ASAP2_VERSION 1 61
/begin PROJECT Econtrols_4G "4G Test"
/begin HEADER "4G A2L Configuration" PROJECT_NO EControls4G /* config for version control */ VERSION "$Revision: 82130 $:" /* config for version control */ /end HEADER
/begin MODULE EControls_4G_SH2A "EControls 4G"
/begin MOD_COMMON "" DEPOSIT ABSOLUTE BYTE_ORDER MSB_FIRST /end MOD_COMMON
/* Define the Record Layouts */
/begin RECORD_LAYOUT ECIPP_ALIGNMENT_UBYTE FNC_VALUES 1 UBYTE COLUMN_DIR DIRECT /end RECORD_LAYOUT
/begin RECORD_LAYOUT ECIPP_ALIGNMENT_UWORD FNC_VALUES 1 UWORD COLUMN_DIR DIRECT /end RECORD_LAYOUT
/begin RECORD_LAYOUT ECIPP_ALIGNMENT_SWORD FNC_VALUES 1 SWORD COLUMN_DIR DIRECT /end RECORD_LAYOUT
/begin RECORD_LAYOUT ECIPP_Lookup_SWORD AXIS_PTS_X 1 SWORD INDEX_INCR DIRECT /end RECORD_LAYOUT
/begin RECORD_LAYOUT ECIPP_ALIGNMENT_FLOAT32_IEEE FNC_VALUES 1 FLOAT32_IEEE COLUMN_DIR DIRECT /end RECORD_LAYOUT
/begin RECORD_LAYOUT ECIPP_Lookup_FLOAT32_IEEE AXIS_PTS_X 1 FLOAT32_IEEE INDEX_INCR DIRECT /end RECORD_LAYOUT
/begin MEASUREMENT ww_Cp_rpm "ww_Cp" UWORD Compu_ww_Cp_rpm 0 0 0 1599.9755859375 ECU_ADDRESS 0x01000248 /end MEASUREMENT
/begin COMPU_METHOD Compu_ww_Cp_rpm " " RAT_FUNC "%.1" "%" COEFFS 0 40.96 0 0 0 1 /end COMPU_METHOD
/begin MEASUREMENT strt_add "Start adder" UWORD Compu_strt_add 0 0 0 6399.90234375 ECU_ADDRESS 0x01000260 /end MEASUREMENT
/begin COMPU_METHOD Compu_strt_add " " RAT_FUNC "%.1" "%" COEFFS 0 10.24 0 0 0 1 /end COMPU_METHOD
/begin MEASUREMENT strt_mult "Start multiplier" UWORD Compu_strt_mult 0 0 0 399.993896484375 ECU_ADDRESS 0x01000268 /end MEASUREMENT
/begin COMPU_METHOD Compu_strt_mult " " RAT_FUNC "%.1" "%" COEFFS 0 163.84 0 0 0 1 /end COMPU_METHOD
/begin MEASUREMENT m_f_start "mass fuel start" UWORD Compu_m_f_start 0 0 0 1023.984375 ECU_ADDRESS 0x01000270 /end MEASUREMENT
/begin COMPU_METHOD Compu_m_f_start " " RAT_FUNC "%.1" "mg/intake" COEFFS 0 64 0 0 0 1 /end COMPU_METHOD
/begin MEASUREMENT m_f_ww1 "mass fuel wall-wet" SWORD Compu_m_f_ww1 0 0 -512 511.984375 ECU_ADDRESS 0x01000278 /end MEASUREMENT
/begin COMPU_METHOD Compu_m_f_ww1 " " RAT_FUNC "%.1" "mg/intake" COEFFS 0 64 0 0 0 1 /end COMPU_METHOD
/begin MEASUREMENT crank_cycles "crank_cycles" UWORD Compu_crank_cycles 0 0 0 255.99609375 ECU_ADDRESS 0x01000290 /end MEASUREMENT
/begin COMPU_METHOD Compu_crank_cycles " " RAT_FUNC "%.2" "cycles" COEFFS 0 256 0 0 0 1 /end COMPU_METHOD
/begin MEASUREMENT m_f_choke "mass fuel choke (primary)" UWORD Compu_m_f_choke 0 0 0 1023.984375 ECU_ADDRESS 0x010002E8 /end MEASUREMENT
/begin COMPU_METHOD Compu_m_f_choke " " RAT_FUNC "%.1" "mg/intake" COEFFS 0 64 0 0 0 1 /end COMPU_METHOD
/begin MEASUREMENT ww_Cn_rpm "ww_Cn" UWORD Compu_ww_Cn_rpm 0 0 0 1599.9755859375 ECU_ADDRESS 0x01000348 /end MEASUREMENT
/begin COMPU_METHOD Compu_ww_Cn_rpm " " RAT_FUNC "%.1" "%" COEFFS 0 40.96 0 0 0 1 /end COMPU_METHOD
/begin CHARACTERISTIC ww_dz "ww_dz" VALUE 0x00147bba /* @ECU_Address@ww_dz@0x01000990@ */ ECIPP_ALIGNMENT_UWORD 100 Compu_ww_dz 0 99.9984741210938 /end CHARACTERISTIC
/begin COMPU_METHOD Compu_ww_dz " " RAT_FUNC "%.2" "%" COEFFS 0 655.36 0 0 0 1 /end COMPU_METHOD
/begin CHARACTERISTIC FSO_ret_init "FSO spark retard max" VALUE 0x00144306 /* @ECU_Address@FSO_ret_init@0x01000AF8@ */ ECIPP_ALIGNMENT_SWORD 2048 Compu_FSO_ret_init -2048 2047.9375 /end CHARACTERISTIC
/begin COMPU_METHOD Compu_FSO_ret_init " " RAT_FUNC "%.1" "CAD" COEFFS 0 16 0 0 0 1 /end COMPU_METHOD
/begin CHARACTERISTIC FSO_ret_decay "FSO retard decay" VALUE 0x001473ca /* @ECU_Address@FSO_ret_decay@0x01000B00@ */ ECIPP_ALIGNMENT_UWORD 500 Compu_FSO_ret_decay 0 499.992370605469 /end CHARACTERISTIC
/begin COMPU_METHOD Compu_FSO_ret_decay " " RAT_FUNC "%.1" "CAD / sec" COEFFS 0 131.072 0 0 0 1 /end COMPU_METHOD
/begin CHARACTERISTIC CWTret_posC "CWT+ retard - gasoline" VALUE 0x00144284 /* @ECU_Address@CWTret_posC@0x01000EA0@ */ ECIPP_ALIGNMENT_SWORD 82 Compu_CWTret_posC -81.92 81.9175 /end CHARACTERISTIC
/begin COMPU_METHOD Compu_CWTret_posC " " RAT_FUNC "%.1" "CAD / %" COEFFS 0 400 0 0 0 1 /end COMPU_METHOD
/begin CHARACTERISTIC CWTretNG_posC "CWT+ retard - NG" VALUE 0x00144288 /* @ECU_Address@CWTretNG_posC@0x01000EB0@ */ ECIPP_ALIGNMENT_SWORD 82 Compu_CWTretNG_posC -81.92 81.9175 /end CHARACTERISTIC
/begin COMPU_METHOD Compu_CWTretNG_posC " " RAT_FUNC "%.1" "CAD / %" COEFFS 0 400 0 0 0 1 /end COMPU_METHOD
/begin CHARACTERISTIC CWTret_negC "CWT- retard - gasoline" VALUE 0x0014427C /* @ECU_Address@CWTret_negC@0x01000EB8@ */ ECIPP_ALIGNMENT_SWORD 82 Compu_CWTret_negC -81.92 81.9175 /end CHARACTERISTIC
/begin COMPU_METHOD Compu_CWTret_negC " " RAT_FUNC "%.1" "CAD / %" COEFFS 0 400 0 0 0 1 /end COMPU_METHOD
/begin CHARACTERISTIC CWTretNG_negC "CWT- retard - NG" VALUE 0x00144280 /* @ECU_Address@CWTretNG_negC@0x01000EC8@ */ ECIPP_ALIGNMENT_SWORD 82 Compu_CWTretNG_negC -81.92 81.9175 /end CHARACTERISTIC
/begin COMPU_METHOD Compu_CWTretNG_negC " " RAT_FUNC "%.1" "CAD / %" COEFFS 0 400 0 0 0 1 /end COMPU_METHOD
/begin MEASUREMENT start_presync "Pre-sync teeth" UWORD Compu_start_presync 0 0 0 65535 ECU_ADDRESS 0x01001138 /end MEASUREMENT
/begin COMPU_METHOD Compu_start_presync " " RAT_FUNC "%.0" "teeth" COEFFS 0 1 0 0 0 1 /end COMPU_METHOD
/begin MEASUREMENT start_postsync "Post-sync teeth to run" UWORD Compu_start_postsync 0 0 0 65535 ECU_ADDRESS 0x01001140 /end MEASUREMENT
/begin COMPU_METHOD Compu_start_postsync " " RAT_FUNC "%.0" "teeth" COEFFS 0 1 0 0 0 1 /end COMPU_METHOD
/begin MEASUREMENT start_tmr "Start time" UWORD Compu_start_tmr 0 0 0 65.535 ECU_ADDRESS 0x01001148 /end MEASUREMENT
/begin COMPU_METHOD Compu_start_tmr " " RAT_FUNC "%.1" "sec" COEFFS 0 1000 0 0 0 1 /end COMPU_METHOD
/begin MEASUREMENT start_rpm_avg "Average start speed" UWORD Compu_start_rpm_avg 0 0 0 65535 ECU_ADDRESS 0x01001150 /end MEASUREMENT
/begin COMPU_METHOD Compu_start_rpm_avg " " RAT_FUNC "%.0" "rpm" COEFFS 0 1 0 0 0 1 /end COMPU_METHOD
/begin MEASUREMENT start_lostsync "Sync-loss events" UBYTE Compu_start_lostsync 0 0 0 255 ECU_ADDRESS 0x01001158 /end MEASUREMENT
/begin COMPU_METHOD Compu_start_lostsync " " RAT_FUNC "%.0" "count" COEFFS 0 1 0 0 0 1 /end COMPU_METHOD
/begin MEASUREMENT start_longtooth "Invalid large-gap events" UBYTE Compu_start_longtooth 0 0 0 255 ECU_ADDRESS 0x01001160 /end MEASUREMENT
/begin COMPU_METHOD Compu_start_longtooth " " RAT_FUNC "%.0" "count" COEFFS 0 1 0 0 0 1 /end COMPU_METHOD
/begin CHARACTERISTIC CHTcrank_Kup "CHTcrank increasing rate" VALUE 0x0014673e /* @ECU_Address@CHTcrank_Kup@0x01001168@ */ ECIPP_ALIGNMENT_UWORD 16 Compu_CHTcrank_Kup 0 15.6247615814209 /end CHARACTERISTIC
/begin COMPU_METHOD Compu_CHTcrank_Kup " " RAT_FUNC "%.2" "deg F / sec / 100% load" COEFFS 0 4194.304 0 0 0 1 /end COMPU_METHOD
/begin CHARACTERISTIC CHTcrank_Kdn "CHTcrank decreasing rate" VALUE 0x0014673c /* @ECU_Address@CHTcrank_Kdn@0x01001170@ */ ECIPP_ALIGNMENT_UWORD 16 Compu_CHTcrank_Kdn 0 15.6247615814209 /end CHARACTERISTIC
/begin COMPU_METHOD Compu_CHTcrank_Kdn " " RAT_FUNC "%.2" "deg F / sec" COEFFS 0 4194.304 0 0 0 1 /end COMPU_METHOD
/begin MEASUREMENT CHTcrank "CHTcrank equivalent" UWORD Compu_CHTcrank 0 0 -460 563.984375 ECU_ADDRESS 0x01001178 /end MEASUREMENT
/begin COMPU_METHOD Compu_CHTcrank " " RAT_FUNC "%.1" "deg F" COEFFS 0 64 29440 0 0 1 /end COMPU_METHOD
/begin MEASUREMENT CHTcrank_delt "CHTcrank delta from CHT" UWORD Compu_CHTcrank_delt 0 0 0 1023.984375 ECU_ADDRESS 0x01001180 /end MEASUREMENT
/begin COMPU_METHOD Compu_CHTcrank_delt " " RAT_FUNC "%.1" "deg F" COEFFS 0 64 0 0 0 1 /end COMPU_METHOD
/begin CHARACTERISTIC CHTcrank_deltmax "CHTcrank delta max" VALUE 0x00146742 /* @ECU_Address@CHTcrank_deltmax@0x01001188@ */ ECIPP_ALIGNMENT_UWORD 1024 Compu_CHTcrank_deltmax 0 1023.984375 /end CHARACTERISTIC
/begin COMPU_METHOD Compu_CHTcrank_deltmax " " RAT_FUNC "%.1" "deg F" COEFFS 0 64 0 0 0 1 /end COMPU_METHOD
/begin CHARACTERISTIC CHTcrank_ceil "CHTcrank ceiling" VALUE 0x00146740 /* @ECU_Address@CHTcrank_ceil@0x01001190@ */ ECIPP_ALIGNMENT_UWORD 564 Compu_CHTcrank_ceil -460 563.984375 /end CHARACTERISTIC
/begin COMPU_METHOD Compu_CHTcrank_ceil " " RAT_FUNC "%.1" "deg F" COEFFS 0 64 29440 0 0 1 /end COMPU_METHOD
/begin MEASUREMENT fuel_shutoff_chk "fuel_shutoff_chk" UBYTE Compu_fuel_shutoff_chk 0 0 0 255 ECU_ADDRESS 0x01001B30 /end MEASUREMENT
/begin COMPU_METHOD Compu_fuel_shutoff_chk " " RAT_FUNC "%.0" "-" COEFFS 0 1 0 0 0 1 /end COMPU_METHOD
/begin MEASUREMENT spark_shutoff_chk "spark_shutoff_chk" UBYTE Compu_spark_shutoff_chk 0 0 0 255 ECU_ADDRESS 0x01001B38 /end MEASUREMENT
/begin COMPU_METHOD Compu_spark_shutoff_chk " " RAT_FUNC "%.0" "-" COEFFS 0 1 0 0 0 1 /end COMPU_METHOD
/begin CHARACTERISTIC alt_coilkill_ena "Gaseous fuel coil kill diagnostic{alt_coilkill_ena&0xff=0:Disallow}{alt_coilkill_ena&0xff=1:Allow}" VALUE 0x001480f4 /* @ECU_Address@alt_coilkill_ena@0x01002260@ */ ECIPP_ALIGNMENT_UBYTE 255 alt_coilkill_ena_COMPU_VTAB 0 255 BIT_MASK 0xff /end CHARACTERISTIC
/begin COMPU_METHOD alt_coilkill_ena_COMPU_VTAB "Verbal Table" TAB_VERB "%.0" "list" COMPU_TAB_REF alt_coilkill_ena_COMPU_VTAB_REF /end COMPU_METHOD
/begin COMPU_VTAB alt_coilkill_ena_COMPU_VTAB_REF "Verbal Table" TAB_VERB 2 0 "Disallow" 1 "Allow" DEFAULT_VALUE "UNKNOWN" /end COMPU_VTAB
/begin CHARACTERISTIC strt_inj_tmng "Start injection timing" VALUE 0x00149060 /* @ECU_Address@strt_inj_tmng@0x010027E8@ */ ECIPP_ALIGNMENT_SWORD 2048 Compu_strt_inj_tmng -2048 2047.9375 /end CHARACTERISTIC
/begin COMPU_METHOD Compu_strt_inj_tmng " " RAT_FUNC "%.0" "CAD BBDCI" COEFFS 0 16 0 0 0 1 /end COMPU_METHOD
/begin CHARACTERISTIC strt_inj_rpm "Start injection timing rpm limit" VALUE 0x00147ba0 /* @ECU_Address@strt_inj_rpm@0x010027F0@ */ ECIPP_ALIGNMENT_UWORD 65535 Compu_strt_inj_rpm 0 65535 /end CHARACTERISTIC
/begin COMPU_METHOD Compu_strt_inj_rpm " " RAT_FUNC "%.0" "rpm" COEFFS 0 1 0 0 0 1 /end COMPU_METHOD
/begin MEASUREMENT MSbasespk "Spark advance test status{MSbasespk&0xff=0:Test Not Started}{MSbasespk&0xff=1:Test Running}{MSbasespk&0xff=2:Test Finished}{MSbasespk&0xff=3:RPM/MAP Too High}{MSbasespk&0xff=4:Condition 2 Not Met}{MSbasespk&0xff=5:Condition 3 Not Met}{MSbasespk&0xff=6:Con" UBYTE MSbasespk_COMPU_VTAB 0 0 0 255 ECU_ADDRESS 0x010032F0 BIT_MASK 0xff /end MEASUREMENT
/begin COMPU_METHOD MSbasespk_COMPU_VTAB "Verbal Table" TAB_VERB "%.0" "list" COMPU_TAB_REF MSbasespk_COMPU_VTAB_REF /end COMPU_METHOD
/begin COMPU_VTAB MSbasespk_COMPU_VTAB_REF "Verbal Table" TAB_VERB 8 0 "Test Not Started" 1 "Test Running" 2 "Test Finished" 3 "RPM/MAP Too High" 4 "Condition 2 Not Met" 5 "Condition 3 Not Met" 6 "Condition 4 Not Met" 7 "Cannot Start Test" DEFAULT_VALUE "UNKNOWN" /end COMPU_VTAB
/begin MEASUREMENT MSIAC "IAC test status{MSIAC&0xff=0:Test Not Started}{MSIAC&0xff=1:Test Running}{MSIAC&0xff=2:Test Finished}{MSIAC&0xff=3:Condition 1 Not Met}{MSIAC&0xff=4:Condition 2 Not Met}{MSIAC&0xff=5:Condition 3 Not Met}{MSIAC&0xff=6:Condition 4 Not Met}{MSIAC&0xff=7:Cann" UBYTE MSIAC_COMPU_VTAB 0 0 0 255 ECU_ADDRESS 0x01003320 BIT_MASK 0xff /end MEASUREMENT
/begin COMPU_METHOD MSIAC_COMPU_VTAB "Verbal Table" TAB_VERB "%.0" "list" COMPU_TAB_REF MSIAC_COMPU_VTAB_REF /end COMPU_METHOD
/begin COMPU_VTAB MSIAC_COMPU_VTAB_REF "Verbal Table" TAB_VERB 8 0 "Test Not Started" 1 "Test Running" 2 "Test Finished" 3 "Condition 1 Not Met" 4 "Condition 2 Not Met" 5 "Condition 3 Not Met" 6 "Condition 4 Not Met" 7 "Cannot Start Test" DEFAULT_VALUE "UNKNOWN" /end COMPU_VTAB
/begin MEASUREMENT MSidle_spd "Idle speed test status{MSidle_spd&0xff=0:Test Not Started}{MSidle_spd&0xff=1:Test Running}{MSidle_spd&0xff=2:Test Finished}{MSidle_spd&0xff=3:Condition 1 Not Met}{MSidle_spd&0xff=4:Condition 2 Not Met}{MSidle_spd&0xff=5:Condition 3 Not Met}{MSidle_spd&0xf" UBYTE MSidle_spd_COMPU_VTAB 0 0 0 255 ECU_ADDRESS 0x01003328 BIT_MASK 0xff /end MEASUREMENT
/begin COMPU_METHOD MSidle_spd_COMPU_VTAB "Verbal Table" TAB_VERB "%.0" "list" COMPU_TAB_REF MSidle_spd_COMPU_VTAB_REF /end COMPU_METHOD
/begin COMPU_VTAB MSidle_spd_COMPU_VTAB_REF "Verbal Table" TAB_VERB 8 0 "Test Not Started" 1 "Test Running" 2 "Test Finished" 3 "Condition 1 Not Met" 4 "Condition 2 Not Met" 5 "Condition 3 Not Met" 6 "Condition 4 Not Met" 7 "Cannot Start Test" DEFAULT_VALUE "UNKNOWN" /end COMPU_VTAB
/begin CHARACTERISTIC basespk_adv "Diagnostic spark advance" VALUE 0x0014658e /* @ECU_Address@basespk_adv@0x01003340@ */ ECIPP_ALIGNMENT_SWORD 2048 Compu_basespk_adv -2048 2047.9375 /end CHARACTERISTIC
/begin COMPU_METHOD Compu_basespk_adv " " RAT_FUNC "%.1" "CAD BTDC" COEFFS 0 16 0 0 0 1 /end COMPU_METHOD
/begin CHARACTERISTIC basespk_rpm "Diagnostic advance RPM limit" VALUE 0x00147a7a /* @ECU_Address@basespk_rpm@0x01003348@ */ ECIPP_ALIGNMENT_UWORD 65535 Compu_basespk_rpm 0 65535 /end CHARACTERISTIC
/begin COMPU_METHOD Compu_basespk_rpm " " RAT_FUNC "%.0" "rpm" COEFFS 0 1 0 0 0 1 /end COMPU_METHOD
/begin CHARACTERISTIC basespk_MAP "Diagnostic advance MAP limit" VALUE 0x00147a78 /* @ECU_Address@basespk_MAP@0x01003350@ */ ECIPP_ALIGNMENT_UWORD 256 Compu_basespk_MAP 0 255.99609375 /end CHARACTERISTIC
/begin COMPU_METHOD Compu_basespk_MAP " " RAT_FUNC "%.2" "psia" COEFFS 0 256 0 0 0 1 /end COMPU_METHOD
/begin MEASUREMENT TSTbasespk "Spark advance test command{TSTbasespk&0xff=0:Disabled}{TSTbasespk&0xff=1:Active}" UBYTE TSTbasespk_COMPU_VTAB 0 0 0 255 ECU_ADDRESS 0x01003358 BIT_MASK 0xff /end MEASUREMENT
/begin COMPU_METHOD TSTbasespk_COMPU_VTAB "Verbal Table" TAB_VERB "%.0" "list" COMPU_TAB_REF TSTbasespk_COMPU_VTAB_REF /end COMPU_METHOD
/begin COMPU_VTAB TSTbasespk_COMPU_VTAB_REF "Verbal Table" TAB_VERB 2 0 "Disabled" 1 "Active" DEFAULT_VALUE "UNKNOWN" /end COMPU_VTAB
/begin CHARACTERISTIC Tspkf_duration "Spark firing test duration" VALUE 0x001479b6 /* @ECU_Address@Tspkf_duration@0x01003360@ */ ECIPP_ALIGNMENT_UWORD 66 Compu_Tspkf_duration 0 65.535 /end CHARACTERISTIC
/begin COMPU_METHOD Compu_Tspkf_duration " " RAT_FUNC "%.1" "sec" COEFFS 0 1000 0 0 0 1 /end COMPU_METHOD
/begin CHARACTERISTIC Tspkf_ena "Spark firing test permission{Tspkf_ena&0xff=0:Not Allowed}{Tspkf_ena&0xff=1:Allowed}" VALUE 0x001480ce /* @ECU_Address@Tspkf_ena@0x01003368@ */ ECIPP_ALIGNMENT_UBYTE 255 Tspkf_ena_COMPU_VTAB 0 255 BIT_MASK 0xff /end CHARACTERISTIC
/begin COMPU_METHOD Tspkf_ena_COMPU_VTAB "Verbal Table" TAB_VERB "%.0" "list" COMPU_TAB_REF Tspkf_ena_COMPU_VTAB_REF /end COMPU_METHOD
/begin COMPU_VTAB Tspkf_ena_COMPU_VTAB_REF "Verbal Table" TAB_VERB 2 0 "Not Allowed" 1 "Allowed" DEFAULT_VALUE "UNKNOWN" /end COMPU_VTAB
/begin MEASUREMENT Tinjf_duration "Injector firing test duration" UWORD Compu_Tinjf_duration 0 0 0 209.712 ECU_ADDRESS 0x01003378 /end MEASUREMENT
/begin COMPU_METHOD Compu_Tinjf_duration " " RAT_FUNC "%.2" "ms" COEFFS 0 312.5 0 0 0 1 /end COMPU_METHOD
/begin CHARACTERISTIC Tinjf_duration_def "Default injector firing test duration" VALUE 0x00147988 /* @ECU_Address@Tinjf_duration_def@0x01003380@ */ ECIPP_ALIGNMENT_UWORD 210 Compu_Tinjf_duration_def 0 209.712 /end CHARACTERISTIC
/begin COMPU_METHOD Compu_Tinjf_duration_def " " RAT_FUNC "%.2" "ms" COEFFS 0 312.5 0 0 0 1 /end COMPU_METHOD
/begin CHARACTERISTIC Tinjf_unlatch_revs "Injector firing test engine clearing" VALUE 0x0014798a /* @ECU_Address@Tinjf_unlatch_revs@0x01003390@ */ ECIPP_ALIGNMENT_UWORD 256 Compu_Tinjf_unlatch_revs 0 255.99609375 /end CHARACTERISTIC
/begin COMPU_METHOD Compu_Tinjf_unlatch_revs " " RAT_FUNC "%.1" "revs" COEFFS 0 256 0 0 0 1 /end COMPU_METHOD
/begin MEASUREMENT TSTIAC "IAC test command{TSTIAC&0xff=0:Disabled}{TSTIAC&0xff=1:Closed-Home Sequence}{TSTIAC&0xff=2:Full-Open Sequence}" UBYTE TSTIAC_COMPU_VTAB 0 0 0 255 ECU_ADDRESS 0x010033A0 BIT_MASK 0xff /end MEASUREMENT
/begin COMPU_METHOD TSTIAC_COMPU_VTAB "Verbal Table" TAB_VERB "%.0" "list" COMPU_TAB_REF TSTIAC_COMPU_VTAB_REF /end COMPU_METHOD
/begin COMPU_VTAB TSTIAC_COMPU_VTAB_REF "Verbal Table" TAB_VERB 3 0 "Disabled" 1 "Closed-Home Sequence" 2 "Full-Open Sequence" DEFAULT_VALUE "UNKNOWN" /end COMPU_VTAB
/begin CHARACTERISTIC Tidlspd_rpm_min "Minimum allowed test idle speed" VALUE 0x00147984 /* @ECU_Address@Tidlspd_rpm_min@0x010033A8@ */ ECIPP_ALIGNMENT_UWORD 65535 Compu_Tidlspd_rpm_min 0 65535 /end CHARACTERISTIC
/begin COMPU_METHOD Compu_Tidlspd_rpm_min " " RAT_FUNC "%.0" "rpm" COEFFS 0 1 0 0 0 1 /end COMPU_METHOD
/begin CHARACTERISTIC Tidlspd_rpm_max "Maximum allowed test idle speed" VALUE 0x00147982 /* @ECU_Address@Tidlspd_rpm_max@0x010033B0@ */ ECIPP_ALIGNMENT_UWORD 65535 Compu_Tidlspd_rpm_max 0 65535 /end CHARACTERISTIC
/begin COMPU_METHOD Compu_Tidlspd_rpm_max " " RAT_FUNC "%.0" "rpm" COEFFS 0 1 0 0 0 1 /end COMPU_METHOD
/begin MEASUREMENT TSTidle_spd "Idle speed test command{TSTidle_spd&0xff=0:Disabled}{TSTidle_spd&0xff=1:Active}" UBYTE TSTidle_spd_COMPU_VTAB 0 0 0 255 ECU_ADDRESS 0x010033B8 BIT_MASK 0xff /end MEASUREMENT
/begin COMPU_METHOD TSTidle_spd_COMPU_VTAB "Verbal Table" TAB_VERB "%.0" "list" COMPU_TAB_REF TSTidle_spd_COMPU_VTAB_REF /end COMPU_METHOD
/begin COMPU_VTAB TSTidle_spd_COMPU_VTAB_REF "Verbal Table" TAB_VERB 2 0 "Disabled" 1 "Active" DEFAULT_VALUE "UNKNOWN" /end COMPU_VTAB
/begin MEASUREMENT TSTidle_spd_rpm "Idle speed test target" UWORD Compu_TSTidle_spd_rpm 0 0 0 65535 ECU_ADDRESS 0x010033C0 /end MEASUREMENT
/begin COMPU_METHOD Compu_TSTidle_spd_rpm " " RAT_FUNC "%.0" "rpm" COEFFS 0 1 0 0 0 1 /end COMPU_METHOD
/begin CHARACTERISTIC Tidlspd_FPP_max "Maximum throttle command" VALUE 0x00147980 /* @ECU_Address@Tidlspd_FPP_max@0x010033C8@ */ ECIPP_ALIGNMENT_UWORD 100 Compu_Tidlspd_FPP_max 0 99.9984741210938 /end CHARACTERISTIC
/begin COMPU_METHOD Compu_Tidlspd_FPP_max " " RAT_FUNC "%.1" "%" COEFFS 0 655.36 0 0 0 1 /end COMPU_METHOD
/begin MEASUREMENT IAC_faultstat "IAC electrical status{IAC_faultstat&0xff=0:OK-warm}{IAC_faultstat&0xff=1:Coil open/short}{IAC_faultstat&0xff=2:Ground short}{IAC_faultstat&0xff=3:OK}" SBYTE IAC_faultstat_COMPU_VTAB 0 0 -128 127 ECU_ADDRESS 0x010033E8 BIT_MASK 0xff /end MEASUREMENT
/begin COMPU_METHOD IAC_faultstat_COMPU_VTAB "Verbal Table" TAB_VERB "%.0" "list" COMPU_TAB_REF IAC_faultstat_COMPU_VTAB_REF /end COMPU_METHOD
/begin COMPU_VTAB IAC_faultstat_COMPU_VTAB_REF "Verbal Table" TAB_VERB 4 0 "OK-warm" 1 "Coil open/short" 2 "Ground short" 3 "OK" DEFAULT_VALUE "UNKNOWN" /end COMPU_VTAB
/begin MEASUREMENT LSD_diag_relay "Power relay electical status{LSD_diag_relay&0xff=0:Ground short}{LSD_diag_relay&0xff=1:Open load}{LSD_diag_relay&0xff=2:Power short}{LSD_diag_relay&0xff=3:OK}" UBYTE LSD_diag_relay_COMPU_VTAB 0 0 0 255 ECU_ADDRESS 0x010033F0 BIT_MASK 0xff /end MEASUREMENT
/begin COMPU_METHOD LSD_diag_relay_COMPU_VTAB "Verbal Table" TAB_VERB "%.0" "list" COMPU_TAB_REF LSD_diag_relay_COMPU_VTAB_REF /end COMPU_METHOD
/begin COMPU_VTAB LSD_diag_relay_COMPU_VTAB_REF "Verbal Table" TAB_VERB 4 0 "Ground short" 1 "Open load" 2 "Power short" 3 "OK" DEFAULT_VALUE "UNKNOWN" /end COMPU_VTAB
/begin MEASUREMENT LSD_diag_FPrly "Fuel-pump relay electrical status{LSD_diag_FPrly&0xff=0:Ground short}{LSD_diag_FPrly&0xff=1:Open load}{LSD_diag_FPrly&0xff=2:Power short}{LSD_diag_FPrly&0xff=3:OK}" UBYTE LSD_diag_FPrly_COMPU_VTAB 0 0 0 255 ECU_ADDRESS 0x01003400 BIT_MASK 0xff /end MEASUREMENT
/begin COMPU_METHOD LSD_diag_FPrly_COMPU_VTAB "Verbal Table" TAB_VERB "%.0" "list" COMPU_TAB_REF LSD_diag_FPrly_COMPU_VTAB_REF /end COMPU_METHOD
/begin COMPU_VTAB LSD_diag_FPrly_COMPU_VTAB_REF "Verbal Table" TAB_VERB 4 0 "Ground short" 1 "Open load" 2 "Power short" 3 "OK" DEFAULT_VALUE "UNKNOWN" /end COMPU_VTAB
/begin MEASUREMENT LSD_diag_buzz "Buzzer electrical status{LSD_diag_buzz&0xff=0:Ground short}{LSD_diag_buzz&0xff=1:Open load}{LSD_diag_buzz&0xff=2:Power short}{LSD_diag_buzz&0xff=3:OK}" UBYTE LSD_diag_buzz_COMPU_VTAB 0 0 0 255 ECU_ADDRESS 0x01003408 BIT_MASK 0xff /end MEASUREMENT
/begin COMPU_METHOD LSD_diag_buzz_COMPU_VTAB "Verbal Table" TAB_VERB "%.0" "list" COMPU_TAB_REF LSD_diag_buzz_COMPU_VTAB_REF /end COMPU_METHOD
/begin COMPU_VTAB LSD_diag_buzz_COMPU_VTAB_REF "Verbal Table" TAB_VERB 4 0 "Ground short" 1 "Open load" 2 "Power short" 3 "OK" DEFAULT_VALUE "UNKNOWN" /end COMPU_VTAB
/begin MEASUREMENT LSD_diag_MIL "MIL electrical status{LSD_diag_MIL&0xff=0:Ground short}{LSD_diag_MIL&0xff=1:Open load}{LSD_diag_MIL&0xff=2:Power short}{LSD_diag_MIL&0xff=3:OK}" UBYTE LSD_diag_MIL_COMPU_VTAB 0 0 0 255 ECU_ADDRESS 0x01003410 BIT_MASK 0xff /end MEASUREMENT
/begin COMPU_METHOD LSD_diag_MIL_COMPU_VTAB "Verbal Table" TAB_VERB "%.0" "list" COMPU_TAB_REF LSD_diag_MIL_COMPU_VTAB_REF /end COMPU_METHOD
/begin COMPU_VTAB LSD_diag_MIL_COMPU_VTAB_REF "Verbal Table" TAB_VERB 4 0 "Ground short" 1 "Open load" 2 "Power short" 3 "OK" DEFAULT_VALUE "UNKNOWN" /end COMPU_VTAB
/begin MEASUREMENT LSD_diag_tach "Tach output electrical status{LSD_diag_tach&0xff=0:Ground short}{LSD_diag_tach&0xff=1:Open load}{LSD_diag_tach&0xff=2:Power short}{LSD_diag_tach&0xff=3:OK}" UBYTE LSD_diag_tach_COMPU_VTAB 0 0 0 255 ECU_ADDRESS 0x01003418 BIT_MASK 0xff /end MEASUREMENT
/begin COMPU_METHOD LSD_diag_tach_COMPU_VTAB "Verbal Table" TAB_VERB "%.0" "list" COMPU_TAB_REF LSD_diag_tach_COMPU_VTAB_REF /end COMPU_METHOD
/begin COMPU_VTAB LSD_diag_tach_COMPU_VTAB_REF "Verbal Table" TAB_VERB 4 0 "Ground short" 1 "Open load" 2 "Power short" 3 "OK" DEFAULT_VALUE "UNKNOWN" /end COMPU_VTAB
/begin CHARACTERISTIC cam_pos_std "Cam position desired value" VALUE 0x001465a8 /* @ECU_Address@cam_pos_std@0x01003578@ */ ECIPP_ALIGNMENT_SWORD 16384 Compu_cam_pos_std -16384 16383.5 /end CHARACTERISTIC
/begin COMPU_METHOD Compu_cam_pos_std " " RAT_FUNC "%.0" "CAD BTDC" COEFFS 0 2 0 0 0 1 /end COMPU_METHOD
/begin MEASUREMENT cam_pos_CAD "Cam position" SWORD Compu_cam_pos_CAD 0 0 -2048 2047.9375 ECU_ADDRESS 0x01003580 /end MEASUREMENT
/begin COMPU_METHOD Compu_cam_pos_CAD " " RAT_FUNC "%.0" "CAD BTDC" COEFFS 0 16 0 0 0 1 /end COMPU_METHOD
/begin MEASUREMENT CCDL_ena "Crank/Cam data log system{CCDL_ena&0xff=0:Off}{CCDL_ena&0xff=1:On}" UBYTE CCDL_ena_COMPU_VTAB 0 0 0 255 ECU_ADDRESS 0x010043B0 BIT_MASK 0xff /end MEASUREMENT
/begin COMPU_METHOD CCDL_ena_COMPU_VTAB "Verbal Table" TAB_VERB "%.0" "list" COMPU_TAB_REF CCDL_ena_COMPU_VTAB_REF /end COMPU_METHOD
/begin COMPU_VTAB CCDL_ena_COMPU_VTAB_REF "Verbal Table" TAB_VERB 2 0 "Off" 1 "On" DEFAULT_VALUE "UNKNOWN" /end COMPU_VTAB
/begin MEASUREMENT CCDL_reset "Crank/Cam data log{CCDL_reset&0xff=0:Reset}{CCDL_reset&0xff=1:Resetting...}" UBYTE CCDL_reset_COMPU_VTAB 0 0 0 255 ECU_ADDRESS 0x010043B8 BIT_MASK 0xff /end MEASUREMENT
/begin COMPU_METHOD CCDL_reset_COMPU_VTAB "Verbal Table" TAB_VERB "%.0" "list" COMPU_TAB_REF CCDL_reset_COMPU_VTAB_REF /end COMPU_METHOD
/begin COMPU_VTAB CCDL_reset_COMPU_VTAB_REF "Verbal Table" TAB_VERB 2 0 "Reset" 1 "Resetting..." DEFAULT_VALUE "UNKNOWN" /end COMPU_VTAB
/begin MEASUREMENT CCDL_forcetrig "Crank/Cam data log{CCDL_forcetrig&0xff=0:Force Trig}{CCDL_forcetrig&0xff=1:Triggering...}" UBYTE CCDL_forcetrig_COMPU_VTAB 0 0 0 255 ECU_ADDRESS 0x010043C0 BIT_MASK 0xff /end MEASUREMENT
/begin COMPU_METHOD CCDL_forcetrig_COMPU_VTAB "Verbal Table" TAB_VERB "%.0" "list" COMPU_TAB_REF CCDL_forcetrig_COMPU_VTAB_REF /end COMPU_METHOD
/begin COMPU_VTAB CCDL_forcetrig_COMPU_VTAB_REF "Verbal Table" TAB_VERB 2 0 "Force Trig" 1 "Triggering..." DEFAULT_VALUE "UNKNOWN" /end COMPU_VTAB
/begin MEASUREMENT CCDL_status "Crank/Cam data log status{CCDL_status&0xff=0:Offline}{CCDL_status&0xff=1:Initializing}{CCDL_status&0xff=2:Armed - Waiting for Trig}{CCDL_status&0xff=3:Triggered - Acquiring...}{CCDL_status&0xff=4:Holding - Data Acquired}" UBYTE CCDL_status_COMPU_VTAB 0 0 0 255 ECU_ADDRESS 0x010043C8 BIT_MASK 0xff /end MEASUREMENT
/begin COMPU_METHOD CCDL_status_COMPU_VTAB "Verbal Table" TAB_VERB "%.0" "list" COMPU_TAB_REF CCDL_status_COMPU_VTAB_REF /end COMPU_METHOD
/begin COMPU_VTAB CCDL_status_COMPU_VTAB_REF "Verbal Table" TAB_VERB 5 0 "Offline" 1 "Initializing" 2 "Armed - Waiting for Trig" 3 "Triggered - Acquiring..." 4 "Holding - Data Acquired" DEFAULT_VALUE "UNKNOWN" /end COMPU_VTAB
/begin CHARACTERISTIC basespk_ena "Diagnostic spark advance input{basespk_ena&0xff=0:Software Switch}{basespk_ena&0xff=1:Aux PU1}{basespk_ena&0xff=2:Aux PU2}{basespk_ena&0xff=3:Aux PU3}{basespk_ena&0xff=4:Aux PUD1}{basespk_ena&0xff=5:Aux PUD2}{basespk_ena&0xff=6:Aux PUD3}{basespk_ena&0xff=" VALUE 0x001480f9 /* @ECU_Address@basespk_ena@0x01004598@ */ ECIPP_ALIGNMENT_UBYTE 255 basespk_ena_COMPU_VTAB 0 255 BIT_MASK 0xff /end CHARACTERISTIC
/begin COMPU_METHOD basespk_ena_COMPU_VTAB "Verbal Table" TAB_VERB "%.0" "list" COMPU_TAB_REF basespk_ena_COMPU_VTAB_REF /end COMPU_METHOD
/begin COMPU_VTAB basespk_ena_COMPU_VTAB_REF "Verbal Table" TAB_VERB 10 0 "Software Switch" 1 "Aux PU1" 2 "Aux PU2" 3 "Aux PU3" 4 "Aux PUD1" 5 "Aux PUD2" 6 "Aux PUD3" 7 "Aux DIG1" 8 "Aux DIG2" 9 "Aux DIG3" DEFAULT_VALUE "UNKNOWN" /end COMPU_VTAB
/begin CHARACTERISTIC Tcmp_input_trig "Compression test trigger type{Tcmp_input_trig&0xff=0:Software Switch}{Tcmp_input_trig&0xff=1:Aux PU1}{Tcmp_input_trig&0xff=2:Aux PU2}{Tcmp_input_trig&0xff=3:Aux PU3}{Tcmp_input_trig&0xff=4:Aux PUD1}{Tcmp_input_trig&0xff=5:Aux PUD2}{Tcmp_input_trig&0xff=6:" VALUE 0x001480ca /* @ECU_Address@Tcmp_input_trig@0x010045C0@ */ ECIPP_ALIGNMENT_UBYTE 255 Tcmp_input_trig_COMPU_VTAB 0 255 BIT_MASK 0xff /end CHARACTERISTIC
/begin COMPU_METHOD Tcmp_input_trig_COMPU_VTAB "Verbal Table" TAB_VERB "%.0" "list" COMPU_TAB_REF Tcmp_input_trig_COMPU_VTAB_REF /end COMPU_METHOD
/begin COMPU_VTAB Tcmp_input_trig_COMPU_VTAB_REF "Verbal Table" TAB_VERB 13 0 "Software Switch" 1 "Aux PU1" 2 "Aux PU2" 3 "Aux PU3" 4 "Aux PUD1" 5 "Aux PUD2" 6 "Aux PUD3" 7 "Aux DIG1" 8 "Aux DIG2" 9 "Aux DIG3" 10 "Fuel Switch=Gasoline" 11 "Fuel Switch=LPG" 12 "Fuel Switch=NG" DEFAULT_VALUE "UNKNOWN" /end COMPU_VTAB
/begin CHARACTERISTIC TD_cyl_smr "Cylinder smear" VALUE 0x00147856 /* @ECU_Address@TD_cyl_smr@0x01004998@ */ ECIPP_ALIGNMENT_UWORD 2 Compu_TD_cyl_smr 0 1.99996948242188 /end CHARACTERISTIC
/begin COMPU_METHOD Compu_TD_cyl_smr " " RAT_FUNC "%.2" "-" COEFFS 0 32768 0 0 0 1 /end COMPU_METHOD
/begin MEASUREMENT TDR_cyl_dly "Cylinder rotational delay" UWORD Compu_TDR_cyl_dly 0 0 0 2047.96875 ECU_ADDRESS 0x010049A8 /end MEASUREMENT
/begin COMPU_METHOD Compu_TDR_cyl_dly " " RAT_FUNC "%.0" "CAD" COEFFS 0 32 0 0 0 1 /end COMPU_METHOD
/begin MEASUREMENT TDM_cyl_td "Cylinder delay" UWORD Compu_TDM_cyl_td 0 0 0 5119.921875 ECU_ADDRESS 0x010049B0 /end MEASUREMENT
/begin COMPU_METHOD Compu_TDM_cyl_td " " RAT_FUNC "%.0" "ms" COEFFS 0 12.8 0 0 0 1 /end COMPU_METHOD
/begin CHARACTERISTIC TD_exh_smr "Exhaust manifold smear" VALUE 0x00147858 /* @ECU_Address@TD_exh_smr@0x010049B8@ */ ECIPP_ALIGNMENT_UWORD 2 Compu_TD_exh_smr 0 1.99996948242188 /end CHARACTERISTIC
/begin COMPU_METHOD Compu_TD_exh_smr " " RAT_FUNC "%.2" "-" COEFFS 0 32768 0 0 0 1 /end COMPU_METHOD
/begin MEASUREMENT TDM_exh_m "Exhaust manifold mass" UWORD Compu_TDM_exh_m 0 0 0 63.9990234375 ECU_ADDRESS 0x010049C0 /end MEASUREMENT
/begin COMPU_METHOD Compu_TDM_exh_m " " RAT_FUNC "%.2" "g" COEFFS 0 1024 0 0 0 1 /end COMPU_METHOD
/begin MEASUREMENT TDM_exh_td "Exhaust manifold delay" UWORD Compu_TDM_exh_td 0 0 0 5119.921875 ECU_ADDRESS 0x010049C8 /end MEASUREMENT
/begin COMPU_METHOD Compu_TDM_exh_td " " RAT_FUNC "%.0" "ms" COEFFS 0 12.8 0 0 0 1 /end COMPU_METHOD
/begin MEASUREMENT TD_dly "Total transport delay" UWORD Compu_TD_dly 0 0 0 65535 ECU_ADDRESS 0x010049D0 /end MEASUREMENT
/begin COMPU_METHOD Compu_TD_dly " " RAT_FUNC "%.0" "ms" COEFFS 0 1 0 0 0 1 /end COMPU_METHOD
/begin MEASUREMENT CLBM1_EGO_o "EGO sensor out" SWORD Compu_CLBM1_EGO_o 0 0 -100 99.9969482421875 ECU_ADDRESS 0x010049D8 /end MEASUREMENT
/begin COMPU_METHOD Compu_CLBM1_EGO_o " " RAT_FUNC "%.2" "-" COEFFS 0 327.68 0 0 0 1 /end COMPU_METHOD
/begin MEASUREMENT CLBM2_EGO_o "EGO sensor out (2)" SWORD Compu_CLBM2_EGO_o 0 0 -100 99.9969482421875 ECU_ADDRESS 0x010049E0 /end MEASUREMENT
/begin COMPU_METHOD Compu_CLBM2_EGO_o " " RAT_FUNC "%.2" "-" COEFFS 0 327.68 0 0 0 1 /end COMPU_METHOD
/begin MEASUREMENT TDE_enable "Measure transport delay{TDE_enable&0xff=0:Disabled}{TDE_enable&0xff=1:Enabled}" UBYTE TDE_enable_COMPU_VTAB 0 0 0 255 ECU_ADDRESS 0x010049E8 BIT_MASK 0xff /end MEASUREMENT
/begin COMPU_METHOD TDE_enable_COMPU_VTAB "Verbal Table" TAB_VERB "%.0" "list" COMPU_TAB_REF TDE_enable_COMPU_VTAB_REF /end COMPU_METHOD
/begin COMPU_VTAB TDE_enable_COMPU_VTAB_REF "Verbal Table" TAB_VERB 2 0 "Disabled" 1 "Enabled" DEFAULT_VALUE "UNKNOWN" /end COMPU_VTAB
/begin MEASUREMENT TDE_CL_edge "Measured delay edge{TDE_CL_edge&0xff=0:Rich-to-lean}{TDE_CL_edge&0xff=1:Lean-to-rich}" UBYTE TDE_CL_edge_COMPU_VTAB 0 0 0 255 ECU_ADDRESS 0x010049F0 BIT_MASK 0xff /end MEASUREMENT
/begin COMPU_METHOD TDE_CL_edge_COMPU_VTAB "Verbal Table" TAB_VERB "%.0" "list" COMPU_TAB_REF TDE_CL_edge_COMPU_VTAB_REF /end COMPU_METHOD
/begin COMPU_VTAB TDE_CL_edge_COMPU_VTAB_REF "Verbal Table" TAB_VERB 2 0 "Rich-to-lean" 1 "Lean-to-rich" DEFAULT_VALUE "UNKNOWN" /end COMPU_VTAB
/begin MEASUREMENT TDE_CL_bank "Measured delay bank{TDE_CL_bank&0xff=0:Bank 1}{TDE_CL_bank&0xff=1:Bank 2}" UBYTE TDE_CL_bank_COMPU_VTAB 0 0 0 255 ECU_ADDRESS 0x010049F8 BIT_MASK 0xff /end MEASUREMENT
/begin COMPU_METHOD TDE_CL_bank_COMPU_VTAB "Verbal Table" TAB_VERB "%.0" "list" COMPU_TAB_REF TDE_CL_bank_COMPU_VTAB_REF /end COMPU_METHOD
/begin COMPU_VTAB TDE_CL_bank_COMPU_VTAB_REF "Verbal Table" TAB_VERB 2 0 "Bank 1" 1 "Bank 2" DEFAULT_VALUE "UNKNOWN" /end COMPU_VTAB
/begin MEASUREMENT TDE_CL_ego "Measured delay EGO{TDE_CL_ego&0xff=0:EGO 1}{TDE_CL_ego&0xff=1:EGO 2}{TDE_CL_ego&0xff=2:EGO 3}{TDE_CL_ego&0xff=3:EGO 4}" UBYTE TDE_CL_ego_COMPU_VTAB 0 0 0 255 ECU_ADDRESS 0x01004A00 BIT_MASK 0xff /end MEASUREMENT
/begin COMPU_METHOD TDE_CL_ego_COMPU_VTAB "Verbal Table" TAB_VERB "%.0" "list" COMPU_TAB_REF TDE_CL_ego_COMPU_VTAB_REF /end COMPU_METHOD
/begin COMPU_VTAB TDE_CL_ego_COMPU_VTAB_REF "Verbal Table" TAB_VERB 4 0 "EGO 1" 1 "EGO 2" 2 "EGO 3" 3 "EGO 4" DEFAULT_VALUE "UNKNOWN" /end COMPU_VTAB
/begin MEASUREMENT TDE_td_min "Minimum transport delay" UWORD Compu_TDE_td_min 0 0 0 65535 ECU_ADDRESS 0x01004A08 /end MEASUREMENT
/begin COMPU_METHOD Compu_TDE_td_min " " RAT_FUNC "%.0" "-" COEFFS 0 1 0 0 0 1 /end COMPU_METHOD
/begin MEASUREMENT TDE_td_max "Maximum transport delay" UWORD Compu_TDE_td_max 0 0 0 65535 ECU_ADDRESS 0x01004A10 /end MEASUREMENT
/begin COMPU_METHOD Compu_TDE_td_max " " RAT_FUNC "%.0" "ms" COEFFS 0 1 0 0 0 1 /end COMPU_METHOD
/begin MEASUREMENT TDE_state "Measured delay state{TDE_state&0xff=0x00:Initialization}{TDE_state&0xff=0x01:Wait for CL transition}{TDE_state&0xff=0x02:Wait for minimum TD time}{TDE_state&0xff=0x03:Check CL transition}{TDE_state&0xff=0x04:CL transition invalid}{TDE_state&0xff=0x05:Wait" UBYTE TDE_state_COMPU_VTAB 0 0 0 255 ECU_ADDRESS 0x01004A18 BIT_MASK 0xff /end MEASUREMENT
/begin COMPU_METHOD TDE_state_COMPU_VTAB "Verbal Table" TAB_VERB "%.0" "list" COMPU_TAB_REF TDE_state_COMPU_VTAB_REF /end COMPU_METHOD
/begin COMPU_VTAB TDE_state_COMPU_VTAB_REF "Verbal Table" TAB_VERB 8 0x00 "Initialization" 0x01 "Wait for CL transition" 0x02 "Wait for minimum TD time" 0x03 "Check CL transition" 0x04 "CL transition invalid" 0x05 "Wait for EGO transition" 0x06 "EGO transition invalid" 0x07 "Calculate EGO transition time" DEFAULT_VALUE "UNKNOWN" /end COMPU_VTAB
/begin MEASUREMENT TDE_CLe_cnt "Measured CL transition errors" UBYTE Compu_TDE_CLe_cnt 0 0 0 255 ECU_ADDRESS 0x01004A20 /end MEASUREMENT
/begin COMPU_METHOD Compu_TDE_CLe_cnt " " RAT_FUNC "%.0" "-" COEFFS 0 1 0 0 0 1 /end COMPU_METHOD
/begin MEASUREMENT TDE_EGOe_cnt "Measured EGO transition errors" UBYTE Compu_TDE_EGOe_cnt 0 0 0 255 ECU_ADDRESS 0x01004A28 /end MEASUREMENT
/begin COMPU_METHOD Compu_TDE_EGOe_cnt " " RAT_FUNC "%.0" "-" COEFFS 0 1 0 0 0 1 /end COMPU_METHOD
/begin MEASUREMENT TDE_cnt "Measured valid samples" UWORD Compu_TDE_cnt 0 0 0 65535 ECU_ADDRESS 0x01004A30 /end MEASUREMENT
/begin COMPU_METHOD Compu_TDE_cnt " " RAT_FUNC "%.0" "-" COEFFS 0 1 0 0 0 1 /end COMPU_METHOD
/begin MEASUREMENT TDE_td_inst "Measured transport delay" UWORD Compu_TDE_td_inst 0 0 0 65535 ECU_ADDRESS 0x01004A38 /end MEASUREMENT
/begin COMPU_METHOD Compu_TDE_td_inst " " RAT_FUNC "%.0" "ms" COEFFS 0 1 0 0 0 1 /end COMPU_METHOD
/begin MEASUREMENT TDE_error "Transport delay model error" SWORD Compu_TDE_error 0 0 -32768 32767 ECU_ADDRESS 0x01004A40 /end MEASUREMENT
/begin COMPU_METHOD Compu_TDE_error " " RAT_FUNC "%.0" "-" COEFFS 0 1 0 0 0 1 /end COMPU_METHOD
/begin CHARACTERISTIC FuelSpk_SD_input "Fuel/Spark inhibit input select{FuelSpk_SD_input&0xff=0:Disabled}{FuelSpk_SD_input&0xff=1:Aux PU1 = Gnd}{FuelSpk_SD_input&0xff=2:Aux PU2 = Gnd}{FuelSpk_SD_input&0xff=3:Aux PU3 = Gnd}{FuelSpk_SD_input&0xff=4:Aux DIG1 = Gnd}{FuelSpk_SD_input&0xff=5:Aux DIG1" VALUE 0x00147d99 /* @ECU_Address@FuelSpk_SD_input@0x01004AD8@ */ ECIPP_ALIGNMENT_UBYTE 255 FuelSpk_SD_input_COMPU_VTAB 0 255 BIT_MASK 0xff /end CHARACTERISTIC
/begin COMPU_METHOD FuelSpk_SD_input_COMPU_VTAB "Verbal Table" TAB_VERB "%.0" "list" COMPU_TAB_REF FuelSpk_SD_input_COMPU_VTAB_REF /end COMPU_METHOD
/begin COMPU_VTAB FuelSpk_SD_input_COMPU_VTAB_REF "Verbal Table" TAB_VERB 28 0 "Disabled" 1 "Aux PU1 = Gnd" 2 "Aux PU2 = Gnd" 3 "Aux PU3 = Gnd" 4 "Aux DIG1 = Gnd" 5 "Aux DIG1 = +V" 6 "Aux DIG2 = Gnd" 7 "Aux DIG2 = +V" 8 "Aux DIG3 = Gnd" 9 "Aux DIG3 = +V" 10 "Aux DIG4 = Gnd" 11 "Aux DIG4 = +V" 12 "Aux DIG1 = Open" 13 "Aux DIG2 = Open" 14 "Aux DIG3 = Open" 15 "Aux DIG4 = Open" 16 "Aux DIG5 = Gnd" 17 "Aux DIG5 = +V" 18 "Aux DIG5 = Open" 19 "Aux DIG6 = Gnd" 20 "Aux DIG6 = +V" 21 "Aux DIG6 = Open" 22 "Aux DIG7 = Gnd" 23 "Aux DIG7 = +V" 24 "Aux DIG7 = Open" 25 "Aux DIG17 = Gnd" 26 "Aux DIG17 = +V" 27 "Aux DIG17 = Open" DEFAULT_VALUE "UNKNOWN" /end COMPU_VTAB
/begin CHARACTERISTIC TD_int_smr "Intake smear" VALUE 0x0014785a /* @ECU_Address@TD_int_smr@0x01004AF8@ */ ECIPP_ALIGNMENT_UWORD 2 Compu_TD_int_smr 0 1.99996948242188 /end CHARACTERISTIC
/begin COMPU_METHOD Compu_TD_int_smr " " RAT_FUNC "%.2" "-" COEFFS 0 32768 0 0 0 1 /end COMPU_METHOD
/begin MEASUREMENT TDM_intu_m "Intake manifold (upstream) mass" UWORD Compu_TDM_intu_m 0 0 0 63.9990234375 ECU_ADDRESS 0x01004B00 /end MEASUREMENT
/begin COMPU_METHOD Compu_TDM_intu_m " " RAT_FUNC "%.2" "g" COEFFS 0 1024 0 0 0 1 /end COMPU_METHOD
/begin MEASUREMENT TDM_intd_m "Intake manifold (downstream) mass" UWORD Compu_TDM_intd_m 0 0 0 63.9990234375 ECU_ADDRESS 0x01004B08 /end MEASUREMENT
/begin COMPU_METHOD Compu_TDM_intd_m " " RAT_FUNC "%.2" "g" COEFFS 0 1024 0 0 0 1 /end COMPU_METHOD
/begin MEASUREMENT TDM_intu_td "Intake manifold (upstream) delay" UWORD Compu_TDM_intu_td 0 0 0 5119.921875 ECU_ADDRESS 0x01004B10 /end MEASUREMENT
/begin COMPU_METHOD Compu_TDM_intu_td " " RAT_FUNC "%.0" "ms" COEFFS 0 12.8 0 0 0 1 /end COMPU_METHOD
/begin MEASUREMENT TDM_intd_td "Intake manifold (downstream) delay" UWORD Compu_TDM_intd_td 0 0 0 5119.921875 ECU_ADDRESS 0x01004B18 /end MEASUREMENT
/begin COMPU_METHOD Compu_TDM_intd_td " " RAT_FUNC "%.0" "ms" COEFFS 0 12.8 0 0 0 1 /end COMPU_METHOD
/begin MEASUREMENT CrkTT_x_dcy "Crank spark timing transition decay fraction" UWORD Compu_CrkTT_x_dcy 0 0 0 199.996948242188 ECU_ADDRESS 0x01004BC0 /end MEASUREMENT
/begin COMPU_METHOD Compu_CrkTT_x_dcy " " RAT_FUNC "%.1" "%" COEFFS 0 327.68 0 0 0 1 /end COMPU_METHOD
/begin MEASUREMENT CrkTT_x_rpm "Crank spark timing transition rpm-delta fraction" UWORD Compu_CrkTT_x_rpm 0 0 0 199.996948242188 ECU_ADDRESS 0x01004BC8 /end MEASUREMENT
/begin COMPU_METHOD Compu_CrkTT_x_rpm " " RAT_FUNC "%.1" "%" COEFFS 0 327.68 0 0 0 1 /end COMPU_METHOD
/begin CHARACTERISTIC CrkTT_delt_rpm "Crank spark timing transition rpm delta" VALUE 0x00146784 /* @ECU_Address@CrkTT_delt_rpm@0x01004BD8@ */ ECIPP_ALIGNMENT_UWORD 65535 Compu_CrkTT_delt_rpm 0 65535 /end CHARACTERISTIC
/begin COMPU_METHOD Compu_CrkTT_delt_rpm " " RAT_FUNC "%.0" "rpm" COEFFS 0 1 0 0 0 1 /end COMPU_METHOD
/begin CHARACTERISTIC afs_crkdly_ECT "Alt-fuel fuel/spark start delay ECT hi" VALUE 0x00147a70 /* @ECU_Address@afs_crkdly_ECT@0x01004D58@ */ ECIPP_ALIGNMENT_UWORD 564 Compu_afs_crkdly_ECT -460 563.984375 /end CHARACTERISTIC
/begin COMPU_METHOD Compu_afs_crkdly_ECT " " RAT_FUNC "%.1" "deg F" COEFFS 0 64 29440 0 0 1 /end COMPU_METHOD
/begin CHARACTERISTIC afs_crkdly_cycs "Alt-fuel fuel/spark start delay cycles" VALUE 0x00147a74 /* @ECU_Address@afs_crkdly_cycs@0x01004D60@ */ ECIPP_ALIGNMENT_UWORD 256 Compu_afs_crkdly_cycs 0 255.99609375 /end CHARACTERISTIC
/begin COMPU_METHOD Compu_afs_crkdly_cycs " " RAT_FUNC "%.2" "engine cycles" COEFFS 0 256 0 0 0 1 /end COMPU_METHOD
/begin CHARACTERISTIC afs_crkdly_ECTlo "Alt-fuel fuel/spark start delay ECT lo" VALUE 0x00147a72 /* @ECU_Address@afs_crkdly_ECTlo@0x01004DA0@ */ ECIPP_ALIGNMENT_UWORD 564 Compu_afs_crkdly_ECTlo -460 563.984375 /end CHARACTERISTIC
/begin COMPU_METHOD Compu_afs_crkdly_ECTlo " " RAT_FUNC "%.1" "deg F" COEFFS 0 64 29440 0 0 1 /end COMPU_METHOD
/begin CHARACTERISTIC afs_crkdly_fs "Alt-fuel fuel/spark start delay mode{afs_crkdly_fs&0xff=0:Disabled}{afs_crkdly_fs&0xff=1:Inhibit Fuel}{afs_crkdly_fs&0xff=2:Inhibit Spark}{afs_crkdly_fs&0xff=3:Inhibit Fuel+Spark}" VALUE 0x001480f2 /* @ECU_Address@afs_crkdly_fs@0x01004DA8@ */ ECIPP_ALIGNMENT_UBYTE 255 afs_crkdly_fs_COMPU_VTAB 0 255 BIT_MASK 0xff /end CHARACTERISTIC
/begin COMPU_METHOD afs_crkdly_fs_COMPU_VTAB "Verbal Table" TAB_VERB "%.0" "list" COMPU_TAB_REF afs_crkdly_fs_COMPU_VTAB_REF /end COMPU_METHOD
/begin COMPU_VTAB afs_crkdly_fs_COMPU_VTAB_REF "Verbal Table" TAB_VERB 4 0 "Disabled" 1 "Inhibit Fuel" 2 "Inhibit Spark" 3 "Inhibit Fuel+Spark" DEFAULT_VALUE "UNKNOWN" /end COMPU_VTAB
/begin MEASUREMENT CCDL_misfire "CCDL spark kill override{CCDL_misfire&0xff=0:Disabled}{CCDL_misfire&0xff=1:Enabled}" UBYTE CCDL_misfire_COMPU_VTAB 0 0 0 255 ECU_ADDRESS 0x01005090 BIT_MASK 0xff /end MEASUREMENT
/begin COMPU_METHOD CCDL_misfire_COMPU_VTAB "Verbal Table" TAB_VERB "%.0" "list" COMPU_TAB_REF CCDL_misfire_COMPU_VTAB_REF /end COMPU_METHOD
/begin COMPU_VTAB CCDL_misfire_COMPU_VTAB_REF "Verbal Table" TAB_VERB 2 0 "Disabled" 1 "Enabled" DEFAULT_VALUE "UNKNOWN" /end COMPU_VTAB
/begin CHARACTERISTIC spko_cyl_mode "Cylinder spark adv mode{spko_cyl_mode&0xff=0:Disabled}{spko_cyl_mode&0xff=1:Gasoline Only}{spko_cyl_mode&0xff=2:LP Only}{spko_cyl_mode&0xff=3:NG Only}{spko_cyl_mode&0xff=4:Gaseous Only}{spko_cyl_mode&0xff=5:Always Enabled}" VALUE 0x001481b9 /* @ECU_Address@spko_cyl_mode@0x01005640@ */ ECIPP_ALIGNMENT_UBYTE 255 spko_cyl_mode_COMPU_VTAB 0 255 BIT_MASK 0xff /end CHARACTERISTIC
/begin COMPU_METHOD spko_cyl_mode_COMPU_VTAB "Verbal Table" TAB_VERB "%.0" "list" COMPU_TAB_REF spko_cyl_mode_COMPU_VTAB_REF /end COMPU_METHOD
/begin COMPU_VTAB spko_cyl_mode_COMPU_VTAB_REF "Verbal Table" TAB_VERB 6 0 "Disabled" 1 "Gasoline Only" 2 "LP Only" 3 "NG Only" 4 "Gaseous Only" 5 "Always Enabled" DEFAULT_VALUE "UNKNOWN" /end COMPU_VTAB
/begin CHARACTERISTIC coil1_spk_mult "Cylinder 1 (F.O.) spark multiplier" VALUE 0x001465AA /* @ECU_Address@coil1_spk_mult@0x01005648@ */ ECIPP_ALIGNMENT_SWORD 2 Compu_coil1_spk_mult -2 1.99993896484375 /end CHARACTERISTIC
/begin COMPU_METHOD Compu_coil1_spk_mult " " RAT_FUNC "%.2" "-" COEFFS 0 16384 0 0 0 1 /end COMPU_METHOD
/begin CHARACTERISTIC coil2_spk_mult "2" VALUE 0x001465AC /* @ECU_Address@coil2_spk_mult@0x01005650@ */ ECIPP_ALIGNMENT_SWORD 2 Compu_coil2_spk_mult -2 1.99993896484375 /end CHARACTERISTIC
/begin COMPU_METHOD Compu_coil2_spk_mult " " RAT_FUNC "%.2" "-" COEFFS 0 16384 0 0 0 1 /end COMPU_METHOD
/begin CHARACTERISTIC coil3_spk_mult "3" VALUE 0x001465AE /* @ECU_Address@coil3_spk_mult@0x01005658@ */ ECIPP_ALIGNMENT_SWORD 2 Compu_coil3_spk_mult -2 1.99993896484375 /end CHARACTERISTIC
/begin COMPU_METHOD Compu_coil3_spk_mult " " RAT_FUNC "%.2" "-" COEFFS 0 16384 0 0 0 1 /end COMPU_METHOD
/begin CHARACTERISTIC coil4_spk_mult "4" VALUE 0x001465B0 /* @ECU_Address@coil4_spk_mult@0x01005660@ */ ECIPP_ALIGNMENT_SWORD 2 Compu_coil4_spk_mult -2 1.99993896484375 /end CHARACTERISTIC
/begin COMPU_METHOD Compu_coil4_spk_mult " " RAT_FUNC "%.2" "-" COEFFS 0 16384 0 0 0 1 /end COMPU_METHOD
/begin CHARACTERISTIC coil5_spk_mult "5" VALUE 0x001465B2 /* @ECU_Address@coil5_spk_mult@0x01005668@ */ ECIPP_ALIGNMENT_SWORD 2 Compu_coil5_spk_mult -2 1.99993896484375 /end CHARACTERISTIC
/begin COMPU_METHOD Compu_coil5_spk_mult " " RAT_FUNC "%.2" "-" COEFFS 0 16384 0 0 0 1 /end COMPU_METHOD
/begin CHARACTERISTIC coil6_spk_mult "6" VALUE 0x001465B4 /* @ECU_Address@coil6_spk_mult@0x01005670@ */ ECIPP_ALIGNMENT_SWORD 2 Compu_coil6_spk_mult -2 1.99993896484375 /end CHARACTERISTIC
/begin COMPU_METHOD Compu_coil6_spk_mult " " RAT_FUNC "%.2" "-" COEFFS 0 16384 0 0 0 1 /end COMPU_METHOD
/begin CHARACTERISTIC coil7_spk_mult "7" VALUE 0x001465B6 /* @ECU_Address@coil7_spk_mult@0x01005678@ */ ECIPP_ALIGNMENT_SWORD 2 Compu_coil7_spk_mult -2 1.99993896484375 /end CHARACTERISTIC
/begin COMPU_METHOD Compu_coil7_spk_mult " " RAT_FUNC "%.2" "-" COEFFS 0 16384 0 0 0 1 /end COMPU_METHOD
/begin CHARACTERISTIC coil8_spk_mult "8" VALUE 0x001465B8 /* @ECU_Address@coil8_spk_mult@0x01005680@ */ ECIPP_ALIGNMENT_SWORD 2 Compu_coil8_spk_mult -2 1.99993896484375 /end CHARACTERISTIC
/begin COMPU_METHOD Compu_coil8_spk_mult " " RAT_FUNC "%.2" "-" COEFFS 0 16384 0 0 0 1 /end COMPU_METHOD
/begin CHARACTERISTIC coil9_spk_mult "9" VALUE 0x001465BA /* @ECU_Address@coil9_spk_mult@0x01005688@ */ ECIPP_ALIGNMENT_SWORD 2 Compu_coil9_spk_mult -2 1.99993896484375 /end CHARACTERISTIC
/begin COMPU_METHOD Compu_coil9_spk_mult " " RAT_FUNC "%.2" "-" COEFFS 0 16384 0 0 0 1 /end COMPU_METHOD
/begin CHARACTERISTIC coil10_spk_mult "10" VALUE 0x001465BC /* @ECU_Address@coil10_spk_mult@0x01005690@ */ ECIPP_ALIGNMENT_SWORD 2 Compu_coil10_spk_mult -2 1.99993896484375 /end CHARACTERISTIC
/begin COMPU_METHOD Compu_coil10_spk_mult " " RAT_FUNC "%.2" "-" COEFFS 0 16384 0 0 0 1 /end COMPU_METHOD
/begin CHARACTERISTIC spko_cyl_dzfilt "Cylinder spark adv dead-zone{spko_cyl_dzfilt&0xff=0:Disabled}{spko_cyl_dzfilt&0xff=1:Enabled}" VALUE 0x001481b8 /* @ECU_Address@spko_cyl_dzfilt@0x01005698@ */ ECIPP_ALIGNMENT_UBYTE 255 spko_cyl_dzfilt_COMPU_VTAB 0 255 BIT_MASK 0xff /end CHARACTERISTIC
/begin COMPU_METHOD spko_cyl_dzfilt_COMPU_VTAB "Verbal Table" TAB_VERB "%.0" "list" COMPU_TAB_REF spko_cyl_dzfilt_COMPU_VTAB_REF /end COMPU_METHOD
/begin COMPU_VTAB spko_cyl_dzfilt_COMPU_VTAB_REF "Verbal Table" TAB_VERB 2 0 "Disabled" 1 "Enabled" DEFAULT_VALUE "UNKNOWN" /end COMPU_VTAB
/begin MEASUREMENT TSTCL "CL test command{TSTCL&0xff=0:Disabled}{TSTCL&0xff=1:Precat+postcat}" UBYTE TSTCL_COMPU_VTAB 0 0 0 255 ECU_ADDRESS 0x010057D0 BIT_MASK 0xff /end MEASUREMENT
/begin COMPU_METHOD TSTCL_COMPU_VTAB "Verbal Table" TAB_VERB "%.0" "list" COMPU_TAB_REF TSTCL_COMPU_VTAB_REF /end COMPU_METHOD
/begin COMPU_VTAB TSTCL_COMPU_VTAB_REF "Verbal Table" TAB_VERB 2 0 "Disabled" 1 "Precat+postcat" DEFAULT_VALUE "UNKNOWN" /end COMPU_VTAB
/begin MEASUREMENT TSTCL_state "CL test state{TSTCL_state&0xff=0:Inactive}{TSTCL_state&0xff=1:Pre-cat init test}{TSTCL_state&0xff=2:Pre-cat heater test}{TSTCL_state&0xff=3:Pre-cat power test}{TSTCL_state&0xff=4:Pre-cat voltage test}{TSTCL_state&0xff=5:Pre-cat BM test}{TSTCL_state&0xff=6" UBYTE TSTCL_state_COMPU_VTAB 0 0 0 255 ECU_ADDRESS 0x010057D8 BIT_MASK 0xff /end MEASUREMENT
/begin COMPU_METHOD TSTCL_state_COMPU_VTAB "Verbal Table" TAB_VERB "%.0" "list" COMPU_TAB_REF TSTCL_state_COMPU_VTAB_REF /end COMPU_METHOD
/begin COMPU_VTAB TSTCL_state_COMPU_VTAB_REF "Verbal Table" TAB_VERB 12 0 "Inactive" 1 "Pre-cat init test" 2 "Pre-cat heater test" 3 "Pre-cat power test" 4 "Pre-cat voltage test" 5 "Pre-cat BM test" 6 "Post-cat heater test" 7 "Post-cat power test" 8 "Post-cat rich test" 9 "Post-cat lean test" 10 "Finished" 11 "Invalid" DEFAULT_VALUE "UNKNOWN" /end COMPU_VTAB
/begin MEASUREMENT TSTCL_duration "CL test duration" UWORD Compu_TSTCL_duration 0 0 0 3276.75 ECU_ADDRESS 0x010057E0 /end MEASUREMENT
/begin COMPU_METHOD Compu_TSTCL_duration " " RAT_FUNC "%.1" "sec" COEFFS 0 20 0 0 0 1 /end COMPU_METHOD
/begin MEASUREMENT MSCLpre "CL pre-cat test status{MSCLpre&0xff=0:Test Not Started}{MSCLpre&0xff=1:Test Running}{MSCLpre&0xff=2:Test Finished: Passed}{MSCLpre&0xff=3:Pre-cat EGO lazy}{MSCLpre&0xff=4:Pre-cat EGO power low}{MSCLpre&0xff=5:Pre-cat EGO non-responsive}{MSCLpre&0xff=6:Pre" UBYTE MSCLpre_COMPU_VTAB 0 0 0 255 ECU_ADDRESS 0x010057E8 BIT_MASK 0xff /end MEASUREMENT
/begin COMPU_METHOD MSCLpre_COMPU_VTAB "Verbal Table" TAB_VERB "%.0" "list" COMPU_TAB_REF MSCLpre_COMPU_VTAB_REF /end COMPU_METHOD
/begin COMPU_VTAB MSCLpre_COMPU_VTAB_REF "Verbal Table" TAB_VERB 8 0 "Test Not Started" 1 "Test Running" 2 "Test Finished: Passed" 3 "Pre-cat EGO lazy" 4 "Pre-cat EGO power low" 5 "Pre-cat EGO non-responsive" 6 "Pre-cat EGO fueling error" 7 "Cannot Start Test" DEFAULT_VALUE "UNKNOWN" /end COMPU_VTAB
/begin MEASUREMENT MSCLpst "CL post-cat test status{MSCLpst&0xff=0:Test Not Started}{MSCLpst&0xff=1:Test Running}{MSCLpst&0xff=2:Test Finished: Passed}{MSCLpst&0xff=3:Post-cat EGO lazy}{MSCLpst&0xff=4:Post-cat EGO power low}{MSCLpst&0xff=5:Post-cat EGO rich failure}{MSCLpst&0xff=6:P" UBYTE MSCLpst_COMPU_VTAB 0 0 0 255 ECU_ADDRESS 0x010057F0 BIT_MASK 0xff /end MEASUREMENT
/begin COMPU_METHOD MSCLpst_COMPU_VTAB "Verbal Table" TAB_VERB "%.0" "list" COMPU_TAB_REF MSCLpst_COMPU_VTAB_REF /end COMPU_METHOD
/begin COMPU_VTAB MSCLpst_COMPU_VTAB_REF "Verbal Table" TAB_VERB 8 0 "Test Not Started" 1 "Test Running" 2 "Test Finished: Passed" 3 "Post-cat EGO lazy" 4 "Post-cat EGO power low" 5 "Post-cat EGO rich failure" 6 "Post-cat EGO lean failure" 7 "Cannot Start Test" DEFAULT_VALUE "UNKNOWN" /end COMPU_VTAB
/begin CHARACTERISTIC TSTCL_rpmd "Engine speed target" VALUE 0x0014791a /* @ECU_Address@TSTCL_rpmd@0x010057F8@ */ ECIPP_ALIGNMENT_UWORD 65535 Compu_TSTCL_rpmd 0 65535 /end CHARACTERISTIC
/begin COMPU_METHOD Compu_TSTCL_rpmd " " RAT_FUNC "%.0" "rpm" COEFFS 0 1 0 0 0 1 /end COMPU_METHOD
/begin CHARACTERISTIC TSTCL_std_wt "EGO Z/volts test duration" VALUE 0x0014791c /* @ECU_Address@TSTCL_std_wt@0x01005800@ */ ECIPP_ALIGNMENT_UWORD 3277 Compu_TSTCL_std_wt 0 3276.75 /end CHARACTERISTIC
/begin COMPU_METHOD Compu_TSTCL_std_wt " " RAT_FUNC "%.1" "sec" COEFFS 0 20 0 0 0 1 /end COMPU_METHOD
/begin CHARACTERISTIC TSTCL_EGO_dZ "EGO Z max +/- error" VALUE 0x0014790a /* @ECU_Address@TSTCL_EGO_dZ@0x01005808@ */ ECIPP_ALIGNMENT_UWORD 65535 Compu_TSTCL_EGO_dZ 0 65535 /end CHARACTERISTIC
/begin COMPU_METHOD Compu_TSTCL_EGO_dZ " " RAT_FUNC "%.0" "ohms" COEFFS 0 1 0 0 0 1 /end COMPU_METHOD
/begin CHARACTERISTIC TSTCL_BM_max "CL + adapt BM max value" VALUE 0x0014546e /* @ECU_Address@TSTCL_BM_max@0x01005810@ */ ECIPP_ALIGNMENT_SWORD 100 Compu_TSTCL_BM_max -100 99.9969482421875 /end CHARACTERISTIC
/begin COMPU_METHOD Compu_TSTCL_BM_max " " RAT_FUNC "%.1" "%" COEFFS 0 327.68 0 0 0 1 /end COMPU_METHOD
/begin CHARACTERISTIC TSTCL_pst_BM "Postcat fueling perturbation" VALUE 0x00145472 /* @ECU_Address@TSTCL_pst_BM@0x01005818@ */ ECIPP_ALIGNMENT_SWORD 100 Compu_TSTCL_pst_BM -100 99.9969482421875 /end CHARACTERISTIC
/begin COMPU_METHOD Compu_TSTCL_pst_BM " " RAT_FUNC "%.1" "%" COEFFS 0 327.68 0 0 0 1 /end COMPU_METHOD
/begin CHARACTERISTIC TSTCL_pst_Vrich "Postcat EGO voltage rich limit" VALUE 0x00147916 /* @ECU_Address@TSTCL_pst_Vrich@0x01005820@ */ ECIPP_ALIGNMENT_UWORD 16 Compu_TSTCL_pst_Vrich 0 15.999755859375 /end CHARACTERISTIC
/begin COMPU_METHOD Compu_TSTCL_pst_Vrich " " RAT_FUNC "%.3" "volts" COEFFS 0 4096 0 0 0 1 /end COMPU_METHOD
/begin CHARACTERISTIC TSTCL_pst_wt "Postcat EGO response wait" VALUE 0x00147918 /* @ECU_Address@TSTCL_pst_wt@0x01005828@ */ ECIPP_ALIGNMENT_UWORD 3277 Compu_TSTCL_pst_wt 0 3276.75 /end CHARACTERISTIC
/begin COMPU_METHOD Compu_TSTCL_pst_wt " " RAT_FUNC "%.1" "sec" COEFFS 0 20 0 0 0 1 /end COMPU_METHOD
/begin CHARACTERISTIC TSTCL_phi_d "Precat phi target" VALUE 0x0014790e /* @ECU_Address@TSTCL_phi_d@0x01005830@ */ ECIPP_ALIGNMENT_UWORD 4 Compu_TSTCL_phi_d 0 3.99993896484375 /end CHARACTERISTIC
/begin COMPU_METHOD Compu_TSTCL_phi_d " " RAT_FUNC "%.3" "phi" COEFFS 0 16384 0 0 0 1 /end COMPU_METHOD
/begin CHARACTERISTIC TSTCL_spk_max "Max spark advance" VALUE 0x00145474 /* @ECU_Address@TSTCL_spk_max@0x01005838@ */ ECIPP_ALIGNMENT_SWORD 2048 Compu_TSTCL_spk_max -2048 2047.9375 /end CHARACTERISTIC
/begin COMPU_METHOD Compu_TSTCL_spk_max " " RAT_FUNC "%.1" "CAD BTDC" COEFFS 0 16 0 0 0 1 /end COMPU_METHOD
/begin CHARACTERISTIC TSTCL_Emin "CL min excursion" VALUE 0x0014790c /* @ECU_Address@TSTCL_Emin@0x01005840@ */ ECIPP_ALIGNMENT_UWORD 200 Compu_TSTCL_Emin 0 199.996948242188 /end CHARACTERISTIC
/begin COMPU_METHOD Compu_TSTCL_Emin " " RAT_FUNC "%.1" "%" COEFFS 0 327.68 0 0 0 1 /end COMPU_METHOD
/begin CHARACTERISTIC TSTCL_EGOZ_time "EGO Z add'l warm-up, or time limit" VALUE 0x00145470 /* @ECU_Address@TSTCL_EGOZ_time@0x01005848@ */ ECIPP_ALIGNMENT_SWORD 2097 Compu_TSTCL_EGOZ_time -2097.152 2097.088 /end CHARACTERISTIC
/begin COMPU_METHOD Compu_TSTCL_EGOZ_time " " RAT_FUNC "%.1" "sec" COEFFS 0 15.625 0 0 0 1 /end COMPU_METHOD
/begin CHARACTERISTIC TSTCL_pst_Vlean "Postcat EGO voltage lean limit" VALUE 0x00147914 /* @ECU_Address@TSTCL_pst_Vlean@0x01005908@ */ ECIPP_ALIGNMENT_UWORD 16 Compu_TSTCL_pst_Vlean 0 15.999755859375 /end CHARACTERISTIC
/begin COMPU_METHOD Compu_TSTCL_pst_Vlean " " RAT_FUNC "%.3" "volts" COEFFS 0 4096 0 0 0 1 /end COMPU_METHOD
/begin CHARACTERISTIC OILT_def "Default oil temperature" VALUE 0x00147672 /* @ECU_Address@OILT_def@0x01005A10@ */ ECIPP_ALIGNMENT_UWORD 7732 Compu_OILT_def -460 7731.875 /end CHARACTERISTIC
/begin COMPU_METHOD Compu_OILT_def " " RAT_FUNC "%.1" "deg F" COEFFS 0 8 3680 0 0 1 /end COMPU_METHOD
/begin MEASUREMENT OILT_est "Oil temperature estimate" UWORD Compu_OILT_est 0 0 -460 7731.875 ECU_ADDRESS 0x01005A18 /end MEASUREMENT
/begin COMPU_METHOD Compu_OILT_est " " RAT_FUNC "%.1" "deg F" COEFFS 0 8 3680 0 0 1 /end COMPU_METHOD
/begin MEASUREMENT coil1_adv_cyl "Cylinder 1 (F.O.) advance offset" SWORD Compu_coil1_adv_cyl 0 0 -2048 2047.9375 ECU_ADDRESS 0x01006B88 /end MEASUREMENT
/begin COMPU_METHOD Compu_coil1_adv_cyl " " RAT_FUNC "%.1" "-" COEFFS 0 16 0 0 0 1 /end COMPU_METHOD
/begin MEASUREMENT coil2_adv_cyl "2" SWORD Compu_coil2_adv_cyl 0 0 -2048 2047.9375 ECU_ADDRESS 0x01006B90 /end MEASUREMENT
/begin COMPU_METHOD Compu_coil2_adv_cyl " " RAT_FUNC "%.1" "-" COEFFS 0 16 0 0 0 1 /end COMPU_METHOD
/begin MEASUREMENT coil3_adv_cyl "3" SWORD Compu_coil3_adv_cyl 0 0 -2048 2047.9375 ECU_ADDRESS 0x01006B98 /end MEASUREMENT
/begin COMPU_METHOD Compu_coil3_adv_cyl " " RAT_FUNC "%.1" "-" COEFFS 0 16 0 0 0 1 /end COMPU_METHOD
/begin MEASUREMENT coil4_adv_cyl "4" SWORD Compu_coil4_adv_cyl 0 0 -2048 2047.9375 ECU_ADDRESS 0x01006BA0 /end MEASUREMENT
/begin COMPU_METHOD Compu_coil4_adv_cyl " " RAT_FUNC "%.1" "-" COEFFS 0 16 0 0 0 1 /end COMPU_METHOD
/begin MEASUREMENT coil5_adv_cyl "5" SWORD Compu_coil5_adv_cyl 0 0 -2048 2047.9375 ECU_ADDRESS 0x01006BA8 /end MEASUREMENT
/begin COMPU_METHOD Compu_coil5_adv_cyl " " RAT_FUNC "%.1" "-" COEFFS 0 16 0 0 0 1 /end COMPU_METHOD
/begin MEASUREMENT coil6_adv_cyl "6" SWORD Compu_coil6_adv_cyl 0 0 -2048 2047.9375 ECU_ADDRESS 0x01006BB0 /end MEASUREMENT
/begin COMPU_METHOD Compu_coil6_adv_cyl " " RAT_FUNC "%.1" "-" COEFFS 0 16 0 0 0 1 /end COMPU_METHOD
/begin MEASUREMENT coil7_adv_cyl "7" SWORD Compu_coil7_adv_cyl 0 0 -2048 2047.9375 ECU_ADDRESS 0x01006BB8 /end MEASUREMENT
/begin COMPU_METHOD Compu_coil7_adv_cyl " " RAT_FUNC "%.1" "-" COEFFS 0 16 0 0 0 1 /end COMPU_METHOD
/begin MEASUREMENT coil8_adv_cyl "8" SWORD Compu_coil8_adv_cyl 0 0 -2048 2047.9375 ECU_ADDRESS 0x01006BC0 /end MEASUREMENT
/begin COMPU_METHOD Compu_coil8_adv_cyl " " RAT_FUNC "%.1" "-" COEFFS 0 16 0 0 0 1 /end COMPU_METHOD
/begin MEASUREMENT coil9_adv_cyl "9" SWORD Compu_coil9_adv_cyl 0 0 -2048 2047.9375 ECU_ADDRESS 0x01006BC8 /end MEASUREMENT
/begin COMPU_METHOD Compu_coil9_adv_cyl " " RAT_FUNC "%.1" "-" COEFFS 0 16 0 0 0 1 /end COMPU_METHOD
/begin MEASUREMENT coil10_adv_cyl "10" SWORD Compu_coil10_adv_cyl 0 0 -2048 2047.9375 ECU_ADDRESS 0x01006BD0 /end MEASUREMENT
/begin COMPU_METHOD Compu_coil10_adv_cyl " " RAT_FUNC "%.1" "-" COEFFS 0 16 0 0 0 1 /end COMPU_METHOD
/begin CHARACTERISTIC FuelSpk_SD_vehspd "Fuel/Spark inhibit max vehicle speed" VALUE 0x00147422 /* @ECU_Address@FuelSpk_SD_vehspd@0x010078F8@ */ ECIPP_ALIGNMENT_UWORD 256 Compu_FuelSpk_SD_vehspd 0 255.99609375 /end CHARACTERISTIC
/begin COMPU_METHOD Compu_FuelSpk_SD_vehspd " " RAT_FUNC "%.1" "kph" COEFFS 0 256 0 0 0 1 /end COMPU_METHOD
/begin CHARACTERISTIC FuelSpk_SD_tmin "Fuel/Spark inhibit momentary latch min on-time" VALUE 0x00147420 /* @ECU_Address@FuelSpk_SD_tmin@0x01007900@ */ ECIPP_ALIGNMENT_UWORD 65535 Compu_FuelSpk_SD_tmin 0 65535 /end CHARACTERISTIC
/begin COMPU_METHOD Compu_FuelSpk_SD_tmin " " RAT_FUNC "%.0" "ms" COEFFS 0 1 0 0 0 1 /end COMPU_METHOD
/begin CHARACTERISTIC FuelSpk_SD_tmax "Fuel/Spark inhibit momentary latch max on-time" VALUE 0x0014741e /* @ECU_Address@FuelSpk_SD_tmax@0x01007908@ */ ECIPP_ALIGNMENT_UWORD 65535 Compu_FuelSpk_SD_tmax 0 65535 /end CHARACTERISTIC
/begin COMPU_METHOD Compu_FuelSpk_SD_tmax " " RAT_FUNC "%.0" "ms" COEFFS 0 1 0 0 0 1 /end COMPU_METHOD
/begin MEASUREMENT FuelSpk_SD_tmr "Fuel/Spark inhibit on-time" UWORD Compu_FuelSpk_SD_tmr 0 0 0 65535 ECU_ADDRESS 0x01007920 /end MEASUREMENT
/begin COMPU_METHOD Compu_FuelSpk_SD_tmr " " RAT_FUNC "%.0" "ms" COEFFS 0 1 0 0 0 1 /end COMPU_METHOD
/begin CHARACTERISTIC RMT_start_tstcomp "Remote start test compression" VALUE 0x001476f8 /* @ECU_Address@RMT_start_tstcomp@0x01007A40@ */ ECIPP_ALIGNMENT_UWORD 66 Compu_RMT_start_tstcomp 0 65.535 /end CHARACTERISTIC
/begin COMPU_METHOD Compu_RMT_start_tstcomp " " RAT_FUNC "%.1" "sec" COEFFS 0 1000 0 0 0 1 /end COMPU_METHOD
/begin CHARACTERISTIC SCD_Vbat_min "Starter command min battery voltage" VALUE 0x00147780 /* @ECU_Address@SCD_Vbat_min@0x01007BB0@ */ ECIPP_ALIGNMENT_UWORD 256 Compu_SCD_Vbat_min 0 255.99609375 /end CHARACTERISTIC
/begin COMPU_METHOD Compu_SCD_Vbat_min " " RAT_FUNC "%.1" "volts" COEFFS 0 256 0 0 0 1 /end COMPU_METHOD
/begin CHARACTERISTIC SCD_relay_on_wt "Command detection wait time" VALUE 0x00147f2b /* @ECU_Address@SCD_relay_on_wt@0x01007BB8@ */ ECIPP_ALIGNMENT_UBYTE 255 Compu_SCD_relay_on_wt 0 255 /end CHARACTERISTIC
/begin COMPU_METHOD Compu_SCD_relay_on_wt " " RAT_FUNC "%.0" "ms" COEFFS 0 1 0 0 0 1 /end COMPU_METHOD
/begin CHARACTERISTIC SCD_PWM_dc "Command detection active duty-cycle" VALUE 0x0014777e /* @ECU_Address@SCD_PWM_dc@0x01007BC0@ */ ECIPP_ALIGNMENT_UWORD 100 Compu_SCD_PWM_dc 0 99.9984741210938 /end CHARACTERISTIC
/begin COMPU_METHOD Compu_SCD_PWM_dc " " RAT_FUNC "%.1" "%" COEFFS 0 655.36 0 0 0 1 /end COMPU_METHOD
/begin CHARACTERISTIC SCD_off_FB_volts "Command off feedback voltage" VALUE 0x00147782 /* @ECU_Address@SCD_off_FB_volts@0x01007BC8@ */ ECIPP_ALIGNMENT_UWORD 256 Compu_SCD_off_FB_volts 0 255.99609375 /end CHARACTERISTIC
/begin COMPU_METHOD Compu_SCD_off_FB_volts " " RAT_FUNC "%.3" "volts" COEFFS 0 256 0 0 0 1 /end COMPU_METHOD
/begin CHARACTERISTIC spk_rpmlo_crank_lmt "Spark low-rpm crank limit" VALUE 0x00147b8e /* @ECU_Address@spk_rpmlo_crank_lmt@0x01007BD0@ */ ECIPP_ALIGNMENT_UWORD 65535 Compu_spk_rpmlo_crank_lmt 0 65535 /end CHARACTERISTIC
/begin COMPU_METHOD Compu_spk_rpmlo_crank_lmt " " RAT_FUNC "%.0" "rpm" COEFFS 0 1 0 0 0 1 /end COMPU_METHOD
/begin CHARACTERISTIC spk_rpmlo_stall_lmt "Spark low-rpm stall limit" VALUE 0x00147b90 /* @ECU_Address@spk_rpmlo_stall_lmt@0x01007BD8@ */ ECIPP_ALIGNMENT_UWORD 65535 Compu_spk_rpmlo_stall_lmt 0 65535 /end CHARACTERISTIC
/begin COMPU_METHOD Compu_spk_rpmlo_stall_lmt " " RAT_FUNC "%.0" "rpm" COEFFS 0 1 0 0 0 1 /end COMPU_METHOD
/begin MEASUREMENT SCD_active_ms "Command detection active timer" UBYTE Compu_SCD_active_ms 0 0 0 255 ECU_ADDRESS 0x01007BE8 /end MEASUREMENT
/begin COMPU_METHOD Compu_SCD_active_ms " " RAT_FUNC "%.0" "ms" COEFFS 0 1 0 0 0 1 /end COMPU_METHOD
/begin CHARACTERISTIC TSTCL_UEGOB_Ttol "UEGO temperature max +/- error" VALUE 0x001493C8 /* @ECU_Address@TSTCL_UEGOB_Ttol@0x010086B0@ */ ECIPP_ALIGNMENT_SWORD 8192 Compu_TSTCL_UEGOB_Ttol -8192 8191.75 /end CHARACTERISTIC
/begin COMPU_METHOD Compu_TSTCL_UEGOB_Ttol " " RAT_FUNC "%.1" "deg C" COEFFS 0 4 0 0 0 1 /end COMPU_METHOD
/begin CHARACTERISTIC TSTCL_pst_Phirich "Postcat UEGO phi rich limit" VALUE 0x00147912 /* @ECU_Address@TSTCL_pst_Phirich@0x010086B8@ */ ECIPP_ALIGNMENT_UWORD 4 Compu_TSTCL_pst_Phirich 0 3.99993896484375 /end CHARACTERISTIC
/begin COMPU_METHOD Compu_TSTCL_pst_Phirich " " RAT_FUNC "%.3" "phi" COEFFS 0 16384 0 0 0 1 /end COMPU_METHOD
/begin CHARACTERISTIC TSTCL_pst_Philean "Postcat UEGO phi lean limit" VALUE 0x00147910 /* @ECU_Address@TSTCL_pst_Philean@0x010086C0@ */ ECIPP_ALIGNMENT_UWORD 4 Compu_TSTCL_pst_Philean 0 3.99993896484375 /end CHARACTERISTIC
/begin COMPU_METHOD Compu_TSTCL_pst_Philean " " RAT_FUNC "%.3" "phi" COEFFS 0 16384 0 0 0 1 /end COMPU_METHOD
/begin MEASUREMENT INT_pstUEGO_delay "Intake post-UEGO delay" UWORD Compu_INT_pstUEGO_delay 0 0 0 5119.921875 ECU_ADDRESS 0x01009440 /end MEASUREMENT
/begin COMPU_METHOD Compu_INT_pstUEGO_delay " " RAT_FUNC "%.0" "ms" COEFFS 0 12.8 0 0 0 1 /end COMPU_METHOD
/begin MEASUREMENT EXH_preEGR_delay "Exhaust pre-EGR delay" UWORD Compu_EXH_preEGR_delay 0 0 0 5119.921875 ECU_ADDRESS 0x01009458 /end MEASUREMENT
/begin COMPU_METHOD Compu_EXH_preEGR_delay " " RAT_FUNC "%.0" "ms" COEFFS 0 12.8 0 0 0 1 /end COMPU_METHOD
/begin MEASUREMENT EXH_pstEGR_delay "Exhaust post-EGR delay" UWORD Compu_EXH_pstEGR_delay 0 0 0 5119.921875 ECU_ADDRESS 0x01009460 /end MEASUREMENT
/begin COMPU_METHOD Compu_EXH_pstEGR_delay " " RAT_FUNC "%.0" "ms" COEFFS 0 12.8 0 0 0 1 /end COMPU_METHOD
/begin MEASUREMENT EGR_hot_delay "EGR hot delay" UWORD Compu_EGR_hot_delay 0 0 0 5119.921875 ECU_ADDRESS 0x01009468 /end MEASUREMENT
/begin COMPU_METHOD Compu_EGR_hot_delay " " RAT_FUNC "%.0" "ms" COEFFS 0 12.8 0 0 0 1 /end COMPU_METHOD
/begin MEASUREMENT EGR_cool_delay "EGR cold delay" UWORD Compu_EGR_cool_delay 0 0 0 5119.921875 ECU_ADDRESS 0x01009470 /end MEASUREMENT
/begin COMPU_METHOD Compu_EGR_cool_delay " " RAT_FUNC "%.0" "ms" COEFFS 0 12.8 0 0 0 1 /end COMPU_METHOD
/begin MEASUREMENT EXH_pstturb_delay "Exhaust post-turbine delay" UWORD Compu_EXH_pstturb_delay 0 0 0 5119.921875 ECU_ADDRESS 0x01009810 /end MEASUREMENT
/begin COMPU_METHOD Compu_EXH_pstturb_delay " " RAT_FUNC "%.0" "ms" COEFFS 0 12.8 0 0 0 1 /end COMPU_METHOD
/begin CHARACTERISTIC EGR_transdelay_smr "EGR transport delay smear" VALUE 0x001408f0 /* @ECU_Address@EGR_transdelay_smr@0x01009FC0@ */ ECIPP_ALIGNMENT_UWORD 2 Compu_EGR_transdelay_smr 0 1.99996948242188 /end CHARACTERISTIC
/begin COMPU_METHOD Compu_EGR_transdelay_smr " " RAT_FUNC "%.1" "-" COEFFS 0 32768 0 0 0 1 /end COMPU_METHOD
/begin CHARACTERISTIC OILT_ena "Oil temperature input{OILT_ena&0xff=0:Disabled}{OILT_ena&0xff=1:Aux PU1}{OILT_ena&0xff=2:Aux PU2}{OILT_ena&0xff=3:Aux PU3}{OILT_ena&0xff=4:Aux PUD1}{OILT_ena&0xff=5:Aux PUD2}{OILT_ena&0xff=6:Aux PUD3}{OILT_ena&0xff=7:EGT Input}{OILT_ena&0xff=8:Aux PUD4}{O" VALUE 0x00147ea3 /* @ECU_Address@OILT_ena@0x0100A1C8@ */ ECIPP_ALIGNMENT_UBYTE 255 OILT_ena_COMPU_VTAB 0 255 BIT_MASK 0xff /end CHARACTERISTIC
/begin COMPU_METHOD OILT_ena_COMPU_VTAB "Verbal Table" TAB_VERB "%.0" "list" COMPU_TAB_REF OILT_ena_COMPU_VTAB_REF /end COMPU_METHOD
/begin COMPU_VTAB OILT_ena_COMPU_VTAB_REF "Verbal Table" TAB_VERB 31 0 "Disabled" 1 "Aux PU1" 2 "Aux PU2" 3 "Aux PU3" 4 "Aux PUD1" 5 "Aux PUD2" 6 "Aux PUD3" 7 "EGT Input" 8 "Aux PUD4" 9 "Aux PUD5" 10 "Aux PUD6" 11 "Aux PUD7" 12 "Aux PUD8" 13 "Aux PUD9" 14 "Aux PUD10" 15 "Aux PUD11" 16 "Aux PUD12" 17 "Aux PUD13" 18 "Aux PUD14" 19 "Aux PUD15" 20 "Aux PUD16" 21 "Aux PUD17" 22 "Aux PUD18" 23 "Aux PUD19" 24 "Aux PUD20" 25 "Aux PUD21" 26 "Aux PUD22" 27 "Aux PUD23" 28 "Aux PUD24" 29 "Aux PUD25" 30 "CAN sourced" DEFAULT_VALUE "UNKNOWN" /end COMPU_VTAB
/begin MEASUREMENT OILT "Oil temperature" UWORD Compu_OILT 0 0 -460 7731.875 ECU_ADDRESS 0x0100A1E0 /end MEASUREMENT
/begin COMPU_METHOD Compu_OILT " " RAT_FUNC "%.1" "deg F" COEFFS 0 8 3680 0 0 1 /end COMPU_METHOD
/begin MEASUREMENT TSTcam_bump "Cam-bump procedure command{TSTcam_bump&0xff=0:Disabled}{TSTcam_bump&0xff=1:Active}" UBYTE TSTcam_bump_COMPU_VTAB 0 0 0 255 ECU_ADDRESS 0x0100B490 BIT_MASK 0xff /end MEASUREMENT
/begin COMPU_METHOD TSTcam_bump_COMPU_VTAB "Verbal Table" TAB_VERB "%.0" "list" COMPU_TAB_REF TSTcam_bump_COMPU_VTAB_REF /end COMPU_METHOD
/begin COMPU_VTAB TSTcam_bump_COMPU_VTAB_REF "Verbal Table" TAB_VERB 2 0 "Disabled" 1 "Active" DEFAULT_VALUE "UNKNOWN" /end COMPU_VTAB
/begin MEASUREMENT MScam_bump "Cam-bump procedure status{MScam_bump&0xff=0:Procedure Not Started}{MScam_bump&0xff=1:Procedure Running}{MScam_bump&0xff=2:Procedure Finished}{MScam_bump&0xff=3:Must restart engine}{MScam_bump&0xff=4:RPM too high}{MScam_bump&0xff=5:Condition 3 Not Met}{MSc" UBYTE MScam_bump_COMPU_VTAB 0 0 0 255 ECU_ADDRESS 0x0100B498 BIT_MASK 0xff /end MEASUREMENT
/begin COMPU_METHOD MScam_bump_COMPU_VTAB "Verbal Table" TAB_VERB "%.0" "list" COMPU_TAB_REF MScam_bump_COMPU_VTAB_REF /end COMPU_METHOD
/begin COMPU_VTAB MScam_bump_COMPU_VTAB_REF "Verbal Table" TAB_VERB 8 0 "Procedure Not Started" 1 "Procedure Running" 2 "Procedure Finished" 3 "Must restart engine" 4 "RPM too high" 5 "Condition 3 Not Met" 6 "Condition 4 Not Met" 7 "Cannot Start Procedure" DEFAULT_VALUE "UNKNOWN" /end COMPU_VTAB
/begin CHARACTERISTIC Tcambmp_rpm_max "Cam-bump test maximum allowed rpm" VALUE 0x00147966 /* @ECU_Address@Tcambmp_rpm_max@0x0100B4A0@ */ ECIPP_ALIGNMENT_UWORD 65535 Compu_Tcambmp_rpm_max 0 65535 /end CHARACTERISTIC
/begin COMPU_METHOD Compu_Tcambmp_rpm_max " " RAT_FUNC "%.0" "rpm" COEFFS 0 1 0 0 0 1 /end COMPU_METHOD
/begin CHARACTERISTIC TSTCL_UEGON_Ttol "UEGO temperature max +/- error" VALUE 0x00149464 /* @ECU_Address@TSTCL_UEGON_Ttol@0x0100BF00@ */ ECIPP_ALIGNMENT_SWORD 8192 Compu_TSTCL_UEGON_Ttol -8192 8191.75 /end CHARACTERISTIC
/begin COMPU_METHOD Compu_TSTCL_UEGON_Ttol " " RAT_FUNC "%.1" "deg C" COEFFS 0 4 0 0 0 1 /end COMPU_METHOD
/begin CHARACTERISTIC OILT_est_mode "Oil temperature initial value{OILT_est_mode&0xff=0:Disabled}{OILT_est_mode&0xff=1:Stored estimate}" VALUE 0x00147ea4 /* @ECU_Address@OILT_est_mode@0x0100C268@ */ ECIPP_ALIGNMENT_UBYTE 255 OILT_est_mode_COMPU_VTAB 0 255 BIT_MASK 0xff /end CHARACTERISTIC
/begin COMPU_METHOD OILT_est_mode_COMPU_VTAB "Verbal Table" TAB_VERB "%.0" "list" COMPU_TAB_REF OILT_est_mode_COMPU_VTAB_REF /end COMPU_METHOD
/begin COMPU_VTAB OILT_est_mode_COMPU_VTAB_REF "Verbal Table" TAB_VERB 2 0 "Disabled" 1 "Stored estimate" DEFAULT_VALUE "UNKNOWN" /end COMPU_VTAB
/begin MEASUREMENT uego_dt_cmd "UEGO drift test command{uego_dt_cmd&0xff=0:Disabled}{uego_dt_cmd&0xff=1:Enabled}" UBYTE uego_dt_cmd_COMPU_VTAB 0 0 0 255 ECU_ADDRESS 0x0100CF98 BIT_MASK 0xff /end MEASUREMENT
/begin COMPU_METHOD uego_dt_cmd_COMPU_VTAB "Verbal Table" TAB_VERB "%.0" "list" COMPU_TAB_REF uego_dt_cmd_COMPU_VTAB_REF /end COMPU_METHOD
/begin COMPU_VTAB uego_dt_cmd_COMPU_VTAB_REF "Verbal Table" TAB_VERB 2 0 "Disabled" 1 "Enabled" DEFAULT_VALUE "UNKNOWN" /end COMPU_VTAB
/begin MEASUREMENT uego_dt_state "UEGO drift test state{uego_dt_state&0xff=0:Inactive}{uego_dt_state&0xff=1:Active}{uego_dt_state&0xff=2:Finished}{uego_dt_state&0xff=3:Invalid}" UBYTE uego_dt_state_COMPU_VTAB 0 0 0 255 ECU_ADDRESS 0x0100CFA0 BIT_MASK 0xff /end MEASUREMENT
/begin COMPU_METHOD uego_dt_state_COMPU_VTAB "Verbal Table" TAB_VERB "%.0" "list" COMPU_TAB_REF uego_dt_state_COMPU_VTAB_REF /end COMPU_METHOD
/begin COMPU_VTAB uego_dt_state_COMPU_VTAB_REF "Verbal Table" TAB_VERB 4 0 "Inactive" 1 "Active" 2 "Finished" 3 "Invalid" DEFAULT_VALUE "UNKNOWN" /end COMPU_VTAB
/begin MEASUREMENT uego_dt_duration "UEGO drift test duration" UWORD Compu_uego_dt_duration 0 0 0 3276.75 ECU_ADDRESS 0x0100CFA8 /end MEASUREMENT
/begin COMPU_METHOD Compu_uego_dt_duration " " RAT_FUNC "%.1" "sec" COEFFS 0 20 0 0 0 1 /end COMPU_METHOD
/begin CHARACTERISTIC FuelSpk_SD_tdelay "Fuel/Spark inhibit non-momentary switch delay" VALUE 0x0014741c /* @ECU_Address@FuelSpk_SD_tdelay@0x0100D148@ */ ECIPP_ALIGNMENT_UWORD 65535 Compu_FuelSpk_SD_tdelay 0 65535 /end CHARACTERISTIC
/begin COMPU_METHOD Compu_FuelSpk_SD_tdelay " " RAT_FUNC "%.0" "ms" COEFFS 0 1 0 0 0 1 /end COMPU_METHOD
/begin MEASUREMENT Tinjf_dur_peak "Injector firing test peak duration" UWORD Compu_Tinjf_dur_peak 0 0 0 209.712 ECU_ADDRESS 0x0100D4C0 /end MEASUREMENT
/begin COMPU_METHOD Compu_Tinjf_dur_peak " " RAT_FUNC "%.2" "ms" COEFFS 0 312.5 0 0 0 1 /end COMPU_METHOD
/begin CHARACTERISTIC Tinjf_dur_peak_def "Default injector firing test peak duration" VALUE 0x00147986 /* @ECU_Address@Tinjf_dur_peak_def@0x0100D4C8@ */ ECIPP_ALIGNMENT_UWORD 210 Compu_Tinjf_dur_peak_def 0 209.712 /end CHARACTERISTIC
/begin COMPU_METHOD Compu_Tinjf_dur_peak_def " " RAT_FUNC "%.2" "ms" COEFFS 0 312.5 0 0 0 1 /end COMPU_METHOD
/begin CHARACTERISTIC TBI_tran_tcyl_min "Minimum time between cylinder events" VALUE 0x0014781e /* @ECU_Address@TBI_tran_tcyl_min@0x0100D558@ */ ECIPP_ALIGNMENT_UWORD 210 Compu_TBI_tran_tcyl_min 0 209.712 /end CHARACTERISTIC
/begin COMPU_METHOD Compu_TBI_tran_tcyl_min " " RAT_FUNC "%.1" "ms/cyl event" COEFFS 0 312.5 0 0 0 1 /end COMPU_METHOD
/begin CHARACTERISTIC TBI_tran_DCstrt_max "Maximum injector duty-cycle at engage" VALUE 0x00147810 /* @ECU_Address@TBI_tran_DCstrt_max@0x0100D560@ */ ECIPP_ALIGNMENT_UWORD 100 Compu_TBI_tran_DCstrt_max 0 99.9984741210938 /end CHARACTERISTIC
/begin COMPU_METHOD Compu_TBI_tran_DCstrt_max " " RAT_FUNC "%.1" "%" COEFFS 0 655.36 0 0 0 1 /end COMPU_METHOD
/begin CHARACTERISTIC TBI_tran_inj_turnoff "Fixed injector turn-off time" VALUE 0x00147814 /* @ECU_Address@TBI_tran_inj_turnoff@0x0100D578@ */ ECIPP_ALIGNMENT_UWORD 210 Compu_TBI_tran_inj_turnoff 0 209.712 /end CHARACTERISTIC
/begin COMPU_METHOD Compu_TBI_tran_inj_turnoff " " RAT_FUNC "%.3" "ms" COEFFS 0 312.5 0 0 0 1 /end COMPU_METHOD
/begin CHARACTERISTIC TBI_tran_inj_minon "Minimum injector on-time" VALUE 0x00147812 /* @ECU_Address@TBI_tran_inj_minon@0x0100D580@ */ ECIPP_ALIGNMENT_UWORD 256 Compu_TBI_tran_inj_minon 0 255.99609375 /end CHARACTERISTIC
/begin COMPU_METHOD Compu_TBI_tran_inj_minon " " RAT_FUNC "%.2" "ms" COEFFS 0 256 0 0 0 1 /end COMPU_METHOD
/begin MEASUREMENT TBI_tran_state "Transient throttle-body status{TBI_tran_state&0xff=0:Disabled}{TBI_tran_state&0xff=1:Not allowed}{TBI_tran_state&0xff=2:Reserved - 2}{TBI_tran_state&0xff=3:Reserved - 3}{TBI_tran_state&0xff=4:Reserved - 4}{TBI_tran_state&0xff=5:Inactive: inj off}{TBI_tran" UBYTE TBI_tran_state_COMPU_VTAB 0 0 0 255 ECU_ADDRESS 0x0100D5A0 BIT_MASK 0xff /end MEASUREMENT
/begin COMPU_METHOD TBI_tran_state_COMPU_VTAB "Verbal Table" TAB_VERB "%.0" "list" COMPU_TAB_REF TBI_tran_state_COMPU_VTAB_REF /end COMPU_METHOD
/begin COMPU_VTAB TBI_tran_state_COMPU_VTAB_REF "Verbal Table" TAB_VERB 26 0 "Disabled" 1 "Not allowed" 2 "Reserved - 2" 3 "Reserved - 3" 4 "Reserved - 4" 5 "Inactive: inj off" 6 "Inactive: system cond" 7 "Inactive: fuel cond" 8 "Inactive: CCM override" 9 "Inactive: run-time" 10 "Inactive: RPM low" 11 "Inactive: RPM high" 12 "Inactive: PW too low" 13 "Inactive: DC high" 14 "Inactive: MAP Low" 15 "Reserved - 15" 16 "Reserved - 16" 17 "Reserved - 17" 18 "Reserved - 18" 19 "Reserved - 19" 20 "Monitoring" 21 "Reserved - 21" 22 "Reserved - 22" 23 "Reserved - 23" 24 "Reserved - 24" 25 "Active" DEFAULT_VALUE "UNKNOWN" /end COMPU_VTAB
/begin MEASUREMENT TBI_tran_injon_DC "Total injector duty-cycle" UWORD Compu_TBI_tran_injon_DC 0 0 0 199.996948242188 ECU_ADDRESS 0x0100D5A8 /end MEASUREMENT
/begin COMPU_METHOD Compu_TBI_tran_injon_DC " " RAT_FUNC "%.1" "%" COEFFS 0 327.68 0 0 0 1 /end COMPU_METHOD
/begin MEASUREMENT TBI_tran_injon_num "Total number of injectors active" UWORD Compu_TBI_tran_injon_num 0 0 0 31.99951171875 ECU_ADDRESS 0x0100D5B0 /end MEASUREMENT
/begin COMPU_METHOD Compu_TBI_tran_injon_num " " RAT_FUNC "%.2" "injectors" COEFFS 0 2048 0 0 0 1 /end COMPU_METHOD
/begin MEASUREMENT TBI_tran_engage_cnt "TBI transient fuel engage count" UWORD Compu_TBI_tran_engage_cnt 0 0 0 65535 ECU_ADDRESS 0x0100D5B8 /end MEASUREMENT
/begin COMPU_METHOD Compu_TBI_tran_engage_cnt " " RAT_FUNC "%.0" "-" COEFFS 0 1 0 0 0 1 /end COMPU_METHOD
/begin CHARACTERISTIC TBI_tran_off_wt_ms "Disengagement validation wait" VALUE 0x0014781a /* @ECU_Address@TBI_tran_off_wt_ms@0x0100D5C8@ */ ECIPP_ALIGNMENT_UWORD 65535 Compu_TBI_tran_off_wt_ms 0 65535 /end CHARACTERISTIC
/begin COMPU_METHOD Compu_TBI_tran_off_wt_ms " " RAT_FUNC "%.0" "ms" COEFFS 0 1 0 0 0 1 /end COMPU_METHOD
/begin MEASUREMENT TBI_tran_PW_prefilt "Low-passed fueling pulse-width" FLOAT32_IEEE Compu_TBI_tran_PW_prefilt 0 0 -10000000000 10000000000 ECU_ADDRESS 0x0100D5D0 /end MEASUREMENT
/begin COMPU_METHOD Compu_TBI_tran_PW_prefilt " " RAT_FUNC "%.2" "ms" COEFFS 0 312.5 0 0 0 1 /end COMPU_METHOD
/begin CHARACTERISTIC TBI_tran_PW_LPtau "Fuel pulse-width pre-filter tau" VALUE 0x00147c2e /* @ECU_Address@TBI_tran_PW_LPtau@0x0100D5D8@ */ ECIPP_ALIGNMENT_UWORD 327680 Compu_TBI_tran_PW_LPtau 0.45084 327680 /end CHARACTERISTIC
/begin COMPU_METHOD Compu_TBI_tran_PW_LPtau " " FORM "%.1" "ms"
 /begin FORMULA "-5 / log(1 - (X1 / 65536))" FORMULA_INV "(1 - exp(-5/X1)) * 65536" /end FORMULA
/end COMPU_METHOD
/begin MEASUREMENT TBI_tran_PW_dev "Pulse-width steady-state deviation" FLOAT32_IEEE Compu_TBI_tran_PW_dev 0 0 -10000000000 10000000000 ECU_ADDRESS 0x0100D5E0 /end MEASUREMENT
/begin COMPU_METHOD Compu_TBI_tran_PW_dev " " RAT_FUNC "%.1" "%" COEFFS 0 0.01 0 0 0 1 /end COMPU_METHOD
/begin CHARACTERISTIC TBI_tran_PWpct_pos "Engagement pulse-width + deviation" VALUE 0x00143a6c /* @ECU_Address@TBI_tran_PWpct_pos@0x0100D5E8@ */ ECIPP_ALIGNMENT_FLOAT32_IEEE 10000000000 Compu_TBI_tran_PWpct_pos -10000000000 10000000000 /end CHARACTERISTIC
/begin COMPU_METHOD Compu_TBI_tran_PWpct_pos " " RAT_FUNC "%.1" "%" COEFFS 0 0.01 0 0 0 1 /end COMPU_METHOD
/begin CHARACTERISTIC TBI_tran_PWpct_neg "Engagement pulse-width - deviation" VALUE 0x00143a64 /* @ECU_Address@TBI_tran_PWpct_neg@0x0100D5F0@ */ ECIPP_ALIGNMENT_FLOAT32_IEEE 10000000000 Compu_TBI_tran_PWpct_neg -10000000000 10000000000 /end CHARACTERISTIC
/begin COMPU_METHOD Compu_TBI_tran_PWpct_neg " " RAT_FUNC "%.1" "%" COEFFS 0 0.01 0 0 0 1 /end COMPU_METHOD
/begin CHARACTERISTIC TBI_tran_PWpct_off "Disengagement pulse-width deviation" VALUE 0x00143a68 /* @ECU_Address@TBI_tran_PWpct_off@0x0100D5F8@ */ ECIPP_ALIGNMENT_FLOAT32_IEEE 10000000000 Compu_TBI_tran_PWpct_off -10000000000 10000000000 /end CHARACTERISTIC
/begin COMPU_METHOD Compu_TBI_tran_PWpct_off " " RAT_FUNC "%.2" "%" COEFFS 0 0.01 0 0 0 1 /end COMPU_METHOD
/begin CHARACTERISTIC TBI_tran_min_MAP "Minimum manifold pressure" VALUE 0x00147816 /* @ECU_Address@TBI_tran_min_MAP@0x0100D608@ */ ECIPP_ALIGNMENT_UWORD 256 Compu_TBI_tran_min_MAP 0 255.99609375 /end CHARACTERISTIC
/begin COMPU_METHOD Compu_TBI_tran_min_MAP " " RAT_FUNC "%.2" "psia" COEFFS 0 256 0 0 0 1 /end COMPU_METHOD
/begin CHARACTERISTIC TBI_tran_PW_HPtau "Fuel pulse-width high-pass tau" VALUE 0x00147c2c /* @ECU_Address@TBI_tran_PW_HPtau@0x0100D610@ */ ECIPP_ALIGNMENT_UWORD 327680 Compu_TBI_tran_PW_HPtau 0.45084 327680 /end CHARACTERISTIC
/begin COMPU_METHOD Compu_TBI_tran_PW_HPtau " " FORM "%.1" "ms"
 /begin FORMULA "-5 / log(1 - (X1 / 65536))" FORMULA_INV "(1 - exp(-5/X1)) * 65536" /end FORMULA
/end COMPU_METHOD
/begin MEASUREMENT TBI_tran_injmin_DC "Minimum injector duty-cycle" UWORD Compu_TBI_tran_injmin_DC 0 0 0 199.996948242188 ECU_ADDRESS 0x0100D618 /end MEASUREMENT
/begin COMPU_METHOD Compu_TBI_tran_injmin_DC " " RAT_FUNC "%.1" "%" COEFFS 0 327.68 0 0 0 1 /end COMPU_METHOD
/begin CHARACTERISTIC TBI_tran_ena "Transient throttle-body fueling{TBI_tran_ena&0xff=0:Disabled}{TBI_tran_ena&0xff=1:Enabled: 5ms}{TBI_tran_ena&0xff=2:Enabled: 10ms}{TBI_tran_ena&0xff=3:Enabled: 15ms}" VALUE 0x00148088 /* @ECU_Address@TBI_tran_ena@0x0100D638@ */ ECIPP_ALIGNMENT_UBYTE 255 TBI_tran_ena_COMPU_VTAB 0 255 BIT_MASK 0xff /end CHARACTERISTIC
/begin COMPU_METHOD TBI_tran_ena_COMPU_VTAB "Verbal Table" TAB_VERB "%.0" "list" COMPU_TAB_REF TBI_tran_ena_COMPU_VTAB_REF /end COMPU_METHOD
/begin COMPU_VTAB TBI_tran_ena_COMPU_VTAB_REF "Verbal Table" TAB_VERB 4 0 "Disabled" 1 "Enabled: 5ms" 2 "Enabled: 10ms" 3 "Enabled: 15ms" DEFAULT_VALUE "UNKNOWN" /end COMPU_VTAB
/begin CHARACTERISTIC TBI_tran_runtime_wt "Run-time wait" VALUE 0x0014781c /* @ECU_Address@TBI_tran_runtime_wt@0x0100D640@ */ ECIPP_ALIGNMENT_UWORD 65535 Compu_TBI_tran_runtime_wt 0 65535 /end CHARACTERISTIC
/begin COMPU_METHOD Compu_TBI_tran_runtime_wt " " RAT_FUNC "%.0" "ms" COEFFS 0 1 0 0 0 1 /end COMPU_METHOD
/begin CHARACTERISTIC TBI_tran_min_rpm "Minimum engine speed" VALUE 0x00147818 /* @ECU_Address@TBI_tran_min_rpm@0x0100D648@ */ ECIPP_ALIGNMENT_UWORD 65535 Compu_TBI_tran_min_rpm 0 65535 /end CHARACTERISTIC
/begin COMPU_METHOD Compu_TBI_tran_min_rpm " " RAT_FUNC "%.0" "rpm" COEFFS 0 1 0 0 0 1 /end COMPU_METHOD
/begin CHARACTERISTIC CrkTT_instant "Crank start-to-run min gov spark slew{CrkTT_instant&0xff=0:Disabled}{CrkTT_instant&0xff=1:Enabled}" VALUE 0x00147d09 /* @ECU_Address@CrkTT_instant@0x0100DA90@ */ ECIPP_ALIGNMENT_UBYTE 255 CrkTT_instant_COMPU_VTAB 0 255 BIT_MASK 0xff /end CHARACTERISTIC
/begin COMPU_METHOD CrkTT_instant_COMPU_VTAB "Verbal Table" TAB_VERB "%.0" "list" COMPU_TAB_REF CrkTT_instant_COMPU_VTAB_REF /end COMPU_METHOD
/begin COMPU_VTAB CrkTT_instant_COMPU_VTAB_REF "Verbal Table" TAB_VERB 2 0 "Disabled" 1 "Enabled" DEFAULT_VALUE "UNKNOWN" /end COMPU_VTAB
/begin CHARACTERISTIC UEGO_delay "UEGO sensor delay" VALUE 0x001479be /* @ECU_Address@UEGO_delay@0x0100DFE8@ */ ECIPP_ALIGNMENT_UWORD 65535 Compu_UEGO_delay 0 65535 /end CHARACTERISTIC
/begin COMPU_METHOD Compu_UEGO_delay " " RAT_FUNC "%.0" "ms" COEFFS 0 1 0 0 0 1 /end COMPU_METHOD
/begin MEASUREMENT INT_pstUEGO_xd "Intake post-UEGO EGR% cmd" SWORD Compu_INT_pstUEGO_xd 0 0 -200 199.993896484375 ECU_ADDRESS 0x0100E020 /end MEASUREMENT
/begin COMPU_METHOD Compu_INT_pstUEGO_xd " " RAT_FUNC "%.1" "%" COEFFS 0 163.84 0 0 0 1 /end COMPU_METHOD
/begin MEASUREMENT EXH_preEGR_xd "Exhaust pre-EGR EGR% cmd" SWORD Compu_EXH_preEGR_xd 0 0 -200 199.993896484375 ECU_ADDRESS 0x0100E028 /end MEASUREMENT
/begin COMPU_METHOD Compu_EXH_preEGR_xd " " RAT_FUNC "%.1" "%" COEFFS 0 163.84 0 0 0 1 /end COMPU_METHOD
/begin MEASUREMENT EXH_pstEGR_xd "Exhaust post-EGR EGR% cmd" SWORD Compu_EXH_pstEGR_xd 0 0 -200 199.993896484375 ECU_ADDRESS 0x0100E030 /end MEASUREMENT
/begin COMPU_METHOD Compu_EXH_pstEGR_xd " " RAT_FUNC "%.1" "%" COEFFS 0 163.84 0 0 0 1 /end COMPU_METHOD
/begin MEASUREMENT EXH_pstturb_xd "Exhaust pst-turbine EGR% cmd" SWORD Compu_EXH_pstturb_xd 0 0 -200 199.993896484375 ECU_ADDRESS 0x0100E038 /end MEASUREMENT
/begin COMPU_METHOD Compu_EXH_pstturb_xd " " RAT_FUNC "%.1" "%" COEFFS 0 163.84 0 0 0 1 /end COMPU_METHOD
/begin MEASUREMENT EGR_hot_xd "EGR hot EGR% cmd" SWORD Compu_EGR_hot_xd 0 0 -200 199.993896484375 ECU_ADDRESS 0x0100E040 /end MEASUREMENT
/begin COMPU_METHOD Compu_EGR_hot_xd " " RAT_FUNC "%.1" "%" COEFFS 0 163.84 0 0 0 1 /end COMPU_METHOD
/begin MEASUREMENT EGR_cool_xd "EGR cool EGR% cmd" SWORD Compu_EGR_cool_xd 0 0 -200 199.993896484375 ECU_ADDRESS 0x0100E048 /end MEASUREMENT
/begin COMPU_METHOD Compu_EGR_cool_xd " " RAT_FUNC "%.1" "%" COEFFS 0 163.84 0 0 0 1 /end COMPU_METHOD
/begin CHARACTERISTIC UEGO_tau_ms "UEGO sensor response tau" VALUE 0x00143c38 /* @ECU_Address@UEGO_tau_ms@0x0100E068@ */ ECIPP_ALIGNMENT_FLOAT32_IEEE 10000000000 Compu_UEGO_tau_ms -10000000000 10000000000 /end CHARACTERISTIC
/begin COMPU_METHOD Compu_UEGO_tau_ms " " RAT_FUNC "%.1" "ms" COEFFS 0 1 0 0 0 1 /end COMPU_METHOD
/begin MEASUREMENT CYL_preTDC_delay "Cylinder pre-TDC delay" UWORD Compu_CYL_preTDC_delay 0 0 0 5119.921875 ECU_ADDRESS 0x0100E280 /end MEASUREMENT
/begin COMPU_METHOD Compu_CYL_preTDC_delay " " RAT_FUNC "%.0" "ms" COEFFS 0 12.8 0 0 0 1 /end COMPU_METHOD
/begin MEASUREMENT CYL_pstTDC_delay "Cylinder post-TDC delay" UWORD Compu_CYL_pstTDC_delay 0 0 0 5119.921875 ECU_ADDRESS 0x0100E288 /end MEASUREMENT
/begin COMPU_METHOD Compu_CYL_pstTDC_delay " " RAT_FUNC "%.0" "ms" COEFFS 0 12.8 0 0 0 1 /end COMPU_METHOD
/begin MEASUREMENT CYL_preTDC_xd "Cylinder pre-TDC EGR% cmd" SWORD Compu_CYL_preTDC_xd 0 0 -200 199.993896484375 ECU_ADDRESS 0x0100E290 /end MEASUREMENT
/begin COMPU_METHOD Compu_CYL_preTDC_xd " " RAT_FUNC "%.1" "%" COEFFS 0 163.84 0 0 0 1 /end COMPU_METHOD
/begin MEASUREMENT CYL_pstTDC_xd "Cylinder post-TDC EGR% cmd" SWORD Compu_CYL_pstTDC_xd 0 0 -200 199.993896484375 ECU_ADDRESS 0x0100E298 /end MEASUREMENT
/begin COMPU_METHOD Compu_CYL_pstTDC_xd " " RAT_FUNC "%.1" "%" COEFFS 0 163.84 0 0 0 1 /end COMPU_METHOD
/begin MEASUREMENT INT_pstfuel_delay "Intake post-fuel delay" UWORD Compu_INT_pstfuel_delay 0 0 0 5119.921875 ECU_ADDRESS 0x0100E378 /end MEASUREMENT
/begin COMPU_METHOD Compu_INT_pstfuel_delay " " RAT_FUNC "%.0" "ms" COEFFS 0 12.8 0 0 0 1 /end COMPU_METHOD
/begin MEASUREMENT INT_pstfuel_xd "Intake post-fuel EGR% cmd" SWORD Compu_INT_pstfuel_xd 0 0 -200 199.993896484375 ECU_ADDRESS 0x0100E380 /end MEASUREMENT
/begin COMPU_METHOD Compu_INT_pstfuel_xd " " RAT_FUNC "%.1" "%" COEFFS 0 163.84 0 0 0 1 /end COMPU_METHOD
/begin MEASUREMENT INT_pstfuel_xa "Intake post-fuel air mass fraction" SWORD Compu_INT_pstfuel_xa 0 0 -200 199.993896484375 ECU_ADDRESS 0x0100E388 /end MEASUREMENT
/begin COMPU_METHOD Compu_INT_pstfuel_xa " " RAT_FUNC "%.1" "%" COEFFS 0 163.84 0 0 0 1 /end COMPU_METHOD
/begin MEASUREMENT INT_pstfuel_xf "Intake post-fuel fuel mass fraction" SWORD Compu_INT_pstfuel_xf 0 0 -200 199.993896484375 ECU_ADDRESS 0x0100E390 /end MEASUREMENT
/begin COMPU_METHOD Compu_INT_pstfuel_xf " " RAT_FUNC "%.1" "%" COEFFS 0 163.84 0 0 0 1 /end COMPU_METHOD
/begin MEASUREMENT INT_pstUEGO_xa "Intake post-UEGO air mass fraction" SWORD Compu_INT_pstUEGO_xa 0 0 -200 199.993896484375 ECU_ADDRESS 0x0100E3A8 /end MEASUREMENT
/begin COMPU_METHOD Compu_INT_pstUEGO_xa " " RAT_FUNC "%.1" "%" COEFFS 0 163.84 0 0 0 1 /end COMPU_METHOD
/begin MEASUREMENT CYL_preTDC_xa "Cylinder pre-TDC air mass fraction" SWORD Compu_CYL_preTDC_xa 0 0 -200 199.993896484375 ECU_ADDRESS 0x0100E3B0 /end MEASUREMENT
/begin COMPU_METHOD Compu_CYL_preTDC_xa " " RAT_FUNC "%.1" "%" COEFFS 0 163.84 0 0 0 1 /end COMPU_METHOD
/begin MEASUREMENT CYL_pstTDC_xa "Cylinder post-TDC air mass fraction" SWORD Compu_CYL_pstTDC_xa 0 0 -200 199.993896484375 ECU_ADDRESS 0x0100E3B8 /end MEASUREMENT
/begin COMPU_METHOD Compu_CYL_pstTDC_xa " " RAT_FUNC "%.1" "%" COEFFS 0 163.84 0 0 0 1 /end COMPU_METHOD
/begin MEASUREMENT EXH_preEGR_xa "Exhaust pre-EGR tap air mass fraction" SWORD Compu_EXH_preEGR_xa 0 0 -200 199.993896484375 ECU_ADDRESS 0x0100E3C0 /end MEASUREMENT
/begin COMPU_METHOD Compu_EXH_preEGR_xa " " RAT_FUNC "%.1" "%" COEFFS 0 163.84 0 0 0 1 /end COMPU_METHOD
/begin MEASUREMENT EXH_pstEGR_xa "Exhaust post-EGR tap air mass fraction" SWORD Compu_EXH_pstEGR_xa 0 0 -200 199.993896484375 ECU_ADDRESS 0x0100E3C8 /end MEASUREMENT
/begin COMPU_METHOD Compu_EXH_pstEGR_xa " " RAT_FUNC "%.1" "%" COEFFS 0 163.84 0 0 0 1 /end COMPU_METHOD
/begin MEASUREMENT EXH_pstturb_xa "Exhaust post-turbo air mass fraction" SWORD Compu_EXH_pstturb_xa 0 0 -200 199.993896484375 ECU_ADDRESS 0x0100E3D0 /end MEASUREMENT
/begin COMPU_METHOD Compu_EXH_pstturb_xa " " RAT_FUNC "%.1" "%" COEFFS 0 163.84 0 0 0 1 /end COMPU_METHOD
/begin MEASUREMENT EGR_hot_xa "EGR hot air mass fraction" SWORD Compu_EGR_hot_xa 0 0 -200 199.993896484375 ECU_ADDRESS 0x0100E3D8 /end MEASUREMENT
/begin COMPU_METHOD Compu_EGR_hot_xa " " RAT_FUNC "%.1" "%" COEFFS 0 163.84 0 0 0 1 /end COMPU_METHOD
/begin MEASUREMENT EGR_cool_xa "EGR cool air mass fraction" SWORD Compu_EGR_cool_xa 0 0 -200 199.993896484375 ECU_ADDRESS 0x0100E3E0 /end MEASUREMENT
/begin COMPU_METHOD Compu_EGR_cool_xa " " RAT_FUNC "%.1" "%" COEFFS 0 163.84 0 0 0 1 /end COMPU_METHOD
/begin MEASUREMENT INT_pstUEGO_xf "Intake post-UEGO fuel mass fraction" SWORD Compu_INT_pstUEGO_xf 0 0 -200 199.993896484375 ECU_ADDRESS 0x0100E3F8 /end MEASUREMENT
/begin COMPU_METHOD Compu_INT_pstUEGO_xf " " RAT_FUNC "%.2" "%" COEFFS 0 163.84 0 0 0 1 /end COMPU_METHOD
/begin MEASUREMENT CYL_preTDC_xf "Cylinder pre-TDC fuel mass fraction" SWORD Compu_CYL_preTDC_xf 0 0 -200 199.993896484375 ECU_ADDRESS 0x0100E400 /end MEASUREMENT
/begin COMPU_METHOD Compu_CYL_preTDC_xf " " RAT_FUNC "%.2" "%" COEFFS 0 163.84 0 0 0 1 /end COMPU_METHOD
/begin MEASUREMENT CYL_pstTDC_xf "Cylinder post-TDC fuel mass fraction" SWORD Compu_CYL_pstTDC_xf 0 0 -200 199.993896484375 ECU_ADDRESS 0x0100E408 /end MEASUREMENT
/begin COMPU_METHOD Compu_CYL_pstTDC_xf " " RAT_FUNC "%.2" "%" COEFFS 0 163.84 0 0 0 1 /end COMPU_METHOD
/begin MEASUREMENT EXH_preEGR_xf "Exhaust pre-EGR tap fuel mass fraction" SWORD Compu_EXH_preEGR_xf 0 0 -200 199.993896484375 ECU_ADDRESS 0x0100E410 /end MEASUREMENT
/begin COMPU_METHOD Compu_EXH_preEGR_xf " " RAT_FUNC "%.2" "%" COEFFS 0 163.84 0 0 0 1 /end COMPU_METHOD
/begin MEASUREMENT EXH_pstEGR_xf "Exhaust post-EGR tap fuel mass fraction" SWORD Compu_EXH_pstEGR_xf 0 0 -200 199.993896484375 ECU_ADDRESS 0x0100E418 /end MEASUREMENT
/begin COMPU_METHOD Compu_EXH_pstEGR_xf " " RAT_FUNC "%.2" "%" COEFFS 0 163.84 0 0 0 1 /end COMPU_METHOD
/begin MEASUREMENT EXH_pstturb_xf "Exhaust post-turbo fuel mass fraction" SWORD Compu_EXH_pstturb_xf 0 0 -200 199.993896484375 ECU_ADDRESS 0x0100E420 /end MEASUREMENT
/begin COMPU_METHOD Compu_EXH_pstturb_xf " " RAT_FUNC "%.2" "%" COEFFS 0 163.84 0 0 0 1 /end COMPU_METHOD
/begin MEASUREMENT EGR_hot_xf "EGR hot fuel mass fraction" SWORD Compu_EGR_hot_xf 0 0 -200 199.993896484375 ECU_ADDRESS 0x0100E428 /end MEASUREMENT
/begin COMPU_METHOD Compu_EGR_hot_xf " " RAT_FUNC "%.2" "%" COEFFS 0 163.84 0 0 0 1 /end COMPU_METHOD
/begin MEASUREMENT EGR_cool_xf "EGR cool fuel mass fraction" SWORD Compu_EGR_cool_xf 0 0 -200 199.993896484375 ECU_ADDRESS 0x0100E430 /end MEASUREMENT
/begin COMPU_METHOD Compu_EGR_cool_xf " " RAT_FUNC "%.2" "%" COEFFS 0 163.84 0 0 0 1 /end COMPU_METHOD
/begin MEASUREMENT OILT_pct_ss "Oil temp % of steady-state" UWORD Compu_OILT_pct_ss 0 0 0 1599.9755859375 ECU_ADDRESS 0x0100E520 /end MEASUREMENT
/begin COMPU_METHOD Compu_OILT_pct_ss " " RAT_FUNC "%.1" "%" COEFFS 0 40.96 0 0 0 1 /end COMPU_METHOD
/begin MEASUREMENT OILT_ss "Steady-state oil temperature" UWORD Compu_OILT_ss 0 0 -460 7731.875 ECU_ADDRESS 0x0100E528 /end MEASUREMENT
/begin COMPU_METHOD Compu_OILT_ss " " RAT_FUNC "%.1" "deg F" COEFFS 0 8 3680 0 0 1 /end COMPU_METHOD
/begin MEASUREMENT InjTT_x_dcy "Crank injection timing transition decay fraction" UWORD Compu_InjTT_x_dcy 0 0 0 199.996948242188 ECU_ADDRESS 0x0100E5B0 /end MEASUREMENT
/begin COMPU_METHOD Compu_InjTT_x_dcy " " RAT_FUNC "%.1" "%" COEFFS 0 327.68 0 0 0 1 /end COMPU_METHOD
/begin MEASUREMENT InjTT_dcy_t "Crank injection timing transition decay" UWORD Compu_InjTT_dcy_t 0 0 0 1048.56 ECU_ADDRESS 0x0100E5B8 /end MEASUREMENT
/begin COMPU_METHOD Compu_InjTT_dcy_t " " RAT_FUNC "%.1" "sec" COEFFS 0 62.5 0 0 0 1 /end COMPU_METHOD
/begin MEASUREMENT inj_timing_crk "Cranking injection timing" SWORD Compu_inj_timing_crk 0 0 -2048 2047.9375 ECU_ADDRESS 0x0100E5C0 /end MEASUREMENT
/begin COMPU_METHOD Compu_inj_timing_crk " " RAT_FUNC "%.0" "CAD BBDCI" COEFFS 0 16 0 0 0 1 /end COMPU_METHOD
/begin MEASUREMENT inj_timing_norm "Running injection timing" SWORD Compu_inj_timing_norm 0 0 -2048 2047.9375 ECU_ADDRESS 0x0100E5C8 /end MEASUREMENT
/begin COMPU_METHOD Compu_inj_timing_norm " " RAT_FUNC "%.0" "CAD BBDCI" COEFFS 0 16 0 0 0 1 /end COMPU_METHOD
/begin CHARACTERISTIC strt_inj_mode_I1 "Crank primary injection timing mode{strt_inj_mode_I1&0xff=0:Single-Point}{strt_inj_mode_I1&0xff=1:CHT Table Based}" VALUE 0x00149056 /* @ECU_Address@strt_inj_mode_I1@0x0100E5D0@ */ ECIPP_ALIGNMENT_UBYTE 255 strt_inj_mode_I1_COMPU_VTAB 0 255 BIT_MASK 0xff /end CHARACTERISTIC
/begin COMPU_METHOD strt_inj_mode_I1_COMPU_VTAB "Verbal Table" TAB_VERB "%.0" "list" COMPU_TAB_REF strt_inj_mode_I1_COMPU_VTAB_REF /end COMPU_METHOD
/begin COMPU_VTAB strt_inj_mode_I1_COMPU_VTAB_REF "Verbal Table" TAB_VERB 2 0 "Single-Point" 1 "CHT Table Based" DEFAULT_VALUE "UNKNOWN" /end COMPU_VTAB
/begin CHARACTERISTIC strt_inj_mode_I2 "Crank secondary injection timing mode{strt_inj_mode_I2&0xff=0:Single-Point}{strt_inj_mode_I2&0xff=1:CHT Table Based}" VALUE 0x0014908E /* @ECU_Address@strt_inj_mode_I2@0x0100E5D8@ */ ECIPP_ALIGNMENT_UBYTE 255 strt_inj_mode_I2_COMPU_VTAB 0 255 BIT_MASK 0xff /end CHARACTERISTIC
/begin COMPU_METHOD strt_inj_mode_I2_COMPU_VTAB "Verbal Table" TAB_VERB "%.0" "list" COMPU_TAB_REF strt_inj_mode_I2_COMPU_VTAB_REF /end COMPU_METHOD
/begin COMPU_VTAB strt_inj_mode_I2_COMPU_VTAB_REF "Verbal Table" TAB_VERB 2 0 "Single-Point" 1 "CHT Table Based" DEFAULT_VALUE "UNKNOWN" /end COMPU_VTAB
/begin MEASUREMENT Phi1_pre_FBd "Phi command (delayed) + perturb" UWORD Compu_Phi1_pre_FBd 0 0 0 3.99993896484375 ECU_ADDRESS 0x0100E838 /end MEASUREMENT
/begin COMPU_METHOD Compu_Phi1_pre_FBd " " RAT_FUNC "%.3" "-" COEFFS 0 16384 0 0 0 1 /end COMPU_METHOD
/begin MEASUREMENT phi1_error_inst "Phi error (delayed) + perturb" SWORD Compu_phi1_error_inst 0 0 -1 0.999969482421875 ECU_ADDRESS 0x0100E840 /end MEASUREMENT
/begin COMPU_METHOD Compu_phi1_error_inst " " RAT_FUNC "%.3" "-" COEFFS 0 32768 0 0 0 1 /end COMPU_METHOD
/begin CHARACTERISTIC spk_rpmlo_crank_ena "Spark low-rpm crank limit enable{spk_rpmlo_crank_ena&0xff=0:Disabled}{spk_rpmlo_crank_ena&0xff=1:Gasoline Only}{spk_rpmlo_crank_ena&0xff=2:LP Only}{spk_rpmlo_crank_ena&0xff=3:NG Only}{spk_rpmlo_crank_ena&0xff=4:Gaseous Only}{spk_rpmlo_crank_ena&0xff=5:Alw" VALUE 0x001481b7 /* @ECU_Address@spk_rpmlo_crank_ena@0x0100F438@ */ ECIPP_ALIGNMENT_UBYTE 255 spk_rpmlo_crank_ena_COMPU_VTAB 0 255 BIT_MASK 0xff /end CHARACTERISTIC
/begin COMPU_METHOD spk_rpmlo_crank_ena_COMPU_VTAB "Verbal Table" TAB_VERB "%.0" "list" COMPU_TAB_REF spk_rpmlo_crank_ena_COMPU_VTAB_REF /end COMPU_METHOD
/begin COMPU_VTAB spk_rpmlo_crank_ena_COMPU_VTAB_REF "Verbal Table" TAB_VERB 6 0 "Disabled" 1 "Gasoline Only" 2 "LP Only" 3 "NG Only" 4 "Gaseous Only" 5 "Always Enabled" DEFAULT_VALUE "UNKNOWN" /end COMPU_VTAB
/begin MEASUREMENT inj_active_class "Active Injector Class{inj_active_class&0xff=0:Not Applicable}{inj_active_class&0xff=1:Primary}{inj_active_class&0xff=2:Secondary}{inj_active_class&0xff=3:TBI}{inj_active_class&0xff=4:Rolling}" UBYTE inj_active_class_COMPU_VTAB 0 0 0 255 ECU_ADDRESS 0x0100F9A8 BIT_MASK 0xff /end MEASUREMENT
/begin COMPU_METHOD inj_active_class_COMPU_VTAB "Verbal Table" TAB_VERB "%.0" "list" COMPU_TAB_REF inj_active_class_COMPU_VTAB_REF /end COMPU_METHOD
/begin COMPU_VTAB inj_active_class_COMPU_VTAB_REF "Verbal Table" TAB_VERB 5 0 "Not Applicable" 1 "Primary" 2 "Secondary" 3 "TBI" 4 "Rolling" DEFAULT_VALUE "UNKNOWN" /end COMPU_VTAB
/begin MEASUREMENT inj_active_order "Active Injector Order{inj_active_order&0xff=0:Firing Order}{inj_active_order&0xff=1:Block Order}{inj_active_order&0xff=2:Hardware Channel Order}" UBYTE inj_active_order_COMPU_VTAB 0 0 0 255 ECU_ADDRESS 0x0100F9B0 BIT_MASK 0xff /end MEASUREMENT
/begin COMPU_METHOD inj_active_order_COMPU_VTAB "Verbal Table" TAB_VERB "%.0" "list" COMPU_TAB_REF inj_active_order_COMPU_VTAB_REF /end COMPU_METHOD
/begin COMPU_VTAB inj_active_order_COMPU_VTAB_REF "Verbal Table" TAB_VERB 3 0 "Firing Order" 1 "Block Order" 2 "Hardware Channel Order" DEFAULT_VALUE "UNKNOWN" /end COMPU_VTAB
/begin CHARACTERISTIC OILTL_ena "Oil Temp/Level PWM input{OILTL_ena&0xff=0:Disabled}{OILTL_ena&0xff=1:Enabled}" VALUE 0x00147ea1 /* @ECU_Address@OILTL_ena@0x010108E0@ */ ECIPP_ALIGNMENT_UBYTE 255 OILTL_ena_COMPU_VTAB 0 255 BIT_MASK 0xff /end CHARACTERISTIC
/begin COMPU_METHOD OILTL_ena_COMPU_VTAB "Verbal Table" TAB_VERB "%.0" "list" COMPU_TAB_REF OILTL_ena_COMPU_VTAB_REF /end COMPU_METHOD
/begin COMPU_VTAB OILTL_ena_COMPU_VTAB_REF "Verbal Table" TAB_VERB 2 0 "Disabled" 1 "Enabled" DEFAULT_VALUE "UNKNOWN" /end COMPU_VTAB
/begin MEASUREMENT OILTL_temp "Temp" UWORD Compu_OILTL_temp 0 0 -460 7731.875 ECU_ADDRESS 0x010108E8 /end MEASUREMENT
/begin COMPU_METHOD Compu_OILTL_temp " " RAT_FUNC "%.1" "deg F" COEFFS 0 8 3680 0 0 1 /end COMPU_METHOD
/begin MEASUREMENT OILTL_ms_temp "Oil T/L temperature pulse" UWORD Compu_OILTL_ms_temp 0 0 0 255.99609375 ECU_ADDRESS 0x010108F0 /end MEASUREMENT
/begin COMPU_METHOD Compu_OILTL_ms_temp " " RAT_FUNC "%.3" "ms" COEFFS 0 256 0 0 0 1 /end COMPU_METHOD
/begin MEASUREMENT OILTL_ms_level "Oil T/L level pulse" UWORD Compu_OILTL_ms_level 0 0 0 255.99609375 ECU_ADDRESS 0x010108F8 /end MEASUREMENT
/begin COMPU_METHOD Compu_OILTL_ms_level " " RAT_FUNC "%.3" "ms" COEFFS 0 256 0 0 0 1 /end COMPU_METHOD
/begin MEASUREMENT OILTL_ms_diag "Oil T/L diagnostics pulse" UWORD Compu_OILTL_ms_diag 0 0 0 255.99609375 ECU_ADDRESS 0x01010900 /end MEASUREMENT
/begin COMPU_METHOD Compu_OILTL_ms_diag " " RAT_FUNC "%.3" "ms" COEFFS 0 256 0 0 0 1 /end COMPU_METHOD
/begin MEASUREMENT OILTL_mm_temp_init "Initial" UWORD Compu_OILTL_mm_temp_init 0 0 0 255.99609375 ECU_ADDRESS 0x01010908 /end MEASUREMENT
/begin COMPU_METHOD Compu_OILTL_mm_temp_init " " RAT_FUNC "%.2" "mm" COEFFS 0 256 0 0 0 1 /end COMPU_METHOD
/begin MEASUREMENT OILTL_mm_temp_crct "Corrected" UWORD Compu_OILTL_mm_temp_crct 0 0 0 255.99609375 ECU_ADDRESS 0x01010910 /end MEASUREMENT
/begin COMPU_METHOD Compu_OILTL_mm_temp_crct " " RAT_FUNC "%.2" "mm" COEFFS 0 256 0 0 0 1 /end COMPU_METHOD
/begin MEASUREMENT OILTL_mm_rpm_crct "Corrected" UWORD Compu_OILTL_mm_rpm_crct 0 0 0 255.99609375 ECU_ADDRESS 0x01010918 /end MEASUREMENT
/begin COMPU_METHOD Compu_OILTL_mm_rpm_crct " " RAT_FUNC "%.2" "mm" COEFFS 0 256 0 0 0 1 /end COMPU_METHOD
/begin CHARACTERISTIC OILTL_level_tau "Oil T/L low pass tau" VALUE 0x00147c22 /* @ECU_Address@OILTL_level_tau@0x01010928@ */ ECIPP_ALIGNMENT_UWORD 3277 Compu_OILTL_level_tau 0.0045084 3276.8 /end CHARACTERISTIC
/begin COMPU_METHOD Compu_OILTL_level_tau " " FORM "%.1" "seconds"
 /begin FORMULA "-0.05 / log(1 - (X1 / 65536))" FORMULA_INV "(1 - exp(-0.05/X1)) * 65536" /end FORMULA
/end COMPU_METHOD
/begin CHARACTERISTIC OILTL_J1939_src "Oil T/L J1939 SPN 98 source{OILTL_J1939_src&0xff=0:Level %}{OILTL_J1939_src&0xff=1:Stage %}" VALUE 0x00147ea0 /* @ECU_Address@OILTL_J1939_src@0x01010930@ */ ECIPP_ALIGNMENT_UBYTE 255 OILTL_J1939_src_COMPU_VTAB 0 255 BIT_MASK 0xff /end CHARACTERISTIC
/begin COMPU_METHOD OILTL_J1939_src_COMPU_VTAB "Verbal Table" TAB_VERB "%.0" "list" COMPU_TAB_REF OILTL_J1939_src_COMPU_VTAB_REF /end COMPU_METHOD
/begin COMPU_VTAB OILTL_J1939_src_COMPU_VTAB_REF "Verbal Table" TAB_VERB 2 0 "Level %" 1 "Stage %" DEFAULT_VALUE "UNKNOWN" /end COMPU_VTAB
/begin MEASUREMENT OILTL_diag "Oil T/L diagnostics state{OILTL_diag&0xff=0:Sensor OK}{OILTL_diag&0xff=1:Voltage OOR}{OILTL_diag&0xff=2:Open/short}{OILTL_diag&0xff=3:Temp OOR}{OILTL_diag&0xff=4:Level OOR}{OILTL_diag&0xff=5:Pulse/gap OOR}{OILTL_diag&0xff=6:Timeout}" UBYTE OILTL_diag_COMPU_VTAB 0 0 0 255 ECU_ADDRESS 0x01010938 BIT_MASK 0xff /end MEASUREMENT
/begin COMPU_METHOD OILTL_diag_COMPU_VTAB "Verbal Table" TAB_VERB "%.0" "list" COMPU_TAB_REF OILTL_diag_COMPU_VTAB_REF /end COMPU_METHOD
/begin COMPU_VTAB OILTL_diag_COMPU_VTAB_REF "Verbal Table" TAB_VERB 7 0 "Sensor OK" 1 "Voltage OOR" 2 "Open/short" 3 "Temp OOR" 4 "Level OOR" 5 "Pulse/gap OOR" 6 "Timeout" DEFAULT_VALUE "UNKNOWN" /end COMPU_VTAB
/begin MEASUREMENT OILTL_diag_LED "Oil T/L diagnostics state{OILTL_diag_LED&0x01=0x00:Inactive}{OILTL_diag_LED&0x01=0x01:Active}" UBYTE OILTL_diag_LED_COMPU_VTAB 0 0 0 255 ECU_ADDRESS 0x01010940 BIT_MASK 0x01 /end MEASUREMENT
/begin COMPU_METHOD OILTL_diag_LED_COMPU_VTAB "Verbal Table" TAB_VERB "%.0" "list" COMPU_TAB_REF OILTL_diag_LED_COMPU_VTAB_REF /end COMPU_METHOD
/begin COMPU_VTAB OILTL_diag_LED_COMPU_VTAB_REF "Verbal Table" TAB_VERB 2 0x00 "Inactive" 0x01 "Active" DEFAULT_VALUE "UNKNOWN" /end COMPU_VTAB
/begin MEASUREMENT OILTL_stage "Stage" UBYTE Compu_OILTL_stage 0 0 0 99.609375 ECU_ADDRESS 0x01010950 /end MEASUREMENT
/begin COMPU_METHOD Compu_OILTL_stage " " RAT_FUNC "%.0" "%" COEFFS 0 2.56 0 0 0 1 /end COMPU_METHOD
/begin CHARACTERISTIC FSO_ret_mode "FSO spark retard mode{FSO_ret_mode&0xff=0:Single Point}{FSO_ret_mode&0xff=1:Table Based}" VALUE 0x00147d86 /* @ECU_Address@FSO_ret_mode@0x01010AD0@ */ ECIPP_ALIGNMENT_UBYTE 255 FSO_ret_mode_COMPU_VTAB 0 255 BIT_MASK 0xff /end CHARACTERISTIC
/begin COMPU_METHOD FSO_ret_mode_COMPU_VTAB "Verbal Table" TAB_VERB "%.0" "list" COMPU_TAB_REF FSO_ret_mode_COMPU_VTAB_REF /end COMPU_METHOD
/begin COMPU_VTAB FSO_ret_mode_COMPU_VTAB_REF "Verbal Table" TAB_VERB 2 0 "Single Point" 1 "Table Based" DEFAULT_VALUE "UNKNOWN" /end COMPU_VTAB
/begin CHARACTERISTIC spkret_decay_time "Spark retard decay time" VALUE 0x00147b96 /* @ECU_Address@spkret_decay_time@0x01010AD8@ */ ECIPP_ALIGNMENT_UWORD 66 Compu_spkret_decay_time 0 65.535 /end CHARACTERISTIC
/begin COMPU_METHOD Compu_spkret_decay_time " " RAT_FUNC "%.1" "seconds" COEFFS 0 1000 0 0 0 1 /end COMPU_METHOD
/begin CHARACTERISTIC strt_spkret_ena "Engine start spark retard{strt_spkret_ena&0xff=0:Disabled}{strt_spkret_ena&0xff=1:Enabled - ECT only}{strt_spkret_ena&0xff=2:Enabled - ECT and EGT}" VALUE 0x001481bc /* @ECU_Address@strt_spkret_ena@0x01010AE0@ */ ECIPP_ALIGNMENT_UBYTE 255 strt_spkret_ena_COMPU_VTAB 0 255 BIT_MASK 0xff /end CHARACTERISTIC
/begin COMPU_METHOD strt_spkret_ena_COMPU_VTAB "Verbal Table" TAB_VERB "%.0" "list" COMPU_TAB_REF strt_spkret_ena_COMPU_VTAB_REF /end COMPU_METHOD
/begin COMPU_VTAB strt_spkret_ena_COMPU_VTAB_REF "Verbal Table" TAB_VERB 3 0 "Disabled" 1 "Enabled - ECT only" 2 "Enabled - ECT and EGT" DEFAULT_VALUE "UNKNOWN" /end COMPU_VTAB
/begin MEASUREMENT spkret_hold_tmr "Eng start/FSO retard hold time" FLOAT32_IEEE Compu_spkret_hold_tmr 0 0 -10000000000 10000000000 ECU_ADDRESS 0x01010AE8 /end MEASUREMENT
/begin COMPU_METHOD Compu_spkret_hold_tmr " " RAT_FUNC "%.1" "seconds" COEFFS 0 1000 0 0 0 1 /end COMPU_METHOD
/begin MEASUREMENT OILTL_level_pct "Converted" SWORD Compu_OILTL_level_pct 0 0 -125 124.996185302734 ECU_ADDRESS 0x01010ED8 /end MEASUREMENT
/begin COMPU_METHOD Compu_OILTL_level_pct " " RAT_FUNC "%.2" "%" COEFFS 0 262.144 0 0 0 1 /end COMPU_METHOD
/begin MEASUREMENT OILTL_level "Oil T/L level" SWORD Compu_OILTL_level 0 0 -125 124.996185302734 ECU_ADDRESS 0x01010EE0 /end MEASUREMENT
/begin COMPU_METHOD Compu_OILTL_level " " RAT_FUNC "%.2" "%" COEFFS 0 262.144 0 0 0 1 /end COMPU_METHOD
/begin CHARACTERISTIC spkret_EGT "EGT retard decay threshold" VALUE 0x00147b94 /* @ECU_Address@spkret_EGT@0x01011B58@ */ ECIPP_ALIGNMENT_UWORD 7732 Compu_spkret_EGT -460 7731.875 /end CHARACTERISTIC
/begin COMPU_METHOD Compu_spkret_EGT " " RAT_FUNC "%.0" "deg F" COEFFS 0 8 3680 0 0 1 /end COMPU_METHOD
/begin CHARACTERISTIC spkret_hold_mult "Invalid EGT hold multiplier" VALUE 0x00147b98 /* @ECU_Address@spkret_hold_mult@0x01011B60@ */ ECIPP_ALIGNMENT_UWORD 1 Compu_spkret_hold_mult 0 0.999984741210938 /end CHARACTERISTIC
/begin COMPU_METHOD Compu_spkret_hold_mult " " RAT_FUNC "%.2" "-" COEFFS 0 65536 0 0 0 1 /end COMPU_METHOD
/begin MEASUREMENT inj_sweep_state "Injector sweep test status{inj_sweep_state&0xff=0:Test Not Started}{inj_sweep_state&0xff=1:Test Injector 1 (Block Order)}{inj_sweep_state&0xff=2:Test Injector 2 (Block Order)}{inj_sweep_state&0xff=3:Test Injector 3 (Block Order)}{inj_sweep_state&0xff=4:Te" UBYTE inj_sweep_state_COMPU_VTAB 0 0 0 255 ECU_ADDRESS 0x01011C68 BIT_MASK 0xff /end MEASUREMENT
/begin COMPU_METHOD inj_sweep_state_COMPU_VTAB "Verbal Table" TAB_VERB "%.0" "list" COMPU_TAB_REF inj_sweep_state_COMPU_VTAB_REF /end COMPU_METHOD
/begin COMPU_VTAB inj_sweep_state_COMPU_VTAB_REF "Verbal Table" TAB_VERB 24 0 "Test Not Started" 1 "Test Injector 1 (Block Order)" 2 "Test Injector 2 (Block Order)" 3 "Test Injector 3 (Block Order)" 4 "Test Injector 4 (Block Order)" 5 "Test Injector 5 (Block Order)" 6 "Test Injector 6 (Block Order)" 7 "Test Injector 7 (Block Order)" 8 "Test Injector 8 (Block Order)" 9 "Test Injector 9 (Block Order)" 10 "Test Injector 10 (Block Order)" 11 "Waiting for CL" 12 "Restoring CL BM Baseline" 13 "Stalled (Restart Engine)" 14 "Resetting Test" 15 "Completed Testing" 16 "Error Occurred" 17 "Test Stopped Prematurely" 18 "Error: CL Inactive" 19 "Error: Engine Not Injected" 20 "Error: Engine Not Running" 21 "Error: Kill Time Too Long" 22 "Error: Inj Kill Test Running" 23 "Error: Diesel Not Supported" DEFAULT_VALUE "UNKNOWN" /end COMPU_VTAB
/begin MEASUREMENT inj_sweep_ena "Injector sweep command{inj_sweep_ena&0xff=0:Disabled}{inj_sweep_ena&0xff=1:Active}" UBYTE inj_sweep_ena_COMPU_VTAB 0 0 0 255 ECU_ADDRESS 0x01011C70 BIT_MASK 0xff /end MEASUREMENT
/begin COMPU_METHOD inj_sweep_ena_COMPU_VTAB "Verbal Table" TAB_VERB "%.0" "list" COMPU_TAB_REF inj_sweep_ena_COMPU_VTAB_REF /end COMPU_METHOD
/begin COMPU_VTAB inj_sweep_ena_COMPU_VTAB_REF "Verbal Table" TAB_VERB 2 0 "Disabled" 1 "Active" DEFAULT_VALUE "UNKNOWN" /end COMPU_VTAB
/begin MEASUREMENT inj_sweep_tmr "Injector sweep test timer" UWORD Compu_inj_sweep_tmr 0 0 0 65.535 ECU_ADDRESS 0x01011F28 /end MEASUREMENT
/begin COMPU_METHOD Compu_inj_sweep_tmr " " RAT_FUNC "%.0" "sec" COEFFS 0 1000 0 0 0 1 /end COMPU_METHOD
/begin CHARACTERISTIC choke_add_mode "Choked fuel adder mode{choke_add_mode&0xff=0:Primary = Gasoline}{choke_add_mode&0xff=1:Primary = Gasoline & Non-DEPR Gaseous}{choke_add_mode&0xff=2:Primary = Gasoline, Secondary = Gaseous}" VALUE 0x00148127 /* @ECU_Address@choke_add_mode@0x01011FB0@ */ ECIPP_ALIGNMENT_UBYTE 255 choke_add_mode_COMPU_VTAB 0 255 BIT_MASK 0xff /end CHARACTERISTIC
/begin COMPU_METHOD choke_add_mode_COMPU_VTAB "Verbal Table" TAB_VERB "%.0" "list" COMPU_TAB_REF choke_add_mode_COMPU_VTAB_REF /end COMPU_METHOD
/begin COMPU_VTAB choke_add_mode_COMPU_VTAB_REF "Verbal Table" TAB_VERB 3 0 "Primary = Gasoline" 1 "Primary = Gasoline & Non-DEPR Gaseous" 2 "Primary = Gasoline, Secondary = Gaseous" DEFAULT_VALUE "UNKNOWN" /end COMPU_VTAB
/begin MEASUREMENT EGR_vlv_dt_cmd "EGR valve test command{EGR_vlv_dt_cmd&0xff=0:Disabled}{EGR_vlv_dt_cmd&0xff=1:Active}" UBYTE EGR_vlv_dt_cmd_COMPU_VTAB 0 0 0 255 ECU_ADDRESS 0x01012F60 BIT_MASK 0xff /end MEASUREMENT
/begin COMPU_METHOD EGR_vlv_dt_cmd_COMPU_VTAB "Verbal Table" TAB_VERB "%.0" "list" COMPU_TAB_REF EGR_vlv_dt_cmd_COMPU_VTAB_REF /end COMPU_METHOD
/begin COMPU_VTAB EGR_vlv_dt_cmd_COMPU_VTAB_REF "Verbal Table" TAB_VERB 2 0 "Disabled" 1 "Active" DEFAULT_VALUE "UNKNOWN" /end COMPU_VTAB
/begin MEASUREMENT EGR_vlv_dt_state "EGR valve test status{EGR_vlv_dt_state&0xff=0:Inactive}{EGR_vlv_dt_state&0xff=1:Inactive: engine not stopped}{EGR_vlv_dt_state&0xff=2:Inactive: key is off}{EGR_vlv_dt_state&0xff=3:Inactive: EGR manual mode}{EGR_vlv_dt_state&0xff=4:Active}" UBYTE EGR_vlv_dt_state_COMPU_VTAB 0 0 0 255 ECU_ADDRESS 0x01012F68 BIT_MASK 0xff /end MEASUREMENT
/begin COMPU_METHOD EGR_vlv_dt_state_COMPU_VTAB "Verbal Table" TAB_VERB "%.0" "list" COMPU_TAB_REF EGR_vlv_dt_state_COMPU_VTAB_REF /end COMPU_METHOD
/begin COMPU_VTAB EGR_vlv_dt_state_COMPU_VTAB_REF "Verbal Table" TAB_VERB 5 0 "Inactive" 1 "Inactive: engine not stopped" 2 "Inactive: key is off" 3 "Inactive: EGR manual mode" 4 "Active" DEFAULT_VALUE "UNKNOWN" /end COMPU_VTAB
/begin MEASUREMENT VSFan_dt_cmd "Fan speed test command{VSFan_dt_cmd&0xff=0:Disabled}{VSFan_dt_cmd&0xff=1:Active}" UBYTE VSFan_dt_cmd_COMPU_VTAB 0 0 0 255 ECU_ADDRESS 0x01012F70 BIT_MASK 0xff /end MEASUREMENT
/begin COMPU_METHOD VSFan_dt_cmd_COMPU_VTAB "Verbal Table" TAB_VERB "%.0" "list" COMPU_TAB_REF VSFan_dt_cmd_COMPU_VTAB_REF /end COMPU_METHOD
/begin COMPU_VTAB VSFan_dt_cmd_COMPU_VTAB_REF "Verbal Table" TAB_VERB 2 0 "Disabled" 1 "Active" DEFAULT_VALUE "UNKNOWN" /end COMPU_VTAB
/begin MEASUREMENT VSFan_dt_state "Fan speed test status{VSFan_dt_state&0xff=0xce:Inactive: foot pedal in use}{VSFan_dt_state&0xff=0xcf:Inactive: fuel shutoff active}{VSFan_dt_state&0xff=0xd0:Inactive: PTO active}{VSFan_dt_state&0xff=0xd1:Inactive: clutch depressed}{VSFan_dt_state&0xff=0xd" UBYTE VSFan_dt_state_COMPU_VTAB 0 0 0 255 ECU_ADDRESS 0x01012F78 BIT_MASK 0xff /end MEASUREMENT
/begin COMPU_METHOD VSFan_dt_state_COMPU_VTAB "Verbal Table" TAB_VERB "%.0" "list" COMPU_TAB_REF VSFan_dt_state_COMPU_VTAB_REF /end COMPU_METHOD
/begin COMPU_VTAB VSFan_dt_state_COMPU_VTAB_REF "Verbal Table" TAB_VERB 25 0xce "Inactive: foot pedal in use" 0xcf "Inactive: fuel shutoff active" 0xd0 "Inactive: PTO active" 0xd1 "Inactive: clutch depressed" 0xd2 "Inactive: clutch state unknown" 0xd3 "Inactive: brake pedal depressed" 0xd4 "Inactive: brake pedal state unknown" 0xd5 "Inactive: vehicle in motion" 0xd6 "Inactive: vehicle speed unknown" 0xd7 "Inactive: transmission in gear" 0xd8 "Inactive: secondary speed control active" 0xfd "Inactive: ECT low" 0xfe "Inactive: AAT low" 0xff "Inactive: OILT low" 0 "Disabled" 1 "Inactive: engine stopped" 2 "Inactive: other diagnostic running" 10 "Inactive" 20 "Completed" 30 "Active: increasing speed" 31 "Active: waiting for fan speed #1" 32 "Active: checking fan speed #1" 33 "Active: waiting for fan speed #2" 34 "Active: checking fan speed #2" 35 "Active: returning to idle" DEFAULT_VALUE "UNKNOWN" /end COMPU_VTAB
/begin MEASUREMENT VSFan_rpm_err "Fan speed error" SWORD Compu_VSFan_rpm_err 0 0 -32768 32767 ECU_ADDRESS 0x01012F80 /end MEASUREMENT
/begin COMPU_METHOD Compu_VSFan_rpm_err " " RAT_FUNC "%.0" "rpm" COEFFS 0 1 0 0 0 1 /end COMPU_METHOD
/begin MEASUREMENT VSFan_dt_err_avg1 "Fan speed average error at speed #1" SWORD Compu_VSFan_dt_err_avg1 0 0 -32768 32767 ECU_ADDRESS 0x01012F88 /end MEASUREMENT
/begin COMPU_METHOD Compu_VSFan_dt_err_avg1 " " RAT_FUNC "%.0" "rpm" COEFFS 0 1 0 0 0 1 /end COMPU_METHOD
/begin MEASUREMENT VSFan_dt_err_avg2 "Fan speed average error at speed #2" SWORD Compu_VSFan_dt_err_avg2 0 0 -32768 32767 ECU_ADDRESS 0x01012F90 /end MEASUREMENT
/begin COMPU_METHOD Compu_VSFan_dt_err_avg2 " " RAT_FUNC "%.0" "rpm" COEFFS 0 1 0 0 0 1 /end COMPU_METHOD
/begin CHARACTERISTIC VSFan_dt_ECT_min "Fan speed test minimum ECT" VALUE 0x00147a30 /* @ECU_Address@VSFan_dt_ECT_min@0x01012F98@ */ ECIPP_ALIGNMENT_UWORD 564 Compu_VSFan_dt_ECT_min -460 563.984375 /end CHARACTERISTIC
/begin COMPU_METHOD Compu_VSFan_dt_ECT_min " " RAT_FUNC "%.1" "deg F" COEFFS 0 64 29440 0 0 1 /end COMPU_METHOD
/begin CHARACTERISTIC VSFan_dt_AAT_min "Fan speed test minimum AAT" VALUE 0x00147a2e /* @ECU_Address@VSFan_dt_AAT_min@0x01012FA0@ */ ECIPP_ALIGNMENT_UWORD 564 Compu_VSFan_dt_AAT_min -460 563.984375 /end CHARACTERISTIC
/begin COMPU_METHOD Compu_VSFan_dt_AAT_min " " RAT_FUNC "%.1" "deg F" COEFFS 0 64 29440 0 0 1 /end COMPU_METHOD
/begin CHARACTERISTIC VSFan_dt_OILT_min "Fan speed test minimum OILT" VALUE 0x00147a32 /* @ECU_Address@VSFan_dt_OILT_min@0x01012FA8@ */ ECIPP_ALIGNMENT_UWORD 7732 Compu_VSFan_dt_OILT_min -460 7731.875 /end CHARACTERISTIC
/begin COMPU_METHOD Compu_VSFan_dt_OILT_min " " RAT_FUNC "%.1" "deg F" COEFFS 0 8 3680 0 0 1 /end COMPU_METHOD
/begin CHARACTERISTIC VSFan_dt_engrpm "Fan test engine speed" VALUE 0x00147a36 /* @ECU_Address@VSFan_dt_engrpm@0x01012FB0@ */ ECIPP_ALIGNMENT_UWORD 65535 Compu_VSFan_dt_engrpm 0 65535 /end CHARACTERISTIC
/begin COMPU_METHOD Compu_VSFan_dt_engrpm " " RAT_FUNC "%.0" "rpm" COEFFS 0 1 0 0 0 1 /end COMPU_METHOD
/begin CHARACTERISTIC VSFan_dt_engrpm_rate "Fan test engine speed ramp rate" VALUE 0x00147a38 /* @ECU_Address@VSFan_dt_engrpm_rate@0x01012FB8@ */ ECIPP_ALIGNMENT_UWORD 65535 Compu_VSFan_dt_engrpm_rate 0 65535 /end CHARACTERISTIC
/begin COMPU_METHOD Compu_VSFan_dt_engrpm_rate " " RAT_FUNC "%.0" "rpm/sec" COEFFS 0 1 0 0 0 1 /end COMPU_METHOD
/begin CHARACTERISTIC VSFan_dt_rpm1 "Fan test speed #1" VALUE 0x00147a3a /* @ECU_Address@VSFan_dt_rpm1@0x01012FC0@ */ ECIPP_ALIGNMENT_UWORD 65535 Compu_VSFan_dt_rpm1 0 65535 /end CHARACTERISTIC
/begin COMPU_METHOD Compu_VSFan_dt_rpm1 " " RAT_FUNC "%.0" "rpm" COEFFS 0 1 0 0 0 1 /end COMPU_METHOD
/begin CHARACTERISTIC VSFan_dt_rpm2 "Fan test speed #2" VALUE 0x00147a3c /* @ECU_Address@VSFan_dt_rpm2@0x01012FC8@ */ ECIPP_ALIGNMENT_UWORD 65535 Compu_VSFan_dt_rpm2 0 65535 /end CHARACTERISTIC
/begin COMPU_METHOD Compu_VSFan_dt_rpm2 " " RAT_FUNC "%.0" "rpm" COEFFS 0 1 0 0 0 1 /end COMPU_METHOD
/begin CHARACTERISTIC VSFan_dt_wait_tm "Fan speed test wait time" VALUE 0x00147a3e /* @ECU_Address@VSFan_dt_wait_tm@0x01012FD0@ */ ECIPP_ALIGNMENT_UWORD 1024 Compu_VSFan_dt_wait_tm 0 1023.984375 /end CHARACTERISTIC
/begin COMPU_METHOD Compu_VSFan_dt_wait_tm " " RAT_FUNC "%.0" "sec" COEFFS 0 64 0 0 0 1 /end COMPU_METHOD
/begin CHARACTERISTIC VSFan_dt_avg_tm "Fan speed error measurement time" VALUE 0x00147a34 /* @ECU_Address@VSFan_dt_avg_tm@0x01012FD8@ */ ECIPP_ALIGNMENT_UWORD 1024 Compu_VSFan_dt_avg_tm 0 1023.984375 /end CHARACTERISTIC
/begin COMPU_METHOD Compu_VSFan_dt_avg_tm " " RAT_FUNC "%.0" "sec" COEFFS 0 64 0 0 0 1 /end COMPU_METHOD
/begin CHARACTERISTIC VSFan_dt_access "Fan speed test write access{VSFan_dt_access&0xff=0:Engineer}{VSFan_dt_access&0xff=1:SuperTech}" VALUE 0x00169609 /* @ECU_Address@VSFan_dt_access@0x01012FE0@ */ ECIPP_ALIGNMENT_UBYTE 255 VSFan_dt_access_COMPU_VTAB 0 255 BIT_MASK 0xff /end CHARACTERISTIC
/begin COMPU_METHOD VSFan_dt_access_COMPU_VTAB "Verbal Table" TAB_VERB "%.0" "list" COMPU_TAB_REF VSFan_dt_access_COMPU_VTAB_REF /end COMPU_METHOD
/begin COMPU_VTAB VSFan_dt_access_COMPU_VTAB_REF "Verbal Table" TAB_VERB 2 0 "Engineer" 1 "SuperTech" DEFAULT_VALUE "UNKNOWN" /end COMPU_VTAB
/begin MEASUREMENT Vbatdt_float "Vbat derivative (dVbat/dt)" FLOAT32_IEEE Compu_Vbatdt_float 0 0 -10000000000 10000000000 ECU_ADDRESS 0x01013018 /end MEASUREMENT
/begin COMPU_METHOD Compu_Vbatdt_float " " RAT_FUNC "%.1" "volts/sec" COEFFS 0 1 0 0 0 1 /end COMPU_METHOD
/begin CHARACTERISTIC fuelclr_auto_ena "Automatic fuel clear{fuelclr_auto_ena&0xff=0:Disabled}{fuelclr_auto_ena&0xff=1:Enabled}" VALUE 0x00148181 /* @ECU_Address@fuelclr_auto_ena@0x010136B0@ */ ECIPP_ALIGNMENT_UBYTE 255 fuelclr_auto_ena_COMPU_VTAB 0 255 BIT_MASK 0xff /end CHARACTERISTIC
/begin COMPU_METHOD fuelclr_auto_ena_COMPU_VTAB "Verbal Table" TAB_VERB "%.0" "list" COMPU_TAB_REF fuelclr_auto_ena_COMPU_VTAB_REF /end COMPU_METHOD
/begin COMPU_VTAB fuelclr_auto_ena_COMPU_VTAB_REF "Verbal Table" TAB_VERB 2 0 "Disabled" 1 "Enabled" DEFAULT_VALUE "UNKNOWN" /end COMPU_VTAB
/begin CHARACTERISTIC fuelclr_auto_rstmode "Automatic fuel clear timer reset{fuelclr_auto_rstmode&0xff=0:After key-off sleep}{fuelclr_auto_rstmode&0xff=1:Every key-off}" VALUE 0x00148182 /* @ECU_Address@fuelclr_auto_rstmode@0x010136B8@ */ ECIPP_ALIGNMENT_UBYTE 255 fuelclr_auto_rstmode_COMPU_VTAB 0 255 BIT_MASK 0xff /end CHARACTERISTIC
/begin COMPU_METHOD fuelclr_auto_rstmode_COMPU_VTAB "Verbal Table" TAB_VERB "%.0" "list" COMPU_TAB_REF fuelclr_auto_rstmode_COMPU_VTAB_REF /end COMPU_METHOD
/begin COMPU_VTAB fuelclr_auto_rstmode_COMPU_VTAB_REF "Verbal Table" TAB_VERB 2 0 "After key-off sleep" 1 "Every key-off" DEFAULT_VALUE "UNKNOWN" /end COMPU_VTAB
/begin MEASUREMENT fuelclr_auto_tmr "Automatic fuel clear timer" UWORD Compu_fuelclr_auto_tmr 0 0 0 65.535 ECU_ADDRESS 0x010136C0 /end MEASUREMENT
/begin COMPU_METHOD Compu_fuelclr_auto_tmr " " RAT_FUNC "%.1" "sec" COEFFS 0 1000 0 0 0 1 /end COMPU_METHOD
/begin MEASUREMENT fuelclr_auto_state "Automatic fuel clear state{fuelclr_auto_state&0xff=0x00:Disabled}{fuelclr_auto_state&0xff=0x01:Inactive}{fuelclr_auto_state&0xff=0x02:Waiting for start}{fuelclr_auto_state&0xff=0x06:Clearing}" UBYTE fuelclr_auto_state_COMPU_VTAB 0 0 0 255 ECU_ADDRESS 0x010136C8 BIT_MASK 0xff /end MEASUREMENT
/begin COMPU_METHOD fuelclr_auto_state_COMPU_VTAB "Verbal Table" TAB_VERB "%.0" "list" COMPU_TAB_REF fuelclr_auto_state_COMPU_VTAB_REF /end COMPU_METHOD
/begin COMPU_VTAB fuelclr_auto_state_COMPU_VTAB_REF "Verbal Table" TAB_VERB 4 0x00 "Disabled" 0x01 "Inactive" 0x02 "Waiting for start" 0x06 "Clearing" DEFAULT_VALUE "UNKNOWN" /end COMPU_VTAB
/begin MEASUREMENT fuelclr_requested "Fuel clear requested{fuelclr_requested&0xff=0:NO}{fuelclr_requested&0xff=1:YES}" UBYTE fuelclr_requested_COMPU_VTAB 0 0 0 255 ECU_ADDRESS 0x010136D0 BIT_MASK 0xff /end MEASUREMENT
/begin COMPU_METHOD fuelclr_requested_COMPU_VTAB "Verbal Table" TAB_VERB "%.0" "list" COMPU_TAB_REF fuelclr_requested_COMPU_VTAB_REF /end COMPU_METHOD
/begin COMPU_VTAB fuelclr_requested_COMPU_VTAB_REF "Verbal Table" TAB_VERB 2 0 "NO" 1 "YES" DEFAULT_VALUE "UNKNOWN" /end COMPU_VTAB
/begin MEASUREMENT TSTCM_cmd "Catalyst test command{TSTCM_cmd&0xff=0:Disabled}{TSTCM_cmd&0xff=1:Active}" UBYTE TSTCM_cmd_COMPU_VTAB 0 0 0 255 ECU_ADDRESS 0x01013768 BIT_MASK 0xff /end MEASUREMENT
/begin COMPU_METHOD TSTCM_cmd_COMPU_VTAB "Verbal Table" TAB_VERB "%.0" "list" COMPU_TAB_REF TSTCM_cmd_COMPU_VTAB_REF /end COMPU_METHOD
/begin COMPU_VTAB TSTCM_cmd_COMPU_VTAB_REF "Verbal Table" TAB_VERB 2 0 "Disabled" 1 "Active" DEFAULT_VALUE "UNKNOWN" /end COMPU_VTAB
/begin MEASUREMENT TSTCM_ntrlock_ovrd "Catalyst test interlock override" UWORD Compu_TSTCM_ntrlock_ovrd 0 0 0 65535 ECU_ADDRESS 0x01013770 /end MEASUREMENT
/begin COMPU_METHOD Compu_TSTCM_ntrlock_ovrd " " RAT_FUNC "%.0" "-" COEFFS 0 1 0 0 0 1 /end COMPU_METHOD
/begin MEASUREMENT TSTCM_state "Catalyst test state{TSTCM_state&0xff=0:Disabled}{TSTCM_state&0xff=1:Inactive: engine stopped}{TSTCM_state&0xff=2:Inactive: other diagnostic running}{TSTCM_state&0xff=3:Inactive: invalid test parameters}{TSTCM_state&0xff=4:Completed}{TSTCM_state&0xff=11:In" UBYTE TSTCM_state_COMPU_VTAB 0 0 0 255 ECU_ADDRESS 0x01013778 BIT_MASK 0xff /end MEASUREMENT
/begin COMPU_METHOD TSTCM_state_COMPU_VTAB "Verbal Table" TAB_VERB "%.0" "list" COMPU_TAB_REF TSTCM_state_COMPU_VTAB_REF /end COMPU_METHOD
/begin COMPU_VTAB TSTCM_state_COMPU_VTAB_REF "Verbal Table" TAB_VERB 21 0 "Disabled" 1 "Inactive: engine stopped" 2 "Inactive: other diagnostic running" 3 "Inactive: invalid test parameters" 4 "Completed" 11 "Inactive: foot pedal in use" 12 "Inactive: fuel shutoff active" 13 "Inactive: PTO active" 14 "Inactive: clutch depressed" 15 "Inactive: clutch state unknown" 16 "Inactive: brake pedal depressed" 17 "Inactive: brake pedal state unknown" 18 "Inactive: vehicle in motion" 19 "Inactive: vehicle speed unknown" 20 "Inactive: transmission in gear" 21 "Inactive: secondary speed control active" 100 "Active: initializing" 101 "Active: increasing speed" 102 "Active: wait period" 103 "Active: monitoring catalyst" 104 "Active: returning to idle" DEFAULT_VALUE "UNKNOWN" /end COMPU_VTAB
/begin MEASUREMENT TSTCM_tmr "Catalyst test timer" UWORD Compu_TSTCM_tmr 0 0 0 65.535 ECU_ADDRESS 0x01013780 /end MEASUREMENT
/begin COMPU_METHOD Compu_TSTCM_tmr " " RAT_FUNC "%.1" "sec" COEFFS 0 1000 0 0 0 1 /end COMPU_METHOD
/begin CHARACTERISTIC TSTCM_wait_tm "Catalyst test wait time" VALUE 0x00147924 /* @ECU_Address@TSTCM_wait_tm@0x01013788@ */ ECIPP_ALIGNMENT_UWORD 66 Compu_TSTCM_wait_tm 0 65.535 /end CHARACTERISTIC
/begin COMPU_METHOD Compu_TSTCM_wait_tm " " RAT_FUNC "%.1" "sec" COEFFS 0 1000 0 0 0 1 /end COMPU_METHOD
/begin CHARACTERISTIC TSTCM_diag_tm "Catalyst test diagnostic time" VALUE 0x0014791e /* @ECU_Address@TSTCM_diag_tm@0x01013790@ */ ECIPP_ALIGNMENT_UWORD 66 Compu_TSTCM_diag_tm 0 65.535 /end CHARACTERISTIC
/begin COMPU_METHOD Compu_TSTCM_diag_tm " " RAT_FUNC "%.1" "sec" COEFFS 0 1000 0 0 0 1 /end COMPU_METHOD
/begin CHARACTERISTIC TSTCM_engrpm "Catalyst test engine speed" VALUE 0x00147920 /* @ECU_Address@TSTCM_engrpm@0x01013798@ */ ECIPP_ALIGNMENT_UWORD 65535 Compu_TSTCM_engrpm 0 65535 /end CHARACTERISTIC
/begin COMPU_METHOD Compu_TSTCM_engrpm " " RAT_FUNC "%.0" "rpm" COEFFS 0 1 0 0 0 1 /end COMPU_METHOD
/begin CHARACTERISTIC TSTCM_engrpm_rate "Catalyst test engine speed ramp rate" VALUE 0x00147922 /* @ECU_Address@TSTCM_engrpm_rate@0x010137A0@ */ ECIPP_ALIGNMENT_UWORD 65535 Compu_TSTCM_engrpm_rate 0 65535 /end CHARACTERISTIC
/begin COMPU_METHOD Compu_TSTCM_engrpm_rate " " RAT_FUNC "%.0" "rpm/sec" COEFFS 0 1 0 0 0 1 /end COMPU_METHOD
/begin MEASUREMENT TSTCM_results "Catalyst test result{TSTCM_results&0x01=0x01:Aborted: fault}{TSTCM_results&0x02=0x02:Aborted: post-cat updates disabled}{TSTCM_results&0x04=0x04:Aborted: non-stoich phi command}{TSTCM_results&0x08=0x08:Aborted: closed-loop disabled}{TSTCM_results&0x10=0x1" UBYTE TSTCM_results_COMPU_VTAB 0 0 0 255 ECU_ADDRESS 0x010137A8 BIT_MASK 0x01 /end MEASUREMENT
/begin COMPU_METHOD TSTCM_results_COMPU_VTAB "Verbal Table" TAB_VERB "%.0" "list" COMPU_TAB_REF TSTCM_results_COMPU_VTAB_REF /end COMPU_METHOD
/begin COMPU_VTAB TSTCM_results_COMPU_VTAB_REF "Verbal Table" TAB_VERB 1 0x01 "Aborted: fault" DEFAULT_VALUE "Unsupported Bit_Mask" /end COMPU_VTAB
/begin CHARACTERISTIC TSTCL_warmup_mode "CL test sensor warm-up mode{TSTCL_warmup_mode&0xff=0:Legacy}{TSTCL_warmup_mode&0xff=1:Normal warm-up process}" VALUE 0x001480bd /* @ECU_Address@TSTCL_warmup_mode@0x010137B0@ */ ECIPP_ALIGNMENT_UBYTE 255 TSTCL_warmup_mode_COMPU_VTAB 0 255 BIT_MASK 0xff /end CHARACTERISTIC
/begin COMPU_METHOD TSTCL_warmup_mode_COMPU_VTAB "Verbal Table" TAB_VERB "%.0" "list" COMPU_TAB_REF TSTCL_warmup_mode_COMPU_VTAB_REF /end COMPU_METHOD
/begin COMPU_VTAB TSTCL_warmup_mode_COMPU_VTAB_REF "Verbal Table" TAB_VERB 2 0 "Legacy" 1 "Normal warm-up process" DEFAULT_VALUE "UNKNOWN" /end COMPU_VTAB
/begin CHARACTERISTIC coldstrt_mode "Cold start mode{coldstrt_mode&0xff=0:Disabled}{coldstrt_mode&0xff=1:Enabled}" VALUE 0x0014812a /* @ECU_Address@coldstrt_mode@0x010137D8@ */ ECIPP_ALIGNMENT_UBYTE 255 coldstrt_mode_COMPU_VTAB 0 255 BIT_MASK 0xff /end CHARACTERISTIC
/begin COMPU_METHOD coldstrt_mode_COMPU_VTAB "Verbal Table" TAB_VERB "%.0" "list" COMPU_TAB_REF coldstrt_mode_COMPU_VTAB_REF /end COMPU_METHOD
/begin COMPU_VTAB coldstrt_mode_COMPU_VTAB_REF "Verbal Table" TAB_VERB 2 0 "Disabled" 1 "Enabled" DEFAULT_VALUE "UNKNOWN" /end COMPU_VTAB
/begin MEASUREMENT coldstrt_state "Cold start state{coldstrt_state&0xff=0:Waiting for start}{coldstrt_state&0xff=1:Active}{coldstrt_state&0xff=10:Disabled}{coldstrt_state&0xff=11:Timed out}{coldstrt_state&0xff=12:Inactive}{coldstrt_state&0xff=13:Complete}" UBYTE coldstrt_state_COMPU_VTAB 0 0 0 255 ECU_ADDRESS 0x010137E0 BIT_MASK 0xff /end MEASUREMENT
/begin COMPU_METHOD coldstrt_state_COMPU_VTAB "Verbal Table" TAB_VERB "%.0" "list" COMPU_TAB_REF coldstrt_state_COMPU_VTAB_REF /end COMPU_METHOD
/begin COMPU_VTAB coldstrt_state_COMPU_VTAB_REF "Verbal Table" TAB_VERB 6 0 "Waiting for start" 1 "Active" 10 "Disabled" 11 "Timed out" 12 "Inactive" 13 "Complete" DEFAULT_VALUE "UNKNOWN" /end COMPU_VTAB
/begin CHARACTERISTIC coldstrt_ECT "Cold start ECT threshold" VALUE 0x00147aa0 /* @ECU_Address@coldstrt_ECT@0x010137E8@ */ ECIPP_ALIGNMENT_UWORD 564 Compu_coldstrt_ECT -460 563.984375 /end CHARACTERISTIC
/begin COMPU_METHOD Compu_coldstrt_ECT " " RAT_FUNC "%.0" "deg F" COEFFS 0 64 29440 0 0 1 /end COMPU_METHOD
/begin CHARACTERISTIC coldstrt_max_tm "Cold start max active time" VALUE 0x00147aa2 /* @ECU_Address@coldstrt_max_tm@0x010137F0@ */ ECIPP_ALIGNMENT_UWORD 65535 Compu_coldstrt_max_tm 0 65535 /end CHARACTERISTIC
/begin COMPU_METHOD Compu_coldstrt_max_tm " " RAT_FUNC "%.0" "sec" COEFFS 0 1 0 0 0 1 /end COMPU_METHOD
/begin CHARACTERISTIC spk_kill_rpm "Spark kill test RPM limit" VALUE 0x00147b88 /* @ECU_Address@spk_kill_rpm@0x01013970@ */ ECIPP_ALIGNMENT_UWORD 65535 Compu_spk_kill_rpm 0 65535 /end CHARACTERISTIC
/begin COMPU_METHOD Compu_spk_kill_rpm " " RAT_FUNC "%.0" "rpm" COEFFS 0 1 0 0 0 1 /end COMPU_METHOD
/begin CHARACTERISTIC spk_kill_MAP "Spark kill test MAP limit" VALUE 0x00147b86 /* @ECU_Address@spk_kill_MAP@0x01013978@ */ ECIPP_ALIGNMENT_UWORD 256 Compu_spk_kill_MAP 0 255.99609375 /end CHARACTERISTIC
/begin COMPU_METHOD Compu_spk_kill_MAP " " RAT_FUNC "%.2" "psia" COEFFS 0 256 0 0 0 1 /end COMPU_METHOD
/begin CHARACTERISTIC spk_kill_CBT "Spark kill test CBT limit" VALUE 0x00147b84 /* @ECU_Address@spk_kill_CBT@0x01013980@ */ ECIPP_ALIGNMENT_UWORD 7732 Compu_spk_kill_CBT -460 7731.875 /end CHARACTERISTIC
/begin COMPU_METHOD Compu_spk_kill_CBT " " RAT_FUNC "%.0" "deg F" COEFFS 0 8 3680 0 0 1 /end COMPU_METHOD
/begin MEASUREMENT m_f_choke2 "mass fuel choke (secondary)" UWORD Compu_m_f_choke2 0 0 0 1023.984375 ECU_ADDRESS 0x01013B78 /end MEASUREMENT
/begin COMPU_METHOD Compu_m_f_choke2 " " RAT_FUNC "%.1" "mg/intake" COEFFS 0 64 0 0 0 1 /end COMPU_METHOD
/begin COMPU_METHOD Compu_Tww_ECT_ECT " " RAT_FUNC "%.0" "CHT (deg F)" COEFFS 0 32 14720 0 0 1 /end COMPU_METHOD
/begin CHARACTERISTIC Tww_ECT_Cp "Cp Wall-Wet" CURVE 0x001464CC /* @ECU_Address@Tww_ECT_Cp@0x02025000@ */ ECIPP_ALIGNMENT_SWORD 800 Compu_Tww_ECT_Cp -800 799.9755859375
 /begin AXIS_DESCR COM_AXIS NO_INPUT_QUANTITY Compu_Tww_ECT_ECT 16 -1484 563.96875 AXIS_PTS_REF Tww_ECT_ECT /end AXIS_DESCR
/end CHARACTERISTIC
/begin AXIS_PTS Tww_ECT_ECT " " 0x001464EC /* @ECU_Address@Tww_ECT_ECT@0x02024000@ */ NO_INPUT_QUANTITY ECIPP_Lookup_SWORD 0 Compu_Tww_ECT_ECT 16 -1484 563.96875 /end AXIS_PTS
/begin COMPU_METHOD Compu_Tww_ECT_Cp " " RAT_FUNC "%.1" "Cww (%)" COEFFS 0 40.96 0 0 0 1 /end COMPU_METHOD
/begin CHARACTERISTIC Tww_ECT_taup "Taup Wall-Wet" CURVE 0x0014652C /* @ECU_Address@Tww_ECT_taup@0x02026000@ */ ECIPP_ALIGNMENT_SWORD 128 Compu_Tww_ECT_taup -128 127.99609375
 /begin AXIS_DESCR COM_AXIS NO_INPUT_QUANTITY Compu_Tww_ECT_ECT 16 -1484 563.96875 AXIS_PTS_REF Tww_ECT_ECT /end AXIS_DESCR
/end CHARACTERISTIC
/begin COMPU_METHOD Compu_Tww_ECT_taup " " RAT_FUNC "%.1" "Cyl Events" COEFFS 0 256 0 0 0 1 /end COMPU_METHOD
/begin COMPU_METHOD Compu_Sww_rpm " " RAT_FUNC "%.0" "Speed (rpm)" COEFFS 0 1 0 0 0 1 /end COMPU_METHOD
/begin CHARACTERISTIC Sww_mult "Cww Speed-CHT Attenuation" MAP 0x001443B6 /* @ECU_Address@Sww_mult@0x02028000@ */ ECIPP_ALIGNMENT_SWORD 1 Compu_Sww_mult -1 0.999969482421875
 /begin AXIS_DESCR COM_AXIS NO_INPUT_QUANTITY Compu_Sww_CHT 4 -1484 563.96875 AXIS_PTS_REF Sww_CHT /end AXIS_DESCR
 /begin AXIS_DESCR COM_AXIS NO_INPUT_QUANTITY Compu_Sww_rpm 4 -32768 32767 AXIS_PTS_REF Sww_rpm /end AXIS_DESCR
/end CHARACTERISTIC
/begin AXIS_PTS Sww_CHT " " 0x001443AE /* @ECU_Address@Sww_CHT@0x02099000@ */ NO_INPUT_QUANTITY ECIPP_Lookup_SWORD 0 Compu_Sww_CHT 4 -1484 563.96875 /end AXIS_PTS
/begin AXIS_PTS Sww_rpm " " 0x001443D6 /* @ECU_Address@Sww_rpm@0x02027000@ */ NO_INPUT_QUANTITY ECIPP_Lookup_SWORD 0 Compu_Sww_rpm 4 -32768 32767 /end AXIS_PTS
/begin COMPU_METHOD Compu_Sww_mult "" RAT_FUNC "%.3" "Cww Multiplier" COEFFS 0 32768 0 0 0 1 /end COMPU_METHOD
/begin COMPU_METHOD Compu_Tstrt_ECT_ECT " " RAT_FUNC "%.0" "CHT (deg F)" COEFFS 0 32 14720 0 0 1 /end COMPU_METHOD
/begin CHARACTERISTIC Tstrt_ECT_add "Crank Fuel Adder" CURVE 0x00146422 /* @ECU_Address@Tstrt_ECT_add@0x0202A000@ */ ECIPP_ALIGNMENT_SWORD 3200 Compu_Tstrt_ECT_add -3200 3199.90234375
 /begin AXIS_DESCR COM_AXIS NO_INPUT_QUANTITY Compu_Tstrt_ECT_ECT 16 -1484 563.96875 AXIS_PTS_REF Tstrt_ECT_ECT /end AXIS_DESCR
/end CHARACTERISTIC
/begin AXIS_PTS Tstrt_ECT_ECT " " 0x00146402 /* @ECU_Address@Tstrt_ECT_ECT@0x02029000@ */ NO_INPUT_QUANTITY ECIPP_Lookup_SWORD 0 Compu_Tstrt_ECT_ECT 16 -1484 563.96875 /end AXIS_PTS
/begin COMPU_METHOD Compu_Tstrt_ECT_add " " RAT_FUNC "%.1" "Crank Fuel (%)" COEFFS 0 10.24 0 0 0 1 /end COMPU_METHOD
/begin COMPU_METHOD Compu_Tstrt_cyc_cyc " " RAT_FUNC "%.2" "Engine Cycles" COEFFS 0 256 0 0 0 1 /end COMPU_METHOD
/begin CHARACTERISTIC Tstrt_cyc_mult "Crank Fuel Multiplier" CURVE 0x00146462 /* @ECU_Address@Tstrt_cyc_mult@0x0202C000@ */ ECIPP_ALIGNMENT_SWORD 200 Compu_Tstrt_cyc_mult -200 199.993896484375
 /begin AXIS_DESCR COM_AXIS NO_INPUT_QUANTITY Compu_Tstrt_cyc_cyc 16 -128 127.99609375 AXIS_PTS_REF Tstrt_cyc_cyc /end AXIS_DESCR
/end CHARACTERISTIC
/begin AXIS_PTS Tstrt_cyc_cyc " " 0x00146442 /* @ECU_Address@Tstrt_cyc_cyc@0x0202B000@ */ NO_INPUT_QUANTITY ECIPP_Lookup_SWORD 0 Compu_Tstrt_cyc_cyc 16 -128 127.99609375 /end AXIS_PTS
/begin COMPU_METHOD Compu_Tstrt_cyc_mult " " RAT_FUNC "%.1" "Crank Mult (%)" COEFFS 0 163.84 0 0 0 1 /end COMPU_METHOD
/begin COMPU_METHOD Compu_Tspko_ECTvL_ECT " " RAT_FUNC "%.0" "CHT (deg F)" COEFFS 0 32 14720 0 0 1 /end COMPU_METHOD
/begin COMPU_METHOD Compu_Tspko_ECTvL_MAP " " RAT_FUNC "%.1" "MAP load (psia)" COEFFS 0 256 0 0 0 1 /end COMPU_METHOD
/begin CHARACTERISTIC Tspko_ECTvL_CAD "Gasoline CHT Spark Offset" MAP 0x0014311C /* @ECU_Address@Tspko_ECTvL_CAD@0x02032000@ */ ECIPP_ALIGNMENT_SWORD 2048 Compu_Tspko_ECTvL_CAD -2048 2047.9375
 /begin AXIS_DESCR COM_AXIS NO_INPUT_QUANTITY Compu_Tspko_ECTvL_MAP 8 -128 127.99609375 AXIS_PTS_REF Tspko_ECTvL_MAP /end AXIS_DESCR
 /begin AXIS_DESCR COM_AXIS NO_INPUT_QUANTITY Compu_Tspko_ECTvL_ECT 16 -1484 563.96875 AXIS_PTS_REF Tspko_ECTvL_ECT /end AXIS_DESCR
/end CHARACTERISTIC
/begin AXIS_PTS Tspko_ECTvL_MAP " " 0x0014323C /* @ECU_Address@Tspko_ECTvL_MAP@0x02031000@ */ NO_INPUT_QUANTITY ECIPP_Lookup_SWORD 0 Compu_Tspko_ECTvL_MAP 8 -128 127.99609375 /end AXIS_PTS
/begin AXIS_PTS Tspko_ECTvL_ECT " " 0x0014321C /* @ECU_Address@Tspko_ECTvL_ECT@0x02030000@ */ NO_INPUT_QUANTITY ECIPP_Lookup_SWORD 0 Compu_Tspko_ECTvL_ECT 16 -1484 563.96875 /end AXIS_PTS
/begin COMPU_METHOD Compu_Tspko_ECTvL_CAD "" RAT_FUNC "%.1" "CAD" COEFFS 0 16 0 0 0 1 /end COMPU_METHOD
/begin COMPU_METHOD Compu_Tspko_MATvL_MAT " " RAT_FUNC "%.0" "MAT (deg F)" COEFFS 0 32 14720 0 0 1 /end COMPU_METHOD
/begin COMPU_METHOD Compu_Tspko_MATvL_MAP " " RAT_FUNC "%.1" "MAP load (psia)" COEFFS 0 256 0 0 0 1 /end COMPU_METHOD
/begin CHARACTERISTIC Tspko_MATvL_CAD "Gasoline MAT Spark Offset" MAP 0x0014324C /* @ECU_Address@Tspko_MATvL_CAD@0x02035000@ */ ECIPP_ALIGNMENT_SWORD 2048 Compu_Tspko_MATvL_CAD -2048 2047.9375
 /begin AXIS_DESCR COM_AXIS NO_INPUT_QUANTITY Compu_Tspko_MATvL_MAP 8 -128 127.99609375 AXIS_PTS_REF Tspko_MATvL_MAP /end AXIS_DESCR
 /begin AXIS_DESCR COM_AXIS NO_INPUT_QUANTITY Compu_Tspko_MATvL_MAT 16 -1484 563.96875 AXIS_PTS_REF Tspko_MATvL_MAT /end AXIS_DESCR
/end CHARACTERISTIC
/begin AXIS_PTS Tspko_MATvL_MAP " " 0x0014334C /* @ECU_Address@Tspko_MATvL_MAP@0x02034000@ */ NO_INPUT_QUANTITY ECIPP_Lookup_SWORD 0 Compu_Tspko_MATvL_MAP 8 -128 127.99609375 /end AXIS_PTS
/begin AXIS_PTS Tspko_MATvL_MAT " " 0x0014335C /* @ECU_Address@Tspko_MATvL_MAT@0x02033000@ */ NO_INPUT_QUANTITY ECIPP_Lookup_SWORD 0 Compu_Tspko_MATvL_MAT 16 -1484 563.96875 /end AXIS_PTS
/begin COMPU_METHOD Compu_Tspko_MATvL_CAD "" RAT_FUNC "%.1" "CAD" COEFFS 0 16 0 0 0 1 /end COMPU_METHOD
/begin COMPU_METHOD Compu_Tmod_ECT_ECT " " RAT_FUNC "%.0" "CHT (deg F)" COEFFS 0 32 14720 0 0 1 /end COMPU_METHOD
/begin CHARACTERISTIC Tspko_ECT_CAD "Spark CHT Offset" CURVE 0x0014633A /* @ECU_Address@Tspko_ECT_CAD@0x02037000@ */ ECIPP_ALIGNMENT_SWORD 2048 Compu_Tspko_ECT_CAD -2048 2047.9375
 /begin AXIS_DESCR COM_AXIS NO_INPUT_QUANTITY Compu_Tmod_ECT_ECT 16 -1484 563.96875 AXIS_PTS_REF Tmod_ECT_ECT /end AXIS_DESCR
/end CHARACTERISTIC
/begin AXIS_PTS Tmod_ECT_ECT " " 0x00145F96 /* @ECU_Address@Tmod_ECT_ECT@0x02036000@ */ NO_INPUT_QUANTITY ECIPP_Lookup_SWORD 0 Compu_Tmod_ECT_ECT 16 -1484 563.96875 /end AXIS_PTS
/begin COMPU_METHOD Compu_Tspko_ECT_CAD " " RAT_FUNC "%.1" "CAD" COEFFS 0 16 0 0 0 1 /end COMPU_METHOD
/begin COMPU_METHOD Compu_Tchk_ECT_ECT " " RAT_FUNC "%.0" "CHT (deg F)" COEFFS 0 32 14720 0 0 1 /end COMPU_METHOD
/begin CHARACTERISTIC Tchk_ECT_add "Primary Choked Fuel Adder" CURVE 0x00145C3A /* @ECU_Address@Tchk_ECT_add@0x0203E000@ */ ECIPP_ALIGNMENT_SWORD 3200 Compu_Tchk_ECT_add -3200 3199.90234375
 /begin AXIS_DESCR COM_AXIS NO_INPUT_QUANTITY Compu_Tchk_ECT_ECT 16 -1484 563.96875 AXIS_PTS_REF Tchk_ECT_ECT /end AXIS_DESCR
/end CHARACTERISTIC
/begin AXIS_PTS Tchk_ECT_ECT " " 0x00145C1A /* @ECU_Address@Tchk_ECT_ECT@0x0203D000@ */ NO_INPUT_QUANTITY ECIPP_Lookup_SWORD 0 Compu_Tchk_ECT_ECT 16 -1484 563.96875 /end AXIS_PTS
/begin COMPU_METHOD Compu_Tchk_ECT_add " " RAT_FUNC "%.1" "Primary Choke Fuel Adder (%)" COEFFS 0 10.24 0 0 0 1 /end COMPU_METHOD
/begin CHARACTERISTIC Tchk_ECT_hold "Choked Fuel Hold" CURVE 0x00145C7A /* @ECU_Address@Tchk_ECT_hold@0x0203F000@ */ ECIPP_ALIGNMENT_SWORD 524 Compu_Tchk_ECT_hold -524.288 524.272
 /begin AXIS_DESCR COM_AXIS NO_INPUT_QUANTITY Compu_Tchk_ECT_ECT 16 -1484 563.96875 AXIS_PTS_REF Tchk_ECT_ECT /end AXIS_DESCR
/end CHARACTERISTIC
/begin COMPU_METHOD Compu_Tchk_ECT_hold " " RAT_FUNC "%.1" "Hold Time (sec)" COEFFS 0 62.5 0 0 0 1 /end COMPU_METHOD
/begin CHARACTERISTIC Tchk_ECT_decay "Choked Fuel Decay" CURVE 0x00145C5A /* @ECU_Address@Tchk_ECT_decay@0x02040000@ */ ECIPP_ALIGNMENT_SWORD 524 Compu_Tchk_ECT_decay -524.288 524.272
 /begin AXIS_DESCR COM_AXIS NO_INPUT_QUANTITY Compu_Tchk_ECT_ECT 16 -1484 563.96875 AXIS_PTS_REF Tchk_ECT_ECT /end AXIS_DESCR
/end CHARACTERISTIC
/begin COMPU_METHOD Compu_Tchk_ECT_decay " " RAT_FUNC "%.1" "Decay Time (sec)" COEFFS 0 62.5 0 0 0 1 /end COMPU_METHOD
/begin CHARACTERISTIC Tspka_baseNG_CAD "NG Base Spark Advance" MAP 0x00142352 /* @ECU_Address@Tspka_baseNG_CAD@0x02049000@ */ ECIPP_ALIGNMENT_SWORD 2048 Compu_Tspka_baseNG_CAD -2048 2047.9375
 /begin AXIS_DESCR COM_AXIS NO_INPUT_QUANTITY Compu_Tspka_baseNG_MAP 16 -128 127.99609375 AXIS_PTS_REF Tspka_baseNG_MAP /end AXIS_DESCR
 /begin AXIS_DESCR COM_AXIS NO_INPUT_QUANTITY Compu_Tspka_baseNG_rpm 16 -32768 32767 AXIS_PTS_REF Tspka_baseNG_rpm /end AXIS_DESCR
/end CHARACTERISTIC
/begin AXIS_PTS Tspka_baseNG_MAP " " 0x00142552 /* @ECU_Address@Tspka_baseNG_MAP@0x0204A000@ */ NO_INPUT_QUANTITY ECIPP_Lookup_SWORD 0 Compu_Tspka_baseNG_MAP 16 -128 127.99609375 /end AXIS_PTS
/begin AXIS_PTS Tspka_baseNG_rpm " " 0x00142572 /* @ECU_Address@Tspka_baseNG_rpm@0x0204B000@ */ NO_INPUT_QUANTITY ECIPP_Lookup_SWORD 0 Compu_Tspka_baseNG_rpm 16 -32768 32767 /end AXIS_PTS
/begin COMPU_METHOD Compu_Tspka_baseNG_CAD "" RAT_FUNC "%.1" "CAD BTDC" COEFFS 0 16 0 0 0 1 /end COMPU_METHOD
/begin COMPU_METHOD Compu_Tspka_baseNG_MAP " " RAT_FUNC "%.1" "MAP load (psia)" COEFFS 0 256 0 0 0 1 /end COMPU_METHOD
/begin COMPU_METHOD Compu_Tspka_baseNG_rpm " " RAT_FUNC "%.0" "Speed (rpm)" COEFFS 0 1 0 0 0 1 /end COMPU_METHOD
/begin COMPU_METHOD Compu_Tspko_ECTvLNG_ECT " " RAT_FUNC "%.0" "CHT (deg F)" COEFFS 0 32 14720 0 0 1 /end COMPU_METHOD
/begin COMPU_METHOD Compu_Tspko_ECTvLNG_MAP " " RAT_FUNC "%.1" "MAP load (psia)" COEFFS 0 256 0 0 0 1 /end COMPU_METHOD
/begin CHARACTERISTIC Tspko_ECTvLNG_CAD "NG CHT Spark Offset" MAP 0x00142592 /* @ECU_Address@Tspko_ECTvLNG_CAD@0x0204E000@ */ ECIPP_ALIGNMENT_SWORD 2048 Compu_Tspko_ECTvLNG_CAD -2048 2047.9375
 /begin AXIS_DESCR COM_AXIS NO_INPUT_QUANTITY Compu_Tspko_ECTvLNG_MAP 8 -128 127.99609375 AXIS_PTS_REF Tspko_ECTvLNG_MAP /end AXIS_DESCR
 /begin AXIS_DESCR COM_AXIS NO_INPUT_QUANTITY Compu_Tspko_ECTvLNG_ECT 16 -1484 563.96875 AXIS_PTS_REF Tspko_ECTvLNG_ECT /end AXIS_DESCR
/end CHARACTERISTIC
/begin AXIS_PTS Tspko_ECTvLNG_MAP " " 0x001426B2 /* @ECU_Address@Tspko_ECTvLNG_MAP@0x0204D000@ */ NO_INPUT_QUANTITY ECIPP_Lookup_SWORD 0 Compu_Tspko_ECTvLNG_MAP 8 -128 127.99609375 /end AXIS_PTS
/begin AXIS_PTS Tspko_ECTvLNG_ECT " " 0x00142692 /* @ECU_Address@Tspko_ECTvLNG_ECT@0x0204C000@ */ NO_INPUT_QUANTITY ECIPP_Lookup_SWORD 0 Compu_Tspko_ECTvLNG_ECT 16 -1484 563.96875 /end AXIS_PTS
/begin COMPU_METHOD Compu_Tspko_ECTvLNG_CAD "" RAT_FUNC "%.1" "CAD" COEFFS 0 16 0 0 0 1 /end COMPU_METHOD
/begin COMPU_METHOD Compu_Tspko_MATvLNG_MAT " " RAT_FUNC "%.0" "MAT (deg F)" COEFFS 0 32 14720 0 0 1 /end COMPU_METHOD
/begin COMPU_METHOD Compu_Tspko_MATvLNG_MAP " " RAT_FUNC "%.1" "MAP load (psia)" COEFFS 0 256 0 0 0 1 /end COMPU_METHOD
/begin CHARACTERISTIC Tspko_MATvLNG_CAD "NG MAT Spark Offset" MAP 0x001426C2 /* @ECU_Address@Tspko_MATvLNG_CAD@0x02051000@ */ ECIPP_ALIGNMENT_SWORD 2048 Compu_Tspko_MATvLNG_CAD -2048 2047.9375
 /begin AXIS_DESCR COM_AXIS NO_INPUT_QUANTITY Compu_Tspko_MATvLNG_MAP 8 -128 127.99609375 AXIS_PTS_REF Tspko_MATvLNG_MAP /end AXIS_DESCR
 /begin AXIS_DESCR COM_AXIS NO_INPUT_QUANTITY Compu_Tspko_MATvLNG_MAT 16 -1484 563.96875 AXIS_PTS_REF Tspko_MATvLNG_MAT /end AXIS_DESCR
/end CHARACTERISTIC
/begin AXIS_PTS Tspko_MATvLNG_MAP " " 0x001427C2 /* @ECU_Address@Tspko_MATvLNG_MAP@0x02050000@ */ NO_INPUT_QUANTITY ECIPP_Lookup_SWORD 0 Compu_Tspko_MATvLNG_MAP 8 -128 127.99609375 /end AXIS_PTS
/begin AXIS_PTS Tspko_MATvLNG_MAT " " 0x001427D2 /* @ECU_Address@Tspko_MATvLNG_MAT@0x0204F000@ */ NO_INPUT_QUANTITY ECIPP_Lookup_SWORD 0 Compu_Tspko_MATvLNG_MAT 16 -1484 563.96875 /end AXIS_PTS
/begin COMPU_METHOD Compu_Tspko_MATvLNG_CAD "" RAT_FUNC "%.1" "CAD" COEFFS 0 16 0 0 0 1 /end COMPU_METHOD
/begin COMPU_METHOD Compu_Sww_CHT " " RAT_FUNC "%.0" "CHT (deg F)" COEFFS 0 32 14720 0 0 1 /end COMPU_METHOD
/begin CHARACTERISTIC Tww_ECT_Cn "Cn Wall-Wet" CURVE 0x001464AC /* @ECU_Address@Tww_ECT_Cn@0x0209A000@ */ ECIPP_ALIGNMENT_SWORD 800 Compu_Tww_ECT_Cn -800 799.9755859375
 /begin AXIS_DESCR COM_AXIS NO_INPUT_QUANTITY Compu_Tww_ECT_ECT 16 -1484 563.96875 AXIS_PTS_REF Tww_ECT_ECT /end AXIS_DESCR
/end CHARACTERISTIC
/begin COMPU_METHOD Compu_Tww_ECT_Cn " " RAT_FUNC "%.1" "Cww (%)" COEFFS 0 40.96 0 0 0 1 /end COMPU_METHOD
/begin CHARACTERISTIC Tww_ECT_taun "Taun Wall-Wet" CURVE 0x0014650C /* @ECU_Address@Tww_ECT_taun@0x0209B000@ */ ECIPP_ALIGNMENT_SWORD 128 Compu_Tww_ECT_taun -128 127.99609375
 /begin AXIS_DESCR COM_AXIS NO_INPUT_QUANTITY Compu_Tww_ECT_ECT 16 -1484 563.96875 AXIS_PTS_REF Tww_ECT_ECT /end AXIS_DESCR
/end CHARACTERISTIC
/begin COMPU_METHOD Compu_Tww_ECT_taun " " RAT_FUNC "%.1" "Cyl Events" COEFFS 0 256 0 0 0 1 /end COMPU_METHOD
/begin CHARACTERISTIC Tspka_crk_CAD "Cranking Ignition Advance" MAP 0x001462EA /* @ECU_Address@Tspka_crk_CAD@0x0209E000@ */ ECIPP_ALIGNMENT_SWORD 2048 Compu_Tspka_crk_CAD -2048 2047.9375
 /begin AXIS_DESCR COM_AXIS NO_INPUT_QUANTITY Compu_Tspka_crk_MAP 4 -128 127.99609375 AXIS_PTS_REF Tspka_crk_MAP /end AXIS_DESCR
 /begin AXIS_DESCR COM_AXIS NO_INPUT_QUANTITY Compu_Tspka_crk_ECT 4 -1484 563.96875 AXIS_PTS_REF Tspka_crk_ECT /end AXIS_DESCR
/end CHARACTERISTIC
/begin AXIS_PTS Tspka_crk_MAP " " 0x00146312 /* @ECU_Address@Tspka_crk_MAP@0x0209F000@ */ NO_INPUT_QUANTITY ECIPP_Lookup_SWORD 0 Compu_Tspka_crk_MAP 4 -128 127.99609375 /end AXIS_PTS
/begin AXIS_PTS Tspka_crk_ECT " " 0x0014630A /* @ECU_Address@Tspka_crk_ECT@0x020A0000@ */ NO_INPUT_QUANTITY ECIPP_Lookup_SWORD 0 Compu_Tspka_crk_ECT 4 -1484 563.96875 /end AXIS_PTS
/begin COMPU_METHOD Compu_Tspka_crk_CAD "" RAT_FUNC "%.1" "CAD BTDC" COEFFS 0 16 0 0 0 1 /end COMPU_METHOD
/begin COMPU_METHOD Compu_Tspka_crk_MAP " " RAT_FUNC "%.1" "MAP (psia)" COEFFS 0 256 0 0 0 1 /end COMPU_METHOD
/begin COMPU_METHOD Compu_Tspka_crk_ECT " " RAT_FUNC "%.0" "ECT (deg F)" COEFFS 0 32 14720 0 0 1 /end COMPU_METHOD
/begin CHARACTERISTIC TCrkTT_ECT_decay "Spark Transition Decay" CURVE 0x00144716 /* @ECU_Address@TCrkTT_ECT_decay@0x02139000@ */ ECIPP_ALIGNMENT_SWORD 524 Compu_TCrkTT_ECT_decay -524.288 524.272
 /begin AXIS_DESCR COM_AXIS NO_INPUT_QUANTITY Compu_Tchk_ECT_ECT 16 -1484 563.96875 AXIS_PTS_REF Tchk_ECT_ECT /end AXIS_DESCR
/end CHARACTERISTIC
/begin COMPU_METHOD Compu_TCrkTT_ECT_decay " " RAT_FUNC "%.1" "Decay Time (sec)" COEFFS 0 62.5 0 0 0 1 /end COMPU_METHOD
/begin COMPU_METHOD Compu_Tspko_cyl_rpm " " RAT_FUNC "%.0" "Speed (rpm)" COEFFS 0 1 0 0 0 1 /end COMPU_METHOD
/begin COMPU_METHOD Compu_Tspko_cyl_MAP " " RAT_FUNC "%.1" "MAP (psia)" COEFFS 0 256 0 0 0 1 /end COMPU_METHOD
/begin CHARACTERISTIC Tspko_cyl_CAD "Cylinder Base Spark Advance Offset" MAP 0x0014635A /* @ECU_Address@Tspko_cyl_CAD@0x02189000@ */ ECIPP_ALIGNMENT_SWORD 2048 Compu_Tspko_cyl_CAD -2048 2047.9375
 /begin AXIS_DESCR COM_AXIS NO_INPUT_QUANTITY Compu_Tspko_cyl_MAP 8 -128 127.99609375 AXIS_PTS_REF Tspko_cyl_MAP /end AXIS_DESCR
 /begin AXIS_DESCR COM_AXIS NO_INPUT_QUANTITY Compu_Tspko_cyl_rpm 8 -32768 32767 AXIS_PTS_REF Tspko_cyl_rpm /end AXIS_DESCR
/end CHARACTERISTIC
/begin AXIS_PTS Tspko_cyl_MAP " " 0x001463DA /* @ECU_Address@Tspko_cyl_MAP@0x02188000@ */ NO_INPUT_QUANTITY ECIPP_Lookup_SWORD 0 Compu_Tspko_cyl_MAP 8 -128 127.99609375 /end AXIS_PTS
/begin AXIS_PTS Tspko_cyl_rpm " " 0x001463EA /* @ECU_Address@Tspko_cyl_rpm@0x02187000@ */ NO_INPUT_QUANTITY ECIPP_Lookup_SWORD 0 Compu_Tspko_cyl_rpm 8 -32768 32767 /end AXIS_PTS
/begin COMPU_METHOD Compu_Tspko_cyl_CAD "" RAT_FUNC "%.1" "CAD advance" COEFFS 0 16 0 0 0 1 /end COMPU_METHOD
/begin CHARACTERISTIC TOILT_ss "Steady-state Oil Temperature" MAP 0x00145304 /* @ECU_Address@TOILT_ss@0x02194000@ */ ECIPP_ALIGNMENT_SWORD 3636 Compu_TOILT_ss -4556 3635.875
 /begin AXIS_DESCR COM_AXIS NO_INPUT_QUANTITY Compu_TOILT_MAP 4 -128 127.99609375 AXIS_PTS_REF TOILT_MAP /end AXIS_DESCR
 /begin AXIS_DESCR COM_AXIS NO_INPUT_QUANTITY Compu_TOILT_rpm 4 -32768 32767 AXIS_PTS_REF TOILT_rpm /end AXIS_DESCR
/end CHARACTERISTIC
/begin AXIS_PTS TOILT_MAP " " 0x001452B4 /* @ECU_Address@TOILT_MAP@0x0219A000@ */ NO_INPUT_QUANTITY ECIPP_Lookup_SWORD 0 Compu_TOILT_MAP 4 -128 127.99609375 /end AXIS_PTS
/begin AXIS_PTS TOILT_rpm " " 0x001452FC /* @ECU_Address@TOILT_rpm@0x02199000@ */ NO_INPUT_QUANTITY ECIPP_Lookup_SWORD 0 Compu_TOILT_rpm 4 -32768 32767 /end AXIS_PTS
/begin COMPU_METHOD Compu_TOILT_ss "" RAT_FUNC "%.0" "deg F" COEFFS 0 8 3680 0 0 1 /end COMPU_METHOD
/begin CHARACTERISTIC TOILT_inctau "Increasing Temperature Tau" MAP 0x001452DC /* @ECU_Address@TOILT_inctau@0x02195000@ */ ECIPP_ALIGNMENT_SWORD 32767 Compu_TOILT_inctau -32768 32767
 /begin AXIS_DESCR COM_AXIS NO_INPUT_QUANTITY Compu_TOILT_MAP 4 -128 127.99609375 AXIS_PTS_REF TOILT_MAP /end AXIS_DESCR
 /begin AXIS_DESCR COM_AXIS NO_INPUT_QUANTITY Compu_TOILT_rpm 4 -32768 32767 AXIS_PTS_REF TOILT_rpm /end AXIS_DESCR
/end CHARACTERISTIC
/begin COMPU_METHOD Compu_TOILT_inctau "" RAT_FUNC "%.0" "sec" COEFFS 0 1 0 0 0 1 /end COMPU_METHOD
/begin CHARACTERISTIC TOILT_dectau "Decreasing Temperature Tau" MAP 0x001452BC /* @ECU_Address@TOILT_dectau@0x02196000@ */ ECIPP_ALIGNMENT_SWORD 32767 Compu_TOILT_dectau -32768 32767
 /begin AXIS_DESCR COM_AXIS NO_INPUT_QUANTITY Compu_TOILT_MAP 4 -128 127.99609375 AXIS_PTS_REF TOILT_MAP /end AXIS_DESCR
 /begin AXIS_DESCR COM_AXIS NO_INPUT_QUANTITY Compu_TOILT_rpm 4 -32768 32767 AXIS_PTS_REF TOILT_rpm /end AXIS_DESCR
/end CHARACTERISTIC
/begin COMPU_METHOD Compu_TOILT_dectau "" RAT_FUNC "%.0" "sec" COEFFS 0 1 0 0 0 1 /end COMPU_METHOD
/begin COMPU_METHOD Compu_TOILT_rpm " " RAT_FUNC "%.0" "Speed (rpm)" COEFFS 0 1 0 0 0 1 /end COMPU_METHOD
/begin COMPU_METHOD Compu_TOILT_MAP " " RAT_FUNC "%.1" "MAP load (psia)" COEFFS 0 256 0 0 0 1 /end COMPU_METHOD
/begin MEASUREMENT ICAV_miscyl_tmr "Misfire active - 1" UBYTE Compu_ICAV_miscyl_tmr 0 0 0 255 ECU_ADDRESS 0x021A8000 MATRIX_DIM 10 1 1 /end MEASUREMENT
/begin COMPU_METHOD Compu_ICAV_miscyl_tmr " " RAT_FUNC "%.0" "-" COEFFS 0 1 0 0 0 1 /end COMPU_METHOD
/begin CHARACTERISTIC TTD_preTPS_V "TD pre-throttle delay" VAL_BLK 0x00147926 /* @ECU_Address@TTD_preTPS_V@0x0220C000@ */ ECIPP_ALIGNMENT_UWORD 32 Compu_TTD_preTPS_V 0 31.99951171875 MATRIX_DIM 3 1 1 /end CHARACTERISTIC
/begin COMPU_METHOD Compu_TTD_preTPS_V " " RAT_FUNC "%.2" "L" COEFFS 0 2048 0 0 0 1 /end COMPU_METHOD
/begin CHARACTERISTIC TTD_pstTPS_V "TD post-throttle delay" VAL_BLK 0x0014792C /* @ECU_Address@TTD_pstTPS_V@0x0220D000@ */ ECIPP_ALIGNMENT_UWORD 32 Compu_TTD_pstTPS_V 0 31.99951171875 MATRIX_DIM 3 1 1 /end CHARACTERISTIC
/begin COMPU_METHOD Compu_TTD_pstTPS_V " " RAT_FUNC "%.2" "L" COEFFS 0 2048 0 0 0 1 /end COMPU_METHOD
/begin CHARACTERISTIC TTD_rotate_CAD "TD rotational delay" VAL_BLK 0x00147938 /* @ECU_Address@TTD_rotate_CAD@0x0220E000@ */ ECIPP_ALIGNMENT_UWORD 2048 Compu_TTD_rotate_CAD 0 2047.96875 MATRIX_DIM 3 1 1 /end CHARACTERISTIC
/begin COMPU_METHOD Compu_TTD_rotate_CAD " " RAT_FUNC "%.0" "CAD" COEFFS 0 32 0 0 0 1 /end COMPU_METHOD
/begin CHARACTERISTIC TTD_pstcyl_V "TD post-rotation delay" VAL_BLK 0x00147932 /* @ECU_Address@TTD_pstcyl_V@0x0220F000@ */ ECIPP_ALIGNMENT_UWORD 32 Compu_TTD_pstcyl_V 0 31.99951171875 MATRIX_DIM 3 1 1 /end CHARACTERISTIC
/begin COMPU_METHOD Compu_TTD_pstcyl_V " " RAT_FUNC "%.2" "L" COEFFS 0 2048 0 0 0 1 /end COMPU_METHOD
/begin CHARACTERISTIC TTD_sens_delay "TD pure signal delay" VAL_BLK 0x0014793E /* @ECU_Address@TTD_sens_delay@0x02210000@ */ ECIPP_ALIGNMENT_UWORD 65535 Compu_TTD_sens_delay 0 65535 MATRIX_DIM 3 1 1 /end CHARACTERISTIC
/begin COMPU_METHOD Compu_TTD_sens_delay " " RAT_FUNC "%.0" "ms" COEFFS 0 1 0 0 0 1 /end COMPU_METHOD
/begin CHARACTERISTIC TTD_exhpreEGR_V "Transport exhaust pre-EGR tap" VAL_BLK 0x00140950 /* @ECU_Address@TTD_exhpreEGR_V@0x022B4000@ */ ECIPP_ALIGNMENT_UWORD 32 Compu_TTD_exhpreEGR_V 0 31.99951171875 MATRIX_DIM 3 1 1 /end CHARACTERISTIC
/begin COMPU_METHOD Compu_TTD_exhpreEGR_V " " RAT_FUNC "%.2" "L" COEFFS 0 2048 0 0 0 1 /end COMPU_METHOD
/begin CHARACTERISTIC TTD_exhpstEGR_V "Transport exhaust post-EGR tap" VAL_BLK 0x00140956 /* @ECU_Address@TTD_exhpstEGR_V@0x022B5000@ */ ECIPP_ALIGNMENT_UWORD 32 Compu_TTD_exhpstEGR_V 0 31.99951171875 MATRIX_DIM 3 1 1 /end CHARACTERISTIC
/begin COMPU_METHOD Compu_TTD_exhpstEGR_V " " RAT_FUNC "%.2" "L" COEFFS 0 2048 0 0 0 1 /end COMPU_METHOD
/begin CHARACTERISTIC TTD_egrhot_V "Transport EGR hot" VAL_BLK 0x0014094A /* @ECU_Address@TTD_egrhot_V@0x022B6000@ */ ECIPP_ALIGNMENT_UWORD 32 Compu_TTD_egrhot_V 0 31.99951171875 MATRIX_DIM 3 1 1 /end CHARACTERISTIC
/begin COMPU_METHOD Compu_TTD_egrhot_V " " RAT_FUNC "%.2" "L" COEFFS 0 2048 0 0 0 1 /end COMPU_METHOD
/begin CHARACTERISTIC TTD_egrcool_V "Transport EGR cool" VAL_BLK 0x00140944 /* @ECU_Address@TTD_egrcool_V@0x022B7000@ */ ECIPP_ALIGNMENT_UWORD 32 Compu_TTD_egrcool_V 0 31.99951171875 MATRIX_DIM 3 1 1 /end CHARACTERISTIC
/begin COMPU_METHOD Compu_TTD_egrcool_V " " RAT_FUNC "%.2" "L" COEFFS 0 2048 0 0 0 1 /end COMPU_METHOD
/begin CHARACTERISTIC TTD_exhpstturb_V "Transport exhaust post-turbine" VAL_BLK 0x0014095C /* @ECU_Address@TTD_exhpstturb_V@0x022D3000@ */ ECIPP_ALIGNMENT_UWORD 32 Compu_TTD_exhpstturb_V 0 31.99951171875 MATRIX_DIM 3 1 1 /end CHARACTERISTIC
/begin COMPU_METHOD Compu_TTD_exhpstturb_V " " RAT_FUNC "%.2" "L" COEFFS 0 2048 0 0 0 1 /end COMPU_METHOD
/begin CHARACTERISTIC TTD_intpstUEGO_V "Intake pre-fuel volume" VAL_BLK 0x00140962 /* @ECU_Address@TTD_intpstUEGO_V@0x023C5000@ */ ECIPP_ALIGNMENT_UWORD 32 Compu_TTD_intpstUEGO_V 0 31.99951171875 MATRIX_DIM 3 1 1 /end CHARACTERISTIC
/begin COMPU_METHOD Compu_TTD_intpstUEGO_V " " RAT_FUNC "%.2" "L" COEFFS 0 2048 0 0 0 1 /end COMPU_METHOD
/begin CHARACTERISTIC TTD_preTDC_CAD "Transport pre-TDC rotation" VAL_BLK 0x0014096E /* @ECU_Address@TTD_preTDC_CAD@0x023D1000@ */ ECIPP_ALIGNMENT_UWORD 2048 Compu_TTD_preTDC_CAD 0 2047.96875 MATRIX_DIM 3 1 1 /end CHARACTERISTIC
/begin COMPU_METHOD Compu_TTD_preTDC_CAD " " RAT_FUNC "%.0" "CAD" COEFFS 0 32 0 0 0 1 /end COMPU_METHOD
/begin CHARACTERISTIC TTD_pstTDC_CAD "Transport post-TDC rotation" VAL_BLK 0x00140974 /* @ECU_Address@TTD_pstTDC_CAD@0x023D2000@ */ ECIPP_ALIGNMENT_UWORD 2048 Compu_TTD_pstTDC_CAD 0 2047.96875 MATRIX_DIM 3 1 1 /end CHARACTERISTIC
/begin COMPU_METHOD Compu_TTD_pstTDC_CAD " " RAT_FUNC "%.0" "CAD" COEFFS 0 32 0 0 0 1 /end COMPU_METHOD
/begin CHARACTERISTIC TTD_intpstfuel_V "Intake post-fuel volume" VAL_BLK 0x00140968 /* @ECU_Address@TTD_intpstfuel_V@0x023D6000@ */ ECIPP_ALIGNMENT_UWORD 32 Compu_TTD_intpstfuel_V 0 31.99951171875 MATRIX_DIM 3 1 1 /end CHARACTERISTIC
/begin COMPU_METHOD Compu_TTD_intpstfuel_V " " RAT_FUNC "%.2" "L" COEFFS 0 2048 0 0 0 1 /end COMPU_METHOD
/begin CHARACTERISTIC TInjTT_ECT_CAD "Crank/After-Start Injection Timing" CURVE 0x00144F92 /* @ECU_Address@TInjTT_ECT_CAD@0x023D9000@ */ ECIPP_ALIGNMENT_SWORD 2048 Compu_TInjTT_ECT_CAD -2048 2047.9375
 /begin AXIS_DESCR COM_AXIS NO_INPUT_QUANTITY Compu_Tchk_ECT_ECT 16 -1484 563.96875 AXIS_PTS_REF Tchk_ECT_ECT /end AXIS_DESCR
/end CHARACTERISTIC
/begin COMPU_METHOD Compu_TInjTT_ECT_CAD " " RAT_FUNC "%.0" "Injection Timing (CAD BBDCI)" COEFFS 0 16 0 0 0 1 /end COMPU_METHOD
/begin CHARACTERISTIC TInjTT_ECT_decay "Injection Timing Transition Decay" CURVE 0x00144FB2 /* @ECU_Address@TInjTT_ECT_decay@0x023DA000@ */ ECIPP_ALIGNMENT_SWORD 524 Compu_TInjTT_ECT_decay -524.288 524.272
 /begin AXIS_DESCR COM_AXIS NO_INPUT_QUANTITY Compu_Tchk_ECT_ECT 16 -1484 563.96875 AXIS_PTS_REF Tchk_ECT_ECT /end AXIS_DESCR
/end CHARACTERISTIC
/begin COMPU_METHOD Compu_TInjTT_ECT_decay " " RAT_FUNC "%.1" "Decay Time (sec)" COEFFS 0 62.5 0 0 0 1 /end COMPU_METHOD
/begin COMPU_METHOD Compu_TOILTL_temp " " RAT_FUNC "%.0" "Temp (deg F)" COEFFS 0 8 3680 0 0 1 /end COMPU_METHOD
/begin CHARACTERISTIC TOILTL_temp_mult "Oil T/L level correction" CURVE 0x001452A0 /* @ECU_Address@TOILTL_temp_mult@0x025CC000@ */ ECIPP_ALIGNMENT_SWORD 32 Compu_TOILTL_temp_mult -32 31.9990234375
 /begin AXIS_DESCR COM_AXIS NO_INPUT_QUANTITY Compu_TOILTL_temp 10 -4556 3635.875 AXIS_PTS_REF TOILTL_temp /end AXIS_DESCR
/end CHARACTERISTIC
/begin AXIS_PTS TOILTL_temp " " 0x0014528C /* @ECU_Address@TOILTL_temp@0x025CB000@ */ NO_INPUT_QUANTITY ECIPP_Lookup_SWORD 0 Compu_TOILTL_temp 10 -4556 3635.875 /end AXIS_PTS
/begin COMPU_METHOD Compu_TOILTL_temp_mult " " RAT_FUNC "%.3" "Multiplier" COEFFS 0 1024 0 0 0 1 /end COMPU_METHOD
/begin COMPU_METHOD Compu_TOILTL_rpm " " RAT_FUNC "%.0" "Speed (rpm)" COEFFS 0 1 0 0 0 1 /end COMPU_METHOD
/begin CHARACTERISTIC TOILTL_rpm_mult "Oil T/L level correction" CURVE 0x0014526E /* @ECU_Address@TOILTL_rpm_mult@0x025CE000@ */ ECIPP_ALIGNMENT_SWORD 32 Compu_TOILTL_rpm_mult -32 31.9990234375
 /begin AXIS_DESCR COM_AXIS NO_INPUT_QUANTITY Compu_TOILTL_rpm 10 -32768 32767 AXIS_PTS_REF TOILTL_rpm /end AXIS_DESCR
/end CHARACTERISTIC
/begin AXIS_PTS TOILTL_rpm " " 0x0014525A /* @ECU_Address@TOILTL_rpm@0x025CD000@ */ NO_INPUT_QUANTITY ECIPP_Lookup_SWORD 0 Compu_TOILTL_rpm 10 -32768 32767 /end AXIS_PTS
/begin COMPU_METHOD Compu_TOILTL_rpm_mult " " RAT_FUNC "%.3" "Multiplier" COEFFS 0 1024 0 0 0 1 /end COMPU_METHOD
/begin COMPU_METHOD Compu_TOILTL_mm " " RAT_FUNC "%.2" "Level (mm)" COEFFS 0 128 0 0 0 1 /end COMPU_METHOD
/begin CHARACTERISTIC TOILTL_pct "Oil T/L level conversion" CURVE 0x00145246 /* @ECU_Address@TOILTL_pct@0x025D0000@ */ ECIPP_ALIGNMENT_SWORD 125 Compu_TOILTL_pct -125 124.996185302734
 /begin AXIS_DESCR COM_AXIS NO_INPUT_QUANTITY Compu_TOILTL_mm 10 -256 255.9921875 AXIS_PTS_REF TOILTL_mm /end AXIS_DESCR
/end CHARACTERISTIC
/begin AXIS_PTS TOILTL_mm " " 0x00145232 /* @ECU_Address@TOILTL_mm@0x025CF000@ */ NO_INPUT_QUANTITY ECIPP_Lookup_SWORD 0 Compu_TOILTL_mm 10 -256 255.9921875 /end AXIS_PTS
/begin COMPU_METHOD Compu_TOILTL_pct " " RAT_FUNC "%.2" "Level (%)" COEFFS 0 262.144 0 0 0 1 /end COMPU_METHOD
/begin CHARACTERISTIC TOILTL_stage "Oil T/L stage conversion" CURVE 0x0014809F /* @ECU_Address@TOILTL_stage@0x025D2000@ */ ECIPP_ALIGNMENT_UBYTE 100 Compu_TOILTL_stage 0 99.609375
 /begin AXIS_DESCR COM_AXIS NO_INPUT_QUANTITY Compu_TOILTL_stage_lvl 5 -125 124.996185302734 AXIS_PTS_REF TOILTL_stage_lvl /end AXIS_DESCR
/end CHARACTERISTIC
/begin AXIS_PTS TOILTL_stage_lvl " " 0x00145282 /* @ECU_Address@TOILTL_stage_lvl@0x025E2000@ */ NO_INPUT_QUANTITY ECIPP_Lookup_SWORD 0 Compu_TOILTL_stage_lvl 5 -125 124.996185302734 /end AXIS_PTS
/begin COMPU_METHOD Compu_TOILTL_stage " " RAT_FUNC "%.0" "Stage (%)" COEFFS 0 2.56 0 0 0 1 /end COMPU_METHOD
/begin COMPU_METHOD Compu_Tspkret_FSOt_FSOt " " RAT_FUNC "%.1" "FSO Time (sec)" COEFFS 0 1000 0 0 0 1 /end COMPU_METHOD
/begin CHARACTERISTIC Tspkret_FSOt_hold "FSO Spark Retard Hold" CURVE 0x00143C20 /* @ECU_Address@Tspkret_FSOt_hold@0x025DA000@ */ ECIPP_ALIGNMENT_FLOAT32_IEEE 10000000000 Compu_Tspkret_FSOt_hold -10000000000 10000000000
 /begin AXIS_DESCR COM_AXIS NO_INPUT_QUANTITY Compu_Tspkret_FSOt_FSOt 4 -10000000000 10000000000 AXIS_PTS_REF Tspkret_FSOt_FSOt /end AXIS_DESCR
/end CHARACTERISTIC
/begin AXIS_PTS Tspkret_FSOt_FSOt " " 0x00143C10 /* @ECU_Address@Tspkret_FSOt_FSOt@0x025D9000@ */ NO_INPUT_QUANTITY ECIPP_Lookup_FLOAT32_IEEE 0 Compu_Tspkret_FSOt_FSOt 4 -10000000000 10000000000 /end AXIS_PTS
/begin COMPU_METHOD Compu_Tspkret_FSOt_hold " " RAT_FUNC "%.1" "Hold Time (sec)" COEFFS 0 1000 0 0 0 1 /end COMPU_METHOD
/begin COMPU_METHOD Compu_Tspkret_ECT_ECT " " RAT_FUNC "%.1" "ECT (deg F)" COEFFS 0 1 460 0 0 1 /end COMPU_METHOD
/begin CHARACTERISTIC Tspkret_ECT_hold "Engine Start Spark Retard Hold" CURVE 0x00143C00 /* @ECU_Address@Tspkret_ECT_hold@0x025DC000@ */ ECIPP_ALIGNMENT_FLOAT32_IEEE 10000000000 Compu_Tspkret_ECT_hold -10000000000 10000000000
 /begin AXIS_DESCR COM_AXIS NO_INPUT_QUANTITY Compu_Tspkret_ECT_ECT 4 -10000000000 10000000000 AXIS_PTS_REF Tspkret_ECT_ECT /end AXIS_DESCR
/end CHARACTERISTIC
/begin AXIS_PTS Tspkret_ECT_ECT " " 0x00143BF0 /* @ECU_Address@Tspkret_ECT_ECT@0x025DB000@ */ NO_INPUT_QUANTITY ECIPP_Lookup_FLOAT32_IEEE 0 Compu_Tspkret_ECT_ECT 4 -10000000000 10000000000 /end AXIS_PTS
/begin COMPU_METHOD Compu_Tspkret_ECT_hold " " RAT_FUNC "%.1" "Hold Time (sec)" COEFFS 0 1000 0 0 0 1 /end COMPU_METHOD
/begin COMPU_METHOD Compu_Tspkret_MAP_MAP " " RAT_FUNC "%.2" "MAP load (psia)" COEFFS 0 256 0 0 0 1 /end COMPU_METHOD
/begin CHARACTERISTIC Tspkret_MAP_retard "MAP-based Spark Retard" CURVE 0x001463FE /* @ECU_Address@Tspkret_MAP_retard@0x025DE000@ */ ECIPP_ALIGNMENT_SWORD 2048 Compu_Tspkret_MAP_retard -2048 2047.9375
 /begin AXIS_DESCR COM_AXIS NO_INPUT_QUANTITY Compu_Tspkret_MAP_MAP 2 -128 127.99609375 AXIS_PTS_REF Tspkret_MAP_MAP /end AXIS_DESCR
/end CHARACTERISTIC
/begin AXIS_PTS Tspkret_MAP_MAP " " 0x001463FA /* @ECU_Address@Tspkret_MAP_MAP@0x025DD000@ */ NO_INPUT_QUANTITY ECIPP_Lookup_SWORD 0 Compu_Tspkret_MAP_MAP 2 -128 127.99609375 /end AXIS_PTS
/begin COMPU_METHOD Compu_Tspkret_MAP_retard " " RAT_FUNC "%.1" "Spark Retard (CAD)" COEFFS 0 16 0 0 0 1 /end COMPU_METHOD
/begin COMPU_METHOD Compu_TOILTL_stage_lvl " " RAT_FUNC "%.2" "Level (%)" COEFFS 0 262.144 0 0 0 1 /end COMPU_METHOD
/begin MEASUREMENT inj_sweep_results "Injector status - 1" UBYTE Compu_inj_sweep_results 0 0 0 255 ECU_ADDRESS 0x0260B000 MATRIX_DIM 10 1 1 /end MEASUREMENT
/begin COMPU_METHOD Compu_inj_sweep_results " " RAT_FUNC "%.0" "-" COEFFS 0 1 0 0 0 1 /end COMPU_METHOD
/begin COMPU_METHOD Compu_Tfuelclr_ECT " " RAT_FUNC "%.0" "ECT (deg F)" COEFFS 0 32 14720 0 0 1 /end COMPU_METHOD
/begin CHARACTERISTIC Tfuelclr_crank_tm "Automatic Fuel Clear" CURVE 0x00147968 /* @ECU_Address@Tfuelclr_crank_tm@0x02660000@ */ ECIPP_ALIGNMENT_UWORD 66 Compu_Tfuelclr_crank_tm 0 65.535
 /begin AXIS_DESCR COM_AXIS NO_INPUT_QUANTITY Compu_Tfuelclr_ECT 6 -1484 563.96875 AXIS_PTS_REF Tfuelclr_ECT /end AXIS_DESCR
/end CHARACTERISTIC
/begin AXIS_PTS Tfuelclr_ECT " " 0x00145DFA /* @ECU_Address@Tfuelclr_ECT@0x0265F000@ */ NO_INPUT_QUANTITY ECIPP_Lookup_SWORD 0 Compu_Tfuelclr_ECT 6 -1484 563.96875 /end AXIS_PTS
/begin COMPU_METHOD Compu_Tfuelclr_crank_tm " " RAT_FUNC "%.1" "Fuel On Time (sec)" COEFFS 0 1000 0 0 0 1 /end COMPU_METHOD
/begin CHARACTERISTIC Tfuelclr_tm "Automatic Fuel Clear" CURVE 0x00147974 /* @ECU_Address@Tfuelclr_tm@0x02661000@ */ ECIPP_ALIGNMENT_UWORD 66 Compu_Tfuelclr_tm 0 65.535
 /begin AXIS_DESCR COM_AXIS NO_INPUT_QUANTITY Compu_Tfuelclr_ECT 6 -1484 563.96875 AXIS_PTS_REF Tfuelclr_ECT /end AXIS_DESCR
/end CHARACTERISTIC
/begin COMPU_METHOD Compu_Tfuelclr_tm " " RAT_FUNC "%.1" "Fuel Clear Time (sec)" COEFFS 0 1000 0 0 0 1 /end COMPU_METHOD
/begin COMPU_METHOD Compu_TspkMATMAPrmultrpm " " RAT_FUNC "%.0" "Speed (rpm)" COEFFS 0 1 0 0 0 1 /end COMPU_METHOD
/begin CHARACTERISTIC TspkMATMAPrmult "MAT Spark Retard Attenuation" CURVE 0x00147992 /* @ECU_Address@TspkMATMAPrmult@0x0266C000@ */ ECIPP_ALIGNMENT_UWORD 100 Compu_TspkMATMAPrmult 0 99.9984741210938
 /begin AXIS_DESCR COM_AXIS NO_INPUT_QUANTITY Compu_TspkMATMAPrmultrpm 6 -32768 32767 AXIS_PTS_REF TspkMATMAPrmultrpm /end AXIS_DESCR
/end CHARACTERISTIC
/begin AXIS_PTS TspkMATMAPrmultrpm " " 0x001462DE /* @ECU_Address@TspkMATMAPrmultrpm@0x0266B000@ */ NO_INPUT_QUANTITY ECIPP_Lookup_SWORD 0 Compu_TspkMATMAPrmultrpm 6 -32768 32767 /end AXIS_PTS
/begin COMPU_METHOD Compu_TspkMATMAPrmult " " RAT_FUNC "%.1" "% CAD" COEFFS 0 655.36 0 0 0 1 /end COMPU_METHOD
/begin COMPU_METHOD Compu_TspkMATMAPrmultNGrpm " " RAT_FUNC "%.0" "Speed (rpm)" COEFFS 0 1 0 0 0 1 /end COMPU_METHOD
/begin CHARACTERISTIC TspkMATMAPrmultNG "NG MAT Spark Retard Attenuation" CURVE 0x001479AA /* @ECU_Address@TspkMATMAPrmultNG@0x02670000@ */ ECIPP_ALIGNMENT_UWORD 100 Compu_TspkMATMAPrmultNG 0 99.9984741210938
 /begin AXIS_DESCR COM_AXIS NO_INPUT_QUANTITY Compu_TspkMATMAPrmultNGrpm 6 -32768 32767 AXIS_PTS_REF TspkMATMAPrmultNGrpm /end AXIS_DESCR
/end CHARACTERISTIC
/begin AXIS_PTS TspkMATMAPrmultNGrpm " " 0x001462D2 /* @ECU_Address@TspkMATMAPrmultNGrpm@0x0266F000@ */ NO_INPUT_QUANTITY ECIPP_Lookup_SWORD 0 Compu_TspkMATMAPrmultNGrpm 6 -32768 32767 /end AXIS_PTS
/begin COMPU_METHOD Compu_TspkMATMAPrmultNG " " RAT_FUNC "%.1" "% CAD" COEFFS 0 655.36 0 0 0 1 /end COMPU_METHOD
/begin CHARACTERISTIC Tchk2_ECT_add "Secondary Choked Fuel Adder" CURVE 0x00145BFA /* @ECU_Address@Tchk2_ECT_add@0x0267D000@ */ ECIPP_ALIGNMENT_SWORD 3200 Compu_Tchk2_ECT_add -3200 3199.90234375
 /begin AXIS_DESCR COM_AXIS NO_INPUT_QUANTITY Compu_Tchk_ECT_ECT 16 -1484 563.96875 AXIS_PTS_REF Tchk_ECT_ECT /end AXIS_DESCR
/end CHARACTERISTIC
/begin COMPU_METHOD Compu_Tchk2_ECT_add " " RAT_FUNC "%.1" "Secondary Choke Fuel Adder (%)" COEFFS 0 10.24 0 0 0 1 /end COMPU_METHOD
/begin GROUP EC_SparkCalNG "ECONTROLS" ROOT
 /begin REF_CHARACTERISTIC CWTretNG_posC CWTretNG_negC Tspka_baseNG_CAD Tspko_ECTvLNG_CAD Tspko_MATvLNG_CAD TspkMATMAPrmultNG /end REF_CHARACTERISTIC
/end GROUP
/begin GROUP EC_SparkOfst "ECONTROLS" ROOT
 /begin REF_CHARACTERISTIC FSO_ret_init FSO_ret_decay CWTret_posC CWTretNG_posC CWTret_negC CWTretNG_negC spko_cyl_mode coil1_spk_mult coil2_spk_mult coil3_spk_mult coil4_spk_mult coil5_spk_mult coil6_spk_mult coil7_spk_mult coil8_spk_mult coil9_spk_mult coil10_spk_mult spko_cyl_dzfilt spk_rpmlo_crank_lmt spk_rpmlo_stall_lmt spk_rpmlo_crank_ena FSO_ret_mode spkret_decay_time strt_spkret_ena spkret_EGT spkret_hold_mult Tspko_ECTvL_CAD Tspko_MATvL_CAD Tspko_ECT_CAD Tspko_cyl_CAD Tspkret_FSOt_hold Tspkret_ECT_hold Tspkret_MAP_retard TspkMATMAPrmult /end REF_CHARACTERISTIC
 /begin REF_MEASUREMENT coil1_adv_cyl coil2_adv_cyl coil3_adv_cyl coil4_adv_cyl coil5_adv_cyl coil6_adv_cyl coil7_adv_cyl coil8_adv_cyl coil9_adv_cyl coil10_adv_cyl spkret_hold_tmr /end REF_MEASUREMENT
/end GROUP
/begin GROUP EC_Starting "ECONTROLS" ROOT
 /begin REF_CHARACTERISTIC CHTcrank_Kup CHTcrank_Kdn CHTcrank_deltmax CHTcrank_ceil strt_inj_tmng strt_inj_rpm CrkTT_delt_rpm afs_crkdly_ECT afs_crkdly_cycs afs_crkdly_ECTlo afs_crkdly_fs SCD_Vbat_min SCD_relay_on_wt SCD_PWM_dc SCD_off_FB_volts CrkTT_instant strt_inj_mode_I1 strt_inj_mode_I2 choke_add_mode fuelclr_auto_ena fuelclr_auto_rstmode coldstrt_mode coldstrt_ECT coldstrt_max_tm Tstrt_ECT_add Tstrt_cyc_mult Tchk_ECT_add Tchk_ECT_hold Tchk_ECT_decay Tspka_crk_CAD TCrkTT_ECT_decay TInjTT_ECT_CAD TInjTT_ECT_decay Tfuelclr_crank_tm Tfuelclr_tm Tchk2_ECT_add /end REF_CHARACTERISTIC
 /begin REF_MEASUREMENT strt_add strt_mult m_f_start m_f_ww1 crank_cycles m_f_choke start_presync start_postsync start_tmr start_rpm_avg start_lostsync start_longtooth CHTcrank CHTcrank_delt CrkTT_x_dcy CrkTT_x_rpm SCD_active_ms InjTT_x_dcy InjTT_dcy_t inj_timing_crk inj_timing_norm Vbatdt_float fuelclr_auto_tmr fuelclr_auto_state coldstrt_state m_f_choke2 /end REF_MEASUREMENT
/end GROUP
/begin GROUP EC_Tests "ECONTROLS" ROOT
 /begin REF_CHARACTERISTIC alt_coilkill_ena basespk_adv basespk_rpm basespk_MAP Tspkf_duration Tspkf_ena Tinjf_duration_def Tinjf_unlatch_revs Tidlspd_rpm_min Tidlspd_rpm_max Tidlspd_FPP_max cam_pos_std basespk_ena Tcmp_input_trig FuelSpk_SD_input TSTCL_rpmd TSTCL_std_wt TSTCL_EGO_dZ TSTCL_BM_max TSTCL_pst_BM TSTCL_pst_Vrich TSTCL_pst_wt TSTCL_phi_d TSTCL_spk_max TSTCL_Emin TSTCL_EGOZ_time TSTCL_pst_Vlean FuelSpk_SD_vehspd FuelSpk_SD_tmin FuelSpk_SD_tmax RMT_start_tstcomp TSTCL_UEGOB_Ttol TSTCL_pst_Phirich TSTCL_pst_Philean Tcambmp_rpm_max TSTCL_UEGON_Ttol FuelSpk_SD_tdelay Tinjf_dur_peak_def VSFan_dt_ECT_min VSFan_dt_AAT_min VSFan_dt_OILT_min VSFan_dt_engrpm VSFan_dt_engrpm_rate VSFan_dt_rpm1 VSFan_dt_rpm2 VSFan_dt_wait_tm VSFan_dt_avg_tm VSFan_dt_access TSTCM_wait_tm TSTCM_diag_tm TSTCM_engrpm TSTCM_engrpm_rate TSTCL_warmup_mode spk_kill_rpm spk_kill_MAP spk_kill_CBT /end REF_CHARACTERISTIC
 /begin REF_MEASUREMENT fuel_shutoff_chk spark_shutoff_chk MSbasespk MSIAC MSidle_spd TSTbasespk Tinjf_duration TSTIAC TSTidle_spd TSTidle_spd_rpm IAC_faultstat LSD_diag_relay LSD_diag_FPrly LSD_diag_buzz LSD_diag_MIL LSD_diag_tach cam_pos_CAD CCDL_ena CCDL_reset CCDL_forcetrig CCDL_status CCDL_misfire TSTCL TSTCL_state TSTCL_duration MSCLpre MSCLpst FuelSpk_SD_tmr TSTcam_bump MScam_bump uego_dt_cmd uego_dt_state uego_dt_duration Tinjf_dur_peak inj_active_class inj_active_order inj_sweep_state inj_sweep_ena inj_sweep_tmr EGR_vlv_dt_cmd EGR_vlv_dt_state VSFan_dt_cmd VSFan_dt_state VSFan_rpm_err VSFan_dt_err_avg1 VSFan_dt_err_avg2 fuelclr_requested TSTCM_cmd TSTCM_ntrlock_ovrd TSTCM_state TSTCM_tmr TSTCM_results ICAV_miscyl_tmr inj_sweep_results /end REF_MEASUREMENT
/end GROUP
/begin GROUP EC_TranCal "ECONTROLS" ROOT
 /begin REF_CHARACTERISTIC ww_dz TD_cyl_smr TD_exh_smr TD_int_smr OILT_def EGR_transdelay_smr OILT_ena OILT_est_mode TBI_tran_tcyl_min TBI_tran_DCstrt_max TBI_tran_inj_turnoff TBI_tran_inj_minon TBI_tran_off_wt_ms TBI_tran_PW_LPtau TBI_tran_PWpct_pos TBI_tran_PWpct_neg TBI_tran_PWpct_off TBI_tran_min_MAP TBI_tran_PW_HPtau TBI_tran_ena TBI_tran_runtime_wt TBI_tran_min_rpm UEGO_delay UEGO_tau_ms OILTL_ena OILTL_level_tau OILTL_J1939_src Tww_ECT_Cp Tww_ECT_taup Sww_mult Tww_ECT_Cn Tww_ECT_taun TOILT_ss TOILT_inctau TOILT_dectau TTD_preTPS_V TTD_pstTPS_V TTD_rotate_CAD TTD_pstcyl_V TTD_sens_delay TTD_exhpreEGR_V TTD_exhpstEGR_V TTD_egrhot_V TTD_egrcool_V TTD_exhpstturb_V TTD_intpstUEGO_V TTD_preTDC_CAD TTD_pstTDC_CAD TTD_intpstfuel_V TOILTL_temp_mult TOILTL_rpm_mult TOILTL_pct TOILTL_stage /end REF_CHARACTERISTIC
 /begin REF_MEASUREMENT ww_Cp_rpm strt_add strt_mult m_f_start m_f_ww1 crank_cycles m_f_choke ww_Cn_rpm TDR_cyl_dly TDM_cyl_td TDM_exh_m TDM_exh_td TD_dly CLBM1_EGO_o CLBM2_EGO_o TDE_enable TDE_CL_edge TDE_CL_bank TDE_CL_ego TDE_td_min TDE_td_max TDE_state TDE_CLe_cnt TDE_EGOe_cnt TDE_cnt TDE_td_inst TDE_error TDM_intu_m TDM_intd_m TDM_intu_td TDM_intd_td OILT_est INT_pstUEGO_delay EXH_preEGR_delay EXH_pstEGR_delay EGR_hot_delay EGR_cool_delay EXH_pstturb_delay OILT TBI_tran_state TBI_tran_injon_DC TBI_tran_injon_num TBI_tran_engage_cnt TBI_tran_PW_prefilt TBI_tran_PW_dev TBI_tran_injmin_DC INT_pstUEGO_xd EXH_preEGR_xd EXH_pstEGR_xd EXH_pstturb_xd EGR_hot_xd EGR_cool_xd CYL_preTDC_delay CYL_pstTDC_delay CYL_preTDC_xd CYL_pstTDC_xd INT_pstfuel_delay INT_pstfuel_xd INT_pstfuel_xa INT_pstfuel_xf INT_pstUEGO_xa CYL_preTDC_xa CYL_pstTDC_xa EXH_preEGR_xa EXH_pstEGR_xa EXH_pstturb_xa EGR_hot_xa EGR_cool_xa INT_pstUEGO_xf CYL_preTDC_xf CYL_pstTDC_xf EXH_preEGR_xf EXH_pstEGR_xf EXH_pstturb_xf EGR_hot_xf EGR_cool_xf OILT_pct_ss OILT_ss Phi1_pre_FBd phi1_error_inst OILTL_temp OILTL_ms_temp OILTL_ms_level OILTL_ms_diag OILTL_mm_temp_init OILTL_mm_temp_crct OILTL_mm_rpm_crct OILTL_diag OILTL_diag_LED OILTL_stage OILTL_level_pct OILTL_level /end REF_MEASUREMENT
/end GROUP
/end MODULE
/end PROJECT
