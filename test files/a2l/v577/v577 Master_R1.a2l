ASAP2_VERSION 1 61
/begin PROJECT Econtrols_4G "4G Test"
/begin HEADER "4G A2L Configuration" PROJECT_NO EControls4G /* config for version control */ VERSION "$Revision: 82130 $:" /* config for version control */ /end HEADER
/begin MODULE EControls_4G_SH2A "EControls 4G"
/begin MOD_COMMON "" DEPOSIT ABSOLUTE BYTE_ORDER MSB_FIRST /end MOD_COMMON
/* Define the Record Layouts */
/begin RECORD_LAYOUT ECIPP_ALIGNMENT_UBYTE FNC_VALUES 1 UBYTE COLUMN_DIR DIRECT /end RECORD_LAYOUT
/begin RECORD_LAYOUT ECIPP_ALIGNMENT_UWORD FNC_VALUES 1 UWORD COLUMN_DIR DIRECT /end RECORD_LAYOUT
/begin RECORD_LAYOUT ECIPP_ALIGNMENT_ULONG FNC_VALUES 1 ULONG COLUMN_DIR DIRECT /end RECORD_LAYOUT
/begin RECORD_LAYOUT ECIPP_ALIGNMENT_FLOAT32_IEEE FNC_VALUES 1 FLOAT32_IEEE COLUMN_DIR DIRECT /end RECORD_LAYOUT
/begin COMPU_METHOD Compu_IDENTITY "Discrete Values " /* Identifier */ IDENTICAL "%.0" /* Format */ "-" /* Units */ /end COMPU_METHOD
/begin CHARACTERISTIC FCdc4_FPP2_IVS_max "FCtl_DTC_0x04(25)" VALUE 0x00163C02 /* @ECU_Address@FCtl_DTC_0x04@0x024C4032@ */ ECIPP_ALIGNMENT_UWORD 65535 Compu_IDENTITY 0 65535 PHYS_UNIT "System ID + DTC" /end CHARACTERISTIC
/begin CHARACTERISTIC FCdc4_FPP2_IVS_min "FCtl_DTC_0x04(26)" VALUE 0x00163C04 /* @ECU_Address@FCtl_DTC_0x04@0x024C4034@ */ ECIPP_ALIGNMENT_UWORD 65535 Compu_IDENTITY 0 65535 PHYS_UNIT "System ID + DTC" /end CHARACTERISTIC
/begin CHARACTERISTIC FCdc4_FPP2_max "FCtl_DTC_0x04(21)" VALUE 0x00163BFA /* @ECU_Address@FCtl_DTC_0x04@0x024C402A@ */ ECIPP_ALIGNMENT_UWORD 65535 Compu_IDENTITY 0 65535 PHYS_UNIT "System ID + DTC" /end CHARACTERISTIC
/begin CHARACTERISTIC FCdc4_FPP2_min "FCtl_DTC_0x04(22)" VALUE 0x00163BFC /* @ECU_Address@FCtl_DTC_0x04@0x024C402C@ */ ECIPP_ALIGNMENT_UWORD 65535 Compu_IDENTITY 0 65535 PHYS_UNIT "System ID + DTC" /end CHARACTERISTIC
/begin CHARACTERISTIC FCdc4_FPP2V_TSC1 "FCtl_DTC_0x04(839)" VALUE 0x0016425E /* @ECU_Address@FCtl_DTC_0x04@0x024C468E@ */ ECIPP_ALIGNMENT_UWORD 65535 Compu_IDENTITY 0 65535 PHYS_UNIT "System ID + DTC" /end CHARACTERISTIC
/begin CHARACTERISTIC FCdc4_FPrly_coilopen "FCtl_DTC_0x04(168)" VALUE 0x00163D20 /* @ECU_Address@FCtl_DTC_0x04@0x024C4150@ */ ECIPP_ALIGNMENT_UWORD 65535 Compu_IDENTITY 0 65535 PHYS_UNIT "System ID + DTC" /end CHARACTERISTIC
/begin CHARACTERISTIC FCdc4_FPrly_coilshort "FCtl_DTC_0x04(169)" VALUE 0x00163D22 /* @ECU_Address@FCtl_DTC_0x04@0x024C4152@ */ ECIPP_ALIGNMENT_UWORD 65535 Compu_IDENTITY 0 65535 PHYS_UNIT "System ID + DTC" /end CHARACTERISTIC
/begin CHARACTERISTIC FCdc4_FPrly_gndshort "FCtl_DTC_0x04(167)" VALUE 0x00163D1E /* @ECU_Address@FCtl_DTC_0x04@0x024C414E@ */ ECIPP_ALIGNMENT_UWORD 65535 Compu_IDENTITY 0 65535 PHYS_UNIT "System ID + DTC" /end CHARACTERISTIC
/begin CHARACTERISTIC FCdc4_FSO_post_TPS_phi_hi "FCtl_DTC_0x04(860)" VALUE 0x00164288 /* @ECU_Address@FCtl_DTC_0x04@0x024C46B8@ */ ECIPP_ALIGNMENT_UWORD 65535 Compu_IDENTITY 0 65535 PHYS_UNIT "System ID + DTC" /end CHARACTERISTIC
/begin CHARACTERISTIC FCdc4_FSO_TPS_phi_hi "FCtl_DTC_0x04(803)" VALUE 0x00164216 /* @ECU_Address@FCtl_DTC_0x04@0x024C4646@ */ ECIPP_ALIGNMENT_UWORD 65535 Compu_IDENTITY 0 65535 PHYS_UNIT "System ID + DTC" /end CHARACTERISTIC
/begin CHARACTERISTIC FCdc4_FT_maxv "FCtl_DTC_0x04(146)" VALUE 0x00163CF4 /* @ECU_Address@FCtl_DTC_0x04@0x024C4124@ */ ECIPP_ALIGNMENT_UWORD 65535 Compu_IDENTITY 0 65535 PHYS_UNIT "System ID + DTC" /end CHARACTERISTIC
/begin CHARACTERISTIC FCdc4_FT_minv "FCtl_DTC_0x04(147)" VALUE 0x00163CF6 /* @ECU_Address@FCtl_DTC_0x04@0x024C4126@ */ ECIPP_ALIGNMENT_UWORD 65535 Compu_IDENTITY 0 65535 PHYS_UNIT "System ID + DTC" /end CHARACTERISTIC
/begin CHARACTERISTIC FCdc4_FTgasf_maxv "FCtl_DTC_0x04(215)" VALUE 0x00163D7E /* @ECU_Address@FCtl_DTC_0x04@0x024C41AE@ */ ECIPP_ALIGNMENT_UWORD 65535 Compu_IDENTITY 0 65535 PHYS_UNIT "System ID + DTC" /end CHARACTERISTIC
/begin CHARACTERISTIC FCdc4_FTgasf_minv "FCtl_DTC_0x04(216)" VALUE 0x00163D80 /* @ECU_Address@FCtl_DTC_0x04@0x024C41B0@ */ ECIPP_ALIGNMENT_UWORD 65535 Compu_IDENTITY 0 65535 PHYS_UNIT "System ID + DTC" /end CHARACTERISTIC
/begin CHARACTERISTIC FCdc4_GLOW_unit_fail "FCtl_DTC_0x04(503)" VALUE 0x00163FBE /* @ECU_Address@FCtl_DTC_0x04@0x024C43EE@ */ ECIPP_ALIGNMENT_UWORD 65535 Compu_IDENTITY 0 65535 PHYS_UNIT "System ID + DTC" /end CHARACTERISTIC
/begin CHARACTERISTIC FCdc4_GLOW1_open "FCtl_DTC_0x04(483)" VALUE 0x00163F96 /* @ECU_Address@FCtl_DTC_0x04@0x024C43C6@ */ ECIPP_ALIGNMENT_UWORD 65535 Compu_IDENTITY 0 65535 PHYS_UNIT "System ID + DTC" /end CHARACTERISTIC
/begin CHARACTERISTIC FCdc4_GLOW1_short "FCtl_DTC_0x04(493)" VALUE 0x00163FAA /* @ECU_Address@FCtl_DTC_0x04@0x024C43DA@ */ ECIPP_ALIGNMENT_UWORD 65535 Compu_IDENTITY 0 65535 PHYS_UNIT "System ID + DTC" /end CHARACTERISTIC
/begin CHARACTERISTIC FCdc4_gov_ntrlock_fail "FCtl_DTC_0x04(92)" VALUE 0x00163C88 /* @ECU_Address@FCtl_DTC_0x04@0x024C40B8@ */ ECIPP_ALIGNMENT_UWORD 65535 Compu_IDENTITY 0 65535 PHYS_UNIT "System ID + DTC" /end CHARACTERISTIC
/begin CHARACTERISTIC FCdc4_gyro_x_max "FCtl_DTC_0x04(708)" VALUE 0x00164158 /* @ECU_Address@FCtl_DTC_0x04@0x024C4588@ */ ECIPP_ALIGNMENT_UWORD 65535 Compu_IDENTITY 0 65535 PHYS_UNIT "System ID + DTC" /end CHARACTERISTIC
/begin CHARACTERISTIC FCdc4_gyro_x_min "FCtl_DTC_0x04(709)" VALUE 0x0016415A /* @ECU_Address@FCtl_DTC_0x04@0x024C458A@ */ ECIPP_ALIGNMENT_UWORD 65535 Compu_IDENTITY 0 65535 PHYS_UNIT "System ID + DTC" /end CHARACTERISTIC
/begin CHARACTERISTIC FCdc4_gyro_y_max "FCtl_DTC_0x04(710)" VALUE 0x0016415C /* @ECU_Address@FCtl_DTC_0x04@0x024C458C@ */ ECIPP_ALIGNMENT_UWORD 65535 Compu_IDENTITY 0 65535 PHYS_UNIT "System ID + DTC" /end CHARACTERISTIC
/begin CHARACTERISTIC FCdc4_gyro_y_min "FCtl_DTC_0x04(711)" VALUE 0x0016415E /* @ECU_Address@FCtl_DTC_0x04@0x024C458E@ */ ECIPP_ALIGNMENT_UWORD 65535 Compu_IDENTITY 0 65535 PHYS_UNIT "System ID + DTC" /end CHARACTERISTIC
/begin CHARACTERISTIC FCdc4_gyro_z_max "FCtl_DTC_0x04(712)" VALUE 0x00164160 /* @ECU_Address@FCtl_DTC_0x04@0x024C4590@ */ ECIPP_ALIGNMENT_UWORD 65535 Compu_IDENTITY 0 65535 PHYS_UNIT "System ID + DTC" /end CHARACTERISTIC
/begin CHARACTERISTIC FCdc4_gyro_z_min "FCtl_DTC_0x04(713)" VALUE 0x00164162 /* @ECU_Address@FCtl_DTC_0x04@0x024C4592@ */ ECIPP_ALIGNMENT_UWORD 65535 Compu_IDENTITY 0 65535 PHYS_UNIT "System ID + DTC" /end CHARACTERISTIC
/begin CHARACTERISTIC FCdc4_HBA_I_max "FCtl_DTC_0x04(528)" VALUE 0x00163FF0 /* @ECU_Address@FCtl_DTC_0x04@0x024C4420@ */ ECIPP_ALIGNMENT_UWORD 65535 Compu_IDENTITY 0 65535 PHYS_UNIT "System ID + DTC" /end CHARACTERISTIC
/begin CHARACTERISTIC FCdc4_HBB_I_max "FCtl_DTC_0x04(529)" VALUE 0x00163FF2 /* @ECU_Address@FCtl_DTC_0x04@0x024C4422@ */ ECIPP_ALIGNMENT_UWORD 65535 Compu_IDENTITY 0 65535 PHYS_UNIT "System ID + DTC" /end CHARACTERISTIC
/begin CHARACTERISTIC FCdc4_HiDiagTemp "FCtl_DTC_0x04(652)" VALUE 0x001640E8 /* @ECU_Address@FCtl_DTC_0x04@0x024C4518@ */ ECIPP_ALIGNMENT_UWORD 65535 Compu_IDENTITY 0 65535 PHYS_UNIT "System ID + DTC" /end CHARACTERISTIC
/begin CHARACTERISTIC FCdc4_HWID_fail "FCtl_DTC_0x04(318)" VALUE 0x00163E4C /* @ECU_Address@FCtl_DTC_0x04@0x024C427C@ */ ECIPP_ALIGNMENT_UWORD 65535 Compu_IDENTITY 0 65535 PHYS_UNIT "System ID + DTC" /end CHARACTERISTIC
/begin CHARACTERISTIC FCdc4_IAC_gndshort "FCtl_DTC_0x04(156)" VALUE 0x00163D08 /* @ECU_Address@FCtl_DTC_0x04@0x024C4138@ */ ECIPP_ALIGNMENT_UWORD 65535 Compu_IDENTITY 0 65535 PHYS_UNIT "System ID + DTC" /end CHARACTERISTIC
/begin CHARACTERISTIC FCdc4_IAC_openshort "FCtl_DTC_0x04(157)" VALUE 0x00163D0A /* @ECU_Address@FCtl_DTC_0x04@0x024C413A@ */ ECIPP_ALIGNMENT_UWORD 65535 Compu_IDENTITY 0 65535 PHYS_UNIT "System ID + DTC" /end CHARACTERISTIC
/begin CHARACTERISTIC FCdc4_IAT_HiExp "FCtl_DTC_0x04(87)" VALUE 0x00163C7E /* @ECU_Address@FCtl_DTC_0x04@0x024C40AE@ */ ECIPP_ALIGNMENT_UWORD 65535 Compu_IDENTITY 0 65535 PHYS_UNIT "System ID + DTC" /end CHARACTERISTIC
/begin CHARACTERISTIC FCdc4_IAT_HiExp2 "FCtl_DTC_0x04(88)" VALUE 0x00163C80 /* @ECU_Address@FCtl_DTC_0x04@0x024C40B0@ */ ECIPP_ALIGNMENT_UWORD 65535 Compu_IDENTITY 0 65535 PHYS_UNIT "System ID + DTC" /end CHARACTERISTIC
/begin CHARACTERISTIC FCdc4_IAT_maxv "FCtl_DTC_0x04(5)" VALUE 0x00163BDA /* @ECU_Address@FCtl_DTC_0x04@0x024C400A@ */ ECIPP_ALIGNMENT_UWORD 65535 Compu_IDENTITY 0 65535 PHYS_UNIT "System ID + DTC" /end CHARACTERISTIC
/begin CHARACTERISTIC FCdc4_IAT_minv "FCtl_DTC_0x04(6)" VALUE 0x00163BDC /* @ECU_Address@FCtl_DTC_0x04@0x024C400C@ */ ECIPP_ALIGNMENT_UWORD 65535 Compu_IDENTITY 0 65535 PHYS_UNIT "System ID + DTC" /end CHARACTERISTIC
/begin CHARACTERISTIC FCdc4_IBF_detected "FCtl_DTC_0x04(861)" VALUE 0x0016428A /* @ECU_Address@FCtl_DTC_0x04@0x024C46BA@ */ ECIPP_ALIGNMENT_UWORD 65535 Compu_IDENTITY 0 65535 PHYS_UNIT "System ID + DTC" /end CHARACTERISTIC
/begin CHARACTERISTIC FCdc4_ICam_maxerr "FCtl_DTC_0x04(288)" VALUE 0x00163E10 /* @ECU_Address@FCtl_DTC_0x04@0x024C4240@ */ ECIPP_ALIGNMENT_UWORD 65535 Compu_IDENTITY 0 65535 PHYS_UNIT "System ID + DTC" /end CHARACTERISTIC
/begin CHARACTERISTIC FCdc4_ICAVD1_mis "FCtl_DTC_0x04(259)" VALUE 0x00163DD6 /* @ECU_Address@FCtl_DTC_0x04@0x024C4206@ */ ECIPP_ALIGNMENT_UWORD 65535 Compu_IDENTITY 0 65535 PHYS_UNIT "System ID + DTC" /end CHARACTERISTIC
/begin CHARACTERISTIC FCdc4_ICAVD1_miscat "FCtl_DTC_0x04(267)" VALUE 0x00163DE6 /* @ECU_Address@FCtl_DTC_0x04@0x024C4216@ */ ECIPP_ALIGNMENT_UWORD 65535 Compu_IDENTITY 0 65535 PHYS_UNIT "System ID + DTC" /end CHARACTERISTIC
/begin CHARACTERISTIC FCdc4_Idle_SD "FCtl_DTC_0x04(654)" VALUE 0x001640EC /* @ECU_Address@FCtl_DTC_0x04@0x024C451C@ */ ECIPP_ALIGNMENT_UWORD 65535 Compu_IDENTITY 0 65535 PHYS_UNIT "System ID + DTC" /end CHARACTERISTIC
/begin CHARACTERISTIC FCdc4_imu_general "FCtl_DTC_0x04(699)" VALUE 0x00164146 /* @ECU_Address@FCtl_DTC_0x04@0x024C4576@ */ ECIPP_ALIGNMENT_UWORD 65535 Compu_IDENTITY 0 65535 PHYS_UNIT "System ID + DTC" /end CHARACTERISTIC
/begin CHARACTERISTIC FCdc4_imu_temp_max "FCtl_DTC_0x04(700)" VALUE 0x00164148 /* @ECU_Address@FCtl_DTC_0x04@0x024C4578@ */ ECIPP_ALIGNMENT_UWORD 65535 Compu_IDENTITY 0 65535 PHYS_UNIT "System ID + DTC" /end CHARACTERISTIC
/begin CHARACTERISTIC FCdc4_imu_temp_min "FCtl_DTC_0x04(701)" VALUE 0x0016414A /* @ECU_Address@FCtl_DTC_0x04@0x024C457A@ */ ECIPP_ALIGNMENT_UWORD 65535 Compu_IDENTITY 0 65535 PHYS_UNIT "System ID + DTC" /end CHARACTERISTIC
/begin CHARACTERISTIC FCdc4_IMVD_Ifb_hi "FCtl_DTC_0x04(583)" VALUE 0x0016405E /* @ECU_Address@FCtl_DTC_0x04@0x024C448E@ */ ECIPP_ALIGNMENT_UWORD 65535 Compu_IDENTITY 0 65535 PHYS_UNIT "System ID + DTC" /end CHARACTERISTIC
/begin CHARACTERISTIC FCdc4_IMVD_Ifb_lo "FCtl_DTC_0x04(582)" VALUE 0x0016405C /* @ECU_Address@FCtl_DTC_0x04@0x024C448C@ */ ECIPP_ALIGNMENT_UWORD 65535 Compu_IDENTITY 0 65535 PHYS_UNIT "System ID + DTC" /end CHARACTERISTIC
/begin CHARACTERISTIC FCdc4_INJD_boost_lo "FCtl_DTC_0x04(578)" VALUE 0x00164054 /* @ECU_Address@FCtl_DTC_0x04@0x024C4484@ */ ECIPP_ALIGNMENT_UWORD 65535 Compu_IDENTITY 0 65535 PHYS_UNIT "System ID + DTC" /end CHARACTERISTIC
/begin CHARACTERISTIC FCdc4_INJD_HS_Ihi "FCtl_DTC_0x04(562)" VALUE 0x00164034 /* @ECU_Address@FCtl_DTC_0x04@0x024C4464@ */ ECIPP_ALIGNMENT_UWORD 65535 Compu_IDENTITY 0 65535 PHYS_UNIT "System ID + DTC" /end CHARACTERISTIC
/begin CHARACTERISTIC FCdc4_INJD_HW_int "FCtl_DTC_0x04(580)" VALUE 0x00164058 /* @ECU_Address@FCtl_DTC_0x04@0x024C4488@ */ ECIPP_ALIGNMENT_UWORD 65535 Compu_IDENTITY 0 65535 PHYS_UNIT "System ID + DTC" /end CHARACTERISTIC
/begin CHARACTERISTIC FCdc4_INJD_LS_Ihi "FCtl_DTC_0x04(570)" VALUE 0x00164044 /* @ECU_Address@FCtl_DTC_0x04@0x024C4474@ */ ECIPP_ALIGNMENT_UWORD 65535 Compu_IDENTITY 0 65535 PHYS_UNIT "System ID + DTC" /end CHARACTERISTIC
/begin CHARACTERISTIC FCdc4_INJD_off_lo "FCtl_DTC_0x04(46)" VALUE 0x00163C2C /* @ECU_Address@FCtl_DTC_0x04@0x024C405C@ */ ECIPP_ALIGNMENT_UWORD 65535 Compu_IDENTITY 0 65535 PHYS_UNIT "System ID + DTC" /end CHARACTERISTIC
/begin CHARACTERISTIC FCdc4_INJD_on_hi "FCtl_DTC_0x04(56)" VALUE 0x00163C40 /* @ECU_Address@FCtl_DTC_0x04@0x024C4070@ */ ECIPP_ALIGNMENT_UWORD 65535 Compu_IDENTITY 0 65535 PHYS_UNIT "System ID + DTC" /end CHARACTERISTIC
/begin CHARACTERISTIC FCdc4_interrupt "FCtl_DTC_0x04(104)" VALUE 0x00163CA0 /* @ECU_Address@FCtl_DTC_0x04@0x024C40D0@ */ ECIPP_ALIGNMENT_UWORD 65535 Compu_IDENTITY 0 65535 PHYS_UNIT "System ID + DTC" /end CHARACTERISTIC
/begin CHARACTERISTIC FCdc4_J1939_AAT_err_loss "FCtl_DTC_0x04(835)" VALUE 0x00164256 /* @ECU_Address@FCtl_DTC_0x04@0x024C4686@ */ ECIPP_ALIGNMENT_UWORD 65535 Compu_IDENTITY 0 65535 PHYS_UNIT "System ID + DTC" /end CHARACTERISTIC
/begin CHARACTERISTIC FCdc4_J1939_addr2Fail "FCtl_DTC_0x04(301)" VALUE 0x00163E2A /* @ECU_Address@FCtl_DTC_0x04@0x024C425A@ */ ECIPP_ALIGNMENT_UWORD 65535 Compu_IDENTITY 0 65535 PHYS_UNIT "System ID + DTC" /end CHARACTERISTIC
/begin CHARACTERISTIC FCdc4_J1939_addr3Fail "FCtl_DTC_0x04(302)" VALUE 0x00163E2C /* @ECU_Address@FCtl_DTC_0x04@0x024C425C@ */ ECIPP_ALIGNMENT_UWORD 65535 Compu_IDENTITY 0 65535 PHYS_UNIT "System ID + DTC" /end CHARACTERISTIC
/begin CHARACTERISTIC FCdc4_J1939_addrFail "FCtl_DTC_0x04(188)" VALUE 0x00163D48 /* @ECU_Address@FCtl_DTC_0x04@0x024C4178@ */ ECIPP_ALIGNMENT_UWORD 65535 Compu_IDENTITY 0 65535 PHYS_UNIT "System ID + DTC" /end CHARACTERISTIC
/begin CHARACTERISTIC FCdc4_J1939_ETC_loss "FCtl_DTC_0x04(219)" VALUE 0x00163D86 /* @ECU_Address@FCtl_DTC_0x04@0x024C41B6@ */ ECIPP_ALIGNMENT_UWORD 65535 Compu_IDENTITY 0 65535 PHYS_UNIT "System ID + DTC" /end CHARACTERISTIC
/begin CHARACTERISTIC FCdc4_J1939_ETC_loss2 "FCtl_DTC_0x04(275)" VALUE 0x00163DF6 /* @ECU_Address@FCtl_DTC_0x04@0x024C4226@ */ ECIPP_ALIGNMENT_UWORD 65535 Compu_IDENTITY 0 65535 PHYS_UNIT "System ID + DTC" /end CHARACTERISTIC
/begin CHARACTERISTIC FCdc4_J1939_PGN_tout "FCtl_DTC_0x04(714)" VALUE 0x00164164 /* @ECU_Address@FCtl_DTC_0x04@0x024C4594@ */ ECIPP_ALIGNMENT_UWORD 65535 Compu_IDENTITY 0 65535 PHYS_UNIT "System ID + DTC" /end CHARACTERISTIC
/begin CHARACTERISTIC FCdc4_J1939_PGN_tout10 "FCtl_DTC_0x04(723)" VALUE 0x00164176 /* @ECU_Address@FCtl_DTC_0x04@0x024C45A6@ */ ECIPP_ALIGNMENT_UWORD 65535 Compu_IDENTITY 0 65535 PHYS_UNIT "System ID + DTC" /end CHARACTERISTIC
/begin CHARACTERISTIC FCdc4_J1939_PGN_tout2 "FCtl_DTC_0x04(715)" VALUE 0x00164166 /* @ECU_Address@FCtl_DTC_0x04@0x024C4596@ */ ECIPP_ALIGNMENT_UWORD 65535 Compu_IDENTITY 0 65535 PHYS_UNIT "System ID + DTC" /end CHARACTERISTIC
/begin CHARACTERISTIC FCdc4_J1939_PGN_tout3 "FCtl_DTC_0x04(716)" VALUE 0x00164168 /* @ECU_Address@FCtl_DTC_0x04@0x024C4598@ */ ECIPP_ALIGNMENT_UWORD 65535 Compu_IDENTITY 0 65535 PHYS_UNIT "System ID + DTC" /end CHARACTERISTIC
/begin CHARACTERISTIC FCdc4_J1939_PGN_tout4 "FCtl_DTC_0x04(717)" VALUE 0x0016416A /* @ECU_Address@FCtl_DTC_0x04@0x024C459A@ */ ECIPP_ALIGNMENT_UWORD 65535 Compu_IDENTITY 0 65535 PHYS_UNIT "System ID + DTC" /end CHARACTERISTIC
/begin CHARACTERISTIC FCdc4_J1939_PGN_tout5 "FCtl_DTC_0x04(718)" VALUE 0x0016416C /* @ECU_Address@FCtl_DTC_0x04@0x024C459C@ */ ECIPP_ALIGNMENT_UWORD 65535 Compu_IDENTITY 0 65535 PHYS_UNIT "System ID + DTC" /end CHARACTERISTIC
/begin CHARACTERISTIC FCdc4_J1939_PGN_tout6 "FCtl_DTC_0x04(719)" VALUE 0x0016416E /* @ECU_Address@FCtl_DTC_0x04@0x024C459E@ */ ECIPP_ALIGNMENT_UWORD 65535 Compu_IDENTITY 0 65535 PHYS_UNIT "System ID + DTC" /end CHARACTERISTIC
/begin CHARACTERISTIC FCdc4_J1939_PGN_tout7 "FCtl_DTC_0x04(720)" VALUE 0x00164170 /* @ECU_Address@FCtl_DTC_0x04@0x024C45A0@ */ ECIPP_ALIGNMENT_UWORD 65535 Compu_IDENTITY 0 65535 PHYS_UNIT "System ID + DTC" /end CHARACTERISTIC
/begin CHARACTERISTIC FCdc4_J1939_PGN_tout8 "FCtl_DTC_0x04(721)" VALUE 0x00164172 /* @ECU_Address@FCtl_DTC_0x04@0x024C45A2@ */ ECIPP_ALIGNMENT_UWORD 65535 Compu_IDENTITY 0 65535 PHYS_UNIT "System ID + DTC" /end CHARACTERISTIC
/begin CHARACTERISTIC FCdc4_J1939_PGN_tout9 "FCtl_DTC_0x04(722)" VALUE 0x00164174 /* @ECU_Address@FCtl_DTC_0x04@0x024C45A4@ */ ECIPP_ALIGNMENT_UWORD 65535 Compu_IDENTITY 0 65535 PHYS_UNIT "System ID + DTC" /end CHARACTERISTIC
/begin CHARACTERISTIC FCdc4_J1939_RS_err_loss "FCtl_DTC_0x04(834)" VALUE 0x00164254 /* @ECU_Address@FCtl_DTC_0x04@0x024C4684@ */ ECIPP_ALIGNMENT_UWORD 65535 Compu_IDENTITY 0 65535 PHYS_UNIT "System ID + DTC" /end CHARACTERISTIC
/begin CHARACTERISTIC FCdc4_J1939_RSsetpt_loss "FCtl_DTC_0x04(600)" VALUE 0x00164080 /* @ECU_Address@FCtl_DTC_0x04@0x024C44B0@ */ ECIPP_ALIGNMENT_UWORD 65535 Compu_IDENTITY 0 65535 PHYS_UNIT "System ID + DTC" /end CHARACTERISTIC
/begin CHARACTERISTIC FCdc4_J1939_Rx2Fail "FCtl_DTC_0x04(299)" VALUE 0x00163E26 /* @ECU_Address@FCtl_DTC_0x04@0x024C4256@ */ ECIPP_ALIGNMENT_UWORD 65535 Compu_IDENTITY 0 65535 PHYS_UNIT "System ID + DTC" /end CHARACTERISTIC
/begin CHARACTERISTIC FCdc4_J1939_Rx3Fail "FCtl_DTC_0x04(300)" VALUE 0x00163E28 /* @ECU_Address@FCtl_DTC_0x04@0x024C4258@ */ ECIPP_ALIGNMENT_UWORD 65535 Compu_IDENTITY 0 65535 PHYS_UNIT "System ID + DTC" /end CHARACTERISTIC
/begin CHARACTERISTIC FPnd_FPP2_IVS_max "FPrm_pending(32)" VALUE 0x001649AC /* @ECU_Address@FPrm_pending@0x021BE040@ */ ECIPP_ALIGNMENT_UWORD 65535 Compu_IDENTITY 0 65535 PHYS_UNIT "Bit Mask" /end CHARACTERISTIC
/begin CHARACTERISTIC FPnd_FPP2_IVS_min "FPrm_pending(33)" VALUE 0x001649AE /* @ECU_Address@FPrm_pending@0x021BE042@ */ ECIPP_ALIGNMENT_UWORD 65535 Compu_IDENTITY 0 65535 PHYS_UNIT "Bit Mask" /end CHARACTERISTIC
/begin CHARACTERISTIC FPnd_FPP2_max "FPrm_pending(28)" VALUE 0x001649A4 /* @ECU_Address@FPrm_pending@0x021BE038@ */ ECIPP_ALIGNMENT_UWORD 65535 Compu_IDENTITY 0 65535 PHYS_UNIT "Bit Mask" /end CHARACTERISTIC
/begin CHARACTERISTIC FPnd_FPP2_min "FPrm_pending(29)" VALUE 0x001649A6 /* @ECU_Address@FPrm_pending@0x021BE03A@ */ ECIPP_ALIGNMENT_UWORD 65535 Compu_IDENTITY 0 65535 PHYS_UNIT "Bit Mask" /end CHARACTERISTIC
/begin CHARACTERISTIC FPnd_FPP2V_TSC1 "FPrm_pending(666)" VALUE 0x00164EA0 /* @ECU_Address@FPrm_pending@0x021BE534@ */ ECIPP_ALIGNMENT_UWORD 65535 Compu_IDENTITY 0 65535 PHYS_UNIT "Bit Mask" /end CHARACTERISTIC
/begin CHARACTERISTIC FPnd_FPrly_coilopen "FPrm_pending(128)" VALUE 0x00164A6C /* @ECU_Address@FPrm_pending@0x021BE100@ */ ECIPP_ALIGNMENT_UWORD 65535 Compu_IDENTITY 0 65535 PHYS_UNIT "Bit Mask" /end CHARACTERISTIC
/begin CHARACTERISTIC FPnd_FPrly_coilshort "FPrm_pending(129)" VALUE 0x00164A6E /* @ECU_Address@FPrm_pending@0x021BE102@ */ ECIPP_ALIGNMENT_UWORD 65535 Compu_IDENTITY 0 65535 PHYS_UNIT "Bit Mask" /end CHARACTERISTIC
/begin CHARACTERISTIC FPnd_FPrly_gndshort "FPrm_pending(127)" VALUE 0x00164A6A /* @ECU_Address@FPrm_pending@0x021BE0FE@ */ ECIPP_ALIGNMENT_UWORD 65535 Compu_IDENTITY 0 65535 PHYS_UNIT "Bit Mask" /end CHARACTERISTIC
/begin CHARACTERISTIC FPnd_FSO_post_TPS_phi_hi "FPrm_pending(687)" VALUE 0x00164ECA /* @ECU_Address@FPrm_pending@0x021BE55E@ */ ECIPP_ALIGNMENT_UWORD 65535 Compu_IDENTITY 0 65535 PHYS_UNIT "Bit Mask" /end CHARACTERISTIC
/begin CHARACTERISTIC FPnd_FSO_TPS_phi_hi "FPrm_pending(632)" VALUE 0x00164E5C /* @ECU_Address@FPrm_pending@0x021BE4F0@ */ ECIPP_ALIGNMENT_UWORD 65535 Compu_IDENTITY 0 65535 PHYS_UNIT "Bit Mask" /end CHARACTERISTIC
/begin CHARACTERISTIC FPnd_FT_maxv "FPrm_pending(106)" VALUE 0x00164A40 /* @ECU_Address@FPrm_pending@0x021BE0D4@ */ ECIPP_ALIGNMENT_UWORD 65535 Compu_IDENTITY 0 65535 PHYS_UNIT "Bit Mask" /end CHARACTERISTIC
/begin CHARACTERISTIC FPnd_FT_minv "FPrm_pending(107)" VALUE 0x00164A42 /* @ECU_Address@FPrm_pending@0x021BE0D6@ */ ECIPP_ALIGNMENT_UWORD 65535 Compu_IDENTITY 0 65535 PHYS_UNIT "Bit Mask" /end CHARACTERISTIC
/begin CHARACTERISTIC FPnd_FTgasf_maxv "FPrm_pending(171)" VALUE 0x00164AC2 /* @ECU_Address@FPrm_pending@0x021BE156@ */ ECIPP_ALIGNMENT_UWORD 65535 Compu_IDENTITY 0 65535 PHYS_UNIT "Bit Mask" /end CHARACTERISTIC
/begin CHARACTERISTIC FPnd_FTgasf_minv "FPrm_pending(172)" VALUE 0x00164AC4 /* @ECU_Address@FPrm_pending@0x021BE158@ */ ECIPP_ALIGNMENT_UWORD 65535 Compu_IDENTITY 0 65535 PHYS_UNIT "Bit Mask" /end CHARACTERISTIC
/begin CHARACTERISTIC FPnd_GLOW_unit_fail "FPrm_pending(382)" VALUE 0x00164C68 /* @ECU_Address@FPrm_pending@0x021BE2FC@ */ ECIPP_ALIGNMENT_UWORD 65535 Compu_IDENTITY 0 65535 PHYS_UNIT "Bit Mask" /end CHARACTERISTIC
/begin CHARACTERISTIC FPnd_GLOW1_open "FPrm_pending(380)" VALUE 0x00164C64 /* @ECU_Address@FPrm_pending@0x021BE2F8@ */ ECIPP_ALIGNMENT_UWORD 65535 Compu_IDENTITY 0 65535 PHYS_UNIT "Bit Mask" /end CHARACTERISTIC
/begin CHARACTERISTIC FPnd_GLOW1_short "FPrm_pending(381)" VALUE 0x00164C66 /* @ECU_Address@FPrm_pending@0x021BE2FA@ */ ECIPP_ALIGNMENT_UWORD 65535 Compu_IDENTITY 0 65535 PHYS_UNIT "Bit Mask" /end CHARACTERISTIC
/begin CHARACTERISTIC FPnd_gov_ntrlock_fail "FPrm_pending(36)" VALUE 0x001649B4 /* @ECU_Address@FPrm_pending@0x021BE048@ */ ECIPP_ALIGNMENT_UWORD 65535 Compu_IDENTITY 0 65535 PHYS_UNIT "Bit Mask" /end CHARACTERISTIC
/begin CHARACTERISTIC FPnd_gyro_x_max "FPrm_pending(538)" VALUE 0x00164DA0 /* @ECU_Address@FPrm_pending@0x021BE434@ */ ECIPP_ALIGNMENT_UWORD 65535 Compu_IDENTITY 0 65535 PHYS_UNIT "Bit Mask" /end CHARACTERISTIC
/begin CHARACTERISTIC FPnd_gyro_x_min "FPrm_pending(539)" VALUE 0x00164DA2 /* @ECU_Address@FPrm_pending@0x021BE436@ */ ECIPP_ALIGNMENT_UWORD 65535 Compu_IDENTITY 0 65535 PHYS_UNIT "Bit Mask" /end CHARACTERISTIC
/begin CHARACTERISTIC FPnd_gyro_y_max "FPrm_pending(540)" VALUE 0x00164DA4 /* @ECU_Address@FPrm_pending@0x021BE438@ */ ECIPP_ALIGNMENT_UWORD 65535 Compu_IDENTITY 0 65535 PHYS_UNIT "Bit Mask" /end CHARACTERISTIC
/begin CHARACTERISTIC FPnd_gyro_y_min "FPrm_pending(541)" VALUE 0x00164DA6 /* @ECU_Address@FPrm_pending@0x021BE43A@ */ ECIPP_ALIGNMENT_UWORD 65535 Compu_IDENTITY 0 65535 PHYS_UNIT "Bit Mask" /end CHARACTERISTIC
/begin CHARACTERISTIC FPnd_gyro_z_max "FPrm_pending(542)" VALUE 0x00164DA8 /* @ECU_Address@FPrm_pending@0x021BE43C@ */ ECIPP_ALIGNMENT_UWORD 65535 Compu_IDENTITY 0 65535 PHYS_UNIT "Bit Mask" /end CHARACTERISTIC
/begin CHARACTERISTIC FPnd_gyro_z_min "FPrm_pending(543)" VALUE 0x00164DAA /* @ECU_Address@FPrm_pending@0x021BE43E@ */ ECIPP_ALIGNMENT_UWORD 65535 Compu_IDENTITY 0 65535 PHYS_UNIT "Bit Mask" /end CHARACTERISTIC
/begin CHARACTERISTIC FPnd_HBA_I_max "FPrm_pending(398)" VALUE 0x00164C88 /* @ECU_Address@FPrm_pending@0x021BE31C@ */ ECIPP_ALIGNMENT_UWORD 65535 Compu_IDENTITY 0 65535 PHYS_UNIT "Bit Mask" /end CHARACTERISTIC
/begin CHARACTERISTIC FPnd_HBB_I_max "FPrm_pending(399)" VALUE 0x00164C8A /* @ECU_Address@FPrm_pending@0x021BE31E@ */ ECIPP_ALIGNMENT_UWORD 65535 Compu_IDENTITY 0 65535 PHYS_UNIT "Bit Mask" /end CHARACTERISTIC
/begin CHARACTERISTIC FPnd_HiDiagTemp "FPrm_pending(482)" VALUE 0x00164D30 /* @ECU_Address@FPrm_pending@0x021BE3C4@ */ ECIPP_ALIGNMENT_UWORD 65535 Compu_IDENTITY 0 65535 PHYS_UNIT "Bit Mask" /end CHARACTERISTIC
/begin CHARACTERISTIC FPnd_HWID_fail "FPrm_pending(227)" VALUE 0x00164B32 /* @ECU_Address@FPrm_pending@0x021BE1C6@ */ ECIPP_ALIGNMENT_UWORD 65535 Compu_IDENTITY 0 65535 PHYS_UNIT "Bit Mask" /end CHARACTERISTIC
/begin CHARACTERISTIC FPnd_IAC_gndshort "FPrm_pending(116)" VALUE 0x00164A54 /* @ECU_Address@FPrm_pending@0x021BE0E8@ */ ECIPP_ALIGNMENT_UWORD 65535 Compu_IDENTITY 0 65535 PHYS_UNIT "Bit Mask" /end CHARACTERISTIC
/begin CHARACTERISTIC FPnd_IAC_openshort "FPrm_pending(117)" VALUE 0x00164A56 /* @ECU_Address@FPrm_pending@0x021BE0EA@ */ ECIPP_ALIGNMENT_UWORD 65535 Compu_IDENTITY 0 65535 PHYS_UNIT "Bit Mask" /end CHARACTERISTIC
/begin CHARACTERISTIC FPnd_IAT_HiExp "FPrm_pending(8)" VALUE 0x0016497C /* @ECU_Address@FPrm_pending@0x021BE010@ */ ECIPP_ALIGNMENT_UWORD 65535 Compu_IDENTITY 0 65535 PHYS_UNIT "Bit Mask" /end CHARACTERISTIC
/begin CHARACTERISTIC FPnd_IAT_HiExp2 "FPrm_pending(9)" VALUE 0x0016497E /* @ECU_Address@FPrm_pending@0x021BE012@ */ ECIPP_ALIGNMENT_UWORD 65535 Compu_IDENTITY 0 65535 PHYS_UNIT "Bit Mask" /end CHARACTERISTIC
/begin CHARACTERISTIC FPnd_IAT_maxv "FPrm_pending(6)" VALUE 0x00164978 /* @ECU_Address@FPrm_pending@0x021BE00C@ */ ECIPP_ALIGNMENT_UWORD 65535 Compu_IDENTITY 0 65535 PHYS_UNIT "Bit Mask" /end CHARACTERISTIC
/begin CHARACTERISTIC FPnd_IAT_minv "FPrm_pending(7)" VALUE 0x0016497A /* @ECU_Address@FPrm_pending@0x021BE00E@ */ ECIPP_ALIGNMENT_UWORD 65535 Compu_IDENTITY 0 65535 PHYS_UNIT "Bit Mask" /end CHARACTERISTIC
/begin CHARACTERISTIC FPnd_IBF_detected "FPrm_pending(688)" VALUE 0x00164ECC /* @ECU_Address@FPrm_pending@0x021BE560@ */ ECIPP_ALIGNMENT_UWORD 65535 Compu_IDENTITY 0 65535 PHYS_UNIT "Bit Mask" /end CHARACTERISTIC
/begin CHARACTERISTIC FPnd_ICam_maxerr "FPrm_pending(210)" VALUE 0x00164B10 /* @ECU_Address@FPrm_pending@0x021BE1A4@ */ ECIPP_ALIGNMENT_UWORD 65535 Compu_IDENTITY 0 65535 PHYS_UNIT "Bit Mask" /end CHARACTERISTIC
/begin CHARACTERISTIC FPnd_ICAVD1_mis "FPrm_pending(195)" VALUE 0x00164AF2 /* @ECU_Address@FPrm_pending@0x021BE186@ */ ECIPP_ALIGNMENT_UWORD 65535 Compu_IDENTITY 0 65535 PHYS_UNIT "Bit Mask" /end CHARACTERISTIC
/begin CHARACTERISTIC FPnd_ICAVD1_miscat "FPrm_pending(196)" VALUE 0x00164AF4 /* @ECU_Address@FPrm_pending@0x021BE188@ */ ECIPP_ALIGNMENT_UWORD 65535 Compu_IDENTITY 0 65535 PHYS_UNIT "Bit Mask" /end CHARACTERISTIC
/begin CHARACTERISTIC FPnd_Idle_SD "FPrm_pending(484)" VALUE 0x00164D34 /* @ECU_Address@FPrm_pending@0x021BE3C8@ */ ECIPP_ALIGNMENT_UWORD 65535 Compu_IDENTITY 0 65535 PHYS_UNIT "Bit Mask" /end CHARACTERISTIC
/begin CHARACTERISTIC FPnd_imu_general "FPrm_pending(529)" VALUE 0x00164D8E /* @ECU_Address@FPrm_pending@0x021BE422@ */ ECIPP_ALIGNMENT_UWORD 65535 Compu_IDENTITY 0 65535 PHYS_UNIT "Bit Mask" /end CHARACTERISTIC
/begin CHARACTERISTIC FPnd_imu_temp_max "FPrm_pending(530)" VALUE 0x00164D90 /* @ECU_Address@FPrm_pending@0x021BE424@ */ ECIPP_ALIGNMENT_UWORD 65535 Compu_IDENTITY 0 65535 PHYS_UNIT "Bit Mask" /end CHARACTERISTIC
/begin CHARACTERISTIC FPnd_imu_temp_min "FPrm_pending(531)" VALUE 0x00164D92 /* @ECU_Address@FPrm_pending@0x021BE426@ */ ECIPP_ALIGNMENT_UWORD 65535 Compu_IDENTITY 0 65535 PHYS_UNIT "Bit Mask" /end CHARACTERISTIC
/begin CHARACTERISTIC FPnd_IMVD_Ifb_hi "FPrm_pending(437)" VALUE 0x00164CD6 /* @ECU_Address@FPrm_pending@0x021BE36A@ */ ECIPP_ALIGNMENT_UWORD 65535 Compu_IDENTITY 0 65535 PHYS_UNIT "Bit Mask" /end CHARACTERISTIC
/begin CHARACTERISTIC FPnd_IMVD_Ifb_lo "FPrm_pending(436)" VALUE 0x00164CD4 /* @ECU_Address@FPrm_pending@0x021BE368@ */ ECIPP_ALIGNMENT_UWORD 65535 Compu_IDENTITY 0 65535 PHYS_UNIT "Bit Mask" /end CHARACTERISTIC
/begin CHARACTERISTIC FPnd_INJD_boost_lo "FPrm_pending(434)" VALUE 0x00164CD0 /* @ECU_Address@FPrm_pending@0x021BE364@ */ ECIPP_ALIGNMENT_UWORD 65535 Compu_IDENTITY 0 65535 PHYS_UNIT "Bit Mask" /end CHARACTERISTIC
/begin CHARACTERISTIC FPnd_INJD_HS_Ihi "FPrm_pending(432)" VALUE 0x00164CCC /* @ECU_Address@FPrm_pending@0x021BE360@ */ ECIPP_ALIGNMENT_UWORD 65535 Compu_IDENTITY 0 65535 PHYS_UNIT "Bit Mask" /end CHARACTERISTIC
/begin CHARACTERISTIC FPnd_INJD_HW_int "FPrm_pending(435)" VALUE 0x00164CD2 /* @ECU_Address@FPrm_pending@0x021BE366@ */ ECIPP_ALIGNMENT_UWORD 65535 Compu_IDENTITY 0 65535 PHYS_UNIT "Bit Mask" /end CHARACTERISTIC
/begin CHARACTERISTIC FPnd_INJD_LS_Ihi "FPrm_pending(433)" VALUE 0x00164CCE /* @ECU_Address@FPrm_pending@0x021BE362@ */ ECIPP_ALIGNMENT_UWORD 65535 Compu_IDENTITY 0 65535 PHYS_UNIT "Bit Mask" /end CHARACTERISTIC
/begin CHARACTERISTIC FPnd_INJD_off_lo "FPrm_pending(53)" VALUE 0x001649D6 /* @ECU_Address@FPrm_pending@0x021BE06A@ */ ECIPP_ALIGNMENT_UWORD 65535 Compu_IDENTITY 0 65535 PHYS_UNIT "Bit Mask" /end CHARACTERISTIC
/begin CHARACTERISTIC FPnd_INJD_on_hi "FPrm_pending(54)" VALUE 0x001649D8 /* @ECU_Address@FPrm_pending@0x021BE06C@ */ ECIPP_ALIGNMENT_UWORD 65535 Compu_IDENTITY 0 65535 PHYS_UNIT "Bit Mask" /end CHARACTERISTIC
/begin CHARACTERISTIC FPnd_interrupt "FPrm_pending(68)" VALUE 0x001649F4 /* @ECU_Address@FPrm_pending@0x021BE088@ */ ECIPP_ALIGNMENT_UWORD 65535 Compu_IDENTITY 0 65535 PHYS_UNIT "Bit Mask" /end CHARACTERISTIC
/begin CHARACTERISTIC FPnd_J1939_AAT_err_loss "FPrm_pending(662)" VALUE 0x00164E98 /* @ECU_Address@FPrm_pending@0x021BE52C@ */ ECIPP_ALIGNMENT_UWORD 65535 Compu_IDENTITY 0 65535 PHYS_UNIT "Bit Mask" /end CHARACTERISTIC
/begin CHARACTERISTIC FPnd_J1939_addr2Fail "FPrm_pending(223)" VALUE 0x00164B2A /* @ECU_Address@FPrm_pending@0x021BE1BE@ */ ECIPP_ALIGNMENT_UWORD 65535 Compu_IDENTITY 0 65535 PHYS_UNIT "Bit Mask" /end CHARACTERISTIC
/begin CHARACTERISTIC FPnd_J1939_addr3Fail "FPrm_pending(224)" VALUE 0x00164B2C /* @ECU_Address@FPrm_pending@0x021BE1C0@ */ ECIPP_ALIGNMENT_UWORD 65535 Compu_IDENTITY 0 65535 PHYS_UNIT "Bit Mask" /end CHARACTERISTIC
/begin CHARACTERISTIC FPnd_J1939_addrFail "FPrm_pending(146)" VALUE 0x00164A90 /* @ECU_Address@FPrm_pending@0x021BE124@ */ ECIPP_ALIGNMENT_UWORD 65535 Compu_IDENTITY 0 65535 PHYS_UNIT "Bit Mask" /end CHARACTERISTIC
/begin CHARACTERISTIC FPnd_J1939_ETC_loss "FPrm_pending(175)" VALUE 0x00164ACA /* @ECU_Address@FPrm_pending@0x021BE15E@ */ ECIPP_ALIGNMENT_UWORD 65535 Compu_IDENTITY 0 65535 PHYS_UNIT "Bit Mask" /end CHARACTERISTIC
/begin CHARACTERISTIC FPnd_J1939_ETC_loss2 "FPrm_pending(197)" VALUE 0x00164AF6 /* @ECU_Address@FPrm_pending@0x021BE18A@ */ ECIPP_ALIGNMENT_UWORD 65535 Compu_IDENTITY 0 65535 PHYS_UNIT "Bit Mask" /end CHARACTERISTIC
/begin CHARACTERISTIC FPnd_J1939_PGN_tout "FPrm_pending(544)" VALUE 0x00164DAC /* @ECU_Address@FPrm_pending@0x021BE440@ */ ECIPP_ALIGNMENT_UWORD 65535 Compu_IDENTITY 0 65535 PHYS_UNIT "Bit Mask" /end CHARACTERISTIC
/begin CHARACTERISTIC FPnd_J1939_PGN_tout10 "FPrm_pending(553)" VALUE 0x00164DBE /* @ECU_Address@FPrm_pending@0x021BE452@ */ ECIPP_ALIGNMENT_UWORD 65535 Compu_IDENTITY 0 65535 PHYS_UNIT "Bit Mask" /end CHARACTERISTIC
/begin CHARACTERISTIC FPnd_J1939_PGN_tout2 "FPrm_pending(545)" VALUE 0x00164DAE /* @ECU_Address@FPrm_pending@0x021BE442@ */ ECIPP_ALIGNMENT_UWORD 65535 Compu_IDENTITY 0 65535 PHYS_UNIT "Bit Mask" /end CHARACTERISTIC
/begin CHARACTERISTIC FPnd_J1939_PGN_tout3 "FPrm_pending(546)" VALUE 0x00164DB0 /* @ECU_Address@FPrm_pending@0x021BE444@ */ ECIPP_ALIGNMENT_UWORD 65535 Compu_IDENTITY 0 65535 PHYS_UNIT "Bit Mask" /end CHARACTERISTIC
/begin CHARACTERISTIC FPnd_J1939_PGN_tout4 "FPrm_pending(547)" VALUE 0x00164DB2 /* @ECU_Address@FPrm_pending@0x021BE446@ */ ECIPP_ALIGNMENT_UWORD 65535 Compu_IDENTITY 0 65535 PHYS_UNIT "Bit Mask" /end CHARACTERISTIC
/begin CHARACTERISTIC FPnd_J1939_PGN_tout5 "FPrm_pending(548)" VALUE 0x00164DB4 /* @ECU_Address@FPrm_pending@0x021BE448@ */ ECIPP_ALIGNMENT_UWORD 65535 Compu_IDENTITY 0 65535 PHYS_UNIT "Bit Mask" /end CHARACTERISTIC
/begin CHARACTERISTIC FPnd_J1939_PGN_tout6 "FPrm_pending(549)" VALUE 0x00164DB6 /* @ECU_Address@FPrm_pending@0x021BE44A@ */ ECIPP_ALIGNMENT_UWORD 65535 Compu_IDENTITY 0 65535 PHYS_UNIT "Bit Mask" /end CHARACTERISTIC
/begin CHARACTERISTIC FPnd_J1939_PGN_tout7 "FPrm_pending(550)" VALUE 0x00164DB8 /* @ECU_Address@FPrm_pending@0x021BE44C@ */ ECIPP_ALIGNMENT_UWORD 65535 Compu_IDENTITY 0 65535 PHYS_UNIT "Bit Mask" /end CHARACTERISTIC
/begin CHARACTERISTIC FPnd_J1939_PGN_tout8 "FPrm_pending(551)" VALUE 0x00164DBA /* @ECU_Address@FPrm_pending@0x021BE44E@ */ ECIPP_ALIGNMENT_UWORD 65535 Compu_IDENTITY 0 65535 PHYS_UNIT "Bit Mask" /end CHARACTERISTIC
/begin CHARACTERISTIC FPnd_J1939_PGN_tout9 "FPrm_pending(552)" VALUE 0x00164DBC /* @ECU_Address@FPrm_pending@0x021BE450@ */ ECIPP_ALIGNMENT_UWORD 65535 Compu_IDENTITY 0 65535 PHYS_UNIT "Bit Mask" /end CHARACTERISTIC
/begin CHARACTERISTIC FPnd_J1939_RS_err_loss "FPrm_pending(661)" VALUE 0x00164E96 /* @ECU_Address@FPrm_pending@0x021BE52A@ */ ECIPP_ALIGNMENT_UWORD 65535 Compu_IDENTITY 0 65535 PHYS_UNIT "Bit Mask" /end CHARACTERISTIC
/begin CHARACTERISTIC FPnd_J1939_RSsetpt_loss "FPrm_pending(454)" VALUE 0x00164CF8 /* @ECU_Address@FPrm_pending@0x021BE38C@ */ ECIPP_ALIGNMENT_UWORD 65535 Compu_IDENTITY 0 65535 PHYS_UNIT "Bit Mask" /end CHARACTERISTIC
/begin CHARACTERISTIC FPnd_J1939_Rx2Fail "FPrm_pending(221)" VALUE 0x00164B26 /* @ECU_Address@FPrm_pending@0x021BE1BA@ */ ECIPP_ALIGNMENT_UWORD 65535 Compu_IDENTITY 0 65535 PHYS_UNIT "Bit Mask" /end CHARACTERISTIC
/begin CHARACTERISTIC FPnd_J1939_Rx3Fail "FPrm_pending(222)" VALUE 0x00164B28 /* @ECU_Address@FPrm_pending@0x021BE1BC@ */ ECIPP_ALIGNMENT_UWORD 65535 Compu_IDENTITY 0 65535 PHYS_UNIT "Bit Mask" /end CHARACTERISTIC
/begin CHARACTERISTIC FPsvr_FPP2_IVS_max "FPrm_severity(32)" VALUE 0x00165DFE /* @ECU_Address@FPrm_severity@0x024B3020@ */ ECIPP_ALIGNMENT_UBYTE 255 Compu_IDENTITY 0 255 PHYS_UNIT "Severity+Class" /end CHARACTERISTIC
/begin CHARACTERISTIC FPsvr_FPP2_IVS_min "FPrm_severity(33)" VALUE 0x00165DFF /* @ECU_Address@FPrm_severity@0x024B3021@ */ ECIPP_ALIGNMENT_UBYTE 255 Compu_IDENTITY 0 255 PHYS_UNIT "Severity+Class" /end CHARACTERISTIC
/begin CHARACTERISTIC FPsvr_FPP2_max "FPrm_severity(28)" VALUE 0x00165DFA /* @ECU_Address@FPrm_severity@0x024B301C@ */ ECIPP_ALIGNMENT_UBYTE 255 Compu_IDENTITY 0 255 PHYS_UNIT "Severity+Class" /end CHARACTERISTIC
/begin CHARACTERISTIC FPsvr_FPP2_min "FPrm_severity(29)" VALUE 0x00165DFB /* @ECU_Address@FPrm_severity@0x024B301D@ */ ECIPP_ALIGNMENT_UBYTE 255 Compu_IDENTITY 0 255 PHYS_UNIT "Severity+Class" /end CHARACTERISTIC
/begin CHARACTERISTIC FPsvr_FPP2V_TSC1 "FPrm_severity(666)" VALUE 0x00166078 /* @ECU_Address@FPrm_severity@0x024B329A@ */ ECIPP_ALIGNMENT_UBYTE 255 Compu_IDENTITY 0 255 PHYS_UNIT "Severity+Class" /end CHARACTERISTIC
/begin CHARACTERISTIC FPsvr_FPrly_coilopen "FPrm_severity(128)" VALUE 0x00165E5E /* @ECU_Address@FPrm_severity@0x024B3080@ */ ECIPP_ALIGNMENT_UBYTE 255 Compu_IDENTITY 0 255 PHYS_UNIT "Severity+Class" /end CHARACTERISTIC
/begin CHARACTERISTIC FPsvr_FPrly_coilshort "FPrm_severity(129)" VALUE 0x00165E5F /* @ECU_Address@FPrm_severity@0x024B3081@ */ ECIPP_ALIGNMENT_UBYTE 255 Compu_IDENTITY 0 255 PHYS_UNIT "Severity+Class" /end CHARACTERISTIC
/begin CHARACTERISTIC FPsvr_FPrly_gndshort "FPrm_severity(127)" VALUE 0x00165E5D /* @ECU_Address@FPrm_severity@0x024B307F@ */ ECIPP_ALIGNMENT_UBYTE 255 Compu_IDENTITY 0 255 PHYS_UNIT "Severity+Class" /end CHARACTERISTIC
/begin CHARACTERISTIC FPsvr_FSO_post_TPS_phi_hi "FPrm_severity(687)" VALUE 0x0016608D /* @ECU_Address@FPrm_severity@0x024B32AF@ */ ECIPP_ALIGNMENT_UBYTE 255 Compu_IDENTITY 0 255 PHYS_UNIT "Severity+Class" /end CHARACTERISTIC
/begin CHARACTERISTIC FPsvr_FSO_TPS_phi_hi "FPrm_severity(632)" VALUE 0x00166056 /* @ECU_Address@FPrm_severity@0x024B3278@ */ ECIPP_ALIGNMENT_UBYTE 255 Compu_IDENTITY 0 255 PHYS_UNIT "Severity+Class" /end CHARACTERISTIC
/begin CHARACTERISTIC FPsvr_FT_maxv "FPrm_severity(106)" VALUE 0x00165E48 /* @ECU_Address@FPrm_severity@0x024B306A@ */ ECIPP_ALIGNMENT_UBYTE 255 Compu_IDENTITY 0 255 PHYS_UNIT "Severity+Class" /end CHARACTERISTIC
/begin CHARACTERISTIC FPsvr_FT_minv "FPrm_severity(107)" VALUE 0x00165E49 /* @ECU_Address@FPrm_severity@0x024B306B@ */ ECIPP_ALIGNMENT_UBYTE 255 Compu_IDENTITY 0 255 PHYS_UNIT "Severity+Class" /end CHARACTERISTIC
/begin CHARACTERISTIC FPsvr_FTgasf_maxv "FPrm_severity(171)" VALUE 0x00165E89 /* @ECU_Address@FPrm_severity@0x024B30AB@ */ ECIPP_ALIGNMENT_UBYTE 255 Compu_IDENTITY 0 255 PHYS_UNIT "Severity+Class" /end CHARACTERISTIC
/begin CHARACTERISTIC FPsvr_FTgasf_minv "FPrm_severity(172)" VALUE 0x00165E8A /* @ECU_Address@FPrm_severity@0x024B30AC@ */ ECIPP_ALIGNMENT_UBYTE 255 Compu_IDENTITY 0 255 PHYS_UNIT "Severity+Class" /end CHARACTERISTIC
/begin CHARACTERISTIC FPsvr_GLOW_unit_fail "FPrm_severity(382)" VALUE 0x00165F5C /* @ECU_Address@FPrm_severity@0x024B317E@ */ ECIPP_ALIGNMENT_UBYTE 255 Compu_IDENTITY 0 255 PHYS_UNIT "Severity+Class" /end CHARACTERISTIC
/begin CHARACTERISTIC FPsvr_GLOW1_open "FPrm_severity(380)" VALUE 0x00165F5A /* @ECU_Address@FPrm_severity@0x024B317C@ */ ECIPP_ALIGNMENT_UBYTE 255 Compu_IDENTITY 0 255 PHYS_UNIT "Severity+Class" /end CHARACTERISTIC
/begin CHARACTERISTIC FPsvr_GLOW1_short "FPrm_severity(381)" VALUE 0x00165F5B /* @ECU_Address@FPrm_severity@0x024B317D@ */ ECIPP_ALIGNMENT_UBYTE 255 Compu_IDENTITY 0 255 PHYS_UNIT "Severity+Class" /end CHARACTERISTIC
/begin CHARACTERISTIC FPsvr_gov_ntrlock_fail "FPrm_severity(36)" VALUE 0x00165E02 /* @ECU_Address@FPrm_severity@0x024B3024@ */ ECIPP_ALIGNMENT_UBYTE 255 Compu_IDENTITY 0 255 PHYS_UNIT "Severity+Class" /end CHARACTERISTIC
/begin CHARACTERISTIC FPsvr_gyro_x_max "FPrm_severity(538)" VALUE 0x00165FF8 /* @ECU_Address@FPrm_severity@0x024B321A@ */ ECIPP_ALIGNMENT_UBYTE 255 Compu_IDENTITY 0 255 PHYS_UNIT "Severity+Class" /end CHARACTERISTIC
/begin CHARACTERISTIC FPsvr_gyro_x_min "FPrm_severity(539)" VALUE 0x00165FF9 /* @ECU_Address@FPrm_severity@0x024B321B@ */ ECIPP_ALIGNMENT_UBYTE 255 Compu_IDENTITY 0 255 PHYS_UNIT "Severity+Class" /end CHARACTERISTIC
/begin CHARACTERISTIC FPsvr_gyro_y_max "FPrm_severity(540)" VALUE 0x00165FFA /* @ECU_Address@FPrm_severity@0x024B321C@ */ ECIPP_ALIGNMENT_UBYTE 255 Compu_IDENTITY 0 255 PHYS_UNIT "Severity+Class" /end CHARACTERISTIC
/begin CHARACTERISTIC FPsvr_gyro_y_min "FPrm_severity(541)" VALUE 0x00165FFB /* @ECU_Address@FPrm_severity@0x024B321D@ */ ECIPP_ALIGNMENT_UBYTE 255 Compu_IDENTITY 0 255 PHYS_UNIT "Severity+Class" /end CHARACTERISTIC
/begin CHARACTERISTIC FPsvr_gyro_z_max "FPrm_severity(542)" VALUE 0x00165FFC /* @ECU_Address@FPrm_severity@0x024B321E@ */ ECIPP_ALIGNMENT_UBYTE 255 Compu_IDENTITY 0 255 PHYS_UNIT "Severity+Class" /end CHARACTERISTIC
/begin CHARACTERISTIC FPsvr_gyro_z_min "FPrm_severity(543)" VALUE 0x00165FFD /* @ECU_Address@FPrm_severity@0x024B321F@ */ ECIPP_ALIGNMENT_UBYTE 255 Compu_IDENTITY 0 255 PHYS_UNIT "Severity+Class" /end CHARACTERISTIC
/begin CHARACTERISTIC FPsvr_HBA_I_max "FPrm_severity(398)" VALUE 0x00165F6C /* @ECU_Address@FPrm_severity@0x024B318E@ */ ECIPP_ALIGNMENT_UBYTE 255 Compu_IDENTITY 0 255 PHYS_UNIT "Severity+Class" /end CHARACTERISTIC
/begin CHARACTERISTIC FPsvr_HBB_I_max "FPrm_severity(399)" VALUE 0x00165F6D /* @ECU_Address@FPrm_severity@0x024B318F@ */ ECIPP_ALIGNMENT_UBYTE 255 Compu_IDENTITY 0 255 PHYS_UNIT "Severity+Class" /end CHARACTERISTIC
/begin CHARACTERISTIC FPsvr_HiDiagTemp "FPrm_severity(482)" VALUE 0x00165FC0 /* @ECU_Address@FPrm_severity@0x024B31E2@ */ ECIPP_ALIGNMENT_UBYTE 255 Compu_IDENTITY 0 255 PHYS_UNIT "Severity+Class" /end CHARACTERISTIC
/begin CHARACTERISTIC FPsvr_HWID_fail "FPrm_severity(227)" VALUE 0x00165EC1 /* @ECU_Address@FPrm_severity@0x024B30E3@ */ ECIPP_ALIGNMENT_UBYTE 255 Compu_IDENTITY 0 255 PHYS_UNIT "Severity+Class" /end CHARACTERISTIC
/begin CHARACTERISTIC FPsvr_IAC_gndshort "FPrm_severity(116)" VALUE 0x00165E52 /* @ECU_Address@FPrm_severity@0x024B3074@ */ ECIPP_ALIGNMENT_UBYTE 255 Compu_IDENTITY 0 255 PHYS_UNIT "Severity+Class" /end CHARACTERISTIC
/begin CHARACTERISTIC FPsvr_IAC_openshort "FPrm_severity(117)" VALUE 0x00165E53 /* @ECU_Address@FPrm_severity@0x024B3075@ */ ECIPP_ALIGNMENT_UBYTE 255 Compu_IDENTITY 0 255 PHYS_UNIT "Severity+Class" /end CHARACTERISTIC
/begin CHARACTERISTIC FPsvr_IAT_HiExp "FPrm_severity(8)" VALUE 0x00165DE6 /* @ECU_Address@FPrm_severity@0x024B3008@ */ ECIPP_ALIGNMENT_UBYTE 255 Compu_IDENTITY 0 255 PHYS_UNIT "Severity+Class" /end CHARACTERISTIC
/begin CHARACTERISTIC FPsvr_IAT_HiExp2 "FPrm_severity(9)" VALUE 0x00165DE7 /* @ECU_Address@FPrm_severity@0x024B3009@ */ ECIPP_ALIGNMENT_UBYTE 255 Compu_IDENTITY 0 255 PHYS_UNIT "Severity+Class" /end CHARACTERISTIC
/begin CHARACTERISTIC FPsvr_IAT_maxv "FPrm_severity(6)" VALUE 0x00165DE4 /* @ECU_Address@FPrm_severity@0x024B3006@ */ ECIPP_ALIGNMENT_UBYTE 255 Compu_IDENTITY 0 255 PHYS_UNIT "Severity+Class" /end CHARACTERISTIC
/begin CHARACTERISTIC FPsvr_IAT_minv "FPrm_severity(7)" VALUE 0x00165DE5 /* @ECU_Address@FPrm_severity@0x024B3007@ */ ECIPP_ALIGNMENT_UBYTE 255 Compu_IDENTITY 0 255 PHYS_UNIT "Severity+Class" /end CHARACTERISTIC
/begin CHARACTERISTIC FPsvr_IBF_detected "FPrm_severity(688)" VALUE 0x0016608E /* @ECU_Address@FPrm_severity@0x024B32B0@ */ ECIPP_ALIGNMENT_UBYTE 255 Compu_IDENTITY 0 255 PHYS_UNIT "Severity+Class" /end CHARACTERISTIC
/begin CHARACTERISTIC FPsvr_ICam_maxerr "FPrm_severity(210)" VALUE 0x00165EB0 /* @ECU_Address@FPrm_severity@0x024B30D2@ */ ECIPP_ALIGNMENT_UBYTE 255 Compu_IDENTITY 0 255 PHYS_UNIT "Severity+Class" /end CHARACTERISTIC
/begin CHARACTERISTIC FPsvr_ICAVD1_mis "FPrm_severity(195)" VALUE 0x00165EA1 /* @ECU_Address@FPrm_severity@0x024B30C3@ */ ECIPP_ALIGNMENT_UBYTE 255 Compu_IDENTITY 0 255 PHYS_UNIT "Severity+Class" /end CHARACTERISTIC
/begin CHARACTERISTIC FPsvr_ICAVD1_miscat "FPrm_severity(196)" VALUE 0x00165EA2 /* @ECU_Address@FPrm_severity@0x024B30C4@ */ ECIPP_ALIGNMENT_UBYTE 255 Compu_IDENTITY 0 255 PHYS_UNIT "Severity+Class" /end CHARACTERISTIC
/begin CHARACTERISTIC FPsvr_Idle_SD "FPrm_severity(484)" VALUE 0x00165FC2 /* @ECU_Address@FPrm_severity@0x024B31E4@ */ ECIPP_ALIGNMENT_UBYTE 255 Compu_IDENTITY 0 255 PHYS_UNIT "Severity+Class" /end CHARACTERISTIC
/begin CHARACTERISTIC FPsvr_imu_general "FPrm_severity(529)" VALUE 0x00165FEF /* @ECU_Address@FPrm_severity@0x024B3211@ */ ECIPP_ALIGNMENT_UBYTE 255 Compu_IDENTITY 0 255 PHYS_UNIT "Severity+Class" /end CHARACTERISTIC
/begin CHARACTERISTIC FPsvr_imu_temp_max "FPrm_severity(530)" VALUE 0x00165FF0 /* @ECU_Address@FPrm_severity@0x024B3212@ */ ECIPP_ALIGNMENT_UBYTE 255 Compu_IDENTITY 0 255 PHYS_UNIT "Severity+Class" /end CHARACTERISTIC
/begin CHARACTERISTIC FPsvr_imu_temp_min "FPrm_severity(531)" VALUE 0x00165FF1 /* @ECU_Address@FPrm_severity@0x024B3213@ */ ECIPP_ALIGNMENT_UBYTE 255 Compu_IDENTITY 0 255 PHYS_UNIT "Severity+Class" /end CHARACTERISTIC
/begin CHARACTERISTIC FPsvr_IMVD_Ifb_hi "FPrm_severity(437)" VALUE 0x00165F93 /* @ECU_Address@FPrm_severity@0x024B31B5@ */ ECIPP_ALIGNMENT_UBYTE 255 Compu_IDENTITY 0 255 PHYS_UNIT "Severity+Class" /end CHARACTERISTIC
/begin CHARACTERISTIC FPsvr_IMVD_Ifb_lo "FPrm_severity(436)" VALUE 0x00165F92 /* @ECU_Address@FPrm_severity@0x024B31B4@ */ ECIPP_ALIGNMENT_UBYTE 255 Compu_IDENTITY 0 255 PHYS_UNIT "Severity+Class" /end CHARACTERISTIC
/begin CHARACTERISTIC FPsvr_INJD_boost_lo "FPrm_severity(434)" VALUE 0x00165F90 /* @ECU_Address@FPrm_severity@0x024B31B2@ */ ECIPP_ALIGNMENT_UBYTE 255 Compu_IDENTITY 0 255 PHYS_UNIT "Severity+Class" /end CHARACTERISTIC
/begin CHARACTERISTIC FPsvr_INJD_HS_Ihi "FPrm_severity(432)" VALUE 0x00165F8E /* @ECU_Address@FPrm_severity@0x024B31B0@ */ ECIPP_ALIGNMENT_UBYTE 255 Compu_IDENTITY 0 255 PHYS_UNIT "Severity+Class" /end CHARACTERISTIC
/begin CHARACTERISTIC FPsvr_INJD_HW_int "FPrm_severity(435)" VALUE 0x00165F91 /* @ECU_Address@FPrm_severity@0x024B31B3@ */ ECIPP_ALIGNMENT_UBYTE 255 Compu_IDENTITY 0 255 PHYS_UNIT "Severity+Class" /end CHARACTERISTIC
/begin CHARACTERISTIC FPsvr_INJD_LS_Ihi "FPrm_severity(433)" VALUE 0x00165F8F /* @ECU_Address@FPrm_severity@0x024B31B1@ */ ECIPP_ALIGNMENT_UBYTE 255 Compu_IDENTITY 0 255 PHYS_UNIT "Severity+Class" /end CHARACTERISTIC
/begin CHARACTERISTIC FPsvr_INJD_off_lo "FPrm_severity(53)" VALUE 0x00165E13 /* @ECU_Address@FPrm_severity@0x024B3035@ */ ECIPP_ALIGNMENT_UBYTE 255 Compu_IDENTITY 0 255 PHYS_UNIT "Severity+Class" /end CHARACTERISTIC
/begin CHARACTERISTIC FPsvr_INJD_on_hi "FPrm_severity(54)" VALUE 0x00165E14 /* @ECU_Address@FPrm_severity@0x024B3036@ */ ECIPP_ALIGNMENT_UBYTE 255 Compu_IDENTITY 0 255 PHYS_UNIT "Severity+Class" /end CHARACTERISTIC
/begin CHARACTERISTIC FPsvr_interrupt "FPrm_severity(68)" VALUE 0x00165E22 /* @ECU_Address@FPrm_severity@0x024B3044@ */ ECIPP_ALIGNMENT_UBYTE 255 Compu_IDENTITY 0 255 PHYS_UNIT "Severity+Class" /end CHARACTERISTIC
/begin CHARACTERISTIC FPsvr_J1939_AAT_err_loss "FPrm_severity(662)" VALUE 0x00166074 /* @ECU_Address@FPrm_severity@0x024B3296@ */ ECIPP_ALIGNMENT_UBYTE 255 Compu_IDENTITY 0 255 PHYS_UNIT "Severity+Class" /end CHARACTERISTIC
/begin CHARACTERISTIC FPsvr_J1939_addr2Fail "FPrm_severity(223)" VALUE 0x00165EBD /* @ECU_Address@FPrm_severity@0x024B30DF@ */ ECIPP_ALIGNMENT_UBYTE 255 Compu_IDENTITY 0 255 PHYS_UNIT "Severity+Class" /end CHARACTERISTIC
/begin CHARACTERISTIC FPsvr_J1939_addr3Fail "FPrm_severity(224)" VALUE 0x00165EBE /* @ECU_Address@FPrm_severity@0x024B30E0@ */ ECIPP_ALIGNMENT_UBYTE 255 Compu_IDENTITY 0 255 PHYS_UNIT "Severity+Class" /end CHARACTERISTIC
/begin CHARACTERISTIC FPsvr_J1939_addrFail "FPrm_severity(146)" VALUE 0x00165E70 /* @ECU_Address@FPrm_severity@0x024B3092@ */ ECIPP_ALIGNMENT_UBYTE 255 Compu_IDENTITY 0 255 PHYS_UNIT "Severity+Class" /end CHARACTERISTIC
/begin CHARACTERISTIC FPsvr_J1939_ETC_loss "FPrm_severity(175)" VALUE 0x00165E8D /* @ECU_Address@FPrm_severity@0x024B30AF@ */ ECIPP_ALIGNMENT_UBYTE 255 Compu_IDENTITY 0 255 PHYS_UNIT "Severity+Class" /end CHARACTERISTIC
/begin CHARACTERISTIC FPsvr_J1939_ETC_loss2 "FPrm_severity(197)" VALUE 0x00165EA3 /* @ECU_Address@FPrm_severity@0x024B30C5@ */ ECIPP_ALIGNMENT_UBYTE 255 Compu_IDENTITY 0 255 PHYS_UNIT "Severity+Class" /end CHARACTERISTIC
/begin CHARACTERISTIC FPsvr_J1939_PGN_tout "FPrm_severity(544)" VALUE 0x00165FFE /* @ECU_Address@FPrm_severity@0x024B3220@ */ ECIPP_ALIGNMENT_UBYTE 255 Compu_IDENTITY 0 255 PHYS_UNIT "Severity+Class" /end CHARACTERISTIC
/begin CHARACTERISTIC FPsvr_J1939_PGN_tout10 "FPrm_severity(553)" VALUE 0x00166007 /* @ECU_Address@FPrm_severity@0x024B3229@ */ ECIPP_ALIGNMENT_UBYTE 255 Compu_IDENTITY 0 255 PHYS_UNIT "Severity+Class" /end CHARACTERISTIC
/begin CHARACTERISTIC FPsvr_J1939_PGN_tout2 "FPrm_severity(545)" VALUE 0x00165FFF /* @ECU_Address@FPrm_severity@0x024B3221@ */ ECIPP_ALIGNMENT_UBYTE 255 Compu_IDENTITY 0 255 PHYS_UNIT "Severity+Class" /end CHARACTERISTIC
/begin CHARACTERISTIC FPsvr_J1939_PGN_tout3 "FPrm_severity(546)" VALUE 0x00166000 /* @ECU_Address@FPrm_severity@0x024B3222@ */ ECIPP_ALIGNMENT_UBYTE 255 Compu_IDENTITY 0 255 PHYS_UNIT "Severity+Class" /end CHARACTERISTIC
/begin CHARACTERISTIC FPsvr_J1939_PGN_tout4 "FPrm_severity(547)" VALUE 0x00166001 /* @ECU_Address@FPrm_severity@0x024B3223@ */ ECIPP_ALIGNMENT_UBYTE 255 Compu_IDENTITY 0 255 PHYS_UNIT "Severity+Class" /end CHARACTERISTIC
/begin CHARACTERISTIC FPsvr_J1939_PGN_tout5 "FPrm_severity(548)" VALUE 0x00166002 /* @ECU_Address@FPrm_severity@0x024B3224@ */ ECIPP_ALIGNMENT_UBYTE 255 Compu_IDENTITY 0 255 PHYS_UNIT "Severity+Class" /end CHARACTERISTIC
/begin CHARACTERISTIC FPsvr_J1939_PGN_tout6 "FPrm_severity(549)" VALUE 0x00166003 /* @ECU_Address@FPrm_severity@0x024B3225@ */ ECIPP_ALIGNMENT_UBYTE 255 Compu_IDENTITY 0 255 PHYS_UNIT "Severity+Class" /end CHARACTERISTIC
/begin CHARACTERISTIC FPsvr_J1939_PGN_tout7 "FPrm_severity(550)" VALUE 0x00166004 /* @ECU_Address@FPrm_severity@0x024B3226@ */ ECIPP_ALIGNMENT_UBYTE 255 Compu_IDENTITY 0 255 PHYS_UNIT "Severity+Class" /end CHARACTERISTIC
/begin CHARACTERISTIC FPsvr_J1939_PGN_tout8 "FPrm_severity(551)" VALUE 0x00166005 /* @ECU_Address@FPrm_severity@0x024B3227@ */ ECIPP_ALIGNMENT_UBYTE 255 Compu_IDENTITY 0 255 PHYS_UNIT "Severity+Class" /end CHARACTERISTIC
/begin CHARACTERISTIC FPsvr_J1939_PGN_tout9 "FPrm_severity(552)" VALUE 0x00166006 /* @ECU_Address@FPrm_severity@0x024B3228@ */ ECIPP_ALIGNMENT_UBYTE 255 Compu_IDENTITY 0 255 PHYS_UNIT "Severity+Class" /end CHARACTERISTIC
/begin CHARACTERISTIC FPsvr_J1939_RS_err_loss "FPrm_severity(661)" VALUE 0x00166073 /* @ECU_Address@FPrm_severity@0x024B3295@ */ ECIPP_ALIGNMENT_UBYTE 255 Compu_IDENTITY 0 255 PHYS_UNIT "Severity+Class" /end CHARACTERISTIC
/begin CHARACTERISTIC FPsvr_J1939_RSsetpt_loss "FPrm_severity(454)" VALUE 0x00165FA4 /* @ECU_Address@FPrm_severity@0x024B31C6@ */ ECIPP_ALIGNMENT_UBYTE 255 Compu_IDENTITY 0 255 PHYS_UNIT "Severity+Class" /end CHARACTERISTIC
/begin CHARACTERISTIC FPsvr_J1939_Rx2Fail "FPrm_severity(221)" VALUE 0x00165EBB /* @ECU_Address@FPrm_severity@0x024B30DD@ */ ECIPP_ALIGNMENT_UBYTE 255 Compu_IDENTITY 0 255 PHYS_UNIT "Severity+Class" /end CHARACTERISTIC
/begin CHARACTERISTIC FPsvr_J1939_Rx3Fail "FPrm_severity(222)" VALUE 0x00165EBC /* @ECU_Address@FPrm_severity@0x024B30DE@ */ ECIPP_ALIGNMENT_UBYTE 255 Compu_IDENTITY 0 255 PHYS_UNIT "Severity+Class" /end CHARACTERISTIC
/begin CHARACTERISTIC FPsw_ext1_FPP2_IVS_max "FPrm_switches_ext1(32)" VALUE 0x00146E7E /* @ECU_Address@FPrm_switches_ext1@0x023A5040@ */ ECIPP_ALIGNMENT_UWORD 65535 Compu_IDENTITY 0 65535 PHYS_UNIT "Enable bits" /end CHARACTERISTIC
/begin CHARACTERISTIC FPsw_ext1_FPP2_IVS_min "FPrm_switches_ext1(33)" VALUE 0x00146E80 /* @ECU_Address@FPrm_switches_ext1@0x023A5042@ */ ECIPP_ALIGNMENT_UWORD 65535 Compu_IDENTITY 0 65535 PHYS_UNIT "Enable bits" /end CHARACTERISTIC
/begin CHARACTERISTIC FPsw_ext1_FPP2_max "FPrm_switches_ext1(28)" VALUE 0x00146E76 /* @ECU_Address@FPrm_switches_ext1@0x023A5038@ */ ECIPP_ALIGNMENT_UWORD 65535 Compu_IDENTITY 0 65535 PHYS_UNIT "Enable bits" /end CHARACTERISTIC
/begin CHARACTERISTIC FPsw_ext1_FPP2_min "FPrm_switches_ext1(29)" VALUE 0x00146E78 /* @ECU_Address@FPrm_switches_ext1@0x023A503A@ */ ECIPP_ALIGNMENT_UWORD 65535 Compu_IDENTITY 0 65535 PHYS_UNIT "Enable bits" /end CHARACTERISTIC
/begin CHARACTERISTIC FPsw_ext1_FPP2V_TSC1 "FPrm_switches_ext1(666)" VALUE 0x00147372 /* @ECU_Address@FPrm_switches_ext1@0x023A5534@ */ ECIPP_ALIGNMENT_UWORD 65535 Compu_IDENTITY 0 65535 PHYS_UNIT "Enable bits" /end CHARACTERISTIC
/begin CHARACTERISTIC FPsw_ext1_FPrly_coilopen "FPrm_switches_ext1(128)" VALUE 0x00146F3E /* @ECU_Address@FPrm_switches_ext1@0x023A5100@ */ ECIPP_ALIGNMENT_UWORD 65535 Compu_IDENTITY 0 65535 PHYS_UNIT "Enable bits" /end CHARACTERISTIC
/begin CHARACTERISTIC FPsw_ext1_FPrly_coilshort "FPrm_switches_ext1(129)" VALUE 0x00146F40 /* @ECU_Address@FPrm_switches_ext1@0x023A5102@ */ ECIPP_ALIGNMENT_UWORD 65535 Compu_IDENTITY 0 65535 PHYS_UNIT "Enable bits" /end CHARACTERISTIC
/begin CHARACTERISTIC FPsw_ext1_FPrly_gndshort "FPrm_switches_ext1(127)" VALUE 0x00146F3C /* @ECU_Address@FPrm_switches_ext1@0x023A50FE@ */ ECIPP_ALIGNMENT_UWORD 65535 Compu_IDENTITY 0 65535 PHYS_UNIT "Enable bits" /end CHARACTERISTIC
/begin CHARACTERISTIC FPsw_ext1_FSO_post_TPS_phi_hi "FPrm_switches_ext1(687)" VALUE 0x0014739C /* @ECU_Address@FPrm_switches_ext1@0x023A555E@ */ ECIPP_ALIGNMENT_UWORD 65535 Compu_IDENTITY 0 65535 PHYS_UNIT "Enable bits" /end CHARACTERISTIC
/begin CHARACTERISTIC FPsw_ext1_FSO_TPS_phi_hi "FPrm_switches_ext1(632)" VALUE 0x0014732E /* @ECU_Address@FPrm_switches_ext1@0x023A54F0@ */ ECIPP_ALIGNMENT_UWORD 65535 Compu_IDENTITY 0 65535 PHYS_UNIT "Enable bits" /end CHARACTERISTIC
/begin CHARACTERISTIC FPsw_ext1_FT_maxv "FPrm_switches_ext1(106)" VALUE 0x00146F12 /* @ECU_Address@FPrm_switches_ext1@0x023A50D4@ */ ECIPP_ALIGNMENT_UWORD 65535 Compu_IDENTITY 0 65535 PHYS_UNIT "Enable bits" /end CHARACTERISTIC
/begin CHARACTERISTIC FPsw_ext1_FT_minv "FPrm_switches_ext1(107)" VALUE 0x00146F14 /* @ECU_Address@FPrm_switches_ext1@0x023A50D6@ */ ECIPP_ALIGNMENT_UWORD 65535 Compu_IDENTITY 0 65535 PHYS_UNIT "Enable bits" /end CHARACTERISTIC
/begin CHARACTERISTIC FPsw_ext1_FTgasf_maxv "FPrm_switches_ext1(171)" VALUE 0x00146F94 /* @ECU_Address@FPrm_switches_ext1@0x023A5156@ */ ECIPP_ALIGNMENT_UWORD 65535 Compu_IDENTITY 0 65535 PHYS_UNIT "Enable bits" /end CHARACTERISTIC
/begin CHARACTERISTIC FPsw_ext1_FTgasf_minv "FPrm_switches_ext1(172)" VALUE 0x00146F96 /* @ECU_Address@FPrm_switches_ext1@0x023A5158@ */ ECIPP_ALIGNMENT_UWORD 65535 Compu_IDENTITY 0 65535 PHYS_UNIT "Enable bits" /end CHARACTERISTIC
/begin CHARACTERISTIC FPsw_ext1_GLOW_unit_fail "FPrm_switches_ext1(382)" VALUE 0x0014713A /* @ECU_Address@FPrm_switches_ext1@0x023A52FC@ */ ECIPP_ALIGNMENT_UWORD 65535 Compu_IDENTITY 0 65535 PHYS_UNIT "Enable bits" /end CHARACTERISTIC
/begin CHARACTERISTIC FPsw_ext1_GLOW1_open "FPrm_switches_ext1(380)" VALUE 0x00147136 /* @ECU_Address@FPrm_switches_ext1@0x023A52F8@ */ ECIPP_ALIGNMENT_UWORD 65535 Compu_IDENTITY 0 65535 PHYS_UNIT "Enable bits" /end CHARACTERISTIC
/begin CHARACTERISTIC FPsw_ext1_GLOW1_short "FPrm_switches_ext1(381)" VALUE 0x00147138 /* @ECU_Address@FPrm_switches_ext1@0x023A52FA@ */ ECIPP_ALIGNMENT_UWORD 65535 Compu_IDENTITY 0 65535 PHYS_UNIT "Enable bits" /end CHARACTERISTIC
/begin CHARACTERISTIC FPsw_ext1_gov_ntrlock_fail "FPrm_switches_ext1(36)" VALUE 0x00146E86 /* @ECU_Address@FPrm_switches_ext1@0x023A5048@ */ ECIPP_ALIGNMENT_UWORD 65535 Compu_IDENTITY 0 65535 PHYS_UNIT "Enable bits" /end CHARACTERISTIC
/begin CHARACTERISTIC FPsw_ext1_gyro_x_max "FPrm_switches_ext1(538)" VALUE 0x00147272 /* @ECU_Address@FPrm_switches_ext1@0x023A5434@ */ ECIPP_ALIGNMENT_UWORD 65535 Compu_IDENTITY 0 65535 PHYS_UNIT "Enable bits" /end CHARACTERISTIC
/begin CHARACTERISTIC FPsw_ext1_gyro_x_min "FPrm_switches_ext1(539)" VALUE 0x00147274 /* @ECU_Address@FPrm_switches_ext1@0x023A5436@ */ ECIPP_ALIGNMENT_UWORD 65535 Compu_IDENTITY 0 65535 PHYS_UNIT "Enable bits" /end CHARACTERISTIC
/begin CHARACTERISTIC FPsw_ext1_gyro_y_max "FPrm_switches_ext1(540)" VALUE 0x00147276 /* @ECU_Address@FPrm_switches_ext1@0x023A5438@ */ ECIPP_ALIGNMENT_UWORD 65535 Compu_IDENTITY 0 65535 PHYS_UNIT "Enable bits" /end CHARACTERISTIC
/begin CHARACTERISTIC FPsw_ext1_gyro_y_min "FPrm_switches_ext1(541)" VALUE 0x00147278 /* @ECU_Address@FPrm_switches_ext1@0x023A543A@ */ ECIPP_ALIGNMENT_UWORD 65535 Compu_IDENTITY 0 65535 PHYS_UNIT "Enable bits" /end CHARACTERISTIC
/begin CHARACTERISTIC FPsw_ext1_gyro_z_max "FPrm_switches_ext1(542)" VALUE 0x0014727A /* @ECU_Address@FPrm_switches_ext1@0x023A543C@ */ ECIPP_ALIGNMENT_UWORD 65535 Compu_IDENTITY 0 65535 PHYS_UNIT "Enable bits" /end CHARACTERISTIC
/begin CHARACTERISTIC FPsw_ext1_gyro_z_min "FPrm_switches_ext1(543)" VALUE 0x0014727C /* @ECU_Address@FPrm_switches_ext1@0x023A543E@ */ ECIPP_ALIGNMENT_UWORD 65535 Compu_IDENTITY 0 65535 PHYS_UNIT "Enable bits" /end CHARACTERISTIC
/begin CHARACTERISTIC FPsw_ext1_HBA_I_max "FPrm_switches_ext1(398)" VALUE 0x0014715A /* @ECU_Address@FPrm_switches_ext1@0x023A531C@ */ ECIPP_ALIGNMENT_UWORD 65535 Compu_IDENTITY 0 65535 PHYS_UNIT "Enable bits" /end CHARACTERISTIC
/begin CHARACTERISTIC FPsw_ext1_HBB_I_max "FPrm_switches_ext1(399)" VALUE 0x0014715C /* @ECU_Address@FPrm_switches_ext1@0x023A531E@ */ ECIPP_ALIGNMENT_UWORD 65535 Compu_IDENTITY 0 65535 PHYS_UNIT "Enable bits" /end CHARACTERISTIC
/begin CHARACTERISTIC FPsw_ext1_HiDiagTemp "FPrm_switches_ext1(482)" VALUE 0x00147202 /* @ECU_Address@FPrm_switches_ext1@0x023A53C4@ */ ECIPP_ALIGNMENT_UWORD 65535 Compu_IDENTITY 0 65535 PHYS_UNIT "Enable bits" /end CHARACTERISTIC
/begin CHARACTERISTIC FPsw_ext1_HWID_fail "FPrm_switches_ext1(227)" VALUE 0x00147004 /* @ECU_Address@FPrm_switches_ext1@0x023A51C6@ */ ECIPP_ALIGNMENT_UWORD 65535 Compu_IDENTITY 0 65535 PHYS_UNIT "Enable bits" /end CHARACTERISTIC
/begin CHARACTERISTIC FPsw_ext1_IAC_gndshort "FPrm_switches_ext1(116)" VALUE 0x00146F26 /* @ECU_Address@FPrm_switches_ext1@0x023A50E8@ */ ECIPP_ALIGNMENT_UWORD 65535 Compu_IDENTITY 0 65535 PHYS_UNIT "Enable bits" /end CHARACTERISTIC
/begin CHARACTERISTIC FPsw_ext1_IAC_openshort "FPrm_switches_ext1(117)" VALUE 0x00146F28 /* @ECU_Address@FPrm_switches_ext1@0x023A50EA@ */ ECIPP_ALIGNMENT_UWORD 65535 Compu_IDENTITY 0 65535 PHYS_UNIT "Enable bits" /end CHARACTERISTIC
/begin CHARACTERISTIC FPsw_ext1_IAT_HiExp "FPrm_switches_ext1(8)" VALUE 0x00146E4E /* @ECU_Address@FPrm_switches_ext1@0x023A5010@ */ ECIPP_ALIGNMENT_UWORD 65535 Compu_IDENTITY 0 65535 PHYS_UNIT "Enable bits" /end CHARACTERISTIC
/begin CHARACTERISTIC FPsw_ext1_IAT_HiExp2 "FPrm_switches_ext1(9)" VALUE 0x00146E50 /* @ECU_Address@FPrm_switches_ext1@0x023A5012@ */ ECIPP_ALIGNMENT_UWORD 65535 Compu_IDENTITY 0 65535 PHYS_UNIT "Enable bits" /end CHARACTERISTIC
/begin CHARACTERISTIC FPsw_ext1_IAT_maxv "FPrm_switches_ext1(6)" VALUE 0x00146E4A /* @ECU_Address@FPrm_switches_ext1@0x023A500C@ */ ECIPP_ALIGNMENT_UWORD 65535 Compu_IDENTITY 0 65535 PHYS_UNIT "Enable bits" /end CHARACTERISTIC
/begin CHARACTERISTIC FPsw_ext1_IAT_minv "FPrm_switches_ext1(7)" VALUE 0x00146E4C /* @ECU_Address@FPrm_switches_ext1@0x023A500E@ */ ECIPP_ALIGNMENT_UWORD 65535 Compu_IDENTITY 0 65535 PHYS_UNIT "Enable bits" /end CHARACTERISTIC
/begin CHARACTERISTIC FPsw_ext1_IBF_detected "FPrm_switches_ext1(688)" VALUE 0x0014739E /* @ECU_Address@FPrm_switches_ext1@0x023A5560@ */ ECIPP_ALIGNMENT_UWORD 65535 Compu_IDENTITY 0 65535 PHYS_UNIT "Enable bits" /end CHARACTERISTIC
/begin CHARACTERISTIC FPsw_ext1_ICam_maxerr "FPrm_switches_ext1(210)" VALUE 0x00146FE2 /* @ECU_Address@FPrm_switches_ext1@0x023A51A4@ */ ECIPP_ALIGNMENT_UWORD 65535 Compu_IDENTITY 0 65535 PHYS_UNIT "Enable bits" /end CHARACTERISTIC
/begin CHARACTERISTIC FPsw_ext1_ICAVD1_mis "FPrm_switches_ext1(195)" VALUE 0x00146FC4 /* @ECU_Address@FPrm_switches_ext1@0x023A5186@ */ ECIPP_ALIGNMENT_UWORD 65535 Compu_IDENTITY 0 65535 PHYS_UNIT "Enable bits" /end CHARACTERISTIC
/begin CHARACTERISTIC FPsw_ext1_ICAVD1_miscat "FPrm_switches_ext1(196)" VALUE 0x00146FC6 /* @ECU_Address@FPrm_switches_ext1@0x023A5188@ */ ECIPP_ALIGNMENT_UWORD 65535 Compu_IDENTITY 0 65535 PHYS_UNIT "Enable bits" /end CHARACTERISTIC
/begin CHARACTERISTIC FPsw_ext1_Idle_SD "FPrm_switches_ext1(484)" VALUE 0x00147206 /* @ECU_Address@FPrm_switches_ext1@0x023A53C8@ */ ECIPP_ALIGNMENT_UWORD 65535 Compu_IDENTITY 0 65535 PHYS_UNIT "Enable bits" /end CHARACTERISTIC
/begin CHARACTERISTIC FPsw_ext1_imu_general "FPrm_switches_ext1(529)" VALUE 0x00147260 /* @ECU_Address@FPrm_switches_ext1@0x023A5422@ */ ECIPP_ALIGNMENT_UWORD 65535 Compu_IDENTITY 0 65535 PHYS_UNIT "Enable bits" /end CHARACTERISTIC
/begin CHARACTERISTIC FPsw_ext1_imu_temp_max "FPrm_switches_ext1(530)" VALUE 0x00147262 /* @ECU_Address@FPrm_switches_ext1@0x023A5424@ */ ECIPP_ALIGNMENT_UWORD 65535 Compu_IDENTITY 0 65535 PHYS_UNIT "Enable bits" /end CHARACTERISTIC
/begin CHARACTERISTIC FPsw_ext1_imu_temp_min "FPrm_switches_ext1(531)" VALUE 0x00147264 /* @ECU_Address@FPrm_switches_ext1@0x023A5426@ */ ECIPP_ALIGNMENT_UWORD 65535 Compu_IDENTITY 0 65535 PHYS_UNIT "Enable bits" /end CHARACTERISTIC
/begin CHARACTERISTIC FPsw_ext1_IMVD_Ifb_hi "FPrm_switches_ext1(437)" VALUE 0x001471A8 /* @ECU_Address@FPrm_switches_ext1@0x023A536A@ */ ECIPP_ALIGNMENT_UWORD 65535 Compu_IDENTITY 0 65535 PHYS_UNIT "Enable bits" /end CHARACTERISTIC
/begin CHARACTERISTIC FPsw_ext1_IMVD_Ifb_lo "FPrm_switches_ext1(436)" VALUE 0x001471A6 /* @ECU_Address@FPrm_switches_ext1@0x023A5368@ */ ECIPP_ALIGNMENT_UWORD 65535 Compu_IDENTITY 0 65535 PHYS_UNIT "Enable bits" /end CHARACTERISTIC
/begin CHARACTERISTIC FPsw_ext1_INJD_boost_lo "FPrm_switches_ext1(434)" VALUE 0x001471A2 /* @ECU_Address@FPrm_switches_ext1@0x023A5364@ */ ECIPP_ALIGNMENT_UWORD 65535 Compu_IDENTITY 0 65535 PHYS_UNIT "Enable bits" /end CHARACTERISTIC
/begin CHARACTERISTIC FPsw_ext1_INJD_HS_Ihi "FPrm_switches_ext1(432)" VALUE 0x0014719E /* @ECU_Address@FPrm_switches_ext1@0x023A5360@ */ ECIPP_ALIGNMENT_UWORD 65535 Compu_IDENTITY 0 65535 PHYS_UNIT "Enable bits" /end CHARACTERISTIC
/begin CHARACTERISTIC FPsw_ext1_INJD_HW_int "FPrm_switches_ext1(435)" VALUE 0x001471A4 /* @ECU_Address@FPrm_switches_ext1@0x023A5366@ */ ECIPP_ALIGNMENT_UWORD 65535 Compu_IDENTITY 0 65535 PHYS_UNIT "Enable bits" /end CHARACTERISTIC
/begin CHARACTERISTIC FPsw_ext1_INJD_LS_Ihi "FPrm_switches_ext1(433)" VALUE 0x001471A0 /* @ECU_Address@FPrm_switches_ext1@0x023A5362@ */ ECIPP_ALIGNMENT_UWORD 65535 Compu_IDENTITY 0 65535 PHYS_UNIT "Enable bits" /end CHARACTERISTIC
/begin CHARACTERISTIC FPsw_ext1_INJD_off_lo "FPrm_switches_ext1(53)" VALUE 0x00146EA8 /* @ECU_Address@FPrm_switches_ext1@0x023A506A@ */ ECIPP_ALIGNMENT_UWORD 65535 Compu_IDENTITY 0 65535 PHYS_UNIT "Enable bits" /end CHARACTERISTIC
/begin CHARACTERISTIC FPsw_ext1_INJD_on_hi "FPrm_switches_ext1(54)" VALUE 0x00146EAA /* @ECU_Address@FPrm_switches_ext1@0x023A506C@ */ ECIPP_ALIGNMENT_UWORD 65535 Compu_IDENTITY 0 65535 PHYS_UNIT "Enable bits" /end CHARACTERISTIC
/begin CHARACTERISTIC FPsw_ext1_interrupt "FPrm_switches_ext1(68)" VALUE 0x00146EC6 /* @ECU_Address@FPrm_switches_ext1@0x023A5088@ */ ECIPP_ALIGNMENT_UWORD 65535 Compu_IDENTITY 0 65535 PHYS_UNIT "Enable bits" /end CHARACTERISTIC
/begin CHARACTERISTIC FPsw_ext1_J1939_AAT_err_loss "FPrm_switches_ext1(662)" VALUE 0x0014736A /* @ECU_Address@FPrm_switches_ext1@0x023A552C@ */ ECIPP_ALIGNMENT_UWORD 65535 Compu_IDENTITY 0 65535 PHYS_UNIT "Enable bits" /end CHARACTERISTIC
/begin CHARACTERISTIC FPsw_ext1_J1939_addr2Fail "FPrm_switches_ext1(223)" VALUE 0x00146FFC /* @ECU_Address@FPrm_switches_ext1@0x023A51BE@ */ ECIPP_ALIGNMENT_UWORD 65535 Compu_IDENTITY 0 65535 PHYS_UNIT "Enable bits" /end CHARACTERISTIC
/begin CHARACTERISTIC FPsw_ext1_J1939_addr3Fail "FPrm_switches_ext1(224)" VALUE 0x00146FFE /* @ECU_Address@FPrm_switches_ext1@0x023A51C0@ */ ECIPP_ALIGNMENT_UWORD 65535 Compu_IDENTITY 0 65535 PHYS_UNIT "Enable bits" /end CHARACTERISTIC
/begin CHARACTERISTIC FPsw_ext1_J1939_addrFail "FPrm_switches_ext1(146)" VALUE 0x00146F62 /* @ECU_Address@FPrm_switches_ext1@0x023A5124@ */ ECIPP_ALIGNMENT_UWORD 65535 Compu_IDENTITY 0 65535 PHYS_UNIT "Enable bits" /end CHARACTERISTIC
/begin CHARACTERISTIC FPsw_ext1_J1939_ETC_loss "FPrm_switches_ext1(175)" VALUE 0x00146F9C /* @ECU_Address@FPrm_switches_ext1@0x023A515E@ */ ECIPP_ALIGNMENT_UWORD 65535 Compu_IDENTITY 0 65535 PHYS_UNIT "Enable bits" /end CHARACTERISTIC
/begin CHARACTERISTIC FPsw_ext1_J1939_ETC_loss2 "FPrm_switches_ext1(197)" VALUE 0x00146FC8 /* @ECU_Address@FPrm_switches_ext1@0x023A518A@ */ ECIPP_ALIGNMENT_UWORD 65535 Compu_IDENTITY 0 65535 PHYS_UNIT "Enable bits" /end CHARACTERISTIC
/begin CHARACTERISTIC FPsw_ext1_J1939_PGN_tout "FPrm_switches_ext1(544)" VALUE 0x0014727E /* @ECU_Address@FPrm_switches_ext1@0x023A5440@ */ ECIPP_ALIGNMENT_UWORD 65535 Compu_IDENTITY 0 65535 PHYS_UNIT "Enable bits" /end CHARACTERISTIC
/begin CHARACTERISTIC FPsw_ext1_J1939_PGN_tout10 "FPrm_switches_ext1(553)" VALUE 0x00147290 /* @ECU_Address@FPrm_switches_ext1@0x023A5452@ */ ECIPP_ALIGNMENT_UWORD 65535 Compu_IDENTITY 0 65535 PHYS_UNIT "Enable bits" /end CHARACTERISTIC
/begin CHARACTERISTIC FPsw_ext1_J1939_PGN_tout2 "FPrm_switches_ext1(545)" VALUE 0x00147280 /* @ECU_Address@FPrm_switches_ext1@0x023A5442@ */ ECIPP_ALIGNMENT_UWORD 65535 Compu_IDENTITY 0 65535 PHYS_UNIT "Enable bits" /end CHARACTERISTIC
/begin CHARACTERISTIC FPsw_ext1_J1939_PGN_tout3 "FPrm_switches_ext1(546)" VALUE 0x00147282 /* @ECU_Address@FPrm_switches_ext1@0x023A5444@ */ ECIPP_ALIGNMENT_UWORD 65535 Compu_IDENTITY 0 65535 PHYS_UNIT "Enable bits" /end CHARACTERISTIC
/begin CHARACTERISTIC FPsw_ext1_J1939_PGN_tout4 "FPrm_switches_ext1(547)" VALUE 0x00147284 /* @ECU_Address@FPrm_switches_ext1@0x023A5446@ */ ECIPP_ALIGNMENT_UWORD 65535 Compu_IDENTITY 0 65535 PHYS_UNIT "Enable bits" /end CHARACTERISTIC
/begin CHARACTERISTIC FPsw_ext1_J1939_PGN_tout5 "FPrm_switches_ext1(548)" VALUE 0x00147286 /* @ECU_Address@FPrm_switches_ext1@0x023A5448@ */ ECIPP_ALIGNMENT_UWORD 65535 Compu_IDENTITY 0 65535 PHYS_UNIT "Enable bits" /end CHARACTERISTIC
/begin CHARACTERISTIC FPsw_ext1_J1939_PGN_tout6 "FPrm_switches_ext1(549)" VALUE 0x00147288 /* @ECU_Address@FPrm_switches_ext1@0x023A544A@ */ ECIPP_ALIGNMENT_UWORD 65535 Compu_IDENTITY 0 65535 PHYS_UNIT "Enable bits" /end CHARACTERISTIC
/begin CHARACTERISTIC FPsw_ext1_J1939_PGN_tout7 "FPrm_switches_ext1(550)" VALUE 0x0014728A /* @ECU_Address@FPrm_switches_ext1@0x023A544C@ */ ECIPP_ALIGNMENT_UWORD 65535 Compu_IDENTITY 0 65535 PHYS_UNIT "Enable bits" /end CHARACTERISTIC
/begin CHARACTERISTIC FPsw_ext1_J1939_PGN_tout8 "FPrm_switches_ext1(551)" VALUE 0x0014728C /* @ECU_Address@FPrm_switches_ext1@0x023A544E@ */ ECIPP_ALIGNMENT_UWORD 65535 Compu_IDENTITY 0 65535 PHYS_UNIT "Enable bits" /end CHARACTERISTIC
/begin CHARACTERISTIC FPsw_ext1_J1939_PGN_tout9 "FPrm_switches_ext1(552)" VALUE 0x0014728E /* @ECU_Address@FPrm_switches_ext1@0x023A5450@ */ ECIPP_ALIGNMENT_UWORD 65535 Compu_IDENTITY 0 65535 PHYS_UNIT "Enable bits" /end CHARACTERISTIC
/begin CHARACTERISTIC FPsw_ext1_J1939_RS_err_loss "FPrm_switches_ext1(661)" VALUE 0x00147368 /* @ECU_Address@FPrm_switches_ext1@0x023A552A@ */ ECIPP_ALIGNMENT_UWORD 65535 Compu_IDENTITY 0 65535 PHYS_UNIT "Enable bits" /end CHARACTERISTIC
/begin CHARACTERISTIC FPsw_ext1_J1939_RSsetpt_loss "FPrm_switches_ext1(454)" VALUE 0x001471CA /* @ECU_Address@FPrm_switches_ext1@0x023A538C@ */ ECIPP_ALIGNMENT_UWORD 65535 Compu_IDENTITY 0 65535 PHYS_UNIT "Enable bits" /end CHARACTERISTIC
/begin CHARACTERISTIC FPsw_ext1_J1939_Rx2Fail "FPrm_switches_ext1(221)" VALUE 0x00146FF8 /* @ECU_Address@FPrm_switches_ext1@0x023A51BA@ */ ECIPP_ALIGNMENT_UWORD 65535 Compu_IDENTITY 0 65535 PHYS_UNIT "Enable bits" /end CHARACTERISTIC
/begin CHARACTERISTIC FPsw_ext1_J1939_Rx3Fail "FPrm_switches_ext1(222)" VALUE 0x00146FFA /* @ECU_Address@FPrm_switches_ext1@0x023A51BC@ */ ECIPP_ALIGNMENT_UWORD 65535 Compu_IDENTITY 0 65535 PHYS_UNIT "Enable bits" /end CHARACTERISTIC
/begin CHARACTERISTIC FPsw_FPP2_IVS_max "FPrm_switches(32)" VALUE 0x0014691C /* @ECU_Address@FPrm_switches@0x021B9040@ */ ECIPP_ALIGNMENT_UWORD 65535 Compu_IDENTITY 0 65535 PHYS_UNIT "Enable bits" /end CHARACTERISTIC
/begin CHARACTERISTIC FPsw_FPP2_IVS_min "FPrm_switches(33)" VALUE 0x0014691E /* @ECU_Address@FPrm_switches@0x021B9042@ */ ECIPP_ALIGNMENT_UWORD 65535 Compu_IDENTITY 0 65535 PHYS_UNIT "Enable bits" /end CHARACTERISTIC
/begin CHARACTERISTIC FPsw_FPP2_max "FPrm_switches(28)" VALUE 0x00146914 /* @ECU_Address@FPrm_switches@0x021B9038@ */ ECIPP_ALIGNMENT_UWORD 65535 Compu_IDENTITY 0 65535 PHYS_UNIT "Enable bits" /end CHARACTERISTIC
/begin CHARACTERISTIC FPsw_FPP2_min "FPrm_switches(29)" VALUE 0x00146916 /* @ECU_Address@FPrm_switches@0x021B903A@ */ ECIPP_ALIGNMENT_UWORD 65535 Compu_IDENTITY 0 65535 PHYS_UNIT "Enable bits" /end CHARACTERISTIC
/begin CHARACTERISTIC FPsw_FPP2V_TSC1 "FPrm_switches(666)" VALUE 0x00146E10 /* @ECU_Address@FPrm_switches@0x021B9534@ */ ECIPP_ALIGNMENT_UWORD 65535 Compu_IDENTITY 0 65535 PHYS_UNIT "Enable bits" /end CHARACTERISTIC
/begin CHARACTERISTIC FPsw_FPrly_coilopen "FPrm_switches(128)" VALUE 0x001469DC /* @ECU_Address@FPrm_switches@0x021B9100@ */ ECIPP_ALIGNMENT_UWORD 65535 Compu_IDENTITY 0 65535 PHYS_UNIT "Enable bits" /end CHARACTERISTIC
/begin CHARACTERISTIC FPsw_FPrly_coilshort "FPrm_switches(129)" VALUE 0x001469DE /* @ECU_Address@FPrm_switches@0x021B9102@ */ ECIPP_ALIGNMENT_UWORD 65535 Compu_IDENTITY 0 65535 PHYS_UNIT "Enable bits" /end CHARACTERISTIC
/begin CHARACTERISTIC FPsw_FPrly_gndshort "FPrm_switches(127)" VALUE 0x001469DA /* @ECU_Address@FPrm_switches@0x021B90FE@ */ ECIPP_ALIGNMENT_UWORD 65535 Compu_IDENTITY 0 65535 PHYS_UNIT "Enable bits" /end CHARACTERISTIC
/begin CHARACTERISTIC FPsw_FSO_post_TPS_phi_hi "FPrm_switches(687)" VALUE 0x00146E3A /* @ECU_Address@FPrm_switches@0x021B955E@ */ ECIPP_ALIGNMENT_UWORD 65535 Compu_IDENTITY 0 65535 PHYS_UNIT "Enable bits" /end CHARACTERISTIC
/begin CHARACTERISTIC FPsw_FSO_TPS_phi_hi "FPrm_switches(632)" VALUE 0x00146DCC /* @ECU_Address@FPrm_switches@0x021B94F0@ */ ECIPP_ALIGNMENT_UWORD 65535 Compu_IDENTITY 0 65535 PHYS_UNIT "Enable bits" /end CHARACTERISTIC
/begin CHARACTERISTIC FPsw_FT_maxv "FPrm_switches(106)" VALUE 0x001469B0 /* @ECU_Address@FPrm_switches@0x021B90D4@ */ ECIPP_ALIGNMENT_UWORD 65535 Compu_IDENTITY 0 65535 PHYS_UNIT "Enable bits" /end CHARACTERISTIC
/begin CHARACTERISTIC FPsw_FT_minv "FPrm_switches(107)" VALUE 0x001469B2 /* @ECU_Address@FPrm_switches@0x021B90D6@ */ ECIPP_ALIGNMENT_UWORD 65535 Compu_IDENTITY 0 65535 PHYS_UNIT "Enable bits" /end CHARACTERISTIC
/begin CHARACTERISTIC FPsw_FTgasf_maxv "FPrm_switches(171)" VALUE 0x00146A32 /* @ECU_Address@FPrm_switches@0x021B9156@ */ ECIPP_ALIGNMENT_UWORD 65535 Compu_IDENTITY 0 65535 PHYS_UNIT "Enable bits" /end CHARACTERISTIC
/begin CHARACTERISTIC FPsw_FTgasf_minv "FPrm_switches(172)" VALUE 0x00146A34 /* @ECU_Address@FPrm_switches@0x021B9158@ */ ECIPP_ALIGNMENT_UWORD 65535 Compu_IDENTITY 0 65535 PHYS_UNIT "Enable bits" /end CHARACTERISTIC
/begin CHARACTERISTIC FPsw_GLOW_unit_fail "FPrm_switches(382)" VALUE 0x00146BD8 /* @ECU_Address@FPrm_switches@0x021B92FC@ */ ECIPP_ALIGNMENT_UWORD 65535 Compu_IDENTITY 0 65535 PHYS_UNIT "Enable bits" /end CHARACTERISTIC
/begin CHARACTERISTIC FPsw_GLOW1_open "FPrm_switches(380)" VALUE 0x00146BD4 /* @ECU_Address@FPrm_switches@0x021B92F8@ */ ECIPP_ALIGNMENT_UWORD 65535 Compu_IDENTITY 0 65535 PHYS_UNIT "Enable bits" /end CHARACTERISTIC
/begin CHARACTERISTIC FPsw_GLOW1_short "FPrm_switches(381)" VALUE 0x00146BD6 /* @ECU_Address@FPrm_switches@0x021B92FA@ */ ECIPP_ALIGNMENT_UWORD 65535 Compu_IDENTITY 0 65535 PHYS_UNIT "Enable bits" /end CHARACTERISTIC
/begin CHARACTERISTIC FPsw_gov_ntrlock_fail "FPrm_switches(36)" VALUE 0x00146924 /* @ECU_Address@FPrm_switches@0x021B9048@ */ ECIPP_ALIGNMENT_UWORD 65535 Compu_IDENTITY 0 65535 PHYS_UNIT "Enable bits" /end CHARACTERISTIC
/begin CHARACTERISTIC FPsw_gyro_x_max "FPrm_switches(538)" VALUE 0x00146D10 /* @ECU_Address@FPrm_switches@0x021B9434@ */ ECIPP_ALIGNMENT_UWORD 65535 Compu_IDENTITY 0 65535 PHYS_UNIT "Enable bits" /end CHARACTERISTIC
/begin CHARACTERISTIC FPsw_gyro_x_min "FPrm_switches(539)" VALUE 0x00146D12 /* @ECU_Address@FPrm_switches@0x021B9436@ */ ECIPP_ALIGNMENT_UWORD 65535 Compu_IDENTITY 0 65535 PHYS_UNIT "Enable bits" /end CHARACTERISTIC
/begin CHARACTERISTIC FPsw_gyro_y_max "FPrm_switches(540)" VALUE 0x00146D14 /* @ECU_Address@FPrm_switches@0x021B9438@ */ ECIPP_ALIGNMENT_UWORD 65535 Compu_IDENTITY 0 65535 PHYS_UNIT "Enable bits" /end CHARACTERISTIC
/begin CHARACTERISTIC FPsw_gyro_y_min "FPrm_switches(541)" VALUE 0x00146D16 /* @ECU_Address@FPrm_switches@0x021B943A@ */ ECIPP_ALIGNMENT_UWORD 65535 Compu_IDENTITY 0 65535 PHYS_UNIT "Enable bits" /end CHARACTERISTIC
/begin CHARACTERISTIC FPsw_gyro_z_max "FPrm_switches(542)" VALUE 0x00146D18 /* @ECU_Address@FPrm_switches@0x021B943C@ */ ECIPP_ALIGNMENT_UWORD 65535 Compu_IDENTITY 0 65535 PHYS_UNIT "Enable bits" /end CHARACTERISTIC
/begin CHARACTERISTIC FPsw_gyro_z_min "FPrm_switches(543)" VALUE 0x00146D1A /* @ECU_Address@FPrm_switches@0x021B943E@ */ ECIPP_ALIGNMENT_UWORD 65535 Compu_IDENTITY 0 65535 PHYS_UNIT "Enable bits" /end CHARACTERISTIC
/begin CHARACTERISTIC FPsw_HBA_I_max "FPrm_switches(398)" VALUE 0x00146BF8 /* @ECU_Address@FPrm_switches@0x021B931C@ */ ECIPP_ALIGNMENT_UWORD 65535 Compu_IDENTITY 0 65535 PHYS_UNIT "Enable bits" /end CHARACTERISTIC
/begin CHARACTERISTIC FPsw_HBB_I_max "FPrm_switches(399)" VALUE 0x00146BFA /* @ECU_Address@FPrm_switches@0x021B931E@ */ ECIPP_ALIGNMENT_UWORD 65535 Compu_IDENTITY 0 65535 PHYS_UNIT "Enable bits" /end CHARACTERISTIC
/begin CHARACTERISTIC FPsw_HiDiagTemp "FPrm_switches(482)" VALUE 0x00146CA0 /* @ECU_Address@FPrm_switches@0x021B93C4@ */ ECIPP_ALIGNMENT_UWORD 65535 Compu_IDENTITY 0 65535 PHYS_UNIT "Enable bits" /end CHARACTERISTIC
/begin CHARACTERISTIC FPsw_HWID_fail "FPrm_switches(227)" VALUE 0x00146AA2 /* @ECU_Address@FPrm_switches@0x021B91C6@ */ ECIPP_ALIGNMENT_UWORD 65535 Compu_IDENTITY 0 65535 PHYS_UNIT "Enable bits" /end CHARACTERISTIC
/begin CHARACTERISTIC FPsw_IAC_gndshort "FPrm_switches(116)" VALUE 0x001469C4 /* @ECU_Address@FPrm_switches@0x021B90E8@ */ ECIPP_ALIGNMENT_UWORD 65535 Compu_IDENTITY 0 65535 PHYS_UNIT "Enable bits" /end CHARACTERISTIC
/begin CHARACTERISTIC FPsw_IAC_openshort "FPrm_switches(117)" VALUE 0x001469C6 /* @ECU_Address@FPrm_switches@0x021B90EA@ */ ECIPP_ALIGNMENT_UWORD 65535 Compu_IDENTITY 0 65535 PHYS_UNIT "Enable bits" /end CHARACTERISTIC
/begin CHARACTERISTIC FPsw_IAT_HiExp "FPrm_switches(8)" VALUE 0x001468EC /* @ECU_Address@FPrm_switches@0x021B9010@ */ ECIPP_ALIGNMENT_UWORD 65535 Compu_IDENTITY 0 65535 PHYS_UNIT "Enable bits" /end CHARACTERISTIC
/begin CHARACTERISTIC FPsw_IAT_HiExp2 "FPrm_switches(9)" VALUE 0x001468EE /* @ECU_Address@FPrm_switches@0x021B9012@ */ ECIPP_ALIGNMENT_UWORD 65535 Compu_IDENTITY 0 65535 PHYS_UNIT "Enable bits" /end CHARACTERISTIC
/begin CHARACTERISTIC FPsw_IAT_maxv "FPrm_switches(6)" VALUE 0x001468E8 /* @ECU_Address@FPrm_switches@0x021B900C@ */ ECIPP_ALIGNMENT_UWORD 65535 Compu_IDENTITY 0 65535 PHYS_UNIT "Enable bits" /end CHARACTERISTIC
/begin CHARACTERISTIC FPsw_IAT_minv "FPrm_switches(7)" VALUE 0x001468EA /* @ECU_Address@FPrm_switches@0x021B900E@ */ ECIPP_ALIGNMENT_UWORD 65535 Compu_IDENTITY 0 65535 PHYS_UNIT "Enable bits" /end CHARACTERISTIC
/begin CHARACTERISTIC FPsw_IBF_detected "FPrm_switches(688)" VALUE 0x00146E3C /* @ECU_Address@FPrm_switches@0x021B9560@ */ ECIPP_ALIGNMENT_UWORD 65535 Compu_IDENTITY 0 65535 PHYS_UNIT "Enable bits" /end CHARACTERISTIC
/begin CHARACTERISTIC FPsw_ICam_maxerr "FPrm_switches(210)" VALUE 0x00146A80 /* @ECU_Address@FPrm_switches@0x021B91A4@ */ ECIPP_ALIGNMENT_UWORD 65535 Compu_IDENTITY 0 65535 PHYS_UNIT "Enable bits" /end CHARACTERISTIC
/begin CHARACTERISTIC FPsw_ICAVD1_mis "FPrm_switches(195)" VALUE 0x00146A62 /* @ECU_Address@FPrm_switches@0x021B9186@ */ ECIPP_ALIGNMENT_UWORD 65535 Compu_IDENTITY 0 65535 PHYS_UNIT "Enable bits" /end CHARACTERISTIC
/begin CHARACTERISTIC FPsw_ICAVD1_miscat "FPrm_switches(196)" VALUE 0x00146A64 /* @ECU_Address@FPrm_switches@0x021B9188@ */ ECIPP_ALIGNMENT_UWORD 65535 Compu_IDENTITY 0 65535 PHYS_UNIT "Enable bits" /end CHARACTERISTIC
/begin CHARACTERISTIC FPsw_Idle_SD "FPrm_switches(484)" VALUE 0x00146CA4 /* @ECU_Address@FPrm_switches@0x021B93C8@ */ ECIPP_ALIGNMENT_UWORD 65535 Compu_IDENTITY 0 65535 PHYS_UNIT "Enable bits" /end CHARACTERISTIC
/begin CHARACTERISTIC FPsw_imu_general "FPrm_switches(529)" VALUE 0x00146CFE /* @ECU_Address@FPrm_switches@0x021B9422@ */ ECIPP_ALIGNMENT_UWORD 65535 Compu_IDENTITY 0 65535 PHYS_UNIT "Enable bits" /end CHARACTERISTIC
/begin CHARACTERISTIC FPsw_imu_temp_max "FPrm_switches(530)" VALUE 0x00146D00 /* @ECU_Address@FPrm_switches@0x021B9424@ */ ECIPP_ALIGNMENT_UWORD 65535 Compu_IDENTITY 0 65535 PHYS_UNIT "Enable bits" /end CHARACTERISTIC
/begin CHARACTERISTIC FPsw_imu_temp_min "FPrm_switches(531)" VALUE 0x00146D02 /* @ECU_Address@FPrm_switches@0x021B9426@ */ ECIPP_ALIGNMENT_UWORD 65535 Compu_IDENTITY 0 65535 PHYS_UNIT "Enable bits" /end CHARACTERISTIC
/begin CHARACTERISTIC FPsw_IMVD_Ifb_hi "FPrm_switches(437)" VALUE 0x00146C46 /* @ECU_Address@FPrm_switches@0x021B936A@ */ ECIPP_ALIGNMENT_UWORD 65535 Compu_IDENTITY 0 65535 PHYS_UNIT "Enable bits" /end CHARACTERISTIC
/begin CHARACTERISTIC FPsw_IMVD_Ifb_lo "FPrm_switches(436)" VALUE 0x00146C44 /* @ECU_Address@FPrm_switches@0x021B9368@ */ ECIPP_ALIGNMENT_UWORD 65535 Compu_IDENTITY 0 65535 PHYS_UNIT "Enable bits" /end CHARACTERISTIC
/begin CHARACTERISTIC FPsw_INJD_boost_lo "FPrm_switches(434)" VALUE 0x00146C40 /* @ECU_Address@FPrm_switches@0x021B9364@ */ ECIPP_ALIGNMENT_UWORD 65535 Compu_IDENTITY 0 65535 PHYS_UNIT "Enable bits" /end CHARACTERISTIC
/begin CHARACTERISTIC FPsw_INJD_HS_Ihi "FPrm_switches(432)" VALUE 0x00146C3C /* @ECU_Address@FPrm_switches@0x021B9360@ */ ECIPP_ALIGNMENT_UWORD 65535 Compu_IDENTITY 0 65535 PHYS_UNIT "Enable bits" /end CHARACTERISTIC
/begin CHARACTERISTIC FPsw_INJD_HW_int "FPrm_switches(435)" VALUE 0x00146C42 /* @ECU_Address@FPrm_switches@0x021B9366@ */ ECIPP_ALIGNMENT_UWORD 65535 Compu_IDENTITY 0 65535 PHYS_UNIT "Enable bits" /end CHARACTERISTIC
/begin CHARACTERISTIC FPsw_INJD_LS_Ihi "FPrm_switches(433)" VALUE 0x00146C3E /* @ECU_Address@FPrm_switches@0x021B9362@ */ ECIPP_ALIGNMENT_UWORD 65535 Compu_IDENTITY 0 65535 PHYS_UNIT "Enable bits" /end CHARACTERISTIC
/begin CHARACTERISTIC FPsw_INJD_off_lo "FPrm_switches(53)" VALUE 0x00146946 /* @ECU_Address@FPrm_switches@0x021B906A@ */ ECIPP_ALIGNMENT_UWORD 65535 Compu_IDENTITY 0 65535 PHYS_UNIT "Enable bits" /end CHARACTERISTIC
/begin CHARACTERISTIC FPsw_INJD_on_hi "FPrm_switches(54)" VALUE 0x00146948 /* @ECU_Address@FPrm_switches@0x021B906C@ */ ECIPP_ALIGNMENT_UWORD 65535 Compu_IDENTITY 0 65535 PHYS_UNIT "Enable bits" /end CHARACTERISTIC
/begin CHARACTERISTIC FPsw_interrupt "FPrm_switches(68)" VALUE 0x00146964 /* @ECU_Address@FPrm_switches@0x021B9088@ */ ECIPP_ALIGNMENT_UWORD 65535 Compu_IDENTITY 0 65535 PHYS_UNIT "Enable bits" /end CHARACTERISTIC
/begin CHARACTERISTIC FPsw_J1939_AAT_err_loss "FPrm_switches(662)" VALUE 0x00146E08 /* @ECU_Address@FPrm_switches@0x021B952C@ */ ECIPP_ALIGNMENT_UWORD 65535 Compu_IDENTITY 0 65535 PHYS_UNIT "Enable bits" /end CHARACTERISTIC
/begin CHARACTERISTIC FPsw_J1939_addr2Fail "FPrm_switches(223)" VALUE 0x00146A9A /* @ECU_Address@FPrm_switches@0x021B91BE@ */ ECIPP_ALIGNMENT_UWORD 65535 Compu_IDENTITY 0 65535 PHYS_UNIT "Enable bits" /end CHARACTERISTIC
/begin CHARACTERISTIC FPsw_J1939_addr3Fail "FPrm_switches(224)" VALUE 0x00146A9C /* @ECU_Address@FPrm_switches@0x021B91C0@ */ ECIPP_ALIGNMENT_UWORD 65535 Compu_IDENTITY 0 65535 PHYS_UNIT "Enable bits" /end CHARACTERISTIC
/begin CHARACTERISTIC FPsw_J1939_addrFail "FPrm_switches(146)" VALUE 0x00146A00 /* @ECU_Address@FPrm_switches@0x021B9124@ */ ECIPP_ALIGNMENT_UWORD 65535 Compu_IDENTITY 0 65535 PHYS_UNIT "Enable bits" /end CHARACTERISTIC
/begin CHARACTERISTIC FPsw_J1939_ETC_loss "FPrm_switches(175)" VALUE 0x00146A3A /* @ECU_Address@FPrm_switches@0x021B915E@ */ ECIPP_ALIGNMENT_UWORD 65535 Compu_IDENTITY 0 65535 PHYS_UNIT "Enable bits" /end CHARACTERISTIC
/begin CHARACTERISTIC FPsw_J1939_ETC_loss2 "FPrm_switches(197)" VALUE 0x00146A66 /* @ECU_Address@FPrm_switches@0x021B918A@ */ ECIPP_ALIGNMENT_UWORD 65535 Compu_IDENTITY 0 65535 PHYS_UNIT "Enable bits" /end CHARACTERISTIC
/begin CHARACTERISTIC FPsw_J1939_PGN_tout "FPrm_switches(544)" VALUE 0x00146D1C /* @ECU_Address@FPrm_switches@0x021B9440@ */ ECIPP_ALIGNMENT_UWORD 65535 Compu_IDENTITY 0 65535 PHYS_UNIT "Enable bits" /end CHARACTERISTIC
/begin CHARACTERISTIC FPsw_J1939_PGN_tout10 "FPrm_switches(553)" VALUE 0x00146D2E /* @ECU_Address@FPrm_switches@0x021B9452@ */ ECIPP_ALIGNMENT_UWORD 65535 Compu_IDENTITY 0 65535 PHYS_UNIT "Enable bits" /end CHARACTERISTIC
/begin CHARACTERISTIC FPsw_J1939_PGN_tout2 "FPrm_switches(545)" VALUE 0x00146D1E /* @ECU_Address@FPrm_switches@0x021B9442@ */ ECIPP_ALIGNMENT_UWORD 65535 Compu_IDENTITY 0 65535 PHYS_UNIT "Enable bits" /end CHARACTERISTIC
/begin CHARACTERISTIC FPsw_J1939_PGN_tout3 "FPrm_switches(546)" VALUE 0x00146D20 /* @ECU_Address@FPrm_switches@0x021B9444@ */ ECIPP_ALIGNMENT_UWORD 65535 Compu_IDENTITY 0 65535 PHYS_UNIT "Enable bits" /end CHARACTERISTIC
/begin CHARACTERISTIC FPsw_J1939_PGN_tout4 "FPrm_switches(547)" VALUE 0x00146D22 /* @ECU_Address@FPrm_switches@0x021B9446@ */ ECIPP_ALIGNMENT_UWORD 65535 Compu_IDENTITY 0 65535 PHYS_UNIT "Enable bits" /end CHARACTERISTIC
/begin CHARACTERISTIC FPsw_J1939_PGN_tout5 "FPrm_switches(548)" VALUE 0x00146D24 /* @ECU_Address@FPrm_switches@0x021B9448@ */ ECIPP_ALIGNMENT_UWORD 65535 Compu_IDENTITY 0 65535 PHYS_UNIT "Enable bits" /end CHARACTERISTIC
/begin CHARACTERISTIC FPsw_J1939_PGN_tout6 "FPrm_switches(549)" VALUE 0x00146D26 /* @ECU_Address@FPrm_switches@0x021B944A@ */ ECIPP_ALIGNMENT_UWORD 65535 Compu_IDENTITY 0 65535 PHYS_UNIT "Enable bits" /end CHARACTERISTIC
/begin CHARACTERISTIC FPsw_J1939_PGN_tout7 "FPrm_switches(550)" VALUE 0x00146D28 /* @ECU_Address@FPrm_switches@0x021B944C@ */ ECIPP_ALIGNMENT_UWORD 65535 Compu_IDENTITY 0 65535 PHYS_UNIT "Enable bits" /end CHARACTERISTIC
/begin CHARACTERISTIC FPsw_J1939_PGN_tout8 "FPrm_switches(551)" VALUE 0x00146D2A /* @ECU_Address@FPrm_switches@0x021B944E@ */ ECIPP_ALIGNMENT_UWORD 65535 Compu_IDENTITY 0 65535 PHYS_UNIT "Enable bits" /end CHARACTERISTIC
/begin CHARACTERISTIC FPsw_J1939_PGN_tout9 "FPrm_switches(552)" VALUE 0x00146D2C /* @ECU_Address@FPrm_switches@0x021B9450@ */ ECIPP_ALIGNMENT_UWORD 65535 Compu_IDENTITY 0 65535 PHYS_UNIT "Enable bits" /end CHARACTERISTIC
/begin CHARACTERISTIC FPsw_J1939_RS_err_loss "FPrm_switches(661)" VALUE 0x00146E06 /* @ECU_Address@FPrm_switches@0x021B952A@ */ ECIPP_ALIGNMENT_UWORD 65535 Compu_IDENTITY 0 65535 PHYS_UNIT "Enable bits" /end CHARACTERISTIC
/begin CHARACTERISTIC FPsw_J1939_RSsetpt_loss "FPrm_switches(454)" VALUE 0x00146C68 /* @ECU_Address@FPrm_switches@0x021B938C@ */ ECIPP_ALIGNMENT_UWORD 65535 Compu_IDENTITY 0 65535 PHYS_UNIT "Enable bits" /end CHARACTERISTIC
/begin CHARACTERISTIC FPsw_J1939_Rx2Fail "FPrm_switches(221)" VALUE 0x00146A96 /* @ECU_Address@FPrm_switches@0x021B91BA@ */ ECIPP_ALIGNMENT_UWORD 65535 Compu_IDENTITY 0 65535 PHYS_UNIT "Enable bits" /end CHARACTERISTIC
/begin CHARACTERISTIC FPsw_J1939_Rx3Fail "FPrm_switches(222)" VALUE 0x00146A98 /* @ECU_Address@FPrm_switches@0x021B91BC@ */ ECIPP_ALIGNMENT_UWORD 65535 Compu_IDENTITY 0 65535 PHYS_UNIT "Enable bits" /end CHARACTERISTIC
/begin CHARACTERISTIC FCdtc_FPP2_IVS_max "FCtl_DTC(25)" VALUE 0x00163546 /* @ECU_Address@FCtl_DTC@0x021B5032@ */ ECIPP_ALIGNMENT_UWORD 65535 Compu_IDENTITY 0 65535 PHYS_UNIT "DTC" /end CHARACTERISTIC
/begin CHARACTERISTIC FCdtc_FPP2_IVS_min "FCtl_DTC(26)" VALUE 0x00163548 /* @ECU_Address@FCtl_DTC@0x021B5034@ */ ECIPP_ALIGNMENT_UWORD 65535 Compu_IDENTITY 0 65535 PHYS_UNIT "DTC" /end CHARACTERISTIC
/begin CHARACTERISTIC FCdtc_FPP2_max "FCtl_DTC(21)" VALUE 0x0016353E /* @ECU_Address@FCtl_DTC@0x021B502A@ */ ECIPP_ALIGNMENT_UWORD 65535 Compu_IDENTITY 0 65535 PHYS_UNIT "DTC" /end CHARACTERISTIC
/begin CHARACTERISTIC FCdtc_FPP2_min "FCtl_DTC(22)" VALUE 0x00163540 /* @ECU_Address@FCtl_DTC@0x021B502C@ */ ECIPP_ALIGNMENT_UWORD 65535 Compu_IDENTITY 0 65535 PHYS_UNIT "DTC" /end CHARACTERISTIC
/begin CHARACTERISTIC FCdtc_FPP2V_TSC1 "FCtl_DTC(839)" VALUE 0x00163BA2 /* @ECU_Address@FCtl_DTC@0x021B568E@ */ ECIPP_ALIGNMENT_UWORD 65535 Compu_IDENTITY 0 65535 PHYS_UNIT "DTC" /end CHARACTERISTIC
/begin CHARACTERISTIC FCdtc_FPrly_coilopen "FCtl_DTC(168)" VALUE 0x00163664 /* @ECU_Address@FCtl_DTC@0x021B5150@ */ ECIPP_ALIGNMENT_UWORD 65535 Compu_IDENTITY 0 65535 PHYS_UNIT "DTC" /end CHARACTERISTIC
/begin CHARACTERISTIC FCdtc_FPrly_coilshort "FCtl_DTC(169)" VALUE 0x00163666 /* @ECU_Address@FCtl_DTC@0x021B5152@ */ ECIPP_ALIGNMENT_UWORD 65535 Compu_IDENTITY 0 65535 PHYS_UNIT "DTC" /end CHARACTERISTIC
/begin CHARACTERISTIC FCdtc_FPrly_gndshort "FCtl_DTC(167)" VALUE 0x00163662 /* @ECU_Address@FCtl_DTC@0x021B514E@ */ ECIPP_ALIGNMENT_UWORD 65535 Compu_IDENTITY 0 65535 PHYS_UNIT "DTC" /end CHARACTERISTIC
/begin CHARACTERISTIC FCdtc_FSO_post_TPS_phi_hi "FCtl_DTC(860)" VALUE 0x00163BCC /* @ECU_Address@FCtl_DTC@0x021B56B8@ */ ECIPP_ALIGNMENT_UWORD 65535 Compu_IDENTITY 0 65535 PHYS_UNIT "DTC" /end CHARACTERISTIC
/begin CHARACTERISTIC FCdtc_FSO_TPS_phi_hi "FCtl_DTC(803)" VALUE 0x00163B5A /* @ECU_Address@FCtl_DTC@0x021B5646@ */ ECIPP_ALIGNMENT_UWORD 65535 Compu_IDENTITY 0 65535 PHYS_UNIT "DTC" /end CHARACTERISTIC
/begin CHARACTERISTIC FCdtc_FT_maxv "FCtl_DTC(146)" VALUE 0x00163638 /* @ECU_Address@FCtl_DTC@0x021B5124@ */ ECIPP_ALIGNMENT_UWORD 65535 Compu_IDENTITY 0 65535 PHYS_UNIT "DTC" /end CHARACTERISTIC
/begin CHARACTERISTIC FCdtc_FT_minv "FCtl_DTC(147)" VALUE 0x0016363A /* @ECU_Address@FCtl_DTC@0x021B5126@ */ ECIPP_ALIGNMENT_UWORD 65535 Compu_IDENTITY 0 65535 PHYS_UNIT "DTC" /end CHARACTERISTIC
/begin CHARACTERISTIC FCdtc_FTgasf_maxv "FCtl_DTC(215)" VALUE 0x001636C2 /* @ECU_Address@FCtl_DTC@0x021B51AE@ */ ECIPP_ALIGNMENT_UWORD 65535 Compu_IDENTITY 0 65535 PHYS_UNIT "DTC" /end CHARACTERISTIC
/begin CHARACTERISTIC FCdtc_FTgasf_minv "FCtl_DTC(216)" VALUE 0x001636C4 /* @ECU_Address@FCtl_DTC@0x021B51B0@ */ ECIPP_ALIGNMENT_UWORD 65535 Compu_IDENTITY 0 65535 PHYS_UNIT "DTC" /end CHARACTERISTIC
/begin CHARACTERISTIC FCdtc_GLOW_unit_fail "FCtl_DTC(503)" VALUE 0x00163902 /* @ECU_Address@FCtl_DTC@0x021B53EE@ */ ECIPP_ALIGNMENT_UWORD 65535 Compu_IDENTITY 0 65535 PHYS_UNIT "DTC" /end CHARACTERISTIC
/begin CHARACTERISTIC FCdtc_GLOW1_open "FCtl_DTC(483)" VALUE 0x001638DA /* @ECU_Address@FCtl_DTC@0x021B53C6@ */ ECIPP_ALIGNMENT_UWORD 65535 Compu_IDENTITY 0 65535 PHYS_UNIT "DTC" /end CHARACTERISTIC
/begin CHARACTERISTIC FCdtc_GLOW1_short "FCtl_DTC(493)" VALUE 0x001638EE /* @ECU_Address@FCtl_DTC@0x021B53DA@ */ ECIPP_ALIGNMENT_UWORD 65535 Compu_IDENTITY 0 65535 PHYS_UNIT "DTC" /end CHARACTERISTIC
/begin CHARACTERISTIC FCdtc_gov_ntrlock_fail "FCtl_DTC(92)" VALUE 0x001635CC /* @ECU_Address@FCtl_DTC@0x021B50B8@ */ ECIPP_ALIGNMENT_UWORD 65535 Compu_IDENTITY 0 65535 PHYS_UNIT "DTC" /end CHARACTERISTIC
/begin CHARACTERISTIC FCdtc_gyro_x_max "FCtl_DTC(708)" VALUE 0x00163A9C /* @ECU_Address@FCtl_DTC@0x021B5588@ */ ECIPP_ALIGNMENT_UWORD 65535 Compu_IDENTITY 0 65535 PHYS_UNIT "DTC" /end CHARACTERISTIC
/begin CHARACTERISTIC FCdtc_gyro_x_min "FCtl_DTC(709)" VALUE 0x00163A9E /* @ECU_Address@FCtl_DTC@0x021B558A@ */ ECIPP_ALIGNMENT_UWORD 65535 Compu_IDENTITY 0 65535 PHYS_UNIT "DTC" /end CHARACTERISTIC
/begin CHARACTERISTIC FCdtc_gyro_y_max "FCtl_DTC(710)" VALUE 0x00163AA0 /* @ECU_Address@FCtl_DTC@0x021B558C@ */ ECIPP_ALIGNMENT_UWORD 65535 Compu_IDENTITY 0 65535 PHYS_UNIT "DTC" /end CHARACTERISTIC
/begin CHARACTERISTIC FCdtc_gyro_y_min "FCtl_DTC(711)" VALUE 0x00163AA2 /* @ECU_Address@FCtl_DTC@0x021B558E@ */ ECIPP_ALIGNMENT_UWORD 65535 Compu_IDENTITY 0 65535 PHYS_UNIT "DTC" /end CHARACTERISTIC
/begin CHARACTERISTIC FCdtc_gyro_z_max "FCtl_DTC(712)" VALUE 0x00163AA4 /* @ECU_Address@FCtl_DTC@0x021B5590@ */ ECIPP_ALIGNMENT_UWORD 65535 Compu_IDENTITY 0 65535 PHYS_UNIT "DTC" /end CHARACTERISTIC
/begin CHARACTERISTIC FCdtc_gyro_z_min "FCtl_DTC(713)" VALUE 0x00163AA6 /* @ECU_Address@FCtl_DTC@0x021B5592@ */ ECIPP_ALIGNMENT_UWORD 65535 Compu_IDENTITY 0 65535 PHYS_UNIT "DTC" /end CHARACTERISTIC
/begin CHARACTERISTIC FCdtc_HBA_I_max "FCtl_DTC(528)" VALUE 0x00163934 /* @ECU_Address@FCtl_DTC@0x021B5420@ */ ECIPP_ALIGNMENT_UWORD 65535 Compu_IDENTITY 0 65535 PHYS_UNIT "DTC" /end CHARACTERISTIC
/begin CHARACTERISTIC FCdtc_HBB_I_max "FCtl_DTC(529)" VALUE 0x00163936 /* @ECU_Address@FCtl_DTC@0x021B5422@ */ ECIPP_ALIGNMENT_UWORD 65535 Compu_IDENTITY 0 65535 PHYS_UNIT "DTC" /end CHARACTERISTIC
/begin CHARACTERISTIC FCdtc_HiDiagTemp "FCtl_DTC(652)" VALUE 0x00163A2C /* @ECU_Address@FCtl_DTC@0x021B5518@ */ ECIPP_ALIGNMENT_UWORD 65535 Compu_IDENTITY 0 65535 PHYS_UNIT "DTC" /end CHARACTERISTIC
/begin CHARACTERISTIC FCdtc_HWID_fail "FCtl_DTC(318)" VALUE 0x00163790 /* @ECU_Address@FCtl_DTC@0x021B527C@ */ ECIPP_ALIGNMENT_UWORD 65535 Compu_IDENTITY 0 65535 PHYS_UNIT "DTC" /end CHARACTERISTIC
/begin CHARACTERISTIC FCdtc_IAC_gndshort "FCtl_DTC(156)" VALUE 0x0016364C /* @ECU_Address@FCtl_DTC@0x021B5138@ */ ECIPP_ALIGNMENT_UWORD 65535 Compu_IDENTITY 0 65535 PHYS_UNIT "DTC" /end CHARACTERISTIC
/begin CHARACTERISTIC FCdtc_IAC_openshort "FCtl_DTC(157)" VALUE 0x0016364E /* @ECU_Address@FCtl_DTC@0x021B513A@ */ ECIPP_ALIGNMENT_UWORD 65535 Compu_IDENTITY 0 65535 PHYS_UNIT "DTC" /end CHARACTERISTIC
/begin CHARACTERISTIC FCdtc_IAT_HiExp "FCtl_DTC(87)" VALUE 0x001635C2 /* @ECU_Address@FCtl_DTC@0x021B50AE@ */ ECIPP_ALIGNMENT_UWORD 65535 Compu_IDENTITY 0 65535 PHYS_UNIT "DTC" /end CHARACTERISTIC
/begin CHARACTERISTIC FCdtc_IAT_HiExp2 "FCtl_DTC(88)" VALUE 0x001635C4 /* @ECU_Address@FCtl_DTC@0x021B50B0@ */ ECIPP_ALIGNMENT_UWORD 65535 Compu_IDENTITY 0 65535 PHYS_UNIT "DTC" /end CHARACTERISTIC
/begin CHARACTERISTIC FCdtc_IAT_maxv "FCtl_DTC(5)" VALUE 0x0016351E /* @ECU_Address@FCtl_DTC@0x021B500A@ */ ECIPP_ALIGNMENT_UWORD 65535 Compu_IDENTITY 0 65535 PHYS_UNIT "DTC" /end CHARACTERISTIC
/begin CHARACTERISTIC FCdtc_IAT_minv "FCtl_DTC(6)" VALUE 0x00163520 /* @ECU_Address@FCtl_DTC@0x021B500C@ */ ECIPP_ALIGNMENT_UWORD 65535 Compu_IDENTITY 0 65535 PHYS_UNIT "DTC" /end CHARACTERISTIC
/begin CHARACTERISTIC FCdtc_IBF_detected "FCtl_DTC(861)" VALUE 0x00163BCE /* @ECU_Address@FCtl_DTC@0x021B56BA@ */ ECIPP_ALIGNMENT_UWORD 65535 Compu_IDENTITY 0 65535 PHYS_UNIT "DTC" /end CHARACTERISTIC
/begin CHARACTERISTIC FCdtc_ICam_maxerr "FCtl_DTC(288)" VALUE 0x00163754 /* @ECU_Address@FCtl_DTC@0x021B5240@ */ ECIPP_ALIGNMENT_UWORD 65535 Compu_IDENTITY 0 65535 PHYS_UNIT "DTC" /end CHARACTERISTIC
/begin CHARACTERISTIC FCdtc_ICAVD1_mis "FCtl_DTC(259)" VALUE 0x0016371A /* @ECU_Address@FCtl_DTC@0x021B5206@ */ ECIPP_ALIGNMENT_UWORD 65535 Compu_IDENTITY 0 65535 PHYS_UNIT "DTC" /end CHARACTERISTIC
/begin CHARACTERISTIC FCdtc_ICAVD1_miscat "FCtl_DTC(267)" VALUE 0x0016372A /* @ECU_Address@FCtl_DTC@0x021B5216@ */ ECIPP_ALIGNMENT_UWORD 65535 Compu_IDENTITY 0 65535 PHYS_UNIT "DTC" /end CHARACTERISTIC
/begin CHARACTERISTIC FCdtc_Idle_SD "FCtl_DTC(654)" VALUE 0x00163A30 /* @ECU_Address@FCtl_DTC@0x021B551C@ */ ECIPP_ALIGNMENT_UWORD 65535 Compu_IDENTITY 0 65535 PHYS_UNIT "DTC" /end CHARACTERISTIC
/begin CHARACTERISTIC FCdtc_imu_general "FCtl_DTC(699)" VALUE 0x00163A8A /* @ECU_Address@FCtl_DTC@0x021B5576@ */ ECIPP_ALIGNMENT_UWORD 65535 Compu_IDENTITY 0 65535 PHYS_UNIT "DTC" /end CHARACTERISTIC
/begin CHARACTERISTIC FCdtc_imu_temp_max "FCtl_DTC(700)" VALUE 0x00163A8C /* @ECU_Address@FCtl_DTC@0x021B5578@ */ ECIPP_ALIGNMENT_UWORD 65535 Compu_IDENTITY 0 65535 PHYS_UNIT "DTC" /end CHARACTERISTIC
/begin CHARACTERISTIC FCdtc_imu_temp_min "FCtl_DTC(701)" VALUE 0x00163A8E /* @ECU_Address@FCtl_DTC@0x021B557A@ */ ECIPP_ALIGNMENT_UWORD 65535 Compu_IDENTITY 0 65535 PHYS_UNIT "DTC" /end CHARACTERISTIC
/begin CHARACTERISTIC FCdtc_IMVD_Ifb_hi "FCtl_DTC(583)" VALUE 0x001639A2 /* @ECU_Address@FCtl_DTC@0x021B548E@ */ ECIPP_ALIGNMENT_UWORD 65535 Compu_IDENTITY 0 65535 PHYS_UNIT "DTC" /end CHARACTERISTIC
/begin CHARACTERISTIC FCdtc_IMVD_Ifb_lo "FCtl_DTC(582)" VALUE 0x001639A0 /* @ECU_Address@FCtl_DTC@0x021B548C@ */ ECIPP_ALIGNMENT_UWORD 65535 Compu_IDENTITY 0 65535 PHYS_UNIT "DTC" /end CHARACTERISTIC
/begin CHARACTERISTIC FCdtc_INJD_boost_lo "FCtl_DTC(578)" VALUE 0x00163998 /* @ECU_Address@FCtl_DTC@0x021B5484@ */ ECIPP_ALIGNMENT_UWORD 65535 Compu_IDENTITY 0 65535 PHYS_UNIT "DTC" /end CHARACTERISTIC
/begin CHARACTERISTIC FCdtc_INJD_HS_Ihi "FCtl_DTC(562)" VALUE 0x00163978 /* @ECU_Address@FCtl_DTC@0x021B5464@ */ ECIPP_ALIGNMENT_UWORD 65535 Compu_IDENTITY 0 65535 PHYS_UNIT "DTC" /end CHARACTERISTIC
/begin CHARACTERISTIC FCdtc_INJD_HW_int "FCtl_DTC(580)" VALUE 0x0016399C /* @ECU_Address@FCtl_DTC@0x021B5488@ */ ECIPP_ALIGNMENT_UWORD 65535 Compu_IDENTITY 0 65535 PHYS_UNIT "DTC" /end CHARACTERISTIC
/begin CHARACTERISTIC FCdtc_INJD_LS_Ihi "FCtl_DTC(570)" VALUE 0x00163988 /* @ECU_Address@FCtl_DTC@0x021B5474@ */ ECIPP_ALIGNMENT_UWORD 65535 Compu_IDENTITY 0 65535 PHYS_UNIT "DTC" /end CHARACTERISTIC
/begin CHARACTERISTIC FCdtc_INJD_off_lo "FCtl_DTC(46)" VALUE 0x00163570 /* @ECU_Address@FCtl_DTC@0x021B505C@ */ ECIPP_ALIGNMENT_UWORD 65535 Compu_IDENTITY 0 65535 PHYS_UNIT "DTC" /end CHARACTERISTIC
/begin CHARACTERISTIC FCdtc_INJD_on_hi "FCtl_DTC(56)" VALUE 0x00163584 /* @ECU_Address@FCtl_DTC@0x021B5070@ */ ECIPP_ALIGNMENT_UWORD 65535 Compu_IDENTITY 0 65535 PHYS_UNIT "DTC" /end CHARACTERISTIC
/begin CHARACTERISTIC FCdtc_interrupt "FCtl_DTC(104)" VALUE 0x001635E4 /* @ECU_Address@FCtl_DTC@0x021B50D0@ */ ECIPP_ALIGNMENT_UWORD 65535 Compu_IDENTITY 0 65535 PHYS_UNIT "DTC" /end CHARACTERISTIC
/begin CHARACTERISTIC FCdtc_J1939_AAT_err_loss "FCtl_DTC(835)" VALUE 0x00163B9A /* @ECU_Address@FCtl_DTC@0x021B5686@ */ ECIPP_ALIGNMENT_UWORD 65535 Compu_IDENTITY 0 65535 PHYS_UNIT "DTC" /end CHARACTERISTIC
/begin CHARACTERISTIC FCdtc_J1939_addr2Fail "FCtl_DTC(301)" VALUE 0x0016376E /* @ECU_Address@FCtl_DTC@0x021B525A@ */ ECIPP_ALIGNMENT_UWORD 65535 Compu_IDENTITY 0 65535 PHYS_UNIT "DTC" /end CHARACTERISTIC
/begin CHARACTERISTIC FCdtc_J1939_addr3Fail "FCtl_DTC(302)" VALUE 0x00163770 /* @ECU_Address@FCtl_DTC@0x021B525C@ */ ECIPP_ALIGNMENT_UWORD 65535 Compu_IDENTITY 0 65535 PHYS_UNIT "DTC" /end CHARACTERISTIC
/begin CHARACTERISTIC FCdtc_J1939_addrFail "FCtl_DTC(188)" VALUE 0x0016368C /* @ECU_Address@FCtl_DTC@0x021B5178@ */ ECIPP_ALIGNMENT_UWORD 65535 Compu_IDENTITY 0 65535 PHYS_UNIT "DTC" /end CHARACTERISTIC
/begin CHARACTERISTIC FCdtc_J1939_ETC_loss "FCtl_DTC(219)" VALUE 0x001636CA /* @ECU_Address@FCtl_DTC@0x021B51B6@ */ ECIPP_ALIGNMENT_UWORD 65535 Compu_IDENTITY 0 65535 PHYS_UNIT "DTC" /end CHARACTERISTIC
/begin CHARACTERISTIC FCdtc_J1939_ETC_loss2 "FCtl_DTC(275)" VALUE 0x0016373A /* @ECU_Address@FCtl_DTC@0x021B5226@ */ ECIPP_ALIGNMENT_UWORD 65535 Compu_IDENTITY 0 65535 PHYS_UNIT "DTC" /end CHARACTERISTIC
/begin CHARACTERISTIC FCdtc_J1939_PGN_tout "FCtl_DTC(714)" VALUE 0x00163AA8 /* @ECU_Address@FCtl_DTC@0x021B5594@ */ ECIPP_ALIGNMENT_UWORD 65535 Compu_IDENTITY 0 65535 PHYS_UNIT "DTC" /end CHARACTERISTIC
/begin CHARACTERISTIC FCdtc_J1939_PGN_tout10 "FCtl_DTC(723)" VALUE 0x00163ABA /* @ECU_Address@FCtl_DTC@0x021B55A6@ */ ECIPP_ALIGNMENT_UWORD 65535 Compu_IDENTITY 0 65535 PHYS_UNIT "DTC" /end CHARACTERISTIC
/begin CHARACTERISTIC FCdtc_J1939_PGN_tout2 "FCtl_DTC(715)" VALUE 0x00163AAA /* @ECU_Address@FCtl_DTC@0x021B5596@ */ ECIPP_ALIGNMENT_UWORD 65535 Compu_IDENTITY 0 65535 PHYS_UNIT "DTC" /end CHARACTERISTIC
/begin CHARACTERISTIC FCdtc_J1939_PGN_tout3 "FCtl_DTC(716)" VALUE 0x00163AAC /* @ECU_Address@FCtl_DTC@0x021B5598@ */ ECIPP_ALIGNMENT_UWORD 65535 Compu_IDENTITY 0 65535 PHYS_UNIT "DTC" /end CHARACTERISTIC
/begin CHARACTERISTIC FCdtc_J1939_PGN_tout4 "FCtl_DTC(717)" VALUE 0x00163AAE /* @ECU_Address@FCtl_DTC@0x021B559A@ */ ECIPP_ALIGNMENT_UWORD 65535 Compu_IDENTITY 0 65535 PHYS_UNIT "DTC" /end CHARACTERISTIC
/begin CHARACTERISTIC FCdtc_J1939_PGN_tout5 "FCtl_DTC(718)" VALUE 0x00163AB0 /* @ECU_Address@FCtl_DTC@0x021B559C@ */ ECIPP_ALIGNMENT_UWORD 65535 Compu_IDENTITY 0 65535 PHYS_UNIT "DTC" /end CHARACTERISTIC
/begin CHARACTERISTIC FCdtc_J1939_PGN_tout6 "FCtl_DTC(719)" VALUE 0x00163AB2 /* @ECU_Address@FCtl_DTC@0x021B559E@ */ ECIPP_ALIGNMENT_UWORD 65535 Compu_IDENTITY 0 65535 PHYS_UNIT "DTC" /end CHARACTERISTIC
/begin CHARACTERISTIC FCdtc_J1939_PGN_tout7 "FCtl_DTC(720)" VALUE 0x00163AB4 /* @ECU_Address@FCtl_DTC@0x021B55A0@ */ ECIPP_ALIGNMENT_UWORD 65535 Compu_IDENTITY 0 65535 PHYS_UNIT "DTC" /end CHARACTERISTIC
/begin CHARACTERISTIC FCdtc_J1939_PGN_tout8 "FCtl_DTC(721)" VALUE 0x00163AB6 /* @ECU_Address@FCtl_DTC@0x021B55A2@ */ ECIPP_ALIGNMENT_UWORD 65535 Compu_IDENTITY 0 65535 PHYS_UNIT "DTC" /end CHARACTERISTIC
/begin CHARACTERISTIC FCdtc_J1939_PGN_tout9 "FCtl_DTC(722)" VALUE 0x00163AB8 /* @ECU_Address@FCtl_DTC@0x021B55A4@ */ ECIPP_ALIGNMENT_UWORD 65535 Compu_IDENTITY 0 65535 PHYS_UNIT "DTC" /end CHARACTERISTIC
/begin CHARACTERISTIC FCdtc_J1939_RS_err_loss "FCtl_DTC(834)" VALUE 0x00163B98 /* @ECU_Address@FCtl_DTC@0x021B5684@ */ ECIPP_ALIGNMENT_UWORD 65535 Compu_IDENTITY 0 65535 PHYS_UNIT "DTC" /end CHARACTERISTIC
/begin CHARACTERISTIC FCdtc_J1939_RSsetpt_loss "FCtl_DTC(600)" VALUE 0x001639C4 /* @ECU_Address@FCtl_DTC@0x021B54B0@ */ ECIPP_ALIGNMENT_UWORD 65535 Compu_IDENTITY 0 65535 PHYS_UNIT "DTC" /end CHARACTERISTIC
/begin CHARACTERISTIC FCdtc_J1939_Rx2Fail "FCtl_DTC(299)" VALUE 0x0016376A /* @ECU_Address@FCtl_DTC@0x021B5256@ */ ECIPP_ALIGNMENT_UWORD 65535 Compu_IDENTITY 0 65535 PHYS_UNIT "DTC" /end CHARACTERISTIC
/begin CHARACTERISTIC FCdtc_J1939_Rx3Fail "FCtl_DTC(300)" VALUE 0x0016376C /* @ECU_Address@FCtl_DTC@0x021B5258@ */ ECIPP_ALIGNMENT_UWORD 65535 Compu_IDENTITY 0 65535 PHYS_UNIT "DTC" /end CHARACTERISTIC
/begin CHARACTERISTIC FCfmi_FPP2_IVS_max "FCtl_FMI(25)" VALUE 0x0016512C /* @ECU_Address@FCtl_FMI@0x021B7019@ */ ECIPP_ALIGNMENT_UBYTE 255 Compu_IDENTITY 0 255 PHYS_UNIT "FMI" /end CHARACTERISTIC
/begin CHARACTERISTIC FCfmi_FPP2_IVS_min "FCtl_FMI(26)" VALUE 0x0016512D /* @ECU_Address@FCtl_FMI@0x021B701A@ */ ECIPP_ALIGNMENT_UBYTE 255 Compu_IDENTITY 0 255 PHYS_UNIT "FMI" /end CHARACTERISTIC
/begin CHARACTERISTIC FCfmi_FPP2_max "FCtl_FMI(21)" VALUE 0x00165128 /* @ECU_Address@FCtl_FMI@0x021B7015@ */ ECIPP_ALIGNMENT_UBYTE 255 Compu_IDENTITY 0 255 PHYS_UNIT "FMI" /end CHARACTERISTIC
/begin CHARACTERISTIC FCfmi_FPP2_min "FCtl_FMI(22)" VALUE 0x00165129 /* @ECU_Address@FCtl_FMI@0x021B7016@ */ ECIPP_ALIGNMENT_UBYTE 255 Compu_IDENTITY 0 255 PHYS_UNIT "FMI" /end CHARACTERISTIC
/begin CHARACTERISTIC FCfmi_FPP2V_TSC1 "FCtl_FMI(839)" VALUE 0x0016545A /* @ECU_Address@FCtl_FMI@0x021B7347@ */ ECIPP_ALIGNMENT_UBYTE 255 Compu_IDENTITY 0 255 PHYS_UNIT "FMI" /end CHARACTERISTIC
/begin CHARACTERISTIC FCfmi_FPrly_coilopen "FCtl_FMI(168)" VALUE 0x001651BB /* @ECU_Address@FCtl_FMI@0x021B70A8@ */ ECIPP_ALIGNMENT_UBYTE 255 Compu_IDENTITY 0 255 PHYS_UNIT "FMI" /end CHARACTERISTIC
/begin CHARACTERISTIC FCfmi_FPrly_coilshort "FCtl_FMI(169)" VALUE 0x001651BC /* @ECU_Address@FCtl_FMI@0x021B70A9@ */ ECIPP_ALIGNMENT_UBYTE 255 Compu_IDENTITY 0 255 PHYS_UNIT "FMI" /end CHARACTERISTIC
/begin CHARACTERISTIC FCfmi_FPrly_gndshort "FCtl_FMI(167)" VALUE 0x001651BA /* @ECU_Address@FCtl_FMI@0x021B70A7@ */ ECIPP_ALIGNMENT_UBYTE 255 Compu_IDENTITY 0 255 PHYS_UNIT "FMI" /end CHARACTERISTIC
/begin CHARACTERISTIC FCfmi_FSO_post_TPS_phi_hi "FCtl_FMI(860)" VALUE 0x0016546F /* @ECU_Address@FCtl_FMI@0x021B735C@ */ ECIPP_ALIGNMENT_UBYTE 255 Compu_IDENTITY 0 255 PHYS_UNIT "FMI" /end CHARACTERISTIC
/begin CHARACTERISTIC FCfmi_FSO_TPS_phi_hi "FCtl_FMI(803)" VALUE 0x00165436 /* @ECU_Address@FCtl_FMI@0x021B7323@ */ ECIPP_ALIGNMENT_UBYTE 255 Compu_IDENTITY 0 255 PHYS_UNIT "FMI" /end CHARACTERISTIC
/begin CHARACTERISTIC FCfmi_FT_maxv "FCtl_FMI(146)" VALUE 0x001651A5 /* @ECU_Address@FCtl_FMI@0x021B7092@ */ ECIPP_ALIGNMENT_UBYTE 255 Compu_IDENTITY 0 255 PHYS_UNIT "FMI" /end CHARACTERISTIC
/begin CHARACTERISTIC FCfmi_FT_minv "FCtl_FMI(147)" VALUE 0x001651A6 /* @ECU_Address@FCtl_FMI@0x021B7093@ */ ECIPP_ALIGNMENT_UBYTE 255 Compu_IDENTITY 0 255 PHYS_UNIT "FMI" /end CHARACTERISTIC
/begin CHARACTERISTIC FCfmi_FTgasf_maxv "FCtl_FMI(215)" VALUE 0x001651EA /* @ECU_Address@FCtl_FMI@0x021B70D7@ */ ECIPP_ALIGNMENT_UBYTE 255 Compu_IDENTITY 0 255 PHYS_UNIT "FMI" /end CHARACTERISTIC
/begin CHARACTERISTIC FCfmi_FTgasf_minv "FCtl_FMI(216)" VALUE 0x001651EB /* @ECU_Address@FCtl_FMI@0x021B70D8@ */ ECIPP_ALIGNMENT_UBYTE 255 Compu_IDENTITY 0 255 PHYS_UNIT "FMI" /end CHARACTERISTIC
/begin CHARACTERISTIC FCfmi_GLOW_unit_fail "FCtl_FMI(503)" VALUE 0x0016530A /* @ECU_Address@FCtl_FMI@0x021B71F7@ */ ECIPP_ALIGNMENT_UBYTE 255 Compu_IDENTITY 0 255 PHYS_UNIT "FMI" /end CHARACTERISTIC
/begin CHARACTERISTIC FCfmi_GLOW1_open "FCtl_FMI(483)" VALUE 0x001652F6 /* @ECU_Address@FCtl_FMI@0x021B71E3@ */ ECIPP_ALIGNMENT_UBYTE 255 Compu_IDENTITY 0 255 PHYS_UNIT "FMI" /end CHARACTERISTIC
/begin CHARACTERISTIC FCfmi_GLOW1_short "FCtl_FMI(493)" VALUE 0x00165300 /* @ECU_Address@FCtl_FMI@0x021B71ED@ */ ECIPP_ALIGNMENT_UBYTE 255 Compu_IDENTITY 0 255 PHYS_UNIT "FMI" /end CHARACTERISTIC
/begin CHARACTERISTIC FCfmi_gov_ntrlock_fail "FCtl_FMI(92)" VALUE 0x0016516F /* @ECU_Address@FCtl_FMI@0x021B705C@ */ ECIPP_ALIGNMENT_UBYTE 255 Compu_IDENTITY 0 255 PHYS_UNIT "FMI" /end CHARACTERISTIC
/begin CHARACTERISTIC FCfmi_gyro_x_max "FCtl_FMI(708)" VALUE 0x001653D7 /* @ECU_Address@FCtl_FMI@0x021B72C4@ */ ECIPP_ALIGNMENT_UBYTE 255 Compu_IDENTITY 0 255 PHYS_UNIT "FMI" /end CHARACTERISTIC
/begin CHARACTERISTIC FCfmi_gyro_x_min "FCtl_FMI(709)" VALUE 0x001653D8 /* @ECU_Address@FCtl_FMI@0x021B72C5@ */ ECIPP_ALIGNMENT_UBYTE 255 Compu_IDENTITY 0 255 PHYS_UNIT "FMI" /end CHARACTERISTIC
/begin CHARACTERISTIC FCfmi_gyro_y_max "FCtl_FMI(710)" VALUE 0x001653D9 /* @ECU_Address@FCtl_FMI@0x021B72C6@ */ ECIPP_ALIGNMENT_UBYTE 255 Compu_IDENTITY 0 255 PHYS_UNIT "FMI" /end CHARACTERISTIC
/begin CHARACTERISTIC FCfmi_gyro_y_min "FCtl_FMI(711)" VALUE 0x001653DA /* @ECU_Address@FCtl_FMI@0x021B72C7@ */ ECIPP_ALIGNMENT_UBYTE 255 Compu_IDENTITY 0 255 PHYS_UNIT "FMI" /end CHARACTERISTIC
/begin CHARACTERISTIC FCfmi_gyro_z_max "FCtl_FMI(712)" VALUE 0x001653DB /* @ECU_Address@FCtl_FMI@0x021B72C8@ */ ECIPP_ALIGNMENT_UBYTE 255 Compu_IDENTITY 0 255 PHYS_UNIT "FMI" /end CHARACTERISTIC
/begin CHARACTERISTIC FCfmi_gyro_z_min "FCtl_FMI(713)" VALUE 0x001653DC /* @ECU_Address@FCtl_FMI@0x021B72C9@ */ ECIPP_ALIGNMENT_UBYTE 255 Compu_IDENTITY 0 255 PHYS_UNIT "FMI" /end CHARACTERISTIC
/begin CHARACTERISTIC FCfmi_HBA_I_max "FCtl_FMI(528)" VALUE 0x00165323 /* @ECU_Address@FCtl_FMI@0x021B7210@ */ ECIPP_ALIGNMENT_UBYTE 255 Compu_IDENTITY 0 255 PHYS_UNIT "FMI" /end CHARACTERISTIC
/begin CHARACTERISTIC FCfmi_HBB_I_max "FCtl_FMI(529)" VALUE 0x00165324 /* @ECU_Address@FCtl_FMI@0x021B7211@ */ ECIPP_ALIGNMENT_UBYTE 255 Compu_IDENTITY 0 255 PHYS_UNIT "FMI" /end CHARACTERISTIC
/begin CHARACTERISTIC FCfmi_HiDiagTemp "FCtl_FMI(652)" VALUE 0x0016539F /* @ECU_Address@FCtl_FMI@0x021B728C@ */ ECIPP_ALIGNMENT_UBYTE 255 Compu_IDENTITY 0 255 PHYS_UNIT "FMI" /end CHARACTERISTIC
/begin CHARACTERISTIC FCfmi_HWID_fail "FCtl_FMI(318)" VALUE 0x00165251 /* @ECU_Address@FCtl_FMI@0x021B713E@ */ ECIPP_ALIGNMENT_UBYTE 255 Compu_IDENTITY 0 255 PHYS_UNIT "FMI" /end CHARACTERISTIC
/begin CHARACTERISTIC FCfmi_IAC_gndshort "FCtl_FMI(156)" VALUE 0x001651AF /* @ECU_Address@FCtl_FMI@0x021B709C@ */ ECIPP_ALIGNMENT_UBYTE 255 Compu_IDENTITY 0 255 PHYS_UNIT "FMI" /end CHARACTERISTIC
/begin CHARACTERISTIC FCfmi_IAC_openshort "FCtl_FMI(157)" VALUE 0x001651B0 /* @ECU_Address@FCtl_FMI@0x021B709D@ */ ECIPP_ALIGNMENT_UBYTE 255 Compu_IDENTITY 0 255 PHYS_UNIT "FMI" /end CHARACTERISTIC
/begin CHARACTERISTIC FCfmi_IAT_HiExp "FCtl_FMI(87)" VALUE 0x0016516A /* @ECU_Address@FCtl_FMI@0x021B7057@ */ ECIPP_ALIGNMENT_UBYTE 255 Compu_IDENTITY 0 255 PHYS_UNIT "FMI" /end CHARACTERISTIC
/begin CHARACTERISTIC FCfmi_IAT_HiExp2 "FCtl_FMI(88)" VALUE 0x0016516B /* @ECU_Address@FCtl_FMI@0x021B7058@ */ ECIPP_ALIGNMENT_UBYTE 255 Compu_IDENTITY 0 255 PHYS_UNIT "FMI" /end CHARACTERISTIC
/begin CHARACTERISTIC FCfmi_IAT_maxv "FCtl_FMI(5)" VALUE 0x00165118 /* @ECU_Address@FCtl_FMI@0x021B7005@ */ ECIPP_ALIGNMENT_UBYTE 255 Compu_IDENTITY 0 255 PHYS_UNIT "FMI" /end CHARACTERISTIC
/begin CHARACTERISTIC FCfmi_IAT_minv "FCtl_FMI(6)" VALUE 0x00165119 /* @ECU_Address@FCtl_FMI@0x021B7006@ */ ECIPP_ALIGNMENT_UBYTE 255 Compu_IDENTITY 0 255 PHYS_UNIT "FMI" /end CHARACTERISTIC
/begin CHARACTERISTIC FCfmi_IBF_detected "FCtl_FMI(861)" VALUE 0x00165470 /* @ECU_Address@FCtl_FMI@0x021B735D@ */ ECIPP_ALIGNMENT_UBYTE 255 Compu_IDENTITY 0 255 PHYS_UNIT "FMI" /end CHARACTERISTIC
/begin CHARACTERISTIC FCfmi_ICam_maxerr "FCtl_FMI(288)" VALUE 0x00165233 /* @ECU_Address@FCtl_FMI@0x021B7120@ */ ECIPP_ALIGNMENT_UBYTE 255 Compu_IDENTITY 0 255 PHYS_UNIT "FMI" /end CHARACTERISTIC
/begin CHARACTERISTIC FCfmi_ICAVD1_mis "FCtl_FMI(259)" VALUE 0x00165216 /* @ECU_Address@FCtl_FMI@0x021B7103@ */ ECIPP_ALIGNMENT_UBYTE 255 Compu_IDENTITY 0 255 PHYS_UNIT "FMI" /end CHARACTERISTIC
/begin CHARACTERISTIC FCfmi_ICAVD1_miscat "FCtl_FMI(267)" VALUE 0x0016521E /* @ECU_Address@FCtl_FMI@0x021B710B@ */ ECIPP_ALIGNMENT_UBYTE 255 Compu_IDENTITY 0 255 PHYS_UNIT "FMI" /end CHARACTERISTIC
/begin CHARACTERISTIC FCfmi_Idle_SD "FCtl_FMI(654)" VALUE 0x001653A1 /* @ECU_Address@FCtl_FMI@0x021B728E@ */ ECIPP_ALIGNMENT_UBYTE 255 Compu_IDENTITY 0 255 PHYS_UNIT "FMI" /end CHARACTERISTIC
/begin CHARACTERISTIC FCfmi_imu_general "FCtl_FMI(699)" VALUE 0x001653CE /* @ECU_Address@FCtl_FMI@0x021B72BB@ */ ECIPP_ALIGNMENT_UBYTE 255 Compu_IDENTITY 0 255 PHYS_UNIT "FMI" /end CHARACTERISTIC
/begin CHARACTERISTIC FCfmi_imu_temp_max "FCtl_FMI(700)" VALUE 0x001653CF /* @ECU_Address@FCtl_FMI@0x021B72BC@ */ ECIPP_ALIGNMENT_UBYTE 255 Compu_IDENTITY 0 255 PHYS_UNIT "FMI" /end CHARACTERISTIC
/begin CHARACTERISTIC FCfmi_imu_temp_min "FCtl_FMI(701)" VALUE 0x001653D0 /* @ECU_Address@FCtl_FMI@0x021B72BD@ */ ECIPP_ALIGNMENT_UBYTE 255 Compu_IDENTITY 0 255 PHYS_UNIT "FMI" /end CHARACTERISTIC
/begin CHARACTERISTIC FCfmi_IMVD_Ifb_hi "FCtl_FMI(583)" VALUE 0x0016535A /* @ECU_Address@FCtl_FMI@0x021B7247@ */ ECIPP_ALIGNMENT_UBYTE 255 Compu_IDENTITY 0 255 PHYS_UNIT "FMI" /end CHARACTERISTIC
/begin CHARACTERISTIC FCfmi_IMVD_Ifb_lo "FCtl_FMI(582)" VALUE 0x00165359 /* @ECU_Address@FCtl_FMI@0x021B7246@ */ ECIPP_ALIGNMENT_UBYTE 255 Compu_IDENTITY 0 255 PHYS_UNIT "FMI" /end CHARACTERISTIC
/begin CHARACTERISTIC FCfmi_INJD_boost_lo "FCtl_FMI(578)" VALUE 0x00165355 /* @ECU_Address@FCtl_FMI@0x021B7242@ */ ECIPP_ALIGNMENT_UBYTE 255 Compu_IDENTITY 0 255 PHYS_UNIT "FMI" /end CHARACTERISTIC
/begin CHARACTERISTIC FCfmi_INJD_HS_Ihi "FCtl_FMI(562)" VALUE 0x00165345 /* @ECU_Address@FCtl_FMI@0x021B7232@ */ ECIPP_ALIGNMENT_UBYTE 255 Compu_IDENTITY 0 255 PHYS_UNIT "FMI" /end CHARACTERISTIC
/begin CHARACTERISTIC FCfmi_INJD_HW_int "FCtl_FMI(580)" VALUE 0x00165357 /* @ECU_Address@FCtl_FMI@0x021B7244@ */ ECIPP_ALIGNMENT_UBYTE 255 Compu_IDENTITY 0 255 PHYS_UNIT "FMI" /end CHARACTERISTIC
/begin CHARACTERISTIC FCfmi_INJD_LS_Ihi "FCtl_FMI(570)" VALUE 0x0016534D /* @ECU_Address@FCtl_FMI@0x021B723A@ */ ECIPP_ALIGNMENT_UBYTE 255 Compu_IDENTITY 0 255 PHYS_UNIT "FMI" /end CHARACTERISTIC
/begin CHARACTERISTIC FCfmi_INJD_off_lo "FCtl_FMI(46)" VALUE 0x00165141 /* @ECU_Address@FCtl_FMI@0x021B702E@ */ ECIPP_ALIGNMENT_UBYTE 255 Compu_IDENTITY 0 255 PHYS_UNIT "FMI" /end CHARACTERISTIC
/begin CHARACTERISTIC FCfmi_INJD_on_hi "FCtl_FMI(56)" VALUE 0x0016514B /* @ECU_Address@FCtl_FMI@0x021B7038@ */ ECIPP_ALIGNMENT_UBYTE 255 Compu_IDENTITY 0 255 PHYS_UNIT "FMI" /end CHARACTERISTIC
/begin CHARACTERISTIC FCfmi_interrupt "FCtl_FMI(104)" VALUE 0x0016517B /* @ECU_Address@FCtl_FMI@0x021B7068@ */ ECIPP_ALIGNMENT_UBYTE 255 Compu_IDENTITY 0 255 PHYS_UNIT "FMI" /end CHARACTERISTIC
/begin CHARACTERISTIC FCfmi_J1939_AAT_err_loss "FCtl_FMI(835)" VALUE 0x00165456 /* @ECU_Address@FCtl_FMI@0x021B7343@ */ ECIPP_ALIGNMENT_UBYTE 255 Compu_IDENTITY 0 255 PHYS_UNIT "FMI" /end CHARACTERISTIC
/begin CHARACTERISTIC FCfmi_J1939_addr2Fail "FCtl_FMI(301)" VALUE 0x00165240 /* @ECU_Address@FCtl_FMI@0x021B712D@ */ ECIPP_ALIGNMENT_UBYTE 255 Compu_IDENTITY 0 255 PHYS_UNIT "FMI" /end CHARACTERISTIC
/begin CHARACTERISTIC FCfmi_J1939_addr3Fail "FCtl_FMI(302)" VALUE 0x00165241 /* @ECU_Address@FCtl_FMI@0x021B712E@ */ ECIPP_ALIGNMENT_UBYTE 255 Compu_IDENTITY 0 255 PHYS_UNIT "FMI" /end CHARACTERISTIC
/begin CHARACTERISTIC FCfmi_J1939_addrFail "FCtl_FMI(188)" VALUE 0x001651CF /* @ECU_Address@FCtl_FMI@0x021B70BC@ */ ECIPP_ALIGNMENT_UBYTE 255 Compu_IDENTITY 0 255 PHYS_UNIT "FMI" /end CHARACTERISTIC
/begin CHARACTERISTIC FCfmi_J1939_ETC_loss "FCtl_FMI(219)" VALUE 0x001651EE /* @ECU_Address@FCtl_FMI@0x021B70DB@ */ ECIPP_ALIGNMENT_UBYTE 255 Compu_IDENTITY 0 255 PHYS_UNIT "FMI" /end CHARACTERISTIC
/begin CHARACTERISTIC FCfmi_J1939_ETC_loss2 "FCtl_FMI(275)" VALUE 0x00165226 /* @ECU_Address@FCtl_FMI@0x021B7113@ */ ECIPP_ALIGNMENT_UBYTE 255 Compu_IDENTITY 0 255 PHYS_UNIT "FMI" /end CHARACTERISTIC
/begin CHARACTERISTIC FCfmi_J1939_PGN_tout "FCtl_FMI(714)" VALUE 0x001653DD /* @ECU_Address@FCtl_FMI@0x021B72CA@ */ ECIPP_ALIGNMENT_UBYTE 255 Compu_IDENTITY 0 255 PHYS_UNIT "FMI" /end CHARACTERISTIC
/begin CHARACTERISTIC FCfmi_J1939_PGN_tout10 "FCtl_FMI(723)" VALUE 0x001653E6 /* @ECU_Address@FCtl_FMI@0x021B72D3@ */ ECIPP_ALIGNMENT_UBYTE 255 Compu_IDENTITY 0 255 PHYS_UNIT "FMI" /end CHARACTERISTIC
/begin CHARACTERISTIC FCfmi_J1939_PGN_tout2 "FCtl_FMI(715)" VALUE 0x001653DE /* @ECU_Address@FCtl_FMI@0x021B72CB@ */ ECIPP_ALIGNMENT_UBYTE 255 Compu_IDENTITY 0 255 PHYS_UNIT "FMI" /end CHARACTERISTIC
/begin CHARACTERISTIC FCfmi_J1939_PGN_tout3 "FCtl_FMI(716)" VALUE 0x001653DF /* @ECU_Address@FCtl_FMI@0x021B72CC@ */ ECIPP_ALIGNMENT_UBYTE 255 Compu_IDENTITY 0 255 PHYS_UNIT "FMI" /end CHARACTERISTIC
/begin CHARACTERISTIC FCfmi_J1939_PGN_tout4 "FCtl_FMI(717)" VALUE 0x001653E0 /* @ECU_Address@FCtl_FMI@0x021B72CD@ */ ECIPP_ALIGNMENT_UBYTE 255 Compu_IDENTITY 0 255 PHYS_UNIT "FMI" /end CHARACTERISTIC
/begin CHARACTERISTIC FCfmi_J1939_PGN_tout5 "FCtl_FMI(718)" VALUE 0x001653E1 /* @ECU_Address@FCtl_FMI@0x021B72CE@ */ ECIPP_ALIGNMENT_UBYTE 255 Compu_IDENTITY 0 255 PHYS_UNIT "FMI" /end CHARACTERISTIC
/begin CHARACTERISTIC FCfmi_J1939_PGN_tout6 "FCtl_FMI(719)" VALUE 0x001653E2 /* @ECU_Address@FCtl_FMI@0x021B72CF@ */ ECIPP_ALIGNMENT_UBYTE 255 Compu_IDENTITY 0 255 PHYS_UNIT "FMI" /end CHARACTERISTIC
/begin CHARACTERISTIC FCfmi_J1939_PGN_tout7 "FCtl_FMI(720)" VALUE 0x001653E3 /* @ECU_Address@FCtl_FMI@0x021B72D0@ */ ECIPP_ALIGNMENT_UBYTE 255 Compu_IDENTITY 0 255 PHYS_UNIT "FMI" /end CHARACTERISTIC
/begin CHARACTERISTIC FCfmi_J1939_PGN_tout8 "FCtl_FMI(721)" VALUE 0x001653E4 /* @ECU_Address@FCtl_FMI@0x021B72D1@ */ ECIPP_ALIGNMENT_UBYTE 255 Compu_IDENTITY 0 255 PHYS_UNIT "FMI" /end CHARACTERISTIC
/begin CHARACTERISTIC FCfmi_J1939_PGN_tout9 "FCtl_FMI(722)" VALUE 0x001653E5 /* @ECU_Address@FCtl_FMI@0x021B72D2@ */ ECIPP_ALIGNMENT_UBYTE 255 Compu_IDENTITY 0 255 PHYS_UNIT "FMI" /end CHARACTERISTIC
/begin CHARACTERISTIC FCfmi_J1939_RS_err_loss "FCtl_FMI(834)" VALUE 0x00165455 /* @ECU_Address@FCtl_FMI@0x021B7342@ */ ECIPP_ALIGNMENT_UBYTE 255 Compu_IDENTITY 0 255 PHYS_UNIT "FMI" /end CHARACTERISTIC
/begin CHARACTERISTIC FCfmi_J1939_RSsetpt_loss "FCtl_FMI(600)" VALUE 0x0016536B /* @ECU_Address@FCtl_FMI@0x021B7258@ */ ECIPP_ALIGNMENT_UBYTE 255 Compu_IDENTITY 0 255 PHYS_UNIT "FMI" /end CHARACTERISTIC
/begin CHARACTERISTIC FCfmi_J1939_Rx2Fail "FCtl_FMI(299)" VALUE 0x0016523E /* @ECU_Address@FCtl_FMI@0x021B712B@ */ ECIPP_ALIGNMENT_UBYTE 255 Compu_IDENTITY 0 255 PHYS_UNIT "FMI" /end CHARACTERISTIC
/begin CHARACTERISTIC FCfmi_J1939_Rx3Fail "FCtl_FMI(300)" VALUE 0x0016523F /* @ECU_Address@FCtl_FMI@0x021B712C@ */ ECIPP_ALIGNMENT_UBYTE 255 Compu_IDENTITY 0 255 PHYS_UNIT "FMI" /end CHARACTERISTIC
/begin CHARACTERISTIC FCftb_FPP2_IVS_max "FCtl_FTB_0x04(25)" VALUE 0x0016548A /* @ECU_Address@FCtl_FTB_0x04@0x024C5019@ */ ECIPP_ALIGNMENT_UBYTE 255 Compu_IDENTITY 0 255 PHYS_UNIT "FTB" /end CHARACTERISTIC
/begin CHARACTERISTIC FCftb_FPP2_IVS_min "FCtl_FTB_0x04(26)" VALUE 0x0016548B /* @ECU_Address@FCtl_FTB_0x04@0x024C501A@ */ ECIPP_ALIGNMENT_UBYTE 255 Compu_IDENTITY 0 255 PHYS_UNIT "FTB" /end CHARACTERISTIC
/begin CHARACTERISTIC FCftb_FPP2_max "FCtl_FTB_0x04(21)" VALUE 0x00165486 /* @ECU_Address@FCtl_FTB_0x04@0x024C5015@ */ ECIPP_ALIGNMENT_UBYTE 255 Compu_IDENTITY 0 255 PHYS_UNIT "FTB" /end CHARACTERISTIC
/begin CHARACTERISTIC FCftb_FPP2_min "FCtl_FTB_0x04(22)" VALUE 0x00165487 /* @ECU_Address@FCtl_FTB_0x04@0x024C5016@ */ ECIPP_ALIGNMENT_UBYTE 255 Compu_IDENTITY 0 255 PHYS_UNIT "FTB" /end CHARACTERISTIC
/begin CHARACTERISTIC FCftb_FPP2V_TSC1 "FCtl_FTB_0x04(839)" VALUE 0x001657B8 /* @ECU_Address@FCtl_FTB_0x04@0x024C5347@ */ ECIPP_ALIGNMENT_UBYTE 255 Compu_IDENTITY 0 255 PHYS_UNIT "FTB" /end CHARACTERISTIC
/begin CHARACTERISTIC FCftb_FPrly_coilopen "FCtl_FTB_0x04(168)" VALUE 0x00165519 /* @ECU_Address@FCtl_FTB_0x04@0x024C50A8@ */ ECIPP_ALIGNMENT_UBYTE 255 Compu_IDENTITY 0 255 PHYS_UNIT "FTB" /end CHARACTERISTIC
/begin CHARACTERISTIC FCftb_FPrly_coilshort "FCtl_FTB_0x04(169)" VALUE 0x0016551A /* @ECU_Address@FCtl_FTB_0x04@0x024C50A9@ */ ECIPP_ALIGNMENT_UBYTE 255 Compu_IDENTITY 0 255 PHYS_UNIT "FTB" /end CHARACTERISTIC
/begin CHARACTERISTIC FCftb_FPrly_gndshort "FCtl_FTB_0x04(167)" VALUE 0x00165518 /* @ECU_Address@FCtl_FTB_0x04@0x024C50A7@ */ ECIPP_ALIGNMENT_UBYTE 255 Compu_IDENTITY 0 255 PHYS_UNIT "FTB" /end CHARACTERISTIC
/begin CHARACTERISTIC FCftb_FSO_post_TPS_phi_hi "FCtl_FTB_0x04(860)" VALUE 0x001657CD /* @ECU_Address@FCtl_FTB_0x04@0x024C535C@ */ ECIPP_ALIGNMENT_UBYTE 255 Compu_IDENTITY 0 255 PHYS_UNIT "FTB" /end CHARACTERISTIC
/begin CHARACTERISTIC FCftb_FSO_TPS_phi_hi "FCtl_FTB_0x04(803)" VALUE 0x00165794 /* @ECU_Address@FCtl_FTB_0x04@0x024C5323@ */ ECIPP_ALIGNMENT_UBYTE 255 Compu_IDENTITY 0 255 PHYS_UNIT "FTB" /end CHARACTERISTIC
/begin CHARACTERISTIC FCftb_FT_maxv "FCtl_FTB_0x04(146)" VALUE 0x00165503 /* @ECU_Address@FCtl_FTB_0x04@0x024C5092@ */ ECIPP_ALIGNMENT_UBYTE 255 Compu_IDENTITY 0 255 PHYS_UNIT "FTB" /end CHARACTERISTIC
/begin CHARACTERISTIC FCftb_FT_minv "FCtl_FTB_0x04(147)" VALUE 0x00165504 /* @ECU_Address@FCtl_FTB_0x04@0x024C5093@ */ ECIPP_ALIGNMENT_UBYTE 255 Compu_IDENTITY 0 255 PHYS_UNIT "FTB" /end CHARACTERISTIC
/begin CHARACTERISTIC FCftb_FTgasf_maxv "FCtl_FTB_0x04(215)" VALUE 0x00165548 /* @ECU_Address@FCtl_FTB_0x04@0x024C50D7@ */ ECIPP_ALIGNMENT_UBYTE 255 Compu_IDENTITY 0 255 PHYS_UNIT "FTB" /end CHARACTERISTIC
/begin CHARACTERISTIC FCftb_FTgasf_minv "FCtl_FTB_0x04(216)" VALUE 0x00165549 /* @ECU_Address@FCtl_FTB_0x04@0x024C50D8@ */ ECIPP_ALIGNMENT_UBYTE 255 Compu_IDENTITY 0 255 PHYS_UNIT "FTB" /end CHARACTERISTIC
/begin CHARACTERISTIC FCftb_GLOW_unit_fail "FCtl_FTB_0x04(503)" VALUE 0x00165668 /* @ECU_Address@FCtl_FTB_0x04@0x024C51F7@ */ ECIPP_ALIGNMENT_UBYTE 255 Compu_IDENTITY 0 255 PHYS_UNIT "FTB" /end CHARACTERISTIC
/begin CHARACTERISTIC FCftb_GLOW1_open "FCtl_FTB_0x04(483)" VALUE 0x00165654 /* @ECU_Address@FCtl_FTB_0x04@0x024C51E3@ */ ECIPP_ALIGNMENT_UBYTE 255 Compu_IDENTITY 0 255 PHYS_UNIT "FTB" /end CHARACTERISTIC
/begin CHARACTERISTIC FCftb_GLOW1_short "FCtl_FTB_0x04(493)" VALUE 0x0016565E /* @ECU_Address@FCtl_FTB_0x04@0x024C51ED@ */ ECIPP_ALIGNMENT_UBYTE 255 Compu_IDENTITY 0 255 PHYS_UNIT "FTB" /end CHARACTERISTIC
/begin CHARACTERISTIC FCftb_gov_ntrlock_fail "FCtl_FTB_0x04(92)" VALUE 0x001654CD /* @ECU_Address@FCtl_FTB_0x04@0x024C505C@ */ ECIPP_ALIGNMENT_UBYTE 255 Compu_IDENTITY 0 255 PHYS_UNIT "FTB" /end CHARACTERISTIC
/begin CHARACTERISTIC FCftb_gyro_x_max "FCtl_FTB_0x04(708)" VALUE 0x00165735 /* @ECU_Address@FCtl_FTB_0x04@0x024C52C4@ */ ECIPP_ALIGNMENT_UBYTE 255 Compu_IDENTITY 0 255 PHYS_UNIT "FTB" /end CHARACTERISTIC
/begin CHARACTERISTIC FCftb_gyro_x_min "FCtl_FTB_0x04(709)" VALUE 0x00165736 /* @ECU_Address@FCtl_FTB_0x04@0x024C52C5@ */ ECIPP_ALIGNMENT_UBYTE 255 Compu_IDENTITY 0 255 PHYS_UNIT "FTB" /end CHARACTERISTIC
/begin CHARACTERISTIC FCftb_gyro_y_max "FCtl_FTB_0x04(710)" VALUE 0x00165737 /* @ECU_Address@FCtl_FTB_0x04@0x024C52C6@ */ ECIPP_ALIGNMENT_UBYTE 255 Compu_IDENTITY 0 255 PHYS_UNIT "FTB" /end CHARACTERISTIC
/begin CHARACTERISTIC FCftb_gyro_y_min "FCtl_FTB_0x04(711)" VALUE 0x00165738 /* @ECU_Address@FCtl_FTB_0x04@0x024C52C7@ */ ECIPP_ALIGNMENT_UBYTE 255 Compu_IDENTITY 0 255 PHYS_UNIT "FTB" /end CHARACTERISTIC
/begin CHARACTERISTIC FCftb_gyro_z_max "FCtl_FTB_0x04(712)" VALUE 0x00165739 /* @ECU_Address@FCtl_FTB_0x04@0x024C52C8@ */ ECIPP_ALIGNMENT_UBYTE 255 Compu_IDENTITY 0 255 PHYS_UNIT "FTB" /end CHARACTERISTIC
/begin CHARACTERISTIC FCftb_gyro_z_min "FCtl_FTB_0x04(713)" VALUE 0x0016573A /* @ECU_Address@FCtl_FTB_0x04@0x024C52C9@ */ ECIPP_ALIGNMENT_UBYTE 255 Compu_IDENTITY 0 255 PHYS_UNIT "FTB" /end CHARACTERISTIC
/begin CHARACTERISTIC FCftb_HBA_I_max "FCtl_FTB_0x04(528)" VALUE 0x00165681 /* @ECU_Address@FCtl_FTB_0x04@0x024C5210@ */ ECIPP_ALIGNMENT_UBYTE 255 Compu_IDENTITY 0 255 PHYS_UNIT "FTB" /end CHARACTERISTIC
/begin CHARACTERISTIC FCftb_HBB_I_max "FCtl_FTB_0x04(529)" VALUE 0x00165682 /* @ECU_Address@FCtl_FTB_0x04@0x024C5211@ */ ECIPP_ALIGNMENT_UBYTE 255 Compu_IDENTITY 0 255 PHYS_UNIT "FTB" /end CHARACTERISTIC
/begin CHARACTERISTIC FCftb_HiDiagTemp "FCtl_FTB_0x04(652)" VALUE 0x001656FD /* @ECU_Address@FCtl_FTB_0x04@0x024C528C@ */ ECIPP_ALIGNMENT_UBYTE 255 Compu_IDENTITY 0 255 PHYS_UNIT "FTB" /end CHARACTERISTIC
/begin CHARACTERISTIC FCftb_HWID_fail "FCtl_FTB_0x04(318)" VALUE 0x001655AF /* @ECU_Address@FCtl_FTB_0x04@0x024C513E@ */ ECIPP_ALIGNMENT_UBYTE 255 Compu_IDENTITY 0 255 PHYS_UNIT "FTB" /end CHARACTERISTIC
/begin CHARACTERISTIC FCftb_IAC_gndshort "FCtl_FTB_0x04(156)" VALUE 0x0016550D /* @ECU_Address@FCtl_FTB_0x04@0x024C509C@ */ ECIPP_ALIGNMENT_UBYTE 255 Compu_IDENTITY 0 255 PHYS_UNIT "FTB" /end CHARACTERISTIC
/begin CHARACTERISTIC FCftb_IAC_openshort "FCtl_FTB_0x04(157)" VALUE 0x0016550E /* @ECU_Address@FCtl_FTB_0x04@0x024C509D@ */ ECIPP_ALIGNMENT_UBYTE 255 Compu_IDENTITY 0 255 PHYS_UNIT "FTB" /end CHARACTERISTIC
/begin CHARACTERISTIC FCftb_IAT_HiExp "FCtl_FTB_0x04(87)" VALUE 0x001654C8 /* @ECU_Address@FCtl_FTB_0x04@0x024C5057@ */ ECIPP_ALIGNMENT_UBYTE 255 Compu_IDENTITY 0 255 PHYS_UNIT "FTB" /end CHARACTERISTIC
/begin CHARACTERISTIC FCftb_IAT_HiExp2 "FCtl_FTB_0x04(88)" VALUE 0x001654C9 /* @ECU_Address@FCtl_FTB_0x04@0x024C5058@ */ ECIPP_ALIGNMENT_UBYTE 255 Compu_IDENTITY 0 255 PHYS_UNIT "FTB" /end CHARACTERISTIC
/begin CHARACTERISTIC FCftb_IAT_maxv "FCtl_FTB_0x04(5)" VALUE 0x00165476 /* @ECU_Address@FCtl_FTB_0x04@0x024C5005@ */ ECIPP_ALIGNMENT_UBYTE 255 Compu_IDENTITY 0 255 PHYS_UNIT "FTB" /end CHARACTERISTIC
/begin CHARACTERISTIC FCftb_IAT_minv "FCtl_FTB_0x04(6)" VALUE 0x00165477 /* @ECU_Address@FCtl_FTB_0x04@0x024C5006@ */ ECIPP_ALIGNMENT_UBYTE 255 Compu_IDENTITY 0 255 PHYS_UNIT "FTB" /end CHARACTERISTIC
/begin CHARACTERISTIC FCftb_IBF_detected "FCtl_FTB_0x04(861)" VALUE 0x001657CE /* @ECU_Address@FCtl_FTB_0x04@0x024C535D@ */ ECIPP_ALIGNMENT_UBYTE 255 Compu_IDENTITY 0 255 PHYS_UNIT "FTB" /end CHARACTERISTIC
/begin CHARACTERISTIC FCftb_ICam_maxerr "FCtl_FTB_0x04(288)" VALUE 0x00165591 /* @ECU_Address@FCtl_FTB_0x04@0x024C5120@ */ ECIPP_ALIGNMENT_UBYTE 255 Compu_IDENTITY 0 255 PHYS_UNIT "FTB" /end CHARACTERISTIC
/begin CHARACTERISTIC FCftb_ICAVD1_mis "FCtl_FTB_0x04(259)" VALUE 0x00165574 /* @ECU_Address@FCtl_FTB_0x04@0x024C5103@ */ ECIPP_ALIGNMENT_UBYTE 255 Compu_IDENTITY 0 255 PHYS_UNIT "FTB" /end CHARACTERISTIC
/begin CHARACTERISTIC FCftb_ICAVD1_miscat "FCtl_FTB_0x04(267)" VALUE 0x0016557C /* @ECU_Address@FCtl_FTB_0x04@0x024C510B@ */ ECIPP_ALIGNMENT_UBYTE 255 Compu_IDENTITY 0 255 PHYS_UNIT "FTB" /end CHARACTERISTIC
/begin CHARACTERISTIC FCftb_Idle_SD "FCtl_FTB_0x04(654)" VALUE 0x001656FF /* @ECU_Address@FCtl_FTB_0x04@0x024C528E@ */ ECIPP_ALIGNMENT_UBYTE 255 Compu_IDENTITY 0 255 PHYS_UNIT "FTB" /end CHARACTERISTIC
/begin CHARACTERISTIC FCftb_imu_general "FCtl_FTB_0x04(699)" VALUE 0x0016572C /* @ECU_Address@FCtl_FTB_0x04@0x024C52BB@ */ ECIPP_ALIGNMENT_UBYTE 255 Compu_IDENTITY 0 255 PHYS_UNIT "FTB" /end CHARACTERISTIC
/begin CHARACTERISTIC FCftb_imu_temp_max "FCtl_FTB_0x04(700)" VALUE 0x0016572D /* @ECU_Address@FCtl_FTB_0x04@0x024C52BC@ */ ECIPP_ALIGNMENT_UBYTE 255 Compu_IDENTITY 0 255 PHYS_UNIT "FTB" /end CHARACTERISTIC
/begin CHARACTERISTIC FCftb_imu_temp_min "FCtl_FTB_0x04(701)" VALUE 0x0016572E /* @ECU_Address@FCtl_FTB_0x04@0x024C52BD@ */ ECIPP_ALIGNMENT_UBYTE 255 Compu_IDENTITY 0 255 PHYS_UNIT "FTB" /end CHARACTERISTIC
/begin CHARACTERISTIC FCftb_IMVD_Ifb_hi "FCtl_FTB_0x04(583)" VALUE 0x001656B8 /* @ECU_Address@FCtl_FTB_0x04@0x024C5247@ */ ECIPP_ALIGNMENT_UBYTE 255 Compu_IDENTITY 0 255 PHYS_UNIT "FTB" /end CHARACTERISTIC
/begin CHARACTERISTIC FCftb_IMVD_Ifb_lo "FCtl_FTB_0x04(582)" VALUE 0x001656B7 /* @ECU_Address@FCtl_FTB_0x04@0x024C5246@ */ ECIPP_ALIGNMENT_UBYTE 255 Compu_IDENTITY 0 255 PHYS_UNIT "FTB" /end CHARACTERISTIC
/begin CHARACTERISTIC FCftb_INJD_boost_lo "FCtl_FTB_0x04(578)" VALUE 0x001656B3 /* @ECU_Address@FCtl_FTB_0x04@0x024C5242@ */ ECIPP_ALIGNMENT_UBYTE 255 Compu_IDENTITY 0 255 PHYS_UNIT "FTB" /end CHARACTERISTIC
/begin CHARACTERISTIC FCftb_INJD_HS_Ihi "FCtl_FTB_0x04(562)" VALUE 0x001656A3 /* @ECU_Address@FCtl_FTB_0x04@0x024C5232@ */ ECIPP_ALIGNMENT_UBYTE 255 Compu_IDENTITY 0 255 PHYS_UNIT "FTB" /end CHARACTERISTIC
/begin CHARACTERISTIC FCftb_INJD_HW_int "FCtl_FTB_0x04(580)" VALUE 0x001656B5 /* @ECU_Address@FCtl_FTB_0x04@0x024C5244@ */ ECIPP_ALIGNMENT_UBYTE 255 Compu_IDENTITY 0 255 PHYS_UNIT "FTB" /end CHARACTERISTIC
/begin CHARACTERISTIC FCftb_INJD_LS_Ihi "FCtl_FTB_0x04(570)" VALUE 0x001656AB /* @ECU_Address@FCtl_FTB_0x04@0x024C523A@ */ ECIPP_ALIGNMENT_UBYTE 255 Compu_IDENTITY 0 255 PHYS_UNIT "FTB" /end CHARACTERISTIC
/begin CHARACTERISTIC FCftb_INJD_off_lo "FCtl_FTB_0x04(46)" VALUE 0x0016549F /* @ECU_Address@FCtl_FTB_0x04@0x024C502E@ */ ECIPP_ALIGNMENT_UBYTE 255 Compu_IDENTITY 0 255 PHYS_UNIT "FTB" /end CHARACTERISTIC
/begin CHARACTERISTIC FCftb_INJD_on_hi "FCtl_FTB_0x04(56)" VALUE 0x001654A9 /* @ECU_Address@FCtl_FTB_0x04@0x024C5038@ */ ECIPP_ALIGNMENT_UBYTE 255 Compu_IDENTITY 0 255 PHYS_UNIT "FTB" /end CHARACTERISTIC
/begin CHARACTERISTIC FCftb_interrupt "FCtl_FTB_0x04(104)" VALUE 0x001654D9 /* @ECU_Address@FCtl_FTB_0x04@0x024C5068@ */ ECIPP_ALIGNMENT_UBYTE 255 Compu_IDENTITY 0 255 PHYS_UNIT "FTB" /end CHARACTERISTIC
/begin CHARACTERISTIC FCftb_J1939_AAT_err_loss "FCtl_FTB_0x04(835)" VALUE 0x001657B4 /* @ECU_Address@FCtl_FTB_0x04@0x024C5343@ */ ECIPP_ALIGNMENT_UBYTE 255 Compu_IDENTITY 0 255 PHYS_UNIT "FTB" /end CHARACTERISTIC
/begin CHARACTERISTIC FCftb_J1939_addr2Fail "FCtl_FTB_0x04(301)" VALUE 0x0016559E /* @ECU_Address@FCtl_FTB_0x04@0x024C512D@ */ ECIPP_ALIGNMENT_UBYTE 255 Compu_IDENTITY 0 255 PHYS_UNIT "FTB" /end CHARACTERISTIC
/begin CHARACTERISTIC FCftb_J1939_addr3Fail "FCtl_FTB_0x04(302)" VALUE 0x0016559F /* @ECU_Address@FCtl_FTB_0x04@0x024C512E@ */ ECIPP_ALIGNMENT_UBYTE 255 Compu_IDENTITY 0 255 PHYS_UNIT "FTB" /end CHARACTERISTIC
/begin CHARACTERISTIC FCftb_J1939_addrFail "FCtl_FTB_0x04(188)" VALUE 0x0016552D /* @ECU_Address@FCtl_FTB_0x04@0x024C50BC@ */ ECIPP_ALIGNMENT_UBYTE 255 Compu_IDENTITY 0 255 PHYS_UNIT "FTB" /end CHARACTERISTIC
/begin CHARACTERISTIC FCftb_J1939_ETC_loss "FCtl_FTB_0x04(219)" VALUE 0x0016554C /* @ECU_Address@FCtl_FTB_0x04@0x024C50DB@ */ ECIPP_ALIGNMENT_UBYTE 255 Compu_IDENTITY 0 255 PHYS_UNIT "FTB" /end CHARACTERISTIC
/begin CHARACTERISTIC FCftb_J1939_ETC_loss2 "FCtl_FTB_0x04(275)" VALUE 0x00165584 /* @ECU_Address@FCtl_FTB_0x04@0x024C5113@ */ ECIPP_ALIGNMENT_UBYTE 255 Compu_IDENTITY 0 255 PHYS_UNIT "FTB" /end CHARACTERISTIC
/begin CHARACTERISTIC FCftb_J1939_PGN_tout "FCtl_FTB_0x04(714)" VALUE 0x0016573B /* @ECU_Address@FCtl_FTB_0x04@0x024C52CA@ */ ECIPP_ALIGNMENT_UBYTE 255 Compu_IDENTITY 0 255 PHYS_UNIT "FTB" /end CHARACTERISTIC
/begin CHARACTERISTIC FCftb_J1939_PGN_tout10 "FCtl_FTB_0x04(723)" VALUE 0x00165744 /* @ECU_Address@FCtl_FTB_0x04@0x024C52D3@ */ ECIPP_ALIGNMENT_UBYTE 255 Compu_IDENTITY 0 255 PHYS_UNIT "FTB" /end CHARACTERISTIC
/begin CHARACTERISTIC FCftb_J1939_PGN_tout2 "FCtl_FTB_0x04(715)" VALUE 0x0016573C /* @ECU_Address@FCtl_FTB_0x04@0x024C52CB@ */ ECIPP_ALIGNMENT_UBYTE 255 Compu_IDENTITY 0 255 PHYS_UNIT "FTB" /end CHARACTERISTIC
/begin CHARACTERISTIC FCftb_J1939_PGN_tout3 "FCtl_FTB_0x04(716)" VALUE 0x0016573D /* @ECU_Address@FCtl_FTB_0x04@0x024C52CC@ */ ECIPP_ALIGNMENT_UBYTE 255 Compu_IDENTITY 0 255 PHYS_UNIT "FTB" /end CHARACTERISTIC
/begin CHARACTERISTIC FCftb_J1939_PGN_tout4 "FCtl_FTB_0x04(717)" VALUE 0x0016573E /* @ECU_Address@FCtl_FTB_0x04@0x024C52CD@ */ ECIPP_ALIGNMENT_UBYTE 255 Compu_IDENTITY 0 255 PHYS_UNIT "FTB" /end CHARACTERISTIC
/begin CHARACTERISTIC FCftb_J1939_PGN_tout5 "FCtl_FTB_0x04(718)" VALUE 0x0016573F /* @ECU_Address@FCtl_FTB_0x04@0x024C52CE@ */ ECIPP_ALIGNMENT_UBYTE 255 Compu_IDENTITY 0 255 PHYS_UNIT "FTB" /end CHARACTERISTIC
/begin CHARACTERISTIC FCftb_J1939_PGN_tout6 "FCtl_FTB_0x04(719)" VALUE 0x00165740 /* @ECU_Address@FCtl_FTB_0x04@0x024C52CF@ */ ECIPP_ALIGNMENT_UBYTE 255 Compu_IDENTITY 0 255 PHYS_UNIT "FTB" /end CHARACTERISTIC
/begin CHARACTERISTIC FCftb_J1939_PGN_tout7 "FCtl_FTB_0x04(720)" VALUE 0x00165741 /* @ECU_Address@FCtl_FTB_0x04@0x024C52D0@ */ ECIPP_ALIGNMENT_UBYTE 255 Compu_IDENTITY 0 255 PHYS_UNIT "FTB" /end CHARACTERISTIC
/begin CHARACTERISTIC FCftb_J1939_PGN_tout8 "FCtl_FTB_0x04(721)" VALUE 0x00165742 /* @ECU_Address@FCtl_FTB_0x04@0x024C52D1@ */ ECIPP_ALIGNMENT_UBYTE 255 Compu_IDENTITY 0 255 PHYS_UNIT "FTB" /end CHARACTERISTIC
/begin CHARACTERISTIC FCftb_J1939_PGN_tout9 "FCtl_FTB_0x04(722)" VALUE 0x00165743 /* @ECU_Address@FCtl_FTB_0x04@0x024C52D2@ */ ECIPP_ALIGNMENT_UBYTE 255 Compu_IDENTITY 0 255 PHYS_UNIT "FTB" /end CHARACTERISTIC
/begin CHARACTERISTIC FCftb_J1939_RS_err_loss "FCtl_FTB_0x04(834)" VALUE 0x001657B3 /* @ECU_Address@FCtl_FTB_0x04@0x024C5342@ */ ECIPP_ALIGNMENT_UBYTE 255 Compu_IDENTITY 0 255 PHYS_UNIT "FTB" /end CHARACTERISTIC
/begin CHARACTERISTIC FCftb_J1939_RSsetpt_loss "FCtl_FTB_0x04(600)" VALUE 0x001656C9 /* @ECU_Address@FCtl_FTB_0x04@0x024C5258@ */ ECIPP_ALIGNMENT_UBYTE 255 Compu_IDENTITY 0 255 PHYS_UNIT "FTB" /end CHARACTERISTIC
/begin CHARACTERISTIC FCftb_J1939_Rx2Fail "FCtl_FTB_0x04(299)" VALUE 0x0016559C /* @ECU_Address@FCtl_FTB_0x04@0x024C512B@ */ ECIPP_ALIGNMENT_UBYTE 255 Compu_IDENTITY 0 255 PHYS_UNIT "FTB" /end CHARACTERISTIC
/begin CHARACTERISTIC FCftb_J1939_Rx3Fail "FCtl_FTB_0x04(300)" VALUE 0x0016559D /* @ECU_Address@FCtl_FTB_0x04@0x024C512C@ */ ECIPP_ALIGNMENT_UBYTE 255 Compu_IDENTITY 0 255 PHYS_UNIT "FTB" /end CHARACTERISTIC
/begin CHARACTERISTIC FCspn_FPP2_IVS_max "FCtl_SPN(25)" VALUE 0x00161D40 /* @ECU_Address@FCtl_SPN@0x021B6064@ */ ECIPP_ALIGNMENT_ULONG 4294967295 Compu_IDENTITY 0 4294967295 PHYS_UNIT "SPN" /end CHARACTERISTIC
/begin CHARACTERISTIC FCspn_FPP2_IVS_min "FCtl_SPN(26)" VALUE 0x00161D44 /* @ECU_Address@FCtl_SPN@0x021B6068@ */ ECIPP_ALIGNMENT_ULONG 4294967295 Compu_IDENTITY 0 4294967295 PHYS_UNIT "SPN" /end CHARACTERISTIC
/begin CHARACTERISTIC FCspn_FPP2_max "FCtl_SPN(21)" VALUE 0x00161D30 /* @ECU_Address@FCtl_SPN@0x021B6054@ */ ECIPP_ALIGNMENT_ULONG 4294967295 Compu_IDENTITY 0 4294967295 PHYS_UNIT "SPN" /end CHARACTERISTIC
/begin CHARACTERISTIC FCspn_FPP2_min "FCtl_SPN(22)" VALUE 0x00161D34 /* @ECU_Address@FCtl_SPN@0x021B6058@ */ ECIPP_ALIGNMENT_ULONG 4294967295 Compu_IDENTITY 0 4294967295 PHYS_UNIT "SPN" /end CHARACTERISTIC
/begin CHARACTERISTIC FCspn_FPP2V_TSC1 "FCtl_SPN(839)" VALUE 0x001629F8 /* @ECU_Address@FCtl_SPN@0x021B6D1C@ */ ECIPP_ALIGNMENT_ULONG 4294967295 Compu_IDENTITY 0 4294967295 PHYS_UNIT "SPN" /end CHARACTERISTIC
/begin CHARACTERISTIC FCspn_FPrly_coilopen "FCtl_SPN(168)" VALUE 0x00161F7C /* @ECU_Address@FCtl_SPN@0x021B62A0@ */ ECIPP_ALIGNMENT_ULONG 4294967295 Compu_IDENTITY 0 4294967295 PHYS_UNIT "SPN" /end CHARACTERISTIC
/begin CHARACTERISTIC FCspn_FPrly_coilshort "FCtl_SPN(169)" VALUE 0x00161F80 /* @ECU_Address@FCtl_SPN@0x021B62A4@ */ ECIPP_ALIGNMENT_ULONG 4294967295 Compu_IDENTITY 0 4294967295 PHYS_UNIT "SPN" /end CHARACTERISTIC
/begin CHARACTERISTIC FCspn_FPrly_gndshort "FCtl_SPN(167)" VALUE 0x00161F78 /* @ECU_Address@FCtl_SPN@0x021B629C@ */ ECIPP_ALIGNMENT_ULONG 4294967295 Compu_IDENTITY 0 4294967295 PHYS_UNIT "SPN" /end CHARACTERISTIC
/begin CHARACTERISTIC FCspn_FSO_post_TPS_phi_hi "FCtl_SPN(860)" VALUE 0x00162A4C /* @ECU_Address@FCtl_SPN@0x021B6D70@ */ ECIPP_ALIGNMENT_ULONG 4294967295 Compu_IDENTITY 0 4294967295 PHYS_UNIT "SPN" /end CHARACTERISTIC
/begin CHARACTERISTIC FCspn_FSO_TPS_phi_hi "FCtl_SPN(803)" VALUE 0x00162968 /* @ECU_Address@FCtl_SPN@0x021B6C8C@ */ ECIPP_ALIGNMENT_ULONG 4294967295 Compu_IDENTITY 0 4294967295 PHYS_UNIT "SPN" /end CHARACTERISTIC
/begin CHARACTERISTIC FCspn_FT_maxv "FCtl_SPN(146)" VALUE 0x00161F24 /* @ECU_Address@FCtl_SPN@0x021B6248@ */ ECIPP_ALIGNMENT_ULONG 4294967295 Compu_IDENTITY 0 4294967295 PHYS_UNIT "SPN" /end CHARACTERISTIC
/begin CHARACTERISTIC FCspn_FT_minv "FCtl_SPN(147)" VALUE 0x00161F28 /* @ECU_Address@FCtl_SPN@0x021B624C@ */ ECIPP_ALIGNMENT_ULONG 4294967295 Compu_IDENTITY 0 4294967295 PHYS_UNIT "SPN" /end CHARACTERISTIC
/begin CHARACTERISTIC FCspn_FTgasf_maxv "FCtl_SPN(215)" VALUE 0x00162038 /* @ECU_Address@FCtl_SPN@0x021B635C@ */ ECIPP_ALIGNMENT_ULONG 4294967295 Compu_IDENTITY 0 4294967295 PHYS_UNIT "SPN" /end CHARACTERISTIC
/begin CHARACTERISTIC FCspn_FTgasf_minv "FCtl_SPN(216)" VALUE 0x0016203C /* @ECU_Address@FCtl_SPN@0x021B6360@ */ ECIPP_ALIGNMENT_ULONG 4294967295 Compu_IDENTITY 0 4294967295 PHYS_UNIT "SPN" /end CHARACTERISTIC
/begin CHARACTERISTIC FCspn_GLOW_unit_fail "FCtl_SPN(503)" VALUE 0x001624B8 /* @ECU_Address@FCtl_SPN@0x021B67DC@ */ ECIPP_ALIGNMENT_ULONG 4294967295 Compu_IDENTITY 0 4294967295 PHYS_UNIT "SPN" /end CHARACTERISTIC
/begin CHARACTERISTIC FCspn_GLOW1_open "FCtl_SPN(483)" VALUE 0x00162468 /* @ECU_Address@FCtl_SPN@0x021B678C@ */ ECIPP_ALIGNMENT_ULONG 4294967295 Compu_IDENTITY 0 4294967295 PHYS_UNIT "SPN" /end CHARACTERISTIC
/begin CHARACTERISTIC FCspn_GLOW1_short "FCtl_SPN(493)" VALUE 0x00162490 /* @ECU_Address@FCtl_SPN@0x021B67B4@ */ ECIPP_ALIGNMENT_ULONG 4294967295 Compu_IDENTITY 0 4294967295 PHYS_UNIT "SPN" /end CHARACTERISTIC
/begin CHARACTERISTIC FCspn_gov_ntrlock_fail "FCtl_SPN(92)" VALUE 0x00161E4C /* @ECU_Address@FCtl_SPN@0x021B6170@ */ ECIPP_ALIGNMENT_ULONG 4294967295 Compu_IDENTITY 0 4294967295 PHYS_UNIT "SPN" /end CHARACTERISTIC
/begin CHARACTERISTIC FCspn_gyro_x_max "FCtl_SPN(708)" VALUE 0x001627EC /* @ECU_Address@FCtl_SPN@0x021B6B10@ */ ECIPP_ALIGNMENT_ULONG 4294967295 Compu_IDENTITY 0 4294967295 PHYS_UNIT "SPN" /end CHARACTERISTIC
/begin CHARACTERISTIC FCspn_gyro_x_min "FCtl_SPN(709)" VALUE 0x001627F0 /* @ECU_Address@FCtl_SPN@0x021B6B14@ */ ECIPP_ALIGNMENT_ULONG 4294967295 Compu_IDENTITY 0 4294967295 PHYS_UNIT "SPN" /end CHARACTERISTIC
/begin CHARACTERISTIC FCspn_gyro_y_max "FCtl_SPN(710)" VALUE 0x001627F4 /* @ECU_Address@FCtl_SPN@0x021B6B18@ */ ECIPP_ALIGNMENT_ULONG 4294967295 Compu_IDENTITY 0 4294967295 PHYS_UNIT "SPN" /end CHARACTERISTIC
/begin CHARACTERISTIC FCspn_gyro_y_min "FCtl_SPN(711)" VALUE 0x001627F8 /* @ECU_Address@FCtl_SPN@0x021B6B1C@ */ ECIPP_ALIGNMENT_ULONG 4294967295 Compu_IDENTITY 0 4294967295 PHYS_UNIT "SPN" /end CHARACTERISTIC
/begin CHARACTERISTIC FCspn_gyro_z_max "FCtl_SPN(712)" VALUE 0x001627FC /* @ECU_Address@FCtl_SPN@0x021B6B20@ */ ECIPP_ALIGNMENT_ULONG 4294967295 Compu_IDENTITY 0 4294967295 PHYS_UNIT "SPN" /end CHARACTERISTIC
/begin CHARACTERISTIC FCspn_gyro_z_min "FCtl_SPN(713)" VALUE 0x00162800 /* @ECU_Address@FCtl_SPN@0x021B6B24@ */ ECIPP_ALIGNMENT_ULONG 4294967295 Compu_IDENTITY 0 4294967295 PHYS_UNIT "SPN" /end CHARACTERISTIC
/begin CHARACTERISTIC FCspn_HBA_I_max "FCtl_SPN(528)" VALUE 0x0016251C /* @ECU_Address@FCtl_SPN@0x021B6840@ */ ECIPP_ALIGNMENT_ULONG 4294967295 Compu_IDENTITY 0 4294967295 PHYS_UNIT "SPN" /end CHARACTERISTIC
/begin CHARACTERISTIC FCspn_HBB_I_max "FCtl_SPN(529)" VALUE 0x00162520 /* @ECU_Address@FCtl_SPN@0x021B6844@ */ ECIPP_ALIGNMENT_ULONG 4294967295 Compu_IDENTITY 0 4294967295 PHYS_UNIT "SPN" /end CHARACTERISTIC
/begin CHARACTERISTIC FCspn_HiDiagTemp "FCtl_SPN(652)" VALUE 0x0016270C /* @ECU_Address@FCtl_SPN@0x021B6A30@ */ ECIPP_ALIGNMENT_ULONG 4294967295 Compu_IDENTITY 0 4294967295 PHYS_UNIT "SPN" /end CHARACTERISTIC
/begin CHARACTERISTIC FCspn_HWID_fail "FCtl_SPN(318)" VALUE 0x001621D4 /* @ECU_Address@FCtl_SPN@0x021B64F8@ */ ECIPP_ALIGNMENT_ULONG 4294967295 Compu_IDENTITY 0 4294967295 PHYS_UNIT "SPN" /end CHARACTERISTIC
/begin CHARACTERISTIC FCspn_IAC_gndshort "FCtl_SPN(156)" VALUE 0x00161F4C /* @ECU_Address@FCtl_SPN@0x021B6270@ */ ECIPP_ALIGNMENT_ULONG 4294967295 Compu_IDENTITY 0 4294967295 PHYS_UNIT "SPN" /end CHARACTERISTIC
/begin CHARACTERISTIC FCspn_IAC_openshort "FCtl_SPN(157)" VALUE 0x00161F50 /* @ECU_Address@FCtl_SPN@0x021B6274@ */ ECIPP_ALIGNMENT_ULONG 4294967295 Compu_IDENTITY 0 4294967295 PHYS_UNIT "SPN" /end CHARACTERISTIC
/begin CHARACTERISTIC FCspn_IAT_HiExp "FCtl_SPN(87)" VALUE 0x00161E38 /* @ECU_Address@FCtl_SPN@0x021B615C@ */ ECIPP_ALIGNMENT_ULONG 4294967295 Compu_IDENTITY 0 4294967295 PHYS_UNIT "SPN" /end CHARACTERISTIC
/begin CHARACTERISTIC FCspn_IAT_HiExp2 "FCtl_SPN(88)" VALUE 0x00161E3C /* @ECU_Address@FCtl_SPN@0x021B6160@ */ ECIPP_ALIGNMENT_ULONG 4294967295 Compu_IDENTITY 0 4294967295 PHYS_UNIT "SPN" /end CHARACTERISTIC
/begin CHARACTERISTIC FCspn_IAT_maxv "FCtl_SPN(5)" VALUE 0x00161CF0 /* @ECU_Address@FCtl_SPN@0x021B6014@ */ ECIPP_ALIGNMENT_ULONG 4294967295 Compu_IDENTITY 0 4294967295 PHYS_UNIT "SPN" /end CHARACTERISTIC
/begin CHARACTERISTIC FCspn_IAT_minv "FCtl_SPN(6)" VALUE 0x00161CF4 /* @ECU_Address@FCtl_SPN@0x021B6018@ */ ECIPP_ALIGNMENT_ULONG 4294967295 Compu_IDENTITY 0 4294967295 PHYS_UNIT "SPN" /end CHARACTERISTIC
/begin CHARACTERISTIC FCspn_IBF_detected "FCtl_SPN(861)" VALUE 0x00162A50 /* @ECU_Address@FCtl_SPN@0x021B6D74@ */ ECIPP_ALIGNMENT_ULONG 4294967295 Compu_IDENTITY 0 4294967295 PHYS_UNIT "SPN" /end CHARACTERISTIC
/begin CHARACTERISTIC FCspn_ICam_maxerr "FCtl_SPN(288)" VALUE 0x0016215C /* @ECU_Address@FCtl_SPN@0x021B6480@ */ ECIPP_ALIGNMENT_ULONG 4294967295 Compu_IDENTITY 0 4294967295 PHYS_UNIT "SPN" /end CHARACTERISTIC
/begin CHARACTERISTIC FCspn_ICAVD1_mis "FCtl_SPN(259)" VALUE 0x001620E8 /* @ECU_Address@FCtl_SPN@0x021B640C@ */ ECIPP_ALIGNMENT_ULONG 4294967295 Compu_IDENTITY 0 4294967295 PHYS_UNIT "SPN" /end CHARACTERISTIC
/begin CHARACTERISTIC FCspn_ICAVD1_miscat "FCtl_SPN(267)" VALUE 0x00162108 /* @ECU_Address@FCtl_SPN@0x021B642C@ */ ECIPP_ALIGNMENT_ULONG 4294967295 Compu_IDENTITY 0 4294967295 PHYS_UNIT "SPN" /end CHARACTERISTIC
/begin CHARACTERISTIC FCspn_Idle_SD "FCtl_SPN(654)" VALUE 0x00162714 /* @ECU_Address@FCtl_SPN@0x021B6A38@ */ ECIPP_ALIGNMENT_ULONG 4294967295 Compu_IDENTITY 0 4294967295 PHYS_UNIT "SPN" /end CHARACTERISTIC
/begin CHARACTERISTIC FCspn_imu_general "FCtl_SPN(699)" VALUE 0x001627C8 /* @ECU_Address@FCtl_SPN@0x021B6AEC@ */ ECIPP_ALIGNMENT_ULONG 4294967295 Compu_IDENTITY 0 4294967295 PHYS_UNIT "SPN" /end CHARACTERISTIC
/begin CHARACTERISTIC FCspn_imu_temp_max "FCtl_SPN(700)" VALUE 0x001627CC /* @ECU_Address@FCtl_SPN@0x021B6AF0@ */ ECIPP_ALIGNMENT_ULONG 4294967295 Compu_IDENTITY 0 4294967295 PHYS_UNIT "SPN" /end CHARACTERISTIC
/begin CHARACTERISTIC FCspn_imu_temp_min "FCtl_SPN(701)" VALUE 0x001627D0 /* @ECU_Address@FCtl_SPN@0x021B6AF4@ */ ECIPP_ALIGNMENT_ULONG 4294967295 Compu_IDENTITY 0 4294967295 PHYS_UNIT "SPN" /end CHARACTERISTIC
/begin CHARACTERISTIC FCspn_IMVD_Ifb_hi "FCtl_SPN(583)" VALUE 0x001625F8 /* @ECU_Address@FCtl_SPN@0x021B691C@ */ ECIPP_ALIGNMENT_ULONG 4294967295 Compu_IDENTITY 0 4294967295 PHYS_UNIT "SPN" /end CHARACTERISTIC
/begin CHARACTERISTIC FCspn_IMVD_Ifb_lo "FCtl_SPN(582)" VALUE 0x001625F4 /* @ECU_Address@FCtl_SPN@0x021B6918@ */ ECIPP_ALIGNMENT_ULONG 4294967295 Compu_IDENTITY 0 4294967295 PHYS_UNIT "SPN" /end CHARACTERISTIC
/begin CHARACTERISTIC FCspn_INJD_boost_lo "FCtl_SPN(578)" VALUE 0x001625E4 /* @ECU_Address@FCtl_SPN@0x021B6908@ */ ECIPP_ALIGNMENT_ULONG 4294967295 Compu_IDENTITY 0 4294967295 PHYS_UNIT "SPN" /end CHARACTERISTIC
/begin CHARACTERISTIC FCspn_INJD_HS_Ihi "FCtl_SPN(562)" VALUE 0x001625A4 /* @ECU_Address@FCtl_SPN@0x021B68C8@ */ ECIPP_ALIGNMENT_ULONG 4294967295 Compu_IDENTITY 0 4294967295 PHYS_UNIT "SPN" /end CHARACTERISTIC
/begin CHARACTERISTIC FCspn_INJD_HW_int "FCtl_SPN(580)" VALUE 0x001625EC /* @ECU_Address@FCtl_SPN@0x021B6910@ */ ECIPP_ALIGNMENT_ULONG 4294967295 Compu_IDENTITY 0 4294967295 PHYS_UNIT "SPN" /end CHARACTERISTIC
/begin CHARACTERISTIC FCspn_INJD_LS_Ihi "FCtl_SPN(570)" VALUE 0x001625C4 /* @ECU_Address@FCtl_SPN@0x021B68E8@ */ ECIPP_ALIGNMENT_ULONG 4294967295 Compu_IDENTITY 0 4294967295 PHYS_UNIT "SPN" /end CHARACTERISTIC
/begin CHARACTERISTIC FCspn_INJD_off_lo "FCtl_SPN(46)" VALUE 0x00161D94 /* @ECU_Address@FCtl_SPN@0x021B60B8@ */ ECIPP_ALIGNMENT_ULONG 4294967295 Compu_IDENTITY 0 4294967295 PHYS_UNIT "SPN" /end CHARACTERISTIC
/begin CHARACTERISTIC FCspn_INJD_on_hi "FCtl_SPN(56)" VALUE 0x00161DBC /* @ECU_Address@FCtl_SPN@0x021B60E0@ */ ECIPP_ALIGNMENT_ULONG 4294967295 Compu_IDENTITY 0 4294967295 PHYS_UNIT "SPN" /end CHARACTERISTIC
/begin CHARACTERISTIC FCspn_interrupt "FCtl_SPN(104)" VALUE 0x00161E7C /* @ECU_Address@FCtl_SPN@0x021B61A0@ */ ECIPP_ALIGNMENT_ULONG 4294967295 Compu_IDENTITY 0 4294967295 PHYS_UNIT "SPN" /end CHARACTERISTIC
/begin CHARACTERISTIC FCspn_J1939_AAT_err_loss "FCtl_SPN(835)" VALUE 0x001629E8 /* @ECU_Address@FCtl_SPN@0x021B6D0C@ */ ECIPP_ALIGNMENT_ULONG 4294967295 Compu_IDENTITY 0 4294967295 PHYS_UNIT "SPN" /end CHARACTERISTIC
/begin CHARACTERISTIC FCspn_J1939_addr2Fail "FCtl_SPN(301)" VALUE 0x00162190 /* @ECU_Address@FCtl_SPN@0x021B64B4@ */ ECIPP_ALIGNMENT_ULONG 4294967295 Compu_IDENTITY 0 4294967295 PHYS_UNIT "SPN" /end CHARACTERISTIC
/begin CHARACTERISTIC FCspn_J1939_addr3Fail "FCtl_SPN(302)" VALUE 0x00162194 /* @ECU_Address@FCtl_SPN@0x021B64B8@ */ ECIPP_ALIGNMENT_ULONG 4294967295 Compu_IDENTITY 0 4294967295 PHYS_UNIT "SPN" /end CHARACTERISTIC
/begin CHARACTERISTIC FCspn_J1939_addrFail "FCtl_SPN(188)" VALUE 0x00161FCC /* @ECU_Address@FCtl_SPN@0x021B62F0@ */ ECIPP_ALIGNMENT_ULONG 4294967295 Compu_IDENTITY 0 4294967295 PHYS_UNIT "SPN" /end CHARACTERISTIC
/begin CHARACTERISTIC FCspn_J1939_ETC_loss "FCtl_SPN(219)" VALUE 0x00162048 /* @ECU_Address@FCtl_SPN@0x021B636C@ */ ECIPP_ALIGNMENT_ULONG 4294967295 Compu_IDENTITY 0 4294967295 PHYS_UNIT "SPN" /end CHARACTERISTIC
/begin CHARACTERISTIC FCspn_J1939_ETC_loss2 "FCtl_SPN(275)" VALUE 0x00162128 /* @ECU_Address@FCtl_SPN@0x021B644C@ */ ECIPP_ALIGNMENT_ULONG 4294967295 Compu_IDENTITY 0 4294967295 PHYS_UNIT "SPN" /end CHARACTERISTIC
/begin CHARACTERISTIC FCspn_J1939_PGN_tout "FCtl_SPN(714)" VALUE 0x00162804 /* @ECU_Address@FCtl_SPN@0x021B6B28@ */ ECIPP_ALIGNMENT_ULONG 4294967295 Compu_IDENTITY 0 4294967295 PHYS_UNIT "SPN" /end CHARACTERISTIC
/begin CHARACTERISTIC FCspn_J1939_PGN_tout10 "FCtl_SPN(723)" VALUE 0x00162828 /* @ECU_Address@FCtl_SPN@0x021B6B4C@ */ ECIPP_ALIGNMENT_ULONG 4294967295 Compu_IDENTITY 0 4294967295 PHYS_UNIT "SPN" /end CHARACTERISTIC
/begin CHARACTERISTIC FCspn_J1939_PGN_tout2 "FCtl_SPN(715)" VALUE 0x00162808 /* @ECU_Address@FCtl_SPN@0x021B6B2C@ */ ECIPP_ALIGNMENT_ULONG 4294967295 Compu_IDENTITY 0 4294967295 PHYS_UNIT "SPN" /end CHARACTERISTIC
/begin CHARACTERISTIC FCspn_J1939_PGN_tout3 "FCtl_SPN(716)" VALUE 0x0016280C /* @ECU_Address@FCtl_SPN@0x021B6B30@ */ ECIPP_ALIGNMENT_ULONG 4294967295 Compu_IDENTITY 0 4294967295 PHYS_UNIT "SPN" /end CHARACTERISTIC
/begin CHARACTERISTIC FCspn_J1939_PGN_tout4 "FCtl_SPN(717)" VALUE 0x00162810 /* @ECU_Address@FCtl_SPN@0x021B6B34@ */ ECIPP_ALIGNMENT_ULONG 4294967295 Compu_IDENTITY 0 4294967295 PHYS_UNIT "SPN" /end CHARACTERISTIC
/begin CHARACTERISTIC FCspn_J1939_PGN_tout5 "FCtl_SPN(718)" VALUE 0x00162814 /* @ECU_Address@FCtl_SPN@0x021B6B38@ */ ECIPP_ALIGNMENT_ULONG 4294967295 Compu_IDENTITY 0 4294967295 PHYS_UNIT "SPN" /end CHARACTERISTIC
/begin CHARACTERISTIC FCspn_J1939_PGN_tout6 "FCtl_SPN(719)" VALUE 0x00162818 /* @ECU_Address@FCtl_SPN@0x021B6B3C@ */ ECIPP_ALIGNMENT_ULONG 4294967295 Compu_IDENTITY 0 4294967295 PHYS_UNIT "SPN" /end CHARACTERISTIC
/begin CHARACTERISTIC FCspn_J1939_PGN_tout7 "FCtl_SPN(720)" VALUE 0x0016281C /* @ECU_Address@FCtl_SPN@0x021B6B40@ */ ECIPP_ALIGNMENT_ULONG 4294967295 Compu_IDENTITY 0 4294967295 PHYS_UNIT "SPN" /end CHARACTERISTIC
/begin CHARACTERISTIC FCspn_J1939_PGN_tout8 "FCtl_SPN(721)" VALUE 0x00162820 /* @ECU_Address@FCtl_SPN@0x021B6B44@ */ ECIPP_ALIGNMENT_ULONG 4294967295 Compu_IDENTITY 0 4294967295 PHYS_UNIT "SPN" /end CHARACTERISTIC
/begin CHARACTERISTIC FCspn_J1939_PGN_tout9 "FCtl_SPN(722)" VALUE 0x00162824 /* @ECU_Address@FCtl_SPN@0x021B6B48@ */ ECIPP_ALIGNMENT_ULONG 4294967295 Compu_IDENTITY 0 4294967295 PHYS_UNIT "SPN" /end CHARACTERISTIC
/begin CHARACTERISTIC FCspn_J1939_RS_err_loss "FCtl_SPN(834)" VALUE 0x001629E4 /* @ECU_Address@FCtl_SPN@0x021B6D08@ */ ECIPP_ALIGNMENT_ULONG 4294967295 Compu_IDENTITY 0 4294967295 PHYS_UNIT "SPN" /end CHARACTERISTIC
/begin CHARACTERISTIC FCspn_J1939_RSsetpt_loss "FCtl_SPN(600)" VALUE 0x0016263C /* @ECU_Address@FCtl_SPN@0x021B6960@ */ ECIPP_ALIGNMENT_ULONG 4294967295 Compu_IDENTITY 0 4294967295 PHYS_UNIT "SPN" /end CHARACTERISTIC
/begin CHARACTERISTIC FCspn_J1939_Rx2Fail "FCtl_SPN(299)" VALUE 0x00162188 /* @ECU_Address@FCtl_SPN@0x021B64AC@ */ ECIPP_ALIGNMENT_ULONG 4294967295 Compu_IDENTITY 0 4294967295 PHYS_UNIT "SPN" /end CHARACTERISTIC
/begin CHARACTERISTIC FCspn_J1939_Rx3Fail "FCtl_SPN(300)" VALUE 0x0016218C /* @ECU_Address@FCtl_SPN@0x021B64B0@ */ ECIPP_ALIGNMENT_ULONG 4294967295 Compu_IDENTITY 0 4294967295 PHYS_UNIT "SPN" /end CHARACTERISTIC
/begin CHARACTERISTIC FPfl_FPP2_IVS_max "FPrm_latch(32)" VALUE 0x00160098 /* @ECU_Address@FPrm_latch@0x021BB080@ */ ECIPP_ALIGNMENT_FLOAT32_IEEE 10000000000 Compu_IDENTITY -10000000000 10000000000 PHYS_UNIT "ms" /end CHARACTERISTIC
/begin CHARACTERISTIC FPfl_FPP2_IVS_min "FPrm_latch(33)" VALUE 0x0016009C /* @ECU_Address@FPrm_latch@0x021BB084@ */ ECIPP_ALIGNMENT_FLOAT32_IEEE 10000000000 Compu_IDENTITY -10000000000 10000000000 PHYS_UNIT "ms" /end CHARACTERISTIC
/begin CHARACTERISTIC FPfl_FPP2_max "FPrm_latch(28)" VALUE 0x00160088 /* @ECU_Address@FPrm_latch@0x021BB070@ */ ECIPP_ALIGNMENT_FLOAT32_IEEE 10000000000 Compu_IDENTITY -10000000000 10000000000 PHYS_UNIT "ms" /end CHARACTERISTIC
/begin CHARACTERISTIC FPfl_FPP2_min "FPrm_latch(29)" VALUE 0x0016008C /* @ECU_Address@FPrm_latch@0x021BB074@ */ ECIPP_ALIGNMENT_FLOAT32_IEEE 10000000000 Compu_IDENTITY -10000000000 10000000000 PHYS_UNIT "ms" /end CHARACTERISTIC
/begin CHARACTERISTIC FPfl_FPP2V_TSC1 "FPrm_latch(666)" VALUE 0x00160A80 /* @ECU_Address@FPrm_latch@0x021BBA68@ */ ECIPP_ALIGNMENT_FLOAT32_IEEE 10000000000 Compu_IDENTITY -10000000000 10000000000 PHYS_UNIT "ms" /end CHARACTERISTIC
/begin CHARACTERISTIC FPfl_FPrly_coilopen "FPrm_latch(128)" VALUE 0x00160218 /* @ECU_Address@FPrm_latch@0x021BB200@ */ ECIPP_ALIGNMENT_FLOAT32_IEEE 10000000000 Compu_IDENTITY -10000000000 10000000000 PHYS_UNIT "samples" /end CHARACTERISTIC
/begin CHARACTERISTIC FPfl_FPrly_coilshort "FPrm_latch(129)" VALUE 0x0016021C /* @ECU_Address@FPrm_latch@0x021BB204@ */ ECIPP_ALIGNMENT_FLOAT32_IEEE 10000000000 Compu_IDENTITY -10000000000 10000000000 PHYS_UNIT "samples" /end CHARACTERISTIC
/begin CHARACTERISTIC FPfl_FPrly_gndshort "FPrm_latch(127)" VALUE 0x00160214 /* @ECU_Address@FPrm_latch@0x021BB1FC@ */ ECIPP_ALIGNMENT_FLOAT32_IEEE 10000000000 Compu_IDENTITY -10000000000 10000000000 PHYS_UNIT "samples" /end CHARACTERISTIC
/begin CHARACTERISTIC FPfl_FSO_post_TPS_phi_hi "FPrm_latch(687)" VALUE 0x00160AD4 /* @ECU_Address@FPrm_latch@0x021BBABC@ */ ECIPP_ALIGNMENT_FLOAT32_IEEE 10000000000 Compu_IDENTITY -10000000000 10000000000 PHYS_UNIT "samples" /end CHARACTERISTIC
/begin CHARACTERISTIC FPfl_FSO_TPS_phi_hi "FPrm_latch(632)" VALUE 0x001609F8 /* @ECU_Address@FPrm_latch@0x021BB9E0@ */ ECIPP_ALIGNMENT_FLOAT32_IEEE 10000000000 Compu_IDENTITY -10000000000 10000000000 PHYS_UNIT "ms" /end CHARACTERISTIC
/begin CHARACTERISTIC FPfl_FT_maxv "FPrm_latch(106)" VALUE 0x001601C0 /* @ECU_Address@FPrm_latch@0x021BB1A8@ */ ECIPP_ALIGNMENT_FLOAT32_IEEE 10000000000 Compu_IDENTITY -10000000000 10000000000 PHYS_UNIT "ms" /end CHARACTERISTIC
/begin CHARACTERISTIC FPfl_FT_minv "FPrm_latch(107)" VALUE 0x001601C4 /* @ECU_Address@FPrm_latch@0x021BB1AC@ */ ECIPP_ALIGNMENT_FLOAT32_IEEE 10000000000 Compu_IDENTITY -10000000000 10000000000 PHYS_UNIT "ms" /end CHARACTERISTIC
/begin CHARACTERISTIC FPfl_FTgasf_maxv "FPrm_latch(171)" VALUE 0x001602C4 /* @ECU_Address@FPrm_latch@0x021BB2AC@ */ ECIPP_ALIGNMENT_FLOAT32_IEEE 10000000000 Compu_IDENTITY -10000000000 10000000000 PHYS_UNIT "ms" /end CHARACTERISTIC
/begin CHARACTERISTIC FPfl_FTgasf_minv "FPrm_latch(172)" VALUE 0x001602C8 /* @ECU_Address@FPrm_latch@0x021BB2B0@ */ ECIPP_ALIGNMENT_FLOAT32_IEEE 10000000000 Compu_IDENTITY -10000000000 10000000000 PHYS_UNIT "ms" /end CHARACTERISTIC
/begin CHARACTERISTIC FPfl_GLOW_unit_fail "FPrm_latch(382)" VALUE 0x00160610 /* @ECU_Address@FPrm_latch@0x021BB5F8@ */ ECIPP_ALIGNMENT_FLOAT32_IEEE 10000000000 Compu_IDENTITY -10000000000 10000000000 PHYS_UNIT "ms" /end CHARACTERISTIC
/begin CHARACTERISTIC FPfl_GLOW1_open "FPrm_latch(380)" VALUE 0x00160608 /* @ECU_Address@FPrm_latch@0x021BB5F0@ */ ECIPP_ALIGNMENT_FLOAT32_IEEE 10000000000 Compu_IDENTITY -10000000000 10000000000 PHYS_UNIT "ms" /end CHARACTERISTIC
/begin CHARACTERISTIC FPfl_GLOW1_short "FPrm_latch(381)" VALUE 0x0016060C /* @ECU_Address@FPrm_latch@0x021BB5F4@ */ ECIPP_ALIGNMENT_FLOAT32_IEEE 10000000000 Compu_IDENTITY -10000000000 10000000000 PHYS_UNIT "ms" /end CHARACTERISTIC
/begin CHARACTERISTIC FPfl_gov_ntrlock_fail "FPrm_latch(36)" VALUE 0x001600A8 /* @ECU_Address@FPrm_latch@0x021BB090@ */ ECIPP_ALIGNMENT_FLOAT32_IEEE 10000000000 Compu_IDENTITY -10000000000 10000000000 PHYS_UNIT "ms" /end CHARACTERISTIC
/begin CHARACTERISTIC FPfl_gyro_x_max "FPrm_latch(538)" VALUE 0x00160880 /* @ECU_Address@FPrm_latch@0x021BB868@ */ ECIPP_ALIGNMENT_FLOAT32_IEEE 10000000000 Compu_IDENTITY -10000000000 10000000000 PHYS_UNIT "ms" /end CHARACTERISTIC
/begin CHARACTERISTIC FPfl_gyro_x_min "FPrm_latch(539)" VALUE 0x00160884 /* @ECU_Address@FPrm_latch@0x021BB86C@ */ ECIPP_ALIGNMENT_FLOAT32_IEEE 10000000000 Compu_IDENTITY -10000000000 10000000000 PHYS_UNIT "ms" /end CHARACTERISTIC
/begin CHARACTERISTIC FPfl_gyro_y_max "FPrm_latch(540)" VALUE 0x00160888 /* @ECU_Address@FPrm_latch@0x021BB870@ */ ECIPP_ALIGNMENT_FLOAT32_IEEE 10000000000 Compu_IDENTITY -10000000000 10000000000 PHYS_UNIT "ms" /end CHARACTERISTIC
/begin CHARACTERISTIC FPfl_gyro_y_min "FPrm_latch(541)" VALUE 0x0016088C /* @ECU_Address@FPrm_latch@0x021BB874@ */ ECIPP_ALIGNMENT_FLOAT32_IEEE 10000000000 Compu_IDENTITY -10000000000 10000000000 PHYS_UNIT "ms" /end CHARACTERISTIC
/begin CHARACTERISTIC FPfl_gyro_z_max "FPrm_latch(542)" VALUE 0x00160890 /* @ECU_Address@FPrm_latch@0x021BB878@ */ ECIPP_ALIGNMENT_FLOAT32_IEEE 10000000000 Compu_IDENTITY -10000000000 10000000000 PHYS_UNIT "ms" /end CHARACTERISTIC
/begin CHARACTERISTIC FPfl_gyro_z_min "FPrm_latch(543)" VALUE 0x00160894 /* @ECU_Address@FPrm_latch@0x021BB87C@ */ ECIPP_ALIGNMENT_FLOAT32_IEEE 10000000000 Compu_IDENTITY -10000000000 10000000000 PHYS_UNIT "ms" /end CHARACTERISTIC
/begin CHARACTERISTIC FPfl_HBA_I_max "FPrm_latch(398)" VALUE 0x00160650 /* @ECU_Address@FPrm_latch@0x021BB638@ */ ECIPP_ALIGNMENT_FLOAT32_IEEE 10000000000 Compu_IDENTITY -10000000000 10000000000 PHYS_UNIT "ms" /end CHARACTERISTIC
/begin CHARACTERISTIC FPfl_HBB_I_max "FPrm_latch(399)" VALUE 0x00160654 /* @ECU_Address@FPrm_latch@0x021BB63C@ */ ECIPP_ALIGNMENT_FLOAT32_IEEE 10000000000 Compu_IDENTITY -10000000000 10000000000 PHYS_UNIT "ms" /end CHARACTERISTIC
/begin CHARACTERISTIC FPfl_HiDiagTemp "FPrm_latch(482)" VALUE 0x001607A0 /* @ECU_Address@FPrm_latch@0x021BB788@ */ ECIPP_ALIGNMENT_FLOAT32_IEEE 10000000000 Compu_IDENTITY -10000000000 10000000000 PHYS_UNIT "ms" /end CHARACTERISTIC
/begin CHARACTERISTIC FPfl_HWID_fail "FPrm_latch(227)" VALUE 0x001603A4 /* @ECU_Address@FPrm_latch@0x021BB38C@ */ ECIPP_ALIGNMENT_FLOAT32_IEEE 10000000000 Compu_IDENTITY -10000000000 10000000000 PHYS_UNIT "ms" /end CHARACTERISTIC
/begin CHARACTERISTIC FPfl_IAC_gndshort "FPrm_latch(116)" VALUE 0x001601E8 /* @ECU_Address@FPrm_latch@0x021BB1D0@ */ ECIPP_ALIGNMENT_FLOAT32_IEEE 10000000000 Compu_IDENTITY -10000000000 10000000000 PHYS_UNIT "samples" /end CHARACTERISTIC
/begin CHARACTERISTIC FPfl_IAC_openshort "FPrm_latch(117)" VALUE 0x001601EC /* @ECU_Address@FPrm_latch@0x021BB1D4@ */ ECIPP_ALIGNMENT_FLOAT32_IEEE 10000000000 Compu_IDENTITY -10000000000 10000000000 PHYS_UNIT "samples" /end CHARACTERISTIC
/begin CHARACTERISTIC FPfl_IAT_HiExp "FPrm_latch(8)" VALUE 0x00160038 /* @ECU_Address@FPrm_latch@0x021BB020@ */ ECIPP_ALIGNMENT_FLOAT32_IEEE 10000000000 Compu_IDENTITY -10000000000 10000000000 PHYS_UNIT "ms" /end CHARACTERISTIC
/begin CHARACTERISTIC FPfl_IAT_HiExp2 "FPrm_latch(9)" VALUE 0x0016003C /* @ECU_Address@FPrm_latch@0x021BB024@ */ ECIPP_ALIGNMENT_FLOAT32_IEEE 10000000000 Compu_IDENTITY -10000000000 10000000000 PHYS_UNIT "ms" /end CHARACTERISTIC
/begin CHARACTERISTIC FPfl_IAT_maxv "FPrm_latch(6)" VALUE 0x00160030 /* @ECU_Address@FPrm_latch@0x021BB018@ */ ECIPP_ALIGNMENT_FLOAT32_IEEE 10000000000 Compu_IDENTITY -10000000000 10000000000 PHYS_UNIT "ms" /end CHARACTERISTIC
/begin CHARACTERISTIC FPfl_IAT_minv "FPrm_latch(7)" VALUE 0x00160034 /* @ECU_Address@FPrm_latch@0x021BB01C@ */ ECIPP_ALIGNMENT_FLOAT32_IEEE 10000000000 Compu_IDENTITY -10000000000 10000000000 PHYS_UNIT "ms" /end CHARACTERISTIC
/begin CHARACTERISTIC FPfl_IBF_detected "FPrm_latch(688)" VALUE 0x00160AD8 /* @ECU_Address@FPrm_latch@0x021BBAC0@ */ ECIPP_ALIGNMENT_FLOAT32_IEEE 10000000000 Compu_IDENTITY -10000000000 10000000000 PHYS_UNIT "ms" /end CHARACTERISTIC
/begin CHARACTERISTIC FPfl_ICam_maxerr "FPrm_latch(210)" VALUE 0x00160360 /* @ECU_Address@FPrm_latch@0x021BB348@ */ ECIPP_ALIGNMENT_FLOAT32_IEEE 10000000000 Compu_IDENTITY -10000000000 10000000000 PHYS_UNIT "ms" /end CHARACTERISTIC
/begin CHARACTERISTIC FPfl_ICAVD1_mis "FPrm_latch(195)" VALUE 0x00160324 /* @ECU_Address@FPrm_latch@0x021BB30C@ */ ECIPP_ALIGNMENT_FLOAT32_IEEE 10000000000 Compu_IDENTITY -10000000000 10000000000 PHYS_UNIT "ms" /end CHARACTERISTIC
/begin CHARACTERISTIC FPfl_ICAVD1_miscat "FPrm_latch(196)" VALUE 0x00160328 /* @ECU_Address@FPrm_latch@0x021BB310@ */ ECIPP_ALIGNMENT_FLOAT32_IEEE 10000000000 Compu_IDENTITY -10000000000 10000000000 PHYS_UNIT "ms" /end CHARACTERISTIC
/begin CHARACTERISTIC FPfl_Idle_SD "FPrm_latch(484)" VALUE 0x001607A8 /* @ECU_Address@FPrm_latch@0x021BB790@ */ ECIPP_ALIGNMENT_FLOAT32_IEEE 10000000000 Compu_IDENTITY -10000000000 10000000000 PHYS_UNIT "ms" /end CHARACTERISTIC
/begin CHARACTERISTIC FPfl_imu_general "FPrm_latch(529)" VALUE 0x0016085C /* @ECU_Address@FPrm_latch@0x021BB844@ */ ECIPP_ALIGNMENT_FLOAT32_IEEE 10000000000 Compu_IDENTITY -10000000000 10000000000 PHYS_UNIT "samples" /end CHARACTERISTIC
/begin CHARACTERISTIC FPfl_imu_temp_max "FPrm_latch(530)" VALUE 0x00160860 /* @ECU_Address@FPrm_latch@0x021BB848@ */ ECIPP_ALIGNMENT_FLOAT32_IEEE 10000000000 Compu_IDENTITY -10000000000 10000000000 PHYS_UNIT "ms" /end CHARACTERISTIC
/begin CHARACTERISTIC FPfl_imu_temp_min "FPrm_latch(531)" VALUE 0x00160864 /* @ECU_Address@FPrm_latch@0x021BB84C@ */ ECIPP_ALIGNMENT_FLOAT32_IEEE 10000000000 Compu_IDENTITY -10000000000 10000000000 PHYS_UNIT "ms" /end CHARACTERISTIC
/begin CHARACTERISTIC FPfl_IMVD_Ifb_hi "FPrm_latch(437)" VALUE 0x001606EC /* @ECU_Address@FPrm_latch@0x021BB6D4@ */ ECIPP_ALIGNMENT_FLOAT32_IEEE 10000000000 Compu_IDENTITY -10000000000 10000000000 PHYS_UNIT "samples" /end CHARACTERISTIC
/begin CHARACTERISTIC FPfl_IMVD_Ifb_lo "FPrm_latch(436)" VALUE 0x001606E8 /* @ECU_Address@FPrm_latch@0x021BB6D0@ */ ECIPP_ALIGNMENT_FLOAT32_IEEE 10000000000 Compu_IDENTITY -10000000000 10000000000 PHYS_UNIT "samples" /end CHARACTERISTIC
/begin CHARACTERISTIC FPfl_INJD_boost_lo "FPrm_latch(434)" VALUE 0x001606E0 /* @ECU_Address@FPrm_latch@0x021BB6C8@ */ ECIPP_ALIGNMENT_FLOAT32_IEEE 10000000000 Compu_IDENTITY -10000000000 10000000000 PHYS_UNIT "samples" /end CHARACTERISTIC
/begin CHARACTERISTIC FPfl_INJD_HS_Ihi "FPrm_latch(432)" VALUE 0x001606D8 /* @ECU_Address@FPrm_latch@0x021BB6C0@ */ ECIPP_ALIGNMENT_FLOAT32_IEEE 10000000000 Compu_IDENTITY -10000000000 10000000000 PHYS_UNIT "samples" /end CHARACTERISTIC
/begin CHARACTERISTIC FPfl_INJD_HW_int "FPrm_latch(435)" VALUE 0x001606E4 /* @ECU_Address@FPrm_latch@0x021BB6CC@ */ ECIPP_ALIGNMENT_FLOAT32_IEEE 10000000000 Compu_IDENTITY -10000000000 10000000000 PHYS_UNIT "samples" /end CHARACTERISTIC
/begin CHARACTERISTIC FPfl_INJD_LS_Ihi "FPrm_latch(433)" VALUE 0x001606DC /* @ECU_Address@FPrm_latch@0x021BB6C4@ */ ECIPP_ALIGNMENT_FLOAT32_IEEE 10000000000 Compu_IDENTITY -10000000000 10000000000 PHYS_UNIT "samples" /end CHARACTERISTIC
/begin CHARACTERISTIC FPfl_INJD_off_lo "FPrm_latch(53)" VALUE 0x001600EC /* @ECU_Address@FPrm_latch@0x021BB0D4@ */ ECIPP_ALIGNMENT_FLOAT32_IEEE 10000000000 Compu_IDENTITY -10000000000 10000000000 PHYS_UNIT "samples" /end CHARACTERISTIC
/begin CHARACTERISTIC FPfl_INJD_on_hi "FPrm_latch(54)" VALUE 0x001600F0 /* @ECU_Address@FPrm_latch@0x021BB0D8@ */ ECIPP_ALIGNMENT_FLOAT32_IEEE 10000000000 Compu_IDENTITY -10000000000 10000000000 PHYS_UNIT "samples" /end CHARACTERISTIC
/begin CHARACTERISTIC FPfl_interrupt "FPrm_latch(68)" VALUE 0x00160128 /* @ECU_Address@FPrm_latch@0x021BB110@ */ ECIPP_ALIGNMENT_FLOAT32_IEEE 10000000000 Compu_IDENTITY -10000000000 10000000000 PHYS_UNIT "ms" /end CHARACTERISTIC
/begin CHARACTERISTIC FPfl_J1939_AAT_err_loss "FPrm_latch(662)" VALUE 0x00160A70 /* @ECU_Address@FPrm_latch@0x021BBA58@ */ ECIPP_ALIGNMENT_FLOAT32_IEEE 10000000000 Compu_IDENTITY -10000000000 10000000000 PHYS_UNIT "ms" /end CHARACTERISTIC
/begin CHARACTERISTIC FPfl_J1939_addr2Fail "FPrm_latch(223)" VALUE 0x00160394 /* @ECU_Address@FPrm_latch@0x021BB37C@ */ ECIPP_ALIGNMENT_FLOAT32_IEEE 10000000000 Compu_IDENTITY -10000000000 10000000000 PHYS_UNIT "ms" /end CHARACTERISTIC
/begin CHARACTERISTIC FPfl_J1939_addr3Fail "FPrm_latch(224)" VALUE 0x00160398 /* @ECU_Address@FPrm_latch@0x021BB380@ */ ECIPP_ALIGNMENT_FLOAT32_IEEE 10000000000 Compu_IDENTITY -10000000000 10000000000 PHYS_UNIT "ms" /end CHARACTERISTIC
/begin CHARACTERISTIC FPfl_J1939_addrFail "FPrm_latch(146)" VALUE 0x00160260 /* @ECU_Address@FPrm_latch@0x021BB248@ */ ECIPP_ALIGNMENT_FLOAT32_IEEE 10000000000 Compu_IDENTITY -10000000000 10000000000 PHYS_UNIT "ms" /end CHARACTERISTIC
/begin CHARACTERISTIC FPfl_J1939_ETC_loss "FPrm_latch(175)" VALUE 0x001602D4 /* @ECU_Address@FPrm_latch@0x021BB2BC@ */ ECIPP_ALIGNMENT_FLOAT32_IEEE 10000000000 Compu_IDENTITY -10000000000 10000000000 PHYS_UNIT "ms" /end CHARACTERISTIC
/begin CHARACTERISTIC FPfl_J1939_ETC_loss2 "FPrm_latch(197)" VALUE 0x0016032C /* @ECU_Address@FPrm_latch@0x021BB314@ */ ECIPP_ALIGNMENT_FLOAT32_IEEE 10000000000 Compu_IDENTITY -10000000000 10000000000 PHYS_UNIT "ms" /end CHARACTERISTIC
/begin CHARACTERISTIC FPfl_J1939_PGN_tout "FPrm_latch(544)" VALUE 0x00160898 /* @ECU_Address@FPrm_latch@0x021BB880@ */ ECIPP_ALIGNMENT_FLOAT32_IEEE 10000000000 Compu_IDENTITY -10000000000 10000000000 PHYS_UNIT "ms" /end CHARACTERISTIC
/begin CHARACTERISTIC FPfl_J1939_PGN_tout10 "FPrm_latch(553)" VALUE 0x001608BC /* @ECU_Address@FPrm_latch@0x021BB8A4@ */ ECIPP_ALIGNMENT_FLOAT32_IEEE 10000000000 Compu_IDENTITY -10000000000 10000000000 PHYS_UNIT "ms" /end CHARACTERISTIC
/begin CHARACTERISTIC FPfl_J1939_PGN_tout2 "FPrm_latch(545)" VALUE 0x0016089C /* @ECU_Address@FPrm_latch@0x021BB884@ */ ECIPP_ALIGNMENT_FLOAT32_IEEE 10000000000 Compu_IDENTITY -10000000000 10000000000 PHYS_UNIT "ms" /end CHARACTERISTIC
/begin CHARACTERISTIC FPfl_J1939_PGN_tout3 "FPrm_latch(546)" VALUE 0x001608A0 /* @ECU_Address@FPrm_latch@0x021BB888@ */ ECIPP_ALIGNMENT_FLOAT32_IEEE 10000000000 Compu_IDENTITY -10000000000 10000000000 PHYS_UNIT "ms" /end CHARACTERISTIC
/begin CHARACTERISTIC FPfl_J1939_PGN_tout4 "FPrm_latch(547)" VALUE 0x001608A4 /* @ECU_Address@FPrm_latch@0x021BB88C@ */ ECIPP_ALIGNMENT_FLOAT32_IEEE 10000000000 Compu_IDENTITY -10000000000 10000000000 PHYS_UNIT "ms" /end CHARACTERISTIC
/begin CHARACTERISTIC FPfl_J1939_PGN_tout5 "FPrm_latch(548)" VALUE 0x001608A8 /* @ECU_Address@FPrm_latch@0x021BB890@ */ ECIPP_ALIGNMENT_FLOAT32_IEEE 10000000000 Compu_IDENTITY -10000000000 10000000000 PHYS_UNIT "ms" /end CHARACTERISTIC
/begin CHARACTERISTIC FPfl_J1939_PGN_tout6 "FPrm_latch(549)" VALUE 0x001608AC /* @ECU_Address@FPrm_latch@0x021BB894@ */ ECIPP_ALIGNMENT_FLOAT32_IEEE 10000000000 Compu_IDENTITY -10000000000 10000000000 PHYS_UNIT "ms" /end CHARACTERISTIC
/begin CHARACTERISTIC FPfl_J1939_PGN_tout7 "FPrm_latch(550)" VALUE 0x001608B0 /* @ECU_Address@FPrm_latch@0x021BB898@ */ ECIPP_ALIGNMENT_FLOAT32_IEEE 10000000000 Compu_IDENTITY -10000000000 10000000000 PHYS_UNIT "ms" /end CHARACTERISTIC
/begin CHARACTERISTIC FPfl_J1939_PGN_tout8 "FPrm_latch(551)" VALUE 0x001608B4 /* @ECU_Address@FPrm_latch@0x021BB89C@ */ ECIPP_ALIGNMENT_FLOAT32_IEEE 10000000000 Compu_IDENTITY -10000000000 10000000000 PHYS_UNIT "ms" /end CHARACTERISTIC
/begin CHARACTERISTIC FPfl_J1939_PGN_tout9 "FPrm_latch(552)" VALUE 0x001608B8 /* @ECU_Address@FPrm_latch@0x021BB8A0@ */ ECIPP_ALIGNMENT_FLOAT32_IEEE 10000000000 Compu_IDENTITY -10000000000 10000000000 PHYS_UNIT "ms" /end CHARACTERISTIC
/begin CHARACTERISTIC FPfl_J1939_RS_err_loss "FPrm_latch(661)" VALUE 0x00160A6C /* @ECU_Address@FPrm_latch@0x021BBA54@ */ ECIPP_ALIGNMENT_FLOAT32_IEEE 10000000000 Compu_IDENTITY -10000000000 10000000000 PHYS_UNIT "ms" /end CHARACTERISTIC
/begin CHARACTERISTIC FPfl_J1939_RSsetpt_loss "FPrm_latch(454)" VALUE 0x00160730 /* @ECU_Address@FPrm_latch@0x021BB718@ */ ECIPP_ALIGNMENT_FLOAT32_IEEE 10000000000 Compu_IDENTITY -10000000000 10000000000 PHYS_UNIT "ms" /end CHARACTERISTIC
/begin CHARACTERISTIC FPfl_J1939_Rx2Fail "FPrm_latch(221)" VALUE 0x0016038C /* @ECU_Address@FPrm_latch@0x021BB374@ */ ECIPP_ALIGNMENT_FLOAT32_IEEE 10000000000 Compu_IDENTITY -10000000000 10000000000 PHYS_UNIT "ms" /end CHARACTERISTIC
/begin CHARACTERISTIC FPfl_J1939_Rx3Fail "FPrm_latch(222)" VALUE 0x00160390 /* @ECU_Address@FPrm_latch@0x021BB378@ */ ECIPP_ALIGNMENT_FLOAT32_IEEE 10000000000 Compu_IDENTITY -10000000000 10000000000 PHYS_UNIT "ms" /end CHARACTERISTIC
/begin CHARACTERISTIC FPfu_FPP2_IVS_max "FPrm_unlatch(32)" VALUE 0x00160B5C /* @ECU_Address@FPrm_unlatch@0x021BD080@ */ ECIPP_ALIGNMENT_FLOAT32_IEEE 10000000000 Compu_IDENTITY -10000000000 10000000000 PHYS_UNIT "ms" /end CHARACTERISTIC
/begin CHARACTERISTIC FPfu_FPP2_IVS_min "FPrm_unlatch(33)" VALUE 0x00160B60 /* @ECU_Address@FPrm_unlatch@0x021BD084@ */ ECIPP_ALIGNMENT_FLOAT32_IEEE 10000000000 Compu_IDENTITY -10000000000 10000000000 PHYS_UNIT "ms" /end CHARACTERISTIC
/begin CHARACTERISTIC FPfu_FPP2_max "FPrm_unlatch(28)" VALUE 0x00160B4C /* @ECU_Address@FPrm_unlatch@0x021BD070@ */ ECIPP_ALIGNMENT_FLOAT32_IEEE 10000000000 Compu_IDENTITY -10000000000 10000000000 PHYS_UNIT "ms" /end CHARACTERISTIC
/begin CHARACTERISTIC FPfu_FPP2_min "FPrm_unlatch(29)" VALUE 0x00160B50 /* @ECU_Address@FPrm_unlatch@0x021BD074@ */ ECIPP_ALIGNMENT_FLOAT32_IEEE 10000000000 Compu_IDENTITY -10000000000 10000000000 PHYS_UNIT "ms" /end CHARACTERISTIC
/begin CHARACTERISTIC FPfu_FPP2V_TSC1 "FPrm_unlatch(666)" VALUE 0x00161544 /* @ECU_Address@FPrm_unlatch@0x021BDA68@ */ ECIPP_ALIGNMENT_FLOAT32_IEEE 10000000000 Compu_IDENTITY -10000000000 10000000000 PHYS_UNIT "ms" /end CHARACTERISTIC
/begin CHARACTERISTIC FPfu_FPrly_coilopen "FPrm_unlatch(128)" VALUE 0x00160CDC /* @ECU_Address@FPrm_unlatch@0x021BD200@ */ ECIPP_ALIGNMENT_FLOAT32_IEEE 10000000000 Compu_IDENTITY -10000000000 10000000000 PHYS_UNIT "samples" /end CHARACTERISTIC
/begin CHARACTERISTIC FPfu_FPrly_coilshort "FPrm_unlatch(129)" VALUE 0x00160CE0 /* @ECU_Address@FPrm_unlatch@0x021BD204@ */ ECIPP_ALIGNMENT_FLOAT32_IEEE 10000000000 Compu_IDENTITY -10000000000 10000000000 PHYS_UNIT "samples" /end CHARACTERISTIC
/begin CHARACTERISTIC FPfu_FPrly_gndshort "FPrm_unlatch(127)" VALUE 0x00160CD8 /* @ECU_Address@FPrm_unlatch@0x021BD1FC@ */ ECIPP_ALIGNMENT_FLOAT32_IEEE 10000000000 Compu_IDENTITY -10000000000 10000000000 PHYS_UNIT "samples" /end CHARACTERISTIC
/begin CHARACTERISTIC FPfu_FSO_post_TPS_phi_hi "FPrm_unlatch(687)" VALUE 0x00161598 /* @ECU_Address@FPrm_unlatch@0x021BDABC@ */ ECIPP_ALIGNMENT_FLOAT32_IEEE 10000000000 Compu_IDENTITY -10000000000 10000000000 PHYS_UNIT "samples" /end CHARACTERISTIC
/begin CHARACTERISTIC FPfu_FSO_TPS_phi_hi "FPrm_unlatch(632)" VALUE 0x001614BC /* @ECU_Address@FPrm_unlatch@0x021BD9E0@ */ ECIPP_ALIGNMENT_FLOAT32_IEEE 10000000000 Compu_IDENTITY -10000000000 10000000000 PHYS_UNIT "ms" /end CHARACTERISTIC
/begin CHARACTERISTIC FPfu_FT_maxv "FPrm_unlatch(106)" VALUE 0x00160C84 /* @ECU_Address@FPrm_unlatch@0x021BD1A8@ */ ECIPP_ALIGNMENT_FLOAT32_IEEE 10000000000 Compu_IDENTITY -10000000000 10000000000 PHYS_UNIT "ms" /end CHARACTERISTIC
/begin CHARACTERISTIC FPfu_FT_minv "FPrm_unlatch(107)" VALUE 0x00160C88 /* @ECU_Address@FPrm_unlatch@0x021BD1AC@ */ ECIPP_ALIGNMENT_FLOAT32_IEEE 10000000000 Compu_IDENTITY -10000000000 10000000000 PHYS_UNIT "ms" /end CHARACTERISTIC
/begin CHARACTERISTIC FPfu_FTgasf_maxv "FPrm_unlatch(171)" VALUE 0x00160D88 /* @ECU_Address@FPrm_unlatch@0x021BD2AC@ */ ECIPP_ALIGNMENT_FLOAT32_IEEE 10000000000 Compu_IDENTITY -10000000000 10000000000 PHYS_UNIT "ms" /end CHARACTERISTIC
/begin CHARACTERISTIC FPfu_FTgasf_minv "FPrm_unlatch(172)" VALUE 0x00160D8C /* @ECU_Address@FPrm_unlatch@0x021BD2B0@ */ ECIPP_ALIGNMENT_FLOAT32_IEEE 10000000000 Compu_IDENTITY -10000000000 10000000000 PHYS_UNIT "ms" /end CHARACTERISTIC
/begin CHARACTERISTIC FPfu_GLOW_unit_fail "FPrm_unlatch(382)" VALUE 0x001610D4 /* @ECU_Address@FPrm_unlatch@0x021BD5F8@ */ ECIPP_ALIGNMENT_FLOAT32_IEEE 10000000000 Compu_IDENTITY -10000000000 10000000000 PHYS_UNIT "ms" /end CHARACTERISTIC
/begin CHARACTERISTIC FPfu_GLOW1_open "FPrm_unlatch(380)" VALUE 0x001610CC /* @ECU_Address@FPrm_unlatch@0x021BD5F0@ */ ECIPP_ALIGNMENT_FLOAT32_IEEE 10000000000 Compu_IDENTITY -10000000000 10000000000 PHYS_UNIT "ms" /end CHARACTERISTIC
/begin CHARACTERISTIC FPfu_GLOW1_short "FPrm_unlatch(381)" VALUE 0x001610D0 /* @ECU_Address@FPrm_unlatch@0x021BD5F4@ */ ECIPP_ALIGNMENT_FLOAT32_IEEE 10000000000 Compu_IDENTITY -10000000000 10000000000 PHYS_UNIT "ms" /end CHARACTERISTIC
/begin CHARACTERISTIC FPfu_gov_ntrlock_fail "FPrm_unlatch(36)" VALUE 0x00160B6C /* @ECU_Address@FPrm_unlatch@0x021BD090@ */ ECIPP_ALIGNMENT_FLOAT32_IEEE 10000000000 Compu_IDENTITY -10000000000 10000000000 PHYS_UNIT "ms" /end CHARACTERISTIC
/begin CHARACTERISTIC FPfu_gyro_x_max "FPrm_unlatch(538)" VALUE 0x00161344 /* @ECU_Address@FPrm_unlatch@0x021BD868@ */ ECIPP_ALIGNMENT_FLOAT32_IEEE 10000000000 Compu_IDENTITY -10000000000 10000000000 PHYS_UNIT "ms" /end CHARACTERISTIC
/begin CHARACTERISTIC FPfu_gyro_x_min "FPrm_unlatch(539)" VALUE 0x00161348 /* @ECU_Address@FPrm_unlatch@0x021BD86C@ */ ECIPP_ALIGNMENT_FLOAT32_IEEE 10000000000 Compu_IDENTITY -10000000000 10000000000 PHYS_UNIT "ms" /end CHARACTERISTIC
/begin CHARACTERISTIC FPfu_gyro_y_max "FPrm_unlatch(540)" VALUE 0x0016134C /* @ECU_Address@FPrm_unlatch@0x021BD870@ */ ECIPP_ALIGNMENT_FLOAT32_IEEE 10000000000 Compu_IDENTITY -10000000000 10000000000 PHYS_UNIT "ms" /end CHARACTERISTIC
/begin CHARACTERISTIC FPfu_gyro_y_min "FPrm_unlatch(541)" VALUE 0x00161350 /* @ECU_Address@FPrm_unlatch@0x021BD874@ */ ECIPP_ALIGNMENT_FLOAT32_IEEE 10000000000 Compu_IDENTITY -10000000000 10000000000 PHYS_UNIT "ms" /end CHARACTERISTIC
/begin CHARACTERISTIC FPfu_gyro_z_max "FPrm_unlatch(542)" VALUE 0x00161354 /* @ECU_Address@FPrm_unlatch@0x021BD878@ */ ECIPP_ALIGNMENT_FLOAT32_IEEE 10000000000 Compu_IDENTITY -10000000000 10000000000 PHYS_UNIT "ms" /end CHARACTERISTIC
/begin CHARACTERISTIC FPfu_gyro_z_min "FPrm_unlatch(543)" VALUE 0x00161358 /* @ECU_Address@FPrm_unlatch@0x021BD87C@ */ ECIPP_ALIGNMENT_FLOAT32_IEEE 10000000000 Compu_IDENTITY -10000000000 10000000000 PHYS_UNIT "ms" /end CHARACTERISTIC
/begin CHARACTERISTIC FPfu_HBA_I_max "FPrm_unlatch(398)" VALUE 0x00161114 /* @ECU_Address@FPrm_unlatch@0x021BD638@ */ ECIPP_ALIGNMENT_FLOAT32_IEEE 10000000000 Compu_IDENTITY -10000000000 10000000000 PHYS_UNIT "ms" /end CHARACTERISTIC
/begin CHARACTERISTIC FPfu_HBB_I_max "FPrm_unlatch(399)" VALUE 0x00161118 /* @ECU_Address@FPrm_unlatch@0x021BD63C@ */ ECIPP_ALIGNMENT_FLOAT32_IEEE 10000000000 Compu_IDENTITY -10000000000 10000000000 PHYS_UNIT "ms" /end CHARACTERISTIC
/begin CHARACTERISTIC FPfu_HiDiagTemp "FPrm_unlatch(482)" VALUE 0x00161264 /* @ECU_Address@FPrm_unlatch@0x021BD788@ */ ECIPP_ALIGNMENT_FLOAT32_IEEE 10000000000 Compu_IDENTITY -10000000000 10000000000 PHYS_UNIT "ms" /end CHARACTERISTIC
/begin CHARACTERISTIC FPfu_HWID_fail "FPrm_unlatch(227)" VALUE 0x00160E68 /* @ECU_Address@FPrm_unlatch@0x021BD38C@ */ ECIPP_ALIGNMENT_FLOAT32_IEEE 10000000000 Compu_IDENTITY -10000000000 10000000000 PHYS_UNIT "ms" /end CHARACTERISTIC
/begin CHARACTERISTIC FPfu_IAC_gndshort "FPrm_unlatch(116)" VALUE 0x00160CAC /* @ECU_Address@FPrm_unlatch@0x021BD1D0@ */ ECIPP_ALIGNMENT_FLOAT32_IEEE 10000000000 Compu_IDENTITY -10000000000 10000000000 PHYS_UNIT "samples" /end CHARACTERISTIC
/begin CHARACTERISTIC FPfu_IAC_openshort "FPrm_unlatch(117)" VALUE 0x00160CB0 /* @ECU_Address@FPrm_unlatch@0x021BD1D4@ */ ECIPP_ALIGNMENT_FLOAT32_IEEE 10000000000 Compu_IDENTITY -10000000000 10000000000 PHYS_UNIT "samples" /end CHARACTERISTIC
/begin CHARACTERISTIC FPfu_IAT_HiExp "FPrm_unlatch(8)" VALUE 0x00160AFC /* @ECU_Address@FPrm_unlatch@0x021BD020@ */ ECIPP_ALIGNMENT_FLOAT32_IEEE 10000000000 Compu_IDENTITY -10000000000 10000000000 PHYS_UNIT "ms" /end CHARACTERISTIC
/begin CHARACTERISTIC FPfu_IAT_HiExp2 "FPrm_unlatch(9)" VALUE 0x00160B00 /* @ECU_Address@FPrm_unlatch@0x021BD024@ */ ECIPP_ALIGNMENT_FLOAT32_IEEE 10000000000 Compu_IDENTITY -10000000000 10000000000 PHYS_UNIT "ms" /end CHARACTERISTIC
/begin CHARACTERISTIC FPfu_IAT_maxv "FPrm_unlatch(6)" VALUE 0x00160AF4 /* @ECU_Address@FPrm_unlatch@0x021BD018@ */ ECIPP_ALIGNMENT_FLOAT32_IEEE 10000000000 Compu_IDENTITY -10000000000 10000000000 PHYS_UNIT "ms" /end CHARACTERISTIC
/begin CHARACTERISTIC FPfu_IAT_minv "FPrm_unlatch(7)" VALUE 0x00160AF8 /* @ECU_Address@FPrm_unlatch@0x021BD01C@ */ ECIPP_ALIGNMENT_FLOAT32_IEEE 10000000000 Compu_IDENTITY -10000000000 10000000000 PHYS_UNIT "ms" /end CHARACTERISTIC
/begin CHARACTERISTIC FPfu_IBF_detected "FPrm_unlatch(688)" VALUE 0x0016159C /* @ECU_Address@FPrm_unlatch@0x021BDAC0@ */ ECIPP_ALIGNMENT_FLOAT32_IEEE 10000000000 Compu_IDENTITY -10000000000 10000000000 PHYS_UNIT "ms" /end CHARACTERISTIC
/begin CHARACTERISTIC FPfu_ICam_maxerr "FPrm_unlatch(210)" VALUE 0x00160E24 /* @ECU_Address@FPrm_unlatch@0x021BD348@ */ ECIPP_ALIGNMENT_FLOAT32_IEEE 10000000000 Compu_IDENTITY -10000000000 10000000000 PHYS_UNIT "ms" /end CHARACTERISTIC
/begin CHARACTERISTIC FPfu_ICAVD1_mis "FPrm_unlatch(195)" VALUE 0x00160DE8 /* @ECU_Address@FPrm_unlatch@0x021BD30C@ */ ECIPP_ALIGNMENT_FLOAT32_IEEE 10000000000 Compu_IDENTITY -10000000000 10000000000 PHYS_UNIT "ms" /end CHARACTERISTIC
/begin CHARACTERISTIC FPfu_ICAVD1_miscat "FPrm_unlatch(196)" VALUE 0x00160DEC /* @ECU_Address@FPrm_unlatch@0x021BD310@ */ ECIPP_ALIGNMENT_FLOAT32_IEEE 10000000000 Compu_IDENTITY -10000000000 10000000000 PHYS_UNIT "ms" /end CHARACTERISTIC
/begin CHARACTERISTIC FPfu_Idle_SD "FPrm_unlatch(484)" VALUE 0x0016126C /* @ECU_Address@FPrm_unlatch@0x021BD790@ */ ECIPP_ALIGNMENT_FLOAT32_IEEE 10000000000 Compu_IDENTITY -10000000000 10000000000 PHYS_UNIT "ms" /end CHARACTERISTIC
/begin CHARACTERISTIC FPfu_imu_general "FPrm_unlatch(529)" VALUE 0x00161320 /* @ECU_Address@FPrm_unlatch@0x021BD844@ */ ECIPP_ALIGNMENT_FLOAT32_IEEE 10000000000 Compu_IDENTITY -10000000000 10000000000 PHYS_UNIT "samples" /end CHARACTERISTIC
/begin CHARACTERISTIC FPfu_imu_temp_max "FPrm_unlatch(530)" VALUE 0x00161324 /* @ECU_Address@FPrm_unlatch@0x021BD848@ */ ECIPP_ALIGNMENT_FLOAT32_IEEE 10000000000 Compu_IDENTITY -10000000000 10000000000 PHYS_UNIT "ms" /end CHARACTERISTIC
/begin CHARACTERISTIC FPfu_imu_temp_min "FPrm_unlatch(531)" VALUE 0x00161328 /* @ECU_Address@FPrm_unlatch@0x021BD84C@ */ ECIPP_ALIGNMENT_FLOAT32_IEEE 10000000000 Compu_IDENTITY -10000000000 10000000000 PHYS_UNIT "ms" /end CHARACTERISTIC
/begin CHARACTERISTIC FPfu_IMVD_Ifb_hi "FPrm_unlatch(437)" VALUE 0x001611B0 /* @ECU_Address@FPrm_unlatch@0x021BD6D4@ */ ECIPP_ALIGNMENT_FLOAT32_IEEE 10000000000 Compu_IDENTITY -10000000000 10000000000 PHYS_UNIT "samples" /end CHARACTERISTIC
/begin CHARACTERISTIC FPfu_IMVD_Ifb_lo "FPrm_unlatch(436)" VALUE 0x001611AC /* @ECU_Address@FPrm_unlatch@0x021BD6D0@ */ ECIPP_ALIGNMENT_FLOAT32_IEEE 10000000000 Compu_IDENTITY -10000000000 10000000000 PHYS_UNIT "samples" /end CHARACTERISTIC
/begin CHARACTERISTIC FPfu_INJD_boost_lo "FPrm_unlatch(434)" VALUE 0x001611A4 /* @ECU_Address@FPrm_unlatch@0x021BD6C8@ */ ECIPP_ALIGNMENT_FLOAT32_IEEE 10000000000 Compu_IDENTITY -10000000000 10000000000 PHYS_UNIT "samples" /end CHARACTERISTIC
/begin CHARACTERISTIC FPfu_INJD_HS_Ihi "FPrm_unlatch(432)" VALUE 0x0016119C /* @ECU_Address@FPrm_unlatch@0x021BD6C0@ */ ECIPP_ALIGNMENT_FLOAT32_IEEE 10000000000 Compu_IDENTITY -10000000000 10000000000 PHYS_UNIT "samples" /end CHARACTERISTIC
/begin CHARACTERISTIC FPfu_INJD_HW_int "FPrm_unlatch(435)" VALUE 0x001611A8 /* @ECU_Address@FPrm_unlatch@0x021BD6CC@ */ ECIPP_ALIGNMENT_FLOAT32_IEEE 10000000000 Compu_IDENTITY -10000000000 10000000000 PHYS_UNIT "samples" /end CHARACTERISTIC
/begin CHARACTERISTIC FPfu_INJD_LS_Ihi "FPrm_unlatch(433)" VALUE 0x001611A0 /* @ECU_Address@FPrm_unlatch@0x021BD6C4@ */ ECIPP_ALIGNMENT_FLOAT32_IEEE 10000000000 Compu_IDENTITY -10000000000 10000000000 PHYS_UNIT "samples" /end CHARACTERISTIC
/begin CHARACTERISTIC FPfu_INJD_off_lo "FPrm_unlatch(53)" VALUE 0x00160BB0 /* @ECU_Address@FPrm_unlatch@0x021BD0D4@ */ ECIPP_ALIGNMENT_FLOAT32_IEEE 10000000000 Compu_IDENTITY -10000000000 10000000000 PHYS_UNIT "samples" /end CHARACTERISTIC
/begin CHARACTERISTIC FPfu_INJD_on_hi "FPrm_unlatch(54)" VALUE 0x00160BB4 /* @ECU_Address@FPrm_unlatch@0x021BD0D8@ */ ECIPP_ALIGNMENT_FLOAT32_IEEE 10000000000 Compu_IDENTITY -10000000000 10000000000 PHYS_UNIT "samples" /end CHARACTERISTIC
/begin CHARACTERISTIC FPfu_interrupt "FPrm_unlatch(68)" VALUE 0x00160BEC /* @ECU_Address@FPrm_unlatch@0x021BD110@ */ ECIPP_ALIGNMENT_FLOAT32_IEEE 10000000000 Compu_IDENTITY -10000000000 10000000000 PHYS_UNIT "ms" /end CHARACTERISTIC
/begin CHARACTERISTIC FPfu_J1939_AAT_err_loss "FPrm_unlatch(662)" VALUE 0x00161534 /* @ECU_Address@FPrm_unlatch@0x021BDA58@ */ ECIPP_ALIGNMENT_FLOAT32_IEEE 10000000000 Compu_IDENTITY -10000000000 10000000000 PHYS_UNIT "ms" /end CHARACTERISTIC
/begin CHARACTERISTIC FPfu_J1939_addr2Fail "FPrm_unlatch(223)" VALUE 0x00160E58 /* @ECU_Address@FPrm_unlatch@0x021BD37C@ */ ECIPP_ALIGNMENT_FLOAT32_IEEE 10000000000 Compu_IDENTITY -10000000000 10000000000 PHYS_UNIT "ms" /end CHARACTERISTIC
/begin CHARACTERISTIC FPfu_J1939_addr3Fail "FPrm_unlatch(224)" VALUE 0x00160E5C /* @ECU_Address@FPrm_unlatch@0x021BD380@ */ ECIPP_ALIGNMENT_FLOAT32_IEEE 10000000000 Compu_IDENTITY -10000000000 10000000000 PHYS_UNIT "ms" /end CHARACTERISTIC
/begin CHARACTERISTIC FPfu_J1939_addrFail "FPrm_unlatch(146)" VALUE 0x00160D24 /* @ECU_Address@FPrm_unlatch@0x021BD248@ */ ECIPP_ALIGNMENT_FLOAT32_IEEE 10000000000 Compu_IDENTITY -10000000000 10000000000 PHYS_UNIT "ms" /end CHARACTERISTIC
/begin CHARACTERISTIC FPfu_J1939_ETC_loss "FPrm_unlatch(175)" VALUE 0x00160D98 /* @ECU_Address@FPrm_unlatch@0x021BD2BC@ */ ECIPP_ALIGNMENT_FLOAT32_IEEE 10000000000 Compu_IDENTITY -10000000000 10000000000 PHYS_UNIT "ms" /end CHARACTERISTIC
/begin CHARACTERISTIC FPfu_J1939_ETC_loss2 "FPrm_unlatch(197)" VALUE 0x00160DF0 /* @ECU_Address@FPrm_unlatch@0x021BD314@ */ ECIPP_ALIGNMENT_FLOAT32_IEEE 10000000000 Compu_IDENTITY -10000000000 10000000000 PHYS_UNIT "ms" /end CHARACTERISTIC
/begin CHARACTERISTIC FPfu_J1939_PGN_tout "FPrm_unlatch(544)" VALUE 0x0016135C /* @ECU_Address@FPrm_unlatch@0x021BD880@ */ ECIPP_ALIGNMENT_FLOAT32_IEEE 10000000000 Compu_IDENTITY -10000000000 10000000000 PHYS_UNIT "ms" /end CHARACTERISTIC
/begin CHARACTERISTIC FPfu_J1939_PGN_tout10 "FPrm_unlatch(553)" VALUE 0x00161380 /* @ECU_Address@FPrm_unlatch@0x021BD8A4@ */ ECIPP_ALIGNMENT_FLOAT32_IEEE 10000000000 Compu_IDENTITY -10000000000 10000000000 PHYS_UNIT "ms" /end CHARACTERISTIC
/begin CHARACTERISTIC FPfu_J1939_PGN_tout2 "FPrm_unlatch(545)" VALUE 0x00161360 /* @ECU_Address@FPrm_unlatch@0x021BD884@ */ ECIPP_ALIGNMENT_FLOAT32_IEEE 10000000000 Compu_IDENTITY -10000000000 10000000000 PHYS_UNIT "ms" /end CHARACTERISTIC
/begin CHARACTERISTIC FPfu_J1939_PGN_tout3 "FPrm_unlatch(546)" VALUE 0x00161364 /* @ECU_Address@FPrm_unlatch@0x021BD888@ */ ECIPP_ALIGNMENT_FLOAT32_IEEE 10000000000 Compu_IDENTITY -10000000000 10000000000 PHYS_UNIT "ms" /end CHARACTERISTIC
/begin CHARACTERISTIC FPfu_J1939_PGN_tout4 "FPrm_unlatch(547)" VALUE 0x00161368 /* @ECU_Address@FPrm_unlatch@0x021BD88C@ */ ECIPP_ALIGNMENT_FLOAT32_IEEE 10000000000 Compu_IDENTITY -10000000000 10000000000 PHYS_UNIT "ms" /end CHARACTERISTIC
/begin CHARACTERISTIC FPfu_J1939_PGN_tout5 "FPrm_unlatch(548)" VALUE 0x0016136C /* @ECU_Address@FPrm_unlatch@0x021BD890@ */ ECIPP_ALIGNMENT_FLOAT32_IEEE 10000000000 Compu_IDENTITY -10000000000 10000000000 PHYS_UNIT "ms" /end CHARACTERISTIC
/begin CHARACTERISTIC FPfu_J1939_PGN_tout6 "FPrm_unlatch(549)" VALUE 0x00161370 /* @ECU_Address@FPrm_unlatch@0x021BD894@ */ ECIPP_ALIGNMENT_FLOAT32_IEEE 10000000000 Compu_IDENTITY -10000000000 10000000000 PHYS_UNIT "ms" /end CHARACTERISTIC
/begin CHARACTERISTIC FPfu_J1939_PGN_tout7 "FPrm_unlatch(550)" VALUE 0x00161374 /* @ECU_Address@FPrm_unlatch@0x021BD898@ */ ECIPP_ALIGNMENT_FLOAT32_IEEE 10000000000 Compu_IDENTITY -10000000000 10000000000 PHYS_UNIT "ms" /end CHARACTERISTIC
/begin CHARACTERISTIC FPfu_J1939_PGN_tout8 "FPrm_unlatch(551)" VALUE 0x00161378 /* @ECU_Address@FPrm_unlatch@0x021BD89C@ */ ECIPP_ALIGNMENT_FLOAT32_IEEE 10000000000 Compu_IDENTITY -10000000000 10000000000 PHYS_UNIT "ms" /end CHARACTERISTIC
/begin CHARACTERISTIC FPfu_J1939_PGN_tout9 "FPrm_unlatch(552)" VALUE 0x0016137C /* @ECU_Address@FPrm_unlatch@0x021BD8A0@ */ ECIPP_ALIGNMENT_FLOAT32_IEEE 10000000000 Compu_IDENTITY -10000000000 10000000000 PHYS_UNIT "ms" /end CHARACTERISTIC
/begin CHARACTERISTIC FPfu_J1939_RS_err_loss "FPrm_unlatch(661)" VALUE 0x00161530 /* @ECU_Address@FPrm_unlatch@0x021BDA54@ */ ECIPP_ALIGNMENT_FLOAT32_IEEE 10000000000 Compu_IDENTITY -10000000000 10000000000 PHYS_UNIT "ms" /end CHARACTERISTIC
/begin CHARACTERISTIC FPfu_J1939_RSsetpt_loss "FPrm_unlatch(454)" VALUE 0x001611F4 /* @ECU_Address@FPrm_unlatch@0x021BD718@ */ ECIPP_ALIGNMENT_FLOAT32_IEEE 10000000000 Compu_IDENTITY -10000000000 10000000000 PHYS_UNIT "ms" /end CHARACTERISTIC
/begin CHARACTERISTIC FPfu_J1939_Rx2Fail "FPrm_unlatch(221)" VALUE 0x00160E50 /* @ECU_Address@FPrm_unlatch@0x021BD374@ */ ECIPP_ALIGNMENT_FLOAT32_IEEE 10000000000 Compu_IDENTITY -10000000000 10000000000 PHYS_UNIT "ms" /end CHARACTERISTIC
/begin CHARACTERISTIC FPfu_J1939_Rx3Fail "FPrm_unlatch(222)" VALUE 0x00160E54 /* @ECU_Address@FPrm_unlatch@0x021BD378@ */ ECIPP_ALIGNMENT_FLOAT32_IEEE 10000000000 Compu_IDENTITY -10000000000 10000000000 PHYS_UNIT "ms" /end CHARACTERISTIC
/begin GROUP FPP2_IVS_max_EC_Fault "FPP2 higher than IVS limit"
 /begin REF_CHARACTERISTIC FCdc4_FPP2_IVS_max FCdtc_FPP2_IVS_max FCfmi_FPP2_IVS_max FCftb_FPP2_IVS_max FCspn_FPP2_IVS_max FPfl_FPP2_IVS_max FPfu_FPP2_IVS_max FPnd_FPP2_IVS_max FPsvr_FPP2_IVS_max FPsw_ext1_FPP2_IVS_max FPsw_FPP2_IVS_max /end REF_CHARACTERISTIC
/end GROUP
/begin GROUP FPP2_IVS_min_EC_Fault "FPP2 lower than IVS limit"
 /begin REF_CHARACTERISTIC FCdc4_FPP2_IVS_min FCdtc_FPP2_IVS_min FCfmi_FPP2_IVS_min FCftb_FPP2_IVS_min FCspn_FPP2_IVS_min FPfl_FPP2_IVS_min FPfu_FPP2_IVS_min FPnd_FPP2_IVS_min FPsvr_FPP2_IVS_min FPsw_ext1_FPP2_IVS_min FPsw_FPP2_IVS_min /end REF_CHARACTERISTIC
/end GROUP
/begin GROUP FPP2_max_EC_Fault "FPP2 high voltage"
 /begin REF_CHARACTERISTIC FCdc4_FPP2_max FCdtc_FPP2_max FCfmi_FPP2_max FCftb_FPP2_max FCspn_FPP2_max FPfl_FPP2_max FPfu_FPP2_max FPnd_FPP2_max FPsvr_FPP2_max FPsw_ext1_FPP2_max FPsw_FPP2_max /end REF_CHARACTERISTIC
/end GROUP
/begin GROUP FPP2_min_EC_Fault "FPP2 low voltage"
 /begin REF_CHARACTERISTIC FCdc4_FPP2_min FCdtc_FPP2_min FCfmi_FPP2_min FCftb_FPP2_min FCspn_FPP2_min FPfl_FPP2_min FPfu_FPP2_min FPnd_FPP2_min FPsvr_FPP2_min FPsw_ext1_FPP2_min FPsw_FPP2_min /end REF_CHARACTERISTIC
/end GROUP
/begin GROUP FPP2V_TSC1_EC_Fault "FPP2 fault and J1939 TSC1 message receipt lost"
 /begin REF_CHARACTERISTIC FCdc4_FPP2V_TSC1 FCdtc_FPP2V_TSC1 FCfmi_FPP2V_TSC1 FCftb_FPP2V_TSC1 FCspn_FPP2V_TSC1 FPfl_FPP2V_TSC1 FPfu_FPP2V_TSC1 FPnd_FPP2V_TSC1 FPsvr_FPP2V_TSC1 FPsw_ext1_FPP2V_TSC1 FPsw_FPP2V_TSC1 /end REF_CHARACTERISTIC
/end GROUP
/begin GROUP FPrly_coilopen_EC_Fault "Fuel pump relay coil open"
 /begin REF_CHARACTERISTIC FCdc4_FPrly_coilopen FCdtc_FPrly_coilopen FCfmi_FPrly_coilopen FCftb_FPrly_coilopen FCspn_FPrly_coilopen FPfl_FPrly_coilopen FPfu_FPrly_coilopen FPnd_FPrly_coilopen FPsvr_FPrly_coilopen FPsw_ext1_FPrly_coilopen FPsw_FPrly_coilopen /end REF_CHARACTERISTIC
/end GROUP
/begin GROUP FPrly_coilshort_EC_Fault "Fuel pump relay coil short to power"
 /begin REF_CHARACTERISTIC FCdc4_FPrly_coilshort FCdtc_FPrly_coilshort FCfmi_FPrly_coilshort FCftb_FPrly_coilshort FCspn_FPrly_coilshort FPfl_FPrly_coilshort FPfu_FPrly_coilshort FPnd_FPrly_coilshort FPsvr_FPrly_coilshort FPsw_ext1_FPrly_coilshort FPsw_FPrly_coilshort /end REF_CHARACTERISTIC
/end GROUP
/begin GROUP FPrly_gndshort_EC_Fault "Fuel pump relay control ground short"
 /begin REF_CHARACTERISTIC FCdc4_FPrly_gndshort FCdtc_FPrly_gndshort FCfmi_FPrly_gndshort FCftb_FPrly_gndshort FCspn_FPrly_gndshort FPfl_FPrly_gndshort FPfu_FPrly_gndshort FPnd_FPrly_gndshort FPsvr_FPrly_gndshort FPsw_ext1_FPrly_gndshort FPsw_FPrly_gndshort /end REF_CHARACTERISTIC
/end GROUP
/begin GROUP FSO_post_TPS_phi_hi_EC_Fault "Failed to reach FSO post throttle open UEGO limit"
 /begin REF_CHARACTERISTIC FCdc4_FSO_post_TPS_phi_hi FCdtc_FSO_post_TPS_phi_hi FCfmi_FSO_post_TPS_phi_hi FCftb_FSO_post_TPS_phi_hi FCspn_FSO_post_TPS_phi_hi FPfl_FSO_post_TPS_phi_hi FPfu_FSO_post_TPS_phi_hi FPnd_FSO_post_TPS_phi_hi FPsvr_FSO_post_TPS_phi_hi FPsw_ext1_FSO_post_TPS_phi_hi FPsw_FSO_post_TPS_phi_hi /end REF_CHARACTERISTIC
/end GROUP
/begin GROUP FSO_TPS_phi_hi_EC_Fault "Failed to reach FSO throttle open UEGO limit"
 /begin REF_CHARACTERISTIC FCdc4_FSO_TPS_phi_hi FCdtc_FSO_TPS_phi_hi FCfmi_FSO_TPS_phi_hi FCftb_FSO_TPS_phi_hi FCspn_FSO_TPS_phi_hi FPfl_FSO_TPS_phi_hi FPfu_FSO_TPS_phi_hi FPnd_FSO_TPS_phi_hi FPsvr_FSO_TPS_phi_hi FPsw_ext1_FSO_TPS_phi_hi FPsw_FSO_TPS_phi_hi /end REF_CHARACTERISTIC
/end GROUP
/begin GROUP FT_maxv_EC_Fault "FT gasoline high"
 /begin REF_CHARACTERISTIC FCdc4_FT_maxv FCdtc_FT_maxv FCfmi_FT_maxv FCftb_FT_maxv FCspn_FT_maxv FPfl_FT_maxv FPfu_FT_maxv FPnd_FT_maxv FPsvr_FT_maxv FPsw_ext1_FT_maxv FPsw_FT_maxv /end REF_CHARACTERISTIC
/end GROUP
/begin GROUP FT_minv_EC_Fault "FT gasoline low"
 /begin REF_CHARACTERISTIC FCdc4_FT_minv FCdtc_FT_minv FCfmi_FT_minv FCftb_FT_minv FCspn_FT_minv FPfl_FT_minv FPfu_FT_minv FPnd_FT_minv FPsvr_FT_minv FPsw_ext1_FT_minv FPsw_FT_minv /end REF_CHARACTERISTIC
/end GROUP
/begin GROUP FTgasf_maxv_EC_Fault "FT gaseous fuel high"
 /begin REF_CHARACTERISTIC FCdc4_FTgasf_maxv FCdtc_FTgasf_maxv FCfmi_FTgasf_maxv FCftb_FTgasf_maxv FCspn_FTgasf_maxv FPfl_FTgasf_maxv FPfu_FTgasf_maxv FPnd_FTgasf_maxv FPsvr_FTgasf_maxv FPsw_ext1_FTgasf_maxv FPsw_FTgasf_maxv /end REF_CHARACTERISTIC
/end GROUP
/begin GROUP FTgasf_minv_EC_Fault "FT gaseous fuel low"
 /begin REF_CHARACTERISTIC FCdc4_FTgasf_minv FCdtc_FTgasf_minv FCfmi_FTgasf_minv FCftb_FTgasf_minv FCspn_FTgasf_minv FPfl_FTgasf_minv FPfu_FTgasf_minv FPnd_FTgasf_minv FPsvr_FTgasf_minv FPsw_ext1_FTgasf_minv FPsw_FTgasf_minv /end REF_CHARACTERISTIC
/end GROUP
/begin GROUP GLOW_unit_fail_EC_Fault "Glow Plug Control Unit Failure"
 /begin REF_CHARACTERISTIC FCdc4_GLOW_unit_fail FCdtc_GLOW_unit_fail FCfmi_GLOW_unit_fail FCftb_GLOW_unit_fail FCspn_GLOW_unit_fail FPfl_GLOW_unit_fail FPfu_GLOW_unit_fail FPnd_GLOW_unit_fail FPsvr_GLOW_unit_fail FPsw_ext1_GLOW_unit_fail FPsw_GLOW_unit_fail /end REF_CHARACTERISTIC
/end GROUP
/begin GROUP GLOW1_open_EC_Fault "Glow Plug Open/Power Short"
 /begin REF_CHARACTERISTIC FCdc4_GLOW1_open FCdtc_GLOW1_open FCfmi_GLOW1_open FCftb_GLOW1_open FCspn_GLOW1_open FPfl_GLOW1_open FPfu_GLOW1_open FPnd_GLOW1_open FPsvr_GLOW1_open FPsw_ext1_GLOW1_open FPsw_GLOW1_open /end REF_CHARACTERISTIC
/end GROUP
/begin GROUP GLOW1_short_EC_Fault "Glow Plug Short to Ground"
 /begin REF_CHARACTERISTIC FCdc4_GLOW1_short FCdtc_GLOW1_short FCfmi_GLOW1_short FCftb_GLOW1_short FCspn_GLOW1_short FPfl_GLOW1_short FPfu_GLOW1_short FPnd_GLOW1_short FPsvr_GLOW1_short FPsw_ext1_GLOW1_short FPsw_GLOW1_short /end REF_CHARACTERISTIC
/end GROUP
/begin GROUP gov_ntrlock_fail_EC_Fault "IVS/Brake/Trans-Park interlock failure"
 /begin REF_CHARACTERISTIC FCdc4_gov_ntrlock_fail FCdtc_gov_ntrlock_fail FCfmi_gov_ntrlock_fail FCftb_gov_ntrlock_fail FCspn_gov_ntrlock_fail FPfl_gov_ntrlock_fail FPfu_gov_ntrlock_fail FPnd_gov_ntrlock_fail FPsvr_gov_ntrlock_fail FPsw_ext1_gov_ntrlock_fail FPsw_gov_ntrlock_fail /end REF_CHARACTERISTIC
/end GROUP
/begin GROUP gyro_x_max_EC_Fault "Gyroscope X-axis out-of-range high"
 /begin REF_CHARACTERISTIC FCdc4_gyro_x_max FCdtc_gyro_x_max FCfmi_gyro_x_max FCftb_gyro_x_max FCspn_gyro_x_max FPfl_gyro_x_max FPfu_gyro_x_max FPnd_gyro_x_max FPsvr_gyro_x_max FPsw_ext1_gyro_x_max FPsw_gyro_x_max /end REF_CHARACTERISTIC
/end GROUP
/begin GROUP gyro_x_min_EC_Fault "Gyroscope X-axis out-of-range low"
 /begin REF_CHARACTERISTIC FCdc4_gyro_x_min FCdtc_gyro_x_min FCfmi_gyro_x_min FCftb_gyro_x_min FCspn_gyro_x_min FPfl_gyro_x_min FPfu_gyro_x_min FPnd_gyro_x_min FPsvr_gyro_x_min FPsw_ext1_gyro_x_min FPsw_gyro_x_min /end REF_CHARACTERISTIC
/end GROUP
/begin GROUP gyro_y_max_EC_Fault "Gyroscope Y-axis out-of-range high"
 /begin REF_CHARACTERISTIC FCdc4_gyro_y_max FCdtc_gyro_y_max FCfmi_gyro_y_max FCftb_gyro_y_max FCspn_gyro_y_max FPfl_gyro_y_max FPfu_gyro_y_max FPnd_gyro_y_max FPsvr_gyro_y_max FPsw_ext1_gyro_y_max FPsw_gyro_y_max /end REF_CHARACTERISTIC
/end GROUP
/begin GROUP gyro_y_min_EC_Fault "Gyroscope Y-axis out-of-range low"
 /begin REF_CHARACTERISTIC FCdc4_gyro_y_min FCdtc_gyro_y_min FCfmi_gyro_y_min FCftb_gyro_y_min FCspn_gyro_y_min FPfl_gyro_y_min FPfu_gyro_y_min FPnd_gyro_y_min FPsvr_gyro_y_min FPsw_ext1_gyro_y_min FPsw_gyro_y_min /end REF_CHARACTERISTIC
/end GROUP
/begin GROUP gyro_z_max_EC_Fault "Gyroscope Z-axis out-of-range high"
 /begin REF_CHARACTERISTIC FCdc4_gyro_z_max FCdtc_gyro_z_max FCfmi_gyro_z_max FCftb_gyro_z_max FCspn_gyro_z_max FPfl_gyro_z_max FPfu_gyro_z_max FPnd_gyro_z_max FPsvr_gyro_z_max FPsw_ext1_gyro_z_max FPsw_gyro_z_max /end REF_CHARACTERISTIC
/end GROUP
/begin GROUP gyro_z_min_EC_Fault "Gyroscope Z-axis out-of-range low"
 /begin REF_CHARACTERISTIC FCdc4_gyro_z_min FCdtc_gyro_z_min FCfmi_gyro_z_min FCftb_gyro_z_min FCspn_gyro_z_min FPfl_gyro_z_min FPfu_gyro_z_min FPnd_gyro_z_min FPsvr_gyro_z_min FPsw_ext1_gyro_z_min FPsw_gyro_z_min /end REF_CHARACTERISTIC
/end GROUP
/begin GROUP HBA_I_max_EC_Fault "HBA drive current high"
 /begin REF_CHARACTERISTIC FCdc4_HBA_I_max FCdtc_HBA_I_max FCfmi_HBA_I_max FCftb_HBA_I_max FCspn_HBA_I_max FPfl_HBA_I_max FPfu_HBA_I_max FPnd_HBA_I_max FPsvr_HBA_I_max FPsw_ext1_HBA_I_max FPsw_HBA_I_max /end REF_CHARACTERISTIC
/end GROUP
/begin GROUP HBB_I_max_EC_Fault "HBB drive current high"
 /begin REF_CHARACTERISTIC FCdc4_HBB_I_max FCdtc_HBB_I_max FCfmi_HBB_I_max FCftb_HBB_I_max FCspn_HBB_I_max FPfl_HBB_I_max FPfu_HBB_I_max FPnd_HBB_I_max FPsvr_HBB_I_max FPsw_ext1_HBB_I_max FPsw_HBB_I_max /end REF_CHARACTERISTIC
/end GROUP
/begin GROUP HiDiagTemp_EC_Fault "ECT too high to enable diagnostics"
 /begin REF_CHARACTERISTIC FCdc4_HiDiagTemp FCdtc_HiDiagTemp FCfmi_HiDiagTemp FCftb_HiDiagTemp FCspn_HiDiagTemp FPfl_HiDiagTemp FPfu_HiDiagTemp FPnd_HiDiagTemp FPsvr_HiDiagTemp FPsw_ext1_HiDiagTemp FPsw_HiDiagTemp /end REF_CHARACTERISTIC
/end GROUP
/begin GROUP HWID_fail_EC_Fault "Hardware ID Failure"
 /begin REF_CHARACTERISTIC FCdc4_HWID_fail FCdtc_HWID_fail FCfmi_HWID_fail FCftb_HWID_fail FCspn_HWID_fail FPfl_HWID_fail FPfu_HWID_fail FPnd_HWID_fail FPsvr_HWID_fail FPsw_ext1_HWID_fail FPsw_HWID_fail /end REF_CHARACTERISTIC
/end GROUP
/begin GROUP IAC_gndshort_EC_Fault "IAC ground short"
 /begin REF_CHARACTERISTIC FCdc4_IAC_gndshort FCdtc_IAC_gndshort FCfmi_IAC_gndshort FCftb_IAC_gndshort FCspn_IAC_gndshort FPfl_IAC_gndshort FPfu_IAC_gndshort FPnd_IAC_gndshort FPsvr_IAC_gndshort FPsw_ext1_IAC_gndshort FPsw_IAC_gndshort /end REF_CHARACTERISTIC
/end GROUP
/begin GROUP IAC_openshort_EC_Fault "IAC coil open/short"
 /begin REF_CHARACTERISTIC FCdc4_IAC_openshort FCdtc_IAC_openshort FCfmi_IAC_openshort FCftb_IAC_openshort FCspn_IAC_openshort FPfl_IAC_openshort FPfu_IAC_openshort FPnd_IAC_openshort FPsvr_IAC_openshort FPsw_ext1_IAC_openshort FPsw_IAC_openshort /end REF_CHARACTERISTIC
/end GROUP
/begin GROUP IAT_HiExp_EC_Fault "IAT higher than expected 1"
 /begin REF_CHARACTERISTIC FCdc4_IAT_HiExp FCdtc_IAT_HiExp FCfmi_IAT_HiExp FCftb_IAT_HiExp FCspn_IAT_HiExp FPfl_IAT_HiExp FPfu_IAT_HiExp FPnd_IAT_HiExp FPsvr_IAT_HiExp FPsw_ext1_IAT_HiExp FPsw_IAT_HiExp /end REF_CHARACTERISTIC
/end GROUP
/begin GROUP IAT_HiExp2_EC_Fault "IAT higher than expected 2"
 /begin REF_CHARACTERISTIC FCdc4_IAT_HiExp2 FCdtc_IAT_HiExp2 FCfmi_IAT_HiExp2 FCftb_IAT_HiExp2 FCspn_IAT_HiExp2 FPfl_IAT_HiExp2 FPfu_IAT_HiExp2 FPnd_IAT_HiExp2 FPsvr_IAT_HiExp2 FPsw_ext1_IAT_HiExp2 FPsw_IAT_HiExp2 /end REF_CHARACTERISTIC
/end GROUP
/begin GROUP IAT_maxv_EC_Fault "IAT high voltage"
 /begin REF_CHARACTERISTIC FCdc4_IAT_maxv FCdtc_IAT_maxv FCfmi_IAT_maxv FCftb_IAT_maxv FCspn_IAT_maxv FPfl_IAT_maxv FPfu_IAT_maxv FPnd_IAT_maxv FPsvr_IAT_maxv FPsw_ext1_IAT_maxv FPsw_IAT_maxv /end REF_CHARACTERISTIC
/end GROUP
/begin GROUP IAT_minv_EC_Fault "IAT low voltage"
 /begin REF_CHARACTERISTIC FCdc4_IAT_minv FCdtc_IAT_minv FCfmi_IAT_minv FCftb_IAT_minv FCspn_IAT_minv FPfl_IAT_minv FPfu_IAT_minv FPnd_IAT_minv FPsvr_IAT_minv FPsw_ext1_IAT_minv FPsw_IAT_minv /end REF_CHARACTERISTIC
/end GROUP
/begin GROUP IBF_detected_EC_Fault "Intake backfire detected"
 /begin REF_CHARACTERISTIC FCdc4_IBF_detected FCdtc_IBF_detected FCfmi_IBF_detected FCftb_IBF_detected FCspn_IBF_detected FPfl_IBF_detected FPfu_IBF_detected FPnd_IBF_detected FPsvr_IBF_detected FPsw_ext1_IBF_detected FPsw_IBF_detected /end REF_CHARACTERISTIC
/end GROUP
/begin GROUP ICam_maxerr_EC_Fault "Intake cam / distributor position"
 /begin REF_CHARACTERISTIC FCdc4_ICam_maxerr FCdtc_ICam_maxerr FCfmi_ICam_maxerr FCftb_ICam_maxerr FCspn_ICam_maxerr FPfl_ICam_maxerr FPfu_ICam_maxerr FPnd_ICam_maxerr FPsvr_ICam_maxerr FPsw_ext1_ICam_maxerr FPsw_ICam_maxerr /end REF_CHARACTERISTIC
/end GROUP
/begin GROUP ICAVD1_mis_EC_Fault "Misfire detected"
 /begin REF_CHARACTERISTIC FCdc4_ICAVD1_mis FCdtc_ICAVD1_mis FCfmi_ICAVD1_mis FCftb_ICAVD1_mis FCspn_ICAVD1_mis FPfl_ICAVD1_mis FPfu_ICAVD1_mis FPnd_ICAVD1_mis FPsvr_ICAVD1_mis FPsw_ext1_ICAVD1_mis FPsw_ICAVD1_mis /end REF_CHARACTERISTIC
/end GROUP
/begin GROUP ICAVD1_miscat_EC_Fault "Emissions/catalyst damaging misfire"
 /begin REF_CHARACTERISTIC FCdc4_ICAVD1_miscat FCdtc_ICAVD1_miscat FCfmi_ICAVD1_miscat FCftb_ICAVD1_miscat FCspn_ICAVD1_miscat FPfl_ICAVD1_miscat FPfu_ICAVD1_miscat FPnd_ICAVD1_miscat FPsvr_ICAVD1_miscat FPsw_ext1_ICAVD1_miscat FPsw_ICAVD1_miscat /end REF_CHARACTERISTIC
/end GROUP
/begin GROUP Idle_SD_EC_Fault "Idle shutdown timer exceeded"
 /begin REF_CHARACTERISTIC FCdc4_Idle_SD FCdtc_Idle_SD FCfmi_Idle_SD FCftb_Idle_SD FCspn_Idle_SD FPfl_Idle_SD FPfu_Idle_SD FPnd_Idle_SD FPsvr_Idle_SD FPsw_ext1_Idle_SD FPsw_Idle_SD /end REF_CHARACTERISTIC
/end GROUP
/begin GROUP imu_general_EC_Fault "Inertial measurement unit general error"
 /begin REF_CHARACTERISTIC FCdc4_imu_general FCdtc_imu_general FCfmi_imu_general FCftb_imu_general FCspn_imu_general FPfl_imu_general FPfu_imu_general FPnd_imu_general FPsvr_imu_general FPsw_ext1_imu_general FPsw_imu_general /end REF_CHARACTERISTIC
/end GROUP
/begin GROUP imu_temp_max_EC_Fault "Inertial measurement unit temperature high"
 /begin REF_CHARACTERISTIC FCdc4_imu_temp_max FCdtc_imu_temp_max FCfmi_imu_temp_max FCftb_imu_temp_max FCspn_imu_temp_max FPfl_imu_temp_max FPfu_imu_temp_max FPnd_imu_temp_max FPsvr_imu_temp_max FPsw_ext1_imu_temp_max FPsw_imu_temp_max /end REF_CHARACTERISTIC
/end GROUP
/begin GROUP imu_temp_min_EC_Fault "Inertial measurement unit temperature low"
 /begin REF_CHARACTERISTIC FCdc4_imu_temp_min FCdtc_imu_temp_min FCfmi_imu_temp_min FCftb_imu_temp_min FCspn_imu_temp_min FPfl_imu_temp_min FPfu_imu_temp_min FPnd_imu_temp_min FPsvr_imu_temp_min FPsw_ext1_imu_temp_min FPsw_imu_temp_min /end REF_CHARACTERISTIC
/end GROUP
/begin GROUP IMVD_Ifb_hi_EC_Fault "IMV Coil Short or Short to Power"
 /begin REF_CHARACTERISTIC FCdc4_IMVD_Ifb_hi FCdtc_IMVD_Ifb_hi FCfmi_IMVD_Ifb_hi FCftb_IMVD_Ifb_hi FCspn_IMVD_Ifb_hi FPfl_IMVD_Ifb_hi FPfu_IMVD_Ifb_hi FPnd_IMVD_Ifb_hi FPsvr_IMVD_Ifb_hi FPsw_ext1_IMVD_Ifb_hi FPsw_IMVD_Ifb_hi /end REF_CHARACTERISTIC
/end GROUP
/begin GROUP IMVD_Ifb_lo_EC_Fault "IMV Loop Open or Short to Ground"
 /begin REF_CHARACTERISTIC FCdc4_IMVD_Ifb_lo FCdtc_IMVD_Ifb_lo FCfmi_IMVD_Ifb_lo FCftb_IMVD_Ifb_lo FCspn_IMVD_Ifb_lo FPfl_IMVD_Ifb_lo FPfu_IMVD_Ifb_lo FPnd_IMVD_Ifb_lo FPsvr_IMVD_Ifb_lo FPsw_ext1_IMVD_Ifb_lo FPsw_IMVD_Ifb_lo /end REF_CHARACTERISTIC
/end GROUP
/begin GROUP INJD_boost_lo_EC_Fault "CR Injection Bank Boost Voltage Low"
 /begin REF_CHARACTERISTIC FCdc4_INJD_boost_lo FCdtc_INJD_boost_lo FCfmi_INJD_boost_lo FCftb_INJD_boost_lo FCspn_INJD_boost_lo FPfl_INJD_boost_lo FPfu_INJD_boost_lo FPnd_INJD_boost_lo FPsvr_INJD_boost_lo FPsw_ext1_INJD_boost_lo FPsw_INJD_boost_lo /end REF_CHARACTERISTIC
/end GROUP
/begin GROUP INJD_HS_Ihi_EC_Fault "CR Injector High-Side Short to Ground"
 /begin REF_CHARACTERISTIC FCdc4_INJD_HS_Ihi FCdtc_INJD_HS_Ihi FCfmi_INJD_HS_Ihi FCftb_INJD_HS_Ihi FCspn_INJD_HS_Ihi FPfl_INJD_HS_Ihi FPfu_INJD_HS_Ihi FPnd_INJD_HS_Ihi FPsvr_INJD_HS_Ihi FPsw_ext1_INJD_HS_Ihi FPsw_INJD_HS_Ihi /end REF_CHARACTERISTIC
/end GROUP
/begin GROUP INJD_HW_int_EC_Fault "CR Injection Bank Internal Fault"
 /begin REF_CHARACTERISTIC FCdc4_INJD_HW_int FCdtc_INJD_HW_int FCfmi_INJD_HW_int FCftb_INJD_HW_int FCspn_INJD_HW_int FPfl_INJD_HW_int FPfu_INJD_HW_int FPnd_INJD_HW_int FPsvr_INJD_HW_int FPsw_ext1_INJD_HW_int FPsw_INJD_HW_int /end REF_CHARACTERISTIC
/end GROUP
/begin GROUP INJD_LS_Ihi_EC_Fault "CR Injector Low-Side Short to Power"
 /begin REF_CHARACTERISTIC FCdc4_INJD_LS_Ihi FCdtc_INJD_LS_Ihi FCfmi_INJD_LS_Ihi FCftb_INJD_LS_Ihi FCspn_INJD_LS_Ihi FPfl_INJD_LS_Ihi FPfu_INJD_LS_Ihi FPnd_INJD_LS_Ihi FPsvr_INJD_LS_Ihi FPsw_ext1_INJD_LS_Ihi FPsw_INJD_LS_Ihi /end REF_CHARACTERISTIC
/end GROUP
/begin GROUP INJD_off_lo_EC_Fault "Injector Loop Open or"
 /begin REF_CHARACTERISTIC FCdc4_INJD_off_lo FCdtc_INJD_off_lo FCfmi_INJD_off_lo FCftb_INJD_off_lo FCspn_INJD_off_lo FPfl_INJD_off_lo FPfu_INJD_off_lo FPnd_INJD_off_lo FPsvr_INJD_off_lo FPsw_ext1_INJD_off_lo FPsw_INJD_off_lo /end REF_CHARACTERISTIC
/end GROUP
/begin GROUP INJD_on_hi_EC_Fault "Injector Coil Shorted"
 /begin REF_CHARACTERISTIC FCdc4_INJD_on_hi FCdtc_INJD_on_hi FCfmi_INJD_on_hi FCftb_INJD_on_hi FCspn_INJD_on_hi FPfl_INJD_on_hi FPfu_INJD_on_hi FPnd_INJD_on_hi FPsvr_INJD_on_hi FPsw_ext1_INJD_on_hi FPsw_INJD_on_hi /end REF_CHARACTERISTIC
/end GROUP
/begin GROUP interrupt_EC_Fault "Invalid interrupt"
 /begin REF_CHARACTERISTIC FCdc4_interrupt FCdtc_interrupt FCfmi_interrupt FCftb_interrupt FCspn_interrupt FPfl_interrupt FPfu_interrupt FPnd_interrupt FPsvr_interrupt FPsw_ext1_interrupt FPsw_interrupt /end REF_CHARACTERISTIC
/end GROUP
/begin GROUP J1939_AAT_err_loss_EC_Fault "J1939 AAT error or message receipt lost"
 /begin REF_CHARACTERISTIC FCdc4_J1939_AAT_err_loss FCdtc_J1939_AAT_err_loss FCfmi_J1939_AAT_err_loss FCftb_J1939_AAT_err_loss FCspn_J1939_AAT_err_loss FPfl_J1939_AAT_err_loss FPfu_J1939_AAT_err_loss FPnd_J1939_AAT_err_loss FPsvr_J1939_AAT_err_loss FPsw_ext1_J1939_AAT_err_loss FPsw_J1939_AAT_err_loss /end REF_CHARACTERISTIC
/end GROUP
/begin GROUP J1939_addr2Fail_EC_Fault "CAN2 address conflict failure"
 /begin REF_CHARACTERISTIC FCdc4_J1939_addr2Fail FCdtc_J1939_addr2Fail FCfmi_J1939_addr2Fail FCftb_J1939_addr2Fail FCspn_J1939_addr2Fail FPfl_J1939_addr2Fail FPfu_J1939_addr2Fail FPnd_J1939_addr2Fail FPsvr_J1939_addr2Fail FPsw_ext1_J1939_addr2Fail FPsw_J1939_addr2Fail /end REF_CHARACTERISTIC
/end GROUP
/begin GROUP J1939_addr3Fail_EC_Fault "CAN3 address conflict failure"
 /begin REF_CHARACTERISTIC FCdc4_J1939_addr3Fail FCdtc_J1939_addr3Fail FCfmi_J1939_addr3Fail FCftb_J1939_addr3Fail FCspn_J1939_addr3Fail FPfl_J1939_addr3Fail FPfu_J1939_addr3Fail FPnd_J1939_addr3Fail FPsvr_J1939_addr3Fail FPsw_ext1_J1939_addr3Fail FPsw_J1939_addr3Fail /end REF_CHARACTERISTIC
/end GROUP
/begin GROUP J1939_addrFail_EC_Fault "CAN1 address conflict failure"
 /begin REF_CHARACTERISTIC FCdc4_J1939_addrFail FCdtc_J1939_addrFail FCfmi_J1939_addrFail FCftb_J1939_addrFail FCspn_J1939_addrFail FPfl_J1939_addrFail FPfu_J1939_addrFail FPnd_J1939_addrFail FPsvr_J1939_addrFail FPsw_ext1_J1939_addrFail FPsw_J1939_addrFail /end REF_CHARACTERISTIC
/end GROUP
/begin GROUP J1939_ETC_loss_EC_Fault "J1939 Electronic Throttle Control (ETC) message receipt lost"
 /begin REF_CHARACTERISTIC FCdc4_J1939_ETC_loss FCdtc_J1939_ETC_loss FCfmi_J1939_ETC_loss FCftb_J1939_ETC_loss FCspn_J1939_ETC_loss FPfl_J1939_ETC_loss FPfu_J1939_ETC_loss FPnd_J1939_ETC_loss FPsvr_J1939_ETC_loss FPsw_ext1_J1939_ETC_loss FPsw_J1939_ETC_loss /end REF_CHARACTERISTIC
/end GROUP
/begin GROUP J1939_ETC_loss2_EC_Fault "J1939 Electronic Throttle Control (ETC) message loss while in-gear"
 /begin REF_CHARACTERISTIC FCdc4_J1939_ETC_loss2 FCdtc_J1939_ETC_loss2 FCfmi_J1939_ETC_loss2 FCftb_J1939_ETC_loss2 FCspn_J1939_ETC_loss2 FPfl_J1939_ETC_loss2 FPfu_J1939_ETC_loss2 FPnd_J1939_ETC_loss2 FPsvr_J1939_ETC_loss2 FPsw_ext1_J1939_ETC_loss2 FPsw_J1939_ETC_loss2 /end REF_CHARACTERISTIC
/end GROUP
/begin GROUP J1939_PGN_tout_EC_Fault "J1939 PGN timeout 1"
 /begin REF_CHARACTERISTIC FCdc4_J1939_PGN_tout FCdtc_J1939_PGN_tout FCfmi_J1939_PGN_tout FCftb_J1939_PGN_tout FCspn_J1939_PGN_tout FPfl_J1939_PGN_tout FPfu_J1939_PGN_tout FPnd_J1939_PGN_tout FPsvr_J1939_PGN_tout FPsw_ext1_J1939_PGN_tout FPsw_J1939_PGN_tout /end REF_CHARACTERISTIC
/end GROUP
/begin GROUP J1939_PGN_tout10_EC_Fault "J1939 PGN timeout 10"
 /begin REF_CHARACTERISTIC FCdc4_J1939_PGN_tout10 FCdtc_J1939_PGN_tout10 FCfmi_J1939_PGN_tout10 FCftb_J1939_PGN_tout10 FCspn_J1939_PGN_tout10 FPfl_J1939_PGN_tout10 FPfu_J1939_PGN_tout10 FPnd_J1939_PGN_tout10 FPsvr_J1939_PGN_tout10 FPsw_ext1_J1939_PGN_tout10 FPsw_J1939_PGN_tout10 /end REF_CHARACTERISTIC
/end GROUP
/begin GROUP J1939_PGN_tout2_EC_Fault "J1939 PGN timeout 2"
 /begin REF_CHARACTERISTIC FCdc4_J1939_PGN_tout2 FCdtc_J1939_PGN_tout2 FCfmi_J1939_PGN_tout2 FCftb_J1939_PGN_tout2 FCspn_J1939_PGN_tout2 FPfl_J1939_PGN_tout2 FPfu_J1939_PGN_tout2 FPnd_J1939_PGN_tout2 FPsvr_J1939_PGN_tout2 FPsw_ext1_J1939_PGN_tout2 FPsw_J1939_PGN_tout2 /end REF_CHARACTERISTIC
/end GROUP
/begin GROUP J1939_PGN_tout3_EC_Fault "J1939 PGN timeout 3"
 /begin REF_CHARACTERISTIC FCdc4_J1939_PGN_tout3 FCdtc_J1939_PGN_tout3 FCfmi_J1939_PGN_tout3 FCftb_J1939_PGN_tout3 FCspn_J1939_PGN_tout3 FPfl_J1939_PGN_tout3 FPfu_J1939_PGN_tout3 FPnd_J1939_PGN_tout3 FPsvr_J1939_PGN_tout3 FPsw_ext1_J1939_PGN_tout3 FPsw_J1939_PGN_tout3 /end REF_CHARACTERISTIC
/end GROUP
/begin GROUP J1939_PGN_tout4_EC_Fault "J1939 PGN timeout 4"
 /begin REF_CHARACTERISTIC FCdc4_J1939_PGN_tout4 FCdtc_J1939_PGN_tout4 FCfmi_J1939_PGN_tout4 FCftb_J1939_PGN_tout4 FCspn_J1939_PGN_tout4 FPfl_J1939_PGN_tout4 FPfu_J1939_PGN_tout4 FPnd_J1939_PGN_tout4 FPsvr_J1939_PGN_tout4 FPsw_ext1_J1939_PGN_tout4 FPsw_J1939_PGN_tout4 /end REF_CHARACTERISTIC
/end GROUP
/begin GROUP J1939_PGN_tout5_EC_Fault "J1939 PGN timeout 5"
 /begin REF_CHARACTERISTIC FCdc4_J1939_PGN_tout5 FCdtc_J1939_PGN_tout5 FCfmi_J1939_PGN_tout5 FCftb_J1939_PGN_tout5 FCspn_J1939_PGN_tout5 FPfl_J1939_PGN_tout5 FPfu_J1939_PGN_tout5 FPnd_J1939_PGN_tout5 FPsvr_J1939_PGN_tout5 FPsw_ext1_J1939_PGN_tout5 FPsw_J1939_PGN_tout5 /end REF_CHARACTERISTIC
/end GROUP
/begin GROUP J1939_PGN_tout6_EC_Fault "J1939 PGN timeout 6"
 /begin REF_CHARACTERISTIC FCdc4_J1939_PGN_tout6 FCdtc_J1939_PGN_tout6 FCfmi_J1939_PGN_tout6 FCftb_J1939_PGN_tout6 FCspn_J1939_PGN_tout6 FPfl_J1939_PGN_tout6 FPfu_J1939_PGN_tout6 FPnd_J1939_PGN_tout6 FPsvr_J1939_PGN_tout6 FPsw_ext1_J1939_PGN_tout6 FPsw_J1939_PGN_tout6 /end REF_CHARACTERISTIC
/end GROUP
/begin GROUP J1939_PGN_tout7_EC_Fault "J1939 PGN timeout 7"
 /begin REF_CHARACTERISTIC FCdc4_J1939_PGN_tout7 FCdtc_J1939_PGN_tout7 FCfmi_J1939_PGN_tout7 FCftb_J1939_PGN_tout7 FCspn_J1939_PGN_tout7 FPfl_J1939_PGN_tout7 FPfu_J1939_PGN_tout7 FPnd_J1939_PGN_tout7 FPsvr_J1939_PGN_tout7 FPsw_ext1_J1939_PGN_tout7 FPsw_J1939_PGN_tout7 /end REF_CHARACTERISTIC
/end GROUP
/begin GROUP J1939_PGN_tout8_EC_Fault "J1939 PGN timeout 8"
 /begin REF_CHARACTERISTIC FCdc4_J1939_PGN_tout8 FCdtc_J1939_PGN_tout8 FCfmi_J1939_PGN_tout8 FCftb_J1939_PGN_tout8 FCspn_J1939_PGN_tout8 FPfl_J1939_PGN_tout8 FPfu_J1939_PGN_tout8 FPnd_J1939_PGN_tout8 FPsvr_J1939_PGN_tout8 FPsw_ext1_J1939_PGN_tout8 FPsw_J1939_PGN_tout8 /end REF_CHARACTERISTIC
/end GROUP
/begin GROUP J1939_PGN_tout9_EC_Fault "J1939 PGN timeout 9"
 /begin REF_CHARACTERISTIC FCdc4_J1939_PGN_tout9 FCdtc_J1939_PGN_tout9 FCfmi_J1939_PGN_tout9 FCftb_J1939_PGN_tout9 FCspn_J1939_PGN_tout9 FPfl_J1939_PGN_tout9 FPfu_J1939_PGN_tout9 FPnd_J1939_PGN_tout9 FPsvr_J1939_PGN_tout9 FPsw_ext1_J1939_PGN_tout9 FPsw_J1939_PGN_tout9 /end REF_CHARACTERISTIC
/end GROUP
/begin GROUP J1939_RS_err_loss_EC_Fault "J1939 roadspeed error or message receipt lost"
 /begin REF_CHARACTERISTIC FCdc4_J1939_RS_err_loss FCdtc_J1939_RS_err_loss FCfmi_J1939_RS_err_loss FCftb_J1939_RS_err_loss FCspn_J1939_RS_err_loss FPfl_J1939_RS_err_loss FPfu_J1939_RS_err_loss FPnd_J1939_RS_err_loss FPsvr_J1939_RS_err_loss FPsw_ext1_J1939_RS_err_loss FPsw_J1939_RS_err_loss /end REF_CHARACTERISTIC
/end GROUP
/begin GROUP J1939_RSsetpt_loss_EC_Fault "J1939 PGN 65450 roadspeed setpoint command receipt lost"
 /begin REF_CHARACTERISTIC FCdc4_J1939_RSsetpt_loss FCdtc_J1939_RSsetpt_loss FCfmi_J1939_RSsetpt_loss FCftb_J1939_RSsetpt_loss FCspn_J1939_RSsetpt_loss FPfl_J1939_RSsetpt_loss FPfu_J1939_RSsetpt_loss FPnd_J1939_RSsetpt_loss FPsvr_J1939_RSsetpt_loss FPsw_ext1_J1939_RSsetpt_loss FPsw_J1939_RSsetpt_loss /end REF_CHARACTERISTIC
/end GROUP
/begin GROUP J1939_Rx2Fail_EC_Fault "CAN2 Rx failure"
 /begin REF_CHARACTERISTIC FCdc4_J1939_Rx2Fail FCdtc_J1939_Rx2Fail FCfmi_J1939_Rx2Fail FCftb_J1939_Rx2Fail FCspn_J1939_Rx2Fail FPfl_J1939_Rx2Fail FPfu_J1939_Rx2Fail FPnd_J1939_Rx2Fail FPsvr_J1939_Rx2Fail FPsw_ext1_J1939_Rx2Fail FPsw_J1939_Rx2Fail /end REF_CHARACTERISTIC
/end GROUP
/begin GROUP J1939_Rx3Fail_EC_Fault "CAN3 Rx failure"
 /begin REF_CHARACTERISTIC FCdc4_J1939_Rx3Fail FCdtc_J1939_Rx3Fail FCfmi_J1939_Rx3Fail FCftb_J1939_Rx3Fail FCspn_J1939_Rx3Fail FPfl_J1939_Rx3Fail FPfu_J1939_Rx3Fail FPnd_J1939_Rx3Fail FPsvr_J1939_Rx3Fail FPsw_ext1_J1939_Rx3Fail FPsw_J1939_Rx3Fail /end REF_CHARACTERISTIC
/end GROUP
/end MODULE
/end PROJECT
