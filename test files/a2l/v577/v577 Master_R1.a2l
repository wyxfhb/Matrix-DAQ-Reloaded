ASAP2_VERSION 1 61
/begin PROJECT Econtrols_4G "4G Test"
/begin HEADER "4G A2L Configuration" PROJECT_NO EControls4G /* config for version control */ VERSION "$Revision: 82130 $:" /* config for version control */ /end HEADER
/begin MODULE EControls_4G_SH2A "EControls 4G"
/begin MOD_COMMON "" DEPOSIT ABSOLUTE BYTE_ORDER MSB_FIRST /end MOD_COMMON
/* Define the Record Layouts */
/begin RECORD_LAYOUT ECIPP_ALIGNMENT_UBYTE FNC_VALUES 1 UBYTE COLUMN_DIR DIRECT /end RECORD_LAYOUT
/begin RECORD_LAYOUT ECIPP_ALIGNMENT_UWORD FNC_VALUES 1 UWORD COLUMN_DIR DIRECT /end RECORD_LAYOUT
/begin RECORD_LAYOUT ECIPP_ALIGNMENT_SWORD FNC_VALUES 1 SWORD COLUMN_DIR DIRECT /end RECORD_LAYOUT
/begin RECORD_LAYOUT ECIPP_Lookup_SWORD AXIS_PTS_X 1 SWORD INDEX_INCR DIRECT /end RECORD_LAYOUT
/begin RECORD_LAYOUT ECIPP_ALIGNMENT_FLOAT32_IEEE FNC_VALUES 1 FLOAT32_IEEE COLUMN_DIR DIRECT /end RECORD_LAYOUT
/begin MEASUREMENT TPS1_raw "TPS1_raw" UWORD Compu_TPS1_raw 0 0 0 5.00114468864469 ECU_ADDRESS 0x010000F0 /end MEASUREMENT
/begin COMPU_METHOD Compu_TPS1_raw " " RAT_FUNC "%.3" "volts" COEFFS 0 13104 0 0 0 1 /end COMPU_METHOD
/begin MEASUREMENT TPS2_raw "TPS2_raw" UWORD Compu_TPS2_raw 0 0 0 5.00114468864469 ECU_ADDRESS 0x010000F8 /end MEASUREMENT
/begin COMPU_METHOD Compu_TPS2_raw " " RAT_FUNC "%.3" "volts" COEFFS 0 13104 0 0 0 1 /end COMPU_METHOD
/begin MEASUREMENT FAratio "A/F ratio" UWORD Compu_FAratio 0 0 0 10000000000 ECU_ADDRESS 0x01000110 /end MEASUREMENT
/begin COMPU_METHOD Compu_FAratio " " RAT_FUNC "%.2" "-" COEFFS 0 0 1 0 7.62939453125E-06 0 /end COMPU_METHOD
/begin MEASUREMENT PM_RMS_volts "Power monitor per-leg voltage" UWORD Compu_PM_RMS_volts 0 0 0 1023.984375 ECU_ADDRESS 0x010003D8 /end MEASUREMENT
/begin COMPU_METHOD Compu_PM_RMS_volts " " RAT_FUNC "%.1" "volts" COEFFS 0 64 0 0 0 1 /end COMPU_METHOD
/begin MEASUREMENT PM_RMS_amps "Power monitor per-leg current" UWORD Compu_PM_RMS_amps 0 0 0 1023.984375 ECU_ADDRESS 0x010003E0 /end MEASUREMENT
/begin COMPU_METHOD Compu_PM_RMS_amps " " RAT_FUNC "%.1" "amps" COEFFS 0 64 0 0 0 1 /end COMPU_METHOD
/begin MEASUREMENT Gen_total_pwr "Generator total power" UWORD Compu_Gen_total_pwr 0 0 0 511.9921875 ECU_ADDRESS 0x010003E8 /end MEASUREMENT
/begin COMPU_METHOD Compu_Gen_total_pwr " " RAT_FUNC "%.2" "kW" COEFFS 0 128 0 0 0 1 /end COMPU_METHOD
/begin MEASUREMENT Gen_real_pwr "Generator real power" UWORD Compu_Gen_real_pwr 0 0 0 511.9921875 ECU_ADDRESS 0x010003F0 /end MEASUREMENT
/begin COMPU_METHOD Compu_Gen_real_pwr " " RAT_FUNC "%.2" "kW" COEFFS 0 128 0 0 0 1 /end COMPU_METHOD
/begin MEASUREMENT Gen_freq "Generator frequency" UWORD Compu_Gen_freq 0 0 0 127.998046875 ECU_ADDRESS 0x010003F8 /end MEASUREMENT
/begin COMPU_METHOD Compu_Gen_freq " " RAT_FUNC "%.2" "Hz" COEFFS 0 512 0 0 0 1 /end COMPU_METHOD
/begin MEASUREMENT Gen_crct_real_pwr "Generator real corrected power" UWORD Compu_Gen_crct_real_pwr 0 0 0 511.9921875 ECU_ADDRESS 0x01000400 /end MEASUREMENT
/begin COMPU_METHOD Compu_Gen_crct_real_pwr " " RAT_FUNC "%.2" "kW" COEFFS 0 128 0 0 0 1 /end COMPU_METHOD
/begin MEASUREMENT Gen_phase_volts "Generator per-phase voltage" UWORD Compu_Gen_phase_volts 0 0 0 1023.984375 ECU_ADDRESS 0x01000408 /end MEASUREMENT
/begin COMPU_METHOD Compu_Gen_phase_volts " " RAT_FUNC "%.1" "volts" COEFFS 0 64 0 0 0 1 /end COMPU_METHOD
/begin MEASUREMENT Gen_phase_amps "Generator per-phase current" UWORD Compu_Gen_phase_amps 0 0 0 1023.984375 ECU_ADDRESS 0x01000410 /end MEASUREMENT
/begin COMPU_METHOD Compu_Gen_phase_amps " " RAT_FUNC "%.1" "amps" COEFFS 0 64 0 0 0 1 /end COMPU_METHOD
/begin MEASUREMENT CRK_ana_raw "CRK_ana_raw" UWORD Compu_CRK_ana_raw 0 0 0 5.00114468864469 ECU_ADDRESS 0x010004C0 /end MEASUREMENT
/begin COMPU_METHOD Compu_CRK_ana_raw " " RAT_FUNC "%.3" "-" COEFFS 0 13104 0 0 0 1 /end COMPU_METHOD
/begin MEASUREMENT MAG_BIAS_raw "MAG_BIAS_raw" UWORD Compu_MAG_BIAS_raw 0 0 0 5.00114468864469 ECU_ADDRESS 0x010004C8 /end MEASUREMENT
/begin COMPU_METHOD Compu_MAG_BIAS_raw " " RAT_FUNC "%.3" "-" COEFFS 0 13104 0 0 0 1 /end COMPU_METHOD
/begin MEASUREMENT KNK1H_raw "KNK1H_raw" UWORD Compu_KNK1H_raw 0 0 0 5.00114468864469 ECU_ADDRESS 0x010004D0 /end MEASUREMENT
/begin COMPU_METHOD Compu_KNK1H_raw " " RAT_FUNC "%.3" "volts" COEFFS 0 13104 0 0 0 1 /end COMPU_METHOD
/begin MEASUREMENT KNK2H_raw "KNK2H_raw" UWORD Compu_KNK2H_raw 0 0 0 5.00114468864469 ECU_ADDRESS 0x010004D8 /end MEASUREMENT
/begin COMPU_METHOD Compu_KNK2H_raw " " RAT_FUNC "%.3" "volts" COEFFS 0 13104 0 0 0 1 /end COMPU_METHOD
/begin MEASUREMENT KNK1L_raw "KNK1L_raw" UWORD Compu_KNK1L_raw 0 0 0 5.00114468864469 ECU_ADDRESS 0x010004E0 /end MEASUREMENT
/begin COMPU_METHOD Compu_KNK1L_raw " " RAT_FUNC "%.3" "volts" COEFFS 0 13104 0 0 0 1 /end COMPU_METHOD
/begin MEASUREMENT KNK2L_raw "KNK2L_raw" UWORD Compu_KNK2L_raw 0 0 0 5.00114468864469 ECU_ADDRESS 0x010004E8 /end MEASUREMENT
/begin COMPU_METHOD Compu_KNK2L_raw " " RAT_FUNC "%.3" "volts" COEFFS 0 13104 0 0 0 1 /end COMPU_METHOD
/begin CHARACTERISTIC OL_phi_limit "Open-loop phi limit" VALUE 0x00147674 /* @ECU_Address@OL_phi_limit@0x010009D0@ */ ECIPP_ALIGNMENT_UWORD 4 Compu_OL_phi_limit 0 3.99993896484375 /end CHARACTERISTIC
/begin COMPU_METHOD Compu_OL_phi_limit " " RAT_FUNC "%.3" "phi" COEFFS 0 16384 0 0 0 1 /end COMPU_METHOD
/begin CHARACTERISTIC Gen_calcs "Generator power calculations{Gen_calcs&0xff=0:Disabled}{Gen_calcs&0xff=1:2-pole, 3-phase}{Gen_calcs&0xff=2:2-pole, 1-phase}{Gen_calcs&0xff=3:1-pole, 3-phase}{Gen_calcs&0xff=4:1-pole, 1-phase}" VALUE 0x00147da1 /* @ECU_Address@Gen_calcs@0x01001A68@ */ ECIPP_ALIGNMENT_UBYTE 255 Gen_calcs_COMPU_VTAB 0 255 BIT_MASK 0xff /end CHARACTERISTIC
/begin COMPU_METHOD Gen_calcs_COMPU_VTAB "Verbal Table" TAB_VERB "%.0" "list" COMPU_TAB_REF Gen_calcs_COMPU_VTAB_REF /end COMPU_METHOD
/begin COMPU_VTAB Gen_calcs_COMPU_VTAB_REF "Verbal Table" TAB_VERB 5 0 "Disabled" 1 "2-pole, 3-phase" 2 "2-pole, 1-phase" 3 "1-pole, 3-phase" 4 "1-pole, 1-phase" DEFAULT_VALUE "UNKNOWN" /end COMPU_VTAB
/begin CHARACTERISTIC Gen_freq_src "Generator frequency source{Gen_freq_src&0xff=0:Engine Speed}{Gen_freq_src&0xff=1:Network Data}" VALUE 0x00147da2 /* @ECU_Address@Gen_freq_src@0x01001A70@ */ ECIPP_ALIGNMENT_UBYTE 255 Gen_freq_src_COMPU_VTAB 0 255 BIT_MASK 0xff /end CHARACTERISTIC
/begin COMPU_METHOD Gen_freq_src_COMPU_VTAB "Verbal Table" TAB_VERB "%.0" "list" COMPU_TAB_REF Gen_freq_src_COMPU_VTAB_REF /end COMPU_METHOD
/begin COMPU_VTAB Gen_freq_src_COMPU_VTAB_REF "Verbal Table" TAB_VERB 2 0 "Engine Speed" 1 "Network Data" DEFAULT_VALUE "UNKNOWN" /end COMPU_VTAB
/begin MEASUREMENT PM_RMS_freq "Power monitor measured frequency" UWORD Compu_PM_RMS_freq 0 0 0 127.998046875 ECU_ADDRESS 0x01001A78 /end MEASUREMENT
/begin COMPU_METHOD Compu_PM_RMS_freq " " RAT_FUNC "%.2" "Hz" COEFFS 0 512 0 0 0 1 /end COMPU_METHOD
/begin MEASUREMENT PM_RMS_phase "Power monitor measured phase" UWORD Compu_PM_RMS_phase 0 0 0 511.9921875 ECU_ADDRESS 0x01001A80 /end MEASUREMENT
/begin COMPU_METHOD Compu_PM_RMS_phase " " RAT_FUNC "%.1" "deg" COEFFS 0 128 0 0 0 1 /end COMPU_METHOD
/begin MEASUREMENT Gen_PF "Generator power factor" UWORD Compu_Gen_PF 0 0 0 0.999984741210938 ECU_ADDRESS 0x01001A88 /end MEASUREMENT
/begin COMPU_METHOD Compu_Gen_PF " " RAT_FUNC "%.2" "-" COEFFS 0 65536 0 0 0 1 /end COMPU_METHOD
/begin MEASUREMENT pwr_correction "Power correction factor" UWORD Compu_pwr_correction 0 0 0 1.99996948242188 ECU_ADDRESS 0x01001AA0 /end MEASUREMENT
/begin COMPU_METHOD Compu_pwr_correction " " RAT_FUNC "%.3" "multiplier" COEFFS 0 32768 0 0 0 1 /end COMPU_METHOD
/begin CHARACTERISTIC pwr_crct_mode "Power correction type{pwr_crct_mode&0xff=0:Manual}{pwr_crct_mode&0xff=1:SAE}{pwr_crct_mode&0xff=2:ISO}" VALUE 0x001481ae /* @ECU_Address@pwr_crct_mode@0x01001AB8@ */ ECIPP_ALIGNMENT_UBYTE 255 pwr_crct_mode_COMPU_VTAB 0 255 BIT_MASK 0xff /end CHARACTERISTIC
/begin COMPU_METHOD pwr_crct_mode_COMPU_VTAB "Verbal Table" TAB_VERB "%.0" "list" COMPU_TAB_REF pwr_crct_mode_COMPU_VTAB_REF /end COMPU_METHOD
/begin COMPU_VTAB pwr_crct_mode_COMPU_VTAB_REF "Verbal Table" TAB_VERB 3 0 "Manual" 1 "SAE" 2 "ISO" DEFAULT_VALUE "UNKNOWN" /end COMPU_VTAB
/begin CHARACTERISTIC Gen_parasitic_pwr "Generator parasitic power" VALUE 0x0014743c /* @ECU_Address@Gen_parasitic_pwr@0x01001AC0@ */ ECIPP_ALIGNMENT_UWORD 512 Compu_Gen_parasitic_pwr 0 511.9921875 /end CHARACTERISTIC
/begin COMPU_METHOD Compu_Gen_parasitic_pwr " " RAT_FUNC "%.2" "kW" COEFFS 0 128 0 0 0 1 /end COMPU_METHOD
/begin CHARACTERISTIC Gen_derate "Generator maunal power derate" VALUE 0x0014743a /* @ECU_Address@Gen_derate@0x01001AC8@ */ ECIPP_ALIGNMENT_UWORD 2 Compu_Gen_derate 0 1.99996948242188 /end CHARACTERISTIC
/begin COMPU_METHOD Compu_Gen_derate " " RAT_FUNC "%.3" "multiplier" COEFFS 0 32768 0 0 0 1 /end COMPU_METHOD
/begin CHARACTERISTIC AAT_source "AAT source{AAT_source&0xff=0:Fixed default}{AAT_source&0xff=1:IAT settings}{AAT_source&0xff=2:Environmental sensor (CAN)}{AAT_source&0xff=3:FTT settings}{AAT_source&0xff=4:Internal sensor}{AAT_source&0xff=5:J1939 AMB SPN 171}" VALUE 0x00147cc4 /* @ECU_Address@AAT_source@0x01001AD0@ */ ECIPP_ALIGNMENT_UBYTE 255 AAT_source_COMPU_VTAB 0 255 BIT_MASK 0xff /end CHARACTERISTIC
/begin COMPU_METHOD AAT_source_COMPU_VTAB "Verbal Table" TAB_VERB "%.0" "list" COMPU_TAB_REF AAT_source_COMPU_VTAB_REF /end COMPU_METHOD
/begin COMPU_VTAB AAT_source_COMPU_VTAB_REF "Verbal Table" TAB_VERB 6 0 "Fixed default" 1 "IAT settings" 2 "Environmental sensor (CAN)" 3 "FTT settings" 4 "Internal sensor" 5 "J1939 AMB SPN 171" DEFAULT_VALUE "UNKNOWN" /end COMPU_VTAB
/begin CHARACTERISTIC SH_phi_ena "Phi humidity correction{SH_phi_ena&0xff=0:Disabled}{SH_phi_ena&0xff=1:Enabled}" VALUE 0x00147f37 /* @ECU_Address@SH_phi_ena@0x01002640@ */ ECIPP_ALIGNMENT_UBYTE 255 SH_phi_ena_COMPU_VTAB 0 255 BIT_MASK 0xff /end CHARACTERISTIC
/begin COMPU_METHOD SH_phi_ena_COMPU_VTAB "Verbal Table" TAB_VERB "%.0" "list" COMPU_TAB_REF SH_phi_ena_COMPU_VTAB_REF /end COMPU_METHOD
/begin COMPU_VTAB SH_phi_ena_COMPU_VTAB_REF "Verbal Table" TAB_VERB 2 0 "Disabled" 1 "Enabled" DEFAULT_VALUE "UNKNOWN" /end COMPU_VTAB
/begin MEASUREMENT Phi_base "Phi base" UWORD Compu_Phi_base 0 0 0 3.99993896484375 ECU_ADDRESS 0x01002650 /end MEASUREMENT
/begin COMPU_METHOD Compu_Phi_base " " RAT_FUNC "%.3" "-" COEFFS 0 16384 0 0 0 1 /end COMPU_METHOD
/begin MEASUREMENT SH_phi_xmul "Phi humidity offset @ 0.65 phi" SWORD Compu_SH_phi_xmul 0 0 -100 99.9969482421875 ECU_ADDRESS 0x01002658 /end MEASUREMENT
/begin COMPU_METHOD Compu_SH_phi_xmul " " RAT_FUNC "%.2" "%" COEFFS 0 327.68 0 0 0 1 /end COMPU_METHOD
/begin MEASUREMENT TIP_raw "TIP_raw" UWORD Compu_TIP_raw 0 0 0 5.00114468864469 ECU_ADDRESS 0x01002678 /end MEASUREMENT
/begin COMPU_METHOD Compu_TIP_raw " " RAT_FUNC "%.3" "volts" COEFFS 0 13104 0 0 0 1 /end COMPU_METHOD
/begin MEASUREMENT FPP1_raw "FPP1_raw" UWORD Compu_FPP1_raw 0 0 0 5.00114468864469 ECU_ADDRESS 0x01002680 /end MEASUREMENT
/begin COMPU_METHOD Compu_FPP1_raw " " RAT_FUNC "%.3" "volts" COEFFS 0 13104 0 0 0 1 /end COMPU_METHOD
/begin MEASUREMENT FPP2_raw "FPP2_raw" UWORD Compu_FPP2_raw 0 0 0 5.00114468864469 ECU_ADDRESS 0x01002688 /end MEASUREMENT
/begin COMPU_METHOD Compu_FPP2_raw " " RAT_FUNC "%.3" "volts" COEFFS 0 13104 0 0 0 1 /end COMPU_METHOD
/begin MEASUREMENT FRP_raw "FRP_raw" UWORD Compu_FRP_raw 0 0 0 5.00114468864469 ECU_ADDRESS 0x01002690 /end MEASUREMENT
/begin COMPU_METHOD Compu_FRP_raw " " RAT_FUNC "%.3" "volts" COEFFS 0 13104 0 0 0 1 /end COMPU_METHOD
/begin MEASUREMENT WGP_raw "WGP_raw" UWORD Compu_WGP_raw 0 0 0 5.00114468864469 ECU_ADDRESS 0x01002698 /end MEASUREMENT
/begin COMPU_METHOD Compu_WGP_raw " " RAT_FUNC "%.3" "volts" COEFFS 0 13104 0 0 0 1 /end COMPU_METHOD
/begin MEASUREMENT EGO1_raw "EGO1_raw" UWORD Compu_EGO1_raw 0 0 0 5.00114468864469 ECU_ADDRESS 0x010026A0 /end MEASUREMENT
/begin COMPU_METHOD Compu_EGO1_raw " " RAT_FUNC "%.3" "volts" COEFFS 0 13104 0 0 0 1 /end COMPU_METHOD
/begin MEASUREMENT EGO2_raw "EGO2_raw" UWORD Compu_EGO2_raw 0 0 0 5.00114468864469 ECU_ADDRESS 0x010026A8 /end MEASUREMENT
/begin COMPU_METHOD Compu_EGO2_raw " " RAT_FUNC "%.3" "volts" COEFFS 0 13104 0 0 0 1 /end COMPU_METHOD
/begin MEASUREMENT EGO3_raw "EGO3_raw" UWORD Compu_EGO3_raw 0 0 0 5.00114468864469 ECU_ADDRESS 0x010026B0 /end MEASUREMENT
/begin COMPU_METHOD Compu_EGO3_raw " " RAT_FUNC "%.3" "volts" COEFFS 0 13104 0 0 0 1 /end COMPU_METHOD
/begin MEASUREMENT Vbat_raw "Vbat_raw" UWORD Compu_Vbat_raw 0 0 0 5.00114468864469 ECU_ADDRESS 0x010026B8 /end MEASUREMENT
/begin COMPU_METHOD Compu_Vbat_raw " " RAT_FUNC "%.3" "volts" COEFFS 0 13104 0 0 0 1 /end COMPU_METHOD
/begin MEASUREMENT Vsw_raw "Vsw_raw" UWORD Compu_Vsw_raw 0 0 0 5.00114468864469 ECU_ADDRESS 0x010026C0 /end MEASUREMENT
/begin COMPU_METHOD Compu_Vsw_raw " " RAT_FUNC "%.3" "volts" COEFFS 0 13104 0 0 0 1 /end COMPU_METHOD
/begin MEASUREMENT VE5a_FB_raw "VE5a_FB_raw" UWORD Compu_VE5a_FB_raw 0 0 0 5.00114468864469 ECU_ADDRESS 0x010026C8 /end MEASUREMENT
/begin COMPU_METHOD Compu_VE5a_FB_raw " " RAT_FUNC "%.3" "volts" COEFFS 0 13104 0 0 0 1 /end COMPU_METHOD
/begin MEASUREMENT FT_raw "FT_raw" UWORD Compu_FT_raw 0 0 0 5.00114468864469 ECU_ADDRESS 0x010026E0 /end MEASUREMENT
/begin COMPU_METHOD Compu_FT_raw " " RAT_FUNC "%.3" "volts" COEFFS 0 13104 0 0 0 1 /end COMPU_METHOD
/begin MEASUREMENT GOV1_raw "GOV1_raw" UWORD Compu_GOV1_raw 0 0 0 5.00114468864469 ECU_ADDRESS 0x010026F0 /end MEASUREMENT
/begin COMPU_METHOD Compu_GOV1_raw " " RAT_FUNC "%.3" "volts" COEFFS 0 13104 0 0 0 1 /end COMPU_METHOD
/begin MEASUREMENT GOV2_raw "AUX_DIG4/GOV2_raw" UWORD Compu_GOV2_raw 0 0 0 5.00114468864469 ECU_ADDRESS 0x010026F8 /end MEASUREMENT
/begin COMPU_METHOD Compu_GOV2_raw " " RAT_FUNC "%.3" "volts" COEFFS 0 13104 0 0 0 1 /end COMPU_METHOD
/begin MEASUREMENT EGO1H_LS_raw "EGO1H_LS_raw" UWORD Compu_EGO1H_LS_raw 0 0 0 5.00114468864469 ECU_ADDRESS 0x01002720 /end MEASUREMENT
/begin COMPU_METHOD Compu_EGO1H_LS_raw " " RAT_FUNC "%.3" "volts" COEFFS 0 13104 0 0 0 1 /end COMPU_METHOD
/begin MEASUREMENT EGO2H_LS_raw "EGO2H_LS_raw" UWORD Compu_EGO2H_LS_raw 0 0 0 5.00114468864469 ECU_ADDRESS 0x01002728 /end MEASUREMENT
/begin COMPU_METHOD Compu_EGO2H_LS_raw " " RAT_FUNC "%.3" "volts" COEFFS 0 13104 0 0 0 1 /end COMPU_METHOD
/begin MEASUREMENT EGO3H_LS_raw "EGO3H_LS_raw" UWORD Compu_EGO3H_LS_raw 0 0 0 5.00114468864469 ECU_ADDRESS 0x01002730 /end MEASUREMENT
/begin COMPU_METHOD Compu_EGO3H_LS_raw " " RAT_FUNC "%.3" "volts" COEFFS 0 13104 0 0 0 1 /end COMPU_METHOD
/begin MEASUREMENT OILP_raw "OILP_raw" UWORD Compu_OILP_raw 0 0 0 5.00114468864469 ECU_ADDRESS 0x01002740 /end MEASUREMENT
/begin COMPU_METHOD Compu_OILP_raw " " RAT_FUNC "%.3" "volts" COEFFS 0 13104 0 0 0 1 /end COMPU_METHOD
/begin MEASUREMENT AUX_DIG1_raw "AUX_DIG1_raw" UWORD Compu_AUX_DIG1_raw 0 0 0 5.00114468864469 ECU_ADDRESS 0x01002748 /end MEASUREMENT
/begin COMPU_METHOD Compu_AUX_DIG1_raw " " RAT_FUNC "%.3" "volts" COEFFS 0 13104 0 0 0 1 /end COMPU_METHOD
/begin MEASUREMENT AUX_DIG2_raw "AUX_DIG2_raw" UWORD Compu_AUX_DIG2_raw 0 0 0 5.00114468864469 ECU_ADDRESS 0x01002750 /end MEASUREMENT
/begin COMPU_METHOD Compu_AUX_DIG2_raw " " RAT_FUNC "%.3" "volts" COEFFS 0 13104 0 0 0 1 /end COMPU_METHOD
/begin MEASUREMENT AUX_PWM1_FB_raw "AUX_PWM1_FB_raw" UWORD Compu_AUX_PWM1_FB_raw 0 0 0 5.00114468864469 ECU_ADDRESS 0x01002758 /end MEASUREMENT
/begin COMPU_METHOD Compu_AUX_PWM1_FB_raw " " RAT_FUNC "%.3" "volts" COEFFS 0 13104 0 0 0 1 /end COMPU_METHOD
/begin MEASUREMENT AUX_PWM2_FB_raw "AUX_PWM2_FB_raw" UWORD Compu_AUX_PWM2_FB_raw 0 0 0 5.00114468864469 ECU_ADDRESS 0x01002760 /end MEASUREMENT
/begin COMPU_METHOD Compu_AUX_PWM2_FB_raw " " RAT_FUNC "%.3" "volts" COEFFS 0 13104 0 0 0 1 /end COMPU_METHOD
/begin CHARACTERISTIC Phi_lowslew_ena "Phi lean-slew-rate limiting{Phi_lowslew_ena&0xff=0:Disabled}{Phi_lowslew_ena&0xff=1:Enabled}" VALUE 0x00147ee6 /* @ECU_Address@Phi_lowslew_ena@0x010027F8@ */ ECIPP_ALIGNMENT_UBYTE 255 Phi_lowslew_ena_COMPU_VTAB 0 255 BIT_MASK 0xff /end CHARACTERISTIC
/begin COMPU_METHOD Phi_lowslew_ena_COMPU_VTAB "Verbal Table" TAB_VERB "%.0" "list" COMPU_TAB_REF Phi_lowslew_ena_COMPU_VTAB_REF /end COMPU_METHOD
/begin COMPU_VTAB Phi_lowslew_ena_COMPU_VTAB_REF "Verbal Table" TAB_VERB 2 0 "Disabled" 1 "Enabled" DEFAULT_VALUE "UNKNOWN" /end COMPU_VTAB
/begin CHARACTERISTIC Phi_lowslew_lim "Phi lean-slew-rate limit" VALUE 0x001476e2 /* @ECU_Address@Phi_lowslew_lim@0x01002800@ */ ECIPP_ALIGNMENT_UWORD 4 Compu_Phi_lowslew_lim 0 3.99993896484375 /end CHARACTERISTIC
/begin COMPU_METHOD Compu_Phi_lowslew_lim " " RAT_FUNC "%.3" "phi" COEFFS 0 16384 0 0 0 1 /end COMPU_METHOD
/begin CHARACTERISTIC Phi_lowslew_rate "Phi lean-slew-rate rate limit" VALUE 0x001476e4 /* @ECU_Address@Phi_lowslew_rate@0x01002808@ */ ECIPP_ALIGNMENT_UWORD 4 Compu_Phi_lowslew_rate 0 3.99993896484375 /end CHARACTERISTIC
/begin COMPU_METHOD Compu_Phi_lowslew_rate " " RAT_FUNC "%.3" "dphi / sec" COEFFS 0 16384 0 0 0 1 /end COMPU_METHOD
/begin MEASUREMENT EGO4_raw "EGO4_raw" UWORD Compu_EGO4_raw 0 0 0 5.00114468864469 ECU_ADDRESS 0x01002E30 /end MEASUREMENT
/begin COMPU_METHOD Compu_EGO4_raw " " RAT_FUNC "%.3" "volts" COEFFS 0 13104 0 0 0 1 /end COMPU_METHOD
/begin MEASUREMENT AUX_DIG3_raw "AUX_DIG3_raw" UWORD Compu_AUX_DIG3_raw 0 0 0 5.00114468864469 ECU_ADDRESS 0x01002E38 /end MEASUREMENT
/begin COMPU_METHOD Compu_AUX_DIG3_raw " " RAT_FUNC "%.3" "volts" COEFFS 0 13104 0 0 0 1 /end COMPU_METHOD
/begin MEASUREMENT EGT_raw "EGT_raw" UWORD Compu_EGT_raw 0 0 0 5.00114468864469 ECU_ADDRESS 0x01002E40 /end MEASUREMENT
/begin COMPU_METHOD Compu_EGT_raw " " RAT_FUNC "%.3" "volts" COEFFS 0 13104 0 0 0 1 /end COMPU_METHOD
/begin MEASUREMENT VE5b_FB_raw "VE5b_FB_raw" UWORD Compu_VE5b_FB_raw 0 0 0 5.00114468864469 ECU_ADDRESS 0x01002E48 /end MEASUREMENT
/begin COMPU_METHOD Compu_VE5b_FB_raw " " RAT_FUNC "%.3" "volts" COEFFS 0 13104 0 0 0 1 /end COMPU_METHOD
/begin MEASUREMENT EGO4H_LS_raw "EGO4H_LS_raw" UWORD Compu_EGO4H_LS_raw 0 0 0 5.00114468864469 ECU_ADDRESS 0x01002E50 /end MEASUREMENT
/begin COMPU_METHOD Compu_EGO4H_LS_raw " " RAT_FUNC "%.3" "volts" COEFFS 0 13104 0 0 0 1 /end COMPU_METHOD
/begin MEASUREMENT AUX_PWM3_FB_raw "AUX_PWM3_FB_raw" UWORD Compu_AUX_PWM3_FB_raw 0 0 0 5.00114468864469 ECU_ADDRESS 0x01002E58 /end MEASUREMENT
/begin COMPU_METHOD Compu_AUX_PWM3_FB_raw " " RAT_FUNC "%.3" "volts" COEFFS 0 13104 0 0 0 1 /end COMPU_METHOD
/begin MEASUREMENT AUX_PWM4_FB_raw "AUX_PWM4_FB_raw" UWORD Compu_AUX_PWM4_FB_raw 0 0 0 5.00114468864469 ECU_ADDRESS 0x01002E60 /end MEASUREMENT
/begin COMPU_METHOD Compu_AUX_PWM4_FB_raw " " RAT_FUNC "%.3" "volts" COEFFS 0 13104 0 0 0 1 /end COMPU_METHOD
/begin MEASUREMENT AUX_PWM5_FB_raw "AUX_PWM5_FB_raw" UWORD Compu_AUX_PWM5_FB_raw 0 0 0 5.00114468864469 ECU_ADDRESS 0x01002E68 /end MEASUREMENT
/begin COMPU_METHOD Compu_AUX_PWM5_FB_raw " " RAT_FUNC "%.3" "volts" COEFFS 0 13104 0 0 0 1 /end COMPU_METHOD
/begin MEASUREMENT AUX_DIG1_volt "AUX_DIG1 volts" UWORD Compu_AUX_DIG1_volt 0 0 0 255.99609375 ECU_ADDRESS 0x01003DA8 /end MEASUREMENT
/begin COMPU_METHOD Compu_AUX_DIG1_volt " " RAT_FUNC "%.2" "volts" COEFFS 0 256 0 0 0 1 /end COMPU_METHOD
/begin MEASUREMENT AUX_DIG2_volt "AUX_DIG2 volts" UWORD Compu_AUX_DIG2_volt 0 0 0 255.99609375 ECU_ADDRESS 0x01003DB0 /end MEASUREMENT
/begin COMPU_METHOD Compu_AUX_DIG2_volt " " RAT_FUNC "%.2" "volts" COEFFS 0 256 0 0 0 1 /end COMPU_METHOD
/begin MEASUREMENT AUX_DIG3_volt "AUX_DIG3 volts" UWORD Compu_AUX_DIG3_volt 0 0 0 255.99609375 ECU_ADDRESS 0x01003DB8 /end MEASUREMENT
/begin COMPU_METHOD Compu_AUX_DIG3_volt " " RAT_FUNC "%.2" "volts" COEFFS 0 256 0 0 0 1 /end COMPU_METHOD
/begin MEASUREMENT MAPrsc_phi "BP rescaled MAP phi index" UWORD Compu_MAPrsc_phi 0 0 0 255.99609375 ECU_ADDRESS 0x01004B30 /end MEASUREMENT
/begin COMPU_METHOD Compu_MAPrsc_phi " " RAT_FUNC "%.2" "psia" COEFFS 0 256 0 0 0 1 /end COMPU_METHOD
/begin MEASUREMENT MAPrsc_max_phi "Max MAP for BP-MAP phi rescaling" UWORD Compu_MAPrsc_max_phi 0 0 0 255.99609375 ECU_ADDRESS 0x01004B40 /end MEASUREMENT
/begin COMPU_METHOD Compu_MAPrsc_max_phi " " RAT_FUNC "%.2" "psia" COEFFS 0 256 0 0 0 1 /end COMPU_METHOD
/begin CHARACTERISTIC MAPrsc_min_phi "Min MAP for BP-MAP phi rescaling" VALUE 0x001475c4 /* @ECU_Address@MAPrsc_min_phi@0x01004B50@ */ ECIPP_ALIGNMENT_UWORD 256 Compu_MAPrsc_min_phi 0 255.99609375 /end CHARACTERISTIC
/begin COMPU_METHOD Compu_MAPrsc_min_phi " " RAT_FUNC "%.2" "psia" COEFFS 0 256 0 0 0 1 /end COMPU_METHOD
/begin MEASUREMENT AUX_PUD4_raw "AUX_PUD4_raw" UWORD Compu_AUX_PUD4_raw 0 0 0 5.00114468864469 ECU_ADDRESS 0x01004FA0 /end MEASUREMENT
/begin COMPU_METHOD Compu_AUX_PUD4_raw " " RAT_FUNC "%.3" "volts" COEFFS 0 13104 0 0 0 1 /end COMPU_METHOD
/begin MEASUREMENT AUX_PUD5_raw "AUX_PUD5_raw" UWORD Compu_AUX_PUD5_raw 0 0 0 5.00114468864469 ECU_ADDRESS 0x01004FA8 /end MEASUREMENT
/begin COMPU_METHOD Compu_AUX_PUD5_raw " " RAT_FUNC "%.3" "volts" COEFFS 0 13104 0 0 0 1 /end COMPU_METHOD
/begin MEASUREMENT AUX_PUD6_raw "AUX_PUD6_raw" UWORD Compu_AUX_PUD6_raw 0 0 0 5.00114468864469 ECU_ADDRESS 0x01004FB0 /end MEASUREMENT
/begin COMPU_METHOD Compu_AUX_PUD6_raw " " RAT_FUNC "%.3" "volts" COEFFS 0 13104 0 0 0 1 /end COMPU_METHOD
/begin CHARACTERISTIC ecm_multi_sync "Multi-ECM selection{ecm_multi_sync&0xff=0:Single ECM / engine}{ecm_multi_sync&0xff=1:Dual ECM / engine}" VALUE 0x00148158 /* @ECU_Address@ecm_multi_sync@0x01005EA0@ */ ECIPP_ALIGNMENT_UBYTE 255 ecm_multi_sync_COMPU_VTAB 0 255 BIT_MASK 0xff /end CHARACTERISTIC
/begin COMPU_METHOD ecm_multi_sync_COMPU_VTAB "Verbal Table" TAB_VERB "%.0" "list" COMPU_TAB_REF ecm_multi_sync_COMPU_VTAB_REF /end COMPU_METHOD
/begin COMPU_VTAB ecm_multi_sync_COMPU_VTAB_REF "Verbal Table" TAB_VERB 2 0 "Single ECM / engine" 1 "Dual ECM / engine" DEFAULT_VALUE "UNKNOWN" /end COMPU_VTAB
/begin MEASUREMENT SHIFT_I_FB_raw "SHIFT_I_FB_raw" UWORD Compu_SHIFT_I_FB_raw 0 0 0 5.00114468864469 ECU_ADDRESS 0x010069A0 /end MEASUREMENT
/begin COMPU_METHOD Compu_SHIFT_I_FB_raw " " RAT_FUNC "%.3" "volts" COEFFS 0 13104 0 0 0 1 /end COMPU_METHOD
/begin MEASUREMENT Valternator_raw "Valternator_raw" UWORD Compu_Valternator_raw 0 0 0 5.00114468864469 ECU_ADDRESS 0x01006FE8 /end MEASUREMENT
/begin COMPU_METHOD Compu_Valternator_raw " " RAT_FUNC "%.3" "-" COEFFS 0 13104 0 0 0 1 /end COMPU_METHOD
/begin MEASUREMENT AUX_PWM6_FB_raw "AUX_PWM6_FB_raw" UWORD Compu_AUX_PWM6_FB_raw 0 0 0 5.00114468864469 ECU_ADDRESS 0x01007040 /end MEASUREMENT
/begin COMPU_METHOD Compu_AUX_PWM6_FB_raw " " RAT_FUNC "%.3" "volts" COEFFS 0 13104 0 0 0 1 /end COMPU_METHOD
/begin MEASUREMENT CAM1_ana_raw "CAM1_ana_raw" UWORD Compu_CAM1_ana_raw 0 0 0 5.00114468864469 ECU_ADDRESS 0x01007448 /end MEASUREMENT
/begin COMPU_METHOD Compu_CAM1_ana_raw " " RAT_FUNC "%.3" "-" COEFFS 0 13104 0 0 0 1 /end COMPU_METHOD
/begin MEASUREMENT RS_ana_raw "RS_ana_raw" UWORD Compu_RS_ana_raw 0 0 0 5.00114468864469 ECU_ADDRESS 0x01007450 /end MEASUREMENT
/begin COMPU_METHOD Compu_RS_ana_raw " " RAT_FUNC "%.3" "-" COEFFS 0 13104 0 0 0 1 /end COMPU_METHOD
/begin MEASUREMENT AUX_PWM7_FB_raw "AUX_PWM7_FB_raw" UWORD Compu_AUX_PWM7_FB_raw 0 0 0 5.00114468864469 ECU_ADDRESS 0x01007458 /end MEASUREMENT
/begin COMPU_METHOD Compu_AUX_PWM7_FB_raw " " RAT_FUNC "%.3" "-" COEFFS 0 13104 0 0 0 1 /end COMPU_METHOD
/begin MEASUREMENT AUX_PWM8_FB_raw "AUX_PWM8_FB_raw" UWORD Compu_AUX_PWM8_FB_raw 0 0 0 5.00114468864469 ECU_ADDRESS 0x01007460 /end MEASUREMENT
/begin COMPU_METHOD Compu_AUX_PWM8_FB_raw " " RAT_FUNC "%.3" "-" COEFFS 0 13104 0 0 0 1 /end COMPU_METHOD
/begin MEASUREMENT RELAY_LS_raw "RELAY_LS_raw" UWORD Compu_RELAY_LS_raw 0 0 0 5.00114468864469 ECU_ADDRESS 0x01007468 /end MEASUREMENT
/begin COMPU_METHOD Compu_RELAY_LS_raw " " RAT_FUNC "%.3" "-" COEFFS 0 13104 0 0 0 1 /end COMPU_METHOD
/begin MEASUREMENT LOCKOFF_LS_raw "LOCKOFF_LS_raw" UWORD Compu_LOCKOFF_LS_raw 0 0 0 5.00114468864469 ECU_ADDRESS 0x01007470 /end MEASUREMENT
/begin COMPU_METHOD Compu_LOCKOFF_LS_raw " " RAT_FUNC "%.3" "-" COEFFS 0 13104 0 0 0 1 /end COMPU_METHOD
/begin MEASUREMENT STARTER_FB_raw "STARTER_FB_raw" UWORD Compu_STARTER_FB_raw 0 0 0 5.00114468864469 ECU_ADDRESS 0x01007478 /end MEASUREMENT
/begin COMPU_METHOD Compu_STARTER_FB_raw " " RAT_FUNC "%.3" "-" COEFFS 0 13104 0 0 0 1 /end COMPU_METHOD
/begin MEASUREMENT MIL_LS_raw "MIL_LS_raw" UWORD Compu_MIL_LS_raw 0 0 0 5.00114468864469 ECU_ADDRESS 0x01007480 /end MEASUREMENT
/begin COMPU_METHOD Compu_MIL_LS_raw " " RAT_FUNC "%.3" "-" COEFFS 0 13104 0 0 0 1 /end COMPU_METHOD
/begin MEASUREMENT TACH_FB_raw "TACH_FB_raw" UWORD Compu_TACH_FB_raw 0 0 0 5.00114468864469 ECU_ADDRESS 0x01007488 /end MEASUREMENT
/begin COMPU_METHOD Compu_TACH_FB_raw " " RAT_FUNC "%.3" "-" COEFFS 0 13104 0 0 0 1 /end COMPU_METHOD
/begin MEASUREMENT AUX_DIG4_raw "AUX_DIG4_raw" UWORD Compu_AUX_DIG4_raw 0 0 0 5.00114468864469 ECU_ADDRESS 0x01007490 /end MEASUREMENT
/begin COMPU_METHOD Compu_AUX_DIG4_raw " " RAT_FUNC "%.3" "-" COEFFS 0 13104 0 0 0 1 /end COMPU_METHOD
/begin MEASUREMENT AUX_DIG5_raw "AUX_DIG5_raw" UWORD Compu_AUX_DIG5_raw 0 0 0 5.00114468864469 ECU_ADDRESS 0x01007498 /end MEASUREMENT
/begin COMPU_METHOD Compu_AUX_DIG5_raw " " RAT_FUNC "%.3" "-" COEFFS 0 13104 0 0 0 1 /end COMPU_METHOD
/begin MEASUREMENT AUX_DIG6_raw "AUX_DIG6_raw" UWORD Compu_AUX_DIG6_raw 0 0 0 5.00114468864469 ECU_ADDRESS 0x010074A0 /end MEASUREMENT
/begin COMPU_METHOD Compu_AUX_DIG6_raw " " RAT_FUNC "%.3" "-" COEFFS 0 13104 0 0 0 1 /end COMPU_METHOD
/begin MEASUREMENT AUX_DIG7_raw "AUX_DIG7_raw" UWORD Compu_AUX_DIG7_raw 0 0 0 5.00114468864469 ECU_ADDRESS 0x010074A8 /end MEASUREMENT
/begin COMPU_METHOD Compu_AUX_DIG7_raw " " RAT_FUNC "%.3" "-" COEFFS 0 13104 0 0 0 1 /end COMPU_METHOD
/begin MEASUREMENT AUX_DIG8_raw "AUX_DIG8_raw" UWORD Compu_AUX_DIG8_raw 0 0 0 5.00114468864469 ECU_ADDRESS 0x010074B0 /end MEASUREMENT
/begin COMPU_METHOD Compu_AUX_DIG8_raw " " RAT_FUNC "%.3" "-" COEFFS 0 13104 0 0 0 1 /end COMPU_METHOD
/begin MEASUREMENT AUX_DIG4_volt "AUX_DIG4 volts" UWORD Compu_AUX_DIG4_volt 0 0 0 255.99609375 ECU_ADDRESS 0x010074B8 /end MEASUREMENT
/begin COMPU_METHOD Compu_AUX_DIG4_volt " " RAT_FUNC "%.2" "volts" COEFFS 0 256 0 0 0 1 /end COMPU_METHOD
/begin MEASUREMENT AUX_DIG5_volt "AUX_DIG5 volts" UWORD Compu_AUX_DIG5_volt 0 0 0 255.99609375 ECU_ADDRESS 0x010074C0 /end MEASUREMENT
/begin COMPU_METHOD Compu_AUX_DIG5_volt " " RAT_FUNC "%.2" "volts" COEFFS 0 256 0 0 0 1 /end COMPU_METHOD
/begin MEASUREMENT AUX_DIG6_volt "AUX_DIG6 volts" UWORD Compu_AUX_DIG6_volt 0 0 0 255.99609375 ECU_ADDRESS 0x010074C8 /end MEASUREMENT
/begin COMPU_METHOD Compu_AUX_DIG6_volt " " RAT_FUNC "%.2" "volts" COEFFS 0 256 0 0 0 1 /end COMPU_METHOD
/begin MEASUREMENT AUX_DIG7_volt "AUX_DIG7 volts" UWORD Compu_AUX_DIG7_volt 0 0 0 255.99609375 ECU_ADDRESS 0x010074D0 /end MEASUREMENT
/begin COMPU_METHOD Compu_AUX_DIG7_volt " " RAT_FUNC "%.2" "volts" COEFFS 0 256 0 0 0 1 /end COMPU_METHOD
/begin MEASUREMENT AUX_DIG8_volt "AUX_DIG8 volts" UWORD Compu_AUX_DIG8_volt 0 0 0 255.99609375 ECU_ADDRESS 0x010074D8 /end MEASUREMENT
/begin COMPU_METHOD Compu_AUX_DIG8_volt " " RAT_FUNC "%.2" "volts" COEFFS 0 256 0 0 0 1 /end COMPU_METHOD
/begin MEASUREMENT UEGOPI_raw "UEGOPI_raw" UWORD Compu_UEGOPI_raw 0 0 0 5.00114468864469 ECU_ADDRESS 0x01007548 /end MEASUREMENT
/begin COMPU_METHOD Compu_UEGOPI_raw " " RAT_FUNC "%.3" "-" COEFFS 0 13104 0 0 0 1 /end COMPU_METHOD
/begin MEASUREMENT UEGOSR_raw "UEGOSR_raw" UWORD Compu_UEGOSR_raw 0 0 0 5.00114468864469 ECU_ADDRESS 0x01007550 /end MEASUREMENT
/begin COMPU_METHOD Compu_UEGOSR_raw " " RAT_FUNC "%.3" "-" COEFFS 0 13104 0 0 0 1 /end COMPU_METHOD
/begin MEASUREMENT UEGOHFB_raw "UEGOHFB_raw" UWORD Compu_UEGOHFB_raw 0 0 0 5.00114468864469 ECU_ADDRESS 0x01007558 /end MEASUREMENT
/begin COMPU_METHOD Compu_UEGOHFB_raw " " RAT_FUNC "%.3" "-" COEFFS 0 13104 0 0 0 1 /end COMPU_METHOD
/begin MEASUREMENT AUX_DIG12_raw "AUX_DIG12_raw" UWORD Compu_AUX_DIG12_raw 0 0 0 5.00114468864469 ECU_ADDRESS 0x01007B18 /end MEASUREMENT
/begin COMPU_METHOD Compu_AUX_DIG12_raw " " RAT_FUNC "%.3" "volts" COEFFS 0 13104 0 0 0 1 /end COMPU_METHOD
/begin MEASUREMENT AUX_PUD7_raw "AUX_PUD7_raw" UWORD Compu_AUX_PUD7_raw 0 0 0 5.00114468864469 ECU_ADDRESS 0x01007B20 /end MEASUREMENT
/begin COMPU_METHOD Compu_AUX_PUD7_raw " " RAT_FUNC "%.3" "volts" COEFFS 0 13104 0 0 0 1 /end COMPU_METHOD
/begin MEASUREMENT AUX_PUD8_raw "AUX_PUD8_raw" UWORD Compu_AUX_PUD8_raw 0 0 0 5.00114468864469 ECU_ADDRESS 0x01007B28 /end MEASUREMENT
/begin COMPU_METHOD Compu_AUX_PUD8_raw " " RAT_FUNC "%.3" "volts" COEFFS 0 13104 0 0 0 1 /end COMPU_METHOD
/begin MEASUREMENT AUX_DIG11_raw "AUX_DIG11_raw" UWORD Compu_AUX_DIG11_raw 0 0 0 5.00114468864469 ECU_ADDRESS 0x01007B30 /end MEASUREMENT
/begin COMPU_METHOD Compu_AUX_DIG11_raw " " RAT_FUNC "%.3" "volts" COEFFS 0 13104 0 0 0 1 /end COMPU_METHOD
/begin MEASUREMENT AUX_DIG11_volt "AUX_DIG11 volts" UWORD Compu_AUX_DIG11_volt 0 0 0 255.99609375 ECU_ADDRESS 0x01007B38 /end MEASUREMENT
/begin COMPU_METHOD Compu_AUX_DIG11_volt " " RAT_FUNC "%.2" "volts" COEFFS 0 256 0 0 0 1 /end COMPU_METHOD
/begin MEASUREMENT FPUMP_FB_raw "FPUMP_FB_raw" UWORD Compu_FPUMP_FB_raw 0 0 0 5.00114468864469 ECU_ADDRESS 0x01007B48 /end MEASUREMENT
/begin COMPU_METHOD Compu_FPUMP_FB_raw " " RAT_FUNC "%.3" "volts" COEFFS 0 13104 0 0 0 1 /end COMPU_METHOD
/begin MEASUREMENT AUX_DIG9_raw "AUX_DIG9_raw" UWORD Compu_AUX_DIG9_raw 0 0 0 5.00114468864469 ECU_ADDRESS 0x01007B68 /end MEASUREMENT
/begin COMPU_METHOD Compu_AUX_DIG9_raw " " RAT_FUNC "%.3" "-" COEFFS 0 13104 0 0 0 1 /end COMPU_METHOD
/begin MEASUREMENT AUX_DIG9_volt "AUX_DIG9 volts" UWORD Compu_AUX_DIG9_volt 0 0 0 255.99609375 ECU_ADDRESS 0x01007B70 /end MEASUREMENT
/begin COMPU_METHOD Compu_AUX_DIG9_volt " " RAT_FUNC "%.2" "volts" COEFFS 0 256 0 0 0 1 /end COMPU_METHOD
/begin MEASUREMENT AUX_DIG10_raw "AUX_DIG10_raw" UWORD Compu_AUX_DIG10_raw 0 0 0 5.00114468864469 ECU_ADDRESS 0x01007B80 /end MEASUREMENT
/begin COMPU_METHOD Compu_AUX_DIG10_raw " " RAT_FUNC "%.3" "-" COEFFS 0 13104 0 0 0 1 /end COMPU_METHOD
/begin MEASUREMENT AUX_DIG10_volt "AUX_DIG10 volts" UWORD Compu_AUX_DIG10_volt 0 0 0 255.99609375 ECU_ADDRESS 0x01007B88 /end MEASUREMENT
/begin COMPU_METHOD Compu_AUX_DIG10_volt " " RAT_FUNC "%.2" "volts" COEFFS 0 256 0 0 0 1 /end COMPU_METHOD
/begin MEASUREMENT AUX_DIG12_volt "AUX_DIG12 volts" UWORD Compu_AUX_DIG12_volt 0 0 0 255.99609375 ECU_ADDRESS 0x01007B98 /end MEASUREMENT
/begin COMPU_METHOD Compu_AUX_DIG12_volt " " RAT_FUNC "%.2" "volts" COEFFS 0 256 0 0 0 1 /end COMPU_METHOD
/begin MEASUREMENT AUX_DIG13_raw "AUX_DIG13_raw" UWORD Compu_AUX_DIG13_raw 0 0 0 5.00114468864469 ECU_ADDRESS 0x01007D68 /end MEASUREMENT
/begin COMPU_METHOD Compu_AUX_DIG13_raw " " RAT_FUNC "%.3" "volts" COEFFS 0 13104 0 0 0 1 /end COMPU_METHOD
/begin MEASUREMENT AUX_DIG13_volt "AUX_DIG13 volts" UWORD Compu_AUX_DIG13_volt 0 0 0 255.99609375 ECU_ADDRESS 0x01007D70 /end MEASUREMENT
/begin COMPU_METHOD Compu_AUX_DIG13_volt " " RAT_FUNC "%.2" "volts" COEFFS 0 256 0 0 0 1 /end COMPU_METHOD
/begin MEASUREMENT AUX_DIG14_raw "AUX_DIG14_raw" UWORD Compu_AUX_DIG14_raw 0 0 0 5.00114468864469 ECU_ADDRESS 0x01007D80 /end MEASUREMENT
/begin COMPU_METHOD Compu_AUX_DIG14_raw " " RAT_FUNC "%.3" "volts" COEFFS 0 13104 0 0 0 1 /end COMPU_METHOD
/begin MEASUREMENT AUX_DIG14_volt "AUX_DIG14 volts" UWORD Compu_AUX_DIG14_volt 0 0 0 255.99609375 ECU_ADDRESS 0x01007D88 /end MEASUREMENT
/begin COMPU_METHOD Compu_AUX_DIG14_volt " " RAT_FUNC "%.2" "volts" COEFFS 0 256 0 0 0 1 /end COMPU_METHOD
/begin MEASUREMENT AUX_DIG15_raw "AUX_DIG15_raw" UWORD Compu_AUX_DIG15_raw 0 0 0 5.00114468864469 ECU_ADDRESS 0x01007D98 /end MEASUREMENT
/begin COMPU_METHOD Compu_AUX_DIG15_raw " " RAT_FUNC "%.3" "volts" COEFFS 0 13104 0 0 0 1 /end COMPU_METHOD
/begin MEASUREMENT AUX_DIG15_volt "AUX_DIG15 volts" UWORD Compu_AUX_DIG15_volt 0 0 0 255.99609375 ECU_ADDRESS 0x01007DA0 /end MEASUREMENT
/begin COMPU_METHOD Compu_AUX_DIG15_volt " " RAT_FUNC "%.2" "volts" COEFFS 0 256 0 0 0 1 /end COMPU_METHOD
/begin MEASUREMENT AUX_DIG16_raw "AUX_DIG16_raw" UWORD Compu_AUX_DIG16_raw 0 0 0 5.00114468864469 ECU_ADDRESS 0x01007DB0 /end MEASUREMENT
/begin COMPU_METHOD Compu_AUX_DIG16_raw " " RAT_FUNC "%.3" "volts" COEFFS 0 13104 0 0 0 1 /end COMPU_METHOD
/begin MEASUREMENT AUX_DIG16_volt "AUX_DIG16 volts" UWORD Compu_AUX_DIG16_volt 0 0 0 255.99609375 ECU_ADDRESS 0x01007DB8 /end MEASUREMENT
/begin COMPU_METHOD Compu_AUX_DIG16_volt " " RAT_FUNC "%.2" "volts" COEFFS 0 256 0 0 0 1 /end COMPU_METHOD
/begin MEASUREMENT AUX_DIG17_raw "AUX_DIG17_raw" UWORD Compu_AUX_DIG17_raw 0 0 0 5.00114468864469 ECU_ADDRESS 0x01007DC8 /end MEASUREMENT
/begin COMPU_METHOD Compu_AUX_DIG17_raw " " RAT_FUNC "%.3" "volts" COEFFS 0 13104 0 0 0 1 /end COMPU_METHOD
/begin MEASUREMENT AUX_DIG17_volt "AUX_DIG17 volts" UWORD Compu_AUX_DIG17_volt 0 0 0 255.99609375 ECU_ADDRESS 0x01007DD0 /end MEASUREMENT
/begin COMPU_METHOD Compu_AUX_DIG17_volt " " RAT_FUNC "%.2" "volts" COEFFS 0 256 0 0 0 1 /end COMPU_METHOD
/begin MEASUREMENT AUX_DIG18_raw "AUX_DIG18_raw" UWORD Compu_AUX_DIG18_raw 0 0 0 5.00114468864469 ECU_ADDRESS 0x01007DE0 /end MEASUREMENT
/begin COMPU_METHOD Compu_AUX_DIG18_raw " " RAT_FUNC "%.3" "volts" COEFFS 0 13104 0 0 0 1 /end COMPU_METHOD
/begin MEASUREMENT AUX_DIG18_volt "AUX_DIG18 volts" UWORD Compu_AUX_DIG18_volt 0 0 0 255.99609375 ECU_ADDRESS 0x01007DE8 /end MEASUREMENT
/begin COMPU_METHOD Compu_AUX_DIG18_volt " " RAT_FUNC "%.2" "volts" COEFFS 0 256 0 0 0 1 /end COMPU_METHOD
/begin MEASUREMENT AUX_DIG19_raw "AUX_DIG19_raw" UWORD Compu_AUX_DIG19_raw 0 0 0 5.00114468864469 ECU_ADDRESS 0x01007DF8 /end MEASUREMENT
/begin COMPU_METHOD Compu_AUX_DIG19_raw " " RAT_FUNC "%.3" "volts" COEFFS 0 13104 0 0 0 1 /end COMPU_METHOD
/begin MEASUREMENT AUX_DIG19_volt "AUX_DIG19 volts" UWORD Compu_AUX_DIG19_volt 0 0 0 255.99609375 ECU_ADDRESS 0x01007E00 /end MEASUREMENT
/begin COMPU_METHOD Compu_AUX_DIG19_volt " " RAT_FUNC "%.2" "volts" COEFFS 0 256 0 0 0 1 /end COMPU_METHOD
/begin MEASUREMENT AUX_PUD9_raw "AUX_PUD9_raw" UWORD Compu_AUX_PUD9_raw 0 0 0 5.00114468864469 ECU_ADDRESS 0x01007E10 /end MEASUREMENT
/begin COMPU_METHOD Compu_AUX_PUD9_raw " " RAT_FUNC "%.3" "volts" COEFFS 0 13104 0 0 0 1 /end COMPU_METHOD
/begin MEASUREMENT AUX_PUD10_raw "AUX_PUD10_raw" UWORD Compu_AUX_PUD10_raw 0 0 0 5.00114468864469 ECU_ADDRESS 0x01007E18 /end MEASUREMENT
/begin COMPU_METHOD Compu_AUX_PUD10_raw " " RAT_FUNC "%.3" "volts" COEFFS 0 13104 0 0 0 1 /end COMPU_METHOD
/begin MEASUREMENT AUX_PUD11_raw "AUX_PUD11_raw" UWORD Compu_AUX_PUD11_raw 0 0 0 5.00114468864469 ECU_ADDRESS 0x01007E20 /end MEASUREMENT
/begin COMPU_METHOD Compu_AUX_PUD11_raw " " RAT_FUNC "%.3" "volts" COEFFS 0 13104 0 0 0 1 /end COMPU_METHOD
/begin MEASUREMENT AUX_PUD12_raw "AUX_PUD12_raw" UWORD Compu_AUX_PUD12_raw 0 0 0 5.00114468864469 ECU_ADDRESS 0x01007E28 /end MEASUREMENT
/begin COMPU_METHOD Compu_AUX_PUD12_raw " " RAT_FUNC "%.3" "volts" COEFFS 0 13104 0 0 0 1 /end COMPU_METHOD
/begin MEASUREMENT AUX_PUD13_raw "AUX_PUD13_raw" UWORD Compu_AUX_PUD13_raw 0 0 0 5.00114468864469 ECU_ADDRESS 0x01007E30 /end MEASUREMENT
/begin COMPU_METHOD Compu_AUX_PUD13_raw " " RAT_FUNC "%.3" "volts" COEFFS 0 13104 0 0 0 1 /end COMPU_METHOD
/begin MEASUREMENT AUX_PUD14_raw "AUX_PUD14_raw" UWORD Compu_AUX_PUD14_raw 0 0 0 5.00114468864469 ECU_ADDRESS 0x01007E38 /end MEASUREMENT
/begin COMPU_METHOD Compu_AUX_PUD14_raw " " RAT_FUNC "%.3" "volts" COEFFS 0 13104 0 0 0 1 /end COMPU_METHOD
/begin MEASUREMENT AUX_PUD15_raw "AUX_PUD15_raw" UWORD Compu_AUX_PUD15_raw 0 0 0 5.00114468864469 ECU_ADDRESS 0x01007E40 /end MEASUREMENT
/begin COMPU_METHOD Compu_AUX_PUD15_raw " " RAT_FUNC "%.3" "volts" COEFFS 0 13104 0 0 0 1 /end COMPU_METHOD
/begin MEASUREMENT AUX_PUD16_raw "AUX_PUD16_raw" UWORD Compu_AUX_PUD16_raw 0 0 0 5.00114468864469 ECU_ADDRESS 0x01007E48 /end MEASUREMENT
/begin COMPU_METHOD Compu_AUX_PUD16_raw " " RAT_FUNC "%.3" "volts" COEFFS 0 13104 0 0 0 1 /end COMPU_METHOD
/begin MEASUREMENT AUX_PUD17_raw "AUX_PUD17_raw" UWORD Compu_AUX_PUD17_raw 0 0 0 5.00114468864469 ECU_ADDRESS 0x01007E50 /end MEASUREMENT
/begin COMPU_METHOD Compu_AUX_PUD17_raw " " RAT_FUNC "%.3" "volts" COEFFS 0 13104 0 0 0 1 /end COMPU_METHOD
/begin MEASUREMENT AUX_PUD18_raw "AUX_PUD18_raw" UWORD Compu_AUX_PUD18_raw 0 0 0 5.00114468864469 ECU_ADDRESS 0x01007E58 /end MEASUREMENT
/begin COMPU_METHOD Compu_AUX_PUD18_raw " " RAT_FUNC "%.3" "volts" COEFFS 0 13104 0 0 0 1 /end COMPU_METHOD
/begin MEASUREMENT AUX_PUD19_raw "AUX_PUD19_raw" UWORD Compu_AUX_PUD19_raw 0 0 0 5.00114468864469 ECU_ADDRESS 0x01007E60 /end MEASUREMENT
/begin COMPU_METHOD Compu_AUX_PUD19_raw " " RAT_FUNC "%.3" "volts" COEFFS 0 13104 0 0 0 1 /end COMPU_METHOD
/begin MEASUREMENT AUX_PUD20_raw "AUX_PUD20_raw" UWORD Compu_AUX_PUD20_raw 0 0 0 5.00114468864469 ECU_ADDRESS 0x01007E68 /end MEASUREMENT
/begin COMPU_METHOD Compu_AUX_PUD20_raw " " RAT_FUNC "%.3" "volts" COEFFS 0 13104 0 0 0 1 /end COMPU_METHOD
/begin MEASUREMENT AUX_PUD21_raw "AUX_PUD21_raw" UWORD Compu_AUX_PUD21_raw 0 0 0 5.00114468864469 ECU_ADDRESS 0x01007E70 /end MEASUREMENT
/begin COMPU_METHOD Compu_AUX_PUD21_raw " " RAT_FUNC "%.3" "volts" COEFFS 0 13104 0 0 0 1 /end COMPU_METHOD
/begin MEASUREMENT AUX_PUD22_raw "AUX_PUD22_raw" UWORD Compu_AUX_PUD22_raw 0 0 0 5.00114468864469 ECU_ADDRESS 0x01007E78 /end MEASUREMENT
/begin COMPU_METHOD Compu_AUX_PUD22_raw " " RAT_FUNC "%.3" "volts" COEFFS 0 13104 0 0 0 1 /end COMPU_METHOD
/begin MEASUREMENT AUX_PUD23_raw "AUX_PUD23_raw" UWORD Compu_AUX_PUD23_raw 0 0 0 5.00114468864469 ECU_ADDRESS 0x01007E80 /end MEASUREMENT
/begin COMPU_METHOD Compu_AUX_PUD23_raw " " RAT_FUNC "%.3" "volts" COEFFS 0 13104 0 0 0 1 /end COMPU_METHOD
/begin MEASUREMENT AUX_PUD24_raw "AUX_PUD24_raw" UWORD Compu_AUX_PUD24_raw 0 0 0 5.00114468864469 ECU_ADDRESS 0x01007E88 /end MEASUREMENT
/begin COMPU_METHOD Compu_AUX_PUD24_raw " " RAT_FUNC "%.3" "volts" COEFFS 0 13104 0 0 0 1 /end COMPU_METHOD
/begin MEASUREMENT AUX_PUD25_raw "AUX_PUD25_raw" UWORD Compu_AUX_PUD25_raw 0 0 0 5.00114468864469 ECU_ADDRESS 0x01007E90 /end MEASUREMENT
/begin COMPU_METHOD Compu_AUX_PUD25_raw " " RAT_FUNC "%.3" "volts" COEFFS 0 13104 0 0 0 1 /end COMPU_METHOD
/begin MEASUREMENT AUX_PWM9_FB_raw "AUX_PWM9_FB_raw" UWORD Compu_AUX_PWM9_FB_raw 0 0 0 5.00114468864469 ECU_ADDRESS 0x01007F98 /end MEASUREMENT
/begin COMPU_METHOD Compu_AUX_PWM9_FB_raw " " RAT_FUNC "%.3" "volts" COEFFS 0 13104 0 0 0 1 /end COMPU_METHOD
/begin MEASUREMENT AUX_PWM10_FB_raw "AUX_PWM10_FB_raw" UWORD Compu_AUX_PWM10_FB_raw 0 0 0 5.00114468864469 ECU_ADDRESS 0x01007FA0 /end MEASUREMENT
/begin COMPU_METHOD Compu_AUX_PWM10_FB_raw " " RAT_FUNC "%.3" "volts" COEFFS 0 13104 0 0 0 1 /end COMPU_METHOD
/begin MEASUREMENT AUX_PWM11_FB_raw "AUX_PWM11_FB_raw" UWORD Compu_AUX_PWM11_FB_raw 0 0 0 5.00114468864469 ECU_ADDRESS 0x01007FA8 /end MEASUREMENT
/begin COMPU_METHOD Compu_AUX_PWM11_FB_raw " " RAT_FUNC "%.3" "volts" COEFFS 0 13104 0 0 0 1 /end COMPU_METHOD
/begin MEASUREMENT AUX_PWM12_FB_raw "AUX_PWM12_FB_raw" UWORD Compu_AUX_PWM12_FB_raw 0 0 0 5.00114468864469 ECU_ADDRESS 0x01007FB0 /end MEASUREMENT
/begin COMPU_METHOD Compu_AUX_PWM12_FB_raw " " RAT_FUNC "%.3" "volts" COEFFS 0 13104 0 0 0 1 /end COMPU_METHOD
/begin MEASUREMENT AUX_PWM13_FB_raw "AUX_PWM13_FB_raw" UWORD Compu_AUX_PWM13_FB_raw 0 0 0 5.00114468864469 ECU_ADDRESS 0x01007FB8 /end MEASUREMENT
/begin COMPU_METHOD Compu_AUX_PWM13_FB_raw " " RAT_FUNC "%.3" "volts" COEFFS 0 13104 0 0 0 1 /end COMPU_METHOD
/begin MEASUREMENT AUX_PWM14_FB_raw "AUX_PWM14_FB_raw" UWORD Compu_AUX_PWM14_FB_raw 0 0 0 5.00114468864469 ECU_ADDRESS 0x01007FC0 /end MEASUREMENT
/begin COMPU_METHOD Compu_AUX_PWM14_FB_raw " " RAT_FUNC "%.3" "volts" COEFFS 0 13104 0 0 0 1 /end COMPU_METHOD
/begin MEASUREMENT AUX_PWM15_FB_raw "AUX_PWM15_FB_raw" UWORD Compu_AUX_PWM15_FB_raw 0 0 0 5.00114468864469 ECU_ADDRESS 0x01007FC8 /end MEASUREMENT
/begin COMPU_METHOD Compu_AUX_PWM15_FB_raw " " RAT_FUNC "%.3" "volts" COEFFS 0 13104 0 0 0 1 /end COMPU_METHOD
/begin MEASUREMENT UEGO2PI_raw "UEGO2PI_raw" UWORD Compu_UEGO2PI_raw 0 0 0 5.00114468864469 ECU_ADDRESS 0x010081E0 /end MEASUREMENT
/begin COMPU_METHOD Compu_UEGO2PI_raw " " RAT_FUNC "%.3" "-" COEFFS 0 13104 0 0 0 1 /end COMPU_METHOD
/begin MEASUREMENT UEGO2SR_raw "UEGO2SR_raw" UWORD Compu_UEGO2SR_raw 0 0 0 5.00114468864469 ECU_ADDRESS 0x010081E8 /end MEASUREMENT
/begin COMPU_METHOD Compu_UEGO2SR_raw " " RAT_FUNC "%.3" "-" COEFFS 0 13104 0 0 0 1 /end COMPU_METHOD
/begin MEASUREMENT UEGO2HFB_raw "UEGO2HFB_raw" UWORD Compu_UEGO2HFB_raw 0 0 0 5.00114468864469 ECU_ADDRESS 0x010081F0 /end MEASUREMENT
/begin COMPU_METHOD Compu_UEGO2HFB_raw " " RAT_FUNC "%.3" "-" COEFFS 0 13104 0 0 0 1 /end COMPU_METHOD
/begin CHARACTERISTIC ecm_multi_Voffset "Multi-ECM slave position offset" VALUE 0x00146668 /* @ECU_Address@ecm_multi_Voffset@0x01008470@ */ ECIPP_ALIGNMENT_SWORD 2048 Compu_ecm_multi_Voffset -2048 2047.9375 /end CHARACTERISTIC
/begin COMPU_METHOD Compu_ecm_multi_Voffset " " RAT_FUNC "%.1" "CAD" COEFFS 0 16 0 0 0 1 /end COMPU_METHOD
/begin CHARACTERISTIC ecm_multi_ECT "Multi-ECM ECT input{ecm_multi_ECT&0xff=0:Master and slave}{ecm_multi_ECT&0xff=1:Master only}" VALUE 0x00148151 /* @ECU_Address@ecm_multi_ECT@0x01008488@ */ ECIPP_ALIGNMENT_UBYTE 255 ecm_multi_ECT_COMPU_VTAB 0 255 BIT_MASK 0xff /end CHARACTERISTIC
/begin COMPU_METHOD ecm_multi_ECT_COMPU_VTAB "Verbal Table" TAB_VERB "%.0" "list" COMPU_TAB_REF ecm_multi_ECT_COMPU_VTAB_REF /end COMPU_METHOD
/begin COMPU_VTAB ecm_multi_ECT_COMPU_VTAB_REF "Verbal Table" TAB_VERB 2 0 "Master and slave" 1 "Master only" DEFAULT_VALUE "UNKNOWN" /end COMPU_VTAB
/begin CHARACTERISTIC ecm_multi_OILP "Multi-ECM oil pressure input{ecm_multi_OILP&0xff=0:Master and slave}{ecm_multi_OILP&0xff=1:Master only}" VALUE 0x00148153 /* @ECU_Address@ecm_multi_OILP@0x01008490@ */ ECIPP_ALIGNMENT_UBYTE 255 ecm_multi_OILP_COMPU_VTAB 0 255 BIT_MASK 0xff /end CHARACTERISTIC
/begin COMPU_METHOD ecm_multi_OILP_COMPU_VTAB "Verbal Table" TAB_VERB "%.0" "list" COMPU_TAB_REF ecm_multi_OILP_COMPU_VTAB_REF /end COMPU_METHOD
/begin COMPU_VTAB ecm_multi_OILP_COMPU_VTAB_REF "Verbal Table" TAB_VERB 2 0 "Master and slave" 1 "Master only" DEFAULT_VALUE "UNKNOWN" /end COMPU_VTAB
/begin CHARACTERISTIC ecm_multi_RELAY "Multi-ECM relay output{ecm_multi_RELAY&0xff=0:Master and slave}{ecm_multi_RELAY&0xff=1:Master only}" VALUE 0x00148154 /* @ECU_Address@ecm_multi_RELAY@0x01008498@ */ ECIPP_ALIGNMENT_UBYTE 255 ecm_multi_RELAY_COMPU_VTAB 0 255 BIT_MASK 0xff /end CHARACTERISTIC
/begin COMPU_METHOD ecm_multi_RELAY_COMPU_VTAB "Verbal Table" TAB_VERB "%.0" "list" COMPU_TAB_REF ecm_multi_RELAY_COMPU_VTAB_REF /end COMPU_METHOD
/begin COMPU_VTAB ecm_multi_RELAY_COMPU_VTAB_REF "Verbal Table" TAB_VERB 2 0 "Master and slave" 1 "Master only" DEFAULT_VALUE "UNKNOWN" /end COMPU_VTAB
/begin CHARACTERISTIC ecm_multi_MIL "Multi-ECM MIL output{ecm_multi_MIL&0xff=0:Master and slave}{ecm_multi_MIL&0xff=1:Master only}" VALUE 0x00148152 /* @ECU_Address@ecm_multi_MIL@0x010084A0@ */ ECIPP_ALIGNMENT_UBYTE 255 ecm_multi_MIL_COMPU_VTAB 0 255 BIT_MASK 0xff /end CHARACTERISTIC
/begin COMPU_METHOD ecm_multi_MIL_COMPU_VTAB "Verbal Table" TAB_VERB "%.0" "list" COMPU_TAB_REF ecm_multi_MIL_COMPU_VTAB_REF /end COMPU_METHOD
/begin COMPU_VTAB ecm_multi_MIL_COMPU_VTAB_REF "Verbal Table" TAB_VERB 2 0 "Master and slave" 1 "Master only" DEFAULT_VALUE "UNKNOWN" /end COMPU_VTAB
/begin CHARACTERISTIC ecm_multi_START "Multi-ECM standard starter output{ecm_multi_START&0xff=0:Master and slave}{ecm_multi_START&0xff=1:Master only}" VALUE 0x00148157 /* @ECU_Address@ecm_multi_START@0x010084A8@ */ ECIPP_ALIGNMENT_UBYTE 255 ecm_multi_START_COMPU_VTAB 0 255 BIT_MASK 0xff /end CHARACTERISTIC
/begin COMPU_METHOD ecm_multi_START_COMPU_VTAB "Verbal Table" TAB_VERB "%.0" "list" COMPU_TAB_REF ecm_multi_START_COMPU_VTAB_REF /end COMPU_METHOD
/begin COMPU_VTAB ecm_multi_START_COMPU_VTAB_REF "Verbal Table" TAB_VERB 2 0 "Master and slave" 1 "Master only" DEFAULT_VALUE "UNKNOWN" /end COMPU_VTAB
/begin CHARACTERISTIC ecm_multi_SPK_mstr1 "Cylinder 1{ecm_multi_SPK_mstr1&0xff=0:Disabled}{ecm_multi_SPK_mstr1&0xff=1:Coil 1a}{ecm_multi_SPK_mstr1&0xff=2:Coil 2a}{ecm_multi_SPK_mstr1&0xff=3:Coil 3a}{ecm_multi_SPK_mstr1&0xff=4:Coil 4a}{ecm_multi_SPK_mstr1&0xff=5:Coil 5a}{ecm_multi_SPK_mstr1&0xff=6:" VALUE 0x0016C30D /* @ECU_Address@ecm_multi_SPK_mstr1@0x010084B0@ */ ECIPP_ALIGNMENT_UBYTE 255 ecm_multi_SPK_mstr1_COMPU_VTAB 0 255 BIT_MASK 0xff /end CHARACTERISTIC
/begin COMPU_METHOD ecm_multi_SPK_mstr1_COMPU_VTAB "Verbal Table" TAB_VERB "%.0" "list" COMPU_TAB_REF ecm_multi_SPK_mstr1_COMPU_VTAB_REF /end COMPU_METHOD
/begin COMPU_VTAB ecm_multi_SPK_mstr1_COMPU_VTAB_REF "Verbal Table" TAB_VERB 11 0 "Disabled" 1 "Coil 1a" 2 "Coil 2a" 3 "Coil 3a" 4 "Coil 4a" 5 "Coil 5a" 6 "Coil 1b" 7 "Coil 2b" 8 "Coil 3b" 9 "Coil 4b" 10 "Coil 5b" DEFAULT_VALUE "UNKNOWN" /end COMPU_VTAB
/begin CHARACTERISTIC ecm_multi_SPK_mstr2 "Cylinder 2{ecm_multi_SPK_mstr2&0xff=0:Disabled}{ecm_multi_SPK_mstr2&0xff=1:Coil 1a}{ecm_multi_SPK_mstr2&0xff=2:Coil 2a}{ecm_multi_SPK_mstr2&0xff=3:Coil 3a}{ecm_multi_SPK_mstr2&0xff=4:Coil 4a}{ecm_multi_SPK_mstr2&0xff=5:Coil 5a}{ecm_multi_SPK_mstr2&0xff=6:" VALUE 0x0016C30E /* @ECU_Address@ecm_multi_SPK_mstr2@0x010084B8@ */ ECIPP_ALIGNMENT_UBYTE 255 ecm_multi_SPK_mstr2_COMPU_VTAB 0 255 BIT_MASK 0xff /end CHARACTERISTIC
/begin COMPU_METHOD ecm_multi_SPK_mstr2_COMPU_VTAB "Verbal Table" TAB_VERB "%.0" "list" COMPU_TAB_REF ecm_multi_SPK_mstr2_COMPU_VTAB_REF /end COMPU_METHOD
/begin COMPU_VTAB ecm_multi_SPK_mstr2_COMPU_VTAB_REF "Verbal Table" TAB_VERB 11 0 "Disabled" 1 "Coil 1a" 2 "Coil 2a" 3 "Coil 3a" 4 "Coil 4a" 5 "Coil 5a" 6 "Coil 1b" 7 "Coil 2b" 8 "Coil 3b" 9 "Coil 4b" 10 "Coil 5b" DEFAULT_VALUE "UNKNOWN" /end COMPU_VTAB
/begin CHARACTERISTIC ecm_multi_SPK_mstr3 "Cylinder 3{ecm_multi_SPK_mstr3&0xff=0:Disabled}{ecm_multi_SPK_mstr3&0xff=1:Coil 1a}{ecm_multi_SPK_mstr3&0xff=2:Coil 2a}{ecm_multi_SPK_mstr3&0xff=3:Coil 3a}{ecm_multi_SPK_mstr3&0xff=4:Coil 4a}{ecm_multi_SPK_mstr3&0xff=5:Coil 5a}{ecm_multi_SPK_mstr3&0xff=6:" VALUE 0x0016C30F /* @ECU_Address@ecm_multi_SPK_mstr3@0x010084C0@ */ ECIPP_ALIGNMENT_UBYTE 255 ecm_multi_SPK_mstr3_COMPU_VTAB 0 255 BIT_MASK 0xff /end CHARACTERISTIC
/begin COMPU_METHOD ecm_multi_SPK_mstr3_COMPU_VTAB "Verbal Table" TAB_VERB "%.0" "list" COMPU_TAB_REF ecm_multi_SPK_mstr3_COMPU_VTAB_REF /end COMPU_METHOD
/begin COMPU_VTAB ecm_multi_SPK_mstr3_COMPU_VTAB_REF "Verbal Table" TAB_VERB 11 0 "Disabled" 1 "Coil 1a" 2 "Coil 2a" 3 "Coil 3a" 4 "Coil 4a" 5 "Coil 5a" 6 "Coil 1b" 7 "Coil 2b" 8 "Coil 3b" 9 "Coil 4b" 10 "Coil 5b" DEFAULT_VALUE "UNKNOWN" /end COMPU_VTAB
/begin CHARACTERISTIC ecm_multi_SPK_mstr4 "Cylinder 4{ecm_multi_SPK_mstr4&0xff=0:Disabled}{ecm_multi_SPK_mstr4&0xff=1:Coil 1a}{ecm_multi_SPK_mstr4&0xff=2:Coil 2a}{ecm_multi_SPK_mstr4&0xff=3:Coil 3a}{ecm_multi_SPK_mstr4&0xff=4:Coil 4a}{ecm_multi_SPK_mstr4&0xff=5:Coil 5a}{ecm_multi_SPK_mstr4&0xff=6:" VALUE 0x0016C310 /* @ECU_Address@ecm_multi_SPK_mstr4@0x010084C8@ */ ECIPP_ALIGNMENT_UBYTE 255 ecm_multi_SPK_mstr4_COMPU_VTAB 0 255 BIT_MASK 0xff /end CHARACTERISTIC
/begin COMPU_METHOD ecm_multi_SPK_mstr4_COMPU_VTAB "Verbal Table" TAB_VERB "%.0" "list" COMPU_TAB_REF ecm_multi_SPK_mstr4_COMPU_VTAB_REF /end COMPU_METHOD
/begin COMPU_VTAB ecm_multi_SPK_mstr4_COMPU_VTAB_REF "Verbal Table" TAB_VERB 11 0 "Disabled" 1 "Coil 1a" 2 "Coil 2a" 3 "Coil 3a" 4 "Coil 4a" 5 "Coil 5a" 6 "Coil 1b" 7 "Coil 2b" 8 "Coil 3b" 9 "Coil 4b" 10 "Coil 5b" DEFAULT_VALUE "UNKNOWN" /end COMPU_VTAB
/begin CHARACTERISTIC ecm_multi_SPK_mstr5 "Cylinder 5{ecm_multi_SPK_mstr5&0xff=0:Disabled}{ecm_multi_SPK_mstr5&0xff=1:Coil 1a}{ecm_multi_SPK_mstr5&0xff=2:Coil 2a}{ecm_multi_SPK_mstr5&0xff=3:Coil 3a}{ecm_multi_SPK_mstr5&0xff=4:Coil 4a}{ecm_multi_SPK_mstr5&0xff=5:Coil 5a}{ecm_multi_SPK_mstr5&0xff=6:" VALUE 0x0016C311 /* @ECU_Address@ecm_multi_SPK_mstr5@0x010084D0@ */ ECIPP_ALIGNMENT_UBYTE 255 ecm_multi_SPK_mstr5_COMPU_VTAB 0 255 BIT_MASK 0xff /end CHARACTERISTIC
/begin COMPU_METHOD ecm_multi_SPK_mstr5_COMPU_VTAB "Verbal Table" TAB_VERB "%.0" "list" COMPU_TAB_REF ecm_multi_SPK_mstr5_COMPU_VTAB_REF /end COMPU_METHOD
/begin COMPU_VTAB ecm_multi_SPK_mstr5_COMPU_VTAB_REF "Verbal Table" TAB_VERB 11 0 "Disabled" 1 "Coil 1a" 2 "Coil 2a" 3 "Coil 3a" 4 "Coil 4a" 5 "Coil 5a" 6 "Coil 1b" 7 "Coil 2b" 8 "Coil 3b" 9 "Coil 4b" 10 "Coil 5b" DEFAULT_VALUE "UNKNOWN" /end COMPU_VTAB
/begin CHARACTERISTIC ecm_multi_SPK_mstr6 "Cylinder 6{ecm_multi_SPK_mstr6&0xff=0:Disabled}{ecm_multi_SPK_mstr6&0xff=1:Coil 1a}{ecm_multi_SPK_mstr6&0xff=2:Coil 2a}{ecm_multi_SPK_mstr6&0xff=3:Coil 3a}{ecm_multi_SPK_mstr6&0xff=4:Coil 4a}{ecm_multi_SPK_mstr6&0xff=5:Coil 5a}{ecm_multi_SPK_mstr6&0xff=6:" VALUE 0x0016C312 /* @ECU_Address@ecm_multi_SPK_mstr6@0x010084D8@ */ ECIPP_ALIGNMENT_UBYTE 255 ecm_multi_SPK_mstr6_COMPU_VTAB 0 255 BIT_MASK 0xff /end CHARACTERISTIC
/begin COMPU_METHOD ecm_multi_SPK_mstr6_COMPU_VTAB "Verbal Table" TAB_VERB "%.0" "list" COMPU_TAB_REF ecm_multi_SPK_mstr6_COMPU_VTAB_REF /end COMPU_METHOD
/begin COMPU_VTAB ecm_multi_SPK_mstr6_COMPU_VTAB_REF "Verbal Table" TAB_VERB 11 0 "Disabled" 1 "Coil 1a" 2 "Coil 2a" 3 "Coil 3a" 4 "Coil 4a" 5 "Coil 5a" 6 "Coil 1b" 7 "Coil 2b" 8 "Coil 3b" 9 "Coil 4b" 10 "Coil 5b" DEFAULT_VALUE "UNKNOWN" /end COMPU_VTAB
/begin CHARACTERISTIC ecm_multi_SPK_mstr7 "Cylinder 7{ecm_multi_SPK_mstr7&0xff=0:Disabled}{ecm_multi_SPK_mstr7&0xff=1:Coil 1a}{ecm_multi_SPK_mstr7&0xff=2:Coil 2a}{ecm_multi_SPK_mstr7&0xff=3:Coil 3a}{ecm_multi_SPK_mstr7&0xff=4:Coil 4a}{ecm_multi_SPK_mstr7&0xff=5:Coil 5a}{ecm_multi_SPK_mstr7&0xff=6:" VALUE 0x0016C313 /* @ECU_Address@ecm_multi_SPK_mstr7@0x010084E0@ */ ECIPP_ALIGNMENT_UBYTE 255 ecm_multi_SPK_mstr7_COMPU_VTAB 0 255 BIT_MASK 0xff /end CHARACTERISTIC
/begin COMPU_METHOD ecm_multi_SPK_mstr7_COMPU_VTAB "Verbal Table" TAB_VERB "%.0" "list" COMPU_TAB_REF ecm_multi_SPK_mstr7_COMPU_VTAB_REF /end COMPU_METHOD
/begin COMPU_VTAB ecm_multi_SPK_mstr7_COMPU_VTAB_REF "Verbal Table" TAB_VERB 11 0 "Disabled" 1 "Coil 1a" 2 "Coil 2a" 3 "Coil 3a" 4 "Coil 4a" 5 "Coil 5a" 6 "Coil 1b" 7 "Coil 2b" 8 "Coil 3b" 9 "Coil 4b" 10 "Coil 5b" DEFAULT_VALUE "UNKNOWN" /end COMPU_VTAB
/begin CHARACTERISTIC ecm_multi_SPK_mstr8 "Cylinder 8{ecm_multi_SPK_mstr8&0xff=0:Disabled}{ecm_multi_SPK_mstr8&0xff=1:Coil 1a}{ecm_multi_SPK_mstr8&0xff=2:Coil 2a}{ecm_multi_SPK_mstr8&0xff=3:Coil 3a}{ecm_multi_SPK_mstr8&0xff=4:Coil 4a}{ecm_multi_SPK_mstr8&0xff=5:Coil 5a}{ecm_multi_SPK_mstr8&0xff=6:" VALUE 0x0016C314 /* @ECU_Address@ecm_multi_SPK_mstr8@0x010084E8@ */ ECIPP_ALIGNMENT_UBYTE 255 ecm_multi_SPK_mstr8_COMPU_VTAB 0 255 BIT_MASK 0xff /end CHARACTERISTIC
/begin COMPU_METHOD ecm_multi_SPK_mstr8_COMPU_VTAB "Verbal Table" TAB_VERB "%.0" "list" COMPU_TAB_REF ecm_multi_SPK_mstr8_COMPU_VTAB_REF /end COMPU_METHOD
/begin COMPU_VTAB ecm_multi_SPK_mstr8_COMPU_VTAB_REF "Verbal Table" TAB_VERB 11 0 "Disabled" 1 "Coil 1a" 2 "Coil 2a" 3 "Coil 3a" 4 "Coil 4a" 5 "Coil 5a" 6 "Coil 1b" 7 "Coil 2b" 8 "Coil 3b" 9 "Coil 4b" 10 "Coil 5b" DEFAULT_VALUE "UNKNOWN" /end COMPU_VTAB
/begin CHARACTERISTIC ecm_multi_SPK_mstr9 "Cylinder 9{ecm_multi_SPK_mstr9&0xff=0:Disabled}{ecm_multi_SPK_mstr9&0xff=1:Coil 1a}{ecm_multi_SPK_mstr9&0xff=2:Coil 2a}{ecm_multi_SPK_mstr9&0xff=3:Coil 3a}{ecm_multi_SPK_mstr9&0xff=4:Coil 4a}{ecm_multi_SPK_mstr9&0xff=5:Coil 5a}{ecm_multi_SPK_mstr9&0xff=6:" VALUE 0x0016C315 /* @ECU_Address@ecm_multi_SPK_mstr9@0x010084F0@ */ ECIPP_ALIGNMENT_UBYTE 255 ecm_multi_SPK_mstr9_COMPU_VTAB 0 255 BIT_MASK 0xff /end CHARACTERISTIC
/begin COMPU_METHOD ecm_multi_SPK_mstr9_COMPU_VTAB "Verbal Table" TAB_VERB "%.0" "list" COMPU_TAB_REF ecm_multi_SPK_mstr9_COMPU_VTAB_REF /end COMPU_METHOD
/begin COMPU_VTAB ecm_multi_SPK_mstr9_COMPU_VTAB_REF "Verbal Table" TAB_VERB 11 0 "Disabled" 1 "Coil 1a" 2 "Coil 2a" 3 "Coil 3a" 4 "Coil 4a" 5 "Coil 5a" 6 "Coil 1b" 7 "Coil 2b" 8 "Coil 3b" 9 "Coil 4b" 10 "Coil 5b" DEFAULT_VALUE "UNKNOWN" /end COMPU_VTAB
/begin CHARACTERISTIC ecm_multi_SPK_mstr10 "Cylinder 10{ecm_multi_SPK_mstr10&0xff=0:Disabled}{ecm_multi_SPK_mstr10&0xff=1:Coil 1a}{ecm_multi_SPK_mstr10&0xff=2:Coil 2a}{ecm_multi_SPK_mstr10&0xff=3:Coil 3a}{ecm_multi_SPK_mstr10&0xff=4:Coil 4a}{ecm_multi_SPK_mstr10&0xff=5:Coil 5a}{ecm_multi_SPK_mstr10" VALUE 0x0016C316 /* @ECU_Address@ecm_multi_SPK_mstr10@0x010084F8@ */ ECIPP_ALIGNMENT_UBYTE 255 ecm_multi_SPK_mstr10_COMPU_VTAB 0 255 BIT_MASK 0xff /end CHARACTERISTIC
/begin COMPU_METHOD ecm_multi_SPK_mstr10_COMPU_VTAB "Verbal Table" TAB_VERB "%.0" "list" COMPU_TAB_REF ecm_multi_SPK_mstr10_COMPU_VTAB_REF /end COMPU_METHOD
/begin COMPU_VTAB ecm_multi_SPK_mstr10_COMPU_VTAB_REF "Verbal Table" TAB_VERB 11 0 "Disabled" 1 "Coil 1a" 2 "Coil 2a" 3 "Coil 3a" 4 "Coil 4a" 5 "Coil 5a" 6 "Coil 1b" 7 "Coil 2b" 8 "Coil 3b" 9 "Coil 4b" 10 "Coil 5b" DEFAULT_VALUE "UNKNOWN" /end COMPU_VTAB
/begin CHARACTERISTIC ecm_multi_SPK_slv1 "Cylinder 1{ecm_multi_SPK_slv1&0xff=0:Disabled}{ecm_multi_SPK_slv1&0xff=1:Coil 1a}{ecm_multi_SPK_slv1&0xff=2:Coil 2a}{ecm_multi_SPK_slv1&0xff=3:Coil 3a}{ecm_multi_SPK_slv1&0xff=4:Coil 4a}{ecm_multi_SPK_slv1&0xff=5:Coil 5a}{ecm_multi_SPK_slv1&0xff=6:Coil 1b" VALUE 0x0016C317 /* @ECU_Address@ecm_multi_SPK_slv1@0x01008500@ */ ECIPP_ALIGNMENT_UBYTE 255 ecm_multi_SPK_slv1_COMPU_VTAB 0 255 BIT_MASK 0xff /end CHARACTERISTIC
/begin COMPU_METHOD ecm_multi_SPK_slv1_COMPU_VTAB "Verbal Table" TAB_VERB "%.0" "list" COMPU_TAB_REF ecm_multi_SPK_slv1_COMPU_VTAB_REF /end COMPU_METHOD
/begin COMPU_VTAB ecm_multi_SPK_slv1_COMPU_VTAB_REF "Verbal Table" TAB_VERB 11 0 "Disabled" 1 "Coil 1a" 2 "Coil 2a" 3 "Coil 3a" 4 "Coil 4a" 5 "Coil 5a" 6 "Coil 1b" 7 "Coil 2b" 8 "Coil 3b" 9 "Coil 4b" 10 "Coil 5b" DEFAULT_VALUE "UNKNOWN" /end COMPU_VTAB
/begin CHARACTERISTIC ecm_multi_SPK_slv2 "Cylinder 2{ecm_multi_SPK_slv2&0xff=0:Disabled}{ecm_multi_SPK_slv2&0xff=1:Coil 1a}{ecm_multi_SPK_slv2&0xff=2:Coil 2a}{ecm_multi_SPK_slv2&0xff=3:Coil 3a}{ecm_multi_SPK_slv2&0xff=4:Coil 4a}{ecm_multi_SPK_slv2&0xff=5:Coil 5a}{ecm_multi_SPK_slv2&0xff=6:Coil 1b" VALUE 0x0016C318 /* @ECU_Address@ecm_multi_SPK_slv2@0x01008508@ */ ECIPP_ALIGNMENT_UBYTE 255 ecm_multi_SPK_slv2_COMPU_VTAB 0 255 BIT_MASK 0xff /end CHARACTERISTIC
/begin COMPU_METHOD ecm_multi_SPK_slv2_COMPU_VTAB "Verbal Table" TAB_VERB "%.0" "list" COMPU_TAB_REF ecm_multi_SPK_slv2_COMPU_VTAB_REF /end COMPU_METHOD
/begin COMPU_VTAB ecm_multi_SPK_slv2_COMPU_VTAB_REF "Verbal Table" TAB_VERB 11 0 "Disabled" 1 "Coil 1a" 2 "Coil 2a" 3 "Coil 3a" 4 "Coil 4a" 5 "Coil 5a" 6 "Coil 1b" 7 "Coil 2b" 8 "Coil 3b" 9 "Coil 4b" 10 "Coil 5b" DEFAULT_VALUE "UNKNOWN" /end COMPU_VTAB
/begin CHARACTERISTIC ecm_multi_SPK_slv3 "Cylinder 3{ecm_multi_SPK_slv3&0xff=0:Disabled}{ecm_multi_SPK_slv3&0xff=1:Coil 1a}{ecm_multi_SPK_slv3&0xff=2:Coil 2a}{ecm_multi_SPK_slv3&0xff=3:Coil 3a}{ecm_multi_SPK_slv3&0xff=4:Coil 4a}{ecm_multi_SPK_slv3&0xff=5:Coil 5a}{ecm_multi_SPK_slv3&0xff=6:Coil 1b" VALUE 0x0016C319 /* @ECU_Address@ecm_multi_SPK_slv3@0x01008510@ */ ECIPP_ALIGNMENT_UBYTE 255 ecm_multi_SPK_slv3_COMPU_VTAB 0 255 BIT_MASK 0xff /end CHARACTERISTIC
/begin COMPU_METHOD ecm_multi_SPK_slv3_COMPU_VTAB "Verbal Table" TAB_VERB "%.0" "list" COMPU_TAB_REF ecm_multi_SPK_slv3_COMPU_VTAB_REF /end COMPU_METHOD
/begin COMPU_VTAB ecm_multi_SPK_slv3_COMPU_VTAB_REF "Verbal Table" TAB_VERB 11 0 "Disabled" 1 "Coil 1a" 2 "Coil 2a" 3 "Coil 3a" 4 "Coil 4a" 5 "Coil 5a" 6 "Coil 1b" 7 "Coil 2b" 8 "Coil 3b" 9 "Coil 4b" 10 "Coil 5b" DEFAULT_VALUE "UNKNOWN" /end COMPU_VTAB
/begin CHARACTERISTIC ecm_multi_SPK_slv4 "Cylinder 4{ecm_multi_SPK_slv4&0xff=0:Disabled}{ecm_multi_SPK_slv4&0xff=1:Coil 1a}{ecm_multi_SPK_slv4&0xff=2:Coil 2a}{ecm_multi_SPK_slv4&0xff=3:Coil 3a}{ecm_multi_SPK_slv4&0xff=4:Coil 4a}{ecm_multi_SPK_slv4&0xff=5:Coil 5a}{ecm_multi_SPK_slv4&0xff=6:Coil 1b" VALUE 0x0016C31A /* @ECU_Address@ecm_multi_SPK_slv4@0x01008518@ */ ECIPP_ALIGNMENT_UBYTE 255 ecm_multi_SPK_slv4_COMPU_VTAB 0 255 BIT_MASK 0xff /end CHARACTERISTIC
/begin COMPU_METHOD ecm_multi_SPK_slv4_COMPU_VTAB "Verbal Table" TAB_VERB "%.0" "list" COMPU_TAB_REF ecm_multi_SPK_slv4_COMPU_VTAB_REF /end COMPU_METHOD
/begin COMPU_VTAB ecm_multi_SPK_slv4_COMPU_VTAB_REF "Verbal Table" TAB_VERB 11 0 "Disabled" 1 "Coil 1a" 2 "Coil 2a" 3 "Coil 3a" 4 "Coil 4a" 5 "Coil 5a" 6 "Coil 1b" 7 "Coil 2b" 8 "Coil 3b" 9 "Coil 4b" 10 "Coil 5b" DEFAULT_VALUE "UNKNOWN" /end COMPU_VTAB
/begin CHARACTERISTIC ecm_multi_SPK_slv5 "Cylinder 5{ecm_multi_SPK_slv5&0xff=0:Disabled}{ecm_multi_SPK_slv5&0xff=1:Coil 1a}{ecm_multi_SPK_slv5&0xff=2:Coil 2a}{ecm_multi_SPK_slv5&0xff=3:Coil 3a}{ecm_multi_SPK_slv5&0xff=4:Coil 4a}{ecm_multi_SPK_slv5&0xff=5:Coil 5a}{ecm_multi_SPK_slv5&0xff=6:Coil 1b" VALUE 0x0016C31B /* @ECU_Address@ecm_multi_SPK_slv5@0x01008520@ */ ECIPP_ALIGNMENT_UBYTE 255 ecm_multi_SPK_slv5_COMPU_VTAB 0 255 BIT_MASK 0xff /end CHARACTERISTIC
/begin COMPU_METHOD ecm_multi_SPK_slv5_COMPU_VTAB "Verbal Table" TAB_VERB "%.0" "list" COMPU_TAB_REF ecm_multi_SPK_slv5_COMPU_VTAB_REF /end COMPU_METHOD
/begin COMPU_VTAB ecm_multi_SPK_slv5_COMPU_VTAB_REF "Verbal Table" TAB_VERB 11 0 "Disabled" 1 "Coil 1a" 2 "Coil 2a" 3 "Coil 3a" 4 "Coil 4a" 5 "Coil 5a" 6 "Coil 1b" 7 "Coil 2b" 8 "Coil 3b" 9 "Coil 4b" 10 "Coil 5b" DEFAULT_VALUE "UNKNOWN" /end COMPU_VTAB
/begin CHARACTERISTIC ecm_multi_SPK_slv6 "Cylinder 6{ecm_multi_SPK_slv6&0xff=0:Disabled}{ecm_multi_SPK_slv6&0xff=1:Coil 1a}{ecm_multi_SPK_slv6&0xff=2:Coil 2a}{ecm_multi_SPK_slv6&0xff=3:Coil 3a}{ecm_multi_SPK_slv6&0xff=4:Coil 4a}{ecm_multi_SPK_slv6&0xff=5:Coil 5a}{ecm_multi_SPK_slv6&0xff=6:Coil 1b" VALUE 0x0016C31C /* @ECU_Address@ecm_multi_SPK_slv6@0x01008528@ */ ECIPP_ALIGNMENT_UBYTE 255 ecm_multi_SPK_slv6_COMPU_VTAB 0 255 BIT_MASK 0xff /end CHARACTERISTIC
/begin COMPU_METHOD ecm_multi_SPK_slv6_COMPU_VTAB "Verbal Table" TAB_VERB "%.0" "list" COMPU_TAB_REF ecm_multi_SPK_slv6_COMPU_VTAB_REF /end COMPU_METHOD
/begin COMPU_VTAB ecm_multi_SPK_slv6_COMPU_VTAB_REF "Verbal Table" TAB_VERB 11 0 "Disabled" 1 "Coil 1a" 2 "Coil 2a" 3 "Coil 3a" 4 "Coil 4a" 5 "Coil 5a" 6 "Coil 1b" 7 "Coil 2b" 8 "Coil 3b" 9 "Coil 4b" 10 "Coil 5b" DEFAULT_VALUE "UNKNOWN" /end COMPU_VTAB
/begin CHARACTERISTIC ecm_multi_SPK_slv7 "Cylinder 7{ecm_multi_SPK_slv7&0xff=0:Disabled}{ecm_multi_SPK_slv7&0xff=1:Coil 1a}{ecm_multi_SPK_slv7&0xff=2:Coil 2a}{ecm_multi_SPK_slv7&0xff=3:Coil 3a}{ecm_multi_SPK_slv7&0xff=4:Coil 4a}{ecm_multi_SPK_slv7&0xff=5:Coil 5a}{ecm_multi_SPK_slv7&0xff=6:Coil 1b" VALUE 0x0016C31D /* @ECU_Address@ecm_multi_SPK_slv7@0x01008530@ */ ECIPP_ALIGNMENT_UBYTE 255 ecm_multi_SPK_slv7_COMPU_VTAB 0 255 BIT_MASK 0xff /end CHARACTERISTIC
/begin COMPU_METHOD ecm_multi_SPK_slv7_COMPU_VTAB "Verbal Table" TAB_VERB "%.0" "list" COMPU_TAB_REF ecm_multi_SPK_slv7_COMPU_VTAB_REF /end COMPU_METHOD
/begin COMPU_VTAB ecm_multi_SPK_slv7_COMPU_VTAB_REF "Verbal Table" TAB_VERB 11 0 "Disabled" 1 "Coil 1a" 2 "Coil 2a" 3 "Coil 3a" 4 "Coil 4a" 5 "Coil 5a" 6 "Coil 1b" 7 "Coil 2b" 8 "Coil 3b" 9 "Coil 4b" 10 "Coil 5b" DEFAULT_VALUE "UNKNOWN" /end COMPU_VTAB
/begin CHARACTERISTIC ecm_multi_SPK_slv8 "Cylinder 8{ecm_multi_SPK_slv8&0xff=0:Disabled}{ecm_multi_SPK_slv8&0xff=1:Coil 1a}{ecm_multi_SPK_slv8&0xff=2:Coil 2a}{ecm_multi_SPK_slv8&0xff=3:Coil 3a}{ecm_multi_SPK_slv8&0xff=4:Coil 4a}{ecm_multi_SPK_slv8&0xff=5:Coil 5a}{ecm_multi_SPK_slv8&0xff=6:Coil 1b" VALUE 0x0016C31E /* @ECU_Address@ecm_multi_SPK_slv8@0x01008538@ */ ECIPP_ALIGNMENT_UBYTE 255 ecm_multi_SPK_slv8_COMPU_VTAB 0 255 BIT_MASK 0xff /end CHARACTERISTIC
/begin COMPU_METHOD ecm_multi_SPK_slv8_COMPU_VTAB "Verbal Table" TAB_VERB "%.0" "list" COMPU_TAB_REF ecm_multi_SPK_slv8_COMPU_VTAB_REF /end COMPU_METHOD
/begin COMPU_VTAB ecm_multi_SPK_slv8_COMPU_VTAB_REF "Verbal Table" TAB_VERB 11 0 "Disabled" 1 "Coil 1a" 2 "Coil 2a" 3 "Coil 3a" 4 "Coil 4a" 5 "Coil 5a" 6 "Coil 1b" 7 "Coil 2b" 8 "Coil 3b" 9 "Coil 4b" 10 "Coil 5b" DEFAULT_VALUE "UNKNOWN" /end COMPU_VTAB
/begin CHARACTERISTIC ecm_multi_SPK_slv9 "Cylinder 9{ecm_multi_SPK_slv9&0xff=0:Disabled}{ecm_multi_SPK_slv9&0xff=1:Coil 1a}{ecm_multi_SPK_slv9&0xff=2:Coil 2a}{ecm_multi_SPK_slv9&0xff=3:Coil 3a}{ecm_multi_SPK_slv9&0xff=4:Coil 4a}{ecm_multi_SPK_slv9&0xff=5:Coil 5a}{ecm_multi_SPK_slv9&0xff=6:Coil 1b" VALUE 0x0016C31F /* @ECU_Address@ecm_multi_SPK_slv9@0x01008540@ */ ECIPP_ALIGNMENT_UBYTE 255 ecm_multi_SPK_slv9_COMPU_VTAB 0 255 BIT_MASK 0xff /end CHARACTERISTIC
/begin COMPU_METHOD ecm_multi_SPK_slv9_COMPU_VTAB "Verbal Table" TAB_VERB "%.0" "list" COMPU_TAB_REF ecm_multi_SPK_slv9_COMPU_VTAB_REF /end COMPU_METHOD
/begin COMPU_VTAB ecm_multi_SPK_slv9_COMPU_VTAB_REF "Verbal Table" TAB_VERB 11 0 "Disabled" 1 "Coil 1a" 2 "Coil 2a" 3 "Coil 3a" 4 "Coil 4a" 5 "Coil 5a" 6 "Coil 1b" 7 "Coil 2b" 8 "Coil 3b" 9 "Coil 4b" 10 "Coil 5b" DEFAULT_VALUE "UNKNOWN" /end COMPU_VTAB
/begin CHARACTERISTIC ecm_multi_SPK_slv10 "Cylinder 10{ecm_multi_SPK_slv10&0xff=0:Disabled}{ecm_multi_SPK_slv10&0xff=1:Coil 1a}{ecm_multi_SPK_slv10&0xff=2:Coil 2a}{ecm_multi_SPK_slv10&0xff=3:Coil 3a}{ecm_multi_SPK_slv10&0xff=4:Coil 4a}{ecm_multi_SPK_slv10&0xff=5:Coil 5a}{ecm_multi_SPK_slv10&0xff=6" VALUE 0x0016C320 /* @ECU_Address@ecm_multi_SPK_slv10@0x01008548@ */ ECIPP_ALIGNMENT_UBYTE 255 ecm_multi_SPK_slv10_COMPU_VTAB 0 255 BIT_MASK 0xff /end CHARACTERISTIC
/begin COMPU_METHOD ecm_multi_SPK_slv10_COMPU_VTAB "Verbal Table" TAB_VERB "%.0" "list" COMPU_TAB_REF ecm_multi_SPK_slv10_COMPU_VTAB_REF /end COMPU_METHOD
/begin COMPU_VTAB ecm_multi_SPK_slv10_COMPU_VTAB_REF "Verbal Table" TAB_VERB 11 0 "Disabled" 1 "Coil 1a" 2 "Coil 2a" 3 "Coil 3a" 4 "Coil 4a" 5 "Coil 5a" 6 "Coil 1b" 7 "Coil 2b" 8 "Coil 3b" 9 "Coil 4b" 10 "Coil 5b" DEFAULT_VALUE "UNKNOWN" /end COMPU_VTAB
/begin CHARACTERISTIC ecm_multi_SPK_ena "Multi-ECM manual spark assignment{ecm_multi_SPK_ena&0xff=0:Disabled}{ecm_multi_SPK_ena&0xff=1:Dual ECM / engine}{ecm_multi_SPK_ena&0xff=2:Single ECM / engine}" VALUE 0x00148156 /* @ECU_Address@ecm_multi_SPK_ena@0x01008550@ */ ECIPP_ALIGNMENT_UBYTE 255 ecm_multi_SPK_ena_COMPU_VTAB 0 255 BIT_MASK 0xff /end CHARACTERISTIC
/begin COMPU_METHOD ecm_multi_SPK_ena_COMPU_VTAB "Verbal Table" TAB_VERB "%.0" "list" COMPU_TAB_REF ecm_multi_SPK_ena_COMPU_VTAB_REF /end COMPU_METHOD
/begin COMPU_VTAB ecm_multi_SPK_ena_COMPU_VTAB_REF "Verbal Table" TAB_VERB 3 0 "Disabled" 1 "Dual ECM / engine" 2 "Single ECM / engine" DEFAULT_VALUE "UNKNOWN" /end COMPU_VTAB
/begin CHARACTERISTIC NTEphi_ena "NTE phi transition sytem enable{NTEphi_ena&0xff=0:Disabled}{NTEphi_ena&0xff=1:Enabled}" VALUE 0x00147e8a /* @ECU_Address@NTEphi_ena@0x010085D8@ */ ECIPP_ALIGNMENT_UBYTE 255 NTEphi_ena_COMPU_VTAB 0 255 BIT_MASK 0xff /end CHARACTERISTIC
/begin COMPU_METHOD NTEphi_ena_COMPU_VTAB "Verbal Table" TAB_VERB "%.0" "list" COMPU_TAB_REF NTEphi_ena_COMPU_VTAB_REF /end COMPU_METHOD
/begin COMPU_VTAB NTEphi_ena_COMPU_VTAB_REF "Verbal Table" TAB_VERB 2 0 "Disabled" 1 "Enabled" DEFAULT_VALUE "UNKNOWN" /end COMPU_VTAB
/begin MEASUREMENT NTEphi_lim_active "NTE phi transition limiting active{NTEphi_lim_active&0xff=0:NO}{NTEphi_lim_active&0xff=1:YES}" UBYTE NTEphi_lim_active_COMPU_VTAB 0 0 0 255 ECU_ADDRESS 0x010085E0 BIT_MASK 0xff /end MEASUREMENT
/begin COMPU_METHOD NTEphi_lim_active_COMPU_VTAB "Verbal Table" TAB_VERB "%.0" "list" COMPU_TAB_REF NTEphi_lim_active_COMPU_VTAB_REF /end COMPU_METHOD
/begin COMPU_VTAB NTEphi_lim_active_COMPU_VTAB_REF "Verbal Table" TAB_VERB 2 0 "NO" 1 "YES" DEFAULT_VALUE "UNKNOWN" /end COMPU_VTAB
/begin CHARACTERISTIC NTEphi_MAP_hyst "NTE phi transition MAP +hysterisis" VALUE 0x0014765c /* @ECU_Address@NTEphi_MAP_hyst@0x010085E8@ */ ECIPP_ALIGNMENT_UWORD 256 Compu_NTEphi_MAP_hyst 0 255.99609375 /end CHARACTERISTIC
/begin COMPU_METHOD Compu_NTEphi_MAP_hyst " " RAT_FUNC "%.2" "psia" COEFFS 0 256 0 0 0 1 /end COMPU_METHOD
/begin CHARACTERISTIC NTEphi_slew_rate "NTE phi transition phi slew rate" VALUE 0x0014765e /* @ECU_Address@NTEphi_slew_rate@0x010085F0@ */ ECIPP_ALIGNMENT_UWORD 4 Compu_NTEphi_slew_rate 0 3.99993896484375 /end CHARACTERISTIC
/begin COMPU_METHOD Compu_NTEphi_slew_rate " " RAT_FUNC "%.3" "phi/sec" COEFFS 0 16384 0 0 0 1 /end COMPU_METHOD
/begin MEASUREMENT NTEphi_lim "NTE phi transition instant lower phi limit" UWORD Compu_NTEphi_lim 0 0 0 3.99993896484375 ECU_ADDRESS 0x010085F8 /end MEASUREMENT
/begin COMPU_METHOD Compu_NTEphi_lim " " RAT_FUNC "%.3" "phi" COEFFS 0 16384 0 0 0 1 /end COMPU_METHOD
/begin MEASUREMENT NTEphi_lim_slew "NTE phi transition slewed lower phi limit" UWORD Compu_NTEphi_lim_slew 0 0 0 3.99993896484375 ECU_ADDRESS 0x01008600 /end MEASUREMENT
/begin COMPU_METHOD Compu_NTEphi_lim_slew " " RAT_FUNC "%.3" "phi" COEFFS 0 16384 0 0 0 1 /end COMPU_METHOD
/begin CHARACTERISTIC NTEphi_MAPdt_slewoff "NTE phi transition slew disable MAPdt" VALUE 0x00144382 /* @ECU_Address@NTEphi_MAPdt_slewoff@0x01008608@ */ ECIPP_ALIGNMENT_SWORD 4000 Compu_NTEphi_MAPdt_slewoff -4000 3999.8779296875 /end CHARACTERISTIC
/begin COMPU_METHOD Compu_NTEphi_MAPdt_slewoff " " RAT_FUNC "%.1" "psi/sec" COEFFS 0 8.192 0 0 0 1 /end COMPU_METHOD
/begin CHARACTERISTIC NTEphi_CL_ramp_rate "NTE transition CL Lo-limit slew rate" VALUE 0x0014765a /* @ECU_Address@NTEphi_CL_ramp_rate@0x01008610@ */ ECIPP_ALIGNMENT_UWORD 200 Compu_NTEphi_CL_ramp_rate 0 199.996948242188 /end CHARACTERISTIC
/begin COMPU_METHOD Compu_NTEphi_CL_ramp_rate " " RAT_FUNC "%.1" "%/sec" COEFFS 0 327.68 0 0 0 1 /end COMPU_METHOD
/begin CHARACTERISTIC NTEphi_AL_ramp_rate "NTE transition AL Lo-limit slew rate" VALUE 0x00147658 /* @ECU_Address@NTEphi_AL_ramp_rate@0x01008618@ */ ECIPP_ALIGNMENT_UWORD 200 Compu_NTEphi_AL_ramp_rate 0 199.996948242188 /end CHARACTERISTIC
/begin COMPU_METHOD Compu_NTEphi_AL_ramp_rate " " RAT_FUNC "%.1" "%/sec" COEFFS 0 327.68 0 0 0 1 /end COMPU_METHOD
/begin MEASUREMENT NTEphi_CLlo_lim "NTE transition instant CL Lo-limit" SWORD Compu_NTEphi_CLlo_lim 0 0 -100 99.9969482421875 ECU_ADDRESS 0x01008620 /end MEASUREMENT
/begin COMPU_METHOD Compu_NTEphi_CLlo_lim " " RAT_FUNC "%.1" "%" COEFFS 0 327.68 0 0 0 1 /end COMPU_METHOD
/begin MEASUREMENT NTEphi_ALlo_lim "NTE transition instant AL Lo-limit" SWORD Compu_NTEphi_ALlo_lim 0 0 -100 99.9969482421875 ECU_ADDRESS 0x01008628 /end MEASUREMENT
/begin COMPU_METHOD Compu_NTEphi_ALlo_lim " " RAT_FUNC "%.1" "%" COEFFS 0 327.68 0 0 0 1 /end COMPU_METHOD
/begin MEASUREMENT NTEphi_CLlo_slew "NTE transition slewed CL Lo-limit" SWORD Compu_NTEphi_CLlo_slew 0 0 -100 99.9969482421875 ECU_ADDRESS 0x01008630 /end MEASUREMENT
/begin COMPU_METHOD Compu_NTEphi_CLlo_slew " " RAT_FUNC "%.1" "%" COEFFS 0 327.68 0 0 0 1 /end COMPU_METHOD
/begin MEASUREMENT NTEphi_ALlo_slew "NTE transition slewed AL Lo-limit" SWORD Compu_NTEphi_ALlo_slew 0 0 -100 99.9969482421875 ECU_ADDRESS 0x01008638 /end MEASUREMENT
/begin COMPU_METHOD Compu_NTEphi_ALlo_slew " " RAT_FUNC "%.1" "%" COEFFS 0 327.68 0 0 0 1 /end COMPU_METHOD
/begin MEASUREMENT NTEphi_CLlo_active "NTE transition CL Lo-limit active{NTEphi_CLlo_active&0xff=0:NO}{NTEphi_CLlo_active&0xff=1:YES}" UBYTE NTEphi_CLlo_active_COMPU_VTAB 0 0 0 255 ECU_ADDRESS 0x01008640 BIT_MASK 0xff /end MEASUREMENT
/begin COMPU_METHOD NTEphi_CLlo_active_COMPU_VTAB "Verbal Table" TAB_VERB "%.0" "list" COMPU_TAB_REF NTEphi_CLlo_active_COMPU_VTAB_REF /end COMPU_METHOD
/begin COMPU_VTAB NTEphi_CLlo_active_COMPU_VTAB_REF "Verbal Table" TAB_VERB 2 0 "NO" 1 "YES" DEFAULT_VALUE "UNKNOWN" /end COMPU_VTAB
/begin MEASUREMENT NTEphi_ALlo_active "NTE transition AL Lo-limit active{NTEphi_ALlo_active&0xff=0:NO}{NTEphi_ALlo_active&0xff=1:YES}" UBYTE NTEphi_ALlo_active_COMPU_VTAB 0 0 0 255 ECU_ADDRESS 0x01008648 BIT_MASK 0xff /end MEASUREMENT
/begin COMPU_METHOD NTEphi_ALlo_active_COMPU_VTAB "Verbal Table" TAB_VERB "%.0" "list" COMPU_TAB_REF NTEphi_ALlo_active_COMPU_VTAB_REF /end COMPU_METHOD
/begin COMPU_VTAB NTEphi_ALlo_active_COMPU_VTAB_REF "Verbal Table" TAB_VERB 2 0 "NO" 1 "YES" DEFAULT_VALUE "UNKNOWN" /end COMPU_VTAB
/begin MEASUREMENT NTEphi_MAP "NTE phi transition lower MAP" UWORD Compu_NTEphi_MAP 0 0 0 255.99609375 ECU_ADDRESS 0x01008650 /end MEASUREMENT
/begin COMPU_METHOD Compu_NTEphi_MAP " " RAT_FUNC "%.2" "psia" COEFFS 0 256 0 0 0 1 /end COMPU_METHOD
/begin MEASUREMENT CL_lo "Currently active CL lower limit" SWORD Compu_CL_lo 0 0 -100 99.9969482421875 ECU_ADDRESS 0x01008658 /end MEASUREMENT
/begin COMPU_METHOD Compu_CL_lo " " RAT_FUNC "%.1" "%" COEFFS 0 327.68 0 0 0 1 /end COMPU_METHOD
/begin MEASUREMENT CL_hi "Currently active CL upper limit" SWORD Compu_CL_hi 0 0 -100 99.9969482421875 ECU_ADDRESS 0x01008660 /end MEASUREMENT
/begin COMPU_METHOD Compu_CL_hi " " RAT_FUNC "%.1" "%" COEFFS 0 327.68 0 0 0 1 /end COMPU_METHOD
/begin MEASUREMENT AL_lo "Currently active AL lower limit" SWORD Compu_AL_lo 0 0 -100 99.9969482421875 ECU_ADDRESS 0x01008668 /end MEASUREMENT
/begin COMPU_METHOD Compu_AL_lo " " RAT_FUNC "%.1" "%" COEFFS 0 327.68 0 0 0 1 /end COMPU_METHOD
/begin MEASUREMENT AL_hi "Currently active AL upper limit" SWORD Compu_AL_hi 0 0 -100 99.9969482421875 ECU_ADDRESS 0x01008670 /end MEASUREMENT
/begin COMPU_METHOD Compu_AL_hi " " RAT_FUNC "%.1" "%" COEFFS 0 327.68 0 0 0 1 /end COMPU_METHOD
/begin MEASUREMENT Vrelay_raw "Vrelay_raw" UWORD Compu_Vrelay_raw 0 0 0 5.00114468864469 ECU_ADDRESS 0x010086E0 /end MEASUREMENT
/begin COMPU_METHOD Compu_Vrelay_raw " " RAT_FUNC "%.3" "volts" COEFFS 0 13104 0 0 0 1 /end COMPU_METHOD
/begin MEASUREMENT VE5c_FB_raw "VE5c_FB_raw" UWORD Compu_VE5c_FB_raw 0 0 0 5.00114468864469 ECU_ADDRESS 0x010086E8 /end MEASUREMENT
/begin COMPU_METHOD Compu_VE5c_FB_raw " " RAT_FUNC "%.3" "volts" COEFFS 0 13104 0 0 0 1 /end COMPU_METHOD
/begin MEASUREMENT IVS_raw "IVS_raw" UWORD Compu_IVS_raw 0 0 0 5.00114468864469 ECU_ADDRESS 0x010086F0 /end MEASUREMENT
/begin COMPU_METHOD Compu_IVS_raw " " RAT_FUNC "%.3" "volts" COEFFS 0 13104 0 0 0 1 /end COMPU_METHOD
/begin MEASUREMENT AUX_DIG20_raw "AUX_DIG20_raw" UWORD Compu_AUX_DIG20_raw 0 0 0 5.00114468864469 ECU_ADDRESS 0x010086F8 /end MEASUREMENT
/begin COMPU_METHOD Compu_AUX_DIG20_raw " " RAT_FUNC "%.3" "volts" COEFFS 0 13104 0 0 0 1 /end COMPU_METHOD
/begin MEASUREMENT AUX_DIG20_volt "AUX_DIG20_volt" UWORD Compu_AUX_DIG20_volt 0 0 0 255.99609375 ECU_ADDRESS 0x01008700 /end MEASUREMENT
/begin COMPU_METHOD Compu_AUX_DIG20_volt " " RAT_FUNC "%.2" "volts" COEFFS 0 256 0 0 0 1 /end COMPU_METHOD
/begin MEASUREMENT AUX_DIG21_raw "AUX_DIG21_raw" UWORD Compu_AUX_DIG21_raw 0 0 0 5.00114468864469 ECU_ADDRESS 0x01008710 /end MEASUREMENT
/begin COMPU_METHOD Compu_AUX_DIG21_raw " " RAT_FUNC "%.3" "volts" COEFFS 0 13104 0 0 0 1 /end COMPU_METHOD
/begin MEASUREMENT AUX_DIG21_volt "AUX_DIG21_volt" UWORD Compu_AUX_DIG21_volt 0 0 0 255.99609375 ECU_ADDRESS 0x01008718 /end MEASUREMENT
/begin COMPU_METHOD Compu_AUX_DIG21_volt " " RAT_FUNC "%.2" "volts" COEFFS 0 256 0 0 0 1 /end COMPU_METHOD
/begin MEASUREMENT AUX_DIG22_raw "AUX_DIG22_raw" UWORD Compu_AUX_DIG22_raw 0 0 0 5.00114468864469 ECU_ADDRESS 0x01008728 /end MEASUREMENT
/begin COMPU_METHOD Compu_AUX_DIG22_raw " " RAT_FUNC "%.3" "volts" COEFFS 0 13104 0 0 0 1 /end COMPU_METHOD
/begin MEASUREMENT AUX_DIG22_volt "AUX_DIG22_volt" UWORD Compu_AUX_DIG22_volt 0 0 0 255.99609375 ECU_ADDRESS 0x01008730 /end MEASUREMENT
/begin COMPU_METHOD Compu_AUX_DIG22_volt " " RAT_FUNC "%.2" "volts" COEFFS 0 256 0 0 0 1 /end COMPU_METHOD
/begin MEASUREMENT AUX_PWM16_FB_raw "AUX_PWM16_FB_raw" UWORD Compu_AUX_PWM16_FB_raw 0 0 0 5.00114468864469 ECU_ADDRESS 0x01008740 /end MEASUREMENT
/begin COMPU_METHOD Compu_AUX_PWM16_FB_raw " " RAT_FUNC "%.3" "volts" COEFFS 0 13104 0 0 0 1 /end COMPU_METHOD
/begin MEASUREMENT AUX_PWM17_FB_raw "AUX_PWM17_FB_raw" UWORD Compu_AUX_PWM17_FB_raw 0 0 0 5.00114468864469 ECU_ADDRESS 0x01008748 /end MEASUREMENT
/begin COMPU_METHOD Compu_AUX_PWM17_FB_raw " " RAT_FUNC "%.3" "volts" COEFFS 0 13104 0 0 0 1 /end COMPU_METHOD
/begin MEASUREMENT AUX_PWM18_FB_raw "AUX_PWM18_FB_raw" UWORD Compu_AUX_PWM18_FB_raw 0 0 0 5.00114468864469 ECU_ADDRESS 0x01008750 /end MEASUREMENT
/begin COMPU_METHOD Compu_AUX_PWM18_FB_raw " " RAT_FUNC "%.3" "volts" COEFFS 0 13104 0 0 0 1 /end COMPU_METHOD
/begin MEASUREMENT AUX_PWM19_FB_raw "AUX_PWM19_FB_raw" UWORD Compu_AUX_PWM19_FB_raw 0 0 0 5.00114468864469 ECU_ADDRESS 0x01008758 /end MEASUREMENT
/begin COMPU_METHOD Compu_AUX_PWM19_FB_raw " " RAT_FUNC "%.3" "volts" COEFFS 0 13104 0 0 0 1 /end COMPU_METHOD
/begin MEASUREMENT AUX_PWM20_FB_raw "AUX_PWM20_FB_raw" UWORD Compu_AUX_PWM20_FB_raw 0 0 0 5.00114468864469 ECU_ADDRESS 0x01008760 /end MEASUREMENT
/begin COMPU_METHOD Compu_AUX_PWM20_FB_raw " " RAT_FUNC "%.3" "volts" COEFFS 0 13104 0 0 0 1 /end COMPU_METHOD
/begin MEASUREMENT AUX_PWM21_FB_raw "AUX_PWM21_FB_raw" UWORD Compu_AUX_PWM21_FB_raw 0 0 0 5.00114468864469 ECU_ADDRESS 0x01008768 /end MEASUREMENT
/begin COMPU_METHOD Compu_AUX_PWM21_FB_raw " " RAT_FUNC "%.3" "volts" COEFFS 0 13104 0 0 0 1 /end COMPU_METHOD
/begin MEASUREMENT AUX_PWM22_FB_raw "AUX_PWM22_FB_raw" UWORD Compu_AUX_PWM22_FB_raw 0 0 0 5.00114468864469 ECU_ADDRESS 0x01008770 /end MEASUREMENT
/begin COMPU_METHOD Compu_AUX_PWM22_FB_raw " " RAT_FUNC "%.3" "volts" COEFFS 0 13104 0 0 0 1 /end COMPU_METHOD
/begin MEASUREMENT AUX_PWM23_FB_raw "AUX_PWM23_FB_raw" UWORD Compu_AUX_PWM23_FB_raw 0 0 0 5.00114468864469 ECU_ADDRESS 0x01008778 /end MEASUREMENT
/begin COMPU_METHOD Compu_AUX_PWM23_FB_raw " " RAT_FUNC "%.3" "volts" COEFFS 0 13104 0 0 0 1 /end COMPU_METHOD
/begin MEASUREMENT PULSE_IN_raw "PULSE_IN_raw" UWORD Compu_PULSE_IN_raw 0 0 0 5.00114468864469 ECU_ADDRESS 0x01008780 /end MEASUREMENT
/begin COMPU_METHOD Compu_PULSE_IN_raw " " RAT_FUNC "%.3" "volts" COEFFS 0 13104 0 0 0 1 /end COMPU_METHOD
/begin MEASUREMENT BUZZ_FB_raw "BUZZ_FB_raw" UWORD Compu_BUZZ_FB_raw 0 0 0 5.00114468864469 ECU_ADDRESS 0x01008788 /end MEASUREMENT
/begin COMPU_METHOD Compu_BUZZ_FB_raw " " RAT_FUNC "%.3" "volts" COEFFS 0 13104 0 0 0 1 /end COMPU_METHOD
/begin MEASUREMENT DBW_iFB_raw "DBW_iFB_raw" UWORD Compu_DBW_iFB_raw 0 0 0 5.00114468864469 ECU_ADDRESS 0x01008790 /end MEASUREMENT
/begin COMPU_METHOD Compu_DBW_iFB_raw " " RAT_FUNC "%.3" "volts" COEFFS 0 13104 0 0 0 1 /end COMPU_METHOD
/begin MEASUREMENT HBA_iFB_raw "HBA_iFB_raw" UWORD Compu_HBA_iFB_raw 0 0 0 5.00114468864469 ECU_ADDRESS 0x01008798 /end MEASUREMENT
/begin COMPU_METHOD Compu_HBA_iFB_raw " " RAT_FUNC "%.3" "volts" COEFFS 0 13104 0 0 0 1 /end COMPU_METHOD
/begin MEASUREMENT HBB_iFB_raw "HBB_iFB_raw" UWORD Compu_HBB_iFB_raw 0 0 0 5.00114468864469 ECU_ADDRESS 0x010087A0 /end MEASUREMENT
/begin COMPU_METHOD Compu_HBB_iFB_raw " " RAT_FUNC "%.3" "volts" COEFFS 0 13104 0 0 0 1 /end COMPU_METHOD
/begin MEASUREMENT CAM2_ana_raw "CAM2_ana_raw" UWORD Compu_CAM2_ana_raw 0 0 0 5.00114468864469 ECU_ADDRESS 0x010087A8 /end MEASUREMENT
/begin COMPU_METHOD Compu_CAM2_ana_raw " " RAT_FUNC "%.3" "volts" COEFFS 0 13104 0 0 0 1 /end COMPU_METHOD
/begin MEASUREMENT SPKI_samp_raw "SPKI_samp_raw" UWORD Compu_SPKI_samp_raw 0 0 0 5.00114468864469 ECU_ADDRESS 0x010089C0 /end MEASUREMENT
/begin COMPU_METHOD Compu_SPKI_samp_raw " " RAT_FUNC "%.3" "volts" COEFFS 0 13104 0 0 0 1 /end COMPU_METHOD
/begin CHARACTERISTIC NTEphi_MAP_LP_tau "NTE phi transition MAP LP" VALUE 0x00147c20 /* @ECU_Address@NTEphi_MAP_LP_tau@0x01008A48@ */ ECIPP_ALIGNMENT_UWORD 327680 Compu_NTEphi_MAP_LP_tau 0.45084 327680 /end CHARACTERISTIC
/begin COMPU_METHOD Compu_NTEphi_MAP_LP_tau " " FORM "%.0" "ms"
 /begin FORMULA "-5 / log(1 - (X1 / 65536))" FORMULA_INV "(1 - exp(-5/X1)) * 65536" /end FORMULA
/end COMPU_METHOD
/begin MEASUREMENT NTEphi_MAP_LP "NTE phi transition MAP" ULONG Compu_NTEphi_MAP_LP 0 0 0 255.999999940395 ECU_ADDRESS 0x01008A70 /end MEASUREMENT
/begin COMPU_METHOD Compu_NTEphi_MAP_LP " " RAT_FUNC "%.2" "psia" COEFFS 0 16777216 0 0 0 1 /end COMPU_METHOD
/begin MEASUREMENT AUX_OUT13_alloc "AUX_OUT13_alloc{AUX_OUT13_alloc&0xff=0:None}{AUX_OUT13_alloc&0xff=1:EOL}{AUX_OUT13_alloc&0xff=2:Tri-Fuel}{AUX_OUT13_alloc&0xff=3:ETHC}{AUX_OUT13_alloc&0xff=4:Configurable1}{AUX_OUT13_alloc&0xff=5:Configurable2}{AUX_OUT13_alloc&0xff=6:Configurable3}{AUX_OU" UBYTE AUX_OUT13_alloc_COMPU_VTAB 0 0 0 255 ECU_ADDRESS 0x01008FE8 BIT_MASK 0xff /end MEASUREMENT
/begin COMPU_METHOD AUX_OUT13_alloc_COMPU_VTAB "Verbal Table" TAB_VERB "%.0" "list" COMPU_TAB_REF AUX_OUT13_alloc_COMPU_VTAB_REF /end COMPU_METHOD
/begin COMPU_VTAB AUX_OUT13_alloc_COMPU_VTAB_REF "Verbal Table" TAB_VERB 40 0 "None" 1 "EOL" 2 "Tri-Fuel" 3 "ETHC" 4 "Configurable1" 5 "Configurable2" 6 "Configurable3" 7 "Shutdown Out" 8 "Max Speed SetPt" 9 "Hard Warn" 10 "Soft Warn" 11 "Intake Cam" 12 "Exhaust Cam" 13 "Fuel Level" 14 "Water Intrusion" 15 "Hydraulic Enable" 16 "Trans Hyd Fwd" 17 "Trans Hyd Rev" 18 "Brake Light" 19 "Trans Enable" 20 "Backup Alarm" 21 "Front Light" 22 "Back Light" 23 "Boost WGA" 24 "Fuel Type Light" 25 "UNKNOWN 25" 26 "UNKNOWN 26" 27 "UNKNOWN 27" 28 "UNKNOWN 28" 29 "UNKNOWN 29" 30 "UNKNOWN 30" 31 "UNKNOWN 31" 32 "UNKNOWN 32" 33 "UNKNOWN 33" 34 "UNKNOWN 34" 35 "UNKNOWN 35" 36 "UNKNOWN 36" 37 "UNKNOWN 37" 38 "UNKNOWN 38" 39 "UNKNOWN 39" DEFAULT_VALUE "UNKNOWN" /end COMPU_VTAB
/begin MEASUREMENT AUX_OUT14_alloc "AUX_OUT14_alloc{AUX_OUT14_alloc&0xff=0:None}{AUX_OUT14_alloc&0xff=1:EOL}{AUX_OUT14_alloc&0xff=2:Tri-Fuel}{AUX_OUT14_alloc&0xff=3:ETHC}{AUX_OUT14_alloc&0xff=4:Configurable1}{AUX_OUT14_alloc&0xff=5:Configurable2}{AUX_OUT14_alloc&0xff=6:Configurable3}{AUX_OU" UBYTE AUX_OUT14_alloc_COMPU_VTAB 0 0 0 255 ECU_ADDRESS 0x01008FF0 BIT_MASK 0xff /end MEASUREMENT
/begin COMPU_METHOD AUX_OUT14_alloc_COMPU_VTAB "Verbal Table" TAB_VERB "%.0" "list" COMPU_TAB_REF AUX_OUT14_alloc_COMPU_VTAB_REF /end COMPU_METHOD
/begin COMPU_VTAB AUX_OUT14_alloc_COMPU_VTAB_REF "Verbal Table" TAB_VERB 40 0 "None" 1 "EOL" 2 "Tri-Fuel" 3 "ETHC" 4 "Configurable1" 5 "Configurable2" 6 "Configurable3" 7 "Shutdown Out" 8 "Max Speed SetPt" 9 "Hard Warn" 10 "Soft Warn" 11 "Intake Cam" 12 "Exhaust Cam" 13 "Fuel Level" 14 "Water Intrusion" 15 "Hydraulic Enable" 16 "Trans Hyd Fwd" 17 "Trans Hyd Rev" 18 "Brake Light" 19 "Trans Enable" 20 "Backup Alarm" 21 "Front Light" 22 "Back Light" 23 "Boost WGA" 24 "Fuel Type Light" 25 "UNKNOWN 25" 26 "UNKNOWN 26" 27 "UNKNOWN 27" 28 "UNKNOWN 28" 29 "UNKNOWN 29" 30 "UNKNOWN 30" 31 "UNKNOWN 31" 32 "UNKNOWN 32" 33 "UNKNOWN 33" 34 "UNKNOWN 34" 35 "UNKNOWN 35" 36 "UNKNOWN 36" 37 "UNKNOWN 37" 38 "UNKNOWN 38" 39 "UNKNOWN 39" DEFAULT_VALUE "UNKNOWN" /end COMPU_VTAB
/begin MEASUREMENT AUX_OUT15_alloc "AUX_OUT15_alloc{AUX_OUT15_alloc&0xff=0:None}{AUX_OUT15_alloc&0xff=1:EOL}{AUX_OUT15_alloc&0xff=2:Tri-Fuel}{AUX_OUT15_alloc&0xff=3:ETHC}{AUX_OUT15_alloc&0xff=4:Configurable1}{AUX_OUT15_alloc&0xff=5:Configurable2}{AUX_OUT15_alloc&0xff=6:Configurable3}{AUX_OU" UBYTE AUX_OUT15_alloc_COMPU_VTAB 0 0 0 255 ECU_ADDRESS 0x01008FF8 BIT_MASK 0xff /end MEASUREMENT
/begin COMPU_METHOD AUX_OUT15_alloc_COMPU_VTAB "Verbal Table" TAB_VERB "%.0" "list" COMPU_TAB_REF AUX_OUT15_alloc_COMPU_VTAB_REF /end COMPU_METHOD
/begin COMPU_VTAB AUX_OUT15_alloc_COMPU_VTAB_REF "Verbal Table" TAB_VERB 40 0 "None" 1 "EOL" 2 "Tri-Fuel" 3 "ETHC" 4 "Configurable1" 5 "Configurable2" 6 "Configurable3" 7 "Shutdown Out" 8 "Max Speed SetPt" 9 "Hard Warn" 10 "Soft Warn" 11 "Intake Cam" 12 "Exhaust Cam" 13 "Fuel Level" 14 "Water Intrusion" 15 "Hydraulic Enable" 16 "Trans Hyd Fwd" 17 "Trans Hyd Rev" 18 "Brake Light" 19 "Trans Enable" 20 "Backup Alarm" 21 "Front Light" 22 "Back Light" 23 "Boost WGA" 24 "Fuel Type Light" 25 "UNKNOWN 25" 26 "UNKNOWN 26" 27 "UNKNOWN 27" 28 "UNKNOWN 28" 29 "UNKNOWN 29" 30 "UNKNOWN 30" 31 "UNKNOWN 31" 32 "UNKNOWN 32" 33 "UNKNOWN 33" 34 "UNKNOWN 34" 35 "UNKNOWN 35" 36 "UNKNOWN 36" 37 "UNKNOWN 37" 38 "UNKNOWN 38" 39 "UNKNOWN 39" DEFAULT_VALUE "UNKNOWN" /end COMPU_VTAB
/begin MEASUREMENT AUX_OUT16_alloc "AUX_OUT16_alloc{AUX_OUT16_alloc&0xff=0:None}{AUX_OUT16_alloc&0xff=1:EOL}{AUX_OUT16_alloc&0xff=2:Tri-Fuel}{AUX_OUT16_alloc&0xff=3:ETHC}{AUX_OUT16_alloc&0xff=4:Configurable1}{AUX_OUT16_alloc&0xff=5:Configurable2}{AUX_OUT16_alloc&0xff=6:Configurable3}{AUX_OU" UBYTE AUX_OUT16_alloc_COMPU_VTAB 0 0 0 255 ECU_ADDRESS 0x01009000 BIT_MASK 0xff /end MEASUREMENT
/begin COMPU_METHOD AUX_OUT16_alloc_COMPU_VTAB "Verbal Table" TAB_VERB "%.0" "list" COMPU_TAB_REF AUX_OUT16_alloc_COMPU_VTAB_REF /end COMPU_METHOD
/begin COMPU_VTAB AUX_OUT16_alloc_COMPU_VTAB_REF "Verbal Table" TAB_VERB 40 0 "None" 1 "EOL" 2 "Tri-Fuel" 3 "ETHC" 4 "Configurable1" 5 "Configurable2" 6 "Configurable3" 7 "Shutdown Out" 8 "Max Speed SetPt" 9 "Hard Warn" 10 "Soft Warn" 11 "Intake Cam" 12 "Exhaust Cam" 13 "Fuel Level" 14 "Water Intrusion" 15 "Hydraulic Enable" 16 "Trans Hyd Fwd" 17 "Trans Hyd Rev" 18 "Brake Light" 19 "Trans Enable" 20 "Backup Alarm" 21 "Front Light" 22 "Back Light" 23 "Boost WGA" 24 "Fuel Type Light" 25 "UNKNOWN 25" 26 "UNKNOWN 26" 27 "UNKNOWN 27" 28 "UNKNOWN 28" 29 "UNKNOWN 29" 30 "UNKNOWN 30" 31 "UNKNOWN 31" 32 "UNKNOWN 32" 33 "UNKNOWN 33" 34 "UNKNOWN 34" 35 "UNKNOWN 35" 36 "UNKNOWN 36" 37 "UNKNOWN 37" 38 "UNKNOWN 38" 39 "UNKNOWN 39" DEFAULT_VALUE "UNKNOWN" /end COMPU_VTAB
/begin MEASUREMENT AUX_OUT17_alloc "AUX_OUT17_alloc{AUX_OUT17_alloc&0xff=0:None}{AUX_OUT17_alloc&0xff=1:EOL}{AUX_OUT17_alloc&0xff=2:Tri-Fuel}{AUX_OUT17_alloc&0xff=3:ETHC}{AUX_OUT17_alloc&0xff=4:Configurable1}{AUX_OUT17_alloc&0xff=5:Configurable2}{AUX_OUT17_alloc&0xff=6:Configurable3}{AUX_OU" UBYTE AUX_OUT17_alloc_COMPU_VTAB 0 0 0 255 ECU_ADDRESS 0x01009008 BIT_MASK 0xff /end MEASUREMENT
/begin COMPU_METHOD AUX_OUT17_alloc_COMPU_VTAB "Verbal Table" TAB_VERB "%.0" "list" COMPU_TAB_REF AUX_OUT17_alloc_COMPU_VTAB_REF /end COMPU_METHOD
/begin COMPU_VTAB AUX_OUT17_alloc_COMPU_VTAB_REF "Verbal Table" TAB_VERB 40 0 "None" 1 "EOL" 2 "Tri-Fuel" 3 "ETHC" 4 "Configurable1" 5 "Configurable2" 6 "Configurable3" 7 "Shutdown Out" 8 "Max Speed SetPt" 9 "Hard Warn" 10 "Soft Warn" 11 "Intake Cam" 12 "Exhaust Cam" 13 "Fuel Level" 14 "Water Intrusion" 15 "Hydraulic Enable" 16 "Trans Hyd Fwd" 17 "Trans Hyd Rev" 18 "Brake Light" 19 "Trans Enable" 20 "Backup Alarm" 21 "Front Light" 22 "Back Light" 23 "Boost WGA" 24 "Fuel Type Light" 25 "UNKNOWN 25" 26 "UNKNOWN 26" 27 "UNKNOWN 27" 28 "UNKNOWN 28" 29 "UNKNOWN 29" 30 "UNKNOWN 30" 31 "UNKNOWN 31" 32 "UNKNOWN 32" 33 "UNKNOWN 33" 34 "UNKNOWN 34" 35 "UNKNOWN 35" 36 "UNKNOWN 36" 37 "UNKNOWN 37" 38 "UNKNOWN 38" 39 "UNKNOWN 39" DEFAULT_VALUE "UNKNOWN" /end COMPU_VTAB
/begin MEASUREMENT AUX_OUT18_alloc "AUX_OUT18_alloc{AUX_OUT18_alloc&0xff=0:None}{AUX_OUT18_alloc&0xff=1:EOL}{AUX_OUT18_alloc&0xff=2:Tri-Fuel}{AUX_OUT18_alloc&0xff=3:ETHC}{AUX_OUT18_alloc&0xff=4:Configurable1}{AUX_OUT18_alloc&0xff=5:Configurable2}{AUX_OUT18_alloc&0xff=6:Configurable3}{AUX_OU" UBYTE AUX_OUT18_alloc_COMPU_VTAB 0 0 0 255 ECU_ADDRESS 0x01009010 BIT_MASK 0xff /end MEASUREMENT
/begin COMPU_METHOD AUX_OUT18_alloc_COMPU_VTAB "Verbal Table" TAB_VERB "%.0" "list" COMPU_TAB_REF AUX_OUT18_alloc_COMPU_VTAB_REF /end COMPU_METHOD
/begin COMPU_VTAB AUX_OUT18_alloc_COMPU_VTAB_REF "Verbal Table" TAB_VERB 40 0 "None" 1 "EOL" 2 "Tri-Fuel" 3 "ETHC" 4 "Configurable1" 5 "Configurable2" 6 "Configurable3" 7 "Shutdown Out" 8 "Max Speed SetPt" 9 "Hard Warn" 10 "Soft Warn" 11 "Intake Cam" 12 "Exhaust Cam" 13 "Fuel Level" 14 "Water Intrusion" 15 "Hydraulic Enable" 16 "Trans Hyd Fwd" 17 "Trans Hyd Rev" 18 "Brake Light" 19 "Trans Enable" 20 "Backup Alarm" 21 "Front Light" 22 "Back Light" 23 "Boost WGA" 24 "Fuel Type Light" 25 "UNKNOWN 25" 26 "UNKNOWN 26" 27 "UNKNOWN 27" 28 "UNKNOWN 28" 29 "UNKNOWN 29" 30 "UNKNOWN 30" 31 "UNKNOWN 31" 32 "UNKNOWN 32" 33 "UNKNOWN 33" 34 "UNKNOWN 34" 35 "UNKNOWN 35" 36 "UNKNOWN 36" 37 "UNKNOWN 37" 38 "UNKNOWN 38" 39 "UNKNOWN 39" DEFAULT_VALUE "UNKNOWN" /end COMPU_VTAB
/begin MEASUREMENT AUX_OUT19_alloc "AUX_OUT19_alloc{AUX_OUT19_alloc&0xff=0:None}{AUX_OUT19_alloc&0xff=1:EOL}{AUX_OUT19_alloc&0xff=2:Tri-Fuel}{AUX_OUT19_alloc&0xff=3:ETHC}{AUX_OUT19_alloc&0xff=4:Configurable1}{AUX_OUT19_alloc&0xff=5:Configurable2}{AUX_OUT19_alloc&0xff=6:Configurable3}{AUX_OU" UBYTE AUX_OUT19_alloc_COMPU_VTAB 0 0 0 255 ECU_ADDRESS 0x01009018 BIT_MASK 0xff /end MEASUREMENT
/begin COMPU_METHOD AUX_OUT19_alloc_COMPU_VTAB "Verbal Table" TAB_VERB "%.0" "list" COMPU_TAB_REF AUX_OUT19_alloc_COMPU_VTAB_REF /end COMPU_METHOD
/begin COMPU_VTAB AUX_OUT19_alloc_COMPU_VTAB_REF "Verbal Table" TAB_VERB 40 0 "None" 1 "EOL" 2 "Tri-Fuel" 3 "ETHC" 4 "Configurable1" 5 "Configurable2" 6 "Configurable3" 7 "Shutdown Out" 8 "Max Speed SetPt" 9 "Hard Warn" 10 "Soft Warn" 11 "Intake Cam" 12 "Exhaust Cam" 13 "Fuel Level" 14 "Water Intrusion" 15 "Hydraulic Enable" 16 "Trans Hyd Fwd" 17 "Trans Hyd Rev" 18 "Brake Light" 19 "Trans Enable" 20 "Backup Alarm" 21 "Front Light" 22 "Back Light" 23 "Boost WGA" 24 "Fuel Type Light" 25 "UNKNOWN 25" 26 "UNKNOWN 26" 27 "UNKNOWN 27" 28 "UNKNOWN 28" 29 "UNKNOWN 29" 30 "UNKNOWN 30" 31 "UNKNOWN 31" 32 "UNKNOWN 32" 33 "UNKNOWN 33" 34 "UNKNOWN 34" 35 "UNKNOWN 35" 36 "UNKNOWN 36" 37 "UNKNOWN 37" 38 "UNKNOWN 38" 39 "UNKNOWN 39" DEFAULT_VALUE "UNKNOWN" /end COMPU_VTAB
/begin MEASUREMENT AUX_OUT20_alloc "AUX_OUT20_alloc{AUX_OUT20_alloc&0xff=0:None}{AUX_OUT20_alloc&0xff=1:EOL}{AUX_OUT20_alloc&0xff=2:Tri-Fuel}{AUX_OUT20_alloc&0xff=3:ETHC}{AUX_OUT20_alloc&0xff=4:Configurable1}{AUX_OUT20_alloc&0xff=5:Configurable2}{AUX_OUT20_alloc&0xff=6:Configurable3}{AUX_OU" UBYTE AUX_OUT20_alloc_COMPU_VTAB 0 0 0 255 ECU_ADDRESS 0x01009020 BIT_MASK 0xff /end MEASUREMENT
/begin COMPU_METHOD AUX_OUT20_alloc_COMPU_VTAB "Verbal Table" TAB_VERB "%.0" "list" COMPU_TAB_REF AUX_OUT20_alloc_COMPU_VTAB_REF /end COMPU_METHOD
/begin COMPU_VTAB AUX_OUT20_alloc_COMPU_VTAB_REF "Verbal Table" TAB_VERB 40 0 "None" 1 "EOL" 2 "Tri-Fuel" 3 "ETHC" 4 "Configurable1" 5 "Configurable2" 6 "Configurable3" 7 "Shutdown Out" 8 "Max Speed SetPt" 9 "Hard Warn" 10 "Soft Warn" 11 "Intake Cam" 12 "Exhaust Cam" 13 "Fuel Level" 14 "Water Intrusion" 15 "Hydraulic Enable" 16 "Trans Hyd Fwd" 17 "Trans Hyd Rev" 18 "Brake Light" 19 "Trans Enable" 20 "Backup Alarm" 21 "Front Light" 22 "Back Light" 23 "Boost WGA" 24 "Fuel Type Light" 25 "UNKNOWN 25" 26 "UNKNOWN 26" 27 "UNKNOWN 27" 28 "UNKNOWN 28" 29 "UNKNOWN 29" 30 "UNKNOWN 30" 31 "UNKNOWN 31" 32 "UNKNOWN 32" 33 "UNKNOWN 33" 34 "UNKNOWN 34" 35 "UNKNOWN 35" 36 "UNKNOWN 36" 37 "UNKNOWN 37" 38 "UNKNOWN 38" 39 "UNKNOWN 39" DEFAULT_VALUE "UNKNOWN" /end COMPU_VTAB
/begin MEASUREMENT AUX_OUT21_alloc "AUX_OUT21_alloc{AUX_OUT21_alloc&0xff=0:None}{AUX_OUT21_alloc&0xff=1:EOL}{AUX_OUT21_alloc&0xff=2:Tri-Fuel}{AUX_OUT21_alloc&0xff=3:ETHC}{AUX_OUT21_alloc&0xff=4:Configurable1}{AUX_OUT21_alloc&0xff=5:Configurable2}{AUX_OUT21_alloc&0xff=6:Configurable3}{AUX_OU" UBYTE AUX_OUT21_alloc_COMPU_VTAB 0 0 0 255 ECU_ADDRESS 0x01009028 BIT_MASK 0xff /end MEASUREMENT
/begin COMPU_METHOD AUX_OUT21_alloc_COMPU_VTAB "Verbal Table" TAB_VERB "%.0" "list" COMPU_TAB_REF AUX_OUT21_alloc_COMPU_VTAB_REF /end COMPU_METHOD
/begin COMPU_VTAB AUX_OUT21_alloc_COMPU_VTAB_REF "Verbal Table" TAB_VERB 40 0 "None" 1 "EOL" 2 "Tri-Fuel" 3 "ETHC" 4 "Configurable1" 5 "Configurable2" 6 "Configurable3" 7 "Shutdown Out" 8 "Max Speed SetPt" 9 "Hard Warn" 10 "Soft Warn" 11 "Intake Cam" 12 "Exhaust Cam" 13 "Fuel Level" 14 "Water Intrusion" 15 "Hydraulic Enable" 16 "Trans Hyd Fwd" 17 "Trans Hyd Rev" 18 "Brake Light" 19 "Trans Enable" 20 "Backup Alarm" 21 "Front Light" 22 "Back Light" 23 "Boost WGA" 24 "Fuel Type Light" 25 "UNKNOWN 25" 26 "UNKNOWN 26" 27 "UNKNOWN 27" 28 "UNKNOWN 28" 29 "UNKNOWN 29" 30 "UNKNOWN 30" 31 "UNKNOWN 31" 32 "UNKNOWN 32" 33 "UNKNOWN 33" 34 "UNKNOWN 34" 35 "UNKNOWN 35" 36 "UNKNOWN 36" 37 "UNKNOWN 37" 38 "UNKNOWN 38" 39 "UNKNOWN 39" DEFAULT_VALUE "UNKNOWN" /end COMPU_VTAB
/begin MEASUREMENT AUX_OUT22_alloc "AUX_OUT22_alloc{AUX_OUT22_alloc&0xff=0:None}{AUX_OUT22_alloc&0xff=1:EOL}{AUX_OUT22_alloc&0xff=2:Tri-Fuel}{AUX_OUT22_alloc&0xff=3:ETHC}{AUX_OUT22_alloc&0xff=4:Configurable1}{AUX_OUT22_alloc&0xff=5:Configurable2}{AUX_OUT22_alloc&0xff=6:Configurable3}{AUX_OU" UBYTE AUX_OUT22_alloc_COMPU_VTAB 0 0 0 255 ECU_ADDRESS 0x01009030 BIT_MASK 0xff /end MEASUREMENT
/begin COMPU_METHOD AUX_OUT22_alloc_COMPU_VTAB "Verbal Table" TAB_VERB "%.0" "list" COMPU_TAB_REF AUX_OUT22_alloc_COMPU_VTAB_REF /end COMPU_METHOD
/begin COMPU_VTAB AUX_OUT22_alloc_COMPU_VTAB_REF "Verbal Table" TAB_VERB 40 0 "None" 1 "EOL" 2 "Tri-Fuel" 3 "ETHC" 4 "Configurable1" 5 "Configurable2" 6 "Configurable3" 7 "Shutdown Out" 8 "Max Speed SetPt" 9 "Hard Warn" 10 "Soft Warn" 11 "Intake Cam" 12 "Exhaust Cam" 13 "Fuel Level" 14 "Water Intrusion" 15 "Hydraulic Enable" 16 "Trans Hyd Fwd" 17 "Trans Hyd Rev" 18 "Brake Light" 19 "Trans Enable" 20 "Backup Alarm" 21 "Front Light" 22 "Back Light" 23 "Boost WGA" 24 "Fuel Type Light" 25 "UNKNOWN 25" 26 "UNKNOWN 26" 27 "UNKNOWN 27" 28 "UNKNOWN 28" 29 "UNKNOWN 29" 30 "UNKNOWN 30" 31 "UNKNOWN 31" 32 "UNKNOWN 32" 33 "UNKNOWN 33" 34 "UNKNOWN 34" 35 "UNKNOWN 35" 36 "UNKNOWN 36" 37 "UNKNOWN 37" 38 "UNKNOWN 38" 39 "UNKNOWN 39" DEFAULT_VALUE "UNKNOWN" /end COMPU_VTAB
/begin MEASUREMENT AUX_OUT23_alloc "AUX_OUT23_alloc{AUX_OUT23_alloc&0xff=0:None}{AUX_OUT23_alloc&0xff=1:EOL}{AUX_OUT23_alloc&0xff=2:Tri-Fuel}{AUX_OUT23_alloc&0xff=3:ETHC}{AUX_OUT23_alloc&0xff=4:Configurable1}{AUX_OUT23_alloc&0xff=5:Configurable2}{AUX_OUT23_alloc&0xff=6:Configurable3}{AUX_OU" UBYTE AUX_OUT23_alloc_COMPU_VTAB 0 0 0 255 ECU_ADDRESS 0x01009038 BIT_MASK 0xff /end MEASUREMENT
/begin COMPU_METHOD AUX_OUT23_alloc_COMPU_VTAB "Verbal Table" TAB_VERB "%.0" "list" COMPU_TAB_REF AUX_OUT23_alloc_COMPU_VTAB_REF /end COMPU_METHOD
/begin COMPU_VTAB AUX_OUT23_alloc_COMPU_VTAB_REF "Verbal Table" TAB_VERB 40 0 "None" 1 "EOL" 2 "Tri-Fuel" 3 "ETHC" 4 "Configurable1" 5 "Configurable2" 6 "Configurable3" 7 "Shutdown Out" 8 "Max Speed SetPt" 9 "Hard Warn" 10 "Soft Warn" 11 "Intake Cam" 12 "Exhaust Cam" 13 "Fuel Level" 14 "Water Intrusion" 15 "Hydraulic Enable" 16 "Trans Hyd Fwd" 17 "Trans Hyd Rev" 18 "Brake Light" 19 "Trans Enable" 20 "Backup Alarm" 21 "Front Light" 22 "Back Light" 23 "Boost WGA" 24 "Fuel Type Light" 25 "UNKNOWN 25" 26 "UNKNOWN 26" 27 "UNKNOWN 27" 28 "UNKNOWN 28" 29 "UNKNOWN 29" 30 "UNKNOWN 30" 31 "UNKNOWN 31" 32 "UNKNOWN 32" 33 "UNKNOWN 33" 34 "UNKNOWN 34" 35 "UNKNOWN 35" 36 "UNKNOWN 36" 37 "UNKNOWN 37" 38 "UNKNOWN 38" 39 "UNKNOWN 39" DEFAULT_VALUE "UNKNOWN" /end COMPU_VTAB
/begin MEASUREMENT AUX_OUT2_conflict "AUX_OUT2_conflict{AUX_OUT2_conflict&0xff=0:None}{AUX_OUT2_conflict&0xff=1:EOL}{AUX_OUT2_conflict&0xff=2:Tri-Fuel}{AUX_OUT2_conflict&0xff=3:ETHC}{AUX_OUT2_conflict&0xff=4:Configurable1}{AUX_OUT2_conflict&0xff=5:Configurable2}{AUX_OUT2_conflict&0xff=6:Confi" UBYTE AUX_OUT2_conflict_COMPU_VTAB 0 0 0 255 ECU_ADDRESS 0x01009040 BIT_MASK 0xff /end MEASUREMENT
/begin COMPU_METHOD AUX_OUT2_conflict_COMPU_VTAB "Verbal Table" TAB_VERB "%.0" "list" COMPU_TAB_REF AUX_OUT2_conflict_COMPU_VTAB_REF /end COMPU_METHOD
/begin COMPU_VTAB AUX_OUT2_conflict_COMPU_VTAB_REF "Verbal Table" TAB_VERB 40 0 "None" 1 "EOL" 2 "Tri-Fuel" 3 "ETHC" 4 "Configurable1" 5 "Configurable2" 6 "Configurable3" 7 "Shutdown Out" 8 "Max Speed SetPt" 9 "Hard Warn" 10 "Soft Warn" 11 "Intake Cam" 12 "Exhaust Cam" 13 "Fuel Level" 14 "Water Intrusion" 15 "Hydraulic Enable" 16 "Trans Hyd Fwd" 17 "Trans Hyd Rev" 18 "Brake Light" 19 "Trans Enable" 20 "Backup Alarm" 21 "Front Light" 22 "Back Light" 23 "Boost WGA" 24 "Fuel Type Light" 25 "UNKNOWN 25" 26 "UNKNOWN 26" 27 "UNKNOWN 27" 28 "UNKNOWN 28" 29 "UNKNOWN 29" 30 "UNKNOWN 30" 31 "UNKNOWN 31" 32 "UNKNOWN 32" 33 "UNKNOWN 33" 34 "UNKNOWN 34" 35 "UNKNOWN 35" 36 "UNKNOWN 36" 37 "UNKNOWN 37" 38 "UNKNOWN 38" 39 "UNKNOWN 39" DEFAULT_VALUE "UNKNOWN" /end COMPU_VTAB
/begin MEASUREMENT AUX_OUT3_conflict "AUX_OUT3_conflict{AUX_OUT3_conflict&0xff=0:None}{AUX_OUT3_conflict&0xff=1:EOL}{AUX_OUT3_conflict&0xff=2:Tri-Fuel}{AUX_OUT3_conflict&0xff=3:ETHC}{AUX_OUT3_conflict&0xff=4:Configurable1}{AUX_OUT3_conflict&0xff=5:Configurable2}{AUX_OUT3_conflict&0xff=6:Confi" UBYTE AUX_OUT3_conflict_COMPU_VTAB 0 0 0 255 ECU_ADDRESS 0x01009048 BIT_MASK 0xff /end MEASUREMENT
/begin COMPU_METHOD AUX_OUT3_conflict_COMPU_VTAB "Verbal Table" TAB_VERB "%.0" "list" COMPU_TAB_REF AUX_OUT3_conflict_COMPU_VTAB_REF /end COMPU_METHOD
/begin COMPU_VTAB AUX_OUT3_conflict_COMPU_VTAB_REF "Verbal Table" TAB_VERB 40 0 "None" 1 "EOL" 2 "Tri-Fuel" 3 "ETHC" 4 "Configurable1" 5 "Configurable2" 6 "Configurable3" 7 "Shutdown Out" 8 "Max Speed SetPt" 9 "Hard Warn" 10 "Soft Warn" 11 "Intake Cam" 12 "Exhaust Cam" 13 "Fuel Level" 14 "Water Intrusion" 15 "Hydraulic Enable" 16 "Trans Hyd Fwd" 17 "Trans Hyd Rev" 18 "Brake Light" 19 "Trans Enable" 20 "Backup Alarm" 21 "Front Light" 22 "Back Light" 23 "Boost WGA" 24 "Fuel Type Light" 25 "UNKNOWN 25" 26 "UNKNOWN 26" 27 "UNKNOWN 27" 28 "UNKNOWN 28" 29 "UNKNOWN 29" 30 "UNKNOWN 30" 31 "UNKNOWN 31" 32 "UNKNOWN 32" 33 "UNKNOWN 33" 34 "UNKNOWN 34" 35 "UNKNOWN 35" 36 "UNKNOWN 36" 37 "UNKNOWN 37" 38 "UNKNOWN 38" 39 "UNKNOWN 39" DEFAULT_VALUE "UNKNOWN" /end COMPU_VTAB
/begin MEASUREMENT AUX_OUT4_conflict "AUX_OUT4_conflict{AUX_OUT4_conflict&0xff=0:None}{AUX_OUT4_conflict&0xff=1:EOL}{AUX_OUT4_conflict&0xff=2:Tri-Fuel}{AUX_OUT4_conflict&0xff=3:ETHC}{AUX_OUT4_conflict&0xff=4:Configurable1}{AUX_OUT4_conflict&0xff=5:Configurable2}{AUX_OUT4_conflict&0xff=6:Confi" UBYTE AUX_OUT4_conflict_COMPU_VTAB 0 0 0 255 ECU_ADDRESS 0x01009050 BIT_MASK 0xff /end MEASUREMENT
/begin COMPU_METHOD AUX_OUT4_conflict_COMPU_VTAB "Verbal Table" TAB_VERB "%.0" "list" COMPU_TAB_REF AUX_OUT4_conflict_COMPU_VTAB_REF /end COMPU_METHOD
/begin COMPU_VTAB AUX_OUT4_conflict_COMPU_VTAB_REF "Verbal Table" TAB_VERB 40 0 "None" 1 "EOL" 2 "Tri-Fuel" 3 "ETHC" 4 "Configurable1" 5 "Configurable2" 6 "Configurable3" 7 "Shutdown Out" 8 "Max Speed SetPt" 9 "Hard Warn" 10 "Soft Warn" 11 "Intake Cam" 12 "Exhaust Cam" 13 "Fuel Level" 14 "Water Intrusion" 15 "Hydraulic Enable" 16 "Trans Hyd Fwd" 17 "Trans Hyd Rev" 18 "Brake Light" 19 "Trans Enable" 20 "Backup Alarm" 21 "Front Light" 22 "Back Light" 23 "Boost WGA" 24 "Fuel Type Light" 25 "UNKNOWN 25" 26 "UNKNOWN 26" 27 "UNKNOWN 27" 28 "UNKNOWN 28" 29 "UNKNOWN 29" 30 "UNKNOWN 30" 31 "UNKNOWN 31" 32 "UNKNOWN 32" 33 "UNKNOWN 33" 34 "UNKNOWN 34" 35 "UNKNOWN 35" 36 "UNKNOWN 36" 37 "UNKNOWN 37" 38 "UNKNOWN 38" 39 "UNKNOWN 39" DEFAULT_VALUE "UNKNOWN" /end COMPU_VTAB
/begin MEASUREMENT AUX_OUT5_conflict "AUX_OUT5_conflict{AUX_OUT5_conflict&0xff=0:None}{AUX_OUT5_conflict&0xff=1:EOL}{AUX_OUT5_conflict&0xff=2:Tri-Fuel}{AUX_OUT5_conflict&0xff=3:ETHC}{AUX_OUT5_conflict&0xff=4:Configurable1}{AUX_OUT5_conflict&0xff=5:Configurable2}{AUX_OUT5_conflict&0xff=6:Confi" UBYTE AUX_OUT5_conflict_COMPU_VTAB 0 0 0 255 ECU_ADDRESS 0x01009058 BIT_MASK 0xff /end MEASUREMENT
/begin COMPU_METHOD AUX_OUT5_conflict_COMPU_VTAB "Verbal Table" TAB_VERB "%.0" "list" COMPU_TAB_REF AUX_OUT5_conflict_COMPU_VTAB_REF /end COMPU_METHOD
/begin COMPU_VTAB AUX_OUT5_conflict_COMPU_VTAB_REF "Verbal Table" TAB_VERB 40 0 "None" 1 "EOL" 2 "Tri-Fuel" 3 "ETHC" 4 "Configurable1" 5 "Configurable2" 6 "Configurable3" 7 "Shutdown Out" 8 "Max Speed SetPt" 9 "Hard Warn" 10 "Soft Warn" 11 "Intake Cam" 12 "Exhaust Cam" 13 "Fuel Level" 14 "Water Intrusion" 15 "Hydraulic Enable" 16 "Trans Hyd Fwd" 17 "Trans Hyd Rev" 18 "Brake Light" 19 "Trans Enable" 20 "Backup Alarm" 21 "Front Light" 22 "Back Light" 23 "Boost WGA" 24 "Fuel Type Light" 25 "UNKNOWN 25" 26 "UNKNOWN 26" 27 "UNKNOWN 27" 28 "UNKNOWN 28" 29 "UNKNOWN 29" 30 "UNKNOWN 30" 31 "UNKNOWN 31" 32 "UNKNOWN 32" 33 "UNKNOWN 33" 34 "UNKNOWN 34" 35 "UNKNOWN 35" 36 "UNKNOWN 36" 37 "UNKNOWN 37" 38 "UNKNOWN 38" 39 "UNKNOWN 39" DEFAULT_VALUE "UNKNOWN" /end COMPU_VTAB
/begin MEASUREMENT AUX_OUT6_conflict "AUX_OUT6_conflict{AUX_OUT6_conflict&0xff=0:None}{AUX_OUT6_conflict&0xff=1:EOL}{AUX_OUT6_conflict&0xff=2:Tri-Fuel}{AUX_OUT6_conflict&0xff=3:ETHC}{AUX_OUT6_conflict&0xff=4:Configurable1}{AUX_OUT6_conflict&0xff=5:Configurable2}{AUX_OUT6_conflict&0xff=6:Confi" UBYTE AUX_OUT6_conflict_COMPU_VTAB 0 0 0 255 ECU_ADDRESS 0x01009060 BIT_MASK 0xff /end MEASUREMENT
/begin COMPU_METHOD AUX_OUT6_conflict_COMPU_VTAB "Verbal Table" TAB_VERB "%.0" "list" COMPU_TAB_REF AUX_OUT6_conflict_COMPU_VTAB_REF /end COMPU_METHOD
/begin COMPU_VTAB AUX_OUT6_conflict_COMPU_VTAB_REF "Verbal Table" TAB_VERB 40 0 "None" 1 "EOL" 2 "Tri-Fuel" 3 "ETHC" 4 "Configurable1" 5 "Configurable2" 6 "Configurable3" 7 "Shutdown Out" 8 "Max Speed SetPt" 9 "Hard Warn" 10 "Soft Warn" 11 "Intake Cam" 12 "Exhaust Cam" 13 "Fuel Level" 14 "Water Intrusion" 15 "Hydraulic Enable" 16 "Trans Hyd Fwd" 17 "Trans Hyd Rev" 18 "Brake Light" 19 "Trans Enable" 20 "Backup Alarm" 21 "Front Light" 22 "Back Light" 23 "Boost WGA" 24 "Fuel Type Light" 25 "UNKNOWN 25" 26 "UNKNOWN 26" 27 "UNKNOWN 27" 28 "UNKNOWN 28" 29 "UNKNOWN 29" 30 "UNKNOWN 30" 31 "UNKNOWN 31" 32 "UNKNOWN 32" 33 "UNKNOWN 33" 34 "UNKNOWN 34" 35 "UNKNOWN 35" 36 "UNKNOWN 36" 37 "UNKNOWN 37" 38 "UNKNOWN 38" 39 "UNKNOWN 39" DEFAULT_VALUE "UNKNOWN" /end COMPU_VTAB
/begin MEASUREMENT AUX_OUT7_conflict "AUX_OUT7_conflict{AUX_OUT7_conflict&0xff=0:None}{AUX_OUT7_conflict&0xff=1:EOL}{AUX_OUT7_conflict&0xff=2:Tri-Fuel}{AUX_OUT7_conflict&0xff=3:ETHC}{AUX_OUT7_conflict&0xff=4:Configurable1}{AUX_OUT7_conflict&0xff=5:Configurable2}{AUX_OUT7_conflict&0xff=6:Confi" UBYTE AUX_OUT7_conflict_COMPU_VTAB 0 0 0 255 ECU_ADDRESS 0x01009068 BIT_MASK 0xff /end MEASUREMENT
/begin COMPU_METHOD AUX_OUT7_conflict_COMPU_VTAB "Verbal Table" TAB_VERB "%.0" "list" COMPU_TAB_REF AUX_OUT7_conflict_COMPU_VTAB_REF /end COMPU_METHOD
/begin COMPU_VTAB AUX_OUT7_conflict_COMPU_VTAB_REF "Verbal Table" TAB_VERB 40 0 "None" 1 "EOL" 2 "Tri-Fuel" 3 "ETHC" 4 "Configurable1" 5 "Configurable2" 6 "Configurable3" 7 "Shutdown Out" 8 "Max Speed SetPt" 9 "Hard Warn" 10 "Soft Warn" 11 "Intake Cam" 12 "Exhaust Cam" 13 "Fuel Level" 14 "Water Intrusion" 15 "Hydraulic Enable" 16 "Trans Hyd Fwd" 17 "Trans Hyd Rev" 18 "Brake Light" 19 "Trans Enable" 20 "Backup Alarm" 21 "Front Light" 22 "Back Light" 23 "Boost WGA" 24 "Fuel Type Light" 25 "UNKNOWN 25" 26 "UNKNOWN 26" 27 "UNKNOWN 27" 28 "UNKNOWN 28" 29 "UNKNOWN 29" 30 "UNKNOWN 30" 31 "UNKNOWN 31" 32 "UNKNOWN 32" 33 "UNKNOWN 33" 34 "UNKNOWN 34" 35 "UNKNOWN 35" 36 "UNKNOWN 36" 37 "UNKNOWN 37" 38 "UNKNOWN 38" 39 "UNKNOWN 39" DEFAULT_VALUE "UNKNOWN" /end COMPU_VTAB
/begin MEASUREMENT AUX_OUT8_conflict "AUX_OUT8_conflict{AUX_OUT8_conflict&0xff=0:None}{AUX_OUT8_conflict&0xff=1:EOL}{AUX_OUT8_conflict&0xff=2:Tri-Fuel}{AUX_OUT8_conflict&0xff=3:ETHC}{AUX_OUT8_conflict&0xff=4:Configurable1}{AUX_OUT8_conflict&0xff=5:Configurable2}{AUX_OUT8_conflict&0xff=6:Confi" UBYTE AUX_OUT8_conflict_COMPU_VTAB 0 0 0 255 ECU_ADDRESS 0x01009070 BIT_MASK 0xff /end MEASUREMENT
/begin COMPU_METHOD AUX_OUT8_conflict_COMPU_VTAB "Verbal Table" TAB_VERB "%.0" "list" COMPU_TAB_REF AUX_OUT8_conflict_COMPU_VTAB_REF /end COMPU_METHOD
/begin COMPU_VTAB AUX_OUT8_conflict_COMPU_VTAB_REF "Verbal Table" TAB_VERB 40 0 "None" 1 "EOL" 2 "Tri-Fuel" 3 "ETHC" 4 "Configurable1" 5 "Configurable2" 6 "Configurable3" 7 "Shutdown Out" 8 "Max Speed SetPt" 9 "Hard Warn" 10 "Soft Warn" 11 "Intake Cam" 12 "Exhaust Cam" 13 "Fuel Level" 14 "Water Intrusion" 15 "Hydraulic Enable" 16 "Trans Hyd Fwd" 17 "Trans Hyd Rev" 18 "Brake Light" 19 "Trans Enable" 20 "Backup Alarm" 21 "Front Light" 22 "Back Light" 23 "Boost WGA" 24 "Fuel Type Light" 25 "UNKNOWN 25" 26 "UNKNOWN 26" 27 "UNKNOWN 27" 28 "UNKNOWN 28" 29 "UNKNOWN 29" 30 "UNKNOWN 30" 31 "UNKNOWN 31" 32 "UNKNOWN 32" 33 "UNKNOWN 33" 34 "UNKNOWN 34" 35 "UNKNOWN 35" 36 "UNKNOWN 36" 37 "UNKNOWN 37" 38 "UNKNOWN 38" 39 "UNKNOWN 39" DEFAULT_VALUE "UNKNOWN" /end COMPU_VTAB
/begin MEASUREMENT AUX_OUT9_conflict "AUX_OUT9_conflict{AUX_OUT9_conflict&0xff=0:None}{AUX_OUT9_conflict&0xff=1:EOL}{AUX_OUT9_conflict&0xff=2:Tri-Fuel}{AUX_OUT9_conflict&0xff=3:ETHC}{AUX_OUT9_conflict&0xff=4:Configurable1}{AUX_OUT9_conflict&0xff=5:Configurable2}{AUX_OUT9_conflict&0xff=6:Confi" UBYTE AUX_OUT9_conflict_COMPU_VTAB 0 0 0 255 ECU_ADDRESS 0x01009078 BIT_MASK 0xff /end MEASUREMENT
/begin COMPU_METHOD AUX_OUT9_conflict_COMPU_VTAB "Verbal Table" TAB_VERB "%.0" "list" COMPU_TAB_REF AUX_OUT9_conflict_COMPU_VTAB_REF /end COMPU_METHOD
/begin COMPU_VTAB AUX_OUT9_conflict_COMPU_VTAB_REF "Verbal Table" TAB_VERB 40 0 "None" 1 "EOL" 2 "Tri-Fuel" 3 "ETHC" 4 "Configurable1" 5 "Configurable2" 6 "Configurable3" 7 "Shutdown Out" 8 "Max Speed SetPt" 9 "Hard Warn" 10 "Soft Warn" 11 "Intake Cam" 12 "Exhaust Cam" 13 "Fuel Level" 14 "Water Intrusion" 15 "Hydraulic Enable" 16 "Trans Hyd Fwd" 17 "Trans Hyd Rev" 18 "Brake Light" 19 "Trans Enable" 20 "Backup Alarm" 21 "Front Light" 22 "Back Light" 23 "Boost WGA" 24 "Fuel Type Light" 25 "UNKNOWN 25" 26 "UNKNOWN 26" 27 "UNKNOWN 27" 28 "UNKNOWN 28" 29 "UNKNOWN 29" 30 "UNKNOWN 30" 31 "UNKNOWN 31" 32 "UNKNOWN 32" 33 "UNKNOWN 33" 34 "UNKNOWN 34" 35 "UNKNOWN 35" 36 "UNKNOWN 36" 37 "UNKNOWN 37" 38 "UNKNOWN 38" 39 "UNKNOWN 39" DEFAULT_VALUE "UNKNOWN" /end COMPU_VTAB
/begin MEASUREMENT AUX_OUT10_conflict "AUX_OUT10_conflict{AUX_OUT10_conflict&0xff=0:None}{AUX_OUT10_conflict&0xff=1:EOL}{AUX_OUT10_conflict&0xff=2:Tri-Fuel}{AUX_OUT10_conflict&0xff=3:ETHC}{AUX_OUT10_conflict&0xff=4:Configurable1}{AUX_OUT10_conflict&0xff=5:Configurable2}{AUX_OUT10_conflict&0xff" UBYTE AUX_OUT10_conflict_COMPU_VTAB 0 0 0 255 ECU_ADDRESS 0x01009080 BIT_MASK 0xff /end MEASUREMENT
/begin COMPU_METHOD AUX_OUT10_conflict_COMPU_VTAB "Verbal Table" TAB_VERB "%.0" "list" COMPU_TAB_REF AUX_OUT10_conflict_COMPU_VTAB_REF /end COMPU_METHOD
/begin COMPU_VTAB AUX_OUT10_conflict_COMPU_VTAB_REF "Verbal Table" TAB_VERB 40 0 "None" 1 "EOL" 2 "Tri-Fuel" 3 "ETHC" 4 "Configurable1" 5 "Configurable2" 6 "Configurable3" 7 "Shutdown Out" 8 "Max Speed SetPt" 9 "Hard Warn" 10 "Soft Warn" 11 "Intake Cam" 12 "Exhaust Cam" 13 "Fuel Level" 14 "Water Intrusion" 15 "Hydraulic Enable" 16 "Trans Hyd Fwd" 17 "Trans Hyd Rev" 18 "Brake Light" 19 "Trans Enable" 20 "Backup Alarm" 21 "Front Light" 22 "Back Light" 23 "Boost WGA" 24 "Fuel Type Light" 25 "UNKNOWN 25" 26 "UNKNOWN 26" 27 "UNKNOWN 27" 28 "UNKNOWN 28" 29 "UNKNOWN 29" 30 "UNKNOWN 30" 31 "UNKNOWN 31" 32 "UNKNOWN 32" 33 "UNKNOWN 33" 34 "UNKNOWN 34" 35 "UNKNOWN 35" 36 "UNKNOWN 36" 37 "UNKNOWN 37" 38 "UNKNOWN 38" 39 "UNKNOWN 39" DEFAULT_VALUE "UNKNOWN" /end COMPU_VTAB
/begin MEASUREMENT AUX_OUT11_conflict "AUX_OUT11_conflict{AUX_OUT11_conflict&0xff=0:None}{AUX_OUT11_conflict&0xff=1:EOL}{AUX_OUT11_conflict&0xff=2:Tri-Fuel}{AUX_OUT11_conflict&0xff=3:ETHC}{AUX_OUT11_conflict&0xff=4:Configurable1}{AUX_OUT11_conflict&0xff=5:Configurable2}{AUX_OUT11_conflict&0xff" UBYTE AUX_OUT11_conflict_COMPU_VTAB 0 0 0 255 ECU_ADDRESS 0x01009088 BIT_MASK 0xff /end MEASUREMENT
/begin COMPU_METHOD AUX_OUT11_conflict_COMPU_VTAB "Verbal Table" TAB_VERB "%.0" "list" COMPU_TAB_REF AUX_OUT11_conflict_COMPU_VTAB_REF /end COMPU_METHOD
/begin COMPU_VTAB AUX_OUT11_conflict_COMPU_VTAB_REF "Verbal Table" TAB_VERB 40 0 "None" 1 "EOL" 2 "Tri-Fuel" 3 "ETHC" 4 "Configurable1" 5 "Configurable2" 6 "Configurable3" 7 "Shutdown Out" 8 "Max Speed SetPt" 9 "Hard Warn" 10 "Soft Warn" 11 "Intake Cam" 12 "Exhaust Cam" 13 "Fuel Level" 14 "Water Intrusion" 15 "Hydraulic Enable" 16 "Trans Hyd Fwd" 17 "Trans Hyd Rev" 18 "Brake Light" 19 "Trans Enable" 20 "Backup Alarm" 21 "Front Light" 22 "Back Light" 23 "Boost WGA" 24 "Fuel Type Light" 25 "UNKNOWN 25" 26 "UNKNOWN 26" 27 "UNKNOWN 27" 28 "UNKNOWN 28" 29 "UNKNOWN 29" 30 "UNKNOWN 30" 31 "UNKNOWN 31" 32 "UNKNOWN 32" 33 "UNKNOWN 33" 34 "UNKNOWN 34" 35 "UNKNOWN 35" 36 "UNKNOWN 36" 37 "UNKNOWN 37" 38 "UNKNOWN 38" 39 "UNKNOWN 39" DEFAULT_VALUE "UNKNOWN" /end COMPU_VTAB
/begin MEASUREMENT AUX_OUT12_conflict "AUX_OUT12_conflict{AUX_OUT12_conflict&0xff=0:None}{AUX_OUT12_conflict&0xff=1:EOL}{AUX_OUT12_conflict&0xff=2:Tri-Fuel}{AUX_OUT12_conflict&0xff=3:ETHC}{AUX_OUT12_conflict&0xff=4:Configurable1}{AUX_OUT12_conflict&0xff=5:Configurable2}{AUX_OUT12_conflict&0xff" UBYTE AUX_OUT12_conflict_COMPU_VTAB 0 0 0 255 ECU_ADDRESS 0x01009090 BIT_MASK 0xff /end MEASUREMENT
/begin COMPU_METHOD AUX_OUT12_conflict_COMPU_VTAB "Verbal Table" TAB_VERB "%.0" "list" COMPU_TAB_REF AUX_OUT12_conflict_COMPU_VTAB_REF /end COMPU_METHOD
/begin COMPU_VTAB AUX_OUT12_conflict_COMPU_VTAB_REF "Verbal Table" TAB_VERB 40 0 "None" 1 "EOL" 2 "Tri-Fuel" 3 "ETHC" 4 "Configurable1" 5 "Configurable2" 6 "Configurable3" 7 "Shutdown Out" 8 "Max Speed SetPt" 9 "Hard Warn" 10 "Soft Warn" 11 "Intake Cam" 12 "Exhaust Cam" 13 "Fuel Level" 14 "Water Intrusion" 15 "Hydraulic Enable" 16 "Trans Hyd Fwd" 17 "Trans Hyd Rev" 18 "Brake Light" 19 "Trans Enable" 20 "Backup Alarm" 21 "Front Light" 22 "Back Light" 23 "Boost WGA" 24 "Fuel Type Light" 25 "UNKNOWN 25" 26 "UNKNOWN 26" 27 "UNKNOWN 27" 28 "UNKNOWN 28" 29 "UNKNOWN 29" 30 "UNKNOWN 30" 31 "UNKNOWN 31" 32 "UNKNOWN 32" 33 "UNKNOWN 33" 34 "UNKNOWN 34" 35 "UNKNOWN 35" 36 "UNKNOWN 36" 37 "UNKNOWN 37" 38 "UNKNOWN 38" 39 "UNKNOWN 39" DEFAULT_VALUE "UNKNOWN" /end COMPU_VTAB
/begin MEASUREMENT AUX_OUT13_conflict "AUX_OUT13_conflict{AUX_OUT13_conflict&0xff=0:None}{AUX_OUT13_conflict&0xff=1:EOL}{AUX_OUT13_conflict&0xff=2:Tri-Fuel}{AUX_OUT13_conflict&0xff=3:ETHC}{AUX_OUT13_conflict&0xff=4:Configurable1}{AUX_OUT13_conflict&0xff=5:Configurable2}{AUX_OUT13_conflict&0xff" UBYTE AUX_OUT13_conflict_COMPU_VTAB 0 0 0 255 ECU_ADDRESS 0x01009098 BIT_MASK 0xff /end MEASUREMENT
/begin COMPU_METHOD AUX_OUT13_conflict_COMPU_VTAB "Verbal Table" TAB_VERB "%.0" "list" COMPU_TAB_REF AUX_OUT13_conflict_COMPU_VTAB_REF /end COMPU_METHOD
/begin COMPU_VTAB AUX_OUT13_conflict_COMPU_VTAB_REF "Verbal Table" TAB_VERB 40 0 "None" 1 "EOL" 2 "Tri-Fuel" 3 "ETHC" 4 "Configurable1" 5 "Configurable2" 6 "Configurable3" 7 "Shutdown Out" 8 "Max Speed SetPt" 9 "Hard Warn" 10 "Soft Warn" 11 "Intake Cam" 12 "Exhaust Cam" 13 "Fuel Level" 14 "Water Intrusion" 15 "Hydraulic Enable" 16 "Trans Hyd Fwd" 17 "Trans Hyd Rev" 18 "Brake Light" 19 "Trans Enable" 20 "Backup Alarm" 21 "Front Light" 22 "Back Light" 23 "Boost WGA" 24 "Fuel Type Light" 25 "UNKNOWN 25" 26 "UNKNOWN 26" 27 "UNKNOWN 27" 28 "UNKNOWN 28" 29 "UNKNOWN 29" 30 "UNKNOWN 30" 31 "UNKNOWN 31" 32 "UNKNOWN 32" 33 "UNKNOWN 33" 34 "UNKNOWN 34" 35 "UNKNOWN 35" 36 "UNKNOWN 36" 37 "UNKNOWN 37" 38 "UNKNOWN 38" 39 "UNKNOWN 39" DEFAULT_VALUE "UNKNOWN" /end COMPU_VTAB
/begin MEASUREMENT AUX_OUT14_conflict "AUX_OUT14_conflict{AUX_OUT14_conflict&0xff=0:None}{AUX_OUT14_conflict&0xff=1:EOL}{AUX_OUT14_conflict&0xff=2:Tri-Fuel}{AUX_OUT14_conflict&0xff=3:ETHC}{AUX_OUT14_conflict&0xff=4:Configurable1}{AUX_OUT14_conflict&0xff=5:Configurable2}{AUX_OUT14_conflict&0xff" UBYTE AUX_OUT14_conflict_COMPU_VTAB 0 0 0 255 ECU_ADDRESS 0x010090A0 BIT_MASK 0xff /end MEASUREMENT
/begin COMPU_METHOD AUX_OUT14_conflict_COMPU_VTAB "Verbal Table" TAB_VERB "%.0" "list" COMPU_TAB_REF AUX_OUT14_conflict_COMPU_VTAB_REF /end COMPU_METHOD
/begin COMPU_VTAB AUX_OUT14_conflict_COMPU_VTAB_REF "Verbal Table" TAB_VERB 40 0 "None" 1 "EOL" 2 "Tri-Fuel" 3 "ETHC" 4 "Configurable1" 5 "Configurable2" 6 "Configurable3" 7 "Shutdown Out" 8 "Max Speed SetPt" 9 "Hard Warn" 10 "Soft Warn" 11 "Intake Cam" 12 "Exhaust Cam" 13 "Fuel Level" 14 "Water Intrusion" 15 "Hydraulic Enable" 16 "Trans Hyd Fwd" 17 "Trans Hyd Rev" 18 "Brake Light" 19 "Trans Enable" 20 "Backup Alarm" 21 "Front Light" 22 "Back Light" 23 "Boost WGA" 24 "Fuel Type Light" 25 "UNKNOWN 25" 26 "UNKNOWN 26" 27 "UNKNOWN 27" 28 "UNKNOWN 28" 29 "UNKNOWN 29" 30 "UNKNOWN 30" 31 "UNKNOWN 31" 32 "UNKNOWN 32" 33 "UNKNOWN 33" 34 "UNKNOWN 34" 35 "UNKNOWN 35" 36 "UNKNOWN 36" 37 "UNKNOWN 37" 38 "UNKNOWN 38" 39 "UNKNOWN 39" DEFAULT_VALUE "UNKNOWN" /end COMPU_VTAB
/begin MEASUREMENT AUX_OUT15_conflict "AUX_OUT15_conflict{AUX_OUT15_conflict&0xff=0:None}{AUX_OUT15_conflict&0xff=1:EOL}{AUX_OUT15_conflict&0xff=2:Tri-Fuel}{AUX_OUT15_conflict&0xff=3:ETHC}{AUX_OUT15_conflict&0xff=4:Configurable1}{AUX_OUT15_conflict&0xff=5:Configurable2}{AUX_OUT15_conflict&0xff" UBYTE AUX_OUT15_conflict_COMPU_VTAB 0 0 0 255 ECU_ADDRESS 0x010090A8 BIT_MASK 0xff /end MEASUREMENT
/begin COMPU_METHOD AUX_OUT15_conflict_COMPU_VTAB "Verbal Table" TAB_VERB "%.0" "list" COMPU_TAB_REF AUX_OUT15_conflict_COMPU_VTAB_REF /end COMPU_METHOD
/begin COMPU_VTAB AUX_OUT15_conflict_COMPU_VTAB_REF "Verbal Table" TAB_VERB 40 0 "None" 1 "EOL" 2 "Tri-Fuel" 3 "ETHC" 4 "Configurable1" 5 "Configurable2" 6 "Configurable3" 7 "Shutdown Out" 8 "Max Speed SetPt" 9 "Hard Warn" 10 "Soft Warn" 11 "Intake Cam" 12 "Exhaust Cam" 13 "Fuel Level" 14 "Water Intrusion" 15 "Hydraulic Enable" 16 "Trans Hyd Fwd" 17 "Trans Hyd Rev" 18 "Brake Light" 19 "Trans Enable" 20 "Backup Alarm" 21 "Front Light" 22 "Back Light" 23 "Boost WGA" 24 "Fuel Type Light" 25 "UNKNOWN 25" 26 "UNKNOWN 26" 27 "UNKNOWN 27" 28 "UNKNOWN 28" 29 "UNKNOWN 29" 30 "UNKNOWN 30" 31 "UNKNOWN 31" 32 "UNKNOWN 32" 33 "UNKNOWN 33" 34 "UNKNOWN 34" 35 "UNKNOWN 35" 36 "UNKNOWN 36" 37 "UNKNOWN 37" 38 "UNKNOWN 38" 39 "UNKNOWN 39" DEFAULT_VALUE "UNKNOWN" /end COMPU_VTAB
/begin MEASUREMENT AUX_OUT16_conflict "AUX_OUT16_conflict{AUX_OUT16_conflict&0xff=0:None}{AUX_OUT16_conflict&0xff=1:EOL}{AUX_OUT16_conflict&0xff=2:Tri-Fuel}{AUX_OUT16_conflict&0xff=3:ETHC}{AUX_OUT16_conflict&0xff=4:Configurable1}{AUX_OUT16_conflict&0xff=5:Configurable2}{AUX_OUT16_conflict&0xff" UBYTE AUX_OUT16_conflict_COMPU_VTAB 0 0 0 255 ECU_ADDRESS 0x010090B0 BIT_MASK 0xff /end MEASUREMENT
/begin COMPU_METHOD AUX_OUT16_conflict_COMPU_VTAB "Verbal Table" TAB_VERB "%.0" "list" COMPU_TAB_REF AUX_OUT16_conflict_COMPU_VTAB_REF /end COMPU_METHOD
/begin COMPU_VTAB AUX_OUT16_conflict_COMPU_VTAB_REF "Verbal Table" TAB_VERB 40 0 "None" 1 "EOL" 2 "Tri-Fuel" 3 "ETHC" 4 "Configurable1" 5 "Configurable2" 6 "Configurable3" 7 "Shutdown Out" 8 "Max Speed SetPt" 9 "Hard Warn" 10 "Soft Warn" 11 "Intake Cam" 12 "Exhaust Cam" 13 "Fuel Level" 14 "Water Intrusion" 15 "Hydraulic Enable" 16 "Trans Hyd Fwd" 17 "Trans Hyd Rev" 18 "Brake Light" 19 "Trans Enable" 20 "Backup Alarm" 21 "Front Light" 22 "Back Light" 23 "Boost WGA" 24 "Fuel Type Light" 25 "UNKNOWN 25" 26 "UNKNOWN 26" 27 "UNKNOWN 27" 28 "UNKNOWN 28" 29 "UNKNOWN 29" 30 "UNKNOWN 30" 31 "UNKNOWN 31" 32 "UNKNOWN 32" 33 "UNKNOWN 33" 34 "UNKNOWN 34" 35 "UNKNOWN 35" 36 "UNKNOWN 36" 37 "UNKNOWN 37" 38 "UNKNOWN 38" 39 "UNKNOWN 39" DEFAULT_VALUE "UNKNOWN" /end COMPU_VTAB
/begin MEASUREMENT AUX_OUT17_conflict "AUX_OUT17_conflict{AUX_OUT17_conflict&0xff=0:None}{AUX_OUT17_conflict&0xff=1:EOL}{AUX_OUT17_conflict&0xff=2:Tri-Fuel}{AUX_OUT17_conflict&0xff=3:ETHC}{AUX_OUT17_conflict&0xff=4:Configurable1}{AUX_OUT17_conflict&0xff=5:Configurable2}{AUX_OUT17_conflict&0xff" UBYTE AUX_OUT17_conflict_COMPU_VTAB 0 0 0 255 ECU_ADDRESS 0x010090B8 BIT_MASK 0xff /end MEASUREMENT
/begin COMPU_METHOD AUX_OUT17_conflict_COMPU_VTAB "Verbal Table" TAB_VERB "%.0" "list" COMPU_TAB_REF AUX_OUT17_conflict_COMPU_VTAB_REF /end COMPU_METHOD
/begin COMPU_VTAB AUX_OUT17_conflict_COMPU_VTAB_REF "Verbal Table" TAB_VERB 40 0 "None" 1 "EOL" 2 "Tri-Fuel" 3 "ETHC" 4 "Configurable1" 5 "Configurable2" 6 "Configurable3" 7 "Shutdown Out" 8 "Max Speed SetPt" 9 "Hard Warn" 10 "Soft Warn" 11 "Intake Cam" 12 "Exhaust Cam" 13 "Fuel Level" 14 "Water Intrusion" 15 "Hydraulic Enable" 16 "Trans Hyd Fwd" 17 "Trans Hyd Rev" 18 "Brake Light" 19 "Trans Enable" 20 "Backup Alarm" 21 "Front Light" 22 "Back Light" 23 "Boost WGA" 24 "Fuel Type Light" 25 "UNKNOWN 25" 26 "UNKNOWN 26" 27 "UNKNOWN 27" 28 "UNKNOWN 28" 29 "UNKNOWN 29" 30 "UNKNOWN 30" 31 "UNKNOWN 31" 32 "UNKNOWN 32" 33 "UNKNOWN 33" 34 "UNKNOWN 34" 35 "UNKNOWN 35" 36 "UNKNOWN 36" 37 "UNKNOWN 37" 38 "UNKNOWN 38" 39 "UNKNOWN 39" DEFAULT_VALUE "UNKNOWN" /end COMPU_VTAB
/begin MEASUREMENT AUX_OUT18_conflict "AUX_OUT18_conflict{AUX_OUT18_conflict&0xff=0:None}{AUX_OUT18_conflict&0xff=1:EOL}{AUX_OUT18_conflict&0xff=2:Tri-Fuel}{AUX_OUT18_conflict&0xff=3:ETHC}{AUX_OUT18_conflict&0xff=4:Configurable1}{AUX_OUT18_conflict&0xff=5:Configurable2}{AUX_OUT18_conflict&0xff" UBYTE AUX_OUT18_conflict_COMPU_VTAB 0 0 0 255 ECU_ADDRESS 0x010090C0 BIT_MASK 0xff /end MEASUREMENT
/begin COMPU_METHOD AUX_OUT18_conflict_COMPU_VTAB "Verbal Table" TAB_VERB "%.0" "list" COMPU_TAB_REF AUX_OUT18_conflict_COMPU_VTAB_REF /end COMPU_METHOD
/begin COMPU_VTAB AUX_OUT18_conflict_COMPU_VTAB_REF "Verbal Table" TAB_VERB 40 0 "None" 1 "EOL" 2 "Tri-Fuel" 3 "ETHC" 4 "Configurable1" 5 "Configurable2" 6 "Configurable3" 7 "Shutdown Out" 8 "Max Speed SetPt" 9 "Hard Warn" 10 "Soft Warn" 11 "Intake Cam" 12 "Exhaust Cam" 13 "Fuel Level" 14 "Water Intrusion" 15 "Hydraulic Enable" 16 "Trans Hyd Fwd" 17 "Trans Hyd Rev" 18 "Brake Light" 19 "Trans Enable" 20 "Backup Alarm" 21 "Front Light" 22 "Back Light" 23 "Boost WGA" 24 "Fuel Type Light" 25 "UNKNOWN 25" 26 "UNKNOWN 26" 27 "UNKNOWN 27" 28 "UNKNOWN 28" 29 "UNKNOWN 29" 30 "UNKNOWN 30" 31 "UNKNOWN 31" 32 "UNKNOWN 32" 33 "UNKNOWN 33" 34 "UNKNOWN 34" 35 "UNKNOWN 35" 36 "UNKNOWN 36" 37 "UNKNOWN 37" 38 "UNKNOWN 38" 39 "UNKNOWN 39" DEFAULT_VALUE "UNKNOWN" /end COMPU_VTAB
/begin MEASUREMENT AUX_OUT19_conflict "AUX_OUT19_conflict{AUX_OUT19_conflict&0xff=0:None}{AUX_OUT19_conflict&0xff=1:EOL}{AUX_OUT19_conflict&0xff=2:Tri-Fuel}{AUX_OUT19_conflict&0xff=3:ETHC}{AUX_OUT19_conflict&0xff=4:Configurable1}{AUX_OUT19_conflict&0xff=5:Configurable2}{AUX_OUT19_conflict&0xff" UBYTE AUX_OUT19_conflict_COMPU_VTAB 0 0 0 255 ECU_ADDRESS 0x010090C8 BIT_MASK 0xff /end MEASUREMENT
/begin COMPU_METHOD AUX_OUT19_conflict_COMPU_VTAB "Verbal Table" TAB_VERB "%.0" "list" COMPU_TAB_REF AUX_OUT19_conflict_COMPU_VTAB_REF /end COMPU_METHOD
/begin COMPU_VTAB AUX_OUT19_conflict_COMPU_VTAB_REF "Verbal Table" TAB_VERB 40 0 "None" 1 "EOL" 2 "Tri-Fuel" 3 "ETHC" 4 "Configurable1" 5 "Configurable2" 6 "Configurable3" 7 "Shutdown Out" 8 "Max Speed SetPt" 9 "Hard Warn" 10 "Soft Warn" 11 "Intake Cam" 12 "Exhaust Cam" 13 "Fuel Level" 14 "Water Intrusion" 15 "Hydraulic Enable" 16 "Trans Hyd Fwd" 17 "Trans Hyd Rev" 18 "Brake Light" 19 "Trans Enable" 20 "Backup Alarm" 21 "Front Light" 22 "Back Light" 23 "Boost WGA" 24 "Fuel Type Light" 25 "UNKNOWN 25" 26 "UNKNOWN 26" 27 "UNKNOWN 27" 28 "UNKNOWN 28" 29 "UNKNOWN 29" 30 "UNKNOWN 30" 31 "UNKNOWN 31" 32 "UNKNOWN 32" 33 "UNKNOWN 33" 34 "UNKNOWN 34" 35 "UNKNOWN 35" 36 "UNKNOWN 36" 37 "UNKNOWN 37" 38 "UNKNOWN 38" 39 "UNKNOWN 39" DEFAULT_VALUE "UNKNOWN" /end COMPU_VTAB
/begin MEASUREMENT AUX_OUT20_conflict "AUX_OUT20_conflict{AUX_OUT20_conflict&0xff=0:None}{AUX_OUT20_conflict&0xff=1:EOL}{AUX_OUT20_conflict&0xff=2:Tri-Fuel}{AUX_OUT20_conflict&0xff=3:ETHC}{AUX_OUT20_conflict&0xff=4:Configurable1}{AUX_OUT20_conflict&0xff=5:Configurable2}{AUX_OUT20_conflict&0xff" UBYTE AUX_OUT20_conflict_COMPU_VTAB 0 0 0 255 ECU_ADDRESS 0x010090D0 BIT_MASK 0xff /end MEASUREMENT
/begin COMPU_METHOD AUX_OUT20_conflict_COMPU_VTAB "Verbal Table" TAB_VERB "%.0" "list" COMPU_TAB_REF AUX_OUT20_conflict_COMPU_VTAB_REF /end COMPU_METHOD
/begin COMPU_VTAB AUX_OUT20_conflict_COMPU_VTAB_REF "Verbal Table" TAB_VERB 40 0 "None" 1 "EOL" 2 "Tri-Fuel" 3 "ETHC" 4 "Configurable1" 5 "Configurable2" 6 "Configurable3" 7 "Shutdown Out" 8 "Max Speed SetPt" 9 "Hard Warn" 10 "Soft Warn" 11 "Intake Cam" 12 "Exhaust Cam" 13 "Fuel Level" 14 "Water Intrusion" 15 "Hydraulic Enable" 16 "Trans Hyd Fwd" 17 "Trans Hyd Rev" 18 "Brake Light" 19 "Trans Enable" 20 "Backup Alarm" 21 "Front Light" 22 "Back Light" 23 "Boost WGA" 24 "Fuel Type Light" 25 "UNKNOWN 25" 26 "UNKNOWN 26" 27 "UNKNOWN 27" 28 "UNKNOWN 28" 29 "UNKNOWN 29" 30 "UNKNOWN 30" 31 "UNKNOWN 31" 32 "UNKNOWN 32" 33 "UNKNOWN 33" 34 "UNKNOWN 34" 35 "UNKNOWN 35" 36 "UNKNOWN 36" 37 "UNKNOWN 37" 38 "UNKNOWN 38" 39 "UNKNOWN 39" DEFAULT_VALUE "UNKNOWN" /end COMPU_VTAB
/begin MEASUREMENT AUX_OUT21_conflict "AUX_OUT21_conflict{AUX_OUT21_conflict&0xff=0:None}{AUX_OUT21_conflict&0xff=1:EOL}{AUX_OUT21_conflict&0xff=2:Tri-Fuel}{AUX_OUT21_conflict&0xff=3:ETHC}{AUX_OUT21_conflict&0xff=4:Configurable1}{AUX_OUT21_conflict&0xff=5:Configurable2}{AUX_OUT21_conflict&0xff" UBYTE AUX_OUT21_conflict_COMPU_VTAB 0 0 0 255 ECU_ADDRESS 0x010090D8 BIT_MASK 0xff /end MEASUREMENT
/begin COMPU_METHOD AUX_OUT21_conflict_COMPU_VTAB "Verbal Table" TAB_VERB "%.0" "list" COMPU_TAB_REF AUX_OUT21_conflict_COMPU_VTAB_REF /end COMPU_METHOD
/begin COMPU_VTAB AUX_OUT21_conflict_COMPU_VTAB_REF "Verbal Table" TAB_VERB 40 0 "None" 1 "EOL" 2 "Tri-Fuel" 3 "ETHC" 4 "Configurable1" 5 "Configurable2" 6 "Configurable3" 7 "Shutdown Out" 8 "Max Speed SetPt" 9 "Hard Warn" 10 "Soft Warn" 11 "Intake Cam" 12 "Exhaust Cam" 13 "Fuel Level" 14 "Water Intrusion" 15 "Hydraulic Enable" 16 "Trans Hyd Fwd" 17 "Trans Hyd Rev" 18 "Brake Light" 19 "Trans Enable" 20 "Backup Alarm" 21 "Front Light" 22 "Back Light" 23 "Boost WGA" 24 "Fuel Type Light" 25 "UNKNOWN 25" 26 "UNKNOWN 26" 27 "UNKNOWN 27" 28 "UNKNOWN 28" 29 "UNKNOWN 29" 30 "UNKNOWN 30" 31 "UNKNOWN 31" 32 "UNKNOWN 32" 33 "UNKNOWN 33" 34 "UNKNOWN 34" 35 "UNKNOWN 35" 36 "UNKNOWN 36" 37 "UNKNOWN 37" 38 "UNKNOWN 38" 39 "UNKNOWN 39" DEFAULT_VALUE "UNKNOWN" /end COMPU_VTAB
/begin MEASUREMENT AUX_OUT22_conflict "AUX_OUT22_conflict{AUX_OUT22_conflict&0xff=0:None}{AUX_OUT22_conflict&0xff=1:EOL}{AUX_OUT22_conflict&0xff=2:Tri-Fuel}{AUX_OUT22_conflict&0xff=3:ETHC}{AUX_OUT22_conflict&0xff=4:Configurable1}{AUX_OUT22_conflict&0xff=5:Configurable2}{AUX_OUT22_conflict&0xff" UBYTE AUX_OUT22_conflict_COMPU_VTAB 0 0 0 255 ECU_ADDRESS 0x010090E0 BIT_MASK 0xff /end MEASUREMENT
/begin COMPU_METHOD AUX_OUT22_conflict_COMPU_VTAB "Verbal Table" TAB_VERB "%.0" "list" COMPU_TAB_REF AUX_OUT22_conflict_COMPU_VTAB_REF /end COMPU_METHOD
/begin COMPU_VTAB AUX_OUT22_conflict_COMPU_VTAB_REF "Verbal Table" TAB_VERB 40 0 "None" 1 "EOL" 2 "Tri-Fuel" 3 "ETHC" 4 "Configurable1" 5 "Configurable2" 6 "Configurable3" 7 "Shutdown Out" 8 "Max Speed SetPt" 9 "Hard Warn" 10 "Soft Warn" 11 "Intake Cam" 12 "Exhaust Cam" 13 "Fuel Level" 14 "Water Intrusion" 15 "Hydraulic Enable" 16 "Trans Hyd Fwd" 17 "Trans Hyd Rev" 18 "Brake Light" 19 "Trans Enable" 20 "Backup Alarm" 21 "Front Light" 22 "Back Light" 23 "Boost WGA" 24 "Fuel Type Light" 25 "UNKNOWN 25" 26 "UNKNOWN 26" 27 "UNKNOWN 27" 28 "UNKNOWN 28" 29 "UNKNOWN 29" 30 "UNKNOWN 30" 31 "UNKNOWN 31" 32 "UNKNOWN 32" 33 "UNKNOWN 33" 34 "UNKNOWN 34" 35 "UNKNOWN 35" 36 "UNKNOWN 36" 37 "UNKNOWN 37" 38 "UNKNOWN 38" 39 "UNKNOWN 39" DEFAULT_VALUE "UNKNOWN" /end COMPU_VTAB
/begin MEASUREMENT AUX_OUT23_conflict "AUX_OUT23_conflict{AUX_OUT23_conflict&0xff=0:None}{AUX_OUT23_conflict&0xff=1:EOL}{AUX_OUT23_conflict&0xff=2:Tri-Fuel}{AUX_OUT23_conflict&0xff=3:ETHC}{AUX_OUT23_conflict&0xff=4:Configurable1}{AUX_OUT23_conflict&0xff=5:Configurable2}{AUX_OUT23_conflict&0xff" UBYTE AUX_OUT23_conflict_COMPU_VTAB 0 0 0 255 ECU_ADDRESS 0x010090E8 BIT_MASK 0xff /end MEASUREMENT
/begin COMPU_METHOD AUX_OUT23_conflict_COMPU_VTAB "Verbal Table" TAB_VERB "%.0" "list" COMPU_TAB_REF AUX_OUT23_conflict_COMPU_VTAB_REF /end COMPU_METHOD
/begin COMPU_VTAB AUX_OUT23_conflict_COMPU_VTAB_REF "Verbal Table" TAB_VERB 40 0 "None" 1 "EOL" 2 "Tri-Fuel" 3 "ETHC" 4 "Configurable1" 5 "Configurable2" 6 "Configurable3" 7 "Shutdown Out" 8 "Max Speed SetPt" 9 "Hard Warn" 10 "Soft Warn" 11 "Intake Cam" 12 "Exhaust Cam" 13 "Fuel Level" 14 "Water Intrusion" 15 "Hydraulic Enable" 16 "Trans Hyd Fwd" 17 "Trans Hyd Rev" 18 "Brake Light" 19 "Trans Enable" 20 "Backup Alarm" 21 "Front Light" 22 "Back Light" 23 "Boost WGA" 24 "Fuel Type Light" 25 "UNKNOWN 25" 26 "UNKNOWN 26" 27 "UNKNOWN 27" 28 "UNKNOWN 28" 29 "UNKNOWN 29" 30 "UNKNOWN 30" 31 "UNKNOWN 31" 32 "UNKNOWN 32" 33 "UNKNOWN 33" 34 "UNKNOWN 34" 35 "UNKNOWN 35" 36 "UNKNOWN 36" 37 "UNKNOWN 37" 38 "UNKNOWN 38" 39 "UNKNOWN 39" DEFAULT_VALUE "UNKNOWN" /end COMPU_VTAB
/begin MEASUREMENT AUX_MIL_alloc "AUX_MIL_alloc{AUX_MIL_alloc&0xff=0:None}{AUX_MIL_alloc&0xff=1:EOL}{AUX_MIL_alloc&0xff=2:Tri-Fuel}{AUX_MIL_alloc&0xff=3:ETHC}{AUX_MIL_alloc&0xff=4:Configurable1}{AUX_MIL_alloc&0xff=5:Configurable2}{AUX_MIL_alloc&0xff=6:Configurable3}{AUX_MIL_alloc&0xff=7:S" UBYTE AUX_MIL_alloc_COMPU_VTAB 0 0 0 255 ECU_ADDRESS 0x010090F0 BIT_MASK 0xff /end MEASUREMENT
/begin COMPU_METHOD AUX_MIL_alloc_COMPU_VTAB "Verbal Table" TAB_VERB "%.0" "list" COMPU_TAB_REF AUX_MIL_alloc_COMPU_VTAB_REF /end COMPU_METHOD
/begin COMPU_VTAB AUX_MIL_alloc_COMPU_VTAB_REF "Verbal Table" TAB_VERB 40 0 "None" 1 "EOL" 2 "Tri-Fuel" 3 "ETHC" 4 "Configurable1" 5 "Configurable2" 6 "Configurable3" 7 "Shutdown Out" 8 "Max Speed SetPt" 9 "Hard Warn" 10 "Soft Warn" 11 "Intake Cam" 12 "Exhaust Cam" 13 "Fuel Level" 14 "Water Intrusion" 15 "Hydraulic Enable" 16 "Trans Hyd Fwd" 17 "Trans Hyd Rev" 18 "Brake Light" 19 "Trans Enable" 20 "Backup Alarm" 21 "Front Light" 22 "Back Light" 23 "Boost WGA" 24 "Fuel Type Light" 25 "UNKNOWN 25" 26 "UNKNOWN 26" 27 "UNKNOWN 27" 28 "UNKNOWN 28" 29 "UNKNOWN 29" 30 "UNKNOWN 30" 31 "UNKNOWN 31" 32 "UNKNOWN 32" 33 "UNKNOWN 33" 34 "UNKNOWN 34" 35 "UNKNOWN 35" 36 "UNKNOWN 36" 37 "UNKNOWN 37" 38 "UNKNOWN 38" 39 "UNKNOWN 39" DEFAULT_VALUE "UNKNOWN" /end COMPU_VTAB
/begin MEASUREMENT AUX_MIL_conflict "AUX_MIL_conflict{AUX_MIL_conflict&0xff=0:None}{AUX_MIL_conflict&0xff=1:EOL}{AUX_MIL_conflict&0xff=2:Tri-Fuel}{AUX_MIL_conflict&0xff=3:ETHC}{AUX_MIL_conflict&0xff=4:Configurable1}{AUX_MIL_conflict&0xff=5:Configurable2}{AUX_MIL_conflict&0xff=6:Configurable3" UBYTE AUX_MIL_conflict_COMPU_VTAB 0 0 0 255 ECU_ADDRESS 0x010090F8 BIT_MASK 0xff /end MEASUREMENT
/begin COMPU_METHOD AUX_MIL_conflict_COMPU_VTAB "Verbal Table" TAB_VERB "%.0" "list" COMPU_TAB_REF AUX_MIL_conflict_COMPU_VTAB_REF /end COMPU_METHOD
/begin COMPU_VTAB AUX_MIL_conflict_COMPU_VTAB_REF "Verbal Table" TAB_VERB 40 0 "None" 1 "EOL" 2 "Tri-Fuel" 3 "ETHC" 4 "Configurable1" 5 "Configurable2" 6 "Configurable3" 7 "Shutdown Out" 8 "Max Speed SetPt" 9 "Hard Warn" 10 "Soft Warn" 11 "Intake Cam" 12 "Exhaust Cam" 13 "Fuel Level" 14 "Water Intrusion" 15 "Hydraulic Enable" 16 "Trans Hyd Fwd" 17 "Trans Hyd Rev" 18 "Brake Light" 19 "Trans Enable" 20 "Backup Alarm" 21 "Front Light" 22 "Back Light" 23 "Boost WGA" 24 "Fuel Type Light" 25 "UNKNOWN 25" 26 "UNKNOWN 26" 27 "UNKNOWN 27" 28 "UNKNOWN 28" 29 "UNKNOWN 29" 30 "UNKNOWN 30" 31 "UNKNOWN 31" 32 "UNKNOWN 32" 33 "UNKNOWN 33" 34 "UNKNOWN 34" 35 "UNKNOWN 35" 36 "UNKNOWN 36" 37 "UNKNOWN 37" 38 "UNKNOWN 38" 39 "UNKNOWN 39" DEFAULT_VALUE "UNKNOWN" /end COMPU_VTAB
/begin MEASUREMENT AUX_TACH_alloc "AUX_TACH_alloc{AUX_TACH_alloc&0xff=0:None}{AUX_TACH_alloc&0xff=1:EOL}{AUX_TACH_alloc&0xff=2:Tri-Fuel}{AUX_TACH_alloc&0xff=3:ETHC}{AUX_TACH_alloc&0xff=4:Configurable1}{AUX_TACH_alloc&0xff=5:Configurable2}{AUX_TACH_alloc&0xff=6:Configurable3}{AUX_TACH_alloc" UBYTE AUX_TACH_alloc_COMPU_VTAB 0 0 0 255 ECU_ADDRESS 0x01009100 BIT_MASK 0xff /end MEASUREMENT
/begin COMPU_METHOD AUX_TACH_alloc_COMPU_VTAB "Verbal Table" TAB_VERB "%.0" "list" COMPU_TAB_REF AUX_TACH_alloc_COMPU_VTAB_REF /end COMPU_METHOD
/begin COMPU_VTAB AUX_TACH_alloc_COMPU_VTAB_REF "Verbal Table" TAB_VERB 40 0 "None" 1 "EOL" 2 "Tri-Fuel" 3 "ETHC" 4 "Configurable1" 5 "Configurable2" 6 "Configurable3" 7 "Shutdown Out" 8 "Max Speed SetPt" 9 "Hard Warn" 10 "Soft Warn" 11 "Intake Cam" 12 "Exhaust Cam" 13 "Fuel Level" 14 "Water Intrusion" 15 "Hydraulic Enable" 16 "Trans Hyd Fwd" 17 "Trans Hyd Rev" 18 "Brake Light" 19 "Trans Enable" 20 "Backup Alarm" 21 "Front Light" 22 "Back Light" 23 "Boost WGA" 24 "Fuel Type Light" 25 "UNKNOWN 25" 26 "UNKNOWN 26" 27 "UNKNOWN 27" 28 "UNKNOWN 28" 29 "UNKNOWN 29" 30 "UNKNOWN 30" 31 "UNKNOWN 31" 32 "UNKNOWN 32" 33 "UNKNOWN 33" 34 "UNKNOWN 34" 35 "UNKNOWN 35" 36 "UNKNOWN 36" 37 "UNKNOWN 37" 38 "UNKNOWN 38" 39 "UNKNOWN 39" DEFAULT_VALUE "UNKNOWN" /end COMPU_VTAB
/begin MEASUREMENT AUX_TACH_conflict "AUX_TACH_conflict{AUX_TACH_conflict&0xff=0:None}{AUX_TACH_conflict&0xff=1:EOL}{AUX_TACH_conflict&0xff=2:Tri-Fuel}{AUX_TACH_conflict&0xff=3:ETHC}{AUX_TACH_conflict&0xff=4:Configurable1}{AUX_TACH_conflict&0xff=5:Configurable2}{AUX_TACH_conflict&0xff=6:Confi" UBYTE AUX_TACH_conflict_COMPU_VTAB 0 0 0 255 ECU_ADDRESS 0x01009108 BIT_MASK 0xff /end MEASUREMENT
/begin COMPU_METHOD AUX_TACH_conflict_COMPU_VTAB "Verbal Table" TAB_VERB "%.0" "list" COMPU_TAB_REF AUX_TACH_conflict_COMPU_VTAB_REF /end COMPU_METHOD
/begin COMPU_VTAB AUX_TACH_conflict_COMPU_VTAB_REF "Verbal Table" TAB_VERB 40 0 "None" 1 "EOL" 2 "Tri-Fuel" 3 "ETHC" 4 "Configurable1" 5 "Configurable2" 6 "Configurable3" 7 "Shutdown Out" 8 "Max Speed SetPt" 9 "Hard Warn" 10 "Soft Warn" 11 "Intake Cam" 12 "Exhaust Cam" 13 "Fuel Level" 14 "Water Intrusion" 15 "Hydraulic Enable" 16 "Trans Hyd Fwd" 17 "Trans Hyd Rev" 18 "Brake Light" 19 "Trans Enable" 20 "Backup Alarm" 21 "Front Light" 22 "Back Light" 23 "Boost WGA" 24 "Fuel Type Light" 25 "UNKNOWN 25" 26 "UNKNOWN 26" 27 "UNKNOWN 27" 28 "UNKNOWN 28" 29 "UNKNOWN 29" 30 "UNKNOWN 30" 31 "UNKNOWN 31" 32 "UNKNOWN 32" 33 "UNKNOWN 33" 34 "UNKNOWN 34" 35 "UNKNOWN 35" 36 "UNKNOWN 36" 37 "UNKNOWN 37" 38 "UNKNOWN 38" 39 "UNKNOWN 39" DEFAULT_VALUE "UNKNOWN" /end COMPU_VTAB
/begin CHARACTERISTIC CRI_Qmin_hyst "Injector minimum quantity hysteresis" VALUE 0x0016c520 /* @ECU_Address@CRI_Qmin_hyst@0x0100A750@ */ ECIPP_ALIGNMENT_SWORD 256 Compu_CRI_Qmin_hyst -256 255.9921875 /end CHARACTERISTIC
/begin COMPU_METHOD Compu_CRI_Qmin_hyst " " RAT_FUNC "%.2" "mg/stroke" COEFFS 0 128 0 0 0 1 /end COMPU_METHOD
/begin MEASUREMENT CRI_mg_minimum "Minimum injection quantity" SWORD Compu_CRI_mg_minimum 0 0 -256 255.9921875 ECU_ADDRESS 0x0100A758 /end MEASUREMENT
/begin COMPU_METHOD Compu_CRI_mg_minimum " " RAT_FUNC "%.2" "mg/stroke" COEFFS 0 128 0 0 0 1 /end COMPU_METHOD
/begin MEASUREMENT CRI_status_pilot2 "Pilot 2 status{CRI_status_pilot2&0xff=0:On: normal}{CRI_status_pilot2&0xff=1:On: width truncated}{CRI_status_pilot2&0xff=2:Off: forced via table}{CRI_status_pilot2&0xff=3:Off: low rail pressure}{CRI_status_pilot2&0xff=4:Off: low fuel quantity}{CRI_status_" UBYTE CRI_status_pilot2_COMPU_VTAB 0 0 0 255 ECU_ADDRESS 0x0100A768 BIT_MASK 0xff /end MEASUREMENT
/begin COMPU_METHOD CRI_status_pilot2_COMPU_VTAB "Verbal Table" TAB_VERB "%.0" "list" COMPU_TAB_REF CRI_status_pilot2_COMPU_VTAB_REF /end COMPU_METHOD
/begin COMPU_VTAB CRI_status_pilot2_COMPU_VTAB_REF "Verbal Table" TAB_VERB 11 0 "On: normal" 1 "On: width truncated" 2 "Off: forced via table" 3 "Off: low rail pressure" 4 "Off: low fuel quantity" 5 "Off: low pulse width" 6 "Off: pilot 2 conflict" 7 "Off: pilot 1 conflict" 8 "Off: main conflict" 9 "Off: post 1 conflict" 10 "Off: post 2 conflict" DEFAULT_VALUE "UNKNOWN" /end COMPU_VTAB
/begin MEASUREMENT CRI_status_pilot1 "Pilot 1 status{CRI_status_pilot1&0xff=0:On: normal}{CRI_status_pilot1&0xff=1:On: width truncated}{CRI_status_pilot1&0xff=2:Off: forced via table}{CRI_status_pilot1&0xff=3:Off: low rail pressure}{CRI_status_pilot1&0xff=4:Off: low fuel quantity}{CRI_status_" UBYTE CRI_status_pilot1_COMPU_VTAB 0 0 0 255 ECU_ADDRESS 0x0100A770 BIT_MASK 0xff /end MEASUREMENT
/begin COMPU_METHOD CRI_status_pilot1_COMPU_VTAB "Verbal Table" TAB_VERB "%.0" "list" COMPU_TAB_REF CRI_status_pilot1_COMPU_VTAB_REF /end COMPU_METHOD
/begin COMPU_VTAB CRI_status_pilot1_COMPU_VTAB_REF "Verbal Table" TAB_VERB 11 0 "On: normal" 1 "On: width truncated" 2 "Off: forced via table" 3 "Off: low rail pressure" 4 "Off: low fuel quantity" 5 "Off: low pulse width" 6 "Off: pilot 2 conflict" 7 "Off: pilot 1 conflict" 8 "Off: main conflict" 9 "Off: post 1 conflict" 10 "Off: post 2 conflict" DEFAULT_VALUE "UNKNOWN" /end COMPU_VTAB
/begin MEASUREMENT CRI_status_main "Main status{CRI_status_main&0xff=0:On: normal}{CRI_status_main&0xff=1:On: width truncated}{CRI_status_main&0xff=2:Off: forced via table}{CRI_status_main&0xff=3:Off: low rail pressure}{CRI_status_main&0xff=4:Off: low fuel quantity}{CRI_status_main&0xff=5:O" UBYTE CRI_status_main_COMPU_VTAB 0 0 0 255 ECU_ADDRESS 0x0100A778 BIT_MASK 0xff /end MEASUREMENT
/begin COMPU_METHOD CRI_status_main_COMPU_VTAB "Verbal Table" TAB_VERB "%.0" "list" COMPU_TAB_REF CRI_status_main_COMPU_VTAB_REF /end COMPU_METHOD
/begin COMPU_VTAB CRI_status_main_COMPU_VTAB_REF "Verbal Table" TAB_VERB 11 0 "On: normal" 1 "On: width truncated" 2 "Off: forced via table" 3 "Off: low rail pressure" 4 "Off: low fuel quantity" 5 "Off: low pulse width" 6 "Off: pilot 2 conflict" 7 "Off: pilot 1 conflict" 8 "Off: main conflict" 9 "Off: post 1 conflict" 10 "Off: post 2 conflict" DEFAULT_VALUE "UNKNOWN" /end COMPU_VTAB
/begin MEASUREMENT CRI_status_post1 "Post 1 status{CRI_status_post1&0xff=0:On: normal}{CRI_status_post1&0xff=1:On: width truncated}{CRI_status_post1&0xff=2:Off: forced via table}{CRI_status_post1&0xff=3:Off: low rail pressure}{CRI_status_post1&0xff=4:Off: low fuel quantity}{CRI_status_post1&" UBYTE CRI_status_post1_COMPU_VTAB 0 0 0 255 ECU_ADDRESS 0x0100A780 BIT_MASK 0xff /end MEASUREMENT
/begin COMPU_METHOD CRI_status_post1_COMPU_VTAB "Verbal Table" TAB_VERB "%.0" "list" COMPU_TAB_REF CRI_status_post1_COMPU_VTAB_REF /end COMPU_METHOD
/begin COMPU_VTAB CRI_status_post1_COMPU_VTAB_REF "Verbal Table" TAB_VERB 11 0 "On: normal" 1 "On: width truncated" 2 "Off: forced via table" 3 "Off: low rail pressure" 4 "Off: low fuel quantity" 5 "Off: low pulse width" 6 "Off: pilot 2 conflict" 7 "Off: pilot 1 conflict" 8 "Off: main conflict" 9 "Off: post 1 conflict" 10 "Off: post 2 conflict" DEFAULT_VALUE "UNKNOWN" /end COMPU_VTAB
/begin MEASUREMENT CRI_status_post2 "Post 2 status{CRI_status_post2&0xff=0:On: normal}{CRI_status_post2&0xff=1:On: width truncated}{CRI_status_post2&0xff=2:Off: forced via table}{CRI_status_post2&0xff=3:Off: low rail pressure}{CRI_status_post2&0xff=4:Off: low fuel quantity}{CRI_status_post2&" UBYTE CRI_status_post2_COMPU_VTAB 0 0 0 255 ECU_ADDRESS 0x0100A788 BIT_MASK 0xff /end MEASUREMENT
/begin COMPU_METHOD CRI_status_post2_COMPU_VTAB "Verbal Table" TAB_VERB "%.0" "list" COMPU_TAB_REF CRI_status_post2_COMPU_VTAB_REF /end COMPU_METHOD
/begin COMPU_VTAB CRI_status_post2_COMPU_VTAB_REF "Verbal Table" TAB_VERB 11 0 "On: normal" 1 "On: width truncated" 2 "Off: forced via table" 3 "Off: low rail pressure" 4 "Off: low fuel quantity" 5 "Off: low pulse width" 6 "Off: pilot 2 conflict" 7 "Off: pilot 1 conflict" 8 "Off: main conflict" 9 "Off: post 1 conflict" 10 "Off: post 2 conflict" DEFAULT_VALUE "UNKNOWN" /end COMPU_VTAB
/begin CHARACTERISTIC CRI_pulseoff_hyst "Forced pulse disabling hysteresis" VALUE 0x00170e64 /* @ECU_Address@CRI_pulseoff_hyst@0x0100A798@ */ ECIPP_ALIGNMENT_UWORD 100 Compu_CRI_pulseoff_hyst 0 99.9984741210938 /end CHARACTERISTIC
/begin COMPU_METHOD Compu_CRI_pulseoff_hyst " " RAT_FUNC "%.1" "%" COEFFS 0 655.36 0 0 0 1 /end COMPU_METHOD
/begin MEASUREMENT CRI_pulseoff_force "Forced pulse disable byte" UBYTE Compu_CRI_pulseoff_force 0 0 0 255 ECU_ADDRESS 0x0100A7A0 /end MEASUREMENT
/begin COMPU_METHOD Compu_CRI_pulseoff_force " " RAT_FUNC "%.0" "-" COEFFS 0 1 0 0 0 1 /end COMPU_METHOD
/begin MEASUREMENT CRI_pi2main_margin "Pilot 2 - Main margin" SWORD Compu_CRI_pi2main_margin 0 0 -32768 32767 ECU_ADDRESS 0x0100B0E8 /end MEASUREMENT
/begin COMPU_METHOD Compu_CRI_pi2main_margin " " RAT_FUNC "%.0" "us" COEFFS 0 1 0 0 0 1 /end COMPU_METHOD
/begin MEASUREMENT CRI_pi2pi1_margin "Pilot 2 - Pilot 1 margin" SWORD Compu_CRI_pi2pi1_margin 0 0 -32768 32767 ECU_ADDRESS 0x0100B0F0 /end MEASUREMENT
/begin COMPU_METHOD Compu_CRI_pi2pi1_margin " " RAT_FUNC "%.0" "us" COEFFS 0 1 0 0 0 1 /end COMPU_METHOD
/begin MEASUREMENT CRI_pi1main_margin "Pilot 1 - Main margin" SWORD Compu_CRI_pi1main_margin 0 0 -32768 32767 ECU_ADDRESS 0x0100B0F8 /end MEASUREMENT
/begin COMPU_METHOD Compu_CRI_pi1main_margin " " RAT_FUNC "%.0" "us" COEFFS 0 1 0 0 0 1 /end COMPU_METHOD
/begin MEASUREMENT CRI_mainpo1_margin "Main - Post 1 margin" SWORD Compu_CRI_mainpo1_margin 0 0 -32768 32767 ECU_ADDRESS 0x0100B100 /end MEASUREMENT
/begin COMPU_METHOD Compu_CRI_mainpo1_margin " " RAT_FUNC "%.0" "us" COEFFS 0 1 0 0 0 1 /end COMPU_METHOD
/begin MEASUREMENT CRI_po1po2_margin "Post 1  - Post 2 margin" SWORD Compu_CRI_po1po2_margin 0 0 -32768 32767 ECU_ADDRESS 0x0100B108 /end MEASUREMENT
/begin COMPU_METHOD Compu_CRI_po1po2_margin " " RAT_FUNC "%.0" "us" COEFFS 0 1 0 0 0 1 /end COMPU_METHOD
/begin MEASUREMENT CRI_mainpo2_margin "Main - Post 2 margin" SWORD Compu_CRI_mainpo2_margin 0 0 -32768 32767 ECU_ADDRESS 0x0100B110 /end MEASUREMENT
/begin COMPU_METHOD Compu_CRI_mainpo2_margin " " RAT_FUNC "%.0" "us" COEFFS 0 1 0 0 0 1 /end COMPU_METHOD
/begin MEASUREMENT CRI1_boost_raw "CRI1_boost_raw" UWORD Compu_CRI1_boost_raw 0 0 0 5.00114468864469 ECU_ADDRESS 0x0100B678 /end MEASUREMENT
/begin COMPU_METHOD Compu_CRI1_boost_raw " " RAT_FUNC "%.3" "volts" COEFFS 0 13104 0 0 0 1 /end COMPU_METHOD
/begin MEASUREMENT CRI1_LS_i_raw "CRI1_LS_i_raw" UWORD Compu_CRI1_LS_i_raw 0 0 0 5.00114468864469 ECU_ADDRESS 0x0100B680 /end MEASUREMENT
/begin COMPU_METHOD Compu_CRI1_LS_i_raw " " RAT_FUNC "%.3" "volts" COEFFS 0 13104 0 0 0 1 /end COMPU_METHOD
/begin MEASUREMENT CRI2_boost_raw "CRI2_boost_raw" UWORD Compu_CRI2_boost_raw 0 0 0 5.00114468864469 ECU_ADDRESS 0x0100B688 /end MEASUREMENT
/begin COMPU_METHOD Compu_CRI2_boost_raw " " RAT_FUNC "%.3" "volts" COEFFS 0 13104 0 0 0 1 /end COMPU_METHOD
/begin MEASUREMENT CRI2_LS_i_raw "CRI2_LS_i_raw" UWORD Compu_CRI2_LS_i_raw 0 0 0 5.00114468864469 ECU_ADDRESS 0x0100B690 /end MEASUREMENT
/begin COMPU_METHOD Compu_CRI2_LS_i_raw " " RAT_FUNC "%.3" "volts" COEFFS 0 13104 0 0 0 1 /end COMPU_METHOD
/begin MEASUREMENT ref_4096V_raw "ref_4096V_raw" UWORD Compu_ref_4096V_raw 0 0 0 5.00114468864469 ECU_ADDRESS 0x0100B8B0 /end MEASUREMENT
/begin COMPU_METHOD Compu_ref_4096V_raw " " RAT_FUNC "%.3" "volts" COEFFS 0 13104 0 0 0 1 /end COMPU_METHOD
/begin MEASUREMENT VE6_FB_raw "VE6_FB_raw" UWORD Compu_VE6_FB_raw 0 0 0 5.00114468864469 ECU_ADDRESS 0x0100C270 /end MEASUREMENT
/begin COMPU_METHOD Compu_VE6_FB_raw " " RAT_FUNC "%.3" "volts" COEFFS 0 13104 0 0 0 1 /end COMPU_METHOD
/begin MEASUREMENT UEGO_Vcc_raw "UEGO_Vcc_raw" UWORD Compu_UEGO_Vcc_raw 0 0 0 5.00114468864469 ECU_ADDRESS 0x0100C278 /end MEASUREMENT
/begin COMPU_METHOD Compu_UEGO_Vcc_raw " " RAT_FUNC "%.3" "volts" COEFFS 0 13104 0 0 0 1 /end COMPU_METHOD
/begin CHARACTERISTIC TIPAdapt_ena "Slave TPS control{TIPAdapt_ena&0xff=0:Disabled}{TIPAdapt_ena&0xff=1:Enabled}" VALUE 0x0014809a /* @ECU_Address@TIPAdapt_ena@0x0100D150@ */ ECIPP_ALIGNMENT_UBYTE 255 TIPAdapt_ena_COMPU_VTAB 0 255 BIT_MASK 0xff /end CHARACTERISTIC
/begin COMPU_METHOD TIPAdapt_ena_COMPU_VTAB "Verbal Table" TAB_VERB "%.0" "list" COMPU_TAB_REF TIPAdapt_ena_COMPU_VTAB_REF /end COMPU_METHOD
/begin COMPU_VTAB TIPAdapt_ena_COMPU_VTAB_REF "Verbal Table" TAB_VERB 2 0 "Disabled" 1 "Enabled" DEFAULT_VALUE "UNKNOWN" /end COMPU_VTAB
/begin CHARACTERISTIC TIPAdapt_deadzone "Deadzone" VALUE 0x00149374 /* @ECU_Address@TIPAdapt_deadzone@0x0100D160@ */ ECIPP_ALIGNMENT_UWORD 256 Compu_TIPAdapt_deadzone 0 255.99609375 /end CHARACTERISTIC
/begin COMPU_METHOD Compu_TIPAdapt_deadzone " " RAT_FUNC "%.1" "psia" COEFFS 0 256 0 0 0 1 /end COMPU_METHOD
/begin CHARACTERISTIC TIPAdapt_min "Minimum correction" VALUE 0x00149376 /* @ECU_Address@TIPAdapt_min@0x0100D168@ */ ECIPP_ALIGNMENT_SWORD 100 Compu_TIPAdapt_min -100 99.9969482421875 /end CHARACTERISTIC
/begin COMPU_METHOD Compu_TIPAdapt_min " " RAT_FUNC "%.1" "% TPS" COEFFS 0 327.68 0 0 0 1 /end COMPU_METHOD
/begin CHARACTERISTIC TIPAdapt_max "Maximum correction" VALUE 0x00149378 /* @ECU_Address@TIPAdapt_max@0x0100D170@ */ ECIPP_ALIGNMENT_SWORD 100 Compu_TIPAdapt_max -100 99.9969482421875 /end CHARACTERISTIC
/begin COMPU_METHOD Compu_TIPAdapt_max " " RAT_FUNC "%.1" "% TPS" COEFFS 0 327.68 0 0 0 1 /end COMPU_METHOD
/begin CHARACTERISTIC TIPAdapt_MAP_tau "MAP low pass tau" VALUE 0x0014937A /* @ECU_Address@TIPAdapt_MAP_tau@0x0100D178@ */ ECIPP_ALIGNMENT_UWORD 3277 Compu_TIPAdapt_MAP_tau 0.0045084 3276.8 /end CHARACTERISTIC
/begin COMPU_METHOD Compu_TIPAdapt_MAP_tau " " FORM "%.1" "sec"
 /begin FORMULA "-0.05 / log(1 - (X1 / 65536))" FORMULA_INV "(1 - exp(-0.05/X1)) * 65536" /end FORMULA
/end COMPU_METHOD
/begin CHARACTERISTIC TIPAdapt_dMAP_max "Maximum MAP delta" VALUE 0x0014937C /* @ECU_Address@TIPAdapt_dMAP_max@0x0100D180@ */ ECIPP_ALIGNMENT_UWORD 256 Compu_TIPAdapt_dMAP_max 0 255.99609375 /end CHARACTERISTIC
/begin COMPU_METHOD Compu_TIPAdapt_dMAP_max " " RAT_FUNC "%.1" "psia" COEFFS 0 256 0 0 0 1 /end COMPU_METHOD
/begin CHARACTERISTIC TIPAdapt_ECT_min "Minumum ECT" VALUE 0x0014937E /* @ECU_Address@TIPAdapt_ECT_min@0x0100D188@ */ ECIPP_ALIGNMENT_UWORD 564 Compu_TIPAdapt_ECT_min -460 563.984375 /end CHARACTERISTIC
/begin COMPU_METHOD Compu_TIPAdapt_ECT_min " " RAT_FUNC "%.1" "deg F" COEFFS 0 64 29440 0 0 1 /end COMPU_METHOD
/begin CHARACTERISTIC TIPAdapt_wait "Stability wait time" VALUE 0x00149380 /* @ECU_Address@TIPAdapt_wait@0x0100D190@ */ ECIPP_ALIGNMENT_UWORD 66 Compu_TIPAdapt_wait 0 65.535 /end CHARACTERISTIC
/begin COMPU_METHOD Compu_TIPAdapt_wait " " RAT_FUNC "%.1" "sec" COEFFS 0 1000 0 0 0 1 /end COMPU_METHOD
/begin MEASUREMENT TIPAdapt_updating "Updating adaptive tbl{TIPAdapt_updating&0xff=0:Inactive: Disabled}{TIPAdapt_updating&0xff=1:Active}{TIPAdapt_updating&0xff=2:Inactive: RAM failed}{TIPAdapt_updating&0xff=3:Inactive: Deadzone}{TIPAdapt_updating&0xff=4:Inactive: Low mstr ECT}{TIPAdapt_updat" UBYTE TIPAdapt_updating_COMPU_VTAB 0 0 0 255 ECU_ADDRESS 0x0100D198 BIT_MASK 0xff /end MEASUREMENT
/begin COMPU_METHOD TIPAdapt_updating_COMPU_VTAB "Verbal Table" TAB_VERB "%.0" "list" COMPU_TAB_REF TIPAdapt_updating_COMPU_VTAB_REF /end COMPU_METHOD
/begin COMPU_VTAB TIPAdapt_updating_COMPU_VTAB_REF "Verbal Table" TAB_VERB 16 0 "Inactive: Disabled" 1 "Active" 2 "Inactive: RAM failed" 3 "Inactive: Deadzone" 4 "Inactive: Low mstr ECT" 5 "Inactive: Low slv ECT" 6 "Inactive: Hi mstr delta MAP" 7 "Inactive: Hi slv delta MAP" 8 "Inactive: Stabilizing" 9 "Inactive: Master ECM" 10 "Inactive: No comm msg" 11 "Inactive: Not running" 12 "Inactive: Mstr MAP range" 13 "Inactive: Slv MAP range" 14 "Inactive: Mstr RPM range" 15 "Inactive: Slv RPM range" DEFAULT_VALUE "UNKNOWN" /end COMPU_VTAB
/begin MEASUREMENT TIPAdapt_correction "TPS correction" SWORD Compu_TIPAdapt_correction 0 0 -100 99.9969482421875 ECU_ADDRESS 0x0100D1A0 /end MEASUREMENT
/begin COMPU_METHOD Compu_TIPAdapt_correction " " RAT_FUNC "%.1" "% TPS" COEFFS 0 327.68 0 0 0 1 /end COMPU_METHOD
/begin MEASUREMENT TIPAdapt_MAP_LPmstr "Master MAP low pass" UWORD Compu_TIPAdapt_MAP_LPmstr 0 0 0 255.99609375 ECU_ADDRESS 0x0100D1A8 /end MEASUREMENT
/begin COMPU_METHOD Compu_TIPAdapt_MAP_LPmstr " " RAT_FUNC "%.1" "psia" COEFFS 0 256 0 0 0 1 /end COMPU_METHOD
/begin MEASUREMENT TIPAdapt_MAP_LPslv "Slave MAP low pass" UWORD Compu_TIPAdapt_MAP_LPslv 0 0 0 255.99609375 ECU_ADDRESS 0x0100D1B0 /end MEASUREMENT
/begin COMPU_METHOD Compu_TIPAdapt_MAP_LPslv " " RAT_FUNC "%.1" "psia" COEFFS 0 256 0 0 0 1 /end COMPU_METHOD
/begin MEASUREMENT TIPAdapt_MAP_mstr "Master real MAP" UWORD Compu_TIPAdapt_MAP_mstr 0 0 0 255.99609375 ECU_ADDRESS 0x0100D1B8 /end MEASUREMENT
/begin COMPU_METHOD Compu_TIPAdapt_MAP_mstr " " RAT_FUNC "%.1" "psia" COEFFS 0 256 0 0 0 1 /end COMPU_METHOD
/begin MEASUREMENT TIPAdapt_MAP_slv "Slave real MAP" UWORD Compu_TIPAdapt_MAP_slv 0 0 0 255.99609375 ECU_ADDRESS 0x0100D1C0 /end MEASUREMENT
/begin COMPU_METHOD Compu_TIPAdapt_MAP_slv " " RAT_FUNC "%.1" "psia" COEFFS 0 256 0 0 0 1 /end COMPU_METHOD
/begin MEASUREMENT TIPAdapt_cmd_mstr "Master TPS command" UWORD Compu_TIPAdapt_cmd_mstr 0 0 0 99.9984741210938 ECU_ADDRESS 0x0100D1C8 /end MEASUREMENT
/begin COMPU_METHOD Compu_TIPAdapt_cmd_mstr " " RAT_FUNC "%.1" "% TPS" COEFFS 0 655.36 0 0 0 1 /end COMPU_METHOD
/begin MEASUREMENT TIPAdapt_cmd_slv "Slave TPS command" UWORD Compu_TIPAdapt_cmd_slv 0 0 0 99.9984741210938 ECU_ADDRESS 0x0100D1D0 /end MEASUREMENT
/begin COMPU_METHOD Compu_TIPAdapt_cmd_slv " " RAT_FUNC "%.1" "% TPS" COEFFS 0 655.36 0 0 0 1 /end COMPU_METHOD
/begin MEASUREMENT TIPAdapt_ECT_mstr "Master ECT" UWORD Compu_TIPAdapt_ECT_mstr 0 0 -460 563.984375 ECU_ADDRESS 0x0100D1D8 /end MEASUREMENT
/begin COMPU_METHOD Compu_TIPAdapt_ECT_mstr " " RAT_FUNC "%.1" "deg F" COEFFS 0 64 29440 0 0 1 /end COMPU_METHOD
/begin MEASUREMENT TIPAdapt_ECT_slv "Slave ECT" UWORD Compu_TIPAdapt_ECT_slv 0 0 -460 563.984375 ECU_ADDRESS 0x0100D1E0 /end MEASUREMENT
/begin COMPU_METHOD Compu_TIPAdapt_ECT_slv " " RAT_FUNC "%.1" "deg F" COEFFS 0 64 29440 0 0 1 /end COMPU_METHOD
/begin MEASUREMENT MAP_slow "MAP slow filtered" UWORD Compu_MAP_slow 0 0 0 255.99609375 ECU_ADDRESS 0x0100D1E8 /end MEASUREMENT
/begin COMPU_METHOD Compu_MAP_slow " " RAT_FUNC "%.1" "psia" COEFFS 0 256 0 0 0 1 /end COMPU_METHOD
/begin MEASUREMENT AUX_DIG23_raw "AUX_DIG23_raw" UWORD Compu_AUX_DIG23_raw 0 0 0 5.00114468864469 ECU_ADDRESS 0x0100D1F8 /end MEASUREMENT
/begin COMPU_METHOD Compu_AUX_DIG23_raw " " RAT_FUNC "%.3" "volts" COEFFS 0 13104 0 0 0 1 /end COMPU_METHOD
/begin MEASUREMENT AUX_DIG23_volt "AUX_DIG23_volt" UWORD Compu_AUX_DIG23_volt 0 0 0 255.99609375 ECU_ADDRESS 0x0100D200 /end MEASUREMENT
/begin COMPU_METHOD Compu_AUX_DIG23_volt " " RAT_FUNC "%.2" "volts" COEFFS 0 256 0 0 0 1 /end COMPU_METHOD
/begin MEASUREMENT AUX_DIG24_raw "AUX_DIG24_raw" UWORD Compu_AUX_DIG24_raw 0 0 0 5.00114468864469 ECU_ADDRESS 0x0100D210 /end MEASUREMENT
/begin COMPU_METHOD Compu_AUX_DIG24_raw " " RAT_FUNC "%.3" "volts" COEFFS 0 13104 0 0 0 1 /end COMPU_METHOD
/begin MEASUREMENT AUX_DIG24_volt "AUX_DIG24_volt" UWORD Compu_AUX_DIG24_volt 0 0 0 255.99609375 ECU_ADDRESS 0x0100D218 /end MEASUREMENT
/begin COMPU_METHOD Compu_AUX_DIG24_volt " " RAT_FUNC "%.2" "volts" COEFFS 0 256 0 0 0 1 /end COMPU_METHOD
/begin MEASUREMENT AUX_DIG25_raw "AUX_DIG25_raw" UWORD Compu_AUX_DIG25_raw 0 0 0 5.00114468864469 ECU_ADDRESS 0x0100D228 /end MEASUREMENT
/begin COMPU_METHOD Compu_AUX_DIG25_raw " " RAT_FUNC "%.3" "volts" COEFFS 0 13104 0 0 0 1 /end COMPU_METHOD
/begin MEASUREMENT AUX_DIG25_volt "AUX_DIG25_volt" UWORD Compu_AUX_DIG25_volt 0 0 0 255.99609375 ECU_ADDRESS 0x0100D230 /end MEASUREMENT
/begin COMPU_METHOD Compu_AUX_DIG25_volt " " RAT_FUNC "%.2" "volts" COEFFS 0 256 0 0 0 1 /end COMPU_METHOD
/begin MEASUREMENT TIPAdapt_cmd_final "Final TPS command" UWORD Compu_TIPAdapt_cmd_final 0 0 0 99.9984741210938 ECU_ADDRESS 0x0100D240 /end MEASUREMENT
/begin COMPU_METHOD Compu_TIPAdapt_cmd_final " " RAT_FUNC "%.1" "% TPS" COEFFS 0 655.36 0 0 0 1 /end COMPU_METHOD
/begin CHARACTERISTIC TIPAdapt_minMAP "TIP Adapt minimum MAP" VALUE 0x00149386 /* @ECU_Address@TIPAdapt_minMAP@0x0100D510@ */ ECIPP_ALIGNMENT_UWORD 256 Compu_TIPAdapt_minMAP 0 255.99609375 /end CHARACTERISTIC
/begin COMPU_METHOD Compu_TIPAdapt_minMAP " " RAT_FUNC "%.1" "psi" COEFFS 0 256 0 0 0 1 /end COMPU_METHOD
/begin CHARACTERISTIC TIPAdapt_maxMAP "TIP Adapt maximum MAP" VALUE 0x00149388 /* @ECU_Address@TIPAdapt_maxMAP@0x0100D518@ */ ECIPP_ALIGNMENT_UWORD 256 Compu_TIPAdapt_maxMAP 0 255.99609375 /end CHARACTERISTIC
/begin COMPU_METHOD Compu_TIPAdapt_maxMAP " " RAT_FUNC "%.1" "psi" COEFFS 0 256 0 0 0 1 /end COMPU_METHOD
/begin CHARACTERISTIC TIPAdapt_minRPM "TIP Adapt minimum RPM" VALUE 0x00149382 /* @ECU_Address@TIPAdapt_minRPM@0x0100D520@ */ ECIPP_ALIGNMENT_UWORD 65535 Compu_TIPAdapt_minRPM 0 65535 /end CHARACTERISTIC
/begin COMPU_METHOD Compu_TIPAdapt_minRPM " " RAT_FUNC "%.0" "rpm" COEFFS 0 1 0 0 0 1 /end COMPU_METHOD
/begin CHARACTERISTIC TIPAdapt_maxRPM "TIP Adapt maximum RPM" VALUE 0x00149384 /* @ECU_Address@TIPAdapt_maxRPM@0x0100D528@ */ ECIPP_ALIGNMENT_UWORD 65535 Compu_TIPAdapt_maxRPM 0 65535 /end CHARACTERISTIC
/begin COMPU_METHOD Compu_TIPAdapt_maxRPM " " RAT_FUNC "%.0" "rpm" COEFFS 0 1 0 0 0 1 /end COMPU_METHOD
/begin MEASUREMENT TIPAdapt_tblcorrect "TIP Adapt table delta correction" SWORD Compu_TIPAdapt_tblcorrect 0 0 -100 99.9969482421875 ECU_ADDRESS 0x0100D530 /end MEASUREMENT
/begin COMPU_METHOD Compu_TIPAdapt_tblcorrect " " RAT_FUNC "%.1" "% TPS" COEFFS 0 327.68 0 0 0 1 /end COMPU_METHOD
/begin MEASUREMENT TIPAdapt_MAPerror "TIP Adapt MAP error" SWORD Compu_TIPAdapt_MAPerror 0 0 -128 127.99609375 ECU_ADDRESS 0x0100D538 /end MEASUREMENT
/begin COMPU_METHOD Compu_TIPAdapt_MAPerror " " RAT_FUNC "%.1" "psi" COEFFS 0 256 0 0 0 1 /end COMPU_METHOD
/begin MEASUREMENT TIPAdapt_TIP_mstr "TIP Adapt master TIP" UWORD Compu_TIPAdapt_TIP_mstr 0 0 0 255.99609375 ECU_ADDRESS 0x0100D650 /end MEASUREMENT
/begin COMPU_METHOD Compu_TIPAdapt_TIP_mstr " " RAT_FUNC "%.1" "psi" COEFFS 0 256 0 0 0 1 /end COMPU_METHOD
/begin MEASUREMENT TIPAdapt_TIP_slv "TIP Adapt slave TIP" UWORD Compu_TIPAdapt_TIP_slv 0 0 0 255.99609375 ECU_ADDRESS 0x0100D658 /end MEASUREMENT
/begin COMPU_METHOD Compu_TIPAdapt_TIP_slv " " RAT_FUNC "%.1" "psi" COEFFS 0 256 0 0 0 1 /end COMPU_METHOD
/begin MEASUREMENT TIPAdapt_TIPcorrect "TIP Adapt TIP correction" SWORD Compu_TIPAdapt_TIPcorrect 0 0 -100 99.9969482421875 ECU_ADDRESS 0x0100D660 /end MEASUREMENT
/begin COMPU_METHOD Compu_TIPAdapt_TIPcorrect " " RAT_FUNC "%.1" "TIP %" COEFFS 0 327.68 0 0 0 1 /end COMPU_METHOD
/begin MEASUREMENT VSFan_rpm "Fan speed" UWORD Compu_VSFan_rpm 0 0 0 65535 ECU_ADDRESS 0x0100D708 /end MEASUREMENT
/begin COMPU_METHOD Compu_VSFan_rpm " " RAT_FUNC "%.0" "rpm" COEFFS 0 1 0 0 0 1 /end COMPU_METHOD
/begin MEASUREMENT VSFan_pcta "Fan max actual" UWORD Compu_VSFan_pcta 0 0 0 399.993896484375 ECU_ADDRESS 0x0100D710 /end MEASUREMENT
/begin COMPU_METHOD Compu_VSFan_pcta " " RAT_FUNC "%.1" "%" COEFFS 0 163.84 0 0 0 1 /end COMPU_METHOD
/begin MEASUREMENT VSFan_pctd "Fan max target" UWORD Compu_VSFan_pctd 0 0 0 99.9984741210938 ECU_ADDRESS 0x0100D718 /end MEASUREMENT
/begin COMPU_METHOD Compu_VSFan_pctd " " RAT_FUNC "%.1" "%" COEFFS 0 655.36 0 0 0 1 /end COMPU_METHOD
/begin MEASUREMENT VSFan_ld_slew "Ramp rate limited engine load" SWORD Compu_VSFan_ld_slew 0 0 -100 99.9969482421875 ECU_ADDRESS 0x0100D720 /end MEASUREMENT
/begin COMPU_METHOD Compu_VSFan_ld_slew " " RAT_FUNC "%.1" "%" COEFFS 0 327.68 0 0 0 1 /end COMPU_METHOD
/begin MEASUREMENT VSFan_DC "Fan PWM output" UWORD Compu_VSFan_DC 0 0 0 99.9984741210938 ECU_ADDRESS 0x0100D728 /end MEASUREMENT
/begin COMPU_METHOD Compu_VSFan_DC " " RAT_FUNC "%.1" "% DC" COEFFS 0 655.36 0 0 0 1 /end COMPU_METHOD
/begin MEASUREMENT AC_ctl_state "AC control state{AC_ctl_state&0xff=0:AC OFF}{AC_ctl_state&0xff=1:AC ON}{AC_ctl_state&0xff=2:AC OFF - Boost TEI}{AC_ctl_state&0xff=3:AC OFF - Min Timer}" UBYTE AC_ctl_state_COMPU_VTAB 0 0 0 255 ECU_ADDRESS 0x0100D758 BIT_MASK 0xff /end MEASUREMENT
/begin COMPU_METHOD AC_ctl_state_COMPU_VTAB "Verbal Table" TAB_VERB "%.0" "list" COMPU_TAB_REF AC_ctl_state_COMPU_VTAB_REF /end COMPU_METHOD
/begin COMPU_VTAB AC_ctl_state_COMPU_VTAB_REF "Verbal Table" TAB_VERB 4 0 "AC OFF" 1 "AC ON" 2 "AC OFF - Boost TEI" 3 "AC OFF - Min Timer" DEFAULT_VALUE "UNKNOWN" /end COMPU_VTAB
/begin MEASUREMENT crank_trans_lim_tmr "Start signal continuously active" UWORD Compu_crank_trans_lim_tmr 0 0 0 65.535 ECU_ADDRESS 0x0100D8C0 /end MEASUREMENT
/begin COMPU_METHOD Compu_crank_trans_lim_tmr " " RAT_FUNC "%.1" "sec" COEFFS 0 1000 0 0 0 1 /end COMPU_METHOD
/begin MEASUREMENT crank_trans_lim_actv "Trans in-gear override limit active" UBYTE Compu_crank_trans_lim_actv 0 0 0 255 ECU_ADDRESS 0x0100D8C8 /end MEASUREMENT
/begin COMPU_METHOD Compu_crank_trans_lim_actv " " RAT_FUNC "%.0" "-" COEFFS 0 1 0 0 0 1 /end COMPU_METHOD
/begin CHARACTERISTIC TIPAdapt_gain_pct "Adaptive gain" VALUE 0x00149370 /* @ECU_Address@TIPAdapt_gain_pct@0x0100D8D8@ */ ECIPP_ALIGNMENT_FLOAT32_IEEE 10000000000 Compu_TIPAdapt_gain_pct -10000000000 10000000000 /end CHARACTERISTIC
/begin COMPU_METHOD Compu_TIPAdapt_gain_pct " " RAT_FUNC "%.2" "% TPS/psi/sec" COEFFS 0 0.01 0 0 0 1 /end COMPU_METHOD
/begin CHARACTERISTIC alphaN_ena "alpha-N MAP estimation mode{alphaN_ena&0xff=0:Disabled}{alphaN_ena&0xff=1:Compute MAP estimate only}{alphaN_ena&0xff=2:Use as MAP estimate}" VALUE 0x001480f3 /* @ECU_Address@alphaN_ena@0x0100D8F0@ */ ECIPP_ALIGNMENT_UBYTE 255 alphaN_ena_COMPU_VTAB 0 255 BIT_MASK 0xff /end CHARACTERISTIC
/begin COMPU_METHOD alphaN_ena_COMPU_VTAB "Verbal Table" TAB_VERB "%.0" "list" COMPU_TAB_REF alphaN_ena_COMPU_VTAB_REF /end COMPU_METHOD
/begin COMPU_VTAB alphaN_ena_COMPU_VTAB_REF "Verbal Table" TAB_VERB 3 0 "Disabled" 1 "Compute MAP estimate only" 2 "Use as MAP estimate" DEFAULT_VALUE "UNKNOWN" /end COMPU_VTAB
/begin MEASUREMENT alphaN_MAPf "alpha-N MAP estimate" FLOAT32_IEEE Compu_alphaN_MAPf 0 0 -10000000000 10000000000 ECU_ADDRESS 0x0100D8F8 /end MEASUREMENT
/begin COMPU_METHOD Compu_alphaN_MAPf " " RAT_FUNC "%.2" "psia" COEFFS 0 1 0 0 0 1 /end COMPU_METHOD
/begin MEASUREMENT alphaN_interp "alpha-N 4-D table interpolation" SWORD Compu_alphaN_interp 0 0 -200 199.993896484375 ECU_ADDRESS 0x0100D900 /end MEASUREMENT
/begin COMPU_METHOD Compu_alphaN_interp " " RAT_FUNC "%.1" "%" COEFFS 0 163.84 0 0 0 1 /end COMPU_METHOD
/begin MEASUREMENT J1939_ABS_active "ABS Active{J1939_ABS_active&0xff=0:No}{J1939_ABS_active&0xff=1:Yes}" UBYTE J1939_ABS_active_COMPU_VTAB 0 0 0 255 ECU_ADDRESS 0x0100DB38 BIT_MASK 0xff /end MEASUREMENT
/begin COMPU_METHOD J1939_ABS_active_COMPU_VTAB "Verbal Table" TAB_VERB "%.0" "list" COMPU_TAB_REF J1939_ABS_active_COMPU_VTAB_REF /end COMPU_METHOD
/begin COMPU_VTAB J1939_ABS_active_COMPU_VTAB_REF "Verbal Table" TAB_VERB 2 0 "No" 1 "Yes" DEFAULT_VALUE "UNKNOWN" /end COMPU_VTAB
/begin CHARACTERISTIC ecm_multi_RELAY_wait "Multi-ECM relay wait for slave{ecm_multi_RELAY_wait&0xff=0:NO}{ecm_multi_RELAY_wait&0xff=1:YES}" VALUE 0x00148155 /* @ECU_Address@ecm_multi_RELAY_wait@0x0100E758@ */ ECIPP_ALIGNMENT_UBYTE 255 ecm_multi_RELAY_wait_COMPU_VTAB 0 255 BIT_MASK 0xff /end CHARACTERISTIC
/begin COMPU_METHOD ecm_multi_RELAY_wait_COMPU_VTAB "Verbal Table" TAB_VERB "%.0" "list" COMPU_TAB_REF ecm_multi_RELAY_wait_COMPU_VTAB_REF /end COMPU_METHOD
/begin COMPU_VTAB ecm_multi_RELAY_wait_COMPU_VTAB_REF "Verbal Table" TAB_VERB 2 0 "NO" 1 "YES" DEFAULT_VALUE "UNKNOWN" /end COMPU_VTAB
/begin MEASUREMENT AUX_PWM1_iFB_raw "AUX_PWM1_iFB_raw" UWORD Compu_AUX_PWM1_iFB_raw 0 0 0 5.00114468864469 ECU_ADDRESS 0x010100C8 /end MEASUREMENT
/begin COMPU_METHOD Compu_AUX_PWM1_iFB_raw " " RAT_FUNC "%.3" "volts" COEFFS 0 13104 0 0 0 1 /end COMPU_METHOD
/begin MEASUREMENT AUX_PWM2_iFB_raw "AUX_PWM2_iFB_raw" UWORD Compu_AUX_PWM2_iFB_raw 0 0 0 5.00114468864469 ECU_ADDRESS 0x010100D0 /end MEASUREMENT
/begin COMPU_METHOD Compu_AUX_PWM2_iFB_raw " " RAT_FUNC "%.3" "volts" COEFFS 0 13104 0 0 0 1 /end COMPU_METHOD
/begin MEASUREMENT AUX_PWM3_iFB_raw "AUX_PWM3_iFB_raw" UWORD Compu_AUX_PWM3_iFB_raw 0 0 0 5.00114468864469 ECU_ADDRESS 0x010100D8 /end MEASUREMENT
/begin COMPU_METHOD Compu_AUX_PWM3_iFB_raw " " RAT_FUNC "%.3" "volts" COEFFS 0 13104 0 0 0 1 /end COMPU_METHOD
/begin MEASUREMENT AUX_PWM4_iFB_raw "AUX_PWM4_iFB_raw" UWORD Compu_AUX_PWM4_iFB_raw 0 0 0 5.00114468864469 ECU_ADDRESS 0x010100E0 /end MEASUREMENT
/begin COMPU_METHOD Compu_AUX_PWM4_iFB_raw " " RAT_FUNC "%.3" "volts" COEFFS 0 13104 0 0 0 1 /end COMPU_METHOD
/begin MEASUREMENT AUX_PWM5_iFB_raw "AUX_PWM5_iFB_raw" UWORD Compu_AUX_PWM5_iFB_raw 0 0 0 5.00114468864469 ECU_ADDRESS 0x010100E8 /end MEASUREMENT
/begin COMPU_METHOD Compu_AUX_PWM5_iFB_raw " " RAT_FUNC "%.3" "volts" COEFFS 0 13104 0 0 0 1 /end COMPU_METHOD
/begin MEASUREMENT AUX_PWM6_iFB_raw "AUX_PWM6_iFB_raw" UWORD Compu_AUX_PWM6_iFB_raw 0 0 0 5.00114468864469 ECU_ADDRESS 0x010100F0 /end MEASUREMENT
/begin COMPU_METHOD Compu_AUX_PWM6_iFB_raw " " RAT_FUNC "%.3" "volts" COEFFS 0 13104 0 0 0 1 /end COMPU_METHOD
/begin MEASUREMENT AUX_PWM8_iFB_raw "AUX_PWM8_iFB_raw" UWORD Compu_AUX_PWM8_iFB_raw 0 0 0 5.00114468864469 ECU_ADDRESS 0x010100F8 /end MEASUREMENT
/begin COMPU_METHOD Compu_AUX_PWM8_iFB_raw " " RAT_FUNC "%.3" "volts" COEFFS 0 13104 0 0 0 1 /end COMPU_METHOD
/begin MEASUREMENT AUX_PWM9_iFB_raw "AUX_PWM9_iFB_raw" UWORD Compu_AUX_PWM9_iFB_raw 0 0 0 5.00114468864469 ECU_ADDRESS 0x01010100 /end MEASUREMENT
/begin COMPU_METHOD Compu_AUX_PWM9_iFB_raw " " RAT_FUNC "%.3" "volts" COEFFS 0 13104 0 0 0 1 /end COMPU_METHOD
/begin MEASUREMENT AUX_PWM7_iFB_raw "AUX_PWM7_iFB_raw" UWORD Compu_AUX_PWM7_iFB_raw 0 0 0 5.00114468864469 ECU_ADDRESS 0x01010170 /end MEASUREMENT
/begin COMPU_METHOD Compu_AUX_PWM7_iFB_raw " " RAT_FUNC "%.3" "volts" COEFFS 0 13104 0 0 0 1 /end COMPU_METHOD
/begin MEASUREMENT AUX_PWM10_iFB_raw "AUX_PWM10_iFB_raw" UWORD Compu_AUX_PWM10_iFB_raw 0 0 0 5.00114468864469 ECU_ADDRESS 0x01010178 /end MEASUREMENT
/begin COMPU_METHOD Compu_AUX_PWM10_iFB_raw " " RAT_FUNC "%.3" "volts" COEFFS 0 13104 0 0 0 1 /end COMPU_METHOD
/begin MEASUREMENT AUX_PWM11_iFB_raw "AUX_PWM11_iFB_raw" UWORD Compu_AUX_PWM11_iFB_raw 0 0 0 5.00114468864469 ECU_ADDRESS 0x01010180 /end MEASUREMENT
/begin COMPU_METHOD Compu_AUX_PWM11_iFB_raw " " RAT_FUNC "%.3" "volts" COEFFS 0 13104 0 0 0 1 /end COMPU_METHOD
/begin MEASUREMENT AUX_PWM12_iFB_raw "AUX_PWM12_iFB_raw" UWORD Compu_AUX_PWM12_iFB_raw 0 0 0 5.00114468864469 ECU_ADDRESS 0x01010188 /end MEASUREMENT
/begin COMPU_METHOD Compu_AUX_PWM12_iFB_raw " " RAT_FUNC "%.3" "volts" COEFFS 0 13104 0 0 0 1 /end COMPU_METHOD
/begin MEASUREMENT AUX_PWM13_iFB_raw "AUX_PWM13_iFB_raw" UWORD Compu_AUX_PWM13_iFB_raw 0 0 0 5.00114468864469 ECU_ADDRESS 0x01010190 /end MEASUREMENT
/begin COMPU_METHOD Compu_AUX_PWM13_iFB_raw " " RAT_FUNC "%.3" "volts" COEFFS 0 13104 0 0 0 1 /end COMPU_METHOD
/begin MEASUREMENT AUX_PWM14_iFB_raw "AUX_PWM14_iFB_raw" UWORD Compu_AUX_PWM14_iFB_raw 0 0 0 5.00114468864469 ECU_ADDRESS 0x01010198 /end MEASUREMENT
/begin COMPU_METHOD Compu_AUX_PWM14_iFB_raw " " RAT_FUNC "%.3" "volts" COEFFS 0 13104 0 0 0 1 /end COMPU_METHOD
/begin MEASUREMENT AUX_PWM15_iFB_raw "AUX_PWM15_iFB_raw" UWORD Compu_AUX_PWM15_iFB_raw 0 0 0 5.00114468864469 ECU_ADDRESS 0x010101A0 /end MEASUREMENT
/begin COMPU_METHOD Compu_AUX_PWM15_iFB_raw " " RAT_FUNC "%.3" "volts" COEFFS 0 13104 0 0 0 1 /end COMPU_METHOD
/begin MEASUREMENT AUX_PWM16_iFB_raw "AUX_PWM16_iFB_raw" UWORD Compu_AUX_PWM16_iFB_raw 0 0 0 5.00114468864469 ECU_ADDRESS 0x010101A8 /end MEASUREMENT
/begin COMPU_METHOD Compu_AUX_PWM16_iFB_raw " " RAT_FUNC "%.3" "volts" COEFFS 0 13104 0 0 0 1 /end COMPU_METHOD
/begin MEASUREMENT AUX_PWM17_iFB_raw "AUX_PWM17_iFB_raw" UWORD Compu_AUX_PWM17_iFB_raw 0 0 0 5.00114468864469 ECU_ADDRESS 0x010101B0 /end MEASUREMENT
/begin COMPU_METHOD Compu_AUX_PWM17_iFB_raw " " RAT_FUNC "%.3" "volts" COEFFS 0 13104 0 0 0 1 /end COMPU_METHOD
/begin MEASUREMENT AUX_PWM18_iFB_raw "AUX_PWM18_iFB_raw" UWORD Compu_AUX_PWM18_iFB_raw 0 0 0 5.00114468864469 ECU_ADDRESS 0x010101B8 /end MEASUREMENT
/begin COMPU_METHOD Compu_AUX_PWM18_iFB_raw " " RAT_FUNC "%.3" "volts" COEFFS 0 13104 0 0 0 1 /end COMPU_METHOD
/begin MEASUREMENT AUX_PWM19_iFB_raw "AUX_PWM19_iFB_raw" UWORD Compu_AUX_PWM19_iFB_raw 0 0 0 5.00114468864469 ECU_ADDRESS 0x010101C0 /end MEASUREMENT
/begin COMPU_METHOD Compu_AUX_PWM19_iFB_raw " " RAT_FUNC "%.3" "volts" COEFFS 0 13104 0 0 0 1 /end COMPU_METHOD
/begin MEASUREMENT AUX_PWM20_iFB_raw "AUX_PWM20_iFB_raw" UWORD Compu_AUX_PWM20_iFB_raw 0 0 0 5.00114468864469 ECU_ADDRESS 0x010101C8 /end MEASUREMENT
/begin COMPU_METHOD Compu_AUX_PWM20_iFB_raw " " RAT_FUNC "%.3" "volts" COEFFS 0 13104 0 0 0 1 /end COMPU_METHOD
/begin MEASUREMENT AUX_PWM21_iFB_raw "AUX_PWM21_iFB_raw" UWORD Compu_AUX_PWM21_iFB_raw 0 0 0 5.00114468864469 ECU_ADDRESS 0x010101D0 /end MEASUREMENT
/begin COMPU_METHOD Compu_AUX_PWM21_iFB_raw " " RAT_FUNC "%.3" "volts" COEFFS 0 13104 0 0 0 1 /end COMPU_METHOD
/begin MEASUREMENT AUX_PWM22_iFB_raw "AUX_PWM22_iFB_raw" UWORD Compu_AUX_PWM22_iFB_raw 0 0 0 5.00114468864469 ECU_ADDRESS 0x010101D8 /end MEASUREMENT
/begin COMPU_METHOD Compu_AUX_PWM22_iFB_raw " " RAT_FUNC "%.3" "volts" COEFFS 0 13104 0 0 0 1 /end COMPU_METHOD
/begin MEASUREMENT AUX_PWM23_iFB_raw "AUX_PWM23_iFB_raw" UWORD Compu_AUX_PWM23_iFB_raw 0 0 0 5.00114468864469 ECU_ADDRESS 0x010101E0 /end MEASUREMENT
/begin COMPU_METHOD Compu_AUX_PWM23_iFB_raw " " RAT_FUNC "%.3" "volts" COEFFS 0 13104 0 0 0 1 /end COMPU_METHOD
/begin MEASUREMENT VE5a "Primary 5V external" UWORD Compu_VE5a 0 0 0 255.99609375 ECU_ADDRESS 0x01010318 /end MEASUREMENT
/begin COMPU_METHOD Compu_VE5a " " RAT_FUNC "%.1" "volts" COEFFS 0 256 0 0 0 1 /end COMPU_METHOD
/begin MEASUREMENT VE5b "Secondary 5V external" UWORD Compu_VE5b 0 0 0 255.99609375 ECU_ADDRESS 0x01010320 /end MEASUREMENT
/begin COMPU_METHOD Compu_VE5b " " RAT_FUNC "%.1" "volts" COEFFS 0 256 0 0 0 1 /end COMPU_METHOD
/begin MEASUREMENT VE5c "Tertiary 5V external" UWORD Compu_VE5c 0 0 0 255.99609375 ECU_ADDRESS 0x01010328 /end MEASUREMENT
/begin COMPU_METHOD Compu_VE5c " " RAT_FUNC "%.1" "volts" COEFFS 0 256 0 0 0 1 /end COMPU_METHOD
/begin MEASUREMENT Vrelay "Vrelay" UWORD Compu_Vrelay 0 0 0 255.99609375 ECU_ADDRESS 0x01011C30 /end MEASUREMENT
/begin COMPU_METHOD Compu_Vrelay " " RAT_FUNC "%.1" "volts" COEFFS 0 256 0 0 0 1 /end COMPU_METHOD
/begin MEASUREMENT KNK3H_raw "KNK3H_raw" UWORD Compu_KNK3H_raw 0 0 0 5.00114468864469 ECU_ADDRESS 0x01011F90 /end MEASUREMENT
/begin COMPU_METHOD Compu_KNK3H_raw " " RAT_FUNC "%.3" "volts" COEFFS 0 13104 0 0 0 1 /end COMPU_METHOD
/begin MEASUREMENT KNK3L_raw "KNK3L_raw" UWORD Compu_KNK3L_raw 0 0 0 5.00114468864469 ECU_ADDRESS 0x01011F98 /end MEASUREMENT
/begin COMPU_METHOD Compu_KNK3L_raw " " RAT_FUNC "%.3" "volts" COEFFS 0 13104 0 0 0 1 /end COMPU_METHOD
/begin MEASUREMENT T_internal_raw "T_internal_raw" UWORD Compu_T_internal_raw 0 0 0 5.00114468864469 ECU_ADDRESS 0x01011FA8 /end MEASUREMENT
/begin COMPU_METHOD Compu_T_internal_raw " " RAT_FUNC "%.3" "volts" COEFFS 0 13104 0 0 0 1 /end COMPU_METHOD
/begin MEASUREMENT VSFan_rpmd "Fan speed target" UWORD Compu_VSFan_rpmd 0 0 0 65535 ECU_ADDRESS 0x01012648 /end MEASUREMENT
/begin COMPU_METHOD Compu_VSFan_rpmd " " RAT_FUNC "%.0" "rpm" COEFFS 0 1 0 0 0 1 /end COMPU_METHOD
/begin MEASUREMENT VSFan_rpm_Iacc "Fan speed feedback integrator" SWORD Compu_VSFan_rpm_Iacc 0 0 -800 799.9755859375 ECU_ADDRESS 0x01012650 /end MEASUREMENT
/begin COMPU_METHOD Compu_VSFan_rpm_Iacc " " RAT_FUNC "%.1" "%" COEFFS 0 40.96 0 0 0 1 /end COMPU_METHOD
/begin MEASUREMENT VSFan_rpm_dot "Fan speed derivative (drpm/dt)" SWORD Compu_VSFan_rpm_dot 0 0 -64 63.998046875 ECU_ADDRESS 0x01012658 /end MEASUREMENT
/begin COMPU_METHOD Compu_VSFan_rpm_dot " " RAT_FUNC "%.1" "rpm/ms" COEFFS 0 512 0 0 0 1 /end COMPU_METHOD
/begin MEASUREMENT RMT_AAT "J1939 AMB AAT" UWORD Compu_RMT_AAT 0 0 -460 563.984375 ECU_ADDRESS 0x01012688 /end MEASUREMENT
/begin COMPU_METHOD Compu_RMT_AAT " " RAT_FUNC "%.1" "deg F" COEFFS 0 64 29440 0 0 1 /end COMPU_METHOD
/begin MEASUREMENT RBC_allowed "Retarder braking allowed{RBC_allowed&0xff=0:NO}{RBC_allowed&0xff=1:YES}" UBYTE RBC_allowed_COMPU_VTAB 0 0 0 255 ECU_ADDRESS 0x01012A20 BIT_MASK 0xff /end MEASUREMENT
/begin COMPU_METHOD RBC_allowed_COMPU_VTAB "Verbal Table" TAB_VERB "%.0" "list" COMPU_TAB_REF RBC_allowed_COMPU_VTAB_REF /end COMPU_METHOD
/begin COMPU_VTAB RBC_allowed_COMPU_VTAB_REF "Verbal Table" TAB_VERB 2 0 "NO" 1 "YES" DEFAULT_VALUE "UNKNOWN" /end COMPU_VTAB
/begin MEASUREMENT AWP_status "AWP controller status{AWP_status&0xff=0:Normal operation}{AWP_status&0xff=1:Unable to start}{AWP_status&0xff=2:High voltage shutdown}{AWP_status&0xff=3:Low voltage shutdown}{AWP_status&0xff=4:High temp shutdown}{AWP_status&0xff=5:Current limit derate}{AWP" UBYTE AWP_status_COMPU_VTAB 0 0 0 255 ECU_ADDRESS 0x01012BA8 BIT_MASK 0xff /end MEASUREMENT
/begin COMPU_METHOD AWP_status_COMPU_VTAB "Verbal Table" TAB_VERB "%.0" "list" COMPU_TAB_REF AWP_status_COMPU_VTAB_REF /end COMPU_METHOD
/begin COMPU_VTAB AWP_status_COMPU_VTAB_REF "Verbal Table" TAB_VERB 17 0 "Normal operation" 1 "Unable to start" 2 "High voltage shutdown" 3 "Low voltage shutdown" 4 "High temp shutdown" 5 "Current limit derate" 6 "System limit derate" 7 "Torque limit derate" 8 "High temp derate" 9 "Overspeed" 10 "Not available" 11 "Offline" 12 "Open circuit" 13 "Short circuit" 14 "OVC problem" 15 "Dry run" 16 "Power hold failure" DEFAULT_VALUE "UNKNOWN" /end COMPU_VTAB
/begin MEASUREMENT J1939_AWP_rpma "AWP motor actual speed" UWORD Compu_J1939_AWP_rpma 0 0 0 65535 ECU_ADDRESS 0x01012BB0 /end MEASUREMENT
/begin COMPU_METHOD Compu_J1939_AWP_rpma " " RAT_FUNC "%.0" "rpm" COEFFS 0 1 0 0 0 1 /end COMPU_METHOD
/begin MEASUREMENT AWP_motor_status "AWP motor status{AWP_motor_status&0x03=0:Motor off}{AWP_motor_status&0x03=1:Motor on - forward}{AWP_motor_status&0x03=2:Motor on - reverse}{AWP_motor_status&0x03=3:Not available}" UBYTE AWP_motor_status_COMPU_VTAB 0 0 0 255 ECU_ADDRESS 0x01012BB8 BIT_MASK 0x03 /end MEASUREMENT
/begin COMPU_METHOD AWP_motor_status_COMPU_VTAB "Verbal Table" TAB_VERB "%.0" "list" COMPU_TAB_REF AWP_motor_status_COMPU_VTAB_REF /end COMPU_METHOD
/begin COMPU_VTAB AWP_motor_status_COMPU_VTAB_REF "Verbal Table" TAB_VERB 4 0 "Motor off" 1 "Motor on - forward" 2 "Motor on - reverse" 3 "Not available" DEFAULT_VALUE "UNKNOWN" /end COMPU_VTAB
/begin MEASUREMENT AWP_ctl_state "AWP control state{AWP_ctl_state&0xff=0:Disabled}{AWP_ctl_state&0xff=1:Inactive: ECT low}{AWP_ctl_state&0xff=2:Inactive: key-off}{AWP_ctl_state&0xff=3:Active: motor off}{AWP_ctl_state&0xff=4:Active: motor on}{AWP_ctl_state&0xff=5:Active: power hold on}" UBYTE AWP_ctl_state_COMPU_VTAB 0 0 0 255 ECU_ADDRESS 0x01012C08 BIT_MASK 0xff /end MEASUREMENT
/begin COMPU_METHOD AWP_ctl_state_COMPU_VTAB "Verbal Table" TAB_VERB "%.0" "list" COMPU_TAB_REF AWP_ctl_state_COMPU_VTAB_REF /end COMPU_METHOD
/begin COMPU_VTAB AWP_ctl_state_COMPU_VTAB_REF "Verbal Table" TAB_VERB 6 0 "Disabled" 1 "Inactive: ECT low" 2 "Inactive: key-off" 3 "Active: motor off" 4 "Active: motor on" 5 "Active: power hold on" DEFAULT_VALUE "UNKNOWN" /end COMPU_VTAB
/begin MEASUREMENT VSFan_pwr "Fan power consumption" UWORD Compu_VSFan_pwr 0 0 0 4095.9375 ECU_ADDRESS 0x01012C10 /end MEASUREMENT
/begin COMPU_METHOD Compu_VSFan_pwr " " RAT_FUNC "%.1" "kW" COEFFS 0 16 0 0 0 1 /end COMPU_METHOD
/begin MEASUREMENT AGS_req1 "Current grille #1 position" UWORD Compu_AGS_req1 0 0 0 99.9984741210938 ECU_ADDRESS 0x010133F0 /end MEASUREMENT
/begin COMPU_METHOD Compu_AGS_req1 " " RAT_FUNC "%.1" "%" COEFFS 0 655.36 0 0 0 1 /end COMPU_METHOD
/begin MEASUREMENT ECWP_idle_tmr "ECWP time at idle" ULONG Compu_ECWP_idle_tmr 0 0 0 4294967.295 ECU_ADDRESS 0x01013420 /end MEASUREMENT
/begin COMPU_METHOD Compu_ECWP_idle_tmr " " RAT_FUNC "%.1" "sec" COEFFS 0 1000 0 0 0 1 /end COMPU_METHOD
/begin MEASUREMENT ECWP_temp_tmr "ECWP temp validation timer" UWORD Compu_ECWP_temp_tmr 0 0 0 65.535 ECU_ADDRESS 0x01013448 /end MEASUREMENT
/begin COMPU_METHOD Compu_ECWP_temp_tmr " " RAT_FUNC "%.1" "sec" COEFFS 0 1000 0 0 0 1 /end COMPU_METHOD
/begin MEASUREMENT ERCV_state "ERCV state{ERCV_state&0xff=0x00:Disabled}{ERCV_state&0xff=0x10:Off}{ERCV_state&0xff=0x23:Initialize}{ERCV_state&0xff=0x30:Ready}{ERCV_state&0xff=0x43:Run}{ERCV_state&0xff=0x51:Stop}{ERCV_state&0xff=0x63:Sleep}" UBYTE ERCV_state_COMPU_VTAB 0 0 0 255 ECU_ADDRESS 0x01013648 BIT_MASK 0xff /end MEASUREMENT
/begin COMPU_METHOD ERCV_state_COMPU_VTAB "Verbal Table" TAB_VERB "%.0" "list" COMPU_TAB_REF ERCV_state_COMPU_VTAB_REF /end COMPU_METHOD
/begin COMPU_VTAB ERCV_state_COMPU_VTAB_REF "Verbal Table" TAB_VERB 7 0x00 "Disabled" 0x10 "Off" 0x23 "Initialize" 0x30 "Ready" 0x43 "Run" 0x51 "Stop" 0x63 "Sleep" DEFAULT_VALUE "UNKNOWN" /end COMPU_VTAB
/begin MEASUREMENT ERCV_speed_freq "ERCV speed input frequency" FLOAT32_IEEE Compu_ERCV_speed_freq 0 0 -10000000000 10000000000 ECU_ADDRESS 0x01013650 /end MEASUREMENT
/begin COMPU_METHOD Compu_ERCV_speed_freq " " RAT_FUNC "%.1" "Hz" COEFFS 0 1 0 0 0 1 /end COMPU_METHOD
/begin MEASUREMENT J1939_retard_actv "J1939 retarder disposition{J1939_retard_actv&0xff=0:Not Received}{J1939_retard_actv&0xff=1:Inactive}{J1939_retard_actv&0xff=2:SPN 520 Negative Torque}{J1939_retard_actv&0xff=3:SPN 1715 Negative Torque}{J1939_retard_actv&0xff=4:SPN 900 Active}" UBYTE J1939_retard_actv_COMPU_VTAB 0 0 0 255 ECU_ADDRESS 0x010136E8 BIT_MASK 0xff /end MEASUREMENT
/begin COMPU_METHOD J1939_retard_actv_COMPU_VTAB "Verbal Table" TAB_VERB "%.0" "list" COMPU_TAB_REF J1939_retard_actv_COMPU_VTAB_REF /end COMPU_METHOD
/begin COMPU_VTAB J1939_retard_actv_COMPU_VTAB_REF "Verbal Table" TAB_VERB 5 0 "Not Received" 1 "Inactive" 2 "SPN 520 Negative Torque" 3 "SPN 1715 Negative Torque" 4 "SPN 900 Active" DEFAULT_VALUE "UNKNOWN" /end COMPU_VTAB
/begin MEASUREMENT CCT "Crankcase temperature" UWORD Compu_CCT 0 0 -460 563.984375 ECU_ADDRESS 0x01013708 /end MEASUREMENT
/begin COMPU_METHOD Compu_CCT " " RAT_FUNC "%.1" "deg F" COEFFS 0 64 29440 0 0 1 /end COMPU_METHOD
/begin MEASUREMENT CCH_state "Crankcase heater state{CCH_state&0xff=0:Disabled}{CCH_state&0xff=1:Inactive: engine stopped}{CCH_state&0xff=2:Monitoring CCT}{CCH_state&0xff=3:CCT fault: warming}{CCH_state&0xff=4:CCT fault: idle}" UBYTE CCH_state_COMPU_VTAB 0 0 0 255 ECU_ADDRESS 0x01013758 BIT_MASK 0xff /end MEASUREMENT
/begin COMPU_METHOD CCH_state_COMPU_VTAB "Verbal Table" TAB_VERB "%.0" "list" COMPU_TAB_REF CCH_state_COMPU_VTAB_REF /end COMPU_METHOD
/begin COMPU_VTAB CCH_state_COMPU_VTAB_REF "Verbal Table" TAB_VERB 5 0 "Disabled" 1 "Inactive: engine stopped" 2 "Monitoring CCT" 3 "CCT fault: warming" 4 "CCT fault: idle" DEFAULT_VALUE "UNKNOWN" /end COMPU_VTAB
/begin MEASUREMENT CCH_active "Crankcase heater active{CCH_active&0xff=0:NO}{CCH_active&0xff=1:YES}" UBYTE CCH_active_COMPU_VTAB 0 0 0 255 ECU_ADDRESS 0x01013760 BIT_MASK 0xff /end MEASUREMENT
/begin COMPU_METHOD CCH_active_COMPU_VTAB "Verbal Table" TAB_VERB "%.0" "list" COMPU_TAB_REF CCH_active_COMPU_VTAB_REF /end COMPU_METHOD
/begin COMPU_VTAB CCH_active_COMPU_VTAB_REF "Verbal Table" TAB_VERB 2 0 "NO" 1 "YES" DEFAULT_VALUE "UNKNOWN" /end COMPU_VTAB
/begin MEASUREMENT autocrk_trig_valid "Start command status{autocrk_trig_valid&0xff=0:Inactive}{autocrk_trig_valid&0xff=1:Active}" UBYTE autocrk_trig_valid_COMPU_VTAB 0 0 0 255 ECU_ADDRESS 0x010138C8 BIT_MASK 0xff /end MEASUREMENT
/begin COMPU_METHOD autocrk_trig_valid_COMPU_VTAB "Verbal Table" TAB_VERB "%.0" "list" COMPU_TAB_REF autocrk_trig_valid_COMPU_VTAB_REF /end COMPU_METHOD
/begin COMPU_VTAB autocrk_trig_valid_COMPU_VTAB_REF "Verbal Table" TAB_VERB 2 0 "Inactive" 1 "Active" DEFAULT_VALUE "UNKNOWN" /end COMPU_VTAB
/begin MEASUREMENT START_CMD_raw "START_CMD raw" UWORD Compu_START_CMD_raw 0 0 0 5.00114468864469 ECU_ADDRESS 0x010138E0 /end MEASUREMENT
/begin COMPU_METHOD Compu_START_CMD_raw " " RAT_FUNC "%.3" "volts" COEFFS 0 13104 0 0 0 1 /end COMPU_METHOD
/begin MEASUREMENT START_CMD_volt "START_CMD volts" UWORD Compu_START_CMD_volt 0 0 0 255.99609375 ECU_ADDRESS 0x010138E8 /end MEASUREMENT
/begin COMPU_METHOD Compu_START_CMD_volt " " RAT_FUNC "%.2" "volts" COEFFS 0 256 0 0 0 1 /end COMPU_METHOD
/begin COMPU_METHOD Compu_TPhi_base_MAP " " RAT_FUNC "%.1" "MAP load (psia)" COEFFS 0 256 0 0 0 1 /end COMPU_METHOD
/begin COMPU_METHOD Compu_TPhi_base_rpm " " RAT_FUNC "%.0" "Speed (rpm)" COEFFS 0 1 0 0 0 1 /end COMPU_METHOD
/begin CHARACTERISTIC TPhi_base_Phi "Gasoline Phi Base" MAP 0x00142B80 /* @ECU_Address@TPhi_base_Phi@0x0201C000@ */ ECIPP_ALIGNMENT_SWORD 2 Compu_TPhi_base_Phi -2 1.99993896484375
 /begin AXIS_DESCR COM_AXIS NO_INPUT_QUANTITY Compu_TPhi_base_MAP 14 -128 127.99609375 AXIS_PTS_REF TPhi_base_MAP /end AXIS_DESCR
 /begin AXIS_DESCR COM_AXIS NO_INPUT_QUANTITY Compu_TPhi_base_rpm 10 -32768 32767 AXIS_PTS_REF TPhi_base_rpm /end AXIS_DESCR
/end CHARACTERISTIC
/begin AXIS_PTS TPhi_base_MAP " " 0x00142B64 /* @ECU_Address@TPhi_base_MAP@0x0201A000@ */ NO_INPUT_QUANTITY ECIPP_Lookup_SWORD 0 Compu_TPhi_base_MAP 14 -128 127.99609375 /end AXIS_PTS
/begin AXIS_PTS TPhi_base_rpm " " 0x00142C98 /* @ECU_Address@TPhi_base_rpm@0x0201B000@ */ NO_INPUT_QUANTITY ECIPP_Lookup_SWORD 0 Compu_TPhi_base_rpm 10 -32768 32767 /end AXIS_PTS
/begin COMPU_METHOD Compu_TPhi_base_Phi "" RAT_FUNC "%.3" "Phi" COEFFS 0 16384 0 0 0 1 /end COMPU_METHOD
/begin CHARACTERISTIC TPhi_cold_Phi "Gasoline Phi Cold" MAP 0x00142CAC /* @ECU_Address@TPhi_cold_Phi@0x0201D000@ */ ECIPP_ALIGNMENT_SWORD 2 Compu_TPhi_cold_Phi -2 1.99993896484375
 /begin AXIS_DESCR COM_AXIS NO_INPUT_QUANTITY Compu_TPhi_base_MAP 14 -128 127.99609375 AXIS_PTS_REF TPhi_base_MAP /end AXIS_DESCR
 /begin AXIS_DESCR COM_AXIS NO_INPUT_QUANTITY Compu_TPhi_base_rpm 10 -32768 32767 AXIS_PTS_REF TPhi_base_rpm /end AXIS_DESCR
/end CHARACTERISTIC
/begin COMPU_METHOD Compu_TPhi_cold_Phi "" RAT_FUNC "%.3" "Phi" COEFFS 0 16384 0 0 0 1 /end COMPU_METHOD
/begin COMPU_METHOD Compu_TPhiC_ECT_ECT " " RAT_FUNC "%.0" "ECT (deg F)" COEFFS 0 32 14720 0 0 1 /end COMPU_METHOD
/begin CHARACTERISTIC TPhiC_ECT_frac "Phi Base-Cold Ratio" CURVE 0x00142B54 /* @ECU_Address@TPhiC_ECT_frac@0x0201F000@ */ ECIPP_ALIGNMENT_SWORD 200 Compu_TPhiC_ECT_frac -200 199.993896484375
 /begin AXIS_DESCR COM_AXIS NO_INPUT_QUANTITY Compu_TPhiC_ECT_ECT 8 -1484 563.96875 AXIS_PTS_REF TPhiC_ECT_ECT /end AXIS_DESCR
/end CHARACTERISTIC
/begin AXIS_PTS TPhiC_ECT_ECT " " 0x00142B44 /* @ECU_Address@TPhiC_ECT_ECT@0x0201E000@ */ NO_INPUT_QUANTITY ECIPP_Lookup_SWORD 0 Compu_TPhiC_ECT_ECT 8 -1484 563.96875 /end AXIS_PTS
/begin COMPU_METHOD Compu_TPhiC_ECT_frac " " RAT_FUNC "%.0" "Phi Cold (%)" COEFFS 0 163.84 0 0 0 1 /end COMPU_METHOD
/begin AXIS_PTS TPhi_base_MAPP " " 0x00141032 /* @ECU_Address@TPhi_base_MAPP@0x02069000@ */ NO_INPUT_QUANTITY ECIPP_Lookup_SWORD 0 Compu_TPhi_base_MAPP 14 -128 127.99609375 /end AXIS_PTS
/begin AXIS_PTS TPhi_base_rpmP " " 0x00141166 /* @ECU_Address@TPhi_base_rpmP@0x0206A000@ */ NO_INPUT_QUANTITY ECIPP_Lookup_SWORD 0 Compu_TPhi_base_rpmP 10 -32768 32767 /end AXIS_PTS
/begin AXIS_PTS TPhi_base_MAPNG " " 0x00141F9A /* @ECU_Address@TPhi_base_MAPNG@0x0206C000@ */ NO_INPUT_QUANTITY ECIPP_Lookup_SWORD 0 Compu_TPhi_base_MAPNG 14 -128 127.99609375 /end AXIS_PTS
/begin AXIS_PTS TPhi_base_rpmNG " " 0x001420CE /* @ECU_Address@TPhi_base_rpmNG@0x0206D000@ */ NO_INPUT_QUANTITY ECIPP_Lookup_SWORD 0 Compu_TPhi_base_rpmNG 10 -32768 32767 /end AXIS_PTS
/begin COMPU_METHOD Compu_TPhi_base_MAPP " " RAT_FUNC "%.1" "MAP load (psia)" COEFFS 0 256 0 0 0 1 /end COMPU_METHOD
/begin COMPU_METHOD Compu_TPhi_base_rpmP " " RAT_FUNC "%.0" "Speed (rpm)" COEFFS 0 1 0 0 0 1 /end COMPU_METHOD
/begin CHARACTERISTIC TPhi_base_PhiP "LPG Phi Base" MAP 0x0014104E /* @ECU_Address@TPhi_base_PhiP@0x0206B000@ */ ECIPP_ALIGNMENT_SWORD 2 Compu_TPhi_base_PhiP -2 1.99993896484375
 /begin AXIS_DESCR COM_AXIS NO_INPUT_QUANTITY Compu_TPhi_base_MAPP 14 -128 127.99609375 AXIS_PTS_REF TPhi_base_MAPP /end AXIS_DESCR
 /begin AXIS_DESCR COM_AXIS NO_INPUT_QUANTITY Compu_TPhi_base_rpmP 10 -32768 32767 AXIS_PTS_REF TPhi_base_rpmP /end AXIS_DESCR
/end CHARACTERISTIC
/begin COMPU_METHOD Compu_TPhi_base_PhiP "" RAT_FUNC "%.3" "Phi" COEFFS 0 16384 0 0 0 1 /end COMPU_METHOD
/begin COMPU_METHOD Compu_TPhi_base_MAPNG " " RAT_FUNC "%.1" "MAP load (psia)" COEFFS 0 256 0 0 0 1 /end COMPU_METHOD
/begin COMPU_METHOD Compu_TPhi_base_rpmNG " " RAT_FUNC "%.0" "Speed (rpm)" COEFFS 0 1 0 0 0 1 /end COMPU_METHOD
/begin CHARACTERISTIC TPhi_base_PhiNG "NG Phi Base" MAP 0x00141FB6 /* @ECU_Address@TPhi_base_PhiNG@0x0206E000@ */ ECIPP_ALIGNMENT_SWORD 2 Compu_TPhi_base_PhiNG -2 1.99993896484375
 /begin AXIS_DESCR COM_AXIS NO_INPUT_QUANTITY Compu_TPhi_base_MAPNG 14 -128 127.99609375 AXIS_PTS_REF TPhi_base_MAPNG /end AXIS_DESCR
 /begin AXIS_DESCR COM_AXIS NO_INPUT_QUANTITY Compu_TPhi_base_rpmNG 10 -32768 32767 AXIS_PTS_REF TPhi_base_rpmNG /end AXIS_DESCR
/end CHARACTERISTIC
/begin COMPU_METHOD Compu_TPhi_base_PhiNG "" RAT_FUNC "%.3" "Phi" COEFFS 0 16384 0 0 0 1 /end COMPU_METHOD
/begin CHARACTERISTIC TPhiC_ECT_fracP "Phi Base-Cold Ratio" CURVE 0x00141022 /* @ECU_Address@TPhiC_ECT_fracP@0x02093000@ */ ECIPP_ALIGNMENT_SWORD 200 Compu_TPhiC_ECT_fracP -200 199.993896484375
 /begin AXIS_DESCR COM_AXIS NO_INPUT_QUANTITY Compu_TPhiC_ECT_ECTP 8 -1484 563.96875 AXIS_PTS_REF TPhiC_ECT_ECTP /end AXIS_DESCR
/end CHARACTERISTIC
/begin AXIS_PTS TPhiC_ECT_ECTP " " 0x00141012 /* @ECU_Address@TPhiC_ECT_ECTP@0x020D9000@ */ NO_INPUT_QUANTITY ECIPP_Lookup_SWORD 0 Compu_TPhiC_ECT_ECTP 8 -1484 563.96875 /end AXIS_PTS
/begin COMPU_METHOD Compu_TPhiC_ECT_fracP " " RAT_FUNC "%.0" "Phi Cold (%)" COEFFS 0 163.84 0 0 0 1 /end COMPU_METHOD
/begin COMPU_METHOD Compu_TPhiC_ECT_ECTN " " RAT_FUNC "%.0" "ECT (deg F)" COEFFS 0 32 14720 0 0 1 /end COMPU_METHOD
/begin CHARACTERISTIC TPhiC_ECT_fracN "Phi Base-Cold Ratio" CURVE 0x00141F8A /* @ECU_Address@TPhiC_ECT_fracN@0x02095000@ */ ECIPP_ALIGNMENT_SWORD 200 Compu_TPhiC_ECT_fracN -200 199.993896484375
 /begin AXIS_DESCR COM_AXIS NO_INPUT_QUANTITY Compu_TPhiC_ECT_ECTN 8 -1484 563.96875 AXIS_PTS_REF TPhiC_ECT_ECTN /end AXIS_DESCR
/end CHARACTERISTIC
/begin AXIS_PTS TPhiC_ECT_ECTN " " 0x00141F7A /* @ECU_Address@TPhiC_ECT_ECTN@0x02094000@ */ NO_INPUT_QUANTITY ECIPP_Lookup_SWORD 0 Compu_TPhiC_ECT_ECTN 8 -1484 563.96875 /end AXIS_PTS
/begin COMPU_METHOD Compu_TPhiC_ECT_fracN " " RAT_FUNC "%.0" "Phi Cold (%)" COEFFS 0 163.84 0 0 0 1 /end COMPU_METHOD
/begin CHARACTERISTIC TPhi_tran_Phi "Gasoline Phi Transition" MAP 0x00142DC4 /* @ECU_Address@TPhi_tran_Phi@0x0209C000@ */ ECIPP_ALIGNMENT_SWORD 2 Compu_TPhi_tran_Phi -2 1.99993896484375
 /begin AXIS_DESCR COM_AXIS NO_INPUT_QUANTITY Compu_TPhi_base_MAP 14 -128 127.99609375 AXIS_PTS_REF TPhi_base_MAP /end AXIS_DESCR
 /begin AXIS_DESCR COM_AXIS NO_INPUT_QUANTITY Compu_TPhi_base_rpm 10 -32768 32767 AXIS_PTS_REF TPhi_base_rpm /end AXIS_DESCR
/end CHARACTERISTIC
/begin COMPU_METHOD Compu_TPhi_tran_Phi "" RAT_FUNC "%.3" "Phi" COEFFS 0 16384 0 0 0 1 /end COMPU_METHOD
/begin CHARACTERISTIC TCL_postcat_phiLP "LPG Post-Cat Phi Target Table" MAP 0x00140EA2 /* @ECU_Address@TCL_postcat_phiLP@0x020C3000@ */ ECIPP_ALIGNMENT_SWORD 2 Compu_TCL_postcat_phiLP -2 1.99993896484375
 /begin AXIS_DESCR COM_AXIS NO_INPUT_QUANTITY Compu_TPhi_base_MAPP 14 -128 127.99609375 AXIS_PTS_REF TPhi_base_MAPP /end AXIS_DESCR
 /begin AXIS_DESCR COM_AXIS NO_INPUT_QUANTITY Compu_TPhi_base_rpmP 10 -32768 32767 AXIS_PTS_REF TPhi_base_rpmP /end AXIS_DESCR
/end CHARACTERISTIC
/begin COMPU_METHOD Compu_TCL_postcat_phiLP "" RAT_FUNC "%.4" "Phi-Target (phi)" COEFFS 0 16384 0 0 0 1 /end COMPU_METHOD
/begin CHARACTERISTIC TCL_postcat_phiNG "NG Post-Cat Phi Target Table" MAP 0x00141E0A /* @ECU_Address@TCL_postcat_phiNG@0x020C4000@ */ ECIPP_ALIGNMENT_SWORD 2 Compu_TCL_postcat_phiNG -2 1.99993896484375
 /begin AXIS_DESCR COM_AXIS NO_INPUT_QUANTITY Compu_TPhi_base_MAPNG 14 -128 127.99609375 AXIS_PTS_REF TPhi_base_MAPNG /end AXIS_DESCR
 /begin AXIS_DESCR COM_AXIS NO_INPUT_QUANTITY Compu_TPhi_base_rpmNG 10 -32768 32767 AXIS_PTS_REF TPhi_base_rpmNG /end AXIS_DESCR
/end CHARACTERISTIC
/begin COMPU_METHOD Compu_TCL_postcat_phiNG "" RAT_FUNC "%.4" "Phi-Target (phi)" COEFFS 0 16384 0 0 0 1 /end COMPU_METHOD
/begin CHARACTERISTIC TPhi_cold_PhiP "LPG Phi Cold" MAP 0x0014117A /* @ECU_Address@TPhi_cold_PhiP@0x020D5000@ */ ECIPP_ALIGNMENT_SWORD 2 Compu_TPhi_cold_PhiP -2 1.99993896484375
 /begin AXIS_DESCR COM_AXIS NO_INPUT_QUANTITY Compu_TPhi_base_MAPP 14 -128 127.99609375 AXIS_PTS_REF TPhi_base_MAPP /end AXIS_DESCR
 /begin AXIS_DESCR COM_AXIS NO_INPUT_QUANTITY Compu_TPhi_base_rpmP 10 -32768 32767 AXIS_PTS_REF TPhi_base_rpmP /end AXIS_DESCR
/end CHARACTERISTIC
/begin COMPU_METHOD Compu_TPhi_cold_PhiP "" RAT_FUNC "%.3" "Phi" COEFFS 0 16384 0 0 0 1 /end COMPU_METHOD
/begin CHARACTERISTIC TPhi_tran_PhiP "LPG Phi Transition" MAP 0x00141292 /* @ECU_Address@TPhi_tran_PhiP@0x020D6000@ */ ECIPP_ALIGNMENT_SWORD 2 Compu_TPhi_tran_PhiP -2 1.99993896484375
 /begin AXIS_DESCR COM_AXIS NO_INPUT_QUANTITY Compu_TPhi_base_MAPP 14 -128 127.99609375 AXIS_PTS_REF TPhi_base_MAPP /end AXIS_DESCR
 /begin AXIS_DESCR COM_AXIS NO_INPUT_QUANTITY Compu_TPhi_base_rpmP 10 -32768 32767 AXIS_PTS_REF TPhi_base_rpmP /end AXIS_DESCR
/end CHARACTERISTIC
/begin COMPU_METHOD Compu_TPhi_tran_PhiP "" RAT_FUNC "%.3" "Phi" COEFFS 0 16384 0 0 0 1 /end COMPU_METHOD
/begin CHARACTERISTIC TPhi_cold_PhiN "NG Phi Cold" MAP 0x001420E2 /* @ECU_Address@TPhi_cold_PhiN@0x020D7000@ */ ECIPP_ALIGNMENT_SWORD 2 Compu_TPhi_cold_PhiN -2 1.99993896484375
 /begin AXIS_DESCR COM_AXIS NO_INPUT_QUANTITY Compu_TPhi_base_MAPNG 14 -128 127.99609375 AXIS_PTS_REF TPhi_base_MAPNG /end AXIS_DESCR
 /begin AXIS_DESCR COM_AXIS NO_INPUT_QUANTITY Compu_TPhi_base_rpmNG 10 -32768 32767 AXIS_PTS_REF TPhi_base_rpmNG /end AXIS_DESCR
/end CHARACTERISTIC
/begin COMPU_METHOD Compu_TPhi_cold_PhiN "" RAT_FUNC "%.3" "Phi" COEFFS 0 16384 0 0 0 1 /end COMPU_METHOD
/begin CHARACTERISTIC TPhi_tran_PhiN "NG Phi Transition" MAP 0x001421FA /* @ECU_Address@TPhi_tran_PhiN@0x020D8000@ */ ECIPP_ALIGNMENT_SWORD 2 Compu_TPhi_tran_PhiN -2 1.99993896484375
 /begin AXIS_DESCR COM_AXIS NO_INPUT_QUANTITY Compu_TPhi_base_MAPNG 14 -128 127.99609375 AXIS_PTS_REF TPhi_base_MAPNG /end AXIS_DESCR
 /begin AXIS_DESCR COM_AXIS NO_INPUT_QUANTITY Compu_TPhi_base_rpmNG 10 -32768 32767 AXIS_PTS_REF TPhi_base_rpmNG /end AXIS_DESCR
/end CHARACTERISTIC
/begin COMPU_METHOD Compu_TPhi_tran_PhiN "" RAT_FUNC "%.3" "Phi" COEFFS 0 16384 0 0 0 1 /end COMPU_METHOD
/begin COMPU_METHOD Compu_TPhiC_ECT_ECTP " " RAT_FUNC "%.0" "ECT (deg F)" COEFFS 0 32 14720 0 0 1 /end COMPU_METHOD
/begin COMPU_METHOD Compu_TSH_phiC_SH " " RAT_FUNC "%.1" "SH (g/kg)" COEFFS 0 65.536 0 0 0 1 /end COMPU_METHOD
/begin CHARACTERISTIC TSH_phiC_x "Phi-target Humidity Compensation" CURVE 0x001453EE /* @ECU_Address@TSH_phiC_x@0x020DD000@ */ ECIPP_ALIGNMENT_SWORD 100 Compu_TSH_phiC_x -100 99.9969482421875
 /begin AXIS_DESCR COM_AXIS NO_INPUT_QUANTITY Compu_TSH_phiC_SH 16 -500 499.984741210938 AXIS_PTS_REF TSH_phiC_SH /end AXIS_DESCR
/end CHARACTERISTIC
/begin AXIS_PTS TSH_phiC_SH " " 0x001453CE /* @ECU_Address@TSH_phiC_SH@0x020DC000@ */ NO_INPUT_QUANTITY ECIPP_Lookup_SWORD 0 Compu_TSH_phiC_SH 16 -500 499.984741210938 /end AXIS_PTS
/begin COMPU_METHOD Compu_TSH_phiC_x " " RAT_FUNC "%.2" "Phi Offset (%@0.65 phi)" COEFFS 0 327.68 0 0 0 1 /end COMPU_METHOD
/begin COMPU_METHOD Compu_TMAPrsc_BP " " RAT_FUNC "%.2" "BP (psia)" COEFFS 0 256 0 0 0 1 /end COMPU_METHOD
/begin CHARACTERISTIC TMAPrsc_max_phi "Max MAP for BP-MAP phi rescale" CURVE 0x001451BE /* @ECU_Address@TMAPrsc_max_phi@0x0212F000@ */ ECIPP_ALIGNMENT_SWORD 128 Compu_TMAPrsc_max_phi -128 127.99609375
 /begin AXIS_DESCR COM_AXIS NO_INPUT_QUANTITY Compu_TMAPrsc_BP 4 -128 127.99609375 AXIS_PTS_REF TMAPrsc_BP /end AXIS_DESCR
/end CHARACTERISTIC
/begin AXIS_PTS TMAPrsc_BP " " 0x001451B6 /* @ECU_Address@TMAPrsc_BP@0x0212E000@ */ NO_INPUT_QUANTITY ECIPP_Lookup_SWORD 0 Compu_TMAPrsc_BP 4 -128 127.99609375 /end AXIS_PTS
/begin COMPU_METHOD Compu_TMAPrsc_max_phi " " RAT_FUNC "%.2" "Max MAP (psia)" COEFFS 0 256 0 0 0 1 /end COMPU_METHOD
/begin COMPU_METHOD Compu_TNTEphi_rpm " " RAT_FUNC "%.0" "Speed (rpm)" COEFFS 0 1 0 0 0 1 /end COMPU_METHOD
/begin CHARACTERISTIC TNTEphi_MAP "NTE Zone Phi Transition" CURVE 0x001451F6 /* @ECU_Address@TNTEphi_MAP@0x0225D000@ */ ECIPP_ALIGNMENT_SWORD 128 Compu_TNTEphi_MAP -128 127.99609375
 /begin AXIS_DESCR COM_AXIS NO_INPUT_QUANTITY Compu_TNTEphi_rpm 10 -32768 32767 AXIS_PTS_REF TNTEphi_rpm /end AXIS_DESCR
/end CHARACTERISTIC
/begin AXIS_PTS TNTEphi_rpm " " 0x0014521E /* @ECU_Address@TNTEphi_rpm@0x0225C000@ */ NO_INPUT_QUANTITY ECIPP_Lookup_SWORD 0 Compu_TNTEphi_rpm 10 -32768 32767 /end AXIS_PTS
/begin COMPU_METHOD Compu_TNTEphi_MAP " " RAT_FUNC "%.2" "Lower MAP (psia)" COEFFS 0 256 0 0 0 1 /end COMPU_METHOD
/begin CHARACTERISTIC TNTEphi_phi "NTE Zone Phi Transition" CURVE 0x0014520A /* @ECU_Address@TNTEphi_phi@0x0225E000@ */ ECIPP_ALIGNMENT_SWORD 2 Compu_TNTEphi_phi -2 1.99993896484375
 /begin AXIS_DESCR COM_AXIS NO_INPUT_QUANTITY Compu_TNTEphi_rpm 10 -32768 32767 AXIS_PTS_REF TNTEphi_rpm /end AXIS_DESCR
/end CHARACTERISTIC
/begin COMPU_METHOD Compu_TNTEphi_phi " " RAT_FUNC "%.3" "Phi Lower Limit" COEFFS 0 16384 0 0 0 1 /end COMPU_METHOD
/begin CHARACTERISTIC TNTEphi_CLlo_lim "NTE Zone Phi Transition" CURVE 0x001451E2 /* @ECU_Address@TNTEphi_CLlo_lim@0x0225F000@ */ ECIPP_ALIGNMENT_SWORD 100 Compu_TNTEphi_CLlo_lim -100 99.9969482421875
 /begin AXIS_DESCR COM_AXIS NO_INPUT_QUANTITY Compu_TNTEphi_rpm 10 -32768 32767 AXIS_PTS_REF TNTEphi_rpm /end AXIS_DESCR
/end CHARACTERISTIC
/begin COMPU_METHOD Compu_TNTEphi_CLlo_lim " " RAT_FUNC "%.1" "CL Lower Limit" COEFFS 0 327.68 0 0 0 1 /end COMPU_METHOD
/begin CHARACTERISTIC TNTEphi_ALlo_lim "NTE Zone Phi Transition" CURVE 0x001451CE /* @ECU_Address@TNTEphi_ALlo_lim@0x02260000@ */ ECIPP_ALIGNMENT_SWORD 100 Compu_TNTEphi_ALlo_lim -100 99.9969482421875
 /begin AXIS_DESCR COM_AXIS NO_INPUT_QUANTITY Compu_TNTEphi_rpm 10 -32768 32767 AXIS_PTS_REF TNTEphi_rpm /end AXIS_DESCR
/end CHARACTERISTIC
/begin COMPU_METHOD Compu_TNTEphi_ALlo_lim " " RAT_FUNC "%.1" "AL Lower Limit" COEFFS 0 327.68 0 0 0 1 /end COMPU_METHOD
/begin MEASUREMENT SPK_IGBT_T_raw "Spk_IGBT_T_raw 0" UWORD Compu_SPK_IGBT_T_raw 0 0 0 5.00114468864469 ECU_ADDRESS 0x0233C000 MATRIX_DIM 11 1 1 /end MEASUREMENT
/begin COMPU_METHOD Compu_SPK_IGBT_T_raw " " RAT_FUNC "%.3" "volts" COEFFS 0 13104 0 0 0 1 /end COMPU_METHOD
/begin GROUP EC_Outputs "ECONTROLS" ROOT
 /begin REF_MEASUREMENT AUX_OUT13_alloc AUX_OUT14_alloc AUX_OUT15_alloc AUX_OUT16_alloc AUX_OUT17_alloc AUX_OUT18_alloc AUX_OUT19_alloc AUX_OUT20_alloc AUX_OUT21_alloc AUX_OUT22_alloc AUX_OUT23_alloc AUX_OUT2_conflict AUX_OUT3_conflict AUX_OUT4_conflict AUX_OUT5_conflict AUX_OUT6_conflict AUX_OUT7_conflict AUX_OUT8_conflict AUX_OUT9_conflict AUX_OUT10_conflict AUX_OUT11_conflict AUX_OUT12_conflict AUX_OUT13_conflict AUX_OUT14_conflict AUX_OUT15_conflict AUX_OUT16_conflict AUX_OUT17_conflict AUX_OUT18_conflict AUX_OUT19_conflict AUX_OUT20_conflict AUX_OUT21_conflict AUX_OUT22_conflict AUX_OUT23_conflict AUX_MIL_alloc AUX_MIL_conflict AUX_TACH_alloc AUX_TACH_conflict VSFan_rpm VSFan_pcta VSFan_pctd VSFan_ld_slew VSFan_DC AC_ctl_state crank_trans_lim_tmr crank_trans_lim_actv J1939_ABS_active VSFan_rpmd VSFan_rpm_Iacc VSFan_rpm_dot RBC_allowed AWP_status J1939_AWP_rpma AWP_motor_status AWP_ctl_state VSFan_pwr AGS_req1 ECWP_idle_tmr ECWP_temp_tmr ERCV_state ERCV_speed_freq J1939_retard_actv CCT CCH_state CCH_active autocrk_trig_valid /end REF_MEASUREMENT
/end GROUP
/begin GROUP EC_PhiGsln "ECONTROLS" ROOT
 /begin REF_CHARACTERISTIC OL_phi_limit MAPrsc_min_phi NTEphi_ena NTEphi_MAP_hyst NTEphi_slew_rate NTEphi_MAPdt_slewoff NTEphi_CL_ramp_rate NTEphi_AL_ramp_rate NTEphi_MAP_LP_tau TPhi_base_Phi TPhi_cold_Phi TPhiC_ECT_frac TPhi_tran_Phi TMAPrsc_max_phi TNTEphi_MAP TNTEphi_phi TNTEphi_CLlo_lim TNTEphi_ALlo_lim /end REF_CHARACTERISTIC
 /begin REF_MEASUREMENT FAratio MAPrsc_phi MAPrsc_max_phi NTEphi_lim_active NTEphi_lim NTEphi_lim_slew NTEphi_CLlo_lim NTEphi_ALlo_lim NTEphi_CLlo_slew NTEphi_ALlo_slew NTEphi_CLlo_active NTEphi_ALlo_active NTEphi_MAP CL_lo CL_hi AL_lo AL_hi NTEphi_MAP_LP /end REF_MEASUREMENT
/end GROUP
/begin GROUP EC_PhiLP "ECONTROLS" ROOT
 /begin REF_CHARACTERISTIC TPhi_base_PhiP TPhiC_ECT_fracP TCL_postcat_phiLP TPhi_cold_PhiP TPhi_tran_PhiP /end REF_CHARACTERISTIC
 /begin REF_MEASUREMENT MAPrsc_phi /end REF_MEASUREMENT
/end GROUP
/begin GROUP EC_PhiNG "ECONTROLS" ROOT
 /begin REF_CHARACTERISTIC SH_phi_ena Phi_lowslew_ena Phi_lowslew_lim Phi_lowslew_rate alphaN_ena TPhi_base_PhiNG TPhiC_ECT_fracN TCL_postcat_phiNG TPhi_cold_PhiN TPhi_tran_PhiN TSH_phiC_x /end REF_CHARACTERISTIC
 /begin REF_MEASUREMENT Phi_base SH_phi_xmul MAPrsc_phi alphaN_MAPf alphaN_interp /end REF_MEASUREMENT
/end GROUP
/begin GROUP EC_PowerMon "ECONTROLS" ROOT
 /begin REF_CHARACTERISTIC Gen_calcs Gen_freq_src pwr_crct_mode Gen_parasitic_pwr Gen_derate AAT_source ecm_multi_sync ecm_multi_Voffset ecm_multi_ECT ecm_multi_OILP ecm_multi_RELAY ecm_multi_MIL ecm_multi_START ecm_multi_SPK_mstr1 ecm_multi_SPK_mstr2 ecm_multi_SPK_mstr3 ecm_multi_SPK_mstr4 ecm_multi_SPK_mstr5 ecm_multi_SPK_mstr6 ecm_multi_SPK_mstr7 ecm_multi_SPK_mstr8 ecm_multi_SPK_mstr9 ecm_multi_SPK_mstr10 ecm_multi_SPK_slv1 ecm_multi_SPK_slv2 ecm_multi_SPK_slv3 ecm_multi_SPK_slv4 ecm_multi_SPK_slv5 ecm_multi_SPK_slv6 ecm_multi_SPK_slv7 ecm_multi_SPK_slv8 ecm_multi_SPK_slv9 ecm_multi_SPK_slv10 ecm_multi_SPK_ena TIPAdapt_ena TIPAdapt_deadzone TIPAdapt_min TIPAdapt_max TIPAdapt_MAP_tau TIPAdapt_dMAP_max TIPAdapt_ECT_min TIPAdapt_wait TIPAdapt_minMAP TIPAdapt_maxMAP TIPAdapt_minRPM TIPAdapt_maxRPM TIPAdapt_gain_pct ecm_multi_RELAY_wait /end REF_CHARACTERISTIC
 /begin REF_MEASUREMENT PM_RMS_volts PM_RMS_amps Gen_total_pwr Gen_real_pwr Gen_freq Gen_crct_real_pwr Gen_phase_volts Gen_phase_amps PM_RMS_freq PM_RMS_phase Gen_PF pwr_correction TIPAdapt_updating TIPAdapt_correction TIPAdapt_MAP_LPmstr TIPAdapt_MAP_LPslv TIPAdapt_MAP_mstr TIPAdapt_MAP_slv TIPAdapt_cmd_mstr TIPAdapt_cmd_slv TIPAdapt_ECT_mstr TIPAdapt_ECT_slv MAP_slow TIPAdapt_cmd_final TIPAdapt_tblcorrect TIPAdapt_MAPerror TIPAdapt_TIP_mstr TIPAdapt_TIP_slv TIPAdapt_TIPcorrect RMT_AAT /end REF_MEASUREMENT
/end GROUP
/begin GROUP EC_QTgeneric "ECONTROLS" ROOT /begin REF_CHARACTERISTIC CRI_Qmin_hyst CRI_pulseoff_hyst /end REF_CHARACTERISTIC
 /begin REF_MEASUREMENT CRI_mg_minimum CRI_status_pilot2 CRI_status_pilot1 CRI_status_main CRI_status_post1 CRI_status_post2 CRI_pulseoff_force CRI_pi2main_margin CRI_pi2pi1_margin CRI_pi1main_margin CRI_mainpo1_margin CRI_po1po2_margin CRI_mainpo2_margin /end REF_MEASUREMENT
/end GROUP
/begin GROUP EC_QTpilot2 "ECONTROLS" ROOT /begin REF_MEASUREMENT CRI_status_pilot2 /end REF_MEASUREMENT /end GROUP
/begin GROUP EC_QTpilot1 "ECONTROLS" ROOT /begin REF_MEASUREMENT CRI_status_pilot1 /end REF_MEASUREMENT /end GROUP
/begin GROUP EC_QTmain "ECONTROLS" ROOT /begin REF_MEASUREMENT CRI_status_main /end REF_MEASUREMENT /end GROUP
/begin GROUP EC_QTpost1 "ECONTROLS" ROOT /begin REF_MEASUREMENT CRI_status_post1 /end REF_MEASUREMENT /end GROUP
/begin GROUP EC_QTpost2 "ECONTROLS" ROOT /begin REF_MEASUREMENT CRI_status_post2 /end REF_MEASUREMENT /end GROUP
/begin GROUP EC_RawVolts "ECONTROLS" ROOT
 /begin REF_MEASUREMENT TPS1_raw TPS2_raw CRK_ana_raw MAG_BIAS_raw KNK1H_raw KNK2H_raw KNK1L_raw KNK2L_raw TIP_raw FPP1_raw FPP2_raw FRP_raw WGP_raw EGO1_raw EGO2_raw EGO3_raw Vbat_raw Vsw_raw VE5a_FB_raw FT_raw GOV1_raw GOV2_raw EGO1H_LS_raw EGO2H_LS_raw EGO3H_LS_raw OILP_raw AUX_DIG1_raw AUX_DIG2_raw AUX_PWM1_FB_raw AUX_PWM2_FB_raw EGO4_raw AUX_DIG3_raw EGT_raw VE5b_FB_raw EGO4H_LS_raw AUX_PWM3_FB_raw AUX_PWM4_FB_raw AUX_PWM5_FB_raw AUX_DIG1_volt AUX_DIG2_volt AUX_DIG3_volt AUX_PUD4_raw AUX_PUD5_raw AUX_PUD6_raw SHIFT_I_FB_raw Valternator_raw AUX_PWM6_FB_raw CAM1_ana_raw RS_ana_raw AUX_PWM7_FB_raw AUX_PWM8_FB_raw RELAY_LS_raw LOCKOFF_LS_raw STARTER_FB_raw MIL_LS_raw TACH_FB_raw AUX_DIG4_raw AUX_DIG5_raw AUX_DIG6_raw AUX_DIG7_raw AUX_DIG8_raw AUX_DIG4_volt AUX_DIG5_volt AUX_DIG6_volt AUX_DIG7_volt AUX_DIG8_volt UEGOPI_raw UEGOSR_raw UEGOHFB_raw AUX_DIG12_raw AUX_PUD7_raw AUX_PUD8_raw AUX_DIG11_raw AUX_DIG11_volt FPUMP_FB_raw AUX_DIG9_raw AUX_DIG9_volt AUX_DIG10_raw AUX_DIG10_volt AUX_DIG12_volt AUX_DIG13_raw AUX_DIG13_volt AUX_DIG14_raw AUX_DIG14_volt AUX_DIG15_raw AUX_DIG15_volt AUX_DIG16_raw AUX_DIG16_volt AUX_DIG17_raw AUX_DIG17_volt AUX_DIG18_raw AUX_DIG18_volt AUX_DIG19_raw AUX_DIG19_volt AUX_PUD9_raw AUX_PUD10_raw AUX_PUD11_raw AUX_PUD12_raw AUX_PUD13_raw AUX_PUD14_raw AUX_PUD15_raw AUX_PUD16_raw AUX_PUD17_raw AUX_PUD18_raw AUX_PUD19_raw AUX_PUD20_raw AUX_PUD21_raw AUX_PUD22_raw AUX_PUD23_raw AUX_PUD24_raw AUX_PUD25_raw AUX_PWM9_FB_raw AUX_PWM10_FB_raw AUX_PWM11_FB_raw AUX_PWM12_FB_raw AUX_PWM13_FB_raw AUX_PWM14_FB_raw AUX_PWM15_FB_raw UEGO2PI_raw UEGO2SR_raw UEGO2HFB_raw Vrelay_raw VE5c_FB_raw IVS_raw AUX_DIG20_raw AUX_DIG20_volt AUX_DIG21_raw AUX_DIG21_volt AUX_DIG22_raw AUX_DIG22_volt AUX_PWM16_FB_raw AUX_PWM17_FB_raw AUX_PWM18_FB_raw AUX_PWM19_FB_raw AUX_PWM20_FB_raw AUX_PWM21_FB_raw AUX_PWM22_FB_raw AUX_PWM23_FB_raw PULSE_IN_raw BUZZ_FB_raw DBW_iFB_raw HBA_iFB_raw HBB_iFB_raw CAM2_ana_raw SPKI_samp_raw CRI1_boost_raw CRI1_LS_i_raw CRI2_boost_raw CRI2_LS_i_raw ref_4096V_raw VE6_FB_raw UEGO_Vcc_raw AUX_DIG23_raw AUX_DIG23_volt AUX_DIG24_raw AUX_DIG24_volt AUX_DIG25_raw AUX_DIG25_volt AUX_PWM1_iFB_raw AUX_PWM2_iFB_raw AUX_PWM3_iFB_raw AUX_PWM4_iFB_raw AUX_PWM5_iFB_raw AUX_PWM6_iFB_raw AUX_PWM8_iFB_raw AUX_PWM9_iFB_raw AUX_PWM7_iFB_raw AUX_PWM10_iFB_raw AUX_PWM11_iFB_raw AUX_PWM12_iFB_raw AUX_PWM13_iFB_raw AUX_PWM14_iFB_raw AUX_PWM15_iFB_raw AUX_PWM16_iFB_raw AUX_PWM17_iFB_raw AUX_PWM18_iFB_raw AUX_PWM19_iFB_raw AUX_PWM20_iFB_raw AUX_PWM21_iFB_raw AUX_PWM22_iFB_raw AUX_PWM23_iFB_raw VE5a VE5b VE5c Vrelay KNK3H_raw KNK3L_raw T_internal_raw START_CMD_raw START_CMD_volt SPK_IGBT_T_raw /end REF_MEASUREMENT
/end GROUP
/begin GROUP EC_Roadspeed "ECONTROLS" ROOT /begin REF_MEASUREMENT MAG_BIAS_raw RS_ana_raw J1939_retard_actv /end REF_MEASUREMENT /end GROUP
/begin GROUP EC_Tests "ECONTROLS" ROOT /begin REF_MEASUREMENT VSFan_rpm /end REF_MEASUREMENT /end GROUP
/end MODULE
/end PROJECT
