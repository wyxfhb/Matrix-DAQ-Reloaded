ASAP2_VERSION 1 61
/begin PROJECT Econtrols_4G "4G Test"
/begin HEADER "4G A2L Configuration" PROJECT_NO EControls4G /* config for version control */ VERSION "$Revision: 82130 $:" /* config for version control */ /end HEADER
/begin MODULE EControls_4G_SH2A "EControls 4G"
/begin MOD_COMMON "" DEPOSIT ABSOLUTE BYTE_ORDER MSB_FIRST /end MOD_COMMON
/* Define the Record Layouts */
/begin RECORD_LAYOUT ECIPP_ALIGNMENT_UBYTE FNC_VALUES 1 UBYTE COLUMN_DIR DIRECT /end RECORD_LAYOUT
/begin RECORD_LAYOUT ECIPP_ALIGNMENT_UWORD FNC_VALUES 1 UWORD COLUMN_DIR DIRECT /end RECORD_LAYOUT
/begin RECORD_LAYOUT ECIPP_ALIGNMENT_ULONG FNC_VALUES 1 ULONG COLUMN_DIR DIRECT /end RECORD_LAYOUT
/begin RECORD_LAYOUT ECIPP_ALIGNMENT_FLOAT32_IEEE FNC_VALUES 1 FLOAT32_IEEE COLUMN_DIR DIRECT /end RECORD_LAYOUT
/begin COMPU_METHOD Compu_IDENTITY "Discrete Values " /* Identifier */ IDENTICAL "%.0" /* Format */ "-" /* Units */ /end COMPU_METHOD
/begin CHARACTERISTIC FCdc4_APUD12_min "FCtl_DTC_0x04(366)" VALUE 0x00163EAC /* @ECU_Address@FCtl_DTC_0x04@0x024C42DC@ */ ECIPP_ALIGNMENT_UWORD 65535 Compu_IDENTITY 0 65535 PHYS_UNIT "System ID + DTC" /end CHARACTERISTIC
/begin CHARACTERISTIC FCdc4_APUD13_max "FCtl_DTC_0x04(367)" VALUE 0x00163EAE /* @ECU_Address@FCtl_DTC_0x04@0x024C42DE@ */ ECIPP_ALIGNMENT_UWORD 65535 Compu_IDENTITY 0 65535 PHYS_UNIT "System ID + DTC" /end CHARACTERISTIC
/begin CHARACTERISTIC FCdc4_APUD13_min "FCtl_DTC_0x04(368)" VALUE 0x00163EB0 /* @ECU_Address@FCtl_DTC_0x04@0x024C42E0@ */ ECIPP_ALIGNMENT_UWORD 65535 Compu_IDENTITY 0 65535 PHYS_UNIT "System ID + DTC" /end CHARACTERISTIC
/begin CHARACTERISTIC FCdc4_APUD14_max "FCtl_DTC_0x04(369)" VALUE 0x00163EB2 /* @ECU_Address@FCtl_DTC_0x04@0x024C42E2@ */ ECIPP_ALIGNMENT_UWORD 65535 Compu_IDENTITY 0 65535 PHYS_UNIT "System ID + DTC" /end CHARACTERISTIC
/begin CHARACTERISTIC FCdc4_APUD14_min "FCtl_DTC_0x04(370)" VALUE 0x00163EB4 /* @ECU_Address@FCtl_DTC_0x04@0x024C42E4@ */ ECIPP_ALIGNMENT_UWORD 65535 Compu_IDENTITY 0 65535 PHYS_UNIT "System ID + DTC" /end CHARACTERISTIC
/begin CHARACTERISTIC FCdc4_APUD15_max "FCtl_DTC_0x04(371)" VALUE 0x00163EB6 /* @ECU_Address@FCtl_DTC_0x04@0x024C42E6@ */ ECIPP_ALIGNMENT_UWORD 65535 Compu_IDENTITY 0 65535 PHYS_UNIT "System ID + DTC" /end CHARACTERISTIC
/begin CHARACTERISTIC FCdc4_APUD15_min "FCtl_DTC_0x04(372)" VALUE 0x00163EB8 /* @ECU_Address@FCtl_DTC_0x04@0x024C42E8@ */ ECIPP_ALIGNMENT_UWORD 65535 Compu_IDENTITY 0 65535 PHYS_UNIT "System ID + DTC" /end CHARACTERISTIC
/begin CHARACTERISTIC FCdc4_APUD16_max "FCtl_DTC_0x04(373)" VALUE 0x00163EBA /* @ECU_Address@FCtl_DTC_0x04@0x024C42EA@ */ ECIPP_ALIGNMENT_UWORD 65535 Compu_IDENTITY 0 65535 PHYS_UNIT "System ID + DTC" /end CHARACTERISTIC
/begin CHARACTERISTIC FCdc4_APUD16_min "FCtl_DTC_0x04(374)" VALUE 0x00163EBC /* @ECU_Address@FCtl_DTC_0x04@0x024C42EC@ */ ECIPP_ALIGNMENT_UWORD 65535 Compu_IDENTITY 0 65535 PHYS_UNIT "System ID + DTC" /end CHARACTERISTIC
/begin CHARACTERISTIC FCdc4_APUD17_max "FCtl_DTC_0x04(375)" VALUE 0x00163EBE /* @ECU_Address@FCtl_DTC_0x04@0x024C42EE@ */ ECIPP_ALIGNMENT_UWORD 65535 Compu_IDENTITY 0 65535 PHYS_UNIT "System ID + DTC" /end CHARACTERISTIC
/begin CHARACTERISTIC FCdc4_APUD17_min "FCtl_DTC_0x04(376)" VALUE 0x00163EC0 /* @ECU_Address@FCtl_DTC_0x04@0x024C42F0@ */ ECIPP_ALIGNMENT_UWORD 65535 Compu_IDENTITY 0 65535 PHYS_UNIT "System ID + DTC" /end CHARACTERISTIC
/begin CHARACTERISTIC FCdc4_APUD18_max "FCtl_DTC_0x04(377)" VALUE 0x00163EC2 /* @ECU_Address@FCtl_DTC_0x04@0x024C42F2@ */ ECIPP_ALIGNMENT_UWORD 65535 Compu_IDENTITY 0 65535 PHYS_UNIT "System ID + DTC" /end CHARACTERISTIC
/begin CHARACTERISTIC FCdc4_APUD18_min "FCtl_DTC_0x04(378)" VALUE 0x00163EC4 /* @ECU_Address@FCtl_DTC_0x04@0x024C42F4@ */ ECIPP_ALIGNMENT_UWORD 65535 Compu_IDENTITY 0 65535 PHYS_UNIT "System ID + DTC" /end CHARACTERISTIC
/begin CHARACTERISTIC FCdc4_APUD19_max "FCtl_DTC_0x04(379)" VALUE 0x00163EC6 /* @ECU_Address@FCtl_DTC_0x04@0x024C42F6@ */ ECIPP_ALIGNMENT_UWORD 65535 Compu_IDENTITY 0 65535 PHYS_UNIT "System ID + DTC" /end CHARACTERISTIC
/begin CHARACTERISTIC FCdc4_APUD19_min "FCtl_DTC_0x04(380)" VALUE 0x00163EC8 /* @ECU_Address@FCtl_DTC_0x04@0x024C42F8@ */ ECIPP_ALIGNMENT_UWORD 65535 Compu_IDENTITY 0 65535 PHYS_UNIT "System ID + DTC" /end CHARACTERISTIC
/begin CHARACTERISTIC FCdc4_APUD2_max "FCtl_DTC_0x04(205)" VALUE 0x00163D6A /* @ECU_Address@FCtl_DTC_0x04@0x024C419A@ */ ECIPP_ALIGNMENT_UWORD 65535 Compu_IDENTITY 0 65535 PHYS_UNIT "System ID + DTC" /end CHARACTERISTIC
/begin CHARACTERISTIC FCdc4_APUD2_min "FCtl_DTC_0x04(206)" VALUE 0x00163D6C /* @ECU_Address@FCtl_DTC_0x04@0x024C419C@ */ ECIPP_ALIGNMENT_UWORD 65535 Compu_IDENTITY 0 65535 PHYS_UNIT "System ID + DTC" /end CHARACTERISTIC
/begin CHARACTERISTIC FCdc4_APUD20_max "FCtl_DTC_0x04(381)" VALUE 0x00163ECA /* @ECU_Address@FCtl_DTC_0x04@0x024C42FA@ */ ECIPP_ALIGNMENT_UWORD 65535 Compu_IDENTITY 0 65535 PHYS_UNIT "System ID + DTC" /end CHARACTERISTIC
/begin CHARACTERISTIC FCdc4_APUD20_min "FCtl_DTC_0x04(382)" VALUE 0x00163ECC /* @ECU_Address@FCtl_DTC_0x04@0x024C42FC@ */ ECIPP_ALIGNMENT_UWORD 65535 Compu_IDENTITY 0 65535 PHYS_UNIT "System ID + DTC" /end CHARACTERISTIC
/begin CHARACTERISTIC FCdc4_APUD21_max "FCtl_DTC_0x04(383)" VALUE 0x00163ECE /* @ECU_Address@FCtl_DTC_0x04@0x024C42FE@ */ ECIPP_ALIGNMENT_UWORD 65535 Compu_IDENTITY 0 65535 PHYS_UNIT "System ID + DTC" /end CHARACTERISTIC
/begin CHARACTERISTIC FCdc4_APUD21_min "FCtl_DTC_0x04(384)" VALUE 0x00163ED0 /* @ECU_Address@FCtl_DTC_0x04@0x024C4300@ */ ECIPP_ALIGNMENT_UWORD 65535 Compu_IDENTITY 0 65535 PHYS_UNIT "System ID + DTC" /end CHARACTERISTIC
/begin CHARACTERISTIC FCdc4_APUD22_max "FCtl_DTC_0x04(385)" VALUE 0x00163ED2 /* @ECU_Address@FCtl_DTC_0x04@0x024C4302@ */ ECIPP_ALIGNMENT_UWORD 65535 Compu_IDENTITY 0 65535 PHYS_UNIT "System ID + DTC" /end CHARACTERISTIC
/begin CHARACTERISTIC FCdc4_APUD22_min "FCtl_DTC_0x04(386)" VALUE 0x00163ED4 /* @ECU_Address@FCtl_DTC_0x04@0x024C4304@ */ ECIPP_ALIGNMENT_UWORD 65535 Compu_IDENTITY 0 65535 PHYS_UNIT "System ID + DTC" /end CHARACTERISTIC
/begin CHARACTERISTIC FCdc4_APUD23_max "FCtl_DTC_0x04(387)" VALUE 0x00163ED6 /* @ECU_Address@FCtl_DTC_0x04@0x024C4306@ */ ECIPP_ALIGNMENT_UWORD 65535 Compu_IDENTITY 0 65535 PHYS_UNIT "System ID + DTC" /end CHARACTERISTIC
/begin CHARACTERISTIC FCdc4_APUD23_min "FCtl_DTC_0x04(388)" VALUE 0x00163ED8 /* @ECU_Address@FCtl_DTC_0x04@0x024C4308@ */ ECIPP_ALIGNMENT_UWORD 65535 Compu_IDENTITY 0 65535 PHYS_UNIT "System ID + DTC" /end CHARACTERISTIC
/begin CHARACTERISTIC FCdc4_APUD24_max "FCtl_DTC_0x04(389)" VALUE 0x00163EDA /* @ECU_Address@FCtl_DTC_0x04@0x024C430A@ */ ECIPP_ALIGNMENT_UWORD 65535 Compu_IDENTITY 0 65535 PHYS_UNIT "System ID + DTC" /end CHARACTERISTIC
/begin CHARACTERISTIC FCdc4_APUD24_min "FCtl_DTC_0x04(390)" VALUE 0x00163EDC /* @ECU_Address@FCtl_DTC_0x04@0x024C430C@ */ ECIPP_ALIGNMENT_UWORD 65535 Compu_IDENTITY 0 65535 PHYS_UNIT "System ID + DTC" /end CHARACTERISTIC
/begin CHARACTERISTIC FCdc4_APUD25_max "FCtl_DTC_0x04(391)" VALUE 0x00163EDE /* @ECU_Address@FCtl_DTC_0x04@0x024C430E@ */ ECIPP_ALIGNMENT_UWORD 65535 Compu_IDENTITY 0 65535 PHYS_UNIT "System ID + DTC" /end CHARACTERISTIC
/begin CHARACTERISTIC FCdc4_APUD25_min "FCtl_DTC_0x04(392)" VALUE 0x00163EE0 /* @ECU_Address@FCtl_DTC_0x04@0x024C4310@ */ ECIPP_ALIGNMENT_UWORD 65535 Compu_IDENTITY 0 65535 PHYS_UNIT "System ID + DTC" /end CHARACTERISTIC
/begin CHARACTERISTIC FCdc4_APUD3_max "FCtl_DTC_0x04(207)" VALUE 0x00163D6E /* @ECU_Address@FCtl_DTC_0x04@0x024C419E@ */ ECIPP_ALIGNMENT_UWORD 65535 Compu_IDENTITY 0 65535 PHYS_UNIT "System ID + DTC" /end CHARACTERISTIC
/begin CHARACTERISTIC FCdc4_APUD3_min "FCtl_DTC_0x04(208)" VALUE 0x00163D70 /* @ECU_Address@FCtl_DTC_0x04@0x024C41A0@ */ ECIPP_ALIGNMENT_UWORD 65535 Compu_IDENTITY 0 65535 PHYS_UNIT "System ID + DTC" /end CHARACTERISTIC
/begin CHARACTERISTIC FCdc4_APUD4_max "FCtl_DTC_0x04(280)" VALUE 0x00163E00 /* @ECU_Address@FCtl_DTC_0x04@0x024C4230@ */ ECIPP_ALIGNMENT_UWORD 65535 Compu_IDENTITY 0 65535 PHYS_UNIT "System ID + DTC" /end CHARACTERISTIC
/begin CHARACTERISTIC FCdc4_APUD4_min "FCtl_DTC_0x04(281)" VALUE 0x00163E02 /* @ECU_Address@FCtl_DTC_0x04@0x024C4232@ */ ECIPP_ALIGNMENT_UWORD 65535 Compu_IDENTITY 0 65535 PHYS_UNIT "System ID + DTC" /end CHARACTERISTIC
/begin CHARACTERISTIC FCdc4_APUD5_max "FCtl_DTC_0x04(331)" VALUE 0x00163E66 /* @ECU_Address@FCtl_DTC_0x04@0x024C4296@ */ ECIPP_ALIGNMENT_UWORD 65535 Compu_IDENTITY 0 65535 PHYS_UNIT "System ID + DTC" /end CHARACTERISTIC
/begin CHARACTERISTIC FCdc4_APUD5_min "FCtl_DTC_0x04(332)" VALUE 0x00163E68 /* @ECU_Address@FCtl_DTC_0x04@0x024C4298@ */ ECIPP_ALIGNMENT_UWORD 65535 Compu_IDENTITY 0 65535 PHYS_UNIT "System ID + DTC" /end CHARACTERISTIC
/begin CHARACTERISTIC FCdc4_APUD6_max "FCtl_DTC_0x04(333)" VALUE 0x00163E6A /* @ECU_Address@FCtl_DTC_0x04@0x024C429A@ */ ECIPP_ALIGNMENT_UWORD 65535 Compu_IDENTITY 0 65535 PHYS_UNIT "System ID + DTC" /end CHARACTERISTIC
/begin CHARACTERISTIC FCdc4_APUD6_min "FCtl_DTC_0x04(334)" VALUE 0x00163E6C /* @ECU_Address@FCtl_DTC_0x04@0x024C429C@ */ ECIPP_ALIGNMENT_UWORD 65535 Compu_IDENTITY 0 65535 PHYS_UNIT "System ID + DTC" /end CHARACTERISTIC
/begin CHARACTERISTIC FCdc4_APUD7_max "FCtl_DTC_0x04(335)" VALUE 0x00163E6E /* @ECU_Address@FCtl_DTC_0x04@0x024C429E@ */ ECIPP_ALIGNMENT_UWORD 65535 Compu_IDENTITY 0 65535 PHYS_UNIT "System ID + DTC" /end CHARACTERISTIC
/begin CHARACTERISTIC FCdc4_APUD7_min "FCtl_DTC_0x04(336)" VALUE 0x00163E70 /* @ECU_Address@FCtl_DTC_0x04@0x024C42A0@ */ ECIPP_ALIGNMENT_UWORD 65535 Compu_IDENTITY 0 65535 PHYS_UNIT "System ID + DTC" /end CHARACTERISTIC
/begin CHARACTERISTIC FCdc4_APUD8_max "FCtl_DTC_0x04(352)" VALUE 0x00163E90 /* @ECU_Address@FCtl_DTC_0x04@0x024C42C0@ */ ECIPP_ALIGNMENT_UWORD 65535 Compu_IDENTITY 0 65535 PHYS_UNIT "System ID + DTC" /end CHARACTERISTIC
/begin CHARACTERISTIC FCdc4_APUD8_min "FCtl_DTC_0x04(353)" VALUE 0x00163E92 /* @ECU_Address@FCtl_DTC_0x04@0x024C42C2@ */ ECIPP_ALIGNMENT_UWORD 65535 Compu_IDENTITY 0 65535 PHYS_UNIT "System ID + DTC" /end CHARACTERISTIC
/begin CHARACTERISTIC FCdc4_APUD9_max "FCtl_DTC_0x04(359)" VALUE 0x00163E9E /* @ECU_Address@FCtl_DTC_0x04@0x024C42CE@ */ ECIPP_ALIGNMENT_UWORD 65535 Compu_IDENTITY 0 65535 PHYS_UNIT "System ID + DTC" /end CHARACTERISTIC
/begin CHARACTERISTIC FCdc4_APUD9_min "FCtl_DTC_0x04(360)" VALUE 0x00163EA0 /* @ECU_Address@FCtl_DTC_0x04@0x024C42D0@ */ ECIPP_ALIGNMENT_UWORD 65535 Compu_IDENTITY 0 65535 PHYS_UNIT "System ID + DTC" /end CHARACTERISTIC
/begin CHARACTERISTIC FCdc4_AWP_intF "FCtl_DTC_0x04(832)" VALUE 0x00164250 /* @ECU_Address@FCtl_DTC_0x04@0x024C4680@ */ ECIPP_ALIGNMENT_UWORD 65535 Compu_IDENTITY 0 65535 PHYS_UNIT "System ID + DTC" /end CHARACTERISTIC
/begin CHARACTERISTIC FCdc4_BP_max "FCtl_DTC_0x04(7)" VALUE 0x00163BDE /* @ECU_Address@FCtl_DTC_0x04@0x024C400E@ */ ECIPP_ALIGNMENT_UWORD 65535 Compu_IDENTITY 0 65535 PHYS_UNIT "System ID + DTC" /end CHARACTERISTIC
/begin CHARACTERISTIC FCdc4_BP_min "FCtl_DTC_0x04(8)" VALUE 0x00163BE0 /* @ECU_Address@FCtl_DTC_0x04@0x024C4010@ */ ECIPP_ALIGNMENT_UWORD 65535 Compu_IDENTITY 0 65535 PHYS_UNIT "System ID + DTC" /end CHARACTERISTIC
/begin CHARACTERISTIC FCdc4_BPS1_max "FCtl_DTC_0x04(474)" VALUE 0x00163F84 /* @ECU_Address@FCtl_DTC_0x04@0x024C43B4@ */ ECIPP_ALIGNMENT_UWORD 65535 Compu_IDENTITY 0 65535 PHYS_UNIT "System ID + DTC" /end CHARACTERISTIC
/begin CHARACTERISTIC FCdc4_BPS1_min "FCtl_DTC_0x04(475)" VALUE 0x00163F86 /* @ECU_Address@FCtl_DTC_0x04@0x024C43B6@ */ ECIPP_ALIGNMENT_UWORD 65535 Compu_IDENTITY 0 65535 PHYS_UNIT "System ID + DTC" /end CHARACTERISTIC
/begin CHARACTERISTIC FCdc4_BPS12_OOR "FCtl_DTC_0x04(482)" VALUE 0x00163F94 /* @ECU_Address@FCtl_DTC_0x04@0x024C43C4@ */ ECIPP_ALIGNMENT_UWORD 65535 Compu_IDENTITY 0 65535 PHYS_UNIT "System ID + DTC" /end CHARACTERISTIC
/begin CHARACTERISTIC FCdc4_BPS12pct_hi "FCtl_DTC_0x04(478)" VALUE 0x00163F8C /* @ECU_Address@FCtl_DTC_0x04@0x024C43BC@ */ ECIPP_ALIGNMENT_UWORD 65535 Compu_IDENTITY 0 65535 PHYS_UNIT "System ID + DTC" /end CHARACTERISTIC
/begin CHARACTERISTIC FCdc4_BPS12pct_lo "FCtl_DTC_0x04(479)" VALUE 0x00163F8E /* @ECU_Address@FCtl_DTC_0x04@0x024C43BE@ */ ECIPP_ALIGNMENT_UWORD 65535 Compu_IDENTITY 0 65535 PHYS_UNIT "System ID + DTC" /end CHARACTERISTIC
/begin CHARACTERISTIC FCdc4_BPS2_max "FCtl_DTC_0x04(476)" VALUE 0x00163F88 /* @ECU_Address@FCtl_DTC_0x04@0x024C43B8@ */ ECIPP_ALIGNMENT_UWORD 65535 Compu_IDENTITY 0 65535 PHYS_UNIT "System ID + DTC" /end CHARACTERISTIC
/begin CHARACTERISTIC FCdc4_BPS2_min "FCtl_DTC_0x04(477)" VALUE 0x00163F8A /* @ECU_Address@FCtl_DTC_0x04@0x024C43BA@ */ ECIPP_ALIGNMENT_UWORD 65535 Compu_IDENTITY 0 65535 PHYS_UNIT "System ID + DTC" /end CHARACTERISTIC
/begin CHARACTERISTIC FCdc4_BPSerr_neg "FCtl_DTC_0x04(481)" VALUE 0x00163F92 /* @ECU_Address@FCtl_DTC_0x04@0x024C43C2@ */ ECIPP_ALIGNMENT_UWORD 65535 Compu_IDENTITY 0 65535 PHYS_UNIT "System ID + DTC" /end CHARACTERISTIC
/begin CHARACTERISTIC FCdc4_BPSerr_pos "FCtl_DTC_0x04(480)" VALUE 0x00163F90 /* @ECU_Address@FCtl_DTC_0x04@0x024C43C0@ */ ECIPP_ALIGNMENT_UWORD 65535 Compu_IDENTITY 0 65535 PHYS_UNIT "System ID + DTC" /end CHARACTERISTIC
/begin CHARACTERISTIC FCdc4_brake_gndshort "FCtl_DTC_0x04(329)" VALUE 0x00163E62 /* @ECU_Address@FCtl_DTC_0x04@0x024C4292@ */ ECIPP_ALIGNMENT_UWORD 65535 Compu_IDENTITY 0 65535 PHYS_UNIT "System ID + DTC" /end CHARACTERISTIC
/begin CHARACTERISTIC FCdc4_brake_pwrshort "FCtl_DTC_0x04(330)" VALUE 0x00163E64 /* @ECU_Address@FCtl_DTC_0x04@0x024C4294@ */ ECIPP_ALIGNMENT_UWORD 65535 Compu_IDENTITY 0 65535 PHYS_UNIT "System ID + DTC" /end CHARACTERISTIC
/begin CHARACTERISTIC FCdc4_bst_MAT_derate_actv "FCtl_DTC_0x04(811)" VALUE 0x00164226 /* @ECU_Address@FCtl_DTC_0x04@0x024C4656@ */ ECIPP_ALIGNMENT_UWORD 65535 Compu_IDENTITY 0 65535 PHYS_UNIT "System ID + DTC" /end CHARACTERISTIC
/begin CHARACTERISTIC FCdc4_BstTIP_Hi "FCtl_DTC_0x04(143)" VALUE 0x00163CEE /* @ECU_Address@FCtl_DTC_0x04@0x024C411E@ */ ECIPP_ALIGNMENT_UWORD 65535 Compu_IDENTITY 0 65535 PHYS_UNIT "System ID + DTC" /end CHARACTERISTIC
/begin CHARACTERISTIC FCdc4_BstTIP_Lo "FCtl_DTC_0x04(144)" VALUE 0x00163CF0 /* @ECU_Address@FCtl_DTC_0x04@0x024C4120@ */ ECIPP_ALIGNMENT_UWORD 65535 Compu_IDENTITY 0 65535 PHYS_UNIT "System ID + DTC" /end CHARACTERISTIC
/begin CHARACTERISTIC FCdc4_BstTIP_Lo2 "FCtl_DTC_0x04(686)" VALUE 0x0016412C /* @ECU_Address@FCtl_DTC_0x04@0x024C455C@ */ ECIPP_ALIGNMENT_UWORD 65535 Compu_IDENTITY 0 65535 PHYS_UNIT "System ID + DTC" /end CHARACTERISTIC
/begin CHARACTERISTIC FCdc4_BstTIP_slow "FCtl_DTC_0x04(655)" VALUE 0x001640EE /* @ECU_Address@FCtl_DTC_0x04@0x024C451E@ */ ECIPP_ALIGNMENT_UWORD 65535 Compu_IDENTITY 0 65535 PHYS_UNIT "System ID + DTC" /end CHARACTERISTIC
/begin CHARACTERISTIC FCdc4_buzz_coilopen "FCtl_DTC_0x04(165)" VALUE 0x00163D1A /* @ECU_Address@FCtl_DTC_0x04@0x024C414A@ */ ECIPP_ALIGNMENT_UWORD 65535 Compu_IDENTITY 0 65535 PHYS_UNIT "System ID + DTC" /end CHARACTERISTIC
/begin CHARACTERISTIC FCdc4_buzz_coilshort "FCtl_DTC_0x04(166)" VALUE 0x00163D1C /* @ECU_Address@FCtl_DTC_0x04@0x024C414C@ */ ECIPP_ALIGNMENT_UWORD 65535 Compu_IDENTITY 0 65535 PHYS_UNIT "System ID + DTC" /end CHARACTERISTIC
/begin CHARACTERISTIC FCdc4_buzz_gndshort "FCtl_DTC_0x04(164)" VALUE 0x00163D18 /* @ECU_Address@FCtl_DTC_0x04@0x024C4148@ */ ECIPP_ALIGNMENT_UWORD 65535 Compu_IDENTITY 0 65535 PHYS_UNIT "System ID + DTC" /end CHARACTERISTIC
/begin CHARACTERISTIC FCdc4_CAC_eta_lo "FCtl_DTC_0x04(656)" VALUE 0x001640F0 /* @ECU_Address@FCtl_DTC_0x04@0x024C4520@ */ ECIPP_ALIGNMENT_UWORD 65535 Compu_IDENTITY 0 65535 PHYS_UNIT "System ID + DTC" /end CHARACTERISTIC
/begin CHARACTERISTIC FCdc4_cal_config "FCtl_DTC_0x04(319)" VALUE 0x00163E4E /* @ECU_Address@FCtl_DTC_0x04@0x024C427E@ */ ECIPP_ALIGNMENT_UWORD 65535 Compu_IDENTITY 0 65535 PHYS_UNIT "System ID + DTC" /end CHARACTERISTIC
/begin CHARACTERISTIC FCdc4_cam2loss "FCtl_DTC_0x04(690)" VALUE 0x00164134 /* @ECU_Address@FCtl_DTC_0x04@0x024C4564@ */ ECIPP_ALIGNMENT_UWORD 65535 Compu_IDENTITY 0 65535 PHYS_UNIT "System ID + DTC" /end CHARACTERISTIC
/begin CHARACTERISTIC FCdc4_camloss "FCtl_DTC_0x04(95)" VALUE 0x00163C8E /* @ECU_Address@FCtl_DTC_0x04@0x024C40BE@ */ ECIPP_ALIGNMENT_UWORD 65535 Compu_IDENTITY 0 65535 PHYS_UNIT "System ID + DTC" /end CHARACTERISTIC
/begin CHARACTERISTIC FCdc4_camnoise "FCtl_DTC_0x04(96)" VALUE 0x00163C90 /* @ECU_Address@FCtl_DTC_0x04@0x024C40C0@ */ ECIPP_ALIGNMENT_UWORD 65535 Compu_IDENTITY 0 65535 PHYS_UNIT "System ID + DTC" /end CHARACTERISTIC
/begin CHARACTERISTIC FCdc4_CATdP_hi "FCtl_DTC_0x04(526)" VALUE 0x00163FEC /* @ECU_Address@FCtl_DTC_0x04@0x024C441C@ */ ECIPP_ALIGNMENT_UWORD 65535 Compu_IDENTITY 0 65535 PHYS_UNIT "System ID + DTC" /end CHARACTERISTIC
/begin CHARACTERISTIC FCdc4_CATdP_lo "FCtl_DTC_0x04(525)" VALUE 0x00163FEA /* @ECU_Address@FCtl_DTC_0x04@0x024C441A@ */ ECIPP_ALIGNMENT_UWORD 65535 Compu_IDENTITY 0 65535 PHYS_UNIT "System ID + DTC" /end CHARACTERISTIC
/begin CHARACTERISTIC FPnd_APUD12_min "FPrm_pending(275)" VALUE 0x00164B92 /* @ECU_Address@FPrm_pending@0x021BE226@ */ ECIPP_ALIGNMENT_UWORD 65535 Compu_IDENTITY 0 65535 PHYS_UNIT "Bit Mask" /end CHARACTERISTIC
/begin CHARACTERISTIC FPnd_APUD13_max "FPrm_pending(276)" VALUE 0x00164B94 /* @ECU_Address@FPrm_pending@0x021BE228@ */ ECIPP_ALIGNMENT_UWORD 65535 Compu_IDENTITY 0 65535 PHYS_UNIT "Bit Mask" /end CHARACTERISTIC
/begin CHARACTERISTIC FPnd_APUD13_min "FPrm_pending(277)" VALUE 0x00164B96 /* @ECU_Address@FPrm_pending@0x021BE22A@ */ ECIPP_ALIGNMENT_UWORD 65535 Compu_IDENTITY 0 65535 PHYS_UNIT "Bit Mask" /end CHARACTERISTIC
/begin CHARACTERISTIC FPnd_APUD14_max "FPrm_pending(278)" VALUE 0x00164B98 /* @ECU_Address@FPrm_pending@0x021BE22C@ */ ECIPP_ALIGNMENT_UWORD 65535 Compu_IDENTITY 0 65535 PHYS_UNIT "Bit Mask" /end CHARACTERISTIC
/begin CHARACTERISTIC FPnd_APUD14_min "FPrm_pending(279)" VALUE 0x00164B9A /* @ECU_Address@FPrm_pending@0x021BE22E@ */ ECIPP_ALIGNMENT_UWORD 65535 Compu_IDENTITY 0 65535 PHYS_UNIT "Bit Mask" /end CHARACTERISTIC
/begin CHARACTERISTIC FPnd_APUD15_max "FPrm_pending(280)" VALUE 0x00164B9C /* @ECU_Address@FPrm_pending@0x021BE230@ */ ECIPP_ALIGNMENT_UWORD 65535 Compu_IDENTITY 0 65535 PHYS_UNIT "Bit Mask" /end CHARACTERISTIC
/begin CHARACTERISTIC FPnd_APUD15_min "FPrm_pending(281)" VALUE 0x00164B9E /* @ECU_Address@FPrm_pending@0x021BE232@ */ ECIPP_ALIGNMENT_UWORD 65535 Compu_IDENTITY 0 65535 PHYS_UNIT "Bit Mask" /end CHARACTERISTIC
/begin CHARACTERISTIC FPnd_APUD16_max "FPrm_pending(282)" VALUE 0x00164BA0 /* @ECU_Address@FPrm_pending@0x021BE234@ */ ECIPP_ALIGNMENT_UWORD 65535 Compu_IDENTITY 0 65535 PHYS_UNIT "Bit Mask" /end CHARACTERISTIC
/begin CHARACTERISTIC FPnd_APUD16_min "FPrm_pending(283)" VALUE 0x00164BA2 /* @ECU_Address@FPrm_pending@0x021BE236@ */ ECIPP_ALIGNMENT_UWORD 65535 Compu_IDENTITY 0 65535 PHYS_UNIT "Bit Mask" /end CHARACTERISTIC
/begin CHARACTERISTIC FPnd_APUD17_max "FPrm_pending(284)" VALUE 0x00164BA4 /* @ECU_Address@FPrm_pending@0x021BE238@ */ ECIPP_ALIGNMENT_UWORD 65535 Compu_IDENTITY 0 65535 PHYS_UNIT "Bit Mask" /end CHARACTERISTIC
/begin CHARACTERISTIC FPnd_APUD17_min "FPrm_pending(285)" VALUE 0x00164BA6 /* @ECU_Address@FPrm_pending@0x021BE23A@ */ ECIPP_ALIGNMENT_UWORD 65535 Compu_IDENTITY 0 65535 PHYS_UNIT "Bit Mask" /end CHARACTERISTIC
/begin CHARACTERISTIC FPnd_APUD18_max "FPrm_pending(286)" VALUE 0x00164BA8 /* @ECU_Address@FPrm_pending@0x021BE23C@ */ ECIPP_ALIGNMENT_UWORD 65535 Compu_IDENTITY 0 65535 PHYS_UNIT "Bit Mask" /end CHARACTERISTIC
/begin CHARACTERISTIC FPnd_APUD18_min "FPrm_pending(287)" VALUE 0x00164BAA /* @ECU_Address@FPrm_pending@0x021BE23E@ */ ECIPP_ALIGNMENT_UWORD 65535 Compu_IDENTITY 0 65535 PHYS_UNIT "Bit Mask" /end CHARACTERISTIC
/begin CHARACTERISTIC FPnd_APUD19_max "FPrm_pending(288)" VALUE 0x00164BAC /* @ECU_Address@FPrm_pending@0x021BE240@ */ ECIPP_ALIGNMENT_UWORD 65535 Compu_IDENTITY 0 65535 PHYS_UNIT "Bit Mask" /end CHARACTERISTIC
/begin CHARACTERISTIC FPnd_APUD19_min "FPrm_pending(289)" VALUE 0x00164BAE /* @ECU_Address@FPrm_pending@0x021BE242@ */ ECIPP_ALIGNMENT_UWORD 65535 Compu_IDENTITY 0 65535 PHYS_UNIT "Bit Mask" /end CHARACTERISTIC
/begin CHARACTERISTIC FPnd_APUD2_max "FPrm_pending(161)" VALUE 0x00164AAE /* @ECU_Address@FPrm_pending@0x021BE142@ */ ECIPP_ALIGNMENT_UWORD 65535 Compu_IDENTITY 0 65535 PHYS_UNIT "Bit Mask" /end CHARACTERISTIC
/begin CHARACTERISTIC FPnd_APUD2_min "FPrm_pending(162)" VALUE 0x00164AB0 /* @ECU_Address@FPrm_pending@0x021BE144@ */ ECIPP_ALIGNMENT_UWORD 65535 Compu_IDENTITY 0 65535 PHYS_UNIT "Bit Mask" /end CHARACTERISTIC
/begin CHARACTERISTIC FPnd_APUD20_max "FPrm_pending(290)" VALUE 0x00164BB0 /* @ECU_Address@FPrm_pending@0x021BE244@ */ ECIPP_ALIGNMENT_UWORD 65535 Compu_IDENTITY 0 65535 PHYS_UNIT "Bit Mask" /end CHARACTERISTIC
/begin CHARACTERISTIC FPnd_APUD20_min "FPrm_pending(291)" VALUE 0x00164BB2 /* @ECU_Address@FPrm_pending@0x021BE246@ */ ECIPP_ALIGNMENT_UWORD 65535 Compu_IDENTITY 0 65535 PHYS_UNIT "Bit Mask" /end CHARACTERISTIC
/begin CHARACTERISTIC FPnd_APUD21_max "FPrm_pending(292)" VALUE 0x00164BB4 /* @ECU_Address@FPrm_pending@0x021BE248@ */ ECIPP_ALIGNMENT_UWORD 65535 Compu_IDENTITY 0 65535 PHYS_UNIT "Bit Mask" /end CHARACTERISTIC
/begin CHARACTERISTIC FPnd_APUD21_min "FPrm_pending(293)" VALUE 0x00164BB6 /* @ECU_Address@FPrm_pending@0x021BE24A@ */ ECIPP_ALIGNMENT_UWORD 65535 Compu_IDENTITY 0 65535 PHYS_UNIT "Bit Mask" /end CHARACTERISTIC
/begin CHARACTERISTIC FPnd_APUD22_max "FPrm_pending(294)" VALUE 0x00164BB8 /* @ECU_Address@FPrm_pending@0x021BE24C@ */ ECIPP_ALIGNMENT_UWORD 65535 Compu_IDENTITY 0 65535 PHYS_UNIT "Bit Mask" /end CHARACTERISTIC
/begin CHARACTERISTIC FPnd_APUD22_min "FPrm_pending(295)" VALUE 0x00164BBA /* @ECU_Address@FPrm_pending@0x021BE24E@ */ ECIPP_ALIGNMENT_UWORD 65535 Compu_IDENTITY 0 65535 PHYS_UNIT "Bit Mask" /end CHARACTERISTIC
/begin CHARACTERISTIC FPnd_APUD23_max "FPrm_pending(296)" VALUE 0x00164BBC /* @ECU_Address@FPrm_pending@0x021BE250@ */ ECIPP_ALIGNMENT_UWORD 65535 Compu_IDENTITY 0 65535 PHYS_UNIT "Bit Mask" /end CHARACTERISTIC
/begin CHARACTERISTIC FPnd_APUD23_min "FPrm_pending(297)" VALUE 0x00164BBE /* @ECU_Address@FPrm_pending@0x021BE252@ */ ECIPP_ALIGNMENT_UWORD 65535 Compu_IDENTITY 0 65535 PHYS_UNIT "Bit Mask" /end CHARACTERISTIC
/begin CHARACTERISTIC FPnd_APUD24_max "FPrm_pending(298)" VALUE 0x00164BC0 /* @ECU_Address@FPrm_pending@0x021BE254@ */ ECIPP_ALIGNMENT_UWORD 65535 Compu_IDENTITY 0 65535 PHYS_UNIT "Bit Mask" /end CHARACTERISTIC
/begin CHARACTERISTIC FPnd_APUD24_min "FPrm_pending(299)" VALUE 0x00164BC2 /* @ECU_Address@FPrm_pending@0x021BE256@ */ ECIPP_ALIGNMENT_UWORD 65535 Compu_IDENTITY 0 65535 PHYS_UNIT "Bit Mask" /end CHARACTERISTIC
/begin CHARACTERISTIC FPnd_APUD25_max "FPrm_pending(300)" VALUE 0x00164BC4 /* @ECU_Address@FPrm_pending@0x021BE258@ */ ECIPP_ALIGNMENT_UWORD 65535 Compu_IDENTITY 0 65535 PHYS_UNIT "Bit Mask" /end CHARACTERISTIC
/begin CHARACTERISTIC FPnd_APUD25_min "FPrm_pending(301)" VALUE 0x00164BC6 /* @ECU_Address@FPrm_pending@0x021BE25A@ */ ECIPP_ALIGNMENT_UWORD 65535 Compu_IDENTITY 0 65535 PHYS_UNIT "Bit Mask" /end CHARACTERISTIC
/begin CHARACTERISTIC FPnd_APUD3_max "FPrm_pending(163)" VALUE 0x00164AB2 /* @ECU_Address@FPrm_pending@0x021BE146@ */ ECIPP_ALIGNMENT_UWORD 65535 Compu_IDENTITY 0 65535 PHYS_UNIT "Bit Mask" /end CHARACTERISTIC
/begin CHARACTERISTIC FPnd_APUD3_min "FPrm_pending(164)" VALUE 0x00164AB4 /* @ECU_Address@FPrm_pending@0x021BE148@ */ ECIPP_ALIGNMENT_UWORD 65535 Compu_IDENTITY 0 65535 PHYS_UNIT "Bit Mask" /end CHARACTERISTIC
/begin CHARACTERISTIC FPnd_APUD4_max "FPrm_pending(202)" VALUE 0x00164B00 /* @ECU_Address@FPrm_pending@0x021BE194@ */ ECIPP_ALIGNMENT_UWORD 65535 Compu_IDENTITY 0 65535 PHYS_UNIT "Bit Mask" /end CHARACTERISTIC
/begin CHARACTERISTIC FPnd_APUD4_min "FPrm_pending(203)" VALUE 0x00164B02 /* @ECU_Address@FPrm_pending@0x021BE196@ */ ECIPP_ALIGNMENT_UWORD 65535 Compu_IDENTITY 0 65535 PHYS_UNIT "Bit Mask" /end CHARACTERISTIC
/begin CHARACTERISTIC FPnd_APUD5_max "FPrm_pending(240)" VALUE 0x00164B4C /* @ECU_Address@FPrm_pending@0x021BE1E0@ */ ECIPP_ALIGNMENT_UWORD 65535 Compu_IDENTITY 0 65535 PHYS_UNIT "Bit Mask" /end CHARACTERISTIC
/begin CHARACTERISTIC FPnd_APUD5_min "FPrm_pending(241)" VALUE 0x00164B4E /* @ECU_Address@FPrm_pending@0x021BE1E2@ */ ECIPP_ALIGNMENT_UWORD 65535 Compu_IDENTITY 0 65535 PHYS_UNIT "Bit Mask" /end CHARACTERISTIC
/begin CHARACTERISTIC FPnd_APUD6_max "FPrm_pending(242)" VALUE 0x00164B50 /* @ECU_Address@FPrm_pending@0x021BE1E4@ */ ECIPP_ALIGNMENT_UWORD 65535 Compu_IDENTITY 0 65535 PHYS_UNIT "Bit Mask" /end CHARACTERISTIC
/begin CHARACTERISTIC FPnd_APUD6_min "FPrm_pending(243)" VALUE 0x00164B52 /* @ECU_Address@FPrm_pending@0x021BE1E6@ */ ECIPP_ALIGNMENT_UWORD 65535 Compu_IDENTITY 0 65535 PHYS_UNIT "Bit Mask" /end CHARACTERISTIC
/begin CHARACTERISTIC FPnd_APUD7_max "FPrm_pending(244)" VALUE 0x00164B54 /* @ECU_Address@FPrm_pending@0x021BE1E8@ */ ECIPP_ALIGNMENT_UWORD 65535 Compu_IDENTITY 0 65535 PHYS_UNIT "Bit Mask" /end CHARACTERISTIC
/begin CHARACTERISTIC FPnd_APUD7_min "FPrm_pending(245)" VALUE 0x00164B56 /* @ECU_Address@FPrm_pending@0x021BE1EA@ */ ECIPP_ALIGNMENT_UWORD 65535 Compu_IDENTITY 0 65535 PHYS_UNIT "Bit Mask" /end CHARACTERISTIC
/begin CHARACTERISTIC FPnd_APUD8_max "FPrm_pending(261)" VALUE 0x00164B76 /* @ECU_Address@FPrm_pending@0x021BE20A@ */ ECIPP_ALIGNMENT_UWORD 65535 Compu_IDENTITY 0 65535 PHYS_UNIT "Bit Mask" /end CHARACTERISTIC
/begin CHARACTERISTIC FPnd_APUD8_min "FPrm_pending(262)" VALUE 0x00164B78 /* @ECU_Address@FPrm_pending@0x021BE20C@ */ ECIPP_ALIGNMENT_UWORD 65535 Compu_IDENTITY 0 65535 PHYS_UNIT "Bit Mask" /end CHARACTERISTIC
/begin CHARACTERISTIC FPnd_APUD9_max "FPrm_pending(268)" VALUE 0x00164B84 /* @ECU_Address@FPrm_pending@0x021BE218@ */ ECIPP_ALIGNMENT_UWORD 65535 Compu_IDENTITY 0 65535 PHYS_UNIT "Bit Mask" /end CHARACTERISTIC
/begin CHARACTERISTIC FPnd_APUD9_min "FPrm_pending(269)" VALUE 0x00164B86 /* @ECU_Address@FPrm_pending@0x021BE21A@ */ ECIPP_ALIGNMENT_UWORD 65535 Compu_IDENTITY 0 65535 PHYS_UNIT "Bit Mask" /end CHARACTERISTIC
/begin CHARACTERISTIC FPnd_AWP_intF "FPrm_pending(659)" VALUE 0x00164E92 /* @ECU_Address@FPrm_pending@0x021BE526@ */ ECIPP_ALIGNMENT_UWORD 65535 Compu_IDENTITY 0 65535 PHYS_UNIT "Bit Mask" /end CHARACTERISTIC
/begin CHARACTERISTIC FPnd_BP_max "FPrm_pending(10)" VALUE 0x00164980 /* @ECU_Address@FPrm_pending@0x021BE014@ */ ECIPP_ALIGNMENT_UWORD 65535 Compu_IDENTITY 0 65535 PHYS_UNIT "Bit Mask" /end CHARACTERISTIC
/begin CHARACTERISTIC FPnd_BP_min "FPrm_pending(11)" VALUE 0x00164982 /* @ECU_Address@FPrm_pending@0x021BE016@ */ ECIPP_ALIGNMENT_UWORD 65535 Compu_IDENTITY 0 65535 PHYS_UNIT "Bit Mask" /end CHARACTERISTIC
/begin CHARACTERISTIC FPnd_BPS1_max "FPrm_pending(371)" VALUE 0x00164C52 /* @ECU_Address@FPrm_pending@0x021BE2E6@ */ ECIPP_ALIGNMENT_UWORD 65535 Compu_IDENTITY 0 65535 PHYS_UNIT "Bit Mask" /end CHARACTERISTIC
/begin CHARACTERISTIC FPnd_BPS1_min "FPrm_pending(372)" VALUE 0x00164C54 /* @ECU_Address@FPrm_pending@0x021BE2E8@ */ ECIPP_ALIGNMENT_UWORD 65535 Compu_IDENTITY 0 65535 PHYS_UNIT "Bit Mask" /end CHARACTERISTIC
/begin CHARACTERISTIC FPnd_BPS12_OOR "FPrm_pending(379)" VALUE 0x00164C62 /* @ECU_Address@FPrm_pending@0x021BE2F6@ */ ECIPP_ALIGNMENT_UWORD 65535 Compu_IDENTITY 0 65535 PHYS_UNIT "Bit Mask" /end CHARACTERISTIC
/begin CHARACTERISTIC FPnd_BPS12pct_hi "FPrm_pending(375)" VALUE 0x00164C5A /* @ECU_Address@FPrm_pending@0x021BE2EE@ */ ECIPP_ALIGNMENT_UWORD 65535 Compu_IDENTITY 0 65535 PHYS_UNIT "Bit Mask" /end CHARACTERISTIC
/begin CHARACTERISTIC FPnd_BPS12pct_lo "FPrm_pending(376)" VALUE 0x00164C5C /* @ECU_Address@FPrm_pending@0x021BE2F0@ */ ECIPP_ALIGNMENT_UWORD 65535 Compu_IDENTITY 0 65535 PHYS_UNIT "Bit Mask" /end CHARACTERISTIC
/begin CHARACTERISTIC FPnd_BPS2_max "FPrm_pending(373)" VALUE 0x00164C56 /* @ECU_Address@FPrm_pending@0x021BE2EA@ */ ECIPP_ALIGNMENT_UWORD 65535 Compu_IDENTITY 0 65535 PHYS_UNIT "Bit Mask" /end CHARACTERISTIC
/begin CHARACTERISTIC FPnd_BPS2_min "FPrm_pending(374)" VALUE 0x00164C58 /* @ECU_Address@FPrm_pending@0x021BE2EC@ */ ECIPP_ALIGNMENT_UWORD 65535 Compu_IDENTITY 0 65535 PHYS_UNIT "Bit Mask" /end CHARACTERISTIC
/begin CHARACTERISTIC FPnd_BPSerr_neg "FPrm_pending(378)" VALUE 0x00164C60 /* @ECU_Address@FPrm_pending@0x021BE2F4@ */ ECIPP_ALIGNMENT_UWORD 65535 Compu_IDENTITY 0 65535 PHYS_UNIT "Bit Mask" /end CHARACTERISTIC
/begin CHARACTERISTIC FPnd_BPSerr_pos "FPrm_pending(377)" VALUE 0x00164C5E /* @ECU_Address@FPrm_pending@0x021BE2F2@ */ ECIPP_ALIGNMENT_UWORD 65535 Compu_IDENTITY 0 65535 PHYS_UNIT "Bit Mask" /end CHARACTERISTIC
/begin CHARACTERISTIC FPnd_brake_gndshort "FPrm_pending(238)" VALUE 0x00164B48 /* @ECU_Address@FPrm_pending@0x021BE1DC@ */ ECIPP_ALIGNMENT_UWORD 65535 Compu_IDENTITY 0 65535 PHYS_UNIT "Bit Mask" /end CHARACTERISTIC
/begin CHARACTERISTIC FPnd_brake_pwrshort "FPrm_pending(239)" VALUE 0x00164B4A /* @ECU_Address@FPrm_pending@0x021BE1DE@ */ ECIPP_ALIGNMENT_UWORD 65535 Compu_IDENTITY 0 65535 PHYS_UNIT "Bit Mask" /end CHARACTERISTIC
/begin CHARACTERISTIC FPnd_bst_MAT_derate_actv "FPrm_pending(638)" VALUE 0x00164E68 /* @ECU_Address@FPrm_pending@0x021BE4FC@ */ ECIPP_ALIGNMENT_UWORD 65535 Compu_IDENTITY 0 65535 PHYS_UNIT "Bit Mask" /end CHARACTERISTIC
/begin CHARACTERISTIC FPnd_BstTIP_Hi "FPrm_pending(103)" VALUE 0x00164A3A /* @ECU_Address@FPrm_pending@0x021BE0CE@ */ ECIPP_ALIGNMENT_UWORD 65535 Compu_IDENTITY 0 65535 PHYS_UNIT "Bit Mask" /end CHARACTERISTIC
/begin CHARACTERISTIC FPnd_BstTIP_Lo "FPrm_pending(104)" VALUE 0x00164A3C /* @ECU_Address@FPrm_pending@0x021BE0D0@ */ ECIPP_ALIGNMENT_UWORD 65535 Compu_IDENTITY 0 65535 PHYS_UNIT "Bit Mask" /end CHARACTERISTIC
/begin CHARACTERISTIC FPnd_BstTIP_Lo2 "FPrm_pending(516)" VALUE 0x00164D74 /* @ECU_Address@FPrm_pending@0x021BE408@ */ ECIPP_ALIGNMENT_UWORD 65535 Compu_IDENTITY 0 65535 PHYS_UNIT "Bit Mask" /end CHARACTERISTIC
/begin CHARACTERISTIC FPnd_BstTIP_slow "FPrm_pending(485)" VALUE 0x00164D36 /* @ECU_Address@FPrm_pending@0x021BE3CA@ */ ECIPP_ALIGNMENT_UWORD 65535 Compu_IDENTITY 0 65535 PHYS_UNIT "Bit Mask" /end CHARACTERISTIC
/begin CHARACTERISTIC FPnd_buzz_coilopen "FPrm_pending(125)" VALUE 0x00164A66 /* @ECU_Address@FPrm_pending@0x021BE0FA@ */ ECIPP_ALIGNMENT_UWORD 65535 Compu_IDENTITY 0 65535 PHYS_UNIT "Bit Mask" /end CHARACTERISTIC
/begin CHARACTERISTIC FPnd_buzz_coilshort "FPrm_pending(126)" VALUE 0x00164A68 /* @ECU_Address@FPrm_pending@0x021BE0FC@ */ ECIPP_ALIGNMENT_UWORD 65535 Compu_IDENTITY 0 65535 PHYS_UNIT "Bit Mask" /end CHARACTERISTIC
/begin CHARACTERISTIC FPnd_buzz_gndshort "FPrm_pending(124)" VALUE 0x00164A64 /* @ECU_Address@FPrm_pending@0x021BE0F8@ */ ECIPP_ALIGNMENT_UWORD 65535 Compu_IDENTITY 0 65535 PHYS_UNIT "Bit Mask" /end CHARACTERISTIC
/begin CHARACTERISTIC FPnd_CAC_eta_lo "FPrm_pending(486)" VALUE 0x00164D38 /* @ECU_Address@FPrm_pending@0x021BE3CC@ */ ECIPP_ALIGNMENT_UWORD 65535 Compu_IDENTITY 0 65535 PHYS_UNIT "Bit Mask" /end CHARACTERISTIC
/begin CHARACTERISTIC FPnd_cal_config "FPrm_pending(228)" VALUE 0x00164B34 /* @ECU_Address@FPrm_pending@0x021BE1C8@ */ ECIPP_ALIGNMENT_UWORD 65535 Compu_IDENTITY 0 65535 PHYS_UNIT "Bit Mask" /end CHARACTERISTIC
/begin CHARACTERISTIC FPnd_cam2loss "FPrm_pending(520)" VALUE 0x00164D7C /* @ECU_Address@FPrm_pending@0x021BE410@ */ ECIPP_ALIGNMENT_UWORD 65535 Compu_IDENTITY 0 65535 PHYS_UNIT "Bit Mask" /end CHARACTERISTIC
/begin CHARACTERISTIC FPnd_camloss "FPrm_pending(59)" VALUE 0x001649E2 /* @ECU_Address@FPrm_pending@0x021BE076@ */ ECIPP_ALIGNMENT_UWORD 65535 Compu_IDENTITY 0 65535 PHYS_UNIT "Bit Mask" /end CHARACTERISTIC
/begin CHARACTERISTIC FPnd_camnoise "FPrm_pending(60)" VALUE 0x001649E4 /* @ECU_Address@FPrm_pending@0x021BE078@ */ ECIPP_ALIGNMENT_UWORD 65535 Compu_IDENTITY 0 65535 PHYS_UNIT "Bit Mask" /end CHARACTERISTIC
/begin CHARACTERISTIC FPnd_CATdP_hi "FPrm_pending(396)" VALUE 0x00164C84 /* @ECU_Address@FPrm_pending@0x021BE318@ */ ECIPP_ALIGNMENT_UWORD 65535 Compu_IDENTITY 0 65535 PHYS_UNIT "Bit Mask" /end CHARACTERISTIC
/begin CHARACTERISTIC FPnd_CATdP_lo "FPrm_pending(395)" VALUE 0x00164C82 /* @ECU_Address@FPrm_pending@0x021BE316@ */ ECIPP_ALIGNMENT_UWORD 65535 Compu_IDENTITY 0 65535 PHYS_UNIT "Bit Mask" /end CHARACTERISTIC
/begin CHARACTERISTIC FPsvr_APUD12_min "FPrm_severity(275)" VALUE 0x00165EF1 /* @ECU_Address@FPrm_severity@0x024B3113@ */ ECIPP_ALIGNMENT_UBYTE 255 Compu_IDENTITY 0 255 PHYS_UNIT "Severity+Class" /end CHARACTERISTIC
/begin CHARACTERISTIC FPsvr_APUD13_max "FPrm_severity(276)" VALUE 0x00165EF2 /* @ECU_Address@FPrm_severity@0x024B3114@ */ ECIPP_ALIGNMENT_UBYTE 255 Compu_IDENTITY 0 255 PHYS_UNIT "Severity+Class" /end CHARACTERISTIC
/begin CHARACTERISTIC FPsvr_APUD13_min "FPrm_severity(277)" VALUE 0x00165EF3 /* @ECU_Address@FPrm_severity@0x024B3115@ */ ECIPP_ALIGNMENT_UBYTE 255 Compu_IDENTITY 0 255 PHYS_UNIT "Severity+Class" /end CHARACTERISTIC
/begin CHARACTERISTIC FPsvr_APUD14_max "FPrm_severity(278)" VALUE 0x00165EF4 /* @ECU_Address@FPrm_severity@0x024B3116@ */ ECIPP_ALIGNMENT_UBYTE 255 Compu_IDENTITY 0 255 PHYS_UNIT "Severity+Class" /end CHARACTERISTIC
/begin CHARACTERISTIC FPsvr_APUD14_min "FPrm_severity(279)" VALUE 0x00165EF5 /* @ECU_Address@FPrm_severity@0x024B3117@ */ ECIPP_ALIGNMENT_UBYTE 255 Compu_IDENTITY 0 255 PHYS_UNIT "Severity+Class" /end CHARACTERISTIC
/begin CHARACTERISTIC FPsvr_APUD15_max "FPrm_severity(280)" VALUE 0x00165EF6 /* @ECU_Address@FPrm_severity@0x024B3118@ */ ECIPP_ALIGNMENT_UBYTE 255 Compu_IDENTITY 0 255 PHYS_UNIT "Severity+Class" /end CHARACTERISTIC
/begin CHARACTERISTIC FPsvr_APUD15_min "FPrm_severity(281)" VALUE 0x00165EF7 /* @ECU_Address@FPrm_severity@0x024B3119@ */ ECIPP_ALIGNMENT_UBYTE 255 Compu_IDENTITY 0 255 PHYS_UNIT "Severity+Class" /end CHARACTERISTIC
/begin CHARACTERISTIC FPsvr_APUD16_max "FPrm_severity(282)" VALUE 0x00165EF8 /* @ECU_Address@FPrm_severity@0x024B311A@ */ ECIPP_ALIGNMENT_UBYTE 255 Compu_IDENTITY 0 255 PHYS_UNIT "Severity+Class" /end CHARACTERISTIC
/begin CHARACTERISTIC FPsvr_APUD16_min "FPrm_severity(283)" VALUE 0x00165EF9 /* @ECU_Address@FPrm_severity@0x024B311B@ */ ECIPP_ALIGNMENT_UBYTE 255 Compu_IDENTITY 0 255 PHYS_UNIT "Severity+Class" /end CHARACTERISTIC
/begin CHARACTERISTIC FPsvr_APUD17_max "FPrm_severity(284)" VALUE 0x00165EFA /* @ECU_Address@FPrm_severity@0x024B311C@ */ ECIPP_ALIGNMENT_UBYTE 255 Compu_IDENTITY 0 255 PHYS_UNIT "Severity+Class" /end CHARACTERISTIC
/begin CHARACTERISTIC FPsvr_APUD17_min "FPrm_severity(285)" VALUE 0x00165EFB /* @ECU_Address@FPrm_severity@0x024B311D@ */ ECIPP_ALIGNMENT_UBYTE 255 Compu_IDENTITY 0 255 PHYS_UNIT "Severity+Class" /end CHARACTERISTIC
/begin CHARACTERISTIC FPsvr_APUD18_max "FPrm_severity(286)" VALUE 0x00165EFC /* @ECU_Address@FPrm_severity@0x024B311E@ */ ECIPP_ALIGNMENT_UBYTE 255 Compu_IDENTITY 0 255 PHYS_UNIT "Severity+Class" /end CHARACTERISTIC
/begin CHARACTERISTIC FPsvr_APUD18_min "FPrm_severity(287)" VALUE 0x00165EFD /* @ECU_Address@FPrm_severity@0x024B311F@ */ ECIPP_ALIGNMENT_UBYTE 255 Compu_IDENTITY 0 255 PHYS_UNIT "Severity+Class" /end CHARACTERISTIC
/begin CHARACTERISTIC FPsvr_APUD19_max "FPrm_severity(288)" VALUE 0x00165EFE /* @ECU_Address@FPrm_severity@0x024B3120@ */ ECIPP_ALIGNMENT_UBYTE 255 Compu_IDENTITY 0 255 PHYS_UNIT "Severity+Class" /end CHARACTERISTIC
/begin CHARACTERISTIC FPsvr_APUD19_min "FPrm_severity(289)" VALUE 0x00165EFF /* @ECU_Address@FPrm_severity@0x024B3121@ */ ECIPP_ALIGNMENT_UBYTE 255 Compu_IDENTITY 0 255 PHYS_UNIT "Severity+Class" /end CHARACTERISTIC
/begin CHARACTERISTIC FPsvr_APUD2_max "FPrm_severity(161)" VALUE 0x00165E7F /* @ECU_Address@FPrm_severity@0x024B30A1@ */ ECIPP_ALIGNMENT_UBYTE 255 Compu_IDENTITY 0 255 PHYS_UNIT "Severity+Class" /end CHARACTERISTIC
/begin CHARACTERISTIC FPsvr_APUD2_min "FPrm_severity(162)" VALUE 0x00165E80 /* @ECU_Address@FPrm_severity@0x024B30A2@ */ ECIPP_ALIGNMENT_UBYTE 255 Compu_IDENTITY 0 255 PHYS_UNIT "Severity+Class" /end CHARACTERISTIC
/begin CHARACTERISTIC FPsvr_APUD20_max "FPrm_severity(290)" VALUE 0x00165F00 /* @ECU_Address@FPrm_severity@0x024B3122@ */ ECIPP_ALIGNMENT_UBYTE 255 Compu_IDENTITY 0 255 PHYS_UNIT "Severity+Class" /end CHARACTERISTIC
/begin CHARACTERISTIC FPsvr_APUD20_min "FPrm_severity(291)" VALUE 0x00165F01 /* @ECU_Address@FPrm_severity@0x024B3123@ */ ECIPP_ALIGNMENT_UBYTE 255 Compu_IDENTITY 0 255 PHYS_UNIT "Severity+Class" /end CHARACTERISTIC
/begin CHARACTERISTIC FPsvr_APUD21_max "FPrm_severity(292)" VALUE 0x00165F02 /* @ECU_Address@FPrm_severity@0x024B3124@ */ ECIPP_ALIGNMENT_UBYTE 255 Compu_IDENTITY 0 255 PHYS_UNIT "Severity+Class" /end CHARACTERISTIC
/begin CHARACTERISTIC FPsvr_APUD21_min "FPrm_severity(293)" VALUE 0x00165F03 /* @ECU_Address@FPrm_severity@0x024B3125@ */ ECIPP_ALIGNMENT_UBYTE 255 Compu_IDENTITY 0 255 PHYS_UNIT "Severity+Class" /end CHARACTERISTIC
/begin CHARACTERISTIC FPsvr_APUD22_max "FPrm_severity(294)" VALUE 0x00165F04 /* @ECU_Address@FPrm_severity@0x024B3126@ */ ECIPP_ALIGNMENT_UBYTE 255 Compu_IDENTITY 0 255 PHYS_UNIT "Severity+Class" /end CHARACTERISTIC
/begin CHARACTERISTIC FPsvr_APUD22_min "FPrm_severity(295)" VALUE 0x00165F05 /* @ECU_Address@FPrm_severity@0x024B3127@ */ ECIPP_ALIGNMENT_UBYTE 255 Compu_IDENTITY 0 255 PHYS_UNIT "Severity+Class" /end CHARACTERISTIC
/begin CHARACTERISTIC FPsvr_APUD23_max "FPrm_severity(296)" VALUE 0x00165F06 /* @ECU_Address@FPrm_severity@0x024B3128@ */ ECIPP_ALIGNMENT_UBYTE 255 Compu_IDENTITY 0 255 PHYS_UNIT "Severity+Class" /end CHARACTERISTIC
/begin CHARACTERISTIC FPsvr_APUD23_min "FPrm_severity(297)" VALUE 0x00165F07 /* @ECU_Address@FPrm_severity@0x024B3129@ */ ECIPP_ALIGNMENT_UBYTE 255 Compu_IDENTITY 0 255 PHYS_UNIT "Severity+Class" /end CHARACTERISTIC
/begin CHARACTERISTIC FPsvr_APUD24_max "FPrm_severity(298)" VALUE 0x00165F08 /* @ECU_Address@FPrm_severity@0x024B312A@ */ ECIPP_ALIGNMENT_UBYTE 255 Compu_IDENTITY 0 255 PHYS_UNIT "Severity+Class" /end CHARACTERISTIC
/begin CHARACTERISTIC FPsvr_APUD24_min "FPrm_severity(299)" VALUE 0x00165F09 /* @ECU_Address@FPrm_severity@0x024B312B@ */ ECIPP_ALIGNMENT_UBYTE 255 Compu_IDENTITY 0 255 PHYS_UNIT "Severity+Class" /end CHARACTERISTIC
/begin CHARACTERISTIC FPsvr_APUD25_max "FPrm_severity(300)" VALUE 0x00165F0A /* @ECU_Address@FPrm_severity@0x024B312C@ */ ECIPP_ALIGNMENT_UBYTE 255 Compu_IDENTITY 0 255 PHYS_UNIT "Severity+Class" /end CHARACTERISTIC
/begin CHARACTERISTIC FPsvr_APUD25_min "FPrm_severity(301)" VALUE 0x00165F0B /* @ECU_Address@FPrm_severity@0x024B312D@ */ ECIPP_ALIGNMENT_UBYTE 255 Compu_IDENTITY 0 255 PHYS_UNIT "Severity+Class" /end CHARACTERISTIC
/begin CHARACTERISTIC FPsvr_APUD3_max "FPrm_severity(163)" VALUE 0x00165E81 /* @ECU_Address@FPrm_severity@0x024B30A3@ */ ECIPP_ALIGNMENT_UBYTE 255 Compu_IDENTITY 0 255 PHYS_UNIT "Severity+Class" /end CHARACTERISTIC
/begin CHARACTERISTIC FPsvr_APUD3_min "FPrm_severity(164)" VALUE 0x00165E82 /* @ECU_Address@FPrm_severity@0x024B30A4@ */ ECIPP_ALIGNMENT_UBYTE 255 Compu_IDENTITY 0 255 PHYS_UNIT "Severity+Class" /end CHARACTERISTIC
/begin CHARACTERISTIC FPsvr_APUD4_max "FPrm_severity(202)" VALUE 0x00165EA8 /* @ECU_Address@FPrm_severity@0x024B30CA@ */ ECIPP_ALIGNMENT_UBYTE 255 Compu_IDENTITY 0 255 PHYS_UNIT "Severity+Class" /end CHARACTERISTIC
/begin CHARACTERISTIC FPsvr_APUD4_min "FPrm_severity(203)" VALUE 0x00165EA9 /* @ECU_Address@FPrm_severity@0x024B30CB@ */ ECIPP_ALIGNMENT_UBYTE 255 Compu_IDENTITY 0 255 PHYS_UNIT "Severity+Class" /end CHARACTERISTIC
/begin CHARACTERISTIC FPsvr_APUD5_max "FPrm_severity(240)" VALUE 0x00165ECE /* @ECU_Address@FPrm_severity@0x024B30F0@ */ ECIPP_ALIGNMENT_UBYTE 255 Compu_IDENTITY 0 255 PHYS_UNIT "Severity+Class" /end CHARACTERISTIC
/begin CHARACTERISTIC FPsvr_APUD5_min "FPrm_severity(241)" VALUE 0x00165ECF /* @ECU_Address@FPrm_severity@0x024B30F1@ */ ECIPP_ALIGNMENT_UBYTE 255 Compu_IDENTITY 0 255 PHYS_UNIT "Severity+Class" /end CHARACTERISTIC
/begin CHARACTERISTIC FPsvr_APUD6_max "FPrm_severity(242)" VALUE 0x00165ED0 /* @ECU_Address@FPrm_severity@0x024B30F2@ */ ECIPP_ALIGNMENT_UBYTE 255 Compu_IDENTITY 0 255 PHYS_UNIT "Severity+Class" /end CHARACTERISTIC
/begin CHARACTERISTIC FPsvr_APUD6_min "FPrm_severity(243)" VALUE 0x00165ED1 /* @ECU_Address@FPrm_severity@0x024B30F3@ */ ECIPP_ALIGNMENT_UBYTE 255 Compu_IDENTITY 0 255 PHYS_UNIT "Severity+Class" /end CHARACTERISTIC
/begin CHARACTERISTIC FPsvr_APUD7_max "FPrm_severity(244)" VALUE 0x00165ED2 /* @ECU_Address@FPrm_severity@0x024B30F4@ */ ECIPP_ALIGNMENT_UBYTE 255 Compu_IDENTITY 0 255 PHYS_UNIT "Severity+Class" /end CHARACTERISTIC
/begin CHARACTERISTIC FPsvr_APUD7_min "FPrm_severity(245)" VALUE 0x00165ED3 /* @ECU_Address@FPrm_severity@0x024B30F5@ */ ECIPP_ALIGNMENT_UBYTE 255 Compu_IDENTITY 0 255 PHYS_UNIT "Severity+Class" /end CHARACTERISTIC
/begin CHARACTERISTIC FPsvr_APUD8_max "FPrm_severity(261)" VALUE 0x00165EE3 /* @ECU_Address@FPrm_severity@0x024B3105@ */ ECIPP_ALIGNMENT_UBYTE 255 Compu_IDENTITY 0 255 PHYS_UNIT "Severity+Class" /end CHARACTERISTIC
/begin CHARACTERISTIC FPsvr_APUD8_min "FPrm_severity(262)" VALUE 0x00165EE4 /* @ECU_Address@FPrm_severity@0x024B3106@ */ ECIPP_ALIGNMENT_UBYTE 255 Compu_IDENTITY 0 255 PHYS_UNIT "Severity+Class" /end CHARACTERISTIC
/begin CHARACTERISTIC FPsvr_APUD9_max "FPrm_severity(268)" VALUE 0x00165EEA /* @ECU_Address@FPrm_severity@0x024B310C@ */ ECIPP_ALIGNMENT_UBYTE 255 Compu_IDENTITY 0 255 PHYS_UNIT "Severity+Class" /end CHARACTERISTIC
/begin CHARACTERISTIC FPsvr_APUD9_min "FPrm_severity(269)" VALUE 0x00165EEB /* @ECU_Address@FPrm_severity@0x024B310D@ */ ECIPP_ALIGNMENT_UBYTE 255 Compu_IDENTITY 0 255 PHYS_UNIT "Severity+Class" /end CHARACTERISTIC
/begin CHARACTERISTIC FPsvr_AWP_intF "FPrm_severity(659)" VALUE 0x00166071 /* @ECU_Address@FPrm_severity@0x024B3293@ */ ECIPP_ALIGNMENT_UBYTE 255 Compu_IDENTITY 0 255 PHYS_UNIT "Severity+Class" /end CHARACTERISTIC
/begin CHARACTERISTIC FPsvr_BP_max "FPrm_severity(10)" VALUE 0x00165DE8 /* @ECU_Address@FPrm_severity@0x024B300A@ */ ECIPP_ALIGNMENT_UBYTE 255 Compu_IDENTITY 0 255 PHYS_UNIT "Severity+Class" /end CHARACTERISTIC
/begin CHARACTERISTIC FPsvr_BP_min "FPrm_severity(11)" VALUE 0x00165DE9 /* @ECU_Address@FPrm_severity@0x024B300B@ */ ECIPP_ALIGNMENT_UBYTE 255 Compu_IDENTITY 0 255 PHYS_UNIT "Severity+Class" /end CHARACTERISTIC
/begin CHARACTERISTIC FPsvr_BPS1_max "FPrm_severity(371)" VALUE 0x00165F51 /* @ECU_Address@FPrm_severity@0x024B3173@ */ ECIPP_ALIGNMENT_UBYTE 255 Compu_IDENTITY 0 255 PHYS_UNIT "Severity+Class" /end CHARACTERISTIC
/begin CHARACTERISTIC FPsvr_BPS1_min "FPrm_severity(372)" VALUE 0x00165F52 /* @ECU_Address@FPrm_severity@0x024B3174@ */ ECIPP_ALIGNMENT_UBYTE 255 Compu_IDENTITY 0 255 PHYS_UNIT "Severity+Class" /end CHARACTERISTIC
/begin CHARACTERISTIC FPsvr_BPS12_OOR "FPrm_severity(379)" VALUE 0x00165F59 /* @ECU_Address@FPrm_severity@0x024B317B@ */ ECIPP_ALIGNMENT_UBYTE 255 Compu_IDENTITY 0 255 PHYS_UNIT "Severity+Class" /end CHARACTERISTIC
/begin CHARACTERISTIC FPsvr_BPS12pct_hi "FPrm_severity(375)" VALUE 0x00165F55 /* @ECU_Address@FPrm_severity@0x024B3177@ */ ECIPP_ALIGNMENT_UBYTE 255 Compu_IDENTITY 0 255 PHYS_UNIT "Severity+Class" /end CHARACTERISTIC
/begin CHARACTERISTIC FPsvr_BPS12pct_lo "FPrm_severity(376)" VALUE 0x00165F56 /* @ECU_Address@FPrm_severity@0x024B3178@ */ ECIPP_ALIGNMENT_UBYTE 255 Compu_IDENTITY 0 255 PHYS_UNIT "Severity+Class" /end CHARACTERISTIC
/begin CHARACTERISTIC FPsvr_BPS2_max "FPrm_severity(373)" VALUE 0x00165F53 /* @ECU_Address@FPrm_severity@0x024B3175@ */ ECIPP_ALIGNMENT_UBYTE 255 Compu_IDENTITY 0 255 PHYS_UNIT "Severity+Class" /end CHARACTERISTIC
/begin CHARACTERISTIC FPsvr_BPS2_min "FPrm_severity(374)" VALUE 0x00165F54 /* @ECU_Address@FPrm_severity@0x024B3176@ */ ECIPP_ALIGNMENT_UBYTE 255 Compu_IDENTITY 0 255 PHYS_UNIT "Severity+Class" /end CHARACTERISTIC
/begin CHARACTERISTIC FPsvr_BPSerr_neg "FPrm_severity(378)" VALUE 0x00165F58 /* @ECU_Address@FPrm_severity@0x024B317A@ */ ECIPP_ALIGNMENT_UBYTE 255 Compu_IDENTITY 0 255 PHYS_UNIT "Severity+Class" /end CHARACTERISTIC
/begin CHARACTERISTIC FPsvr_BPSerr_pos "FPrm_severity(377)" VALUE 0x00165F57 /* @ECU_Address@FPrm_severity@0x024B3179@ */ ECIPP_ALIGNMENT_UBYTE 255 Compu_IDENTITY 0 255 PHYS_UNIT "Severity+Class" /end CHARACTERISTIC
/begin CHARACTERISTIC FPsvr_brake_gndshort "FPrm_severity(238)" VALUE 0x00165ECC /* @ECU_Address@FPrm_severity@0x024B30EE@ */ ECIPP_ALIGNMENT_UBYTE 255 Compu_IDENTITY 0 255 PHYS_UNIT "Severity+Class" /end CHARACTERISTIC
/begin CHARACTERISTIC FPsvr_brake_pwrshort "FPrm_severity(239)" VALUE 0x00165ECD /* @ECU_Address@FPrm_severity@0x024B30EF@ */ ECIPP_ALIGNMENT_UBYTE 255 Compu_IDENTITY 0 255 PHYS_UNIT "Severity+Class" /end CHARACTERISTIC
/begin CHARACTERISTIC FPsvr_bst_MAT_derate_actv "FPrm_severity(638)" VALUE 0x0016605C /* @ECU_Address@FPrm_severity@0x024B327E@ */ ECIPP_ALIGNMENT_UBYTE 255 Compu_IDENTITY 0 255 PHYS_UNIT "Severity+Class" /end CHARACTERISTIC
/begin CHARACTERISTIC FPsvr_BstTIP_Hi "FPrm_severity(103)" VALUE 0x00165E45 /* @ECU_Address@FPrm_severity@0x024B3067@ */ ECIPP_ALIGNMENT_UBYTE 255 Compu_IDENTITY 0 255 PHYS_UNIT "Severity+Class" /end CHARACTERISTIC
/begin CHARACTERISTIC FPsvr_BstTIP_Lo "FPrm_severity(104)" VALUE 0x00165E46 /* @ECU_Address@FPrm_severity@0x024B3068@ */ ECIPP_ALIGNMENT_UBYTE 255 Compu_IDENTITY 0 255 PHYS_UNIT "Severity+Class" /end CHARACTERISTIC
/begin CHARACTERISTIC FPsvr_BstTIP_Lo2 "FPrm_severity(516)" VALUE 0x00165FE2 /* @ECU_Address@FPrm_severity@0x024B3204@ */ ECIPP_ALIGNMENT_UBYTE 255 Compu_IDENTITY 0 255 PHYS_UNIT "Severity+Class" /end CHARACTERISTIC
/begin CHARACTERISTIC FPsvr_BstTIP_slow "FPrm_severity(485)" VALUE 0x00165FC3 /* @ECU_Address@FPrm_severity@0x024B31E5@ */ ECIPP_ALIGNMENT_UBYTE 255 Compu_IDENTITY 0 255 PHYS_UNIT "Severity+Class" /end CHARACTERISTIC
/begin CHARACTERISTIC FPsvr_buzz_coilopen "FPrm_severity(125)" VALUE 0x00165E5B /* @ECU_Address@FPrm_severity@0x024B307D@ */ ECIPP_ALIGNMENT_UBYTE 255 Compu_IDENTITY 0 255 PHYS_UNIT "Severity+Class" /end CHARACTERISTIC
/begin CHARACTERISTIC FPsvr_buzz_coilshort "FPrm_severity(126)" VALUE 0x00165E5C /* @ECU_Address@FPrm_severity@0x024B307E@ */ ECIPP_ALIGNMENT_UBYTE 255 Compu_IDENTITY 0 255 PHYS_UNIT "Severity+Class" /end CHARACTERISTIC
/begin CHARACTERISTIC FPsvr_buzz_gndshort "FPrm_severity(124)" VALUE 0x00165E5A /* @ECU_Address@FPrm_severity@0x024B307C@ */ ECIPP_ALIGNMENT_UBYTE 255 Compu_IDENTITY 0 255 PHYS_UNIT "Severity+Class" /end CHARACTERISTIC
/begin CHARACTERISTIC FPsvr_CAC_eta_lo "FPrm_severity(486)" VALUE 0x00165FC4 /* @ECU_Address@FPrm_severity@0x024B31E6@ */ ECIPP_ALIGNMENT_UBYTE 255 Compu_IDENTITY 0 255 PHYS_UNIT "Severity+Class" /end CHARACTERISTIC
/begin CHARACTERISTIC FPsvr_cal_config "FPrm_severity(228)" VALUE 0x00165EC2 /* @ECU_Address@FPrm_severity@0x024B30E4@ */ ECIPP_ALIGNMENT_UBYTE 255 Compu_IDENTITY 0 255 PHYS_UNIT "Severity+Class" /end CHARACTERISTIC
/begin CHARACTERISTIC FPsvr_cam2loss "FPrm_severity(520)" VALUE 0x00165FE6 /* @ECU_Address@FPrm_severity@0x024B3208@ */ ECIPP_ALIGNMENT_UBYTE 255 Compu_IDENTITY 0 255 PHYS_UNIT "Severity+Class" /end CHARACTERISTIC
/begin CHARACTERISTIC FPsvr_camloss "FPrm_severity(59)" VALUE 0x00165E19 /* @ECU_Address@FPrm_severity@0x024B303B@ */ ECIPP_ALIGNMENT_UBYTE 255 Compu_IDENTITY 0 255 PHYS_UNIT "Severity+Class" /end CHARACTERISTIC
/begin CHARACTERISTIC FPsvr_camnoise "FPrm_severity(60)" VALUE 0x00165E1A /* @ECU_Address@FPrm_severity@0x024B303C@ */ ECIPP_ALIGNMENT_UBYTE 255 Compu_IDENTITY 0 255 PHYS_UNIT "Severity+Class" /end CHARACTERISTIC
/begin CHARACTERISTIC FPsvr_CATdP_hi "FPrm_severity(396)" VALUE 0x00165F6A /* @ECU_Address@FPrm_severity@0x024B318C@ */ ECIPP_ALIGNMENT_UBYTE 255 Compu_IDENTITY 0 255 PHYS_UNIT "Severity+Class" /end CHARACTERISTIC
/begin CHARACTERISTIC FPsvr_CATdP_lo "FPrm_severity(395)" VALUE 0x00165F69 /* @ECU_Address@FPrm_severity@0x024B318B@ */ ECIPP_ALIGNMENT_UBYTE 255 Compu_IDENTITY 0 255 PHYS_UNIT "Severity+Class" /end CHARACTERISTIC
/begin CHARACTERISTIC FPsw_APUD12_min "FPrm_switches(275)" VALUE 0x00146B02 /* @ECU_Address@FPrm_switches@0x021B9226@ */ ECIPP_ALIGNMENT_UWORD 65535 Compu_IDENTITY 0 65535 PHYS_UNIT "Enable bits" /end CHARACTERISTIC
/begin CHARACTERISTIC FPsw_APUD13_max "FPrm_switches(276)" VALUE 0x00146B04 /* @ECU_Address@FPrm_switches@0x021B9228@ */ ECIPP_ALIGNMENT_UWORD 65535 Compu_IDENTITY 0 65535 PHYS_UNIT "Enable bits" /end CHARACTERISTIC
/begin CHARACTERISTIC FPsw_APUD13_min "FPrm_switches(277)" VALUE 0x00146B06 /* @ECU_Address@FPrm_switches@0x021B922A@ */ ECIPP_ALIGNMENT_UWORD 65535 Compu_IDENTITY 0 65535 PHYS_UNIT "Enable bits" /end CHARACTERISTIC
/begin CHARACTERISTIC FPsw_APUD14_max "FPrm_switches(278)" VALUE 0x00146B08 /* @ECU_Address@FPrm_switches@0x021B922C@ */ ECIPP_ALIGNMENT_UWORD 65535 Compu_IDENTITY 0 65535 PHYS_UNIT "Enable bits" /end CHARACTERISTIC
/begin CHARACTERISTIC FPsw_APUD14_min "FPrm_switches(279)" VALUE 0x00146B0A /* @ECU_Address@FPrm_switches@0x021B922E@ */ ECIPP_ALIGNMENT_UWORD 65535 Compu_IDENTITY 0 65535 PHYS_UNIT "Enable bits" /end CHARACTERISTIC
/begin CHARACTERISTIC FPsw_APUD15_max "FPrm_switches(280)" VALUE 0x00146B0C /* @ECU_Address@FPrm_switches@0x021B9230@ */ ECIPP_ALIGNMENT_UWORD 65535 Compu_IDENTITY 0 65535 PHYS_UNIT "Enable bits" /end CHARACTERISTIC
/begin CHARACTERISTIC FPsw_APUD15_min "FPrm_switches(281)" VALUE 0x00146B0E /* @ECU_Address@FPrm_switches@0x021B9232@ */ ECIPP_ALIGNMENT_UWORD 65535 Compu_IDENTITY 0 65535 PHYS_UNIT "Enable bits" /end CHARACTERISTIC
/begin CHARACTERISTIC FPsw_APUD16_max "FPrm_switches(282)" VALUE 0x00146B10 /* @ECU_Address@FPrm_switches@0x021B9234@ */ ECIPP_ALIGNMENT_UWORD 65535 Compu_IDENTITY 0 65535 PHYS_UNIT "Enable bits" /end CHARACTERISTIC
/begin CHARACTERISTIC FPsw_APUD16_min "FPrm_switches(283)" VALUE 0x00146B12 /* @ECU_Address@FPrm_switches@0x021B9236@ */ ECIPP_ALIGNMENT_UWORD 65535 Compu_IDENTITY 0 65535 PHYS_UNIT "Enable bits" /end CHARACTERISTIC
/begin CHARACTERISTIC FPsw_APUD17_max "FPrm_switches(284)" VALUE 0x00146B14 /* @ECU_Address@FPrm_switches@0x021B9238@ */ ECIPP_ALIGNMENT_UWORD 65535 Compu_IDENTITY 0 65535 PHYS_UNIT "Enable bits" /end CHARACTERISTIC
/begin CHARACTERISTIC FPsw_APUD17_min "FPrm_switches(285)" VALUE 0x00146B16 /* @ECU_Address@FPrm_switches@0x021B923A@ */ ECIPP_ALIGNMENT_UWORD 65535 Compu_IDENTITY 0 65535 PHYS_UNIT "Enable bits" /end CHARACTERISTIC
/begin CHARACTERISTIC FPsw_APUD18_max "FPrm_switches(286)" VALUE 0x00146B18 /* @ECU_Address@FPrm_switches@0x021B923C@ */ ECIPP_ALIGNMENT_UWORD 65535 Compu_IDENTITY 0 65535 PHYS_UNIT "Enable bits" /end CHARACTERISTIC
/begin CHARACTERISTIC FPsw_APUD18_min "FPrm_switches(287)" VALUE 0x00146B1A /* @ECU_Address@FPrm_switches@0x021B923E@ */ ECIPP_ALIGNMENT_UWORD 65535 Compu_IDENTITY 0 65535 PHYS_UNIT "Enable bits" /end CHARACTERISTIC
/begin CHARACTERISTIC FPsw_APUD19_max "FPrm_switches(288)" VALUE 0x00146B1C /* @ECU_Address@FPrm_switches@0x021B9240@ */ ECIPP_ALIGNMENT_UWORD 65535 Compu_IDENTITY 0 65535 PHYS_UNIT "Enable bits" /end CHARACTERISTIC
/begin CHARACTERISTIC FPsw_APUD19_min "FPrm_switches(289)" VALUE 0x00146B1E /* @ECU_Address@FPrm_switches@0x021B9242@ */ ECIPP_ALIGNMENT_UWORD 65535 Compu_IDENTITY 0 65535 PHYS_UNIT "Enable bits" /end CHARACTERISTIC
/begin CHARACTERISTIC FPsw_APUD2_max "FPrm_switches(161)" VALUE 0x00146A1E /* @ECU_Address@FPrm_switches@0x021B9142@ */ ECIPP_ALIGNMENT_UWORD 65535 Compu_IDENTITY 0 65535 PHYS_UNIT "Enable bits" /end CHARACTERISTIC
/begin CHARACTERISTIC FPsw_APUD2_min "FPrm_switches(162)" VALUE 0x00146A20 /* @ECU_Address@FPrm_switches@0x021B9144@ */ ECIPP_ALIGNMENT_UWORD 65535 Compu_IDENTITY 0 65535 PHYS_UNIT "Enable bits" /end CHARACTERISTIC
/begin CHARACTERISTIC FPsw_APUD20_max "FPrm_switches(290)" VALUE 0x00146B20 /* @ECU_Address@FPrm_switches@0x021B9244@ */ ECIPP_ALIGNMENT_UWORD 65535 Compu_IDENTITY 0 65535 PHYS_UNIT "Enable bits" /end CHARACTERISTIC
/begin CHARACTERISTIC FPsw_APUD20_min "FPrm_switches(291)" VALUE 0x00146B22 /* @ECU_Address@FPrm_switches@0x021B9246@ */ ECIPP_ALIGNMENT_UWORD 65535 Compu_IDENTITY 0 65535 PHYS_UNIT "Enable bits" /end CHARACTERISTIC
/begin CHARACTERISTIC FPsw_APUD21_max "FPrm_switches(292)" VALUE 0x00146B24 /* @ECU_Address@FPrm_switches@0x021B9248@ */ ECIPP_ALIGNMENT_UWORD 65535 Compu_IDENTITY 0 65535 PHYS_UNIT "Enable bits" /end CHARACTERISTIC
/begin CHARACTERISTIC FPsw_APUD21_min "FPrm_switches(293)" VALUE 0x00146B26 /* @ECU_Address@FPrm_switches@0x021B924A@ */ ECIPP_ALIGNMENT_UWORD 65535 Compu_IDENTITY 0 65535 PHYS_UNIT "Enable bits" /end CHARACTERISTIC
/begin CHARACTERISTIC FPsw_APUD22_max "FPrm_switches(294)" VALUE 0x00146B28 /* @ECU_Address@FPrm_switches@0x021B924C@ */ ECIPP_ALIGNMENT_UWORD 65535 Compu_IDENTITY 0 65535 PHYS_UNIT "Enable bits" /end CHARACTERISTIC
/begin CHARACTERISTIC FPsw_APUD22_min "FPrm_switches(295)" VALUE 0x00146B2A /* @ECU_Address@FPrm_switches@0x021B924E@ */ ECIPP_ALIGNMENT_UWORD 65535 Compu_IDENTITY 0 65535 PHYS_UNIT "Enable bits" /end CHARACTERISTIC
/begin CHARACTERISTIC FPsw_APUD23_max "FPrm_switches(296)" VALUE 0x00146B2C /* @ECU_Address@FPrm_switches@0x021B9250@ */ ECIPP_ALIGNMENT_UWORD 65535 Compu_IDENTITY 0 65535 PHYS_UNIT "Enable bits" /end CHARACTERISTIC
/begin CHARACTERISTIC FPsw_APUD23_min "FPrm_switches(297)" VALUE 0x00146B2E /* @ECU_Address@FPrm_switches@0x021B9252@ */ ECIPP_ALIGNMENT_UWORD 65535 Compu_IDENTITY 0 65535 PHYS_UNIT "Enable bits" /end CHARACTERISTIC
/begin CHARACTERISTIC FPsw_APUD24_max "FPrm_switches(298)" VALUE 0x00146B30 /* @ECU_Address@FPrm_switches@0x021B9254@ */ ECIPP_ALIGNMENT_UWORD 65535 Compu_IDENTITY 0 65535 PHYS_UNIT "Enable bits" /end CHARACTERISTIC
/begin CHARACTERISTIC FPsw_APUD24_min "FPrm_switches(299)" VALUE 0x00146B32 /* @ECU_Address@FPrm_switches@0x021B9256@ */ ECIPP_ALIGNMENT_UWORD 65535 Compu_IDENTITY 0 65535 PHYS_UNIT "Enable bits" /end CHARACTERISTIC
/begin CHARACTERISTIC FPsw_APUD25_max "FPrm_switches(300)" VALUE 0x00146B34 /* @ECU_Address@FPrm_switches@0x021B9258@ */ ECIPP_ALIGNMENT_UWORD 65535 Compu_IDENTITY 0 65535 PHYS_UNIT "Enable bits" /end CHARACTERISTIC
/begin CHARACTERISTIC FPsw_APUD25_min "FPrm_switches(301)" VALUE 0x00146B36 /* @ECU_Address@FPrm_switches@0x021B925A@ */ ECIPP_ALIGNMENT_UWORD 65535 Compu_IDENTITY 0 65535 PHYS_UNIT "Enable bits" /end CHARACTERISTIC
/begin CHARACTERISTIC FPsw_APUD3_max "FPrm_switches(163)" VALUE 0x00146A22 /* @ECU_Address@FPrm_switches@0x021B9146@ */ ECIPP_ALIGNMENT_UWORD 65535 Compu_IDENTITY 0 65535 PHYS_UNIT "Enable bits" /end CHARACTERISTIC
/begin CHARACTERISTIC FPsw_APUD3_min "FPrm_switches(164)" VALUE 0x00146A24 /* @ECU_Address@FPrm_switches@0x021B9148@ */ ECIPP_ALIGNMENT_UWORD 65535 Compu_IDENTITY 0 65535 PHYS_UNIT "Enable bits" /end CHARACTERISTIC
/begin CHARACTERISTIC FPsw_APUD4_max "FPrm_switches(202)" VALUE 0x00146A70 /* @ECU_Address@FPrm_switches@0x021B9194@ */ ECIPP_ALIGNMENT_UWORD 65535 Compu_IDENTITY 0 65535 PHYS_UNIT "Enable bits" /end CHARACTERISTIC
/begin CHARACTERISTIC FPsw_APUD4_min "FPrm_switches(203)" VALUE 0x00146A72 /* @ECU_Address@FPrm_switches@0x021B9196@ */ ECIPP_ALIGNMENT_UWORD 65535 Compu_IDENTITY 0 65535 PHYS_UNIT "Enable bits" /end CHARACTERISTIC
/begin CHARACTERISTIC FPsw_APUD5_max "FPrm_switches(240)" VALUE 0x00146ABC /* @ECU_Address@FPrm_switches@0x021B91E0@ */ ECIPP_ALIGNMENT_UWORD 65535 Compu_IDENTITY 0 65535 PHYS_UNIT "Enable bits" /end CHARACTERISTIC
/begin CHARACTERISTIC FPsw_APUD5_min "FPrm_switches(241)" VALUE 0x00146ABE /* @ECU_Address@FPrm_switches@0x021B91E2@ */ ECIPP_ALIGNMENT_UWORD 65535 Compu_IDENTITY 0 65535 PHYS_UNIT "Enable bits" /end CHARACTERISTIC
/begin CHARACTERISTIC FPsw_APUD6_max "FPrm_switches(242)" VALUE 0x00146AC0 /* @ECU_Address@FPrm_switches@0x021B91E4@ */ ECIPP_ALIGNMENT_UWORD 65535 Compu_IDENTITY 0 65535 PHYS_UNIT "Enable bits" /end CHARACTERISTIC
/begin CHARACTERISTIC FPsw_APUD6_min "FPrm_switches(243)" VALUE 0x00146AC2 /* @ECU_Address@FPrm_switches@0x021B91E6@ */ ECIPP_ALIGNMENT_UWORD 65535 Compu_IDENTITY 0 65535 PHYS_UNIT "Enable bits" /end CHARACTERISTIC
/begin CHARACTERISTIC FPsw_APUD7_max "FPrm_switches(244)" VALUE 0x00146AC4 /* @ECU_Address@FPrm_switches@0x021B91E8@ */ ECIPP_ALIGNMENT_UWORD 65535 Compu_IDENTITY 0 65535 PHYS_UNIT "Enable bits" /end CHARACTERISTIC
/begin CHARACTERISTIC FPsw_APUD7_min "FPrm_switches(245)" VALUE 0x00146AC6 /* @ECU_Address@FPrm_switches@0x021B91EA@ */ ECIPP_ALIGNMENT_UWORD 65535 Compu_IDENTITY 0 65535 PHYS_UNIT "Enable bits" /end CHARACTERISTIC
/begin CHARACTERISTIC FPsw_APUD8_max "FPrm_switches(261)" VALUE 0x00146AE6 /* @ECU_Address@FPrm_switches@0x021B920A@ */ ECIPP_ALIGNMENT_UWORD 65535 Compu_IDENTITY 0 65535 PHYS_UNIT "Enable bits" /end CHARACTERISTIC
/begin CHARACTERISTIC FPsw_APUD8_min "FPrm_switches(262)" VALUE 0x00146AE8 /* @ECU_Address@FPrm_switches@0x021B920C@ */ ECIPP_ALIGNMENT_UWORD 65535 Compu_IDENTITY 0 65535 PHYS_UNIT "Enable bits" /end CHARACTERISTIC
/begin CHARACTERISTIC FPsw_APUD9_max "FPrm_switches(268)" VALUE 0x00146AF4 /* @ECU_Address@FPrm_switches@0x021B9218@ */ ECIPP_ALIGNMENT_UWORD 65535 Compu_IDENTITY 0 65535 PHYS_UNIT "Enable bits" /end CHARACTERISTIC
/begin CHARACTERISTIC FPsw_APUD9_min "FPrm_switches(269)" VALUE 0x00146AF6 /* @ECU_Address@FPrm_switches@0x021B921A@ */ ECIPP_ALIGNMENT_UWORD 65535 Compu_IDENTITY 0 65535 PHYS_UNIT "Enable bits" /end CHARACTERISTIC
/begin CHARACTERISTIC FPsw_AWP_intF "FPrm_switches(659)" VALUE 0x00146E02 /* @ECU_Address@FPrm_switches@0x021B9526@ */ ECIPP_ALIGNMENT_UWORD 65535 Compu_IDENTITY 0 65535 PHYS_UNIT "Enable bits" /end CHARACTERISTIC
/begin CHARACTERISTIC FPsw_BP_max "FPrm_switches(10)" VALUE 0x001468F0 /* @ECU_Address@FPrm_switches@0x021B9014@ */ ECIPP_ALIGNMENT_UWORD 65535 Compu_IDENTITY 0 65535 PHYS_UNIT "Enable bits" /end CHARACTERISTIC
/begin CHARACTERISTIC FPsw_BP_min "FPrm_switches(11)" VALUE 0x001468F2 /* @ECU_Address@FPrm_switches@0x021B9016@ */ ECIPP_ALIGNMENT_UWORD 65535 Compu_IDENTITY 0 65535 PHYS_UNIT "Enable bits" /end CHARACTERISTIC
/begin CHARACTERISTIC FPsw_BPS1_max "FPrm_switches(371)" VALUE 0x00146BC2 /* @ECU_Address@FPrm_switches@0x021B92E6@ */ ECIPP_ALIGNMENT_UWORD 65535 Compu_IDENTITY 0 65535 PHYS_UNIT "Enable bits" /end CHARACTERISTIC
/begin CHARACTERISTIC FPsw_BPS1_min "FPrm_switches(372)" VALUE 0x00146BC4 /* @ECU_Address@FPrm_switches@0x021B92E8@ */ ECIPP_ALIGNMENT_UWORD 65535 Compu_IDENTITY 0 65535 PHYS_UNIT "Enable bits" /end CHARACTERISTIC
/begin CHARACTERISTIC FPsw_BPS12_OOR "FPrm_switches(379)" VALUE 0x00146BD2 /* @ECU_Address@FPrm_switches@0x021B92F6@ */ ECIPP_ALIGNMENT_UWORD 65535 Compu_IDENTITY 0 65535 PHYS_UNIT "Enable bits" /end CHARACTERISTIC
/begin CHARACTERISTIC FPsw_BPS12pct_hi "FPrm_switches(375)" VALUE 0x00146BCA /* @ECU_Address@FPrm_switches@0x021B92EE@ */ ECIPP_ALIGNMENT_UWORD 65535 Compu_IDENTITY 0 65535 PHYS_UNIT "Enable bits" /end CHARACTERISTIC
/begin CHARACTERISTIC FPsw_BPS12pct_lo "FPrm_switches(376)" VALUE 0x00146BCC /* @ECU_Address@FPrm_switches@0x021B92F0@ */ ECIPP_ALIGNMENT_UWORD 65535 Compu_IDENTITY 0 65535 PHYS_UNIT "Enable bits" /end CHARACTERISTIC
/begin CHARACTERISTIC FPsw_BPS2_max "FPrm_switches(373)" VALUE 0x00146BC6 /* @ECU_Address@FPrm_switches@0x021B92EA@ */ ECIPP_ALIGNMENT_UWORD 65535 Compu_IDENTITY 0 65535 PHYS_UNIT "Enable bits" /end CHARACTERISTIC
/begin CHARACTERISTIC FPsw_BPS2_min "FPrm_switches(374)" VALUE 0x00146BC8 /* @ECU_Address@FPrm_switches@0x021B92EC@ */ ECIPP_ALIGNMENT_UWORD 65535 Compu_IDENTITY 0 65535 PHYS_UNIT "Enable bits" /end CHARACTERISTIC
/begin CHARACTERISTIC FPsw_BPSerr_neg "FPrm_switches(378)" VALUE 0x00146BD0 /* @ECU_Address@FPrm_switches@0x021B92F4@ */ ECIPP_ALIGNMENT_UWORD 65535 Compu_IDENTITY 0 65535 PHYS_UNIT "Enable bits" /end CHARACTERISTIC
/begin CHARACTERISTIC FPsw_BPSerr_pos "FPrm_switches(377)" VALUE 0x00146BCE /* @ECU_Address@FPrm_switches@0x021B92F2@ */ ECIPP_ALIGNMENT_UWORD 65535 Compu_IDENTITY 0 65535 PHYS_UNIT "Enable bits" /end CHARACTERISTIC
/begin CHARACTERISTIC FPsw_brake_gndshort "FPrm_switches(238)" VALUE 0x00146AB8 /* @ECU_Address@FPrm_switches@0x021B91DC@ */ ECIPP_ALIGNMENT_UWORD 65535 Compu_IDENTITY 0 65535 PHYS_UNIT "Enable bits" /end CHARACTERISTIC
/begin CHARACTERISTIC FPsw_brake_pwrshort "FPrm_switches(239)" VALUE 0x00146ABA /* @ECU_Address@FPrm_switches@0x021B91DE@ */ ECIPP_ALIGNMENT_UWORD 65535 Compu_IDENTITY 0 65535 PHYS_UNIT "Enable bits" /end CHARACTERISTIC
/begin CHARACTERISTIC FPsw_bst_MAT_derate_actv "FPrm_switches(638)" VALUE 0x00146DD8 /* @ECU_Address@FPrm_switches@0x021B94FC@ */ ECIPP_ALIGNMENT_UWORD 65535 Compu_IDENTITY 0 65535 PHYS_UNIT "Enable bits" /end CHARACTERISTIC
/begin CHARACTERISTIC FPsw_BstTIP_Hi "FPrm_switches(103)" VALUE 0x001469AA /* @ECU_Address@FPrm_switches@0x021B90CE@ */ ECIPP_ALIGNMENT_UWORD 65535 Compu_IDENTITY 0 65535 PHYS_UNIT "Enable bits" /end CHARACTERISTIC
/begin CHARACTERISTIC FPsw_BstTIP_Lo "FPrm_switches(104)" VALUE 0x001469AC /* @ECU_Address@FPrm_switches@0x021B90D0@ */ ECIPP_ALIGNMENT_UWORD 65535 Compu_IDENTITY 0 65535 PHYS_UNIT "Enable bits" /end CHARACTERISTIC
/begin CHARACTERISTIC FPsw_BstTIP_Lo2 "FPrm_switches(516)" VALUE 0x00146CE4 /* @ECU_Address@FPrm_switches@0x021B9408@ */ ECIPP_ALIGNMENT_UWORD 65535 Compu_IDENTITY 0 65535 PHYS_UNIT "Enable bits" /end CHARACTERISTIC
/begin CHARACTERISTIC FPsw_BstTIP_slow "FPrm_switches(485)" VALUE 0x00146CA6 /* @ECU_Address@FPrm_switches@0x021B93CA@ */ ECIPP_ALIGNMENT_UWORD 65535 Compu_IDENTITY 0 65535 PHYS_UNIT "Enable bits" /end CHARACTERISTIC
/begin CHARACTERISTIC FPsw_buzz_coilopen "FPrm_switches(125)" VALUE 0x001469D6 /* @ECU_Address@FPrm_switches@0x021B90FA@ */ ECIPP_ALIGNMENT_UWORD 65535 Compu_IDENTITY 0 65535 PHYS_UNIT "Enable bits" /end CHARACTERISTIC
/begin CHARACTERISTIC FPsw_buzz_coilshort "FPrm_switches(126)" VALUE 0x001469D8 /* @ECU_Address@FPrm_switches@0x021B90FC@ */ ECIPP_ALIGNMENT_UWORD 65535 Compu_IDENTITY 0 65535 PHYS_UNIT "Enable bits" /end CHARACTERISTIC
/begin CHARACTERISTIC FPsw_buzz_gndshort "FPrm_switches(124)" VALUE 0x001469D4 /* @ECU_Address@FPrm_switches@0x021B90F8@ */ ECIPP_ALIGNMENT_UWORD 65535 Compu_IDENTITY 0 65535 PHYS_UNIT "Enable bits" /end CHARACTERISTIC
/begin CHARACTERISTIC FPsw_CAC_eta_lo "FPrm_switches(486)" VALUE 0x00146CA8 /* @ECU_Address@FPrm_switches@0x021B93CC@ */ ECIPP_ALIGNMENT_UWORD 65535 Compu_IDENTITY 0 65535 PHYS_UNIT "Enable bits" /end CHARACTERISTIC
/begin CHARACTERISTIC FPsw_cal_config "FPrm_switches(228)" VALUE 0x00146AA4 /* @ECU_Address@FPrm_switches@0x021B91C8@ */ ECIPP_ALIGNMENT_UWORD 65535 Compu_IDENTITY 0 65535 PHYS_UNIT "Enable bits" /end CHARACTERISTIC
/begin CHARACTERISTIC FPsw_cam2loss "FPrm_switches(520)" VALUE 0x00146CEC /* @ECU_Address@FPrm_switches@0x021B9410@ */ ECIPP_ALIGNMENT_UWORD 65535 Compu_IDENTITY 0 65535 PHYS_UNIT "Enable bits" /end CHARACTERISTIC
/begin CHARACTERISTIC FPsw_camloss "FPrm_switches(59)" VALUE 0x00146952 /* @ECU_Address@FPrm_switches@0x021B9076@ */ ECIPP_ALIGNMENT_UWORD 65535 Compu_IDENTITY 0 65535 PHYS_UNIT "Enable bits" /end CHARACTERISTIC
/begin CHARACTERISTIC FPsw_camnoise "FPrm_switches(60)" VALUE 0x00146954 /* @ECU_Address@FPrm_switches@0x021B9078@ */ ECIPP_ALIGNMENT_UWORD 65535 Compu_IDENTITY 0 65535 PHYS_UNIT "Enable bits" /end CHARACTERISTIC
/begin CHARACTERISTIC FPsw_CATdP_hi "FPrm_switches(396)" VALUE 0x00146BF4 /* @ECU_Address@FPrm_switches@0x021B9318@ */ ECIPP_ALIGNMENT_UWORD 65535 Compu_IDENTITY 0 65535 PHYS_UNIT "Enable bits" /end CHARACTERISTIC
/begin CHARACTERISTIC FPsw_CATdP_lo "FPrm_switches(395)" VALUE 0x00146BF2 /* @ECU_Address@FPrm_switches@0x021B9316@ */ ECIPP_ALIGNMENT_UWORD 65535 Compu_IDENTITY 0 65535 PHYS_UNIT "Enable bits" /end CHARACTERISTIC
/begin CHARACTERISTIC FPsw_ext1_APUD12_min "FPrm_switches_ext1(275)" VALUE 0x00147064 /* @ECU_Address@FPrm_switches_ext1@0x023A5226@ */ ECIPP_ALIGNMENT_UWORD 65535 Compu_IDENTITY 0 65535 PHYS_UNIT "Enable bits" /end CHARACTERISTIC
/begin CHARACTERISTIC FPsw_ext1_APUD13_max "FPrm_switches_ext1(276)" VALUE 0x00147066 /* @ECU_Address@FPrm_switches_ext1@0x023A5228@ */ ECIPP_ALIGNMENT_UWORD 65535 Compu_IDENTITY 0 65535 PHYS_UNIT "Enable bits" /end CHARACTERISTIC
/begin CHARACTERISTIC FPsw_ext1_APUD13_min "FPrm_switches_ext1(277)" VALUE 0x00147068 /* @ECU_Address@FPrm_switches_ext1@0x023A522A@ */ ECIPP_ALIGNMENT_UWORD 65535 Compu_IDENTITY 0 65535 PHYS_UNIT "Enable bits" /end CHARACTERISTIC
/begin CHARACTERISTIC FPsw_ext1_APUD14_max "FPrm_switches_ext1(278)" VALUE 0x0014706A /* @ECU_Address@FPrm_switches_ext1@0x023A522C@ */ ECIPP_ALIGNMENT_UWORD 65535 Compu_IDENTITY 0 65535 PHYS_UNIT "Enable bits" /end CHARACTERISTIC
/begin CHARACTERISTIC FPsw_ext1_APUD14_min "FPrm_switches_ext1(279)" VALUE 0x0014706C /* @ECU_Address@FPrm_switches_ext1@0x023A522E@ */ ECIPP_ALIGNMENT_UWORD 65535 Compu_IDENTITY 0 65535 PHYS_UNIT "Enable bits" /end CHARACTERISTIC
/begin CHARACTERISTIC FPsw_ext1_APUD15_max "FPrm_switches_ext1(280)" VALUE 0x0014706E /* @ECU_Address@FPrm_switches_ext1@0x023A5230@ */ ECIPP_ALIGNMENT_UWORD 65535 Compu_IDENTITY 0 65535 PHYS_UNIT "Enable bits" /end CHARACTERISTIC
/begin CHARACTERISTIC FPsw_ext1_APUD15_min "FPrm_switches_ext1(281)" VALUE 0x00147070 /* @ECU_Address@FPrm_switches_ext1@0x023A5232@ */ ECIPP_ALIGNMENT_UWORD 65535 Compu_IDENTITY 0 65535 PHYS_UNIT "Enable bits" /end CHARACTERISTIC
/begin CHARACTERISTIC FPsw_ext1_APUD16_max "FPrm_switches_ext1(282)" VALUE 0x00147072 /* @ECU_Address@FPrm_switches_ext1@0x023A5234@ */ ECIPP_ALIGNMENT_UWORD 65535 Compu_IDENTITY 0 65535 PHYS_UNIT "Enable bits" /end CHARACTERISTIC
/begin CHARACTERISTIC FPsw_ext1_APUD16_min "FPrm_switches_ext1(283)" VALUE 0x00147074 /* @ECU_Address@FPrm_switches_ext1@0x023A5236@ */ ECIPP_ALIGNMENT_UWORD 65535 Compu_IDENTITY 0 65535 PHYS_UNIT "Enable bits" /end CHARACTERISTIC
/begin CHARACTERISTIC FPsw_ext1_APUD17_max "FPrm_switches_ext1(284)" VALUE 0x00147076 /* @ECU_Address@FPrm_switches_ext1@0x023A5238@ */ ECIPP_ALIGNMENT_UWORD 65535 Compu_IDENTITY 0 65535 PHYS_UNIT "Enable bits" /end CHARACTERISTIC
/begin CHARACTERISTIC FPsw_ext1_APUD17_min "FPrm_switches_ext1(285)" VALUE 0x00147078 /* @ECU_Address@FPrm_switches_ext1@0x023A523A@ */ ECIPP_ALIGNMENT_UWORD 65535 Compu_IDENTITY 0 65535 PHYS_UNIT "Enable bits" /end CHARACTERISTIC
/begin CHARACTERISTIC FPsw_ext1_APUD18_max "FPrm_switches_ext1(286)" VALUE 0x0014707A /* @ECU_Address@FPrm_switches_ext1@0x023A523C@ */ ECIPP_ALIGNMENT_UWORD 65535 Compu_IDENTITY 0 65535 PHYS_UNIT "Enable bits" /end CHARACTERISTIC
/begin CHARACTERISTIC FPsw_ext1_APUD18_min "FPrm_switches_ext1(287)" VALUE 0x0014707C /* @ECU_Address@FPrm_switches_ext1@0x023A523E@ */ ECIPP_ALIGNMENT_UWORD 65535 Compu_IDENTITY 0 65535 PHYS_UNIT "Enable bits" /end CHARACTERISTIC
/begin CHARACTERISTIC FPsw_ext1_APUD19_max "FPrm_switches_ext1(288)" VALUE 0x0014707E /* @ECU_Address@FPrm_switches_ext1@0x023A5240@ */ ECIPP_ALIGNMENT_UWORD 65535 Compu_IDENTITY 0 65535 PHYS_UNIT "Enable bits" /end CHARACTERISTIC
/begin CHARACTERISTIC FPsw_ext1_APUD19_min "FPrm_switches_ext1(289)" VALUE 0x00147080 /* @ECU_Address@FPrm_switches_ext1@0x023A5242@ */ ECIPP_ALIGNMENT_UWORD 65535 Compu_IDENTITY 0 65535 PHYS_UNIT "Enable bits" /end CHARACTERISTIC
/begin CHARACTERISTIC FPsw_ext1_APUD2_max "FPrm_switches_ext1(161)" VALUE 0x00146F80 /* @ECU_Address@FPrm_switches_ext1@0x023A5142@ */ ECIPP_ALIGNMENT_UWORD 65535 Compu_IDENTITY 0 65535 PHYS_UNIT "Enable bits" /end CHARACTERISTIC
/begin CHARACTERISTIC FPsw_ext1_APUD2_min "FPrm_switches_ext1(162)" VALUE 0x00146F82 /* @ECU_Address@FPrm_switches_ext1@0x023A5144@ */ ECIPP_ALIGNMENT_UWORD 65535 Compu_IDENTITY 0 65535 PHYS_UNIT "Enable bits" /end CHARACTERISTIC
/begin CHARACTERISTIC FPsw_ext1_APUD20_max "FPrm_switches_ext1(290)" VALUE 0x00147082 /* @ECU_Address@FPrm_switches_ext1@0x023A5244@ */ ECIPP_ALIGNMENT_UWORD 65535 Compu_IDENTITY 0 65535 PHYS_UNIT "Enable bits" /end CHARACTERISTIC
/begin CHARACTERISTIC FPsw_ext1_APUD20_min "FPrm_switches_ext1(291)" VALUE 0x00147084 /* @ECU_Address@FPrm_switches_ext1@0x023A5246@ */ ECIPP_ALIGNMENT_UWORD 65535 Compu_IDENTITY 0 65535 PHYS_UNIT "Enable bits" /end CHARACTERISTIC
/begin CHARACTERISTIC FPsw_ext1_APUD21_max "FPrm_switches_ext1(292)" VALUE 0x00147086 /* @ECU_Address@FPrm_switches_ext1@0x023A5248@ */ ECIPP_ALIGNMENT_UWORD 65535 Compu_IDENTITY 0 65535 PHYS_UNIT "Enable bits" /end CHARACTERISTIC
/begin CHARACTERISTIC FPsw_ext1_APUD21_min "FPrm_switches_ext1(293)" VALUE 0x00147088 /* @ECU_Address@FPrm_switches_ext1@0x023A524A@ */ ECIPP_ALIGNMENT_UWORD 65535 Compu_IDENTITY 0 65535 PHYS_UNIT "Enable bits" /end CHARACTERISTIC
/begin CHARACTERISTIC FPsw_ext1_APUD22_max "FPrm_switches_ext1(294)" VALUE 0x0014708A /* @ECU_Address@FPrm_switches_ext1@0x023A524C@ */ ECIPP_ALIGNMENT_UWORD 65535 Compu_IDENTITY 0 65535 PHYS_UNIT "Enable bits" /end CHARACTERISTIC
/begin CHARACTERISTIC FPsw_ext1_APUD22_min "FPrm_switches_ext1(295)" VALUE 0x0014708C /* @ECU_Address@FPrm_switches_ext1@0x023A524E@ */ ECIPP_ALIGNMENT_UWORD 65535 Compu_IDENTITY 0 65535 PHYS_UNIT "Enable bits" /end CHARACTERISTIC
/begin CHARACTERISTIC FPsw_ext1_APUD23_max "FPrm_switches_ext1(296)" VALUE 0x0014708E /* @ECU_Address@FPrm_switches_ext1@0x023A5250@ */ ECIPP_ALIGNMENT_UWORD 65535 Compu_IDENTITY 0 65535 PHYS_UNIT "Enable bits" /end CHARACTERISTIC
/begin CHARACTERISTIC FPsw_ext1_APUD23_min "FPrm_switches_ext1(297)" VALUE 0x00147090 /* @ECU_Address@FPrm_switches_ext1@0x023A5252@ */ ECIPP_ALIGNMENT_UWORD 65535 Compu_IDENTITY 0 65535 PHYS_UNIT "Enable bits" /end CHARACTERISTIC
/begin CHARACTERISTIC FPsw_ext1_APUD24_max "FPrm_switches_ext1(298)" VALUE 0x00147092 /* @ECU_Address@FPrm_switches_ext1@0x023A5254@ */ ECIPP_ALIGNMENT_UWORD 65535 Compu_IDENTITY 0 65535 PHYS_UNIT "Enable bits" /end CHARACTERISTIC
/begin CHARACTERISTIC FPsw_ext1_APUD24_min "FPrm_switches_ext1(299)" VALUE 0x00147094 /* @ECU_Address@FPrm_switches_ext1@0x023A5256@ */ ECIPP_ALIGNMENT_UWORD 65535 Compu_IDENTITY 0 65535 PHYS_UNIT "Enable bits" /end CHARACTERISTIC
/begin CHARACTERISTIC FPsw_ext1_APUD25_max "FPrm_switches_ext1(300)" VALUE 0x00147096 /* @ECU_Address@FPrm_switches_ext1@0x023A5258@ */ ECIPP_ALIGNMENT_UWORD 65535 Compu_IDENTITY 0 65535 PHYS_UNIT "Enable bits" /end CHARACTERISTIC
/begin CHARACTERISTIC FPsw_ext1_APUD25_min "FPrm_switches_ext1(301)" VALUE 0x00147098 /* @ECU_Address@FPrm_switches_ext1@0x023A525A@ */ ECIPP_ALIGNMENT_UWORD 65535 Compu_IDENTITY 0 65535 PHYS_UNIT "Enable bits" /end CHARACTERISTIC
/begin CHARACTERISTIC FPsw_ext1_APUD3_max "FPrm_switches_ext1(163)" VALUE 0x00146F84 /* @ECU_Address@FPrm_switches_ext1@0x023A5146@ */ ECIPP_ALIGNMENT_UWORD 65535 Compu_IDENTITY 0 65535 PHYS_UNIT "Enable bits" /end CHARACTERISTIC
/begin CHARACTERISTIC FPsw_ext1_APUD3_min "FPrm_switches_ext1(164)" VALUE 0x00146F86 /* @ECU_Address@FPrm_switches_ext1@0x023A5148@ */ ECIPP_ALIGNMENT_UWORD 65535 Compu_IDENTITY 0 65535 PHYS_UNIT "Enable bits" /end CHARACTERISTIC
/begin CHARACTERISTIC FPsw_ext1_APUD4_max "FPrm_switches_ext1(202)" VALUE 0x00146FD2 /* @ECU_Address@FPrm_switches_ext1@0x023A5194@ */ ECIPP_ALIGNMENT_UWORD 65535 Compu_IDENTITY 0 65535 PHYS_UNIT "Enable bits" /end CHARACTERISTIC
/begin CHARACTERISTIC FPsw_ext1_APUD4_min "FPrm_switches_ext1(203)" VALUE 0x00146FD4 /* @ECU_Address@FPrm_switches_ext1@0x023A5196@ */ ECIPP_ALIGNMENT_UWORD 65535 Compu_IDENTITY 0 65535 PHYS_UNIT "Enable bits" /end CHARACTERISTIC
/begin CHARACTERISTIC FPsw_ext1_APUD5_max "FPrm_switches_ext1(240)" VALUE 0x0014701E /* @ECU_Address@FPrm_switches_ext1@0x023A51E0@ */ ECIPP_ALIGNMENT_UWORD 65535 Compu_IDENTITY 0 65535 PHYS_UNIT "Enable bits" /end CHARACTERISTIC
/begin CHARACTERISTIC FPsw_ext1_APUD5_min "FPrm_switches_ext1(241)" VALUE 0x00147020 /* @ECU_Address@FPrm_switches_ext1@0x023A51E2@ */ ECIPP_ALIGNMENT_UWORD 65535 Compu_IDENTITY 0 65535 PHYS_UNIT "Enable bits" /end CHARACTERISTIC
/begin CHARACTERISTIC FPsw_ext1_APUD6_max "FPrm_switches_ext1(242)" VALUE 0x00147022 /* @ECU_Address@FPrm_switches_ext1@0x023A51E4@ */ ECIPP_ALIGNMENT_UWORD 65535 Compu_IDENTITY 0 65535 PHYS_UNIT "Enable bits" /end CHARACTERISTIC
/begin CHARACTERISTIC FPsw_ext1_APUD6_min "FPrm_switches_ext1(243)" VALUE 0x00147024 /* @ECU_Address@FPrm_switches_ext1@0x023A51E6@ */ ECIPP_ALIGNMENT_UWORD 65535 Compu_IDENTITY 0 65535 PHYS_UNIT "Enable bits" /end CHARACTERISTIC
/begin CHARACTERISTIC FPsw_ext1_APUD7_max "FPrm_switches_ext1(244)" VALUE 0x00147026 /* @ECU_Address@FPrm_switches_ext1@0x023A51E8@ */ ECIPP_ALIGNMENT_UWORD 65535 Compu_IDENTITY 0 65535 PHYS_UNIT "Enable bits" /end CHARACTERISTIC
/begin CHARACTERISTIC FPsw_ext1_APUD7_min "FPrm_switches_ext1(245)" VALUE 0x00147028 /* @ECU_Address@FPrm_switches_ext1@0x023A51EA@ */ ECIPP_ALIGNMENT_UWORD 65535 Compu_IDENTITY 0 65535 PHYS_UNIT "Enable bits" /end CHARACTERISTIC
/begin CHARACTERISTIC FPsw_ext1_APUD8_max "FPrm_switches_ext1(261)" VALUE 0x00147048 /* @ECU_Address@FPrm_switches_ext1@0x023A520A@ */ ECIPP_ALIGNMENT_UWORD 65535 Compu_IDENTITY 0 65535 PHYS_UNIT "Enable bits" /end CHARACTERISTIC
/begin CHARACTERISTIC FPsw_ext1_APUD8_min "FPrm_switches_ext1(262)" VALUE 0x0014704A /* @ECU_Address@FPrm_switches_ext1@0x023A520C@ */ ECIPP_ALIGNMENT_UWORD 65535 Compu_IDENTITY 0 65535 PHYS_UNIT "Enable bits" /end CHARACTERISTIC
/begin CHARACTERISTIC FPsw_ext1_APUD9_max "FPrm_switches_ext1(268)" VALUE 0x00147056 /* @ECU_Address@FPrm_switches_ext1@0x023A5218@ */ ECIPP_ALIGNMENT_UWORD 65535 Compu_IDENTITY 0 65535 PHYS_UNIT "Enable bits" /end CHARACTERISTIC
/begin CHARACTERISTIC FPsw_ext1_APUD9_min "FPrm_switches_ext1(269)" VALUE 0x00147058 /* @ECU_Address@FPrm_switches_ext1@0x023A521A@ */ ECIPP_ALIGNMENT_UWORD 65535 Compu_IDENTITY 0 65535 PHYS_UNIT "Enable bits" /end CHARACTERISTIC
/begin CHARACTERISTIC FPsw_ext1_AWP_intF "FPrm_switches_ext1(659)" VALUE 0x00147364 /* @ECU_Address@FPrm_switches_ext1@0x023A5526@ */ ECIPP_ALIGNMENT_UWORD 65535 Compu_IDENTITY 0 65535 PHYS_UNIT "Enable bits" /end CHARACTERISTIC
/begin CHARACTERISTIC FPsw_ext1_BP_max "FPrm_switches_ext1(10)" VALUE 0x00146E52 /* @ECU_Address@FPrm_switches_ext1@0x023A5014@ */ ECIPP_ALIGNMENT_UWORD 65535 Compu_IDENTITY 0 65535 PHYS_UNIT "Enable bits" /end CHARACTERISTIC
/begin CHARACTERISTIC FPsw_ext1_BP_min "FPrm_switches_ext1(11)" VALUE 0x00146E54 /* @ECU_Address@FPrm_switches_ext1@0x023A5016@ */ ECIPP_ALIGNMENT_UWORD 65535 Compu_IDENTITY 0 65535 PHYS_UNIT "Enable bits" /end CHARACTERISTIC
/begin CHARACTERISTIC FPsw_ext1_BPS1_max "FPrm_switches_ext1(371)" VALUE 0x00147124 /* @ECU_Address@FPrm_switches_ext1@0x023A52E6@ */ ECIPP_ALIGNMENT_UWORD 65535 Compu_IDENTITY 0 65535 PHYS_UNIT "Enable bits" /end CHARACTERISTIC
/begin CHARACTERISTIC FPsw_ext1_BPS1_min "FPrm_switches_ext1(372)" VALUE 0x00147126 /* @ECU_Address@FPrm_switches_ext1@0x023A52E8@ */ ECIPP_ALIGNMENT_UWORD 65535 Compu_IDENTITY 0 65535 PHYS_UNIT "Enable bits" /end CHARACTERISTIC
/begin CHARACTERISTIC FPsw_ext1_BPS12_OOR "FPrm_switches_ext1(379)" VALUE 0x00147134 /* @ECU_Address@FPrm_switches_ext1@0x023A52F6@ */ ECIPP_ALIGNMENT_UWORD 65535 Compu_IDENTITY 0 65535 PHYS_UNIT "Enable bits" /end CHARACTERISTIC
/begin CHARACTERISTIC FPsw_ext1_BPS12pct_hi "FPrm_switches_ext1(375)" VALUE 0x0014712C /* @ECU_Address@FPrm_switches_ext1@0x023A52EE@ */ ECIPP_ALIGNMENT_UWORD 65535 Compu_IDENTITY 0 65535 PHYS_UNIT "Enable bits" /end CHARACTERISTIC
/begin CHARACTERISTIC FPsw_ext1_BPS12pct_lo "FPrm_switches_ext1(376)" VALUE 0x0014712E /* @ECU_Address@FPrm_switches_ext1@0x023A52F0@ */ ECIPP_ALIGNMENT_UWORD 65535 Compu_IDENTITY 0 65535 PHYS_UNIT "Enable bits" /end CHARACTERISTIC
/begin CHARACTERISTIC FPsw_ext1_BPS2_max "FPrm_switches_ext1(373)" VALUE 0x00147128 /* @ECU_Address@FPrm_switches_ext1@0x023A52EA@ */ ECIPP_ALIGNMENT_UWORD 65535 Compu_IDENTITY 0 65535 PHYS_UNIT "Enable bits" /end CHARACTERISTIC
/begin CHARACTERISTIC FPsw_ext1_BPS2_min "FPrm_switches_ext1(374)" VALUE 0x0014712A /* @ECU_Address@FPrm_switches_ext1@0x023A52EC@ */ ECIPP_ALIGNMENT_UWORD 65535 Compu_IDENTITY 0 65535 PHYS_UNIT "Enable bits" /end CHARACTERISTIC
/begin CHARACTERISTIC FPsw_ext1_BPSerr_neg "FPrm_switches_ext1(378)" VALUE 0x00147132 /* @ECU_Address@FPrm_switches_ext1@0x023A52F4@ */ ECIPP_ALIGNMENT_UWORD 65535 Compu_IDENTITY 0 65535 PHYS_UNIT "Enable bits" /end CHARACTERISTIC
/begin CHARACTERISTIC FPsw_ext1_BPSerr_pos "FPrm_switches_ext1(377)" VALUE 0x00147130 /* @ECU_Address@FPrm_switches_ext1@0x023A52F2@ */ ECIPP_ALIGNMENT_UWORD 65535 Compu_IDENTITY 0 65535 PHYS_UNIT "Enable bits" /end CHARACTERISTIC
/begin CHARACTERISTIC FPsw_ext1_brake_gndshort "FPrm_switches_ext1(238)" VALUE 0x0014701A /* @ECU_Address@FPrm_switches_ext1@0x023A51DC@ */ ECIPP_ALIGNMENT_UWORD 65535 Compu_IDENTITY 0 65535 PHYS_UNIT "Enable bits" /end CHARACTERISTIC
/begin CHARACTERISTIC FPsw_ext1_brake_pwrshort "FPrm_switches_ext1(239)" VALUE 0x0014701C /* @ECU_Address@FPrm_switches_ext1@0x023A51DE@ */ ECIPP_ALIGNMENT_UWORD 65535 Compu_IDENTITY 0 65535 PHYS_UNIT "Enable bits" /end CHARACTERISTIC
/begin CHARACTERISTIC FPsw_ext1_bst_MAT_derate_actv "FPrm_switches_ext1(638)" VALUE 0x0014733A /* @ECU_Address@FPrm_switches_ext1@0x023A54FC@ */ ECIPP_ALIGNMENT_UWORD 65535 Compu_IDENTITY 0 65535 PHYS_UNIT "Enable bits" /end CHARACTERISTIC
/begin CHARACTERISTIC FPsw_ext1_BstTIP_Hi "FPrm_switches_ext1(103)" VALUE 0x00146F0C /* @ECU_Address@FPrm_switches_ext1@0x023A50CE@ */ ECIPP_ALIGNMENT_UWORD 65535 Compu_IDENTITY 0 65535 PHYS_UNIT "Enable bits" /end CHARACTERISTIC
/begin CHARACTERISTIC FPsw_ext1_BstTIP_Lo "FPrm_switches_ext1(104)" VALUE 0x00146F0E /* @ECU_Address@FPrm_switches_ext1@0x023A50D0@ */ ECIPP_ALIGNMENT_UWORD 65535 Compu_IDENTITY 0 65535 PHYS_UNIT "Enable bits" /end CHARACTERISTIC
/begin CHARACTERISTIC FPsw_ext1_BstTIP_Lo2 "FPrm_switches_ext1(516)" VALUE 0x00147246 /* @ECU_Address@FPrm_switches_ext1@0x023A5408@ */ ECIPP_ALIGNMENT_UWORD 65535 Compu_IDENTITY 0 65535 PHYS_UNIT "Enable bits" /end CHARACTERISTIC
/begin CHARACTERISTIC FPsw_ext1_BstTIP_slow "FPrm_switches_ext1(485)" VALUE 0x00147208 /* @ECU_Address@FPrm_switches_ext1@0x023A53CA@ */ ECIPP_ALIGNMENT_UWORD 65535 Compu_IDENTITY 0 65535 PHYS_UNIT "Enable bits" /end CHARACTERISTIC
/begin CHARACTERISTIC FPsw_ext1_buzz_coilopen "FPrm_switches_ext1(125)" VALUE 0x00146F38 /* @ECU_Address@FPrm_switches_ext1@0x023A50FA@ */ ECIPP_ALIGNMENT_UWORD 65535 Compu_IDENTITY 0 65535 PHYS_UNIT "Enable bits" /end CHARACTERISTIC
/begin CHARACTERISTIC FPsw_ext1_buzz_coilshort "FPrm_switches_ext1(126)" VALUE 0x00146F3A /* @ECU_Address@FPrm_switches_ext1@0x023A50FC@ */ ECIPP_ALIGNMENT_UWORD 65535 Compu_IDENTITY 0 65535 PHYS_UNIT "Enable bits" /end CHARACTERISTIC
/begin CHARACTERISTIC FPsw_ext1_buzz_gndshort "FPrm_switches_ext1(124)" VALUE 0x00146F36 /* @ECU_Address@FPrm_switches_ext1@0x023A50F8@ */ ECIPP_ALIGNMENT_UWORD 65535 Compu_IDENTITY 0 65535 PHYS_UNIT "Enable bits" /end CHARACTERISTIC
/begin CHARACTERISTIC FPsw_ext1_CAC_eta_lo "FPrm_switches_ext1(486)" VALUE 0x0014720A /* @ECU_Address@FPrm_switches_ext1@0x023A53CC@ */ ECIPP_ALIGNMENT_UWORD 65535 Compu_IDENTITY 0 65535 PHYS_UNIT "Enable bits" /end CHARACTERISTIC
/begin CHARACTERISTIC FPsw_ext1_cal_config "FPrm_switches_ext1(228)" VALUE 0x00147006 /* @ECU_Address@FPrm_switches_ext1@0x023A51C8@ */ ECIPP_ALIGNMENT_UWORD 65535 Compu_IDENTITY 0 65535 PHYS_UNIT "Enable bits" /end CHARACTERISTIC
/begin CHARACTERISTIC FPsw_ext1_cam2loss "FPrm_switches_ext1(520)" VALUE 0x0014724E /* @ECU_Address@FPrm_switches_ext1@0x023A5410@ */ ECIPP_ALIGNMENT_UWORD 65535 Compu_IDENTITY 0 65535 PHYS_UNIT "Enable bits" /end CHARACTERISTIC
/begin CHARACTERISTIC FPsw_ext1_camloss "FPrm_switches_ext1(59)" VALUE 0x00146EB4 /* @ECU_Address@FPrm_switches_ext1@0x023A5076@ */ ECIPP_ALIGNMENT_UWORD 65535 Compu_IDENTITY 0 65535 PHYS_UNIT "Enable bits" /end CHARACTERISTIC
/begin CHARACTERISTIC FPsw_ext1_camnoise "FPrm_switches_ext1(60)" VALUE 0x00146EB6 /* @ECU_Address@FPrm_switches_ext1@0x023A5078@ */ ECIPP_ALIGNMENT_UWORD 65535 Compu_IDENTITY 0 65535 PHYS_UNIT "Enable bits" /end CHARACTERISTIC
/begin CHARACTERISTIC FPsw_ext1_CATdP_hi "FPrm_switches_ext1(396)" VALUE 0x00147156 /* @ECU_Address@FPrm_switches_ext1@0x023A5318@ */ ECIPP_ALIGNMENT_UWORD 65535 Compu_IDENTITY 0 65535 PHYS_UNIT "Enable bits" /end CHARACTERISTIC
/begin CHARACTERISTIC FPsw_ext1_CATdP_lo "FPrm_switches_ext1(395)" VALUE 0x00147154 /* @ECU_Address@FPrm_switches_ext1@0x023A5316@ */ ECIPP_ALIGNMENT_UWORD 65535 Compu_IDENTITY 0 65535 PHYS_UNIT "Enable bits" /end CHARACTERISTIC
/begin CHARACTERISTIC FCdtc_APUD12_min "FCtl_DTC(366)" VALUE 0x001637F0 /* @ECU_Address@FCtl_DTC@0x021B52DC@ */ ECIPP_ALIGNMENT_UWORD 65535 Compu_IDENTITY 0 65535 PHYS_UNIT "DTC" /end CHARACTERISTIC
/begin CHARACTERISTIC FCdtc_APUD13_max "FCtl_DTC(367)" VALUE 0x001637F2 /* @ECU_Address@FCtl_DTC@0x021B52DE@ */ ECIPP_ALIGNMENT_UWORD 65535 Compu_IDENTITY 0 65535 PHYS_UNIT "DTC" /end CHARACTERISTIC
/begin CHARACTERISTIC FCdtc_APUD13_min "FCtl_DTC(368)" VALUE 0x001637F4 /* @ECU_Address@FCtl_DTC@0x021B52E0@ */ ECIPP_ALIGNMENT_UWORD 65535 Compu_IDENTITY 0 65535 PHYS_UNIT "DTC" /end CHARACTERISTIC
/begin CHARACTERISTIC FCdtc_APUD14_max "FCtl_DTC(369)" VALUE 0x001637F6 /* @ECU_Address@FCtl_DTC@0x021B52E2@ */ ECIPP_ALIGNMENT_UWORD 65535 Compu_IDENTITY 0 65535 PHYS_UNIT "DTC" /end CHARACTERISTIC
/begin CHARACTERISTIC FCdtc_APUD14_min "FCtl_DTC(370)" VALUE 0x001637F8 /* @ECU_Address@FCtl_DTC@0x021B52E4@ */ ECIPP_ALIGNMENT_UWORD 65535 Compu_IDENTITY 0 65535 PHYS_UNIT "DTC" /end CHARACTERISTIC
/begin CHARACTERISTIC FCdtc_APUD15_max "FCtl_DTC(371)" VALUE 0x001637FA /* @ECU_Address@FCtl_DTC@0x021B52E6@ */ ECIPP_ALIGNMENT_UWORD 65535 Compu_IDENTITY 0 65535 PHYS_UNIT "DTC" /end CHARACTERISTIC
/begin CHARACTERISTIC FCdtc_APUD15_min "FCtl_DTC(372)" VALUE 0x001637FC /* @ECU_Address@FCtl_DTC@0x021B52E8@ */ ECIPP_ALIGNMENT_UWORD 65535 Compu_IDENTITY 0 65535 PHYS_UNIT "DTC" /end CHARACTERISTIC
/begin CHARACTERISTIC FCdtc_APUD16_max "FCtl_DTC(373)" VALUE 0x001637FE /* @ECU_Address@FCtl_DTC@0x021B52EA@ */ ECIPP_ALIGNMENT_UWORD 65535 Compu_IDENTITY 0 65535 PHYS_UNIT "DTC" /end CHARACTERISTIC
/begin CHARACTERISTIC FCdtc_APUD16_min "FCtl_DTC(374)" VALUE 0x00163800 /* @ECU_Address@FCtl_DTC@0x021B52EC@ */ ECIPP_ALIGNMENT_UWORD 65535 Compu_IDENTITY 0 65535 PHYS_UNIT "DTC" /end CHARACTERISTIC
/begin CHARACTERISTIC FCdtc_APUD17_max "FCtl_DTC(375)" VALUE 0x00163802 /* @ECU_Address@FCtl_DTC@0x021B52EE@ */ ECIPP_ALIGNMENT_UWORD 65535 Compu_IDENTITY 0 65535 PHYS_UNIT "DTC" /end CHARACTERISTIC
/begin CHARACTERISTIC FCdtc_APUD17_min "FCtl_DTC(376)" VALUE 0x00163804 /* @ECU_Address@FCtl_DTC@0x021B52F0@ */ ECIPP_ALIGNMENT_UWORD 65535 Compu_IDENTITY 0 65535 PHYS_UNIT "DTC" /end CHARACTERISTIC
/begin CHARACTERISTIC FCdtc_APUD18_max "FCtl_DTC(377)" VALUE 0x00163806 /* @ECU_Address@FCtl_DTC@0x021B52F2@ */ ECIPP_ALIGNMENT_UWORD 65535 Compu_IDENTITY 0 65535 PHYS_UNIT "DTC" /end CHARACTERISTIC
/begin CHARACTERISTIC FCdtc_APUD18_min "FCtl_DTC(378)" VALUE 0x00163808 /* @ECU_Address@FCtl_DTC@0x021B52F4@ */ ECIPP_ALIGNMENT_UWORD 65535 Compu_IDENTITY 0 65535 PHYS_UNIT "DTC" /end CHARACTERISTIC
/begin CHARACTERISTIC FCdtc_APUD19_max "FCtl_DTC(379)" VALUE 0x0016380A /* @ECU_Address@FCtl_DTC@0x021B52F6@ */ ECIPP_ALIGNMENT_UWORD 65535 Compu_IDENTITY 0 65535 PHYS_UNIT "DTC" /end CHARACTERISTIC
/begin CHARACTERISTIC FCdtc_APUD19_min "FCtl_DTC(380)" VALUE 0x0016380C /* @ECU_Address@FCtl_DTC@0x021B52F8@ */ ECIPP_ALIGNMENT_UWORD 65535 Compu_IDENTITY 0 65535 PHYS_UNIT "DTC" /end CHARACTERISTIC
/begin CHARACTERISTIC FCdtc_APUD2_max "FCtl_DTC(205)" VALUE 0x001636AE /* @ECU_Address@FCtl_DTC@0x021B519A@ */ ECIPP_ALIGNMENT_UWORD 65535 Compu_IDENTITY 0 65535 PHYS_UNIT "DTC" /end CHARACTERISTIC
/begin CHARACTERISTIC FCdtc_APUD2_min "FCtl_DTC(206)" VALUE 0x001636B0 /* @ECU_Address@FCtl_DTC@0x021B519C@ */ ECIPP_ALIGNMENT_UWORD 65535 Compu_IDENTITY 0 65535 PHYS_UNIT "DTC" /end CHARACTERISTIC
/begin CHARACTERISTIC FCdtc_APUD20_max "FCtl_DTC(381)" VALUE 0x0016380E /* @ECU_Address@FCtl_DTC@0x021B52FA@ */ ECIPP_ALIGNMENT_UWORD 65535 Compu_IDENTITY 0 65535 PHYS_UNIT "DTC" /end CHARACTERISTIC
/begin CHARACTERISTIC FCdtc_APUD20_min "FCtl_DTC(382)" VALUE 0x00163810 /* @ECU_Address@FCtl_DTC@0x021B52FC@ */ ECIPP_ALIGNMENT_UWORD 65535 Compu_IDENTITY 0 65535 PHYS_UNIT "DTC" /end CHARACTERISTIC
/begin CHARACTERISTIC FCdtc_APUD21_max "FCtl_DTC(383)" VALUE 0x00163812 /* @ECU_Address@FCtl_DTC@0x021B52FE@ */ ECIPP_ALIGNMENT_UWORD 65535 Compu_IDENTITY 0 65535 PHYS_UNIT "DTC" /end CHARACTERISTIC
/begin CHARACTERISTIC FCdtc_APUD21_min "FCtl_DTC(384)" VALUE 0x00163814 /* @ECU_Address@FCtl_DTC@0x021B5300@ */ ECIPP_ALIGNMENT_UWORD 65535 Compu_IDENTITY 0 65535 PHYS_UNIT "DTC" /end CHARACTERISTIC
/begin CHARACTERISTIC FCdtc_APUD22_max "FCtl_DTC(385)" VALUE 0x00163816 /* @ECU_Address@FCtl_DTC@0x021B5302@ */ ECIPP_ALIGNMENT_UWORD 65535 Compu_IDENTITY 0 65535 PHYS_UNIT "DTC" /end CHARACTERISTIC
/begin CHARACTERISTIC FCdtc_APUD22_min "FCtl_DTC(386)" VALUE 0x00163818 /* @ECU_Address@FCtl_DTC@0x021B5304@ */ ECIPP_ALIGNMENT_UWORD 65535 Compu_IDENTITY 0 65535 PHYS_UNIT "DTC" /end CHARACTERISTIC
/begin CHARACTERISTIC FCdtc_APUD23_max "FCtl_DTC(387)" VALUE 0x0016381A /* @ECU_Address@FCtl_DTC@0x021B5306@ */ ECIPP_ALIGNMENT_UWORD 65535 Compu_IDENTITY 0 65535 PHYS_UNIT "DTC" /end CHARACTERISTIC
/begin CHARACTERISTIC FCdtc_APUD23_min "FCtl_DTC(388)" VALUE 0x0016381C /* @ECU_Address@FCtl_DTC@0x021B5308@ */ ECIPP_ALIGNMENT_UWORD 65535 Compu_IDENTITY 0 65535 PHYS_UNIT "DTC" /end CHARACTERISTIC
/begin CHARACTERISTIC FCdtc_APUD24_max "FCtl_DTC(389)" VALUE 0x0016381E /* @ECU_Address@FCtl_DTC@0x021B530A@ */ ECIPP_ALIGNMENT_UWORD 65535 Compu_IDENTITY 0 65535 PHYS_UNIT "DTC" /end CHARACTERISTIC
/begin CHARACTERISTIC FCdtc_APUD24_min "FCtl_DTC(390)" VALUE 0x00163820 /* @ECU_Address@FCtl_DTC@0x021B530C@ */ ECIPP_ALIGNMENT_UWORD 65535 Compu_IDENTITY 0 65535 PHYS_UNIT "DTC" /end CHARACTERISTIC
/begin CHARACTERISTIC FCdtc_APUD25_max "FCtl_DTC(391)" VALUE 0x00163822 /* @ECU_Address@FCtl_DTC@0x021B530E@ */ ECIPP_ALIGNMENT_UWORD 65535 Compu_IDENTITY 0 65535 PHYS_UNIT "DTC" /end CHARACTERISTIC
/begin CHARACTERISTIC FCdtc_APUD25_min "FCtl_DTC(392)" VALUE 0x00163824 /* @ECU_Address@FCtl_DTC@0x021B5310@ */ ECIPP_ALIGNMENT_UWORD 65535 Compu_IDENTITY 0 65535 PHYS_UNIT "DTC" /end CHARACTERISTIC
/begin CHARACTERISTIC FCdtc_APUD3_max "FCtl_DTC(207)" VALUE 0x001636B2 /* @ECU_Address@FCtl_DTC@0x021B519E@ */ ECIPP_ALIGNMENT_UWORD 65535 Compu_IDENTITY 0 65535 PHYS_UNIT "DTC" /end CHARACTERISTIC
/begin CHARACTERISTIC FCdtc_APUD3_min "FCtl_DTC(208)" VALUE 0x001636B4 /* @ECU_Address@FCtl_DTC@0x021B51A0@ */ ECIPP_ALIGNMENT_UWORD 65535 Compu_IDENTITY 0 65535 PHYS_UNIT "DTC" /end CHARACTERISTIC
/begin CHARACTERISTIC FCdtc_APUD4_max "FCtl_DTC(280)" VALUE 0x00163744 /* @ECU_Address@FCtl_DTC@0x021B5230@ */ ECIPP_ALIGNMENT_UWORD 65535 Compu_IDENTITY 0 65535 PHYS_UNIT "DTC" /end CHARACTERISTIC
/begin CHARACTERISTIC FCdtc_APUD4_min "FCtl_DTC(281)" VALUE 0x00163746 /* @ECU_Address@FCtl_DTC@0x021B5232@ */ ECIPP_ALIGNMENT_UWORD 65535 Compu_IDENTITY 0 65535 PHYS_UNIT "DTC" /end CHARACTERISTIC
/begin CHARACTERISTIC FCdtc_APUD5_max "FCtl_DTC(331)" VALUE 0x001637AA /* @ECU_Address@FCtl_DTC@0x021B5296@ */ ECIPP_ALIGNMENT_UWORD 65535 Compu_IDENTITY 0 65535 PHYS_UNIT "DTC" /end CHARACTERISTIC
/begin CHARACTERISTIC FCdtc_APUD5_min "FCtl_DTC(332)" VALUE 0x001637AC /* @ECU_Address@FCtl_DTC@0x021B5298@ */ ECIPP_ALIGNMENT_UWORD 65535 Compu_IDENTITY 0 65535 PHYS_UNIT "DTC" /end CHARACTERISTIC
/begin CHARACTERISTIC FCdtc_APUD6_max "FCtl_DTC(333)" VALUE 0x001637AE /* @ECU_Address@FCtl_DTC@0x021B529A@ */ ECIPP_ALIGNMENT_UWORD 65535 Compu_IDENTITY 0 65535 PHYS_UNIT "DTC" /end CHARACTERISTIC
/begin CHARACTERISTIC FCdtc_APUD6_min "FCtl_DTC(334)" VALUE 0x001637B0 /* @ECU_Address@FCtl_DTC@0x021B529C@ */ ECIPP_ALIGNMENT_UWORD 65535 Compu_IDENTITY 0 65535 PHYS_UNIT "DTC" /end CHARACTERISTIC
/begin CHARACTERISTIC FCdtc_APUD7_max "FCtl_DTC(335)" VALUE 0x001637B2 /* @ECU_Address@FCtl_DTC@0x021B529E@ */ ECIPP_ALIGNMENT_UWORD 65535 Compu_IDENTITY 0 65535 PHYS_UNIT "DTC" /end CHARACTERISTIC
/begin CHARACTERISTIC FCdtc_APUD7_min "FCtl_DTC(336)" VALUE 0x001637B4 /* @ECU_Address@FCtl_DTC@0x021B52A0@ */ ECIPP_ALIGNMENT_UWORD 65535 Compu_IDENTITY 0 65535 PHYS_UNIT "DTC" /end CHARACTERISTIC
/begin CHARACTERISTIC FCdtc_APUD8_max "FCtl_DTC(352)" VALUE 0x001637D4 /* @ECU_Address@FCtl_DTC@0x021B52C0@ */ ECIPP_ALIGNMENT_UWORD 65535 Compu_IDENTITY 0 65535 PHYS_UNIT "DTC" /end CHARACTERISTIC
/begin CHARACTERISTIC FCdtc_APUD8_min "FCtl_DTC(353)" VALUE 0x001637D6 /* @ECU_Address@FCtl_DTC@0x021B52C2@ */ ECIPP_ALIGNMENT_UWORD 65535 Compu_IDENTITY 0 65535 PHYS_UNIT "DTC" /end CHARACTERISTIC
/begin CHARACTERISTIC FCdtc_APUD9_max "FCtl_DTC(359)" VALUE 0x001637E2 /* @ECU_Address@FCtl_DTC@0x021B52CE@ */ ECIPP_ALIGNMENT_UWORD 65535 Compu_IDENTITY 0 65535 PHYS_UNIT "DTC" /end CHARACTERISTIC
/begin CHARACTERISTIC FCdtc_APUD9_min "FCtl_DTC(360)" VALUE 0x001637E4 /* @ECU_Address@FCtl_DTC@0x021B52D0@ */ ECIPP_ALIGNMENT_UWORD 65535 Compu_IDENTITY 0 65535 PHYS_UNIT "DTC" /end CHARACTERISTIC
/begin CHARACTERISTIC FCdtc_AWP_intF "FCtl_DTC(832)" VALUE 0x00163B94 /* @ECU_Address@FCtl_DTC@0x021B5680@ */ ECIPP_ALIGNMENT_UWORD 65535 Compu_IDENTITY 0 65535 PHYS_UNIT "DTC" /end CHARACTERISTIC
/begin CHARACTERISTIC FCdtc_BP_max "FCtl_DTC(7)" VALUE 0x00163522 /* @ECU_Address@FCtl_DTC@0x021B500E@ */ ECIPP_ALIGNMENT_UWORD 65535 Compu_IDENTITY 0 65535 PHYS_UNIT "DTC" /end CHARACTERISTIC
/begin CHARACTERISTIC FCdtc_BP_min "FCtl_DTC(8)" VALUE 0x00163524 /* @ECU_Address@FCtl_DTC@0x021B5010@ */ ECIPP_ALIGNMENT_UWORD 65535 Compu_IDENTITY 0 65535 PHYS_UNIT "DTC" /end CHARACTERISTIC
/begin CHARACTERISTIC FCdtc_BPS1_max "FCtl_DTC(474)" VALUE 0x001638C8 /* @ECU_Address@FCtl_DTC@0x021B53B4@ */ ECIPP_ALIGNMENT_UWORD 65535 Compu_IDENTITY 0 65535 PHYS_UNIT "DTC" /end CHARACTERISTIC
/begin CHARACTERISTIC FCdtc_BPS1_min "FCtl_DTC(475)" VALUE 0x001638CA /* @ECU_Address@FCtl_DTC@0x021B53B6@ */ ECIPP_ALIGNMENT_UWORD 65535 Compu_IDENTITY 0 65535 PHYS_UNIT "DTC" /end CHARACTERISTIC
/begin CHARACTERISTIC FCdtc_BPS12_OOR "FCtl_DTC(482)" VALUE 0x001638D8 /* @ECU_Address@FCtl_DTC@0x021B53C4@ */ ECIPP_ALIGNMENT_UWORD 65535 Compu_IDENTITY 0 65535 PHYS_UNIT "DTC" /end CHARACTERISTIC
/begin CHARACTERISTIC FCdtc_BPS12pct_hi "FCtl_DTC(478)" VALUE 0x001638D0 /* @ECU_Address@FCtl_DTC@0x021B53BC@ */ ECIPP_ALIGNMENT_UWORD 65535 Compu_IDENTITY 0 65535 PHYS_UNIT "DTC" /end CHARACTERISTIC
/begin CHARACTERISTIC FCdtc_BPS12pct_lo "FCtl_DTC(479)" VALUE 0x001638D2 /* @ECU_Address@FCtl_DTC@0x021B53BE@ */ ECIPP_ALIGNMENT_UWORD 65535 Compu_IDENTITY 0 65535 PHYS_UNIT "DTC" /end CHARACTERISTIC
/begin CHARACTERISTIC FCdtc_BPS2_max "FCtl_DTC(476)" VALUE 0x001638CC /* @ECU_Address@FCtl_DTC@0x021B53B8@ */ ECIPP_ALIGNMENT_UWORD 65535 Compu_IDENTITY 0 65535 PHYS_UNIT "DTC" /end CHARACTERISTIC
/begin CHARACTERISTIC FCdtc_BPS2_min "FCtl_DTC(477)" VALUE 0x001638CE /* @ECU_Address@FCtl_DTC@0x021B53BA@ */ ECIPP_ALIGNMENT_UWORD 65535 Compu_IDENTITY 0 65535 PHYS_UNIT "DTC" /end CHARACTERISTIC
/begin CHARACTERISTIC FCdtc_BPSerr_neg "FCtl_DTC(481)" VALUE 0x001638D6 /* @ECU_Address@FCtl_DTC@0x021B53C2@ */ ECIPP_ALIGNMENT_UWORD 65535 Compu_IDENTITY 0 65535 PHYS_UNIT "DTC" /end CHARACTERISTIC
/begin CHARACTERISTIC FCdtc_BPSerr_pos "FCtl_DTC(480)" VALUE 0x001638D4 /* @ECU_Address@FCtl_DTC@0x021B53C0@ */ ECIPP_ALIGNMENT_UWORD 65535 Compu_IDENTITY 0 65535 PHYS_UNIT "DTC" /end CHARACTERISTIC
/begin CHARACTERISTIC FCdtc_brake_gndshort "FCtl_DTC(329)" VALUE 0x001637A6 /* @ECU_Address@FCtl_DTC@0x021B5292@ */ ECIPP_ALIGNMENT_UWORD 65535 Compu_IDENTITY 0 65535 PHYS_UNIT "DTC" /end CHARACTERISTIC
/begin CHARACTERISTIC FCdtc_brake_pwrshort "FCtl_DTC(330)" VALUE 0x001637A8 /* @ECU_Address@FCtl_DTC@0x021B5294@ */ ECIPP_ALIGNMENT_UWORD 65535 Compu_IDENTITY 0 65535 PHYS_UNIT "DTC" /end CHARACTERISTIC
/begin CHARACTERISTIC FCdtc_bst_MAT_derate_actv "FCtl_DTC(811)" VALUE 0x00163B6A /* @ECU_Address@FCtl_DTC@0x021B5656@ */ ECIPP_ALIGNMENT_UWORD 65535 Compu_IDENTITY 0 65535 PHYS_UNIT "DTC" /end CHARACTERISTIC
/begin CHARACTERISTIC FCdtc_BstTIP_Hi "FCtl_DTC(143)" VALUE 0x00163632 /* @ECU_Address@FCtl_DTC@0x021B511E@ */ ECIPP_ALIGNMENT_UWORD 65535 Compu_IDENTITY 0 65535 PHYS_UNIT "DTC" /end CHARACTERISTIC
/begin CHARACTERISTIC FCdtc_BstTIP_Lo "FCtl_DTC(144)" VALUE 0x00163634 /* @ECU_Address@FCtl_DTC@0x021B5120@ */ ECIPP_ALIGNMENT_UWORD 65535 Compu_IDENTITY 0 65535 PHYS_UNIT "DTC" /end CHARACTERISTIC
/begin CHARACTERISTIC FCdtc_BstTIP_Lo2 "FCtl_DTC(686)" VALUE 0x00163A70 /* @ECU_Address@FCtl_DTC@0x021B555C@ */ ECIPP_ALIGNMENT_UWORD 65535 Compu_IDENTITY 0 65535 PHYS_UNIT "DTC" /end CHARACTERISTIC
/begin CHARACTERISTIC FCdtc_BstTIP_slow "FCtl_DTC(655)" VALUE 0x00163A32 /* @ECU_Address@FCtl_DTC@0x021B551E@ */ ECIPP_ALIGNMENT_UWORD 65535 Compu_IDENTITY 0 65535 PHYS_UNIT "DTC" /end CHARACTERISTIC
/begin CHARACTERISTIC FCdtc_buzz_coilopen "FCtl_DTC(165)" VALUE 0x0016365E /* @ECU_Address@FCtl_DTC@0x021B514A@ */ ECIPP_ALIGNMENT_UWORD 65535 Compu_IDENTITY 0 65535 PHYS_UNIT "DTC" /end CHARACTERISTIC
/begin CHARACTERISTIC FCdtc_buzz_coilshort "FCtl_DTC(166)" VALUE 0x00163660 /* @ECU_Address@FCtl_DTC@0x021B514C@ */ ECIPP_ALIGNMENT_UWORD 65535 Compu_IDENTITY 0 65535 PHYS_UNIT "DTC" /end CHARACTERISTIC
/begin CHARACTERISTIC FCdtc_buzz_gndshort "FCtl_DTC(164)" VALUE 0x0016365C /* @ECU_Address@FCtl_DTC@0x021B5148@ */ ECIPP_ALIGNMENT_UWORD 65535 Compu_IDENTITY 0 65535 PHYS_UNIT "DTC" /end CHARACTERISTIC
/begin CHARACTERISTIC FCdtc_CAC_eta_lo "FCtl_DTC(656)" VALUE 0x00163A34 /* @ECU_Address@FCtl_DTC@0x021B5520@ */ ECIPP_ALIGNMENT_UWORD 65535 Compu_IDENTITY 0 65535 PHYS_UNIT "DTC" /end CHARACTERISTIC
/begin CHARACTERISTIC FCdtc_cal_config "FCtl_DTC(319)" VALUE 0x00163792 /* @ECU_Address@FCtl_DTC@0x021B527E@ */ ECIPP_ALIGNMENT_UWORD 65535 Compu_IDENTITY 0 65535 PHYS_UNIT "DTC" /end CHARACTERISTIC
/begin CHARACTERISTIC FCdtc_cam2loss "FCtl_DTC(690)" VALUE 0x00163A78 /* @ECU_Address@FCtl_DTC@0x021B5564@ */ ECIPP_ALIGNMENT_UWORD 65535 Compu_IDENTITY 0 65535 PHYS_UNIT "DTC" /end CHARACTERISTIC
/begin CHARACTERISTIC FCdtc_camloss "FCtl_DTC(95)" VALUE 0x001635D2 /* @ECU_Address@FCtl_DTC@0x021B50BE@ */ ECIPP_ALIGNMENT_UWORD 65535 Compu_IDENTITY 0 65535 PHYS_UNIT "DTC" /end CHARACTERISTIC
/begin CHARACTERISTIC FCdtc_camnoise "FCtl_DTC(96)" VALUE 0x001635D4 /* @ECU_Address@FCtl_DTC@0x021B50C0@ */ ECIPP_ALIGNMENT_UWORD 65535 Compu_IDENTITY 0 65535 PHYS_UNIT "DTC" /end CHARACTERISTIC
/begin CHARACTERISTIC FCdtc_CATdP_hi "FCtl_DTC(526)" VALUE 0x00163930 /* @ECU_Address@FCtl_DTC@0x021B541C@ */ ECIPP_ALIGNMENT_UWORD 65535 Compu_IDENTITY 0 65535 PHYS_UNIT "DTC" /end CHARACTERISTIC
/begin CHARACTERISTIC FCdtc_CATdP_lo "FCtl_DTC(525)" VALUE 0x0016392E /* @ECU_Address@FCtl_DTC@0x021B541A@ */ ECIPP_ALIGNMENT_UWORD 65535 Compu_IDENTITY 0 65535 PHYS_UNIT "DTC" /end CHARACTERISTIC
/begin CHARACTERISTIC FCfmi_APUD12_min "FCtl_FMI(366)" VALUE 0x00165281 /* @ECU_Address@FCtl_FMI@0x021B716E@ */ ECIPP_ALIGNMENT_UBYTE 255 Compu_IDENTITY 0 255 PHYS_UNIT "FMI" /end CHARACTERISTIC
/begin CHARACTERISTIC FCfmi_APUD13_max "FCtl_FMI(367)" VALUE 0x00165282 /* @ECU_Address@FCtl_FMI@0x021B716F@ */ ECIPP_ALIGNMENT_UBYTE 255 Compu_IDENTITY 0 255 PHYS_UNIT "FMI" /end CHARACTERISTIC
/begin CHARACTERISTIC FCfmi_APUD13_min "FCtl_FMI(368)" VALUE 0x00165283 /* @ECU_Address@FCtl_FMI@0x021B7170@ */ ECIPP_ALIGNMENT_UBYTE 255 Compu_IDENTITY 0 255 PHYS_UNIT "FMI" /end CHARACTERISTIC
/begin CHARACTERISTIC FCfmi_APUD14_max "FCtl_FMI(369)" VALUE 0x00165284 /* @ECU_Address@FCtl_FMI@0x021B7171@ */ ECIPP_ALIGNMENT_UBYTE 255 Compu_IDENTITY 0 255 PHYS_UNIT "FMI" /end CHARACTERISTIC
/begin CHARACTERISTIC FCfmi_APUD14_min "FCtl_FMI(370)" VALUE 0x00165285 /* @ECU_Address@FCtl_FMI@0x021B7172@ */ ECIPP_ALIGNMENT_UBYTE 255 Compu_IDENTITY 0 255 PHYS_UNIT "FMI" /end CHARACTERISTIC
/begin CHARACTERISTIC FCfmi_APUD15_max "FCtl_FMI(371)" VALUE 0x00165286 /* @ECU_Address@FCtl_FMI@0x021B7173@ */ ECIPP_ALIGNMENT_UBYTE 255 Compu_IDENTITY 0 255 PHYS_UNIT "FMI" /end CHARACTERISTIC
/begin CHARACTERISTIC FCfmi_APUD15_min "FCtl_FMI(372)" VALUE 0x00165287 /* @ECU_Address@FCtl_FMI@0x021B7174@ */ ECIPP_ALIGNMENT_UBYTE 255 Compu_IDENTITY 0 255 PHYS_UNIT "FMI" /end CHARACTERISTIC
/begin CHARACTERISTIC FCfmi_APUD16_max "FCtl_FMI(373)" VALUE 0x00165288 /* @ECU_Address@FCtl_FMI@0x021B7175@ */ ECIPP_ALIGNMENT_UBYTE 255 Compu_IDENTITY 0 255 PHYS_UNIT "FMI" /end CHARACTERISTIC
/begin CHARACTERISTIC FCfmi_APUD16_min "FCtl_FMI(374)" VALUE 0x00165289 /* @ECU_Address@FCtl_FMI@0x021B7176@ */ ECIPP_ALIGNMENT_UBYTE 255 Compu_IDENTITY 0 255 PHYS_UNIT "FMI" /end CHARACTERISTIC
/begin CHARACTERISTIC FCfmi_APUD17_max "FCtl_FMI(375)" VALUE 0x0016528A /* @ECU_Address@FCtl_FMI@0x021B7177@ */ ECIPP_ALIGNMENT_UBYTE 255 Compu_IDENTITY 0 255 PHYS_UNIT "FMI" /end CHARACTERISTIC
/begin CHARACTERISTIC FCfmi_APUD17_min "FCtl_FMI(376)" VALUE 0x0016528B /* @ECU_Address@FCtl_FMI@0x021B7178@ */ ECIPP_ALIGNMENT_UBYTE 255 Compu_IDENTITY 0 255 PHYS_UNIT "FMI" /end CHARACTERISTIC
/begin CHARACTERISTIC FCfmi_APUD18_max "FCtl_FMI(377)" VALUE 0x0016528C /* @ECU_Address@FCtl_FMI@0x021B7179@ */ ECIPP_ALIGNMENT_UBYTE 255 Compu_IDENTITY 0 255 PHYS_UNIT "FMI" /end CHARACTERISTIC
/begin CHARACTERISTIC FCfmi_APUD18_min "FCtl_FMI(378)" VALUE 0x0016528D /* @ECU_Address@FCtl_FMI@0x021B717A@ */ ECIPP_ALIGNMENT_UBYTE 255 Compu_IDENTITY 0 255 PHYS_UNIT "FMI" /end CHARACTERISTIC
/begin CHARACTERISTIC FCfmi_APUD19_max "FCtl_FMI(379)" VALUE 0x0016528E /* @ECU_Address@FCtl_FMI@0x021B717B@ */ ECIPP_ALIGNMENT_UBYTE 255 Compu_IDENTITY 0 255 PHYS_UNIT "FMI" /end CHARACTERISTIC
/begin CHARACTERISTIC FCfmi_APUD19_min "FCtl_FMI(380)" VALUE 0x0016528F /* @ECU_Address@FCtl_FMI@0x021B717C@ */ ECIPP_ALIGNMENT_UBYTE 255 Compu_IDENTITY 0 255 PHYS_UNIT "FMI" /end CHARACTERISTIC
/begin CHARACTERISTIC FCfmi_APUD2_max "FCtl_FMI(205)" VALUE 0x001651E0 /* @ECU_Address@FCtl_FMI@0x021B70CD@ */ ECIPP_ALIGNMENT_UBYTE 255 Compu_IDENTITY 0 255 PHYS_UNIT "FMI" /end CHARACTERISTIC
/begin CHARACTERISTIC FCfmi_APUD2_min "FCtl_FMI(206)" VALUE 0x001651E1 /* @ECU_Address@FCtl_FMI@0x021B70CE@ */ ECIPP_ALIGNMENT_UBYTE 255 Compu_IDENTITY 0 255 PHYS_UNIT "FMI" /end CHARACTERISTIC
/begin CHARACTERISTIC FCfmi_APUD20_max "FCtl_FMI(381)" VALUE 0x00165290 /* @ECU_Address@FCtl_FMI@0x021B717D@ */ ECIPP_ALIGNMENT_UBYTE 255 Compu_IDENTITY 0 255 PHYS_UNIT "FMI" /end CHARACTERISTIC
/begin CHARACTERISTIC FCfmi_APUD20_min "FCtl_FMI(382)" VALUE 0x00165291 /* @ECU_Address@FCtl_FMI@0x021B717E@ */ ECIPP_ALIGNMENT_UBYTE 255 Compu_IDENTITY 0 255 PHYS_UNIT "FMI" /end CHARACTERISTIC
/begin CHARACTERISTIC FCfmi_APUD21_max "FCtl_FMI(383)" VALUE 0x00165292 /* @ECU_Address@FCtl_FMI@0x021B717F@ */ ECIPP_ALIGNMENT_UBYTE 255 Compu_IDENTITY 0 255 PHYS_UNIT "FMI" /end CHARACTERISTIC
/begin CHARACTERISTIC FCfmi_APUD21_min "FCtl_FMI(384)" VALUE 0x00165293 /* @ECU_Address@FCtl_FMI@0x021B7180@ */ ECIPP_ALIGNMENT_UBYTE 255 Compu_IDENTITY 0 255 PHYS_UNIT "FMI" /end CHARACTERISTIC
/begin CHARACTERISTIC FCfmi_APUD22_max "FCtl_FMI(385)" VALUE 0x00165294 /* @ECU_Address@FCtl_FMI@0x021B7181@ */ ECIPP_ALIGNMENT_UBYTE 255 Compu_IDENTITY 0 255 PHYS_UNIT "FMI" /end CHARACTERISTIC
/begin CHARACTERISTIC FCfmi_APUD22_min "FCtl_FMI(386)" VALUE 0x00165295 /* @ECU_Address@FCtl_FMI@0x021B7182@ */ ECIPP_ALIGNMENT_UBYTE 255 Compu_IDENTITY 0 255 PHYS_UNIT "FMI" /end CHARACTERISTIC
/begin CHARACTERISTIC FCfmi_APUD23_max "FCtl_FMI(387)" VALUE 0x00165296 /* @ECU_Address@FCtl_FMI@0x021B7183@ */ ECIPP_ALIGNMENT_UBYTE 255 Compu_IDENTITY 0 255 PHYS_UNIT "FMI" /end CHARACTERISTIC
/begin CHARACTERISTIC FCfmi_APUD23_min "FCtl_FMI(388)" VALUE 0x00165297 /* @ECU_Address@FCtl_FMI@0x021B7184@ */ ECIPP_ALIGNMENT_UBYTE 255 Compu_IDENTITY 0 255 PHYS_UNIT "FMI" /end CHARACTERISTIC
/begin CHARACTERISTIC FCfmi_APUD24_max "FCtl_FMI(389)" VALUE 0x00165298 /* @ECU_Address@FCtl_FMI@0x021B7185@ */ ECIPP_ALIGNMENT_UBYTE 255 Compu_IDENTITY 0 255 PHYS_UNIT "FMI" /end CHARACTERISTIC
/begin CHARACTERISTIC FCfmi_APUD24_min "FCtl_FMI(390)" VALUE 0x00165299 /* @ECU_Address@FCtl_FMI@0x021B7186@ */ ECIPP_ALIGNMENT_UBYTE 255 Compu_IDENTITY 0 255 PHYS_UNIT "FMI" /end CHARACTERISTIC
/begin CHARACTERISTIC FCfmi_APUD25_max "FCtl_FMI(391)" VALUE 0x0016529A /* @ECU_Address@FCtl_FMI@0x021B7187@ */ ECIPP_ALIGNMENT_UBYTE 255 Compu_IDENTITY 0 255 PHYS_UNIT "FMI" /end CHARACTERISTIC
/begin CHARACTERISTIC FCfmi_APUD25_min "FCtl_FMI(392)" VALUE 0x0016529B /* @ECU_Address@FCtl_FMI@0x021B7188@ */ ECIPP_ALIGNMENT_UBYTE 255 Compu_IDENTITY 0 255 PHYS_UNIT "FMI" /end CHARACTERISTIC
/begin CHARACTERISTIC FCfmi_APUD3_max "FCtl_FMI(207)" VALUE 0x001651E2 /* @ECU_Address@FCtl_FMI@0x021B70CF@ */ ECIPP_ALIGNMENT_UBYTE 255 Compu_IDENTITY 0 255 PHYS_UNIT "FMI" /end CHARACTERISTIC
/begin CHARACTERISTIC FCfmi_APUD3_min "FCtl_FMI(208)" VALUE 0x001651E3 /* @ECU_Address@FCtl_FMI@0x021B70D0@ */ ECIPP_ALIGNMENT_UBYTE 255 Compu_IDENTITY 0 255 PHYS_UNIT "FMI" /end CHARACTERISTIC
/begin CHARACTERISTIC FCfmi_APUD4_max "FCtl_FMI(280)" VALUE 0x0016522B /* @ECU_Address@FCtl_FMI@0x021B7118@ */ ECIPP_ALIGNMENT_UBYTE 255 Compu_IDENTITY 0 255 PHYS_UNIT "FMI" /end CHARACTERISTIC
/begin CHARACTERISTIC FCfmi_APUD4_min "FCtl_FMI(281)" VALUE 0x0016522C /* @ECU_Address@FCtl_FMI@0x021B7119@ */ ECIPP_ALIGNMENT_UBYTE 255 Compu_IDENTITY 0 255 PHYS_UNIT "FMI" /end CHARACTERISTIC
/begin CHARACTERISTIC FCfmi_APUD5_max "FCtl_FMI(331)" VALUE 0x0016525E /* @ECU_Address@FCtl_FMI@0x021B714B@ */ ECIPP_ALIGNMENT_UBYTE 255 Compu_IDENTITY 0 255 PHYS_UNIT "FMI" /end CHARACTERISTIC
/begin CHARACTERISTIC FCfmi_APUD5_min "FCtl_FMI(332)" VALUE 0x0016525F /* @ECU_Address@FCtl_FMI@0x021B714C@ */ ECIPP_ALIGNMENT_UBYTE 255 Compu_IDENTITY 0 255 PHYS_UNIT "FMI" /end CHARACTERISTIC
/begin CHARACTERISTIC FCfmi_APUD6_max "FCtl_FMI(333)" VALUE 0x00165260 /* @ECU_Address@FCtl_FMI@0x021B714D@ */ ECIPP_ALIGNMENT_UBYTE 255 Compu_IDENTITY 0 255 PHYS_UNIT "FMI" /end CHARACTERISTIC
/begin CHARACTERISTIC FCfmi_APUD6_min "FCtl_FMI(334)" VALUE 0x00165261 /* @ECU_Address@FCtl_FMI@0x021B714E@ */ ECIPP_ALIGNMENT_UBYTE 255 Compu_IDENTITY 0 255 PHYS_UNIT "FMI" /end CHARACTERISTIC
/begin CHARACTERISTIC FCfmi_APUD7_max "FCtl_FMI(335)" VALUE 0x00165262 /* @ECU_Address@FCtl_FMI@0x021B714F@ */ ECIPP_ALIGNMENT_UBYTE 255 Compu_IDENTITY 0 255 PHYS_UNIT "FMI" /end CHARACTERISTIC
/begin CHARACTERISTIC FCfmi_APUD7_min "FCtl_FMI(336)" VALUE 0x00165263 /* @ECU_Address@FCtl_FMI@0x021B7150@ */ ECIPP_ALIGNMENT_UBYTE 255 Compu_IDENTITY 0 255 PHYS_UNIT "FMI" /end CHARACTERISTIC
/begin CHARACTERISTIC FCfmi_APUD8_max "FCtl_FMI(352)" VALUE 0x00165273 /* @ECU_Address@FCtl_FMI@0x021B7160@ */ ECIPP_ALIGNMENT_UBYTE 255 Compu_IDENTITY 0 255 PHYS_UNIT "FMI" /end CHARACTERISTIC
/begin CHARACTERISTIC FCfmi_APUD8_min "FCtl_FMI(353)" VALUE 0x00165274 /* @ECU_Address@FCtl_FMI@0x021B7161@ */ ECIPP_ALIGNMENT_UBYTE 255 Compu_IDENTITY 0 255 PHYS_UNIT "FMI" /end CHARACTERISTIC
/begin CHARACTERISTIC FCfmi_APUD9_max "FCtl_FMI(359)" VALUE 0x0016527A /* @ECU_Address@FCtl_FMI@0x021B7167@ */ ECIPP_ALIGNMENT_UBYTE 255 Compu_IDENTITY 0 255 PHYS_UNIT "FMI" /end CHARACTERISTIC
/begin CHARACTERISTIC FCfmi_APUD9_min "FCtl_FMI(360)" VALUE 0x0016527B /* @ECU_Address@FCtl_FMI@0x021B7168@ */ ECIPP_ALIGNMENT_UBYTE 255 Compu_IDENTITY 0 255 PHYS_UNIT "FMI" /end CHARACTERISTIC
/begin CHARACTERISTIC FCfmi_AWP_intF "FCtl_FMI(832)" VALUE 0x00165453 /* @ECU_Address@FCtl_FMI@0x021B7340@ */ ECIPP_ALIGNMENT_UBYTE 255 Compu_IDENTITY 0 255 PHYS_UNIT "FMI" /end CHARACTERISTIC
/begin CHARACTERISTIC FCfmi_BP_max "FCtl_FMI(7)" VALUE 0x0016511A /* @ECU_Address@FCtl_FMI@0x021B7007@ */ ECIPP_ALIGNMENT_UBYTE 255 Compu_IDENTITY 0 255 PHYS_UNIT "FMI" /end CHARACTERISTIC
/begin CHARACTERISTIC FCfmi_BP_min "FCtl_FMI(8)" VALUE 0x0016511B /* @ECU_Address@FCtl_FMI@0x021B7008@ */ ECIPP_ALIGNMENT_UBYTE 255 Compu_IDENTITY 0 255 PHYS_UNIT "FMI" /end CHARACTERISTIC
/begin CHARACTERISTIC FCfmi_BPS1_max "FCtl_FMI(474)" VALUE 0x001652ED /* @ECU_Address@FCtl_FMI@0x021B71DA@ */ ECIPP_ALIGNMENT_UBYTE 255 Compu_IDENTITY 0 255 PHYS_UNIT "FMI" /end CHARACTERISTIC
/begin CHARACTERISTIC FCfmi_BPS1_min "FCtl_FMI(475)" VALUE 0x001652EE /* @ECU_Address@FCtl_FMI@0x021B71DB@ */ ECIPP_ALIGNMENT_UBYTE 255 Compu_IDENTITY 0 255 PHYS_UNIT "FMI" /end CHARACTERISTIC
/begin CHARACTERISTIC FCfmi_BPS12_OOR "FCtl_FMI(482)" VALUE 0x001652F5 /* @ECU_Address@FCtl_FMI@0x021B71E2@ */ ECIPP_ALIGNMENT_UBYTE 255 Compu_IDENTITY 0 255 PHYS_UNIT "FMI" /end CHARACTERISTIC
/begin CHARACTERISTIC FCfmi_BPS12pct_hi "FCtl_FMI(478)" VALUE 0x001652F1 /* @ECU_Address@FCtl_FMI@0x021B71DE@ */ ECIPP_ALIGNMENT_UBYTE 255 Compu_IDENTITY 0 255 PHYS_UNIT "FMI" /end CHARACTERISTIC
/begin CHARACTERISTIC FCfmi_BPS12pct_lo "FCtl_FMI(479)" VALUE 0x001652F2 /* @ECU_Address@FCtl_FMI@0x021B71DF@ */ ECIPP_ALIGNMENT_UBYTE 255 Compu_IDENTITY 0 255 PHYS_UNIT "FMI" /end CHARACTERISTIC
/begin CHARACTERISTIC FCfmi_BPS2_max "FCtl_FMI(476)" VALUE 0x001652EF /* @ECU_Address@FCtl_FMI@0x021B71DC@ */ ECIPP_ALIGNMENT_UBYTE 255 Compu_IDENTITY 0 255 PHYS_UNIT "FMI" /end CHARACTERISTIC
/begin CHARACTERISTIC FCfmi_BPS2_min "FCtl_FMI(477)" VALUE 0x001652F0 /* @ECU_Address@FCtl_FMI@0x021B71DD@ */ ECIPP_ALIGNMENT_UBYTE 255 Compu_IDENTITY 0 255 PHYS_UNIT "FMI" /end CHARACTERISTIC
/begin CHARACTERISTIC FCfmi_BPSerr_neg "FCtl_FMI(481)" VALUE 0x001652F4 /* @ECU_Address@FCtl_FMI@0x021B71E1@ */ ECIPP_ALIGNMENT_UBYTE 255 Compu_IDENTITY 0 255 PHYS_UNIT "FMI" /end CHARACTERISTIC
/begin CHARACTERISTIC FCfmi_BPSerr_pos "FCtl_FMI(480)" VALUE 0x001652F3 /* @ECU_Address@FCtl_FMI@0x021B71E0@ */ ECIPP_ALIGNMENT_UBYTE 255 Compu_IDENTITY 0 255 PHYS_UNIT "FMI" /end CHARACTERISTIC
/begin CHARACTERISTIC FCfmi_brake_gndshort "FCtl_FMI(329)" VALUE 0x0016525C /* @ECU_Address@FCtl_FMI@0x021B7149@ */ ECIPP_ALIGNMENT_UBYTE 255 Compu_IDENTITY 0 255 PHYS_UNIT "FMI" /end CHARACTERISTIC
/begin CHARACTERISTIC FCfmi_brake_pwrshort "FCtl_FMI(330)" VALUE 0x0016525D /* @ECU_Address@FCtl_FMI@0x021B714A@ */ ECIPP_ALIGNMENT_UBYTE 255 Compu_IDENTITY 0 255 PHYS_UNIT "FMI" /end CHARACTERISTIC
/begin CHARACTERISTIC FCfmi_bst_MAT_derate_actv "FCtl_FMI(811)" VALUE 0x0016543E /* @ECU_Address@FCtl_FMI@0x021B732B@ */ ECIPP_ALIGNMENT_UBYTE 255 Compu_IDENTITY 0 255 PHYS_UNIT "FMI" /end CHARACTERISTIC
/begin CHARACTERISTIC FCfmi_BstTIP_Hi "FCtl_FMI(143)" VALUE 0x001651A2 /* @ECU_Address@FCtl_FMI@0x021B708F@ */ ECIPP_ALIGNMENT_UBYTE 255 Compu_IDENTITY 0 255 PHYS_UNIT "FMI" /end CHARACTERISTIC
/begin CHARACTERISTIC FCfmi_BstTIP_Lo "FCtl_FMI(144)" VALUE 0x001651A3 /* @ECU_Address@FCtl_FMI@0x021B7090@ */ ECIPP_ALIGNMENT_UBYTE 255 Compu_IDENTITY 0 255 PHYS_UNIT "FMI" /end CHARACTERISTIC
/begin CHARACTERISTIC FCfmi_BstTIP_Lo2 "FCtl_FMI(686)" VALUE 0x001653C1 /* @ECU_Address@FCtl_FMI@0x021B72AE@ */ ECIPP_ALIGNMENT_UBYTE 255 Compu_IDENTITY 0 255 PHYS_UNIT "FMI" /end CHARACTERISTIC
/begin CHARACTERISTIC FCfmi_BstTIP_slow "FCtl_FMI(655)" VALUE 0x001653A2 /* @ECU_Address@FCtl_FMI@0x021B728F@ */ ECIPP_ALIGNMENT_UBYTE 255 Compu_IDENTITY 0 255 PHYS_UNIT "FMI" /end CHARACTERISTIC
/begin CHARACTERISTIC FCfmi_buzz_coilopen "FCtl_FMI(165)" VALUE 0x001651B8 /* @ECU_Address@FCtl_FMI@0x021B70A5@ */ ECIPP_ALIGNMENT_UBYTE 255 Compu_IDENTITY 0 255 PHYS_UNIT "FMI" /end CHARACTERISTIC
/begin CHARACTERISTIC FCfmi_buzz_coilshort "FCtl_FMI(166)" VALUE 0x001651B9 /* @ECU_Address@FCtl_FMI@0x021B70A6@ */ ECIPP_ALIGNMENT_UBYTE 255 Compu_IDENTITY 0 255 PHYS_UNIT "FMI" /end CHARACTERISTIC
/begin CHARACTERISTIC FCfmi_buzz_gndshort "FCtl_FMI(164)" VALUE 0x001651B7 /* @ECU_Address@FCtl_FMI@0x021B70A4@ */ ECIPP_ALIGNMENT_UBYTE 255 Compu_IDENTITY 0 255 PHYS_UNIT "FMI" /end CHARACTERISTIC
/begin CHARACTERISTIC FCfmi_CAC_eta_lo "FCtl_FMI(656)" VALUE 0x001653A3 /* @ECU_Address@FCtl_FMI@0x021B7290@ */ ECIPP_ALIGNMENT_UBYTE 255 Compu_IDENTITY 0 255 PHYS_UNIT "FMI" /end CHARACTERISTIC
/begin CHARACTERISTIC FCfmi_cal_config "FCtl_FMI(319)" VALUE 0x00165252 /* @ECU_Address@FCtl_FMI@0x021B713F@ */ ECIPP_ALIGNMENT_UBYTE 255 Compu_IDENTITY 0 255 PHYS_UNIT "FMI" /end CHARACTERISTIC
/begin CHARACTERISTIC FCfmi_cam2loss "FCtl_FMI(690)" VALUE 0x001653C5 /* @ECU_Address@FCtl_FMI@0x021B72B2@ */ ECIPP_ALIGNMENT_UBYTE 255 Compu_IDENTITY 0 255 PHYS_UNIT "FMI" /end CHARACTERISTIC
/begin CHARACTERISTIC FCfmi_camloss "FCtl_FMI(95)" VALUE 0x00165172 /* @ECU_Address@FCtl_FMI@0x021B705F@ */ ECIPP_ALIGNMENT_UBYTE 255 Compu_IDENTITY 0 255 PHYS_UNIT "FMI" /end CHARACTERISTIC
/begin CHARACTERISTIC FCfmi_camnoise "FCtl_FMI(96)" VALUE 0x00165173 /* @ECU_Address@FCtl_FMI@0x021B7060@ */ ECIPP_ALIGNMENT_UBYTE 255 Compu_IDENTITY 0 255 PHYS_UNIT "FMI" /end CHARACTERISTIC
/begin CHARACTERISTIC FCfmi_CATdP_hi "FCtl_FMI(526)" VALUE 0x00165321 /* @ECU_Address@FCtl_FMI@0x021B720E@ */ ECIPP_ALIGNMENT_UBYTE 255 Compu_IDENTITY 0 255 PHYS_UNIT "FMI" /end CHARACTERISTIC
/begin CHARACTERISTIC FCfmi_CATdP_lo "FCtl_FMI(525)" VALUE 0x00165320 /* @ECU_Address@FCtl_FMI@0x021B720D@ */ ECIPP_ALIGNMENT_UBYTE 255 Compu_IDENTITY 0 255 PHYS_UNIT "FMI" /end CHARACTERISTIC
/begin CHARACTERISTIC FCftb_APUD12_min "FCtl_FTB_0x04(366)" VALUE 0x001655DF /* @ECU_Address@FCtl_FTB_0x04@0x024C516E@ */ ECIPP_ALIGNMENT_UBYTE 255 Compu_IDENTITY 0 255 PHYS_UNIT "FTB" /end CHARACTERISTIC
/begin CHARACTERISTIC FCftb_APUD13_max "FCtl_FTB_0x04(367)" VALUE 0x001655E0 /* @ECU_Address@FCtl_FTB_0x04@0x024C516F@ */ ECIPP_ALIGNMENT_UBYTE 255 Compu_IDENTITY 0 255 PHYS_UNIT "FTB" /end CHARACTERISTIC
/begin CHARACTERISTIC FCftb_APUD13_min "FCtl_FTB_0x04(368)" VALUE 0x001655E1 /* @ECU_Address@FCtl_FTB_0x04@0x024C5170@ */ ECIPP_ALIGNMENT_UBYTE 255 Compu_IDENTITY 0 255 PHYS_UNIT "FTB" /end CHARACTERISTIC
/begin CHARACTERISTIC FCftb_APUD14_max "FCtl_FTB_0x04(369)" VALUE 0x001655E2 /* @ECU_Address@FCtl_FTB_0x04@0x024C5171@ */ ECIPP_ALIGNMENT_UBYTE 255 Compu_IDENTITY 0 255 PHYS_UNIT "FTB" /end CHARACTERISTIC
/begin CHARACTERISTIC FCftb_APUD14_min "FCtl_FTB_0x04(370)" VALUE 0x001655E3 /* @ECU_Address@FCtl_FTB_0x04@0x024C5172@ */ ECIPP_ALIGNMENT_UBYTE 255 Compu_IDENTITY 0 255 PHYS_UNIT "FTB" /end CHARACTERISTIC
/begin CHARACTERISTIC FCftb_APUD15_max "FCtl_FTB_0x04(371)" VALUE 0x001655E4 /* @ECU_Address@FCtl_FTB_0x04@0x024C5173@ */ ECIPP_ALIGNMENT_UBYTE 255 Compu_IDENTITY 0 255 PHYS_UNIT "FTB" /end CHARACTERISTIC
/begin CHARACTERISTIC FCftb_APUD15_min "FCtl_FTB_0x04(372)" VALUE 0x001655E5 /* @ECU_Address@FCtl_FTB_0x04@0x024C5174@ */ ECIPP_ALIGNMENT_UBYTE 255 Compu_IDENTITY 0 255 PHYS_UNIT "FTB" /end CHARACTERISTIC
/begin CHARACTERISTIC FCftb_APUD16_max "FCtl_FTB_0x04(373)" VALUE 0x001655E6 /* @ECU_Address@FCtl_FTB_0x04@0x024C5175@ */ ECIPP_ALIGNMENT_UBYTE 255 Compu_IDENTITY 0 255 PHYS_UNIT "FTB" /end CHARACTERISTIC
/begin CHARACTERISTIC FCftb_APUD16_min "FCtl_FTB_0x04(374)" VALUE 0x001655E7 /* @ECU_Address@FCtl_FTB_0x04@0x024C5176@ */ ECIPP_ALIGNMENT_UBYTE 255 Compu_IDENTITY 0 255 PHYS_UNIT "FTB" /end CHARACTERISTIC
/begin CHARACTERISTIC FCftb_APUD17_max "FCtl_FTB_0x04(375)" VALUE 0x001655E8 /* @ECU_Address@FCtl_FTB_0x04@0x024C5177@ */ ECIPP_ALIGNMENT_UBYTE 255 Compu_IDENTITY 0 255 PHYS_UNIT "FTB" /end CHARACTERISTIC
/begin CHARACTERISTIC FCftb_APUD17_min "FCtl_FTB_0x04(376)" VALUE 0x001655E9 /* @ECU_Address@FCtl_FTB_0x04@0x024C5178@ */ ECIPP_ALIGNMENT_UBYTE 255 Compu_IDENTITY 0 255 PHYS_UNIT "FTB" /end CHARACTERISTIC
/begin CHARACTERISTIC FCftb_APUD18_max "FCtl_FTB_0x04(377)" VALUE 0x001655EA /* @ECU_Address@FCtl_FTB_0x04@0x024C5179@ */ ECIPP_ALIGNMENT_UBYTE 255 Compu_IDENTITY 0 255 PHYS_UNIT "FTB" /end CHARACTERISTIC
/begin CHARACTERISTIC FCftb_APUD18_min "FCtl_FTB_0x04(378)" VALUE 0x001655EB /* @ECU_Address@FCtl_FTB_0x04@0x024C517A@ */ ECIPP_ALIGNMENT_UBYTE 255 Compu_IDENTITY 0 255 PHYS_UNIT "FTB" /end CHARACTERISTIC
/begin CHARACTERISTIC FCftb_APUD19_max "FCtl_FTB_0x04(379)" VALUE 0x001655EC /* @ECU_Address@FCtl_FTB_0x04@0x024C517B@ */ ECIPP_ALIGNMENT_UBYTE 255 Compu_IDENTITY 0 255 PHYS_UNIT "FTB" /end CHARACTERISTIC
/begin CHARACTERISTIC FCftb_APUD19_min "FCtl_FTB_0x04(380)" VALUE 0x001655ED /* @ECU_Address@FCtl_FTB_0x04@0x024C517C@ */ ECIPP_ALIGNMENT_UBYTE 255 Compu_IDENTITY 0 255 PHYS_UNIT "FTB" /end CHARACTERISTIC
/begin CHARACTERISTIC FCftb_APUD2_max "FCtl_FTB_0x04(205)" VALUE 0x0016553E /* @ECU_Address@FCtl_FTB_0x04@0x024C50CD@ */ ECIPP_ALIGNMENT_UBYTE 255 Compu_IDENTITY 0 255 PHYS_UNIT "FTB" /end CHARACTERISTIC
/begin CHARACTERISTIC FCftb_APUD2_min "FCtl_FTB_0x04(206)" VALUE 0x0016553F /* @ECU_Address@FCtl_FTB_0x04@0x024C50CE@ */ ECIPP_ALIGNMENT_UBYTE 255 Compu_IDENTITY 0 255 PHYS_UNIT "FTB" /end CHARACTERISTIC
/begin CHARACTERISTIC FCftb_APUD20_max "FCtl_FTB_0x04(381)" VALUE 0x001655EE /* @ECU_Address@FCtl_FTB_0x04@0x024C517D@ */ ECIPP_ALIGNMENT_UBYTE 255 Compu_IDENTITY 0 255 PHYS_UNIT "FTB" /end CHARACTERISTIC
/begin CHARACTERISTIC FCftb_APUD20_min "FCtl_FTB_0x04(382)" VALUE 0x001655EF /* @ECU_Address@FCtl_FTB_0x04@0x024C517E@ */ ECIPP_ALIGNMENT_UBYTE 255 Compu_IDENTITY 0 255 PHYS_UNIT "FTB" /end CHARACTERISTIC
/begin CHARACTERISTIC FCftb_APUD21_max "FCtl_FTB_0x04(383)" VALUE 0x001655F0 /* @ECU_Address@FCtl_FTB_0x04@0x024C517F@ */ ECIPP_ALIGNMENT_UBYTE 255 Compu_IDENTITY 0 255 PHYS_UNIT "FTB" /end CHARACTERISTIC
/begin CHARACTERISTIC FCftb_APUD21_min "FCtl_FTB_0x04(384)" VALUE 0x001655F1 /* @ECU_Address@FCtl_FTB_0x04@0x024C5180@ */ ECIPP_ALIGNMENT_UBYTE 255 Compu_IDENTITY 0 255 PHYS_UNIT "FTB" /end CHARACTERISTIC
/begin CHARACTERISTIC FCftb_APUD22_max "FCtl_FTB_0x04(385)" VALUE 0x001655F2 /* @ECU_Address@FCtl_FTB_0x04@0x024C5181@ */ ECIPP_ALIGNMENT_UBYTE 255 Compu_IDENTITY 0 255 PHYS_UNIT "FTB" /end CHARACTERISTIC
/begin CHARACTERISTIC FCftb_APUD22_min "FCtl_FTB_0x04(386)" VALUE 0x001655F3 /* @ECU_Address@FCtl_FTB_0x04@0x024C5182@ */ ECIPP_ALIGNMENT_UBYTE 255 Compu_IDENTITY 0 255 PHYS_UNIT "FTB" /end CHARACTERISTIC
/begin CHARACTERISTIC FCftb_APUD23_max "FCtl_FTB_0x04(387)" VALUE 0x001655F4 /* @ECU_Address@FCtl_FTB_0x04@0x024C5183@ */ ECIPP_ALIGNMENT_UBYTE 255 Compu_IDENTITY 0 255 PHYS_UNIT "FTB" /end CHARACTERISTIC
/begin CHARACTERISTIC FCftb_APUD23_min "FCtl_FTB_0x04(388)" VALUE 0x001655F5 /* @ECU_Address@FCtl_FTB_0x04@0x024C5184@ */ ECIPP_ALIGNMENT_UBYTE 255 Compu_IDENTITY 0 255 PHYS_UNIT "FTB" /end CHARACTERISTIC
/begin CHARACTERISTIC FCftb_APUD24_max "FCtl_FTB_0x04(389)" VALUE 0x001655F6 /* @ECU_Address@FCtl_FTB_0x04@0x024C5185@ */ ECIPP_ALIGNMENT_UBYTE 255 Compu_IDENTITY 0 255 PHYS_UNIT "FTB" /end CHARACTERISTIC
/begin CHARACTERISTIC FCftb_APUD24_min "FCtl_FTB_0x04(390)" VALUE 0x001655F7 /* @ECU_Address@FCtl_FTB_0x04@0x024C5186@ */ ECIPP_ALIGNMENT_UBYTE 255 Compu_IDENTITY 0 255 PHYS_UNIT "FTB" /end CHARACTERISTIC
/begin CHARACTERISTIC FCftb_APUD25_max "FCtl_FTB_0x04(391)" VALUE 0x001655F8 /* @ECU_Address@FCtl_FTB_0x04@0x024C5187@ */ ECIPP_ALIGNMENT_UBYTE 255 Compu_IDENTITY 0 255 PHYS_UNIT "FTB" /end CHARACTERISTIC
/begin CHARACTERISTIC FCftb_APUD25_min "FCtl_FTB_0x04(392)" VALUE 0x001655F9 /* @ECU_Address@FCtl_FTB_0x04@0x024C5188@ */ ECIPP_ALIGNMENT_UBYTE 255 Compu_IDENTITY 0 255 PHYS_UNIT "FTB" /end CHARACTERISTIC
/begin CHARACTERISTIC FCftb_APUD3_max "FCtl_FTB_0x04(207)" VALUE 0x00165540 /* @ECU_Address@FCtl_FTB_0x04@0x024C50CF@ */ ECIPP_ALIGNMENT_UBYTE 255 Compu_IDENTITY 0 255 PHYS_UNIT "FTB" /end CHARACTERISTIC
/begin CHARACTERISTIC FCftb_APUD3_min "FCtl_FTB_0x04(208)" VALUE 0x00165541 /* @ECU_Address@FCtl_FTB_0x04@0x024C50D0@ */ ECIPP_ALIGNMENT_UBYTE 255 Compu_IDENTITY 0 255 PHYS_UNIT "FTB" /end CHARACTERISTIC
/begin CHARACTERISTIC FCftb_APUD4_max "FCtl_FTB_0x04(280)" VALUE 0x00165589 /* @ECU_Address@FCtl_FTB_0x04@0x024C5118@ */ ECIPP_ALIGNMENT_UBYTE 255 Compu_IDENTITY 0 255 PHYS_UNIT "FTB" /end CHARACTERISTIC
/begin CHARACTERISTIC FCftb_APUD4_min "FCtl_FTB_0x04(281)" VALUE 0x0016558A /* @ECU_Address@FCtl_FTB_0x04@0x024C5119@ */ ECIPP_ALIGNMENT_UBYTE 255 Compu_IDENTITY 0 255 PHYS_UNIT "FTB" /end CHARACTERISTIC
/begin CHARACTERISTIC FCftb_APUD5_max "FCtl_FTB_0x04(331)" VALUE 0x001655BC /* @ECU_Address@FCtl_FTB_0x04@0x024C514B@ */ ECIPP_ALIGNMENT_UBYTE 255 Compu_IDENTITY 0 255 PHYS_UNIT "FTB" /end CHARACTERISTIC
/begin CHARACTERISTIC FCftb_APUD5_min "FCtl_FTB_0x04(332)" VALUE 0x001655BD /* @ECU_Address@FCtl_FTB_0x04@0x024C514C@ */ ECIPP_ALIGNMENT_UBYTE 255 Compu_IDENTITY 0 255 PHYS_UNIT "FTB" /end CHARACTERISTIC
/begin CHARACTERISTIC FCftb_APUD6_max "FCtl_FTB_0x04(333)" VALUE 0x001655BE /* @ECU_Address@FCtl_FTB_0x04@0x024C514D@ */ ECIPP_ALIGNMENT_UBYTE 255 Compu_IDENTITY 0 255 PHYS_UNIT "FTB" /end CHARACTERISTIC
/begin CHARACTERISTIC FCftb_APUD6_min "FCtl_FTB_0x04(334)" VALUE 0x001655BF /* @ECU_Address@FCtl_FTB_0x04@0x024C514E@ */ ECIPP_ALIGNMENT_UBYTE 255 Compu_IDENTITY 0 255 PHYS_UNIT "FTB" /end CHARACTERISTIC
/begin CHARACTERISTIC FCftb_APUD7_max "FCtl_FTB_0x04(335)" VALUE 0x001655C0 /* @ECU_Address@FCtl_FTB_0x04@0x024C514F@ */ ECIPP_ALIGNMENT_UBYTE 255 Compu_IDENTITY 0 255 PHYS_UNIT "FTB" /end CHARACTERISTIC
/begin CHARACTERISTIC FCftb_APUD7_min "FCtl_FTB_0x04(336)" VALUE 0x001655C1 /* @ECU_Address@FCtl_FTB_0x04@0x024C5150@ */ ECIPP_ALIGNMENT_UBYTE 255 Compu_IDENTITY 0 255 PHYS_UNIT "FTB" /end CHARACTERISTIC
/begin CHARACTERISTIC FCftb_APUD8_max "FCtl_FTB_0x04(352)" VALUE 0x001655D1 /* @ECU_Address@FCtl_FTB_0x04@0x024C5160@ */ ECIPP_ALIGNMENT_UBYTE 255 Compu_IDENTITY 0 255 PHYS_UNIT "FTB" /end CHARACTERISTIC
/begin CHARACTERISTIC FCftb_APUD8_min "FCtl_FTB_0x04(353)" VALUE 0x001655D2 /* @ECU_Address@FCtl_FTB_0x04@0x024C5161@ */ ECIPP_ALIGNMENT_UBYTE 255 Compu_IDENTITY 0 255 PHYS_UNIT "FTB" /end CHARACTERISTIC
/begin CHARACTERISTIC FCftb_APUD9_max "FCtl_FTB_0x04(359)" VALUE 0x001655D8 /* @ECU_Address@FCtl_FTB_0x04@0x024C5167@ */ ECIPP_ALIGNMENT_UBYTE 255 Compu_IDENTITY 0 255 PHYS_UNIT "FTB" /end CHARACTERISTIC
/begin CHARACTERISTIC FCftb_APUD9_min "FCtl_FTB_0x04(360)" VALUE 0x001655D9 /* @ECU_Address@FCtl_FTB_0x04@0x024C5168@ */ ECIPP_ALIGNMENT_UBYTE 255 Compu_IDENTITY 0 255 PHYS_UNIT "FTB" /end CHARACTERISTIC
/begin CHARACTERISTIC FCftb_AWP_intF "FCtl_FTB_0x04(832)" VALUE 0x001657B1 /* @ECU_Address@FCtl_FTB_0x04@0x024C5340@ */ ECIPP_ALIGNMENT_UBYTE 255 Compu_IDENTITY 0 255 PHYS_UNIT "FTB" /end CHARACTERISTIC
/begin CHARACTERISTIC FCftb_BP_max "FCtl_FTB_0x04(7)" VALUE 0x00165478 /* @ECU_Address@FCtl_FTB_0x04@0x024C5007@ */ ECIPP_ALIGNMENT_UBYTE 255 Compu_IDENTITY 0 255 PHYS_UNIT "FTB" /end CHARACTERISTIC
/begin CHARACTERISTIC FCftb_BP_min "FCtl_FTB_0x04(8)" VALUE 0x00165479 /* @ECU_Address@FCtl_FTB_0x04@0x024C5008@ */ ECIPP_ALIGNMENT_UBYTE 255 Compu_IDENTITY 0 255 PHYS_UNIT "FTB" /end CHARACTERISTIC
/begin CHARACTERISTIC FCftb_BPS1_max "FCtl_FTB_0x04(474)" VALUE 0x0016564B /* @ECU_Address@FCtl_FTB_0x04@0x024C51DA@ */ ECIPP_ALIGNMENT_UBYTE 255 Compu_IDENTITY 0 255 PHYS_UNIT "FTB" /end CHARACTERISTIC
/begin CHARACTERISTIC FCftb_BPS1_min "FCtl_FTB_0x04(475)" VALUE 0x0016564C /* @ECU_Address@FCtl_FTB_0x04@0x024C51DB@ */ ECIPP_ALIGNMENT_UBYTE 255 Compu_IDENTITY 0 255 PHYS_UNIT "FTB" /end CHARACTERISTIC
/begin CHARACTERISTIC FCftb_BPS12_OOR "FCtl_FTB_0x04(482)" VALUE 0x00165653 /* @ECU_Address@FCtl_FTB_0x04@0x024C51E2@ */ ECIPP_ALIGNMENT_UBYTE 255 Compu_IDENTITY 0 255 PHYS_UNIT "FTB" /end CHARACTERISTIC
/begin CHARACTERISTIC FCftb_BPS12pct_hi "FCtl_FTB_0x04(478)" VALUE 0x0016564F /* @ECU_Address@FCtl_FTB_0x04@0x024C51DE@ */ ECIPP_ALIGNMENT_UBYTE 255 Compu_IDENTITY 0 255 PHYS_UNIT "FTB" /end CHARACTERISTIC
/begin CHARACTERISTIC FCftb_BPS12pct_lo "FCtl_FTB_0x04(479)" VALUE 0x00165650 /* @ECU_Address@FCtl_FTB_0x04@0x024C51DF@ */ ECIPP_ALIGNMENT_UBYTE 255 Compu_IDENTITY 0 255 PHYS_UNIT "FTB" /end CHARACTERISTIC
/begin CHARACTERISTIC FCftb_BPS2_max "FCtl_FTB_0x04(476)" VALUE 0x0016564D /* @ECU_Address@FCtl_FTB_0x04@0x024C51DC@ */ ECIPP_ALIGNMENT_UBYTE 255 Compu_IDENTITY 0 255 PHYS_UNIT "FTB" /end CHARACTERISTIC
/begin CHARACTERISTIC FCftb_BPS2_min "FCtl_FTB_0x04(477)" VALUE 0x0016564E /* @ECU_Address@FCtl_FTB_0x04@0x024C51DD@ */ ECIPP_ALIGNMENT_UBYTE 255 Compu_IDENTITY 0 255 PHYS_UNIT "FTB" /end CHARACTERISTIC
/begin CHARACTERISTIC FCftb_BPSerr_neg "FCtl_FTB_0x04(481)" VALUE 0x00165652 /* @ECU_Address@FCtl_FTB_0x04@0x024C51E1@ */ ECIPP_ALIGNMENT_UBYTE 255 Compu_IDENTITY 0 255 PHYS_UNIT "FTB" /end CHARACTERISTIC
/begin CHARACTERISTIC FCftb_BPSerr_pos "FCtl_FTB_0x04(480)" VALUE 0x00165651 /* @ECU_Address@FCtl_FTB_0x04@0x024C51E0@ */ ECIPP_ALIGNMENT_UBYTE 255 Compu_IDENTITY 0 255 PHYS_UNIT "FTB" /end CHARACTERISTIC
/begin CHARACTERISTIC FCftb_brake_gndshort "FCtl_FTB_0x04(329)" VALUE 0x001655BA /* @ECU_Address@FCtl_FTB_0x04@0x024C5149@ */ ECIPP_ALIGNMENT_UBYTE 255 Compu_IDENTITY 0 255 PHYS_UNIT "FTB" /end CHARACTERISTIC
/begin CHARACTERISTIC FCftb_brake_pwrshort "FCtl_FTB_0x04(330)" VALUE 0x001655BB /* @ECU_Address@FCtl_FTB_0x04@0x024C514A@ */ ECIPP_ALIGNMENT_UBYTE 255 Compu_IDENTITY 0 255 PHYS_UNIT "FTB" /end CHARACTERISTIC
/begin CHARACTERISTIC FCftb_bst_MAT_derate_actv "FCtl_FTB_0x04(811)" VALUE 0x0016579C /* @ECU_Address@FCtl_FTB_0x04@0x024C532B@ */ ECIPP_ALIGNMENT_UBYTE 255 Compu_IDENTITY 0 255 PHYS_UNIT "FTB" /end CHARACTERISTIC
/begin CHARACTERISTIC FCftb_BstTIP_Hi "FCtl_FTB_0x04(143)" VALUE 0x00165500 /* @ECU_Address@FCtl_FTB_0x04@0x024C508F@ */ ECIPP_ALIGNMENT_UBYTE 255 Compu_IDENTITY 0 255 PHYS_UNIT "FTB" /end CHARACTERISTIC
/begin CHARACTERISTIC FCftb_BstTIP_Lo "FCtl_FTB_0x04(144)" VALUE 0x00165501 /* @ECU_Address@FCtl_FTB_0x04@0x024C5090@ */ ECIPP_ALIGNMENT_UBYTE 255 Compu_IDENTITY 0 255 PHYS_UNIT "FTB" /end CHARACTERISTIC
/begin CHARACTERISTIC FCftb_BstTIP_Lo2 "FCtl_FTB_0x04(686)" VALUE 0x0016571F /* @ECU_Address@FCtl_FTB_0x04@0x024C52AE@ */ ECIPP_ALIGNMENT_UBYTE 255 Compu_IDENTITY 0 255 PHYS_UNIT "FTB" /end CHARACTERISTIC
/begin CHARACTERISTIC FCftb_BstTIP_slow "FCtl_FTB_0x04(655)" VALUE 0x00165700 /* @ECU_Address@FCtl_FTB_0x04@0x024C528F@ */ ECIPP_ALIGNMENT_UBYTE 255 Compu_IDENTITY 0 255 PHYS_UNIT "FTB" /end CHARACTERISTIC
/begin CHARACTERISTIC FCftb_buzz_coilopen "FCtl_FTB_0x04(165)" VALUE 0x00165516 /* @ECU_Address@FCtl_FTB_0x04@0x024C50A5@ */ ECIPP_ALIGNMENT_UBYTE 255 Compu_IDENTITY 0 255 PHYS_UNIT "FTB" /end CHARACTERISTIC
/begin CHARACTERISTIC FCftb_buzz_coilshort "FCtl_FTB_0x04(166)" VALUE 0x00165517 /* @ECU_Address@FCtl_FTB_0x04@0x024C50A6@ */ ECIPP_ALIGNMENT_UBYTE 255 Compu_IDENTITY 0 255 PHYS_UNIT "FTB" /end CHARACTERISTIC
/begin CHARACTERISTIC FCftb_buzz_gndshort "FCtl_FTB_0x04(164)" VALUE 0x00165515 /* @ECU_Address@FCtl_FTB_0x04@0x024C50A4@ */ ECIPP_ALIGNMENT_UBYTE 255 Compu_IDENTITY 0 255 PHYS_UNIT "FTB" /end CHARACTERISTIC
/begin CHARACTERISTIC FCftb_CAC_eta_lo "FCtl_FTB_0x04(656)" VALUE 0x00165701 /* @ECU_Address@FCtl_FTB_0x04@0x024C5290@ */ ECIPP_ALIGNMENT_UBYTE 255 Compu_IDENTITY 0 255 PHYS_UNIT "FTB" /end CHARACTERISTIC
/begin CHARACTERISTIC FCftb_cal_config "FCtl_FTB_0x04(319)" VALUE 0x001655B0 /* @ECU_Address@FCtl_FTB_0x04@0x024C513F@ */ ECIPP_ALIGNMENT_UBYTE 255 Compu_IDENTITY 0 255 PHYS_UNIT "FTB" /end CHARACTERISTIC
/begin CHARACTERISTIC FCftb_cam2loss "FCtl_FTB_0x04(690)" VALUE 0x00165723 /* @ECU_Address@FCtl_FTB_0x04@0x024C52B2@ */ ECIPP_ALIGNMENT_UBYTE 255 Compu_IDENTITY 0 255 PHYS_UNIT "FTB" /end CHARACTERISTIC
/begin CHARACTERISTIC FCftb_camloss "FCtl_FTB_0x04(95)" VALUE 0x001654D0 /* @ECU_Address@FCtl_FTB_0x04@0x024C505F@ */ ECIPP_ALIGNMENT_UBYTE 255 Compu_IDENTITY 0 255 PHYS_UNIT "FTB" /end CHARACTERISTIC
/begin CHARACTERISTIC FCftb_camnoise "FCtl_FTB_0x04(96)" VALUE 0x001654D1 /* @ECU_Address@FCtl_FTB_0x04@0x024C5060@ */ ECIPP_ALIGNMENT_UBYTE 255 Compu_IDENTITY 0 255 PHYS_UNIT "FTB" /end CHARACTERISTIC
/begin CHARACTERISTIC FCftb_CATdP_hi "FCtl_FTB_0x04(526)" VALUE 0x0016567F /* @ECU_Address@FCtl_FTB_0x04@0x024C520E@ */ ECIPP_ALIGNMENT_UBYTE 255 Compu_IDENTITY 0 255 PHYS_UNIT "FTB" /end CHARACTERISTIC
/begin CHARACTERISTIC FCftb_CATdP_lo "FCtl_FTB_0x04(525)" VALUE 0x0016567E /* @ECU_Address@FCtl_FTB_0x04@0x024C520D@ */ ECIPP_ALIGNMENT_UBYTE 255 Compu_IDENTITY 0 255 PHYS_UNIT "FTB" /end CHARACTERISTIC
/begin CHARACTERISTIC FCspn_APUD12_min "FCtl_SPN(366)" VALUE 0x00162294 /* @ECU_Address@FCtl_SPN@0x021B65B8@ */ ECIPP_ALIGNMENT_ULONG 4294967295 Compu_IDENTITY 0 4294967295 PHYS_UNIT "SPN" /end CHARACTERISTIC
/begin CHARACTERISTIC FCspn_APUD13_max "FCtl_SPN(367)" VALUE 0x00162298 /* @ECU_Address@FCtl_SPN@0x021B65BC@ */ ECIPP_ALIGNMENT_ULONG 4294967295 Compu_IDENTITY 0 4294967295 PHYS_UNIT "SPN" /end CHARACTERISTIC
/begin CHARACTERISTIC FCspn_APUD13_min "FCtl_SPN(368)" VALUE 0x0016229C /* @ECU_Address@FCtl_SPN@0x021B65C0@ */ ECIPP_ALIGNMENT_ULONG 4294967295 Compu_IDENTITY 0 4294967295 PHYS_UNIT "SPN" /end CHARACTERISTIC
/begin CHARACTERISTIC FCspn_APUD14_max "FCtl_SPN(369)" VALUE 0x001622A0 /* @ECU_Address@FCtl_SPN@0x021B65C4@ */ ECIPP_ALIGNMENT_ULONG 4294967295 Compu_IDENTITY 0 4294967295 PHYS_UNIT "SPN" /end CHARACTERISTIC
/begin CHARACTERISTIC FCspn_APUD14_min "FCtl_SPN(370)" VALUE 0x001622A4 /* @ECU_Address@FCtl_SPN@0x021B65C8@ */ ECIPP_ALIGNMENT_ULONG 4294967295 Compu_IDENTITY 0 4294967295 PHYS_UNIT "SPN" /end CHARACTERISTIC
/begin CHARACTERISTIC FCspn_APUD15_max "FCtl_SPN(371)" VALUE 0x001622A8 /* @ECU_Address@FCtl_SPN@0x021B65CC@ */ ECIPP_ALIGNMENT_ULONG 4294967295 Compu_IDENTITY 0 4294967295 PHYS_UNIT "SPN" /end CHARACTERISTIC
/begin CHARACTERISTIC FCspn_APUD15_min "FCtl_SPN(372)" VALUE 0x001622AC /* @ECU_Address@FCtl_SPN@0x021B65D0@ */ ECIPP_ALIGNMENT_ULONG 4294967295 Compu_IDENTITY 0 4294967295 PHYS_UNIT "SPN" /end CHARACTERISTIC
/begin CHARACTERISTIC FCspn_APUD16_max "FCtl_SPN(373)" VALUE 0x001622B0 /* @ECU_Address@FCtl_SPN@0x021B65D4@ */ ECIPP_ALIGNMENT_ULONG 4294967295 Compu_IDENTITY 0 4294967295 PHYS_UNIT "SPN" /end CHARACTERISTIC
/begin CHARACTERISTIC FCspn_APUD16_min "FCtl_SPN(374)" VALUE 0x001622B4 /* @ECU_Address@FCtl_SPN@0x021B65D8@ */ ECIPP_ALIGNMENT_ULONG 4294967295 Compu_IDENTITY 0 4294967295 PHYS_UNIT "SPN" /end CHARACTERISTIC
/begin CHARACTERISTIC FCspn_APUD17_max "FCtl_SPN(375)" VALUE 0x001622B8 /* @ECU_Address@FCtl_SPN@0x021B65DC@ */ ECIPP_ALIGNMENT_ULONG 4294967295 Compu_IDENTITY 0 4294967295 PHYS_UNIT "SPN" /end CHARACTERISTIC
/begin CHARACTERISTIC FCspn_APUD17_min "FCtl_SPN(376)" VALUE 0x001622BC /* @ECU_Address@FCtl_SPN@0x021B65E0@ */ ECIPP_ALIGNMENT_ULONG 4294967295 Compu_IDENTITY 0 4294967295 PHYS_UNIT "SPN" /end CHARACTERISTIC
/begin CHARACTERISTIC FCspn_APUD18_max "FCtl_SPN(377)" VALUE 0x001622C0 /* @ECU_Address@FCtl_SPN@0x021B65E4@ */ ECIPP_ALIGNMENT_ULONG 4294967295 Compu_IDENTITY 0 4294967295 PHYS_UNIT "SPN" /end CHARACTERISTIC
/begin CHARACTERISTIC FCspn_APUD18_min "FCtl_SPN(378)" VALUE 0x001622C4 /* @ECU_Address@FCtl_SPN@0x021B65E8@ */ ECIPP_ALIGNMENT_ULONG 4294967295 Compu_IDENTITY 0 4294967295 PHYS_UNIT "SPN" /end CHARACTERISTIC
/begin CHARACTERISTIC FCspn_APUD19_max "FCtl_SPN(379)" VALUE 0x001622C8 /* @ECU_Address@FCtl_SPN@0x021B65EC@ */ ECIPP_ALIGNMENT_ULONG 4294967295 Compu_IDENTITY 0 4294967295 PHYS_UNIT "SPN" /end CHARACTERISTIC
/begin CHARACTERISTIC FCspn_APUD19_min "FCtl_SPN(380)" VALUE 0x001622CC /* @ECU_Address@FCtl_SPN@0x021B65F0@ */ ECIPP_ALIGNMENT_ULONG 4294967295 Compu_IDENTITY 0 4294967295 PHYS_UNIT "SPN" /end CHARACTERISTIC
/begin CHARACTERISTIC FCspn_APUD2_max "FCtl_SPN(205)" VALUE 0x00162010 /* @ECU_Address@FCtl_SPN@0x021B6334@ */ ECIPP_ALIGNMENT_ULONG 4294967295 Compu_IDENTITY 0 4294967295 PHYS_UNIT "SPN" /end CHARACTERISTIC
/begin CHARACTERISTIC FCspn_APUD2_min "FCtl_SPN(206)" VALUE 0x00162014 /* @ECU_Address@FCtl_SPN@0x021B6338@ */ ECIPP_ALIGNMENT_ULONG 4294967295 Compu_IDENTITY 0 4294967295 PHYS_UNIT "SPN" /end CHARACTERISTIC
/begin CHARACTERISTIC FCspn_APUD20_max "FCtl_SPN(381)" VALUE 0x001622D0 /* @ECU_Address@FCtl_SPN@0x021B65F4@ */ ECIPP_ALIGNMENT_ULONG 4294967295 Compu_IDENTITY 0 4294967295 PHYS_UNIT "SPN" /end CHARACTERISTIC
/begin CHARACTERISTIC FCspn_APUD20_min "FCtl_SPN(382)" VALUE 0x001622D4 /* @ECU_Address@FCtl_SPN@0x021B65F8@ */ ECIPP_ALIGNMENT_ULONG 4294967295 Compu_IDENTITY 0 4294967295 PHYS_UNIT "SPN" /end CHARACTERISTIC
/begin CHARACTERISTIC FCspn_APUD21_max "FCtl_SPN(383)" VALUE 0x001622D8 /* @ECU_Address@FCtl_SPN@0x021B65FC@ */ ECIPP_ALIGNMENT_ULONG 4294967295 Compu_IDENTITY 0 4294967295 PHYS_UNIT "SPN" /end CHARACTERISTIC
/begin CHARACTERISTIC FCspn_APUD21_min "FCtl_SPN(384)" VALUE 0x001622DC /* @ECU_Address@FCtl_SPN@0x021B6600@ */ ECIPP_ALIGNMENT_ULONG 4294967295 Compu_IDENTITY 0 4294967295 PHYS_UNIT "SPN" /end CHARACTERISTIC
/begin CHARACTERISTIC FCspn_APUD22_max "FCtl_SPN(385)" VALUE 0x001622E0 /* @ECU_Address@FCtl_SPN@0x021B6604@ */ ECIPP_ALIGNMENT_ULONG 4294967295 Compu_IDENTITY 0 4294967295 PHYS_UNIT "SPN" /end CHARACTERISTIC
/begin CHARACTERISTIC FCspn_APUD22_min "FCtl_SPN(386)" VALUE 0x001622E4 /* @ECU_Address@FCtl_SPN@0x021B6608@ */ ECIPP_ALIGNMENT_ULONG 4294967295 Compu_IDENTITY 0 4294967295 PHYS_UNIT "SPN" /end CHARACTERISTIC
/begin CHARACTERISTIC FCspn_APUD23_max "FCtl_SPN(387)" VALUE 0x001622E8 /* @ECU_Address@FCtl_SPN@0x021B660C@ */ ECIPP_ALIGNMENT_ULONG 4294967295 Compu_IDENTITY 0 4294967295 PHYS_UNIT "SPN" /end CHARACTERISTIC
/begin CHARACTERISTIC FCspn_APUD23_min "FCtl_SPN(388)" VALUE 0x001622EC /* @ECU_Address@FCtl_SPN@0x021B6610@ */ ECIPP_ALIGNMENT_ULONG 4294967295 Compu_IDENTITY 0 4294967295 PHYS_UNIT "SPN" /end CHARACTERISTIC
/begin CHARACTERISTIC FCspn_APUD24_max "FCtl_SPN(389)" VALUE 0x001622F0 /* @ECU_Address@FCtl_SPN@0x021B6614@ */ ECIPP_ALIGNMENT_ULONG 4294967295 Compu_IDENTITY 0 4294967295 PHYS_UNIT "SPN" /end CHARACTERISTIC
/begin CHARACTERISTIC FCspn_APUD24_min "FCtl_SPN(390)" VALUE 0x001622F4 /* @ECU_Address@FCtl_SPN@0x021B6618@ */ ECIPP_ALIGNMENT_ULONG 4294967295 Compu_IDENTITY 0 4294967295 PHYS_UNIT "SPN" /end CHARACTERISTIC
/begin CHARACTERISTIC FCspn_APUD25_max "FCtl_SPN(391)" VALUE 0x001622F8 /* @ECU_Address@FCtl_SPN@0x021B661C@ */ ECIPP_ALIGNMENT_ULONG 4294967295 Compu_IDENTITY 0 4294967295 PHYS_UNIT "SPN" /end CHARACTERISTIC
/begin CHARACTERISTIC FCspn_APUD25_min "FCtl_SPN(392)" VALUE 0x001622FC /* @ECU_Address@FCtl_SPN@0x021B6620@ */ ECIPP_ALIGNMENT_ULONG 4294967295 Compu_IDENTITY 0 4294967295 PHYS_UNIT "SPN" /end CHARACTERISTIC
/begin CHARACTERISTIC FCspn_APUD3_max "FCtl_SPN(207)" VALUE 0x00162018 /* @ECU_Address@FCtl_SPN@0x021B633C@ */ ECIPP_ALIGNMENT_ULONG 4294967295 Compu_IDENTITY 0 4294967295 PHYS_UNIT "SPN" /end CHARACTERISTIC
/begin CHARACTERISTIC FCspn_APUD3_min "FCtl_SPN(208)" VALUE 0x0016201C /* @ECU_Address@FCtl_SPN@0x021B6340@ */ ECIPP_ALIGNMENT_ULONG 4294967295 Compu_IDENTITY 0 4294967295 PHYS_UNIT "SPN" /end CHARACTERISTIC
/begin CHARACTERISTIC FCspn_APUD4_max "FCtl_SPN(280)" VALUE 0x0016213C /* @ECU_Address@FCtl_SPN@0x021B6460@ */ ECIPP_ALIGNMENT_ULONG 4294967295 Compu_IDENTITY 0 4294967295 PHYS_UNIT "SPN" /end CHARACTERISTIC
/begin CHARACTERISTIC FCspn_APUD4_min "FCtl_SPN(281)" VALUE 0x00162140 /* @ECU_Address@FCtl_SPN@0x021B6464@ */ ECIPP_ALIGNMENT_ULONG 4294967295 Compu_IDENTITY 0 4294967295 PHYS_UNIT "SPN" /end CHARACTERISTIC
/begin CHARACTERISTIC FCspn_APUD5_max "FCtl_SPN(331)" VALUE 0x00162208 /* @ECU_Address@FCtl_SPN@0x021B652C@ */ ECIPP_ALIGNMENT_ULONG 4294967295 Compu_IDENTITY 0 4294967295 PHYS_UNIT "SPN" /end CHARACTERISTIC
/begin CHARACTERISTIC FCspn_APUD5_min "FCtl_SPN(332)" VALUE 0x0016220C /* @ECU_Address@FCtl_SPN@0x021B6530@ */ ECIPP_ALIGNMENT_ULONG 4294967295 Compu_IDENTITY 0 4294967295 PHYS_UNIT "SPN" /end CHARACTERISTIC
/begin CHARACTERISTIC FCspn_APUD6_max "FCtl_SPN(333)" VALUE 0x00162210 /* @ECU_Address@FCtl_SPN@0x021B6534@ */ ECIPP_ALIGNMENT_ULONG 4294967295 Compu_IDENTITY 0 4294967295 PHYS_UNIT "SPN" /end CHARACTERISTIC
/begin CHARACTERISTIC FCspn_APUD6_min "FCtl_SPN(334)" VALUE 0x00162214 /* @ECU_Address@FCtl_SPN@0x021B6538@ */ ECIPP_ALIGNMENT_ULONG 4294967295 Compu_IDENTITY 0 4294967295 PHYS_UNIT "SPN" /end CHARACTERISTIC
/begin CHARACTERISTIC FCspn_APUD7_max "FCtl_SPN(335)" VALUE 0x00162218 /* @ECU_Address@FCtl_SPN@0x021B653C@ */ ECIPP_ALIGNMENT_ULONG 4294967295 Compu_IDENTITY 0 4294967295 PHYS_UNIT "SPN" /end CHARACTERISTIC
/begin CHARACTERISTIC FCspn_APUD7_min "FCtl_SPN(336)" VALUE 0x0016221C /* @ECU_Address@FCtl_SPN@0x021B6540@ */ ECIPP_ALIGNMENT_ULONG 4294967295 Compu_IDENTITY 0 4294967295 PHYS_UNIT "SPN" /end CHARACTERISTIC
/begin CHARACTERISTIC FCspn_APUD8_max "FCtl_SPN(352)" VALUE 0x0016225C /* @ECU_Address@FCtl_SPN@0x021B6580@ */ ECIPP_ALIGNMENT_ULONG 4294967295 Compu_IDENTITY 0 4294967295 PHYS_UNIT "SPN" /end CHARACTERISTIC
/begin CHARACTERISTIC FCspn_APUD8_min "FCtl_SPN(353)" VALUE 0x00162260 /* @ECU_Address@FCtl_SPN@0x021B6584@ */ ECIPP_ALIGNMENT_ULONG 4294967295 Compu_IDENTITY 0 4294967295 PHYS_UNIT "SPN" /end CHARACTERISTIC
/begin CHARACTERISTIC FCspn_APUD9_max "FCtl_SPN(359)" VALUE 0x00162278 /* @ECU_Address@FCtl_SPN@0x021B659C@ */ ECIPP_ALIGNMENT_ULONG 4294967295 Compu_IDENTITY 0 4294967295 PHYS_UNIT "SPN" /end CHARACTERISTIC
/begin CHARACTERISTIC FCspn_APUD9_min "FCtl_SPN(360)" VALUE 0x0016227C /* @ECU_Address@FCtl_SPN@0x021B65A0@ */ ECIPP_ALIGNMENT_ULONG 4294967295 Compu_IDENTITY 0 4294967295 PHYS_UNIT "SPN" /end CHARACTERISTIC
/begin CHARACTERISTIC FCspn_AWP_intF "FCtl_SPN(832)" VALUE 0x001629DC /* @ECU_Address@FCtl_SPN@0x021B6D00@ */ ECIPP_ALIGNMENT_ULONG 4294967295 Compu_IDENTITY 0 4294967295 PHYS_UNIT "SPN" /end CHARACTERISTIC
/begin CHARACTERISTIC FCspn_BP_max "FCtl_SPN(7)" VALUE 0x00161CF8 /* @ECU_Address@FCtl_SPN@0x021B601C@ */ ECIPP_ALIGNMENT_ULONG 4294967295 Compu_IDENTITY 0 4294967295 PHYS_UNIT "SPN" /end CHARACTERISTIC
/begin CHARACTERISTIC FCspn_BP_min "FCtl_SPN(8)" VALUE 0x00161CFC /* @ECU_Address@FCtl_SPN@0x021B6020@ */ ECIPP_ALIGNMENT_ULONG 4294967295 Compu_IDENTITY 0 4294967295 PHYS_UNIT "SPN" /end CHARACTERISTIC
/begin CHARACTERISTIC FCspn_BPS1_max "FCtl_SPN(474)" VALUE 0x00162444 /* @ECU_Address@FCtl_SPN@0x021B6768@ */ ECIPP_ALIGNMENT_ULONG 4294967295 Compu_IDENTITY 0 4294967295 PHYS_UNIT "SPN" /end CHARACTERISTIC
/begin CHARACTERISTIC FCspn_BPS1_min "FCtl_SPN(475)" VALUE 0x00162448 /* @ECU_Address@FCtl_SPN@0x021B676C@ */ ECIPP_ALIGNMENT_ULONG 4294967295 Compu_IDENTITY 0 4294967295 PHYS_UNIT "SPN" /end CHARACTERISTIC
/begin CHARACTERISTIC FCspn_BPS12_OOR "FCtl_SPN(482)" VALUE 0x00162464 /* @ECU_Address@FCtl_SPN@0x021B6788@ */ ECIPP_ALIGNMENT_ULONG 4294967295 Compu_IDENTITY 0 4294967295 PHYS_UNIT "SPN" /end CHARACTERISTIC
/begin CHARACTERISTIC FCspn_BPS12pct_hi "FCtl_SPN(478)" VALUE 0x00162454 /* @ECU_Address@FCtl_SPN@0x021B6778@ */ ECIPP_ALIGNMENT_ULONG 4294967295 Compu_IDENTITY 0 4294967295 PHYS_UNIT "SPN" /end CHARACTERISTIC
/begin CHARACTERISTIC FCspn_BPS12pct_lo "FCtl_SPN(479)" VALUE 0x00162458 /* @ECU_Address@FCtl_SPN@0x021B677C@ */ ECIPP_ALIGNMENT_ULONG 4294967295 Compu_IDENTITY 0 4294967295 PHYS_UNIT "SPN" /end CHARACTERISTIC
/begin CHARACTERISTIC FCspn_BPS2_max "FCtl_SPN(476)" VALUE 0x0016244C /* @ECU_Address@FCtl_SPN@0x021B6770@ */ ECIPP_ALIGNMENT_ULONG 4294967295 Compu_IDENTITY 0 4294967295 PHYS_UNIT "SPN" /end CHARACTERISTIC
/begin CHARACTERISTIC FCspn_BPS2_min "FCtl_SPN(477)" VALUE 0x00162450 /* @ECU_Address@FCtl_SPN@0x021B6774@ */ ECIPP_ALIGNMENT_ULONG 4294967295 Compu_IDENTITY 0 4294967295 PHYS_UNIT "SPN" /end CHARACTERISTIC
/begin CHARACTERISTIC FCspn_BPSerr_neg "FCtl_SPN(481)" VALUE 0x00162460 /* @ECU_Address@FCtl_SPN@0x021B6784@ */ ECIPP_ALIGNMENT_ULONG 4294967295 Compu_IDENTITY 0 4294967295 PHYS_UNIT "SPN" /end CHARACTERISTIC
/begin CHARACTERISTIC FCspn_BPSerr_pos "FCtl_SPN(480)" VALUE 0x0016245C /* @ECU_Address@FCtl_SPN@0x021B6780@ */ ECIPP_ALIGNMENT_ULONG 4294967295 Compu_IDENTITY 0 4294967295 PHYS_UNIT "SPN" /end CHARACTERISTIC
/begin CHARACTERISTIC FCspn_brake_gndshort "FCtl_SPN(329)" VALUE 0x00162200 /* @ECU_Address@FCtl_SPN@0x021B6524@ */ ECIPP_ALIGNMENT_ULONG 4294967295 Compu_IDENTITY 0 4294967295 PHYS_UNIT "SPN" /end CHARACTERISTIC
/begin CHARACTERISTIC FCspn_brake_pwrshort "FCtl_SPN(330)" VALUE 0x00162204 /* @ECU_Address@FCtl_SPN@0x021B6528@ */ ECIPP_ALIGNMENT_ULONG 4294967295 Compu_IDENTITY 0 4294967295 PHYS_UNIT "SPN" /end CHARACTERISTIC
/begin CHARACTERISTIC FCspn_bst_MAT_derate_actv "FCtl_SPN(811)" VALUE 0x00162988 /* @ECU_Address@FCtl_SPN@0x021B6CAC@ */ ECIPP_ALIGNMENT_ULONG 4294967295 Compu_IDENTITY 0 4294967295 PHYS_UNIT "SPN" /end CHARACTERISTIC
/begin CHARACTERISTIC FCspn_BstTIP_Hi "FCtl_SPN(143)" VALUE 0x00161F18 /* @ECU_Address@FCtl_SPN@0x021B623C@ */ ECIPP_ALIGNMENT_ULONG 4294967295 Compu_IDENTITY 0 4294967295 PHYS_UNIT "SPN" /end CHARACTERISTIC
/begin CHARACTERISTIC FCspn_BstTIP_Lo "FCtl_SPN(144)" VALUE 0x00161F1C /* @ECU_Address@FCtl_SPN@0x021B6240@ */ ECIPP_ALIGNMENT_ULONG 4294967295 Compu_IDENTITY 0 4294967295 PHYS_UNIT "SPN" /end CHARACTERISTIC
/begin CHARACTERISTIC FCspn_BstTIP_Lo2 "FCtl_SPN(686)" VALUE 0x00162794 /* @ECU_Address@FCtl_SPN@0x021B6AB8@ */ ECIPP_ALIGNMENT_ULONG 4294967295 Compu_IDENTITY 0 4294967295 PHYS_UNIT "SPN" /end CHARACTERISTIC
/begin CHARACTERISTIC FCspn_BstTIP_slow "FCtl_SPN(655)" VALUE 0x00162718 /* @ECU_Address@FCtl_SPN@0x021B6A3C@ */ ECIPP_ALIGNMENT_ULONG 4294967295 Compu_IDENTITY 0 4294967295 PHYS_UNIT "SPN" /end CHARACTERISTIC
/begin CHARACTERISTIC FCspn_buzz_coilopen "FCtl_SPN(165)" VALUE 0x00161F70 /* @ECU_Address@FCtl_SPN@0x021B6294@ */ ECIPP_ALIGNMENT_ULONG 4294967295 Compu_IDENTITY 0 4294967295 PHYS_UNIT "SPN" /end CHARACTERISTIC
/begin CHARACTERISTIC FCspn_buzz_coilshort "FCtl_SPN(166)" VALUE 0x00161F74 /* @ECU_Address@FCtl_SPN@0x021B6298@ */ ECIPP_ALIGNMENT_ULONG 4294967295 Compu_IDENTITY 0 4294967295 PHYS_UNIT "SPN" /end CHARACTERISTIC
/begin CHARACTERISTIC FCspn_buzz_gndshort "FCtl_SPN(164)" VALUE 0x00161F6C /* @ECU_Address@FCtl_SPN@0x021B6290@ */ ECIPP_ALIGNMENT_ULONG 4294967295 Compu_IDENTITY 0 4294967295 PHYS_UNIT "SPN" /end CHARACTERISTIC
/begin CHARACTERISTIC FCspn_CAC_eta_lo "FCtl_SPN(656)" VALUE 0x0016271C /* @ECU_Address@FCtl_SPN@0x021B6A40@ */ ECIPP_ALIGNMENT_ULONG 4294967295 Compu_IDENTITY 0 4294967295 PHYS_UNIT "SPN" /end CHARACTERISTIC
/begin CHARACTERISTIC FCspn_cal_config "FCtl_SPN(319)" VALUE 0x001621D8 /* @ECU_Address@FCtl_SPN@0x021B64FC@ */ ECIPP_ALIGNMENT_ULONG 4294967295 Compu_IDENTITY 0 4294967295 PHYS_UNIT "SPN" /end CHARACTERISTIC
/begin CHARACTERISTIC FCspn_cam2loss "FCtl_SPN(690)" VALUE 0x001627A4 /* @ECU_Address@FCtl_SPN@0x021B6AC8@ */ ECIPP_ALIGNMENT_ULONG 4294967295 Compu_IDENTITY 0 4294967295 PHYS_UNIT "SPN" /end CHARACTERISTIC
/begin CHARACTERISTIC FCspn_camloss "FCtl_SPN(95)" VALUE 0x00161E58 /* @ECU_Address@FCtl_SPN@0x021B617C@ */ ECIPP_ALIGNMENT_ULONG 4294967295 Compu_IDENTITY 0 4294967295 PHYS_UNIT "SPN" /end CHARACTERISTIC
/begin CHARACTERISTIC FCspn_camnoise "FCtl_SPN(96)" VALUE 0x00161E5C /* @ECU_Address@FCtl_SPN@0x021B6180@ */ ECIPP_ALIGNMENT_ULONG 4294967295 Compu_IDENTITY 0 4294967295 PHYS_UNIT "SPN" /end CHARACTERISTIC
/begin CHARACTERISTIC FCspn_CATdP_hi "FCtl_SPN(526)" VALUE 0x00162514 /* @ECU_Address@FCtl_SPN@0x021B6838@ */ ECIPP_ALIGNMENT_ULONG 4294967295 Compu_IDENTITY 0 4294967295 PHYS_UNIT "SPN" /end CHARACTERISTIC
/begin CHARACTERISTIC FCspn_CATdP_lo "FCtl_SPN(525)" VALUE 0x00162510 /* @ECU_Address@FCtl_SPN@0x021B6834@ */ ECIPP_ALIGNMENT_ULONG 4294967295 Compu_IDENTITY 0 4294967295 PHYS_UNIT "SPN" /end CHARACTERISTIC
/begin CHARACTERISTIC FPfl_APUD12_min "FPrm_latch(275)" VALUE 0x00160464 /* @ECU_Address@FPrm_latch@0x021BB44C@ */ ECIPP_ALIGNMENT_FLOAT32_IEEE 10000000000 Compu_IDENTITY -10000000000 10000000000 PHYS_UNIT "ms" /end CHARACTERISTIC
/begin CHARACTERISTIC FPfl_APUD13_max "FPrm_latch(276)" VALUE 0x00160468 /* @ECU_Address@FPrm_latch@0x021BB450@ */ ECIPP_ALIGNMENT_FLOAT32_IEEE 10000000000 Compu_IDENTITY -10000000000 10000000000 PHYS_UNIT "ms" /end CHARACTERISTIC
/begin CHARACTERISTIC FPfl_APUD13_min "FPrm_latch(277)" VALUE 0x0016046C /* @ECU_Address@FPrm_latch@0x021BB454@ */ ECIPP_ALIGNMENT_FLOAT32_IEEE 10000000000 Compu_IDENTITY -10000000000 10000000000 PHYS_UNIT "ms" /end CHARACTERISTIC
/begin CHARACTERISTIC FPfl_APUD14_max "FPrm_latch(278)" VALUE 0x00160470 /* @ECU_Address@FPrm_latch@0x021BB458@ */ ECIPP_ALIGNMENT_FLOAT32_IEEE 10000000000 Compu_IDENTITY -10000000000 10000000000 PHYS_UNIT "ms" /end CHARACTERISTIC
/begin CHARACTERISTIC FPfl_APUD14_min "FPrm_latch(279)" VALUE 0x00160474 /* @ECU_Address@FPrm_latch@0x021BB45C@ */ ECIPP_ALIGNMENT_FLOAT32_IEEE 10000000000 Compu_IDENTITY -10000000000 10000000000 PHYS_UNIT "ms" /end CHARACTERISTIC
/begin CHARACTERISTIC FPfl_APUD15_max "FPrm_latch(280)" VALUE 0x00160478 /* @ECU_Address@FPrm_latch@0x021BB460@ */ ECIPP_ALIGNMENT_FLOAT32_IEEE 10000000000 Compu_IDENTITY -10000000000 10000000000 PHYS_UNIT "ms" /end CHARACTERISTIC
/begin CHARACTERISTIC FPfl_APUD15_min "FPrm_latch(281)" VALUE 0x0016047C /* @ECU_Address@FPrm_latch@0x021BB464@ */ ECIPP_ALIGNMENT_FLOAT32_IEEE 10000000000 Compu_IDENTITY -10000000000 10000000000 PHYS_UNIT "ms" /end CHARACTERISTIC
/begin CHARACTERISTIC FPfl_APUD16_max "FPrm_latch(282)" VALUE 0x00160480 /* @ECU_Address@FPrm_latch@0x021BB468@ */ ECIPP_ALIGNMENT_FLOAT32_IEEE 10000000000 Compu_IDENTITY -10000000000 10000000000 PHYS_UNIT "ms" /end CHARACTERISTIC
/begin CHARACTERISTIC FPfl_APUD16_min "FPrm_latch(283)" VALUE 0x00160484 /* @ECU_Address@FPrm_latch@0x021BB46C@ */ ECIPP_ALIGNMENT_FLOAT32_IEEE 10000000000 Compu_IDENTITY -10000000000 10000000000 PHYS_UNIT "ms" /end CHARACTERISTIC
/begin CHARACTERISTIC FPfl_APUD17_max "FPrm_latch(284)" VALUE 0x00160488 /* @ECU_Address@FPrm_latch@0x021BB470@ */ ECIPP_ALIGNMENT_FLOAT32_IEEE 10000000000 Compu_IDENTITY -10000000000 10000000000 PHYS_UNIT "ms" /end CHARACTERISTIC
/begin CHARACTERISTIC FPfl_APUD17_min "FPrm_latch(285)" VALUE 0x0016048C /* @ECU_Address@FPrm_latch@0x021BB474@ */ ECIPP_ALIGNMENT_FLOAT32_IEEE 10000000000 Compu_IDENTITY -10000000000 10000000000 PHYS_UNIT "ms" /end CHARACTERISTIC
/begin CHARACTERISTIC FPfl_APUD18_max "FPrm_latch(286)" VALUE 0x00160490 /* @ECU_Address@FPrm_latch@0x021BB478@ */ ECIPP_ALIGNMENT_FLOAT32_IEEE 10000000000 Compu_IDENTITY -10000000000 10000000000 PHYS_UNIT "ms" /end CHARACTERISTIC
/begin CHARACTERISTIC FPfl_APUD18_min "FPrm_latch(287)" VALUE 0x00160494 /* @ECU_Address@FPrm_latch@0x021BB47C@ */ ECIPP_ALIGNMENT_FLOAT32_IEEE 10000000000 Compu_IDENTITY -10000000000 10000000000 PHYS_UNIT "ms" /end CHARACTERISTIC
/begin CHARACTERISTIC FPfl_APUD19_max "FPrm_latch(288)" VALUE 0x00160498 /* @ECU_Address@FPrm_latch@0x021BB480@ */ ECIPP_ALIGNMENT_FLOAT32_IEEE 10000000000 Compu_IDENTITY -10000000000 10000000000 PHYS_UNIT "ms" /end CHARACTERISTIC
/begin CHARACTERISTIC FPfl_APUD19_min "FPrm_latch(289)" VALUE 0x0016049C /* @ECU_Address@FPrm_latch@0x021BB484@ */ ECIPP_ALIGNMENT_FLOAT32_IEEE 10000000000 Compu_IDENTITY -10000000000 10000000000 PHYS_UNIT "ms" /end CHARACTERISTIC
/begin CHARACTERISTIC FPfl_APUD2_max "FPrm_latch(161)" VALUE 0x0016029C /* @ECU_Address@FPrm_latch@0x021BB284@ */ ECIPP_ALIGNMENT_FLOAT32_IEEE 10000000000 Compu_IDENTITY -10000000000 10000000000 PHYS_UNIT "ms" /end CHARACTERISTIC
/begin CHARACTERISTIC FPfl_APUD2_min "FPrm_latch(162)" VALUE 0x001602A0 /* @ECU_Address@FPrm_latch@0x021BB288@ */ ECIPP_ALIGNMENT_FLOAT32_IEEE 10000000000 Compu_IDENTITY -10000000000 10000000000 PHYS_UNIT "ms" /end CHARACTERISTIC
/begin CHARACTERISTIC FPfl_APUD20_max "FPrm_latch(290)" VALUE 0x001604A0 /* @ECU_Address@FPrm_latch@0x021BB488@ */ ECIPP_ALIGNMENT_FLOAT32_IEEE 10000000000 Compu_IDENTITY -10000000000 10000000000 PHYS_UNIT "ms" /end CHARACTERISTIC
/begin CHARACTERISTIC FPfl_APUD20_min "FPrm_latch(291)" VALUE 0x001604A4 /* @ECU_Address@FPrm_latch@0x021BB48C@ */ ECIPP_ALIGNMENT_FLOAT32_IEEE 10000000000 Compu_IDENTITY -10000000000 10000000000 PHYS_UNIT "ms" /end CHARACTERISTIC
/begin CHARACTERISTIC FPfl_APUD21_max "FPrm_latch(292)" VALUE 0x001604A8 /* @ECU_Address@FPrm_latch@0x021BB490@ */ ECIPP_ALIGNMENT_FLOAT32_IEEE 10000000000 Compu_IDENTITY -10000000000 10000000000 PHYS_UNIT "ms" /end CHARACTERISTIC
/begin CHARACTERISTIC FPfl_APUD21_min "FPrm_latch(293)" VALUE 0x001604AC /* @ECU_Address@FPrm_latch@0x021BB494@ */ ECIPP_ALIGNMENT_FLOAT32_IEEE 10000000000 Compu_IDENTITY -10000000000 10000000000 PHYS_UNIT "ms" /end CHARACTERISTIC
/begin CHARACTERISTIC FPfl_APUD22_max "FPrm_latch(294)" VALUE 0x001604B0 /* @ECU_Address@FPrm_latch@0x021BB498@ */ ECIPP_ALIGNMENT_FLOAT32_IEEE 10000000000 Compu_IDENTITY -10000000000 10000000000 PHYS_UNIT "ms" /end CHARACTERISTIC
/begin CHARACTERISTIC FPfl_APUD22_min "FPrm_latch(295)" VALUE 0x001604B4 /* @ECU_Address@FPrm_latch@0x021BB49C@ */ ECIPP_ALIGNMENT_FLOAT32_IEEE 10000000000 Compu_IDENTITY -10000000000 10000000000 PHYS_UNIT "ms" /end CHARACTERISTIC
/begin CHARACTERISTIC FPfl_APUD23_max "FPrm_latch(296)" VALUE 0x001604B8 /* @ECU_Address@FPrm_latch@0x021BB4A0@ */ ECIPP_ALIGNMENT_FLOAT32_IEEE 10000000000 Compu_IDENTITY -10000000000 10000000000 PHYS_UNIT "ms" /end CHARACTERISTIC
/begin CHARACTERISTIC FPfl_APUD23_min "FPrm_latch(297)" VALUE 0x001604BC /* @ECU_Address@FPrm_latch@0x021BB4A4@ */ ECIPP_ALIGNMENT_FLOAT32_IEEE 10000000000 Compu_IDENTITY -10000000000 10000000000 PHYS_UNIT "ms" /end CHARACTERISTIC
/begin CHARACTERISTIC FPfl_APUD24_max "FPrm_latch(298)" VALUE 0x001604C0 /* @ECU_Address@FPrm_latch@0x021BB4A8@ */ ECIPP_ALIGNMENT_FLOAT32_IEEE 10000000000 Compu_IDENTITY -10000000000 10000000000 PHYS_UNIT "ms" /end CHARACTERISTIC
/begin CHARACTERISTIC FPfl_APUD24_min "FPrm_latch(299)" VALUE 0x001604C4 /* @ECU_Address@FPrm_latch@0x021BB4AC@ */ ECIPP_ALIGNMENT_FLOAT32_IEEE 10000000000 Compu_IDENTITY -10000000000 10000000000 PHYS_UNIT "ms" /end CHARACTERISTIC
/begin CHARACTERISTIC FPfl_APUD25_max "FPrm_latch(300)" VALUE 0x001604C8 /* @ECU_Address@FPrm_latch@0x021BB4B0@ */ ECIPP_ALIGNMENT_FLOAT32_IEEE 10000000000 Compu_IDENTITY -10000000000 10000000000 PHYS_UNIT "ms" /end CHARACTERISTIC
/begin CHARACTERISTIC FPfl_APUD25_min "FPrm_latch(301)" VALUE 0x001604CC /* @ECU_Address@FPrm_latch@0x021BB4B4@ */ ECIPP_ALIGNMENT_FLOAT32_IEEE 10000000000 Compu_IDENTITY -10000000000 10000000000 PHYS_UNIT "ms" /end CHARACTERISTIC
/begin CHARACTERISTIC FPfl_APUD3_max "FPrm_latch(163)" VALUE 0x001602A4 /* @ECU_Address@FPrm_latch@0x021BB28C@ */ ECIPP_ALIGNMENT_FLOAT32_IEEE 10000000000 Compu_IDENTITY -10000000000 10000000000 PHYS_UNIT "ms" /end CHARACTERISTIC
/begin CHARACTERISTIC FPfl_APUD3_min "FPrm_latch(164)" VALUE 0x001602A8 /* @ECU_Address@FPrm_latch@0x021BB290@ */ ECIPP_ALIGNMENT_FLOAT32_IEEE 10000000000 Compu_IDENTITY -10000000000 10000000000 PHYS_UNIT "ms" /end CHARACTERISTIC
/begin CHARACTERISTIC FPfl_APUD4_max "FPrm_latch(202)" VALUE 0x00160340 /* @ECU_Address@FPrm_latch@0x021BB328@ */ ECIPP_ALIGNMENT_FLOAT32_IEEE 10000000000 Compu_IDENTITY -10000000000 10000000000 PHYS_UNIT "ms" /end CHARACTERISTIC
/begin CHARACTERISTIC FPfl_APUD4_min "FPrm_latch(203)" VALUE 0x00160344 /* @ECU_Address@FPrm_latch@0x021BB32C@ */ ECIPP_ALIGNMENT_FLOAT32_IEEE 10000000000 Compu_IDENTITY -10000000000 10000000000 PHYS_UNIT "ms" /end CHARACTERISTIC
/begin CHARACTERISTIC FPfl_APUD5_max "FPrm_latch(240)" VALUE 0x001603D8 /* @ECU_Address@FPrm_latch@0x021BB3C0@ */ ECIPP_ALIGNMENT_FLOAT32_IEEE 10000000000 Compu_IDENTITY -10000000000 10000000000 PHYS_UNIT "ms" /end CHARACTERISTIC
/begin CHARACTERISTIC FPfl_APUD5_min "FPrm_latch(241)" VALUE 0x001603DC /* @ECU_Address@FPrm_latch@0x021BB3C4@ */ ECIPP_ALIGNMENT_FLOAT32_IEEE 10000000000 Compu_IDENTITY -10000000000 10000000000 PHYS_UNIT "ms" /end CHARACTERISTIC
/begin CHARACTERISTIC FPfl_APUD6_max "FPrm_latch(242)" VALUE 0x001603E0 /* @ECU_Address@FPrm_latch@0x021BB3C8@ */ ECIPP_ALIGNMENT_FLOAT32_IEEE 10000000000 Compu_IDENTITY -10000000000 10000000000 PHYS_UNIT "ms" /end CHARACTERISTIC
/begin CHARACTERISTIC FPfl_APUD6_min "FPrm_latch(243)" VALUE 0x001603E4 /* @ECU_Address@FPrm_latch@0x021BB3CC@ */ ECIPP_ALIGNMENT_FLOAT32_IEEE 10000000000 Compu_IDENTITY -10000000000 10000000000 PHYS_UNIT "ms" /end CHARACTERISTIC
/begin CHARACTERISTIC FPfl_APUD7_max "FPrm_latch(244)" VALUE 0x001603E8 /* @ECU_Address@FPrm_latch@0x021BB3D0@ */ ECIPP_ALIGNMENT_FLOAT32_IEEE 10000000000 Compu_IDENTITY -10000000000 10000000000 PHYS_UNIT "ms" /end CHARACTERISTIC
/begin CHARACTERISTIC FPfl_APUD7_min "FPrm_latch(245)" VALUE 0x001603EC /* @ECU_Address@FPrm_latch@0x021BB3D4@ */ ECIPP_ALIGNMENT_FLOAT32_IEEE 10000000000 Compu_IDENTITY -10000000000 10000000000 PHYS_UNIT "ms" /end CHARACTERISTIC
/begin CHARACTERISTIC FPfl_APUD8_max "FPrm_latch(261)" VALUE 0x0016042C /* @ECU_Address@FPrm_latch@0x021BB414@ */ ECIPP_ALIGNMENT_FLOAT32_IEEE 10000000000 Compu_IDENTITY -10000000000 10000000000 PHYS_UNIT "ms" /end CHARACTERISTIC
/begin CHARACTERISTIC FPfl_APUD8_min "FPrm_latch(262)" VALUE 0x00160430 /* @ECU_Address@FPrm_latch@0x021BB418@ */ ECIPP_ALIGNMENT_FLOAT32_IEEE 10000000000 Compu_IDENTITY -10000000000 10000000000 PHYS_UNIT "ms" /end CHARACTERISTIC
/begin CHARACTERISTIC FPfl_APUD9_max "FPrm_latch(268)" VALUE 0x00160448 /* @ECU_Address@FPrm_latch@0x021BB430@ */ ECIPP_ALIGNMENT_FLOAT32_IEEE 10000000000 Compu_IDENTITY -10000000000 10000000000 PHYS_UNIT "ms" /end CHARACTERISTIC
/begin CHARACTERISTIC FPfl_APUD9_min "FPrm_latch(269)" VALUE 0x0016044C /* @ECU_Address@FPrm_latch@0x021BB434@ */ ECIPP_ALIGNMENT_FLOAT32_IEEE 10000000000 Compu_IDENTITY -10000000000 10000000000 PHYS_UNIT "ms" /end CHARACTERISTIC
/begin CHARACTERISTIC FPfl_AWP_intF "FPrm_latch(659)" VALUE 0x00160A64 /* @ECU_Address@FPrm_latch@0x021BBA4C@ */ ECIPP_ALIGNMENT_FLOAT32_IEEE 10000000000 Compu_IDENTITY -10000000000 10000000000 PHYS_UNIT "ms" /end CHARACTERISTIC
/begin CHARACTERISTIC FPfl_BP_max "FPrm_latch(10)" VALUE 0x00160040 /* @ECU_Address@FPrm_latch@0x021BB028@ */ ECIPP_ALIGNMENT_FLOAT32_IEEE 10000000000 Compu_IDENTITY -10000000000 10000000000 PHYS_UNIT "ms" /end CHARACTERISTIC
/begin CHARACTERISTIC FPfl_BP_min "FPrm_latch(11)" VALUE 0x00160044 /* @ECU_Address@FPrm_latch@0x021BB02C@ */ ECIPP_ALIGNMENT_FLOAT32_IEEE 10000000000 Compu_IDENTITY -10000000000 10000000000 PHYS_UNIT "ms" /end CHARACTERISTIC
/begin CHARACTERISTIC FPfl_BPS1_max "FPrm_latch(371)" VALUE 0x001605E4 /* @ECU_Address@FPrm_latch@0x021BB5CC@ */ ECIPP_ALIGNMENT_FLOAT32_IEEE 10000000000 Compu_IDENTITY -10000000000 10000000000 PHYS_UNIT "ms" /end CHARACTERISTIC
/begin CHARACTERISTIC FPfl_BPS1_min "FPrm_latch(372)" VALUE 0x001605E8 /* @ECU_Address@FPrm_latch@0x021BB5D0@ */ ECIPP_ALIGNMENT_FLOAT32_IEEE 10000000000 Compu_IDENTITY -10000000000 10000000000 PHYS_UNIT "ms" /end CHARACTERISTIC
/begin CHARACTERISTIC FPfl_BPS12_OOR "FPrm_latch(379)" VALUE 0x00160604 /* @ECU_Address@FPrm_latch@0x021BB5EC@ */ ECIPP_ALIGNMENT_FLOAT32_IEEE 10000000000 Compu_IDENTITY -10000000000 10000000000 PHYS_UNIT "ms" /end CHARACTERISTIC
/begin CHARACTERISTIC FPfl_BPS12pct_hi "FPrm_latch(375)" VALUE 0x001605F4 /* @ECU_Address@FPrm_latch@0x021BB5DC@ */ ECIPP_ALIGNMENT_FLOAT32_IEEE 10000000000 Compu_IDENTITY -10000000000 10000000000 PHYS_UNIT "ms" /end CHARACTERISTIC
/begin CHARACTERISTIC FPfl_BPS12pct_lo "FPrm_latch(376)" VALUE 0x001605F8 /* @ECU_Address@FPrm_latch@0x021BB5E0@ */ ECIPP_ALIGNMENT_FLOAT32_IEEE 10000000000 Compu_IDENTITY -10000000000 10000000000 PHYS_UNIT "ms" /end CHARACTERISTIC
/begin CHARACTERISTIC FPfl_BPS2_max "FPrm_latch(373)" VALUE 0x001605EC /* @ECU_Address@FPrm_latch@0x021BB5D4@ */ ECIPP_ALIGNMENT_FLOAT32_IEEE 10000000000 Compu_IDENTITY -10000000000 10000000000 PHYS_UNIT "ms" /end CHARACTERISTIC
/begin CHARACTERISTIC FPfl_BPS2_min "FPrm_latch(374)" VALUE 0x001605F0 /* @ECU_Address@FPrm_latch@0x021BB5D8@ */ ECIPP_ALIGNMENT_FLOAT32_IEEE 10000000000 Compu_IDENTITY -10000000000 10000000000 PHYS_UNIT "ms" /end CHARACTERISTIC
/begin CHARACTERISTIC FPfl_BPSerr_neg "FPrm_latch(378)" VALUE 0x00160600 /* @ECU_Address@FPrm_latch@0x021BB5E8@ */ ECIPP_ALIGNMENT_FLOAT32_IEEE 10000000000 Compu_IDENTITY -10000000000 10000000000 PHYS_UNIT "ms" /end CHARACTERISTIC
/begin CHARACTERISTIC FPfl_BPSerr_pos "FPrm_latch(377)" VALUE 0x001605FC /* @ECU_Address@FPrm_latch@0x021BB5E4@ */ ECIPP_ALIGNMENT_FLOAT32_IEEE 10000000000 Compu_IDENTITY -10000000000 10000000000 PHYS_UNIT "ms" /end CHARACTERISTIC
/begin CHARACTERISTIC FPfl_brake_gndshort "FPrm_latch(238)" VALUE 0x001603D0 /* @ECU_Address@FPrm_latch@0x021BB3B8@ */ ECIPP_ALIGNMENT_FLOAT32_IEEE 10000000000 Compu_IDENTITY -10000000000 10000000000 PHYS_UNIT "samples" /end CHARACTERISTIC
/begin CHARACTERISTIC FPfl_brake_pwrshort "FPrm_latch(239)" VALUE 0x001603D4 /* @ECU_Address@FPrm_latch@0x021BB3BC@ */ ECIPP_ALIGNMENT_FLOAT32_IEEE 10000000000 Compu_IDENTITY -10000000000 10000000000 PHYS_UNIT "samples" /end CHARACTERISTIC
/begin CHARACTERISTIC FPfl_bst_MAT_derate_actv "FPrm_latch(638)" VALUE 0x00160A10 /* @ECU_Address@FPrm_latch@0x021BB9F8@ */ ECIPP_ALIGNMENT_FLOAT32_IEEE 10000000000 Compu_IDENTITY -10000000000 10000000000 PHYS_UNIT "ms" /end CHARACTERISTIC
/begin CHARACTERISTIC FPfl_BstTIP_Hi "FPrm_latch(103)" VALUE 0x001601B4 /* @ECU_Address@FPrm_latch@0x021BB19C@ */ ECIPP_ALIGNMENT_FLOAT32_IEEE 10000000000 Compu_IDENTITY -10000000000 10000000000 PHYS_UNIT "ms" /end CHARACTERISTIC
/begin CHARACTERISTIC FPfl_BstTIP_Lo "FPrm_latch(104)" VALUE 0x001601B8 /* @ECU_Address@FPrm_latch@0x021BB1A0@ */ ECIPP_ALIGNMENT_FLOAT32_IEEE 10000000000 Compu_IDENTITY -10000000000 10000000000 PHYS_UNIT "ms" /end CHARACTERISTIC
/begin CHARACTERISTIC FPfl_BstTIP_Lo2 "FPrm_latch(516)" VALUE 0x00160828 /* @ECU_Address@FPrm_latch@0x021BB810@ */ ECIPP_ALIGNMENT_FLOAT32_IEEE 10000000000 Compu_IDENTITY -10000000000 10000000000 PHYS_UNIT "ms" /end CHARACTERISTIC
/begin CHARACTERISTIC FPfl_BstTIP_slow "FPrm_latch(485)" VALUE 0x001607AC /* @ECU_Address@FPrm_latch@0x021BB794@ */ ECIPP_ALIGNMENT_FLOAT32_IEEE 10000000000 Compu_IDENTITY -10000000000 10000000000 PHYS_UNIT "ms" /end CHARACTERISTIC
/begin CHARACTERISTIC FPfl_buzz_coilopen "FPrm_latch(125)" VALUE 0x0016020C /* @ECU_Address@FPrm_latch@0x021BB1F4@ */ ECIPP_ALIGNMENT_FLOAT32_IEEE 10000000000 Compu_IDENTITY -10000000000 10000000000 PHYS_UNIT "samples" /end CHARACTERISTIC
/begin CHARACTERISTIC FPfl_buzz_coilshort "FPrm_latch(126)" VALUE 0x00160210 /* @ECU_Address@FPrm_latch@0x021BB1F8@ */ ECIPP_ALIGNMENT_FLOAT32_IEEE 10000000000 Compu_IDENTITY -10000000000 10000000000 PHYS_UNIT "samples" /end CHARACTERISTIC
/begin CHARACTERISTIC FPfl_buzz_gndshort "FPrm_latch(124)" VALUE 0x00160208 /* @ECU_Address@FPrm_latch@0x021BB1F0@ */ ECIPP_ALIGNMENT_FLOAT32_IEEE 10000000000 Compu_IDENTITY -10000000000 10000000000 PHYS_UNIT "samples" /end CHARACTERISTIC
/begin CHARACTERISTIC FPfl_CAC_eta_lo "FPrm_latch(486)" VALUE 0x001607B0 /* @ECU_Address@FPrm_latch@0x021BB798@ */ ECIPP_ALIGNMENT_FLOAT32_IEEE 10000000000 Compu_IDENTITY -10000000000 10000000000 PHYS_UNIT "ms" /end CHARACTERISTIC
/begin CHARACTERISTIC FPfl_cal_config "FPrm_latch(228)" VALUE 0x001603A8 /* @ECU_Address@FPrm_latch@0x021BB390@ */ ECIPP_ALIGNMENT_FLOAT32_IEEE 10000000000 Compu_IDENTITY -10000000000 10000000000 PHYS_UNIT "ms" /end CHARACTERISTIC
/begin CHARACTERISTIC FPfl_cam2loss "FPrm_latch(520)" VALUE 0x00160838 /* @ECU_Address@FPrm_latch@0x021BB820@ */ ECIPP_ALIGNMENT_FLOAT32_IEEE 10000000000 Compu_IDENTITY -10000000000 10000000000 PHYS_UNIT "ms" /end CHARACTERISTIC
/begin CHARACTERISTIC FPfl_camloss "FPrm_latch(59)" VALUE 0x00160104 /* @ECU_Address@FPrm_latch@0x021BB0EC@ */ ECIPP_ALIGNMENT_FLOAT32_IEEE 10000000000 Compu_IDENTITY -10000000000 10000000000 PHYS_UNIT "ms" /end CHARACTERISTIC
/begin CHARACTERISTIC FPfl_camnoise "FPrm_latch(60)" VALUE 0x00160108 /* @ECU_Address@FPrm_latch@0x021BB0F0@ */ ECIPP_ALIGNMENT_FLOAT32_IEEE 10000000000 Compu_IDENTITY -10000000000 10000000000 PHYS_UNIT "ms" /end CHARACTERISTIC
/begin CHARACTERISTIC FPfl_CATdP_hi "FPrm_latch(396)" VALUE 0x00160648 /* @ECU_Address@FPrm_latch@0x021BB630@ */ ECIPP_ALIGNMENT_FLOAT32_IEEE 10000000000 Compu_IDENTITY -10000000000 10000000000 PHYS_UNIT "ms" /end CHARACTERISTIC
/begin CHARACTERISTIC FPfl_CATdP_lo "FPrm_latch(395)" VALUE 0x00160644 /* @ECU_Address@FPrm_latch@0x021BB62C@ */ ECIPP_ALIGNMENT_FLOAT32_IEEE 10000000000 Compu_IDENTITY -10000000000 10000000000 PHYS_UNIT "ms" /end CHARACTERISTIC
/begin CHARACTERISTIC FPfu_APUD12_min "FPrm_unlatch(275)" VALUE 0x00160F28 /* @ECU_Address@FPrm_unlatch@0x021BD44C@ */ ECIPP_ALIGNMENT_FLOAT32_IEEE 10000000000 Compu_IDENTITY -10000000000 10000000000 PHYS_UNIT "ms" /end CHARACTERISTIC
/begin CHARACTERISTIC FPfu_APUD13_max "FPrm_unlatch(276)" VALUE 0x00160F2C /* @ECU_Address@FPrm_unlatch@0x021BD450@ */ ECIPP_ALIGNMENT_FLOAT32_IEEE 10000000000 Compu_IDENTITY -10000000000 10000000000 PHYS_UNIT "ms" /end CHARACTERISTIC
/begin CHARACTERISTIC FPfu_APUD13_min "FPrm_unlatch(277)" VALUE 0x00160F30 /* @ECU_Address@FPrm_unlatch@0x021BD454@ */ ECIPP_ALIGNMENT_FLOAT32_IEEE 10000000000 Compu_IDENTITY -10000000000 10000000000 PHYS_UNIT "ms" /end CHARACTERISTIC
/begin CHARACTERISTIC FPfu_APUD14_max "FPrm_unlatch(278)" VALUE 0x00160F34 /* @ECU_Address@FPrm_unlatch@0x021BD458@ */ ECIPP_ALIGNMENT_FLOAT32_IEEE 10000000000 Compu_IDENTITY -10000000000 10000000000 PHYS_UNIT "ms" /end CHARACTERISTIC
/begin CHARACTERISTIC FPfu_APUD14_min "FPrm_unlatch(279)" VALUE 0x00160F38 /* @ECU_Address@FPrm_unlatch@0x021BD45C@ */ ECIPP_ALIGNMENT_FLOAT32_IEEE 10000000000 Compu_IDENTITY -10000000000 10000000000 PHYS_UNIT "ms" /end CHARACTERISTIC
/begin CHARACTERISTIC FPfu_APUD15_max "FPrm_unlatch(280)" VALUE 0x00160F3C /* @ECU_Address@FPrm_unlatch@0x021BD460@ */ ECIPP_ALIGNMENT_FLOAT32_IEEE 10000000000 Compu_IDENTITY -10000000000 10000000000 PHYS_UNIT "ms" /end CHARACTERISTIC
/begin CHARACTERISTIC FPfu_APUD15_min "FPrm_unlatch(281)" VALUE 0x00160F40 /* @ECU_Address@FPrm_unlatch@0x021BD464@ */ ECIPP_ALIGNMENT_FLOAT32_IEEE 10000000000 Compu_IDENTITY -10000000000 10000000000 PHYS_UNIT "ms" /end CHARACTERISTIC
/begin CHARACTERISTIC FPfu_APUD16_max "FPrm_unlatch(282)" VALUE 0x00160F44 /* @ECU_Address@FPrm_unlatch@0x021BD468@ */ ECIPP_ALIGNMENT_FLOAT32_IEEE 10000000000 Compu_IDENTITY -10000000000 10000000000 PHYS_UNIT "ms" /end CHARACTERISTIC
/begin CHARACTERISTIC FPfu_APUD16_min "FPrm_unlatch(283)" VALUE 0x00160F48 /* @ECU_Address@FPrm_unlatch@0x021BD46C@ */ ECIPP_ALIGNMENT_FLOAT32_IEEE 10000000000 Compu_IDENTITY -10000000000 10000000000 PHYS_UNIT "ms" /end CHARACTERISTIC
/begin CHARACTERISTIC FPfu_APUD17_max "FPrm_unlatch(284)" VALUE 0x00160F4C /* @ECU_Address@FPrm_unlatch@0x021BD470@ */ ECIPP_ALIGNMENT_FLOAT32_IEEE 10000000000 Compu_IDENTITY -10000000000 10000000000 PHYS_UNIT "ms" /end CHARACTERISTIC
/begin CHARACTERISTIC FPfu_APUD17_min "FPrm_unlatch(285)" VALUE 0x00160F50 /* @ECU_Address@FPrm_unlatch@0x021BD474@ */ ECIPP_ALIGNMENT_FLOAT32_IEEE 10000000000 Compu_IDENTITY -10000000000 10000000000 PHYS_UNIT "ms" /end CHARACTERISTIC
/begin CHARACTERISTIC FPfu_APUD18_max "FPrm_unlatch(286)" VALUE 0x00160F54 /* @ECU_Address@FPrm_unlatch@0x021BD478@ */ ECIPP_ALIGNMENT_FLOAT32_IEEE 10000000000 Compu_IDENTITY -10000000000 10000000000 PHYS_UNIT "ms" /end CHARACTERISTIC
/begin CHARACTERISTIC FPfu_APUD18_min "FPrm_unlatch(287)" VALUE 0x00160F58 /* @ECU_Address@FPrm_unlatch@0x021BD47C@ */ ECIPP_ALIGNMENT_FLOAT32_IEEE 10000000000 Compu_IDENTITY -10000000000 10000000000 PHYS_UNIT "ms" /end CHARACTERISTIC
/begin CHARACTERISTIC FPfu_APUD19_max "FPrm_unlatch(288)" VALUE 0x00160F5C /* @ECU_Address@FPrm_unlatch@0x021BD480@ */ ECIPP_ALIGNMENT_FLOAT32_IEEE 10000000000 Compu_IDENTITY -10000000000 10000000000 PHYS_UNIT "ms" /end CHARACTERISTIC
/begin CHARACTERISTIC FPfu_APUD19_min "FPrm_unlatch(289)" VALUE 0x00160F60 /* @ECU_Address@FPrm_unlatch@0x021BD484@ */ ECIPP_ALIGNMENT_FLOAT32_IEEE 10000000000 Compu_IDENTITY -10000000000 10000000000 PHYS_UNIT "ms" /end CHARACTERISTIC
/begin CHARACTERISTIC FPfu_APUD2_max "FPrm_unlatch(161)" VALUE 0x00160D60 /* @ECU_Address@FPrm_unlatch@0x021BD284@ */ ECIPP_ALIGNMENT_FLOAT32_IEEE 10000000000 Compu_IDENTITY -10000000000 10000000000 PHYS_UNIT "ms" /end CHARACTERISTIC
/begin CHARACTERISTIC FPfu_APUD2_min "FPrm_unlatch(162)" VALUE 0x00160D64 /* @ECU_Address@FPrm_unlatch@0x021BD288@ */ ECIPP_ALIGNMENT_FLOAT32_IEEE 10000000000 Compu_IDENTITY -10000000000 10000000000 PHYS_UNIT "ms" /end CHARACTERISTIC
/begin CHARACTERISTIC FPfu_APUD20_max "FPrm_unlatch(290)" VALUE 0x00160F64 /* @ECU_Address@FPrm_unlatch@0x021BD488@ */ ECIPP_ALIGNMENT_FLOAT32_IEEE 10000000000 Compu_IDENTITY -10000000000 10000000000 PHYS_UNIT "ms" /end CHARACTERISTIC
/begin CHARACTERISTIC FPfu_APUD20_min "FPrm_unlatch(291)" VALUE 0x00160F68 /* @ECU_Address@FPrm_unlatch@0x021BD48C@ */ ECIPP_ALIGNMENT_FLOAT32_IEEE 10000000000 Compu_IDENTITY -10000000000 10000000000 PHYS_UNIT "ms" /end CHARACTERISTIC
/begin CHARACTERISTIC FPfu_APUD21_max "FPrm_unlatch(292)" VALUE 0x00160F6C /* @ECU_Address@FPrm_unlatch@0x021BD490@ */ ECIPP_ALIGNMENT_FLOAT32_IEEE 10000000000 Compu_IDENTITY -10000000000 10000000000 PHYS_UNIT "ms" /end CHARACTERISTIC
/begin CHARACTERISTIC FPfu_APUD21_min "FPrm_unlatch(293)" VALUE 0x00160F70 /* @ECU_Address@FPrm_unlatch@0x021BD494@ */ ECIPP_ALIGNMENT_FLOAT32_IEEE 10000000000 Compu_IDENTITY -10000000000 10000000000 PHYS_UNIT "ms" /end CHARACTERISTIC
/begin CHARACTERISTIC FPfu_APUD22_max "FPrm_unlatch(294)" VALUE 0x00160F74 /* @ECU_Address@FPrm_unlatch@0x021BD498@ */ ECIPP_ALIGNMENT_FLOAT32_IEEE 10000000000 Compu_IDENTITY -10000000000 10000000000 PHYS_UNIT "ms" /end CHARACTERISTIC
/begin CHARACTERISTIC FPfu_APUD22_min "FPrm_unlatch(295)" VALUE 0x00160F78 /* @ECU_Address@FPrm_unlatch@0x021BD49C@ */ ECIPP_ALIGNMENT_FLOAT32_IEEE 10000000000 Compu_IDENTITY -10000000000 10000000000 PHYS_UNIT "ms" /end CHARACTERISTIC
/begin CHARACTERISTIC FPfu_APUD23_max "FPrm_unlatch(296)" VALUE 0x00160F7C /* @ECU_Address@FPrm_unlatch@0x021BD4A0@ */ ECIPP_ALIGNMENT_FLOAT32_IEEE 10000000000 Compu_IDENTITY -10000000000 10000000000 PHYS_UNIT "ms" /end CHARACTERISTIC
/begin CHARACTERISTIC FPfu_APUD23_min "FPrm_unlatch(297)" VALUE 0x00160F80 /* @ECU_Address@FPrm_unlatch@0x021BD4A4@ */ ECIPP_ALIGNMENT_FLOAT32_IEEE 10000000000 Compu_IDENTITY -10000000000 10000000000 PHYS_UNIT "ms" /end CHARACTERISTIC
/begin CHARACTERISTIC FPfu_APUD24_max "FPrm_unlatch(298)" VALUE 0x00160F84 /* @ECU_Address@FPrm_unlatch@0x021BD4A8@ */ ECIPP_ALIGNMENT_FLOAT32_IEEE 10000000000 Compu_IDENTITY -10000000000 10000000000 PHYS_UNIT "ms" /end CHARACTERISTIC
/begin CHARACTERISTIC FPfu_APUD24_min "FPrm_unlatch(299)" VALUE 0x00160F88 /* @ECU_Address@FPrm_unlatch@0x021BD4AC@ */ ECIPP_ALIGNMENT_FLOAT32_IEEE 10000000000 Compu_IDENTITY -10000000000 10000000000 PHYS_UNIT "ms" /end CHARACTERISTIC
/begin CHARACTERISTIC FPfu_APUD25_max "FPrm_unlatch(300)" VALUE 0x00160F8C /* @ECU_Address@FPrm_unlatch@0x021BD4B0@ */ ECIPP_ALIGNMENT_FLOAT32_IEEE 10000000000 Compu_IDENTITY -10000000000 10000000000 PHYS_UNIT "ms" /end CHARACTERISTIC
/begin CHARACTERISTIC FPfu_APUD25_min "FPrm_unlatch(301)" VALUE 0x00160F90 /* @ECU_Address@FPrm_unlatch@0x021BD4B4@ */ ECIPP_ALIGNMENT_FLOAT32_IEEE 10000000000 Compu_IDENTITY -10000000000 10000000000 PHYS_UNIT "ms" /end CHARACTERISTIC
/begin CHARACTERISTIC FPfu_APUD3_max "FPrm_unlatch(163)" VALUE 0x00160D68 /* @ECU_Address@FPrm_unlatch@0x021BD28C@ */ ECIPP_ALIGNMENT_FLOAT32_IEEE 10000000000 Compu_IDENTITY -10000000000 10000000000 PHYS_UNIT "ms" /end CHARACTERISTIC
/begin CHARACTERISTIC FPfu_APUD3_min "FPrm_unlatch(164)" VALUE 0x00160D6C /* @ECU_Address@FPrm_unlatch@0x021BD290@ */ ECIPP_ALIGNMENT_FLOAT32_IEEE 10000000000 Compu_IDENTITY -10000000000 10000000000 PHYS_UNIT "ms" /end CHARACTERISTIC
/begin CHARACTERISTIC FPfu_APUD4_max "FPrm_unlatch(202)" VALUE 0x00160E04 /* @ECU_Address@FPrm_unlatch@0x021BD328@ */ ECIPP_ALIGNMENT_FLOAT32_IEEE 10000000000 Compu_IDENTITY -10000000000 10000000000 PHYS_UNIT "ms" /end CHARACTERISTIC
/begin CHARACTERISTIC FPfu_APUD4_min "FPrm_unlatch(203)" VALUE 0x00160E08 /* @ECU_Address@FPrm_unlatch@0x021BD32C@ */ ECIPP_ALIGNMENT_FLOAT32_IEEE 10000000000 Compu_IDENTITY -10000000000 10000000000 PHYS_UNIT "ms" /end CHARACTERISTIC
/begin CHARACTERISTIC FPfu_APUD5_max "FPrm_unlatch(240)" VALUE 0x00160E9C /* @ECU_Address@FPrm_unlatch@0x021BD3C0@ */ ECIPP_ALIGNMENT_FLOAT32_IEEE 10000000000 Compu_IDENTITY -10000000000 10000000000 PHYS_UNIT "ms" /end CHARACTERISTIC
/begin CHARACTERISTIC FPfu_APUD5_min "FPrm_unlatch(241)" VALUE 0x00160EA0 /* @ECU_Address@FPrm_unlatch@0x021BD3C4@ */ ECIPP_ALIGNMENT_FLOAT32_IEEE 10000000000 Compu_IDENTITY -10000000000 10000000000 PHYS_UNIT "ms" /end CHARACTERISTIC
/begin CHARACTERISTIC FPfu_APUD6_max "FPrm_unlatch(242)" VALUE 0x00160EA4 /* @ECU_Address@FPrm_unlatch@0x021BD3C8@ */ ECIPP_ALIGNMENT_FLOAT32_IEEE 10000000000 Compu_IDENTITY -10000000000 10000000000 PHYS_UNIT "ms" /end CHARACTERISTIC
/begin CHARACTERISTIC FPfu_APUD6_min "FPrm_unlatch(243)" VALUE 0x00160EA8 /* @ECU_Address@FPrm_unlatch@0x021BD3CC@ */ ECIPP_ALIGNMENT_FLOAT32_IEEE 10000000000 Compu_IDENTITY -10000000000 10000000000 PHYS_UNIT "ms" /end CHARACTERISTIC
/begin CHARACTERISTIC FPfu_APUD7_max "FPrm_unlatch(244)" VALUE 0x00160EAC /* @ECU_Address@FPrm_unlatch@0x021BD3D0@ */ ECIPP_ALIGNMENT_FLOAT32_IEEE 10000000000 Compu_IDENTITY -10000000000 10000000000 PHYS_UNIT "ms" /end CHARACTERISTIC
/begin CHARACTERISTIC FPfu_APUD7_min "FPrm_unlatch(245)" VALUE 0x00160EB0 /* @ECU_Address@FPrm_unlatch@0x021BD3D4@ */ ECIPP_ALIGNMENT_FLOAT32_IEEE 10000000000 Compu_IDENTITY -10000000000 10000000000 PHYS_UNIT "ms" /end CHARACTERISTIC
/begin CHARACTERISTIC FPfu_APUD8_max "FPrm_unlatch(261)" VALUE 0x00160EF0 /* @ECU_Address@FPrm_unlatch@0x021BD414@ */ ECIPP_ALIGNMENT_FLOAT32_IEEE 10000000000 Compu_IDENTITY -10000000000 10000000000 PHYS_UNIT "ms" /end CHARACTERISTIC
/begin CHARACTERISTIC FPfu_APUD8_min "FPrm_unlatch(262)" VALUE 0x00160EF4 /* @ECU_Address@FPrm_unlatch@0x021BD418@ */ ECIPP_ALIGNMENT_FLOAT32_IEEE 10000000000 Compu_IDENTITY -10000000000 10000000000 PHYS_UNIT "ms" /end CHARACTERISTIC
/begin CHARACTERISTIC FPfu_APUD9_max "FPrm_unlatch(268)" VALUE 0x00160F0C /* @ECU_Address@FPrm_unlatch@0x021BD430@ */ ECIPP_ALIGNMENT_FLOAT32_IEEE 10000000000 Compu_IDENTITY -10000000000 10000000000 PHYS_UNIT "ms" /end CHARACTERISTIC
/begin CHARACTERISTIC FPfu_APUD9_min "FPrm_unlatch(269)" VALUE 0x00160F10 /* @ECU_Address@FPrm_unlatch@0x021BD434@ */ ECIPP_ALIGNMENT_FLOAT32_IEEE 10000000000 Compu_IDENTITY -10000000000 10000000000 PHYS_UNIT "ms" /end CHARACTERISTIC
/begin CHARACTERISTIC FPfu_AWP_intF "FPrm_unlatch(659)" VALUE 0x00161528 /* @ECU_Address@FPrm_unlatch@0x021BDA4C@ */ ECIPP_ALIGNMENT_FLOAT32_IEEE 10000000000 Compu_IDENTITY -10000000000 10000000000 PHYS_UNIT "ms" /end CHARACTERISTIC
/begin CHARACTERISTIC FPfu_BP_max "FPrm_unlatch(10)" VALUE 0x00160B04 /* @ECU_Address@FPrm_unlatch@0x021BD028@ */ ECIPP_ALIGNMENT_FLOAT32_IEEE 10000000000 Compu_IDENTITY -10000000000 10000000000 PHYS_UNIT "ms" /end CHARACTERISTIC
/begin CHARACTERISTIC FPfu_BP_min "FPrm_unlatch(11)" VALUE 0x00160B08 /* @ECU_Address@FPrm_unlatch@0x021BD02C@ */ ECIPP_ALIGNMENT_FLOAT32_IEEE 10000000000 Compu_IDENTITY -10000000000 10000000000 PHYS_UNIT "ms" /end CHARACTERISTIC
/begin CHARACTERISTIC FPfu_BPS1_max "FPrm_unlatch(371)" VALUE 0x001610A8 /* @ECU_Address@FPrm_unlatch@0x021BD5CC@ */ ECIPP_ALIGNMENT_FLOAT32_IEEE 10000000000 Compu_IDENTITY -10000000000 10000000000 PHYS_UNIT "ms" /end CHARACTERISTIC
/begin CHARACTERISTIC FPfu_BPS1_min "FPrm_unlatch(372)" VALUE 0x001610AC /* @ECU_Address@FPrm_unlatch@0x021BD5D0@ */ ECIPP_ALIGNMENT_FLOAT32_IEEE 10000000000 Compu_IDENTITY -10000000000 10000000000 PHYS_UNIT "ms" /end CHARACTERISTIC
/begin CHARACTERISTIC FPfu_BPS12_OOR "FPrm_unlatch(379)" VALUE 0x001610C8 /* @ECU_Address@FPrm_unlatch@0x021BD5EC@ */ ECIPP_ALIGNMENT_FLOAT32_IEEE 10000000000 Compu_IDENTITY -10000000000 10000000000 PHYS_UNIT "ms" /end CHARACTERISTIC
/begin CHARACTERISTIC FPfu_BPS12pct_hi "FPrm_unlatch(375)" VALUE 0x001610B8 /* @ECU_Address@FPrm_unlatch@0x021BD5DC@ */ ECIPP_ALIGNMENT_FLOAT32_IEEE 10000000000 Compu_IDENTITY -10000000000 10000000000 PHYS_UNIT "ms" /end CHARACTERISTIC
/begin CHARACTERISTIC FPfu_BPS12pct_lo "FPrm_unlatch(376)" VALUE 0x001610BC /* @ECU_Address@FPrm_unlatch@0x021BD5E0@ */ ECIPP_ALIGNMENT_FLOAT32_IEEE 10000000000 Compu_IDENTITY -10000000000 10000000000 PHYS_UNIT "ms" /end CHARACTERISTIC
/begin CHARACTERISTIC FPfu_BPS2_max "FPrm_unlatch(373)" VALUE 0x001610B0 /* @ECU_Address@FPrm_unlatch@0x021BD5D4@ */ ECIPP_ALIGNMENT_FLOAT32_IEEE 10000000000 Compu_IDENTITY -10000000000 10000000000 PHYS_UNIT "ms" /end CHARACTERISTIC
/begin CHARACTERISTIC FPfu_BPS2_min "FPrm_unlatch(374)" VALUE 0x001610B4 /* @ECU_Address@FPrm_unlatch@0x021BD5D8@ */ ECIPP_ALIGNMENT_FLOAT32_IEEE 10000000000 Compu_IDENTITY -10000000000 10000000000 PHYS_UNIT "ms" /end CHARACTERISTIC
/begin CHARACTERISTIC FPfu_BPSerr_neg "FPrm_unlatch(378)" VALUE 0x001610C4 /* @ECU_Address@FPrm_unlatch@0x021BD5E8@ */ ECIPP_ALIGNMENT_FLOAT32_IEEE 10000000000 Compu_IDENTITY -10000000000 10000000000 PHYS_UNIT "ms" /end CHARACTERISTIC
/begin CHARACTERISTIC FPfu_BPSerr_pos "FPrm_unlatch(377)" VALUE 0x001610C0 /* @ECU_Address@FPrm_unlatch@0x021BD5E4@ */ ECIPP_ALIGNMENT_FLOAT32_IEEE 10000000000 Compu_IDENTITY -10000000000 10000000000 PHYS_UNIT "ms" /end CHARACTERISTIC
/begin CHARACTERISTIC FPfu_brake_gndshort "FPrm_unlatch(238)" VALUE 0x00160E94 /* @ECU_Address@FPrm_unlatch@0x021BD3B8@ */ ECIPP_ALIGNMENT_FLOAT32_IEEE 10000000000 Compu_IDENTITY -10000000000 10000000000 PHYS_UNIT "samples" /end CHARACTERISTIC
/begin CHARACTERISTIC FPfu_brake_pwrshort "FPrm_unlatch(239)" VALUE 0x00160E98 /* @ECU_Address@FPrm_unlatch@0x021BD3BC@ */ ECIPP_ALIGNMENT_FLOAT32_IEEE 10000000000 Compu_IDENTITY -10000000000 10000000000 PHYS_UNIT "samples" /end CHARACTERISTIC
/begin CHARACTERISTIC FPfu_bst_MAT_derate_actv "FPrm_unlatch(638)" VALUE 0x001614D4 /* @ECU_Address@FPrm_unlatch@0x021BD9F8@ */ ECIPP_ALIGNMENT_FLOAT32_IEEE 10000000000 Compu_IDENTITY -10000000000 10000000000 PHYS_UNIT "ms" /end CHARACTERISTIC
/begin CHARACTERISTIC FPfu_BstTIP_Hi "FPrm_unlatch(103)" VALUE 0x00160C78 /* @ECU_Address@FPrm_unlatch@0x021BD19C@ */ ECIPP_ALIGNMENT_FLOAT32_IEEE 10000000000 Compu_IDENTITY -10000000000 10000000000 PHYS_UNIT "ms" /end CHARACTERISTIC
/begin CHARACTERISTIC FPfu_BstTIP_Lo "FPrm_unlatch(104)" VALUE 0x00160C7C /* @ECU_Address@FPrm_unlatch@0x021BD1A0@ */ ECIPP_ALIGNMENT_FLOAT32_IEEE 10000000000 Compu_IDENTITY -10000000000 10000000000 PHYS_UNIT "ms" /end CHARACTERISTIC
/begin CHARACTERISTIC FPfu_BstTIP_Lo2 "FPrm_unlatch(516)" VALUE 0x001612EC /* @ECU_Address@FPrm_unlatch@0x021BD810@ */ ECIPP_ALIGNMENT_FLOAT32_IEEE 10000000000 Compu_IDENTITY -10000000000 10000000000 PHYS_UNIT "ms" /end CHARACTERISTIC
/begin CHARACTERISTIC FPfu_BstTIP_slow "FPrm_unlatch(485)" VALUE 0x00161270 /* @ECU_Address@FPrm_unlatch@0x021BD794@ */ ECIPP_ALIGNMENT_FLOAT32_IEEE 10000000000 Compu_IDENTITY -10000000000 10000000000 PHYS_UNIT "ms" /end CHARACTERISTIC
/begin CHARACTERISTIC FPfu_buzz_coilopen "FPrm_unlatch(125)" VALUE 0x00160CD0 /* @ECU_Address@FPrm_unlatch@0x021BD1F4@ */ ECIPP_ALIGNMENT_FLOAT32_IEEE 10000000000 Compu_IDENTITY -10000000000 10000000000 PHYS_UNIT "samples" /end CHARACTERISTIC
/begin CHARACTERISTIC FPfu_buzz_coilshort "FPrm_unlatch(126)" VALUE 0x00160CD4 /* @ECU_Address@FPrm_unlatch@0x021BD1F8@ */ ECIPP_ALIGNMENT_FLOAT32_IEEE 10000000000 Compu_IDENTITY -10000000000 10000000000 PHYS_UNIT "samples" /end CHARACTERISTIC
/begin CHARACTERISTIC FPfu_buzz_gndshort "FPrm_unlatch(124)" VALUE 0x00160CCC /* @ECU_Address@FPrm_unlatch@0x021BD1F0@ */ ECIPP_ALIGNMENT_FLOAT32_IEEE 10000000000 Compu_IDENTITY -10000000000 10000000000 PHYS_UNIT "samples" /end CHARACTERISTIC
/begin CHARACTERISTIC FPfu_CAC_eta_lo "FPrm_unlatch(486)" VALUE 0x00161274 /* @ECU_Address@FPrm_unlatch@0x021BD798@ */ ECIPP_ALIGNMENT_FLOAT32_IEEE 10000000000 Compu_IDENTITY -10000000000 10000000000 PHYS_UNIT "ms" /end CHARACTERISTIC
/begin CHARACTERISTIC FPfu_cal_config "FPrm_unlatch(228)" VALUE 0x00160E6C /* @ECU_Address@FPrm_unlatch@0x021BD390@ */ ECIPP_ALIGNMENT_FLOAT32_IEEE 10000000000 Compu_IDENTITY -10000000000 10000000000 PHYS_UNIT "ms" /end CHARACTERISTIC
/begin CHARACTERISTIC FPfu_cam2loss "FPrm_unlatch(520)" VALUE 0x001612FC /* @ECU_Address@FPrm_unlatch@0x021BD820@ */ ECIPP_ALIGNMENT_FLOAT32_IEEE 10000000000 Compu_IDENTITY -10000000000 10000000000 PHYS_UNIT "ms" /end CHARACTERISTIC
/begin CHARACTERISTIC FPfu_camloss "FPrm_unlatch(59)" VALUE 0x00160BC8 /* @ECU_Address@FPrm_unlatch@0x021BD0EC@ */ ECIPP_ALIGNMENT_FLOAT32_IEEE 10000000000 Compu_IDENTITY -10000000000 10000000000 PHYS_UNIT "ms" /end CHARACTERISTIC
/begin CHARACTERISTIC FPfu_camnoise "FPrm_unlatch(60)" VALUE 0x00160BCC /* @ECU_Address@FPrm_unlatch@0x021BD0F0@ */ ECIPP_ALIGNMENT_FLOAT32_IEEE 10000000000 Compu_IDENTITY -10000000000 10000000000 PHYS_UNIT "ms" /end CHARACTERISTIC
/begin CHARACTERISTIC FPfu_CATdP_hi "FPrm_unlatch(396)" VALUE 0x0016110C /* @ECU_Address@FPrm_unlatch@0x021BD630@ */ ECIPP_ALIGNMENT_FLOAT32_IEEE 10000000000 Compu_IDENTITY -10000000000 10000000000 PHYS_UNIT "ms" /end CHARACTERISTIC
/begin CHARACTERISTIC FPfu_CATdP_lo "FPrm_unlatch(395)" VALUE 0x00161108 /* @ECU_Address@FPrm_unlatch@0x021BD62C@ */ ECIPP_ALIGNMENT_FLOAT32_IEEE 10000000000 Compu_IDENTITY -10000000000 10000000000 PHYS_UNIT "ms" /end CHARACTERISTIC
/begin GROUP APUD12_min_EC_Fault "AUX analog Pull-Up/Down 12 low voltage"
 /begin REF_CHARACTERISTIC FCdc4_APUD12_min FCdtc_APUD12_min FCfmi_APUD12_min FCftb_APUD12_min FCspn_APUD12_min FPfl_APUD12_min FPfu_APUD12_min FPnd_APUD12_min FPsvr_APUD12_min FPsw_ext1_APUD12_min FPsw_APUD12_min /end REF_CHARACTERISTIC
/end GROUP
/begin GROUP APUD13_max_EC_Fault "AUX analog Pull-Up/Down 13 high voltage"
 /begin REF_CHARACTERISTIC FCdc4_APUD13_max FCdtc_APUD13_max FCfmi_APUD13_max FCftb_APUD13_max FCspn_APUD13_max FPfl_APUD13_max FPfu_APUD13_max FPnd_APUD13_max FPsvr_APUD13_max FPsw_ext1_APUD13_max FPsw_APUD13_max /end REF_CHARACTERISTIC
/end GROUP
/begin GROUP APUD13_min_EC_Fault "AUX analog Pull-Up/Down 13 low voltage"
 /begin REF_CHARACTERISTIC FCdc4_APUD13_min FCdtc_APUD13_min FCfmi_APUD13_min FCftb_APUD13_min FCspn_APUD13_min FPfl_APUD13_min FPfu_APUD13_min FPnd_APUD13_min FPsvr_APUD13_min FPsw_ext1_APUD13_min FPsw_APUD13_min /end REF_CHARACTERISTIC
/end GROUP
/begin GROUP APUD14_max_EC_Fault "AUX analog Pull-Up/Down 14 high voltage"
 /begin REF_CHARACTERISTIC FCdc4_APUD14_max FCdtc_APUD14_max FCfmi_APUD14_max FCftb_APUD14_max FCspn_APUD14_max FPfl_APUD14_max FPfu_APUD14_max FPnd_APUD14_max FPsvr_APUD14_max FPsw_ext1_APUD14_max FPsw_APUD14_max /end REF_CHARACTERISTIC
/end GROUP
/begin GROUP APUD14_min_EC_Fault "AUX analog Pull-Up/Down 14 low voltage"
 /begin REF_CHARACTERISTIC FCdc4_APUD14_min FCdtc_APUD14_min FCfmi_APUD14_min FCftb_APUD14_min FCspn_APUD14_min FPfl_APUD14_min FPfu_APUD14_min FPnd_APUD14_min FPsvr_APUD14_min FPsw_ext1_APUD14_min FPsw_APUD14_min /end REF_CHARACTERISTIC
/end GROUP
/begin GROUP APUD15_max_EC_Fault "AUX analog Pull-Up/Down 15 high voltage"
 /begin REF_CHARACTERISTIC FCdc4_APUD15_max FCdtc_APUD15_max FCfmi_APUD15_max FCftb_APUD15_max FCspn_APUD15_max FPfl_APUD15_max FPfu_APUD15_max FPnd_APUD15_max FPsvr_APUD15_max FPsw_ext1_APUD15_max FPsw_APUD15_max /end REF_CHARACTERISTIC
/end GROUP
/begin GROUP APUD15_min_EC_Fault "AUX analog Pull-Up/Down 15 low voltage"
 /begin REF_CHARACTERISTIC FCdc4_APUD15_min FCdtc_APUD15_min FCfmi_APUD15_min FCftb_APUD15_min FCspn_APUD15_min FPfl_APUD15_min FPfu_APUD15_min FPnd_APUD15_min FPsvr_APUD15_min FPsw_ext1_APUD15_min FPsw_APUD15_min /end REF_CHARACTERISTIC
/end GROUP
/begin GROUP APUD16_max_EC_Fault "AUX analog Pull-Up/Down 16 high voltage"
 /begin REF_CHARACTERISTIC FCdc4_APUD16_max FCdtc_APUD16_max FCfmi_APUD16_max FCftb_APUD16_max FCspn_APUD16_max FPfl_APUD16_max FPfu_APUD16_max FPnd_APUD16_max FPsvr_APUD16_max FPsw_ext1_APUD16_max FPsw_APUD16_max /end REF_CHARACTERISTIC
/end GROUP
/begin GROUP APUD16_min_EC_Fault "AUX analog Pull-Up/Down 16 low voltage"
 /begin REF_CHARACTERISTIC FCdc4_APUD16_min FCdtc_APUD16_min FCfmi_APUD16_min FCftb_APUD16_min FCspn_APUD16_min FPfl_APUD16_min FPfu_APUD16_min FPnd_APUD16_min FPsvr_APUD16_min FPsw_ext1_APUD16_min FPsw_APUD16_min /end REF_CHARACTERISTIC
/end GROUP
/begin GROUP APUD17_max_EC_Fault "AUX analog Pull-Up/Down 17 high voltage"
 /begin REF_CHARACTERISTIC FCdc4_APUD17_max FCdtc_APUD17_max FCfmi_APUD17_max FCftb_APUD17_max FCspn_APUD17_max FPfl_APUD17_max FPfu_APUD17_max FPnd_APUD17_max FPsvr_APUD17_max FPsw_ext1_APUD17_max FPsw_APUD17_max /end REF_CHARACTERISTIC
/end GROUP
/begin GROUP APUD17_min_EC_Fault "AUX analog Pull-Up/Down 17 low voltage"
 /begin REF_CHARACTERISTIC FCdc4_APUD17_min FCdtc_APUD17_min FCfmi_APUD17_min FCftb_APUD17_min FCspn_APUD17_min FPfl_APUD17_min FPfu_APUD17_min FPnd_APUD17_min FPsvr_APUD17_min FPsw_ext1_APUD17_min FPsw_APUD17_min /end REF_CHARACTERISTIC
/end GROUP
/begin GROUP APUD18_max_EC_Fault "AUX analog Pull-Up/Down 18 high voltage"
 /begin REF_CHARACTERISTIC FCdc4_APUD18_max FCdtc_APUD18_max FCfmi_APUD18_max FCftb_APUD18_max FCspn_APUD18_max FPfl_APUD18_max FPfu_APUD18_max FPnd_APUD18_max FPsvr_APUD18_max FPsw_ext1_APUD18_max FPsw_APUD18_max /end REF_CHARACTERISTIC
/end GROUP
/begin GROUP APUD18_min_EC_Fault "AUX analog Pull-Up/Down 18 low voltage"
 /begin REF_CHARACTERISTIC FCdc4_APUD18_min FCdtc_APUD18_min FCfmi_APUD18_min FCftb_APUD18_min FCspn_APUD18_min FPfl_APUD18_min FPfu_APUD18_min FPnd_APUD18_min FPsvr_APUD18_min FPsw_ext1_APUD18_min FPsw_APUD18_min /end REF_CHARACTERISTIC
/end GROUP
/begin GROUP APUD19_max_EC_Fault "AUX analog Pull-Up/Down 19 high voltage"
 /begin REF_CHARACTERISTIC FCdc4_APUD19_max FCdtc_APUD19_max FCfmi_APUD19_max FCftb_APUD19_max FCspn_APUD19_max FPfl_APUD19_max FPfu_APUD19_max FPnd_APUD19_max FPsvr_APUD19_max FPsw_ext1_APUD19_max FPsw_APUD19_max /end REF_CHARACTERISTIC
/end GROUP
/begin GROUP APUD19_min_EC_Fault "AUX analog Pull-Up/Down 19 low voltage"
 /begin REF_CHARACTERISTIC FCdc4_APUD19_min FCdtc_APUD19_min FCfmi_APUD19_min FCftb_APUD19_min FCspn_APUD19_min FPfl_APUD19_min FPfu_APUD19_min FPnd_APUD19_min FPsvr_APUD19_min FPsw_ext1_APUD19_min FPsw_APUD19_min /end REF_CHARACTERISTIC
/end GROUP
/begin GROUP APUD2_max_EC_Fault "AUX analog Pull-Up/Down 2 high voltage"
 /begin REF_CHARACTERISTIC FCdc4_APUD2_max FCdtc_APUD2_max FCfmi_APUD2_max FCftb_APUD2_max FCspn_APUD2_max FPfl_APUD2_max FPfu_APUD2_max FPnd_APUD2_max FPsvr_APUD2_max FPsw_ext1_APUD2_max FPsw_APUD2_max /end REF_CHARACTERISTIC
/end GROUP
/begin GROUP APUD2_min_EC_Fault "AUX analog Pull-Up/Down 2 low voltage"
 /begin REF_CHARACTERISTIC FCdc4_APUD2_min FCdtc_APUD2_min FCfmi_APUD2_min FCftb_APUD2_min FCspn_APUD2_min FPfl_APUD2_min FPfu_APUD2_min FPnd_APUD2_min FPsvr_APUD2_min FPsw_ext1_APUD2_min FPsw_APUD2_min /end REF_CHARACTERISTIC
/end GROUP
/begin GROUP APUD20_max_EC_Fault "AUX analog Pull-Up/Down 20 high voltage"
 /begin REF_CHARACTERISTIC FCdc4_APUD20_max FCdtc_APUD20_max FCfmi_APUD20_max FCftb_APUD20_max FCspn_APUD20_max FPfl_APUD20_max FPfu_APUD20_max FPnd_APUD20_max FPsvr_APUD20_max FPsw_ext1_APUD20_max FPsw_APUD20_max /end REF_CHARACTERISTIC
/end GROUP
/begin GROUP APUD20_min_EC_Fault "AUX analog Pull-Up/Down 20 low voltage"
 /begin REF_CHARACTERISTIC FCdc4_APUD20_min FCdtc_APUD20_min FCfmi_APUD20_min FCftb_APUD20_min FCspn_APUD20_min FPfl_APUD20_min FPfu_APUD20_min FPnd_APUD20_min FPsvr_APUD20_min FPsw_ext1_APUD20_min FPsw_APUD20_min /end REF_CHARACTERISTIC
/end GROUP
/begin GROUP APUD21_max_EC_Fault "AUX analog Pull-Up/Down 21 high voltage"
 /begin REF_CHARACTERISTIC FCdc4_APUD21_max FCdtc_APUD21_max FCfmi_APUD21_max FCftb_APUD21_max FCspn_APUD21_max FPfl_APUD21_max FPfu_APUD21_max FPnd_APUD21_max FPsvr_APUD21_max FPsw_ext1_APUD21_max FPsw_APUD21_max /end REF_CHARACTERISTIC
/end GROUP
/begin GROUP APUD21_min_EC_Fault "AUX analog Pull-Up/Down 21 low voltage"
 /begin REF_CHARACTERISTIC FCdc4_APUD21_min FCdtc_APUD21_min FCfmi_APUD21_min FCftb_APUD21_min FCspn_APUD21_min FPfl_APUD21_min FPfu_APUD21_min FPnd_APUD21_min FPsvr_APUD21_min FPsw_ext1_APUD21_min FPsw_APUD21_min /end REF_CHARACTERISTIC
/end GROUP
/begin GROUP APUD22_max_EC_Fault "AUX analog Pull-Up/Down 22 high voltage"
 /begin REF_CHARACTERISTIC FCdc4_APUD22_max FCdtc_APUD22_max FCfmi_APUD22_max FCftb_APUD22_max FCspn_APUD22_max FPfl_APUD22_max FPfu_APUD22_max FPnd_APUD22_max FPsvr_APUD22_max FPsw_ext1_APUD22_max FPsw_APUD22_max /end REF_CHARACTERISTIC
/end GROUP
/begin GROUP APUD22_min_EC_Fault "AUX analog Pull-Up/Down 22 low voltage"
 /begin REF_CHARACTERISTIC FCdc4_APUD22_min FCdtc_APUD22_min FCfmi_APUD22_min FCftb_APUD22_min FCspn_APUD22_min FPfl_APUD22_min FPfu_APUD22_min FPnd_APUD22_min FPsvr_APUD22_min FPsw_ext1_APUD22_min FPsw_APUD22_min /end REF_CHARACTERISTIC
/end GROUP
/begin GROUP APUD23_max_EC_Fault "AUX analog Pull-Up/Down 23 high voltage"
 /begin REF_CHARACTERISTIC FCdc4_APUD23_max FCdtc_APUD23_max FCfmi_APUD23_max FCftb_APUD23_max FCspn_APUD23_max FPfl_APUD23_max FPfu_APUD23_max FPnd_APUD23_max FPsvr_APUD23_max FPsw_ext1_APUD23_max FPsw_APUD23_max /end REF_CHARACTERISTIC
/end GROUP
/begin GROUP APUD23_min_EC_Fault "AUX analog Pull-Up/Down 23 low voltage"
 /begin REF_CHARACTERISTIC FCdc4_APUD23_min FCdtc_APUD23_min FCfmi_APUD23_min FCftb_APUD23_min FCspn_APUD23_min FPfl_APUD23_min FPfu_APUD23_min FPnd_APUD23_min FPsvr_APUD23_min FPsw_ext1_APUD23_min FPsw_APUD23_min /end REF_CHARACTERISTIC
/end GROUP
/begin GROUP APUD24_max_EC_Fault "AUX analog Pull-Up/Down 24 high voltage"
 /begin REF_CHARACTERISTIC FCdc4_APUD24_max FCdtc_APUD24_max FCfmi_APUD24_max FCftb_APUD24_max FCspn_APUD24_max FPfl_APUD24_max FPfu_APUD24_max FPnd_APUD24_max FPsvr_APUD24_max FPsw_ext1_APUD24_max FPsw_APUD24_max /end REF_CHARACTERISTIC
/end GROUP
/begin GROUP APUD24_min_EC_Fault "AUX analog Pull-Up/Down 24 low voltage"
 /begin REF_CHARACTERISTIC FCdc4_APUD24_min FCdtc_APUD24_min FCfmi_APUD24_min FCftb_APUD24_min FCspn_APUD24_min FPfl_APUD24_min FPfu_APUD24_min FPnd_APUD24_min FPsvr_APUD24_min FPsw_ext1_APUD24_min FPsw_APUD24_min /end REF_CHARACTERISTIC
/end GROUP
/begin GROUP APUD25_max_EC_Fault "AUX analog Pull-Up/Down 25 high voltage"
 /begin REF_CHARACTERISTIC FCdc4_APUD25_max FCdtc_APUD25_max FCfmi_APUD25_max FCftb_APUD25_max FCspn_APUD25_max FPfl_APUD25_max FPfu_APUD25_max FPnd_APUD25_max FPsvr_APUD25_max FPsw_ext1_APUD25_max FPsw_APUD25_max /end REF_CHARACTERISTIC
/end GROUP
/begin GROUP APUD25_min_EC_Fault "AUX analog Pull-Up/Down 25 low voltage"
 /begin REF_CHARACTERISTIC FCdc4_APUD25_min FCdtc_APUD25_min FCfmi_APUD25_min FCftb_APUD25_min FCspn_APUD25_min FPfl_APUD25_min FPfu_APUD25_min FPnd_APUD25_min FPsvr_APUD25_min FPsw_ext1_APUD25_min FPsw_APUD25_min /end REF_CHARACTERISTIC
/end GROUP
/begin GROUP APUD3_max_EC_Fault "AUX analog Pull-Up/Down 3 high voltage"
 /begin REF_CHARACTERISTIC FCdc4_APUD3_max FCdtc_APUD3_max FCfmi_APUD3_max FCftb_APUD3_max FCspn_APUD3_max FPfl_APUD3_max FPfu_APUD3_max FPnd_APUD3_max FPsvr_APUD3_max FPsw_ext1_APUD3_max FPsw_APUD3_max /end REF_CHARACTERISTIC
/end GROUP
/begin GROUP APUD3_min_EC_Fault "AUX analog Pull-Up/Down 3 low voltage"
 /begin REF_CHARACTERISTIC FCdc4_APUD3_min FCdtc_APUD3_min FCfmi_APUD3_min FCftb_APUD3_min FCspn_APUD3_min FPfl_APUD3_min FPfu_APUD3_min FPnd_APUD3_min FPsvr_APUD3_min FPsw_ext1_APUD3_min FPsw_APUD3_min /end REF_CHARACTERISTIC
/end GROUP
/begin GROUP APUD4_max_EC_Fault "AUX analog Pull-Up/Down 4 high voltage"
 /begin REF_CHARACTERISTIC FCdc4_APUD4_max FCdtc_APUD4_max FCfmi_APUD4_max FCftb_APUD4_max FCspn_APUD4_max FPfl_APUD4_max FPfu_APUD4_max FPnd_APUD4_max FPsvr_APUD4_max FPsw_ext1_APUD4_max FPsw_APUD4_max /end REF_CHARACTERISTIC
/end GROUP
/begin GROUP APUD4_min_EC_Fault "AUX analog Pull-Up/Down 4 low voltage"
 /begin REF_CHARACTERISTIC FCdc4_APUD4_min FCdtc_APUD4_min FCfmi_APUD4_min FCftb_APUD4_min FCspn_APUD4_min FPfl_APUD4_min FPfu_APUD4_min FPnd_APUD4_min FPsvr_APUD4_min FPsw_ext1_APUD4_min FPsw_APUD4_min /end REF_CHARACTERISTIC
/end GROUP
/begin GROUP APUD5_max_EC_Fault "AUX analog Pull-Up/Down 5 high voltage"
 /begin REF_CHARACTERISTIC FCdc4_APUD5_max FCdtc_APUD5_max FCfmi_APUD5_max FCftb_APUD5_max FCspn_APUD5_max FPfl_APUD5_max FPfu_APUD5_max FPnd_APUD5_max FPsvr_APUD5_max FPsw_ext1_APUD5_max FPsw_APUD5_max /end REF_CHARACTERISTIC
/end GROUP
/begin GROUP APUD5_min_EC_Fault "AUX analog Pull-Up/Down 5 low voltage"
 /begin REF_CHARACTERISTIC FCdc4_APUD5_min FCdtc_APUD5_min FCfmi_APUD5_min FCftb_APUD5_min FCspn_APUD5_min FPfl_APUD5_min FPfu_APUD5_min FPnd_APUD5_min FPsvr_APUD5_min FPsw_ext1_APUD5_min FPsw_APUD5_min /end REF_CHARACTERISTIC
/end GROUP
/begin GROUP APUD6_max_EC_Fault "AUX analog Pull-Up/Down 6 high voltage"
 /begin REF_CHARACTERISTIC FCdc4_APUD6_max FCdtc_APUD6_max FCfmi_APUD6_max FCftb_APUD6_max FCspn_APUD6_max FPfl_APUD6_max FPfu_APUD6_max FPnd_APUD6_max FPsvr_APUD6_max FPsw_ext1_APUD6_max FPsw_APUD6_max /end REF_CHARACTERISTIC
/end GROUP
/begin GROUP APUD6_min_EC_Fault "AUX analog Pull-Up/Down 6 low voltage"
 /begin REF_CHARACTERISTIC FCdc4_APUD6_min FCdtc_APUD6_min FCfmi_APUD6_min FCftb_APUD6_min FCspn_APUD6_min FPfl_APUD6_min FPfu_APUD6_min FPnd_APUD6_min FPsvr_APUD6_min FPsw_ext1_APUD6_min FPsw_APUD6_min /end REF_CHARACTERISTIC
/end GROUP
/begin GROUP APUD7_max_EC_Fault "AUX analog Pull-Up/Down 7 high voltage"
 /begin REF_CHARACTERISTIC FCdc4_APUD7_max FCdtc_APUD7_max FCfmi_APUD7_max FCftb_APUD7_max FCspn_APUD7_max FPfl_APUD7_max FPfu_APUD7_max FPnd_APUD7_max FPsvr_APUD7_max FPsw_ext1_APUD7_max FPsw_APUD7_max /end REF_CHARACTERISTIC
/end GROUP
/begin GROUP APUD7_min_EC_Fault "AUX analog Pull-Up/Down 7 low voltage"
 /begin REF_CHARACTERISTIC FCdc4_APUD7_min FCdtc_APUD7_min FCfmi_APUD7_min FCftb_APUD7_min FCspn_APUD7_min FPfl_APUD7_min FPfu_APUD7_min FPnd_APUD7_min FPsvr_APUD7_min FPsw_ext1_APUD7_min FPsw_APUD7_min /end REF_CHARACTERISTIC
/end GROUP
/begin GROUP APUD8_max_EC_Fault "AUX analog Pull-Up/Down 8 high voltage"
 /begin REF_CHARACTERISTIC FCdc4_APUD8_max FCdtc_APUD8_max FCfmi_APUD8_max FCftb_APUD8_max FCspn_APUD8_max FPfl_APUD8_max FPfu_APUD8_max FPnd_APUD8_max FPsvr_APUD8_max FPsw_ext1_APUD8_max FPsw_APUD8_max /end REF_CHARACTERISTIC
/end GROUP
/begin GROUP APUD8_min_EC_Fault "AUX analog Pull-Up/Down 8 low voltage"
 /begin REF_CHARACTERISTIC FCdc4_APUD8_min FCdtc_APUD8_min FCfmi_APUD8_min FCftb_APUD8_min FCspn_APUD8_min FPfl_APUD8_min FPfu_APUD8_min FPnd_APUD8_min FPsvr_APUD8_min FPsw_ext1_APUD8_min FPsw_APUD8_min /end REF_CHARACTERISTIC
/end GROUP
/begin GROUP APUD9_max_EC_Fault "AUX analog Pull-Up/Down 9 high voltage"
 /begin REF_CHARACTERISTIC FCdc4_APUD9_max FCdtc_APUD9_max FCfmi_APUD9_max FCftb_APUD9_max FCspn_APUD9_max FPfl_APUD9_max FPfu_APUD9_max FPnd_APUD9_max FPsvr_APUD9_max FPsw_ext1_APUD9_max FPsw_APUD9_max /end REF_CHARACTERISTIC
/end GROUP
/begin GROUP APUD9_min_EC_Fault "AUX analog Pull-Up/Down 9 low voltage"
 /begin REF_CHARACTERISTIC FCdc4_APUD9_min FCdtc_APUD9_min FCfmi_APUD9_min FCftb_APUD9_min FCspn_APUD9_min FPfl_APUD9_min FPfu_APUD9_min FPnd_APUD9_min FPsvr_APUD9_min FPsw_ext1_APUD9_min FPsw_APUD9_min /end REF_CHARACTERISTIC
/end GROUP
/begin GROUP AWP_intF_EC_Fault "Auxiliary water pump internal fault detection"
 /begin REF_CHARACTERISTIC FCdc4_AWP_intF FCdtc_AWP_intF FCfmi_AWP_intF FCftb_AWP_intF FCspn_AWP_intF FPfl_AWP_intF FPfu_AWP_intF FPnd_AWP_intF FPsvr_AWP_intF FPsw_ext1_AWP_intF FPsw_AWP_intF /end REF_CHARACTERISTIC
/end GROUP
/begin GROUP BP_max_EC_Fault "BP high pressure"
 /begin REF_CHARACTERISTIC FCdc4_BP_max FCdtc_BP_max FCfmi_BP_max FCftb_BP_max FCspn_BP_max FPfl_BP_max FPfu_BP_max FPnd_BP_max FPsvr_BP_max FPsw_ext1_BP_max FPsw_BP_max /end REF_CHARACTERISTIC
/end GROUP
/begin GROUP BP_min_EC_Fault "BP low pressure"
 /begin REF_CHARACTERISTIC FCdc4_BP_min FCdtc_BP_min FCfmi_BP_min FCftb_BP_min FCspn_BP_min FPfl_BP_min FPfu_BP_min FPnd_BP_min FPsvr_BP_min FPsw_ext1_BP_min FPsw_BP_min /end REF_CHARACTERISTIC
/end GROUP
/begin GROUP BPS1_max_EC_Fault "BPS1 high voltage"
 /begin REF_CHARACTERISTIC FCdc4_BPS1_max FCdtc_BPS1_max FCfmi_BPS1_max FCftb_BPS1_max FCspn_BPS1_max FPfl_BPS1_max FPfu_BPS1_max FPnd_BPS1_max FPsvr_BPS1_max FPsw_ext1_BPS1_max FPsw_BPS1_max /end REF_CHARACTERISTIC
/end GROUP
/begin GROUP BPS1_min_EC_Fault "BPS1 low voltage"
 /begin REF_CHARACTERISTIC FCdc4_BPS1_min FCdtc_BPS1_min FCfmi_BPS1_min FCftb_BPS1_min FCspn_BPS1_min FPfl_BPS1_min FPfu_BPS1_min FPnd_BPS1_min FPsvr_BPS1_min FPsw_ext1_BPS1_min FPsw_BPS1_min /end REF_CHARACTERISTIC
/end GROUP
/begin GROUP BPS12_OOR_EC_Fault "BPS1/2 simultaneous voltages"
 /begin REF_CHARACTERISTIC FCdc4_BPS12_OOR FCdtc_BPS12_OOR FCfmi_BPS12_OOR FCftb_BPS12_OOR FCspn_BPS12_OOR FPfl_BPS12_OOR FPfu_BPS12_OOR FPnd_BPS12_OOR FPsvr_BPS12_OOR FPsw_ext1_BPS12_OOR FPsw_BPS12_OOR /end REF_CHARACTERISTIC
/end GROUP
/begin GROUP BPS12pct_hi_EC_Fault "BPS1 higher than BPS2"
 /begin REF_CHARACTERISTIC FCdc4_BPS12pct_hi FCdtc_BPS12pct_hi FCfmi_BPS12pct_hi FCftb_BPS12pct_hi FCspn_BPS12pct_hi FPfl_BPS12pct_hi FPfu_BPS12pct_hi FPnd_BPS12pct_hi FPsvr_BPS12pct_hi FPsw_ext1_BPS12pct_hi FPsw_BPS12pct_hi /end REF_CHARACTERISTIC
/end GROUP
/begin GROUP BPS12pct_lo_EC_Fault "BPS1 lower than BPS2"
 /begin REF_CHARACTERISTIC FCdc4_BPS12pct_lo FCdtc_BPS12pct_lo FCfmi_BPS12pct_lo FCftb_BPS12pct_lo FCspn_BPS12pct_lo FPfl_BPS12pct_lo FPfu_BPS12pct_lo FPnd_BPS12pct_lo FPsvr_BPS12pct_lo FPsw_ext1_BPS12pct_lo FPsw_BPS12pct_lo /end REF_CHARACTERISTIC
/end GROUP
/begin GROUP BPS2_max_EC_Fault "BPS2 high voltage"
 /begin REF_CHARACTERISTIC FCdc4_BPS2_max FCdtc_BPS2_max FCfmi_BPS2_max FCftb_BPS2_max FCspn_BPS2_max FPfl_BPS2_max FPfu_BPS2_max FPnd_BPS2_max FPsvr_BPS2_max FPsw_ext1_BPS2_max FPsw_BPS2_max /end REF_CHARACTERISTIC
/end GROUP
/begin GROUP BPS2_min_EC_Fault "BPS2 low voltage"
 /begin REF_CHARACTERISTIC FCdc4_BPS2_min FCdtc_BPS2_min FCfmi_BPS2_min FCftb_BPS2_min FCspn_BPS2_min FPfl_BPS2_min FPfu_BPS2_min FPnd_BPS2_min FPsvr_BPS2_min FPsw_ext1_BPS2_min FPsw_BPS2_min /end REF_CHARACTERISTIC
/end GROUP
/begin GROUP BPSerr_neg_EC_Fault "Unable to reach lower BPS"
 /begin REF_CHARACTERISTIC FCdc4_BPSerr_neg FCdtc_BPSerr_neg FCfmi_BPSerr_neg FCftb_BPSerr_neg FCspn_BPSerr_neg FPfl_BPSerr_neg FPfu_BPSerr_neg FPnd_BPSerr_neg FPsvr_BPSerr_neg FPsw_ext1_BPSerr_neg FPsw_BPSerr_neg /end REF_CHARACTERISTIC
/end GROUP
/begin GROUP BPSerr_pos_EC_Fault "Unable to reach higher BPS"
 /begin REF_CHARACTERISTIC FCdc4_BPSerr_pos FCdtc_BPSerr_pos FCfmi_BPSerr_pos FCftb_BPSerr_pos FCspn_BPSerr_pos FPfl_BPSerr_pos FPfu_BPSerr_pos FPnd_BPSerr_pos FPsvr_BPSerr_pos FPsw_ext1_BPSerr_pos FPsw_BPSerr_pos /end REF_CHARACTERISTIC
/end GROUP
/begin GROUP brake_gndshort_EC_Fault "Brake output open / ground short"
 /begin REF_CHARACTERISTIC FCdc4_brake_gndshort FCdtc_brake_gndshort FCfmi_brake_gndshort FCftb_brake_gndshort FCspn_brake_gndshort FPfl_brake_gndshort FPfu_brake_gndshort FPnd_brake_gndshort FPsvr_brake_gndshort FPsw_ext1_brake_gndshort FPsw_brake_gndshort /end REF_CHARACTERISTIC
/end GROUP
/begin GROUP brake_pwrshort_EC_Fault "Brake output short to power"
 /begin REF_CHARACTERISTIC FCdc4_brake_pwrshort FCdtc_brake_pwrshort FCfmi_brake_pwrshort FCftb_brake_pwrshort FCspn_brake_pwrshort FPfl_brake_pwrshort FPfu_brake_pwrshort FPnd_brake_pwrshort FPsvr_brake_pwrshort FPsw_ext1_brake_pwrshort FPsw_brake_pwrshort /end REF_CHARACTERISTIC
/end GROUP
/begin GROUP bst_MAT_derate_actv_EC_Fault "Boost target MAT derate active"
 /begin REF_CHARACTERISTIC FCdc4_bst_MAT_derate_actv FCdtc_bst_MAT_derate_actv FCfmi_bst_MAT_derate_actv FCftb_bst_MAT_derate_actv FCspn_bst_MAT_derate_actv FPfl_bst_MAT_derate_actv FPfu_bst_MAT_derate_actv FPnd_bst_MAT_derate_actv FPsvr_bst_MAT_derate_actv FPsw_ext1_bst_MAT_derate_actv FPsw_bst_MAT_derate_actv /end REF_CHARACTERISTIC
/end GROUP
/begin GROUP BstTIP_Hi_EC_Fault "Control overboost"
 /begin REF_CHARACTERISTIC FCdc4_BstTIP_Hi FCdtc_BstTIP_Hi FCfmi_BstTIP_Hi FCftb_BstTIP_Hi FCspn_BstTIP_Hi FPfl_BstTIP_Hi FPfu_BstTIP_Hi FPnd_BstTIP_Hi FPsvr_BstTIP_Hi FPsw_ext1_BstTIP_Hi FPsw_BstTIP_Hi /end REF_CHARACTERISTIC
/end GROUP
/begin GROUP BstTIP_Lo_EC_Fault "Control underboost 1"
 /begin REF_CHARACTERISTIC FCdc4_BstTIP_Lo FCdtc_BstTIP_Lo FCfmi_BstTIP_Lo FCftb_BstTIP_Lo FCspn_BstTIP_Lo FPfl_BstTIP_Lo FPfu_BstTIP_Lo FPnd_BstTIP_Lo FPsvr_BstTIP_Lo FPsw_ext1_BstTIP_Lo FPsw_BstTIP_Lo /end REF_CHARACTERISTIC
/end GROUP
/begin GROUP BstTIP_Lo2_EC_Fault "Control underboost 2"
 /begin REF_CHARACTERISTIC FCdc4_BstTIP_Lo2 FCdtc_BstTIP_Lo2 FCfmi_BstTIP_Lo2 FCftb_BstTIP_Lo2 FCspn_BstTIP_Lo2 FPfl_BstTIP_Lo2 FPfu_BstTIP_Lo2 FPnd_BstTIP_Lo2 FPsvr_BstTIP_Lo2 FPsw_ext1_BstTIP_Lo2 FPsw_BstTIP_Lo2 /end REF_CHARACTERISTIC
/end GROUP
/begin GROUP BstTIP_slow_EC_Fault "Boost control slow to respond"
 /begin REF_CHARACTERISTIC FCdc4_BstTIP_slow FCdtc_BstTIP_slow FCfmi_BstTIP_slow FCftb_BstTIP_slow FCspn_BstTIP_slow FPfl_BstTIP_slow FPfu_BstTIP_slow FPnd_BstTIP_slow FPsvr_BstTIP_slow FPsw_ext1_BstTIP_slow FPsw_BstTIP_slow /end REF_CHARACTERISTIC
/end GROUP
/begin GROUP buzz_coilopen_EC_Fault "Buzzer open"
 /begin REF_CHARACTERISTIC FCdc4_buzz_coilopen FCdtc_buzz_coilopen FCfmi_buzz_coilopen FCftb_buzz_coilopen FCspn_buzz_coilopen FPfl_buzz_coilopen FPfu_buzz_coilopen FPnd_buzz_coilopen FPsvr_buzz_coilopen FPsw_ext1_buzz_coilopen FPsw_buzz_coilopen /end REF_CHARACTERISTIC
/end GROUP
/begin GROUP buzz_coilshort_EC_Fault "Buzzer control short to power"
 /begin REF_CHARACTERISTIC FCdc4_buzz_coilshort FCdtc_buzz_coilshort FCfmi_buzz_coilshort FCftb_buzz_coilshort FCspn_buzz_coilshort FPfl_buzz_coilshort FPfu_buzz_coilshort FPnd_buzz_coilshort FPsvr_buzz_coilshort FPsw_ext1_buzz_coilshort FPsw_buzz_coilshort /end REF_CHARACTERISTIC
/end GROUP
/begin GROUP buzz_gndshort_EC_Fault "Buzzer control ground short"
 /begin REF_CHARACTERISTIC FCdc4_buzz_gndshort FCdtc_buzz_gndshort FCfmi_buzz_gndshort FCftb_buzz_gndshort FCspn_buzz_gndshort FPfl_buzz_gndshort FPfu_buzz_gndshort FPnd_buzz_gndshort FPsvr_buzz_gndshort FPsw_ext1_buzz_gndshort FPsw_buzz_gndshort /end REF_CHARACTERISTIC
/end GROUP
/begin GROUP CAC_eta_lo_EC_Fault "CAC efficiency lower than expected"
 /begin REF_CHARACTERISTIC FCdc4_CAC_eta_lo FCdtc_CAC_eta_lo FCfmi_CAC_eta_lo FCftb_CAC_eta_lo FCspn_CAC_eta_lo FPfl_CAC_eta_lo FPfu_CAC_eta_lo FPnd_CAC_eta_lo FPsvr_CAC_eta_lo FPsw_ext1_CAC_eta_lo FPsw_CAC_eta_lo /end REF_CHARACTERISTIC
/end GROUP
/begin GROUP cal_config_EC_Fault "Calibration Configuration Error"
 /begin REF_CHARACTERISTIC FCdc4_cal_config FCdtc_cal_config FCfmi_cal_config FCftb_cal_config FCspn_cal_config FPfl_cal_config FPfu_cal_config FPnd_cal_config FPsvr_cal_config FPsw_ext1_cal_config FPsw_cal_config /end REF_CHARACTERISTIC
/end GROUP
/begin GROUP cam2loss_EC_Fault "Cam2 loss (exhaust)"
 /begin REF_CHARACTERISTIC FCdc4_cam2loss FCdtc_cam2loss FCfmi_cam2loss FCftb_cam2loss FCspn_cam2loss FPfl_cam2loss FPfu_cam2loss FPnd_cam2loss FPsvr_cam2loss FPsw_ext1_cam2loss FPsw_cam2loss /end REF_CHARACTERISTIC
/end GROUP
/begin GROUP camloss_EC_Fault "Cam1 loss (intake)"
 /begin REF_CHARACTERISTIC FCdc4_camloss FCdtc_camloss FCfmi_camloss FCftb_camloss FCspn_camloss FPfl_camloss FPfu_camloss FPnd_camloss FPsvr_camloss FPsw_ext1_camloss FPsw_camloss /end REF_CHARACTERISTIC
/end GROUP
/begin GROUP camnoise_EC_Fault "Cam sync noise"
 /begin REF_CHARACTERISTIC FCdc4_camnoise FCdtc_camnoise FCfmi_camnoise FCftb_camnoise FCspn_camnoise FPfl_camnoise FPfu_camnoise FPnd_camnoise FPsvr_camnoise FPsw_ext1_camnoise FPsw_camnoise /end REF_CHARACTERISTIC
/end GROUP
/begin GROUP CATdP_hi_EC_Fault "Catalyst monitor - exhaust P high"
 /begin REF_CHARACTERISTIC FCdc4_CATdP_hi FCdtc_CATdP_hi FCfmi_CATdP_hi FCftb_CATdP_hi FCspn_CATdP_hi FPfl_CATdP_hi FPfu_CATdP_hi FPnd_CATdP_hi FPsvr_CATdP_hi FPsw_ext1_CATdP_hi FPsw_CATdP_hi /end REF_CHARACTERISTIC
/end GROUP
/begin GROUP CATdP_lo_EC_Fault "Catalyst monitor - exhaust P low"
 /begin REF_CHARACTERISTIC FCdc4_CATdP_lo FCdtc_CATdP_lo FCfmi_CATdP_lo FCftb_CATdP_lo FCspn_CATdP_lo FPfl_CATdP_lo FPfu_CATdP_lo FPnd_CATdP_lo FPsvr_CATdP_lo FPsw_ext1_CATdP_lo FPsw_CATdP_lo /end REF_CHARACTERISTIC
/end GROUP
/end MODULE
/end PROJECT
