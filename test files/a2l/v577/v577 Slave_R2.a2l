/*
Copyright (c) 2000-2022.
All rights reserved.  This is an unpublished work.
*/
ASAP2_VERSION 1 61
/begin PROJECT Econtrols_4G "4G Test"
/begin HEADER "4G A2L Configuration" PROJECT_NO EControls4G /* config for version control */ VERSION "$Revision: 82130 $:" /* config for version control */ /end HEADER
/begin MODULE EControls_4G_SH2A "EControls 4G"
/begin MOD_COMMON "" DEPOSIT ABSOLUTE BYTE_ORDER MSB_FIRST /end MOD_COMMON
/* Define the Record Layouts */
/begin RECORD_LAYOUT ECIPP_ALIGNMENT_UBYTE FNC_VALUES 1 UBYTE COLUMN_DIR DIRECT /end RECORD_LAYOUT
/begin RECORD_LAYOUT ECIPP_ALIGNMENT_UWORD FNC_VALUES 1 UWORD COLUMN_DIR DIRECT /end RECORD_LAYOUT
/begin RECORD_LAYOUT ECIPP_Lookup_UWORD AXIS_PTS_X 1 UWORD INDEX_INCR DIRECT /end RECORD_LAYOUT
/begin RECORD_LAYOUT ECIPP_ALIGNMENT_SWORD FNC_VALUES 1 SWORD COLUMN_DIR DIRECT /end RECORD_LAYOUT
/begin RECORD_LAYOUT ECIPP_Lookup_SWORD AXIS_PTS_X 1 SWORD INDEX_INCR DIRECT /end RECORD_LAYOUT
/begin RECORD_LAYOUT ECIPP_ALIGNMENT_ULONG FNC_VALUES 1 ULONG COLUMN_DIR DIRECT /end RECORD_LAYOUT
/begin RECORD_LAYOUT ECIPP_ALIGNMENT_SLONG FNC_VALUES 1 SLONG COLUMN_DIR DIRECT /end RECORD_LAYOUT
/begin RECORD_LAYOUT ECIPP_ALIGNMENT_FLOAT32_IEEE FNC_VALUES 1 FLOAT32_IEEE COLUMN_DIR DIRECT /end RECORD_LAYOUT
/* Define generic COMPU_METHODS used in the A2L */ /* NOTE: most of the parameters from ECIPP use unique/specific COMPU_METHODS */
/begin COMPU_METHOD Compu_ECIPP_STRINGS "ECIPP Strings " /* Identifier */ RAT_FUNC "%.0" /* Format */ "ASCII" /* Units */ COEFFS 0 1 0 0 0 1 /end COMPU_METHOD
/begin CHARACTERISTIC trim_nom_crkN "Trim valve cranking nominal" VALUE 0x00142812 /* @ECU_Address@trim_nom_crkN@0x01000FB8@ */ ECIPP_ALIGNMENT_SWORD 200 Compu_trim_nom_crkN -200 199.993896484375 /end CHARACTERISTIC
/begin COMPU_METHOD Compu_trim_nom_crkN " " RAT_FUNC "%.1" "%" COEFFS 0 163.84 0 0 0 1 /end COMPU_METHOD
/begin CHARACTERISTIC CLNG_hi "CL max (Fault Condition:CL_BM >)" VALUE 0x0014282C /* @ECU_Address@CLNG_hi@0x01001048@ */ ECIPP_ALIGNMENT_SWORD 100 Compu_CLNG_hi -100 99.9969482421875 /end CHARACTERISTIC
/begin COMPU_METHOD Compu_CLNG_hi " " RAT_FUNC "%.1" "%" COEFFS 0 327.68 0 0 0 1 /end COMPU_METHOD
/begin CHARACTERISTIC CLNG_lo "CL min (Fault Condition:CL_BM <)" VALUE 0x0014282E /* @ECU_Address@CLNG_lo@0x01001050@ */ ECIPP_ALIGNMENT_SWORD 100 Compu_CLNG_lo -100 99.9969482421875 /end CHARACTERISTIC
/begin COMPU_METHOD Compu_CLNG_lo " " RAT_FUNC "%.1" "%" COEFFS 0 327.68 0 0 0 1 /end COMPU_METHOD
/begin CHARACTERISTIC CLNG_K "K_CL_switching" VALUE 0x00142830 /* @ECU_Address@CLNG_K@0x01001058@ */ ECIPP_ALIGNMENT_SWORD 100 Compu_CLNG_K -100 99.9969482421875 /end CHARACTERISTIC
/begin COMPU_METHOD Compu_CLNG_K " " RAT_FUNC "%.1" "%" COEFFS 0 327.68 0 0 0 1 /end COMPU_METHOD
/begin CHARACTERISTIC CLNG_K_acquire "K_CL_acquire" VALUE 0x00142832 /* @ECU_Address@CLNG_K_acquire@0x01001060@ */ ECIPP_ALIGNMENT_SWORD 100 Compu_CLNG_K_acquire -100 99.9969482421875 /end CHARACTERISTIC
/begin COMPU_METHOD Compu_CLNG_K_acquire " " RAT_FUNC "%.1" "%" COEFFS 0 327.68 0 0 0 1 /end COMPU_METHOD
/begin CHARACTERISTIC CLNG_stepmax "CL_stepmax" VALUE 0x00142834 /* @ECU_Address@CLNG_stepmax@0x01001068@ */ ECIPP_ALIGNMENT_SWORD 100 Compu_CLNG_stepmax -100 99.9969482421875 /end CHARACTERISTIC
/begin COMPU_METHOD Compu_CLNG_stepmax " " RAT_FUNC "%.1" "%" COEFFS 0 327.68 0 0 0 1 /end COMPU_METHOD
/begin CHARACTERISTIC CLpNG_Emax "CLp_Emax" VALUE 0x00142836 /* @ECU_Address@CLpNG_Emax@0x01001070@ */ ECIPP_ALIGNMENT_UWORD 200 Compu_CLpNG_Emax 0 199.996948242188 /end CHARACTERISTIC
/begin COMPU_METHOD Compu_CLpNG_Emax " " RAT_FUNC "%.1" "%" COEFFS 0 327.68 0 0 0 1 /end COMPU_METHOD
/begin CHARACTERISTIC CLpNG_Emin "CLp_Emin" VALUE 0x00142838 /* @ECU_Address@CLpNG_Emin@0x01001078@ */ ECIPP_ALIGNMENT_UWORD 200 Compu_CLpNG_Emin 0 199.996948242188 /end CHARACTERISTIC
/begin COMPU_METHOD Compu_CLpNG_Emin " " RAT_FUNC "%.1" "%" COEFFS 0 327.68 0 0 0 1 /end COMPU_METHOD
/begin CHARACTERISTIC CLpNG_Rp_def "CLp_Rp" VALUE 0x0014283A /* @ECU_Address@CLpNG_Rp_def@0x01001080@ */ ECIPP_ALIGNMENT_UWORD 100 Compu_CLpNG_Rp_def 0 99.9984741210938 /end CHARACTERISTIC
/begin COMPU_METHOD Compu_CLpNG_Rp_def " " RAT_FUNC "%.1" "%" COEFFS 0 655.36 0 0 0 1 /end COMPU_METHOD
/begin CHARACTERISTIC CLpNG_Rn_def "CLp_Rn" VALUE 0x0014283C /* @ECU_Address@CLpNG_Rn_def@0x01001088@ */ ECIPP_ALIGNMENT_UWORD 100 Compu_CLpNG_Rn_def 0 99.9984741210938 /end CHARACTERISTIC
/begin COMPU_METHOD Compu_CLpNG_Rn_def " " RAT_FUNC "%.1" "%" COEFFS 0 655.36 0 0 0 1 /end COMPU_METHOD
/begin CHARACTERISTIC ALNG_hi "Adapt max (Fault Condition:AL_BM >)" VALUE 0x0014283E /* @ECU_Address@ALNG_hi@0x01001090@ */ ECIPP_ALIGNMENT_SWORD 100 Compu_ALNG_hi -100 99.9969482421875 /end CHARACTERISTIC
/begin COMPU_METHOD Compu_ALNG_hi " " RAT_FUNC "%.1" "%" COEFFS 0 327.68 0 0 0 1 /end COMPU_METHOD
/begin CHARACTERISTIC ALNG_lo "Adapt min (Fault Condition:AL_BM <)" VALUE 0x00142840 /* @ECU_Address@ALNG_lo@0x01001098@ */ ECIPP_ALIGNMENT_SWORD 100 Compu_ALNG_lo -100 99.9969482421875 /end CHARACTERISTIC
/begin COMPU_METHOD Compu_ALNG_lo " " RAT_FUNC "%.1" "%" COEFFS 0 327.68 0 0 0 1 /end COMPU_METHOD
/begin CHARACTERISTIC ALNG_K "K adaptive learn" VALUE 0x00142842 /* @ECU_Address@ALNG_K@0x010010A0@ */ ECIPP_ALIGNMENT_SWORD 100 Compu_ALNG_K -100 99.9969482421875 /end CHARACTERISTIC
/begin COMPU_METHOD Compu_ALNG_K " " RAT_FUNC "%.1" "%" COEFFS 0 327.68 0 0 0 1 /end COMPU_METHOD
/begin CHARACTERISTIC ALNG_stepmax "Adapt stepmax" VALUE 0x00142844 /* @ECU_Address@ALNG_stepmax@0x010010A8@ */ ECIPP_ALIGNMENT_UWORD 200 Compu_ALNG_stepmax 0 199.996948242188 /end CHARACTERISTIC
/begin COMPU_METHOD Compu_ALNG_stepmax " " RAT_FUNC "%.1" "%" COEFFS 0 327.68 0 0 0 1 /end COMPU_METHOD
/begin CHARACTERISTIC ALNG_dzone "Adapt deadzone" VALUE 0x00142846 /* @ECU_Address@ALNG_dzone@0x010010B0@ */ ECIPP_ALIGNMENT_UWORD 200 Compu_ALNG_dzone 0 199.996948242188 /end CHARACTERISTIC
/begin COMPU_METHOD Compu_ALNG_dzone " " RAT_FUNC "%.1" "%" COEFFS 0 327.68 0 0 0 1 /end COMPU_METHOD
/begin CHARACTERISTIC ALNG_valid "Adaptive update validation error" VALUE 0x00142848 /* @ECU_Address@ALNG_valid@0x010010B8@ */ ECIPP_ALIGNMENT_SWORD 100 Compu_ALNG_valid -100 99.9969482421875 /end CHARACTERISTIC
/begin COMPU_METHOD Compu_ALNG_valid " " RAT_FUNC "%.1" "%" COEFFS 0 327.68 0 0 0 1 /end COMPU_METHOD
/begin CHARACTERISTIC ALNG_wait "Valid adaptive cycles min" VALUE 0x0014284A /* @ECU_Address@ALNG_wait@0x010010C0@ */ ECIPP_ALIGNMENT_UBYTE 255 Compu_ALNG_wait 0 255 /end CHARACTERISTIC
/begin COMPU_METHOD Compu_ALNG_wait " " RAT_FUNC "%.0" "count" COEFFS 0 1 0 0 0 1 /end COMPU_METHOD
/begin CHARACTERISTIC CL_dis_NG "NG CL Control{CL_dis_NG&0xff=0x00:Enabled}{CL_dis_NG&0xff=0x01:Disabled}" VALUE 0x00147CFB /* @ECU_Address@CL_dis_NG@0x010013C8@ */ ECIPP_ALIGNMENT_UBYTE 255 CL_dis_NG_COMPU_VTAB 0 255 BIT_MASK 0xff /end CHARACTERISTIC
/begin COMPU_METHOD CL_dis_NG_COMPU_VTAB "Verbal Table" TAB_VERB "%.0" "list" COMPU_TAB_REF CL_dis_NG_COMPU_VTAB_REF /end COMPU_METHOD
/begin COMPU_VTAB CL_dis_NG_COMPU_VTAB_REF "Verbal Table" TAB_VERB 2 0x00 "Enabled" 0x01 "Disabled" DEFAULT_VALUE "UNKNOWN" /end COMPU_VTAB
/begin MEASUREMENT RMT_ctl_SD "RMT_ctl_SD{RMT_ctl_SD&0x10=0x00:OFF}{RMT_ctl_SD&0x10=0x10:ON}" UBYTE RMT_ctl_SD_COMPU_VTAB 0 0 0 255 ECU_ADDRESS 0x01001790 BIT_MASK 0xFF /end MEASUREMENT
/begin COMPU_METHOD RMT_ctl_SD_COMPU_VTAB "Verbal Table" TAB_VERB "%.0" "list" COMPU_TAB_REF RMT_ctl_SD_COMPU_VTAB_REF /end COMPU_METHOD
/begin COMPU_VTAB RMT_ctl_SD_COMPU_VTAB_REF "Verbal Table" TAB_VERB 2 0x00 "OFF" 0x10 "ON" DEFAULT_VALUE "Unsupported Bit_Shift" /end COMPU_VTAB
/begin MEASUREMENT RMT_ctl_START "RMT_ctl_START{RMT_ctl_START&0x08=0x00:OFF}{RMT_ctl_START&0x08=0x08:ON}" UBYTE RMT_ctl_START_COMPU_VTAB 0 0 0 255 ECU_ADDRESS 0x01001798 BIT_MASK 0x08 /end MEASUREMENT
/begin COMPU_METHOD RMT_ctl_START_COMPU_VTAB "Verbal Table" TAB_VERB "%.0" "list" COMPU_TAB_REF RMT_ctl_START_COMPU_VTAB_REF /end COMPU_METHOD
/begin COMPU_VTAB RMT_ctl_START_COMPU_VTAB_REF "Verbal Table" TAB_VERB 2 0x00 "OFF" 0x08 "ON" DEFAULT_VALUE "UNKNOWN" /end COMPU_VTAB
/begin MEASUREMENT RMT_ctl_SPEED "RMT_ctl_SPEED{RMT_ctl_SPEED&0x04=0x00:OFF}{RMT_ctl_SPEED&0x04=0x04:ON}" UBYTE RMT_ctl_SPEED_COMPU_VTAB 0 0 0 255 ECU_ADDRESS 0x010017A0 BIT_MASK 0x04 /end MEASUREMENT
/begin COMPU_METHOD RMT_ctl_SPEED_COMPU_VTAB "Verbal Table" TAB_VERB "%.0" "list" COMPU_TAB_REF RMT_ctl_SPEED_COMPU_VTAB_REF /end COMPU_METHOD
/begin COMPU_VTAB RMT_ctl_SPEED_COMPU_VTAB_REF "Verbal Table" TAB_VERB 2 0x00 "OFF" 0x04 "ON" DEFAULT_VALUE "UNKNOWN" /end COMPU_VTAB
/begin MEASUREMENT RMT_ctl_FUEL "RMT_ctl_FUEL{RMT_ctl_FUEL&0x02=0x00:OFF}{RMT_ctl_FUEL&0x02=0x02:ON}" UBYTE RMT_ctl_FUEL_COMPU_VTAB 0 0 0 255 ECU_ADDRESS 0x010017A8 BIT_MASK 0x02 /end MEASUREMENT
/begin COMPU_METHOD RMT_ctl_FUEL_COMPU_VTAB "Verbal Table" TAB_VERB "%.0" "list" COMPU_TAB_REF RMT_ctl_FUEL_COMPU_VTAB_REF /end COMPU_METHOD
/begin COMPU_VTAB RMT_ctl_FUEL_COMPU_VTAB_REF "Verbal Table" TAB_VERB 2 0x00 "OFF" 0x02 "ON" DEFAULT_VALUE "UNKNOWN" /end COMPU_VTAB
/begin MEASUREMENT RMT_ctl_FAULT "RMT_ctl_FAULT{RMT_ctl_FAULT&0x01=0x00:OFF}{RMT_ctl_FAULT&0x01=0x01:ON}" UBYTE RMT_ctl_FAULT_COMPU_VTAB 0 0 0 255 ECU_ADDRESS 0x010017B0 BIT_MASK 0x01 /end MEASUREMENT
/begin COMPU_METHOD RMT_ctl_FAULT_COMPU_VTAB "Verbal Table" TAB_VERB "%.0" "list" COMPU_TAB_REF RMT_ctl_FAULT_COMPU_VTAB_REF /end COMPU_METHOD
/begin COMPU_VTAB RMT_ctl_FAULT_COMPU_VTAB_REF "Verbal Table" TAB_VERB 2 0x00 "OFF" 0x01 "ON" DEFAULT_VALUE "UNKNOWN" /end COMPU_VTAB
/begin MEASUREMENT RMT_speed "Remote speed setpoint/limit" UWORD Compu_RMT_speed 0 0 0 65535 ECU_ADDRESS 0x010017B8 /end MEASUREMENT
/begin COMPU_METHOD Compu_RMT_speed " " RAT_FUNC "%.0" "rpm" COEFFS 0 1 0 0 0 1 /end COMPU_METHOD
/begin MEASUREMENT RMT_start_tmr "Remote start limit timer" UWORD Compu_RMT_start_tmr 0 0 0 65.535 ECU_ADDRESS 0x010017C0 /end MEASUREMENT
/begin COMPU_METHOD Compu_RMT_start_tmr " " RAT_FUNC "%.1" "sec" COEFFS 0 1000 0 0 0 1 /end COMPU_METHOD
/begin CHARACTERISTIC RMT_start_tout "Remote start limt timeout" VALUE 0x001476f6 /* @ECU_Address@RMT_start_tout@0x010017C8@ */ ECIPP_ALIGNMENT_UWORD 66 Compu_RMT_start_tout 0 65.535 /end CHARACTERISTIC
/begin COMPU_METHOD Compu_RMT_start_tout " " RAT_FUNC "%.1" "sec" COEFFS 0 1000 0 0 0 1 /end COMPU_METHOD
/begin MEASUREMENT RMT_start "Remote starter control{RMT_start&0xff=0x00:Disengaged}{RMT_start&0xff=0x01:Request Start}{RMT_start&0xff=0x02:Starter Engaged}" UBYTE RMT_start_COMPU_VTAB 0 0 0 255 ECU_ADDRESS 0x010017D0 BIT_MASK 0xff /end MEASUREMENT
/begin COMPU_METHOD RMT_start_COMPU_VTAB "Verbal Table" TAB_VERB "%.0" "list" COMPU_TAB_REF RMT_start_COMPU_VTAB_REF /end COMPU_METHOD
/begin COMPU_VTAB RMT_start_COMPU_VTAB_REF "Verbal Table" TAB_VERB 3 0x00 "Disengaged" 0x01 "Request Start" 0x02 "Starter Engaged" DEFAULT_VALUE "UNKNOWN" /end COMPU_VTAB
/begin MEASUREMENT RMT_fuel_select "Remote fuel selection{RMT_fuel_select&0xff=0x00:Gasoline}{RMT_fuel_select&0xff=0x01:Gaseous}{RMT_fuel_select&0xff=0x02:Propane}{RMT_fuel_select&0xff=0x03:Natural Gas}" UBYTE RMT_fuel_select_COMPU_VTAB 0 0 0 255 ECU_ADDRESS 0x010017E0 BIT_MASK 0xff /end MEASUREMENT
/begin COMPU_METHOD RMT_fuel_select_COMPU_VTAB "Verbal Table" TAB_VERB "%.0" "list" COMPU_TAB_REF RMT_fuel_select_COMPU_VTAB_REF /end COMPU_METHOD
/begin COMPU_VTAB RMT_fuel_select_COMPU_VTAB_REF "Verbal Table" TAB_VERB 4 0x00 "Gasoline" 0x01 "Gaseous" 0x02 "Propane" 0x03 "Natural Gas" DEFAULT_VALUE "UNKNOWN" /end COMPU_VTAB
/begin MEASUREMENT RMT_clear_SD "Remote shutdown clear{RMT_clear_SD&0xff=0x00:None}{RMT_clear_SD&0xff=0x01:Request Clear}" UBYTE RMT_clear_SD_COMPU_VTAB 0 0 0 255 ECU_ADDRESS 0x010017E8 BIT_MASK 0xff /end MEASUREMENT
/begin COMPU_METHOD RMT_clear_SD_COMPU_VTAB "Verbal Table" TAB_VERB "%.0" "list" COMPU_TAB_REF RMT_clear_SD_COMPU_VTAB_REF /end COMPU_METHOD
/begin COMPU_VTAB RMT_clear_SD_COMPU_VTAB_REF "Verbal Table" TAB_VERB 2 0x00 "None" 0x01 "Request Clear" DEFAULT_VALUE "UNKNOWN" /end COMPU_VTAB
/begin CHARACTERISTIC RMT_start_ena "Remote start function{RMT_start_ena&0xff=0x00:Disabled}{RMT_start_ena&0xff=0x01:Remote only}{RMT_start_ena&0xff=0x02:Remote or local}" VALUE 0x00147ef5 /* @ECU_Address@RMT_start_ena@0x010017F0@ */ ECIPP_ALIGNMENT_UBYTE 255 RMT_start_ena_COMPU_VTAB 0 255 BIT_MASK 0xff /end CHARACTERISTIC
/begin COMPU_METHOD RMT_start_ena_COMPU_VTAB "Verbal Table" TAB_VERB "%.0" "list" COMPU_TAB_REF RMT_start_ena_COMPU_VTAB_REF /end COMPU_METHOD
/begin COMPU_VTAB RMT_start_ena_COMPU_VTAB_REF "Verbal Table" TAB_VERB 3 0x00 "Disabled" 0x01 "Remote only" 0x02 "Remote or local" DEFAULT_VALUE "UNKNOWN" /end COMPU_VTAB
/begin CHARACTERISTIC RMT_start_rpm "Remote start speed release" VALUE 0x001476f4 /* @ECU_Address@RMT_start_rpm@0x010017F8@ */ ECIPP_ALIGNMENT_UWORD 65535 Compu_RMT_start_rpm 0 65535 /end CHARACTERISTIC
/begin COMPU_METHOD Compu_RMT_start_rpm " " RAT_FUNC "%.0" "rpm" COEFFS 0 1 0 0 0 1 /end COMPU_METHOD
/begin CHARACTERISTIC J1939_ena "J1939 comm system{J1939_ena&0xff=0:Disabled}{J1939_ena&0xff=1:Enabled}" VALUE 0x00148562 /* @ECU_Address@J1939_ena@0x01001958@ */ ECIPP_ALIGNMENT_UBYTE 255 J1939_ena_COMPU_VTAB 0 255 BIT_MASK 0xff /end CHARACTERISTIC
/begin COMPU_METHOD J1939_ena_COMPU_VTAB "Verbal Table" TAB_VERB "%.0" "list" COMPU_TAB_REF J1939_ena_COMPU_VTAB_REF /end COMPU_METHOD
/begin COMPU_VTAB J1939_ena_COMPU_VTAB_REF "Verbal Table" TAB_VERB 2 0 "Disabled" 1 "Enabled" DEFAULT_VALUE "UNKNOWN" /end COMPU_VTAB
/begin CHARACTERISTIC trim_NG_max "Trim valve maximum duty-cycle" VALUE 0x00142822 /* @ECU_Address@trim_NG_max@0x01001EB0@ */ ECIPP_ALIGNMENT_UWORD 100 Compu_trim_NG_max 0 99.9984741210938 /end CHARACTERISTIC
/begin COMPU_METHOD Compu_trim_NG_max " " RAT_FUNC "%.1" "%" COEFFS 0 655.36 0 0 0 1 /end COMPU_METHOD
/begin CHARACTERISTIC trim_NG_min "Trim valve minimum duty-cycle" VALUE 0x00142824 /* @ECU_Address@trim_NG_min@0x01001EB8@ */ ECIPP_ALIGNMENT_UWORD 100 Compu_trim_NG_min 0 99.9984741210938 /end CHARACTERISTIC
/begin COMPU_METHOD Compu_trim_NG_min " " RAT_FUNC "%.1" "%" COEFFS 0 655.36 0 0 0 1 /end COMPU_METHOD
/begin CHARACTERISTIC CLNG_lo_postcat "Postcat delta-phi min" VALUE 0x00142862 /* @ECU_Address@CLNG_lo_postcat@0x01001F60@ */ ECIPP_ALIGNMENT_SWORD 2 Compu_CLNG_lo_postcat -2 1.99993896484375 /end CHARACTERISTIC
/begin COMPU_METHOD Compu_CLNG_lo_postcat " " RAT_FUNC "%.3" "phi" COEFFS 0 16384 0 0 0 1 /end COMPU_METHOD
/begin CHARACTERISTIC CLNG_hi_postcat "Postcat delta-phi max" VALUE 0x00142860 /* @ECU_Address@CLNG_hi_postcat@0x01001F68@ */ ECIPP_ALIGNMENT_SWORD 2 Compu_CLNG_hi_postcat -2 1.99993896484375 /end CHARACTERISTIC
/begin COMPU_METHOD Compu_CLNG_hi_postcat " " RAT_FUNC "%.3" "phi" COEFFS 0 16384 0 0 0 1 /end COMPU_METHOD
/begin CHARACTERISTIC CLNG_Ki_p_postcat "Ki increasing postcat" VALUE 0x00142850 /* @ECU_Address@CLNG_Ki_p_postcat@0x01001F80@ */ ECIPP_ALIGNMENT_SWORD 100 Compu_CLNG_Ki_p_postcat -100 99.9969482421875 /end CHARACTERISTIC
/begin COMPU_METHOD Compu_CLNG_Ki_p_postcat " " RAT_FUNC "%.1" "% / T_delay" COEFFS 0 327.68 0 0 0 1 /end COMPU_METHOD
/begin CHARACTERISTIC CLNG_postcat_ena "NG postcat control{CLNG_postcat_ena&0xff=0:Disabled}{CLNG_postcat_ena&0xff=1:Post-Cat Phi}{CLNG_postcat_ena&0xff=2:TWC Model}" VALUE 0x0014284B /* @ECU_Address@CLNG_postcat_ena@0x01001F98@ */ ECIPP_ALIGNMENT_UBYTE 255 CLNG_postcat_ena_COMPU_VTAB 0 255 BIT_MASK 0xff /end CHARACTERISTIC
/begin COMPU_METHOD CLNG_postcat_ena_COMPU_VTAB "Verbal Table" TAB_VERB "%.0" "list" COMPU_TAB_REF CLNG_postcat_ena_COMPU_VTAB_REF /end COMPU_METHOD
/begin COMPU_VTAB CLNG_postcat_ena_COMPU_VTAB_REF "Verbal Table" TAB_VERB 3 0 "Disabled" 1 "Post-Cat Phi" 2 "TWC Model" DEFAULT_VALUE "UNKNOWN" /end COMPU_VTAB
/begin CHARACTERISTIC CLNG_Ki_n_postcat "Ki decreasing postcat" VALUE 0x00142852 /* @ECU_Address@CLNG_Ki_n_postcat@0x01001FF8@ */ ECIPP_ALIGNMENT_SWORD 100 Compu_CLNG_Ki_n_postcat -100 99.9969482421875 /end CHARACTERISTIC
/begin COMPU_METHOD Compu_CLNG_Ki_n_postcat " " RAT_FUNC "%.1" "% / T_delay" COEFFS 0 327.68 0 0 0 1 /end COMPU_METHOD
/begin CHARACTERISTIC CLNG_Kp_p_postcat "Kp increasing postcat" VALUE 0x0014284C /* @ECU_Address@CLNG_Kp_p_postcat@0x01002010@ */ ECIPP_ALIGNMENT_SWORD 100 Compu_CLNG_Kp_p_postcat -100 99.9969482421875 /end CHARACTERISTIC
/begin COMPU_METHOD Compu_CLNG_Kp_p_postcat " " RAT_FUNC "%.1" "%" COEFFS 0 327.68 0 0 0 1 /end COMPU_METHOD
/begin CHARACTERISTIC CLNG_Kp_n_postcat "Kp decreasing postcat" VALUE 0x0014284E /* @ECU_Address@CLNG_Kp_n_postcat@0x01002028@ */ ECIPP_ALIGNMENT_SWORD 100 Compu_CLNG_Kp_n_postcat -100 99.9969482421875 /end CHARACTERISTIC
/begin COMPU_METHOD Compu_CLNG_Kp_n_postcat " " RAT_FUNC "%.1" "%" COEFFS 0 327.68 0 0 0 1 /end COMPU_METHOD
/begin CHARACTERISTIC CLNG_Kiv_p_postcat "Kiv increasing postcat" VALUE 0x00142854 /* @ECU_Address@CLNG_Kiv_p_postcat@0x01002050@ */ ECIPP_ALIGNMENT_SWORD 800 Compu_CLNG_Kiv_p_postcat -800 799.9755859375 /end CHARACTERISTIC
/begin COMPU_METHOD Compu_CLNG_Kiv_p_postcat " " RAT_FUNC "%.1" "% / T_delay^2" COEFFS 0 40.96 0 0 0 1 /end COMPU_METHOD
/begin CHARACTERISTIC CLNG_Kiv_n_postcat "Kiv decreasing postcat" VALUE 0x00142856 /* @ECU_Address@CLNG_Kiv_n_postcat@0x01002058@ */ ECIPP_ALIGNMENT_SWORD 800 Compu_CLNG_Kiv_n_postcat -800 799.9755859375 /end CHARACTERISTIC
/begin COMPU_METHOD Compu_CLNG_Kiv_n_postcat " " RAT_FUNC "%.1" "% / T_delay^2" COEFFS 0 40.96 0 0 0 1 /end COMPU_METHOD
/begin CHARACTERISTIC CLN_phidt_hi_postcat "Postcat dphi/dt max" VALUE 0x00142864 /* @ECU_Address@CLN_phidt_hi_postcat@0x01002088@ */ ECIPP_ALIGNMENT_SWORD 0 Compu_CLN_phidt_hi_postcat -0.125 0.124996185302734 /end CHARACTERISTIC
/begin COMPU_METHOD Compu_CLN_phidt_hi_postcat " " RAT_FUNC "%.3" "dphi / T_delay" COEFFS 0 262144 0 0 0 1 /end COMPU_METHOD
/begin CHARACTERISTIC CLN_phidt_lo_postcat "Postcat dphi/dt min" VALUE 0x00142866 /* @ECU_Address@CLN_phidt_lo_postcat@0x01002090@ */ ECIPP_ALIGNMENT_SWORD 0 Compu_CLN_phidt_lo_postcat -0.125 0.124996185302734 /end CHARACTERISTIC
/begin COMPU_METHOD Compu_CLN_phidt_lo_postcat " " RAT_FUNC "%.3" "dphi / T_delay" COEFFS 0 262144 0 0 0 1 /end COMPU_METHOD
/begin CHARACTERISTIC MJ_P_minN "EPR minimum pressure" VALUE 0x00141956 /* @ECU_Address@MJ_P_minN@0x010020B8@ */ ECIPP_ALIGNMENT_SWORD 222 Compu_MJ_P_minN -222 221.993225097656 /end CHARACTERISTIC
/begin COMPU_METHOD Compu_MJ_P_minN " " RAT_FUNC "%.2" "in H2O" COEFFS 0 147.603603603604 0 0 0 1 /end COMPU_METHOD
/begin CHARACTERISTIC MJ_P_maxN "EPR maximum pressure" VALUE 0x00141954 /* @ECU_Address@MJ_P_maxN@0x010020C8@ */ ECIPP_ALIGNMENT_SWORD 222 Compu_MJ_P_maxN -222 221.993225097656 /end CHARACTERISTIC
/begin COMPU_METHOD Compu_MJ_P_maxN " " RAT_FUNC "%.2" "in H2O" COEFFS 0 147.603603603604 0 0 0 1 /end COMPU_METHOD
/begin CHARACTERISTIC MJ_nom_crkN "Cranking nominal EPR setpoint" VALUE 0x0014195a /* @ECU_Address@MJ_nom_crkN@0x010020D0@ */ ECIPP_ALIGNMENT_SWORD 222 Compu_MJ_nom_crkN -222 221.993225097656 /end CHARACTERISTIC
/begin COMPU_METHOD Compu_MJ_nom_crkN " " RAT_FUNC "%.2" "in H2O" COEFFS 0 147.603603603604 0 0 0 1 /end COMPU_METHOD
/begin MEASUREMENT CAN_Rx_packs "CAN Rx packets" ULONG Compu_CAN_Rx_packs 0 0 0 4294967295 ECU_ADDRESS 0x01002150 /end MEASUREMENT
/begin COMPU_METHOD Compu_CAN_Rx_packs " " RAT_FUNC "%.0" "-" COEFFS 0 1 0 0 0 1 /end COMPU_METHOD
/begin MEASUREMENT CAN_Tx_packs "CAN Tx packets" ULONG Compu_CAN_Tx_packs 0 0 0 4294967295 ECU_ADDRESS 0x01002158 /end MEASUREMENT
/begin COMPU_METHOD Compu_CAN_Tx_packs " " RAT_FUNC "%.0" "-" COEFFS 0 1 0 0 0 1 /end COMPU_METHOD
/begin CHARACTERISTIC MJ_Pin_N "EPR nominal inlet pressure" VALUE 0x00141958 /* @ECU_Address@MJ_Pin_N@0x01002380@ */ ECIPP_ALIGNMENT_SWORD 222 Compu_MJ_Pin_N -222 221.993225097656 /end CHARACTERISTIC
/begin COMPU_METHOD Compu_MJ_Pin_N " " RAT_FUNC "%.2" "H2O" COEFFS 0 147.603603603604 0 0 0 1 /end COMPU_METHOD
/begin CHARACTERISTIC FAstoich_s_N "Stoich F/A ratio standard" VALUE 0x00149622 /* @ECU_Address@FAstoich_s_N@0x01002930@ */ ECIPP_ALIGNMENT_UWORD 0 Compu_FAstoich_s_N 0 0.124998092651367 /end CHARACTERISTIC
/begin COMPU_METHOD Compu_FAstoich_s_N " " RAT_FUNC "%.5" "-" COEFFS 0 524288 0 0 0 1 /end COMPU_METHOD
/begin CHARACTERISTIC FAstoich_a_N "Stoich F/A ratio actual" VALUE 0x00149620 /* @ECU_Address@FAstoich_a_N@0x01002948@ */ ECIPP_ALIGNMENT_UWORD 0 Compu_FAstoich_a_N 0 0.124998092651367 /end CHARACTERISTIC
/begin COMPU_METHOD Compu_FAstoich_a_N " " RAT_FUNC "%.5" "-" COEFFS 0 524288 0 0 0 1 /end COMPU_METHOD
/begin CHARACTERISTIC SGf_NG "Fuel specific gravity actual" VALUE 0x0014961C /* @ECU_Address@SGf_NG@0x01002978@ */ ECIPP_ALIGNMENT_UWORD 128 Compu_SGf_NG 0 127.998046875 /end CHARACTERISTIC
/begin COMPU_METHOD Compu_SGf_NG " " RAT_FUNC "%.3" "-" COEFFS 0 512 0 0 0 1 /end COMPU_METHOD
/begin CHARACTERISTIC SGfs_NG "Fuel specific gravity standard" VALUE 0x0014961E /* @ECU_Address@SGfs_NG@0x01002980@ */ ECIPP_ALIGNMENT_UWORD 128 Compu_SGfs_NG 0 127.998046875 /end CHARACTERISTIC
/begin COMPU_METHOD Compu_SGfs_NG " " RAT_FUNC "%.3" "-" COEFFS 0 512 0 0 0 1 /end COMPU_METHOD
/begin CHARACTERISTIC TSC_limit_only "Remote speed requests{TSC_limit_only&0xff=0:Full Authority}{TSC_limit_only&0xff=1:Limit Only}{TSC_limit_only&0xff=2:Limit if FPP fault}" VALUE 0x001480ba /* @ECU_Address@TSC_limit_only@0x01002D28@ */ ECIPP_ALIGNMENT_UBYTE 255 TSC_limit_only_COMPU_VTAB 0 255 BIT_MASK 0xff /end CHARACTERISTIC
/begin COMPU_METHOD TSC_limit_only_COMPU_VTAB "Verbal Table" TAB_VERB "%.0" "list" COMPU_TAB_REF TSC_limit_only_COMPU_VTAB_REF /end COMPU_METHOD
/begin COMPU_VTAB TSC_limit_only_COMPU_VTAB_REF "Verbal Table" TAB_VERB 3 0 "Full Authority" 1 "Limit Only" 2 "Limit if FPP fault" DEFAULT_VALUE "UNKNOWN" /end COMPU_VTAB
/begin CHARACTERISTIC maxgv_TSC_Gov3 "Remote speed limit throttle gov parameters{maxgv_TSC_Gov3&0xff=0:Normal Max Gov}{maxgv_TSC_Gov3&0xff=1:Use Gov3 Settings}" VALUE 0x001481a8 /* @ECU_Address@maxgv_TSC_Gov3@0x01002D30@ */ ECIPP_ALIGNMENT_UBYTE 255 maxgv_TSC_Gov3_COMPU_VTAB 0 255 BIT_MASK 0xff /end CHARACTERISTIC
/begin COMPU_METHOD maxgv_TSC_Gov3_COMPU_VTAB "Verbal Table" TAB_VERB "%.0" "list" COMPU_TAB_REF maxgv_TSC_Gov3_COMPU_VTAB_REF /end COMPU_METHOD
/begin COMPU_VTAB maxgv_TSC_Gov3_COMPU_VTAB_REF "Verbal Table" TAB_VERB 2 0 "Normal Max Gov" 1 "Use Gov3 Settings" DEFAULT_VALUE "UNKNOWN" /end COMPU_VTAB
/begin MEASUREMENT PGrq_last_SA "Last PGN req SA" UBYTE Compu_PGrq_last_SA 0 0 0 255 ECU_ADDRESS 0x01002D50 /end MEASUREMENT
/begin COMPU_METHOD Compu_PGrq_last_SA " " RAT_FUNC "%.0" "SA" COEFFS 0 1 0 0 0 1 /end COMPU_METHOD
/begin MEASUREMENT PGrq_last_RA "Last PGN req RA" UBYTE Compu_PGrq_last_RA 0 0 0 255 ECU_ADDRESS 0x01002D58 /end MEASUREMENT
/begin COMPU_METHOD Compu_PGrq_last_RA " " RAT_FUNC "%.0" "RA" COEFFS 0 1 0 0 0 1 /end COMPU_METHOD
/begin MEASUREMENT PGrq_cnt "PGN req activity" UBYTE Compu_PGrq_cnt 0 0 0 255 ECU_ADDRESS 0x01002D60 /end MEASUREMENT
/begin COMPU_METHOD Compu_PGrq_cnt " " RAT_FUNC "%.0" "count" COEFFS 0 1 0 0 0 1 /end COMPU_METHOD
/begin MEASUREMENT DENIED_cnt "DENIED activity" UBYTE Compu_DENIED_cnt 0 0 0 255 ECU_ADDRESS 0x01002D68 /end MEASUREMENT
/begin COMPU_METHOD Compu_DENIED_cnt " " RAT_FUNC "%.0" "count" COEFFS 0 1 0 0 0 1 /end COMPU_METHOD
/begin MEASUREMENT NACK_cnt "NACK activity" UBYTE Compu_NACK_cnt 0 0 0 255 ECU_ADDRESS 0x01002D70 /end MEASUREMENT
/begin COMPU_METHOD Compu_NACK_cnt " " RAT_FUNC "%.0" "count" COEFFS 0 1 0 0 0 1 /end COMPU_METHOD
/begin MEASUREMENT PGRx_cnt "Incoming PGN Rx activity" UBYTE Compu_PGRx_cnt 0 0 0 255 ECU_ADDRESS 0x01002D78 /end MEASUREMENT
/begin COMPU_METHOD Compu_PGRx_cnt " " RAT_FUNC "%.0" "count" COEFFS 0 1 0 0 0 1 /end COMPU_METHOD
/begin MEASUREMENT ADDRCLAIM_cnt "Address claim activity" UBYTE Compu_ADDRCLAIM_cnt 0 0 0 255 ECU_ADDRESS 0x01002D80 /end MEASUREMENT
/begin COMPU_METHOD Compu_ADDRCLAIM_cnt " " RAT_FUNC "%.0" "count" COEFFS 0 1 0 0 0 1 /end COMPU_METHOD
/begin MEASUREMENT NACK_last_SA "Last NACK SA" UBYTE Compu_NACK_last_SA 0 0 0 255 ECU_ADDRESS 0x01002D90 /end MEASUREMENT
/begin COMPU_METHOD Compu_NACK_last_SA " " RAT_FUNC "%.0" "SA" COEFFS 0 1 0 0 0 1 /end COMPU_METHOD
/begin MEASUREMENT NACK_last_RA "Last NACK RA" UBYTE Compu_NACK_last_RA 0 0 0 255 ECU_ADDRESS 0x01002D98 /end MEASUREMENT
/begin COMPU_METHOD Compu_NACK_last_RA " " RAT_FUNC "%.0" "RA" COEFFS 0 1 0 0 0 1 /end COMPU_METHOD
/begin MEASUREMENT DENIED_last_SA "Last DENIED SA" UBYTE Compu_DENIED_last_SA 0 0 0 255 ECU_ADDRESS 0x01002DA8 /end MEASUREMENT
/begin COMPU_METHOD Compu_DENIED_last_SA " " RAT_FUNC "%.0" "SA" COEFFS 0 1 0 0 0 1 /end COMPU_METHOD
/begin MEASUREMENT DENIED_last_RA "Last DENIED RA" UBYTE Compu_DENIED_last_RA 0 0 0 255 ECU_ADDRESS 0x01002DB0 /end MEASUREMENT
/begin COMPU_METHOD Compu_DENIED_last_RA " " RAT_FUNC "%.0" "RA" COEFFS 0 1 0 0 0 1 /end COMPU_METHOD
/begin CHARACTERISTIC CCP_allow "CCP comm processing{CCP_allow&0xff=0:Disabled}{CCP_allow&0xff=1:Enabled}" VALUE 0x00148563 /* @ECU_Address@CCP_allow@0x01003518@ */ ECIPP_ALIGNMENT_UBYTE 255 CCP_allow_COMPU_VTAB 0 255 BIT_MASK 0xff /end CHARACTERISTIC
/begin COMPU_METHOD CCP_allow_COMPU_VTAB "Verbal Table" TAB_VERB "%.0" "list" COMPU_TAB_REF CCP_allow_COMPU_VTAB_REF /end COMPU_METHOD
/begin COMPU_VTAB CCP_allow_COMPU_VTAB_REF "Verbal Table" TAB_VERB 2 0 "Disabled" 1 "Enabled" DEFAULT_VALUE "UNKNOWN" /end COMPU_VTAB
/begin MEASUREMENT CCP_CR_counter "CCP CR (Rx) packets" ULONG Compu_CCP_CR_counter 0 0 0 4294967295 ECU_ADDRESS 0x01003520 /end MEASUREMENT
/begin COMPU_METHOD Compu_CCP_CR_counter " " RAT_FUNC "%.0" "count" COEFFS 0 1 0 0 0 1 /end COMPU_METHOD
/begin MEASUREMENT CCP_DT_counter "CCP DT (Tx) packets" ULONG Compu_CCP_DT_counter 0 0 0 4294967295 ECU_ADDRESS 0x01003528 /end MEASUREMENT
/begin COMPU_METHOD Compu_CCP_DT_counter " " RAT_FUNC "%.0" "count" COEFFS 0 1 0 0 0 1 /end COMPU_METHOD
/begin MEASUREMENT CCP_session_actv "CCP session state{CCP_session_actv&0xff=0:Inactive}{CCP_session_actv&0xff=1:Active}" UBYTE CCP_session_actv_COMPU_VTAB 0 0 0 255 ECU_ADDRESS 0x01003530 BIT_MASK 0xff /end MEASUREMENT
/begin COMPU_METHOD CCP_session_actv_COMPU_VTAB "Verbal Table" TAB_VERB "%.0" "list" COMPU_TAB_REF CCP_session_actv_COMPU_VTAB_REF /end COMPU_METHOD
/begin COMPU_VTAB CCP_session_actv_COMPU_VTAB_REF "Verbal Table" TAB_VERB 2 0 "Inactive" 1 "Active" DEFAULT_VALUE "UNKNOWN" /end COMPU_VTAB
/begin CHARACTERISTIC J1939_addrFail "J1939 address conflict fail limit (Fault Condition:Address conflict counter >)" VALUE 0x0014856C /* @ECU_Address@J1939_addrFail@0x010036E8@ */ ECIPP_ALIGNMENT_UBYTE 255 Compu_J1939_addrFail 0 255 /end CHARACTERISTIC
/begin COMPU_METHOD Compu_J1939_addrFail " " RAT_FUNC "%.0" "failures" COEFFS 0 1 0 0 0 1 /end COMPU_METHOD
/begin MEASUREMENT J1939_addr_conflict "J1939 address conflict counter" UBYTE Compu_J1939_addr_conflict 0 0 0 255 ECU_ADDRESS 0x01003700 /end MEASUREMENT
/begin COMPU_METHOD Compu_J1939_addr_conflict " " RAT_FUNC "%.0" "count" COEFFS 0 1 0 0 0 1 /end COMPU_METHOD
/begin CHARACTERISTIC J1939_ena2 "CAN2 channel{J1939_ena2&0xff=0:Disabled}{J1939_ena2&0xff=1:Enabled}" VALUE 0x001488FA /* @ECU_Address@J1939_ena2@0x01003D00@ */ ECIPP_ALIGNMENT_UBYTE 255 J1939_ena2_COMPU_VTAB 0 255 BIT_MASK 0xff /end CHARACTERISTIC
/begin COMPU_METHOD J1939_ena2_COMPU_VTAB "Verbal Table" TAB_VERB "%.0" "list" COMPU_TAB_REF J1939_ena2_COMPU_VTAB_REF /end COMPU_METHOD
/begin COMPU_VTAB J1939_ena2_COMPU_VTAB_REF "Verbal Table" TAB_VERB 2 0 "Disabled" 1 "Enabled" DEFAULT_VALUE "UNKNOWN" /end COMPU_VTAB
/begin MEASUREMENT CAN2_Rx_packs "CAN2 Rx packets" ULONG Compu_CAN2_Rx_packs 0 0 0 4294967295 ECU_ADDRESS 0x01003D08 /end MEASUREMENT
/begin COMPU_METHOD Compu_CAN2_Rx_packs " " RAT_FUNC "%.0" "-" COEFFS 0 1 0 0 0 1 /end COMPU_METHOD
/begin MEASUREMENT CAN2_Tx_packs "CAN2 Tx packets" ULONG Compu_CAN2_Tx_packs 0 0 0 4294967295 ECU_ADDRESS 0x01003D10 /end MEASUREMENT
/begin COMPU_METHOD Compu_CAN2_Tx_packs " " RAT_FUNC "%.0" "-" COEFFS 0 1 0 0 0 1 /end COMPU_METHOD
/begin CHARACTERISTIC CAN1_speed "CAN1 link speed{CAN1_speed&0xff=0:125 Kbaud}{CAN1_speed&0xff=1:250 Kbaud (J1939)}{CAN1_speed&0xff=2:500 Kbaud}{CAN1_speed&0xff=3:1000 Kbaud}" VALUE 0x00148565 /* @ECU_Address@CAN1_speed@0x01003EB0@ */ ECIPP_ALIGNMENT_UBYTE 255 CAN1_speed_COMPU_VTAB 0 255 BIT_MASK 0xff /end CHARACTERISTIC
/begin COMPU_METHOD CAN1_speed_COMPU_VTAB "Verbal Table" TAB_VERB "%.0" "list" COMPU_TAB_REF CAN1_speed_COMPU_VTAB_REF /end COMPU_METHOD
/begin COMPU_VTAB CAN1_speed_COMPU_VTAB_REF "Verbal Table" TAB_VERB 4 0 "125 Kbaud" 1 "250 Kbaud (J1939)" 2 "500 Kbaud" 3 "1000 Kbaud" DEFAULT_VALUE "UNKNOWN" /end COMPU_VTAB
/begin CHARACTERISTIC CAN2_speed "CAN2 link speed{CAN2_speed&0xff=0:125 Kbaud}{CAN2_speed&0xff=1:250 Kbaud (J1939)}{CAN2_speed&0xff=2:500 Kbaud}{CAN2_speed&0xff=3:1000 Kbaud}" VALUE 0x001488FD /* @ECU_Address@CAN2_speed@0x01003EB8@ */ ECIPP_ALIGNMENT_UBYTE 255 CAN2_speed_COMPU_VTAB 0 255 BIT_MASK 0xff /end CHARACTERISTIC
/begin COMPU_METHOD CAN2_speed_COMPU_VTAB "Verbal Table" TAB_VERB "%.0" "list" COMPU_TAB_REF CAN2_speed_COMPU_VTAB_REF /end COMPU_METHOD
/begin COMPU_VTAB CAN2_speed_COMPU_VTAB_REF "Verbal Table" TAB_VERB 4 0 "125 Kbaud" 1 "250 Kbaud (J1939)" 2 "500 Kbaud" 3 "1000 Kbaud" DEFAULT_VALUE "UNKNOWN" /end COMPU_VTAB
/begin MEASUREMENT RMT_ctl_THROT "RMT_ctl_THROT{RMT_ctl_THROT&0x80=0x00:OFF}{RMT_ctl_THROT&0x80=0x80:ON}" UBYTE RMT_ctl_THROT_COMPU_VTAB 0 0 0 255 ECU_ADDRESS 0x01003F78 BIT_MASK 0xFF /end MEASUREMENT
/begin COMPU_METHOD RMT_ctl_THROT_COMPU_VTAB "Verbal Table" TAB_VERB "%.0" "list" COMPU_TAB_REF RMT_ctl_THROT_COMPU_VTAB_REF /end COMPU_METHOD
/begin COMPU_VTAB RMT_ctl_THROT_COMPU_VTAB_REF "Verbal Table" TAB_VERB 2 0x00 "OFF" 0x80 "ON" DEFAULT_VALUE "Unsupported Bit_Shift" /end COMPU_VTAB
/begin MEASUREMENT RMT_throt "Remote throttle request" UWORD Compu_RMT_throt 0 0 0 99.9984741210938 ECU_ADDRESS 0x01003F80 /end MEASUREMENT
/begin COMPU_METHOD Compu_RMT_throt " " RAT_FUNC "%.1" "%" COEFFS 0 655.36 0 0 0 1 /end COMPU_METHOD
/begin CHARACTERISTIC trim_tran_forceN "+Transient forced valve setpoint" VALUE 0x00142828 /* @ECU_Address@trim_tran_forceN@0x01004358@ */ ECIPP_ALIGNMENT_UWORD 100 Compu_trim_tran_forceN 0 99.9984741210938 /end CHARACTERISTIC
/begin COMPU_METHOD Compu_trim_tran_forceN " " RAT_FUNC "%.1" "%" COEFFS 0 655.36 0 0 0 1 /end COMPU_METHOD
/begin CHARACTERISTIC trim_ntran_forceN "-Transient forced valve setpoint" VALUE 0x00142826 /* @ECU_Address@trim_ntran_forceN@0x01004368@ */ ECIPP_ALIGNMENT_UWORD 100 Compu_trim_ntran_forceN 0 99.9984741210938 /end CHARACTERISTIC
/begin COMPU_METHOD Compu_trim_ntran_forceN " " RAT_FUNC "%.1" "%" COEFFS 0 655.36 0 0 0 1 /end COMPU_METHOD
/begin CHARACTERISTIC TSC_idlelim_mode "Remote speed request idle-limit{TSC_idlelim_mode&0xff=0:>= Idle Schedule}{TSC_idlelim_mode&0xff=1:>= Abs Min Speed}" VALUE 0x001480b9 /* @ECU_Address@TSC_idlelim_mode@0x01004398@ */ ECIPP_ALIGNMENT_UBYTE 255 TSC_idlelim_mode_COMPU_VTAB 0 255 BIT_MASK 0xff /end CHARACTERISTIC
/begin COMPU_METHOD TSC_idlelim_mode_COMPU_VTAB "Verbal Table" TAB_VERB "%.0" "list" COMPU_TAB_REF TSC_idlelim_mode_COMPU_VTAB_REF /end COMPU_METHOD
/begin COMPU_VTAB TSC_idlelim_mode_COMPU_VTAB_REF "Verbal Table" TAB_VERB 2 0 ">= Idle Schedule" 1 ">= Abs Min Speed" DEFAULT_VALUE "UNKNOWN" /end COMPU_VTAB
/begin CHARACTERISTIC TSC_ff_torque "Remote speed request feedforward torque{TSC_ff_torque&0xff=0:Disabled}{TSC_ff_torque&0xff=1:Enabled - Gov Load %}{TSC_ff_torque&0xff=2:Enabled - Ref Torque %}" VALUE 0x001480b8 /* @ECU_Address@TSC_ff_torque@0x010043A0@ */ ECIPP_ALIGNMENT_UBYTE 255 TSC_ff_torque_COMPU_VTAB 0 255 BIT_MASK 0xff /end CHARACTERISTIC
/begin COMPU_METHOD TSC_ff_torque_COMPU_VTAB "Verbal Table" TAB_VERB "%.0" "list" COMPU_TAB_REF TSC_ff_torque_COMPU_VTAB_REF /end COMPU_METHOD
/begin COMPU_VTAB TSC_ff_torque_COMPU_VTAB_REF "Verbal Table" TAB_VERB 3 0 "Disabled" 1 "Enabled - Gov Load %" 2 "Enabled - Ref Torque %" DEFAULT_VALUE "UNKNOWN" /end COMPU_VTAB
/begin MEASUREMENT TRANS_gear_a "Transmission actual gear{TRANS_gear_a&0xff=128:Uninitialized}{TRANS_gear_a&0xff=129:Error}{TRANS_gear_a&0xff=130:Not Available}{TRANS_gear_a&0xff=126:Park}{TRANS_gear_a&0xff=0:Neutral}{TRANS_gear_a&0xff=1:Forward 1}{TRANS_gear_a&0xff=2:Forward 2}{TRANS_ge" UBYTE TRANS_gear_a_COMPU_VTAB 0 0 0 255 ECU_ADDRESS 0x010044D0 BIT_MASK 0xff /end MEASUREMENT
/begin COMPU_METHOD TRANS_gear_a_COMPU_VTAB "Verbal Table" TAB_VERB "%.0" "list" COMPU_TAB_REF TRANS_gear_a_COMPU_VTAB_REF /end COMPU_METHOD
/begin COMPU_VTAB TRANS_gear_a_COMPU_VTAB_REF "Verbal Table" TAB_VERB 11 128 "Uninitialized" 129 "Error" 130 "Not Available" 126 "Park" 0 "Neutral" 1 "Forward 1" 2 "Forward 2" 3 "Forward 3" 4 "Forward 4" 5 "Forward 5" 6 "Forward 6" DEFAULT_VALUE "Unsupported Bit_Mask" /end COMPU_VTAB
/begin MEASUREMENT TRANS_gear_d "Transmission desired gear{TRANS_gear_d&0xff=128:Uninitialized}{TRANS_gear_d&0xff=129:Error}{TRANS_gear_d&0xff=130:Not Available}{TRANS_gear_d&0xff=126:Park}{TRANS_gear_d&0xff=0:Neutral}{TRANS_gear_d&0xff=1:Forward 1}{TRANS_gear_d&0xff=2:Forward 2}{TRANS_g" UBYTE TRANS_gear_d_COMPU_VTAB 0 0 0 255 ECU_ADDRESS 0x010044D8 BIT_MASK 0xff /end MEASUREMENT
/begin COMPU_METHOD TRANS_gear_d_COMPU_VTAB "Verbal Table" TAB_VERB "%.0" "list" COMPU_TAB_REF TRANS_gear_d_COMPU_VTAB_REF /end COMPU_METHOD
/begin COMPU_VTAB TRANS_gear_d_COMPU_VTAB_REF "Verbal Table" TAB_VERB 11 128 "Uninitialized" 129 "Error" 130 "Not Available" 126 "Park" 0 "Neutral" 1 "Forward 1" 2 "Forward 2" 3 "Forward 3" 4 "Forward 4" 5 "Forward 5" 6 "Forward 6" DEFAULT_VALUE "Unsupported Bit_Mask" /end COMPU_VTAB
/begin CHARACTERISTIC torque_Nm_ref "J1939 engine config reference torque" VALUE 0x00147bb8 /* @ECU_Address@torque_Nm_ref@0x01004500@ */ ECIPP_ALIGNMENT_UWORD 16384 Compu_torque_Nm_ref 0 16383.75 /end CHARACTERISTIC
/begin COMPU_METHOD Compu_torque_Nm_ref " " RAT_FUNC "%.1" "N-m" COEFFS 0 4 0 0 0 1 /end COMPU_METHOD
/begin CHARACTERISTIC J1939EC_broad_ena "J1939 EC/RC broadcast{J1939EC_broad_ena&0xff=0:Disabled}{J1939EC_broad_ena&0xff=1:Enabled = Engine Config}{J1939EC_broad_ena&0xff=2:Enabled = Retard Config}{J1939EC_broad_ena&0xff=3:Enabled = Engine + Retard Config}" VALUE 0x00148569 /* @ECU_Address@J1939EC_broad_ena@0x01004538@ */ ECIPP_ALIGNMENT_UBYTE 255 J1939EC_broad_ena_COMPU_VTAB 0 255 BIT_MASK 0xff /end CHARACTERISTIC
/begin COMPU_METHOD J1939EC_broad_ena_COMPU_VTAB "Verbal Table" TAB_VERB "%.0" "list" COMPU_TAB_REF J1939EC_broad_ena_COMPU_VTAB_REF /end COMPU_METHOD
/begin COMPU_VTAB J1939EC_broad_ena_COMPU_VTAB_REF "Verbal Table" TAB_VERB 4 0 "Disabled" 1 "Enabled = Engine Config" 2 "Enabled = Retard Config" 3 "Enabled = Engine + Retard Config" DEFAULT_VALUE "UNKNOWN" /end COMPU_VTAB
/begin MEASUREMENT RMT_torq "Remote torque setpoint/limit" SWORD Compu_RMT_torq 0 0 -200 199.993896484375 ECU_ADDRESS 0x01004540 /end MEASUREMENT
/begin COMPU_METHOD Compu_RMT_torq " " RAT_FUNC "%.1" "%" COEFFS 0 163.84 0 0 0 1 /end COMPU_METHOD
/begin CHARACTERISTIC J1939_MIL_mode "J1939 MIL key-on/engine-stop behavior{J1939_MIL_mode&0xff=0:On Continuously}{J1939_MIL_mode&0xff=1:On Only If Stored Faults}{J1939_MIL_mode&0xff=2:Same As Hardware MIL}{J1939_MIL_mode&0xff=3:Off Continuously}" VALUE 0x00147df1 /* @ECU_Address@J1939_MIL_mode@0x01004548@ */ ECIPP_ALIGNMENT_UBYTE 255 J1939_MIL_mode_COMPU_VTAB 0 255 BIT_MASK 0xff /end CHARACTERISTIC
/begin COMPU_METHOD J1939_MIL_mode_COMPU_VTAB "Verbal Table" TAB_VERB "%.0" "list" COMPU_TAB_REF J1939_MIL_mode_COMPU_VTAB_REF /end COMPU_METHOD
/begin COMPU_VTAB J1939_MIL_mode_COMPU_VTAB_REF "Verbal Table" TAB_VERB 4 0 "On Continuously" 1 "On Only If Stored Faults" 2 "Same As Hardware MIL" 3 "Off Continuously" DEFAULT_VALUE "UNKNOWN" /end COMPU_VTAB
/begin MEASUREMENT J1939_lamps_MIL "J1939 MIL{J1939_lamps_MIL&0x40=0x00:OFF}{J1939_lamps_MIL&0x40=0x40:ON}" UBYTE J1939_lamps_MIL_COMPU_VTAB 0 0 0 255 ECU_ADDRESS 0x01004550 BIT_MASK 0x40 /end MEASUREMENT
/begin COMPU_METHOD J1939_lamps_MIL_COMPU_VTAB "Verbal Table" TAB_VERB "%.0" "list" COMPU_TAB_REF J1939_lamps_MIL_COMPU_VTAB_REF /end COMPU_METHOD
/begin COMPU_VTAB J1939_lamps_MIL_COMPU_VTAB_REF "Verbal Table" TAB_VERB 2 0x00 "OFF" 0x40 "ON" DEFAULT_VALUE "UNKNOWN" /end COMPU_VTAB
/begin MEASUREMENT J1939_lamps_RedStop "J1939 Red Stop{J1939_lamps_RedStop&0x10=0x00:OFF}{J1939_lamps_RedStop&0x10=0x10:ON}" UBYTE J1939_lamps_RedStop_COMPU_VTAB 0 0 0 255 ECU_ADDRESS 0x01004558 BIT_MASK 0xFF /end MEASUREMENT
/begin COMPU_METHOD J1939_lamps_RedStop_COMPU_VTAB "Verbal Table" TAB_VERB "%.0" "list" COMPU_TAB_REF J1939_lamps_RedStop_COMPU_VTAB_REF /end COMPU_METHOD
/begin COMPU_VTAB J1939_lamps_RedStop_COMPU_VTAB_REF "Verbal Table" TAB_VERB 2 0x00 "OFF" 0x10 "ON" DEFAULT_VALUE "Unsupported Bit_Shift" /end COMPU_VTAB
/begin MEASUREMENT J1939_lamps_AmbWarn "J1939 Amber Warn{J1939_lamps_AmbWarn&0x04=0x00:OFF}{J1939_lamps_AmbWarn&0x04=0x04:ON}" UBYTE J1939_lamps_AmbWarn_COMPU_VTAB 0 0 0 255 ECU_ADDRESS 0x01004560 BIT_MASK 0x04 /end MEASUREMENT
/begin COMPU_METHOD J1939_lamps_AmbWarn_COMPU_VTAB "Verbal Table" TAB_VERB "%.0" "list" COMPU_TAB_REF J1939_lamps_AmbWarn_COMPU_VTAB_REF /end COMPU_METHOD
/begin COMPU_VTAB J1939_lamps_AmbWarn_COMPU_VTAB_REF "Verbal Table" TAB_VERB 2 0x00 "OFF" 0x04 "ON" DEFAULT_VALUE "UNKNOWN" /end COMPU_VTAB
/begin MEASUREMENT J1939_lamps_Protect "J1939 Protect{J1939_lamps_Protect&0x01=0x00:OFF}{J1939_lamps_Protect&0x01=0x01:ON}" UBYTE J1939_lamps_Protect_COMPU_VTAB 0 0 0 255 ECU_ADDRESS 0x01004568 BIT_MASK 0x01 /end MEASUREMENT
/begin COMPU_METHOD J1939_lamps_Protect_COMPU_VTAB "Verbal Table" TAB_VERB "%.0" "list" COMPU_TAB_REF J1939_lamps_Protect_COMPU_VTAB_REF /end COMPU_METHOD
/begin COMPU_VTAB J1939_lamps_Protect_COMPU_VTAB_REF "Verbal Table" TAB_VERB 2 0x00 "OFF" 0x01 "ON" DEFAULT_VALUE "UNKNOWN" /end COMPU_VTAB
/begin CHARACTERISTIC J1939_addr_frcena "CAN1 J1939 address selection{J1939_addr_frcena&0xff=0:Engine Number Based}{J1939_addr_frcena&0xff=1:Force Constant Value}" VALUE 0x00148567 /* @ECU_Address@J1939_addr_frcena@0x010045A0@ */ ECIPP_ALIGNMENT_UBYTE 255 J1939_addr_frcena_COMPU_VTAB 0 255 BIT_MASK 0xff /end CHARACTERISTIC
/begin COMPU_METHOD J1939_addr_frcena_COMPU_VTAB "Verbal Table" TAB_VERB "%.0" "list" COMPU_TAB_REF J1939_addr_frcena_COMPU_VTAB_REF /end COMPU_METHOD
/begin COMPU_VTAB J1939_addr_frcena_COMPU_VTAB_REF "Verbal Table" TAB_VERB 2 0 "Engine Number Based" 1 "Force Constant Value" DEFAULT_VALUE "UNKNOWN" /end COMPU_VTAB
/begin CHARACTERISTIC J1939_addr2_frcena "CAN2 J1939 address selection{J1939_addr2_frcena&0xff=0:Engine Number Based}{J1939_addr2_frcena&0xff=1:Force Constant Value}" VALUE 0x001488FF /* @ECU_Address@J1939_addr2_frcena@0x010045A8@ */ ECIPP_ALIGNMENT_UBYTE 255 J1939_addr2_frcena_COMPU_VTAB 0 255 BIT_MASK 0xff /end CHARACTERISTIC
/begin COMPU_METHOD J1939_addr2_frcena_COMPU_VTAB "Verbal Table" TAB_VERB "%.0" "list" COMPU_TAB_REF J1939_addr2_frcena_COMPU_VTAB_REF /end COMPU_METHOD
/begin COMPU_VTAB J1939_addr2_frcena_COMPU_VTAB_REF "Verbal Table" TAB_VERB 2 0 "Engine Number Based" 1 "Force Constant Value" DEFAULT_VALUE "UNKNOWN" /end COMPU_VTAB
/begin CHARACTERISTIC J1939_addr_frcval "CAN1 J1939 address forced value" VALUE 0x00148568 /* @ECU_Address@J1939_addr_frcval@0x010045B0@ */ ECIPP_ALIGNMENT_UBYTE 255 Compu_J1939_addr_frcval 0 255 /end CHARACTERISTIC
/begin COMPU_METHOD Compu_J1939_addr_frcval " " RAT_FUNC "%.0" "-" COEFFS 0 1 0 0 0 1 /end COMPU_METHOD
/begin CHARACTERISTIC J1939_addr2_frcval "CAN2 J1939 address forced value" VALUE 0x00148900 /* @ECU_Address@J1939_addr2_frcval@0x010045B8@ */ ECIPP_ALIGNMENT_UBYTE 255 Compu_J1939_addr2_frcval 0 255 /end CHARACTERISTIC
/begin COMPU_METHOD Compu_J1939_addr2_frcval " " RAT_FUNC "%.0" "-" COEFFS 0 1 0 0 0 1 /end COMPU_METHOD
/begin MEASUREMENT J1939_addr_latch "CAN1 current J1939 address" UBYTE Compu_J1939_addr_latch 0 0 0 255 ECU_ADDRESS 0x010045C8 /end MEASUREMENT
/begin COMPU_METHOD Compu_J1939_addr_latch " " RAT_FUNC "%.0" "-" COEFFS 0 1 0 0 0 1 /end COMPU_METHOD
/begin MEASUREMENT J1939_addr2_latch "CAN2 current J1939 address" UBYTE Compu_J1939_addr2_latch 0 0 0 255 ECU_ADDRESS 0x010045D0 /end MEASUREMENT
/begin COMPU_METHOD Compu_J1939_addr2_latch " " RAT_FUNC "%.0" "-" COEFFS 0 1 0 0 0 1 /end COMPU_METHOD
/begin CHARACTERISTIC CLNG_TD_enable "CL acquire transport delay{CLNG_TD_enable&0xff=0:Disabled}{CLNG_TD_enable&0xff=1:Enabled}" VALUE 0x00142888 /* @ECU_Address@CLNG_TD_enable@0x01004AA8@ */ ECIPP_ALIGNMENT_UBYTE 255 CLNG_TD_enable_COMPU_VTAB 0 255 BIT_MASK 0xff /end CHARACTERISTIC
/begin COMPU_METHOD CLNG_TD_enable_COMPU_VTAB "Verbal Table" TAB_VERB "%.0" "list" COMPU_TAB_REF CLNG_TD_enable_COMPU_VTAB_REF /end COMPU_METHOD
/begin COMPU_VTAB CLNG_TD_enable_COMPU_VTAB_REF "Verbal Table" TAB_VERB 2 0 "Disabled" 1 "Enabled" DEFAULT_VALUE "UNKNOWN" /end COMPU_VTAB
/begin CHARACTERISTIC CLNG_TD_max_p "CL acquire max rich overshoot" VALUE 0x00142880 /* @ECU_Address@CLNG_TD_max_p@0x01004AB0@ */ ECIPP_ALIGNMENT_SWORD 100 Compu_CLNG_TD_max_p -100 99.9969482421875 /end CHARACTERISTIC
/begin COMPU_METHOD Compu_CLNG_TD_max_p " " RAT_FUNC "%.1" "%" COEFFS 0 327.68 0 0 0 1 /end COMPU_METHOD
/begin CHARACTERISTIC CLNG_TD_max_n "CL acquire max lean overshoot" VALUE 0x0014287E /* @ECU_Address@CLNG_TD_max_n@0x01004AB8@ */ ECIPP_ALIGNMENT_SWORD 100 Compu_CLNG_TD_max_n -100 99.9969482421875 /end CHARACTERISTIC
/begin COMPU_METHOD Compu_CLNG_TD_max_n " " RAT_FUNC "%.1" "%" COEFFS 0 327.68 0 0 0 1 /end COMPU_METHOD
/begin CHARACTERISTIC CLNG_TD_EGOsw_ena "EGO switch acquisition mode{CLNG_TD_EGOsw_ena&0xff=0:Disabled}{CLNG_TD_EGOsw_ena&0xff=1:Enabled}" VALUE 0x00142889 /* @ECU_Address@CLNG_TD_EGOsw_ena@0x01004AC0@ */ ECIPP_ALIGNMENT_UBYTE 255 CLNG_TD_EGOsw_ena_COMPU_VTAB 0 255 BIT_MASK 0xff /end CHARACTERISTIC
/begin COMPU_METHOD CLNG_TD_EGOsw_ena_COMPU_VTAB "Verbal Table" TAB_VERB "%.0" "list" COMPU_TAB_REF CLNG_TD_EGOsw_ena_COMPU_VTAB_REF /end COMPU_METHOD
/begin COMPU_VTAB CLNG_TD_EGOsw_ena_COMPU_VTAB_REF "Verbal Table" TAB_VERB 2 0 "Disabled" 1 "Enabled" DEFAULT_VALUE "UNKNOWN" /end COMPU_VTAB
/begin CHARACTERISTIC CLNG_TD_sw_offset "EGO switch delay offset" VALUE 0x00142882 /* @ECU_Address@CLNG_TD_sw_offset@0x01004AC8@ */ ECIPP_ALIGNMENT_SWORD 100 Compu_CLNG_TD_sw_offset -100 99.9969482421875 /end CHARACTERISTIC
/begin COMPU_METHOD Compu_CLNG_TD_sw_offset " " RAT_FUNC "%.1" "%" COEFFS 0 327.68 0 0 0 1 /end COMPU_METHOD
/begin CHARACTERISTIC CLNG_TD_sw_pct "EGO switch initial step" VALUE 0x00142884 /* @ECU_Address@CLNG_TD_sw_pct@0x01004AD0@ */ ECIPP_ALIGNMENT_UWORD 200 Compu_CLNG_TD_sw_pct 0 199.996948242188 /end CHARACTERISTIC
/begin COMPU_METHOD Compu_CLNG_TD_sw_pct " " RAT_FUNC "%.1" "%" COEFFS 0 327.68 0 0 0 1 /end COMPU_METHOD
/begin CHARACTERISTIC RMT_gov_att_ena "Remote governor gain attenuators{RMT_gov_att_ena&0xff=0:Rejected}{RMT_gov_att_ena&0xff=1:Accepted}" VALUE 0x00147ef4 /* @ECU_Address@RMT_gov_att_ena@0x01004AE8@ */ ECIPP_ALIGNMENT_UBYTE 255 RMT_gov_att_ena_COMPU_VTAB 0 255 BIT_MASK 0xff /end CHARACTERISTIC
/begin COMPU_METHOD RMT_gov_att_ena_COMPU_VTAB "Verbal Table" TAB_VERB "%.0" "list" COMPU_TAB_REF RMT_gov_att_ena_COMPU_VTAB_REF /end COMPU_METHOD
/begin COMPU_VTAB RMT_gov_att_ena_COMPU_VTAB_REF "Verbal Table" TAB_VERB 2 0 "Rejected" 1 "Accepted" DEFAULT_VALUE "UNKNOWN" /end COMPU_VTAB
/begin MEASUREMENT RMT_Kd_att "Remote Kd attenuator" UWORD Compu_RMT_Kd_att 0 0 0 0.999984741210938 ECU_ADDRESS 0x01004AF0 /end MEASUREMENT
/begin COMPU_METHOD Compu_RMT_Kd_att " " RAT_FUNC "%.3" "-" COEFFS 0 65536 0 0 0 1 /end COMPU_METHOD
/begin CHARACTERISTIC NMHG_FPPidle_chk "NMHG idle valid transmission check{NMHG_FPPidle_chk&0xff=0:Disabled}{NMHG_FPPidle_chk&0xff=1:Special FPP cal if type=1,14}" VALUE 0x00147e89 /* @ECU_Address@NMHG_FPPidle_chk@0x01004B80@ */ ECIPP_ALIGNMENT_UBYTE 255 NMHG_FPPidle_chk_COMPU_VTAB 0 255 BIT_MASK 0xff /end CHARACTERISTIC
/begin COMPU_METHOD NMHG_FPPidle_chk_COMPU_VTAB "Verbal Table" TAB_VERB "%.0" "list" COMPU_TAB_REF NMHG_FPPidle_chk_COMPU_VTAB_REF /end COMPU_METHOD
/begin COMPU_VTAB NMHG_FPPidle_chk_COMPU_VTAB_REF "Verbal Table" TAB_VERB 2 0 "Disabled" 1 "Special FPP cal if type=1,14" DEFAULT_VALUE "UNKNOWN" /end COMPU_VTAB
/begin MEASUREMENT NMHG_trans_type "NMHG indicated transmission type" UBYTE Compu_NMHG_trans_type 0 0 0 255 ECU_ADDRESS 0x01004B88 /end MEASUREMENT
/begin COMPU_METHOD Compu_NMHG_trans_type " " RAT_FUNC "%.0" "-" COEFFS 0 1 0 0 0 1 /end COMPU_METHOD
/begin CHARACTERISTIC maxgvspk_TSC_Gov3 "Remote speed limit spark gov parameters{maxgvspk_TSC_Gov3&0xff=0:Normal Max Gov}{maxgvspk_TSC_Gov3&0xff=1:Use Gov3 Settings}" VALUE 0x001481aa /* @ECU_Address@maxgvspk_TSC_Gov3@0x01004D50@ */ ECIPP_ALIGNMENT_UBYTE 255 maxgvspk_TSC_Gov3_COMPU_VTAB 0 255 BIT_MASK 0xff /end CHARACTERISTIC
/begin COMPU_METHOD maxgvspk_TSC_Gov3_COMPU_VTAB "Verbal Table" TAB_VERB "%.0" "list" COMPU_TAB_REF maxgvspk_TSC_Gov3_COMPU_VTAB_REF /end COMPU_METHOD
/begin COMPU_VTAB maxgvspk_TSC_Gov3_COMPU_VTAB_REF "Verbal Table" TAB_VERB 2 0 "Normal Max Gov" 1 "Use Gov3 Settings" DEFAULT_VALUE "UNKNOWN" /end COMPU_VTAB
/begin CHARACTERISTIC CAN1_term_ena "CAN1 termination{CAN1_term_ena&0xff=0:Termination OFF}{CAN1_term_ena&0xff=1:Termination ON}{CAN1_term_ena&0xff=2:Auto default OFF}{CAN1_term_ena&0xff=3:Auto default ON}" VALUE 0x00148566 /* @ECU_Address@CAN1_term_ena@0x01004F78@ */ ECIPP_ALIGNMENT_UBYTE 255 CAN1_term_ena_COMPU_VTAB 0 255 BIT_MASK 0xff /end CHARACTERISTIC
/begin COMPU_METHOD CAN1_term_ena_COMPU_VTAB "Verbal Table" TAB_VERB "%.0" "list" COMPU_TAB_REF CAN1_term_ena_COMPU_VTAB_REF /end COMPU_METHOD
/begin COMPU_VTAB CAN1_term_ena_COMPU_VTAB_REF "Verbal Table" TAB_VERB 4 0 "Termination OFF" 1 "Termination ON" 2 "Auto default OFF" 3 "Auto default ON" DEFAULT_VALUE "UNKNOWN" /end COMPU_VTAB
/begin CHARACTERISTIC CAN2_term_ena "CAN2 termination{CAN2_term_ena&0xff=0:Termination OFF}{CAN2_term_ena&0xff=1:Termination ON}{CAN2_term_ena&0xff=2:Auto default OFF}{CAN2_term_ena&0xff=3:Auto default ON}" VALUE 0x001488FE /* @ECU_Address@CAN2_term_ena@0x01004F80@ */ ECIPP_ALIGNMENT_UBYTE 255 CAN2_term_ena_COMPU_VTAB 0 255 BIT_MASK 0xff /end CHARACTERISTIC
/begin COMPU_METHOD CAN2_term_ena_COMPU_VTAB "Verbal Table" TAB_VERB "%.0" "list" COMPU_TAB_REF CAN2_term_ena_COMPU_VTAB_REF /end COMPU_METHOD
/begin COMPU_VTAB CAN2_term_ena_COMPU_VTAB_REF "Verbal Table" TAB_VERB 4 0 "Termination OFF" 1 "Termination ON" 2 "Auto default OFF" 3 "Auto default ON" DEFAULT_VALUE "UNKNOWN" /end COMPU_VTAB
/begin CHARACTERISTIC CLNG_rst_postcat "Postcat inactive delta-phi reset{CLNG_rst_postcat&0xff=0:Do not reset}{CLNG_rst_postcat&0xff=1:Reset temporarily}{CLNG_rst_postcat&0xff=2:Reset completely}" VALUE 0x0014288B /* @ECU_Address@CLNG_rst_postcat@0x01005058@ */ ECIPP_ALIGNMENT_UBYTE 255 CLNG_rst_postcat_COMPU_VTAB 0 255 BIT_MASK 0xff /end CHARACTERISTIC
/begin COMPU_METHOD CLNG_rst_postcat_COMPU_VTAB "Verbal Table" TAB_VERB "%.0" "list" COMPU_TAB_REF CLNG_rst_postcat_COMPU_VTAB_REF /end COMPU_METHOD
/begin COMPU_VTAB CLNG_rst_postcat_COMPU_VTAB_REF "Verbal Table" TAB_VERB 3 0 "Do not reset" 1 "Reset temporarily" 2 "Reset completely" DEFAULT_VALUE "UNKNOWN" /end COMPU_VTAB
/begin MEASUREMENT RMT_stop_occurred "Remote engine stop log{RMT_stop_occurred&0xff=0:Inactive}{RMT_stop_occurred&0xff=1:Caused Engine Stop}" UBYTE RMT_stop_occurred_COMPU_VTAB 0 0 0 255 ECU_ADDRESS 0x01005060 BIT_MASK 0xff /end MEASUREMENT
/begin COMPU_METHOD RMT_stop_occurred_COMPU_VTAB "Verbal Table" TAB_VERB "%.0" "list" COMPU_TAB_REF RMT_stop_occurred_COMPU_VTAB_REF /end COMPU_METHOD
/begin COMPU_VTAB RMT_stop_occurred_COMPU_VTAB_REF "Verbal Table" TAB_VERB 2 0 "Inactive" 1 "Caused Engine Stop" DEFAULT_VALUE "UNKNOWN" /end COMPU_VTAB
/begin MEASUREMENT RMT_stop "Remote engine stop request{RMT_stop&0xff=0:Inactive}{RMT_stop&0xff=1:Requesting Stop}" UBYTE RMT_stop_COMPU_VTAB 0 0 0 255 ECU_ADDRESS 0x01005068 BIT_MASK 0xff /end MEASUREMENT
/begin COMPU_METHOD RMT_stop_COMPU_VTAB "Verbal Table" TAB_VERB "%.0" "list" COMPU_TAB_REF RMT_stop_COMPU_VTAB_REF /end COMPU_METHOD
/begin COMPU_VTAB RMT_stop_COMPU_VTAB_REF "Verbal Table" TAB_VERB 2 0 "Inactive" 1 "Requesting Stop" DEFAULT_VALUE "UNKNOWN" /end COMPU_VTAB
/begin MEASUREMENT RMT_ctl_STOP "RMT_ctl_STOP{RMT_ctl_STOP&0x80=0x00:OFF}{RMT_ctl_STOP&0x80=0x80:ON}" UBYTE RMT_ctl_STOP_COMPU_VTAB 0 0 0 255 ECU_ADDRESS 0x01005070 BIT_MASK 0xFF /end MEASUREMENT
/begin COMPU_METHOD RMT_ctl_STOP_COMPU_VTAB "Verbal Table" TAB_VERB "%.0" "list" COMPU_TAB_REF RMT_ctl_STOP_COMPU_VTAB_REF /end COMPU_METHOD
/begin COMPU_VTAB RMT_ctl_STOP_COMPU_VTAB_REF "Verbal Table" TAB_VERB 2 0x00 "OFF" 0x80 "ON" DEFAULT_VALUE "Unsupported Bit_Shift" /end COMPU_VTAB
/begin MEASUREMENT J1939_reload "CAN1 Refresh{J1939_reload&0xff=0:Refresh CAN1 Config}{J1939_reload&0xff=1:Refreshing CAN1 ...}" UBYTE J1939_reload_COMPU_VTAB 0 0 0 255 ECU_ADDRESS 0x01005328 BIT_MASK 0xff /end MEASUREMENT
/begin COMPU_METHOD J1939_reload_COMPU_VTAB "Verbal Table" TAB_VERB "%.0" "list" COMPU_TAB_REF J1939_reload_COMPU_VTAB_REF /end COMPU_METHOD
/begin COMPU_VTAB J1939_reload_COMPU_VTAB_REF "Verbal Table" TAB_VERB 2 0 "Refresh CAN1 Config" 1 "Refreshing CAN1 ..." DEFAULT_VALUE "UNKNOWN" /end COMPU_VTAB
/begin CHARACTERISTIC J1939_MIL_ena "J1939 MIL{J1939_MIL_ena&0xff=0:Disabled}{J1939_MIL_ena&0xff=1:Enabled}" VALUE 0x00147df0 /* @ECU_Address@J1939_MIL_ena@0x010059D0@ */ ECIPP_ALIGNMENT_UBYTE 255 J1939_MIL_ena_COMPU_VTAB 0 255 BIT_MASK 0xff /end CHARACTERISTIC
/begin COMPU_METHOD J1939_MIL_ena_COMPU_VTAB "Verbal Table" TAB_VERB "%.0" "list" COMPU_TAB_REF J1939_MIL_ena_COMPU_VTAB_REF /end COMPU_METHOD
/begin COMPU_VTAB J1939_MIL_ena_COMPU_VTAB_REF "Verbal Table" TAB_VERB 2 0 "Disabled" 1 "Enabled" DEFAULT_VALUE "UNKNOWN" /end COMPU_VTAB
/begin CHARACTERISTIC TSC_limit_trq "TSC torque control mode{TSC_limit_trq&0xff=0:Full authority}{TSC_limit_trq&0xff=1:Limit only}" VALUE 0x001480bb /* @ECU_Address@TSC_limit_trq@0x01005DC8@ */ ECIPP_ALIGNMENT_UBYTE 255 TSC_limit_trq_COMPU_VTAB 0 255 BIT_MASK 0xff /end CHARACTERISTIC
/begin COMPU_METHOD TSC_limit_trq_COMPU_VTAB "Verbal Table" TAB_VERB "%.0" "list" COMPU_TAB_REF TSC_limit_trq_COMPU_VTAB_REF /end COMPU_METHOD
/begin COMPU_VTAB TSC_limit_trq_COMPU_VTAB_REF "Verbal Table" TAB_VERB 2 0 "Full authority" 1 "Limit only" DEFAULT_VALUE "UNKNOWN" /end COMPU_VTAB
/begin MEASUREMENT RMT_ctl_TRQ "RMT_ctl_TRQ{RMT_ctl_TRQ&0x40=0x00:OFF}{RMT_ctl_TRQ&0x40=0x40:ON}" UBYTE RMT_ctl_TRQ_COMPU_VTAB 0 0 0 255 ECU_ADDRESS 0x01005DD0 BIT_MASK 0x40 /end MEASUREMENT
/begin COMPU_METHOD RMT_ctl_TRQ_COMPU_VTAB "Verbal Table" TAB_VERB "%.0" "list" COMPU_TAB_REF RMT_ctl_TRQ_COMPU_VTAB_REF /end COMPU_METHOD
/begin COMPU_VTAB RMT_ctl_TRQ_COMPU_VTAB_REF "Verbal Table" TAB_VERB 2 0x00 "OFF" 0x40 "ON" DEFAULT_VALUE "UNKNOWN" /end COMPU_VTAB
/begin MEASUREMENT ADDRCLAIM2_cnt "Address claim activity" UBYTE Compu_ADDRCLAIM2_cnt 0 0 0 255 ECU_ADDRESS 0x01005EA8 /end MEASUREMENT
/begin COMPU_METHOD Compu_ADDRCLAIM2_cnt " " RAT_FUNC "%.0" "count" COEFFS 0 1 0 0 0 1 /end COMPU_METHOD
/begin MEASUREMENT J1939_addr2_conflict "J1939 address conflict counter" UBYTE Compu_J1939_addr2_conflict 0 0 0 255 ECU_ADDRESS 0x01005EB0 /end MEASUREMENT
/begin COMPU_METHOD Compu_J1939_addr2_conflict " " RAT_FUNC "%.0" "count" COEFFS 0 1 0 0 0 1 /end COMPU_METHOD
/begin CHARACTERISTIC CLNG_TD_mdota "CL acquire min port air flow rate" VALUE 0x00142886 /* @ECU_Address@CLNG_TD_mdota@0x01005EC8@ */ ECIPP_ALIGNMENT_UWORD 1024 Compu_CLNG_TD_mdota 0 1023.984375 /end CHARACTERISTIC
/begin COMPU_METHOD Compu_CLNG_TD_mdota " " RAT_FUNC "%.1" "g/sec" COEFFS 0 64 0 0 0 1 /end COMPU_METHOD
/begin CHARACTERISTIC J1939_ena3 "CAN3 channel{J1939_ena3&0xff=0:Disabled}{J1939_ena3&0xff=1:Enabled}" VALUE 0x00148C92 /* @ECU_Address@J1939_ena3@0x010063E0@ */ ECIPP_ALIGNMENT_UBYTE 255 J1939_ena3_COMPU_VTAB 0 255 BIT_MASK 0xff /end CHARACTERISTIC
/begin COMPU_METHOD J1939_ena3_COMPU_VTAB "Verbal Table" TAB_VERB "%.0" "list" COMPU_TAB_REF J1939_ena3_COMPU_VTAB_REF /end COMPU_METHOD
/begin COMPU_VTAB J1939_ena3_COMPU_VTAB_REF "Verbal Table" TAB_VERB 2 0 "Disabled" 1 "Enabled" DEFAULT_VALUE "UNKNOWN" /end COMPU_VTAB
/begin CHARACTERISTIC CCP3_allow "CCP3 comm processing{CCP3_allow&0xff=0:Disabled}{CCP3_allow&0xff=1:Enabled}" VALUE 0x00148C93 /* @ECU_Address@CCP3_allow@0x010063E8@ */ ECIPP_ALIGNMENT_UBYTE 255 CCP3_allow_COMPU_VTAB 0 255 BIT_MASK 0xff /end CHARACTERISTIC
/begin COMPU_METHOD CCP3_allow_COMPU_VTAB "Verbal Table" TAB_VERB "%.0" "list" COMPU_TAB_REF CCP3_allow_COMPU_VTAB_REF /end COMPU_METHOD
/begin COMPU_VTAB CCP3_allow_COMPU_VTAB_REF "Verbal Table" TAB_VERB 2 0 "Disabled" 1 "Enabled" DEFAULT_VALUE "UNKNOWN" /end COMPU_VTAB
/begin CHARACTERISTIC CAN3_speed "CAN3 link speed{CAN3_speed&0xff=0:125 Kbaud}{CAN3_speed&0xff=1:250 Kbaud (J1939)}{CAN3_speed&0xff=2:500 Kbaud}{CAN3_speed&0xff=3:1000 Kbaud}" VALUE 0x00148C95 /* @ECU_Address@CAN3_speed@0x010063F0@ */ ECIPP_ALIGNMENT_UBYTE 255 CAN3_speed_COMPU_VTAB 0 255 BIT_MASK 0xff /end CHARACTERISTIC
/begin COMPU_METHOD CAN3_speed_COMPU_VTAB "Verbal Table" TAB_VERB "%.0" "list" COMPU_TAB_REF CAN3_speed_COMPU_VTAB_REF /end COMPU_METHOD
/begin COMPU_VTAB CAN3_speed_COMPU_VTAB_REF "Verbal Table" TAB_VERB 4 0 "125 Kbaud" 1 "250 Kbaud (J1939)" 2 "500 Kbaud" 3 "1000 Kbaud" DEFAULT_VALUE "UNKNOWN" /end COMPU_VTAB
/begin CHARACTERISTIC CAN3_term_ena "CAN3 termination{CAN3_term_ena&0xff=0:Termination OFF}{CAN3_term_ena&0xff=1:Termination ON}{CAN3_term_ena&0xff=2:Auto default OFF}{CAN3_term_ena&0xff=3:Auto default ON}" VALUE 0x00148C96 /* @ECU_Address@CAN3_term_ena@0x010063F8@ */ ECIPP_ALIGNMENT_UBYTE 255 CAN3_term_ena_COMPU_VTAB 0 255 BIT_MASK 0xff /end CHARACTERISTIC
/begin COMPU_METHOD CAN3_term_ena_COMPU_VTAB "Verbal Table" TAB_VERB "%.0" "list" COMPU_TAB_REF CAN3_term_ena_COMPU_VTAB_REF /end COMPU_METHOD
/begin COMPU_VTAB CAN3_term_ena_COMPU_VTAB_REF "Verbal Table" TAB_VERB 4 0 "Termination OFF" 1 "Termination ON" 2 "Auto default OFF" 3 "Auto default ON" DEFAULT_VALUE "UNKNOWN" /end COMPU_VTAB
/begin CHARACTERISTIC J1939_addr3_frcena "CAN3 J1939 address selection{J1939_addr3_frcena&0xff=0:Engine Number Based}{J1939_addr3_frcena&0xff=1:Force Constant Value}" VALUE 0x00148C97 /* @ECU_Address@J1939_addr3_frcena@0x01006400@ */ ECIPP_ALIGNMENT_UBYTE 255 J1939_addr3_frcena_COMPU_VTAB 0 255 BIT_MASK 0xff /end CHARACTERISTIC
/begin COMPU_METHOD J1939_addr3_frcena_COMPU_VTAB "Verbal Table" TAB_VERB "%.0" "list" COMPU_TAB_REF J1939_addr3_frcena_COMPU_VTAB_REF /end COMPU_METHOD
/begin COMPU_VTAB J1939_addr3_frcena_COMPU_VTAB_REF "Verbal Table" TAB_VERB 2 0 "Engine Number Based" 1 "Force Constant Value" DEFAULT_VALUE "UNKNOWN" /end COMPU_VTAB
/begin CHARACTERISTIC J1939_addr3_frcval "CAN3 J1939 address forced value" VALUE 0x00148C98 /* @ECU_Address@J1939_addr3_frcval@0x01006408@ */ ECIPP_ALIGNMENT_UBYTE 255 Compu_J1939_addr3_frcval 0 255 /end CHARACTERISTIC
/begin COMPU_METHOD Compu_J1939_addr3_frcval " " RAT_FUNC "%.0" "-" COEFFS 0 1 0 0 0 1 /end COMPU_METHOD
/begin CHARACTERISTIC J1939EC_broad3_ena "J1939-3 Engine Configuration (EC) broadcast{J1939EC_broad3_ena&0xff=0:Disabled}{J1939EC_broad3_ena&0xff=1:Enabled = Engine Config}{J1939EC_broad3_ena&0xff=2:Enabled = Retard Config}{J1939EC_broad3_ena&0xff=3:Enabled = Engine + Retard Config}" VALUE 0x00148C99 /* @ECU_Address@J1939EC_broad3_ena@0x01006410@ */ ECIPP_ALIGNMENT_UBYTE 255 J1939EC_broad3_ena_COMPU_VTAB 0 255 BIT_MASK 0xff /end CHARACTERISTIC
/begin COMPU_METHOD J1939EC_broad3_ena_COMPU_VTAB "Verbal Table" TAB_VERB "%.0" "list" COMPU_TAB_REF J1939EC_broad3_ena_COMPU_VTAB_REF /end COMPU_METHOD
/begin COMPU_VTAB J1939EC_broad3_ena_COMPU_VTAB_REF "Verbal Table" TAB_VERB 4 0 "Disabled" 1 "Enabled = Engine Config" 2 "Enabled = Retard Config" 3 "Enabled = Engine + Retard Config" DEFAULT_VALUE "UNKNOWN" /end COMPU_VTAB
/begin CHARACTERISTIC CCP2_allow "CCP2 comm processing{CCP2_allow&0xff=0:Disabled}{CCP2_allow&0xff=1:Enabled}" VALUE 0x001488FB /* @ECU_Address@CCP2_allow@0x01006428@ */ ECIPP_ALIGNMENT_UBYTE 255 CCP2_allow_COMPU_VTAB 0 255 BIT_MASK 0xff /end CHARACTERISTIC
/begin COMPU_METHOD CCP2_allow_COMPU_VTAB "Verbal Table" TAB_VERB "%.0" "list" COMPU_TAB_REF CCP2_allow_COMPU_VTAB_REF /end COMPU_METHOD
/begin COMPU_VTAB CCP2_allow_COMPU_VTAB_REF "Verbal Table" TAB_VERB 2 0 "Disabled" 1 "Enabled" DEFAULT_VALUE "UNKNOWN" /end COMPU_VTAB
/begin CHARACTERISTIC J1939EC_broad2_ena "J1939-2 Engine Configuration (EC) broadcast{J1939EC_broad2_ena&0xff=0:Disabled}{J1939EC_broad2_ena&0xff=1:Enabled = Engine Config}{J1939EC_broad2_ena&0xff=2:Enabled = Retard Config}{J1939EC_broad2_ena&0xff=3:Enabled = Engine + Retard Config}" VALUE 0x00148901 /* @ECU_Address@J1939EC_broad2_ena@0x01006430@ */ ECIPP_ALIGNMENT_UBYTE 255 J1939EC_broad2_ena_COMPU_VTAB 0 255 BIT_MASK 0xff /end CHARACTERISTIC
/begin COMPU_METHOD J1939EC_broad2_ena_COMPU_VTAB "Verbal Table" TAB_VERB "%.0" "list" COMPU_TAB_REF J1939EC_broad2_ena_COMPU_VTAB_REF /end COMPU_METHOD
/begin COMPU_VTAB J1939EC_broad2_ena_COMPU_VTAB_REF "Verbal Table" TAB_VERB 4 0 "Disabled" 1 "Enabled = Engine Config" 2 "Enabled = Retard Config" 3 "Enabled = Engine + Retard Config" DEFAULT_VALUE "UNKNOWN" /end COMPU_VTAB
/begin CHARACTERISTIC J1939_addr2Fail "J1939-2 address conflict fail limit (Fault Condition:Address conflict counter >)" VALUE 0x00148904 /* @ECU_Address@J1939_addr2Fail@0x01006510@ */ ECIPP_ALIGNMENT_UBYTE 255 Compu_J1939_addr2Fail 0 255 /end CHARACTERISTIC
/begin COMPU_METHOD Compu_J1939_addr2Fail " " RAT_FUNC "%.0" "failures" COEFFS 0 1 0 0 0 1 /end COMPU_METHOD
/begin CHARACTERISTIC J1939_addr3Fail "J1939-3 address conflict fail limit (Fault Condition:Address conflict counter >)" VALUE 0x00148C9C /* @ECU_Address@J1939_addr3Fail@0x01006528@ */ ECIPP_ALIGNMENT_UBYTE 255 Compu_J1939_addr3Fail 0 255 /end CHARACTERISTIC
/begin COMPU_METHOD Compu_J1939_addr3Fail " " RAT_FUNC "%.0" "failures" COEFFS 0 1 0 0 0 1 /end COMPU_METHOD
/begin MEASUREMENT CCP2_session_actv "CCP2 session state{CCP2_session_actv&0xff=0:Inactive}{CCP2_session_actv&0xff=1:Active}" UBYTE CCP2_session_actv_COMPU_VTAB 0 0 0 255 ECU_ADDRESS 0x01006530 BIT_MASK 0xff /end MEASUREMENT
/begin COMPU_METHOD CCP2_session_actv_COMPU_VTAB "Verbal Table" TAB_VERB "%.0" "list" COMPU_TAB_REF CCP2_session_actv_COMPU_VTAB_REF /end COMPU_METHOD
/begin COMPU_VTAB CCP2_session_actv_COMPU_VTAB_REF "Verbal Table" TAB_VERB 2 0 "Inactive" 1 "Active" DEFAULT_VALUE "UNKNOWN" /end COMPU_VTAB
/begin MEASUREMENT CCP3_session_actv "CCP3 session state{CCP3_session_actv&0xff=0:Inactive}{CCP3_session_actv&0xff=1:Active}" UBYTE CCP3_session_actv_COMPU_VTAB 0 0 0 255 ECU_ADDRESS 0x01006538 BIT_MASK 0xff /end MEASUREMENT
/begin COMPU_METHOD CCP3_session_actv_COMPU_VTAB "Verbal Table" TAB_VERB "%.0" "list" COMPU_TAB_REF CCP3_session_actv_COMPU_VTAB_REF /end COMPU_METHOD
/begin COMPU_VTAB CCP3_session_actv_COMPU_VTAB_REF "Verbal Table" TAB_VERB 2 0 "Inactive" 1 "Active" DEFAULT_VALUE "UNKNOWN" /end COMPU_VTAB
/begin MEASUREMENT J1939_addr3_latch "CAN3 current J1939 address" UBYTE Compu_J1939_addr3_latch 0 0 0 255 ECU_ADDRESS 0x01006540 /end MEASUREMENT
/begin COMPU_METHOD Compu_J1939_addr3_latch " " RAT_FUNC "%.0" "-" COEFFS 0 1 0 0 0 1 /end COMPU_METHOD
/begin MEASUREMENT CAN3_Rx_packs "CAN3 Rx packets" ULONG Compu_CAN3_Rx_packs 0 0 0 4294967295 ECU_ADDRESS 0x01006548 /end MEASUREMENT
/begin COMPU_METHOD Compu_CAN3_Rx_packs " " RAT_FUNC "%.0" "-" COEFFS 0 1 0 0 0 1 /end COMPU_METHOD
/begin MEASUREMENT CAN3_Tx_packs "CAN3 Tx packets" ULONG Compu_CAN3_Tx_packs 0 0 0 4294967295 ECU_ADDRESS 0x01006550 /end MEASUREMENT
/begin COMPU_METHOD Compu_CAN3_Tx_packs " " RAT_FUNC "%.0" "-" COEFFS 0 1 0 0 0 1 /end COMPU_METHOD
/begin MEASUREMENT CCP2_CR_counter "CCP CR (Rx) packets - CAN2" ULONG Compu_CCP2_CR_counter 0 0 0 4294967295 ECU_ADDRESS 0x01006558 /end MEASUREMENT
/begin COMPU_METHOD Compu_CCP2_CR_counter " " RAT_FUNC "%.0" "count" COEFFS 0 1 0 0 0 1 /end COMPU_METHOD
/begin MEASUREMENT CCP2_DT_counter "CCP DT (Tx) packets - CAN2" ULONG Compu_CCP2_DT_counter 0 0 0 4294967295 ECU_ADDRESS 0x01006560 /end MEASUREMENT
/begin COMPU_METHOD Compu_CCP2_DT_counter " " RAT_FUNC "%.0" "count" COEFFS 0 1 0 0 0 1 /end COMPU_METHOD
/begin MEASUREMENT CCP3_CR_counter "CCP CR (Rx) packets - CAN3" ULONG Compu_CCP3_CR_counter 0 0 0 4294967295 ECU_ADDRESS 0x01006568 /end MEASUREMENT
/begin COMPU_METHOD Compu_CCP3_CR_counter " " RAT_FUNC "%.0" "count" COEFFS 0 1 0 0 0 1 /end COMPU_METHOD
/begin MEASUREMENT CCP3_DT_counter "CCP DT (Tx) packets - CAN3" ULONG Compu_CCP3_DT_counter 0 0 0 4294967295 ECU_ADDRESS 0x01006570 /end MEASUREMENT
/begin COMPU_METHOD Compu_CCP3_DT_counter " " RAT_FUNC "%.0" "count" COEFFS 0 1 0 0 0 1 /end COMPU_METHOD
/begin MEASUREMENT J1939_addr3_conflict "J1939-3 address conflict counter" UBYTE Compu_J1939_addr3_conflict 0 0 0 255 ECU_ADDRESS 0x01006578 /end MEASUREMENT
/begin COMPU_METHOD Compu_J1939_addr3_conflict " " RAT_FUNC "%.0" "count" COEFFS 0 1 0 0 0 1 /end COMPU_METHOD
/begin MEASUREMENT ADDRCLAIM3_cnt "Address claim activity" UBYTE Compu_ADDRCLAIM3_cnt 0 0 0 255 ECU_ADDRESS 0x01006580 /end MEASUREMENT
/begin COMPU_METHOD Compu_ADDRCLAIM3_cnt " " RAT_FUNC "%.0" "count" COEFFS 0 1 0 0 0 1 /end COMPU_METHOD
/begin MEASUREMENT PGrq2_cnt "PGN2 req activity" UBYTE Compu_PGrq2_cnt 0 0 0 255 ECU_ADDRESS 0x01006588 /end MEASUREMENT
/begin COMPU_METHOD Compu_PGrq2_cnt " " RAT_FUNC "%.0" "count" COEFFS 0 1 0 0 0 1 /end COMPU_METHOD
/begin MEASUREMENT DENIED2_cnt "DENIED2 activity" UBYTE Compu_DENIED2_cnt 0 0 0 255 ECU_ADDRESS 0x01006590 /end MEASUREMENT
/begin COMPU_METHOD Compu_DENIED2_cnt " " RAT_FUNC "%.0" "count" COEFFS 0 1 0 0 0 1 /end COMPU_METHOD
/begin MEASUREMENT NACK2_cnt "NACK2 activity" UBYTE Compu_NACK2_cnt 0 0 0 255 ECU_ADDRESS 0x01006598 /end MEASUREMENT
/begin COMPU_METHOD Compu_NACK2_cnt " " RAT_FUNC "%.0" "count" COEFFS 0 1 0 0 0 1 /end COMPU_METHOD
/begin MEASUREMENT PGRx2_cnt "Incoming PGN Rx2 activity" UBYTE Compu_PGRx2_cnt 0 0 0 255 ECU_ADDRESS 0x010065A0 /end MEASUREMENT
/begin COMPU_METHOD Compu_PGRx2_cnt " " RAT_FUNC "%.0" "count" COEFFS 0 1 0 0 0 1 /end COMPU_METHOD
/begin MEASUREMENT PGrq3_cnt "PGN3 req activity" UBYTE Compu_PGrq3_cnt 0 0 0 255 ECU_ADDRESS 0x010065A8 /end MEASUREMENT
/begin COMPU_METHOD Compu_PGrq3_cnt " " RAT_FUNC "%.0" "count" COEFFS 0 1 0 0 0 1 /end COMPU_METHOD
/begin MEASUREMENT DENIED3_cnt "DENIED3 activity" UBYTE Compu_DENIED3_cnt 0 0 0 255 ECU_ADDRESS 0x010065B0 /end MEASUREMENT
/begin COMPU_METHOD Compu_DENIED3_cnt " " RAT_FUNC "%.0" "count" COEFFS 0 1 0 0 0 1 /end COMPU_METHOD
/begin MEASUREMENT NACK3_cnt "NACK3 activity" UBYTE Compu_NACK3_cnt 0 0 0 255 ECU_ADDRESS 0x010065B8 /end MEASUREMENT
/begin COMPU_METHOD Compu_NACK3_cnt " " RAT_FUNC "%.0" "count" COEFFS 0 1 0 0 0 1 /end COMPU_METHOD
/begin MEASUREMENT PGRx3_cnt "Incoming PGN Rx3 activity" UBYTE Compu_PGRx3_cnt 0 0 0 255 ECU_ADDRESS 0x010065C0 /end MEASUREMENT
/begin COMPU_METHOD Compu_PGRx3_cnt " " RAT_FUNC "%.0" "count" COEFFS 0 1 0 0 0 1 /end COMPU_METHOD
/begin MEASUREMENT PGrq2_last_SA "Last PGN req2 SA" UBYTE Compu_PGrq2_last_SA 0 0 0 255 ECU_ADDRESS 0x010065D0 /end MEASUREMENT
/begin COMPU_METHOD Compu_PGrq2_last_SA " " RAT_FUNC "%.0" "SA" COEFFS 0 1 0 0 0 1 /end COMPU_METHOD
/begin MEASUREMENT PGrq2_last_RA "Last PGN req2 RA" UBYTE Compu_PGrq2_last_RA 0 0 0 255 ECU_ADDRESS 0x010065D8 /end MEASUREMENT
/begin COMPU_METHOD Compu_PGrq2_last_RA " " RAT_FUNC "%.0" "RA" COEFFS 0 1 0 0 0 1 /end COMPU_METHOD
/begin MEASUREMENT NACK2_last_SA "Last NACK2 SA" UBYTE Compu_NACK2_last_SA 0 0 0 255 ECU_ADDRESS 0x010065E8 /end MEASUREMENT
/begin COMPU_METHOD Compu_NACK2_last_SA " " RAT_FUNC "%.0" "SA" COEFFS 0 1 0 0 0 1 /end COMPU_METHOD
/begin MEASUREMENT NACK2_last_RA "Last NACK2 RA" UBYTE Compu_NACK2_last_RA 0 0 0 255 ECU_ADDRESS 0x010065F0 /end MEASUREMENT
/begin COMPU_METHOD Compu_NACK2_last_RA " " RAT_FUNC "%.0" "RA" COEFFS 0 1 0 0 0 1 /end COMPU_METHOD
/begin MEASUREMENT DENIED2_last_SA "Last DENIED2 SA" UBYTE Compu_DENIED2_last_SA 0 0 0 255 ECU_ADDRESS 0x01006600 /end MEASUREMENT
/begin COMPU_METHOD Compu_DENIED2_last_SA " " RAT_FUNC "%.0" "SA" COEFFS 0 1 0 0 0 1 /end COMPU_METHOD
/begin MEASUREMENT DENIED2_last_RA "Last DENIED2 RA" UBYTE Compu_DENIED2_last_RA 0 0 0 255 ECU_ADDRESS 0x01006608 /end MEASUREMENT
/begin COMPU_METHOD Compu_DENIED2_last_RA " " RAT_FUNC "%.0" "RA" COEFFS 0 1 0 0 0 1 /end COMPU_METHOD
/begin MEASUREMENT PGrq3_last_SA "Last PGN req3 SA" UBYTE Compu_PGrq3_last_SA 0 0 0 255 ECU_ADDRESS 0x01006618 /end MEASUREMENT
/begin COMPU_METHOD Compu_PGrq3_last_SA " " RAT_FUNC "%.0" "SA" COEFFS 0 1 0 0 0 1 /end COMPU_METHOD
/begin MEASUREMENT PGrq3_last_RA "Last PGN req3 RA" UBYTE Compu_PGrq3_last_RA 0 0 0 255 ECU_ADDRESS 0x01006620 /end MEASUREMENT
/begin COMPU_METHOD Compu_PGrq3_last_RA " " RAT_FUNC "%.0" "RA" COEFFS 0 1 0 0 0 1 /end COMPU_METHOD
/begin MEASUREMENT NACK3_last_SA "Last NACK3 SA" UBYTE Compu_NACK3_last_SA 0 0 0 255 ECU_ADDRESS 0x01006630 /end MEASUREMENT
/begin COMPU_METHOD Compu_NACK3_last_SA " " RAT_FUNC "%.0" "SA" COEFFS 0 1 0 0 0 1 /end COMPU_METHOD
/begin MEASUREMENT NACK3_last_RA "Last NACK3 RA" UBYTE Compu_NACK3_last_RA 0 0 0 255 ECU_ADDRESS 0x01006638 /end MEASUREMENT
/begin COMPU_METHOD Compu_NACK3_last_RA " " RAT_FUNC "%.0" "RA" COEFFS 0 1 0 0 0 1 /end COMPU_METHOD
/begin MEASUREMENT DENIED3_last_SA "Last DENIED3 SA" UBYTE Compu_DENIED3_last_SA 0 0 0 255 ECU_ADDRESS 0x01006648 /end MEASUREMENT
/begin COMPU_METHOD Compu_DENIED3_last_SA " " RAT_FUNC "%.0" "SA" COEFFS 0 1 0 0 0 1 /end COMPU_METHOD
/begin MEASUREMENT DENIED3_last_RA "Last DENIED3 RA" UBYTE Compu_DENIED3_last_RA 0 0 0 255 ECU_ADDRESS 0x01006650 /end MEASUREMENT
/begin COMPU_METHOD Compu_DENIED3_last_RA " " RAT_FUNC "%.0" "RA" COEFFS 0 1 0 0 0 1 /end COMPU_METHOD
/begin MEASUREMENT J1939_reload2 "CAN2 Refresh{J1939_reload2&0xff=0:Refresh CAN2 Config}{J1939_reload2&0xff=1:Refreshing CAN2 ...}" UBYTE J1939_reload2_COMPU_VTAB 0 0 0 255 ECU_ADDRESS 0x01006658 BIT_MASK 0xff /end MEASUREMENT
/begin COMPU_METHOD J1939_reload2_COMPU_VTAB "Verbal Table" TAB_VERB "%.0" "list" COMPU_TAB_REF J1939_reload2_COMPU_VTAB_REF /end COMPU_METHOD
/begin COMPU_VTAB J1939_reload2_COMPU_VTAB_REF "Verbal Table" TAB_VERB 2 0 "Refresh CAN2 Config" 1 "Refreshing CAN2 ..." DEFAULT_VALUE "UNKNOWN" /end COMPU_VTAB
/begin MEASUREMENT J1939_reload3 "CAN3 Refresh{J1939_reload3&0xff=0:Refresh CAN3 Config}{J1939_reload3&0xff=1:Refreshing CAN3 ...}" UBYTE J1939_reload3_COMPU_VTAB 0 0 0 255 ECU_ADDRESS 0x01006660 BIT_MASK 0xff /end MEASUREMENT
/begin COMPU_METHOD J1939_reload3_COMPU_VTAB "Verbal Table" TAB_VERB "%.0" "list" COMPU_TAB_REF J1939_reload3_COMPU_VTAB_REF /end COMPU_METHOD
/begin COMPU_VTAB J1939_reload3_COMPU_VTAB_REF "Verbal Table" TAB_VERB 2 0 "Refresh CAN3 Config" 1 "Refreshing CAN3 ..." DEFAULT_VALUE "UNKNOWN" /end COMPU_VTAB
/begin MEASUREMENT RMT_load "Remote net torque request" SWORD Compu_RMT_load 0 0 -200 199.993896484375 ECU_ADDRESS 0x01006750 /end MEASUREMENT
/begin COMPU_METHOD Compu_RMT_load " " RAT_FUNC "%.1" "%" COEFFS 0 163.84 0 0 0 1 /end COMPU_METHOD
/begin MEASUREMENT RMT_IVS_atidle "Remote IVS at-idle{RMT_IVS_atidle&0xff=0x00:Off Idle}{RMT_IVS_atidle&0xff=0x01:At Idle}" UBYTE RMT_IVS_atidle_COMPU_VTAB 0 0 0 255 ECU_ADDRESS 0x01006868 BIT_MASK 0xff /end MEASUREMENT
/begin COMPU_METHOD RMT_IVS_atidle_COMPU_VTAB "Verbal Table" TAB_VERB "%.0" "list" COMPU_TAB_REF RMT_IVS_atidle_COMPU_VTAB_REF /end COMPU_METHOD
/begin COMPU_VTAB RMT_IVS_atidle_COMPU_VTAB_REF "Verbal Table" TAB_VERB 2 0x00 "Off Idle" 0x01 "At Idle" DEFAULT_VALUE "UNKNOWN" /end COMPU_VTAB
/begin MEASUREMENT RMT_FPP1_raw "Remote FPP1" UWORD Compu_RMT_FPP1_raw 0 0 0 5.00114468864469 ECU_ADDRESS 0x01006870 /end MEASUREMENT
/begin COMPU_METHOD Compu_RMT_FPP1_raw " " RAT_FUNC "%.2" "-" COEFFS 0 13104 0 0 0 1 /end COMPU_METHOD
/begin MEASUREMENT RMT_FPP2_raw "Remote FPP2" UWORD Compu_RMT_FPP2_raw 0 0 0 5.00114468864469 ECU_ADDRESS 0x01006878 /end MEASUREMENT
/begin COMPU_METHOD Compu_RMT_FPP2_raw " " RAT_FUNC "%.2" "-" COEFFS 0 13104 0 0 0 1 /end COMPU_METHOD
/begin MEASUREMENT RMT_ctl_FPPRAW "Remote FPP active{RMT_ctl_FPPRAW&0x20=0x00:Off}{RMT_ctl_FPPRAW&0x20=0x20:On}" UBYTE RMT_ctl_FPPRAW_COMPU_VTAB 0 0 0 255 ECU_ADDRESS 0x01006880 BIT_MASK 0x20 /end MEASUREMENT
/begin COMPU_METHOD RMT_ctl_FPPRAW_COMPU_VTAB "Verbal Table" TAB_VERB "%.0" "list" COMPU_TAB_REF RMT_ctl_FPPRAW_COMPU_VTAB_REF /end COMPU_METHOD
/begin COMPU_VTAB RMT_ctl_FPPRAW_COMPU_VTAB_REF "Verbal Table" TAB_VERB 2 0x00 "Off" 0x20 "On" DEFAULT_VALUE "UNKNOWN" /end COMPU_VTAB
/begin MEASUREMENT SHIFT_Nlock_btn "Shift interlock button{SHIFT_Nlock_btn&0x01=0x00:Off}{SHIFT_Nlock_btn&0x01=0x01:On}" UBYTE SHIFT_Nlock_btn_COMPU_VTAB 0 0 0 255 ECU_ADDRESS 0x010069C0 BIT_MASK 0x01 /end MEASUREMENT
/begin COMPU_METHOD SHIFT_Nlock_btn_COMPU_VTAB "Verbal Table" TAB_VERB "%.0" "list" COMPU_TAB_REF SHIFT_Nlock_btn_COMPU_VTAB_REF /end COMPU_METHOD
/begin COMPU_VTAB SHIFT_Nlock_btn_COMPU_VTAB_REF "Verbal Table" TAB_VERB 2 0x00 "Off" 0x01 "On" DEFAULT_VALUE "UNKNOWN" /end COMPU_VTAB
/begin CHARACTERISTIC MJ_nom_crkslwdN "Cranking final/slewed EPR setpoint" VALUE 0x0014195c /* @ECU_Address@MJ_nom_crkslwdN@0x01006A30@ */ ECIPP_ALIGNMENT_SWORD 222 Compu_MJ_nom_crkslwdN -222 221.993225097656 /end CHARACTERISTIC
/begin COMPU_METHOD Compu_MJ_nom_crkslwdN " " RAT_FUNC "%.2" "in H2O" COEFFS 0 147.603603603604 0 0 0 1 /end COMPU_METHOD
/begin CHARACTERISTIC MJ_crk_holdN "Cranking initial EPR setpoint hold" VALUE 0x00142814 /* @ECU_Address@MJ_crk_holdN@0x01006A48@ */ ECIPP_ALIGNMENT_UWORD 256 Compu_MJ_crk_holdN 0 255.99609375 /end CHARACTERISTIC
/begin COMPU_METHOD Compu_MJ_crk_holdN " " RAT_FUNC "%.2" "cycles" COEFFS 0 256 0 0 0 1 /end COMPU_METHOD
/begin CHARACTERISTIC MJ_crk_slewN "Cranking transition EPR setpoint slew" VALUE 0x00142818 /* @ECU_Address@MJ_crk_slewN@0x01006A50@ */ ECIPP_ALIGNMENT_UWORD 256 Compu_MJ_crk_slewN 0 255.99609375 /end CHARACTERISTIC
/begin COMPU_METHOD Compu_MJ_crk_slewN " " RAT_FUNC "%.2" "cycles" COEFFS 0 256 0 0 0 1 /end COMPU_METHOD
/begin CHARACTERISTIC J1939_DM4_manuf "J1939 DM4 manufacturer proprietary{J1939_DM4_manuf&0xff=0:ECI default}{J1939_DM4_manuf&0xff=1:NMHG custom}" VALUE 0x00147deb /* @ECU_Address@J1939_DM4_manuf@0x01007278@ */ ECIPP_ALIGNMENT_UBYTE 255 J1939_DM4_manuf_COMPU_VTAB 0 255 BIT_MASK 0xff /end CHARACTERISTIC
/begin COMPU_METHOD J1939_DM4_manuf_COMPU_VTAB "Verbal Table" TAB_VERB "%.0" "list" COMPU_TAB_REF J1939_DM4_manuf_COMPU_VTAB_REF /end COMPU_METHOD
/begin COMPU_VTAB J1939_DM4_manuf_COMPU_VTAB_REF "Verbal Table" TAB_VERB 2 0 "ECI default" 1 "NMHG custom" DEFAULT_VALUE "UNKNOWN" /end COMPU_VTAB
/begin CHARACTERISTIC J1939_TSC1_mode "J1939 TSC1 priority{J1939_TSC1_mode&0xff=0:Most recent message}{J1939_TSC1_mode&0xff=1:Lowest speed/torque}" VALUE 0x00147df5 /* @ECU_Address@J1939_TSC1_mode@0x010072C8@ */ ECIPP_ALIGNMENT_UBYTE 255 J1939_TSC1_mode_COMPU_VTAB 0 255 BIT_MASK 0xff /end CHARACTERISTIC
/begin COMPU_METHOD J1939_TSC1_mode_COMPU_VTAB "Verbal Table" TAB_VERB "%.0" "list" COMPU_TAB_REF J1939_TSC1_mode_COMPU_VTAB_REF /end COMPU_METHOD
/begin COMPU_VTAB J1939_TSC1_mode_COMPU_VTAB_REF "Verbal Table" TAB_VERB 2 0 "Most recent message" 1 "Lowest speed/torque" DEFAULT_VALUE "UNKNOWN" /end COMPU_VTAB
/begin MEASUREMENT RMT_speed_lmt "Remote speed limit" UWORD Compu_RMT_speed_lmt 0 0 0 65535 ECU_ADDRESS 0x01007400 /end MEASUREMENT
/begin COMPU_METHOD Compu_RMT_speed_lmt " " RAT_FUNC "%.0" "rpm" COEFFS 0 1 0 0 0 1 /end COMPU_METHOD
/begin MEASUREMENT RMT_torq_lmt "Remote torque limit" SWORD Compu_RMT_torq_lmt 0 0 -200 199.993896484375 ECU_ADDRESS 0x01007408 /end MEASUREMENT
/begin COMPU_METHOD Compu_RMT_torq_lmt " " RAT_FUNC "%.1" "%" COEFFS 0 163.84 0 0 0 1 /end COMPU_METHOD
/begin MEASUREMENT RMT_speed_SA "Remote speed source" UBYTE Compu_RMT_speed_SA 0 0 0 255 ECU_ADDRESS 0x01007410 /end MEASUREMENT
/begin COMPU_METHOD Compu_RMT_speed_SA " " RAT_FUNC "%.0" "-" COEFFS 0 1 0 0 0 1 /end COMPU_METHOD
/begin MEASUREMENT RMT_speed_lmt_SA "Remote speed limit source" UBYTE Compu_RMT_speed_lmt_SA 0 0 0 255 ECU_ADDRESS 0x01007418 /end MEASUREMENT
/begin COMPU_METHOD Compu_RMT_speed_lmt_SA " " RAT_FUNC "%.0" "-" COEFFS 0 1 0 0 0 1 /end COMPU_METHOD
/begin MEASUREMENT RMT_torq_SA "Remote torque source" UBYTE Compu_RMT_torq_SA 0 0 0 255 ECU_ADDRESS 0x01007420 /end MEASUREMENT
/begin COMPU_METHOD Compu_RMT_torq_SA " " RAT_FUNC "%.0" "-" COEFFS 0 1 0 0 0 1 /end COMPU_METHOD
/begin MEASUREMENT RMT_torq_lmt_SA "Remote torque limit source" UBYTE Compu_RMT_torq_lmt_SA 0 0 0 255 ECU_ADDRESS 0x01007428 /end MEASUREMENT
/begin COMPU_METHOD Compu_RMT_torq_lmt_SA " " RAT_FUNC "%.0" "-" COEFFS 0 1 0 0 0 1 /end COMPU_METHOD
/begin MEASUREMENT RMT_load_lmt "Remote load limit" SWORD Compu_RMT_load_lmt 0 0 -200 199.993896484375 ECU_ADDRESS 0x01007430 /end MEASUREMENT
/begin COMPU_METHOD Compu_RMT_load_lmt " " RAT_FUNC "%.1" "%" COEFFS 0 163.84 0 0 0 1 /end COMPU_METHOD
/begin MEASUREMENT RMT_ctl_SPEED_LMT "Remote speed limit active{RMT_ctl_SPEED_LMT&0x20=0x00:OFF}{RMT_ctl_SPEED_LMT&0x20=0x20:ON}" UBYTE RMT_ctl_SPEED_LMT_COMPU_VTAB 0 0 0 255 ECU_ADDRESS 0x01007438 BIT_MASK 0x20 /end MEASUREMENT
/begin COMPU_METHOD RMT_ctl_SPEED_LMT_COMPU_VTAB "Verbal Table" TAB_VERB "%.0" "list" COMPU_TAB_REF RMT_ctl_SPEED_LMT_COMPU_VTAB_REF /end COMPU_METHOD
/begin COMPU_VTAB RMT_ctl_SPEED_LMT_COMPU_VTAB_REF "Verbal Table" TAB_VERB 2 0x00 "OFF" 0x20 "ON" DEFAULT_VALUE "UNKNOWN" /end COMPU_VTAB
/begin MEASUREMENT RMT_ctl_TRQ_LMT "Remote torque limit active{RMT_ctl_TRQ_LMT&0x40=0x00:OFF}{RMT_ctl_TRQ_LMT&0x40=0x40:ON}" UBYTE RMT_ctl_TRQ_LMT_COMPU_VTAB 0 0 0 255 ECU_ADDRESS 0x01007440 BIT_MASK 0x40 /end MEASUREMENT
/begin COMPU_METHOD RMT_ctl_TRQ_LMT_COMPU_VTAB "Verbal Table" TAB_VERB "%.0" "list" COMPU_TAB_REF RMT_ctl_TRQ_LMT_COMPU_VTAB_REF /end COMPU_METHOD
/begin COMPU_VTAB RMT_ctl_TRQ_LMT_COMPU_VTAB_REF "Verbal Table" TAB_VERB 2 0x00 "OFF" 0x40 "ON" DEFAULT_VALUE "UNKNOWN" /end COMPU_VTAB
/begin CHARACTERISTIC MJ_crk_run_slewN "Run mode EPR maximum slew" VALUE 0x00142816 /* @ECU_Address@MJ_crk_run_slewN@0x01007838@ */ ECIPP_ALIGNMENT_UWORD 444 Compu_MJ_crk_run_slewN 0 443.993225097656 /end CHARACTERISTIC
/begin COMPU_METHOD Compu_MJ_crk_run_slewN " " RAT_FUNC "%.2" "H20" COEFFS 0 147.603603603604 0 0 0 1 /end COMPU_METHOD
/begin CHARACTERISTIC J1939_fuel_rate_mode "J1939 engine fuel rate mode{J1939_fuel_rate_mode&0xff=0:Nominal Fuel Flow}{J1939_fuel_rate_mode&0xff=1:CL Corrected Flow}" VALUE 0x00147df9 /* @ECU_Address@J1939_fuel_rate_mode@0x01008CB0@ */ ECIPP_ALIGNMENT_UBYTE 255 J1939_fuel_rate_mode_COMPU_VTAB 0 255 BIT_MASK 0xff /end CHARACTERISTIC
/begin COMPU_METHOD J1939_fuel_rate_mode_COMPU_VTAB "Verbal Table" TAB_VERB "%.0" "list" COMPU_TAB_REF J1939_fuel_rate_mode_COMPU_VTAB_REF /end COMPU_METHOD
/begin COMPU_VTAB J1939_fuel_rate_mode_COMPU_VTAB_REF "Verbal Table" TAB_VERB 2 0 "Nominal Fuel Flow" 1 "CL Corrected Flow" DEFAULT_VALUE "UNKNOWN" /end COMPU_VTAB
/begin CHARACTERISTIC J1939_fuel_rate_mult "J1939 engine fuel rate multiplier" VALUE 0x00147512 /* @ECU_Address@J1939_fuel_rate_mult@0x01008CB8@ */ ECIPP_ALIGNMENT_UWORD 4 Compu_J1939_fuel_rate_mult 0 3.99993896484375 /end CHARACTERISTIC
/begin COMPU_METHOD Compu_J1939_fuel_rate_mult " " RAT_FUNC "%.3" "-" COEFFS 0 16384 0 0 0 1 /end COMPU_METHOD
/begin MEASUREMENT J1939_mdot_f_ports "J1939 engine fuel rate" UWORD Compu_J1939_mdot_f_ports 0 0 0 127.998046875 ECU_ADDRESS 0x01008CC0 /end MEASUREMENT
/begin COMPU_METHOD Compu_J1939_mdot_f_ports " " RAT_FUNC "%.2" "g/sec" COEFFS 0 512 0 0 0 1 /end COMPU_METHOD
/begin MEASUREMENT CRI_mg_main_cld "Cold main quantity offset" SWORD Compu_CRI_mg_main_cld 0 0 -1024 1023.96875 ECU_ADDRESS 0x0100A080 /end MEASUREMENT
/begin COMPU_METHOD Compu_CRI_mg_main_cld " " RAT_FUNC "%.1" "mg/stroke" COEFFS 0 32 0 0 0 1 /end COMPU_METHOD
/begin MEASUREMENT CRI_mg_pilot2_cld "Cold pilot 2 quantity offset" SWORD Compu_CRI_mg_pilot2_cld 0 0 -1024 1023.96875 ECU_ADDRESS 0x0100A088 /end MEASUREMENT
/begin COMPU_METHOD Compu_CRI_mg_pilot2_cld " " RAT_FUNC "%.1" "mg/stroke" COEFFS 0 32 0 0 0 1 /end COMPU_METHOD
/begin MEASUREMENT CRI_mg_pilot1_cld "Cold pilot 1 quantity offset" SWORD Compu_CRI_mg_pilot1_cld 0 0 -1024 1023.96875 ECU_ADDRESS 0x0100A090 /end MEASUREMENT
/begin COMPU_METHOD Compu_CRI_mg_pilot1_cld " " RAT_FUNC "%.1" "mg/stroke" COEFFS 0 32 0 0 0 1 /end COMPU_METHOD
/begin MEASUREMENT CRI_mg_post1_cld "Cold post 1 quantity offset" SWORD Compu_CRI_mg_post1_cld 0 0 -1024 1023.96875 ECU_ADDRESS 0x0100A098 /end MEASUREMENT
/begin COMPU_METHOD Compu_CRI_mg_post1_cld " " RAT_FUNC "%.1" "mg/stroke" COEFFS 0 32 0 0 0 1 /end COMPU_METHOD
/begin MEASUREMENT CRI_mg_post2_cld "Cold post 2 quantity offset" SWORD Compu_CRI_mg_post2_cld 0 0 -1024 1023.96875 ECU_ADDRESS 0x0100A0A0 /end MEASUREMENT
/begin COMPU_METHOD Compu_CRI_mg_post2_cld " " RAT_FUNC "%.1" "mg/stroke" COEFFS 0 32 0 0 0 1 /end COMPU_METHOD
/begin MEASUREMENT CRI_cad_main_cld "Cold main  timing offset" SWORD Compu_CRI_cad_main_cld 0 0 -2048 2047.9375 ECU_ADDRESS 0x0100A0A8 /end MEASUREMENT
/begin COMPU_METHOD Compu_CRI_cad_main_cld " " RAT_FUNC "%.1" "CAD" COEFFS 0 16 0 0 0 1 /end COMPU_METHOD
/begin MEASUREMENT CRI_cad_pilot2_cld "Cold pilot 2 timing offset" SWORD Compu_CRI_cad_pilot2_cld 0 0 -2048 2047.9375 ECU_ADDRESS 0x0100A0B0 /end MEASUREMENT
/begin COMPU_METHOD Compu_CRI_cad_pilot2_cld " " RAT_FUNC "%.1" "CAD" COEFFS 0 16 0 0 0 1 /end COMPU_METHOD
/begin MEASUREMENT CRI_cad_pilot1_cld "Cold pilot 1 timing offset" SWORD Compu_CRI_cad_pilot1_cld 0 0 -2048 2047.9375 ECU_ADDRESS 0x0100A0B8 /end MEASUREMENT
/begin COMPU_METHOD Compu_CRI_cad_pilot1_cld " " RAT_FUNC "%.1" "CAD" COEFFS 0 16 0 0 0 1 /end COMPU_METHOD
/begin MEASUREMENT CRI_cad_post1_cld "Cold post 1 timing offset" SWORD Compu_CRI_cad_post1_cld 0 0 -2048 2047.9375 ECU_ADDRESS 0x0100A0C0 /end MEASUREMENT
/begin COMPU_METHOD Compu_CRI_cad_post1_cld " " RAT_FUNC "%.1" "CAD" COEFFS 0 16 0 0 0 1 /end COMPU_METHOD
/begin MEASUREMENT CRI_cad_post2_cld "Cold post 2 timing offset" SWORD Compu_CRI_cad_post2_cld 0 0 -2048 2047.9375 ECU_ADDRESS 0x0100A0C8 /end MEASUREMENT
/begin COMPU_METHOD Compu_CRI_cad_post2_cld " " RAT_FUNC "%.1" "CAD" COEFFS 0 16 0 0 0 1 /end COMPU_METHOD
/begin CHARACTERISTIC CRI_Tpilot2_type "Pilot 2 timing type{CRI_Tpilot2_type&0xff=0:(CAD BTDCC)}{CRI_Tpilot2_type&0xff=1:(us before main)}{CRI_Tpilot2_type&0xff=2:(us before pilot 1)}" VALUE 0x00170edd /* @ECU_Address@CRI_Tpilot2_type@0x0100A2F0@ */ ECIPP_ALIGNMENT_UBYTE 255 CRI_Tpilot2_type_COMPU_VTAB 0 255 BIT_MASK 0xff /end CHARACTERISTIC
/begin COMPU_METHOD CRI_Tpilot2_type_COMPU_VTAB "Verbal Table" TAB_VERB "%.0" "list" COMPU_TAB_REF CRI_Tpilot2_type_COMPU_VTAB_REF /end COMPU_METHOD
/begin COMPU_VTAB CRI_Tpilot2_type_COMPU_VTAB_REF "Verbal Table" TAB_VERB 3 0 "(CAD BTDCC)" 1 "(us before main)" 2 "(us before pilot 1)" DEFAULT_VALUE "UNKNOWN" /end COMPU_VTAB
/begin CHARACTERISTIC CRI_Tpilot1_type "Pilot 1 timing type{CRI_Tpilot1_type&0xff=0:(CAD BTDCC)}{CRI_Tpilot1_type&0xff=1:(us before main)}" VALUE 0x00170ed2 /* @ECU_Address@CRI_Tpilot1_type@0x0100A2F8@ */ ECIPP_ALIGNMENT_UBYTE 255 CRI_Tpilot1_type_COMPU_VTAB 0 255 BIT_MASK 0xff /end CHARACTERISTIC
/begin COMPU_METHOD CRI_Tpilot1_type_COMPU_VTAB "Verbal Table" TAB_VERB "%.0" "list" COMPU_TAB_REF CRI_Tpilot1_type_COMPU_VTAB_REF /end COMPU_METHOD
/begin COMPU_VTAB CRI_Tpilot1_type_COMPU_VTAB_REF "Verbal Table" TAB_VERB 2 0 "(CAD BTDCC)" 1 "(us before main)" DEFAULT_VALUE "UNKNOWN" /end COMPU_VTAB
/begin CHARACTERISTIC SENT1_Data1_c "SENT1 Data1 transformation slope" VALUE 0x00149304 /* @ECU_Address@SENT1_Data1_c@0x0100B710@ */ ECIPP_ALIGNMENT_FLOAT32_IEEE 10000000000 Compu_SENT1_Data1_c -10000000000 10000000000 /end CHARACTERISTIC
/begin COMPU_METHOD Compu_SENT1_Data1_c " " RAT_FUNC "%.3" "multiplier" COEFFS 0 1 0 0 0 1 /end COMPU_METHOD
/begin CHARACTERISTIC SENT1_Data1_o "SENT1 Data1 transformation offset" VALUE 0x00149308 /* @ECU_Address@SENT1_Data1_o@0x0100B718@ */ ECIPP_ALIGNMENT_FLOAT32_IEEE 10000000000 Compu_SENT1_Data1_o -10000000000 10000000000 /end CHARACTERISTIC
/begin COMPU_METHOD Compu_SENT1_Data1_o " " RAT_FUNC "%.3" "adder" COEFFS 0 1 0 0 0 1 /end COMPU_METHOD
/begin CHARACTERISTIC SENT1_Data2_c "SENT1 Data2 transformation slope" VALUE 0x0014930C /* @ECU_Address@SENT1_Data2_c@0x0100B720@ */ ECIPP_ALIGNMENT_FLOAT32_IEEE 10000000000 Compu_SENT1_Data2_c -10000000000 10000000000 /end CHARACTERISTIC
/begin COMPU_METHOD Compu_SENT1_Data2_c " " RAT_FUNC "%.3" "multiplier" COEFFS 0 1 0 0 0 1 /end COMPU_METHOD
/begin CHARACTERISTIC SENT1_Data2_o "SENT1 Data2 transformation offset" VALUE 0x00149310 /* @ECU_Address@SENT1_Data2_o@0x0100B728@ */ ECIPP_ALIGNMENT_FLOAT32_IEEE 10000000000 Compu_SENT1_Data2_o -10000000000 10000000000 /end CHARACTERISTIC
/begin COMPU_METHOD Compu_SENT1_Data2_o " " RAT_FUNC "%.3" "adder" COEFFS 0 1 0 0 0 1 /end COMPU_METHOD
/begin CHARACTERISTIC SENT1_ena "SENT channel 1 mode{SENT1_ena&0xff=0:Disabled}{SENT1_ena&0xff=1:J2716 TPS1/2}{SENT1_ena&0xff=2:J2716 FP/FT}{SENT1_ena&0xff=3:J2716 TPS1 Pause}" VALUE 0x0014931A /* @ECU_Address@SENT1_ena@0x0100B730@ */ ECIPP_ALIGNMENT_UBYTE 255 SENT1_ena_COMPU_VTAB 0 255 BIT_MASK 0xff /end CHARACTERISTIC
/begin COMPU_METHOD SENT1_ena_COMPU_VTAB "Verbal Table" TAB_VERB "%.0" "list" COMPU_TAB_REF SENT1_ena_COMPU_VTAB_REF /end COMPU_METHOD
/begin COMPU_VTAB SENT1_ena_COMPU_VTAB_REF "Verbal Table" TAB_VERB 4 0 "Disabled" 1 "J2716 TPS1/2" 2 "J2716 FP/FT" 3 "J2716 TPS1 Pause" DEFAULT_VALUE "UNKNOWN" /end COMPU_VTAB
/begin CHARACTERISTIC SENT2_ena "SENT channel 2 mode{SENT2_ena&0xff=0:Disabled}{SENT2_ena&0xff=1:J2716 TPS1/2}{SENT2_ena&0xff=2:J2716 FP/FT}{SENT2_ena&0xff=3:J2716 TPS1 Pause}" VALUE 0x00149332 /* @ECU_Address@SENT2_ena@0x0100B738@ */ ECIPP_ALIGNMENT_UBYTE 255 SENT2_ena_COMPU_VTAB 0 255 BIT_MASK 0xff /end CHARACTERISTIC
/begin COMPU_METHOD SENT2_ena_COMPU_VTAB "Verbal Table" TAB_VERB "%.0" "list" COMPU_TAB_REF SENT2_ena_COMPU_VTAB_REF /end COMPU_METHOD
/begin COMPU_VTAB SENT2_ena_COMPU_VTAB_REF "Verbal Table" TAB_VERB 4 0 "Disabled" 1 "J2716 TPS1/2" 2 "J2716 FP/FT" 3 "J2716 TPS1 Pause" DEFAULT_VALUE "UNKNOWN" /end COMPU_VTAB
/begin MEASUREMENT SENT1_data1 "SENT1 Data1" UWORD Compu_SENT1_data1 0 0 0 65535 ECU_ADDRESS 0x0100B740 /end MEASUREMENT
/begin COMPU_METHOD Compu_SENT1_data1 " " RAT_FUNC "%.0" "integer" COEFFS 0 1 0 0 0 1 /end COMPU_METHOD
/begin MEASUREMENT SENT1_data2 "SENT1 Data2" UWORD Compu_SENT1_data2 0 0 0 65535 ECU_ADDRESS 0x0100B748 /end MEASUREMENT
/begin COMPU_METHOD Compu_SENT1_data2 " " RAT_FUNC "%.0" "integer" COEFFS 0 1 0 0 0 1 /end COMPU_METHOD
/begin MEASUREMENT SENT1_error_cnt "SENT1 error counter" UWORD Compu_SENT1_error_cnt 0 0 0 65535 ECU_ADDRESS 0x0100B750 /end MEASUREMENT
/begin COMPU_METHOD Compu_SENT1_error_cnt " " RAT_FUNC "%.0" "count" COEFFS 0 1 0 0 0 1 /end COMPU_METHOD
/begin MEASUREMENT SENT1_no_signal_cnt "SENT1 no-signal counter" UWORD Compu_SENT1_no_signal_cnt 0 0 0 65535 ECU_ADDRESS 0x0100B758 /end MEASUREMENT
/begin COMPU_METHOD Compu_SENT1_no_signal_cnt " " RAT_FUNC "%.0" "count" COEFFS 0 1 0 0 0 1 /end COMPU_METHOD
/begin MEASUREMENT SENT1_sync_time "SENT1 sync time" UWORD Compu_SENT1_sync_time 0 0 0 65535 ECU_ADDRESS 0x0100B760 /end MEASUREMENT
/begin COMPU_METHOD Compu_SENT1_sync_time " " RAT_FUNC "%.0" "0.05us" COEFFS 0 1 0 0 0 1 /end COMPU_METHOD
/begin MEASUREMENT SENT1_timeout_cnt "SENT1 timeout counter" UWORD Compu_SENT1_timeout_cnt 0 0 0 65535 ECU_ADDRESS 0x0100B768 /end MEASUREMENT
/begin COMPU_METHOD Compu_SENT1_timeout_cnt " " RAT_FUNC "%.0" "count" COEFFS 0 1 0 0 0 1 /end COMPU_METHOD
/begin MEASUREMENT SENT1_crc_computed "SENT1 CRC - computed" UBYTE Compu_SENT1_crc_computed 0 0 0 255 ECU_ADDRESS 0x0100B770 /end MEASUREMENT
/begin COMPU_METHOD Compu_SENT1_crc_computed " " RAT_FUNC "%.0" "integer" COEFFS 0 1 0 0 0 1 /end COMPU_METHOD
/begin MEASUREMENT SENT1_crc_received "SENT1 CRC - received" UBYTE Compu_SENT1_crc_received 0 0 0 255 ECU_ADDRESS 0x0100B778 /end MEASUREMENT
/begin COMPU_METHOD Compu_SENT1_crc_received " " RAT_FUNC "%.0" "integer" COEFFS 0 1 0 0 0 1 /end COMPU_METHOD
/begin MEASUREMENT SENT1_diag_info "SENT1 internal diagnostic flags" UBYTE Compu_SENT1_diag_info 0 0 0 255 ECU_ADDRESS 0x0100B780 /end MEASUREMENT
/begin COMPU_METHOD Compu_SENT1_diag_info " " RAT_FUNC "%.0" "coded" COEFFS 0 1 0 0 0 1 /end COMPU_METHOD
/begin MEASUREMENT SENT1_status "SENT1 status byte" UBYTE Compu_SENT1_status 0 0 0 255 ECU_ADDRESS 0x0100B788 /end MEASUREMENT
/begin COMPU_METHOD Compu_SENT1_status " " RAT_FUNC "%.0" "coded" COEFFS 0 1 0 0 0 1 /end COMPU_METHOD
/begin MEASUREMENT SENT2_data1 "SENT2 Data1" UWORD Compu_SENT2_data1 0 0 0 65535 ECU_ADDRESS 0x0100B790 /end MEASUREMENT
/begin COMPU_METHOD Compu_SENT2_data1 " " RAT_FUNC "%.0" "integer" COEFFS 0 1 0 0 0 1 /end COMPU_METHOD
/begin MEASUREMENT SENT2_data2 "SENT2 Data2" UWORD Compu_SENT2_data2 0 0 0 65535 ECU_ADDRESS 0x0100B798 /end MEASUREMENT
/begin COMPU_METHOD Compu_SENT2_data2 " " RAT_FUNC "%.0" "integer" COEFFS 0 1 0 0 0 1 /end COMPU_METHOD
/begin MEASUREMENT SENT2_error_cnt "SENT2 error counter" UWORD Compu_SENT2_error_cnt 0 0 0 65535 ECU_ADDRESS 0x0100B7A0 /end MEASUREMENT
/begin COMPU_METHOD Compu_SENT2_error_cnt " " RAT_FUNC "%.0" "count" COEFFS 0 1 0 0 0 1 /end COMPU_METHOD
/begin MEASUREMENT SENT2_no_signal_cnt "SENT2 no-signal counter" UWORD Compu_SENT2_no_signal_cnt 0 0 0 65535 ECU_ADDRESS 0x0100B7A8 /end MEASUREMENT
/begin COMPU_METHOD Compu_SENT2_no_signal_cnt " " RAT_FUNC "%.0" "count" COEFFS 0 1 0 0 0 1 /end COMPU_METHOD
/begin MEASUREMENT SENT2_sync_time "SENT2 sync time" UWORD Compu_SENT2_sync_time 0 0 0 65535 ECU_ADDRESS 0x0100B7B0 /end MEASUREMENT
/begin COMPU_METHOD Compu_SENT2_sync_time " " RAT_FUNC "%.0" "0.05us" COEFFS 0 1 0 0 0 1 /end COMPU_METHOD
/begin MEASUREMENT SENT2_timeout_cnt "SENT2 timeout counter" UWORD Compu_SENT2_timeout_cnt 0 0 0 65535 ECU_ADDRESS 0x0100B7B8 /end MEASUREMENT
/begin COMPU_METHOD Compu_SENT2_timeout_cnt " " RAT_FUNC "%.0" "count" COEFFS 0 1 0 0 0 1 /end COMPU_METHOD
/begin MEASUREMENT SENT2_crc_computed "SENT2 CRC - computed" UBYTE Compu_SENT2_crc_computed 0 0 0 255 ECU_ADDRESS 0x0100B7C0 /end MEASUREMENT
/begin COMPU_METHOD Compu_SENT2_crc_computed " " RAT_FUNC "%.0" "integer" COEFFS 0 1 0 0 0 1 /end COMPU_METHOD
/begin MEASUREMENT SENT2_crc_received "SENT2 CRC - received" UBYTE Compu_SENT2_crc_received 0 0 0 255 ECU_ADDRESS 0x0100B7C8 /end MEASUREMENT
/begin COMPU_METHOD Compu_SENT2_crc_received " " RAT_FUNC "%.0" "integer" COEFFS 0 1 0 0 0 1 /end COMPU_METHOD
/begin MEASUREMENT SENT2_diag_info "SENT2 internal diagnostic flags" UBYTE Compu_SENT2_diag_info 0 0 0 255 ECU_ADDRESS 0x0100B7D0 /end MEASUREMENT
/begin COMPU_METHOD Compu_SENT2_diag_info " " RAT_FUNC "%.0" "coded" COEFFS 0 1 0 0 0 1 /end COMPU_METHOD
/begin MEASUREMENT SENT2_status "SENT2 status byte" UBYTE Compu_SENT2_status 0 0 0 255 ECU_ADDRESS 0x0100B7D8 /end MEASUREMENT
/begin COMPU_METHOD Compu_SENT2_status " " RAT_FUNC "%.0" "coded" COEFFS 0 1 0 0 0 1 /end COMPU_METHOD
/begin CHARACTERISTIC SENT2_Data1_c "SENT2 Data1 transformation slope" VALUE 0x0014931C /* @ECU_Address@SENT2_Data1_c@0x0100B7F0@ */ ECIPP_ALIGNMENT_FLOAT32_IEEE 10000000000 Compu_SENT2_Data1_c -10000000000 10000000000 /end CHARACTERISTIC
/begin COMPU_METHOD Compu_SENT2_Data1_c " " RAT_FUNC "%.3" "multiplier" COEFFS 0 1 0 0 0 1 /end COMPU_METHOD
/begin CHARACTERISTIC SENT2_Data1_o "SENT2 Data1 transformation offset" VALUE 0x00149320 /* @ECU_Address@SENT2_Data1_o@0x0100B7F8@ */ ECIPP_ALIGNMENT_FLOAT32_IEEE 10000000000 Compu_SENT2_Data1_o -10000000000 10000000000 /end CHARACTERISTIC
/begin COMPU_METHOD Compu_SENT2_Data1_o " " RAT_FUNC "%.3" "adder" COEFFS 0 1 0 0 0 1 /end COMPU_METHOD
/begin CHARACTERISTIC SENT2_Data2_c "SENT2 Data2 transformation slope" VALUE 0x00149324 /* @ECU_Address@SENT2_Data2_c@0x0100B800@ */ ECIPP_ALIGNMENT_FLOAT32_IEEE 10000000000 Compu_SENT2_Data2_c -10000000000 10000000000 /end CHARACTERISTIC
/begin COMPU_METHOD Compu_SENT2_Data2_c " " RAT_FUNC "%.3" "multiplier" COEFFS 0 1 0 0 0 1 /end COMPU_METHOD
/begin CHARACTERISTIC SENT2_Data2_o "SENT2 Data2 transformation offset" VALUE 0x00149328 /* @ECU_Address@SENT2_Data2_o@0x0100B808@ */ ECIPP_ALIGNMENT_FLOAT32_IEEE 10000000000 Compu_SENT2_Data2_o -10000000000 10000000000 /end CHARACTERISTIC
/begin COMPU_METHOD Compu_SENT2_Data2_o " " RAT_FUNC "%.3" "adder" COEFFS 0 1 0 0 0 1 /end COMPU_METHOD
/begin CHARACTERISTIC SENT1_Data1_def "SENT1 Data1 default/init value" VALUE 0x00149314 /* @ECU_Address@SENT1_Data1_def@0x0100B810@ */ ECIPP_ALIGNMENT_UWORD 65535 Compu_SENT1_Data1_def 0 65535 /end CHARACTERISTIC
/begin COMPU_METHOD Compu_SENT1_Data1_def " " RAT_FUNC "%.0" "integer" COEFFS 0 1 0 0 0 1 /end COMPU_METHOD
/begin CHARACTERISTIC SENT1_Data2_def "SENT1 Data2 default/init value" VALUE 0x00149316 /* @ECU_Address@SENT1_Data2_def@0x0100B818@ */ ECIPP_ALIGNMENT_UWORD 65535 Compu_SENT1_Data2_def 0 65535 /end CHARACTERISTIC
/begin COMPU_METHOD Compu_SENT1_Data2_def " " RAT_FUNC "%.0" "integer" COEFFS 0 1 0 0 0 1 /end COMPU_METHOD
/begin CHARACTERISTIC SENT2_Data1_def "SENT2 Data1 default/init value" VALUE 0x0014932C /* @ECU_Address@SENT2_Data1_def@0x0100B820@ */ ECIPP_ALIGNMENT_UWORD 65535 Compu_SENT2_Data1_def 0 65535 /end CHARACTERISTIC
/begin COMPU_METHOD Compu_SENT2_Data1_def " " RAT_FUNC "%.0" "integer" COEFFS 0 1 0 0 0 1 /end COMPU_METHOD
/begin CHARACTERISTIC SENT2_Data2_def "SENT2 Data2 default/init value" VALUE 0x0014932E /* @ECU_Address@SENT2_Data2_def@0x0100B828@ */ ECIPP_ALIGNMENT_UWORD 65535 Compu_SENT2_Data2_def 0 65535 /end CHARACTERISTIC
/begin COMPU_METHOD Compu_SENT2_Data2_def " " RAT_FUNC "%.0" "integer" COEFFS 0 1 0 0 0 1 /end COMPU_METHOD
/begin CHARACTERISTIC J1939_FPPdual_idle "J1939 EEC2 dual-FPP idle{J1939_FPPdual_idle&0xff=0:Not allowed}{J1939_FPPdual_idle&0xff=1:FPP command idle}{J1939_FPPdual_idle&0xff=2:Report FPP during TSC1}{J1939_FPPdual_idle&0xff=3:FPP position idle}" VALUE 0x00147dee /* @ECU_Address@J1939_FPPdual_idle@0x0100B880@ */ ECIPP_ALIGNMENT_UBYTE 255 J1939_FPPdual_idle_COMPU_VTAB 0 255 BIT_MASK 0xff /end CHARACTERISTIC
/begin COMPU_METHOD J1939_FPPdual_idle_COMPU_VTAB "Verbal Table" TAB_VERB "%.0" "list" COMPU_TAB_REF J1939_FPPdual_idle_COMPU_VTAB_REF /end COMPU_METHOD
/begin COMPU_VTAB J1939_FPPdual_idle_COMPU_VTAB_REF "Verbal Table" TAB_VERB 4 0 "Not allowed" 1 "FPP command idle" 2 "Report FPP during TSC1" 3 "FPP position idle" DEFAULT_VALUE "UNKNOWN" /end COMPU_VTAB
/begin MEASUREMENT NMHG_perfmode_cmd "NMHG performance mode command{NMHG_perfmode_cmd&0x07=0:Economy}{NMHG_perfmode_cmd&0x07=1:Standard}{NMHG_perfmode_cmd&0x07=2:Power}{NMHG_perfmode_cmd&0x07=7:N/A}" UBYTE NMHG_perfmode_cmd_COMPU_VTAB 0 0 0 255 ECU_ADDRESS 0x0100BBF8 BIT_MASK 0x07 /end MEASUREMENT
/begin COMPU_METHOD NMHG_perfmode_cmd_COMPU_VTAB "Verbal Table" TAB_VERB "%.0" "list" COMPU_TAB_REF NMHG_perfmode_cmd_COMPU_VTAB_REF /end COMPU_METHOD
/begin COMPU_VTAB NMHG_perfmode_cmd_COMPU_VTAB_REF "Verbal Table" TAB_VERB 4 0 "Economy" 1 "Standard" 2 "Power" 7 "N/A" DEFAULT_VALUE "UNKNOWN" /end COMPU_VTAB
/begin CHARACTERISTIC J1939_RC_SA_ena "J1939 RC source address{J1939_RC_SA_ena&0xff=0:Default}{J1939_RC_SA_ena&0xff=1:Engine Retarder (15)}{J1939_RC_SA_ena&0xff=2:Exhaust Retarder (41)}{J1939_RC_SA_ena&0xff=3:Both + torque curves}" VALUE 0x00147df2 /* @ECU_Address@J1939_RC_SA_ena@0x0100C210@ */ ECIPP_ALIGNMENT_UBYTE 255 J1939_RC_SA_ena_COMPU_VTAB 0 255 BIT_MASK 0xff /end CHARACTERISTIC
/begin COMPU_METHOD J1939_RC_SA_ena_COMPU_VTAB "Verbal Table" TAB_VERB "%.0" "list" COMPU_TAB_REF J1939_RC_SA_ena_COMPU_VTAB_REF /end COMPU_METHOD
/begin COMPU_VTAB J1939_RC_SA_ena_COMPU_VTAB_REF "Verbal Table" TAB_VERB 4 0 "Default" 1 "Engine Retarder (15)" 2 "Exhaust Retarder (41)" 3 "Both + torque curves" DEFAULT_VALUE "UNKNOWN" /end COMPU_VTAB
/begin MEASUREMENT TSC1_SA "Controlling SA" UBYTE Compu_TSC1_SA 0 0 0 255 ECU_ADDRESS 0x0100C220 /end MEASUREMENT
/begin COMPU_METHOD Compu_TSC1_SA " " RAT_FUNC "%.0" "-" COEFFS 0 1 0 0 0 1 /end COMPU_METHOD
/begin CHARACTERISTIC J1939EC_tx_rate "J1939 EC1/RC broadcast rate{J1939EC_tx_rate&0xff=0:5 seconds}{J1939EC_tx_rate&0xff=1:2 seconds}" VALUE 0x00147dea /* @ECU_Address@J1939EC_tx_rate@0x0100C238@ */ ECIPP_ALIGNMENT_UBYTE 255 J1939EC_tx_rate_COMPU_VTAB 0 255 BIT_MASK 0xff /end CHARACTERISTIC
/begin COMPU_METHOD J1939EC_tx_rate_COMPU_VTAB "Verbal Table" TAB_VERB "%.0" "list" COMPU_TAB_REF J1939EC_tx_rate_COMPU_VTAB_REF /end COMPU_METHOD
/begin COMPU_VTAB J1939EC_tx_rate_COMPU_VTAB_REF "Verbal Table" TAB_VERB 2 0 "5 seconds" 1 "2 seconds" DEFAULT_VALUE "UNKNOWN" /end COMPU_VTAB
/begin CHARACTERISTIC SPN_3344_ena "J1939 EC1 variable rate reporting{SPN_3344_ena&0xff=0:Disabled}{SPN_3344_ena&0xff=1:SPN3344-static pts}{SPN_3344_ena&0xff=2:SPN3344-dynamic pts}" VALUE 0x00147f3b /* @ECU_Address@SPN_3344_ena@0x0100C240@ */ ECIPP_ALIGNMENT_UBYTE 255 SPN_3344_ena_COMPU_VTAB 0 255 BIT_MASK 0xff /end CHARACTERISTIC
/begin COMPU_METHOD SPN_3344_ena_COMPU_VTAB "Verbal Table" TAB_VERB "%.0" "list" COMPU_TAB_REF SPN_3344_ena_COMPU_VTAB_REF /end COMPU_METHOD
/begin COMPU_VTAB SPN_3344_ena_COMPU_VTAB_REF "Verbal Table" TAB_VERB 3 0 "Disabled" 1 "SPN3344-static pts" 2 "SPN3344-dynamic pts" DEFAULT_VALUE "UNKNOWN" /end COMPU_VTAB
/begin MEASUREMENT RMT_aux_SD_state "Remote engine aux shutdown{RMT_aux_SD_state&0xff=0:Inactive}{RMT_aux_SD_state&0xff=1:Requesting Stop}{RMT_aux_SD_state&0xff=2:Stop Wait}{RMT_aux_SD_state&0xff=3:Requesting Start}" UBYTE RMT_aux_SD_state_COMPU_VTAB 0 0 0 255 ECU_ADDRESS 0x0100C280 BIT_MASK 0xff /end MEASUREMENT
/begin COMPU_METHOD RMT_aux_SD_state_COMPU_VTAB "Verbal Table" TAB_VERB "%.0" "list" COMPU_TAB_REF RMT_aux_SD_state_COMPU_VTAB_REF /end COMPU_METHOD
/begin COMPU_VTAB RMT_aux_SD_state_COMPU_VTAB_REF "Verbal Table" TAB_VERB 4 0 "Inactive" 1 "Requesting Stop" 2 "Stop Wait" 3 "Requesting Start" DEFAULT_VALUE "UNKNOWN" /end COMPU_VTAB
/begin CHARACTERISTIC J1939_EBC1_SD_tout "J1939 EBC1 shutdown back-on time" VALUE 0x001474ea /* @ECU_Address@J1939_EBC1_SD_tout@0x0100C288@ */ ECIPP_ALIGNMENT_UWORD 66 Compu_J1939_EBC1_SD_tout 0 65.535 /end CHARACTERISTIC
/begin COMPU_METHOD Compu_J1939_EBC1_SD_tout " " RAT_FUNC "%.1" "sec" COEFFS 0 1000 0 0 0 1 /end COMPU_METHOD
/begin CHARACTERISTIC J1939_TP_mod "J1939 TP modified CAN ID{J1939_TP_mod&0xff=0:Disabled}{J1939_TP_mod&0xff=1:Priority 6}" VALUE 0x00147df3 /* @ECU_Address@J1939_TP_mod@0x0100C308@ */ ECIPP_ALIGNMENT_UBYTE 255 J1939_TP_mod_COMPU_VTAB 0 255 BIT_MASK 0xff /end CHARACTERISTIC
/begin COMPU_METHOD J1939_TP_mod_COMPU_VTAB "Verbal Table" TAB_VERB "%.0" "list" COMPU_TAB_REF J1939_TP_mod_COMPU_VTAB_REF /end COMPU_METHOD
/begin COMPU_VTAB J1939_TP_mod_COMPU_VTAB_REF "Verbal Table" TAB_VERB 2 0 "Disabled" 1 "Priority 6" DEFAULT_VALUE "UNKNOWN" /end COMPU_VTAB
/begin MEASUREMENT ISO15765_2_Err_Cnt "15765-2 Error count" ULONG Compu_ISO15765_2_Err_Cnt 0 0 0 4294967295 ECU_ADDRESS 0x0100CA58 /end MEASUREMENT
/begin COMPU_METHOD Compu_ISO15765_2_Err_Cnt " " RAT_FUNC "%.0" "-" COEFFS 0 1 0 0 0 1 /end COMPU_METHOD
/begin MEASUREMENT ISO15765_2_Err_Code "15765-2 Error code" ULONG Compu_ISO15765_2_Err_Code 0 0 0 4294967295 ECU_ADDRESS 0x0100CA60 /end MEASUREMENT
/begin COMPU_METHOD Compu_ISO15765_2_Err_Code " " RAT_FUNC "%.0" "-" COEFFS 0 1 0 0 0 1 /end COMPU_METHOD
/begin MEASUREMENT ISO15765_4_Err_Cnt "15765-4 Error count" ULONG Compu_ISO15765_4_Err_Cnt 0 0 0 4294967295 ECU_ADDRESS 0x0100CA68 /end MEASUREMENT
/begin COMPU_METHOD Compu_ISO15765_4_Err_Cnt " " RAT_FUNC "%.0" "-" COEFFS 0 1 0 0 0 1 /end COMPU_METHOD
/begin MEASUREMENT ISO15765_4_Err_Code "15765-4 Error code" ULONG Compu_ISO15765_4_Err_Code 0 0 0 4294967295 ECU_ADDRESS 0x0100CA70 /end MEASUREMENT
/begin COMPU_METHOD Compu_ISO15765_4_Err_Code " " RAT_FUNC "%.0" "-" COEFFS 0 1 0 0 0 1 /end COMPU_METHOD
/begin MEASUREMENT CAN1_15765_2_Rx "CAN1 15765-2 Rx packets" ULONG Compu_CAN1_15765_2_Rx 0 0 0 4294967295 ECU_ADDRESS 0x0100CA78 /end MEASUREMENT
/begin COMPU_METHOD Compu_CAN1_15765_2_Rx " " RAT_FUNC "%.0" "-" COEFFS 0 1 0 0 0 1 /end COMPU_METHOD
/begin MEASUREMENT CAN1_15765_2_Tx "CAN1 15765-2 Tx packets" ULONG Compu_CAN1_15765_2_Tx 0 0 0 4294967295 ECU_ADDRESS 0x0100CA80 /end MEASUREMENT
/begin COMPU_METHOD Compu_CAN1_15765_2_Tx " " RAT_FUNC "%.0" "-" COEFFS 0 1 0 0 0 1 /end COMPU_METHOD
/begin MEASUREMENT CAN1_15765_4_Rx "CAN1 15765-4 Rx packets" ULONG Compu_CAN1_15765_4_Rx 0 0 0 4294967295 ECU_ADDRESS 0x0100CA88 /end MEASUREMENT
/begin COMPU_METHOD Compu_CAN1_15765_4_Rx " " RAT_FUNC "%.0" "-" COEFFS 0 1 0 0 0 1 /end COMPU_METHOD
/begin MEASUREMENT CAN1_15765_4_Tx "CAN1 15765-4 Tx packets" ULONG Compu_CAN1_15765_4_Tx 0 0 0 4294967295 ECU_ADDRESS 0x0100CA90 /end MEASUREMENT
/begin COMPU_METHOD Compu_CAN1_15765_4_Tx " " RAT_FUNC "%.0" "-" COEFFS 0 1 0 0 0 1 /end COMPU_METHOD
/begin MEASUREMENT CAN2_15765_2_Rx "CAN2 15765-2 Rx packets" ULONG Compu_CAN2_15765_2_Rx 0 0 0 4294967295 ECU_ADDRESS 0x0100CA98 /end MEASUREMENT
/begin COMPU_METHOD Compu_CAN2_15765_2_Rx " " RAT_FUNC "%.0" "-" COEFFS 0 1 0 0 0 1 /end COMPU_METHOD
/begin MEASUREMENT CAN2_15765_2_Tx "CAN2 15765-2 Tx packets" ULONG Compu_CAN2_15765_2_Tx 0 0 0 4294967295 ECU_ADDRESS 0x0100CAA0 /end MEASUREMENT
/begin COMPU_METHOD Compu_CAN2_15765_2_Tx " " RAT_FUNC "%.0" "-" COEFFS 0 1 0 0 0 1 /end COMPU_METHOD
/begin MEASUREMENT CAN2_15765_4_Rx "CAN2 15765-4 Rx packets" ULONG Compu_CAN2_15765_4_Rx 0 0 0 4294967295 ECU_ADDRESS 0x0100CAA8 /end MEASUREMENT
/begin COMPU_METHOD Compu_CAN2_15765_4_Rx " " RAT_FUNC "%.0" "-" COEFFS 0 1 0 0 0 1 /end COMPU_METHOD
/begin MEASUREMENT CAN2_15765_4_Tx "CAN2 15765-4 Tx packets" ULONG Compu_CAN2_15765_4_Tx 0 0 0 4294967295 ECU_ADDRESS 0x0100CAB0 /end MEASUREMENT
/begin COMPU_METHOD Compu_CAN2_15765_4_Tx " " RAT_FUNC "%.0" "-" COEFFS 0 1 0 0 0 1 /end COMPU_METHOD
/begin MEASUREMENT CAN3_15765_2_Rx "CAN3 15765-2 Rx packets" ULONG Compu_CAN3_15765_2_Rx 0 0 0 4294967295 ECU_ADDRESS 0x0100CAB8 /end MEASUREMENT
/begin COMPU_METHOD Compu_CAN3_15765_2_Rx " " RAT_FUNC "%.0" "-" COEFFS 0 1 0 0 0 1 /end COMPU_METHOD
/begin MEASUREMENT CAN3_15765_2_Tx "CAN3 15765-2 Tx packets" ULONG Compu_CAN3_15765_2_Tx 0 0 0 4294967295 ECU_ADDRESS 0x0100CAC0 /end MEASUREMENT
/begin COMPU_METHOD Compu_CAN3_15765_2_Tx " " RAT_FUNC "%.0" "-" COEFFS 0 1 0 0 0 1 /end COMPU_METHOD
/begin MEASUREMENT CAN3_15765_4_Rx "CAN3 15765-4 Rx packets" ULONG Compu_CAN3_15765_4_Rx 0 0 0 4294967295 ECU_ADDRESS 0x0100CAC8 /end MEASUREMENT
/begin COMPU_METHOD Compu_CAN3_15765_4_Rx " " RAT_FUNC "%.0" "-" COEFFS 0 1 0 0 0 1 /end COMPU_METHOD
/begin MEASUREMENT CAN3_15765_4_Tx "CAN3 15765-4 Tx packets" ULONG Compu_CAN3_15765_4_Tx 0 0 0 4294967295 ECU_ADDRESS 0x0100CAD0 /end MEASUREMENT
/begin COMPU_METHOD Compu_CAN3_15765_4_Tx " " RAT_FUNC "%.0" "-" COEFFS 0 1 0 0 0 1 /end COMPU_METHOD
/begin MEASUREMENT Linde_ff_torq_req "Remote feedforward torque request" SWORD Compu_Linde_ff_torq_req 0 0 -200 199.993896484375 ECU_ADDRESS 0x0100CD58 /end MEASUREMENT
/begin COMPU_METHOD Compu_Linde_ff_torq_req " " RAT_FUNC "%.1" "%" COEFFS 0 163.84 0 0 0 1 /end COMPU_METHOD
/begin CHARACTERISTIC RMT_ff_torq_mode "Remote feedforward torque mode{RMT_ff_torq_mode&0xff=0:Disabled}{RMT_ff_torq_mode&0xff=1:Enabled - Gov Load %}{RMT_ff_torq_mode&0xff=2:Enabled - Ref Torque %}" VALUE 0x00147ef3 /* @ECU_Address@RMT_ff_torq_mode@0x0100CD68@ */ ECIPP_ALIGNMENT_UBYTE 255 RMT_ff_torq_mode_COMPU_VTAB 0 255 BIT_MASK 0xff /end CHARACTERISTIC
/begin COMPU_METHOD RMT_ff_torq_mode_COMPU_VTAB "Verbal Table" TAB_VERB "%.0" "list" COMPU_TAB_REF RMT_ff_torq_mode_COMPU_VTAB_REF /end COMPU_METHOD
/begin COMPU_VTAB RMT_ff_torq_mode_COMPU_VTAB_REF "Verbal Table" TAB_VERB 3 0 "Disabled" 1 "Enabled - Gov Load %" 2 "Enabled - Ref Torque %" DEFAULT_VALUE "UNKNOWN" /end COMPU_VTAB
/begin MEASUREMENT J1939_key_state "J1939 key state{J1939_key_state&0xff=0:Not available}{J1939_key_state&0xff=1:Key not present}{J1939_key_state&0xff=2:Off}{J1939_key_state&0xff=3:Lock}{J1939_key_state&0xff=4:Accessory}{J1939_key_state&0xff=5:On}{J1939_key_state&0xff=6:Start}" UBYTE J1939_key_state_COMPU_VTAB 0 0 0 255 ECU_ADDRESS 0x0100D8D0 BIT_MASK 0xff /end MEASUREMENT
/begin COMPU_METHOD J1939_key_state_COMPU_VTAB "Verbal Table" TAB_VERB "%.0" "list" COMPU_TAB_REF J1939_key_state_COMPU_VTAB_REF /end COMPU_METHOD
/begin COMPU_VTAB J1939_key_state_COMPU_VTAB_REF "Verbal Table" TAB_VERB 7 0 "Not available" 1 "Key not present" 2 "Off" 3 "Lock" 4 "Accessory" 5 "On" 6 "Start" DEFAULT_VALUE "UNKNOWN" /end COMPU_VTAB
/begin CHARACTERISTIC ISO15765_obdsup "PID 0x1C - OBD support{ISO15765_obdsup&0xff=0:Disabled}{ISO15765_obdsup&0xff=1:OBD II (California ARB)}{ISO15765_obdsup&0xff=2:OBD (Federal EPA)}{ISO15765_obdsup&0xff=3:OBD and OBD II}{ISO15765_obdsup&0xff=4:OBD I}{ISO15765_obdsup&0xff=5:Not OBD compliant" VALUE 0x00147de1 /* @ECU_Address@ISO15765_obdsup@0x0100DA08@ */ ECIPP_ALIGNMENT_UBYTE 255 ISO15765_obdsup_COMPU_VTAB 0 255 BIT_MASK 0xff /end CHARACTERISTIC
/begin COMPU_METHOD ISO15765_obdsup_COMPU_VTAB "Verbal Table" TAB_VERB "%.0" "list" COMPU_TAB_REF ISO15765_obdsup_COMPU_VTAB_REF /end COMPU_METHOD
/begin COMPU_VTAB ISO15765_obdsup_COMPU_VTAB_REF "Verbal Table" TAB_VERB 43 0 "Disabled" 1 "OBD II (California ARB)" 2 "OBD (Federal EPA)" 3 "OBD and OBD II" 4 "OBD I" 5 "Not OBD compliant" 6 "EOBD" 7 "EOBD and OBD II" 8 "EOBD and OBD" 9 "EOBD, OBD and OBD II" 10 "JOBD" 11 "JOBD and OBD II" 12 "JOBD and EOBD" 13 "JOBD, EOBD, and OBD II" 14 "OBD, EOBD and KOBD" 15 "OBD, OBD II, EOBD and KOBD" 16 "SAE/ISO reserved (0x10)" 17 "Engine Manufacturer Diagnostics (EMD)" 18 "Engine Manufacturer Diagnostics Enhanced (EMD+)" 19 "Heavy Duty On-Board Diagnostics (Child/Partial)" 20 "Heavy Duty On-Board Diagnostics" 21 "World Wide Harmonized OBD" 22 "SAE/ISO reserved (0x16)" 23 "Heavy Duty Euro OBD Stage I without NOx Control" 24 "Heavy Duty Euro OBD Stage I with NOx Control" 25 "Heavy Duty Euro OBD Stage II without NOx Control" 26 "Heavy Duty Euro OBD Stage II with NOx Control" 27 "SAE/ISO reserved (0x1B)" 28 "Brazil OBD Phase 1" 29 "Brazil OBD Phase 2 and Phase 2+" 30 "Korean OBD" 31 "India OBD I" 32 "India OBD II" 33 "Euro VI" 34 "OBD, OBD II and HD OBD" 35 "Brazil OBD Phase 3" 36 "Motorcycle, Euro OBD-I" 37 "Motorcycle, Euro OBD-II" 38 "Motorcycle, China OBD-I" 39 "Motorcycle, Taiwan OBD-I" 40 "Motorcycle, Japan OBD-I" 41 "China Nationwide Stage 6" 42 "Brazil OBD Diesel" DEFAULT_VALUE "UNKNOWN" /end COMPU_VTAB
/begin CHARACTERISTIC ISO15765_emissup "PID 0x5F - Emission support{ISO15765_emissup&0xff=0:Disabled}{ISO15765_emissup&0xff=1:Heavy Duty Vehicles (EURO IV) B1}{ISO15765_emissup&0xff=2:Heavy Duty Vehicles (EURO V) B2}{ISO15765_emissup&0xff=3:Heavy Duty Vehicles (EURO EEV) C}{ISO15765_emissup&0xf" VALUE 0x00147dde /* @ECU_Address@ISO15765_emissup@0x0100DA10@ */ ECIPP_ALIGNMENT_UBYTE 255 ISO15765_emissup_COMPU_VTAB 0 255 BIT_MASK 0xff /end CHARACTERISTIC
/begin COMPU_METHOD ISO15765_emissup_COMPU_VTAB "Verbal Table" TAB_VERB "%.0" "list" COMPU_TAB_REF ISO15765_emissup_COMPU_VTAB_REF /end COMPU_METHOD
/begin COMPU_VTAB ISO15765_emissup_COMPU_VTAB_REF "Verbal Table" TAB_VERB 5 0 "Disabled" 1 "Heavy Duty Vehicles (EURO IV) B1" 2 "Heavy Duty Vehicles (EURO V) B2" 3 "Heavy Duty Vehicles (EURO EEV) C" 4 "Heavy Duty Vehicles (Euro VI)" DEFAULT_VALUE "UNKNOWN" /end COMPU_VTAB
/begin CHARACTERISTIC SPN_1437_mode "J1939 EEC2 road speed limit status{SPN_1437_mode&0xff=0:System active}{SPN_1437_mode&0xff=1:Actively limiting}" VALUE 0x00147f3a /* @ECU_Address@SPN_1437_mode@0x0100DD40@ */ ECIPP_ALIGNMENT_UBYTE 255 SPN_1437_mode_COMPU_VTAB 0 255 BIT_MASK 0xff /end CHARACTERISTIC
/begin COMPU_METHOD SPN_1437_mode_COMPU_VTAB "Verbal Table" TAB_VERB "%.0" "list" COMPU_TAB_REF SPN_1437_mode_COMPU_VTAB_REF /end COMPU_METHOD
/begin COMPU_VTAB SPN_1437_mode_COMPU_VTAB_REF "Verbal Table" TAB_VERB 2 0 "System active" 1 "Actively limiting" DEFAULT_VALUE "UNKNOWN" /end COMPU_VTAB
/begin CHARACTERISTIC J1939_EC1_droop "J1939 EC1 Point6 Enable{J1939_EC1_droop&0xff=0:Disabled}{J1939_EC1_droop&0xff=1:Enabled}" VALUE 0x00147dec /* @ECU_Address@J1939_EC1_droop@0x0100E6A8@ */ ECIPP_ALIGNMENT_UBYTE 255 J1939_EC1_droop_COMPU_VTAB 0 255 BIT_MASK 0xff /end CHARACTERISTIC
/begin COMPU_METHOD J1939_EC1_droop_COMPU_VTAB "Verbal Table" TAB_VERB "%.0" "list" COMPU_TAB_REF J1939_EC1_droop_COMPU_VTAB_REF /end COMPU_METHOD
/begin COMPU_VTAB J1939_EC1_droop_COMPU_VTAB_REF "Verbal Table" TAB_VERB 2 0 "Disabled" 1 "Enabled" DEFAULT_VALUE "UNKNOWN" /end COMPU_VTAB
/begin CHARACTERISTIC TSC_RPM_0_ignore "Remote speed ignore 0 RPM{TSC_RPM_0_ignore&0xff=0:Disabled}{TSC_RPM_0_ignore&0xff=1:Enabled}" VALUE 0x001480b7 /* @ECU_Address@TSC_RPM_0_ignore@0x0100E778@ */ ECIPP_ALIGNMENT_UBYTE 255 TSC_RPM_0_ignore_COMPU_VTAB 0 255 BIT_MASK 0xff /end CHARACTERISTIC
/begin COMPU_METHOD TSC_RPM_0_ignore_COMPU_VTAB "Verbal Table" TAB_VERB "%.0" "list" COMPU_TAB_REF TSC_RPM_0_ignore_COMPU_VTAB_REF /end COMPU_METHOD
/begin COMPU_VTAB TSC_RPM_0_ignore_COMPU_VTAB_REF "Verbal Table" TAB_VERB 2 0 "Disabled" 1 "Enabled" DEFAULT_VALUE "UNKNOWN" /end COMPU_VTAB
/begin CHARACTERISTIC RMT_tsc_fpp_ena "Remote TSC1 and FPP SC{RMT_tsc_fpp_ena&0xff=0x00:Disabled}{RMT_tsc_fpp_ena&0xff=0x01:Enabled}" VALUE 0x00147ef6 /* @ECU_Address@RMT_tsc_fpp_ena@0x0100E868@ */ ECIPP_ALIGNMENT_UBYTE 255 RMT_tsc_fpp_ena_COMPU_VTAB 0 255 BIT_MASK 0xff /end CHARACTERISTIC
/begin COMPU_METHOD RMT_tsc_fpp_ena_COMPU_VTAB "Verbal Table" TAB_VERB "%.0" "list" COMPU_TAB_REF RMT_tsc_fpp_ena_COMPU_VTAB_REF /end COMPU_METHOD
/begin COMPU_VTAB RMT_tsc_fpp_ena_COMPU_VTAB_REF "Verbal Table" TAB_VERB 2 0x00 "Disabled" 0x01 "Enabled" DEFAULT_VALUE "UNKNOWN" /end COMPU_VTAB
/begin MEASUREMENT pid_0x01_mil "PID 0x01 - MIL{pid_0x01_mil&0xff=0:Off}{pid_0x01_mil&0xff=1:On}" UBYTE pid_0x01_mil_COMPU_VTAB 0 0 0 255 ECU_ADDRESS 0x0100EA20 BIT_MASK 0xff /end MEASUREMENT
/begin COMPU_METHOD pid_0x01_mil_COMPU_VTAB "Verbal Table" TAB_VERB "%.0" "list" COMPU_TAB_REF pid_0x01_mil_COMPU_VTAB_REF /end COMPU_METHOD
/begin COMPU_VTAB pid_0x01_mil_COMPU_VTAB_REF "Verbal Table" TAB_VERB 2 0 "Off" 1 "On" DEFAULT_VALUE "UNKNOWN" /end COMPU_VTAB
/begin CHARACTERISTIC CAN1_ISO15031_ena "ISO 15031 / SAE J1979{CAN1_ISO15031_ena&0xff=0:Disabled}{CAN1_ISO15031_ena&0xff=1:Enabled}" VALUE 0x00148571 /* @ECU_Address@CAN1_ISO15031_ena@0x0100EA48@ */ ECIPP_ALIGNMENT_UBYTE 255 CAN1_ISO15031_ena_COMPU_VTAB 0 255 BIT_MASK 0xff /end CHARACTERISTIC
/begin COMPU_METHOD CAN1_ISO15031_ena_COMPU_VTAB "Verbal Table" TAB_VERB "%.0" "list" COMPU_TAB_REF CAN1_ISO15031_ena_COMPU_VTAB_REF /end COMPU_METHOD
/begin COMPU_VTAB CAN1_ISO15031_ena_COMPU_VTAB_REF "Verbal Table" TAB_VERB 2 0 "Disabled" 1 "Enabled" DEFAULT_VALUE "UNKNOWN" /end COMPU_VTAB
/begin CHARACTERISTIC CAN2_ISO15031_ena "ISO 15031 / SAE J1979{CAN2_ISO15031_ena&0xff=0:Disabled}{CAN2_ISO15031_ena&0xff=1:Enabled}" VALUE 0x00148909 /* @ECU_Address@CAN2_ISO15031_ena@0x0100EA50@ */ ECIPP_ALIGNMENT_UBYTE 255 CAN2_ISO15031_ena_COMPU_VTAB 0 255 BIT_MASK 0xff /end CHARACTERISTIC
/begin COMPU_METHOD CAN2_ISO15031_ena_COMPU_VTAB "Verbal Table" TAB_VERB "%.0" "list" COMPU_TAB_REF CAN2_ISO15031_ena_COMPU_VTAB_REF /end COMPU_METHOD
/begin COMPU_VTAB CAN2_ISO15031_ena_COMPU_VTAB_REF "Verbal Table" TAB_VERB 2 0 "Disabled" 1 "Enabled" DEFAULT_VALUE "UNKNOWN" /end COMPU_VTAB
/begin CHARACTERISTIC CAN3_ISO15031_ena "ISO 15031 / SAE J1979{CAN3_ISO15031_ena&0xff=0:Disabled}{CAN3_ISO15031_ena&0xff=1:Enabled}" VALUE 0x00148CA1 /* @ECU_Address@CAN3_ISO15031_ena@0x0100EA58@ */ ECIPP_ALIGNMENT_UBYTE 255 CAN3_ISO15031_ena_COMPU_VTAB 0 255 BIT_MASK 0xff /end CHARACTERISTIC
/begin COMPU_METHOD CAN3_ISO15031_ena_COMPU_VTAB "Verbal Table" TAB_VERB "%.0" "list" COMPU_TAB_REF CAN3_ISO15031_ena_COMPU_VTAB_REF /end COMPU_METHOD
/begin COMPU_VTAB CAN3_ISO15031_ena_COMPU_VTAB_REF "Verbal Table" TAB_VERB 2 0 "Disabled" 1 "Enabled" DEFAULT_VALUE "UNKNOWN" /end COMPU_VTAB
/begin CHARACTERISTIC CAN1_UDS_KWP_mode "ISO 14229 / ISO 14230{CAN1_UDS_KWP_mode&0xff=0:Disabled}{CAN1_UDS_KWP_mode&0xff=1:Legacy (Mixed)}{CAN1_UDS_KWP_mode&0xff=2:ISO 14229 (UDS)}{CAN1_UDS_KWP_mode&0xff=3:ISO 14230 (KWP 2000)}{CAN1_UDS_KWP_mode&0xff=4:ISO 14229 (UDS) PEA2+}{CAN1_UDS_KWP_mode&0x" VALUE 0x00148572 /* @ECU_Address@CAN1_UDS_KWP_mode@0x0100EA60@ */ ECIPP_ALIGNMENT_UBYTE 255 CAN1_UDS_KWP_mode_COMPU_VTAB 0 255 BIT_MASK 0xff /end CHARACTERISTIC
/begin COMPU_METHOD CAN1_UDS_KWP_mode_COMPU_VTAB "Verbal Table" TAB_VERB "%.0" "list" COMPU_TAB_REF CAN1_UDS_KWP_mode_COMPU_VTAB_REF /end COMPU_METHOD
/begin COMPU_VTAB CAN1_UDS_KWP_mode_COMPU_VTAB_REF "Verbal Table" TAB_VERB 6 0 "Disabled" 1 "Legacy (Mixed)" 2 "ISO 14229 (UDS)" 3 "ISO 14230 (KWP 2000)" 4 "ISO 14229 (UDS) PEA2+" 5 "ISO 14229 (UDS) CFG1" DEFAULT_VALUE "UNKNOWN" /end COMPU_VTAB
/begin CHARACTERISTIC CAN2_UDS_KWP_mode "ISO 14229 / ISO 14230{CAN2_UDS_KWP_mode&0xff=0:Disabled}{CAN2_UDS_KWP_mode&0xff=1:Legacy (Mixed)}{CAN2_UDS_KWP_mode&0xff=2:ISO 14229 (UDS)}{CAN2_UDS_KWP_mode&0xff=3:ISO 14230 (KWP 2000)}{CAN2_UDS_KWP_mode&0xff=4:ISO 14229 (UDS) PEA2+}{CAN2_UDS_KWP_mode&0x" VALUE 0x0014890A /* @ECU_Address@CAN2_UDS_KWP_mode@0x0100EA68@ */ ECIPP_ALIGNMENT_UBYTE 255 CAN2_UDS_KWP_mode_COMPU_VTAB 0 255 BIT_MASK 0xff /end CHARACTERISTIC
/begin COMPU_METHOD CAN2_UDS_KWP_mode_COMPU_VTAB "Verbal Table" TAB_VERB "%.0" "list" COMPU_TAB_REF CAN2_UDS_KWP_mode_COMPU_VTAB_REF /end COMPU_METHOD
/begin COMPU_VTAB CAN2_UDS_KWP_mode_COMPU_VTAB_REF "Verbal Table" TAB_VERB 6 0 "Disabled" 1 "Legacy (Mixed)" 2 "ISO 14229 (UDS)" 3 "ISO 14230 (KWP 2000)" 4 "ISO 14229 (UDS) PEA2+" 5 "ISO 14229 (UDS) CFG1" DEFAULT_VALUE "UNKNOWN" /end COMPU_VTAB
/begin CHARACTERISTIC CAN3_UDS_KWP_mode "ISO 14229 / ISO 14230{CAN3_UDS_KWP_mode&0xff=0:Disabled}{CAN3_UDS_KWP_mode&0xff=1:Legacy (Mixed)}{CAN3_UDS_KWP_mode&0xff=2:ISO 14229 (UDS)}{CAN3_UDS_KWP_mode&0xff=3:ISO 14230 (KWP 2000)}{CAN3_UDS_KWP_mode&0xff=4:ISO 14229 (UDS) PEA2+}{CAN3_UDS_KWP_mode&0x" VALUE 0x00148CA2 /* @ECU_Address@CAN3_UDS_KWP_mode@0x0100EA70@ */ ECIPP_ALIGNMENT_UBYTE 255 CAN3_UDS_KWP_mode_COMPU_VTAB 0 255 BIT_MASK 0xff /end CHARACTERISTIC
/begin COMPU_METHOD CAN3_UDS_KWP_mode_COMPU_VTAB "Verbal Table" TAB_VERB "%.0" "list" COMPU_TAB_REF CAN3_UDS_KWP_mode_COMPU_VTAB_REF /end COMPU_METHOD
/begin COMPU_VTAB CAN3_UDS_KWP_mode_COMPU_VTAB_REF "Verbal Table" TAB_VERB 6 0 "Disabled" 1 "Legacy (Mixed)" 2 "ISO 14229 (UDS)" 3 "ISO 14230 (KWP 2000)" 4 "ISO 14229 (UDS) PEA2+" 5 "ISO 14229 (UDS) CFG1" DEFAULT_VALUE "UNKNOWN" /end COMPU_VTAB
/begin CHARACTERISTIC ISO15765_ipt_spark "ITID 0x08 - IUPR spark{ISO15765_ipt_spark&0xff=0:Disabled}{ISO15765_ipt_spark&0xff=1:Enabled}" VALUE 0x00147de0 /* @ECU_Address@ISO15765_ipt_spark@0x0100EAC0@ */ ECIPP_ALIGNMENT_UBYTE 255 ISO15765_ipt_spark_COMPU_VTAB 0 255 BIT_MASK 0xff /end CHARACTERISTIC
/begin COMPU_METHOD ISO15765_ipt_spark_COMPU_VTAB "Verbal Table" TAB_VERB "%.0" "list" COMPU_TAB_REF ISO15765_ipt_spark_COMPU_VTAB_REF /end COMPU_METHOD
/begin COMPU_VTAB ISO15765_ipt_spark_COMPU_VTAB_REF "Verbal Table" TAB_VERB 2 0 "Disabled" 1 "Enabled" DEFAULT_VALUE "UNKNOWN" /end COMPU_VTAB
/begin CHARACTERISTIC ISO15765_ipt_comp "ITID 0x0B - IUPR comp{ISO15765_ipt_comp&0xff=0:Disabled}{ISO15765_ipt_comp&0xff=1:Enabled}" VALUE 0x00147ddf /* @ECU_Address@ISO15765_ipt_comp@0x0100EAC8@ */ ECIPP_ALIGNMENT_UBYTE 255 ISO15765_ipt_comp_COMPU_VTAB 0 255 BIT_MASK 0xff /end CHARACTERISTIC
/begin COMPU_METHOD ISO15765_ipt_comp_COMPU_VTAB "Verbal Table" TAB_VERB "%.0" "list" COMPU_TAB_REF ISO15765_ipt_comp_COMPU_VTAB_REF /end COMPU_METHOD
/begin COMPU_VTAB ISO15765_ipt_comp_COMPU_VTAB_REF "Verbal Table" TAB_VERB 2 0 "Disabled" 1 "Enabled" DEFAULT_VALUE "UNKNOWN" /end COMPU_VTAB
/begin CHARACTERISTIC maxgv_TSC_FA_Gov3 "Remote speed req throttle gov{maxgv_TSC_FA_Gov3&0xff=0:Normal Gov3}{maxgv_TSC_FA_Gov3&0xff=1:Use Max Gov Settings}" VALUE 0x001481a7 /* @ECU_Address@maxgv_TSC_FA_Gov3@0x0100EF20@ */ ECIPP_ALIGNMENT_UBYTE 255 maxgv_TSC_FA_Gov3_COMPU_VTAB 0 255 BIT_MASK 0xff /end CHARACTERISTIC
/begin COMPU_METHOD maxgv_TSC_FA_Gov3_COMPU_VTAB "Verbal Table" TAB_VERB "%.0" "list" COMPU_TAB_REF maxgv_TSC_FA_Gov3_COMPU_VTAB_REF /end COMPU_METHOD
/begin COMPU_VTAB maxgv_TSC_FA_Gov3_COMPU_VTAB_REF "Verbal Table" TAB_VERB 2 0 "Normal Gov3" 1 "Use Max Gov Settings" DEFAULT_VALUE "UNKNOWN" /end COMPU_VTAB
/begin CHARACTERISTIC maxgvspk_TSC_FA_Gov3 "Remote speed req spark gov{maxgvspk_TSC_FA_Gov3&0xff=0:Normal Gov3}{maxgvspk_TSC_FA_Gov3&0xff=1:Use Max Gov Settings}" VALUE 0x001481a9 /* @ECU_Address@maxgvspk_TSC_FA_Gov3@0x0100EF28@ */ ECIPP_ALIGNMENT_UBYTE 255 maxgvspk_TSC_FA_Gov3_COMPU_VTAB 0 255 BIT_MASK 0xff /end CHARACTERISTIC
/begin COMPU_METHOD maxgvspk_TSC_FA_Gov3_COMPU_VTAB "Verbal Table" TAB_VERB "%.0" "list" COMPU_TAB_REF maxgvspk_TSC_FA_Gov3_COMPU_VTAB_REF /end COMPU_METHOD
/begin COMPU_VTAB maxgvspk_TSC_FA_Gov3_COMPU_VTAB_REF "Verbal Table" TAB_VERB 2 0 "Normal Gov3" 1 "Use Max Gov Settings" DEFAULT_VALUE "UNKNOWN" /end COMPU_VTAB
/begin CHARACTERISTIC TSC_gov_acc_setpnt "Remote speed req acc setpoint" VALUE 0x00144090 /* @ECU_Address@TSC_gov_acc_setpnt@0x0100F440@ */ ECIPP_ALIGNMENT_SLONG 800 Compu_TSC_gov_acc_setpnt -800 799.999999627471 /end CHARACTERISTIC
/begin COMPU_METHOD Compu_TSC_gov_acc_setpnt " " RAT_FUNC "%.1" "%" COEFFS 0 2684354.56 0 0 0 1 /end COMPU_METHOD
/begin CHARACTERISTIC SENT1_crc_type "SENT channel 1 CRC{SENT1_crc_type&0xff=0:Legacy - FEB2008}{SENT1_crc_type&0xff=1:Recommended - JAN2010}" VALUE 0x0014931B /* @ECU_Address@SENT1_crc_type@0x0100F4F8@ */ ECIPP_ALIGNMENT_UBYTE 255 SENT1_crc_type_COMPU_VTAB 0 255 BIT_MASK 0xff /end CHARACTERISTIC
/begin COMPU_METHOD SENT1_crc_type_COMPU_VTAB "Verbal Table" TAB_VERB "%.0" "list" COMPU_TAB_REF SENT1_crc_type_COMPU_VTAB_REF /end COMPU_METHOD
/begin COMPU_VTAB SENT1_crc_type_COMPU_VTAB_REF "Verbal Table" TAB_VERB 2 0 "Legacy - FEB2008" 1 "Recommended - JAN2010" DEFAULT_VALUE "UNKNOWN" /end COMPU_VTAB
/begin CHARACTERISTIC SENT2_crc_type "SENT channel 2 CRC{SENT2_crc_type&0xff=0:Legacy - FEB2008}{SENT2_crc_type&0xff=1:Recommended - JAN2010}" VALUE 0x00149333 /* @ECU_Address@SENT2_crc_type@0x0100F500@ */ ECIPP_ALIGNMENT_UBYTE 255 SENT2_crc_type_COMPU_VTAB 0 255 BIT_MASK 0xff /end CHARACTERISTIC
/begin COMPU_METHOD SENT2_crc_type_COMPU_VTAB "Verbal Table" TAB_VERB "%.0" "list" COMPU_TAB_REF SENT2_crc_type_COMPU_VTAB_REF /end COMPU_METHOD
/begin COMPU_VTAB SENT2_crc_type_COMPU_VTAB_REF "Verbal Table" TAB_VERB 2 0 "Legacy - FEB2008" 1 "Recommended - JAN2010" DEFAULT_VALUE "UNKNOWN" /end COMPU_VTAB
/begin CHARACTERISTIC SENT1_serial_def "Data default/init value" VALUE 0x00149318 /* @ECU_Address@SENT1_serial_def@0x0100F508@ */ ECIPP_ALIGNMENT_UWORD 65535 Compu_SENT1_serial_def 0 65535 /end CHARACTERISTIC
/begin COMPU_METHOD Compu_SENT1_serial_def " " RAT_FUNC "%.0" "integer" COEFFS 0 1 0 0 0 1 /end COMPU_METHOD
/begin CHARACTERISTIC SENT2_serial_def "Data default/init value" VALUE 0x00149330 /* @ECU_Address@SENT2_serial_def@0x0100F510@ */ ECIPP_ALIGNMENT_UWORD 65535 Compu_SENT2_serial_def 0 65535 /end CHARACTERISTIC
/begin COMPU_METHOD Compu_SENT2_serial_def " " RAT_FUNC "%.0" "integer" COEFFS 0 1 0 0 0 1 /end COMPU_METHOD
/begin MEASUREMENT SENT1_serial_data "Data" UWORD Compu_SENT1_serial_data 0 0 0 65535 ECU_ADDRESS 0x0100F518 /end MEASUREMENT
/begin COMPU_METHOD Compu_SENT1_serial_data " " RAT_FUNC "%.0" "integer" COEFFS 0 1 0 0 0 1 /end COMPU_METHOD
/begin MEASUREMENT SENT2_serial_data "Data" UWORD Compu_SENT2_serial_data 0 0 0 65535 ECU_ADDRESS 0x0100F520 /end MEASUREMENT
/begin COMPU_METHOD Compu_SENT2_serial_data " " RAT_FUNC "%.0" "integer" COEFFS 0 1 0 0 0 1 /end COMPU_METHOD
/begin MEASUREMENT SENT1_serial_msg_id "Message ID" UBYTE Compu_SENT1_serial_msg_id 0 0 0 255 ECU_ADDRESS 0x0100F528 /end MEASUREMENT
/begin COMPU_METHOD Compu_SENT1_serial_msg_id " " RAT_FUNC "%.0" "integer" COEFFS 0 1 0 0 0 1 /end COMPU_METHOD
/begin MEASUREMENT SENT2_serial_msg_id "Message ID" UBYTE Compu_SENT2_serial_msg_id 0 0 0 255 ECU_ADDRESS 0x0100F530 /end MEASUREMENT
/begin COMPU_METHOD Compu_SENT2_serial_msg_id " " RAT_FUNC "%.0" "integer" COEFFS 0 1 0 0 0 1 /end COMPU_METHOD
/begin MEASUREMENT SENT1_serial_crc_ok "CRC - matched" UWORD Compu_SENT1_serial_crc_ok 0 0 0 65535 ECU_ADDRESS 0x0100F538 /end MEASUREMENT
/begin COMPU_METHOD Compu_SENT1_serial_crc_ok " " RAT_FUNC "%.0" "count" COEFFS 0 1 0 0 0 1 /end COMPU_METHOD
/begin MEASUREMENT SENT2_serial_crc_ok "CRC - matched" UWORD Compu_SENT2_serial_crc_ok 0 0 0 65535 ECU_ADDRESS 0x0100F540 /end MEASUREMENT
/begin COMPU_METHOD Compu_SENT2_serial_crc_ok " " RAT_FUNC "%.0" "count" COEFFS 0 1 0 0 0 1 /end COMPU_METHOD
/begin MEASUREMENT SENT1_serial_crc_no "CRC - error" UWORD Compu_SENT1_serial_crc_no 0 0 0 65535 ECU_ADDRESS 0x0100F548 /end MEASUREMENT
/begin COMPU_METHOD Compu_SENT1_serial_crc_no " " RAT_FUNC "%.0" "count" COEFFS 0 1 0 0 0 1 /end COMPU_METHOD
/begin MEASUREMENT SENT2_serial_crc_no "CRC - error" UWORD Compu_SENT2_serial_crc_no 0 0 0 65535 ECU_ADDRESS 0x0100F550 /end MEASUREMENT
/begin COMPU_METHOD Compu_SENT2_serial_crc_no " " RAT_FUNC "%.0" "count" COEFFS 0 1 0 0 0 1 /end COMPU_METHOD
/begin MEASUREMENT SENT1_serial_resync "Resyncs" UWORD Compu_SENT1_serial_resync 0 0 0 65535 ECU_ADDRESS 0x0100F558 /end MEASUREMENT
/begin COMPU_METHOD Compu_SENT1_serial_resync " " RAT_FUNC "%.0" "count" COEFFS 0 1 0 0 0 1 /end COMPU_METHOD
/begin MEASUREMENT SENT2_serial_resync "Resyncs" UWORD Compu_SENT2_serial_resync 0 0 0 65535 ECU_ADDRESS 0x0100F560 /end MEASUREMENT
/begin COMPU_METHOD Compu_SENT2_serial_resync " " RAT_FUNC "%.0" "count" COEFFS 0 1 0 0 0 1 /end COMPU_METHOD
/begin CHARACTERISTIC CAN1_ISO15765_2_ena "ISO 15765-2{CAN1_ISO15765_2_ena&0xff=0:Disabled}{CAN1_ISO15765_2_ena&0xff=1:Enabled}" VALUE 0x0014856F /* @ECU_Address@CAN1_ISO15765_2_ena@0x0100F888@ */ ECIPP_ALIGNMENT_UBYTE 255 CAN1_ISO15765_2_ena_COMPU_VTAB 0 255 BIT_MASK 0xff /end CHARACTERISTIC
/begin COMPU_METHOD CAN1_ISO15765_2_ena_COMPU_VTAB "Verbal Table" TAB_VERB "%.0" "list" COMPU_TAB_REF CAN1_ISO15765_2_ena_COMPU_VTAB_REF /end COMPU_METHOD
/begin COMPU_VTAB CAN1_ISO15765_2_ena_COMPU_VTAB_REF "Verbal Table" TAB_VERB 2 0 "Disabled" 1 "Enabled" DEFAULT_VALUE "UNKNOWN" /end COMPU_VTAB
/begin CHARACTERISTIC CAN2_ISO15765_2_ena "ISO 15765-2{CAN2_ISO15765_2_ena&0xff=0:Disabled}{CAN2_ISO15765_2_ena&0xff=1:Enabled}" VALUE 0x00148907 /* @ECU_Address@CAN2_ISO15765_2_ena@0x0100F890@ */ ECIPP_ALIGNMENT_UBYTE 255 CAN2_ISO15765_2_ena_COMPU_VTAB 0 255 BIT_MASK 0xff /end CHARACTERISTIC
/begin COMPU_METHOD CAN2_ISO15765_2_ena_COMPU_VTAB "Verbal Table" TAB_VERB "%.0" "list" COMPU_TAB_REF CAN2_ISO15765_2_ena_COMPU_VTAB_REF /end COMPU_METHOD
/begin COMPU_VTAB CAN2_ISO15765_2_ena_COMPU_VTAB_REF "Verbal Table" TAB_VERB 2 0 "Disabled" 1 "Enabled" DEFAULT_VALUE "UNKNOWN" /end COMPU_VTAB
/begin CHARACTERISTIC CAN3_ISO15765_2_ena "ISO 15765-2{CAN3_ISO15765_2_ena&0xff=0:Disabled}{CAN3_ISO15765_2_ena&0xff=1:Enabled}" VALUE 0x00148C9F /* @ECU_Address@CAN3_ISO15765_2_ena@0x0100F898@ */ ECIPP_ALIGNMENT_UBYTE 255 CAN3_ISO15765_2_ena_COMPU_VTAB 0 255 BIT_MASK 0xff /end CHARACTERISTIC
/begin COMPU_METHOD CAN3_ISO15765_2_ena_COMPU_VTAB "Verbal Table" TAB_VERB "%.0" "list" COMPU_TAB_REF CAN3_ISO15765_2_ena_COMPU_VTAB_REF /end COMPU_METHOD
/begin COMPU_VTAB CAN3_ISO15765_2_ena_COMPU_VTAB_REF "Verbal Table" TAB_VERB 2 0 "Disabled" 1 "Enabled" DEFAULT_VALUE "UNKNOWN" /end COMPU_VTAB
/begin CHARACTERISTIC CAN1_ISO15765_2_cid "ISO 15765-2 CAN identifier{CAN1_ISO15765_2_cid&0xff=0:11-bit}{CAN1_ISO15765_2_cid&0xff=1:29-bit}{CAN1_ISO15765_2_cid&0xff=2:11-bit and 29-bit}" VALUE 0x00148570 /* @ECU_Address@CAN1_ISO15765_2_cid@0x0100F8A0@ */ ECIPP_ALIGNMENT_UBYTE 255 CAN1_ISO15765_2_cid_COMPU_VTAB 0 255 BIT_MASK 0xff /end CHARACTERISTIC
/begin COMPU_METHOD CAN1_ISO15765_2_cid_COMPU_VTAB "Verbal Table" TAB_VERB "%.0" "list" COMPU_TAB_REF CAN1_ISO15765_2_cid_COMPU_VTAB_REF /end COMPU_METHOD
/begin COMPU_VTAB CAN1_ISO15765_2_cid_COMPU_VTAB_REF "Verbal Table" TAB_VERB 3 0 "11-bit" 1 "29-bit" 2 "11-bit and 29-bit" DEFAULT_VALUE "UNKNOWN" /end COMPU_VTAB
/begin CHARACTERISTIC CAN2_ISO15765_2_cid "ISO 15765-2 CAN identifier{CAN2_ISO15765_2_cid&0xff=0:11-bit}{CAN2_ISO15765_2_cid&0xff=1:29-bit}{CAN2_ISO15765_2_cid&0xff=2:11-bit and 29-bit}" VALUE 0x00148908 /* @ECU_Address@CAN2_ISO15765_2_cid@0x0100F8A8@ */ ECIPP_ALIGNMENT_UBYTE 255 CAN2_ISO15765_2_cid_COMPU_VTAB 0 255 BIT_MASK 0xff /end CHARACTERISTIC
/begin COMPU_METHOD CAN2_ISO15765_2_cid_COMPU_VTAB "Verbal Table" TAB_VERB "%.0" "list" COMPU_TAB_REF CAN2_ISO15765_2_cid_COMPU_VTAB_REF /end COMPU_METHOD
/begin COMPU_VTAB CAN2_ISO15765_2_cid_COMPU_VTAB_REF "Verbal Table" TAB_VERB 3 0 "11-bit" 1 "29-bit" 2 "11-bit and 29-bit" DEFAULT_VALUE "UNKNOWN" /end COMPU_VTAB
/begin CHARACTERISTIC CAN3_ISO15765_2_cid "ISO 15765-2 CAN identifier{CAN3_ISO15765_2_cid&0xff=0:11-bit}{CAN3_ISO15765_2_cid&0xff=1:29-bit}{CAN3_ISO15765_2_cid&0xff=2:11-bit and 29-bit}" VALUE 0x00148CA0 /* @ECU_Address@CAN3_ISO15765_2_cid@0x0100F8B0@ */ ECIPP_ALIGNMENT_UBYTE 255 CAN3_ISO15765_2_cid_COMPU_VTAB 0 255 BIT_MASK 0xff /end CHARACTERISTIC
/begin COMPU_METHOD CAN3_ISO15765_2_cid_COMPU_VTAB "Verbal Table" TAB_VERB "%.0" "list" COMPU_TAB_REF CAN3_ISO15765_2_cid_COMPU_VTAB_REF /end COMPU_METHOD
/begin COMPU_VTAB CAN3_ISO15765_2_cid_COMPU_VTAB_REF "Verbal Table" TAB_VERB 3 0 "11-bit" 1 "29-bit" 2 "11-bit and 29-bit" DEFAULT_VALUE "UNKNOWN" /end COMPU_VTAB
/begin CHARACTERISTIC CAN1_J1939_DM1_ena "J1939 DM1 broadcast{CAN1_J1939_DM1_ena&0xff=0:Disabled}{CAN1_J1939_DM1_ena&0xff=1:Enabled}" VALUE 0x00148573 /* @ECU_Address@CAN1_J1939_DM1_ena@0x010102C0@ */ ECIPP_ALIGNMENT_UBYTE 255 CAN1_J1939_DM1_ena_COMPU_VTAB 0 255 BIT_MASK 0xff /end CHARACTERISTIC
/begin COMPU_METHOD CAN1_J1939_DM1_ena_COMPU_VTAB "Verbal Table" TAB_VERB "%.0" "list" COMPU_TAB_REF CAN1_J1939_DM1_ena_COMPU_VTAB_REF /end COMPU_METHOD
/begin COMPU_VTAB CAN1_J1939_DM1_ena_COMPU_VTAB_REF "Verbal Table" TAB_VERB 2 0 "Disabled" 1 "Enabled" DEFAULT_VALUE "UNKNOWN" /end COMPU_VTAB
/begin CHARACTERISTIC CAN2_J1939_DM1_ena "J1939 DM1 broadcast{CAN2_J1939_DM1_ena&0xff=0:Disabled}{CAN2_J1939_DM1_ena&0xff=1:Enabled}" VALUE 0x0014890B /* @ECU_Address@CAN2_J1939_DM1_ena@0x010102C8@ */ ECIPP_ALIGNMENT_UBYTE 255 CAN2_J1939_DM1_ena_COMPU_VTAB 0 255 BIT_MASK 0xff /end CHARACTERISTIC
/begin COMPU_METHOD CAN2_J1939_DM1_ena_COMPU_VTAB "Verbal Table" TAB_VERB "%.0" "list" COMPU_TAB_REF CAN2_J1939_DM1_ena_COMPU_VTAB_REF /end COMPU_METHOD
/begin COMPU_VTAB CAN2_J1939_DM1_ena_COMPU_VTAB_REF "Verbal Table" TAB_VERB 2 0 "Disabled" 1 "Enabled" DEFAULT_VALUE "UNKNOWN" /end COMPU_VTAB
/begin CHARACTERISTIC CAN3_J1939_DM1_ena "J1939 DM1 broadcast{CAN3_J1939_DM1_ena&0xff=0:Disabled}{CAN3_J1939_DM1_ena&0xff=1:Enabled}" VALUE 0x00148CA3 /* @ECU_Address@CAN3_J1939_DM1_ena@0x010102D0@ */ ECIPP_ALIGNMENT_UBYTE 255 CAN3_J1939_DM1_ena_COMPU_VTAB 0 255 BIT_MASK 0xff /end CHARACTERISTIC
/begin COMPU_METHOD CAN3_J1939_DM1_ena_COMPU_VTAB "Verbal Table" TAB_VERB "%.0" "list" COMPU_TAB_REF CAN3_J1939_DM1_ena_COMPU_VTAB_REF /end COMPU_METHOD
/begin COMPU_VTAB CAN3_J1939_DM1_ena_COMPU_VTAB_REF "Verbal Table" TAB_VERB 2 0 "Disabled" 1 "Enabled" DEFAULT_VALUE "UNKNOWN" /end COMPU_VTAB
/begin CHARACTERISTIC CAN1_CCP_chksum "CCP checksum{CAN1_CCP_chksum&0xff=0:Add16 Sum32 - Legacy}{CAN1_CCP_chksum&0xff=1:Add8 Sum32 - A2L}" VALUE 0x00148564 /* @ECU_Address@CAN1_CCP_chksum@0x010102F8@ */ ECIPP_ALIGNMENT_UBYTE 255 CAN1_CCP_chksum_COMPU_VTAB 0 255 BIT_MASK 0xff /end CHARACTERISTIC
/begin COMPU_METHOD CAN1_CCP_chksum_COMPU_VTAB "Verbal Table" TAB_VERB "%.0" "list" COMPU_TAB_REF CAN1_CCP_chksum_COMPU_VTAB_REF /end COMPU_METHOD
/begin COMPU_VTAB CAN1_CCP_chksum_COMPU_VTAB_REF "Verbal Table" TAB_VERB 2 0 "Add16 Sum32 - Legacy" 1 "Add8 Sum32 - A2L" DEFAULT_VALUE "UNKNOWN" /end COMPU_VTAB
/begin CHARACTERISTIC CAN2_CCP_chksum "CCP checksum{CAN2_CCP_chksum&0xff=0:Add16 Sum32 - Legacy}{CAN2_CCP_chksum&0xff=1:Add8 Sum32 - A2L}" VALUE 0x001488FC /* @ECU_Address@CAN2_CCP_chksum@0x01010300@ */ ECIPP_ALIGNMENT_UBYTE 255 CAN2_CCP_chksum_COMPU_VTAB 0 255 BIT_MASK 0xff /end CHARACTERISTIC
/begin COMPU_METHOD CAN2_CCP_chksum_COMPU_VTAB "Verbal Table" TAB_VERB "%.0" "list" COMPU_TAB_REF CAN2_CCP_chksum_COMPU_VTAB_REF /end COMPU_METHOD
/begin COMPU_VTAB CAN2_CCP_chksum_COMPU_VTAB_REF "Verbal Table" TAB_VERB 2 0 "Add16 Sum32 - Legacy" 1 "Add8 Sum32 - A2L" DEFAULT_VALUE "UNKNOWN" /end COMPU_VTAB
/begin CHARACTERISTIC CAN3_CCP_chksum "CCP checksum{CAN3_CCP_chksum&0xff=0:Add16 Sum32 - Legacy}{CAN3_CCP_chksum&0xff=1:Add8 Sum32 - A2L}" VALUE 0x00148C94 /* @ECU_Address@CAN3_CCP_chksum@0x01010308@ */ ECIPP_ALIGNMENT_UBYTE 255 CAN3_CCP_chksum_COMPU_VTAB 0 255 BIT_MASK 0xff /end CHARACTERISTIC
/begin COMPU_METHOD CAN3_CCP_chksum_COMPU_VTAB "Verbal Table" TAB_VERB "%.0" "list" COMPU_TAB_REF CAN3_CCP_chksum_COMPU_VTAB_REF /end COMPU_METHOD
/begin COMPU_VTAB CAN3_CCP_chksum_COMPU_VTAB_REF "Verbal Table" TAB_VERB 2 0 "Add16 Sum32 - Legacy" 1 "Add8 Sum32 - A2L" DEFAULT_VALUE "UNKNOWN" /end COMPU_VTAB
/begin CHARACTERISTIC EBC1_hybrid_mode "J1939 EBC1 hybrid mode{EBC1_hybrid_mode&0xff=0x00:Disabled}{EBC1_hybrid_mode&0xff=0x01:Enabled}" VALUE 0x00147d12 /* @ECU_Address@EBC1_hybrid_mode@0x01010388@ */ ECIPP_ALIGNMENT_UBYTE 255 EBC1_hybrid_mode_COMPU_VTAB 0 255 BIT_MASK 0xff /end CHARACTERISTIC
/begin COMPU_METHOD EBC1_hybrid_mode_COMPU_VTAB "Verbal Table" TAB_VERB "%.0" "list" COMPU_TAB_REF EBC1_hybrid_mode_COMPU_VTAB_REF /end COMPU_METHOD
/begin COMPU_VTAB EBC1_hybrid_mode_COMPU_VTAB_REF "Verbal Table" TAB_VERB 2 0x00 "Disabled" 0x01 "Enabled" DEFAULT_VALUE "UNKNOWN" /end COMPU_VTAB
/begin CHARACTERISTIC CCP_DAQ_ena "CCP DAQ mode{CCP_DAQ_ena&0xff=0:Disabled}{CCP_DAQ_ena&0xff=1:CAN1 - 5ms}{CCP_DAQ_ena&0xff=2:CAN1 - 10ms}{CCP_DAQ_ena&0xff=3:CAN2 - 5ms}{CCP_DAQ_ena&0xff=4:CAN2 - 10ms}{CCP_DAQ_ena&0xff=5:CAN3 - 5ms}{CCP_DAQ_ena&0xff=6:CAN3 - 10ms}" VALUE 0x00147cef /* @ECU_Address@CCP_DAQ_ena@0x01010390@ */ ECIPP_ALIGNMENT_UBYTE 255 CCP_DAQ_ena_COMPU_VTAB 0 255 BIT_MASK 0xff /end CHARACTERISTIC
/begin COMPU_METHOD CCP_DAQ_ena_COMPU_VTAB "Verbal Table" TAB_VERB "%.0" "list" COMPU_TAB_REF CCP_DAQ_ena_COMPU_VTAB_REF /end COMPU_METHOD
/begin COMPU_VTAB CCP_DAQ_ena_COMPU_VTAB_REF "Verbal Table" TAB_VERB 7 0 "Disabled" 1 "CAN1 - 5ms" 2 "CAN1 - 10ms" 3 "CAN2 - 5ms" 4 "CAN2 - 10ms" 5 "CAN3 - 5ms" 6 "CAN3 - 10ms" DEFAULT_VALUE "UNKNOWN" /end COMPU_VTAB
/begin MEASUREMENT PGrq_last_PGN "Last PGN req PGN" ULONG Compu_PGrq_last_PGN 0 0 0 4294967295 ECU_ADDRESS 0x010105F0 /end MEASUREMENT
/begin COMPU_METHOD Compu_PGrq_last_PGN " " RAT_FUNC "%.0" "PGN" COEFFS 0 1 0 0 0 1 /end COMPU_METHOD
/begin MEASUREMENT PGrq2_last_PGN "Last PGN req2 PGN" ULONG Compu_PGrq2_last_PGN 0 0 0 4294967295 ECU_ADDRESS 0x010105F8 /end MEASUREMENT
/begin COMPU_METHOD Compu_PGrq2_last_PGN " " RAT_FUNC "%.0" "PGN" COEFFS 0 1 0 0 0 1 /end COMPU_METHOD
/begin MEASUREMENT PGrq3_last_PGN "Last PGN req3 PGN" ULONG Compu_PGrq3_last_PGN 0 0 0 4294967295 ECU_ADDRESS 0x01010600 /end MEASUREMENT
/begin COMPU_METHOD Compu_PGrq3_last_PGN " " RAT_FUNC "%.0" "PGN" COEFFS 0 1 0 0 0 1 /end COMPU_METHOD
/begin MEASUREMENT NACK_last_PGN "Last NACK PGN" ULONG Compu_NACK_last_PGN 0 0 0 4294967295 ECU_ADDRESS 0x01010608 /end MEASUREMENT
/begin COMPU_METHOD Compu_NACK_last_PGN " " RAT_FUNC "%.0" "PGN" COEFFS 0 1 0 0 0 1 /end COMPU_METHOD
/begin MEASUREMENT NACK2_last_PGN "Last NACK2 PGN" ULONG Compu_NACK2_last_PGN 0 0 0 4294967295 ECU_ADDRESS 0x01010610 /end MEASUREMENT
/begin COMPU_METHOD Compu_NACK2_last_PGN " " RAT_FUNC "%.0" "PGN" COEFFS 0 1 0 0 0 1 /end COMPU_METHOD
/begin MEASUREMENT NACK3_last_PGN "Last NACK3 PGN" ULONG Compu_NACK3_last_PGN 0 0 0 4294967295 ECU_ADDRESS 0x01010618 /end MEASUREMENT
/begin COMPU_METHOD Compu_NACK3_last_PGN " " RAT_FUNC "%.0" "PGN" COEFFS 0 1 0 0 0 1 /end COMPU_METHOD
/begin MEASUREMENT DENIED_last_PGN "Last DENIED PGN" ULONG Compu_DENIED_last_PGN 0 0 0 4294967295 ECU_ADDRESS 0x01010620 /end MEASUREMENT
/begin COMPU_METHOD Compu_DENIED_last_PGN " " RAT_FUNC "%.0" "PGN" COEFFS 0 1 0 0 0 1 /end COMPU_METHOD
/begin MEASUREMENT DENIED2_last_PGN "Last DENIED2 PGN" ULONG Compu_DENIED2_last_PGN 0 0 0 4294967295 ECU_ADDRESS 0x01010628 /end MEASUREMENT
/begin COMPU_METHOD Compu_DENIED2_last_PGN " " RAT_FUNC "%.0" "PGN" COEFFS 0 1 0 0 0 1 /end COMPU_METHOD
/begin MEASUREMENT DENIED3_last_PGN "Last DENIED3 PGN" ULONG Compu_DENIED3_last_PGN 0 0 0 4294967295 ECU_ADDRESS 0x01010630 /end MEASUREMENT
/begin COMPU_METHOD Compu_DENIED3_last_PGN " " RAT_FUNC "%.0" "PGN" COEFFS 0 1 0 0 0 1 /end COMPU_METHOD
/begin MEASUREMENT J1939_Vdot_f_ports "J1939 engine fuel rate" UWORD Compu_J1939_Vdot_f_ports 0 0 0 3276.75 ECU_ADDRESS 0x010106F0 /end MEASUREMENT
/begin COMPU_METHOD Compu_J1939_Vdot_f_ports " " RAT_FUNC "%.2" "liters/hr" COEFFS 0 20 0 0 0 1 /end COMPU_METHOD
/begin MEASUREMENT RMT_loadlim_tbl "Load-limit table select command{RMT_loadlim_tbl&0xff=0:None}{RMT_loadlim_tbl&0xff=1:Table 1}{RMT_loadlim_tbl&0xff=2:Table 2}{RMT_loadlim_tbl&0xff=3:Table 3}{RMT_loadlim_tbl&0xff=4:Table 4}{RMT_loadlim_tbl&0xff=5:Table 5}{RMT_loadlim_tbl&0xff=6:Table 6}{RM" UBYTE RMT_loadlim_tbl_COMPU_VTAB 0 0 0 255 ECU_ADDRESS 0x010108D8 BIT_MASK 0xff /end MEASUREMENT
/begin COMPU_METHOD RMT_loadlim_tbl_COMPU_VTAB "Verbal Table" TAB_VERB "%.0" "list" COMPU_TAB_REF RMT_loadlim_tbl_COMPU_VTAB_REF /end COMPU_METHOD
/begin COMPU_VTAB RMT_loadlim_tbl_COMPU_VTAB_REF "Verbal Table" TAB_VERB 9 0 "None" 1 "Table 1" 2 "Table 2" 3 "Table 3" 4 "Table 4" 5 "Table 5" 6 "Table 6" 7 "Table 7" 8 "Table 8" DEFAULT_VALUE "UNKNOWN" /end COMPU_VTAB
/begin CHARACTERISTIC GLOW_type "Glow device output type{GLOW_type&0xff=0:Disabled}{GLOW_type&0xff=1:Direct output}{GLOW_type&0xff=2:Glow control unit}" VALUE 0x00147d9f /* @ECU_Address@GLOW_type@0x01011470@ */ ECIPP_ALIGNMENT_UBYTE 255 GLOW_type_COMPU_VTAB 0 255 BIT_MASK 0xff /end CHARACTERISTIC
/begin COMPU_METHOD GLOW_type_COMPU_VTAB "Verbal Table" TAB_VERB "%.0" "list" COMPU_TAB_REF GLOW_type_COMPU_VTAB_REF /end COMPU_METHOD
/begin COMPU_VTAB GLOW_type_COMPU_VTAB_REF "Verbal Table" TAB_VERB 3 0 "Disabled" 1 "Direct output" 2 "Glow control unit" DEFAULT_VALUE "UNKNOWN" /end COMPU_VTAB
/begin CHARACTERISTIC GLOW_mode "Glow control mode{GLOW_mode&0xff=0:Pre-glow only}{GLOW_mode&0xff=1:Pre- & post-glow}" VALUE 0x00147d9d /* @ECU_Address@GLOW_mode@0x01011478@ */ ECIPP_ALIGNMENT_UBYTE 255 GLOW_mode_COMPU_VTAB 0 255 BIT_MASK 0xff /end CHARACTERISTIC
/begin COMPU_METHOD GLOW_mode_COMPU_VTAB "Verbal Table" TAB_VERB "%.0" "list" COMPU_TAB_REF GLOW_mode_COMPU_VTAB_REF /end COMPU_METHOD
/begin COMPU_VTAB GLOW_mode_COMPU_VTAB_REF "Verbal Table" TAB_VERB 2 0 "Pre-glow only" 1 "Pre- & post-glow" DEFAULT_VALUE "UNKNOWN" /end COMPU_VTAB
/begin CHARACTERISTIC GLOW_channel "Glow output channel{GLOW_channel&0xff=0:Disabled}{GLOW_channel&0xff=1:Buzzer Output}{GLOW_channel&0xff=2:MIL Output}{GLOW_channel&0xff=3:TACH Output}{GLOW_channel&0xff=4:Starter Output}{GLOW_channel&0xff=5:EGOH1}{GLOW_channel&0xff=6:EGOH2}{GLOW_channel&0x" VALUE 0x00147d9b /* @ECU_Address@GLOW_channel@0x01011480@ */ ECIPP_ALIGNMENT_UBYTE 255 GLOW_channel_COMPU_VTAB 0 255 BIT_MASK 0xff /end CHARACTERISTIC
/begin COMPU_METHOD GLOW_channel_COMPU_VTAB "Verbal Table" TAB_VERB "%.0" "list" COMPU_TAB_REF GLOW_channel_COMPU_VTAB_REF /end COMPU_METHOD
/begin COMPU_VTAB GLOW_channel_COMPU_VTAB_REF "Verbal Table" TAB_VERB 19 0 "Disabled" 1 "Buzzer Output" 2 "MIL Output" 3 "TACH Output" 4 "Starter Output" 5 "EGOH1" 6 "EGOH2" 7 "EGOH3" 8 "EGOH4" 9 "Aux PWM1" 10 "Aux PWM2" 11 "Aux PWM3" 12 "Aux PWM4" 13 "Aux PWM5" 14 "Aux PWM6" 15 "Aux PWM7" 16 "Aux PWM8" 17 "Aux PWM9" 18 "Aux PWM10" DEFAULT_VALUE "UNKNOWN" /end COMPU_VTAB
/begin CHARACTERISTIC GLOW_GCU_diag_in "GCU diag. input channel{GLOW_GCU_diag_in&0xff=0:Disabled}{GLOW_GCU_diag_in&0xff=1:Aux PU1}{GLOW_GCU_diag_in&0xff=2:Aux PU2}{GLOW_GCU_diag_in&0xff=3:Aux PU3}{GLOW_GCU_diag_in&0xff=4:Aux PD1}{GLOW_GCU_diag_in&0xff=5:Aux PD2}{GLOW_GCU_diag_in&0xff=6:Aux PD3}" VALUE 0x00147d9a /* @ECU_Address@GLOW_GCU_diag_in@0x01011488@ */ ECIPP_ALIGNMENT_UBYTE 255 GLOW_GCU_diag_in_COMPU_VTAB 0 255 BIT_MASK 0xff /end CHARACTERISTIC
/begin COMPU_METHOD GLOW_GCU_diag_in_COMPU_VTAB "Verbal Table" TAB_VERB "%.0" "list" COMPU_TAB_REF GLOW_GCU_diag_in_COMPU_VTAB_REF /end COMPU_METHOD
/begin COMPU_VTAB GLOW_GCU_diag_in_COMPU_VTAB_REF "Verbal Table" TAB_VERB 14 0 "Disabled" 1 "Aux PU1" 2 "Aux PU2" 3 "Aux PU3" 4 "Aux PD1" 5 "Aux PD2" 6 "Aux PD3" 7 "Aux PUD1" 8 "Aux PUD2" 9 "Aux PUD3" 10 "Aux PUD4" 11 "Aux PUD5" 12 "Aux PUD6" 13 "Aux PUD7" DEFAULT_VALUE "UNKNOWN" /end COMPU_VTAB
/begin CHARACTERISTIC GLOW_temp_input "Glow temperature input{GLOW_temp_input&0xff=0:Ambient air temperature}{GLOW_temp_input&0xff=1:Engine coolant temperature}{GLOW_temp_input&0xff=2:Oil temperature}{GLOW_temp_input&0xff=3:Cylinder head temperature}" VALUE 0x00147d9e /* @ECU_Address@GLOW_temp_input@0x01011490@ */ ECIPP_ALIGNMENT_UBYTE 255 GLOW_temp_input_COMPU_VTAB 0 255 BIT_MASK 0xff /end CHARACTERISTIC
/begin COMPU_METHOD GLOW_temp_input_COMPU_VTAB "Verbal Table" TAB_VERB "%.0" "list" COMPU_TAB_REF GLOW_temp_input_COMPU_VTAB_REF /end COMPU_METHOD
/begin COMPU_VTAB GLOW_temp_input_COMPU_VTAB_REF "Verbal Table" TAB_VERB 4 0 "Ambient air temperature" 1 "Engine coolant temperature" 2 "Oil temperature" 3 "Cylinder head temperature" DEFAULT_VALUE "UNKNOWN" /end COMPU_VTAB
/begin CHARACTERISTIC GLOW_Vbat_high "Glow Vbat high" VALUE 0x0014742a /* @ECU_Address@GLOW_Vbat_high@0x01011498@ */ ECIPP_ALIGNMENT_UWORD 256 Compu_GLOW_Vbat_high 0 255.99609375 /end CHARACTERISTIC
/begin COMPU_METHOD Compu_GLOW_Vbat_high " " RAT_FUNC "%.1" "V" COEFFS 0 256 0 0 0 1 /end COMPU_METHOD
/begin CHARACTERISTIC GLOW_pre_Vbat_low "Glow Vbat low" VALUE 0x0014742c /* @ECU_Address@GLOW_pre_Vbat_low@0x010114A0@ */ ECIPP_ALIGNMENT_UWORD 256 Compu_GLOW_pre_Vbat_low 0 255.99609375 /end CHARACTERISTIC
/begin COMPU_METHOD Compu_GLOW_pre_Vbat_low " " RAT_FUNC "%.1" "V" COEFFS 0 256 0 0 0 1 /end COMPU_METHOD
/begin CHARACTERISTIC GLOW_ECT_high "Glow temp high thld" VALUE 0x00147428 /* @ECU_Address@GLOW_ECT_high@0x010114A8@ */ ECIPP_ALIGNMENT_UWORD 564 Compu_GLOW_ECT_high -460 563.984375 /end CHARACTERISTIC
/begin COMPU_METHOD Compu_GLOW_ECT_high " " RAT_FUNC "%.0" "deg F" COEFFS 0 64 29440 0 0 1 /end COMPU_METHOD
/begin CHARACTERISTIC GLOW_pre_keyon_wt "Glow key-on wait time" VALUE 0x0014742e /* @ECU_Address@GLOW_pre_keyon_wt@0x010114B0@ */ ECIPP_ALIGNMENT_UWORD 65535 Compu_GLOW_pre_keyon_wt 0 65535 /end CHARACTERISTIC
/begin COMPU_METHOD Compu_GLOW_pre_keyon_wt " " RAT_FUNC "%.0" "ms" COEFFS 0 1 0 0 0 1 /end COMPU_METHOD
/begin CHARACTERISTIC GLOW_shutoff_temp "Glow shut-off temp." VALUE 0x00147432 /* @ECU_Address@GLOW_shutoff_temp@0x010114B8@ */ ECIPP_ALIGNMENT_UWORD 564 Compu_GLOW_shutoff_temp -460 563.984375 /end CHARACTERISTIC
/begin COMPU_METHOD Compu_GLOW_shutoff_temp " " RAT_FUNC "%.0" "deg F" COEFFS 0 64 29440 0 0 1 /end COMPU_METHOD
/begin CHARACTERISTIC GLOW_time_max "Maximum glow time" VALUE 0x00147436 /* @ECU_Address@GLOW_time_max@0x010114C0@ */ ECIPP_ALIGNMENT_UWORD 1049 Compu_GLOW_time_max 0 1048.56 /end CHARACTERISTIC
/begin COMPU_METHOD Compu_GLOW_time_max " " RAT_FUNC "%.1" "seconds" COEFFS 0 62.5 0 0 0 1 /end COMPU_METHOD
/begin CHARACTERISTIC GLOW_voltage "Target glow voltage" VALUE 0x00147438 /* @ECU_Address@GLOW_voltage@0x010114C8@ */ ECIPP_ALIGNMENT_UWORD 256 Compu_GLOW_voltage 0 255.99609375 /end CHARACTERISTIC
/begin COMPU_METHOD Compu_GLOW_voltage " " RAT_FUNC "%.1" "V" COEFFS 0 256 0 0 0 1 /end COMPU_METHOD
/begin CHARACTERISTIC GLOW_DC_min "Min. glow output DC" VALUE 0x00147426 /* @ECU_Address@GLOW_DC_min@0x010114D0@ */ ECIPP_ALIGNMENT_UWORD 100 Compu_GLOW_DC_min 0 99.9984741210938 /end CHARACTERISTIC
/begin COMPU_METHOD Compu_GLOW_DC_min " " RAT_FUNC "%.1" "%" COEFFS 0 655.36 0 0 0 1 /end COMPU_METHOD
/begin CHARACTERISTIC GLOW_DC_max "Max. glow output DC" VALUE 0x00147424 /* @ECU_Address@GLOW_DC_max@0x010114D8@ */ ECIPP_ALIGNMENT_UWORD 100 Compu_GLOW_DC_max 0 99.9984741210938 /end CHARACTERISTIC
/begin COMPU_METHOD Compu_GLOW_DC_max " " RAT_FUNC "%.1" "%" COEFFS 0 655.36 0 0 0 1 /end COMPU_METHOD
/begin MEASUREMENT GLOW_state "Glow state{GLOW_state&0xff=0x00:GLOW_INIT}{GLOW_state&0xff=0x01:GLOW_WAIT_FOR_STOP}{GLOW_state&0xff=0x02:GLOW_PRE_ACTIVE_ENGINE_STOPPED}{GLOW_state&0xff=0x03:GLOW_PRE_PERSIST_ENGINE_RUNNING}{GLOW_state&0xff=0x04:GLOW_POST_ACTIVE_ENGINE_RUNNING}{GLOW_state" UBYTE GLOW_state_COMPU_VTAB 0 0 0 255 ECU_ADDRESS 0x010114E0 BIT_MASK 0xff /end MEASUREMENT
/begin COMPU_METHOD GLOW_state_COMPU_VTAB "Verbal Table" TAB_VERB "%.0" "list" COMPU_TAB_REF GLOW_state_COMPU_VTAB_REF /end COMPU_METHOD
/begin COMPU_VTAB GLOW_state_COMPU_VTAB_REF "Verbal Table" TAB_VERB 9 0x00 "GLOW_INIT" 0x01 "GLOW_WAIT_FOR_STOP" 0x02 "GLOW_PRE_ACTIVE_ENGINE_STOPPED" 0x03 "GLOW_PRE_PERSIST_ENGINE_RUNNING" 0x04 "GLOW_POST_ACTIVE_ENGINE_RUNNING" 0x05 "GLOW_COMPLETE" 0x06 "GLOW_ABORT" 0x07 "GLOW_WAIT_FOR_START" 0x08 "GLOW_INTERMEDIATE" DEFAULT_VALUE "UNKNOWN" /end COMPU_VTAB
/begin MEASUREMENT GLOW_temp "Glow feedback temp." UWORD Compu_GLOW_temp 0 0 -460 563.984375 ECU_ADDRESS 0x010114E8 /end MEASUREMENT
/begin COMPU_METHOD Compu_GLOW_temp " " RAT_FUNC "%.0" "deg F" COEFFS 0 64 29440 0 0 1 /end COMPU_METHOD
/begin MEASUREMENT GLOW_pre_ms "Pre-glow timer" ULONG Compu_GLOW_pre_ms 0 0 0 4294967.295 ECU_ADDRESS 0x010114F0 /end MEASUREMENT
/begin COMPU_METHOD Compu_GLOW_pre_ms " " RAT_FUNC "%.1" "seconds" COEFFS 0 1000 0 0 0 1 /end COMPU_METHOD
/begin MEASUREMENT GLOW_max_ms "Max glow timer" ULONG Compu_GLOW_max_ms 0 0 0 4294967.295 ECU_ADDRESS 0x010114F8 /end MEASUREMENT
/begin COMPU_METHOD Compu_GLOW_max_ms " " RAT_FUNC "%.1" "seconds" COEFFS 0 1000 0 0 0 1 /end COMPU_METHOD
/begin MEASUREMENT GLOW_active "Glow activity{GLOW_active&0xff=0x00:Inactive}{GLOW_active&0xff=0x01:Active}" UBYTE GLOW_active_COMPU_VTAB 0 0 0 255 ECU_ADDRESS 0x01011500 BIT_MASK 0xff /end MEASUREMENT
/begin COMPU_METHOD GLOW_active_COMPU_VTAB "Verbal Table" TAB_VERB "%.0" "list" COMPU_TAB_REF GLOW_active_COMPU_VTAB_REF /end COMPU_METHOD
/begin COMPU_VTAB GLOW_active_COMPU_VTAB_REF "Verbal Table" TAB_VERB 2 0x00 "Inactive" 0x01 "Active" DEFAULT_VALUE "UNKNOWN" /end COMPU_VTAB
/begin CHARACTERISTIC GLOW_lamp_channel "Glow lamp channel{GLOW_lamp_channel&0xff=0:Disabled}{GLOW_lamp_channel&0xff=1:Buzzer Output}{GLOW_lamp_channel&0xff=2:MIL Output}{GLOW_lamp_channel&0xff=3:TACH Output}{GLOW_lamp_channel&0xff=4:Starter Output}{GLOW_lamp_channel&0xff=5:EGOH1}{GLOW_lamp_chan" VALUE 0x00147d9c /* @ECU_Address@GLOW_lamp_channel@0x01011980@ */ ECIPP_ALIGNMENT_UBYTE 255 GLOW_lamp_channel_COMPU_VTAB 0 255 BIT_MASK 0xff /end CHARACTERISTIC
/begin COMPU_METHOD GLOW_lamp_channel_COMPU_VTAB "Verbal Table" TAB_VERB "%.0" "list" COMPU_TAB_REF GLOW_lamp_channel_COMPU_VTAB_REF /end COMPU_METHOD
/begin COMPU_VTAB GLOW_lamp_channel_COMPU_VTAB_REF "Verbal Table" TAB_VERB 19 0 "Disabled" 1 "Buzzer Output" 2 "MIL Output" 3 "TACH Output" 4 "Starter Output" 5 "EGOH1" 6 "EGOH2" 7 "EGOH3" 8 "EGOH4" 9 "Aux PWM1" 10 "Aux PWM2" 11 "Aux PWM3" 12 "Aux PWM4" 13 "Aux PWM5" 14 "Aux PWM6" 15 "Aux PWM7" 16 "Aux PWM8" 17 "Aux PWM9" 18 "Aux PWM10" DEFAULT_VALUE "UNKNOWN" /end COMPU_VTAB
/begin CHARACTERISTIC GLOW_pre_time_max "Maximum pre-glow time" VALUE 0x00147430 /* @ECU_Address@GLOW_pre_time_max@0x01011988@ */ ECIPP_ALIGNMENT_UWORD 1049 Compu_GLOW_pre_time_max 0 1048.56 /end CHARACTERISTIC
/begin COMPU_METHOD Compu_GLOW_pre_time_max " " RAT_FUNC "%.0" "seconds" COEFFS 0 62.5 0 0 0 1 /end COMPU_METHOD
/begin MEASUREMENT GLOW_post_ms "Post-glow timer" ULONG Compu_GLOW_post_ms 0 0 0 4294967.295 ECU_ADDRESS 0x01011990 /end MEASUREMENT
/begin COMPU_METHOD Compu_GLOW_post_ms " " RAT_FUNC "%.1" "seconds" COEFFS 0 1000 0 0 0 1 /end COMPU_METHOD
/begin MEASUREMENT GLOW_pre_max_ms "Pre-glow timer" ULONG Compu_GLOW_pre_max_ms 0 0 0 4294967.295 ECU_ADDRESS 0x01011998 /end MEASUREMENT
/begin COMPU_METHOD Compu_GLOW_pre_max_ms " " RAT_FUNC "%.1" "seconds" COEFFS 0 1000 0 0 0 1 /end COMPU_METHOD
/begin CHARACTERISTIC GLOW_starter_pause "Glow starter in-rush pause time" VALUE 0x00147434 /* @ECU_Address@GLOW_starter_pause@0x010119A0@ */ ECIPP_ALIGNMENT_UWORD 65535 Compu_GLOW_starter_pause 0 65535 /end CHARACTERISTIC
/begin COMPU_METHOD Compu_GLOW_starter_pause " " RAT_FUNC "%.0" "ms" COEFFS 0 1 0 0 0 1 /end COMPU_METHOD
/begin CHARACTERISTIC CLNG_Kp_p_ROL "Kp increasing ROL" VALUE 0x00142858 /* @ECU_Address@CLNG_Kp_p_ROL@0x01011D60@ */ ECIPP_ALIGNMENT_SWORD 100 Compu_CLNG_Kp_p_ROL -100 99.9969482421875 /end CHARACTERISTIC
/begin COMPU_METHOD Compu_CLNG_Kp_p_ROL " " RAT_FUNC "%.1" "%" COEFFS 0 327.68 0 0 0 1 /end COMPU_METHOD
/begin CHARACTERISTIC CLNG_Kp_n_ROL "Kp decreasing ROL" VALUE 0x0014285A /* @ECU_Address@CLNG_Kp_n_ROL@0x01011D78@ */ ECIPP_ALIGNMENT_SWORD 100 Compu_CLNG_Kp_n_ROL -100 99.9969482421875 /end CHARACTERISTIC
/begin COMPU_METHOD Compu_CLNG_Kp_n_ROL " " RAT_FUNC "%.1" "%" COEFFS 0 327.68 0 0 0 1 /end COMPU_METHOD
/begin CHARACTERISTIC CLNG_Ki_p_ROL "Ki increasing ROL" VALUE 0x0014285C /* @ECU_Address@CLNG_Ki_p_ROL@0x01011D90@ */ ECIPP_ALIGNMENT_SWORD 100 Compu_CLNG_Ki_p_ROL -100 99.9969482421875 /end CHARACTERISTIC
/begin COMPU_METHOD Compu_CLNG_Ki_p_ROL " " RAT_FUNC "%.1" "%" COEFFS 0 327.68 0 0 0 1 /end COMPU_METHOD
/begin CHARACTERISTIC CLNG_Ki_n_ROL "Ki decreasing ROL" VALUE 0x0014285E /* @ECU_Address@CLNG_Ki_n_ROL@0x01011DA8@ */ ECIPP_ALIGNMENT_SWORD 100 Compu_CLNG_Ki_n_ROL -100 99.9969482421875 /end CHARACTERISTIC
/begin COMPU_METHOD Compu_CLNG_Ki_n_ROL " " RAT_FUNC "%.1" "%" COEFFS 0 327.68 0 0 0 1 /end COMPU_METHOD
/begin CHARACTERISTIC CLNG_ROL_win_p "ROL post-cat window upper" VALUE 0x0014288C /* @ECU_Address@CLNG_ROL_win_p@0x01011DC0@ */ ECIPP_ALIGNMENT_SWORD 2 Compu_CLNG_ROL_win_p -2 1.99993896484375 /end CHARACTERISTIC
/begin COMPU_METHOD Compu_CLNG_ROL_win_p " " RAT_FUNC "%.3" "-" COEFFS 0 16384 0 0 0 1 /end COMPU_METHOD
/begin CHARACTERISTIC CLNG_ROL_win_n "ROL post-cat window lower" VALUE 0x0014288E /* @ECU_Address@CLNG_ROL_win_n@0x01011DD8@ */ ECIPP_ALIGNMENT_SWORD 2 Compu_CLNG_ROL_win_n -2 1.99993896484375 /end CHARACTERISTIC
/begin COMPU_METHOD Compu_CLNG_ROL_win_n " " RAT_FUNC "%.3" "-" COEFFS 0 16384 0 0 0 1 /end COMPU_METHOD
/begin CHARACTERISTIC CLNG_ROL_res_dly "ROL ctrl resume delay" VALUE 0x00142890 /* @ECU_Address@CLNG_ROL_res_dly@0x01011DF0@ */ ECIPP_ALIGNMENT_UWORD 66 Compu_CLNG_ROL_res_dly 0 65.535 /end CHARACTERISTIC
/begin COMPU_METHOD Compu_CLNG_ROL_res_dly " " RAT_FUNC "%.1" "sec" COEFFS 0 1000 0 0 0 1 /end COMPU_METHOD
/begin CHARACTERISTIC CLNG_SS_dly "ROL SS trans delay" VALUE 0x00142892 /* @ECU_Address@CLNG_SS_dly@0x01011E08@ */ ECIPP_ALIGNMENT_UWORD 66 Compu_CLNG_SS_dly 0 65.535 /end CHARACTERISTIC
/begin COMPU_METHOD Compu_CLNG_SS_dly " " RAT_FUNC "%.1" "sec" COEFFS 0 1000 0 0 0 1 /end COMPU_METHOD
/begin CHARACTERISTIC J1939_fuel_rate_tau "J1939 engine fuel rate low-pass tau" VALUE 0x00147bfa /* @ECU_Address@J1939_fuel_rate_tau@0x01012698@ */ ECIPP_ALIGNMENT_UWORD 327680 Compu_J1939_fuel_rate_tau 0.45084 327680 /end CHARACTERISTIC
/begin COMPU_METHOD Compu_J1939_fuel_rate_tau " " FORM "%.0" "ms"
 /begin FORMULA "-5 / log(1 - (X1 / 65536))" FORMULA_INV "(1 - exp(-5/X1)) * 65536" /end FORMULA
/end COMPU_METHOD
/begin MEASUREMENT J1939_fuel_rate_acc "J1939 engine fuel rate filtered" UWORD Compu_J1939_fuel_rate_acc 0 0 0 127.998046875 ECU_ADDRESS 0x010126A0 /end MEASUREMENT
/begin COMPU_METHOD Compu_J1939_fuel_rate_acc " " RAT_FUNC "%.2" "g/sec" COEFFS 0 512 0 0 0 1 /end COMPU_METHOD
/begin CHARACTERISTIC diesel_lwld_comp_ena "Low-load compensation enable{diesel_lwld_comp_ena&0xff=0:Disabled}{diesel_lwld_comp_ena&0xff=1:Alternate 1 as offset}" VALUE 0x00148141 /* @ECU_Address@diesel_lwld_comp_ena@0x01012788@ */ ECIPP_ALIGNMENT_UBYTE 255 diesel_lwld_comp_ena_COMPU_VTAB 0 255 BIT_MASK 0xff /end CHARACTERISTIC
/begin COMPU_METHOD diesel_lwld_comp_ena_COMPU_VTAB "Verbal Table" TAB_VERB "%.0" "list" COMPU_TAB_REF diesel_lwld_comp_ena_COMPU_VTAB_REF /end COMPU_METHOD
/begin COMPU_VTAB diesel_lwld_comp_ena_COMPU_VTAB_REF "Verbal Table" TAB_VERB 2 0 "Disabled" 1 "Alternate 1 as offset" DEFAULT_VALUE "UNKNOWN" /end COMPU_VTAB
/begin CHARACTERISTIC diesel_lwld_spd_thld "Low-load speed threshold" VALUE 0x00147ada /* @ECU_Address@diesel_lwld_spd_thld@0x01012790@ */ ECIPP_ALIGNMENT_UWORD 65535 Compu_diesel_lwld_spd_thld 0 65535 /end CHARACTERISTIC
/begin COMPU_METHOD Compu_diesel_lwld_spd_thld " " RAT_FUNC "%.0" "rpm" COEFFS 0 1 0 0 0 1 /end COMPU_METHOD
/begin CHARACTERISTIC diesel_lwld_ld_thld "Low-load load threshold" VALUE 0x00147ad0 /* @ECU_Address@diesel_lwld_ld_thld@0x01012798@ */ ECIPP_ALIGNMENT_UWORD 100 Compu_diesel_lwld_ld_thld 0 99.9984741210938 /end CHARACTERISTIC
/begin COMPU_METHOD Compu_diesel_lwld_ld_thld " " RAT_FUNC "%.0" "%" COEFFS 0 655.36 0 0 0 1 /end COMPU_METHOD
/begin CHARACTERISTIC diesel_lwld_low_wait "Low-load wait time" VALUE 0x00147ad4 /* @ECU_Address@diesel_lwld_low_wait@0x010127A0@ */ ECIPP_ALIGNMENT_UWORD 65535 Compu_diesel_lwld_low_wait 0 65535 /end CHARACTERISTIC
/begin COMPU_METHOD Compu_diesel_lwld_low_wait " " RAT_FUNC "%.1" "sec" COEFFS 0 1 0 0 0 1 /end COMPU_METHOD
/begin CHARACTERISTIC diesel_lwld_low_slew "Low-load slew rate" VALUE 0x00147ad2 /* @ECU_Address@diesel_lwld_low_slew@0x010127A8@ */ ECIPP_ALIGNMENT_UWORD 100 Compu_diesel_lwld_low_slew 0 99.9984741210938 /end CHARACTERISTIC
/begin COMPU_METHOD Compu_diesel_lwld_low_slew " " RAT_FUNC "%.1" "%/sec" COEFFS 0 655.36 0 0 0 1 /end COMPU_METHOD
/begin CHARACTERISTIC diesel_lwld_nrm_wait "Normal mode wait time" VALUE 0x00147ad8 /* @ECU_Address@diesel_lwld_nrm_wait@0x010127B0@ */ ECIPP_ALIGNMENT_UWORD 65535 Compu_diesel_lwld_nrm_wait 0 65535 /end CHARACTERISTIC
/begin COMPU_METHOD Compu_diesel_lwld_nrm_wait " " RAT_FUNC "%.1" "sec" COEFFS 0 1 0 0 0 1 /end COMPU_METHOD
/begin CHARACTERISTIC diesel_lwld_nrm_slew "Normal mode slew rate" VALUE 0x00147ad6 /* @ECU_Address@diesel_lwld_nrm_slew@0x010127B8@ */ ECIPP_ALIGNMENT_UWORD 100 Compu_diesel_lwld_nrm_slew 0 99.9984741210938 /end CHARACTERISTIC
/begin COMPU_METHOD Compu_diesel_lwld_nrm_slew " " RAT_FUNC "%.1" "%/sec" COEFFS 0 655.36 0 0 0 1 /end COMPU_METHOD
/begin MEASUREMENT diesel_lwld_state "Low-load compensation state{diesel_lwld_state&0xff=0:Normal}{diesel_lwld_state&0xff=1:Low-load waiting}{diesel_lwld_state&0xff=2:Low-load slewing}{diesel_lwld_state&0xff=3:Low-load}{diesel_lwld_state&0xff=4:Normal waiting}{diesel_lwld_state&0xff=5:Normal " UBYTE diesel_lwld_state_COMPU_VTAB 0 0 0 255 ECU_ADDRESS 0x010127C0 BIT_MASK 0xff /end MEASUREMENT
/begin COMPU_METHOD diesel_lwld_state_COMPU_VTAB "Verbal Table" TAB_VERB "%.0" "list" COMPU_TAB_REF diesel_lwld_state_COMPU_VTAB_REF /end COMPU_METHOD
/begin COMPU_VTAB diesel_lwld_state_COMPU_VTAB_REF "Verbal Table" TAB_VERB 7 0 "Normal" 1 "Low-load waiting" 2 "Low-load slewing" 3 "Low-load" 4 "Normal waiting" 5 "Normal slewing" 6 "Low-load initialized" DEFAULT_VALUE "UNKNOWN" /end COMPU_VTAB
/begin MEASUREMENT diesel_lwld_timer "Mode change timer" ULONG Compu_diesel_lwld_timer 0 0 0 4294967.295 ECU_ADDRESS 0x010127C8 /end MEASUREMENT
/begin COMPU_METHOD Compu_diesel_lwld_timer " " RAT_FUNC "%.1" "sec" COEFFS 0 1000 0 0 0 1 /end COMPU_METHOD
/begin MEASUREMENT diesel_lwld_slewval "Low-load compensation factor" UWORD Compu_diesel_lwld_slewval 0 0 0 99.9984741210938 ECU_ADDRESS 0x010127D0 /end MEASUREMENT
/begin COMPU_METHOD Compu_diesel_lwld_slewval " " RAT_FUNC "%.1" "%" COEFFS 0 655.36 0 0 0 1 /end COMPU_METHOD
/begin CHARACTERISTIC J1939_fuel_rate_FT1 "J1939 EI engine fuel rate 1 encoding{J1939_fuel_rate_FT1&0xff=0:Active fuel type flow rate}{J1939_fuel_rate_FT1&0xff=1:Gasoline flow rate}{J1939_fuel_rate_FT1&0xff=2:LPG flow rate}{J1939_fuel_rate_FT1&0xff=3:NG flow rate}" VALUE 0x00147df7 /* @ECU_Address@J1939_fuel_rate_FT1@0x01012F38@ */ ECIPP_ALIGNMENT_UBYTE 255 J1939_fuel_rate_FT1_COMPU_VTAB 0 255 BIT_MASK 0xff /end CHARACTERISTIC
/begin COMPU_METHOD J1939_fuel_rate_FT1_COMPU_VTAB "Verbal Table" TAB_VERB "%.0" "list" COMPU_TAB_REF J1939_fuel_rate_FT1_COMPU_VTAB_REF /end COMPU_METHOD
/begin COMPU_VTAB J1939_fuel_rate_FT1_COMPU_VTAB_REF "Verbal Table" TAB_VERB 4 0 "Active fuel type flow rate" 1 "Gasoline flow rate" 2 "LPG flow rate" 3 "NG flow rate" DEFAULT_VALUE "UNKNOWN" /end COMPU_VTAB
/begin CHARACTERISTIC J1939_fuel_rate_FT2 "J1939 GFI3 engine fuel rate 2 encoding{J1939_fuel_rate_FT2&0xff=0:Active fuel type flow rate}{J1939_fuel_rate_FT2&0xff=1:LPG flow rate}{J1939_fuel_rate_FT2&0xff=2:NG flow rate}" VALUE 0x00147df8 /* @ECU_Address@J1939_fuel_rate_FT2@0x01012F40@ */ ECIPP_ALIGNMENT_UBYTE 255 J1939_fuel_rate_FT2_COMPU_VTAB 0 255 BIT_MASK 0xff /end CHARACTERISTIC
/begin COMPU_METHOD J1939_fuel_rate_FT2_COMPU_VTAB "Verbal Table" TAB_VERB "%.0" "list" COMPU_TAB_REF J1939_fuel_rate_FT2_COMPU_VTAB_REF /end COMPU_METHOD
/begin COMPU_VTAB J1939_fuel_rate_FT2_COMPU_VTAB_REF "Verbal Table" TAB_VERB 3 0 "Active fuel type flow rate" 1 "LPG flow rate" 2 "NG flow rate" DEFAULT_VALUE "UNKNOWN" /end COMPU_VTAB
/begin CHARACTERISTIC J1939_EEC1_torq_lmt "J1939 EEC1 TSC1 torque limit reporting{J1939_EEC1_torq_lmt&0xff=0:Disabled}{J1939_EEC1_torq_lmt&0xff=1:Enabled}" VALUE 0x00147ded /* @ECU_Address@J1939_EEC1_torq_lmt@0x01013020@ */ ECIPP_ALIGNMENT_UBYTE 255 J1939_EEC1_torq_lmt_COMPU_VTAB 0 255 BIT_MASK 0xff /end CHARACTERISTIC
/begin COMPU_METHOD J1939_EEC1_torq_lmt_COMPU_VTAB "Verbal Table" TAB_VERB "%.0" "list" COMPU_TAB_REF J1939_EEC1_torq_lmt_COMPU_VTAB_REF /end COMPU_METHOD
/begin COMPU_VTAB J1939_EEC1_torq_lmt_COMPU_VTAB_REF "Verbal Table" TAB_VERB 2 0 "Disabled" 1 "Enabled" DEFAULT_VALUE "UNKNOWN" /end COMPU_VTAB
/begin CHARACTERISTIC SPN_1437_latch_tm "J1939 EEC2 road speed limit latch time" VALUE 0x001477ba /* @ECU_Address@SPN_1437_latch_tm@0x01013200@ */ ECIPP_ALIGNMENT_UWORD 66 Compu_SPN_1437_latch_tm 0 65.535 /end CHARACTERISTIC
/begin COMPU_METHOD Compu_SPN_1437_latch_tm " " RAT_FUNC "%.1" "sec" COEFFS 0 1000 0 0 0 1 /end COMPU_METHOD
/begin CHARACTERISTIC SPN_1437_unlatch_tm "J1939 EEC2 road speed limit unlatch time" VALUE 0x001477bc /* @ECU_Address@SPN_1437_unlatch_tm@0x01013208@ */ ECIPP_ALIGNMENT_UWORD 66 Compu_SPN_1437_unlatch_tm 0 65.535 /end CHARACTERISTIC
/begin COMPU_METHOD Compu_SPN_1437_unlatch_tm " " RAT_FUNC "%.1" "sec" COEFFS 0 1000 0 0 0 1 /end COMPU_METHOD
/begin CHARACTERISTIC J1939_TSC1_loss_mode "J1939 TSC1 loss mode{J1939_TSC1_loss_mode&0xff=0:Normal unlatch; no filter}{J1939_TSC1_loss_mode&0xff=1:Key cyc; only neg req, neg lim}{J1939_TSC1_loss_mode&0xff=2:Key cyc; only neg req, all lim}" VALUE 0x00147df4 /* @ECU_Address@J1939_TSC1_loss_mode@0x010133D8@ */ ECIPP_ALIGNMENT_UBYTE 255 J1939_TSC1_loss_mode_COMPU_VTAB 0 255 BIT_MASK 0xff /end CHARACTERISTIC
/begin COMPU_METHOD J1939_TSC1_loss_mode_COMPU_VTAB "Verbal Table" TAB_VERB "%.0" "list" COMPU_TAB_REF J1939_TSC1_loss_mode_COMPU_VTAB_REF /end COMPU_METHOD
/begin COMPU_VTAB J1939_TSC1_loss_mode_COMPU_VTAB_REF "Verbal Table" TAB_VERB 3 0 "Normal unlatch; no filter" 1 "Key cyc; only neg req, neg lim" 2 "Key cyc; only neg req, all lim" DEFAULT_VALUE "UNKNOWN" /end COMPU_VTAB
/begin CHARACTERISTIC EMS3_fuelleak_input "EMS3 fuel leakage PWM input{EMS3_fuelleak_input&0xff=0:Disabled}{EMS3_fuelleak_input&0xff=1:Pulse in}{EMS3_fuelleak_input&0xff=2:Roadspeed}{EMS3_fuelleak_input&0xff=3:Aux DIG23 comparator}{EMS3_fuelleak_input&0xff=4:Aux DIG24 comparator}{EMS3_fuelleak_inp" VALUE 0x00147d33 /* @ECU_Address@EMS3_fuelleak_input@0x01013400@ */ ECIPP_ALIGNMENT_UBYTE 255 EMS3_fuelleak_input_COMPU_VTAB 0 255 BIT_MASK 0xff /end CHARACTERISTIC
/begin COMPU_METHOD EMS3_fuelleak_input_COMPU_VTAB "Verbal Table" TAB_VERB "%.0" "list" COMPU_TAB_REF EMS3_fuelleak_input_COMPU_VTAB_REF /end COMPU_METHOD
/begin COMPU_VTAB EMS3_fuelleak_input_COMPU_VTAB_REF "Verbal Table" TAB_VERB 6 0 "Disabled" 1 "Pulse in" 2 "Roadspeed" 3 "Aux DIG23 comparator" 4 "Aux DIG24 comparator" 5 "Aux DIG25 comparator" DEFAULT_VALUE "UNKNOWN" /end COMPU_VTAB
/begin CHARACTERISTIC CLNG_postcat_winpdlt "Post-cat window high delta" VALUE 0x0014289A /* @ECU_Address@CLNG_postcat_winpdlt@0x01013830@ */ ECIPP_ALIGNMENT_SWORD 2 Compu_CLNG_postcat_winpdlt -2 1.99993896484375 /end CHARACTERISTIC
/begin COMPU_METHOD Compu_CLNG_postcat_winpdlt " " RAT_FUNC "%.3" "-" COEFFS 0 16384 0 0 0 1 /end COMPU_METHOD
/begin CHARACTERISTIC CLNG_postcat_winndlt "Post-cat window low delta" VALUE 0x0014289C /* @ECU_Address@CLNG_postcat_winndlt@0x01013848@ */ ECIPP_ALIGNMENT_SWORD 2 Compu_CLNG_postcat_winndlt -2 1.99993896484375 /end CHARACTERISTIC
/begin COMPU_METHOD Compu_CLNG_postcat_winndlt " " RAT_FUNC "%.3" "-" COEFFS 0 16384 0 0 0 1 /end COMPU_METHOD
/begin CHARACTERISTIC CLNG_ROLend_fastwrtm "Post-cat Temp Phi cont CL" VALUE 0x0014289E /* @ECU_Address@CLNG_ROLend_fastwrtm@0x01013860@ */ ECIPP_ALIGNMENT_UWORD 66 Compu_CLNG_ROLend_fastwrtm 0 65.535 /end CHARACTERISTIC
/begin COMPU_METHOD Compu_CLNG_ROLend_fastwrtm " " RAT_FUNC "%.2" "sec" COEFFS 0 1000 0 0 0 1 /end COMPU_METHOD
/begin CHARACTERISTIC CLNG_post_fastwr_tm "Post-cat Phi cont CL time" VALUE 0x001428A0 /* @ECU_Address@CLNG_post_fastwr_tm@0x01013878@ */ ECIPP_ALIGNMENT_UWORD 66 Compu_CLNG_post_fastwr_tm 0 65.535 /end CHARACTERISTIC
/begin COMPU_METHOD Compu_CLNG_post_fastwr_tm " " RAT_FUNC "%.2" "sec" COEFFS 0 1000 0 0 0 1 /end COMPU_METHOD
/begin CHARACTERISTIC TSC_maxlim_mode "Remote speed maximum limit{TSC_maxlim_mode&0xff=0:<= Max Governor Speed}{TSC_maxlim_mode&0xff=1:<= High Idle Speed}" VALUE 0x001480bc /* @ECU_Address@TSC_maxlim_mode@0x01013958@ */ ECIPP_ALIGNMENT_UBYTE 255 TSC_maxlim_mode_COMPU_VTAB 0 255 BIT_MASK 0xff /end CHARACTERISTIC
/begin COMPU_METHOD TSC_maxlim_mode_COMPU_VTAB "Verbal Table" TAB_VERB "%.0" "list" COMPU_TAB_REF TSC_maxlim_mode_COMPU_VTAB_REF /end COMPU_METHOD
/begin COMPU_VTAB TSC_maxlim_mode_COMPU_VTAB_REF "Verbal Table" TAB_VERB 2 0 "<= Max Governor Speed" 1 "<= High Idle Speed" DEFAULT_VALUE "UNKNOWN" /end COMPU_VTAB
/begin CHARACTERISTIC J1939_TSC1_rx_tout "J1939 TSC1 timeout override" VALUE 0x00147510 /* @ECU_Address@J1939_TSC1_rx_tout@0x01013968@ */ ECIPP_ALIGNMENT_UWORD 327675 Compu_J1939_TSC1_rx_tout 0 327675 /end CHARACTERISTIC
/begin COMPU_METHOD Compu_J1939_TSC1_rx_tout " " RAT_FUNC "%.0" "ms" COEFFS 0 0.2 0 0 0 1 /end COMPU_METHOD
/begin CHARACTERISTIC diesel_lwld_ini_wait "Low-load init. wait time" VALUE 0x00147ace /* @ECU_Address@diesel_lwld_ini_wait@0x01013A58@ */ ECIPP_ALIGNMENT_UWORD 65535 Compu_diesel_lwld_ini_wait 0 65535 /end CHARACTERISTIC
/begin COMPU_METHOD Compu_diesel_lwld_ini_wait " " RAT_FUNC "%.1" "sec" COEFFS 0 1 0 0 0 1 /end COMPU_METHOD
/begin COMPU_METHOD Compu_TCLp_tau_rpmNG " " RAT_FUNC "%.0" "Speed (rpm)" COEFFS 0 1 0 0 0 1 /end COMPU_METHOD
/begin COMPU_METHOD Compu_TCLp_tau_MAPNG " " RAT_FUNC "%.1" "MAP (psia)" COEFFS 0 256 0 0 0 1 /end COMPU_METHOD
/begin CHARACTERISTIC TCLp_tau_cycNG "NG CL switching frequency" MAP 0x00141F2A /* @ECU_Address@TCLp_tau_cycNG@0x02066000@ */ ECIPP_ALIGNMENT_SWORD 2048 Compu_TCLp_tau_cycNG -2048 2047.9375
 /begin AXIS_DESCR COM_AXIS NO_INPUT_QUANTITY Compu_TCLp_tau_MAPNG 4 -128 127.99609375 AXIS_PTS_REF TCLp_tau_MAPNG /end AXIS_DESCR
 /begin AXIS_DESCR COM_AXIS NO_INPUT_QUANTITY Compu_TCLp_tau_rpmNG 8 -32768 32767 AXIS_PTS_REF TCLp_tau_rpmNG /end AXIS_DESCR
/end CHARACTERISTIC
/begin AXIS_PTS TCLp_tau_MAPNG " " 0x00141F22 /* @ECU_Address@TCLp_tau_MAPNG@0x02065000@ */ NO_INPUT_QUANTITY ECIPP_Lookup_SWORD 0 Compu_TCLp_tau_MAPNG 4 -128 127.99609375 /end AXIS_PTS
/begin AXIS_PTS TCLp_tau_rpmNG " " 0x00141F6A /* @ECU_Address@TCLp_tau_rpmNG@0x02064000@ */ NO_INPUT_QUANTITY ECIPP_Lookup_SWORD 0 Compu_TCLp_tau_rpmNG 8 -32768 32767 /end AXIS_PTS
/begin COMPU_METHOD Compu_TCLp_tau_cycNG "" RAT_FUNC "%.1" "Engine Cycles" COEFFS 0 16 0 0 0 1 /end COMPU_METHOD
/begin CHARACTERISTIC TCL_enaNG "NG CL Enable Table" MAP 0x00141CF2 /* @ECU_Address@TCL_enaNG@0x02068000@ */ ECIPP_ALIGNMENT_SWORD 128 Compu_TCL_enaNG -128 127.99609375
 /begin AXIS_DESCR COM_AXIS NO_INPUT_QUANTITY Compu_TPhi_base_MAPNG 14 -128 127.99609375 AXIS_PTS_REF TPhi_base_MAPNG /end AXIS_DESCR
 /begin AXIS_DESCR COM_AXIS NO_INPUT_QUANTITY Compu_TPhi_base_rpmNG 10 -32768 32767 AXIS_PTS_REF TPhi_base_rpmNG /end AXIS_DESCR
/end CHARACTERISTIC
/begin AXIS_PTS TPhi_base_MAPNG " " 0x00141F9A /* @ECU_Address@TPhi_base_MAPNG@0x0206C000@ */ NO_INPUT_QUANTITY ECIPP_Lookup_SWORD 0 Compu_TPhi_base_MAPNG 14 -128 127.99609375 /end AXIS_PTS
/begin AXIS_PTS TPhi_base_rpmNG " " 0x001420CE /* @ECU_Address@TPhi_base_rpmNG@0x0206D000@ */ NO_INPUT_QUANTITY ECIPP_Lookup_SWORD 0 Compu_TPhi_base_rpmNG 10 -32768 32767 /end AXIS_PTS
/begin COMPU_METHOD Compu_TCL_enaNG "" RAT_FUNC "%.0" "CL eanble (logical)" COEFFS 0 256 0 0 0 1 /end COMPU_METHOD
/begin COMPU_METHOD Compu_TPhi_base_MAPNG " " RAT_FUNC "%.1" "MAP load (psia)" COEFFS 0 256 0 0 0 1 /end COMPU_METHOD
/begin COMPU_METHOD Compu_TPhi_base_rpmNG " " RAT_FUNC "%.0" "Speed (rpm)" COEFFS 0 1 0 0 0 1 /end COMPU_METHOD
/begin COMPU_METHOD Compu_Ttrim_mdotaNG " " RAT_FUNC "%.1" "Mdot Air (g/sec)" COEFFS 0 32 0 0 0 1 /end COMPU_METHOD
/begin CHARACTERISTIC Tvent_PN "NG Venturi Signal" CURVE 0x00142802 /* @ECU_Address@Tvent_PN@0x020C6000@ */ ECIPP_ALIGNMENT_SWORD 222 Compu_Tvent_PN -222 221.993225097656
 /begin AXIS_DESCR COM_AXIS NO_INPUT_QUANTITY Compu_Ttrim_mdotaNG 8 -1024 1023.96875 AXIS_PTS_REF Ttrim_mdotaNG /end AXIS_DESCR
/end CHARACTERISTIC
/begin AXIS_PTS Ttrim_mdotaNG " " 0x001427F2 /* @ECU_Address@Ttrim_mdotaNG@0x02071000@ */ NO_INPUT_QUANTITY ECIPP_Lookup_SWORD 0 Compu_Ttrim_mdotaNG 8 -1024 1023.96875 /end AXIS_PTS
/begin COMPU_METHOD Compu_Tvent_PN " " RAT_FUNC "%.2" "in H2O" COEFFS 0 147.603603603604 0 0 0 1 /end COMPU_METHOD
/begin COMPU_METHOD Compu_T2trim_nom_MAPNG " " RAT_FUNC "%.1" "MAP_load (psia)" COEFFS 0 256 0 0 0 1 /end COMPU_METHOD
/begin COMPU_METHOD Compu_T2trim_nom_rpmNG " " RAT_FUNC "%.0" "Speed (rpm)" COEFFS 0 1 0 0 0 1 /end COMPU_METHOD
/begin CHARACTERISTIC T2trim_nom_DCNG "NG Nominal PWM Trim Duty-Cycle" MAP 0x00141A76 /* @ECU_Address@T2trim_nom_DCNG@0x020D2000@ */ ECIPP_ALIGNMENT_SWORD 200 Compu_T2trim_nom_DCNG -200 199.993896484375
 /begin AXIS_DESCR COM_AXIS NO_INPUT_QUANTITY Compu_T2trim_nom_MAPNG 14 -128 127.99609375 AXIS_PTS_REF T2trim_nom_MAPNG /end AXIS_DESCR
 /begin AXIS_DESCR COM_AXIS NO_INPUT_QUANTITY Compu_T2trim_nom_rpmNG 10 -32768 32767 AXIS_PTS_REF T2trim_nom_rpmNG /end AXIS_DESCR
/end CHARACTERISTIC
/begin AXIS_PTS T2trim_nom_MAPNG " " 0x00141B8E /* @ECU_Address@T2trim_nom_MAPNG@0x020D0000@ */ NO_INPUT_QUANTITY ECIPP_Lookup_SWORD 0 Compu_T2trim_nom_MAPNG 14 -128 127.99609375 /end AXIS_PTS
/begin AXIS_PTS T2trim_nom_rpmNG " " 0x00141CDE /* @ECU_Address@T2trim_nom_rpmNG@0x020D1000@ */ NO_INPUT_QUANTITY ECIPP_Lookup_SWORD 0 Compu_T2trim_nom_rpmNG 10 -32768 32767 /end AXIS_PTS
/begin COMPU_METHOD Compu_T2trim_nom_DCNG "" RAT_FUNC "%.1" "Nominal Duty-Cycle (%)" COEFFS 0 163.84 0 0 0 1 /end COMPU_METHOD
/begin CHARACTERISTIC T2MJ_nom_PN "NG Nominal MegaJector Outlet Pressure" MAP 0x0014195E /* @ECU_Address@T2MJ_nom_PN@0x020D3000@ */ ECIPP_ALIGNMENT_SWORD 222 Compu_T2MJ_nom_PN -222 221.993225097656
 /begin AXIS_DESCR COM_AXIS NO_INPUT_QUANTITY Compu_T2trim_nom_MAPNG 14 -128 127.99609375 AXIS_PTS_REF T2trim_nom_MAPNG /end AXIS_DESCR
 /begin AXIS_DESCR COM_AXIS NO_INPUT_QUANTITY Compu_T2trim_nom_rpmNG 10 -32768 32767 AXIS_PTS_REF T2trim_nom_rpmNG /end AXIS_DESCR
/end CHARACTERISTIC
/begin COMPU_METHOD Compu_T2MJ_nom_PN "" RAT_FUNC "%.2" "Nominal Phi Pressure (in H2O)" COEFFS 0 147.603603603604 0 0 0 1 /end COMPU_METHOD
/begin CHARACTERISTIC T2trim_nom_phiNG "NG Nominal Trim Phi" MAP 0x00141BC6 /* @ECU_Address@T2trim_nom_phiNG@0x020D4000@ */ ECIPP_ALIGNMENT_SWORD 2 Compu_T2trim_nom_phiNG -2 1.99993896484375
 /begin AXIS_DESCR COM_AXIS NO_INPUT_QUANTITY Compu_T2trim_nom_MAPNG 14 -128 127.99609375 AXIS_PTS_REF T2trim_nom_MAPNG /end AXIS_DESCR
 /begin AXIS_DESCR COM_AXIS NO_INPUT_QUANTITY Compu_T2trim_nom_rpmNG 10 -32768 32767 AXIS_PTS_REF T2trim_nom_rpmNG /end AXIS_DESCR
/end CHARACTERISTIC
/begin COMPU_METHOD Compu_T2trim_nom_phiNG "" RAT_FUNC "%.3" "Nominal Phi" COEFFS 0 16384 0 0 0 1 /end COMPU_METHOD
/begin CHARACTERISTIC T2trim_nom_maLNG "Trim Vdot comp mdot air X-axis NG" VAL_BLK 0x00141BAA /* @ECU_Address@T2trim_nom_maLNG@0x02109000@ */ ECIPP_ALIGNMENT_SWORD 8192 Compu_T2trim_nom_maLNG -8192 8191.75 MATRIX_DIM 14 1 1 /end CHARACTERISTIC
/begin COMPU_METHOD Compu_T2trim_nom_maLNG " " RAT_FUNC "%.0" "mg/Ld" COEFFS 0 4 0 0 0 1 /end COMPU_METHOD
/begin COMPU_METHOD Compu_TTVf_BMDC_DCN " " RAT_FUNC "%.1" "Duty-Cycle (%)" COEFFS 0 163.84 0 0 0 1 /end COMPU_METHOD
/begin CHARACTERISTIC TTVf_BMDC_BMN "NG PWM Trim Sensitivity" MAP 0x00142312 /* @ECU_Address@TTVf_BMDC_BMN@0x02117000@ */ ECIPP_ALIGNMENT_SWORD 200 Compu_TTVf_BMDC_BMN -200 199.993896484375
 /begin AXIS_DESCR COM_AXIS NO_INPUT_QUANTITY Compu_TTVf_BMDC_DCN 4 0 399.993896484375 AXIS_PTS_REF TTVf_BMDC_DCN /end AXIS_DESCR
 /begin AXIS_DESCR COM_AXIS NO_INPUT_QUANTITY Compu_Ttrim_mdotaNG 8 -1024 1023.96875 AXIS_PTS_REF Ttrim_mdotaNG /end AXIS_DESCR
/end CHARACTERISTIC
/begin AXIS_PTS TTVf_BMDC_DCN " " 0x0014281A /* @ECU_Address@TTVf_BMDC_DCN@0x02115000@ */ NO_INPUT_QUANTITY ECIPP_Lookup_UWORD 0 Compu_TTVf_BMDC_DCN 4 0 399.993896484375 /end AXIS_PTS
/begin COMPU_METHOD Compu_TTVf_BMDC_BMN "" RAT_FUNC "%.1" "Delta-phi from 50% DC (%)" COEFFS 0 163.84 0 0 0 1 /end COMPU_METHOD
/begin MEASUREMENT CAN1term_valid "CAN1 term valid - 1{CAN1term_valid&0x80=0x00:Invalid}{CAN1term_valid&0x80=0x80:Valid}" UBYTE CAN1term_valid_COMPU_VTAB 0 0 0 255 ECU_ADDRESS 0x0219E000 MATRIX_DIM 16 1 1 BIT_MASK 0xFF /end MEASUREMENT
/begin COMPU_METHOD CAN1term_valid_COMPU_VTAB "Verbal Table" TAB_VERB "%.0" "list" COMPU_TAB_REF CAN1term_valid_COMPU_VTAB_REF /end COMPU_METHOD
/begin COMPU_VTAB CAN1term_valid_COMPU_VTAB_REF "Verbal Table" TAB_VERB 2 0x00 "Invalid" 0x80 "Valid" DEFAULT_VALUE "Unsupported Bit_Shift" /end COMPU_VTAB
/begin MEASUREMENT CAN1term_mode "CAN1 term mode - 1{CAN1term_mode&0x10=0x00:Manual}{CAN1term_mode&0x10=0x10:Auto}" UBYTE CAN1term_mode_COMPU_VTAB 0 0 0 255 ECU_ADDRESS 0x0219F000 MATRIX_DIM 16 1 1 BIT_MASK 0xFF /end MEASUREMENT
/begin COMPU_METHOD CAN1term_mode_COMPU_VTAB "Verbal Table" TAB_VERB "%.0" "list" COMPU_TAB_REF CAN1term_mode_COMPU_VTAB_REF /end COMPU_METHOD
/begin COMPU_VTAB CAN1term_mode_COMPU_VTAB_REF "Verbal Table" TAB_VERB 2 0x00 "Manual" 0x10 "Auto" DEFAULT_VALUE "Unsupported Bit_Shift" /end COMPU_VTAB
/begin MEASUREMENT CAN1term_type "CAN1 term type - 1{CAN1term_type&0x0c=0x00:NA}{CAN1term_type&0x0c=0x04:No Term}{CAN1term_type&0x0c=0x08:Term}" UBYTE CAN1term_type_COMPU_VTAB 0 0 0 255 ECU_ADDRESS 0x021A0000 MATRIX_DIM 16 1 1 BIT_MASK 0x0c /end MEASUREMENT
/begin COMPU_METHOD CAN1term_type_COMPU_VTAB "Verbal Table" TAB_VERB "%.0" "list" COMPU_TAB_REF CAN1term_type_COMPU_VTAB_REF /end COMPU_METHOD
/begin COMPU_VTAB CAN1term_type_COMPU_VTAB_REF "Verbal Table" TAB_VERB 3 0x00 "NA" 0x04 "No Term" 0x08 "Term" DEFAULT_VALUE "UNKNOWN" /end COMPU_VTAB
/begin MEASUREMENT CAN1term_loc "CAN1 term loc - 1{CAN1term_loc&0x03=0x00:NA}{CAN1term_loc&0x03=0x01:Rear}{CAN1term_loc&0x03=0x02:Mid}{CAN1term_loc&0x03=0x03:Front}" UBYTE CAN1term_loc_COMPU_VTAB 0 0 0 255 ECU_ADDRESS 0x021A1000 MATRIX_DIM 16 1 1 BIT_MASK 0x03 /end MEASUREMENT
/begin COMPU_METHOD CAN1term_loc_COMPU_VTAB "Verbal Table" TAB_VERB "%.0" "list" COMPU_TAB_REF CAN1term_loc_COMPU_VTAB_REF /end COMPU_METHOD
/begin COMPU_VTAB CAN1term_loc_COMPU_VTAB_REF "Verbal Table" TAB_VERB 4 0x00 "NA" 0x01 "Rear" 0x02 "Mid" 0x03 "Front" DEFAULT_VALUE "UNKNOWN" /end COMPU_VTAB
/begin MEASUREMENT CAN2term_valid "CAN2 term valid - 1{CAN2term_valid&0x80=0x00:Invalid}{CAN2term_valid&0x80=0x80:Valid}" UBYTE CAN2term_valid_COMPU_VTAB 0 0 0 255 ECU_ADDRESS 0x021A2000 MATRIX_DIM 16 1 1 BIT_MASK 0xFF /end MEASUREMENT
/begin COMPU_METHOD CAN2term_valid_COMPU_VTAB "Verbal Table" TAB_VERB "%.0" "list" COMPU_TAB_REF CAN2term_valid_COMPU_VTAB_REF /end COMPU_METHOD
/begin COMPU_VTAB CAN2term_valid_COMPU_VTAB_REF "Verbal Table" TAB_VERB 2 0x00 "Invalid" 0x80 "Valid" DEFAULT_VALUE "Unsupported Bit_Shift" /end COMPU_VTAB
/begin MEASUREMENT CAN2term_mode "CAN2 term mode - 1{CAN2term_mode&0x10=0x00:Manual}{CAN2term_mode&0x10=0x10:Auto}" UBYTE CAN2term_mode_COMPU_VTAB 0 0 0 255 ECU_ADDRESS 0x021A3000 MATRIX_DIM 16 1 1 BIT_MASK 0xFF /end MEASUREMENT
/begin COMPU_METHOD CAN2term_mode_COMPU_VTAB "Verbal Table" TAB_VERB "%.0" "list" COMPU_TAB_REF CAN2term_mode_COMPU_VTAB_REF /end COMPU_METHOD
/begin COMPU_VTAB CAN2term_mode_COMPU_VTAB_REF "Verbal Table" TAB_VERB 2 0x00 "Manual" 0x10 "Auto" DEFAULT_VALUE "Unsupported Bit_Shift" /end COMPU_VTAB
/begin MEASUREMENT CAN2term_type "CAN2 term type - 1{CAN2term_type&0x0c=0x00:NA}{CAN2term_type&0x0c=0x04:No Term}{CAN2term_type&0x0c=0x08:Term}" UBYTE CAN2term_type_COMPU_VTAB 0 0 0 255 ECU_ADDRESS 0x021A4000 MATRIX_DIM 16 1 1 BIT_MASK 0x0c /end MEASUREMENT
/begin COMPU_METHOD CAN2term_type_COMPU_VTAB "Verbal Table" TAB_VERB "%.0" "list" COMPU_TAB_REF CAN2term_type_COMPU_VTAB_REF /end COMPU_METHOD
/begin COMPU_VTAB CAN2term_type_COMPU_VTAB_REF "Verbal Table" TAB_VERB 3 0x00 "NA" 0x04 "No Term" 0x08 "Term" DEFAULT_VALUE "UNKNOWN" /end COMPU_VTAB
/begin MEASUREMENT CAN2term_loc "CAN2 term loc - 1{CAN2term_loc&0x03=0x00:NA}{CAN2term_loc&0x03=0x01:Rear}{CAN2term_loc&0x03=0x02:Mid}{CAN2term_loc&0x03=0x03:Front}" UBYTE CAN2term_loc_COMPU_VTAB 0 0 0 255 ECU_ADDRESS 0x021A5000 MATRIX_DIM 16 1 1 BIT_MASK 0x03 /end MEASUREMENT
/begin COMPU_METHOD CAN2term_loc_COMPU_VTAB "Verbal Table" TAB_VERB "%.0" "list" COMPU_TAB_REF CAN2term_loc_COMPU_VTAB_REF /end COMPU_METHOD
/begin COMPU_VTAB CAN2term_loc_COMPU_VTAB_REF "Verbal Table" TAB_VERB 4 0x00 "NA" 0x01 "Rear" 0x02 "Mid" 0x03 "Front" DEFAULT_VALUE "UNKNOWN" /end COMPU_VTAB
/begin MEASUREMENT CAN1term_src "CAN1 term src - 1" UBYTE Compu_CAN1term_src 0 0 0 255 ECU_ADDRESS 0x021A6000 MATRIX_DIM 16 1 1 /end MEASUREMENT
/begin COMPU_METHOD Compu_CAN1term_src " " RAT_FUNC "%.0" "-" COEFFS 0 1 0 0 0 1 /end COMPU_METHOD
/begin MEASUREMENT CAN2term_src "CAN2 term src - 1" UBYTE Compu_CAN2term_src 0 0 0 255 ECU_ADDRESS 0x021A7000 MATRIX_DIM 16 1 1 /end MEASUREMENT
/begin COMPU_METHOD Compu_CAN2term_src " " RAT_FUNC "%.0" "-" COEFFS 0 1 0 0 0 1 /end COMPU_METHOD
/begin CHARACTERISTIC TJ1939_Tx_PGNs "Broadcast Tx PGN List" VAL_BLK 0x001481DC /* @ECU_Address@TJ1939_Tx_PGNs@0x021E1000@ */ ECIPP_ALIGNMENT_ULONG 4294967295 Compu_TJ1939_Tx_PGNs 0 4294967295 MATRIX_DIM 64 1 1 /end CHARACTERISTIC
/begin COMPU_METHOD Compu_TJ1939_Tx_PGNs " " RAT_FUNC "%.0" "-" COEFFS 0 1 0 0 0 1 /end COMPU_METHOD
/begin CHARACTERISTIC TJ1939_Tx2_PGNs "Broadcast Tx2 PGN List" VAL_BLK 0x00148574 /* @ECU_Address@TJ1939_Tx2_PGNs@0x021E2000@ */ ECIPP_ALIGNMENT_ULONG 4294967295 Compu_TJ1939_Tx2_PGNs 0 4294967295 MATRIX_DIM 64 1 1 /end CHARACTERISTIC
/begin COMPU_METHOD Compu_TJ1939_Tx2_PGNs " " RAT_FUNC "%.0" "-" COEFFS 0 1 0 0 0 1 /end COMPU_METHOD
/begin CHARACTERISTIC TJ1939_Tx3_PGNs "Broadcast Tx3 PGN List" VAL_BLK 0x0014890C /* @ECU_Address@TJ1939_Tx3_PGNs@0x021E3000@ */ ECIPP_ALIGNMENT_ULONG 4294967295 Compu_TJ1939_Tx3_PGNs 0 4294967295 MATRIX_DIM 64 1 1 /end CHARACTERISTIC
/begin COMPU_METHOD Compu_TJ1939_Tx3_PGNs " " RAT_FUNC "%.0" "-" COEFFS 0 1 0 0 0 1 /end COMPU_METHOD
/begin CHARACTERISTIC TJ1939_TxOK_PGNs "Supported Tx PGN List" VAL_BLK 0x001482DC /* @ECU_Address@TJ1939_TxOK_PGNs@0x021E4000@ */ ECIPP_ALIGNMENT_ULONG 4294967295 Compu_TJ1939_TxOK_PGNs 0 4294967295 MATRIX_DIM 64 1 1 /end CHARACTERISTIC
/begin COMPU_METHOD Compu_TJ1939_TxOK_PGNs " " RAT_FUNC "%.0" "-" COEFFS 0 1 0 0 0 1 /end COMPU_METHOD
/begin CHARACTERISTIC TJ1939_TxOK2_PGNs "Supported Tx2 PGN List" VAL_BLK 0x00148674 /* @ECU_Address@TJ1939_TxOK2_PGNs@0x021E5000@ */ ECIPP_ALIGNMENT_ULONG 4294967295 Compu_TJ1939_TxOK2_PGNs 0 4294967295 MATRIX_DIM 64 1 1 /end CHARACTERISTIC
/begin COMPU_METHOD Compu_TJ1939_TxOK2_PGNs " " RAT_FUNC "%.0" "-" COEFFS 0 1 0 0 0 1 /end COMPU_METHOD
/begin CHARACTERISTIC TJ1939_TxOK3_PGNs "Supported Tx3 PGN List" VAL_BLK 0x00148A0C /* @ECU_Address@TJ1939_TxOK3_PGNs@0x021E6000@ */ ECIPP_ALIGNMENT_ULONG 4294967295 Compu_TJ1939_TxOK3_PGNs 0 4294967295 MATRIX_DIM 64 1 1 /end CHARACTERISTIC
/begin COMPU_METHOD Compu_TJ1939_TxOK3_PGNs " " RAT_FUNC "%.0" "-" COEFFS 0 1 0 0 0 1 /end COMPU_METHOD
/begin CHARACTERISTIC TJ1939_Rx_PGNs "Required Rx PGN List" VAL_BLK 0x001483DC /* @ECU_Address@TJ1939_Rx_PGNs@0x021E7000@ */ ECIPP_ALIGNMENT_ULONG 4294967295 Compu_TJ1939_Rx_PGNs 0 4294967295 MATRIX_DIM 64 1 1 /end CHARACTERISTIC
/begin COMPU_METHOD Compu_TJ1939_Rx_PGNs " " RAT_FUNC "%.0" "-" COEFFS 0 1 0 0 0 1 /end COMPU_METHOD
/begin CHARACTERISTIC TJ1939_Rx2_PGNs "Required Rx2 PGN List" VAL_BLK 0x00148774 /* @ECU_Address@TJ1939_Rx2_PGNs@0x021E8000@ */ ECIPP_ALIGNMENT_ULONG 4294967295 Compu_TJ1939_Rx2_PGNs 0 4294967295 MATRIX_DIM 64 1 1 /end CHARACTERISTIC
/begin COMPU_METHOD Compu_TJ1939_Rx2_PGNs " " RAT_FUNC "%.0" "-" COEFFS 0 1 0 0 0 1 /end COMPU_METHOD
/begin CHARACTERISTIC TJ1939_Rx3_PGNs "Required Rx3 PGN List" VAL_BLK 0x00148B0C /* @ECU_Address@TJ1939_Rx3_PGNs@0x021E9000@ */ ECIPP_ALIGNMENT_ULONG 4294967295 Compu_TJ1939_Rx3_PGNs 0 4294967295 MATRIX_DIM 64 1 1 /end CHARACTERISTIC
/begin COMPU_METHOD Compu_TJ1939_Rx3_PGNs " " RAT_FUNC "%.0" "-" COEFFS 0 1 0 0 0 1 /end COMPU_METHOD
/begin CHARACTERISTIC TJ1939_Rx_SPNs "Rx SPN Update Access" VAL_BLK 0x001484DC /* @ECU_Address@TJ1939_Rx_SPNs@0x021EA000@ */ ECIPP_ALIGNMENT_UWORD 65535 Compu_TJ1939_Rx_SPNs 0 65535 MATRIX_DIM 64 1 1 /end CHARACTERISTIC
/begin COMPU_METHOD Compu_TJ1939_Rx_SPNs " " RAT_FUNC "%.0" "-" COEFFS 0 1 0 0 0 1 /end COMPU_METHOD
/begin CHARACTERISTIC TJ1939_Rx2_SPNs "Rx2 SPN Update Access" VAL_BLK 0x00148874 /* @ECU_Address@TJ1939_Rx2_SPNs@0x021EB000@ */ ECIPP_ALIGNMENT_UWORD 65535 Compu_TJ1939_Rx2_SPNs 0 65535 MATRIX_DIM 64 1 1 /end CHARACTERISTIC
/begin COMPU_METHOD Compu_TJ1939_Rx2_SPNs " " RAT_FUNC "%.0" "-" COEFFS 0 1 0 0 0 1 /end COMPU_METHOD
/begin CHARACTERISTIC TJ1939_Rx3_SPNs "Rx3 SPN Update Access" VAL_BLK 0x00148C0C /* @ECU_Address@TJ1939_Rx3_SPNs@0x021EC000@ */ ECIPP_ALIGNMENT_UWORD 65535 Compu_TJ1939_Rx3_SPNs 0 65535 MATRIX_DIM 64 1 1 /end CHARACTERISTIC
/begin COMPU_METHOD Compu_TJ1939_Rx3_SPNs " " RAT_FUNC "%.0" "-" COEFFS 0 1 0 0 0 1 /end COMPU_METHOD
/begin MEASUREMENT CAN3term_valid "CAN3 term valid - 1{CAN3term_valid&0x80=0x00:Invalid}{CAN3term_valid&0x80=0x80:Valid}" UBYTE CAN3term_valid_COMPU_VTAB 0 0 0 255 ECU_ADDRESS 0x021F5000 MATRIX_DIM 16 1 1 BIT_MASK 0xFF /end MEASUREMENT
/begin COMPU_METHOD CAN3term_valid_COMPU_VTAB "Verbal Table" TAB_VERB "%.0" "list" COMPU_TAB_REF CAN3term_valid_COMPU_VTAB_REF /end COMPU_METHOD
/begin COMPU_VTAB CAN3term_valid_COMPU_VTAB_REF "Verbal Table" TAB_VERB 2 0x00 "Invalid" 0x80 "Valid" DEFAULT_VALUE "Unsupported Bit_Shift" /end COMPU_VTAB
/begin MEASUREMENT CAN3term_mode "CAN3 term mode - 1{CAN3term_mode&0x10=0x00:Manual}{CAN3term_mode&0x10=0x10:Auto}" UBYTE CAN3term_mode_COMPU_VTAB 0 0 0 255 ECU_ADDRESS 0x021F6000 MATRIX_DIM 16 1 1 BIT_MASK 0xFF /end MEASUREMENT
/begin COMPU_METHOD CAN3term_mode_COMPU_VTAB "Verbal Table" TAB_VERB "%.0" "list" COMPU_TAB_REF CAN3term_mode_COMPU_VTAB_REF /end COMPU_METHOD
/begin COMPU_VTAB CAN3term_mode_COMPU_VTAB_REF "Verbal Table" TAB_VERB 2 0x00 "Manual" 0x10 "Auto" DEFAULT_VALUE "Unsupported Bit_Shift" /end COMPU_VTAB
/begin MEASUREMENT CAN3term_type "CAN3 term type - 1{CAN3term_type&0x0c=0x00:NA}{CAN3term_type&0x0c=0x04:No Term}{CAN3term_type&0x0c=0x08:Term}" UBYTE CAN3term_type_COMPU_VTAB 0 0 0 255 ECU_ADDRESS 0x021F7000 MATRIX_DIM 16 1 1 BIT_MASK 0x0c /end MEASUREMENT
/begin COMPU_METHOD CAN3term_type_COMPU_VTAB "Verbal Table" TAB_VERB "%.0" "list" COMPU_TAB_REF CAN3term_type_COMPU_VTAB_REF /end COMPU_METHOD
/begin COMPU_VTAB CAN3term_type_COMPU_VTAB_REF "Verbal Table" TAB_VERB 3 0x00 "NA" 0x04 "No Term" 0x08 "Term" DEFAULT_VALUE "UNKNOWN" /end COMPU_VTAB
/begin MEASUREMENT CAN3term_loc "CAN3 term loc - 1{CAN3term_loc&0x03=0x00:NA}{CAN3term_loc&0x03=0x01:Rear}{CAN3term_loc&0x03=0x02:Mid}{CAN3term_loc&0x03=0x03:Front}" UBYTE CAN3term_loc_COMPU_VTAB 0 0 0 255 ECU_ADDRESS 0x021F8000 MATRIX_DIM 16 1 1 BIT_MASK 0x03 /end MEASUREMENT
/begin COMPU_METHOD CAN3term_loc_COMPU_VTAB "Verbal Table" TAB_VERB "%.0" "list" COMPU_TAB_REF CAN3term_loc_COMPU_VTAB_REF /end COMPU_METHOD
/begin COMPU_VTAB CAN3term_loc_COMPU_VTAB_REF "Verbal Table" TAB_VERB 4 0x00 "NA" 0x01 "Rear" 0x02 "Mid" 0x03 "Front" DEFAULT_VALUE "UNKNOWN" /end COMPU_VTAB
/begin MEASUREMENT CAN3term_src "CAN3 term src - 1" UBYTE Compu_CAN3term_src 0 0 0 255 ECU_ADDRESS 0x021F9000 MATRIX_DIM 16 1 1 /end MEASUREMENT
/begin COMPU_METHOD Compu_CAN3term_src " " RAT_FUNC "%.0" "-" COEFFS 0 1 0 0 0 1 /end COMPU_METHOD
/begin COMPU_METHOD Compu_TCRI_cld_ECT " " RAT_FUNC "%.1" "ECT (deg F)" COEFFS 0 32 14720 0 0 1 /end COMPU_METHOD
/begin COMPU_METHOD Compu_TCRI_cld_yrpm " " RAT_FUNC "%.0" "Speed (rpm)" COEFFS 0 1 0 0 0 1 /end COMPU_METHOD
/begin AXIS_PTS TCRI_cld_xload " " 0x00170A84 /* @ECU_Address@TCRI_cld_xload@0x022EB000@ */ NO_INPUT_QUANTITY ECIPP_Lookup_SWORD 0 Compu_TCRI_cld_xload 8 -1024 1023.96875 /end AXIS_PTS
/begin AXIS_PTS TCRI_cld_yrpm " " 0x00170A94 /* @ECU_Address@TCRI_cld_yrpm@0x022E0000@ */ NO_INPUT_QUANTITY ECIPP_Lookup_SWORD 0 Compu_TCRI_cld_yrpm 8 -32768 32767 /end AXIS_PTS
/begin CHARACTERISTIC TCRI_cld_Pmult "Pressure Base Offset Multiplier" CURVE 0x00170A54 /* @ECU_Address@TCRI_cld_Pmult@0x022E8000@ */ ECIPP_ALIGNMENT_SWORD 128 Compu_TCRI_cld_Pmult -128 127.99609375
 /begin AXIS_DESCR COM_AXIS NO_INPUT_QUANTITY Compu_TCRI_cld_ECT 8 -1484 563.96875 AXIS_PTS_REF TCRI_cld_ECT /end AXIS_DESCR
/end CHARACTERISTIC
/begin AXIS_PTS TCRI_cld_ECT " " 0x00170A44 /* @ECU_Address@TCRI_cld_ECT@0x022DE000@ */ NO_INPUT_QUANTITY ECIPP_Lookup_SWORD 0 Compu_TCRI_cld_ECT 8 -1484 563.96875 /end AXIS_PTS
/begin COMPU_METHOD Compu_TCRI_cld_Pmult " " RAT_FUNC "%.2" "Pressure Offset Mult" COEFFS 0 256 0 0 0 1 /end COMPU_METHOD
/begin CHARACTERISTIC TCRI_cld_Qmult "Quantity Base Offset Multiplier" CURVE 0x00170A64 /* @ECU_Address@TCRI_cld_Qmult@0x022E9000@ */ ECIPP_ALIGNMENT_SWORD 128 Compu_TCRI_cld_Qmult -128 127.99609375
 /begin AXIS_DESCR COM_AXIS NO_INPUT_QUANTITY Compu_TCRI_cld_ECT 8 -1484 563.96875 AXIS_PTS_REF TCRI_cld_ECT /end AXIS_DESCR
/end CHARACTERISTIC
/begin COMPU_METHOD Compu_TCRI_cld_Qmult " " RAT_FUNC "%.2" "Quantity Offset Mult" COEFFS 0 256 0 0 0 1 /end COMPU_METHOD
/begin CHARACTERISTIC TCRI_cld_Tmult "Timing Base Offset Multiplier" CURVE 0x00170A74 /* @ECU_Address@TCRI_cld_Tmult@0x022EA000@ */ ECIPP_ALIGNMENT_SWORD 128 Compu_TCRI_cld_Tmult -128 127.99609375
 /begin AXIS_DESCR COM_AXIS NO_INPUT_QUANTITY Compu_TCRI_cld_ECT 8 -1484 563.96875 AXIS_PTS_REF TCRI_cld_ECT /end AXIS_DESCR
/end CHARACTERISTIC
/begin COMPU_METHOD Compu_TCRI_cld_Tmult " " RAT_FUNC "%.2" "Timing Offset Mult" COEFFS 0 256 0 0 0 1 /end COMPU_METHOD
/begin COMPU_METHOD Compu_TCRI_cld_xload " " RAT_FUNC "%.1" "Fuel Load (mg/cyl)" COEFFS 0 32 0 0 0 1 /end COMPU_METHOD
/begin CHARACTERISTIC TCRI_Qpost1_cld "Post 1 Quantity Base Offset (mg/stroke)" MAP 0x0016EFC4 /* @ECU_Address@TCRI_Qpost1_cld@0x022F8000@ */ ECIPP_ALIGNMENT_SWORD 1024 Compu_TCRI_Qpost1_cld -1024 1023.96875
 /begin AXIS_DESCR COM_AXIS NO_INPUT_QUANTITY Compu_TCRI_cld_xload 8 -1024 1023.96875 AXIS_PTS_REF TCRI_cld_xload /end AXIS_DESCR
 /begin AXIS_DESCR COM_AXIS NO_INPUT_QUANTITY Compu_TCRI_cld_yrpm 8 -32768 32767 AXIS_PTS_REF TCRI_cld_yrpm /end AXIS_DESCR
/end CHARACTERISTIC
/begin COMPU_METHOD Compu_TCRI_Qpost1_cld "" RAT_FUNC "%.1" "Fuel Load (mg/cyl)" COEFFS 0 32 0 0 0 1 /end COMPU_METHOD
/begin CHARACTERISTIC TCRI_Qpost2_cld "Post 2 Quantity Base Offset (mg/stroke)" MAP 0x0016F444 /* @ECU_Address@TCRI_Qpost2_cld@0x022FB000@ */ ECIPP_ALIGNMENT_SWORD 1024 Compu_TCRI_Qpost2_cld -1024 1023.96875
 /begin AXIS_DESCR COM_AXIS NO_INPUT_QUANTITY Compu_TCRI_cld_xload 8 -1024 1023.96875 AXIS_PTS_REF TCRI_cld_xload /end AXIS_DESCR
 /begin AXIS_DESCR COM_AXIS NO_INPUT_QUANTITY Compu_TCRI_cld_yrpm 8 -32768 32767 AXIS_PTS_REF TCRI_cld_yrpm /end AXIS_DESCR
/end CHARACTERISTIC
/begin COMPU_METHOD Compu_TCRI_Qpost2_cld "" RAT_FUNC "%.1" "Fuel Load (mg/cyl)" COEFFS 0 32 0 0 0 1 /end COMPU_METHOD
/begin CHARACTERISTIC TCRI_Tpilot1_cld "Pilot 1 Timing Base Offset (CAD)" MAP 0x0016CC44 /* @ECU_Address@TCRI_Tpilot1_cld@0x02301000@ */ ECIPP_ALIGNMENT_SLONG 134217728 Compu_TCRI_Tpilot1_cld -134217728 134217727.9375
 /begin AXIS_DESCR COM_AXIS NO_INPUT_QUANTITY Compu_TCRI_cld_xload 8 -1024 1023.96875 AXIS_PTS_REF TCRI_cld_xload /end AXIS_DESCR
 /begin AXIS_DESCR COM_AXIS NO_INPUT_QUANTITY Compu_TCRI_cld_yrpm 8 -32768 32767 AXIS_PTS_REF TCRI_cld_yrpm /end AXIS_DESCR
/end CHARACTERISTIC
/begin COMPU_METHOD Compu_TCRI_Tpilot1_cld "" RAT_FUNC "%.1" "Fuel Load (mg/cyl)" COEFFS 0 16 0 0 0 1 /end COMPU_METHOD
/begin CHARACTERISTIC STR_WWHOBD_GTR_ver "ITID 0x11 - WWH-OBD GTR" ASCII 0x001693C4 /* @ECU_Address@STR_WWHOBD_GTR_ver@0x024B6000@ */ ECIPP_ALIGNMENT_UBYTE 255 Compu_ECIPP_STRINGS 0 255 MATRIX_DIM 19 1 1 /end CHARACTERISTIC
/begin COMPU_METHOD Compu_TGLOW_pre_TdegR " " RAT_FUNC "%.1" "Temp (deg F)" COEFFS 0 32 14720 0 0 1 /end COMPU_METHOD
/begin CHARACTERISTIC TGLOW_pre_time "Pre-glow schedule" CURVE 0x00144BFA /* @ECU_Address@TGLOW_pre_time@0x025F6000@ */ ECIPP_ALIGNMENT_SWORD 524 Compu_TGLOW_pre_time -524.288 524.272
 /begin AXIS_DESCR COM_AXIS NO_INPUT_QUANTITY Compu_TGLOW_pre_TdegR 8 -1484 563.96875 AXIS_PTS_REF TGLOW_pre_TdegR /end AXIS_DESCR
/end CHARACTERISTIC
/begin AXIS_PTS TGLOW_pre_TdegR " " 0x00144BEA /* @ECU_Address@TGLOW_pre_TdegR@0x025F5000@ */ NO_INPUT_QUANTITY ECIPP_Lookup_SWORD 0 Compu_TGLOW_pre_TdegR 8 -1484 563.96875 /end AXIS_PTS
/begin COMPU_METHOD Compu_TGLOW_pre_time " " RAT_FUNC "%.1" "Time (sec)" COEFFS 0 62.5 0 0 0 1 /end COMPU_METHOD
/begin CHARACTERISTIC TGLOW_post_time "Post-glow schedule" CURVE 0x00144BDA /* @ECU_Address@TGLOW_post_time@0x025FC000@ */ ECIPP_ALIGNMENT_SWORD 524 Compu_TGLOW_post_time -524.288 524.272
 /begin AXIS_DESCR COM_AXIS NO_INPUT_QUANTITY Compu_TGLOW_pre_TdegR 8 -1484 563.96875 AXIS_PTS_REF TGLOW_pre_TdegR /end AXIS_DESCR
/end CHARACTERISTIC
/begin COMPU_METHOD Compu_TGLOW_post_time " " RAT_FUNC "%.1" "Time (sec)" COEFFS 0 62.5 0 0 0 1 /end COMPU_METHOD
/begin GROUP EC_CLCalNG "ECONTROLS" ROOT
 /begin REF_CHARACTERISTIC trim_nom_crkN CLNG_hi CLNG_lo CLNG_K CLNG_K_acquire CLNG_stepmax CLpNG_Emax CLpNG_Emin CLpNG_Rp_def CLpNG_Rn_def ALNG_hi ALNG_lo ALNG_K ALNG_stepmax ALNG_dzone ALNG_valid ALNG_wait CL_dis_NG trim_NG_max trim_NG_min CLNG_lo_postcat CLNG_hi_postcat CLNG_Ki_p_postcat CLNG_postcat_ena CLNG_Ki_n_postcat CLNG_Kp_p_postcat CLNG_Kp_n_postcat CLNG_Kiv_p_postcat CLNG_Kiv_n_postcat CLN_phidt_hi_postcat CLN_phidt_lo_postcat MJ_P_minN MJ_P_maxN MJ_nom_crkN MJ_Pin_N FAstoich_s_N FAstoich_a_N SGf_NG SGfs_NG trim_tran_forceN trim_ntran_forceN CLNG_TD_enable CLNG_TD_max_p CLNG_TD_max_n CLNG_TD_EGOsw_ena CLNG_TD_sw_offset CLNG_TD_sw_pct CLNG_rst_postcat CLNG_TD_mdota MJ_nom_crkslwdN MJ_crk_holdN MJ_crk_slewN MJ_crk_run_slewN CLNG_Kp_p_ROL CLNG_Kp_n_ROL CLNG_Ki_p_ROL CLNG_Ki_n_ROL CLNG_ROL_win_p CLNG_ROL_win_n CLNG_ROL_res_dly CLNG_SS_dly CLNG_postcat_winpdlt CLNG_postcat_winndlt CLNG_ROLend_fastwrtm CLNG_post_fastwr_tm TCLp_tau_cycNG TCL_enaNG Tvent_PN T2trim_nom_DCNG T2MJ_nom_PN T2trim_nom_phiNG T2trim_nom_maLNG TTVf_BMDC_BMN /end REF_CHARACTERISTIC
/end GROUP
/begin GROUP EC_ColdStart "ECONTROLS" ROOT
 /begin REF_CHARACTERISTIC CRI_Tpilot2_type CRI_Tpilot1_type GLOW_type GLOW_mode GLOW_channel GLOW_GCU_diag_in GLOW_temp_input GLOW_Vbat_high GLOW_pre_Vbat_low GLOW_ECT_high GLOW_pre_keyon_wt GLOW_shutoff_temp GLOW_time_max GLOW_voltage GLOW_DC_min GLOW_DC_max GLOW_lamp_channel GLOW_pre_time_max GLOW_starter_pause diesel_lwld_comp_ena diesel_lwld_spd_thld diesel_lwld_ld_thld diesel_lwld_low_wait diesel_lwld_low_slew diesel_lwld_nrm_wait diesel_lwld_nrm_slew diesel_lwld_ini_wait TCRI_cld_Pmult TCRI_cld_Qmult TCRI_cld_Tmult TCRI_Qpost1_cld TCRI_Qpost2_cld TCRI_Tpilot1_cld TGLOW_pre_time TGLOW_post_time /end REF_CHARACTERISTIC
 /begin REF_MEASUREMENT CRI_mg_main_cld CRI_mg_pilot2_cld CRI_mg_pilot1_cld CRI_mg_post1_cld CRI_mg_post2_cld CRI_cad_main_cld CRI_cad_pilot2_cld CRI_cad_pilot1_cld CRI_cad_post1_cld CRI_cad_post2_cld GLOW_state GLOW_temp GLOW_pre_ms GLOW_max_ms GLOW_active GLOW_post_ms GLOW_pre_max_ms diesel_lwld_state diesel_lwld_timer diesel_lwld_slewval /end REF_MEASUREMENT
/end GROUP
/begin GROUP EC_Comms "ECONTROLS" ROOT
 /begin REF_CHARACTERISTIC RMT_start_tout RMT_start_ena RMT_start_rpm J1939_ena TSC_limit_only maxgv_TSC_Gov3 CCP_allow J1939_addrFail J1939_ena2 CAN1_speed CAN2_speed TSC_idlelim_mode TSC_ff_torque torque_Nm_ref J1939EC_broad_ena J1939_MIL_mode J1939_addr_frcena J1939_addr2_frcena J1939_addr_frcval J1939_addr2_frcval RMT_gov_att_ena NMHG_FPPidle_chk maxgvspk_TSC_Gov3 CAN1_term_ena CAN2_term_ena J1939_MIL_ena TSC_limit_trq J1939_ena3 CCP3_allow CAN3_speed CAN3_term_ena J1939_addr3_frcena J1939_addr3_frcval J1939EC_broad3_ena CCP2_allow J1939EC_broad2_ena J1939_addr2Fail J1939_addr3Fail J1939_DM4_manuf J1939_TSC1_mode J1939_fuel_rate_mode J1939_fuel_rate_mult SENT1_Data1_c SENT1_Data1_o SENT1_Data2_c SENT1_Data2_o SENT1_ena SENT2_ena SENT2_Data1_c SENT2_Data1_o SENT2_Data2_c SENT2_Data2_o SENT1_Data1_def SENT1_Data2_def SENT2_Data1_def SENT2_Data2_def J1939_FPPdual_idle J1939_RC_SA_ena J1939EC_tx_rate SPN_3344_ena J1939_EBC1_SD_tout J1939_TP_mod RMT_ff_torq_mode ISO15765_obdsup ISO15765_emissup SPN_1437_mode J1939_EC1_droop TSC_RPM_0_ignore RMT_tsc_fpp_ena CAN1_ISO15031_ena CAN2_ISO15031_ena CAN3_ISO15031_ena CAN1_UDS_KWP_mode CAN2_UDS_KWP_mode CAN3_UDS_KWP_mode ISO15765_ipt_spark ISO15765_ipt_comp maxgv_TSC_FA_Gov3 maxgvspk_TSC_FA_Gov3 TSC_gov_acc_setpnt SENT1_crc_type SENT2_crc_type SENT1_serial_def SENT2_serial_def CAN1_ISO15765_2_ena CAN2_ISO15765_2_ena CAN3_ISO15765_2_ena CAN1_ISO15765_2_cid CAN2_ISO15765_2_cid CAN3_ISO15765_2_cid CAN1_J1939_DM1_ena CAN2_J1939_DM1_ena CAN3_J1939_DM1_ena CAN1_CCP_chksum CAN2_CCP_chksum CAN3_CCP_chksum EBC1_hybrid_mode CCP_DAQ_ena J1939_fuel_rate_tau J1939_fuel_rate_FT1 J1939_fuel_rate_FT2 J1939_EEC1_torq_lmt SPN_1437_latch_tm SPN_1437_unlatch_tm J1939_TSC1_loss_mode EMS3_fuelleak_input TSC_maxlim_mode J1939_TSC1_rx_tout TJ1939_Tx_PGNs TJ1939_Tx2_PGNs TJ1939_Tx3_PGNs TJ1939_TxOK_PGNs TJ1939_TxOK2_PGNs TJ1939_TxOK3_PGNs TJ1939_Rx_PGNs TJ1939_Rx2_PGNs TJ1939_Rx3_PGNs TJ1939_Rx_SPNs TJ1939_Rx2_SPNs TJ1939_Rx3_SPNs STR_WWHOBD_GTR_ver /end REF_CHARACTERISTIC
 /begin REF_MEASUREMENT RMT_ctl_SD RMT_ctl_START RMT_ctl_SPEED RMT_ctl_FUEL RMT_ctl_FAULT RMT_speed RMT_start_tmr RMT_start RMT_fuel_select RMT_clear_SD CAN_Rx_packs CAN_Tx_packs PGrq_last_SA PGrq_last_RA PGrq_cnt DENIED_cnt NACK_cnt PGRx_cnt ADDRCLAIM_cnt NACK_last_SA NACK_last_RA DENIED_last_SA DENIED_last_RA CCP_CR_counter CCP_DT_counter CCP_session_actv J1939_addr_conflict CAN2_Rx_packs CAN2_Tx_packs RMT_ctl_THROT RMT_throt TRANS_gear_a TRANS_gear_d RMT_torq J1939_lamps_MIL J1939_lamps_RedStop J1939_lamps_AmbWarn J1939_lamps_Protect J1939_addr_latch J1939_addr2_latch RMT_Kd_att NMHG_trans_type RMT_stop_occurred RMT_stop RMT_ctl_STOP J1939_reload RMT_ctl_TRQ ADDRCLAIM2_cnt J1939_addr2_conflict CCP2_session_actv CCP3_session_actv J1939_addr3_latch CAN3_Rx_packs CAN3_Tx_packs CCP2_CR_counter CCP2_DT_counter CCP3_CR_counter CCP3_DT_counter J1939_addr3_conflict ADDRCLAIM3_cnt PGrq2_cnt DENIED2_cnt NACK2_cnt PGRx2_cnt PGrq3_cnt DENIED3_cnt NACK3_cnt PGRx3_cnt PGrq2_last_SA PGrq2_last_RA NACK2_last_SA NACK2_last_RA DENIED2_last_SA DENIED2_last_RA PGrq3_last_SA PGrq3_last_RA NACK3_last_SA NACK3_last_RA DENIED3_last_SA DENIED3_last_RA J1939_reload2 J1939_reload3 RMT_load RMT_IVS_atidle RMT_FPP1_raw RMT_FPP2_raw RMT_ctl_FPPRAW SHIFT_Nlock_btn RMT_speed_lmt RMT_torq_lmt RMT_speed_SA RMT_speed_lmt_SA RMT_torq_SA RMT_torq_lmt_SA RMT_load_lmt RMT_ctl_SPEED_LMT RMT_ctl_TRQ_LMT J1939_mdot_f_ports SENT1_data1 SENT1_data2 SENT1_error_cnt SENT1_no_signal_cnt SENT1_sync_time SENT1_timeout_cnt SENT1_crc_computed SENT1_crc_received SENT1_diag_info SENT1_status SENT2_data1 SENT2_data2 SENT2_error_cnt SENT2_no_signal_cnt SENT2_sync_time SENT2_timeout_cnt SENT2_crc_computed SENT2_crc_received SENT2_diag_info SENT2_status NMHG_perfmode_cmd TSC1_SA RMT_aux_SD_state ISO15765_2_Err_Cnt ISO15765_2_Err_Code ISO15765_4_Err_Cnt ISO15765_4_Err_Code CAN1_15765_2_Rx CAN1_15765_2_Tx CAN1_15765_4_Rx CAN1_15765_4_Tx CAN2_15765_2_Rx CAN2_15765_2_Tx CAN2_15765_4_Rx CAN2_15765_4_Tx CAN3_15765_2_Rx CAN3_15765_2_Tx CAN3_15765_4_Rx CAN3_15765_4_Tx Linde_ff_torq_req J1939_key_state pid_0x01_mil SENT1_serial_data SENT2_serial_data SENT1_serial_msg_id SENT2_serial_msg_id SENT1_serial_crc_ok SENT2_serial_crc_ok SENT1_serial_crc_no SENT2_serial_crc_no SENT1_serial_resync SENT2_serial_resync PGrq_last_PGN PGrq2_last_PGN PGrq3_last_PGN NACK_last_PGN NACK2_last_PGN NACK3_last_PGN DENIED_last_PGN DENIED2_last_PGN DENIED3_last_PGN J1939_Vdot_f_ports RMT_loadlim_tbl J1939_fuel_rate_acc CAN1term_valid CAN1term_mode CAN1term_type CAN1term_loc CAN2term_valid CAN2term_mode CAN2term_type CAN2term_loc CAN1term_src CAN2term_src CAN3term_valid CAN3term_mode CAN3term_type CAN3term_loc CAN3term_src /end REF_MEASUREMENT
/end GROUP
/begin GROUP EC_GovCal "ECONTROLS" ROOT /begin REF_CHARACTERISTIC TSC_gov_acc_setpnt /end REF_CHARACTERISTIC /begin REF_MEASUREMENT RMT_Kd_att /end REF_MEASUREMENT /end GROUP
/begin GROUP EC_HDOBD "ECONTROLS" ROOT /begin REF_MEASUREMENT pid_0x01_mil /end REF_MEASUREMENT /end GROUP
/begin GROUP EC_LoadCal "ECONTROLS" ROOT /begin REF_CHARACTERISTIC torque_Nm_ref /end REF_CHARACTERISTIC /end GROUP
/begin GROUP EC_Marine "ECONTROLS" ROOT /begin REF_MEASUREMENT TRANS_gear_a TRANS_gear_d SHIFT_Nlock_btn /end REF_MEASUREMENT /end GROUP
/begin GROUP EC_PhiNG "ECONTROLS" ROOT /begin REF_CHARACTERISTIC CLpNG_Emax CLpNG_Emin CLpNG_Rp_def CLpNG_Rn_def CL_dis_NG /end REF_CHARACTERISTIC /end GROUP
/begin GROUP EC_QTpilot2 "ECONTROLS" ROOT /begin REF_CHARACTERISTIC CRI_Tpilot2_type /end REF_CHARACTERISTIC /end GROUP
/begin GROUP EC_QTpilot1 "ECONTROLS" ROOT /begin REF_CHARACTERISTIC CRI_Tpilot1_type /end REF_CHARACTERISTIC /end GROUP
/end MODULE
/end PROJECT
