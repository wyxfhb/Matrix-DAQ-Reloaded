ASAP2_VERSION 1 61
/begin PROJECT Econtrols_4G "4G Test"
/begin HEADER "4G A2L Configuration" PROJECT_NO EControls4G /* config for version control */ VERSION "$Revision: 82130 $:" /* config for version control */ /end HEADER
/begin MODULE EControls_4G_SH2A "EControls 4G"
/begin MOD_COMMON "" DEPOSIT ABSOLUTE BYTE_ORDER MSB_FIRST /end MOD_COMMON
/* Define the Record Layouts */
/begin RECORD_LAYOUT ECIPP_ALIGNMENT_UBYTE FNC_VALUES 1 UBYTE COLUMN_DIR DIRECT /end RECORD_LAYOUT
/begin RECORD_LAYOUT ECIPP_ALIGNMENT_UWORD FNC_VALUES 1 UWORD COLUMN_DIR DIRECT /end RECORD_LAYOUT
/begin RECORD_LAYOUT ECIPP_ALIGNMENT_SWORD FNC_VALUES 1 SWORD COLUMN_DIR DIRECT /end RECORD_LAYOUT
/begin RECORD_LAYOUT ECIPP_Lookup_SWORD AXIS_PTS_X 1 SWORD INDEX_INCR DIRECT /end RECORD_LAYOUT
/begin RECORD_LAYOUT ECIPP_ALIGNMENT_ULONG FNC_VALUES 1 ULONG COLUMN_DIR DIRECT /end RECORD_LAYOUT
/begin RECORD_LAYOUT ECIPP_Lookup_ULONG AXIS_PTS_X 1 ULONG INDEX_INCR DIRECT /end RECORD_LAYOUT
/begin RECORD_LAYOUT ECIPP_ALIGNMENT_FLOAT32_IEEE FNC_VALUES 1 FLOAT32_IEEE COLUMN_DIR DIRECT /end RECORD_LAYOUT
/* Define generic COMPU_METHODS used in the A2L */ /* NOTE: most of the parameters from ECIPP use unique/specific COMPU_METHODS */
/begin COMPU_METHOD Compu_ECIPP_STRINGS "ECIPP Strings " /* Identifier */ RAT_FUNC "%.0" /* Format */ "ASCII" /* Units */ COEFFS 0 1 0 0 0 1 /end COMPU_METHOD
/begin COMPU_METHOD Compu_IDENTITY "Discrete Values " /* Identifier */ IDENTICAL "%.0" /* Format */ "-" /* Units */ /end COMPU_METHOD
/begin CHARACTERISTIC FRO_sleep "{FRO_sleep&0xff=0:Disabled}{FRO_sleep&0xff=1:Enabled}" VALUE 0x00166340 /* @ECU_Address@FRO_sleep@0x01011978@ */ ECIPP_ALIGNMENT_UBYTE 255 FRO_sleep_COMPU_VTAB 0 255 BIT_MASK 0xff /end CHARACTERISTIC
/begin COMPU_METHOD FRO_sleep_COMPU_VTAB "Verbal Table" TAB_VERB "%.0" "list" COMPU_TAB_REF FRO_sleep_COMPU_VTAB_REF /end COMPU_METHOD
/begin COMPU_VTAB FRO_sleep_COMPU_VTAB_REF "Verbal Table" TAB_VERB 2 0 "Disabled" 1 "Enabled" DEFAULT_VALUE "UNKNOWN" /end COMPU_VTAB
/begin CHARACTERISTIC EGRO_postlk_EGRdP "Air # EGRO_postlk_EGRdP (Fault Condition:EGRdP (single point) >)" VALUE 0x001401b8 /* @ECU_Address@EGRO_postlk_EGRdP@0x01011AD0@ */ ECIPP_ALIGNMENT_SWORD 32 Compu_EGRO_postlk_EGRdP -32 31.9990234375 /end CHARACTERISTIC
/begin COMPU_METHOD Compu_EGRO_postlk_EGRdP " " RAT_FUNC "%.3" "psi" COEFFS 0 1024 0 0 0 1 /end COMPU_METHOD
/begin CHARACTERISTIC EGRO_postlk_rpmdt "Air # EGRO_postlk_rpmdt (Fault Condition:and dRPM/dt <)" VALUE 0x00140044 /* @ECU_Address@EGRO_postlk_rpmdt@0x01011AD8@ */ ECIPP_ALIGNMENT_FLOAT32_IEEE 10000000000 Compu_EGRO_postlk_rpmdt -10000000000 10000000000 /end CHARACTERISTIC
/begin COMPU_METHOD Compu_EGRO_postlk_rpmdt " " RAT_FUNC "%.3" "rpm/s" COEFFS 0 0.001 0 0 0 1 /end COMPU_METHOD
/begin CHARACTERISTIC CM_unresp_FSO_tm "CL # CM_unresp_FSO_tm (Fault Condition:throttle open FSO active for >)" VALUE 0x0016348c /* @ECU_Address@CM_unresp_FSO_tm@0x01011BD0@ */ ECIPP_ALIGNMENT_UWORD 66 Compu_CM_unresp_FSO_tm 0 65.535 /end CHARACTERISTIC
/begin COMPU_METHOD Compu_CM_unresp_FSO_tm " " RAT_FUNC "%.3" "sec" COEFFS 0 1000 0 0 0 1 /end COMPU_METHOD
/begin CHARACTERISTIC CM_unresp_phi_tm "CL # CM_unresp_phi_tm (Fault Condition:for this time after FSO exit:)" VALUE 0x00163496 /* @ECU_Address@CM_unresp_phi_tm@0x01011BD8@ */ ECIPP_ALIGNMENT_UWORD 66 Compu_CM_unresp_phi_tm 0 65.535 /end CHARACTERISTIC
/begin COMPU_METHOD Compu_CM_unresp_phi_tm " " RAT_FUNC "%.3" "sec" COEFFS 0 1000 0 0 0 1 /end COMPU_METHOD
/begin CHARACTERISTIC CM_unresp_maxV "CL # CM_unresp_maxV (Fault Condition:and post-cat sensor voltage >)" VALUE 0x0016348e /* @ECU_Address@CM_unresp_maxV@0x01011BE0@ */ ECIPP_ALIGNMENT_UWORD 16 Compu_CM_unresp_maxV 0 15.999755859375 /end CHARACTERISTIC
/begin COMPU_METHOD Compu_CM_unresp_maxV " " RAT_FUNC "%.3" "volts" COEFFS 0 4096 0 0 0 1 /end COMPU_METHOD
/begin CHARACTERISTIC CM_unresp_min_MAP "CL # CM_unresp_min_MAP (Fault Condition:MAP >)" VALUE 0x00163490 /* @ECU_Address@CM_unresp_min_MAP@0x01011BE8@ */ ECIPP_ALIGNMENT_UWORD 256 Compu_CM_unresp_min_MAP 0 255.99609375 /end CHARACTERISTIC
/begin COMPU_METHOD Compu_CM_unresp_min_MAP " " RAT_FUNC "%.3" "psia" COEFFS 0 256 0 0 0 1 /end COMPU_METHOD
/begin CHARACTERISTIC CM_unresp_min_RPM "CL # CM_unresp_min_RPM (Fault Condition:and RPM >)" VALUE 0x00163492 /* @ECU_Address@CM_unresp_min_RPM@0x01011BF0@ */ ECIPP_ALIGNMENT_UWORD 65535 Compu_CM_unresp_min_RPM 0 65535 /end CHARACTERISTIC
/begin COMPU_METHOD Compu_CM_unresp_min_RPM " " RAT_FUNC "%.0" "rpm" COEFFS 0 1 0 0 0 1 /end COMPU_METHOD
/begin CHARACTERISTIC CM_unresp_pst_sw "CL # CM_unresp_pst_sw (Fault Condition:and post-cat sensor voltage <)" VALUE 0x00163498 /* @ECU_Address@CM_unresp_pst_sw@0x01011BF8@ */ ECIPP_ALIGNMENT_UWORD 16 Compu_CM_unresp_pst_sw 0 15.999755859375 /end CHARACTERISTIC
/begin COMPU_METHOD Compu_CM_unresp_pst_sw " " RAT_FUNC "%.3" "volts" COEFFS 0 4096 0 0 0 1 /end COMPU_METHOD
/begin CHARACTERISTIC MFG_RLV_FROmax "FaultConfig # MFG_RLV_FROmax (Fault Condition:Fuel run-out engine run time >)" VALUE 0x001475f4 /* @ECU_Address@MFG_RLV_FROmax@0x01011C40@ */ ECIPP_ALIGNMENT_UWORD 65535 Compu_MFG_RLV_FROmax 0 65535 /end CHARACTERISTIC
/begin COMPU_METHOD Compu_MFG_RLV_FROmax " " RAT_FUNC "%.0" "ms" COEFFS 0 1 0 0 0 1 /end COMPU_METHOD
/begin CHARACTERISTIC MFG_RLV_eng_cyc "FaultConfig # MFG_RLV_eng_cyc (Fault Condition:Number of engine warm cycles between runs)" VALUE 0x0016636d /* @ECU_Address@MFG_RLV_eng_cyc@0x01011C48@ */ ECIPP_ALIGNMENT_UBYTE 255 Compu_MFG_RLV_eng_cyc 0 255 /end CHARACTERISTIC
/begin COMPU_METHOD Compu_MFG_RLV_eng_cyc " " RAT_FUNC "%.0" "cycles" COEFFS 0 1 0 0 0 1 /end COMPU_METHOD
/begin CHARACTERISTIC MFG_RLV_run_force "FaultConfig # MFG_RLV_run_force (Fault Condition:Engine hours elapsed before forced test run)" VALUE 0x00162b98 /* @ECU_Address@MFG_RLV_run_force@0x01011C50@ */ ECIPP_ALIGNMENT_ULONG 1193046 Compu_MFG_RLV_run_force 0 1193046.47083333 /end CHARACTERISTIC
/begin COMPU_METHOD Compu_MFG_RLV_run_force " " RAT_FUNC "%.3" "hours" COEFFS 0 3600 0 0 0 1 /end COMPU_METHOD
/begin CHARACTERISTIC inj_sweep_tout "Injector individual kill timeout" VALUE 0x00147b46 /* @ECU_Address@inj_sweep_tout@0x01011C78@ */ ECIPP_ALIGNMENT_UWORD 66 Compu_inj_sweep_tout 0 65.535 MAX_REFRESH 6 1 /end CHARACTERISTIC
/begin COMPU_METHOD Compu_inj_sweep_tout " " RAT_FUNC "%.1" "sec" COEFFS 0 1000 0 0 0 1 /end COMPU_METHOD
/begin CHARACTERISTIC inj_sweep_delta "Injector good CL BM delta" VALUE 0x00146672 /* @ECU_Address@inj_sweep_delta@0x01011C80@ */ ECIPP_ALIGNMENT_SWORD 100 Compu_inj_sweep_delta -100 99.9969482421875 MAX_REFRESH 6 1 /end CHARACTERISTIC
/begin COMPU_METHOD Compu_inj_sweep_delta " " RAT_FUNC "%.1" "%" COEFFS 0 327.68 0 0 0 1 /end COMPU_METHOD
/begin CHARACTERISTIC inj_sweep_CL_delay "Injector sweep CL reset delay" VALUE 0x0014422c /* @ECU_Address@inj_sweep_CL_delay@0x01011C88@ */ ECIPP_ALIGNMENT_ULONG 4294967 Compu_inj_sweep_CL_delay 0 4294967.295 MAX_REFRESH 6 1 /end CHARACTERISTIC
/begin COMPU_METHOD Compu_inj_sweep_CL_delay " " RAT_FUNC "%.1" "sec" COEFFS 0 1000 0 0 0 1 /end COMPU_METHOD
/begin CHARACTERISTIC TWCmod_Kphi_gain "TWC observer gain" VALUE 0x00143bd0 /* @ECU_Address@TWCmod_Kphi_gain@0x01011CD8@ */ ECIPP_ALIGNMENT_FLOAT32_IEEE 10000000000 Compu_TWCmod_Kphi_gain -10000000000 10000000000 /end CHARACTERISTIC
/begin COMPU_METHOD Compu_TWCmod_Kphi_gain " " RAT_FUNC "%.3" "-" COEFFS 0 1 0 0 0 1 /end COMPU_METHOD
/begin CHARACTERISTIC TWCmod_K_OSC "TWC phi drift delay constant" VALUE 0x00143bcc /* @ECU_Address@TWCmod_K_OSC@0x01011CF0@ */ ECIPP_ALIGNMENT_FLOAT32_IEEE 10000000000 Compu_TWCmod_K_OSC -10000000000 10000000000 /end CHARACTERISTIC
/begin COMPU_METHOD Compu_TWCmod_K_OSC " " RAT_FUNC "%.1" "-" COEFFS 0 1 0 0 0 1 /end COMPU_METHOD
/begin CHARACTERISTIC TWCmod_phi_corr_max "TWC model phi correction upper limit" VALUE 0x00143be8 /* @ECU_Address@TWCmod_phi_corr_max@0x01011D08@ */ ECIPP_ALIGNMENT_FLOAT32_IEEE 10000000000 Compu_TWCmod_phi_corr_max -10000000000 10000000000 /end CHARACTERISTIC
/begin COMPU_METHOD Compu_TWCmod_phi_corr_max " " RAT_FUNC "%.3" "-" COEFFS 0 1 0 0 0 1 /end COMPU_METHOD
/begin CHARACTERISTIC TWCmod_phi_corr_min "TWC model phi correction lower limit" VALUE 0x00143bec /* @ECU_Address@TWCmod_phi_corr_min@0x01011D10@ */ ECIPP_ALIGNMENT_FLOAT32_IEEE 10000000000 Compu_TWCmod_phi_corr_min -10000000000 10000000000 /end CHARACTERISTIC
/begin COMPU_METHOD Compu_TWCmod_phi_corr_min " " RAT_FUNC "%.3" "-" COEFFS 0 1 0 0 0 1 /end COMPU_METHOD
/begin CHARACTERISTIC XEGOi_OOR_phi_min "FaultConfig # XEGOi_OOR_phi_min (Fault Condition:Pre-cat phi <)" VALUE 0x001650de /* @ECU_Address@XEGOi_OOR_phi_min@0x01011D20@ */ ECIPP_ALIGNMENT_UWORD 4 Compu_XEGOi_OOR_phi_min 0 3.99993896484375 /end CHARACTERISTIC
/begin COMPU_METHOD Compu_XEGOi_OOR_phi_min " " RAT_FUNC "%.3" "phi" COEFFS 0 16384 0 0 0 1 /end COMPU_METHOD
/begin CHARACTERISTIC XEGOi_OOR_phi_max "FaultConfig # XEGOi_OOR_phi_max (Fault Condition:or Pre-cat phi >)" VALUE 0x001650dc /* @ECU_Address@XEGOi_OOR_phi_max@0x01011D28@ */ ECIPP_ALIGNMENT_UWORD 4 Compu_XEGOi_OOR_phi_max 0 3.99993896484375 /end CHARACTERISTIC
/begin COMPU_METHOD Compu_XEGOi_OOR_phi_max " " RAT_FUNC "%.3" "phi" COEFFS 0 16384 0 0 0 1 /end COMPU_METHOD
/begin CHARACTERISTIC XEGOi_OOR_MAP_min "FaultConfig # XEGOi_OOR_MAP_min (Fault Condition:with MAP load >)" VALUE 0x001650d6 /* @ECU_Address@XEGOi_OOR_MAP_min@0x01011D30@ */ ECIPP_ALIGNMENT_UWORD 256 Compu_XEGOi_OOR_MAP_min 0 255.99609375 /end CHARACTERISTIC
/begin COMPU_METHOD Compu_XEGOi_OOR_MAP_min " " RAT_FUNC "%.3" "psia" COEFFS 0 256 0 0 0 1 /end COMPU_METHOD
/begin CHARACTERISTIC XEGOi_OOR_MAP_max "FaultConfig # XEGOi_OOR_MAP_max (Fault Condition:and MAP load <)" VALUE 0x001650d4 /* @ECU_Address@XEGOi_OOR_MAP_max@0x01011D38@ */ ECIPP_ALIGNMENT_UWORD 256 Compu_XEGOi_OOR_MAP_max 0 255.99609375 /end CHARACTERISTIC
/begin COMPU_METHOD Compu_XEGOi_OOR_MAP_max " " RAT_FUNC "%.3" "psia" COEFFS 0 256 0 0 0 1 /end COMPU_METHOD
/begin CHARACTERISTIC XEGOi_OOR_RPM_min "FaultConfig # XEGOi_OOR_RPM_min (Fault Condition:and RPM >)" VALUE 0x001650da /* @ECU_Address@XEGOi_OOR_RPM_min@0x01011D40@ */ ECIPP_ALIGNMENT_UWORD 65535 Compu_XEGOi_OOR_RPM_min 0 65535 /end CHARACTERISTIC
/begin COMPU_METHOD Compu_XEGOi_OOR_RPM_min " " RAT_FUNC "%.0" "rpm" COEFFS 0 1 0 0 0 1 /end COMPU_METHOD
/begin CHARACTERISTIC XEGOi_OOR_RPM_max "FaultConfig # XEGOi_OOR_RPM_max (Fault Condition:and RPM <)" VALUE 0x001650d8 /* @ECU_Address@XEGOi_OOR_RPM_max@0x01011D48@ */ ECIPP_ALIGNMENT_UWORD 65535 Compu_XEGOi_OOR_RPM_max 0 65535 /end CHARACTERISTIC
/begin COMPU_METHOD Compu_XEGOi_OOR_RPM_max " " RAT_FUNC "%.0" "rpm" COEFFS 0 1 0 0 0 1 /end COMPU_METHOD
/begin CHARACTERISTIC TWCdiag_OSC_est_thld "CL # TWCdiag_OSC_est_thld (Fault Condition:and TWC oxygen storage capacity <)" VALUE 0x00161cc0 /* @ECU_Address@TWCdiag_OSC_est_thld@0x01011EA0@ */ ECIPP_ALIGNMENT_FLOAT32_IEEE 10000000000 Compu_TWCdiag_OSC_est_thld -10000000000 10000000000 /end CHARACTERISTIC
/begin COMPU_METHOD Compu_TWCdiag_OSC_est_thld " " RAT_FUNC "%.3" "g" COEFFS 0 1 0 0 0 1 /end COMPU_METHOD
/begin CHARACTERISTIC CM_unresp_min_phi "CL # CM_unresp_min_phi (Fault Condition:and pre-cat phi >)" VALUE 0x00163494 /* @ECU_Address@CM_unresp_min_phi@0x01011FE0@ */ ECIPP_ALIGNMENT_UWORD 4 Compu_CM_unresp_min_phi 0 3.99993896484375 /end CHARACTERISTIC
/begin COMPU_METHOD Compu_CM_unresp_min_phi " " RAT_FUNC "%.3" "phi" COEFFS 0 16384 0 0 0 1 /end COMPU_METHOD
/begin CHARACTERISTIC engine_SNPN_flash "Reprogram # engine_SNPN_flash" VALUE 0x001650e6 /* @ECU_Address@engine_SNPN_flash@0x01012018@ */ ECIPP_ALIGNMENT_UWORD 65535 Compu_engine_SNPN_flash 0 65535 /end CHARACTERISTIC
/begin COMPU_METHOD Compu_engine_SNPN_flash " " RAT_FUNC "%.0" "NONE" COEFFS 0 1 0 0 0 1 /end COMPU_METHOD
/begin CHARACTERISTIC fm_induce_l3_ll "{fm_induce_l3_ll&0xff=0:Disabled}{fm_induce_l3_ll&0xff=1:Table 1 / Gasoline Load-Limit}{fm_induce_l3_ll&0xff=2:Table 2 / LPG Load-Limit}{fm_induce_l3_ll&0xff=3:Table 3 / NG Load-Limit}{fm_induce_l3_ll&0xff=4:Table 4 / Power Load-Limit}{fm_induce_l3_ll&0xf" VALUE 0x0016c324 /* @ECU_Address@fm_induce_l3_ll@0x01012020@ */ ECIPP_ALIGNMENT_UBYTE 255 fm_induce_l3_ll_COMPU_VTAB 0 255 BIT_MASK 0xff /end CHARACTERISTIC
/begin COMPU_METHOD fm_induce_l3_ll_COMPU_VTAB "Verbal Table" TAB_VERB "%.0" "list" COMPU_TAB_REF fm_induce_l3_ll_COMPU_VTAB_REF /end COMPU_METHOD
/begin COMPU_VTAB fm_induce_l3_ll_COMPU_VTAB_REF "Verbal Table" TAB_VERB 9 0 "Disabled" 1 "Table 1 / Gasoline Load-Limit" 2 "Table 2 / LPG Load-Limit" 3 "Table 3 / NG Load-Limit" 4 "Table 4 / Power Load-Limit" 5 "Table 5" 6 "Table 6" 7 "Table 7" 8 "Table 8" DEFAULT_VALUE "UNKNOWN" /end COMPU_VTAB
/begin CHARACTERISTIC camloss_crkng_ena "{camloss_crkng_ena&0xff=0:Disabled}{camloss_crkng_ena&0xff=1:Enabled} (Fault Condition:Cam1 loss during cranking)" VALUE 0x0016c30a /* @ECU_Address@camloss_crkng_ena@0x01012070@ */ ECIPP_ALIGNMENT_UBYTE 255 camloss_crkng_ena_COMPU_VTAB 0 255 BIT_MASK 0xff /end CHARACTERISTIC
/begin COMPU_METHOD camloss_crkng_ena_COMPU_VTAB "Verbal Table" TAB_VERB "%.0" "list" COMPU_TAB_REF camloss_crkng_ena_COMPU_VTAB_REF /end COMPU_METHOD
/begin COMPU_VTAB camloss_crkng_ena_COMPU_VTAB_REF "Verbal Table" TAB_VERB 2 0 "Disabled" 1 "Enabled" DEFAULT_VALUE "UNKNOWN" /end COMPU_VTAB
/begin CHARACTERISTIC camloss_crkng "FaultConfig # camloss_crkng (Fault Condition:No cam pulse during cranking in)" VALUE 0x0016c309 /* @ECU_Address@camloss_crkng@0x01012078@ */ ECIPP_ALIGNMENT_UBYTE 64 Compu_camloss_crkng 0 63.75 /end CHARACTERISTIC
/begin COMPU_METHOD Compu_camloss_crkng " " RAT_FUNC "%.3" "cycles" COEFFS 0 4 0 0 0 1 /end COMPU_METHOD
/begin CHARACTERISTIC cam2loss_crkng_ena "{cam2loss_crkng_ena&0xff=0:Disabled}{cam2loss_crkng_ena&0xff=1:Enabled} (Fault Condition:Cam2 loss during cranking)" VALUE 0x0016c308 /* @ECU_Address@cam2loss_crkng_ena@0x01012088@ */ ECIPP_ALIGNMENT_UBYTE 255 cam2loss_crkng_ena_COMPU_VTAB 0 255 BIT_MASK 0xff /end CHARACTERISTIC
/begin COMPU_METHOD cam2loss_crkng_ena_COMPU_VTAB "Verbal Table" TAB_VERB "%.0" "list" COMPU_TAB_REF cam2loss_crkng_ena_COMPU_VTAB_REF /end COMPU_METHOD
/begin COMPU_VTAB cam2loss_crkng_ena_COMPU_VTAB_REF "Verbal Table" TAB_VERB 2 0 "Disabled" 1 "Enabled" DEFAULT_VALUE "UNKNOWN" /end COMPU_VTAB
/begin CHARACTERISTIC cam2loss_crkng "FaultConfig # cam2loss_crkng (Fault Condition:No cam pulse during cranking in)" VALUE 0x0016c307 /* @ECU_Address@cam2loss_crkng@0x01012090@ */ ECIPP_ALIGNMENT_UBYTE 64 Compu_cam2loss_crkng 0 63.75 /end CHARACTERISTIC
/begin COMPU_METHOD Compu_cam2loss_crkng " " RAT_FUNC "%.3" "cycles" COEFFS 0 4 0 0 0 1 /end COMPU_METHOD
/begin CHARACTERISTIC OILTL_def "IOConfig # OILTL_def" VALUE 0x00162bde /* @ECU_Address@OILTL_def@0x010120A0@ */ ECIPP_ALIGNMENT_SWORD 125 Compu_OILTL_def -125 124.996185302734 /end CHARACTERISTIC
/begin COMPU_METHOD Compu_OILTL_def " " RAT_FUNC "%.3" "%" COEFFS 0 262.144 0 0 0 1 /end COMPU_METHOD
/begin CHARACTERISTIC ntwk_node_family "General # ntwk_node_family" VALUE 0x001650f0 /* @ECU_Address@ntwk_node_family@0x010120E0@ */ ECIPP_ALIGNMENT_UWORD 65535 Compu_ntwk_node_family 0 65535 /end CHARACTERISTIC
/begin COMPU_METHOD Compu_ntwk_node_family " " RAT_FUNC "%.0" "NONE" COEFFS 0 1 0 0 0 1 /end COMPU_METHOD
/begin CHARACTERISTIC ntwk_node_type "General # ntwk_node_type" VALUE 0x001650f4 /* @ECU_Address@ntwk_node_type@0x010120E8@ */ ECIPP_ALIGNMENT_UWORD 65535 Compu_ntwk_node_type 0 65535 /end CHARACTERISTIC
/begin COMPU_METHOD Compu_ntwk_node_type " " RAT_FUNC "%.0" "NONE" COEFFS 0 1 0 0 0 1 /end COMPU_METHOD
/begin CHARACTERISTIC ntwk_node_pos "General # ntwk_node_pos" VALUE 0x001650f2 /* @ECU_Address@ntwk_node_pos@0x010120F0@ */ ECIPP_ALIGNMENT_UWORD 65535 Compu_ntwk_node_pos 0 65535 /end CHARACTERISTIC
/begin COMPU_METHOD Compu_ntwk_node_pos " " RAT_FUNC "%.0" "NONE" COEFFS 0 1 0 0 0 1 /end COMPU_METHOD
/begin CHARACTERISTIC EGT_maxv "FaultConfig # EGT_maxv (Fault Condition:EGT voltage >)" VALUE 0x00163502 /* @ECU_Address@EGT_maxv@0x01012160@ */ ECIPP_ALIGNMENT_UWORD 5 Compu_EGT_maxv 0 5.00114468864469 /end CHARACTERISTIC
/begin COMPU_METHOD Compu_EGT_maxv " " RAT_FUNC "%.3" "volts" COEFFS 0 13104 0 0 0 1 /end COMPU_METHOD
/begin CHARACTERISTIC EGT_minv "FaultConfig # EGT_minv (Fault Condition:EGT voltage <)" VALUE 0x00163508 /* @ECU_Address@EGT_minv@0x01012168@ */ ECIPP_ALIGNMENT_UWORD 5 Compu_EGT_minv 0 5.00114468864469 /end CHARACTERISTIC
/begin COMPU_METHOD Compu_EGT_minv " " RAT_FUNC "%.3" "volts" COEFFS 0 13104 0 0 0 1 /end COMPU_METHOD
/begin CHARACTERISTIC FPlo_derate_time "FaultConfig # FPlo_derate_time (Fault Condition:Low fuel pressure derate active >)" VALUE 0x001468da /* @ECU_Address@FPlo_derate_time@0x01012180@ */ ECIPP_ALIGNMENT_UWORD 65535 Compu_FPlo_derate_time 0 65535 /end CHARACTERISTIC
/begin COMPU_METHOD Compu_FPlo_derate_time " " RAT_FUNC "%.0" "seconds" COEFFS 0 1 0 0 0 1 /end COMPU_METHOD
/begin CHARACTERISTIC EGR_LoExp_dmdot "Air # EGR_LoExp_dmdot (Fault Condition:EGR flow command dt <=)" VALUE 0x00143980 /* @ECU_Address@EGR_LoExp_dmdot@0x01012258@ */ ECIPP_ALIGNMENT_FLOAT32_IEEE 10000000000 Compu_EGR_LoExp_dmdot -10000000000 10000000000 /end CHARACTERISTIC
/begin COMPU_METHOD Compu_EGR_LoExp_dmdot " " RAT_FUNC "%.3" "g/sec^2" COEFFS 0 1 0 0 0 1 /end COMPU_METHOD
/begin CHARACTERISTIC EGR_LoExp_dmdot_wait "Air # EGR_LoExp_dmdot_wait (Fault Condition:for at least)" VALUE 0x00146806 /* @ECU_Address@EGR_LoExp_dmdot_wait@0x01012260@ */ ECIPP_ALIGNMENT_UWORD 66 Compu_EGR_LoExp_dmdot_wait 0 65.535 /end CHARACTERISTIC
/begin COMPU_METHOD Compu_EGR_LoExp_dmdot_wait " " RAT_FUNC "%.3" "seconds" COEFFS 0 1000 0 0 0 1 /end COMPU_METHOD
/begin CHARACTERISTIC EGRO_postlk_RPMmax "Air # EGRO_postlk_RPMmax (Fault Condition:and RPM <)" VALUE 0x001634f2 /* @ECU_Address@EGRO_postlk_RPMmax@0x010122C8@ */ ECIPP_ALIGNMENT_UWORD 65535 Compu_EGRO_postlk_RPMmax 0 65535 /end CHARACTERISTIC
/begin COMPU_METHOD Compu_EGRO_postlk_RPMmax " " RAT_FUNC "%.0" "rpm" COEFFS 0 1 0 0 0 1 /end COMPU_METHOD
/begin CHARACTERISTIC IAT_HiExp_mdota_min "FaultConfig # IAT_HiExp_mdota_min (Fault Condition:and air mass flow >)" VALUE 0x00164f20 /* @ECU_Address@IAT_HiExp_mdota_min@0x010122D0@ */ ECIPP_ALIGNMENT_UWORD 1024 Compu_IAT_HiExp_mdota_min 0 1023.984375 /end CHARACTERISTIC
/begin COMPU_METHOD Compu_IAT_HiExp_mdota_min " " RAT_FUNC "%.3" "g/sec" COEFFS 0 64 0 0 0 1 /end COMPU_METHOD
/begin CHARACTERISTIC IAT_HiExp2_mdota_min "FaultConfig # IAT_HiExp2_mdota_min (Fault Condition:and air mass flow >)" VALUE 0x00164f1e /* @ECU_Address@IAT_HiExp2_mdota_min@0x010122D8@ */ ECIPP_ALIGNMENT_UWORD 1024 Compu_IAT_HiExp2_mdota_min 0 1023.984375 /end CHARACTERISTIC
/begin COMPU_METHOD Compu_IAT_HiExp2_mdota_min " " RAT_FUNC "%.3" "g/sec" COEFFS 0 64 0 0 0 1 /end COMPU_METHOD
/begin CHARACTERISTIC EGRO_postlk_source "{EGRO_postlk_source&0xff=0:Single Point}{EGRO_postlk_source&0xff=1:Table Based} (Fault Condition:EGRdP threshold source)" VALUE 0x00147d29 /* @ECU_Address@EGRO_postlk_source@0x010124F0@ */ ECIPP_ALIGNMENT_UBYTE 255 EGRO_postlk_source_COMPU_VTAB 0 255 BIT_MASK 0xff /end CHARACTERISTIC
/begin COMPU_METHOD EGRO_postlk_source_COMPU_VTAB "Verbal Table" TAB_VERB "%.0" "list" COMPU_TAB_REF EGRO_postlk_source_COMPU_VTAB_REF /end COMPU_METHOD
/begin COMPU_VTAB EGRO_postlk_source_COMPU_VTAB_REF "Verbal Table" TAB_VERB 2 0 "Single Point" 1 "Table Based" DEFAULT_VALUE "UNKNOWN" /end COMPU_VTAB
/begin CHARACTERISTIC EGRO_postlk_vlvdP_lo "Air # EGRO_postlk_vlvdP_lo" VALUE 0x001442bc /* @ECU_Address@EGRO_postlk_vlvdP_lo@0x010124F8@ */ ECIPP_ALIGNMENT_SWORD 128 Compu_EGRO_postlk_vlvdP_lo -128 127.99609375 /end CHARACTERISTIC
/begin COMPU_METHOD Compu_EGRO_postlk_vlvdP_lo " " RAT_FUNC "%.3" "psi" COEFFS 0 256 0 0 0 1 /end COMPU_METHOD
/begin CHARACTERISTIC EGRO_postlk_vlvdP_hi "Air # EGRO_postlk_vlvdP_hi" VALUE 0x001442ba /* @ECU_Address@EGRO_postlk_vlvdP_hi@0x01012500@ */ ECIPP_ALIGNMENT_SWORD 128 Compu_EGRO_postlk_vlvdP_hi -128 127.99609375 /end CHARACTERISTIC
/begin COMPU_METHOD Compu_EGRO_postlk_vlvdP_hi " " RAT_FUNC "%.3" "psi" COEFFS 0 256 0 0 0 1 /end COMPU_METHOD
/begin CHARACTERISTIC EGRO_postlk_tbl_pct "Air # EGRO_postlk_tbl_pct" VALUE 0x00146804 /* @ECU_Address@EGRO_postlk_tbl_pct@0x01012508@ */ ECIPP_ALIGNMENT_UWORD 400 Compu_EGRO_postlk_tbl_pct 0 399.993896484375 /end CHARACTERISTIC
/begin COMPU_METHOD Compu_EGRO_postlk_tbl_pct " " RAT_FUNC "%.3" "%" COEFFS 0 163.84 0 0 0 1 /end COMPU_METHOD
/begin CHARACTERISTIC WGPerr_minRS "FaultConfig # WGPerr_minRS (Fault Condition:and roadspeed >=)" VALUE 0x00147a6c /* @ECU_Address@WGPerr_minRS@0x01012510@ */ ECIPP_ALIGNMENT_UWORD 256 Compu_WGPerr_minRS 0 255.99609375 /end CHARACTERISTIC
/begin COMPU_METHOD Compu_WGPerr_minRS " " RAT_FUNC "%.3" "km/hr" COEFFS 0 256 0 0 0 1 /end COMPU_METHOD
/begin CHARACTERISTIC EGRO_postlk_FSO_min "Air # EGRO_postlk_FSO_min" VALUE 0x00146802 /* @ECU_Address@EGRO_postlk_FSO_min@0x01012518@ */ ECIPP_ALIGNMENT_UWORD 66 Compu_EGRO_postlk_FSO_min 0 65.535 /end CHARACTERISTIC
/begin COMPU_METHOD Compu_EGRO_postlk_FSO_min " " RAT_FUNC "%.3" "sec" COEFFS 0 1000 0 0 0 1 /end COMPU_METHOD
/begin CHARACTERISTIC EGRO_postlk_FSO_max "Air # EGRO_postlk_FSO_max" VALUE 0x00146800 /* @ECU_Address@EGRO_postlk_FSO_max@0x01012520@ */ ECIPP_ALIGNMENT_UWORD 66 Compu_EGRO_postlk_FSO_max 0 65.535 /end CHARACTERISTIC
/begin COMPU_METHOD Compu_EGRO_postlk_FSO_max " " RAT_FUNC "%.3" "sec" COEFFS 0 1000 0 0 0 1 /end COMPU_METHOD
/begin CHARACTERISTIC fuelclr_chan "{fuelclr_chan&0xff=0:Disabled}{fuelclr_chan&0xff=1:Aux PU1 = Gnd}{fuelclr_chan&0xff=2:Aux PU2 = Gnd}{fuelclr_chan&0xff=3:Aux PU3 = Gnd}{fuelclr_chan&0xff=4:Aux PUD1 = Gnd}{fuelclr_chan&0xff=5:Aux PUD2 = Gnd}{fuelclr_chan&0xff=6:Aux PUD3 = Gnd}{fuelclr_cha" VALUE 0x0016c325 /* @ECU_Address@fuelclr_chan@0x01012570@ */ ECIPP_ALIGNMENT_UBYTE 255 fuelclr_chan_COMPU_VTAB 0 255 BIT_MASK 0xff /end CHARACTERISTIC
/begin COMPU_METHOD fuelclr_chan_COMPU_VTAB "Verbal Table" TAB_VERB "%.0" "list" COMPU_TAB_REF fuelclr_chan_COMPU_VTAB_REF /end COMPU_METHOD
/begin COMPU_VTAB fuelclr_chan_COMPU_VTAB_REF "Verbal Table" TAB_VERB 30 0 "Disabled" 1 "Aux PU1 = Gnd" 2 "Aux PU2 = Gnd" 3 "Aux PU3 = Gnd" 4 "Aux PUD1 = Gnd" 5 "Aux PUD2 = Gnd" 6 "Aux PUD3 = Gnd" 7 "Aux PUD4 = +V" 8 "Aux PUD5 = Gnd" 9 "Aux DIG1" 10 "Aux DIG2" 11 "Aux DIG3" 12 "Aux DIG4" 13 "Aux DIG5" 14 "Aux DIG6" 15 "Aux DIG7" 16 "Aux DIG8" 17 "Aux DIG9" 18 "Aux DIG10" 19 "Aux DIG11" 20 "Aux DIG12" 21 "Aux DIG13" 22 "Aux DIG14" 23 "Aux DIG15" 24 "Aux DIG16" 25 "Aux DIG17" 26 "Aux DIG18" 27 "Aux DIG19" 28 "Gov1" 29 "Gov2" DEFAULT_VALUE "UNKNOWN" /end COMPU_VTAB
/begin CHARACTERISTIC fuelclr_chan_cfg "{fuelclr_chan_cfg&0xff=0:Default}{fuelclr_chan_cfg&0xff=1:GND}{fuelclr_chan_cfg&0xff=2:GND/+V}{fuelclr_chan_cfg&0xff=3:+V}{fuelclr_chan_cfg&0xff=4:Open}" VALUE 0x0016c326 /* @ECU_Address@fuelclr_chan_cfg@0x01012578@ */ ECIPP_ALIGNMENT_UBYTE 255 fuelclr_chan_cfg_COMPU_VTAB 0 255 BIT_MASK 0xff /end CHARACTERISTIC
/begin COMPU_METHOD fuelclr_chan_cfg_COMPU_VTAB "Verbal Table" TAB_VERB "%.0" "list" COMPU_TAB_REF fuelclr_chan_cfg_COMPU_VTAB_REF /end COMPU_METHOD
/begin COMPU_VTAB fuelclr_chan_cfg_COMPU_VTAB_REF "Verbal Table" TAB_VERB 5 0 "Default" 1 "GND" 2 "GND/+V" 3 "+V" 4 "Open" DEFAULT_VALUE "UNKNOWN" /end COMPU_VTAB
/begin CHARACTERISTIC fuelclr_debounce "Fuel # fuelclr_debounce" VALUE 0x001650ee /* @ECU_Address@fuelclr_debounce@0x01012580@ */ ECIPP_ALIGNMENT_UWORD 66 Compu_fuelclr_debounce 0 65.535 /end CHARACTERISTIC
/begin COMPU_METHOD Compu_fuelclr_debounce " " RAT_FUNC "%.3" "sec" COEFFS 0 1000 0 0 0 1 /end COMPU_METHOD
/begin CHARACTERISTIC KNK_retardlmt_oct "FaultConfig # KNK_retardlmt_oct (Fault Condition:and octane rating <=)" VALUE 0x00147538 /* @ECU_Address@KNK_retardlmt_oct@0x010125B0@ */ ECIPP_ALIGNMENT_UWORD 100 Compu_KNK_retardlmt_oct 0 99.9984741210938 /end CHARACTERISTIC
/begin COMPU_METHOD Compu_KNK_retardlmt_oct " " RAT_FUNC "%.3" "%" COEFFS 0 655.36 0 0 0 1 /end COMPU_METHOD
/begin CHARACTERISTIC KNK_retardlmt_oct2 "FaultConfig # KNK_retardlmt_oct2 (Fault Condition:and octane rating <=)" VALUE 0x0014753a /* @ECU_Address@KNK_retardlmt_oct2@0x010125B8@ */ ECIPP_ALIGNMENT_UWORD 100 Compu_KNK_retardlmt_oct2 0 99.9984741210938 /end CHARACTERISTIC
/begin COMPU_METHOD Compu_KNK_retardlmt_oct2 " " RAT_FUNC "%.3" "%" COEFFS 0 655.36 0 0 0 1 /end COMPU_METHOD
/begin CHARACTERISTIC RS_setsrc_ntwk "{RS_setsrc_ntwk&0xff=0:PGN 65450}{RS_setsrc_ntwk&0xff=1:PGN 65261 CCSS}{RS_setsrc_ntwk&0xff=2:PGN 65473}" VALUE 0x00166383 /* @ECU_Address@RS_setsrc_ntwk@0x010126A8@ */ ECIPP_ALIGNMENT_UBYTE 255 RS_setsrc_ntwk_COMPU_VTAB 0 255 BIT_MASK 0xff /end CHARACTERISTIC
/begin COMPU_METHOD RS_setsrc_ntwk_COMPU_VTAB "Verbal Table" TAB_VERB "%.0" "list" COMPU_TAB_REF RS_setsrc_ntwk_COMPU_VTAB_REF /end COMPU_METHOD
/begin COMPU_VTAB RS_setsrc_ntwk_COMPU_VTAB_REF "Verbal Table" TAB_VERB 3 0 "PGN 65450" 1 "PGN 65261 CCSS" 2 "PGN 65473" DEFAULT_VALUE "UNKNOWN" /end COMPU_VTAB
/begin CHARACTERISTIC J1939_DM19_cksum "General # J1939_DM19_cksum" VALUE 0x00166363 /* @ECU_Address@J1939_DM19_cksum@0x010126C0@ */ ECIPP_ALIGNMENT_UBYTE 255 Compu_J1939_DM19_cksum 1 256 /end CHARACTERISTIC
/begin COMPU_METHOD Compu_J1939_DM19_cksum " " RAT_FUNC "%.0" "-" COEFFS 0 1 -1 0 0 1 /end COMPU_METHOD
/begin CHARACTERISTIC WGPerr_delta "FaultConfig # WGPerr_delta (Fault Condition:and abs(target WGP - actual WGP) >)" VALUE 0x0014657e /* @ECU_Address@WGPerr_delta@0x01012710@ */ ECIPP_ALIGNMENT_SWORD 128 Compu_WGPerr_delta -128 127.99609375 /end CHARACTERISTIC
/begin COMPU_METHOD Compu_WGPerr_delta " " RAT_FUNC "%.3" "psi" COEFFS 0 256 0 0 0 1 /end COMPU_METHOD
/begin CHARACTERISTIC EGRdP_HiExp_source "{EGRdP_HiExp_source&0xff=0:Single Point}{EGRdP_HiExp_source&0xff=1:Table Based} (Fault Condition:EGRdP threshold source)" VALUE 0x001409b6 /* @ECU_Address@EGRdP_HiExp_source@0x01012720@ */ ECIPP_ALIGNMENT_UBYTE 255 EGRdP_HiExp_source_COMPU_VTAB 0 255 BIT_MASK 0xff /end CHARACTERISTIC
/begin COMPU_METHOD EGRdP_HiExp_source_COMPU_VTAB "Verbal Table" TAB_VERB "%.0" "list" COMPU_TAB_REF EGRdP_HiExp_source_COMPU_VTAB_REF /end COMPU_METHOD
/begin COMPU_VTAB EGRdP_HiExp_source_COMPU_VTAB_REF "Verbal Table" TAB_VERB 2 0 "Single Point" 1 "Table Based" DEFAULT_VALUE "UNKNOWN" /end COMPU_VTAB
/begin CHARACTERISTIC module_load_ECM_ID "General # module_load_ECM_ID" VALUE 0x0016c329 /* @ECU_Address@module_load_ECM_ID@0x01012768@ */ ECIPP_ALIGNMENT_UBYTE 255 Compu_module_load_ECM_ID 0 255 /end CHARACTERISTIC
/begin COMPU_METHOD Compu_module_load_ECM_ID " " RAT_FUNC "%.0" "-" COEFFS 0 1 0 0 0 1 /end COMPU_METHOD
/begin CHARACTERISTIC OILP_wait_source "{OILP_wait_source&0xff=0:Single Point}{OILP_wait_source&0xff=1:Table Based} (Fault Condition:Run time wait threshold source)" VALUE 0x00147e9f /* @ECU_Address@OILP_wait_source@0x01012770@ */ ECIPP_ALIGNMENT_UBYTE 255 OILP_wait_source_COMPU_VTAB 0 255 BIT_MASK 0xff /end CHARACTERISTIC
/begin COMPU_METHOD OILP_wait_source_COMPU_VTAB "Verbal Table" TAB_VERB "%.0" "list" COMPU_TAB_REF OILP_wait_source_COMPU_VTAB_REF /end COMPU_METHOD
/begin COMPU_VTAB OILP_wait_source_COMPU_VTAB_REF "Verbal Table" TAB_VERB 2 0 "Single Point" 1 "Table Based" DEFAULT_VALUE "UNKNOWN" /end COMPU_VTAB
/begin CHARACTERISTIC F201_security "IOConfig # F201_security" VALUE 0x00165112 /* @ECU_Address@F201_security@0x010127D8@ */ ECIPP_ALIGNMENT_UBYTE 255 Compu_F201_security 0 255 /end CHARACTERISTIC
/begin COMPU_METHOD Compu_F201_security " " RAT_FUNC "%.0" "-" COEFFS 0 1 0 0 0 1 /end COMPU_METHOD
/begin CHARACTERISTIC F201_version "IOConfig # F201_version" VALUE 0x00163512 /* @ECU_Address@F201_version@0x010127E0@ */ ECIPP_ALIGNMENT_UWORD 65535 Compu_F201_version 0 65535 /end CHARACTERISTIC
/begin COMPU_METHOD Compu_F201_version " " RAT_FUNC "%.0" "-" COEFFS 0 1 0 0 0 1 /end COMPU_METHOD
/begin CHARACTERISTIC CL_ROL_reinit_hi "ROL state re-init high value" VALUE 0x001433E4 /* @ECU_Address@CL_ROL_reinit_hi@0x01012810@ */ ECIPP_ALIGNMENT_UWORD 100 Compu_CL_ROL_reinit_hi 0 99.9984741210938 MAX_REFRESH 6 1 /end CHARACTERISTIC
/begin COMPU_METHOD Compu_CL_ROL_reinit_hi " " RAT_FUNC "%.0" "%" COEFFS 0 655.36 0 0 0 1 /end COMPU_METHOD
/begin CHARACTERISTIC CLLP_ROL_reinit_hi "ROL state re-init high value" VALUE 0x0014192C /* @ECU_Address@CLLP_ROL_reinit_hi@0x01012818@ */ ECIPP_ALIGNMENT_UWORD 100 Compu_CLLP_ROL_reinit_hi 0 99.9984741210938 MAX_REFRESH 6 1 /end CHARACTERISTIC
/begin COMPU_METHOD Compu_CLLP_ROL_reinit_hi " " RAT_FUNC "%.0" "%" COEFFS 0 655.36 0 0 0 1 /end COMPU_METHOD
/begin CHARACTERISTIC CLNG_ROL_reinit_hi "ROL state re-init high value" VALUE 0x00142894 /* @ECU_Address@CLNG_ROL_reinit_hi@0x01012820@ */ ECIPP_ALIGNMENT_UWORD 100 Compu_CLNG_ROL_reinit_hi 0 99.9984741210938 MAX_REFRESH 6 1 /end CHARACTERISTIC
/begin COMPU_METHOD Compu_CLNG_ROL_reinit_hi " " RAT_FUNC "%.0" "%" COEFFS 0 655.36 0 0 0 1 /end COMPU_METHOD
/begin CHARACTERISTIC CL_ROL_reinit_lo "ROL state re-init low value" VALUE 0x001433E6 /* @ECU_Address@CL_ROL_reinit_lo@0x01012828@ */ ECIPP_ALIGNMENT_UWORD 100 Compu_CL_ROL_reinit_lo 0 99.9984741210938 MAX_REFRESH 6 1 /end CHARACTERISTIC
/begin COMPU_METHOD Compu_CL_ROL_reinit_lo " " RAT_FUNC "%.0" "%" COEFFS 0 655.36 0 0 0 1 /end COMPU_METHOD
/begin CHARACTERISTIC CLLP_ROL_reinit_lo "ROL state re-init low value" VALUE 0x0014192E /* @ECU_Address@CLLP_ROL_reinit_lo@0x01012830@ */ ECIPP_ALIGNMENT_UWORD 100 Compu_CLLP_ROL_reinit_lo 0 99.9984741210938 MAX_REFRESH 6 1 /end CHARACTERISTIC
/begin COMPU_METHOD Compu_CLLP_ROL_reinit_lo " " RAT_FUNC "%.0" "%" COEFFS 0 655.36 0 0 0 1 /end COMPU_METHOD
/begin CHARACTERISTIC CLNG_ROL_reinit_lo "ROL state re-init low value" VALUE 0x00142896 /* @ECU_Address@CLNG_ROL_reinit_lo@0x01012838@ */ ECIPP_ALIGNMENT_UWORD 100 Compu_CLNG_ROL_reinit_lo 0 99.9984741210938 MAX_REFRESH 6 1 /end CHARACTERISTIC
/begin COMPU_METHOD Compu_CLNG_ROL_reinit_lo " " RAT_FUNC "%.0" "%" COEFFS 0 655.36 0 0 0 1 /end COMPU_METHOD
/begin CHARACTERISTIC CL_ROL_reinit_ena "Re-initialize on ROL re-entry{CL_ROL_reinit_ena&0xff=0:No}{CL_ROL_reinit_ena&0xff=1:Yes}" VALUE 0x001433E8 /* @ECU_Address@CL_ROL_reinit_ena@0x01012840@ */ ECIPP_ALIGNMENT_UBYTE 255 CL_ROL_reinit_ena_COMPU_VTAB 0 255 MAX_REFRESH 6 1 BIT_MASK 0xff /end CHARACTERISTIC
/begin COMPU_METHOD CL_ROL_reinit_ena_COMPU_VTAB "Verbal Table" TAB_VERB "%.0" "list" COMPU_TAB_REF CL_ROL_reinit_ena_COMPU_VTAB_REF /end COMPU_METHOD
/begin COMPU_VTAB CL_ROL_reinit_ena_COMPU_VTAB_REF "Verbal Table" TAB_VERB 2 0 "No" 1 "Yes" DEFAULT_VALUE "UNKNOWN" /end COMPU_VTAB
/begin CHARACTERISTIC CLLP_ROL_reinit_ena "Re-initialize on ROL re-entry{CLLP_ROL_reinit_ena&0xff=0:No}{CLLP_ROL_reinit_ena&0xff=1:Yes}" VALUE 0x00141930 /* @ECU_Address@CLLP_ROL_reinit_ena@0x01012848@ */ ECIPP_ALIGNMENT_UBYTE 255 CLLP_ROL_reinit_ena_COMPU_VTAB 0 255 MAX_REFRESH 6 1 BIT_MASK 0xff /end CHARACTERISTIC
/begin COMPU_METHOD CLLP_ROL_reinit_ena_COMPU_VTAB "Verbal Table" TAB_VERB "%.0" "list" COMPU_TAB_REF CLLP_ROL_reinit_ena_COMPU_VTAB_REF /end COMPU_METHOD
/begin COMPU_VTAB CLLP_ROL_reinit_ena_COMPU_VTAB_REF "Verbal Table" TAB_VERB 2 0 "No" 1 "Yes" DEFAULT_VALUE "UNKNOWN" /end COMPU_VTAB
/begin CHARACTERISTIC CLNG_ROL_reinit_ena "Re-initialize on ROL re-entry{CLNG_ROL_reinit_ena&0xff=0:No}{CLNG_ROL_reinit_ena&0xff=1:Yes}" VALUE 0x00142898 /* @ECU_Address@CLNG_ROL_reinit_ena@0x01012850@ */ ECIPP_ALIGNMENT_UBYTE 255 CLNG_ROL_reinit_ena_COMPU_VTAB 0 255 MAX_REFRESH 6 1 BIT_MASK 0xff /end CHARACTERISTIC
/begin COMPU_METHOD CLNG_ROL_reinit_ena_COMPU_VTAB "Verbal Table" TAB_VERB "%.0" "list" COMPU_TAB_REF CLNG_ROL_reinit_ena_COMPU_VTAB_REF /end COMPU_METHOD
/begin COMPU_VTAB CLNG_ROL_reinit_ena_COMPU_VTAB_REF "Verbal Table" TAB_VERB 2 0 "No" 1 "Yes" DEFAULT_VALUE "UNKNOWN" /end COMPU_VTAB
/begin CHARACTERISTIC CVCS_discon_RPM_max "FaultConfig # CVCS_discon_RPM_max (Fault Condition:and RPM <)" VALUE 0x0016349c /* @ECU_Address@CVCS_discon_RPM_max@0x01012878@ */ ECIPP_ALIGNMENT_UWORD 65535 Compu_CVCS_discon_RPM_max 0 65535 /end CHARACTERISTIC
/begin COMPU_METHOD Compu_CVCS_discon_RPM_max " " RAT_FUNC "%.0" "rpm" COEFFS 0 1 0 0 0 1 /end COMPU_METHOD
/begin CHARACTERISTIC CVDS_discon_RPM_max "FaultConfig # CVDS_discon_RPM_max (Fault Condition:and RPM <)" VALUE 0x001634a4 /* @ECU_Address@CVDS_discon_RPM_max@0x01012880@ */ ECIPP_ALIGNMENT_UWORD 65535 Compu_CVDS_discon_RPM_max 0 65535 /end CHARACTERISTIC
/begin COMPU_METHOD Compu_CVDS_discon_RPM_max " " RAT_FUNC "%.0" "rpm" COEFFS 0 1 0 0 0 1 /end COMPU_METHOD
/begin CHARACTERISTIC PWMLO_pwr_src "{PWMLO_pwr_src&0xff=0:Key switch powered}{PWMLO_pwr_src&0xff=1:Relay powered} (Fault Condition:Power source)" VALUE 0x00166381 /* @ECU_Address@PWMLO_pwr_src@0x010128D0@ */ ECIPP_ALIGNMENT_UBYTE 255 PWMLO_pwr_src_COMPU_VTAB 0 255 BIT_MASK 0xff /end CHARACTERISTIC
/begin COMPU_METHOD PWMLO_pwr_src_COMPU_VTAB "Verbal Table" TAB_VERB "%.0" "list" COMPU_TAB_REF PWMLO_pwr_src_COMPU_VTAB_REF /end COMPU_METHOD
/begin COMPU_VTAB PWMLO_pwr_src_COMPU_VTAB_REF "Verbal Table" TAB_VERB 2 0 "Key switch powered" 1 "Relay powered" DEFAULT_VALUE "UNKNOWN" /end COMPU_VTAB
/begin CHARACTERISTIC EGT_maxv_MAP "FaultConfig # EGT_maxv_MAP (Fault Condition:and MAP >=)" VALUE 0x00163504 /* @ECU_Address@EGT_maxv_MAP@0x01012968@ */ ECIPP_ALIGNMENT_UWORD 256 Compu_EGT_maxv_MAP 0 255.99609375 /end CHARACTERISTIC
/begin COMPU_METHOD Compu_EGT_maxv_MAP " " RAT_FUNC "%.3" "psia" COEFFS 0 256 0 0 0 1 /end COMPU_METHOD
/begin CHARACTERISTIC EGT_maxv_rpm "FaultConfig # EGT_maxv_rpm (Fault Condition:and RPM >=)" VALUE 0x00163506 /* @ECU_Address@EGT_maxv_rpm@0x01012970@ */ ECIPP_ALIGNMENT_UWORD 65535 Compu_EGT_maxv_rpm 0 65535 /end CHARACTERISTIC
/begin COMPU_METHOD Compu_EGT_maxv_rpm " " RAT_FUNC "%.0" "rpm" COEFFS 0 1 0 0 0 1 /end COMPU_METHOD
/begin CHARACTERISTIC EGT_maxv_wait "FaultConfig # EGT_maxv_wait (Fault Condition:and run time >=)" VALUE 0x00161cd4 /* @ECU_Address@EGT_maxv_wait@0x01012978@ */ ECIPP_ALIGNMENT_ULONG 4294967 Compu_EGT_maxv_wait 0 4294967.295 /end CHARACTERISTIC
/begin COMPU_METHOD Compu_EGT_maxv_wait " " RAT_FUNC "%.3" "seconds" COEFFS 0 1000 0 0 0 1 /end COMPU_METHOD
/begin CHARACTERISTIC EGT_minv_MAP "FaultConfig # EGT_minv_MAP (Fault Condition:and MAP >=)" VALUE 0x0016350a /* @ECU_Address@EGT_minv_MAP@0x01012980@ */ ECIPP_ALIGNMENT_UWORD 256 Compu_EGT_minv_MAP 0 255.99609375 /end CHARACTERISTIC
/begin COMPU_METHOD Compu_EGT_minv_MAP " " RAT_FUNC "%.3" "psia" COEFFS 0 256 0 0 0 1 /end COMPU_METHOD
/begin CHARACTERISTIC EGT_minv_rpm "FaultConfig # EGT_minv_rpm (Fault Condition:and RPM >=)" VALUE 0x0016350c /* @ECU_Address@EGT_minv_rpm@0x01012988@ */ ECIPP_ALIGNMENT_UWORD 65535 Compu_EGT_minv_rpm 0 65535 /end CHARACTERISTIC
/begin COMPU_METHOD Compu_EGT_minv_rpm " " RAT_FUNC "%.0" "rpm" COEFFS 0 1 0 0 0 1 /end COMPU_METHOD
/begin CHARACTERISTIC EGT_minv_wait "FaultConfig # EGT_minv_wait (Fault Condition:and run time >=)" VALUE 0x00161cd8 /* @ECU_Address@EGT_minv_wait@0x01012990@ */ ECIPP_ALIGNMENT_ULONG 4294967 Compu_EGT_minv_wait 0 4294967.295 /end CHARACTERISTIC
/begin COMPU_METHOD Compu_EGT_minv_wait " " RAT_FUNC "%.3" "seconds" COEFFS 0 1000 0 0 0 1 /end COMPU_METHOD
/begin CHARACTERISTIC CATout_OOR_delta "FaultConfig # CATout_OOR_delta (Fault Condition:abs(CBT - CAT outlet) >)" VALUE 0x001466ea /* @ECU_Address@CATout_OOR_delta@0x01012A68@ */ ECIPP_ALIGNMENT_UWORD 8192 Compu_CATout_OOR_delta 0 8191.875 /end CHARACTERISTIC
/begin COMPU_METHOD Compu_CATout_OOR_delta " " RAT_FUNC "%.3" "deg F" COEFFS 0 8 0 0 0 1 /end COMPU_METHOD
/begin CHARACTERISTIC CATout_OOR_CBT "FaultConfig # CATout_OOR_CBT (Fault Condition:and CBT >)" VALUE 0x001466e6 /* @ECU_Address@CATout_OOR_CBT@0x01012A70@ */ ECIPP_ALIGNMENT_UWORD 7732 Compu_CATout_OOR_CBT -460 7731.875 /end CHARACTERISTIC
/begin COMPU_METHOD Compu_CATout_OOR_CBT " " RAT_FUNC "%.3" "deg F" COEFFS 0 8 3680 0 0 1 /end COMPU_METHOD
/begin CHARACTERISTIC CATout_OOR_rpm "FaultConfig # CATout_OOR_rpm (Fault Condition:and RPM >)" VALUE 0x001466ee /* @ECU_Address@CATout_OOR_rpm@0x01012A78@ */ ECIPP_ALIGNMENT_UWORD 65535 Compu_CATout_OOR_rpm 0 65535 /end CHARACTERISTIC
/begin COMPU_METHOD Compu_CATout_OOR_rpm " " RAT_FUNC "%.0" "rpm" COEFFS 0 1 0 0 0 1 /end COMPU_METHOD
/begin CHARACTERISTIC CATout_OOR_MAPload "FaultConfig # CATout_OOR_MAPload (Fault Condition:and MAP load >)" VALUE 0x001466e8 /* @ECU_Address@CATout_OOR_MAPload@0x01012A80@ */ ECIPP_ALIGNMENT_UWORD 256 Compu_CATout_OOR_MAPload 0 255.99609375 /end CHARACTERISTIC
/begin COMPU_METHOD Compu_CATout_OOR_MAPload " " RAT_FUNC "%.3" "psia" COEFFS 0 256 0 0 0 1 /end COMPU_METHOD
/begin CHARACTERISTIC CATout_OOR_wt "FaultConfig # CATout_OOR_wt (Fault Condition:and engine run time >)" VALUE 0x001440a0 /* @ECU_Address@CATout_OOR_wt@0x01012A88@ */ ECIPP_ALIGNMENT_ULONG 4294967 Compu_CATout_OOR_wt 0 4294967.295 /end CHARACTERISTIC
/begin COMPU_METHOD Compu_CATout_OOR_wt " " RAT_FUNC "%.3" "seconds" COEFFS 0 1000 0 0 0 1 /end COMPU_METHOD
/begin CHARACTERISTIC CATout_OOR_latch_wt "FaultConfig # CATout_OOR_latch_wt (Fault Condition:and CBT, RPM, MAP load conditions persist for)" VALUE 0x001466ec /* @ECU_Address@CATout_OOR_latch_wt@0x01012A90@ */ ECIPP_ALIGNMENT_UWORD 66 Compu_CATout_OOR_latch_wt 0 65.535 /end CHARACTERISTIC
/begin COMPU_METHOD Compu_CATout_OOR_latch_wt " " RAT_FUNC "%.3" "seconds" COEFFS 0 1000 0 0 0 1 /end COMPU_METHOD
/begin CHARACTERISTIC CRI_purge_cranktime "{CRI_purge_cranktime&0xff=0x00:Disabled}{CRI_purge_cranktime&0xff=0x01:Enabled}" VALUE 0x00165105 /* @ECU_Address@CRI_purge_cranktime@0x01012A98@ */ ECIPP_ALIGNMENT_UBYTE 255 CRI_purge_cranktime_COMPU_VTAB 0 255 BIT_MASK 0xff /end CHARACTERISTIC
/begin COMPU_METHOD CRI_purge_cranktime_COMPU_VTAB "Verbal Table" TAB_VERB "%.0" "list" COMPU_TAB_REF CRI_purge_cranktime_COMPU_VTAB_REF /end COMPU_METHOD
/begin COMPU_VTAB CRI_purge_cranktime_COMPU_VTAB_REF "Verbal Table" TAB_VERB 2 0x00 "Disabled" 0x01 "Enabled" DEFAULT_VALUE "UNKNOWN" /end COMPU_VTAB
/begin CHARACTERISTIC CRI_purge_T2 "Fuel # CRI_purge_T2" VALUE 0x00165100 /* @ECU_Address@CRI_purge_T2@0x01012AA0@ */ ECIPP_ALIGNMENT_UBYTE 255 Compu_CRI_purge_T2 0 255 /end CHARACTERISTIC
/begin COMPU_METHOD Compu_CRI_purge_T2 " " RAT_FUNC "%.0" "sec" COEFFS 0 1 0 0 0 1 /end COMPU_METHOD
/begin CHARACTERISTIC CRI_purge_T3 "Fuel # CRI_purge_T3" VALUE 0x00165101 /* @ECU_Address@CRI_purge_T3@0x01012AA8@ */ ECIPP_ALIGNMENT_UBYTE 255 Compu_CRI_purge_T3 0 255 /end CHARACTERISTIC
/begin COMPU_METHOD Compu_CRI_purge_T3 " " RAT_FUNC "%.0" "sec" COEFFS 0 1 0 0 0 1 /end COMPU_METHOD
/begin CHARACTERISTIC CRI_purge_T4 "Fuel # CRI_purge_T4" VALUE 0x00165102 /* @ECU_Address@CRI_purge_T4@0x01012AB0@ */ ECIPP_ALIGNMENT_UBYTE 255 Compu_CRI_purge_T4 0 255 /end CHARACTERISTIC
/begin COMPU_METHOD Compu_CRI_purge_T4 " " RAT_FUNC "%.0" "sec" COEFFS 0 1 0 0 0 1 /end COMPU_METHOD
/begin CHARACTERISTIC CRI_purge_T5 "Fuel # CRI_purge_T5" VALUE 0x00165103 /* @ECU_Address@CRI_purge_T5@0x01012AB8@ */ ECIPP_ALIGNMENT_UBYTE 255 Compu_CRI_purge_T5 0 255 /end CHARACTERISTIC
/begin COMPU_METHOD Compu_CRI_purge_T5 " " RAT_FUNC "%.0" "sec" COEFFS 0 1 0 0 0 1 /end COMPU_METHOD
/begin CHARACTERISTIC CRI_purge_T6 "Fuel # CRI_purge_T6" VALUE 0x00165104 /* @ECU_Address@CRI_purge_T6@0x01012AC0@ */ ECIPP_ALIGNMENT_UBYTE 255 Compu_CRI_purge_T6 0 255 /end CHARACTERISTIC
/begin COMPU_METHOD Compu_CRI_purge_T6 " " RAT_FUNC "%.0" "sec" COEFFS 0 1 0 0 0 1 /end COMPU_METHOD
/begin CHARACTERISTIC CRI_purge_rpm_limit "Fuel # CRI_purge_rpm_limit" VALUE 0x0016349a /* @ECU_Address@CRI_purge_rpm_limit@0x01012AC8@ */ ECIPP_ALIGNMENT_UWORD 65535 Compu_CRI_purge_rpm_limit 0 65535 /end CHARACTERISTIC
/begin COMPU_METHOD Compu_CRI_purge_rpm_limit " " RAT_FUNC "%.0" "rpm" COEFFS 0 1 0 0 0 1 /end COMPU_METHOD
/begin CHARACTERISTIC CRI_purge_accel_limit "Fuel # CRI_purge_accel_limit" VALUE 0x00162bbc /* @ECU_Address@CRI_purge_accel_limit@0x01012AD0@ */ ECIPP_ALIGNMENT_SWORD 32767 Compu_CRI_purge_accel_limit -32768 32767 /end CHARACTERISTIC
/begin COMPU_METHOD Compu_CRI_purge_accel_limit " " RAT_FUNC "%.0" "rpm/sec" COEFFS 0 1 0 0 0 1 /end COMPU_METHOD
/begin CHARACTERISTIC CRI_width_Npr "Fuel # CRI_width_Npr" VALUE 0x00161cc8 /* @ECU_Address@CRI_width_Npr@0x01012AD8@ */ ECIPP_ALIGNMENT_ULONG 214748365 Compu_CRI_width_Npr 0 214748364.75 /end CHARACTERISTIC
/begin COMPU_METHOD Compu_CRI_width_Npr " " RAT_FUNC "%.3" "us" COEFFS 0 20 0 0 0 1 /end COMPU_METHOD
/begin CHARACTERISTIC CRI_cad_Npr "Fuel # CRI_cad_Npr" VALUE 0x00162bba /* @ECU_Address@CRI_cad_Npr@0x01012AE0@ */ ECIPP_ALIGNMENT_SWORD 2048 Compu_CRI_cad_Npr -2048 2047.9375 /end CHARACTERISTIC
/begin COMPU_METHOD Compu_CRI_cad_Npr " " RAT_FUNC "%.3" "CAD BTDC" COEFFS 0 16 0 0 0 1 /end COMPU_METHOD
/begin CHARACTERISTIC CRI_width_Gpr "Fuel # CRI_width_Gpr" VALUE 0x00161cc4 /* @ECU_Address@CRI_width_Gpr@0x01012AE8@ */ ECIPP_ALIGNMENT_ULONG 214748365 Compu_CRI_width_Gpr 0 214748364.75 /end CHARACTERISTIC
/begin COMPU_METHOD Compu_CRI_width_Gpr " " RAT_FUNC "%.3" "us" COEFFS 0 20 0 0 0 1 /end COMPU_METHOD
/begin CHARACTERISTIC CRI_cad_Gpr "Fuel # CRI_cad_Gpr" VALUE 0x00162bb8 /* @ECU_Address@CRI_cad_Gpr@0x01012AF0@ */ ECIPP_ALIGNMENT_SWORD 2048 Compu_CRI_cad_Gpr -2048 2047.9375 /end CHARACTERISTIC
/begin COMPU_METHOD Compu_CRI_cad_Gpr " " RAT_FUNC "%.3" "CAD BTDC" COEFFS 0 16 0 0 0 1 /end COMPU_METHOD
/begin CHARACTERISTIC OILP_stopped_wait "FaultConfig # OILP_stopped_wait (Fault Condition:Stopped wait time for oil pressure switch voltage faults)" VALUE 0x0014766a /* @ECU_Address@OILP_stopped_wait@0x01012B50@ */ ECIPP_ALIGNMENT_UWORD 66 Compu_OILP_stopped_wait 0 65.535 /end CHARACTERISTIC
/begin COMPU_METHOD Compu_OILP_stopped_wait " " RAT_FUNC "%.3" "seconds" COEFFS 0 1000 0 0 0 1 /end COMPU_METHOD
/begin CHARACTERISTIC OCT_adapt_fault_mode "{OCT_adapt_fault_mode&0xff=0:Set to 0%}{OCT_adapt_fault_mode&0xff=1:Use last value}" VALUE 0x00166380 /* @ECU_Address@OCT_adapt_fault_mode@0x01012C00@ */ ECIPP_ALIGNMENT_UBYTE 255 OCT_adapt_fault_mode_COMPU_VTAB 0 255 BIT_MASK 0xff /end CHARACTERISTIC
/begin COMPU_METHOD OCT_adapt_fault_mode_COMPU_VTAB "Verbal Table" TAB_VERB "%.0" "list" COMPU_TAB_REF OCT_adapt_fault_mode_COMPU_VTAB_REF /end COMPU_METHOD
/begin COMPU_VTAB OCT_adapt_fault_mode_COMPU_VTAB_REF "Verbal Table" TAB_VERB 2 0 "Set to 0%" 1 "Use last value" DEFAULT_VALUE "UNKNOWN" /end COMPU_VTAB
/begin CHARACTERISTIC EV_RH_rat_mode "{EV_RH_rat_mode&0xff=0:Disabled}{EV_RH_rat_mode&0xff=1:Enabled}" VALUE 0x00165111 /* @ECU_Address@EV_RH_rat_mode@0x01012D60@ */ ECIPP_ALIGNMENT_UBYTE 255 EV_RH_rat_mode_COMPU_VTAB 0 255 BIT_MASK 0xff /end CHARACTERISTIC
/begin COMPU_METHOD EV_RH_rat_mode_COMPU_VTAB "Verbal Table" TAB_VERB "%.0" "list" COMPU_TAB_REF EV_RH_rat_mode_COMPU_VTAB_REF /end COMPU_METHOD
/begin COMPU_VTAB EV_RH_rat_mode_COMPU_VTAB_REF "Verbal Table" TAB_VERB 2 0 "Disabled" 1 "Enabled" DEFAULT_VALUE "UNKNOWN" /end COMPU_VTAB
/begin CHARACTERISTIC EV_RH_uns_latch_tm "FaultConfig # EV_RH_uns_latch_tm" VALUE 0x0016350e /* @ECU_Address@EV_RH_uns_latch_tm@0x01012D70@ */ ECIPP_ALIGNMENT_UWORD 66 Compu_EV_RH_uns_latch_tm 0 65.535 /end CHARACTERISTIC
/begin COMPU_METHOD Compu_EV_RH_uns_latch_tm " " RAT_FUNC "%.3" "seconds" COEFFS 0 1000 0 0 0 1 /end COMPU_METHOD
/begin CHARACTERISTIC EV_RH_uns_unlatch_tm "FaultConfig # EV_RH_uns_unlatch_tm" VALUE 0x00163510 /* @ECU_Address@EV_RH_uns_unlatch_tm@0x01012D78@ */ ECIPP_ALIGNMENT_UWORD 66 Compu_EV_RH_uns_unlatch_tm 0 65.535 /end CHARACTERISTIC
/begin COMPU_METHOD Compu_EV_RH_uns_unlatch_tm " " RAT_FUNC "%.3" "seconds" COEFFS 0 1000 0 0 0 1 /end COMPU_METHOD
/begin CHARACTERISTIC FIMP_fault_def "Fuel # FIMP_fault_def" VALUE 0x00162bd8 /* @ECU_Address@FIMP_fault_def@0x01012EA0@ */ ECIPP_ALIGNMENT_SWORD 200 Compu_FIMP_fault_def -200 199.993896484375 /end CHARACTERISTIC
/begin COMPU_METHOD Compu_FIMP_fault_def " " RAT_FUNC "%.3" "%" COEFFS 0 163.84 0 0 0 1 /end COMPU_METHOD
/begin CHARACTERISTIC INDUCEblk_on "FaultConfig # INDUCEblk_on" VALUE 0x00147dcc /* @ECU_Address@INDUCEblk_on@0x01012EA8@ */ ECIPP_ALIGNMENT_UBYTE 12750 Compu_INDUCEblk_on 0 12750 /end CHARACTERISTIC
/begin COMPU_METHOD Compu_INDUCEblk_on " " RAT_FUNC "%.3" "On-Time (ms)" COEFFS 0 0.02 0 0 0 1 /end COMPU_METHOD
/begin CHARACTERISTIC INDUCEblk_off "FaultConfig # INDUCEblk_off" VALUE 0x00147dcb /* @ECU_Address@INDUCEblk_off@0x01012EB0@ */ ECIPP_ALIGNMENT_UBYTE 12750 Compu_INDUCEblk_off 0 12750 /end CHARACTERISTIC
/begin COMPU_METHOD Compu_INDUCEblk_off " " RAT_FUNC "%.3" "Off-Time (ms)" COEFFS 0 0.02 0 0 0 1 /end COMPU_METHOD
/begin CHARACTERISTIC INDUCE_bulbchk "FaultConfig # INDUCE_bulbchk" VALUE 0x001474ba /* @ECU_Address@INDUCE_bulbchk@0x01012EB8@ */ ECIPP_ALIGNMENT_UWORD 65535 Compu_INDUCE_bulbchk 0 65535 /end CHARACTERISTIC
/begin COMPU_METHOD Compu_INDUCE_bulbchk " " RAT_FUNC "%.0" "Time (ms)" COEFFS 0 1 0 0 0 1 /end COMPU_METHOD
/begin CHARACTERISTIC INDUCE_bulbon "{INDUCE_bulbon&0xff=0:Blink}{INDUCE_bulbon&0xff=1:On}" VALUE 0x00147dc9 /* @ECU_Address@INDUCE_bulbon@0x01012EC0@ */ ECIPP_ALIGNMENT_UBYTE 255 INDUCE_bulbon_COMPU_VTAB 0 255 BIT_MASK 0xff /end CHARACTERISTIC
/begin COMPU_METHOD INDUCE_bulbon_COMPU_VTAB "Verbal Table" TAB_VERB "%.0" "list" COMPU_TAB_REF INDUCE_bulbon_COMPU_VTAB_REF /end COMPU_METHOD
/begin COMPU_VTAB INDUCE_bulbon_COMPU_VTAB_REF "Verbal Table" TAB_VERB 2 0 "Blink" 1 "On" DEFAULT_VALUE "UNKNOWN" /end COMPU_VTAB
/begin CHARACTERISTIC EGR_stuckvlv_dc_min "Air # EGR_stuckvlv_dc_min" VALUE 0x00162bc8 /* @ECU_Address@EGR_stuckvlv_dc_min@0x01012ED0@ */ ECIPP_ALIGNMENT_SWORD 100 Compu_EGR_stuckvlv_dc_min -100 99.9969482421875 /end CHARACTERISTIC
/begin COMPU_METHOD Compu_EGR_stuckvlv_dc_min " " RAT_FUNC "%.3" "%" COEFFS 0 327.68 0 0 0 1 /end COMPU_METHOD
/begin CHARACTERISTIC EGR_stuckvlv_dc_max "Air # EGR_stuckvlv_dc_max" VALUE 0x00162bc6 /* @ECU_Address@EGR_stuckvlv_dc_max@0x01012ED8@ */ ECIPP_ALIGNMENT_SWORD 100 Compu_EGR_stuckvlv_dc_max -100 99.9969482421875 /end CHARACTERISTIC
/begin COMPU_METHOD Compu_EGR_stuckvlv_dc_max " " RAT_FUNC "%.3" "%" COEFFS 0 327.68 0 0 0 1 /end COMPU_METHOD
/begin CHARACTERISTIC EGR_stuckvlv_dc_tau "Air # EGR_stuckvlv_dc_tau" VALUE 0x001650f6 /* @ECU_Address@EGR_stuckvlv_dc_tau@0x01012EE0@ */ ECIPP_ALIGNMENT_UWORD 163840 Compu_EGR_stuckvlv_dc_tau 0.16703 163840 /end CHARACTERISTIC
/begin COMPU_METHOD Compu_EGR_stuckvlv_dc_tau " " FORM "%.3" "ms"
 /begin FORMULA "-5 / log(1.0000000000001 - (X1 / 32768))" FORMULA_INV "(1.0000000000001 - exp(-5/X1)) * 32768" /end FORMULA
/end COMPU_METHOD
/begin CHARACTERISTIC EGR_stuckvlv_DChi_tm "Air # EGR_stuckvlv_DChi_tm" VALUE 0x001634f4 /* @ECU_Address@EGR_stuckvlv_DChi_tm@0x01012EE8@ */ ECIPP_ALIGNMENT_UWORD 65535 Compu_EGR_stuckvlv_DChi_tm 0 65535 /end CHARACTERISTIC
/begin COMPU_METHOD Compu_EGR_stuckvlv_DChi_tm " " RAT_FUNC "%.0" "ms" COEFFS 0 1 0 0 0 1 /end COMPU_METHOD
/begin CHARACTERISTIC EGR_stuckvlv_rest_tm "Air # EGR_stuckvlv_rest_tm" VALUE 0x001634fc /* @ECU_Address@EGR_stuckvlv_rest_tm@0x01012EF0@ */ ECIPP_ALIGNMENT_UWORD 65535 Compu_EGR_stuckvlv_rest_tm 0 65535 /end CHARACTERISTIC
/begin COMPU_METHOD Compu_EGR_stuckvlv_rest_tm " " RAT_FUNC "%.0" "ms" COEFFS 0 1 0 0 0 1 /end COMPU_METHOD
/begin CHARACTERISTIC EGR_stuckvlv_movepct "Air # EGR_stuckvlv_movepct" VALUE 0x001634f8 /* @ECU_Address@EGR_stuckvlv_movepct@0x01012EF8@ */ ECIPP_ALIGNMENT_UWORD 100 Compu_EGR_stuckvlv_movepct 0 99.9984741210938 /end CHARACTERISTIC
/begin COMPU_METHOD Compu_EGR_stuckvlv_movepct " " RAT_FUNC "%.3" "%" COEFFS 0 655.36 0 0 0 1 /end COMPU_METHOD
/begin CHARACTERISTIC EGR_stuckvlv_move_tm "Air # EGR_stuckvlv_move_tm" VALUE 0x001634f6 /* @ECU_Address@EGR_stuckvlv_move_tm@0x01012F00@ */ ECIPP_ALIGNMENT_UWORD 65535 Compu_EGR_stuckvlv_move_tm 0 65535 /end CHARACTERISTIC
/begin COMPU_METHOD Compu_EGR_stuckvlv_move_tm " " RAT_FUNC "%.0" "ms" COEFFS 0 1 0 0 0 1 /end COMPU_METHOD
/begin CHARACTERISTIC EGR_stuckvlv_nearpct "Air # EGR_stuckvlv_nearpct" VALUE 0x001634fa /* @ECU_Address@EGR_stuckvlv_nearpct@0x01012F08@ */ ECIPP_ALIGNMENT_UWORD 100 Compu_EGR_stuckvlv_nearpct 0 99.9984741210938 /end CHARACTERISTIC
/begin COMPU_METHOD Compu_EGR_stuckvlv_nearpct " " RAT_FUNC "%.3" "%" COEFFS 0 655.36 0 0 0 1 /end COMPU_METHOD
/begin CHARACTERISTIC EGR_stuckvlv_cnt_max "Air # EGR_stuckvlv_cnt_max" VALUE 0x0016510a /* @ECU_Address@EGR_stuckvlv_cnt_max@0x01012F10@ */ ECIPP_ALIGNMENT_UBYTE 255 Compu_EGR_stuckvlv_cnt_max 0 255 /end CHARACTERISTIC
/begin COMPU_METHOD Compu_EGR_stuckvlv_cnt_max " " RAT_FUNC "%.0" "attempts" COEFFS 0 1 0 0 0 1 /end COMPU_METHOD
/begin CHARACTERISTIC LOD_FRO_vehspd_max "FaultConfig # LOD_FRO_vehspd_max (Fault Condition:and vehicle speed <)" VALUE 0x00164f24 /* @ECU_Address@LOD_FRO_vehspd_max@0x01012F48@ */ ECIPP_ALIGNMENT_UWORD 256 Compu_LOD_FRO_vehspd_max 0 255.99609375 /end CHARACTERISTIC
/begin COMPU_METHOD Compu_LOD_FRO_vehspd_max " " RAT_FUNC "%.3" "kph" COEFFS 0 256 0 0 0 1 /end COMPU_METHOD
/begin CHARACTERISTIC fm_gd_oper_AAT_max "FaultConfig # fm_gd_oper_AAT_max" VALUE 0x001650e8 /* @ECU_Address@fm_gd_oper_AAT_max@0x01012FE8@ */ ECIPP_ALIGNMENT_UWORD 564 Compu_fm_gd_oper_AAT_max -460 563.984375 /end CHARACTERISTIC
/begin COMPU_METHOD Compu_fm_gd_oper_AAT_max " " RAT_FUNC "%.3" "deg F" COEFFS 0 64 29440 0 0 1 /end COMPU_METHOD
/begin CHARACTERISTIC BstTIP_Lo_RPM_max "FaultConfig # BstTIP_Lo_RPM_max (Fault Condition:and RPM <)" VALUE 0x001466ce /* @ECU_Address@BstTIP_Lo_RPM_max@0x01012FF0@ */ ECIPP_ALIGNMENT_UWORD 65535 Compu_BstTIP_Lo_RPM_max 0 65535 /end CHARACTERISTIC
/begin COMPU_METHOD Compu_BstTIP_Lo_RPM_max " " RAT_FUNC "%.0" "rpm" COEFFS 0 1 0 0 0 1 /end COMPU_METHOD
/begin CHARACTERISTIC BstTIP_Lo2_RPM_max "FaultConfig # BstTIP_Lo2_RPM_max (Fault Condition:and RPM <)" VALUE 0x001466c6 /* @ECU_Address@BstTIP_Lo2_RPM_max@0x01012FF8@ */ ECIPP_ALIGNMENT_UWORD 65535 Compu_BstTIP_Lo2_RPM_max 0 65535 /end CHARACTERISTIC
/begin COMPU_METHOD Compu_BstTIP_Lo2_RPM_max " " RAT_FUNC "%.0" "rpm" COEFFS 0 1 0 0 0 1 /end COMPU_METHOD
/begin CHARACTERISTIC BstTIP_Lo_speed_exec "{BstTIP_Lo_speed_exec&0xff=0:No}{BstTIP_Lo_speed_exec&0xff=1:Yes} (Fault Condition:full authority discrete speed governing is active)" VALUE 0x00147ce4 /* @ECU_Address@BstTIP_Lo_speed_exec@0x01013000@ */ ECIPP_ALIGNMENT_UBYTE 255 BstTIP_Lo_speed_exec_COMPU_VTAB 0 255 BIT_MASK 0xff /end CHARACTERISTIC
/begin COMPU_METHOD BstTIP_Lo_speed_exec_COMPU_VTAB "Verbal Table" TAB_VERB "%.0" "list" COMPU_TAB_REF BstTIP_Lo_speed_exec_COMPU_VTAB_REF /end COMPU_METHOD
/begin COMPU_VTAB BstTIP_Lo_speed_exec_COMPU_VTAB_REF "Verbal Table" TAB_VERB 2 0 "No" 1 "Yes" DEFAULT_VALUE "UNKNOWN" /end COMPU_VTAB
/begin CHARACTERISTIC LOD_flk_abort_Vbat "FaultConfig # LOD_flk_abort_Vbat (Fault Condition:Battery voltage drop >)" VALUE 0x0014756a /* @ECU_Address@LOD_flk_abort_Vbat@0x01013008@ */ ECIPP_ALIGNMENT_UWORD 256 Compu_LOD_flk_abort_Vbat 0 255.99609375 /end CHARACTERISTIC
/begin COMPU_METHOD Compu_LOD_flk_abort_Vbat " " RAT_FUNC "%.3" "volts" COEFFS 0 256 0 0 0 1 /end COMPU_METHOD
/begin CHARACTERISTIC LOD_flk_abort_Vbatdt "FaultConfig # LOD_flk_abort_Vbatdt (Fault Condition:and dVbat/dt >)" VALUE 0x0014433c /* @ECU_Address@LOD_flk_abort_Vbatdt@0x01013010@ */ ECIPP_ALIGNMENT_SWORD 1024 Compu_LOD_flk_abort_Vbatdt -1024 1023.96875 /end CHARACTERISTIC
/begin COMPU_METHOD Compu_LOD_flk_abort_Vbatdt " " RAT_FUNC "%.3" "volts/sec" COEFFS 0 32 0 0 0 1 /end COMPU_METHOD
/begin CHARACTERISTIC FPD_off_loVf "FaultConfig # FPD_off_loVf (Fault Condition:PWM low-side feedback <)" VALUE 0x0016495e /* @ECU_Address@FPD_off_loVf@0x010130A0@ */ ECIPP_ALIGNMENT_UWORD 100 Compu_FPD_off_loVf 0 99.9984741210938 /end CHARACTERISTIC
/begin COMPU_METHOD Compu_FPD_off_loVf " " RAT_FUNC "%.3" "% Vbat" COEFFS 0 655.36 0 0 0 1 /end COMPU_METHOD
/begin CHARACTERISTIC FPD_on_hiVf "FaultConfig # FPD_on_hiVf (Fault Condition:PWM low-side feedback >)" VALUE 0x00164962 /* @ECU_Address@FPD_on_hiVf@0x010130A8@ */ ECIPP_ALIGNMENT_UWORD 100 Compu_FPD_on_hiVf 0 99.9984741210938 /end CHARACTERISTIC
/begin COMPU_METHOD Compu_FPD_on_hiVf " " RAT_FUNC "%.3" "% Vbat" COEFFS 0 655.36 0 0 0 1 /end COMPU_METHOD
/begin CHARACTERISTIC FPD_off_loDC "FaultConfig # FPD_off_loDC (Fault Condition:and PWM duty-cycle <)" VALUE 0x0016495c /* @ECU_Address@FPD_off_loDC@0x010130B0@ */ ECIPP_ALIGNMENT_UWORD 100 Compu_FPD_off_loDC 0 99.9984741210938 /end CHARACTERISTIC
/begin COMPU_METHOD Compu_FPD_off_loDC " " RAT_FUNC "%.3" "%" COEFFS 0 655.36 0 0 0 1 /end COMPU_METHOD
/begin CHARACTERISTIC FPD_on_hiDC "FaultConfig # FPD_on_hiDC (Fault Condition:and PWM duty-cycle >)" VALUE 0x00164960 /* @ECU_Address@FPD_on_hiDC@0x010130B8@ */ ECIPP_ALIGNMENT_UWORD 100 Compu_FPD_on_hiDC 0 99.9984741210938 /end CHARACTERISTIC
/begin COMPU_METHOD Compu_FPD_on_hiDC " " RAT_FUNC "%.3" "%" COEFFS 0 655.36 0 0 0 1 /end COMPU_METHOD
/begin CHARACTERISTIC HEX_CCP_svc_key "IOConfig # HEX_CCP_svc_key" VALUE 0x001440e4 /* @ECU_Address@HEX_CCP_svc_key@0x010132B8@ */ ECIPP_ALIGNMENT_ULONG 4294967295 Compu_HEX_CCP_svc_key 0 4294967295 /end CHARACTERISTIC
/begin COMPU_METHOD Compu_HEX_CCP_svc_key " " RAT_FUNC "%.0" "-" COEFFS 0 1 0 0 0 1 /end COMPU_METHOD
/begin CHARACTERISTIC HEX_CCP_oem_key "IOConfig # HEX_CCP_oem_key" VALUE 0x001440e0 /* @ECU_Address@HEX_CCP_oem_key@0x010132C0@ */ ECIPP_ALIGNMENT_ULONG 4294967295 Compu_HEX_CCP_oem_key 0 4294967295 /end CHARACTERISTIC
/begin COMPU_METHOD Compu_HEX_CCP_oem_key " " RAT_FUNC "%.0" "-" COEFFS 0 1 0 0 0 1 /end COMPU_METHOD
/begin CHARACTERISTIC HEX_UDS_svc_key "IOConfig # HEX_UDS_svc_key" VALUE 0x001440ec /* @ECU_Address@HEX_UDS_svc_key@0x010132C8@ */ ECIPP_ALIGNMENT_ULONG 4294967295 Compu_HEX_UDS_svc_key 0 4294967295 /end CHARACTERISTIC
/begin COMPU_METHOD Compu_HEX_UDS_svc_key " " RAT_FUNC "%.0" "-" COEFFS 0 1 0 0 0 1 /end COMPU_METHOD
/begin CHARACTERISTIC HEX_UDS_oem_key "IOConfig # HEX_UDS_oem_key" VALUE 0x001440e8 /* @ECU_Address@HEX_UDS_oem_key@0x010132D0@ */ ECIPP_ALIGNMENT_ULONG 4294967295 Compu_HEX_UDS_oem_key 0 4294967295 /end CHARACTERISTIC
/begin COMPU_METHOD Compu_HEX_UDS_oem_key " " RAT_FUNC "%.0" "-" COEFFS 0 1 0 0 0 1 /end COMPU_METHOD
/begin CHARACTERISTIC FPUMP_off_loVf "FaultConfig # FPUMP_off_loVf (Fault Condition:OR low-side driver off-state feedback <)" VALUE 0x001468ca /* @ECU_Address@FPUMP_off_loVf@0x010132F0@ */ ECIPP_ALIGNMENT_UWORD 100 Compu_FPUMP_off_loVf 0 99.9984741210938 /end CHARACTERISTIC
/begin COMPU_METHOD Compu_FPUMP_off_loVf " " RAT_FUNC "%.3" "% Vbat" COEFFS 0 655.36 0 0 0 1 /end COMPU_METHOD
/begin CHARACTERISTIC FPUMP_off_hiVf "FaultConfig # FPUMP_off_hiVf (Fault Condition:OR high-side driver off-state feedback >)" VALUE 0x001468c6 /* @ECU_Address@FPUMP_off_hiVf@0x010132F8@ */ ECIPP_ALIGNMENT_UWORD 100 Compu_FPUMP_off_hiVf 0 99.9984741210938 /end CHARACTERISTIC
/begin COMPU_METHOD Compu_FPUMP_off_hiVf " " RAT_FUNC "%.3" "% Vbat" COEFFS 0 655.36 0 0 0 1 /end COMPU_METHOD
/begin CHARACTERISTIC FTgasf_minECT "Fuel # FTgasf_minECT (Fault Condition:and ECT >=)" VALUE 0x00147410 /* @ECU_Address@FTgasf_minECT@0x01013300@ */ ECIPP_ALIGNMENT_UWORD 564 Compu_FTgasf_minECT -460 563.984375 /end CHARACTERISTIC
/begin COMPU_METHOD Compu_FTgasf_minECT " " RAT_FUNC "%.3" "deg F" COEFFS 0 64 29440 0 0 1 /end COMPU_METHOD
/begin CHARACTERISTIC MILblk_code_strt_max "General # MILblk_code_strt_max" VALUE 0x00166372 /* @ECU_Address@MILblk_code_strt_max@0x01013478@ */ ECIPP_ALIGNMENT_UBYTE 255 Compu_MILblk_code_strt_max 0 255 /end CHARACTERISTIC
/begin COMPU_METHOD Compu_MILblk_code_strt_max " " RAT_FUNC "%.0" "cycles" COEFFS 0 1 0 0 0 1 /end COMPU_METHOD
/begin CHARACTERISTIC MFG_RLV_FRO_RS_ena "{MFG_RLV_FRO_RS_ena&0xff=0:Disabled}{MFG_RLV_FRO_RS_ena&0xff=1:Enabled} (Fault Condition:'Fuel run-out longer than expected' road speed conditions)" VALUE 0x00147e66 /* @ECU_Address@MFG_RLV_FRO_RS_ena@0x010134B0@ */ ECIPP_ALIGNMENT_UBYTE 255 MFG_RLV_FRO_RS_ena_COMPU_VTAB 0 255 BIT_MASK 0xff /end CHARACTERISTIC
/begin COMPU_METHOD MFG_RLV_FRO_RS_ena_COMPU_VTAB "Verbal Table" TAB_VERB "%.0" "list" COMPU_TAB_REF MFG_RLV_FRO_RS_ena_COMPU_VTAB_REF /end COMPU_METHOD
/begin COMPU_VTAB MFG_RLV_FRO_RS_ena_COMPU_VTAB_REF "Verbal Table" TAB_VERB 2 0 "Disabled" 1 "Enabled" DEFAULT_VALUE "UNKNOWN" /end COMPU_VTAB
/begin CHARACTERISTIC MFG_RLV_FROWARNforce "{MFG_RLV_FROWARNforce&0xff=0:Disabled}{MFG_RLV_FROWARNforce&0xff=1:Soft Warning}{MFG_RLV_FROWARNforce&0xff=2:Hard Warning} (Fault Condition:Historic fault forced indication)" VALUE 0x00147e65 /* @ECU_Address@MFG_RLV_FROWARNforce@0x010134B8@ */ ECIPP_ALIGNMENT_UBYTE 255 MFG_RLV_FROWARNforce_COMPU_VTAB 0 255 BIT_MASK 0xff /end CHARACTERISTIC
/begin COMPU_METHOD MFG_RLV_FROWARNforce_COMPU_VTAB "Verbal Table" TAB_VERB "%.0" "list" COMPU_TAB_REF MFG_RLV_FROWARNforce_COMPU_VTAB_REF /end COMPU_METHOD
/begin COMPU_VTAB MFG_RLV_FROWARNforce_COMPU_VTAB_REF "Verbal Table" TAB_VERB 3 0 "Disabled" 1 "Soft Warning" 2 "Hard Warning" DEFAULT_VALUE "UNKNOWN" /end COMPU_VTAB
/begin CHARACTERISTIC TRAT_engstop_tm "FaultConfig # TRAT_engstop_tm" VALUE 0x00169605 /* @ECU_Address@TRAT_engstop_tm@0x010134D8@ */ ECIPP_ALIGNMENT_UBYTE 1 Compu_TRAT_engstop_tm 0 0.99609375 /end CHARACTERISTIC
/begin COMPU_METHOD Compu_TRAT_engstop_tm " " RAT_FUNC "%.3" "hours" COEFFS 0 256 0 0 0 1 /end COMPU_METHOD
/begin CHARACTERISTIC TRAT_samp_tm "FaultConfig # TRAT_samp_tm" VALUE 0x00165066 /* @ECU_Address@TRAT_samp_tm@0x010134F0@ */ ECIPP_ALIGNMENT_UWORD 66 Compu_TRAT_samp_tm 0 65.535 /end CHARACTERISTIC
/begin COMPU_METHOD Compu_TRAT_samp_tm " " RAT_FUNC "%.3" "sec" COEFFS 0 1000 0 0 0 1 /end COMPU_METHOD
/begin CHARACTERISTIC TRAT_ana_samp_cnt "FaultConfig # TRAT_ana_samp_cnt" VALUE 0x00169604 /* @ECU_Address@TRAT_ana_samp_cnt@0x010134F8@ */ ECIPP_ALIGNMENT_UBYTE 255 Compu_TRAT_ana_samp_cnt 0 255 /end CHARACTERISTIC
/begin COMPU_METHOD Compu_TRAT_ana_samp_cnt " " RAT_FUNC "%.0" "samples" COEFFS 0 1 0 0 0 1 /end COMPU_METHOD
/begin CHARACTERISTIC TRAT_crank_total_lim "FaultConfig # TRAT_crank_total_lim" VALUE 0x00165064 /* @ECU_Address@TRAT_crank_total_lim@0x01013500@ */ ECIPP_ALIGNMENT_UWORD 66 Compu_TRAT_crank_total_lim 0 65.535 /end CHARACTERISTIC
/begin COMPU_METHOD Compu_TRAT_crank_total_lim " " RAT_FUNC "%.3" "sec" COEFFS 0 1000 0 0 0 1 /end COMPU_METHOD
/begin CHARACTERISTIC TRAT_IAT_dT_max "FaultConfig # TRAT_IAT_dT_max (Fault Condition:abs(ECT - IAT) >)" VALUE 0x00165068 /* @ECU_Address@TRAT_IAT_dT_max@0x01013518@ */ ECIPP_ALIGNMENT_UWORD 1024 Compu_TRAT_IAT_dT_max 0 1023.984375 /end CHARACTERISTIC
/begin COMPU_METHOD Compu_TRAT_IAT_dT_max " " RAT_FUNC "%.3" "deg F" COEFFS 0 64 0 0 0 1 /end COMPU_METHOD
/begin CHARACTERISTIC TRAT_AAT_dT_max "FaultConfig # TRAT_AAT_dT_max (Fault Condition:abs(ECT - AAT) >)" VALUE 0x0016506A /* @ECU_Address@TRAT_AAT_dT_max@0x01013530@ */ ECIPP_ALIGNMENT_UWORD 1024 Compu_TRAT_AAT_dT_max 0 1023.984375 /end CHARACTERISTIC
/begin COMPU_METHOD Compu_TRAT_AAT_dT_max " " RAT_FUNC "%.3" "deg F" COEFFS 0 64 0 0 0 1 /end COMPU_METHOD
/begin CHARACTERISTIC TRAT_EGRT_dT_max "FaultConfig # TRAT_EGRT_dT_max (Fault Condition:abs(ECT - EGRT) >)" VALUE 0x0016506C /* @ECU_Address@TRAT_EGRT_dT_max@0x01013548@ */ ECIPP_ALIGNMENT_UWORD 1024 Compu_TRAT_EGRT_dT_max 0 1023.984375 /end CHARACTERISTIC
/begin COMPU_METHOD Compu_TRAT_EGRT_dT_max " " RAT_FUNC "%.3" "deg F" COEFFS 0 64 0 0 0 1 /end COMPU_METHOD
/begin CHARACTERISTIC TRAT_FT_dT_max "FaultConfig # TRAT_FT_dT_max (Fault Condition:abs(ECT - FT) >)" VALUE 0x0016506E /* @ECU_Address@TRAT_FT_dT_max@0x01013560@ */ ECIPP_ALIGNMENT_UWORD 1024 Compu_TRAT_FT_dT_max 0 1023.984375 /end CHARACTERISTIC
/begin COMPU_METHOD Compu_TRAT_FT_dT_max " " RAT_FUNC "%.3" "deg F" COEFFS 0 64 0 0 0 1 /end COMPU_METHOD
/begin CHARACTERISTIC TRAT_OILT_dT_max "FaultConfig # TRAT_OILT_dT_max (Fault Condition:abs(ECT - OILT) >)" VALUE 0x00165070 /* @ECU_Address@TRAT_OILT_dT_max@0x01013578@ */ ECIPP_ALIGNMENT_UWORD 1024 Compu_TRAT_OILT_dT_max 0 1023.984375 /end CHARACTERISTIC
/begin COMPU_METHOD Compu_TRAT_OILT_dT_max " " RAT_FUNC "%.3" "deg F" COEFFS 0 64 0 0 0 1 /end COMPU_METHOD
/begin CHARACTERISTIC TRAT_EGT_dT_max "FaultConfig # TRAT_EGT_dT_max (Fault Condition:abs(ECT - EGT) >)" VALUE 0x00165072 /* @ECU_Address@TRAT_EGT_dT_max@0x01013590@ */ ECIPP_ALIGNMENT_UWORD 1024 Compu_TRAT_EGT_dT_max 0 1023.984375 /end CHARACTERISTIC
/begin COMPU_METHOD Compu_TRAT_EGT_dT_max " " RAT_FUNC "%.3" "deg F" COEFFS 0 64 0 0 0 1 /end COMPU_METHOD
/begin CHARACTERISTIC TRAT_TIAT_dT_max "FaultConfig # TRAT_TIAT_dT_max (Fault Condition:abs(ECT - TIAT) >)" VALUE 0x00165074 /* @ECU_Address@TRAT_TIAT_dT_max@0x010135A8@ */ ECIPP_ALIGNMENT_UWORD 1024 Compu_TRAT_TIAT_dT_max 0 1023.984375 /end CHARACTERISTIC
/begin COMPU_METHOD Compu_TRAT_TIAT_dT_max " " RAT_FUNC "%.3" "deg F" COEFFS 0 64 0 0 0 1 /end COMPU_METHOD
/begin CHARACTERISTIC TRAT_TAUX_n1_dT_max "FaultConfig # TRAT_TAUX_n1_dT_max (Fault Condition:abs(ECT - AUX Temperature X) >)" VALUE 0x00165076 /* @ECU_Address@TRAT_TAUX_n1_dT_max@0x010135C0@ */ ECIPP_ALIGNMENT_UWORD 1024 Compu_TRAT_TAUX_n1_dT_max 0 1023.984375 /end CHARACTERISTIC
/begin COMPU_METHOD Compu_TRAT_TAUX_n1_dT_max " " RAT_FUNC "%.3" "deg F" COEFFS 0 64 0 0 0 1 /end COMPU_METHOD
/begin CHARACTERISTIC TRAT_TAUX_n2_dT_max "FaultConfig # TRAT_TAUX_n2_dT_max (Fault Condition:abs(ECT - AUX Temperature X) >)" VALUE 0x00165078 /* @ECU_Address@TRAT_TAUX_n2_dT_max@0x010135E0@ */ ECIPP_ALIGNMENT_UWORD 1024 Compu_TRAT_TAUX_n2_dT_max 0 1023.984375 /end CHARACTERISTIC
/begin COMPU_METHOD Compu_TRAT_TAUX_n2_dT_max " " RAT_FUNC "%.3" "deg F" COEFFS 0 64 0 0 0 1 /end COMPU_METHOD
/begin CHARACTERISTIC TRAT_AAT_min "FaultConfig # TRAT_AAT_min" VALUE 0x00165062 /* @ECU_Address@TRAT_AAT_min@0x01013610@ */ ECIPP_ALIGNMENT_UWORD 564 Compu_TRAT_AAT_min -460 563.984375 /end CHARACTERISTIC
/begin COMPU_METHOD Compu_TRAT_AAT_min " " RAT_FUNC "%.3" "deg F" COEFFS 0 64 29440 0 0 1 /end COMPU_METHOD
/begin CHARACTERISTIC ERCV_diag_run_wait "FaultConfig # ERCV_diag_run_wait (Fault Condition:Time in “Run” state >)" VALUE 0x0016510f /* @ECU_Address@ERCV_diag_run_wait@0x01013658@ */ ECIPP_ALIGNMENT_UBYTE 255 Compu_ERCV_diag_run_wait 0 255 /end CHARACTERISTIC
/begin COMPU_METHOD Compu_ERCV_diag_run_wait " " RAT_FUNC "%.0" "sec" COEFFS 0 1 0 0 0 1 /end COMPU_METHOD
/begin CHARACTERISTIC ERCV_diag_stop_wait "FaultConfig # ERCV_diag_stop_wait (Fault Condition:OR engine stopped time >)" VALUE 0x00165110 /* @ECU_Address@ERCV_diag_stop_wait@0x01013660@ */ ECIPP_ALIGNMENT_UBYTE 255 Compu_ERCV_diag_stop_wait 0 255 /end CHARACTERISTIC
/begin COMPU_METHOD Compu_ERCV_diag_stop_wait " " RAT_FUNC "%.0" "sec" COEFFS 0 1 0 0 0 1 /end COMPU_METHOD
/begin CHARACTERISTIC ERCV_speed_freq_min "FaultConfig # ERCV_speed_freq_min (Fault Condition:and frequency is not >=)" VALUE 0x00160014 /* @ECU_Address@ERCV_speed_freq_min@0x01013668@ */ ECIPP_ALIGNMENT_FLOAT32_IEEE 10000000000 Compu_ERCV_speed_freq_min -10000000000 10000000000 /end CHARACTERISTIC
/begin COMPU_METHOD Compu_ERCV_speed_freq_min " " RAT_FUNC "%.3" "Hz" COEFFS 0 1 0 0 0 1 /end COMPU_METHOD
/begin CHARACTERISTIC ERCV_speed_freq_max "FaultConfig # ERCV_speed_freq_max (Fault Condition:and frequency is not <=)" VALUE 0x00160010 /* @ECU_Address@ERCV_speed_freq_max@0x01013670@ */ ECIPP_ALIGNMENT_FLOAT32_IEEE 10000000000 Compu_ERCV_speed_freq_max -10000000000 10000000000 /end CHARACTERISTIC
/begin COMPU_METHOD Compu_ERCV_speed_freq_max " " RAT_FUNC "%.3" "Hz" COEFFS 0 1 0 0 0 1 /end COMPU_METHOD
/begin CHARACTERISTIC tech_LLgear_write_en "{tech_LLgear_write_en&0xff=0:Not allowed}{tech_LLgear_write_en&0xff=1:Allowed}" VALUE 0x0016c332 /* @ECU_Address@tech_LLgear_write_en@0x01013678@ */ ECIPP_ALIGNMENT_UBYTE 255 tech_LLgear_write_en_COMPU_VTAB 0 255 BIT_MASK 0xff /end CHARACTERISTIC
/begin COMPU_METHOD tech_LLgear_write_en_COMPU_VTAB "Verbal Table" TAB_VERB "%.0" "list" COMPU_TAB_REF tech_LLgear_write_en_COMPU_VTAB_REF /end COMPU_METHOD
/begin COMPU_VTAB tech_LLgear_write_en_COMPU_VTAB_REF "Verbal Table" TAB_VERB 2 0 "Not allowed" 1 "Allowed" DEFAULT_VALUE "UNKNOWN" /end COMPU_VTAB
/begin CHARACTERISTIC CCT_Taux_cal "{CCT_Taux_cal&0xff=0:Fuel source}{CCT_Taux_cal&0xff=1:Exhaust manifold/riser}{CCT_Taux_cal&0xff=2:Aux Temp A}{CCT_Taux_cal&0xff=3:Aux Temp B}{CCT_Taux_cal&0xff=4:Aux Temp C}{CCT_Taux_cal&0xff=5:Aux Temp D}" VALUE 0x00147cf0 /* @ECU_Address@CCT_Taux_cal@0x010136F8@ */ ECIPP_ALIGNMENT_UBYTE 255 CCT_Taux_cal_COMPU_VTAB 0 255 BIT_MASK 0xff /end CHARACTERISTIC
/begin COMPU_METHOD CCT_Taux_cal_COMPU_VTAB "Verbal Table" TAB_VERB "%.0" "list" COMPU_TAB_REF CCT_Taux_cal_COMPU_VTAB_REF /end COMPU_METHOD
/begin COMPU_VTAB CCT_Taux_cal_COMPU_VTAB_REF "Verbal Table" TAB_VERB 6 0 "Fuel source" 1 "Exhaust manifold/riser" 2 "Aux Temp A" 3 "Aux Temp B" 4 "Aux Temp C" 5 "Aux Temp D" DEFAULT_VALUE "UNKNOWN" /end COMPU_VTAB
/begin CHARACTERISTIC CCT_vdr "IOConfig # CCT_vdr" VALUE 0x0014396c /* @ECU_Address@CCT_vdr@0x01013700@ */ ECIPP_ALIGNMENT_FLOAT32_IEEE 10000000000 Compu_CCT_vdr -10000000000 10000000000 /end CHARACTERISTIC
/begin COMPU_METHOD Compu_CCT_vdr " " RAT_FUNC "%.3" "ohms" COEFFS 0 1 0 0 0 1 /end COMPU_METHOD
/begin CHARACTERISTIC J1939_SOFT_mode "{J1939_SOFT_mode&0xff=0:Standard}{J1939_SOFT_mode&0xff=1:Alternate}" VALUE 0x00166364 /* @ECU_Address@J1939_SOFT_mode@0x010137C0@ */ ECIPP_ALIGNMENT_UBYTE 255 J1939_SOFT_mode_COMPU_VTAB 0 255 BIT_MASK 0xff /end CHARACTERISTIC
/begin COMPU_METHOD J1939_SOFT_mode_COMPU_VTAB "Verbal Table" TAB_VERB "%.0" "list" COMPU_TAB_REF J1939_SOFT_mode_COMPU_VTAB_REF /end COMPU_METHOD
/begin COMPU_VTAB J1939_SOFT_mode_COMPU_VTAB_REF "Verbal Table" TAB_VERB 2 0 "Standard" 1 "Alternate" DEFAULT_VALUE "UNKNOWN" /end COMPU_VTAB
/begin MEASUREMENT TWCmod_OSC_crct "Current oxygen storage capacity" FLOAT32_IEEE Compu_TWCmod_OSC_crct 0 0 -10000000000 10000000000 ECU_ADDRESS 0x010138A8 /end MEASUREMENT
/begin COMPU_METHOD Compu_TWCmod_OSC_crct " " RAT_FUNC "%.1" "g" COEFFS 0 1 0 0 0 1 /end COMPU_METHOD
/begin CHARACTERISTIC CM_unresp_nstoich_en "{CM_unresp_nstoich_en&0xff=0:before FSO}{CM_unresp_nstoich_en&0xff=1:during FSO} (Fault Condition:and phi command is within excursion limits)" VALUE 0x001650ff /* @ECU_Address@CM_unresp_nstoich_en@0x010138C0@ */ ECIPP_ALIGNMENT_UBYTE 255 CM_unresp_nstoich_en_COMPU_VTAB 0 255 BIT_MASK 0xff /end CHARACTERISTIC
/begin COMPU_METHOD CM_unresp_nstoich_en_COMPU_VTAB "Verbal Table" TAB_VERB "%.0" "list" COMPU_TAB_REF CM_unresp_nstoich_en_COMPU_VTAB_REF /end COMPU_METHOD
/begin COMPU_VTAB CM_unresp_nstoich_en_COMPU_VTAB_REF "Verbal Table" TAB_VERB 2 0 "before FSO" 1 "during FSO" DEFAULT_VALUE "UNKNOWN" /end COMPU_VTAB
/begin CHARACTERISTIC VDS_reprog_mode "{VDS_reprog_mode&0xff=0:Standard}{VDS_reprog_mode&0xff=1:Variant Data Set}" VALUE 0x00169608 /* @ECU_Address@VDS_reprog_mode@0x01013918@ */ ECIPP_ALIGNMENT_UBYTE 255 VDS_reprog_mode_COMPU_VTAB 0 255 BIT_MASK 0xff /end CHARACTERISTIC
/begin COMPU_METHOD VDS_reprog_mode_COMPU_VTAB "Verbal Table" TAB_VERB "%.0" "list" COMPU_TAB_REF VDS_reprog_mode_COMPU_VTAB_REF /end COMPU_METHOD
/begin COMPU_VTAB VDS_reprog_mode_COMPU_VTAB_REF "Verbal Table" TAB_VERB 2 0 "Standard" 1 "Variant Data Set" DEFAULT_VALUE "UNKNOWN" /end COMPU_VTAB
/begin CHARACTERISTIC ICam_ref_offset "IOConfig # ICam_ref_offset" VALUE 0x00149032 /* @ECU_Address@ICam_ref_offset@0x01013928@ */ ECIPP_ALIGNMENT_SWORD 2048 Compu_ICam_ref_offset -2048 2047.9375 /end CHARACTERISTIC
/begin COMPU_METHOD Compu_ICam_ref_offset " " RAT_FUNC "%.3" "CAD BTDC" COEFFS 0 16 0 0 0 1 /end COMPU_METHOD
/begin CHARACTERISTIC ECam_ref_offset "IOConfig # ECam_ref_offset" VALUE 0x00148DBE /* @ECU_Address@ECam_ref_offset@0x01013930@ */ ECIPP_ALIGNMENT_SWORD 2048 Compu_ECam_ref_offset -2048 2047.9375 /end CHARACTERISTIC
/begin COMPU_METHOD Compu_ECam_ref_offset " " RAT_FUNC "%.3" "CAD BTDC" COEFFS 0 16 0 0 0 1 /end COMPU_METHOD
/begin CHARACTERISTIC MFA_lo_flow_pct "FaultConfig # MFA_lo_flow_pct (Fault Condition:(actual flow - VE estimated flow) <)" VALUE 0x0014436a /* @ECU_Address@MFA_lo_flow_pct@0x01013A08@ */ ECIPP_ALIGNMENT_SWORD 400 Compu_MFA_lo_flow_pct -400 399.98779296875 /end CHARACTERISTIC
/begin COMPU_METHOD Compu_MFA_lo_flow_pct " " RAT_FUNC "%.3" "%" COEFFS 0 81.92 0 0 0 1 /end COMPU_METHOD
/begin CHARACTERISTIC MFA_hi_flow_pct "FaultConfig # MFA_hi_flow_pct (Fault Condition:(actual flow - VE estimated flow) >)" VALUE 0x00144368 /* @ECU_Address@MFA_hi_flow_pct@0x01013A10@ */ ECIPP_ALIGNMENT_SWORD 400 Compu_MFA_hi_flow_pct -400 399.98779296875 /end CHARACTERISTIC
/begin COMPU_METHOD Compu_MFA_hi_flow_pct " " RAT_FUNC "%.3" "%" COEFFS 0 81.92 0 0 0 1 /end COMPU_METHOD
/begin CHARACTERISTIC MFA_flow_min_RPM "FaultConfig # MFA_flow_min_RPM (Fault Condition:and RPM >)" VALUE 0x001475f0 /* @ECU_Address@MFA_flow_min_RPM@0x01013A18@ */ ECIPP_ALIGNMENT_UWORD 65535 Compu_MFA_flow_min_RPM 0 65535 /end CHARACTERISTIC
/begin COMPU_METHOD Compu_MFA_flow_min_RPM " " RAT_FUNC "%.0" "rpm" COEFFS 0 1 0 0 0 1 /end COMPU_METHOD
/begin CHARACTERISTIC MFA_flow_min_MAP "FaultConfig # MFA_flow_min_MAP (Fault Condition:and MAP >)" VALUE 0x001475ee /* @ECU_Address@MFA_flow_min_MAP@0x01013A20@ */ ECIPP_ALIGNMENT_UWORD 256 Compu_MFA_flow_min_MAP 0 255.99609375 /end CHARACTERISTIC
/begin COMPU_METHOD Compu_MFA_flow_min_MAP " " RAT_FUNC "%.3" "psia" COEFFS 0 256 0 0 0 1 /end COMPU_METHOD
/begin CHARACTERISTIC MFG_lo_flow_pct "FaultConfig # MFG_lo_flow_pct (Fault Condition:(actual flow - commanded flow) <)" VALUE 0x0014436e /* @ECU_Address@MFG_lo_flow_pct@0x01013A30@ */ ECIPP_ALIGNMENT_SWORD 400 Compu_MFG_lo_flow_pct -400 399.98779296875 /end CHARACTERISTIC
/begin COMPU_METHOD Compu_MFG_lo_flow_pct " " RAT_FUNC "%.3" "%" COEFFS 0 81.92 0 0 0 1 /end COMPU_METHOD
/begin CHARACTERISTIC MFG_hi_flow_pct "FaultConfig # MFG_hi_flow_pct (Fault Condition:(actual flow - commanded flow) >)" VALUE 0x0014436c /* @ECU_Address@MFG_hi_flow_pct@0x01013A38@ */ ECIPP_ALIGNMENT_SWORD 400 Compu_MFG_hi_flow_pct -400 399.98779296875 /end CHARACTERISTIC
/begin COMPU_METHOD Compu_MFG_hi_flow_pct " " RAT_FUNC "%.3" "%" COEFFS 0 81.92 0 0 0 1 /end COMPU_METHOD
/begin CHARACTERISTIC MFG_flow_min_RPM "FaultConfig # MFG_flow_min_RPM (Fault Condition:and RPM >)" VALUE 0x001475fc /* @ECU_Address@MFG_flow_min_RPM@0x01013A40@ */ ECIPP_ALIGNMENT_UWORD 65535 Compu_MFG_flow_min_RPM 0 65535 /end CHARACTERISTIC
/begin COMPU_METHOD Compu_MFG_flow_min_RPM " " RAT_FUNC "%.0" "rpm" COEFFS 0 1 0 0 0 1 /end COMPU_METHOD
/begin CHARACTERISTIC MFG_flow_min_MAP "FaultConfig # MFG_flow_min_MAP (Fault Condition:and MAP >)" VALUE 0x001475fa /* @ECU_Address@MFG_flow_min_MAP@0x01013A48@ */ ECIPP_ALIGNMENT_UWORD 256 Compu_MFG_flow_min_MAP 0 255.99609375 /end CHARACTERISTIC
/begin COMPU_METHOD Compu_MFG_flow_min_MAP " " RAT_FUNC "%.3" "psia" COEFFS 0 256 0 0 0 1 /end COMPU_METHOD
/begin CHARACTERISTIC FSO_TPS_diag_pct "FaultConfig # FSO_TPS_diag_pct" VALUE 0x00164ece /* @ECU_Address@FSO_TPS_diag_pct@0x01013A70@ */ ECIPP_ALIGNMENT_UWORD 100 Compu_FSO_TPS_diag_pct 0 99.9984741210938 /end CHARACTERISTIC
/begin COMPU_METHOD Compu_FSO_TPS_diag_pct " " RAT_FUNC "%.3" "%" COEFFS 0 655.36 0 0 0 1 /end COMPU_METHOD
/begin CHARACTERISTIC IBF_fault_events "FaultConfig # IBF_fault_events (Fault Condition:Intake backfire events >=)" VALUE 0x00166361 /* @ECU_Address@IBF_fault_events@0x01013AD0@ */ ECIPP_ALIGNMENT_UBYTE 255 Compu_IBF_fault_events 0 255 /end CHARACTERISTIC
/begin COMPU_METHOD Compu_IBF_fault_events " " RAT_FUNC "%.0" "events" COEFFS 0 1 0 0 0 1 /end COMPU_METHOD
/begin CHARACTERISTIC IBF_fault_hours "FaultConfig # IBF_fault_hours (Fault Condition:Timeframe <=)" VALUE 0x00166362 /* @ECU_Address@IBF_fault_hours@0x01013AD8@ */ ECIPP_ALIGNMENT_UBYTE 255 Compu_IBF_fault_hours 0 255 /end CHARACTERISTIC
/begin COMPU_METHOD Compu_IBF_fault_hours " " RAT_FUNC "%.0" "hours" COEFFS 0 1 0 0 0 1 /end COMPU_METHOD
/begin CHARACTERISTIC MAP_addtl_flt_react "{MAP_addtl_flt_react&0xff=0x00:None}{MAP_addtl_flt_react&0x01=0x01:MAP higher than expected fault}{MAP_addtl_flt_react&0x02=0x02:MAP pegging reference out-of-range fault}{MAP_addtl_flt_react&0x03=0x03:Both faults}" VALUE 0x0016636c /* @ECU_Address@MAP_addtl_flt_react@0x01013AE0@ */ ECIPP_ALIGNMENT_UBYTE 255 MAP_addtl_flt_react_COMPU_VTAB 0 255 BIT_MASK 0xff /end CHARACTERISTIC
/begin COMPU_METHOD MAP_addtl_flt_react_COMPU_VTAB "Verbal Table" TAB_VERB "%.0" "list" COMPU_TAB_REF MAP_addtl_flt_react_COMPU_VTAB_REF /end COMPU_METHOD
/begin COMPU_VTAB MAP_addtl_flt_react_COMPU_VTAB_REF "Verbal Table" TAB_VERB 1 0x00 "None" DEFAULT_VALUE "Unsupported Bit_Mask" /end COMPU_VTAB
/begin CHARACTERISTIC RS_loss_PTO_stat "{RS_loss_PTO_stat&0xff=0x00:Ignored}{RS_loss_PTO_stat&0xff=0x01:Inactive} (Fault Condition:and PTO status is)" VALUE 0x00166382 /* @ECU_Address@RS_loss_PTO_stat@0x01013AE8@ */ ECIPP_ALIGNMENT_UBYTE 255 RS_loss_PTO_stat_COMPU_VTAB 0 255 BIT_MASK 0xff /end CHARACTERISTIC
/begin COMPU_METHOD RS_loss_PTO_stat_COMPU_VTAB "Verbal Table" TAB_VERB "%.0" "list" COMPU_TAB_REF RS_loss_PTO_stat_COMPU_VTAB_REF /end COMPU_METHOD
/begin COMPU_VTAB RS_loss_PTO_stat_COMPU_VTAB_REF "Verbal Table" TAB_VERB 2 0x00 "Ignored" 0x01 "Inactive" DEFAULT_VALUE "UNKNOWN" /end COMPU_VTAB
/begin CHARACTERISTIC fuellev_pct_def "IOConfig # fuellev_pct_def" VALUE 0x00147b1c /* @ECU_Address@fuellev_pct_def@0x01013BB8@ */ ECIPP_ALIGNMENT_UWORD 100 Compu_fuellev_pct_def 0 99.9984741210938 /end CHARACTERISTIC
/begin COMPU_METHOD Compu_fuellev_pct_def " " RAT_FUNC "%.3" "%" COEFFS 0 655.36 0 0 0 1 /end COMPU_METHOD
/begin MEASUREMENT TSoftID_table_def "General # TSoftID_table_def" ULONG Compu_TSoftID_table_def 0 0 0 4294967295 ECU_ADDRESS 0x02007000 MATRIX_DIM 4 1 1 /end MEASUREMENT
/begin COMPU_METHOD Compu_TSoftID_table_def " " RAT_FUNC "%.0" "-" COEFFS 0 1 0 0 0 1 /end COMPU_METHOD
/begin MEASUREMENT TCalID_table "Current calibration model" ULONG Compu_TCalID_table 0 0 0 4294967295 ECU_ADDRESS 0x02008000 MATRIX_DIM 4 1 1 /end MEASUREMENT
/begin COMPU_METHOD Compu_TCalID_table " " RAT_FUNC "%.0" "-" COEFFS 0 1 0 0 0 1 /end COMPU_METHOD
/begin CHARACTERISTIC STR_CalBaseName "Calibration file base name" ASCII 0x00147F3D /* @ECU_Address@STR_CalBaseName@0x0200C000@ */ ECIPP_ALIGNMENT_UBYTE 255 Compu_ECIPP_STRINGS 0 255 MATRIX_DIM 159 1 1 /end CHARACTERISTIC
/begin CHARACTERISTIC STR_engine_defPN "General # STR_engine_defPN" ASCII 0x00169460 /* @ECU_Address@STR_engine_defPN@0x0200F000@ */ ECIPP_ALIGNMENT_UBYTE 255 Compu_ECIPP_STRINGS 0 255 MATRIX_DIM 19 1 1 /end CHARACTERISTIC
/begin CHARACTERISTIC STR_engine_defSN "General # STR_engine_defSN" ASCII 0x00169474 /* @ECU_Address@STR_engine_defSN@0x02010000@ */ ECIPP_ALIGNMENT_UBYTE 255 Compu_ECIPP_STRINGS 0 255 MATRIX_DIM 19 1 1 /end CHARACTERISTIC
/begin CHARACTERISTIC AdaptMAP "CL # AdaptMAP" VAL_BLK 0x001428A2 /* @ECU_Address@AdaptMAP@0x02020000@ */ ECIPP_ALIGNMENT_SWORD 128 Compu_AdaptMAP -128 127.99609375 MATRIX_DIM 8 1 1 /end CHARACTERISTIC
/begin COMPU_METHOD Compu_AdaptMAP " " RAT_FUNC "%.1" "MAP (psia)" COEFFS 0 256 0 0 0 1 /end COMPU_METHOD
/begin CHARACTERISTIC AdaptRPM "CL # AdaptRPM" VAL_BLK 0x001428B2 /* @ECU_Address@AdaptRPM@0x02021000@ */ ECIPP_ALIGNMENT_SWORD 32767 Compu_AdaptRPM -32768 32767 MATRIX_DIM 5 1 1 /end CHARACTERISTIC
/begin COMPU_METHOD Compu_AdaptRPM " " RAT_FUNC "%.0" "Speed (rpm)" COEFFS 0 1 0 0 0 1 /end COMPU_METHOD
/begin MEASUREMENT AdaptTbl1 "Gasoline Bank1 Adaptive Table" SWORD Compu_AdaptTbl1 0 0 -100 99.9969482421875 ECU_ADDRESS 0x02022000 MATRIX_DIM 40 1 1 /end MEASUREMENT
/begin COMPU_METHOD Compu_AdaptTbl1 " " RAT_FUNC "%.1" "A_BM1 (%)" COEFFS 0 327.68 0 0 0 1 /end COMPU_METHOD
/begin CHARACTERISTIC AdaptMAPP "CL # AdaptMAPP" VAL_BLK 0x001409D2 /* @ECU_Address@AdaptMAPP@0x0205B000@ */ ECIPP_ALIGNMENT_SWORD 128 Compu_AdaptMAPP -128 127.99609375 MATRIX_DIM 8 1 1 /end CHARACTERISTIC
/begin COMPU_METHOD Compu_AdaptMAPP " " RAT_FUNC "%.1" "MAP (psia)" COEFFS 0 256 0 0 0 1 /end COMPU_METHOD
/begin CHARACTERISTIC AdaptRPMP "CL # AdaptRPMP" VAL_BLK 0x001409E2 /* @ECU_Address@AdaptRPMP@0x0205C000@ */ ECIPP_ALIGNMENT_SWORD 32767 Compu_AdaptRPMP -32768 32767 MATRIX_DIM 5 1 1 /end CHARACTERISTIC
/begin COMPU_METHOD Compu_AdaptRPMP " " RAT_FUNC "%.0" "Speed (rpm)" COEFFS 0 1 0 0 0 1 /end COMPU_METHOD
/begin MEASUREMENT AdaptTblP "LPG Adaptive Table" SWORD Compu_AdaptTblP 0 0 -100 99.9969482421875 ECU_ADDRESS 0x0205D000 MATRIX_DIM 40 1 1 /end MEASUREMENT
/begin COMPU_METHOD Compu_AdaptTblP " " RAT_FUNC "%.1" "A_BM (%)" COEFFS 0 327.68 0 0 0 1 /end COMPU_METHOD
/begin CHARACTERISTIC AdaptMAPNG "CL # AdaptMAPNG" VAL_BLK 0x0014193A /* @ECU_Address@AdaptMAPNG@0x0205E000@ */ ECIPP_ALIGNMENT_SWORD 128 Compu_AdaptMAPNG -128 127.99609375 MATRIX_DIM 8 1 1 /end CHARACTERISTIC
/begin COMPU_METHOD Compu_AdaptMAPNG " " RAT_FUNC "%.1" "MAP (psia)" COEFFS 0 256 0 0 0 1 /end COMPU_METHOD
/begin CHARACTERISTIC AdaptRPMNG "CL # AdaptRPMNG" VAL_BLK 0x0014194A /* @ECU_Address@AdaptRPMNG@0x0205F000@ */ ECIPP_ALIGNMENT_SWORD 32767 Compu_AdaptRPMNG -32768 32767 MATRIX_DIM 5 1 1 /end CHARACTERISTIC
/begin COMPU_METHOD Compu_AdaptRPMNG " " RAT_FUNC "%.0" "Speed (rpm)" COEFFS 0 1 0 0 0 1 /end COMPU_METHOD
/begin MEASUREMENT AdaptTblNG "NG Adaptive Table" SWORD Compu_AdaptTblNG 0 0 -100 99.9969482421875 ECU_ADDRESS 0x02060000 MATRIX_DIM 40 1 1 /end MEASUREMENT
/begin COMPU_METHOD Compu_AdaptTblNG " " RAT_FUNC "%.1" "A_BM (%)" COEFFS 0 327.68 0 0 0 1 /end COMPU_METHOD
/begin MEASUREMENT AdaptTbl2 "Gasoline Bank2 Adaptive Table" SWORD Compu_AdaptTbl2 0 0 -100 99.9969482421875 ECU_ADDRESS 0x0209D000 MATRIX_DIM 40 1 1 /end MEASUREMENT
/begin COMPU_METHOD Compu_AdaptTbl2 " " RAT_FUNC "%.1" "A_BM2 (%)" COEFFS 0 327.68 0 0 0 1 /end COMPU_METHOD
/begin CHARACTERISTIC TOCTadpt_MAP "Spark # TOCTadpt_MAP" VAL_BLK 0x0014388C /* @ECU_Address@TOCTadpt_MAP@0x020EA000@ */ ECIPP_ALIGNMENT_SWORD 128 Compu_TOCTadpt_MAP -128 127.99609375 MATRIX_DIM 4 1 1 /end CHARACTERISTIC
/begin COMPU_METHOD Compu_TOCTadpt_MAP " " RAT_FUNC "%.1" "MAP_load (psia)" COEFFS 0 256 0 0 0 1 /end COMPU_METHOD
/begin CHARACTERISTIC TOCTadpt_RPM "Spark # TOCTadpt_RPM" VAL_BLK 0x00143894 /* @ECU_Address@TOCTadpt_RPM@0x020EB000@ */ ECIPP_ALIGNMENT_SWORD 32767 Compu_TOCTadpt_RPM -32768 32767 MATRIX_DIM 5 1 1 /end CHARACTERISTIC
/begin COMPU_METHOD Compu_TOCTadpt_RPM " " RAT_FUNC "%.0" "Speed (rpm)" COEFFS 0 1 0 0 0 1 /end COMPU_METHOD
/begin MEASUREMENT TOCTadpt_oct "Adaptive Octane Learn Table" SWORD Compu_TOCTadpt_oct 0 0 -100 99.9969482421875 ECU_ADDRESS 0x020EC000 MATRIX_DIM 20 1 1 /end MEASUREMENT
/begin COMPU_METHOD Compu_TOCTadpt_oct " " RAT_FUNC "%.1" "Octane (%)" COEFFS 0 327.68 0 0 0 1 /end COMPU_METHOD
/begin CHARACTERISTIC TIAC_step_Vbat "Gov # TIAC_step_Vbat" VAL_BLK 0x00144C0A /* @ECU_Address@TIAC_step_Vbat@0x020F2000@ */ ECIPP_ALIGNMENT_SWORD 128 Compu_TIAC_step_Vbat -128 127.99609375 MATRIX_DIM 4 1 1 /end CHARACTERISTIC
/begin COMPU_METHOD Compu_TIAC_step_Vbat " " RAT_FUNC "%.3" "(volts)" COEFFS 0 256 0 0 0 1 /end COMPU_METHOD
/begin CHARACTERISTIC TIAC_step_int "Gov # TIAC_step_int" VAL_BLK 0x00144C12 /* @ECU_Address@TIAC_step_int@0x020F3000@ */ ECIPP_ALIGNMENT_SWORD 128 Compu_TIAC_step_int -128 127.99609375 MATRIX_DIM 4 1 1 /end CHARACTERISTIC
/begin COMPU_METHOD Compu_TIAC_step_int " " RAT_FUNC "%.3" "(ms)" COEFFS 0 256 0 0 0 1 /end COMPU_METHOD
/begin CHARACTERISTIC HstSL_Tbl_MAPdf "FaultConfig # HstSL_Tbl_MAPdf" VAL_BLK 0x0016C372 /* @ECU_Address@HstSL_Tbl_MAPdf@0x02141000@ */ ECIPP_ALIGNMENT_UWORD 256 Compu_HstSL_Tbl_MAPdf 0 255.99609375 MATRIX_DIM 6 1 1 /end CHARACTERISTIC
/begin COMPU_METHOD Compu_HstSL_Tbl_MAPdf " " RAT_FUNC "%.3" "MAP load (psia)" COEFFS 0 256 0 0 0 1 /end COMPU_METHOD
/begin MEASUREMENT HstSL_Tbl_MAP "General # HstSL_Tbl_MAP" UWORD Compu_HstSL_Tbl_MAP 0 0 0 255.99609375 ECU_ADDRESS 0x02143000 MATRIX_DIM 6 1 1 /end MEASUREMENT
/begin COMPU_METHOD Compu_HstSL_Tbl_MAP " " RAT_FUNC "%.1" "MAP (psia)" COEFFS 0 256 0 0 0 1 /end COMPU_METHOD
/begin CHARACTERISTIC TTM_IACA_POS "Air # TTM_IACA_POS" VAL_BLK 0x001631FA /* @ECU_Address@TTM_IACA_POS@0x02147000@ */ ECIPP_ALIGNMENT_SWORD 100 Compu_TTM_IACA_POS -100 99.9969482421875 MATRIX_DIM 16 1 1 /end CHARACTERISTIC
/begin COMPU_METHOD Compu_TTM_IACA_POS " " RAT_FUNC "%.3" "(%)" COEFFS 0 327.68 0 0 0 1 /end COMPU_METHOD
/begin CHARACTERISTIC TTM_IACA_A "Air # TTM_IACA_A" VAL_BLK 0x001631DA /* @ECU_Address@TTM_IACA_A@0x02148000@ */ ECIPP_ALIGNMENT_SWORD 2 Compu_TTM_IACA_A -2 1.99993896484375 MATRIX_DIM 16 1 1 /end CHARACTERISTIC
/begin COMPU_METHOD Compu_TTM_IACA_A " " RAT_FUNC "%.3" "(in^2)" COEFFS 0 16384 0 0 0 1 /end COMPU_METHOD
/begin CHARACTERISTIC FPcal_V "IOConfig # FPcal_V" VAL_BLK 0x001442FE /* @ECU_Address@FPcal_V@0x02152000@ */ ECIPP_ALIGNMENT_SWORD 5 Compu_FPcal_V -5 4.99984741210938 MATRIX_DIM 2 1 1 /end CHARACTERISTIC
/begin COMPU_METHOD Compu_FPcal_V " " RAT_FUNC "%.3" "(volts)" COEFFS 0 6553.6 0 0 0 1 /end COMPU_METHOD
/begin CHARACTERISTIC FPcal_P "IOConfig # FPcal_P" VAL_BLK 0x001442F6 /* @ECU_Address@FPcal_P@0x02153000@ */ ECIPP_ALIGNMENT_SWORD 256 Compu_FPcal_P -256 255.9921875 MATRIX_DIM 2 1 1 /end CHARACTERISTIC
/begin COMPU_METHOD Compu_FPcal_P " " RAT_FUNC "%.3" "-" COEFFS 0 128 0 0 0 1 /end COMPU_METHOD
/begin CHARACTERISTIC FTPcal_V "IOConfig # FTPcal_V" VAL_BLK 0x0014430C /* @ECU_Address@FTPcal_V@0x02154000@ */ ECIPP_ALIGNMENT_SWORD 5 Compu_FTPcal_V -5 4.99984741210938 MATRIX_DIM 2 1 1 /end CHARACTERISTIC
/begin COMPU_METHOD Compu_FTPcal_V " " RAT_FUNC "%.3" "(volts)" COEFFS 0 6553.6 0 0 0 1 /end COMPU_METHOD
/begin CHARACTERISTIC FTPcal_P "IOConfig # FTPcal_P" VAL_BLK 0x00144308 /* @ECU_Address@FTPcal_P@0x02155000@ */ ECIPP_ALIGNMENT_SWORD 8192 Compu_FTPcal_P -8192 8191.75 MATRIX_DIM 2 1 1 /end CHARACTERISTIC
/begin COMPU_METHOD Compu_FTPcal_P " " RAT_FUNC "%.3" "-" COEFFS 0 4 0 0 0 1 /end COMPU_METHOD
/begin COMPU_METHOD Compu_TDPS_K_Pcmd " " RAT_FUNC "%.1" "Pcmd (inH2O)" COEFFS 0 512 0 0 0 1 /end COMPU_METHOD
/begin CHARACTERISTIC TDPS_Kp "EPR DP Gain Schedule" CURVE 0x00144766 /* @ECU_Address@TDPS_Kp@0x02157000@ */ ECIPP_ALIGNMENT_SWORD 200 Compu_TDPS_Kp -200 199.993896484375 MAX_REFRESH 6 1
 /begin AXIS_DESCR COM_AXIS NO_INPUT_QUANTITY Compu_TDPS_K_Pcmd 8 -64 63.998046875 AXIS_PTS_REF TDPS_K_Pcmd /end AXIS_DESCR
/end CHARACTERISTIC
/begin AXIS_PTS TDPS_K_Pcmd " " 0x00144736 /* @ECU_Address@TDPS_K_Pcmd@0x02156000@ */ NO_INPUT_QUANTITY ECIPP_Lookup_SWORD 0 Compu_TDPS_K_Pcmd 8 -64 63.998046875 /end AXIS_PTS
/begin COMPU_METHOD Compu_TDPS_Kp " " RAT_FUNC "%.3" "Kp (%/inH2O)" COEFFS 0 163.84 0 0 0 1 /end COMPU_METHOD
/begin CHARACTERISTIC TDPS_Ki "EPR DP Gain Schedule" CURVE 0x00144756 /* @ECU_Address@TDPS_Ki@0x02158000@ */ ECIPP_ALIGNMENT_SWORD 3 Compu_TDPS_Ki -3.125 3.12490463256836 MAX_REFRESH 6 1
 /begin AXIS_DESCR COM_AXIS NO_INPUT_QUANTITY Compu_TDPS_K_Pcmd 8 -64 63.998046875 AXIS_PTS_REF TDPS_K_Pcmd /end AXIS_DESCR
/end CHARACTERISTIC
/begin COMPU_METHOD Compu_TDPS_Ki " " RAT_FUNC "%.3" "Ki (%/inH2O/ms)" COEFFS 0 10485.76 0 0 0 1 /end COMPU_METHOD
/begin CHARACTERISTIC TDPS_Kd "EPR DP Gain Schedule" CURVE 0x00144746 /* @ECU_Address@TDPS_Kd@0x02159000@ */ ECIPP_ALIGNMENT_SWORD 12800 Compu_TDPS_Kd -12800 12799.609375 MAX_REFRESH 6 1
 /begin AXIS_DESCR COM_AXIS NO_INPUT_QUANTITY Compu_TDPS_K_Pcmd 8 -64 63.998046875 AXIS_PTS_REF TDPS_K_Pcmd /end AXIS_DESCR
/end CHARACTERISTIC
/begin COMPU_METHOD Compu_TDPS_Kd " " RAT_FUNC "%.1" "Kd (%/inH2O*ms)" COEFFS 0 2.56 0 0 0 1 /end COMPU_METHOD
/begin COMPU_METHOD Compu_TDP_FF_Pcmd " " RAT_FUNC "%.1" "Pcmd (inH2O)" COEFFS 0 512 0 0 0 1 /end COMPU_METHOD
/begin CHARACTERISTIC TDP_FF_pct "EPR Feedforward Schedule" CURVE 0x0014479A /* @ECU_Address@TDP_FF_pct@0x0215B000@ */ ECIPP_ALIGNMENT_SWORD 100 Compu_TDP_FF_pct -100 99.9969482421875 MAX_REFRESH 6 1
 /begin AXIS_DESCR COM_AXIS NO_INPUT_QUANTITY Compu_TDP_FF_Pcmd 8 -64 63.998046875 AXIS_PTS_REF TDP_FF_Pcmd /end AXIS_DESCR
/end CHARACTERISTIC
/begin AXIS_PTS TDP_FF_Pcmd " " 0x0014478A /* @ECU_Address@TDP_FF_Pcmd@0x0215A000@ */ NO_INPUT_QUANTITY ECIPP_Lookup_SWORD 0 Compu_TDP_FF_Pcmd 8 -64 63.998046875 /end AXIS_PTS
/begin COMPU_METHOD Compu_TDP_FF_pct " " RAT_FUNC "%.1" "Feedforward (%)" COEFFS 0 327.68 0 0 0 1 /end COMPU_METHOD
/begin MEASUREMENT TFltCfg "FaultConfig # TFltCfg" UWORD Compu_TFltCfg 0 0 0 65535 ECU_ADDRESS 0x0215F000 MATRIX_DIM 16 1 1 /end MEASUREMENT
/begin COMPU_METHOD Compu_TFltCfg " " RAT_FUNC "%.0" "-" COEFFS 0 1 0 0 0 1 /end COMPU_METHOD
/begin MEASUREMENT TFltMiniHst "FaultConfig # TFltMiniHst" UWORD Compu_TFltMiniHst 0 0 0 65535 ECU_ADDRESS 0x02160000 MATRIX_DIM 14 1 1 /end MEASUREMENT
/begin COMPU_METHOD Compu_TFltMiniHst " " RAT_FUNC "%.0" "-" COEFFS 0 1 0 0 0 1 /end COMPU_METHOD
/begin MEASUREMENT TFltMiniAct "FaultConfig # TFltMiniAct" UWORD Compu_TFltMiniAct 0 0 0 65535 ECU_ADDRESS 0x02161000 MATRIX_DIM 14 1 1 /end MEASUREMENT
/begin COMPU_METHOD Compu_TFltMiniAct " " RAT_FUNC "%.0" "-" COEFFS 0 1 0 0 0 1 /end COMPU_METHOD
/begin MEASUREMENT TFltMiniPnd "FaultConfig # TFltMiniPnd" UWORD Compu_TFltMiniPnd 0 0 0 65535 ECU_ADDRESS 0x02162000 MATRIX_DIM 14 1 1 /end MEASUREMENT
/begin COMPU_METHOD Compu_TFltMiniPnd " " RAT_FUNC "%.0" "-" COEFFS 0 1 0 0 0 1 /end COMPU_METHOD
/begin MEASUREMENT ICAV_mis_cyls "Misfire cylinder count - 1" UWORD Compu_ICAV_mis_cyls 0 0 0 65535 ECU_ADDRESS 0x0216C000 MATRIX_DIM 10 1 1 /end MEASUREMENT
/begin COMPU_METHOD Compu_ICAV_mis_cyls " " RAT_FUNC "%.0" "-" COEFFS 0 1 0 0 0 1 /end COMPU_METHOD
/begin CHARACTERISTIC TPW_VC_volts "Fuel # TPW_VC_volts" VAL_BLK 0x00162F7A /* @ECU_Address@TPW_VC_volts@0x0218A000@ */ ECIPP_ALIGNMENT_SWORD 128 Compu_TPW_VC_volts -128 127.99609375 MATRIX_DIM 16 1 1 /end CHARACTERISTIC
/begin COMPU_METHOD Compu_TPW_VC_volts " " RAT_FUNC "%.3" "(volts)" COEFFS 0 256 0 0 0 1 /end COMPU_METHOD
/begin CHARACTERISTIC TPW_VC_time "Fuel # TPW_VC_time" VAL_BLK 0x00162F3A /* @ECU_Address@TPW_VC_time@0x0218B000@ */ ECIPP_ALIGNMENT_SWORD 105 Compu_TPW_VC_time -104.8576 104.8544 MATRIX_DIM 16 1 1 /end CHARACTERISTIC
/begin COMPU_METHOD Compu_TPW_VC_time " " RAT_FUNC "%.3" "(ms)" COEFFS 0 312.5 0 0 0 1 /end COMPU_METHOD
/begin CHARACTERISTIC TICAV_hst_prog "FaultConfig # TICAV_hst_prog" VAL_BLK 0x00144CFA /* @ECU_Address@TICAV_hst_prog@0x0218C000@ */ ECIPP_ALIGNMENT_SWORD 32767 Compu_TICAV_hst_prog -32768 32767 MATRIX_DIM 7 1 1 /end CHARACTERISTIC
/begin COMPU_METHOD Compu_TICAV_hst_prog " " RAT_FUNC "%.0" "Progress (cycles)" COEFFS 0 1 0 0 0 1 /end COMPU_METHOD
/begin CHARACTERISTIC TICAV_hst_tmult "FaultConfig # TICAV_hst_tmult" VAL_BLK 0x00144D08 /* @ECU_Address@TICAV_hst_tmult@0x0218D000@ */ ECIPP_ALIGNMENT_SWORD 4 Compu_TICAV_hst_tmult -4 3.9998779296875 MATRIX_DIM 7 1 1 /end CHARACTERISTIC
/begin COMPU_METHOD Compu_TICAV_hst_tmult " " RAT_FUNC "%.2" "Thres Multiplier" COEFFS 0 8192 0 0 0 1 /end COMPU_METHOD
/begin MEASUREMENT ICAV_chst_cnts "ICAV Continuous Misfires" SWORD Compu_ICAV_chst_cnts 0 0 -1024 1023.96875 ECU_ADDRESS 0x0218E000 MATRIX_DIM 32 1 1 /end MEASUREMENT
/begin COMPU_METHOD Compu_ICAV_chst_cnts " " RAT_FUNC "%.0" "misfires" COEFFS 0 32 0 0 0 1 /end COMPU_METHOD
/begin MEASUREMENT ICAV_rhst_cnts "ICAV Random Misfires" SWORD Compu_ICAV_rhst_cnts 0 0 -1024 1023.96875 ECU_ADDRESS 0x0218F000 MATRIX_DIM 32 1 1 /end MEASUREMENT
/begin COMPU_METHOD Compu_ICAV_rhst_cnts " " RAT_FUNC "%.0" "misfires" COEFFS 0 32 0 0 0 1 /end COMPU_METHOD
/begin MEASUREMENT ICAV_chst_prog "Continuous Misfire Adapt Prog" UBYTE Compu_ICAV_chst_prog 0 0 0 255 ECU_ADDRESS 0x02190000 MATRIX_DIM 7 1 1 /end MEASUREMENT
/begin COMPU_METHOD Compu_ICAV_chst_prog " " RAT_FUNC "%.0" "Misfires" COEFFS 0 1 0 0 0 1 /end COMPU_METHOD
/begin MEASUREMENT ICAV_rhst_prog "Random Misfire Adapt Prog" UBYTE Compu_ICAV_rhst_prog 0 0 0 255 ECU_ADDRESS 0x02191000 MATRIX_DIM 7 1 1 /end MEASUREMENT
/begin COMPU_METHOD Compu_ICAV_rhst_prog " " RAT_FUNC "%.0" "Misfires" COEFFS 0 1 0 0 0 1 /end COMPU_METHOD
/begin MEASUREMENT ICAV_chst_tmult "Continuous Misfire Thres Mult" UBYTE Compu_ICAV_chst_tmult 0 0 0 255 ECU_ADDRESS 0x02192000 MATRIX_DIM 7 1 1 /end MEASUREMENT
/begin COMPU_METHOD Compu_ICAV_chst_tmult " " RAT_FUNC "%.0" "Misfires" COEFFS 0 1 0 0 0 1 /end COMPU_METHOD
/begin MEASUREMENT ICAV_rhst_tmult "Random Misfire Thres Mult" UBYTE Compu_ICAV_rhst_tmult 0 0 0 255 ECU_ADDRESS 0x02193000 MATRIX_DIM 7 1 1 /end MEASUREMENT
/begin COMPU_METHOD Compu_ICAV_rhst_tmult " " RAT_FUNC "%.0" "Misfires" COEFFS 0 1 0 0 0 1 /end COMPU_METHOD
/begin CHARACTERISTIC TCHT_CHT "General # TCHT_CHT" VAL_BLK 0x001615A0 /* @ECU_Address@TCHT_CHT@0x021BF000@ */ ECIPP_ALIGNMENT_FLOAT32_IEEE 10000000000 Compu_TCHT_CHT -10000000000 10000000000 MATRIX_DIM 16 1 1 /end CHARACTERISTIC
/begin COMPU_METHOD Compu_TCHT_CHT " " RAT_FUNC "%.3" "Temp (deg F)" COEFFS 0 1 460 0 0 1 /end COMPU_METHOD
/begin CHARACTERISTIC TECT_ECT "General # TECT_ECT" VAL_BLK 0x00143A90 /* @ECU_Address@TECT_ECT@0x021C0000@ */ ECIPP_ALIGNMENT_FLOAT32_IEEE 10000000000 Compu_TECT_ECT -10000000000 10000000000 MATRIX_DIM 16 1 1 /end CHARACTERISTIC
/begin COMPU_METHOD Compu_TECT_ECT " " RAT_FUNC "%.3" "Temp (deg F)" COEFFS 0 1 460 0 0 1 /end COMPU_METHOD
/begin CHARACTERISTIC TEGO_phiFB_v "General # TEGO_phiFB_v" VAL_BLK 0x00162D1A /* @ECU_Address@TEGO_phiFB_v@0x021C1000@ */ ECIPP_ALIGNMENT_SWORD 8 Compu_TEGO_phiFB_v -8 7.999755859375 MATRIX_DIM 16 1 1 /end CHARACTERISTIC
/begin COMPU_METHOD Compu_TEGO_phiFB_v " " RAT_FUNC "%.3" "EGO Volts" COEFFS 0 4096 0 0 0 1 /end COMPU_METHOD
/begin CHARACTERISTIC TEGOpre_phiFB_phi "General # TEGOpre_phiFB_phi" VAL_BLK 0x00162D3A /* @ECU_Address@TEGOpre_phiFB_phi@0x021C2000@ */ ECIPP_ALIGNMENT_SWORD 2 Compu_TEGOpre_phiFB_phi -2 1.99993896484375 MATRIX_DIM 16 1 1 /end CHARACTERISTIC
/begin COMPU_METHOD Compu_TEGOpre_phiFB_phi " " RAT_FUNC "%.3" "EGO Phi" COEFFS 0 16384 0 0 0 1 /end COMPU_METHOD
/begin CHARACTERISTIC TEGOpst_phiFB_phi "General # TEGOpst_phiFB_phi" VAL_BLK 0x00162D5A /* @ECU_Address@TEGOpst_phiFB_phi@0x021C3000@ */ ECIPP_ALIGNMENT_SWORD 2 Compu_TEGOpst_phiFB_phi -2 1.99993896484375 MATRIX_DIM 16 1 1 /end CHARACTERISTIC
/begin COMPU_METHOD Compu_TEGOpst_phiFB_phi " " RAT_FUNC "%.3" "EGO Phi" COEFFS 0 16384 0 0 0 1 /end COMPU_METHOD
/begin CHARACTERISTIC TEMWT_EMWT "General # TEMWT_EMWT" VAL_BLK 0x00161620 /* @ECU_Address@TEMWT_EMWT@0x021C4000@ */ ECIPP_ALIGNMENT_FLOAT32_IEEE 10000000000 Compu_TEMWT_EMWT -10000000000 10000000000 MATRIX_DIM 16 1 1 /end CHARACTERISTIC
/begin COMPU_METHOD Compu_TEMWT_EMWT " " RAT_FUNC "%.3" "Temp (deg F)" COEFFS 0 1 460 0 0 1 /end COMPU_METHOD
/begin CHARACTERISTIC TFR_TinKt_Kt "General # TFR_TinKt_Kt" VAL_BLK 0x00162D92 /* @ECU_Address@TFR_TinKt_Kt@0x021C5000@ */ ECIPP_ALIGNMENT_SWORD 32 Compu_TFR_TinKt_Kt -32 31.9990234375 MATRIX_DIM 16 1 1 /end CHARACTERISTIC
/begin COMPU_METHOD Compu_TFR_TinKt_Kt " " RAT_FUNC "%.3" "(g/sec/psia/in^2)" COEFFS 0 1024 0 0 0 1 /end COMPU_METHOD
/begin CHARACTERISTIC TFR_TinKt_Tin "General # TFR_TinKt_Tin" VAL_BLK 0x00162DB2 /* @ECU_Address@TFR_TinKt_Tin@0x021C6000@ */ ECIPP_ALIGNMENT_SWORD 7732 Compu_TFR_TinKt_Tin -8652 7731.75 MATRIX_DIM 16 1 1 /end CHARACTERISTIC
/begin COMPU_METHOD Compu_TFR_TinKt_Tin " " RAT_FUNC "%.3" "(deg F)" COEFFS 0 4 1840 0 0 1 /end COMPU_METHOD
/begin CHARACTERISTIC TFST_FST "General # TFST_FST" VAL_BLK 0x001616A0 /* @ECU_Address@TFST_FST@0x021C7000@ */ ECIPP_ALIGNMENT_FLOAT32_IEEE 10000000000 Compu_TFST_FST -10000000000 10000000000 MATRIX_DIM 16 1 1 /end CHARACTERISTIC
/begin COMPU_METHOD Compu_TFST_FST " " RAT_FUNC "%.3" "Temp (deg F)" COEFFS 0 1 460 0 0 1 /end COMPU_METHOD
/begin CHARACTERISTIC TFTT_FTT "General # TFTT_FTT" VAL_BLK 0x00161720 /* @ECU_Address@TFTT_FTT@0x021C8000@ */ ECIPP_ALIGNMENT_FLOAT32_IEEE 10000000000 Compu_TFTT_FTT -10000000000 10000000000 MATRIX_DIM 16 1 1 /end CHARACTERISTIC
/begin COMPU_METHOD Compu_TFTT_FTT " " RAT_FUNC "%.3" "Temp (deg F)" COEFFS 0 1 460 0 0 1 /end COMPU_METHOD
/begin CHARACTERISTIC TFT_FT "General # TFT_FT" VAL_BLK 0x001617A0 /* @ECU_Address@TFT_FT@0x021C9000@ */ ECIPP_ALIGNMENT_FLOAT32_IEEE 10000000000 Compu_TFT_FT -10000000000 10000000000 MATRIX_DIM 16 1 1 /end CHARACTERISTIC
/begin COMPU_METHOD Compu_TFT_FT " " RAT_FUNC "%.3" "Temp (deg F)" COEFFS 0 1 460 0 0 1 /end COMPU_METHOD
/begin CHARACTERISTIC TFTgaseous_FT "General # TFTgaseous_FT" VAL_BLK 0x00161820 /* @ECU_Address@TFTgaseous_FT@0x021CA000@ */ ECIPP_ALIGNMENT_FLOAT32_IEEE 10000000000 Compu_TFTgaseous_FT -10000000000 10000000000 MATRIX_DIM 16 1 1 /end CHARACTERISTIC
/begin COMPU_METHOD Compu_TFTgaseous_FT " " RAT_FUNC "%.3" "Temp (deg F)" COEFFS 0 1 460 0 0 1 /end COMPU_METHOD
/begin CHARACTERISTIC TIAT_IAT "General # TIAT_IAT" VAL_BLK 0x00161900 /* @ECU_Address@TIAT_IAT@0x021CB000@ */ ECIPP_ALIGNMENT_FLOAT32_IEEE 10000000000 Compu_TIAT_IAT -10000000000 10000000000 MATRIX_DIM 16 1 1 /end CHARACTERISTIC
/begin COMPU_METHOD Compu_TIAT_IAT " " RAT_FUNC "%.3" "Temp (deg F)" COEFFS 0 1 460 0 0 1 /end COMPU_METHOD
/begin CHARACTERISTIC TMJ_TinKtN_Kt "General # TMJ_TinKtN_Kt" VAL_BLK 0x00162E9A /* @ECU_Address@TMJ_TinKtN_Kt@0x021CF000@ */ ECIPP_ALIGNMENT_SWORD 32 Compu_TMJ_TinKtN_Kt -32 31.9990234375 MATRIX_DIM 16 1 1 /end CHARACTERISTIC
/begin COMPU_METHOD Compu_TMJ_TinKtN_Kt " " RAT_FUNC "%.3" "(g/sec/psia/in^2)" COEFFS 0 1024 0 0 0 1 /end COMPU_METHOD
/begin CHARACTERISTIC TMJ_TinKtP_Kt "General # TMJ_TinKtP_Kt" VAL_BLK 0x00162EBA /* @ECU_Address@TMJ_TinKtP_Kt@0x021D0000@ */ ECIPP_ALIGNMENT_SWORD 32 Compu_TMJ_TinKtP_Kt -32 31.9990234375 MATRIX_DIM 16 1 1 /end CHARACTERISTIC
/begin COMPU_METHOD Compu_TMJ_TinKtP_Kt " " RAT_FUNC "%.3" "(g/sec/psia/in^2)" COEFFS 0 1024 0 0 0 1 /end COMPU_METHOD
/begin CHARACTERISTIC TMJ_TinKt_Tin "General # TMJ_TinKt_Tin" VAL_BLK 0x00162EDA /* @ECU_Address@TMJ_TinKt_Tin@0x021D1000@ */ ECIPP_ALIGNMENT_SWORD 564 Compu_TMJ_TinKt_Tin -1484 563.96875 MATRIX_DIM 16 1 1 /end CHARACTERISTIC
/begin COMPU_METHOD Compu_TMJ_TinKt_Tin " " RAT_FUNC "%.3" "(deg F)" COEFFS 0 32 14720 0 0 1 /end COMPU_METHOD
/begin CHARACTERISTIC PW_emg_data "General # PW_emg_data" VAL_BLK 0x00162BE2 /* @ECU_Address@PW_emg_data@0x021D2000@ */ ECIPP_ALIGNMENT_SWORD 2048 Compu_PW_emg_data -2048 2047.9375 MATRIX_DIM 16 1 1 /end CHARACTERISTIC
/begin COMPU_METHOD Compu_PW_emg_data " " RAT_FUNC "%.3" "(mg/inj)" COEFFS 0 16 0 0 0 1 /end COMPU_METHOD
/begin CHARACTERISTIC PW_ems_data "General # PW_ems_data" VAL_BLK 0x00162C02 /* @ECU_Address@PW_ems_data@0x021D3000@ */ ECIPP_ALIGNMENT_SWORD 1024 Compu_PW_ems_data -1024 1023.96875 MATRIX_DIM 16 1 1 /end CHARACTERISTIC
/begin COMPU_METHOD Compu_PW_ems_data " " RAT_FUNC "%.3" "(ms)" COEFFS 0 32 0 0 0 1 /end COMPU_METHOD
/begin CHARACTERISTIC PW_mg_data "General # PW_mg_data" VAL_BLK 0x00162C22 /* @ECU_Address@PW_mg_data@0x021D4000@ */ ECIPP_ALIGNMENT_SWORD 512 Compu_PW_mg_data -512 511.984375 MATRIX_DIM 16 1 1 /end CHARACTERISTIC
/begin COMPU_METHOD Compu_PW_mg_data " " RAT_FUNC "%.3" "(mg/inj)" COEFFS 0 64 0 0 0 1 /end COMPU_METHOD
/begin CHARACTERISTIC PW_ms_data "General # PW_ms_data" VAL_BLK 0x00162C62 /* @ECU_Address@PW_ms_data@0x021D5000@ */ ECIPP_ALIGNMENT_SWORD 105 Compu_PW_ms_data -104.8576 104.8544 MATRIX_DIM 16 1 1 /end CHARACTERISTIC
/begin COMPU_METHOD Compu_PW_ms_data " " RAT_FUNC "%.3" "(ms)" COEFFS 0 312.5 0 0 0 1 /end COMPU_METHOD
/begin CHARACTERISTIC TTM_TinKt_Kt "General # TTM_TinKt_Kt" VAL_BLK 0x0016329A /* @ECU_Address@TTM_TinKt_Kt@0x021D8000@ */ ECIPP_ALIGNMENT_SWORD 32 Compu_TTM_TinKt_Kt -32 31.9990234375 MATRIX_DIM 16 1 1 /end CHARACTERISTIC
/begin COMPU_METHOD Compu_TTM_TinKt_Kt " " RAT_FUNC "%.3" "(g/sec/psia/in^2)" COEFFS 0 1024 0 0 0 1 /end COMPU_METHOD
/begin CHARACTERISTIC TTM_TinKt_Tin "General # TTM_TinKt_Tin" VAL_BLK 0x001632BA /* @ECU_Address@TTM_TinKt_Tin@0x021D9000@ */ ECIPP_ALIGNMENT_SWORD 564 Compu_TTM_TinKt_Tin -1484 563.96875 MATRIX_DIM 16 1 1 /end CHARACTERISTIC
/begin COMPU_METHOD Compu_TTM_TinKt_Tin " " RAT_FUNC "%.3" "(deg F)" COEFFS 0 32 14720 0 0 1 /end COMPU_METHOD
/begin CHARACTERISTIC TVEmod_ECT_ECT "General # TVEmod_ECT_ECT" VAL_BLK 0x001632DA /* @ECU_Address@TVEmod_ECT_ECT@0x021DA000@ */ ECIPP_ALIGNMENT_SWORD 564 Compu_TVEmod_ECT_ECT -1484 563.96875 MATRIX_DIM 16 1 1 /end CHARACTERISTIC
/begin COMPU_METHOD Compu_TVEmod_ECT_ECT " " RAT_FUNC "%.3" "(deg F)" COEFFS 0 32 14720 0 0 1 /end COMPU_METHOD
/begin CHARACTERISTIC TVEmod_MAT_MAT "General # TVEmod_MAT_MAT" VAL_BLK 0x0016331A /* @ECU_Address@TVEmod_MAT_MAT@0x021DC000@ */ ECIPP_ALIGNMENT_SWORD 564 Compu_TVEmod_MAT_MAT -1484 563.96875 MATRIX_DIM 16 1 1 /end CHARACTERISTIC
/begin COMPU_METHOD Compu_TVEmod_MAT_MAT " " RAT_FUNC "%.3" "(deg F)" COEFFS 0 32 14720 0 0 1 /end COMPU_METHOD
/begin CHARACTERISTIC WGPcal_V "General # WGPcal_V" VAL_BLK 0x0014657A /* @ECU_Address@WGPcal_V@0x021DF000@ */ ECIPP_ALIGNMENT_SWORD 5 Compu_WGPcal_V -5 4.99984741210938 MATRIX_DIM 2 1 1 /end CHARACTERISTIC
/begin COMPU_METHOD Compu_WGPcal_V " " RAT_FUNC "%.3" "(volts)" COEFFS 0 6553.6 0 0 0 1 /end COMPU_METHOD
/begin CHARACTERISTIC WGPcal_P "General # WGPcal_P" VAL_BLK 0x00146576 /* @ECU_Address@WGPcal_P@0x021E0000@ */ ECIPP_ALIGNMENT_SWORD 128 Compu_WGPcal_P -128 127.99609375 MATRIX_DIM 2 1 1 /end CHARACTERISTIC
/begin COMPU_METHOD Compu_WGPcal_P " " RAT_FUNC "%.3" "-" COEFFS 0 256 0 0 0 1 /end COMPU_METHOD
/begin CHARACTERISTIC TIAT_ohms "IOConfig # TIAT_ohms" VAL_BLK 0x00161940 /* @ECU_Address@TIAT_ohms@0x021ED000@ */ ECIPP_ALIGNMENT_FLOAT32_IEEE 10000000000 Compu_TIAT_ohms -10000000000 10000000000 MATRIX_DIM 16 1 1 /end CHARACTERISTIC
/begin COMPU_METHOD Compu_TIAT_ohms " " RAT_FUNC "%.3" "Ohms" COEFFS 0 1 0 0 0 1 /end COMPU_METHOD
/begin CHARACTERISTIC TECT_ohms "IOConfig # TECT_ohms" VAL_BLK 0x00143AD0 /* @ECU_Address@TECT_ohms@0x021EE000@ */ ECIPP_ALIGNMENT_FLOAT32_IEEE 10000000000 Compu_TECT_ohms -10000000000 10000000000 MATRIX_DIM 16 1 1 /end CHARACTERISTIC
/begin COMPU_METHOD Compu_TECT_ohms " " RAT_FUNC "%.3" "Ohms" COEFFS 0 1 0 0 0 1 /end COMPU_METHOD
/begin CHARACTERISTIC TFT_ohms "IOConfig # TFT_ohms" VAL_BLK 0x001617E0 /* @ECU_Address@TFT_ohms@0x021EF000@ */ ECIPP_ALIGNMENT_FLOAT32_IEEE 10000000000 Compu_TFT_ohms -10000000000 10000000000 MATRIX_DIM 16 1 1 /end CHARACTERISTIC
/begin COMPU_METHOD Compu_TFT_ohms " " RAT_FUNC "%.3" "Ohms" COEFFS 0 1 0 0 0 1 /end COMPU_METHOD
/begin CHARACTERISTIC TCHT_ohms "IOConfig # TCHT_ohms" VAL_BLK 0x001615E0 /* @ECU_Address@TCHT_ohms@0x021F0000@ */ ECIPP_ALIGNMENT_FLOAT32_IEEE 10000000000 Compu_TCHT_ohms -10000000000 10000000000 MATRIX_DIM 16 1 1 /end CHARACTERISTIC
/begin COMPU_METHOD Compu_TCHT_ohms " " RAT_FUNC "%.3" "Ohms" COEFFS 0 1 0 0 0 1 /end COMPU_METHOD
/begin CHARACTERISTIC TFTgaseous_ohms "IOConfig # TFTgaseous_ohms" VAL_BLK 0x00161860 /* @ECU_Address@TFTgaseous_ohms@0x021F1000@ */ ECIPP_ALIGNMENT_FLOAT32_IEEE 10000000000 Compu_TFTgaseous_ohms -10000000000 10000000000 MATRIX_DIM 16 1 1 /end CHARACTERISTIC
/begin COMPU_METHOD Compu_TFTgaseous_ohms " " RAT_FUNC "%.3" "Ohms" COEFFS 0 1 0 0 0 1 /end COMPU_METHOD
/begin CHARACTERISTIC TFTT_ohms "IOConfig # TFTT_ohms" VAL_BLK 0x00161760 /* @ECU_Address@TFTT_ohms@0x021F2000@ */ ECIPP_ALIGNMENT_FLOAT32_IEEE 10000000000 Compu_TFTT_ohms -10000000000 10000000000 MATRIX_DIM 16 1 1 /end CHARACTERISTIC
/begin COMPU_METHOD Compu_TFTT_ohms " " RAT_FUNC "%.3" "Ohms" COEFFS 0 1 0 0 0 1 /end COMPU_METHOD
/begin CHARACTERISTIC TFST_ohms "IOConfig # TFST_ohms" VAL_BLK 0x001616E0 /* @ECU_Address@TFST_ohms@0x021F3000@ */ ECIPP_ALIGNMENT_FLOAT32_IEEE 10000000000 Compu_TFST_ohms -10000000000 10000000000 MATRIX_DIM 16 1 1 /end CHARACTERISTIC
/begin COMPU_METHOD Compu_TFST_ohms " " RAT_FUNC "%.3" "Ohms" COEFFS 0 1 0 0 0 1 /end COMPU_METHOD
/begin CHARACTERISTIC TEMWT_ohms "IOConfig # TEMWT_ohms" VAL_BLK 0x00161660 /* @ECU_Address@TEMWT_ohms@0x021F4000@ */ ECIPP_ALIGNMENT_FLOAT32_IEEE 10000000000 Compu_TEMWT_ohms -10000000000 10000000000 MATRIX_DIM 16 1 1 /end CHARACTERISTIC
/begin COMPU_METHOD Compu_TEMWT_ohms " " RAT_FUNC "%.3" "Ohms" COEFFS 0 1 0 0 0 1 /end COMPU_METHOD
/begin CHARACTERISTIC TUEGOB_Vheater "CL # TUEGOB_Vheater" VAL_BLK 0x001493CA /* @ECU_Address@TUEGOB_Vheater@0x0222C000@ */ ECIPP_ALIGNMENT_SWORD 32 Compu_TUEGOB_Vheater -32 31.9990234375 MATRIX_DIM 16 1 1 /end CHARACTERISTIC
/begin COMPU_METHOD Compu_TUEGOB_Vheater " " RAT_FUNC "%.3" "Cmd (volts)" COEFFS 0 1024 0 0 0 1 /end COMPU_METHOD
/begin CHARACTERISTIC TUEGOB_Vheater_sec "CL # TUEGOB_Vheater_sec" VAL_BLK 0x001493EA /* @ECU_Address@TUEGOB_Vheater_sec@0x02234000@ */ ECIPP_ALIGNMENT_SWORD 524 Compu_TUEGOB_Vheater_sec -524.288 524.272 MATRIX_DIM 16 1 1 /end CHARACTERISTIC
/begin COMPU_METHOD Compu_TUEGOB_Vheater_sec " " RAT_FUNC "%.3" "(seconds)" COEFFS 0 62.5 0 0 0 1 /end COMPU_METHOD
/begin CHARACTERISTIC KNKHst_Tbl_RPMdf "FaultConfig # KNKHst_Tbl_RPMdf" VAL_BLK 0x0016C3A2 /* @ECU_Address@KNKHst_Tbl_RPMdf@0x02235000@ */ ECIPP_ALIGNMENT_UWORD 65535 Compu_KNKHst_Tbl_RPMdf 0 65535 MATRIX_DIM 6 1 1 /end CHARACTERISTIC
/begin COMPU_METHOD Compu_KNKHst_Tbl_RPMdf " " RAT_FUNC "%.0" "-" COEFFS 0 1 0 0 0 1 /end COMPU_METHOD
/begin CHARACTERISTIC KNKHst_Tbl_MAPdf "FaultConfig # KNKHst_Tbl_MAPdf" VAL_BLK 0x0016C396 /* @ECU_Address@KNKHst_Tbl_MAPdf@0x02236000@ */ ECIPP_ALIGNMENT_UWORD 256 Compu_KNKHst_Tbl_MAPdf 0 255.99609375 MATRIX_DIM 6 1 1 /end CHARACTERISTIC
/begin COMPU_METHOD Compu_KNKHst_Tbl_MAPdf " " RAT_FUNC "%.3" "MAP load (psia)" COEFFS 0 256 0 0 0 1 /end COMPU_METHOD
/begin MEASUREMENT KNKHst_Tbl_RPM "General # KNKHst_Tbl_RPM" UWORD Compu_KNKHst_Tbl_RPM 0 0 0 65535 ECU_ADDRESS 0x02237000 MATRIX_DIM 6 1 1 /end MEASUREMENT
/begin COMPU_METHOD Compu_KNKHst_Tbl_RPM " " RAT_FUNC "%.0" "Speed (rpm)" COEFFS 0 1 0 0 0 1 /end COMPU_METHOD
/begin MEASUREMENT KNKHst_Tbl_MAP "General # KNKHst_Tbl_MAP" UWORD Compu_KNKHst_Tbl_MAP 0 0 0 255.99609375 ECU_ADDRESS 0x02238000 MATRIX_DIM 6 1 1 /end MEASUREMENT
/begin COMPU_METHOD Compu_KNKHst_Tbl_MAP " " RAT_FUNC "%.1" "MAP (psia)" COEFFS 0 256 0 0 0 1 /end COMPU_METHOD
/begin CHARACTERISTIC STR_Calibration_File "General # STR_Calibration_File" ASCII 0x0016644C /* @ECU_Address@STR_Calibration_File@0x0223A000@ */ ECIPP_ALIGNMENT_UBYTE 255 Compu_ECIPP_STRINGS 0 255 MATRIX_DIM 199 1 1 /end CHARACTERISTIC
/begin CHARACTERISTIC STR_ECTgd_comment "General # STR_ECTgd_comment" ASCII 0x00166514 /* @ECU_Address@STR_ECTgd_comment@0x0223B000@ */ ECIPP_ALIGNMENT_UBYTE 255 Compu_ECIPP_STRINGS 0 255 MATRIX_DIM 39 1 1 /end CHARACTERISTIC
/begin CHARACTERISTIC STR_EGOCmt "General # STR_EGOCmt" ASCII 0x0016653C /* @ECU_Address@STR_EGOCmt@0x0223C000@ */ ECIPP_ALIGNMENT_UBYTE 255 Compu_ECIPP_STRINGS 0 255 MATRIX_DIM 99 1 1 /end CHARACTERISTIC
/begin CHARACTERISTIC STR_EGOCmtNG "General # STR_EGOCmtNG" ASCII 0x001665A0 /* @ECU_Address@STR_EGOCmtNG@0x0223D000@ */ ECIPP_ALIGNMENT_UBYTE 255 Compu_ECIPP_STRINGS 0 255 MATRIX_DIM 99 1 1 /end CHARACTERISTIC
/begin CHARACTERISTIC STR_EGOCmtP "General # STR_EGOCmtP" ASCII 0x00166604 /* @ECU_Address@STR_EGOCmtP@0x0223E000@ */ ECIPP_ALIGNMENT_UBYTE 255 Compu_ECIPP_STRINGS 0 255 MATRIX_DIM 99 1 1 /end CHARACTERISTIC
/begin CHARACTERISTIC STR_Eng_Description "General # STR_Eng_Description" ASCII 0x00166668 /* @ECU_Address@STR_Eng_Description@0x0223F000@ */ ECIPP_ALIGNMENT_UBYTE 255 Compu_ECIPP_STRINGS 0 255 MATRIX_DIM 199 1 1 /end CHARACTERISTIC
/begin CHARACTERISTIC STR_IgnAdvCmt "General # STR_IgnAdvCmt" ASCII 0x00166730 /* @ECU_Address@STR_IgnAdvCmt@0x02240000@ */ ECIPP_ALIGNMENT_UBYTE 255 Compu_ECIPP_STRINGS 0 255 MATRIX_DIM 99 1 1 /end CHARACTERISTIC
/begin CHARACTERISTIC STR_LPCarb_cmnt "General # STR_LPCarb_cmnt" ASCII 0x00166794 /* @ECU_Address@STR_LPCarb_cmnt@0x02241000@ */ ECIPP_ALIGNMENT_UBYTE 255 Compu_ECIPP_STRINGS 0 255 MATRIX_DIM 59 1 1 /end CHARACTERISTIC
/begin CHARACTERISTIC STR_LPtrim_cmnt "General # STR_LPtrim_cmnt" ASCII 0x00166898 /* @ECU_Address@STR_LPtrim_cmnt@0x02242000@ */ ECIPP_ALIGNMENT_UBYTE 255 Compu_ECIPP_STRINGS 0 255 MATRIX_DIM 59 1 1 /end CHARACTERISTIC
/begin CHARACTERISTIC STR_Model_Year "General # STR_Model_Year" ASCII 0x001668D4 /* @ECU_Address@STR_Model_Year@0x02243000@ */ ECIPP_ALIGNMENT_UBYTE 255 Compu_ECIPP_STRINGS 0 255 MATRIX_DIM 159 1 1 /end CHARACTERISTIC
/begin CHARACTERISTIC STR_NGCarb_cmnt "General # STR_NGCarb_cmnt" ASCII 0x00166974 /* @ECU_Address@STR_NGCarb_cmnt@0x02244000@ */ ECIPP_ALIGNMENT_UBYTE 255 Compu_ECIPP_STRINGS 0 255 MATRIX_DIM 59 1 1 /end CHARACTERISTIC
/begin CHARACTERISTIC STR_NGtrim_cmnt "General # STR_NGtrim_cmnt" ASCII 0x00166A78 /* @ECU_Address@STR_NGtrim_cmnt@0x02245000@ */ ECIPP_ALIGNMENT_UBYTE 255 Compu_ECIPP_STRINGS 0 255 MATRIX_DIM 59 1 1 /end CHARACTERISTIC
/begin CHARACTERISTIC STR_OilPgd_comment "General # STR_OilPgd_comment" ASCII 0x00166CB4 /* @ECU_Address@STR_OilPgd_comment@0x02246000@ */ ECIPP_ALIGNMENT_UBYTE 255 Compu_ECIPP_STRINGS 0 255 MATRIX_DIM 39 1 1 /end CHARACTERISTIC
/begin CHARACTERISTIC STR_PhiCmt "General # STR_PhiCmt" ASCII 0x00166CDC /* @ECU_Address@STR_PhiCmt@0x02247000@ */ ECIPP_ALIGNMENT_UBYTE 255 Compu_ECIPP_STRINGS 0 255 MATRIX_DIM 99 1 1 /end CHARACTERISTIC
/begin CHARACTERISTIC STR_PhiCmtNG "General # STR_PhiCmtNG" ASCII 0x00166D40 /* @ECU_Address@STR_PhiCmtNG@0x02248000@ */ ECIPP_ALIGNMENT_UBYTE 255 Compu_ECIPP_STRINGS 0 255 MATRIX_DIM 99 1 1 /end CHARACTERISTIC
/begin CHARACTERISTIC STR_PhiCmtP "General # STR_PhiCmtP" ASCII 0x00166DA4 /* @ECU_Address@STR_PhiCmtP@0x02249000@ */ ECIPP_ALIGNMENT_UBYTE 255 Compu_ECIPP_STRINGS 0 255 MATRIX_DIM 99 1 1 /end CHARACTERISTIC
/begin CHARACTERISTIC STR_PhicoldCmt "General # STR_PhicoldCmt" ASCII 0x00166E08 /* @ECU_Address@STR_PhicoldCmt@0x0224A000@ */ ECIPP_ALIGNMENT_UBYTE 255 Compu_ECIPP_STRINGS 0 255 MATRIX_DIM 99 1 1 /end CHARACTERISTIC
/begin CHARACTERISTIC STR_PhicoldCmtN "General # STR_PhicoldCmtN" ASCII 0x00166E6C /* @ECU_Address@STR_PhicoldCmtN@0x0224B000@ */ ECIPP_ALIGNMENT_UBYTE 255 Compu_ECIPP_STRINGS 0 255 MATRIX_DIM 99 1 1 /end CHARACTERISTIC
/begin CHARACTERISTIC STR_PhicoldCmtP "General # STR_PhicoldCmtP" ASCII 0x00166ED0 /* @ECU_Address@STR_PhicoldCmtP@0x0224C000@ */ ECIPP_ALIGNMENT_UBYTE 255 Compu_ECIPP_STRINGS 0 255 MATRIX_DIM 99 1 1 /end CHARACTERISTIC
/begin CHARACTERISTIC STR_PhitranCmt "General # STR_PhitranCmt" ASCII 0x00166F34 /* @ECU_Address@STR_PhitranCmt@0x0224D000@ */ ECIPP_ALIGNMENT_UBYTE 255 Compu_ECIPP_STRINGS 0 255 MATRIX_DIM 99 1 1 /end CHARACTERISTIC
/begin CHARACTERISTIC STR_PhitranCmtN "General # STR_PhitranCmtN" ASCII 0x00166F98 /* @ECU_Address@STR_PhitranCmtN@0x0224E000@ */ ECIPP_ALIGNMENT_UBYTE 255 Compu_ECIPP_STRINGS 0 255 MATRIX_DIM 99 1 1 /end CHARACTERISTIC
/begin CHARACTERISTIC STR_PhitranCmtP "General # STR_PhitranCmtP" ASCII 0x00166FFC /* @ECU_Address@STR_PhitranCmtP@0x0224F000@ */ ECIPP_ALIGNMENT_UBYTE 255 Compu_ECIPP_STRINGS 0 255 MATRIX_DIM 99 1 1 /end CHARACTERISTIC
/begin CHARACTERISTIC STR_LP_postcat_phi "General # STR_LP_postcat_phi" ASCII 0x00166834 /* @ECU_Address@STR_LP_postcat_phi@0x02250000@ */ ECIPP_ALIGNMENT_UBYTE 255 Compu_ECIPP_STRINGS 0 255 MATRIX_DIM 99 1 1 /end CHARACTERISTIC
/begin CHARACTERISTIC STR_NG_postcat_phi "General # STR_NG_postcat_phi" ASCII 0x00166A14 /* @ECU_Address@STR_NG_postcat_phi@0x02251000@ */ ECIPP_ALIGNMENT_UBYTE 255 Compu_ECIPP_STRINGS 0 255 MATRIX_DIM 99 1 1 /end CHARACTERISTIC
/begin CHARACTERISTIC STR_postcat_phi "General # STR_postcat_phi" ASCII 0x001695A0 /* @ECU_Address@STR_postcat_phi@0x02252000@ */ ECIPP_ALIGNMENT_UBYTE 255 Compu_ECIPP_STRINGS 0 255 MATRIX_DIM 99 1 1 /end CHARACTERISTIC
/begin CHARACTERISTIC STR_Update_Comment "General # STR_Update_Comment" ASCII 0x00169130 /* @ECU_Address@STR_Update_Comment@0x02253000@ */ ECIPP_ALIGNMENT_UBYTE 255 Compu_ECIPP_STRINGS 0 255 MATRIX_DIM 259 1 1 /end CHARACTERISTIC
/begin CHARACTERISTIC STR_V1gd_comment "General # STR_V1gd_comment" ASCII 0x00169234 /* @ECU_Address@STR_V1gd_comment@0x02254000@ */ ECIPP_ALIGNMENT_UBYTE 255 Compu_ECIPP_STRINGS 0 255 MATRIX_DIM 39 1 1 /end CHARACTERISTIC
/begin CHARACTERISTIC STR_VECmt "General # STR_VECmt" ASCII 0x0016925C /* @ECU_Address@STR_VECmt@0x02255000@ */ ECIPP_ALIGNMENT_UBYTE 255 Compu_ECIPP_STRINGS 0 255 MATRIX_DIM 159 1 1 /end CHARACTERISTIC
/begin CHARACTERISTIC STR_Vehicle "General # STR_Vehicle" ASCII 0x001692FC /* @ECU_Address@STR_Vehicle@0x02256000@ */ ECIPP_ALIGNMENT_UBYTE 255 Compu_ECIPP_STRINGS 0 255 MATRIX_DIM 199 1 1 /end CHARACTERISTIC
/begin CHARACTERISTIC STR_fuelinj_desc "General # STR_fuelinj_desc" ASCII 0x0016949C /* @ECU_Address@STR_fuelinj_desc@0x02257000@ */ ECIPP_ALIGNMENT_UBYTE 255 Compu_ECIPP_STRINGS 0 255 MATRIX_DIM 99 1 1 /end CHARACTERISTIC
/begin CHARACTERISTIC TOCTadpt_init "Spark # TOCTadpt_init" VAL_BLK 0x0014389E /* @ECU_Address@TOCTadpt_init@0x0225B000@ */ ECIPP_ALIGNMENT_SWORD 100 Compu_TOCTadpt_init -100 99.9969482421875 MATRIX_DIM 20 1 1 /end CHARACTERISTIC
/begin COMPU_METHOD Compu_TOCTadpt_init "" RAT_FUNC "%.3" "-" COEFFS 0 327.68 0 0 0 1 /end COMPU_METHOD
/begin CHARACTERISTIC TCRI_rho_Prail "Fuel # TCRI_rho_Prail" VAL_BLK 0x00162CCA /* @ECU_Address@TCRI_rho_Prail@0x02287000@ */ ECIPP_ALIGNMENT_SWORD 4096 Compu_TCRI_rho_Prail -4096 4095.875 MATRIX_DIM 8 1 1 /end CHARACTERISTIC
/begin COMPU_METHOD Compu_TCRI_rho_Prail " " RAT_FUNC "%.3" "-" COEFFS 0 8 0 0 0 1 /end COMPU_METHOD
/begin CHARACTERISTIC TCRI_rho_FRT "Fuel # TCRI_rho_FRT" VAL_BLK 0x00162CC2 /* @ECU_Address@TCRI_rho_FRT@0x02288000@ */ ECIPP_ALIGNMENT_SWORD 564 Compu_TCRI_rho_FRT -1484 563.96875 MATRIX_DIM 4 1 1 /end CHARACTERISTIC
/begin COMPU_METHOD Compu_TCRI_rho_FRT " " RAT_FUNC "%.3" "Fuel Rail Temperature (deg F)" COEFFS 0 32 14720 0 0 1 /end COMPU_METHOD
/begin CHARACTERISTIC TPW_VC_volts_I2 "Fuel # TPW_VC_volts_I2" VAL_BLK 0x00162F9A /* @ECU_Address@TPW_VC_volts_I2@0x022A0000@ */ ECIPP_ALIGNMENT_SWORD 128 Compu_TPW_VC_volts_I2 -128 127.99609375 MATRIX_DIM 16 1 1 /end CHARACTERISTIC
/begin COMPU_METHOD Compu_TPW_VC_volts_I2 " " RAT_FUNC "%.3" "(volts)" COEFFS 0 256 0 0 0 1 /end COMPU_METHOD
/begin CHARACTERISTIC TPW_VC_time_I2 "Fuel # TPW_VC_time_I2" VAL_BLK 0x00162F5A /* @ECU_Address@TPW_VC_time_I2@0x022A1000@ */ ECIPP_ALIGNMENT_SWORD 105 Compu_TPW_VC_time_I2 -104.8576 104.8544 MATRIX_DIM 16 1 1 /end CHARACTERISTIC
/begin COMPU_METHOD Compu_TPW_VC_time_I2 " " RAT_FUNC "%.3" "(ms)" COEFFS 0 312.5 0 0 0 1 /end COMPU_METHOD
/begin CHARACTERISTIC PW_mg_data_I2 "General # PW_mg_data_I2" VAL_BLK 0x00162C42 /* @ECU_Address@PW_mg_data_I2@0x022A2000@ */ ECIPP_ALIGNMENT_SWORD 512 Compu_PW_mg_data_I2 -512 511.984375 MATRIX_DIM 16 1 1 /end CHARACTERISTIC
/begin COMPU_METHOD Compu_PW_mg_data_I2 " " RAT_FUNC "%.3" "(mg/inj)" COEFFS 0 64 0 0 0 1 /end COMPU_METHOD
/begin CHARACTERISTIC PW_ms_data_I2 "General # PW_ms_data_I2" VAL_BLK 0x00162C82 /* @ECU_Address@PW_ms_data_I2@0x022A3000@ */ ECIPP_ALIGNMENT_SWORD 105 Compu_PW_ms_data_I2 -104.8576 104.8544 MATRIX_DIM 16 1 1 /end CHARACTERISTIC
/begin COMPU_METHOD Compu_PW_ms_data_I2 " " RAT_FUNC "%.3" "(ms)" COEFFS 0 312.5 0 0 0 1 /end COMPU_METHOD
/begin CHARACTERISTIC FPcal_P_I2 "IOConfig # FPcal_P_I2" VAL_BLK 0x001442FA /* @ECU_Address@FPcal_P_I2@0x022A7000@ */ ECIPP_ALIGNMENT_SWORD 256 Compu_FPcal_P_I2 -256 255.9921875 MATRIX_DIM 2 1 1 /end CHARACTERISTIC
/begin COMPU_METHOD Compu_FPcal_P_I2 " " RAT_FUNC "%.3" "-" COEFFS 0 128 0 0 0 1 /end COMPU_METHOD
/begin CHARACTERISTIC CAD_TDC_cyl_shift "IOConfig # CAD_TDC_cyl_shift" VAL_BLK 0x00162BA4 /* @ECU_Address@CAD_TDC_cyl_shift@0x022A8000@ */ ECIPP_ALIGNMENT_SWORD 2048 Compu_CAD_TDC_cyl_shift -2048 2047.9375 MATRIX_DIM 10 1 1 /end CHARACTERISTIC
/begin COMPU_METHOD Compu_CAD_TDC_cyl_shift " " RAT_FUNC "%.3" "(CAD ATDC nominal)" COEFFS 0 16 0 0 0 1 /end COMPU_METHOD
/begin CHARACTERISTIC STR_engine_defVIN "General # STR_engine_defVIN" ASCII 0x00169488 /* @ECU_Address@STR_engine_defVIN@0x022AA000@ */ ECIPP_ALIGNMENT_UBYTE 255 Compu_ECIPP_STRINGS 0 255 MATRIX_DIM 19 1 1 /end CHARACTERISTIC
/begin CHARACTERISTIC TTAUXA_TAUXA "General # TTAUXA_TAUXA" VAL_BLK 0x00161A80 /* @ECU_Address@TTAUXA_TAUXA@0x022BA000@ */ ECIPP_ALIGNMENT_FLOAT32_IEEE 10000000000 Compu_TTAUXA_TAUXA -10000000000 10000000000 MATRIX_DIM 16 1 1 /end CHARACTERISTIC
/begin COMPU_METHOD Compu_TTAUXA_TAUXA " " RAT_FUNC "%.3" "Temp (deg F)" COEFFS 0 1 460 0 0 1 /end COMPU_METHOD
/begin CHARACTERISTIC TTAUXB_TAUXB "General # TTAUXB_TAUXB" VAL_BLK 0x00161B00 /* @ECU_Address@TTAUXB_TAUXB@0x022BB000@ */ ECIPP_ALIGNMENT_FLOAT32_IEEE 10000000000 Compu_TTAUXB_TAUXB -10000000000 10000000000 MATRIX_DIM 16 1 1 /end CHARACTERISTIC
/begin COMPU_METHOD Compu_TTAUXB_TAUXB " " RAT_FUNC "%.3" "Temp (deg F)" COEFFS 0 1 460 0 0 1 /end COMPU_METHOD
/begin CHARACTERISTIC TTAUXC_TAUXC "General # TTAUXC_TAUXC" VAL_BLK 0x00161B80 /* @ECU_Address@TTAUXC_TAUXC@0x022BC000@ */ ECIPP_ALIGNMENT_FLOAT32_IEEE 10000000000 Compu_TTAUXC_TAUXC -10000000000 10000000000 MATRIX_DIM 16 1 1 /end CHARACTERISTIC
/begin COMPU_METHOD Compu_TTAUXC_TAUXC " " RAT_FUNC "%.3" "Temp (deg F)" COEFFS 0 1 460 0 0 1 /end COMPU_METHOD
/begin CHARACTERISTIC TTAUXD_TAUXD "General # TTAUXD_TAUXD" VAL_BLK 0x00161C00 /* @ECU_Address@TTAUXD_TAUXD@0x022BD000@ */ ECIPP_ALIGNMENT_FLOAT32_IEEE 10000000000 Compu_TTAUXD_TAUXD -10000000000 10000000000 MATRIX_DIM 16 1 1 /end CHARACTERISTIC
/begin COMPU_METHOD Compu_TTAUXD_TAUXD " " RAT_FUNC "%.3" "Temp (deg F)" COEFFS 0 1 460 0 0 1 /end COMPU_METHOD
/begin CHARACTERISTIC TTAUXA_ohms "IOConfig # TTAUXA_ohms" VAL_BLK 0x00161AC0 /* @ECU_Address@TTAUXA_ohms@0x022BE000@ */ ECIPP_ALIGNMENT_FLOAT32_IEEE 10000000000 Compu_TTAUXA_ohms -10000000000 10000000000 MATRIX_DIM 16 1 1 /end CHARACTERISTIC
/begin COMPU_METHOD Compu_TTAUXA_ohms " " RAT_FUNC "%.3" "Ohms" COEFFS 0 1 0 0 0 1 /end COMPU_METHOD
/begin CHARACTERISTIC TTAUXB_ohms "IOConfig # TTAUXB_ohms" VAL_BLK 0x00161B40 /* @ECU_Address@TTAUXB_ohms@0x022BF000@ */ ECIPP_ALIGNMENT_FLOAT32_IEEE 10000000000 Compu_TTAUXB_ohms -10000000000 10000000000 MATRIX_DIM 16 1 1 /end CHARACTERISTIC
/begin COMPU_METHOD Compu_TTAUXB_ohms " " RAT_FUNC "%.3" "Ohms" COEFFS 0 1 0 0 0 1 /end COMPU_METHOD
/begin CHARACTERISTIC TTAUXC_ohms "IOConfig # TTAUXC_ohms" VAL_BLK 0x00161BC0 /* @ECU_Address@TTAUXC_ohms@0x022C0000@ */ ECIPP_ALIGNMENT_FLOAT32_IEEE 10000000000 Compu_TTAUXC_ohms -10000000000 10000000000 MATRIX_DIM 16 1 1 /end CHARACTERISTIC
/begin COMPU_METHOD Compu_TTAUXC_ohms " " RAT_FUNC "%.3" "Ohms" COEFFS 0 1 0 0 0 1 /end COMPU_METHOD
/begin CHARACTERISTIC TTAUXD_ohms "IOConfig # TTAUXD_ohms" VAL_BLK 0x00161C40 /* @ECU_Address@TTAUXD_ohms@0x022C1000@ */ ECIPP_ALIGNMENT_FLOAT32_IEEE 10000000000 Compu_TTAUXD_ohms -10000000000 10000000000 MATRIX_DIM 16 1 1 /end CHARACTERISTIC
/begin COMPU_METHOD Compu_TTAUXD_ohms " " RAT_FUNC "%.3" "Ohms" COEFFS 0 1 0 0 0 1 /end COMPU_METHOD
/begin CHARACTERISTIC PauxAcal_V "IOConfig # PauxAcal_V" VAL_BLK 0x001439E4 /* @ECU_Address@PauxAcal_V@0x022C2000@ */ ECIPP_ALIGNMENT_FLOAT32_IEEE 10000000000 Compu_PauxAcal_V -10000000000 10000000000 MATRIX_DIM 2 1 1 /end CHARACTERISTIC
/begin COMPU_METHOD Compu_PauxAcal_V " " RAT_FUNC "%.3" "(volts)" COEFFS 0 1 0 0 0 1 /end COMPU_METHOD
/begin CHARACTERISTIC PauxBcal_V "IOConfig # PauxBcal_V" VAL_BLK 0x001439F4 /* @ECU_Address@PauxBcal_V@0x022C3000@ */ ECIPP_ALIGNMENT_FLOAT32_IEEE 10000000000 Compu_PauxBcal_V -10000000000 10000000000 MATRIX_DIM 2 1 1 /end CHARACTERISTIC
/begin COMPU_METHOD Compu_PauxBcal_V " " RAT_FUNC "%.3" "(volts)" COEFFS 0 1 0 0 0 1 /end COMPU_METHOD
/begin CHARACTERISTIC PauxCcal_V "IOConfig # PauxCcal_V" VAL_BLK 0x00143A04 /* @ECU_Address@PauxCcal_V@0x022C4000@ */ ECIPP_ALIGNMENT_FLOAT32_IEEE 10000000000 Compu_PauxCcal_V -10000000000 10000000000 MATRIX_DIM 2 1 1 /end CHARACTERISTIC
/begin COMPU_METHOD Compu_PauxCcal_V " " RAT_FUNC "%.3" "(volts)" COEFFS 0 1 0 0 0 1 /end COMPU_METHOD
/begin CHARACTERISTIC PauxDcal_V "IOConfig # PauxDcal_V" VAL_BLK 0x00143A14 /* @ECU_Address@PauxDcal_V@0x022C5000@ */ ECIPP_ALIGNMENT_FLOAT32_IEEE 10000000000 Compu_PauxDcal_V -10000000000 10000000000 MATRIX_DIM 2 1 1 /end CHARACTERISTIC
/begin COMPU_METHOD Compu_PauxDcal_V " " RAT_FUNC "%.3" "(volts)" COEFFS 0 1 0 0 0 1 /end COMPU_METHOD
/begin CHARACTERISTIC PauxAcal_P "IOConfig # PauxAcal_P" VAL_BLK 0x001439DC /* @ECU_Address@PauxAcal_P@0x022C6000@ */ ECIPP_ALIGNMENT_FLOAT32_IEEE 10000000000 Compu_PauxAcal_P -10000000000 10000000000 MATRIX_DIM 2 1 1 /end CHARACTERISTIC
/begin COMPU_METHOD Compu_PauxAcal_P " " RAT_FUNC "%.3" "-" COEFFS 0 1 0 0 0 1 /end COMPU_METHOD
/begin CHARACTERISTIC PauxBcal_P "IOConfig # PauxBcal_P" VAL_BLK 0x001439EC /* @ECU_Address@PauxBcal_P@0x022C7000@ */ ECIPP_ALIGNMENT_FLOAT32_IEEE 10000000000 Compu_PauxBcal_P -10000000000 10000000000 MATRIX_DIM 2 1 1 /end CHARACTERISTIC
/begin COMPU_METHOD Compu_PauxBcal_P " " RAT_FUNC "%.3" "-" COEFFS 0 1 0 0 0 1 /end COMPU_METHOD
/begin CHARACTERISTIC PauxCcal_P "IOConfig # PauxCcal_P" VAL_BLK 0x001439FC /* @ECU_Address@PauxCcal_P@0x022C8000@ */ ECIPP_ALIGNMENT_FLOAT32_IEEE 10000000000 Compu_PauxCcal_P -10000000000 10000000000 MATRIX_DIM 2 1 1 /end CHARACTERISTIC
/begin COMPU_METHOD Compu_PauxCcal_P " " RAT_FUNC "%.3" "-" COEFFS 0 1 0 0 0 1 /end COMPU_METHOD
/begin CHARACTERISTIC PauxDcal_P "IOConfig # PauxDcal_P" VAL_BLK 0x00143A0C /* @ECU_Address@PauxDcal_P@0x022C9000@ */ ECIPP_ALIGNMENT_FLOAT32_IEEE 10000000000 Compu_PauxDcal_P -10000000000 10000000000 MATRIX_DIM 2 1 1 /end CHARACTERISTIC
/begin COMPU_METHOD Compu_PauxDcal_P " " RAT_FUNC "%.3" "-" COEFFS 0 1 0 0 0 1 /end COMPU_METHOD
/begin CHARACTERISTIC TMAF32_flow_Hz "Air # TMAF32_flow_Hz" VAL_BLK 0x00161980 /* @ECU_Address@TMAF32_flow_Hz@0x022D8000@ */ ECIPP_ALIGNMENT_FLOAT32_IEEE 10000000000 Compu_TMAF32_flow_Hz -10000000000 10000000000 MATRIX_DIM 32 1 1 /end CHARACTERISTIC
/begin COMPU_METHOD Compu_TMAF32_flow_Hz " " RAT_FUNC "%.3" "(Hz)" COEFFS 0 1 0 0 0 1 /end COMPU_METHOD
/begin CHARACTERISTIC TMAF32_flow_gsec "Air # TMAF32_flow_gsec" VAL_BLK 0x00161A00 /* @ECU_Address@TMAF32_flow_gsec@0x022D9000@ */ ECIPP_ALIGNMENT_FLOAT32_IEEE 10000000000 Compu_TMAF32_flow_gsec -10000000000 10000000000 MATRIX_DIM 32 1 1 /end CHARACTERISTIC
/begin COMPU_METHOD Compu_TMAF32_flow_gsec " " RAT_FUNC "%.3" "(g/sec)" COEFFS 0 1 0 0 0 1 /end COMPU_METHOD
/begin MEASUREMENT TTMTPSad_Apct "Adaptive Throttle Model TPS Area" SWORD Compu_TTMTPSad_Apct 0 0 -100 99.9969482421875 ECU_ADDRESS 0x02311000 MATRIX_DIM 20 1 1 /end MEASUREMENT
/begin COMPU_METHOD Compu_TTMTPSad_Apct " " RAT_FUNC "%.1" "Area Adapt (%)" COEFFS 0 327.68 0 0 0 1 /end COMPU_METHOD
/begin CHARACTERISTIC TTMTPSad_TPS "Air # TTMTPSad_TPS" VAL_BLK 0x00145592 /* @ECU_Address@TTMTPSad_TPS@0x02312000@ */ ECIPP_ALIGNMENT_SWORD 100 Compu_TTMTPSad_TPS -100 99.9969482421875 MATRIX_DIM 10 1 1 /end CHARACTERISTIC
/begin COMPU_METHOD Compu_TTMTPSad_TPS " " RAT_FUNC "%.1" "TPS (%)" COEFFS 0 327.68 0 0 0 1 /end COMPU_METHOD
/begin CHARACTERISTIC TTMTPSad_PR "Air # TTMTPSad_PR" VAL_BLK 0x0014558E /* @ECU_Address@TTMTPSad_PR@0x02313000@ */ ECIPP_ALIGNMENT_SWORD 1 Compu_TTMTPSad_PR -1 0.999969482421875 MATRIX_DIM 2 1 1 /end CHARACTERISTIC
/begin COMPU_METHOD Compu_TTMTPSad_PR " " RAT_FUNC "%.3" "PR (MAP/TIP)" COEFFS 0 32768 0 0 0 1 /end COMPU_METHOD
/begin CHARACTERISTIC UEGOHst_recvr_def "IOConfig # UEGOHst_recvr_def" VAL_BLK 0x0016C3FA /* @ECU_Address@UEGOHst_recvr_def@0x0232B000@ */ ECIPP_ALIGNMENT_SWORD 32767 Compu_UEGOHst_recvr_def -32768 32767 MATRIX_DIM 11 1 1 /end CHARACTERISTIC
/begin COMPU_METHOD Compu_UEGOHst_recvr_def " " RAT_FUNC "%.0" "(hours)" COEFFS 0 1 0 0 0 1 /end COMPU_METHOD
/begin CHARACTERISTIC UEGOHst_drift_def "IOConfig # UEGOHst_drift_def" VAL_BLK 0x0016C410 /* @ECU_Address@UEGOHst_drift_def@0x0232C000@ */ ECIPP_ALIGNMENT_SWORD 100 Compu_UEGOHst_drift_def -100 99.9969482421875 MATRIX_DIM 11 1 1 /end CHARACTERISTIC
/begin COMPU_METHOD Compu_UEGOHst_drift_def " " RAT_FUNC "%.3" "Error (% Ip)" COEFFS 0 327.68 0 0 0 1 /end COMPU_METHOD
/begin MEASUREMENT UEGOHst_recvr_hours "IOConfig # UEGOHst_recvr_hours" SWORD Compu_UEGOHst_recvr_hours 0 0 -32768 32767 ECU_ADDRESS 0x0232D000 MATRIX_DIM 11 1 1 /end MEASUREMENT
/begin COMPU_METHOD Compu_UEGOHst_recvr_hours " " RAT_FUNC "%.0" "Hours since recovery" COEFFS 0 1 0 0 0 1 /end COMPU_METHOD
/begin MEASUREMENT UEGOHst_drift_pct "IOConfig # UEGOHst_drift_pct" SWORD Compu_UEGOHst_drift_pct 0 0 -100 99.9969482421875 ECU_ADDRESS 0x0232E000 MATRIX_DIM 11 1 1 /end MEASUREMENT
/begin COMPU_METHOD Compu_UEGOHst_drift_pct " " RAT_FUNC "%.1" "Ip Error (%)" COEFFS 0 327.68 0 0 0 1 /end COMPU_METHOD
/begin MEASUREMENT UEGO1Hst_recoveries "UEGO1 Recoveries" UWORD Compu_UEGO1Hst_recoveries 0 0 0 65535 ECU_ADDRESS 0x0232F000 MATRIX_DIM 11 1 1 /end MEASUREMENT
/begin COMPU_METHOD Compu_UEGO1Hst_recoveries " " RAT_FUNC "%.0" "Recovs" COEFFS 0 1 0 0 0 1 /end COMPU_METHOD
/begin MEASUREMENT UEGO1Hst_drift_pre "UEGO1 Pre-recoveries" UWORD Compu_UEGO1Hst_drift_pre 0 0 0 65535 ECU_ADDRESS 0x02330000 MATRIX_DIM 11 1 1 /end MEASUREMENT
/begin COMPU_METHOD Compu_UEGO1Hst_drift_pre " " RAT_FUNC "%.0" "Pre Recovs" COEFFS 0 1 0 0 0 1 /end COMPU_METHOD
/begin MEASUREMENT UEGO1Hst_drift_post "UEGO1 Post-recoveries" UWORD Compu_UEGO1Hst_drift_post 0 0 0 65535 ECU_ADDRESS 0x02331000 MATRIX_DIM 11 1 1 /end MEASUREMENT
/begin COMPU_METHOD Compu_UEGO1Hst_drift_post " " RAT_FUNC "%.0" "Post Recovs" COEFFS 0 1 0 0 0 1 /end COMPU_METHOD
/begin MEASUREMENT UEGO2Hst_recoveries "UEGO2 Recoveries" UWORD Compu_UEGO2Hst_recoveries 0 0 0 65535 ECU_ADDRESS 0x02332000 MATRIX_DIM 11 1 1 /end MEASUREMENT
/begin COMPU_METHOD Compu_UEGO2Hst_recoveries " " RAT_FUNC "%.0" "Recovs" COEFFS 0 1 0 0 0 1 /end COMPU_METHOD
/begin MEASUREMENT UEGO2Hst_drift_pre "UEGO2 Pre-recoveries" UWORD Compu_UEGO2Hst_drift_pre 0 0 0 65535 ECU_ADDRESS 0x02333000 MATRIX_DIM 11 1 1 /end MEASUREMENT
/begin COMPU_METHOD Compu_UEGO2Hst_drift_pre " " RAT_FUNC "%.0" "Pre Recovs" COEFFS 0 1 0 0 0 1 /end COMPU_METHOD
/begin MEASUREMENT UEGO2Hst_drift_post "UEGO2 Post-recoveries" UWORD Compu_UEGO2Hst_drift_post 0 0 0 65535 ECU_ADDRESS 0x02334000 MATRIX_DIM 11 1 1 /end MEASUREMENT
/begin COMPU_METHOD Compu_UEGO2Hst_drift_post " " RAT_FUNC "%.0" "Post Recovs" COEFFS 0 1 0 0 0 1 /end COMPU_METHOD
/begin CHARACTERISTIC TTC_comp_margin "Air # TTC_comp_margin" VAL_BLK 0x0016302A /* @ECU_Address@TTC_comp_margin@0x02342000@ */ ECIPP_ALIGNMENT_SWORD 200 Compu_TTC_comp_margin -200 199.993896484375 MATRIX_DIM 4 1 1 /end CHARACTERISTIC
/begin COMPU_METHOD Compu_TTC_comp_margin " " RAT_FUNC "%.3" "Surge-Choke Margin (%)" COEFFS 0 163.84 0 0 0 1 /end COMPU_METHOD
/begin CHARACTERISTIC TTC_turb_WGA_pct "Air # TTC_turb_WGA_pct" VAL_BLK 0x00163102 /* @ECU_Address@TTC_turb_WGA_pct@0x02346000@ */ ECIPP_ALIGNMENT_SWORD 200 Compu_TTC_turb_WGA_pct -200 199.993896484375 MATRIX_DIM 8 1 1 /end CHARACTERISTIC
/begin COMPU_METHOD Compu_TTC_turb_WGA_pct " " RAT_FUNC "%.3" "WGA Position (%)" COEFFS 0 163.84 0 0 0 1 /end COMPU_METHOD
/begin CHARACTERISTIC TTC_turb_WGA_crct "Air # TTC_turb_WGA_crct" VAL_BLK 0x001630F2 /* @ECU_Address@TTC_turb_WGA_crct@0x02349000@ */ ECIPP_ALIGNMENT_SWORD 200 Compu_TTC_turb_WGA_crct -200 199.993896484375 MATRIX_DIM 8 1 1 /end CHARACTERISTIC
/begin COMPU_METHOD Compu_TTC_turb_WGA_crct " " RAT_FUNC "%.3" "-" COEFFS 0 163.84 0 0 0 1 /end COMPU_METHOD
/begin CHARACTERISTIC TTC_turb_mdot1c_Npct "Air # TTC_turb_mdot1c_Npct" VAL_BLK 0x00163192 /* @ECU_Address@TTC_turb_mdot1c_Npct@0x0234A000@ */ ECIPP_ALIGNMENT_SWORD 200 Compu_TTC_turb_mdot1c_Npct -200 199.993896484375 MATRIX_DIM 4 1 1 /end CHARACTERISTIC
/begin COMPU_METHOD Compu_TTC_turb_mdot1c_Npct " " RAT_FUNC "%.3" "Turbine Corrected Speed (% ref)" COEFFS 0 163.84 0 0 0 1 /end COMPU_METHOD
/begin CHARACTERISTIC TTM_EGRAad_PR "Air # TTM_EGRAad_PR" VAL_BLK 0x00140198 /* @ECU_Address@TTM_EGRAad_PR@0x0234F000@ */ ECIPP_ALIGNMENT_FLOAT32_IEEE 10000000000 Compu_TTM_EGRAad_PR -10000000000 10000000000 MATRIX_DIM 2 1 1 /end CHARACTERISTIC
/begin COMPU_METHOD Compu_TTM_EGRAad_PR " " RAT_FUNC "%.3" "PR (EGRLP/EGRHP)" COEFFS 0 1 0 0 0 1 /end COMPU_METHOD
/begin CHARACTERISTIC TUEGON_Vheater "CL # TUEGON_Vheater" VAL_BLK 0x00149466 /* @ECU_Address@TUEGON_Vheater@0x02350000@ */ ECIPP_ALIGNMENT_SWORD 32 Compu_TUEGON_Vheater -32 31.9990234375 MATRIX_DIM 16 1 1 /end CHARACTERISTIC
/begin COMPU_METHOD Compu_TUEGON_Vheater " " RAT_FUNC "%.3" "Cmd (volts)" COEFFS 0 1024 0 0 0 1 /end COMPU_METHOD
/begin CHARACTERISTIC TUEGON_Vheater_sec "CL # TUEGON_Vheater_sec" VAL_BLK 0x00149486 /* @ECU_Address@TUEGON_Vheater_sec@0x02351000@ */ ECIPP_ALIGNMENT_SWORD 524 Compu_TUEGON_Vheater_sec -524.288 524.272 MATRIX_DIM 16 1 1 /end CHARACTERISTIC
/begin COMPU_METHOD Compu_TUEGON_Vheater_sec " " RAT_FUNC "%.3" "(seconds)" COEFFS 0 62.5 0 0 0 1 /end COMPU_METHOD
/begin CHARACTERISTIC TCATdP_vdot "Air # TCATdP_vdot" VAL_BLK 0x0016500A /* @ECU_Address@TCATdP_vdot@0x0235E000@ */ ECIPP_ALIGNMENT_UWORD 8192 Compu_TCATdP_vdot 0 8191.875 MATRIX_DIM 8 1 1 /end CHARACTERISTIC
/begin COMPU_METHOD Compu_TCATdP_vdot " " RAT_FUNC "%.3" "-" COEFFS 0 8 0 0 0 1 /end COMPU_METHOD
/begin CHARACTERISTIC TCATdP_min "Air # TCATdP_min" VAL_BLK 0x00162CB2 /* @ECU_Address@TCATdP_min@0x0235F000@ */ ECIPP_ALIGNMENT_SWORD 32 Compu_TCATdP_min -32 31.9990234375 MATRIX_DIM 8 1 1 /end CHARACTERISTIC
/begin COMPU_METHOD Compu_TCATdP_min " " RAT_FUNC "%.3" "-" COEFFS 0 1024 0 0 0 1 /end COMPU_METHOD
/begin CHARACTERISTIC TCATdP_max "Air # TCATdP_max" VAL_BLK 0x00162CA2 /* @ECU_Address@TCATdP_max@0x02360000@ */ ECIPP_ALIGNMENT_SWORD 32 Compu_TCATdP_max -32 31.9990234375 MATRIX_DIM 8 1 1 /end CHARACTERISTIC
/begin COMPU_METHOD Compu_TCATdP_max " " RAT_FUNC "%.3" "-" COEFFS 0 1024 0 0 0 1 /end COMPU_METHOD
/begin CHARACTERISTIC TIpark_tps "IOConfig # TIpark_tps" VAL_BLK 0x00162DD2 /* @ECU_Address@TIpark_tps@0x02361000@ */ ECIPP_ALIGNMENT_SWORD 100 Compu_TIpark_tps -100 99.9969482421875 MATRIX_DIM 4 1 1 /end CHARACTERISTIC
/begin COMPU_METHOD Compu_TIpark_tps " " RAT_FUNC "%.3" "amps" COEFFS 0 327.68 0 0 0 1 /end COMPU_METHOD
/begin CHARACTERISTIC TIpark_DBW_Ilim "IOConfig # TIpark_DBW_Ilim" VAL_BLK 0x00148D70 /* @ECU_Address@TIpark_DBW_Ilim@0x02362000@ */ ECIPP_ALIGNMENT_SWORD 32 Compu_TIpark_DBW_Ilim -32 31.9990234375 MATRIX_DIM 4 1 1 /end CHARACTERISTIC
/begin COMPU_METHOD Compu_TIpark_DBW_Ilim " " RAT_FUNC "%.3" "amps" COEFFS 0 1024 0 0 0 1 /end COMPU_METHOD
/begin CHARACTERISTIC TIpark_HBA_Ilim "IOConfig # TIpark_HBA_Ilim" VAL_BLK 0x00148F44 /* @ECU_Address@TIpark_HBA_Ilim@0x02363000@ */ ECIPP_ALIGNMENT_SWORD 32 Compu_TIpark_HBA_Ilim -32 31.9990234375 MATRIX_DIM 4 1 1 /end CHARACTERISTIC
/begin COMPU_METHOD Compu_TIpark_HBA_Ilim " " RAT_FUNC "%.3" "amps" COEFFS 0 1024 0 0 0 1 /end COMPU_METHOD
/begin CHARACTERISTIC TIpark_HBB_Ilim "IOConfig # TIpark_HBB_Ilim" VAL_BLK 0x00148FE4 /* @ECU_Address@TIpark_HBB_Ilim@0x02364000@ */ ECIPP_ALIGNMENT_SWORD 32 Compu_TIpark_HBB_Ilim -32 31.9990234375 MATRIX_DIM 4 1 1 /end CHARACTERISTIC
/begin COMPU_METHOD Compu_TIpark_HBB_Ilim " " RAT_FUNC "%.3" "amps" COEFFS 0 1024 0 0 0 1 /end COMPU_METHOD
/begin CHARACTERISTIC TUEGO_1Dlmt_sec "CL # TUEGO_1Dlmt_sec" VAL_BLK 0x0014561E /* @ECU_Address@TUEGO_1Dlmt_sec@0x02365000@ */ ECIPP_ALIGNMENT_SWORD 524 Compu_TUEGO_1Dlmt_sec -524.288 524.272 MATRIX_DIM 4 1 1 /end CHARACTERISTIC
/begin COMPU_METHOD Compu_TUEGO_1Dlmt_sec " " RAT_FUNC "%.3" "(seconds)" COEFFS 0 62.5 0 0 0 1 /end COMPU_METHOD
/begin CHARACTERISTIC TUEGOB_1Dlmt_min "CL # TUEGOB_1Dlmt_min" VAL_BLK 0x0014940A /* @ECU_Address@TUEGOB_1Dlmt_min@0x02366000@ */ ECIPP_ALIGNMENT_SWORD 32 Compu_TUEGOB_1Dlmt_min -32 31.9990234375 MATRIX_DIM 4 1 1 /end CHARACTERISTIC
/begin COMPU_METHOD Compu_TUEGOB_1Dlmt_min " " RAT_FUNC "%.3" "(volts)" COEFFS 0 1024 0 0 0 1 /end COMPU_METHOD
/begin CHARACTERISTIC TUEGOB_1Dlmt_max "CL # TUEGOB_1Dlmt_max" VAL_BLK 0x00149412 /* @ECU_Address@TUEGOB_1Dlmt_max@0x02367000@ */ ECIPP_ALIGNMENT_SWORD 32 Compu_TUEGOB_1Dlmt_max -32 31.9990234375 MATRIX_DIM 4 1 1 /end CHARACTERISTIC
/begin COMPU_METHOD Compu_TUEGOB_1Dlmt_max " " RAT_FUNC "%.3" "(volts)" COEFFS 0 1024 0 0 0 1 /end COMPU_METHOD
/begin CHARACTERISTIC TUEGON_1Dlmt_min "CL # TUEGON_1Dlmt_min" VAL_BLK 0x001494A6 /* @ECU_Address@TUEGON_1Dlmt_min@0x02368000@ */ ECIPP_ALIGNMENT_SWORD 32 Compu_TUEGON_1Dlmt_min -32 31.9990234375 MATRIX_DIM 4 1 1 /end CHARACTERISTIC
/begin COMPU_METHOD Compu_TUEGON_1Dlmt_min " " RAT_FUNC "%.3" "(volts)" COEFFS 0 1024 0 0 0 1 /end COMPU_METHOD
/begin CHARACTERISTIC TUEGON_1Dlmt_max "CL # TUEGON_1Dlmt_max" VAL_BLK 0x001494AE /* @ECU_Address@TUEGON_1Dlmt_max@0x02369000@ */ ECIPP_ALIGNMENT_SWORD 32 Compu_TUEGON_1Dlmt_max -32 31.9990234375 MATRIX_DIM 4 1 1 /end CHARACTERISTIC
/begin COMPU_METHOD Compu_TUEGON_1Dlmt_max " " RAT_FUNC "%.3" "(volts)" COEFFS 0 1024 0 0 0 1 /end COMPU_METHOD
/begin CHARACTERISTIC TFauxAcal_V "IOConfig # TFauxAcal_V" VAL_BLK 0x001618B8 /* @ECU_Address@TFauxAcal_V@0x0236B000@ */ ECIPP_ALIGNMENT_FLOAT32_IEEE 10000000000 Compu_TFauxAcal_V -10000000000 10000000000 MATRIX_DIM 6 1 1 /end CHARACTERISTIC
/begin COMPU_METHOD Compu_TFauxAcal_V " " RAT_FUNC "%.3" "(volts)" COEFFS 0 1 0 0 0 1 /end COMPU_METHOD
/begin CHARACTERISTIC TFauxBcal_V "IOConfig # TFauxBcal_V" VAL_BLK 0x001618E8 /* @ECU_Address@TFauxBcal_V@0x0236C000@ */ ECIPP_ALIGNMENT_FLOAT32_IEEE 10000000000 Compu_TFauxBcal_V -10000000000 10000000000 MATRIX_DIM 6 1 1 /end CHARACTERISTIC
/begin COMPU_METHOD Compu_TFauxBcal_V " " RAT_FUNC "%.3" "(volts)" COEFFS 0 1 0 0 0 1 /end COMPU_METHOD
/begin CHARACTERISTIC TFauxAcal_F "IOConfig # TFauxAcal_F" VAL_BLK 0x001618A0 /* @ECU_Address@TFauxAcal_F@0x0236D000@ */ ECIPP_ALIGNMENT_FLOAT32_IEEE 10000000000 Compu_TFauxAcal_F -10000000000 10000000000 MATRIX_DIM 6 1 1 /end CHARACTERISTIC
/begin COMPU_METHOD Compu_TFauxAcal_F " " RAT_FUNC "%.3" "-" COEFFS 0 1 0 0 0 1 /end COMPU_METHOD
/begin CHARACTERISTIC TFauxBcal_F "IOConfig # TFauxBcal_F" VAL_BLK 0x001618D0 /* @ECU_Address@TFauxBcal_F@0x0236E000@ */ ECIPP_ALIGNMENT_FLOAT32_IEEE 10000000000 Compu_TFauxBcal_F -10000000000 10000000000 MATRIX_DIM 6 1 1 /end CHARACTERISTIC
/begin COMPU_METHOD Compu_TFauxBcal_F " " RAT_FUNC "%.3" "-" COEFFS 0 1 0 0 0 1 /end COMPU_METHOD
/begin CHARACTERISTIC TIPAdaptMAP "Gov # TIPAdaptMAP" VAL_BLK 0x00144F5E /* @ECU_Address@TIPAdaptMAP@0x02390000@ */ ECIPP_ALIGNMENT_SWORD 128 Compu_TIPAdaptMAP -128 127.99609375 MATRIX_DIM 8 1 1 /end CHARACTERISTIC
/begin COMPU_METHOD Compu_TIPAdaptMAP " " RAT_FUNC "%.1" "MAP (psia)" COEFFS 0 256 0 0 0 1 /end COMPU_METHOD
/begin CHARACTERISTIC TIPAdaptRPM "Gov # TIPAdaptRPM" VAL_BLK 0x00144F6E /* @ECU_Address@TIPAdaptRPM@0x02391000@ */ ECIPP_ALIGNMENT_SWORD 32767 Compu_TIPAdaptRPM -32768 32767 MATRIX_DIM 5 1 1 /end CHARACTERISTIC
/begin COMPU_METHOD Compu_TIPAdaptRPM " " RAT_FUNC "%.0" "Speed (rpm)" COEFFS 0 1 0 0 0 1 /end COMPU_METHOD
/begin MEASUREMENT TIPAdaptTbl "Slave TIP Adaptive Table" SWORD Compu_TIPAdaptTbl 0 0 -100 99.9969482421875 ECU_ADDRESS 0x02392000 MATRIX_DIM 40 1 1 /end MEASUREMENT
/begin COMPU_METHOD Compu_TIPAdaptTbl " " RAT_FUNC "%.1" "TIP Correction (%)" COEFFS 0 327.68 0 0 0 1 /end COMPU_METHOD
/begin CHARACTERISTIC STR_LPIgnAdvCmt "General # STR_LPIgnAdvCmt" ASCII 0x001667D0 /* @ECU_Address@STR_LPIgnAdvCmt@0x02393000@ */ ECIPP_ALIGNMENT_UBYTE 255 Compu_ECIPP_STRINGS 0 255 MATRIX_DIM 99 1 1 /end CHARACTERISTIC
/begin CHARACTERISTIC STR_NGIgnAdvCmt "General # STR_NGIgnAdvCmt" ASCII 0x001669B0 /* @ECU_Address@STR_NGIgnAdvCmt@0x02394000@ */ ECIPP_ALIGNMENT_UBYTE 255 Compu_ECIPP_STRINGS 0 255 MATRIX_DIM 99 1 1 /end CHARACTERISTIC
/begin MEASUREMENT TTM_EGRAad_in2 "EGR Valve Adaptive Effective Area" FLOAT32_IEEE Compu_TTM_EGRAad_in2 0 0 -10000000000 10000000000 ECU_ADDRESS 0x02395000 MATRIX_DIM 32 1 1 /end MEASUREMENT
/begin COMPU_METHOD Compu_TTM_EGRAad_in2 " " RAT_FUNC "%.3" "Area Adapt (in^2)" COEFFS 0 1 0 0 0 1 /end COMPU_METHOD
/begin CHARACTERISTIC TPW_VC_PCF "Fuel # TPW_VC_PCF" VAL_BLK 0x00162EFA /* @ECU_Address@TPW_VC_PCF@0x02396000@ */ ECIPP_ALIGNMENT_SWORD 0 Compu_TPW_VC_PCF -0.1024 0.102396875 MATRIX_DIM 16 1 1 /end CHARACTERISTIC
/begin COMPU_METHOD Compu_TPW_VC_PCF " " RAT_FUNC "%.3" "(ms/psi)" COEFFS 0 320000 0 0 0 1 /end COMPU_METHOD
/begin CHARACTERISTIC TPW_VC_PCF_I2 "Fuel # TPW_VC_PCF_I2" VAL_BLK 0x00162F1A /* @ECU_Address@TPW_VC_PCF_I2@0x02397000@ */ ECIPP_ALIGNMENT_SWORD 0 Compu_TPW_VC_PCF_I2 -0.1024 0.102396875 MATRIX_DIM 16 1 1 /end CHARACTERISTIC
/begin COMPU_METHOD Compu_TPW_VC_PCF_I2 " " RAT_FUNC "%.3" "(ms/psi)" COEFFS 0 320000 0 0 0 1 /end COMPU_METHOD
/begin CHARACTERISTIC TPW_VC_peak "Fuel # TPW_VC_peak" VAL_BLK 0x00165022 /* @ECU_Address@TPW_VC_peak@0x02398000@ */ ECIPP_ALIGNMENT_UWORD 210 Compu_TPW_VC_peak 0 209.712 MATRIX_DIM 16 1 1 /end CHARACTERISTIC
/begin COMPU_METHOD Compu_TPW_VC_peak " " RAT_FUNC "%.3" "Hold Time (ms)" COEFFS 0 312.5 0 0 0 1 /end COMPU_METHOD
/begin CHARACTERISTIC TPW_VC_peak_I2 "Fuel # TPW_VC_peak_I2" VAL_BLK 0x00165042 /* @ECU_Address@TPW_VC_peak_I2@0x02399000@ */ ECIPP_ALIGNMENT_UWORD 210 Compu_TPW_VC_peak_I2 0 209.712 MATRIX_DIM 16 1 1 /end CHARACTERISTIC
/begin COMPU_METHOD Compu_TPW_VC_peak_I2 " " RAT_FUNC "%.3" "Hold Time (ms)" COEFFS 0 312.5 0 0 0 1 /end COMPU_METHOD
/begin CHARACTERISTIC ECTHst_Tbl_ECT "General # ECTHst_Tbl_ECT" VAL_BLK 0x001634B4 /* @ECU_Address@ECTHst_Tbl_ECT@0x023BF000@ */ ECIPP_ALIGNMENT_UWORD 564 Compu_ECTHst_Tbl_ECT -460 563.984375 MATRIX_DIM 8 1 1 /end CHARACTERISTIC
/begin COMPU_METHOD Compu_ECTHst_Tbl_ECT " " RAT_FUNC "%.1" "ECT (degF)" COEFFS 0 64 29440 0 0 1 /end COMPU_METHOD
/begin CHARACTERISTIC TEGR_PRf_PR "Air # TEGR_PRf_PR" VAL_BLK 0x00140110 /* @ECU_Address@TEGR_PRf_PR@0x023C9000@ */ ECIPP_ALIGNMENT_FLOAT32_IEEE 10000000000 Compu_TEGR_PRf_PR -10000000000 10000000000 MATRIX_DIM 6 1 1 /end CHARACTERISTIC
/begin COMPU_METHOD Compu_TEGR_PRf_PR " " RAT_FUNC "%.3" "PR (psia)" COEFFS 0 1 0 0 0 1 /end COMPU_METHOD
/begin MEASUREMENT TEGR_PRf_crct "EGR Pressure Ratio Adaptive Correction" FLOAT32_IEEE Compu_TEGR_PRf_crct 0 0 -10000000000 10000000000 ECU_ADDRESS 0x023CA000 MATRIX_DIM 36 1 1 /end MEASUREMENT
/begin COMPU_METHOD Compu_TEGR_PRf_crct " " RAT_FUNC "%.2" "-" COEFFS 0 0.01 0 0 0 1 /end COMPU_METHOD
/begin CHARACTERISTIC TEGRad_in2pct_pct "Air # TEGRad_in2pct_pct" VAL_BLK 0x0014083E /* @ECU_Address@TEGRad_in2pct_pct@0x023D3000@ */ ECIPP_ALIGNMENT_SWORD 100 Compu_TEGRad_in2pct_pct -100 99.9969482421875 MATRIX_DIM 6 1 1 /end CHARACTERISTIC
/begin COMPU_METHOD Compu_TEGRad_in2pct_pct " " RAT_FUNC "%.3" "(%)" COEFFS 0 327.68 0 0 0 1 /end COMPU_METHOD
/begin CHARACTERISTIC TEGRad_in2pct_min "Air # TEGRad_in2pct_min" VAL_BLK 0x00140832 /* @ECU_Address@TEGRad_in2pct_min@0x023D4000@ */ ECIPP_ALIGNMENT_SWORD 16 Compu_TEGRad_in2pct_min -16 15.99951171875 MATRIX_DIM 6 1 1 /end CHARACTERISTIC
/begin COMPU_METHOD Compu_TEGRad_in2pct_min " " RAT_FUNC "%.3" "(in^2/100%)" COEFFS 0 2048 0 0 0 1 /end COMPU_METHOD
/begin CHARACTERISTIC TEGRad_in2pct_max "Air # TEGRad_in2pct_max" VAL_BLK 0x00140826 /* @ECU_Address@TEGRad_in2pct_max@0x023D5000@ */ ECIPP_ALIGNMENT_SWORD 16 Compu_TEGRad_in2pct_max -16 15.99951171875 MATRIX_DIM 6 1 1 /end CHARACTERISTIC
/begin COMPU_METHOD Compu_TEGRad_in2pct_max " " RAT_FUNC "%.3" "(in^2/100%)" COEFFS 0 2048 0 0 0 1 /end COMPU_METHOD
/begin CHARACTERISTIC TTM_TPSAad_PR "Air # TTM_TPSAad_PR" VAL_BLK 0x00143B80 /* @ECU_Address@TTM_TPSAad_PR@0x024C7000@ */ ECIPP_ALIGNMENT_FLOAT32_IEEE 10000000000 Compu_TTM_TPSAad_PR -10000000000 10000000000 MATRIX_DIM 2 1 1 /end CHARACTERISTIC
/begin COMPU_METHOD Compu_TTM_TPSAad_PR " " RAT_FUNC "%.3" "PR (TOP/TIP)" COEFFS 0 1 0 0 0 1 /end COMPU_METHOD
/begin MEASUREMENT TTM_TPSAad_in2 "Throttle Adaptive Effective Area" FLOAT32_IEEE Compu_TTM_TPSAad_in2 0 0 -10000000000 10000000000 ECU_ADDRESS 0x024C8000 MATRIX_DIM 32 1 1 /end MEASUREMENT
/begin COMPU_METHOD Compu_TTM_TPSAad_in2 " " RAT_FUNC "%.3" "Area Adapt (in^2)" COEFFS 0 1 0 0 0 1 /end COMPU_METHOD
/begin CHARACTERISTIC TTPSad_in2pct_pct "Air # TTPSad_in2pct_pct" VAL_BLK 0x001455B6 /* @ECU_Address@TTPSad_in2pct_pct@0x024C9000@ */ ECIPP_ALIGNMENT_SWORD 100 Compu_TTPSad_in2pct_pct -100 99.9969482421875 MATRIX_DIM 4 1 1 /end CHARACTERISTIC
/begin COMPU_METHOD Compu_TTPSad_in2pct_pct " " RAT_FUNC "%.3" "(%)" COEFFS 0 327.68 0 0 0 1 /end COMPU_METHOD
/begin CHARACTERISTIC TTPSad_in2pct_min "Air # TTPSad_in2pct_min" VAL_BLK 0x001455AE /* @ECU_Address@TTPSad_in2pct_min@0x024CA000@ */ ECIPP_ALIGNMENT_SWORD 16 Compu_TTPSad_in2pct_min -16 15.99951171875 MATRIX_DIM 4 1 1 /end CHARACTERISTIC
/begin COMPU_METHOD Compu_TTPSad_in2pct_min " " RAT_FUNC "%.3" "(in^2/100%)" COEFFS 0 2048 0 0 0 1 /end COMPU_METHOD
/begin CHARACTERISTIC TTPSad_in2pct_max "Air # TTPSad_in2pct_max" VAL_BLK 0x001455A6 /* @ECU_Address@TTPSad_in2pct_max@0x024CB000@ */ ECIPP_ALIGNMENT_SWORD 16 Compu_TTPSad_in2pct_max -16 15.99951171875 MATRIX_DIM 4 1 1 /end CHARACTERISTIC
/begin COMPU_METHOD Compu_TTPSad_in2pct_max " " RAT_FUNC "%.3" "(in^2/100%)" COEFFS 0 2048 0 0 0 1 /end COMPU_METHOD
/begin CHARACTERISTIC TTPS_PRf_TIP "Air # TTPS_PRf_TIP" VAL_BLK 0x00143BA0 /* @ECU_Address@TTPS_PRf_TIP@0x024CC000@ */ ECIPP_ALIGNMENT_FLOAT32_IEEE 10000000000 Compu_TTPS_PRf_TIP -10000000000 10000000000 MATRIX_DIM 6 1 1 /end CHARACTERISTIC
/begin COMPU_METHOD Compu_TTPS_PRf_TIP " " RAT_FUNC "%.1" "TIP (psia)" COEFFS 0 1 0 0 0 1 /end COMPU_METHOD
/begin CHARACTERISTIC TTPS_PRf_PR "Air # TTPS_PRf_PR" VAL_BLK 0x00143B88 /* @ECU_Address@TTPS_PRf_PR@0x024CD000@ */ ECIPP_ALIGNMENT_FLOAT32_IEEE 10000000000 Compu_TTPS_PRf_PR -10000000000 10000000000 MATRIX_DIM 6 1 1 /end CHARACTERISTIC
/begin COMPU_METHOD Compu_TTPS_PRf_PR " " RAT_FUNC "%.3" "PR (psia)" COEFFS 0 1 0 0 0 1 /end COMPU_METHOD
/begin MEASUREMENT TTPS_PRf_crct "TPS Pressure Ratio Adaptive Correction" FLOAT32_IEEE Compu_TTPS_PRf_crct 0 0 -10000000000 10000000000 ECU_ADDRESS 0x024CE000 MATRIX_DIM 36 1 1 /end MEASUREMENT
/begin COMPU_METHOD Compu_TTPS_PRf_crct " " RAT_FUNC "%.2" "-" COEFFS 0 0.01 0 0 0 1 /end COMPU_METHOD
/begin CHARACTERISTIC TICAV_expadpt_rpm "FaultConfig # TICAV_expadpt_rpm" VAL_BLK 0x00149358 /* @ECU_Address@TICAV_expadpt_rpm@0x0259D000@ */ ECIPP_ALIGNMENT_SWORD 32767 Compu_TICAV_expadpt_rpm -32768 32767 MATRIX_DIM 12 1 1 /end CHARACTERISTIC
/begin COMPU_METHOD Compu_TICAV_expadpt_rpm " " RAT_FUNC "%.0" "Speed (rpm)" COEFFS 0 1 0 0 0 1 /end COMPU_METHOD
/begin CHARACTERISTIC TICAV_expadpt_maL "FaultConfig # TICAV_expadpt_maL" VAL_BLK 0x0014934C /* @ECU_Address@TICAV_expadpt_maL@0x0259E000@ */ ECIPP_ALIGNMENT_SWORD 8192 Compu_TICAV_expadpt_maL -8192 8191.75 MATRIX_DIM 6 1 1 /end CHARACTERISTIC
/begin COMPU_METHOD Compu_TICAV_expadpt_maL " " RAT_FUNC "%.0" "Air flow (mg/L-disp)" COEFFS 0 4 0 0 0 1 /end COMPU_METHOD
/begin MEASUREMENT ICAV_expadpt1 "ICAV Cylinder 1 adaptive" FLOAT32_IEEE Compu_ICAV_expadpt1 0 0 -10000000000 10000000000 ECU_ADDRESS 0x0259F000 MATRIX_DIM 72 1 1 /end MEASUREMENT
/begin COMPU_METHOD Compu_ICAV_expadpt1 " " RAT_FUNC "%.2" "% speed deviation" COEFFS 0 0.01 0 0 0 1 /end COMPU_METHOD
/begin MEASUREMENT ICAV_expadpt2 "ICAV Cylinder 2 adaptive" FLOAT32_IEEE Compu_ICAV_expadpt2 0 0 -10000000000 10000000000 ECU_ADDRESS 0x025A0000 MATRIX_DIM 72 1 1 /end MEASUREMENT
/begin COMPU_METHOD Compu_ICAV_expadpt2 " " RAT_FUNC "%.2" "% speed deviation" COEFFS 0 0.01 0 0 0 1 /end COMPU_METHOD
/begin MEASUREMENT ICAV_expadpt3 "ICAV Cylinder 3 adaptive" FLOAT32_IEEE Compu_ICAV_expadpt3 0 0 -10000000000 10000000000 ECU_ADDRESS 0x025A1000 MATRIX_DIM 72 1 1 /end MEASUREMENT
/begin COMPU_METHOD Compu_ICAV_expadpt3 " " RAT_FUNC "%.2" "% speed deviation" COEFFS 0 0.01 0 0 0 1 /end COMPU_METHOD
/begin MEASUREMENT ICAV_expadpt4 "ICAV Cylinder 4 adaptive" FLOAT32_IEEE Compu_ICAV_expadpt4 0 0 -10000000000 10000000000 ECU_ADDRESS 0x025A2000 MATRIX_DIM 72 1 1 /end MEASUREMENT
/begin COMPU_METHOD Compu_ICAV_expadpt4 " " RAT_FUNC "%.2" "% speed deviation" COEFFS 0 0.01 0 0 0 1 /end COMPU_METHOD
/begin MEASUREMENT ICAV_expadpt5 "ICAV Cylinder 5 adaptive" FLOAT32_IEEE Compu_ICAV_expadpt5 0 0 -10000000000 10000000000 ECU_ADDRESS 0x025A3000 MATRIX_DIM 72 1 1 /end MEASUREMENT
/begin COMPU_METHOD Compu_ICAV_expadpt5 " " RAT_FUNC "%.2" "% speed deviation" COEFFS 0 0.01 0 0 0 1 /end COMPU_METHOD
/begin MEASUREMENT ICAV_expadpt6 "ICAV Cylinder 6 adaptive" FLOAT32_IEEE Compu_ICAV_expadpt6 0 0 -10000000000 10000000000 ECU_ADDRESS 0x025A4000 MATRIX_DIM 72 1 1 /end MEASUREMENT
/begin COMPU_METHOD Compu_ICAV_expadpt6 " " RAT_FUNC "%.2" "% speed deviation" COEFFS 0 0.01 0 0 0 1 /end COMPU_METHOD
/begin MEASUREMENT ICAV_expadpt7 "ICAV Cylinder 7 adaptive" FLOAT32_IEEE Compu_ICAV_expadpt7 0 0 -10000000000 10000000000 ECU_ADDRESS 0x025A5000 MATRIX_DIM 72 1 1 /end MEASUREMENT
/begin COMPU_METHOD Compu_ICAV_expadpt7 " " RAT_FUNC "%.2" "% speed deviation" COEFFS 0 0.01 0 0 0 1 /end COMPU_METHOD
/begin MEASUREMENT ICAV_expadpt8 "ICAV Cylinder 8 adaptive" FLOAT32_IEEE Compu_ICAV_expadpt8 0 0 -10000000000 10000000000 ECU_ADDRESS 0x025A6000 MATRIX_DIM 72 1 1 /end MEASUREMENT
/begin COMPU_METHOD Compu_ICAV_expadpt8 " " RAT_FUNC "%.2" "% speed deviation" COEFFS 0 0.01 0 0 0 1 /end COMPU_METHOD
/begin MEASUREMENT ICAV_expadpt9 "ICAV Cylinder 9 adaptive" FLOAT32_IEEE Compu_ICAV_expadpt9 0 0 -10000000000 10000000000 ECU_ADDRESS 0x025A7000 MATRIX_DIM 72 1 1 /end MEASUREMENT
/begin COMPU_METHOD Compu_ICAV_expadpt9 " " RAT_FUNC "%.2" "% speed deviation" COEFFS 0 0.01 0 0 0 1 /end COMPU_METHOD
/begin MEASUREMENT ICAV_expadpt10 "ICAV Cylinder 10 adaptive" FLOAT32_IEEE Compu_ICAV_expadpt10 0 0 -10000000000 10000000000 ECU_ADDRESS 0x025A8000 MATRIX_DIM 72 1 1 /end MEASUREMENT
/begin COMPU_METHOD Compu_ICAV_expadpt10 " " RAT_FUNC "%.2" "% speed deviation" COEFFS 0 0.01 0 0 0 1 /end COMPU_METHOD
/begin MEASUREMENT ICAV_expadptT "ICAV Adaptive histogram" ULONG Compu_ICAV_expadptT 0 0 0 65535.9999847412 ECU_ADDRESS 0x025A9000 MATRIX_DIM 72 1 1 /end MEASUREMENT
/begin COMPU_METHOD Compu_ICAV_expadptT " " RAT_FUNC "%.0" "cycles" COEFFS 0 65536 0 0 0 1 /end COMPU_METHOD
/begin CHARACTERISTIC HstSL_expTbl_RPMdf "FaultConfig # HstSL_expTbl_RPMdf" VAL_BLK 0x0016C37E /* @ECU_Address@HstSL_expTbl_RPMdf@0x025AA000@ */ ECIPP_ALIGNMENT_UWORD 65535 Compu_HstSL_expTbl_RPMdf 0 65535 MATRIX_DIM 12 1 1 /end CHARACTERISTIC
/begin COMPU_METHOD Compu_HstSL_expTbl_RPMdf " " RAT_FUNC "%.0" "-" COEFFS 0 1 0 0 0 1 /end COMPU_METHOD
/begin MEASUREMENT HstSL_expTbl_RPM "General # HstSL_expTbl_RPM" UWORD Compu_HstSL_expTbl_RPM 0 0 0 65535 ECU_ADDRESS 0x025AB000 MATRIX_DIM 12 1 1 /end MEASUREMENT
/begin COMPU_METHOD Compu_HstSL_expTbl_RPM " " RAT_FUNC "%.0" "Speed (rpm)" COEFFS 0 1 0 0 0 1 /end COMPU_METHOD
/begin CHARACTERISTIC TEGRwr_Vheater "CL # TEGRwr_Vheater" VAL_BLK 0x00162D7A /* @ECU_Address@TEGRwr_Vheater@0x025B8000@ */ ECIPP_ALIGNMENT_SWORD 32 Compu_TEGRwr_Vheater -32 31.9990234375 MATRIX_DIM 6 1 1 /end CHARACTERISTIC
/begin COMPU_METHOD Compu_TEGRwr_Vheater " " RAT_FUNC "%.3" "Cmd (volts)" COEFFS 0 1024 0 0 0 1 /end COMPU_METHOD
/begin CHARACTERISTIC TEGRwr_Vheater_sec "CL # TEGRwr_Vheater_sec" VAL_BLK 0x00162D86 /* @ECU_Address@TEGRwr_Vheater_sec@0x025B9000@ */ ECIPP_ALIGNMENT_SWORD 524 Compu_TEGRwr_Vheater_sec -524.288 524.272 MATRIX_DIM 6 1 1 /end CHARACTERISTIC
/begin COMPU_METHOD Compu_TEGRwr_Vheater_sec " " RAT_FUNC "%.3" "(seconds)" COEFFS 0 62.5 0 0 0 1 /end COMPU_METHOD
/begin CHARACTERISTIC J1939_PGN_tout "FaultConfig # J1939_PGN_tout (Fault Condition:Run-time > time above and PGN =)" VAL_BLK 0x001474F4 /* @ECU_Address@J1939_PGN_tout@0x025BA000@ */ ECIPP_ALIGNMENT_UWORD 65535 Compu_J1939_PGN_tout 0 65535 MATRIX_DIM 10 1 1 /end CHARACTERISTIC
/begin COMPU_METHOD Compu_J1939_PGN_tout " " RAT_FUNC "%.0" "-" COEFFS 0 1 0 0 0 1 /end COMPU_METHOD
/begin CHARACTERISTIC TEGR_PRf_EGRLP "Air # TEGR_PRf_EGRLP" VAL_BLK 0x001400F8 /* @ECU_Address@TEGR_PRf_EGRLP@0x025C6000@ */ ECIPP_ALIGNMENT_FLOAT32_IEEE 10000000000 Compu_TEGR_PRf_EGRLP -10000000000 10000000000 MATRIX_DIM 6 1 1 /end CHARACTERISTIC
/begin COMPU_METHOD Compu_TEGR_PRf_EGRLP " " RAT_FUNC "%.1" "EGRLP (psia)" COEFFS 0 1 0 0 0 1 /end COMPU_METHOD
/begin CHARACTERISTIC cal_grp_scalars "General # cal_grp_scalars" VAL_BLK 0x0016960B /* @ECU_Address@cal_grp_scalars@0x025FF000@ */ ECIPP_ALIGNMENT_UBYTE 255 Compu_cal_grp_scalars 0 255 MATRIX_DIM 9854 1 1 /end CHARACTERISTIC
/begin COMPU_METHOD Compu_cal_grp_scalars " " RAT_FUNC "%.0" "N" COEFFS 0 1 0 0 0 1 /end COMPU_METHOD
/begin CHARACTERISTIC cal_grp_tables "General # cal_grp_tables" VAL_BLK 0x0016BC89 /* @ECU_Address@cal_grp_tables@0x02600000@ */ ECIPP_ALIGNMENT_UBYTE 255 Compu_cal_grp_tables 0 255 MATRIX_DIM 1662 1 1 /end CHARACTERISTIC
/begin COMPU_METHOD Compu_cal_grp_tables " " RAT_FUNC "%.0" "N" COEFFS 0 1 0 0 0 1 /end COMPU_METHOD
/begin CHARACTERISTIC STR_engine_chassis_ID "General # STR_engine_chassis_ID" ASCII 0x00140000 /* @ECU_Address@STR_engine_chassis_ID@0x0261C000@ */ ECIPP_ALIGNMENT_UBYTE 255 Compu_ECIPP_STRINGS 0 255 MATRIX_DIM 19 1 1 /end CHARACTERISTIC
/begin CHARACTERISTIC STR_DID_0xF196 "General # STR_DID_0xF196" ASCII 0x00147FDD /* @ECU_Address@STR_DID_0xF196@0x0261F000@ */ ECIPP_ALIGNMENT_UBYTE 255 Compu_ECIPP_STRINGS 0 255 MATRIX_DIM 9 1 1 /end CHARACTERISTIC
/begin CHARACTERISTIC HEX_F201_ids "IOConfig # HEX_F201_ids" VAL_BLK 0x00162A54 /* @ECU_Address@HEX_F201_ids@0x0263A000@ */ ECIPP_ALIGNMENT_ULONG 4294967295 Compu_HEX_F201_ids 0 4294967295 MATRIX_DIM 80 1 1 /end CHARACTERISTIC
/begin COMPU_METHOD Compu_HEX_F201_ids " " RAT_FUNC "%.0" "DID F202" COEFFS 0 1 0 0 0 1 /end COMPU_METHOD
/begin CHARACTERISTIC TVSFan_pwr_rpm "IOConfig # TVSFan_pwr_rpm" VAL_BLK 0x0016335A /* @ECU_Address@TVSFan_pwr_rpm@0x02645000@ */ ECIPP_ALIGNMENT_SWORD 32767 Compu_TVSFan_pwr_rpm -32768 32767 MATRIX_DIM 16 1 1 /end CHARACTERISTIC
/begin COMPU_METHOD Compu_TVSFan_pwr_rpm " " RAT_FUNC "%.0" "(rpm)" COEFFS 0 1 0 0 0 1 /end COMPU_METHOD
/begin CHARACTERISTIC TVSFan_pwr_kW "IOConfig # TVSFan_pwr_kW" VAL_BLK 0x0016507A /* @ECU_Address@TVSFan_pwr_kW@0x02646000@ */ ECIPP_ALIGNMENT_UWORD 4096 Compu_TVSFan_pwr_kW 0 4095.9375 MATRIX_DIM 16 1 1 /end CHARACTERISTIC
/begin COMPU_METHOD Compu_TVSFan_pwr_kW " " RAT_FUNC "%.3" "(kW)" COEFFS 0 16 0 0 0 1 /end COMPU_METHOD
/begin MEASUREMENT J1939RC_ER_rpm "General # J1939RC_ER_rpm" UWORD Compu_J1939RC_ER_rpm 0 0 0 65535 ECU_ADDRESS 0x02652000 MATRIX_DIM 5 1 1 /end MEASUREMENT
/begin COMPU_METHOD Compu_J1939RC_ER_rpm " " RAT_FUNC "%.0" "Speed (rpm)" COEFFS 0 1 0 0 0 1 /end COMPU_METHOD
/begin MEASUREMENT J1939RC_EXR_rpm "General # J1939RC_EXR_rpm" UWORD Compu_J1939RC_EXR_rpm 0 0 0 65535 ECU_ADDRESS 0x02653000 MATRIX_DIM 5 1 1 /end MEASUREMENT
/begin COMPU_METHOD Compu_J1939RC_EXR_rpm " " RAT_FUNC "%.0" "Speed (rpm)" COEFFS 0 1 0 0 0 1 /end COMPU_METHOD
/begin CHARACTERISTIC STR_cal_pwd "Cal pwd" ASCII 0x00169438 /* @ECU_Address@STR_cal_pwd@0x0265A000@ */ ECIPP_ALIGNMENT_UBYTE 255 Compu_ECIPP_STRINGS 0 255 MATRIX_DIM 19 1 1 /end CHARACTERISTIC
/begin CHARACTERISTIC TPhi_FSO_CBT "Fuel # TPhi_FSO_CBT" VAL_BLK 0x001453AC /* @ECU_Address@TPhi_FSO_CBT@0x02663000@ */ ECIPP_ALIGNMENT_SWORD 7732 Compu_TPhi_FSO_CBT -8652 7731.75 MATRIX_DIM 4 1 1 /end CHARACTERISTIC
/begin COMPU_METHOD Compu_TPhi_FSO_CBT " " RAT_FUNC "%.0" "CBT (deg F)" COEFFS 0 4 1840 0 0 1 /end COMPU_METHOD
/begin CHARACTERISTIC TPhi_FSO_offset_cal "Fuel # TPhi_FSO_offset_cal" VAL_BLK 0x0014938C /* @ECU_Address@TPhi_FSO_offset_cal@0x02664000@ */ ECIPP_ALIGNMENT_SWORD 200 Compu_TPhi_FSO_offset_cal -200 199.993896484375 MATRIX_DIM 3 1 1 /end CHARACTERISTIC
/begin COMPU_METHOD Compu_TPhi_FSO_offset_cal " " RAT_FUNC "%.3" "Enrichment (%)" COEFFS 0 163.84 0 0 0 1 /end COMPU_METHOD
/begin MEASUREMENT TPhi_FSO_offset "FSO Phi Catalyst Enrichment in Cold Start Mode" SWORD Compu_TPhi_FSO_offset 0 0 -200 199.993896484375 ECU_ADDRESS 0x02665000 MATRIX_DIM 4 1 1 /end MEASUREMENT
/begin COMPU_METHOD Compu_TPhi_FSO_offset " " RAT_FUNC "%.3" "Phi Offset" COEFFS 0 163.84 0 0 0 1 /end COMPU_METHOD
/begin CHARACTERISTIC HEX_FSS_DID_tbl "General # HEX_FSS_DID_tbl" VAL_BLK 0x00164ED0 /* @ECU_Address@HEX_FSS_DID_tbl@0x02666000@ */ ECIPP_ALIGNMENT_UWORD 65535 Compu_HEX_FSS_DID_tbl 0 65535 MATRIX_DIM 15 1 1 /end CHARACTERISTIC
/begin COMPU_METHOD Compu_HEX_FSS_DID_tbl " " RAT_FUNC "%.0" "FSS DIDs" COEFFS 0 1 0 0 0 1 /end COMPU_METHOD
/begin CHARACTERISTIC Tdrvtrim_V_volts "IOConfig # Tdrvtrim_V_volts" VAL_BLK 0x0016337E /* @ECU_Address@Tdrvtrim_V_volts@0x02667000@ */ ECIPP_ALIGNMENT_SWORD 128 Compu_Tdrvtrim_V_volts -128 127.99609375 MATRIX_DIM 2 1 1 /end CHARACTERISTIC
/begin COMPU_METHOD Compu_Tdrvtrim_V_volts " " RAT_FUNC "%.3" "(volts)" COEFFS 0 256 0 0 0 1 /end COMPU_METHOD
/begin CHARACTERISTIC Tdrvtrim_V_angle "IOConfig # Tdrvtrim_V_angle" VAL_BLK 0x0016337A /* @ECU_Address@Tdrvtrim_V_angle@0x02668000@ */ ECIPP_ALIGNMENT_SWORD 2048 Compu_Tdrvtrim_V_angle -2048 2047.9375 MATRIX_DIM 2 1 1 /end CHARACTERISTIC
/begin COMPU_METHOD Compu_Tdrvtrim_V_angle " " RAT_FUNC "%.3" "(degrees)" COEFFS 0 16 0 0 0 1 /end COMPU_METHOD
/begin CHARACTERISTIC Tdrvtrim_cmd_pct "IOConfig # Tdrvtrim_cmd_pct" VAL_BLK 0x00163386 /* @ECU_Address@Tdrvtrim_cmd_pct@0x02669000@ */ ECIPP_ALIGNMENT_SWORD 200 Compu_Tdrvtrim_cmd_pct -200 199.993896484375 MATRIX_DIM 2 1 1 /end CHARACTERISTIC
/begin COMPU_METHOD Compu_Tdrvtrim_cmd_pct " " RAT_FUNC "%.3" "(%)" COEFFS 0 163.84 0 0 0 1 /end COMPU_METHOD
/begin CHARACTERISTIC Tdrvtrim_cmd_angle "IOConfig # Tdrvtrim_cmd_angle" VAL_BLK 0x00163382 /* @ECU_Address@Tdrvtrim_cmd_angle@0x0266A000@ */ ECIPP_ALIGNMENT_SWORD 2048 Compu_Tdrvtrim_cmd_angle -2048 2047.9375 MATRIX_DIM 2 1 1 /end CHARACTERISTIC
/begin COMPU_METHOD Compu_Tdrvtrim_cmd_angle " " RAT_FUNC "%.3" "(degrees)" COEFFS 0 16 0 0 0 1 /end COMPU_METHOD
/begin CHARACTERISTIC THstIBF_MAP_def "FaultConfig # THstIBF_MAP_def" VAL_BLK 0x0016C35C /* @ECU_Address@THstIBF_MAP_def@0x02673000@ */ ECIPP_ALIGNMENT_UWORD 256 Compu_THstIBF_MAP_def 0 255.99609375 MATRIX_DIM 5 1 1 /end CHARACTERISTIC
/begin COMPU_METHOD Compu_THstIBF_MAP_def " " RAT_FUNC "%.3" "MAP load (psia)" COEFFS 0 256 0 0 0 1 /end COMPU_METHOD
/begin MEASUREMENT THstIBF_MAP "General # THstIBF_MAP" UWORD Compu_THstIBF_MAP 0 0 0 255.99609375 ECU_ADDRESS 0x02674000 MATRIX_DIM 5 1 1 /end MEASUREMENT
/begin COMPU_METHOD Compu_THstIBF_MAP " " RAT_FUNC "%.1" "MAP load (psia)" COEFFS 0 256 0 0 0 1 /end COMPU_METHOD
/begin CHARACTERISTIC THstIBF_RPM_def "FaultConfig # THstIBF_RPM_def" VAL_BLK 0x0016C366 /* @ECU_Address@THstIBF_RPM_def@0x02675000@ */ ECIPP_ALIGNMENT_UWORD 65535 Compu_THstIBF_RPM_def 0 65535 MATRIX_DIM 6 1 1 /end CHARACTERISTIC
/begin COMPU_METHOD Compu_THstIBF_RPM_def " " RAT_FUNC "%.0" "-" COEFFS 0 1 0 0 0 1 /end COMPU_METHOD
/begin MEASUREMENT THstIBF_RPM "General # THstIBF_RPM" UWORD Compu_THstIBF_RPM 0 0 0 65535 ECU_ADDRESS 0x02676000 MATRIX_DIM 6 1 1 /end MEASUREMENT
/begin COMPU_METHOD Compu_THstIBF_RPM " " RAT_FUNC "%.0" "Speed (rpm)" COEFFS 0 1 0 0 0 1 /end COMPU_METHOD
/begin CHARACTERISTIC THrsIBF_hrs_def "FaultConfig # THrsIBF_hrs_def" VAL_BLK 0x0016501A /* @ECU_Address@THrsIBF_hrs_def@0x02679000@ */ ECIPP_ALIGNMENT_UWORD 65535 Compu_THrsIBF_hrs_def 0 65535 MATRIX_DIM 4 1 1 /end CHARACTERISTIC
/begin COMPU_METHOD Compu_THrsIBF_hrs_def " " RAT_FUNC "%.0" "-" COEFFS 0 1 0 0 0 1 /end COMPU_METHOD
/begin MEASUREMENT THrsIBF_hrs "General # THrsIBF_hrs" UWORD Compu_THrsIBF_hrs 0 0 0 65535 ECU_ADDRESS 0x0267A000 MATRIX_DIM 4 1 1 /end MEASUREMENT
/begin COMPU_METHOD Compu_THrsIBF_hrs " " RAT_FUNC "%.0" "Time (hours)" COEFFS 0 1 0 0 0 1 /end COMPU_METHOD
/begin CHARACTERISTIC FCdc4_AL2_hi "FCtl_DTC_0x04(40)" VALUE 0x00163C20 /* @ECU_Address@FCtl_DTC_0x04@0x024C4050@ */ ECIPP_ALIGNMENT_UWORD 65535 Compu_IDENTITY 0 65535 PHYS_UNIT "System ID + DTC" /end CHARACTERISTIC
/begin CHARACTERISTIC FCdc4_AL2_lo "FCtl_DTC_0x04(41)" VALUE 0x00163C22 /* @ECU_Address@FCtl_DTC_0x04@0x024C4052@ */ ECIPP_ALIGNMENT_UWORD 65535 Compu_IDENTITY 0 65535 PHYS_UNIT "System ID + DTC" /end CHARACTERISTIC
/begin CHARACTERISTIC FCdc4_CFVxminFT "FCtl_DTC_0x04(533)" VALUE 0x00163FFA /* @ECU_Address@FCtl_DTC_0x04@0x024C442A@ */ ECIPP_ALIGNMENT_UWORD 65535 Compu_IDENTITY 0 65535 PHYS_UNIT "System ID + DTC" /end CHARACTERISTIC
/begin CHARACTERISTIC FCdc4_CL2_hi "FCtl_DTC_0x04(34)" VALUE 0x00163C14 /* @ECU_Address@FCtl_DTC_0x04@0x024C4044@ */ ECIPP_ALIGNMENT_UWORD 65535 Compu_IDENTITY 0 65535 PHYS_UNIT "System ID + DTC" /end CHARACTERISTIC
/begin CHARACTERISTIC FCdc4_CL2_lo "FCtl_DTC_0x04(35)" VALUE 0x00163C16 /* @ECU_Address@FCtl_DTC_0x04@0x024C4046@ */ ECIPP_ALIGNMENT_UWORD 65535 Compu_IDENTITY 0 65535 PHYS_UNIT "System ID + DTC" /end CHARACTERISTIC
/begin CHARACTERISTIC FCdc4_CM2_unresp "FCtl_DTC_0x04(800)" VALUE 0x00164210 /* @ECU_Address@FCtl_DTC_0x04@0x024C4640@ */ ECIPP_ALIGNMENT_UWORD 65535 Compu_IDENTITY 0 65535 PHYS_UNIT "System ID + DTC" /end CHARACTERISTIC
/begin CHARACTERISTIC FCdc4_CM2gsln_inact "FCtl_DTC_0x04(199)" VALUE 0x00163D5E /* @ECU_Address@FCtl_DTC_0x04@0x024C418E@ */ ECIPP_ALIGNMENT_UWORD 65535 Compu_IDENTITY 0 65535 PHYS_UNIT "System ID + DTC" /end CHARACTERISTIC
/begin CHARACTERISTIC FCdc4_EGO4_open "FCtl_DTC_0x04(200)" VALUE 0x00163D60 /* @ECU_Address@FCtl_DTC_0x04@0x024C4190@ */ ECIPP_ALIGNMENT_UWORD 65535 Compu_IDENTITY 0 65535 PHYS_UNIT "System ID + DTC" /end CHARACTERISTIC
/begin CHARACTERISTIC FCdc4_EMWT2_HiExp1 "FCtl_DTC_0x04(226)" VALUE 0x00163D94 /* @ECU_Address@FCtl_DTC_0x04@0x024C41C4@ */ ECIPP_ALIGNMENT_UWORD 65535 Compu_IDENTITY 0 65535 PHYS_UNIT "System ID + DTC" /end CHARACTERISTIC
/begin CHARACTERISTIC FCdc4_EMWT2_HiExp2 "FCtl_DTC_0x04(228)" VALUE 0x00163D98 /* @ECU_Address@FCtl_DTC_0x04@0x024C41C8@ */ ECIPP_ALIGNMENT_UWORD 65535 Compu_IDENTITY 0 65535 PHYS_UNIT "System ID + DTC" /end CHARACTERISTIC
/begin CHARACTERISTIC FCdc4_EMWT2_maxv "FCtl_DTC_0x04(222)" VALUE 0x00163D8C /* @ECU_Address@FCtl_DTC_0x04@0x024C41BC@ */ ECIPP_ALIGNMENT_UWORD 65535 Compu_IDENTITY 0 65535 PHYS_UNIT "System ID + DTC" /end CHARACTERISTIC
/begin CHARACTERISTIC FCdc4_EMWT2_minv "FCtl_DTC_0x04(224)" VALUE 0x00163D90 /* @ECU_Address@FCtl_DTC_0x04@0x024C41C0@ */ ECIPP_ALIGNMENT_UWORD 65535 Compu_IDENTITY 0 65535 PHYS_UNIT "System ID + DTC" /end CHARACTERISTIC
/begin CHARACTERISTIC FCdc4_ERWT2_HiExp1 "FCtl_DTC_0x04(238)" VALUE 0x00163DAC /* @ECU_Address@FCtl_DTC_0x04@0x024C41DC@ */ ECIPP_ALIGNMENT_UWORD 65535 Compu_IDENTITY 0 65535 PHYS_UNIT "System ID + DTC" /end CHARACTERISTIC
/begin CHARACTERISTIC FCdc4_ERWT2_HiExp2 "FCtl_DTC_0x04(240)" VALUE 0x00163DB0 /* @ECU_Address@FCtl_DTC_0x04@0x024C41E0@ */ ECIPP_ALIGNMENT_UWORD 65535 Compu_IDENTITY 0 65535 PHYS_UNIT "System ID + DTC" /end CHARACTERISTIC
/begin CHARACTERISTIC FCdc4_ERWT2_maxv "FCtl_DTC_0x04(234)" VALUE 0x00163DA4 /* @ECU_Address@FCtl_DTC_0x04@0x024C41D4@ */ ECIPP_ALIGNMENT_UWORD 65535 Compu_IDENTITY 0 65535 PHYS_UNIT "System ID + DTC" /end CHARACTERISTIC
/begin CHARACTERISTIC FCdc4_ERWT2_minv "FCtl_DTC_0x04(236)" VALUE 0x00163DA8 /* @ECU_Address@FCtl_DTC_0x04@0x024C41D8@ */ ECIPP_ALIGNMENT_UWORD 65535 Compu_IDENTITY 0 65535 PHYS_UNIT "System ID + DTC" /end CHARACTERISTIC
/begin CHARACTERISTIC FCdc4_GLOW10_open "FCtl_DTC_0x04(492)" VALUE 0x00163FA8 /* @ECU_Address@FCtl_DTC_0x04@0x024C43D8@ */ ECIPP_ALIGNMENT_UWORD 65535 Compu_IDENTITY 0 65535 PHYS_UNIT "System ID + DTC" /end CHARACTERISTIC
/begin CHARACTERISTIC FCdc4_GLOW10_short "FCtl_DTC_0x04(502)" VALUE 0x00163FBC /* @ECU_Address@FCtl_DTC_0x04@0x024C43EC@ */ ECIPP_ALIGNMENT_UWORD 65535 Compu_IDENTITY 0 65535 PHYS_UNIT "System ID + DTC" /end CHARACTERISTIC
/begin CHARACTERISTIC FCdc4_GLOW2_open "FCtl_DTC_0x04(484)" VALUE 0x00163F98 /* @ECU_Address@FCtl_DTC_0x04@0x024C43C8@ */ ECIPP_ALIGNMENT_UWORD 65535 Compu_IDENTITY 0 65535 PHYS_UNIT "System ID + DTC" /end CHARACTERISTIC
/begin CHARACTERISTIC FCdc4_GLOW2_short "FCtl_DTC_0x04(494)" VALUE 0x00163FAC /* @ECU_Address@FCtl_DTC_0x04@0x024C43DC@ */ ECIPP_ALIGNMENT_UWORD 65535 Compu_IDENTITY 0 65535 PHYS_UNIT "System ID + DTC" /end CHARACTERISTIC
/begin CHARACTERISTIC FCdc4_GLOW3_open "FCtl_DTC_0x04(485)" VALUE 0x00163F9A /* @ECU_Address@FCtl_DTC_0x04@0x024C43CA@ */ ECIPP_ALIGNMENT_UWORD 65535 Compu_IDENTITY 0 65535 PHYS_UNIT "System ID + DTC" /end CHARACTERISTIC
/begin CHARACTERISTIC FCdc4_GLOW3_short "FCtl_DTC_0x04(495)" VALUE 0x00163FAE /* @ECU_Address@FCtl_DTC_0x04@0x024C43DE@ */ ECIPP_ALIGNMENT_UWORD 65535 Compu_IDENTITY 0 65535 PHYS_UNIT "System ID + DTC" /end CHARACTERISTIC
/begin CHARACTERISTIC FCdc4_GLOW4_open "FCtl_DTC_0x04(486)" VALUE 0x00163F9C /* @ECU_Address@FCtl_DTC_0x04@0x024C43CC@ */ ECIPP_ALIGNMENT_UWORD 65535 Compu_IDENTITY 0 65535 PHYS_UNIT "System ID + DTC" /end CHARACTERISTIC
/begin CHARACTERISTIC FCdc4_GLOW4_short "FCtl_DTC_0x04(496)" VALUE 0x00163FB0 /* @ECU_Address@FCtl_DTC_0x04@0x024C43E0@ */ ECIPP_ALIGNMENT_UWORD 65535 Compu_IDENTITY 0 65535 PHYS_UNIT "System ID + DTC" /end CHARACTERISTIC
/begin CHARACTERISTIC FCdc4_GLOW5_open "FCtl_DTC_0x04(487)" VALUE 0x00163F9E /* @ECU_Address@FCtl_DTC_0x04@0x024C43CE@ */ ECIPP_ALIGNMENT_UWORD 65535 Compu_IDENTITY 0 65535 PHYS_UNIT "System ID + DTC" /end CHARACTERISTIC
/begin CHARACTERISTIC FCdc4_GLOW5_short "FCtl_DTC_0x04(497)" VALUE 0x00163FB2 /* @ECU_Address@FCtl_DTC_0x04@0x024C43E2@ */ ECIPP_ALIGNMENT_UWORD 65535 Compu_IDENTITY 0 65535 PHYS_UNIT "System ID + DTC" /end CHARACTERISTIC
/begin CHARACTERISTIC FCdc4_GLOW6_open "FCtl_DTC_0x04(488)" VALUE 0x00163FA0 /* @ECU_Address@FCtl_DTC_0x04@0x024C43D0@ */ ECIPP_ALIGNMENT_UWORD 65535 Compu_IDENTITY 0 65535 PHYS_UNIT "System ID + DTC" /end CHARACTERISTIC
/begin CHARACTERISTIC FCdc4_GLOW6_short "FCtl_DTC_0x04(498)" VALUE 0x00163FB4 /* @ECU_Address@FCtl_DTC_0x04@0x024C43E4@ */ ECIPP_ALIGNMENT_UWORD 65535 Compu_IDENTITY 0 65535 PHYS_UNIT "System ID + DTC" /end CHARACTERISTIC
/begin CHARACTERISTIC FCdc4_GLOW7_open "FCtl_DTC_0x04(489)" VALUE 0x00163FA2 /* @ECU_Address@FCtl_DTC_0x04@0x024C43D2@ */ ECIPP_ALIGNMENT_UWORD 65535 Compu_IDENTITY 0 65535 PHYS_UNIT "System ID + DTC" /end CHARACTERISTIC
/begin CHARACTERISTIC FCdc4_GLOW7_short "FCtl_DTC_0x04(499)" VALUE 0x00163FB6 /* @ECU_Address@FCtl_DTC_0x04@0x024C43E6@ */ ECIPP_ALIGNMENT_UWORD 65535 Compu_IDENTITY 0 65535 PHYS_UNIT "System ID + DTC" /end CHARACTERISTIC
/begin CHARACTERISTIC FCdc4_GLOW8_open "FCtl_DTC_0x04(490)" VALUE 0x00163FA4 /* @ECU_Address@FCtl_DTC_0x04@0x024C43D4@ */ ECIPP_ALIGNMENT_UWORD 65535 Compu_IDENTITY 0 65535 PHYS_UNIT "System ID + DTC" /end CHARACTERISTIC
/begin CHARACTERISTIC FCdc4_GLOW8_short "FCtl_DTC_0x04(500)" VALUE 0x00163FB8 /* @ECU_Address@FCtl_DTC_0x04@0x024C43E8@ */ ECIPP_ALIGNMENT_UWORD 65535 Compu_IDENTITY 0 65535 PHYS_UNIT "System ID + DTC" /end CHARACTERISTIC
/begin CHARACTERISTIC FCdc4_GLOW9_open "FCtl_DTC_0x04(491)" VALUE 0x00163FA6 /* @ECU_Address@FCtl_DTC_0x04@0x024C43D6@ */ ECIPP_ALIGNMENT_UWORD 65535 Compu_IDENTITY 0 65535 PHYS_UNIT "System ID + DTC" /end CHARACTERISTIC
/begin CHARACTERISTIC FCdc4_GLOW9_short "FCtl_DTC_0x04(501)" VALUE 0x00163FBA /* @ECU_Address@FCtl_DTC_0x04@0x024C43EA@ */ ECIPP_ALIGNMENT_UWORD 65535 Compu_IDENTITY 0 65535 PHYS_UNIT "System ID + DTC" /end CHARACTERISTIC
/begin CHARACTERISTIC FCdc4_ICAVD10_mis "FCtl_DTC_0x04(315)" VALUE 0x00163E46 /* @ECU_Address@FCtl_DTC_0x04@0x024C4276@ */ ECIPP_ALIGNMENT_UWORD 65535 Compu_IDENTITY 0 65535 PHYS_UNIT "System ID + DTC" /end CHARACTERISTIC
/begin CHARACTERISTIC FCdc4_ICAVD10_miscat "FCtl_DTC_0x04(317)" VALUE 0x00163E4A /* @ECU_Address@FCtl_DTC_0x04@0x024C427A@ */ ECIPP_ALIGNMENT_UWORD 65535 Compu_IDENTITY 0 65535 PHYS_UNIT "System ID + DTC" /end CHARACTERISTIC
/begin CHARACTERISTIC FCdc4_ICAVD2_mis "FCtl_DTC_0x04(260)" VALUE 0x00163DD8 /* @ECU_Address@FCtl_DTC_0x04@0x024C4208@ */ ECIPP_ALIGNMENT_UWORD 65535 Compu_IDENTITY 0 65535 PHYS_UNIT "System ID + DTC" /end CHARACTERISTIC
/begin CHARACTERISTIC FCdc4_ICAVD2_miscat "FCtl_DTC_0x04(268)" VALUE 0x00163DE8 /* @ECU_Address@FCtl_DTC_0x04@0x024C4218@ */ ECIPP_ALIGNMENT_UWORD 65535 Compu_IDENTITY 0 65535 PHYS_UNIT "System ID + DTC" /end CHARACTERISTIC
/begin CHARACTERISTIC FCdc4_ICAVD3_mis "FCtl_DTC_0x04(261)" VALUE 0x00163DDA /* @ECU_Address@FCtl_DTC_0x04@0x024C420A@ */ ECIPP_ALIGNMENT_UWORD 65535 Compu_IDENTITY 0 65535 PHYS_UNIT "System ID + DTC" /end CHARACTERISTIC
/begin CHARACTERISTIC FCdc4_ICAVD3_miscat "FCtl_DTC_0x04(269)" VALUE 0x00163DEA /* @ECU_Address@FCtl_DTC_0x04@0x024C421A@ */ ECIPP_ALIGNMENT_UWORD 65535 Compu_IDENTITY 0 65535 PHYS_UNIT "System ID + DTC" /end CHARACTERISTIC
/begin CHARACTERISTIC FCdc4_ICAVD4_mis "FCtl_DTC_0x04(262)" VALUE 0x00163DDC /* @ECU_Address@FCtl_DTC_0x04@0x024C420C@ */ ECIPP_ALIGNMENT_UWORD 65535 Compu_IDENTITY 0 65535 PHYS_UNIT "System ID + DTC" /end CHARACTERISTIC
/begin CHARACTERISTIC FCdc4_ICAVD4_miscat "FCtl_DTC_0x04(270)" VALUE 0x00163DEC /* @ECU_Address@FCtl_DTC_0x04@0x024C421C@ */ ECIPP_ALIGNMENT_UWORD 65535 Compu_IDENTITY 0 65535 PHYS_UNIT "System ID + DTC" /end CHARACTERISTIC
/begin CHARACTERISTIC FCdc4_ICAVD5_mis "FCtl_DTC_0x04(263)" VALUE 0x00163DDE /* @ECU_Address@FCtl_DTC_0x04@0x024C420E@ */ ECIPP_ALIGNMENT_UWORD 65535 Compu_IDENTITY 0 65535 PHYS_UNIT "System ID + DTC" /end CHARACTERISTIC
/begin CHARACTERISTIC FCdc4_ICAVD5_miscat "FCtl_DTC_0x04(271)" VALUE 0x00163DEE /* @ECU_Address@FCtl_DTC_0x04@0x024C421E@ */ ECIPP_ALIGNMENT_UWORD 65535 Compu_IDENTITY 0 65535 PHYS_UNIT "System ID + DTC" /end CHARACTERISTIC
/begin CHARACTERISTIC FCdc4_ICAVD6_mis "FCtl_DTC_0x04(264)" VALUE 0x00163DE0 /* @ECU_Address@FCtl_DTC_0x04@0x024C4210@ */ ECIPP_ALIGNMENT_UWORD 65535 Compu_IDENTITY 0 65535 PHYS_UNIT "System ID + DTC" /end CHARACTERISTIC
/begin CHARACTERISTIC FCdc4_ICAVD6_miscat "FCtl_DTC_0x04(272)" VALUE 0x00163DF0 /* @ECU_Address@FCtl_DTC_0x04@0x024C4220@ */ ECIPP_ALIGNMENT_UWORD 65535 Compu_IDENTITY 0 65535 PHYS_UNIT "System ID + DTC" /end CHARACTERISTIC
/begin CHARACTERISTIC FCdc4_ICAVD7_mis "FCtl_DTC_0x04(265)" VALUE 0x00163DE2 /* @ECU_Address@FCtl_DTC_0x04@0x024C4212@ */ ECIPP_ALIGNMENT_UWORD 65535 Compu_IDENTITY 0 65535 PHYS_UNIT "System ID + DTC" /end CHARACTERISTIC
/begin CHARACTERISTIC FCdc4_ICAVD7_miscat "FCtl_DTC_0x04(273)" VALUE 0x00163DF2 /* @ECU_Address@FCtl_DTC_0x04@0x024C4222@ */ ECIPP_ALIGNMENT_UWORD 65535 Compu_IDENTITY 0 65535 PHYS_UNIT "System ID + DTC" /end CHARACTERISTIC
/begin CHARACTERISTIC FCdc4_ICAVD8_mis "FCtl_DTC_0x04(266)" VALUE 0x00163DE4 /* @ECU_Address@FCtl_DTC_0x04@0x024C4214@ */ ECIPP_ALIGNMENT_UWORD 65535 Compu_IDENTITY 0 65535 PHYS_UNIT "System ID + DTC" /end CHARACTERISTIC
/begin CHARACTERISTIC FCdc4_ICAVD8_miscat "FCtl_DTC_0x04(274)" VALUE 0x00163DF4 /* @ECU_Address@FCtl_DTC_0x04@0x024C4224@ */ ECIPP_ALIGNMENT_UWORD 65535 Compu_IDENTITY 0 65535 PHYS_UNIT "System ID + DTC" /end CHARACTERISTIC
/begin CHARACTERISTIC FCdc4_ICAVD9_mis "FCtl_DTC_0x04(314)" VALUE 0x00163E44 /* @ECU_Address@FCtl_DTC_0x04@0x024C4274@ */ ECIPP_ALIGNMENT_UWORD 65535 Compu_IDENTITY 0 65535 PHYS_UNIT "System ID + DTC" /end CHARACTERISTIC
/begin CHARACTERISTIC FCdc4_ICAVD9_miscat "FCtl_DTC_0x04(316)" VALUE 0x00163E48 /* @ECU_Address@FCtl_DTC_0x04@0x024C4278@ */ ECIPP_ALIGNMENT_UWORD 65535 Compu_IDENTITY 0 65535 PHYS_UNIT "System ID + DTC" /end CHARACTERISTIC
/begin CHARACTERISTIC FCdc4_INJD10_off_lo "FCtl_DTC_0x04(55)" VALUE 0x00163C3E /* @ECU_Address@FCtl_DTC_0x04@0x024C406E@ */ ECIPP_ALIGNMENT_UWORD 65535 Compu_IDENTITY 0 65535 PHYS_UNIT "System ID + DTC" /end CHARACTERISTIC
/begin CHARACTERISTIC FCdc4_INJD10_on_hi "FCtl_DTC_0x04(65)" VALUE 0x00163C52 /* @ECU_Address@FCtl_DTC_0x04@0x024C4082@ */ ECIPP_ALIGNMENT_UWORD 65535 Compu_IDENTITY 0 65535 PHYS_UNIT "System ID + DTC" /end CHARACTERISTIC
/begin CHARACTERISTIC FCdc4_INJD2_boost_lo "FCtl_DTC_0x04(579)" VALUE 0x00164056 /* @ECU_Address@FCtl_DTC_0x04@0x024C4486@ */ ECIPP_ALIGNMENT_UWORD 65535 Compu_IDENTITY 0 65535 PHYS_UNIT "System ID + DTC" /end CHARACTERISTIC
/begin CHARACTERISTIC FCdc4_INJD2_HS_Ihi "FCtl_DTC_0x04(563)" VALUE 0x00164036 /* @ECU_Address@FCtl_DTC_0x04@0x024C4466@ */ ECIPP_ALIGNMENT_UWORD 65535 Compu_IDENTITY 0 65535 PHYS_UNIT "System ID + DTC" /end CHARACTERISTIC
/begin CHARACTERISTIC FCdc4_INJD2_HW_int "FCtl_DTC_0x04(581)" VALUE 0x0016405A /* @ECU_Address@FCtl_DTC_0x04@0x024C448A@ */ ECIPP_ALIGNMENT_UWORD 65535 Compu_IDENTITY 0 65535 PHYS_UNIT "System ID + DTC" /end CHARACTERISTIC
/begin CHARACTERISTIC FCdc4_INJD2_LS_Ihi "FCtl_DTC_0x04(571)" VALUE 0x00164046 /* @ECU_Address@FCtl_DTC_0x04@0x024C4476@ */ ECIPP_ALIGNMENT_UWORD 65535 Compu_IDENTITY 0 65535 PHYS_UNIT "System ID + DTC" /end CHARACTERISTIC
/begin CHARACTERISTIC FCdc4_INJD2_off_lo "FCtl_DTC_0x04(47)" VALUE 0x00163C2E /* @ECU_Address@FCtl_DTC_0x04@0x024C405E@ */ ECIPP_ALIGNMENT_UWORD 65535 Compu_IDENTITY 0 65535 PHYS_UNIT "System ID + DTC" /end CHARACTERISTIC
/begin CHARACTERISTIC FCdc4_INJD2_on_hi "FCtl_DTC_0x04(57)" VALUE 0x00163C42 /* @ECU_Address@FCtl_DTC_0x04@0x024C4072@ */ ECIPP_ALIGNMENT_UWORD 65535 Compu_IDENTITY 0 65535 PHYS_UNIT "System ID + DTC" /end CHARACTERISTIC
/begin CHARACTERISTIC FCdc4_INJD3_HS_Ihi "FCtl_DTC_0x04(564)" VALUE 0x00164038 /* @ECU_Address@FCtl_DTC_0x04@0x024C4468@ */ ECIPP_ALIGNMENT_UWORD 65535 Compu_IDENTITY 0 65535 PHYS_UNIT "System ID + DTC" /end CHARACTERISTIC
/begin CHARACTERISTIC FCdc4_INJD3_LS_Ihi "FCtl_DTC_0x04(572)" VALUE 0x00164048 /* @ECU_Address@FCtl_DTC_0x04@0x024C4478@ */ ECIPP_ALIGNMENT_UWORD 65535 Compu_IDENTITY 0 65535 PHYS_UNIT "System ID + DTC" /end CHARACTERISTIC
/begin CHARACTERISTIC FCdc4_INJD3_off_lo "FCtl_DTC_0x04(48)" VALUE 0x00163C30 /* @ECU_Address@FCtl_DTC_0x04@0x024C4060@ */ ECIPP_ALIGNMENT_UWORD 65535 Compu_IDENTITY 0 65535 PHYS_UNIT "System ID + DTC" /end CHARACTERISTIC
/begin CHARACTERISTIC FCdc4_INJD3_on_hi "FCtl_DTC_0x04(58)" VALUE 0x00163C44 /* @ECU_Address@FCtl_DTC_0x04@0x024C4074@ */ ECIPP_ALIGNMENT_UWORD 65535 Compu_IDENTITY 0 65535 PHYS_UNIT "System ID + DTC" /end CHARACTERISTIC
/begin CHARACTERISTIC FCdc4_INJD4_HS_Ihi "FCtl_DTC_0x04(565)" VALUE 0x0016403A /* @ECU_Address@FCtl_DTC_0x04@0x024C446A@ */ ECIPP_ALIGNMENT_UWORD 65535 Compu_IDENTITY 0 65535 PHYS_UNIT "System ID + DTC" /end CHARACTERISTIC
/begin CHARACTERISTIC FCdc4_INJD4_LS_Ihi "FCtl_DTC_0x04(573)" VALUE 0x0016404A /* @ECU_Address@FCtl_DTC_0x04@0x024C447A@ */ ECIPP_ALIGNMENT_UWORD 65535 Compu_IDENTITY 0 65535 PHYS_UNIT "System ID + DTC" /end CHARACTERISTIC
/begin CHARACTERISTIC FCdc4_INJD4_off_lo "FCtl_DTC_0x04(49)" VALUE 0x00163C32 /* @ECU_Address@FCtl_DTC_0x04@0x024C4062@ */ ECIPP_ALIGNMENT_UWORD 65535 Compu_IDENTITY 0 65535 PHYS_UNIT "System ID + DTC" /end CHARACTERISTIC
/begin CHARACTERISTIC FCdc4_INJD4_on_hi "FCtl_DTC_0x04(59)" VALUE 0x00163C46 /* @ECU_Address@FCtl_DTC_0x04@0x024C4076@ */ ECIPP_ALIGNMENT_UWORD 65535 Compu_IDENTITY 0 65535 PHYS_UNIT "System ID + DTC" /end CHARACTERISTIC
/begin CHARACTERISTIC FCdc4_INJD5_HS_Ihi "FCtl_DTC_0x04(566)" VALUE 0x0016403C /* @ECU_Address@FCtl_DTC_0x04@0x024C446C@ */ ECIPP_ALIGNMENT_UWORD 65535 Compu_IDENTITY 0 65535 PHYS_UNIT "System ID + DTC" /end CHARACTERISTIC
/begin CHARACTERISTIC FCdc4_INJD5_LS_Ihi "FCtl_DTC_0x04(574)" VALUE 0x0016404C /* @ECU_Address@FCtl_DTC_0x04@0x024C447C@ */ ECIPP_ALIGNMENT_UWORD 65535 Compu_IDENTITY 0 65535 PHYS_UNIT "System ID + DTC" /end CHARACTERISTIC
/begin CHARACTERISTIC FCdc4_INJD5_off_lo "FCtl_DTC_0x04(50)" VALUE 0x00163C34 /* @ECU_Address@FCtl_DTC_0x04@0x024C4064@ */ ECIPP_ALIGNMENT_UWORD 65535 Compu_IDENTITY 0 65535 PHYS_UNIT "System ID + DTC" /end CHARACTERISTIC
/begin CHARACTERISTIC FCdc4_INJD5_on_hi "FCtl_DTC_0x04(60)" VALUE 0x00163C48 /* @ECU_Address@FCtl_DTC_0x04@0x024C4078@ */ ECIPP_ALIGNMENT_UWORD 65535 Compu_IDENTITY 0 65535 PHYS_UNIT "System ID + DTC" /end CHARACTERISTIC
/begin CHARACTERISTIC FCdc4_INJD6_HS_Ihi "FCtl_DTC_0x04(567)" VALUE 0x0016403E /* @ECU_Address@FCtl_DTC_0x04@0x024C446E@ */ ECIPP_ALIGNMENT_UWORD 65535 Compu_IDENTITY 0 65535 PHYS_UNIT "System ID + DTC" /end CHARACTERISTIC
/begin CHARACTERISTIC FCdc4_INJD6_LS_Ihi "FCtl_DTC_0x04(575)" VALUE 0x0016404E /* @ECU_Address@FCtl_DTC_0x04@0x024C447E@ */ ECIPP_ALIGNMENT_UWORD 65535 Compu_IDENTITY 0 65535 PHYS_UNIT "System ID + DTC" /end CHARACTERISTIC
/begin CHARACTERISTIC FCdc4_INJD6_off_lo "FCtl_DTC_0x04(51)" VALUE 0x00163C36 /* @ECU_Address@FCtl_DTC_0x04@0x024C4066@ */ ECIPP_ALIGNMENT_UWORD 65535 Compu_IDENTITY 0 65535 PHYS_UNIT "System ID + DTC" /end CHARACTERISTIC
/begin CHARACTERISTIC FCdc4_INJD6_on_hi "FCtl_DTC_0x04(61)" VALUE 0x00163C4A /* @ECU_Address@FCtl_DTC_0x04@0x024C407A@ */ ECIPP_ALIGNMENT_UWORD 65535 Compu_IDENTITY 0 65535 PHYS_UNIT "System ID + DTC" /end CHARACTERISTIC
/begin CHARACTERISTIC FCdc4_INJD7_HS_Ihi "FCtl_DTC_0x04(568)" VALUE 0x00164040 /* @ECU_Address@FCtl_DTC_0x04@0x024C4470@ */ ECIPP_ALIGNMENT_UWORD 65535 Compu_IDENTITY 0 65535 PHYS_UNIT "System ID + DTC" /end CHARACTERISTIC
/begin CHARACTERISTIC FCdc4_INJD7_LS_Ihi "FCtl_DTC_0x04(576)" VALUE 0x00164050 /* @ECU_Address@FCtl_DTC_0x04@0x024C4480@ */ ECIPP_ALIGNMENT_UWORD 65535 Compu_IDENTITY 0 65535 PHYS_UNIT "System ID + DTC" /end CHARACTERISTIC
/begin CHARACTERISTIC FCdc4_INJD7_off_lo "FCtl_DTC_0x04(52)" VALUE 0x00163C38 /* @ECU_Address@FCtl_DTC_0x04@0x024C4068@ */ ECIPP_ALIGNMENT_UWORD 65535 Compu_IDENTITY 0 65535 PHYS_UNIT "System ID + DTC" /end CHARACTERISTIC
/begin CHARACTERISTIC FCdc4_INJD7_on_hi "FCtl_DTC_0x04(62)" VALUE 0x00163C4C /* @ECU_Address@FCtl_DTC_0x04@0x024C407C@ */ ECIPP_ALIGNMENT_UWORD 65535 Compu_IDENTITY 0 65535 PHYS_UNIT "System ID + DTC" /end CHARACTERISTIC
/begin CHARACTERISTIC FCdc4_INJD8_HS_Ihi "FCtl_DTC_0x04(569)" VALUE 0x00164042 /* @ECU_Address@FCtl_DTC_0x04@0x024C4472@ */ ECIPP_ALIGNMENT_UWORD 65535 Compu_IDENTITY 0 65535 PHYS_UNIT "System ID + DTC" /end CHARACTERISTIC
/begin CHARACTERISTIC FCdc4_INJD8_LS_Ihi "FCtl_DTC_0x04(577)" VALUE 0x00164052 /* @ECU_Address@FCtl_DTC_0x04@0x024C4482@ */ ECIPP_ALIGNMENT_UWORD 65535 Compu_IDENTITY 0 65535 PHYS_UNIT "System ID + DTC" /end CHARACTERISTIC
/begin CHARACTERISTIC FCdc4_INJD8_off_lo "FCtl_DTC_0x04(53)" VALUE 0x00163C3A /* @ECU_Address@FCtl_DTC_0x04@0x024C406A@ */ ECIPP_ALIGNMENT_UWORD 65535 Compu_IDENTITY 0 65535 PHYS_UNIT "System ID + DTC" /end CHARACTERISTIC
/begin CHARACTERISTIC FCdc4_INJD8_on_hi "FCtl_DTC_0x04(63)" VALUE 0x00163C4E /* @ECU_Address@FCtl_DTC_0x04@0x024C407E@ */ ECIPP_ALIGNMENT_UWORD 65535 Compu_IDENTITY 0 65535 PHYS_UNIT "System ID + DTC" /end CHARACTERISTIC
/begin CHARACTERISTIC FCdc4_INJD9_off_lo "FCtl_DTC_0x04(54)" VALUE 0x00163C3C /* @ECU_Address@FCtl_DTC_0x04@0x024C406C@ */ ECIPP_ALIGNMENT_UWORD 65535 Compu_IDENTITY 0 65535 PHYS_UNIT "System ID + DTC" /end CHARACTERISTIC
/begin CHARACTERISTIC FCdc4_INJD9_on_hi "FCtl_DTC_0x04(64)" VALUE 0x00163C50 /* @ECU_Address@FCtl_DTC_0x04@0x024C4080@ */ ECIPP_ALIGNMENT_UWORD 65535 Compu_IDENTITY 0 65535 PHYS_UNIT "System ID + DTC" /end CHARACTERISTIC
/begin CHARACTERISTIC FCdc4_KNK2_max "FCtl_DTC_0x04(185)" VALUE 0x00163D42 /* @ECU_Address@FCtl_DTC_0x04@0x024C4172@ */ ECIPP_ALIGNMENT_UWORD 65535 Compu_IDENTITY 0 65535 PHYS_UNIT "System ID + DTC" /end CHARACTERISTIC
/begin CHARACTERISTIC FCdc4_KNK2_min "FCtl_DTC_0x04(184)" VALUE 0x00163D40 /* @ECU_Address@FCtl_DTC_0x04@0x024C4170@ */ ECIPP_ALIGNMENT_UWORD 65535 Compu_IDENTITY 0 65535 PHYS_UNIT "System ID + DTC" /end CHARACTERISTIC
/begin CHARACTERISTIC FCdc4_KNK3_max "FCtl_DTC_0x04(806)" VALUE 0x0016421C /* @ECU_Address@FCtl_DTC_0x04@0x024C464C@ */ ECIPP_ALIGNMENT_UWORD 65535 Compu_IDENTITY 0 65535 PHYS_UNIT "System ID + DTC" /end CHARACTERISTIC
/begin CHARACTERISTIC FCdc4_KNK3_min "FCtl_DTC_0x04(805)" VALUE 0x0016421A /* @ECU_Address@FCtl_DTC_0x04@0x024C464A@ */ ECIPP_ALIGNMENT_UWORD 65535 Compu_IDENTITY 0 65535 PHYS_UNIT "System ID + DTC" /end CHARACTERISTIC
/begin CHARACTERISTIC FCdc4_SPK10_IGBT_T "FCtl_DTC_0x04(518)" VALUE 0x00163FDC /* @ECU_Address@FCtl_DTC_0x04@0x024C440C@ */ ECIPP_ALIGNMENT_UWORD 65535 Compu_IDENTITY 0 65535 PHYS_UNIT "System ID + DTC" /end CHARACTERISTIC
/begin CHARACTERISTIC FCdc4_SPK2_IGBT_T "FCtl_DTC_0x04(510)" VALUE 0x00163FCC /* @ECU_Address@FCtl_DTC_0x04@0x024C43FC@ */ ECIPP_ALIGNMENT_UWORD 65535 Compu_IDENTITY 0 65535 PHYS_UNIT "System ID + DTC" /end CHARACTERISTIC
/begin CHARACTERISTIC FCdc4_SPK3_IGBT_T "FCtl_DTC_0x04(511)" VALUE 0x00163FCE /* @ECU_Address@FCtl_DTC_0x04@0x024C43FE@ */ ECIPP_ALIGNMENT_UWORD 65535 Compu_IDENTITY 0 65535 PHYS_UNIT "System ID + DTC" /end CHARACTERISTIC
/begin CHARACTERISTIC FCdc4_SPK4_IGBT_T "FCtl_DTC_0x04(512)" VALUE 0x00163FD0 /* @ECU_Address@FCtl_DTC_0x04@0x024C4400@ */ ECIPP_ALIGNMENT_UWORD 65535 Compu_IDENTITY 0 65535 PHYS_UNIT "System ID + DTC" /end CHARACTERISTIC
/begin CHARACTERISTIC FCdc4_SPK5_IGBT_T "FCtl_DTC_0x04(513)" VALUE 0x00163FD2 /* @ECU_Address@FCtl_DTC_0x04@0x024C4402@ */ ECIPP_ALIGNMENT_UWORD 65535 Compu_IDENTITY 0 65535 PHYS_UNIT "System ID + DTC" /end CHARACTERISTIC
/begin CHARACTERISTIC FCdc4_SPK6_IGBT_T "FCtl_DTC_0x04(514)" VALUE 0x00163FD4 /* @ECU_Address@FCtl_DTC_0x04@0x024C4404@ */ ECIPP_ALIGNMENT_UWORD 65535 Compu_IDENTITY 0 65535 PHYS_UNIT "System ID + DTC" /end CHARACTERISTIC
/begin CHARACTERISTIC FCdc4_SPK7_IGBT_T "FCtl_DTC_0x04(515)" VALUE 0x00163FD6 /* @ECU_Address@FCtl_DTC_0x04@0x024C4406@ */ ECIPP_ALIGNMENT_UWORD 65535 Compu_IDENTITY 0 65535 PHYS_UNIT "System ID + DTC" /end CHARACTERISTIC
/begin CHARACTERISTIC FCdc4_SPK8_IGBT_T "FCtl_DTC_0x04(516)" VALUE 0x00163FD8 /* @ECU_Address@FCtl_DTC_0x04@0x024C4408@ */ ECIPP_ALIGNMENT_UWORD 65535 Compu_IDENTITY 0 65535 PHYS_UNIT "System ID + DTC" /end CHARACTERISTIC
/begin CHARACTERISTIC FCdc4_SPK9_IGBT_T "FCtl_DTC_0x04(517)" VALUE 0x00163FDA /* @ECU_Address@FCtl_DTC_0x04@0x024C440A@ */ ECIPP_ALIGNMENT_UWORD 65535 Compu_IDENTITY 0 65535 PHYS_UNIT "System ID + DTC" /end CHARACTERISTIC
/begin CHARACTERISTIC FCdc4_SPKD10_coil_fail "FCtl_DTC_0x04(313)" VALUE 0x00163E42 /* @ECU_Address@FCtl_DTC_0x04@0x024C4272@ */ ECIPP_ALIGNMENT_UWORD 65535 Compu_IDENTITY 0 65535 PHYS_UNIT "System ID + DTC" /end CHARACTERISTIC
/begin CHARACTERISTIC FCdc4_SPKD10_dw_hi "FCtl_DTC_0x04(85)" VALUE 0x00163C7A /* @ECU_Address@FCtl_DTC_0x04@0x024C40AA@ */ ECIPP_ALIGNMENT_UWORD 65535 Compu_IDENTITY 0 65535 PHYS_UNIT "System ID + DTC" /end CHARACTERISTIC
/begin CHARACTERISTIC FCdc4_SPKD10_dw_lo "FCtl_DTC_0x04(75)" VALUE 0x00163C66 /* @ECU_Address@FCtl_DTC_0x04@0x024C4096@ */ ECIPP_ALIGNMENT_UWORD 65535 Compu_IDENTITY 0 65535 PHYS_UNIT "System ID + DTC" /end CHARACTERISTIC
/begin CHARACTERISTIC FCdc4_SPKD2_coil_fail "FCtl_DTC_0x04(305)" VALUE 0x00163E32 /* @ECU_Address@FCtl_DTC_0x04@0x024C4262@ */ ECIPP_ALIGNMENT_UWORD 65535 Compu_IDENTITY 0 65535 PHYS_UNIT "System ID + DTC" /end CHARACTERISTIC
/begin CHARACTERISTIC FCdc4_SPKD2_dw_hi "FCtl_DTC_0x04(77)" VALUE 0x00163C6A /* @ECU_Address@FCtl_DTC_0x04@0x024C409A@ */ ECIPP_ALIGNMENT_UWORD 65535 Compu_IDENTITY 0 65535 PHYS_UNIT "System ID + DTC" /end CHARACTERISTIC
/begin CHARACTERISTIC FCdc4_SPKD2_dw_lo "FCtl_DTC_0x04(67)" VALUE 0x00163C56 /* @ECU_Address@FCtl_DTC_0x04@0x024C4086@ */ ECIPP_ALIGNMENT_UWORD 65535 Compu_IDENTITY 0 65535 PHYS_UNIT "System ID + DTC" /end CHARACTERISTIC
/begin CHARACTERISTIC FCdc4_SPKD3_coil_fail "FCtl_DTC_0x04(306)" VALUE 0x00163E34 /* @ECU_Address@FCtl_DTC_0x04@0x024C4264@ */ ECIPP_ALIGNMENT_UWORD 65535 Compu_IDENTITY 0 65535 PHYS_UNIT "System ID + DTC" /end CHARACTERISTIC
/begin CHARACTERISTIC FCdc4_SPKD3_dw_hi "FCtl_DTC_0x04(78)" VALUE 0x00163C6C /* @ECU_Address@FCtl_DTC_0x04@0x024C409C@ */ ECIPP_ALIGNMENT_UWORD 65535 Compu_IDENTITY 0 65535 PHYS_UNIT "System ID + DTC" /end CHARACTERISTIC
/begin CHARACTERISTIC FCdc4_SPKD3_dw_lo "FCtl_DTC_0x04(68)" VALUE 0x00163C58 /* @ECU_Address@FCtl_DTC_0x04@0x024C4088@ */ ECIPP_ALIGNMENT_UWORD 65535 Compu_IDENTITY 0 65535 PHYS_UNIT "System ID + DTC" /end CHARACTERISTIC
/begin CHARACTERISTIC FCdc4_SPKD4_coil_fail "FCtl_DTC_0x04(307)" VALUE 0x00163E36 /* @ECU_Address@FCtl_DTC_0x04@0x024C4266@ */ ECIPP_ALIGNMENT_UWORD 65535 Compu_IDENTITY 0 65535 PHYS_UNIT "System ID + DTC" /end CHARACTERISTIC
/begin CHARACTERISTIC FCdc4_SPKD4_dw_hi "FCtl_DTC_0x04(79)" VALUE 0x00163C6E /* @ECU_Address@FCtl_DTC_0x04@0x024C409E@ */ ECIPP_ALIGNMENT_UWORD 65535 Compu_IDENTITY 0 65535 PHYS_UNIT "System ID + DTC" /end CHARACTERISTIC
/begin CHARACTERISTIC FCdc4_SPKD4_dw_lo "FCtl_DTC_0x04(69)" VALUE 0x00163C5A /* @ECU_Address@FCtl_DTC_0x04@0x024C408A@ */ ECIPP_ALIGNMENT_UWORD 65535 Compu_IDENTITY 0 65535 PHYS_UNIT "System ID + DTC" /end CHARACTERISTIC
/begin CHARACTERISTIC FCdc4_SPKD5_coil_fail "FCtl_DTC_0x04(308)" VALUE 0x00163E38 /* @ECU_Address@FCtl_DTC_0x04@0x024C4268@ */ ECIPP_ALIGNMENT_UWORD 65535 Compu_IDENTITY 0 65535 PHYS_UNIT "System ID + DTC" /end CHARACTERISTIC
/begin CHARACTERISTIC FCdc4_SPKD5_dw_hi "FCtl_DTC_0x04(80)" VALUE 0x00163C70 /* @ECU_Address@FCtl_DTC_0x04@0x024C40A0@ */ ECIPP_ALIGNMENT_UWORD 65535 Compu_IDENTITY 0 65535 PHYS_UNIT "System ID + DTC" /end CHARACTERISTIC
/begin CHARACTERISTIC FCdc4_SPKD5_dw_lo "FCtl_DTC_0x04(70)" VALUE 0x00163C5C /* @ECU_Address@FCtl_DTC_0x04@0x024C408C@ */ ECIPP_ALIGNMENT_UWORD 65535 Compu_IDENTITY 0 65535 PHYS_UNIT "System ID + DTC" /end CHARACTERISTIC
/begin CHARACTERISTIC FCdc4_SPKD6_coil_fail "FCtl_DTC_0x04(309)" VALUE 0x00163E3A /* @ECU_Address@FCtl_DTC_0x04@0x024C426A@ */ ECIPP_ALIGNMENT_UWORD 65535 Compu_IDENTITY 0 65535 PHYS_UNIT "System ID + DTC" /end CHARACTERISTIC
/begin CHARACTERISTIC FCdc4_SPKD6_dw_hi "FCtl_DTC_0x04(81)" VALUE 0x00163C72 /* @ECU_Address@FCtl_DTC_0x04@0x024C40A2@ */ ECIPP_ALIGNMENT_UWORD 65535 Compu_IDENTITY 0 65535 PHYS_UNIT "System ID + DTC" /end CHARACTERISTIC
/begin CHARACTERISTIC FCdc4_SPKD6_dw_lo "FCtl_DTC_0x04(71)" VALUE 0x00163C5E /* @ECU_Address@FCtl_DTC_0x04@0x024C408E@ */ ECIPP_ALIGNMENT_UWORD 65535 Compu_IDENTITY 0 65535 PHYS_UNIT "System ID + DTC" /end CHARACTERISTIC
/begin CHARACTERISTIC FCdc4_SPKD7_coil_fail "FCtl_DTC_0x04(310)" VALUE 0x00163E3C /* @ECU_Address@FCtl_DTC_0x04@0x024C426C@ */ ECIPP_ALIGNMENT_UWORD 65535 Compu_IDENTITY 0 65535 PHYS_UNIT "System ID + DTC" /end CHARACTERISTIC
/begin CHARACTERISTIC FCdc4_SPKD7_dw_hi "FCtl_DTC_0x04(82)" VALUE 0x00163C74 /* @ECU_Address@FCtl_DTC_0x04@0x024C40A4@ */ ECIPP_ALIGNMENT_UWORD 65535 Compu_IDENTITY 0 65535 PHYS_UNIT "System ID + DTC" /end CHARACTERISTIC
/begin CHARACTERISTIC FCdc4_SPKD7_dw_lo "FCtl_DTC_0x04(72)" VALUE 0x00163C60 /* @ECU_Address@FCtl_DTC_0x04@0x024C4090@ */ ECIPP_ALIGNMENT_UWORD 65535 Compu_IDENTITY 0 65535 PHYS_UNIT "System ID + DTC" /end CHARACTERISTIC
/begin CHARACTERISTIC FCdc4_SPKD8_coil_fail "FCtl_DTC_0x04(311)" VALUE 0x00163E3E /* @ECU_Address@FCtl_DTC_0x04@0x024C426E@ */ ECIPP_ALIGNMENT_UWORD 65535 Compu_IDENTITY 0 65535 PHYS_UNIT "System ID + DTC" /end CHARACTERISTIC
/begin CHARACTERISTIC FCdc4_SPKD8_dw_hi "FCtl_DTC_0x04(83)" VALUE 0x00163C76 /* @ECU_Address@FCtl_DTC_0x04@0x024C40A6@ */ ECIPP_ALIGNMENT_UWORD 65535 Compu_IDENTITY 0 65535 PHYS_UNIT "System ID + DTC" /end CHARACTERISTIC
/begin CHARACTERISTIC FCdc4_SPKD8_dw_lo "FCtl_DTC_0x04(73)" VALUE 0x00163C62 /* @ECU_Address@FCtl_DTC_0x04@0x024C4092@ */ ECIPP_ALIGNMENT_UWORD 65535 Compu_IDENTITY 0 65535 PHYS_UNIT "System ID + DTC" /end CHARACTERISTIC
/begin CHARACTERISTIC FCdc4_SPKD9_coil_fail "FCtl_DTC_0x04(312)" VALUE 0x00163E40 /* @ECU_Address@FCtl_DTC_0x04@0x024C4270@ */ ECIPP_ALIGNMENT_UWORD 65535 Compu_IDENTITY 0 65535 PHYS_UNIT "System ID + DTC" /end CHARACTERISTIC
/begin CHARACTERISTIC FCdc4_SPKD9_dw_hi "FCtl_DTC_0x04(84)" VALUE 0x00163C78 /* @ECU_Address@FCtl_DTC_0x04@0x024C40A8@ */ ECIPP_ALIGNMENT_UWORD 65535 Compu_IDENTITY 0 65535 PHYS_UNIT "System ID + DTC" /end CHARACTERISTIC
/begin CHARACTERISTIC FCdc4_SPKD9_dw_lo "FCtl_DTC_0x04(74)" VALUE 0x00163C64 /* @ECU_Address@FCtl_DTC_0x04@0x024C4094@ */ ECIPP_ALIGNMENT_UWORD 65535 Compu_IDENTITY 0 65535 PHYS_UNIT "System ID + DTC" /end CHARACTERISTIC
/begin CHARACTERISTIC FCdc4_UGF_Hv_lo "FCtl_DTC_0x04(243)" VALUE 0x00163DB6 /* @ECU_Address@FCtl_DTC_0x04@0x024C41E6@ */ ECIPP_ALIGNMENT_UWORD 65535 Compu_IDENTITY 0 65535 PHYS_UNIT "System ID + DTC" /end CHARACTERISTIC
/begin CHARACTERISTIC FCdc4_UGF1_PR_hi "FCtl_DTC_0x04(257)" VALUE 0x00163DD2 /* @ECU_Address@FCtl_DTC_0x04@0x024C4202@ */ ECIPP_ALIGNMENT_UWORD 65535 Compu_IDENTITY 0 65535 PHYS_UNIT "System ID + DTC" /end CHARACTERISTIC
/begin CHARACTERISTIC FCdc4_UGF1_PR_lo "FCtl_DTC_0x04(258)" VALUE 0x00163DD4 /* @ECU_Address@FCtl_DTC_0x04@0x024C4204@ */ ECIPP_ALIGNMENT_UWORD 65535 Compu_IDENTITY 0 65535 PHYS_UNIT "System ID + DTC" /end CHARACTERISTIC
/begin CHARACTERISTIC FCdc4_UGF1_PR_slow "FCtl_DTC_0x04(255)" VALUE 0x00163DCE /* @ECU_Address@FCtl_DTC_0x04@0x024C41FE@ */ ECIPP_ALIGNMENT_UWORD 65535 Compu_IDENTITY 0 65535 PHYS_UNIT "System ID + DTC" /end CHARACTERISTIC
/begin CHARACTERISTIC FCdc4_UGF1_Pv_hi "FCtl_DTC_0x04(252)" VALUE 0x00163DC8 /* @ECU_Address@FCtl_DTC_0x04@0x024C41F8@ */ ECIPP_ALIGNMENT_UWORD 65535 Compu_IDENTITY 0 65535 PHYS_UNIT "System ID + DTC" /end CHARACTERISTIC
/begin CHARACTERISTIC FCdc4_UGF1_Pv_lo "FCtl_DTC_0x04(253)" VALUE 0x00163DCA /* @ECU_Address@FCtl_DTC_0x04@0x024C41FA@ */ ECIPP_ALIGNMENT_UWORD 65535 Compu_IDENTITY 0 65535 PHYS_UNIT "System ID + DTC" /end CHARACTERISTIC
/begin CHARACTERISTIC FCdc4_UGF1_PvFB_hi "FCtl_DTC_0x04(248)" VALUE 0x00163DC0 /* @ECU_Address@FCtl_DTC_0x04@0x024C41F0@ */ ECIPP_ALIGNMENT_UWORD 65535 Compu_IDENTITY 0 65535 PHYS_UNIT "System ID + DTC" /end CHARACTERISTIC
/begin CHARACTERISTIC FCdc4_UGF1_PvFB_lo "FCtl_DTC_0x04(249)" VALUE 0x00163DC2 /* @ECU_Address@FCtl_DTC_0x04@0x024C41F2@ */ ECIPP_ALIGNMENT_UWORD 65535 Compu_IDENTITY 0 65535 PHYS_UNIT "System ID + DTC" /end CHARACTERISTIC
/begin CHARACTERISTIC FCdc4_UGF1_R_lo "FCtl_DTC_0x04(245)" VALUE 0x00163DBA /* @ECU_Address@FCtl_DTC_0x04@0x024C41EA@ */ ECIPP_ALIGNMENT_UWORD 65535 Compu_IDENTITY 0 65535 PHYS_UNIT "System ID + DTC" /end CHARACTERISTIC
/begin CHARACTERISTIC FCdc4_UGF1_rtn_hi "FCtl_DTC_0x04(246)" VALUE 0x00163DBC /* @ECU_Address@FCtl_DTC_0x04@0x024C41EC@ */ ECIPP_ALIGNMENT_UWORD 65535 Compu_IDENTITY 0 65535 PHYS_UNIT "System ID + DTC" /end CHARACTERISTIC
/begin CHARACTERISTIC FCdc4_UGF1_rtn_lo "FCtl_DTC_0x04(247)" VALUE 0x00163DBE /* @ECU_Address@FCtl_DTC_0x04@0x024C41EE@ */ ECIPP_ALIGNMENT_UWORD 65535 Compu_IDENTITY 0 65535 PHYS_UNIT "System ID + DTC" /end CHARACTERISTIC
/begin CHARACTERISTIC FCdc4_UGF1_Sv_lo "FCtl_DTC_0x04(251)" VALUE 0x00163DC6 /* @ECU_Address@FCtl_DTC_0x04@0x024C41F6@ */ ECIPP_ALIGNMENT_UWORD 65535 Compu_IDENTITY 0 65535 PHYS_UNIT "System ID + DTC" /end CHARACTERISTIC
/begin CHARACTERISTIC FCdc4_UGF2_Hv_lo "FCtl_DTC_0x04(410)" VALUE 0x00163F04 /* @ECU_Address@FCtl_DTC_0x04@0x024C4334@ */ ECIPP_ALIGNMENT_UWORD 65535 Compu_IDENTITY 0 65535 PHYS_UNIT "System ID + DTC" /end CHARACTERISTIC
/begin CHARACTERISTIC FCdc4_UGF2_PR_hi "FCtl_DTC_0x04(424)" VALUE 0x00163F20 /* @ECU_Address@FCtl_DTC_0x04@0x024C4350@ */ ECIPP_ALIGNMENT_UWORD 65535 Compu_IDENTITY 0 65535 PHYS_UNIT "System ID + DTC" /end CHARACTERISTIC
/begin CHARACTERISTIC FCdc4_UGF2_PR_lo "FCtl_DTC_0x04(425)" VALUE 0x00163F22 /* @ECU_Address@FCtl_DTC_0x04@0x024C4352@ */ ECIPP_ALIGNMENT_UWORD 65535 Compu_IDENTITY 0 65535 PHYS_UNIT "System ID + DTC" /end CHARACTERISTIC
/begin CHARACTERISTIC FCdc4_UGF2_PR_slow "FCtl_DTC_0x04(422)" VALUE 0x00163F1C /* @ECU_Address@FCtl_DTC_0x04@0x024C434C@ */ ECIPP_ALIGNMENT_UWORD 65535 Compu_IDENTITY 0 65535 PHYS_UNIT "System ID + DTC" /end CHARACTERISTIC
/begin CHARACTERISTIC FCdc4_UGF2_Pv_hi "FCtl_DTC_0x04(419)" VALUE 0x00163F16 /* @ECU_Address@FCtl_DTC_0x04@0x024C4346@ */ ECIPP_ALIGNMENT_UWORD 65535 Compu_IDENTITY 0 65535 PHYS_UNIT "System ID + DTC" /end CHARACTERISTIC
/begin CHARACTERISTIC FCdc4_UGF2_Pv_lo "FCtl_DTC_0x04(420)" VALUE 0x00163F18 /* @ECU_Address@FCtl_DTC_0x04@0x024C4348@ */ ECIPP_ALIGNMENT_UWORD 65535 Compu_IDENTITY 0 65535 PHYS_UNIT "System ID + DTC" /end CHARACTERISTIC
/begin CHARACTERISTIC FCdc4_UGF2_PvFB_hi "FCtl_DTC_0x04(415)" VALUE 0x00163F0E /* @ECU_Address@FCtl_DTC_0x04@0x024C433E@ */ ECIPP_ALIGNMENT_UWORD 65535 Compu_IDENTITY 0 65535 PHYS_UNIT "System ID + DTC" /end CHARACTERISTIC
/begin CHARACTERISTIC FCdc4_UGF2_PvFB_lo "FCtl_DTC_0x04(416)" VALUE 0x00163F10 /* @ECU_Address@FCtl_DTC_0x04@0x024C4340@ */ ECIPP_ALIGNMENT_UWORD 65535 Compu_IDENTITY 0 65535 PHYS_UNIT "System ID + DTC" /end CHARACTERISTIC
/begin CHARACTERISTIC FCdc4_UGF2_R_lo "FCtl_DTC_0x04(412)" VALUE 0x00163F08 /* @ECU_Address@FCtl_DTC_0x04@0x024C4338@ */ ECIPP_ALIGNMENT_UWORD 65535 Compu_IDENTITY 0 65535 PHYS_UNIT "System ID + DTC" /end CHARACTERISTIC
/begin CHARACTERISTIC FCdc4_UGF2_rtn_hi "FCtl_DTC_0x04(413)" VALUE 0x00163F0A /* @ECU_Address@FCtl_DTC_0x04@0x024C433A@ */ ECIPP_ALIGNMENT_UWORD 65535 Compu_IDENTITY 0 65535 PHYS_UNIT "System ID + DTC" /end CHARACTERISTIC
/begin CHARACTERISTIC FCdc4_UGF2_rtn_lo "FCtl_DTC_0x04(414)" VALUE 0x00163F0C /* @ECU_Address@FCtl_DTC_0x04@0x024C433C@ */ ECIPP_ALIGNMENT_UWORD 65535 Compu_IDENTITY 0 65535 PHYS_UNIT "System ID + DTC" /end CHARACTERISTIC
/begin CHARACTERISTIC FCdc4_UGF2_Sv_lo "FCtl_DTC_0x04(418)" VALUE 0x00163F14 /* @ECU_Address@FCtl_DTC_0x04@0x024C4344@ */ ECIPP_ALIGNMENT_UWORD 65535 Compu_IDENTITY 0 65535 PHYS_UNIT "System ID + DTC" /end CHARACTERISTIC
/begin CHARACTERISTIC FCdc4_UGF3_Hv_lo "FCtl_DTC_0x04(606)" VALUE 0x0016408C /* @ECU_Address@FCtl_DTC_0x04@0x024C44BC@ */ ECIPP_ALIGNMENT_UWORD 65535 Compu_IDENTITY 0 65535 PHYS_UNIT "System ID + DTC" /end CHARACTERISTIC
/begin CHARACTERISTIC FCdc4_UGF3_PR_hi "FCtl_DTC_0x04(620)" VALUE 0x001640A8 /* @ECU_Address@FCtl_DTC_0x04@0x024C44D8@ */ ECIPP_ALIGNMENT_UWORD 65535 Compu_IDENTITY 0 65535 PHYS_UNIT "System ID + DTC" /end CHARACTERISTIC
/begin CHARACTERISTIC FCdc4_UGF3_PR_lo "FCtl_DTC_0x04(621)" VALUE 0x001640AA /* @ECU_Address@FCtl_DTC_0x04@0x024C44DA@ */ ECIPP_ALIGNMENT_UWORD 65535 Compu_IDENTITY 0 65535 PHYS_UNIT "System ID + DTC" /end CHARACTERISTIC
/begin CHARACTERISTIC FCdc4_UGF3_PR_slow "FCtl_DTC_0x04(618)" VALUE 0x001640A4 /* @ECU_Address@FCtl_DTC_0x04@0x024C44D4@ */ ECIPP_ALIGNMENT_UWORD 65535 Compu_IDENTITY 0 65535 PHYS_UNIT "System ID + DTC" /end CHARACTERISTIC
/begin CHARACTERISTIC FCdc4_UGF3_Pv_hi "FCtl_DTC_0x04(615)" VALUE 0x0016409E /* @ECU_Address@FCtl_DTC_0x04@0x024C44CE@ */ ECIPP_ALIGNMENT_UWORD 65535 Compu_IDENTITY 0 65535 PHYS_UNIT "System ID + DTC" /end CHARACTERISTIC
/begin CHARACTERISTIC FCdc4_UGF3_Pv_lo "FCtl_DTC_0x04(616)" VALUE 0x001640A0 /* @ECU_Address@FCtl_DTC_0x04@0x024C44D0@ */ ECIPP_ALIGNMENT_UWORD 65535 Compu_IDENTITY 0 65535 PHYS_UNIT "System ID + DTC" /end CHARACTERISTIC
/begin CHARACTERISTIC FCdc4_UGF3_PvFB_hi "FCtl_DTC_0x04(611)" VALUE 0x00164096 /* @ECU_Address@FCtl_DTC_0x04@0x024C44C6@ */ ECIPP_ALIGNMENT_UWORD 65535 Compu_IDENTITY 0 65535 PHYS_UNIT "System ID + DTC" /end CHARACTERISTIC
/begin CHARACTERISTIC FCdc4_UGF3_PvFB_lo "FCtl_DTC_0x04(612)" VALUE 0x00164098 /* @ECU_Address@FCtl_DTC_0x04@0x024C44C8@ */ ECIPP_ALIGNMENT_UWORD 65535 Compu_IDENTITY 0 65535 PHYS_UNIT "System ID + DTC" /end CHARACTERISTIC
/begin CHARACTERISTIC FCdc4_UGF3_R_lo "FCtl_DTC_0x04(608)" VALUE 0x00164090 /* @ECU_Address@FCtl_DTC_0x04@0x024C44C0@ */ ECIPP_ALIGNMENT_UWORD 65535 Compu_IDENTITY 0 65535 PHYS_UNIT "System ID + DTC" /end CHARACTERISTIC
/begin CHARACTERISTIC FCdc4_UGF3_rtn_hi "FCtl_DTC_0x04(609)" VALUE 0x00164092 /* @ECU_Address@FCtl_DTC_0x04@0x024C44C2@ */ ECIPP_ALIGNMENT_UWORD 65535 Compu_IDENTITY 0 65535 PHYS_UNIT "System ID + DTC" /end CHARACTERISTIC
/begin CHARACTERISTIC FCdc4_UGF3_rtn_lo "FCtl_DTC_0x04(610)" VALUE 0x00164094 /* @ECU_Address@FCtl_DTC_0x04@0x024C44C4@ */ ECIPP_ALIGNMENT_UWORD 65535 Compu_IDENTITY 0 65535 PHYS_UNIT "System ID + DTC" /end CHARACTERISTIC
/begin CHARACTERISTIC FCdc4_UGF3_Sv_lo "FCtl_DTC_0x04(614)" VALUE 0x0016409C /* @ECU_Address@FCtl_DTC_0x04@0x024C44CC@ */ ECIPP_ALIGNMENT_UWORD 65535 Compu_IDENTITY 0 65535 PHYS_UNIT "System ID + DTC" /end CHARACTERISTIC
/begin CHARACTERISTIC FCdc4_UGF4_Hv_lo "FCtl_DTC_0x04(629)" VALUE 0x001640BA /* @ECU_Address@FCtl_DTC_0x04@0x024C44EA@ */ ECIPP_ALIGNMENT_UWORD 65535 Compu_IDENTITY 0 65535 PHYS_UNIT "System ID + DTC" /end CHARACTERISTIC
/begin CHARACTERISTIC FCdc4_UGF4_PR_hi "FCtl_DTC_0x04(643)" VALUE 0x001640D6 /* @ECU_Address@FCtl_DTC_0x04@0x024C4506@ */ ECIPP_ALIGNMENT_UWORD 65535 Compu_IDENTITY 0 65535 PHYS_UNIT "System ID + DTC" /end CHARACTERISTIC
/begin CHARACTERISTIC FCdc4_UGF4_PR_lo "FCtl_DTC_0x04(644)" VALUE 0x001640D8 /* @ECU_Address@FCtl_DTC_0x04@0x024C4508@ */ ECIPP_ALIGNMENT_UWORD 65535 Compu_IDENTITY 0 65535 PHYS_UNIT "System ID + DTC" /end CHARACTERISTIC
/begin CHARACTERISTIC FCdc4_UGF4_PR_slow "FCtl_DTC_0x04(641)" VALUE 0x001640D2 /* @ECU_Address@FCtl_DTC_0x04@0x024C4502@ */ ECIPP_ALIGNMENT_UWORD 65535 Compu_IDENTITY 0 65535 PHYS_UNIT "System ID + DTC" /end CHARACTERISTIC
/begin CHARACTERISTIC FCdc4_UGF4_Pv_hi "FCtl_DTC_0x04(638)" VALUE 0x001640CC /* @ECU_Address@FCtl_DTC_0x04@0x024C44FC@ */ ECIPP_ALIGNMENT_UWORD 65535 Compu_IDENTITY 0 65535 PHYS_UNIT "System ID + DTC" /end CHARACTERISTIC
/begin CHARACTERISTIC FCdc4_UGF4_Pv_lo "FCtl_DTC_0x04(639)" VALUE 0x001640CE /* @ECU_Address@FCtl_DTC_0x04@0x024C44FE@ */ ECIPP_ALIGNMENT_UWORD 65535 Compu_IDENTITY 0 65535 PHYS_UNIT "System ID + DTC" /end CHARACTERISTIC
/begin CHARACTERISTIC FCdc4_UGF4_PvFB_hi "FCtl_DTC_0x04(634)" VALUE 0x001640C4 /* @ECU_Address@FCtl_DTC_0x04@0x024C44F4@ */ ECIPP_ALIGNMENT_UWORD 65535 Compu_IDENTITY 0 65535 PHYS_UNIT "System ID + DTC" /end CHARACTERISTIC
/begin CHARACTERISTIC FCdc4_UGF4_PvFB_lo "FCtl_DTC_0x04(635)" VALUE 0x001640C6 /* @ECU_Address@FCtl_DTC_0x04@0x024C44F6@ */ ECIPP_ALIGNMENT_UWORD 65535 Compu_IDENTITY 0 65535 PHYS_UNIT "System ID + DTC" /end CHARACTERISTIC
/begin CHARACTERISTIC FCdc4_UGF4_R_lo "FCtl_DTC_0x04(631)" VALUE 0x001640BE /* @ECU_Address@FCtl_DTC_0x04@0x024C44EE@ */ ECIPP_ALIGNMENT_UWORD 65535 Compu_IDENTITY 0 65535 PHYS_UNIT "System ID + DTC" /end CHARACTERISTIC
/begin CHARACTERISTIC FCdc4_UGF4_rtn_hi "FCtl_DTC_0x04(632)" VALUE 0x001640C0 /* @ECU_Address@FCtl_DTC_0x04@0x024C44F0@ */ ECIPP_ALIGNMENT_UWORD 65535 Compu_IDENTITY 0 65535 PHYS_UNIT "System ID + DTC" /end CHARACTERISTIC
/begin CHARACTERISTIC FCdc4_UGF4_rtn_lo "FCtl_DTC_0x04(633)" VALUE 0x001640C2 /* @ECU_Address@FCtl_DTC_0x04@0x024C44F2@ */ ECIPP_ALIGNMENT_UWORD 65535 Compu_IDENTITY 0 65535 PHYS_UNIT "System ID + DTC" /end CHARACTERISTIC
/begin CHARACTERISTIC FCdc4_UGF4_Sv_lo "FCtl_DTC_0x04(637)" VALUE 0x001640CA /* @ECU_Address@FCtl_DTC_0x04@0x024C44FA@ */ ECIPP_ALIGNMENT_UWORD 65535 Compu_IDENTITY 0 65535 PHYS_UNIT "System ID + DTC" /end CHARACTERISTIC
/begin CHARACTERISTIC FCdtc_AL2_hi "FCtl_DTC(40)" VALUE 0x00163564 /* @ECU_Address@FCtl_DTC@0x021B5050@ */ ECIPP_ALIGNMENT_UWORD 65535 Compu_IDENTITY 0 65535 PHYS_UNIT "DTC" /end CHARACTERISTIC
/begin CHARACTERISTIC FCdtc_AL2_lo "FCtl_DTC(41)" VALUE 0x00163566 /* @ECU_Address@FCtl_DTC@0x021B5052@ */ ECIPP_ALIGNMENT_UWORD 65535 Compu_IDENTITY 0 65535 PHYS_UNIT "DTC" /end CHARACTERISTIC
/begin CHARACTERISTIC FCdtc_CFVxminFT "FCtl_DTC(533)" VALUE 0x0016393E /* @ECU_Address@FCtl_DTC@0x021B542A@ */ ECIPP_ALIGNMENT_UWORD 65535 Compu_IDENTITY 0 65535 PHYS_UNIT "DTC" /end CHARACTERISTIC
/begin CHARACTERISTIC FCdtc_CL2_hi "FCtl_DTC(34)" VALUE 0x00163558 /* @ECU_Address@FCtl_DTC@0x021B5044@ */ ECIPP_ALIGNMENT_UWORD 65535 Compu_IDENTITY 0 65535 PHYS_UNIT "DTC" /end CHARACTERISTIC
/begin CHARACTERISTIC FCdtc_CL2_lo "FCtl_DTC(35)" VALUE 0x0016355A /* @ECU_Address@FCtl_DTC@0x021B5046@ */ ECIPP_ALIGNMENT_UWORD 65535 Compu_IDENTITY 0 65535 PHYS_UNIT "DTC" /end CHARACTERISTIC
/begin CHARACTERISTIC FCdtc_CM2_unresp "FCtl_DTC(800)" VALUE 0x00163B54 /* @ECU_Address@FCtl_DTC@0x021B5640@ */ ECIPP_ALIGNMENT_UWORD 65535 Compu_IDENTITY 0 65535 PHYS_UNIT "DTC" /end CHARACTERISTIC
/begin CHARACTERISTIC FCdtc_CM2gsln_inact "FCtl_DTC(199)" VALUE 0x001636A2 /* @ECU_Address@FCtl_DTC@0x021B518E@ */ ECIPP_ALIGNMENT_UWORD 65535 Compu_IDENTITY 0 65535 PHYS_UNIT "DTC" /end CHARACTERISTIC
/begin CHARACTERISTIC FCdtc_EGO4_open "FCtl_DTC(200)" VALUE 0x001636A4 /* @ECU_Address@FCtl_DTC@0x021B5190@ */ ECIPP_ALIGNMENT_UWORD 65535 Compu_IDENTITY 0 65535 PHYS_UNIT "DTC" /end CHARACTERISTIC
/begin CHARACTERISTIC FCdtc_EMWT2_HiExp1 "FCtl_DTC(226)" VALUE 0x001636D8 /* @ECU_Address@FCtl_DTC@0x021B51C4@ */ ECIPP_ALIGNMENT_UWORD 65535 Compu_IDENTITY 0 65535 PHYS_UNIT "DTC" /end CHARACTERISTIC
/begin CHARACTERISTIC FCdtc_EMWT2_HiExp2 "FCtl_DTC(228)" VALUE 0x001636DC /* @ECU_Address@FCtl_DTC@0x021B51C8@ */ ECIPP_ALIGNMENT_UWORD 65535 Compu_IDENTITY 0 65535 PHYS_UNIT "DTC" /end CHARACTERISTIC
/begin CHARACTERISTIC FCdtc_EMWT2_maxv "FCtl_DTC(222)" VALUE 0x001636D0 /* @ECU_Address@FCtl_DTC@0x021B51BC@ */ ECIPP_ALIGNMENT_UWORD 65535 Compu_IDENTITY 0 65535 PHYS_UNIT "DTC" /end CHARACTERISTIC
/begin CHARACTERISTIC FCdtc_EMWT2_minv "FCtl_DTC(224)" VALUE 0x001636D4 /* @ECU_Address@FCtl_DTC@0x021B51C0@ */ ECIPP_ALIGNMENT_UWORD 65535 Compu_IDENTITY 0 65535 PHYS_UNIT "DTC" /end CHARACTERISTIC
/begin CHARACTERISTIC FCdtc_ERWT2_HiExp1 "FCtl_DTC(238)" VALUE 0x001636F0 /* @ECU_Address@FCtl_DTC@0x021B51DC@ */ ECIPP_ALIGNMENT_UWORD 65535 Compu_IDENTITY 0 65535 PHYS_UNIT "DTC" /end CHARACTERISTIC
/begin CHARACTERISTIC FCdtc_ERWT2_HiExp2 "FCtl_DTC(240)" VALUE 0x001636F4 /* @ECU_Address@FCtl_DTC@0x021B51E0@ */ ECIPP_ALIGNMENT_UWORD 65535 Compu_IDENTITY 0 65535 PHYS_UNIT "DTC" /end CHARACTERISTIC
/begin CHARACTERISTIC FCdtc_ERWT2_maxv "FCtl_DTC(234)" VALUE 0x001636E8 /* @ECU_Address@FCtl_DTC@0x021B51D4@ */ ECIPP_ALIGNMENT_UWORD 65535 Compu_IDENTITY 0 65535 PHYS_UNIT "DTC" /end CHARACTERISTIC
/begin CHARACTERISTIC FCdtc_ERWT2_minv "FCtl_DTC(236)" VALUE 0x001636EC /* @ECU_Address@FCtl_DTC@0x021B51D8@ */ ECIPP_ALIGNMENT_UWORD 65535 Compu_IDENTITY 0 65535 PHYS_UNIT "DTC" /end CHARACTERISTIC
/begin CHARACTERISTIC FCdtc_GLOW10_open "FCtl_DTC(492)" VALUE 0x001638EC /* @ECU_Address@FCtl_DTC@0x021B53D8@ */ ECIPP_ALIGNMENT_UWORD 65535 Compu_IDENTITY 0 65535 PHYS_UNIT "DTC" /end CHARACTERISTIC
/begin CHARACTERISTIC FCdtc_GLOW10_short "FCtl_DTC(502)" VALUE 0x00163900 /* @ECU_Address@FCtl_DTC@0x021B53EC@ */ ECIPP_ALIGNMENT_UWORD 65535 Compu_IDENTITY 0 65535 PHYS_UNIT "DTC" /end CHARACTERISTIC
/begin CHARACTERISTIC FCdtc_GLOW2_open "FCtl_DTC(484)" VALUE 0x001638DC /* @ECU_Address@FCtl_DTC@0x021B53C8@ */ ECIPP_ALIGNMENT_UWORD 65535 Compu_IDENTITY 0 65535 PHYS_UNIT "DTC" /end CHARACTERISTIC
/begin CHARACTERISTIC FCdtc_GLOW2_short "FCtl_DTC(494)" VALUE 0x001638F0 /* @ECU_Address@FCtl_DTC@0x021B53DC@ */ ECIPP_ALIGNMENT_UWORD 65535 Compu_IDENTITY 0 65535 PHYS_UNIT "DTC" /end CHARACTERISTIC
/begin CHARACTERISTIC FCdtc_GLOW3_open "FCtl_DTC(485)" VALUE 0x001638DE /* @ECU_Address@FCtl_DTC@0x021B53CA@ */ ECIPP_ALIGNMENT_UWORD 65535 Compu_IDENTITY 0 65535 PHYS_UNIT "DTC" /end CHARACTERISTIC
/begin CHARACTERISTIC FCdtc_GLOW3_short "FCtl_DTC(495)" VALUE 0x001638F2 /* @ECU_Address@FCtl_DTC@0x021B53DE@ */ ECIPP_ALIGNMENT_UWORD 65535 Compu_IDENTITY 0 65535 PHYS_UNIT "DTC" /end CHARACTERISTIC
/begin CHARACTERISTIC FCdtc_GLOW4_open "FCtl_DTC(486)" VALUE 0x001638E0 /* @ECU_Address@FCtl_DTC@0x021B53CC@ */ ECIPP_ALIGNMENT_UWORD 65535 Compu_IDENTITY 0 65535 PHYS_UNIT "DTC" /end CHARACTERISTIC
/begin CHARACTERISTIC FCdtc_GLOW4_short "FCtl_DTC(496)" VALUE 0x001638F4 /* @ECU_Address@FCtl_DTC@0x021B53E0@ */ ECIPP_ALIGNMENT_UWORD 65535 Compu_IDENTITY 0 65535 PHYS_UNIT "DTC" /end CHARACTERISTIC
/begin CHARACTERISTIC FCdtc_GLOW5_open "FCtl_DTC(487)" VALUE 0x001638E2 /* @ECU_Address@FCtl_DTC@0x021B53CE@ */ ECIPP_ALIGNMENT_UWORD 65535 Compu_IDENTITY 0 65535 PHYS_UNIT "DTC" /end CHARACTERISTIC
/begin CHARACTERISTIC FCdtc_GLOW5_short "FCtl_DTC(497)" VALUE 0x001638F6 /* @ECU_Address@FCtl_DTC@0x021B53E2@ */ ECIPP_ALIGNMENT_UWORD 65535 Compu_IDENTITY 0 65535 PHYS_UNIT "DTC" /end CHARACTERISTIC
/begin CHARACTERISTIC FCdtc_GLOW6_open "FCtl_DTC(488)" VALUE 0x001638E4 /* @ECU_Address@FCtl_DTC@0x021B53D0@ */ ECIPP_ALIGNMENT_UWORD 65535 Compu_IDENTITY 0 65535 PHYS_UNIT "DTC" /end CHARACTERISTIC
/begin CHARACTERISTIC FCdtc_GLOW6_short "FCtl_DTC(498)" VALUE 0x001638F8 /* @ECU_Address@FCtl_DTC@0x021B53E4@ */ ECIPP_ALIGNMENT_UWORD 65535 Compu_IDENTITY 0 65535 PHYS_UNIT "DTC" /end CHARACTERISTIC
/begin CHARACTERISTIC FCdtc_GLOW7_open "FCtl_DTC(489)" VALUE 0x001638E6 /* @ECU_Address@FCtl_DTC@0x021B53D2@ */ ECIPP_ALIGNMENT_UWORD 65535 Compu_IDENTITY 0 65535 PHYS_UNIT "DTC" /end CHARACTERISTIC
/begin CHARACTERISTIC FCdtc_GLOW7_short "FCtl_DTC(499)" VALUE 0x001638FA /* @ECU_Address@FCtl_DTC@0x021B53E6@ */ ECIPP_ALIGNMENT_UWORD 65535 Compu_IDENTITY 0 65535 PHYS_UNIT "DTC" /end CHARACTERISTIC
/begin CHARACTERISTIC FCdtc_GLOW8_open "FCtl_DTC(490)" VALUE 0x001638E8 /* @ECU_Address@FCtl_DTC@0x021B53D4@ */ ECIPP_ALIGNMENT_UWORD 65535 Compu_IDENTITY 0 65535 PHYS_UNIT "DTC" /end CHARACTERISTIC
/begin CHARACTERISTIC FCdtc_GLOW8_short "FCtl_DTC(500)" VALUE 0x001638FC /* @ECU_Address@FCtl_DTC@0x021B53E8@ */ ECIPP_ALIGNMENT_UWORD 65535 Compu_IDENTITY 0 65535 PHYS_UNIT "DTC" /end CHARACTERISTIC
/begin CHARACTERISTIC FCdtc_GLOW9_open "FCtl_DTC(491)" VALUE 0x001638EA /* @ECU_Address@FCtl_DTC@0x021B53D6@ */ ECIPP_ALIGNMENT_UWORD 65535 Compu_IDENTITY 0 65535 PHYS_UNIT "DTC" /end CHARACTERISTIC
/begin CHARACTERISTIC FCdtc_GLOW9_short "FCtl_DTC(501)" VALUE 0x001638FE /* @ECU_Address@FCtl_DTC@0x021B53EA@ */ ECIPP_ALIGNMENT_UWORD 65535 Compu_IDENTITY 0 65535 PHYS_UNIT "DTC" /end CHARACTERISTIC
/begin CHARACTERISTIC FCdtc_ICAVD10_mis "FCtl_DTC(315)" VALUE 0x0016378A /* @ECU_Address@FCtl_DTC@0x021B5276@ */ ECIPP_ALIGNMENT_UWORD 65535 Compu_IDENTITY 0 65535 PHYS_UNIT "DTC" /end CHARACTERISTIC
/begin CHARACTERISTIC FCdtc_ICAVD10_miscat "FCtl_DTC(317)" VALUE 0x0016378E /* @ECU_Address@FCtl_DTC@0x021B527A@ */ ECIPP_ALIGNMENT_UWORD 65535 Compu_IDENTITY 0 65535 PHYS_UNIT "DTC" /end CHARACTERISTIC
/begin CHARACTERISTIC FCdtc_ICAVD2_mis "FCtl_DTC(260)" VALUE 0x0016371C /* @ECU_Address@FCtl_DTC@0x021B5208@ */ ECIPP_ALIGNMENT_UWORD 65535 Compu_IDENTITY 0 65535 PHYS_UNIT "DTC" /end CHARACTERISTIC
/begin CHARACTERISTIC FCdtc_ICAVD2_miscat "FCtl_DTC(268)" VALUE 0x0016372C /* @ECU_Address@FCtl_DTC@0x021B5218@ */ ECIPP_ALIGNMENT_UWORD 65535 Compu_IDENTITY 0 65535 PHYS_UNIT "DTC" /end CHARACTERISTIC
/begin CHARACTERISTIC FCdtc_ICAVD3_mis "FCtl_DTC(261)" VALUE 0x0016371E /* @ECU_Address@FCtl_DTC@0x021B520A@ */ ECIPP_ALIGNMENT_UWORD 65535 Compu_IDENTITY 0 65535 PHYS_UNIT "DTC" /end CHARACTERISTIC
/begin CHARACTERISTIC FCdtc_ICAVD3_miscat "FCtl_DTC(269)" VALUE 0x0016372E /* @ECU_Address@FCtl_DTC@0x021B521A@ */ ECIPP_ALIGNMENT_UWORD 65535 Compu_IDENTITY 0 65535 PHYS_UNIT "DTC" /end CHARACTERISTIC
/begin CHARACTERISTIC FCdtc_ICAVD4_mis "FCtl_DTC(262)" VALUE 0x00163720 /* @ECU_Address@FCtl_DTC@0x021B520C@ */ ECIPP_ALIGNMENT_UWORD 65535 Compu_IDENTITY 0 65535 PHYS_UNIT "DTC" /end CHARACTERISTIC
/begin CHARACTERISTIC FCdtc_ICAVD4_miscat "FCtl_DTC(270)" VALUE 0x00163730 /* @ECU_Address@FCtl_DTC@0x021B521C@ */ ECIPP_ALIGNMENT_UWORD 65535 Compu_IDENTITY 0 65535 PHYS_UNIT "DTC" /end CHARACTERISTIC
/begin CHARACTERISTIC FCdtc_ICAVD5_mis "FCtl_DTC(263)" VALUE 0x00163722 /* @ECU_Address@FCtl_DTC@0x021B520E@ */ ECIPP_ALIGNMENT_UWORD 65535 Compu_IDENTITY 0 65535 PHYS_UNIT "DTC" /end CHARACTERISTIC
/begin CHARACTERISTIC FCdtc_ICAVD5_miscat "FCtl_DTC(271)" VALUE 0x00163732 /* @ECU_Address@FCtl_DTC@0x021B521E@ */ ECIPP_ALIGNMENT_UWORD 65535 Compu_IDENTITY 0 65535 PHYS_UNIT "DTC" /end CHARACTERISTIC
/begin CHARACTERISTIC FCdtc_ICAVD6_mis "FCtl_DTC(264)" VALUE 0x00163724 /* @ECU_Address@FCtl_DTC@0x021B5210@ */ ECIPP_ALIGNMENT_UWORD 65535 Compu_IDENTITY 0 65535 PHYS_UNIT "DTC" /end CHARACTERISTIC
/begin CHARACTERISTIC FCdtc_ICAVD6_miscat "FCtl_DTC(272)" VALUE 0x00163734 /* @ECU_Address@FCtl_DTC@0x021B5220@ */ ECIPP_ALIGNMENT_UWORD 65535 Compu_IDENTITY 0 65535 PHYS_UNIT "DTC" /end CHARACTERISTIC
/begin CHARACTERISTIC FCdtc_ICAVD7_mis "FCtl_DTC(265)" VALUE 0x00163726 /* @ECU_Address@FCtl_DTC@0x021B5212@ */ ECIPP_ALIGNMENT_UWORD 65535 Compu_IDENTITY 0 65535 PHYS_UNIT "DTC" /end CHARACTERISTIC
/begin CHARACTERISTIC FCdtc_ICAVD7_miscat "FCtl_DTC(273)" VALUE 0x00163736 /* @ECU_Address@FCtl_DTC@0x021B5222@ */ ECIPP_ALIGNMENT_UWORD 65535 Compu_IDENTITY 0 65535 PHYS_UNIT "DTC" /end CHARACTERISTIC
/begin CHARACTERISTIC FCdtc_ICAVD8_mis "FCtl_DTC(266)" VALUE 0x00163728 /* @ECU_Address@FCtl_DTC@0x021B5214@ */ ECIPP_ALIGNMENT_UWORD 65535 Compu_IDENTITY 0 65535 PHYS_UNIT "DTC" /end CHARACTERISTIC
/begin CHARACTERISTIC FCdtc_ICAVD8_miscat "FCtl_DTC(274)" VALUE 0x00163738 /* @ECU_Address@FCtl_DTC@0x021B5224@ */ ECIPP_ALIGNMENT_UWORD 65535 Compu_IDENTITY 0 65535 PHYS_UNIT "DTC" /end CHARACTERISTIC
/begin CHARACTERISTIC FCdtc_ICAVD9_mis "FCtl_DTC(314)" VALUE 0x00163788 /* @ECU_Address@FCtl_DTC@0x021B5274@ */ ECIPP_ALIGNMENT_UWORD 65535 Compu_IDENTITY 0 65535 PHYS_UNIT "DTC" /end CHARACTERISTIC
/end MODULE
/end PROJECT
