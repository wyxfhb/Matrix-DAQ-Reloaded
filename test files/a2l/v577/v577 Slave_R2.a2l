ASAP2_VERSION 1 61
/begin PROJECT Econtrols_4G "4G Test"
/begin HEADER "4G A2L Configuration" PROJECT_NO EControls4G /* config for version control */ VERSION "$Revision: 82130 $:" /* config for version control */ /end HEADER
/begin MODULE EControls_4G_SH2A "EControls 4G"
/begin MOD_COMMON "" DEPOSIT ABSOLUTE BYTE_ORDER MSB_FIRST /end MOD_COMMON
/* Define the Record Layouts */
/begin RECORD_LAYOUT ECIPP_ALIGNMENT_UBYTE FNC_VALUES 1 UBYTE COLUMN_DIR DIRECT /end RECORD_LAYOUT
/begin RECORD_LAYOUT ECIPP_Lookup_UBYTE AXIS_PTS_X 1 UBYTE INDEX_INCR DIRECT /end RECORD_LAYOUT
/begin RECORD_LAYOUT ECIPP_ALIGNMENT_UWORD FNC_VALUES 1 UWORD COLUMN_DIR DIRECT /end RECORD_LAYOUT
/begin RECORD_LAYOUT ECIPP_ALIGNMENT_SWORD FNC_VALUES 1 SWORD COLUMN_DIR DIRECT /end RECORD_LAYOUT
/begin RECORD_LAYOUT ECIPP_ALIGNMENT_ULONG FNC_VALUES 1 ULONG COLUMN_DIR DIRECT /end RECORD_LAYOUT
/begin RECORD_LAYOUT ECIPP_ALIGNMENT_SLONG FNC_VALUES 1 SLONG COLUMN_DIR DIRECT /end RECORD_LAYOUT
/begin RECORD_LAYOUT ECIPP_ALIGNMENT_FLOAT32_IEEE FNC_VALUES 1 FLOAT32_IEEE COLUMN_DIR DIRECT /end RECORD_LAYOUT
/begin COMPU_METHOD Compu_IDENTITY "Discrete Values " /* Identifier */ IDENTICAL "%.0" /* Format */ "-" /* Units */ /end COMPU_METHOD
/* Describe the special address used to COPY RCalibration (RAM) to DCalibration (FLASH) */ /* CCP_CMT_ADDR=0x06000000 CCP_CMD_CMD=0x5A=90 CCP_REL_CMD=0xA5 */
/begin COMPU_METHOD Compu_DirtyCal_VTAB "Verbal Table" TAB_VERB "%8.0" "" COMPU_TAB_REF Compu_DirtyCal_VTAB_REF /end COMPU_METHOD
/begin COMPU_VTAB Compu_DirtyCal_VTAB_REF "Verbal Table" TAB_VERB 2 0 "RAM-EEPROM Mismatch" 1 "RAM-EEPROM Match" DEFAULT_VALUE "Undefined" /end COMPU_VTAB
/begin MEASUREMENT DirtyCalibration "Calibration RAM Data is changed" UBYTE Compu_DirtyCal_VTAB 0 0 0 255 ECU_ADDRESS 0x06000000 /end MEASUREMENT
/begin MEASUREMENT HM_hours "General # HM_hours" UWORD Compu_HM_hours 0 0 0 65535 ECU_ADDRESS 0x01001310 /end MEASUREMENT
/begin COMPU_METHOD Compu_HM_hours " " RAT_FUNC "%.0" "-" COEFFS 0 1 0 0 0 1 /end COMPU_METHOD
/begin CHARACTERISTIC MAP_max "FaultConfig # MAP_max (Fault Condition:MAP pressure >)" VALUE 0x001475b2 /* @ECU_Address@MAP_max@0x010013E0@ */ ECIPP_ALIGNMENT_UWORD 256 Compu_MAP_max 0 255.99609375 /end CHARACTERISTIC
/begin COMPU_METHOD Compu_MAP_max " " RAT_FUNC "%.3" "psia" COEFFS 0 256 0 0 0 1 /end COMPU_METHOD
/begin CHARACTERISTIC MAP_maxTPS "FaultConfig # MAP_maxTPS (Fault Condition:and TPS <)" VALUE 0x001475b6 /* @ECU_Address@MAP_maxTPS@0x010013E8@ */ ECIPP_ALIGNMENT_UWORD 100 Compu_MAP_maxTPS 0 99.9984741210938 /end CHARACTERISTIC
/begin COMPU_METHOD Compu_MAP_maxTPS " " RAT_FUNC "%.3" "%" COEFFS 0 655.36 0 0 0 1 /end COMPU_METHOD
/begin CHARACTERISTIC MAP_maxRPM "FaultConfig # MAP_maxRPM (Fault Condition:and RPM >)" VALUE 0x001475b4 /* @ECU_Address@MAP_maxRPM@0x010013F0@ */ ECIPP_ALIGNMENT_UWORD 65535 Compu_MAP_maxRPM 0 65535 /end CHARACTERISTIC
/begin COMPU_METHOD Compu_MAP_maxRPM " " RAT_FUNC "%.0" "rpm" COEFFS 0 1 0 0 0 1 /end COMPU_METHOD
/begin CHARACTERISTIC MAP_minv "FaultConfig # MAP_minv (Fault Condition:MAP voltage <)" VALUE 0x001475ba /* @ECU_Address@MAP_minv@0x010013F8@ */ ECIPP_ALIGNMENT_UWORD 5 Compu_MAP_minv 0 5.00114468864469 /end CHARACTERISTIC
/begin COMPU_METHOD Compu_MAP_minv " " RAT_FUNC "%.3" "volts" COEFFS 0 13104 0 0 0 1 /end COMPU_METHOD
/begin CHARACTERISTIC MAP_minvTPS "FaultConfig # MAP_minvTPS (Fault Condition:and TPS >)" VALUE 0x001475be /* @ECU_Address@MAP_minvTPS@0x01001400@ */ ECIPP_ALIGNMENT_UWORD 100 Compu_MAP_minvTPS 0 99.9984741210938 /end CHARACTERISTIC
/begin COMPU_METHOD Compu_MAP_minvTPS " " RAT_FUNC "%.3" "%" COEFFS 0 655.36 0 0 0 1 /end COMPU_METHOD
/begin CHARACTERISTIC MAP_minvRPM "FaultConfig # MAP_minvRPM (Fault Condition:and RPM <)" VALUE 0x001475bc /* @ECU_Address@MAP_minvRPM@0x01001408@ */ ECIPP_ALIGNMENT_UWORD 65535 Compu_MAP_minvRPM 0 65535 /end CHARACTERISTIC
/begin COMPU_METHOD Compu_MAP_minvRPM " " RAT_FUNC "%.0" "rpm" COEFFS 0 1 0 0 0 1 /end COMPU_METHOD
/begin CHARACTERISTIC ECT_maxv "FaultConfig # ECT_maxv (Fault Condition:ECT voltage >)" VALUE 0x001467b8 /* @ECU_Address@ECT_maxv@0x01001410@ */ ECIPP_ALIGNMENT_UWORD 5 Compu_ECT_maxv 0 5.00114468864469 /end CHARACTERISTIC
/begin COMPU_METHOD Compu_ECT_maxv " " RAT_FUNC "%.3" "volts" COEFFS 0 13104 0 0 0 1 /end COMPU_METHOD
/begin CHARACTERISTIC ECT_minv "FaultConfig # ECT_minv (Fault Condition:ECT voltage <)" VALUE 0x001467ba /* @ECU_Address@ECT_minv@0x01001418@ */ ECIPP_ALIGNMENT_UWORD 5 Compu_ECT_minv 0 5.00114468864469 /end CHARACTERISTIC
/begin COMPU_METHOD Compu_ECT_minv " " RAT_FUNC "%.3" "volts" COEFFS 0 13104 0 0 0 1 /end COMPU_METHOD
/begin CHARACTERISTIC ECT_HiExp "FaultConfig # ECT_HiExp (Fault Condition:ECT >)" VALUE 0x0014679c /* @ECU_Address@ECT_HiExp@0x01001420@ */ ECIPP_ALIGNMENT_UWORD 564 Compu_ECT_HiExp -460 563.984375 /end CHARACTERISTIC
/begin COMPU_METHOD Compu_ECT_HiExp " " RAT_FUNC "%.3" "deg F" COEFFS 0 64 29440 0 0 1 /end COMPU_METHOD
/begin CHARACTERISTIC ECT_HiExp_rpm "FaultConfig # ECT_HiExp_rpm (Fault Condition:and RPM >)" VALUE 0x001467a6 /* @ECU_Address@ECT_HiExp_rpm@0x01001428@ */ ECIPP_ALIGNMENT_UWORD 65535 Compu_ECT_HiExp_rpm 0 65535 /end CHARACTERISTIC
/begin COMPU_METHOD Compu_ECT_HiExp_rpm " " RAT_FUNC "%.0" "rpm" COEFFS 0 1 0 0 0 1 /end COMPU_METHOD
/begin CHARACTERISTIC ECT_HiExp2 "FaultConfig # ECT_HiExp2 (Fault Condition:ECT >)" VALUE 0x0014679e /* @ECU_Address@ECT_HiExp2@0x01001430@ */ ECIPP_ALIGNMENT_UWORD 564 Compu_ECT_HiExp2 -460 563.984375 /end CHARACTERISTIC
/begin COMPU_METHOD Compu_ECT_HiExp2 " " RAT_FUNC "%.3" "deg F" COEFFS 0 64 29440 0 0 1 /end COMPU_METHOD
/begin CHARACTERISTIC ECT_HiExp2_rpm "FaultConfig # ECT_HiExp2_rpm (Fault Condition:and RPM >)" VALUE 0x001467a2 /* @ECU_Address@ECT_HiExp2_rpm@0x01001438@ */ ECIPP_ALIGNMENT_UWORD 65535 Compu_ECT_HiExp2_rpm 0 65535 /end CHARACTERISTIC
/begin COMPU_METHOD Compu_ECT_HiExp2_rpm " " RAT_FUNC "%.0" "rpm" COEFFS 0 1 0 0 0 1 /end COMPU_METHOD
/begin CHARACTERISTIC IAT_maxv "FaultConfig # IAT_maxv (Fault Condition:IAT voltage >)" VALUE 0x00147476 /* @ECU_Address@IAT_maxv@0x01001440@ */ ECIPP_ALIGNMENT_UWORD 5 Compu_IAT_maxv 0 5.00114468864469 /end CHARACTERISTIC
/begin COMPU_METHOD Compu_IAT_maxv " " RAT_FUNC "%.3" "volts" COEFFS 0 13104 0 0 0 1 /end COMPU_METHOD
/begin CHARACTERISTIC IAT_minv "FaultConfig # IAT_minv (Fault Condition:IAT voltage <)" VALUE 0x00147478 /* @ECU_Address@IAT_minv@0x01001448@ */ ECIPP_ALIGNMENT_UWORD 5 Compu_IAT_minv 0 5.00114468864469 /end CHARACTERISTIC
/begin COMPU_METHOD Compu_IAT_minv " " RAT_FUNC "%.3" "volts" COEFFS 0 13104 0 0 0 1 /end COMPU_METHOD
/begin CHARACTERISTIC IAT_HiExp "FaultConfig # IAT_HiExp (Fault Condition:IAT >)" VALUE 0x0014746c /* @ECU_Address@IAT_HiExp@0x01001450@ */ ECIPP_ALIGNMENT_UWORD 564 Compu_IAT_HiExp -460 563.984375 /end CHARACTERISTIC
/begin COMPU_METHOD Compu_IAT_HiExp " " RAT_FUNC "%.3" "deg F" COEFFS 0 64 29440 0 0 1 /end COMPU_METHOD
/begin CHARACTERISTIC IAT_HiExp_rpm "FaultConfig # IAT_HiExp_rpm (Fault Condition:and RPM >)" VALUE 0x00147472 /* @ECU_Address@IAT_HiExp_rpm@0x01001458@ */ ECIPP_ALIGNMENT_UWORD 65535 Compu_IAT_HiExp_rpm 0 65535 /end CHARACTERISTIC
/begin COMPU_METHOD Compu_IAT_HiExp_rpm " " RAT_FUNC "%.0" "rpm" COEFFS 0 1 0 0 0 1 /end COMPU_METHOD
/begin CHARACTERISTIC IAT_HiExp2 "FaultConfig # IAT_HiExp2 (Fault Condition:IAT >)" VALUE 0x0014746e /* @ECU_Address@IAT_HiExp2@0x01001460@ */ ECIPP_ALIGNMENT_UWORD 564 Compu_IAT_HiExp2 -460 563.984375 /end CHARACTERISTIC
/begin COMPU_METHOD Compu_IAT_HiExp2 " " RAT_FUNC "%.3" "deg F" COEFFS 0 64 29440 0 0 1 /end COMPU_METHOD
/begin CHARACTERISTIC IAT_HiExp2_rpm "FaultConfig # IAT_HiExp2_rpm (Fault Condition:and RPM >)" VALUE 0x00147470 /* @ECU_Address@IAT_HiExp2_rpm@0x01001468@ */ ECIPP_ALIGNMENT_UWORD 65535 Compu_IAT_HiExp2_rpm 0 65535 /end CHARACTERISTIC
/begin COMPU_METHOD Compu_IAT_HiExp2_rpm " " RAT_FUNC "%.0" "rpm" COEFFS 0 1 0 0 0 1 /end COMPU_METHOD
/begin CHARACTERISTIC BP_max "FaultConfig # BP_max (Fault Condition:BP pressure >)" VALUE 0x001466ae /* @ECU_Address@BP_max@0x01001470@ */ ECIPP_ALIGNMENT_UWORD 256 Compu_BP_max 0 255.99609375 /end CHARACTERISTIC
/begin COMPU_METHOD Compu_BP_max " " RAT_FUNC "%.3" "psia" COEFFS 0 256 0 0 0 1 /end COMPU_METHOD
/begin CHARACTERISTIC BP_min "FaultConfig # BP_min (Fault Condition:BP pressure <)" VALUE 0x001466b0 /* @ECU_Address@BP_min@0x01001478@ */ ECIPP_ALIGNMENT_UWORD 256 Compu_BP_min 0 255.99609375 /end CHARACTERISTIC
/begin COMPU_METHOD Compu_BP_min " " RAT_FUNC "%.3" "psia" COEFFS 0 256 0 0 0 1 /end COMPU_METHOD
/begin CHARACTERISTIC V_max "FaultConfig # V_max (Fault Condition:Voltage >)" VALUE 0x00147a58 /* @ECU_Address@V_max@0x01001480@ */ ECIPP_ALIGNMENT_UWORD 256 Compu_V_max 0 255.99609375 /end CHARACTERISTIC
/begin COMPU_METHOD Compu_V_max " " RAT_FUNC "%.3" "volts" COEFFS 0 256 0 0 0 1 /end COMPU_METHOD
/begin CHARACTERISTIC V_min "FaultConfig # V_min (Fault Condition:Voltage <)" VALUE 0x00147a5a /* @ECU_Address@V_min@0x01001488@ */ ECIPP_ALIGNMENT_UWORD 256 Compu_V_min 0 255.99609375 /end CHARACTERISTIC
/begin COMPU_METHOD Compu_V_min " " RAT_FUNC "%.3" "volts" COEFFS 0 256 0 0 0 1 /end COMPU_METHOD
/begin CHARACTERISTIC V_minRPM "FaultConfig # V_minRPM (Fault Condition:and RPM >)" VALUE 0x00147a5c /* @ECU_Address@V_minRPM@0x01001490@ */ ECIPP_ALIGNMENT_UWORD 65535 Compu_V_minRPM 0 65535 /end CHARACTERISTIC
/begin COMPU_METHOD Compu_V_minRPM " " RAT_FUNC "%.0" "rpm" COEFFS 0 1 0 0 0 1 /end COMPU_METHOD
/begin CHARACTERISTIC VE5_max "FaultConfig # VE5_max (Fault Condition:5VE1 >)" VALUE 0x001650c8 /* @ECU_Address@VE5_max@0x01001498@ */ ECIPP_ALIGNMENT_UWORD 6 Compu_VE5_max 0 5.50125915750916 /end CHARACTERISTIC
/begin COMPU_METHOD Compu_VE5_max " " RAT_FUNC "%.3" "volts" COEFFS 0 11912.7272727273 0 0 0 1 /end COMPU_METHOD
/begin CHARACTERISTIC VE5_min "FaultConfig # VE5_min (Fault Condition:5VE1 <)" VALUE 0x001650ca /* @ECU_Address@VE5_min@0x010014A0@ */ ECIPP_ALIGNMENT_UWORD 6 Compu_VE5_min 0 5.50125915750916 /end CHARACTERISTIC
/begin COMPU_METHOD Compu_VE5_min " " RAT_FUNC "%.3" "volts" COEFFS 0 11912.7272727273 0 0 0 1 /end COMPU_METHOD
/begin CHARACTERISTIC VE5b_max "FaultConfig # VE5b_max (Fault Condition:5VE2 >)" VALUE 0x001650cc /* @ECU_Address@VE5b_max@0x010014A8@ */ ECIPP_ALIGNMENT_UWORD 6 Compu_VE5b_max 0 5.50125915750916 /end CHARACTERISTIC
/begin COMPU_METHOD Compu_VE5b_max " " RAT_FUNC "%.3" "volts" COEFFS 0 11912.7272727273 0 0 0 1 /end COMPU_METHOD
/begin CHARACTERISTIC VE5b_min "FaultConfig # VE5b_min (Fault Condition:5VE2 <)" VALUE 0x001650ce /* @ECU_Address@VE5b_min@0x010014B0@ */ ECIPP_ALIGNMENT_UWORD 6 Compu_VE5b_min 0 5.50125915750916 /end CHARACTERISTIC
/begin COMPU_METHOD Compu_VE5b_min " " RAT_FUNC "%.3" "volts" COEFFS 0 11912.7272727273 0 0 0 1 /end COMPU_METHOD
/begin CHARACTERISTIC TPS1_min "FaultConfig # TPS1_min (Fault Condition:TPS1 voltage <)" VALUE 0x00148D42 /* @ECU_Address@TPS1_min@0x010014B8@ */ ECIPP_ALIGNMENT_UWORD 5 Compu_TPS1_min 0 5.00114468864469 /end CHARACTERISTIC
/begin COMPU_METHOD Compu_TPS1_min " " RAT_FUNC "%.3" "volts" COEFFS 0 13104 0 0 0 1 /end COMPU_METHOD
/begin CHARACTERISTIC TPS1_max "FaultConfig # TPS1_max (Fault Condition:TPS1 voltage >)" VALUE 0x00148D44 /* @ECU_Address@TPS1_max@0x010014C0@ */ ECIPP_ALIGNMENT_UWORD 5 Compu_TPS1_max 0 5.00114468864469 /end CHARACTERISTIC
/begin COMPU_METHOD Compu_TPS1_max " " RAT_FUNC "%.3" "volts" COEFFS 0 13104 0 0 0 1 /end COMPU_METHOD
/begin CHARACTERISTIC TPS2_min "FaultConfig # TPS2_min (Fault Condition:TPS2 voltage <)" VALUE 0x00148D46 /* @ECU_Address@TPS2_min@0x010014C8@ */ ECIPP_ALIGNMENT_UWORD 5 Compu_TPS2_min 0 5.00114468864469 /end CHARACTERISTIC
/begin COMPU_METHOD Compu_TPS2_min " " RAT_FUNC "%.3" "volts" COEFFS 0 13104 0 0 0 1 /end COMPU_METHOD
/begin CHARACTERISTIC TPS2_max "FaultConfig # TPS2_max (Fault Condition:TPS2 voltage >)" VALUE 0x00148D48 /* @ECU_Address@TPS2_max@0x010014D0@ */ ECIPP_ALIGNMENT_UWORD 5 Compu_TPS2_max 0 5.00114468864469 /end CHARACTERISTIC
/begin COMPU_METHOD Compu_TPS2_max " " RAT_FUNC "%.3" "volts" COEFFS 0 13104 0 0 0 1 /end COMPU_METHOD
/begin CHARACTERISTIC TPS12pct_hi "FaultConfig # TPS12pct_hi (Fault Condition:(TPS1% - TPS2%) >)" VALUE 0x00148D4A /* @ECU_Address@TPS12pct_hi@0x010014D8@ */ ECIPP_ALIGNMENT_SWORD 100 Compu_TPS12pct_hi -100 99.9969482421875 /end CHARACTERISTIC
/begin COMPU_METHOD Compu_TPS12pct_hi " " RAT_FUNC "%.3" "%" COEFFS 0 327.68 0 0 0 1 /end COMPU_METHOD
/begin CHARACTERISTIC TPS12pct_lo "FaultConfig # TPS12pct_lo (Fault Condition:(TPS1% - TPS2%) <)" VALUE 0x00148D4C /* @ECU_Address@TPS12pct_lo@0x010014E0@ */ ECIPP_ALIGNMENT_SWORD 100 Compu_TPS12pct_lo -100 99.9969482421875 /end CHARACTERISTIC
/begin COMPU_METHOD Compu_TPS12pct_lo " " RAT_FUNC "%.3" "%" COEFFS 0 327.68 0 0 0 1 /end COMPU_METHOD
/begin CHARACTERISTIC TPSerr_pos "FaultConfig # TPSerr_pos (Fault Condition:(target TPS - actual TPS) >)" VALUE 0x00148D4E /* @ECU_Address@TPSerr_pos@0x010014E8@ */ ECIPP_ALIGNMENT_SWORD 100 Compu_TPSerr_pos -100 99.9969482421875 /end CHARACTERISTIC
/begin COMPU_METHOD Compu_TPSerr_pos " " RAT_FUNC "%.3" "%" COEFFS 0 327.68 0 0 0 1 /end COMPU_METHOD
/begin CHARACTERISTIC TPSerr_neg "FaultConfig # TPSerr_neg (Fault Condition:(target TPS - actual TPS) <)" VALUE 0x00148D50 /* @ECU_Address@TPSerr_neg@0x010014F0@ */ ECIPP_ALIGNMENT_SWORD 100 Compu_TPSerr_neg -100 99.9969482421875 /end CHARACTERISTIC
/begin COMPU_METHOD Compu_TPSerr_neg " " RAT_FUNC "%.3" "%" COEFFS 0 327.68 0 0 0 1 /end COMPU_METHOD
/begin CHARACTERISTIC TPSerr_wait "FaultConfig # TPSerr_wait (Fault Condition:persistently longer than)" VALUE 0x00148D52 /* @ECU_Address@TPSerr_wait@0x010014F8@ */ ECIPP_ALIGNMENT_UWORD 65535 Compu_TPSerr_wait 0 65535 /end CHARACTERISTIC
/begin COMPU_METHOD Compu_TPSerr_wait " " RAT_FUNC "%.0" "ms" COEFFS 0 1 0 0 0 1 /end COMPU_METHOD
/begin CHARACTERISTIC TPSerr_minVbat "FaultConfig # TPSerr_minVbat (Fault Condition:while battery voltage >)" VALUE 0x00148D54 /* @ECU_Address@TPSerr_minVbat@0x01001500@ */ ECIPP_ALIGNMENT_UWORD 256 Compu_TPSerr_minVbat 0 255.99609375 /end CHARACTERISTIC
/begin COMPU_METHOD Compu_TPSerr_minVbat " " RAT_FUNC "%.3" "volts" COEFFS 0 256 0 0 0 1 /end COMPU_METHOD
/begin CHARACTERISTIC FPP1_min "FaultConfig # FPP1_min (Fault Condition:FPP1 voltage <)" VALUE 0x00164966 /* @ECU_Address@FPP1_min@0x01001510@ */ ECIPP_ALIGNMENT_UWORD 5 Compu_FPP1_min 0 5.00114468864469 /end CHARACTERISTIC
/begin COMPU_METHOD Compu_FPP1_min " " RAT_FUNC "%.3" "volts" COEFFS 0 13104 0 0 0 1 /end COMPU_METHOD
/begin CHARACTERISTIC FPP1_max "FaultConfig # FPP1_max (Fault Condition:FPP1 voltage >)" VALUE 0x00164964 /* @ECU_Address@FPP1_max@0x01001518@ */ ECIPP_ALIGNMENT_UWORD 5 Compu_FPP1_max 0 5.00114468864469 /end CHARACTERISTIC
/begin COMPU_METHOD Compu_FPP1_max " " RAT_FUNC "%.3" "volts" COEFFS 0 13104 0 0 0 1 /end COMPU_METHOD
/begin CHARACTERISTIC FPP2_min "FaultConfig # FPP2_min (Fault Condition:FPP2 voltage <)" VALUE 0x0016496a /* @ECU_Address@FPP2_min@0x01001520@ */ ECIPP_ALIGNMENT_UWORD 5 Compu_FPP2_min 0 5.00114468864469 /end CHARACTERISTIC
/begin COMPU_METHOD Compu_FPP2_min " " RAT_FUNC "%.3" "volts" COEFFS 0 13104 0 0 0 1 /end COMPU_METHOD
/begin CHARACTERISTIC FPP2_max "FaultConfig # FPP2_max (Fault Condition:FPP2 voltage >)" VALUE 0x00164968 /* @ECU_Address@FPP2_max@0x01001528@ */ ECIPP_ALIGNMENT_UWORD 5 Compu_FPP2_max 0 5.00114468864469 /end CHARACTERISTIC
/begin COMPU_METHOD Compu_FPP2_max " " RAT_FUNC "%.3" "volts" COEFFS 0 13104 0 0 0 1 /end COMPU_METHOD
/begin CHARACTERISTIC FPP12pct_hi "FaultConfig # FPP12pct_hi (Fault Condition:(FPP1% - FPP2%) >)" VALUE 0x001442f2 /* @ECU_Address@FPP12pct_hi@0x01001530@ */ ECIPP_ALIGNMENT_SWORD 100 Compu_FPP12pct_hi -100 99.9969482421875 /end CHARACTERISTIC
/begin COMPU_METHOD Compu_FPP12pct_hi " " RAT_FUNC "%.3" "%" COEFFS 0 327.68 0 0 0 1 /end COMPU_METHOD
/begin CHARACTERISTIC FPP12pct_lo "FaultConfig # FPP12pct_lo (Fault Condition:(FPP1% - FPP2%) <)" VALUE 0x001442f4 /* @ECU_Address@FPP12pct_lo@0x01001538@ */ ECIPP_ALIGNMENT_SWORD 100 Compu_FPP12pct_lo -100 99.9969482421875 /end CHARACTERISTIC
/begin COMPU_METHOD Compu_FPP12pct_lo " " RAT_FUNC "%.3" "%" COEFFS 0 327.68 0 0 0 1 /end COMPU_METHOD
/begin CHARACTERISTIC OILP_RPM "FaultConfig # OILP_RPM (Fault Condition:RPM lower limit for all oil pressure low faults:)" VALUE 0x00147662 /* @ECU_Address@OILP_RPM@0x01001548@ */ ECIPP_ALIGNMENT_UWORD 65535 Compu_OILP_RPM 0 65535 /end CHARACTERISTIC
/begin COMPU_METHOD Compu_OILP_RPM " " RAT_FUNC "%.0" "rpm" COEFFS 0 1 0 0 0 1 /end COMPU_METHOD
/begin CHARACTERISTIC KNK_min "FaultConfig # KNK_min (Fault Condition:is less than)" VALUE 0x00147524 /* @ECU_Address@KNK_min@0x01001578@ */ ECIPP_ALIGNMENT_UWORD 64 Compu_KNK_min 0 63.9990234375 /end CHARACTERISTIC
/begin COMPU_METHOD Compu_KNK_min " " RAT_FUNC "%.3" "volts" COEFFS 0 1024 0 0 0 1 /end COMPU_METHOD
/begin CHARACTERISTIC KNK_min_RPMlim "FaultConfig # KNK_min_RPMlim (Fault Condition:and RPM >)" VALUE 0x00147528 /* @ECU_Address@KNK_min_RPMlim@0x01001580@ */ ECIPP_ALIGNMENT_UWORD 65535 Compu_KNK_min_RPMlim 0 65535 /end CHARACTERISTIC
/begin COMPU_METHOD Compu_KNK_min_RPMlim " " RAT_FUNC "%.0" "rpm" COEFFS 0 1 0 0 0 1 /end COMPU_METHOD
/begin CHARACTERISTIC KNK_min_MAPlim "FaultConfig # KNK_min_MAPlim (Fault Condition:and MAP >)" VALUE 0x00147526 /* @ECU_Address@KNK_min_MAPlim@0x01001588@ */ ECIPP_ALIGNMENT_UWORD 256 Compu_KNK_min_MAPlim 0 255.99609375 /end CHARACTERISTIC
/begin COMPU_METHOD Compu_KNK_min_MAPlim " " RAT_FUNC "%.3" "psia" COEFFS 0 256 0 0 0 1 /end COMPU_METHOD
/begin CHARACTERISTIC KNK_max "FaultConfig # KNK_max (Fault Condition:KNK1/2/3 sensor input >)" VALUE 0x00147520 /* @ECU_Address@KNK_max@0x01001590@ */ ECIPP_ALIGNMENT_UWORD 64 Compu_KNK_max 0 63.9990234375 /end CHARACTERISTIC
/begin COMPU_METHOD Compu_KNK_max " " RAT_FUNC "%.3" "volts" COEFFS 0 1024 0 0 0 1 /end COMPU_METHOD
/begin CHARACTERISTIC KNK_max_MAPlim "FaultConfig # KNK_max_MAPlim (Fault Condition:and MAP <)" VALUE 0x00147522 /* @ECU_Address@KNK_max_MAPlim@0x01001598@ */ ECIPP_ALIGNMENT_UWORD 256 Compu_KNK_max_MAPlim 0 255.99609375 /end CHARACTERISTIC
/begin COMPU_METHOD Compu_KNK_max_MAPlim " " RAT_FUNC "%.3" "psia" COEFFS 0 256 0 0 0 1 /end COMPU_METHOD
/begin CHARACTERISTIC gov_ntrlock_fail "FaultConfig # gov_ntrlock_fail (Fault Condition:interlock failure persistent >)" VALUE 0x00147b2c /* @ECU_Address@gov_ntrlock_fail@0x010015A0@ */ ECIPP_ALIGNMENT_UWORD 65535 Compu_gov_ntrlock_fail 0 65535 /end CHARACTERISTIC
/begin COMPU_METHOD Compu_gov_ntrlock_fail " " RAT_FUNC "%.0" "ms" COEFFS 0 1 0 0 0 1 /end COMPU_METHOD
/begin CHARACTERISTIC crk_flt_chk_minV "FaultConfig # crk_flt_chk_minV" VALUE 0x00147ab6 /* @ECU_Address@crk_flt_chk_minV@0x010015A8@ */ ECIPP_ALIGNMENT_UWORD 256 Compu_crk_flt_chk_minV 0 255.99609375 /end CHARACTERISTIC
/begin COMPU_METHOD Compu_crk_flt_chk_minV " " RAT_FUNC "%.3" "volts" COEFFS 0 256 0 0 0 1 /end COMPU_METHOD
/begin CHARACTERISTIC EGO1fault "FaultConfig # EGO1fault (Fault Condition:EGO cold persistently >)" VALUE 0x001440d0 /* @ECU_Address@EGO1fault@0x010015B0@ */ ECIPP_ALIGNMENT_ULONG 4294967 Compu_EGO1fault 0 4294967.295 /end CHARACTERISTIC
/begin COMPU_METHOD Compu_EGO1fault " " RAT_FUNC "%.3" "seconds" COEFFS 0 1000 0 0 0 1 /end COMPU_METHOD
/begin CHARACTERISTIC INJD_off_lo "FaultConfig # INJD_off_lo (Fault Condition:Non-CR Injector off-state low-side <)" VALUE 0x001474bc /* @ECU_Address@INJD_off_lo@0x010015B8@ */ ECIPP_ALIGNMENT_UWORD 55 Compu_INJD_off_lo 0 55.0125915750916 /end CHARACTERISTIC
/begin COMPU_METHOD Compu_INJD_off_lo " " RAT_FUNC "%.3" "volts" COEFFS 0 1191.27272727273 0 0 0 1 /end COMPU_METHOD
/begin CHARACTERISTIC INJD_off_minVbat "FaultConfig # INJD_off_minVbat (Fault Condition:and battery voltage >)" VALUE 0x001474be /* @ECU_Address@INJD_off_minVbat@0x010015C0@ */ ECIPP_ALIGNMENT_UWORD 256 Compu_INJD_off_minVbat 0 255.99609375 /end CHARACTERISTIC
/begin COMPU_METHOD Compu_INJD_off_minVbat " " RAT_FUNC "%.3" "volts" COEFFS 0 256 0 0 0 1 /end COMPU_METHOD
/begin CHARACTERISTIC INJD_on_hi "FaultConfig # INJD_on_hi (Fault Condition:Non-CR Injector on-state low-side >)" VALUE 0x001474c0 /* @ECU_Address@INJD_on_hi@0x010015C8@ */ ECIPP_ALIGNMENT_UWORD 55 Compu_INJD_on_hi 0 55.0125915750916 /end CHARACTERISTIC
/begin COMPU_METHOD Compu_INJD_on_hi " " RAT_FUNC "%.3" "volts" COEFFS 0 1191.27272727273 0 0 0 1 /end COMPU_METHOD
/begin CHARACTERISTIC INJD_on_maxVbat "FaultConfig # INJD_on_maxVbat (Fault Condition:and battery voltage <)" VALUE 0x001474c2 /* @ECU_Address@INJD_on_maxVbat@0x010015D0@ */ ECIPP_ALIGNMENT_UWORD 256 Compu_INJD_on_maxVbat 0 255.99609375 /end CHARACTERISTIC
/begin COMPU_METHOD Compu_INJD_on_maxVbat " " RAT_FUNC "%.3" "volts" COEFFS 0 256 0 0 0 1 /end COMPU_METHOD
/begin CHARACTERISTIC SPKD_dw_lo "FaultConfig # SPKD_dw_lo (Fault Condition:dwell adjustment >=)" VALUE 0x001443a8 /* @ECU_Address@SPKD_dw_lo@0x010015D8@ */ ECIPP_ALIGNMENT_SWORD 105 Compu_SPKD_dw_lo -104.8576 104.8544 /end CHARACTERISTIC
/begin COMPU_METHOD Compu_SPKD_dw_lo " " RAT_FUNC "%.3" "ms" COEFFS 0 312.5 0 0 0 1 /end COMPU_METHOD
/begin CHARACTERISTIC SPKD_dwabs_lo "FaultConfig # SPKD_dwabs_lo (Fault Condition:or total dwell >=)" VALUE 0x001477a8 /* @ECU_Address@SPKD_dwabs_lo@0x010015E0@ */ ECIPP_ALIGNMENT_UWORD 210 Compu_SPKD_dwabs_lo 0 209.712 /end CHARACTERISTIC
/begin COMPU_METHOD Compu_SPKD_dwabs_lo " " RAT_FUNC "%.3" "ms" COEFFS 0 312.5 0 0 0 1 /end COMPU_METHOD
/begin CHARACTERISTIC SPKD_dwminv_lo "FaultConfig # SPKD_dwminv_lo (Fault Condition:Battery voltage >)" VALUE 0x001477ac /* @ECU_Address@SPKD_dwminv_lo@0x010015E8@ */ ECIPP_ALIGNMENT_UWORD 256 Compu_SPKD_dwminv_lo 0 255.99609375 /end CHARACTERISTIC
/begin COMPU_METHOD Compu_SPKD_dwminv_lo " " RAT_FUNC "%.3" "volts" COEFFS 0 256 0 0 0 1 /end COMPU_METHOD
/begin CHARACTERISTIC SPKD_dw_hi "FaultConfig # SPKD_dw_hi (Fault Condition:dwell adjustment <=)" VALUE 0x001443a6 /* @ECU_Address@SPKD_dw_hi@0x010015F0@ */ ECIPP_ALIGNMENT_SWORD 105 Compu_SPKD_dw_hi -104.8576 104.8544 /end CHARACTERISTIC
/begin COMPU_METHOD Compu_SPKD_dw_hi " " RAT_FUNC "%.3" "ms" COEFFS 0 312.5 0 0 0 1 /end COMPU_METHOD
/begin CHARACTERISTIC SPKD_dwabs_hi "FaultConfig # SPKD_dwabs_hi (Fault Condition:or total dwell <=)" VALUE 0x001477a6 /* @ECU_Address@SPKD_dwabs_hi@0x010015F8@ */ ECIPP_ALIGNMENT_UWORD 210 Compu_SPKD_dwabs_hi 0 209.712 /end CHARACTERISTIC
/begin COMPU_METHOD Compu_SPKD_dwabs_hi " " RAT_FUNC "%.3" "ms" COEFFS 0 312.5 0 0 0 1 /end COMPU_METHOD
/begin CHARACTERISTIC SPKD_dwmaxv_hi "FaultConfig # SPKD_dwmaxv_hi (Fault Condition:Battery voltage <)" VALUE 0x001477aa /* @ECU_Address@SPKD_dwmaxv_hi@0x01001600@ */ ECIPP_ALIGNMENT_UWORD 256 Compu_SPKD_dwmaxv_hi 0 255.99609375 /end CHARACTERISTIC
/begin COMPU_METHOD Compu_SPKD_dwmaxv_hi " " RAT_FUNC "%.3" "volts" COEFFS 0 256 0 0 0 1 /end COMPU_METHOD
/begin CHARACTERISTIC crknoise_rpm "FaultConfig # crknoise_rpm (Fault Condition:and RPM >)" VALUE 0x00147abc /* @ECU_Address@crknoise_rpm@0x01001608@ */ ECIPP_ALIGNMENT_UWORD 65535 Compu_crknoise_rpm 0 65535 /end CHARACTERISTIC
/begin COMPU_METHOD Compu_crknoise_rpm " " RAT_FUNC "%.0" "rpm" COEFFS 0 1 0 0 0 1 /end COMPU_METHOD
/begin CHARACTERISTIC camloss_rpm "FaultConfig # camloss_rpm (Fault Condition:and RPM >)" VALUE 0x00147a9a /* @ECU_Address@camloss_rpm@0x01001610@ */ ECIPP_ALIGNMENT_UWORD 65535 Compu_camloss_rpm 0 65535 /end CHARACTERISTIC
/begin COMPU_METHOD Compu_camloss_rpm " " RAT_FUNC "%.0" "rpm" COEFFS 0 1 0 0 0 1 /end COMPU_METHOD
/begin CHARACTERISTIC crknoise "FaultConfig # crknoise (Fault Condition:Number of invalid crank re-syncs)" VALUE 0x00147aba /* @ECU_Address@crknoise@0x01001618@ */ ECIPP_ALIGNMENT_UWORD 65535 Compu_crknoise 0 65535 /end CHARACTERISTIC
/begin COMPU_METHOD Compu_crknoise " " RAT_FUNC "%.0" "re-syncs" COEFFS 0 1 0 0 0 1 /end COMPU_METHOD
/begin CHARACTERISTIC camnoise "FaultConfig # camnoise (Fault Condition:Number of invalid cam re-syncs)" VALUE 0x00147a9c /* @ECU_Address@camnoise@0x01001620@ */ ECIPP_ALIGNMENT_UWORD 65535 Compu_camnoise 0 65535 /end CHARACTERISTIC
/begin COMPU_METHOD Compu_camnoise " " RAT_FUNC "%.0" "re-syncs" COEFFS 0 1 0 0 0 1 /end COMPU_METHOD
/begin CHARACTERISTIC CHT_HiExp "FaultConfig # CHT_HiExp (Fault Condition:CHT >)" VALUE 0x0014672e /* @ECU_Address@CHT_HiExp@0x01001628@ */ ECIPP_ALIGNMENT_UWORD 564 Compu_CHT_HiExp -460 563.984375 /end CHARACTERISTIC
/begin COMPU_METHOD Compu_CHT_HiExp " " RAT_FUNC "%.3" "deg F" COEFFS 0 64 29440 0 0 1 /end COMPU_METHOD
/begin CHARACTERISTIC CHT_HiExp_rpm "FaultConfig # CHT_HiExp_rpm (Fault Condition:and RPM >)" VALUE 0x00146734 /* @ECU_Address@CHT_HiExp_rpm@0x01001630@ */ ECIPP_ALIGNMENT_UWORD 65535 Compu_CHT_HiExp_rpm 0 65535 /end CHARACTERISTIC
/begin COMPU_METHOD Compu_CHT_HiExp_rpm " " RAT_FUNC "%.0" "rpm" COEFFS 0 1 0 0 0 1 /end COMPU_METHOD
/begin CHARACTERISTIC CHT_HiExp2 "FaultConfig # CHT_HiExp2 (Fault Condition:CHT >)" VALUE 0x00146730 /* @ECU_Address@CHT_HiExp2@0x01001638@ */ ECIPP_ALIGNMENT_UWORD 564 Compu_CHT_HiExp2 -460 563.984375 /end CHARACTERISTIC
/begin COMPU_METHOD Compu_CHT_HiExp2 " " RAT_FUNC "%.3" "deg F" COEFFS 0 64 29440 0 0 1 /end COMPU_METHOD
/begin CHARACTERISTIC CHT_HiExp2_rpm "FaultConfig # CHT_HiExp2_rpm (Fault Condition:and RPM >)" VALUE 0x00146732 /* @ECU_Address@CHT_HiExp2_rpm@0x01001640@ */ ECIPP_ALIGNMENT_UWORD 65535 Compu_CHT_HiExp2_rpm 0 65535 /end CHARACTERISTIC
/begin COMPU_METHOD Compu_CHT_HiExp2_rpm " " RAT_FUNC "%.0" "rpm" COEFFS 0 1 0 0 0 1 /end COMPU_METHOD
/begin CHARACTERISTIC crknoise_tout "FaultConfig # crknoise_tout (Fault Condition:within a time window of <=)" VALUE 0x00147abe /* @ECU_Address@crknoise_tout@0x01001658@ */ ECIPP_ALIGNMENT_UWORD 65535 Compu_crknoise_tout 0 65535 /end CHARACTERISTIC
/begin COMPU_METHOD Compu_crknoise_tout " " RAT_FUNC "%.0" "ms" COEFFS 0 1 0 0 0 1 /end COMPU_METHOD
/begin CHARACTERISTIC camnoise_tout "FaultConfig # camnoise_tout (Fault Condition:within a time window of <=)" VALUE 0x00147a9e /* @ECU_Address@camnoise_tout@0x01001660@ */ ECIPP_ALIGNMENT_UWORD 65535 Compu_camnoise_tout 0 65535 /end CHARACTERISTIC
/begin COMPU_METHOD Compu_camnoise_tout " " RAT_FUNC "%.0" "ms" COEFFS 0 1 0 0 0 1 /end COMPU_METHOD
/begin CHARACTERISTIC MAP_max_unlch "General # MAP_max_unlch (Fault Condition:to unlatch, MAP pressure must be <)" VALUE 0x001475b8 /* @ECU_Address@MAP_max_unlch@0x010016A8@ */ ECIPP_ALIGNMENT_UWORD 256 Compu_MAP_max_unlch 0 255.99609375 /end CHARACTERISTIC
/begin COMPU_METHOD Compu_MAP_max_unlch " " RAT_FUNC "%.3" "psia" COEFFS 0 256 0 0 0 1 /end COMPU_METHOD
/begin CHARACTERISTIC MAP_minv_unlch "General # MAP_minv_unlch (Fault Condition:to unlatch, MAP voltage must be >)" VALUE 0x001475c0 /* @ECU_Address@MAP_minv_unlch@0x010016B0@ */ ECIPP_ALIGNMENT_UWORD 5 Compu_MAP_minv_unlch 0 5.00114468864469 /end CHARACTERISTIC
/begin COMPU_METHOD Compu_MAP_minv_unlch " " RAT_FUNC "%.3" "volts" COEFFS 0 13104 0 0 0 1 /end COMPU_METHOD
/begin CHARACTERISTIC APD1_max "FaultConfig # APD1_max (Fault Condition:AUX analog PD1 >)" VALUE 0x001633f2 /* @ECU_Address@APD1_max@0x01001708@ */ ECIPP_ALIGNMENT_UWORD 5 Compu_APD1_max 0 5.00114468864469 /end CHARACTERISTIC
/begin COMPU_METHOD Compu_APD1_max " " RAT_FUNC "%.3" "volts" COEFFS 0 13104 0 0 0 1 /end COMPU_METHOD
/begin CHARACTERISTIC APD1_min "FaultConfig # APD1_min (Fault Condition:AUX analog PD1 <)" VALUE 0x001633f4 /* @ECU_Address@APD1_min@0x01001710@ */ ECIPP_ALIGNMENT_UWORD 5 Compu_APD1_min 0 5.00114468864469 /end CHARACTERISTIC
/begin COMPU_METHOD Compu_APD1_min " " RAT_FUNC "%.3" "volts" COEFFS 0 13104 0 0 0 1 /end COMPU_METHOD
/begin CHARACTERISTIC APU1_max "FaultConfig # APU1_max (Fault Condition:AUX analog PU1 >)" VALUE 0x001633fe /* @ECU_Address@APU1_max@0x01001718@ */ ECIPP_ALIGNMENT_UWORD 5 Compu_APU1_max 0 5.00114468864469 /end CHARACTERISTIC
/begin COMPU_METHOD Compu_APU1_max " " RAT_FUNC "%.3" "volts" COEFFS 0 13104 0 0 0 1 /end COMPU_METHOD
/begin CHARACTERISTIC APU1_min "FaultConfig # APU1_min (Fault Condition:AUX analog PU1 <)" VALUE 0x00163400 /* @ECU_Address@APU1_min@0x01001720@ */ ECIPP_ALIGNMENT_UWORD 5 Compu_APU1_min 0 5.00114468864469 /end CHARACTERISTIC
/begin COMPU_METHOD Compu_APU1_min " " RAT_FUNC "%.3" "volts" COEFFS 0 13104 0 0 0 1 /end COMPU_METHOD
/begin CHARACTERISTIC APU2_max "FaultConfig # APU2_max (Fault Condition:AUX analog PU2 >)" VALUE 0x00163402 /* @ECU_Address@APU2_max@0x01001728@ */ ECIPP_ALIGNMENT_UWORD 5 Compu_APU2_max 0 5.00114468864469 /end CHARACTERISTIC
/begin COMPU_METHOD Compu_APU2_max " " RAT_FUNC "%.3" "volts" COEFFS 0 13104 0 0 0 1 /end COMPU_METHOD
/begin CHARACTERISTIC APU2_min "FaultConfig # APU2_min (Fault Condition:AUX analog PU2 <)" VALUE 0x00163404 /* @ECU_Address@APU2_min@0x01001730@ */ ECIPP_ALIGNMENT_UWORD 5 Compu_APU2_min 0 5.00114468864469 /end CHARACTERISTIC
/begin COMPU_METHOD Compu_APU2_min " " RAT_FUNC "%.3" "volts" COEFFS 0 13104 0 0 0 1 /end COMPU_METHOD
/begin CHARACTERISTIC OILP_wait "FaultConfig # OILP_wait (Fault Condition:Run time wait for all oil pressure low faults:)" VALUE 0x00144104 /* @ECU_Address@OILP_wait@0x01001780@ */ ECIPP_ALIGNMENT_ULONG 4294967 Compu_OILP_wait 0 4294967.295 /end CHARACTERISTIC
/begin COMPU_METHOD Compu_OILP_wait " " RAT_FUNC "%.3" "seconds" COEFFS 0 1000 0 0 0 1 /end COMPU_METHOD
/begin CHARACTERISTIC RS485_Rx_inact "IOConfig # RS485_Rx_inact (Fault Condition:Power alive >)" VALUE 0x00144114 /* @ECU_Address@RS485_Rx_inact@0x01001808@ */ ECIPP_ALIGNMENT_ULONG 4294967 Compu_RS485_Rx_inact 0 4294967.295 /end CHARACTERISTIC
/begin COMPU_METHOD Compu_RS485_Rx_inact " " RAT_FUNC "%.3" "sec" COEFFS 0 1000 0 0 0 1 /end COMPU_METHOD
/begin CHARACTERISTIC RS485_Rx_noise "IOConfig # RS485_Rx_noise (Fault Condition:Number of noisy packets >=)" VALUE 0x001476fa /* @ECU_Address@RS485_Rx_noise@0x01001810@ */ ECIPP_ALIGNMENT_UWORD 65535 Compu_RS485_Rx_noise 0 65535 /end CHARACTERISTIC
/begin COMPU_METHOD Compu_RS485_Rx_noise " " RAT_FUNC "%.0" "packets" COEFFS 0 1 0 0 0 1 /end COMPU_METHOD
/begin CHARACTERISTIC RS485_bad_fmt "IOConfig # RS485_bad_fmt (Fault Condition:Number of invalid formats >=)" VALUE 0x001476fe /* @ECU_Address@RS485_bad_fmt@0x01001818@ */ ECIPP_ALIGNMENT_UWORD 65535 Compu_RS485_bad_fmt 0 65535 /end CHARACTERISTIC
/begin COMPU_METHOD Compu_RS485_bad_fmt " " RAT_FUNC "%.0" "packets" COEFFS 0 1 0 0 0 1 /end COMPU_METHOD
/begin CHARACTERISTIC RS485_SD_rq "IOConfig # RS485_SD_rq (Fault Condition:Number of shutdown requests >=)" VALUE 0x001476fc /* @ECU_Address@RS485_SD_rq@0x01001820@ */ ECIPP_ALIGNMENT_UWORD 65535 Compu_RS485_SD_rq 0 65535 /end CHARACTERISTIC
/begin COMPU_METHOD Compu_RS485_SD_rq " " RAT_FUNC "%.0" "requests" COEFFS 0 1 0 0 0 1 /end COMPU_METHOD
/begin CHARACTERISTIC FPP1_IVS_max "FaultConfig # FPP1_IVS_max (Fault Condition:IVS at-idle when FPP1 >)" VALUE 0x00146880 /* @ECU_Address@FPP1_IVS_max@0x010018A0@ */ ECIPP_ALIGNMENT_UWORD 5 Compu_FPP1_IVS_max 0 5.00114468864469 /end CHARACTERISTIC
/begin COMPU_METHOD Compu_FPP1_IVS_max " " RAT_FUNC "%.3" "volts" COEFFS 0 13104 0 0 0 1 /end COMPU_METHOD
/begin CHARACTERISTIC FPP1_IVS_min "FaultConfig # FPP1_IVS_min (Fault Condition:IVS off-idle when FPP1 <)" VALUE 0x00146882 /* @ECU_Address@FPP1_IVS_min@0x010018A8@ */ ECIPP_ALIGNMENT_UWORD 5 Compu_FPP1_IVS_min 0 5.00114468864469 /end CHARACTERISTIC
/begin COMPU_METHOD Compu_FPP1_IVS_min " " RAT_FUNC "%.3" "volts" COEFFS 0 13104 0 0 0 1 /end COMPU_METHOD
/begin CHARACTERISTIC FPP2_IVS_max "FaultConfig # FPP2_IVS_max (Fault Condition:IVS at-idle when FPP2 >)" VALUE 0x00146886 /* @ECU_Address@FPP2_IVS_max@0x010018B0@ */ ECIPP_ALIGNMENT_UWORD 5 Compu_FPP2_IVS_max 0 5.00114468864469 /end CHARACTERISTIC
/begin COMPU_METHOD Compu_FPP2_IVS_max " " RAT_FUNC "%.3" "volts" COEFFS 0 13104 0 0 0 1 /end COMPU_METHOD
/begin CHARACTERISTIC FPP2_IVS_min "FaultConfig # FPP2_IVS_min (Fault Condition:IVS off-idle when FPP2 <)" VALUE 0x00146888 /* @ECU_Address@FPP2_IVS_min@0x010018B8@ */ ECIPP_ALIGNMENT_UWORD 5 Compu_FPP2_IVS_min 0 5.00114468864469 /end CHARACTERISTIC
/begin COMPU_METHOD Compu_FPP2_IVS_min " " RAT_FUNC "%.3" "volts" COEFFS 0 13104 0 0 0 1 /end COMPU_METHOD
/begin CHARACTERISTIC max_gov_override "FaultConfig # max_gov_override (Fault Condition:rpm >)" VALUE 0x00147b5c /* @ECU_Address@max_gov_override@0x010018C0@ */ ECIPP_ALIGNMENT_UWORD 65535 Compu_max_gov_override 0 65535 /end CHARACTERISTIC
/begin COMPU_METHOD Compu_max_gov_override " " RAT_FUNC "%.0" "rpm" COEFFS 0 1 0 0 0 1 /end COMPU_METHOD
/begin CHARACTERISTIC FPPatidle_min "IOConfig # FPPatidle_min" VALUE 0x001468b4 /* @ECU_Address@FPPatidle_min@0x010018D8@ */ ECIPP_ALIGNMENT_UWORD 5 Compu_FPPatidle_min 0 5.00114468864469 /end CHARACTERISTIC
/begin COMPU_METHOD Compu_FPPatidle_min " " RAT_FUNC "%.3" "volts" COEFFS 0 13104 0 0 0 1 /end COMPU_METHOD
/begin CHARACTERISTIC FPPatidle_max "IOConfig # FPPatidle_max" VALUE 0x001468b2 /* @ECU_Address@FPPatidle_max@0x010018E0@ */ ECIPP_ALIGNMENT_UWORD 5 Compu_FPPatidle_max 0 5.00114468864469 /end CHARACTERISTIC
/begin COMPU_METHOD Compu_FPPatidle_max " " RAT_FUNC "%.3" "volts" COEFFS 0 13104 0 0 0 1 /end COMPU_METHOD
/begin CHARACTERISTIC FPPatidle_IVSdelta "IOConfig # FPPatidle_IVSdelta (Fault Condition:and FPP1 < FPP1 learned idle +)" VALUE 0x001468ae /* @ECU_Address@FPPatidle_IVSdelta@0x010018E8@ */ ECIPP_ALIGNMENT_UWORD 5 Compu_FPPatidle_IVSdelta 0 5.00114468864469 /end CHARACTERISTIC
/begin COMPU_METHOD Compu_FPPatidle_IVSdelta " " RAT_FUNC "%.3" "volts" COEFFS 0 13104 0 0 0 1 /end COMPU_METHOD
/begin CHARACTERISTIC FPPatidle_IVSmargin "IOConfig # FPPatidle_IVSmargin" VALUE 0x001468b0 /* @ECU_Address@FPPatidle_IVSmargin@0x010018F0@ */ ECIPP_ALIGNMENT_UWORD 5 Compu_FPPatidle_IVSmargin 0 5.00114468864469 /end CHARACTERISTIC
/begin COMPU_METHOD Compu_FPPatidle_IVSmargin " " RAT_FUNC "%.3" "volts" COEFFS 0 13104 0 0 0 1 /end COMPU_METHOD
/begin CHARACTERISTIC FPPatidle_ena "{FPPatidle_ena&0xff=0:Disabled}{FPPatidle_ena&0xff=1:Enabled} (Fault Condition:OR IVS off-idle if FPP1 @idle fault)" VALUE 0x00147d72 /* @ECU_Address@FPPatidle_ena@0x010018F8@ */ ECIPP_ALIGNMENT_UBYTE 255 FPPatidle_ena_COMPU_VTAB 0 255 BIT_MASK 0xff /end CHARACTERISTIC
/begin COMPU_METHOD FPPatidle_ena_COMPU_VTAB "Verbal Table" TAB_VERB "%.0" "list" COMPU_TAB_REF FPPatidle_ena_COMPU_VTAB_REF /end COMPU_METHOD
/begin COMPU_VTAB FPPatidle_ena_COMPU_VTAB_REF "Verbal Table" TAB_VERB 2 0 "Disabled" 1 "Enabled" DEFAULT_VALUE "UNKNOWN" /end COMPU_VTAB
/begin CHARACTERISTIC FPP1_idle_init "IOConfig # FPP1_idle_init" VALUE 0x00148DFE /* @ECU_Address@FPP1_idle_init@0x01001900@ */ ECIPP_ALIGNMENT_UWORD 5 Compu_FPP1_idle_init 0 5.00114468864469 /end CHARACTERISTIC
/begin COMPU_METHOD Compu_FPP1_idle_init " " RAT_FUNC "%.3" "volts" COEFFS 0 13104 0 0 0 1 /end COMPU_METHOD
/begin CHARACTERISTIC FPP1_full_init "IOConfig # FPP1_full_init" VALUE 0x00148E00 /* @ECU_Address@FPP1_full_init@0x01001908@ */ ECIPP_ALIGNMENT_UWORD 5 Compu_FPP1_full_init 0 5.00114468864469 /end CHARACTERISTIC
/begin COMPU_METHOD Compu_FPP1_full_init " " RAT_FUNC "%.3" "volts" COEFFS 0 13104 0 0 0 1 /end COMPU_METHOD
/begin CHARACTERISTIC FPP1_def "IOConfig # FPP1_def" VALUE 0x00148DF8 /* @ECU_Address@FPP1_def@0x01001910@ */ ECIPP_ALIGNMENT_UWORD 5 Compu_FPP1_def 0 5.00114468864469 /end CHARACTERISTIC
/begin COMPU_METHOD Compu_FPP1_def " " RAT_FUNC "%.3" "volts" COEFFS 0 13104 0 0 0 1 /end COMPU_METHOD
/begin CHARACTERISTIC FPP2_idle_init "IOConfig # FPP2_idle_init" VALUE 0x00148E08 /* @ECU_Address@FPP2_idle_init@0x01001918@ */ ECIPP_ALIGNMENT_UWORD 5 Compu_FPP2_idle_init 0 5.00114468864469 /end CHARACTERISTIC
/begin COMPU_METHOD Compu_FPP2_idle_init " " RAT_FUNC "%.3" "volts" COEFFS 0 13104 0 0 0 1 /end COMPU_METHOD
/begin CHARACTERISTIC FPP2_full_init "IOConfig # FPP2_full_init" VALUE 0x00148E0A /* @ECU_Address@FPP2_full_init@0x01001920@ */ ECIPP_ALIGNMENT_UWORD 5 Compu_FPP2_full_init 0 5.00114468864469 /end CHARACTERISTIC
/begin COMPU_METHOD Compu_FPP2_full_init " " RAT_FUNC "%.3" "volts" COEFFS 0 13104 0 0 0 1 /end COMPU_METHOD
/begin CHARACTERISTIC FPP2_def "IOConfig # FPP2_def" VALUE 0x00148E02 /* @ECU_Address@FPP2_def@0x01001928@ */ ECIPP_ALIGNMENT_UWORD 5 Compu_FPP2_def 0 5.00114468864469 /end CHARACTERISTIC
/begin COMPU_METHOD Compu_FPP2_def " " RAT_FUNC "%.3" "volts" COEFFS 0 13104 0 0 0 1 /end COMPU_METHOD
/begin CHARACTERISTIC IVS_trans_wait "IOConfig # IVS_trans_wait" VALUE 0x001474ce /* @ECU_Address@IVS_trans_wait@0x01001940@ */ ECIPP_ALIGNMENT_UWORD 65535 Compu_IVS_trans_wait 0 65535 /end CHARACTERISTIC
/begin COMPU_METHOD Compu_IVS_trans_wait " " RAT_FUNC "%.0" "ms" COEFFS 0 1 0 0 0 1 /end COMPU_METHOD
/begin CHARACTERISTIC IVS_FPPpwr_pct "IOConfig # IVS_FPPpwr_pct" VALUE 0x001474cc /* @ECU_Address@IVS_FPPpwr_pct@0x01001948@ */ ECIPP_ALIGNMENT_UWORD 100 Compu_IVS_FPPpwr_pct 0 99.9984741210938 /end CHARACTERISTIC
/begin COMPU_METHOD Compu_IVS_FPPpwr_pct " " RAT_FUNC "%.3" "%" COEFFS 0 655.36 0 0 0 1 /end COMPU_METHOD
/begin CHARACTERISTIC MJ_Pe_HiExp "FaultConfig # MJ_Pe_HiExp (Fault Condition:EPR (actual-commanded) pressure >)" VALUE 0x00144372 /* @ECU_Address@MJ_Pe_HiExp@0x010021D8@ */ ECIPP_ALIGNMENT_SWORD 222 Compu_MJ_Pe_HiExp -222 221.993225097656 /end CHARACTERISTIC
/begin COMPU_METHOD Compu_MJ_Pe_HiExp " " RAT_FUNC "%.3" "in H2O" COEFFS 0 147.603603603604 0 0 0 1 /end COMPU_METHOD
/begin CHARACTERISTIC MJ_Pe_LoExp "FaultConfig # MJ_Pe_LoExp (Fault Condition:EPR (actual-commanded) pressure <)" VALUE 0x00144374 /* @ECU_Address@MJ_Pe_LoExp@0x010021E0@ */ ECIPP_ALIGNMENT_SWORD 222 Compu_MJ_Pe_LoExp -222 221.993225097656 /end CHARACTERISTIC
/begin COMPU_METHOD Compu_MJ_Pe_LoExp " " RAT_FUNC "%.3" "in H2O" COEFFS 0 147.603603603604 0 0 0 1 /end COMPU_METHOD
/begin CHARACTERISTIC MJ_comm_tout "FaultConfig # MJ_comm_tout (Fault Condition:No EPR / CFV packets received within)" VALUE 0x00147626 /* @ECU_Address@MJ_comm_tout@0x010021E8@ */ ECIPP_ALIGNMENT_UWORD 65535 Compu_MJ_comm_tout 0 65535 /end CHARACTERISTIC
/begin COMPU_METHOD Compu_MJ_comm_tout " " RAT_FUNC "%.0" "ms" COEFFS 0 1 0 0 0 1 /end COMPU_METHOD
/begin CHARACTERISTIC DPS_I_min "EPR I min" VALUE 0x001442a8 /* @ECU_Address@DPS_I_min@0x01002420@ */ ECIPP_ALIGNMENT_SWORD 25599 Compu_DPS_I_min -25600 25599.21875 MAX_REFRESH 6 1 /end CHARACTERISTIC
/begin COMPU_METHOD Compu_DPS_I_min " " RAT_FUNC "%.1" "%" COEFFS 0 1.28 0 0 0 1 /end COMPU_METHOD
/begin CHARACTERISTIC DPS_I_max "EPR I max" VALUE 0x001442a6 /* @ECU_Address@DPS_I_max@0x01002428@ */ ECIPP_ALIGNMENT_SWORD 25599 Compu_DPS_I_max -25600 25599.21875 MAX_REFRESH 6 1 /end CHARACTERISTIC
/begin COMPU_METHOD Compu_DPS_I_max " " RAT_FUNC "%.1" "%" COEFFS 0 1.28 0 0 0 1 /end COMPU_METHOD
/begin CHARACTERISTIC DPS_AcmdLP "EPR area output LP tau" VALUE 0x00147bcc /* @ECU_Address@DPS_AcmdLP@0x01002430@ */ ECIPP_ALIGNMENT_UWORD 163840 Compu_DPS_AcmdLP 0.16703 163840 MAX_REFRESH 6 1 /end CHARACTERISTIC
/begin COMPU_METHOD Compu_DPS_AcmdLP " " FORM "%.1" "ms"
 /begin FORMULA "-5 / log(1.0000000000001 - (X1 / 32768))" FORMULA_INV "(1.0000000000001 - exp(-5/X1)) * 32768" /end FORMULA
/end COMPU_METHOD
/begin CHARACTERISTIC DPS_SenseLP "EPR sensor input LP tau" VALUE 0x00147bce /* @ECU_Address@DPS_SenseLP@0x01002438@ */ ECIPP_ALIGNMENT_UWORD 32768 Compu_DPS_SenseLP 0.045084 32768 MAX_REFRESH 6 1 /end CHARACTERISTIC
/begin COMPU_METHOD Compu_DPS_SenseLP " " FORM "%.1" "ms"
 /begin FORMULA "-0.5 / log(1 - (X1 / 65536))" FORMULA_INV "(1 - exp(-0.5/X1)) * 65536" /end FORMULA
/end COMPU_METHOD
/begin CHARACTERISTIC MJI_Pstart "EPR internal default start press" VALUE 0x00144370 /* @ECU_Address@MJI_Pstart@0x01002440@ */ ECIPP_ALIGNMENT_SWORD 64 Compu_MJI_Pstart -64 63.998046875 MAX_REFRESH 6 1 /end CHARACTERISTIC
/begin COMPU_METHOD Compu_MJI_Pstart " " RAT_FUNC "%.2" "in H2O" COEFFS 0 512 0 0 0 1 /end COMPU_METHOD
/begin CHARACTERISTIC DBW_Vcomp_min "Gov # DBW_Vcomp_min" VALUE 0x00148D96 /* @ECU_Address@DBW_Vcomp_min@0x010027C8@ */ ECIPP_ALIGNMENT_UWORD 256 Compu_DBW_Vcomp_min 0 255.99609375 /end CHARACTERISTIC
/begin COMPU_METHOD Compu_DBW_Vcomp_min " " RAT_FUNC "%.3" "volts" COEFFS 0 256 0 0 0 1 /end COMPU_METHOD
/begin CHARACTERISTIC DBW_Vcomp_max "Gov # DBW_Vcomp_max" VALUE 0x00148D98 /* @ECU_Address@DBW_Vcomp_max@0x010027D0@ */ ECIPP_ALIGNMENT_UWORD 256 Compu_DBW_Vcomp_max 0 255.99609375 /end CHARACTERISTIC
/begin COMPU_METHOD Compu_DBW_Vcomp_max " " RAT_FUNC "%.3" "volts" COEFFS 0 256 0 0 0 1 /end COMPU_METHOD
/begin CHARACTERISTIC TPS_learn_idle_seek "Gov # TPS_learn_idle_seek" VALUE 0x00148D0A /* @ECU_Address@TPS_learn_idle_seek@0x010027D8@ */ ECIPP_ALIGNMENT_UWORD 100 Compu_TPS_learn_idle_seek 0 99.9984741210938 /end CHARACTERISTIC
/begin COMPU_METHOD Compu_TPS_learn_idle_seek " " RAT_FUNC "%.3" "%" COEFFS 0 655.36 0 0 0 1 /end COMPU_METHOD
/begin CHARACTERISTIC TPS_learn_full_seek "Gov # TPS_learn_full_seek" VALUE 0x00148D10 /* @ECU_Address@TPS_learn_full_seek@0x010027E0@ */ ECIPP_ALIGNMENT_UWORD 100 Compu_TPS_learn_full_seek 0 99.9984741210938 /end CHARACTERISTIC
/begin COMPU_METHOD Compu_TPS_learn_full_seek " " RAT_FUNC "%.3" "%" COEFFS 0 655.36 0 0 0 1 /end COMPU_METHOD
/begin CHARACTERISTIC TIP_maxMAP "FaultConfig # TIP_maxMAP (Fault Condition:and MAP <)" VALUE 0x001478a2 /* @ECU_Address@TIP_maxMAP@0x01002988@ */ ECIPP_ALIGNMENT_UWORD 256 Compu_TIP_maxMAP 0 255.99609375 /end CHARACTERISTIC
/begin COMPU_METHOD Compu_TIP_maxMAP " " RAT_FUNC "%.3" "psia" COEFFS 0 256 0 0 0 1 /end COMPU_METHOD
/begin CHARACTERISTIC TIP_minv "FaultConfig # TIP_minv (Fault Condition:TIP/TOP voltage <)" VALUE 0x001478a6 /* @ECU_Address@TIP_minv@0x01002990@ */ ECIPP_ALIGNMENT_UWORD 5 Compu_TIP_minv 0 5.00114468864469 /end CHARACTERISTIC
/begin COMPU_METHOD Compu_TIP_minv " " RAT_FUNC "%.3" "volts" COEFFS 0 13104 0 0 0 1 /end COMPU_METHOD
/begin CHARACTERISTIC TIP_maxv "FaultConfig # TIP_maxv (Fault Condition:TIP/TOP voltage >)" VALUE 0x001478a4 /* @ECU_Address@TIP_maxv@0x01002998@ */ ECIPP_ALIGNMENT_UWORD 5 Compu_TIP_maxv 0 5.00114468864469 /end CHARACTERISTIC
/begin COMPU_METHOD Compu_TIP_maxv " " RAT_FUNC "%.3" "volts" COEFFS 0 13104 0 0 0 1 /end COMPU_METHOD
/begin CHARACTERISTIC FP_maxv "FaultConfig # FP_maxv (Fault Condition:Primary FP voltage >)" VALUE 0x00149044 /* @ECU_Address@FP_maxv@0x010029D0@ */ ECIPP_ALIGNMENT_UWORD 5 Compu_FP_maxv 0 5.00114468864469 /end CHARACTERISTIC
/begin COMPU_METHOD Compu_FP_maxv " " RAT_FUNC "%.3" "volts" COEFFS 0 13104 0 0 0 1 /end COMPU_METHOD
/begin CHARACTERISTIC FP_minv "FaultConfig # FP_minv (Fault Condition:Primary FP voltage <)" VALUE 0x00149046 /* @ECU_Address@FP_minv@0x010029D8@ */ ECIPP_ALIGNMENT_UWORD 5 Compu_FP_minv 0 5.00114468864469 /end CHARACTERISTIC
/begin COMPU_METHOD Compu_FP_minv " " RAT_FUNC "%.3" "volts" COEFFS 0 13104 0 0 0 1 /end COMPU_METHOD
/begin CHARACTERISTIC FT_maxv "FaultConfig # FT_maxv (Fault Condition:FT voltage >)" VALUE 0x00147406 /* @ECU_Address@FT_maxv@0x010029E0@ */ ECIPP_ALIGNMENT_UWORD 5 Compu_FT_maxv 0 5.00114468864469 /end CHARACTERISTIC
/begin COMPU_METHOD Compu_FT_maxv " " RAT_FUNC "%.3" "volts" COEFFS 0 13104 0 0 0 1 /end COMPU_METHOD
/begin CHARACTERISTIC FT_minv "FaultConfig # FT_minv (Fault Condition:FT voltage <)" VALUE 0x00147408 /* @ECU_Address@FT_minv@0x010029E8@ */ ECIPP_ALIGNMENT_UWORD 5 Compu_FT_minv 0 5.00114468864469 /end CHARACTERISTIC
/begin COMPU_METHOD Compu_FT_minv " " RAT_FUNC "%.3" "volts" COEFFS 0 13104 0 0 0 1 /end COMPU_METHOD
/begin CHARACTERISTIC OilP_hiP_RPM "FaultConfig # OilP_hiP_RPM (Fault Condition:and RPM >)" VALUE 0x0014767c /* @ECU_Address@OilP_hiP_RPM@0x01002BC0@ */ ECIPP_ALIGNMENT_UWORD 65535 Compu_OilP_hiP_RPM 0 65535 /end CHARACTERISTIC
/begin COMPU_METHOD Compu_OilP_hiP_RPM " " RAT_FUNC "%.0" "rpm" COEFFS 0 1 0 0 0 1 /end COMPU_METHOD
/begin CHARACTERISTIC crkloss "Spark # crkloss (Fault Condition:Cam pulses without crank activity >)" VALUE 0x00147ab8 /* @ECU_Address@crkloss@0x01002C08@ */ ECIPP_ALIGNMENT_UWORD 65535 Compu_crkloss 0 65535 /end CHARACTERISTIC
/begin COMPU_METHOD Compu_crkloss " " RAT_FUNC "%.0" "cam pulses" COEFFS 0 1 0 0 0 1 /end COMPU_METHOD
/begin CHARACTERISTIC J1939_TxFail "FaultConfig # J1939_TxFail (Fault Condition:Tx error counter >)" VALUE 0x0014856D /* @ECU_Address@J1939_TxFail@0x01002D38@ */ ECIPP_ALIGNMENT_UBYTE 255 Compu_J1939_TxFail 0 255 /end CHARACTERISTIC
/begin COMPU_METHOD Compu_J1939_TxFail " " RAT_FUNC "%.0" "failures" COEFFS 0 1 0 0 0 1 /end COMPU_METHOD
/begin CHARACTERISTIC J1939_RxFail "FaultConfig # J1939_RxFail (Fault Condition:Rx error counter >)" VALUE 0x0014856E /* @ECU_Address@J1939_RxFail@0x01002D40@ */ ECIPP_ALIGNMENT_UBYTE 255 Compu_J1939_RxFail 0 255 /end CHARACTERISTIC
/begin COMPU_METHOD Compu_J1939_RxFail " " RAT_FUNC "%.0" "failures" COEFFS 0 1 0 0 0 1 /end COMPU_METHOD
/begin CHARACTERISTIC DBW_IAC_mode "DBW / IAC configuration{DBW_IAC_mode&0xff=0:DBW}{DBW_IAC_mode&0xff=1:IAC}" VALUE 0x00147d0d /* @ECU_Address@DBW_IAC_mode@0x01002DB8@ */ ECIPP_ALIGNMENT_UBYTE 255 DBW_IAC_mode_COMPU_VTAB 0 255 BIT_MASK 0xff /end CHARACTERISTIC
/begin COMPU_METHOD DBW_IAC_mode_COMPU_VTAB "Verbal Table" TAB_VERB "%.0" "list" COMPU_TAB_REF DBW_IAC_mode_COMPU_VTAB_REF /end COMPU_METHOD
/begin COMPU_VTAB DBW_IAC_mode_COMPU_VTAB_REF "Verbal Table" TAB_VERB 2 0 "DBW" 1 "IAC" DEFAULT_VALUE "UNKNOWN" /end COMPU_VTAB
/begin CHARACTERISTIC MIL_persist_min "FaultConfig # MIL_persist_min" VALUE 0x00147604 /* @ECU_Address@MIL_persist_min@0x01003270@ */ ECIPP_ALIGNMENT_UWORD 66 Compu_MIL_persist_min 0 65.535 /end CHARACTERISTIC
/begin COMPU_METHOD Compu_MIL_persist_min " " RAT_FUNC "%.3" "seconds" COEFFS 0 1000 0 0 0 1 /end COMPU_METHOD
/begin CHARACTERISTIC FPP2atidle_min "IOConfig # FPP2atidle_min" VALUE 0x00146890 /* @ECU_Address@FPP2atidle_min@0x01003420@ */ ECIPP_ALIGNMENT_UWORD 5 Compu_FPP2atidle_min 0 5.00114468864469 /end CHARACTERISTIC
/begin COMPU_METHOD Compu_FPP2atidle_min " " RAT_FUNC "%.3" "volts" COEFFS 0 13104 0 0 0 1 /end COMPU_METHOD
/begin CHARACTERISTIC FPP2atidle_max "IOConfig # FPP2atidle_max" VALUE 0x0014688e /* @ECU_Address@FPP2atidle_max@0x01003428@ */ ECIPP_ALIGNMENT_UWORD 5 Compu_FPP2atidle_max 0 5.00114468864469 /end CHARACTERISTIC
/begin COMPU_METHOD Compu_FPP2atidle_max " " RAT_FUNC "%.3" "volts" COEFFS 0 13104 0 0 0 1 /end COMPU_METHOD
/begin CHARACTERISTIC FPP2atidle_IVSdelta "IOConfig # FPP2atidle_IVSdelta (Fault Condition:and FPP2 < FPP2 learned idle +)" VALUE 0x0014688a /* @ECU_Address@FPP2atidle_IVSdelta@0x01003430@ */ ECIPP_ALIGNMENT_UWORD 5 Compu_FPP2atidle_IVSdelta 0 5.00114468864469 /end CHARACTERISTIC
/begin COMPU_METHOD Compu_FPP2atidle_IVSdelta " " RAT_FUNC "%.3" "volts" COEFFS 0 13104 0 0 0 1 /end COMPU_METHOD
/begin CHARACTERISTIC FPP2atidle_IVSmargin "IOConfig # FPP2atidle_IVSmargin" VALUE 0x0014688c /* @ECU_Address@FPP2atidle_IVSmargin@0x01003438@ */ ECIPP_ALIGNMENT_UWORD 5 Compu_FPP2atidle_IVSmargin 0 5.00114468864469 /end CHARACTERISTIC
/begin COMPU_METHOD Compu_FPP2atidle_IVSmargin " " RAT_FUNC "%.3" "volts" COEFFS 0 13104 0 0 0 1 /end COMPU_METHOD
/begin CHARACTERISTIC FPP2atidle_ena "{FPP2atidle_ena&0xff=0:Disabled}{FPP2atidle_ena&0xff=1:Enabled} (Fault Condition:or IVS off-idle if FPP2 @idle fault)" VALUE 0x00147d65 /* @ECU_Address@FPP2atidle_ena@0x01003440@ */ ECIPP_ALIGNMENT_UBYTE 255 FPP2atidle_ena_COMPU_VTAB 0 255 BIT_MASK 0xff /end CHARACTERISTIC
/begin COMPU_METHOD FPP2atidle_ena_COMPU_VTAB "Verbal Table" TAB_VERB "%.0" "list" COMPU_TAB_REF FPP2atidle_ena_COMPU_VTAB_REF /end COMPU_METHOD
/begin COMPU_VTAB FPP2atidle_ena_COMPU_VTAB_REF "Verbal Table" TAB_VERB 2 0 "Disabled" 1 "Enabled" DEFAULT_VALUE "UNKNOWN" /end COMPU_VTAB
/begin CHARACTERISTIC DBW_spring_0 "Gov # DBW_spring_0" VALUE 0x00148D7E /* @ECU_Address@DBW_spring_0@0x010034F8@ */ ECIPP_ALIGNMENT_SWORD 200 Compu_DBW_spring_0 -200 199.993896484375 /end CHARACTERISTIC
/begin COMPU_METHOD Compu_DBW_spring_0 " " RAT_FUNC "%.3" "%" COEFFS 0 163.84 0 0 0 1 /end COMPU_METHOD
/begin CHARACTERISTIC DBW_spring_100 "Gov # DBW_spring_100" VALUE 0x00148D80 /* @ECU_Address@DBW_spring_100@0x01003500@ */ ECIPP_ALIGNMENT_SWORD 200 Compu_DBW_spring_100 -200 199.993896484375 /end CHARACTERISTIC
/begin COMPU_METHOD Compu_DBW_spring_100 " " RAT_FUNC "%.3" "%" COEFFS 0 163.84 0 0 0 1 /end COMPU_METHOD
/begin MEASUREMENT CCP_slave_address "IOConfig # CCP_slave_address" UWORD Compu_CCP_slave_address 0 0 0 65535 ECU_ADDRESS 0x01003538 /end MEASUREMENT
/begin COMPU_METHOD Compu_CCP_slave_address " " RAT_FUNC "%.0" "-" COEFFS 0 1 0 0 0 1 /end COMPU_METHOD
/begin MEASUREMENT CCP_resource "IOConfig # CCP_resource" UBYTE Compu_CCP_resource 0 0 0 255 ECU_ADDRESS 0x01003540 /end MEASUREMENT
/begin COMPU_METHOD Compu_CCP_resource " " RAT_FUNC "%.0" "-" COEFFS 0 1 0 0 0 1 /end COMPU_METHOD
/begin CHARACTERISTIC PWM1_off_loVf "FaultConfig # PWM1_off_loVf (Fault Condition:PWM 1 low-side feedback <)" VALUE 0x00164f88 /* @ECU_Address@PWM1_off_loVf@0x01003708@ */ ECIPP_ALIGNMENT_UWORD 100 Compu_PWM1_off_loVf 0 99.9984741210938 /end CHARACTERISTIC
/begin COMPU_METHOD Compu_PWM1_off_loVf " " RAT_FUNC "%.3" "% Vbat" COEFFS 0 655.36 0 0 0 1 /end COMPU_METHOD
/begin CHARACTERISTIC PWM2_off_loVf "FaultConfig # PWM2_off_loVf (Fault Condition:PWM 2 low-side feedback <)" VALUE 0x00164fb4 /* @ECU_Address@PWM2_off_loVf@0x01003710@ */ ECIPP_ALIGNMENT_UWORD 100 Compu_PWM2_off_loVf 0 99.9984741210938 /end CHARACTERISTIC
/begin COMPU_METHOD Compu_PWM2_off_loVf " " RAT_FUNC "%.3" "% Vbat" COEFFS 0 655.36 0 0 0 1 /end COMPU_METHOD
/begin CHARACTERISTIC PWM3_off_loVf "FaultConfig # PWM3_off_loVf (Fault Condition:PWM 3 low-side feedback <)" VALUE 0x00164fbc /* @ECU_Address@PWM3_off_loVf@0x01003718@ */ ECIPP_ALIGNMENT_UWORD 100 Compu_PWM3_off_loVf 0 99.9984741210938 /end CHARACTERISTIC
/begin COMPU_METHOD Compu_PWM3_off_loVf " " RAT_FUNC "%.3" "% Vbat" COEFFS 0 655.36 0 0 0 1 /end COMPU_METHOD
/begin CHARACTERISTIC PWM4_off_loVf "FaultConfig # PWM4_off_loVf (Fault Condition:PWM 4 low-side feedback <)" VALUE 0x00164fc8 /* @ECU_Address@PWM4_off_loVf@0x01003720@ */ ECIPP_ALIGNMENT_UWORD 100 Compu_PWM4_off_loVf 0 99.9984741210938 /end CHARACTERISTIC
/begin COMPU_METHOD Compu_PWM4_off_loVf " " RAT_FUNC "%.3" "% Vbat" COEFFS 0 655.36 0 0 0 1 /end COMPU_METHOD
/begin CHARACTERISTIC PWM5_off_loVf "FaultConfig # PWM5_off_loVf (Fault Condition:PWM 5 low-side feedback <)" VALUE 0x00164fd0 /* @ECU_Address@PWM5_off_loVf@0x01003728@ */ ECIPP_ALIGNMENT_UWORD 100 Compu_PWM5_off_loVf 0 99.9984741210938 /end CHARACTERISTIC
/begin COMPU_METHOD Compu_PWM5_off_loVf " " RAT_FUNC "%.3" "% Vbat" COEFFS 0 655.36 0 0 0 1 /end COMPU_METHOD
/begin CHARACTERISTIC PWM1_on_hiVf "FaultConfig # PWM1_on_hiVf (Fault Condition:PWM 1 low-side feedback >)" VALUE 0x00164f8c /* @ECU_Address@PWM1_on_hiVf@0x01003730@ */ ECIPP_ALIGNMENT_UWORD 100 Compu_PWM1_on_hiVf 0 99.9984741210938 /end CHARACTERISTIC
/begin COMPU_METHOD Compu_PWM1_on_hiVf " " RAT_FUNC "%.3" "% Vbat" COEFFS 0 655.36 0 0 0 1 /end COMPU_METHOD
/begin CHARACTERISTIC PWM2_on_hiVf "FaultConfig # PWM2_on_hiVf (Fault Condition:PWM 2 low-side feedback >)" VALUE 0x00164fb8 /* @ECU_Address@PWM2_on_hiVf@0x01003738@ */ ECIPP_ALIGNMENT_UWORD 100 Compu_PWM2_on_hiVf 0 99.9984741210938 /end CHARACTERISTIC
/begin COMPU_METHOD Compu_PWM2_on_hiVf " " RAT_FUNC "%.3" "% Vbat" COEFFS 0 655.36 0 0 0 1 /end COMPU_METHOD
/begin CHARACTERISTIC PWM3_on_hiVf "FaultConfig # PWM3_on_hiVf (Fault Condition:PWM 3 low-side feedback >)" VALUE 0x00164fc0 /* @ECU_Address@PWM3_on_hiVf@0x01003740@ */ ECIPP_ALIGNMENT_UWORD 100 Compu_PWM3_on_hiVf 0 99.9984741210938 /end CHARACTERISTIC
/begin COMPU_METHOD Compu_PWM3_on_hiVf " " RAT_FUNC "%.3" "% Vbat" COEFFS 0 655.36 0 0 0 1 /end COMPU_METHOD
/begin CHARACTERISTIC PWM4_on_hiVf "FaultConfig # PWM4_on_hiVf (Fault Condition:PWM 4 low-side feedback >)" VALUE 0x00164fcc /* @ECU_Address@PWM4_on_hiVf@0x01003748@ */ ECIPP_ALIGNMENT_UWORD 100 Compu_PWM4_on_hiVf 0 99.9984741210938 /end CHARACTERISTIC
/begin COMPU_METHOD Compu_PWM4_on_hiVf " " RAT_FUNC "%.3" "% Vbat" COEFFS 0 655.36 0 0 0 1 /end COMPU_METHOD
/begin CHARACTERISTIC PWM5_on_hiVf "FaultConfig # PWM5_on_hiVf (Fault Condition:PWM 5 low-side feedback >)" VALUE 0x00164fd4 /* @ECU_Address@PWM5_on_hiVf@0x01003750@ */ ECIPP_ALIGNMENT_UWORD 100 Compu_PWM5_on_hiVf 0 99.9984741210938 /end CHARACTERISTIC
/begin COMPU_METHOD Compu_PWM5_on_hiVf " " RAT_FUNC "%.3" "% Vbat" COEFFS 0 655.36 0 0 0 1 /end COMPU_METHOD
/begin CHARACTERISTIC PWM1_off_loDC "FaultConfig # PWM1_off_loDC (Fault Condition:and PWM duty-cycle <)" VALUE 0x00164f86 /* @ECU_Address@PWM1_off_loDC@0x01003758@ */ ECIPP_ALIGNMENT_UWORD 100 Compu_PWM1_off_loDC 0 99.9984741210938 /end CHARACTERISTIC
/begin COMPU_METHOD Compu_PWM1_off_loDC " " RAT_FUNC "%.3" "%" COEFFS 0 655.36 0 0 0 1 /end COMPU_METHOD
/begin CHARACTERISTIC PWM2_off_loDC "FaultConfig # PWM2_off_loDC (Fault Condition:and PWM duty-cycle <)" VALUE 0x00164fb2 /* @ECU_Address@PWM2_off_loDC@0x01003760@ */ ECIPP_ALIGNMENT_UWORD 100 Compu_PWM2_off_loDC 0 99.9984741210938 /end CHARACTERISTIC
/begin COMPU_METHOD Compu_PWM2_off_loDC " " RAT_FUNC "%.3" "%" COEFFS 0 655.36 0 0 0 1 /end COMPU_METHOD
/begin CHARACTERISTIC PWM3_off_loDC "FaultConfig # PWM3_off_loDC (Fault Condition:and PWM duty-cycle <)" VALUE 0x00164fba /* @ECU_Address@PWM3_off_loDC@0x01003768@ */ ECIPP_ALIGNMENT_UWORD 100 Compu_PWM3_off_loDC 0 99.9984741210938 /end CHARACTERISTIC
/begin COMPU_METHOD Compu_PWM3_off_loDC " " RAT_FUNC "%.3" "%" COEFFS 0 655.36 0 0 0 1 /end COMPU_METHOD
/begin CHARACTERISTIC PWM4_off_loDC "FaultConfig # PWM4_off_loDC (Fault Condition:and PWM duty-cycle <)" VALUE 0x00164fc6 /* @ECU_Address@PWM4_off_loDC@0x01003770@ */ ECIPP_ALIGNMENT_UWORD 100 Compu_PWM4_off_loDC 0 99.9984741210938 /end CHARACTERISTIC
/begin COMPU_METHOD Compu_PWM4_off_loDC " " RAT_FUNC "%.3" "%" COEFFS 0 655.36 0 0 0 1 /end COMPU_METHOD
/begin CHARACTERISTIC PWM5_off_loDC "FaultConfig # PWM5_off_loDC (Fault Condition:and PWM duty-cycle <)" VALUE 0x00164fce /* @ECU_Address@PWM5_off_loDC@0x01003778@ */ ECIPP_ALIGNMENT_UWORD 100 Compu_PWM5_off_loDC 0 99.9984741210938 /end CHARACTERISTIC
/begin COMPU_METHOD Compu_PWM5_off_loDC " " RAT_FUNC "%.3" "%" COEFFS 0 655.36 0 0 0 1 /end COMPU_METHOD
/begin CHARACTERISTIC PWM1_on_hiDC "FaultConfig # PWM1_on_hiDC (Fault Condition:and PWM duty-cycle >)" VALUE 0x00164f8a /* @ECU_Address@PWM1_on_hiDC@0x01003780@ */ ECIPP_ALIGNMENT_UWORD 100 Compu_PWM1_on_hiDC 0 99.9984741210938 /end CHARACTERISTIC
/begin COMPU_METHOD Compu_PWM1_on_hiDC " " RAT_FUNC "%.3" "%" COEFFS 0 655.36 0 0 0 1 /end COMPU_METHOD
/begin CHARACTERISTIC PWM2_on_hiDC "FaultConfig # PWM2_on_hiDC (Fault Condition:and PWM duty-cycle >)" VALUE 0x00164fb6 /* @ECU_Address@PWM2_on_hiDC@0x01003788@ */ ECIPP_ALIGNMENT_UWORD 100 Compu_PWM2_on_hiDC 0 99.9984741210938 /end CHARACTERISTIC
/begin COMPU_METHOD Compu_PWM2_on_hiDC " " RAT_FUNC "%.3" "%" COEFFS 0 655.36 0 0 0 1 /end COMPU_METHOD
/begin CHARACTERISTIC PWM3_on_hiDC "FaultConfig # PWM3_on_hiDC (Fault Condition:and PWM duty-cycle >)" VALUE 0x00164fbe /* @ECU_Address@PWM3_on_hiDC@0x01003790@ */ ECIPP_ALIGNMENT_UWORD 100 Compu_PWM3_on_hiDC 0 99.9984741210938 /end CHARACTERISTIC
/begin COMPU_METHOD Compu_PWM3_on_hiDC " " RAT_FUNC "%.3" "%" COEFFS 0 655.36 0 0 0 1 /end COMPU_METHOD
/begin CHARACTERISTIC PWM4_on_hiDC "FaultConfig # PWM4_on_hiDC (Fault Condition:and PWM duty-cycle >)" VALUE 0x00164fca /* @ECU_Address@PWM4_on_hiDC@0x01003798@ */ ECIPP_ALIGNMENT_UWORD 100 Compu_PWM4_on_hiDC 0 99.9984741210938 /end CHARACTERISTIC
/begin COMPU_METHOD Compu_PWM4_on_hiDC " " RAT_FUNC "%.3" "%" COEFFS 0 655.36 0 0 0 1 /end COMPU_METHOD
/begin CHARACTERISTIC PWM5_on_hiDC "FaultConfig # PWM5_on_hiDC (Fault Condition:and PWM duty-cycle >)" VALUE 0x00164fd2 /* @ECU_Address@PWM5_on_hiDC@0x010037A0@ */ ECIPP_ALIGNMENT_UWORD 100 Compu_PWM5_on_hiDC 0 99.9984741210938 /end CHARACTERISTIC
/begin COMPU_METHOD Compu_PWM5_on_hiDC " " RAT_FUNC "%.3" "%" COEFFS 0 655.36 0 0 0 1 /end COMPU_METHOD
/begin CHARACTERISTIC APU3_max "FaultConfig # APU3_max (Fault Condition:AUX analog PU3 >)" VALUE 0x00163406 /* @ECU_Address@APU3_max@0x01003D38@ */ ECIPP_ALIGNMENT_UWORD 5 Compu_APU3_max 0 5.00114468864469 /end CHARACTERISTIC
/begin COMPU_METHOD Compu_APU3_max " " RAT_FUNC "%.3" "volts" COEFFS 0 13104 0 0 0 1 /end COMPU_METHOD
/begin CHARACTERISTIC APU3_min "FaultConfig # APU3_min (Fault Condition:AUX analog PU3 <)" VALUE 0x00163408 /* @ECU_Address@APU3_min@0x01003D40@ */ ECIPP_ALIGNMENT_UWORD 5 Compu_APU3_min 0 5.00114468864469 /end CHARACTERISTIC
/begin COMPU_METHOD Compu_APU3_min " " RAT_FUNC "%.3" "volts" COEFFS 0 13104 0 0 0 1 /end COMPU_METHOD
/begin CHARACTERISTIC APUD1_max "FaultConfig # APUD1_max (Fault Condition:AUX analog PUD1 >)" VALUE 0x00163432 /* @ECU_Address@APUD1_max@0x01003D48@ */ ECIPP_ALIGNMENT_UWORD 5 Compu_APUD1_max 0 5.00114468864469 /end CHARACTERISTIC
/begin COMPU_METHOD Compu_APUD1_max " " RAT_FUNC "%.3" "volts" COEFFS 0 13104 0 0 0 1 /end COMPU_METHOD
/begin CHARACTERISTIC APUD1_min "FaultConfig # APUD1_min (Fault Condition:AUX analog PUD1 <)" VALUE 0x00163434 /* @ECU_Address@APUD1_min@0x01003D50@ */ ECIPP_ALIGNMENT_UWORD 5 Compu_APUD1_min 0 5.00114468864469 /end CHARACTERISTIC
/begin COMPU_METHOD Compu_APUD1_min " " RAT_FUNC "%.3" "volts" COEFFS 0 13104 0 0 0 1 /end COMPU_METHOD
/begin CHARACTERISTIC APUD2_max "FaultConfig # APUD2_max (Fault Condition:AUX analog PUD2 >)" VALUE 0x0016344e /* @ECU_Address@APUD2_max@0x01003D58@ */ ECIPP_ALIGNMENT_UWORD 5 Compu_APUD2_max 0 5.00114468864469 /end CHARACTERISTIC
/begin COMPU_METHOD Compu_APUD2_max " " RAT_FUNC "%.3" "volts" COEFFS 0 13104 0 0 0 1 /end COMPU_METHOD
/begin CHARACTERISTIC APUD2_min "FaultConfig # APUD2_min (Fault Condition:AUX analog PUD2 <)" VALUE 0x00163450 /* @ECU_Address@APUD2_min@0x01003D60@ */ ECIPP_ALIGNMENT_UWORD 5 Compu_APUD2_min 0 5.00114468864469 /end CHARACTERISTIC
/begin COMPU_METHOD Compu_APUD2_min " " RAT_FUNC "%.3" "volts" COEFFS 0 13104 0 0 0 1 /end COMPU_METHOD
/begin CHARACTERISTIC APUD3_max "FaultConfig # APUD3_max (Fault Condition:AUX analog PUD3 >)" VALUE 0x00163452 /* @ECU_Address@APUD3_max@0x01003D68@ */ ECIPP_ALIGNMENT_UWORD 5 Compu_APUD3_max 0 5.00114468864469 /end CHARACTERISTIC
/begin COMPU_METHOD Compu_APUD3_max " " RAT_FUNC "%.3" "volts" COEFFS 0 13104 0 0 0 1 /end COMPU_METHOD
/begin CHARACTERISTIC APUD3_min "FaultConfig # APUD3_min (Fault Condition:AUX analog PUD3 <)" VALUE 0x00163454 /* @ECU_Address@APUD3_min@0x01003D70@ */ ECIPP_ALIGNMENT_UWORD 5 Compu_APUD3_min 0 5.00114468864469 /end CHARACTERISTIC
/begin COMPU_METHOD Compu_APUD3_min " " RAT_FUNC "%.3" "volts" COEFFS 0 13104 0 0 0 1 /end COMPU_METHOD
/begin CHARACTERISTIC ADIG1_max "FaultConfig # ADIG1_max (Fault Condition:AUX DIG1 >)" VALUE 0x001633b6 /* @ECU_Address@ADIG1_max@0x01003D78@ */ ECIPP_ALIGNMENT_UWORD 256 Compu_ADIG1_max 0 255.99609375 /end CHARACTERISTIC
/begin COMPU_METHOD Compu_ADIG1_max " " RAT_FUNC "%.3" "volts" COEFFS 0 256 0 0 0 1 /end COMPU_METHOD
/begin CHARACTERISTIC ADIG1_min "FaultConfig # ADIG1_min (Fault Condition:AUX DIG1 <)" VALUE 0x001633b8 /* @ECU_Address@ADIG1_min@0x01003D80@ */ ECIPP_ALIGNMENT_UWORD 256 Compu_ADIG1_min 0 255.99609375 /end CHARACTERISTIC
/begin COMPU_METHOD Compu_ADIG1_min " " RAT_FUNC "%.3" "volts" COEFFS 0 256 0 0 0 1 /end COMPU_METHOD
/begin CHARACTERISTIC ADIG2_max "FaultConfig # ADIG2_max (Fault Condition:AUX DIG2 >)" VALUE 0x001633d2 /* @ECU_Address@ADIG2_max@0x01003D88@ */ ECIPP_ALIGNMENT_UWORD 256 Compu_ADIG2_max 0 255.99609375 /end CHARACTERISTIC
/begin COMPU_METHOD Compu_ADIG2_max " " RAT_FUNC "%.3" "volts" COEFFS 0 256 0 0 0 1 /end COMPU_METHOD
/begin CHARACTERISTIC ADIG2_min "FaultConfig # ADIG2_min (Fault Condition:AUX DIG2 <)" VALUE 0x001633d4 /* @ECU_Address@ADIG2_min@0x01003D90@ */ ECIPP_ALIGNMENT_UWORD 256 Compu_ADIG2_min 0 255.99609375 /end CHARACTERISTIC
/begin COMPU_METHOD Compu_ADIG2_min " " RAT_FUNC "%.3" "volts" COEFFS 0 256 0 0 0 1 /end COMPU_METHOD
/begin CHARACTERISTIC ADIG3_min "FaultConfig # ADIG3_min (Fault Condition:AUX DIG3 <)" VALUE 0x001633d8 /* @ECU_Address@ADIG3_min@0x01003DA0@ */ ECIPP_ALIGNMENT_UWORD 256 Compu_ADIG3_min 0 255.99609375 /end CHARACTERISTIC
/begin COMPU_METHOD Compu_ADIG3_min " " RAT_FUNC "%.3" "volts" COEFFS 0 256 0 0 0 1 /end COMPU_METHOD
/begin CHARACTERISTIC FTgasf_maxv "FaultConfig # FTgasf_maxv (Fault Condition:FT voltage >)" VALUE 0x0014740e /* @ECU_Address@FTgasf_maxv@0x01003E28@ */ ECIPP_ALIGNMENT_UWORD 5 Compu_FTgasf_maxv 0 5.00114468864469 /end CHARACTERISTIC
/begin COMPU_METHOD Compu_FTgasf_maxv " " RAT_FUNC "%.3" "volts" COEFFS 0 13104 0 0 0 1 /end COMPU_METHOD
/begin CHARACTERISTIC FTgasf_minv "FaultConfig # FTgasf_minv (Fault Condition:FT voltage <)" VALUE 0x00147414 /* @ECU_Address@FTgasf_minv@0x01003E30@ */ ECIPP_ALIGNMENT_UWORD 5 Compu_FTgasf_minv 0 5.00114468864469 /end CHARACTERISTIC
/begin COMPU_METHOD Compu_FTgasf_minv " " RAT_FUNC "%.3" "volts" COEFFS 0 13104 0 0 0 1 /end COMPU_METHOD
/begin CHARACTERISTIC BstTIP_Lo_RPM "FaultConfig # BstTIP_Lo_RPM (Fault Condition:and RPM >)" VALUE 0x001466cc /* @ECU_Address@BstTIP_Lo_RPM@0x01003E38@ */ ECIPP_ALIGNMENT_UWORD 65535 Compu_BstTIP_Lo_RPM 0 65535 /end CHARACTERISTIC
/begin COMPU_METHOD Compu_BstTIP_Lo_RPM " " RAT_FUNC "%.0" "rpm" COEFFS 0 1 0 0 0 1 /end COMPU_METHOD
/begin CHARACTERISTIC ICam_coil_Rnom "Air # ICam_coil_Rnom" VALUE 0x0014901A /* @ECU_Address@ICam_coil_Rnom@0x01004260@ */ ECIPP_ALIGNMENT_UWORD 64 Compu_ICam_coil_Rnom 0 63.9990234375 /end CHARACTERISTIC
/begin COMPU_METHOD Compu_ICam_coil_Rnom " " RAT_FUNC "%.3" "ohms" COEFFS 0 1024 0 0 0 1 /end COMPU_METHOD
/begin CHARACTERISTIC ICam_coil_Rmin "Air # ICam_coil_Rmin" VALUE 0x00149018 /* @ECU_Address@ICam_coil_Rmin@0x01004268@ */ ECIPP_ALIGNMENT_UWORD 64 Compu_ICam_coil_Rmin 0 63.9990234375 /end CHARACTERISTIC
/begin COMPU_METHOD Compu_ICam_coil_Rmin " " RAT_FUNC "%.3" "ohms" COEFFS 0 1024 0 0 0 1 /end COMPU_METHOD
/begin CHARACTERISTIC ICam_coil_Rmax "Air # ICam_coil_Rmax" VALUE 0x00149016 /* @ECU_Address@ICam_coil_Rmax@0x01004270@ */ ECIPP_ALIGNMENT_UWORD 64 Compu_ICam_coil_Rmax 0 63.9990234375 /end CHARACTERISTIC
/begin COMPU_METHOD Compu_ICam_coil_Rmax " " RAT_FUNC "%.3" "ohms" COEFFS 0 1024 0 0 0 1 /end COMPU_METHOD
/begin CHARACTERISTIC ECam_coil_Rnom "Air # ECam_coil_Rnom" VALUE 0x00148DA6 /* @ECU_Address@ECam_coil_Rnom@0x01004278@ */ ECIPP_ALIGNMENT_UWORD 64 Compu_ECam_coil_Rnom 0 63.9990234375 /end CHARACTERISTIC
/begin COMPU_METHOD Compu_ECam_coil_Rnom " " RAT_FUNC "%.3" "ohms" COEFFS 0 1024 0 0 0 1 /end COMPU_METHOD
/begin CHARACTERISTIC ECam_coil_Rmin "Air # ECam_coil_Rmin" VALUE 0x00148DA4 /* @ECU_Address@ECam_coil_Rmin@0x01004280@ */ ECIPP_ALIGNMENT_UWORD 64 Compu_ECam_coil_Rmin 0 63.9990234375 /end CHARACTERISTIC
/begin COMPU_METHOD Compu_ECam_coil_Rmin " " RAT_FUNC "%.3" "ohms" COEFFS 0 1024 0 0 0 1 /end COMPU_METHOD
/begin CHARACTERISTIC ECam_coil_Rmax "Air # ECam_coil_Rmax" VALUE 0x00148DA2 /* @ECU_Address@ECam_coil_Rmax@0x01004288@ */ ECIPP_ALIGNMENT_UWORD 64 Compu_ECam_coil_Rmax 0 63.9990234375 /end CHARACTERISTIC
/begin COMPU_METHOD Compu_ECam_coil_Rmax " " RAT_FUNC "%.3" "ohms" COEFFS 0 1024 0 0 0 1 /end COMPU_METHOD
/begin CHARACTERISTIC ICam_coil_Imin "Air # ICam_coil_Imin" VALUE 0x0014901E /* @ECU_Address@ICam_coil_Imin@0x01004298@ */ ECIPP_ALIGNMENT_UWORD 64 Compu_ICam_coil_Imin 0 63.9990234375 /end CHARACTERISTIC
/begin COMPU_METHOD Compu_ICam_coil_Imin " " RAT_FUNC "%.3" "amps" COEFFS 0 1024 0 0 0 1 /end COMPU_METHOD
/begin CHARACTERISTIC ICam_coil_Imax "Air # ICam_coil_Imax" VALUE 0x0014901C /* @ECU_Address@ICam_coil_Imax@0x010042A0@ */ ECIPP_ALIGNMENT_UWORD 64 Compu_ICam_coil_Imax 0 63.9990234375 /end CHARACTERISTIC
/begin COMPU_METHOD Compu_ICam_coil_Imax " " RAT_FUNC "%.3" "amps" COEFFS 0 1024 0 0 0 1 /end COMPU_METHOD
/begin CHARACTERISTIC ECam_coil_Imin "Air # ECam_coil_Imin" VALUE 0x00148DAA /* @ECU_Address@ECam_coil_Imin@0x010042B0@ */ ECIPP_ALIGNMENT_UWORD 64 Compu_ECam_coil_Imin 0 63.9990234375 /end CHARACTERISTIC
/begin COMPU_METHOD Compu_ECam_coil_Imin " " RAT_FUNC "%.3" "amps" COEFFS 0 1024 0 0 0 1 /end COMPU_METHOD
/begin CHARACTERISTIC ECam_coil_Imax "Air # ECam_coil_Imax" VALUE 0x00148DA8 /* @ECU_Address@ECam_coil_Imax@0x010042B8@ */ ECIPP_ALIGNMENT_UWORD 64 Compu_ECam_coil_Imax 0 63.9990234375 /end CHARACTERISTIC
/begin COMPU_METHOD Compu_ECam_coil_Imax " " RAT_FUNC "%.3" "amps" COEFFS 0 1024 0 0 0 1 /end COMPU_METHOD
/begin CHARACTERISTIC ICam_coil_Tnom "Air # ICam_coil_Tnom" VALUE 0x00149014 /* @ECU_Address@ICam_coil_Tnom@0x010042F0@ */ ECIPP_ALIGNMENT_UWORD 564 Compu_ICam_coil_Tnom -460 563.984375 /end CHARACTERISTIC
/begin COMPU_METHOD Compu_ICam_coil_Tnom " " RAT_FUNC "%.3" "deg F" COEFFS 0 64 29440 0 0 1 /end COMPU_METHOD
/begin CHARACTERISTIC ECam_coil_Tnom "Air # ECam_coil_Tnom" VALUE 0x00148DA0 /* @ECU_Address@ECam_coil_Tnom@0x010042F8@ */ ECIPP_ALIGNMENT_UWORD 564 Compu_ECam_coil_Tnom -460 563.984375 /end CHARACTERISTIC
/begin COMPU_METHOD Compu_ECam_coil_Tnom " " RAT_FUNC "%.3" "deg F" COEFFS 0 64 29440 0 0 1 /end COMPU_METHOD
/begin CHARACTERISTIC ICam_coil_KTR "Air # ICam_coil_KTR" VALUE 0x00149012 /* @ECU_Address@ICam_coil_KTR@0x01004300@ */ ECIPP_ALIGNMENT_SWORD 0 Compu_ICam_coil_KTR -0.5 0.499984741210938 /end CHARACTERISTIC
/begin COMPU_METHOD Compu_ICam_coil_KTR " " RAT_FUNC "%.3" "ohms/deg F" COEFFS 0 65536 0 0 0 1 /end COMPU_METHOD
/begin CHARACTERISTIC ECam_coil_KTR "Air # ECam_coil_KTR" VALUE 0x00148D9E /* @ECU_Address@ECam_coil_KTR@0x01004308@ */ ECIPP_ALIGNMENT_SWORD 0 Compu_ECam_coil_KTR -0.5 0.499984741210938 /end CHARACTERISTIC
/begin COMPU_METHOD Compu_ECam_coil_KTR " " RAT_FUNC "%.3" "ohms/deg F" COEFFS 0 65536 0 0 0 1 /end COMPU_METHOD
/begin CHARACTERISTIC EGO1wait "CL # EGO1wait" VALUE 0x001440d4 /* @ECU_Address@EGO1wait@0x01004668@ */ ECIPP_ALIGNMENT_ULONG 4294967 Compu_EGO1wait 0 4294967.295 /end CHARACTERISTIC
/begin COMPU_METHOD Compu_EGO1wait " " RAT_FUNC "%.3" "seconds" COEFFS 0 1000 0 0 0 1 /end COMPU_METHOD
/begin CHARACTERISTIC EMWT_maxv "FaultConfig # EMWT_maxv (Fault Condition:EMWT voltage >)" VALUE 0x00148DD2 /* @ECU_Address@EMWT_maxv@0x010048C0@ */ ECIPP_ALIGNMENT_UWORD 5 Compu_EMWT_maxv 0 5.00114468864469 /end CHARACTERISTIC
/begin COMPU_METHOD Compu_EMWT_maxv " " RAT_FUNC "%.3" "volts" COEFFS 0 13104 0 0 0 1 /end COMPU_METHOD
/begin CHARACTERISTIC EMWT_minv "FaultConfig # EMWT_minv (Fault Condition:EMWT voltage <)" VALUE 0x00148DD4 /* @ECU_Address@EMWT_minv@0x010048C8@ */ ECIPP_ALIGNMENT_UWORD 5 Compu_EMWT_minv 0 5.00114468864469 /end CHARACTERISTIC
/begin COMPU_METHOD Compu_EMWT_minv " " RAT_FUNC "%.3" "volts" COEFFS 0 13104 0 0 0 1 /end COMPU_METHOD
/begin CHARACTERISTIC APD2_max "FaultConfig # APD2_max (Fault Condition:AUX analog PD2 >)" VALUE 0x001633f6 /* @ECU_Address@APD2_max@0x01004E38@ */ ECIPP_ALIGNMENT_UWORD 5 Compu_APD2_max 0 5.00114468864469 /end CHARACTERISTIC
/begin COMPU_METHOD Compu_APD2_max " " RAT_FUNC "%.3" "volts" COEFFS 0 13104 0 0 0 1 /end COMPU_METHOD
/begin CHARACTERISTIC APD2_min "FaultConfig # APD2_min (Fault Condition:AUX analog PD2 <)" VALUE 0x001633f8 /* @ECU_Address@APD2_min@0x01004E40@ */ ECIPP_ALIGNMENT_UWORD 5 Compu_APD2_min 0 5.00114468864469 /end CHARACTERISTIC
/begin COMPU_METHOD Compu_APD2_min " " RAT_FUNC "%.3" "volts" COEFFS 0 13104 0 0 0 1 /end COMPU_METHOD
/begin CHARACTERISTIC APD3_max "FaultConfig # APD3_max (Fault Condition:AUX analog PD3 >)" VALUE 0x001633fa /* @ECU_Address@APD3_max@0x01004E48@ */ ECIPP_ALIGNMENT_UWORD 5 Compu_APD3_max 0 5.00114468864469 /end CHARACTERISTIC
/begin COMPU_METHOD Compu_APD3_max " " RAT_FUNC "%.3" "volts" COEFFS 0 13104 0 0 0 1 /end COMPU_METHOD
/begin CHARACTERISTIC APD3_min "FaultConfig # APD3_min (Fault Condition:AUX analog PD3 <)" VALUE 0x001633fc /* @ECU_Address@APD3_min@0x01004E50@ */ ECIPP_ALIGNMENT_UWORD 5 Compu_APD3_min 0 5.00114468864469 /end CHARACTERISTIC
/begin COMPU_METHOD Compu_APD3_min " " RAT_FUNC "%.3" "volts" COEFFS 0 13104 0 0 0 1 /end COMPU_METHOD
/begin CHARACTERISTIC FTP_abs_gage "{FTP_abs_gage&0xff=0:(psia)}{FTP_abs_gage&0xff=1:(psig)}" VALUE 0x00147d8b /* @ECU_Address@FTP_abs_gage@0x01004E70@ */ ECIPP_ALIGNMENT_UBYTE 255 FTP_abs_gage_COMPU_VTAB 0 255 BIT_MASK 0xff /end CHARACTERISTIC
/begin COMPU_METHOD FTP_abs_gage_COMPU_VTAB "Verbal Table" TAB_VERB "%.0" "list" COMPU_TAB_REF FTP_abs_gage_COMPU_VTAB_REF /end COMPU_METHOD
/begin COMPU_VTAB FTP_abs_gage_COMPU_VTAB_REF "Verbal Table" TAB_VERB 2 0 "(psia)" 1 "(psig)" DEFAULT_VALUE "UNKNOWN" /end COMPU_VTAB
/begin CHARACTERISTIC FTP_def "IOConfig # FTP_def" VALUE 0x001473f8 /* @ECU_Address@FTP_def@0x01004E80@ */ ECIPP_ALIGNMENT_UWORD 8192 Compu_FTP_def 0 8191.875 /end CHARACTERISTIC
/begin COMPU_METHOD Compu_FTP_def " " RAT_FUNC "%.3" "psia" COEFFS 0 8 0 0 0 1 /end COMPU_METHOD
/begin MEASUREMENT FPP_EOL_throt "IOConfig # FPP_EOL_throt" UBYTE Compu_FPP_EOL_throt 0 0 0 255 ECU_ADDRESS 0x01004EF8 /end MEASUREMENT
/begin COMPU_METHOD Compu_FPP_EOL_throt " " RAT_FUNC "%.0" "-" COEFFS 0 1 0 0 0 1 /end COMPU_METHOD
/begin CHARACTERISTIC ICam_ref_nom "IOConfig # ICam_ref_nom" VALUE 0x00149034 /* @ECU_Address@ICam_ref_nom@0x01004F10@ */ ECIPP_ALIGNMENT_SWORD 2048 Compu_ICam_ref_nom -2048 2047.9375 /end CHARACTERISTIC
/begin COMPU_METHOD Compu_ICam_ref_nom " " RAT_FUNC "%.3" "CAD BTDC" COEFFS 0 16 0 0 0 1 /end COMPU_METHOD
/begin CHARACTERISTIC ICam_ref_timing "IOConfig # ICam_ref_timing" VALUE 0x00149036 /* @ECU_Address@ICam_ref_timing@0x01004F18@ */ ECIPP_ALIGNMENT_SWORD 2048 Compu_ICam_ref_timing -2048 2047.9375 /end CHARACTERISTIC
/begin COMPU_METHOD Compu_ICam_ref_timing " " RAT_FUNC "%.3" "CAD BTDC" COEFFS 0 16 0 0 0 1 /end COMPU_METHOD
/begin CHARACTERISTIC ECam_ref_nom "IOConfig # ECam_ref_nom" VALUE 0x00148DC0 /* @ECU_Address@ECam_ref_nom@0x01004F20@ */ ECIPP_ALIGNMENT_SWORD 2048 Compu_ECam_ref_nom -2048 2047.9375 /end CHARACTERISTIC
/begin COMPU_METHOD Compu_ECam_ref_nom " " RAT_FUNC "%.3" "CAD BTDC" COEFFS 0 16 0 0 0 1 /end COMPU_METHOD
/begin CHARACTERISTIC ECam_ref_timing "IOConfig # ECam_ref_timing" VALUE 0x00148DC2 /* @ECU_Address@ECam_ref_timing@0x01004F28@ */ ECIPP_ALIGNMENT_SWORD 2048 Compu_ECam_ref_timing -2048 2047.9375 /end CHARACTERISTIC
/begin COMPU_METHOD Compu_ECam_ref_timing " " RAT_FUNC "%.3" "CAD BTDC" COEFFS 0 16 0 0 0 1 /end COMPU_METHOD
/begin CHARACTERISTIC ERWT_maxv "FaultConfig # ERWT_maxv (Fault Condition:ERWT voltage >)" VALUE 0x00148DEA /* @ECU_Address@ERWT_maxv@0x01004FC0@ */ ECIPP_ALIGNMENT_UWORD 5 Compu_ERWT_maxv 0 5.00114468864469 /end CHARACTERISTIC
/begin COMPU_METHOD Compu_ERWT_maxv " " RAT_FUNC "%.3" "volts" COEFFS 0 13104 0 0 0 1 /end COMPU_METHOD
/begin CHARACTERISTIC ERWT_minv "FaultConfig # ERWT_minv (Fault Condition:ERWT voltage <)" VALUE 0x00148DEC /* @ECU_Address@ERWT_minv@0x01004FC8@ */ ECIPP_ALIGNMENT_UWORD 5 Compu_ERWT_minv 0 5.00114468864469 /end CHARACTERISTIC
/begin COMPU_METHOD Compu_ERWT_minv " " RAT_FUNC "%.3" "volts" COEFFS 0 13104 0 0 0 1 /end COMPU_METHOD
/begin MEASUREMENT ICAV_cid_succ "Continuous ID success count" UWORD Compu_ICAV_cid_succ 0 0 0 65535 ECU_ADDRESS 0x010051C8 /end MEASUREMENT
/begin COMPU_METHOD Compu_ICAV_cid_succ " " RAT_FUNC "%.0" "misfires" COEFFS 0 1 0 0 0 1 /end COMPU_METHOD
/begin MEASUREMENT ICAV_cid_fail "Continuous ID fail count" UWORD Compu_ICAV_cid_fail 0 0 0 65535 ECU_ADDRESS 0x010051D0 /end MEASUREMENT
/begin COMPU_METHOD Compu_ICAV_cid_fail " " RAT_FUNC "%.0" "misfires" COEFFS 0 1 0 0 0 1 /end COMPU_METHOD
/begin CHARACTERISTIC ICAVD_mis "FaultConfig # ICAVD_mis (Fault Condition:Identify cylinders misfiring >=)" VALUE 0x00147482 /* @ECU_Address@ICAVD_mis@0x010051D8@ */ ECIPP_ALIGNMENT_UWORD 100 Compu_ICAVD_mis 0 99.9984741210938 /end CHARACTERISTIC
/begin COMPU_METHOD Compu_ICAVD_mis " " RAT_FUNC "%.3" "% max" COEFFS 0 655.36 0 0 0 1 /end COMPU_METHOD
/begin CHARACTERISTIC ICAVD_miscat "FaultConfig # ICAVD_miscat (Fault Condition:Identify cylinders misfiring >=)" VALUE 0x00147484 /* @ECU_Address@ICAVD_miscat@0x010051E0@ */ ECIPP_ALIGNMENT_UWORD 100 Compu_ICAVD_miscat 0 99.9984741210938 /end CHARACTERISTIC
/begin COMPU_METHOD Compu_ICAVD_miscat " " RAT_FUNC "%.3" "% max" COEFFS 0 655.36 0 0 0 1 /end COMPU_METHOD
/begin CHARACTERISTIC J1939_ETC_loss2 "FaultConfig # J1939_ETC_loss2 (Fault Condition:In-Gear Loss of ETC after engine running >=)" VALUE 0x001474ee /* @ECU_Address@J1939_ETC_loss2@0x01005350@ */ ECIPP_ALIGNMENT_UWORD 66 Compu_J1939_ETC_loss2 0 65.535 /end CHARACTERISTIC
/begin COMPU_METHOD Compu_J1939_ETC_loss2 " " RAT_FUNC "%.3" "sec" COEFFS 0 1000 0 0 0 1 /end COMPU_METHOD
/begin MEASUREMENT ICAV_nomis_keyc "Misfire free key cycles" UWORD Compu_ICAV_nomis_keyc 0 0 0 65535 ECU_ADDRESS 0x01005628 /end MEASUREMENT
/begin COMPU_METHOD Compu_ICAV_nomis_keyc " " RAT_FUNC "%.0" "-" COEFFS 0 1 0 0 0 1 /end COMPU_METHOD
/begin MEASUREMENT ICAV_maxcts_nrm "Max norm cts indicator" SWORD Compu_ICAV_maxcts_nrm 0 0 -4 3.9998779296875 ECU_ADDRESS 0x01005920 /end MEASUREMENT
/begin COMPU_METHOD Compu_ICAV_maxcts_nrm " " RAT_FUNC "%.2" "-" COEFFS 0 8192 0 0 0 1 /end COMPU_METHOD
/begin MEASUREMENT ICAV_maxcts_rpm "Max norm cts indicator speed" UWORD Compu_ICAV_maxcts_rpm 0 0 0 65535 ECU_ADDRESS 0x01005928 /end MEASUREMENT
/begin COMPU_METHOD Compu_ICAV_maxcts_rpm " " RAT_FUNC "%.0" "rpm" COEFFS 0 1 0 0 0 1 /end COMPU_METHOD
/begin MEASUREMENT ICAV_maxcts_maL "Max norm cts indicator load" UWORD Compu_ICAV_maxcts_maL 0 0 0 16383.75 ECU_ADDRESS 0x01005930 /end MEASUREMENT
/begin COMPU_METHOD Compu_ICAV_maxcts_maL " " RAT_FUNC "%.0" "mg/Ld" COEFFS 0 4 0 0 0 1 /end COMPU_METHOD
/begin CHARACTERISTIC PWM6_off_loVf "FaultConfig # PWM6_off_loVf (Fault Condition:PWM 6 low-side feedback <)" VALUE 0x00164fd8 /* @ECU_Address@PWM6_off_loVf@0x01005A38@ */ ECIPP_ALIGNMENT_UWORD 100 Compu_PWM6_off_loVf 0 99.9984741210938 /end CHARACTERISTIC
/begin COMPU_METHOD Compu_PWM6_off_loVf " " RAT_FUNC "%.3" "% Vbat" COEFFS 0 655.36 0 0 0 1 /end COMPU_METHOD
/begin CHARACTERISTIC PWM7_off_loVf "FaultConfig # PWM7_off_loVf (Fault Condition:PWM 7 low-side feedback <)" VALUE 0x00164fe4 /* @ECU_Address@PWM7_off_loVf@0x01005A40@ */ ECIPP_ALIGNMENT_UWORD 100 Compu_PWM7_off_loVf 0 99.9984741210938 /end CHARACTERISTIC
/begin COMPU_METHOD Compu_PWM7_off_loVf " " RAT_FUNC "%.3" "% Vbat" COEFFS 0 655.36 0 0 0 1 /end COMPU_METHOD
/begin CHARACTERISTIC PWM6_on_hiVf "FaultConfig # PWM6_on_hiVf (Fault Condition:PWM 6 low-side feedback >)" VALUE 0x00164fdc /* @ECU_Address@PWM6_on_hiVf@0x01005A48@ */ ECIPP_ALIGNMENT_UWORD 100 Compu_PWM6_on_hiVf 0 99.9984741210938 /end CHARACTERISTIC
/begin COMPU_METHOD Compu_PWM6_on_hiVf " " RAT_FUNC "%.3" "% Vbat" COEFFS 0 655.36 0 0 0 1 /end COMPU_METHOD
/begin CHARACTERISTIC PWM7_on_hiVf "FaultConfig # PWM7_on_hiVf (Fault Condition:PWM 7 low-side feedback >)" VALUE 0x00164fe8 /* @ECU_Address@PWM7_on_hiVf@0x01005A50@ */ ECIPP_ALIGNMENT_UWORD 100 Compu_PWM7_on_hiVf 0 99.9984741210938 /end CHARACTERISTIC
/begin COMPU_METHOD Compu_PWM7_on_hiVf " " RAT_FUNC "%.3" "% Vbat" COEFFS 0 655.36 0 0 0 1 /end COMPU_METHOD
/begin CHARACTERISTIC PWM6_off_loDC "FaultConfig # PWM6_off_loDC (Fault Condition:and PWM duty-cycle <)" VALUE 0x00164fd6 /* @ECU_Address@PWM6_off_loDC@0x01005A58@ */ ECIPP_ALIGNMENT_UWORD 100 Compu_PWM6_off_loDC 0 99.9984741210938 /end CHARACTERISTIC
/begin COMPU_METHOD Compu_PWM6_off_loDC " " RAT_FUNC "%.3" "%" COEFFS 0 655.36 0 0 0 1 /end COMPU_METHOD
/begin CHARACTERISTIC PWM7_off_loDC "FaultConfig # PWM7_off_loDC (Fault Condition:and PWM duty-cycle <)" VALUE 0x00164fe2 /* @ECU_Address@PWM7_off_loDC@0x01005A60@ */ ECIPP_ALIGNMENT_UWORD 100 Compu_PWM7_off_loDC 0 99.9984741210938 /end CHARACTERISTIC
/begin COMPU_METHOD Compu_PWM7_off_loDC " " RAT_FUNC "%.3" "%" COEFFS 0 655.36 0 0 0 1 /end COMPU_METHOD
/begin CHARACTERISTIC PWM6_on_hiDC "FaultConfig # PWM6_on_hiDC (Fault Condition:and PWM duty-cycle >)" VALUE 0x00164fda /* @ECU_Address@PWM6_on_hiDC@0x01005A68@ */ ECIPP_ALIGNMENT_UWORD 100 Compu_PWM6_on_hiDC 0 99.9984741210938 /end CHARACTERISTIC
/begin COMPU_METHOD Compu_PWM6_on_hiDC " " RAT_FUNC "%.3" "%" COEFFS 0 655.36 0 0 0 1 /end COMPU_METHOD
/begin CHARACTERISTIC PWM7_on_hiDC "FaultConfig # PWM7_on_hiDC (Fault Condition:and PWM duty-cycle >)" VALUE 0x00164fe6 /* @ECU_Address@PWM7_on_hiDC@0x01005A70@ */ ECIPP_ALIGNMENT_UWORD 100 Compu_PWM7_on_hiDC 0 99.9984741210938 /end CHARACTERISTIC
/begin COMPU_METHOD Compu_PWM7_on_hiDC " " RAT_FUNC "%.3" "%" COEFFS 0 655.36 0 0 0 1 /end COMPU_METHOD
/begin CHARACTERISTIC APUD4_max "FaultConfig # APUD4_max (Fault Condition:AUX analog PUD4 >)" VALUE 0x00163456 /* @ECU_Address@APUD4_max@0x01005AD8@ */ ECIPP_ALIGNMENT_UWORD 5 Compu_APUD4_max 0 5.00114468864469 /end CHARACTERISTIC
/begin COMPU_METHOD Compu_APUD4_max " " RAT_FUNC "%.3" "volts" COEFFS 0 13104 0 0 0 1 /end COMPU_METHOD
/begin CHARACTERISTIC APUD4_min "FaultConfig # APUD4_min (Fault Condition:AUX analog PUD4 <)" VALUE 0x00163458 /* @ECU_Address@APUD4_min@0x01005AE0@ */ ECIPP_ALIGNMENT_UWORD 5 Compu_APUD4_min 0 5.00114468864469 /end CHARACTERISTIC
/begin COMPU_METHOD Compu_APUD4_min " " RAT_FUNC "%.3" "volts" COEFFS 0 13104 0 0 0 1 /end COMPU_METHOD
/begin CHARACTERISTIC ECT_HiExp_wait "FaultConfig # ECT_HiExp_wait (Fault Condition:and run-time >)" VALUE 0x001440c0 /* @ECU_Address@ECT_HiExp_wait@0x01005BA8@ */ ECIPP_ALIGNMENT_ULONG 4294967 Compu_ECT_HiExp_wait 0 4294967.295 /end CHARACTERISTIC
/begin COMPU_METHOD Compu_ECT_HiExp_wait " " RAT_FUNC "%.3" "seconds" COEFFS 0 1000 0 0 0 1 /end COMPU_METHOD
/begin CHARACTERISTIC CHT_HiExp_wait "FaultConfig # CHT_HiExp_wait (Fault Condition:and run-time >)" VALUE 0x001440ac /* @ECU_Address@CHT_HiExp_wait@0x01005BB0@ */ ECIPP_ALIGNMENT_ULONG 4294967 Compu_CHT_HiExp_wait 0 4294967.295 /end CHARACTERISTIC
/begin COMPU_METHOD Compu_CHT_HiExp_wait " " RAT_FUNC "%.3" "seconds" COEFFS 0 1000 0 0 0 1 /end COMPU_METHOD
/begin CHARACTERISTIC FIMP_pct_high "FaultConfig # FIMP_pct_high (Fault Condition:Fuel impurity level >)" VALUE 0x00146862 /* @ECU_Address@FIMP_pct_high@0x01005CB0@ */ ECIPP_ALIGNMENT_UWORD 100 Compu_FIMP_pct_high 0 99.9984741210938 /end CHARACTERISTIC
/begin COMPU_METHOD Compu_FIMP_pct_high " " RAT_FUNC "%.3" "%" COEFFS 0 655.36 0 0 0 1 /end COMPU_METHOD
/begin CHARACTERISTIC PWM8_off_loVf "FaultConfig # PWM8_off_loVf (Fault Condition:PWM 8 low-side feedback <)" VALUE 0x00164fec /* @ECU_Address@PWM8_off_loVf@0x01005CC8@ */ ECIPP_ALIGNMENT_UWORD 100 Compu_PWM8_off_loVf 0 99.9984741210938 /end CHARACTERISTIC
/begin COMPU_METHOD Compu_PWM8_off_loVf " " RAT_FUNC "%.3" "% Vbat" COEFFS 0 655.36 0 0 0 1 /end COMPU_METHOD
/begin CHARACTERISTIC PWM9_off_loVf "FaultConfig # PWM9_off_loVf (Fault Condition:PWM 9 low-side feedback <)" VALUE 0x00164ff4 /* @ECU_Address@PWM9_off_loVf@0x01005CD0@ */ ECIPP_ALIGNMENT_UWORD 100 Compu_PWM9_off_loVf 0 99.9984741210938 /end CHARACTERISTIC
/begin COMPU_METHOD Compu_PWM9_off_loVf " " RAT_FUNC "%.3" "% Vbat" COEFFS 0 655.36 0 0 0 1 /end COMPU_METHOD
/begin CHARACTERISTIC PWM8_on_hiVf "FaultConfig # PWM8_on_hiVf (Fault Condition:PWM 8 low-side feedback >)" VALUE 0x00164ff0 /* @ECU_Address@PWM8_on_hiVf@0x01005CD8@ */ ECIPP_ALIGNMENT_UWORD 100 Compu_PWM8_on_hiVf 0 99.9984741210938 /end CHARACTERISTIC
/begin COMPU_METHOD Compu_PWM8_on_hiVf " " RAT_FUNC "%.3" "% Vbat" COEFFS 0 655.36 0 0 0 1 /end COMPU_METHOD
/begin CHARACTERISTIC PWM9_on_hiVf "FaultConfig # PWM9_on_hiVf (Fault Condition:PWM 9 low-side feedback >)" VALUE 0x00164ff8 /* @ECU_Address@PWM9_on_hiVf@0x01005CE0@ */ ECIPP_ALIGNMENT_UWORD 100 Compu_PWM9_on_hiVf 0 99.9984741210938 /end CHARACTERISTIC
/begin COMPU_METHOD Compu_PWM9_on_hiVf " " RAT_FUNC "%.3" "% Vbat" COEFFS 0 655.36 0 0 0 1 /end COMPU_METHOD
/begin CHARACTERISTIC PWM8_off_loDC "FaultConfig # PWM8_off_loDC (Fault Condition:and PWM duty-cycle <)" VALUE 0x00164fea /* @ECU_Address@PWM8_off_loDC@0x01005CE8@ */ ECIPP_ALIGNMENT_UWORD 100 Compu_PWM8_off_loDC 0 99.9984741210938 /end CHARACTERISTIC
/begin COMPU_METHOD Compu_PWM8_off_loDC " " RAT_FUNC "%.3" "%" COEFFS 0 655.36 0 0 0 1 /end COMPU_METHOD
/begin CHARACTERISTIC PWM9_off_loDC "FaultConfig # PWM9_off_loDC (Fault Condition:and PWM duty-cycle <)" VALUE 0x00164ff2 /* @ECU_Address@PWM9_off_loDC@0x01005CF0@ */ ECIPP_ALIGNMENT_UWORD 100 Compu_PWM9_off_loDC 0 99.9984741210938 /end CHARACTERISTIC
/begin COMPU_METHOD Compu_PWM9_off_loDC " " RAT_FUNC "%.3" "%" COEFFS 0 655.36 0 0 0 1 /end COMPU_METHOD
/begin CHARACTERISTIC PWM8_on_hiDC "FaultConfig # PWM8_on_hiDC (Fault Condition:and PWM duty-cycle >)" VALUE 0x00164fee /* @ECU_Address@PWM8_on_hiDC@0x01005CF8@ */ ECIPP_ALIGNMENT_UWORD 100 Compu_PWM8_on_hiDC 0 99.9984741210938 /end CHARACTERISTIC
/begin COMPU_METHOD Compu_PWM8_on_hiDC " " RAT_FUNC "%.3" "%" COEFFS 0 655.36 0 0 0 1 /end COMPU_METHOD
/begin CHARACTERISTIC PWM9_on_hiDC "FaultConfig # PWM9_on_hiDC (Fault Condition:and PWM duty-cycle >)" VALUE 0x00164ff6 /* @ECU_Address@PWM9_on_hiDC@0x01005D00@ */ ECIPP_ALIGNMENT_UWORD 100 Compu_PWM9_on_hiDC 0 99.9984741210938 /end CHARACTERISTIC
/begin COMPU_METHOD Compu_PWM9_on_hiDC " " RAT_FUNC "%.3" "%" COEFFS 0 655.36 0 0 0 1 /end COMPU_METHOD
/begin CHARACTERISTIC CTM_mdota_max "FaultConfig # CTM_mdota_max (Fault Condition:and mass flow at ports <=)" VALUE 0x0014676a /* @ECU_Address@CTM_mdota_max@0x01005D18@ */ ECIPP_ALIGNMENT_UWORD 1024 Compu_CTM_mdota_max 0 1023.984375 /end CHARACTERISTIC
/begin COMPU_METHOD Compu_CTM_mdota_max " " RAT_FUNC "%.3" "g/sec" COEFFS 0 64 0 0 0 1 /end COMPU_METHOD
/begin CHARACTERISTIC CTM_mdota_min "FaultConfig # CTM_mdota_min (Fault Condition:and mass flow at ports >=)" VALUE 0x0014676c /* @ECU_Address@CTM_mdota_min@0x01005D20@ */ ECIPP_ALIGNMENT_UWORD 1024 Compu_CTM_mdota_min 0 1023.984375 /end CHARACTERISTIC
/begin COMPU_METHOD Compu_CTM_mdota_min " " RAT_FUNC "%.3" "g/sec" COEFFS 0 64 0 0 0 1 /end COMPU_METHOD
/begin CHARACTERISTIC CBT_ss_delta "FaultConfig # CBT_ss_delta (Fault Condition:and CBT - CBT_ss +/-)" VALUE 0x001466f0 /* @ECU_Address@CBT_ss_delta@0x01005D28@ */ ECIPP_ALIGNMENT_UWORD 8192 Compu_CBT_ss_delta 0 8191.875 /end CHARACTERISTIC
/begin COMPU_METHOD Compu_CBT_ss_delta " " RAT_FUNC "%.3" "deg F" COEFFS 0 8 0 0 0 1 /end COMPU_METHOD
/begin CHARACTERISTIC CTM_fltena_wt "FaultConfig # CTM_fltena_wt (Fault Condition:persistently for)" VALUE 0x00146768 /* @ECU_Address@CTM_fltena_wt@0x01005D30@ */ ECIPP_ALIGNMENT_UWORD 66 Compu_CTM_fltena_wt 0 65.535 /end CHARACTERISTIC
/begin COMPU_METHOD Compu_CTM_fltena_wt " " RAT_FUNC "%.3" "sec" COEFFS 0 1000 0 0 0 1 /end COMPU_METHOD
/begin CHARACTERISTIC ICam_maxerr "Air # ICam_maxerr (Fault Condition:Intake cam position error >)" VALUE 0x00149030 /* @ECU_Address@ICam_maxerr@0x01005E88@ */ ECIPP_ALIGNMENT_SWORD 2048 Compu_ICam_maxerr -2048 2047.9375 /end CHARACTERISTIC
/begin COMPU_METHOD Compu_ICam_maxerr " " RAT_FUNC "%.3" "CAD" COEFFS 0 16 0 0 0 1 /end COMPU_METHOD
/begin CHARACTERISTIC ECam_maxerr "Air # ECam_maxerr (Fault Condition:Exhaust cam position error >)" VALUE 0x00148DBC /* @ECU_Address@ECam_maxerr@0x01005E90@ */ ECIPP_ALIGNMENT_SWORD 2048 Compu_ECam_maxerr -2048 2047.9375 /end CHARACTERISTIC
/begin COMPU_METHOD Compu_ECam_maxerr " " RAT_FUNC "%.3" "CAD" COEFFS 0 16 0 0 0 1 /end COMPU_METHOD
/begin CHARACTERISTIC cam_err_rpm "FaultConfig # cam_err_rpm (Fault Condition:and RPM >)" VALUE 0x00147a98 /* @ECU_Address@cam_err_rpm@0x01005E98@ */ ECIPP_ALIGNMENT_UWORD 65535 Compu_cam_err_rpm 0 65535 /end CHARACTERISTIC
/begin COMPU_METHOD Compu_cam_err_rpm " " RAT_FUNC "%.0" "-" COEFFS 0 1 0 0 0 1 /end COMPU_METHOD
/begin CHARACTERISTIC TRIM_lim_bhvG "CL # TRIM_lim_bhvG" VALUE 0x001433DA /* @ECU_Address@TRIM_lim_bhvG@0x01005ED8@ */ ECIPP_ALIGNMENT_UBYTE 255 Compu_TRIM_lim_bhvG 0 255 /end CHARACTERISTIC
/begin COMPU_METHOD Compu_TRIM_lim_bhvG " " RAT_FUNC "%.0" "-" COEFFS 0 1 0 0 0 1 /end COMPU_METHOD
/begin CHARACTERISTIC min_gov_rpm_dummy "Gov # min_gov_rpm_dummy" VALUE 0x00148EB6 /* @ECU_Address@min_gov_rpm_dummy@0x01005EE0@ */ ECIPP_ALIGNMENT_UWORD 65535 Compu_min_gov_rpm_dummy 0 65535 /end CHARACTERISTIC
/begin COMPU_METHOD Compu_min_gov_rpm_dummy " " RAT_FUNC "%.0" "-" COEFFS 0 1 0 0 0 1 /end COMPU_METHOD
/begin CHARACTERISTIC FPP1_learn_wait "IOConfig # FPP1_learn_wait" VALUE 0x00148DFA /* @ECU_Address@FPP1_learn_wait@0x01005EE8@ */ ECIPP_ALIGNMENT_SWORD 32767 Compu_FPP1_learn_wait -32768 32767 /end CHARACTERISTIC
/begin COMPU_METHOD Compu_FPP1_learn_wait " " RAT_FUNC "%.0" "ms" COEFFS 0 1 0 0 0 1 /end COMPU_METHOD
/begin CHARACTERISTIC FPP2_learn_wait "IOConfig # FPP2_learn_wait" VALUE 0x00148E04 /* @ECU_Address@FPP2_learn_wait@0x01005EF0@ */ ECIPP_ALIGNMENT_SWORD 32767 Compu_FPP2_learn_wait -32768 32767 /end CHARACTERISTIC
/begin COMPU_METHOD Compu_FPP2_learn_wait " " RAT_FUNC "%.0" "ms" COEFFS 0 1 0 0 0 1 /end COMPU_METHOD
/begin CHARACTERISTIC TPS1_learn_wait "IOConfig # TPS1_learn_wait" VALUE 0x0016C3E8 /* @ECU_Address@TPS1_learn_wait@0x01005EF8@ */ ECIPP_ALIGNMENT_SWORD 32767 Compu_TPS1_learn_wait -32768 32767 /end CHARACTERISTIC
/begin COMPU_METHOD Compu_TPS1_learn_wait " " RAT_FUNC "%.0" "ms" COEFFS 0 1 0 0 0 1 /end COMPU_METHOD
/begin CHARACTERISTIC TPS2_learn_wait "IOConfig # TPS2_learn_wait" VALUE 0x0016C3F2 /* @ECU_Address@TPS2_learn_wait@0x01005F00@ */ ECIPP_ALIGNMENT_SWORD 32767 Compu_TPS2_learn_wait -32768 32767 /end CHARACTERISTIC
/begin COMPU_METHOD Compu_TPS2_learn_wait " " RAT_FUNC "%.0" "ms" COEFFS 0 1 0 0 0 1 /end COMPU_METHOD
/begin CHARACTERISTIC FPP1_learn_tau "IOConfig # FPP1_learn_tau" VALUE 0x00148DFC /* @ECU_Address@FPP1_learn_tau@0x01005F08@ */ ECIPP_ALIGNMENT_UWORD 327680 Compu_FPP1_learn_tau 0.45084 327680 /end CHARACTERISTIC
/begin COMPU_METHOD Compu_FPP1_learn_tau " " FORM "%.3" "ms"
 /begin FORMULA "-5 / log(1 - (X1 / 65536))" FORMULA_INV "(1 - exp(-5/X1)) * 65536" /end FORMULA
/end COMPU_METHOD
/begin CHARACTERISTIC FPP2_learn_tau "IOConfig # FPP2_learn_tau" VALUE 0x00148E06 /* @ECU_Address@FPP2_learn_tau@0x01005F10@ */ ECIPP_ALIGNMENT_UWORD 327680 Compu_FPP2_learn_tau 0.45084 327680 /end CHARACTERISTIC
/begin COMPU_METHOD Compu_FPP2_learn_tau " " FORM "%.3" "ms"
 /begin FORMULA "-5 / log(1 - (X1 / 65536))" FORMULA_INV "(1 - exp(-5/X1)) * 65536" /end FORMULA
/end COMPU_METHOD
/begin CHARACTERISTIC TPS1_learn_tau "IOConfig # TPS1_learn_tau" VALUE 0x0016C3EA /* @ECU_Address@TPS1_learn_tau@0x01005F18@ */ ECIPP_ALIGNMENT_UWORD 327680 Compu_TPS1_learn_tau 0.45084 327680 /end CHARACTERISTIC
/begin COMPU_METHOD Compu_TPS1_learn_tau " " FORM "%.3" "ms"
 /begin FORMULA "-5 / log(1 - (X1 / 65536))" FORMULA_INV "(1 - exp(-5/X1)) * 65536" /end FORMULA
/end COMPU_METHOD
/begin CHARACTERISTIC TPS2_learn_tau "IOConfig # TPS2_learn_tau" VALUE 0x0016C3F4 /* @ECU_Address@TPS2_learn_tau@0x01005F20@ */ ECIPP_ALIGNMENT_UWORD 327680 Compu_TPS2_learn_tau 0.45084 327680 /end CHARACTERISTIC
/begin COMPU_METHOD Compu_TPS2_learn_tau " " FORM "%.3" "ms"
 /begin FORMULA "-5 / log(1 - (X1 / 65536))" FORMULA_INV "(1 - exp(-5/X1)) * 65536" /end FORMULA
/end COMPU_METHOD
/begin CHARACTERISTIC TPS1_idle_init "IOConfig # TPS1_idle_init" VALUE 0x0016C3EC /* @ECU_Address@TPS1_idle_init@0x01005F28@ */ ECIPP_ALIGNMENT_UWORD 5 Compu_TPS1_idle_init 0 5.00114468864469 /end CHARACTERISTIC
/begin COMPU_METHOD Compu_TPS1_idle_init " " RAT_FUNC "%.3" "volts" COEFFS 0 13104 0 0 0 1 /end COMPU_METHOD
/begin CHARACTERISTIC TPS1_full_init "IOConfig # TPS1_full_init" VALUE 0x0016C3EE /* @ECU_Address@TPS1_full_init@0x01005F30@ */ ECIPP_ALIGNMENT_UWORD 5 Compu_TPS1_full_init 0 5.00114468864469 /end CHARACTERISTIC
/begin COMPU_METHOD Compu_TPS1_full_init " " RAT_FUNC "%.3" "volts" COEFFS 0 13104 0 0 0 1 /end COMPU_METHOD
/begin CHARACTERISTIC TPS1_def "IOConfig # TPS1_def" VALUE 0x0016C3E6 /* @ECU_Address@TPS1_def@0x01005F38@ */ ECIPP_ALIGNMENT_UWORD 5 Compu_TPS1_def 0 5.00114468864469 /end CHARACTERISTIC
/begin COMPU_METHOD Compu_TPS1_def " " RAT_FUNC "%.3" "volts" COEFFS 0 13104 0 0 0 1 /end COMPU_METHOD
/begin CHARACTERISTIC TPS2_idle_init "IOConfig # TPS2_idle_init" VALUE 0x0016C3F6 /* @ECU_Address@TPS2_idle_init@0x01005F40@ */ ECIPP_ALIGNMENT_UWORD 5 Compu_TPS2_idle_init 0 5.00114468864469 /end CHARACTERISTIC
/begin COMPU_METHOD Compu_TPS2_idle_init " " RAT_FUNC "%.3" "volts" COEFFS 0 13104 0 0 0 1 /end COMPU_METHOD
/begin CHARACTERISTIC TPS2_full_init "IOConfig # TPS2_full_init" VALUE 0x0016C3F8 /* @ECU_Address@TPS2_full_init@0x01005F48@ */ ECIPP_ALIGNMENT_UWORD 5 Compu_TPS2_full_init 0 5.00114468864469 /end CHARACTERISTIC
/begin COMPU_METHOD Compu_TPS2_full_init " " RAT_FUNC "%.3" "volts" COEFFS 0 13104 0 0 0 1 /end COMPU_METHOD
/begin CHARACTERISTIC TPS2_def "IOConfig # TPS2_def" VALUE 0x0016C3F0 /* @ECU_Address@TPS2_def@0x01005F50@ */ ECIPP_ALIGNMENT_UWORD 5 Compu_TPS2_def 0 5.00114468864469 /end CHARACTERISTIC
/begin COMPU_METHOD Compu_TPS2_def " " RAT_FUNC "%.3" "volts" COEFFS 0 13104 0 0 0 1 /end COMPU_METHOD
/begin CHARACTERISTIC TPS1_idle_def "IOConfig # TPS1_idle_def" VALUE 0x00148D1C /* @ECU_Address@TPS1_idle_def@0x01005F58@ */ ECIPP_ALIGNMENT_FLOAT32_IEEE 10000000000 Compu_TPS1_idle_def -10000000000 10000000000 /end CHARACTERISTIC
/begin COMPU_METHOD Compu_TPS1_idle_def " " RAT_FUNC "%.3" "volts" COEFFS 0 1 0 0 0 1 /end COMPU_METHOD
/begin CHARACTERISTIC TPS1_full_def "IOConfig # TPS1_full_def" VALUE 0x00148D20 /* @ECU_Address@TPS1_full_def@0x01005F60@ */ ECIPP_ALIGNMENT_FLOAT32_IEEE 10000000000 Compu_TPS1_full_def -10000000000 10000000000 /end CHARACTERISTIC
/begin COMPU_METHOD Compu_TPS1_full_def " " RAT_FUNC "%.3" "volts" COEFFS 0 1 0 0 0 1 /end COMPU_METHOD
/begin CHARACTERISTIC TEM_R "IOConfig # TEM_R" VALUE 0x00148D5C /* @ECU_Address@TEM_R@0x01005F68@ */ ECIPP_ALIGNMENT_FLOAT32_IEEE 10000000000 Compu_TEM_R -10000000000 10000000000 /end CHARACTERISTIC
/begin COMPU_METHOD Compu_TEM_R " " RAT_FUNC "%.3" "ohms" COEFFS 0 1 0 0 0 1 /end COMPU_METHOD
/begin CHARACTERISTIC TEM_L "IOConfig # TEM_L" VALUE 0x00148D60 /* @ECU_Address@TEM_L@0x01005F70@ */ ECIPP_ALIGNMENT_FLOAT32_IEEE 10000000000 Compu_TEM_L -10000000000 10000000000 /end CHARACTERISTIC
/begin COMPU_METHOD Compu_TEM_L " " RAT_FUNC "%.3" "mH" COEFFS 0 1 0 0 0 1 /end COMPU_METHOD
/begin CHARACTERISTIC TEM_Kv "IOConfig # TEM_Kv" VALUE 0x00148D64 /* @ECU_Address@TEM_Kv@0x01005F78@ */ ECIPP_ALIGNMENT_FLOAT32_IEEE 10000000000 Compu_TEM_Kv -10000000000 10000000000 /end CHARACTERISTIC
/begin COMPU_METHOD Compu_TEM_Kv " " RAT_FUNC "%.3" "V / (100% / sec)" COEFFS 0 1 0 0 0 1 /end COMPU_METHOD
/begin CHARACTERISTIC Adapt_start_wait "General # Adapt_start_wait" VALUE 0x00144098 /* @ECU_Address@Adapt_start_wait@0x01005F80@ */ ECIPP_ALIGNMENT_ULONG 4294967 Compu_Adapt_start_wait 0 4294967.295 /end CHARACTERISTIC
/begin COMPU_METHOD Compu_Adapt_start_wait " " RAT_FUNC "%.3" "seconds" COEFFS 0 1000 0 0 0 1 /end COMPU_METHOD
/begin CHARACTERISTIC BP_MAP_H "General # BP_MAP_H" VALUE 0x001466a2 /* @ECU_Address@BP_MAP_H@0x01005F88@ */ ECIPP_ALIGNMENT_UWORD 256 Compu_BP_MAP_H 0 255.99609375 /end CHARACTERISTIC
/begin COMPU_METHOD Compu_BP_MAP_H " " RAT_FUNC "%.3" "psia" COEFFS 0 256 0 0 0 1 /end COMPU_METHOD
/begin CHARACTERISTIC BP_RPM_H "General # BP_RPM_H" VALUE 0x001466a4 /* @ECU_Address@BP_RPM_H@0x01005F90@ */ ECIPP_ALIGNMENT_UWORD 65535 Compu_BP_RPM_H 0 65535 /end CHARACTERISTIC
/begin COMPU_METHOD Compu_BP_RPM_H " " RAT_FUNC "%.0" "rpm" COEFFS 0 1 0 0 0 1 /end COMPU_METHOD
/begin CHARACTERISTIC BP_TPS_L "General # BP_TPS_L" VALUE 0x001466a6 /* @ECU_Address@BP_TPS_L@0x01005F98@ */ ECIPP_ALIGNMENT_UWORD 100 Compu_BP_TPS_L 0 99.9984741210938 /end CHARACTERISTIC
/begin COMPU_METHOD Compu_BP_TPS_L " " RAT_FUNC "%.3" "%" COEFFS 0 655.36 0 0 0 1 /end COMPU_METHOD
/begin CHARACTERISTIC BP_def "General # BP_def" VALUE 0x001466a8 /* @ECU_Address@BP_def@0x01005FA0@ */ ECIPP_ALIGNMENT_UWORD 256 Compu_BP_def 0 255.99609375 /end CHARACTERISTIC
/begin COMPU_METHOD Compu_BP_def " " RAT_FUNC "%.3" "psia" COEFFS 0 256 0 0 0 1 /end COMPU_METHOD
/begin CHARACTERISTIC BP_key_halt "General # BP_key_halt" VALUE 0x001466aa /* @ECU_Address@BP_key_halt@0x01005FA8@ */ ECIPP_ALIGNMENT_UWORD 65535 Compu_BP_key_halt 0 65535 /end CHARACTERISTIC
/begin COMPU_METHOD Compu_BP_key_halt " " RAT_FUNC "%.0" "ms" COEFFS 0 1 0 0 0 1 /end COMPU_METHOD
/begin CHARACTERISTIC BP_key_wait "General # BP_key_wait" VALUE 0x001466ac /* @ECU_Address@BP_key_wait@0x01005FB0@ */ ECIPP_ALIGNMENT_UWORD 65535 Compu_BP_key_wait 0 65535 /end CHARACTERISTIC
/begin COMPU_METHOD Compu_BP_key_wait " " RAT_FUNC "%.0" "ms" COEFFS 0 1 0 0 0 1 /end COMPU_METHOD
/begin CHARACTERISTIC BP_sample_tau "General # BP_sample_tau" VALUE 0x00147bbe /* @ECU_Address@BP_sample_tau@0x01005FB8@ */ ECIPP_ALIGNMENT_UWORD 327680 Compu_BP_sample_tau 0.45084 327680 /end CHARACTERISTIC
/begin COMPU_METHOD Compu_BP_sample_tau " " FORM "%.3" "ms"
 /begin FORMULA "-5 / log(1 - (X1 / 65536))" FORMULA_INV "(1 - exp(-5/X1)) * 65536" /end FORMULA
/end COMPU_METHOD
/begin CHARACTERISTIC BPs "General # BPs" VALUE 0x001466b2 /* @ECU_Address@BPs@0x01005FC0@ */ ECIPP_ALIGNMENT_UWORD 256 Compu_BPs 0 255.99609375 /end CHARACTERISTIC
/begin COMPU_METHOD Compu_BPs " " RAT_FUNC "%.3" "psia" COEFFS 0 256 0 0 0 1 /end COMPU_METHOD
/begin CHARACTERISTIC CHT_ECT_est "{CHT_ECT_est&0xff=0:ECT sensor present / estimate CHT}{CHT_ECT_est&0xff=1:CHT sensor present / estimate ECT}" VALUE 0x00147cf6 /* @ECU_Address@CHT_ECT_est@0x01005FC8@ */ ECIPP_ALIGNMENT_UBYTE 255 CHT_ECT_est_COMPU_VTAB 0 255 BIT_MASK 0xff /end CHARACTERISTIC
/begin COMPU_METHOD CHT_ECT_est_COMPU_VTAB "Verbal Table" TAB_VERB "%.0" "list" COMPU_TAB_REF CHT_ECT_est_COMPU_VTAB_REF /end COMPU_METHOD
/begin COMPU_VTAB CHT_ECT_est_COMPU_VTAB_REF "Verbal Table" TAB_VERB 2 0 "ECT sensor present / estimate CHT" 1 "CHT sensor present / estimate ECT" DEFAULT_VALUE "UNKNOWN" /end COMPU_VTAB
/begin CHARACTERISTIC CHT_def "General # CHT_def" VALUE 0x00146736 /* @ECU_Address@CHT_def@0x01005FD0@ */ ECIPP_ALIGNMENT_UWORD 564 Compu_CHT_def -460 563.984375 /end CHARACTERISTIC
/begin COMPU_METHOD Compu_CHT_def " " RAT_FUNC "%.3" "deg F" COEFFS 0 64 29440 0 0 1 /end COMPU_METHOD
/begin CHARACTERISTIC CHT_s "General # CHT_s" VALUE 0x00146738 /* @ECU_Address@CHT_s@0x01005FD8@ */ ECIPP_ALIGNMENT_UWORD 564 Compu_CHT_s -460 563.984375 /end CHARACTERISTIC
/begin COMPU_METHOD Compu_CHT_s " " RAT_FUNC "%.3" "deg F" COEFFS 0 64 29440 0 0 1 /end COMPU_METHOD
/begin CHARACTERISTIC CL_start_wait "General # CL_start_wait" VALUE 0x001440b0 /* @ECU_Address@CL_start_wait@0x01005FE8@ */ ECIPP_ALIGNMENT_ULONG 4294967 Compu_CL_start_wait 0 4294967.295 /end CHARACTERISTIC
/begin COMPU_METHOD Compu_CL_start_wait " " RAT_FUNC "%.3" "seconds" COEFFS 0 1000 0 0 0 1 /end COMPU_METHOD
/begin CHARACTERISTIC CLp_tau_def "General # CLp_tau_def" VALUE 0x0014675e /* @ECU_Address@CLp_tau_def@0x01005FF0@ */ ECIPP_ALIGNMENT_UWORD 65535 Compu_CLp_tau_def 0 65535 /end CHARACTERISTIC
/begin COMPU_METHOD Compu_CLp_tau_def " " RAT_FUNC "%.0" "ms" COEFFS 0 1 0 0 0 1 /end COMPU_METHOD
/begin CHARACTERISTIC Crank_rpm "General # Crank_rpm" VALUE 0x00146782 /* @ECU_Address@Crank_rpm@0x01005FF8@ */ ECIPP_ALIGNMENT_UWORD 65535 Compu_Crank_rpm 0 65535 /end CHARACTERISTIC
/begin COMPU_METHOD Compu_Crank_rpm " " RAT_FUNC "%.0" "rpm" COEFFS 0 1 0 0 0 1 /end COMPU_METHOD
/begin CHARACTERISTIC EBP_def "General # EBP_def" VALUE 0x0014678c /* @ECU_Address@EBP_def@0x01006000@ */ ECIPP_ALIGNMENT_UWORD 256 Compu_EBP_def 0 255.99609375 /end CHARACTERISTIC
/begin COMPU_METHOD Compu_EBP_def " " RAT_FUNC "%.3" "psia" COEFFS 0 256 0 0 0 1 /end COMPU_METHOD
/begin CHARACTERISTIC EBPs "General # EBPs" VALUE 0x00146790 /* @ECU_Address@EBPs@0x01006008@ */ ECIPP_ALIGNMENT_UWORD 256 Compu_EBPs 0 255.99609375 /end CHARACTERISTIC
/begin COMPU_METHOD Compu_EBPs " " RAT_FUNC "%.3" "psia" COEFFS 0 256 0 0 0 1 /end COMPU_METHOD
/begin CHARACTERISTIC ECT_adapt "General # ECT_adapt" VALUE 0x001467b4 /* @ECU_Address@ECT_adapt@0x01006018@ */ ECIPP_ALIGNMENT_UWORD 564 Compu_ECT_adapt -460 563.984375 /end CHARACTERISTIC
/begin COMPU_METHOD Compu_ECT_adapt " " RAT_FUNC "%.3" "deg F" COEFFS 0 64 29440 0 0 1 /end COMPU_METHOD
/begin CHARACTERISTIC ECT_def "General # ECT_def" VALUE 0x001467b6 /* @ECU_Address@ECT_def@0x01006020@ */ ECIPP_ALIGNMENT_UWORD 564 Compu_ECT_def -460 563.984375 /end CHARACTERISTIC
/begin COMPU_METHOD Compu_ECT_def " " RAT_FUNC "%.3" "deg F" COEFFS 0 64 29440 0 0 1 /end COMPU_METHOD
/begin CHARACTERISTIC ECTs "General # ECTs" VALUE 0x001467ce /* @ECU_Address@ECTs@0x01006028@ */ ECIPP_ALIGNMENT_UWORD 564 Compu_ECTs -460 563.984375 /end CHARACTERISTIC
/begin COMPU_METHOD Compu_ECTs " " RAT_FUNC "%.3" "deg F" COEFFS 0 64 29440 0 0 1 /end COMPU_METHOD
/begin CHARACTERISTIC EGO1Tcold "General # EGO1Tcold" VALUE 0x00143c84 /* @ECU_Address@EGO1Tcold@0x01006030@ */ ECIPP_ALIGNMENT_SLONG 2147483647 Compu_EGO1Tcold -2147483648 2147483647 /end CHARACTERISTIC
/begin COMPU_METHOD Compu_EGO1Tcold " " RAT_FUNC "%.0" "ms" COEFFS 0 1 0 0 0 1 /end COMPU_METHOD
/begin CHARACTERISTIC EGO1Thot "General # EGO1Thot" VALUE 0x00143c88 /* @ECU_Address@EGO1Thot@0x01006038@ */ ECIPP_ALIGNMENT_SLONG 2147483647 Compu_EGO1Thot -2147483648 2147483647 /end CHARACTERISTIC
/begin COMPU_METHOD Compu_EGO1Thot " " RAT_FUNC "%.0" "ms" COEFFS 0 1 0 0 0 1 /end COMPU_METHOD
/begin CHARACTERISTIC EGO1sw "General # EGO1sw" VALUE 0x001467e2 /* @ECU_Address@EGO1sw@0x01006040@ */ ECIPP_ALIGNMENT_UWORD 16 Compu_EGO1sw 0 15.999755859375 /end CHARACTERISTIC
/begin COMPU_METHOD Compu_EGO1sw " " RAT_FUNC "%.3" "volts" COEFFS 0 4096 0 0 0 1 /end COMPU_METHOD
/begin CHARACTERISTIC EGT_def "General # EGT_def" VALUE 0x00146812 /* @ECU_Address@EGT_def@0x01006048@ */ ECIPP_ALIGNMENT_UWORD 7732 Compu_EGT_def -460 7731.875 /end CHARACTERISTIC
/begin COMPU_METHOD Compu_EGT_def " " RAT_FUNC "%.3" "deg F" COEFFS 0 8 3680 0 0 1 /end COMPU_METHOD
/begin CHARACTERISTIC EGTs "General # EGTs" VALUE 0x00146816 /* @ECU_Address@EGTs@0x01006050@ */ ECIPP_ALIGNMENT_UWORD 7732 Compu_EGTs -460 7731.875 /end CHARACTERISTIC
/begin COMPU_METHOD Compu_EGTs " " RAT_FUNC "%.3" "deg F" COEFFS 0 8 3680 0 0 1 /end COMPU_METHOD
/begin CHARACTERISTIC ETHC_channel "{ETHC_channel&0xff=0:Aux PWM1}{ETHC_channel&0xff=1:Aux PWM2}" VALUE 0x00147d40 /* @ECU_Address@ETHC_channel@0x01006058@ */ ECIPP_ALIGNMENT_UBYTE 255 ETHC_channel_COMPU_VTAB 0 255 BIT_MASK 0xff /end CHARACTERISTIC
/begin COMPU_METHOD ETHC_channel_COMPU_VTAB "Verbal Table" TAB_VERB "%.0" "list" COMPU_TAB_REF ETHC_channel_COMPU_VTAB_REF /end COMPU_METHOD
/begin COMPU_VTAB ETHC_channel_COMPU_VTAB_REF "Verbal Table" TAB_VERB 2 0 "Aux PWM1" 1 "Aux PWM2" DEFAULT_VALUE "UNKNOWN" /end COMPU_VTAB
/begin CHARACTERISTIC EvsECTCF_ena "{EvsECTCF_ena&0xff=0:Off}{EvsECTCF_ena&0xff=1:On}" VALUE 0x00147d45 /* @ECU_Address@EvsECTCF_ena@0x01006060@ */ ECIPP_ALIGNMENT_UBYTE 255 EvsECTCF_ena_COMPU_VTAB 0 255 BIT_MASK 0xff /end CHARACTERISTIC
/begin COMPU_METHOD EvsECTCF_ena_COMPU_VTAB "Verbal Table" TAB_VERB "%.0" "list" COMPU_TAB_REF EvsECTCF_ena_COMPU_VTAB_REF /end COMPU_METHOD
/begin COMPU_VTAB EvsECTCF_ena_COMPU_VTAB_REF "Verbal Table" TAB_VERB 2 0 "Off" 1 "On" DEFAULT_VALUE "UNKNOWN" /end COMPU_VTAB
/begin CHARACTERISTIC EvsMATCF_ena "{EvsMATCF_ena&0xff=0:Off}{EvsMATCF_ena&0xff=1:On}" VALUE 0x00147d46 /* @ECU_Address@EvsMATCF_ena@0x01006068@ */ ECIPP_ALIGNMENT_UBYTE 255 EvsMATCF_ena_COMPU_VTAB 0 255 BIT_MASK 0xff /end CHARACTERISTIC
/begin COMPU_METHOD EvsMATCF_ena_COMPU_VTAB "Verbal Table" TAB_VERB "%.0" "list" COMPU_TAB_REF EvsMATCF_ena_COMPU_VTAB_REF /end COMPU_METHOD
/begin COMPU_VTAB EvsMATCF_ena_COMPU_VTAB_REF "Verbal Table" TAB_VERB 2 0 "Off" 1 "On" DEFAULT_VALUE "UNKNOWN" /end COMPU_VTAB
/begin CHARACTERISTIC FPout_loc "{FPout_loc&0xff=0:MAP}{FPout_loc&0xff=1:TIP}" VALUE 0x00149067 /* @ECU_Address@FPout_loc@0x01006070@ */ ECIPP_ALIGNMENT_UBYTE 255 FPout_loc_COMPU_VTAB 0 255 BIT_MASK 0xff /end CHARACTERISTIC
/begin COMPU_METHOD FPout_loc_COMPU_VTAB "Verbal Table" TAB_VERB "%.0" "list" COMPU_TAB_REF FPout_loc_COMPU_VTAB_REF /end COMPU_METHOD
/begin COMPU_VTAB FPout_loc_COMPU_VTAB_REF "Verbal Table" TAB_VERB 2 0 "MAP" 1 "TIP" DEFAULT_VALUE "UNKNOWN" /end COMPU_VTAB
/begin CHARACTERISTIC FT_MAPsw "General # FT_MAPsw" VALUE 0x001473fe /* @ECU_Address@FT_MAPsw@0x01006078@ */ ECIPP_ALIGNMENT_UWORD 256 Compu_FT_MAPsw 0 255.99609375 /end CHARACTERISTIC
/begin COMPU_METHOD Compu_FT_MAPsw " " RAT_FUNC "%.3" "psia" COEFFS 0 256 0 0 0 1 /end COMPU_METHOD
/begin CHARACTERISTIC FT_RPMsw "General # FT_RPMsw" VALUE 0x00147400 /* @ECU_Address@FT_RPMsw@0x01006080@ */ ECIPP_ALIGNMENT_UWORD 65535 Compu_FT_RPMsw 0 65535 /end CHARACTERISTIC
/begin COMPU_METHOD Compu_FT_RPMsw " " RAT_FUNC "%.0" "rpm" COEFFS 0 1 0 0 0 1 /end COMPU_METHOD
/begin CHARACTERISTIC FT_sw_mode "{FT_sw_mode&0xff=0:Normal}{FT_sw_mode&0xff=1:Stopped Engine}" VALUE 0x00147d94 /* @ECU_Address@FT_sw_mode@0x01006088@ */ ECIPP_ALIGNMENT_UBYTE 255 FT_sw_mode_COMPU_VTAB 0 255 BIT_MASK 0xff /end CHARACTERISTIC
/begin COMPU_METHOD FT_sw_mode_COMPU_VTAB "Verbal Table" TAB_VERB "%.0" "list" COMPU_TAB_REF FT_sw_mode_COMPU_VTAB_REF /end COMPU_METHOD
/begin COMPU_VTAB FT_sw_mode_COMPU_VTAB_REF "Verbal Table" TAB_VERB 2 0 "Normal" 1 "Stopped Engine" DEFAULT_VALUE "UNKNOWN" /end COMPU_VTAB
/begin CHARACTERISTIC Gov_sw_debounce "General # Gov_sw_debounce" VALUE 0x00147440 /* @ECU_Address@Gov_sw_debounce@0x010060A0@ */ ECIPP_ALIGNMENT_UWORD 65535 Compu_Gov_sw_debounce 0 65535 /end CHARACTERISTIC
/begin COMPU_METHOD Compu_Gov_sw_debounce " " RAT_FUNC "%.0" "ms" COEFFS 0 1 0 0 0 1 /end COMPU_METHOD
/begin CHARACTERISTIC IAT_def "General # IAT_def" VALUE 0x00147474 /* @ECU_Address@IAT_def@0x010060A8@ */ ECIPP_ALIGNMENT_UWORD 564 Compu_IAT_def -460 563.984375 /end CHARACTERISTIC
/begin COMPU_METHOD Compu_IAT_def " " RAT_FUNC "%.3" "deg F" COEFFS 0 64 29440 0 0 1 /end COMPU_METHOD
/begin CHARACTERISTIC Inj1_bank "{Inj1_bank&0xff=0:Disabled}{Inj1_bank&0xff=1:Bank 1}{Inj1_bank&0xff=2:Bank 2}" VALUE 0x00148194 /* @ECU_Address@Inj1_bank@0x010060B0@ */ ECIPP_ALIGNMENT_UBYTE 255 Inj1_bank_COMPU_VTAB 0 255 BIT_MASK 0xff /end CHARACTERISTIC
/begin COMPU_METHOD Inj1_bank_COMPU_VTAB "Verbal Table" TAB_VERB "%.0" "list" COMPU_TAB_REF Inj1_bank_COMPU_VTAB_REF /end COMPU_METHOD
/begin COMPU_VTAB Inj1_bank_COMPU_VTAB_REF "Verbal Table" TAB_VERB 3 0 "Disabled" 1 "Bank 1" 2 "Bank 2" DEFAULT_VALUE "UNKNOWN" /end COMPU_VTAB
/begin CHARACTERISTIC Inj2_bank "{Inj2_bank&0xff=0:Disabled}{Inj2_bank&0xff=1:Bank 1}{Inj2_bank&0xff=2:Bank 2}" VALUE 0x00148195 /* @ECU_Address@Inj2_bank@0x010060B8@ */ ECIPP_ALIGNMENT_UBYTE 255 Inj2_bank_COMPU_VTAB 0 255 BIT_MASK 0xff /end CHARACTERISTIC
/begin COMPU_METHOD Inj2_bank_COMPU_VTAB "Verbal Table" TAB_VERB "%.0" "list" COMPU_TAB_REF Inj2_bank_COMPU_VTAB_REF /end COMPU_METHOD
/begin COMPU_VTAB Inj2_bank_COMPU_VTAB_REF "Verbal Table" TAB_VERB 3 0 "Disabled" 1 "Bank 1" 2 "Bank 2" DEFAULT_VALUE "UNKNOWN" /end COMPU_VTAB
/begin CHARACTERISTIC Inj3_bank "{Inj3_bank&0xff=0:Disabled}{Inj3_bank&0xff=1:Bank 1}{Inj3_bank&0xff=2:Bank 2}" VALUE 0x00148196 /* @ECU_Address@Inj3_bank@0x010060C0@ */ ECIPP_ALIGNMENT_UBYTE 255 Inj3_bank_COMPU_VTAB 0 255 BIT_MASK 0xff /end CHARACTERISTIC
/begin COMPU_METHOD Inj3_bank_COMPU_VTAB "Verbal Table" TAB_VERB "%.0" "list" COMPU_TAB_REF Inj3_bank_COMPU_VTAB_REF /end COMPU_METHOD
/begin COMPU_VTAB Inj3_bank_COMPU_VTAB_REF "Verbal Table" TAB_VERB 3 0 "Disabled" 1 "Bank 1" 2 "Bank 2" DEFAULT_VALUE "UNKNOWN" /end COMPU_VTAB
/begin CHARACTERISTIC Inj4_bank "{Inj4_bank&0xff=0:Disabled}{Inj4_bank&0xff=1:Bank 1}{Inj4_bank&0xff=2:Bank 2}" VALUE 0x00148197 /* @ECU_Address@Inj4_bank@0x010060C8@ */ ECIPP_ALIGNMENT_UBYTE 255 Inj4_bank_COMPU_VTAB 0 255 BIT_MASK 0xff /end CHARACTERISTIC
/begin COMPU_METHOD Inj4_bank_COMPU_VTAB "Verbal Table" TAB_VERB "%.0" "list" COMPU_TAB_REF Inj4_bank_COMPU_VTAB_REF /end COMPU_METHOD
/begin COMPU_VTAB Inj4_bank_COMPU_VTAB_REF "Verbal Table" TAB_VERB 3 0 "Disabled" 1 "Bank 1" 2 "Bank 2" DEFAULT_VALUE "UNKNOWN" /end COMPU_VTAB
/begin CHARACTERISTIC Inj5_bank "{Inj5_bank&0xff=0:Disabled}{Inj5_bank&0xff=1:Bank 1}{Inj5_bank&0xff=2:Bank 2}" VALUE 0x00148198 /* @ECU_Address@Inj5_bank@0x010060D0@ */ ECIPP_ALIGNMENT_UBYTE 255 Inj5_bank_COMPU_VTAB 0 255 BIT_MASK 0xff /end CHARACTERISTIC
/begin COMPU_METHOD Inj5_bank_COMPU_VTAB "Verbal Table" TAB_VERB "%.0" "list" COMPU_TAB_REF Inj5_bank_COMPU_VTAB_REF /end COMPU_METHOD
/begin COMPU_VTAB Inj5_bank_COMPU_VTAB_REF "Verbal Table" TAB_VERB 3 0 "Disabled" 1 "Bank 1" 2 "Bank 2" DEFAULT_VALUE "UNKNOWN" /end COMPU_VTAB
/begin CHARACTERISTIC Inj6_bank "{Inj6_bank&0xff=0:Disabled}{Inj6_bank&0xff=1:Bank 1}{Inj6_bank&0xff=2:Bank 2}" VALUE 0x00148199 /* @ECU_Address@Inj6_bank@0x010060D8@ */ ECIPP_ALIGNMENT_UBYTE 255 Inj6_bank_COMPU_VTAB 0 255 BIT_MASK 0xff /end CHARACTERISTIC
/begin COMPU_METHOD Inj6_bank_COMPU_VTAB "Verbal Table" TAB_VERB "%.0" "list" COMPU_TAB_REF Inj6_bank_COMPU_VTAB_REF /end COMPU_METHOD
/begin COMPU_VTAB Inj6_bank_COMPU_VTAB_REF "Verbal Table" TAB_VERB 3 0 "Disabled" 1 "Bank 1" 2 "Bank 2" DEFAULT_VALUE "UNKNOWN" /end COMPU_VTAB
/begin CHARACTERISTIC Inj7_bank "{Inj7_bank&0xff=0:Disabled}{Inj7_bank&0xff=1:Bank 1}{Inj7_bank&0xff=2:Bank 2}" VALUE 0x0014819A /* @ECU_Address@Inj7_bank@0x010060E0@ */ ECIPP_ALIGNMENT_UBYTE 255 Inj7_bank_COMPU_VTAB 0 255 BIT_MASK 0xff /end CHARACTERISTIC
/begin COMPU_METHOD Inj7_bank_COMPU_VTAB "Verbal Table" TAB_VERB "%.0" "list" COMPU_TAB_REF Inj7_bank_COMPU_VTAB_REF /end COMPU_METHOD
/begin COMPU_VTAB Inj7_bank_COMPU_VTAB_REF "Verbal Table" TAB_VERB 3 0 "Disabled" 1 "Bank 1" 2 "Bank 2" DEFAULT_VALUE "UNKNOWN" /end COMPU_VTAB
/begin CHARACTERISTIC Inj8_bank "{Inj8_bank&0xff=0:Disabled}{Inj8_bank&0xff=1:Bank 1}{Inj8_bank&0xff=2:Bank 2}" VALUE 0x0014819B /* @ECU_Address@Inj8_bank@0x010060E8@ */ ECIPP_ALIGNMENT_UBYTE 255 Inj8_bank_COMPU_VTAB 0 255 BIT_MASK 0xff /end CHARACTERISTIC
/begin COMPU_METHOD Inj8_bank_COMPU_VTAB "Verbal Table" TAB_VERB "%.0" "list" COMPU_TAB_REF Inj8_bank_COMPU_VTAB_REF /end COMPU_METHOD
/begin COMPU_VTAB Inj8_bank_COMPU_VTAB_REF "Verbal Table" TAB_VERB 3 0 "Disabled" 1 "Bank 1" 2 "Bank 2" DEFAULT_VALUE "UNKNOWN" /end COMPU_VTAB
/begin CHARACTERISTIC Inj9_bank "{Inj9_bank&0xff=0:Disabled}{Inj9_bank&0xff=1:Bank 1}{Inj9_bank&0xff=2:Bank 2}" VALUE 0x0014819C /* @ECU_Address@Inj9_bank@0x010060F0@ */ ECIPP_ALIGNMENT_UBYTE 255 Inj9_bank_COMPU_VTAB 0 255 BIT_MASK 0xff /end CHARACTERISTIC
/begin COMPU_METHOD Inj9_bank_COMPU_VTAB "Verbal Table" TAB_VERB "%.0" "list" COMPU_TAB_REF Inj9_bank_COMPU_VTAB_REF /end COMPU_METHOD
/begin COMPU_VTAB Inj9_bank_COMPU_VTAB_REF "Verbal Table" TAB_VERB 3 0 "Disabled" 1 "Bank 1" 2 "Bank 2" DEFAULT_VALUE "UNKNOWN" /end COMPU_VTAB
/begin CHARACTERISTIC Inj10_bank "{Inj10_bank&0xff=0:Disabled}{Inj10_bank&0xff=1:Bank 1}{Inj10_bank&0xff=2:Bank 2}" VALUE 0x0014819D /* @ECU_Address@Inj10_bank@0x010060F8@ */ ECIPP_ALIGNMENT_UBYTE 255 Inj10_bank_COMPU_VTAB 0 255 BIT_MASK 0xff /end CHARACTERISTIC
/begin COMPU_METHOD Inj10_bank_COMPU_VTAB "Verbal Table" TAB_VERB "%.0" "list" COMPU_TAB_REF Inj10_bank_COMPU_VTAB_REF /end COMPU_METHOD
/begin COMPU_VTAB Inj10_bank_COMPU_VTAB_REF "Verbal Table" TAB_VERB 3 0 "Disabled" 1 "Bank 1" 2 "Bank 2" DEFAULT_VALUE "UNKNOWN" /end COMPU_VTAB
/begin CHARACTERISTIC Ipark_Ilim "General # Ipark_Ilim" VALUE 0x00148D6E /* @ECU_Address@Ipark_Ilim@0x01006100@ */ ECIPP_ALIGNMENT_UWORD 64 Compu_Ipark_Ilim 0 63.9990234375 /end CHARACTERISTIC
/begin COMPU_METHOD Compu_Ipark_Ilim " " RAT_FUNC "%.3" "amps" COEFFS 0 1024 0 0 0 1 /end COMPU_METHOD
/begin CHARACTERISTIC Ipark_Ki "General # Ipark_Ki" VALUE 0x00148D7A /* @ECU_Address@Ipark_Ki@0x01006108@ */ ECIPP_ALIGNMENT_UWORD 3125 Compu_Ipark_Ki 0 3124.95231628418 /end CHARACTERISTIC
/begin COMPU_METHOD Compu_Ipark_Ki " " RAT_FUNC "%.3" "% / amp / sec" COEFFS 0 20.97152 0 0 0 1 /end COMPU_METHOD
/begin CHARACTERISTIC Ipark_dly "General # Ipark_dly" VALUE 0x00148D78 /* @ECU_Address@Ipark_dly@0x01006110@ */ ECIPP_ALIGNMENT_UWORD 66 Compu_Ipark_dly 0 65.535 /end CHARACTERISTIC
/begin COMPU_METHOD Compu_Ipark_dly " " RAT_FUNC "%.3" "seconds" COEFFS 0 1000 0 0 0 1 /end COMPU_METHOD
/begin CHARACTERISTIC Ipark_ena "{Ipark_ena&0xff=0:Disabled}{Ipark_ena&0xff=1:Single-Point}{Ipark_ena&0xff=2:1-D Table-Based}" VALUE 0x00148D6C /* @ECU_Address@Ipark_ena@0x01006118@ */ ECIPP_ALIGNMENT_UBYTE 255 Ipark_ena_COMPU_VTAB 0 255 BIT_MASK 0xff /end CHARACTERISTIC
/begin COMPU_METHOD Ipark_ena_COMPU_VTAB "Verbal Table" TAB_VERB "%.0" "list" COMPU_TAB_REF Ipark_ena_COMPU_VTAB_REF /end COMPU_METHOD
/begin COMPU_VTAB Ipark_ena_COMPU_VTAB_REF "Verbal Table" TAB_VERB 3 0 "Disabled" 1 "Single-Point" 2 "1-D Table-Based" DEFAULT_VALUE "UNKNOWN" /end COMPU_VTAB
/begin CHARACTERISTIC Ipark_max_att "General # Ipark_max_att" VALUE 0x00148D7C /* @ECU_Address@Ipark_max_att@0x01006120@ */ ECIPP_ALIGNMENT_SWORD 100 Compu_Ipark_max_att -100 99.9969482421875 /end CHARACTERISTIC
/begin COMPU_METHOD Compu_Ipark_max_att " " RAT_FUNC "%.3" "% decrease" COEFFS 0 327.68 0 0 0 1 /end COMPU_METHOD
/begin CHARACTERISTIC KNKF_retard "General # KNKF_retard" VALUE 0x001438ca /* @ECU_Address@KNKF_retard@0x01006128@ */ ECIPP_ALIGNMENT_UWORD 128 Compu_KNKF_retard 0 127.998046875 /end CHARACTERISTIC
/begin COMPU_METHOD Compu_KNKF_retard " " RAT_FUNC "%.3" "CAD retard" COEFFS 0 512 0 0 0 1 /end COMPU_METHOD
/begin CHARACTERISTIC LP_EGO "General # LP_EGO" VALUE 0x00147bfe /* @ECU_Address@LP_EGO@0x01006130@ */ ECIPP_ALIGNMENT_UWORD 327680 Compu_LP_EGO 0.45084 327680 /end CHARACTERISTIC
/begin COMPU_METHOD Compu_LP_EGO " " FORM "%.3" "ms"
 /begin FORMULA "-5 / log(1 - (X1 / 65536))" FORMULA_INV "(1 - exp(-5/X1)) * 65536" /end FORMULA
/end COMPU_METHOD
/begin CHARACTERISTIC LP_fast "General # LP_fast" VALUE 0x00147c00 /* @ECU_Address@LP_fast@0x01006138@ */ ECIPP_ALIGNMENT_UWORD 327680 Compu_LP_fast 0.45084 327680 /end CHARACTERISTIC
/begin COMPU_METHOD Compu_LP_fast " " FORM "%.3" "ms"
 /begin FORMULA "-5 / log(1 - (X1 / 65536))" FORMULA_INV "(1 - exp(-5/X1)) * 65536" /end FORMULA
/end COMPU_METHOD
/begin CHARACTERISTIC LP_nominal "General # LP_nominal" VALUE 0x00147c02 /* @ECU_Address@LP_nominal@0x01006140@ */ ECIPP_ALIGNMENT_UWORD 327680 Compu_LP_nominal 0.45084 327680 /end CHARACTERISTIC
/begin COMPU_METHOD Compu_LP_nominal " " FORM "%.3" "ms"
 /begin FORMULA "-5 / log(1 - (X1 / 65536))" FORMULA_INV "(1 - exp(-5/X1)) * 65536" /end FORMULA
/end COMPU_METHOD
/begin CHARACTERISTIC LP_slow "General # LP_slow" VALUE 0x00147c04 /* @ECU_Address@LP_slow@0x01006148@ */ ECIPP_ALIGNMENT_UWORD 327680 Compu_LP_slow 0.45084 327680 /end CHARACTERISTIC
/begin COMPU_METHOD Compu_LP_slow " " FORM "%.3" "ms"
 /begin FORMULA "-5 / log(1 - (X1 / 65536))" FORMULA_INV "(1 - exp(-5/X1)) * 65536" /end FORMULA
/end COMPU_METHOD
/begin CHARACTERISTIC MAP_MPI_max "General # MAP_MPI_max" VALUE 0x001475aa /* @ECU_Address@MAP_MPI_max@0x01006150@ */ ECIPP_ALIGNMENT_UWORD 256 Compu_MAP_MPI_max 0 255.99609375 /end CHARACTERISTIC
/begin COMPU_METHOD Compu_MAP_MPI_max " " RAT_FUNC "%.3" "psia" COEFFS 0 256 0 0 0 1 /end COMPU_METHOD
/begin CHARACTERISTIC MAP_MPI_min "General # MAP_MPI_min" VALUE 0x001475ac /* @ECU_Address@MAP_MPI_min@0x01006158@ */ ECIPP_ALIGNMENT_UWORD 256 Compu_MAP_MPI_min 0 255.99609375 /end CHARACTERISTIC
/begin COMPU_METHOD Compu_MAP_MPI_min " " RAT_FUNC "%.3" "psia" COEFFS 0 256 0 0 0 1 /end COMPU_METHOD
/begin CHARACTERISTIC MAP_def "General # MAP_def" VALUE 0x001475b0 /* @ECU_Address@MAP_def@0x01006160@ */ ECIPP_ALIGNMENT_UWORD 256 Compu_MAP_def 0 255.99609375 /end CHARACTERISTIC
/begin COMPU_METHOD Compu_MAP_def " " RAT_FUNC "%.3" "psia" COEFFS 0 256 0 0 0 1 /end COMPU_METHOD
/begin CHARACTERISTIC MAPdt_ICTmax "General # MAPdt_ICTmax" VALUE 0x001475c2 /* @ECU_Address@MAPdt_ICTmax@0x01006168@ */ ECIPP_ALIGNMENT_UWORD 564 Compu_MAPdt_ICTmax -460 563.984375 /end CHARACTERISTIC
/begin COMPU_METHOD Compu_MAPdt_ICTmax " " RAT_FUNC "%.3" "deg F" COEFFS 0 64 29440 0 0 1 /end COMPU_METHOD
/begin CHARACTERISTIC MAT_def "General # MAT_def" VALUE 0x001475c8 /* @ECU_Address@MAT_def@0x01006170@ */ ECIPP_ALIGNMENT_UWORD 564 Compu_MAT_def -460 563.984375 /end CHARACTERISTIC
/begin COMPU_METHOD Compu_MAT_def " " RAT_FUNC "%.3" "deg F" COEFFS 0 64 29440 0 0 1 /end COMPU_METHOD
/begin CHARACTERISTIC MAT_est_ena "{MAT_est_ena&0xff=0:MAT = IAT (estimate off)}{MAT_est_ena&0xff=1:IAT-CHT based estimate}" VALUE 0x00147e5b /* @ECU_Address@MAT_est_ena@0x01006180@ */ ECIPP_ALIGNMENT_UBYTE 255 MAT_est_ena_COMPU_VTAB 0 255 BIT_MASK 0xff /end CHARACTERISTIC
/begin COMPU_METHOD MAT_est_ena_COMPU_VTAB "Verbal Table" TAB_VERB "%.0" "list" COMPU_TAB_REF MAT_est_ena_COMPU_VTAB_REF /end COMPU_METHOD
/begin COMPU_VTAB MAT_est_ena_COMPU_VTAB_REF "Verbal Table" TAB_VERB 2 0 "MAT = IAT (estimate off)" 1 "IAT-CHT based estimate" DEFAULT_VALUE "UNKNOWN" /end COMPU_VTAB
/begin CHARACTERISTIC MATs "General # MATs" VALUE 0x001475ce /* @ECU_Address@MATs@0x01006188@ */ ECIPP_ALIGNMENT_UWORD 564 Compu_MATs -460 563.984375 /end CHARACTERISTIC
/begin COMPU_METHOD Compu_MATs " " RAT_FUNC "%.3" "deg F" COEFFS 0 64 29440 0 0 1 /end COMPU_METHOD
/begin CHARACTERISTIC MILblk_btw_codes "General # MILblk_btw_codes" VALUE 0x0016636e /* @ECU_Address@MILblk_btw_codes@0x01006190@ */ ECIPP_ALIGNMENT_UBYTE 12750 Compu_MILblk_btw_codes 0 12750 /end CHARACTERISTIC
/begin COMPU_METHOD Compu_MILblk_btw_codes " " RAT_FUNC "%.3" "ms" COEFFS 0 0.02 0 0 0 1 /end COMPU_METHOD
/begin CHARACTERISTIC MILblk_btw_digits "General # MILblk_btw_digits" VALUE 0x0016636f /* @ECU_Address@MILblk_btw_digits@0x01006198@ */ ECIPP_ALIGNMENT_UBYTE 12750 Compu_MILblk_btw_digits 0 12750 /end CHARACTERISTIC
/begin COMPU_METHOD Compu_MILblk_btw_digits " " RAT_FUNC "%.3" "ms" COEFFS 0 0.02 0 0 0 1 /end COMPU_METHOD
/begin CHARACTERISTIC MILblk_btw_repeat "General # MILblk_btw_repeat" VALUE 0x00166370 /* @ECU_Address@MILblk_btw_repeat@0x010061A0@ */ ECIPP_ALIGNMENT_UBYTE 12750 Compu_MILblk_btw_repeat 0 12750 /end CHARACTERISTIC
/begin COMPU_METHOD Compu_MILblk_btw_repeat " " RAT_FUNC "%.3" "ms" COEFFS 0 0.02 0 0 0 1 /end COMPU_METHOD
/begin CHARACTERISTIC MILblk_code_rpt "General # MILblk_code_rpt" VALUE 0x00166371 /* @ECU_Address@MILblk_code_rpt@0x010061A8@ */ ECIPP_ALIGNMENT_UBYTE 255 Compu_MILblk_code_rpt 0 255 /end CHARACTERISTIC
/begin COMPU_METHOD Compu_MILblk_code_rpt " " RAT_FUNC "%.0" "-" COEFFS 0 1 0 0 0 1 /end COMPU_METHOD
/begin CHARACTERISTIC MILblk_digit_off "General # MILblk_digit_off" VALUE 0x00166373 /* @ECU_Address@MILblk_digit_off@0x010061B0@ */ ECIPP_ALIGNMENT_UBYTE 12750 Compu_MILblk_digit_off 0 12750 /end CHARACTERISTIC
/begin COMPU_METHOD Compu_MILblk_digit_off " " RAT_FUNC "%.3" "ms" COEFFS 0 0.02 0 0 0 1 /end COMPU_METHOD
/begin CHARACTERISTIC MILblk_digit_on "General # MILblk_digit_on" VALUE 0x00166374 /* @ECU_Address@MILblk_digit_on@0x010061B8@ */ ECIPP_ALIGNMENT_UBYTE 12750 Compu_MILblk_digit_on 0 12750 /end CHARACTERISTIC
/begin COMPU_METHOD Compu_MILblk_digit_on " " RAT_FUNC "%.3" "ms" COEFFS 0 0.02 0 0 0 1 /end COMPU_METHOD
/begin CHARACTERISTIC MILblk_series_wait "General # MILblk_series_wait" VALUE 0x00166378 /* @ECU_Address@MILblk_series_wait@0x010061C0@ */ ECIPP_ALIGNMENT_UBYTE 12750 Compu_MILblk_series_wait 0 12750 /end CHARACTERISTIC
/begin COMPU_METHOD Compu_MILblk_series_wait " " RAT_FUNC "%.3" "ms" COEFFS 0 0.02 0 0 0 1 /end COMPU_METHOD
/begin CHARACTERISTIC MILblk_start_wait "General # MILblk_start_wait" VALUE 0x00166379 /* @ECU_Address@MILblk_start_wait@0x010061C8@ */ ECIPP_ALIGNMENT_UBYTE 12750 Compu_MILblk_start_wait 0 12750 /end CHARACTERISTIC
/begin COMPU_METHOD Compu_MILblk_start_wait " " RAT_FUNC "%.3" "ms" COEFFS 0 0.02 0 0 0 1 /end COMPU_METHOD
/begin CHARACTERISTIC MILpdfb_off "General # MILpdfb_off" VALUE 0x0016637c /* @ECU_Address@MILpdfb_off@0x010061D0@ */ ECIPP_ALIGNMENT_UBYTE 12750 Compu_MILpdfb_off 0 12750 /end CHARACTERISTIC
/begin COMPU_METHOD Compu_MILpdfb_off " " RAT_FUNC "%.3" "ms" COEFFS 0 0.02 0 0 0 1 /end COMPU_METHOD
/begin CHARACTERISTIC MILpdfb_on "General # MILpdfb_on" VALUE 0x0016637d /* @ECU_Address@MILpdfb_on@0x010061D8@ */ ECIPP_ALIGNMENT_UBYTE 12750 Compu_MILpdfb_on 0 12750 /end CHARACTERISTIC
/begin COMPU_METHOD Compu_MILpdfb_on " " RAT_FUNC "%.3" "ms" COEFFS 0 0.02 0 0 0 1 /end COMPU_METHOD
/begin CHARACTERISTIC MILst_off "General # MILst_off" VALUE 0x0016637e /* @ECU_Address@MILst_off@0x010061E0@ */ ECIPP_ALIGNMENT_UBYTE 12750 Compu_MILst_off 0 12750 /end CHARACTERISTIC
/begin COMPU_METHOD Compu_MILst_off " " RAT_FUNC "%.3" "ms" COEFFS 0 0.02 0 0 0 1 /end COMPU_METHOD
/begin CHARACTERISTIC MILst_on "General # MILst_on" VALUE 0x0016637f /* @ECU_Address@MILst_on@0x010061E8@ */ ECIPP_ALIGNMENT_UBYTE 12750 Compu_MILst_on 0 12750 /end CHARACTERISTIC
/begin COMPU_METHOD Compu_MILst_on " " RAT_FUNC "%.3" "ms" COEFFS 0 0.02 0 0 0 1 /end COMPU_METHOD
/begin CHARACTERISTIC MinMAP_frz_wait "General # MinMAP_frz_wait" VALUE 0x0014764e /* @ECU_Address@MinMAP_frz_wait@0x010061F0@ */ ECIPP_ALIGNMENT_UWORD 65535 Compu_MinMAP_frz_wait 0 65535 /end CHARACTERISTIC
/begin COMPU_METHOD Compu_MinMAP_frz_wait " " RAT_FUNC "%.0" "ms" COEFFS 0 1 0 0 0 1 /end COMPU_METHOD
/begin CHARACTERISTIC OILL_def_lowlev "General # OILL_def_lowlev" VALUE 0x00147e98 /* @ECU_Address@OILL_def_lowlev@0x010061F8@ */ ECIPP_ALIGNMENT_UBYTE 100 Compu_OILL_def_lowlev 0 99.609375 /end CHARACTERISTIC
/begin COMPU_METHOD Compu_OILL_def_lowlev " " RAT_FUNC "%.3" "%" COEFFS 0 2.56 0 0 0 1 /end COMPU_METHOD
/begin CHARACTERISTIC OILL_def_normlev "General # OILL_def_normlev" VALUE 0x00147e99 /* @ECU_Address@OILL_def_normlev@0x01006200@ */ ECIPP_ALIGNMENT_UBYTE 100 Compu_OILL_def_normlev 0 99.609375 /end CHARACTERISTIC
/begin COMPU_METHOD Compu_OILL_def_normlev " " RAT_FUNC "%.3" "%" COEFFS 0 2.56 0 0 0 1 /end COMPU_METHOD
/begin CHARACTERISTIC OILL_input "{OILL_input&0xff=0:Disabled}{OILL_input&0xff=1:Aux PU1}{OILL_input&0xff=2:Aux PD1}{OILL_input&0xff=3:Aux PU2}" VALUE 0x00147e9a /* @ECU_Address@OILL_input@0x01006208@ */ ECIPP_ALIGNMENT_UBYTE 255 OILL_input_COMPU_VTAB 0 255 BIT_MASK 0xff /end CHARACTERISTIC
/begin COMPU_METHOD OILL_input_COMPU_VTAB "Verbal Table" TAB_VERB "%.0" "list" COMPU_TAB_REF OILL_input_COMPU_VTAB_REF /end COMPU_METHOD
/begin COMPU_VTAB OILL_input_COMPU_VTAB_REF "Verbal Table" TAB_VERB 4 0 "Disabled" 1 "Aux PU1" 2 "Aux PD1" 3 "Aux PU2" DEFAULT_VALUE "UNKNOWN" /end COMPU_VTAB
/begin CHARACTERISTIC OILL_sense "{OILL_sense&0xff=0:GND = OK}{OILL_sense&0xff=1:OPEN = OK}" VALUE 0x00147e9b /* @ECU_Address@OILL_sense@0x01006210@ */ ECIPP_ALIGNMENT_UBYTE 255 OILL_sense_COMPU_VTAB 0 255 BIT_MASK 0xff /end CHARACTERISTIC
/begin COMPU_METHOD OILL_sense_COMPU_VTAB "Verbal Table" TAB_VERB "%.0" "list" COMPU_TAB_REF OILL_sense_COMPU_VTAB_REF /end COMPU_METHOD
/begin COMPU_VTAB OILL_sense_COMPU_VTAB_REF "Verbal Table" TAB_VERB 2 0 "GND = OK" 1 "OPEN = OK" DEFAULT_VALUE "UNKNOWN" /end COMPU_VTAB
/begin CHARACTERISTIC OILP_def_lowigp "General # OILP_def_lowigp" VALUE 0x00147664 /* @ECU_Address@OILP_def_lowigp@0x01006218@ */ ECIPP_ALIGNMENT_UWORD 256 Compu_OILP_def_lowigp 0 255.99609375 /end CHARACTERISTIC
/begin COMPU_METHOD Compu_OILP_def_lowigp " " RAT_FUNC "%.3" "psig" COEFFS 0 256 0 0 0 1 /end COMPU_METHOD
/begin CHARACTERISTIC OILP_def_lowp "General # OILP_def_lowp" VALUE 0x00147666 /* @ECU_Address@OILP_def_lowp@0x01006220@ */ ECIPP_ALIGNMENT_UWORD 256 Compu_OILP_def_lowp 0 255.99609375 /end CHARACTERISTIC
/begin COMPU_METHOD Compu_OILP_def_lowp " " RAT_FUNC "%.3" "psig" COEFFS 0 256 0 0 0 1 /end COMPU_METHOD
/begin CHARACTERISTIC OILP_def_normp "General # OILP_def_normp" VALUE 0x00147668 /* @ECU_Address@OILP_def_normp@0x01006228@ */ ECIPP_ALIGNMENT_UWORD 256 Compu_OILP_def_normp 0 255.99609375 /end CHARACTERISTIC
/begin COMPU_METHOD Compu_OILP_def_normp " " RAT_FUNC "%.3" "psig" COEFFS 0 256 0 0 0 1 /end COMPU_METHOD
/begin CHARACTERISTIC PR_air_critical "General # PR_air_critical" VALUE 0x001476ac /* @ECU_Address@PR_air_critical@0x01006240@ */ ECIPP_ALIGNMENT_UWORD 1 Compu_PR_air_critical 0 0.999984741210938 /end CHARACTERISTIC
/begin COMPU_METHOD Compu_PR_air_critical " " RAT_FUNC "%.3" "-" COEFFS 0 65536 0 0 0 1 /end COMPU_METHOD
/begin CHARACTERISTIC FCdc4_UGF4_drifttl2 "FCtl_DTC_0x04(627)" VALUE 0x001640B6 /* @ECU_Address@FCtl_DTC_0x04@0x024C44E6@ */ ECIPP_ALIGNMENT_UWORD 65535 Compu_IDENTITY 0 65535 PHYS_UNIT "System ID + DTC" /end CHARACTERISTIC
/begin CHARACTERISTIC FCdc4_UGF4_drifttol "FCtl_DTC_0x04(626)" VALUE 0x001640B4 /* @ECU_Address@FCtl_DTC_0x04@0x024C44E4@ */ ECIPP_ALIGNMENT_UWORD 65535 Compu_IDENTITY 0 65535 PHYS_UNIT "System ID + DTC" /end CHARACTERISTIC
/begin CHARACTERISTIC FCdc4_UGF4_Hv_hi "FCtl_DTC_0x04(628)" VALUE 0x001640B8 /* @ECU_Address@FCtl_DTC_0x04@0x024C44E8@ */ ECIPP_ALIGNMENT_UWORD 65535 Compu_IDENTITY 0 65535 PHYS_UNIT "System ID + DTC" /end CHARACTERISTIC
/begin CHARACTERISTIC FCdc4_UGF4_internal "FCtl_DTC_0x04(624)" VALUE 0x001640B0 /* @ECU_Address@FCtl_DTC_0x04@0x024C44E0@ */ ECIPP_ALIGNMENT_UWORD 65535 Compu_IDENTITY 0 65535 PHYS_UNIT "System ID + DTC" /end CHARACTERISTIC
/begin CHARACTERISTIC FCdc4_UGF4_lowsupply "FCtl_DTC_0x04(625)" VALUE 0x001640B2 /* @ECU_Address@FCtl_DTC_0x04@0x024C44E2@ */ ECIPP_ALIGNMENT_UWORD 65535 Compu_IDENTITY 0 65535 PHYS_UNIT "System ID + DTC" /end CHARACTERISTIC
/begin CHARACTERISTIC FCdc4_UGF4_R_hi "FCtl_DTC_0x04(630)" VALUE 0x001640BC /* @ECU_Address@FCtl_DTC_0x04@0x024C44EC@ */ ECIPP_ALIGNMENT_UWORD 65535 Compu_IDENTITY 0 65535 PHYS_UNIT "System ID + DTC" /end CHARACTERISTIC
/begin CHARACTERISTIC FCdc4_UGF4_SR_hi "FCtl_DTC_0x04(642)" VALUE 0x001640D4 /* @ECU_Address@FCtl_DTC_0x04@0x024C4504@ */ ECIPP_ALIGNMENT_UWORD 65535 Compu_IDENTITY 0 65535 PHYS_UNIT "System ID + DTC" /end CHARACTERISTIC
/begin CHARACTERISTIC FCdc4_UGF4_SR_slow "FCtl_DTC_0x04(640)" VALUE 0x001640D0 /* @ECU_Address@FCtl_DTC_0x04@0x024C4500@ */ ECIPP_ALIGNMENT_UWORD 65535 Compu_IDENTITY 0 65535 PHYS_UNIT "System ID + DTC" /end CHARACTERISTIC
/begin CHARACTERISTIC FCdc4_UGF4_Sv_hi "FCtl_DTC_0x04(636)" VALUE 0x001640C8 /* @ECU_Address@FCtl_DTC_0x04@0x024C44F8@ */ ECIPP_ALIGNMENT_UWORD 65535 Compu_IDENTITY 0 65535 PHYS_UNIT "System ID + DTC" /end CHARACTERISTIC
/begin CHARACTERISTIC FCdc4_V_max "FCtl_DTC_0x04(9)" VALUE 0x00163BE2 /* @ECU_Address@FCtl_DTC_0x04@0x024C4012@ */ ECIPP_ALIGNMENT_UWORD 65535 Compu_IDENTITY 0 65535 PHYS_UNIT "System ID + DTC" /end CHARACTERISTIC
/begin CHARACTERISTIC FCdc4_V_min "FCtl_DTC_0x04(10)" VALUE 0x00163BE4 /* @ECU_Address@FCtl_DTC_0x04@0x024C4014@ */ ECIPP_ALIGNMENT_UWORD 65535 Compu_IDENTITY 0 65535 PHYS_UNIT "System ID + DTC" /end CHARACTERISTIC
/begin CHARACTERISTIC FCdc4_VE5_max "FCtl_DTC_0x04(11)" VALUE 0x00163BE6 /* @ECU_Address@FCtl_DTC_0x04@0x024C4016@ */ ECIPP_ALIGNMENT_UWORD 65535 Compu_IDENTITY 0 65535 PHYS_UNIT "System ID + DTC" /end CHARACTERISTIC
/begin CHARACTERISTIC FCdc4_VE5_min "FCtl_DTC_0x04(12)" VALUE 0x00163BE8 /* @ECU_Address@FCtl_DTC_0x04@0x024C4018@ */ ECIPP_ALIGNMENT_UWORD 65535 Compu_IDENTITY 0 65535 PHYS_UNIT "System ID + DTC" /end CHARACTERISTIC
/begin CHARACTERISTIC FCdc4_VE5ab_OOR "FCtl_DTC_0x04(183)" VALUE 0x00163D3E /* @ECU_Address@FCtl_DTC_0x04@0x024C416E@ */ ECIPP_ALIGNMENT_UWORD 65535 Compu_IDENTITY 0 65535 PHYS_UNIT "System ID + DTC" /end CHARACTERISTIC
/begin CHARACTERISTIC FCdc4_VE5b_max "FCtl_DTC_0x04(181)" VALUE 0x00163D3A /* @ECU_Address@FCtl_DTC_0x04@0x024C416A@ */ ECIPP_ALIGNMENT_UWORD 65535 Compu_IDENTITY 0 65535 PHYS_UNIT "System ID + DTC" /end CHARACTERISTIC
/begin CHARACTERISTIC FCdc4_VE5b_min "FCtl_DTC_0x04(182)" VALUE 0x00163D3C /* @ECU_Address@FCtl_DTC_0x04@0x024C416C@ */ ECIPP_ALIGNMENT_UWORD 65535 Compu_IDENTITY 0 65535 PHYS_UNIT "System ID + DTC" /end CHARACTERISTIC
/begin CHARACTERISTIC FCdc4_VE5c_max "FCtl_DTC_0x04(507)" VALUE 0x00163FC6 /* @ECU_Address@FCtl_DTC_0x04@0x024C43F6@ */ ECIPP_ALIGNMENT_UWORD 65535 Compu_IDENTITY 0 65535 PHYS_UNIT "System ID + DTC" /end CHARACTERISTIC
/begin CHARACTERISTIC FCdc4_VE5c_min "FCtl_DTC_0x04(508)" VALUE 0x00163FC8 /* @ECU_Address@FCtl_DTC_0x04@0x024C43F8@ */ ECIPP_ALIGNMENT_UWORD 65535 Compu_IDENTITY 0 65535 PHYS_UNIT "System ID + DTC" /end CHARACTERISTIC
/begin CHARACTERISTIC FCdc4_WGP_maxv "FCtl_DTC_0x04(141)" VALUE 0x00163CEA /* @ECU_Address@FCtl_DTC_0x04@0x024C411A@ */ ECIPP_ALIGNMENT_UWORD 65535 Compu_IDENTITY 0 65535 PHYS_UNIT "System ID + DTC" /end CHARACTERISTIC
/begin CHARACTERISTIC FCdc4_WGP_minv "FCtl_DTC_0x04(142)" VALUE 0x00163CEC /* @ECU_Address@FCtl_DTC_0x04@0x024C411C@ */ ECIPP_ALIGNMENT_UWORD 65535 Compu_IDENTITY 0 65535 PHYS_UNIT "System ID + DTC" /end CHARACTERISTIC
/begin CHARACTERISTIC FCdc4_WGPerr_neg "FCtl_DTC_0x04(697)" VALUE 0x00164142 /* @ECU_Address@FCtl_DTC_0x04@0x024C4572@ */ ECIPP_ALIGNMENT_UWORD 65535 Compu_IDENTITY 0 65535 PHYS_UNIT "System ID + DTC" /end CHARACTERISTIC
/begin CHARACTERISTIC FCdc4_WGPerr_pos "FCtl_DTC_0x04(696)" VALUE 0x00164140 /* @ECU_Address@FCtl_DTC_0x04@0x024C4570@ */ ECIPP_ALIGNMENT_UWORD 65535 Compu_IDENTITY 0 65535 PHYS_UNIT "System ID + DTC" /end CHARACTERISTIC
/begin CHARACTERISTIC FCdc4_WTRIN_detect "FCtl_DTC_0x04(292)" VALUE 0x00163E18 /* @ECU_Address@FCtl_DTC_0x04@0x024C4248@ */ ECIPP_ALIGNMENT_UWORD 65535 Compu_IDENTITY 0 65535 PHYS_UNIT "System ID + DTC" /end CHARACTERISTIC
/begin CHARACTERISTIC FCdc4_XEGOi_OOR "FCtl_DTC_0x04(802)" VALUE 0x00164214 /* @ECU_Address@FCtl_DTC_0x04@0x024C4644@ */ ECIPP_ALIGNMENT_UWORD 65535 Compu_IDENTITY 0 65535 PHYS_UNIT "System ID + DTC" /end CHARACTERISTIC
/begin CHARACTERISTIC FPnd_UGF4_drifttl2 "FPrm_pending(469)" VALUE 0x00164D16 /* @ECU_Address@FPrm_pending@0x021BE3AA@ */ ECIPP_ALIGNMENT_UWORD 65535 Compu_IDENTITY 0 65535 PHYS_UNIT "Bit Mask" /end CHARACTERISTIC
/begin CHARACTERISTIC FPnd_UGF4_drifttol "FPrm_pending(468)" VALUE 0x00164D14 /* @ECU_Address@FPrm_pending@0x021BE3A8@ */ ECIPP_ALIGNMENT_UWORD 65535 Compu_IDENTITY 0 65535 PHYS_UNIT "Bit Mask" /end CHARACTERISTIC
/begin CHARACTERISTIC FPnd_UGF4_Hv_hi "FPrm_pending(470)" VALUE 0x00164D18 /* @ECU_Address@FPrm_pending@0x021BE3AC@ */ ECIPP_ALIGNMENT_UWORD 65535 Compu_IDENTITY 0 65535 PHYS_UNIT "Bit Mask" /end CHARACTERISTIC
/begin CHARACTERISTIC FPnd_UGF4_internal "FPrm_pending(466)" VALUE 0x00164D10 /* @ECU_Address@FPrm_pending@0x021BE3A4@ */ ECIPP_ALIGNMENT_UWORD 65535 Compu_IDENTITY 0 65535 PHYS_UNIT "Bit Mask" /end CHARACTERISTIC
/begin CHARACTERISTIC FPnd_UGF4_lowsupply "FPrm_pending(467)" VALUE 0x00164D12 /* @ECU_Address@FPrm_pending@0x021BE3A6@ */ ECIPP_ALIGNMENT_UWORD 65535 Compu_IDENTITY 0 65535 PHYS_UNIT "Bit Mask" /end CHARACTERISTIC
/begin CHARACTERISTIC FPnd_UGF4_R_hi "FPrm_pending(471)" VALUE 0x00164D1A /* @ECU_Address@FPrm_pending@0x021BE3AE@ */ ECIPP_ALIGNMENT_UWORD 65535 Compu_IDENTITY 0 65535 PHYS_UNIT "Bit Mask" /end CHARACTERISTIC
/begin CHARACTERISTIC FPnd_UGF4_SR_hi "FPrm_pending(474)" VALUE 0x00164D20 /* @ECU_Address@FPrm_pending@0x021BE3B4@ */ ECIPP_ALIGNMENT_UWORD 65535 Compu_IDENTITY 0 65535 PHYS_UNIT "Bit Mask" /end CHARACTERISTIC
/begin CHARACTERISTIC FPnd_UGF4_SR_slow "FPrm_pending(473)" VALUE 0x00164D1E /* @ECU_Address@FPrm_pending@0x021BE3B2@ */ ECIPP_ALIGNMENT_UWORD 65535 Compu_IDENTITY 0 65535 PHYS_UNIT "Bit Mask" /end CHARACTERISTIC
/begin CHARACTERISTIC FPnd_UGF4_Sv_hi "FPrm_pending(472)" VALUE 0x00164D1C /* @ECU_Address@FPrm_pending@0x021BE3B0@ */ ECIPP_ALIGNMENT_UWORD 65535 Compu_IDENTITY 0 65535 PHYS_UNIT "Bit Mask" /end CHARACTERISTIC
/begin CHARACTERISTIC FPnd_V_max "FPrm_pending(14)" VALUE 0x00164988 /* @ECU_Address@FPrm_pending@0x021BE01C@ */ ECIPP_ALIGNMENT_UWORD 65535 Compu_IDENTITY 0 65535 PHYS_UNIT "Bit Mask" /end CHARACTERISTIC
/begin CHARACTERISTIC FPnd_V_min "FPrm_pending(15)" VALUE 0x0016498A /* @ECU_Address@FPrm_pending@0x021BE01E@ */ ECIPP_ALIGNMENT_UWORD 65535 Compu_IDENTITY 0 65535 PHYS_UNIT "Bit Mask" /end CHARACTERISTIC
/begin CHARACTERISTIC FPnd_VE5_max "FPrm_pending(16)" VALUE 0x0016498C /* @ECU_Address@FPrm_pending@0x021BE020@ */ ECIPP_ALIGNMENT_UWORD 65535 Compu_IDENTITY 0 65535 PHYS_UNIT "Bit Mask" /end CHARACTERISTIC
/begin CHARACTERISTIC FPnd_VE5_min "FPrm_pending(17)" VALUE 0x0016498E /* @ECU_Address@FPrm_pending@0x021BE022@ */ ECIPP_ALIGNMENT_UWORD 65535 Compu_IDENTITY 0 65535 PHYS_UNIT "Bit Mask" /end CHARACTERISTIC
/begin CHARACTERISTIC FPnd_VE5ab_OOR "FPrm_pending(143)" VALUE 0x00164A8A /* @ECU_Address@FPrm_pending@0x021BE11E@ */ ECIPP_ALIGNMENT_UWORD 65535 Compu_IDENTITY 0 65535 PHYS_UNIT "Bit Mask" /end CHARACTERISTIC
/begin CHARACTERISTIC FPnd_VE5b_max "FPrm_pending(141)" VALUE 0x00164A86 /* @ECU_Address@FPrm_pending@0x021BE11A@ */ ECIPP_ALIGNMENT_UWORD 65535 Compu_IDENTITY 0 65535 PHYS_UNIT "Bit Mask" /end CHARACTERISTIC
/begin CHARACTERISTIC FPnd_VE5b_min "FPrm_pending(142)" VALUE 0x00164A88 /* @ECU_Address@FPrm_pending@0x021BE11C@ */ ECIPP_ALIGNMENT_UWORD 65535 Compu_IDENTITY 0 65535 PHYS_UNIT "Bit Mask" /end CHARACTERISTIC
/begin CHARACTERISTIC FPnd_VE5c_max "FPrm_pending(386)" VALUE 0x00164C70 /* @ECU_Address@FPrm_pending@0x021BE304@ */ ECIPP_ALIGNMENT_UWORD 65535 Compu_IDENTITY 0 65535 PHYS_UNIT "Bit Mask" /end CHARACTERISTIC
/begin CHARACTERISTIC FPnd_VE5c_min "FPrm_pending(387)" VALUE 0x00164C72 /* @ECU_Address@FPrm_pending@0x021BE306@ */ ECIPP_ALIGNMENT_UWORD 65535 Compu_IDENTITY 0 65535 PHYS_UNIT "Bit Mask" /end CHARACTERISTIC
/begin CHARACTERISTIC FPnd_WGP_maxv "FPrm_pending(101)" VALUE 0x00164A36 /* @ECU_Address@FPrm_pending@0x021BE0CA@ */ ECIPP_ALIGNMENT_UWORD 65535 Compu_IDENTITY 0 65535 PHYS_UNIT "Bit Mask" /end CHARACTERISTIC
/begin CHARACTERISTIC FPnd_WGP_minv "FPrm_pending(102)" VALUE 0x00164A38 /* @ECU_Address@FPrm_pending@0x021BE0CC@ */ ECIPP_ALIGNMENT_UWORD 65535 Compu_IDENTITY 0 65535 PHYS_UNIT "Bit Mask" /end CHARACTERISTIC
/begin CHARACTERISTIC FPnd_WGPerr_neg "FPrm_pending(527)" VALUE 0x00164D8A /* @ECU_Address@FPrm_pending@0x021BE41E@ */ ECIPP_ALIGNMENT_UWORD 65535 Compu_IDENTITY 0 65535 PHYS_UNIT "Bit Mask" /end CHARACTERISTIC
/begin CHARACTERISTIC FPnd_WGPerr_pos "FPrm_pending(526)" VALUE 0x00164D88 /* @ECU_Address@FPrm_pending@0x021BE41C@ */ ECIPP_ALIGNMENT_UWORD 65535 Compu_IDENTITY 0 65535 PHYS_UNIT "Bit Mask" /end CHARACTERISTIC
/begin CHARACTERISTIC FPnd_WTRIN_detect "FPrm_pending(214)" VALUE 0x00164B18 /* @ECU_Address@FPrm_pending@0x021BE1AC@ */ ECIPP_ALIGNMENT_UWORD 65535 Compu_IDENTITY 0 65535 PHYS_UNIT "Bit Mask" /end CHARACTERISTIC
/begin CHARACTERISTIC FPnd_XEGOi_OOR "FPrm_pending(631)" VALUE 0x00164E5A /* @ECU_Address@FPrm_pending@0x021BE4EE@ */ ECIPP_ALIGNMENT_UWORD 65535 Compu_IDENTITY 0 65535 PHYS_UNIT "Bit Mask" /end CHARACTERISTIC
/begin CHARACTERISTIC FPsvr_UGF4_drifttl2 "FPrm_severity(469)" VALUE 0x00165FB3 /* @ECU_Address@FPrm_severity@0x024B31D5@ */ ECIPP_ALIGNMENT_UBYTE 255 Compu_IDENTITY 0 255 PHYS_UNIT "Severity+Class" /end CHARACTERISTIC
/begin CHARACTERISTIC FPsvr_UGF4_drifttol "FPrm_severity(468)" VALUE 0x00165FB2 /* @ECU_Address@FPrm_severity@0x024B31D4@ */ ECIPP_ALIGNMENT_UBYTE 255 Compu_IDENTITY 0 255 PHYS_UNIT "Severity+Class" /end CHARACTERISTIC
/begin CHARACTERISTIC FPsvr_UGF4_Hv_hi "FPrm_severity(470)" VALUE 0x00165FB4 /* @ECU_Address@FPrm_severity@0x024B31D6@ */ ECIPP_ALIGNMENT_UBYTE 255 Compu_IDENTITY 0 255 PHYS_UNIT "Severity+Class" /end CHARACTERISTIC
/begin CHARACTERISTIC FPsvr_UGF4_internal "FPrm_severity(466)" VALUE 0x00165FB0 /* @ECU_Address@FPrm_severity@0x024B31D2@ */ ECIPP_ALIGNMENT_UBYTE 255 Compu_IDENTITY 0 255 PHYS_UNIT "Severity+Class" /end CHARACTERISTIC
/begin CHARACTERISTIC FPsvr_UGF4_lowsupply "FPrm_severity(467)" VALUE 0x00165FB1 /* @ECU_Address@FPrm_severity@0x024B31D3@ */ ECIPP_ALIGNMENT_UBYTE 255 Compu_IDENTITY 0 255 PHYS_UNIT "Severity+Class" /end CHARACTERISTIC
/begin CHARACTERISTIC FPsvr_UGF4_R_hi "FPrm_severity(471)" VALUE 0x00165FB5 /* @ECU_Address@FPrm_severity@0x024B31D7@ */ ECIPP_ALIGNMENT_UBYTE 255 Compu_IDENTITY 0 255 PHYS_UNIT "Severity+Class" /end CHARACTERISTIC
/begin CHARACTERISTIC FPsvr_UGF4_SR_hi "FPrm_severity(474)" VALUE 0x00165FB8 /* @ECU_Address@FPrm_severity@0x024B31DA@ */ ECIPP_ALIGNMENT_UBYTE 255 Compu_IDENTITY 0 255 PHYS_UNIT "Severity+Class" /end CHARACTERISTIC
/begin CHARACTERISTIC FPsvr_UGF4_SR_slow "FPrm_severity(473)" VALUE 0x00165FB7 /* @ECU_Address@FPrm_severity@0x024B31D9@ */ ECIPP_ALIGNMENT_UBYTE 255 Compu_IDENTITY 0 255 PHYS_UNIT "Severity+Class" /end CHARACTERISTIC
/begin CHARACTERISTIC FPsvr_UGF4_Sv_hi "FPrm_severity(472)" VALUE 0x00165FB6 /* @ECU_Address@FPrm_severity@0x024B31D8@ */ ECIPP_ALIGNMENT_UBYTE 255 Compu_IDENTITY 0 255 PHYS_UNIT "Severity+Class" /end CHARACTERISTIC
/begin CHARACTERISTIC FPsvr_V_max "FPrm_severity(14)" VALUE 0x00165DEC /* @ECU_Address@FPrm_severity@0x024B300E@ */ ECIPP_ALIGNMENT_UBYTE 255 Compu_IDENTITY 0 255 PHYS_UNIT "Severity+Class" /end CHARACTERISTIC
/begin CHARACTERISTIC FPsvr_V_min "FPrm_severity(15)" VALUE 0x00165DED /* @ECU_Address@FPrm_severity@0x024B300F@ */ ECIPP_ALIGNMENT_UBYTE 255 Compu_IDENTITY 0 255 PHYS_UNIT "Severity+Class" /end CHARACTERISTIC
/begin CHARACTERISTIC FPsvr_VE5_max "FPrm_severity(16)" VALUE 0x00165DEE /* @ECU_Address@FPrm_severity@0x024B3010@ */ ECIPP_ALIGNMENT_UBYTE 255 Compu_IDENTITY 0 255 PHYS_UNIT "Severity+Class" /end CHARACTERISTIC
/begin CHARACTERISTIC FPsvr_VE5_min "FPrm_severity(17)" VALUE 0x00165DEF /* @ECU_Address@FPrm_severity@0x024B3011@ */ ECIPP_ALIGNMENT_UBYTE 255 Compu_IDENTITY 0 255 PHYS_UNIT "Severity+Class" /end CHARACTERISTIC
/begin CHARACTERISTIC FPsvr_VE5ab_OOR "FPrm_severity(143)" VALUE 0x00165E6D /* @ECU_Address@FPrm_severity@0x024B308F@ */ ECIPP_ALIGNMENT_UBYTE 255 Compu_IDENTITY 0 255 PHYS_UNIT "Severity+Class" /end CHARACTERISTIC
/begin CHARACTERISTIC FPsvr_VE5b_max "FPrm_severity(141)" VALUE 0x00165E6B /* @ECU_Address@FPrm_severity@0x024B308D@ */ ECIPP_ALIGNMENT_UBYTE 255 Compu_IDENTITY 0 255 PHYS_UNIT "Severity+Class" /end CHARACTERISTIC
/begin CHARACTERISTIC FPsvr_VE5b_min "FPrm_severity(142)" VALUE 0x00165E6C /* @ECU_Address@FPrm_severity@0x024B308E@ */ ECIPP_ALIGNMENT_UBYTE 255 Compu_IDENTITY 0 255 PHYS_UNIT "Severity+Class" /end CHARACTERISTIC
/begin CHARACTERISTIC FPsvr_VE5c_max "FPrm_severity(386)" VALUE 0x00165F60 /* @ECU_Address@FPrm_severity@0x024B3182@ */ ECIPP_ALIGNMENT_UBYTE 255 Compu_IDENTITY 0 255 PHYS_UNIT "Severity+Class" /end CHARACTERISTIC
/begin CHARACTERISTIC FPsvr_VE5c_min "FPrm_severity(387)" VALUE 0x00165F61 /* @ECU_Address@FPrm_severity@0x024B3183@ */ ECIPP_ALIGNMENT_UBYTE 255 Compu_IDENTITY 0 255 PHYS_UNIT "Severity+Class" /end CHARACTERISTIC
/begin CHARACTERISTIC FPsvr_WGP_maxv "FPrm_severity(101)" VALUE 0x00165E43 /* @ECU_Address@FPrm_severity@0x024B3065@ */ ECIPP_ALIGNMENT_UBYTE 255 Compu_IDENTITY 0 255 PHYS_UNIT "Severity+Class" /end CHARACTERISTIC
/begin CHARACTERISTIC FPsvr_WGP_minv "FPrm_severity(102)" VALUE 0x00165E44 /* @ECU_Address@FPrm_severity@0x024B3066@ */ ECIPP_ALIGNMENT_UBYTE 255 Compu_IDENTITY 0 255 PHYS_UNIT "Severity+Class" /end CHARACTERISTIC
/begin CHARACTERISTIC FPsvr_WGPerr_neg "FPrm_severity(527)" VALUE 0x00165FED /* @ECU_Address@FPrm_severity@0x024B320F@ */ ECIPP_ALIGNMENT_UBYTE 255 Compu_IDENTITY 0 255 PHYS_UNIT "Severity+Class" /end CHARACTERISTIC
/begin CHARACTERISTIC FPsvr_WGPerr_pos "FPrm_severity(526)" VALUE 0x00165FEC /* @ECU_Address@FPrm_severity@0x024B320E@ */ ECIPP_ALIGNMENT_UBYTE 255 Compu_IDENTITY 0 255 PHYS_UNIT "Severity+Class" /end CHARACTERISTIC
/begin CHARACTERISTIC FPsvr_WTRIN_detect "FPrm_severity(214)" VALUE 0x00165EB4 /* @ECU_Address@FPrm_severity@0x024B30D6@ */ ECIPP_ALIGNMENT_UBYTE 255 Compu_IDENTITY 0 255 PHYS_UNIT "Severity+Class" /end CHARACTERISTIC
/begin CHARACTERISTIC FPsvr_XEGOi_OOR "FPrm_severity(631)" VALUE 0x00166055 /* @ECU_Address@FPrm_severity@0x024B3277@ */ ECIPP_ALIGNMENT_UBYTE 255 Compu_IDENTITY 0 255 PHYS_UNIT "Severity+Class" /end CHARACTERISTIC
/begin CHARACTERISTIC FPsw_ext1_UGF4_drifttl2 "FPrm_switches_ext1(469)" VALUE 0x001471E8 /* @ECU_Address@FPrm_switches_ext1@0x023A53AA@ */ ECIPP_ALIGNMENT_UWORD 65535 Compu_IDENTITY 0 65535 PHYS_UNIT "Enable bits" /end CHARACTERISTIC
/begin CHARACTERISTIC FPsw_ext1_UGF4_drifttol "FPrm_switches_ext1(468)" VALUE 0x001471E6 /* @ECU_Address@FPrm_switches_ext1@0x023A53A8@ */ ECIPP_ALIGNMENT_UWORD 65535 Compu_IDENTITY 0 65535 PHYS_UNIT "Enable bits" /end CHARACTERISTIC
/begin CHARACTERISTIC FPsw_ext1_UGF4_Hv_hi "FPrm_switches_ext1(470)" VALUE 0x001471EA /* @ECU_Address@FPrm_switches_ext1@0x023A53AC@ */ ECIPP_ALIGNMENT_UWORD 65535 Compu_IDENTITY 0 65535 PHYS_UNIT "Enable bits" /end CHARACTERISTIC
/begin CHARACTERISTIC FPsw_ext1_UGF4_internal "FPrm_switches_ext1(466)" VALUE 0x001471E2 /* @ECU_Address@FPrm_switches_ext1@0x023A53A4@ */ ECIPP_ALIGNMENT_UWORD 65535 Compu_IDENTITY 0 65535 PHYS_UNIT "Enable bits" /end CHARACTERISTIC
/begin CHARACTERISTIC FPsw_ext1_UGF4_lowsupply "FPrm_switches_ext1(467)" VALUE 0x001471E4 /* @ECU_Address@FPrm_switches_ext1@0x023A53A6@ */ ECIPP_ALIGNMENT_UWORD 65535 Compu_IDENTITY 0 65535 PHYS_UNIT "Enable bits" /end CHARACTERISTIC
/begin CHARACTERISTIC FPsw_ext1_UGF4_R_hi "FPrm_switches_ext1(471)" VALUE 0x001471EC /* @ECU_Address@FPrm_switches_ext1@0x023A53AE@ */ ECIPP_ALIGNMENT_UWORD 65535 Compu_IDENTITY 0 65535 PHYS_UNIT "Enable bits" /end CHARACTERISTIC
/begin CHARACTERISTIC FPsw_ext1_UGF4_SR_hi "FPrm_switches_ext1(474)" VALUE 0x001471F2 /* @ECU_Address@FPrm_switches_ext1@0x023A53B4@ */ ECIPP_ALIGNMENT_UWORD 65535 Compu_IDENTITY 0 65535 PHYS_UNIT "Enable bits" /end CHARACTERISTIC
/begin CHARACTERISTIC FPsw_ext1_UGF4_SR_slow "FPrm_switches_ext1(473)" VALUE 0x001471F0 /* @ECU_Address@FPrm_switches_ext1@0x023A53B2@ */ ECIPP_ALIGNMENT_UWORD 65535 Compu_IDENTITY 0 65535 PHYS_UNIT "Enable bits" /end CHARACTERISTIC
/begin CHARACTERISTIC FPsw_ext1_UGF4_Sv_hi "FPrm_switches_ext1(472)" VALUE 0x001471EE /* @ECU_Address@FPrm_switches_ext1@0x023A53B0@ */ ECIPP_ALIGNMENT_UWORD 65535 Compu_IDENTITY 0 65535 PHYS_UNIT "Enable bits" /end CHARACTERISTIC
/begin CHARACTERISTIC FPsw_ext1_V_max "FPrm_switches_ext1(14)" VALUE 0x00146E5A /* @ECU_Address@FPrm_switches_ext1@0x023A501C@ */ ECIPP_ALIGNMENT_UWORD 65535 Compu_IDENTITY 0 65535 PHYS_UNIT "Enable bits" /end CHARACTERISTIC
/begin CHARACTERISTIC FPsw_ext1_V_min "FPrm_switches_ext1(15)" VALUE 0x00146E5C /* @ECU_Address@FPrm_switches_ext1@0x023A501E@ */ ECIPP_ALIGNMENT_UWORD 65535 Compu_IDENTITY 0 65535 PHYS_UNIT "Enable bits" /end CHARACTERISTIC
/begin CHARACTERISTIC FPsw_ext1_VE5_max "FPrm_switches_ext1(16)" VALUE 0x00146E5E /* @ECU_Address@FPrm_switches_ext1@0x023A5020@ */ ECIPP_ALIGNMENT_UWORD 65535 Compu_IDENTITY 0 65535 PHYS_UNIT "Enable bits" /end CHARACTERISTIC
/begin CHARACTERISTIC FPsw_ext1_VE5_min "FPrm_switches_ext1(17)" VALUE 0x00146E60 /* @ECU_Address@FPrm_switches_ext1@0x023A5022@ */ ECIPP_ALIGNMENT_UWORD 65535 Compu_IDENTITY 0 65535 PHYS_UNIT "Enable bits" /end CHARACTERISTIC
/begin CHARACTERISTIC FPsw_ext1_VE5ab_OOR "FPrm_switches_ext1(143)" VALUE 0x00146F5C /* @ECU_Address@FPrm_switches_ext1@0x023A511E@ */ ECIPP_ALIGNMENT_UWORD 65535 Compu_IDENTITY 0 65535 PHYS_UNIT "Enable bits" /end CHARACTERISTIC
/begin CHARACTERISTIC FPsw_ext1_VE5b_max "FPrm_switches_ext1(141)" VALUE 0x00146F58 /* @ECU_Address@FPrm_switches_ext1@0x023A511A@ */ ECIPP_ALIGNMENT_UWORD 65535 Compu_IDENTITY 0 65535 PHYS_UNIT "Enable bits" /end CHARACTERISTIC
/begin CHARACTERISTIC FPsw_ext1_VE5b_min "FPrm_switches_ext1(142)" VALUE 0x00146F5A /* @ECU_Address@FPrm_switches_ext1@0x023A511C@ */ ECIPP_ALIGNMENT_UWORD 65535 Compu_IDENTITY 0 65535 PHYS_UNIT "Enable bits" /end CHARACTERISTIC
/begin CHARACTERISTIC FPsw_ext1_VE5c_max "FPrm_switches_ext1(386)" VALUE 0x00147142 /* @ECU_Address@FPrm_switches_ext1@0x023A5304@ */ ECIPP_ALIGNMENT_UWORD 65535 Compu_IDENTITY 0 65535 PHYS_UNIT "Enable bits" /end CHARACTERISTIC
/begin CHARACTERISTIC FPsw_ext1_VE5c_min "FPrm_switches_ext1(387)" VALUE 0x00147144 /* @ECU_Address@FPrm_switches_ext1@0x023A5306@ */ ECIPP_ALIGNMENT_UWORD 65535 Compu_IDENTITY 0 65535 PHYS_UNIT "Enable bits" /end CHARACTERISTIC
/begin CHARACTERISTIC FPsw_ext1_WGP_maxv "FPrm_switches_ext1(101)" VALUE 0x00146F08 /* @ECU_Address@FPrm_switches_ext1@0x023A50CA@ */ ECIPP_ALIGNMENT_UWORD 65535 Compu_IDENTITY 0 65535 PHYS_UNIT "Enable bits" /end CHARACTERISTIC
/begin CHARACTERISTIC FPsw_ext1_WGP_minv "FPrm_switches_ext1(102)" VALUE 0x00146F0A /* @ECU_Address@FPrm_switches_ext1@0x023A50CC@ */ ECIPP_ALIGNMENT_UWORD 65535 Compu_IDENTITY 0 65535 PHYS_UNIT "Enable bits" /end CHARACTERISTIC
/begin CHARACTERISTIC FPsw_ext1_WGPerr_neg "FPrm_switches_ext1(527)" VALUE 0x0014725C /* @ECU_Address@FPrm_switches_ext1@0x023A541E@ */ ECIPP_ALIGNMENT_UWORD 65535 Compu_IDENTITY 0 65535 PHYS_UNIT "Enable bits" /end CHARACTERISTIC
/begin CHARACTERISTIC FPsw_ext1_WGPerr_pos "FPrm_switches_ext1(526)" VALUE 0x0014725A /* @ECU_Address@FPrm_switches_ext1@0x023A541C@ */ ECIPP_ALIGNMENT_UWORD 65535 Compu_IDENTITY 0 65535 PHYS_UNIT "Enable bits" /end CHARACTERISTIC
/begin CHARACTERISTIC FPsw_ext1_WTRIN_detect "FPrm_switches_ext1(214)" VALUE 0x00146FEA /* @ECU_Address@FPrm_switches_ext1@0x023A51AC@ */ ECIPP_ALIGNMENT_UWORD 65535 Compu_IDENTITY 0 65535 PHYS_UNIT "Enable bits" /end CHARACTERISTIC
/begin CHARACTERISTIC FPsw_ext1_XEGOi_OOR "FPrm_switches_ext1(631)" VALUE 0x0014732C /* @ECU_Address@FPrm_switches_ext1@0x023A54EE@ */ ECIPP_ALIGNMENT_UWORD 65535 Compu_IDENTITY 0 65535 PHYS_UNIT "Enable bits" /end CHARACTERISTIC
/begin CHARACTERISTIC FPsw_UGF4_drifttl2 "FPrm_switches(469)" VALUE 0x00146C86 /* @ECU_Address@FPrm_switches@0x021B93AA@ */ ECIPP_ALIGNMENT_UWORD 65535 Compu_IDENTITY 0 65535 PHYS_UNIT "Enable bits" /end CHARACTERISTIC
/begin CHARACTERISTIC FPsw_UGF4_drifttol "FPrm_switches(468)" VALUE 0x00146C84 /* @ECU_Address@FPrm_switches@0x021B93A8@ */ ECIPP_ALIGNMENT_UWORD 65535 Compu_IDENTITY 0 65535 PHYS_UNIT "Enable bits" /end CHARACTERISTIC
/begin CHARACTERISTIC FPsw_UGF4_Hv_hi "FPrm_switches(470)" VALUE 0x00146C88 /* @ECU_Address@FPrm_switches@0x021B93AC@ */ ECIPP_ALIGNMENT_UWORD 65535 Compu_IDENTITY 0 65535 PHYS_UNIT "Enable bits" /end CHARACTERISTIC
/begin CHARACTERISTIC FPsw_UGF4_internal "FPrm_switches(466)" VALUE 0x00146C80 /* @ECU_Address@FPrm_switches@0x021B93A4@ */ ECIPP_ALIGNMENT_UWORD 65535 Compu_IDENTITY 0 65535 PHYS_UNIT "Enable bits" /end CHARACTERISTIC
/begin CHARACTERISTIC FPsw_UGF4_lowsupply "FPrm_switches(467)" VALUE 0x00146C82 /* @ECU_Address@FPrm_switches@0x021B93A6@ */ ECIPP_ALIGNMENT_UWORD 65535 Compu_IDENTITY 0 65535 PHYS_UNIT "Enable bits" /end CHARACTERISTIC
/begin CHARACTERISTIC FPsw_UGF4_R_hi "FPrm_switches(471)" VALUE 0x00146C8A /* @ECU_Address@FPrm_switches@0x021B93AE@ */ ECIPP_ALIGNMENT_UWORD 65535 Compu_IDENTITY 0 65535 PHYS_UNIT "Enable bits" /end CHARACTERISTIC
/begin CHARACTERISTIC FPsw_UGF4_SR_hi "FPrm_switches(474)" VALUE 0x00146C90 /* @ECU_Address@FPrm_switches@0x021B93B4@ */ ECIPP_ALIGNMENT_UWORD 65535 Compu_IDENTITY 0 65535 PHYS_UNIT "Enable bits" /end CHARACTERISTIC
/begin CHARACTERISTIC FPsw_UGF4_SR_slow "FPrm_switches(473)" VALUE 0x00146C8E /* @ECU_Address@FPrm_switches@0x021B93B2@ */ ECIPP_ALIGNMENT_UWORD 65535 Compu_IDENTITY 0 65535 PHYS_UNIT "Enable bits" /end CHARACTERISTIC
/begin CHARACTERISTIC FPsw_UGF4_Sv_hi "FPrm_switches(472)" VALUE 0x00146C8C /* @ECU_Address@FPrm_switches@0x021B93B0@ */ ECIPP_ALIGNMENT_UWORD 65535 Compu_IDENTITY 0 65535 PHYS_UNIT "Enable bits" /end CHARACTERISTIC
/begin CHARACTERISTIC FPsw_V_max "FPrm_switches(14)" VALUE 0x001468F8 /* @ECU_Address@FPrm_switches@0x021B901C@ */ ECIPP_ALIGNMENT_UWORD 65535 Compu_IDENTITY 0 65535 PHYS_UNIT "Enable bits" /end CHARACTERISTIC
/begin CHARACTERISTIC FPsw_V_min "FPrm_switches(15)" VALUE 0x001468FA /* @ECU_Address@FPrm_switches@0x021B901E@ */ ECIPP_ALIGNMENT_UWORD 65535 Compu_IDENTITY 0 65535 PHYS_UNIT "Enable bits" /end CHARACTERISTIC
/begin CHARACTERISTIC FPsw_VE5_max "FPrm_switches(16)" VALUE 0x001468FC /* @ECU_Address@FPrm_switches@0x021B9020@ */ ECIPP_ALIGNMENT_UWORD 65535 Compu_IDENTITY 0 65535 PHYS_UNIT "Enable bits" /end CHARACTERISTIC
/begin CHARACTERISTIC FPsw_VE5_min "FPrm_switches(17)" VALUE 0x001468FE /* @ECU_Address@FPrm_switches@0x021B9022@ */ ECIPP_ALIGNMENT_UWORD 65535 Compu_IDENTITY 0 65535 PHYS_UNIT "Enable bits" /end CHARACTERISTIC
/begin CHARACTERISTIC FPsw_VE5ab_OOR "FPrm_switches(143)" VALUE 0x001469FA /* @ECU_Address@FPrm_switches@0x021B911E@ */ ECIPP_ALIGNMENT_UWORD 65535 Compu_IDENTITY 0 65535 PHYS_UNIT "Enable bits" /end CHARACTERISTIC
/begin CHARACTERISTIC FPsw_VE5b_max "FPrm_switches(141)" VALUE 0x001469F6 /* @ECU_Address@FPrm_switches@0x021B911A@ */ ECIPP_ALIGNMENT_UWORD 65535 Compu_IDENTITY 0 65535 PHYS_UNIT "Enable bits" /end CHARACTERISTIC
/begin CHARACTERISTIC FPsw_VE5b_min "FPrm_switches(142)" VALUE 0x001469F8 /* @ECU_Address@FPrm_switches@0x021B911C@ */ ECIPP_ALIGNMENT_UWORD 65535 Compu_IDENTITY 0 65535 PHYS_UNIT "Enable bits" /end CHARACTERISTIC
/begin CHARACTERISTIC FPsw_VE5c_max "FPrm_switches(386)" VALUE 0x00146BE0 /* @ECU_Address@FPrm_switches@0x021B9304@ */ ECIPP_ALIGNMENT_UWORD 65535 Compu_IDENTITY 0 65535 PHYS_UNIT "Enable bits" /end CHARACTERISTIC
/begin CHARACTERISTIC FPsw_VE5c_min "FPrm_switches(387)" VALUE 0x00146BE2 /* @ECU_Address@FPrm_switches@0x021B9306@ */ ECIPP_ALIGNMENT_UWORD 65535 Compu_IDENTITY 0 65535 PHYS_UNIT "Enable bits" /end CHARACTERISTIC
/begin CHARACTERISTIC FPsw_WGP_maxv "FPrm_switches(101)" VALUE 0x001469A6 /* @ECU_Address@FPrm_switches@0x021B90CA@ */ ECIPP_ALIGNMENT_UWORD 65535 Compu_IDENTITY 0 65535 PHYS_UNIT "Enable bits" /end CHARACTERISTIC
/begin CHARACTERISTIC FPsw_WGP_minv "FPrm_switches(102)" VALUE 0x001469A8 /* @ECU_Address@FPrm_switches@0x021B90CC@ */ ECIPP_ALIGNMENT_UWORD 65535 Compu_IDENTITY 0 65535 PHYS_UNIT "Enable bits" /end CHARACTERISTIC
/begin CHARACTERISTIC FPsw_WGPerr_neg "FPrm_switches(527)" VALUE 0x00146CFA /* @ECU_Address@FPrm_switches@0x021B941E@ */ ECIPP_ALIGNMENT_UWORD 65535 Compu_IDENTITY 0 65535 PHYS_UNIT "Enable bits" /end CHARACTERISTIC
/begin CHARACTERISTIC FPsw_WGPerr_pos "FPrm_switches(526)" VALUE 0x00146CF8 /* @ECU_Address@FPrm_switches@0x021B941C@ */ ECIPP_ALIGNMENT_UWORD 65535 Compu_IDENTITY 0 65535 PHYS_UNIT "Enable bits" /end CHARACTERISTIC
/begin CHARACTERISTIC FPsw_WTRIN_detect "FPrm_switches(214)" VALUE 0x00146A88 /* @ECU_Address@FPrm_switches@0x021B91AC@ */ ECIPP_ALIGNMENT_UWORD 65535 Compu_IDENTITY 0 65535 PHYS_UNIT "Enable bits" /end CHARACTERISTIC
/begin CHARACTERISTIC FPsw_XEGOi_OOR "FPrm_switches(631)" VALUE 0x00146DCA /* @ECU_Address@FPrm_switches@0x021B94EE@ */ ECIPP_ALIGNMENT_UWORD 65535 Compu_IDENTITY 0 65535 PHYS_UNIT "Enable bits" /end CHARACTERISTIC
/begin CHARACTERISTIC FCdtc_UGF4_drifttl2 "FCtl_DTC(627)" VALUE 0x001639FA /* @ECU_Address@FCtl_DTC@0x021B54E6@ */ ECIPP_ALIGNMENT_UWORD 65535 Compu_IDENTITY 0 65535 PHYS_UNIT "DTC" /end CHARACTERISTIC
/begin CHARACTERISTIC FCdtc_UGF4_drifttol "FCtl_DTC(626)" VALUE 0x001639F8 /* @ECU_Address@FCtl_DTC@0x021B54E4@ */ ECIPP_ALIGNMENT_UWORD 65535 Compu_IDENTITY 0 65535 PHYS_UNIT "DTC" /end CHARACTERISTIC
/begin CHARACTERISTIC FCdtc_UGF4_Hv_hi "FCtl_DTC(628)" VALUE 0x001639FC /* @ECU_Address@FCtl_DTC@0x021B54E8@ */ ECIPP_ALIGNMENT_UWORD 65535 Compu_IDENTITY 0 65535 PHYS_UNIT "DTC" /end CHARACTERISTIC
/begin CHARACTERISTIC FCdtc_UGF4_internal "FCtl_DTC(624)" VALUE 0x001639F4 /* @ECU_Address@FCtl_DTC@0x021B54E0@ */ ECIPP_ALIGNMENT_UWORD 65535 Compu_IDENTITY 0 65535 PHYS_UNIT "DTC" /end CHARACTERISTIC
/begin CHARACTERISTIC FCdtc_UGF4_lowsupply "FCtl_DTC(625)" VALUE 0x001639F6 /* @ECU_Address@FCtl_DTC@0x021B54E2@ */ ECIPP_ALIGNMENT_UWORD 65535 Compu_IDENTITY 0 65535 PHYS_UNIT "DTC" /end CHARACTERISTIC
/begin CHARACTERISTIC FCdtc_UGF4_R_hi "FCtl_DTC(630)" VALUE 0x00163A00 /* @ECU_Address@FCtl_DTC@0x021B54EC@ */ ECIPP_ALIGNMENT_UWORD 65535 Compu_IDENTITY 0 65535 PHYS_UNIT "DTC" /end CHARACTERISTIC
/begin CHARACTERISTIC FCdtc_UGF4_SR_hi "FCtl_DTC(642)" VALUE 0x00163A18 /* @ECU_Address@FCtl_DTC@0x021B5504@ */ ECIPP_ALIGNMENT_UWORD 65535 Compu_IDENTITY 0 65535 PHYS_UNIT "DTC" /end CHARACTERISTIC
/begin CHARACTERISTIC FCdtc_UGF4_SR_slow "FCtl_DTC(640)" VALUE 0x00163A14 /* @ECU_Address@FCtl_DTC@0x021B5500@ */ ECIPP_ALIGNMENT_UWORD 65535 Compu_IDENTITY 0 65535 PHYS_UNIT "DTC" /end CHARACTERISTIC
/begin CHARACTERISTIC FCdtc_UGF4_Sv_hi "FCtl_DTC(636)" VALUE 0x00163A0C /* @ECU_Address@FCtl_DTC@0x021B54F8@ */ ECIPP_ALIGNMENT_UWORD 65535 Compu_IDENTITY 0 65535 PHYS_UNIT "DTC" /end CHARACTERISTIC
/begin CHARACTERISTIC FCdtc_V_max "FCtl_DTC(9)" VALUE 0x00163526 /* @ECU_Address@FCtl_DTC@0x021B5012@ */ ECIPP_ALIGNMENT_UWORD 65535 Compu_IDENTITY 0 65535 PHYS_UNIT "DTC" /end CHARACTERISTIC
/begin CHARACTERISTIC FCdtc_V_min "FCtl_DTC(10)" VALUE 0x00163528 /* @ECU_Address@FCtl_DTC@0x021B5014@ */ ECIPP_ALIGNMENT_UWORD 65535 Compu_IDENTITY 0 65535 PHYS_UNIT "DTC" /end CHARACTERISTIC
/begin CHARACTERISTIC FCdtc_VE5_max "FCtl_DTC(11)" VALUE 0x0016352A /* @ECU_Address@FCtl_DTC@0x021B5016@ */ ECIPP_ALIGNMENT_UWORD 65535 Compu_IDENTITY 0 65535 PHYS_UNIT "DTC" /end CHARACTERISTIC
/begin CHARACTERISTIC FCdtc_VE5_min "FCtl_DTC(12)" VALUE 0x0016352C /* @ECU_Address@FCtl_DTC@0x021B5018@ */ ECIPP_ALIGNMENT_UWORD 65535 Compu_IDENTITY 0 65535 PHYS_UNIT "DTC" /end CHARACTERISTIC
/begin CHARACTERISTIC FCdtc_VE5ab_OOR "FCtl_DTC(183)" VALUE 0x00163682 /* @ECU_Address@FCtl_DTC@0x021B516E@ */ ECIPP_ALIGNMENT_UWORD 65535 Compu_IDENTITY 0 65535 PHYS_UNIT "DTC" /end CHARACTERISTIC
/begin CHARACTERISTIC FCdtc_VE5b_max "FCtl_DTC(181)" VALUE 0x0016367E /* @ECU_Address@FCtl_DTC@0x021B516A@ */ ECIPP_ALIGNMENT_UWORD 65535 Compu_IDENTITY 0 65535 PHYS_UNIT "DTC" /end CHARACTERISTIC
/begin CHARACTERISTIC FCdtc_VE5b_min "FCtl_DTC(182)" VALUE 0x00163680 /* @ECU_Address@FCtl_DTC@0x021B516C@ */ ECIPP_ALIGNMENT_UWORD 65535 Compu_IDENTITY 0 65535 PHYS_UNIT "DTC" /end CHARACTERISTIC
/begin CHARACTERISTIC FCdtc_VE5c_max "FCtl_DTC(507)" VALUE 0x0016390A /* @ECU_Address@FCtl_DTC@0x021B53F6@ */ ECIPP_ALIGNMENT_UWORD 65535 Compu_IDENTITY 0 65535 PHYS_UNIT "DTC" /end CHARACTERISTIC
/begin CHARACTERISTIC FCdtc_VE5c_min "FCtl_DTC(508)" VALUE 0x0016390C /* @ECU_Address@FCtl_DTC@0x021B53F8@ */ ECIPP_ALIGNMENT_UWORD 65535 Compu_IDENTITY 0 65535 PHYS_UNIT "DTC" /end CHARACTERISTIC
/begin CHARACTERISTIC FCdtc_WGP_maxv "FCtl_DTC(141)" VALUE 0x0016362E /* @ECU_Address@FCtl_DTC@0x021B511A@ */ ECIPP_ALIGNMENT_UWORD 65535 Compu_IDENTITY 0 65535 PHYS_UNIT "DTC" /end CHARACTERISTIC
/begin CHARACTERISTIC FCdtc_WGP_minv "FCtl_DTC(142)" VALUE 0x00163630 /* @ECU_Address@FCtl_DTC@0x021B511C@ */ ECIPP_ALIGNMENT_UWORD 65535 Compu_IDENTITY 0 65535 PHYS_UNIT "DTC" /end CHARACTERISTIC
/begin CHARACTERISTIC FCdtc_WGPerr_neg "FCtl_DTC(697)" VALUE 0x00163A86 /* @ECU_Address@FCtl_DTC@0x021B5572@ */ ECIPP_ALIGNMENT_UWORD 65535 Compu_IDENTITY 0 65535 PHYS_UNIT "DTC" /end CHARACTERISTIC
/begin CHARACTERISTIC FCdtc_WGPerr_pos "FCtl_DTC(696)" VALUE 0x00163A84 /* @ECU_Address@FCtl_DTC@0x021B5570@ */ ECIPP_ALIGNMENT_UWORD 65535 Compu_IDENTITY 0 65535 PHYS_UNIT "DTC" /end CHARACTERISTIC
/begin CHARACTERISTIC FCdtc_WTRIN_detect "FCtl_DTC(292)" VALUE 0x0016375C /* @ECU_Address@FCtl_DTC@0x021B5248@ */ ECIPP_ALIGNMENT_UWORD 65535 Compu_IDENTITY 0 65535 PHYS_UNIT "DTC" /end CHARACTERISTIC
/begin CHARACTERISTIC FCdtc_XEGOi_OOR "FCtl_DTC(802)" VALUE 0x00163B58 /* @ECU_Address@FCtl_DTC@0x021B5644@ */ ECIPP_ALIGNMENT_UWORD 65535 Compu_IDENTITY 0 65535 PHYS_UNIT "DTC" /end CHARACTERISTIC
/begin CHARACTERISTIC FCfmi_UGF4_drifttl2 "FCtl_FMI(627)" VALUE 0x00165386 /* @ECU_Address@FCtl_FMI@0x021B7273@ */ ECIPP_ALIGNMENT_UBYTE 255 Compu_IDENTITY 0 255 PHYS_UNIT "FMI" /end CHARACTERISTIC
/begin CHARACTERISTIC FCfmi_UGF4_drifttol "FCtl_FMI(626)" VALUE 0x00165385 /* @ECU_Address@FCtl_FMI@0x021B7272@ */ ECIPP_ALIGNMENT_UBYTE 255 Compu_IDENTITY 0 255 PHYS_UNIT "FMI" /end CHARACTERISTIC
/begin CHARACTERISTIC FCfmi_UGF4_Hv_hi "FCtl_FMI(628)" VALUE 0x00165387 /* @ECU_Address@FCtl_FMI@0x021B7274@ */ ECIPP_ALIGNMENT_UBYTE 255 Compu_IDENTITY 0 255 PHYS_UNIT "FMI" /end CHARACTERISTIC
/begin CHARACTERISTIC FCfmi_UGF4_internal "FCtl_FMI(624)" VALUE 0x00165383 /* @ECU_Address@FCtl_FMI@0x021B7270@ */ ECIPP_ALIGNMENT_UBYTE 255 Compu_IDENTITY 0 255 PHYS_UNIT "FMI" /end CHARACTERISTIC
/begin CHARACTERISTIC FCfmi_UGF4_lowsupply "FCtl_FMI(625)" VALUE 0x00165384 /* @ECU_Address@FCtl_FMI@0x021B7271@ */ ECIPP_ALIGNMENT_UBYTE 255 Compu_IDENTITY 0 255 PHYS_UNIT "FMI" /end CHARACTERISTIC
/begin CHARACTERISTIC FCfmi_UGF4_R_hi "FCtl_FMI(630)" VALUE 0x00165389 /* @ECU_Address@FCtl_FMI@0x021B7276@ */ ECIPP_ALIGNMENT_UBYTE 255 Compu_IDENTITY 0 255 PHYS_UNIT "FMI" /end CHARACTERISTIC
/begin CHARACTERISTIC FCfmi_UGF4_SR_hi "FCtl_FMI(642)" VALUE 0x00165395 /* @ECU_Address@FCtl_FMI@0x021B7282@ */ ECIPP_ALIGNMENT_UBYTE 255 Compu_IDENTITY 0 255 PHYS_UNIT "FMI" /end CHARACTERISTIC
/begin CHARACTERISTIC FCfmi_UGF4_SR_slow "FCtl_FMI(640)" VALUE 0x00165393 /* @ECU_Address@FCtl_FMI@0x021B7280@ */ ECIPP_ALIGNMENT_UBYTE 255 Compu_IDENTITY 0 255 PHYS_UNIT "FMI" /end CHARACTERISTIC
/begin CHARACTERISTIC FCfmi_UGF4_Sv_hi "FCtl_FMI(636)" VALUE 0x0016538F /* @ECU_Address@FCtl_FMI@0x021B727C@ */ ECIPP_ALIGNMENT_UBYTE 255 Compu_IDENTITY 0 255 PHYS_UNIT "FMI" /end CHARACTERISTIC
/begin CHARACTERISTIC FCfmi_V_max "FCtl_FMI(9)" VALUE 0x0016511C /* @ECU_Address@FCtl_FMI@0x021B7009@ */ ECIPP_ALIGNMENT_UBYTE 255 Compu_IDENTITY 0 255 PHYS_UNIT "FMI" /end CHARACTERISTIC
/begin CHARACTERISTIC FCfmi_V_min "FCtl_FMI(10)" VALUE 0x0016511D /* @ECU_Address@FCtl_FMI@0x021B700A@ */ ECIPP_ALIGNMENT_UBYTE 255 Compu_IDENTITY 0 255 PHYS_UNIT "FMI" /end CHARACTERISTIC
/begin CHARACTERISTIC FCfmi_VE5_max "FCtl_FMI(11)" VALUE 0x0016511E /* @ECU_Address@FCtl_FMI@0x021B700B@ */ ECIPP_ALIGNMENT_UBYTE 255 Compu_IDENTITY 0 255 PHYS_UNIT "FMI" /end CHARACTERISTIC
/begin CHARACTERISTIC FCfmi_VE5_min "FCtl_FMI(12)" VALUE 0x0016511F /* @ECU_Address@FCtl_FMI@0x021B700C@ */ ECIPP_ALIGNMENT_UBYTE 255 Compu_IDENTITY 0 255 PHYS_UNIT "FMI" /end CHARACTERISTIC
/begin CHARACTERISTIC FCfmi_VE5ab_OOR "FCtl_FMI(183)" VALUE 0x001651CA /* @ECU_Address@FCtl_FMI@0x021B70B7@ */ ECIPP_ALIGNMENT_UBYTE 255 Compu_IDENTITY 0 255 PHYS_UNIT "FMI" /end CHARACTERISTIC
/begin CHARACTERISTIC FCfmi_VE5b_max "FCtl_FMI(181)" VALUE 0x001651C8 /* @ECU_Address@FCtl_FMI@0x021B70B5@ */ ECIPP_ALIGNMENT_UBYTE 255 Compu_IDENTITY 0 255 PHYS_UNIT "FMI" /end CHARACTERISTIC
/begin CHARACTERISTIC FCfmi_VE5b_min "FCtl_FMI(182)" VALUE 0x001651C9 /* @ECU_Address@FCtl_FMI@0x021B70B6@ */ ECIPP_ALIGNMENT_UBYTE 255 Compu_IDENTITY 0 255 PHYS_UNIT "FMI" /end CHARACTERISTIC
/begin CHARACTERISTIC FCfmi_VE5c_max "FCtl_FMI(507)" VALUE 0x0016530E /* @ECU_Address@FCtl_FMI@0x021B71FB@ */ ECIPP_ALIGNMENT_UBYTE 255 Compu_IDENTITY 0 255 PHYS_UNIT "FMI" /end CHARACTERISTIC
/begin CHARACTERISTIC FCfmi_VE5c_min "FCtl_FMI(508)" VALUE 0x0016530F /* @ECU_Address@FCtl_FMI@0x021B71FC@ */ ECIPP_ALIGNMENT_UBYTE 255 Compu_IDENTITY 0 255 PHYS_UNIT "FMI" /end CHARACTERISTIC
/begin CHARACTERISTIC FCfmi_WGP_maxv "FCtl_FMI(141)" VALUE 0x001651A0 /* @ECU_Address@FCtl_FMI@0x021B708D@ */ ECIPP_ALIGNMENT_UBYTE 255 Compu_IDENTITY 0 255 PHYS_UNIT "FMI" /end CHARACTERISTIC
/begin CHARACTERISTIC FCfmi_WGP_minv "FCtl_FMI(142)" VALUE 0x001651A1 /* @ECU_Address@FCtl_FMI@0x021B708E@ */ ECIPP_ALIGNMENT_UBYTE 255 Compu_IDENTITY 0 255 PHYS_UNIT "FMI" /end CHARACTERISTIC
/begin CHARACTERISTIC FCfmi_WGPerr_neg "FCtl_FMI(697)" VALUE 0x001653CC /* @ECU_Address@FCtl_FMI@0x021B72B9@ */ ECIPP_ALIGNMENT_UBYTE 255 Compu_IDENTITY 0 255 PHYS_UNIT "FMI" /end CHARACTERISTIC
/begin CHARACTERISTIC FCfmi_WGPerr_pos "FCtl_FMI(696)" VALUE 0x001653CB /* @ECU_Address@FCtl_FMI@0x021B72B8@ */ ECIPP_ALIGNMENT_UBYTE 255 Compu_IDENTITY 0 255 PHYS_UNIT "FMI" /end CHARACTERISTIC
/begin CHARACTERISTIC FCfmi_WTRIN_detect "FCtl_FMI(292)" VALUE 0x00165237 /* @ECU_Address@FCtl_FMI@0x021B7124@ */ ECIPP_ALIGNMENT_UBYTE 255 Compu_IDENTITY 0 255 PHYS_UNIT "FMI" /end CHARACTERISTIC
/begin CHARACTERISTIC FCfmi_XEGOi_OOR "FCtl_FMI(802)" VALUE 0x00165435 /* @ECU_Address@FCtl_FMI@0x021B7322@ */ ECIPP_ALIGNMENT_UBYTE 255 Compu_IDENTITY 0 255 PHYS_UNIT "FMI" /end CHARACTERISTIC
/begin CHARACTERISTIC FCftb_UGF4_drifttl2 "FCtl_FTB_0x04(627)" VALUE 0x001656E4 /* @ECU_Address@FCtl_FTB_0x04@0x024C5273@ */ ECIPP_ALIGNMENT_UBYTE 255 Compu_IDENTITY 0 255 PHYS_UNIT "FTB" /end CHARACTERISTIC
/begin CHARACTERISTIC FCftb_UGF4_drifttol "FCtl_FTB_0x04(626)" VALUE 0x001656E3 /* @ECU_Address@FCtl_FTB_0x04@0x024C5272@ */ ECIPP_ALIGNMENT_UBYTE 255 Compu_IDENTITY 0 255 PHYS_UNIT "FTB" /end CHARACTERISTIC
/begin CHARACTERISTIC FCftb_UGF4_Hv_hi "FCtl_FTB_0x04(628)" VALUE 0x001656E5 /* @ECU_Address@FCtl_FTB_0x04@0x024C5274@ */ ECIPP_ALIGNMENT_UBYTE 255 Compu_IDENTITY 0 255 PHYS_UNIT "FTB" /end CHARACTERISTIC
/begin CHARACTERISTIC FCftb_UGF4_internal "FCtl_FTB_0x04(624)" VALUE 0x001656E1 /* @ECU_Address@FCtl_FTB_0x04@0x024C5270@ */ ECIPP_ALIGNMENT_UBYTE 255 Compu_IDENTITY 0 255 PHYS_UNIT "FTB" /end CHARACTERISTIC
/begin CHARACTERISTIC FCftb_UGF4_lowsupply "FCtl_FTB_0x04(625)" VALUE 0x001656E2 /* @ECU_Address@FCtl_FTB_0x04@0x024C5271@ */ ECIPP_ALIGNMENT_UBYTE 255 Compu_IDENTITY 0 255 PHYS_UNIT "FTB" /end CHARACTERISTIC
/begin CHARACTERISTIC FCftb_UGF4_R_hi "FCtl_FTB_0x04(630)" VALUE 0x001656E7 /* @ECU_Address@FCtl_FTB_0x04@0x024C5276@ */ ECIPP_ALIGNMENT_UBYTE 255 Compu_IDENTITY 0 255 PHYS_UNIT "FTB" /end CHARACTERISTIC
/begin CHARACTERISTIC FCftb_UGF4_SR_hi "FCtl_FTB_0x04(642)" VALUE 0x001656F3 /* @ECU_Address@FCtl_FTB_0x04@0x024C5282@ */ ECIPP_ALIGNMENT_UBYTE 255 Compu_IDENTITY 0 255 PHYS_UNIT "FTB" /end CHARACTERISTIC
/begin CHARACTERISTIC FCftb_UGF4_SR_slow "FCtl_FTB_0x04(640)" VALUE 0x001656F1 /* @ECU_Address@FCtl_FTB_0x04@0x024C5280@ */ ECIPP_ALIGNMENT_UBYTE 255 Compu_IDENTITY 0 255 PHYS_UNIT "FTB" /end CHARACTERISTIC
/begin CHARACTERISTIC FCftb_UGF4_Sv_hi "FCtl_FTB_0x04(636)" VALUE 0x001656ED /* @ECU_Address@FCtl_FTB_0x04@0x024C527C@ */ ECIPP_ALIGNMENT_UBYTE 255 Compu_IDENTITY 0 255 PHYS_UNIT "FTB" /end CHARACTERISTIC
/begin CHARACTERISTIC FCftb_V_max "FCtl_FTB_0x04(9)" VALUE 0x0016547A /* @ECU_Address@FCtl_FTB_0x04@0x024C5009@ */ ECIPP_ALIGNMENT_UBYTE 255 Compu_IDENTITY 0 255 PHYS_UNIT "FTB" /end CHARACTERISTIC
/begin CHARACTERISTIC FCftb_V_min "FCtl_FTB_0x04(10)" VALUE 0x0016547B /* @ECU_Address@FCtl_FTB_0x04@0x024C500A@ */ ECIPP_ALIGNMENT_UBYTE 255 Compu_IDENTITY 0 255 PHYS_UNIT "FTB" /end CHARACTERISTIC
/begin CHARACTERISTIC FCftb_VE5_max "FCtl_FTB_0x04(11)" VALUE 0x0016547C /* @ECU_Address@FCtl_FTB_0x04@0x024C500B@ */ ECIPP_ALIGNMENT_UBYTE 255 Compu_IDENTITY 0 255 PHYS_UNIT "FTB" /end CHARACTERISTIC
/begin CHARACTERISTIC FCftb_VE5_min "FCtl_FTB_0x04(12)" VALUE 0x0016547D /* @ECU_Address@FCtl_FTB_0x04@0x024C500C@ */ ECIPP_ALIGNMENT_UBYTE 255 Compu_IDENTITY 0 255 PHYS_UNIT "FTB" /end CHARACTERISTIC
/begin CHARACTERISTIC FCftb_VE5ab_OOR "FCtl_FTB_0x04(183)" VALUE 0x00165528 /* @ECU_Address@FCtl_FTB_0x04@0x024C50B7@ */ ECIPP_ALIGNMENT_UBYTE 255 Compu_IDENTITY 0 255 PHYS_UNIT "FTB" /end CHARACTERISTIC
/begin CHARACTERISTIC FCftb_VE5b_max "FCtl_FTB_0x04(181)" VALUE 0x00165526 /* @ECU_Address@FCtl_FTB_0x04@0x024C50B5@ */ ECIPP_ALIGNMENT_UBYTE 255 Compu_IDENTITY 0 255 PHYS_UNIT "FTB" /end CHARACTERISTIC
/begin CHARACTERISTIC FCftb_VE5b_min "FCtl_FTB_0x04(182)" VALUE 0x00165527 /* @ECU_Address@FCtl_FTB_0x04@0x024C50B6@ */ ECIPP_ALIGNMENT_UBYTE 255 Compu_IDENTITY 0 255 PHYS_UNIT "FTB" /end CHARACTERISTIC
/begin CHARACTERISTIC FCftb_VE5c_max "FCtl_FTB_0x04(507)" VALUE 0x0016566C /* @ECU_Address@FCtl_FTB_0x04@0x024C51FB@ */ ECIPP_ALIGNMENT_UBYTE 255 Compu_IDENTITY 0 255 PHYS_UNIT "FTB" /end CHARACTERISTIC
/begin CHARACTERISTIC FCftb_VE5c_min "FCtl_FTB_0x04(508)" VALUE 0x0016566D /* @ECU_Address@FCtl_FTB_0x04@0x024C51FC@ */ ECIPP_ALIGNMENT_UBYTE 255 Compu_IDENTITY 0 255 PHYS_UNIT "FTB" /end CHARACTERISTIC
/begin CHARACTERISTIC FCftb_WGP_maxv "FCtl_FTB_0x04(141)" VALUE 0x001654FE /* @ECU_Address@FCtl_FTB_0x04@0x024C508D@ */ ECIPP_ALIGNMENT_UBYTE 255 Compu_IDENTITY 0 255 PHYS_UNIT "FTB" /end CHARACTERISTIC
/begin CHARACTERISTIC FCftb_WGP_minv "FCtl_FTB_0x04(142)" VALUE 0x001654FF /* @ECU_Address@FCtl_FTB_0x04@0x024C508E@ */ ECIPP_ALIGNMENT_UBYTE 255 Compu_IDENTITY 0 255 PHYS_UNIT "FTB" /end CHARACTERISTIC
/begin CHARACTERISTIC FCftb_WGPerr_neg "FCtl_FTB_0x04(697)" VALUE 0x0016572A /* @ECU_Address@FCtl_FTB_0x04@0x024C52B9@ */ ECIPP_ALIGNMENT_UBYTE 255 Compu_IDENTITY 0 255 PHYS_UNIT "FTB" /end CHARACTERISTIC
/begin CHARACTERISTIC FCftb_WGPerr_pos "FCtl_FTB_0x04(696)" VALUE 0x00165729 /* @ECU_Address@FCtl_FTB_0x04@0x024C52B8@ */ ECIPP_ALIGNMENT_UBYTE 255 Compu_IDENTITY 0 255 PHYS_UNIT "FTB" /end CHARACTERISTIC
/begin CHARACTERISTIC FCftb_WTRIN_detect "FCtl_FTB_0x04(292)" VALUE 0x00165595 /* @ECU_Address@FCtl_FTB_0x04@0x024C5124@ */ ECIPP_ALIGNMENT_UBYTE 255 Compu_IDENTITY 0 255 PHYS_UNIT "FTB" /end CHARACTERISTIC
/begin CHARACTERISTIC FCftb_XEGOi_OOR "FCtl_FTB_0x04(802)" VALUE 0x00165793 /* @ECU_Address@FCtl_FTB_0x04@0x024C5322@ */ ECIPP_ALIGNMENT_UBYTE 255 Compu_IDENTITY 0 255 PHYS_UNIT "FTB" /end CHARACTERISTIC
/begin CHARACTERISTIC FCspn_UGF4_drifttl2 "FCtl_SPN(627)" VALUE 0x001626A8 /* @ECU_Address@FCtl_SPN@0x021B69CC@ */ ECIPP_ALIGNMENT_ULONG 4294967295 Compu_IDENTITY 0 4294967295 PHYS_UNIT "SPN" /end CHARACTERISTIC
/begin CHARACTERISTIC FCspn_UGF4_drifttol "FCtl_SPN(626)" VALUE 0x001626A4 /* @ECU_Address@FCtl_SPN@0x021B69C8@ */ ECIPP_ALIGNMENT_ULONG 4294967295 Compu_IDENTITY 0 4294967295 PHYS_UNIT "SPN" /end CHARACTERISTIC
/begin CHARACTERISTIC FCspn_UGF4_Hv_hi "FCtl_SPN(628)" VALUE 0x001626AC /* @ECU_Address@FCtl_SPN@0x021B69D0@ */ ECIPP_ALIGNMENT_ULONG 4294967295 Compu_IDENTITY 0 4294967295 PHYS_UNIT "SPN" /end CHARACTERISTIC
/begin CHARACTERISTIC FCspn_UGF4_internal "FCtl_SPN(624)" VALUE 0x0016269C /* @ECU_Address@FCtl_SPN@0x021B69C0@ */ ECIPP_ALIGNMENT_ULONG 4294967295 Compu_IDENTITY 0 4294967295 PHYS_UNIT "SPN" /end CHARACTERISTIC
/begin CHARACTERISTIC FCspn_UGF4_lowsupply "FCtl_SPN(625)" VALUE 0x001626A0 /* @ECU_Address@FCtl_SPN@0x021B69C4@ */ ECIPP_ALIGNMENT_ULONG 4294967295 Compu_IDENTITY 0 4294967295 PHYS_UNIT "SPN" /end CHARACTERISTIC
/begin CHARACTERISTIC FCspn_UGF4_R_hi "FCtl_SPN(630)" VALUE 0x001626B4 /* @ECU_Address@FCtl_SPN@0x021B69D8@ */ ECIPP_ALIGNMENT_ULONG 4294967295 Compu_IDENTITY 0 4294967295 PHYS_UNIT "SPN" /end CHARACTERISTIC
/begin CHARACTERISTIC FCspn_UGF4_SR_hi "FCtl_SPN(642)" VALUE 0x001626E4 /* @ECU_Address@FCtl_SPN@0x021B6A08@ */ ECIPP_ALIGNMENT_ULONG 4294967295 Compu_IDENTITY 0 4294967295 PHYS_UNIT "SPN" /end CHARACTERISTIC
/begin CHARACTERISTIC FCspn_UGF4_SR_slow "FCtl_SPN(640)" VALUE 0x001626DC /* @ECU_Address@FCtl_SPN@0x021B6A00@ */ ECIPP_ALIGNMENT_ULONG 4294967295 Compu_IDENTITY 0 4294967295 PHYS_UNIT "SPN" /end CHARACTERISTIC
/begin CHARACTERISTIC FCspn_UGF4_Sv_hi "FCtl_SPN(636)" VALUE 0x001626CC /* @ECU_Address@FCtl_SPN@0x021B69F0@ */ ECIPP_ALIGNMENT_ULONG 4294967295 Compu_IDENTITY 0 4294967295 PHYS_UNIT "SPN" /end CHARACTERISTIC
/begin CHARACTERISTIC FCspn_V_max "FCtl_SPN(9)" VALUE 0x00161D00 /* @ECU_Address@FCtl_SPN@0x021B6024@ */ ECIPP_ALIGNMENT_ULONG 4294967295 Compu_IDENTITY 0 4294967295 PHYS_UNIT "SPN" /end CHARACTERISTIC
/begin CHARACTERISTIC FCspn_V_min "FCtl_SPN(10)" VALUE 0x00161D04 /* @ECU_Address@FCtl_SPN@0x021B6028@ */ ECIPP_ALIGNMENT_ULONG 4294967295 Compu_IDENTITY 0 4294967295 PHYS_UNIT "SPN" /end CHARACTERISTIC
/begin CHARACTERISTIC FCspn_VE5_max "FCtl_SPN(11)" VALUE 0x00161D08 /* @ECU_Address@FCtl_SPN@0x021B602C@ */ ECIPP_ALIGNMENT_ULONG 4294967295 Compu_IDENTITY 0 4294967295 PHYS_UNIT "SPN" /end CHARACTERISTIC
/begin CHARACTERISTIC FCspn_VE5_min "FCtl_SPN(12)" VALUE 0x00161D0C /* @ECU_Address@FCtl_SPN@0x021B6030@ */ ECIPP_ALIGNMENT_ULONG 4294967295 Compu_IDENTITY 0 4294967295 PHYS_UNIT "SPN" /end CHARACTERISTIC
/begin CHARACTERISTIC FCspn_VE5ab_OOR "FCtl_SPN(183)" VALUE 0x00161FB8 /* @ECU_Address@FCtl_SPN@0x021B62DC@ */ ECIPP_ALIGNMENT_ULONG 4294967295 Compu_IDENTITY 0 4294967295 PHYS_UNIT "SPN" /end CHARACTERISTIC
/begin CHARACTERISTIC FCspn_VE5b_max "FCtl_SPN(181)" VALUE 0x00161FB0 /* @ECU_Address@FCtl_SPN@0x021B62D4@ */ ECIPP_ALIGNMENT_ULONG 4294967295 Compu_IDENTITY 0 4294967295 PHYS_UNIT "SPN" /end CHARACTERISTIC
/begin CHARACTERISTIC FCspn_VE5b_min "FCtl_SPN(182)" VALUE 0x00161FB4 /* @ECU_Address@FCtl_SPN@0x021B62D8@ */ ECIPP_ALIGNMENT_ULONG 4294967295 Compu_IDENTITY 0 4294967295 PHYS_UNIT "SPN" /end CHARACTERISTIC
/begin CHARACTERISTIC FCspn_VE5c_max "FCtl_SPN(507)" VALUE 0x001624C8 /* @ECU_Address@FCtl_SPN@0x021B67EC@ */ ECIPP_ALIGNMENT_ULONG 4294967295 Compu_IDENTITY 0 4294967295 PHYS_UNIT "SPN" /end CHARACTERISTIC
/begin CHARACTERISTIC FCspn_VE5c_min "FCtl_SPN(508)" VALUE 0x001624CC /* @ECU_Address@FCtl_SPN@0x021B67F0@ */ ECIPP_ALIGNMENT_ULONG 4294967295 Compu_IDENTITY 0 4294967295 PHYS_UNIT "SPN" /end CHARACTERISTIC
/begin CHARACTERISTIC FCspn_WGP_maxv "FCtl_SPN(141)" VALUE 0x00161F10 /* @ECU_Address@FCtl_SPN@0x021B6234@ */ ECIPP_ALIGNMENT_ULONG 4294967295 Compu_IDENTITY 0 4294967295 PHYS_UNIT "SPN" /end CHARACTERISTIC
/begin CHARACTERISTIC FCspn_WGP_minv "FCtl_SPN(142)" VALUE 0x00161F14 /* @ECU_Address@FCtl_SPN@0x021B6238@ */ ECIPP_ALIGNMENT_ULONG 4294967295 Compu_IDENTITY 0 4294967295 PHYS_UNIT "SPN" /end CHARACTERISTIC
/begin CHARACTERISTIC FCspn_WGPerr_neg "FCtl_SPN(697)" VALUE 0x001627C0 /* @ECU_Address@FCtl_SPN@0x021B6AE4@ */ ECIPP_ALIGNMENT_ULONG 4294967295 Compu_IDENTITY 0 4294967295 PHYS_UNIT "SPN" /end CHARACTERISTIC
/begin CHARACTERISTIC FCspn_WGPerr_pos "FCtl_SPN(696)" VALUE 0x001627BC /* @ECU_Address@FCtl_SPN@0x021B6AE0@ */ ECIPP_ALIGNMENT_ULONG 4294967295 Compu_IDENTITY 0 4294967295 PHYS_UNIT "SPN" /end CHARACTERISTIC
/begin CHARACTERISTIC FCspn_WTRIN_detect "FCtl_SPN(292)" VALUE 0x0016216C /* @ECU_Address@FCtl_SPN@0x021B6490@ */ ECIPP_ALIGNMENT_ULONG 4294967295 Compu_IDENTITY 0 4294967295 PHYS_UNIT "SPN" /end CHARACTERISTIC
/begin CHARACTERISTIC FCspn_XEGOi_OOR "FCtl_SPN(802)" VALUE 0x00162964 /* @ECU_Address@FCtl_SPN@0x021B6C88@ */ ECIPP_ALIGNMENT_ULONG 4294967295 Compu_IDENTITY 0 4294967295 PHYS_UNIT "SPN" /end CHARACTERISTIC
/begin CHARACTERISTIC FPfl_UGF4_drifttl2 "FPrm_latch(469)" VALUE 0x0016076C /* @ECU_Address@FPrm_latch@0x021BB754@ */ ECIPP_ALIGNMENT_FLOAT32_IEEE 10000000000 Compu_IDENTITY -10000000000 10000000000 PHYS_UNIT "ms" /end CHARACTERISTIC
/begin CHARACTERISTIC FPfl_UGF4_drifttol "FPrm_latch(468)" VALUE 0x00160768 /* @ECU_Address@FPrm_latch@0x021BB750@ */ ECIPP_ALIGNMENT_FLOAT32_IEEE 10000000000 Compu_IDENTITY -10000000000 10000000000 PHYS_UNIT "ms" /end CHARACTERISTIC
/begin CHARACTERISTIC FPfl_UGF4_Hv_hi "FPrm_latch(470)" VALUE 0x00160770 /* @ECU_Address@FPrm_latch@0x021BB758@ */ ECIPP_ALIGNMENT_FLOAT32_IEEE 10000000000 Compu_IDENTITY -10000000000 10000000000 PHYS_UNIT "ms" /end CHARACTERISTIC
/begin CHARACTERISTIC FPfl_UGF4_internal "FPrm_latch(466)" VALUE 0x00160760 /* @ECU_Address@FPrm_latch@0x021BB748@ */ ECIPP_ALIGNMENT_FLOAT32_IEEE 10000000000 Compu_IDENTITY -10000000000 10000000000 PHYS_UNIT "ms" /end CHARACTERISTIC
/begin CHARACTERISTIC FPfl_UGF4_lowsupply "FPrm_latch(467)" VALUE 0x00160764 /* @ECU_Address@FPrm_latch@0x021BB74C@ */ ECIPP_ALIGNMENT_FLOAT32_IEEE 10000000000 Compu_IDENTITY -10000000000 10000000000 PHYS_UNIT "ms" /end CHARACTERISTIC
/begin CHARACTERISTIC FPfl_UGF4_R_hi "FPrm_latch(471)" VALUE 0x00160774 /* @ECU_Address@FPrm_latch@0x021BB75C@ */ ECIPP_ALIGNMENT_FLOAT32_IEEE 10000000000 Compu_IDENTITY -10000000000 10000000000 PHYS_UNIT "ms" /end CHARACTERISTIC
/begin CHARACTERISTIC FPfl_UGF4_SR_hi "FPrm_latch(474)" VALUE 0x00160780 /* @ECU_Address@FPrm_latch@0x021BB768@ */ ECIPP_ALIGNMENT_FLOAT32_IEEE 10000000000 Compu_IDENTITY -10000000000 10000000000 PHYS_UNIT "ms" /end CHARACTERISTIC
/begin CHARACTERISTIC FPfl_UGF4_SR_slow "FPrm_latch(473)" VALUE 0x0016077C /* @ECU_Address@FPrm_latch@0x021BB764@ */ ECIPP_ALIGNMENT_FLOAT32_IEEE 10000000000 Compu_IDENTITY -10000000000 10000000000 PHYS_UNIT "ms" /end CHARACTERISTIC
/begin CHARACTERISTIC FPfl_UGF4_Sv_hi "FPrm_latch(472)" VALUE 0x00160778 /* @ECU_Address@FPrm_latch@0x021BB760@ */ ECIPP_ALIGNMENT_FLOAT32_IEEE 10000000000 Compu_IDENTITY -10000000000 10000000000 PHYS_UNIT "ms" /end CHARACTERISTIC
/begin CHARACTERISTIC FPfl_V_max "FPrm_latch(14)" VALUE 0x00160050 /* @ECU_Address@FPrm_latch@0x021BB038@ */ ECIPP_ALIGNMENT_FLOAT32_IEEE 10000000000 Compu_IDENTITY -10000000000 10000000000 PHYS_UNIT "ms" /end CHARACTERISTIC
/begin CHARACTERISTIC FPfl_V_min "FPrm_latch(15)" VALUE 0x00160054 /* @ECU_Address@FPrm_latch@0x021BB03C@ */ ECIPP_ALIGNMENT_FLOAT32_IEEE 10000000000 Compu_IDENTITY -10000000000 10000000000 PHYS_UNIT "ms" /end CHARACTERISTIC
/begin CHARACTERISTIC FPfl_VE5_max "FPrm_latch(16)" VALUE 0x00160058 /* @ECU_Address@FPrm_latch@0x021BB040@ */ ECIPP_ALIGNMENT_FLOAT32_IEEE 10000000000 Compu_IDENTITY -10000000000 10000000000 PHYS_UNIT "ms" /end CHARACTERISTIC
/begin CHARACTERISTIC FPfl_VE5_min "FPrm_latch(17)" VALUE 0x0016005C /* @ECU_Address@FPrm_latch@0x021BB044@ */ ECIPP_ALIGNMENT_FLOAT32_IEEE 10000000000 Compu_IDENTITY -10000000000 10000000000 PHYS_UNIT "ms" /end CHARACTERISTIC
/begin CHARACTERISTIC FPfl_VE5ab_OOR "FPrm_latch(143)" VALUE 0x00160254 /* @ECU_Address@FPrm_latch@0x021BB23C@ */ ECIPP_ALIGNMENT_FLOAT32_IEEE 10000000000 Compu_IDENTITY -10000000000 10000000000 PHYS_UNIT "ms" /end CHARACTERISTIC
/begin CHARACTERISTIC FPfl_VE5b_max "FPrm_latch(141)" VALUE 0x0016024C /* @ECU_Address@FPrm_latch@0x021BB234@ */ ECIPP_ALIGNMENT_FLOAT32_IEEE 10000000000 Compu_IDENTITY -10000000000 10000000000 PHYS_UNIT "ms" /end CHARACTERISTIC
/begin CHARACTERISTIC FPfl_VE5b_min "FPrm_latch(142)" VALUE 0x00160250 /* @ECU_Address@FPrm_latch@0x021BB238@ */ ECIPP_ALIGNMENT_FLOAT32_IEEE 10000000000 Compu_IDENTITY -10000000000 10000000000 PHYS_UNIT "ms" /end CHARACTERISTIC
/begin CHARACTERISTIC FPfl_VE5c_max "FPrm_latch(386)" VALUE 0x00160620 /* @ECU_Address@FPrm_latch@0x021BB608@ */ ECIPP_ALIGNMENT_FLOAT32_IEEE 10000000000 Compu_IDENTITY -10000000000 10000000000 PHYS_UNIT "ms" /end CHARACTERISTIC
/begin CHARACTERISTIC FPfl_VE5c_min "FPrm_latch(387)" VALUE 0x00160624 /* @ECU_Address@FPrm_latch@0x021BB60C@ */ ECIPP_ALIGNMENT_FLOAT32_IEEE 10000000000 Compu_IDENTITY -10000000000 10000000000 PHYS_UNIT "ms" /end CHARACTERISTIC
/begin CHARACTERISTIC FPfl_WGP_maxv "FPrm_latch(101)" VALUE 0x001601AC /* @ECU_Address@FPrm_latch@0x021BB194@ */ ECIPP_ALIGNMENT_FLOAT32_IEEE 10000000000 Compu_IDENTITY -10000000000 10000000000 PHYS_UNIT "ms" /end CHARACTERISTIC
/begin CHARACTERISTIC FPfl_WGP_minv "FPrm_latch(102)" VALUE 0x001601B0 /* @ECU_Address@FPrm_latch@0x021BB198@ */ ECIPP_ALIGNMENT_FLOAT32_IEEE 10000000000 Compu_IDENTITY -10000000000 10000000000 PHYS_UNIT "ms" /end CHARACTERISTIC
/begin CHARACTERISTIC FPfl_WGPerr_neg "FPrm_latch(527)" VALUE 0x00160854 /* @ECU_Address@FPrm_latch@0x021BB83C@ */ ECIPP_ALIGNMENT_FLOAT32_IEEE 10000000000 Compu_IDENTITY -10000000000 10000000000 PHYS_UNIT "ms" /end CHARACTERISTIC
/begin CHARACTERISTIC FPfl_WGPerr_pos "FPrm_latch(526)" VALUE 0x00160850 /* @ECU_Address@FPrm_latch@0x021BB838@ */ ECIPP_ALIGNMENT_FLOAT32_IEEE 10000000000 Compu_IDENTITY -10000000000 10000000000 PHYS_UNIT "ms" /end CHARACTERISTIC
/begin CHARACTERISTIC FPfl_WTRIN_detect "FPrm_latch(214)" VALUE 0x00160370 /* @ECU_Address@FPrm_latch@0x021BB358@ */ ECIPP_ALIGNMENT_FLOAT32_IEEE 10000000000 Compu_IDENTITY -10000000000 10000000000 PHYS_UNIT "ms" /end CHARACTERISTIC
/begin CHARACTERISTIC FPfl_XEGOi_OOR "FPrm_latch(631)" VALUE 0x001609F4 /* @ECU_Address@FPrm_latch@0x021BB9DC@ */ ECIPP_ALIGNMENT_FLOAT32_IEEE 10000000000 Compu_IDENTITY -10000000000 10000000000 PHYS_UNIT "ms" /end CHARACTERISTIC
/begin CHARACTERISTIC FPfu_UGF4_drifttl2 "FPrm_unlatch(469)" VALUE 0x00161230 /* @ECU_Address@FPrm_unlatch@0x021BD754@ */ ECIPP_ALIGNMENT_FLOAT32_IEEE 10000000000 Compu_IDENTITY -10000000000 10000000000 PHYS_UNIT "ms" /end CHARACTERISTIC
/begin CHARACTERISTIC FPfu_UGF4_drifttol "FPrm_unlatch(468)" VALUE 0x0016122C /* @ECU_Address@FPrm_unlatch@0x021BD750@ */ ECIPP_ALIGNMENT_FLOAT32_IEEE 10000000000 Compu_IDENTITY -10000000000 10000000000 PHYS_UNIT "ms" /end CHARACTERISTIC
/begin CHARACTERISTIC FPfu_UGF4_Hv_hi "FPrm_unlatch(470)" VALUE 0x00161234 /* @ECU_Address@FPrm_unlatch@0x021BD758@ */ ECIPP_ALIGNMENT_FLOAT32_IEEE 10000000000 Compu_IDENTITY -10000000000 10000000000 PHYS_UNIT "ms" /end CHARACTERISTIC
/begin CHARACTERISTIC FPfu_UGF4_internal "FPrm_unlatch(466)" VALUE 0x00161224 /* @ECU_Address@FPrm_unlatch@0x021BD748@ */ ECIPP_ALIGNMENT_FLOAT32_IEEE 10000000000 Compu_IDENTITY -10000000000 10000000000 PHYS_UNIT "ms" /end CHARACTERISTIC
/begin CHARACTERISTIC FPfu_UGF4_lowsupply "FPrm_unlatch(467)" VALUE 0x00161228 /* @ECU_Address@FPrm_unlatch@0x021BD74C@ */ ECIPP_ALIGNMENT_FLOAT32_IEEE 10000000000 Compu_IDENTITY -10000000000 10000000000 PHYS_UNIT "ms" /end CHARACTERISTIC
/begin CHARACTERISTIC FPfu_UGF4_R_hi "FPrm_unlatch(471)" VALUE 0x00161238 /* @ECU_Address@FPrm_unlatch@0x021BD75C@ */ ECIPP_ALIGNMENT_FLOAT32_IEEE 10000000000 Compu_IDENTITY -10000000000 10000000000 PHYS_UNIT "ms" /end CHARACTERISTIC
/begin CHARACTERISTIC FPfu_UGF4_SR_hi "FPrm_unlatch(474)" VALUE 0x00161244 /* @ECU_Address@FPrm_unlatch@0x021BD768@ */ ECIPP_ALIGNMENT_FLOAT32_IEEE 10000000000 Compu_IDENTITY -10000000000 10000000000 PHYS_UNIT "ms" /end CHARACTERISTIC
/begin CHARACTERISTIC FPfu_UGF4_SR_slow "FPrm_unlatch(473)" VALUE 0x00161240 /* @ECU_Address@FPrm_unlatch@0x021BD764@ */ ECIPP_ALIGNMENT_FLOAT32_IEEE 10000000000 Compu_IDENTITY -10000000000 10000000000 PHYS_UNIT "ms" /end CHARACTERISTIC
/begin CHARACTERISTIC FPfu_UGF4_Sv_hi "FPrm_unlatch(472)" VALUE 0x0016123C /* @ECU_Address@FPrm_unlatch@0x021BD760@ */ ECIPP_ALIGNMENT_FLOAT32_IEEE 10000000000 Compu_IDENTITY -10000000000 10000000000 PHYS_UNIT "ms" /end CHARACTERISTIC
/begin CHARACTERISTIC FPfu_V_max "FPrm_unlatch(14)" VALUE 0x00160B14 /* @ECU_Address@FPrm_unlatch@0x021BD038@ */ ECIPP_ALIGNMENT_FLOAT32_IEEE 10000000000 Compu_IDENTITY -10000000000 10000000000 PHYS_UNIT "ms" /end CHARACTERISTIC
/begin CHARACTERISTIC FPfu_V_min "FPrm_unlatch(15)" VALUE 0x00160B18 /* @ECU_Address@FPrm_unlatch@0x021BD03C@ */ ECIPP_ALIGNMENT_FLOAT32_IEEE 10000000000 Compu_IDENTITY -10000000000 10000000000 PHYS_UNIT "ms" /end CHARACTERISTIC
/begin CHARACTERISTIC FPfu_VE5_max "FPrm_unlatch(16)" VALUE 0x00160B1C /* @ECU_Address@FPrm_unlatch@0x021BD040@ */ ECIPP_ALIGNMENT_FLOAT32_IEEE 10000000000 Compu_IDENTITY -10000000000 10000000000 PHYS_UNIT "ms" /end CHARACTERISTIC
/begin CHARACTERISTIC FPfu_VE5_min "FPrm_unlatch(17)" VALUE 0x00160B20 /* @ECU_Address@FPrm_unlatch@0x021BD044@ */ ECIPP_ALIGNMENT_FLOAT32_IEEE 10000000000 Compu_IDENTITY -10000000000 10000000000 PHYS_UNIT "ms" /end CHARACTERISTIC
/begin CHARACTERISTIC FPfu_VE5ab_OOR "FPrm_unlatch(143)" VALUE 0x00160D18 /* @ECU_Address@FPrm_unlatch@0x021BD23C@ */ ECIPP_ALIGNMENT_FLOAT32_IEEE 10000000000 Compu_IDENTITY -10000000000 10000000000 PHYS_UNIT "ms" /end CHARACTERISTIC
/begin CHARACTERISTIC FPfu_VE5b_max "FPrm_unlatch(141)" VALUE 0x00160D10 /* @ECU_Address@FPrm_unlatch@0x021BD234@ */ ECIPP_ALIGNMENT_FLOAT32_IEEE 10000000000 Compu_IDENTITY -10000000000 10000000000 PHYS_UNIT "ms" /end CHARACTERISTIC
/begin CHARACTERISTIC FPfu_VE5b_min "FPrm_unlatch(142)" VALUE 0x00160D14 /* @ECU_Address@FPrm_unlatch@0x021BD238@ */ ECIPP_ALIGNMENT_FLOAT32_IEEE 10000000000 Compu_IDENTITY -10000000000 10000000000 PHYS_UNIT "ms" /end CHARACTERISTIC
/begin CHARACTERISTIC FPfu_VE5c_max "FPrm_unlatch(386)" VALUE 0x001610E4 /* @ECU_Address@FPrm_unlatch@0x021BD608@ */ ECIPP_ALIGNMENT_FLOAT32_IEEE 10000000000 Compu_IDENTITY -10000000000 10000000000 PHYS_UNIT "ms" /end CHARACTERISTIC
/begin CHARACTERISTIC FPfu_VE5c_min "FPrm_unlatch(387)" VALUE 0x001610E8 /* @ECU_Address@FPrm_unlatch@0x021BD60C@ */ ECIPP_ALIGNMENT_FLOAT32_IEEE 10000000000 Compu_IDENTITY -10000000000 10000000000 PHYS_UNIT "ms" /end CHARACTERISTIC
/begin CHARACTERISTIC FPfu_WGP_maxv "FPrm_unlatch(101)" VALUE 0x00160C70 /* @ECU_Address@FPrm_unlatch@0x021BD194@ */ ECIPP_ALIGNMENT_FLOAT32_IEEE 10000000000 Compu_IDENTITY -10000000000 10000000000 PHYS_UNIT "ms" /end CHARACTERISTIC
/begin CHARACTERISTIC FPfu_WGP_minv "FPrm_unlatch(102)" VALUE 0x00160C74 /* @ECU_Address@FPrm_unlatch@0x021BD198@ */ ECIPP_ALIGNMENT_FLOAT32_IEEE 10000000000 Compu_IDENTITY -10000000000 10000000000 PHYS_UNIT "ms" /end CHARACTERISTIC
/begin CHARACTERISTIC FPfu_WGPerr_neg "FPrm_unlatch(527)" VALUE 0x00161318 /* @ECU_Address@FPrm_unlatch@0x021BD83C@ */ ECIPP_ALIGNMENT_FLOAT32_IEEE 10000000000 Compu_IDENTITY -10000000000 10000000000 PHYS_UNIT "ms" /end CHARACTERISTIC
/begin CHARACTERISTIC FPfu_WGPerr_pos "FPrm_unlatch(526)" VALUE 0x00161314 /* @ECU_Address@FPrm_unlatch@0x021BD838@ */ ECIPP_ALIGNMENT_FLOAT32_IEEE 10000000000 Compu_IDENTITY -10000000000 10000000000 PHYS_UNIT "ms" /end CHARACTERISTIC
/begin CHARACTERISTIC FPfu_WTRIN_detect "FPrm_unlatch(214)" VALUE 0x00160E34 /* @ECU_Address@FPrm_unlatch@0x021BD358@ */ ECIPP_ALIGNMENT_FLOAT32_IEEE 10000000000 Compu_IDENTITY -10000000000 10000000000 PHYS_UNIT "ms" /end CHARACTERISTIC
/begin CHARACTERISTIC FPfu_XEGOi_OOR "FPrm_unlatch(631)" VALUE 0x001614B8 /* @ECU_Address@FPrm_unlatch@0x021BD9DC@ */ ECIPP_ALIGNMENT_FLOAT32_IEEE 10000000000 Compu_IDENTITY -10000000000 10000000000 PHYS_UNIT "ms" /end CHARACTERISTIC
/begin GROUP UGF4_drifttl2_EC_Fault "UEGO4 drift is out-of-tolerance - level 2"
 /begin REF_CHARACTERISTIC FCdc4_UGF4_drifttl2 FCdtc_UGF4_drifttl2 FCfmi_UGF4_drifttl2 FCftb_UGF4_drifttl2 FCspn_UGF4_drifttl2 FPfl_UGF4_drifttl2 FPfu_UGF4_drifttl2 FPnd_UGF4_drifttl2 FPsvr_UGF4_drifttl2 FPsw_ext1_UGF4_drifttl2 FPsw_UGF4_drifttl2 /end REF_CHARACTERISTIC
/end GROUP
/begin GROUP UGF4_drifttol_EC_Fault "UEGO4 drift is out-of-tolerance"
 /begin REF_CHARACTERISTIC FCdc4_UGF4_drifttol FCdtc_UGF4_drifttol FCfmi_UGF4_drifttol FCftb_UGF4_drifttol FCspn_UGF4_drifttol FPfl_UGF4_drifttol FPfu_UGF4_drifttol FPnd_UGF4_drifttol FPsvr_UGF4_drifttol FPsw_ext1_UGF4_drifttol FPsw_UGF4_drifttol /end REF_CHARACTERISTIC
/end GROUP
/begin GROUP UGF4_Hv_hi_EC_Fault "UEGO4 heater supply high voltage"
 /begin REF_CHARACTERISTIC FCdc4_UGF4_Hv_hi FCdtc_UGF4_Hv_hi FCfmi_UGF4_Hv_hi FCftb_UGF4_Hv_hi FCspn_UGF4_Hv_hi FPfl_UGF4_Hv_hi FPfu_UGF4_Hv_hi FPnd_UGF4_Hv_hi FPsvr_UGF4_Hv_hi FPsw_ext1_UGF4_Hv_hi FPsw_UGF4_Hv_hi /end REF_CHARACTERISTIC
/end GROUP
/begin GROUP UGF4_internal_EC_Fault "UEGO4 internal processor fault"
 /begin REF_CHARACTERISTIC FCdc4_UGF4_internal FCdtc_UGF4_internal FCfmi_UGF4_internal FCftb_UGF4_internal FCspn_UGF4_internal FPfl_UGF4_internal FPfu_UGF4_internal FPnd_UGF4_internal FPsvr_UGF4_internal FPsw_ext1_UGF4_internal FPsw_UGF4_internal /end REF_CHARACTERISTIC
/end GROUP
/begin GROUP UGF4_lowsupply_EC_Fault "UEGO4 internal supply voltage low"
 /begin REF_CHARACTERISTIC FCdc4_UGF4_lowsupply FCdtc_UGF4_lowsupply FCfmi_UGF4_lowsupply FCftb_UGF4_lowsupply FCspn_UGF4_lowsupply FPfl_UGF4_lowsupply FPfu_UGF4_lowsupply FPnd_UGF4_lowsupply FPsvr_UGF4_lowsupply FPsw_ext1_UGF4_lowsupply FPsw_UGF4_lowsupply /end REF_CHARACTERISTIC
/end GROUP
/begin GROUP UGF4_R_hi_EC_Fault "UEGO4 cal resistor voltage high"
 /begin REF_CHARACTERISTIC FCdc4_UGF4_R_hi FCdtc_UGF4_R_hi FCfmi_UGF4_R_hi FCftb_UGF4_R_hi FCspn_UGF4_R_hi FPfl_UGF4_R_hi FPfu_UGF4_R_hi FPnd_UGF4_R_hi FPsvr_UGF4_R_hi FPsw_ext1_UGF4_R_hi FPsw_UGF4_R_hi /end REF_CHARACTERISTIC
/end GROUP
/begin GROUP UGF4_SR_hi_EC_Fault "UEGO4 sense cell impedance high"
 /begin REF_CHARACTERISTIC FCdc4_UGF4_SR_hi FCdtc_UGF4_SR_hi FCfmi_UGF4_SR_hi FCftb_UGF4_SR_hi FCspn_UGF4_SR_hi FPfl_UGF4_SR_hi FPfu_UGF4_SR_hi FPnd_UGF4_SR_hi FPsvr_UGF4_SR_hi FPsw_ext1_UGF4_SR_hi FPsw_UGF4_SR_hi /end REF_CHARACTERISTIC
/end GROUP
/begin GROUP UGF4_SR_slow_EC_Fault "UEGO4 sense cell slow to warm up"
 /begin REF_CHARACTERISTIC FCdc4_UGF4_SR_slow FCdtc_UGF4_SR_slow FCfmi_UGF4_SR_slow FCftb_UGF4_SR_slow FCspn_UGF4_SR_slow FPfl_UGF4_SR_slow FPfu_UGF4_SR_slow FPnd_UGF4_SR_slow FPsvr_UGF4_SR_slow FPsw_ext1_UGF4_SR_slow FPsw_UGF4_SR_slow /end REF_CHARACTERISTIC
/end GROUP
/begin GROUP UGF4_Sv_hi_EC_Fault "UEGO4 sense cell voltage high"
 /begin REF_CHARACTERISTIC FCdc4_UGF4_Sv_hi FCdtc_UGF4_Sv_hi FCfmi_UGF4_Sv_hi FCftb_UGF4_Sv_hi FCspn_UGF4_Sv_hi FPfl_UGF4_Sv_hi FPfu_UGF4_Sv_hi FPnd_UGF4_Sv_hi FPsvr_UGF4_Sv_hi FPsw_ext1_UGF4_Sv_hi FPsw_UGF4_Sv_hi /end REF_CHARACTERISTIC
/end GROUP
/begin GROUP V_max_EC_Fault "Voltage high"
 /begin REF_CHARACTERISTIC FCdc4_V_max FCdtc_V_max FCfmi_V_max FCftb_V_max FCspn_V_max FPfl_V_max FPfu_V_max FPnd_V_max FPsvr_V_max FPsw_ext1_V_max FPsw_V_max /end REF_CHARACTERISTIC
/end GROUP
/begin GROUP V_min_EC_Fault "Voltage low"
 /begin REF_CHARACTERISTIC FCdc4_V_min FCdtc_V_min FCfmi_V_min FCftb_V_min FCspn_V_min FPfl_V_min FPfu_V_min FPnd_V_min FPsvr_V_min FPsw_ext1_V_min FPsw_V_min /end REF_CHARACTERISTIC
/end GROUP
/begin GROUP VE5_max_EC_Fault "5VE1 high voltage"
 /begin REF_CHARACTERISTIC FCdc4_VE5_max FCdtc_VE5_max FCfmi_VE5_max FCftb_VE5_max FCspn_VE5_max FPfl_VE5_max FPfu_VE5_max FPnd_VE5_max FPsvr_VE5_max FPsw_ext1_VE5_max FPsw_VE5_max /end REF_CHARACTERISTIC
/end GROUP
/begin GROUP VE5_min_EC_Fault "5VE1 low voltage"
 /begin REF_CHARACTERISTIC FCdc4_VE5_min FCdtc_VE5_min FCfmi_VE5_min FCftb_VE5_min FCspn_VE5_min FPfl_VE5_min FPfu_VE5_min FPnd_VE5_min FPsvr_VE5_min FPsw_ext1_VE5_min FPsw_VE5_min /end REF_CHARACTERISTIC
/end GROUP
/begin GROUP VE5ab_OOR_EC_Fault "5VE1/2 simultaneous out-of-range"
 /begin REF_CHARACTERISTIC FCdc4_VE5ab_OOR FCdtc_VE5ab_OOR FCfmi_VE5ab_OOR FCftb_VE5ab_OOR FCspn_VE5ab_OOR FPfl_VE5ab_OOR FPfu_VE5ab_OOR FPnd_VE5ab_OOR FPsvr_VE5ab_OOR FPsw_ext1_VE5ab_OOR FPsw_VE5ab_OOR /end REF_CHARACTERISTIC
/end GROUP
/begin GROUP VE5b_max_EC_Fault "5VE2 high voltage"
 /begin REF_CHARACTERISTIC FCdc4_VE5b_max FCdtc_VE5b_max FCfmi_VE5b_max FCftb_VE5b_max FCspn_VE5b_max FPfl_VE5b_max FPfu_VE5b_max FPnd_VE5b_max FPsvr_VE5b_max FPsw_ext1_VE5b_max FPsw_VE5b_max /end REF_CHARACTERISTIC
/end GROUP
/begin GROUP VE5b_min_EC_Fault "5VE2 low voltage"
 /begin REF_CHARACTERISTIC FCdc4_VE5b_min FCdtc_VE5b_min FCfmi_VE5b_min FCftb_VE5b_min FCspn_VE5b_min FPfl_VE5b_min FPfu_VE5b_min FPnd_VE5b_min FPsvr_VE5b_min FPsw_ext1_VE5b_min FPsw_VE5b_min /end REF_CHARACTERISTIC
/end GROUP
/begin GROUP VE5c_max_EC_Fault "5VE3 high voltage"
 /begin REF_CHARACTERISTIC FCdc4_VE5c_max FCdtc_VE5c_max FCfmi_VE5c_max FCftb_VE5c_max FCspn_VE5c_max FPfl_VE5c_max FPfu_VE5c_max FPnd_VE5c_max FPsvr_VE5c_max FPsw_ext1_VE5c_max FPsw_VE5c_max /end REF_CHARACTERISTIC
/end GROUP
/begin GROUP VE5c_min_EC_Fault "5VE3 low voltage"
 /begin REF_CHARACTERISTIC FCdc4_VE5c_min FCdtc_VE5c_min FCfmi_VE5c_min FCftb_VE5c_min FCspn_VE5c_min FPfl_VE5c_min FPfu_VE5c_min FPnd_VE5c_min FPsvr_VE5c_min FPsw_ext1_VE5c_min FPsw_VE5c_min /end REF_CHARACTERISTIC
/end GROUP
/begin GROUP WGP_maxv_EC_Fault "WGP high voltage or control pressure too high"
 /begin REF_CHARACTERISTIC FCdc4_WGP_maxv FCdtc_WGP_maxv FCfmi_WGP_maxv FCftb_WGP_maxv FCspn_WGP_maxv FPfl_WGP_maxv FPfu_WGP_maxv FPnd_WGP_maxv FPsvr_WGP_maxv FPsw_ext1_WGP_maxv FPsw_WGP_maxv /end REF_CHARACTERISTIC
/end GROUP
/begin GROUP WGP_minv_EC_Fault "WGP low voltage"
 /begin REF_CHARACTERISTIC FCdc4_WGP_minv FCdtc_WGP_minv FCfmi_WGP_minv FCftb_WGP_minv FCspn_WGP_minv FPfl_WGP_minv FPfu_WGP_minv FPnd_WGP_minv FPsvr_WGP_minv FPsw_ext1_WGP_minv FPsw_WGP_minv /end REF_CHARACTERISTIC
/end GROUP
/begin GROUP WGPerr_neg_EC_Fault "Unable to reach lower WGP"
 /begin REF_CHARACTERISTIC FCdc4_WGPerr_neg FCdtc_WGPerr_neg FCfmi_WGPerr_neg FCftb_WGPerr_neg FCspn_WGPerr_neg FPfl_WGPerr_neg FPfu_WGPerr_neg FPnd_WGPerr_neg FPsvr_WGPerr_neg FPsw_ext1_WGPerr_neg FPsw_WGPerr_neg /end REF_CHARACTERISTIC
/end GROUP
/begin GROUP WGPerr_pos_EC_Fault "Unable to reach higher WGP"
 /begin REF_CHARACTERISTIC FCdc4_WGPerr_pos FCdtc_WGPerr_pos FCfmi_WGPerr_pos FCftb_WGPerr_pos FCspn_WGPerr_pos FPfl_WGPerr_pos FPfu_WGPerr_pos FPnd_WGPerr_pos FPsvr_WGPerr_pos FPsw_ext1_WGPerr_pos FPsw_WGPerr_pos /end REF_CHARACTERISTIC
/end GROUP
/begin GROUP WTRIN_detect_EC_Fault "Water Intrusion Detection"
 /begin REF_CHARACTERISTIC FCdc4_WTRIN_detect FCdtc_WTRIN_detect FCfmi_WTRIN_detect FCftb_WTRIN_detect FCspn_WTRIN_detect FPfl_WTRIN_detect FPfu_WTRIN_detect FPnd_WTRIN_detect FPsvr_WTRIN_detect FPsw_ext1_WTRIN_detect FPsw_WTRIN_detect /end REF_CHARACTERISTIC
/end GROUP
/begin GROUP XEGOi_OOR_EC_Fault "Pre-catalyst O2 sensor out of range"
 /begin REF_CHARACTERISTIC FCdc4_XEGOi_OOR FCdtc_XEGOi_OOR FCfmi_XEGOi_OOR FCftb_XEGOi_OOR FCspn_XEGOi_OOR FPfl_XEGOi_OOR FPfu_XEGOi_OOR FPnd_XEGOi_OOR FPsvr_XEGOi_OOR FPsw_ext1_XEGOi_OOR FPsw_XEGOi_OOR /end REF_CHARACTERISTIC
/end GROUP
/begin GROUP EC__Faults "Diagnostic Faults" ROOT
 /begin SUB_GROUP accel_x_max_EC_Fault accel_x_min_EC_Fault accel_y_max_EC_Fault accel_y_min_EC_Fault accel_z_max_EC_Fault accel_z_min_EC_Fault ADIG1_max_EC_Fault ADIG1_min_EC_Fault ADIG10_max_EC_Fault ADIG10_min_EC_Fault ADIG11_max_EC_Fault ADIG11_min_EC_Fault ADIG12_max_EC_Fault ADIG12_min_EC_Fault ADIG13_max_EC_Fault ADIG13_min_EC_Fault ADIG14_max_EC_Fault ADIG14_min_EC_Fault ADIG15_max_EC_Fault ADIG15_min_EC_Fault ADIG16_max_EC_Fault ADIG16_min_EC_Fault ADIG17_max_EC_Fault ADIG17_min_EC_Fault ADIG18_max_EC_Fault ADIG18_min_EC_Fault ADIG19_max_EC_Fault ADIG19_min_EC_Fault ADIG2_max_EC_Fault ADIG2_min_EC_Fault ADIG20_max_EC_Fault ADIG20_min_EC_Fault ADIG21_max_EC_Fault ADIG21_min_EC_Fault ADIG22_max_EC_Fault ADIG22_min_EC_Fault ADIG23_max_EC_Fault ADIG23_min_EC_Fault ADIG24_max_EC_Fault ADIG24_min_EC_Fault ADIG25_max_EC_Fault ADIG25_min_EC_Fault ADIG3_max_EC_Fault ADIG3_min_EC_Fault ADIG4_max_EC_Fault ADIG4_min_EC_Fault ADIG5_max_EC_Fault ADIG5_min_EC_Fault ADIG6_max_EC_Fault ADIG6_min_EC_Fault ADIG7_max_EC_Fault ADIG7_min_EC_Fault ADIG8_max_EC_Fault ADIG8_min_EC_Fault ADIG9_max_EC_Fault ADIG9_min_EC_Fault ADloss_EC_Fault AFILT_dP_high_EC_Fault AL_hi_EC_Fault AL_lo_EC_Fault ALLP_hi_EC_Fault ALLP_lo_EC_Fault ALNG_hi_EC_Fault ALNG_lo_EC_Fault APD1_max_EC_Fault APD1_min_EC_Fault APD2_max_EC_Fault APD2_min_EC_Fault APD3_max_EC_Fault APD3_min_EC_Fault APS1_max_EC_Fault APS1_min_EC_Fault APS12_OOR_EC_Fault APS12pct_hi_EC_Fault APS12pct_lo_EC_Fault APS2_max_EC_Fault APS2_min_EC_Fault APSerr_neg_EC_Fault APSerr_pos_EC_Fault APU1_max_EC_Fault APU1_min_EC_Fault APU2_max_EC_Fault APU2_min_EC_Fault APU3_max_EC_Fault APU3_min_EC_Fault APUD1_max_EC_Fault APUD1_min_EC_Fault APUD10_max_EC_Fault APUD10_min_EC_Fault APUD11_max_EC_Fault APUD11_min_EC_Fault APUD12_max_EC_Fault APUD12_min_EC_Fault APUD13_max_EC_Fault APUD13_min_EC_Fault APUD14_max_EC_Fault APUD14_min_EC_Fault APUD15_max_EC_Fault APUD15_min_EC_Fault APUD16_max_EC_Fault APUD16_min_EC_Fault APUD17_max_EC_Fault APUD17_min_EC_Fault APUD18_max_EC_Fault APUD18_min_EC_Fault APUD19_max_EC_Fault APUD19_min_EC_Fault APUD2_max_EC_Fault APUD2_min_EC_Fault APUD20_max_EC_Fault APUD20_min_EC_Fault APUD21_max_EC_Fault APUD21_min_EC_Fault APUD22_max_EC_Fault APUD22_min_EC_Fault APUD23_max_EC_Fault APUD23_min_EC_Fault APUD24_max_EC_Fault APUD24_min_EC_Fault APUD25_max_EC_Fault APUD25_min_EC_Fault APUD3_max_EC_Fault APUD3_min_EC_Fault APUD4_max_EC_Fault APUD4_min_EC_Fault APUD5_max_EC_Fault APUD5_min_EC_Fault APUD6_max_EC_Fault APUD6_min_EC_Fault APUD7_max_EC_Fault APUD7_min_EC_Fault APUD8_max_EC_Fault APUD8_min_EC_Fault APUD9_max_EC_Fault APUD9_min_EC_Fault AWP_intF_EC_Fault BP_max_EC_Fault BP_min_EC_Fault BPS1_max_EC_Fault BPS1_min_EC_Fault BPS12_OOR_EC_Fault BPS12pct_hi_EC_Fault BPS12pct_lo_EC_Fault BPS2_max_EC_Fault BPS2_min_EC_Fault BPSerr_neg_EC_Fault BPSerr_pos_EC_Fault brake_gndshort_EC_Fault brake_pwrshort_EC_Fault bst_MAT_derate_actv_EC_Fault BstTIP_Hi_EC_Fault BstTIP_Lo_EC_Fault BstTIP_Lo2_EC_Fault BstTIP_slow_EC_Fault buzz_coilopen_EC_Fault buzz_coilshort_EC_Fault buzz_gndshort_EC_Fault CAC_eta_lo_EC_Fault cal_config_EC_Fault cam2loss_EC_Fault camloss_EC_Fault camnoise_EC_Fault CATdP_hi_EC_Fault CATdP_lo_EC_Fault CATout_OOR_EC_Fault CFV_FP_minv_EC_Fault CFV_FT_maxv_EC_Fault CFV_FT_minv_EC_Fault CFV_mdot_hi_EC_Fault CFV_mdot_lo_EC_Fault CFV_mdot_rms_hi_EC_Fault CFV_pwr_loss_EC_Fault CFV_RLV_fail_EC_Fault CFV_RLV_P_min_EC_Fault CHT_HiExp_EC_Fault CHT_HiExp2_EC_Fault CL_hi_EC_Fault CL_lo_EC_Fault CL_phi_hi_EC_Fault CL_phi_lo_EC_Fault CLLP_hi_EC_Fault CLLP_lo_EC_Fault CLNG_hi_EC_Fault CLNG_lo_EC_Fault CM_unresp_EC_Fault CMgsln_inact_EC_Fault CMLP_inact_EC_Fault CMNG_inact_EC_Fault COPfail_EC_Fault COT_hi_EC_Fault crkloss_EC_Fault crknever_EC_Fault crknoise_EC_Fault CVCS_discon_EC_Fault CVDS_discon_EC_Fault CVP1_hi_EC_Fault CVP1_lo_EC_Fault CVP2_hi_EC_Fault CVP2_lo_EC_Fault DBW_I_max_EC_Fault ECam_maxerr_EC_Fault ECL_low_EC_Fault ECT_AAT_dT_max_EC_Fault ECT_derate_actv_EC_Fault ECT_dT_max_EC_Fault ECT_EGRT_dT_max_EC_Fault ECT_EGT_dT_max_EC_Fault ECT_FT_dT_max_EC_Fault ECT_HiExp_EC_Fault ECT_HiExp2_EC_Fault ECT_IAT_dT_max_EC_Fault ECT_LoExp_EC_Fault ECT_LoExp2_EC_Fault ECT_maxv_EC_Fault ECT_minv_EC_Fault ECT_OILT_dT_max_EC_Fault ECT_TAUX_dT1_max_EC_Fault ECT_TAUX_dT2_max_EC_Fault ECT_TIAT_dT_max_EC_Fault EGO1_open_EC_Fault EGO2_open_EC_Fault EGO3_open_EC_Fault EGOH1_off_open_EC_Fault EGOH1_on_short_EC_Fault EGOH2_off_open_EC_Fault EGOH2_on_short_EC_Fault EGOH3_off_open_EC_Fault EGOH3_on_short_EC_Fault EGOH4_off_open_EC_Fault EGOH4_on_short_EC_Fault EGR_clr_eta_lo_EC_Fault EGR_clr_eta_lo2_EC_Fault EGR_deice_excess_EC_Fault EGR_offmin_excess_EC_Fault EGR_OOA_hi_EC_Fault EGR_OOA_lo_EC_Fault EGR_slowdec_EC_Fault EGR_slowinc_EC_Fault EGR_UEGOdP_hi_EC_Fault EGR_UEGOdP_lo_EC_Fault EGR_vlv_DC_lim_EC_Fault EGR_vlv_stuck_EC_Fault EGR_vlv_temp_hi_EC_Fault EGR_vlvCAN_commlost_EC_Fault EGR_vlvCAN_lowfunc_EC_Fault EGR_vlvCAN_nofunc_EC_Fault EGRdP_HiExp_EC_Fault EGRdP_LoExp_EC_Fault EGRdP_maxv_EC_Fault EGRdP_minv_EC_Fault EGRflow_HiExp_EC_Fault EGRflow_LoExp_EC_Fault EGRflow_LoExp2_EC_Fault EGRHP_maxv_EC_Fault EGRHP_minv_EC_Fault EGRHP_OOR_EC_Fault EGRO_postlk_EC_Fault EGRT_hi_EC_Fault EGRT_maxv_EC_Fault EGRT_minv_EC_Fault EGT_dig_Hi_EC_Fault EGT_maxv_EC_Fault EGT_minv_EC_Fault EMWT1_HiExp1_EC_Fault EMWT1_HiExp2_EC_Fault EMWT1_maxv_EC_Fault EMWT1_minv_EC_Fault envtech_AAT_inv_EC_Fault envtech_BP_inv_EC_Fault envtech_comm_EC_Fault envtech_general_EC_Fault envtech_RH_inv_EC_Fault envtech_RH_uns_EC_Fault ERCV_speed_OOR_EC_Fault ERWT1_HiExp1_EC_Fault ERWT1_HiExp2_EC_Fault ERWT1_maxv_EC_Fault ERWT1_minv_EC_Fault F1OOR_F2IVS_EC_Fault F2OOR_F1IVS_EC_Fault FCoolH2O_lo_EC_Fault FIMP_pct_high_EC_Fault FIP_LoExp_EC_Fault flash_fail_EC_Fault FP_high_EC_Fault FP_low_EC_Fault FP_maxv_EC_Fault FP_minv_EC_Fault FP2_high_EC_Fault FP2_low_EC_Fault FP2_maxv_EC_Fault FP2_minv_EC_Fault FPD_off_hi_EC_Fault FPD_on_lo_EC_Fault FPlo_derate_actv_EC_Fault FPlo_derate_excess_EC_Fault FPP_NeutLock_fail_EC_Fault FPP1_IVS_max_EC_Fault FPP1_IVS_min_EC_Fault FPP1_max_EC_Fault FPP1_min_EC_Fault FPP12_IVS_max_EC_Fault FPP12_IVS_min_EC_Fault FPP12_OOR_EC_Fault FPP12IVS_TSC1_EC_Fault FPP12MM_IVSMM_EC_Fault FPP12pct_hi_EC_Fault FPP12pct_lo_EC_Fault FPP2_IVS_max_EC_Fault FPP2_IVS_min_EC_Fault FPP2_max_EC_Fault FPP2_min_EC_Fault FPP2V_TSC1_EC_Fault FPrly_coilopen_EC_Fault FPrly_coilshort_EC_Fault FPrly_gndshort_EC_Fault FSO_post_TPS_phi_hi_EC_Fault FSO_TPS_phi_hi_EC_Fault FT_maxv_EC_Fault FT_minv_EC_Fault FTgasf_maxv_EC_Fault FTgasf_minv_EC_Fault GLOW_unit_fail_EC_Fault GLOW1_open_EC_Fault GLOW1_short_EC_Fault gov_ntrlock_fail_EC_Fault gyro_x_max_EC_Fault gyro_x_min_EC_Fault gyro_y_max_EC_Fault gyro_y_min_EC_Fault gyro_z_max_EC_Fault gyro_z_min_EC_Fault HBA_I_max_EC_Fault HBB_I_max_EC_Fault HiDiagTemp_EC_Fault HWID_fail_EC_Fault IAC_gndshort_EC_Fault IAC_openshort_EC_Fault IAT_HiExp_EC_Fault IAT_HiExp2_EC_Fault IAT_maxv_EC_Fault IAT_minv_EC_Fault IBF_detected_EC_Fault ICam_maxerr_EC_Fault ICAVD1_mis_EC_Fault ICAVD1_miscat_EC_Fault Idle_SD_EC_Fault imu_general_EC_Fault imu_temp_max_EC_Fault imu_temp_min_EC_Fault IMVD_Ifb_hi_EC_Fault IMVD_Ifb_lo_EC_Fault INJD_boost_lo_EC_Fault INJD_HS_Ihi_EC_Fault INJD_HW_int_EC_Fault INJD_LS_Ihi_EC_Fault INJD_off_lo_EC_Fault INJD_on_hi_EC_Fault interrupt_EC_Fault J1939_AAT_err_loss_EC_Fault J1939_addr2Fail_EC_Fault J1939_addr3Fail_EC_Fault J1939_addrFail_EC_Fault J1939_ETC_loss_EC_Fault J1939_ETC_loss2_EC_Fault J1939_PGN_tout_EC_Fault J1939_PGN_tout10_EC_Fault J1939_PGN_tout2_EC_Fault J1939_PGN_tout3_EC_Fault J1939_PGN_tout4_EC_Fault J1939_PGN_tout5_EC_Fault J1939_PGN_tout6_EC_Fault J1939_PGN_tout7_EC_Fault J1939_PGN_tout8_EC_Fault J1939_PGN_tout9_EC_Fault J1939_RS_err_loss_EC_Fault J1939_RSsetpt_loss_EC_Fault J1939_Rx2Fail_EC_Fault J1939_Rx3Fail_EC_Fault J1939_RxFail_EC_Fault J1939_SD_rq_EC_Fault J1939_TSC1_chksum_EC_Fault J1939_TSC1_cntr_EC_Fault J1939_TSC1_loss_EC_Fault J1939_Tx2Fail_EC_Fault J1939_Tx3Fail_EC_Fault J1939_TxFail_EC_Fault KNK_max_EC_Fault KNK_min_EC_Fault KNK_retardlmt_EC_Fault KNK_retardlmt2_EC_Fault LOD_flk_EC_Fault LOD_FROmax_EC_Fault LOD_slk_EC_Fault LowCLTemp_EC_Fault LowDiagTemp_EC_Fault LowOperTemp_EC_Fault MAP_HiExp_EC_Fault MAP_max_EC_Fault MAP_minv_EC_Fault MFA_ctout_EC_Fault MFA_hi_flow_EC_Fault MFA_hsd_comm_EC_Fault MFA_intF_circ_EC_Fault MFA_intF_DP_V_max_EC_Fault MFA_intF_DP_V_min_EC_Fault MFA_intF_DSPress_V_max_EC_Fault MFA_intF_DSPress_V_min_EC_Fault MFA_intF_FTemp_V_max_EC_Fault MFA_intF_FTemp_V_min_EC_Fault MFA_intF_general_EC_Fault MFA_intF_Tposerr_n_EC_Fault MFA_intF_Tposerr_p_EC_Fault MFA_intF_USPress_V_max_EC_Fault MFA_intF_USPress_V_min_EC_Fault MFA_intF_Vbat_max_EC_Fault MFA_intF_Vbat_min_EC_Fault MFA_lo_flow_EC_Fault MFG_ctout_EC_Fault MFG_hi_flow_EC_Fault MFG_hsd_comm_EC_Fault MFG_intF_circ_EC_Fault MFG_intF_DP_V_max_EC_Fault MFG_intF_DP_V_min_EC_Fault MFG_intF_DPzVolt_V_max_EC_Fault MFG_intF_DPzVolt_V_min_EC_Fault MFG_intF_DSPress_V_max_EC_Fault MFG_intF_DSPress_V_min_EC_Fault MFG_intF_FTemp_V_max_EC_Fault MFG_intF_FTemp_V_min_EC_Fault MFG_intF_general_EC_Fault MFG_intF_Tposerr_n_EC_Fault MFG_intF_Tposerr_p_EC_Fault MFG_intF_USPress_V_max_EC_Fault MFG_intF_USPress_V_min_EC_Fault MFG_intF_Vbat_max_EC_Fault MFG_intF_Vbat_min_EC_Fault MFG_lo_flow_EC_Fault MFG_RLV_fail_EC_Fault MIL_coilopen_EC_Fault MIL_coilshort_EC_Fault MIL_gndshort_EC_Fault MJ_comm_tout_EC_Fault MJ_intF_act_EC_Fault MJ_intF_az_EC_Fault MJ_intF_circ_EC_Fault MJ_intF_comm_EC_Fault MJ_intF_Vhi_EC_Fault MJ_intF_Vlo_EC_Fault MJ_Pe_HiExp_EC_Fault MJ_Pe_LoExp_EC_Fault MJ2_comm_tout_EC_Fault MJ2_intF_act_EC_Fault MJ2_intF_circ_EC_Fault MJ2_intF_comm_EC_Fault MJ2_intF_Vhi_EC_Fault MJ2_intF_Vlo_EC_Fault MJ2_Pe_HiExp_EC_Fault MJ2_Pe_LoExp_EC_Fault NOx_hi_EC_Fault OilP_hiP_EC_Fault OilP_loP_EC_Fault OilP_maxV_EC_Fault OilP_minV_EC_Fault OILP_test_EC_Fault OilP2_loP_EC_Fault OILTL_loss_EC_Fault OILTL_Lvl_lo_EC_Fault OILTL_Lvl_OOR_EC_Fault OILTL_T_hi_EC_Fault OILTL_T_OOR_EC_Fault OILTL_V_OOR_EC_Fault PAUX_dP1_max_EC_Fault PAUX_dP1_min_EC_Fault PAUX_dP2_max_EC_Fault PAUX_dP2_min_EC_Fault PAUX1_max_EC_Fault PAUX1_min_EC_Fault PAUX2_max_EC_Fault PAUX2_min_EC_Fault PAUX3_max_EC_Fault PAUX3_min_EC_Fault PAUX4_max_EC_Fault PAUX4_min_EC_Fault PPEG_BP_EC_Fault PPEG_CVP1_EC_Fault PPEG_CVP2_EC_Fault PPEG_EBP_EC_Fault PPEG_EGRdP_EC_Fault PPEG_EGRHP_EC_Fault PPEG_EGRLP_EC_Fault PPEG_EGRwrP_EC_Fault PPEG_MAP_EC_Fault PPEG_TIP_EC_Fault PWM1_off_loVf_EC_Fault PWM1_on_hiVf_EC_Fault PWM10_off_loVf_EC_Fault PWM10_on_hiVf_EC_Fault PWM11_off_loVf_EC_Fault PWM11_on_hiVf_EC_Fault PWM12_off_loVf_EC_Fault PWM12_on_hiVf_EC_Fault PWM13_off_loVf_EC_Fault PWM13_on_hiVf_EC_Fault PWM14_off_loVf_EC_Fault PWM14_on_hiVf_EC_Fault PWM15_off_loVf_EC_Fault PWM15_on_hiVf_EC_Fault PWM16_off_loVf_EC_Fault PWM16_on_hiVf_EC_Fault PWM17_off_loVf_EC_Fault PWM17_on_hiVf_EC_Fault PWM18_off_loVf_EC_Fault PWM18_on_hiVf_EC_Fault PWM19_off_loVf_EC_Fault PWM19_on_hiVf_EC_Fault PWM2_off_loVf_EC_Fault PWM2_on_hiVf_EC_Fault PWM20_off_loVf_EC_Fault PWM20_on_hiVf_EC_Fault PWM21_off_loVf_EC_Fault PWM21_on_hiVf_EC_Fault PWM22_off_loVf_EC_Fault PWM22_on_hiVf_EC_Fault PWM23_off_loVf_EC_Fault PWM23_on_hiVf_EC_Fault PWM3_off_loVf_EC_Fault PWM3_on_hiVf_EC_Fault PWM4_off_loVf_EC_Fault PWM4_on_hiVf_EC_Fault PWM5_off_loVf_EC_Fault PWM5_on_hiVf_EC_Fault PWM6_off_loVf_EC_Fault PWM6_on_hiVf_EC_Fault PWM7_off_loVf_EC_Fault PWM7_on_hiVf_EC_Fault PWM8_off_loVf_EC_Fault PWM8_on_hiVf_EC_Fault PWM9_off_loVf_EC_Fault PWM9_on_hiVf_EC_Fault PWMLO_off_loVf_EC_Fault PWMLO_on_hiVf_EC_Fault RAM_fail_EC_Fault relay_coilopen_EC_Fault relay_coilshort_EC_Fault relay_gndshort_EC_Fault relayoff_hiV_EC_Fault relayon_loV_EC_Fault rpm_hi_expected_EC_Fault rpmd_gov_lo_EC_Fault RS_discon_EC_Fault RS_hiV_EC_Fault RS_loss_EC_Fault RS_loV_EC_Fault RS485_bad_fmt_EC_Fault RS485_Rx_inact_EC_Fault RS485_Rx_noise_EC_Fault RS485_SD_rq_EC_Fault RTI1_EC_Fault RTI2_EC_Fault RTI3_EC_Fault SHIFT_FB_OOR_EC_Fault SHIFT_intcirc_fail_EC_Fault SHIFT_shift_fail_EC_Fault SL_fuel_EC_Fault SL_gov_EC_Fault SL_spk_EC_Fault slv_MAP_hi_OOA_EC_Fault slv_MAP_lo_OOA_EC_Fault SPK_int_fail_EC_Fault SPK1_IGBT_T_EC_Fault SPKD_coil_fail_EC_Fault SPKD_dw_hi_EC_Fault SPKD_dw_lo_EC_Fault SRVC_expired_EC_Fault SRVC_expired2_EC_Fault start_coilopen_EC_Fault start_coilshort_EC_Fault start_excess_EC_Fault start_gndshort_EC_Fault start_stuck_active_EC_Fault SubDiagTemp_EC_Fault tach_gndshort_EC_Fault tach_pwrshort_EC_Fault TAUX_dT1_max_EC_Fault TAUX_dT1_min_EC_Fault TAUX_dT2_max_EC_Fault TAUX_dT2_min_EC_Fault Taux1_derate_actv_EC_Fault TAUX1_max_EC_Fault TAUX1_min_EC_Fault Taux2_derate_actv_EC_Fault TAUX2_max_EC_Fault TAUX2_min_EC_Fault TAUX3_max_EC_Fault TAUX3_min_EC_Fault TAUX4_max_EC_Fault TAUX4_min_EC_Fault TEL_derate_actv_EC_Fault TEL_dis_EC_Fault TEL_intF_EC_Fault TEL_key_invalid_EC_Fault TEL_key_to_EC_Fault TEL_req_to_EC_Fault TEL_RPM_cmd_EC_Fault TEL_RPM_psv_EC_Fault TEL_shutdown_cmd_EC_Fault TEL_shutdown_psv_EC_Fault TEL_torq_cmd_EC_Fault TEL_torq_psv_EC_Fault TIP_act_EC_Fault TIP_maxv_EC_Fault TIP_minv_EC_Fault TPS1_max_EC_Fault TPS1_min_EC_Fault TPS12_OOR_EC_Fault TPS12pct_hi_EC_Fault TPS12pct_lo_EC_Fault TPS2_max_EC_Fault TPS2_min_EC_Fault TPSerr_neg_EC_Fault TPSerr_pos_EC_Fault TRANS_comm_EC_Fault TRANS_fuel_inh_EC_Fault TWCDiag_OSC_lo_EC_Fault UEGOH1_off_open_EC_Fault UEGOH1_on_short_EC_Fault UEGOH2_off_open_EC_Fault UEGOH2_on_short_EC_Fault UEGOH3_off_open_EC_Fault UEGOH3_on_short_EC_Fault UEGOH4_off_open_EC_Fault UEGOH4_on_short_EC_Fault UGF_Hv_hi_EC_Fault UGF_internal_EC_Fault UGF_lowsupply_EC_Fault UGF1_comm_lost_EC_Fault UGF1_drifttl2_EC_Fault UGF1_drifttol_EC_Fault UGF1_R_hi_EC_Fault UGF1_SR_hi_EC_Fault UGF1_SR_slow_EC_Fault UGF1_Sv_hi_EC_Fault UGF2_comm_lost_EC_Fault UGF2_drifttl2_EC_Fault UGF2_drifttol_EC_Fault UGF2_Hv_hi_EC_Fault UGF2_internal_EC_Fault UGF2_lowsupply_EC_Fault UGF2_R_hi_EC_Fault UGF2_SR_hi_EC_Fault UGF2_SR_slow_EC_Fault UGF2_Sv_hi_EC_Fault UGF3_comm_lost_EC_Fault UGF3_drifttl2_EC_Fault UGF3_drifttol_EC_Fault UGF3_Hv_hi_EC_Fault UGF3_internal_EC_Fault UGF3_lowsupply_EC_Fault UGF3_R_hi_EC_Fault UGF3_SR_hi_EC_Fault UGF3_SR_slow_EC_Fault UGF3_Sv_hi_EC_Fault UGF4_comm_lost_EC_Fault UGF4_drifttl2_EC_Fault UGF4_drifttol_EC_Fault UGF4_Hv_hi_EC_Fault UGF4_internal_EC_Fault UGF4_lowsupply_EC_Fault UGF4_R_hi_EC_Fault UGF4_SR_hi_EC_Fault UGF4_SR_slow_EC_Fault UGF4_Sv_hi_EC_Fault V_max_EC_Fault V_min_EC_Fault VE5_max_EC_Fault VE5_min_EC_Fault VE5ab_OOR_EC_Fault VE5b_max_EC_Fault VE5b_min_EC_Fault VE5c_max_EC_Fault VE5c_min_EC_Fault WGP_maxv_EC_Fault WGP_minv_EC_Fault WGPerr_neg_EC_Fault WGPerr_pos_EC_Fault WTRIN_detect_EC_Fault XEGOi_OOR_EC_Fault /end SUB_GROUP
/end GROUP
/end MODULE
/end PROJECT
