ASAP2_VERSION 1 61
/begin PROJECT Econtrols_4G "4G Test"
/begin HEADER "4G A2L Configuration" PROJECT_NO EControls4G /* config for version control */ VERSION "$Revision: 82130 $:" /* config for version control */ /end HEADER
/begin MODULE EControls_4G_SH2A "EControls 4G"
/begin MOD_COMMON "" DEPOSIT ABSOLUTE BYTE_ORDER MSB_FIRST /end MOD_COMMON
/* Define the Record Layouts */
/begin RECORD_LAYOUT ECIPP_ALIGNMENT_UBYTE FNC_VALUES 1 UBYTE COLUMN_DIR DIRECT /end RECORD_LAYOUT
/begin RECORD_LAYOUT ECIPP_ALIGNMENT_UWORD FNC_VALUES 1 UWORD COLUMN_DIR DIRECT /end RECORD_LAYOUT
/begin RECORD_LAYOUT ECIPP_ALIGNMENT_SWORD FNC_VALUES 1 SWORD COLUMN_DIR DIRECT /end RECORD_LAYOUT
/begin RECORD_LAYOUT ECIPP_Lookup_SWORD AXIS_PTS_X 1 SWORD INDEX_INCR DIRECT /end RECORD_LAYOUT
/begin RECORD_LAYOUT ECIPP_ALIGNMENT_ULONG FNC_VALUES 1 ULONG COLUMN_DIR DIRECT /end RECORD_LAYOUT
/begin RECORD_LAYOUT ECIPP_ALIGNMENT_FLOAT32_IEEE FNC_VALUES 1 FLOAT32_IEEE COLUMN_DIR DIRECT /end RECORD_LAYOUT
/begin CHARACTERISTIC ETHC_ena "ETHC control enable{ETHC_ena&0xff=0x00:Disabled}{ETHC_ena&0xff=0x01:Enabled}{ETHC_ena&0xff=0x02:Manual}" VALUE 0x00147d41 /* @ECU_Address@ETHC_ena@0x01000C50@ */ ECIPP_ALIGNMENT_UBYTE 255 ETHC_ena_COMPU_VTAB 0 255 BIT_MASK 0xff /end CHARACTERISTIC
/begin COMPU_METHOD ETHC_ena_COMPU_VTAB "Verbal Table" TAB_VERB "%.0" "list" COMPU_TAB_REF ETHC_ena_COMPU_VTAB_REF /end COMPU_METHOD
/begin COMPU_VTAB ETHC_ena_COMPU_VTAB_REF "Verbal Table" TAB_VERB 3 0x00 "Disabled" 0x01 "Enabled" 0x02 "Manual" DEFAULT_VALUE "UNKNOWN" /end COMPU_VTAB
/begin CHARACTERISTIC ETHC_cont_time "ETHC 100% time" VALUE 0x00146836 /* @ECU_Address@ETHC_cont_time@0x01000C68@ */ ECIPP_ALIGNMENT_UWORD 66 Compu_ETHC_cont_time 0 65.535 /end CHARACTERISTIC
/begin COMPU_METHOD Compu_ETHC_cont_time " " RAT_FUNC "%.3" "seconds" COEFFS 0 1000 0 0 0 1 /end COMPU_METHOD
/begin CHARACTERISTIC ETHC_period "ETHC pulsing period" VALUE 0x00146838 /* @ECU_Address@ETHC_period@0x01000C70@ */ ECIPP_ALIGNMENT_UWORD 65535 Compu_ETHC_period 0 65535 /end CHARACTERISTIC
/begin COMPU_METHOD Compu_ETHC_period " " RAT_FUNC "%.0" "ms" COEFFS 0 1 0 0 0 1 /end COMPU_METHOD
/begin CHARACTERISTIC ETHC_Kp "ETHC Kp" VALUE 0x001442ca /* @ECU_Address@ETHC_Kp@0x01000C78@ */ ECIPP_ALIGNMENT_SWORD 3200 Compu_ETHC_Kp -3200 3199.90234375 /end CHARACTERISTIC
/begin COMPU_METHOD Compu_ETHC_Kp " " RAT_FUNC "%.1" "% / deg F" COEFFS 0 10.24 0 0 0 1 /end COMPU_METHOD
/begin CHARACTERISTIC ETHC_Kd "ETHC Kd" VALUE 0x001442c8 /* @ECU_Address@ETHC_Kd@0x01000EF0@ */ ECIPP_ALIGNMENT_SWORD 6400 Compu_ETHC_Kd -6400 6399.8046875 /end CHARACTERISTIC
/begin COMPU_METHOD Compu_ETHC_Kd " " RAT_FUNC "%.1" "% / (deg F/sec)" COEFFS 0 5.12 0 0 0 1 /end COMPU_METHOD
/begin CHARACTERISTIC cfgout_RPMon "RPM_on" VALUE 0x0014951C /* @ECU_Address@cfgout_RPMon@0x010011A8@ */ ECIPP_ALIGNMENT_UWORD 65535 Compu_cfgout_RPMon 0 65535 /end CHARACTERISTIC
/begin COMPU_METHOD Compu_cfgout_RPMon " " RAT_FUNC "%.0" "rpm" COEFFS 0 1 0 0 0 1 /end COMPU_METHOD
/begin CHARACTERISTIC cfgout_MAPon "MAP_on" VALUE 0x0014951E /* @ECU_Address@cfgout_MAPon@0x010011B0@ */ ECIPP_ALIGNMENT_UWORD 256 Compu_cfgout_MAPon 0 255.99609375 /end CHARACTERISTIC
/begin COMPU_METHOD Compu_cfgout_MAPon " " RAT_FUNC "%.2" "psia" COEFFS 0 256 0 0 0 1 /end COMPU_METHOD
/begin CHARACTERISTIC cfgout_ECTon "ECT_on" VALUE 0x00149520 /* @ECU_Address@cfgout_ECTon@0x010011B8@ */ ECIPP_ALIGNMENT_UWORD 564 Compu_cfgout_ECTon -460 563.984375 /end CHARACTERISTIC
/begin COMPU_METHOD Compu_cfgout_ECTon " " RAT_FUNC "%.1" "deg F" COEFFS 0 64 29440 0 0 1 /end COMPU_METHOD
/begin CHARACTERISTIC cfgout_RPMoff "RPM_off" VALUE 0x00149534 /* @ECU_Address@cfgout_RPMoff@0x010011C0@ */ ECIPP_ALIGNMENT_UWORD 65535 Compu_cfgout_RPMoff 0 65535 /end CHARACTERISTIC
/begin COMPU_METHOD Compu_cfgout_RPMoff " " RAT_FUNC "%.0" "rpm" COEFFS 0 1 0 0 0 1 /end COMPU_METHOD
/begin CHARACTERISTIC cfgout_MAPoff "MAP_off" VALUE 0x00149536 /* @ECU_Address@cfgout_MAPoff@0x010011C8@ */ ECIPP_ALIGNMENT_UWORD 256 Compu_cfgout_MAPoff 0 255.99609375 /end CHARACTERISTIC
/begin COMPU_METHOD Compu_cfgout_MAPoff " " RAT_FUNC "%.2" "psia" COEFFS 0 256 0 0 0 1 /end COMPU_METHOD
/begin CHARACTERISTIC cfgout_ECToff "ECT_off" VALUE 0x00149538 /* @ECU_Address@cfgout_ECToff@0x010011D0@ */ ECIPP_ALIGNMENT_UWORD 564 Compu_cfgout_ECToff -460 563.984375 /end CHARACTERISTIC
/begin COMPU_METHOD Compu_cfgout_ECToff " " RAT_FUNC "%.1" "deg F" COEFFS 0 64 29440 0 0 1 /end COMPU_METHOD
/begin CHARACTERISTIC cfgout_RPMlon "RPM is{cfgout_RPMlon&0xff=0x00:Ignored}{cfgout_RPMlon&0xff=0x01:<}{cfgout_RPMlon&0xff=0x02:>}{cfgout_RPMlon&0xff=0x03:<=}{cfgout_RPMlon&0xff=0x04:>=}{cfgout_RPMlon&0xff=0x05:=}{cfgout_RPMlon&0xff=0x06:<>}" VALUE 0x00149504 /* @ECU_Address@cfgout_RPMlon@0x010011D8@ */ ECIPP_ALIGNMENT_UBYTE 255 cfgout_RPMlon_COMPU_VTAB 0 255 BIT_MASK 0xff /end CHARACTERISTIC
/begin COMPU_METHOD cfgout_RPMlon_COMPU_VTAB "Verbal Table" TAB_VERB "%.0" "list" COMPU_TAB_REF cfgout_RPMlon_COMPU_VTAB_REF /end COMPU_METHOD
/begin COMPU_VTAB cfgout_RPMlon_COMPU_VTAB_REF "Verbal Table" TAB_VERB 7 0x00 "Ignored" 0x01 "<" 0x02 ">" 0x03 "<=" 0x04 ">=" 0x05 "=" 0x06 "<>" DEFAULT_VALUE "UNKNOWN" /end COMPU_VTAB
/begin CHARACTERISTIC cfgout_MAPlon "and MAP is{cfgout_MAPlon&0xff=0x00:Ignored}{cfgout_MAPlon&0xff=0x01:<}{cfgout_MAPlon&0xff=0x02:>}{cfgout_MAPlon&0xff=0x03:<=}{cfgout_MAPlon&0xff=0x04:>=}{cfgout_MAPlon&0xff=0x05:=}{cfgout_MAPlon&0xff=0x06:<>}" VALUE 0x00149505 /* @ECU_Address@cfgout_MAPlon@0x010011E0@ */ ECIPP_ALIGNMENT_UBYTE 255 cfgout_MAPlon_COMPU_VTAB 0 255 BIT_MASK 0xff /end CHARACTERISTIC
/begin COMPU_METHOD cfgout_MAPlon_COMPU_VTAB "Verbal Table" TAB_VERB "%.0" "list" COMPU_TAB_REF cfgout_MAPlon_COMPU_VTAB_REF /end COMPU_METHOD
/begin COMPU_VTAB cfgout_MAPlon_COMPU_VTAB_REF "Verbal Table" TAB_VERB 7 0x00 "Ignored" 0x01 "<" 0x02 ">" 0x03 "<=" 0x04 ">=" 0x05 "=" 0x06 "<>" DEFAULT_VALUE "UNKNOWN" /end COMPU_VTAB
/begin CHARACTERISTIC cfgout_ECTlon "and ECT is{cfgout_ECTlon&0xff=0x00:Ignored}{cfgout_ECTlon&0xff=0x01:<}{cfgout_ECTlon&0xff=0x02:>}{cfgout_ECTlon&0xff=0x03:<=}{cfgout_ECTlon&0xff=0x04:>=}{cfgout_ECTlon&0xff=0x05:=}{cfgout_ECTlon&0xff=0x06:<>}" VALUE 0x00149506 /* @ECU_Address@cfgout_ECTlon@0x010011E8@ */ ECIPP_ALIGNMENT_UBYTE 255 cfgout_ECTlon_COMPU_VTAB 0 255 BIT_MASK 0xff /end CHARACTERISTIC
/begin COMPU_METHOD cfgout_ECTlon_COMPU_VTAB "Verbal Table" TAB_VERB "%.0" "list" COMPU_TAB_REF cfgout_ECTlon_COMPU_VTAB_REF /end COMPU_METHOD
/begin COMPU_VTAB cfgout_ECTlon_COMPU_VTAB_REF "Verbal Table" TAB_VERB 7 0x00 "Ignored" 0x01 "<" 0x02 ">" 0x03 "<=" 0x04 ">=" 0x05 "=" 0x06 "<>" DEFAULT_VALUE "UNKNOWN" /end COMPU_VTAB
/begin CHARACTERISTIC cfgout_RPMloff "RPM is{cfgout_RPMloff&0xff=0x00:Ignored}{cfgout_RPMloff&0xff=0x01:<}{cfgout_RPMloff&0xff=0x02:>}{cfgout_RPMloff&0xff=0x03:<=}{cfgout_RPMloff&0xff=0x04:>=}{cfgout_RPMloff&0xff=0x05:=}{cfgout_RPMloff&0xff=0x06:<>}" VALUE 0x00149510 /* @ECU_Address@cfgout_RPMloff@0x010011F0@ */ ECIPP_ALIGNMENT_UBYTE 255 cfgout_RPMloff_COMPU_VTAB 0 255 BIT_MASK 0xff /end CHARACTERISTIC
/begin COMPU_METHOD cfgout_RPMloff_COMPU_VTAB "Verbal Table" TAB_VERB "%.0" "list" COMPU_TAB_REF cfgout_RPMloff_COMPU_VTAB_REF /end COMPU_METHOD
/begin COMPU_VTAB cfgout_RPMloff_COMPU_VTAB_REF "Verbal Table" TAB_VERB 7 0x00 "Ignored" 0x01 "<" 0x02 ">" 0x03 "<=" 0x04 ">=" 0x05 "=" 0x06 "<>" DEFAULT_VALUE "UNKNOWN" /end COMPU_VTAB
/begin CHARACTERISTIC cfgout_MAPloff "and MAP is{cfgout_MAPloff&0xff=0x00:Ignored}{cfgout_MAPloff&0xff=0x01:<}{cfgout_MAPloff&0xff=0x02:>}{cfgout_MAPloff&0xff=0x03:<=}{cfgout_MAPloff&0xff=0x04:>=}{cfgout_MAPloff&0xff=0x05:=}{cfgout_MAPloff&0xff=0x06:<>}" VALUE 0x00149511 /* @ECU_Address@cfgout_MAPloff@0x010011F8@ */ ECIPP_ALIGNMENT_UBYTE 255 cfgout_MAPloff_COMPU_VTAB 0 255 BIT_MASK 0xff /end CHARACTERISTIC
/begin COMPU_METHOD cfgout_MAPloff_COMPU_VTAB "Verbal Table" TAB_VERB "%.0" "list" COMPU_TAB_REF cfgout_MAPloff_COMPU_VTAB_REF /end COMPU_METHOD
/begin COMPU_VTAB cfgout_MAPloff_COMPU_VTAB_REF "Verbal Table" TAB_VERB 7 0x00 "Ignored" 0x01 "<" 0x02 ">" 0x03 "<=" 0x04 ">=" 0x05 "=" 0x06 "<>" DEFAULT_VALUE "UNKNOWN" /end COMPU_VTAB
/begin CHARACTERISTIC cfgout_ECTloff "and ECT is{cfgout_ECTloff&0xff=0x00:Ignored}{cfgout_ECTloff&0xff=0x01:<}{cfgout_ECTloff&0xff=0x02:>}{cfgout_ECTloff&0xff=0x03:<=}{cfgout_ECTloff&0xff=0x04:>=}{cfgout_ECTloff&0xff=0x05:=}{cfgout_ECTloff&0xff=0x06:<>}" VALUE 0x00149512 /* @ECU_Address@cfgout_ECTloff@0x01001200@ */ ECIPP_ALIGNMENT_UBYTE 255 cfgout_ECTloff_COMPU_VTAB 0 255 BIT_MASK 0xff /end CHARACTERISTIC
/begin COMPU_METHOD cfgout_ECTloff_COMPU_VTAB "Verbal Table" TAB_VERB "%.0" "list" COMPU_TAB_REF cfgout_ECTloff_COMPU_VTAB_REF /end COMPU_METHOD
/begin COMPU_VTAB cfgout_ECTloff_COMPU_VTAB_REF "Verbal Table" TAB_VERB 7 0x00 "Ignored" 0x01 "<" 0x02 ">" 0x03 "<=" 0x04 ">=" 0x05 "=" 0x06 "<>" DEFAULT_VALUE "UNKNOWN" /end COMPU_VTAB
/begin CHARACTERISTIC cfgout_on_wait "persistently longer than" VALUE 0x0014954C /* @ECU_Address@cfgout_on_wait@0x01001208@ */ ECIPP_ALIGNMENT_UWORD 66 Compu_cfgout_on_wait 0 65.535 /end CHARACTERISTIC
/begin COMPU_METHOD Compu_cfgout_on_wait " " RAT_FUNC "%.1" "seconds" COEFFS 0 1000 0 0 0 1 /end COMPU_METHOD
/begin CHARACTERISTIC cfgout_off_wait "persistently longer than" VALUE 0x0014954E /* @ECU_Address@cfgout_off_wait@0x01001210@ */ ECIPP_ALIGNMENT_UWORD 66 Compu_cfgout_off_wait 0 65.535 /end CHARACTERISTIC
/begin COMPU_METHOD Compu_cfgout_off_wait " " RAT_FUNC "%.1" "seconds" COEFFS 0 1000 0 0 0 1 /end COMPU_METHOD
/begin CHARACTERISTIC cfgout_chan "Configurable output channel #1{cfgout_chan&0xff=0:Disabled}{cfgout_chan&0xff=1:Aux PWM1}{cfgout_chan&0xff=2:Aux PWM2}{cfgout_chan&0xff=3:Aux PWM3}{cfgout_chan&0xff=4:Aux PWM4}{cfgout_chan&0xff=5:Aux PWM5}{cfgout_chan&0xff=6:Aux PWM6}{cfgout_chan&0xff=7:Au" VALUE 0x001494F8 /* @ECU_Address@cfgout_chan@0x01001218@ */ ECIPP_ALIGNMENT_UBYTE 255 cfgout_chan_COMPU_VTAB 0 255 BIT_MASK 0xff /end CHARACTERISTIC
/begin COMPU_METHOD cfgout_chan_COMPU_VTAB "Verbal Table" TAB_VERB "%.0" "list" COMPU_TAB_REF cfgout_chan_COMPU_VTAB_REF /end COMPU_METHOD
/begin COMPU_VTAB cfgout_chan_COMPU_VTAB_REF "Verbal Table" TAB_VERB 16 0 "Disabled" 1 "Aux PWM1" 2 "Aux PWM2" 3 "Aux PWM3" 4 "Aux PWM4" 5 "Aux PWM5" 6 "Aux PWM6" 7 "Aux PWM7" 8 "Aux PWM8" 9 "Aux PWM9" 10 "Aux PWM10" 11 "Aux PWM11" 12 "Aux PWM12" 13 "Aux PWM13" 14 "Aux PWM14" 15 "Aux PWM15" DEFAULT_VALUE "UNKNOWN" /end COMPU_VTAB
/begin CHARACTERISTIC cfgout_stopped "Engine stopped state{cfgout_stopped&0xff=0x00:Off}{cfgout_stopped&0xff=0x01:On}{cfgout_stopped&0xff=0x02:Automatic}" VALUE 0x001494F9 /* @ECU_Address@cfgout_stopped@0x01001220@ */ ECIPP_ALIGNMENT_UBYTE 255 cfgout_stopped_COMPU_VTAB 0 255 BIT_MASK 0xff /end CHARACTERISTIC
/begin COMPU_METHOD cfgout_stopped_COMPU_VTAB "Verbal Table" TAB_VERB "%.0" "list" COMPU_TAB_REF cfgout_stopped_COMPU_VTAB_REF /end COMPU_METHOD
/begin COMPU_VTAB cfgout_stopped_COMPU_VTAB_REF "Verbal Table" TAB_VERB 3 0x00 "Off" 0x01 "On" 0x02 "Automatic" DEFAULT_VALUE "UNKNOWN" /end COMPU_VTAB
/begin CHARACTERISTIC cfgout_cranking "Engine cranking state{cfgout_cranking&0xff=0x00:Off}{cfgout_cranking&0xff=0x01:On}{cfgout_cranking&0xff=0x02:Automatic}" VALUE 0x001494FA /* @ECU_Address@cfgout_cranking@0x01001228@ */ ECIPP_ALIGNMENT_UBYTE 255 cfgout_cranking_COMPU_VTAB 0 255 BIT_MASK 0xff /end CHARACTERISTIC
/begin COMPU_METHOD cfgout_cranking_COMPU_VTAB "Verbal Table" TAB_VERB "%.0" "list" COMPU_TAB_REF cfgout_cranking_COMPU_VTAB_REF /end COMPU_METHOD
/begin COMPU_VTAB cfgout_cranking_COMPU_VTAB_REF "Verbal Table" TAB_VERB 3 0x00 "Off" 0x01 "On" 0x02 "Automatic" DEFAULT_VALUE "UNKNOWN" /end COMPU_VTAB
/begin CHARACTERISTIC cfgout_running "Engine running state{cfgout_running&0xff=0x00:Off}{cfgout_running&0xff=0x01:On}{cfgout_running&0xff=0x02:Automatic}" VALUE 0x001494FB /* @ECU_Address@cfgout_running@0x01001230@ */ ECIPP_ALIGNMENT_UBYTE 255 cfgout_running_COMPU_VTAB 0 255 BIT_MASK 0xff /end CHARACTERISTIC
/begin COMPU_METHOD cfgout_running_COMPU_VTAB "Verbal Table" TAB_VERB "%.0" "list" COMPU_TAB_REF cfgout_running_COMPU_VTAB_REF /end COMPU_METHOD
/begin COMPU_VTAB cfgout_running_COMPU_VTAB_REF "Verbal Table" TAB_VERB 3 0x00 "Off" 0x01 "On" 0x02 "Automatic" DEFAULT_VALUE "UNKNOWN" /end COMPU_VTAB
/begin CHARACTERISTIC crank_lim_ena "Crank limiter function{crank_lim_ena&0xff=0:Disabled}{crank_lim_ena&0xff=1:N/C Starter-Lockout Mode}{crank_lim_ena&0xff=2:N/O Auto-Crank Mode}{crank_lim_ena&0xff=3:N/O Starter-Lockout Mode}{crank_lim_ena&0xff=4:N/O Starter-Lockout Pass-Thru}" VALUE 0x0014812d /* @ECU_Address@crank_lim_ena@0x01001388@ */ ECIPP_ALIGNMENT_UBYTE 255 crank_lim_ena_COMPU_VTAB 0 255 BIT_MASK 0xff /end CHARACTERISTIC
/begin COMPU_METHOD crank_lim_ena_COMPU_VTAB "Verbal Table" TAB_VERB "%.0" "list" COMPU_TAB_REF crank_lim_ena_COMPU_VTAB_REF /end COMPU_METHOD
/begin COMPU_VTAB crank_lim_ena_COMPU_VTAB_REF "Verbal Table" TAB_VERB 5 0 "Disabled" 1 "N/C Starter-Lockout Mode" 2 "N/O Auto-Crank Mode" 3 "N/O Starter-Lockout Mode" 4 "N/O Starter-Lockout Pass-Thru" DEFAULT_VALUE "UNKNOWN" /end COMPU_VTAB
/begin CHARACTERISTIC crank_lim_wt "Crank limiter wind-up time" VALUE 0x00147aaa /* @ECU_Address@crank_lim_wt@0x01001390@ */ ECIPP_ALIGNMENT_UWORD 66 Compu_crank_lim_wt 0 65.535 /end CHARACTERISTIC
/begin COMPU_METHOD Compu_crank_lim_wt " " RAT_FUNC "%.1" "sec" COEFFS 0 1000 0 0 0 1 /end COMPU_METHOD
/begin CHARACTERISTIC crank_rst_wt "Crank limiter wind-down time" VALUE 0x00147aac /* @ECU_Address@crank_rst_wt@0x01001398@ */ ECIPP_ALIGNMENT_UWORD 66 Compu_crank_rst_wt 0 65.535 /end CHARACTERISTIC
/begin COMPU_METHOD Compu_crank_rst_wt " " RAT_FUNC "%.1" "sec" COEFFS 0 1000 0 0 0 1 /end COMPU_METHOD
/begin CHARACTERISTIC crank_total_lim "Cumulative crank-time limit" VALUE 0x00147aae /* @ECU_Address@crank_total_lim@0x010013A8@ */ ECIPP_ALIGNMENT_UWORD 66 Compu_crank_total_lim 0 65.535 /end CHARACTERISTIC
/begin COMPU_METHOD Compu_crank_total_lim " " RAT_FUNC "%.1" "sec" COEFFS 0 1000 0 0 0 1 /end COMPU_METHOD
/begin CHARACTERISTIC cfgout_PD1lon "and Aux PD1 is{cfgout_PD1lon&0xff=0x00:Ignored}{cfgout_PD1lon&0xff=0x01:<}{cfgout_PD1lon&0xff=0x02:>}{cfgout_PD1lon&0xff=0x03:<=}{cfgout_PD1lon&0xff=0x04:>=}{cfgout_PD1lon&0xff=0x05:=}{cfgout_PD1lon&0xff=0x06:<>}" VALUE 0x00149507 /* @ECU_Address@cfgout_PD1lon@0x010016B8@ */ ECIPP_ALIGNMENT_UBYTE 255 cfgout_PD1lon_COMPU_VTAB 0 255 BIT_MASK 0xff /end CHARACTERISTIC
/begin COMPU_METHOD cfgout_PD1lon_COMPU_VTAB "Verbal Table" TAB_VERB "%.0" "list" COMPU_TAB_REF cfgout_PD1lon_COMPU_VTAB_REF /end COMPU_METHOD
/begin COMPU_VTAB cfgout_PD1lon_COMPU_VTAB_REF "Verbal Table" TAB_VERB 7 0x00 "Ignored" 0x01 "<" 0x02 ">" 0x03 "<=" 0x04 ">=" 0x05 "=" 0x06 "<>" DEFAULT_VALUE "UNKNOWN" /end COMPU_VTAB
/begin CHARACTERISTIC cfgout_PU1lon "and Aux PU1 is{cfgout_PU1lon&0xff=0x00:Ignored}{cfgout_PU1lon&0xff=0x01:<}{cfgout_PU1lon&0xff=0x02:>}{cfgout_PU1lon&0xff=0x03:<=}{cfgout_PU1lon&0xff=0x04:>=}{cfgout_PU1lon&0xff=0x05:=}{cfgout_PU1lon&0xff=0x06:<>}" VALUE 0x00149508 /* @ECU_Address@cfgout_PU1lon@0x010016C0@ */ ECIPP_ALIGNMENT_UBYTE 255 cfgout_PU1lon_COMPU_VTAB 0 255 BIT_MASK 0xff /end CHARACTERISTIC
/begin COMPU_METHOD cfgout_PU1lon_COMPU_VTAB "Verbal Table" TAB_VERB "%.0" "list" COMPU_TAB_REF cfgout_PU1lon_COMPU_VTAB_REF /end COMPU_METHOD
/begin COMPU_VTAB cfgout_PU1lon_COMPU_VTAB_REF "Verbal Table" TAB_VERB 7 0x00 "Ignored" 0x01 "<" 0x02 ">" 0x03 "<=" 0x04 ">=" 0x05 "=" 0x06 "<>" DEFAULT_VALUE "UNKNOWN" /end COMPU_VTAB
/begin CHARACTERISTIC cfgout_PD1loff "and Aux PD1 is{cfgout_PD1loff&0xff=0x00:Ignored}{cfgout_PD1loff&0xff=0x01:<}{cfgout_PD1loff&0xff=0x02:>}{cfgout_PD1loff&0xff=0x03:<=}{cfgout_PD1loff&0xff=0x04:>=}{cfgout_PD1loff&0xff=0x05:=}{cfgout_PD1loff&0xff=0x06:<>}" VALUE 0x00149513 /* @ECU_Address@cfgout_PD1loff@0x010016C8@ */ ECIPP_ALIGNMENT_UBYTE 255 cfgout_PD1loff_COMPU_VTAB 0 255 BIT_MASK 0xff /end CHARACTERISTIC
/begin COMPU_METHOD cfgout_PD1loff_COMPU_VTAB "Verbal Table" TAB_VERB "%.0" "list" COMPU_TAB_REF cfgout_PD1loff_COMPU_VTAB_REF /end COMPU_METHOD
/begin COMPU_VTAB cfgout_PD1loff_COMPU_VTAB_REF "Verbal Table" TAB_VERB 7 0x00 "Ignored" 0x01 "<" 0x02 ">" 0x03 "<=" 0x04 ">=" 0x05 "=" 0x06 "<>" DEFAULT_VALUE "UNKNOWN" /end COMPU_VTAB
/begin CHARACTERISTIC cfgout_PU1loff "and Aux PU1 is{cfgout_PU1loff&0xff=0x00:Ignored}{cfgout_PU1loff&0xff=0x01:<}{cfgout_PU1loff&0xff=0x02:>}{cfgout_PU1loff&0xff=0x03:<=}{cfgout_PU1loff&0xff=0x04:>=}{cfgout_PU1loff&0xff=0x05:=}{cfgout_PU1loff&0xff=0x06:<>}" VALUE 0x00149514 /* @ECU_Address@cfgout_PU1loff@0x010016D0@ */ ECIPP_ALIGNMENT_UBYTE 255 cfgout_PU1loff_COMPU_VTAB 0 255 BIT_MASK 0xff /end CHARACTERISTIC
/begin COMPU_METHOD cfgout_PU1loff_COMPU_VTAB "Verbal Table" TAB_VERB "%.0" "list" COMPU_TAB_REF cfgout_PU1loff_COMPU_VTAB_REF /end COMPU_METHOD
/begin COMPU_VTAB cfgout_PU1loff_COMPU_VTAB_REF "Verbal Table" TAB_VERB 7 0x00 "Ignored" 0x01 "<" 0x02 ">" 0x03 "<=" 0x04 ">=" 0x05 "=" 0x06 "<>" DEFAULT_VALUE "UNKNOWN" /end COMPU_VTAB
/begin CHARACTERISTIC cfgout_PD1on "PD1_on" VALUE 0x00149522 /* @ECU_Address@cfgout_PD1on@0x010016D8@ */ ECIPP_ALIGNMENT_UWORD 5 Compu_cfgout_PD1on 0 5.00114468864469 /end CHARACTERISTIC
/begin COMPU_METHOD Compu_cfgout_PD1on " " RAT_FUNC "%.2" "volts" COEFFS 0 13104 0 0 0 1 /end COMPU_METHOD
/begin CHARACTERISTIC cfgout_PU1on "PU1_on" VALUE 0x00149524 /* @ECU_Address@cfgout_PU1on@0x010016E0@ */ ECIPP_ALIGNMENT_UWORD 5 Compu_cfgout_PU1on 0 5.00114468864469 /end CHARACTERISTIC
/begin COMPU_METHOD Compu_cfgout_PU1on " " RAT_FUNC "%.2" "volts" COEFFS 0 13104 0 0 0 1 /end COMPU_METHOD
/begin CHARACTERISTIC cfgout_PD1off "PD1_off" VALUE 0x0014953A /* @ECU_Address@cfgout_PD1off@0x010016E8@ */ ECIPP_ALIGNMENT_UWORD 5 Compu_cfgout_PD1off 0 5.00114468864469 /end CHARACTERISTIC
/begin COMPU_METHOD Compu_cfgout_PD1off " " RAT_FUNC "%.2" "volts" COEFFS 0 13104 0 0 0 1 /end COMPU_METHOD
/begin CHARACTERISTIC cfgout_PU1off "PU1_off" VALUE 0x0014953C /* @ECU_Address@cfgout_PU1off@0x010016F0@ */ ECIPP_ALIGNMENT_UWORD 5 Compu_cfgout_PU1off 0 5.00114468864469 /end CHARACTERISTIC
/begin COMPU_METHOD Compu_cfgout_PU1off " " RAT_FUNC "%.2" "volts" COEFFS 0 13104 0 0 0 1 /end COMPU_METHOD
/begin CHARACTERISTIC cfgout2_RPMon "RPM_on" VALUE 0x00149574 /* @ECU_Address@cfgout2_RPMon@0x01001B50@ */ ECIPP_ALIGNMENT_UWORD 65535 Compu_cfgout2_RPMon 0 65535 /end CHARACTERISTIC
/begin COMPU_METHOD Compu_cfgout2_RPMon " " RAT_FUNC "%.0" "rpm" COEFFS 0 1 0 0 0 1 /end COMPU_METHOD
/begin CHARACTERISTIC cfgout2_MAPon "MAP_on" VALUE 0x00149576 /* @ECU_Address@cfgout2_MAPon@0x01001B58@ */ ECIPP_ALIGNMENT_UWORD 256 Compu_cfgout2_MAPon 0 255.99609375 /end CHARACTERISTIC
/begin COMPU_METHOD Compu_cfgout2_MAPon " " RAT_FUNC "%.2" "psia" COEFFS 0 256 0 0 0 1 /end COMPU_METHOD
/begin CHARACTERISTIC cfgout2_ECTon "ECT_on" VALUE 0x00149578 /* @ECU_Address@cfgout2_ECTon@0x01001B60@ */ ECIPP_ALIGNMENT_UWORD 564 Compu_cfgout2_ECTon -460 563.984375 /end CHARACTERISTIC
/begin COMPU_METHOD Compu_cfgout2_ECTon " " RAT_FUNC "%.1" "deg F" COEFFS 0 64 29440 0 0 1 /end COMPU_METHOD
/begin CHARACTERISTIC cfgout2_RPMoff "RPM_off" VALUE 0x0014958C /* @ECU_Address@cfgout2_RPMoff@0x01001B68@ */ ECIPP_ALIGNMENT_UWORD 65535 Compu_cfgout2_RPMoff 0 65535 /end CHARACTERISTIC
/begin COMPU_METHOD Compu_cfgout2_RPMoff " " RAT_FUNC "%.0" "rpm" COEFFS 0 1 0 0 0 1 /end COMPU_METHOD
/begin CHARACTERISTIC cfgout2_MAPoff "MAP_off" VALUE 0x0014958E /* @ECU_Address@cfgout2_MAPoff@0x01001B70@ */ ECIPP_ALIGNMENT_UWORD 256 Compu_cfgout2_MAPoff 0 255.99609375 /end CHARACTERISTIC
/begin COMPU_METHOD Compu_cfgout2_MAPoff " " RAT_FUNC "%.2" "psia" COEFFS 0 256 0 0 0 1 /end COMPU_METHOD
/begin CHARACTERISTIC cfgout2_ECToff "ECT_off" VALUE 0x00149590 /* @ECU_Address@cfgout2_ECToff@0x01001B78@ */ ECIPP_ALIGNMENT_UWORD 564 Compu_cfgout2_ECToff -460 563.984375 /end CHARACTERISTIC
/begin COMPU_METHOD Compu_cfgout2_ECToff " " RAT_FUNC "%.1" "deg F" COEFFS 0 64 29440 0 0 1 /end COMPU_METHOD
/begin CHARACTERISTIC cfgout2_RPMlon "RPM is{cfgout2_RPMlon&0xff=0x00:Ignored}{cfgout2_RPMlon&0xff=0x01:<}{cfgout2_RPMlon&0xff=0x02:>}{cfgout2_RPMlon&0xff=0x03:<=}{cfgout2_RPMlon&0xff=0x04:>=}{cfgout2_RPMlon&0xff=0x05:=}{cfgout2_RPMlon&0xff=0x06:<>}" VALUE 0x0014955C /* @ECU_Address@cfgout2_RPMlon@0x01001B80@ */ ECIPP_ALIGNMENT_UBYTE 255 cfgout2_RPMlon_COMPU_VTAB 0 255 BIT_MASK 0xff /end CHARACTERISTIC
/begin COMPU_METHOD cfgout2_RPMlon_COMPU_VTAB "Verbal Table" TAB_VERB "%.0" "list" COMPU_TAB_REF cfgout2_RPMlon_COMPU_VTAB_REF /end COMPU_METHOD
/begin COMPU_VTAB cfgout2_RPMlon_COMPU_VTAB_REF "Verbal Table" TAB_VERB 7 0x00 "Ignored" 0x01 "<" 0x02 ">" 0x03 "<=" 0x04 ">=" 0x05 "=" 0x06 "<>" DEFAULT_VALUE "UNKNOWN" /end COMPU_VTAB
/begin CHARACTERISTIC cfgout2_MAPlon "and MAP is{cfgout2_MAPlon&0xff=0x00:Ignored}{cfgout2_MAPlon&0xff=0x01:<}{cfgout2_MAPlon&0xff=0x02:>}{cfgout2_MAPlon&0xff=0x03:<=}{cfgout2_MAPlon&0xff=0x04:>=}{cfgout2_MAPlon&0xff=0x05:=}{cfgout2_MAPlon&0xff=0x06:<>}" VALUE 0x0014955D /* @ECU_Address@cfgout2_MAPlon@0x01001B88@ */ ECIPP_ALIGNMENT_UBYTE 255 cfgout2_MAPlon_COMPU_VTAB 0 255 BIT_MASK 0xff /end CHARACTERISTIC
/begin COMPU_METHOD cfgout2_MAPlon_COMPU_VTAB "Verbal Table" TAB_VERB "%.0" "list" COMPU_TAB_REF cfgout2_MAPlon_COMPU_VTAB_REF /end COMPU_METHOD
/begin COMPU_VTAB cfgout2_MAPlon_COMPU_VTAB_REF "Verbal Table" TAB_VERB 7 0x00 "Ignored" 0x01 "<" 0x02 ">" 0x03 "<=" 0x04 ">=" 0x05 "=" 0x06 "<>" DEFAULT_VALUE "UNKNOWN" /end COMPU_VTAB
/begin CHARACTERISTIC cfgout2_ECTlon "and ECT is{cfgout2_ECTlon&0xff=0x00:Ignored}{cfgout2_ECTlon&0xff=0x01:<}{cfgout2_ECTlon&0xff=0x02:>}{cfgout2_ECTlon&0xff=0x03:<=}{cfgout2_ECTlon&0xff=0x04:>=}{cfgout2_ECTlon&0xff=0x05:=}{cfgout2_ECTlon&0xff=0x06:<>}" VALUE 0x0014955E /* @ECU_Address@cfgout2_ECTlon@0x01001B90@ */ ECIPP_ALIGNMENT_UBYTE 255 cfgout2_ECTlon_COMPU_VTAB 0 255 BIT_MASK 0xff /end CHARACTERISTIC
/begin COMPU_METHOD cfgout2_ECTlon_COMPU_VTAB "Verbal Table" TAB_VERB "%.0" "list" COMPU_TAB_REF cfgout2_ECTlon_COMPU_VTAB_REF /end COMPU_METHOD
/begin COMPU_VTAB cfgout2_ECTlon_COMPU_VTAB_REF "Verbal Table" TAB_VERB 7 0x00 "Ignored" 0x01 "<" 0x02 ">" 0x03 "<=" 0x04 ">=" 0x05 "=" 0x06 "<>" DEFAULT_VALUE "UNKNOWN" /end COMPU_VTAB
/begin CHARACTERISTIC cfgout2_RPMloff "RPM is{cfgout2_RPMloff&0xff=0x00:Ignored}{cfgout2_RPMloff&0xff=0x01:<}{cfgout2_RPMloff&0xff=0x02:>}{cfgout2_RPMloff&0xff=0x03:<=}{cfgout2_RPMloff&0xff=0x04:>=}{cfgout2_RPMloff&0xff=0x05:=}{cfgout2_RPMloff&0xff=0x06:<>}" VALUE 0x00149568 /* @ECU_Address@cfgout2_RPMloff@0x01001B98@ */ ECIPP_ALIGNMENT_UBYTE 255 cfgout2_RPMloff_COMPU_VTAB 0 255 BIT_MASK 0xff /end CHARACTERISTIC
/begin COMPU_METHOD cfgout2_RPMloff_COMPU_VTAB "Verbal Table" TAB_VERB "%.0" "list" COMPU_TAB_REF cfgout2_RPMloff_COMPU_VTAB_REF /end COMPU_METHOD
/begin COMPU_VTAB cfgout2_RPMloff_COMPU_VTAB_REF "Verbal Table" TAB_VERB 7 0x00 "Ignored" 0x01 "<" 0x02 ">" 0x03 "<=" 0x04 ">=" 0x05 "=" 0x06 "<>" DEFAULT_VALUE "UNKNOWN" /end COMPU_VTAB
/begin CHARACTERISTIC cfgout2_MAPloff "and MAP is{cfgout2_MAPloff&0xff=0x00:Ignored}{cfgout2_MAPloff&0xff=0x01:<}{cfgout2_MAPloff&0xff=0x02:>}{cfgout2_MAPloff&0xff=0x03:<=}{cfgout2_MAPloff&0xff=0x04:>=}{cfgout2_MAPloff&0xff=0x05:=}{cfgout2_MAPloff&0xff=0x06:<>}" VALUE 0x00149569 /* @ECU_Address@cfgout2_MAPloff@0x01001BA0@ */ ECIPP_ALIGNMENT_UBYTE 255 cfgout2_MAPloff_COMPU_VTAB 0 255 BIT_MASK 0xff /end CHARACTERISTIC
/begin COMPU_METHOD cfgout2_MAPloff_COMPU_VTAB "Verbal Table" TAB_VERB "%.0" "list" COMPU_TAB_REF cfgout2_MAPloff_COMPU_VTAB_REF /end COMPU_METHOD
/begin COMPU_VTAB cfgout2_MAPloff_COMPU_VTAB_REF "Verbal Table" TAB_VERB 7 0x00 "Ignored" 0x01 "<" 0x02 ">" 0x03 "<=" 0x04 ">=" 0x05 "=" 0x06 "<>" DEFAULT_VALUE "UNKNOWN" /end COMPU_VTAB
/begin CHARACTERISTIC cfgout2_ECTloff "and ECT is{cfgout2_ECTloff&0xff=0x00:Ignored}{cfgout2_ECTloff&0xff=0x01:<}{cfgout2_ECTloff&0xff=0x02:>}{cfgout2_ECTloff&0xff=0x03:<=}{cfgout2_ECTloff&0xff=0x04:>=}{cfgout2_ECTloff&0xff=0x05:=}{cfgout2_ECTloff&0xff=0x06:<>}" VALUE 0x0014956A /* @ECU_Address@cfgout2_ECTloff@0x01001BA8@ */ ECIPP_ALIGNMENT_UBYTE 255 cfgout2_ECTloff_COMPU_VTAB 0 255 BIT_MASK 0xff /end CHARACTERISTIC
/begin COMPU_METHOD cfgout2_ECTloff_COMPU_VTAB "Verbal Table" TAB_VERB "%.0" "list" COMPU_TAB_REF cfgout2_ECTloff_COMPU_VTAB_REF /end COMPU_METHOD
/begin COMPU_VTAB cfgout2_ECTloff_COMPU_VTAB_REF "Verbal Table" TAB_VERB 7 0x00 "Ignored" 0x01 "<" 0x02 ">" 0x03 "<=" 0x04 ">=" 0x05 "=" 0x06 "<>" DEFAULT_VALUE "UNKNOWN" /end COMPU_VTAB
/begin CHARACTERISTIC cfgout2_on_wait "persistently longer than" VALUE 0x001495A4 /* @ECU_Address@cfgout2_on_wait@0x01001BB0@ */ ECIPP_ALIGNMENT_UWORD 66 Compu_cfgout2_on_wait 0 65.535 /end CHARACTERISTIC
/begin COMPU_METHOD Compu_cfgout2_on_wait " " RAT_FUNC "%.1" "seconds" COEFFS 0 1000 0 0 0 1 /end COMPU_METHOD
/begin CHARACTERISTIC cfgout2_off_wait "persistently longer than" VALUE 0x001495A6 /* @ECU_Address@cfgout2_off_wait@0x01001BB8@ */ ECIPP_ALIGNMENT_UWORD 66 Compu_cfgout2_off_wait 0 65.535 /end CHARACTERISTIC
/begin COMPU_METHOD Compu_cfgout2_off_wait " " RAT_FUNC "%.1" "seconds" COEFFS 0 1000 0 0 0 1 /end COMPU_METHOD
/begin CHARACTERISTIC cfgout2_chan "Configurable output channel #2{cfgout2_chan&0xff=0:Disabled}{cfgout2_chan&0xff=1:Aux PWM1}{cfgout2_chan&0xff=2:Aux PWM2}{cfgout2_chan&0xff=3:Aux PWM3}{cfgout2_chan&0xff=4:Aux PWM4}{cfgout2_chan&0xff=5:Aux PWM5}{cfgout2_chan&0xff=6:Aux PWM6}{cfgout2_chan&0" VALUE 0x00149550 /* @ECU_Address@cfgout2_chan@0x01001BC0@ */ ECIPP_ALIGNMENT_UBYTE 255 cfgout2_chan_COMPU_VTAB 0 255 BIT_MASK 0xff /end CHARACTERISTIC
/begin COMPU_METHOD cfgout2_chan_COMPU_VTAB "Verbal Table" TAB_VERB "%.0" "list" COMPU_TAB_REF cfgout2_chan_COMPU_VTAB_REF /end COMPU_METHOD
/begin COMPU_VTAB cfgout2_chan_COMPU_VTAB_REF "Verbal Table" TAB_VERB 16 0 "Disabled" 1 "Aux PWM1" 2 "Aux PWM2" 3 "Aux PWM3" 4 "Aux PWM4" 5 "Aux PWM5" 6 "Aux PWM6" 7 "Aux PWM7" 8 "Aux PWM8" 9 "Aux PWM9" 10 "Aux PWM10" 11 "Aux PWM11" 12 "Aux PWM12" 13 "Aux PWM13" 14 "Aux PWM14" 15 "Aux PWM15" DEFAULT_VALUE "UNKNOWN" /end COMPU_VTAB
/begin CHARACTERISTIC cfgout2_stopped "Engine stopped state{cfgout2_stopped&0xff=0x00:Off}{cfgout2_stopped&0xff=0x01:On}{cfgout2_stopped&0xff=0x02:Automatic}" VALUE 0x00149551 /* @ECU_Address@cfgout2_stopped@0x01001BC8@ */ ECIPP_ALIGNMENT_UBYTE 255 cfgout2_stopped_COMPU_VTAB 0 255 BIT_MASK 0xff /end CHARACTERISTIC
/begin COMPU_METHOD cfgout2_stopped_COMPU_VTAB "Verbal Table" TAB_VERB "%.0" "list" COMPU_TAB_REF cfgout2_stopped_COMPU_VTAB_REF /end COMPU_METHOD
/begin COMPU_VTAB cfgout2_stopped_COMPU_VTAB_REF "Verbal Table" TAB_VERB 3 0x00 "Off" 0x01 "On" 0x02 "Automatic" DEFAULT_VALUE "UNKNOWN" /end COMPU_VTAB
/begin CHARACTERISTIC cfgout2_cranking "Engine cranking state{cfgout2_cranking&0xff=0x00:Off}{cfgout2_cranking&0xff=0x01:On}{cfgout2_cranking&0xff=0x02:Automatic}" VALUE 0x00149552 /* @ECU_Address@cfgout2_cranking@0x01001BD0@ */ ECIPP_ALIGNMENT_UBYTE 255 cfgout2_cranking_COMPU_VTAB 0 255 BIT_MASK 0xff /end CHARACTERISTIC
/begin COMPU_METHOD cfgout2_cranking_COMPU_VTAB "Verbal Table" TAB_VERB "%.0" "list" COMPU_TAB_REF cfgout2_cranking_COMPU_VTAB_REF /end COMPU_METHOD
/begin COMPU_VTAB cfgout2_cranking_COMPU_VTAB_REF "Verbal Table" TAB_VERB 3 0x00 "Off" 0x01 "On" 0x02 "Automatic" DEFAULT_VALUE "UNKNOWN" /end COMPU_VTAB
/begin CHARACTERISTIC cfgout2_running "Engine running state{cfgout2_running&0xff=0x00:Off}{cfgout2_running&0xff=0x01:On}{cfgout2_running&0xff=0x02:Automatic}" VALUE 0x00149553 /* @ECU_Address@cfgout2_running@0x01001BD8@ */ ECIPP_ALIGNMENT_UBYTE 255 cfgout2_running_COMPU_VTAB 0 255 BIT_MASK 0xff /end CHARACTERISTIC
/begin COMPU_METHOD cfgout2_running_COMPU_VTAB "Verbal Table" TAB_VERB "%.0" "list" COMPU_TAB_REF cfgout2_running_COMPU_VTAB_REF /end COMPU_METHOD
/begin COMPU_VTAB cfgout2_running_COMPU_VTAB_REF "Verbal Table" TAB_VERB 3 0x00 "Off" 0x01 "On" 0x02 "Automatic" DEFAULT_VALUE "UNKNOWN" /end COMPU_VTAB
/begin CHARACTERISTIC cfgout2_PD1lon "and AUX PD1 is{cfgout2_PD1lon&0xff=0x00:Ignored}{cfgout2_PD1lon&0xff=0x01:<}{cfgout2_PD1lon&0xff=0x02:>}{cfgout2_PD1lon&0xff=0x03:<=}{cfgout2_PD1lon&0xff=0x04:>=}{cfgout2_PD1lon&0xff=0x05:=}{cfgout2_PD1lon&0xff=0x06:<>}" VALUE 0x0014955F /* @ECU_Address@cfgout2_PD1lon@0x01001BE8@ */ ECIPP_ALIGNMENT_UBYTE 255 cfgout2_PD1lon_COMPU_VTAB 0 255 BIT_MASK 0xff /end CHARACTERISTIC
/begin COMPU_METHOD cfgout2_PD1lon_COMPU_VTAB "Verbal Table" TAB_VERB "%.0" "list" COMPU_TAB_REF cfgout2_PD1lon_COMPU_VTAB_REF /end COMPU_METHOD
/begin COMPU_VTAB cfgout2_PD1lon_COMPU_VTAB_REF "Verbal Table" TAB_VERB 7 0x00 "Ignored" 0x01 "<" 0x02 ">" 0x03 "<=" 0x04 ">=" 0x05 "=" 0x06 "<>" DEFAULT_VALUE "UNKNOWN" /end COMPU_VTAB
/begin CHARACTERISTIC cfgout2_PU1lon "and AUX PU1 is{cfgout2_PU1lon&0xff=0x00:Ignored}{cfgout2_PU1lon&0xff=0x01:<}{cfgout2_PU1lon&0xff=0x02:>}{cfgout2_PU1lon&0xff=0x03:<=}{cfgout2_PU1lon&0xff=0x04:>=}{cfgout2_PU1lon&0xff=0x05:=}{cfgout2_PU1lon&0xff=0x06:<>}" VALUE 0x00149560 /* @ECU_Address@cfgout2_PU1lon@0x01001BF0@ */ ECIPP_ALIGNMENT_UBYTE 255 cfgout2_PU1lon_COMPU_VTAB 0 255 BIT_MASK 0xff /end CHARACTERISTIC
/begin COMPU_METHOD cfgout2_PU1lon_COMPU_VTAB "Verbal Table" TAB_VERB "%.0" "list" COMPU_TAB_REF cfgout2_PU1lon_COMPU_VTAB_REF /end COMPU_METHOD
/begin COMPU_VTAB cfgout2_PU1lon_COMPU_VTAB_REF "Verbal Table" TAB_VERB 7 0x00 "Ignored" 0x01 "<" 0x02 ">" 0x03 "<=" 0x04 ">=" 0x05 "=" 0x06 "<>" DEFAULT_VALUE "UNKNOWN" /end COMPU_VTAB
/begin CHARACTERISTIC cfgout2_PD1loff "and AUX PD1 is{cfgout2_PD1loff&0xff=0x00:Ignored}{cfgout2_PD1loff&0xff=0x01:<}{cfgout2_PD1loff&0xff=0x02:>}{cfgout2_PD1loff&0xff=0x03:<=}{cfgout2_PD1loff&0xff=0x04:>=}{cfgout2_PD1loff&0xff=0x05:=}{cfgout2_PD1loff&0xff=0x06:<>}" VALUE 0x0014956B /* @ECU_Address@cfgout2_PD1loff@0x01001BF8@ */ ECIPP_ALIGNMENT_UBYTE 255 cfgout2_PD1loff_COMPU_VTAB 0 255 BIT_MASK 0xff /end CHARACTERISTIC
/begin COMPU_METHOD cfgout2_PD1loff_COMPU_VTAB "Verbal Table" TAB_VERB "%.0" "list" COMPU_TAB_REF cfgout2_PD1loff_COMPU_VTAB_REF /end COMPU_METHOD
/begin COMPU_VTAB cfgout2_PD1loff_COMPU_VTAB_REF "Verbal Table" TAB_VERB 7 0x00 "Ignored" 0x01 "<" 0x02 ">" 0x03 "<=" 0x04 ">=" 0x05 "=" 0x06 "<>" DEFAULT_VALUE "UNKNOWN" /end COMPU_VTAB
/begin CHARACTERISTIC cfgout2_PU1loff "and AUX PU1 is{cfgout2_PU1loff&0xff=0x00:Ignored}{cfgout2_PU1loff&0xff=0x01:<}{cfgout2_PU1loff&0xff=0x02:>}{cfgout2_PU1loff&0xff=0x03:<=}{cfgout2_PU1loff&0xff=0x04:>=}{cfgout2_PU1loff&0xff=0x05:=}{cfgout2_PU1loff&0xff=0x06:<>}" VALUE 0x0014956C /* @ECU_Address@cfgout2_PU1loff@0x01001C00@ */ ECIPP_ALIGNMENT_UBYTE 255 cfgout2_PU1loff_COMPU_VTAB 0 255 BIT_MASK 0xff /end CHARACTERISTIC
/begin COMPU_METHOD cfgout2_PU1loff_COMPU_VTAB "Verbal Table" TAB_VERB "%.0" "list" COMPU_TAB_REF cfgout2_PU1loff_COMPU_VTAB_REF /end COMPU_METHOD
/begin COMPU_VTAB cfgout2_PU1loff_COMPU_VTAB_REF "Verbal Table" TAB_VERB 7 0x00 "Ignored" 0x01 "<" 0x02 ">" 0x03 "<=" 0x04 ">=" 0x05 "=" 0x06 "<>" DEFAULT_VALUE "UNKNOWN" /end COMPU_VTAB
/begin CHARACTERISTIC cfgout2_PD1on "PD1_on" VALUE 0x0014957A /* @ECU_Address@cfgout2_PD1on@0x01001C08@ */ ECIPP_ALIGNMENT_UWORD 5 Compu_cfgout2_PD1on 0 5.00114468864469 /end CHARACTERISTIC
/begin COMPU_METHOD Compu_cfgout2_PD1on " " RAT_FUNC "%.2" "volts" COEFFS 0 13104 0 0 0 1 /end COMPU_METHOD
/begin CHARACTERISTIC cfgout2_PU1on "PU1_on" VALUE 0x0014957C /* @ECU_Address@cfgout2_PU1on@0x01001C10@ */ ECIPP_ALIGNMENT_UWORD 5 Compu_cfgout2_PU1on 0 5.00114468864469 /end CHARACTERISTIC
/begin COMPU_METHOD Compu_cfgout2_PU1on " " RAT_FUNC "%.2" "volts" COEFFS 0 13104 0 0 0 1 /end COMPU_METHOD
/begin CHARACTERISTIC cfgout2_PD1off "PD1_off" VALUE 0x00149592 /* @ECU_Address@cfgout2_PD1off@0x01001C18@ */ ECIPP_ALIGNMENT_UWORD 5 Compu_cfgout2_PD1off 0 5.00114468864469 /end CHARACTERISTIC
/begin COMPU_METHOD Compu_cfgout2_PD1off " " RAT_FUNC "%.2" "volts" COEFFS 0 13104 0 0 0 1 /end COMPU_METHOD
/begin CHARACTERISTIC cfgout2_PU1off "PU1_off" VALUE 0x00149594 /* @ECU_Address@cfgout2_PU1off@0x01001C20@ */ ECIPP_ALIGNMENT_UWORD 5 Compu_cfgout2_PU1off 0 5.00114468864469 /end CHARACTERISTIC
/begin COMPU_METHOD Compu_cfgout2_PU1off " " RAT_FUNC "%.2" "volts" COEFFS 0 13104 0 0 0 1 /end COMPU_METHOD
/begin CHARACTERISTIC cfgout_OilPlon "and Oil Pressure is{cfgout_OilPlon&0xff=0x00:Ignored}{cfgout_OilPlon&0xff=0x01:<}{cfgout_OilPlon&0xff=0x02:>}{cfgout_OilPlon&0xff=0x03:<=}{cfgout_OilPlon&0xff=0x04:>=}{cfgout_OilPlon&0xff=0x05:=}{cfgout_OilPlon&0xff=0x06:<>}" VALUE 0x00149509 /* @ECU_Address@cfgout_OilPlon@0x01001C28@ */ ECIPP_ALIGNMENT_UBYTE 255 cfgout_OilPlon_COMPU_VTAB 0 255 BIT_MASK 0xff /end CHARACTERISTIC
/begin COMPU_METHOD cfgout_OilPlon_COMPU_VTAB "Verbal Table" TAB_VERB "%.0" "list" COMPU_TAB_REF cfgout_OilPlon_COMPU_VTAB_REF /end COMPU_METHOD
/begin COMPU_VTAB cfgout_OilPlon_COMPU_VTAB_REF "Verbal Table" TAB_VERB 7 0x00 "Ignored" 0x01 "<" 0x02 ">" 0x03 "<=" 0x04 ">=" 0x05 "=" 0x06 "<>" DEFAULT_VALUE "UNKNOWN" /end COMPU_VTAB
/begin CHARACTERISTIC cfgout_OilPloff "and Oil Pressure is{cfgout_OilPloff&0xff=0x00:Ignored}{cfgout_OilPloff&0xff=0x01:<}{cfgout_OilPloff&0xff=0x02:>}{cfgout_OilPloff&0xff=0x03:<=}{cfgout_OilPloff&0xff=0x04:>=}{cfgout_OilPloff&0xff=0x05:=}{cfgout_OilPloff&0xff=0x06:<>}" VALUE 0x00149515 /* @ECU_Address@cfgout_OilPloff@0x01001C30@ */ ECIPP_ALIGNMENT_UBYTE 255 cfgout_OilPloff_COMPU_VTAB 0 255 BIT_MASK 0xff /end CHARACTERISTIC
/begin COMPU_METHOD cfgout_OilPloff_COMPU_VTAB "Verbal Table" TAB_VERB "%.0" "list" COMPU_TAB_REF cfgout_OilPloff_COMPU_VTAB_REF /end COMPU_METHOD
/begin COMPU_VTAB cfgout_OilPloff_COMPU_VTAB_REF "Verbal Table" TAB_VERB 7 0x00 "Ignored" 0x01 "<" 0x02 ">" 0x03 "<=" 0x04 ">=" 0x05 "=" 0x06 "<>" DEFAULT_VALUE "UNKNOWN" /end COMPU_VTAB
/begin CHARACTERISTIC cfgout2_OilPlon "and Oil Pressure is{cfgout2_OilPlon&0xff=0x00:Ignored}{cfgout2_OilPlon&0xff=0x01:<}{cfgout2_OilPlon&0xff=0x02:>}{cfgout2_OilPlon&0xff=0x03:<=}{cfgout2_OilPlon&0xff=0x04:>=}{cfgout2_OilPlon&0xff=0x05:=}{cfgout2_OilPlon&0xff=0x06:<>}" VALUE 0x00149561 /* @ECU_Address@cfgout2_OilPlon@0x01001C38@ */ ECIPP_ALIGNMENT_UBYTE 255 cfgout2_OilPlon_COMPU_VTAB 0 255 BIT_MASK 0xff /end CHARACTERISTIC
/begin COMPU_METHOD cfgout2_OilPlon_COMPU_VTAB "Verbal Table" TAB_VERB "%.0" "list" COMPU_TAB_REF cfgout2_OilPlon_COMPU_VTAB_REF /end COMPU_METHOD
/begin COMPU_VTAB cfgout2_OilPlon_COMPU_VTAB_REF "Verbal Table" TAB_VERB 7 0x00 "Ignored" 0x01 "<" 0x02 ">" 0x03 "<=" 0x04 ">=" 0x05 "=" 0x06 "<>" DEFAULT_VALUE "UNKNOWN" /end COMPU_VTAB
/begin CHARACTERISTIC cfgout2_OilPloff "and Oil Pressure is{cfgout2_OilPloff&0xff=0x00:Ignored}{cfgout2_OilPloff&0xff=0x01:<}{cfgout2_OilPloff&0xff=0x02:>}{cfgout2_OilPloff&0xff=0x03:<=}{cfgout2_OilPloff&0xff=0x04:>=}{cfgout2_OilPloff&0xff=0x05:=}{cfgout2_OilPloff&0xff=0x06:<>}" VALUE 0x0014956D /* @ECU_Address@cfgout2_OilPloff@0x01001C40@ */ ECIPP_ALIGNMENT_UBYTE 255 cfgout2_OilPloff_COMPU_VTAB 0 255 BIT_MASK 0xff /end CHARACTERISTIC
/begin COMPU_METHOD cfgout2_OilPloff_COMPU_VTAB "Verbal Table" TAB_VERB "%.0" "list" COMPU_TAB_REF cfgout2_OilPloff_COMPU_VTAB_REF /end COMPU_METHOD
/begin COMPU_VTAB cfgout2_OilPloff_COMPU_VTAB_REF "Verbal Table" TAB_VERB 7 0x00 "Ignored" 0x01 "<" 0x02 ">" 0x03 "<=" 0x04 ">=" 0x05 "=" 0x06 "<>" DEFAULT_VALUE "UNKNOWN" /end COMPU_VTAB
/begin CHARACTERISTIC cfgout_OilPon "OilP_on" VALUE 0x00149526 /* @ECU_Address@cfgout_OilPon@0x01001C48@ */ ECIPP_ALIGNMENT_UWORD 256 Compu_cfgout_OilPon 0 255.99609375 /end CHARACTERISTIC
/begin COMPU_METHOD Compu_cfgout_OilPon " " RAT_FUNC "%.1" "psig" COEFFS 0 256 0 0 0 1 /end COMPU_METHOD
/begin CHARACTERISTIC cfgout_OilPoff "OilP_off" VALUE 0x0014953E /* @ECU_Address@cfgout_OilPoff@0x01001C50@ */ ECIPP_ALIGNMENT_UWORD 256 Compu_cfgout_OilPoff 0 255.99609375 /end CHARACTERISTIC
/begin COMPU_METHOD Compu_cfgout_OilPoff " " RAT_FUNC "%.1" "psig" COEFFS 0 256 0 0 0 1 /end COMPU_METHOD
/begin CHARACTERISTIC cfgout2_OilPon "OilP_on" VALUE 0x0014957E /* @ECU_Address@cfgout2_OilPon@0x01001C58@ */ ECIPP_ALIGNMENT_UWORD 256 Compu_cfgout2_OilPon 0 255.99609375 /end CHARACTERISTIC
/begin COMPU_METHOD Compu_cfgout2_OilPon " " RAT_FUNC "%.1" "psig" COEFFS 0 256 0 0 0 1 /end COMPU_METHOD
/begin CHARACTERISTIC cfgout2_OilPoff "OilP_off" VALUE 0x00149596 /* @ECU_Address@cfgout2_OilPoff@0x01001C60@ */ ECIPP_ALIGNMENT_UWORD 256 Compu_cfgout2_OilPoff 0 255.99609375 /end CHARACTERISTIC
/begin COMPU_METHOD Compu_cfgout2_OilPoff " " RAT_FUNC "%.1" "psig" COEFFS 0 256 0 0 0 1 /end COMPU_METHOD
/begin CHARACTERISTIC cfgout3_RPMon "RPM_on" VALUE 0x001495CC /* @ECU_Address@cfgout3_RPMon@0x01001CF8@ */ ECIPP_ALIGNMENT_UWORD 65535 Compu_cfgout3_RPMon 0 65535 /end CHARACTERISTIC
/begin COMPU_METHOD Compu_cfgout3_RPMon " " RAT_FUNC "%.0" "rpm" COEFFS 0 1 0 0 0 1 /end COMPU_METHOD
/begin CHARACTERISTIC cfgout3_MAPon "MAP_on" VALUE 0x001495CE /* @ECU_Address@cfgout3_MAPon@0x01001D00@ */ ECIPP_ALIGNMENT_UWORD 256 Compu_cfgout3_MAPon 0 255.99609375 /end CHARACTERISTIC
/begin COMPU_METHOD Compu_cfgout3_MAPon " " RAT_FUNC "%.2" "psia" COEFFS 0 256 0 0 0 1 /end COMPU_METHOD
/begin CHARACTERISTIC cfgout3_ECTon "ECT_on" VALUE 0x001495D0 /* @ECU_Address@cfgout3_ECTon@0x01001D08@ */ ECIPP_ALIGNMENT_UWORD 564 Compu_cfgout3_ECTon -460 563.984375 /end CHARACTERISTIC
/begin COMPU_METHOD Compu_cfgout3_ECTon " " RAT_FUNC "%.1" "deg F" COEFFS 0 64 29440 0 0 1 /end COMPU_METHOD
/begin CHARACTERISTIC cfgout3_RPMoff "RPM_off" VALUE 0x001495E4 /* @ECU_Address@cfgout3_RPMoff@0x01001D10@ */ ECIPP_ALIGNMENT_UWORD 65535 Compu_cfgout3_RPMoff 0 65535 /end CHARACTERISTIC
/begin COMPU_METHOD Compu_cfgout3_RPMoff " " RAT_FUNC "%.0" "rpm" COEFFS 0 1 0 0 0 1 /end COMPU_METHOD
/begin CHARACTERISTIC cfgout3_MAPoff "MAP_off" VALUE 0x001495E6 /* @ECU_Address@cfgout3_MAPoff@0x01001D18@ */ ECIPP_ALIGNMENT_UWORD 256 Compu_cfgout3_MAPoff 0 255.99609375 /end CHARACTERISTIC
/begin COMPU_METHOD Compu_cfgout3_MAPoff " " RAT_FUNC "%.2" "psia" COEFFS 0 256 0 0 0 1 /end COMPU_METHOD
/begin CHARACTERISTIC cfgout3_ECToff "ECT_off" VALUE 0x001495E8 /* @ECU_Address@cfgout3_ECToff@0x01001D20@ */ ECIPP_ALIGNMENT_UWORD 564 Compu_cfgout3_ECToff -460 563.984375 /end CHARACTERISTIC
/begin COMPU_METHOD Compu_cfgout3_ECToff " " RAT_FUNC "%.1" "deg F" COEFFS 0 64 29440 0 0 1 /end COMPU_METHOD
/begin CHARACTERISTIC cfgout3_RPMlon "RPM is{cfgout3_RPMlon&0xff=0x00:Ignored}{cfgout3_RPMlon&0xff=0x01:<}{cfgout3_RPMlon&0xff=0x02:>}{cfgout3_RPMlon&0xff=0x03:<=}{cfgout3_RPMlon&0xff=0x04:>=}{cfgout3_RPMlon&0xff=0x05:=}{cfgout3_RPMlon&0xff=0x06:<>}" VALUE 0x001495B4 /* @ECU_Address@cfgout3_RPMlon@0x01001D28@ */ ECIPP_ALIGNMENT_UBYTE 255 cfgout3_RPMlon_COMPU_VTAB 0 255 BIT_MASK 0xff /end CHARACTERISTIC
/begin COMPU_METHOD cfgout3_RPMlon_COMPU_VTAB "Verbal Table" TAB_VERB "%.0" "list" COMPU_TAB_REF cfgout3_RPMlon_COMPU_VTAB_REF /end COMPU_METHOD
/begin COMPU_VTAB cfgout3_RPMlon_COMPU_VTAB_REF "Verbal Table" TAB_VERB 7 0x00 "Ignored" 0x01 "<" 0x02 ">" 0x03 "<=" 0x04 ">=" 0x05 "=" 0x06 "<>" DEFAULT_VALUE "UNKNOWN" /end COMPU_VTAB
/begin CHARACTERISTIC cfgout3_MAPlon "and MAP is{cfgout3_MAPlon&0xff=0x00:Ignored}{cfgout3_MAPlon&0xff=0x01:<}{cfgout3_MAPlon&0xff=0x02:>}{cfgout3_MAPlon&0xff=0x03:<=}{cfgout3_MAPlon&0xff=0x04:>=}{cfgout3_MAPlon&0xff=0x05:=}{cfgout3_MAPlon&0xff=0x06:<>}" VALUE 0x001495B5 /* @ECU_Address@cfgout3_MAPlon@0x01001D30@ */ ECIPP_ALIGNMENT_UBYTE 255 cfgout3_MAPlon_COMPU_VTAB 0 255 BIT_MASK 0xff /end CHARACTERISTIC
/begin COMPU_METHOD cfgout3_MAPlon_COMPU_VTAB "Verbal Table" TAB_VERB "%.0" "list" COMPU_TAB_REF cfgout3_MAPlon_COMPU_VTAB_REF /end COMPU_METHOD
/begin COMPU_VTAB cfgout3_MAPlon_COMPU_VTAB_REF "Verbal Table" TAB_VERB 7 0x00 "Ignored" 0x01 "<" 0x02 ">" 0x03 "<=" 0x04 ">=" 0x05 "=" 0x06 "<>" DEFAULT_VALUE "UNKNOWN" /end COMPU_VTAB
/begin CHARACTERISTIC cfgout3_ECTlon "and ECT is{cfgout3_ECTlon&0xff=0x00:Ignored}{cfgout3_ECTlon&0xff=0x01:<}{cfgout3_ECTlon&0xff=0x02:>}{cfgout3_ECTlon&0xff=0x03:<=}{cfgout3_ECTlon&0xff=0x04:>=}{cfgout3_ECTlon&0xff=0x05:=}{cfgout3_ECTlon&0xff=0x06:<>}" VALUE 0x001495B6 /* @ECU_Address@cfgout3_ECTlon@0x01001D38@ */ ECIPP_ALIGNMENT_UBYTE 255 cfgout3_ECTlon_COMPU_VTAB 0 255 BIT_MASK 0xff /end CHARACTERISTIC
/begin COMPU_METHOD cfgout3_ECTlon_COMPU_VTAB "Verbal Table" TAB_VERB "%.0" "list" COMPU_TAB_REF cfgout3_ECTlon_COMPU_VTAB_REF /end COMPU_METHOD
/begin COMPU_VTAB cfgout3_ECTlon_COMPU_VTAB_REF "Verbal Table" TAB_VERB 7 0x00 "Ignored" 0x01 "<" 0x02 ">" 0x03 "<=" 0x04 ">=" 0x05 "=" 0x06 "<>" DEFAULT_VALUE "UNKNOWN" /end COMPU_VTAB
/begin CHARACTERISTIC cfgout3_RPMloff "RPM is{cfgout3_RPMloff&0xff=0x00:Ignored}{cfgout3_RPMloff&0xff=0x01:<}{cfgout3_RPMloff&0xff=0x02:>}{cfgout3_RPMloff&0xff=0x03:<=}{cfgout3_RPMloff&0xff=0x04:>=}{cfgout3_RPMloff&0xff=0x05:=}{cfgout3_RPMloff&0xff=0x06:<>}" VALUE 0x001495C0 /* @ECU_Address@cfgout3_RPMloff@0x01001D40@ */ ECIPP_ALIGNMENT_UBYTE 255 cfgout3_RPMloff_COMPU_VTAB 0 255 BIT_MASK 0xff /end CHARACTERISTIC
/begin COMPU_METHOD cfgout3_RPMloff_COMPU_VTAB "Verbal Table" TAB_VERB "%.0" "list" COMPU_TAB_REF cfgout3_RPMloff_COMPU_VTAB_REF /end COMPU_METHOD
/begin COMPU_VTAB cfgout3_RPMloff_COMPU_VTAB_REF "Verbal Table" TAB_VERB 7 0x00 "Ignored" 0x01 "<" 0x02 ">" 0x03 "<=" 0x04 ">=" 0x05 "=" 0x06 "<>" DEFAULT_VALUE "UNKNOWN" /end COMPU_VTAB
/begin CHARACTERISTIC cfgout3_MAPloff "and MAP is{cfgout3_MAPloff&0xff=0x00:Ignored}{cfgout3_MAPloff&0xff=0x01:<}{cfgout3_MAPloff&0xff=0x02:>}{cfgout3_MAPloff&0xff=0x03:<=}{cfgout3_MAPloff&0xff=0x04:>=}{cfgout3_MAPloff&0xff=0x05:=}{cfgout3_MAPloff&0xff=0x06:<>}" VALUE 0x001495C1 /* @ECU_Address@cfgout3_MAPloff@0x01001D48@ */ ECIPP_ALIGNMENT_UBYTE 255 cfgout3_MAPloff_COMPU_VTAB 0 255 BIT_MASK 0xff /end CHARACTERISTIC
/begin COMPU_METHOD cfgout3_MAPloff_COMPU_VTAB "Verbal Table" TAB_VERB "%.0" "list" COMPU_TAB_REF cfgout3_MAPloff_COMPU_VTAB_REF /end COMPU_METHOD
/begin COMPU_VTAB cfgout3_MAPloff_COMPU_VTAB_REF "Verbal Table" TAB_VERB 7 0x00 "Ignored" 0x01 "<" 0x02 ">" 0x03 "<=" 0x04 ">=" 0x05 "=" 0x06 "<>" DEFAULT_VALUE "UNKNOWN" /end COMPU_VTAB
/begin CHARACTERISTIC cfgout3_ECTloff "and ECT is{cfgout3_ECTloff&0xff=0x00:Ignored}{cfgout3_ECTloff&0xff=0x01:<}{cfgout3_ECTloff&0xff=0x02:>}{cfgout3_ECTloff&0xff=0x03:<=}{cfgout3_ECTloff&0xff=0x04:>=}{cfgout3_ECTloff&0xff=0x05:=}{cfgout3_ECTloff&0xff=0x06:<>}" VALUE 0x001495C2 /* @ECU_Address@cfgout3_ECTloff@0x01001D50@ */ ECIPP_ALIGNMENT_UBYTE 255 cfgout3_ECTloff_COMPU_VTAB 0 255 BIT_MASK 0xff /end CHARACTERISTIC
/begin COMPU_METHOD cfgout3_ECTloff_COMPU_VTAB "Verbal Table" TAB_VERB "%.0" "list" COMPU_TAB_REF cfgout3_ECTloff_COMPU_VTAB_REF /end COMPU_METHOD
/begin COMPU_VTAB cfgout3_ECTloff_COMPU_VTAB_REF "Verbal Table" TAB_VERB 7 0x00 "Ignored" 0x01 "<" 0x02 ">" 0x03 "<=" 0x04 ">=" 0x05 "=" 0x06 "<>" DEFAULT_VALUE "UNKNOWN" /end COMPU_VTAB
/begin CHARACTERISTIC cfgout3_on_wait "persistently longer than" VALUE 0x001495FC /* @ECU_Address@cfgout3_on_wait@0x01001D58@ */ ECIPP_ALIGNMENT_UWORD 66 Compu_cfgout3_on_wait 0 65.535 /end CHARACTERISTIC
/begin COMPU_METHOD Compu_cfgout3_on_wait " " RAT_FUNC "%.1" "seconds" COEFFS 0 1000 0 0 0 1 /end COMPU_METHOD
/begin CHARACTERISTIC cfgout3_off_wait "persistently longer than" VALUE 0x001495FE /* @ECU_Address@cfgout3_off_wait@0x01001D60@ */ ECIPP_ALIGNMENT_UWORD 66 Compu_cfgout3_off_wait 0 65.535 /end CHARACTERISTIC
/begin COMPU_METHOD Compu_cfgout3_off_wait " " RAT_FUNC "%.1" "seconds" COEFFS 0 1000 0 0 0 1 /end COMPU_METHOD
/begin CHARACTERISTIC cfgout3_chan "Configurable output channel #3{cfgout3_chan&0xff=0:Disabled}{cfgout3_chan&0xff=1:Aux PWM1}{cfgout3_chan&0xff=2:Aux PWM2}{cfgout3_chan&0xff=3:Aux PWM3}{cfgout3_chan&0xff=4:Aux PWM4}{cfgout3_chan&0xff=5:Aux PWM5}{cfgout3_chan&0xff=6:Aux PWM6}{cfgout3_chan&0" VALUE 0x001495A8 /* @ECU_Address@cfgout3_chan@0x01001D68@ */ ECIPP_ALIGNMENT_UBYTE 255 cfgout3_chan_COMPU_VTAB 0 255 BIT_MASK 0xff /end CHARACTERISTIC
/begin COMPU_METHOD cfgout3_chan_COMPU_VTAB "Verbal Table" TAB_VERB "%.0" "list" COMPU_TAB_REF cfgout3_chan_COMPU_VTAB_REF /end COMPU_METHOD
/begin COMPU_VTAB cfgout3_chan_COMPU_VTAB_REF "Verbal Table" TAB_VERB 16 0 "Disabled" 1 "Aux PWM1" 2 "Aux PWM2" 3 "Aux PWM3" 4 "Aux PWM4" 5 "Aux PWM5" 6 "Aux PWM6" 7 "Aux PWM7" 8 "Aux PWM8" 9 "Aux PWM9" 10 "Aux PWM10" 11 "Aux PWM11" 12 "Aux PWM12" 13 "Aux PWM13" 14 "Aux PWM14" 15 "Aux PWM15" DEFAULT_VALUE "UNKNOWN" /end COMPU_VTAB
/begin CHARACTERISTIC cfgout3_stopped "Engine stopped state{cfgout3_stopped&0xff=0x00:Off}{cfgout3_stopped&0xff=0x01:On}{cfgout3_stopped&0xff=0x02:Automatic}" VALUE 0x001495A9 /* @ECU_Address@cfgout3_stopped@0x01001D70@ */ ECIPP_ALIGNMENT_UBYTE 255 cfgout3_stopped_COMPU_VTAB 0 255 BIT_MASK 0xff /end CHARACTERISTIC
/begin COMPU_METHOD cfgout3_stopped_COMPU_VTAB "Verbal Table" TAB_VERB "%.0" "list" COMPU_TAB_REF cfgout3_stopped_COMPU_VTAB_REF /end COMPU_METHOD
/begin COMPU_VTAB cfgout3_stopped_COMPU_VTAB_REF "Verbal Table" TAB_VERB 3 0x00 "Off" 0x01 "On" 0x02 "Automatic" DEFAULT_VALUE "UNKNOWN" /end COMPU_VTAB
/begin CHARACTERISTIC cfgout3_cranking "Engine cranking state{cfgout3_cranking&0xff=0x00:Off}{cfgout3_cranking&0xff=0x01:On}{cfgout3_cranking&0xff=0x02:Automatic}" VALUE 0x001495AA /* @ECU_Address@cfgout3_cranking@0x01001D78@ */ ECIPP_ALIGNMENT_UBYTE 255 cfgout3_cranking_COMPU_VTAB 0 255 BIT_MASK 0xff /end CHARACTERISTIC
/begin COMPU_METHOD cfgout3_cranking_COMPU_VTAB "Verbal Table" TAB_VERB "%.0" "list" COMPU_TAB_REF cfgout3_cranking_COMPU_VTAB_REF /end COMPU_METHOD
/begin COMPU_VTAB cfgout3_cranking_COMPU_VTAB_REF "Verbal Table" TAB_VERB 3 0x00 "Off" 0x01 "On" 0x02 "Automatic" DEFAULT_VALUE "UNKNOWN" /end COMPU_VTAB
/begin CHARACTERISTIC cfgout3_running "Engine running state{cfgout3_running&0xff=0x00:Off}{cfgout3_running&0xff=0x01:On}{cfgout3_running&0xff=0x02:Automatic}" VALUE 0x001495AB /* @ECU_Address@cfgout3_running@0x01001D80@ */ ECIPP_ALIGNMENT_UBYTE 255 cfgout3_running_COMPU_VTAB 0 255 BIT_MASK 0xff /end CHARACTERISTIC
/begin COMPU_METHOD cfgout3_running_COMPU_VTAB "Verbal Table" TAB_VERB "%.0" "list" COMPU_TAB_REF cfgout3_running_COMPU_VTAB_REF /end COMPU_METHOD
/begin COMPU_VTAB cfgout3_running_COMPU_VTAB_REF "Verbal Table" TAB_VERB 3 0x00 "Off" 0x01 "On" 0x02 "Automatic" DEFAULT_VALUE "UNKNOWN" /end COMPU_VTAB
/begin CHARACTERISTIC cfgout3_PD1lon "and AUX PD1 is{cfgout3_PD1lon&0xff=0x00:Ignored}{cfgout3_PD1lon&0xff=0x01:<}{cfgout3_PD1lon&0xff=0x02:>}{cfgout3_PD1lon&0xff=0x03:<=}{cfgout3_PD1lon&0xff=0x04:>=}{cfgout3_PD1lon&0xff=0x05:=}{cfgout3_PD1lon&0xff=0x06:<>}" VALUE 0x001495B7 /* @ECU_Address@cfgout3_PD1lon@0x01001D90@ */ ECIPP_ALIGNMENT_UBYTE 255 cfgout3_PD1lon_COMPU_VTAB 0 255 BIT_MASK 0xff /end CHARACTERISTIC
/begin COMPU_METHOD cfgout3_PD1lon_COMPU_VTAB "Verbal Table" TAB_VERB "%.0" "list" COMPU_TAB_REF cfgout3_PD1lon_COMPU_VTAB_REF /end COMPU_METHOD
/begin COMPU_VTAB cfgout3_PD1lon_COMPU_VTAB_REF "Verbal Table" TAB_VERB 7 0x00 "Ignored" 0x01 "<" 0x02 ">" 0x03 "<=" 0x04 ">=" 0x05 "=" 0x06 "<>" DEFAULT_VALUE "UNKNOWN" /end COMPU_VTAB
/begin CHARACTERISTIC cfgout3_PU1lon "and AUX PU1 is{cfgout3_PU1lon&0xff=0x00:Ignored}{cfgout3_PU1lon&0xff=0x01:<}{cfgout3_PU1lon&0xff=0x02:>}{cfgout3_PU1lon&0xff=0x03:<=}{cfgout3_PU1lon&0xff=0x04:>=}{cfgout3_PU1lon&0xff=0x05:=}{cfgout3_PU1lon&0xff=0x06:<>}" VALUE 0x001495B8 /* @ECU_Address@cfgout3_PU1lon@0x01001D98@ */ ECIPP_ALIGNMENT_UBYTE 255 cfgout3_PU1lon_COMPU_VTAB 0 255 BIT_MASK 0xff /end CHARACTERISTIC
/begin COMPU_METHOD cfgout3_PU1lon_COMPU_VTAB "Verbal Table" TAB_VERB "%.0" "list" COMPU_TAB_REF cfgout3_PU1lon_COMPU_VTAB_REF /end COMPU_METHOD
/begin COMPU_VTAB cfgout3_PU1lon_COMPU_VTAB_REF "Verbal Table" TAB_VERB 7 0x00 "Ignored" 0x01 "<" 0x02 ">" 0x03 "<=" 0x04 ">=" 0x05 "=" 0x06 "<>" DEFAULT_VALUE "UNKNOWN" /end COMPU_VTAB
/begin CHARACTERISTIC cfgout3_PD1loff "and AUX PD1 is{cfgout3_PD1loff&0xff=0x00:Ignored}{cfgout3_PD1loff&0xff=0x01:<}{cfgout3_PD1loff&0xff=0x02:>}{cfgout3_PD1loff&0xff=0x03:<=}{cfgout3_PD1loff&0xff=0x04:>=}{cfgout3_PD1loff&0xff=0x05:=}{cfgout3_PD1loff&0xff=0x06:<>}" VALUE 0x001495C3 /* @ECU_Address@cfgout3_PD1loff@0x01001DA0@ */ ECIPP_ALIGNMENT_UBYTE 255 cfgout3_PD1loff_COMPU_VTAB 0 255 BIT_MASK 0xff /end CHARACTERISTIC
/begin COMPU_METHOD cfgout3_PD1loff_COMPU_VTAB "Verbal Table" TAB_VERB "%.0" "list" COMPU_TAB_REF cfgout3_PD1loff_COMPU_VTAB_REF /end COMPU_METHOD
/begin COMPU_VTAB cfgout3_PD1loff_COMPU_VTAB_REF "Verbal Table" TAB_VERB 7 0x00 "Ignored" 0x01 "<" 0x02 ">" 0x03 "<=" 0x04 ">=" 0x05 "=" 0x06 "<>" DEFAULT_VALUE "UNKNOWN" /end COMPU_VTAB
/begin CHARACTERISTIC cfgout3_PU1loff "and AUX PU1 is{cfgout3_PU1loff&0xff=0x00:Ignored}{cfgout3_PU1loff&0xff=0x01:<}{cfgout3_PU1loff&0xff=0x02:>}{cfgout3_PU1loff&0xff=0x03:<=}{cfgout3_PU1loff&0xff=0x04:>=}{cfgout3_PU1loff&0xff=0x05:=}{cfgout3_PU1loff&0xff=0x06:<>}" VALUE 0x001495C4 /* @ECU_Address@cfgout3_PU1loff@0x01001DA8@ */ ECIPP_ALIGNMENT_UBYTE 255 cfgout3_PU1loff_COMPU_VTAB 0 255 BIT_MASK 0xff /end CHARACTERISTIC
/begin COMPU_METHOD cfgout3_PU1loff_COMPU_VTAB "Verbal Table" TAB_VERB "%.0" "list" COMPU_TAB_REF cfgout3_PU1loff_COMPU_VTAB_REF /end COMPU_METHOD
/begin COMPU_VTAB cfgout3_PU1loff_COMPU_VTAB_REF "Verbal Table" TAB_VERB 7 0x00 "Ignored" 0x01 "<" 0x02 ">" 0x03 "<=" 0x04 ">=" 0x05 "=" 0x06 "<>" DEFAULT_VALUE "UNKNOWN" /end COMPU_VTAB
/begin CHARACTERISTIC cfgout3_PD1on "PD1_on" VALUE 0x001495D2 /* @ECU_Address@cfgout3_PD1on@0x01001DB0@ */ ECIPP_ALIGNMENT_UWORD 5 Compu_cfgout3_PD1on 0 5.00114468864469 /end CHARACTERISTIC
/begin COMPU_METHOD Compu_cfgout3_PD1on " " RAT_FUNC "%.2" "volts" COEFFS 0 13104 0 0 0 1 /end COMPU_METHOD
/begin CHARACTERISTIC cfgout3_PU1on "PU1_on" VALUE 0x001495D4 /* @ECU_Address@cfgout3_PU1on@0x01001DB8@ */ ECIPP_ALIGNMENT_UWORD 5 Compu_cfgout3_PU1on 0 5.00114468864469 /end CHARACTERISTIC
/begin COMPU_METHOD Compu_cfgout3_PU1on " " RAT_FUNC "%.2" "volts" COEFFS 0 13104 0 0 0 1 /end COMPU_METHOD
/begin CHARACTERISTIC cfgout3_PD1off "PD1_off" VALUE 0x001495EA /* @ECU_Address@cfgout3_PD1off@0x01001DC0@ */ ECIPP_ALIGNMENT_UWORD 5 Compu_cfgout3_PD1off 0 5.00114468864469 /end CHARACTERISTIC
/begin COMPU_METHOD Compu_cfgout3_PD1off " " RAT_FUNC "%.2" "volts" COEFFS 0 13104 0 0 0 1 /end COMPU_METHOD
/begin CHARACTERISTIC cfgout3_PU1off "PU1_off" VALUE 0x001495EC /* @ECU_Address@cfgout3_PU1off@0x01001DC8@ */ ECIPP_ALIGNMENT_UWORD 5 Compu_cfgout3_PU1off 0 5.00114468864469 /end CHARACTERISTIC
/begin COMPU_METHOD Compu_cfgout3_PU1off " " RAT_FUNC "%.2" "volts" COEFFS 0 13104 0 0 0 1 /end COMPU_METHOD
/begin CHARACTERISTIC cfgout3_OilPlon "and Oil Pressure is{cfgout3_OilPlon&0xff=0x00:Ignored}{cfgout3_OilPlon&0xff=0x01:<}{cfgout3_OilPlon&0xff=0x02:>}{cfgout3_OilPlon&0xff=0x03:<=}{cfgout3_OilPlon&0xff=0x04:>=}{cfgout3_OilPlon&0xff=0x05:=}{cfgout3_OilPlon&0xff=0x06:<>}" VALUE 0x001495B9 /* @ECU_Address@cfgout3_OilPlon@0x01001DD0@ */ ECIPP_ALIGNMENT_UBYTE 255 cfgout3_OilPlon_COMPU_VTAB 0 255 BIT_MASK 0xff /end CHARACTERISTIC
/begin COMPU_METHOD cfgout3_OilPlon_COMPU_VTAB "Verbal Table" TAB_VERB "%.0" "list" COMPU_TAB_REF cfgout3_OilPlon_COMPU_VTAB_REF /end COMPU_METHOD
/begin COMPU_VTAB cfgout3_OilPlon_COMPU_VTAB_REF "Verbal Table" TAB_VERB 7 0x00 "Ignored" 0x01 "<" 0x02 ">" 0x03 "<=" 0x04 ">=" 0x05 "=" 0x06 "<>" DEFAULT_VALUE "UNKNOWN" /end COMPU_VTAB
/begin CHARACTERISTIC cfgout3_OilPloff "and Oil Pressure is{cfgout3_OilPloff&0xff=0x00:Ignored}{cfgout3_OilPloff&0xff=0x01:<}{cfgout3_OilPloff&0xff=0x02:>}{cfgout3_OilPloff&0xff=0x03:<=}{cfgout3_OilPloff&0xff=0x04:>=}{cfgout3_OilPloff&0xff=0x05:=}{cfgout3_OilPloff&0xff=0x06:<>}" VALUE 0x001495C5 /* @ECU_Address@cfgout3_OilPloff@0x01001DD8@ */ ECIPP_ALIGNMENT_UBYTE 255 cfgout3_OilPloff_COMPU_VTAB 0 255 BIT_MASK 0xff /end CHARACTERISTIC
/begin COMPU_METHOD cfgout3_OilPloff_COMPU_VTAB "Verbal Table" TAB_VERB "%.0" "list" COMPU_TAB_REF cfgout3_OilPloff_COMPU_VTAB_REF /end COMPU_METHOD
/begin COMPU_VTAB cfgout3_OilPloff_COMPU_VTAB_REF "Verbal Table" TAB_VERB 7 0x00 "Ignored" 0x01 "<" 0x02 ">" 0x03 "<=" 0x04 ">=" 0x05 "=" 0x06 "<>" DEFAULT_VALUE "UNKNOWN" /end COMPU_VTAB
/begin CHARACTERISTIC cfgout3_OilPon "OilP_on" VALUE 0x001495D6 /* @ECU_Address@cfgout3_OilPon@0x01001DE0@ */ ECIPP_ALIGNMENT_UWORD 256 Compu_cfgout3_OilPon 0 255.99609375 /end CHARACTERISTIC
/begin COMPU_METHOD Compu_cfgout3_OilPon " " RAT_FUNC "%.1" "psig" COEFFS 0 256 0 0 0 1 /end COMPU_METHOD
/begin CHARACTERISTIC cfgout3_OilPoff "OilP_off" VALUE 0x001495EE /* @ECU_Address@cfgout3_OilPoff@0x01001DE8@ */ ECIPP_ALIGNMENT_UWORD 256 Compu_cfgout3_OilPoff 0 255.99609375 /end CHARACTERISTIC
/begin COMPU_METHOD Compu_cfgout3_OilPoff " " RAT_FUNC "%.1" "psig" COEFFS 0 256 0 0 0 1 /end COMPU_METHOD
/begin CHARACTERISTIC autocrk_trig "Start signal input{autocrk_trig&0xff=0:Disabled (key-on)}{autocrk_trig&0xff=1:Aux PU1 = Gnd}{autocrk_trig&0xff=2:Aux PU2 = Gnd}{autocrk_trig&0xff=3:Aux PU3 = Gnd}{autocrk_trig&0xff=4:Aux PUD1 = Gnd}{autocrk_trig&0xff=5:Aux PUD2 = Gnd}{autocrk_trig&0xff=6:" VALUE 0x001480f7 /* @ECU_Address@autocrk_trig@0x01001EC0@ */ ECIPP_ALIGNMENT_UBYTE 255 autocrk_trig_COMPU_VTAB 0 255 BIT_MASK 0xff /end CHARACTERISTIC
/begin COMPU_METHOD autocrk_trig_COMPU_VTAB "Verbal Table" TAB_VERB "%.0" "list" COMPU_TAB_REF autocrk_trig_COMPU_VTAB_REF /end COMPU_METHOD
/begin COMPU_VTAB autocrk_trig_COMPU_VTAB_REF "Verbal Table" TAB_VERB 22 0 "Disabled (key-on)" 1 "Aux PU1 = Gnd" 2 "Aux PU2 = Gnd" 3 "Aux PU3 = Gnd" 4 "Aux PUD1 = Gnd" 5 "Aux PUD2 = Gnd" 6 "Aux PUD3 = Gnd" 7 "Aux DIG1 = +V" 8 "Aux DIG2 = +V" 9 "Aux DIG3 = +V" 10 "Aux DIG4 = +V" 11 "Aux DIG5 = +V" 12 "Aux DIG6 = +V" 13 "Aux DIG7 = +V" 14 "Aux DIG8 = +V" 15 "Aux DIG9 = +V" 16 "Aux DIG10 = +V" 17 "Aux DIG11 = +V" 18 "Aux DIG12 = +V" 19 "J1939 key state" 20 "Proprietary CAN msg" 21 "Standard" DEFAULT_VALUE "UNKNOWN" /end COMPU_VTAB
/begin CHARACTERISTIC SD_out_ena "Shutdown output{SD_out_ena&0xff=0:Disabled}{SD_out_ena&0xff=1:Aux PWM1}{SD_out_ena&0xff=2:Aux PWM2}{SD_out_ena&0xff=3:Aux PWM3}{SD_out_ena&0xff=4:Aux PWM4}{SD_out_ena&0xff=5:Aux PWM5}" VALUE 0x00147f2d /* @ECU_Address@SD_out_ena@0x01002098@ */ ECIPP_ALIGNMENT_UBYTE 255 SD_out_ena_COMPU_VTAB 0 255 BIT_MASK 0xff /end CHARACTERISTIC
/begin COMPU_METHOD SD_out_ena_COMPU_VTAB "Verbal Table" TAB_VERB "%.0" "list" COMPU_TAB_REF SD_out_ena_COMPU_VTAB_REF /end COMPU_METHOD
/begin COMPU_VTAB SD_out_ena_COMPU_VTAB_REF "Verbal Table" TAB_VERB 6 0 "Disabled" 1 "Aux PWM1" 2 "Aux PWM2" 3 "Aux PWM3" 4 "Aux PWM4" 5 "Aux PWM5" DEFAULT_VALUE "UNKNOWN" /end COMPU_VTAB
/begin CHARACTERISTIC tach_mode "Tachometer output mode{tach_mode&0xff=0:1 pulse/cylinder}{tach_mode&0xff=1:custom pulse/rev}" VALUE 0x001481bf /* @ECU_Address@tach_mode@0x01002160@ */ ECIPP_ALIGNMENT_UBYTE 255 tach_mode_COMPU_VTAB 0 255 BIT_MASK 0xff /end CHARACTERISTIC
/begin COMPU_METHOD tach_mode_COMPU_VTAB "Verbal Table" TAB_VERB "%.0" "list" COMPU_TAB_REF tach_mode_COMPU_VTAB_REF /end COMPU_METHOD
/begin COMPU_VTAB tach_mode_COMPU_VTAB_REF "Verbal Table" TAB_VERB 2 0 "1 pulse/cylinder" 1 "custom pulse/rev" DEFAULT_VALUE "UNKNOWN" /end COMPU_VTAB
/begin CHARACTERISTIC tach_pprev "Tachometer custom frequency" VALUE 0x00147bb6 /* @ECU_Address@tach_pprev@0x01002168@ */ ECIPP_ALIGNMENT_UWORD 256 Compu_tach_pprev 0 255.99609375 /end CHARACTERISTIC
/begin COMPU_METHOD Compu_tach_pprev " " RAT_FUNC "%.2" "pulses/rev" COEFFS 0 256 0 0 0 1 /end COMPU_METHOD
/begin MEASUREMENT MJI_flash_wr_left "Internal flash writes remaining" SBYTE Compu_MJI_flash_wr_left 0 0 -128 127 ECU_ADDRESS 0x01002448 /end MEASUREMENT
/begin COMPU_METHOD Compu_MJI_flash_wr_left " " RAT_FUNC "%.0" "count" COEFFS 0 1 0 0 0 1 /end COMPU_METHOD
/begin MEASUREMENT MJI_flash_wr_force "Internal flash write request{MJI_flash_wr_force&0xff=0:Idle}{MJI_flash_wr_force&0xff=1:Write Flash}" UBYTE MJI_flash_wr_force_COMPU_VTAB 0 0 0 255 ECU_ADDRESS 0x01002450 BIT_MASK 0xff /end MEASUREMENT
/begin COMPU_METHOD MJI_flash_wr_force_COMPU_VTAB "Verbal Table" TAB_VERB "%.0" "list" COMPU_TAB_REF MJI_flash_wr_force_COMPU_VTAB_REF /end COMPU_METHOD
/begin COMPU_VTAB MJI_flash_wr_force_COMPU_VTAB_REF "Verbal Table" TAB_VERB 2 0 "Idle" 1 "Write Flash" DEFAULT_VALUE "UNKNOWN" /end COMPU_VTAB
/begin MEASUREMENT MJI_cur_cal_mod "Internal current EPR cal model" ULONG Compu_MJI_cur_cal_mod 0 0 0 4294967295 ECU_ADDRESS 0x01002458 /end MEASUREMENT
/begin COMPU_METHOD Compu_MJI_cur_cal_mod " " RAT_FUNC "%.0" "-" COEFFS 0 1 0 0 0 1 /end COMPU_METHOD
/begin CHARACTERISTIC PN_MJ_eng_cal_mod "Engine calibration EPR cal model" VALUE 0x0014410c /* @ECU_Address@PN_MJ_eng_cal_mod@0x01002460@ */ ECIPP_ALIGNMENT_ULONG 4294967295 Compu_PN_MJ_eng_cal_mod 0 4294967295 /end CHARACTERISTIC
/begin COMPU_METHOD Compu_PN_MJ_eng_cal_mod " " RAT_FUNC "%.0" "-" COEFFS 0 1 0 0 0 1 /end COMPU_METHOD
/begin MEASUREMENT MJ_param_differ "EPR cal parameter status{MJ_param_differ&0xff=0:Params Match}{MJ_param_differ&0xff=1:Params Do Not Match}" UBYTE MJ_param_differ_COMPU_VTAB 0 0 0 255 ECU_ADDRESS 0x01002478 BIT_MASK 0xff /end MEASUREMENT
/begin COMPU_METHOD MJ_param_differ_COMPU_VTAB "Verbal Table" TAB_VERB "%.0" "list" COMPU_TAB_REF MJ_param_differ_COMPU_VTAB_REF /end COMPU_METHOD
/begin COMPU_VTAB MJ_param_differ_COMPU_VTAB_REF "Verbal Table" TAB_VERB 2 0 "Params Match" 1 "Params Do Not Match" DEFAULT_VALUE "UNKNOWN" /end COMPU_VTAB
/begin MEASUREMENT MJ_param_upload "EPR cal upload from MJ{MJ_param_upload&0xff=0:Idle}{MJ_param_upload&0xff=1:Upload Params From MJ}" UBYTE MJ_param_upload_COMPU_VTAB 0 0 0 255 ECU_ADDRESS 0x01002480 BIT_MASK 0xff /end MEASUREMENT
/begin COMPU_METHOD MJ_param_upload_COMPU_VTAB "Verbal Table" TAB_VERB "%.0" "list" COMPU_TAB_REF MJ_param_upload_COMPU_VTAB_REF /end COMPU_METHOD
/begin COMPU_VTAB MJ_param_upload_COMPU_VTAB_REF "Verbal Table" TAB_VERB 2 0 "Idle" 1 "Upload Params From MJ" DEFAULT_VALUE "UNKNOWN" /end COMPU_VTAB
/begin MEASUREMENT MJ_intF_bits "EPR fault bits" ULONG Compu_MJ_intF_bits 0 0 0 4294967295 ECU_ADDRESS 0x01002488 /end MEASUREMENT
/begin COMPU_METHOD Compu_MJ_intF_bits " " RAT_FUNC "%.0" "bits" COEFFS 0 1 0 0 0 1 /end COMPU_METHOD
/begin CHARACTERISTIC TransFPP_ena "Trans FPP PWM output{TransFPP_ena&0xff=0:Disabled}{TransFPP_ena&0xff=1:Not Available}{TransFPP_ena&0xff=2:Not Available}{TransFPP_ena&0xff=3:Aux PWM1}{TransFPP_ena&0xff=4:Aux PWM2}{TransFPP_ena&0xff=5:Aux PWM3}{TransFPP_ena&0xff=6:Aux PWM4}{TransFPP_ena&0" VALUE 0x001480cb /* @ECU_Address@TransFPP_ena@0x01002810@ */ ECIPP_ALIGNMENT_UBYTE 255 TransFPP_ena_COMPU_VTAB 0 255 BIT_MASK 0xff /end CHARACTERISTIC
/begin COMPU_METHOD TransFPP_ena_COMPU_VTAB "Verbal Table" TAB_VERB "%.0" "list" COMPU_TAB_REF TransFPP_ena_COMPU_VTAB_REF /end COMPU_METHOD
/begin COMPU_VTAB TransFPP_ena_COMPU_VTAB_REF "Verbal Table" TAB_VERB 9 0 "Disabled" 1 "Not Available" 2 "Not Available" 3 "Aux PWM1" 4 "Aux PWM2" 5 "Aux PWM3" 6 "Aux PWM4" 7 "Aux PWM5" 8 "Aux PWM6" DEFAULT_VALUE "UNKNOWN" /end COMPU_VTAB
/begin CHARACTERISTIC TransFPP_per "Trans FPP period" VALUE 0x00147990 /* @ECU_Address@TransFPP_per@0x01002818@ */ ECIPP_ALIGNMENT_UWORD 128 Compu_TransFPP_per 0 127.998046875 /end CHARACTERISTIC
/begin COMPU_METHOD Compu_TransFPP_per " " RAT_FUNC "%.3" "ms" COEFFS 0 512 0 0 0 1 /end COMPU_METHOD
/begin CHARACTERISTIC TransFPP_minDC "Trans min FPP output duty-cycle" VALUE 0x0014798e /* @ECU_Address@TransFPP_minDC@0x01002820@ */ ECIPP_ALIGNMENT_UWORD 100 Compu_TransFPP_minDC 0 99.9984741210938 /end CHARACTERISTIC
/begin COMPU_METHOD Compu_TransFPP_minDC " " RAT_FUNC "%.1" "%" COEFFS 0 655.36 0 0 0 1 /end COMPU_METHOD
/begin CHARACTERISTIC TransFPP_maxDC "Trans max FPP output duty-cycle" VALUE 0x0014798c /* @ECU_Address@TransFPP_maxDC@0x01002828@ */ ECIPP_ALIGNMENT_UWORD 100 Compu_TransFPP_maxDC 0 99.9984741210938 /end CHARACTERISTIC
/begin COMPU_METHOD Compu_TransFPP_maxDC " " RAT_FUNC "%.1" "%" COEFFS 0 655.36 0 0 0 1 /end COMPU_METHOD
/begin CHARACTERISTIC MaxSetPt_actvlt "User setpoint speed control indication{MaxSetPt_actvlt&0xff=0:Disabled}{MaxSetPt_actvlt&0xff=1:Aux PWM1}{MaxSetPt_actvlt&0xff=2:Aux PWM2}{MaxSetPt_actvlt&0xff=3:Aux PWM3}{MaxSetPt_actvlt&0xff=4:Aux PWM4}{MaxSetPt_actvlt&0xff=5:Aux PWM5}{MaxSetPt_actvlt&0x" VALUE 0x00147e83 /* @ECU_Address@MaxSetPt_actvlt@0x01002CE0@ */ ECIPP_ALIGNMENT_UBYTE 255 MaxSetPt_actvlt_COMPU_VTAB 0 255 BIT_MASK 0xff /end CHARACTERISTIC
/begin COMPU_METHOD MaxSetPt_actvlt_COMPU_VTAB "Verbal Table" TAB_VERB "%.0" "list" COMPU_TAB_REF MaxSetPt_actvlt_COMPU_VTAB_REF /end COMPU_METHOD
/begin COMPU_VTAB MaxSetPt_actvlt_COMPU_VTAB_REF "Verbal Table" TAB_VERB 12 0 "Disabled" 1 "Aux PWM1" 2 "Aux PWM2" 3 "Aux PWM3" 4 "Aux PWM4" 5 "Aux PWM5" 6 "Aux PWM6" 7 "Aux PWM1 (duplicate)" 8 "EGOH1" 9 "EGOH2" 10 "EGOH3" 11 "EGOH4" DEFAULT_VALUE "UNKNOWN" /end COMPU_VTAB
/begin CHARACTERISTIC MaxSetPt_appup_rpm "Approach indication RPM window" VALUE 0x001490DC /* @ECU_Address@MaxSetPt_appup_rpm@0x010030E0@ */ ECIPP_ALIGNMENT_UWORD 65535 Compu_MaxSetPt_appup_rpm 0 65535 /end CHARACTERISTIC
/begin COMPU_METHOD Compu_MaxSetPt_appup_rpm " " RAT_FUNC "%.0" "rpm" COEFFS 0 1 0 0 0 1 /end COMPU_METHOD
/begin CHARACTERISTIC MaxSetPt_appdn_rpm "Fall-off indication RPM window" VALUE 0x001490DE /* @ECU_Address@MaxSetPt_appdn_rpm@0x010030E8@ */ ECIPP_ALIGNMENT_UWORD 65535 Compu_MaxSetPt_appdn_rpm 0 65535 /end CHARACTERISTIC
/begin COMPU_METHOD Compu_MaxSetPt_appdn_rpm " " RAT_FUNC "%.0" "rpm" COEFFS 0 1 0 0 0 1 /end COMPU_METHOD
/begin CHARACTERISTIC MSP_blkup_ont "Approach indication blink-on" VALUE 0x001490E6 /* @ECU_Address@MSP_blkup_ont@0x010030F0@ */ ECIPP_ALIGNMENT_UWORD 65535 Compu_MSP_blkup_ont 0 65535 /end CHARACTERISTIC
/begin COMPU_METHOD Compu_MSP_blkup_ont " " RAT_FUNC "%.0" "ms" COEFFS 0 1 0 0 0 1 /end COMPU_METHOD
/begin CHARACTERISTIC MSP_blkup_offt "Approach indication blink-off" VALUE 0x001490E8 /* @ECU_Address@MSP_blkup_offt@0x010030F8@ */ ECIPP_ALIGNMENT_UWORD 65535 Compu_MSP_blkup_offt 0 65535 /end CHARACTERISTIC
/begin COMPU_METHOD Compu_MSP_blkup_offt " " RAT_FUNC "%.0" "ms" COEFFS 0 1 0 0 0 1 /end COMPU_METHOD
/begin CHARACTERISTIC MSP_blkdn_ont "Fall-off indication blink-on" VALUE 0x001490EA /* @ECU_Address@MSP_blkdn_ont@0x01003100@ */ ECIPP_ALIGNMENT_UWORD 65535 Compu_MSP_blkdn_ont 0 65535 /end CHARACTERISTIC
/begin COMPU_METHOD Compu_MSP_blkdn_ont " " RAT_FUNC "%.0" "ms" COEFFS 0 1 0 0 0 1 /end COMPU_METHOD
/begin CHARACTERISTIC MSP_blkdn_offt "Fall-off indication blink-off" VALUE 0x001490EC /* @ECU_Address@MSP_blkdn_offt@0x01003108@ */ ECIPP_ALIGNMENT_UWORD 65535 Compu_MSP_blkdn_offt 0 65535 /end CHARACTERISTIC
/begin COMPU_METHOD Compu_MSP_blkdn_offt " " RAT_FUNC "%.0" "ms" COEFFS 0 1 0 0 0 1 /end COMPU_METHOD
/begin CHARACTERISTIC RS_ena "Roadspeed function{RS_ena&0xff=0:Disabled}{RS_ena&0xff=1:Enabled - Measure Speed Only}{RS_ena&0xff=2:Enabled - Limit Max TPS}{RS_ena&0xff=3:Max RPM Setpoint Controlled}{RS_ena&0xff=4:Enabled - Limit Max + Cruise}" VALUE 0x00147f0c /* @ECU_Address@RS_ena@0x01003128@ */ ECIPP_ALIGNMENT_UBYTE 255 RS_ena_COMPU_VTAB 0 255 BIT_MASK 0xff /end CHARACTERISTIC
/begin COMPU_METHOD RS_ena_COMPU_VTAB "Verbal Table" TAB_VERB "%.0" "list" COMPU_TAB_REF RS_ena_COMPU_VTAB_REF /end COMPU_METHOD
/begin COMPU_VTAB RS_ena_COMPU_VTAB_REF "Verbal Table" TAB_VERB 5 0 "Disabled" 1 "Enabled - Measure Speed Only" 2 "Enabled - Limit Max TPS" 3 "Max RPM Setpoint Controlled" 4 "Enabled - Limit Max + Cruise" DEFAULT_VALUE "UNKNOWN" /end COMPU_VTAB
/begin CHARACTERISTIC RS_speed_max "TPS-based control roadspeed limt" VALUE 0x00147746 /* @ECU_Address@RS_speed_max@0x01003160@ */ ECIPP_ALIGNMENT_UWORD 256 Compu_RS_speed_max 0 255.99609375 /end CHARACTERISTIC
/begin COMPU_METHOD Compu_RS_speed_max " " RAT_FUNC "%.1" "km/hr" COEFFS 0 256 0 0 0 1 /end COMPU_METHOD
/begin CHARACTERISTIC SWARN_chan "Soft warning output channel{SWARN_chan&0xff=0:None}{SWARN_chan&0xff=1:Buzzer Output}{SWARN_chan&0xff=2:Aux PWM1}{SWARN_chan&0xff=3:Aux PWM2}{SWARN_chan&0xff=4:Aux PWM3}{SWARN_chan&0xff=5:Aux PWM4}{SWARN_chan&0xff=6:Aux PWM5}{SWARN_chan&0xff=7:Aux PWM6}{SW" VALUE 0x00148060 /* @ECU_Address@SWARN_chan@0x010031F8@ */ ECIPP_ALIGNMENT_UBYTE 255 SWARN_chan_COMPU_VTAB 0 255 BIT_MASK 0xff /end CHARACTERISTIC
/begin COMPU_METHOD SWARN_chan_COMPU_VTAB "Verbal Table" TAB_VERB "%.0" "list" COMPU_TAB_REF SWARN_chan_COMPU_VTAB_REF /end COMPU_METHOD
/begin COMPU_VTAB SWARN_chan_COMPU_VTAB_REF "Verbal Table" TAB_VERB 13 0 "None" 1 "Buzzer Output" 2 "Aux PWM1" 3 "Aux PWM2" 4 "Aux PWM3" 5 "Aux PWM4" 6 "Aux PWM5" 7 "Aux PWM6" 8 "Aux PWM7" 9 "Aux PWM8" 10 "Aux PWM9" 11 "Starter Output" 12 "MIL" DEFAULT_VALUE "UNKNOWN" /end COMPU_VTAB
/begin CHARACTERISTIC HWARN_chan "Hard warning output channel{HWARN_chan&0xff=0:None}{HWARN_chan&0xff=1:Buzzer Output}{HWARN_chan&0xff=2:Aux PWM1}{HWARN_chan&0xff=3:Aux PWM2}{HWARN_chan&0xff=4:Aux PWM3}{HWARN_chan&0xff=5:Aux PWM4}{HWARN_chan&0xff=6:Aux PWM5}{HWARN_chan&0xff=7:Aux PWM6}{HW" VALUE 0x00147dab /* @ECU_Address@HWARN_chan@0x01003200@ */ ECIPP_ALIGNMENT_UBYTE 255 HWARN_chan_COMPU_VTAB 0 255 BIT_MASK 0xff /end CHARACTERISTIC
/begin COMPU_METHOD HWARN_chan_COMPU_VTAB "Verbal Table" TAB_VERB "%.0" "list" COMPU_TAB_REF HWARN_chan_COMPU_VTAB_REF /end COMPU_METHOD
/begin COMPU_VTAB HWARN_chan_COMPU_VTAB_REF "Verbal Table" TAB_VERB 13 0 "None" 1 "Buzzer Output" 2 "Aux PWM1" 3 "Aux PWM2" 4 "Aux PWM3" 5 "Aux PWM4" 6 "Aux PWM5" 7 "Aux PWM6" 8 "Aux PWM7" 9 "Aux PWM8" 10 "Aux PWM9" 11 "Starter Output" 12 "MIL" DEFAULT_VALUE "UNKNOWN" /end COMPU_VTAB
/begin CHARACTERISTIC SWARNblk_on "Soft warning blink/pulse on-time" VALUE 0x00148063 /* @ECU_Address@SWARNblk_on@0x01003208@ */ ECIPP_ALIGNMENT_UBYTE 12750 Compu_SWARNblk_on 0 12750 /end CHARACTERISTIC
/begin COMPU_METHOD Compu_SWARNblk_on " " RAT_FUNC "%.0" "ms" COEFFS 0 0.02 0 0 0 1 /end COMPU_METHOD
/begin CHARACTERISTIC HWARNblk_on "Hard warning blink/pulse on-time" VALUE 0x00147dae /* @ECU_Address@HWARNblk_on@0x01003210@ */ ECIPP_ALIGNMENT_UBYTE 12750 Compu_HWARNblk_on 0 12750 /end CHARACTERISTIC
/begin COMPU_METHOD Compu_HWARNblk_on " " RAT_FUNC "%.0" "ms" COEFFS 0 0.02 0 0 0 1 /end COMPU_METHOD
/begin CHARACTERISTIC SWARNblk_off "Soft warning blink/pulse off-time" VALUE 0x00148062 /* @ECU_Address@SWARNblk_off@0x01003218@ */ ECIPP_ALIGNMENT_UBYTE 12750 Compu_SWARNblk_off 0 12750 /end CHARACTERISTIC
/begin COMPU_METHOD Compu_SWARNblk_off " " RAT_FUNC "%.0" "ms" COEFFS 0 0.02 0 0 0 1 /end COMPU_METHOD
/begin CHARACTERISTIC HWARNblk_off "Hard warning blink/pulse off-time" VALUE 0x00147dad /* @ECU_Address@HWARNblk_off@0x01003220@ */ ECIPP_ALIGNMENT_UBYTE 12750 Compu_HWARNblk_off 0 12750 /end CHARACTERISTIC
/begin COMPU_METHOD Compu_HWARNblk_off " " RAT_FUNC "%.0" "ms" COEFFS 0 0.02 0 0 0 1 /end COMPU_METHOD
/begin CHARACTERISTIC inj_kill_tout "Injector kill timeout" VALUE 0x00147b38 /* @ECU_Address@inj_kill_tout@0x01003330@ */ ECIPP_ALIGNMENT_UWORD 66 Compu_inj_kill_tout 0 65.535 /end CHARACTERISTIC
/begin COMPU_METHOD Compu_inj_kill_tout " " RAT_FUNC "%.1" "sec" COEFFS 0 1000 0 0 0 1 /end COMPU_METHOD
/begin CHARACTERISTIC spk_kill_tout "Spark kill timeout" VALUE 0x00147b8a /* @ECU_Address@spk_kill_tout@0x01003338@ */ ECIPP_ALIGNMENT_UWORD 66 Compu_spk_kill_tout 0 65.535 /end CHARACTERISTIC
/begin COMPU_METHOD Compu_spk_kill_tout " " RAT_FUNC "%.1" "sec" COEFFS 0 1000 0 0 0 1 /end COMPU_METHOD
/begin CHARACTERISTIC FRT_est_xmin "FT min contribution (FRT)" VALUE 0x001473a4 /* @ECU_Address@FRT_est_xmin@0x01003DC0@ */ ECIPP_ALIGNMENT_UWORD 100 Compu_FRT_est_xmin 0 99.9984741210938 /end CHARACTERISTIC
/begin COMPU_METHOD Compu_FRT_est_xmin " " RAT_FUNC "%.1" "%" COEFFS 0 655.36 0 0 0 1 /end COMPU_METHOD
/begin CHARACTERISTIC FRT_est_xmax "FT max contribution (FRT)" VALUE 0x001473a2 /* @ECU_Address@FRT_est_xmax@0x01003DC8@ */ ECIPP_ALIGNMENT_UWORD 100 Compu_FRT_est_xmax 0 99.9984741210938 /end CHARACTERISTIC
/begin COMPU_METHOD Compu_FRT_est_xmax " " RAT_FUNC "%.1" "%" COEFFS 0 655.36 0 0 0 1 /end COMPU_METHOD
/begin CHARACTERISTIC FRT_est_tau "FRT estimation tau" VALUE 0x00147bee /* @ECU_Address@FRT_est_tau@0x01003DD0@ */ ECIPP_ALIGNMENT_UWORD 3277 Compu_FRT_est_tau 0.0045084 3276.8 /end CHARACTERISTIC
/begin COMPU_METHOD Compu_FRT_est_tau " " FORM "%.1" "sec"
 /begin FORMULA "-0.05 / log(1 - (X1 / 65536))" FORMULA_INV "(1 - exp(-0.05/X1)) * 65536" /end FORMULA
/end COMPU_METHOD
/begin CHARACTERISTIC FRT_est_ena "FRT Estimate{FRT_est_ena&0xff=0:FRT = FT (estimate off)}{FRT_est_ena&0xff=1:IAT-FT based estimate}" VALUE 0x00147d7e /* @ECU_Address@FRT_est_ena@0x01003DD8@ */ ECIPP_ALIGNMENT_UBYTE 255 FRT_est_ena_COMPU_VTAB 0 255 BIT_MASK 0xff /end CHARACTERISTIC
/begin COMPU_METHOD FRT_est_ena_COMPU_VTAB "Verbal Table" TAB_VERB "%.0" "list" COMPU_TAB_REF FRT_est_ena_COMPU_VTAB_REF /end COMPU_METHOD
/begin COMPU_VTAB FRT_est_ena_COMPU_VTAB_REF "Verbal Table" TAB_VERB 2 0 "FRT = FT (estimate off)" 1 "IAT-FT based estimate" DEFAULT_VALUE "UNKNOWN" /end COMPU_VTAB
/begin MEASUREMENT FRT "Fuel rail/mixer temperature" UWORD Compu_FRT 0 0 -460 563.984375 ECU_ADDRESS 0x01003DE8 /end MEASUREMENT
/begin COMPU_METHOD Compu_FRT " " RAT_FUNC "%.1" "deg F" COEFFS 0 64 29440 0 0 1 /end COMPU_METHOD
/begin CHARACTERISTIC FT_s "Fuel temp (FRT/FT) - standard" VALUE 0x0014740a /* @ECU_Address@FT_s@0x01003DF0@ */ ECIPP_ALIGNMENT_UWORD 564 Compu_FT_s -460 563.984375 /end CHARACTERISTIC
/begin COMPU_METHOD Compu_FT_s " " RAT_FUNC "%.1" "deg F" COEFFS 0 64 29440 0 0 1 /end COMPU_METHOD
/begin CHARACTERISTIC IATs "Intake air temp (IAT) - standard" VALUE 0x0014747a /* @ECU_Address@IATs@0x01003DF8@ */ ECIPP_ALIGNMENT_UWORD 564 Compu_IATs -460 563.984375 /end CHARACTERISTIC
/begin COMPU_METHOD Compu_IATs " " RAT_FUNC "%.1" "deg F" COEFFS 0 64 29440 0 0 1 /end COMPU_METHOD
/begin CHARACTERISTIC MJ_VVC_Tcrct_ena "Variable venturi FRT/IAT correction{MJ_VVC_Tcrct_ena&0xff=0:Disabled}{MJ_VVC_Tcrct_ena&0xff=1:Enabled}" VALUE 0x00147e73 /* @ECU_Address@MJ_VVC_Tcrct_ena@0x01003E00@ */ ECIPP_ALIGNMENT_UBYTE 255 MJ_VVC_Tcrct_ena_COMPU_VTAB 0 255 BIT_MASK 0xff /end CHARACTERISTIC
/begin COMPU_METHOD MJ_VVC_Tcrct_ena_COMPU_VTAB "Verbal Table" TAB_VERB "%.0" "list" COMPU_TAB_REF MJ_VVC_Tcrct_ena_COMPU_VTAB_REF /end COMPU_METHOD
/begin COMPU_VTAB MJ_VVC_Tcrct_ena_COMPU_VTAB_REF "Verbal Table" TAB_VERB 2 0 "Disabled" 1 "Enabled" DEFAULT_VALUE "UNKNOWN" /end COMPU_VTAB
/begin CHARACTERISTIC cfgout_DG1lon "and Aux DIG1 is{cfgout_DG1lon&0xff=0x00:Ignored}{cfgout_DG1lon&0xff=0x01:<}{cfgout_DG1lon&0xff=0x02:>}{cfgout_DG1lon&0xff=0x03:<=}{cfgout_DG1lon&0xff=0x04:>=}{cfgout_DG1lon&0xff=0x05:=}{cfgout_DG1lon&0xff=0x06:<>}" VALUE 0x0014950A /* @ECU_Address@cfgout_DG1lon@0x01003E50@ */ ECIPP_ALIGNMENT_UBYTE 255 cfgout_DG1lon_COMPU_VTAB 0 255 BIT_MASK 0xff /end CHARACTERISTIC
/begin COMPU_METHOD cfgout_DG1lon_COMPU_VTAB "Verbal Table" TAB_VERB "%.0" "list" COMPU_TAB_REF cfgout_DG1lon_COMPU_VTAB_REF /end COMPU_METHOD
/begin COMPU_VTAB cfgout_DG1lon_COMPU_VTAB_REF "Verbal Table" TAB_VERB 7 0x00 "Ignored" 0x01 "<" 0x02 ">" 0x03 "<=" 0x04 ">=" 0x05 "=" 0x06 "<>" DEFAULT_VALUE "UNKNOWN" /end COMPU_VTAB
/begin CHARACTERISTIC cfgout_DG1loff "and Aux DIG1 is{cfgout_DG1loff&0xff=0x00:Ignored}{cfgout_DG1loff&0xff=0x01:<}{cfgout_DG1loff&0xff=0x02:>}{cfgout_DG1loff&0xff=0x03:<=}{cfgout_DG1loff&0xff=0x04:>=}{cfgout_DG1loff&0xff=0x05:=}{cfgout_DG1loff&0xff=0x06:<>}" VALUE 0x00149516 /* @ECU_Address@cfgout_DG1loff@0x01003E58@ */ ECIPP_ALIGNMENT_UBYTE 255 cfgout_DG1loff_COMPU_VTAB 0 255 BIT_MASK 0xff /end CHARACTERISTIC
/begin COMPU_METHOD cfgout_DG1loff_COMPU_VTAB "Verbal Table" TAB_VERB "%.0" "list" COMPU_TAB_REF cfgout_DG1loff_COMPU_VTAB_REF /end COMPU_METHOD
/begin COMPU_VTAB cfgout_DG1loff_COMPU_VTAB_REF "Verbal Table" TAB_VERB 7 0x00 "Ignored" 0x01 "<" 0x02 ">" 0x03 "<=" 0x04 ">=" 0x05 "=" 0x06 "<>" DEFAULT_VALUE "UNKNOWN" /end COMPU_VTAB
/begin CHARACTERISTIC cfgout2_DG1lon "and Aux DIG1 is{cfgout2_DG1lon&0xff=0x00:Ignored}{cfgout2_DG1lon&0xff=0x01:<}{cfgout2_DG1lon&0xff=0x02:>}{cfgout2_DG1lon&0xff=0x03:<=}{cfgout2_DG1lon&0xff=0x04:>=}{cfgout2_DG1lon&0xff=0x05:=}{cfgout2_DG1lon&0xff=0x06:<>}" VALUE 0x00149562 /* @ECU_Address@cfgout2_DG1lon@0x01003E60@ */ ECIPP_ALIGNMENT_UBYTE 255 cfgout2_DG1lon_COMPU_VTAB 0 255 BIT_MASK 0xff /end CHARACTERISTIC
/begin COMPU_METHOD cfgout2_DG1lon_COMPU_VTAB "Verbal Table" TAB_VERB "%.0" "list" COMPU_TAB_REF cfgout2_DG1lon_COMPU_VTAB_REF /end COMPU_METHOD
/begin COMPU_VTAB cfgout2_DG1lon_COMPU_VTAB_REF "Verbal Table" TAB_VERB 7 0x00 "Ignored" 0x01 "<" 0x02 ">" 0x03 "<=" 0x04 ">=" 0x05 "=" 0x06 "<>" DEFAULT_VALUE "UNKNOWN" /end COMPU_VTAB
/begin CHARACTERISTIC cfgout2_DG1loff "and Aux DIG1 is{cfgout2_DG1loff&0xff=0x00:Ignored}{cfgout2_DG1loff&0xff=0x01:<}{cfgout2_DG1loff&0xff=0x02:>}{cfgout2_DG1loff&0xff=0x03:<=}{cfgout2_DG1loff&0xff=0x04:>=}{cfgout2_DG1loff&0xff=0x05:=}{cfgout2_DG1loff&0xff=0x06:<>}" VALUE 0x0014956E /* @ECU_Address@cfgout2_DG1loff@0x01003E68@ */ ECIPP_ALIGNMENT_UBYTE 255 cfgout2_DG1loff_COMPU_VTAB 0 255 BIT_MASK 0xff /end CHARACTERISTIC
/begin COMPU_METHOD cfgout2_DG1loff_COMPU_VTAB "Verbal Table" TAB_VERB "%.0" "list" COMPU_TAB_REF cfgout2_DG1loff_COMPU_VTAB_REF /end COMPU_METHOD
/begin COMPU_VTAB cfgout2_DG1loff_COMPU_VTAB_REF "Verbal Table" TAB_VERB 7 0x00 "Ignored" 0x01 "<" 0x02 ">" 0x03 "<=" 0x04 ">=" 0x05 "=" 0x06 "<>" DEFAULT_VALUE "UNKNOWN" /end COMPU_VTAB
/begin CHARACTERISTIC cfgout3_DG1lon "and Aux DIG1 is{cfgout3_DG1lon&0xff=0x00:Ignored}{cfgout3_DG1lon&0xff=0x01:<}{cfgout3_DG1lon&0xff=0x02:>}{cfgout3_DG1lon&0xff=0x03:<=}{cfgout3_DG1lon&0xff=0x04:>=}{cfgout3_DG1lon&0xff=0x05:=}{cfgout3_DG1lon&0xff=0x06:<>}" VALUE 0x001495BA /* @ECU_Address@cfgout3_DG1lon@0x01003E70@ */ ECIPP_ALIGNMENT_UBYTE 255 cfgout3_DG1lon_COMPU_VTAB 0 255 BIT_MASK 0xff /end CHARACTERISTIC
/begin COMPU_METHOD cfgout3_DG1lon_COMPU_VTAB "Verbal Table" TAB_VERB "%.0" "list" COMPU_TAB_REF cfgout3_DG1lon_COMPU_VTAB_REF /end COMPU_METHOD
/begin COMPU_VTAB cfgout3_DG1lon_COMPU_VTAB_REF "Verbal Table" TAB_VERB 7 0x00 "Ignored" 0x01 "<" 0x02 ">" 0x03 "<=" 0x04 ">=" 0x05 "=" 0x06 "<>" DEFAULT_VALUE "UNKNOWN" /end COMPU_VTAB
/begin CHARACTERISTIC cfgout3_DG1loff "and Aux DIG1 is{cfgout3_DG1loff&0xff=0x00:Ignored}{cfgout3_DG1loff&0xff=0x01:<}{cfgout3_DG1loff&0xff=0x02:>}{cfgout3_DG1loff&0xff=0x03:<=}{cfgout3_DG1loff&0xff=0x04:>=}{cfgout3_DG1loff&0xff=0x05:=}{cfgout3_DG1loff&0xff=0x06:<>}" VALUE 0x001495C6 /* @ECU_Address@cfgout3_DG1loff@0x01003E78@ */ ECIPP_ALIGNMENT_UBYTE 255 cfgout3_DG1loff_COMPU_VTAB 0 255 BIT_MASK 0xff /end CHARACTERISTIC
/begin COMPU_METHOD cfgout3_DG1loff_COMPU_VTAB "Verbal Table" TAB_VERB "%.0" "list" COMPU_TAB_REF cfgout3_DG1loff_COMPU_VTAB_REF /end COMPU_METHOD
/begin COMPU_VTAB cfgout3_DG1loff_COMPU_VTAB_REF "Verbal Table" TAB_VERB 7 0x00 "Ignored" 0x01 "<" 0x02 ">" 0x03 "<=" 0x04 ">=" 0x05 "=" 0x06 "<>" DEFAULT_VALUE "UNKNOWN" /end COMPU_VTAB
/begin CHARACTERISTIC cfgout_DG1on "DIG1_on" VALUE 0x00149528 /* @ECU_Address@cfgout_DG1on@0x01003E80@ */ ECIPP_ALIGNMENT_UWORD 256 Compu_cfgout_DG1on 0 255.99609375 /end CHARACTERISTIC
/begin COMPU_METHOD Compu_cfgout_DG1on " " RAT_FUNC "%.2" "volts" COEFFS 0 256 0 0 0 1 /end COMPU_METHOD
/begin CHARACTERISTIC cfgout_DG1off "DIG1_off" VALUE 0x00149540 /* @ECU_Address@cfgout_DG1off@0x01003E88@ */ ECIPP_ALIGNMENT_UWORD 256 Compu_cfgout_DG1off 0 255.99609375 /end CHARACTERISTIC
/begin COMPU_METHOD Compu_cfgout_DG1off " " RAT_FUNC "%.2" "volts" COEFFS 0 256 0 0 0 1 /end COMPU_METHOD
/begin CHARACTERISTIC cfgout2_DG1on "DIG1_on" VALUE 0x00149580 /* @ECU_Address@cfgout2_DG1on@0x01003E90@ */ ECIPP_ALIGNMENT_UWORD 256 Compu_cfgout2_DG1on 0 255.99609375 /end CHARACTERISTIC
/begin COMPU_METHOD Compu_cfgout2_DG1on " " RAT_FUNC "%.2" "volts" COEFFS 0 256 0 0 0 1 /end COMPU_METHOD
/begin MEASUREMENT MJ_VVC_mdot_a "VVC inlet air flow" UWORD Compu_MJ_VVC_mdot_a 0 0 0 1023.984375 ECU_ADDRESS 0x01003F98 /end MEASUREMENT
/begin COMPU_METHOD Compu_MJ_VVC_mdot_a " " RAT_FUNC "%.2" "g/sec" COEFFS 0 64 0 0 0 1 /end COMPU_METHOD
/begin MEASUREMENT MJ_VVC_mdot_dia "VVC diaphragm flow" SWORD Compu_MJ_VVC_mdot_dia 0 0 -8 7.999755859375 ECU_ADDRESS 0x01003FA0 /end MEASUREMENT
/begin COMPU_METHOD Compu_MJ_VVC_mdot_dia " " RAT_FUNC "%.2" "g/sec" COEFFS 0 4096 0 0 0 1 /end COMPU_METHOD
/begin MEASUREMENT MJ_VVC_mdot_thtl "VVC throttle flow" UWORD Compu_MJ_VVC_mdot_thtl 0 0 0 1023.984375 ECU_ADDRESS 0x01003FA8 /end MEASUREMENT
/begin COMPU_METHOD Compu_MJ_VVC_mdot_thtl " " RAT_FUNC "%.2" "g/sec" COEFFS 0 64 0 0 0 1 /end COMPU_METHOD
/begin MEASUREMENT MJ_VVC_mdot_ports "VVC port flow" UWORD Compu_MJ_VVC_mdot_ports 0 0 0 1023.984375 ECU_ADDRESS 0x01003FB0 /end MEASUREMENT
/begin COMPU_METHOD Compu_MJ_VVC_mdot_ports " " RAT_FUNC "%.2" "g/sec" COEFFS 0 64 0 0 0 1 /end COMPU_METHOD
/begin MEASUREMENT MJ_VVC_TIP "VVC inlet air pressure" ULONG Compu_MJ_VVC_TIP 0 0 0 127.999999970198 ECU_ADDRESS 0x01003FB8 /end MEASUREMENT
/begin COMPU_METHOD Compu_MJ_VVC_TIP " " RAT_FUNC "%.2" "psia" COEFFS 0 33554432 0 0 0 1 /end COMPU_METHOD
/begin MEASUREMENT MJ_VVC_TIP_Pth "VVC current air-driving dP" ULONG Compu_MJ_VVC_TIP_Pth 0 0 0 3551.99999917299 ECU_ADDRESS 0x01003FC0 /end MEASUREMENT
/begin COMPU_METHOD Compu_MJ_VVC_TIP_Pth " " RAT_FUNC "%.3" "in. H20" COEFFS 0 1209168.72072072 0 0 0 1 /end COMPU_METHOD
/begin MEASUREMENT MJ_VVC_Pdia "VVC diaphragm pressure" ULONG Compu_MJ_VVC_Pdia 0 0 0 127.999999970198 ECU_ADDRESS 0x01003FC8 /end MEASUREMENT
/begin COMPU_METHOD Compu_MJ_VVC_Pdia " " RAT_FUNC "%.2" "psia" COEFFS 0 33554432 0 0 0 1 /end COMPU_METHOD
/begin MEASUREMENT MJ_VVC_Pth "VVC throat pressure" ULONG Compu_MJ_VVC_Pth 0 0 0 127.999999970198 ECU_ADDRESS 0x01003FD0 /end MEASUREMENT
/begin COMPU_METHOD Compu_MJ_VVC_Pth " " RAT_FUNC "%.2" "psia" COEFFS 0 33554432 0 0 0 1 /end COMPU_METHOD
/begin MEASUREMENT MJ_VVC_x "VVC diaphragm displacement" ULONG Compu_MJ_VVC_x 0 0 0 1.99999999953434 ECU_ADDRESS 0x01003FD8 /end MEASUREMENT
/begin COMPU_METHOD Compu_MJ_VVC_x " " RAT_FUNC "%.3" "inch" COEFFS 0 2147483648 0 0 0 1 /end COMPU_METHOD
/begin MEASUREMENT MJ_VVC_x_ss "VVC steady-state diaphragm displacement" UWORD Compu_MJ_VVC_x_ss 0 0 0 1.99996948242188 ECU_ADDRESS 0x01003FE0 /end MEASUREMENT
/begin COMPU_METHOD Compu_MJ_VVC_x_ss " " RAT_FUNC "%.3" "inch" COEFFS 0 32768 0 0 0 1 /end COMPU_METHOD
/begin MEASUREMENT MJ_VVC_TIP_Pthss "VVC steady-state air-driving dP" UWORD Compu_MJ_VVC_TIP_Pthss 0 0 0 110.998306274414 ECU_ADDRESS 0x01003FE8 /end MEASUREMENT
/begin COMPU_METHOD Compu_MJ_VVC_TIP_Pthss " " RAT_FUNC "%.3" "in. H20" COEFFS 0 590.414414414414 0 0 0 1 /end COMPU_METHOD
/begin MEASUREMENT MJ_VVC_Pcrct "VVC pressure correction multiplier" UWORD Compu_MJ_VVC_Pcrct 0 0 0 15.999755859375 ECU_ADDRESS 0x01003FF0 /end MEASUREMENT
/begin COMPU_METHOD Compu_MJ_VVC_Pcrct " " RAT_FUNC "%.3" "-" COEFFS 0 4096 0 0 0 1 /end COMPU_METHOD
/begin MEASUREMENT MJ_P_cmdnom "EPR un-compensated pressure command" SWORD Compu_MJ_P_cmdnom 0 0 -222 221.993225097656 ECU_ADDRESS 0x01003FF8 /end MEASUREMENT
/begin COMPU_METHOD Compu_MJ_P_cmdnom " " RAT_FUNC "%.2" "in H20" COEFFS 0 147.603603603604 0 0 0 1 /end COMPU_METHOD
/begin CHARACTERISTIC MJ_VVC_mount "VVC mounting{MJ_VVC_mount&0xff=0:Upside down}{MJ_VVC_mount&0xff=1:Side mount}{MJ_VVC_mount&0xff=2:Normal mount}" VALUE 0x00147e76 /* @ECU_Address@MJ_VVC_mount@0x01004000@ */ ECIPP_ALIGNMENT_UBYTE 255 MJ_VVC_mount_COMPU_VTAB 0 255 BIT_MASK 0xff /end CHARACTERISTIC
/begin COMPU_METHOD MJ_VVC_mount_COMPU_VTAB "Verbal Table" TAB_VERB "%.0" "list" COMPU_TAB_REF MJ_VVC_mount_COMPU_VTAB_REF /end COMPU_METHOD
/begin COMPU_VTAB MJ_VVC_mount_COMPU_VTAB_REF "Verbal Table" TAB_VERB 3 0 "Upside down" 1 "Side mount" 2 "Normal mount" DEFAULT_VALUE "UNKNOWN" /end COMPU_VTAB
/begin CHARACTERISTIC MJ_VVC_Pcrct_lt1 "VVC tip-in compensation multiplier" VALUE 0x0014437a /* @ECU_Address@MJ_VVC_Pcrct_lt1@0x01004008@ */ ECIPP_ALIGNMENT_SWORD 4 Compu_MJ_VVC_Pcrct_lt1 -4 3.9998779296875 /end CHARACTERISTIC
/begin COMPU_METHOD Compu_MJ_VVC_Pcrct_lt1 " " RAT_FUNC "%.2" "-" COEFFS 0 8192 0 0 0 1 /end COMPU_METHOD
/begin CHARACTERISTIC MJ_VVC_Pcrct_gt1 "VVC tip-out compensation multiplier" VALUE 0x00144378 /* @ECU_Address@MJ_VVC_Pcrct_gt1@0x01004010@ */ ECIPP_ALIGNMENT_SWORD 4 Compu_MJ_VVC_Pcrct_gt1 -4 3.9998779296875 /end CHARACTERISTIC
/begin COMPU_METHOD Compu_MJ_VVC_Pcrct_gt1 " " RAT_FUNC "%.2" "-" COEFFS 0 8192 0 0 0 1 /end COMPU_METHOD
/begin CHARACTERISTIC MJ_VVC_Cd_a "VVC inlet flow Cd" VALUE 0x0014760e /* @ECU_Address@MJ_VVC_Cd_a@0x01004018@ */ ECIPP_ALIGNMENT_UWORD 2 Compu_MJ_VVC_Cd_a 0 1.99996948242188 /end CHARACTERISTIC
/begin COMPU_METHOD Compu_MJ_VVC_Cd_a " " RAT_FUNC "%.2" "-" COEFFS 0 32768 0 0 0 1 /end COMPU_METHOD
/begin CHARACTERISTIC MJ_VVC_Di "VVC inner diameter" VALUE 0x00147610 /* @ECU_Address@MJ_VVC_Di@0x01004020@ */ ECIPP_ALIGNMENT_UWORD 8 Compu_MJ_VVC_Di 0 7.9998779296875 /end CHARACTERISTIC
/begin COMPU_METHOD Compu_MJ_VVC_Di " " RAT_FUNC "%.3" "inch" COEFFS 0 8192 0 0 0 1 /end COMPU_METHOD
/begin CHARACTERISTIC MJ_VVC_Do "VVC outer diameter" VALUE 0x00147612 /* @ECU_Address@MJ_VVC_Do@0x01004028@ */ ECIPP_ALIGNMENT_UWORD 8 Compu_MJ_VVC_Do 0 7.9998779296875 /end CHARACTERISTIC
/begin COMPU_METHOD Compu_MJ_VVC_Do " " RAT_FUNC "%.3" "inch" COEFFS 0 8192 0 0 0 1 /end COMPU_METHOD
/begin CHARACTERISTIC MJ_VVC_Ao_m "VVC outer area multiplier" VALUE 0x0014760a /* @ECU_Address@MJ_VVC_Ao_m@0x01004030@ */ ECIPP_ALIGNMENT_UWORD 1 Compu_MJ_VVC_Ao_m 0 0.999984741210938 /end CHARACTERISTIC
/begin COMPU_METHOD Compu_MJ_VVC_Ao_m " " RAT_FUNC "%.2" "-" COEFFS 0 65536 0 0 0 1 /end COMPU_METHOD
/begin CHARACTERISTIC MJ_VVC_m_dia "VVC diaphragm mass" VALUE 0x0014761c /* @ECU_Address@MJ_VVC_m_dia@0x01004038@ */ ECIPP_ALIGNMENT_UWORD 256 Compu_MJ_VVC_m_dia 0 255.99609375 /end CHARACTERISTIC
/begin COMPU_METHOD Compu_MJ_VVC_m_dia " " RAT_FUNC "%.2" "g" COEFFS 0 256 0 0 0 1 /end COMPU_METHOD
/begin CHARACTERISTIC MJ_VVC_ks "VVC spring constant" VALUE 0x0014761a /* @ECU_Address@MJ_VVC_ks@0x01004040@ */ ECIPP_ALIGNMENT_UWORD 16 Compu_MJ_VVC_ks 0 15.999755859375 /end CHARACTERISTIC
/begin COMPU_METHOD Compu_MJ_VVC_ks " " RAT_FUNC "%.2" "lbf/in" COEFFS 0 4096 0 0 0 1 /end COMPU_METHOD
/begin CHARACTERISTIC MJ_VVC_x0 "VVC initial spring deflection" VALUE 0x00147620 /* @ECU_Address@MJ_VVC_x0@0x01004048@ */ ECIPP_ALIGNMENT_UWORD 1 Compu_MJ_VVC_x0 0 0.999984741210938 /end CHARACTERISTIC
/begin COMPU_METHOD Compu_MJ_VVC_x0 " " RAT_FUNC "%.3" "inch" COEFFS 0 65536 0 0 0 1 /end COMPU_METHOD
/begin CHARACTERISTIC MJ_VVC_xmax "VVC maximum diaphragm displacement" VALUE 0x00147622 /* @ECU_Address@MJ_VVC_xmax@0x01004050@ */ ECIPP_ALIGNMENT_UWORD 2 Compu_MJ_VVC_xmax 0 1.99996948242188 /end CHARACTERISTIC
/begin COMPU_METHOD Compu_MJ_VVC_xmax " " RAT_FUNC "%.3" "inch" COEFFS 0 32768 0 0 0 1 /end COMPU_METHOD
/begin CHARACTERISTIC MJ_VVC_CdA_dia "VVC diaphragm CdA" VALUE 0x0014760c /* @ECU_Address@MJ_VVC_CdA_dia@0x01004058@ */ ECIPP_ALIGNMENT_UWORD 0 Compu_MJ_VVC_CdA_dia 0 6.24990463256836E-02 /end CHARACTERISTIC
/begin COMPU_METHOD Compu_MJ_VVC_CdA_dia " " RAT_FUNC "%.4" "in^2" COEFFS 0 1048576 0 0 0 1 /end COMPU_METHOD
/begin CHARACTERISTIC MJ_VVC_Vth "VVC throat volume" VALUE 0x00147618 /* @ECU_Address@MJ_VVC_Vth@0x01004060@ */ ECIPP_ALIGNMENT_UWORD 2 Compu_MJ_VVC_Vth 0 1.99996948242188 /end CHARACTERISTIC
/begin COMPU_METHOD Compu_MJ_VVC_Vth " " RAT_FUNC "%.2" "L" COEFFS 0 32768 0 0 0 1 /end COMPU_METHOD
/begin CHARACTERISTIC MJ_VVC_Vdia_min "VVC minimum diaphragm volume" VALUE 0x00147616 /* @ECU_Address@MJ_VVC_Vdia_min@0x01004068@ */ ECIPP_ALIGNMENT_UWORD 2 Compu_MJ_VVC_Vdia_min 0 1.99996948242188 /end CHARACTERISTIC
/begin COMPU_METHOD Compu_MJ_VVC_Vdia_min " " RAT_FUNC "%.3" "L" COEFFS 0 32768 0 0 0 1 /end COMPU_METHOD
/begin CHARACTERISTIC MJ_VVC_damp "VVC damping" VALUE 0x0014437c /* @ECU_Address@MJ_VVC_damp@0x01004070@ */ ECIPP_ALIGNMENT_SWORD 1 Compu_MJ_VVC_damp -1 0.999969482421875 /end CHARACTERISTIC
/begin COMPU_METHOD Compu_MJ_VVC_damp " " RAT_FUNC "%.3" "psia/(in/sec)" COEFFS 0 32768 0 0 0 1 /end COMPU_METHOD
/begin CHARACTERISTIC MJ_VVC_stict "VVC stiction" VALUE 0x00144100 /* @ECU_Address@MJ_VVC_stict@0x01004078@ */ ECIPP_ALIGNMENT_ULONG 128 Compu_MJ_VVC_stict 0 127.999999970198 /end CHARACTERISTIC
/begin COMPU_METHOD Compu_MJ_VVC_stict " " RAT_FUNC "%.3" "psia" COEFFS 0 33554432 0 0 0 1 /end COMPU_METHOD
/begin CHARACTERISTIC MJ_VVC_stict_delta "VVC stiction delta" VALUE 0x0014761e /* @ECU_Address@MJ_VVC_stict_delta@0x01004080@ */ ECIPP_ALIGNMENT_UWORD 64 Compu_MJ_VVC_stict_delta 0 63.9990234375 /end CHARACTERISTIC
/begin COMPU_METHOD Compu_MJ_VVC_stict_delta " " RAT_FUNC "%.3" "in/sec" COEFFS 0 1024 0 0 0 1 /end COMPU_METHOD
/begin CHARACTERISTIC MJ_VVC_Pth_tau "VVC throat pressure tau" VALUE 0x00147c16 /* @ECU_Address@MJ_VVC_Pth_tau@0x01004088@ */ ECIPP_ALIGNMENT_UWORD 40960 Compu_MJ_VVC_Pth_tau 0.056355 40960 /end CHARACTERISTIC
/begin COMPU_METHOD Compu_MJ_VVC_Pth_tau " " FORM "%.1" "ms"
 /begin FORMULA "-0.625 / log(1 - (X1 / 65536))" FORMULA_INV "(1 - exp(-0.625/X1)) * 65536" /end FORMULA
/end COMPU_METHOD
/begin CHARACTERISTIC MJ_VVC_TIP_tau "VVC inlet pressure tau" VALUE 0x00147c18 /* @ECU_Address@MJ_VVC_TIP_tau@0x01004090@ */ ECIPP_ALIGNMENT_UWORD 327680 Compu_MJ_VVC_TIP_tau 0.45084 327680 /end CHARACTERISTIC
/begin COMPU_METHOD Compu_MJ_VVC_TIP_tau " " FORM "%.0" "ms"
 /begin FORMULA "-5 / log(1 - (X1 / 65536))" FORMULA_INV "(1 - exp(-5/X1)) * 65536" /end FORMULA
/end COMPU_METHOD
/begin CHARACTERISTIC MJ_VVC_mdot_tau "VVC throttle flow tau" VALUE 0x00147c1a /* @ECU_Address@MJ_VVC_mdot_tau@0x01004098@ */ ECIPP_ALIGNMENT_UWORD 327680 Compu_MJ_VVC_mdot_tau 0.45084 327680 /end CHARACTERISTIC
/begin COMPU_METHOD Compu_MJ_VVC_mdot_tau " " FORM "%.1" "ms"
 /begin FORMULA "-5 / log(1 - (X1 / 65536))" FORMULA_INV "(1 - exp(-5/X1)) * 65536" /end FORMULA
/end COMPU_METHOD
/begin CHARACTERISTIC MJ_VVC_iterreq "VVC number of iterations" VALUE 0x00147e75 /* @ECU_Address@MJ_VVC_iterreq@0x010040A0@ */ ECIPP_ALIGNMENT_UBYTE 255 Compu_MJ_VVC_iterreq 0 255 /end CHARACTERISTIC
/begin COMPU_METHOD Compu_MJ_VVC_iterreq " " RAT_FUNC "%.0" "-" COEFFS 0 1 0 0 0 1 /end COMPU_METHOD
/begin MEASUREMENT MJ_VVC_Ts "VVC sample time" SWORD Compu_MJ_VVC_Ts 0 0 -7.8125 7.8122615814209 ECU_ADDRESS 0x010040A8 /end MEASUREMENT
/begin COMPU_METHOD Compu_MJ_VVC_Ts " " RAT_FUNC "%.3" "ms" COEFFS 0 4194.304 0 0 0 1 /end COMPU_METHOD
/begin CHARACTERISTIC MJ_VVC_ena "Carb transient model{MJ_VVC_ena&0xff=0:Disabled}{MJ_VVC_ena&0xff=1:Enabled}" VALUE 0x00147e74 /* @ECU_Address@MJ_VVC_ena@0x010040B0@ */ ECIPP_ALIGNMENT_UBYTE 255 MJ_VVC_ena_COMPU_VTAB 0 255 BIT_MASK 0xff /end CHARACTERISTIC
/begin COMPU_METHOD MJ_VVC_ena_COMPU_VTAB "Verbal Table" TAB_VERB "%.0" "list" COMPU_TAB_REF MJ_VVC_ena_COMPU_VTAB_REF /end COMPU_METHOD
/begin COMPU_VTAB MJ_VVC_ena_COMPU_VTAB_REF "Verbal Table" TAB_VERB 2 0 "Disabled" 1 "Enabled" DEFAULT_VALUE "UNKNOWN" /end COMPU_VTAB
/begin CHARACTERISTIC MJ_VVC_num_carbs "Number of carburetors" VALUE 0x00147e77 /* @ECU_Address@MJ_VVC_num_carbs@0x010040B8@ */ ECIPP_ALIGNMENT_UBYTE 255 Compu_MJ_VVC_num_carbs 0 255 /end CHARACTERISTIC
/begin COMPU_METHOD Compu_MJ_VVC_num_carbs " " RAT_FUNC "%.0" "count" COEFFS 0 1 0 0 0 1 /end COMPU_METHOD
/begin MEASUREMENT trim_TIPVd_load "Fuel trim Vdot load estimate" UWORD Compu_trim_TIPVd_load 0 0 0 99.9984741210938 ECU_ADDRESS 0x010040C8 /end MEASUREMENT
/begin COMPU_METHOD Compu_trim_TIPVd_load " " RAT_FUNC "%.1" "%" COEFFS 0 655.36 0 0 0 1 /end COMPU_METHOD
/begin MEASUREMENT trim_TIPVd_TIPss "Fuel trim Vdot TIPss estimate" UWORD Compu_trim_TIPVd_TIPss 0 0 0 255.99609375 ECU_ADDRESS 0x010040D0 /end MEASUREMENT
/begin COMPU_METHOD Compu_trim_TIPVd_TIPss " " RAT_FUNC "%.2" "psia" COEFFS 0 256 0 0 0 1 /end COMPU_METHOD
/begin MEASUREMENT trim_TIPVd_mult "Fuel trim Vdot compensation" UWORD Compu_trim_TIPVd_mult 0 0 0 1.99996948242188 ECU_ADDRESS 0x010040D8 /end MEASUREMENT
/begin COMPU_METHOD Compu_trim_TIPVd_mult " " RAT_FUNC "%.3" "multiplier" COEFFS 0 32768 0 0 0 1 /end COMPU_METHOD
/begin MEASUREMENT RS_prop_V "Proportional setpoint filterd voltage" UWORD Compu_RS_prop_V 0 0 0 5.00114468864469 ECU_ADDRESS 0x01004168 /end MEASUREMENT
/begin COMPU_METHOD Compu_RS_prop_V " " RAT_FUNC "%.3" "volts" COEFFS 0 13104 0 0 0 1 /end COMPU_METHOD
/begin CHARACTERISTIC RS_prop_V0 "Proportional setpoint V min" VALUE 0x00147738 /* @ECU_Address@RS_prop_V0@0x01004178@ */ ECIPP_ALIGNMENT_UWORD 5 Compu_RS_prop_V0 0 5.00114468864469 /end CHARACTERISTIC
/begin COMPU_METHOD Compu_RS_prop_V0 " " RAT_FUNC "%.3" "volts" COEFFS 0 13104 0 0 0 1 /end COMPU_METHOD
/begin CHARACTERISTIC RS_prop_V1 "Proportional setpoint V max" VALUE 0x0014773a /* @ECU_Address@RS_prop_V1@0x01004180@ */ ECIPP_ALIGNMENT_UWORD 5 Compu_RS_prop_V1 0 5.00114468864469 /end CHARACTERISTIC
/begin COMPU_METHOD Compu_RS_prop_V1 " " RAT_FUNC "%.3" "volts" COEFFS 0 13104 0 0 0 1 /end COMPU_METHOD
/begin CHARACTERISTIC RS_prop_RS0 "Proportional setpoint speed min" VALUE 0x00147734 /* @ECU_Address@RS_prop_RS0@0x01004188@ */ ECIPP_ALIGNMENT_UWORD 256 Compu_RS_prop_RS0 0 255.99609375 /end CHARACTERISTIC
/begin COMPU_METHOD Compu_RS_prop_RS0 " " RAT_FUNC "%.1" "km/hr" COEFFS 0 256 0 0 0 1 /end COMPU_METHOD
/begin CHARACTERISTIC RS_prop_RS1 "Proportional setpoint speed max" VALUE 0x00147736 /* @ECU_Address@RS_prop_RS1@0x01004190@ */ ECIPP_ALIGNMENT_UWORD 256 Compu_RS_prop_RS1 0 255.99609375 /end CHARACTERISTIC
/begin COMPU_METHOD Compu_RS_prop_RS1 " " RAT_FUNC "%.1" "km/hr" COEFFS 0 256 0 0 0 1 /end COMPU_METHOD
/begin MEASUREMENT MJI_cur_SW_mod "Internal current EPR SW model" ULONG Compu_MJI_cur_SW_mod 0 0 0 4294967295 ECU_ADDRESS 0x01004F38 /end MEASUREMENT
/begin COMPU_METHOD Compu_MJI_cur_SW_mod " " RAT_FUNC "%.0" "-" COEFFS 0 1 0 0 0 1 /end COMPU_METHOD
/begin MEASUREMENT MJI_cur_HW_mod "Internal current EPR HW model" ULONG Compu_MJI_cur_HW_mod 0 0 0 4294967295 ECU_ADDRESS 0x01004F40 /end MEASUREMENT
/begin COMPU_METHOD Compu_MJI_cur_HW_mod " " RAT_FUNC "%.0" "-" COEFFS 0 1 0 0 0 1 /end COMPU_METHOD
/begin MEASUREMENT spk_kill_mode "Spark kill mode{spk_kill_mode&0xff=0:Single continuous}{spk_kill_mode&0xff=1:Paired continuous}{spk_kill_mode&0xff=2:Evenly spaced}" UBYTE spk_kill_mode_COMPU_VTAB 0 0 0 255 ECU_ADDRESS 0x01005078 BIT_MASK 0xff /end MEASUREMENT
/begin COMPU_METHOD spk_kill_mode_COMPU_VTAB "Verbal Table" TAB_VERB "%.0" "list" COMPU_TAB_REF spk_kill_mode_COMPU_VTAB_REF /end COMPU_METHOD
/begin COMPU_VTAB spk_kill_mode_COMPU_VTAB_REF "Verbal Table" TAB_VERB 3 0 "Single continuous" 1 "Paired continuous" 2 "Evenly spaced" DEFAULT_VALUE "UNKNOWN" /end COMPU_VTAB
/begin MEASUREMENT spk_kill_pct "Spark kill percent" UWORD Compu_spk_kill_pct 0 0 0 99.9984741210938 ECU_ADDRESS 0x01005080 /end MEASUREMENT
/begin COMPU_METHOD Compu_spk_kill_pct " " RAT_FUNC "%.2" "-" COEFFS 0 655.36 0 0 0 1 /end COMPU_METHOD
/begin MEASUREMENT spk_kill_cyl "Spark kill cylinder" UBYTE Compu_spk_kill_cyl 0 0 0 255 ECU_ADDRESS 0x01005088 /end MEASUREMENT
/begin COMPU_METHOD Compu_spk_kill_cyl " " RAT_FUNC "%.0" "-" COEFFS 0 1 0 0 0 1 /end COMPU_METHOD
/begin CHARACTERISTIC ICAV_ena "ICAV-based misfire detection{ICAV_ena&0xff=0:Disabled}{ICAV_ena&0xff=1:Enabled}" VALUE 0x00147dc1 /* @ECU_Address@ICAV_ena@0x01005098@ */ ECIPP_ALIGNMENT_UBYTE 255 ICAV_ena_COMPU_VTAB 0 255 BIT_MASK 0xff /end CHARACTERISTIC
/begin COMPU_METHOD ICAV_ena_COMPU_VTAB "Verbal Table" TAB_VERB "%.0" "list" COMPU_TAB_REF ICAV_ena_COMPU_VTAB_REF /end COMPU_METHOD
/begin COMPU_VTAB ICAV_ena_COMPU_VTAB_REF "Verbal Table" TAB_VERB 2 0 "Disabled" 1 "Enabled" DEFAULT_VALUE "UNKNOWN" /end COMPU_VTAB
/begin MEASUREMENT ICAV_status "ICAV status{ICAV_status&0xff=0:Disabled}{ICAV_status&0xff=1:Syncing}{ICAV_status&0xff=2:Start/ECT wait}{ICAV_status&0xff=3:Spark/fuel off}{ICAV_status&0xff=4:Transient: RPMdt}{ICAV_status&0xff=5:Random inactive}{ICAV_status&0xff=6:Adaptive inactive}{ICAV_" UBYTE ICAV_status_COMPU_VTAB 0 0 0 255 ECU_ADDRESS 0x010050A0 BIT_MASK 0xff /end MEASUREMENT
/begin COMPU_METHOD ICAV_status_COMPU_VTAB "Verbal Table" TAB_VERB "%.0" "list" COMPU_TAB_REF ICAV_status_COMPU_VTAB_REF /end COMPU_METHOD
/begin COMPU_VTAB ICAV_status_COMPU_VTAB_REF "Verbal Table" TAB_VERB 18 0 "Disabled" 1 "Syncing" 2 "Start/ECT wait" 3 "Spark/fuel off" 4 "Transient: RPMdt" 5 "Random inactive" 6 "Adaptive inactive" 7 "Adapt/Diag inactive" 8 "Active" 9 "Gear change" 10 "Idle mode active" 11 "VE CWT disable" 12 "Knock disable" 13 "Oil temp disable" 14 "Transient: MAPdt" 15 "Transient: dhist/dt" 16 "Speed/load disable" 17 "PTO disable" DEFAULT_VALUE "UNKNOWN" /end COMPU_VTAB
/begin MEASUREMENT ICAV_sync_cnt "Misfire sync count" UBYTE Compu_ICAV_sync_cnt 0 0 0 255 ECU_ADDRESS 0x010050B0 /end MEASUREMENT
/begin COMPU_METHOD Compu_ICAV_sync_cnt " " RAT_FUNC "%.0" "-" COEFFS 0 1 0 0 0 1 /end COMPU_METHOD
/begin CHARACTERISTIC ICAV_rdm_wt "Random misfire wait" VALUE 0x00147dc4 /* @ECU_Address@ICAV_rdm_wt@0x010050C0@ */ ECIPP_ALIGNMENT_UBYTE 16 Compu_ICAV_rdm_wt 0 15.9375 /end CHARACTERISTIC
/begin COMPU_METHOD Compu_ICAV_rdm_wt " " RAT_FUNC "%.1" "cycles" COEFFS 0 16 0 0 0 1 /end COMPU_METHOD
/begin CHARACTERISTIC ICAV_adpt_wt "Adaptive misfire disabling" VALUE 0x00147db9 /* @ECU_Address@ICAV_adpt_wt@0x010050C8@ */ ECIPP_ALIGNMENT_UBYTE 16 Compu_ICAV_adpt_wt 0 15.9375 /end CHARACTERISTIC
/begin COMPU_METHOD Compu_ICAV_adpt_wt " " RAT_FUNC "%.1" "cycles" COEFFS 0 16 0 0 0 1 /end COMPU_METHOD
/begin CHARACTERISTIC ICAV_start_wait "Misfire start wait" VALUE 0x001474b2 /* @ECU_Address@ICAV_start_wait@0x010050D0@ */ ECIPP_ALIGNMENT_UWORD 65535 Compu_ICAV_start_wait 0 65535 /end CHARACTERISTIC
/begin COMPU_METHOD Compu_ICAV_start_wait " " RAT_FUNC "%.1" "sec" COEFFS 0 1 0 0 0 1 /end COMPU_METHOD
/begin CHARACTERISTIC ICAV_ECT_ena "Misfire ECT enable" VALUE 0x00147486 /* @ECU_Address@ICAV_ECT_ena@0x010050D8@ */ ECIPP_ALIGNMENT_UWORD 564 Compu_ICAV_ECT_ena -460 563.984375 /end CHARACTERISTIC
/begin COMPU_METHOD Compu_ICAV_ECT_ena " " RAT_FUNC "%.1" "deg F" COEFFS 0 64 29440 0 0 1 /end COMPU_METHOD
/begin MEASUREMENT ICAV_MAPdt_off "Misfire MAPdt trigger" SWORD Compu_ICAV_MAPdt_off 0 0 -4000 3999.8779296875 ECU_ADDRESS 0x010050E0 /end MEASUREMENT
/begin COMPU_METHOD Compu_ICAV_MAPdt_off " " RAT_FUNC "%.0" "psi/sec" COEFFS 0 8.192 0 0 0 1 /end COMPU_METHOD
/begin MEASUREMENT ICAV_rpmdt_off "Misfire disable RPMdt trigger" SWORD Compu_ICAV_rpmdt_off 0 0 -30720 30719.0625 ECU_ADDRESS 0x010050E8 /end MEASUREMENT
/begin COMPU_METHOD Compu_ICAV_rpmdt_off " " RAT_FUNC "%.0" "rpm/sec" COEFFS 0 1.06666666666667 0 0 0 1 /end COMPU_METHOD
/begin MEASUREMENT ICAV_rpm_dt "ICAV RPMdt" SWORD Compu_ICAV_rpm_dt 0 0 -30720 30719.0625 ECU_ADDRESS 0x010050F0 /end MEASUREMENT
/begin COMPU_METHOD Compu_ICAV_rpm_dt " " RAT_FUNC "%.0" "rpm/sec" COEFFS 0 1.06666666666667 0 0 0 1 /end COMPU_METHOD
/begin CHARACTERISTIC ICAV_misdet_mult "Misfire detect multiplier" VALUE 0x001474aa /* @ECU_Address@ICAV_misdet_mult@0x010050F8@ */ ECIPP_ALIGNMENT_UWORD 256 Compu_ICAV_misdet_mult 0 255.99609375 /end CHARACTERISTIC
/begin COMPU_METHOD Compu_ICAV_misdet_mult " " RAT_FUNC "%.2" "-" COEFFS 0 256 0 0 0 1 /end COMPU_METHOD
/begin CHARACTERISTIC ICAV_adpt_K "Adaptive gain" VALUE 0x0014748e /* @ECU_Address@ICAV_adpt_K@0x01005100@ */ ECIPP_ALIGNMENT_UWORD 100 Compu_ICAV_adpt_K 0 99.9984741210938 /end CHARACTERISTIC
/begin COMPU_METHOD Compu_ICAV_adpt_K " " RAT_FUNC "%.3" "% error / cycle" COEFFS 0 655.36 0 0 0 1 /end COMPU_METHOD
/begin MEASUREMENT ICAV_pct_tau "ICAV tau" UWORD Compu_ICAV_pct_tau 0 0 0.090168 65536 ECU_ADDRESS 0x01005108 /end MEASUREMENT
/begin COMPU_METHOD Compu_ICAV_pct_tau " " FORM "%.0" "cycles"
 /begin FORMULA "-1 / log(1 - (X1 / 65536))" FORMULA_INV "(1 - exp(-1/X1)) * 65536" /end FORMULA
/end COMPU_METHOD
/begin CHARACTERISTIC ICAV_cts_tau "Continuous indicator tau" VALUE 0x00147bf6 /* @ECU_Address@ICAV_cts_tau@0x01005110@ */ ECIPP_ALIGNMENT_UWORD 32768 Compu_ICAV_cts_tau 0.033406 32768 /end CHARACTERISTIC
/begin COMPU_METHOD Compu_ICAV_cts_tau " " FORM "%.0" "cycles"
 /begin FORMULA "-1 / log(1.0000000000001 - (X1 / 32768))" FORMULA_INV "(1.0000000000001 - exp(-1/X1)) * 32768" /end FORMULA
/end COMPU_METHOD
/begin MEASUREMENT ICAV_thres_cts "Continuous indicator threshold" SWORD Compu_ICAV_thres_cts 0 0 -1024 1023.96875 ECU_ADDRESS 0x01005118 /end MEASUREMENT
/begin COMPU_METHOD Compu_ICAV_thres_cts " " RAT_FUNC "%.1" "rev/sec^2" COEFFS 0 32 0 0 0 1 /end COMPU_METHOD
/begin MEASUREMENT ICAV_thres_rdm "Random indicator threshold" SWORD Compu_ICAV_thres_rdm 0 0 -1024 1023.96875 ECU_ADDRESS 0x01005120 /end MEASUREMENT
/begin COMPU_METHOD Compu_ICAV_thres_rdm " " RAT_FUNC "%.1" "rev/sec^2" COEFFS 0 32 0 0 0 1 /end COMPU_METHOD
/begin MEASUREMENT ICAV_flt_trig "Fault trigger threshold" SWORD Compu_ICAV_flt_trig 0 0 -200 199.993896484375 ECU_ADDRESS 0x01005128 /end MEASUREMENT
/begin COMPU_METHOD Compu_ICAV_flt_trig " " RAT_FUNC "%.1" "%" COEFFS 0 163.84 0 0 0 1 /end COMPU_METHOD
/begin MEASUREMENT ICAV_reset "Misfire reset{ICAV_reset&0xff=0:Inactive}{ICAV_reset&0xff=1:Reset misfire count}{ICAV_reset&0xff=2:Reset adaptation}{ICAV_reset&0xff=3:Reset all}" UBYTE ICAV_reset_COMPU_VTAB 0 0 0 255 ECU_ADDRESS 0x01005130 BIT_MASK 0xff /end MEASUREMENT
/begin COMPU_METHOD ICAV_reset_COMPU_VTAB "Verbal Table" TAB_VERB "%.0" "list" COMPU_TAB_REF ICAV_reset_COMPU_VTAB_REF /end COMPU_METHOD
/begin COMPU_VTAB ICAV_reset_COMPU_VTAB_REF "Verbal Table" TAB_VERB 4 0 "Inactive" 1 "Reset misfire count" 2 "Reset adaptation" 3 "Reset all" DEFAULT_VALUE "UNKNOWN" /end COMPU_VTAB
/begin MEASUREMENT ICAV_pct_bk1 "Misfire percent bank 1" UWORD Compu_ICAV_pct_bk1 0 0 0 399.993896484375 ECU_ADDRESS 0x01005140 /end MEASUREMENT
/begin COMPU_METHOD Compu_ICAV_pct_bk1 " " RAT_FUNC "%.2" "%" COEFFS 0 163.84 0 0 0 1 /end COMPU_METHOD
/begin MEASUREMENT ICAV_pct_bk2 "Misfire percent bank 2" UWORD Compu_ICAV_pct_bk2 0 0 0 399.993896484375 ECU_ADDRESS 0x01005148 /end MEASUREMENT
/begin COMPU_METHOD Compu_ICAV_pct_bk2 " " RAT_FUNC "%.2" "%" COEFFS 0 163.84 0 0 0 1 /end COMPU_METHOD
/begin MEASUREMENT ICAV_pct_total "Misfire percent" UWORD Compu_ICAV_pct_total 0 0 0 399.993896484375 ECU_ADDRESS 0x01005150 /end MEASUREMENT
/begin COMPU_METHOD Compu_ICAV_pct_total " " RAT_FUNC "%.2" "%" COEFFS 0 163.84 0 0 0 1 /end COMPU_METHOD
/begin MEASUREMENT ICAV_nrm_bk1 "Normalized misfire bank 1" UWORD Compu_ICAV_nrm_bk1 0 0 0 255.99609375 ECU_ADDRESS 0x01005158 /end MEASUREMENT
/begin COMPU_METHOD Compu_ICAV_nrm_bk1 " " RAT_FUNC "%.2" "-" COEFFS 0 256 0 0 0 1 /end COMPU_METHOD
/begin MEASUREMENT ICAV_nrm_bk2 "Normalized misfire bank 2" UWORD Compu_ICAV_nrm_bk2 0 0 0 255.99609375 ECU_ADDRESS 0x01005160 /end MEASUREMENT
/begin COMPU_METHOD Compu_ICAV_nrm_bk2 " " RAT_FUNC "%.2" "-" COEFFS 0 256 0 0 0 1 /end COMPU_METHOD
/begin MEASUREMENT ICAV_nrm_total "Normalized misfire" UWORD Compu_ICAV_nrm_total 0 0 0 255.99609375 ECU_ADDRESS 0x01005168 /end MEASUREMENT
/begin COMPU_METHOD Compu_ICAV_nrm_total " " RAT_FUNC "%.2" "-" COEFFS 0 256 0 0 0 1 /end COMPU_METHOD
/begin MEASUREMENT ICAV_det_trig "Misfire detected trigger" UWORD Compu_ICAV_det_trig 0 0 0 399.993896484375 ECU_ADDRESS 0x01005170 /end MEASUREMENT
/begin COMPU_METHOD Compu_ICAV_det_trig " " RAT_FUNC "%.1" "%" COEFFS 0 163.84 0 0 0 1 /end COMPU_METHOD
/begin MEASUREMENT ICAV_cyc_cts "Continuous misfire indicator" SWORD Compu_ICAV_cyc_cts 0 0 -1024 1023.96875 ECU_ADDRESS 0x01005178 /end MEASUREMENT
/begin COMPU_METHOD Compu_ICAV_cyc_cts " " RAT_FUNC "%.1" "rev/sec^2" COEFFS 0 32 0 0 0 1 /end COMPU_METHOD
/begin MEASUREMENT inj_kill_mode "Injector kill mode{inj_kill_mode&0xff=0:Single continuous}{inj_kill_mode&0xff=1:Paired continuous}" UBYTE inj_kill_mode_COMPU_VTAB 0 0 0 255 ECU_ADDRESS 0x01005180 BIT_MASK 0xff /end MEASUREMENT
/begin COMPU_METHOD inj_kill_mode_COMPU_VTAB "Verbal Table" TAB_VERB "%.0" "list" COMPU_TAB_REF inj_kill_mode_COMPU_VTAB_REF /end COMPU_METHOD
/begin COMPU_VTAB inj_kill_mode_COMPU_VTAB_REF "Verbal Table" TAB_VERB 2 0 "Single continuous" 1 "Paired continuous" DEFAULT_VALUE "UNKNOWN" /end COMPU_VTAB
/begin MEASUREMENT ICAV_hist "Adaptive progress histogram" UWORD Compu_ICAV_hist 0 0 0 65535 ECU_ADDRESS 0x01005190 /end MEASUREMENT
/begin COMPU_METHOD Compu_ICAV_hist " " RAT_FUNC "%.0" "cycles" COEFFS 0 1 0 0 0 1 /end COMPU_METHOD
/begin CHARACTERISTIC ICAV_thres_hist "Adaptive progress threshold" VALUE 0x001474b4 /* @ECU_Address@ICAV_thres_hist@0x01005198@ */ ECIPP_ALIGNMENT_UWORD 65535 Compu_ICAV_thres_hist 0 65535 /end CHARACTERISTIC
/begin COMPU_METHOD Compu_ICAV_thres_hist " " RAT_FUNC "%.0" "cycles" COEFFS 0 1 0 0 0 1 /end COMPU_METHOD
/begin MEASUREMENT ICAV_thres_safe "Adaptive safe threshold" SWORD Compu_ICAV_thres_safe 0 0 -2 1.99993896484375 ECU_ADDRESS 0x010051A0 /end MEASUREMENT
/begin COMPU_METHOD Compu_ICAV_thres_safe " " RAT_FUNC "%.2" "%" COEFFS 0 16384 0 0 0 1 /end COMPU_METHOD
/begin MEASUREMENT ICAV_safe "Adaptive safe" SWORD Compu_ICAV_safe 0 0 -2 1.99993896484375 ECU_ADDRESS 0x010051A8 /end MEASUREMENT
/begin COMPU_METHOD Compu_ICAV_safe " " RAT_FUNC "%.2" "%" COEFFS 0 16384 0 0 0 1 /end COMPU_METHOD
/begin CHARACTERISTIC ICAV_rdm_rst "Random misfire reset" VALUE 0x0014432a /* @ECU_Address@ICAV_rdm_rst@0x010051B0@ */ ECIPP_ALIGNMENT_SWORD 200 Compu_ICAV_rdm_rst -200 199.993896484375 /end CHARACTERISTIC
/begin COMPU_METHOD Compu_ICAV_rdm_rst " " RAT_FUNC "%.1" "% threshold" COEFFS 0 163.84 0 0 0 1 /end COMPU_METHOD
/begin CHARACTERISTIC ICAV_cid_num "Continuous misfire id" VALUE 0x00147dbe /* @ECU_Address@ICAV_cid_num@0x010051B8@ */ ECIPP_ALIGNMENT_UBYTE 255 Compu_ICAV_cid_num 0 255 /end CHARACTERISTIC
/begin COMPU_METHOD Compu_ICAV_cid_num " " RAT_FUNC "%.0" "cyls" COEFFS 0 1 0 0 0 1 /end COMPU_METHOD
/begin CHARACTERISTIC ICAV_cid_thres "Continuous misfire ID threshold" VALUE 0x00144324 /* @ECU_Address@ICAV_cid_thres@0x010051C0@ */ ECIPP_ALIGNMENT_SWORD 200 Compu_ICAV_cid_thres -200 199.993896484375 /end CHARACTERISTIC
/begin COMPU_METHOD Compu_ICAV_cid_thres " " RAT_FUNC "%.1" "%" COEFFS 0 163.84 0 0 0 1 /end COMPU_METHOD
/begin CHARACTERISTIC ICAV_adpt_dead "Adaptive deadzone" VALUE 0x00144320 /* @ECU_Address@ICAV_adpt_dead@0x010051E8@ */ ECIPP_ALIGNMENT_SWORD 200 Compu_ICAV_adpt_dead -200 199.993896484375 /end CHARACTERISTIC
/begin COMPU_METHOD Compu_ICAV_adpt_dead " " RAT_FUNC "%.1" "% cts thres" COEFFS 0 163.84 0 0 0 1 /end COMPU_METHOD
/begin CHARACTERISTIC ICAV_adpt_rolloff "Adaptive update rolloff" VALUE 0x00144322 /* @ECU_Address@ICAV_adpt_rolloff@0x010051F0@ */ ECIPP_ALIGNMENT_SWORD 100 Compu_ICAV_adpt_rolloff -100 99.9969482421875 /end CHARACTERISTIC
/begin COMPU_METHOD Compu_ICAV_adpt_rolloff " " RAT_FUNC "%.1" "% oper pt" COEFFS 0 327.68 0 0 0 1 /end COMPU_METHOD
/begin MEASUREMENT ICAV_max_rdm "Random indicator max" SWORD Compu_ICAV_max_rdm 0 0 -1024 1023.96875 ECU_ADDRESS 0x010051F8 /end MEASUREMENT
/begin COMPU_METHOD Compu_ICAV_max_rdm " " RAT_FUNC "%.1" "rev/sec^2" COEFFS 0 32 0 0 0 1 /end COMPU_METHOD
/begin CHARACTERISTIC ICAV_wind_safe "Adapt safe % wind-up" VALUE 0x001474b6 /* @ECU_Address@ICAV_wind_safe@0x01005210@ */ ECIPP_ALIGNMENT_UWORD 66 Compu_ICAV_wind_safe 0 65.535 /end CHARACTERISTIC
/begin COMPU_METHOD Compu_ICAV_wind_safe " " RAT_FUNC "%.1" "sec" COEFFS 0 1000 0 0 0 1 /end COMPU_METHOD
/begin CHARACTERISTIC ICAV_wind_unsafe "Adapt unsafe % wind-down" VALUE 0x001474b8 /* @ECU_Address@ICAV_wind_unsafe@0x01005218@ */ ECIPP_ALIGNMENT_UWORD 66 Compu_ICAV_wind_unsafe 0 65.535 /end CHARACTERISTIC
/begin COMPU_METHOD Compu_ICAV_wind_unsafe " " RAT_FUNC "%.1" "sec" COEFFS 0 1000 0 0 0 1 /end COMPU_METHOD
/begin MEASUREMENT ICAV_safe_cnt "Adapt safe %" UWORD Compu_ICAV_safe_cnt 0 0 0 99.9984741210938 ECU_ADDRESS 0x01005220 /end MEASUREMENT
/begin COMPU_METHOD Compu_ICAV_safe_cnt " " RAT_FUNC "%.1" "%" COEFFS 0 655.36 0 0 0 1 /end COMPU_METHOD
/begin MEASUREMENT ICAV_safe_latch "Adapt safe %-latch" UWORD Compu_ICAV_safe_latch 0 0 0 99.9984741210938 ECU_ADDRESS 0x01005228 /end MEASUREMENT
/begin COMPU_METHOD Compu_ICAV_safe_latch " " RAT_FUNC "%.1" "%" COEFFS 0 655.36 0 0 0 1 /end COMPU_METHOD
/begin MEASUREMENT ICAV_LED_init "Initialized{ICAV_LED_init&0x80=0x00:Off}{ICAV_LED_init&0x80=0x80:On}" UBYTE ICAV_LED_init_COMPU_VTAB 0 0 0 255 ECU_ADDRESS 0x01005240 BIT_MASK 0xFF /end MEASUREMENT
/begin COMPU_METHOD ICAV_LED_init_COMPU_VTAB "Verbal Table" TAB_VERB "%.0" "list" COMPU_TAB_REF ICAV_LED_init_COMPU_VTAB_REF /end COMPU_METHOD
/begin COMPU_VTAB ICAV_LED_init_COMPU_VTAB_REF "Verbal Table" TAB_VERB 2 0x00 "Off" 0x80 "On" DEFAULT_VALUE "Unsupported Bit_Shift" /end COMPU_VTAB
/begin MEASUREMENT ICAV_LED_safe "Safe{ICAV_LED_safe&0x40=0x00:Off}{ICAV_LED_safe&0x40=0x40:On}" UBYTE ICAV_LED_safe_COMPU_VTAB 0 0 0 255 ECU_ADDRESS 0x01005248 BIT_MASK 0x40 /end MEASUREMENT
/begin COMPU_METHOD ICAV_LED_safe_COMPU_VTAB "Verbal Table" TAB_VERB "%.0" "list" COMPU_TAB_REF ICAV_LED_safe_COMPU_VTAB_REF /end COMPU_METHOD
/begin COMPU_VTAB ICAV_LED_safe_COMPU_VTAB_REF "Verbal Table" TAB_VERB 2 0x00 "Off" 0x40 "On" DEFAULT_VALUE "UNKNOWN" /end COMPU_VTAB
/begin MEASUREMENT ICAV_LED_adapt "Adapting{ICAV_LED_adapt&0x20=0x00:Off}{ICAV_LED_adapt&0x20=0x20:On}" UBYTE ICAV_LED_adapt_COMPU_VTAB 0 0 0 255 ECU_ADDRESS 0x01005250 BIT_MASK 0x20 /end MEASUREMENT
/begin COMPU_METHOD ICAV_LED_adapt_COMPU_VTAB "Verbal Table" TAB_VERB "%.0" "list" COMPU_TAB_REF ICAV_LED_adapt_COMPU_VTAB_REF /end COMPU_METHOD
/begin COMPU_VTAB ICAV_LED_adapt_COMPU_VTAB_REF "Verbal Table" TAB_VERB 2 0x00 "Off" 0x20 "On" DEFAULT_VALUE "UNKNOWN" /end COMPU_VTAB
/begin MEASUREMENT ICAV_LED_diag "Diagnosing{ICAV_LED_diag&0x10=0x00:Off}{ICAV_LED_diag&0x10=0x10:On}" UBYTE ICAV_LED_diag_COMPU_VTAB 0 0 0 255 ECU_ADDRESS 0x01005258 BIT_MASK 0xFF /end MEASUREMENT
/begin COMPU_METHOD ICAV_LED_diag_COMPU_VTAB "Verbal Table" TAB_VERB "%.0" "list" COMPU_TAB_REF ICAV_LED_diag_COMPU_VTAB_REF /end COMPU_METHOD
/begin COMPU_VTAB ICAV_LED_diag_COMPU_VTAB_REF "Verbal Table" TAB_VERB 2 0x00 "Off" 0x10 "On" DEFAULT_VALUE "Unsupported Bit_Shift" /end COMPU_VTAB
/begin MEASUREMENT ICAV_LED_miss "Misfiring{ICAV_LED_miss&0x08=0x00:Off}{ICAV_LED_miss&0x08=0x08:On}" UBYTE ICAV_LED_miss_COMPU_VTAB 0 0 0 255 ECU_ADDRESS 0x01005260 BIT_MASK 0x08 /end MEASUREMENT
/begin COMPU_METHOD ICAV_LED_miss_COMPU_VTAB "Verbal Table" TAB_VERB "%.0" "list" COMPU_TAB_REF ICAV_LED_miss_COMPU_VTAB_REF /end COMPU_METHOD
/begin COMPU_VTAB ICAV_LED_miss_COMPU_VTAB_REF "Verbal Table" TAB_VERB 2 0x00 "Off" 0x08 "On" DEFAULT_VALUE "UNKNOWN" /end COMPU_VTAB
/begin CHARACTERISTIC ICAV_adpt_Khi "Adaptive progressed high gain" VALUE 0x00147490 /* @ECU_Address@ICAV_adpt_Khi@0x01005268@ */ ECIPP_ALIGNMENT_UWORD 100 Compu_ICAV_adpt_Khi 0 99.9984741210938 /end CHARACTERISTIC
/begin COMPU_METHOD Compu_ICAV_adpt_Khi " " RAT_FUNC "%.3" "% error / cycle" COEFFS 0 655.36 0 0 0 1 /end COMPU_METHOD
/begin CHARACTERISTIC ICAV_adpt_Klo "Adaptive progressed low gain" VALUE 0x00147492 /* @ECU_Address@ICAV_adpt_Klo@0x01005270@ */ ECIPP_ALIGNMENT_UWORD 100 Compu_ICAV_adpt_Klo 0 99.9984741210938 /end CHARACTERISTIC
/begin COMPU_METHOD Compu_ICAV_adpt_Klo " " RAT_FUNC "%.3" "% error / cycle" COEFFS 0 655.36 0 0 0 1 /end COMPU_METHOD
/begin CHARACTERISTIC ICAV_miscyl_rst "Misfire cyl diag persist" VALUE 0x00147dc2 /* @ECU_Address@ICAV_miscyl_rst@0x01005278@ */ ECIPP_ALIGNMENT_UBYTE 13 Compu_ICAV_miscyl_rst 0 12.75 /end CHARACTERISTIC
/begin COMPU_METHOD Compu_ICAV_miscyl_rst " " RAT_FUNC "%.1" "sec" COEFFS 0 20 0 0 0 1 /end COMPU_METHOD
/begin MEASUREMENT ICAV_LED_trans "Transient{ICAV_LED_trans&0x04=0x00:Off}{ICAV_LED_trans&0x04=0x04:On}" UBYTE ICAV_LED_trans_COMPU_VTAB 0 0 0 255 ECU_ADDRESS 0x01005280 BIT_MASK 0x04 /end MEASUREMENT
/begin COMPU_METHOD ICAV_LED_trans_COMPU_VTAB "Verbal Table" TAB_VERB "%.0" "list" COMPU_TAB_REF ICAV_LED_trans_COMPU_VTAB_REF /end COMPU_METHOD
/begin COMPU_VTAB ICAV_LED_trans_COMPU_VTAB_REF "Verbal Table" TAB_VERB 2 0x00 "Off" 0x04 "On" DEFAULT_VALUE "UNKNOWN" /end COMPU_VTAB
/begin CHARACTERISTIC ICAV_thres_mult "Adapt in-progress added margin" VALUE 0x0014432e /* @ECU_Address@ICAV_thres_mult@0x01005340@ */ ECIPP_ALIGNMENT_SWORD 100 Compu_ICAV_thres_mult -300 99.993896484375 /end CHARACTERISTIC
/begin COMPU_METHOD Compu_ICAV_thres_mult " " RAT_FUNC "%.1" "%" COEFFS 0 163.84 16384 0 0 1 /end COMPU_METHOD
/begin CHARACTERISTIC ICAV_nomis_lmt "Misfire free key cycle count reset" VALUE 0x00147dc3 /* @ECU_Address@ICAV_nomis_lmt@0x01005630@ */ ECIPP_ALIGNMENT_UBYTE 255 Compu_ICAV_nomis_lmt 0 255 /end CHARACTERISTIC
/begin COMPU_METHOD Compu_ICAV_nomis_lmt " " RAT_FUNC "%.0" "key cyc" COEFFS 0 1 0 0 0 1 /end COMPU_METHOD
/begin MEASUREMENT ICAV_cts_norm "Continuous normalized indicator" SWORD Compu_ICAV_cts_norm 0 0 -4 3.9998779296875 ECU_ADDRESS 0x01005730 /end MEASUREMENT
/begin COMPU_METHOD Compu_ICAV_cts_norm " " RAT_FUNC "%.2" "-" COEFFS 0 8192 0 0 0 1 /end COMPU_METHOD
/begin MEASUREMENT ICAV_rdm_norm "Random normalized indicator" SWORD Compu_ICAV_rdm_norm 0 0 -4 3.9998779296875 ECU_ADDRESS 0x01005738 /end MEASUREMENT
/begin COMPU_METHOD Compu_ICAV_rdm_norm " " RAT_FUNC "%.2" "-" COEFFS 0 8192 0 0 0 1 /end COMPU_METHOD
/begin CHARACTERISTIC ICAV_transient_wt "Transient diag disabling" VALUE 0x00147dc7 /* @ECU_Address@ICAV_transient_wt@0x01005850@ */ ECIPP_ALIGNMENT_UBYTE 128 Compu_ICAV_transient_wt 0 127.5 /end CHARACTERISTIC
/begin COMPU_METHOD Compu_ICAV_transient_wt " " RAT_FUNC "%.1" "cycles" COEFFS 0 2 0 0 0 1 /end COMPU_METHOD
/begin CHARACTERISTIC ICAV_dhist_tau "Adaptive progress derivative filter" VALUE 0x00147bf8 /* @ECU_Address@ICAV_dhist_tau@0x01005858@ */ ECIPP_ALIGNMENT_UWORD 1638398 Compu_ICAV_dhist_tau 1.6703 1638400 /end CHARACTERISTIC
/begin COMPU_METHOD Compu_ICAV_dhist_tau " " FORM "%.0" "ms"
 /begin FORMULA "-50 / log(1.0000000000001 - (X1 / 32768))" FORMULA_INV "(1.0000000000001 - exp(-50/X1)) * 32768" /end FORMULA
/end COMPU_METHOD
/begin CHARACTERISTIC ICAV_dhist_max "Adaptive progress derivative limit" VALUE 0x0014749a /* @ECU_Address@ICAV_dhist_max@0x01005860@ */ ECIPP_ALIGNMENT_UWORD 1024 Compu_ICAV_dhist_max 0 1023.984375 /end CHARACTERISTIC
/begin COMPU_METHOD Compu_ICAV_dhist_max " " RAT_FUNC "%.1" "cycles/sec" COEFFS 0 64 0 0 0 1 /end COMPU_METHOD
/begin MEASUREMENT ICAV_dhist "Adaptive progress derivative" UWORD Compu_ICAV_dhist 0 0 0 1023.984375 ECU_ADDRESS 0x01005868 /end MEASUREMENT
/begin COMPU_METHOD Compu_ICAV_dhist " " RAT_FUNC "%.1" "cycles/sec" COEFFS 0 64 0 0 0 1 /end COMPU_METHOD
/begin CHARACTERISTIC ICAV_rpm_min "Lower/upper speed limits" VALUE 0x001474b0 /* @ECU_Address@ICAV_rpm_min@0x010058D0@ */ ECIPP_ALIGNMENT_UWORD 65535 Compu_ICAV_rpm_min 0 65535 /end CHARACTERISTIC
/begin COMPU_METHOD Compu_ICAV_rpm_min " " RAT_FUNC "%.0" "rpm" COEFFS 0 1 0 0 0 1 /end COMPU_METHOD
/begin CHARACTERISTIC ICAV_rpm_max "Upper speed limit" VALUE 0x001474ae /* @ECU_Address@ICAV_rpm_max@0x010058D8@ */ ECIPP_ALIGNMENT_UWORD 65535 Compu_ICAV_rpm_max 0 65535 /end CHARACTERISTIC
/begin COMPU_METHOD Compu_ICAV_rpm_max " " RAT_FUNC "%.0" "rpm" COEFFS 0 1 0 0 0 1 /end COMPU_METHOD
/begin CHARACTERISTIC ICAV_maL_min "Lower/upper load limits" VALUE 0x001474a8 /* @ECU_Address@ICAV_maL_min@0x010058E0@ */ ECIPP_ALIGNMENT_UWORD 16384 Compu_ICAV_maL_min 0 16383.75 /end CHARACTERISTIC
/begin COMPU_METHOD Compu_ICAV_maL_min " " RAT_FUNC "%.0" "mg/Ld" COEFFS 0 4 0 0 0 1 /end COMPU_METHOD
/begin CHARACTERISTIC ICAV_maL_max "Upper load limit" VALUE 0x001474a6 /* @ECU_Address@ICAV_maL_max@0x010058E8@ */ ECIPP_ALIGNMENT_UWORD 16384 Compu_ICAV_maL_max 0 16383.75 /end CHARACTERISTIC
/begin COMPU_METHOD Compu_ICAV_maL_max " " RAT_FUNC "%.0" "mg/Ld" COEFFS 0 4 0 0 0 1 /end COMPU_METHOD
/begin CHARACTERISTIC ICAV_rdmtrans_wt "Random diag trans disable" VALUE 0x00147dc5 /* @ECU_Address@ICAV_rdmtrans_wt@0x01005910@ */ ECIPP_ALIGNMENT_UBYTE 255 Compu_ICAV_rdmtrans_wt 0 255 /end CHARACTERISTIC
/begin COMPU_METHOD Compu_ICAV_rdmtrans_wt " " RAT_FUNC "%.0" "cycles" COEFFS 0 1 0 0 0 1 /end COMPU_METHOD
/begin CHARACTERISTIC ICAV_adpthst_load "Power-on histogram restore{ICAV_adpthst_load&0xff=0:Disabled}{ICAV_adpthst_load&0xff=1:Enabled}" VALUE 0x00147dba /* @ECU_Address@ICAV_adpthst_load@0x01005918@ */ ECIPP_ALIGNMENT_UBYTE 255 ICAV_adpthst_load_COMPU_VTAB 0 255 BIT_MASK 0xff /end CHARACTERISTIC
/begin COMPU_METHOD ICAV_adpthst_load_COMPU_VTAB "Verbal Table" TAB_VERB "%.0" "list" COMPU_TAB_REF ICAV_adpthst_load_COMPU_VTAB_REF /end COMPU_METHOD
/begin COMPU_VTAB ICAV_adpthst_load_COMPU_VTAB_REF "Verbal Table" TAB_VERB 2 0 "Disabled" 1 "Enabled" DEFAULT_VALUE "UNKNOWN" /end COMPU_VTAB
/begin MEASUREMENT ICAV_dctsnrm "Continuous indicator derivative" SWORD Compu_ICAV_dctsnrm 0 0 -12.5 12.4996185302734 ECU_ADDRESS 0x01005938 /end MEASUREMENT
/begin COMPU_METHOD Compu_ICAV_dctsnrm " " RAT_FUNC "%.3" "%/cyc" COEFFS 0 2621.44 0 0 0 1 /end COMPU_METHOD
/begin CHARACTERISTIC ICAV_dctsnrm_max "Max derivative continuous indicator" VALUE 0x00144326 /* @ECU_Address@ICAV_dctsnrm_max@0x01005940@ */ ECIPP_ALIGNMENT_SWORD 12 Compu_ICAV_dctsnrm_max -12.5 12.4996185302734 /end CHARACTERISTIC
/begin COMPU_METHOD Compu_ICAV_dctsnrm_max " " RAT_FUNC "%.3" "%/cyc" COEFFS 0 2621.44 0 0 0 1 /end COMPU_METHOD
/begin CHARACTERISTIC ICAV_dctsnrm_wt "Max derivative adapt disabling" VALUE 0x00147dbf /* @ECU_Address@ICAV_dctsnrm_wt@0x01005948@ */ ECIPP_ALIGNMENT_UBYTE 255 Compu_ICAV_dctsnrm_wt 0 255 /end CHARACTERISTIC
/begin COMPU_METHOD Compu_ICAV_dctsnrm_wt " " RAT_FUNC "%.0" "cycles" COEFFS 0 1 0 0 0 1 /end COMPU_METHOD
/begin CHARACTERISTIC ICAV_rmis_transwt "Random misfire trans wait" VALUE 0x00147dc6 /* @ECU_Address@ICAV_rmis_transwt@0x01005950@ */ ECIPP_ALIGNMENT_UBYTE 16 Compu_ICAV_rmis_transwt 0 15.9375 /end CHARACTERISTIC
/begin COMPU_METHOD Compu_ICAV_rmis_transwt " " RAT_FUNC "%.1" "cycles" COEFFS 0 16 0 0 0 1 /end COMPU_METHOD
/begin CHARACTERISTIC ICAV_MAPdt_mult "Misfire MAPdt disable mult" VALUE 0x0014431a /* @ECU_Address@ICAV_MAPdt_mult@0x01005958@ */ ECIPP_ALIGNMENT_SWORD 4 Compu_ICAV_MAPdt_mult -4 3.9998779296875 /end CHARACTERISTIC
/begin COMPU_METHOD Compu_ICAV_MAPdt_mult " " RAT_FUNC "%.2" "-" COEFFS 0 8192 0 0 0 1 /end COMPU_METHOD
/begin CHARACTERISTIC ICAV_rpmdt_mult "Misfire RPMdt disable mult" VALUE 0x0014432c /* @ECU_Address@ICAV_rpmdt_mult@0x01005960@ */ ECIPP_ALIGNMENT_SWORD 4 Compu_ICAV_rpmdt_mult -4 3.9998779296875 /end CHARACTERISTIC
/begin COMPU_METHOD Compu_ICAV_rpmdt_mult " " RAT_FUNC "%.2" "-" COEFFS 0 8192 0 0 0 1 /end COMPU_METHOD
/begin CHARACTERISTIC ICAV_transx_wt "Misfire transient disable" VALUE 0x00147dc8 /* @ECU_Address@ICAV_transx_wt@0x01005968@ */ ECIPP_ALIGNMENT_UBYTE 255 Compu_ICAV_transx_wt 0 255 /end CHARACTERISTIC
/begin COMPU_METHOD Compu_ICAV_transx_wt " " RAT_FUNC "%.0" "cycles" COEFFS 0 1 0 0 0 1 /end COMPU_METHOD
/begin CHARACTERISTIC ICAV_dgear_wt "Misfire gear change disable" VALUE 0x00147498 /* @ECU_Address@ICAV_dgear_wt@0x01005970@ */ ECIPP_ALIGNMENT_UWORD 66 Compu_ICAV_dgear_wt 0 65.535 /end CHARACTERISTIC
/begin COMPU_METHOD Compu_ICAV_dgear_wt " " RAT_FUNC "%.1" "sec" COEFFS 0 1000 0 0 0 1 /end COMPU_METHOD
/begin CHARACTERISTIC ICAV_idle_rpm "Idle mode activate" VALUE 0x001474a2 /* @ECU_Address@ICAV_idle_rpm@0x01005978@ */ ECIPP_ALIGNMENT_UWORD 65535 Compu_ICAV_idle_rpm 0 65535 /end CHARACTERISTIC
/begin COMPU_METHOD Compu_ICAV_idle_rpm " " RAT_FUNC "%.0" "rpm" COEFFS 0 1 0 0 0 1 /end COMPU_METHOD
/begin CHARACTERISTIC ICAV_idle_hyst "Idle mode deactivate hysteresis" VALUE 0x001474a0 /* @ECU_Address@ICAV_idle_hyst@0x01005980@ */ ECIPP_ALIGNMENT_UWORD 65535 Compu_ICAV_idle_hyst 0 65535 /end CHARACTERISTIC
/begin COMPU_METHOD Compu_ICAV_idle_hyst " " RAT_FUNC "%.0" "rpm" COEFFS 0 1 0 0 0 1 /end COMPU_METHOD
/begin CHARACTERISTIC ICAV_idle_wt "Idle mode misfire disable" VALUE 0x001474a4 /* @ECU_Address@ICAV_idle_wt@0x01005988@ */ ECIPP_ALIGNMENT_UWORD 66 Compu_ICAV_idle_wt 0 65.535 /end CHARACTERISTIC
/begin COMPU_METHOD Compu_ICAV_idle_wt " " RAT_FUNC "%.1" "sec" COEFFS 0 1000 0 0 0 1 /end COMPU_METHOD
/begin CHARACTERISTIC ICAV_idle_Kmult "Idle mode adapt K mult" VALUE 0x0014749e /* @ECU_Address@ICAV_idle_Kmult@0x01005990@ */ ECIPP_ALIGNMENT_UWORD 4 Compu_ICAV_idle_Kmult 0 3.99993896484375 /end CHARACTERISTIC
/begin COMPU_METHOD Compu_ICAV_idle_Kmult " " RAT_FUNC "%.2" "-" COEFFS 0 16384 0 0 0 1 /end COMPU_METHOD
/begin MEASUREMENT ICAV_LED_gear "Gear Change{ICAV_LED_gear&0x02=0x00:Off}{ICAV_LED_gear&0x02=0x02:On}" UBYTE ICAV_LED_gear_COMPU_VTAB 0 0 0 255 ECU_ADDRESS 0x01005998 BIT_MASK 0x02 /end MEASUREMENT
/begin COMPU_METHOD ICAV_LED_gear_COMPU_VTAB "Verbal Table" TAB_VERB "%.0" "list" COMPU_TAB_REF ICAV_LED_gear_COMPU_VTAB_REF /end COMPU_METHOD
/begin COMPU_VTAB ICAV_LED_gear_COMPU_VTAB_REF "Verbal Table" TAB_VERB 2 0x00 "Off" 0x02 "On" DEFAULT_VALUE "UNKNOWN" /end COMPU_VTAB
/begin MEASUREMENT ICAV_LED_idle "Idle Mode{ICAV_LED_idle&0x01=0x00:Off}{ICAV_LED_idle&0x01=0x01:On}" UBYTE ICAV_LED_idle_COMPU_VTAB 0 0 0 255 ECU_ADDRESS 0x010059A0 BIT_MASK 0x01 /end MEASUREMENT
/begin COMPU_METHOD ICAV_LED_idle_COMPU_VTAB "Verbal Table" TAB_VERB "%.0" "list" COMPU_TAB_REF ICAV_LED_idle_COMPU_VTAB_REF /end COMPU_METHOD
/begin COMPU_VTAB ICAV_LED_idle_COMPU_VTAB_REF "Verbal Table" TAB_VERB 2 0x00 "Off" 0x01 "On" DEFAULT_VALUE "UNKNOWN" /end COMPU_VTAB
/begin CHARACTERISTIC ICAV_VECWT_max "VE CWT + misfire detect disable" VALUE 0x0014431c /* @ECU_Address@ICAV_VECWT_max@0x010059A8@ */ ECIPP_ALIGNMENT_SWORD 100 Compu_ICAV_VECWT_max -100 99.9969482421875 /end CHARACTERISTIC
/begin COMPU_METHOD Compu_ICAV_VECWT_max " " RAT_FUNC "%.1" "%" COEFFS 0 327.68 0 0 0 1 /end COMPU_METHOD
/begin CHARACTERISTIC ICAV_VECWT_min "VE CWT - misfire detect disable" VALUE 0x0014431e /* @ECU_Address@ICAV_VECWT_min@0x010059B0@ */ ECIPP_ALIGNMENT_SWORD 100 Compu_ICAV_VECWT_min -100 99.9969482421875 /end CHARACTERISTIC
/begin COMPU_METHOD Compu_ICAV_VECWT_min " " RAT_FUNC "%.1" "%" COEFFS 0 327.68 0 0 0 1 /end COMPU_METHOD
/begin CHARACTERISTIC ICAV_KNK_max "Knock misfire detect disable" VALUE 0x00147488 /* @ECU_Address@ICAV_KNK_max@0x010059B8@ */ ECIPP_ALIGNMENT_UWORD 100 Compu_ICAV_KNK_max 0 99.9984741210938 /end CHARACTERISTIC
/begin COMPU_METHOD Compu_ICAV_KNK_max " " RAT_FUNC "%.1" "%" COEFFS 0 655.36 0 0 0 1 /end COMPU_METHOD
/begin CHARACTERISTIC ICAV_diag_wt "VE/KNK detect disable" VALUE 0x00147dc0 /* @ECU_Address@ICAV_diag_wt@0x010059C0@ */ ECIPP_ALIGNMENT_UBYTE 255 Compu_ICAV_diag_wt 0 255 /end CHARACTERISTIC
/begin COMPU_METHOD Compu_ICAV_diag_wt " " RAT_FUNC "%.0" "cycles" COEFFS 0 1 0 0 0 1 /end COMPU_METHOD
/begin CHARACTERISTIC ICAV_dctsnrmi_max "Max derivative cts indicator at idle" VALUE 0x00144328 /* @ECU_Address@ICAV_dctsnrmi_max@0x010059C8@ */ ECIPP_ALIGNMENT_SWORD 12 Compu_ICAV_dctsnrmi_max -12.5 12.4996185302734 /end CHARACTERISTIC
/begin COMPU_METHOD Compu_ICAV_dctsnrmi_max " " RAT_FUNC "%.3" "%/cyc" COEFFS 0 2621.44 0 0 0 1 /end COMPU_METHOD
/begin MEASUREMENT EPR_SenseLP "DEPR sensor low-pass tau" UWORD Compu_EPR_SenseLP 0 0 0.045084 32768 ECU_ADDRESS 0x01005DE0 /end MEASUREMENT
/begin COMPU_METHOD Compu_EPR_SenseLP " " FORM "%.1" "ms"
 /begin FORMULA "-0.5 / log(1 - (X1 / 65536))" FORMULA_INV "(1 - exp(-0.5/X1)) * 65536" /end FORMULA
/end COMPU_METHOD
/begin MEASUREMENT MJ_P_cmdavg "Pulsed fuel flow press cmd average" SWORD Compu_MJ_P_cmdavg 0 0 -222 221.993225097656 ECU_ADDRESS 0x01005DE8 /end MEASUREMENT
/begin COMPU_METHOD Compu_MJ_P_cmdavg " " RAT_FUNC "%.3" "in H20" COEFFS 0 147.603603603604 0 0 0 1 /end COMPU_METHOD
/begin MEASUREMENT Vent_dP_cmd "Pulsed fuel flow fuel suction average" SWORD Compu_Vent_dP_cmd 0 0 -222 221.993225097656 ECU_ADDRESS 0x01005DF0 /end MEASUREMENT
/begin COMPU_METHOD Compu_Vent_dP_cmd " " RAT_FUNC "%.3" "in H20" COEFFS 0 147.603603603604 0 0 0 1 /end COMPU_METHOD
/begin CHARACTERISTIC EPRPF_Vent_min "Pulsed fuel flow fuel suction trigger" VALUE 0x00162bd2 /* @ECU_Address@EPRPF_Vent_min@0x01005DF8@ */ ECIPP_ALIGNMENT_SWORD 222 Compu_EPRPF_Vent_min -222 221.993225097656 /end CHARACTERISTIC
/begin COMPU_METHOD Compu_EPRPF_Vent_min " " RAT_FUNC "%.2" "in H20" COEFFS 0 147.603603603604 0 0 0 1 /end COMPU_METHOD
/begin CHARACTERISTIC EPRPF_Vent_hyst "Pulsed fuel flow fuel suction hyst" VALUE 0x00162bd0 /* @ECU_Address@EPRPF_Vent_hyst@0x01005E00@ */ ECIPP_ALIGNMENT_SWORD 222 Compu_EPRPF_Vent_hyst -222 221.993225097656 /end CHARACTERISTIC
/begin COMPU_METHOD Compu_EPRPF_Vent_hyst " " RAT_FUNC "%.2" "in H20" COEFFS 0 147.603603603604 0 0 0 1 /end COMPU_METHOD
/begin CHARACTERISTIC EPRPF_Vent_dead "Pulsed fuel flow fuel suction deadzone" VALUE 0x00162bce /* @ECU_Address@EPRPF_Vent_dead@0x01005E08@ */ ECIPP_ALIGNMENT_SWORD 64 Compu_EPRPF_Vent_dead -64 63.998046875 /end CHARACTERISTIC
/begin COMPU_METHOD Compu_EPRPF_Vent_dead " " RAT_FUNC "%.2" "in H20" COEFFS 0 512 0 0 0 1 /end COMPU_METHOD
/begin CHARACTERISTIC EPRPF_ena "Pulsed fuel flow{EPRPF_ena&0xff=0:Disabled}{EPRPF_ena&0xff=1:Enabled}" VALUE 0x0016510b /* @ECU_Address@EPRPF_ena@0x01005E10@ */ ECIPP_ALIGNMENT_UBYTE 255 EPRPF_ena_COMPU_VTAB 0 255 BIT_MASK 0xff /end CHARACTERISTIC
/begin COMPU_METHOD EPRPF_ena_COMPU_VTAB "Verbal Table" TAB_VERB "%.0" "list" COMPU_TAB_REF EPRPF_ena_COMPU_VTAB_REF /end COMPU_METHOD
/begin COMPU_VTAB EPRPF_ena_COMPU_VTAB_REF "Verbal Table" TAB_VERB 2 0 "Disabled" 1 "Enabled" DEFAULT_VALUE "UNKNOWN" /end COMPU_VTAB
/begin MEASUREMENT EPRPF_active "Pulsed fuel flow status{EPRPF_active&0xff=0:Inactive}{EPRPF_active&0xff=1:Active}" UBYTE EPRPF_active_COMPU_VTAB 0 0 0 255 ECU_ADDRESS 0x01005E18 BIT_MASK 0xff /end MEASUREMENT
/begin COMPU_METHOD EPRPF_active_COMPU_VTAB "Verbal Table" TAB_VERB "%.0" "list" COMPU_TAB_REF EPRPF_active_COMPU_VTAB_REF /end COMPU_METHOD
/begin COMPU_VTAB EPRPF_active_COMPU_VTAB_REF "Verbal Table" TAB_VERB 2 0 "Inactive" 1 "Active" DEFAULT_VALUE "UNKNOWN" /end COMPU_VTAB
/begin CHARACTERISTIC EPRPF_period "Pulsed fuel flow period" VALUE 0x0016510e /* @ECU_Address@EPRPF_period@0x01005E20@ */ ECIPP_ALIGNMENT_UBYTE 255 Compu_EPRPF_period 0 255 /end CHARACTERISTIC
/begin COMPU_METHOD Compu_EPRPF_period " " RAT_FUNC "%.0" "ms" COEFFS 0 1 0 0 0 1 /end COMPU_METHOD
/begin CHARACTERISTIC EPRPF_min_ton "Pulsed fuel flow minimum on-time" VALUE 0x0016510d /* @ECU_Address@EPRPF_min_ton@0x01005E28@ */ ECIPP_ALIGNMENT_UBYTE 255 Compu_EPRPF_min_ton 0 255 /end CHARACTERISTIC
/begin COMPU_METHOD Compu_EPRPF_min_ton " " RAT_FUNC "%.0" "ms" COEFFS 0 1 0 0 0 1 /end COMPU_METHOD
/begin CHARACTERISTIC EPRPF_min_toff "Pulsed fuel flow minimum off-time" VALUE 0x0016510c /* @ECU_Address@EPRPF_min_toff@0x01005E30@ */ ECIPP_ALIGNMENT_UBYTE 255 Compu_EPRPF_min_toff 0 255 /end CHARACTERISTIC
/begin COMPU_METHOD Compu_EPRPF_min_toff " " RAT_FUNC "%.0" "ms" COEFFS 0 1 0 0 0 1 /end COMPU_METHOD
/begin MEASUREMENT EPRPF_inst_PW "Pulsed fuel flow pulse-width" UBYTE Compu_EPRPF_inst_PW 0 0 0 255 ECU_ADDRESS 0x01005E38 /end MEASUREMENT
/begin COMPU_METHOD Compu_EPRPF_inst_PW " " RAT_FUNC "%.1" "ms" COEFFS 0 1 0 0 0 1 /end COMPU_METHOD
/begin MEASUREMENT EPRPF_inst_mult "Pulsed fuel flow fuel suction multiplier" SWORD Compu_EPRPF_inst_mult 0 0 -128 127.99609375 ECU_ADDRESS 0x01005E40 /end MEASUREMENT
/begin COMPU_METHOD Compu_EPRPF_inst_mult " " RAT_FUNC "%.3" "-" COEFFS 0 256 0 0 0 1 /end COMPU_METHOD
/begin CHARACTERISTIC EPRPF_cbrk_trig "Pulsed closing brake trigger" VALUE 0x00162bd4 /* @ECU_Address@EPRPF_cbrk_trig@0x01005E48@ */ ECIPP_ALIGNMENT_SWORD 100 Compu_EPRPF_cbrk_trig -100 99.9969482421875 /end CHARACTERISTIC
/begin COMPU_METHOD Compu_EPRPF_cbrk_trig " " RAT_FUNC "%.1" "%" COEFFS 0 327.68 0 0 0 1 /end COMPU_METHOD
/begin CHARACTERISTIC EPRPF_obrk_trig "Pulsed opening brake trigger" VALUE 0x00162bd6 /* @ECU_Address@EPRPF_obrk_trig@0x01005E50@ */ ECIPP_ALIGNMENT_SWORD 100 Compu_EPRPF_obrk_trig -100 99.9969482421875 /end CHARACTERISTIC
/begin COMPU_METHOD Compu_EPRPF_obrk_trig " " RAT_FUNC "%.1" "%" COEFFS 0 327.68 0 0 0 1 /end COMPU_METHOD
/begin CHARACTERISTIC EPRPF_brk_lptau "Pulsed brake low-pass tau" VALUE 0x001650f8 /* @ECU_Address@EPRPF_brk_lptau@0x01005E58@ */ ECIPP_ALIGNMENT_UWORD 32768 Compu_EPRPF_brk_lptau 0.045084 32768 /end CHARACTERISTIC
/begin COMPU_METHOD Compu_EPRPF_brk_lptau " " FORM "%.1" "ms"
 /begin FORMULA "-0.5 / log(1 - (X1 / 65536))" FORMULA_INV "(1 - exp(-0.5/X1)) * 65536" /end FORMULA
/end COMPU_METHOD
/begin CHARACTERISTIC MJ_azero_wt "Autozero request key-on wait" VALUE 0x00147624 /* @ECU_Address@MJ_azero_wt@0x01005E70@ */ ECIPP_ALIGNMENT_UWORD 65535 Compu_MJ_azero_wt 0 65535 /end CHARACTERISTIC
/begin COMPU_METHOD Compu_MJ_azero_wt " " RAT_FUNC "%.0" "ms" COEFFS 0 1 0 0 0 1 /end COMPU_METHOD
/begin MEASUREMENT MJ_azero_status "Autozero status{MJ_azero_status&0xff=0:Inactive}{MJ_azero_status&0xff=1:Success}{MJ_azero_status&0xff=2:Failed}{MJ_azero_status&0xff=3:Requested}{MJ_azero_status&0xff=4:Active}{MJ_azero_status&0xff=5:Halting}" UBYTE MJ_azero_status_COMPU_VTAB 0 0 0 255 ECU_ADDRESS 0x01005E78 BIT_MASK 0xff /end MEASUREMENT
/begin COMPU_METHOD MJ_azero_status_COMPU_VTAB "Verbal Table" TAB_VERB "%.0" "list" COMPU_TAB_REF MJ_azero_status_COMPU_VTAB_REF /end COMPU_METHOD
/begin COMPU_VTAB MJ_azero_status_COMPU_VTAB_REF "Verbal Table" TAB_VERB 6 0 "Inactive" 1 "Success" 2 "Failed" 3 "Requested" 4 "Active" 5 "Halting" DEFAULT_VALUE "UNKNOWN" /end COMPU_VTAB
/begin MEASUREMENT ICAV_cal_assist "Misfire calibration assist{ICAV_cal_assist&0xff=0:Inactive}{ICAV_cal_assist&0xff=1:Adapt Learn}{ICAV_cal_assist&0xff=2:Thresholds}" UBYTE ICAV_cal_assist_COMPU_VTAB 0 0 0 255 ECU_ADDRESS 0x01007198 BIT_MASK 0xff /end MEASUREMENT
/begin COMPU_METHOD ICAV_cal_assist_COMPU_VTAB "Verbal Table" TAB_VERB "%.0" "list" COMPU_TAB_REF ICAV_cal_assist_COMPU_VTAB_REF /end COMPU_METHOD
/begin COMPU_VTAB ICAV_cal_assist_COMPU_VTAB_REF "Verbal Table" TAB_VERB 3 0 "Inactive" 1 "Adapt Learn" 2 "Thresholds" DEFAULT_VALUE "UNKNOWN" /end COMPU_VTAB
/begin CHARACTERISTIC ICAV_hires_mult "Adaptive update high-resolution multiplier" VALUE 0x0014749c /* @ECU_Address@ICAV_hires_mult@0x010071A0@ */ ECIPP_ALIGNMENT_UWORD 2 Compu_ICAV_hires_mult 0 1.99996948242188 /end CHARACTERISTIC
/begin COMPU_METHOD Compu_ICAV_hires_mult " " RAT_FUNC "%.2" "%" COEFFS 0 32768 0 0 0 1 /end COMPU_METHOD
/begin CHARACTERISTIC ICAV_adpt_hires "Adaptive update high-resolution mode{ICAV_adpt_hires&0xff=0:Disabled}{ICAV_adpt_hires&0xff=1:Enabled}" VALUE 0x00147db8 /* @ECU_Address@ICAV_adpt_hires@0x010071A8@ */ ECIPP_ALIGNMENT_UBYTE 255 ICAV_adpt_hires_COMPU_VTAB 0 255 BIT_MASK 0xff /end CHARACTERISTIC
/begin COMPU_METHOD ICAV_adpt_hires_COMPU_VTAB "Verbal Table" TAB_VERB "%.0" "list" COMPU_TAB_REF ICAV_adpt_hires_COMPU_VTAB_REF /end COMPU_METHOD
/begin COMPU_VTAB ICAV_adpt_hires_COMPU_VTAB_REF "Verbal Table" TAB_VERB 2 0 "Disabled" 1 "Enabled" DEFAULT_VALUE "UNKNOWN" /end COMPU_VTAB
/begin CHARACTERISTIC ICAV_adpt_limit "Adaptive entry saturation" VALUE 0x00147494 /* @ECU_Address@ICAV_adpt_limit@0x010071B0@ */ ECIPP_ALIGNMENT_UWORD 100 Compu_ICAV_adpt_limit 0 99.9984741210938 /end CHARACTERISTIC
/begin COMPU_METHOD Compu_ICAV_adpt_limit " " RAT_FUNC "%.2" "%" COEFFS 0 655.36 0 0 0 1 /end COMPU_METHOD
/begin CHARACTERISTIC DPS_I_init "MJ/EPR DPstd I init" VALUE 0x001442a4 /* @ECU_Address@DPS_I_init@0x010077F0@ */ ECIPP_ALIGNMENT_SWORD 100 Compu_DPS_I_init -100 99.9969482421875 /end CHARACTERISTIC
/begin COMPU_METHOD Compu_DPS_I_init " " RAT_FUNC "%.1" "%" COEFFS 0 327.68 0 0 0 1 /end COMPU_METHOD
/begin CHARACTERISTIC DEPR_strtspk_ena "DEPR starting spark inhibit{DEPR_strtspk_ena&0xff=0:Disabled}{DEPR_strtspk_ena&0xff=1:Enabled: Fuel}{DEPR_strtspk_ena&0xff=2:Enabled: Fuel+Start}" VALUE 0x00147d0e /* @ECU_Address@DEPR_strtspk_ena@0x01007800@ */ ECIPP_ALIGNMENT_UBYTE 255 DEPR_strtspk_ena_COMPU_VTAB 0 255 BIT_MASK 0xff /end CHARACTERISTIC
/begin COMPU_METHOD DEPR_strtspk_ena_COMPU_VTAB "Verbal Table" TAB_VERB "%.0" "list" COMPU_TAB_REF DEPR_strtspk_ena_COMPU_VTAB_REF /end COMPU_METHOD
/begin COMPU_VTAB DEPR_strtspk_ena_COMPU_VTAB_REF "Verbal Table" TAB_VERB 3 0 "Disabled" 1 "Enabled: Fuel" 2 "Enabled: Fuel+Start" DEFAULT_VALUE "UNKNOWN" /end COMPU_VTAB
/begin CHARACTERISTIC DEPR_strtspk_hitrig "DEPR starting spark high trigger" VALUE 0x0014428c /* @ECU_Address@DEPR_strtspk_hitrig@0x01007808@ */ ECIPP_ALIGNMENT_SWORD 222 Compu_DEPR_strtspk_hitrig -222 221.993225097656 /end CHARACTERISTIC
/begin COMPU_METHOD Compu_DEPR_strtspk_hitrig " " RAT_FUNC "%.2" "in H20" COEFFS 0 147.603603603604 0 0 0 1 /end COMPU_METHOD
/begin CHARACTERISTIC DEPR_strtspk_lotrig "DEPR starting spark low trigger" VALUE 0x0014428e /* @ECU_Address@DEPR_strtspk_lotrig@0x01007810@ */ ECIPP_ALIGNMENT_SWORD 222 Compu_DEPR_strtspk_lotrig -222 221.993225097656 /end CHARACTERISTIC
/begin COMPU_METHOD Compu_DEPR_strtspk_lotrig " " RAT_FUNC "%.2" "in H20" COEFFS 0 147.603603603604 0 0 0 1 /end COMPU_METHOD
/begin CHARACTERISTIC DEPR_strtspk_cycles "DEPR starting spark crank cycles" VALUE 0x00146786 /* @ECU_Address@DEPR_strtspk_cycles@0x01007818@ */ ECIPP_ALIGNMENT_UWORD 256 Compu_DEPR_strtspk_cycles 0 255.99609375 /end CHARACTERISTIC
/begin COMPU_METHOD Compu_DEPR_strtspk_cycles " " RAT_FUNC "%.3" "cycles" COEFFS 0 256 0 0 0 1 /end COMPU_METHOD
/begin MEASUREMENT DEPR_strtspk_active "DEPR starting spark active{DEPR_strtspk_active&0x01=0x00:Off}{DEPR_strtspk_active&0x01=0x01:On}" UBYTE DEPR_strtspk_active_COMPU_VTAB 0 0 0 255 ECU_ADDRESS 0x01007820 BIT_MASK 0x01 /end MEASUREMENT
/begin COMPU_METHOD DEPR_strtspk_active_COMPU_VTAB "Verbal Table" TAB_VERB "%.0" "list" COMPU_TAB_REF DEPR_strtspk_active_COMPU_VTAB_REF /end COMPU_METHOD
/begin COMPU_VTAB DEPR_strtspk_active_COMPU_VTAB_REF "Verbal Table" TAB_VERB 2 0x00 "Off" 0x01 "On" DEFAULT_VALUE "UNKNOWN" /end COMPU_VTAB
/begin CHARACTERISTIC DEPR_strtspk_window "DEPR starting spark monitor delay" VALUE 0x00146788 /* @ECU_Address@DEPR_strtspk_window@0x01007828@ */ ECIPP_ALIGNMENT_UWORD 256 Compu_DEPR_strtspk_window 0 255.99609375 /end CHARACTERISTIC
/begin COMPU_METHOD Compu_DEPR_strtspk_window " " RAT_FUNC "%.3" "cycles" COEFFS 0 256 0 0 0 1 /end COMPU_METHOD
/begin CHARACTERISTIC MJ_VVC_Pcrct_TIP "VVC TIP comp multiplier" VALUE 0x00144376 /* @ECU_Address@MJ_VVC_Pcrct_TIP@0x01007CB0@ */ ECIPP_ALIGNMENT_SWORD 4 Compu_MJ_VVC_Pcrct_TIP -4 3.9998779296875 /end CHARACTERISTIC
/begin COMPU_METHOD Compu_MJ_VVC_Pcrct_TIP " " RAT_FUNC "%.2" "-" COEFFS 0 8192 0 0 0 1 /end COMPU_METHOD
/begin MEASUREMENT MJ_VVC_Pcrct_ss "VVC steady-state correction multiplier" UWORD Compu_MJ_VVC_Pcrct_ss 0 0 0 1.99996948242188 ECU_ADDRESS 0x01007CB8 /end MEASUREMENT
/begin COMPU_METHOD Compu_MJ_VVC_Pcrct_ss " " RAT_FUNC "%.3" "-" COEFFS 0 32768 0 0 0 1 /end COMPU_METHOD
/begin CHARACTERISTIC MJ_VVC_MAP_tau "VVC manifold pressure tau" VALUE 0x00147c14 /* @ECU_Address@MJ_VVC_MAP_tau@0x01007CD8@ */ ECIPP_ALIGNMENT_UWORD 327680 Compu_MJ_VVC_MAP_tau 0.45084 327680 /end CHARACTERISTIC
/begin COMPU_METHOD Compu_MJ_VVC_MAP_tau " " FORM "%.0" "ms"
 /begin FORMULA "-5 / log(1 - (X1 / 65536))" FORMULA_INV "(1 - exp(-5/X1)) * 65536" /end FORMULA
/end COMPU_METHOD
/begin CHARACTERISTIC MJ_VVC_MAP_add "VVC TIP comp MAP delta-P" VALUE 0x00147614 /* @ECU_Address@MJ_VVC_MAP_add@0x01007CE0@ */ ECIPP_ALIGNMENT_UWORD 256 Compu_MJ_VVC_MAP_add 0 255.99609375 /end CHARACTERISTIC
/begin COMPU_METHOD Compu_MJ_VVC_MAP_add " " RAT_FUNC "%.1" "psia" COEFFS 0 256 0 0 0 1 /end COMPU_METHOD
/begin MEASUREMENT MJ_P_TIPnom "EPR temp corrected nominal press" SWORD Compu_MJ_P_TIPnom 0 0 -222 221.993225097656 ECU_ADDRESS 0x01007CF0 /end MEASUREMENT
/begin COMPU_METHOD Compu_MJ_P_TIPnom " " RAT_FUNC "%.2" "in H2O" COEFFS 0 147.603603603604 0 0 0 1 /end COMPU_METHOD
/begin MEASUREMENT mdot_f_valve_TPSf "TM based throttle-body valve fuel cmd" FLOAT32_IEEE Compu_mdot_f_valve_TPSf 0 0 -10000000000 10000000000 ECU_ADDRESS 0x0100A690 /end MEASUREMENT
/begin COMPU_METHOD Compu_mdot_f_valve_TPSf " " RAT_FUNC "%.2" "g/sec" COEFFS 0 1 0 0 0 1 /end COMPU_METHOD
/begin CHARACTERISTIC CFV_fuel_calc "CFV fuel calculation mode{CFV_fuel_calc&0xff=0:Speed-Density + dMAP/dt}{CFV_fuel_calc&0xff=1:Throttle-Model Based}" VALUE 0x00147cf5 /* @ECU_Address@CFV_fuel_calc@0x0100B150@ */ ECIPP_ALIGNMENT_UBYTE 255 CFV_fuel_calc_COMPU_VTAB 0 255 BIT_MASK 0xff /end CHARACTERISTIC
/begin COMPU_METHOD CFV_fuel_calc_COMPU_VTAB "Verbal Table" TAB_VERB "%.0" "list" COMPU_TAB_REF CFV_fuel_calc_COMPU_VTAB_REF /end COMPU_METHOD
/begin COMPU_VTAB CFV_fuel_calc_COMPU_VTAB_REF "Verbal Table" TAB_VERB 2 0 "Speed-Density + dMAP/dt" 1 "Throttle-Model Based" DEFAULT_VALUE "UNKNOWN" /end COMPU_VTAB
/begin MEASUREMENT CFV_ctltype_cmd "CFV control type command{CFV_ctltype_cmd&0xff=0:Flow Command}{CFV_ctltype_cmd&0xff=1:Fixed Press/Pos/Flow}{CFV_ctltype_cmd&0xff=2:Force Command}{CFV_ctltype_cmd&0xff=3:Offline}" UBYTE CFV_ctltype_cmd_COMPU_VTAB 0 0 0 255 ECU_ADDRESS 0x0100B2E8 BIT_MASK 0xff /end MEASUREMENT
/begin COMPU_METHOD CFV_ctltype_cmd_COMPU_VTAB "Verbal Table" TAB_VERB "%.0" "list" COMPU_TAB_REF CFV_ctltype_cmd_COMPU_VTAB_REF /end COMPU_METHOD
/begin COMPU_VTAB CFV_ctltype_cmd_COMPU_VTAB_REF "Verbal Table" TAB_VERB 4 0 "Flow Command" 1 "Fixed Press/Pos/Flow" 2 "Force Command" 3 "Offline" DEFAULT_VALUE "UNKNOWN" /end COMPU_VTAB
/begin MEASUREMENT CFV_ctltype_act "CFV control type feedback{CFV_ctltype_act&0xff=0:Flow Command}{CFV_ctltype_act&0xff=1:Fixed Press/Pos/Flow}{CFV_ctltype_act&0xff=2:Force Command}{CFV_ctltype_act&0xff=3:Offline}" UBYTE CFV_ctltype_act_COMPU_VTAB 0 0 0 255 ECU_ADDRESS 0x0100B2F0 BIT_MASK 0xff /end MEASUREMENT
/begin COMPU_METHOD CFV_ctltype_act_COMPU_VTAB "Verbal Table" TAB_VERB "%.0" "list" COMPU_TAB_REF CFV_ctltype_act_COMPU_VTAB_REF /end COMPU_METHOD
/begin COMPU_VTAB CFV_ctltype_act_COMPU_VTAB_REF "Verbal Table" TAB_VERB 4 0 "Flow Command" 1 "Fixed Press/Pos/Flow" 2 "Force Command" 3 "Offline" DEFAULT_VALUE "UNKNOWN" /end COMPU_VTAB
/begin MEASUREMENT CFVI_flash_wr_left "Internal flash writes remaining" SBYTE Compu_CFVI_flash_wr_left 0 0 -128 127 ECU_ADDRESS 0x0100B300 /end MEASUREMENT
/begin COMPU_METHOD Compu_CFVI_flash_wr_left " " RAT_FUNC "%.0" "count" COEFFS 0 1 0 0 0 1 /end COMPU_METHOD
/begin MEASUREMENT CFVI_flash_wr_force "Internal flash write request{CFVI_flash_wr_force&0xff=0:Idle}{CFVI_flash_wr_force&0xff=1:Write Flash}" UBYTE CFVI_flash_wr_force_COMPU_VTAB 0 0 0 255 ECU_ADDRESS 0x0100B308 BIT_MASK 0xff /end MEASUREMENT
/begin COMPU_METHOD CFVI_flash_wr_force_COMPU_VTAB "Verbal Table" TAB_VERB "%.0" "list" COMPU_TAB_REF CFVI_flash_wr_force_COMPU_VTAB_REF /end COMPU_METHOD
/begin COMPU_VTAB CFVI_flash_wr_force_COMPU_VTAB_REF "Verbal Table" TAB_VERB 2 0 "Idle" 1 "Write Flash" DEFAULT_VALUE "UNKNOWN" /end COMPU_VTAB
/begin MEASUREMENT CFV_param_differ "CFV cal parameter status{CFV_param_differ&0xff=0:Params Match}{CFV_param_differ&0xff=1:Params Do Not Match}" UBYTE CFV_param_differ_COMPU_VTAB 0 0 0 255 ECU_ADDRESS 0x0100B320 BIT_MASK 0xff /end MEASUREMENT
/begin COMPU_METHOD CFV_param_differ_COMPU_VTAB "Verbal Table" TAB_VERB "%.0" "list" COMPU_TAB_REF CFV_param_differ_COMPU_VTAB_REF /end COMPU_METHOD
/begin COMPU_VTAB CFV_param_differ_COMPU_VTAB_REF "Verbal Table" TAB_VERB 2 0 "Params Match" 1 "Params Do Not Match" DEFAULT_VALUE "UNKNOWN" /end COMPU_VTAB
/begin MEASUREMENT CFV_param_upload "CFV cal upload from CFV{CFV_param_upload&0xff=0:Idle}{CFV_param_upload&0xff=1:Upload Params from CFV}" UBYTE CFV_param_upload_COMPU_VTAB 0 0 0 255 ECU_ADDRESS 0x0100B328 BIT_MASK 0xff /end MEASUREMENT
/begin COMPU_METHOD CFV_param_upload_COMPU_VTAB "Verbal Table" TAB_VERB "%.0" "list" COMPU_TAB_REF CFV_param_upload_COMPU_VTAB_REF /end COMPU_METHOD
/begin COMPU_VTAB CFV_param_upload_COMPU_VTAB_REF "Verbal Table" TAB_VERB 2 0 "Idle" 1 "Upload Params from CFV" DEFAULT_VALUE "UNKNOWN" /end COMPU_VTAB
/begin MEASUREMENT CFV_intF_bits "CFV fault bits" ULONG Compu_CFV_intF_bits 0 0 0 4294967295 ECU_ADDRESS 0x0100B330 /end MEASUREMENT
/begin COMPU_METHOD Compu_CFV_intF_bits " " RAT_FUNC "%.0" "bits" COEFFS 0 1 0 0 0 1 /end COMPU_METHOD
/begin MEASUREMENT CFV_cal_state "CFV_cal_state" UBYTE Compu_CFV_cal_state 0 0 0 255 ECU_ADDRESS 0x0100B338 /end MEASUREMENT
/begin COMPU_METHOD Compu_CFV_cal_state " " RAT_FUNC "%.0" "state" COEFFS 0 1 0 0 0 1 /end COMPU_METHOD
/begin CHARACTERISTIC CFV_mdot_FS "CFV full-scale mdot fuel" VALUE 0x00146726 /* @ECU_Address@CFV_mdot_FS@0x0100B350@ */ ECIPP_ALIGNMENT_UWORD 128 Compu_CFV_mdot_FS 0 127.998046875 /end CHARACTERISTIC
/begin COMPU_METHOD Compu_CFV_mdot_FS " " RAT_FUNC "%.2" "g/sec" COEFFS 0 512 0 0 0 1 /end COMPU_METHOD
/begin CHARACTERISTIC CFV_dis_restrict "CFV effective discharge restriction" VALUE 0x00146724 /* @ECU_Address@CFV_dis_restrict@0x0100B358@ */ ECIPP_ALIGNMENT_UWORD 4096 Compu_CFV_dis_restrict 0 4095.9375 /end CHARACTERISTIC
/begin COMPU_METHOD Compu_CFV_dis_restrict " " RAT_FUNC "%.1" "mm^2" COEFFS 0 16 0 0 0 1 /end COMPU_METHOD
/begin CHARACTERISTIC CFV_Pdis_margin_kPa "CFV discharge pressure pulsation margin" VALUE 0x00146702 /* @ECU_Address@CFV_Pdis_margin_kPa@0x0100B360@ */ ECIPP_ALIGNMENT_UWORD 297 Compu_CFV_Pdis_margin_kPa 0 297.0332915625 /end CHARACTERISTIC
/begin COMPU_METHOD Compu_CFV_Pdis_margin_kPa " " RAT_FUNC "%.2" "psid" COEFFS 0 220.631834415808 0 0 0 1 /end COMPU_METHOD
/begin CHARACTERISTIC CFV_Pin_def_psig "CFV estimated inlet pressure" VALUE 0x00146704 /* @ECU_Address@CFV_Pin_def_psig@0x0100B368@ */ ECIPP_ALIGNMENT_UWORD 256 Compu_CFV_Pin_def_psig 0 255.99609375 /end CHARACTERISTIC
/begin COMPU_METHOD Compu_CFV_Pin_def_psig " " RAT_FUNC "%.2" "psig" COEFFS 0 256 0 0 0 1 /end COMPU_METHOD
/begin MEASUREMENT CFV_P_man_DC "CFV manual pressure actuator duty-cycle" SWORD Compu_CFV_P_man_DC 0 0 -100 99.9969482421875 ECU_ADDRESS 0x0100B3D8 /end MEASUREMENT
/begin COMPU_METHOD Compu_CFV_P_man_DC " " RAT_FUNC "%.1" "%" COEFFS 0 327.68 0 0 0 1 /end COMPU_METHOD
/begin MEASUREMENT CFV_x_man_DC "CFV manual valve actuator duty-cycle" SWORD Compu_CFV_x_man_DC 0 0 -100 99.9969482421875 ECU_ADDRESS 0x0100B3E0 /end MEASUREMENT
/begin COMPU_METHOD Compu_CFV_x_man_DC " " RAT_FUNC "%.1" "%" COEFFS 0 327.68 0 0 0 1 /end COMPU_METHOD
/begin MEASUREMENT CFV_param_NA_cnt "CFV parameter not-available counter" UWORD Compu_CFV_param_NA_cnt 0 0 0 65535 ECU_ADDRESS 0x0100B4B8 /end MEASUREMENT
/begin COMPU_METHOD Compu_CFV_param_NA_cnt " " RAT_FUNC "%.0" "count" COEFFS 0 1 0 0 0 1 /end COMPU_METHOD
/begin CHARACTERISTIC CFV_RLV_ena "CFV RLV mode{CFV_RLV_ena&0xff=0:Disabled}{CFV_RLV_ena&0xff=1:Interstage pressure test}{CFV_RLV_ena&0xff=2:Fuel run-out test}" VALUE 0x00147cf2 /* @ECU_Address@CFV_RLV_ena@0x0100CAE0@ */ ECIPP_ALIGNMENT_UBYTE 255 CFV_RLV_ena_COMPU_VTAB 0 255 BIT_MASK 0xff /end CHARACTERISTIC
/begin COMPU_METHOD CFV_RLV_ena_COMPU_VTAB "Verbal Table" TAB_VERB "%.0" "list" COMPU_TAB_REF CFV_RLV_ena_COMPU_VTAB_REF /end COMPU_METHOD
/begin COMPU_VTAB CFV_RLV_ena_COMPU_VTAB_REF "Verbal Table" TAB_VERB 3 0 "Disabled" 1 "Interstage pressure test" 2 "Fuel run-out test" DEFAULT_VALUE "UNKNOWN" /end COMPU_VTAB
/begin CHARACTERISTIC CFV_RLV_lockoff "CFV RLV lockoff select{CFV_RLV_lockoff&0xff=0:Primary}{CFV_RLV_lockoff&0xff=1:Secondary}" VALUE 0x00147cf3 /* @ECU_Address@CFV_RLV_lockoff@0x0100CAE8@ */ ECIPP_ALIGNMENT_UBYTE 255 CFV_RLV_lockoff_COMPU_VTAB 0 255 BIT_MASK 0xff /end CHARACTERISTIC
/begin COMPU_METHOD CFV_RLV_lockoff_COMPU_VTAB "Verbal Table" TAB_VERB "%.0" "list" COMPU_TAB_REF CFV_RLV_lockoff_COMPU_VTAB_REF /end COMPU_METHOD
/begin COMPU_VTAB CFV_RLV_lockoff_COMPU_VTAB_REF "Verbal Table" TAB_VERB 2 0 "Primary" 1 "Secondary" DEFAULT_VALUE "UNKNOWN" /end COMPU_VTAB
/begin MEASUREMENT CFV_RLV_HM_last_test "CFV RLV last test hour meter" ULONG Compu_CFV_RLV_HM_last_test 0 0 0 1193046.47083333 ECU_ADDRESS 0x0100CB08 /end MEASUREMENT
/begin COMPU_METHOD Compu_CFV_RLV_HM_last_test " " RAT_FUNC "%.3" "hours" COEFFS 0 3600 0 0 0 1 /end COMPU_METHOD
/begin MEASUREMENT CFV_RLV_HM_next_test "CFV RLV next test hour meter" ULONG Compu_CFV_RLV_HM_next_test 0 0 0 1193046.47083333 ECU_ADDRESS 0x0100CB10 /end MEASUREMENT
/begin COMPU_METHOD Compu_CFV_RLV_HM_next_test " " RAT_FUNC "%.3" "hours" COEFFS 0 3600 0 0 0 1 /end COMPU_METHOD
/begin CHARACTERISTIC CFV_RLV_tmin_ena "CFV RLV min test time mode{CFV_RLV_tmin_ena&0xff=0:Disabled}{CFV_RLV_tmin_ena&0xff=1:Enabled}" VALUE 0x00147cf4 /* @ECU_Address@CFV_RLV_tmin_ena@0x0100CB18@ */ ECIPP_ALIGNMENT_UBYTE 255 CFV_RLV_tmin_ena_COMPU_VTAB 0 255 BIT_MASK 0xff /end CHARACTERISTIC
/begin COMPU_METHOD CFV_RLV_tmin_ena_COMPU_VTAB "Verbal Table" TAB_VERB "%.0" "list" COMPU_TAB_REF CFV_RLV_tmin_ena_COMPU_VTAB_REF /end COMPU_METHOD
/begin COMPU_VTAB CFV_RLV_tmin_ena_COMPU_VTAB_REF "Verbal Table" TAB_VERB 2 0 "Disabled" 1 "Enabled" DEFAULT_VALUE "UNKNOWN" /end COMPU_VTAB
/begin CHARACTERISTIC CFV_RLV_test_tmin "CFV RLV min test time" VALUE 0x00146720 /* @ECU_Address@CFV_RLV_test_tmin@0x0100CB20@ */ ECIPP_ALIGNMENT_UWORD 65535 Compu_CFV_RLV_test_tmin 0 65535 /end CHARACTERISTIC
/begin COMPU_METHOD Compu_CFV_RLV_test_tmin " " RAT_FUNC "%.0" "ms" COEFFS 0 1 0 0 0 1 /end COMPU_METHOD
/begin CHARACTERISTIC CFV_RLV_testPeriod "CFV RLV test period" VALUE 0x001440a4 /* @ECU_Address@CFV_RLV_testPeriod@0x0100CB28@ */ ECIPP_ALIGNMENT_ULONG 1193046 Compu_CFV_RLV_testPeriod 0 1193046.47083333 /end CHARACTERISTIC
/begin COMPU_METHOD Compu_CFV_RLV_testPeriod " " RAT_FUNC "%.3" "hours" COEFFS 0 3600 0 0 0 1 /end COMPU_METHOD
/begin CHARACTERISTIC CFV_RLV_sstate_time "CFV RLV steady state time" VALUE 0x0014671e /* @ECU_Address@CFV_RLV_sstate_time@0x0100CB30@ */ ECIPP_ALIGNMENT_UWORD 66 Compu_CFV_RLV_sstate_time 0 65.535 /end CHARACTERISTIC
/begin COMPU_METHOD Compu_CFV_RLV_sstate_time " " RAT_FUNC "%.1" "sec" COEFFS 0 1000 0 0 0 1 /end COMPU_METHOD
/begin CHARACTERISTIC CFV_RLV_charge_hold "CFV RLV charge hold time" VALUE 0x00146712 /* @ECU_Address@CFV_RLV_charge_hold@0x0100CB38@ */ ECIPP_ALIGNMENT_UWORD 65535 Compu_CFV_RLV_charge_hold 0 65535 /end CHARACTERISTIC
/begin COMPU_METHOD Compu_CFV_RLV_charge_hold " " RAT_FUNC "%.0" "ms" COEFFS 0 1 0 0 0 1 /end COMPU_METHOD
/begin CHARACTERISTIC CFV_RLV_test_tout "CFV RLV test time out" VALUE 0x00146722 /* @ECU_Address@CFV_RLV_test_tout@0x0100CB40@ */ ECIPP_ALIGNMENT_UWORD 66 Compu_CFV_RLV_test_tout 0 65.535 /end CHARACTERISTIC
/begin COMPU_METHOD Compu_CFV_RLV_test_tout " " RAT_FUNC "%.1" "sec" COEFFS 0 1000 0 0 0 1 /end COMPU_METHOD
/begin CHARACTERISTIC CFV_RLV_P_charge "CFV RLV charge pressure" VALUE 0x0014425c /* @ECU_Address@CFV_RLV_P_charge@0x0100CB48@ */ ECIPP_ALIGNMENT_SWORD 149 Compu_CFV_RLV_P_charge -148.518912 148.5143795625 /end CHARACTERISTIC
/begin COMPU_METHOD Compu_CFV_RLV_P_charge " " RAT_FUNC "%.2" "psia" COEFFS 0 220.631834415808 0 0 0 1 /end COMPU_METHOD
/begin CHARACTERISTIC CFV_RLV_P_test_min "CFV RLV min test pressure" VALUE 0x00144262 /* @ECU_Address@CFV_RLV_P_test_min@0x0100CB50@ */ ECIPP_ALIGNMENT_SWORD 149 Compu_CFV_RLV_P_test_min -148.518912 148.5143795625 /end CHARACTERISTIC
/begin COMPU_METHOD Compu_CFV_RLV_P_test_min " " RAT_FUNC "%.2" "psia" COEFFS 0 220.631834415808 0 0 0 1 /end COMPU_METHOD
/begin CHARACTERISTIC CFV_RLV_P_trigger "CFV RLV trigger pressure" VALUE 0x00144264 /* @ECU_Address@CFV_RLV_P_trigger@0x0100CB58@ */ ECIPP_ALIGNMENT_SWORD 149 Compu_CFV_RLV_P_trigger -148.518912 148.5143795625 /end CHARACTERISTIC
/begin COMPU_METHOD Compu_CFV_RLV_P_trigger " " RAT_FUNC "%.2" "psia" COEFFS 0 220.631834415808 0 0 0 1 /end COMPU_METHOD
/begin CHARACTERISTIC CFV_RLV_FPPslew "CFV RLV FPP slew" VALUE 0x0014670a /* @ECU_Address@CFV_RLV_FPPslew@0x0100CB60@ */ ECIPP_ALIGNMENT_UWORD 99998 Compu_CFV_RLV_FPPslew 0 99998.4741210938 /end CHARACTERISTIC
/begin COMPU_METHOD Compu_CFV_RLV_FPPslew " " RAT_FUNC "%.1" "%/sec" COEFFS 0 0.65536 0 0 0 1 /end COMPU_METHOD
/begin CHARACTERISTIC CFV_RLV_mdot_pct_min "CFV RLV fuel flow min" VALUE 0x00146716 /* @ECU_Address@CFV_RLV_mdot_pct_min@0x0100CB68@ */ ECIPP_ALIGNMENT_UWORD 100 Compu_CFV_RLV_mdot_pct_min 0 99.9984741210938 /end CHARACTERISTIC
/begin COMPU_METHOD Compu_CFV_RLV_mdot_pct_min " " RAT_FUNC "%.1" "% FS" COEFFS 0 655.36 0 0 0 1 /end COMPU_METHOD
/begin CHARACTERISTIC CFV_RLV_mdot_pct_max "CFV RLV fuel flow max" VALUE 0x00146714 /* @ECU_Address@CFV_RLV_mdot_pct_max@0x0100CB70@ */ ECIPP_ALIGNMENT_UWORD 100 Compu_CFV_RLV_mdot_pct_max 0 99.9984741210938 /end CHARACTERISTIC
/begin COMPU_METHOD Compu_CFV_RLV_mdot_pct_max " " RAT_FUNC "%.1" "% FS" COEFFS 0 655.36 0 0 0 1 /end COMPU_METHOD
/begin CHARACTERISTIC CFV_RLV_LoadLim_min "CFV RLV load limit min" VALUE 0x0014670e /* @ECU_Address@CFV_RLV_LoadLim_min@0x0100CB78@ */ ECIPP_ALIGNMENT_UWORD 100 Compu_CFV_RLV_LoadLim_min 0 99.9984741210938 /end CHARACTERISTIC
/begin COMPU_METHOD Compu_CFV_RLV_LoadLim_min " " RAT_FUNC "%.1" "%" COEFFS 0 655.36 0 0 0 1 /end COMPU_METHOD
/begin CHARACTERISTIC CFV_RLV_LoadLim_max "CFV RLV load limit max" VALUE 0x0014670c /* @ECU_Address@CFV_RLV_LoadLim_max@0x0100CB80@ */ ECIPP_ALIGNMENT_UWORD 100 Compu_CFV_RLV_LoadLim_max 0 99.9984741210938 /end CHARACTERISTIC
/begin COMPU_METHOD Compu_CFV_RLV_LoadLim_max " " RAT_FUNC "%.1" "%" COEFFS 0 655.36 0 0 0 1 /end COMPU_METHOD
/begin CHARACTERISTIC CFV_RLV_Vbat_min "CFV RLV Vbat min" VALUE 0x00146710 /* @ECU_Address@CFV_RLV_Vbat_min@0x0100CB88@ */ ECIPP_ALIGNMENT_UWORD 256 Compu_CFV_RLV_Vbat_min 0 255.99609375 /end CHARACTERISTIC
/begin COMPU_METHOD Compu_CFV_RLV_Vbat_min " " RAT_FUNC "%.1" "V" COEFFS 0 256 0 0 0 1 /end COMPU_METHOD
/begin CHARACTERISTIC CFV_RLV_ECT_min "CFV RLV ECT min" VALUE 0x00146706 /* @ECU_Address@CFV_RLV_ECT_min@0x0100CB90@ */ ECIPP_ALIGNMENT_UWORD 564 Compu_CFV_RLV_ECT_min -460 563.984375 /end CHARACTERISTIC
/begin COMPU_METHOD Compu_CFV_RLV_ECT_min " " RAT_FUNC "%.1" "deg F" COEFFS 0 64 29440 0 0 1 /end COMPU_METHOD
/begin CHARACTERISTIC CFV_RLV_rpm_min "CFV RLV rpm min" VALUE 0x0014671c /* @ECU_Address@CFV_RLV_rpm_min@0x0100CB98@ */ ECIPP_ALIGNMENT_UWORD 65535 Compu_CFV_RLV_rpm_min 0 65535 /end CHARACTERISTIC
/begin COMPU_METHOD Compu_CFV_RLV_rpm_min " " RAT_FUNC "%.0" "rpm" COEFFS 0 1 0 0 0 1 /end COMPU_METHOD
/begin CHARACTERISTIC CFV_RLV_rpm_max "CFV RLV rpm max" VALUE 0x0014671a /* @ECU_Address@CFV_RLV_rpm_max@0x0100CBA0@ */ ECIPP_ALIGNMENT_UWORD 65535 Compu_CFV_RLV_rpm_max 0 65535 /end CHARACTERISTIC
/begin COMPU_METHOD Compu_CFV_RLV_rpm_max " " RAT_FUNC "%.0" "rpm" COEFFS 0 1 0 0 0 1 /end COMPU_METHOD
/begin CHARACTERISTIC CFV_RLV_P_kPa_min "CFV RLV interstage press min" VALUE 0x00144260 /* @ECU_Address@CFV_RLV_P_kPa_min@0x0100CBA8@ */ ECIPP_ALIGNMENT_SWORD 149 Compu_CFV_RLV_P_kPa_min -148.518912 148.5143795625 /end CHARACTERISTIC
/begin COMPU_METHOD Compu_CFV_RLV_P_kPa_min " " RAT_FUNC "%.2" "psia" COEFFS 0 220.631834415808 0 0 0 1 /end COMPU_METHOD
/begin CHARACTERISTIC CFV_RLV_P_kPa_max "CFV RLV interstage press max" VALUE 0x0014425e /* @ECU_Address@CFV_RLV_P_kPa_max@0x0100CBB0@ */ ECIPP_ALIGNMENT_SWORD 149 Compu_CFV_RLV_P_kPa_max -148.518912 148.5143795625 /end CHARACTERISTIC
/begin COMPU_METHOD Compu_CFV_RLV_P_kPa_max " " RAT_FUNC "%.2" "psia" COEFFS 0 220.631834415808 0 0 0 1 /end COMPU_METHOD
/begin CHARACTERISTIC CFV_RLV_FPP_pct_max "CFV RLV FPP max" VALUE 0x00146708 /* @ECU_Address@CFV_RLV_FPP_pct_max@0x0100CBB8@ */ ECIPP_ALIGNMENT_UWORD 100 Compu_CFV_RLV_FPP_pct_max 0 99.9984741210938 /end CHARACTERISTIC
/begin COMPU_METHOD Compu_CFV_RLV_FPP_pct_max " " RAT_FUNC "%.1" "%" COEFFS 0 655.36 0 0 0 1 /end COMPU_METHOD
/begin CHARACTERISTIC CFV_RLV_recover_time "CFV RLV recovery time" VALUE 0x00146718 /* @ECU_Address@CFV_RLV_recover_time@0x0100CD18@ */ ECIPP_ALIGNMENT_UWORD 65535 Compu_CFV_RLV_recover_time 0 65535 /end CHARACTERISTIC
/begin COMPU_METHOD Compu_CFV_RLV_recover_time " " RAT_FUNC "%.0" "ms" COEFFS 0 1 0 0 0 1 /end COMPU_METHOD
/begin MEASUREMENT MJ2_P_act "Secondary EPR feedback press" SWORD Compu_MJ2_P_act 0 0 -222 221.993225097656 ECU_ADDRESS 0x010103C0 /end MEASUREMENT
/begin COMPU_METHOD Compu_MJ2_P_act " " RAT_FUNC "%.2" "-" COEFFS 0 147.603603603604 0 0 0 1 /end COMPU_METHOD
/begin MEASUREMENT MJ2_A_act "Legacy Secondary EPR duty-cycle feedback" SWORD Compu_MJ2_A_act 0 0 -100 99.9969482421875 ECU_ADDRESS 0x010103C8 /end MEASUREMENT
/begin COMPU_METHOD Compu_MJ2_A_act " " RAT_FUNC "%.1" "-" COEFFS 0 327.68 0 0 0 1 /end COMPU_METHOD
/begin MEASUREMENT MJ2_ctltype_act "Secondary EPR control type feedback{MJ2_ctltype_act&0xff=0:Pressure Cmd}{MJ2_ctltype_act&0xff=1:Area Cmd}{MJ2_ctltype_act&0xff=2:PA+FF or Pulsed}{MJ2_ctltype_act&0xff=3:Offline}" UBYTE MJ2_ctltype_act_COMPU_VTAB 0 0 0 255 ECU_ADDRESS 0x010103D0 BIT_MASK 0xff /end MEASUREMENT
/begin COMPU_METHOD MJ2_ctltype_act_COMPU_VTAB "Verbal Table" TAB_VERB "%.0" "list" COMPU_TAB_REF MJ2_ctltype_act_COMPU_VTAB_REF /end COMPU_METHOD
/begin COMPU_VTAB MJ2_ctltype_act_COMPU_VTAB_REF "Verbal Table" TAB_VERB 4 0 "Pressure Cmd" 1 "Area Cmd" 2 "PA+FF or Pulsed" 3 "Offline" DEFAULT_VALUE "UNKNOWN" /end COMPU_VTAB
/begin MEASUREMENT MJ2_status "Secondary EPR status{MJ2_status&0xff=0:Comm Lost}{MJ2_status&0xff=1:OK}{MJ2_status&0xff=2:Fault}" UBYTE MJ2_status_COMPU_VTAB 0 0 0 255 ECU_ADDRESS 0x010103D8 BIT_MASK 0xff /end MEASUREMENT
/begin COMPU_METHOD MJ2_status_COMPU_VTAB "Verbal Table" TAB_VERB "%.0" "list" COMPU_TAB_REF MJ2_status_COMPU_VTAB_REF /end COMPU_METHOD
/begin COMPU_VTAB MJ2_status_COMPU_VTAB_REF "Verbal Table" TAB_VERB 3 0 "Comm Lost" 1 "OK" 2 "Fault" DEFAULT_VALUE "UNKNOWN" /end COMPU_VTAB
/begin MEASUREMENT MJ2_intF_bits "Secondary EPR fault bits" ULONG Compu_MJ2_intF_bits 0 0 0 4294967295 ECU_ADDRESS 0x010103E0 /end MEASUREMENT
/begin COMPU_METHOD Compu_MJ2_intF_bits " " RAT_FUNC "%.0" "-" COEFFS 0 1 0 0 0 1 /end COMPU_METHOD
/begin MEASUREMENT MJ2I_flash_wr_left "Secondary internal flash writes remaining" SBYTE Compu_MJ2I_flash_wr_left 0 0 -128 127 ECU_ADDRESS 0x010103E8 /end MEASUREMENT
/begin COMPU_METHOD Compu_MJ2I_flash_wr_left " " RAT_FUNC "%.0" "-" COEFFS 0 1 0 0 0 1 /end COMPU_METHOD
/begin MEASUREMENT MJ2I_cur_cal_mod "Internal current child EPR cal model" ULONG Compu_MJ2I_cur_cal_mod 0 0 0 4294967295 ECU_ADDRESS 0x010103F0 /end MEASUREMENT
/begin COMPU_METHOD Compu_MJ2I_cur_cal_mod " " RAT_FUNC "%.0" "-" COEFFS 0 1 0 0 0 1 /end COMPU_METHOD
/begin MEASUREMENT MJ2I_cur_SW_mod "Internal current child EPR SW model" ULONG Compu_MJ2I_cur_SW_mod 0 0 0 4294967295 ECU_ADDRESS 0x010103F8 /end MEASUREMENT
/begin COMPU_METHOD Compu_MJ2I_cur_SW_mod " " RAT_FUNC "%.0" "-" COEFFS 0 1 0 0 0 1 /end COMPU_METHOD
/begin MEASUREMENT MJ2I_cur_HW_mod "Internal current child EPR HW model" ULONG Compu_MJ2I_cur_HW_mod 0 0 0 4294967295 ECU_ADDRESS 0x01010400 /end MEASUREMENT
/begin COMPU_METHOD Compu_MJ2I_cur_HW_mod " " RAT_FUNC "%.0" "-" COEFFS 0 1 0 0 0 1 /end COMPU_METHOD
/begin MEASUREMENT MJ2_param_differ "Secondary EPR cal parameter status{MJ2_param_differ&0xff=0:Params Match}{MJ2_param_differ&0xff=1:Params Do Not Match}" UBYTE MJ2_param_differ_COMPU_VTAB 0 0 0 255 ECU_ADDRESS 0x01010408 BIT_MASK 0xff /end MEASUREMENT
/begin COMPU_METHOD MJ2_param_differ_COMPU_VTAB "Verbal Table" TAB_VERB "%.0" "list" COMPU_TAB_REF MJ2_param_differ_COMPU_VTAB_REF /end COMPU_METHOD
/begin COMPU_VTAB MJ2_param_differ_COMPU_VTAB_REF "Verbal Table" TAB_VERB 2 0 "Params Match" 1 "Params Do Not Match" DEFAULT_VALUE "UNKNOWN" /end COMPU_VTAB
/begin MEASUREMENT MJ2_param_upload "Secondary EPR cal upload from MJ{MJ2_param_upload&0xff=0:Idle}{MJ2_param_upload&0xff=1:Upload Params From MJ}" UBYTE MJ2_param_upload_COMPU_VTAB 0 0 0 255 ECU_ADDRESS 0x01010410 BIT_MASK 0xff /end MEASUREMENT
/begin COMPU_METHOD MJ2_param_upload_COMPU_VTAB "Verbal Table" TAB_VERB "%.0" "list" COMPU_TAB_REF MJ2_param_upload_COMPU_VTAB_REF /end COMPU_METHOD
/begin COMPU_VTAB MJ2_param_upload_COMPU_VTAB_REF "Verbal Table" TAB_VERB 2 0 "Idle" 1 "Upload Params From MJ" DEFAULT_VALUE "UNKNOWN" /end COMPU_VTAB
/begin MEASUREMENT MJ2I_flash_wr_force "Secondary Internal flash write request{MJ2I_flash_wr_force&0xff=0:Idle}{MJ2I_flash_wr_force&0xff=1:Write Flash}" UBYTE MJ2I_flash_wr_force_COMPU_VTAB 0 0 0 255 ECU_ADDRESS 0x01010418 BIT_MASK 0xff /end MEASUREMENT
/begin COMPU_METHOD MJ2I_flash_wr_force_COMPU_VTAB "Verbal Table" TAB_VERB "%.0" "list" COMPU_TAB_REF MJ2I_flash_wr_force_COMPU_VTAB_REF /end COMPU_METHOD
/begin COMPU_VTAB MJ2I_flash_wr_force_COMPU_VTAB_REF "Verbal Table" TAB_VERB 2 0 "Idle" 1 "Write Flash" DEFAULT_VALUE "UNKNOWN" /end COMPU_VTAB
/begin MEASUREMENT LOD_slk_state "Lockoff slow leak test status{LOD_slk_state&0xff=0:Not Started}{LOD_slk_state&0xff=1:FRO Wait}{LOD_slk_state&0xff=2:Sampling}{LOD_slk_state&0xff=3:Complete}{LOD_slk_state&0xff=4:Aborted}" UBYTE LOD_slk_state_COMPU_VTAB 0 0 0 255 ECU_ADDRESS 0x01010548 BIT_MASK 0xff /end MEASUREMENT
/begin COMPU_METHOD LOD_slk_state_COMPU_VTAB "Verbal Table" TAB_VERB "%.0" "list" COMPU_TAB_REF LOD_slk_state_COMPU_VTAB_REF /end COMPU_METHOD
/begin COMPU_VTAB LOD_slk_state_COMPU_VTAB_REF "Verbal Table" TAB_VERB 5 0 "Not Started" 1 "FRO Wait" 2 "Sampling" 3 "Complete" 4 "Aborted" DEFAULT_VALUE "UNKNOWN" /end COMPU_VTAB
/begin MEASUREMENT LOD_slk_test_tmr "Lockoff slow leak test timer" UWORD Compu_LOD_slk_test_tmr 0 0 0 65.535 ECU_ADDRESS 0x01010550 /end MEASUREMENT
/begin COMPU_METHOD Compu_LOD_slk_test_tmr " " RAT_FUNC "%.0" "sec" COEFFS 0 1000 0 0 0 1 /end COMPU_METHOD
/begin MEASUREMENT LOD_flk_state "Fuel leak test status{LOD_flk_state&0xff=0:Not Started}{LOD_flk_state&0xff=1:Shutdown}{LOD_flk_state&0xff=2:Sampling}{LOD_flk_state&0xff=3:Complete}{LOD_flk_state&0xff=4:Aborted}" UBYTE LOD_flk_state_COMPU_VTAB 0 0 0 255 ECU_ADDRESS 0x01010560 BIT_MASK 0xff /end MEASUREMENT
/begin COMPU_METHOD LOD_flk_state_COMPU_VTAB "Verbal Table" TAB_VERB "%.0" "list" COMPU_TAB_REF LOD_flk_state_COMPU_VTAB_REF /end COMPU_METHOD
/begin COMPU_VTAB LOD_flk_state_COMPU_VTAB_REF "Verbal Table" TAB_VERB 5 0 "Not Started" 1 "Shutdown" 2 "Sampling" 3 "Complete" 4 "Aborted" DEFAULT_VALUE "UNKNOWN" /end COMPU_VTAB
/begin MEASUREMENT LOD_flk_test_tmr "Fuel leak test timer" UWORD Compu_LOD_flk_test_tmr 0 0 0 65.535 ECU_ADDRESS 0x01010568 /end MEASUREMENT
/begin COMPU_METHOD Compu_LOD_flk_test_tmr " " RAT_FUNC "%.0" "sec" COEFFS 0 1000 0 0 0 1 /end COMPU_METHOD
/begin MEASUREMENT LOD_slk_warm_cycles "Lockoff slow leak test warm engine cycles" UBYTE Compu_LOD_slk_warm_cycles 0 0 0 255 ECU_ADDRESS 0x01010580 /end MEASUREMENT
/begin COMPU_METHOD Compu_LOD_slk_warm_cycles " " RAT_FUNC "%.0" "cycles" COEFFS 0 1 0 0 0 1 /end COMPU_METHOD
/begin MEASUREMENT LOD_flk_warm_cycles "Fuel leak test warm engine cycles" UBYTE Compu_LOD_flk_warm_cycles 0 0 0 255 ECU_ADDRESS 0x01010588 /end MEASUREMENT
/begin COMPU_METHOD Compu_LOD_flk_warm_cycles " " RAT_FUNC "%.0" "cycles" COEFFS 0 1 0 0 0 1 /end COMPU_METHOD
/begin MEASUREMENT LOD_slk_eng_cycles "Lockoff slow leak test total engine cycles" UBYTE Compu_LOD_slk_eng_cycles 0 0 0 255 ECU_ADDRESS 0x01010590 /end MEASUREMENT
/begin COMPU_METHOD Compu_LOD_slk_eng_cycles " " RAT_FUNC "%.0" "cycles" COEFFS 0 1 0 0 0 1 /end COMPU_METHOD
/begin MEASUREMENT LOD_flk_eng_cycles "Fuel leak test total engine cycles" UBYTE Compu_LOD_flk_eng_cycles 0 0 0 255 ECU_ADDRESS 0x01010598 /end MEASUREMENT
/begin COMPU_METHOD Compu_LOD_flk_eng_cycles " " RAT_FUNC "%.0" "cycles" COEFFS 0 1 0 0 0 1 /end COMPU_METHOD
/begin MEASUREMENT LOD_flk_test_run "Fuel leak test run on last shutdown{LOD_flk_test_run&0xff=0:No}{LOD_flk_test_run&0xff=1:Yes}" UBYTE LOD_flk_test_run_COMPU_VTAB 0 0 0 255 ECU_ADDRESS 0x010105A0 BIT_MASK 0xff /end MEASUREMENT
/begin COMPU_METHOD LOD_flk_test_run_COMPU_VTAB "Verbal Table" TAB_VERB "%.0" "list" COMPU_TAB_REF LOD_flk_test_run_COMPU_VTAB_REF /end COMPU_METHOD
/begin COMPU_VTAB LOD_flk_test_run_COMPU_VTAB_REF "Verbal Table" TAB_VERB 2 0 "No" 1 "Yes" DEFAULT_VALUE "UNKNOWN" /end COMPU_VTAB
/begin CHARACTERISTIC CFV_strtf_mult "CFV starting fuel multiplier" VALUE 0x00143970 /* @ECU_Address@CFV_strtf_mult@0x010105A8@ */ ECIPP_ALIGNMENT_FLOAT32_IEEE 10000000000 Compu_CFV_strtf_mult -10000000000 10000000000 /end CHARACTERISTIC
/begin COMPU_METHOD Compu_CFV_strtf_mult " " RAT_FUNC "%.2" "-" COEFFS 0 1 0 0 0 1 /end COMPU_METHOD
/begin CHARACTERISTIC CFV_strtf_hold_cyc "CFV starting fuel crank cycles" VALUE 0x0014672a /* @ECU_Address@CFV_strtf_hold_cyc@0x010105B0@ */ ECIPP_ALIGNMENT_UWORD 256 Compu_CFV_strtf_hold_cyc 0 255.99609375 /end CHARACTERISTIC
/begin COMPU_METHOD Compu_CFV_strtf_hold_cyc " " RAT_FUNC "%.2" "cycles" COEFFS 0 256 0 0 0 1 /end COMPU_METHOD
/begin CHARACTERISTIC CFV_strtf_slew "CFV starting fuel slew out rate" VALUE 0x00143c7c /* @ECU_Address@CFV_strtf_slew@0x010105B8@ */ ECIPP_ALIGNMENT_FLOAT32_IEEE 10000000000 Compu_CFV_strtf_slew -10000000000 10000000000 /end CHARACTERISTIC
/begin COMPU_METHOD Compu_CFV_strtf_slew " " RAT_FUNC "%.1" "% / cycle" COEFFS 0 0 1 0 0.01 0 /end COMPU_METHOD
/begin CHARACTERISTIC CFV_strtf_reset_tm "CFV starting fuel reset time" VALUE 0x0014672c /* @ECU_Address@CFV_strtf_reset_tm@0x010105C0@ */ ECIPP_ALIGNMENT_UWORD 66 Compu_CFV_strtf_reset_tm 0 65.535 /end CHARACTERISTIC
/begin COMPU_METHOD Compu_CFV_strtf_reset_tm " " RAT_FUNC "%.0" "sec" COEFFS 0 1000 0 0 0 1 /end COMPU_METHOD
/begin CHARACTERISTIC LOD_flk_sd_tout "Fuel leak test shutdown timeout (Fault Condition:Timeout for engine shutdown)" VALUE 0x0014756c /* @ECU_Address@LOD_flk_sd_tout@0x010106F8@ */ ECIPP_ALIGNMENT_UWORD 66 Compu_LOD_flk_sd_tout 0 65.535 /end CHARACTERISTIC
/begin COMPU_METHOD Compu_LOD_flk_sd_tout " " RAT_FUNC "%.0" "sec" COEFFS 0 1000 0 0 0 1 /end COMPU_METHOD
/begin CHARACTERISTIC LOD_throt_lim "Fuel leak test throttle limit (Fault Condition:Throttle position limit during test)" VALUE 0x0014756e /* @ECU_Address@LOD_throt_lim@0x01010700@ */ ECIPP_ALIGNMENT_UWORD 100 Compu_LOD_throt_lim 0 99.9984741210938 /end CHARACTERISTIC
/begin COMPU_METHOD Compu_LOD_throt_lim " " RAT_FUNC "%.0" "%" COEFFS 0 655.36 0 0 0 1 /end COMPU_METHOD
/begin CHARACTERISTIC LOD_flk_retry_lim "Fuel leak test retry limit (Fault Condition:Maximum number of retries)" VALUE 0x00147e18 /* @ECU_Address@LOD_flk_retry_lim@0x01010AA8@ */ ECIPP_ALIGNMENT_UBYTE 255 Compu_LOD_flk_retry_lim 0 255 /end CHARACTERISTIC
/begin COMPU_METHOD Compu_LOD_flk_retry_lim " " RAT_FUNC "%.0" "-" COEFFS 0 1 0 0 0 1 /end COMPU_METHOD
/begin CHARACTERISTIC ICAV_cat_prot "Misfire cat prot - single cyl{ICAV_cat_prot&0xff=0:Disabled}{ICAV_cat_prot&0xff=1:Table 1 / Gasoline Load-Limit}{ICAV_cat_prot&0xff=2:Table 2 / LPG Load-Limit}{ICAV_cat_prot&0xff=3:Table 3 / NG Load-Limit}{ICAV_cat_prot&0xff=4:Table 4 / Power Load-Limit}{" VALUE 0x00147dbb /* @ECU_Address@ICAV_cat_prot@0x01010B10@ */ ECIPP_ALIGNMENT_UBYTE 255 ICAV_cat_prot_COMPU_VTAB 0 255 BIT_MASK 0xff /end CHARACTERISTIC
/begin COMPU_METHOD ICAV_cat_prot_COMPU_VTAB "Verbal Table" TAB_VERB "%.0" "list" COMPU_TAB_REF ICAV_cat_prot_COMPU_VTAB_REF /end COMPU_METHOD
/begin COMPU_VTAB ICAV_cat_prot_COMPU_VTAB_REF "Verbal Table" TAB_VERB 9 0 "Disabled" 1 "Table 1 / Gasoline Load-Limit" 2 "Table 2 / LPG Load-Limit" 3 "Table 3 / NG Load-Limit" 4 "Table 4 / Power Load-Limit" 5 "Table 5" 6 "Table 6" 7 "Table 7" 8 "Table 8" DEFAULT_VALUE "UNKNOWN" /end COMPU_VTAB
/begin CHARACTERISTIC ICAV_cat_prot_fuel "Misfire cat protect fuel type{ICAV_cat_prot_fuel&0xff=0x00:Gasoline}{ICAV_cat_prot_fuel&0xff=0x01:Propane}{ICAV_cat_prot_fuel&0xff=0x02:Natural Gas}" VALUE 0x00147dbd /* @ECU_Address@ICAV_cat_prot_fuel@0x01010B18@ */ ECIPP_ALIGNMENT_UBYTE 255 ICAV_cat_prot_fuel_COMPU_VTAB 0 255 BIT_MASK 0xff /end CHARACTERISTIC
/begin COMPU_METHOD ICAV_cat_prot_fuel_COMPU_VTAB "Verbal Table" TAB_VERB "%.0" "list" COMPU_TAB_REF ICAV_cat_prot_fuel_COMPU_VTAB_REF /end COMPU_METHOD
/begin COMPU_VTAB ICAV_cat_prot_fuel_COMPU_VTAB_REF "Verbal Table" TAB_VERB 3 0x00 "Gasoline" 0x01 "Propane" 0x02 "Natural Gas" DEFAULT_VALUE "UNKNOWN" /end COMPU_VTAB
/begin MEASUREMENT ICAV_cat_prot_act "Misfire cat protect status{ICAV_cat_prot_act&0xff=0:Inactive}{ICAV_cat_prot_act&0xff=1:Active}" UBYTE ICAV_cat_prot_act_COMPU_VTAB 0 0 0 255 ECU_ADDRESS 0x01010B20 BIT_MASK 0xff /end MEASUREMENT
/begin COMPU_METHOD ICAV_cat_prot_act_COMPU_VTAB "Verbal Table" TAB_VERB "%.0" "list" COMPU_TAB_REF ICAV_cat_prot_act_COMPU_VTAB_REF /end COMPU_METHOD
/begin COMPU_VTAB ICAV_cat_prot_act_COMPU_VTAB_REF "Verbal Table" TAB_VERB 2 0 "Inactive" 1 "Active" DEFAULT_VALUE "UNKNOWN" /end COMPU_VTAB
/begin CHARACTERISTIC ICAV_OILT_src "Oil temperature source{ICAV_OILT_src&0xff=0:Model}{ICAV_OILT_src&0xff=1:Sensor}" VALUE 0x00147db5 /* @ECU_Address@ICAV_OILT_src@0x01011588@ */ ECIPP_ALIGNMENT_UBYTE 255 ICAV_OILT_src_COMPU_VTAB 0 255 BIT_MASK 0xff /end CHARACTERISTIC
/begin COMPU_METHOD ICAV_OILT_src_COMPU_VTAB "Verbal Table" TAB_VERB "%.0" "list" COMPU_TAB_REF ICAV_OILT_src_COMPU_VTAB_REF /end COMPU_METHOD
/begin COMPU_VTAB ICAV_OILT_src_COMPU_VTAB_REF "Verbal Table" TAB_VERB 2 0 "Model" 1 "Sensor" DEFAULT_VALUE "UNKNOWN" /end COMPU_VTAB
/begin MEASUREMENT MFG_man_mode "MFG manual mode{MFG_man_mode&0xff=0:Auto}{MFG_man_mode&0xff=1:Manual Position}{MFG_man_mode&0xff=2:Manual Flow}{MFG_man_mode&0xff=3:Manual Off}" UBYTE MFG_man_mode_COMPU_VTAB 0 0 0 255 ECU_ADDRESS 0x01011598 BIT_MASK 0xff /end MEASUREMENT
/begin COMPU_METHOD MFG_man_mode_COMPU_VTAB "Verbal Table" TAB_VERB "%.0" "list" COMPU_TAB_REF MFG_man_mode_COMPU_VTAB_REF /end COMPU_METHOD
/begin COMPU_VTAB MFG_man_mode_COMPU_VTAB_REF "Verbal Table" TAB_VERB 4 0 "Auto" 1 "Manual Position" 2 "Manual Flow" 3 "Manual Off" DEFAULT_VALUE "UNKNOWN" /end COMPU_VTAB
/begin MEASUREMENT MFG_ctltype_cmd "MFG control type command{MFG_ctltype_cmd&0xff=0:Off}{MFG_ctltype_cmd&0xff=1:Position}{MFG_ctltype_cmd&0xff=2:Flow}{MFG_ctltype_cmd&0xff=3:Reserved}" UBYTE MFG_ctltype_cmd_COMPU_VTAB 0 0 0 255 ECU_ADDRESS 0x010115A0 BIT_MASK 0xff /end MEASUREMENT
/begin COMPU_METHOD MFG_ctltype_cmd_COMPU_VTAB "Verbal Table" TAB_VERB "%.0" "list" COMPU_TAB_REF MFG_ctltype_cmd_COMPU_VTAB_REF /end COMPU_METHOD
/begin COMPU_VTAB MFG_ctltype_cmd_COMPU_VTAB_REF "Verbal Table" TAB_VERB 4 0 "Off" 1 "Position" 2 "Flow" 3 "Reserved" DEFAULT_VALUE "UNKNOWN" /end COMPU_VTAB
/begin MEASUREMENT MFG_ctltype_act "MFG control type feedback{MFG_ctltype_act&0xff=0:Off}{MFG_ctltype_act&0xff=1:Position}{MFG_ctltype_act&0xff=2:Flow}{MFG_ctltype_act&0xff=3:Reserved}" UBYTE MFG_ctltype_act_COMPU_VTAB 0 0 0 255 ECU_ADDRESS 0x010115A8 BIT_MASK 0xff /end MEASUREMENT
/begin COMPU_METHOD MFG_ctltype_act_COMPU_VTAB "Verbal Table" TAB_VERB "%.0" "list" COMPU_TAB_REF MFG_ctltype_act_COMPU_VTAB_REF /end COMPU_METHOD
/begin COMPU_VTAB MFG_ctltype_act_COMPU_VTAB_REF "Verbal Table" TAB_VERB 4 0 "Off" 1 "Position" 2 "Flow" 3 "Reserved" DEFAULT_VALUE "UNKNOWN" /end COMPU_VTAB
/begin MEASUREMENT MFG_status "MFG status{MFG_status&0xff=0:Comm Lost}{MFG_status&0xff=1:OK}{MFG_status&0xff=2:Fault}" UBYTE MFG_status_COMPU_VTAB 0 0 0 255 ECU_ADDRESS 0x010115B0 BIT_MASK 0xff /end MEASUREMENT
/begin COMPU_METHOD MFG_status_COMPU_VTAB "Verbal Table" TAB_VERB "%.0" "list" COMPU_TAB_REF MFG_status_COMPU_VTAB_REF /end COMPU_METHOD
/begin COMPU_VTAB MFG_status_COMPU_VTAB_REF "Verbal Table" TAB_VERB 3 0 "Comm Lost" 1 "OK" 2 "Fault" DEFAULT_VALUE "UNKNOWN" /end COMPU_VTAB
/begin MEASUREMENT MFGI_flash_wr_left "Internal flash writes remaining" SBYTE Compu_MFGI_flash_wr_left 0 0 -128 127 ECU_ADDRESS 0x010115B8 /end MEASUREMENT
/begin COMPU_METHOD Compu_MFGI_flash_wr_left " " RAT_FUNC "%.0" "-" COEFFS 0 1 0 0 0 1 /end COMPU_METHOD
/begin MEASUREMENT MFGI_flash_wr_force "Internal flash write request{MFGI_flash_wr_force&0xff=0:Idle}{MFGI_flash_wr_force&0xff=1:Write Flash}" UBYTE MFGI_flash_wr_force_COMPU_VTAB 0 0 0 255 ECU_ADDRESS 0x010115C0 BIT_MASK 0xff /end MEASUREMENT
/begin COMPU_METHOD MFGI_flash_wr_force_COMPU_VTAB "Verbal Table" TAB_VERB "%.0" "list" COMPU_TAB_REF MFGI_flash_wr_force_COMPU_VTAB_REF /end COMPU_METHOD
/begin COMPU_VTAB MFGI_flash_wr_force_COMPU_VTAB_REF "Verbal Table" TAB_VERB 2 0 "Idle" 1 "Write Flash" DEFAULT_VALUE "UNKNOWN" /end COMPU_VTAB
/begin MEASUREMENT MFGI_cur_cal_mod "Internal current MFG cal model" ULONG Compu_MFGI_cur_cal_mod 0 0 0 4294967295 ECU_ADDRESS 0x010115C8 /end MEASUREMENT
/begin COMPU_METHOD Compu_MFGI_cur_cal_mod " " RAT_FUNC "%.0" "-" COEFFS 0 1 0 0 0 1 /end COMPU_METHOD
/begin CHARACTERISTIC PN_MFG_eng_cal_mod "Engine calibration MFG cal model" VALUE 0x001490D0 /* @ECU_Address@PN_MFG_eng_cal_mod@0x010115D0@ */ ECIPP_ALIGNMENT_ULONG 4294967295 Compu_PN_MFG_eng_cal_mod 0 4294967295 /end CHARACTERISTIC
/begin COMPU_METHOD Compu_PN_MFG_eng_cal_mod " " RAT_FUNC "%.0" "(7 digits + 1 letter)" COEFFS 0 1 0 0 0 1 /end COMPU_METHOD
/begin MEASUREMENT MFG_param_differ "MFG cal parameter status{MFG_param_differ&0xff=0:Params Match}{MFG_param_differ&0xff=1:Params Do Not Match}" UBYTE MFG_param_differ_COMPU_VTAB 0 0 0 255 ECU_ADDRESS 0x010115D8 BIT_MASK 0xff /end MEASUREMENT
/begin COMPU_METHOD MFG_param_differ_COMPU_VTAB "Verbal Table" TAB_VERB "%.0" "list" COMPU_TAB_REF MFG_param_differ_COMPU_VTAB_REF /end COMPU_METHOD
/begin COMPU_VTAB MFG_param_differ_COMPU_VTAB_REF "Verbal Table" TAB_VERB 2 0 "Params Match" 1 "Params Do Not Match" DEFAULT_VALUE "UNKNOWN" /end COMPU_VTAB
/begin MEASUREMENT MFG_param_upload "MFG cal upload from MFG{MFG_param_upload&0xff=0:Idle}{MFG_param_upload&0xff=1:Upload Params from MFG}" UBYTE MFG_param_upload_COMPU_VTAB 0 0 0 255 ECU_ADDRESS 0x010115E0 BIT_MASK 0xff /end MEASUREMENT
/begin COMPU_METHOD MFG_param_upload_COMPU_VTAB "Verbal Table" TAB_VERB "%.0" "list" COMPU_TAB_REF MFG_param_upload_COMPU_VTAB_REF /end COMPU_METHOD
/begin COMPU_VTAB MFG_param_upload_COMPU_VTAB_REF "Verbal Table" TAB_VERB 2 0 "Idle" 1 "Upload Params from MFG" DEFAULT_VALUE "UNKNOWN" /end COMPU_VTAB
/begin MEASUREMENT MFG_cal_state "MFG cal / paramocan state" UBYTE Compu_MFG_cal_state 0 0 0 255 ECU_ADDRESS 0x010115E8 /end MEASUREMENT
/begin COMPU_METHOD Compu_MFG_cal_state " " RAT_FUNC "%.0" "state" COEFFS 0 1 0 0 0 1 /end COMPU_METHOD
/begin MEASUREMENT MFGI_cur_SW_mod "Internal current MFG SW model" ULONG Compu_MFGI_cur_SW_mod 0 0 0 4294967295 ECU_ADDRESS 0x010115F0 /end MEASUREMENT
/begin COMPU_METHOD Compu_MFGI_cur_SW_mod " " RAT_FUNC "%.0" "-" COEFFS 0 1 0 0 0 1 /end COMPU_METHOD
/begin MEASUREMENT MFGI_cur_HW_mod "Internal current MFG HW model" ULONG Compu_MFGI_cur_HW_mod 0 0 0 4294967295 ECU_ADDRESS 0x010115F8 /end MEASUREMENT
/begin COMPU_METHOD Compu_MFGI_cur_HW_mod " " RAT_FUNC "%.0" "-" COEFFS 0 1 0 0 0 1 /end COMPU_METHOD
/begin CHARACTERISTIC MFG_mdot_FS "MFG full-scale mdot fuel" VALUE 0x001475fe /* @ECU_Address@MFG_mdot_FS@0x01011600@ */ ECIPP_ALIGNMENT_UWORD 16384 Compu_MFG_mdot_FS 0 16383.75 /end CHARACTERISTIC
/begin COMPU_METHOD Compu_MFG_mdot_FS " " RAT_FUNC "%.2" "g/sec" COEFFS 0 4 0 0 0 1 /end COMPU_METHOD
/begin MEASUREMENT MFG_mdot_act_pct "MFG actual fuel flow" UWORD Compu_MFG_mdot_act_pct 0 0 0 99.9984741210938 ECU_ADDRESS 0x01011608 /end MEASUREMENT
/begin COMPU_METHOD Compu_MFG_mdot_act_pct " " RAT_FUNC "%.1" "% of FS" COEFFS 0 655.36 0 0 0 1 /end COMPU_METHOD
/begin MEASUREMENT MFG_mdot_act "MFG actual fuel flow" ULONG Compu_MFG_mdot_act 0 0 0 16383.9999961853 ECU_ADDRESS 0x01011610 /end MEASUREMENT
/begin COMPU_METHOD Compu_MFG_mdot_act " " RAT_FUNC "%.2" "g/sec" COEFFS 0 262144 0 0 0 1 /end COMPU_METHOD
/begin MEASUREMENT MFG_mdot_cmd_pct "MFG commanded fuel flow" UWORD Compu_MFG_mdot_cmd_pct 0 0 0 99.9984741210938 ECU_ADDRESS 0x01011618 /end MEASUREMENT
/begin COMPU_METHOD Compu_MFG_mdot_cmd_pct " " RAT_FUNC "%.1" "% of FS" COEFFS 0 655.36 0 0 0 1 /end COMPU_METHOD
/begin MEASUREMENT MFG_mdot_cmd "MFG commanded fuel flow" ULONG Compu_MFG_mdot_cmd 0 0 0 16383.9999961853 ECU_ADDRESS 0x01011620 /end MEASUREMENT
/begin COMPU_METHOD Compu_MFG_mdot_cmd " " RAT_FUNC "%.2" "g/sec" COEFFS 0 262144 0 0 0 1 /end COMPU_METHOD
/begin MEASUREMENT MFG_param_NA_cnt "MFG parameter not-available counter" UWORD Compu_MFG_param_NA_cnt 0 0 0 65535 ECU_ADDRESS 0x01011628 /end MEASUREMENT
/begin COMPU_METHOD Compu_MFG_param_NA_cnt " " RAT_FUNC "%.0" "count" COEFFS 0 1 0 0 0 1 /end COMPU_METHOD
/begin MEASUREMENT MFG_TPS_act_pct "MFG actual position" UWORD Compu_MFG_TPS_act_pct 0 0 0 99.9984741210938 ECU_ADDRESS 0x01011630 /end MEASUREMENT
/begin COMPU_METHOD Compu_MFG_TPS_act_pct " " RAT_FUNC "%.1" "%" COEFFS 0 655.36 0 0 0 1 /end COMPU_METHOD
/begin MEASUREMENT MFG_TPS_cmd_pct "MFG commanded position" UWORD Compu_MFG_TPS_cmd_pct 0 0 0 99.9984741210938 ECU_ADDRESS 0x01011638 /end MEASUREMENT
/begin COMPU_METHOD Compu_MFG_TPS_cmd_pct " " RAT_FUNC "%.1" "%" COEFFS 0 655.36 0 0 0 1 /end COMPU_METHOD
/begin MEASUREMENT MFG_FTemp "MFG fuel temperature" UWORD Compu_MFG_FTemp 0 0 -460 1383.171875 ECU_ADDRESS 0x01011640 /end MEASUREMENT
/begin COMPU_METHOD Compu_MFG_FTemp " " RAT_FUNC "%.1" "deg F" COEFFS 0 35.5555555555556 16355.5555555556 0 0 1 /end COMPU_METHOD
/begin MEASUREMENT MFG_USPress "MFG upstream pressure" UWORD Compu_MFG_USPress 0 0 0 148.51664578125 ECU_ADDRESS 0x01011650 /end MEASUREMENT
/begin COMPU_METHOD Compu_MFG_USPress " " RAT_FUNC "%.2" "psia" COEFFS 0 441.263668831617 0 0 0 1 /end COMPU_METHOD
/begin MEASUREMENT MFG_DSPress "MFG downstream pressure" UWORD Compu_MFG_DSPress 0 0 0 148.51664578125 ECU_ADDRESS 0x01011658 /end MEASUREMENT
/begin COMPU_METHOD Compu_MFG_DSPress " " RAT_FUNC "%.2" "psia" COEFFS 0 441.263668831617 0 0 0 1 /end COMPU_METHOD
/begin MEASUREMENT MFG_DPPress "MFG delta pressure" SWORD Compu_MFG_DPPress 0 0 -2.320608 2.32053718066406 ECU_ADDRESS 0x01011660 /end MEASUREMENT
/begin COMPU_METHOD Compu_MFG_DPPress " " RAT_FUNC "%.3" "psia" COEFFS 0 14120.4374026117 0 0 0 1 /end COMPU_METHOD
/begin CHARACTERISTIC MFG_dP_cyl_events "MFG dP averaging window" VALUE 0x001490C8 /* @ECU_Address@MFG_dP_cyl_events@0x01011668@ */ ECIPP_ALIGNMENT_UWORD 64 Compu_MFG_dP_cyl_events 0 63.9990234375 /end CHARACTERISTIC
/begin COMPU_METHOD Compu_MFG_dP_cyl_events " " RAT_FUNC "%.1" "cyl events" COEFFS 0 1024 0 0 0 1 /end COMPU_METHOD
/begin MEASUREMENT MFG_dP_avg_window "MFG dP averaging window" UWORD Compu_MFG_dP_avg_window 0 0 0 1023.984375 ECU_ADDRESS 0x01011670 /end MEASUREMENT
/begin COMPU_METHOD Compu_MFG_dP_avg_window " " RAT_FUNC "%.2" "ms" COEFFS 0 64 0 0 0 1 /end COMPU_METHOD
/begin MEASUREMENT MFG_DPPress_Pcrct "MFG differenced dP corrected" SWORD Compu_MFG_DPPress_Pcrct 0 0 -148.518912 148.5143795625 ECU_ADDRESS 0x01011678 /end MEASUREMENT
/begin COMPU_METHOD Compu_MFG_DPPress_Pcrct " " RAT_FUNC "%.3" "psia" COEFFS 0 220.631834415808 0 0 0 1 /end COMPU_METHOD
/begin MEASUREMENT MFG_DPPress_final "MFG final DP for mass-flow" SWORD Compu_MFG_DPPress_final 0 0 -148.518912 148.5143795625 ECU_ADDRESS 0x01011680 /end MEASUREMENT
/begin COMPU_METHOD Compu_MFG_DPPress_final " " RAT_FUNC "%.3" "psia" COEFFS 0 220.631834415808 0 0 0 1 /end COMPU_METHOD
/begin CHARACTERISTIC MFG_enabled "MFG enabled{MFG_enabled&0xff=0:Disabled}{MFG_enabled&0xff=1:Enabled}" VALUE 0x001490CC /* @ECU_Address@MFG_enabled@0x01011778@ */ ECIPP_ALIGNMENT_UBYTE 255 MFG_enabled_COMPU_VTAB 0 255 BIT_MASK 0xff /end CHARACTERISTIC
/begin COMPU_METHOD MFG_enabled_COMPU_VTAB "Verbal Table" TAB_VERB "%.0" "list" COMPU_TAB_REF MFG_enabled_COMPU_VTAB_REF /end COMPU_METHOD
/begin COMPU_VTAB MFG_enabled_COMPU_VTAB_REF "Verbal Table" TAB_VERB 2 0 "Disabled" 1 "Enabled" DEFAULT_VALUE "UNKNOWN" /end COMPU_VTAB
/begin CHARACTERISTIC MFG_fuel_calc "MFG fuel calculation mode{MFG_fuel_calc&0xff=0:Speed-Density + dMAP/dt}{MFG_fuel_calc&0xff=1:Throttle-Model Based}{MFG_fuel_calc&0xff=2:MFA mass flow}" VALUE 0x00147e68 /* @ECU_Address@MFG_fuel_calc@0x01011788@ */ ECIPP_ALIGNMENT_UBYTE 255 MFG_fuel_calc_COMPU_VTAB 0 255 BIT_MASK 0xff /end CHARACTERISTIC
/begin COMPU_METHOD MFG_fuel_calc_COMPU_VTAB "Verbal Table" TAB_VERB "%.0" "list" COMPU_TAB_REF MFG_fuel_calc_COMPU_VTAB_REF /end COMPU_METHOD
/begin COMPU_VTAB MFG_fuel_calc_COMPU_VTAB_REF "Verbal Table" TAB_VERB 3 0 "Speed-Density + dMAP/dt" 1 "Throttle-Model Based" 2 "MFA mass flow" DEFAULT_VALUE "UNKNOWN" /end COMPU_VTAB
/begin CHARACTERISTIC MFG_loc "MFG location{MFG_loc&0xff=0:Air filter}{MFG_loc&0xff=1:Pre-throttle}" VALUE 0x00147e69 /* @ECU_Address@MFG_loc@0x01011790@ */ ECIPP_ALIGNMENT_UBYTE 255 MFG_loc_COMPU_VTAB 0 255 BIT_MASK 0xff /end CHARACTERISTIC
/begin COMPU_METHOD MFG_loc_COMPU_VTAB "Verbal Table" TAB_VERB "%.0" "list" COMPU_TAB_REF MFG_loc_COMPU_VTAB_REF /end COMPU_METHOD
/begin COMPU_VTAB MFG_loc_COMPU_VTAB_REF "Verbal Table" TAB_VERB 2 0 "Air filter" 1 "Pre-throttle" DEFAULT_VALUE "UNKNOWN" /end COMPU_VTAB
/begin MEASUREMENT MFG_SD_mdot_cmd "Speed-density-based fuel cmd" FLOAT32_IEEE Compu_MFG_SD_mdot_cmd 0 0 -10000000000 10000000000 ECU_ADDRESS 0x01011798 /end MEASUREMENT
/begin COMPU_METHOD Compu_MFG_SD_mdot_cmd " " RAT_FUNC "%.2" "g/sec" COEFFS 0 1 0 0 0 1 /end COMPU_METHOD
/begin MEASUREMENT MFG_MFA_mdot_cmd "MFA mass flow-based fuel cmd" FLOAT32_IEEE Compu_MFG_MFA_mdot_cmd 0 0 -10000000000 10000000000 ECU_ADDRESS 0x010117A0 /end MEASUREMENT
/begin COMPU_METHOD Compu_MFG_MFA_mdot_cmd " " RAT_FUNC "%.2" "g/sec" COEFFS 0 1 0 0 0 1 /end COMPU_METHOD
/begin CHARACTERISTIC MFG_hsdata_tx_ena "MFG high speed data tx enabled{MFG_hsdata_tx_ena&0xff=0:Disabled}{MFG_hsdata_tx_ena&0xff=1:Enabled}{MFG_hsdata_tx_ena&0xff=2:Automatic}" VALUE 0x001490D8 /* @ECU_Address@MFG_hsdata_tx_ena@0x010117C8@ */ ECIPP_ALIGNMENT_UBYTE 255 MFG_hsdata_tx_ena_COMPU_VTAB 0 255 BIT_MASK 0xff /end CHARACTERISTIC
/begin COMPU_METHOD MFG_hsdata_tx_ena_COMPU_VTAB "Verbal Table" TAB_VERB "%.0" "list" COMPU_TAB_REF MFG_hsdata_tx_ena_COMPU_VTAB_REF /end COMPU_METHOD
/begin COMPU_VTAB MFG_hsdata_tx_ena_COMPU_VTAB_REF "Verbal Table" TAB_VERB 3 0 "Disabled" 1 "Enabled" 2 "Automatic" DEFAULT_VALUE "UNKNOWN" /end COMPU_VTAB
/begin MEASUREMENT MFG_hsdata_tx_act "MFG high speed data tx actual{MFG_hsdata_tx_act&0xff=0:Disabled}{MFG_hsdata_tx_act&0xff=1:Enabled}" UWORD MFG_hsdata_tx_act_COMPU_VTAB 0 0 0 65535 ECU_ADDRESS 0x010117D0 BIT_MASK 0xff /end MEASUREMENT
/begin COMPU_METHOD MFG_hsdata_tx_act_COMPU_VTAB "Verbal Table" TAB_VERB "%.0" "list" COMPU_TAB_REF MFG_hsdata_tx_act_COMPU_VTAB_REF /end COMPU_METHOD
/begin COMPU_VTAB MFG_hsdata_tx_act_COMPU_VTAB_REF "Verbal Table" TAB_VERB 2 0 "Disabled" 1 "Enabled" DEFAULT_VALUE "UNKNOWN" /end COMPU_VTAB
/begin MEASUREMENT MFG_DSPress_slow "MFG downstream pressure (slow-avg)" UWORD Compu_MFG_DSPress_slow 0 0 0 148.51664578125 ECU_ADDRESS 0x010117D8 /end MEASUREMENT
/begin COMPU_METHOD Compu_MFG_DSPress_slow " " RAT_FUNC "%.2" "psia" COEFFS 0 441.263668831617 0 0 0 1 /end COMPU_METHOD
/begin MEASUREMENT MFG_DSPressdt "MFG downstream pressure dt" SWORD Compu_MFG_DSPressdt 0 0 -2320.608 2320.53718066406 ECU_ADDRESS 0x010117E0 /end MEASUREMENT
/begin COMPU_METHOD Compu_MFG_DSPressdt " " RAT_FUNC "%.2" "psi/sec" COEFFS 0 14.1204374026117 0 0 0 1 /end COMPU_METHOD
/begin MEASUREMENT MFG_DSPress_fast "MFG downstream pressure (fast-avg)" UWORD Compu_MFG_DSPress_fast 0 0 0 148.51664578125 ECU_ADDRESS 0x010117F0 /end MEASUREMENT
/begin COMPU_METHOD Compu_MFG_DSPress_fast " " RAT_FUNC "%.2" "psia" COEFFS 0 441.263668831617 0 0 0 1 /end COMPU_METHOD
/begin MEASUREMENT MFG_hsdata_active "MFG high speed data active{MFG_hsdata_active&0xff=0:Inactive}{MFG_hsdata_active&0xff=1:Active}" UBYTE MFG_hsdata_active_COMPU_VTAB 0 0 0 255 ECU_ADDRESS 0x01011800 BIT_MASK 0xff /end MEASUREMENT
/begin COMPU_METHOD MFG_hsdata_active_COMPU_VTAB "Verbal Table" TAB_VERB "%.0" "list" COMPU_TAB_REF MFG_hsdata_active_COMPU_VTAB_REF /end COMPU_METHOD
/begin COMPU_VTAB MFG_hsdata_active_COMPU_VTAB_REF "Verbal Table" TAB_VERB 2 0 "Inactive" 1 "Active" DEFAULT_VALUE "UNKNOWN" /end COMPU_VTAB
/begin CHARACTERISTIC MFG_TPS_cmd_min "MFG throttle position min" VALUE 0x001475f8 /* @ECU_Address@MFG_TPS_cmd_min@0x01011820@ */ ECIPP_ALIGNMENT_UWORD 100 Compu_MFG_TPS_cmd_min 0 99.9984741210938 /end CHARACTERISTIC
/begin COMPU_METHOD Compu_MFG_TPS_cmd_min " " RAT_FUNC "%.1" "%" COEFFS 0 655.36 0 0 0 1 /end COMPU_METHOD
/begin CHARACTERISTIC MFG_TPS_cmd_max "MFG throttle position max" VALUE 0x001475f6 /* @ECU_Address@MFG_TPS_cmd_max@0x01011828@ */ ECIPP_ALIGNMENT_UWORD 100 Compu_MFG_TPS_cmd_max 0 99.9984741210938 /end CHARACTERISTIC
/begin COMPU_METHOD Compu_MFG_TPS_cmd_max " " RAT_FUNC "%.1" "%" COEFFS 0 655.36 0 0 0 1 /end COMPU_METHOD
/begin MEASUREMENT gammaf_act "Actual fuel specific heat ratio" UWORD Compu_gammaf_act 0 0 0 3.99993896484375 ECU_ADDRESS 0x01011850 /end MEASUREMENT
/begin COMPU_METHOD Compu_gammaf_act " " RAT_FUNC "%.3" "-" COEFFS 0 16384 0 0 0 1 /end COMPU_METHOD
/begin MEASUREMENT SGf_act "Actual fuel specific gravity" UWORD Compu_SGf_act 0 0 0 127.998046875 ECU_ADDRESS 0x01011858 /end MEASUREMENT
/begin COMPU_METHOD Compu_SGf_act " " RAT_FUNC "%.3" "-" COEFFS 0 512 0 0 0 1 /end COMPU_METHOD
/begin MEASUREMENT MFG_fault_range_1 "MFG fault range 1" UWORD Compu_MFG_fault_range_1 0 0 0 65535 ECU_ADDRESS 0x01011870 /end MEASUREMENT
/begin COMPU_METHOD Compu_MFG_fault_range_1 " " RAT_FUNC "%.0" "bit flag" COEFFS 0 1 0 0 0 1 /end COMPU_METHOD
/begin MEASUREMENT MFG_fault_range_2 "MFG fault range 2" UWORD Compu_MFG_fault_range_2 0 0 0 65535 ECU_ADDRESS 0x01011880 /end MEASUREMENT
/begin COMPU_METHOD Compu_MFG_fault_range_2 " " RAT_FUNC "%.0" "bit flag" COEFFS 0 1 0 0 0 1 /end COMPU_METHOD
/begin CHARACTERISTIC MFG_RLV_ena "MFG redundant lockoff verification{MFG_RLV_ena&0xff=0:Disabled}{MFG_RLV_ena&0xff=1:Enabled}" VALUE 0x00147e67 /* @ECU_Address@MFG_RLV_ena@0x01011C38@ */ ECIPP_ALIGNMENT_UBYTE 255 MFG_RLV_ena_COMPU_VTAB 0 255 BIT_MASK 0xff /end CHARACTERISTIC
/begin COMPU_METHOD MFG_RLV_ena_COMPU_VTAB "Verbal Table" TAB_VERB "%.0" "list" COMPU_TAB_REF MFG_RLV_ena_COMPU_VTAB_REF /end COMPU_METHOD
/begin COMPU_VTAB MFG_RLV_ena_COMPU_VTAB_REF "Verbal Table" TAB_VERB 2 0 "Disabled" 1 "Enabled" DEFAULT_VALUE "UNKNOWN" /end COMPU_VTAB
/begin MEASUREMENT MFG_RLV_cyc_elapsed "CFV / MFG RLV test warm cycles" UBYTE Compu_MFG_RLV_cyc_elapsed 0 0 0 255 ECU_ADDRESS 0x01011C58 /end MEASUREMENT
/begin COMPU_METHOD Compu_MFG_RLV_cyc_elapsed " " RAT_FUNC "%.0" "cycles" COEFFS 0 1 0 0 0 1 /end COMPU_METHOD
/begin MEASUREMENT MFG_RLV_HM_elapsed "CFV / MFG RLV test elapsed time" ULONG Compu_MFG_RLV_HM_elapsed 0 0 0 1193046.47083333 ECU_ADDRESS 0x01011C60 /end MEASUREMENT
/begin COMPU_METHOD Compu_MFG_RLV_HM_elapsed " " RAT_FUNC "%.2" "hours" COEFFS 0 3600 0 0 0 1 /end COMPU_METHOD
/begin MEASUREMENT MFG_mdot_choke "MFG after-start fuel enrichment" UWORD Compu_MFG_mdot_choke 0 0 0 1023.984375 ECU_ADDRESS 0x01011FC0 /end MEASUREMENT
/begin COMPU_METHOD Compu_MFG_mdot_choke " " RAT_FUNC "%.2" "g/sec" COEFFS 0 64 0 0 0 1 /end COMPU_METHOD
/begin CHARACTERISTIC ICAV_adpt_flt_ena "Misfire faults adapt disable{ICAV_adpt_flt_ena&0xff=0:Disabled}{ICAV_adpt_flt_ena&0xff=1:Enabled}" VALUE 0x00147db7 /* @ECU_Address@ICAV_adpt_flt_ena@0x01011FD0@ */ ECIPP_ALIGNMENT_UBYTE 255 ICAV_adpt_flt_ena_COMPU_VTAB 0 255 BIT_MASK 0xff /end CHARACTERISTIC
/begin COMPU_METHOD ICAV_adpt_flt_ena_COMPU_VTAB "Verbal Table" TAB_VERB "%.0" "list" COMPU_TAB_REF ICAV_adpt_flt_ena_COMPU_VTAB_REF /end COMPU_METHOD
/begin COMPU_VTAB ICAV_adpt_flt_ena_COMPU_VTAB_REF "Verbal Table" TAB_VERB 2 0 "Disabled" 1 "Enabled" DEFAULT_VALUE "UNKNOWN" /end COMPU_VTAB
/begin MEASUREMENT ICAV_adpt_flt "Misfire faults adapt disabled" UBYTE Compu_ICAV_adpt_flt 0 0 0 255 ECU_ADDRESS 0x01011FD8 /end MEASUREMENT
/begin COMPU_METHOD Compu_ICAV_adpt_flt " " RAT_FUNC "%.0" "-" COEFFS 0 1 0 0 0 1 /end COMPU_METHOD
/begin MEASUREMENT MFG_RLV_state "CFV / MFG RLV fuel run-out test state{MFG_RLV_state&0xff=0:Inactive}{MFG_RLV_state&0xff=1:Lockoff 1 test active}{MFG_RLV_state&0xff=2:Lockoff 2 test active}{MFG_RLV_state&0xff=3:Lockoff 3 test active}{MFG_RLV_state&0xff=4:Lockoff 4 test active}" UBYTE MFG_RLV_state_COMPU_VTAB 0 0 0 255 ECU_ADDRESS 0x010120B0 BIT_MASK 0xff /end MEASUREMENT
/begin COMPU_METHOD MFG_RLV_state_COMPU_VTAB "Verbal Table" TAB_VERB "%.0" "list" COMPU_TAB_REF MFG_RLV_state_COMPU_VTAB_REF /end COMPU_METHOD
/begin COMPU_VTAB MFG_RLV_state_COMPU_VTAB_REF "Verbal Table" TAB_VERB 5 0 "Inactive" 1 "Lockoff 1 test active" 2 "Lockoff 2 test active" 3 "Lockoff 3 test active" 4 "Lockoff 4 test active" DEFAULT_VALUE "UNKNOWN" /end COMPU_VTAB
/begin CHARACTERISTIC ICAV_cat_prot_2cyl "Misfire cat protect - multi-cyl{ICAV_cat_prot_2cyl&0xff=0:One cylinder option}{ICAV_cat_prot_2cyl&0xff=1:Engine shutdown}" VALUE 0x00147dbc /* @ECU_Address@ICAV_cat_prot_2cyl@0x01012178@ */ ECIPP_ALIGNMENT_UBYTE 255 ICAV_cat_prot_2cyl_COMPU_VTAB 0 255 BIT_MASK 0xff /end CHARACTERISTIC
/begin COMPU_METHOD ICAV_cat_prot_2cyl_COMPU_VTAB "Verbal Table" TAB_VERB "%.0" "list" COMPU_TAB_REF ICAV_cat_prot_2cyl_COMPU_VTAB_REF /end COMPU_METHOD
/begin COMPU_VTAB ICAV_cat_prot_2cyl_COMPU_VTAB_REF "Verbal Table" TAB_VERB 2 0 "One cylinder option" 1 "Engine shutdown" DEFAULT_VALUE "UNKNOWN" /end COMPU_VTAB
/begin CHARACTERISTIC MFG_mdot_mult "MFG fuel cmd multiplier" VALUE 0x00147600 /* @ECU_Address@MFG_mdot_mult@0x010128D8@ */ ECIPP_ALIGNMENT_UWORD 4 Compu_MFG_mdot_mult 0 3.99993896484375 /end CHARACTERISTIC
/begin COMPU_METHOD Compu_MFG_mdot_mult " " RAT_FUNC "%.3" "3456789A" COEFFS 0 16384 0 0 0 1 /end COMPU_METHOD
/begin CHARACTERISTIC MFG_mdot_cmd_tau "MFG fuel cmd LP tau" VALUE 0x001439d4 /* @ECU_Address@MFG_mdot_cmd_tau@0x010128E0@ */ ECIPP_ALIGNMENT_FLOAT32_IEEE 10000000000 Compu_MFG_mdot_cmd_tau -10000000000 10000000000 /end CHARACTERISTIC
/begin COMPU_METHOD Compu_MFG_mdot_cmd_tau " " RAT_FUNC "%.1" "ms" COEFFS 0 1 0 0 0 1 /end COMPU_METHOD
/begin CHARACTERISTIC ICAV_PTO_ena "PTO: misfire detect disable{ICAV_PTO_ena&0xff=0:Disabled}{ICAV_PTO_ena&0xff=1:Enabled}" VALUE 0x00147db6 /* @ECU_Address@ICAV_PTO_ena@0x01012950@ */ ECIPP_ALIGNMENT_UBYTE 255 ICAV_PTO_ena_COMPU_VTAB 0 255 BIT_MASK 0xff /end CHARACTERISTIC
/begin COMPU_METHOD ICAV_PTO_ena_COMPU_VTAB "Verbal Table" TAB_VERB "%.0" "list" COMPU_TAB_REF ICAV_PTO_ena_COMPU_VTAB_REF /end COMPU_METHOD
/begin COMPU_VTAB ICAV_PTO_ena_COMPU_VTAB_REF "Verbal Table" TAB_VERB 2 0 "Disabled" 1 "Enabled" DEFAULT_VALUE "UNKNOWN" /end COMPU_VTAB
/begin CHARACTERISTIC ICAV_PTO_rpm_max "PTO: disable max engine speed" VALUE 0x0014748c /* @ECU_Address@ICAV_PTO_rpm_max@0x01012958@ */ ECIPP_ALIGNMENT_UWORD 65535 Compu_ICAV_PTO_rpm_max 0 65535 /end CHARACTERISTIC
/begin COMPU_METHOD Compu_ICAV_PTO_rpm_max " " RAT_FUNC "%.0" "rpm" COEFFS 0 1 0 0 0 1 /end COMPU_METHOD
/begin CHARACTERISTIC ICAV_PTO_MAPload_max "PTO: disable max MAP load" VALUE 0x0014748a /* @ECU_Address@ICAV_PTO_MAPload_max@0x01012960@ */ ECIPP_ALIGNMENT_UWORD 256 Compu_ICAV_PTO_MAPload_max 0 255.99609375 /end CHARACTERISTIC
/begin COMPU_METHOD Compu_ICAV_PTO_MAPload_max " " RAT_FUNC "%.2" "psia" COEFFS 0 256 0 0 0 1 /end COMPU_METHOD
/begin MEASUREMENT MFG_VE_mdot_err "MFG vs VE mdot error" SWORD Compu_MFG_VE_mdot_err 0 0 -400 399.98779296875 ECU_ADDRESS 0x01013A50 /end MEASUREMENT
/begin COMPU_METHOD Compu_MFG_VE_mdot_err " " RAT_FUNC "%.1" "%" COEFFS 0 81.92 0 0 0 1 /end COMPU_METHOD
/begin MEASUREMENT MJ_choke_pct "EPR after-start fuel enrichment" UWORD Compu_MJ_choke_pct 0 0 0 6399.90234375 ECU_ADDRESS 0x01013B80 /end MEASUREMENT
/begin COMPU_METHOD Compu_MJ_choke_pct " " RAT_FUNC "%.1" "%" COEFFS 0 10.24 0 0 0 1 /end COMPU_METHOD
/begin CHARACTERISTIC TICAV_wdw_mult "ICAV Acceleration window multipliers" MAP 0x00144E7E /* @ECU_Address@TICAV_wdw_mult@0x02164000@ */ ECIPP_ALIGNMENT_SWORD 200 Compu_TICAV_wdw_mult -200 199.993896484375
 /begin AXIS_DESCR COM_AXIS NO_INPUT_QUANTITY Compu_TICAV_adpt_maL 4 -8192 8191.75 AXIS_PTS_REF TICAV_adpt_maL /end AXIS_DESCR
 /begin AXIS_DESCR COM_AXIS NO_INPUT_QUANTITY Compu_TICAV_adpt_rpm 8 -32768 32767 AXIS_PTS_REF TICAV_adpt_rpm /end AXIS_DESCR
/end CHARACTERISTIC
/begin AXIS_PTS TICAV_adpt_maL " " 0x00144C9A /* @ECU_Address@TICAV_adpt_maL@0x02170000@ */ NO_INPUT_QUANTITY ECIPP_Lookup_SWORD 0 Compu_TICAV_adpt_maL 4 -8192 8191.75 /end AXIS_PTS
/begin AXIS_PTS TICAV_adpt_rpm " " 0x00144CA2 /* @ECU_Address@TICAV_adpt_rpm@0x0216F000@ */ NO_INPUT_QUANTITY ECIPP_Lookup_SWORD 0 Compu_TICAV_adpt_rpm 8 -32768 32767 /end AXIS_PTS
/begin COMPU_METHOD Compu_TICAV_wdw_mult "" RAT_FUNC "%.0" "window multiplier" COEFFS 0 163.84 0 0 0 1 /end COMPU_METHOD
/begin COMPU_METHOD Compu_TICAV_rpm " " RAT_FUNC "%.0" "Speed (rpm)" COEFFS 0 1 0 0 0 1 /end COMPU_METHOD
/begin COMPU_METHOD Compu_TICAV_maL " " RAT_FUNC "%.0" "Air flow (mg/L-disp)" COEFFS 0 4 0 0 0 1 /end COMPU_METHOD
/begin CHARACTERISTIC TICAV_thres_cts "ICAV Continuous Misfire Threshold" MAP 0x00144DAE /* @ECU_Address@TICAV_thres_cts@0x02167000@ */ ECIPP_ALIGNMENT_SWORD 1024 Compu_TICAV_thres_cts -1024 1023.96875
 /begin AXIS_DESCR COM_AXIS NO_INPUT_QUANTITY Compu_TICAV_maL 6 -8192 8191.75 AXIS_PTS_REF TICAV_maL /end AXIS_DESCR
 /begin AXIS_DESCR COM_AXIS NO_INPUT_QUANTITY Compu_TICAV_rpm 6 -32768 32767 AXIS_PTS_REF TICAV_rpm /end AXIS_DESCR
/end CHARACTERISTIC
/begin AXIS_PTS TICAV_maL " " 0x00144D16 /* @ECU_Address@TICAV_maL@0x02166000@ */ NO_INPUT_QUANTITY ECIPP_Lookup_SWORD 0 Compu_TICAV_maL 6 -8192 8191.75 /end AXIS_PTS
/begin AXIS_PTS TICAV_rpm " " 0x00144D22 /* @ECU_Address@TICAV_rpm@0x02165000@ */ NO_INPUT_QUANTITY ECIPP_Lookup_SWORD 0 Compu_TICAV_rpm 6 -32768 32767 /end AXIS_PTS
/begin COMPU_METHOD Compu_TICAV_thres_cts "" RAT_FUNC "%.1" "threshold (rev/sec^2)" COEFFS 0 32 0 0 0 1 /end COMPU_METHOD
/begin CHARACTERISTIC TICAV_thres_rdm "ICAV Random Misfire Threshold" MAP 0x00144DF6 /* @ECU_Address@TICAV_thres_rdm@0x02168000@ */ ECIPP_ALIGNMENT_SWORD 1024 Compu_TICAV_thres_rdm -1024 1023.96875
 /begin AXIS_DESCR COM_AXIS NO_INPUT_QUANTITY Compu_TICAV_maL 6 -8192 8191.75 AXIS_PTS_REF TICAV_maL /end AXIS_DESCR
 /begin AXIS_DESCR COM_AXIS NO_INPUT_QUANTITY Compu_TICAV_rpm 6 -32768 32767 AXIS_PTS_REF TICAV_rpm /end AXIS_DESCR
/end CHARACTERISTIC
/begin COMPU_METHOD Compu_TICAV_thres_rdm "" RAT_FUNC "%.1" "threshold (rev/sec^2)" COEFFS 0 32 0 0 0 1 /end COMPU_METHOD
/begin CHARACTERISTIC TICAV_flt_trig "ICAV Misfire Fault Triggering" MAP 0x00144CB2 /* @ECU_Address@TICAV_flt_trig@0x0216B000@ */ ECIPP_ALIGNMENT_SWORD 200 Compu_TICAV_flt_trig -200 199.993896484375
 /begin AXIS_DESCR COM_AXIS NO_INPUT_QUANTITY Compu_TICAV_maL 6 -8192 8191.75 AXIS_PTS_REF TICAV_maL /end AXIS_DESCR
 /begin AXIS_DESCR COM_AXIS NO_INPUT_QUANTITY Compu_TICAV_rpm 6 -32768 32767 AXIS_PTS_REF TICAV_rpm /end AXIS_DESCR
/end CHARACTERISTIC
/begin COMPU_METHOD Compu_TICAV_flt_trig "" RAT_FUNC "%.1" "fault trigger (% mis)" COEFFS 0 163.84 0 0 0 1 /end COMPU_METHOD
/begin COMPU_METHOD Compu_TICAV_adpt_rpm " " RAT_FUNC "%.0" "Speed (rpm)" COEFFS 0 1 0 0 0 1 /end COMPU_METHOD
/begin COMPU_METHOD Compu_TICAV_adpt_maL " " RAT_FUNC "%.0" "Air flow (mg/L-disp)" COEFFS 0 4 0 0 0 1 /end COMPU_METHOD
/begin CHARACTERISTIC TICAV_safe "ICAV Adaptive safe region" MAP 0x00144D6E /* @ECU_Address@TICAV_safe@0x0217B000@ */ ECIPP_ALIGNMENT_SWORD 2 Compu_TICAV_safe -2 1.99993896484375
 /begin AXIS_DESCR COM_AXIS NO_INPUT_QUANTITY Compu_TICAV_adpt_maL 4 -8192 8191.75 AXIS_PTS_REF TICAV_adpt_maL /end AXIS_DESCR
 /begin AXIS_DESCR COM_AXIS NO_INPUT_QUANTITY Compu_TICAV_adpt_rpm 8 -32768 32767 AXIS_PTS_REF TICAV_adpt_rpm /end AXIS_DESCR
/end CHARACTERISTIC
/begin COMPU_METHOD Compu_TICAV_safe "" RAT_FUNC "%.1" "fraction" COEFFS 0 16384 0 0 0 1 /end COMPU_METHOD
/begin CHARACTERISTIC TICAV_thres_safe "ICAV Adaptive safe threshold" MAP 0x00144E3E /* @ECU_Address@TICAV_thres_safe@0x0217C000@ */ ECIPP_ALIGNMENT_SWORD 2 Compu_TICAV_thres_safe -2 1.99993896484375
 /begin AXIS_DESCR COM_AXIS NO_INPUT_QUANTITY Compu_TICAV_adpt_maL 4 -8192 8191.75 AXIS_PTS_REF TICAV_adpt_maL /end AXIS_DESCR
 /begin AXIS_DESCR COM_AXIS NO_INPUT_QUANTITY Compu_TICAV_adpt_rpm 8 -32768 32767 AXIS_PTS_REF TICAV_adpt_rpm /end AXIS_DESCR
/end CHARACTERISTIC
/begin COMPU_METHOD Compu_TICAV_thres_safe "" RAT_FUNC "%.2" "fraction" COEFFS 0 16384 0 0 0 1 /end COMPU_METHOD
/begin CHARACTERISTIC TICAV_MAPdt_off "ICAV MAPdt disable trigger" MAP 0x00144C1A /* @ECU_Address@TICAV_MAPdt_off@0x0217D000@ */ ECIPP_ALIGNMENT_SWORD 4000 Compu_TICAV_MAPdt_off -4000 3999.8779296875
 /begin AXIS_DESCR COM_AXIS NO_INPUT_QUANTITY Compu_TICAV_adpt_maL 4 -8192 8191.75 AXIS_PTS_REF TICAV_adpt_maL /end AXIS_DESCR
 /begin AXIS_DESCR COM_AXIS NO_INPUT_QUANTITY Compu_TICAV_adpt_rpm 8 -32768 32767 AXIS_PTS_REF TICAV_adpt_rpm /end AXIS_DESCR
/end CHARACTERISTIC
/begin COMPU_METHOD Compu_TICAV_MAPdt_off "" RAT_FUNC "%.0" "MAPdt disable trigger (psi/sec)" COEFFS 0 8.192 0 0 0 1 /end COMPU_METHOD
/begin CHARACTERISTIC TICAV_rpmdt_off "ICAV RPMdt disable trigger" MAP 0x00144D2E /* @ECU_Address@TICAV_rpmdt_off@0x0217E000@ */ ECIPP_ALIGNMENT_SWORD 30719 Compu_TICAV_rpmdt_off -30720 30719.0625
 /begin AXIS_DESCR COM_AXIS NO_INPUT_QUANTITY Compu_TICAV_adpt_maL 4 -8192 8191.75 AXIS_PTS_REF TICAV_adpt_maL /end AXIS_DESCR
 /begin AXIS_DESCR COM_AXIS NO_INPUT_QUANTITY Compu_TICAV_adpt_rpm 8 -32768 32767 AXIS_PTS_REF TICAV_adpt_rpm /end AXIS_DESCR
/end CHARACTERISTIC
/begin COMPU_METHOD Compu_TICAV_rpmdt_off "" RAT_FUNC "%.0" "RPMdt disable trigger (rpm/sec)" COEFFS 0 1.06666666666667 0 0 0 1 /end COMPU_METHOD
/begin AXIS_PTS TOILT_MAP " " 0x001452B4 /* @ECU_Address@TOILT_MAP@0x0219A000@ */ NO_INPUT_QUANTITY ECIPP_Lookup_SWORD 0 Compu_TOILT_MAP 4 -128 127.99609375 /end AXIS_PTS
/begin AXIS_PTS TOILT_rpm " " 0x001452FC /* @ECU_Address@TOILT_rpm@0x02199000@ */ NO_INPUT_QUANTITY ECIPP_Lookup_SWORD 0 Compu_TOILT_rpm 4 -32768 32767 /end AXIS_PTS
/begin CHARACTERISTIC TICAV_OILT_min "Minimum Oil Temperature" MAP 0x00144C7A /* @ECU_Address@TICAV_OILT_min@0x02197000@ */ ECIPP_ALIGNMENT_SWORD 3636 Compu_TICAV_OILT_min -4556 3635.875
 /begin AXIS_DESCR COM_AXIS NO_INPUT_QUANTITY Compu_TOILT_MAP 4 -128 127.99609375 AXIS_PTS_REF TOILT_MAP /end AXIS_DESCR
 /begin AXIS_DESCR COM_AXIS NO_INPUT_QUANTITY Compu_TOILT_rpm 4 -32768 32767 AXIS_PTS_REF TOILT_rpm /end AXIS_DESCR
/end CHARACTERISTIC
/begin COMPU_METHOD Compu_TICAV_OILT_min "" RAT_FUNC "%.0" "deg F" COEFFS 0 8 3680 0 0 1 /end COMPU_METHOD
/begin CHARACTERISTIC TICAV_OILT_max "Maximum Oil Temperature" MAP 0x00144C5A /* @ECU_Address@TICAV_OILT_max@0x02198000@ */ ECIPP_ALIGNMENT_SWORD 3636 Compu_TICAV_OILT_max -4556 3635.875
 /begin AXIS_DESCR COM_AXIS NO_INPUT_QUANTITY Compu_TOILT_MAP 4 -128 127.99609375 AXIS_PTS_REF TOILT_MAP /end AXIS_DESCR
 /begin AXIS_DESCR COM_AXIS NO_INPUT_QUANTITY Compu_TOILT_rpm 4 -32768 32767 AXIS_PTS_REF TOILT_rpm /end AXIS_DESCR
/end CHARACTERISTIC
/begin COMPU_METHOD Compu_TICAV_OILT_max "" RAT_FUNC "%.0" "deg F" COEFFS 0 8 3680 0 0 1 /end COMPU_METHOD
/begin COMPU_METHOD Compu_TOILT_rpm " " RAT_FUNC "%.0" "Speed (rpm)" COEFFS 0 1 0 0 0 1 /end COMPU_METHOD
/begin COMPU_METHOD Compu_TOILT_MAP " " RAT_FUNC "%.1" "MAP load (psia)" COEFFS 0 256 0 0 0 1 /end COMPU_METHOD
/begin COMPU_METHOD Compu_TDPS_SenseRPM " " RAT_FUNC "%.0" "Speed (rpm)" COEFFS 0 1 0 0 0 1 /end COMPU_METHOD
/begin COMPU_METHOD Compu_TDPS_SenseMAP " " RAT_FUNC "%.1" "MAP load (psia)" COEFFS 0 256 0 0 0 1 /end COMPU_METHOD
/begin CHARACTERISTIC TDPS_SenseLP "DEPR Sensor Input Calibration" MAP 0x00147C32 /* @ECU_Address@TDPS_SenseLP@0x0219D000@ */ ECIPP_ALIGNMENT_UWORD 32768 Compu_TDPS_SenseLP 0.045084 32768
 /begin AXIS_DESCR COM_AXIS NO_INPUT_QUANTITY Compu_TDPS_SenseMAP 4 -128 127.99609375 AXIS_PTS_REF TDPS_SenseMAP /end AXIS_DESCR
 /begin AXIS_DESCR COM_AXIS NO_INPUT_QUANTITY Compu_TDPS_SenseRPM 6 -32768 32767 AXIS_PTS_REF TDPS_SenseRPM /end AXIS_DESCR
/end CHARACTERISTIC
/begin AXIS_PTS TDPS_SenseMAP " " 0x00144776 /* @ECU_Address@TDPS_SenseMAP@0x0219C000@ */ NO_INPUT_QUANTITY ECIPP_Lookup_SWORD 0 Compu_TDPS_SenseMAP 4 -128 127.99609375 /end AXIS_PTS
/begin AXIS_PTS TDPS_SenseRPM " " 0x0014477E /* @ECU_Address@TDPS_SenseRPM@0x0219B000@ */ NO_INPUT_QUANTITY ECIPP_Lookup_SWORD 0 Compu_TDPS_SenseRPM 6 -32768 32767 /end AXIS_PTS
/begin COMPU_METHOD Compu_TDPS_SenseLP "" FORM "%.1" "DP low-pass tau (ms)"
 /begin FORMULA "-0.5 / log(1 - (X1 / 65536))" FORMULA_INV "(1 - exp(-0.5/X1)) * 65536" /end FORMULA
/end COMPU_METHOD
/begin GROUP EC_Megajector "ECONTROLS" ROOT
 /begin REF_CHARACTERISTIC PN_MJ_eng_cal_mod FRT_est_xmin FRT_est_xmax FRT_est_tau FRT_est_ena FT_s IATs MJ_VVC_Tcrct_ena MJ_VVC_mount MJ_VVC_Pcrct_lt1 MJ_VVC_Pcrct_gt1 MJ_VVC_Cd_a MJ_VVC_Di MJ_VVC_Do MJ_VVC_Ao_m MJ_VVC_m_dia MJ_VVC_ks MJ_VVC_x0 MJ_VVC_xmax MJ_VVC_CdA_dia MJ_VVC_Vth MJ_VVC_Vdia_min MJ_VVC_damp MJ_VVC_stict MJ_VVC_stict_delta MJ_VVC_Pth_tau MJ_VVC_TIP_tau MJ_VVC_mdot_tau MJ_VVC_iterreq MJ_VVC_ena MJ_VVC_num_carbs EPRPF_Vent_min EPRPF_Vent_hyst EPRPF_Vent_dead EPRPF_ena EPRPF_period EPRPF_min_ton EPRPF_min_toff EPRPF_cbrk_trig EPRPF_obrk_trig EPRPF_brk_lptau MJ_azero_wt DPS_I_init DEPR_strtspk_ena DEPR_strtspk_hitrig DEPR_strtspk_lotrig DEPR_strtspk_cycles DEPR_strtspk_window MJ_VVC_Pcrct_TIP MJ_VVC_MAP_tau MJ_VVC_MAP_add CFV_fuel_calc CFV_mdot_FS CFV_dis_restrict CFV_Pdis_margin_kPa CFV_Pin_def_psig CFV_RLV_ena CFV_RLV_lockoff CFV_RLV_tmin_ena CFV_RLV_test_tmin CFV_RLV_testPeriod CFV_RLV_sstate_time CFV_RLV_charge_hold CFV_RLV_test_tout CFV_RLV_P_charge CFV_RLV_P_test_min CFV_RLV_P_trigger CFV_RLV_FPPslew CFV_RLV_mdot_pct_min CFV_RLV_mdot_pct_max CFV_RLV_LoadLim_min CFV_RLV_LoadLim_max CFV_RLV_Vbat_min CFV_RLV_ECT_min CFV_RLV_rpm_min CFV_RLV_rpm_max CFV_RLV_P_kPa_min CFV_RLV_P_kPa_max CFV_RLV_FPP_pct_max CFV_RLV_recover_time CFV_strtf_mult CFV_strtf_hold_cyc CFV_strtf_slew CFV_strtf_reset_tm LOD_flk_sd_tout LOD_throt_lim LOD_flk_retry_lim PN_MFG_eng_cal_mod MFG_mdot_FS MFG_dP_cyl_events MFG_enabled MFG_fuel_calc MFG_loc MFG_hsdata_tx_ena MFG_TPS_cmd_min MFG_TPS_cmd_max MFG_RLV_ena MFG_mdot_mult MFG_mdot_cmd_tau TDPS_SenseLP /end REF_CHARACTERISTIC
 /begin REF_MEASUREMENT MJI_flash_wr_left MJI_flash_wr_force MJI_cur_cal_mod MJ_param_differ MJ_param_upload MJ_intF_bits FRT MJ_VVC_mdot_a MJ_VVC_mdot_dia MJ_VVC_mdot_thtl MJ_VVC_mdot_ports MJ_VVC_TIP MJ_VVC_TIP_Pth MJ_VVC_Pdia MJ_VVC_Pth MJ_VVC_x MJ_VVC_x_ss MJ_VVC_TIP_Pthss MJ_VVC_Pcrct MJ_P_cmdnom MJ_VVC_Ts trim_TIPVd_load trim_TIPVd_TIPss trim_TIPVd_mult MJI_cur_SW_mod MJI_cur_HW_mod EPR_SenseLP MJ_P_cmdavg Vent_dP_cmd EPRPF_active EPRPF_inst_PW EPRPF_inst_mult MJ_azero_status DEPR_strtspk_active MJ_VVC_Pcrct_ss MJ_P_TIPnom mdot_f_valve_TPSf CFV_ctltype_cmd CFV_ctltype_act CFVI_flash_wr_left CFVI_flash_wr_force CFV_param_differ CFV_param_upload CFV_intF_bits CFV_cal_state CFV_P_man_DC CFV_x_man_DC CFV_param_NA_cnt CFV_RLV_HM_last_test CFV_RLV_HM_next_test MJ2_P_act MJ2_A_act MJ2_ctltype_act MJ2_status MJ2_intF_bits MJ2I_flash_wr_left MJ2I_cur_cal_mod MJ2I_cur_SW_mod MJ2I_cur_HW_mod MJ2_param_differ MJ2_param_upload MJ2I_flash_wr_force LOD_slk_state LOD_slk_test_tmr LOD_flk_state LOD_flk_test_tmr LOD_slk_warm_cycles LOD_flk_warm_cycles LOD_slk_eng_cycles LOD_flk_eng_cycles LOD_flk_test_run MFG_man_mode MFG_ctltype_cmd MFG_ctltype_act MFG_status MFGI_flash_wr_left MFGI_flash_wr_force MFGI_cur_cal_mod MFG_param_differ MFG_param_upload MFG_cal_state MFGI_cur_SW_mod MFGI_cur_HW_mod MFG_mdot_act_pct MFG_mdot_act MFG_mdot_cmd_pct MFG_mdot_cmd MFG_param_NA_cnt MFG_TPS_act_pct MFG_TPS_cmd_pct MFG_FTemp MFG_USPress MFG_DSPress MFG_DPPress MFG_dP_avg_window MFG_DPPress_Pcrct MFG_DPPress_final MFG_SD_mdot_cmd MFG_MFA_mdot_cmd MFG_hsdata_tx_act MFG_DSPress_slow MFG_DSPressdt MFG_DSPress_fast MFG_hsdata_active gammaf_act SGf_act MFG_fault_range_1 MFG_fault_range_2 MFG_RLV_cyc_elapsed MFG_RLV_HM_elapsed MFG_mdot_choke MFG_RLV_state MFG_VE_mdot_err MJ_choke_pct /end REF_MEASUREMENT
/end GROUP
/begin GROUP EC_Misfire "ECONTROLS" ROOT
 /begin REF_CHARACTERISTIC inj_kill_tout spk_kill_tout ICAV_ena ICAV_rdm_wt ICAV_adpt_wt ICAV_start_wait ICAV_ECT_ena ICAV_misdet_mult ICAV_adpt_K ICAV_cts_tau ICAV_thres_hist ICAV_rdm_rst ICAV_cid_num ICAV_cid_thres ICAV_adpt_dead ICAV_adpt_rolloff ICAV_wind_safe ICAV_wind_unsafe ICAV_adpt_Khi ICAV_adpt_Klo ICAV_miscyl_rst ICAV_thres_mult ICAV_nomis_lmt ICAV_transient_wt ICAV_dhist_tau ICAV_dhist_max ICAV_rpm_min ICAV_rpm_max ICAV_maL_min ICAV_maL_max ICAV_rdmtrans_wt ICAV_adpthst_load ICAV_dctsnrm_max ICAV_dctsnrm_wt ICAV_rmis_transwt ICAV_MAPdt_mult ICAV_rpmdt_mult ICAV_transx_wt ICAV_dgear_wt ICAV_idle_rpm ICAV_idle_hyst ICAV_idle_wt ICAV_idle_Kmult ICAV_VECWT_max ICAV_VECWT_min ICAV_KNK_max ICAV_diag_wt ICAV_dctsnrmi_max ICAV_hires_mult ICAV_adpt_hires ICAV_adpt_limit ICAV_cat_prot ICAV_cat_prot_fuel ICAV_OILT_src ICAV_adpt_flt_ena ICAV_cat_prot_2cyl ICAV_PTO_ena ICAV_PTO_rpm_max ICAV_PTO_MAPload_max TICAV_wdw_mult TICAV_thres_cts TICAV_thres_rdm TICAV_flt_trig TICAV_safe TICAV_thres_safe TICAV_MAPdt_off TICAV_rpmdt_off TICAV_OILT_min TICAV_OILT_max /end REF_CHARACTERISTIC
 /begin REF_MEASUREMENT spk_kill_mode spk_kill_pct spk_kill_cyl ICAV_status ICAV_sync_cnt ICAV_MAPdt_off ICAV_rpmdt_off ICAV_rpm_dt ICAV_pct_tau ICAV_thres_cts ICAV_thres_rdm ICAV_flt_trig ICAV_reset ICAV_pct_bk1 ICAV_pct_bk2 ICAV_pct_total ICAV_nrm_bk1 ICAV_nrm_bk2 ICAV_nrm_total ICAV_det_trig ICAV_cyc_cts inj_kill_mode ICAV_hist ICAV_thres_safe ICAV_safe ICAV_max_rdm ICAV_safe_cnt ICAV_safe_latch ICAV_LED_init ICAV_LED_safe ICAV_LED_adapt ICAV_LED_diag ICAV_LED_miss ICAV_LED_trans ICAV_cts_norm ICAV_rdm_norm ICAV_dhist ICAV_dctsnrm ICAV_LED_gear ICAV_LED_idle ICAV_cal_assist ICAV_cat_prot_act ICAV_adpt_flt /end REF_MEASUREMENT
/end GROUP
/begin GROUP EC_OEMEOLConf "ECONTROLS" ROOT
 /begin REF_CHARACTERISTIC RS_ena RS_speed_max RS_prop_V0 RS_prop_V1 RS_prop_RS0 RS_prop_RS1 /end REF_CHARACTERISTIC
 /begin REF_MEASUREMENT RS_prop_V /end REF_MEASUREMENT
/end GROUP
/begin GROUP EC_Outputs "ECONTROLS" ROOT
 /begin REF_CHARACTERISTIC ETHC_ena ETHC_cont_time ETHC_period ETHC_Kp ETHC_Kd cfgout_RPMon cfgout_MAPon cfgout_ECTon cfgout_RPMoff cfgout_MAPoff cfgout_ECToff cfgout_RPMlon cfgout_MAPlon cfgout_ECTlon cfgout_RPMloff cfgout_MAPloff cfgout_ECTloff cfgout_on_wait cfgout_off_wait cfgout_chan cfgout_stopped cfgout_cranking cfgout_running crank_lim_ena crank_lim_wt crank_rst_wt crank_total_lim cfgout_PD1lon cfgout_PU1lon cfgout_PD1loff cfgout_PU1loff cfgout_PD1on cfgout_PU1on cfgout_PD1off cfgout_PU1off cfgout2_RPMon cfgout2_MAPon cfgout2_ECTon cfgout2_RPMoff cfgout2_MAPoff cfgout2_ECToff cfgout2_RPMlon cfgout2_MAPlon cfgout2_ECTlon cfgout2_RPMloff cfgout2_MAPloff cfgout2_ECTloff cfgout2_on_wait cfgout2_off_wait cfgout2_chan cfgout2_stopped cfgout2_cranking cfgout2_running cfgout2_PD1lon cfgout2_PU1lon cfgout2_PD1loff cfgout2_PU1loff cfgout2_PD1on cfgout2_PU1on cfgout2_PD1off cfgout2_PU1off cfgout_OilPlon cfgout_OilPloff cfgout2_OilPlon cfgout2_OilPloff cfgout_OilPon cfgout_OilPoff cfgout2_OilPon cfgout2_OilPoff cfgout3_RPMon cfgout3_MAPon cfgout3_ECTon cfgout3_RPMoff cfgout3_MAPoff cfgout3_ECToff cfgout3_RPMlon cfgout3_MAPlon cfgout3_ECTlon cfgout3_RPMloff cfgout3_MAPloff cfgout3_ECTloff cfgout3_on_wait cfgout3_off_wait cfgout3_chan cfgout3_stopped cfgout3_cranking cfgout3_running cfgout3_PD1lon cfgout3_PU1lon cfgout3_PD1loff cfgout3_PU1loff cfgout3_PD1on cfgout3_PU1on cfgout3_PD1off cfgout3_PU1off cfgout3_OilPlon cfgout3_OilPloff cfgout3_OilPon cfgout3_OilPoff autocrk_trig SD_out_ena tach_mode tach_pprev TransFPP_ena TransFPP_per TransFPP_minDC TransFPP_maxDC MaxSetPt_actvlt MaxSetPt_appup_rpm MaxSetPt_appdn_rpm MSP_blkup_ont MSP_blkup_offt MSP_blkdn_ont MSP_blkdn_offt SWARN_chan HWARN_chan SWARNblk_on HWARNblk_on SWARNblk_off HWARNblk_off cfgout_DG1lon cfgout_DG1loff cfgout2_DG1lon cfgout2_DG1loff cfgout3_DG1lon cfgout3_DG1loff cfgout_DG1on cfgout_DG1off cfgout2_DG1on /end REF_CHARACTERISTIC
/end GROUP
/begin GROUP EC_Roadspeed "ECONTROLS" ROOT
 /begin REF_CHARACTERISTIC RS_ena RS_speed_max RS_prop_V0 RS_prop_V1 RS_prop_RS0 RS_prop_RS1 /end REF_CHARACTERISTIC
 /begin REF_MEASUREMENT RS_prop_V /end REF_MEASUREMENT
/end GROUP
/begin GROUP EC_Tests "ECONTROLS" ROOT /begin REF_CHARACTERISTIC inj_kill_tout spk_kill_tout ICAV_miscyl_rst /end REF_CHARACTERISTIC /begin REF_MEASUREMENT ICAV_LED_safe ICAV_LED_adapt ICAV_LED_diag ICAV_LED_miss /end REF_MEASUREMENT /end GROUP
/begin GROUP EC_VECal "ECONTROLS" ROOT /begin REF_MEASUREMENT FRT mdot_f_valve_TPSf /end REF_MEASUREMENT /end GROUP
/end MODULE
/end PROJECT
