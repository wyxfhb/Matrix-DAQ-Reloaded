ASAP2_VERSION 1 61
/begin PROJECT Econtrols_4G "4G Test"
/begin HEADER "4G A2L Configuration" PROJECT_NO EControls4G /* config for version control */ VERSION "$Revision: 82130 $:" /* config for version control */ /end HEADER
/begin MODULE EControls_4G_SH2A "EControls 4G"
/begin MOD_COMMON "" DEPOSIT ABSOLUTE BYTE_ORDER MSB_FIRST /end MOD_COMMON
/* Define the Record Layouts */
/begin RECORD_LAYOUT ECIPP_ALIGNMENT_UBYTE FNC_VALUES 1 UBYTE COLUMN_DIR DIRECT /end RECORD_LAYOUT
/begin RECORD_LAYOUT ECIPP_ALIGNMENT_SBYTE FNC_VALUES 1 SBYTE COLUMN_DIR DIRECT /end RECORD_LAYOUT
/begin RECORD_LAYOUT ECIPP_Lookup_SBYTE AXIS_PTS_X 1 SBYTE INDEX_INCR DIRECT /end RECORD_LAYOUT
/begin RECORD_LAYOUT ECIPP_ALIGNMENT_UWORD FNC_VALUES 1 UWORD COLUMN_DIR DIRECT /end RECORD_LAYOUT
/begin RECORD_LAYOUT ECIPP_ALIGNMENT_SWORD FNC_VALUES 1 SWORD COLUMN_DIR DIRECT /end RECORD_LAYOUT
/begin RECORD_LAYOUT ECIPP_ALIGNMENT_ULONG FNC_VALUES 1 ULONG COLUMN_DIR DIRECT /end RECORD_LAYOUT
/begin RECORD_LAYOUT ECIPP_ALIGNMENT_FLOAT32_IEEE FNC_VALUES 1 FLOAT32_IEEE COLUMN_DIR DIRECT /end RECORD_LAYOUT
/begin CHARACTERISTIC BPS1_max "FaultConfig # BPS1_max (Fault Condition:BPS1 voltage >)" VALUE 0x00148FB8 /* @ECU_Address@BPS1_max@0x01009DE0@ */ ECIPP_ALIGNMENT_UWORD 5 Compu_BPS1_max 0 5.00114468864469 /end CHARACTERISTIC
/begin COMPU_METHOD Compu_BPS1_max " " RAT_FUNC "%.3" "volts" COEFFS 0 13104 0 0 0 1 /end COMPU_METHOD
/begin CHARACTERISTIC BPS2_min "FaultConfig # BPS2_min (Fault Condition:BPS2 voltage <)" VALUE 0x00148FBA /* @ECU_Address@BPS2_min@0x01009DE8@ */ ECIPP_ALIGNMENT_UWORD 5 Compu_BPS2_min 0 5.00114468864469 /end CHARACTERISTIC
/begin COMPU_METHOD Compu_BPS2_min " " RAT_FUNC "%.3" "volts" COEFFS 0 13104 0 0 0 1 /end COMPU_METHOD
/begin CHARACTERISTIC BPS2_max "FaultConfig # BPS2_max (Fault Condition:BPS2 voltage >)" VALUE 0x00148FBC /* @ECU_Address@BPS2_max@0x01009DF0@ */ ECIPP_ALIGNMENT_UWORD 5 Compu_BPS2_max 0 5.00114468864469 /end CHARACTERISTIC
/begin COMPU_METHOD Compu_BPS2_max " " RAT_FUNC "%.3" "volts" COEFFS 0 13104 0 0 0 1 /end COMPU_METHOD
/begin CHARACTERISTIC BPS12pct_hi "FaultConfig # BPS12pct_hi (Fault Condition:(BPS1% - BPS2%) >)" VALUE 0x00148FBE /* @ECU_Address@BPS12pct_hi@0x01009DF8@ */ ECIPP_ALIGNMENT_SWORD 100 Compu_BPS12pct_hi -100 99.9969482421875 /end CHARACTERISTIC
/begin COMPU_METHOD Compu_BPS12pct_hi " " RAT_FUNC "%.3" "%" COEFFS 0 327.68 0 0 0 1 /end COMPU_METHOD
/begin CHARACTERISTIC BPS12pct_lo "FaultConfig # BPS12pct_lo (Fault Condition:(BPS1% - BPS2%) <)" VALUE 0x00148FC0 /* @ECU_Address@BPS12pct_lo@0x01009E00@ */ ECIPP_ALIGNMENT_SWORD 100 Compu_BPS12pct_lo -100 99.9969482421875 /end CHARACTERISTIC
/begin COMPU_METHOD Compu_BPS12pct_lo " " RAT_FUNC "%.3" "%" COEFFS 0 327.68 0 0 0 1 /end COMPU_METHOD
/begin CHARACTERISTIC BPSerr_pos "FaultConfig # BPSerr_pos (Fault Condition:(target BPS - actual BPS) >)" VALUE 0x00148FC2 /* @ECU_Address@BPSerr_pos@0x01009E08@ */ ECIPP_ALIGNMENT_SWORD 100 Compu_BPSerr_pos -100 99.9969482421875 /end CHARACTERISTIC
/begin COMPU_METHOD Compu_BPSerr_pos " " RAT_FUNC "%.3" "%" COEFFS 0 327.68 0 0 0 1 /end COMPU_METHOD
/begin CHARACTERISTIC BPSerr_neg "FaultConfig # BPSerr_neg (Fault Condition:(target BPS - actual BPS) <)" VALUE 0x00148FC4 /* @ECU_Address@BPSerr_neg@0x01009E10@ */ ECIPP_ALIGNMENT_SWORD 100 Compu_BPSerr_neg -100 99.9969482421875 /end CHARACTERISTIC
/begin COMPU_METHOD Compu_BPSerr_neg " " RAT_FUNC "%.3" "%" COEFFS 0 327.68 0 0 0 1 /end COMPU_METHOD
/begin CHARACTERISTIC BPSerr_wait "FaultConfig # BPSerr_wait (Fault Condition:persistently longer than)" VALUE 0x00148FC6 /* @ECU_Address@BPSerr_wait@0x01009E18@ */ ECIPP_ALIGNMENT_UWORD 65535 Compu_BPSerr_wait 0 65535 /end CHARACTERISTIC
/begin COMPU_METHOD Compu_BPSerr_wait " " RAT_FUNC "%.0" "ms" COEFFS 0 1 0 0 0 1 /end COMPU_METHOD
/begin CHARACTERISTIC BPSerr_minVbat "FaultConfig # BPSerr_minVbat (Fault Condition:while battery voltage >)" VALUE 0x00148FC8 /* @ECU_Address@BPSerr_minVbat@0x01009E20@ */ ECIPP_ALIGNMENT_UWORD 256 Compu_BPSerr_minVbat 0 255.99609375 /end CHARACTERISTIC
/begin COMPU_METHOD Compu_BPSerr_minVbat " " RAT_FUNC "%.3" "volts" COEFFS 0 256 0 0 0 1 /end COMPU_METHOD
/begin CHARACTERISTIC DBW2_output "{DBW2_output&0xff=0:Disabled}{DBW2_output&0xff=1:H-bridge A}{DBW2_output&0xff=2:H-bridge B}" VALUE 0x00147d0c /* @ECU_Address@DBW2_output@0x0100A038@ */ ECIPP_ALIGNMENT_UBYTE 255 DBW2_output_COMPU_VTAB 0 255 BIT_MASK 0xff /end CHARACTERISTIC
/begin COMPU_METHOD DBW2_output_COMPU_VTAB "Verbal Table" TAB_VERB "%.0" "list" COMPU_TAB_REF DBW2_output_COMPU_VTAB_REF /end COMPU_METHOD
/begin COMPU_VTAB DBW2_output_COMPU_VTAB_REF "Verbal Table" TAB_VERB 3 0 "Disabled" 1 "H-bridge A" 2 "H-bridge B" DEFAULT_VALUE "UNKNOWN" /end COMPU_VTAB
/begin CHARACTERISTIC OILT_Taux_cal "{OILT_Taux_cal&0xff=0:Fuel source}{OILT_Taux_cal&0xff=1:Exhaust manifold/riser}{OILT_Taux_cal&0xff=2:Aux Temp A}{OILT_Taux_cal&0xff=3:Aux Temp B}{OILT_Taux_cal&0xff=4:Aux Temp C}{OILT_Taux_cal&0xff=5:Aux Temp D}" VALUE 0x00147ea2 /* @ECU_Address@OILT_Taux_cal@0x0100A1D0@ */ ECIPP_ALIGNMENT_UBYTE 255 OILT_Taux_cal_COMPU_VTAB 0 255 BIT_MASK 0xff /end CHARACTERISTIC
/begin COMPU_METHOD OILT_Taux_cal_COMPU_VTAB "Verbal Table" TAB_VERB "%.0" "list" COMPU_TAB_REF OILT_Taux_cal_COMPU_VTAB_REF /end COMPU_METHOD
/begin COMPU_VTAB OILT_Taux_cal_COMPU_VTAB_REF "Verbal Table" TAB_VERB 6 0 "Fuel source" 1 "Exhaust manifold/riser" 2 "Aux Temp A" 3 "Aux Temp B" 4 "Aux Temp C" 5 "Aux Temp D" DEFAULT_VALUE "UNKNOWN" /end COMPU_VTAB
/begin CHARACTERISTIC OILT_vdr "IOConfig # OILT_vdr" VALUE 0x001439d8 /* @ECU_Address@OILT_vdr@0x0100A1D8@ */ ECIPP_ALIGNMENT_FLOAT32_IEEE 10000000000 Compu_OILT_vdr -10000000000 10000000000 /end CHARACTERISTIC
/begin COMPU_METHOD Compu_OILT_vdr " " RAT_FUNC "%.3" "ohms" COEFFS 0 1 0 0 0 1 /end COMPU_METHOD
/begin CHARACTERISTIC engine_type "{engine_type&0xff=0:Spark-ignited non-DI}{engine_type&0xff=1:Common-rail diesel}{engine_type&0xff=2:Spark-ignited CRDI}" VALUE 0x0014815b /* @ECU_Address@engine_type@0x0100A2D0@ */ ECIPP_ALIGNMENT_UBYTE 255 engine_type_COMPU_VTAB 0 255 BIT_MASK 0xff /end CHARACTERISTIC
/begin COMPU_METHOD engine_type_COMPU_VTAB "Verbal Table" TAB_VERB "%.0" "list" COMPU_TAB_REF engine_type_COMPU_VTAB_REF /end COMPU_METHOD
/begin COMPU_VTAB engine_type_COMPU_VTAB_REF "Verbal Table" TAB_VERB 3 0 "Spark-ignited non-DI" 1 "Common-rail diesel" 2 "Spark-ignited CRDI" DEFAULT_VALUE "UNKNOWN" /end COMPU_VTAB
/begin CHARACTERISTIC module_load_diesel "General # module_load_diesel" VALUE 0x0016c32d /* @ECU_Address@module_load_diesel@0x0100B120@ */ ECIPP_ALIGNMENT_UBYTE 255 Compu_module_load_diesel 0 255 /end CHARACTERISTIC
/begin COMPU_METHOD Compu_module_load_diesel " " RAT_FUNC "%.0" "-" COEFFS 0 1 0 0 0 1 /end COMPU_METHOD
/begin CHARACTERISTIC module_load_EGR "General # module_load_EGR" VALUE 0x0016c32a /* @ECU_Address@module_load_EGR@0x0100B128@ */ ECIPP_ALIGNMENT_UBYTE 255 Compu_module_load_EGR 0 255 /end CHARACTERISTIC
/begin COMPU_METHOD Compu_module_load_EGR " " RAT_FUNC "%.0" "-" COEFFS 0 1 0 0 0 1 /end COMPU_METHOD
/begin CHARACTERISTIC module_load_gasoline "General # module_load_gasoline" VALUE 0x0016c32e /* @ECU_Address@module_load_gasoline@0x0100B130@ */ ECIPP_ALIGNMENT_UBYTE 255 Compu_module_load_gasoline 0 255 /end CHARACTERISTIC
/begin COMPU_METHOD Compu_module_load_gasoline " " RAT_FUNC "%.0" "-" COEFFS 0 1 0 0 0 1 /end COMPU_METHOD
/begin CHARACTERISTIC module_load_LPG "General # module_load_LPG" VALUE 0x0016c32b /* @ECU_Address@module_load_LPG@0x0100B138@ */ ECIPP_ALIGNMENT_UBYTE 255 Compu_module_load_LPG 0 255 /end CHARACTERISTIC
/begin COMPU_METHOD Compu_module_load_LPG " " RAT_FUNC "%.0" "-" COEFFS 0 1 0 0 0 1 /end COMPU_METHOD
/begin CHARACTERISTIC module_load_NG "General # module_load_NG" VALUE 0x0016c32c /* @ECU_Address@module_load_NG@0x0100B140@ */ ECIPP_ALIGNMENT_UBYTE 255 Compu_module_load_NG 0 255 /end CHARACTERISTIC
/begin COMPU_METHOD Compu_module_load_NG " " RAT_FUNC "%.0" "-" COEFFS 0 1 0 0 0 1 /end COMPU_METHOD
/begin CHARACTERISTIC module_load_knock "General # module_load_knock" VALUE 0x0016c32f /* @ECU_Address@module_load_knock@0x0100B148@ */ ECIPP_ALIGNMENT_UBYTE 255 Compu_module_load_knock 0 255 /end CHARACTERISTIC
/begin COMPU_METHOD Compu_module_load_knock " " RAT_FUNC "%.0" "-" COEFFS 0 1 0 0 0 1 /end COMPU_METHOD
/begin MEASUREMENT UEGO1_hours "UEGO hours" ULONG Compu_UEGO1_hours 0 0 0 1193046.47083333 ECU_ADDRESS 0x0100B230 /end MEASUREMENT
/begin COMPU_METHOD Compu_UEGO1_hours " " RAT_FUNC "%.3" "hours" COEFFS 0 3600 0 0 0 1 /end COMPU_METHOD
/begin MEASUREMENT UEGO2_hours "UEGO hours" ULONG Compu_UEGO2_hours 0 0 0 1193046.47083333 ECU_ADDRESS 0x0100B238 /end MEASUREMENT
/begin COMPU_METHOD Compu_UEGO2_hours " " RAT_FUNC "%.3" "hours" COEFFS 0 3600 0 0 0 1 /end COMPU_METHOD
/begin MEASUREMENT UEGO1_drift_accum "UEGO drift compensation accum" SLONG Compu_UEGO1_drift_accum 0 0 -100 99.9999999534339 ECU_ADDRESS 0x0100B240 /end MEASUREMENT
/begin COMPU_METHOD Compu_UEGO1_drift_accum " " RAT_FUNC "%.2" "% Ip" COEFFS 0 21474836.48 0 0 0 1 /end COMPU_METHOD
/begin MEASUREMENT UEGO2_drift_accum "UEGO drift compensation accum" SLONG Compu_UEGO2_drift_accum 0 0 -100 99.9999999534339 ECU_ADDRESS 0x0100B248 /end MEASUREMENT
/begin COMPU_METHOD Compu_UEGO2_drift_accum " " RAT_FUNC "%.2" "% Ip" COEFFS 0 21474836.48 0 0 0 1 /end COMPU_METHOD
/begin MEASUREMENT UEGO1_drift_hours "UEGO drift time since sample" ULONG Compu_UEGO1_drift_hours 0 0 0 1193046.47083333 ECU_ADDRESS 0x0100B250 /end MEASUREMENT
/begin COMPU_METHOD Compu_UEGO1_drift_hours " " RAT_FUNC "%.3" "hours" COEFFS 0 3600 0 0 0 1 /end COMPU_METHOD
/begin MEASUREMENT UEGO2_drift_hours "UEGO drift time since sample" ULONG Compu_UEGO2_drift_hours 0 0 0 1193046.47083333 ECU_ADDRESS 0x0100B258 /end MEASUREMENT
/begin COMPU_METHOD Compu_UEGO2_drift_hours " " RAT_FUNC "%.3" "hours" COEFFS 0 3600 0 0 0 1 /end COMPU_METHOD
/begin MEASUREMENT UEGO1_recvr_seconds "UEGO time since last recovery" ULONG Compu_UEGO1_recvr_seconds 0 0 0 1193046.47083333 ECU_ADDRESS 0x0100B2A8 /end MEASUREMENT
/begin COMPU_METHOD Compu_UEGO1_recvr_seconds " " RAT_FUNC "%.3" "hours" COEFFS 0 3600 0 0 0 1 /end COMPU_METHOD
/begin MEASUREMENT UEGO2_recvr_seconds "UEGO time since last recovery" ULONG Compu_UEGO2_recvr_seconds 0 0 0 1193046.47083333 ECU_ADDRESS 0x0100B2B0 /end MEASUREMENT
/begin COMPU_METHOD Compu_UEGO2_recvr_seconds " " RAT_FUNC "%.3" "hours" COEFFS 0 3600 0 0 0 1 /end COMPU_METHOD
/begin MEASUREMENT UEGO1_drift_success "UEGO1 drift successful samples" ULONG Compu_UEGO1_drift_success 0 0 0 4294967295 ECU_ADDRESS 0x0100B440 /end MEASUREMENT
/begin COMPU_METHOD Compu_UEGO1_drift_success " " RAT_FUNC "%.0" "-" COEFFS 0 1 0 0 0 1 /end COMPU_METHOD
/begin MEASUREMENT UEGO1_drift_aborted "UEGO1 drift aborted samples" ULONG Compu_UEGO1_drift_aborted 0 0 0 4294967295 ECU_ADDRESS 0x0100B448 /end MEASUREMENT
/begin COMPU_METHOD Compu_UEGO1_drift_aborted " " RAT_FUNC "%.0" "-" COEFFS 0 1 0 0 0 1 /end COMPU_METHOD
/begin MEASUREMENT UEGO2_drift_success "UEGO2 drift successful samples" ULONG Compu_UEGO2_drift_success 0 0 0 4294967295 ECU_ADDRESS 0x0100B450 /end MEASUREMENT
/begin COMPU_METHOD Compu_UEGO2_drift_success " " RAT_FUNC "%.0" "-" COEFFS 0 1 0 0 0 1 /end COMPU_METHOD
/begin MEASUREMENT UEGO2_drift_aborted "UEGO2 drift aborted samples" ULONG Compu_UEGO2_drift_aborted 0 0 0 4294967295 ECU_ADDRESS 0x0100B458 /end MEASUREMENT
/begin COMPU_METHOD Compu_UEGO2_drift_aborted " " RAT_FUNC "%.0" "-" COEFFS 0 1 0 0 0 1 /end COMPU_METHOD
/begin CHARACTERISTIC KNK_retardlmt_RPM "FaultConfig # KNK_retardlmt_RPM (Fault Condition:RPM >)" VALUE 0x00147534 /* @ECU_Address@KNK_retardlmt_RPM@0x0100B460@ */ ECIPP_ALIGNMENT_UWORD 65535 Compu_KNK_retardlmt_RPM 0 65535 /end CHARACTERISTIC
/begin COMPU_METHOD Compu_KNK_retardlmt_RPM " " RAT_FUNC "%.0" "rpm" COEFFS 0 1 0 0 0 1 /end COMPU_METHOD
/begin CHARACTERISTIC KNK_retardlmt_MAP "FaultConfig # KNK_retardlmt_MAP (Fault Condition:and MAP >)" VALUE 0x0014752c /* @ECU_Address@KNK_retardlmt_MAP@0x0100B468@ */ ECIPP_ALIGNMENT_UWORD 256 Compu_KNK_retardlmt_MAP 0 255.99609375 /end CHARACTERISTIC
/begin COMPU_METHOD Compu_KNK_retardlmt_MAP " " RAT_FUNC "%.3" "psia" COEFFS 0 256 0 0 0 1 /end COMPU_METHOD
/begin CHARACTERISTIC UGF1_drift_min "FaultConfig # UGF1_drift_min (Fault Condition:UEGO1 drift compensation accumulator <)" VALUE 0x00146552 /* @ECU_Address@UGF1_drift_min@0x0100B470@ */ ECIPP_ALIGNMENT_SWORD 100 Compu_UGF1_drift_min -100 99.9969482421875 /end CHARACTERISTIC
/begin COMPU_METHOD Compu_UGF1_drift_min " " RAT_FUNC "%.3" "% Ip" COEFFS 0 327.68 0 0 0 1 /end COMPU_METHOD
/begin CHARACTERISTIC UGF1_drift_max "FaultConfig # UGF1_drift_max (Fault Condition:or >)" VALUE 0x0014654e /* @ECU_Address@UGF1_drift_max@0x0100B478@ */ ECIPP_ALIGNMENT_SWORD 100 Compu_UGF1_drift_max -100 99.9969482421875 /end CHARACTERISTIC
/begin COMPU_METHOD Compu_UGF1_drift_max " " RAT_FUNC "%.3" "% Ip" COEFFS 0 327.68 0 0 0 1 /end COMPU_METHOD
/begin CHARACTERISTIC UGF2_drift_min "FaultConfig # UGF2_drift_min (Fault Condition:UEGO2 drift compensation accumulator <)" VALUE 0x0014655a /* @ECU_Address@UGF2_drift_min@0x0100B480@ */ ECIPP_ALIGNMENT_SWORD 100 Compu_UGF2_drift_min -100 99.9969482421875 /end CHARACTERISTIC
/begin COMPU_METHOD Compu_UGF2_drift_min " " RAT_FUNC "%.3" "% Ip" COEFFS 0 327.68 0 0 0 1 /end COMPU_METHOD
/begin CHARACTERISTIC UGF2_drift_max "FaultConfig # UGF2_drift_max (Fault Condition:or >)" VALUE 0x00146556 /* @ECU_Address@UGF2_drift_max@0x0100B488@ */ ECIPP_ALIGNMENT_SWORD 100 Compu_UGF2_drift_max -100 99.9969482421875 /end CHARACTERISTIC
/begin COMPU_METHOD Compu_UGF2_drift_max " " RAT_FUNC "%.3" "% Ip" COEFFS 0 327.68 0 0 0 1 /end COMPU_METHOD
/begin CHARACTERISTIC VE5c_max "FaultConfig # VE5c_max (Fault Condition:5VE3 >)" VALUE 0x001650d0 /* @ECU_Address@VE5c_max@0x0100B4C0@ */ ECIPP_ALIGNMENT_UWORD 6 Compu_VE5c_max 0 5.50125915750916 /end CHARACTERISTIC
/begin COMPU_METHOD Compu_VE5c_max " " RAT_FUNC "%.3" "volts" COEFFS 0 11912.7272727273 0 0 0 1 /end COMPU_METHOD
/begin CHARACTERISTIC VE5c_min "FaultConfig # VE5c_min (Fault Condition:5VE3 <)" VALUE 0x001650d2 /* @ECU_Address@VE5c_min@0x0100B4C8@ */ ECIPP_ALIGNMENT_UWORD 6 Compu_VE5c_min 0 5.50125915750916 /end CHARACTERISTIC
/begin COMPU_METHOD Compu_VE5c_min " " RAT_FUNC "%.3" "volts" COEFFS 0 11912.7272727273 0 0 0 1 /end COMPU_METHOD
/begin CHARACTERISTIC module_load_CRI "General # module_load_CRI" VALUE 0x0016c328 /* @ECU_Address@module_load_CRI@0x0100B530@ */ ECIPP_ALIGNMENT_UBYTE 255 Compu_module_load_CRI 0 255 /end CHARACTERISTIC
/begin COMPU_METHOD Compu_module_load_CRI " " RAT_FUNC "%.0" "-" COEFFS 0 1 0 0 0 1 /end COMPU_METHOD
/begin CHARACTERISTIC PAUX9_Paux_cal "{PAUX9_Paux_cal&0xff=0:Aux Press A}{PAUX9_Paux_cal&0xff=1:Aux Press B}{PAUX9_Paux_cal&0xff=2:Aux Press C}{PAUX9_Paux_cal&0xff=3:Aux Press D}" VALUE 0x00147EB5 /* @ECU_Address@PAUX9_Paux_cal@0x0100BA40@ */ ECIPP_ALIGNMENT_UBYTE 255 PAUX9_Paux_cal_COMPU_VTAB 0 255 BIT_MASK 0xff /end CHARACTERISTIC
/begin COMPU_METHOD PAUX9_Paux_cal_COMPU_VTAB "Verbal Table" TAB_VERB "%.0" "list" COMPU_TAB_REF PAUX9_Paux_cal_COMPU_VTAB_REF /end COMPU_METHOD
/begin COMPU_VTAB PAUX9_Paux_cal_COMPU_VTAB_REF "Verbal Table" TAB_VERB 4 0 "Aux Press A" 1 "Aux Press B" 2 "Aux Press C" 3 "Aux Press D" DEFAULT_VALUE "UNKNOWN" /end COMPU_VTAB
/begin CHARACTERISTIC PAUX10_Paux_cal "{PAUX10_Paux_cal&0xff=0:Aux Press A}{PAUX10_Paux_cal&0xff=1:Aux Press B}{PAUX10_Paux_cal&0xff=2:Aux Press C}{PAUX10_Paux_cal&0xff=3:Aux Press D}" VALUE 0x00147EB6 /* @ECU_Address@PAUX10_Paux_cal@0x0100BA48@ */ ECIPP_ALIGNMENT_UBYTE 255 PAUX10_Paux_cal_COMPU_VTAB 0 255 BIT_MASK 0xff /end CHARACTERISTIC
/begin COMPU_METHOD PAUX10_Paux_cal_COMPU_VTAB "Verbal Table" TAB_VERB "%.0" "list" COMPU_TAB_REF PAUX10_Paux_cal_COMPU_VTAB_REF /end COMPU_METHOD
/begin COMPU_VTAB PAUX10_Paux_cal_COMPU_VTAB_REF "Verbal Table" TAB_VERB 4 0 "Aux Press A" 1 "Aux Press B" 2 "Aux Press C" 3 "Aux Press D" DEFAULT_VALUE "UNKNOWN" /end COMPU_VTAB
/begin CHARACTERISTIC PAUX11_Paux_cal "{PAUX11_Paux_cal&0xff=0:Aux Press A}{PAUX11_Paux_cal&0xff=1:Aux Press B}{PAUX11_Paux_cal&0xff=2:Aux Press C}{PAUX11_Paux_cal&0xff=3:Aux Press D}" VALUE 0x00147EB7 /* @ECU_Address@PAUX11_Paux_cal@0x0100BA50@ */ ECIPP_ALIGNMENT_UBYTE 255 PAUX11_Paux_cal_COMPU_VTAB 0 255 BIT_MASK 0xff /end CHARACTERISTIC
/begin COMPU_METHOD PAUX11_Paux_cal_COMPU_VTAB "Verbal Table" TAB_VERB "%.0" "list" COMPU_TAB_REF PAUX11_Paux_cal_COMPU_VTAB_REF /end COMPU_METHOD
/begin COMPU_VTAB PAUX11_Paux_cal_COMPU_VTAB_REF "Verbal Table" TAB_VERB 4 0 "Aux Press A" 1 "Aux Press B" 2 "Aux Press C" 3 "Aux Press D" DEFAULT_VALUE "UNKNOWN" /end COMPU_VTAB
/begin CHARACTERISTIC PAUX12_Paux_cal "{PAUX12_Paux_cal&0xff=0:Aux Press A}{PAUX12_Paux_cal&0xff=1:Aux Press B}{PAUX12_Paux_cal&0xff=2:Aux Press C}{PAUX12_Paux_cal&0xff=3:Aux Press D}" VALUE 0x00147EB8 /* @ECU_Address@PAUX12_Paux_cal@0x0100BA58@ */ ECIPP_ALIGNMENT_UBYTE 255 PAUX12_Paux_cal_COMPU_VTAB 0 255 BIT_MASK 0xff /end CHARACTERISTIC
/begin COMPU_METHOD PAUX12_Paux_cal_COMPU_VTAB "Verbal Table" TAB_VERB "%.0" "list" COMPU_TAB_REF PAUX12_Paux_cal_COMPU_VTAB_REF /end COMPU_METHOD
/begin COMPU_VTAB PAUX12_Paux_cal_COMPU_VTAB_REF "Verbal Table" TAB_VERB 4 0 "Aux Press A" 1 "Aux Press B" 2 "Aux Press C" 3 "Aux Press D" DEFAULT_VALUE "UNKNOWN" /end COMPU_VTAB
/begin CHARACTERISTIC PAUX13_Paux_cal "{PAUX13_Paux_cal&0xff=0:Aux Press A}{PAUX13_Paux_cal&0xff=1:Aux Press B}{PAUX13_Paux_cal&0xff=2:Aux Press C}{PAUX13_Paux_cal&0xff=3:Aux Press D}" VALUE 0x00147EB9 /* @ECU_Address@PAUX13_Paux_cal@0x0100BA60@ */ ECIPP_ALIGNMENT_UBYTE 255 PAUX13_Paux_cal_COMPU_VTAB 0 255 BIT_MASK 0xff /end CHARACTERISTIC
/begin COMPU_METHOD PAUX13_Paux_cal_COMPU_VTAB "Verbal Table" TAB_VERB "%.0" "list" COMPU_TAB_REF PAUX13_Paux_cal_COMPU_VTAB_REF /end COMPU_METHOD
/begin COMPU_VTAB PAUX13_Paux_cal_COMPU_VTAB_REF "Verbal Table" TAB_VERB 4 0 "Aux Press A" 1 "Aux Press B" 2 "Aux Press C" 3 "Aux Press D" DEFAULT_VALUE "UNKNOWN" /end COMPU_VTAB
/begin CHARACTERISTIC PAUX14_Paux_cal "{PAUX14_Paux_cal&0xff=0:Aux Press A}{PAUX14_Paux_cal&0xff=1:Aux Press B}{PAUX14_Paux_cal&0xff=2:Aux Press C}{PAUX14_Paux_cal&0xff=3:Aux Press D}" VALUE 0x00147EBA /* @ECU_Address@PAUX14_Paux_cal@0x0100BA68@ */ ECIPP_ALIGNMENT_UBYTE 255 PAUX14_Paux_cal_COMPU_VTAB 0 255 BIT_MASK 0xff /end CHARACTERISTIC
/begin COMPU_METHOD PAUX14_Paux_cal_COMPU_VTAB "Verbal Table" TAB_VERB "%.0" "list" COMPU_TAB_REF PAUX14_Paux_cal_COMPU_VTAB_REF /end COMPU_METHOD
/begin COMPU_VTAB PAUX14_Paux_cal_COMPU_VTAB_REF "Verbal Table" TAB_VERB 4 0 "Aux Press A" 1 "Aux Press B" 2 "Aux Press C" 3 "Aux Press D" DEFAULT_VALUE "UNKNOWN" /end COMPU_VTAB
/begin CHARACTERISTIC PAUX15_Paux_cal "{PAUX15_Paux_cal&0xff=0:Aux Press A}{PAUX15_Paux_cal&0xff=1:Aux Press B}{PAUX15_Paux_cal&0xff=2:Aux Press C}{PAUX15_Paux_cal&0xff=3:Aux Press D}" VALUE 0x00147EBB /* @ECU_Address@PAUX15_Paux_cal@0x0100BA70@ */ ECIPP_ALIGNMENT_UBYTE 255 PAUX15_Paux_cal_COMPU_VTAB 0 255 BIT_MASK 0xff /end CHARACTERISTIC
/begin COMPU_METHOD PAUX15_Paux_cal_COMPU_VTAB "Verbal Table" TAB_VERB "%.0" "list" COMPU_TAB_REF PAUX15_Paux_cal_COMPU_VTAB_REF /end COMPU_METHOD
/begin COMPU_VTAB PAUX15_Paux_cal_COMPU_VTAB_REF "Verbal Table" TAB_VERB 4 0 "Aux Press A" 1 "Aux Press B" 2 "Aux Press C" 3 "Aux Press D" DEFAULT_VALUE "UNKNOWN" /end COMPU_VTAB
/begin CHARACTERISTIC PAUX16_Paux_cal "{PAUX16_Paux_cal&0xff=0:Aux Press A}{PAUX16_Paux_cal&0xff=1:Aux Press B}{PAUX16_Paux_cal&0xff=2:Aux Press C}{PAUX16_Paux_cal&0xff=3:Aux Press D}" VALUE 0x00147EBC /* @ECU_Address@PAUX16_Paux_cal@0x0100BA78@ */ ECIPP_ALIGNMENT_UBYTE 255 PAUX16_Paux_cal_COMPU_VTAB 0 255 BIT_MASK 0xff /end CHARACTERISTIC
/begin COMPU_METHOD PAUX16_Paux_cal_COMPU_VTAB "Verbal Table" TAB_VERB "%.0" "list" COMPU_TAB_REF PAUX16_Paux_cal_COMPU_VTAB_REF /end COMPU_METHOD
/begin COMPU_VTAB PAUX16_Paux_cal_COMPU_VTAB_REF "Verbal Table" TAB_VERB 4 0 "Aux Press A" 1 "Aux Press B" 2 "Aux Press C" 3 "Aux Press D" DEFAULT_VALUE "UNKNOWN" /end COMPU_VTAB
/begin CHARACTERISTIC PAUX9_ena "{PAUX9_ena&0xff=0:Disabled}{PAUX9_ena&0xff=1:Aux PD1}{PAUX9_ena&0xff=2:Aux PD2}{PAUX9_ena&0xff=3:Aux PD3}{PAUX9_ena&0xff=4:Aux PUD1}{PAUX9_ena&0xff=5:Aux PUD2}{PAUX9_ena&0xff=6:Aux PUD3}{PAUX9_ena&0xff=7:Aux PUD4}{PAUX9_ena&0xff=8:Aux PUD5}{PAUX9_ena&0xff" VALUE 0x00147EC5 /* @ECU_Address@PAUX9_ena@0x0100BA80@ */ ECIPP_ALIGNMENT_UBYTE 255 PAUX9_ena_COMPU_VTAB 0 255 BIT_MASK 0xff /end CHARACTERISTIC
/begin COMPU_METHOD PAUX9_ena_COMPU_VTAB "Verbal Table" TAB_VERB "%.0" "list" COMPU_TAB_REF PAUX9_ena_COMPU_VTAB_REF /end COMPU_METHOD
/begin COMPU_VTAB PAUX9_ena_COMPU_VTAB_REF "Verbal Table" TAB_VERB 31 0 "Disabled" 1 "Aux PD1" 2 "Aux PD2" 3 "Aux PD3" 4 "Aux PUD1" 5 "Aux PUD2" 6 "Aux PUD3" 7 "Aux PUD4" 8 "Aux PUD5" 9 "Aux PUD6" 10 "Aux PUD7" 11 "Aux PUD8" 12 "Aux PUD9" 13 "Aux PUD10" 14 "Aux PUD11" 15 "Aux PUD12" 16 "Aux PUD13" 17 "Aux PUD14" 18 "Aux PUD15" 19 "CAN sourced" 20 "FPP2 Input" 21 "Aux PUD16" 22 "Aux PUD17" 23 "Aux PUD18" 24 "Aux PUD19" 25 "Aux PUD20" 26 "Aux PUD21" 27 "Aux PUD22" 28 "Aux PUD23" 29 "Aux PUD24" 30 "Aux PUD25" DEFAULT_VALUE "UNKNOWN" /end COMPU_VTAB
/begin CHARACTERISTIC PAUX10_ena "{PAUX10_ena&0xff=0:Disabled}{PAUX10_ena&0xff=1:Aux PD1}{PAUX10_ena&0xff=2:Aux PD2}{PAUX10_ena&0xff=3:Aux PD3}{PAUX10_ena&0xff=4:Aux PUD1}{PAUX10_ena&0xff=5:Aux PUD2}{PAUX10_ena&0xff=6:Aux PUD3}{PAUX10_ena&0xff=7:Aux PUD4}{PAUX10_ena&0xff=8:Aux PUD5}{PAUX1" VALUE 0x00147EC6 /* @ECU_Address@PAUX10_ena@0x0100BA88@ */ ECIPP_ALIGNMENT_UBYTE 255 PAUX10_ena_COMPU_VTAB 0 255 BIT_MASK 0xff /end CHARACTERISTIC
/begin COMPU_METHOD PAUX10_ena_COMPU_VTAB "Verbal Table" TAB_VERB "%.0" "list" COMPU_TAB_REF PAUX10_ena_COMPU_VTAB_REF /end COMPU_METHOD
/begin COMPU_VTAB PAUX10_ena_COMPU_VTAB_REF "Verbal Table" TAB_VERB 31 0 "Disabled" 1 "Aux PD1" 2 "Aux PD2" 3 "Aux PD3" 4 "Aux PUD1" 5 "Aux PUD2" 6 "Aux PUD3" 7 "Aux PUD4" 8 "Aux PUD5" 9 "Aux PUD6" 10 "Aux PUD7" 11 "Aux PUD8" 12 "Aux PUD9" 13 "Aux PUD10" 14 "Aux PUD11" 15 "Aux PUD12" 16 "Aux PUD13" 17 "Aux PUD14" 18 "Aux PUD15" 19 "CAN sourced" 20 "FPP2 Input" 21 "Aux PUD16" 22 "Aux PUD17" 23 "Aux PUD18" 24 "Aux PUD19" 25 "Aux PUD20" 26 "Aux PUD21" 27 "Aux PUD22" 28 "Aux PUD23" 29 "Aux PUD24" 30 "Aux PUD25" DEFAULT_VALUE "UNKNOWN" /end COMPU_VTAB
/begin CHARACTERISTIC PAUX11_ena "{PAUX11_ena&0xff=0:Disabled}{PAUX11_ena&0xff=1:Aux PD1}{PAUX11_ena&0xff=2:Aux PD2}{PAUX11_ena&0xff=3:Aux PD3}{PAUX11_ena&0xff=4:Aux PUD1}{PAUX11_ena&0xff=5:Aux PUD2}{PAUX11_ena&0xff=6:Aux PUD3}{PAUX11_ena&0xff=7:Aux PUD4}{PAUX11_ena&0xff=8:Aux PUD5}{PAUX1" VALUE 0x00147EC7 /* @ECU_Address@PAUX11_ena@0x0100BA90@ */ ECIPP_ALIGNMENT_UBYTE 255 PAUX11_ena_COMPU_VTAB 0 255 BIT_MASK 0xff /end CHARACTERISTIC
/begin COMPU_METHOD PAUX11_ena_COMPU_VTAB "Verbal Table" TAB_VERB "%.0" "list" COMPU_TAB_REF PAUX11_ena_COMPU_VTAB_REF /end COMPU_METHOD
/begin COMPU_VTAB PAUX11_ena_COMPU_VTAB_REF "Verbal Table" TAB_VERB 31 0 "Disabled" 1 "Aux PD1" 2 "Aux PD2" 3 "Aux PD3" 4 "Aux PUD1" 5 "Aux PUD2" 6 "Aux PUD3" 7 "Aux PUD4" 8 "Aux PUD5" 9 "Aux PUD6" 10 "Aux PUD7" 11 "Aux PUD8" 12 "Aux PUD9" 13 "Aux PUD10" 14 "Aux PUD11" 15 "Aux PUD12" 16 "Aux PUD13" 17 "Aux PUD14" 18 "Aux PUD15" 19 "CAN sourced" 20 "FPP2 Input" 21 "Aux PUD16" 22 "Aux PUD17" 23 "Aux PUD18" 24 "Aux PUD19" 25 "Aux PUD20" 26 "Aux PUD21" 27 "Aux PUD22" 28 "Aux PUD23" 29 "Aux PUD24" 30 "Aux PUD25" DEFAULT_VALUE "UNKNOWN" /end COMPU_VTAB
/begin CHARACTERISTIC PAUX12_ena "{PAUX12_ena&0xff=0:Disabled}{PAUX12_ena&0xff=1:Aux PD1}{PAUX12_ena&0xff=2:Aux PD2}{PAUX12_ena&0xff=3:Aux PD3}{PAUX12_ena&0xff=4:Aux PUD1}{PAUX12_ena&0xff=5:Aux PUD2}{PAUX12_ena&0xff=6:Aux PUD3}{PAUX12_ena&0xff=7:Aux PUD4}{PAUX12_ena&0xff=8:Aux PUD5}{PAUX1" VALUE 0x00147EC8 /* @ECU_Address@PAUX12_ena@0x0100BA98@ */ ECIPP_ALIGNMENT_UBYTE 255 PAUX12_ena_COMPU_VTAB 0 255 BIT_MASK 0xff /end CHARACTERISTIC
/begin COMPU_METHOD PAUX12_ena_COMPU_VTAB "Verbal Table" TAB_VERB "%.0" "list" COMPU_TAB_REF PAUX12_ena_COMPU_VTAB_REF /end COMPU_METHOD
/begin COMPU_VTAB PAUX12_ena_COMPU_VTAB_REF "Verbal Table" TAB_VERB 31 0 "Disabled" 1 "Aux PD1" 2 "Aux PD2" 3 "Aux PD3" 4 "Aux PUD1" 5 "Aux PUD2" 6 "Aux PUD3" 7 "Aux PUD4" 8 "Aux PUD5" 9 "Aux PUD6" 10 "Aux PUD7" 11 "Aux PUD8" 12 "Aux PUD9" 13 "Aux PUD10" 14 "Aux PUD11" 15 "Aux PUD12" 16 "Aux PUD13" 17 "Aux PUD14" 18 "Aux PUD15" 19 "CAN sourced" 20 "FPP2 Input" 21 "Aux PUD16" 22 "Aux PUD17" 23 "Aux PUD18" 24 "Aux PUD19" 25 "Aux PUD20" 26 "Aux PUD21" 27 "Aux PUD22" 28 "Aux PUD23" 29 "Aux PUD24" 30 "Aux PUD25" DEFAULT_VALUE "UNKNOWN" /end COMPU_VTAB
/begin CHARACTERISTIC PAUX13_ena "{PAUX13_ena&0xff=0:Disabled}{PAUX13_ena&0xff=1:Aux PD1}{PAUX13_ena&0xff=2:Aux PD2}{PAUX13_ena&0xff=3:Aux PD3}{PAUX13_ena&0xff=4:Aux PUD1}{PAUX13_ena&0xff=5:Aux PUD2}{PAUX13_ena&0xff=6:Aux PUD3}{PAUX13_ena&0xff=7:Aux PUD4}{PAUX13_ena&0xff=8:Aux PUD5}{PAUX1" VALUE 0x00147EC9 /* @ECU_Address@PAUX13_ena@0x0100BAA0@ */ ECIPP_ALIGNMENT_UBYTE 255 PAUX13_ena_COMPU_VTAB 0 255 BIT_MASK 0xff /end CHARACTERISTIC
/begin COMPU_METHOD PAUX13_ena_COMPU_VTAB "Verbal Table" TAB_VERB "%.0" "list" COMPU_TAB_REF PAUX13_ena_COMPU_VTAB_REF /end COMPU_METHOD
/begin COMPU_VTAB PAUX13_ena_COMPU_VTAB_REF "Verbal Table" TAB_VERB 31 0 "Disabled" 1 "Aux PD1" 2 "Aux PD2" 3 "Aux PD3" 4 "Aux PUD1" 5 "Aux PUD2" 6 "Aux PUD3" 7 "Aux PUD4" 8 "Aux PUD5" 9 "Aux PUD6" 10 "Aux PUD7" 11 "Aux PUD8" 12 "Aux PUD9" 13 "Aux PUD10" 14 "Aux PUD11" 15 "Aux PUD12" 16 "Aux PUD13" 17 "Aux PUD14" 18 "Aux PUD15" 19 "CAN sourced" 20 "FPP2 Input" 21 "Aux PUD16" 22 "Aux PUD17" 23 "Aux PUD18" 24 "Aux PUD19" 25 "Aux PUD20" 26 "Aux PUD21" 27 "Aux PUD22" 28 "Aux PUD23" 29 "Aux PUD24" 30 "Aux PUD25" DEFAULT_VALUE "UNKNOWN" /end COMPU_VTAB
/begin CHARACTERISTIC PAUX14_ena "{PAUX14_ena&0xff=0:Disabled}{PAUX14_ena&0xff=1:Aux PD1}{PAUX14_ena&0xff=2:Aux PD2}{PAUX14_ena&0xff=3:Aux PD3}{PAUX14_ena&0xff=4:Aux PUD1}{PAUX14_ena&0xff=5:Aux PUD2}{PAUX14_ena&0xff=6:Aux PUD3}{PAUX14_ena&0xff=7:Aux PUD4}{PAUX14_ena&0xff=8:Aux PUD5}{PAUX1" VALUE 0x00147ECA /* @ECU_Address@PAUX14_ena@0x0100BAA8@ */ ECIPP_ALIGNMENT_UBYTE 255 PAUX14_ena_COMPU_VTAB 0 255 BIT_MASK 0xff /end CHARACTERISTIC
/begin COMPU_METHOD PAUX14_ena_COMPU_VTAB "Verbal Table" TAB_VERB "%.0" "list" COMPU_TAB_REF PAUX14_ena_COMPU_VTAB_REF /end COMPU_METHOD
/begin COMPU_VTAB PAUX14_ena_COMPU_VTAB_REF "Verbal Table" TAB_VERB 31 0 "Disabled" 1 "Aux PD1" 2 "Aux PD2" 3 "Aux PD3" 4 "Aux PUD1" 5 "Aux PUD2" 6 "Aux PUD3" 7 "Aux PUD4" 8 "Aux PUD5" 9 "Aux PUD6" 10 "Aux PUD7" 11 "Aux PUD8" 12 "Aux PUD9" 13 "Aux PUD10" 14 "Aux PUD11" 15 "Aux PUD12" 16 "Aux PUD13" 17 "Aux PUD14" 18 "Aux PUD15" 19 "CAN sourced" 20 "FPP2 Input" 21 "Aux PUD16" 22 "Aux PUD17" 23 "Aux PUD18" 24 "Aux PUD19" 25 "Aux PUD20" 26 "Aux PUD21" 27 "Aux PUD22" 28 "Aux PUD23" 29 "Aux PUD24" 30 "Aux PUD25" DEFAULT_VALUE "UNKNOWN" /end COMPU_VTAB
/begin CHARACTERISTIC PAUX15_ena "{PAUX15_ena&0xff=0:Disabled}{PAUX15_ena&0xff=1:Aux PD1}{PAUX15_ena&0xff=2:Aux PD2}{PAUX15_ena&0xff=3:Aux PD3}{PAUX15_ena&0xff=4:Aux PUD1}{PAUX15_ena&0xff=5:Aux PUD2}{PAUX15_ena&0xff=6:Aux PUD3}{PAUX15_ena&0xff=7:Aux PUD4}{PAUX15_ena&0xff=8:Aux PUD5}{PAUX1" VALUE 0x00147ECB /* @ECU_Address@PAUX15_ena@0x0100BAB0@ */ ECIPP_ALIGNMENT_UBYTE 255 PAUX15_ena_COMPU_VTAB 0 255 BIT_MASK 0xff /end CHARACTERISTIC
/begin COMPU_METHOD PAUX15_ena_COMPU_VTAB "Verbal Table" TAB_VERB "%.0" "list" COMPU_TAB_REF PAUX15_ena_COMPU_VTAB_REF /end COMPU_METHOD
/begin COMPU_VTAB PAUX15_ena_COMPU_VTAB_REF "Verbal Table" TAB_VERB 31 0 "Disabled" 1 "Aux PD1" 2 "Aux PD2" 3 "Aux PD3" 4 "Aux PUD1" 5 "Aux PUD2" 6 "Aux PUD3" 7 "Aux PUD4" 8 "Aux PUD5" 9 "Aux PUD6" 10 "Aux PUD7" 11 "Aux PUD8" 12 "Aux PUD9" 13 "Aux PUD10" 14 "Aux PUD11" 15 "Aux PUD12" 16 "Aux PUD13" 17 "Aux PUD14" 18 "Aux PUD15" 19 "CAN sourced" 20 "FPP2 Input" 21 "Aux PUD16" 22 "Aux PUD17" 23 "Aux PUD18" 24 "Aux PUD19" 25 "Aux PUD20" 26 "Aux PUD21" 27 "Aux PUD22" 28 "Aux PUD23" 29 "Aux PUD24" 30 "Aux PUD25" DEFAULT_VALUE "UNKNOWN" /end COMPU_VTAB
/begin CHARACTERISTIC PAUX16_ena "{PAUX16_ena&0xff=0:Disabled}{PAUX16_ena&0xff=1:Aux PD1}{PAUX16_ena&0xff=2:Aux PD2}{PAUX16_ena&0xff=3:Aux PD3}{PAUX16_ena&0xff=4:Aux PUD1}{PAUX16_ena&0xff=5:Aux PUD2}{PAUX16_ena&0xff=6:Aux PUD3}{PAUX16_ena&0xff=7:Aux PUD4}{PAUX16_ena&0xff=8:Aux PUD5}{PAUX1" VALUE 0x00147ECC /* @ECU_Address@PAUX16_ena@0x0100BAB8@ */ ECIPP_ALIGNMENT_UBYTE 255 PAUX16_ena_COMPU_VTAB 0 255 BIT_MASK 0xff /end CHARACTERISTIC
/begin COMPU_METHOD PAUX16_ena_COMPU_VTAB "Verbal Table" TAB_VERB "%.0" "list" COMPU_TAB_REF PAUX16_ena_COMPU_VTAB_REF /end COMPU_METHOD
/begin COMPU_VTAB PAUX16_ena_COMPU_VTAB_REF "Verbal Table" TAB_VERB 31 0 "Disabled" 1 "Aux PD1" 2 "Aux PD2" 3 "Aux PD3" 4 "Aux PUD1" 5 "Aux PUD2" 6 "Aux PUD3" 7 "Aux PUD4" 8 "Aux PUD5" 9 "Aux PUD6" 10 "Aux PUD7" 11 "Aux PUD8" 12 "Aux PUD9" 13 "Aux PUD10" 14 "Aux PUD11" 15 "Aux PUD12" 16 "Aux PUD13" 17 "Aux PUD14" 18 "Aux PUD15" 19 "CAN sourced" 20 "FPP2 Input" 21 "Aux PUD16" 22 "Aux PUD17" 23 "Aux PUD18" 24 "Aux PUD19" 25 "Aux PUD20" 26 "Aux PUD21" 27 "Aux PUD22" 28 "Aux PUD23" 29 "Aux PUD24" 30 "Aux PUD25" DEFAULT_VALUE "UNKNOWN" /end COMPU_VTAB
/begin CHARACTERISTIC TAUX9_ena "{TAUX9_ena&0xff=0:Disabled}{TAUX9_ena&0xff=1:Aux PU1}{TAUX9_ena&0xff=2:Aux PU2}{TAUX9_ena&0xff=3:Aux PU3}{TAUX9_ena&0xff=4:Aux PUD1}{TAUX9_ena&0xff=5:Aux PUD2}{TAUX9_ena&0xff=6:Aux PUD3}{TAUX9_ena&0xff=7:EGT Input}{TAUX9_ena&0xff=8:Aux PUD4}{TAUX9_ena&0xf" VALUE 0x0014807F /* @ECU_Address@TAUX9_ena@0x0100BAC0@ */ ECIPP_ALIGNMENT_UBYTE 255 TAUX9_ena_COMPU_VTAB 0 255 BIT_MASK 0xff /end CHARACTERISTIC
/begin COMPU_METHOD TAUX9_ena_COMPU_VTAB "Verbal Table" TAB_VERB "%.0" "list" COMPU_TAB_REF TAUX9_ena_COMPU_VTAB_REF /end COMPU_METHOD
/begin COMPU_VTAB TAUX9_ena_COMPU_VTAB_REF "Verbal Table" TAB_VERB 31 0 "Disabled" 1 "Aux PU1" 2 "Aux PU2" 3 "Aux PU3" 4 "Aux PUD1" 5 "Aux PUD2" 6 "Aux PUD3" 7 "EGT Input" 8 "Aux PUD4" 9 "Aux PUD5" 10 "Aux PUD6" 11 "Aux PUD7" 12 "Aux PUD8" 13 "Aux PUD9" 14 "Aux PUD10" 15 "Aux PUD11" 16 "Aux PUD12" 17 "Aux PUD13" 18 "Aux PUD14" 19 "Aux PUD15" 20 "Aux PUD16" 21 "Aux PUD17" 22 "Aux PUD18" 23 "Aux PUD19" 24 "Aux PUD20" 25 "Aux PUD21" 26 "Aux PUD22" 27 "Aux PUD23" 28 "Aux PUD24" 29 "Aux PUD25" 30 "CAN sourced" DEFAULT_VALUE "UNKNOWN" /end COMPU_VTAB
/begin CHARACTERISTIC TAUX10_ena "{TAUX10_ena&0xff=0:Disabled}{TAUX10_ena&0xff=1:Aux PU1}{TAUX10_ena&0xff=2:Aux PU2}{TAUX10_ena&0xff=3:Aux PU3}{TAUX10_ena&0xff=4:Aux PUD1}{TAUX10_ena&0xff=5:Aux PUD2}{TAUX10_ena&0xff=6:Aux PUD3}{TAUX10_ena&0xff=7:EGT Input}{TAUX10_ena&0xff=8:Aux PUD4}{TAUX" VALUE 0x00148080 /* @ECU_Address@TAUX10_ena@0x0100BAC8@ */ ECIPP_ALIGNMENT_UBYTE 255 TAUX10_ena_COMPU_VTAB 0 255 BIT_MASK 0xff /end CHARACTERISTIC
/begin COMPU_METHOD TAUX10_ena_COMPU_VTAB "Verbal Table" TAB_VERB "%.0" "list" COMPU_TAB_REF TAUX10_ena_COMPU_VTAB_REF /end COMPU_METHOD
/begin COMPU_VTAB TAUX10_ena_COMPU_VTAB_REF "Verbal Table" TAB_VERB 31 0 "Disabled" 1 "Aux PU1" 2 "Aux PU2" 3 "Aux PU3" 4 "Aux PUD1" 5 "Aux PUD2" 6 "Aux PUD3" 7 "EGT Input" 8 "Aux PUD4" 9 "Aux PUD5" 10 "Aux PUD6" 11 "Aux PUD7" 12 "Aux PUD8" 13 "Aux PUD9" 14 "Aux PUD10" 15 "Aux PUD11" 16 "Aux PUD12" 17 "Aux PUD13" 18 "Aux PUD14" 19 "Aux PUD15" 20 "Aux PUD16" 21 "Aux PUD17" 22 "Aux PUD18" 23 "Aux PUD19" 24 "Aux PUD20" 25 "Aux PUD21" 26 "Aux PUD22" 27 "Aux PUD23" 28 "Aux PUD24" 29 "Aux PUD25" 30 "CAN sourced" DEFAULT_VALUE "UNKNOWN" /end COMPU_VTAB
/begin CHARACTERISTIC TAUX11_ena "{TAUX11_ena&0xff=0:Disabled}{TAUX11_ena&0xff=1:Aux PU1}{TAUX11_ena&0xff=2:Aux PU2}{TAUX11_ena&0xff=3:Aux PU3}{TAUX11_ena&0xff=4:Aux PUD1}{TAUX11_ena&0xff=5:Aux PUD2}{TAUX11_ena&0xff=6:Aux PUD3}{TAUX11_ena&0xff=7:EGT Input}{TAUX11_ena&0xff=8:Aux PUD4}{TAUX" VALUE 0x00148081 /* @ECU_Address@TAUX11_ena@0x0100BAD0@ */ ECIPP_ALIGNMENT_UBYTE 255 TAUX11_ena_COMPU_VTAB 0 255 BIT_MASK 0xff /end CHARACTERISTIC
/begin COMPU_METHOD TAUX11_ena_COMPU_VTAB "Verbal Table" TAB_VERB "%.0" "list" COMPU_TAB_REF TAUX11_ena_COMPU_VTAB_REF /end COMPU_METHOD
/begin COMPU_VTAB TAUX11_ena_COMPU_VTAB_REF "Verbal Table" TAB_VERB 31 0 "Disabled" 1 "Aux PU1" 2 "Aux PU2" 3 "Aux PU3" 4 "Aux PUD1" 5 "Aux PUD2" 6 "Aux PUD3" 7 "EGT Input" 8 "Aux PUD4" 9 "Aux PUD5" 10 "Aux PUD6" 11 "Aux PUD7" 12 "Aux PUD8" 13 "Aux PUD9" 14 "Aux PUD10" 15 "Aux PUD11" 16 "Aux PUD12" 17 "Aux PUD13" 18 "Aux PUD14" 19 "Aux PUD15" 20 "Aux PUD16" 21 "Aux PUD17" 22 "Aux PUD18" 23 "Aux PUD19" 24 "Aux PUD20" 25 "Aux PUD21" 26 "Aux PUD22" 27 "Aux PUD23" 28 "Aux PUD24" 29 "Aux PUD25" 30 "CAN sourced" DEFAULT_VALUE "UNKNOWN" /end COMPU_VTAB
/begin CHARACTERISTIC TAUX12_ena "{TAUX12_ena&0xff=0:Disabled}{TAUX12_ena&0xff=1:Aux PU1}{TAUX12_ena&0xff=2:Aux PU2}{TAUX12_ena&0xff=3:Aux PU3}{TAUX12_ena&0xff=4:Aux PUD1}{TAUX12_ena&0xff=5:Aux PUD2}{TAUX12_ena&0xff=6:Aux PUD3}{TAUX12_ena&0xff=7:EGT Input}{TAUX12_ena&0xff=8:Aux PUD4}{TAUX" VALUE 0x00148082 /* @ECU_Address@TAUX12_ena@0x0100BAD8@ */ ECIPP_ALIGNMENT_UBYTE 255 TAUX12_ena_COMPU_VTAB 0 255 BIT_MASK 0xff /end CHARACTERISTIC
/begin COMPU_METHOD TAUX12_ena_COMPU_VTAB "Verbal Table" TAB_VERB "%.0" "list" COMPU_TAB_REF TAUX12_ena_COMPU_VTAB_REF /end COMPU_METHOD
/begin COMPU_VTAB TAUX12_ena_COMPU_VTAB_REF "Verbal Table" TAB_VERB 31 0 "Disabled" 1 "Aux PU1" 2 "Aux PU2" 3 "Aux PU3" 4 "Aux PUD1" 5 "Aux PUD2" 6 "Aux PUD3" 7 "EGT Input" 8 "Aux PUD4" 9 "Aux PUD5" 10 "Aux PUD6" 11 "Aux PUD7" 12 "Aux PUD8" 13 "Aux PUD9" 14 "Aux PUD10" 15 "Aux PUD11" 16 "Aux PUD12" 17 "Aux PUD13" 18 "Aux PUD14" 19 "Aux PUD15" 20 "Aux PUD16" 21 "Aux PUD17" 22 "Aux PUD18" 23 "Aux PUD19" 24 "Aux PUD20" 25 "Aux PUD21" 26 "Aux PUD22" 27 "Aux PUD23" 28 "Aux PUD24" 29 "Aux PUD25" 30 "CAN sourced" DEFAULT_VALUE "UNKNOWN" /end COMPU_VTAB
/begin CHARACTERISTIC TAUX13_ena "{TAUX13_ena&0xff=0:Disabled}{TAUX13_ena&0xff=1:Aux PU1}{TAUX13_ena&0xff=2:Aux PU2}{TAUX13_ena&0xff=3:Aux PU3}{TAUX13_ena&0xff=4:Aux PUD1}{TAUX13_ena&0xff=5:Aux PUD2}{TAUX13_ena&0xff=6:Aux PUD3}{TAUX13_ena&0xff=7:EGT Input}{TAUX13_ena&0xff=8:Aux PUD4}{TAUX" VALUE 0x00148083 /* @ECU_Address@TAUX13_ena@0x0100BAE0@ */ ECIPP_ALIGNMENT_UBYTE 255 TAUX13_ena_COMPU_VTAB 0 255 BIT_MASK 0xff /end CHARACTERISTIC
/begin COMPU_METHOD TAUX13_ena_COMPU_VTAB "Verbal Table" TAB_VERB "%.0" "list" COMPU_TAB_REF TAUX13_ena_COMPU_VTAB_REF /end COMPU_METHOD
/begin COMPU_VTAB TAUX13_ena_COMPU_VTAB_REF "Verbal Table" TAB_VERB 31 0 "Disabled" 1 "Aux PU1" 2 "Aux PU2" 3 "Aux PU3" 4 "Aux PUD1" 5 "Aux PUD2" 6 "Aux PUD3" 7 "EGT Input" 8 "Aux PUD4" 9 "Aux PUD5" 10 "Aux PUD6" 11 "Aux PUD7" 12 "Aux PUD8" 13 "Aux PUD9" 14 "Aux PUD10" 15 "Aux PUD11" 16 "Aux PUD12" 17 "Aux PUD13" 18 "Aux PUD14" 19 "Aux PUD15" 20 "Aux PUD16" 21 "Aux PUD17" 22 "Aux PUD18" 23 "Aux PUD19" 24 "Aux PUD20" 25 "Aux PUD21" 26 "Aux PUD22" 27 "Aux PUD23" 28 "Aux PUD24" 29 "Aux PUD25" 30 "CAN sourced" DEFAULT_VALUE "UNKNOWN" /end COMPU_VTAB
/begin CHARACTERISTIC TAUX14_ena "{TAUX14_ena&0xff=0:Disabled}{TAUX14_ena&0xff=1:Aux PU1}{TAUX14_ena&0xff=2:Aux PU2}{TAUX14_ena&0xff=3:Aux PU3}{TAUX14_ena&0xff=4:Aux PUD1}{TAUX14_ena&0xff=5:Aux PUD2}{TAUX14_ena&0xff=6:Aux PUD3}{TAUX14_ena&0xff=7:EGT Input}{TAUX14_ena&0xff=8:Aux PUD4}{TAUX" VALUE 0x00148084 /* @ECU_Address@TAUX14_ena@0x0100BAE8@ */ ECIPP_ALIGNMENT_UBYTE 255 TAUX14_ena_COMPU_VTAB 0 255 BIT_MASK 0xff /end CHARACTERISTIC
/begin COMPU_METHOD TAUX14_ena_COMPU_VTAB "Verbal Table" TAB_VERB "%.0" "list" COMPU_TAB_REF TAUX14_ena_COMPU_VTAB_REF /end COMPU_METHOD
/begin COMPU_VTAB TAUX14_ena_COMPU_VTAB_REF "Verbal Table" TAB_VERB 31 0 "Disabled" 1 "Aux PU1" 2 "Aux PU2" 3 "Aux PU3" 4 "Aux PUD1" 5 "Aux PUD2" 6 "Aux PUD3" 7 "EGT Input" 8 "Aux PUD4" 9 "Aux PUD5" 10 "Aux PUD6" 11 "Aux PUD7" 12 "Aux PUD8" 13 "Aux PUD9" 14 "Aux PUD10" 15 "Aux PUD11" 16 "Aux PUD12" 17 "Aux PUD13" 18 "Aux PUD14" 19 "Aux PUD15" 20 "Aux PUD16" 21 "Aux PUD17" 22 "Aux PUD18" 23 "Aux PUD19" 24 "Aux PUD20" 25 "Aux PUD21" 26 "Aux PUD22" 27 "Aux PUD23" 28 "Aux PUD24" 29 "Aux PUD25" 30 "CAN sourced" DEFAULT_VALUE "UNKNOWN" /end COMPU_VTAB
/begin CHARACTERISTIC TAUX15_ena "{TAUX15_ena&0xff=0:Disabled}{TAUX15_ena&0xff=1:Aux PU1}{TAUX15_ena&0xff=2:Aux PU2}{TAUX15_ena&0xff=3:Aux PU3}{TAUX15_ena&0xff=4:Aux PUD1}{TAUX15_ena&0xff=5:Aux PUD2}{TAUX15_ena&0xff=6:Aux PUD3}{TAUX15_ena&0xff=7:EGT Input}{TAUX15_ena&0xff=8:Aux PUD4}{TAUX" VALUE 0x00148085 /* @ECU_Address@TAUX15_ena@0x0100BAF0@ */ ECIPP_ALIGNMENT_UBYTE 255 TAUX15_ena_COMPU_VTAB 0 255 BIT_MASK 0xff /end CHARACTERISTIC
/begin COMPU_METHOD TAUX15_ena_COMPU_VTAB "Verbal Table" TAB_VERB "%.0" "list" COMPU_TAB_REF TAUX15_ena_COMPU_VTAB_REF /end COMPU_METHOD
/begin COMPU_VTAB TAUX15_ena_COMPU_VTAB_REF "Verbal Table" TAB_VERB 31 0 "Disabled" 1 "Aux PU1" 2 "Aux PU2" 3 "Aux PU3" 4 "Aux PUD1" 5 "Aux PUD2" 6 "Aux PUD3" 7 "EGT Input" 8 "Aux PUD4" 9 "Aux PUD5" 10 "Aux PUD6" 11 "Aux PUD7" 12 "Aux PUD8" 13 "Aux PUD9" 14 "Aux PUD10" 15 "Aux PUD11" 16 "Aux PUD12" 17 "Aux PUD13" 18 "Aux PUD14" 19 "Aux PUD15" 20 "Aux PUD16" 21 "Aux PUD17" 22 "Aux PUD18" 23 "Aux PUD19" 24 "Aux PUD20" 25 "Aux PUD21" 26 "Aux PUD22" 27 "Aux PUD23" 28 "Aux PUD24" 29 "Aux PUD25" 30 "CAN sourced" DEFAULT_VALUE "UNKNOWN" /end COMPU_VTAB
/begin CHARACTERISTIC TAUX16_ena "{TAUX16_ena&0xff=0:Disabled}{TAUX16_ena&0xff=1:Aux PU1}{TAUX16_ena&0xff=2:Aux PU2}{TAUX16_ena&0xff=3:Aux PU3}{TAUX16_ena&0xff=4:Aux PUD1}{TAUX16_ena&0xff=5:Aux PUD2}{TAUX16_ena&0xff=6:Aux PUD3}{TAUX16_ena&0xff=7:EGT Input}{TAUX16_ena&0xff=8:Aux PUD4}{TAUX" VALUE 0x00148086 /* @ECU_Address@TAUX16_ena@0x0100BAF8@ */ ECIPP_ALIGNMENT_UBYTE 255 TAUX16_ena_COMPU_VTAB 0 255 BIT_MASK 0xff /end CHARACTERISTIC
/begin COMPU_METHOD TAUX16_ena_COMPU_VTAB "Verbal Table" TAB_VERB "%.0" "list" COMPU_TAB_REF TAUX16_ena_COMPU_VTAB_REF /end COMPU_METHOD
/begin COMPU_VTAB TAUX16_ena_COMPU_VTAB_REF "Verbal Table" TAB_VERB 31 0 "Disabled" 1 "Aux PU1" 2 "Aux PU2" 3 "Aux PU3" 4 "Aux PUD1" 5 "Aux PUD2" 6 "Aux PUD3" 7 "EGT Input" 8 "Aux PUD4" 9 "Aux PUD5" 10 "Aux PUD6" 11 "Aux PUD7" 12 "Aux PUD8" 13 "Aux PUD9" 14 "Aux PUD10" 15 "Aux PUD11" 16 "Aux PUD12" 17 "Aux PUD13" 18 "Aux PUD14" 19 "Aux PUD15" 20 "Aux PUD16" 21 "Aux PUD17" 22 "Aux PUD18" 23 "Aux PUD19" 24 "Aux PUD20" 25 "Aux PUD21" 26 "Aux PUD22" 27 "Aux PUD23" 28 "Aux PUD24" 29 "Aux PUD25" 30 "CAN sourced" DEFAULT_VALUE "UNKNOWN" /end COMPU_VTAB
/begin CHARACTERISTIC TAUX9_Taux_cal "{TAUX9_Taux_cal&0xff=0:Fuel source}{TAUX9_Taux_cal&0xff=1:Exhaust manifold/riser}{TAUX9_Taux_cal&0xff=2:Aux Temp A}{TAUX9_Taux_cal&0xff=3:Aux Temp B}{TAUX9_Taux_cal&0xff=4:Aux Temp C}{TAUX9_Taux_cal&0xff=5:Aux Temp D}" VALUE 0x0014806F /* @ECU_Address@TAUX9_Taux_cal@0x0100BB00@ */ ECIPP_ALIGNMENT_UBYTE 255 TAUX9_Taux_cal_COMPU_VTAB 0 255 BIT_MASK 0xff /end CHARACTERISTIC
/begin COMPU_METHOD TAUX9_Taux_cal_COMPU_VTAB "Verbal Table" TAB_VERB "%.0" "list" COMPU_TAB_REF TAUX9_Taux_cal_COMPU_VTAB_REF /end COMPU_METHOD
/begin COMPU_VTAB TAUX9_Taux_cal_COMPU_VTAB_REF "Verbal Table" TAB_VERB 6 0 "Fuel source" 1 "Exhaust manifold/riser" 2 "Aux Temp A" 3 "Aux Temp B" 4 "Aux Temp C" 5 "Aux Temp D" DEFAULT_VALUE "UNKNOWN" /end COMPU_VTAB
/begin CHARACTERISTIC TAUX10_Taux_cal "{TAUX10_Taux_cal&0xff=0:Fuel source}{TAUX10_Taux_cal&0xff=1:Exhaust manifold/riser}{TAUX10_Taux_cal&0xff=2:Aux Temp A}{TAUX10_Taux_cal&0xff=3:Aux Temp B}{TAUX10_Taux_cal&0xff=4:Aux Temp C}{TAUX10_Taux_cal&0xff=5:Aux Temp D}" VALUE 0x00148070 /* @ECU_Address@TAUX10_Taux_cal@0x0100BB08@ */ ECIPP_ALIGNMENT_UBYTE 255 TAUX10_Taux_cal_COMPU_VTAB 0 255 BIT_MASK 0xff /end CHARACTERISTIC
/begin COMPU_METHOD TAUX10_Taux_cal_COMPU_VTAB "Verbal Table" TAB_VERB "%.0" "list" COMPU_TAB_REF TAUX10_Taux_cal_COMPU_VTAB_REF /end COMPU_METHOD
/begin COMPU_VTAB TAUX10_Taux_cal_COMPU_VTAB_REF "Verbal Table" TAB_VERB 6 0 "Fuel source" 1 "Exhaust manifold/riser" 2 "Aux Temp A" 3 "Aux Temp B" 4 "Aux Temp C" 5 "Aux Temp D" DEFAULT_VALUE "UNKNOWN" /end COMPU_VTAB
/begin CHARACTERISTIC TAUX11_Taux_cal "{TAUX11_Taux_cal&0xff=0:Fuel source}{TAUX11_Taux_cal&0xff=1:Exhaust manifold/riser}{TAUX11_Taux_cal&0xff=2:Aux Temp A}{TAUX11_Taux_cal&0xff=3:Aux Temp B}{TAUX11_Taux_cal&0xff=4:Aux Temp C}{TAUX11_Taux_cal&0xff=5:Aux Temp D}" VALUE 0x00148071 /* @ECU_Address@TAUX11_Taux_cal@0x0100BB10@ */ ECIPP_ALIGNMENT_UBYTE 255 TAUX11_Taux_cal_COMPU_VTAB 0 255 BIT_MASK 0xff /end CHARACTERISTIC
/begin COMPU_METHOD TAUX11_Taux_cal_COMPU_VTAB "Verbal Table" TAB_VERB "%.0" "list" COMPU_TAB_REF TAUX11_Taux_cal_COMPU_VTAB_REF /end COMPU_METHOD
/begin COMPU_VTAB TAUX11_Taux_cal_COMPU_VTAB_REF "Verbal Table" TAB_VERB 6 0 "Fuel source" 1 "Exhaust manifold/riser" 2 "Aux Temp A" 3 "Aux Temp B" 4 "Aux Temp C" 5 "Aux Temp D" DEFAULT_VALUE "UNKNOWN" /end COMPU_VTAB
/begin CHARACTERISTIC TAUX12_Taux_cal "{TAUX12_Taux_cal&0xff=0:Fuel source}{TAUX12_Taux_cal&0xff=1:Exhaust manifold/riser}{TAUX12_Taux_cal&0xff=2:Aux Temp A}{TAUX12_Taux_cal&0xff=3:Aux Temp B}{TAUX12_Taux_cal&0xff=4:Aux Temp C}{TAUX12_Taux_cal&0xff=5:Aux Temp D}" VALUE 0x00148072 /* @ECU_Address@TAUX12_Taux_cal@0x0100BB18@ */ ECIPP_ALIGNMENT_UBYTE 255 TAUX12_Taux_cal_COMPU_VTAB 0 255 BIT_MASK 0xff /end CHARACTERISTIC
/begin COMPU_METHOD TAUX12_Taux_cal_COMPU_VTAB "Verbal Table" TAB_VERB "%.0" "list" COMPU_TAB_REF TAUX12_Taux_cal_COMPU_VTAB_REF /end COMPU_METHOD
/begin COMPU_VTAB TAUX12_Taux_cal_COMPU_VTAB_REF "Verbal Table" TAB_VERB 6 0 "Fuel source" 1 "Exhaust manifold/riser" 2 "Aux Temp A" 3 "Aux Temp B" 4 "Aux Temp C" 5 "Aux Temp D" DEFAULT_VALUE "UNKNOWN" /end COMPU_VTAB
/begin CHARACTERISTIC TAUX13_Taux_cal "{TAUX13_Taux_cal&0xff=0:Fuel source}{TAUX13_Taux_cal&0xff=1:Exhaust manifold/riser}{TAUX13_Taux_cal&0xff=2:Aux Temp A}{TAUX13_Taux_cal&0xff=3:Aux Temp B}{TAUX13_Taux_cal&0xff=4:Aux Temp C}{TAUX13_Taux_cal&0xff=5:Aux Temp D}" VALUE 0x00148073 /* @ECU_Address@TAUX13_Taux_cal@0x0100BB20@ */ ECIPP_ALIGNMENT_UBYTE 255 TAUX13_Taux_cal_COMPU_VTAB 0 255 BIT_MASK 0xff /end CHARACTERISTIC
/begin COMPU_METHOD TAUX13_Taux_cal_COMPU_VTAB "Verbal Table" TAB_VERB "%.0" "list" COMPU_TAB_REF TAUX13_Taux_cal_COMPU_VTAB_REF /end COMPU_METHOD
/begin COMPU_VTAB TAUX13_Taux_cal_COMPU_VTAB_REF "Verbal Table" TAB_VERB 6 0 "Fuel source" 1 "Exhaust manifold/riser" 2 "Aux Temp A" 3 "Aux Temp B" 4 "Aux Temp C" 5 "Aux Temp D" DEFAULT_VALUE "UNKNOWN" /end COMPU_VTAB
/begin CHARACTERISTIC TAUX14_Taux_cal "{TAUX14_Taux_cal&0xff=0:Fuel source}{TAUX14_Taux_cal&0xff=1:Exhaust manifold/riser}{TAUX14_Taux_cal&0xff=2:Aux Temp A}{TAUX14_Taux_cal&0xff=3:Aux Temp B}{TAUX14_Taux_cal&0xff=4:Aux Temp C}{TAUX14_Taux_cal&0xff=5:Aux Temp D}" VALUE 0x00148074 /* @ECU_Address@TAUX14_Taux_cal@0x0100BB28@ */ ECIPP_ALIGNMENT_UBYTE 255 TAUX14_Taux_cal_COMPU_VTAB 0 255 BIT_MASK 0xff /end CHARACTERISTIC
/begin COMPU_METHOD TAUX14_Taux_cal_COMPU_VTAB "Verbal Table" TAB_VERB "%.0" "list" COMPU_TAB_REF TAUX14_Taux_cal_COMPU_VTAB_REF /end COMPU_METHOD
/begin COMPU_VTAB TAUX14_Taux_cal_COMPU_VTAB_REF "Verbal Table" TAB_VERB 6 0 "Fuel source" 1 "Exhaust manifold/riser" 2 "Aux Temp A" 3 "Aux Temp B" 4 "Aux Temp C" 5 "Aux Temp D" DEFAULT_VALUE "UNKNOWN" /end COMPU_VTAB
/begin CHARACTERISTIC TAUX15_Taux_cal "{TAUX15_Taux_cal&0xff=0:Fuel source}{TAUX15_Taux_cal&0xff=1:Exhaust manifold/riser}{TAUX15_Taux_cal&0xff=2:Aux Temp A}{TAUX15_Taux_cal&0xff=3:Aux Temp B}{TAUX15_Taux_cal&0xff=4:Aux Temp C}{TAUX15_Taux_cal&0xff=5:Aux Temp D}" VALUE 0x00148075 /* @ECU_Address@TAUX15_Taux_cal@0x0100BB30@ */ ECIPP_ALIGNMENT_UBYTE 255 TAUX15_Taux_cal_COMPU_VTAB 0 255 BIT_MASK 0xff /end CHARACTERISTIC
/begin COMPU_METHOD TAUX15_Taux_cal_COMPU_VTAB "Verbal Table" TAB_VERB "%.0" "list" COMPU_TAB_REF TAUX15_Taux_cal_COMPU_VTAB_REF /end COMPU_METHOD
/begin COMPU_VTAB TAUX15_Taux_cal_COMPU_VTAB_REF "Verbal Table" TAB_VERB 6 0 "Fuel source" 1 "Exhaust manifold/riser" 2 "Aux Temp A" 3 "Aux Temp B" 4 "Aux Temp C" 5 "Aux Temp D" DEFAULT_VALUE "UNKNOWN" /end COMPU_VTAB
/begin CHARACTERISTIC TAUX16_Taux_cal "{TAUX16_Taux_cal&0xff=0:Fuel source}{TAUX16_Taux_cal&0xff=1:Exhaust manifold/riser}{TAUX16_Taux_cal&0xff=2:Aux Temp A}{TAUX16_Taux_cal&0xff=3:Aux Temp B}{TAUX16_Taux_cal&0xff=4:Aux Temp C}{TAUX16_Taux_cal&0xff=5:Aux Temp D}" VALUE 0x00148076 /* @ECU_Address@TAUX16_Taux_cal@0x0100BB38@ */ ECIPP_ALIGNMENT_UBYTE 255 TAUX16_Taux_cal_COMPU_VTAB 0 255 BIT_MASK 0xff /end CHARACTERISTIC
/begin COMPU_METHOD TAUX16_Taux_cal_COMPU_VTAB "Verbal Table" TAB_VERB "%.0" "list" COMPU_TAB_REF TAUX16_Taux_cal_COMPU_VTAB_REF /end COMPU_METHOD
/begin COMPU_VTAB TAUX16_Taux_cal_COMPU_VTAB_REF "Verbal Table" TAB_VERB 6 0 "Fuel source" 1 "Exhaust manifold/riser" 2 "Aux Temp A" 3 "Aux Temp B" 4 "Aux Temp C" 5 "Aux Temp D" DEFAULT_VALUE "UNKNOWN" /end COMPU_VTAB
/begin CHARACTERISTIC TAUX9_vdr "IOConfig # TAUX9_vdr" VALUE 0x00143A44 /* @ECU_Address@TAUX9_vdr@0x0100BB40@ */ ECIPP_ALIGNMENT_FLOAT32_IEEE 10000000000 Compu_TAUX9_vdr -10000000000 10000000000 /end CHARACTERISTIC
/begin COMPU_METHOD Compu_TAUX9_vdr " " RAT_FUNC "%.3" "ohms" COEFFS 0 1 0 0 0 1 /end COMPU_METHOD
/begin CHARACTERISTIC TAUX10_vdr "IOConfig # TAUX10_vdr" VALUE 0x00143A48 /* @ECU_Address@TAUX10_vdr@0x0100BB48@ */ ECIPP_ALIGNMENT_FLOAT32_IEEE 10000000000 Compu_TAUX10_vdr -10000000000 10000000000 /end CHARACTERISTIC
/begin COMPU_METHOD Compu_TAUX10_vdr " " RAT_FUNC "%.3" "ohms" COEFFS 0 1 0 0 0 1 /end COMPU_METHOD
/begin CHARACTERISTIC TAUX11_vdr "IOConfig # TAUX11_vdr" VALUE 0x00143A4C /* @ECU_Address@TAUX11_vdr@0x0100BB50@ */ ECIPP_ALIGNMENT_FLOAT32_IEEE 10000000000 Compu_TAUX11_vdr -10000000000 10000000000 /end CHARACTERISTIC
/begin COMPU_METHOD Compu_TAUX11_vdr " " RAT_FUNC "%.3" "ohms" COEFFS 0 1 0 0 0 1 /end COMPU_METHOD
/begin CHARACTERISTIC TAUX12_vdr "IOConfig # TAUX12_vdr" VALUE 0x00143A50 /* @ECU_Address@TAUX12_vdr@0x0100BB58@ */ ECIPP_ALIGNMENT_FLOAT32_IEEE 10000000000 Compu_TAUX12_vdr -10000000000 10000000000 /end CHARACTERISTIC
/begin COMPU_METHOD Compu_TAUX12_vdr " " RAT_FUNC "%.3" "ohms" COEFFS 0 1 0 0 0 1 /end COMPU_METHOD
/begin CHARACTERISTIC TAUX13_vdr "IOConfig # TAUX13_vdr" VALUE 0x00143A54 /* @ECU_Address@TAUX13_vdr@0x0100BB60@ */ ECIPP_ALIGNMENT_FLOAT32_IEEE 10000000000 Compu_TAUX13_vdr -10000000000 10000000000 /end CHARACTERISTIC
/begin COMPU_METHOD Compu_TAUX13_vdr " " RAT_FUNC "%.3" "ohms" COEFFS 0 1 0 0 0 1 /end COMPU_METHOD
/begin CHARACTERISTIC TAUX14_vdr "IOConfig # TAUX14_vdr" VALUE 0x00143A58 /* @ECU_Address@TAUX14_vdr@0x0100BB68@ */ ECIPP_ALIGNMENT_FLOAT32_IEEE 10000000000 Compu_TAUX14_vdr -10000000000 10000000000 /end CHARACTERISTIC
/begin COMPU_METHOD Compu_TAUX14_vdr " " RAT_FUNC "%.3" "ohms" COEFFS 0 1 0 0 0 1 /end COMPU_METHOD
/begin CHARACTERISTIC TAUX15_vdr "IOConfig # TAUX15_vdr" VALUE 0x00143A5C /* @ECU_Address@TAUX15_vdr@0x0100BB70@ */ ECIPP_ALIGNMENT_FLOAT32_IEEE 10000000000 Compu_TAUX15_vdr -10000000000 10000000000 /end CHARACTERISTIC
/begin COMPU_METHOD Compu_TAUX15_vdr " " RAT_FUNC "%.3" "ohms" COEFFS 0 1 0 0 0 1 /end COMPU_METHOD
/begin CHARACTERISTIC TAUX16_vdr "IOConfig # TAUX16_vdr" VALUE 0x00143A60 /* @ECU_Address@TAUX16_vdr@0x0100BB78@ */ ECIPP_ALIGNMENT_FLOAT32_IEEE 10000000000 Compu_TAUX16_vdr -10000000000 10000000000 /end CHARACTERISTIC
/begin COMPU_METHOD Compu_TAUX16_vdr " " RAT_FUNC "%.3" "ohms" COEFFS 0 1 0 0 0 1 /end COMPU_METHOD
/begin CHARACTERISTIC EGRHP_Paux_cal "{EGRHP_Paux_cal&0xff=0:Aux Press A}{EGRHP_Paux_cal&0xff=1:Aux Press B}{EGRHP_Paux_cal&0xff=2:Aux Press C}{EGRHP_Paux_cal&0xff=3:Aux Press D}" VALUE 0x001409a3 /* @ECU_Address@EGRHP_Paux_cal@0x0100BBA8@ */ ECIPP_ALIGNMENT_UBYTE 255 EGRHP_Paux_cal_COMPU_VTAB 0 255 BIT_MASK 0xff /end CHARACTERISTIC
/begin COMPU_METHOD EGRHP_Paux_cal_COMPU_VTAB "Verbal Table" TAB_VERB "%.0" "list" COMPU_TAB_REF EGRHP_Paux_cal_COMPU_VTAB_REF /end COMPU_METHOD
/begin COMPU_VTAB EGRHP_Paux_cal_COMPU_VTAB_REF "Verbal Table" TAB_VERB 4 0 "Aux Press A" 1 "Aux Press B" 2 "Aux Press C" 3 "Aux Press D" DEFAULT_VALUE "UNKNOWN" /end COMPU_VTAB
/begin CHARACTERISTIC Aux_DIG2_rpm_lo "FaultConfig # Aux_DIG2_rpm_lo (Fault Condition:and RPM >=)" VALUE 0x0016347e /* @ECU_Address@Aux_DIG2_rpm_lo@0x0100BC00@ */ ECIPP_ALIGNMENT_UWORD 65535 Compu_Aux_DIG2_rpm_lo 0 65535 /end CHARACTERISTIC
/begin COMPU_METHOD Compu_Aux_DIG2_rpm_lo " " RAT_FUNC "%.0" "rpm" COEFFS 0 1 0 0 0 1 /end COMPU_METHOD
/begin CHARACTERISTIC Aux_DIG2_rpm_hi "FaultConfig # Aux_DIG2_rpm_hi (Fault Condition:and RPM <=)" VALUE 0x0016347c /* @ECU_Address@Aux_DIG2_rpm_hi@0x0100BC08@ */ ECIPP_ALIGNMENT_UWORD 65535 Compu_Aux_DIG2_rpm_hi 0 65535 /end CHARACTERISTIC
/begin COMPU_METHOD Compu_Aux_DIG2_rpm_hi " " RAT_FUNC "%.0" "rpm" COEFFS 0 1 0 0 0 1 /end COMPU_METHOD
/begin CHARACTERISTIC Aux_DIG2_ECT_lo "FaultConfig # Aux_DIG2_ECT_lo (Fault Condition:and ECT >=)" VALUE 0x0016347a /* @ECU_Address@Aux_DIG2_ECT_lo@0x0100BC10@ */ ECIPP_ALIGNMENT_UWORD 564 Compu_Aux_DIG2_ECT_lo -460 563.984375 /end CHARACTERISTIC
/begin COMPU_METHOD Compu_Aux_DIG2_ECT_lo " " RAT_FUNC "%.3" "deg F" COEFFS 0 64 29440 0 0 1 /end COMPU_METHOD
/begin CHARACTERISTIC EGRLP_Paux_cal "{EGRLP_Paux_cal&0xff=0:Aux Press A}{EGRLP_Paux_cal&0xff=1:Aux Press B}{EGRLP_Paux_cal&0xff=2:Aux Press C}{EGRLP_Paux_cal&0xff=3:Aux Press D}" VALUE 0x001409a5 /* @ECU_Address@EGRLP_Paux_cal@0x0100BC50@ */ ECIPP_ALIGNMENT_UBYTE 255 EGRLP_Paux_cal_COMPU_VTAB 0 255 BIT_MASK 0xff /end CHARACTERISTIC
/begin COMPU_METHOD EGRLP_Paux_cal_COMPU_VTAB "Verbal Table" TAB_VERB "%.0" "list" COMPU_TAB_REF EGRLP_Paux_cal_COMPU_VTAB_REF /end COMPU_METHOD
/begin COMPU_VTAB EGRLP_Paux_cal_COMPU_VTAB_REF "Verbal Table" TAB_VERB 4 0 "Aux Press A" 1 "Aux Press B" 2 "Aux Press C" 3 "Aux Press D" DEFAULT_VALUE "UNKNOWN" /end COMPU_VTAB
/begin CHARACTERISTIC PWM_flt_DCtrans_wt "FaultConfig # PWM_flt_DCtrans_wt (Fault Condition:PWM duty-cycle transition fault ignore wait)" VALUE 0x001650fc /* @ECU_Address@PWM_flt_DCtrans_wt@0x0100BD90@ */ ECIPP_ALIGNMENT_SBYTE 127 Compu_PWM_flt_DCtrans_wt -128 127 /end CHARACTERISTIC
/begin COMPU_METHOD Compu_PWM_flt_DCtrans_wt " " RAT_FUNC "%.0" "ms" COEFFS 0 1 0 0 0 1 /end COMPU_METHOD
/begin CHARACTERISTIC rpmd_gov_lo_lmt "FaultConfig # rpmd_gov_lo_lmt (Fault Condition:rpm - governor desired speed >)" VALUE 0x00147b72 /* @ECU_Address@rpmd_gov_lo_lmt@0x0100BD98@ */ ECIPP_ALIGNMENT_UWORD 65535 Compu_rpmd_gov_lo_lmt 0 65535 /end CHARACTERISTIC
/begin COMPU_METHOD Compu_rpmd_gov_lo_lmt " " RAT_FUNC "%.0" "rpm" COEFFS 0 1 0 0 0 1 /end COMPU_METHOD
/begin CHARACTERISTIC rpmd_gov_lo_min "FaultConfig # rpmd_gov_lo_min (Fault Condition:and governor desired speed >)" VALUE 0x00147b76 /* @ECU_Address@rpmd_gov_lo_min@0x0100BDA0@ */ ECIPP_ALIGNMENT_UWORD 65535 Compu_rpmd_gov_lo_min 0 65535 /end CHARACTERISTIC
/begin COMPU_METHOD Compu_rpmd_gov_lo_min " " RAT_FUNC "%.0" "rpm" COEFFS 0 1 0 0 0 1 /end COMPU_METHOD
/begin CHARACTERISTIC rpmd_gov_lo_max "FaultConfig # rpmd_gov_lo_max (Fault Condition:and governor desired speed <)" VALUE 0x00147b74 /* @ECU_Address@rpmd_gov_lo_max@0x0100BDA8@ */ ECIPP_ALIGNMENT_UWORD 65535 Compu_rpmd_gov_lo_max 0 65535 /end CHARACTERISTIC
/begin COMPU_METHOD Compu_rpmd_gov_lo_max " " RAT_FUNC "%.0" "rpm" COEFFS 0 1 0 0 0 1 /end COMPU_METHOD
/begin CHARACTERISTIC MAP_HiExp "FaultConfig # MAP_HiExp (Fault Condition:MAP - MAP estimate >)" VALUE 0x001475a8 /* @ECU_Address@MAP_HiExp@0x0100BDB0@ */ ECIPP_ALIGNMENT_UWORD 256 Compu_MAP_HiExp 0 255.99609375 /end CHARACTERISTIC
/begin COMPU_METHOD Compu_MAP_HiExp " " RAT_FUNC "%.3" "psi" COEFFS 0 256 0 0 0 1 /end COMPU_METHOD
/begin CHARACTERISTIC PWMLO_off_loVf "FaultConfig # PWMLO_off_loVf (Fault Condition:PWM low-side feedback <)" VALUE 0x00164ffc /* @ECU_Address@PWMLO_off_loVf@0x0100C028@ */ ECIPP_ALIGNMENT_UWORD 100 Compu_PWMLO_off_loVf 0 99.9984741210938 /end CHARACTERISTIC
/begin COMPU_METHOD Compu_PWMLO_off_loVf " " RAT_FUNC "%.3" "% Vbat" COEFFS 0 655.36 0 0 0 1 /end COMPU_METHOD
/begin CHARACTERISTIC PWMLO_off_loDC "FaultConfig # PWMLO_off_loDC (Fault Condition:and PWM duty-cycle <)" VALUE 0x00164ffa /* @ECU_Address@PWMLO_off_loDC@0x0100C030@ */ ECIPP_ALIGNMENT_UWORD 100 Compu_PWMLO_off_loDC 0 99.9984741210938 /end CHARACTERISTIC
/begin COMPU_METHOD Compu_PWMLO_off_loDC " " RAT_FUNC "%.3" "%" COEFFS 0 655.36 0 0 0 1 /end COMPU_METHOD
/begin CHARACTERISTIC PWMLO_on_hiVf "FaultConfig # PWMLO_on_hiVf (Fault Condition:PWM low-side feedback >)" VALUE 0x00165000 /* @ECU_Address@PWMLO_on_hiVf@0x0100C038@ */ ECIPP_ALIGNMENT_UWORD 100 Compu_PWMLO_on_hiVf 0 99.9984741210938 /end CHARACTERISTIC
/begin COMPU_METHOD Compu_PWMLO_on_hiVf " " RAT_FUNC "%.3" "% Vbat" COEFFS 0 655.36 0 0 0 1 /end COMPU_METHOD
/begin CHARACTERISTIC PWMLO_on_hiDC "FaultConfig # PWMLO_on_hiDC (Fault Condition:and PWM duty-cycle >)" VALUE 0x00164ffe /* @ECU_Address@PWMLO_on_hiDC@0x0100C040@ */ ECIPP_ALIGNMENT_UWORD 100 Compu_PWMLO_on_hiDC 0 99.9984741210938 /end CHARACTERISTIC
/begin COMPU_METHOD Compu_PWMLO_on_hiDC " " RAT_FUNC "%.3" "%" COEFFS 0 655.36 0 0 0 1 /end COMPU_METHOD
/begin CHARACTERISTIC IOAI_alternator "{IOAI_alternator&0xff=0:Default / standard pin}{IOAI_alternator&0xff=1:Aux PUD1}{IOAI_alternator&0xff=2:Aux PUD2}{IOAI_alternator&0xff=3:Aux PUD3}{IOAI_alternator&0xff=4:Aux PUD4}{IOAI_alternator&0xff=5:Aux PUD5}{IOAI_alternator&0xff=6:Aux PUD6}{IOAI_alte" VALUE 0x00147dcd /* @ECU_Address@IOAI_alternator@0x0100C048@ */ ECIPP_ALIGNMENT_UBYTE 255 IOAI_alternator_COMPU_VTAB 0 255 BIT_MASK 0xff /end CHARACTERISTIC
/begin COMPU_METHOD IOAI_alternator_COMPU_VTAB "Verbal Table" TAB_VERB "%.0" "list" COMPU_TAB_REF IOAI_alternator_COMPU_VTAB_REF /end COMPU_METHOD
/begin COMPU_VTAB IOAI_alternator_COMPU_VTAB_REF "Verbal Table" TAB_VERB 51 0 "Default / standard pin" 1 "Aux PUD1" 2 "Aux PUD2" 3 "Aux PUD3" 4 "Aux PUD4" 5 "Aux PUD5" 6 "Aux PUD6" 7 "Aux PUD7" 8 "Aux PUD8" 9 "Aux PUD9" 10 "Aux PUD10" 11 "Aux PUD11" 12 "Aux PUD12" 13 "Aux PUD13" 14 "Aux PUD14" 15 "Aux PUD15" 16 "Aux PUD16" 17 "Aux PUD17" 18 "Aux PUD18" 19 "Aux PUD19" 20 "Aux PUD20" 21 "Aux PUD21" 22 "Aux PUD22" 23 "Aux PUD23" 24 "Aux PUD24" 25 "Aux PUD25" 26 "Aux DIG1" 27 "Aux DIG2" 28 "Aux DIG3" 29 "Aux DIG4" 30 "Aux DIG5" 31 "Aux DIG6" 32 "Aux DIG7" 33 "Aux DIG8" 34 "Aux DIG9" 35 "Aux DIG10" 36 "Aux DIG11" 37 "Aux DIG12" 38 "Aux DIG13" 39 "Aux DIG14" 40 "Aux DIG15" 41 "Aux DIG16" 42 "Aux DIG17" 43 "Aux DIG18" 44 "Aux DIG19" 45 "Aux DIG20" 46 "Aux DIG21" 47 "Aux DIG22" 48 "Aux DIG23" 49 "Aux DIG24" 50 "Aux DIG25" DEFAULT_VALUE "UNKNOWN" /end COMPU_VTAB
/begin CHARACTERISTIC UGF1_Hv_lo_limit "FaultConfig # UGF1_Hv_lo_limit (Fault Condition:or <)" VALUE 0x001479da /* @ECU_Address@UGF1_Hv_lo_limit@0x0100C0A8@ */ ECIPP_ALIGNMENT_UWORD 256 Compu_UGF1_Hv_lo_limit 0 255.99609375 /end CHARACTERISTIC
/begin COMPU_METHOD Compu_UGF1_Hv_lo_limit " " RAT_FUNC "%.3" "volts" COEFFS 0 256 0 0 0 1 /end COMPU_METHOD
/begin CHARACTERISTIC UGF1_Hv_hi_limit "FaultConfig # UGF1_Hv_hi_limit (Fault Condition:UEGO1 heater supply voltage >)" VALUE 0x001479d8 /* @ECU_Address@UGF1_Hv_hi_limit@0x0100C0B0@ */ ECIPP_ALIGNMENT_UWORD 256 Compu_UGF1_Hv_hi_limit 0 255.99609375 /end CHARACTERISTIC
/begin COMPU_METHOD Compu_UGF1_Hv_hi_limit " " RAT_FUNC "%.3" "volts" COEFFS 0 256 0 0 0 1 /end COMPU_METHOD
/begin CHARACTERISTIC UGF2_Hv_lo_limit "FaultConfig # UGF2_Hv_lo_limit (Fault Condition:or <)" VALUE 0x001479de /* @ECU_Address@UGF2_Hv_lo_limit@0x0100C0B8@ */ ECIPP_ALIGNMENT_UWORD 256 Compu_UGF2_Hv_lo_limit 0 255.99609375 /end CHARACTERISTIC
/begin COMPU_METHOD Compu_UGF2_Hv_lo_limit " " RAT_FUNC "%.3" "volts" COEFFS 0 256 0 0 0 1 /end COMPU_METHOD
/begin CHARACTERISTIC UGF2_Hv_hi_limit "FaultConfig # UGF2_Hv_hi_limit (Fault Condition:UEGO2 heater supply voltage >)" VALUE 0x001479dc /* @ECU_Address@UGF2_Hv_hi_limit@0x0100C0C0@ */ ECIPP_ALIGNMENT_UWORD 256 Compu_UGF2_Hv_hi_limit 0 255.99609375 /end CHARACTERISTIC
/begin COMPU_METHOD Compu_UGF2_Hv_hi_limit " " RAT_FUNC "%.3" "volts" COEFFS 0 256 0 0 0 1 /end COMPU_METHOD
/begin CHARACTERISTIC CFV_mdot_pct_hi "Fuel # CFV_mdot_pct_hi (Fault Condition:(actual flow - commanded flow) >)" VALUE 0x00144266 /* @ECU_Address@CFV_mdot_pct_hi@0x0100C2A8@ */ ECIPP_ALIGNMENT_SWORD 6400 Compu_CFV_mdot_pct_hi -6400 6399.8046875 /end CHARACTERISTIC
/begin COMPU_METHOD Compu_CFV_mdot_pct_hi " " RAT_FUNC "%.3" "%" COEFFS 0 5.12 0 0 0 1 /end COMPU_METHOD
/begin CHARACTERISTIC CFV_mdot_pct_lo "Fuel # CFV_mdot_pct_lo (Fault Condition:(actual flow - commanded flow) <)" VALUE 0x00144268 /* @ECU_Address@CFV_mdot_pct_lo@0x0100C2B0@ */ ECIPP_ALIGNMENT_SWORD 6400 Compu_CFV_mdot_pct_lo -6400 6399.8046875 /end CHARACTERISTIC
/begin COMPU_METHOD Compu_CFV_mdot_pct_lo " " RAT_FUNC "%.3" "%" COEFFS 0 5.12 0 0 0 1 /end COMPU_METHOD
/begin CHARACTERISTIC CATdP_Paux_cal "{CATdP_Paux_cal&0xff=0:Aux Press A}{CATdP_Paux_cal&0xff=1:Aux Press B}{CATdP_Paux_cal&0xff=2:Aux Press C}{CATdP_Paux_cal&0xff=3:Aux Press D}" VALUE 0x00147ceb /* @ECU_Address@CATdP_Paux_cal@0x0100C2F8@ */ ECIPP_ALIGNMENT_UBYTE 255 CATdP_Paux_cal_COMPU_VTAB 0 255 BIT_MASK 0xff /end CHARACTERISTIC
/begin COMPU_METHOD CATdP_Paux_cal_COMPU_VTAB "Verbal Table" TAB_VERB "%.0" "list" COMPU_TAB_REF CATdP_Paux_cal_COMPU_VTAB_REF /end COMPU_METHOD
/begin COMPU_VTAB CATdP_Paux_cal_COMPU_VTAB_REF "Verbal Table" TAB_VERB 4 0 "Aux Press A" 1 "Aux Press B" 2 "Aux Press C" 3 "Aux Press D" DEFAULT_VALUE "UNKNOWN" /end COMPU_VTAB
/begin CHARACTERISTIC CATdP_Vdot_min "General # CATdP_Vdot_min" VALUE 0x001466e4 /* @ECU_Address@CATdP_Vdot_min@0x0100C300@ */ ECIPP_ALIGNMENT_UWORD 8192 Compu_CATdP_Vdot_min 0 8191.875 /end CHARACTERISTIC
/begin COMPU_METHOD Compu_CATdP_Vdot_min " " RAT_FUNC "%.3" "liters/sec" COEFFS 0 8 0 0 0 1 /end COMPU_METHOD
/begin CHARACTERISTIC TPS2_angle_at_full "IOConfig # TPS2_angle_at_full" VALUE 0x00148D16 /* @ECU_Address@TPS2_angle_at_full@0x0100C310@ */ ECIPP_ALIGNMENT_UWORD 100 Compu_TPS2_angle_at_full 0 99.9984741210938 /end CHARACTERISTIC
/begin COMPU_METHOD Compu_TPS2_angle_at_full " " RAT_FUNC "%.3" "%" COEFFS 0 655.36 0 0 0 1 /end COMPU_METHOD
/begin CHARACTERISTIC APS2_angle_at_full "IOConfig # APS2_angle_at_full" VALUE 0x00148EEA /* @ECU_Address@APS2_angle_at_full@0x0100C318@ */ ECIPP_ALIGNMENT_UWORD 100 Compu_APS2_angle_at_full 0 99.9984741210938 /end CHARACTERISTIC
/begin COMPU_METHOD Compu_APS2_angle_at_full " " RAT_FUNC "%.3" "%" COEFFS 0 655.36 0 0 0 1 /end COMPU_METHOD
/begin CHARACTERISTIC BPS2_angle_at_full "IOConfig # BPS2_angle_at_full" VALUE 0x00148F8A /* @ECU_Address@BPS2_angle_at_full@0x0100C320@ */ ECIPP_ALIGNMENT_UWORD 100 Compu_BPS2_angle_at_full 0 99.9984741210938 /end CHARACTERISTIC
/begin COMPU_METHOD Compu_BPS2_angle_at_full " " RAT_FUNC "%.3" "%" COEFFS 0 655.36 0 0 0 1 /end COMPU_METHOD
/begin CHARACTERISTIC DBW_fault_Ilim "FaultConfig # DBW_fault_Ilim (Fault Condition:DBW electrical model current >)" VALUE 0x00148D58 /* @ECU_Address@DBW_fault_Ilim@0x0100C328@ */ ECIPP_ALIGNMENT_UWORD 64 Compu_DBW_fault_Ilim 0 63.9990234375 /end CHARACTERISTIC
/begin COMPU_METHOD Compu_DBW_fault_Ilim " " RAT_FUNC "%.3" "amps" COEFFS 0 1024 0 0 0 1 /end COMPU_METHOD
/begin CHARACTERISTIC HBA_fault_Ilim "FaultConfig # HBA_fault_Ilim (Fault Condition:HBA electrical model current >)" VALUE 0x00148F2C /* @ECU_Address@HBA_fault_Ilim@0x0100C330@ */ ECIPP_ALIGNMENT_UWORD 64 Compu_HBA_fault_Ilim 0 63.9990234375 /end CHARACTERISTIC
/begin COMPU_METHOD Compu_HBA_fault_Ilim " " RAT_FUNC "%.3" "amps" COEFFS 0 1024 0 0 0 1 /end COMPU_METHOD
/begin CHARACTERISTIC HBB_fault_Ilim "FaultConfig # HBB_fault_Ilim (Fault Condition:HBB electrical model current >)" VALUE 0x00148FCC /* @ECU_Address@HBB_fault_Ilim@0x0100C338@ */ ECIPP_ALIGNMENT_UWORD 64 Compu_HBB_fault_Ilim 0 63.9990234375 /end CHARACTERISTIC
/begin COMPU_METHOD Compu_HBB_fault_Ilim " " RAT_FUNC "%.3" "amps" COEFFS 0 1024 0 0 0 1 /end COMPU_METHOD
/begin CHARACTERISTIC FauxA_Funits "{FauxA_Funits&0xff=0:gpm}{FauxA_Funits&0xff=1:Lpm}" VALUE 0x00147d96 /* @ECU_Address@FauxA_Funits@0x0100C6E8@ */ ECIPP_ALIGNMENT_UBYTE 255 FauxA_Funits_COMPU_VTAB 0 255 BIT_MASK 0xff /end CHARACTERISTIC
/begin COMPU_METHOD FauxA_Funits_COMPU_VTAB "Verbal Table" TAB_VERB "%.0" "list" COMPU_TAB_REF FauxA_Funits_COMPU_VTAB_REF /end COMPU_METHOD
/begin COMPU_VTAB FauxA_Funits_COMPU_VTAB_REF "Verbal Table" TAB_VERB 2 0 "gpm" 1 "Lpm" DEFAULT_VALUE "UNKNOWN" /end COMPU_VTAB
/begin CHARACTERISTIC FauxB_Funits "{FauxB_Funits&0xff=0:gpm}{FauxB_Funits&0xff=1:Lpm}" VALUE 0x00147d97 /* @ECU_Address@FauxB_Funits@0x0100C6F0@ */ ECIPP_ALIGNMENT_UBYTE 255 FauxB_Funits_COMPU_VTAB 0 255 BIT_MASK 0xff /end CHARACTERISTIC
/begin COMPU_METHOD FauxB_Funits_COMPU_VTAB "Verbal Table" TAB_VERB "%.0" "list" COMPU_TAB_REF FauxB_Funits_COMPU_VTAB_REF /end COMPU_METHOD
/begin COMPU_VTAB FauxB_Funits_COMPU_VTAB_REF "Verbal Table" TAB_VERB 2 0 "gpm" 1 "Lpm" DEFAULT_VALUE "UNKNOWN" /end COMPU_VTAB
/begin CHARACTERISTIC FAUX1_Faux_cal "{FAUX1_Faux_cal&0xff=0:Aux Flow A}{FAUX1_Faux_cal&0xff=1:Aux Flow B}" VALUE 0x00147D47 /* @ECU_Address@FAUX1_Faux_cal@0x0100C708@ */ ECIPP_ALIGNMENT_UBYTE 255 FAUX1_Faux_cal_COMPU_VTAB 0 255 BIT_MASK 0xff /end CHARACTERISTIC
/begin COMPU_METHOD FAUX1_Faux_cal_COMPU_VTAB "Verbal Table" TAB_VERB "%.0" "list" COMPU_TAB_REF FAUX1_Faux_cal_COMPU_VTAB_REF /end COMPU_METHOD
/begin COMPU_VTAB FAUX1_Faux_cal_COMPU_VTAB_REF "Verbal Table" TAB_VERB 2 0 "Aux Flow A" 1 "Aux Flow B" DEFAULT_VALUE "UNKNOWN" /end COMPU_VTAB
/begin CHARACTERISTIC FAUX2_Faux_cal "{FAUX2_Faux_cal&0xff=0:Aux Flow A}{FAUX2_Faux_cal&0xff=1:Aux Flow B}" VALUE 0x00147D48 /* @ECU_Address@FAUX2_Faux_cal@0x0100C710@ */ ECIPP_ALIGNMENT_UBYTE 255 FAUX2_Faux_cal_COMPU_VTAB 0 255 BIT_MASK 0xff /end CHARACTERISTIC
/begin COMPU_METHOD FAUX2_Faux_cal_COMPU_VTAB "Verbal Table" TAB_VERB "%.0" "list" COMPU_TAB_REF FAUX2_Faux_cal_COMPU_VTAB_REF /end COMPU_METHOD
/begin COMPU_VTAB FAUX2_Faux_cal_COMPU_VTAB_REF "Verbal Table" TAB_VERB 2 0 "Aux Flow A" 1 "Aux Flow B" DEFAULT_VALUE "UNKNOWN" /end COMPU_VTAB
/begin CHARACTERISTIC FAUX1_ena "{FAUX1_ena&0xff=0:Disabled}{FAUX1_ena&0xff=1:Aux PUD1}{FAUX1_ena&0xff=2:Aux PUD2}{FAUX1_ena&0xff=3:Aux PUD3}{FAUX1_ena&0xff=4:Aux PUD4}{FAUX1_ena&0xff=5:Aux PUD5}{FAUX1_ena&0xff=6:Aux PUD6}{FAUX1_ena&0xff=7:Aux PUD7}{FAUX1_ena&0xff=8:Aux PUD8}{FAUX1_ena&0" VALUE 0x00147D49 /* @ECU_Address@FAUX1_ena@0x0100C718@ */ ECIPP_ALIGNMENT_UBYTE 255 FAUX1_ena_COMPU_VTAB 0 255 BIT_MASK 0xff /end CHARACTERISTIC
/begin COMPU_METHOD FAUX1_ena_COMPU_VTAB "Verbal Table" TAB_VERB "%.0" "list" COMPU_TAB_REF FAUX1_ena_COMPU_VTAB_REF /end COMPU_METHOD
/begin COMPU_VTAB FAUX1_ena_COMPU_VTAB_REF "Verbal Table" TAB_VERB 10 0 "Disabled" 1 "Aux PUD1" 2 "Aux PUD2" 3 "Aux PUD3" 4 "Aux PUD4" 5 "Aux PUD5" 6 "Aux PUD6" 7 "Aux PUD7" 8 "Aux PUD8" 9 "Aux PUD9" DEFAULT_VALUE "UNKNOWN" /end COMPU_VTAB
/begin CHARACTERISTIC FAUX2_ena "{FAUX2_ena&0xff=0:Disabled}{FAUX2_ena&0xff=1:Aux PUD1}{FAUX2_ena&0xff=2:Aux PUD2}{FAUX2_ena&0xff=3:Aux PUD3}{FAUX2_ena&0xff=4:Aux PUD4}{FAUX2_ena&0xff=5:Aux PUD5}{FAUX2_ena&0xff=6:Aux PUD6}{FAUX2_ena&0xff=7:Aux PUD7}{FAUX2_ena&0xff=8:Aux PUD8}{FAUX2_ena&0" VALUE 0x00147D4A /* @ECU_Address@FAUX2_ena@0x0100C720@ */ ECIPP_ALIGNMENT_UBYTE 255 FAUX2_ena_COMPU_VTAB 0 255 BIT_MASK 0xff /end CHARACTERISTIC
/begin COMPU_METHOD FAUX2_ena_COMPU_VTAB "Verbal Table" TAB_VERB "%.0" "list" COMPU_TAB_REF FAUX2_ena_COMPU_VTAB_REF /end COMPU_METHOD
/begin COMPU_VTAB FAUX2_ena_COMPU_VTAB_REF "Verbal Table" TAB_VERB 10 0 "Disabled" 1 "Aux PUD1" 2 "Aux PUD2" 3 "Aux PUD3" 4 "Aux PUD4" 5 "Aux PUD5" 6 "Aux PUD6" 7 "Aux PUD7" 8 "Aux PUD8" 9 "Aux PUD9" DEFAULT_VALUE "UNKNOWN" /end COMPU_VTAB
/begin CHARACTERISTIC CoolingH2OLow_pct "FaultConfig # CoolingH2OLow_pct (Fault Condition:cooling water flow low by more than)" VALUE 0x00146780 /* @ECU_Address@CoolingH2OLow_pct@0x0100C750@ */ ECIPP_ALIGNMENT_UWORD 65535 Compu_CoolingH2OLow_pct 0 65535 /end CHARACTERISTIC
/begin COMPU_METHOD Compu_CoolingH2OLow_pct " " RAT_FUNC "%.0" "%" COEFFS 0 1 0 0 0 1 /end COMPU_METHOD
/begin CHARACTERISTIC IAT_vdr_slct "{IAT_vdr_slct&0xff=0:Default}{IAT_vdr_slct&0xff=1:2.21K ohms}{IAT_vdr_slct&0xff=2:22.1K ohms}" VALUE 0x00147db3 /* @ECU_Address@IAT_vdr_slct@0x0100C768@ */ ECIPP_ALIGNMENT_UBYTE 255 IAT_vdr_slct_COMPU_VTAB 0 255 BIT_MASK 0xff /end CHARACTERISTIC
/begin COMPU_METHOD IAT_vdr_slct_COMPU_VTAB "Verbal Table" TAB_VERB "%.0" "list" COMPU_TAB_REF IAT_vdr_slct_COMPU_VTAB_REF /end COMPU_METHOD
/begin COMPU_VTAB IAT_vdr_slct_COMPU_VTAB_REF "Verbal Table" TAB_VERB 3 0 "Default" 1 "2.21K ohms" 2 "22.1K ohms" DEFAULT_VALUE "UNKNOWN" /end COMPU_VTAB
/begin CHARACTERISTIC EBP_Paux_cal "{EBP_Paux_cal&0xff=0:Aux Press A}{EBP_Paux_cal&0xff=1:Aux Press B}{EBP_Paux_cal&0xff=2:Aux Press C}{EBP_Paux_cal&0xff=3:Aux Press D}" VALUE 0x00147d13 /* @ECU_Address@EBP_Paux_cal@0x0100C7F8@ */ ECIPP_ALIGNMENT_UBYTE 255 EBP_Paux_cal_COMPU_VTAB 0 255 BIT_MASK 0xff /end CHARACTERISTIC
/begin COMPU_METHOD EBP_Paux_cal_COMPU_VTAB "Verbal Table" TAB_VERB "%.0" "list" COMPU_TAB_REF EBP_Paux_cal_COMPU_VTAB_REF /end COMPU_METHOD
/begin COMPU_VTAB EBP_Paux_cal_COMPU_VTAB_REF "Verbal Table" TAB_VERB 4 0 "Aux Press A" 1 "Aux Press B" 2 "Aux Press C" 3 "Aux Press D" DEFAULT_VALUE "UNKNOWN" /end COMPU_VTAB
/begin CHARACTERISTIC fuel_throt_mode "{fuel_throt_mode&0xff=0:Legacy}{fuel_throt_mode&0xff=1:Corrected}" VALUE 0x0014817f /* @ECU_Address@fuel_throt_mode@0x0100CBE8@ */ ECIPP_ALIGNMENT_UBYTE 255 fuel_throt_mode_COMPU_VTAB 0 255 BIT_MASK 0xff /end CHARACTERISTIC
/begin COMPU_METHOD fuel_throt_mode_COMPU_VTAB "Verbal Table" TAB_VERB "%.0" "list" COMPU_TAB_REF fuel_throt_mode_COMPU_VTAB_REF /end COMPU_METHOD
/begin COMPU_VTAB fuel_throt_mode_COMPU_VTAB_REF "Verbal Table" TAB_VERB 2 0 "Legacy" 1 "Corrected" DEFAULT_VALUE "UNKNOWN" /end COMPU_VTAB
/begin CHARACTERISTIC UGF1_drift_min_lvl2 "FaultConfig # UGF1_drift_min_lvl2 (Fault Condition:UEGO1 drift compensation accumulator <)" VALUE 0x00146554 /* @ECU_Address@UGF1_drift_min_lvl2@0x0100CD20@ */ ECIPP_ALIGNMENT_SWORD 100 Compu_UGF1_drift_min_lvl2 -100 99.9969482421875 /end CHARACTERISTIC
/begin COMPU_METHOD Compu_UGF1_drift_min_lvl2 " " RAT_FUNC "%.3" "% Ip" COEFFS 0 327.68 0 0 0 1 /end COMPU_METHOD
/begin CHARACTERISTIC UGF1_drift_max_lvl2 "FaultConfig # UGF1_drift_max_lvl2 (Fault Condition:or >)" VALUE 0x00146550 /* @ECU_Address@UGF1_drift_max_lvl2@0x0100CD28@ */ ECIPP_ALIGNMENT_SWORD 100 Compu_UGF1_drift_max_lvl2 -100 99.9969482421875 /end CHARACTERISTIC
/begin COMPU_METHOD Compu_UGF1_drift_max_lvl2 " " RAT_FUNC "%.3" "% Ip" COEFFS 0 327.68 0 0 0 1 /end COMPU_METHOD
/begin CHARACTERISTIC UGF2_drift_min_lvl2 "FaultConfig # UGF2_drift_min_lvl2 (Fault Condition:UEGO2 drift compensation accumulator <)" VALUE 0x0014655c /* @ECU_Address@UGF2_drift_min_lvl2@0x0100CD30@ */ ECIPP_ALIGNMENT_SWORD 100 Compu_UGF2_drift_min_lvl2 -100 99.9969482421875 /end CHARACTERISTIC
/begin COMPU_METHOD Compu_UGF2_drift_min_lvl2 " " RAT_FUNC "%.3" "% Ip" COEFFS 0 327.68 0 0 0 1 /end COMPU_METHOD
/begin CHARACTERISTIC UGF2_drift_max_lvl2 "FaultConfig # UGF2_drift_max_lvl2 (Fault Condition:or >)" VALUE 0x00146558 /* @ECU_Address@UGF2_drift_max_lvl2@0x0100CD38@ */ ECIPP_ALIGNMENT_SWORD 100 Compu_UGF2_drift_max_lvl2 -100 99.9969482421875 /end CHARACTERISTIC
/begin COMPU_METHOD Compu_UGF2_drift_max_lvl2 " " RAT_FUNC "%.3" "% Ip" COEFFS 0 327.68 0 0 0 1 /end COMPU_METHOD
/begin CHARACTERISTIC TAUX1_max "FaultConfig # TAUX1_max (Fault Condition:AUX Temperature 1 >)" VALUE 0x0016C3D8 /* @ECU_Address@TAUX1_max@0x0100CD70@ */ ECIPP_ALIGNMENT_UWORD 7732 Compu_TAUX1_max -460 7731.875 /end CHARACTERISTIC
/begin COMPU_METHOD Compu_TAUX1_max " " RAT_FUNC "%.3" "deg F" COEFFS 0 8 3680 0 0 1 /end COMPU_METHOD
/begin CHARACTERISTIC TAUX1_min "FaultConfig # TAUX1_min (Fault Condition:AUX Temperature 1 <)" VALUE 0x0016C3D6 /* @ECU_Address@TAUX1_min@0x0100CD78@ */ ECIPP_ALIGNMENT_UWORD 7732 Compu_TAUX1_min -460 7731.875 /end CHARACTERISTIC
/begin COMPU_METHOD Compu_TAUX1_min " " RAT_FUNC "%.3" "deg F" COEFFS 0 8 3680 0 0 1 /end COMPU_METHOD
/begin CHARACTERISTIC TAUX2_max "FaultConfig # TAUX2_max (Fault Condition:AUX Temperature 2 >)" VALUE 0x0016C3DC /* @ECU_Address@TAUX2_max@0x0100CD80@ */ ECIPP_ALIGNMENT_UWORD 7732 Compu_TAUX2_max -460 7731.875 /end CHARACTERISTIC
/begin COMPU_METHOD Compu_TAUX2_max " " RAT_FUNC "%.3" "deg F" COEFFS 0 8 3680 0 0 1 /end COMPU_METHOD
/begin CHARACTERISTIC TAUX2_min "FaultConfig # TAUX2_min (Fault Condition:AUX Temperature 2 <)" VALUE 0x0016C3DA /* @ECU_Address@TAUX2_min@0x0100CD88@ */ ECIPP_ALIGNMENT_UWORD 7732 Compu_TAUX2_min -460 7731.875 /end CHARACTERISTIC
/begin COMPU_METHOD Compu_TAUX2_min " " RAT_FUNC "%.3" "deg F" COEFFS 0 8 3680 0 0 1 /end COMPU_METHOD
/begin CHARACTERISTIC TAUX3_max "FaultConfig # TAUX3_max (Fault Condition:AUX Temperature 3 >)" VALUE 0x0016C3E0 /* @ECU_Address@TAUX3_max@0x0100CD90@ */ ECIPP_ALIGNMENT_UWORD 7732 Compu_TAUX3_max -460 7731.875 /end CHARACTERISTIC
/begin COMPU_METHOD Compu_TAUX3_max " " RAT_FUNC "%.3" "deg F" COEFFS 0 8 3680 0 0 1 /end COMPU_METHOD
/begin CHARACTERISTIC TAUX3_min "FaultConfig # TAUX3_min (Fault Condition:AUX Temperature 3 <)" VALUE 0x0016C3DE /* @ECU_Address@TAUX3_min@0x0100CD98@ */ ECIPP_ALIGNMENT_UWORD 7732 Compu_TAUX3_min -460 7731.875 /end CHARACTERISTIC
/begin COMPU_METHOD Compu_TAUX3_min " " RAT_FUNC "%.3" "deg F" COEFFS 0 8 3680 0 0 1 /end COMPU_METHOD
/begin CHARACTERISTIC TAUX4_max "FaultConfig # TAUX4_max (Fault Condition:AUX Temperature 4 >)" VALUE 0x0016C3E4 /* @ECU_Address@TAUX4_max@0x0100CDA0@ */ ECIPP_ALIGNMENT_UWORD 7732 Compu_TAUX4_max -460 7731.875 /end CHARACTERISTIC
/begin COMPU_METHOD Compu_TAUX4_max " " RAT_FUNC "%.3" "deg F" COEFFS 0 8 3680 0 0 1 /end COMPU_METHOD
/begin CHARACTERISTIC TAUX4_min "FaultConfig # TAUX4_min (Fault Condition:AUX Temperature 4 <)" VALUE 0x0016C3E2 /* @ECU_Address@TAUX4_min@0x0100CDA8@ */ ECIPP_ALIGNMENT_UWORD 7732 Compu_TAUX4_min -460 7731.875 /end CHARACTERISTIC
/begin COMPU_METHOD Compu_TAUX4_min " " RAT_FUNC "%.3" "deg F" COEFFS 0 8 3680 0 0 1 /end COMPU_METHOD
/begin CHARACTERISTIC TAUX_dT1_max "FaultConfig # TAUX_dT1_max (Fault Condition:AUX Temperature X-Y >)" VALUE 0x0016C3CE /* @ECU_Address@TAUX_dT1_max@0x0100CDC8@ */ ECIPP_ALIGNMENT_SWORD 4096 Compu_TAUX_dT1_max -4096 4095.875 /end CHARACTERISTIC
/begin COMPU_METHOD Compu_TAUX_dT1_max " " RAT_FUNC "%.3" "deg F" COEFFS 0 8 0 0 0 1 /end COMPU_METHOD
/begin CHARACTERISTIC TAUX_dT1_min "FaultConfig # TAUX_dT1_min (Fault Condition:AUX Temperature X-Y <)" VALUE 0x0016C3CC /* @ECU_Address@TAUX_dT1_min@0x0100CDD0@ */ ECIPP_ALIGNMENT_SWORD 4096 Compu_TAUX_dT1_min -4096 4095.875 /end CHARACTERISTIC
/begin COMPU_METHOD Compu_TAUX_dT1_min " " RAT_FUNC "%.3" "deg F" COEFFS 0 8 0 0 0 1 /end COMPU_METHOD
/begin CHARACTERISTIC TAUX_dT2_max "FaultConfig # TAUX_dT2_max (Fault Condition:AUX Temperature X-Y >)" VALUE 0x0016C3D4 /* @ECU_Address@TAUX_dT2_max@0x0100CDF0@ */ ECIPP_ALIGNMENT_SWORD 4096 Compu_TAUX_dT2_max -4096 4095.875 /end CHARACTERISTIC
/begin COMPU_METHOD Compu_TAUX_dT2_max " " RAT_FUNC "%.3" "deg F" COEFFS 0 8 0 0 0 1 /end COMPU_METHOD
/begin CHARACTERISTIC TAUX_dT2_min "FaultConfig # TAUX_dT2_min (Fault Condition:AUX Temperature X-Y <)" VALUE 0x0016C3D2 /* @ECU_Address@TAUX_dT2_min@0x0100CDF8@ */ ECIPP_ALIGNMENT_SWORD 4096 Compu_TAUX_dT2_min -4096 4095.875 /end CHARACTERISTIC
/begin COMPU_METHOD Compu_TAUX_dT2_min " " RAT_FUNC "%.3" "deg F" COEFFS 0 8 0 0 0 1 /end COMPU_METHOD
/begin CHARACTERISTIC PAUX1_max "FaultConfig # PAUX1_max (Fault Condition:AUX Pressure 1 >)" VALUE 0x0016C3BC /* @ECU_Address@PAUX1_max@0x0100CE00@ */ ECIPP_ALIGNMENT_UWORD 256 Compu_PAUX1_max 0 255.99609375 /end CHARACTERISTIC
/begin COMPU_METHOD Compu_PAUX1_max " " RAT_FUNC "%.3" "psia" COEFFS 0 256 0 0 0 1 /end COMPU_METHOD
/begin CHARACTERISTIC PAUX1_min "FaultConfig # PAUX1_min (Fault Condition:AUX Pressure 1 <)" VALUE 0x0016C3BA /* @ECU_Address@PAUX1_min@0x0100CE08@ */ ECIPP_ALIGNMENT_UWORD 256 Compu_PAUX1_min 0 255.99609375 /end CHARACTERISTIC
/begin COMPU_METHOD Compu_PAUX1_min " " RAT_FUNC "%.3" "psia" COEFFS 0 256 0 0 0 1 /end COMPU_METHOD
/begin CHARACTERISTIC PAUX2_max "FaultConfig # PAUX2_max (Fault Condition:AUX Pressure 2 >)" VALUE 0x0016C3C0 /* @ECU_Address@PAUX2_max@0x0100CE10@ */ ECIPP_ALIGNMENT_UWORD 256 Compu_PAUX2_max 0 255.99609375 /end CHARACTERISTIC
/begin COMPU_METHOD Compu_PAUX2_max " " RAT_FUNC "%.3" "psia" COEFFS 0 256 0 0 0 1 /end COMPU_METHOD
/begin CHARACTERISTIC PAUX2_min "FaultConfig # PAUX2_min (Fault Condition:AUX Pressure 2 <)" VALUE 0x0016C3BE /* @ECU_Address@PAUX2_min@0x0100CE18@ */ ECIPP_ALIGNMENT_UWORD 256 Compu_PAUX2_min 0 255.99609375 /end CHARACTERISTIC
/begin COMPU_METHOD Compu_PAUX2_min " " RAT_FUNC "%.3" "psia" COEFFS 0 256 0 0 0 1 /end COMPU_METHOD
/begin CHARACTERISTIC PAUX3_max "FaultConfig # PAUX3_max (Fault Condition:AUX Pressure 3 >)" VALUE 0x0016C3C4 /* @ECU_Address@PAUX3_max@0x0100CE20@ */ ECIPP_ALIGNMENT_UWORD 256 Compu_PAUX3_max 0 255.99609375 /end CHARACTERISTIC
/begin COMPU_METHOD Compu_PAUX3_max " " RAT_FUNC "%.3" "psia" COEFFS 0 256 0 0 0 1 /end COMPU_METHOD
/begin CHARACTERISTIC PAUX3_min "FaultConfig # PAUX3_min (Fault Condition:AUX Pressure 3 <)" VALUE 0x0016C3C2 /* @ECU_Address@PAUX3_min@0x0100CE28@ */ ECIPP_ALIGNMENT_UWORD 256 Compu_PAUX3_min 0 255.99609375 /end CHARACTERISTIC
/begin COMPU_METHOD Compu_PAUX3_min " " RAT_FUNC "%.3" "psia" COEFFS 0 256 0 0 0 1 /end COMPU_METHOD
/begin CHARACTERISTIC PAUX4_max "FaultConfig # PAUX4_max (Fault Condition:AUX Pressure 4 >)" VALUE 0x0016C3C8 /* @ECU_Address@PAUX4_max@0x0100CE30@ */ ECIPP_ALIGNMENT_UWORD 256 Compu_PAUX4_max 0 255.99609375 /end CHARACTERISTIC
/begin COMPU_METHOD Compu_PAUX4_max " " RAT_FUNC "%.3" "psia" COEFFS 0 256 0 0 0 1 /end COMPU_METHOD
/begin CHARACTERISTIC PAUX4_min "FaultConfig # PAUX4_min (Fault Condition:AUX Pressure 4 <)" VALUE 0x0016C3C6 /* @ECU_Address@PAUX4_min@0x0100CE38@ */ ECIPP_ALIGNMENT_UWORD 256 Compu_PAUX4_min 0 255.99609375 /end CHARACTERISTIC
/begin COMPU_METHOD Compu_PAUX4_min " " RAT_FUNC "%.3" "psia" COEFFS 0 256 0 0 0 1 /end COMPU_METHOD
/begin CHARACTERISTIC PAUX_dP1_max "FaultConfig # PAUX_dP1_max (Fault Condition:AUX Pressure X-Y >)" VALUE 0x0016C3B2 /* @ECU_Address@PAUX_dP1_max@0x0100CE58@ */ ECIPP_ALIGNMENT_SWORD 128 Compu_PAUX_dP1_max -128 127.99609375 /end CHARACTERISTIC
/begin COMPU_METHOD Compu_PAUX_dP1_max " " RAT_FUNC "%.3" "psi" COEFFS 0 256 0 0 0 1 /end COMPU_METHOD
/begin CHARACTERISTIC PAUX_dP1_min "FaultConfig # PAUX_dP1_min (Fault Condition:AUX Pressure X-Y <)" VALUE 0x0016C3B0 /* @ECU_Address@PAUX_dP1_min@0x0100CE60@ */ ECIPP_ALIGNMENT_SWORD 128 Compu_PAUX_dP1_min -128 127.99609375 /end CHARACTERISTIC
/begin COMPU_METHOD Compu_PAUX_dP1_min " " RAT_FUNC "%.3" "psi" COEFFS 0 256 0 0 0 1 /end COMPU_METHOD
/begin CHARACTERISTIC PAUX_dP2_max "FaultConfig # PAUX_dP2_max (Fault Condition:AUX Pressure X-Y >)" VALUE 0x0016C3B8 /* @ECU_Address@PAUX_dP2_max@0x0100CE80@ */ ECIPP_ALIGNMENT_SWORD 128 Compu_PAUX_dP2_max -128 127.99609375 /end CHARACTERISTIC
/begin COMPU_METHOD Compu_PAUX_dP2_max " " RAT_FUNC "%.3" "psi" COEFFS 0 256 0 0 0 1 /end COMPU_METHOD
/begin CHARACTERISTIC PAUX_dP2_min "FaultConfig # PAUX_dP2_min (Fault Condition:AUX Pressure X-Y <)" VALUE 0x0016C3B6 /* @ECU_Address@PAUX_dP2_min@0x0100CE88@ */ ECIPP_ALIGNMENT_SWORD 128 Compu_PAUX_dP2_min -128 127.99609375 /end CHARACTERISTIC
/begin COMPU_METHOD Compu_PAUX_dP2_min " " RAT_FUNC "%.3" "psi" COEFFS 0 256 0 0 0 1 /end COMPU_METHOD
/begin CHARACTERISTIC ADIG20_max "FaultConfig # ADIG20_max (Fault Condition:AUX DIG20 >)" VALUE 0x001633ba /* @ECU_Address@ADIG20_max@0x0100D248@ */ ECIPP_ALIGNMENT_UWORD 256 Compu_ADIG20_max 0 255.99609375 /end CHARACTERISTIC
/begin COMPU_METHOD Compu_ADIG20_max " " RAT_FUNC "%.3" "volts" COEFFS 0 256 0 0 0 1 /end COMPU_METHOD
/begin CHARACTERISTIC ADIG20_min "FaultConfig # ADIG20_min (Fault Condition:AUX DIG20 <)" VALUE 0x001633bc /* @ECU_Address@ADIG20_min@0x0100D250@ */ ECIPP_ALIGNMENT_UWORD 256 Compu_ADIG20_min 0 255.99609375 /end CHARACTERISTIC
/begin COMPU_METHOD Compu_ADIG20_min " " RAT_FUNC "%.3" "volts" COEFFS 0 256 0 0 0 1 /end COMPU_METHOD
/begin CHARACTERISTIC ADIG21_max "FaultConfig # ADIG21_max (Fault Condition:AUX DIG21 >)" VALUE 0x001633be /* @ECU_Address@ADIG21_max@0x0100D258@ */ ECIPP_ALIGNMENT_UWORD 256 Compu_ADIG21_max 0 255.99609375 /end CHARACTERISTIC
/begin COMPU_METHOD Compu_ADIG21_max " " RAT_FUNC "%.3" "volts" COEFFS 0 256 0 0 0 1 /end COMPU_METHOD
/begin CHARACTERISTIC ADIG21_min "FaultConfig # ADIG21_min (Fault Condition:AUX DIG21 <)" VALUE 0x001633c0 /* @ECU_Address@ADIG21_min@0x0100D260@ */ ECIPP_ALIGNMENT_UWORD 256 Compu_ADIG21_min 0 255.99609375 /end CHARACTERISTIC
/begin COMPU_METHOD Compu_ADIG21_min " " RAT_FUNC "%.3" "volts" COEFFS 0 256 0 0 0 1 /end COMPU_METHOD
/begin CHARACTERISTIC ADIG22_max "FaultConfig # ADIG22_max (Fault Condition:AUX DIG22 >)" VALUE 0x001633c2 /* @ECU_Address@ADIG22_max@0x0100D268@ */ ECIPP_ALIGNMENT_UWORD 256 Compu_ADIG22_max 0 255.99609375 /end CHARACTERISTIC
/begin COMPU_METHOD Compu_ADIG22_max " " RAT_FUNC "%.3" "volts" COEFFS 0 256 0 0 0 1 /end COMPU_METHOD
/begin CHARACTERISTIC ADIG22_min "FaultConfig # ADIG22_min (Fault Condition:AUX DIG22 <)" VALUE 0x001633c4 /* @ECU_Address@ADIG22_min@0x0100D270@ */ ECIPP_ALIGNMENT_UWORD 256 Compu_ADIG22_min 0 255.99609375 /end CHARACTERISTIC
/begin COMPU_METHOD Compu_ADIG22_min " " RAT_FUNC "%.3" "volts" COEFFS 0 256 0 0 0 1 /end COMPU_METHOD
/begin CHARACTERISTIC ADIG23_max "FaultConfig # ADIG23_max (Fault Condition:AUX DIG23 >)" VALUE 0x001633c6 /* @ECU_Address@ADIG23_max@0x0100D278@ */ ECIPP_ALIGNMENT_UWORD 256 Compu_ADIG23_max 0 255.99609375 /end CHARACTERISTIC
/begin COMPU_METHOD Compu_ADIG23_max " " RAT_FUNC "%.3" "volts" COEFFS 0 256 0 0 0 1 /end COMPU_METHOD
/begin CHARACTERISTIC ADIG23_min "FaultConfig # ADIG23_min (Fault Condition:AUX DIG23 <)" VALUE 0x001633c8 /* @ECU_Address@ADIG23_min@0x0100D280@ */ ECIPP_ALIGNMENT_UWORD 256 Compu_ADIG23_min 0 255.99609375 /end CHARACTERISTIC
/begin COMPU_METHOD Compu_ADIG23_min " " RAT_FUNC "%.3" "volts" COEFFS 0 256 0 0 0 1 /end COMPU_METHOD
/begin CHARACTERISTIC ADIG24_max "FaultConfig # ADIG24_max (Fault Condition:AUX DIG24 >)" VALUE 0x001633ca /* @ECU_Address@ADIG24_max@0x0100D288@ */ ECIPP_ALIGNMENT_UWORD 256 Compu_ADIG24_max 0 255.99609375 /end CHARACTERISTIC
/begin COMPU_METHOD Compu_ADIG24_max " " RAT_FUNC "%.3" "volts" COEFFS 0 256 0 0 0 1 /end COMPU_METHOD
/begin CHARACTERISTIC ADIG24_min "FaultConfig # ADIG24_min (Fault Condition:AUX DIG24 <)" VALUE 0x001633cc /* @ECU_Address@ADIG24_min@0x0100D290@ */ ECIPP_ALIGNMENT_UWORD 256 Compu_ADIG24_min 0 255.99609375 /end CHARACTERISTIC
/begin COMPU_METHOD Compu_ADIG24_min " " RAT_FUNC "%.3" "volts" COEFFS 0 256 0 0 0 1 /end COMPU_METHOD
/begin CHARACTERISTIC ADIG25_max "FaultConfig # ADIG25_max (Fault Condition:AUX DIG25 >)" VALUE 0x001633ce /* @ECU_Address@ADIG25_max@0x0100D298@ */ ECIPP_ALIGNMENT_UWORD 256 Compu_ADIG25_max 0 255.99609375 /end CHARACTERISTIC
/begin COMPU_METHOD Compu_ADIG25_max " " RAT_FUNC "%.3" "volts" COEFFS 0 256 0 0 0 1 /end COMPU_METHOD
/begin CHARACTERISTIC ADIG25_min "FaultConfig # ADIG25_min (Fault Condition:AUX DIG25 <)" VALUE 0x001633d0 /* @ECU_Address@ADIG25_min@0x0100D2A0@ */ ECIPP_ALIGNMENT_UWORD 256 Compu_ADIG25_min 0 255.99609375 /end CHARACTERISTIC
/begin COMPU_METHOD Compu_ADIG25_min " " RAT_FUNC "%.3" "volts" COEFFS 0 256 0 0 0 1 /end COMPU_METHOD
/begin CHARACTERISTIC EGR_LoExp_mdot "Air # EGR_LoExp_mdot (Fault Condition:EGR flow command >)" VALUE 0x001408a4 /* @ECU_Address@EGR_LoExp_mdot@0x0100D390@ */ ECIPP_ALIGNMENT_UWORD 1024 Compu_EGR_LoExp_mdot 0 1023.984375 /end CHARACTERISTIC
/begin COMPU_METHOD Compu_EGR_LoExp_mdot " " RAT_FUNC "%.3" "g/sec" COEFFS 0 64 0 0 0 1 /end COMPU_METHOD
/begin CHARACTERISTIC EGR_HiExp_mdot "Air # EGR_HiExp_mdot (Fault Condition:EGR flow command >)" VALUE 0x00140898 /* @ECU_Address@EGR_HiExp_mdot@0x0100D398@ */ ECIPP_ALIGNMENT_UWORD 1024 Compu_EGR_HiExp_mdot 0 1023.984375 /end CHARACTERISTIC
/begin COMPU_METHOD Compu_EGR_HiExp_mdot " " RAT_FUNC "%.3" "g/sec" COEFFS 0 64 0 0 0 1 /end COMPU_METHOD
/begin CHARACTERISTIC EGR_LoExp_pctmin "Air # EGR_LoExp_pctmin (Fault Condition:and command >)" VALUE 0x001408a8 /* @ECU_Address@EGR_LoExp_pctmin@0x0100D3A0@ */ ECIPP_ALIGNMENT_UWORD 400 Compu_EGR_LoExp_pctmin 0 399.993896484375 /end CHARACTERISTIC
/begin COMPU_METHOD Compu_EGR_LoExp_pctmin " " RAT_FUNC "%.3" "% dil" COEFFS 0 163.84 0 0 0 1 /end COMPU_METHOD
/begin CHARACTERISTIC EGR_LoExp_pcterr "Air # EGR_LoExp_pcterr (Fault Condition:and command - actual >)" VALUE 0x001408a6 /* @ECU_Address@EGR_LoExp_pcterr@0x0100D3A8@ */ ECIPP_ALIGNMENT_UWORD 400 Compu_EGR_LoExp_pcterr 0 399.993896484375 /end CHARACTERISTIC
/begin COMPU_METHOD Compu_EGR_LoExp_pcterr " " RAT_FUNC "%.3" "% dil" COEFFS 0 163.84 0 0 0 1 /end COMPU_METHOD
/begin CHARACTERISTIC EGR_HiExp_pctmin "Air # EGR_HiExp_pctmin (Fault Condition:and command >)" VALUE 0x0014089c /* @ECU_Address@EGR_HiExp_pctmin@0x0100D3B0@ */ ECIPP_ALIGNMENT_UWORD 400 Compu_EGR_HiExp_pctmin 0 399.993896484375 /end CHARACTERISTIC
/begin COMPU_METHOD Compu_EGR_HiExp_pctmin " " RAT_FUNC "%.3" "% dil" COEFFS 0 163.84 0 0 0 1 /end COMPU_METHOD
/begin CHARACTERISTIC EGR_HiExp_pcterr "Air # EGR_HiExp_pcterr (Fault Condition:and actual - command >)" VALUE 0x0014089a /* @ECU_Address@EGR_HiExp_pcterr@0x0100D3B8@ */ ECIPP_ALIGNMENT_UWORD 400 Compu_EGR_HiExp_pcterr 0 399.993896484375 /end CHARACTERISTIC
/begin COMPU_METHOD Compu_EGR_HiExp_pcterr " " RAT_FUNC "%.3" "% dil" COEFFS 0 163.84 0 0 0 1 /end COMPU_METHOD
/begin CHARACTERISTIC UEGO_extreme_rich "{UEGO_extreme_rich&0xff=0:Normal}{UEGO_extreme_rich&0xff=1:Extreme Rich}" VALUE 0x001480d5 /* @ECU_Address@UEGO_extreme_rich@0x0100D3D0@ */ ECIPP_ALIGNMENT_UBYTE 255 UEGO_extreme_rich_COMPU_VTAB 0 255 BIT_MASK 0xff /end CHARACTERISTIC
/begin COMPU_METHOD UEGO_extreme_rich_COMPU_VTAB "Verbal Table" TAB_VERB "%.0" "list" COMPU_TAB_REF UEGO_extreme_rich_COMPU_VTAB_REF /end COMPU_METHOD
/begin COMPU_VTAB UEGO_extreme_rich_COMPU_VTAB_REF "Verbal Table" TAB_VERB 2 0 "Normal" 1 "Extreme Rich" DEFAULT_VALUE "UNKNOWN" /end COMPU_VTAB
/begin CHARACTERISTIC inj_peak_I "Peak current target" VALUE 0x00147b3e /* @ECU_Address@inj_peak_I@0x0100D430@ */ ECIPP_ALIGNMENT_UWORD 64 Compu_inj_peak_I 0 63.9990234375 /end CHARACTERISTIC
/begin COMPU_METHOD Compu_inj_peak_I " " RAT_FUNC "%.2" "amps" COEFFS 0 1024 0 0 0 1 /end COMPU_METHOD
/begin CHARACTERISTIC inj_high_peak_I "Cold start peak current target" VALUE 0x00147b30 /* @ECU_Address@inj_high_peak_I@0x0100D438@ */ ECIPP_ALIGNMENT_UWORD 64 Compu_inj_high_peak_I 0 63.9990234375 /end CHARACTERISTIC
/begin COMPU_METHOD Compu_inj_high_peak_I " " RAT_FUNC "%.2" "amps" COEFFS 0 1024 0 0 0 1 /end COMPU_METHOD
/begin CHARACTERISTIC inj_hold_I "Hold current target" VALUE 0x00147b34 /* @ECU_Address@inj_hold_I@0x0100D440@ */ ECIPP_ALIGNMENT_UWORD 64 Compu_inj_hold_I 0 63.9990234375 /end CHARACTERISTIC
/begin COMPU_METHOD Compu_inj_hold_I " " RAT_FUNC "%.2" "amps" COEFFS 0 1024 0 0 0 1 /end COMPU_METHOD
/begin CHARACTERISTIC inj_pk_hld_I "Peak to Hold current trig" VALUE 0x00147b42 /* @ECU_Address@inj_pk_hld_I@0x0100D448@ */ ECIPP_ALIGNMENT_UWORD 64 Compu_inj_pk_hld_I 0 63.9990234375 /end CHARACTERISTIC
/begin COMPU_METHOD Compu_inj_pk_hld_I " " RAT_FUNC "%.2" "amps" COEFFS 0 1024 0 0 0 1 /end COMPU_METHOD
/begin CHARACTERISTIC inj_rapid_pk_I "Rapid peak decay current trig" VALUE 0x00147b44 /* @ECU_Address@inj_rapid_pk_I@0x0100D450@ */ ECIPP_ALIGNMENT_UWORD 64 Compu_inj_rapid_pk_I 0 63.9990234375 /end CHARACTERISTIC
/begin COMPU_METHOD Compu_inj_rapid_pk_I " " RAT_FUNC "%.2" "amps" COEFFS 0 1024 0 0 0 1 /end COMPU_METHOD
/begin CHARACTERISTIC inj_peak_offT "Peak off-time" VALUE 0x00147b40 /* @ECU_Address@inj_peak_offT@0x0100D458@ */ ECIPP_ALIGNMENT_UWORD 4096 Compu_inj_peak_offT 0 4095.9375 /end CHARACTERISTIC
/begin COMPU_METHOD Compu_inj_peak_offT " " RAT_FUNC "%.1" "us" COEFFS 0 16 0 0 0 1 /end COMPU_METHOD
/begin CHARACTERISTIC inj_high_peak_offT "Cold start peak off-time" VALUE 0x00147b32 /* @ECU_Address@inj_high_peak_offT@0x0100D460@ */ ECIPP_ALIGNMENT_UWORD 4096 Compu_inj_high_peak_offT 0 4095.9375 /end CHARACTERISTIC
/begin COMPU_METHOD Compu_inj_high_peak_offT " " RAT_FUNC "%.1" "us" COEFFS 0 16 0 0 0 1 /end COMPU_METHOD
/begin CHARACTERISTIC inj_hold_offT "Hold off-time" VALUE 0x00147b36 /* @ECU_Address@inj_hold_offT@0x0100D468@ */ ECIPP_ALIGNMENT_UWORD 4096 Compu_inj_hold_offT 0 4095.9375 /end CHARACTERISTIC
/begin COMPU_METHOD Compu_inj_hold_offT " " RAT_FUNC "%.1" "us" COEFFS 0 16 0 0 0 1 /end COMPU_METHOD
/begin CHARACTERISTIC PWPCF_mode "{PWPCF_mode&0xff=0:Fixed scalar}{PWPCF_mode&0xff=1:Voltage-based}" VALUE 0x00149057 /* @ECU_Address@PWPCF_mode@0x0100D470@ */ ECIPP_ALIGNMENT_UBYTE 255 PWPCF_mode_COMPU_VTAB 0 255 BIT_MASK 0xff /end CHARACTERISTIC
/begin COMPU_METHOD PWPCF_mode_COMPU_VTAB "Verbal Table" TAB_VERB "%.0" "list" COMPU_TAB_REF PWPCF_mode_COMPU_VTAB_REF /end COMPU_METHOD
/begin COMPU_VTAB PWPCF_mode_COMPU_VTAB_REF "Verbal Table" TAB_VERB 2 0 "Fixed scalar" 1 "Voltage-based" DEFAULT_VALUE "UNKNOWN" /end COMPU_VTAB
/begin CHARACTERISTIC PWPCF_mode_I2 "{PWPCF_mode_I2&0xff=0:Fixed scalar}{PWPCF_mode_I2&0xff=1:Voltage-based}" VALUE 0x0014908F /* @ECU_Address@PWPCF_mode_I2@0x0100D478@ */ ECIPP_ALIGNMENT_UBYTE 255 PWPCF_mode_I2_COMPU_VTAB 0 255 BIT_MASK 0xff /end CHARACTERISTIC
/begin COMPU_METHOD PWPCF_mode_I2_COMPU_VTAB "Verbal Table" TAB_VERB "%.0" "list" COMPU_TAB_REF PWPCF_mode_I2_COMPU_VTAB_REF /end COMPU_METHOD
/begin COMPU_VTAB PWPCF_mode_I2_COMPU_VTAB_REF "Verbal Table" TAB_VERB 2 0 "Fixed scalar" 1 "Voltage-based" DEFAULT_VALUE "UNKNOWN" /end COMPU_VTAB
/begin CHARACTERISTIC inj_min_riseT "Min rise time to peak current" VALUE 0x00147b3c /* @ECU_Address@inj_min_riseT@0x0100D620@ */ ECIPP_ALIGNMENT_UWORD 65535 Compu_inj_min_riseT 0 65535 /end CHARACTERISTIC
/begin COMPU_METHOD Compu_inj_min_riseT " " RAT_FUNC "%.0" "us" COEFFS 0 1 0 0 0 1 /end COMPU_METHOD
/begin CHARACTERISTIC inj_max_riseT "Max rise time to peak current" VALUE 0x00147b3a /* @ECU_Address@inj_max_riseT@0x0100D628@ */ ECIPP_ALIGNMENT_UWORD 65535 Compu_inj_max_riseT 0 65535 /end CHARACTERISTIC
/begin COMPU_METHOD Compu_inj_max_riseT " " RAT_FUNC "%.0" "us" COEFFS 0 1 0 0 0 1 /end COMPU_METHOD
/begin CHARACTERISTIC INJD_ph_maxR_minV "FaultConfig # INJD_ph_maxR_minV (Fault Condition:and battery voltage >)" VALUE 0x001474c4 /* @ECU_Address@INJD_ph_maxR_minV@0x0100D630@ */ ECIPP_ALIGNMENT_UWORD 256 Compu_INJD_ph_maxR_minV 0 255.99609375 /end CHARACTERISTIC
/begin COMPU_METHOD Compu_INJD_ph_maxR_minV " " RAT_FUNC "%.3" "volts" COEFFS 0 256 0 0 0 1 /end COMPU_METHOD
/begin MEASUREMENT fm_ign_cyc_counter "Ignition cycle counter" UWORD Compu_fm_ign_cyc_counter 0 0 0 65535 ECU_ADDRESS 0x0100DA28 /end MEASUREMENT
/begin COMPU_METHOD Compu_fm_ign_cyc_counter " " RAT_FUNC "%.0" "cycles" COEFFS 0 1 0 0 0 1 /end COMPU_METHOD
/begin MEASUREMENT fm_wuc_wo_MIL "Warm-ups without MIL" UBYTE Compu_fm_wuc_wo_MIL 0 0 0 255 ECU_ADDRESS 0x0100DA38 /end MEASUREMENT
/begin COMPU_METHOD Compu_fm_wuc_wo_MIL " " RAT_FUNC "%.0" "cycles" COEFFS 0 1 0 0 0 1 /end COMPU_METHOD
/begin MEASUREMENT fm_wu_since_clr "Warm-ups since clear" UBYTE Compu_fm_wu_since_clr 0 0 0 255 ECU_ADDRESS 0x0100DA40 /end MEASUREMENT
/begin COMPU_METHOD Compu_fm_wu_since_clr " " RAT_FUNC "%.0" "cycles" COEFFS 0 1 0 0 0 1 /end COMPU_METHOD
/begin MEASUREMENT fm_rt_while_MIL "Engine run time with MIL" ULONG Compu_fm_rt_while_MIL 0 0 0 71582788.25 ECU_ADDRESS 0x0100DA48 /end MEASUREMENT
/begin COMPU_METHOD Compu_fm_rt_while_MIL " " RAT_FUNC "%.0" "minutes" COEFFS 0 60 0 0 0 1 /end COMPU_METHOD
/begin MEASUREMENT fm_rt_since_clr "Engine run time since clear" ULONG Compu_fm_rt_since_clr 0 0 0 71582788.25 ECU_ADDRESS 0x0100DA50 /end MEASUREMENT
/begin COMPU_METHOD Compu_fm_rt_since_clr " " RAT_FUNC "%.0" "minutes" COEFFS 0 60 0 0 0 1 /end COMPU_METHOD
/begin MEASUREMENT fm_dist_while_MIL "Distance with MIL" ULONG Compu_fm_dist_while_MIL 0 0 0 536870911.875 ECU_ADDRESS 0x0100DA58 /end MEASUREMENT
/begin COMPU_METHOD Compu_fm_dist_while_MIL " " RAT_FUNC "%.0" "km" COEFFS 0 8 0 0 0 1 /end COMPU_METHOD
/begin MEASUREMENT fm_dist_since_clr "Distance since clear" ULONG Compu_fm_dist_since_clr 0 0 0 536870911.875 ECU_ADDRESS 0x0100DA60 /end MEASUREMENT
/begin COMPU_METHOD Compu_fm_dist_since_clr " " RAT_FUNC "%.0" "km" COEFFS 0 8 0 0 0 1 /end COMPU_METHOD
/begin CHARACTERISTIC ECTHst_reset_key "General # ECTHst_reset_key" VALUE 0x00146798 /* @ECU_Address@ECTHst_reset_key@0x0100DD50@ */ ECIPP_ALIGNMENT_UWORD 65535 Compu_ECTHst_reset_key 0 65535 /end CHARACTERISTIC
/begin COMPU_METHOD Compu_ECTHst_reset_key " " RAT_FUNC "%.0" "-" COEFFS 0 1 0 0 0 1 /end COMPU_METHOD
/begin CHARACTERISTIC J1939_RSsetpt_loss "FaultConfig # J1939_RSsetpt_loss (Fault Condition:Loss of RS setpoint after engine running >=)" VALUE 0x0014750c /* @ECU_Address@J1939_RSsetpt_loss@0x0100DDA0@ */ ECIPP_ALIGNMENT_UWORD 66 Compu_J1939_RSsetpt_loss 0 65.535 /end CHARACTERISTIC
/begin COMPU_METHOD Compu_J1939_RSsetpt_loss " " RAT_FUNC "%.3" "sec" COEFFS 0 1000 0 0 0 1 /end COMPU_METHOD
/begin CHARACTERISTIC EGRwrP_Paux_cal "{EGRwrP_Paux_cal&0xff=0:Aux Press A}{EGRwrP_Paux_cal&0xff=1:Aux Press B}{EGRwrP_Paux_cal&0xff=2:Aux Press C}{EGRwrP_Paux_cal&0xff=3:Aux Press D}" VALUE 0x001409ba /* @ECU_Address@EGRwrP_Paux_cal@0x0100DDD0@ */ ECIPP_ALIGNMENT_UBYTE 255 EGRwrP_Paux_cal_COMPU_VTAB 0 255 BIT_MASK 0xff /end CHARACTERISTIC
/begin COMPU_METHOD EGRwrP_Paux_cal_COMPU_VTAB "Verbal Table" TAB_VERB "%.0" "list" COMPU_TAB_REF EGRwrP_Paux_cal_COMPU_VTAB_REF /end COMPU_METHOD
/begin COMPU_VTAB EGRwrP_Paux_cal_COMPU_VTAB_REF "Verbal Table" TAB_VERB 4 0 "Aux Press A" 1 "Aux Press B" 2 "Aux Press C" 3 "Aux Press D" DEFAULT_VALUE "UNKNOWN" /end COMPU_VTAB
/begin CHARACTERISTIC EGRHP_def "General # EGRHP_def" VALUE 0x00140880 /* @ECU_Address@EGRHP_def@0x0100DF30@ */ ECIPP_ALIGNMENT_UWORD 256 Compu_EGRHP_def 0 255.99609375 /end CHARACTERISTIC
/begin COMPU_METHOD Compu_EGRHP_def " " RAT_FUNC "%.3" "psia" COEFFS 0 256 0 0 0 1 /end COMPU_METHOD
/begin CHARACTERISTIC EGRLP_def "General # EGRLP_def" VALUE 0x00140888 /* @ECU_Address@EGRLP_def@0x0100DF38@ */ ECIPP_ALIGNMENT_UWORD 256 Compu_EGRLP_def 0 255.99609375 /end CHARACTERISTIC
/begin COMPU_METHOD Compu_EGRLP_def " " RAT_FUNC "%.3" "psia" COEFFS 0 256 0 0 0 1 /end COMPU_METHOD
/begin CHARACTERISTIC EGRT_def "General # EGRT_def" VALUE 0x0014088a /* @ECU_Address@EGRT_def@0x0100DF40@ */ ECIPP_ALIGNMENT_UWORD 7732 Compu_EGRT_def -460 7731.875 /end CHARACTERISTIC
/begin COMPU_METHOD Compu_EGRT_def " " RAT_FUNC "%.3" "deg F" COEFFS 0 8 3680 0 0 1 /end COMPU_METHOD
/begin MEASUREMENT UEGO3_hours "UEGO hours" ULONG Compu_UEGO3_hours 0 0 0 1193046.47083333 ECU_ADDRESS 0x0100E0F0 /end MEASUREMENT
/begin COMPU_METHOD Compu_UEGO3_hours " " RAT_FUNC "%.3" "hours" COEFFS 0 3600 0 0 0 1 /end COMPU_METHOD
/begin MEASUREMENT UEGO3_drift_hours "UEGO drift time since sample" ULONG Compu_UEGO3_drift_hours 0 0 0 1193046.47083333 ECU_ADDRESS 0x0100E118 /end MEASUREMENT
/begin COMPU_METHOD Compu_UEGO3_drift_hours " " RAT_FUNC "%.3" "hours" COEFFS 0 3600 0 0 0 1 /end COMPU_METHOD
/begin MEASUREMENT UEGO3_drift_success "UEGO3 drift successful samples" ULONG Compu_UEGO3_drift_success 0 0 0 4294967295 ECU_ADDRESS 0x0100E120 /end MEASUREMENT
/begin COMPU_METHOD Compu_UEGO3_drift_success " " RAT_FUNC "%.0" "-" COEFFS 0 1 0 0 0 1 /end COMPU_METHOD
/begin MEASUREMENT UEGO3_drift_aborted "UEGO3 drift aborted samples" ULONG Compu_UEGO3_drift_aborted 0 0 0 4294967295 ECU_ADDRESS 0x0100E128 /end MEASUREMENT
/begin COMPU_METHOD Compu_UEGO3_drift_aborted " " RAT_FUNC "%.0" "-" COEFFS 0 1 0 0 0 1 /end COMPU_METHOD
/begin MEASUREMENT UEGO3_drift_accum "UEGO drift compensation accum" SLONG Compu_UEGO3_drift_accum 0 0 -100 99.9999999534339 ECU_ADDRESS 0x0100E150 /end MEASUREMENT
/begin COMPU_METHOD Compu_UEGO3_drift_accum " " RAT_FUNC "%.2" "% Ip" COEFFS 0 21474836.48 0 0 0 1 /end COMPU_METHOD
/begin MEASUREMENT UEGO4_hours "UEGO hours" ULONG Compu_UEGO4_hours 0 0 0 1193046.47083333 ECU_ADDRESS 0x0100E1C8 /end MEASUREMENT
/begin COMPU_METHOD Compu_UEGO4_hours " " RAT_FUNC "%.3" "hours" COEFFS 0 3600 0 0 0 1 /end COMPU_METHOD
/begin MEASUREMENT UEGO4_drift_hours "UEGO drift time since sample" ULONG Compu_UEGO4_drift_hours 0 0 0 1193046.47083333 ECU_ADDRESS 0x0100E1F0 /end MEASUREMENT
/begin COMPU_METHOD Compu_UEGO4_drift_hours " " RAT_FUNC "%.3" "hours" COEFFS 0 3600 0 0 0 1 /end COMPU_METHOD
/begin MEASUREMENT UEGO4_drift_success "UEGO4 drift successful samples" ULONG Compu_UEGO4_drift_success 0 0 0 4294967295 ECU_ADDRESS 0x0100E1F8 /end MEASUREMENT
/begin COMPU_METHOD Compu_UEGO4_drift_success " " RAT_FUNC "%.0" "-" COEFFS 0 1 0 0 0 1 /end COMPU_METHOD
/begin MEASUREMENT UEGO4_drift_aborted "UEGO4 drift aborted samples" ULONG Compu_UEGO4_drift_aborted 0 0 0 4294967295 ECU_ADDRESS 0x0100E200 /end MEASUREMENT
/begin COMPU_METHOD Compu_UEGO4_drift_aborted " " RAT_FUNC "%.0" "-" COEFFS 0 1 0 0 0 1 /end COMPU_METHOD
/begin MEASUREMENT UEGO4_drift_accum "UEGO drift compensation accum" SLONG Compu_UEGO4_drift_accum 0 0 -100 99.9999999534339 ECU_ADDRESS 0x0100E228 /end MEASUREMENT
/begin COMPU_METHOD Compu_UEGO4_drift_accum " " RAT_FUNC "%.2" "% Ip" COEFFS 0 21474836.48 0 0 0 1 /end COMPU_METHOD
/begin CHARACTERISTIC UGF3_run_wait "FaultConfig # UGF3_run_wait (Fault Condition:or warmup period and an additional)" VALUE 0x00144214 /* @ECU_Address@UGF3_run_wait@0x0100E460@ */ ECIPP_ALIGNMENT_ULONG 4294967 Compu_UGF3_run_wait 0 4294967.295 /end CHARACTERISTIC
/begin COMPU_METHOD Compu_UGF3_run_wait " " RAT_FUNC "%.3" "seconds" COEFFS 0 1000 0 0 0 1 /end COMPU_METHOD
/begin CHARACTERISTIC UGF3_drift_min "FaultConfig # UGF3_drift_min (Fault Condition:UEGO3 drift compensation accumulator <)" VALUE 0x00146562 /* @ECU_Address@UGF3_drift_min@0x0100E468@ */ ECIPP_ALIGNMENT_SWORD 100 Compu_UGF3_drift_min -100 99.9969482421875 /end CHARACTERISTIC
/begin COMPU_METHOD Compu_UGF3_drift_min " " RAT_FUNC "%.3" "% Ip" COEFFS 0 327.68 0 0 0 1 /end COMPU_METHOD
/begin CHARACTERISTIC UGF3_drift_max "FaultConfig # UGF3_drift_max (Fault Condition:or >)" VALUE 0x0014655e /* @ECU_Address@UGF3_drift_max@0x0100E470@ */ ECIPP_ALIGNMENT_SWORD 100 Compu_UGF3_drift_max -100 99.9969482421875 /end CHARACTERISTIC
/begin COMPU_METHOD Compu_UGF3_drift_max " " RAT_FUNC "%.3" "% Ip" COEFFS 0 327.68 0 0 0 1 /end COMPU_METHOD
/begin CHARACTERISTIC UGF3_Hv_lo_limit "FaultConfig # UGF3_Hv_lo_limit (Fault Condition:or <)" VALUE 0x001479e2 /* @ECU_Address@UGF3_Hv_lo_limit@0x0100E478@ */ ECIPP_ALIGNMENT_UWORD 256 Compu_UGF3_Hv_lo_limit 0 255.99609375 /end CHARACTERISTIC
/begin COMPU_METHOD Compu_UGF3_Hv_lo_limit " " RAT_FUNC "%.3" "volts" COEFFS 0 256 0 0 0 1 /end COMPU_METHOD
/begin CHARACTERISTIC UGF3_Hv_hi_limit "FaultConfig # UGF3_Hv_hi_limit (Fault Condition:UEGO3 heater supply voltage >)" VALUE 0x001479e0 /* @ECU_Address@UGF3_Hv_hi_limit@0x0100E480@ */ ECIPP_ALIGNMENT_UWORD 256 Compu_UGF3_Hv_hi_limit 0 255.99609375 /end CHARACTERISTIC
/begin COMPU_METHOD Compu_UGF3_Hv_hi_limit " " RAT_FUNC "%.3" "volts" COEFFS 0 256 0 0 0 1 /end COMPU_METHOD
/begin CHARACTERISTIC UGF3_drift_min_lvl2 "FaultConfig # UGF3_drift_min_lvl2 (Fault Condition:UEGO3 drift compensation accumulator <)" VALUE 0x00146564 /* @ECU_Address@UGF3_drift_min_lvl2@0x0100E488@ */ ECIPP_ALIGNMENT_SWORD 100 Compu_UGF3_drift_min_lvl2 -100 99.9969482421875 /end CHARACTERISTIC
/begin COMPU_METHOD Compu_UGF3_drift_min_lvl2 " " RAT_FUNC "%.3" "% Ip" COEFFS 0 327.68 0 0 0 1 /end COMPU_METHOD
/begin CHARACTERISTIC UGF3_drift_max_lvl2 "FaultConfig # UGF3_drift_max_lvl2 (Fault Condition:or >)" VALUE 0x00146560 /* @ECU_Address@UGF3_drift_max_lvl2@0x0100E490@ */ ECIPP_ALIGNMENT_SWORD 100 Compu_UGF3_drift_max_lvl2 -100 99.9969482421875 /end CHARACTERISTIC
/begin COMPU_METHOD Compu_UGF3_drift_max_lvl2 " " RAT_FUNC "%.3" "% Ip" COEFFS 0 327.68 0 0 0 1 /end COMPU_METHOD
/begin CHARACTERISTIC UGF4_run_wait "FaultConfig # UGF4_run_wait (Fault Condition:or warmup period and an additional)" VALUE 0x00144218 /* @ECU_Address@UGF4_run_wait@0x0100E498@ */ ECIPP_ALIGNMENT_ULONG 4294967 Compu_UGF4_run_wait 0 4294967.295 /end CHARACTERISTIC
/begin COMPU_METHOD Compu_UGF4_run_wait " " RAT_FUNC "%.3" "seconds" COEFFS 0 1000 0 0 0 1 /end COMPU_METHOD
/begin CHARACTERISTIC UGF4_drift_min "FaultConfig # UGF4_drift_min (Fault Condition:UEGO4 drift compensation accumulator <)" VALUE 0x0014656a /* @ECU_Address@UGF4_drift_min@0x0100E4A0@ */ ECIPP_ALIGNMENT_SWORD 100 Compu_UGF4_drift_min -100 99.9969482421875 /end CHARACTERISTIC
/begin COMPU_METHOD Compu_UGF4_drift_min " " RAT_FUNC "%.3" "% Ip" COEFFS 0 327.68 0 0 0 1 /end COMPU_METHOD
/begin CHARACTERISTIC UGF4_drift_max "FaultConfig # UGF4_drift_max (Fault Condition:or >)" VALUE 0x00146566 /* @ECU_Address@UGF4_drift_max@0x0100E4A8@ */ ECIPP_ALIGNMENT_SWORD 100 Compu_UGF4_drift_max -100 99.9969482421875 /end CHARACTERISTIC
/begin COMPU_METHOD Compu_UGF4_drift_max " " RAT_FUNC "%.3" "% Ip" COEFFS 0 327.68 0 0 0 1 /end COMPU_METHOD
/begin CHARACTERISTIC UGF4_Hv_lo_limit "FaultConfig # UGF4_Hv_lo_limit (Fault Condition:or <)" VALUE 0x001479e6 /* @ECU_Address@UGF4_Hv_lo_limit@0x0100E4B0@ */ ECIPP_ALIGNMENT_UWORD 256 Compu_UGF4_Hv_lo_limit 0 255.99609375 /end CHARACTERISTIC
/begin COMPU_METHOD Compu_UGF4_Hv_lo_limit " " RAT_FUNC "%.3" "volts" COEFFS 0 256 0 0 0 1 /end COMPU_METHOD
/begin CHARACTERISTIC UGF4_Hv_hi_limit "FaultConfig # UGF4_Hv_hi_limit (Fault Condition:UEGO4 heater supply voltage >)" VALUE 0x001479e4 /* @ECU_Address@UGF4_Hv_hi_limit@0x0100E4B8@ */ ECIPP_ALIGNMENT_UWORD 256 Compu_UGF4_Hv_hi_limit 0 255.99609375 /end CHARACTERISTIC
/begin COMPU_METHOD Compu_UGF4_Hv_hi_limit " " RAT_FUNC "%.3" "volts" COEFFS 0 256 0 0 0 1 /end COMPU_METHOD
/begin CHARACTERISTIC UGF4_drift_min_lvl2 "FaultConfig # UGF4_drift_min_lvl2 (Fault Condition:UEGO4 drift compensation accumulator <)" VALUE 0x0014656c /* @ECU_Address@UGF4_drift_min_lvl2@0x0100E4C0@ */ ECIPP_ALIGNMENT_SWORD 100 Compu_UGF4_drift_min_lvl2 -100 99.9969482421875 /end CHARACTERISTIC
/begin COMPU_METHOD Compu_UGF4_drift_min_lvl2 " " RAT_FUNC "%.3" "% Ip" COEFFS 0 327.68 0 0 0 1 /end COMPU_METHOD
/begin CHARACTERISTIC UGF4_drift_max_lvl2 "FaultConfig # UGF4_drift_max_lvl2 (Fault Condition:or >)" VALUE 0x00146568 /* @ECU_Address@UGF4_drift_max_lvl2@0x0100E4C8@ */ ECIPP_ALIGNMENT_SWORD 100 Compu_UGF4_drift_max_lvl2 -100 99.9969482421875 /end CHARACTERISTIC
/begin COMPU_METHOD Compu_UGF4_drift_max_lvl2 " " RAT_FUNC "%.3" "% Ip" COEFFS 0 327.68 0 0 0 1 /end COMPU_METHOD
/begin CHARACTERISTIC UEGOH3_off_loVf "FaultConfig # UEGOH3_off_loVf (Fault Condition:UEGO3 heater low-side feedback <)" VALUE 0x001650ac /* @ECU_Address@UEGOH3_off_loVf@0x0100E4D0@ */ ECIPP_ALIGNMENT_UWORD 100 Compu_UEGOH3_off_loVf 0 99.9984741210938 /end CHARACTERISTIC
/begin COMPU_METHOD Compu_UEGOH3_off_loVf " " RAT_FUNC "%.3" "% Vbat" COEFFS 0 655.36 0 0 0 1 /end COMPU_METHOD
/begin CHARACTERISTIC UEGOH4_off_loVf "FaultConfig # UEGOH4_off_loVf (Fault Condition:UEGO4 heater low-side feedback <)" VALUE 0x001650b4 /* @ECU_Address@UEGOH4_off_loVf@0x0100E4D8@ */ ECIPP_ALIGNMENT_UWORD 100 Compu_UEGOH4_off_loVf 0 99.9984741210938 /end CHARACTERISTIC
/begin COMPU_METHOD Compu_UEGOH4_off_loVf " " RAT_FUNC "%.3" "% Vbat" COEFFS 0 655.36 0 0 0 1 /end COMPU_METHOD
/begin CHARACTERISTIC UEGOH3_on_hiVf "FaultConfig # UEGOH3_on_hiVf (Fault Condition:UEGO3 heater low-side feedback >)" VALUE 0x001650b0 /* @ECU_Address@UEGOH3_on_hiVf@0x0100E4E0@ */ ECIPP_ALIGNMENT_UWORD 100 Compu_UEGOH3_on_hiVf 0 99.9984741210938 /end CHARACTERISTIC
/begin COMPU_METHOD Compu_UEGOH3_on_hiVf " " RAT_FUNC "%.3" "% Vbat" COEFFS 0 655.36 0 0 0 1 /end COMPU_METHOD
/begin CHARACTERISTIC UEGOH4_on_hiVf "FaultConfig # UEGOH4_on_hiVf (Fault Condition:UEGO4 heater low-side feedback >)" VALUE 0x001650b8 /* @ECU_Address@UEGOH4_on_hiVf@0x0100E4E8@ */ ECIPP_ALIGNMENT_UWORD 100 Compu_UEGOH4_on_hiVf 0 99.9984741210938 /end CHARACTERISTIC
/begin COMPU_METHOD Compu_UEGOH4_on_hiVf " " RAT_FUNC "%.3" "% Vbat" COEFFS 0 655.36 0 0 0 1 /end COMPU_METHOD
/begin CHARACTERISTIC UEGOH3_off_loDC "FaultConfig # UEGOH3_off_loDC (Fault Condition:and PWM duty-cycle <)" VALUE 0x001650aa /* @ECU_Address@UEGOH3_off_loDC@0x0100E4F0@ */ ECIPP_ALIGNMENT_UWORD 100 Compu_UEGOH3_off_loDC 0 99.9984741210938 /end CHARACTERISTIC
/begin COMPU_METHOD Compu_UEGOH3_off_loDC " " RAT_FUNC "%.3" "%" COEFFS 0 655.36 0 0 0 1 /end COMPU_METHOD
/begin CHARACTERISTIC UEGOH4_off_loDC "FaultConfig # UEGOH4_off_loDC (Fault Condition:and PWM duty-cycle <)" VALUE 0x001650b2 /* @ECU_Address@UEGOH4_off_loDC@0x0100E4F8@ */ ECIPP_ALIGNMENT_UWORD 100 Compu_UEGOH4_off_loDC 0 99.9984741210938 /end CHARACTERISTIC
/begin COMPU_METHOD Compu_UEGOH4_off_loDC " " RAT_FUNC "%.3" "%" COEFFS 0 655.36 0 0 0 1 /end COMPU_METHOD
/begin CHARACTERISTIC UEGOH3_on_hiDC "FaultConfig # UEGOH3_on_hiDC (Fault Condition:and PWM duty-cycle >)" VALUE 0x001650ae /* @ECU_Address@UEGOH3_on_hiDC@0x0100E500@ */ ECIPP_ALIGNMENT_UWORD 100 Compu_UEGOH3_on_hiDC 0 99.9984741210938 /end CHARACTERISTIC
/begin COMPU_METHOD Compu_UEGOH3_on_hiDC " " RAT_FUNC "%.3" "%" COEFFS 0 655.36 0 0 0 1 /end COMPU_METHOD
/begin CHARACTERISTIC UEGOH4_on_hiDC "FaultConfig # UEGOH4_on_hiDC (Fault Condition:and PWM duty-cycle >)" VALUE 0x001650b6 /* @ECU_Address@UEGOH4_on_hiDC@0x0100E508@ */ ECIPP_ALIGNMENT_UWORD 100 Compu_UEGOH4_on_hiDC 0 99.9984741210938 /end CHARACTERISTIC
/begin COMPU_METHOD Compu_UEGOH4_on_hiDC " " RAT_FUNC "%.3" "%" COEFFS 0 655.36 0 0 0 1 /end COMPU_METHOD
/begin CHARACTERISTIC ECT_HiExp_MAP "FaultConfig # ECT_HiExp_MAP (Fault Condition:and MAP >)" VALUE 0x001467a4 /* @ECU_Address@ECT_HiExp_MAP@0x0100E6D8@ */ ECIPP_ALIGNMENT_UWORD 256 Compu_ECT_HiExp_MAP 0 255.99609375 /end CHARACTERISTIC
/begin COMPU_METHOD Compu_ECT_HiExp_MAP " " RAT_FUNC "%.3" "psia" COEFFS 0 256 0 0 0 1 /end COMPU_METHOD
/begin CHARACTERISTIC ECT_HiExp2_MAP "FaultConfig # ECT_HiExp2_MAP (Fault Condition:and MAP >)" VALUE 0x001467a0 /* @ECU_Address@ECT_HiExp2_MAP@0x0100E6E0@ */ ECIPP_ALIGNMENT_UWORD 256 Compu_ECT_HiExp2_MAP 0 255.99609375 /end CHARACTERISTIC
/begin COMPU_METHOD Compu_ECT_HiExp2_MAP " " RAT_FUNC "%.3" "psia" COEFFS 0 256 0 0 0 1 /end COMPU_METHOD
/begin CHARACTERISTIC ECT_LoExp "FaultConfig # ECT_LoExp (Fault Condition:ECT <)" VALUE 0x001467a8 /* @ECU_Address@ECT_LoExp@0x0100E6E8@ */ ECIPP_ALIGNMENT_UWORD 564 Compu_ECT_LoExp -460 563.984375 /end CHARACTERISTIC
/begin COMPU_METHOD Compu_ECT_LoExp " " RAT_FUNC "%.3" "deg F" COEFFS 0 64 29440 0 0 1 /end COMPU_METHOD
/begin CHARACTERISTIC ECT_LoExp_rpm "FaultConfig # ECT_LoExp_rpm (Fault Condition:and RPM >)" VALUE 0x001467b2 /* @ECU_Address@ECT_LoExp_rpm@0x0100E6F0@ */ ECIPP_ALIGNMENT_UWORD 65535 Compu_ECT_LoExp_rpm 0 65535 /end CHARACTERISTIC
/begin COMPU_METHOD Compu_ECT_LoExp_rpm " " RAT_FUNC "%.0" "rpm" COEFFS 0 1 0 0 0 1 /end COMPU_METHOD
/begin CHARACTERISTIC ECT_LoExp_MAP "FaultConfig # ECT_LoExp_MAP (Fault Condition:and MAP >)" VALUE 0x001467b0 /* @ECU_Address@ECT_LoExp_MAP@0x0100E6F8@ */ ECIPP_ALIGNMENT_UWORD 256 Compu_ECT_LoExp_MAP 0 255.99609375 /end CHARACTERISTIC
/begin COMPU_METHOD Compu_ECT_LoExp_MAP " " RAT_FUNC "%.3" "psia" COEFFS 0 256 0 0 0 1 /end COMPU_METHOD
/begin CHARACTERISTIC ECT_LoExp_wait "FaultConfig # ECT_LoExp_wait (Fault Condition:and run-time >)" VALUE 0x001440c8 /* @ECU_Address@ECT_LoExp_wait@0x0100E700@ */ ECIPP_ALIGNMENT_ULONG 4294967 Compu_ECT_LoExp_wait 0 4294967.295 /end CHARACTERISTIC
/begin COMPU_METHOD Compu_ECT_LoExp_wait " " RAT_FUNC "%.3" "seconds" COEFFS 0 1000 0 0 0 1 /end COMPU_METHOD
/begin CHARACTERISTIC ECT_LoExp2 "FaultConfig # ECT_LoExp2 (Fault Condition:ECT <)" VALUE 0x001467aa /* @ECU_Address@ECT_LoExp2@0x0100E708@ */ ECIPP_ALIGNMENT_UWORD 564 Compu_ECT_LoExp2 -460 563.984375 /end CHARACTERISTIC
/begin COMPU_METHOD Compu_ECT_LoExp2 " " RAT_FUNC "%.3" "deg F" COEFFS 0 64 29440 0 0 1 /end COMPU_METHOD
/begin CHARACTERISTIC ECT_LoExp2_rpm "FaultConfig # ECT_LoExp2_rpm (Fault Condition:and RPM >)" VALUE 0x001467ae /* @ECU_Address@ECT_LoExp2_rpm@0x0100E710@ */ ECIPP_ALIGNMENT_UWORD 65535 Compu_ECT_LoExp2_rpm 0 65535 /end CHARACTERISTIC
/begin COMPU_METHOD Compu_ECT_LoExp2_rpm " " RAT_FUNC "%.0" "rpm" COEFFS 0 1 0 0 0 1 /end COMPU_METHOD
/begin CHARACTERISTIC ECT_LoExp2_MAP "FaultConfig # ECT_LoExp2_MAP (Fault Condition:and MAP >)" VALUE 0x001467ac /* @ECU_Address@ECT_LoExp2_MAP@0x0100E718@ */ ECIPP_ALIGNMENT_UWORD 256 Compu_ECT_LoExp2_MAP 0 255.99609375 /end CHARACTERISTIC
/begin COMPU_METHOD Compu_ECT_LoExp2_MAP " " RAT_FUNC "%.3" "psia" COEFFS 0 256 0 0 0 1 /end COMPU_METHOD
/begin CHARACTERISTIC ECT_LoExp2_wait "FaultConfig # ECT_LoExp2_wait (Fault Condition:and run-time >)" VALUE 0x001440c4 /* @ECU_Address@ECT_LoExp2_wait@0x0100E720@ */ ECIPP_ALIGNMENT_ULONG 4294967 Compu_ECT_LoExp2_wait 0 4294967.295 /end CHARACTERISTIC
/begin COMPU_METHOD Compu_ECT_LoExp2_wait " " RAT_FUNC "%.3" "seconds" COEFFS 0 1000 0 0 0 1 /end COMPU_METHOD
/begin CHARACTERISTIC LowCLTemp_rpm "FaultConfig # LowCLTemp_rpm (Fault Condition:and RPM >)" VALUE 0x00147580 /* @ECU_Address@LowCLTemp_rpm@0x0100E728@ */ ECIPP_ALIGNMENT_UWORD 65535 Compu_LowCLTemp_rpm 0 65535 /end CHARACTERISTIC
/begin COMPU_METHOD Compu_LowCLTemp_rpm " " RAT_FUNC "%.0" "rpm" COEFFS 0 1 0 0 0 1 /end COMPU_METHOD
/begin CHARACTERISTIC LowCLTemp_MAP "FaultConfig # LowCLTemp_MAP (Fault Condition:and MAP >)" VALUE 0x0014757e /* @ECU_Address@LowCLTemp_MAP@0x0100E730@ */ ECIPP_ALIGNMENT_UWORD 256 Compu_LowCLTemp_MAP 0 255.99609375 /end CHARACTERISTIC
/begin COMPU_METHOD Compu_LowCLTemp_MAP " " RAT_FUNC "%.3" "psia" COEFFS 0 256 0 0 0 1 /end COMPU_METHOD
/begin CHARACTERISTIC LowDiagTemp_rpm "FaultConfig # LowDiagTemp_rpm (Fault Condition:and RPM >)" VALUE 0x00147584 /* @ECU_Address@LowDiagTemp_rpm@0x0100E738@ */ ECIPP_ALIGNMENT_UWORD 65535 Compu_LowDiagTemp_rpm 0 65535 /end CHARACTERISTIC
/begin COMPU_METHOD Compu_LowDiagTemp_rpm " " RAT_FUNC "%.0" "rpm" COEFFS 0 1 0 0 0 1 /end COMPU_METHOD
/begin CHARACTERISTIC LowDiagTemp_MAP "FaultConfig # LowDiagTemp_MAP (Fault Condition:and MAP >)" VALUE 0x00147582 /* @ECU_Address@LowDiagTemp_MAP@0x0100E740@ */ ECIPP_ALIGNMENT_UWORD 256 Compu_LowDiagTemp_MAP 0 255.99609375 /end CHARACTERISTIC
/begin COMPU_METHOD Compu_LowDiagTemp_MAP " " RAT_FUNC "%.3" "psia" COEFFS 0 256 0 0 0 1 /end COMPU_METHOD
/begin CHARACTERISTIC HiDiagTemp_wait "FaultConfig # HiDiagTemp_wait (Fault Condition:and run-time >)" VALUE 0x001440f0 /* @ECU_Address@HiDiagTemp_wait@0x0100E748@ */ ECIPP_ALIGNMENT_ULONG 4294967 Compu_HiDiagTemp_wait 0 4294967.295 /end CHARACTERISTIC
/begin COMPU_METHOD Compu_HiDiagTemp_wait " " RAT_FUNC "%.3" "seconds" COEFFS 0 1000 0 0 0 1 /end COMPU_METHOD
/begin MEASUREMENT fm_rt_while_b1 "B1 counter" ULONG Compu_fm_rt_while_b1 0 0 0 1193046.47083333 ECU_ADDRESS 0x0100E9C8 /end MEASUREMENT
/begin COMPU_METHOD Compu_fm_rt_while_b1 " " RAT_FUNC "%.2" "hours" COEFFS 0 3600 0 0 0 1 /end COMPU_METHOD
/begin MEASUREMENT fm_cycles_wo_b1 "Cycles since B1 active" UBYTE Compu_fm_cycles_wo_b1 0 0 0 255 ECU_ADDRESS 0x0100E9D0 /end MEASUREMENT
/begin COMPU_METHOD Compu_fm_cycles_wo_b1 " " RAT_FUNC "%.0" "cycles" COEFFS 0 1 0 0 0 1 /end COMPU_METHOD
/begin MEASUREMENT fm_rt_cumcont_mil "Cumulative cont-MI counter" ULONG Compu_fm_rt_cumcont_mil 0 0 0 1193046.47083333 ECU_ADDRESS 0x0100E9D8 /end MEASUREMENT
/begin COMPU_METHOD Compu_fm_rt_cumcont_mil " " RAT_FUNC "%.2" "hours" COEFFS 0 3600 0 0 0 1 /end COMPU_METHOD
/begin MEASUREMENT fm_rt_cont_mil "Continuous-MI counter" ULONG Compu_fm_rt_cont_mil 0 0 0 1193046.47083333 ECU_ADDRESS 0x0100E9E0 /end MEASUREMENT
/begin COMPU_METHOD Compu_fm_rt_cont_mil " " RAT_FUNC "%.2" "hours" COEFFS 0 3600 0 0 0 1 /end COMPU_METHOD
/begin MEASUREMENT fm_cont_mil_na_cyc "Cycles since cont-MI" UBYTE Compu_fm_cont_mil_na_cyc 0 0 0 255 ECU_ADDRESS 0x0100E9E8 /end MEASUREMENT
/begin COMPU_METHOD Compu_fm_cont_mil_na_cyc " " RAT_FUNC "%.0" "cycles" COEFFS 0 1 0 0 0 1 /end COMPU_METHOD
/begin MEASUREMENT fm_wu_cont_mil_hld "Warm-ups cont-MI held" UBYTE Compu_fm_wu_cont_mil_hld 0 0 0 255 ECU_ADDRESS 0x0100E9F0 /end MEASUREMENT
/begin COMPU_METHOD Compu_fm_wu_cont_mil_hld " " RAT_FUNC "%.0" "cycles" COEFFS 0 1 0 0 0 1 /end COMPU_METHOD
/begin MEASUREMENT fm_rt_cont_mil_hld "Engine hours cont-MI held" ULONG Compu_fm_rt_cont_mil_hld 0 0 0 1193046.47083333 ECU_ADDRESS 0x0100E9F8 /end MEASUREMENT
/begin COMPU_METHOD Compu_fm_rt_cont_mil_hld " " RAT_FUNC "%.2" "hours" COEFFS 0 3600 0 0 0 1 /end COMPU_METHOD
/begin MEASUREMENT fm_general_denom "General denominator" UWORD Compu_fm_general_denom 0 0 0 65535 ECU_ADDRESS 0x0100EA90 /end MEASUREMENT
/begin COMPU_METHOD Compu_fm_general_denom " " RAT_FUNC "%.0" "cycles" COEFFS 0 1 0 0 0 1 /end COMPU_METHOD
/begin MEASUREMENT rdy_rdy_misfire "OBD Readiness Status Ready 1" UBYTE Compu_rdy_rdy_misfire 0 0 0 255 ECU_ADDRESS 0x0100EAD0 /end MEASUREMENT
/begin COMPU_METHOD Compu_rdy_rdy_misfire " " RAT_FUNC "%.0" "-" COEFFS 0 1 0 0 0 1 /end COMPU_METHOD
/begin MEASUREMENT rdy_rdy_fuel "OBD Readiness Status Ready 2" UBYTE Compu_rdy_rdy_fuel 0 0 0 255 ECU_ADDRESS 0x0100EAD8 /end MEASUREMENT
/begin COMPU_METHOD Compu_rdy_rdy_fuel " " RAT_FUNC "%.0" "-" COEFFS 0 1 0 0 0 1 /end COMPU_METHOD
/begin MEASUREMENT rdy_rdy_compcomp "OBD Readiness Status Ready 3" UBYTE Compu_rdy_rdy_compcomp 0 0 0 255 ECU_ADDRESS 0x0100EAE0 /end MEASUREMENT
/begin COMPU_METHOD Compu_rdy_rdy_compcomp " " RAT_FUNC "%.0" "-" COEFFS 0 1 0 0 0 1 /end COMPU_METHOD
/begin MEASUREMENT rdy_rdy_cat "OBD Readiness Status Ready 4" UBYTE Compu_rdy_rdy_cat 0 0 0 255 ECU_ADDRESS 0x0100EAE8 /end MEASUREMENT
/begin COMPU_METHOD Compu_rdy_rdy_cat " " RAT_FUNC "%.0" "-" COEFFS 0 1 0 0 0 1 /end COMPU_METHOD
/begin MEASUREMENT rdy_rdy_boost "OBD Readiness Status Ready 10" UBYTE Compu_rdy_rdy_boost 0 0 0 255 ECU_ADDRESS 0x0100EB18 /end MEASUREMENT
/begin COMPU_METHOD Compu_rdy_rdy_boost " " RAT_FUNC "%.0" "-" COEFFS 0 1 0 0 0 1 /end COMPU_METHOD
/begin MEASUREMENT rdy_rdy_o2 "OBD Readiness Status Ready 11" UBYTE Compu_rdy_rdy_o2 0 0 0 255 ECU_ADDRESS 0x0100EB20 /end MEASUREMENT
/begin COMPU_METHOD Compu_rdy_rdy_o2 " " RAT_FUNC "%.0" "-" COEFFS 0 1 0 0 0 1 /end COMPU_METHOD
/begin MEASUREMENT rdy_rdy_o2_heater "OBD Readiness Status Ready 13" UBYTE Compu_rdy_rdy_o2_heater 0 0 0 255 ECU_ADDRESS 0x0100EB30 /end MEASUREMENT
/begin COMPU_METHOD Compu_rdy_rdy_o2_heater " " RAT_FUNC "%.0" "-" COEFFS 0 1 0 0 0 1 /end COMPU_METHOD
/begin MEASUREMENT rdy_rdy_egr_vvt "OBD Readiness Status Ready 15" UBYTE Compu_rdy_rdy_egr_vvt 0 0 0 255 ECU_ADDRESS 0x0100EB40 /end MEASUREMENT
/begin COMPU_METHOD Compu_rdy_rdy_egr_vvt " " RAT_FUNC "%.0" "-" COEFFS 0 1 0 0 0 1 /end COMPU_METHOD
/begin MEASUREMENT rdy_sup_misfire "OBD Readiness Status Supported 1" UBYTE Compu_rdy_sup_misfire 0 0 0 255 ECU_ADDRESS 0x0100EB50 /end MEASUREMENT
/begin COMPU_METHOD Compu_rdy_sup_misfire " " RAT_FUNC "%.0" "-" COEFFS 0 1 0 0 0 1 /end COMPU_METHOD
/begin MEASUREMENT rdy_sup_fuel "OBD Readiness Status Supported 2" UBYTE Compu_rdy_sup_fuel 0 0 0 255 ECU_ADDRESS 0x0100EB58 /end MEASUREMENT
/begin COMPU_METHOD Compu_rdy_sup_fuel " " RAT_FUNC "%.0" "-" COEFFS 0 1 0 0 0 1 /end COMPU_METHOD
/begin MEASUREMENT rdy_sup_compcomp "OBD Readiness Status Supported 3" UBYTE Compu_rdy_sup_compcomp 0 0 0 255 ECU_ADDRESS 0x0100EB60 /end MEASUREMENT
/begin COMPU_METHOD Compu_rdy_sup_compcomp " " RAT_FUNC "%.0" "-" COEFFS 0 1 0 0 0 1 /end COMPU_METHOD
/begin MEASUREMENT rdy_sup_cat "OBD Readiness Status Supported 4" UBYTE Compu_rdy_sup_cat 0 0 0 255 ECU_ADDRESS 0x0100EB68 /end MEASUREMENT
/begin COMPU_METHOD Compu_rdy_sup_cat " " RAT_FUNC "%.0" "-" COEFFS 0 1 0 0 0 1 /end COMPU_METHOD
/begin MEASUREMENT rdy_sup_boost "OBD Readiness Status Supported 10" UBYTE Compu_rdy_sup_boost 0 0 0 255 ECU_ADDRESS 0x0100EB98 /end MEASUREMENT
/begin COMPU_METHOD Compu_rdy_sup_boost " " RAT_FUNC "%.0" "-" COEFFS 0 1 0 0 0 1 /end COMPU_METHOD
/begin MEASUREMENT rdy_sup_o2 "OBD Readiness Status Supported 11" UBYTE Compu_rdy_sup_o2 0 0 0 255 ECU_ADDRESS 0x0100EBA0 /end MEASUREMENT
/begin COMPU_METHOD Compu_rdy_sup_o2 " " RAT_FUNC "%.0" "-" COEFFS 0 1 0 0 0 1 /end COMPU_METHOD
/begin MEASUREMENT rdy_sup_o2_heater "OBD Readiness Status Supported 13" UBYTE Compu_rdy_sup_o2_heater 0 0 0 255 ECU_ADDRESS 0x0100EBB0 /end MEASUREMENT
/begin COMPU_METHOD Compu_rdy_sup_o2_heater " " RAT_FUNC "%.0" "-" COEFFS 0 1 0 0 0 1 /end COMPU_METHOD
/begin MEASUREMENT rdy_sup_egr_vvt "OBD Readiness Status Supported 15" UBYTE Compu_rdy_sup_egr_vvt 0 0 0 255 ECU_ADDRESS 0x0100EBC0 /end MEASUREMENT
/begin COMPU_METHOD Compu_rdy_sup_egr_vvt " " RAT_FUNC "%.0" "-" COEFFS 0 1 0 0 0 1 /end COMPU_METHOD
/begin MEASUREMENT iupr_sup_cat_b1 "IUPR Supported 1" UBYTE Compu_iupr_sup_cat_b1 0 0 0 255 ECU_ADDRESS 0x0100ECD0 /end MEASUREMENT
/begin COMPU_METHOD Compu_iupr_sup_cat_b1 " " RAT_FUNC "%.0" "-" COEFFS 0 1 0 0 0 1 /end COMPU_METHOD
/begin MEASUREMENT iupr_sup_cat_b2 "IUPR Supported 2" UBYTE Compu_iupr_sup_cat_b2 0 0 0 255 ECU_ADDRESS 0x0100ECD8 /end MEASUREMENT
/begin COMPU_METHOD Compu_iupr_sup_cat_b2 " " RAT_FUNC "%.0" "-" COEFFS 0 1 0 0 0 1 /end COMPU_METHOD
/begin MEASUREMENT iupr_sup_o2_b1 "IUPR Supported 3" UBYTE Compu_iupr_sup_o2_b1 0 0 0 255 ECU_ADDRESS 0x0100ECE0 /end MEASUREMENT
/begin COMPU_METHOD Compu_iupr_sup_o2_b1 " " RAT_FUNC "%.0" "-" COEFFS 0 1 0 0 0 1 /end COMPU_METHOD
/begin MEASUREMENT iupr_sup_o2_b2 "IUPR Supported 4" UBYTE Compu_iupr_sup_o2_b2 0 0 0 255 ECU_ADDRESS 0x0100ECE8 /end MEASUREMENT
/begin COMPU_METHOD Compu_iupr_sup_o2_b2 " " RAT_FUNC "%.0" "-" COEFFS 0 1 0 0 0 1 /end COMPU_METHOD
/begin MEASUREMENT iupr_sup_egr_vvt "IUPR Supported 5" UBYTE Compu_iupr_sup_egr_vvt 0 0 0 255 ECU_ADDRESS 0x0100ECF0 /end MEASUREMENT
/begin COMPU_METHOD Compu_iupr_sup_egr_vvt " " RAT_FUNC "%.0" "-" COEFFS 0 1 0 0 0 1 /end COMPU_METHOD
/begin MEASUREMENT iupr_sup_sec_o2_b1 "IUPR Supported 8" UBYTE Compu_iupr_sup_sec_o2_b1 0 0 0 255 ECU_ADDRESS 0x0100ED08 /end MEASUREMENT
/begin COMPU_METHOD Compu_iupr_sup_sec_o2_b1 " " RAT_FUNC "%.0" "-" COEFFS 0 1 0 0 0 1 /end COMPU_METHOD
/begin MEASUREMENT iupr_sup_sec_o2_b2 "IUPR Supported 9" UBYTE Compu_iupr_sup_sec_o2_b2 0 0 0 255 ECU_ADDRESS 0x0100ED10 /end MEASUREMENT
/begin COMPU_METHOD Compu_iupr_sup_sec_o2_b2 " " RAT_FUNC "%.0" "-" COEFFS 0 1 0 0 0 1 /end COMPU_METHOD
/begin MEASUREMENT iupr_sup_boost "IUPR Supported 15" UBYTE Compu_iupr_sup_boost 0 0 0 255 ECU_ADDRESS 0x0100ED40 /end MEASUREMENT
/begin COMPU_METHOD Compu_iupr_sup_boost " " RAT_FUNC "%.0" "-" COEFFS 0 1 0 0 0 1 /end COMPU_METHOD
/begin MEASUREMENT iupr_num_cat_b1 "IUPR Numerator 1" UWORD Compu_iupr_num_cat_b1 0 0 0 65535 ECU_ADDRESS 0x0100ED50 /end MEASUREMENT
/begin COMPU_METHOD Compu_iupr_num_cat_b1 " " RAT_FUNC "%.0" "-" COEFFS 0 1 0 0 0 1 /end COMPU_METHOD
/begin MEASUREMENT iupr_num_cat_b2 "IUPR Numerator 2" UWORD Compu_iupr_num_cat_b2 0 0 0 65535 ECU_ADDRESS 0x0100ED58 /end MEASUREMENT
/begin COMPU_METHOD Compu_iupr_num_cat_b2 " " RAT_FUNC "%.0" "-" COEFFS 0 1 0 0 0 1 /end COMPU_METHOD
/begin MEASUREMENT iupr_num_o2_b1 "IUPR Numerator 3" UWORD Compu_iupr_num_o2_b1 0 0 0 65535 ECU_ADDRESS 0x0100ED60 /end MEASUREMENT
/begin COMPU_METHOD Compu_iupr_num_o2_b1 " " RAT_FUNC "%.0" "-" COEFFS 0 1 0 0 0 1 /end COMPU_METHOD
/begin MEASUREMENT iupr_num_o2_b2 "IUPR Numerator 4" UWORD Compu_iupr_num_o2_b2 0 0 0 65535 ECU_ADDRESS 0x0100ED68 /end MEASUREMENT
/begin COMPU_METHOD Compu_iupr_num_o2_b2 " " RAT_FUNC "%.0" "-" COEFFS 0 1 0 0 0 1 /end COMPU_METHOD
/begin MEASUREMENT iupr_num_egr_vvt "IUPR Numerator 5" UWORD Compu_iupr_num_egr_vvt 0 0 0 65535 ECU_ADDRESS 0x0100ED70 /end MEASUREMENT
/begin COMPU_METHOD Compu_iupr_num_egr_vvt " " RAT_FUNC "%.0" "-" COEFFS 0 1 0 0 0 1 /end COMPU_METHOD
/begin MEASUREMENT iupr_num_sec_o2_b1 "IUPR Numerator 8" UWORD Compu_iupr_num_sec_o2_b1 0 0 0 65535 ECU_ADDRESS 0x0100ED88 /end MEASUREMENT
/begin COMPU_METHOD Compu_iupr_num_sec_o2_b1 " " RAT_FUNC "%.0" "-" COEFFS 0 1 0 0 0 1 /end COMPU_METHOD
/begin MEASUREMENT iupr_num_sec_o2_b2 "IUPR Numerator 9" UWORD Compu_iupr_num_sec_o2_b2 0 0 0 65535 ECU_ADDRESS 0x0100ED90 /end MEASUREMENT
/begin COMPU_METHOD Compu_iupr_num_sec_o2_b2 " " RAT_FUNC "%.0" "-" COEFFS 0 1 0 0 0 1 /end COMPU_METHOD
/begin MEASUREMENT iupr_num_boost "IUPR Numerator 15" UWORD Compu_iupr_num_boost 0 0 0 65535 ECU_ADDRESS 0x0100EDC0 /end MEASUREMENT
/begin COMPU_METHOD Compu_iupr_num_boost " " RAT_FUNC "%.0" "-" COEFFS 0 1 0 0 0 1 /end COMPU_METHOD
/begin MEASUREMENT iupr_den_cat_b1 "IUPR Denominator 1" UWORD Compu_iupr_den_cat_b1 0 0 0 65535 ECU_ADDRESS 0x0100EDD0 /end MEASUREMENT
/begin COMPU_METHOD Compu_iupr_den_cat_b1 " " RAT_FUNC "%.0" "-" COEFFS 0 1 0 0 0 1 /end COMPU_METHOD
/begin MEASUREMENT iupr_den_cat_b2 "IUPR Denominator 2" UWORD Compu_iupr_den_cat_b2 0 0 0 65535 ECU_ADDRESS 0x0100EDD8 /end MEASUREMENT
/begin COMPU_METHOD Compu_iupr_den_cat_b2 " " RAT_FUNC "%.0" "-" COEFFS 0 1 0 0 0 1 /end COMPU_METHOD
/begin MEASUREMENT iupr_den_o2_b1 "IUPR Denominator 3" UWORD Compu_iupr_den_o2_b1 0 0 0 65535 ECU_ADDRESS 0x0100EDE0 /end MEASUREMENT
/begin COMPU_METHOD Compu_iupr_den_o2_b1 " " RAT_FUNC "%.0" "-" COEFFS 0 1 0 0 0 1 /end COMPU_METHOD
/begin MEASUREMENT iupr_den_o2_b2 "IUPR Denominator 4" UWORD Compu_iupr_den_o2_b2 0 0 0 65535 ECU_ADDRESS 0x0100EDE8 /end MEASUREMENT
/begin COMPU_METHOD Compu_iupr_den_o2_b2 " " RAT_FUNC "%.0" "-" COEFFS 0 1 0 0 0 1 /end COMPU_METHOD
/begin MEASUREMENT iupr_den_egr_vvt "IUPR Denominator 5" UWORD Compu_iupr_den_egr_vvt 0 0 0 65535 ECU_ADDRESS 0x0100EDF0 /end MEASUREMENT
/begin COMPU_METHOD Compu_iupr_den_egr_vvt " " RAT_FUNC "%.0" "-" COEFFS 0 1 0 0 0 1 /end COMPU_METHOD
/begin MEASUREMENT iupr_den_sec_o2_b1 "IUPR Denominator 8" UWORD Compu_iupr_den_sec_o2_b1 0 0 0 65535 ECU_ADDRESS 0x0100EE08 /end MEASUREMENT
/begin COMPU_METHOD Compu_iupr_den_sec_o2_b1 " " RAT_FUNC "%.0" "-" COEFFS 0 1 0 0 0 1 /end COMPU_METHOD
/begin MEASUREMENT iupr_den_sec_o2_b2 "IUPR Denominator 9" UWORD Compu_iupr_den_sec_o2_b2 0 0 0 65535 ECU_ADDRESS 0x0100EE10 /end MEASUREMENT
/begin COMPU_METHOD Compu_iupr_den_sec_o2_b2 " " RAT_FUNC "%.0" "-" COEFFS 0 1 0 0 0 1 /end COMPU_METHOD
/begin MEASUREMENT iupr_den_boost "IUPR Denominator 15" UWORD Compu_iupr_den_boost 0 0 0 65535 ECU_ADDRESS 0x0100EE40 /end MEASUREMENT
/begin COMPU_METHOD Compu_iupr_den_boost " " RAT_FUNC "%.0" "-" COEFFS 0 1 0 0 0 1 /end COMPU_METHOD
/begin CHARACTERISTIC BstTIP_slow_delta "FaultConfig # BstTIP_slow_delta (Fault Condition:P < P target -)" VALUE 0x001466d4 /* @ECU_Address@BstTIP_slow_delta@0x0100EE98@ */ ECIPP_ALIGNMENT_UWORD 256 Compu_BstTIP_slow_delta 0 255.99609375 /end CHARACTERISTIC
/begin COMPU_METHOD Compu_BstTIP_slow_delta " " RAT_FUNC "%.3" "psi" COEFFS 0 256 0 0 0 1 /end COMPU_METHOD
/begin CHARACTERISTIC BstTIP_slow_MAP "FaultConfig # BstTIP_slow_MAP (Fault Condition:and P >)" VALUE 0x001466d2 /* @ECU_Address@BstTIP_slow_MAP@0x0100EEA0@ */ ECIPP_ALIGNMENT_UWORD 256 Compu_BstTIP_slow_MAP 0 255.99609375 /end CHARACTERISTIC
/begin COMPU_METHOD Compu_BstTIP_slow_MAP " " RAT_FUNC "%.3" "psia" COEFFS 0 256 0 0 0 1 /end COMPU_METHOD
/begin CHARACTERISTIC BstTIP_slow_rpm "FaultConfig # BstTIP_slow_rpm (Fault Condition:and RPM >)" VALUE 0x001466d6 /* @ECU_Address@BstTIP_slow_rpm@0x0100EEA8@ */ ECIPP_ALIGNMENT_UWORD 65535 Compu_BstTIP_slow_rpm 0 65535 /end CHARACTERISTIC
/begin COMPU_METHOD Compu_BstTIP_slow_rpm " " RAT_FUNC "%.0" "rpm" COEFFS 0 1 0 0 0 1 /end COMPU_METHOD
/begin CHARACTERISTIC BstTIP_slow_dtdz "FaultConfig # BstTIP_slow_dtdz (Fault Condition:and dP/dt <)" VALUE 0x00144250 /* @ECU_Address@BstTIP_slow_dtdz@0x0100EEB0@ */ ECIPP_ALIGNMENT_SWORD 512 Compu_BstTIP_slow_dtdz -512 511.984375 /end CHARACTERISTIC
/begin COMPU_METHOD Compu_BstTIP_slow_dtdz " " RAT_FUNC "%.3" "psi/sec" COEFFS 0 64 0 0 0 1 /end COMPU_METHOD
/begin CHARACTERISTIC CAC_eta_lo_mdota "FaultConfig # CAC_eta_lo_mdota (Fault Condition:Air mass flow >)" VALUE 0x001466e2 /* @ECU_Address@CAC_eta_lo_mdota@0x0100EEB8@ */ ECIPP_ALIGNMENT_UWORD 1024 Compu_CAC_eta_lo_mdota 0 1023.984375 /end CHARACTERISTIC
/begin COMPU_METHOD Compu_CAC_eta_lo_mdota " " RAT_FUNC "%.3" "g/sec" COEFFS 0 64 0 0 0 1 /end COMPU_METHOD
/begin CHARACTERISTIC CAC_eta_lo_COT "FaultConfig # CAC_eta_lo_COT (Fault Condition:and COT >)" VALUE 0x001466de /* @ECU_Address@CAC_eta_lo_COT@0x0100EEC0@ */ ECIPP_ALIGNMENT_UWORD 7732 Compu_CAC_eta_lo_COT -460 7731.875 /end CHARACTERISTIC
/begin COMPU_METHOD Compu_CAC_eta_lo_COT " " RAT_FUNC "%.3" "deg F" COEFFS 0 8 3680 0 0 1 /end COMPU_METHOD
/begin CHARACTERISTIC CAC_eta_lo_kph "FaultConfig # CAC_eta_lo_kph (Fault Condition:and roadspeed >)" VALUE 0x001466e0 /* @ECU_Address@CAC_eta_lo_kph@0x0100EEC8@ */ ECIPP_ALIGNMENT_UWORD 256 Compu_CAC_eta_lo_kph 0 255.99609375 /end CHARACTERISTIC
/begin COMPU_METHOD Compu_CAC_eta_lo_kph " " RAT_FUNC "%.3" "km/hr" COEFFS 0 256 0 0 0 1 /end COMPU_METHOD
/begin CHARACTERISTIC CAC_eta_lo "FaultConfig # CAC_eta_lo (Fault Condition:and CAC efficiency <)" VALUE 0x001466dc /* @ECU_Address@CAC_eta_lo@0x0100EED0@ */ ECIPP_ALIGNMENT_UWORD 100 Compu_CAC_eta_lo 0 99.9984741210938 /end CHARACTERISTIC
/begin COMPU_METHOD Compu_CAC_eta_lo " " RAT_FUNC "%.3" "%" COEFFS 0 655.36 0 0 0 1 /end COMPU_METHOD
/begin CHARACTERISTIC COT_Taux_cal "{COT_Taux_cal&0xff=0:Fuel source}{COT_Taux_cal&0xff=1:Exhaust manifold/riser}{COT_Taux_cal&0xff=2:Aux Temp A}{COT_Taux_cal&0xff=3:Aux Temp B}{COT_Taux_cal&0xff=4:Aux Temp C}{COT_Taux_cal&0xff=5:Aux Temp D}" VALUE 0x00147d00 /* @ECU_Address@COT_Taux_cal@0x0100EEE0@ */ ECIPP_ALIGNMENT_UBYTE 255 COT_Taux_cal_COMPU_VTAB 0 255 BIT_MASK 0xff /end CHARACTERISTIC
/begin COMPU_METHOD COT_Taux_cal_COMPU_VTAB "Verbal Table" TAB_VERB "%.0" "list" COMPU_TAB_REF COT_Taux_cal_COMPU_VTAB_REF /end COMPU_METHOD
/begin COMPU_VTAB COT_Taux_cal_COMPU_VTAB_REF "Verbal Table" TAB_VERB 6 0 "Fuel source" 1 "Exhaust manifold/riser" 2 "Aux Temp A" 3 "Aux Temp B" 4 "Aux Temp C" 5 "Aux Temp D" DEFAULT_VALUE "UNKNOWN" /end COMPU_VTAB
/begin CHARACTERISTIC COT_vdr "IOConfig # COT_vdr" VALUE 0x00143978 /* @ECU_Address@COT_vdr@0x0100EEE8@ */ ECIPP_ALIGNMENT_FLOAT32_IEEE 10000000000 Compu_COT_vdr -10000000000 10000000000 /end CHARACTERISTIC
/begin COMPU_METHOD Compu_COT_vdr " " RAT_FUNC "%.3" "ohms" COEFFS 0 1 0 0 0 1 /end COMPU_METHOD
/begin CHARACTERISTIC TIAT_Taux_cal "{TIAT_Taux_cal&0xff=0:Fuel source}{TIAT_Taux_cal&0xff=1:Exhaust manifold/riser}{TIAT_Taux_cal&0xff=2:Aux Temp A}{TIAT_Taux_cal&0xff=3:Aux Temp B}{TIAT_Taux_cal&0xff=4:Aux Temp C}{TIAT_Taux_cal&0xff=5:Aux Temp D}" VALUE 0x00148098 /* @ECU_Address@TIAT_Taux_cal@0x0100EEF8@ */ ECIPP_ALIGNMENT_UBYTE 255 TIAT_Taux_cal_COMPU_VTAB 0 255 BIT_MASK 0xff /end CHARACTERISTIC
/begin COMPU_METHOD TIAT_Taux_cal_COMPU_VTAB "Verbal Table" TAB_VERB "%.0" "list" COMPU_TAB_REF TIAT_Taux_cal_COMPU_VTAB_REF /end COMPU_METHOD
/begin COMPU_VTAB TIAT_Taux_cal_COMPU_VTAB_REF "Verbal Table" TAB_VERB 6 0 "Fuel source" 1 "Exhaust manifold/riser" 2 "Aux Temp A" 3 "Aux Temp B" 4 "Aux Temp C" 5 "Aux Temp D" DEFAULT_VALUE "UNKNOWN" /end COMPU_VTAB
/begin CHARACTERISTIC TIAT_vdr "IOConfig # TIAT_vdr" VALUE 0x00143b10 /* @ECU_Address@TIAT_vdr@0x0100EF00@ */ ECIPP_ALIGNMENT_FLOAT32_IEEE 10000000000 Compu_TIAT_vdr -10000000000 10000000000 /end CHARACTERISTIC
/begin COMPU_METHOD Compu_TIAT_vdr " " RAT_FUNC "%.3" "ohms" COEFFS 0 1 0 0 0 1 /end COMPU_METHOD
/begin CHARACTERISTIC TPSdP_Paux_cal "{TPSdP_Paux_cal&0xff=0:Aux Press A}{TPSdP_Paux_cal&0xff=1:Aux Press B}{TPSdP_Paux_cal&0xff=2:Aux Press C}{TPSdP_Paux_cal&0xff=3:Aux Press D}" VALUE 0x001480ae /* @ECU_Address@TPSdP_Paux_cal@0x0100F0B0@ */ ECIPP_ALIGNMENT_UBYTE 255 TPSdP_Paux_cal_COMPU_VTAB 0 255 BIT_MASK 0xff /end CHARACTERISTIC
/begin COMPU_METHOD TPSdP_Paux_cal_COMPU_VTAB "Verbal Table" TAB_VERB "%.0" "list" COMPU_TAB_REF TPSdP_Paux_cal_COMPU_VTAB_REF /end COMPU_METHOD
/begin COMPU_VTAB TPSdP_Paux_cal_COMPU_VTAB_REF "Verbal Table" TAB_VERB 4 0 "Aux Press A" 1 "Aux Press B" 2 "Aux Press C" 3 "Aux Press D" DEFAULT_VALUE "UNKNOWN" /end COMPU_VTAB
/begin MEASUREMENT TPSdP_offset_float "TPSdP offset" FLOAT32_IEEE Compu_TPSdP_offset_float 0 0 -10000000000 10000000000 ECU_ADDRESS 0x0100F0F8 /end MEASUREMENT
/begin COMPU_METHOD Compu_TPSdP_offset_float " " RAT_FUNC "%.3" "psi" COEFFS 0 1 0 0 0 1 /end COMPU_METHOD
/begin CHARACTERISTIC TPS_learn_EE_ofst "General # TPS_learn_EE_ofst" VALUE 0x00148D14 /* @ECU_Address@TPS_learn_EE_ofst@0x0100F130@ */ ECIPP_ALIGNMENT_UWORD 5 Compu_TPS_learn_EE_ofst 0 5.00114468864469 /end CHARACTERISTIC
/begin COMPU_METHOD Compu_TPS_learn_EE_ofst " " RAT_FUNC "%.3" "volts" COEFFS 0 13104 0 0 0 1 /end COMPU_METHOD
/begin CHARACTERISTIC APS_learn_EE_ofst "General # APS_learn_EE_ofst" VALUE 0x00148EE8 /* @ECU_Address@APS_learn_EE_ofst@0x0100F138@ */ ECIPP_ALIGNMENT_UWORD 5 Compu_APS_learn_EE_ofst 0 5.00114468864469 /end CHARACTERISTIC
/begin COMPU_METHOD Compu_APS_learn_EE_ofst " " RAT_FUNC "%.3" "volts" COEFFS 0 13104 0 0 0 1 /end COMPU_METHOD
/begin CHARACTERISTIC BPS_learn_EE_ofst "General # BPS_learn_EE_ofst" VALUE 0x00148F88 /* @ECU_Address@BPS_learn_EE_ofst@0x0100F140@ */ ECIPP_ALIGNMENT_UWORD 5 Compu_BPS_learn_EE_ofst 0 5.00114468864469 /end CHARACTERISTIC
/begin COMPU_METHOD Compu_BPS_learn_EE_ofst " " RAT_FUNC "%.3" "volts" COEFFS 0 13104 0 0 0 1 /end COMPU_METHOD
/begin CHARACTERISTIC EGR_slowinc_err "Air # EGR_slowinc_err (Fault Condition:EGR commanded - model estimated >)" VALUE 0x001401ca /* @ECU_Address@EGR_slowinc_err@0x0100F298@ */ ECIPP_ALIGNMENT_SWORD 200 Compu_EGR_slowinc_err -200 199.993896484375 /end CHARACTERISTIC
/begin COMPU_METHOD Compu_EGR_slowinc_err " " RAT_FUNC "%.3" "%" COEFFS 0 163.84 0 0 0 1 /end COMPU_METHOD
/begin CHARACTERISTIC EGR_slowdec_err "Air # EGR_slowdec_err (Fault Condition:EGR model estimated - commanded >)" VALUE 0x001401c8 /* @ECU_Address@EGR_slowdec_err@0x0100F2A0@ */ ECIPP_ALIGNMENT_SWORD 200 Compu_EGR_slowdec_err -200 199.993896484375 /end CHARACTERISTIC
/begin COMPU_METHOD Compu_EGR_slowdec_err " " RAT_FUNC "%.3" "%" COEFFS 0 163.84 0 0 0 1 /end COMPU_METHOD
/begin CHARACTERISTIC EGR_OOA_hi_err "Air # EGR_OOA_hi_err (Fault Condition:EGR commanded - model estimated >)" VALUE 0x001401ba /* @ECU_Address@EGR_OOA_hi_err@0x0100F2A8@ */ ECIPP_ALIGNMENT_SWORD 200 Compu_EGR_OOA_hi_err -200 199.993896484375 /end CHARACTERISTIC
/begin COMPU_METHOD Compu_EGR_OOA_hi_err " " RAT_FUNC "%.3" "%" COEFFS 0 163.84 0 0 0 1 /end COMPU_METHOD
/begin CHARACTERISTIC EGR_OOA_lo_err "Air # EGR_OOA_lo_err (Fault Condition:EGR model estimated - commanded >)" VALUE 0x001401bc /* @ECU_Address@EGR_OOA_lo_err@0x0100F2B0@ */ ECIPP_ALIGNMENT_SWORD 200 Compu_EGR_OOA_lo_err -200 199.993896484375 /end CHARACTERISTIC
/begin COMPU_METHOD Compu_EGR_OOA_lo_err " " RAT_FUNC "%.3" "%" COEFFS 0 163.84 0 0 0 1 /end COMPU_METHOD
/begin CHARACTERISTIC EGR_UEGOdP_hi_min "Air # EGR_UEGOdP_hi_min (Fault Condition:EGR UEGO feedback >)" VALUE 0x001408b2 /* @ECU_Address@EGR_UEGOdP_hi_min@0x0100F2B8@ */ ECIPP_ALIGNMENT_UWORD 400 Compu_EGR_UEGOdP_hi_min 0 399.993896484375 /end CHARACTERISTIC
/begin COMPU_METHOD Compu_EGR_UEGOdP_hi_min " " RAT_FUNC "%.3" "%" COEFFS 0 163.84 0 0 0 1 /end COMPU_METHOD
/begin CHARACTERISTIC EGR_UEGOdP_hi_err "Air # EGR_UEGOdP_hi_err (Fault Condition:and EGR (UEGO-dP) feedback >)" VALUE 0x001401be /* @ECU_Address@EGR_UEGOdP_hi_err@0x0100F2C0@ */ ECIPP_ALIGNMENT_SWORD 200 Compu_EGR_UEGOdP_hi_err -200 199.993896484375 /end CHARACTERISTIC
/begin COMPU_METHOD Compu_EGR_UEGOdP_hi_err " " RAT_FUNC "%.3" "%" COEFFS 0 163.84 0 0 0 1 /end COMPU_METHOD
/begin CHARACTERISTIC EGR_UEGOdP_lo_min "Air # EGR_UEGOdP_lo_min (Fault Condition:EGR dP feedback >)" VALUE 0x001408b4 /* @ECU_Address@EGR_UEGOdP_lo_min@0x0100F2C8@ */ ECIPP_ALIGNMENT_UWORD 400 Compu_EGR_UEGOdP_lo_min 0 399.993896484375 /end CHARACTERISTIC
/begin COMPU_METHOD Compu_EGR_UEGOdP_lo_min " " RAT_FUNC "%.3" "%" COEFFS 0 163.84 0 0 0 1 /end COMPU_METHOD
/begin CHARACTERISTIC EGR_UEGOdP_lo_err "Air # EGR_UEGOdP_lo_err (Fault Condition:and EGR (dP-UEGO) feedback >)" VALUE 0x001401c0 /* @ECU_Address@EGR_UEGOdP_lo_err@0x0100F2D0@ */ ECIPP_ALIGNMENT_SWORD 200 Compu_EGR_UEGOdP_lo_err -200 199.993896484375 /end CHARACTERISTIC
/begin COMPU_METHOD Compu_EGR_UEGOdP_lo_err " " RAT_FUNC "%.3" "%" COEFFS 0 163.84 0 0 0 1 /end COMPU_METHOD
/begin CHARACTERISTIC EGR_offmin_lmt "Air # EGR_offmin_lmt (Fault Condition:and EGR min/nom fraction <)" VALUE 0x001401c4 /* @ECU_Address@EGR_offmin_lmt@0x0100F2D8@ */ ECIPP_ALIGNMENT_SWORD 2 Compu_EGR_offmin_lmt -2 1.99993896484375 /end CHARACTERISTIC
/begin COMPU_METHOD Compu_EGR_offmin_lmt " " RAT_FUNC "%.3" "-" COEFFS 0 16384 0 0 0 1 /end COMPU_METHOD
/begin CHARACTERISTIC EGR_clr_eta_ECTmin "Air # EGR_clr_eta_ECTmin (Fault Condition:ECT >)" VALUE 0x001408c0 /* @ECU_Address@EGR_clr_eta_ECTmin@0x0100F2E8@ */ ECIPP_ALIGNMENT_UWORD 564 Compu_EGR_clr_eta_ECTmin -460 563.984375 /end CHARACTERISTIC
/begin COMPU_METHOD Compu_EGR_clr_eta_ECTmin " " RAT_FUNC "%.3" "deg F" COEFFS 0 64 29440 0 0 1 /end COMPU_METHOD
/begin CHARACTERISTIC EGR_clr_eta_ECTmax "Air # EGR_clr_eta_ECTmax (Fault Condition:and ECT <)" VALUE 0x001408be /* @ECU_Address@EGR_clr_eta_ECTmax@0x0100F2F0@ */ ECIPP_ALIGNMENT_UWORD 564 Compu_EGR_clr_eta_ECTmax -460 563.984375 /end CHARACTERISTIC
/begin COMPU_METHOD Compu_EGR_clr_eta_ECTmax " " RAT_FUNC "%.3" "deg F" COEFFS 0 64 29440 0 0 1 /end COMPU_METHOD
/begin CHARACTERISTIC EGR_clr_eta_dTmax "Air # EGR_clr_eta_dTmax (Fault Condition:and EGRT > ECT +)" VALUE 0x001408c2 /* @ECU_Address@EGR_clr_eta_dTmax@0x0100F2F8@ */ ECIPP_ALIGNMENT_UWORD 1024 Compu_EGR_clr_eta_dTmax 0 1023.984375 /end CHARACTERISTIC
/begin COMPU_METHOD Compu_EGR_clr_eta_dTmax " " RAT_FUNC "%.3" "deg F" COEFFS 0 64 0 0 0 1 /end COMPU_METHOD
/begin CHARACTERISTIC PPEG_BP_fault "IOConfig # PPEG_BP_fault (Fault Condition:abs(BP offset) sample >)" VALUE 0x001476a0 /* @ECU_Address@PPEG_BP_fault@0x0100F300@ */ ECIPP_ALIGNMENT_UWORD 256 Compu_PPEG_BP_fault 0 255.99609375 /end CHARACTERISTIC
/begin COMPU_METHOD Compu_PPEG_BP_fault " " RAT_FUNC "%.3" "psi" COEFFS 0 256 0 0 0 1 /end COMPU_METHOD
/begin CHARACTERISTIC PPEG_EBP_fault "IOConfig # PPEG_EBP_fault (Fault Condition:abs(EBP offset) sample >)" VALUE 0x001476a6 /* @ECU_Address@PPEG_EBP_fault@0x0100F308@ */ ECIPP_ALIGNMENT_UWORD 256 Compu_PPEG_EBP_fault 0 255.99609375 /end CHARACTERISTIC
/begin COMPU_METHOD Compu_PPEG_EBP_fault " " RAT_FUNC "%.3" "psi" COEFFS 0 256 0 0 0 1 /end COMPU_METHOD
/begin CHARACTERISTIC PPEG_EGRLP_fault "IOConfig # PPEG_EGRLP_fault (Fault Condition:abs(EGRLP offset) sample >)" VALUE 0x00140928 /* @ECU_Address@PPEG_EGRLP_fault@0x0100F310@ */ ECIPP_ALIGNMENT_UWORD 256 Compu_PPEG_EGRLP_fault 0 255.99609375 /end CHARACTERISTIC
/begin COMPU_METHOD Compu_PPEG_EGRLP_fault " " RAT_FUNC "%.3" "psi" COEFFS 0 256 0 0 0 1 /end COMPU_METHOD
/begin CHARACTERISTIC PPEG_EGRHP_fault "IOConfig # PPEG_EGRHP_fault (Fault Condition:abs(EGRHP offset) sample >)" VALUE 0x00140926 /* @ECU_Address@PPEG_EGRHP_fault@0x0100F318@ */ ECIPP_ALIGNMENT_UWORD 256 Compu_PPEG_EGRHP_fault 0 255.99609375 /end CHARACTERISTIC
/begin COMPU_METHOD Compu_PPEG_EGRHP_fault " " RAT_FUNC "%.3" "psi" COEFFS 0 256 0 0 0 1 /end COMPU_METHOD
/begin CHARACTERISTIC PPEG_TIP_fault "IOConfig # PPEG_TIP_fault (Fault Condition:abs(TIP offset) sample >)" VALUE 0x001476aa /* @ECU_Address@PPEG_TIP_fault@0x0100F320@ */ ECIPP_ALIGNMENT_UWORD 256 Compu_PPEG_TIP_fault 0 255.99609375 /end CHARACTERISTIC
/begin COMPU_METHOD Compu_PPEG_TIP_fault " " RAT_FUNC "%.3" "psi" COEFFS 0 256 0 0 0 1 /end COMPU_METHOD
/begin CHARACTERISTIC PPEG_EGRwrP_fault "IOConfig # PPEG_EGRwrP_fault (Fault Condition:abs(EGRwrP offset) sample >)" VALUE 0x0014092a /* @ECU_Address@PPEG_EGRwrP_fault@0x0100F328@ */ ECIPP_ALIGNMENT_UWORD 256 Compu_PPEG_EGRwrP_fault 0 255.99609375 /end CHARACTERISTIC
/begin COMPU_METHOD Compu_PPEG_EGRwrP_fault " " RAT_FUNC "%.3" "psi" COEFFS 0 256 0 0 0 1 /end COMPU_METHOD
/begin CHARACTERISTIC PPEG_MAP_fault "IOConfig # PPEG_MAP_fault (Fault Condition:(>=2) are out-of-range and agree within <)" VALUE 0x001476a8 /* @ECU_Address@PPEG_MAP_fault@0x0100F330@ */ ECIPP_ALIGNMENT_UWORD 256 Compu_PPEG_MAP_fault 0 255.99609375 /end CHARACTERISTIC
/begin COMPU_METHOD Compu_PPEG_MAP_fault " " RAT_FUNC "%.3" "psi" COEFFS 0 256 0 0 0 1 /end COMPU_METHOD
/begin CHARACTERISTIC CFV_mdot_pct_rms "Fuel # CFV_mdot_pct_rms (Fault Condition:(actual flow - commanded flow) RMS >)" VALUE 0x00146728 /* @ECU_Address@CFV_mdot_pct_rms@0x0100F400@ */ ECIPP_ALIGNMENT_UWORD 400 Compu_CFV_mdot_pct_rms 0 399.993896484375 /end CHARACTERISTIC
/begin COMPU_METHOD Compu_CFV_mdot_pct_rms " " RAT_FUNC "%.3" "%" COEFFS 0 163.84 0 0 0 1 /end COMPU_METHOD
/begin CHARACTERISTIC CL_phi_hi "Fuel # CL_phi_hi (Fault Condition:Postcat phi >)" VALUE 0x00146746 /* @ECU_Address@CL_phi_hi@0x0100F408@ */ ECIPP_ALIGNMENT_UWORD 4 Compu_CL_phi_hi 0 3.99993896484375 /end CHARACTERISTIC
/begin COMPU_METHOD Compu_CL_phi_hi " " RAT_FUNC "%.3" "phi" COEFFS 0 16384 0 0 0 1 /end COMPU_METHOD
/begin CHARACTERISTIC CL_phi_lo "Fuel # CL_phi_lo (Fault Condition:Postcat phi <)" VALUE 0x00146750 /* @ECU_Address@CL_phi_lo@0x0100F410@ */ ECIPP_ALIGNMENT_UWORD 4 Compu_CL_phi_lo 0 3.99993896484375 /end CHARACTERISTIC
/begin COMPU_METHOD Compu_CL_phi_lo " " RAT_FUNC "%.3" "phi" COEFFS 0 16384 0 0 0 1 /end COMPU_METHOD
/begin CHARACTERISTIC CL_phi_lmt_RPMmin "FaultConfig # CL_phi_lmt_RPMmin (Fault Condition:and RPM >=)" VALUE 0x0014674e /* @ECU_Address@CL_phi_lmt_RPMmin@0x0100F418@ */ ECIPP_ALIGNMENT_UWORD 65535 Compu_CL_phi_lmt_RPMmin 0 65535 /end CHARACTERISTIC
/begin COMPU_METHOD Compu_CL_phi_lmt_RPMmin " " RAT_FUNC "%.0" "rpm" COEFFS 0 1 0 0 0 1 /end COMPU_METHOD
/begin CHARACTERISTIC CL_phi_lmt_RPMmax "FaultConfig # CL_phi_lmt_RPMmax (Fault Condition:and RPM <=)" VALUE 0x0014674c /* @ECU_Address@CL_phi_lmt_RPMmax@0x0100F420@ */ ECIPP_ALIGNMENT_UWORD 65535 Compu_CL_phi_lmt_RPMmax 0 65535 /end CHARACTERISTIC
/begin COMPU_METHOD Compu_CL_phi_lmt_RPMmax " " RAT_FUNC "%.0" "rpm" COEFFS 0 1 0 0 0 1 /end COMPU_METHOD
/begin CHARACTERISTIC CL_phi_lmt_MAPmin "FaultConfig # CL_phi_lmt_MAPmin (Fault Condition:and MAP >=)" VALUE 0x0014674a /* @ECU_Address@CL_phi_lmt_MAPmin@0x0100F428@ */ ECIPP_ALIGNMENT_UWORD 256 Compu_CL_phi_lmt_MAPmin 0 255.99609375 /end CHARACTERISTIC
/begin COMPU_METHOD Compu_CL_phi_lmt_MAPmin " " RAT_FUNC "%.3" "psia" COEFFS 0 256 0 0 0 1 /end COMPU_METHOD
/begin CHARACTERISTIC CL_phi_lmt_MAPmax "FaultConfig # CL_phi_lmt_MAPmax (Fault Condition:and MAP <=)" VALUE 0x00146748 /* @ECU_Address@CL_phi_lmt_MAPmax@0x0100F430@ */ ECIPP_ALIGNMENT_UWORD 256 Compu_CL_phi_lmt_MAPmax 0 255.99609375 /end CHARACTERISTIC
/begin COMPU_METHOD Compu_CL_phi_lmt_MAPmax " " RAT_FUNC "%.3" "psia" COEFFS 0 256 0 0 0 1 /end COMPU_METHOD
/begin CHARACTERISTIC TPSerr_run_mode "{TPSerr_run_mode&0xff=0:Stopped}{TPSerr_run_mode&0xff=1:Cranking}{TPSerr_run_mode&0xff=2:Underspeed}{TPSerr_run_mode&0xff=3:Running} (Fault Condition:and run mode >)" VALUE 0x00148D56 /* @ECU_Address@TPSerr_run_mode@0x0100F448@ */ ECIPP_ALIGNMENT_UBYTE 255 TPSerr_run_mode_COMPU_VTAB 0 255 BIT_MASK 0xff /end CHARACTERISTIC
/begin COMPU_METHOD TPSerr_run_mode_COMPU_VTAB "Verbal Table" TAB_VERB "%.0" "list" COMPU_TAB_REF TPSerr_run_mode_COMPU_VTAB_REF /end COMPU_METHOD
/begin COMPU_VTAB TPSerr_run_mode_COMPU_VTAB_REF "Verbal Table" TAB_VERB 4 0 "Stopped" 1 "Cranking" 2 "Underspeed" 3 "Running" DEFAULT_VALUE "UNKNOWN" /end COMPU_VTAB
/begin CHARACTERISTIC APSerr_run_mode "{APSerr_run_mode&0xff=0:Stopped}{APSerr_run_mode&0xff=1:Cranking}{APSerr_run_mode&0xff=2:Underspeed}{APSerr_run_mode&0xff=3:Running} (Fault Condition:and run mode >)" VALUE 0x00148F2A /* @ECU_Address@APSerr_run_mode@0x0100F450@ */ ECIPP_ALIGNMENT_UBYTE 255 APSerr_run_mode_COMPU_VTAB 0 255 BIT_MASK 0xff /end CHARACTERISTIC
/begin COMPU_METHOD APSerr_run_mode_COMPU_VTAB "Verbal Table" TAB_VERB "%.0" "list" COMPU_TAB_REF APSerr_run_mode_COMPU_VTAB_REF /end COMPU_METHOD
/begin COMPU_VTAB APSerr_run_mode_COMPU_VTAB_REF "Verbal Table" TAB_VERB 4 0 "Stopped" 1 "Cranking" 2 "Underspeed" 3 "Running" DEFAULT_VALUE "UNKNOWN" /end COMPU_VTAB
/begin CHARACTERISTIC BPSerr_run_mode "{BPSerr_run_mode&0xff=0:Stopped}{BPSerr_run_mode&0xff=1:Cranking}{BPSerr_run_mode&0xff=2:Underspeed}{BPSerr_run_mode&0xff=3:Running} (Fault Condition:and run mode >)" VALUE 0x00148FCA /* @ECU_Address@BPSerr_run_mode@0x0100F458@ */ ECIPP_ALIGNMENT_UBYTE 255 BPSerr_run_mode_COMPU_VTAB 0 255 BIT_MASK 0xff /end CHARACTERISTIC
/begin COMPU_METHOD BPSerr_run_mode_COMPU_VTAB "Verbal Table" TAB_VERB "%.0" "list" COMPU_TAB_REF BPSerr_run_mode_COMPU_VTAB_REF /end COMPU_METHOD
/begin COMPU_VTAB BPSerr_run_mode_COMPU_VTAB_REF "Verbal Table" TAB_VERB 4 0 "Stopped" 1 "Cranking" 2 "Underspeed" 3 "Running" DEFAULT_VALUE "UNKNOWN" /end COMPU_VTAB
/begin CHARACTERISTIC EGR_offmin_nomcmd "Air # EGR_offmin_nomcmd (Fault Condition:EGR nominal command >)" VALUE 0x001408e8 /* @ECU_Address@EGR_offmin_nomcmd@0x0100F460@ */ ECIPP_ALIGNMENT_UWORD 400 Compu_EGR_offmin_nomcmd 0 399.993896484375 /end CHARACTERISTIC
/begin COMPU_METHOD Compu_EGR_offmin_nomcmd " " RAT_FUNC "%.3" "%" COEFFS 0 163.84 0 0 0 1 /end COMPU_METHOD
/begin CHARACTERISTIC EGR_offmin_mincmd "Air # EGR_offmin_mincmd (Fault Condition:and EGR minimum command >)" VALUE 0x001408e6 /* @ECU_Address@EGR_offmin_mincmd@0x0100F468@ */ ECIPP_ALIGNMENT_UWORD 400 Compu_EGR_offmin_mincmd 0 399.993896484375 /end CHARACTERISTIC
/begin COMPU_METHOD Compu_EGR_offmin_mincmd " " RAT_FUNC "%.3" "%" COEFFS 0 163.84 0 0 0 1 /end COMPU_METHOD
/begin CHARACTERISTIC CAT1_Taux_cal "{CAT1_Taux_cal&0xff=0:Fuel source}{CAT1_Taux_cal&0xff=1:Exhaust manifold/riser}{CAT1_Taux_cal&0xff=2:Aux Temp A}{CAT1_Taux_cal&0xff=3:Aux Temp B}{CAT1_Taux_cal&0xff=4:Aux Temp C}{CAT1_Taux_cal&0xff=5:Aux Temp D}" VALUE 0x00147ce6 /* @ECU_Address@CAT1_Taux_cal@0x0100F590@ */ ECIPP_ALIGNMENT_UBYTE 255 CAT1_Taux_cal_COMPU_VTAB 0 255 BIT_MASK 0xff /end CHARACTERISTIC
/begin COMPU_METHOD CAT1_Taux_cal_COMPU_VTAB "Verbal Table" TAB_VERB "%.0" "list" COMPU_TAB_REF CAT1_Taux_cal_COMPU_VTAB_REF /end COMPU_METHOD
/begin COMPU_VTAB CAT1_Taux_cal_COMPU_VTAB_REF "Verbal Table" TAB_VERB 6 0 "Fuel source" 1 "Exhaust manifold/riser" 2 "Aux Temp A" 3 "Aux Temp B" 4 "Aux Temp C" 5 "Aux Temp D" DEFAULT_VALUE "UNKNOWN" /end COMPU_VTAB
/begin CHARACTERISTIC CAT2_Taux_cal "{CAT2_Taux_cal&0xff=0:Fuel source}{CAT2_Taux_cal&0xff=1:Exhaust manifold/riser}{CAT2_Taux_cal&0xff=2:Aux Temp A}{CAT2_Taux_cal&0xff=3:Aux Temp B}{CAT2_Taux_cal&0xff=4:Aux Temp C}{CAT2_Taux_cal&0xff=5:Aux Temp D}" VALUE 0x00147ce8 /* @ECU_Address@CAT2_Taux_cal@0x0100F598@ */ ECIPP_ALIGNMENT_UBYTE 255 CAT2_Taux_cal_COMPU_VTAB 0 255 BIT_MASK 0xff /end CHARACTERISTIC
/begin COMPU_METHOD CAT2_Taux_cal_COMPU_VTAB "Verbal Table" TAB_VERB "%.0" "list" COMPU_TAB_REF CAT2_Taux_cal_COMPU_VTAB_REF /end COMPU_METHOD
/begin COMPU_VTAB CAT2_Taux_cal_COMPU_VTAB_REF "Verbal Table" TAB_VERB 6 0 "Fuel source" 1 "Exhaust manifold/riser" 2 "Aux Temp A" 3 "Aux Temp B" 4 "Aux Temp C" 5 "Aux Temp D" DEFAULT_VALUE "UNKNOWN" /end COMPU_VTAB
/begin CHARACTERISTIC CAT1_vdr "IOConfig # CAT1_vdr" VALUE 0x00143964 /* @ECU_Address@CAT1_vdr@0x0100F5A8@ */ ECIPP_ALIGNMENT_FLOAT32_IEEE 10000000000 Compu_CAT1_vdr -10000000000 10000000000 /end CHARACTERISTIC
/begin COMPU_METHOD Compu_CAT1_vdr " " RAT_FUNC "%.3" "ohms" COEFFS 0 1 0 0 0 1 /end COMPU_METHOD
/begin CHARACTERISTIC CAT2_vdr "IOConfig # CAT2_vdr" VALUE 0x00143968 /* @ECU_Address@CAT2_vdr@0x0100F5B0@ */ ECIPP_ALIGNMENT_FLOAT32_IEEE 10000000000 Compu_CAT2_vdr -10000000000 10000000000 /end CHARACTERISTIC
/begin COMPU_METHOD Compu_CAT2_vdr " " RAT_FUNC "%.3" "ohms" COEFFS 0 1 0 0 0 1 /end COMPU_METHOD
/begin CHARACTERISTIC EGR_PR_mdlerr_max "Air # EGR_PR_mdlerr_max (Fault Condition:EGR valve PR <)" VALUE 0x001408ac /* @ECU_Address@EGR_PR_mdlerr_max@0x0100F640@ */ ECIPP_ALIGNMENT_UWORD 1 Compu_EGR_PR_mdlerr_max 0 0.999984741210938 /end CHARACTERISTIC
/begin COMPU_METHOD Compu_EGR_PR_mdlerr_max " " RAT_FUNC "%.3" "LP/HP" COEFFS 0 65536 0 0 0 1 /end COMPU_METHOD
/begin CHARACTERISTIC sf_blink_output "{sf_blink_output&0xff=0:Disabled}{sf_blink_output&0xff=1:MIL}{sf_blink_output&0xff=2:Soft warning}{sf_blink_output&0xff=3:Hard warning}" VALUE 0x0016c330 /* @ECU_Address@sf_blink_output@0x0100F8E0@ */ ECIPP_ALIGNMENT_UBYTE 255 sf_blink_output_COMPU_VTAB 0 255 BIT_MASK 0xff /end CHARACTERISTIC
/begin COMPU_METHOD sf_blink_output_COMPU_VTAB "Verbal Table" TAB_VERB "%.0" "list" COMPU_TAB_REF sf_blink_output_COMPU_VTAB_REF /end COMPU_METHOD
/begin COMPU_VTAB sf_blink_output_COMPU_VTAB_REF "Verbal Table" TAB_VERB 4 0 "Disabled" 1 "MIL" 2 "Soft warning" 3 "Hard warning" DEFAULT_VALUE "UNKNOWN" /end COMPU_VTAB
/begin CHARACTERISTIC EGR_LoExp2_mdot "Air # EGR_LoExp2_mdot (Fault Condition:EGR flow command >)" VALUE 0x0014089e /* @ECU_Address@EGR_LoExp2_mdot@0x0100F8E8@ */ ECIPP_ALIGNMENT_UWORD 1024 Compu_EGR_LoExp2_mdot 0 1023.984375 /end CHARACTERISTIC
/begin COMPU_METHOD Compu_EGR_LoExp2_mdot " " RAT_FUNC "%.3" "g/sec" COEFFS 0 64 0 0 0 1 /end COMPU_METHOD
/begin CHARACTERISTIC EGR_LoExp2_pctmin "Air # EGR_LoExp2_pctmin (Fault Condition:and command >)" VALUE 0x001408a2 /* @ECU_Address@EGR_LoExp2_pctmin@0x0100F8F0@ */ ECIPP_ALIGNMENT_UWORD 400 Compu_EGR_LoExp2_pctmin 0 399.993896484375 /end CHARACTERISTIC
/begin COMPU_METHOD Compu_EGR_LoExp2_pctmin " " RAT_FUNC "%.3" "% dil" COEFFS 0 163.84 0 0 0 1 /end COMPU_METHOD
/begin CHARACTERISTIC EGR_LoExp2_pcterr "Air # EGR_LoExp2_pcterr (Fault Condition:and command - actual >)" VALUE 0x001408a0 /* @ECU_Address@EGR_LoExp2_pcterr@0x0100F8F8@ */ ECIPP_ALIGNMENT_UWORD 400 Compu_EGR_LoExp2_pcterr 0 399.993896484375 /end CHARACTERISTIC
/begin COMPU_METHOD Compu_EGR_LoExp2_pcterr " " RAT_FUNC "%.3" "% dil" COEFFS 0 163.84 0 0 0 1 /end COMPU_METHOD
/begin CHARACTERISTIC EGR_clr_eta2_ECTmin "Air # EGR_clr_eta2_ECTmin (Fault Condition:ECT >)" VALUE 0x001408ba /* @ECU_Address@EGR_clr_eta2_ECTmin@0x0100F900@ */ ECIPP_ALIGNMENT_UWORD 564 Compu_EGR_clr_eta2_ECTmin -460 563.984375 /end CHARACTERISTIC
/begin COMPU_METHOD Compu_EGR_clr_eta2_ECTmin " " RAT_FUNC "%.3" "deg F" COEFFS 0 64 29440 0 0 1 /end COMPU_METHOD
/begin CHARACTERISTIC EGR_clr_eta2_ECTmax "Air # EGR_clr_eta2_ECTmax (Fault Condition:and ECT <)" VALUE 0x001408b8 /* @ECU_Address@EGR_clr_eta2_ECTmax@0x0100F908@ */ ECIPP_ALIGNMENT_UWORD 564 Compu_EGR_clr_eta2_ECTmax -460 563.984375 /end CHARACTERISTIC
/begin COMPU_METHOD Compu_EGR_clr_eta2_ECTmax " " RAT_FUNC "%.3" "deg F" COEFFS 0 64 29440 0 0 1 /end COMPU_METHOD
/begin CHARACTERISTIC EGR_clr_eta2_Tmax "Air # EGR_clr_eta2_Tmax (Fault Condition:EGRT >)" VALUE 0x001408bc /* @ECU_Address@EGR_clr_eta2_Tmax@0x0100F910@ */ ECIPP_ALIGNMENT_UWORD 7732 Compu_EGR_clr_eta2_Tmax -460 7731.875 /end CHARACTERISTIC
/begin COMPU_METHOD Compu_EGR_clr_eta2_Tmax " " RAT_FUNC "%.3" "deg F" COEFFS 0 8 3680 0 0 1 /end COMPU_METHOD
/begin CHARACTERISTIC EGRwrT_vdr "IOConfig # EGRwrT_vdr" VALUE 0x00143988 /* @ECU_Address@EGRwrT_vdr@0x0100F920@ */ ECIPP_ALIGNMENT_FLOAT32_IEEE 10000000000 Compu_EGRwrT_vdr -10000000000 10000000000 /end CHARACTERISTIC
/begin COMPU_METHOD Compu_EGRwrT_vdr " " RAT_FUNC "%.3" "ohms" COEFFS 0 1 0 0 0 1 /end COMPU_METHOD
/begin CHARACTERISTIC EGRwrT_Taux_cal "{EGRwrT_Taux_cal&0xff=0:Fuel source}{EGRwrT_Taux_cal&0xff=1:Exhaust manifold/riser}{EGRwrT_Taux_cal&0xff=2:Aux Temp A}{EGRwrT_Taux_cal&0xff=3:Aux Temp B}{EGRwrT_Taux_cal&0xff=4:Aux Temp C}{EGRwrT_Taux_cal&0xff=5:Aux Temp D}" VALUE 0x00147d2b /* @ECU_Address@EGRwrT_Taux_cal@0x0100F928@ */ ECIPP_ALIGNMENT_UBYTE 255 EGRwrT_Taux_cal_COMPU_VTAB 0 255 BIT_MASK 0xff /end CHARACTERISTIC
/begin COMPU_METHOD EGRwrT_Taux_cal_COMPU_VTAB "Verbal Table" TAB_VERB "%.0" "list" COMPU_TAB_REF EGRwrT_Taux_cal_COMPU_VTAB_REF /end COMPU_METHOD
/begin COMPU_VTAB EGRwrT_Taux_cal_COMPU_VTAB_REF "Verbal Table" TAB_VERB 6 0 "Fuel source" 1 "Exhaust manifold/riser" 2 "Aux Temp A" 3 "Aux Temp B" 4 "Aux Temp C" 5 "Aux Temp D" DEFAULT_VALUE "UNKNOWN" /end COMPU_VTAB
/begin CHARACTERISTIC BstTIP_Lo2 "FaultConfig # BstTIP_Lo2 (Fault Condition:P < P target -)" VALUE 0x001466c0 /* @ECU_Address@BstTIP_Lo2@0x0100F980@ */ ECIPP_ALIGNMENT_UWORD 256 Compu_BstTIP_Lo2 0 255.99609375 /end CHARACTERISTIC
/begin COMPU_METHOD Compu_BstTIP_Lo2 " " RAT_FUNC "%.3" "psi" COEFFS 0 256 0 0 0 1 /end COMPU_METHOD
/begin CHARACTERISTIC BstTIP_Lo2_abs "FaultConfig # BstTIP_Lo2_abs (Fault Condition:and P target >)" VALUE 0x001466c8 /* @ECU_Address@BstTIP_Lo2_abs@0x0100F988@ */ ECIPP_ALIGNMENT_UWORD 256 Compu_BstTIP_Lo2_abs 0 255.99609375 /end CHARACTERISTIC
/begin COMPU_METHOD Compu_BstTIP_Lo2_abs " " RAT_FUNC "%.3" "psia" COEFFS 0 256 0 0 0 1 /end COMPU_METHOD
/begin CHARACTERISTIC BstTIP_Lo2_dtdz "FaultConfig # BstTIP_Lo2_dtdz (Fault Condition:and dP/dt <=)" VALUE 0x0014424c /* @ECU_Address@BstTIP_Lo2_dtdz@0x0100F990@ */ ECIPP_ALIGNMENT_SWORD 512 Compu_BstTIP_Lo2_dtdz -512 511.984375 /end CHARACTERISTIC
/begin COMPU_METHOD Compu_BstTIP_Lo2_dtdz " " RAT_FUNC "%.3" "psi/sec" COEFFS 0 64 0 0 0 1 /end COMPU_METHOD
/begin CHARACTERISTIC BstTIP_Lo2_RPM "FaultConfig # BstTIP_Lo2_RPM (Fault Condition:and RPM >)" VALUE 0x001466c4 /* @ECU_Address@BstTIP_Lo2_RPM@0x0100F998@ */ ECIPP_ALIGNMENT_UWORD 65535 Compu_BstTIP_Lo2_RPM 0 65535 /end CHARACTERISTIC
/begin COMPU_METHOD Compu_BstTIP_Lo2_RPM " " RAT_FUNC "%.0" "rpm" COEFFS 0 1 0 0 0 1 /end COMPU_METHOD
/begin CHARACTERISTIC BstTIP_Lo2_ECT "FaultConfig # BstTIP_Lo2_ECT (Fault Condition:and ECT >)" VALUE 0x001466c2 /* @ECU_Address@BstTIP_Lo2_ECT@0x0100F9A0@ */ ECIPP_ALIGNMENT_UWORD 564 Compu_BstTIP_Lo2_ECT -460 563.984375 /end CHARACTERISTIC
/begin COMPU_METHOD Compu_BstTIP_Lo2_ECT " " RAT_FUNC "%.3" "deg F" COEFFS 0 64 29440 0 0 1 /end COMPU_METHOD
/begin CHARACTERISTIC FIMP_SW_input_pin "{FIMP_SW_input_pin&0xff=0:Disabled}{FIMP_SW_input_pin&0xff=1:Aux DIG1}{FIMP_SW_input_pin&0xff=2:Aux DIG2}{FIMP_SW_input_pin&0xff=3:Aux DIG3}{FIMP_SW_input_pin&0xff=4:Aux DIG4}{FIMP_SW_input_pin&0xff=5:Aux DIG5}{FIMP_SW_input_pin&0xff=6:Aux DIG6}{FIMP_SW_i" VALUE 0x00147d4e /* @ECU_Address@FIMP_SW_input_pin@0x0100FB58@ */ ECIPP_ALIGNMENT_UBYTE 255 FIMP_SW_input_pin_COMPU_VTAB 0 255 BIT_MASK 0xff /end CHARACTERISTIC
/begin COMPU_METHOD FIMP_SW_input_pin_COMPU_VTAB "Verbal Table" TAB_VERB "%.0" "list" COMPU_TAB_REF FIMP_SW_input_pin_COMPU_VTAB_REF /end COMPU_METHOD
/begin COMPU_VTAB FIMP_SW_input_pin_COMPU_VTAB_REF "Verbal Table" TAB_VERB 20 0 "Disabled" 1 "Aux DIG1" 2 "Aux DIG2" 3 "Aux DIG3" 4 "Aux DIG4" 5 "Aux DIG5" 6 "Aux DIG6" 7 "Aux DIG7" 8 "Aux DIG8" 9 "Aux DIG9" 10 "Aux DIG10" 11 "Aux DIG11" 12 "Aux DIG12" 13 "Aux DIG13" 14 "Aux DIG14" 15 "Aux DIG15" 16 "Aux DIG16" 17 "Aux DIG17" 18 "Aux DIG18" 19 "Aux DIG19" DEFAULT_VALUE "UNKNOWN" /end COMPU_VTAB
/begin CHARACTERISTIC FIMP_SW_input_cfg "{FIMP_SW_input_cfg&0xff=0x00:Disabled}{FIMP_SW_input_cfg&0xff=0x01:Gnd=0, Open=50, +V=100}{FIMP_SW_input_cfg&0xff=0x02:Gnd=0, Open=100, +V=50}{FIMP_SW_input_cfg&0xff=0x03:Gnd=50, Open=0, +V=100}{FIMP_SW_input_cfg&0xff=0x04:Gnd=50, Open=100, +V=0}{FIMP_SW_" VALUE 0x00147d4d /* @ECU_Address@FIMP_SW_input_cfg@0x0100FB60@ */ ECIPP_ALIGNMENT_UBYTE 255 FIMP_SW_input_cfg_COMPU_VTAB 0 255 BIT_MASK 0xff /end CHARACTERISTIC
/begin COMPU_METHOD FIMP_SW_input_cfg_COMPU_VTAB "Verbal Table" TAB_VERB "%.0" "list" COMPU_TAB_REF FIMP_SW_input_cfg_COMPU_VTAB_REF /end COMPU_METHOD
/begin COMPU_VTAB FIMP_SW_input_cfg_COMPU_VTAB_REF "Verbal Table" TAB_VERB 7 0x00 "Disabled" 0x01 "Gnd=0, Open=50, +V=100" 0x02 "Gnd=0, Open=100, +V=50" 0x03 "Gnd=50, Open=0, +V=100" 0x04 "Gnd=50, Open=100, +V=0" 0x05 "Gnd=100, Open=0, +V=50" 0x06 "Gnd=100, Open=50, +V=0" DEFAULT_VALUE "UNKNOWN" /end COMPU_VTAB
/begin CHARACTERISTIC FIMP_extV_input_pin "{FIMP_extV_input_pin&0xff=0:Disabled}{FIMP_extV_input_pin&0xff=1:Aux PU1}{FIMP_extV_input_pin&0xff=2:Aux PU2}{FIMP_extV_input_pin&0xff=3:Aux PU3}{FIMP_extV_input_pin&0xff=4:Aux PD1}{FIMP_extV_input_pin&0xff=5:Aux PD2}{FIMP_extV_input_pin&0xff=6:Aux PD3}{F" VALUE 0x00147d50 /* @ECU_Address@FIMP_extV_input_pin@0x0100FB68@ */ ECIPP_ALIGNMENT_UBYTE 255 FIMP_extV_input_pin_COMPU_VTAB 0 255 BIT_MASK 0xff /end CHARACTERISTIC
/begin COMPU_METHOD FIMP_extV_input_pin_COMPU_VTAB "Verbal Table" TAB_VERB "%.0" "list" COMPU_TAB_REF FIMP_extV_input_pin_COMPU_VTAB_REF /end COMPU_METHOD
/begin COMPU_VTAB FIMP_extV_input_pin_COMPU_VTAB_REF "Verbal Table" TAB_VERB 32 0 "Disabled" 1 "Aux PU1" 2 "Aux PU2" 3 "Aux PU3" 4 "Aux PD1" 5 "Aux PD2" 6 "Aux PD3" 7 "Aux PUD1" 8 "Aux PUD2" 9 "Aux PUD3" 10 "Aux PUD4" 11 "Aux PUD5" 12 "Aux PUD6" 13 "Aux PUD7" 14 "Aux PUD8" 15 "Aux PUD9" 16 "Aux PUD10" 17 "Aux PUD11" 18 "Aux PUD12" 19 "Aux PUD13" 20 "Aux PUD14" 21 "Aux PUD15" 22 "Aux PUD16" 23 "Aux PUD17" 24 "Aux PUD18" 25 "Aux PUD19" 26 "Aux PUD20" 27 "Aux PUD21" 28 "Aux PUD22" 29 "Aux PUD23" 30 "Aux PUD24" 31 "Aux PUD25" DEFAULT_VALUE "UNKNOWN" /end COMPU_VTAB
/begin CHARACTERISTIC FIMP_extV_tau "IOConfig # FIMP_extV_tau" VALUE 0x00147bdc /* @ECU_Address@FIMP_extV_tau@0x0100FB70@ */ ECIPP_ALIGNMENT_UWORD 327680 Compu_FIMP_extV_tau 0.45084 327680 /end CHARACTERISTIC
/begin COMPU_METHOD Compu_FIMP_extV_tau " " FORM "%.3" "ms"
 /begin FORMULA "-5 / log(1 - (X1 / 65536))" FORMULA_INV "(1 - exp(-5/X1)) * 65536" /end FORMULA
/end COMPU_METHOD
/begin CHARACTERISTIC FIMP_extV_0pct "IOConfig # FIMP_extV_0pct" VALUE 0x0014685e /* @ECU_Address@FIMP_extV_0pct@0x0100FB78@ */ ECIPP_ALIGNMENT_UWORD 5 Compu_FIMP_extV_0pct 0 5.00114468864469 /end CHARACTERISTIC
/begin COMPU_METHOD Compu_FIMP_extV_0pct " " RAT_FUNC "%.3" "volts" COEFFS 0 13104 0 0 0 1 /end COMPU_METHOD
/begin CHARACTERISTIC FIMP_extV_100pct "IOConfig # FIMP_extV_100pct" VALUE 0x00146860 /* @ECU_Address@FIMP_extV_100pct@0x0100FB80@ */ ECIPP_ALIGNMENT_UWORD 5 Compu_FIMP_extV_100pct 0 5.00114468864469 /end CHARACTERISTIC
/begin COMPU_METHOD Compu_FIMP_extV_100pct " " RAT_FUNC "%.3" "volts" COEFFS 0 13104 0 0 0 1 /end COMPU_METHOD
/begin CHARACTERISTIC cam2loss_rpm "FaultConfig # cam2loss_rpm (Fault Condition:and RPM >)" VALUE 0x00147a96 /* @ECU_Address@cam2loss_rpm@0x0100FC38@ */ ECIPP_ALIGNMENT_UWORD 65535 Compu_cam2loss_rpm 0 65535 /end CHARACTERISTIC
/begin COMPU_METHOD Compu_cam2loss_rpm " " RAT_FUNC "%.0" "rpm" COEFFS 0 1 0 0 0 1 /end COMPU_METHOD
/begin CHARACTERISTIC cam2loss "FaultConfig # cam2loss (Fault Condition:No cam pulse in)" VALUE 0x00148122 /* @ECU_Address@cam2loss@0x0100FC40@ */ ECIPP_ALIGNMENT_UBYTE 64 Compu_cam2loss 0 63.75 /end CHARACTERISTIC
/begin COMPU_METHOD Compu_cam2loss " " RAT_FUNC "%.3" "cycles" COEFFS 0 4 0 0 0 1 /end COMPU_METHOD
/begin CHARACTERISTIC FIP_Paux_cal "{FIP_Paux_cal&0xff=0:Aux Press A}{FIP_Paux_cal&0xff=1:Aux Press B}{FIP_Paux_cal&0xff=2:Aux Press C}{FIP_Paux_cal&0xff=3:Aux Press D}" VALUE 0x00147d54 /* @ECU_Address@FIP_Paux_cal@0x0100FD08@ */ ECIPP_ALIGNMENT_UBYTE 255 FIP_Paux_cal_COMPU_VTAB 0 255 BIT_MASK 0xff /end CHARACTERISTIC
/begin COMPU_METHOD FIP_Paux_cal_COMPU_VTAB "Verbal Table" TAB_VERB "%.0" "list" COMPU_TAB_REF FIP_Paux_cal_COMPU_VTAB_REF /end COMPU_METHOD
/begin COMPU_VTAB FIP_Paux_cal_COMPU_VTAB_REF "Verbal Table" TAB_VERB 4 0 "Aux Press A" 1 "Aux Press B" 2 "Aux Press C" 3 "Aux Press D" DEFAULT_VALUE "UNKNOWN" /end COMPU_VTAB
/begin MEASUREMENT enov_slnk_1ms_ena "{enov_slnk_1ms_ena&0xff=0:NO}{enov_slnk_1ms_ena&0xff=1:YES}" UBYTE enov_slnk_1ms_ena_COMPU_VTAB 0 0 0 255 ECU_ADDRESS 0x0100FEA0 BIT_MASK 0xff /end MEASUREMENT
/begin COMPU_METHOD enov_slnk_1ms_ena_COMPU_VTAB "Verbal Table" TAB_VERB "%.0" "list" COMPU_TAB_REF enov_slnk_1ms_ena_COMPU_VTAB_REF /end COMPU_METHOD
/begin COMPU_VTAB enov_slnk_1ms_ena_COMPU_VTAB_REF "Verbal Table" TAB_VERB 2 0 "NO" 1 "YES" DEFAULT_VALUE "UNKNOWN" /end COMPU_VTAB
/begin MEASUREMENT enov_slnk_5ms_ena "{enov_slnk_5ms_ena&0xff=0:NO}{enov_slnk_5ms_ena&0xff=1:YES}" UBYTE enov_slnk_5ms_ena_COMPU_VTAB 0 0 0 255 ECU_ADDRESS 0x0100FEC8 BIT_MASK 0xff /end MEASUREMENT
/begin COMPU_METHOD enov_slnk_5ms_ena_COMPU_VTAB "Verbal Table" TAB_VERB "%.0" "list" COMPU_TAB_REF enov_slnk_5ms_ena_COMPU_VTAB_REF /end COMPU_METHOD
/begin COMPU_VTAB enov_slnk_5ms_ena_COMPU_VTAB_REF "Verbal Table" TAB_VERB 2 0 "NO" 1 "YES" DEFAULT_VALUE "UNKNOWN" /end COMPU_VTAB
/begin MEASUREMENT enov_slnk_50ms_ena "{enov_slnk_50ms_ena&0xff=0:NO}{enov_slnk_50ms_ena&0xff=1:YES}" UBYTE enov_slnk_50ms_ena_COMPU_VTAB 0 0 0 255 ECU_ADDRESS 0x0100FEF0 BIT_MASK 0xff /end MEASUREMENT
/begin COMPU_METHOD enov_slnk_50ms_ena_COMPU_VTAB "Verbal Table" TAB_VERB "%.0" "list" COMPU_TAB_REF enov_slnk_50ms_ena_COMPU_VTAB_REF /end COMPU_METHOD
/begin COMPU_VTAB enov_slnk_50ms_ena_COMPU_VTAB_REF "Verbal Table" TAB_VERB 2 0 "NO" 1 "YES" DEFAULT_VALUE "UNKNOWN" /end COMPU_VTAB
/begin CHARACTERISTIC EGRT_maxv "Air # EGRT_maxv (Fault Condition:EGRT voltage >)" VALUE 0x00140892 /* @ECU_Address@EGRT_maxv@0x0100FFA8@ */ ECIPP_ALIGNMENT_UWORD 5 Compu_EGRT_maxv 0 5.00114468864469 /end CHARACTERISTIC
/begin COMPU_METHOD Compu_EGRT_maxv " " RAT_FUNC "%.3" "volts" COEFFS 0 13104 0 0 0 1 /end COMPU_METHOD
/begin CHARACTERISTIC EGRT_maxv_ECTmin "Air # EGRT_maxv_ECTmin (Fault Condition:and ECT >)" VALUE 0x00140894 /* @ECU_Address@EGRT_maxv_ECTmin@0x0100FFB0@ */ ECIPP_ALIGNMENT_UWORD 564 Compu_EGRT_maxv_ECTmin -460 563.984375 /end CHARACTERISTIC
/begin COMPU_METHOD Compu_EGRT_maxv_ECTmin " " RAT_FUNC "%.3" "deg F" COEFFS 0 64 29440 0 0 1 /end COMPU_METHOD
/begin CHARACTERISTIC EGRT_minv "Air # EGRT_minv (Fault Condition:EGRT voltage <)" VALUE 0x00140896 /* @ECU_Address@EGRT_minv@0x0100FFB8@ */ ECIPP_ALIGNMENT_UWORD 5 Compu_EGRT_minv 0 5.00114468864469 /end CHARACTERISTIC
/begin COMPU_METHOD Compu_EGRT_minv " " RAT_FUNC "%.3" "volts" COEFFS 0 13104 0 0 0 1 /end COMPU_METHOD
/begin CHARACTERISTIC EGRT_hi_ECTmin "Air # EGRT_hi_ECTmin (Fault Condition:ECT >)" VALUE 0x0014088e /* @ECU_Address@EGRT_hi_ECTmin@0x0100FFC0@ */ ECIPP_ALIGNMENT_UWORD 564 Compu_EGRT_hi_ECTmin -460 563.984375 /end CHARACTERISTIC
/begin COMPU_METHOD Compu_EGRT_hi_ECTmin " " RAT_FUNC "%.3" "deg F" COEFFS 0 64 29440 0 0 1 /end COMPU_METHOD
/begin CHARACTERISTIC EGRT_hi_ECTmax "Air # EGRT_hi_ECTmax (Fault Condition:and ECT <)" VALUE 0x0014088c /* @ECU_Address@EGRT_hi_ECTmax@0x0100FFC8@ */ ECIPP_ALIGNMENT_UWORD 564 Compu_EGRT_hi_ECTmax -460 563.984375 /end CHARACTERISTIC
/begin COMPU_METHOD Compu_EGRT_hi_ECTmax " " RAT_FUNC "%.3" "deg F" COEFFS 0 64 29440 0 0 1 /end COMPU_METHOD
/begin CHARACTERISTIC EGRT_hi_Tmax "Air # EGRT_hi_Tmax (Fault Condition:EGRT >)" VALUE 0x00140890 /* @ECU_Address@EGRT_hi_Tmax@0x0100FFD0@ */ ECIPP_ALIGNMENT_UWORD 7732 Compu_EGRT_hi_Tmax -460 7731.875 /end CHARACTERISTIC
/begin COMPU_METHOD Compu_EGRT_hi_Tmax " " RAT_FUNC "%.3" "deg F" COEFFS 0 8 3680 0 0 1 /end COMPU_METHOD
/begin CHARACTERISTIC FIP_LoExp_mdot "Fuel # FIP_LoExp_mdot (Fault Condition:and fuel flow >)" VALUE 0x0014686a /* @ECU_Address@FIP_LoExp_mdot@0x0100FFD8@ */ ECIPP_ALIGNMENT_UWORD 128 Compu_FIP_LoExp_mdot 0 127.998046875 /end CHARACTERISTIC
/begin COMPU_METHOD Compu_FIP_LoExp_mdot " " RAT_FUNC "%.3" "g/sec" COEFFS 0 512 0 0 0 1 /end COMPU_METHOD
/begin CHARACTERISTIC WGPerr_pos "FaultConfig # WGPerr_pos (Fault Condition:(target WGP - actual WGP) >)" VALUE 0x00146584 /* @ECU_Address@WGPerr_pos@0x0100FFE0@ */ ECIPP_ALIGNMENT_SWORD 100 Compu_WGPerr_pos -100 99.9969482421875 /end CHARACTERISTIC
/begin COMPU_METHOD Compu_WGPerr_pos " " RAT_FUNC "%.3" "%" COEFFS 0 327.68 0 0 0 1 /end COMPU_METHOD
/begin CHARACTERISTIC WGPerr_neg "FaultConfig # WGPerr_neg (Fault Condition:(target WGP - actual WGP) <)" VALUE 0x00146582 /* @ECU_Address@WGPerr_neg@0x0100FFE8@ */ ECIPP_ALIGNMENT_SWORD 100 Compu_WGPerr_neg -100 99.9969482421875 /end CHARACTERISTIC
/begin COMPU_METHOD Compu_WGPerr_neg " " RAT_FUNC "%.3" "%" COEFFS 0 327.68 0 0 0 1 /end COMPU_METHOD
/begin CHARACTERISTIC WGPerr_dtdz "FaultConfig # WGPerr_dtdz (Fault Condition:and abs(dTIP/dt) <=)" VALUE 0x00146580 /* @ECU_Address@WGPerr_dtdz@0x0100FFF0@ */ ECIPP_ALIGNMENT_SWORD 512 Compu_WGPerr_dtdz -512 511.984375 /end CHARACTERISTIC
/begin COMPU_METHOD Compu_WGPerr_dtdz " " RAT_FUNC "%.3" "psi/sec" COEFFS 0 64 0 0 0 1 /end COMPU_METHOD
/begin CHARACTERISTIC KNK_retardlmt_MAX "FaultConfig # KNK_retardlmt_MAX (Fault Condition:and knock spark retard at percent of maximum)" VALUE 0x00147530 /* @ECU_Address@KNK_retardlmt_MAX@0x01010000@ */ ECIPP_ALIGNMENT_UWORD 100 Compu_KNK_retardlmt_MAX 0 99.9984741210938 /end CHARACTERISTIC
/begin COMPU_METHOD Compu_KNK_retardlmt_MAX " " RAT_FUNC "%.3" "%" COEFFS 0 655.36 0 0 0 1 /end COMPU_METHOD
/begin CHARACTERISTIC KNK_retardlmt_MAX2 "FaultConfig # KNK_retardlmt_MAX2 (Fault Condition:and knock spark retard at percent of maximum)" VALUE 0x00147532 /* @ECU_Address@KNK_retardlmt_MAX2@0x01010008@ */ ECIPP_ALIGNMENT_UWORD 100 Compu_KNK_retardlmt_MAX2 0 99.9984741210938 /end CHARACTERISTIC
/begin COMPU_METHOD Compu_KNK_retardlmt_MAX2 " " RAT_FUNC "%.3" "%" COEFFS 0 655.36 0 0 0 1 /end COMPU_METHOD
/begin CHARACTERISTIC KNK_retardlmt_RPM2 "FaultConfig # KNK_retardlmt_RPM2 (Fault Condition:RPM >)" VALUE 0x00147536 /* @ECU_Address@KNK_retardlmt_RPM2@0x01010010@ */ ECIPP_ALIGNMENT_UWORD 65535 Compu_KNK_retardlmt_RPM2 0 65535 /end CHARACTERISTIC
/begin COMPU_METHOD Compu_KNK_retardlmt_RPM2 " " RAT_FUNC "%.0" "rpm" COEFFS 0 1 0 0 0 1 /end COMPU_METHOD
/begin CHARACTERISTIC KNK_retardlmt_MAP2 "FaultConfig # KNK_retardlmt_MAP2 (Fault Condition:and MAP >)" VALUE 0x0014752e /* @ECU_Address@KNK_retardlmt_MAP2@0x01010018@ */ ECIPP_ALIGNMENT_UWORD 256 Compu_KNK_retardlmt_MAP2 0 255.99609375 /end CHARACTERISTIC
/begin COMPU_METHOD Compu_KNK_retardlmt_MAP2 " " RAT_FUNC "%.3" "psia" COEFFS 0 256 0 0 0 1 /end COMPU_METHOD
/begin CHARACTERISTIC imu_temp_max "FaultConfig # imu_temp_max (Fault Condition:IMU temperature >=)" VALUE 0x0014666e /* @ECU_Address@imu_temp_max@0x010101E8@ */ ECIPP_ALIGNMENT_SWORD 2073 Compu_imu_temp_max -2023 2072.9375 /end CHARACTERISTIC
/begin COMPU_METHOD Compu_imu_temp_max " " RAT_FUNC "%.3" "deg C" COEFFS 0 16 -400 0 0 1 /end COMPU_METHOD
/begin CHARACTERISTIC imu_temp_min "FaultConfig # imu_temp_min (Fault Condition:IMU temperature <=)" VALUE 0x00146670 /* @ECU_Address@imu_temp_min@0x010101F0@ */ ECIPP_ALIGNMENT_SWORD 2073 Compu_imu_temp_min -2023 2072.9375 /end CHARACTERISTIC
/begin COMPU_METHOD Compu_imu_temp_min " " RAT_FUNC "%.3" "deg C" COEFFS 0 16 -400 0 0 1 /end COMPU_METHOD
/begin CHARACTERISTIC imu_temp_min_wait "FaultConfig # imu_temp_min_wait (Fault Condition:and  key-on time >=)" VALUE 0x00144228 /* @ECU_Address@imu_temp_min_wait@0x010101F8@ */ ECIPP_ALIGNMENT_ULONG 4294967 Compu_imu_temp_min_wait 0 4294967.295 /end CHARACTERISTIC
/begin COMPU_METHOD Compu_imu_temp_min_wait " " RAT_FUNC "%.3" "seconds" COEFFS 0 1000 0 0 0 1 /end COMPU_METHOD
/begin CHARACTERISTIC imu_accel_x_max "FaultConfig # imu_accel_x_max (Fault Condition:X-axis linear acceleration >=)" VALUE 0x00143c4c /* @ECU_Address@imu_accel_x_max@0x01010200@ */ ECIPP_ALIGNMENT_FLOAT32_IEEE 10000000000 Compu_imu_accel_x_max -10000000000 10000000000 /end CHARACTERISTIC
/begin COMPU_METHOD Compu_imu_accel_x_max " " RAT_FUNC "%.3" "g" COEFFS 0 1 0 0 0 1 /end COMPU_METHOD
/begin CHARACTERISTIC imu_accel_x_min "FaultConfig # imu_accel_x_min (Fault Condition:X-axis linear acceleration <=)" VALUE 0x00143c50 /* @ECU_Address@imu_accel_x_min@0x01010208@ */ ECIPP_ALIGNMENT_FLOAT32_IEEE 10000000000 Compu_imu_accel_x_min -10000000000 10000000000 /end CHARACTERISTIC
/begin COMPU_METHOD Compu_imu_accel_x_min " " RAT_FUNC "%.3" "g" COEFFS 0 1 0 0 0 1 /end COMPU_METHOD
/begin CHARACTERISTIC imu_accel_y_max "FaultConfig # imu_accel_y_max (Fault Condition:Y-axis linear acceleration >=)" VALUE 0x00143c54 /* @ECU_Address@imu_accel_y_max@0x01010210@ */ ECIPP_ALIGNMENT_FLOAT32_IEEE 10000000000 Compu_imu_accel_y_max -10000000000 10000000000 /end CHARACTERISTIC
/begin COMPU_METHOD Compu_imu_accel_y_max " " RAT_FUNC "%.3" "g" COEFFS 0 1 0 0 0 1 /end COMPU_METHOD
/begin CHARACTERISTIC imu_accel_y_min "FaultConfig # imu_accel_y_min (Fault Condition:Y-axis linear acceleration <=)" VALUE 0x00143c58 /* @ECU_Address@imu_accel_y_min@0x01010218@ */ ECIPP_ALIGNMENT_FLOAT32_IEEE 10000000000 Compu_imu_accel_y_min -10000000000 10000000000 /end CHARACTERISTIC
/begin COMPU_METHOD Compu_imu_accel_y_min " " RAT_FUNC "%.3" "g" COEFFS 0 1 0 0 0 1 /end COMPU_METHOD
/begin CHARACTERISTIC imu_accel_z_max "FaultConfig # imu_accel_z_max (Fault Condition:Z-axis linear acceleration >=)" VALUE 0x00143c5c /* @ECU_Address@imu_accel_z_max@0x01010220@ */ ECIPP_ALIGNMENT_FLOAT32_IEEE 10000000000 Compu_imu_accel_z_max -10000000000 10000000000 /end CHARACTERISTIC
/begin COMPU_METHOD Compu_imu_accel_z_max " " RAT_FUNC "%.3" "g" COEFFS 0 1 0 0 0 1 /end COMPU_METHOD
/begin CHARACTERISTIC imu_accel_z_min "FaultConfig # imu_accel_z_min (Fault Condition:Z-axis linear acceleration <=)" VALUE 0x00143c60 /* @ECU_Address@imu_accel_z_min@0x01010228@ */ ECIPP_ALIGNMENT_FLOAT32_IEEE 10000000000 Compu_imu_accel_z_min -10000000000 10000000000 /end CHARACTERISTIC
/begin COMPU_METHOD Compu_imu_accel_z_min " " RAT_FUNC "%.3" "g" COEFFS 0 1 0 0 0 1 /end COMPU_METHOD
/begin CHARACTERISTIC imu_gyro_x_max "FaultConfig # imu_gyro_x_max (Fault Condition:X-axis angular rate >=)" VALUE 0x00143c64 /* @ECU_Address@imu_gyro_x_max@0x01010230@ */ ECIPP_ALIGNMENT_FLOAT32_IEEE 10000000000 Compu_imu_gyro_x_max -10000000000 10000000000 /end CHARACTERISTIC
/begin COMPU_METHOD Compu_imu_gyro_x_max " " RAT_FUNC "%.3" "dps" COEFFS 0 1 0 0 0 1 /end COMPU_METHOD
/begin CHARACTERISTIC imu_gyro_x_min "FaultConfig # imu_gyro_x_min (Fault Condition:X-axis angular rate <=)" VALUE 0x00143c68 /* @ECU_Address@imu_gyro_x_min@0x01010238@ */ ECIPP_ALIGNMENT_FLOAT32_IEEE 10000000000 Compu_imu_gyro_x_min -10000000000 10000000000 /end CHARACTERISTIC
/begin COMPU_METHOD Compu_imu_gyro_x_min " " RAT_FUNC "%.3" "dps" COEFFS 0 1 0 0 0 1 /end COMPU_METHOD
/begin CHARACTERISTIC imu_gyro_y_max "FaultConfig # imu_gyro_y_max (Fault Condition:Y-axis angular rate >=)" VALUE 0x00143c6c /* @ECU_Address@imu_gyro_y_max@0x01010240@ */ ECIPP_ALIGNMENT_FLOAT32_IEEE 10000000000 Compu_imu_gyro_y_max -10000000000 10000000000 /end CHARACTERISTIC
/begin COMPU_METHOD Compu_imu_gyro_y_max " " RAT_FUNC "%.3" "dps" COEFFS 0 1 0 0 0 1 /end COMPU_METHOD
/begin CHARACTERISTIC imu_gyro_y_min "FaultConfig # imu_gyro_y_min (Fault Condition:Y-axis angular rate <=)" VALUE 0x00143c70 /* @ECU_Address@imu_gyro_y_min@0x01010248@ */ ECIPP_ALIGNMENT_FLOAT32_IEEE 10000000000 Compu_imu_gyro_y_min -10000000000 10000000000 /end CHARACTERISTIC
/begin COMPU_METHOD Compu_imu_gyro_y_min " " RAT_FUNC "%.3" "dps" COEFFS 0 1 0 0 0 1 /end COMPU_METHOD
/begin CHARACTERISTIC imu_gyro_z_max "FaultConfig # imu_gyro_z_max (Fault Condition:Z-axis angular rate >=)" VALUE 0x00143c74 /* @ECU_Address@imu_gyro_z_max@0x01010250@ */ ECIPP_ALIGNMENT_FLOAT32_IEEE 10000000000 Compu_imu_gyro_z_max -10000000000 10000000000 /end CHARACTERISTIC
/begin COMPU_METHOD Compu_imu_gyro_z_max " " RAT_FUNC "%.3" "dps" COEFFS 0 1 0 0 0 1 /end COMPU_METHOD
/begin CHARACTERISTIC imu_gyro_z_min "FaultConfig # imu_gyro_z_min (Fault Condition:Z-axis angular rate <=)" VALUE 0x00143c78 /* @ECU_Address@imu_gyro_z_min@0x01010258@ */ ECIPP_ALIGNMENT_FLOAT32_IEEE 10000000000 Compu_imu_gyro_z_min -10000000000 10000000000 /end CHARACTERISTIC
/begin COMPU_METHOD Compu_imu_gyro_z_min " " RAT_FUNC "%.3" "dps" COEFFS 0 1 0 0 0 1 /end COMPU_METHOD
/begin CHARACTERISTIC controller_type "{controller_type&0xff=0:Engine controller}{controller_type&0xff=1:Suspension controller}" VALUE 0x0016c30c /* @ECU_Address@controller_type@0x01010268@ */ ECIPP_ALIGNMENT_UBYTE 255 controller_type_COMPU_VTAB 0 255 BIT_MASK 0xff /end CHARACTERISTIC
/begin COMPU_METHOD controller_type_COMPU_VTAB "Verbal Table" TAB_VERB "%.0" "list" COMPU_TAB_REF controller_type_COMPU_VTAB_REF /end COMPU_METHOD
/begin COMPU_VTAB controller_type_COMPU_VTAB_REF "Verbal Table" TAB_VERB 2 0 "Engine controller" 1 "Suspension controller" DEFAULT_VALUE "UNKNOWN" /end COMPU_VTAB
/begin CHARACTERISTIC KNK_retardlmt_ECT2 "FaultConfig # KNK_retardlmt_ECT2 (Fault Condition:and ECT >)" VALUE 0x0014752a /* @ECU_Address@KNK_retardlmt_ECT2@0x010102B0@ */ ECIPP_ALIGNMENT_UWORD 564 Compu_KNK_retardlmt_ECT2 -460 563.984375 /end CHARACTERISTIC
/begin COMPU_METHOD Compu_KNK_retardlmt_ECT2 " " RAT_FUNC "%.3" "deg F" COEFFS 0 64 29440 0 0 1 /end COMPU_METHOD
/begin CHARACTERISTIC KNK_retardlmt_wt2 "FaultConfig # KNK_retardlmt_wt2 (Fault Condition:and engine run time >)" VALUE 0x001440f8 /* @ECU_Address@KNK_retardlmt_wt2@0x010102B8@ */ ECIPP_ALIGNMENT_ULONG 4294967 Compu_KNK_retardlmt_wt2 0 4294967.295 /end CHARACTERISTIC
/begin COMPU_METHOD Compu_KNK_retardlmt_wt2 " " RAT_FUNC "%.3" "sec" COEFFS 0 1000 0 0 0 1 /end COMPU_METHOD
/begin CHARACTERISTIC J1939_PGN_tout_runtm "FaultConfig # J1939_PGN_tout_runtm (Fault Condition:Run-time >)" VALUE 0x0014750a /* @ECU_Address@J1939_PGN_tout_runtm@0x01010340@ */ ECIPP_ALIGNMENT_UWORD 66 Compu_J1939_PGN_tout_runtm 0 65.535 /end CHARACTERISTIC
/begin COMPU_METHOD Compu_J1939_PGN_tout_runtm " " RAT_FUNC "%.3" "sec" COEFFS 0 1000 0 0 0 1 /end COMPU_METHOD
/begin CHARACTERISTIC J1939_PGN_tout_keytm "FaultConfig # J1939_PGN_tout_keytm (Fault Condition:and key-on time >)" VALUE 0x00147508 /* @ECU_Address@J1939_PGN_tout_keytm@0x01010380@ */ ECIPP_ALIGNMENT_UWORD 66 Compu_J1939_PGN_tout_keytm 0 65.535 /end CHARACTERISTIC
/begin COMPU_METHOD Compu_J1939_PGN_tout_keytm " " RAT_FUNC "%.3" "sec" COEFFS 0 1000 0 0 0 1 /end COMPU_METHOD
/begin MEASUREMENT VDS_state "Calibration Source{VDS_state&0xff=0:Standard is Loaded}{VDS_state&0xff=1:Variant is Loaded}{VDS_state&0xff=2:Request Standard}{VDS_state&0xff=3:Request Variant}" UBYTE VDS_state_COMPU_VTAB 0 0 0 255 ECU_ADDRESS 0x010104B0 BIT_MASK 0xff /end MEASUREMENT
/begin COMPU_METHOD VDS_state_COMPU_VTAB "Verbal Table" TAB_VERB "%.0" "list" COMPU_TAB_REF VDS_state_COMPU_VTAB_REF /end COMPU_METHOD
/begin COMPU_VTAB VDS_state_COMPU_VTAB_REF "Verbal Table" TAB_VERB 4 0 "Standard is Loaded" 1 "Variant is Loaded" 2 "Request Standard" 3 "Request Variant" DEFAULT_VALUE "UNKNOWN" /end COMPU_VTAB
/begin CHARACTERISTIC IAT_HiExp_FSOdis "{IAT_HiExp_FSOdis&0xff=0:No}{IAT_HiExp_FSOdis&0xff=1:Yes} (Fault Condition:Disable all IAT HiExp faults during fuel shut off)" VALUE 0x00166360 /* @ECU_Address@IAT_HiExp_FSOdis@0x010104D0@ */ ECIPP_ALIGNMENT_UBYTE 255 IAT_HiExp_FSOdis_COMPU_VTAB 0 255 BIT_MASK 0xff /end CHARACTERISTIC
/begin COMPU_METHOD IAT_HiExp_FSOdis_COMPU_VTAB "Verbal Table" TAB_VERB "%.0" "list" COMPU_TAB_REF IAT_HiExp_FSOdis_COMPU_VTAB_REF /end COMPU_METHOD
/begin COMPU_VTAB IAT_HiExp_FSOdis_COMPU_VTAB_REF "Verbal Table" TAB_VERB 2 0 "No" 1 "Yes" DEFAULT_VALUE "UNKNOWN" /end COMPU_VTAB
/begin CHARACTERISTIC J1939_TP_BAM "{J1939_TP_BAM&0xff=0x00:Disabled}{J1939_TP_BAM&0xff=0x01:Enabled}" VALUE 0x00166365 /* @ECU_Address@J1939_TP_BAM@0x010104D8@ */ ECIPP_ALIGNMENT_UBYTE 255 J1939_TP_BAM_COMPU_VTAB 0 255 BIT_MASK 0xff /end CHARACTERISTIC
/begin COMPU_METHOD J1939_TP_BAM_COMPU_VTAB "Verbal Table" TAB_VERB "%.0" "list" COMPU_TAB_REF J1939_TP_BAM_COMPU_VTAB_REF /end COMPU_METHOD
/begin COMPU_VTAB J1939_TP_BAM_COMPU_VTAB_REF "Verbal Table" TAB_VERB 2 0x00 "Disabled" 0x01 "Enabled" DEFAULT_VALUE "UNKNOWN" /end COMPU_VTAB
/begin CHARACTERISTIC TEL_enable_FAW "Telematics system 3{TEL_enable_FAW&0xff=0:Disabled}{TEL_enable_FAW&0xff=1:Enabled}" VALUE 0x00148095 /* @ECU_Address@TEL_enable_FAW@0x010104E0@ */ ECIPP_ALIGNMENT_UBYTE 255 TEL_enable_FAW_COMPU_VTAB 0 255 MAX_REFRESH 6 1 BIT_MASK 0xff /end CHARACTERISTIC
/begin COMPU_METHOD TEL_enable_FAW_COMPU_VTAB "Verbal Table" TAB_VERB "%.0" "list" COMPU_TAB_REF TEL_enable_FAW_COMPU_VTAB_REF /end COMPU_METHOD
/begin COMPU_VTAB TEL_enable_FAW_COMPU_VTAB_REF "Verbal Table" TAB_VERB 2 0 "Disabled" 1 "Enabled" DEFAULT_VALUE "UNKNOWN" /end COMPU_VTAB
/begin CHARACTERISTIC LOD_min_ECT "FaultConfig # LOD_min_ECT (Fault Condition:and ECT >)" VALUE 0x00164f2a /* @ECU_Address@LOD_min_ECT@0x010104E8@ */ ECIPP_ALIGNMENT_UWORD 564 Compu_LOD_min_ECT -460 563.984375 /end CHARACTERISTIC
/begin COMPU_METHOD Compu_LOD_min_ECT " " RAT_FUNC "%.3" "deg F" COEFFS 0 64 29440 0 0 1 /end COMPU_METHOD
/begin CHARACTERISTIC LOD_min_ECT_tm "FaultConfig # LOD_min_ECT_tm (Fault Condition:and ECT > above temp for)" VALUE 0x00162b94 /* @ECU_Address@LOD_min_ECT_tm@0x010104F0@ */ ECIPP_ALIGNMENT_ULONG 4294967 Compu_LOD_min_ECT_tm 0 4294967.295 /end CHARACTERISTIC
/begin COMPU_METHOD Compu_LOD_min_ECT_tm " " RAT_FUNC "%.3" "sec" COEFFS 0 1000 0 0 0 1 /end COMPU_METHOD
/begin CHARACTERISTIC LOD_slk_Pinc "FaultConfig # LOD_slk_Pinc (Fault Condition:EPR feedback pressure rise >)" VALUE 0x00162bdc /* @ECU_Address@LOD_slk_Pinc@0x010104F8@ */ ECIPP_ALIGNMENT_SWORD 222 Compu_LOD_slk_Pinc -222 221.993225097656 /end CHARACTERISTIC
/begin COMPU_METHOD Compu_LOD_slk_Pinc " " RAT_FUNC "%.3" "in H2O" COEFFS 0 147.603603603604 0 0 0 1 /end COMPU_METHOD
/begin CHARACTERISTIC LOD_slk_tm "FaultConfig # LOD_slk_tm (Fault Condition:during test time limit of)" VALUE 0x00164f2c /* @ECU_Address@LOD_slk_tm@0x01010500@ */ ECIPP_ALIGNMENT_UWORD 66 Compu_LOD_slk_tm 0 65.535 /end CHARACTERISTIC
/begin COMPU_METHOD Compu_LOD_slk_tm " " RAT_FUNC "%.3" "sec" COEFFS 0 1000 0 0 0 1 /end COMPU_METHOD
/begin CHARACTERISTIC LOD_slk_eng_cyc "FaultConfig # LOD_slk_eng_cyc (Fault Condition:Number of engine warm cycles between runs)" VALUE 0x0016636b /* @ECU_Address@LOD_slk_eng_cyc@0x01010508@ */ ECIPP_ALIGNMENT_UBYTE 255 Compu_LOD_slk_eng_cyc 0 255 /end CHARACTERISTIC
/begin COMPU_METHOD Compu_LOD_slk_eng_cyc " " RAT_FUNC "%.0" "cycles" COEFFS 0 1 0 0 0 1 /end COMPU_METHOD
/begin CHARACTERISTIC LOD_slk_cyc_force "FaultConfig # LOD_slk_cyc_force (Fault Condition:Number of engine cycles before forced test run)" VALUE 0x0016636a /* @ECU_Address@LOD_slk_cyc_force@0x01010510@ */ ECIPP_ALIGNMENT_UBYTE 255 Compu_LOD_slk_cyc_force 0 255 /end CHARACTERISTIC
/begin COMPU_METHOD Compu_LOD_slk_cyc_force " " RAT_FUNC "%.0" "cycles" COEFFS 0 1 0 0 0 1 /end COMPU_METHOD
/begin CHARACTERISTIC LOD_flk_Pdec "FaultConfig # LOD_flk_Pdec (Fault Condition:EPR feedback pressure fall >)" VALUE 0x00162bda /* @ECU_Address@LOD_flk_Pdec@0x01010518@ */ ECIPP_ALIGNMENT_SWORD 222 Compu_LOD_flk_Pdec -222 221.993225097656 /end CHARACTERISTIC
/begin COMPU_METHOD Compu_LOD_flk_Pdec " " RAT_FUNC "%.3" "in H2O" COEFFS 0 147.603603603604 0 0 0 1 /end COMPU_METHOD
/begin CHARACTERISTIC LOD_flk_tm "FaultConfig # LOD_flk_tm (Fault Condition:during test time limit of)" VALUE 0x00164f28 /* @ECU_Address@LOD_flk_tm@0x01010520@ */ ECIPP_ALIGNMENT_UWORD 66 Compu_LOD_flk_tm 0 65.535 /end CHARACTERISTIC
/begin COMPU_METHOD Compu_LOD_flk_tm " " RAT_FUNC "%.3" "sec" COEFFS 0 1000 0 0 0 1 /end COMPU_METHOD
/begin CHARACTERISTIC LOD_flk_eng_cyc "FaultConfig # LOD_flk_eng_cyc (Fault Condition:Number of engine warm cycles between runs)" VALUE 0x00166368 /* @ECU_Address@LOD_flk_eng_cyc@0x01010528@ */ ECIPP_ALIGNMENT_UBYTE 255 Compu_LOD_flk_eng_cyc 0 255 /end CHARACTERISTIC
/begin COMPU_METHOD Compu_LOD_flk_eng_cyc " " RAT_FUNC "%.0" "cycles" COEFFS 0 1 0 0 0 1 /end COMPU_METHOD
/begin CHARACTERISTIC LOD_flk_spk_inh_cyc "FaultConfig # LOD_flk_spk_inh_cyc (Fault Condition:Num crank cycles to inhibit spark on next start)" VALUE 0x00166369 /* @ECU_Address@LOD_flk_spk_inh_cyc@0x01010530@ */ ECIPP_ALIGNMENT_UBYTE 255 Compu_LOD_flk_spk_inh_cyc 0 255 /end CHARACTERISTIC
/begin COMPU_METHOD Compu_LOD_flk_spk_inh_cyc " " RAT_FUNC "%.0" "cycles" COEFFS 0 1 0 0 0 1 /end COMPU_METHOD
/begin CHARACTERISTIC LOD_flk_spk_inh_ECT "FaultConfig # LOD_flk_spk_inh_ECT (Fault Condition:when ECT >)" VALUE 0x00164f26 /* @ECU_Address@LOD_flk_spk_inh_ECT@0x01010538@ */ ECIPP_ALIGNMENT_UWORD 564 Compu_LOD_flk_spk_inh_ECT -460 563.984375 /end CHARACTERISTIC
/begin COMPU_METHOD Compu_LOD_flk_spk_inh_ECT " " RAT_FUNC "%.3" "deg F" COEFFS 0 64 29440 0 0 1 /end COMPU_METHOD
/begin CHARACTERISTIC LOD_flk_cyc_force "FaultConfig # LOD_flk_cyc_force (Fault Condition:Number of engine cycles before forced test run)" VALUE 0x00166367 /* @ECU_Address@LOD_flk_cyc_force@0x01010540@ */ ECIPP_ALIGNMENT_UBYTE 255 Compu_LOD_flk_cyc_force 0 255 /end CHARACTERISTIC
/begin COMPU_METHOD Compu_LOD_flk_cyc_force " " RAT_FUNC "%.0" "cycles" COEFFS 0 1 0 0 0 1 /end COMPU_METHOD
/begin CHARACTERISTIC J1939_NG_Vdot_ratio "Fuel # J1939_NG_Vdot_ratio" VALUE 0x00164f22 /* @ECU_Address@J1939_NG_Vdot_ratio@0x010106E8@ */ ECIPP_ALIGNMENT_UWORD 65535 Compu_J1939_NG_Vdot_ratio 0 65535 /end CHARACTERISTIC
/begin COMPU_METHOD Compu_J1939_NG_Vdot_ratio " " RAT_FUNC "%.0" "-" COEFFS 0 1 0 0 0 1 /end COMPU_METHOD
/begin CHARACTERISTIC LOD_flk_WARN_force "{LOD_flk_WARN_force&0xff=0:Disabled}{LOD_flk_WARN_force&0xff=1:Soft Warning}{LOD_flk_WARN_force&0xff=2:Hard Warning} (Fault Condition:Historic fault forced indication)" VALUE 0x00147e17 /* @ECU_Address@LOD_flk_WARN_force@0x01010708@ */ ECIPP_ALIGNMENT_UBYTE 255 LOD_flk_WARN_force_COMPU_VTAB 0 255 BIT_MASK 0xff /end CHARACTERISTIC
/begin COMPU_METHOD LOD_flk_WARN_force_COMPU_VTAB "Verbal Table" TAB_VERB "%.0" "list" COMPU_TAB_REF LOD_flk_WARN_force_COMPU_VTAB_REF /end COMPU_METHOD
/begin COMPU_VTAB LOD_flk_WARN_force_COMPU_VTAB_REF "Verbal Table" TAB_VERB 3 0 "Disabled" 1 "Soft Warning" 2 "Hard Warning" DEFAULT_VALUE "UNKNOWN" /end COMPU_VTAB
/begin CHARACTERISTIC OILTL_temp_hi "FaultConfig # OILTL_temp_hi (Fault Condition:Oil temperature >)" VALUE 0x00147670 /* @ECU_Address@OILTL_temp_hi@0x01010960@ */ ECIPP_ALIGNMENT_UWORD 7732 Compu_OILTL_temp_hi -460 7731.875 /end CHARACTERISTIC
/begin COMPU_METHOD Compu_OILTL_temp_hi " " RAT_FUNC "%.3" "deg F" COEFFS 0 8 3680 0 0 1 /end COMPU_METHOD
/begin CHARACTERISTIC EGR_vlv_type "{EGR_vlv_type&0xff=0:Bidirectional}{EGR_vlv_type&0xff=1:Spring return}" VALUE 0x00147d2a /* @ECU_Address@EGR_vlv_type@0x01010968@ */ ECIPP_ALIGNMENT_UBYTE 255 EGR_vlv_type_COMPU_VTAB 0 255 BIT_MASK 0xff /end CHARACTERISTIC
/begin COMPU_METHOD EGR_vlv_type_COMPU_VTAB "Verbal Table" TAB_VERB "%.0" "list" COMPU_TAB_REF EGR_vlv_type_COMPU_VTAB_REF /end COMPU_METHOD
/begin COMPU_VTAB EGR_vlv_type_COMPU_VTAB_REF "Verbal Table" TAB_VERB 2 0 "Bidirectional" 1 "Spring return" DEFAULT_VALUE "UNKNOWN" /end COMPU_VTAB
/begin CHARACTERISTIC EGR_vlv_DC_hi "FaultConfig # EGR_vlv_DC_hi (Fault Condition:EGR valve PWM duty cycle >)" VALUE 0x001442be /* @ECU_Address@EGR_vlv_DC_hi@0x01010970@ */ ECIPP_ALIGNMENT_SWORD 100 Compu_EGR_vlv_DC_hi -100 99.9969482421875 /end CHARACTERISTIC
/begin COMPU_METHOD Compu_EGR_vlv_DC_hi " " RAT_FUNC "%.3" "%" COEFFS 0 327.68 0 0 0 1 /end COMPU_METHOD
/begin CHARACTERISTIC EGR_vlv_0pct_dly "General # EGR_vlv_0pct_dly" VALUE 0x00146808 /* @ECU_Address@EGR_vlv_0pct_dly@0x01010978@ */ ECIPP_ALIGNMENT_UWORD 65535 Compu_EGR_vlv_0pct_dly 0 65535 /end CHARACTERISTIC
/begin COMPU_METHOD Compu_EGR_vlv_0pct_dly " " RAT_FUNC "%.0" "ms" COEFFS 0 1 0 0 0 1 /end COMPU_METHOD
/begin CHARACTERISTIC EGR_vlv_temp_max "FaultConfig # EGR_vlv_temp_max (Fault Condition:Estimated EGR valve temperature >)" VALUE 0x00143984 /* @ECU_Address@EGR_vlv_temp_max@0x01010980@ */ ECIPP_ALIGNMENT_FLOAT32_IEEE 10000000000 Compu_EGR_vlv_temp_max -10000000000 10000000000 /end CHARACTERISTIC
/begin COMPU_METHOD Compu_EGR_vlv_temp_max " " RAT_FUNC "%.3" "deg C" COEFFS 0 1 0 0 0 1 /end COMPU_METHOD
/begin CHARACTERISTIC J1939_VI_fmt "{J1939_VI_fmt&0xff=0:Engine PN*SN*VIN}{J1939_VI_fmt&0xff=1:VIN*Engine PN*SN}" VALUE 0x00166366 /* @ECU_Address@J1939_VI_fmt@0x01010AB0@ */ ECIPP_ALIGNMENT_UBYTE 255 J1939_VI_fmt_COMPU_VTAB 0 255 BIT_MASK 0xff /end CHARACTERISTIC
/begin COMPU_METHOD J1939_VI_fmt_COMPU_VTAB "Verbal Table" TAB_VERB "%.0" "list" COMPU_TAB_REF J1939_VI_fmt_COMPU_VTAB_REF /end COMPU_METHOD
/begin COMPU_VTAB J1939_VI_fmt_COMPU_VTAB_REF "Verbal Table" TAB_VERB 2 0 "Engine PN*SN*VIN" 1 "VIN*Engine PN*SN" DEFAULT_VALUE "UNKNOWN" /end COMPU_VTAB
/begin CHARACTERISTIC CAC_eta_lo_Tsrc "{CAC_eta_lo_Tsrc&0xff=0:COT}{CAC_eta_lo_Tsrc&0xff=1:IAT} (Fault Condition:and temperature source)" VALUE 0x001650fd /* @ECU_Address@CAC_eta_lo_Tsrc@0x01010B30@ */ ECIPP_ALIGNMENT_UBYTE 255 CAC_eta_lo_Tsrc_COMPU_VTAB 0 255 BIT_MASK 0xff /end CHARACTERISTIC
/begin COMPU_METHOD CAC_eta_lo_Tsrc_COMPU_VTAB "Verbal Table" TAB_VERB "%.0" "list" COMPU_TAB_REF CAC_eta_lo_Tsrc_COMPU_VTAB_REF /end COMPU_METHOD
/begin COMPU_VTAB CAC_eta_lo_Tsrc_COMPU_VTAB_REF "Verbal Table" TAB_VERB 2 0 "COT" 1 "IAT" DEFAULT_VALUE "UNKNOWN" /end COMPU_VTAB
/begin CHARACTERISTIC CAC_eta_lo_TIP "FaultConfig # CAC_eta_lo_TIP (Fault Condition:and TIP >)" VALUE 0x0016348a /* @ECU_Address@CAC_eta_lo_TIP@0x01010B38@ */ ECIPP_ALIGNMENT_UWORD 256 Compu_CAC_eta_lo_TIP 0 255.99609375 /end CHARACTERISTIC
/begin COMPU_METHOD Compu_CAC_eta_lo_TIP " " RAT_FUNC "%.3" "psia" COEFFS 0 256 0 0 0 1 /end COMPU_METHOD
/begin CHARACTERISTIC PPEG_CVP1_fault "IOConfig # PPEG_CVP1_fault (Fault Condition:abs(CVP1 offset) sample >)" VALUE 0x001476a2 /* @ECU_Address@PPEG_CVP1_fault@0x01010C30@ */ ECIPP_ALIGNMENT_UWORD 256 Compu_PPEG_CVP1_fault 0 255.99609375 /end CHARACTERISTIC
/begin COMPU_METHOD Compu_PPEG_CVP1_fault " " RAT_FUNC "%.3" "psi" COEFFS 0 256 0 0 0 1 /end COMPU_METHOD
/begin CHARACTERISTIC PPEG_CVP2_fault "IOConfig # PPEG_CVP2_fault (Fault Condition:abs(CVP2 offset) sample >)" VALUE 0x001476a4 /* @ECU_Address@PPEG_CVP2_fault@0x01010C38@ */ ECIPP_ALIGNMENT_UWORD 256 Compu_PPEG_CVP2_fault 0 255.99609375 /end CHARACTERISTIC
/begin COMPU_METHOD Compu_PPEG_CVP2_fault " " RAT_FUNC "%.3" "psi" COEFFS 0 256 0 0 0 1 /end COMPU_METHOD
/begin CHARACTERISTIC CVCSP_Paux_cal "{CVCSP_Paux_cal&0xff=0:Aux Press A}{CVCSP_Paux_cal&0xff=1:Aux Press B}{CVCSP_Paux_cal&0xff=2:Aux Press C}{CVCSP_Paux_cal&0xff=3:Aux Press D}" VALUE 0x00148CE5 /* @ECU_Address@CVCSP_Paux_cal@0x01010C48@ */ ECIPP_ALIGNMENT_UBYTE 255 CVCSP_Paux_cal_COMPU_VTAB 0 255 BIT_MASK 0xff /end CHARACTERISTIC
/begin COMPU_METHOD CVCSP_Paux_cal_COMPU_VTAB "Verbal Table" TAB_VERB "%.0" "list" COMPU_TAB_REF CVCSP_Paux_cal_COMPU_VTAB_REF /end COMPU_METHOD
/begin COMPU_VTAB CVCSP_Paux_cal_COMPU_VTAB_REF "Verbal Table" TAB_VERB 4 0 "Aux Press A" 1 "Aux Press B" 2 "Aux Press C" 3 "Aux Press D" DEFAULT_VALUE "UNKNOWN" /end COMPU_VTAB
/begin CHARACTERISTIC CVDSP_Paux_cal "{CVDSP_Paux_cal&0xff=0:Aux Press A}{CVDSP_Paux_cal&0xff=1:Aux Press B}{CVDSP_Paux_cal&0xff=2:Aux Press C}{CVDSP_Paux_cal&0xff=3:Aux Press D}" VALUE 0x00148CEB /* @ECU_Address@CVDSP_Paux_cal@0x01010C68@ */ ECIPP_ALIGNMENT_UBYTE 255 CVDSP_Paux_cal_COMPU_VTAB 0 255 BIT_MASK 0xff /end CHARACTERISTIC
/begin COMPU_METHOD CVDSP_Paux_cal_COMPU_VTAB "Verbal Table" TAB_VERB "%.0" "list" COMPU_TAB_REF CVDSP_Paux_cal_COMPU_VTAB_REF /end COMPU_METHOD
/begin COMPU_VTAB CVDSP_Paux_cal_COMPU_VTAB_REF "Verbal Table" TAB_VERB 4 0 "Aux Press A" 1 "Aux Press B" 2 "Aux Press C" 3 "Aux Press D" DEFAULT_VALUE "UNKNOWN" /end COMPU_VTAB
/begin CHARACTERISTIC CVPAUX1_Paux_cal "{CVPAUX1_Paux_cal&0xff=0:Aux Press A}{CVPAUX1_Paux_cal&0xff=1:Aux Press B}{CVPAUX1_Paux_cal&0xff=2:Aux Press C}{CVPAUX1_Paux_cal&0xff=3:Aux Press D}" VALUE 0x00148CF1 /* @ECU_Address@CVPAUX1_Paux_cal@0x01010C88@ */ ECIPP_ALIGNMENT_UBYTE 255 CVPAUX1_Paux_cal_COMPU_VTAB 0 255 BIT_MASK 0xff /end CHARACTERISTIC
/begin COMPU_METHOD CVPAUX1_Paux_cal_COMPU_VTAB "Verbal Table" TAB_VERB "%.0" "list" COMPU_TAB_REF CVPAUX1_Paux_cal_COMPU_VTAB_REF /end COMPU_METHOD
/begin COMPU_VTAB CVPAUX1_Paux_cal_COMPU_VTAB_REF "Verbal Table" TAB_VERB 4 0 "Aux Press A" 1 "Aux Press B" 2 "Aux Press C" 3 "Aux Press D" DEFAULT_VALUE "UNKNOWN" /end COMPU_VTAB
/begin CHARACTERISTIC CVPAUX2_Paux_cal "{CVPAUX2_Paux_cal&0xff=0:Aux Press A}{CVPAUX2_Paux_cal&0xff=1:Aux Press B}{CVPAUX2_Paux_cal&0xff=2:Aux Press C}{CVPAUX2_Paux_cal&0xff=3:Aux Press D}" VALUE 0x00148CF7 /* @ECU_Address@CVPAUX2_Paux_cal@0x01010CA8@ */ ECIPP_ALIGNMENT_UBYTE 255 CVPAUX2_Paux_cal_COMPU_VTAB 0 255 BIT_MASK 0xff /end CHARACTERISTIC
/begin COMPU_METHOD CVPAUX2_Paux_cal_COMPU_VTAB "Verbal Table" TAB_VERB "%.0" "list" COMPU_TAB_REF CVPAUX2_Paux_cal_COMPU_VTAB_REF /end COMPU_METHOD
/begin COMPU_VTAB CVPAUX2_Paux_cal_COMPU_VTAB_REF "Verbal Table" TAB_VERB 4 0 "Aux Press A" 1 "Aux Press B" 2 "Aux Press C" 3 "Aux Press D" DEFAULT_VALUE "UNKNOWN" /end COMPU_VTAB
/begin CHARACTERISTIC CVP_abs_def "General # CVP_abs_def" VALUE 0x00144278 /* @ECU_Address@CVP_abs_def@0x01010D10@ */ ECIPP_ALIGNMENT_SWORD 32 Compu_CVP_abs_def -32 31.9990234375 /end CHARACTERISTIC
/begin COMPU_METHOD Compu_CVP_abs_def " " RAT_FUNC "%.3" "psia" COEFFS 0 1024 0 0 0 1 /end COMPU_METHOD
/begin CHARACTERISTIC CVP_dP_def "General # CVP_dP_def" VALUE 0x0014427a /* @ECU_Address@CVP_dP_def@0x01010D18@ */ ECIPP_ALIGNMENT_SWORD 32 Compu_CVP_dP_def -32 31.9990234375 /end CHARACTERISTIC
/begin COMPU_METHOD Compu_CVP_dP_def " " RAT_FUNC "%.3" "psia" COEFFS 0 1024 0 0 0 1 /end COMPU_METHOD
/begin CHARACTERISTIC CVCS_discon_mdota_min "FaultConfig # CVCS_discon_mdota_min (Fault Condition:Air mass  flow >)" VALUE 0x001634a0 /* @ECU_Address@CVCS_discon_mdota_min@0x01010D20@ */ ECIPP_ALIGNMENT_UWORD 1024 Compu_CVCS_discon_mdota_min 0 1023.984375 /end CHARACTERISTIC
/begin COMPU_METHOD Compu_CVCS_discon_mdota_min " " RAT_FUNC "%.3" "g/sec" COEFFS 0 64 0 0 0 1 /end COMPU_METHOD
/begin CHARACTERISTIC CVCS_discon_pct "FaultConfig # CVCS_discon_pct (Fault Condition:a threshold of)" VALUE 0x001634a2 /* @ECU_Address@CVCS_discon_pct@0x01010D28@ */ ECIPP_ALIGNMENT_UWORD 100 Compu_CVCS_discon_pct 0 99.9984741210938 /end CHARACTERISTIC
/begin COMPU_METHOD Compu_CVCS_discon_pct " " RAT_FUNC "%.3" "%" COEFFS 0 655.36 0 0 0 1 /end COMPU_METHOD
/begin CHARACTERISTIC CVCS_discon_tbl "{CVCS_discon_tbl&0xff=0:Pressure 1 lookup}{CVCS_discon_tbl&0xff=1:Pressure 2 lookup} (Fault Condition:of)" VALUE 0x00165106 /* @ECU_Address@CVCS_discon_tbl@0x01010D30@ */ ECIPP_ALIGNMENT_UBYTE 255 CVCS_discon_tbl_COMPU_VTAB 0 255 BIT_MASK 0xff /end CHARACTERISTIC
/begin COMPU_METHOD CVCS_discon_tbl_COMPU_VTAB "Verbal Table" TAB_VERB "%.0" "list" COMPU_TAB_REF CVCS_discon_tbl_COMPU_VTAB_REF /end COMPU_METHOD
/begin COMPU_VTAB CVCS_discon_tbl_COMPU_VTAB_REF "Verbal Table" TAB_VERB 2 0 "Pressure 1 lookup" 1 "Pressure 2 lookup" DEFAULT_VALUE "UNKNOWN" /end COMPU_VTAB
/begin CHARACTERISTIC CVDS_discon_mdota_min "FaultConfig # CVDS_discon_mdota_min (Fault Condition:Air mass  flow >)" VALUE 0x001634a8 /* @ECU_Address@CVDS_discon_mdota_min@0x01010D38@ */ ECIPP_ALIGNMENT_UWORD 1024 Compu_CVDS_discon_mdota_min 0 1023.984375 /end CHARACTERISTIC
/begin COMPU_METHOD Compu_CVDS_discon_mdota_min " " RAT_FUNC "%.3" "g/sec" COEFFS 0 64 0 0 0 1 /end COMPU_METHOD
/begin CHARACTERISTIC CVDS_discon_pct "FaultConfig # CVDS_discon_pct (Fault Condition:a threshold of)" VALUE 0x001634aa /* @ECU_Address@CVDS_discon_pct@0x01010D40@ */ ECIPP_ALIGNMENT_UWORD 100 Compu_CVDS_discon_pct 0 99.9984741210938 /end CHARACTERISTIC
/begin COMPU_METHOD Compu_CVDS_discon_pct " " RAT_FUNC "%.3" "%" COEFFS 0 655.36 0 0 0 1 /end COMPU_METHOD
/begin CHARACTERISTIC CVDS_discon_tbl "{CVDS_discon_tbl&0xff=0:Pressure 1 lookup}{CVDS_discon_tbl&0xff=1:Pressure 2 lookup} (Fault Condition:of)" VALUE 0x00165108 /* @ECU_Address@CVDS_discon_tbl@0x01010D48@ */ ECIPP_ALIGNMENT_UBYTE 255 CVDS_discon_tbl_COMPU_VTAB 0 255 BIT_MASK 0xff /end CHARACTERISTIC
/begin COMPU_METHOD CVDS_discon_tbl_COMPU_VTAB "Verbal Table" TAB_VERB "%.0" "list" COMPU_TAB_REF CVDS_discon_tbl_COMPU_VTAB_REF /end COMPU_METHOD
/begin COMPU_VTAB CVDS_discon_tbl_COMPU_VTAB_REF "Verbal Table" TAB_VERB 2 0 "Pressure 1 lookup" 1 "Pressure 2 lookup" DEFAULT_VALUE "UNKNOWN" /end COMPU_VTAB
/begin CHARACTERISTIC ECT_sel "{ECT_sel&0xff=0:Standard input}{ECT_sel&0xff=1:Oil temperature input}" VALUE 0x00147d1e /* @ECU_Address@ECT_sel@0x01010D60@ */ ECIPP_ALIGNMENT_UBYTE 255 ECT_sel_COMPU_VTAB 0 255 BIT_MASK 0xff /end CHARACTERISTIC
/begin COMPU_METHOD ECT_sel_COMPU_VTAB "Verbal Table" TAB_VERB "%.0" "list" COMPU_TAB_REF ECT_sel_COMPU_VTAB_REF /end COMPU_METHOD
/begin COMPU_VTAB ECT_sel_COMPU_VTAB_REF "Verbal Table" TAB_VERB 2 0 "Standard input" 1 "Oil temperature input" DEFAULT_VALUE "UNKNOWN" /end COMPU_VTAB
/begin CHARACTERISTIC CVCS_discon_mdota_max "FaultConfig # CVCS_discon_mdota_max (Fault Condition:and air mass flow <)" VALUE 0x0016349e /* @ECU_Address@CVCS_discon_mdota_max@0x01010D98@ */ ECIPP_ALIGNMENT_UWORD 1024 Compu_CVCS_discon_mdota_max 0 1023.984375 /end CHARACTERISTIC
/begin COMPU_METHOD Compu_CVCS_discon_mdota_max " " RAT_FUNC "%.3" "g/sec" COEFFS 0 64 0 0 0 1 /end COMPU_METHOD
/begin CHARACTERISTIC CVDS_discon_mdota_max "FaultConfig # CVDS_discon_mdota_max (Fault Condition:and air mass flow <)" VALUE 0x001634a6 /* @ECU_Address@CVDS_discon_mdota_max@0x01010DA0@ */ ECIPP_ALIGNMENT_UWORD 1024 Compu_CVDS_discon_mdota_max 0 1023.984375 /end CHARACTERISTIC
/begin COMPU_METHOD Compu_CVDS_discon_mdota_max " " RAT_FUNC "%.3" "g/sec" COEFFS 0 64 0 0 0 1 /end COMPU_METHOD
/begin CHARACTERISTIC CVCS_discon_test "FaultConfig # CVCS_discon_test (Fault Condition:and pressure is)" VALUE 0x00165107 /* @ECU_Address@CVCS_discon_test@0x01010DA8@ */ ECIPP_ALIGNMENT_UBYTE 255 Compu_CVCS_discon_test 1 256 /end CHARACTERISTIC
/begin COMPU_METHOD Compu_CVCS_discon_test " " RAT_FUNC "%.0" "-" COEFFS 0 1 -1 0 0 1 /end COMPU_METHOD
/begin CHARACTERISTIC CVDS_discon_test "FaultConfig # CVDS_discon_test (Fault Condition:and pressure is)" VALUE 0x00165109 /* @ECU_Address@CVDS_discon_test@0x01010DB0@ */ ECIPP_ALIGNMENT_UBYTE 255 Compu_CVDS_discon_test 1 256 /end CHARACTERISTIC
/begin COMPU_METHOD Compu_CVDS_discon_test " " RAT_FUNC "%.0" "-" COEFFS 0 1 -1 0 0 1 /end COMPU_METHOD
/begin CHARACTERISTIC EGRdP_HiExp_p "Air # EGRdP_HiExp_p (Fault Condition:EGRdP (single point) >)" VALUE 0x00162bca /* @ECU_Address@EGRdP_HiExp_p@0x01010DC0@ */ ECIPP_ALIGNMENT_SWORD 32 Compu_EGRdP_HiExp_p -32 31.9990234375 /end CHARACTERISTIC
/begin COMPU_METHOD Compu_EGRdP_HiExp_p " " RAT_FUNC "%.3" "psi" COEFFS 0 1024 0 0 0 1 /end COMPU_METHOD
/begin CHARACTERISTIC EGRdP_LoExp_p "Air # EGRdP_LoExp_p (Fault Condition:EGRdP <)" VALUE 0x00162bcc /* @ECU_Address@EGRdP_LoExp_p@0x01010DC8@ */ ECIPP_ALIGNMENT_SWORD 32 Compu_EGRdP_LoExp_p -32 31.9990234375 /end CHARACTERISTIC
/begin COMPU_METHOD Compu_EGRdP_LoExp_p " " RAT_FUNC "%.3" "psi" COEFFS 0 1024 0 0 0 1 /end COMPU_METHOD
/begin CHARACTERISTIC EGRdP_HiExp_mdot "Air # EGRdP_HiExp_mdot (Fault Condition:and EGR modeled flow <)" VALUE 0x00160008 /* @ECU_Address@EGRdP_HiExp_mdot@0x01010DD0@ */ ECIPP_ALIGNMENT_FLOAT32_IEEE 10000000000 Compu_EGRdP_HiExp_mdot -10000000000 10000000000 /end CHARACTERISTIC
/begin COMPU_METHOD Compu_EGRdP_HiExp_mdot " " RAT_FUNC "%.3" "g/sec" COEFFS 0 1 0 0 0 1 /end COMPU_METHOD
/begin CHARACTERISTIC EGRdP_LoExp_mdot "Air # EGRdP_LoExp_mdot (Fault Condition:and EGR modeled flow >)" VALUE 0x0016000c /* @ECU_Address@EGRdP_LoExp_mdot@0x01010DD8@ */ ECIPP_ALIGNMENT_FLOAT32_IEEE 10000000000 Compu_EGRdP_LoExp_mdot -10000000000 10000000000 /end CHARACTERISTIC
/begin COMPU_METHOD Compu_EGRdP_LoExp_mdot " " RAT_FUNC "%.3" "g/sec" COEFFS 0 1 0 0 0 1 /end COMPU_METHOD
/begin CHARACTERISTIC EGRHP_OOR_minMAP "Air # EGRHP_OOR_minMAP (Fault Condition:and MAP load >)" VALUE 0x001634e8 /* @ECU_Address@EGRHP_OOR_minMAP@0x01010DE0@ */ ECIPP_ALIGNMENT_UWORD 256 Compu_EGRHP_OOR_minMAP 0 255.99609375 /end CHARACTERISTIC
/begin COMPU_METHOD Compu_EGRHP_OOR_minMAP " " RAT_FUNC "%.3" "psia" COEFFS 0 256 0 0 0 1 /end COMPU_METHOD
/begin CHARACTERISTIC EGRHP_OOR_maxMAP "Air # EGRHP_OOR_maxMAP (Fault Condition:and MAP load <)" VALUE 0x001634e4 /* @ECU_Address@EGRHP_OOR_maxMAP@0x01010DE8@ */ ECIPP_ALIGNMENT_UWORD 256 Compu_EGRHP_OOR_maxMAP 0 255.99609375 /end CHARACTERISTIC
/begin COMPU_METHOD Compu_EGRHP_OOR_maxMAP " " RAT_FUNC "%.3" "psia" COEFFS 0 256 0 0 0 1 /end COMPU_METHOD
/begin CHARACTERISTIC EGRHP_OOR_minRPM "Air # EGRHP_OOR_minRPM (Fault Condition:and RPM >)" VALUE 0x001634ea /* @ECU_Address@EGRHP_OOR_minRPM@0x01010DF0@ */ ECIPP_ALIGNMENT_UWORD 65535 Compu_EGRHP_OOR_minRPM 0 65535 /end CHARACTERISTIC
/begin COMPU_METHOD Compu_EGRHP_OOR_minRPM " " RAT_FUNC "%.0" "rpm" COEFFS 0 1 0 0 0 1 /end COMPU_METHOD
/begin CHARACTERISTIC EGRHP_OOR_maxRPM "Air # EGRHP_OOR_maxRPM (Fault Condition:and RPM <)" VALUE 0x001634e6 /* @ECU_Address@EGRHP_OOR_maxRPM@0x01010DF8@ */ ECIPP_ALIGNMENT_UWORD 65535 Compu_EGRHP_OOR_maxRPM 0 65535 /end CHARACTERISTIC
/begin COMPU_METHOD Compu_EGRHP_OOR_maxRPM " " RAT_FUNC "%.0" "rpm" COEFFS 0 1 0 0 0 1 /end COMPU_METHOD
/begin CHARACTERISTIC EGRHP_OOR_vlv_min "Air # EGRHP_OOR_vlv_min (Fault Condition:and EGR valve position >)" VALUE 0x001634ec /* @ECU_Address@EGRHP_OOR_vlv_min@0x01010E00@ */ ECIPP_ALIGNMENT_UWORD 100 Compu_EGRHP_OOR_vlv_min 0 99.9984741210938 /end CHARACTERISTIC
/begin COMPU_METHOD Compu_EGRHP_OOR_vlv_min " " RAT_FUNC "%.3" "%" COEFFS 0 655.36 0 0 0 1 /end COMPU_METHOD
/begin CHARACTERISTIC EGRHP_OOR_lim_neg "Air # EGRHP_OOR_lim_neg (Fault Condition:EGRHP < (TIP - EGR Cooler Drop) -)" VALUE 0x00160000 /* @ECU_Address@EGRHP_OOR_lim_neg@0x01010E08@ */ ECIPP_ALIGNMENT_FLOAT32_IEEE 10000000000 Compu_EGRHP_OOR_lim_neg -10000000000 10000000000 /end CHARACTERISTIC
/begin COMPU_METHOD Compu_EGRHP_OOR_lim_neg " " RAT_FUNC "%.3" "psi" COEFFS 0 1 0 0 0 1 /end COMPU_METHOD
/begin CHARACTERISTIC EGRHP_OOR_lim_pos "Air # EGRHP_OOR_lim_pos (Fault Condition:or EGRHP > (TIP - EGR Cooler Drop) +)" VALUE 0x00160004 /* @ECU_Address@EGRHP_OOR_lim_pos@0x01010E10@ */ ECIPP_ALIGNMENT_FLOAT32_IEEE 10000000000 Compu_EGRHP_OOR_lim_pos -10000000000 10000000000 /end CHARACTERISTIC
/begin COMPU_METHOD Compu_EGRHP_OOR_lim_pos " " RAT_FUNC "%.3" "psi" COEFFS 0 1 0 0 0 1 /end COMPU_METHOD
/begin CHARACTERISTIC PPEG_EGRdP_fault "IOConfig # PPEG_EGRdP_fault (Fault Condition:abs(EGRdP offset) sample >)" VALUE 0x00162be0 /* @ECU_Address@PPEG_EGRdP_fault@0x01010E18@ */ ECIPP_ALIGNMENT_SWORD 32 Compu_PPEG_EGRdP_fault -32 31.9990234375 /end CHARACTERISTIC
/begin COMPU_METHOD Compu_PPEG_EGRdP_fault " " RAT_FUNC "%.3" "psi" COEFFS 0 1024 0 0 0 1 /end COMPU_METHOD
/begin CHARACTERISTIC EGRHP_maxv "Air # EGRHP_maxv (Fault Condition:EGRHP voltage >)" VALUE 0x001634ee /* @ECU_Address@EGRHP_maxv@0x01010E20@ */ ECIPP_ALIGNMENT_UWORD 5 Compu_EGRHP_maxv 0 5.00114468864469 /end CHARACTERISTIC
/begin COMPU_METHOD Compu_EGRHP_maxv " " RAT_FUNC "%.3" "volts" COEFFS 0 13104 0 0 0 1 /end COMPU_METHOD
/begin CHARACTERISTIC EGRHP_minv "Air # EGRHP_minv (Fault Condition:EGRHP voltage <)" VALUE 0x001634f0 /* @ECU_Address@EGRHP_minv@0x01010E28@ */ ECIPP_ALIGNMENT_UWORD 5 Compu_EGRHP_minv 0 5.00114468864469 /end CHARACTERISTIC
/begin COMPU_METHOD Compu_EGRHP_minv " " RAT_FUNC "%.3" "volts" COEFFS 0 13104 0 0 0 1 /end COMPU_METHOD
/begin CHARACTERISTIC EGRdP_maxv "Air # EGRdP_maxv (Fault Condition:EGRdP voltage >)" VALUE 0x001634fe /* @ECU_Address@EGRdP_maxv@0x01010E30@ */ ECIPP_ALIGNMENT_UWORD 5 Compu_EGRdP_maxv 0 5.00114468864469 /end CHARACTERISTIC
/begin COMPU_METHOD Compu_EGRdP_maxv " " RAT_FUNC "%.3" "volts" COEFFS 0 13104 0 0 0 1 /end COMPU_METHOD
/begin CHARACTERISTIC EGRdP_minv "Air # EGRdP_minv (Fault Condition:EGRdP voltage <)" VALUE 0x00163500 /* @ECU_Address@EGRdP_minv@0x01010E38@ */ ECIPP_ALIGNMENT_UWORD 5 Compu_EGRdP_minv 0 5.00114468864469 /end CHARACTERISTIC
/begin COMPU_METHOD Compu_EGRdP_minv " " RAT_FUNC "%.3" "volts" COEFFS 0 13104 0 0 0 1 /end COMPU_METHOD
/begin CHARACTERISTIC fm_induce_l1_ll "{fm_induce_l1_ll&0xff=0:Disabled}{fm_induce_l1_ll&0xff=1:Table 1 / Gasoline Load-Limit}{fm_induce_l1_ll&0xff=2:Table 2 / LPG Load-Limit}{fm_induce_l1_ll&0xff=3:Table 3 / NG Load-Limit}{fm_induce_l1_ll&0xff=4:Table 4 / Power Load-Limit}{fm_induce_l1_ll&0xf" VALUE 0x0016c323 /* @ECU_Address@fm_induce_l1_ll@0x01010E58@ */ ECIPP_ALIGNMENT_UBYTE 255 fm_induce_l1_ll_COMPU_VTAB 0 255 BIT_MASK 0xff /end CHARACTERISTIC
/begin COMPU_METHOD fm_induce_l1_ll_COMPU_VTAB "Verbal Table" TAB_VERB "%.0" "list" COMPU_TAB_REF fm_induce_l1_ll_COMPU_VTAB_REF /end COMPU_METHOD
/begin COMPU_VTAB fm_induce_l1_ll_COMPU_VTAB_REF "Verbal Table" TAB_VERB 9 0 "Disabled" 1 "Table 1 / Gasoline Load-Limit" 2 "Table 2 / LPG Load-Limit" 3 "Table 3 / NG Load-Limit" 4 "Table 4 / Power Load-Limit" 5 "Table 5" 6 "Table 6" 7 "Table 7" 8 "Table 8" DEFAULT_VALUE "UNKNOWN" /end COMPU_VTAB
/begin CHARACTERISTIC fm_induce_l3_km "FaultConfig # fm_induce_l3_km" VALUE 0x001650ea /* @ECU_Address@fm_induce_l3_km@0x01010E60@ */ ECIPP_ALIGNMENT_UWORD 256 Compu_fm_induce_l3_km 0 255.99609375 /end CHARACTERISTIC
/begin COMPU_METHOD Compu_fm_induce_l3_km " " RAT_FUNC "%.3" "km/hr" COEFFS 0 256 0 0 0 1 /end COMPU_METHOD
/begin MEASUREMENT VDS_ena "Calibration Switch{VDS_ena&0xff=0:Request Standard}{VDS_ena&0xff=1:Request Variant}" UBYTE VDS_ena_COMPU_VTAB 0 0 0 255 ECU_ADDRESS 0x01010EB0 BIT_MASK 0xff /end MEASUREMENT
/begin COMPU_METHOD VDS_ena_COMPU_VTAB "Verbal Table" TAB_VERB "%.0" "list" COMPU_TAB_REF VDS_ena_COMPU_VTAB_REF /end COMPU_METHOD
/begin COMPU_VTAB VDS_ena_COMPU_VTAB_REF "Verbal Table" TAB_VERB 2 0 "Request Standard" 1 "Request Variant" DEFAULT_VALUE "UNKNOWN" /end COMPU_VTAB
/begin CHARACTERISTIC CATmon_disable "{CATmon_disable&0xff=0:None}{CATmon_disable&0xff=1:Sensor low voltage faulted}{CATmon_disable&0xff=2:Sensor high voltage faulted}" VALUE 0x001650fe /* @ECU_Address@CATmon_disable@0x01010ED0@ */ ECIPP_ALIGNMENT_UBYTE 255 CATmon_disable_COMPU_VTAB 0 255 BIT_MASK 0xff /end CHARACTERISTIC
/begin COMPU_METHOD CATmon_disable_COMPU_VTAB "Verbal Table" TAB_VERB "%.0" "list" COMPU_TAB_REF CATmon_disable_COMPU_VTAB_REF /end COMPU_METHOD
/begin COMPU_VTAB CATmon_disable_COMPU_VTAB_REF "Verbal Table" TAB_VERB 3 0 "None" 1 "Sensor low voltage faulted" 2 "Sensor high voltage faulted" DEFAULT_VALUE "UNKNOWN" /end COMPU_VTAB
/begin CHARACTERISTIC OILTL_level_lo "FaultConfig # OILTL_level_lo (Fault Condition:Oil level <)" VALUE 0x0014766e /* @ECU_Address@OILTL_level_lo@0x01010EE8@ */ ECIPP_ALIGNMENT_UWORD 250 Compu_OILTL_level_lo 0 249.996185302734 /end CHARACTERISTIC
/begin COMPU_METHOD Compu_OILTL_level_lo " " RAT_FUNC "%.3" "level %" COEFFS 0 262.144 0 0 0 1 /end COMPU_METHOD
/begin CHARACTERISTIC AFILTdP_Paux_cal "{AFILTdP_Paux_cal&0xff=0:Aux Press A}{AFILTdP_Paux_cal&0xff=1:Aux Press B}{AFILTdP_Paux_cal&0xff=2:Aux Press C}{AFILTdP_Paux_cal&0xff=3:Aux Press D}" VALUE 0x00147ccd /* @ECU_Address@AFILTdP_Paux_cal@0x01011448@ */ ECIPP_ALIGNMENT_UBYTE 255 AFILTdP_Paux_cal_COMPU_VTAB 0 255 BIT_MASK 0xff /end CHARACTERISTIC
/begin COMPU_METHOD AFILTdP_Paux_cal_COMPU_VTAB "Verbal Table" TAB_VERB "%.0" "list" COMPU_TAB_REF AFILTdP_Paux_cal_COMPU_VTAB_REF /end COMPU_METHOD
/begin COMPU_VTAB AFILTdP_Paux_cal_COMPU_VTAB_REF "Verbal Table" TAB_VERB 4 0 "Aux Press A" 1 "Aux Press B" 2 "Aux Press C" 3 "Aux Press D" DEFAULT_VALUE "UNKNOWN" /end COMPU_VTAB
/begin CHARACTERISTIC MFG_comm_tout "FaultConfig # MFG_comm_tout (Fault Condition:No packets received within)" VALUE 0x001490D4 /* @ECU_Address@MFG_comm_tout@0x01011648@ */ ECIPP_ALIGNMENT_UWORD 65535 Compu_MFG_comm_tout 0 65535 /end CHARACTERISTIC
/begin COMPU_METHOD Compu_MFG_comm_tout " " RAT_FUNC "%.0" "ms" COEFFS 0 1 0 0 0 1 /end COMPU_METHOD
/begin CHARACTERISTIC MFA_comm_tout "FaultConfig # MFA_comm_tout (Fault Condition:No packets received within)" VALUE 0x001490C0 /* @ECU_Address@MFA_comm_tout@0x01011738@ */ ECIPP_ALIGNMENT_UWORD 65535 Compu_MFA_comm_tout 0 65535 /end CHARACTERISTIC
/begin COMPU_METHOD Compu_MFA_comm_tout " " RAT_FUNC "%.0" "ms" COEFFS 0 1 0 0 0 1 /end COMPU_METHOD
/begin CHARACTERISTIC MFG_hsd_comm_tout "FaultConfig # MFG_hsd_comm_tout (Fault Condition:No high speed data packets received within)" VALUE 0x001490D6 /* @ECU_Address@MFG_hsd_comm_tout@0x01011808@ */ ECIPP_ALIGNMENT_UWORD 65535 Compu_MFG_hsd_comm_tout 0 65535 /end CHARACTERISTIC
/begin COMPU_METHOD Compu_MFG_hsd_comm_tout " " RAT_FUNC "%.0" "ms" COEFFS 0 1 0 0 0 1 /end COMPU_METHOD
/begin CHARACTERISTIC MFA_hsd_comm_tout "FaultConfig # MFA_hsd_comm_tout (Fault Condition:No high speed data packets received within)" VALUE 0x001490C2 /* @ECU_Address@MFA_hsd_comm_tout@0x01011810@ */ ECIPP_ALIGNMENT_UWORD 65535 Compu_MFA_hsd_comm_tout 0 65535 /end CHARACTERISTIC
/begin COMPU_METHOD Compu_MFA_hsd_comm_tout " " RAT_FUNC "%.0" "ms" COEFFS 0 1 0 0 0 1 /end COMPU_METHOD
/begin CHARACTERISTIC NOx_hi_ECT "FaultConfig # NOx_hi_ECT (Fault Condition:ECT >)" VALUE 0x00164f32 /* @ECU_Address@NOx_hi_ECT@0x010118A8@ */ ECIPP_ALIGNMENT_UWORD 564 Compu_NOx_hi_ECT -460 563.984375 /end CHARACTERISTIC
/begin COMPU_METHOD Compu_NOx_hi_ECT " " RAT_FUNC "%.3" "deg F" COEFFS 0 64 29440 0 0 1 /end COMPU_METHOD
/begin CHARACTERISTIC NOx_hi_ppm "FaultConfig # NOx_hi_ppm (Fault Condition:and Postcat NOx >)" VALUE 0x00164f34 /* @ECU_Address@NOx_hi_ppm@0x010118B8@ */ ECIPP_ALIGNMENT_UWORD 4096 Compu_NOx_hi_ppm 0 4095.9375 /end CHARACTERISTIC
/begin COMPU_METHOD Compu_NOx_hi_ppm " " RAT_FUNC "%.3" "ppm" COEFFS 0 16 0 0 0 1 /end COMPU_METHOD
/begin CHARACTERISTIC CVP1_hi "FaultConfig # CVP1_hi (Fault Condition:and CVP1 >)" VALUE 0x00162bbe /* @ECU_Address@CVP1_hi@0x010118D0@ */ ECIPP_ALIGNMENT_SWORD 32 Compu_CVP1_hi -32 31.9990234375 /end CHARACTERISTIC
/begin COMPU_METHOD Compu_CVP1_hi " " RAT_FUNC "%.3" "psi[a]" COEFFS 0 1024 0 0 0 1 /end COMPU_METHOD
/begin CHARACTERISTIC CVP1_lo "FaultConfig # CVP1_lo (Fault Condition:and CVP1 <)" VALUE 0x00162bc0 /* @ECU_Address@CVP1_lo@0x010118D8@ */ ECIPP_ALIGNMENT_SWORD 32 Compu_CVP1_lo -32 31.9990234375 /end CHARACTERISTIC
/begin COMPU_METHOD Compu_CVP1_lo " " RAT_FUNC "%.3" "psi[a]" COEFFS 0 1024 0 0 0 1 /end COMPU_METHOD
/begin CHARACTERISTIC CVP2_hi "FaultConfig # CVP2_hi (Fault Condition:and CVP2 >)" VALUE 0x00162bc2 /* @ECU_Address@CVP2_hi@0x010118E0@ */ ECIPP_ALIGNMENT_SWORD 32 Compu_CVP2_hi -32 31.9990234375 /end CHARACTERISTIC
/begin COMPU_METHOD Compu_CVP2_hi " " RAT_FUNC "%.3" "psi[a]" COEFFS 0 1024 0 0 0 1 /end COMPU_METHOD
/begin CHARACTERISTIC CVP2_lo "FaultConfig # CVP2_lo (Fault Condition:and CVP2 <)" VALUE 0x00162bc4 /* @ECU_Address@CVP2_lo@0x010118E8@ */ ECIPP_ALIGNMENT_SWORD 32 Compu_CVP2_lo -32 31.9990234375 /end CHARACTERISTIC
/begin COMPU_METHOD Compu_CVP2_lo " " RAT_FUNC "%.3" "psi[a]" COEFFS 0 1024 0 0 0 1 /end COMPU_METHOD
/begin CHARACTERISTIC CVP1_hi_MAP "FaultConfig # CVP1_hi_MAP (Fault Condition:MAP >)" VALUE 0x001634ac /* @ECU_Address@CVP1_hi_MAP@0x010118F0@ */ ECIPP_ALIGNMENT_UWORD 256 Compu_CVP1_hi_MAP 0 255.99609375 /end CHARACTERISTIC
/begin COMPU_METHOD Compu_CVP1_hi_MAP " " RAT_FUNC "%.3" "psia" COEFFS 0 256 0 0 0 1 /end COMPU_METHOD
/begin CHARACTERISTIC CVP1_lo_MAP "FaultConfig # CVP1_lo_MAP (Fault Condition:MAP >)" VALUE 0x001634ae /* @ECU_Address@CVP1_lo_MAP@0x010118F8@ */ ECIPP_ALIGNMENT_UWORD 256 Compu_CVP1_lo_MAP 0 255.99609375 /end CHARACTERISTIC
/begin COMPU_METHOD Compu_CVP1_lo_MAP " " RAT_FUNC "%.3" "psia" COEFFS 0 256 0 0 0 1 /end COMPU_METHOD
/begin CHARACTERISTIC CVP2_hi_MAP "FaultConfig # CVP2_hi_MAP (Fault Condition:MAP >)" VALUE 0x001634b0 /* @ECU_Address@CVP2_hi_MAP@0x01011900@ */ ECIPP_ALIGNMENT_UWORD 256 Compu_CVP2_hi_MAP 0 255.99609375 /end CHARACTERISTIC
/begin COMPU_METHOD Compu_CVP2_hi_MAP " " RAT_FUNC "%.3" "psia" COEFFS 0 256 0 0 0 1 /end COMPU_METHOD
/begin CHARACTERISTIC CVP2_lo_MAP "FaultConfig # CVP2_lo_MAP (Fault Condition:MAP >)" VALUE 0x001634b2 /* @ECU_Address@CVP2_lo_MAP@0x01011908@ */ ECIPP_ALIGNMENT_UWORD 256 Compu_CVP2_lo_MAP 0 255.99609375 /end CHARACTERISTIC
/begin COMPU_METHOD Compu_CVP2_lo_MAP " " RAT_FUNC "%.3" "psia" COEFFS 0 256 0 0 0 1 /end COMPU_METHOD
/begin CHARACTERISTIC controller_flash "{controller_flash&0xff=0:SH Base}{controller_flash&0xff=1:SH Extended}" VALUE 0x0016c30b /* @ECU_Address@controller_flash@0x01011930@ */ ECIPP_ALIGNMENT_UBYTE 255 controller_flash_COMPU_VTAB 0 255 BIT_MASK 0xff /end CHARACTERISTIC
/begin COMPU_METHOD controller_flash_COMPU_VTAB "Verbal Table" TAB_VERB "%.0" "list" COMPU_TAB_REF controller_flash_COMPU_VTAB_REF /end COMPU_METHOD
/begin COMPU_VTAB controller_flash_COMPU_VTAB_REF "Verbal Table" TAB_VERB 2 0 "SH Base" 1 "SH Extended" DEFAULT_VALUE "UNKNOWN" /end COMPU_VTAB
/end MODULE
/end PROJECT
