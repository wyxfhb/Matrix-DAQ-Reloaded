ASAP2_VERSION 1 61
/begin PROJECT Econtrols_4G "4G Test"
/begin HEADER "4G A2L Configuration" PROJECT_NO EControls4G /* config for version control */ VERSION "$Revision: 82130 $:" /* config for version control */ /end HEADER
/begin MODULE EControls_4G_SH2A "EControls 4G"
/begin MOD_COMMON "" DEPOSIT ABSOLUTE BYTE_ORDER MSB_FIRST /end MOD_COMMON
/* Define the Record Layouts */
/begin RECORD_LAYOUT ECIPP_ALIGNMENT_UBYTE FNC_VALUES 1 UBYTE COLUMN_DIR DIRECT /end RECORD_LAYOUT
/begin RECORD_LAYOUT ECIPP_ALIGNMENT_UWORD FNC_VALUES 1 UWORD COLUMN_DIR DIRECT /end RECORD_LAYOUT
/begin RECORD_LAYOUT ECIPP_ALIGNMENT_ULONG FNC_VALUES 1 ULONG COLUMN_DIR DIRECT /end RECORD_LAYOUT
/begin RECORD_LAYOUT ECIPP_ALIGNMENT_FLOAT32_IEEE FNC_VALUES 1 FLOAT32_IEEE COLUMN_DIR DIRECT /end RECORD_LAYOUT
/begin COMPU_METHOD Compu_IDENTITY "Discrete Values " /* Identifier */ IDENTICAL "%.0" /* Format */ "-" /* Units */ /end COMPU_METHOD
/begin CHARACTERISTIC FCdc4_EGR_slowdec "FCtl_DTC_0x04(660)" VALUE 0x001640F8 /* @ECU_Address@FCtl_DTC_0x04@0x024C4528@ */ ECIPP_ALIGNMENT_UWORD 65535 Compu_IDENTITY 0 65535 PHYS_UNIT "System ID + DTC" /end CHARACTERISTIC
/begin CHARACTERISTIC FCdc4_EGR_slowinc "FCtl_DTC_0x04(659)" VALUE 0x001640F6 /* @ECU_Address@FCtl_DTC_0x04@0x024C4526@ */ ECIPP_ALIGNMENT_UWORD 65535 Compu_IDENTITY 0 65535 PHYS_UNIT "System ID + DTC" /end CHARACTERISTIC
/begin CHARACTERISTIC FCdc4_EGR_UEGOdP_hi "FCtl_DTC_0x04(663)" VALUE 0x001640FE /* @ECU_Address@FCtl_DTC_0x04@0x024C452E@ */ ECIPP_ALIGNMENT_UWORD 65535 Compu_IDENTITY 0 65535 PHYS_UNIT "System ID + DTC" /end CHARACTERISTIC
/begin CHARACTERISTIC FCdc4_EGR_UEGOdP_lo "FCtl_DTC_0x04(664)" VALUE 0x00164100 /* @ECU_Address@FCtl_DTC_0x04@0x024C4530@ */ ECIPP_ALIGNMENT_UWORD 65535 Compu_IDENTITY 0 65535 PHYS_UNIT "System ID + DTC" /end CHARACTERISTIC
/begin CHARACTERISTIC FCdc4_EGR_vlv_DC_lim "FCtl_DTC_0x04(743)" VALUE 0x0016419E /* @ECU_Address@FCtl_DTC_0x04@0x024C45CE@ */ ECIPP_ALIGNMENT_UWORD 65535 Compu_IDENTITY 0 65535 PHYS_UNIT "System ID + DTC" /end CHARACTERISTIC
/begin CHARACTERISTIC FCdc4_EGR_vlv_stuck "FCtl_DTC_0x04(833)" VALUE 0x00164252 /* @ECU_Address@FCtl_DTC_0x04@0x024C4682@ */ ECIPP_ALIGNMENT_UWORD 65535 Compu_IDENTITY 0 65535 PHYS_UNIT "System ID + DTC" /end CHARACTERISTIC
/begin CHARACTERISTIC FCdc4_EGR_vlv_temp_hi "FCtl_DTC_0x04(744)" VALUE 0x001641A0 /* @ECU_Address@FCtl_DTC_0x04@0x024C45D0@ */ ECIPP_ALIGNMENT_UWORD 65535 Compu_IDENTITY 0 65535 PHYS_UNIT "System ID + DTC" /end CHARACTERISTIC
/begin CHARACTERISTIC FCdc4_EGR_vlvCAN_commlost "FCtl_DTC_0x04(667)" VALUE 0x00164106 /* @ECU_Address@FCtl_DTC_0x04@0x024C4536@ */ ECIPP_ALIGNMENT_UWORD 65535 Compu_IDENTITY 0 65535 PHYS_UNIT "System ID + DTC" /end CHARACTERISTIC
/begin CHARACTERISTIC FCdc4_EGR_vlvCAN_lowfunc "FCtl_DTC_0x04(669)" VALUE 0x0016410A /* @ECU_Address@FCtl_DTC_0x04@0x024C453A@ */ ECIPP_ALIGNMENT_UWORD 65535 Compu_IDENTITY 0 65535 PHYS_UNIT "System ID + DTC" /end CHARACTERISTIC
/begin CHARACTERISTIC FCdc4_EGR_vlvCAN_nofunc "FCtl_DTC_0x04(668)" VALUE 0x00164108 /* @ECU_Address@FCtl_DTC_0x04@0x024C4538@ */ ECIPP_ALIGNMENT_UWORD 65535 Compu_IDENTITY 0 65535 PHYS_UNIT "System ID + DTC" /end CHARACTERISTIC
/begin CHARACTERISTIC FCdc4_EGRdP_HiExp "FCtl_DTC_0x04(752)" VALUE 0x001641B0 /* @ECU_Address@FCtl_DTC_0x04@0x024C45E0@ */ ECIPP_ALIGNMENT_UWORD 65535 Compu_IDENTITY 0 65535 PHYS_UNIT "System ID + DTC" /end CHARACTERISTIC
/begin CHARACTERISTIC FCdc4_EGRdP_LoExp "FCtl_DTC_0x04(751)" VALUE 0x001641AE /* @ECU_Address@FCtl_DTC_0x04@0x024C45DE@ */ ECIPP_ALIGNMENT_UWORD 65535 Compu_IDENTITY 0 65535 PHYS_UNIT "System ID + DTC" /end CHARACTERISTIC
/begin CHARACTERISTIC FCdc4_EGRdP_maxv "FCtl_DTC_0x04(749)" VALUE 0x001641AA /* @ECU_Address@FCtl_DTC_0x04@0x024C45DA@ */ ECIPP_ALIGNMENT_UWORD 65535 Compu_IDENTITY 0 65535 PHYS_UNIT "System ID + DTC" /end CHARACTERISTIC
/begin CHARACTERISTIC FCdc4_EGRdP_minv "FCtl_DTC_0x04(750)" VALUE 0x001641AC /* @ECU_Address@FCtl_DTC_0x04@0x024C45DC@ */ ECIPP_ALIGNMENT_UWORD 65535 Compu_IDENTITY 0 65535 PHYS_UNIT "System ID + DTC" /end CHARACTERISTIC
/begin CHARACTERISTIC FCdc4_EGRflow_HiExp "FCtl_DTC_0x04(597)" VALUE 0x0016407A /* @ECU_Address@FCtl_DTC_0x04@0x024C44AA@ */ ECIPP_ALIGNMENT_UWORD 65535 Compu_IDENTITY 0 65535 PHYS_UNIT "System ID + DTC" /end CHARACTERISTIC
/begin CHARACTERISTIC FCdc4_EGRflow_LoExp "FCtl_DTC_0x04(596)" VALUE 0x00164078 /* @ECU_Address@FCtl_DTC_0x04@0x024C44A8@ */ ECIPP_ALIGNMENT_UWORD 65535 Compu_IDENTITY 0 65535 PHYS_UNIT "System ID + DTC" /end CHARACTERISTIC
/begin CHARACTERISTIC FCdc4_EGRflow_LoExp2 "FCtl_DTC_0x04(684)" VALUE 0x00164128 /* @ECU_Address@FCtl_DTC_0x04@0x024C4558@ */ ECIPP_ALIGNMENT_UWORD 65535 Compu_IDENTITY 0 65535 PHYS_UNIT "System ID + DTC" /end CHARACTERISTIC
/begin CHARACTERISTIC FCdc4_EGRHP_maxv "FCtl_DTC_0x04(753)" VALUE 0x001641B2 /* @ECU_Address@FCtl_DTC_0x04@0x024C45E2@ */ ECIPP_ALIGNMENT_UWORD 65535 Compu_IDENTITY 0 65535 PHYS_UNIT "System ID + DTC" /end CHARACTERISTIC
/begin CHARACTERISTIC FCdc4_EGRHP_minv "FCtl_DTC_0x04(754)" VALUE 0x001641B4 /* @ECU_Address@FCtl_DTC_0x04@0x024C45E4@ */ ECIPP_ALIGNMENT_UWORD 65535 Compu_IDENTITY 0 65535 PHYS_UNIT "System ID + DTC" /end CHARACTERISTIC
/begin CHARACTERISTIC FCdc4_EGRHP_OOR "FCtl_DTC_0x04(755)" VALUE 0x001641B6 /* @ECU_Address@FCtl_DTC_0x04@0x024C45E6@ */ ECIPP_ALIGNMENT_UWORD 65535 Compu_IDENTITY 0 65535 PHYS_UNIT "System ID + DTC" /end CHARACTERISTIC
/begin CHARACTERISTIC FCdc4_EGRO_postlk "FCtl_DTC_0x04(798)" VALUE 0x0016420C /* @ECU_Address@FCtl_DTC_0x04@0x024C463C@ */ ECIPP_ALIGNMENT_UWORD 65535 Compu_IDENTITY 0 65535 PHYS_UNIT "System ID + DTC" /end CHARACTERISTIC
/begin CHARACTERISTIC FCdc4_EGRT_hi "FCtl_DTC_0x04(694)" VALUE 0x0016413C /* @ECU_Address@FCtl_DTC_0x04@0x024C456C@ */ ECIPP_ALIGNMENT_UWORD 65535 Compu_IDENTITY 0 65535 PHYS_UNIT "System ID + DTC" /end CHARACTERISTIC
/begin CHARACTERISTIC FCdc4_EGRT_maxv "FCtl_DTC_0x04(692)" VALUE 0x00164138 /* @ECU_Address@FCtl_DTC_0x04@0x024C4568@ */ ECIPP_ALIGNMENT_UWORD 65535 Compu_IDENTITY 0 65535 PHYS_UNIT "System ID + DTC" /end CHARACTERISTIC
/begin CHARACTERISTIC FCdc4_EGRT_minv "FCtl_DTC_0x04(693)" VALUE 0x0016413A /* @ECU_Address@FCtl_DTC_0x04@0x024C456A@ */ ECIPP_ALIGNMENT_UWORD 65535 Compu_IDENTITY 0 65535 PHYS_UNIT "System ID + DTC" /end CHARACTERISTIC
/begin CHARACTERISTIC FCdc4_EGT_dig_Hi "FCtl_DTC_0x04(187)" VALUE 0x00163D46 /* @ECU_Address@FCtl_DTC_0x04@0x024C4176@ */ ECIPP_ALIGNMENT_UWORD 65535 Compu_IDENTITY 0 65535 PHYS_UNIT "System ID + DTC" /end CHARACTERISTIC
/begin CHARACTERISTIC FCdc4_EGT_maxv "FCtl_DTC_0x04(808)" VALUE 0x00164220 /* @ECU_Address@FCtl_DTC_0x04@0x024C4650@ */ ECIPP_ALIGNMENT_UWORD 65535 Compu_IDENTITY 0 65535 PHYS_UNIT "System ID + DTC" /end CHARACTERISTIC
/begin CHARACTERISTIC FCdc4_EGT_minv "FCtl_DTC_0x04(809)" VALUE 0x00164222 /* @ECU_Address@FCtl_DTC_0x04@0x024C4652@ */ ECIPP_ALIGNMENT_UWORD 65535 Compu_IDENTITY 0 65535 PHYS_UNIT "System ID + DTC" /end CHARACTERISTIC
/begin CHARACTERISTIC FCdc4_EMWT1_HiExp1 "FCtl_DTC_0x04(225)" VALUE 0x00163D92 /* @ECU_Address@FCtl_DTC_0x04@0x024C41C2@ */ ECIPP_ALIGNMENT_UWORD 65535 Compu_IDENTITY 0 65535 PHYS_UNIT "System ID + DTC" /end CHARACTERISTIC
/begin CHARACTERISTIC FCdc4_EMWT1_HiExp2 "FCtl_DTC_0x04(227)" VALUE 0x00163D96 /* @ECU_Address@FCtl_DTC_0x04@0x024C41C6@ */ ECIPP_ALIGNMENT_UWORD 65535 Compu_IDENTITY 0 65535 PHYS_UNIT "System ID + DTC" /end CHARACTERISTIC
/begin CHARACTERISTIC FCdc4_EMWT1_maxv "FCtl_DTC_0x04(221)" VALUE 0x00163D8A /* @ECU_Address@FCtl_DTC_0x04@0x024C41BA@ */ ECIPP_ALIGNMENT_UWORD 65535 Compu_IDENTITY 0 65535 PHYS_UNIT "System ID + DTC" /end CHARACTERISTIC
/begin CHARACTERISTIC FCdc4_EMWT1_minv "FCtl_DTC_0x04(223)" VALUE 0x00163D8E /* @ECU_Address@FCtl_DTC_0x04@0x024C41BE@ */ ECIPP_ALIGNMENT_UWORD 65535 Compu_IDENTITY 0 65535 PHYS_UNIT "System ID + DTC" /end CHARACTERISTIC
/begin CHARACTERISTIC FCdc4_envtech_AAT_inv "FCtl_DTC_0x04(814)" VALUE 0x0016422C /* @ECU_Address@FCtl_DTC_0x04@0x024C465C@ */ ECIPP_ALIGNMENT_UWORD 65535 Compu_IDENTITY 0 65535 PHYS_UNIT "System ID + DTC" /end CHARACTERISTIC
/begin CHARACTERISTIC FCdc4_envtech_BP_inv "FCtl_DTC_0x04(815)" VALUE 0x0016422E /* @ECU_Address@FCtl_DTC_0x04@0x024C465E@ */ ECIPP_ALIGNMENT_UWORD 65535 Compu_IDENTITY 0 65535 PHYS_UNIT "System ID + DTC" /end CHARACTERISTIC
/begin CHARACTERISTIC FCdc4_envtech_comm "FCtl_DTC_0x04(358)" VALUE 0x00163E9C /* @ECU_Address@FCtl_DTC_0x04@0x024C42CC@ */ ECIPP_ALIGNMENT_UWORD 65535 Compu_IDENTITY 0 65535 PHYS_UNIT "System ID + DTC" /end CHARACTERISTIC
/begin CHARACTERISTIC FCdc4_envtech_general "FCtl_DTC_0x04(817)" VALUE 0x00164232 /* @ECU_Address@FCtl_DTC_0x04@0x024C4662@ */ ECIPP_ALIGNMENT_UWORD 65535 Compu_IDENTITY 0 65535 PHYS_UNIT "System ID + DTC" /end CHARACTERISTIC
/begin CHARACTERISTIC FCdc4_envtech_RH_inv "FCtl_DTC_0x04(816)" VALUE 0x00164230 /* @ECU_Address@FCtl_DTC_0x04@0x024C4660@ */ ECIPP_ALIGNMENT_UWORD 65535 Compu_IDENTITY 0 65535 PHYS_UNIT "System ID + DTC" /end CHARACTERISTIC
/begin CHARACTERISTIC FCdc4_envtech_RH_uns "FCtl_DTC_0x04(818)" VALUE 0x00164234 /* @ECU_Address@FCtl_DTC_0x04@0x024C4664@ */ ECIPP_ALIGNMENT_UWORD 65535 Compu_IDENTITY 0 65535 PHYS_UNIT "System ID + DTC" /end CHARACTERISTIC
/begin CHARACTERISTIC FCdc4_ERCV_speed_OOR "FCtl_DTC_0x04(853)" VALUE 0x0016427A /* @ECU_Address@FCtl_DTC_0x04@0x024C46AA@ */ ECIPP_ALIGNMENT_UWORD 65535 Compu_IDENTITY 0 65535 PHYS_UNIT "System ID + DTC" /end CHARACTERISTIC
/begin CHARACTERISTIC FCdc4_ERWT1_HiExp1 "FCtl_DTC_0x04(237)" VALUE 0x00163DAA /* @ECU_Address@FCtl_DTC_0x04@0x024C41DA@ */ ECIPP_ALIGNMENT_UWORD 65535 Compu_IDENTITY 0 65535 PHYS_UNIT "System ID + DTC" /end CHARACTERISTIC
/begin CHARACTERISTIC FCdc4_ERWT1_HiExp2 "FCtl_DTC_0x04(239)" VALUE 0x00163DAE /* @ECU_Address@FCtl_DTC_0x04@0x024C41DE@ */ ECIPP_ALIGNMENT_UWORD 65535 Compu_IDENTITY 0 65535 PHYS_UNIT "System ID + DTC" /end CHARACTERISTIC
/begin CHARACTERISTIC FCdc4_ERWT1_maxv "FCtl_DTC_0x04(233)" VALUE 0x00163DA2 /* @ECU_Address@FCtl_DTC_0x04@0x024C41D2@ */ ECIPP_ALIGNMENT_UWORD 65535 Compu_IDENTITY 0 65535 PHYS_UNIT "System ID + DTC" /end CHARACTERISTIC
/begin CHARACTERISTIC FCdc4_ERWT1_minv "FCtl_DTC_0x04(235)" VALUE 0x00163DA6 /* @ECU_Address@FCtl_DTC_0x04@0x024C41D6@ */ ECIPP_ALIGNMENT_UWORD 65535 Compu_IDENTITY 0 65535 PHYS_UNIT "System ID + DTC" /end CHARACTERISTIC
/begin CHARACTERISTIC FCdc4_F1OOR_F2IVS "FCtl_DTC_0x04(178)" VALUE 0x00163D34 /* @ECU_Address@FCtl_DTC_0x04@0x024C4164@ */ ECIPP_ALIGNMENT_UWORD 65535 Compu_IDENTITY 0 65535 PHYS_UNIT "System ID + DTC" /end CHARACTERISTIC
/begin CHARACTERISTIC FCdc4_F2OOR_F1IVS "FCtl_DTC_0x04(179)" VALUE 0x00163D36 /* @ECU_Address@FCtl_DTC_0x04@0x024C4166@ */ ECIPP_ALIGNMENT_UWORD 65535 Compu_IDENTITY 0 65535 PHYS_UNIT "System ID + DTC" /end CHARACTERISTIC
/begin CHARACTERISTIC FCdc4_FCoolH2O_lo "FCtl_DTC_0x04(532)" VALUE 0x00163FF8 /* @ECU_Address@FCtl_DTC_0x04@0x024C4428@ */ ECIPP_ALIGNMENT_UWORD 65535 Compu_IDENTITY 0 65535 PHYS_UNIT "System ID + DTC" /end CHARACTERISTIC
/begin CHARACTERISTIC FCdc4_FIMP_pct_high "FCtl_DTC_0x04(282)" VALUE 0x00163E04 /* @ECU_Address@FCtl_DTC_0x04@0x024C4234@ */ ECIPP_ALIGNMENT_UWORD 65535 Compu_IDENTITY 0 65535 PHYS_UNIT "System ID + DTC" /end CHARACTERISTIC
/begin CHARACTERISTIC FCdc4_FIP_LoExp "FCtl_DTC_0x04(695)" VALUE 0x0016413E /* @ECU_Address@FCtl_DTC_0x04@0x024C456E@ */ ECIPP_ALIGNMENT_UWORD 65535 Compu_IDENTITY 0 65535 PHYS_UNIT "System ID + DTC" /end CHARACTERISTIC
/begin CHARACTERISTIC FCdc4_flash_fail "FCtl_DTC_0x04(105)" VALUE 0x00163CA2 /* @ECU_Address@FCtl_DTC_0x04@0x024C40D2@ */ ECIPP_ALIGNMENT_UWORD 65535 Compu_IDENTITY 0 65535 PHYS_UNIT "System ID + DTC" /end CHARACTERISTIC
/begin CHARACTERISTIC FCdc4_FP_high "FCtl_DTC_0x04(290)" VALUE 0x00163E14 /* @ECU_Address@FCtl_DTC_0x04@0x024C4244@ */ ECIPP_ALIGNMENT_UWORD 65535 Compu_IDENTITY 0 65535 PHYS_UNIT "System ID + DTC" /end CHARACTERISTIC
/begin CHARACTERISTIC FCdc4_FP_low "FCtl_DTC_0x04(291)" VALUE 0x00163E16 /* @ECU_Address@FCtl_DTC_0x04@0x024C4246@ */ ECIPP_ALIGNMENT_UWORD 65535 Compu_IDENTITY 0 65535 PHYS_UNIT "System ID + DTC" /end CHARACTERISTIC
/begin CHARACTERISTIC FCdc4_FP_maxv "FCtl_DTC_0x04(128)" VALUE 0x00163CD0 /* @ECU_Address@FCtl_DTC_0x04@0x024C4100@ */ ECIPP_ALIGNMENT_UWORD 65535 Compu_IDENTITY 0 65535 PHYS_UNIT "System ID + DTC" /end CHARACTERISTIC
/begin CHARACTERISTIC FCdc4_FP_minv "FCtl_DTC_0x04(129)" VALUE 0x00163CD2 /* @ECU_Address@FCtl_DTC_0x04@0x024C4102@ */ ECIPP_ALIGNMENT_UWORD 65535 Compu_IDENTITY 0 65535 PHYS_UNIT "System ID + DTC" /end CHARACTERISTIC
/begin CHARACTERISTIC FCdc4_FP2_high "FCtl_DTC_0x04(463)" VALUE 0x00163F6E /* @ECU_Address@FCtl_DTC_0x04@0x024C439E@ */ ECIPP_ALIGNMENT_UWORD 65535 Compu_IDENTITY 0 65535 PHYS_UNIT "System ID + DTC" /end CHARACTERISTIC
/begin CHARACTERISTIC FCdc4_FP2_low "FCtl_DTC_0x04(464)" VALUE 0x00163F70 /* @ECU_Address@FCtl_DTC_0x04@0x024C43A0@ */ ECIPP_ALIGNMENT_UWORD 65535 Compu_IDENTITY 0 65535 PHYS_UNIT "System ID + DTC" /end CHARACTERISTIC
/begin CHARACTERISTIC FCdc4_FP2_maxv "FCtl_DTC_0x04(461)" VALUE 0x00163F6A /* @ECU_Address@FCtl_DTC_0x04@0x024C439A@ */ ECIPP_ALIGNMENT_UWORD 65535 Compu_IDENTITY 0 65535 PHYS_UNIT "System ID + DTC" /end CHARACTERISTIC
/begin CHARACTERISTIC FCdc4_FP2_minv "FCtl_DTC_0x04(462)" VALUE 0x00163F6C /* @ECU_Address@FCtl_DTC_0x04@0x024C439C@ */ ECIPP_ALIGNMENT_UWORD 65535 Compu_IDENTITY 0 65535 PHYS_UNIT "System ID + DTC" /end CHARACTERISTIC
/begin CHARACTERISTIC FCdc4_FPD_off_hi "FCtl_DTC_0x04(94)" VALUE 0x00163C8C /* @ECU_Address@FCtl_DTC_0x04@0x024C40BC@ */ ECIPP_ALIGNMENT_UWORD 65535 Compu_IDENTITY 0 65535 PHYS_UNIT "System ID + DTC" /end CHARACTERISTIC
/begin CHARACTERISTIC FCdc4_FPD_on_lo "FCtl_DTC_0x04(93)" VALUE 0x00163C8A /* @ECU_Address@FCtl_DTC_0x04@0x024C40BA@ */ ECIPP_ALIGNMENT_UWORD 65535 Compu_IDENTITY 0 65535 PHYS_UNIT "System ID + DTC" /end CHARACTERISTIC
/begin CHARACTERISTIC FCdc4_FPlo_derate_actv "FCtl_DTC_0x04(807)" VALUE 0x0016421E /* @ECU_Address@FCtl_DTC_0x04@0x024C464E@ */ ECIPP_ALIGNMENT_UWORD 65535 Compu_IDENTITY 0 65535 PHYS_UNIT "System ID + DTC" /end CHARACTERISTIC
/begin CHARACTERISTIC FCdc4_FPlo_derate_excess "FCtl_DTC_0x04(810)" VALUE 0x00164224 /* @ECU_Address@FCtl_DTC_0x04@0x024C4654@ */ ECIPP_ALIGNMENT_UWORD 65535 Compu_IDENTITY 0 65535 PHYS_UNIT "System ID + DTC" /end CHARACTERISTIC
/begin CHARACTERISTIC FCdc4_FPP_NeutLock_fail "FCtl_DTC_0x04(658)" VALUE 0x001640F4 /* @ECU_Address@FCtl_DTC_0x04@0x024C4524@ */ ECIPP_ALIGNMENT_UWORD 65535 Compu_IDENTITY 0 65535 PHYS_UNIT "System ID + DTC" /end CHARACTERISTIC
/begin CHARACTERISTIC FCdc4_FPP1_IVS_max "FCtl_DTC_0x04(23)" VALUE 0x00163BFE /* @ECU_Address@FCtl_DTC_0x04@0x024C402E@ */ ECIPP_ALIGNMENT_UWORD 65535 Compu_IDENTITY 0 65535 PHYS_UNIT "System ID + DTC" /end CHARACTERISTIC
/begin CHARACTERISTIC FCdc4_FPP1_IVS_min "FCtl_DTC_0x04(24)" VALUE 0x00163C00 /* @ECU_Address@FCtl_DTC_0x04@0x024C4030@ */ ECIPP_ALIGNMENT_UWORD 65535 Compu_IDENTITY 0 65535 PHYS_UNIT "System ID + DTC" /end CHARACTERISTIC
/begin CHARACTERISTIC FCdc4_FPP1_max "FCtl_DTC_0x04(19)" VALUE 0x00163BF6 /* @ECU_Address@FCtl_DTC_0x04@0x024C4026@ */ ECIPP_ALIGNMENT_UWORD 65535 Compu_IDENTITY 0 65535 PHYS_UNIT "System ID + DTC" /end CHARACTERISTIC
/begin CHARACTERISTIC FCdc4_FPP1_min "FCtl_DTC_0x04(20)" VALUE 0x00163BF8 /* @ECU_Address@FCtl_DTC_0x04@0x024C4028@ */ ECIPP_ALIGNMENT_UWORD 65535 Compu_IDENTITY 0 65535 PHYS_UNIT "System ID + DTC" /end CHARACTERISTIC
/begin CHARACTERISTIC FCdc4_FPP12_IVS_max "FCtl_DTC_0x04(175)" VALUE 0x00163D2E /* @ECU_Address@FCtl_DTC_0x04@0x024C415E@ */ ECIPP_ALIGNMENT_UWORD 65535 Compu_IDENTITY 0 65535 PHYS_UNIT "System ID + DTC" /end CHARACTERISTIC
/begin CHARACTERISTIC FCdc4_FPP12_IVS_min "FCtl_DTC_0x04(176)" VALUE 0x00163D30 /* @ECU_Address@FCtl_DTC_0x04@0x024C4160@ */ ECIPP_ALIGNMENT_UWORD 65535 Compu_IDENTITY 0 65535 PHYS_UNIT "System ID + DTC" /end CHARACTERISTIC
/begin CHARACTERISTIC FCdc4_FPP12_OOR "FCtl_DTC_0x04(177)" VALUE 0x00163D32 /* @ECU_Address@FCtl_DTC_0x04@0x024C4162@ */ ECIPP_ALIGNMENT_UWORD 65535 Compu_IDENTITY 0 65535 PHYS_UNIT "System ID + DTC" /end CHARACTERISTIC
/begin CHARACTERISTIC FCdc4_FPP12IVS_TSC1 "FCtl_DTC_0x04(734)" VALUE 0x0016418C /* @ECU_Address@FCtl_DTC_0x04@0x024C45BC@ */ ECIPP_ALIGNMENT_UWORD 65535 Compu_IDENTITY 0 65535 PHYS_UNIT "System ID + DTC" /end CHARACTERISTIC
/begin CHARACTERISTIC FCdc4_FPP12MM_IVSMM "FCtl_DTC_0x04(180)" VALUE 0x00163D38 /* @ECU_Address@FCtl_DTC_0x04@0x024C4168@ */ ECIPP_ALIGNMENT_UWORD 65535 Compu_IDENTITY 0 65535 PHYS_UNIT "System ID + DTC" /end CHARACTERISTIC
/begin CHARACTERISTIC FCdc4_FPP12pct_hi "FCtl_DTC_0x04(27)" VALUE 0x00163C06 /* @ECU_Address@FCtl_DTC_0x04@0x024C4036@ */ ECIPP_ALIGNMENT_UWORD 65535 Compu_IDENTITY 0 65535 PHYS_UNIT "System ID + DTC" /end CHARACTERISTIC
/begin CHARACTERISTIC FCdc4_FPP12pct_lo "FCtl_DTC_0x04(28)" VALUE 0x00163C08 /* @ECU_Address@FCtl_DTC_0x04@0x024C4038@ */ ECIPP_ALIGNMENT_UWORD 65535 Compu_IDENTITY 0 65535 PHYS_UNIT "System ID + DTC" /end CHARACTERISTIC
/begin CHARACTERISTIC FPnd_EGR_slowdec "FPrm_pending(490)" VALUE 0x00164D40 /* @ECU_Address@FPrm_pending@0x021BE3D4@ */ ECIPP_ALIGNMENT_UWORD 65535 Compu_IDENTITY 0 65535 PHYS_UNIT "Bit Mask" /end CHARACTERISTIC
/begin CHARACTERISTIC FPnd_EGR_slowinc "FPrm_pending(489)" VALUE 0x00164D3E /* @ECU_Address@FPrm_pending@0x021BE3D2@ */ ECIPP_ALIGNMENT_UWORD 65535 Compu_IDENTITY 0 65535 PHYS_UNIT "Bit Mask" /end CHARACTERISTIC
/begin CHARACTERISTIC FPnd_EGR_UEGOdP_hi "FPrm_pending(493)" VALUE 0x00164D46 /* @ECU_Address@FPrm_pending@0x021BE3DA@ */ ECIPP_ALIGNMENT_UWORD 65535 Compu_IDENTITY 0 65535 PHYS_UNIT "Bit Mask" /end CHARACTERISTIC
/begin CHARACTERISTIC FPnd_EGR_UEGOdP_lo "FPrm_pending(494)" VALUE 0x00164D48 /* @ECU_Address@FPrm_pending@0x021BE3DC@ */ ECIPP_ALIGNMENT_UWORD 65535 Compu_IDENTITY 0 65535 PHYS_UNIT "Bit Mask" /end CHARACTERISTIC
/begin CHARACTERISTIC FPnd_EGR_vlv_DC_lim "FPrm_pending(573)" VALUE 0x00164DE6 /* @ECU_Address@FPrm_pending@0x021BE47A@ */ ECIPP_ALIGNMENT_UWORD 65535 Compu_IDENTITY 0 65535 PHYS_UNIT "Bit Mask" /end CHARACTERISTIC
/begin CHARACTERISTIC FPnd_EGR_vlv_stuck "FPrm_pending(660)" VALUE 0x00164E94 /* @ECU_Address@FPrm_pending@0x021BE528@ */ ECIPP_ALIGNMENT_UWORD 65535 Compu_IDENTITY 0 65535 PHYS_UNIT "Bit Mask" /end CHARACTERISTIC
/begin CHARACTERISTIC FPnd_EGR_vlv_temp_hi "FPrm_pending(574)" VALUE 0x00164DE8 /* @ECU_Address@FPrm_pending@0x021BE47C@ */ ECIPP_ALIGNMENT_UWORD 65535 Compu_IDENTITY 0 65535 PHYS_UNIT "Bit Mask" /end CHARACTERISTIC
/begin CHARACTERISTIC FPnd_EGR_vlvCAN_commlost "FPrm_pending(497)" VALUE 0x00164D4E /* @ECU_Address@FPrm_pending@0x021BE3E2@ */ ECIPP_ALIGNMENT_UWORD 65535 Compu_IDENTITY 0 65535 PHYS_UNIT "Bit Mask" /end CHARACTERISTIC
/begin CHARACTERISTIC FPnd_EGR_vlvCAN_lowfunc "FPrm_pending(499)" VALUE 0x00164D52 /* @ECU_Address@FPrm_pending@0x021BE3E6@ */ ECIPP_ALIGNMENT_UWORD 65535 Compu_IDENTITY 0 65535 PHYS_UNIT "Bit Mask" /end CHARACTERISTIC
/begin CHARACTERISTIC FPnd_EGR_vlvCAN_nofunc "FPrm_pending(498)" VALUE 0x00164D50 /* @ECU_Address@FPrm_pending@0x021BE3E4@ */ ECIPP_ALIGNMENT_UWORD 65535 Compu_IDENTITY 0 65535 PHYS_UNIT "Bit Mask" /end CHARACTERISTIC
/begin CHARACTERISTIC FPnd_EGRdP_HiExp "FPrm_pending(582)" VALUE 0x00164DF8 /* @ECU_Address@FPrm_pending@0x021BE48C@ */ ECIPP_ALIGNMENT_UWORD 65535 Compu_IDENTITY 0 65535 PHYS_UNIT "Bit Mask" /end CHARACTERISTIC
/begin CHARACTERISTIC FPnd_EGRdP_LoExp "FPrm_pending(581)" VALUE 0x00164DF6 /* @ECU_Address@FPrm_pending@0x021BE48A@ */ ECIPP_ALIGNMENT_UWORD 65535 Compu_IDENTITY 0 65535 PHYS_UNIT "Bit Mask" /end CHARACTERISTIC
/begin CHARACTERISTIC FPnd_EGRdP_maxv "FPrm_pending(579)" VALUE 0x00164DF2 /* @ECU_Address@FPrm_pending@0x021BE486@ */ ECIPP_ALIGNMENT_UWORD 65535 Compu_IDENTITY 0 65535 PHYS_UNIT "Bit Mask" /end CHARACTERISTIC
/begin CHARACTERISTIC FPnd_EGRdP_minv "FPrm_pending(580)" VALUE 0x00164DF4 /* @ECU_Address@FPrm_pending@0x021BE488@ */ ECIPP_ALIGNMENT_UWORD 65535 Compu_IDENTITY 0 65535 PHYS_UNIT "Bit Mask" /end CHARACTERISTIC
/begin CHARACTERISTIC FPnd_EGRflow_HiExp "FPrm_pending(451)" VALUE 0x00164CF2 /* @ECU_Address@FPrm_pending@0x021BE386@ */ ECIPP_ALIGNMENT_UWORD 65535 Compu_IDENTITY 0 65535 PHYS_UNIT "Bit Mask" /end CHARACTERISTIC
/begin CHARACTERISTIC FPnd_EGRflow_LoExp "FPrm_pending(450)" VALUE 0x00164CF0 /* @ECU_Address@FPrm_pending@0x021BE384@ */ ECIPP_ALIGNMENT_UWORD 65535 Compu_IDENTITY 0 65535 PHYS_UNIT "Bit Mask" /end CHARACTERISTIC
/begin CHARACTERISTIC FPnd_EGRflow_LoExp2 "FPrm_pending(514)" VALUE 0x00164D70 /* @ECU_Address@FPrm_pending@0x021BE404@ */ ECIPP_ALIGNMENT_UWORD 65535 Compu_IDENTITY 0 65535 PHYS_UNIT "Bit Mask" /end CHARACTERISTIC
/begin CHARACTERISTIC FPnd_EGRHP_maxv "FPrm_pending(583)" VALUE 0x00164DFA /* @ECU_Address@FPrm_pending@0x021BE48E@ */ ECIPP_ALIGNMENT_UWORD 65535 Compu_IDENTITY 0 65535 PHYS_UNIT "Bit Mask" /end CHARACTERISTIC
/begin CHARACTERISTIC FPnd_EGRHP_minv "FPrm_pending(584)" VALUE 0x00164DFC /* @ECU_Address@FPrm_pending@0x021BE490@ */ ECIPP_ALIGNMENT_UWORD 65535 Compu_IDENTITY 0 65535 PHYS_UNIT "Bit Mask" /end CHARACTERISTIC
/begin CHARACTERISTIC FPnd_EGRHP_OOR "FPrm_pending(585)" VALUE 0x00164DFE /* @ECU_Address@FPrm_pending@0x021BE492@ */ ECIPP_ALIGNMENT_UWORD 65535 Compu_IDENTITY 0 65535 PHYS_UNIT "Bit Mask" /end CHARACTERISTIC
/begin CHARACTERISTIC FPnd_EGRO_postlk "FPrm_pending(628)" VALUE 0x00164E54 /* @ECU_Address@FPrm_pending@0x021BE4E8@ */ ECIPP_ALIGNMENT_UWORD 65535 Compu_IDENTITY 0 65535 PHYS_UNIT "Bit Mask" /end CHARACTERISTIC
/begin CHARACTERISTIC FPnd_EGRT_hi "FPrm_pending(524)" VALUE 0x00164D84 /* @ECU_Address@FPrm_pending@0x021BE418@ */ ECIPP_ALIGNMENT_UWORD 65535 Compu_IDENTITY 0 65535 PHYS_UNIT "Bit Mask" /end CHARACTERISTIC
/begin CHARACTERISTIC FPnd_EGRT_maxv "FPrm_pending(522)" VALUE 0x00164D80 /* @ECU_Address@FPrm_pending@0x021BE414@ */ ECIPP_ALIGNMENT_UWORD 65535 Compu_IDENTITY 0 65535 PHYS_UNIT "Bit Mask" /end CHARACTERISTIC
/begin CHARACTERISTIC FPnd_EGRT_minv "FPrm_pending(523)" VALUE 0x00164D82 /* @ECU_Address@FPrm_pending@0x021BE416@ */ ECIPP_ALIGNMENT_UWORD 65535 Compu_IDENTITY 0 65535 PHYS_UNIT "Bit Mask" /end CHARACTERISTIC
/begin CHARACTERISTIC FPnd_EGT_dig_Hi "FPrm_pending(145)" VALUE 0x00164A8E /* @ECU_Address@FPrm_pending@0x021BE122@ */ ECIPP_ALIGNMENT_UWORD 65535 Compu_IDENTITY 0 65535 PHYS_UNIT "Bit Mask" /end CHARACTERISTIC
/begin CHARACTERISTIC FPnd_EGT_maxv "FPrm_pending(635)" VALUE 0x00164E62 /* @ECU_Address@FPrm_pending@0x021BE4F6@ */ ECIPP_ALIGNMENT_UWORD 65535 Compu_IDENTITY 0 65535 PHYS_UNIT "Bit Mask" /end CHARACTERISTIC
/begin CHARACTERISTIC FPnd_EGT_minv "FPrm_pending(636)" VALUE 0x00164E64 /* @ECU_Address@FPrm_pending@0x021BE4F8@ */ ECIPP_ALIGNMENT_UWORD 65535 Compu_IDENTITY 0 65535 PHYS_UNIT "Bit Mask" /end CHARACTERISTIC
/begin CHARACTERISTIC FPnd_EMWT1_HiExp1 "FPrm_pending(179)" VALUE 0x00164AD2 /* @ECU_Address@FPrm_pending@0x021BE166@ */ ECIPP_ALIGNMENT_UWORD 65535 Compu_IDENTITY 0 65535 PHYS_UNIT "Bit Mask" /end CHARACTERISTIC
/begin CHARACTERISTIC FPnd_EMWT1_HiExp2 "FPrm_pending(180)" VALUE 0x00164AD4 /* @ECU_Address@FPrm_pending@0x021BE168@ */ ECIPP_ALIGNMENT_UWORD 65535 Compu_IDENTITY 0 65535 PHYS_UNIT "Bit Mask" /end CHARACTERISTIC
/begin CHARACTERISTIC FPnd_EMWT1_maxv "FPrm_pending(177)" VALUE 0x00164ACE /* @ECU_Address@FPrm_pending@0x021BE162@ */ ECIPP_ALIGNMENT_UWORD 65535 Compu_IDENTITY 0 65535 PHYS_UNIT "Bit Mask" /end CHARACTERISTIC
/begin CHARACTERISTIC FPnd_EMWT1_minv "FPrm_pending(178)" VALUE 0x00164AD0 /* @ECU_Address@FPrm_pending@0x021BE164@ */ ECIPP_ALIGNMENT_UWORD 65535 Compu_IDENTITY 0 65535 PHYS_UNIT "Bit Mask" /end CHARACTERISTIC
/begin CHARACTERISTIC FPnd_envtech_AAT_inv "FPrm_pending(641)" VALUE 0x00164E6E /* @ECU_Address@FPrm_pending@0x021BE502@ */ ECIPP_ALIGNMENT_UWORD 65535 Compu_IDENTITY 0 65535 PHYS_UNIT "Bit Mask" /end CHARACTERISTIC
/begin CHARACTERISTIC FPnd_envtech_BP_inv "FPrm_pending(642)" VALUE 0x00164E70 /* @ECU_Address@FPrm_pending@0x021BE504@ */ ECIPP_ALIGNMENT_UWORD 65535 Compu_IDENTITY 0 65535 PHYS_UNIT "Bit Mask" /end CHARACTERISTIC
/begin CHARACTERISTIC FPnd_envtech_comm "FPrm_pending(267)" VALUE 0x00164B82 /* @ECU_Address@FPrm_pending@0x021BE216@ */ ECIPP_ALIGNMENT_UWORD 65535 Compu_IDENTITY 0 65535 PHYS_UNIT "Bit Mask" /end CHARACTERISTIC
/begin CHARACTERISTIC FPnd_envtech_general "FPrm_pending(644)" VALUE 0x00164E74 /* @ECU_Address@FPrm_pending@0x021BE508@ */ ECIPP_ALIGNMENT_UWORD 65535 Compu_IDENTITY 0 65535 PHYS_UNIT "Bit Mask" /end CHARACTERISTIC
/begin CHARACTERISTIC FPnd_envtech_RH_inv "FPrm_pending(643)" VALUE 0x00164E72 /* @ECU_Address@FPrm_pending@0x021BE506@ */ ECIPP_ALIGNMENT_UWORD 65535 Compu_IDENTITY 0 65535 PHYS_UNIT "Bit Mask" /end CHARACTERISTIC
/begin CHARACTERISTIC FPnd_envtech_RH_uns "FPrm_pending(645)" VALUE 0x00164E76 /* @ECU_Address@FPrm_pending@0x021BE50A@ */ ECIPP_ALIGNMENT_UWORD 65535 Compu_IDENTITY 0 65535 PHYS_UNIT "Bit Mask" /end CHARACTERISTIC
/begin CHARACTERISTIC FPnd_ERCV_speed_OOR "FPrm_pending(680)" VALUE 0x00164EBC /* @ECU_Address@FPrm_pending@0x021BE550@ */ ECIPP_ALIGNMENT_UWORD 65535 Compu_IDENTITY 0 65535 PHYS_UNIT "Bit Mask" /end CHARACTERISTIC
/begin CHARACTERISTIC FPnd_ERWT1_HiExp1 "FPrm_pending(187)" VALUE 0x00164AE2 /* @ECU_Address@FPrm_pending@0x021BE176@ */ ECIPP_ALIGNMENT_UWORD 65535 Compu_IDENTITY 0 65535 PHYS_UNIT "Bit Mask" /end CHARACTERISTIC
/begin CHARACTERISTIC FPnd_ERWT1_HiExp2 "FPrm_pending(188)" VALUE 0x00164AE4 /* @ECU_Address@FPrm_pending@0x021BE178@ */ ECIPP_ALIGNMENT_UWORD 65535 Compu_IDENTITY 0 65535 PHYS_UNIT "Bit Mask" /end CHARACTERISTIC
/begin CHARACTERISTIC FPnd_ERWT1_maxv "FPrm_pending(185)" VALUE 0x00164ADE /* @ECU_Address@FPrm_pending@0x021BE172@ */ ECIPP_ALIGNMENT_UWORD 65535 Compu_IDENTITY 0 65535 PHYS_UNIT "Bit Mask" /end CHARACTERISTIC
/begin CHARACTERISTIC FPnd_ERWT1_minv "FPrm_pending(186)" VALUE 0x00164AE0 /* @ECU_Address@FPrm_pending@0x021BE174@ */ ECIPP_ALIGNMENT_UWORD 65535 Compu_IDENTITY 0 65535 PHYS_UNIT "Bit Mask" /end CHARACTERISTIC
/begin CHARACTERISTIC FPnd_F1OOR_F2IVS "FPrm_pending(138)" VALUE 0x00164A80 /* @ECU_Address@FPrm_pending@0x021BE114@ */ ECIPP_ALIGNMENT_UWORD 65535 Compu_IDENTITY 0 65535 PHYS_UNIT "Bit Mask" /end CHARACTERISTIC
/begin CHARACTERISTIC FPnd_F2OOR_F1IVS "FPrm_pending(139)" VALUE 0x00164A82 /* @ECU_Address@FPrm_pending@0x021BE116@ */ ECIPP_ALIGNMENT_UWORD 65535 Compu_IDENTITY 0 65535 PHYS_UNIT "Bit Mask" /end CHARACTERISTIC
/begin CHARACTERISTIC FPnd_FCoolH2O_lo "FPrm_pending(402)" VALUE 0x00164C90 /* @ECU_Address@FPrm_pending@0x021BE324@ */ ECIPP_ALIGNMENT_UWORD 65535 Compu_IDENTITY 0 65535 PHYS_UNIT "Bit Mask" /end CHARACTERISTIC
/begin CHARACTERISTIC FPnd_FIMP_pct_high "FPrm_pending(204)" VALUE 0x00164B04 /* @ECU_Address@FPrm_pending@0x021BE198@ */ ECIPP_ALIGNMENT_UWORD 65535 Compu_IDENTITY 0 65535 PHYS_UNIT "Bit Mask" /end CHARACTERISTIC
/begin CHARACTERISTIC FPnd_FIP_LoExp "FPrm_pending(525)" VALUE 0x00164D86 /* @ECU_Address@FPrm_pending@0x021BE41A@ */ ECIPP_ALIGNMENT_UWORD 65535 Compu_IDENTITY 0 65535 PHYS_UNIT "Bit Mask" /end CHARACTERISTIC
/begin CHARACTERISTIC FPnd_flash_fail "FPrm_pending(69)" VALUE 0x001649F6 /* @ECU_Address@FPrm_pending@0x021BE08A@ */ ECIPP_ALIGNMENT_UWORD 65535 Compu_IDENTITY 0 65535 PHYS_UNIT "Bit Mask" /end CHARACTERISTIC
/begin CHARACTERISTIC FPnd_FP_high "FPrm_pending(212)" VALUE 0x00164B14 /* @ECU_Address@FPrm_pending@0x021BE1A8@ */ ECIPP_ALIGNMENT_UWORD 65535 Compu_IDENTITY 0 65535 PHYS_UNIT "Bit Mask" /end CHARACTERISTIC
/begin CHARACTERISTIC FPnd_FP_low "FPrm_pending(213)" VALUE 0x00164B16 /* @ECU_Address@FPrm_pending@0x021BE1AA@ */ ECIPP_ALIGNMENT_UWORD 65535 Compu_IDENTITY 0 65535 PHYS_UNIT "Bit Mask" /end CHARACTERISTIC
/begin CHARACTERISTIC FPnd_FP_maxv "FPrm_pending(87)" VALUE 0x00164A1A /* @ECU_Address@FPrm_pending@0x021BE0AE@ */ ECIPP_ALIGNMENT_UWORD 65535 Compu_IDENTITY 0 65535 PHYS_UNIT "Bit Mask" /end CHARACTERISTIC
/begin CHARACTERISTIC FPnd_FP_minv "FPrm_pending(88)" VALUE 0x00164A1C /* @ECU_Address@FPrm_pending@0x021BE0B0@ */ ECIPP_ALIGNMENT_UWORD 65535 Compu_IDENTITY 0 65535 PHYS_UNIT "Bit Mask" /end CHARACTERISTIC
/begin CHARACTERISTIC FPnd_FP2_high "FPrm_pending(360)" VALUE 0x00164C3C /* @ECU_Address@FPrm_pending@0x021BE2D0@ */ ECIPP_ALIGNMENT_UWORD 65535 Compu_IDENTITY 0 65535 PHYS_UNIT "Bit Mask" /end CHARACTERISTIC
/begin CHARACTERISTIC FPnd_FP2_low "FPrm_pending(361)" VALUE 0x00164C3E /* @ECU_Address@FPrm_pending@0x021BE2D2@ */ ECIPP_ALIGNMENT_UWORD 65535 Compu_IDENTITY 0 65535 PHYS_UNIT "Bit Mask" /end CHARACTERISTIC
/begin CHARACTERISTIC FPnd_FP2_maxv "FPrm_pending(358)" VALUE 0x00164C38 /* @ECU_Address@FPrm_pending@0x021BE2CC@ */ ECIPP_ALIGNMENT_UWORD 65535 Compu_IDENTITY 0 65535 PHYS_UNIT "Bit Mask" /end CHARACTERISTIC
/begin CHARACTERISTIC FPnd_FP2_minv "FPrm_pending(359)" VALUE 0x00164C3A /* @ECU_Address@FPrm_pending@0x021BE2CE@ */ ECIPP_ALIGNMENT_UWORD 65535 Compu_IDENTITY 0 65535 PHYS_UNIT "Bit Mask" /end CHARACTERISTIC
/begin CHARACTERISTIC FPnd_FPD_off_hi "FPrm_pending(58)" VALUE 0x001649E0 /* @ECU_Address@FPrm_pending@0x021BE074@ */ ECIPP_ALIGNMENT_UWORD 65535 Compu_IDENTITY 0 65535 PHYS_UNIT "Bit Mask" /end CHARACTERISTIC
/begin CHARACTERISTIC FPnd_FPD_on_lo "FPrm_pending(57)" VALUE 0x001649DE /* @ECU_Address@FPrm_pending@0x021BE072@ */ ECIPP_ALIGNMENT_UWORD 65535 Compu_IDENTITY 0 65535 PHYS_UNIT "Bit Mask" /end CHARACTERISTIC
/begin CHARACTERISTIC FPnd_FPlo_derate_actv "FPrm_pending(634)" VALUE 0x00164E60 /* @ECU_Address@FPrm_pending@0x021BE4F4@ */ ECIPP_ALIGNMENT_UWORD 65535 Compu_IDENTITY 0 65535 PHYS_UNIT "Bit Mask" /end CHARACTERISTIC
/begin CHARACTERISTIC FPnd_FPlo_derate_excess "FPrm_pending(637)" VALUE 0x00164E66 /* @ECU_Address@FPrm_pending@0x021BE4FA@ */ ECIPP_ALIGNMENT_UWORD 65535 Compu_IDENTITY 0 65535 PHYS_UNIT "Bit Mask" /end CHARACTERISTIC
/begin CHARACTERISTIC FPnd_FPP_NeutLock_fail "FPrm_pending(488)" VALUE 0x00164D3C /* @ECU_Address@FPrm_pending@0x021BE3D0@ */ ECIPP_ALIGNMENT_UWORD 65535 Compu_IDENTITY 0 65535 PHYS_UNIT "Bit Mask" /end CHARACTERISTIC
/begin CHARACTERISTIC FPnd_FPP1_IVS_max "FPrm_pending(30)" VALUE 0x001649A8 /* @ECU_Address@FPrm_pending@0x021BE03C@ */ ECIPP_ALIGNMENT_UWORD 65535 Compu_IDENTITY 0 65535 PHYS_UNIT "Bit Mask" /end CHARACTERISTIC
/begin CHARACTERISTIC FPnd_FPP1_IVS_min "FPrm_pending(31)" VALUE 0x001649AA /* @ECU_Address@FPrm_pending@0x021BE03E@ */ ECIPP_ALIGNMENT_UWORD 65535 Compu_IDENTITY 0 65535 PHYS_UNIT "Bit Mask" /end CHARACTERISTIC
/begin CHARACTERISTIC FPnd_FPP1_max "FPrm_pending(26)" VALUE 0x001649A0 /* @ECU_Address@FPrm_pending@0x021BE034@ */ ECIPP_ALIGNMENT_UWORD 65535 Compu_IDENTITY 0 65535 PHYS_UNIT "Bit Mask" /end CHARACTERISTIC
/begin CHARACTERISTIC FPnd_FPP1_min "FPrm_pending(27)" VALUE 0x001649A2 /* @ECU_Address@FPrm_pending@0x021BE036@ */ ECIPP_ALIGNMENT_UWORD 65535 Compu_IDENTITY 0 65535 PHYS_UNIT "Bit Mask" /end CHARACTERISTIC
/begin CHARACTERISTIC FPnd_FPP12_IVS_max "FPrm_pending(135)" VALUE 0x00164A7A /* @ECU_Address@FPrm_pending@0x021BE10E@ */ ECIPP_ALIGNMENT_UWORD 65535 Compu_IDENTITY 0 65535 PHYS_UNIT "Bit Mask" /end CHARACTERISTIC
/begin CHARACTERISTIC FPnd_FPP12_IVS_min "FPrm_pending(136)" VALUE 0x00164A7C /* @ECU_Address@FPrm_pending@0x021BE110@ */ ECIPP_ALIGNMENT_UWORD 65535 Compu_IDENTITY 0 65535 PHYS_UNIT "Bit Mask" /end CHARACTERISTIC
/begin CHARACTERISTIC FPnd_FPP12_OOR "FPrm_pending(137)" VALUE 0x00164A7E /* @ECU_Address@FPrm_pending@0x021BE112@ */ ECIPP_ALIGNMENT_UWORD 65535 Compu_IDENTITY 0 65535 PHYS_UNIT "Bit Mask" /end CHARACTERISTIC
/begin CHARACTERISTIC FPnd_FPP12IVS_TSC1 "FPrm_pending(564)" VALUE 0x00164DD4 /* @ECU_Address@FPrm_pending@0x021BE468@ */ ECIPP_ALIGNMENT_UWORD 65535 Compu_IDENTITY 0 65535 PHYS_UNIT "Bit Mask" /end CHARACTERISTIC
/begin CHARACTERISTIC FPnd_FPP12MM_IVSMM "FPrm_pending(140)" VALUE 0x00164A84 /* @ECU_Address@FPrm_pending@0x021BE118@ */ ECIPP_ALIGNMENT_UWORD 65535 Compu_IDENTITY 0 65535 PHYS_UNIT "Bit Mask" /end CHARACTERISTIC
/begin CHARACTERISTIC FPnd_FPP12pct_hi "FPrm_pending(34)" VALUE 0x001649B0 /* @ECU_Address@FPrm_pending@0x021BE044@ */ ECIPP_ALIGNMENT_UWORD 65535 Compu_IDENTITY 0 65535 PHYS_UNIT "Bit Mask" /end CHARACTERISTIC
/begin CHARACTERISTIC FPnd_FPP12pct_lo "FPrm_pending(35)" VALUE 0x001649B2 /* @ECU_Address@FPrm_pending@0x021BE046@ */ ECIPP_ALIGNMENT_UWORD 65535 Compu_IDENTITY 0 65535 PHYS_UNIT "Bit Mask" /end CHARACTERISTIC
/begin CHARACTERISTIC FPsvr_EGR_slowdec "FPrm_severity(490)" VALUE 0x00165FC8 /* @ECU_Address@FPrm_severity@0x024B31EA@ */ ECIPP_ALIGNMENT_UBYTE 255 Compu_IDENTITY 0 255 PHYS_UNIT "Severity+Class" /end CHARACTERISTIC
/begin CHARACTERISTIC FPsvr_EGR_slowinc "FPrm_severity(489)" VALUE 0x00165FC7 /* @ECU_Address@FPrm_severity@0x024B31E9@ */ ECIPP_ALIGNMENT_UBYTE 255 Compu_IDENTITY 0 255 PHYS_UNIT "Severity+Class" /end CHARACTERISTIC
/begin CHARACTERISTIC FPsvr_EGR_UEGOdP_hi "FPrm_severity(493)" VALUE 0x00165FCB /* @ECU_Address@FPrm_severity@0x024B31ED@ */ ECIPP_ALIGNMENT_UBYTE 255 Compu_IDENTITY 0 255 PHYS_UNIT "Severity+Class" /end CHARACTERISTIC
/begin CHARACTERISTIC FPsvr_EGR_UEGOdP_lo "FPrm_severity(494)" VALUE 0x00165FCC /* @ECU_Address@FPrm_severity@0x024B31EE@ */ ECIPP_ALIGNMENT_UBYTE 255 Compu_IDENTITY 0 255 PHYS_UNIT "Severity+Class" /end CHARACTERISTIC
/begin CHARACTERISTIC FPsvr_EGR_vlv_DC_lim "FPrm_severity(573)" VALUE 0x0016601B /* @ECU_Address@FPrm_severity@0x024B323D@ */ ECIPP_ALIGNMENT_UBYTE 255 Compu_IDENTITY 0 255 PHYS_UNIT "Severity+Class" /end CHARACTERISTIC
/begin CHARACTERISTIC FPsvr_EGR_vlv_stuck "FPrm_severity(660)" VALUE 0x00166072 /* @ECU_Address@FPrm_severity@0x024B3294@ */ ECIPP_ALIGNMENT_UBYTE 255 Compu_IDENTITY 0 255 PHYS_UNIT "Severity+Class" /end CHARACTERISTIC
/begin CHARACTERISTIC FPsvr_EGR_vlv_temp_hi "FPrm_severity(574)" VALUE 0x0016601C /* @ECU_Address@FPrm_severity@0x024B323E@ */ ECIPP_ALIGNMENT_UBYTE 255 Compu_IDENTITY 0 255 PHYS_UNIT "Severity+Class" /end CHARACTERISTIC
/begin CHARACTERISTIC FPsvr_EGR_vlvCAN_commlost "FPrm_severity(497)" VALUE 0x00165FCF /* @ECU_Address@FPrm_severity@0x024B31F1@ */ ECIPP_ALIGNMENT_UBYTE 255 Compu_IDENTITY 0 255 PHYS_UNIT "Severity+Class" /end CHARACTERISTIC
/begin CHARACTERISTIC FPsvr_EGR_vlvCAN_lowfunc "FPrm_severity(499)" VALUE 0x00165FD1 /* @ECU_Address@FPrm_severity@0x024B31F3@ */ ECIPP_ALIGNMENT_UBYTE 255 Compu_IDENTITY 0 255 PHYS_UNIT "Severity+Class" /end CHARACTERISTIC
/begin CHARACTERISTIC FPsvr_EGR_vlvCAN_nofunc "FPrm_severity(498)" VALUE 0x00165FD0 /* @ECU_Address@FPrm_severity@0x024B31F2@ */ ECIPP_ALIGNMENT_UBYTE 255 Compu_IDENTITY 0 255 PHYS_UNIT "Severity+Class" /end CHARACTERISTIC
/begin CHARACTERISTIC FPsvr_EGRdP_HiExp "FPrm_severity(582)" VALUE 0x00166024 /* @ECU_Address@FPrm_severity@0x024B3246@ */ ECIPP_ALIGNMENT_UBYTE 255 Compu_IDENTITY 0 255 PHYS_UNIT "Severity+Class" /end CHARACTERISTIC
/begin CHARACTERISTIC FPsvr_EGRdP_LoExp "FPrm_severity(581)" VALUE 0x00166023 /* @ECU_Address@FPrm_severity@0x024B3245@ */ ECIPP_ALIGNMENT_UBYTE 255 Compu_IDENTITY 0 255 PHYS_UNIT "Severity+Class" /end CHARACTERISTIC
/begin CHARACTERISTIC FPsvr_EGRdP_maxv "FPrm_severity(579)" VALUE 0x00166021 /* @ECU_Address@FPrm_severity@0x024B3243@ */ ECIPP_ALIGNMENT_UBYTE 255 Compu_IDENTITY 0 255 PHYS_UNIT "Severity+Class" /end CHARACTERISTIC
/begin CHARACTERISTIC FPsvr_EGRdP_minv "FPrm_severity(580)" VALUE 0x00166022 /* @ECU_Address@FPrm_severity@0x024B3244@ */ ECIPP_ALIGNMENT_UBYTE 255 Compu_IDENTITY 0 255 PHYS_UNIT "Severity+Class" /end CHARACTERISTIC
/begin CHARACTERISTIC FPsvr_EGRflow_HiExp "FPrm_severity(451)" VALUE 0x00165FA1 /* @ECU_Address@FPrm_severity@0x024B31C3@ */ ECIPP_ALIGNMENT_UBYTE 255 Compu_IDENTITY 0 255 PHYS_UNIT "Severity+Class" /end CHARACTERISTIC
/begin CHARACTERISTIC FPsvr_EGRflow_LoExp "FPrm_severity(450)" VALUE 0x00165FA0 /* @ECU_Address@FPrm_severity@0x024B31C2@ */ ECIPP_ALIGNMENT_UBYTE 255 Compu_IDENTITY 0 255 PHYS_UNIT "Severity+Class" /end CHARACTERISTIC
/begin CHARACTERISTIC FPsvr_EGRflow_LoExp2 "FPrm_severity(514)" VALUE 0x00165FE0 /* @ECU_Address@FPrm_severity@0x024B3202@ */ ECIPP_ALIGNMENT_UBYTE 255 Compu_IDENTITY 0 255 PHYS_UNIT "Severity+Class" /end CHARACTERISTIC
/begin CHARACTERISTIC FPsvr_EGRHP_maxv "FPrm_severity(583)" VALUE 0x00166025 /* @ECU_Address@FPrm_severity@0x024B3247@ */ ECIPP_ALIGNMENT_UBYTE 255 Compu_IDENTITY 0 255 PHYS_UNIT "Severity+Class" /end CHARACTERISTIC
/begin CHARACTERISTIC FPsvr_EGRHP_minv "FPrm_severity(584)" VALUE 0x00166026 /* @ECU_Address@FPrm_severity@0x024B3248@ */ ECIPP_ALIGNMENT_UBYTE 255 Compu_IDENTITY 0 255 PHYS_UNIT "Severity+Class" /end CHARACTERISTIC
/begin CHARACTERISTIC FPsvr_EGRHP_OOR "FPrm_severity(585)" VALUE 0x00166027 /* @ECU_Address@FPrm_severity@0x024B3249@ */ ECIPP_ALIGNMENT_UBYTE 255 Compu_IDENTITY 0 255 PHYS_UNIT "Severity+Class" /end CHARACTERISTIC
/begin CHARACTERISTIC FPsvr_EGRO_postlk "FPrm_severity(628)" VALUE 0x00166052 /* @ECU_Address@FPrm_severity@0x024B3274@ */ ECIPP_ALIGNMENT_UBYTE 255 Compu_IDENTITY 0 255 PHYS_UNIT "Severity+Class" /end CHARACTERISTIC
/begin CHARACTERISTIC FPsvr_EGRT_hi "FPrm_severity(524)" VALUE 0x00165FEA /* @ECU_Address@FPrm_severity@0x024B320C@ */ ECIPP_ALIGNMENT_UBYTE 255 Compu_IDENTITY 0 255 PHYS_UNIT "Severity+Class" /end CHARACTERISTIC
/begin CHARACTERISTIC FPsvr_EGRT_maxv "FPrm_severity(522)" VALUE 0x00165FE8 /* @ECU_Address@FPrm_severity@0x024B320A@ */ ECIPP_ALIGNMENT_UBYTE 255 Compu_IDENTITY 0 255 PHYS_UNIT "Severity+Class" /end CHARACTERISTIC
/begin CHARACTERISTIC FPsvr_EGRT_minv "FPrm_severity(523)" VALUE 0x00165FE9 /* @ECU_Address@FPrm_severity@0x024B320B@ */ ECIPP_ALIGNMENT_UBYTE 255 Compu_IDENTITY 0 255 PHYS_UNIT "Severity+Class" /end CHARACTERISTIC
/begin CHARACTERISTIC FPsvr_EGT_dig_Hi "FPrm_severity(145)" VALUE 0x00165E6F /* @ECU_Address@FPrm_severity@0x024B3091@ */ ECIPP_ALIGNMENT_UBYTE 255 Compu_IDENTITY 0 255 PHYS_UNIT "Severity+Class" /end CHARACTERISTIC
/begin CHARACTERISTIC FPsvr_EGT_maxv "FPrm_severity(635)" VALUE 0x00166059 /* @ECU_Address@FPrm_severity@0x024B327B@ */ ECIPP_ALIGNMENT_UBYTE 255 Compu_IDENTITY 0 255 PHYS_UNIT "Severity+Class" /end CHARACTERISTIC
/begin CHARACTERISTIC FPsvr_EGT_minv "FPrm_severity(636)" VALUE 0x0016605A /* @ECU_Address@FPrm_severity@0x024B327C@ */ ECIPP_ALIGNMENT_UBYTE 255 Compu_IDENTITY 0 255 PHYS_UNIT "Severity+Class" /end CHARACTERISTIC
/begin CHARACTERISTIC FPsvr_EMWT1_HiExp1 "FPrm_severity(179)" VALUE 0x00165E91 /* @ECU_Address@FPrm_severity@0x024B30B3@ */ ECIPP_ALIGNMENT_UBYTE 255 Compu_IDENTITY 0 255 PHYS_UNIT "Severity+Class" /end CHARACTERISTIC
/begin CHARACTERISTIC FPsvr_EMWT1_HiExp2 "FPrm_severity(180)" VALUE 0x00165E92 /* @ECU_Address@FPrm_severity@0x024B30B4@ */ ECIPP_ALIGNMENT_UBYTE 255 Compu_IDENTITY 0 255 PHYS_UNIT "Severity+Class" /end CHARACTERISTIC
/begin CHARACTERISTIC FPsvr_EMWT1_maxv "FPrm_severity(177)" VALUE 0x00165E8F /* @ECU_Address@FPrm_severity@0x024B30B1@ */ ECIPP_ALIGNMENT_UBYTE 255 Compu_IDENTITY 0 255 PHYS_UNIT "Severity+Class" /end CHARACTERISTIC
/begin CHARACTERISTIC FPsvr_EMWT1_minv "FPrm_severity(178)" VALUE 0x00165E90 /* @ECU_Address@FPrm_severity@0x024B30B2@ */ ECIPP_ALIGNMENT_UBYTE 255 Compu_IDENTITY 0 255 PHYS_UNIT "Severity+Class" /end CHARACTERISTIC
/begin CHARACTERISTIC FPsvr_envtech_AAT_inv "FPrm_severity(641)" VALUE 0x0016605F /* @ECU_Address@FPrm_severity@0x024B3281@ */ ECIPP_ALIGNMENT_UBYTE 255 Compu_IDENTITY 0 255 PHYS_UNIT "Severity+Class" /end CHARACTERISTIC
/begin CHARACTERISTIC FPsvr_envtech_BP_inv "FPrm_severity(642)" VALUE 0x00166060 /* @ECU_Address@FPrm_severity@0x024B3282@ */ ECIPP_ALIGNMENT_UBYTE 255 Compu_IDENTITY 0 255 PHYS_UNIT "Severity+Class" /end CHARACTERISTIC
/begin CHARACTERISTIC FPsvr_envtech_comm "FPrm_severity(267)" VALUE 0x00165EE9 /* @ECU_Address@FPrm_severity@0x024B310B@ */ ECIPP_ALIGNMENT_UBYTE 255 Compu_IDENTITY 0 255 PHYS_UNIT "Severity+Class" /end CHARACTERISTIC
/begin CHARACTERISTIC FPsvr_envtech_general "FPrm_severity(644)" VALUE 0x00166062 /* @ECU_Address@FPrm_severity@0x024B3284@ */ ECIPP_ALIGNMENT_UBYTE 255 Compu_IDENTITY 0 255 PHYS_UNIT "Severity+Class" /end CHARACTERISTIC
/begin CHARACTERISTIC FPsvr_envtech_RH_inv "FPrm_severity(643)" VALUE 0x00166061 /* @ECU_Address@FPrm_severity@0x024B3283@ */ ECIPP_ALIGNMENT_UBYTE 255 Compu_IDENTITY 0 255 PHYS_UNIT "Severity+Class" /end CHARACTERISTIC
/begin CHARACTERISTIC FPsvr_envtech_RH_uns "FPrm_severity(645)" VALUE 0x00166063 /* @ECU_Address@FPrm_severity@0x024B3285@ */ ECIPP_ALIGNMENT_UBYTE 255 Compu_IDENTITY 0 255 PHYS_UNIT "Severity+Class" /end CHARACTERISTIC
/begin CHARACTERISTIC FPsvr_ERCV_speed_OOR "FPrm_severity(680)" VALUE 0x00166086 /* @ECU_Address@FPrm_severity@0x024B32A8@ */ ECIPP_ALIGNMENT_UBYTE 255 Compu_IDENTITY 0 255 PHYS_UNIT "Severity+Class" /end CHARACTERISTIC
/begin CHARACTERISTIC FPsvr_ERWT1_HiExp1 "FPrm_severity(187)" VALUE 0x00165E99 /* @ECU_Address@FPrm_severity@0x024B30BB@ */ ECIPP_ALIGNMENT_UBYTE 255 Compu_IDENTITY 0 255 PHYS_UNIT "Severity+Class" /end CHARACTERISTIC
/begin CHARACTERISTIC FPsvr_ERWT1_HiExp2 "FPrm_severity(188)" VALUE 0x00165E9A /* @ECU_Address@FPrm_severity@0x024B30BC@ */ ECIPP_ALIGNMENT_UBYTE 255 Compu_IDENTITY 0 255 PHYS_UNIT "Severity+Class" /end CHARACTERISTIC
/begin CHARACTERISTIC FPsvr_ERWT1_maxv "FPrm_severity(185)" VALUE 0x00165E97 /* @ECU_Address@FPrm_severity@0x024B30B9@ */ ECIPP_ALIGNMENT_UBYTE 255 Compu_IDENTITY 0 255 PHYS_UNIT "Severity+Class" /end CHARACTERISTIC
/begin CHARACTERISTIC FPsvr_ERWT1_minv "FPrm_severity(186)" VALUE 0x00165E98 /* @ECU_Address@FPrm_severity@0x024B30BA@ */ ECIPP_ALIGNMENT_UBYTE 255 Compu_IDENTITY 0 255 PHYS_UNIT "Severity+Class" /end CHARACTERISTIC
/begin CHARACTERISTIC FPsvr_F1OOR_F2IVS "FPrm_severity(138)" VALUE 0x00165E68 /* @ECU_Address@FPrm_severity@0x024B308A@ */ ECIPP_ALIGNMENT_UBYTE 255 Compu_IDENTITY 0 255 PHYS_UNIT "Severity+Class" /end CHARACTERISTIC
/begin CHARACTERISTIC FPsvr_F2OOR_F1IVS "FPrm_severity(139)" VALUE 0x00165E69 /* @ECU_Address@FPrm_severity@0x024B308B@ */ ECIPP_ALIGNMENT_UBYTE 255 Compu_IDENTITY 0 255 PHYS_UNIT "Severity+Class" /end CHARACTERISTIC
/begin CHARACTERISTIC FPsvr_FCoolH2O_lo "FPrm_severity(402)" VALUE 0x00165F70 /* @ECU_Address@FPrm_severity@0x024B3192@ */ ECIPP_ALIGNMENT_UBYTE 255 Compu_IDENTITY 0 255 PHYS_UNIT "Severity+Class" /end CHARACTERISTIC
/begin CHARACTERISTIC FPsvr_FIMP_pct_high "FPrm_severity(204)" VALUE 0x00165EAA /* @ECU_Address@FPrm_severity@0x024B30CC@ */ ECIPP_ALIGNMENT_UBYTE 255 Compu_IDENTITY 0 255 PHYS_UNIT "Severity+Class" /end CHARACTERISTIC
/begin CHARACTERISTIC FPsvr_FIP_LoExp "FPrm_severity(525)" VALUE 0x00165FEB /* @ECU_Address@FPrm_severity@0x024B320D@ */ ECIPP_ALIGNMENT_UBYTE 255 Compu_IDENTITY 0 255 PHYS_UNIT "Severity+Class" /end CHARACTERISTIC
/begin CHARACTERISTIC FPsvr_flash_fail "FPrm_severity(69)" VALUE 0x00165E23 /* @ECU_Address@FPrm_severity@0x024B3045@ */ ECIPP_ALIGNMENT_UBYTE 255 Compu_IDENTITY 0 255 PHYS_UNIT "Severity+Class" /end CHARACTERISTIC
/begin CHARACTERISTIC FPsvr_FP_high "FPrm_severity(212)" VALUE 0x00165EB2 /* @ECU_Address@FPrm_severity@0x024B30D4@ */ ECIPP_ALIGNMENT_UBYTE 255 Compu_IDENTITY 0 255 PHYS_UNIT "Severity+Class" /end CHARACTERISTIC
/begin CHARACTERISTIC FPsvr_FP_low "FPrm_severity(213)" VALUE 0x00165EB3 /* @ECU_Address@FPrm_severity@0x024B30D5@ */ ECIPP_ALIGNMENT_UBYTE 255 Compu_IDENTITY 0 255 PHYS_UNIT "Severity+Class" /end CHARACTERISTIC
/begin CHARACTERISTIC FPsvr_FP_maxv "FPrm_severity(87)" VALUE 0x00165E35 /* @ECU_Address@FPrm_severity@0x024B3057@ */ ECIPP_ALIGNMENT_UBYTE 255 Compu_IDENTITY 0 255 PHYS_UNIT "Severity+Class" /end CHARACTERISTIC
/begin CHARACTERISTIC FPsvr_FP_minv "FPrm_severity(88)" VALUE 0x00165E36 /* @ECU_Address@FPrm_severity@0x024B3058@ */ ECIPP_ALIGNMENT_UBYTE 255 Compu_IDENTITY 0 255 PHYS_UNIT "Severity+Class" /end CHARACTERISTIC
/begin CHARACTERISTIC FPsvr_FP2_high "FPrm_severity(360)" VALUE 0x00165F46 /* @ECU_Address@FPrm_severity@0x024B3168@ */ ECIPP_ALIGNMENT_UBYTE 255 Compu_IDENTITY 0 255 PHYS_UNIT "Severity+Class" /end CHARACTERISTIC
/begin CHARACTERISTIC FPsvr_FP2_low "FPrm_severity(361)" VALUE 0x00165F47 /* @ECU_Address@FPrm_severity@0x024B3169@ */ ECIPP_ALIGNMENT_UBYTE 255 Compu_IDENTITY 0 255 PHYS_UNIT "Severity+Class" /end CHARACTERISTIC
/begin CHARACTERISTIC FPsvr_FP2_maxv "FPrm_severity(358)" VALUE 0x00165F44 /* @ECU_Address@FPrm_severity@0x024B3166@ */ ECIPP_ALIGNMENT_UBYTE 255 Compu_IDENTITY 0 255 PHYS_UNIT "Severity+Class" /end CHARACTERISTIC
/begin CHARACTERISTIC FPsvr_FP2_minv "FPrm_severity(359)" VALUE 0x00165F45 /* @ECU_Address@FPrm_severity@0x024B3167@ */ ECIPP_ALIGNMENT_UBYTE 255 Compu_IDENTITY 0 255 PHYS_UNIT "Severity+Class" /end CHARACTERISTIC
/begin CHARACTERISTIC FPsvr_FPD_off_hi "FPrm_severity(58)" VALUE 0x00165E18 /* @ECU_Address@FPrm_severity@0x024B303A@ */ ECIPP_ALIGNMENT_UBYTE 255 Compu_IDENTITY 0 255 PHYS_UNIT "Severity+Class" /end CHARACTERISTIC
/begin CHARACTERISTIC FPsvr_FPD_on_lo "FPrm_severity(57)" VALUE 0x00165E17 /* @ECU_Address@FPrm_severity@0x024B3039@ */ ECIPP_ALIGNMENT_UBYTE 255 Compu_IDENTITY 0 255 PHYS_UNIT "Severity+Class" /end CHARACTERISTIC
/begin CHARACTERISTIC FPsvr_FPlo_derate_actv "FPrm_severity(634)" VALUE 0x00166058 /* @ECU_Address@FPrm_severity@0x024B327A@ */ ECIPP_ALIGNMENT_UBYTE 255 Compu_IDENTITY 0 255 PHYS_UNIT "Severity+Class" /end CHARACTERISTIC
/begin CHARACTERISTIC FPsvr_FPlo_derate_excess "FPrm_severity(637)" VALUE 0x0016605B /* @ECU_Address@FPrm_severity@0x024B327D@ */ ECIPP_ALIGNMENT_UBYTE 255 Compu_IDENTITY 0 255 PHYS_UNIT "Severity+Class" /end CHARACTERISTIC
/begin CHARACTERISTIC FPsvr_FPP_NeutLock_fail "FPrm_severity(488)" VALUE 0x00165FC6 /* @ECU_Address@FPrm_severity@0x024B31E8@ */ ECIPP_ALIGNMENT_UBYTE 255 Compu_IDENTITY 0 255 PHYS_UNIT "Severity+Class" /end CHARACTERISTIC
/begin CHARACTERISTIC FPsvr_FPP1_IVS_max "FPrm_severity(30)" VALUE 0x00165DFC /* @ECU_Address@FPrm_severity@0x024B301E@ */ ECIPP_ALIGNMENT_UBYTE 255 Compu_IDENTITY 0 255 PHYS_UNIT "Severity+Class" /end CHARACTERISTIC
/begin CHARACTERISTIC FPsvr_FPP1_IVS_min "FPrm_severity(31)" VALUE 0x00165DFD /* @ECU_Address@FPrm_severity@0x024B301F@ */ ECIPP_ALIGNMENT_UBYTE 255 Compu_IDENTITY 0 255 PHYS_UNIT "Severity+Class" /end CHARACTERISTIC
/begin CHARACTERISTIC FPsvr_FPP1_max "FPrm_severity(26)" VALUE 0x00165DF8 /* @ECU_Address@FPrm_severity@0x024B301A@ */ ECIPP_ALIGNMENT_UBYTE 255 Compu_IDENTITY 0 255 PHYS_UNIT "Severity+Class" /end CHARACTERISTIC
/begin CHARACTERISTIC FPsvr_FPP1_min "FPrm_severity(27)" VALUE 0x00165DF9 /* @ECU_Address@FPrm_severity@0x024B301B@ */ ECIPP_ALIGNMENT_UBYTE 255 Compu_IDENTITY 0 255 PHYS_UNIT "Severity+Class" /end CHARACTERISTIC
/begin CHARACTERISTIC FPsvr_FPP12_IVS_max "FPrm_severity(135)" VALUE 0x00165E65 /* @ECU_Address@FPrm_severity@0x024B3087@ */ ECIPP_ALIGNMENT_UBYTE 255 Compu_IDENTITY 0 255 PHYS_UNIT "Severity+Class" /end CHARACTERISTIC
/begin CHARACTERISTIC FPsvr_FPP12_IVS_min "FPrm_severity(136)" VALUE 0x00165E66 /* @ECU_Address@FPrm_severity@0x024B3088@ */ ECIPP_ALIGNMENT_UBYTE 255 Compu_IDENTITY 0 255 PHYS_UNIT "Severity+Class" /end CHARACTERISTIC
/begin CHARACTERISTIC FPsvr_FPP12_OOR "FPrm_severity(137)" VALUE 0x00165E67 /* @ECU_Address@FPrm_severity@0x024B3089@ */ ECIPP_ALIGNMENT_UBYTE 255 Compu_IDENTITY 0 255 PHYS_UNIT "Severity+Class" /end CHARACTERISTIC
/begin CHARACTERISTIC FPsvr_FPP12IVS_TSC1 "FPrm_severity(564)" VALUE 0x00166012 /* @ECU_Address@FPrm_severity@0x024B3234@ */ ECIPP_ALIGNMENT_UBYTE 255 Compu_IDENTITY 0 255 PHYS_UNIT "Severity+Class" /end CHARACTERISTIC
/begin CHARACTERISTIC FPsvr_FPP12MM_IVSMM "FPrm_severity(140)" VALUE 0x00165E6A /* @ECU_Address@FPrm_severity@0x024B308C@ */ ECIPP_ALIGNMENT_UBYTE 255 Compu_IDENTITY 0 255 PHYS_UNIT "Severity+Class" /end CHARACTERISTIC
/begin CHARACTERISTIC FPsvr_FPP12pct_hi "FPrm_severity(34)" VALUE 0x00165E00 /* @ECU_Address@FPrm_severity@0x024B3022@ */ ECIPP_ALIGNMENT_UBYTE 255 Compu_IDENTITY 0 255 PHYS_UNIT "Severity+Class" /end CHARACTERISTIC
/begin CHARACTERISTIC FPsvr_FPP12pct_lo "FPrm_severity(35)" VALUE 0x00165E01 /* @ECU_Address@FPrm_severity@0x024B3023@ */ ECIPP_ALIGNMENT_UBYTE 255 Compu_IDENTITY 0 255 PHYS_UNIT "Severity+Class" /end CHARACTERISTIC
/begin CHARACTERISTIC FPsw_EGR_slowdec "FPrm_switches(490)" VALUE 0x00146CB0 /* @ECU_Address@FPrm_switches@0x021B93D4@ */ ECIPP_ALIGNMENT_UWORD 65535 Compu_IDENTITY 0 65535 PHYS_UNIT "Enable bits" /end CHARACTERISTIC
/begin CHARACTERISTIC FPsw_EGR_slowinc "FPrm_switches(489)" VALUE 0x00146CAE /* @ECU_Address@FPrm_switches@0x021B93D2@ */ ECIPP_ALIGNMENT_UWORD 65535 Compu_IDENTITY 0 65535 PHYS_UNIT "Enable bits" /end CHARACTERISTIC
/begin CHARACTERISTIC FPsw_EGR_UEGOdP_hi "FPrm_switches(493)" VALUE 0x00146CB6 /* @ECU_Address@FPrm_switches@0x021B93DA@ */ ECIPP_ALIGNMENT_UWORD 65535 Compu_IDENTITY 0 65535 PHYS_UNIT "Enable bits" /end CHARACTERISTIC
/begin CHARACTERISTIC FPsw_EGR_UEGOdP_lo "FPrm_switches(494)" VALUE 0x00146CB8 /* @ECU_Address@FPrm_switches@0x021B93DC@ */ ECIPP_ALIGNMENT_UWORD 65535 Compu_IDENTITY 0 65535 PHYS_UNIT "Enable bits" /end CHARACTERISTIC
/begin CHARACTERISTIC FPsw_EGR_vlv_DC_lim "FPrm_switches(573)" VALUE 0x00146D56 /* @ECU_Address@FPrm_switches@0x021B947A@ */ ECIPP_ALIGNMENT_UWORD 65535 Compu_IDENTITY 0 65535 PHYS_UNIT "Enable bits" /end CHARACTERISTIC
/begin CHARACTERISTIC FPsw_EGR_vlv_stuck "FPrm_switches(660)" VALUE 0x00146E04 /* @ECU_Address@FPrm_switches@0x021B9528@ */ ECIPP_ALIGNMENT_UWORD 65535 Compu_IDENTITY 0 65535 PHYS_UNIT "Enable bits" /end CHARACTERISTIC
/begin CHARACTERISTIC FPsw_EGR_vlv_temp_hi "FPrm_switches(574)" VALUE 0x00146D58 /* @ECU_Address@FPrm_switches@0x021B947C@ */ ECIPP_ALIGNMENT_UWORD 65535 Compu_IDENTITY 0 65535 PHYS_UNIT "Enable bits" /end CHARACTERISTIC
/begin CHARACTERISTIC FPsw_EGR_vlvCAN_commlost "FPrm_switches(497)" VALUE 0x00146CBE /* @ECU_Address@FPrm_switches@0x021B93E2@ */ ECIPP_ALIGNMENT_UWORD 65535 Compu_IDENTITY 0 65535 PHYS_UNIT "Enable bits" /end CHARACTERISTIC
/begin CHARACTERISTIC FPsw_EGR_vlvCAN_lowfunc "FPrm_switches(499)" VALUE 0x00146CC2 /* @ECU_Address@FPrm_switches@0x021B93E6@ */ ECIPP_ALIGNMENT_UWORD 65535 Compu_IDENTITY 0 65535 PHYS_UNIT "Enable bits" /end CHARACTERISTIC
/begin CHARACTERISTIC FPsw_EGR_vlvCAN_nofunc "FPrm_switches(498)" VALUE 0x00146CC0 /* @ECU_Address@FPrm_switches@0x021B93E4@ */ ECIPP_ALIGNMENT_UWORD 65535 Compu_IDENTITY 0 65535 PHYS_UNIT "Enable bits" /end CHARACTERISTIC
/begin CHARACTERISTIC FPsw_EGRdP_HiExp "FPrm_switches(582)" VALUE 0x00146D68 /* @ECU_Address@FPrm_switches@0x021B948C@ */ ECIPP_ALIGNMENT_UWORD 65535 Compu_IDENTITY 0 65535 PHYS_UNIT "Enable bits" /end CHARACTERISTIC
/begin CHARACTERISTIC FPsw_EGRdP_LoExp "FPrm_switches(581)" VALUE 0x00146D66 /* @ECU_Address@FPrm_switches@0x021B948A@ */ ECIPP_ALIGNMENT_UWORD 65535 Compu_IDENTITY 0 65535 PHYS_UNIT "Enable bits" /end CHARACTERISTIC
/begin CHARACTERISTIC FPsw_EGRdP_maxv "FPrm_switches(579)" VALUE 0x00146D62 /* @ECU_Address@FPrm_switches@0x021B9486@ */ ECIPP_ALIGNMENT_UWORD 65535 Compu_IDENTITY 0 65535 PHYS_UNIT "Enable bits" /end CHARACTERISTIC
/begin CHARACTERISTIC FPsw_EGRdP_minv "FPrm_switches(580)" VALUE 0x00146D64 /* @ECU_Address@FPrm_switches@0x021B9488@ */ ECIPP_ALIGNMENT_UWORD 65535 Compu_IDENTITY 0 65535 PHYS_UNIT "Enable bits" /end CHARACTERISTIC
/begin CHARACTERISTIC FPsw_EGRflow_HiExp "FPrm_switches(451)" VALUE 0x00146C62 /* @ECU_Address@FPrm_switches@0x021B9386@ */ ECIPP_ALIGNMENT_UWORD 65535 Compu_IDENTITY 0 65535 PHYS_UNIT "Enable bits" /end CHARACTERISTIC
/begin CHARACTERISTIC FPsw_EGRflow_LoExp "FPrm_switches(450)" VALUE 0x00146C60 /* @ECU_Address@FPrm_switches@0x021B9384@ */ ECIPP_ALIGNMENT_UWORD 65535 Compu_IDENTITY 0 65535 PHYS_UNIT "Enable bits" /end CHARACTERISTIC
/begin CHARACTERISTIC FPsw_EGRflow_LoExp2 "FPrm_switches(514)" VALUE 0x00146CE0 /* @ECU_Address@FPrm_switches@0x021B9404@ */ ECIPP_ALIGNMENT_UWORD 65535 Compu_IDENTITY 0 65535 PHYS_UNIT "Enable bits" /end CHARACTERISTIC
/begin CHARACTERISTIC FPsw_EGRHP_maxv "FPrm_switches(583)" VALUE 0x00146D6A /* @ECU_Address@FPrm_switches@0x021B948E@ */ ECIPP_ALIGNMENT_UWORD 65535 Compu_IDENTITY 0 65535 PHYS_UNIT "Enable bits" /end CHARACTERISTIC
/begin CHARACTERISTIC FPsw_EGRHP_minv "FPrm_switches(584)" VALUE 0x00146D6C /* @ECU_Address@FPrm_switches@0x021B9490@ */ ECIPP_ALIGNMENT_UWORD 65535 Compu_IDENTITY 0 65535 PHYS_UNIT "Enable bits" /end CHARACTERISTIC
/begin CHARACTERISTIC FPsw_EGRHP_OOR "FPrm_switches(585)" VALUE 0x00146D6E /* @ECU_Address@FPrm_switches@0x021B9492@ */ ECIPP_ALIGNMENT_UWORD 65535 Compu_IDENTITY 0 65535 PHYS_UNIT "Enable bits" /end CHARACTERISTIC
/begin CHARACTERISTIC FPsw_EGRO_postlk "FPrm_switches(628)" VALUE 0x00146DC4 /* @ECU_Address@FPrm_switches@0x021B94E8@ */ ECIPP_ALIGNMENT_UWORD 65535 Compu_IDENTITY 0 65535 PHYS_UNIT "Enable bits" /end CHARACTERISTIC
/begin CHARACTERISTIC FPsw_EGRT_hi "FPrm_switches(524)" VALUE 0x00146CF4 /* @ECU_Address@FPrm_switches@0x021B9418@ */ ECIPP_ALIGNMENT_UWORD 65535 Compu_IDENTITY 0 65535 PHYS_UNIT "Enable bits" /end CHARACTERISTIC
/begin CHARACTERISTIC FPsw_EGRT_maxv "FPrm_switches(522)" VALUE 0x00146CF0 /* @ECU_Address@FPrm_switches@0x021B9414@ */ ECIPP_ALIGNMENT_UWORD 65535 Compu_IDENTITY 0 65535 PHYS_UNIT "Enable bits" /end CHARACTERISTIC
/begin CHARACTERISTIC FPsw_EGRT_minv "FPrm_switches(523)" VALUE 0x00146CF2 /* @ECU_Address@FPrm_switches@0x021B9416@ */ ECIPP_ALIGNMENT_UWORD 65535 Compu_IDENTITY 0 65535 PHYS_UNIT "Enable bits" /end CHARACTERISTIC
/begin CHARACTERISTIC FPsw_EGT_dig_Hi "FPrm_switches(145)" VALUE 0x001469FE /* @ECU_Address@FPrm_switches@0x021B9122@ */ ECIPP_ALIGNMENT_UWORD 65535 Compu_IDENTITY 0 65535 PHYS_UNIT "Enable bits" /end CHARACTERISTIC
/begin CHARACTERISTIC FPsw_EGT_maxv "FPrm_switches(635)" VALUE 0x00146DD2 /* @ECU_Address@FPrm_switches@0x021B94F6@ */ ECIPP_ALIGNMENT_UWORD 65535 Compu_IDENTITY 0 65535 PHYS_UNIT "Enable bits" /end CHARACTERISTIC
/begin CHARACTERISTIC FPsw_EGT_minv "FPrm_switches(636)" VALUE 0x00146DD4 /* @ECU_Address@FPrm_switches@0x021B94F8@ */ ECIPP_ALIGNMENT_UWORD 65535 Compu_IDENTITY 0 65535 PHYS_UNIT "Enable bits" /end CHARACTERISTIC
/begin CHARACTERISTIC FPsw_EMWT1_HiExp1 "FPrm_switches(179)" VALUE 0x00146A42 /* @ECU_Address@FPrm_switches@0x021B9166@ */ ECIPP_ALIGNMENT_UWORD 65535 Compu_IDENTITY 0 65535 PHYS_UNIT "Enable bits" /end CHARACTERISTIC
/begin CHARACTERISTIC FPsw_EMWT1_HiExp2 "FPrm_switches(180)" VALUE 0x00146A44 /* @ECU_Address@FPrm_switches@0x021B9168@ */ ECIPP_ALIGNMENT_UWORD 65535 Compu_IDENTITY 0 65535 PHYS_UNIT "Enable bits" /end CHARACTERISTIC
/begin CHARACTERISTIC FPsw_EMWT1_maxv "FPrm_switches(177)" VALUE 0x00146A3E /* @ECU_Address@FPrm_switches@0x021B9162@ */ ECIPP_ALIGNMENT_UWORD 65535 Compu_IDENTITY 0 65535 PHYS_UNIT "Enable bits" /end CHARACTERISTIC
/begin CHARACTERISTIC FPsw_EMWT1_minv "FPrm_switches(178)" VALUE 0x00146A40 /* @ECU_Address@FPrm_switches@0x021B9164@ */ ECIPP_ALIGNMENT_UWORD 65535 Compu_IDENTITY 0 65535 PHYS_UNIT "Enable bits" /end CHARACTERISTIC
/begin CHARACTERISTIC FPsw_envtech_AAT_inv "FPrm_switches(641)" VALUE 0x00146DDE /* @ECU_Address@FPrm_switches@0x021B9502@ */ ECIPP_ALIGNMENT_UWORD 65535 Compu_IDENTITY 0 65535 PHYS_UNIT "Enable bits" /end CHARACTERISTIC
/begin CHARACTERISTIC FPsw_envtech_BP_inv "FPrm_switches(642)" VALUE 0x00146DE0 /* @ECU_Address@FPrm_switches@0x021B9504@ */ ECIPP_ALIGNMENT_UWORD 65535 Compu_IDENTITY 0 65535 PHYS_UNIT "Enable bits" /end CHARACTERISTIC
/begin CHARACTERISTIC FPsw_envtech_comm "FPrm_switches(267)" VALUE 0x00146AF2 /* @ECU_Address@FPrm_switches@0x021B9216@ */ ECIPP_ALIGNMENT_UWORD 65535 Compu_IDENTITY 0 65535 PHYS_UNIT "Enable bits" /end CHARACTERISTIC
/begin CHARACTERISTIC FPsw_envtech_general "FPrm_switches(644)" VALUE 0x00146DE4 /* @ECU_Address@FPrm_switches@0x021B9508@ */ ECIPP_ALIGNMENT_UWORD 65535 Compu_IDENTITY 0 65535 PHYS_UNIT "Enable bits" /end CHARACTERISTIC
/begin CHARACTERISTIC FPsw_envtech_RH_inv "FPrm_switches(643)" VALUE 0x00146DE2 /* @ECU_Address@FPrm_switches@0x021B9506@ */ ECIPP_ALIGNMENT_UWORD 65535 Compu_IDENTITY 0 65535 PHYS_UNIT "Enable bits" /end CHARACTERISTIC
/begin CHARACTERISTIC FPsw_envtech_RH_uns "FPrm_switches(645)" VALUE 0x00146DE6 /* @ECU_Address@FPrm_switches@0x021B950A@ */ ECIPP_ALIGNMENT_UWORD 65535 Compu_IDENTITY 0 65535 PHYS_UNIT "Enable bits" /end CHARACTERISTIC
/begin CHARACTERISTIC FPsw_ERCV_speed_OOR "FPrm_switches(680)" VALUE 0x00146E2C /* @ECU_Address@FPrm_switches@0x021B9550@ */ ECIPP_ALIGNMENT_UWORD 65535 Compu_IDENTITY 0 65535 PHYS_UNIT "Enable bits" /end CHARACTERISTIC
/begin CHARACTERISTIC FPsw_ERWT1_HiExp1 "FPrm_switches(187)" VALUE 0x00146A52 /* @ECU_Address@FPrm_switches@0x021B9176@ */ ECIPP_ALIGNMENT_UWORD 65535 Compu_IDENTITY 0 65535 PHYS_UNIT "Enable bits" /end CHARACTERISTIC
/begin CHARACTERISTIC FPsw_ERWT1_HiExp2 "FPrm_switches(188)" VALUE 0x00146A54 /* @ECU_Address@FPrm_switches@0x021B9178@ */ ECIPP_ALIGNMENT_UWORD 65535 Compu_IDENTITY 0 65535 PHYS_UNIT "Enable bits" /end CHARACTERISTIC
/begin CHARACTERISTIC FPsw_ERWT1_maxv "FPrm_switches(185)" VALUE 0x00146A4E /* @ECU_Address@FPrm_switches@0x021B9172@ */ ECIPP_ALIGNMENT_UWORD 65535 Compu_IDENTITY 0 65535 PHYS_UNIT "Enable bits" /end CHARACTERISTIC
/begin CHARACTERISTIC FPsw_ERWT1_minv "FPrm_switches(186)" VALUE 0x00146A50 /* @ECU_Address@FPrm_switches@0x021B9174@ */ ECIPP_ALIGNMENT_UWORD 65535 Compu_IDENTITY 0 65535 PHYS_UNIT "Enable bits" /end CHARACTERISTIC
/begin CHARACTERISTIC FPsw_ext1_EGR_slowdec "FPrm_switches_ext1(490)" VALUE 0x00147212 /* @ECU_Address@FPrm_switches_ext1@0x023A53D4@ */ ECIPP_ALIGNMENT_UWORD 65535 Compu_IDENTITY 0 65535 PHYS_UNIT "Enable bits" /end CHARACTERISTIC
/begin CHARACTERISTIC FPsw_ext1_EGR_slowinc "FPrm_switches_ext1(489)" VALUE 0x00147210 /* @ECU_Address@FPrm_switches_ext1@0x023A53D2@ */ ECIPP_ALIGNMENT_UWORD 65535 Compu_IDENTITY 0 65535 PHYS_UNIT "Enable bits" /end CHARACTERISTIC
/begin CHARACTERISTIC FPsw_ext1_EGR_UEGOdP_hi "FPrm_switches_ext1(493)" VALUE 0x00147218 /* @ECU_Address@FPrm_switches_ext1@0x023A53DA@ */ ECIPP_ALIGNMENT_UWORD 65535 Compu_IDENTITY 0 65535 PHYS_UNIT "Enable bits" /end CHARACTERISTIC
/begin CHARACTERISTIC FPsw_ext1_EGR_UEGOdP_lo "FPrm_switches_ext1(494)" VALUE 0x0014721A /* @ECU_Address@FPrm_switches_ext1@0x023A53DC@ */ ECIPP_ALIGNMENT_UWORD 65535 Compu_IDENTITY 0 65535 PHYS_UNIT "Enable bits" /end CHARACTERISTIC
/begin CHARACTERISTIC FPsw_ext1_EGR_vlv_DC_lim "FPrm_switches_ext1(573)" VALUE 0x001472B8 /* @ECU_Address@FPrm_switches_ext1@0x023A547A@ */ ECIPP_ALIGNMENT_UWORD 65535 Compu_IDENTITY 0 65535 PHYS_UNIT "Enable bits" /end CHARACTERISTIC
/begin CHARACTERISTIC FPsw_ext1_EGR_vlv_stuck "FPrm_switches_ext1(660)" VALUE 0x00147366 /* @ECU_Address@FPrm_switches_ext1@0x023A5528@ */ ECIPP_ALIGNMENT_UWORD 65535 Compu_IDENTITY 0 65535 PHYS_UNIT "Enable bits" /end CHARACTERISTIC
/begin CHARACTERISTIC FPsw_ext1_EGR_vlv_temp_hi "FPrm_switches_ext1(574)" VALUE 0x001472BA /* @ECU_Address@FPrm_switches_ext1@0x023A547C@ */ ECIPP_ALIGNMENT_UWORD 65535 Compu_IDENTITY 0 65535 PHYS_UNIT "Enable bits" /end CHARACTERISTIC
/begin CHARACTERISTIC FPsw_ext1_EGR_vlvCAN_commlost "FPrm_switches_ext1(497)" VALUE 0x00147220 /* @ECU_Address@FPrm_switches_ext1@0x023A53E2@ */ ECIPP_ALIGNMENT_UWORD 65535 Compu_IDENTITY 0 65535 PHYS_UNIT "Enable bits" /end CHARACTERISTIC
/begin CHARACTERISTIC FPsw_ext1_EGR_vlvCAN_lowfunc "FPrm_switches_ext1(499)" VALUE 0x00147224 /* @ECU_Address@FPrm_switches_ext1@0x023A53E6@ */ ECIPP_ALIGNMENT_UWORD 65535 Compu_IDENTITY 0 65535 PHYS_UNIT "Enable bits" /end CHARACTERISTIC
/begin CHARACTERISTIC FPsw_ext1_EGR_vlvCAN_nofunc "FPrm_switches_ext1(498)" VALUE 0x00147222 /* @ECU_Address@FPrm_switches_ext1@0x023A53E4@ */ ECIPP_ALIGNMENT_UWORD 65535 Compu_IDENTITY 0 65535 PHYS_UNIT "Enable bits" /end CHARACTERISTIC
/begin CHARACTERISTIC FPsw_ext1_EGRdP_HiExp "FPrm_switches_ext1(582)" VALUE 0x001472CA /* @ECU_Address@FPrm_switches_ext1@0x023A548C@ */ ECIPP_ALIGNMENT_UWORD 65535 Compu_IDENTITY 0 65535 PHYS_UNIT "Enable bits" /end CHARACTERISTIC
/begin CHARACTERISTIC FPsw_ext1_EGRdP_LoExp "FPrm_switches_ext1(581)" VALUE 0x001472C8 /* @ECU_Address@FPrm_switches_ext1@0x023A548A@ */ ECIPP_ALIGNMENT_UWORD 65535 Compu_IDENTITY 0 65535 PHYS_UNIT "Enable bits" /end CHARACTERISTIC
/begin CHARACTERISTIC FPsw_ext1_EGRdP_maxv "FPrm_switches_ext1(579)" VALUE 0x001472C4 /* @ECU_Address@FPrm_switches_ext1@0x023A5486@ */ ECIPP_ALIGNMENT_UWORD 65535 Compu_IDENTITY 0 65535 PHYS_UNIT "Enable bits" /end CHARACTERISTIC
/begin CHARACTERISTIC FPsw_ext1_EGRdP_minv "FPrm_switches_ext1(580)" VALUE 0x001472C6 /* @ECU_Address@FPrm_switches_ext1@0x023A5488@ */ ECIPP_ALIGNMENT_UWORD 65535 Compu_IDENTITY 0 65535 PHYS_UNIT "Enable bits" /end CHARACTERISTIC
/begin CHARACTERISTIC FPsw_ext1_EGRflow_HiExp "FPrm_switches_ext1(451)" VALUE 0x001471C4 /* @ECU_Address@FPrm_switches_ext1@0x023A5386@ */ ECIPP_ALIGNMENT_UWORD 65535 Compu_IDENTITY 0 65535 PHYS_UNIT "Enable bits" /end CHARACTERISTIC
/begin CHARACTERISTIC FPsw_ext1_EGRflow_LoExp "FPrm_switches_ext1(450)" VALUE 0x001471C2 /* @ECU_Address@FPrm_switches_ext1@0x023A5384@ */ ECIPP_ALIGNMENT_UWORD 65535 Compu_IDENTITY 0 65535 PHYS_UNIT "Enable bits" /end CHARACTERISTIC
/begin CHARACTERISTIC FPsw_ext1_EGRflow_LoExp2 "FPrm_switches_ext1(514)" VALUE 0x00147242 /* @ECU_Address@FPrm_switches_ext1@0x023A5404@ */ ECIPP_ALIGNMENT_UWORD 65535 Compu_IDENTITY 0 65535 PHYS_UNIT "Enable bits" /end CHARACTERISTIC
/begin CHARACTERISTIC FPsw_ext1_EGRHP_maxv "FPrm_switches_ext1(583)" VALUE 0x001472CC /* @ECU_Address@FPrm_switches_ext1@0x023A548E@ */ ECIPP_ALIGNMENT_UWORD 65535 Compu_IDENTITY 0 65535 PHYS_UNIT "Enable bits" /end CHARACTERISTIC
/begin CHARACTERISTIC FPsw_ext1_EGRHP_minv "FPrm_switches_ext1(584)" VALUE 0x001472CE /* @ECU_Address@FPrm_switches_ext1@0x023A5490@ */ ECIPP_ALIGNMENT_UWORD 65535 Compu_IDENTITY 0 65535 PHYS_UNIT "Enable bits" /end CHARACTERISTIC
/begin CHARACTERISTIC FPsw_ext1_EGRHP_OOR "FPrm_switches_ext1(585)" VALUE 0x001472D0 /* @ECU_Address@FPrm_switches_ext1@0x023A5492@ */ ECIPP_ALIGNMENT_UWORD 65535 Compu_IDENTITY 0 65535 PHYS_UNIT "Enable bits" /end CHARACTERISTIC
/begin CHARACTERISTIC FPsw_ext1_EGRO_postlk "FPrm_switches_ext1(628)" VALUE 0x00147326 /* @ECU_Address@FPrm_switches_ext1@0x023A54E8@ */ ECIPP_ALIGNMENT_UWORD 65535 Compu_IDENTITY 0 65535 PHYS_UNIT "Enable bits" /end CHARACTERISTIC
/begin CHARACTERISTIC FPsw_ext1_EGRT_hi "FPrm_switches_ext1(524)" VALUE 0x00147256 /* @ECU_Address@FPrm_switches_ext1@0x023A5418@ */ ECIPP_ALIGNMENT_UWORD 65535 Compu_IDENTITY 0 65535 PHYS_UNIT "Enable bits" /end CHARACTERISTIC
/begin CHARACTERISTIC FPsw_ext1_EGRT_maxv "FPrm_switches_ext1(522)" VALUE 0x00147252 /* @ECU_Address@FPrm_switches_ext1@0x023A5414@ */ ECIPP_ALIGNMENT_UWORD 65535 Compu_IDENTITY 0 65535 PHYS_UNIT "Enable bits" /end CHARACTERISTIC
/begin CHARACTERISTIC FPsw_ext1_EGRT_minv "FPrm_switches_ext1(523)" VALUE 0x00147254 /* @ECU_Address@FPrm_switches_ext1@0x023A5416@ */ ECIPP_ALIGNMENT_UWORD 65535 Compu_IDENTITY 0 65535 PHYS_UNIT "Enable bits" /end CHARACTERISTIC
/begin CHARACTERISTIC FPsw_ext1_EGT_dig_Hi "FPrm_switches_ext1(145)" VALUE 0x00146F60 /* @ECU_Address@FPrm_switches_ext1@0x023A5122@ */ ECIPP_ALIGNMENT_UWORD 65535 Compu_IDENTITY 0 65535 PHYS_UNIT "Enable bits" /end CHARACTERISTIC
/begin CHARACTERISTIC FPsw_ext1_EGT_maxv "FPrm_switches_ext1(635)" VALUE 0x00147334 /* @ECU_Address@FPrm_switches_ext1@0x023A54F6@ */ ECIPP_ALIGNMENT_UWORD 65535 Compu_IDENTITY 0 65535 PHYS_UNIT "Enable bits" /end CHARACTERISTIC
/begin CHARACTERISTIC FPsw_ext1_EGT_minv "FPrm_switches_ext1(636)" VALUE 0x00147336 /* @ECU_Address@FPrm_switches_ext1@0x023A54F8@ */ ECIPP_ALIGNMENT_UWORD 65535 Compu_IDENTITY 0 65535 PHYS_UNIT "Enable bits" /end CHARACTERISTIC
/begin CHARACTERISTIC FPsw_ext1_EMWT1_HiExp1 "FPrm_switches_ext1(179)" VALUE 0x00146FA4 /* @ECU_Address@FPrm_switches_ext1@0x023A5166@ */ ECIPP_ALIGNMENT_UWORD 65535 Compu_IDENTITY 0 65535 PHYS_UNIT "Enable bits" /end CHARACTERISTIC
/begin CHARACTERISTIC FPsw_ext1_EMWT1_HiExp2 "FPrm_switches_ext1(180)" VALUE 0x00146FA6 /* @ECU_Address@FPrm_switches_ext1@0x023A5168@ */ ECIPP_ALIGNMENT_UWORD 65535 Compu_IDENTITY 0 65535 PHYS_UNIT "Enable bits" /end CHARACTERISTIC
/begin CHARACTERISTIC FPsw_ext1_EMWT1_maxv "FPrm_switches_ext1(177)" VALUE 0x00146FA0 /* @ECU_Address@FPrm_switches_ext1@0x023A5162@ */ ECIPP_ALIGNMENT_UWORD 65535 Compu_IDENTITY 0 65535 PHYS_UNIT "Enable bits" /end CHARACTERISTIC
/begin CHARACTERISTIC FPsw_ext1_EMWT1_minv "FPrm_switches_ext1(178)" VALUE 0x00146FA2 /* @ECU_Address@FPrm_switches_ext1@0x023A5164@ */ ECIPP_ALIGNMENT_UWORD 65535 Compu_IDENTITY 0 65535 PHYS_UNIT "Enable bits" /end CHARACTERISTIC
/begin CHARACTERISTIC FPsw_ext1_envtech_AAT_inv "FPrm_switches_ext1(641)" VALUE 0x00147340 /* @ECU_Address@FPrm_switches_ext1@0x023A5502@ */ ECIPP_ALIGNMENT_UWORD 65535 Compu_IDENTITY 0 65535 PHYS_UNIT "Enable bits" /end CHARACTERISTIC
/begin CHARACTERISTIC FPsw_ext1_envtech_BP_inv "FPrm_switches_ext1(642)" VALUE 0x00147342 /* @ECU_Address@FPrm_switches_ext1@0x023A5504@ */ ECIPP_ALIGNMENT_UWORD 65535 Compu_IDENTITY 0 65535 PHYS_UNIT "Enable bits" /end CHARACTERISTIC
/begin CHARACTERISTIC FPsw_ext1_envtech_comm "FPrm_switches_ext1(267)" VALUE 0x00147054 /* @ECU_Address@FPrm_switches_ext1@0x023A5216@ */ ECIPP_ALIGNMENT_UWORD 65535 Compu_IDENTITY 0 65535 PHYS_UNIT "Enable bits" /end CHARACTERISTIC
/begin CHARACTERISTIC FPsw_ext1_envtech_general "FPrm_switches_ext1(644)" VALUE 0x00147346 /* @ECU_Address@FPrm_switches_ext1@0x023A5508@ */ ECIPP_ALIGNMENT_UWORD 65535 Compu_IDENTITY 0 65535 PHYS_UNIT "Enable bits" /end CHARACTERISTIC
/begin CHARACTERISTIC FPsw_ext1_envtech_RH_inv "FPrm_switches_ext1(643)" VALUE 0x00147344 /* @ECU_Address@FPrm_switches_ext1@0x023A5506@ */ ECIPP_ALIGNMENT_UWORD 65535 Compu_IDENTITY 0 65535 PHYS_UNIT "Enable bits" /end CHARACTERISTIC
/begin CHARACTERISTIC FPsw_ext1_envtech_RH_uns "FPrm_switches_ext1(645)" VALUE 0x00147348 /* @ECU_Address@FPrm_switches_ext1@0x023A550A@ */ ECIPP_ALIGNMENT_UWORD 65535 Compu_IDENTITY 0 65535 PHYS_UNIT "Enable bits" /end CHARACTERISTIC
/begin CHARACTERISTIC FPsw_ext1_ERCV_speed_OOR "FPrm_switches_ext1(680)" VALUE 0x0014738E /* @ECU_Address@FPrm_switches_ext1@0x023A5550@ */ ECIPP_ALIGNMENT_UWORD 65535 Compu_IDENTITY 0 65535 PHYS_UNIT "Enable bits" /end CHARACTERISTIC
/begin CHARACTERISTIC FPsw_ext1_ERWT1_HiExp1 "FPrm_switches_ext1(187)" VALUE 0x00146FB4 /* @ECU_Address@FPrm_switches_ext1@0x023A5176@ */ ECIPP_ALIGNMENT_UWORD 65535 Compu_IDENTITY 0 65535 PHYS_UNIT "Enable bits" /end CHARACTERISTIC
/begin CHARACTERISTIC FPsw_ext1_ERWT1_HiExp2 "FPrm_switches_ext1(188)" VALUE 0x00146FB6 /* @ECU_Address@FPrm_switches_ext1@0x023A5178@ */ ECIPP_ALIGNMENT_UWORD 65535 Compu_IDENTITY 0 65535 PHYS_UNIT "Enable bits" /end CHARACTERISTIC
/begin CHARACTERISTIC FPsw_ext1_ERWT1_maxv "FPrm_switches_ext1(185)" VALUE 0x00146FB0 /* @ECU_Address@FPrm_switches_ext1@0x023A5172@ */ ECIPP_ALIGNMENT_UWORD 65535 Compu_IDENTITY 0 65535 PHYS_UNIT "Enable bits" /end CHARACTERISTIC
/begin CHARACTERISTIC FPsw_ext1_ERWT1_minv "FPrm_switches_ext1(186)" VALUE 0x00146FB2 /* @ECU_Address@FPrm_switches_ext1@0x023A5174@ */ ECIPP_ALIGNMENT_UWORD 65535 Compu_IDENTITY 0 65535 PHYS_UNIT "Enable bits" /end CHARACTERISTIC
/begin CHARACTERISTIC FPsw_ext1_F1OOR_F2IVS "FPrm_switches_ext1(138)" VALUE 0x00146F52 /* @ECU_Address@FPrm_switches_ext1@0x023A5114@ */ ECIPP_ALIGNMENT_UWORD 65535 Compu_IDENTITY 0 65535 PHYS_UNIT "Enable bits" /end CHARACTERISTIC
/begin CHARACTERISTIC FPsw_ext1_F2OOR_F1IVS "FPrm_switches_ext1(139)" VALUE 0x00146F54 /* @ECU_Address@FPrm_switches_ext1@0x023A5116@ */ ECIPP_ALIGNMENT_UWORD 65535 Compu_IDENTITY 0 65535 PHYS_UNIT "Enable bits" /end CHARACTERISTIC
/begin CHARACTERISTIC FPsw_ext1_FCoolH2O_lo "FPrm_switches_ext1(402)" VALUE 0x00147162 /* @ECU_Address@FPrm_switches_ext1@0x023A5324@ */ ECIPP_ALIGNMENT_UWORD 65535 Compu_IDENTITY 0 65535 PHYS_UNIT "Enable bits" /end CHARACTERISTIC
/begin CHARACTERISTIC FPsw_ext1_FIMP_pct_high "FPrm_switches_ext1(204)" VALUE 0x00146FD6 /* @ECU_Address@FPrm_switches_ext1@0x023A5198@ */ ECIPP_ALIGNMENT_UWORD 65535 Compu_IDENTITY 0 65535 PHYS_UNIT "Enable bits" /end CHARACTERISTIC
/begin CHARACTERISTIC FPsw_ext1_FIP_LoExp "FPrm_switches_ext1(525)" VALUE 0x00147258 /* @ECU_Address@FPrm_switches_ext1@0x023A541A@ */ ECIPP_ALIGNMENT_UWORD 65535 Compu_IDENTITY 0 65535 PHYS_UNIT "Enable bits" /end CHARACTERISTIC
/begin CHARACTERISTIC FPsw_ext1_flash_fail "FPrm_switches_ext1(69)" VALUE 0x00146EC8 /* @ECU_Address@FPrm_switches_ext1@0x023A508A@ */ ECIPP_ALIGNMENT_UWORD 65535 Compu_IDENTITY 0 65535 PHYS_UNIT "Enable bits" /end CHARACTERISTIC
/begin CHARACTERISTIC FPsw_ext1_FP_high "FPrm_switches_ext1(212)" VALUE 0x00146FE6 /* @ECU_Address@FPrm_switches_ext1@0x023A51A8@ */ ECIPP_ALIGNMENT_UWORD 65535 Compu_IDENTITY 0 65535 PHYS_UNIT "Enable bits" /end CHARACTERISTIC
/begin CHARACTERISTIC FPsw_ext1_FP_low "FPrm_switches_ext1(213)" VALUE 0x00146FE8 /* @ECU_Address@FPrm_switches_ext1@0x023A51AA@ */ ECIPP_ALIGNMENT_UWORD 65535 Compu_IDENTITY 0 65535 PHYS_UNIT "Enable bits" /end CHARACTERISTIC
/begin CHARACTERISTIC FPsw_ext1_FP_maxv "FPrm_switches_ext1(87)" VALUE 0x00146EEC /* @ECU_Address@FPrm_switches_ext1@0x023A50AE@ */ ECIPP_ALIGNMENT_UWORD 65535 Compu_IDENTITY 0 65535 PHYS_UNIT "Enable bits" /end CHARACTERISTIC
/begin CHARACTERISTIC FPsw_ext1_FP_minv "FPrm_switches_ext1(88)" VALUE 0x00146EEE /* @ECU_Address@FPrm_switches_ext1@0x023A50B0@ */ ECIPP_ALIGNMENT_UWORD 65535 Compu_IDENTITY 0 65535 PHYS_UNIT "Enable bits" /end CHARACTERISTIC
/begin CHARACTERISTIC FPsw_ext1_FP2_high "FPrm_switches_ext1(360)" VALUE 0x0014710E /* @ECU_Address@FPrm_switches_ext1@0x023A52D0@ */ ECIPP_ALIGNMENT_UWORD 65535 Compu_IDENTITY 0 65535 PHYS_UNIT "Enable bits" /end CHARACTERISTIC
/begin CHARACTERISTIC FPsw_ext1_FP2_low "FPrm_switches_ext1(361)" VALUE 0x00147110 /* @ECU_Address@FPrm_switches_ext1@0x023A52D2@ */ ECIPP_ALIGNMENT_UWORD 65535 Compu_IDENTITY 0 65535 PHYS_UNIT "Enable bits" /end CHARACTERISTIC
/begin CHARACTERISTIC FPsw_ext1_FP2_maxv "FPrm_switches_ext1(358)" VALUE 0x0014710A /* @ECU_Address@FPrm_switches_ext1@0x023A52CC@ */ ECIPP_ALIGNMENT_UWORD 65535 Compu_IDENTITY 0 65535 PHYS_UNIT "Enable bits" /end CHARACTERISTIC
/begin CHARACTERISTIC FPsw_ext1_FP2_minv "FPrm_switches_ext1(359)" VALUE 0x0014710C /* @ECU_Address@FPrm_switches_ext1@0x023A52CE@ */ ECIPP_ALIGNMENT_UWORD 65535 Compu_IDENTITY 0 65535 PHYS_UNIT "Enable bits" /end CHARACTERISTIC
/begin CHARACTERISTIC FPsw_ext1_FPD_off_hi "FPrm_switches_ext1(58)" VALUE 0x00146EB2 /* @ECU_Address@FPrm_switches_ext1@0x023A5074@ */ ECIPP_ALIGNMENT_UWORD 65535 Compu_IDENTITY 0 65535 PHYS_UNIT "Enable bits" /end CHARACTERISTIC
/begin CHARACTERISTIC FPsw_ext1_FPD_on_lo "FPrm_switches_ext1(57)" VALUE 0x00146EB0 /* @ECU_Address@FPrm_switches_ext1@0x023A5072@ */ ECIPP_ALIGNMENT_UWORD 65535 Compu_IDENTITY 0 65535 PHYS_UNIT "Enable bits" /end CHARACTERISTIC
/begin CHARACTERISTIC FPsw_ext1_FPlo_derate_actv "FPrm_switches_ext1(634)" VALUE 0x00147332 /* @ECU_Address@FPrm_switches_ext1@0x023A54F4@ */ ECIPP_ALIGNMENT_UWORD 65535 Compu_IDENTITY 0 65535 PHYS_UNIT "Enable bits" /end CHARACTERISTIC
/begin CHARACTERISTIC FPsw_ext1_FPlo_derate_excess "FPrm_switches_ext1(637)" VALUE 0x00147338 /* @ECU_Address@FPrm_switches_ext1@0x023A54FA@ */ ECIPP_ALIGNMENT_UWORD 65535 Compu_IDENTITY 0 65535 PHYS_UNIT "Enable bits" /end CHARACTERISTIC
/begin CHARACTERISTIC FPsw_ext1_FPP_NeutLock_fail "FPrm_switches_ext1(488)" VALUE 0x0014720E /* @ECU_Address@FPrm_switches_ext1@0x023A53D0@ */ ECIPP_ALIGNMENT_UWORD 65535 Compu_IDENTITY 0 65535 PHYS_UNIT "Enable bits" /end CHARACTERISTIC
/begin CHARACTERISTIC FPsw_ext1_FPP1_IVS_max "FPrm_switches_ext1(30)" VALUE 0x00146E7A /* @ECU_Address@FPrm_switches_ext1@0x023A503C@ */ ECIPP_ALIGNMENT_UWORD 65535 Compu_IDENTITY 0 65535 PHYS_UNIT "Enable bits" /end CHARACTERISTIC
/begin CHARACTERISTIC FPsw_ext1_FPP1_IVS_min "FPrm_switches_ext1(31)" VALUE 0x00146E7C /* @ECU_Address@FPrm_switches_ext1@0x023A503E@ */ ECIPP_ALIGNMENT_UWORD 65535 Compu_IDENTITY 0 65535 PHYS_UNIT "Enable bits" /end CHARACTERISTIC
/begin CHARACTERISTIC FPsw_ext1_FPP1_max "FPrm_switches_ext1(26)" VALUE 0x00146E72 /* @ECU_Address@FPrm_switches_ext1@0x023A5034@ */ ECIPP_ALIGNMENT_UWORD 65535 Compu_IDENTITY 0 65535 PHYS_UNIT "Enable bits" /end CHARACTERISTIC
/begin CHARACTERISTIC FPsw_ext1_FPP1_min "FPrm_switches_ext1(27)" VALUE 0x00146E74 /* @ECU_Address@FPrm_switches_ext1@0x023A5036@ */ ECIPP_ALIGNMENT_UWORD 65535 Compu_IDENTITY 0 65535 PHYS_UNIT "Enable bits" /end CHARACTERISTIC
/begin CHARACTERISTIC FPsw_ext1_FPP12_IVS_max "FPrm_switches_ext1(135)" VALUE 0x00146F4C /* @ECU_Address@FPrm_switches_ext1@0x023A510E@ */ ECIPP_ALIGNMENT_UWORD 65535 Compu_IDENTITY 0 65535 PHYS_UNIT "Enable bits" /end CHARACTERISTIC
/begin CHARACTERISTIC FPsw_ext1_FPP12_IVS_min "FPrm_switches_ext1(136)" VALUE 0x00146F4E /* @ECU_Address@FPrm_switches_ext1@0x023A5110@ */ ECIPP_ALIGNMENT_UWORD 65535 Compu_IDENTITY 0 65535 PHYS_UNIT "Enable bits" /end CHARACTERISTIC
/begin CHARACTERISTIC FPsw_ext1_FPP12_OOR "FPrm_switches_ext1(137)" VALUE 0x00146F50 /* @ECU_Address@FPrm_switches_ext1@0x023A5112@ */ ECIPP_ALIGNMENT_UWORD 65535 Compu_IDENTITY 0 65535 PHYS_UNIT "Enable bits" /end CHARACTERISTIC
/begin CHARACTERISTIC FPsw_ext1_FPP12IVS_TSC1 "FPrm_switches_ext1(564)" VALUE 0x001472A6 /* @ECU_Address@FPrm_switches_ext1@0x023A5468@ */ ECIPP_ALIGNMENT_UWORD 65535 Compu_IDENTITY 0 65535 PHYS_UNIT "Enable bits" /end CHARACTERISTIC
/begin CHARACTERISTIC FPsw_ext1_FPP12MM_IVSMM "FPrm_switches_ext1(140)" VALUE 0x00146F56 /* @ECU_Address@FPrm_switches_ext1@0x023A5118@ */ ECIPP_ALIGNMENT_UWORD 65535 Compu_IDENTITY 0 65535 PHYS_UNIT "Enable bits" /end CHARACTERISTIC
/begin CHARACTERISTIC FPsw_ext1_FPP12pct_hi "FPrm_switches_ext1(34)" VALUE 0x00146E82 /* @ECU_Address@FPrm_switches_ext1@0x023A5044@ */ ECIPP_ALIGNMENT_UWORD 65535 Compu_IDENTITY 0 65535 PHYS_UNIT "Enable bits" /end CHARACTERISTIC
/begin CHARACTERISTIC FPsw_ext1_FPP12pct_lo "FPrm_switches_ext1(35)" VALUE 0x00146E84 /* @ECU_Address@FPrm_switches_ext1@0x023A5046@ */ ECIPP_ALIGNMENT_UWORD 65535 Compu_IDENTITY 0 65535 PHYS_UNIT "Enable bits" /end CHARACTERISTIC
/begin CHARACTERISTIC FPsw_F1OOR_F2IVS "FPrm_switches(138)" VALUE 0x001469F0 /* @ECU_Address@FPrm_switches@0x021B9114@ */ ECIPP_ALIGNMENT_UWORD 65535 Compu_IDENTITY 0 65535 PHYS_UNIT "Enable bits" /end CHARACTERISTIC
/begin CHARACTERISTIC FPsw_F2OOR_F1IVS "FPrm_switches(139)" VALUE 0x001469F2 /* @ECU_Address@FPrm_switches@0x021B9116@ */ ECIPP_ALIGNMENT_UWORD 65535 Compu_IDENTITY 0 65535 PHYS_UNIT "Enable bits" /end CHARACTERISTIC
/begin CHARACTERISTIC FPsw_FCoolH2O_lo "FPrm_switches(402)" VALUE 0x00146C00 /* @ECU_Address@FPrm_switches@0x021B9324@ */ ECIPP_ALIGNMENT_UWORD 65535 Compu_IDENTITY 0 65535 PHYS_UNIT "Enable bits" /end CHARACTERISTIC
/begin CHARACTERISTIC FPsw_FIMP_pct_high "FPrm_switches(204)" VALUE 0x00146A74 /* @ECU_Address@FPrm_switches@0x021B9198@ */ ECIPP_ALIGNMENT_UWORD 65535 Compu_IDENTITY 0 65535 PHYS_UNIT "Enable bits" /end CHARACTERISTIC
/begin CHARACTERISTIC FPsw_FIP_LoExp "FPrm_switches(525)" VALUE 0x00146CF6 /* @ECU_Address@FPrm_switches@0x021B941A@ */ ECIPP_ALIGNMENT_UWORD 65535 Compu_IDENTITY 0 65535 PHYS_UNIT "Enable bits" /end CHARACTERISTIC
/begin CHARACTERISTIC FPsw_flash_fail "FPrm_switches(69)" VALUE 0x00146966 /* @ECU_Address@FPrm_switches@0x021B908A@ */ ECIPP_ALIGNMENT_UWORD 65535 Compu_IDENTITY 0 65535 PHYS_UNIT "Enable bits" /end CHARACTERISTIC
/begin CHARACTERISTIC FPsw_FP_high "FPrm_switches(212)" VALUE 0x00146A84 /* @ECU_Address@FPrm_switches@0x021B91A8@ */ ECIPP_ALIGNMENT_UWORD 65535 Compu_IDENTITY 0 65535 PHYS_UNIT "Enable bits" /end CHARACTERISTIC
/begin CHARACTERISTIC FPsw_FP_low "FPrm_switches(213)" VALUE 0x00146A86 /* @ECU_Address@FPrm_switches@0x021B91AA@ */ ECIPP_ALIGNMENT_UWORD 65535 Compu_IDENTITY 0 65535 PHYS_UNIT "Enable bits" /end CHARACTERISTIC
/begin CHARACTERISTIC FPsw_FP_maxv "FPrm_switches(87)" VALUE 0x0014698A /* @ECU_Address@FPrm_switches@0x021B90AE@ */ ECIPP_ALIGNMENT_UWORD 65535 Compu_IDENTITY 0 65535 PHYS_UNIT "Enable bits" /end CHARACTERISTIC
/begin CHARACTERISTIC FPsw_FP_minv "FPrm_switches(88)" VALUE 0x0014698C /* @ECU_Address@FPrm_switches@0x021B90B0@ */ ECIPP_ALIGNMENT_UWORD 65535 Compu_IDENTITY 0 65535 PHYS_UNIT "Enable bits" /end CHARACTERISTIC
/begin CHARACTERISTIC FPsw_FP2_high "FPrm_switches(360)" VALUE 0x00146BAC /* @ECU_Address@FPrm_switches@0x021B92D0@ */ ECIPP_ALIGNMENT_UWORD 65535 Compu_IDENTITY 0 65535 PHYS_UNIT "Enable bits" /end CHARACTERISTIC
/begin CHARACTERISTIC FPsw_FP2_low "FPrm_switches(361)" VALUE 0x00146BAE /* @ECU_Address@FPrm_switches@0x021B92D2@ */ ECIPP_ALIGNMENT_UWORD 65535 Compu_IDENTITY 0 65535 PHYS_UNIT "Enable bits" /end CHARACTERISTIC
/begin CHARACTERISTIC FPsw_FP2_maxv "FPrm_switches(358)" VALUE 0x00146BA8 /* @ECU_Address@FPrm_switches@0x021B92CC@ */ ECIPP_ALIGNMENT_UWORD 65535 Compu_IDENTITY 0 65535 PHYS_UNIT "Enable bits" /end CHARACTERISTIC
/begin CHARACTERISTIC FPsw_FP2_minv "FPrm_switches(359)" VALUE 0x00146BAA /* @ECU_Address@FPrm_switches@0x021B92CE@ */ ECIPP_ALIGNMENT_UWORD 65535 Compu_IDENTITY 0 65535 PHYS_UNIT "Enable bits" /end CHARACTERISTIC
/begin CHARACTERISTIC FPsw_FPD_off_hi "FPrm_switches(58)" VALUE 0x00146950 /* @ECU_Address@FPrm_switches@0x021B9074@ */ ECIPP_ALIGNMENT_UWORD 65535 Compu_IDENTITY 0 65535 PHYS_UNIT "Enable bits" /end CHARACTERISTIC
/begin CHARACTERISTIC FPsw_FPD_on_lo "FPrm_switches(57)" VALUE 0x0014694E /* @ECU_Address@FPrm_switches@0x021B9072@ */ ECIPP_ALIGNMENT_UWORD 65535 Compu_IDENTITY 0 65535 PHYS_UNIT "Enable bits" /end CHARACTERISTIC
/begin CHARACTERISTIC FPsw_FPlo_derate_actv "FPrm_switches(634)" VALUE 0x00146DD0 /* @ECU_Address@FPrm_switches@0x021B94F4@ */ ECIPP_ALIGNMENT_UWORD 65535 Compu_IDENTITY 0 65535 PHYS_UNIT "Enable bits" /end CHARACTERISTIC
/begin CHARACTERISTIC FPsw_FPlo_derate_excess "FPrm_switches(637)" VALUE 0x00146DD6 /* @ECU_Address@FPrm_switches@0x021B94FA@ */ ECIPP_ALIGNMENT_UWORD 65535 Compu_IDENTITY 0 65535 PHYS_UNIT "Enable bits" /end CHARACTERISTIC
/begin CHARACTERISTIC FPsw_FPP_NeutLock_fail "FPrm_switches(488)" VALUE 0x00146CAC /* @ECU_Address@FPrm_switches@0x021B93D0@ */ ECIPP_ALIGNMENT_UWORD 65535 Compu_IDENTITY 0 65535 PHYS_UNIT "Enable bits" /end CHARACTERISTIC
/begin CHARACTERISTIC FPsw_FPP1_IVS_max "FPrm_switches(30)" VALUE 0x00146918 /* @ECU_Address@FPrm_switches@0x021B903C@ */ ECIPP_ALIGNMENT_UWORD 65535 Compu_IDENTITY 0 65535 PHYS_UNIT "Enable bits" /end CHARACTERISTIC
/begin CHARACTERISTIC FPsw_FPP1_IVS_min "FPrm_switches(31)" VALUE 0x0014691A /* @ECU_Address@FPrm_switches@0x021B903E@ */ ECIPP_ALIGNMENT_UWORD 65535 Compu_IDENTITY 0 65535 PHYS_UNIT "Enable bits" /end CHARACTERISTIC
/begin CHARACTERISTIC FPsw_FPP1_max "FPrm_switches(26)" VALUE 0x00146910 /* @ECU_Address@FPrm_switches@0x021B9034@ */ ECIPP_ALIGNMENT_UWORD 65535 Compu_IDENTITY 0 65535 PHYS_UNIT "Enable bits" /end CHARACTERISTIC
/begin CHARACTERISTIC FPsw_FPP1_min "FPrm_switches(27)" VALUE 0x00146912 /* @ECU_Address@FPrm_switches@0x021B9036@ */ ECIPP_ALIGNMENT_UWORD 65535 Compu_IDENTITY 0 65535 PHYS_UNIT "Enable bits" /end CHARACTERISTIC
/begin CHARACTERISTIC FPsw_FPP12_IVS_max "FPrm_switches(135)" VALUE 0x001469EA /* @ECU_Address@FPrm_switches@0x021B910E@ */ ECIPP_ALIGNMENT_UWORD 65535 Compu_IDENTITY 0 65535 PHYS_UNIT "Enable bits" /end CHARACTERISTIC
/begin CHARACTERISTIC FPsw_FPP12_IVS_min "FPrm_switches(136)" VALUE 0x001469EC /* @ECU_Address@FPrm_switches@0x021B9110@ */ ECIPP_ALIGNMENT_UWORD 65535 Compu_IDENTITY 0 65535 PHYS_UNIT "Enable bits" /end CHARACTERISTIC
/begin CHARACTERISTIC FPsw_FPP12_OOR "FPrm_switches(137)" VALUE 0x001469EE /* @ECU_Address@FPrm_switches@0x021B9112@ */ ECIPP_ALIGNMENT_UWORD 65535 Compu_IDENTITY 0 65535 PHYS_UNIT "Enable bits" /end CHARACTERISTIC
/begin CHARACTERISTIC FPsw_FPP12IVS_TSC1 "FPrm_switches(564)" VALUE 0x00146D44 /* @ECU_Address@FPrm_switches@0x021B9468@ */ ECIPP_ALIGNMENT_UWORD 65535 Compu_IDENTITY 0 65535 PHYS_UNIT "Enable bits" /end CHARACTERISTIC
/begin CHARACTERISTIC FPsw_FPP12MM_IVSMM "FPrm_switches(140)" VALUE 0x001469F4 /* @ECU_Address@FPrm_switches@0x021B9118@ */ ECIPP_ALIGNMENT_UWORD 65535 Compu_IDENTITY 0 65535 PHYS_UNIT "Enable bits" /end CHARACTERISTIC
/begin CHARACTERISTIC FPsw_FPP12pct_hi "FPrm_switches(34)" VALUE 0x00146920 /* @ECU_Address@FPrm_switches@0x021B9044@ */ ECIPP_ALIGNMENT_UWORD 65535 Compu_IDENTITY 0 65535 PHYS_UNIT "Enable bits" /end CHARACTERISTIC
/begin CHARACTERISTIC FPsw_FPP12pct_lo "FPrm_switches(35)" VALUE 0x00146922 /* @ECU_Address@FPrm_switches@0x021B9046@ */ ECIPP_ALIGNMENT_UWORD 65535 Compu_IDENTITY 0 65535 PHYS_UNIT "Enable bits" /end CHARACTERISTIC
/begin CHARACTERISTIC FCdtc_EGR_slowdec "FCtl_DTC(660)" VALUE 0x00163A3C /* @ECU_Address@FCtl_DTC@0x021B5528@ */ ECIPP_ALIGNMENT_UWORD 65535 Compu_IDENTITY 0 65535 PHYS_UNIT "DTC" /end CHARACTERISTIC
/begin CHARACTERISTIC FCdtc_EGR_slowinc "FCtl_DTC(659)" VALUE 0x00163A3A /* @ECU_Address@FCtl_DTC@0x021B5526@ */ ECIPP_ALIGNMENT_UWORD 65535 Compu_IDENTITY 0 65535 PHYS_UNIT "DTC" /end CHARACTERISTIC
/begin CHARACTERISTIC FCdtc_EGR_UEGOdP_hi "FCtl_DTC(663)" VALUE 0x00163A42 /* @ECU_Address@FCtl_DTC@0x021B552E@ */ ECIPP_ALIGNMENT_UWORD 65535 Compu_IDENTITY 0 65535 PHYS_UNIT "DTC" /end CHARACTERISTIC
/begin CHARACTERISTIC FCdtc_EGR_UEGOdP_lo "FCtl_DTC(664)" VALUE 0x00163A44 /* @ECU_Address@FCtl_DTC@0x021B5530@ */ ECIPP_ALIGNMENT_UWORD 65535 Compu_IDENTITY 0 65535 PHYS_UNIT "DTC" /end CHARACTERISTIC
/begin CHARACTERISTIC FCdtc_EGR_vlv_DC_lim "FCtl_DTC(743)" VALUE 0x00163AE2 /* @ECU_Address@FCtl_DTC@0x021B55CE@ */ ECIPP_ALIGNMENT_UWORD 65535 Compu_IDENTITY 0 65535 PHYS_UNIT "DTC" /end CHARACTERISTIC
/begin CHARACTERISTIC FCdtc_EGR_vlv_stuck "FCtl_DTC(833)" VALUE 0x00163B96 /* @ECU_Address@FCtl_DTC@0x021B5682@ */ ECIPP_ALIGNMENT_UWORD 65535 Compu_IDENTITY 0 65535 PHYS_UNIT "DTC" /end CHARACTERISTIC
/begin CHARACTERISTIC FCdtc_EGR_vlv_temp_hi "FCtl_DTC(744)" VALUE 0x00163AE4 /* @ECU_Address@FCtl_DTC@0x021B55D0@ */ ECIPP_ALIGNMENT_UWORD 65535 Compu_IDENTITY 0 65535 PHYS_UNIT "DTC" /end CHARACTERISTIC
/begin CHARACTERISTIC FCdtc_EGR_vlvCAN_commlost "FCtl_DTC(667)" VALUE 0x00163A4A /* @ECU_Address@FCtl_DTC@0x021B5536@ */ ECIPP_ALIGNMENT_UWORD 65535 Compu_IDENTITY 0 65535 PHYS_UNIT "DTC" /end CHARACTERISTIC
/begin CHARACTERISTIC FCdtc_EGR_vlvCAN_lowfunc "FCtl_DTC(669)" VALUE 0x00163A4E /* @ECU_Address@FCtl_DTC@0x021B553A@ */ ECIPP_ALIGNMENT_UWORD 65535 Compu_IDENTITY 0 65535 PHYS_UNIT "DTC" /end CHARACTERISTIC
/begin CHARACTERISTIC FCdtc_EGR_vlvCAN_nofunc "FCtl_DTC(668)" VALUE 0x00163A4C /* @ECU_Address@FCtl_DTC@0x021B5538@ */ ECIPP_ALIGNMENT_UWORD 65535 Compu_IDENTITY 0 65535 PHYS_UNIT "DTC" /end CHARACTERISTIC
/begin CHARACTERISTIC FCdtc_EGRdP_HiExp "FCtl_DTC(752)" VALUE 0x00163AF4 /* @ECU_Address@FCtl_DTC@0x021B55E0@ */ ECIPP_ALIGNMENT_UWORD 65535 Compu_IDENTITY 0 65535 PHYS_UNIT "DTC" /end CHARACTERISTIC
/begin CHARACTERISTIC FCdtc_EGRdP_LoExp "FCtl_DTC(751)" VALUE 0x00163AF2 /* @ECU_Address@FCtl_DTC@0x021B55DE@ */ ECIPP_ALIGNMENT_UWORD 65535 Compu_IDENTITY 0 65535 PHYS_UNIT "DTC" /end CHARACTERISTIC
/begin CHARACTERISTIC FCdtc_EGRdP_maxv "FCtl_DTC(749)" VALUE 0x00163AEE /* @ECU_Address@FCtl_DTC@0x021B55DA@ */ ECIPP_ALIGNMENT_UWORD 65535 Compu_IDENTITY 0 65535 PHYS_UNIT "DTC" /end CHARACTERISTIC
/begin CHARACTERISTIC FCdtc_EGRdP_minv "FCtl_DTC(750)" VALUE 0x00163AF0 /* @ECU_Address@FCtl_DTC@0x021B55DC@ */ ECIPP_ALIGNMENT_UWORD 65535 Compu_IDENTITY 0 65535 PHYS_UNIT "DTC" /end CHARACTERISTIC
/begin CHARACTERISTIC FCdtc_EGRflow_HiExp "FCtl_DTC(597)" VALUE 0x001639BE /* @ECU_Address@FCtl_DTC@0x021B54AA@ */ ECIPP_ALIGNMENT_UWORD 65535 Compu_IDENTITY 0 65535 PHYS_UNIT "DTC" /end CHARACTERISTIC
/begin CHARACTERISTIC FCdtc_EGRflow_LoExp "FCtl_DTC(596)" VALUE 0x001639BC /* @ECU_Address@FCtl_DTC@0x021B54A8@ */ ECIPP_ALIGNMENT_UWORD 65535 Compu_IDENTITY 0 65535 PHYS_UNIT "DTC" /end CHARACTERISTIC
/begin CHARACTERISTIC FCdtc_EGRflow_LoExp2 "FCtl_DTC(684)" VALUE 0x00163A6C /* @ECU_Address@FCtl_DTC@0x021B5558@ */ ECIPP_ALIGNMENT_UWORD 65535 Compu_IDENTITY 0 65535 PHYS_UNIT "DTC" /end CHARACTERISTIC
/begin CHARACTERISTIC FCdtc_EGRHP_maxv "FCtl_DTC(753)" VALUE 0x00163AF6 /* @ECU_Address@FCtl_DTC@0x021B55E2@ */ ECIPP_ALIGNMENT_UWORD 65535 Compu_IDENTITY 0 65535 PHYS_UNIT "DTC" /end CHARACTERISTIC
/begin CHARACTERISTIC FCdtc_EGRHP_minv "FCtl_DTC(754)" VALUE 0x00163AF8 /* @ECU_Address@FCtl_DTC@0x021B55E4@ */ ECIPP_ALIGNMENT_UWORD 65535 Compu_IDENTITY 0 65535 PHYS_UNIT "DTC" /end CHARACTERISTIC
/begin CHARACTERISTIC FCdtc_EGRHP_OOR "FCtl_DTC(755)" VALUE 0x00163AFA /* @ECU_Address@FCtl_DTC@0x021B55E6@ */ ECIPP_ALIGNMENT_UWORD 65535 Compu_IDENTITY 0 65535 PHYS_UNIT "DTC" /end CHARACTERISTIC
/begin CHARACTERISTIC FCdtc_EGRO_postlk "FCtl_DTC(798)" VALUE 0x00163B50 /* @ECU_Address@FCtl_DTC@0x021B563C@ */ ECIPP_ALIGNMENT_UWORD 65535 Compu_IDENTITY 0 65535 PHYS_UNIT "DTC" /end CHARACTERISTIC
/begin CHARACTERISTIC FCdtc_EGRT_hi "FCtl_DTC(694)" VALUE 0x00163A80 /* @ECU_Address@FCtl_DTC@0x021B556C@ */ ECIPP_ALIGNMENT_UWORD 65535 Compu_IDENTITY 0 65535 PHYS_UNIT "DTC" /end CHARACTERISTIC
/begin CHARACTERISTIC FCdtc_EGRT_maxv "FCtl_DTC(692)" VALUE 0x00163A7C /* @ECU_Address@FCtl_DTC@0x021B5568@ */ ECIPP_ALIGNMENT_UWORD 65535 Compu_IDENTITY 0 65535 PHYS_UNIT "DTC" /end CHARACTERISTIC
/begin CHARACTERISTIC FCdtc_EGRT_minv "FCtl_DTC(693)" VALUE 0x00163A7E /* @ECU_Address@FCtl_DTC@0x021B556A@ */ ECIPP_ALIGNMENT_UWORD 65535 Compu_IDENTITY 0 65535 PHYS_UNIT "DTC" /end CHARACTERISTIC
/begin CHARACTERISTIC FCdtc_EGT_dig_Hi "FCtl_DTC(187)" VALUE 0x0016368A /* @ECU_Address@FCtl_DTC@0x021B5176@ */ ECIPP_ALIGNMENT_UWORD 65535 Compu_IDENTITY 0 65535 PHYS_UNIT "DTC" /end CHARACTERISTIC
/begin CHARACTERISTIC FCdtc_EGT_maxv "FCtl_DTC(808)" VALUE 0x00163B64 /* @ECU_Address@FCtl_DTC@0x021B5650@ */ ECIPP_ALIGNMENT_UWORD 65535 Compu_IDENTITY 0 65535 PHYS_UNIT "DTC" /end CHARACTERISTIC
/begin CHARACTERISTIC FCdtc_EGT_minv "FCtl_DTC(809)" VALUE 0x00163B66 /* @ECU_Address@FCtl_DTC@0x021B5652@ */ ECIPP_ALIGNMENT_UWORD 65535 Compu_IDENTITY 0 65535 PHYS_UNIT "DTC" /end CHARACTERISTIC
/begin CHARACTERISTIC FCdtc_EMWT1_HiExp1 "FCtl_DTC(225)" VALUE 0x001636D6 /* @ECU_Address@FCtl_DTC@0x021B51C2@ */ ECIPP_ALIGNMENT_UWORD 65535 Compu_IDENTITY 0 65535 PHYS_UNIT "DTC" /end CHARACTERISTIC
/begin CHARACTERISTIC FCdtc_EMWT1_HiExp2 "FCtl_DTC(227)" VALUE 0x001636DA /* @ECU_Address@FCtl_DTC@0x021B51C6@ */ ECIPP_ALIGNMENT_UWORD 65535 Compu_IDENTITY 0 65535 PHYS_UNIT "DTC" /end CHARACTERISTIC
/begin CHARACTERISTIC FCdtc_EMWT1_maxv "FCtl_DTC(221)" VALUE 0x001636CE /* @ECU_Address@FCtl_DTC@0x021B51BA@ */ ECIPP_ALIGNMENT_UWORD 65535 Compu_IDENTITY 0 65535 PHYS_UNIT "DTC" /end CHARACTERISTIC
/begin CHARACTERISTIC FCdtc_EMWT1_minv "FCtl_DTC(223)" VALUE 0x001636D2 /* @ECU_Address@FCtl_DTC@0x021B51BE@ */ ECIPP_ALIGNMENT_UWORD 65535 Compu_IDENTITY 0 65535 PHYS_UNIT "DTC" /end CHARACTERISTIC
/begin CHARACTERISTIC FCdtc_envtech_AAT_inv "FCtl_DTC(814)" VALUE 0x00163B70 /* @ECU_Address@FCtl_DTC@0x021B565C@ */ ECIPP_ALIGNMENT_UWORD 65535 Compu_IDENTITY 0 65535 PHYS_UNIT "DTC" /end CHARACTERISTIC
/begin CHARACTERISTIC FCdtc_envtech_BP_inv "FCtl_DTC(815)" VALUE 0x00163B72 /* @ECU_Address@FCtl_DTC@0x021B565E@ */ ECIPP_ALIGNMENT_UWORD 65535 Compu_IDENTITY 0 65535 PHYS_UNIT "DTC" /end CHARACTERISTIC
/begin CHARACTERISTIC FCdtc_envtech_comm "FCtl_DTC(358)" VALUE 0x001637E0 /* @ECU_Address@FCtl_DTC@0x021B52CC@ */ ECIPP_ALIGNMENT_UWORD 65535 Compu_IDENTITY 0 65535 PHYS_UNIT "DTC" /end CHARACTERISTIC
/begin CHARACTERISTIC FCdtc_envtech_general "FCtl_DTC(817)" VALUE 0x00163B76 /* @ECU_Address@FCtl_DTC@0x021B5662@ */ ECIPP_ALIGNMENT_UWORD 65535 Compu_IDENTITY 0 65535 PHYS_UNIT "DTC" /end CHARACTERISTIC
/begin CHARACTERISTIC FCdtc_envtech_RH_inv "FCtl_DTC(816)" VALUE 0x00163B74 /* @ECU_Address@FCtl_DTC@0x021B5660@ */ ECIPP_ALIGNMENT_UWORD 65535 Compu_IDENTITY 0 65535 PHYS_UNIT "DTC" /end CHARACTERISTIC
/begin CHARACTERISTIC FCdtc_envtech_RH_uns "FCtl_DTC(818)" VALUE 0x00163B78 /* @ECU_Address@FCtl_DTC@0x021B5664@ */ ECIPP_ALIGNMENT_UWORD 65535 Compu_IDENTITY 0 65535 PHYS_UNIT "DTC" /end CHARACTERISTIC
/begin CHARACTERISTIC FCdtc_ERCV_speed_OOR "FCtl_DTC(853)" VALUE 0x00163BBE /* @ECU_Address@FCtl_DTC@0x021B56AA@ */ ECIPP_ALIGNMENT_UWORD 65535 Compu_IDENTITY 0 65535 PHYS_UNIT "DTC" /end CHARACTERISTIC
/begin CHARACTERISTIC FCdtc_ERWT1_HiExp1 "FCtl_DTC(237)" VALUE 0x001636EE /* @ECU_Address@FCtl_DTC@0x021B51DA@ */ ECIPP_ALIGNMENT_UWORD 65535 Compu_IDENTITY 0 65535 PHYS_UNIT "DTC" /end CHARACTERISTIC
/begin CHARACTERISTIC FCdtc_ERWT1_HiExp2 "FCtl_DTC(239)" VALUE 0x001636F2 /* @ECU_Address@FCtl_DTC@0x021B51DE@ */ ECIPP_ALIGNMENT_UWORD 65535 Compu_IDENTITY 0 65535 PHYS_UNIT "DTC" /end CHARACTERISTIC
/begin CHARACTERISTIC FCdtc_ERWT1_maxv "FCtl_DTC(233)" VALUE 0x001636E6 /* @ECU_Address@FCtl_DTC@0x021B51D2@ */ ECIPP_ALIGNMENT_UWORD 65535 Compu_IDENTITY 0 65535 PHYS_UNIT "DTC" /end CHARACTERISTIC
/begin CHARACTERISTIC FCdtc_ERWT1_minv "FCtl_DTC(235)" VALUE 0x001636EA /* @ECU_Address@FCtl_DTC@0x021B51D6@ */ ECIPP_ALIGNMENT_UWORD 65535 Compu_IDENTITY 0 65535 PHYS_UNIT "DTC" /end CHARACTERISTIC
/begin CHARACTERISTIC FCdtc_F1OOR_F2IVS "FCtl_DTC(178)" VALUE 0x00163678 /* @ECU_Address@FCtl_DTC@0x021B5164@ */ ECIPP_ALIGNMENT_UWORD 65535 Compu_IDENTITY 0 65535 PHYS_UNIT "DTC" /end CHARACTERISTIC
/begin CHARACTERISTIC FCdtc_F2OOR_F1IVS "FCtl_DTC(179)" VALUE 0x0016367A /* @ECU_Address@FCtl_DTC@0x021B5166@ */ ECIPP_ALIGNMENT_UWORD 65535 Compu_IDENTITY 0 65535 PHYS_UNIT "DTC" /end CHARACTERISTIC
/begin CHARACTERISTIC FCdtc_FCoolH2O_lo "FCtl_DTC(532)" VALUE 0x0016393C /* @ECU_Address@FCtl_DTC@0x021B5428@ */ ECIPP_ALIGNMENT_UWORD 65535 Compu_IDENTITY 0 65535 PHYS_UNIT "DTC" /end CHARACTERISTIC
/begin CHARACTERISTIC FCdtc_FIMP_pct_high "FCtl_DTC(282)" VALUE 0x00163748 /* @ECU_Address@FCtl_DTC@0x021B5234@ */ ECIPP_ALIGNMENT_UWORD 65535 Compu_IDENTITY 0 65535 PHYS_UNIT "DTC" /end CHARACTERISTIC
/begin CHARACTERISTIC FCdtc_FIP_LoExp "FCtl_DTC(695)" VALUE 0x00163A82 /* @ECU_Address@FCtl_DTC@0x021B556E@ */ ECIPP_ALIGNMENT_UWORD 65535 Compu_IDENTITY 0 65535 PHYS_UNIT "DTC" /end CHARACTERISTIC
/begin CHARACTERISTIC FCdtc_flash_fail "FCtl_DTC(105)" VALUE 0x001635E6 /* @ECU_Address@FCtl_DTC@0x021B50D2@ */ ECIPP_ALIGNMENT_UWORD 65535 Compu_IDENTITY 0 65535 PHYS_UNIT "DTC" /end CHARACTERISTIC
/begin CHARACTERISTIC FCdtc_FP_high "FCtl_DTC(290)" VALUE 0x00163758 /* @ECU_Address@FCtl_DTC@0x021B5244@ */ ECIPP_ALIGNMENT_UWORD 65535 Compu_IDENTITY 0 65535 PHYS_UNIT "DTC" /end CHARACTERISTIC
/begin CHARACTERISTIC FCdtc_FP_low "FCtl_DTC(291)" VALUE 0x0016375A /* @ECU_Address@FCtl_DTC@0x021B5246@ */ ECIPP_ALIGNMENT_UWORD 65535 Compu_IDENTITY 0 65535 PHYS_UNIT "DTC" /end CHARACTERISTIC
/begin CHARACTERISTIC FCdtc_FP_maxv "FCtl_DTC(128)" VALUE 0x00163614 /* @ECU_Address@FCtl_DTC@0x021B5100@ */ ECIPP_ALIGNMENT_UWORD 65535 Compu_IDENTITY 0 65535 PHYS_UNIT "DTC" /end CHARACTERISTIC
/begin CHARACTERISTIC FCdtc_FP_minv "FCtl_DTC(129)" VALUE 0x00163616 /* @ECU_Address@FCtl_DTC@0x021B5102@ */ ECIPP_ALIGNMENT_UWORD 65535 Compu_IDENTITY 0 65535 PHYS_UNIT "DTC" /end CHARACTERISTIC
/begin CHARACTERISTIC FCdtc_FP2_high "FCtl_DTC(463)" VALUE 0x001638B2 /* @ECU_Address@FCtl_DTC@0x021B539E@ */ ECIPP_ALIGNMENT_UWORD 65535 Compu_IDENTITY 0 65535 PHYS_UNIT "DTC" /end CHARACTERISTIC
/begin CHARACTERISTIC FCdtc_FP2_low "FCtl_DTC(464)" VALUE 0x001638B4 /* @ECU_Address@FCtl_DTC@0x021B53A0@ */ ECIPP_ALIGNMENT_UWORD 65535 Compu_IDENTITY 0 65535 PHYS_UNIT "DTC" /end CHARACTERISTIC
/begin CHARACTERISTIC FCdtc_FP2_maxv "FCtl_DTC(461)" VALUE 0x001638AE /* @ECU_Address@FCtl_DTC@0x021B539A@ */ ECIPP_ALIGNMENT_UWORD 65535 Compu_IDENTITY 0 65535 PHYS_UNIT "DTC" /end CHARACTERISTIC
/begin CHARACTERISTIC FCdtc_FP2_minv "FCtl_DTC(462)" VALUE 0x001638B0 /* @ECU_Address@FCtl_DTC@0x021B539C@ */ ECIPP_ALIGNMENT_UWORD 65535 Compu_IDENTITY 0 65535 PHYS_UNIT "DTC" /end CHARACTERISTIC
/begin CHARACTERISTIC FCdtc_FPD_off_hi "FCtl_DTC(94)" VALUE 0x001635D0 /* @ECU_Address@FCtl_DTC@0x021B50BC@ */ ECIPP_ALIGNMENT_UWORD 65535 Compu_IDENTITY 0 65535 PHYS_UNIT "DTC" /end CHARACTERISTIC
/begin CHARACTERISTIC FCdtc_FPD_on_lo "FCtl_DTC(93)" VALUE 0x001635CE /* @ECU_Address@FCtl_DTC@0x021B50BA@ */ ECIPP_ALIGNMENT_UWORD 65535 Compu_IDENTITY 0 65535 PHYS_UNIT "DTC" /end CHARACTERISTIC
/begin CHARACTERISTIC FCdtc_FPlo_derate_actv "FCtl_DTC(807)" VALUE 0x00163B62 /* @ECU_Address@FCtl_DTC@0x021B564E@ */ ECIPP_ALIGNMENT_UWORD 65535 Compu_IDENTITY 0 65535 PHYS_UNIT "DTC" /end CHARACTERISTIC
/begin CHARACTERISTIC FCdtc_FPlo_derate_excess "FCtl_DTC(810)" VALUE 0x00163B68 /* @ECU_Address@FCtl_DTC@0x021B5654@ */ ECIPP_ALIGNMENT_UWORD 65535 Compu_IDENTITY 0 65535 PHYS_UNIT "DTC" /end CHARACTERISTIC
/begin CHARACTERISTIC FCdtc_FPP_NeutLock_fail "FCtl_DTC(658)" VALUE 0x00163A38 /* @ECU_Address@FCtl_DTC@0x021B5524@ */ ECIPP_ALIGNMENT_UWORD 65535 Compu_IDENTITY 0 65535 PHYS_UNIT "DTC" /end CHARACTERISTIC
/begin CHARACTERISTIC FCdtc_FPP1_IVS_max "FCtl_DTC(23)" VALUE 0x00163542 /* @ECU_Address@FCtl_DTC@0x021B502E@ */ ECIPP_ALIGNMENT_UWORD 65535 Compu_IDENTITY 0 65535 PHYS_UNIT "DTC" /end CHARACTERISTIC
/begin CHARACTERISTIC FCdtc_FPP1_IVS_min "FCtl_DTC(24)" VALUE 0x00163544 /* @ECU_Address@FCtl_DTC@0x021B5030@ */ ECIPP_ALIGNMENT_UWORD 65535 Compu_IDENTITY 0 65535 PHYS_UNIT "DTC" /end CHARACTERISTIC
/begin CHARACTERISTIC FCdtc_FPP1_max "FCtl_DTC(19)" VALUE 0x0016353A /* @ECU_Address@FCtl_DTC@0x021B5026@ */ ECIPP_ALIGNMENT_UWORD 65535 Compu_IDENTITY 0 65535 PHYS_UNIT "DTC" /end CHARACTERISTIC
/begin CHARACTERISTIC FCdtc_FPP1_min "FCtl_DTC(20)" VALUE 0x0016353C /* @ECU_Address@FCtl_DTC@0x021B5028@ */ ECIPP_ALIGNMENT_UWORD 65535 Compu_IDENTITY 0 65535 PHYS_UNIT "DTC" /end CHARACTERISTIC
/begin CHARACTERISTIC FCdtc_FPP12_IVS_max "FCtl_DTC(175)" VALUE 0x00163672 /* @ECU_Address@FCtl_DTC@0x021B515E@ */ ECIPP_ALIGNMENT_UWORD 65535 Compu_IDENTITY 0 65535 PHYS_UNIT "DTC" /end CHARACTERISTIC
/begin CHARACTERISTIC FCdtc_FPP12_IVS_min "FCtl_DTC(176)" VALUE 0x00163674 /* @ECU_Address@FCtl_DTC@0x021B5160@ */ ECIPP_ALIGNMENT_UWORD 65535 Compu_IDENTITY 0 65535 PHYS_UNIT "DTC" /end CHARACTERISTIC
/begin CHARACTERISTIC FCdtc_FPP12_OOR "FCtl_DTC(177)" VALUE 0x00163676 /* @ECU_Address@FCtl_DTC@0x021B5162@ */ ECIPP_ALIGNMENT_UWORD 65535 Compu_IDENTITY 0 65535 PHYS_UNIT "DTC" /end CHARACTERISTIC
/begin CHARACTERISTIC FCdtc_FPP12IVS_TSC1 "FCtl_DTC(734)" VALUE 0x00163AD0 /* @ECU_Address@FCtl_DTC@0x021B55BC@ */ ECIPP_ALIGNMENT_UWORD 65535 Compu_IDENTITY 0 65535 PHYS_UNIT "DTC" /end CHARACTERISTIC
/begin CHARACTERISTIC FCdtc_FPP12MM_IVSMM "FCtl_DTC(180)" VALUE 0x0016367C /* @ECU_Address@FCtl_DTC@0x021B5168@ */ ECIPP_ALIGNMENT_UWORD 65535 Compu_IDENTITY 0 65535 PHYS_UNIT "DTC" /end CHARACTERISTIC
/begin CHARACTERISTIC FCdtc_FPP12pct_hi "FCtl_DTC(27)" VALUE 0x0016354A /* @ECU_Address@FCtl_DTC@0x021B5036@ */ ECIPP_ALIGNMENT_UWORD 65535 Compu_IDENTITY 0 65535 PHYS_UNIT "DTC" /end CHARACTERISTIC
/begin CHARACTERISTIC FCdtc_FPP12pct_lo "FCtl_DTC(28)" VALUE 0x0016354C /* @ECU_Address@FCtl_DTC@0x021B5038@ */ ECIPP_ALIGNMENT_UWORD 65535 Compu_IDENTITY 0 65535 PHYS_UNIT "DTC" /end CHARACTERISTIC
/begin CHARACTERISTIC FCfmi_EGR_slowdec "FCtl_FMI(660)" VALUE 0x001653A7 /* @ECU_Address@FCtl_FMI@0x021B7294@ */ ECIPP_ALIGNMENT_UBYTE 255 Compu_IDENTITY 0 255 PHYS_UNIT "FMI" /end CHARACTERISTIC
/begin CHARACTERISTIC FCfmi_EGR_slowinc "FCtl_FMI(659)" VALUE 0x001653A6 /* @ECU_Address@FCtl_FMI@0x021B7293@ */ ECIPP_ALIGNMENT_UBYTE 255 Compu_IDENTITY 0 255 PHYS_UNIT "FMI" /end CHARACTERISTIC
/begin CHARACTERISTIC FCfmi_EGR_UEGOdP_hi "FCtl_FMI(663)" VALUE 0x001653AA /* @ECU_Address@FCtl_FMI@0x021B7297@ */ ECIPP_ALIGNMENT_UBYTE 255 Compu_IDENTITY 0 255 PHYS_UNIT "FMI" /end CHARACTERISTIC
/begin CHARACTERISTIC FCfmi_EGR_UEGOdP_lo "FCtl_FMI(664)" VALUE 0x001653AB /* @ECU_Address@FCtl_FMI@0x021B7298@ */ ECIPP_ALIGNMENT_UBYTE 255 Compu_IDENTITY 0 255 PHYS_UNIT "FMI" /end CHARACTERISTIC
/begin CHARACTERISTIC FCfmi_EGR_vlv_DC_lim "FCtl_FMI(743)" VALUE 0x001653FA /* @ECU_Address@FCtl_FMI@0x021B72E7@ */ ECIPP_ALIGNMENT_UBYTE 255 Compu_IDENTITY 0 255 PHYS_UNIT "FMI" /end CHARACTERISTIC
/begin CHARACTERISTIC FCfmi_EGR_vlv_stuck "FCtl_FMI(833)" VALUE 0x00165454 /* @ECU_Address@FCtl_FMI@0x021B7341@ */ ECIPP_ALIGNMENT_UBYTE 255 Compu_IDENTITY 0 255 PHYS_UNIT "FMI" /end CHARACTERISTIC
/begin CHARACTERISTIC FCfmi_EGR_vlv_temp_hi "FCtl_FMI(744)" VALUE 0x001653FB /* @ECU_Address@FCtl_FMI@0x021B72E8@ */ ECIPP_ALIGNMENT_UBYTE 255 Compu_IDENTITY 0 255 PHYS_UNIT "FMI" /end CHARACTERISTIC
/begin CHARACTERISTIC FCfmi_EGR_vlvCAN_commlost "FCtl_FMI(667)" VALUE 0x001653AE /* @ECU_Address@FCtl_FMI@0x021B729B@ */ ECIPP_ALIGNMENT_UBYTE 255 Compu_IDENTITY 0 255 PHYS_UNIT "FMI" /end CHARACTERISTIC
/begin CHARACTERISTIC FCfmi_EGR_vlvCAN_lowfunc "FCtl_FMI(669)" VALUE 0x001653B0 /* @ECU_Address@FCtl_FMI@0x021B729D@ */ ECIPP_ALIGNMENT_UBYTE 255 Compu_IDENTITY 0 255 PHYS_UNIT "FMI" /end CHARACTERISTIC
/begin CHARACTERISTIC FCfmi_EGR_vlvCAN_nofunc "FCtl_FMI(668)" VALUE 0x001653AF /* @ECU_Address@FCtl_FMI@0x021B729C@ */ ECIPP_ALIGNMENT_UBYTE 255 Compu_IDENTITY 0 255 PHYS_UNIT "FMI" /end CHARACTERISTIC
/begin CHARACTERISTIC FCfmi_EGRdP_HiExp "FCtl_FMI(752)" VALUE 0x00165403 /* @ECU_Address@FCtl_FMI@0x021B72F0@ */ ECIPP_ALIGNMENT_UBYTE 255 Compu_IDENTITY 0 255 PHYS_UNIT "FMI" /end CHARACTERISTIC
/begin CHARACTERISTIC FCfmi_EGRdP_LoExp "FCtl_FMI(751)" VALUE 0x00165402 /* @ECU_Address@FCtl_FMI@0x021B72EF@ */ ECIPP_ALIGNMENT_UBYTE 255 Compu_IDENTITY 0 255 PHYS_UNIT "FMI" /end CHARACTERISTIC
/begin CHARACTERISTIC FCfmi_EGRdP_maxv "FCtl_FMI(749)" VALUE 0x00165400 /* @ECU_Address@FCtl_FMI@0x021B72ED@ */ ECIPP_ALIGNMENT_UBYTE 255 Compu_IDENTITY 0 255 PHYS_UNIT "FMI" /end CHARACTERISTIC
/begin CHARACTERISTIC FCfmi_EGRdP_minv "FCtl_FMI(750)" VALUE 0x00165401 /* @ECU_Address@FCtl_FMI@0x021B72EE@ */ ECIPP_ALIGNMENT_UBYTE 255 Compu_IDENTITY 0 255 PHYS_UNIT "FMI" /end CHARACTERISTIC
/begin CHARACTERISTIC FCfmi_EGRflow_HiExp "FCtl_FMI(597)" VALUE 0x00165368 /* @ECU_Address@FCtl_FMI@0x021B7255@ */ ECIPP_ALIGNMENT_UBYTE 255 Compu_IDENTITY 0 255 PHYS_UNIT "FMI" /end CHARACTERISTIC
/begin CHARACTERISTIC FCfmi_EGRflow_LoExp "FCtl_FMI(596)" VALUE 0x00165367 /* @ECU_Address@FCtl_FMI@0x021B7254@ */ ECIPP_ALIGNMENT_UBYTE 255 Compu_IDENTITY 0 255 PHYS_UNIT "FMI" /end CHARACTERISTIC
/begin CHARACTERISTIC FCfmi_EGRflow_LoExp2 "FCtl_FMI(684)" VALUE 0x001653BF /* @ECU_Address@FCtl_FMI@0x021B72AC@ */ ECIPP_ALIGNMENT_UBYTE 255 Compu_IDENTITY 0 255 PHYS_UNIT "FMI" /end CHARACTERISTIC
/begin CHARACTERISTIC FCfmi_EGRHP_maxv "FCtl_FMI(753)" VALUE 0x00165404 /* @ECU_Address@FCtl_FMI@0x021B72F1@ */ ECIPP_ALIGNMENT_UBYTE 255 Compu_IDENTITY 0 255 PHYS_UNIT "FMI" /end CHARACTERISTIC
/begin CHARACTERISTIC FCfmi_EGRHP_minv "FCtl_FMI(754)" VALUE 0x00165405 /* @ECU_Address@FCtl_FMI@0x021B72F2@ */ ECIPP_ALIGNMENT_UBYTE 255 Compu_IDENTITY 0 255 PHYS_UNIT "FMI" /end CHARACTERISTIC
/begin CHARACTERISTIC FCfmi_EGRHP_OOR "FCtl_FMI(755)" VALUE 0x00165406 /* @ECU_Address@FCtl_FMI@0x021B72F3@ */ ECIPP_ALIGNMENT_UBYTE 255 Compu_IDENTITY 0 255 PHYS_UNIT "FMI" /end CHARACTERISTIC
/begin CHARACTERISTIC FCfmi_EGRO_postlk "FCtl_FMI(798)" VALUE 0x00165431 /* @ECU_Address@FCtl_FMI@0x021B731E@ */ ECIPP_ALIGNMENT_UBYTE 255 Compu_IDENTITY 0 255 PHYS_UNIT "FMI" /end CHARACTERISTIC
/begin CHARACTERISTIC FCfmi_EGRT_hi "FCtl_FMI(694)" VALUE 0x001653C9 /* @ECU_Address@FCtl_FMI@0x021B72B6@ */ ECIPP_ALIGNMENT_UBYTE 255 Compu_IDENTITY 0 255 PHYS_UNIT "FMI" /end CHARACTERISTIC
/begin CHARACTERISTIC FCfmi_EGRT_maxv "FCtl_FMI(692)" VALUE 0x001653C7 /* @ECU_Address@FCtl_FMI@0x021B72B4@ */ ECIPP_ALIGNMENT_UBYTE 255 Compu_IDENTITY 0 255 PHYS_UNIT "FMI" /end CHARACTERISTIC
/begin CHARACTERISTIC FCfmi_EGRT_minv "FCtl_FMI(693)" VALUE 0x001653C8 /* @ECU_Address@FCtl_FMI@0x021B72B5@ */ ECIPP_ALIGNMENT_UBYTE 255 Compu_IDENTITY 0 255 PHYS_UNIT "FMI" /end CHARACTERISTIC
/begin CHARACTERISTIC FCfmi_EGT_dig_Hi "FCtl_FMI(187)" VALUE 0x001651CE /* @ECU_Address@FCtl_FMI@0x021B70BB@ */ ECIPP_ALIGNMENT_UBYTE 255 Compu_IDENTITY 0 255 PHYS_UNIT "FMI" /end CHARACTERISTIC
/begin CHARACTERISTIC FCfmi_EGT_maxv "FCtl_FMI(808)" VALUE 0x0016543B /* @ECU_Address@FCtl_FMI@0x021B7328@ */ ECIPP_ALIGNMENT_UBYTE 255 Compu_IDENTITY 0 255 PHYS_UNIT "FMI" /end CHARACTERISTIC
/begin CHARACTERISTIC FCfmi_EGT_minv "FCtl_FMI(809)" VALUE 0x0016543C /* @ECU_Address@FCtl_FMI@0x021B7329@ */ ECIPP_ALIGNMENT_UBYTE 255 Compu_IDENTITY 0 255 PHYS_UNIT "FMI" /end CHARACTERISTIC
/begin CHARACTERISTIC FCfmi_EMWT1_HiExp1 "FCtl_FMI(225)" VALUE 0x001651F4 /* @ECU_Address@FCtl_FMI@0x021B70E1@ */ ECIPP_ALIGNMENT_UBYTE 255 Compu_IDENTITY 0 255 PHYS_UNIT "FMI" /end CHARACTERISTIC
/begin CHARACTERISTIC FCfmi_EMWT1_HiExp2 "FCtl_FMI(227)" VALUE 0x001651F6 /* @ECU_Address@FCtl_FMI@0x021B70E3@ */ ECIPP_ALIGNMENT_UBYTE 255 Compu_IDENTITY 0 255 PHYS_UNIT "FMI" /end CHARACTERISTIC
/begin CHARACTERISTIC FCfmi_EMWT1_maxv "FCtl_FMI(221)" VALUE 0x001651F0 /* @ECU_Address@FCtl_FMI@0x021B70DD@ */ ECIPP_ALIGNMENT_UBYTE 255 Compu_IDENTITY 0 255 PHYS_UNIT "FMI" /end CHARACTERISTIC
/begin CHARACTERISTIC FCfmi_EMWT1_minv "FCtl_FMI(223)" VALUE 0x001651F2 /* @ECU_Address@FCtl_FMI@0x021B70DF@ */ ECIPP_ALIGNMENT_UBYTE 255 Compu_IDENTITY 0 255 PHYS_UNIT "FMI" /end CHARACTERISTIC
/begin CHARACTERISTIC FCfmi_envtech_AAT_inv "FCtl_FMI(814)" VALUE 0x00165441 /* @ECU_Address@FCtl_FMI@0x021B732E@ */ ECIPP_ALIGNMENT_UBYTE 255 Compu_IDENTITY 0 255 PHYS_UNIT "FMI" /end CHARACTERISTIC
/begin CHARACTERISTIC FCfmi_envtech_BP_inv "FCtl_FMI(815)" VALUE 0x00165442 /* @ECU_Address@FCtl_FMI@0x021B732F@ */ ECIPP_ALIGNMENT_UBYTE 255 Compu_IDENTITY 0 255 PHYS_UNIT "FMI" /end CHARACTERISTIC
/begin CHARACTERISTIC FCfmi_envtech_comm "FCtl_FMI(358)" VALUE 0x00165279 /* @ECU_Address@FCtl_FMI@0x021B7166@ */ ECIPP_ALIGNMENT_UBYTE 255 Compu_IDENTITY 0 255 PHYS_UNIT "FMI" /end CHARACTERISTIC
/begin CHARACTERISTIC FCfmi_envtech_general "FCtl_FMI(817)" VALUE 0x00165444 /* @ECU_Address@FCtl_FMI@0x021B7331@ */ ECIPP_ALIGNMENT_UBYTE 255 Compu_IDENTITY 0 255 PHYS_UNIT "FMI" /end CHARACTERISTIC
/begin CHARACTERISTIC FCfmi_envtech_RH_inv "FCtl_FMI(816)" VALUE 0x00165443 /* @ECU_Address@FCtl_FMI@0x021B7330@ */ ECIPP_ALIGNMENT_UBYTE 255 Compu_IDENTITY 0 255 PHYS_UNIT "FMI" /end CHARACTERISTIC
/begin CHARACTERISTIC FCfmi_envtech_RH_uns "FCtl_FMI(818)" VALUE 0x00165445 /* @ECU_Address@FCtl_FMI@0x021B7332@ */ ECIPP_ALIGNMENT_UBYTE 255 Compu_IDENTITY 0 255 PHYS_UNIT "FMI" /end CHARACTERISTIC
/begin CHARACTERISTIC FCfmi_ERCV_speed_OOR "FCtl_FMI(853)" VALUE 0x00165468 /* @ECU_Address@FCtl_FMI@0x021B7355@ */ ECIPP_ALIGNMENT_UBYTE 255 Compu_IDENTITY 0 255 PHYS_UNIT "FMI" /end CHARACTERISTIC
/begin CHARACTERISTIC FCfmi_ERWT1_HiExp1 "FCtl_FMI(237)" VALUE 0x00165200 /* @ECU_Address@FCtl_FMI@0x021B70ED@ */ ECIPP_ALIGNMENT_UBYTE 255 Compu_IDENTITY 0 255 PHYS_UNIT "FMI" /end CHARACTERISTIC
/begin CHARACTERISTIC FCfmi_ERWT1_HiExp2 "FCtl_FMI(239)" VALUE 0x00165202 /* @ECU_Address@FCtl_FMI@0x021B70EF@ */ ECIPP_ALIGNMENT_UBYTE 255 Compu_IDENTITY 0 255 PHYS_UNIT "FMI" /end CHARACTERISTIC
/begin CHARACTERISTIC FCfmi_ERWT1_maxv "FCtl_FMI(233)" VALUE 0x001651FC /* @ECU_Address@FCtl_FMI@0x021B70E9@ */ ECIPP_ALIGNMENT_UBYTE 255 Compu_IDENTITY 0 255 PHYS_UNIT "FMI" /end CHARACTERISTIC
/begin CHARACTERISTIC FCfmi_ERWT1_minv "FCtl_FMI(235)" VALUE 0x001651FE /* @ECU_Address@FCtl_FMI@0x021B70EB@ */ ECIPP_ALIGNMENT_UBYTE 255 Compu_IDENTITY 0 255 PHYS_UNIT "FMI" /end CHARACTERISTIC
/begin CHARACTERISTIC FCfmi_F1OOR_F2IVS "FCtl_FMI(178)" VALUE 0x001651C5 /* @ECU_Address@FCtl_FMI@0x021B70B2@ */ ECIPP_ALIGNMENT_UBYTE 255 Compu_IDENTITY 0 255 PHYS_UNIT "FMI" /end CHARACTERISTIC
/begin CHARACTERISTIC FCfmi_F2OOR_F1IVS "FCtl_FMI(179)" VALUE 0x001651C6 /* @ECU_Address@FCtl_FMI@0x021B70B3@ */ ECIPP_ALIGNMENT_UBYTE 255 Compu_IDENTITY 0 255 PHYS_UNIT "FMI" /end CHARACTERISTIC
/begin CHARACTERISTIC FCfmi_FCoolH2O_lo "FCtl_FMI(532)" VALUE 0x00165327 /* @ECU_Address@FCtl_FMI@0x021B7214@ */ ECIPP_ALIGNMENT_UBYTE 255 Compu_IDENTITY 0 255 PHYS_UNIT "FMI" /end CHARACTERISTIC
/begin CHARACTERISTIC FCfmi_FIMP_pct_high "FCtl_FMI(282)" VALUE 0x0016522D /* @ECU_Address@FCtl_FMI@0x021B711A@ */ ECIPP_ALIGNMENT_UBYTE 255 Compu_IDENTITY 0 255 PHYS_UNIT "FMI" /end CHARACTERISTIC
/begin CHARACTERISTIC FCfmi_FIP_LoExp "FCtl_FMI(695)" VALUE 0x001653CA /* @ECU_Address@FCtl_FMI@0x021B72B7@ */ ECIPP_ALIGNMENT_UBYTE 255 Compu_IDENTITY 0 255 PHYS_UNIT "FMI" /end CHARACTERISTIC
/begin CHARACTERISTIC FCfmi_flash_fail "FCtl_FMI(105)" VALUE 0x0016517C /* @ECU_Address@FCtl_FMI@0x021B7069@ */ ECIPP_ALIGNMENT_UBYTE 255 Compu_IDENTITY 0 255 PHYS_UNIT "FMI" /end CHARACTERISTIC
/begin CHARACTERISTIC FCfmi_FP_high "FCtl_FMI(290)" VALUE 0x00165235 /* @ECU_Address@FCtl_FMI@0x021B7122@ */ ECIPP_ALIGNMENT_UBYTE 255 Compu_IDENTITY 0 255 PHYS_UNIT "FMI" /end CHARACTERISTIC
/begin CHARACTERISTIC FCfmi_FP_low "FCtl_FMI(291)" VALUE 0x00165236 /* @ECU_Address@FCtl_FMI@0x021B7123@ */ ECIPP_ALIGNMENT_UBYTE 255 Compu_IDENTITY 0 255 PHYS_UNIT "FMI" /end CHARACTERISTIC
/begin CHARACTERISTIC FCfmi_FP_maxv "FCtl_FMI(128)" VALUE 0x00165193 /* @ECU_Address@FCtl_FMI@0x021B7080@ */ ECIPP_ALIGNMENT_UBYTE 255 Compu_IDENTITY 0 255 PHYS_UNIT "FMI" /end CHARACTERISTIC
/begin CHARACTERISTIC FCfmi_FP_minv "FCtl_FMI(129)" VALUE 0x00165194 /* @ECU_Address@FCtl_FMI@0x021B7081@ */ ECIPP_ALIGNMENT_UBYTE 255 Compu_IDENTITY 0 255 PHYS_UNIT "FMI" /end CHARACTERISTIC
/begin CHARACTERISTIC FCfmi_FP2_high "FCtl_FMI(463)" VALUE 0x001652E2 /* @ECU_Address@FCtl_FMI@0x021B71CF@ */ ECIPP_ALIGNMENT_UBYTE 255 Compu_IDENTITY 0 255 PHYS_UNIT "FMI" /end CHARACTERISTIC
/begin CHARACTERISTIC FCfmi_FP2_low "FCtl_FMI(464)" VALUE 0x001652E3 /* @ECU_Address@FCtl_FMI@0x021B71D0@ */ ECIPP_ALIGNMENT_UBYTE 255 Compu_IDENTITY 0 255 PHYS_UNIT "FMI" /end CHARACTERISTIC
/begin CHARACTERISTIC FCfmi_FP2_maxv "FCtl_FMI(461)" VALUE 0x001652E0 /* @ECU_Address@FCtl_FMI@0x021B71CD@ */ ECIPP_ALIGNMENT_UBYTE 255 Compu_IDENTITY 0 255 PHYS_UNIT "FMI" /end CHARACTERISTIC
/begin CHARACTERISTIC FCfmi_FP2_minv "FCtl_FMI(462)" VALUE 0x001652E1 /* @ECU_Address@FCtl_FMI@0x021B71CE@ */ ECIPP_ALIGNMENT_UBYTE 255 Compu_IDENTITY 0 255 PHYS_UNIT "FMI" /end CHARACTERISTIC
/begin CHARACTERISTIC FCfmi_FPD_off_hi "FCtl_FMI(94)" VALUE 0x00165171 /* @ECU_Address@FCtl_FMI@0x021B705E@ */ ECIPP_ALIGNMENT_UBYTE 255 Compu_IDENTITY 0 255 PHYS_UNIT "FMI" /end CHARACTERISTIC
/begin CHARACTERISTIC FCfmi_FPD_on_lo "FCtl_FMI(93)" VALUE 0x00165170 /* @ECU_Address@FCtl_FMI@0x021B705D@ */ ECIPP_ALIGNMENT_UBYTE 255 Compu_IDENTITY 0 255 PHYS_UNIT "FMI" /end CHARACTERISTIC
/begin CHARACTERISTIC FCfmi_FPlo_derate_actv "FCtl_FMI(807)" VALUE 0x0016543A /* @ECU_Address@FCtl_FMI@0x021B7327@ */ ECIPP_ALIGNMENT_UBYTE 255 Compu_IDENTITY 0 255 PHYS_UNIT "FMI" /end CHARACTERISTIC
/begin CHARACTERISTIC FCfmi_FPlo_derate_excess "FCtl_FMI(810)" VALUE 0x0016543D /* @ECU_Address@FCtl_FMI@0x021B732A@ */ ECIPP_ALIGNMENT_UBYTE 255 Compu_IDENTITY 0 255 PHYS_UNIT "FMI" /end CHARACTERISTIC
/begin CHARACTERISTIC FCfmi_FPP_NeutLock_fail "FCtl_FMI(658)" VALUE 0x001653A5 /* @ECU_Address@FCtl_FMI@0x021B7292@ */ ECIPP_ALIGNMENT_UBYTE 255 Compu_IDENTITY 0 255 PHYS_UNIT "FMI" /end CHARACTERISTIC
/begin CHARACTERISTIC FCfmi_FPP1_IVS_max "FCtl_FMI(23)" VALUE 0x0016512A /* @ECU_Address@FCtl_FMI@0x021B7017@ */ ECIPP_ALIGNMENT_UBYTE 255 Compu_IDENTITY 0 255 PHYS_UNIT "FMI" /end CHARACTERISTIC
/begin CHARACTERISTIC FCfmi_FPP1_IVS_min "FCtl_FMI(24)" VALUE 0x0016512B /* @ECU_Address@FCtl_FMI@0x021B7018@ */ ECIPP_ALIGNMENT_UBYTE 255 Compu_IDENTITY 0 255 PHYS_UNIT "FMI" /end CHARACTERISTIC
/begin CHARACTERISTIC FCfmi_FPP1_max "FCtl_FMI(19)" VALUE 0x00165126 /* @ECU_Address@FCtl_FMI@0x021B7013@ */ ECIPP_ALIGNMENT_UBYTE 255 Compu_IDENTITY 0 255 PHYS_UNIT "FMI" /end CHARACTERISTIC
/begin CHARACTERISTIC FCfmi_FPP1_min "FCtl_FMI(20)" VALUE 0x00165127 /* @ECU_Address@FCtl_FMI@0x021B7014@ */ ECIPP_ALIGNMENT_UBYTE 255 Compu_IDENTITY 0 255 PHYS_UNIT "FMI" /end CHARACTERISTIC
/begin CHARACTERISTIC FCfmi_FPP12_IVS_max "FCtl_FMI(175)" VALUE 0x001651C2 /* @ECU_Address@FCtl_FMI@0x021B70AF@ */ ECIPP_ALIGNMENT_UBYTE 255 Compu_IDENTITY 0 255 PHYS_UNIT "FMI" /end CHARACTERISTIC
/begin CHARACTERISTIC FCfmi_FPP12_IVS_min "FCtl_FMI(176)" VALUE 0x001651C3 /* @ECU_Address@FCtl_FMI@0x021B70B0@ */ ECIPP_ALIGNMENT_UBYTE 255 Compu_IDENTITY 0 255 PHYS_UNIT "FMI" /end CHARACTERISTIC
/begin CHARACTERISTIC FCfmi_FPP12_OOR "FCtl_FMI(177)" VALUE 0x001651C4 /* @ECU_Address@FCtl_FMI@0x021B70B1@ */ ECIPP_ALIGNMENT_UBYTE 255 Compu_IDENTITY 0 255 PHYS_UNIT "FMI" /end CHARACTERISTIC
/begin CHARACTERISTIC FCfmi_FPP12IVS_TSC1 "FCtl_FMI(734)" VALUE 0x001653F1 /* @ECU_Address@FCtl_FMI@0x021B72DE@ */ ECIPP_ALIGNMENT_UBYTE 255 Compu_IDENTITY 0 255 PHYS_UNIT "FMI" /end CHARACTERISTIC
/begin CHARACTERISTIC FCfmi_FPP12MM_IVSMM "FCtl_FMI(180)" VALUE 0x001651C7 /* @ECU_Address@FCtl_FMI@0x021B70B4@ */ ECIPP_ALIGNMENT_UBYTE 255 Compu_IDENTITY 0 255 PHYS_UNIT "FMI" /end CHARACTERISTIC
/begin CHARACTERISTIC FCfmi_FPP12pct_hi "FCtl_FMI(27)" VALUE 0x0016512E /* @ECU_Address@FCtl_FMI@0x021B701B@ */ ECIPP_ALIGNMENT_UBYTE 255 Compu_IDENTITY 0 255 PHYS_UNIT "FMI" /end CHARACTERISTIC
/begin CHARACTERISTIC FCfmi_FPP12pct_lo "FCtl_FMI(28)" VALUE 0x0016512F /* @ECU_Address@FCtl_FMI@0x021B701C@ */ ECIPP_ALIGNMENT_UBYTE 255 Compu_IDENTITY 0 255 PHYS_UNIT "FMI" /end CHARACTERISTIC
/begin CHARACTERISTIC FCftb_EGR_slowdec "FCtl_FTB_0x04(660)" VALUE 0x00165705 /* @ECU_Address@FCtl_FTB_0x04@0x024C5294@ */ ECIPP_ALIGNMENT_UBYTE 255 Compu_IDENTITY 0 255 PHYS_UNIT "FTB" /end CHARACTERISTIC
/begin CHARACTERISTIC FCftb_EGR_slowinc "FCtl_FTB_0x04(659)" VALUE 0x00165704 /* @ECU_Address@FCtl_FTB_0x04@0x024C5293@ */ ECIPP_ALIGNMENT_UBYTE 255 Compu_IDENTITY 0 255 PHYS_UNIT "FTB" /end CHARACTERISTIC
/begin CHARACTERISTIC FCftb_EGR_UEGOdP_hi "FCtl_FTB_0x04(663)" VALUE 0x00165708 /* @ECU_Address@FCtl_FTB_0x04@0x024C5297@ */ ECIPP_ALIGNMENT_UBYTE 255 Compu_IDENTITY 0 255 PHYS_UNIT "FTB" /end CHARACTERISTIC
/begin CHARACTERISTIC FCftb_EGR_UEGOdP_lo "FCtl_FTB_0x04(664)" VALUE 0x00165709 /* @ECU_Address@FCtl_FTB_0x04@0x024C5298@ */ ECIPP_ALIGNMENT_UBYTE 255 Compu_IDENTITY 0 255 PHYS_UNIT "FTB" /end CHARACTERISTIC
/begin CHARACTERISTIC FCftb_EGR_vlv_DC_lim "FCtl_FTB_0x04(743)" VALUE 0x00165758 /* @ECU_Address@FCtl_FTB_0x04@0x024C52E7@ */ ECIPP_ALIGNMENT_UBYTE 255 Compu_IDENTITY 0 255 PHYS_UNIT "FTB" /end CHARACTERISTIC
/begin CHARACTERISTIC FCftb_EGR_vlv_stuck "FCtl_FTB_0x04(833)" VALUE 0x001657B2 /* @ECU_Address@FCtl_FTB_0x04@0x024C5341@ */ ECIPP_ALIGNMENT_UBYTE 255 Compu_IDENTITY 0 255 PHYS_UNIT "FTB" /end CHARACTERISTIC
/begin CHARACTERISTIC FCftb_EGR_vlv_temp_hi "FCtl_FTB_0x04(744)" VALUE 0x00165759 /* @ECU_Address@FCtl_FTB_0x04@0x024C52E8@ */ ECIPP_ALIGNMENT_UBYTE 255 Compu_IDENTITY 0 255 PHYS_UNIT "FTB" /end CHARACTERISTIC
/begin CHARACTERISTIC FCftb_EGR_vlvCAN_commlost "FCtl_FTB_0x04(667)" VALUE 0x0016570C /* @ECU_Address@FCtl_FTB_0x04@0x024C529B@ */ ECIPP_ALIGNMENT_UBYTE 255 Compu_IDENTITY 0 255 PHYS_UNIT "FTB" /end CHARACTERISTIC
/begin CHARACTERISTIC FCftb_EGR_vlvCAN_lowfunc "FCtl_FTB_0x04(669)" VALUE 0x0016570E /* @ECU_Address@FCtl_FTB_0x04@0x024C529D@ */ ECIPP_ALIGNMENT_UBYTE 255 Compu_IDENTITY 0 255 PHYS_UNIT "FTB" /end CHARACTERISTIC
/begin CHARACTERISTIC FCftb_EGR_vlvCAN_nofunc "FCtl_FTB_0x04(668)" VALUE 0x0016570D /* @ECU_Address@FCtl_FTB_0x04@0x024C529C@ */ ECIPP_ALIGNMENT_UBYTE 255 Compu_IDENTITY 0 255 PHYS_UNIT "FTB" /end CHARACTERISTIC
/begin CHARACTERISTIC FCftb_EGRdP_HiExp "FCtl_FTB_0x04(752)" VALUE 0x00165761 /* @ECU_Address@FCtl_FTB_0x04@0x024C52F0@ */ ECIPP_ALIGNMENT_UBYTE 255 Compu_IDENTITY 0 255 PHYS_UNIT "FTB" /end CHARACTERISTIC
/begin CHARACTERISTIC FCftb_EGRdP_LoExp "FCtl_FTB_0x04(751)" VALUE 0x00165760 /* @ECU_Address@FCtl_FTB_0x04@0x024C52EF@ */ ECIPP_ALIGNMENT_UBYTE 255 Compu_IDENTITY 0 255 PHYS_UNIT "FTB" /end CHARACTERISTIC
/begin CHARACTERISTIC FCftb_EGRdP_maxv "FCtl_FTB_0x04(749)" VALUE 0x0016575E /* @ECU_Address@FCtl_FTB_0x04@0x024C52ED@ */ ECIPP_ALIGNMENT_UBYTE 255 Compu_IDENTITY 0 255 PHYS_UNIT "FTB" /end CHARACTERISTIC
/begin CHARACTERISTIC FCftb_EGRdP_minv "FCtl_FTB_0x04(750)" VALUE 0x0016575F /* @ECU_Address@FCtl_FTB_0x04@0x024C52EE@ */ ECIPP_ALIGNMENT_UBYTE 255 Compu_IDENTITY 0 255 PHYS_UNIT "FTB" /end CHARACTERISTIC
/begin CHARACTERISTIC FCftb_EGRflow_HiExp "FCtl_FTB_0x04(597)" VALUE 0x001656C6 /* @ECU_Address@FCtl_FTB_0x04@0x024C5255@ */ ECIPP_ALIGNMENT_UBYTE 255 Compu_IDENTITY 0 255 PHYS_UNIT "FTB" /end CHARACTERISTIC
/begin CHARACTERISTIC FCftb_EGRflow_LoExp "FCtl_FTB_0x04(596)" VALUE 0x001656C5 /* @ECU_Address@FCtl_FTB_0x04@0x024C5254@ */ ECIPP_ALIGNMENT_UBYTE 255 Compu_IDENTITY 0 255 PHYS_UNIT "FTB" /end CHARACTERISTIC
/begin CHARACTERISTIC FCftb_EGRflow_LoExp2 "FCtl_FTB_0x04(684)" VALUE 0x0016571D /* @ECU_Address@FCtl_FTB_0x04@0x024C52AC@ */ ECIPP_ALIGNMENT_UBYTE 255 Compu_IDENTITY 0 255 PHYS_UNIT "FTB" /end CHARACTERISTIC
/begin CHARACTERISTIC FCftb_EGRHP_maxv "FCtl_FTB_0x04(753)" VALUE 0x00165762 /* @ECU_Address@FCtl_FTB_0x04@0x024C52F1@ */ ECIPP_ALIGNMENT_UBYTE 255 Compu_IDENTITY 0 255 PHYS_UNIT "FTB" /end CHARACTERISTIC
/begin CHARACTERISTIC FCftb_EGRHP_minv "FCtl_FTB_0x04(754)" VALUE 0x00165763 /* @ECU_Address@FCtl_FTB_0x04@0x024C52F2@ */ ECIPP_ALIGNMENT_UBYTE 255 Compu_IDENTITY 0 255 PHYS_UNIT "FTB" /end CHARACTERISTIC
/begin CHARACTERISTIC FCftb_EGRHP_OOR "FCtl_FTB_0x04(755)" VALUE 0x00165764 /* @ECU_Address@FCtl_FTB_0x04@0x024C52F3@ */ ECIPP_ALIGNMENT_UBYTE 255 Compu_IDENTITY 0 255 PHYS_UNIT "FTB" /end CHARACTERISTIC
/begin CHARACTERISTIC FCftb_EGRO_postlk "FCtl_FTB_0x04(798)" VALUE 0x0016578F /* @ECU_Address@FCtl_FTB_0x04@0x024C531E@ */ ECIPP_ALIGNMENT_UBYTE 255 Compu_IDENTITY 0 255 PHYS_UNIT "FTB" /end CHARACTERISTIC
/begin CHARACTERISTIC FCftb_EGRT_hi "FCtl_FTB_0x04(694)" VALUE 0x00165727 /* @ECU_Address@FCtl_FTB_0x04@0x024C52B6@ */ ECIPP_ALIGNMENT_UBYTE 255 Compu_IDENTITY 0 255 PHYS_UNIT "FTB" /end CHARACTERISTIC
/begin CHARACTERISTIC FCftb_EGRT_maxv "FCtl_FTB_0x04(692)" VALUE 0x00165725 /* @ECU_Address@FCtl_FTB_0x04@0x024C52B4@ */ ECIPP_ALIGNMENT_UBYTE 255 Compu_IDENTITY 0 255 PHYS_UNIT "FTB" /end CHARACTERISTIC
/begin CHARACTERISTIC FCftb_EGRT_minv "FCtl_FTB_0x04(693)" VALUE 0x00165726 /* @ECU_Address@FCtl_FTB_0x04@0x024C52B5@ */ ECIPP_ALIGNMENT_UBYTE 255 Compu_IDENTITY 0 255 PHYS_UNIT "FTB" /end CHARACTERISTIC
/begin CHARACTERISTIC FCftb_EGT_dig_Hi "FCtl_FTB_0x04(187)" VALUE 0x0016552C /* @ECU_Address@FCtl_FTB_0x04@0x024C50BB@ */ ECIPP_ALIGNMENT_UBYTE 255 Compu_IDENTITY 0 255 PHYS_UNIT "FTB" /end CHARACTERISTIC
/begin CHARACTERISTIC FCftb_EGT_maxv "FCtl_FTB_0x04(808)" VALUE 0x00165799 /* @ECU_Address@FCtl_FTB_0x04@0x024C5328@ */ ECIPP_ALIGNMENT_UBYTE 255 Compu_IDENTITY 0 255 PHYS_UNIT "FTB" /end CHARACTERISTIC
/begin CHARACTERISTIC FCftb_EGT_minv "FCtl_FTB_0x04(809)" VALUE 0x0016579A /* @ECU_Address@FCtl_FTB_0x04@0x024C5329@ */ ECIPP_ALIGNMENT_UBYTE 255 Compu_IDENTITY 0 255 PHYS_UNIT "FTB" /end CHARACTERISTIC
/begin CHARACTERISTIC FCftb_EMWT1_HiExp1 "FCtl_FTB_0x04(225)" VALUE 0x00165552 /* @ECU_Address@FCtl_FTB_0x04@0x024C50E1@ */ ECIPP_ALIGNMENT_UBYTE 255 Compu_IDENTITY 0 255 PHYS_UNIT "FTB" /end CHARACTERISTIC
/begin CHARACTERISTIC FCftb_EMWT1_HiExp2 "FCtl_FTB_0x04(227)" VALUE 0x00165554 /* @ECU_Address@FCtl_FTB_0x04@0x024C50E3@ */ ECIPP_ALIGNMENT_UBYTE 255 Compu_IDENTITY 0 255 PHYS_UNIT "FTB" /end CHARACTERISTIC
/begin CHARACTERISTIC FCftb_EMWT1_maxv "FCtl_FTB_0x04(221)" VALUE 0x0016554E /* @ECU_Address@FCtl_FTB_0x04@0x024C50DD@ */ ECIPP_ALIGNMENT_UBYTE 255 Compu_IDENTITY 0 255 PHYS_UNIT "FTB" /end CHARACTERISTIC
/begin CHARACTERISTIC FCftb_EMWT1_minv "FCtl_FTB_0x04(223)" VALUE 0x00165550 /* @ECU_Address@FCtl_FTB_0x04@0x024C50DF@ */ ECIPP_ALIGNMENT_UBYTE 255 Compu_IDENTITY 0 255 PHYS_UNIT "FTB" /end CHARACTERISTIC
/begin CHARACTERISTIC FCftb_envtech_AAT_inv "FCtl_FTB_0x04(814)" VALUE 0x0016579F /* @ECU_Address@FCtl_FTB_0x04@0x024C532E@ */ ECIPP_ALIGNMENT_UBYTE 255 Compu_IDENTITY 0 255 PHYS_UNIT "FTB" /end CHARACTERISTIC
/begin CHARACTERISTIC FCftb_envtech_BP_inv "FCtl_FTB_0x04(815)" VALUE 0x001657A0 /* @ECU_Address@FCtl_FTB_0x04@0x024C532F@ */ ECIPP_ALIGNMENT_UBYTE 255 Compu_IDENTITY 0 255 PHYS_UNIT "FTB" /end CHARACTERISTIC
/begin CHARACTERISTIC FCftb_envtech_comm "FCtl_FTB_0x04(358)" VALUE 0x001655D7 /* @ECU_Address@FCtl_FTB_0x04@0x024C5166@ */ ECIPP_ALIGNMENT_UBYTE 255 Compu_IDENTITY 0 255 PHYS_UNIT "FTB" /end CHARACTERISTIC
/begin CHARACTERISTIC FCftb_envtech_general "FCtl_FTB_0x04(817)" VALUE 0x001657A2 /* @ECU_Address@FCtl_FTB_0x04@0x024C5331@ */ ECIPP_ALIGNMENT_UBYTE 255 Compu_IDENTITY 0 255 PHYS_UNIT "FTB" /end CHARACTERISTIC
/begin CHARACTERISTIC FCftb_envtech_RH_inv "FCtl_FTB_0x04(816)" VALUE 0x001657A1 /* @ECU_Address@FCtl_FTB_0x04@0x024C5330@ */ ECIPP_ALIGNMENT_UBYTE 255 Compu_IDENTITY 0 255 PHYS_UNIT "FTB" /end CHARACTERISTIC
/begin CHARACTERISTIC FCftb_envtech_RH_uns "FCtl_FTB_0x04(818)" VALUE 0x001657A3 /* @ECU_Address@FCtl_FTB_0x04@0x024C5332@ */ ECIPP_ALIGNMENT_UBYTE 255 Compu_IDENTITY 0 255 PHYS_UNIT "FTB" /end CHARACTERISTIC
/begin CHARACTERISTIC FCftb_ERCV_speed_OOR "FCtl_FTB_0x04(853)" VALUE 0x001657C6 /* @ECU_Address@FCtl_FTB_0x04@0x024C5355@ */ ECIPP_ALIGNMENT_UBYTE 255 Compu_IDENTITY 0 255 PHYS_UNIT "FTB" /end CHARACTERISTIC
/begin CHARACTERISTIC FCftb_ERWT1_HiExp1 "FCtl_FTB_0x04(237)" VALUE 0x0016555E /* @ECU_Address@FCtl_FTB_0x04@0x024C50ED@ */ ECIPP_ALIGNMENT_UBYTE 255 Compu_IDENTITY 0 255 PHYS_UNIT "FTB" /end CHARACTERISTIC
/begin CHARACTERISTIC FCftb_ERWT1_HiExp2 "FCtl_FTB_0x04(239)" VALUE 0x00165560 /* @ECU_Address@FCtl_FTB_0x04@0x024C50EF@ */ ECIPP_ALIGNMENT_UBYTE 255 Compu_IDENTITY 0 255 PHYS_UNIT "FTB" /end CHARACTERISTIC
/begin CHARACTERISTIC FCftb_ERWT1_maxv "FCtl_FTB_0x04(233)" VALUE 0x0016555A /* @ECU_Address@FCtl_FTB_0x04@0x024C50E9@ */ ECIPP_ALIGNMENT_UBYTE 255 Compu_IDENTITY 0 255 PHYS_UNIT "FTB" /end CHARACTERISTIC
/begin CHARACTERISTIC FCftb_ERWT1_minv "FCtl_FTB_0x04(235)" VALUE 0x0016555C /* @ECU_Address@FCtl_FTB_0x04@0x024C50EB@ */ ECIPP_ALIGNMENT_UBYTE 255 Compu_IDENTITY 0 255 PHYS_UNIT "FTB" /end CHARACTERISTIC
/begin CHARACTERISTIC FCftb_F1OOR_F2IVS "FCtl_FTB_0x04(178)" VALUE 0x00165523 /* @ECU_Address@FCtl_FTB_0x04@0x024C50B2@ */ ECIPP_ALIGNMENT_UBYTE 255 Compu_IDENTITY 0 255 PHYS_UNIT "FTB" /end CHARACTERISTIC
/begin CHARACTERISTIC FCftb_F2OOR_F1IVS "FCtl_FTB_0x04(179)" VALUE 0x00165524 /* @ECU_Address@FCtl_FTB_0x04@0x024C50B3@ */ ECIPP_ALIGNMENT_UBYTE 255 Compu_IDENTITY 0 255 PHYS_UNIT "FTB" /end CHARACTERISTIC
/begin CHARACTERISTIC FCftb_FCoolH2O_lo "FCtl_FTB_0x04(532)" VALUE 0x00165685 /* @ECU_Address@FCtl_FTB_0x04@0x024C5214@ */ ECIPP_ALIGNMENT_UBYTE 255 Compu_IDENTITY 0 255 PHYS_UNIT "FTB" /end CHARACTERISTIC
/begin CHARACTERISTIC FCftb_FIMP_pct_high "FCtl_FTB_0x04(282)" VALUE 0x0016558B /* @ECU_Address@FCtl_FTB_0x04@0x024C511A@ */ ECIPP_ALIGNMENT_UBYTE 255 Compu_IDENTITY 0 255 PHYS_UNIT "FTB" /end CHARACTERISTIC
/begin CHARACTERISTIC FCftb_FIP_LoExp "FCtl_FTB_0x04(695)" VALUE 0x00165728 /* @ECU_Address@FCtl_FTB_0x04@0x024C52B7@ */ ECIPP_ALIGNMENT_UBYTE 255 Compu_IDENTITY 0 255 PHYS_UNIT "FTB" /end CHARACTERISTIC
/begin CHARACTERISTIC FCftb_flash_fail "FCtl_FTB_0x04(105)" VALUE 0x001654DA /* @ECU_Address@FCtl_FTB_0x04@0x024C5069@ */ ECIPP_ALIGNMENT_UBYTE 255 Compu_IDENTITY 0 255 PHYS_UNIT "FTB" /end CHARACTERISTIC
/begin CHARACTERISTIC FCftb_FP_high "FCtl_FTB_0x04(290)" VALUE 0x00165593 /* @ECU_Address@FCtl_FTB_0x04@0x024C5122@ */ ECIPP_ALIGNMENT_UBYTE 255 Compu_IDENTITY 0 255 PHYS_UNIT "FTB" /end CHARACTERISTIC
/begin CHARACTERISTIC FCftb_FP_low "FCtl_FTB_0x04(291)" VALUE 0x00165594 /* @ECU_Address@FCtl_FTB_0x04@0x024C5123@ */ ECIPP_ALIGNMENT_UBYTE 255 Compu_IDENTITY 0 255 PHYS_UNIT "FTB" /end CHARACTERISTIC
/begin CHARACTERISTIC FCftb_FP_maxv "FCtl_FTB_0x04(128)" VALUE 0x001654F1 /* @ECU_Address@FCtl_FTB_0x04@0x024C5080@ */ ECIPP_ALIGNMENT_UBYTE 255 Compu_IDENTITY 0 255 PHYS_UNIT "FTB" /end CHARACTERISTIC
/begin CHARACTERISTIC FCftb_FP_minv "FCtl_FTB_0x04(129)" VALUE 0x001654F2 /* @ECU_Address@FCtl_FTB_0x04@0x024C5081@ */ ECIPP_ALIGNMENT_UBYTE 255 Compu_IDENTITY 0 255 PHYS_UNIT "FTB" /end CHARACTERISTIC
/begin CHARACTERISTIC FCftb_FP2_high "FCtl_FTB_0x04(463)" VALUE 0x00165640 /* @ECU_Address@FCtl_FTB_0x04@0x024C51CF@ */ ECIPP_ALIGNMENT_UBYTE 255 Compu_IDENTITY 0 255 PHYS_UNIT "FTB" /end CHARACTERISTIC
/begin CHARACTERISTIC FCftb_FP2_low "FCtl_FTB_0x04(464)" VALUE 0x00165641 /* @ECU_Address@FCtl_FTB_0x04@0x024C51D0@ */ ECIPP_ALIGNMENT_UBYTE 255 Compu_IDENTITY 0 255 PHYS_UNIT "FTB" /end CHARACTERISTIC
/begin CHARACTERISTIC FCftb_FP2_maxv "FCtl_FTB_0x04(461)" VALUE 0x0016563E /* @ECU_Address@FCtl_FTB_0x04@0x024C51CD@ */ ECIPP_ALIGNMENT_UBYTE 255 Compu_IDENTITY 0 255 PHYS_UNIT "FTB" /end CHARACTERISTIC
/begin CHARACTERISTIC FCftb_FP2_minv "FCtl_FTB_0x04(462)" VALUE 0x0016563F /* @ECU_Address@FCtl_FTB_0x04@0x024C51CE@ */ ECIPP_ALIGNMENT_UBYTE 255 Compu_IDENTITY 0 255 PHYS_UNIT "FTB" /end CHARACTERISTIC
/begin CHARACTERISTIC FCftb_FPD_off_hi "FCtl_FTB_0x04(94)" VALUE 0x001654CF /* @ECU_Address@FCtl_FTB_0x04@0x024C505E@ */ ECIPP_ALIGNMENT_UBYTE 255 Compu_IDENTITY 0 255 PHYS_UNIT "FTB" /end CHARACTERISTIC
/begin CHARACTERISTIC FCftb_FPD_on_lo "FCtl_FTB_0x04(93)" VALUE 0x001654CE /* @ECU_Address@FCtl_FTB_0x04@0x024C505D@ */ ECIPP_ALIGNMENT_UBYTE 255 Compu_IDENTITY 0 255 PHYS_UNIT "FTB" /end CHARACTERISTIC
/begin CHARACTERISTIC FCftb_FPlo_derate_actv "FCtl_FTB_0x04(807)" VALUE 0x00165798 /* @ECU_Address@FCtl_FTB_0x04@0x024C5327@ */ ECIPP_ALIGNMENT_UBYTE 255 Compu_IDENTITY 0 255 PHYS_UNIT "FTB" /end CHARACTERISTIC
/begin CHARACTERISTIC FCftb_FPlo_derate_excess "FCtl_FTB_0x04(810)" VALUE 0x0016579B /* @ECU_Address@FCtl_FTB_0x04@0x024C532A@ */ ECIPP_ALIGNMENT_UBYTE 255 Compu_IDENTITY 0 255 PHYS_UNIT "FTB" /end CHARACTERISTIC
/begin CHARACTERISTIC FCftb_FPP_NeutLock_fail "FCtl_FTB_0x04(658)" VALUE 0x00165703 /* @ECU_Address@FCtl_FTB_0x04@0x024C5292@ */ ECIPP_ALIGNMENT_UBYTE 255 Compu_IDENTITY 0 255 PHYS_UNIT "FTB" /end CHARACTERISTIC
/begin CHARACTERISTIC FCftb_FPP1_IVS_max "FCtl_FTB_0x04(23)" VALUE 0x00165488 /* @ECU_Address@FCtl_FTB_0x04@0x024C5017@ */ ECIPP_ALIGNMENT_UBYTE 255 Compu_IDENTITY 0 255 PHYS_UNIT "FTB" /end CHARACTERISTIC
/begin CHARACTERISTIC FCftb_FPP1_IVS_min "FCtl_FTB_0x04(24)" VALUE 0x00165489 /* @ECU_Address@FCtl_FTB_0x04@0x024C5018@ */ ECIPP_ALIGNMENT_UBYTE 255 Compu_IDENTITY 0 255 PHYS_UNIT "FTB" /end CHARACTERISTIC
/begin CHARACTERISTIC FCftb_FPP1_max "FCtl_FTB_0x04(19)" VALUE 0x00165484 /* @ECU_Address@FCtl_FTB_0x04@0x024C5013@ */ ECIPP_ALIGNMENT_UBYTE 255 Compu_IDENTITY 0 255 PHYS_UNIT "FTB" /end CHARACTERISTIC
/begin CHARACTERISTIC FCftb_FPP1_min "FCtl_FTB_0x04(20)" VALUE 0x00165485 /* @ECU_Address@FCtl_FTB_0x04@0x024C5014@ */ ECIPP_ALIGNMENT_UBYTE 255 Compu_IDENTITY 0 255 PHYS_UNIT "FTB" /end CHARACTERISTIC
/begin CHARACTERISTIC FCftb_FPP12_IVS_max "FCtl_FTB_0x04(175)" VALUE 0x00165520 /* @ECU_Address@FCtl_FTB_0x04@0x024C50AF@ */ ECIPP_ALIGNMENT_UBYTE 255 Compu_IDENTITY 0 255 PHYS_UNIT "FTB" /end CHARACTERISTIC
/begin CHARACTERISTIC FCftb_FPP12_IVS_min "FCtl_FTB_0x04(176)" VALUE 0x00165521 /* @ECU_Address@FCtl_FTB_0x04@0x024C50B0@ */ ECIPP_ALIGNMENT_UBYTE 255 Compu_IDENTITY 0 255 PHYS_UNIT "FTB" /end CHARACTERISTIC
/begin CHARACTERISTIC FCftb_FPP12_OOR "FCtl_FTB_0x04(177)" VALUE 0x00165522 /* @ECU_Address@FCtl_FTB_0x04@0x024C50B1@ */ ECIPP_ALIGNMENT_UBYTE 255 Compu_IDENTITY 0 255 PHYS_UNIT "FTB" /end CHARACTERISTIC
/begin CHARACTERISTIC FCftb_FPP12IVS_TSC1 "FCtl_FTB_0x04(734)" VALUE 0x0016574F /* @ECU_Address@FCtl_FTB_0x04@0x024C52DE@ */ ECIPP_ALIGNMENT_UBYTE 255 Compu_IDENTITY 0 255 PHYS_UNIT "FTB" /end CHARACTERISTIC
/begin CHARACTERISTIC FCftb_FPP12MM_IVSMM "FCtl_FTB_0x04(180)" VALUE 0x00165525 /* @ECU_Address@FCtl_FTB_0x04@0x024C50B4@ */ ECIPP_ALIGNMENT_UBYTE 255 Compu_IDENTITY 0 255 PHYS_UNIT "FTB" /end CHARACTERISTIC
/begin CHARACTERISTIC FCftb_FPP12pct_hi "FCtl_FTB_0x04(27)" VALUE 0x0016548C /* @ECU_Address@FCtl_FTB_0x04@0x024C501B@ */ ECIPP_ALIGNMENT_UBYTE 255 Compu_IDENTITY 0 255 PHYS_UNIT "FTB" /end CHARACTERISTIC
/begin CHARACTERISTIC FCftb_FPP12pct_lo "FCtl_FTB_0x04(28)" VALUE 0x0016548D /* @ECU_Address@FCtl_FTB_0x04@0x024C501C@ */ ECIPP_ALIGNMENT_UBYTE 255 Compu_IDENTITY 0 255 PHYS_UNIT "FTB" /end CHARACTERISTIC
/begin CHARACTERISTIC FCspn_EGR_slowdec "FCtl_SPN(660)" VALUE 0x0016272C /* @ECU_Address@FCtl_SPN@0x021B6A50@ */ ECIPP_ALIGNMENT_ULONG 4294967295 Compu_IDENTITY 0 4294967295 PHYS_UNIT "SPN" /end CHARACTERISTIC
/begin CHARACTERISTIC FCspn_EGR_slowinc "FCtl_SPN(659)" VALUE 0x00162728 /* @ECU_Address@FCtl_SPN@0x021B6A4C@ */ ECIPP_ALIGNMENT_ULONG 4294967295 Compu_IDENTITY 0 4294967295 PHYS_UNIT "SPN" /end CHARACTERISTIC
/begin CHARACTERISTIC FCspn_EGR_UEGOdP_hi "FCtl_SPN(663)" VALUE 0x00162738 /* @ECU_Address@FCtl_SPN@0x021B6A5C@ */ ECIPP_ALIGNMENT_ULONG 4294967295 Compu_IDENTITY 0 4294967295 PHYS_UNIT "SPN" /end CHARACTERISTIC
/begin CHARACTERISTIC FCspn_EGR_UEGOdP_lo "FCtl_SPN(664)" VALUE 0x0016273C /* @ECU_Address@FCtl_SPN@0x021B6A60@ */ ECIPP_ALIGNMENT_ULONG 4294967295 Compu_IDENTITY 0 4294967295 PHYS_UNIT "SPN" /end CHARACTERISTIC
/begin CHARACTERISTIC FCspn_EGR_vlv_DC_lim "FCtl_SPN(743)" VALUE 0x00162878 /* @ECU_Address@FCtl_SPN@0x021B6B9C@ */ ECIPP_ALIGNMENT_ULONG 4294967295 Compu_IDENTITY 0 4294967295 PHYS_UNIT "SPN" /end CHARACTERISTIC
/begin CHARACTERISTIC FCspn_EGR_vlv_stuck "FCtl_SPN(833)" VALUE 0x001629E0 /* @ECU_Address@FCtl_SPN@0x021B6D04@ */ ECIPP_ALIGNMENT_ULONG 4294967295 Compu_IDENTITY 0 4294967295 PHYS_UNIT "SPN" /end CHARACTERISTIC
/begin CHARACTERISTIC FCspn_EGR_vlv_temp_hi "FCtl_SPN(744)" VALUE 0x0016287C /* @ECU_Address@FCtl_SPN@0x021B6BA0@ */ ECIPP_ALIGNMENT_ULONG 4294967295 Compu_IDENTITY 0 4294967295 PHYS_UNIT "SPN" /end CHARACTERISTIC
/begin CHARACTERISTIC FCspn_EGR_vlvCAN_commlost "FCtl_SPN(667)" VALUE 0x00162748 /* @ECU_Address@FCtl_SPN@0x021B6A6C@ */ ECIPP_ALIGNMENT_ULONG 4294967295 Compu_IDENTITY 0 4294967295 PHYS_UNIT "SPN" /end CHARACTERISTIC
/begin CHARACTERISTIC FCspn_EGR_vlvCAN_lowfunc "FCtl_SPN(669)" VALUE 0x00162750 /* @ECU_Address@FCtl_SPN@0x021B6A74@ */ ECIPP_ALIGNMENT_ULONG 4294967295 Compu_IDENTITY 0 4294967295 PHYS_UNIT "SPN" /end CHARACTERISTIC
/begin CHARACTERISTIC FCspn_EGR_vlvCAN_nofunc "FCtl_SPN(668)" VALUE 0x0016274C /* @ECU_Address@FCtl_SPN@0x021B6A70@ */ ECIPP_ALIGNMENT_ULONG 4294967295 Compu_IDENTITY 0 4294967295 PHYS_UNIT "SPN" /end CHARACTERISTIC
/begin CHARACTERISTIC FCspn_EGRdP_HiExp "FCtl_SPN(752)" VALUE 0x0016289C /* @ECU_Address@FCtl_SPN@0x021B6BC0@ */ ECIPP_ALIGNMENT_ULONG 4294967295 Compu_IDENTITY 0 4294967295 PHYS_UNIT "SPN" /end CHARACTERISTIC
/begin CHARACTERISTIC FCspn_EGRdP_LoExp "FCtl_SPN(751)" VALUE 0x00162898 /* @ECU_Address@FCtl_SPN@0x021B6BBC@ */ ECIPP_ALIGNMENT_ULONG 4294967295 Compu_IDENTITY 0 4294967295 PHYS_UNIT "SPN" /end CHARACTERISTIC
/begin CHARACTERISTIC FCspn_EGRdP_maxv "FCtl_SPN(749)" VALUE 0x00162890 /* @ECU_Address@FCtl_SPN@0x021B6BB4@ */ ECIPP_ALIGNMENT_ULONG 4294967295 Compu_IDENTITY 0 4294967295 PHYS_UNIT "SPN" /end CHARACTERISTIC
/begin CHARACTERISTIC FCspn_EGRdP_minv "FCtl_SPN(750)" VALUE 0x00162894 /* @ECU_Address@FCtl_SPN@0x021B6BB8@ */ ECIPP_ALIGNMENT_ULONG 4294967295 Compu_IDENTITY 0 4294967295 PHYS_UNIT "SPN" /end CHARACTERISTIC
/begin CHARACTERISTIC FCspn_EGRflow_HiExp "FCtl_SPN(597)" VALUE 0x00162630 /* @ECU_Address@FCtl_SPN@0x021B6954@ */ ECIPP_ALIGNMENT_ULONG 4294967295 Compu_IDENTITY 0 4294967295 PHYS_UNIT "SPN" /end CHARACTERISTIC
/begin CHARACTERISTIC FCspn_EGRflow_LoExp "FCtl_SPN(596)" VALUE 0x0016262C /* @ECU_Address@FCtl_SPN@0x021B6950@ */ ECIPP_ALIGNMENT_ULONG 4294967295 Compu_IDENTITY 0 4294967295 PHYS_UNIT "SPN" /end CHARACTERISTIC
/begin CHARACTERISTIC FCspn_EGRflow_LoExp2 "FCtl_SPN(684)" VALUE 0x0016278C /* @ECU_Address@FCtl_SPN@0x021B6AB0@ */ ECIPP_ALIGNMENT_ULONG 4294967295 Compu_IDENTITY 0 4294967295 PHYS_UNIT "SPN" /end CHARACTERISTIC
/begin CHARACTERISTIC FCspn_EGRHP_maxv "FCtl_SPN(753)" VALUE 0x001628A0 /* @ECU_Address@FCtl_SPN@0x021B6BC4@ */ ECIPP_ALIGNMENT_ULONG 4294967295 Compu_IDENTITY 0 4294967295 PHYS_UNIT "SPN" /end CHARACTERISTIC
/begin CHARACTERISTIC FCspn_EGRHP_minv "FCtl_SPN(754)" VALUE 0x001628A4 /* @ECU_Address@FCtl_SPN@0x021B6BC8@ */ ECIPP_ALIGNMENT_ULONG 4294967295 Compu_IDENTITY 0 4294967295 PHYS_UNIT "SPN" /end CHARACTERISTIC
/begin CHARACTERISTIC FCspn_EGRHP_OOR "FCtl_SPN(755)" VALUE 0x001628A8 /* @ECU_Address@FCtl_SPN@0x021B6BCC@ */ ECIPP_ALIGNMENT_ULONG 4294967295 Compu_IDENTITY 0 4294967295 PHYS_UNIT "SPN" /end CHARACTERISTIC
/begin CHARACTERISTIC FCspn_EGRO_postlk "FCtl_SPN(798)" VALUE 0x00162954 /* @ECU_Address@FCtl_SPN@0x021B6C78@ */ ECIPP_ALIGNMENT_ULONG 4294967295 Compu_IDENTITY 0 4294967295 PHYS_UNIT "SPN" /end CHARACTERISTIC
/begin CHARACTERISTIC FCspn_EGRT_hi "FCtl_SPN(694)" VALUE 0x001627B4 /* @ECU_Address@FCtl_SPN@0x021B6AD8@ */ ECIPP_ALIGNMENT_ULONG 4294967295 Compu_IDENTITY 0 4294967295 PHYS_UNIT "SPN" /end CHARACTERISTIC
/begin CHARACTERISTIC FCspn_EGRT_maxv "FCtl_SPN(692)" VALUE 0x001627AC /* @ECU_Address@FCtl_SPN@0x021B6AD0@ */ ECIPP_ALIGNMENT_ULONG 4294967295 Compu_IDENTITY 0 4294967295 PHYS_UNIT "SPN" /end CHARACTERISTIC
/begin CHARACTERISTIC FCspn_EGRT_minv "FCtl_SPN(693)" VALUE 0x001627B0 /* @ECU_Address@FCtl_SPN@0x021B6AD4@ */ ECIPP_ALIGNMENT_ULONG 4294967295 Compu_IDENTITY 0 4294967295 PHYS_UNIT "SPN" /end CHARACTERISTIC
/begin CHARACTERISTIC FCspn_EGT_dig_Hi "FCtl_SPN(187)" VALUE 0x00161FC8 /* @ECU_Address@FCtl_SPN@0x021B62EC@ */ ECIPP_ALIGNMENT_ULONG 4294967295 Compu_IDENTITY 0 4294967295 PHYS_UNIT "SPN" /end CHARACTERISTIC
/begin CHARACTERISTIC FCspn_EGT_maxv "FCtl_SPN(808)" VALUE 0x0016297C /* @ECU_Address@FCtl_SPN@0x021B6CA0@ */ ECIPP_ALIGNMENT_ULONG 4294967295 Compu_IDENTITY 0 4294967295 PHYS_UNIT "SPN" /end CHARACTERISTIC
/begin CHARACTERISTIC FCspn_EGT_minv "FCtl_SPN(809)" VALUE 0x00162980 /* @ECU_Address@FCtl_SPN@0x021B6CA4@ */ ECIPP_ALIGNMENT_ULONG 4294967295 Compu_IDENTITY 0 4294967295 PHYS_UNIT "SPN" /end CHARACTERISTIC
/begin CHARACTERISTIC FCspn_EMWT1_HiExp1 "FCtl_SPN(225)" VALUE 0x00162060 /* @ECU_Address@FCtl_SPN@0x021B6384@ */ ECIPP_ALIGNMENT_ULONG 4294967295 Compu_IDENTITY 0 4294967295 PHYS_UNIT "SPN" /end CHARACTERISTIC
/begin CHARACTERISTIC FCspn_EMWT1_HiExp2 "FCtl_SPN(227)" VALUE 0x00162068 /* @ECU_Address@FCtl_SPN@0x021B638C@ */ ECIPP_ALIGNMENT_ULONG 4294967295 Compu_IDENTITY 0 4294967295 PHYS_UNIT "SPN" /end CHARACTERISTIC
/begin CHARACTERISTIC FCspn_EMWT1_maxv "FCtl_SPN(221)" VALUE 0x00162050 /* @ECU_Address@FCtl_SPN@0x021B6374@ */ ECIPP_ALIGNMENT_ULONG 4294967295 Compu_IDENTITY 0 4294967295 PHYS_UNIT "SPN" /end CHARACTERISTIC
/begin CHARACTERISTIC FCspn_EMWT1_minv "FCtl_SPN(223)" VALUE 0x00162058 /* @ECU_Address@FCtl_SPN@0x021B637C@ */ ECIPP_ALIGNMENT_ULONG 4294967295 Compu_IDENTITY 0 4294967295 PHYS_UNIT "SPN" /end CHARACTERISTIC
/begin CHARACTERISTIC FCspn_envtech_AAT_inv "FCtl_SPN(814)" VALUE 0x00162994 /* @ECU_Address@FCtl_SPN@0x021B6CB8@ */ ECIPP_ALIGNMENT_ULONG 4294967295 Compu_IDENTITY 0 4294967295 PHYS_UNIT "SPN" /end CHARACTERISTIC
/begin CHARACTERISTIC FCspn_envtech_BP_inv "FCtl_SPN(815)" VALUE 0x00162998 /* @ECU_Address@FCtl_SPN@0x021B6CBC@ */ ECIPP_ALIGNMENT_ULONG 4294967295 Compu_IDENTITY 0 4294967295 PHYS_UNIT "SPN" /end CHARACTERISTIC
/begin CHARACTERISTIC FCspn_envtech_comm "FCtl_SPN(358)" VALUE 0x00162274 /* @ECU_Address@FCtl_SPN@0x021B6598@ */ ECIPP_ALIGNMENT_ULONG 4294967295 Compu_IDENTITY 0 4294967295 PHYS_UNIT "SPN" /end CHARACTERISTIC
/begin CHARACTERISTIC FCspn_envtech_general "FCtl_SPN(817)" VALUE 0x001629A0 /* @ECU_Address@FCtl_SPN@0x021B6CC4@ */ ECIPP_ALIGNMENT_ULONG 4294967295 Compu_IDENTITY 0 4294967295 PHYS_UNIT "SPN" /end CHARACTERISTIC
/begin CHARACTERISTIC FCspn_envtech_RH_inv "FCtl_SPN(816)" VALUE 0x0016299C /* @ECU_Address@FCtl_SPN@0x021B6CC0@ */ ECIPP_ALIGNMENT_ULONG 4294967295 Compu_IDENTITY 0 4294967295 PHYS_UNIT "SPN" /end CHARACTERISTIC
/begin CHARACTERISTIC FCspn_envtech_RH_uns "FCtl_SPN(818)" VALUE 0x001629A4 /* @ECU_Address@FCtl_SPN@0x021B6CC8@ */ ECIPP_ALIGNMENT_ULONG 4294967295 Compu_IDENTITY 0 4294967295 PHYS_UNIT "SPN" /end CHARACTERISTIC
/begin CHARACTERISTIC FCspn_ERCV_speed_OOR "FCtl_SPN(853)" VALUE 0x00162A30 /* @ECU_Address@FCtl_SPN@0x021B6D54@ */ ECIPP_ALIGNMENT_ULONG 4294967295 Compu_IDENTITY 0 4294967295 PHYS_UNIT "SPN" /end CHARACTERISTIC
/begin CHARACTERISTIC FCspn_ERWT1_HiExp1 "FCtl_SPN(237)" VALUE 0x00162090 /* @ECU_Address@FCtl_SPN@0x021B63B4@ */ ECIPP_ALIGNMENT_ULONG 4294967295 Compu_IDENTITY 0 4294967295 PHYS_UNIT "SPN" /end CHARACTERISTIC
/begin CHARACTERISTIC FCspn_ERWT1_HiExp2 "FCtl_SPN(239)" VALUE 0x00162098 /* @ECU_Address@FCtl_SPN@0x021B63BC@ */ ECIPP_ALIGNMENT_ULONG 4294967295 Compu_IDENTITY 0 4294967295 PHYS_UNIT "SPN" /end CHARACTERISTIC
/begin CHARACTERISTIC FCspn_ERWT1_maxv "FCtl_SPN(233)" VALUE 0x00162080 /* @ECU_Address@FCtl_SPN@0x021B63A4@ */ ECIPP_ALIGNMENT_ULONG 4294967295 Compu_IDENTITY 0 4294967295 PHYS_UNIT "SPN" /end CHARACTERISTIC
/begin CHARACTERISTIC FCspn_ERWT1_minv "FCtl_SPN(235)" VALUE 0x00162088 /* @ECU_Address@FCtl_SPN@0x021B63AC@ */ ECIPP_ALIGNMENT_ULONG 4294967295 Compu_IDENTITY 0 4294967295 PHYS_UNIT "SPN" /end CHARACTERISTIC
/begin CHARACTERISTIC FCspn_F1OOR_F2IVS "FCtl_SPN(178)" VALUE 0x00161FA4 /* @ECU_Address@FCtl_SPN@0x021B62C8@ */ ECIPP_ALIGNMENT_ULONG 4294967295 Compu_IDENTITY 0 4294967295 PHYS_UNIT "SPN" /end CHARACTERISTIC
/begin CHARACTERISTIC FCspn_F2OOR_F1IVS "FCtl_SPN(179)" VALUE 0x00161FA8 /* @ECU_Address@FCtl_SPN@0x021B62CC@ */ ECIPP_ALIGNMENT_ULONG 4294967295 Compu_IDENTITY 0 4294967295 PHYS_UNIT "SPN" /end CHARACTERISTIC
/begin CHARACTERISTIC FCspn_FCoolH2O_lo "FCtl_SPN(532)" VALUE 0x0016252C /* @ECU_Address@FCtl_SPN@0x021B6850@ */ ECIPP_ALIGNMENT_ULONG 4294967295 Compu_IDENTITY 0 4294967295 PHYS_UNIT "SPN" /end CHARACTERISTIC
/begin CHARACTERISTIC FCspn_FIMP_pct_high "FCtl_SPN(282)" VALUE 0x00162144 /* @ECU_Address@FCtl_SPN@0x021B6468@ */ ECIPP_ALIGNMENT_ULONG 4294967295 Compu_IDENTITY 0 4294967295 PHYS_UNIT "SPN" /end CHARACTERISTIC
/begin CHARACTERISTIC FCspn_FIP_LoExp "FCtl_SPN(695)" VALUE 0x001627B8 /* @ECU_Address@FCtl_SPN@0x021B6ADC@ */ ECIPP_ALIGNMENT_ULONG 4294967295 Compu_IDENTITY 0 4294967295 PHYS_UNIT "SPN" /end CHARACTERISTIC
/begin CHARACTERISTIC FCspn_flash_fail "FCtl_SPN(105)" VALUE 0x00161E80 /* @ECU_Address@FCtl_SPN@0x021B61A4@ */ ECIPP_ALIGNMENT_ULONG 4294967295 Compu_IDENTITY 0 4294967295 PHYS_UNIT "SPN" /end CHARACTERISTIC
/begin CHARACTERISTIC FCspn_FP_high "FCtl_SPN(290)" VALUE 0x00162164 /* @ECU_Address@FCtl_SPN@0x021B6488@ */ ECIPP_ALIGNMENT_ULONG 4294967295 Compu_IDENTITY 0 4294967295 PHYS_UNIT "SPN" /end CHARACTERISTIC
/begin CHARACTERISTIC FCspn_FP_low "FCtl_SPN(291)" VALUE 0x00162168 /* @ECU_Address@FCtl_SPN@0x021B648C@ */ ECIPP_ALIGNMENT_ULONG 4294967295 Compu_IDENTITY 0 4294967295 PHYS_UNIT "SPN" /end CHARACTERISTIC
/begin CHARACTERISTIC FCspn_FP_maxv "FCtl_SPN(128)" VALUE 0x00161EDC /* @ECU_Address@FCtl_SPN@0x021B6200@ */ ECIPP_ALIGNMENT_ULONG 4294967295 Compu_IDENTITY 0 4294967295 PHYS_UNIT "SPN" /end CHARACTERISTIC
/begin CHARACTERISTIC FCspn_FP_minv "FCtl_SPN(129)" VALUE 0x00161EE0 /* @ECU_Address@FCtl_SPN@0x021B6204@ */ ECIPP_ALIGNMENT_ULONG 4294967295 Compu_IDENTITY 0 4294967295 PHYS_UNIT "SPN" /end CHARACTERISTIC
/begin CHARACTERISTIC FCspn_FP2_high "FCtl_SPN(463)" VALUE 0x00162418 /* @ECU_Address@FCtl_SPN@0x021B673C@ */ ECIPP_ALIGNMENT_ULONG 4294967295 Compu_IDENTITY 0 4294967295 PHYS_UNIT "SPN" /end CHARACTERISTIC
/begin CHARACTERISTIC FCspn_FP2_low "FCtl_SPN(464)" VALUE 0x0016241C /* @ECU_Address@FCtl_SPN@0x021B6740@ */ ECIPP_ALIGNMENT_ULONG 4294967295 Compu_IDENTITY 0 4294967295 PHYS_UNIT "SPN" /end CHARACTERISTIC
/begin CHARACTERISTIC FCspn_FP2_maxv "FCtl_SPN(461)" VALUE 0x00162410 /* @ECU_Address@FCtl_SPN@0x021B6734@ */ ECIPP_ALIGNMENT_ULONG 4294967295 Compu_IDENTITY 0 4294967295 PHYS_UNIT "SPN" /end CHARACTERISTIC
/begin CHARACTERISTIC FCspn_FP2_minv "FCtl_SPN(462)" VALUE 0x00162414 /* @ECU_Address@FCtl_SPN@0x021B6738@ */ ECIPP_ALIGNMENT_ULONG 4294967295 Compu_IDENTITY 0 4294967295 PHYS_UNIT "SPN" /end CHARACTERISTIC
/begin CHARACTERISTIC FCspn_FPD_off_hi "FCtl_SPN(94)" VALUE 0x00161E54 /* @ECU_Address@FCtl_SPN@0x021B6178@ */ ECIPP_ALIGNMENT_ULONG 4294967295 Compu_IDENTITY 0 4294967295 PHYS_UNIT "SPN" /end CHARACTERISTIC
/begin CHARACTERISTIC FCspn_FPD_on_lo "FCtl_SPN(93)" VALUE 0x00161E50 /* @ECU_Address@FCtl_SPN@0x021B6174@ */ ECIPP_ALIGNMENT_ULONG 4294967295 Compu_IDENTITY 0 4294967295 PHYS_UNIT "SPN" /end CHARACTERISTIC
/begin CHARACTERISTIC FCspn_FPlo_derate_actv "FCtl_SPN(807)" VALUE 0x00162978 /* @ECU_Address@FCtl_SPN@0x021B6C9C@ */ ECIPP_ALIGNMENT_ULONG 4294967295 Compu_IDENTITY 0 4294967295 PHYS_UNIT "SPN" /end CHARACTERISTIC
/begin CHARACTERISTIC FCspn_FPlo_derate_excess "FCtl_SPN(810)" VALUE 0x00162984 /* @ECU_Address@FCtl_SPN@0x021B6CA8@ */ ECIPP_ALIGNMENT_ULONG 4294967295 Compu_IDENTITY 0 4294967295 PHYS_UNIT "SPN" /end CHARACTERISTIC
/begin CHARACTERISTIC FCspn_FPP_NeutLock_fail "FCtl_SPN(658)" VALUE 0x00162724 /* @ECU_Address@FCtl_SPN@0x021B6A48@ */ ECIPP_ALIGNMENT_ULONG 4294967295 Compu_IDENTITY 0 4294967295 PHYS_UNIT "SPN" /end CHARACTERISTIC
/begin CHARACTERISTIC FCspn_FPP1_IVS_max "FCtl_SPN(23)" VALUE 0x00161D38 /* @ECU_Address@FCtl_SPN@0x021B605C@ */ ECIPP_ALIGNMENT_ULONG 4294967295 Compu_IDENTITY 0 4294967295 PHYS_UNIT "SPN" /end CHARACTERISTIC
/begin CHARACTERISTIC FCspn_FPP1_IVS_min "FCtl_SPN(24)" VALUE 0x00161D3C /* @ECU_Address@FCtl_SPN@0x021B6060@ */ ECIPP_ALIGNMENT_ULONG 4294967295 Compu_IDENTITY 0 4294967295 PHYS_UNIT "SPN" /end CHARACTERISTIC
/begin CHARACTERISTIC FCspn_FPP1_max "FCtl_SPN(19)" VALUE 0x00161D28 /* @ECU_Address@FCtl_SPN@0x021B604C@ */ ECIPP_ALIGNMENT_ULONG 4294967295 Compu_IDENTITY 0 4294967295 PHYS_UNIT "SPN" /end CHARACTERISTIC
/begin CHARACTERISTIC FCspn_FPP1_min "FCtl_SPN(20)" VALUE 0x00161D2C /* @ECU_Address@FCtl_SPN@0x021B6050@ */ ECIPP_ALIGNMENT_ULONG 4294967295 Compu_IDENTITY 0 4294967295 PHYS_UNIT "SPN" /end CHARACTERISTIC
/begin CHARACTERISTIC FCspn_FPP12_IVS_max "FCtl_SPN(175)" VALUE 0x00161F98 /* @ECU_Address@FCtl_SPN@0x021B62BC@ */ ECIPP_ALIGNMENT_ULONG 4294967295 Compu_IDENTITY 0 4294967295 PHYS_UNIT "SPN" /end CHARACTERISTIC
/begin CHARACTERISTIC FCspn_FPP12_IVS_min "FCtl_SPN(176)" VALUE 0x00161F9C /* @ECU_Address@FCtl_SPN@0x021B62C0@ */ ECIPP_ALIGNMENT_ULONG 4294967295 Compu_IDENTITY 0 4294967295 PHYS_UNIT "SPN" /end CHARACTERISTIC
/begin CHARACTERISTIC FCspn_FPP12_OOR "FCtl_SPN(177)" VALUE 0x00161FA0 /* @ECU_Address@FCtl_SPN@0x021B62C4@ */ ECIPP_ALIGNMENT_ULONG 4294967295 Compu_IDENTITY 0 4294967295 PHYS_UNIT "SPN" /end CHARACTERISTIC
/begin CHARACTERISTIC FCspn_FPP12IVS_TSC1 "FCtl_SPN(734)" VALUE 0x00162854 /* @ECU_Address@FCtl_SPN@0x021B6B78@ */ ECIPP_ALIGNMENT_ULONG 4294967295 Compu_IDENTITY 0 4294967295 PHYS_UNIT "SPN" /end CHARACTERISTIC
/begin CHARACTERISTIC FCspn_FPP12MM_IVSMM "FCtl_SPN(180)" VALUE 0x00161FAC /* @ECU_Address@FCtl_SPN@0x021B62D0@ */ ECIPP_ALIGNMENT_ULONG 4294967295 Compu_IDENTITY 0 4294967295 PHYS_UNIT "SPN" /end CHARACTERISTIC
/begin CHARACTERISTIC FCspn_FPP12pct_hi "FCtl_SPN(27)" VALUE 0x00161D48 /* @ECU_Address@FCtl_SPN@0x021B606C@ */ ECIPP_ALIGNMENT_ULONG 4294967295 Compu_IDENTITY 0 4294967295 PHYS_UNIT "SPN" /end CHARACTERISTIC
/begin CHARACTERISTIC FCspn_FPP12pct_lo "FCtl_SPN(28)" VALUE 0x00161D4C /* @ECU_Address@FCtl_SPN@0x021B6070@ */ ECIPP_ALIGNMENT_ULONG 4294967295 Compu_IDENTITY 0 4294967295 PHYS_UNIT "SPN" /end CHARACTERISTIC
/begin CHARACTERISTIC FPfl_EGR_slowdec "FPrm_latch(490)" VALUE 0x001607C0 /* @ECU_Address@FPrm_latch@0x021BB7A8@ */ ECIPP_ALIGNMENT_FLOAT32_IEEE 10000000000 Compu_IDENTITY -10000000000 10000000000 PHYS_UNIT "ms" /end CHARACTERISTIC
/begin CHARACTERISTIC FPfl_EGR_slowinc "FPrm_latch(489)" VALUE 0x001607BC /* @ECU_Address@FPrm_latch@0x021BB7A4@ */ ECIPP_ALIGNMENT_FLOAT32_IEEE 10000000000 Compu_IDENTITY -10000000000 10000000000 PHYS_UNIT "ms" /end CHARACTERISTIC
/begin CHARACTERISTIC FPfl_EGR_UEGOdP_hi "FPrm_latch(493)" VALUE 0x001607CC /* @ECU_Address@FPrm_latch@0x021BB7B4@ */ ECIPP_ALIGNMENT_FLOAT32_IEEE 10000000000 Compu_IDENTITY -10000000000 10000000000 PHYS_UNIT "ms" /end CHARACTERISTIC
/begin CHARACTERISTIC FPfl_EGR_UEGOdP_lo "FPrm_latch(494)" VALUE 0x001607D0 /* @ECU_Address@FPrm_latch@0x021BB7B8@ */ ECIPP_ALIGNMENT_FLOAT32_IEEE 10000000000 Compu_IDENTITY -10000000000 10000000000 PHYS_UNIT "ms" /end CHARACTERISTIC
/begin CHARACTERISTIC FPfl_EGR_vlv_DC_lim "FPrm_latch(573)" VALUE 0x0016090C /* @ECU_Address@FPrm_latch@0x021BB8F4@ */ ECIPP_ALIGNMENT_FLOAT32_IEEE 10000000000 Compu_IDENTITY -10000000000 10000000000 PHYS_UNIT "ms" /end CHARACTERISTIC
/begin CHARACTERISTIC FPfl_EGR_vlv_stuck "FPrm_latch(660)" VALUE 0x00160A68 /* @ECU_Address@FPrm_latch@0x021BBA50@ */ ECIPP_ALIGNMENT_FLOAT32_IEEE 10000000000 Compu_IDENTITY -10000000000 10000000000 PHYS_UNIT "ms" /end CHARACTERISTIC
/begin CHARACTERISTIC FPfl_EGR_vlv_temp_hi "FPrm_latch(574)" VALUE 0x00160910 /* @ECU_Address@FPrm_latch@0x021BB8F8@ */ ECIPP_ALIGNMENT_FLOAT32_IEEE 10000000000 Compu_IDENTITY -10000000000 10000000000 PHYS_UNIT "ms" /end CHARACTERISTIC
/begin CHARACTERISTIC FPfl_EGR_vlvCAN_commlost "FPrm_latch(497)" VALUE 0x001607DC /* @ECU_Address@FPrm_latch@0x021BB7C4@ */ ECIPP_ALIGNMENT_FLOAT32_IEEE 10000000000 Compu_IDENTITY -10000000000 10000000000 PHYS_UNIT "ms" /end CHARACTERISTIC
/begin CHARACTERISTIC FPfl_EGR_vlvCAN_lowfunc "FPrm_latch(499)" VALUE 0x001607E4 /* @ECU_Address@FPrm_latch@0x021BB7CC@ */ ECIPP_ALIGNMENT_FLOAT32_IEEE 10000000000 Compu_IDENTITY -10000000000 10000000000 PHYS_UNIT "ms" /end CHARACTERISTIC
/begin CHARACTERISTIC FPfl_EGR_vlvCAN_nofunc "FPrm_latch(498)" VALUE 0x001607E0 /* @ECU_Address@FPrm_latch@0x021BB7C8@ */ ECIPP_ALIGNMENT_FLOAT32_IEEE 10000000000 Compu_IDENTITY -10000000000 10000000000 PHYS_UNIT "ms" /end CHARACTERISTIC
/begin CHARACTERISTIC FPfl_EGRdP_HiExp "FPrm_latch(582)" VALUE 0x00160930 /* @ECU_Address@FPrm_latch@0x021BB918@ */ ECIPP_ALIGNMENT_FLOAT32_IEEE 10000000000 Compu_IDENTITY -10000000000 10000000000 PHYS_UNIT "ms" /end CHARACTERISTIC
/begin CHARACTERISTIC FPfl_EGRdP_LoExp "FPrm_latch(581)" VALUE 0x0016092C /* @ECU_Address@FPrm_latch@0x021BB914@ */ ECIPP_ALIGNMENT_FLOAT32_IEEE 10000000000 Compu_IDENTITY -10000000000 10000000000 PHYS_UNIT "ms" /end CHARACTERISTIC
/begin CHARACTERISTIC FPfl_EGRdP_maxv "FPrm_latch(579)" VALUE 0x00160924 /* @ECU_Address@FPrm_latch@0x021BB90C@ */ ECIPP_ALIGNMENT_FLOAT32_IEEE 10000000000 Compu_IDENTITY -10000000000 10000000000 PHYS_UNIT "ms" /end CHARACTERISTIC
/begin CHARACTERISTIC FPfl_EGRdP_minv "FPrm_latch(580)" VALUE 0x00160928 /* @ECU_Address@FPrm_latch@0x021BB910@ */ ECIPP_ALIGNMENT_FLOAT32_IEEE 10000000000 Compu_IDENTITY -10000000000 10000000000 PHYS_UNIT "ms" /end CHARACTERISTIC
/begin CHARACTERISTIC FPfl_EGRflow_HiExp "FPrm_latch(451)" VALUE 0x00160724 /* @ECU_Address@FPrm_latch@0x021BB70C@ */ ECIPP_ALIGNMENT_FLOAT32_IEEE 10000000000 Compu_IDENTITY -10000000000 10000000000 PHYS_UNIT "ms" /end CHARACTERISTIC
/begin CHARACTERISTIC FPfl_EGRflow_LoExp "FPrm_latch(450)" VALUE 0x00160720 /* @ECU_Address@FPrm_latch@0x021BB708@ */ ECIPP_ALIGNMENT_FLOAT32_IEEE 10000000000 Compu_IDENTITY -10000000000 10000000000 PHYS_UNIT "ms" /end CHARACTERISTIC
/begin CHARACTERISTIC FPfl_EGRflow_LoExp2 "FPrm_latch(514)" VALUE 0x00160820 /* @ECU_Address@FPrm_latch@0x021BB808@ */ ECIPP_ALIGNMENT_FLOAT32_IEEE 10000000000 Compu_IDENTITY -10000000000 10000000000 PHYS_UNIT "ms" /end CHARACTERISTIC
/begin CHARACTERISTIC FPfl_EGRHP_maxv "FPrm_latch(583)" VALUE 0x00160934 /* @ECU_Address@FPrm_latch@0x021BB91C@ */ ECIPP_ALIGNMENT_FLOAT32_IEEE 10000000000 Compu_IDENTITY -10000000000 10000000000 PHYS_UNIT "ms" /end CHARACTERISTIC
/begin CHARACTERISTIC FPfl_EGRHP_minv "FPrm_latch(584)" VALUE 0x00160938 /* @ECU_Address@FPrm_latch@0x021BB920@ */ ECIPP_ALIGNMENT_FLOAT32_IEEE 10000000000 Compu_IDENTITY -10000000000 10000000000 PHYS_UNIT "ms" /end CHARACTERISTIC
/begin CHARACTERISTIC FPfl_EGRHP_OOR "FPrm_latch(585)" VALUE 0x0016093C /* @ECU_Address@FPrm_latch@0x021BB924@ */ ECIPP_ALIGNMENT_FLOAT32_IEEE 10000000000 Compu_IDENTITY -10000000000 10000000000 PHYS_UNIT "ms" /end CHARACTERISTIC
/begin CHARACTERISTIC FPfl_EGRO_postlk "FPrm_latch(628)" VALUE 0x001609E8 /* @ECU_Address@FPrm_latch@0x021BB9D0@ */ ECIPP_ALIGNMENT_FLOAT32_IEEE 10000000000 Compu_IDENTITY -10000000000 10000000000 PHYS_UNIT "ms" /end CHARACTERISTIC
/begin CHARACTERISTIC FPfl_EGRT_hi "FPrm_latch(524)" VALUE 0x00160848 /* @ECU_Address@FPrm_latch@0x021BB830@ */ ECIPP_ALIGNMENT_FLOAT32_IEEE 10000000000 Compu_IDENTITY -10000000000 10000000000 PHYS_UNIT "ms" /end CHARACTERISTIC
/begin CHARACTERISTIC FPfl_EGRT_maxv "FPrm_latch(522)" VALUE 0x00160840 /* @ECU_Address@FPrm_latch@0x021BB828@ */ ECIPP_ALIGNMENT_FLOAT32_IEEE 10000000000 Compu_IDENTITY -10000000000 10000000000 PHYS_UNIT "ms" /end CHARACTERISTIC
/begin CHARACTERISTIC FPfl_EGRT_minv "FPrm_latch(523)" VALUE 0x00160844 /* @ECU_Address@FPrm_latch@0x021BB82C@ */ ECIPP_ALIGNMENT_FLOAT32_IEEE 10000000000 Compu_IDENTITY -10000000000 10000000000 PHYS_UNIT "ms" /end CHARACTERISTIC
/begin CHARACTERISTIC FPfl_EGT_dig_Hi "FPrm_latch(145)" VALUE 0x0016025C /* @ECU_Address@FPrm_latch@0x021BB244@ */ ECIPP_ALIGNMENT_FLOAT32_IEEE 10000000000 Compu_IDENTITY -10000000000 10000000000 PHYS_UNIT "ms" /end CHARACTERISTIC
/begin CHARACTERISTIC FPfl_EGT_maxv "FPrm_latch(635)" VALUE 0x00160A04 /* @ECU_Address@FPrm_latch@0x021BB9EC@ */ ECIPP_ALIGNMENT_FLOAT32_IEEE 10000000000 Compu_IDENTITY -10000000000 10000000000 PHYS_UNIT "ms" /end CHARACTERISTIC
/begin CHARACTERISTIC FPfl_EGT_minv "FPrm_latch(636)" VALUE 0x00160A08 /* @ECU_Address@FPrm_latch@0x021BB9F0@ */ ECIPP_ALIGNMENT_FLOAT32_IEEE 10000000000 Compu_IDENTITY -10000000000 10000000000 PHYS_UNIT "ms" /end CHARACTERISTIC
/begin CHARACTERISTIC FPfl_EMWT1_HiExp1 "FPrm_latch(179)" VALUE 0x001602E4 /* @ECU_Address@FPrm_latch@0x021BB2CC@ */ ECIPP_ALIGNMENT_FLOAT32_IEEE 10000000000 Compu_IDENTITY -10000000000 10000000000 PHYS_UNIT "ms" /end CHARACTERISTIC
/begin CHARACTERISTIC FPfl_EMWT1_HiExp2 "FPrm_latch(180)" VALUE 0x001602E8 /* @ECU_Address@FPrm_latch@0x021BB2D0@ */ ECIPP_ALIGNMENT_FLOAT32_IEEE 10000000000 Compu_IDENTITY -10000000000 10000000000 PHYS_UNIT "ms" /end CHARACTERISTIC
/begin CHARACTERISTIC FPfl_EMWT1_maxv "FPrm_latch(177)" VALUE 0x001602DC /* @ECU_Address@FPrm_latch@0x021BB2C4@ */ ECIPP_ALIGNMENT_FLOAT32_IEEE 10000000000 Compu_IDENTITY -10000000000 10000000000 PHYS_UNIT "ms" /end CHARACTERISTIC
/begin CHARACTERISTIC FPfl_EMWT1_minv "FPrm_latch(178)" VALUE 0x001602E0 /* @ECU_Address@FPrm_latch@0x021BB2C8@ */ ECIPP_ALIGNMENT_FLOAT32_IEEE 10000000000 Compu_IDENTITY -10000000000 10000000000 PHYS_UNIT "ms" /end CHARACTERISTIC
/begin CHARACTERISTIC FPfl_envtech_AAT_inv "FPrm_latch(641)" VALUE 0x00160A1C /* @ECU_Address@FPrm_latch@0x021BBA04@ */ ECIPP_ALIGNMENT_FLOAT32_IEEE 10000000000 Compu_IDENTITY -10000000000 10000000000 PHYS_UNIT "ms" /end CHARACTERISTIC
/begin CHARACTERISTIC FPfl_envtech_BP_inv "FPrm_latch(642)" VALUE 0x00160A20 /* @ECU_Address@FPrm_latch@0x021BBA08@ */ ECIPP_ALIGNMENT_FLOAT32_IEEE 10000000000 Compu_IDENTITY -10000000000 10000000000 PHYS_UNIT "ms" /end CHARACTERISTIC
/begin CHARACTERISTIC FPfl_envtech_comm "FPrm_latch(267)" VALUE 0x00160444 /* @ECU_Address@FPrm_latch@0x021BB42C@ */ ECIPP_ALIGNMENT_FLOAT32_IEEE 10000000000 Compu_IDENTITY -10000000000 10000000000 PHYS_UNIT "ms" /end CHARACTERISTIC
/begin CHARACTERISTIC FPfl_envtech_general "FPrm_latch(644)" VALUE 0x00160A28 /* @ECU_Address@FPrm_latch@0x021BBA10@ */ ECIPP_ALIGNMENT_FLOAT32_IEEE 10000000000 Compu_IDENTITY -10000000000 10000000000 PHYS_UNIT "ms" /end CHARACTERISTIC
/begin CHARACTERISTIC FPfl_envtech_RH_inv "FPrm_latch(643)" VALUE 0x00160A24 /* @ECU_Address@FPrm_latch@0x021BBA0C@ */ ECIPP_ALIGNMENT_FLOAT32_IEEE 10000000000 Compu_IDENTITY -10000000000 10000000000 PHYS_UNIT "ms" /end CHARACTERISTIC
/begin CHARACTERISTIC FPfl_envtech_RH_uns "FPrm_latch(645)" VALUE 0x00160A2C /* @ECU_Address@FPrm_latch@0x021BBA14@ */ ECIPP_ALIGNMENT_FLOAT32_IEEE 10000000000 Compu_IDENTITY -10000000000 10000000000 PHYS_UNIT "ms" /end CHARACTERISTIC
/begin CHARACTERISTIC FPfl_ERCV_speed_OOR "FPrm_latch(680)" VALUE 0x00160AB8 /* @ECU_Address@FPrm_latch@0x021BBAA0@ */ ECIPP_ALIGNMENT_FLOAT32_IEEE 10000000000 Compu_IDENTITY -10000000000 10000000000 PHYS_UNIT "ms" /end CHARACTERISTIC
/begin CHARACTERISTIC FPfl_ERWT1_HiExp1 "FPrm_latch(187)" VALUE 0x00160304 /* @ECU_Address@FPrm_latch@0x021BB2EC@ */ ECIPP_ALIGNMENT_FLOAT32_IEEE 10000000000 Compu_IDENTITY -10000000000 10000000000 PHYS_UNIT "ms" /end CHARACTERISTIC
/begin CHARACTERISTIC FPfl_ERWT1_HiExp2 "FPrm_latch(188)" VALUE 0x00160308 /* @ECU_Address@FPrm_latch@0x021BB2F0@ */ ECIPP_ALIGNMENT_FLOAT32_IEEE 10000000000 Compu_IDENTITY -10000000000 10000000000 PHYS_UNIT "ms" /end CHARACTERISTIC
/begin CHARACTERISTIC FPfl_ERWT1_maxv "FPrm_latch(185)" VALUE 0x001602FC /* @ECU_Address@FPrm_latch@0x021BB2E4@ */ ECIPP_ALIGNMENT_FLOAT32_IEEE 10000000000 Compu_IDENTITY -10000000000 10000000000 PHYS_UNIT "ms" /end CHARACTERISTIC
/begin CHARACTERISTIC FPfl_ERWT1_minv "FPrm_latch(186)" VALUE 0x00160300 /* @ECU_Address@FPrm_latch@0x021BB2E8@ */ ECIPP_ALIGNMENT_FLOAT32_IEEE 10000000000 Compu_IDENTITY -10000000000 10000000000 PHYS_UNIT "ms" /end CHARACTERISTIC
/begin CHARACTERISTIC FPfl_F1OOR_F2IVS "FPrm_latch(138)" VALUE 0x00160240 /* @ECU_Address@FPrm_latch@0x021BB228@ */ ECIPP_ALIGNMENT_FLOAT32_IEEE 10000000000 Compu_IDENTITY -10000000000 10000000000 PHYS_UNIT "ms" /end CHARACTERISTIC
/begin CHARACTERISTIC FPfl_F2OOR_F1IVS "FPrm_latch(139)" VALUE 0x00160244 /* @ECU_Address@FPrm_latch@0x021BB22C@ */ ECIPP_ALIGNMENT_FLOAT32_IEEE 10000000000 Compu_IDENTITY -10000000000 10000000000 PHYS_UNIT "ms" /end CHARACTERISTIC
/begin CHARACTERISTIC FPfl_FCoolH2O_lo "FPrm_latch(402)" VALUE 0x00160660 /* @ECU_Address@FPrm_latch@0x021BB648@ */ ECIPP_ALIGNMENT_FLOAT32_IEEE 10000000000 Compu_IDENTITY -10000000000 10000000000 PHYS_UNIT "ms" /end CHARACTERISTIC
/begin CHARACTERISTIC FPfl_FIMP_pct_high "FPrm_latch(204)" VALUE 0x00160348 /* @ECU_Address@FPrm_latch@0x021BB330@ */ ECIPP_ALIGNMENT_FLOAT32_IEEE 10000000000 Compu_IDENTITY -10000000000 10000000000 PHYS_UNIT "ms" /end CHARACTERISTIC
/begin CHARACTERISTIC FPfl_FIP_LoExp "FPrm_latch(525)" VALUE 0x0016084C /* @ECU_Address@FPrm_latch@0x021BB834@ */ ECIPP_ALIGNMENT_FLOAT32_IEEE 10000000000 Compu_IDENTITY -10000000000 10000000000 PHYS_UNIT "ms" /end CHARACTERISTIC
/begin CHARACTERISTIC FPfl_flash_fail "FPrm_latch(69)" VALUE 0x0016012C /* @ECU_Address@FPrm_latch@0x021BB114@ */ ECIPP_ALIGNMENT_FLOAT32_IEEE 10000000000 Compu_IDENTITY -10000000000 10000000000 PHYS_UNIT "ms" /end CHARACTERISTIC
/begin CHARACTERISTIC FPfl_FP_high "FPrm_latch(212)" VALUE 0x00160368 /* @ECU_Address@FPrm_latch@0x021BB350@ */ ECIPP_ALIGNMENT_FLOAT32_IEEE 10000000000 Compu_IDENTITY -10000000000 10000000000 PHYS_UNIT "ms" /end CHARACTERISTIC
/begin CHARACTERISTIC FPfl_FP_low "FPrm_latch(213)" VALUE 0x0016036C /* @ECU_Address@FPrm_latch@0x021BB354@ */ ECIPP_ALIGNMENT_FLOAT32_IEEE 10000000000 Compu_IDENTITY -10000000000 10000000000 PHYS_UNIT "ms" /end CHARACTERISTIC
/begin CHARACTERISTIC FPfl_FP_maxv "FPrm_latch(87)" VALUE 0x00160174 /* @ECU_Address@FPrm_latch@0x021BB15C@ */ ECIPP_ALIGNMENT_FLOAT32_IEEE 10000000000 Compu_IDENTITY -10000000000 10000000000 PHYS_UNIT "ms" /end CHARACTERISTIC
/begin CHARACTERISTIC FPfl_FP_minv "FPrm_latch(88)" VALUE 0x00160178 /* @ECU_Address@FPrm_latch@0x021BB160@ */ ECIPP_ALIGNMENT_FLOAT32_IEEE 10000000000 Compu_IDENTITY -10000000000 10000000000 PHYS_UNIT "ms" /end CHARACTERISTIC
/begin CHARACTERISTIC FPfl_FP2_high "FPrm_latch(360)" VALUE 0x001605B8 /* @ECU_Address@FPrm_latch@0x021BB5A0@ */ ECIPP_ALIGNMENT_FLOAT32_IEEE 10000000000 Compu_IDENTITY -10000000000 10000000000 PHYS_UNIT "ms" /end CHARACTERISTIC
/begin CHARACTERISTIC FPfl_FP2_low "FPrm_latch(361)" VALUE 0x001605BC /* @ECU_Address@FPrm_latch@0x021BB5A4@ */ ECIPP_ALIGNMENT_FLOAT32_IEEE 10000000000 Compu_IDENTITY -10000000000 10000000000 PHYS_UNIT "ms" /end CHARACTERISTIC
/begin CHARACTERISTIC FPfl_FP2_maxv "FPrm_latch(358)" VALUE 0x001605B0 /* @ECU_Address@FPrm_latch@0x021BB598@ */ ECIPP_ALIGNMENT_FLOAT32_IEEE 10000000000 Compu_IDENTITY -10000000000 10000000000 PHYS_UNIT "ms" /end CHARACTERISTIC
/begin CHARACTERISTIC FPfl_FP2_minv "FPrm_latch(359)" VALUE 0x001605B4 /* @ECU_Address@FPrm_latch@0x021BB59C@ */ ECIPP_ALIGNMENT_FLOAT32_IEEE 10000000000 Compu_IDENTITY -10000000000 10000000000 PHYS_UNIT "ms" /end CHARACTERISTIC
/begin CHARACTERISTIC FPfl_FPD_off_hi "FPrm_latch(58)" VALUE 0x00160100 /* @ECU_Address@FPrm_latch@0x021BB0E8@ */ ECIPP_ALIGNMENT_FLOAT32_IEEE 10000000000 Compu_IDENTITY -10000000000 10000000000 PHYS_UNIT "ms" /end CHARACTERISTIC
/begin CHARACTERISTIC FPfl_FPD_on_lo "FPrm_latch(57)" VALUE 0x001600FC /* @ECU_Address@FPrm_latch@0x021BB0E4@ */ ECIPP_ALIGNMENT_FLOAT32_IEEE 10000000000 Compu_IDENTITY -10000000000 10000000000 PHYS_UNIT "ms" /end CHARACTERISTIC
/begin CHARACTERISTIC FPfl_FPlo_derate_actv "FPrm_latch(634)" VALUE 0x00160A00 /* @ECU_Address@FPrm_latch@0x021BB9E8@ */ ECIPP_ALIGNMENT_FLOAT32_IEEE 10000000000 Compu_IDENTITY -10000000000 10000000000 PHYS_UNIT "ms" /end CHARACTERISTIC
/begin CHARACTERISTIC FPfl_FPlo_derate_excess "FPrm_latch(637)" VALUE 0x00160A0C /* @ECU_Address@FPrm_latch@0x021BB9F4@ */ ECIPP_ALIGNMENT_FLOAT32_IEEE 10000000000 Compu_IDENTITY -10000000000 10000000000 PHYS_UNIT "ms" /end CHARACTERISTIC
/begin CHARACTERISTIC FPfl_FPP_NeutLock_fail "FPrm_latch(488)" VALUE 0x001607B8 /* @ECU_Address@FPrm_latch@0x021BB7A0@ */ ECIPP_ALIGNMENT_FLOAT32_IEEE 10000000000 Compu_IDENTITY -10000000000 10000000000 PHYS_UNIT "ms" /end CHARACTERISTIC
/begin CHARACTERISTIC FPfl_FPP1_IVS_max "FPrm_latch(30)" VALUE 0x00160090 /* @ECU_Address@FPrm_latch@0x021BB078@ */ ECIPP_ALIGNMENT_FLOAT32_IEEE 10000000000 Compu_IDENTITY -10000000000 10000000000 PHYS_UNIT "ms" /end CHARACTERISTIC
/begin CHARACTERISTIC FPfl_FPP1_IVS_min "FPrm_latch(31)" VALUE 0x00160094 /* @ECU_Address@FPrm_latch@0x021BB07C@ */ ECIPP_ALIGNMENT_FLOAT32_IEEE 10000000000 Compu_IDENTITY -10000000000 10000000000 PHYS_UNIT "ms" /end CHARACTERISTIC
/begin CHARACTERISTIC FPfl_FPP1_max "FPrm_latch(26)" VALUE 0x00160080 /* @ECU_Address@FPrm_latch@0x021BB068@ */ ECIPP_ALIGNMENT_FLOAT32_IEEE 10000000000 Compu_IDENTITY -10000000000 10000000000 PHYS_UNIT "ms" /end CHARACTERISTIC
/begin CHARACTERISTIC FPfl_FPP1_min "FPrm_latch(27)" VALUE 0x00160084 /* @ECU_Address@FPrm_latch@0x021BB06C@ */ ECIPP_ALIGNMENT_FLOAT32_IEEE 10000000000 Compu_IDENTITY -10000000000 10000000000 PHYS_UNIT "ms" /end CHARACTERISTIC
/begin CHARACTERISTIC FPfl_FPP12_IVS_max "FPrm_latch(135)" VALUE 0x00160234 /* @ECU_Address@FPrm_latch@0x021BB21C@ */ ECIPP_ALIGNMENT_FLOAT32_IEEE 10000000000 Compu_IDENTITY -10000000000 10000000000 PHYS_UNIT "ms" /end CHARACTERISTIC
/begin CHARACTERISTIC FPfl_FPP12_IVS_min "FPrm_latch(136)" VALUE 0x00160238 /* @ECU_Address@FPrm_latch@0x021BB220@ */ ECIPP_ALIGNMENT_FLOAT32_IEEE 10000000000 Compu_IDENTITY -10000000000 10000000000 PHYS_UNIT "ms" /end CHARACTERISTIC
/begin CHARACTERISTIC FPfl_FPP12_OOR "FPrm_latch(137)" VALUE 0x0016023C /* @ECU_Address@FPrm_latch@0x021BB224@ */ ECIPP_ALIGNMENT_FLOAT32_IEEE 10000000000 Compu_IDENTITY -10000000000 10000000000 PHYS_UNIT "ms" /end CHARACTERISTIC
/begin CHARACTERISTIC FPfl_FPP12IVS_TSC1 "FPrm_latch(564)" VALUE 0x001608E8 /* @ECU_Address@FPrm_latch@0x021BB8D0@ */ ECIPP_ALIGNMENT_FLOAT32_IEEE 10000000000 Compu_IDENTITY -10000000000 10000000000 PHYS_UNIT "ms" /end CHARACTERISTIC
/begin CHARACTERISTIC FPfl_FPP12MM_IVSMM "FPrm_latch(140)" VALUE 0x00160248 /* @ECU_Address@FPrm_latch@0x021BB230@ */ ECIPP_ALIGNMENT_FLOAT32_IEEE 10000000000 Compu_IDENTITY -10000000000 10000000000 PHYS_UNIT "ms" /end CHARACTERISTIC
/begin CHARACTERISTIC FPfl_FPP12pct_hi "FPrm_latch(34)" VALUE 0x001600A0 /* @ECU_Address@FPrm_latch@0x021BB088@ */ ECIPP_ALIGNMENT_FLOAT32_IEEE 10000000000 Compu_IDENTITY -10000000000 10000000000 PHYS_UNIT "ms" /end CHARACTERISTIC
/begin CHARACTERISTIC FPfl_FPP12pct_lo "FPrm_latch(35)" VALUE 0x001600A4 /* @ECU_Address@FPrm_latch@0x021BB08C@ */ ECIPP_ALIGNMENT_FLOAT32_IEEE 10000000000 Compu_IDENTITY -10000000000 10000000000 PHYS_UNIT "ms" /end CHARACTERISTIC
/begin CHARACTERISTIC FPfu_EGR_slowdec "FPrm_unlatch(490)" VALUE 0x00161284 /* @ECU_Address@FPrm_unlatch@0x021BD7A8@ */ ECIPP_ALIGNMENT_FLOAT32_IEEE 10000000000 Compu_IDENTITY -10000000000 10000000000 PHYS_UNIT "ms" /end CHARACTERISTIC
/begin CHARACTERISTIC FPfu_EGR_slowinc "FPrm_unlatch(489)" VALUE 0x00161280 /* @ECU_Address@FPrm_unlatch@0x021BD7A4@ */ ECIPP_ALIGNMENT_FLOAT32_IEEE 10000000000 Compu_IDENTITY -10000000000 10000000000 PHYS_UNIT "ms" /end CHARACTERISTIC
/begin CHARACTERISTIC FPfu_EGR_UEGOdP_hi "FPrm_unlatch(493)" VALUE 0x00161290 /* @ECU_Address@FPrm_unlatch@0x021BD7B4@ */ ECIPP_ALIGNMENT_FLOAT32_IEEE 10000000000 Compu_IDENTITY -10000000000 10000000000 PHYS_UNIT "ms" /end CHARACTERISTIC
/begin CHARACTERISTIC FPfu_EGR_UEGOdP_lo "FPrm_unlatch(494)" VALUE 0x00161294 /* @ECU_Address@FPrm_unlatch@0x021BD7B8@ */ ECIPP_ALIGNMENT_FLOAT32_IEEE 10000000000 Compu_IDENTITY -10000000000 10000000000 PHYS_UNIT "ms" /end CHARACTERISTIC
/begin CHARACTERISTIC FPfu_EGR_vlv_DC_lim "FPrm_unlatch(573)" VALUE 0x001613D0 /* @ECU_Address@FPrm_unlatch@0x021BD8F4@ */ ECIPP_ALIGNMENT_FLOAT32_IEEE 10000000000 Compu_IDENTITY -10000000000 10000000000 PHYS_UNIT "ms" /end CHARACTERISTIC
/begin CHARACTERISTIC FPfu_EGR_vlv_stuck "FPrm_unlatch(660)" VALUE 0x0016152C /* @ECU_Address@FPrm_unlatch@0x021BDA50@ */ ECIPP_ALIGNMENT_FLOAT32_IEEE 10000000000 Compu_IDENTITY -10000000000 10000000000 PHYS_UNIT "ms" /end CHARACTERISTIC
/begin CHARACTERISTIC FPfu_EGR_vlv_temp_hi "FPrm_unlatch(574)" VALUE 0x001613D4 /* @ECU_Address@FPrm_unlatch@0x021BD8F8@ */ ECIPP_ALIGNMENT_FLOAT32_IEEE 10000000000 Compu_IDENTITY -10000000000 10000000000 PHYS_UNIT "ms" /end CHARACTERISTIC
/begin CHARACTERISTIC FPfu_EGR_vlvCAN_commlost "FPrm_unlatch(497)" VALUE 0x001612A0 /* @ECU_Address@FPrm_unlatch@0x021BD7C4@ */ ECIPP_ALIGNMENT_FLOAT32_IEEE 10000000000 Compu_IDENTITY -10000000000 10000000000 PHYS_UNIT "ms" /end CHARACTERISTIC
/begin CHARACTERISTIC FPfu_EGR_vlvCAN_lowfunc "FPrm_unlatch(499)" VALUE 0x001612A8 /* @ECU_Address@FPrm_unlatch@0x021BD7CC@ */ ECIPP_ALIGNMENT_FLOAT32_IEEE 10000000000 Compu_IDENTITY -10000000000 10000000000 PHYS_UNIT "ms" /end CHARACTERISTIC
/begin CHARACTERISTIC FPfu_EGR_vlvCAN_nofunc "FPrm_unlatch(498)" VALUE 0x001612A4 /* @ECU_Address@FPrm_unlatch@0x021BD7C8@ */ ECIPP_ALIGNMENT_FLOAT32_IEEE 10000000000 Compu_IDENTITY -10000000000 10000000000 PHYS_UNIT "ms" /end CHARACTERISTIC
/begin CHARACTERISTIC FPfu_EGRdP_HiExp "FPrm_unlatch(582)" VALUE 0x001613F4 /* @ECU_Address@FPrm_unlatch@0x021BD918@ */ ECIPP_ALIGNMENT_FLOAT32_IEEE 10000000000 Compu_IDENTITY -10000000000 10000000000 PHYS_UNIT "ms" /end CHARACTERISTIC
/begin CHARACTERISTIC FPfu_EGRdP_LoExp "FPrm_unlatch(581)" VALUE 0x001613F0 /* @ECU_Address@FPrm_unlatch@0x021BD914@ */ ECIPP_ALIGNMENT_FLOAT32_IEEE 10000000000 Compu_IDENTITY -10000000000 10000000000 PHYS_UNIT "ms" /end CHARACTERISTIC
/begin CHARACTERISTIC FPfu_EGRdP_maxv "FPrm_unlatch(579)" VALUE 0x001613E8 /* @ECU_Address@FPrm_unlatch@0x021BD90C@ */ ECIPP_ALIGNMENT_FLOAT32_IEEE 10000000000 Compu_IDENTITY -10000000000 10000000000 PHYS_UNIT "ms" /end CHARACTERISTIC
/begin CHARACTERISTIC FPfu_EGRdP_minv "FPrm_unlatch(580)" VALUE 0x001613EC /* @ECU_Address@FPrm_unlatch@0x021BD910@ */ ECIPP_ALIGNMENT_FLOAT32_IEEE 10000000000 Compu_IDENTITY -10000000000 10000000000 PHYS_UNIT "ms" /end CHARACTERISTIC
/begin CHARACTERISTIC FPfu_EGRflow_HiExp "FPrm_unlatch(451)" VALUE 0x001611E8 /* @ECU_Address@FPrm_unlatch@0x021BD70C@ */ ECIPP_ALIGNMENT_FLOAT32_IEEE 10000000000 Compu_IDENTITY -10000000000 10000000000 PHYS_UNIT "ms" /end CHARACTERISTIC
/begin CHARACTERISTIC FPfu_EGRflow_LoExp "FPrm_unlatch(450)" VALUE 0x001611E4 /* @ECU_Address@FPrm_unlatch@0x021BD708@ */ ECIPP_ALIGNMENT_FLOAT32_IEEE 10000000000 Compu_IDENTITY -10000000000 10000000000 PHYS_UNIT "ms" /end CHARACTERISTIC
/begin CHARACTERISTIC FPfu_EGRflow_LoExp2 "FPrm_unlatch(514)" VALUE 0x001612E4 /* @ECU_Address@FPrm_unlatch@0x021BD808@ */ ECIPP_ALIGNMENT_FLOAT32_IEEE 10000000000 Compu_IDENTITY -10000000000 10000000000 PHYS_UNIT "ms" /end CHARACTERISTIC
/begin CHARACTERISTIC FPfu_EGRHP_maxv "FPrm_unlatch(583)" VALUE 0x001613F8 /* @ECU_Address@FPrm_unlatch@0x021BD91C@ */ ECIPP_ALIGNMENT_FLOAT32_IEEE 10000000000 Compu_IDENTITY -10000000000 10000000000 PHYS_UNIT "ms" /end CHARACTERISTIC
/begin CHARACTERISTIC FPfu_EGRHP_minv "FPrm_unlatch(584)" VALUE 0x001613FC /* @ECU_Address@FPrm_unlatch@0x021BD920@ */ ECIPP_ALIGNMENT_FLOAT32_IEEE 10000000000 Compu_IDENTITY -10000000000 10000000000 PHYS_UNIT "ms" /end CHARACTERISTIC
/begin CHARACTERISTIC FPfu_EGRHP_OOR "FPrm_unlatch(585)" VALUE 0x00161400 /* @ECU_Address@FPrm_unlatch@0x021BD924@ */ ECIPP_ALIGNMENT_FLOAT32_IEEE 10000000000 Compu_IDENTITY -10000000000 10000000000 PHYS_UNIT "ms" /end CHARACTERISTIC
/begin CHARACTERISTIC FPfu_EGRO_postlk "FPrm_unlatch(628)" VALUE 0x001614AC /* @ECU_Address@FPrm_unlatch@0x021BD9D0@ */ ECIPP_ALIGNMENT_FLOAT32_IEEE 10000000000 Compu_IDENTITY -10000000000 10000000000 PHYS_UNIT "ms" /end CHARACTERISTIC
/begin CHARACTERISTIC FPfu_EGRT_hi "FPrm_unlatch(524)" VALUE 0x0016130C /* @ECU_Address@FPrm_unlatch@0x021BD830@ */ ECIPP_ALIGNMENT_FLOAT32_IEEE 10000000000 Compu_IDENTITY -10000000000 10000000000 PHYS_UNIT "ms" /end CHARACTERISTIC
/begin CHARACTERISTIC FPfu_EGRT_maxv "FPrm_unlatch(522)" VALUE 0x00161304 /* @ECU_Address@FPrm_unlatch@0x021BD828@ */ ECIPP_ALIGNMENT_FLOAT32_IEEE 10000000000 Compu_IDENTITY -10000000000 10000000000 PHYS_UNIT "ms" /end CHARACTERISTIC
/begin CHARACTERISTIC FPfu_EGRT_minv "FPrm_unlatch(523)" VALUE 0x00161308 /* @ECU_Address@FPrm_unlatch@0x021BD82C@ */ ECIPP_ALIGNMENT_FLOAT32_IEEE 10000000000 Compu_IDENTITY -10000000000 10000000000 PHYS_UNIT "ms" /end CHARACTERISTIC
/begin CHARACTERISTIC FPfu_EGT_dig_Hi "FPrm_unlatch(145)" VALUE 0x00160D20 /* @ECU_Address@FPrm_unlatch@0x021BD244@ */ ECIPP_ALIGNMENT_FLOAT32_IEEE 10000000000 Compu_IDENTITY -10000000000 10000000000 PHYS_UNIT "ms" /end CHARACTERISTIC
/begin CHARACTERISTIC FPfu_EGT_maxv "FPrm_unlatch(635)" VALUE 0x001614C8 /* @ECU_Address@FPrm_unlatch@0x021BD9EC@ */ ECIPP_ALIGNMENT_FLOAT32_IEEE 10000000000 Compu_IDENTITY -10000000000 10000000000 PHYS_UNIT "ms" /end CHARACTERISTIC
/begin CHARACTERISTIC FPfu_EGT_minv "FPrm_unlatch(636)" VALUE 0x001614CC /* @ECU_Address@FPrm_unlatch@0x021BD9F0@ */ ECIPP_ALIGNMENT_FLOAT32_IEEE 10000000000 Compu_IDENTITY -10000000000 10000000000 PHYS_UNIT "ms" /end CHARACTERISTIC
/begin CHARACTERISTIC FPfu_EMWT1_HiExp1 "FPrm_unlatch(179)" VALUE 0x00160DA8 /* @ECU_Address@FPrm_unlatch@0x021BD2CC@ */ ECIPP_ALIGNMENT_FLOAT32_IEEE 10000000000 Compu_IDENTITY -10000000000 10000000000 PHYS_UNIT "ms" /end CHARACTERISTIC
/begin CHARACTERISTIC FPfu_EMWT1_HiExp2 "FPrm_unlatch(180)" VALUE 0x00160DAC /* @ECU_Address@FPrm_unlatch@0x021BD2D0@ */ ECIPP_ALIGNMENT_FLOAT32_IEEE 10000000000 Compu_IDENTITY -10000000000 10000000000 PHYS_UNIT "ms" /end CHARACTERISTIC
/begin CHARACTERISTIC FPfu_EMWT1_maxv "FPrm_unlatch(177)" VALUE 0x00160DA0 /* @ECU_Address@FPrm_unlatch@0x021BD2C4@ */ ECIPP_ALIGNMENT_FLOAT32_IEEE 10000000000 Compu_IDENTITY -10000000000 10000000000 PHYS_UNIT "ms" /end CHARACTERISTIC
/begin CHARACTERISTIC FPfu_EMWT1_minv "FPrm_unlatch(178)" VALUE 0x00160DA4 /* @ECU_Address@FPrm_unlatch@0x021BD2C8@ */ ECIPP_ALIGNMENT_FLOAT32_IEEE 10000000000 Compu_IDENTITY -10000000000 10000000000 PHYS_UNIT "ms" /end CHARACTERISTIC
/begin CHARACTERISTIC FPfu_envtech_AAT_inv "FPrm_unlatch(641)" VALUE 0x001614E0 /* @ECU_Address@FPrm_unlatch@0x021BDA04@ */ ECIPP_ALIGNMENT_FLOAT32_IEEE 10000000000 Compu_IDENTITY -10000000000 10000000000 PHYS_UNIT "ms" /end CHARACTERISTIC
/begin CHARACTERISTIC FPfu_envtech_BP_inv "FPrm_unlatch(642)" VALUE 0x001614E4 /* @ECU_Address@FPrm_unlatch@0x021BDA08@ */ ECIPP_ALIGNMENT_FLOAT32_IEEE 10000000000 Compu_IDENTITY -10000000000 10000000000 PHYS_UNIT "ms" /end CHARACTERISTIC
/begin CHARACTERISTIC FPfu_envtech_comm "FPrm_unlatch(267)" VALUE 0x00160F08 /* @ECU_Address@FPrm_unlatch@0x021BD42C@ */ ECIPP_ALIGNMENT_FLOAT32_IEEE 10000000000 Compu_IDENTITY -10000000000 10000000000 PHYS_UNIT "ms" /end CHARACTERISTIC
/begin CHARACTERISTIC FPfu_envtech_general "FPrm_unlatch(644)" VALUE 0x001614EC /* @ECU_Address@FPrm_unlatch@0x021BDA10@ */ ECIPP_ALIGNMENT_FLOAT32_IEEE 10000000000 Compu_IDENTITY -10000000000 10000000000 PHYS_UNIT "ms" /end CHARACTERISTIC
/begin CHARACTERISTIC FPfu_envtech_RH_inv "FPrm_unlatch(643)" VALUE 0x001614E8 /* @ECU_Address@FPrm_unlatch@0x021BDA0C@ */ ECIPP_ALIGNMENT_FLOAT32_IEEE 10000000000 Compu_IDENTITY -10000000000 10000000000 PHYS_UNIT "ms" /end CHARACTERISTIC
/begin CHARACTERISTIC FPfu_envtech_RH_uns "FPrm_unlatch(645)" VALUE 0x001614F0 /* @ECU_Address@FPrm_unlatch@0x021BDA14@ */ ECIPP_ALIGNMENT_FLOAT32_IEEE 10000000000 Compu_IDENTITY -10000000000 10000000000 PHYS_UNIT "ms" /end CHARACTERISTIC
/begin CHARACTERISTIC FPfu_ERCV_speed_OOR "FPrm_unlatch(680)" VALUE 0x0016157C /* @ECU_Address@FPrm_unlatch@0x021BDAA0@ */ ECIPP_ALIGNMENT_FLOAT32_IEEE 10000000000 Compu_IDENTITY -10000000000 10000000000 PHYS_UNIT "ms" /end CHARACTERISTIC
/begin CHARACTERISTIC FPfu_ERWT1_HiExp1 "FPrm_unlatch(187)" VALUE 0x00160DC8 /* @ECU_Address@FPrm_unlatch@0x021BD2EC@ */ ECIPP_ALIGNMENT_FLOAT32_IEEE 10000000000 Compu_IDENTITY -10000000000 10000000000 PHYS_UNIT "ms" /end CHARACTERISTIC
/begin CHARACTERISTIC FPfu_ERWT1_HiExp2 "FPrm_unlatch(188)" VALUE 0x00160DCC /* @ECU_Address@FPrm_unlatch@0x021BD2F0@ */ ECIPP_ALIGNMENT_FLOAT32_IEEE 10000000000 Compu_IDENTITY -10000000000 10000000000 PHYS_UNIT "ms" /end CHARACTERISTIC
/begin CHARACTERISTIC FPfu_ERWT1_maxv "FPrm_unlatch(185)" VALUE 0x00160DC0 /* @ECU_Address@FPrm_unlatch@0x021BD2E4@ */ ECIPP_ALIGNMENT_FLOAT32_IEEE 10000000000 Compu_IDENTITY -10000000000 10000000000 PHYS_UNIT "ms" /end CHARACTERISTIC
/begin CHARACTERISTIC FPfu_ERWT1_minv "FPrm_unlatch(186)" VALUE 0x00160DC4 /* @ECU_Address@FPrm_unlatch@0x021BD2E8@ */ ECIPP_ALIGNMENT_FLOAT32_IEEE 10000000000 Compu_IDENTITY -10000000000 10000000000 PHYS_UNIT "ms" /end CHARACTERISTIC
/begin CHARACTERISTIC FPfu_F1OOR_F2IVS "FPrm_unlatch(138)" VALUE 0x00160D04 /* @ECU_Address@FPrm_unlatch@0x021BD228@ */ ECIPP_ALIGNMENT_FLOAT32_IEEE 10000000000 Compu_IDENTITY -10000000000 10000000000 PHYS_UNIT "ms" /end CHARACTERISTIC
/begin CHARACTERISTIC FPfu_F2OOR_F1IVS "FPrm_unlatch(139)" VALUE 0x00160D08 /* @ECU_Address@FPrm_unlatch@0x021BD22C@ */ ECIPP_ALIGNMENT_FLOAT32_IEEE 10000000000 Compu_IDENTITY -10000000000 10000000000 PHYS_UNIT "ms" /end CHARACTERISTIC
/begin CHARACTERISTIC FPfu_FCoolH2O_lo "FPrm_unlatch(402)" VALUE 0x00161124 /* @ECU_Address@FPrm_unlatch@0x021BD648@ */ ECIPP_ALIGNMENT_FLOAT32_IEEE 10000000000 Compu_IDENTITY -10000000000 10000000000 PHYS_UNIT "ms" /end CHARACTERISTIC
/begin CHARACTERISTIC FPfu_FIMP_pct_high "FPrm_unlatch(204)" VALUE 0x00160E0C /* @ECU_Address@FPrm_unlatch@0x021BD330@ */ ECIPP_ALIGNMENT_FLOAT32_IEEE 10000000000 Compu_IDENTITY -10000000000 10000000000 PHYS_UNIT "ms" /end CHARACTERISTIC
/begin CHARACTERISTIC FPfu_FIP_LoExp "FPrm_unlatch(525)" VALUE 0x00161310 /* @ECU_Address@FPrm_unlatch@0x021BD834@ */ ECIPP_ALIGNMENT_FLOAT32_IEEE 10000000000 Compu_IDENTITY -10000000000 10000000000 PHYS_UNIT "ms" /end CHARACTERISTIC
/begin CHARACTERISTIC FPfu_flash_fail "FPrm_unlatch(69)" VALUE 0x00160BF0 /* @ECU_Address@FPrm_unlatch@0x021BD114@ */ ECIPP_ALIGNMENT_FLOAT32_IEEE 10000000000 Compu_IDENTITY -10000000000 10000000000 PHYS_UNIT "ms" /end CHARACTERISTIC
/begin CHARACTERISTIC FPfu_FP_high "FPrm_unlatch(212)" VALUE 0x00160E2C /* @ECU_Address@FPrm_unlatch@0x021BD350@ */ ECIPP_ALIGNMENT_FLOAT32_IEEE 10000000000 Compu_IDENTITY -10000000000 10000000000 PHYS_UNIT "ms" /end CHARACTERISTIC
/begin CHARACTERISTIC FPfu_FP_low "FPrm_unlatch(213)" VALUE 0x00160E30 /* @ECU_Address@FPrm_unlatch@0x021BD354@ */ ECIPP_ALIGNMENT_FLOAT32_IEEE 10000000000 Compu_IDENTITY -10000000000 10000000000 PHYS_UNIT "ms" /end CHARACTERISTIC
/begin CHARACTERISTIC FPfu_FP_maxv "FPrm_unlatch(87)" VALUE 0x00160C38 /* @ECU_Address@FPrm_unlatch@0x021BD15C@ */ ECIPP_ALIGNMENT_FLOAT32_IEEE 10000000000 Compu_IDENTITY -10000000000 10000000000 PHYS_UNIT "ms" /end CHARACTERISTIC
/begin CHARACTERISTIC FPfu_FP_minv "FPrm_unlatch(88)" VALUE 0x00160C3C /* @ECU_Address@FPrm_unlatch@0x021BD160@ */ ECIPP_ALIGNMENT_FLOAT32_IEEE 10000000000 Compu_IDENTITY -10000000000 10000000000 PHYS_UNIT "ms" /end CHARACTERISTIC
/begin CHARACTERISTIC FPfu_FP2_high "FPrm_unlatch(360)" VALUE 0x0016107C /* @ECU_Address@FPrm_unlatch@0x021BD5A0@ */ ECIPP_ALIGNMENT_FLOAT32_IEEE 10000000000 Compu_IDENTITY -10000000000 10000000000 PHYS_UNIT "ms" /end CHARACTERISTIC
/begin CHARACTERISTIC FPfu_FP2_low "FPrm_unlatch(361)" VALUE 0x00161080 /* @ECU_Address@FPrm_unlatch@0x021BD5A4@ */ ECIPP_ALIGNMENT_FLOAT32_IEEE 10000000000 Compu_IDENTITY -10000000000 10000000000 PHYS_UNIT "ms" /end CHARACTERISTIC
/begin CHARACTERISTIC FPfu_FP2_maxv "FPrm_unlatch(358)" VALUE 0x00161074 /* @ECU_Address@FPrm_unlatch@0x021BD598@ */ ECIPP_ALIGNMENT_FLOAT32_IEEE 10000000000 Compu_IDENTITY -10000000000 10000000000 PHYS_UNIT "ms" /end CHARACTERISTIC
/begin CHARACTERISTIC FPfu_FP2_minv "FPrm_unlatch(359)" VALUE 0x00161078 /* @ECU_Address@FPrm_unlatch@0x021BD59C@ */ ECIPP_ALIGNMENT_FLOAT32_IEEE 10000000000 Compu_IDENTITY -10000000000 10000000000 PHYS_UNIT "ms" /end CHARACTERISTIC
/begin CHARACTERISTIC FPfu_FPD_off_hi "FPrm_unlatch(58)" VALUE 0x00160BC4 /* @ECU_Address@FPrm_unlatch@0x021BD0E8@ */ ECIPP_ALIGNMENT_FLOAT32_IEEE 10000000000 Compu_IDENTITY -10000000000 10000000000 PHYS_UNIT "ms" /end CHARACTERISTIC
/begin CHARACTERISTIC FPfu_FPD_on_lo "FPrm_unlatch(57)" VALUE 0x00160BC0 /* @ECU_Address@FPrm_unlatch@0x021BD0E4@ */ ECIPP_ALIGNMENT_FLOAT32_IEEE 10000000000 Compu_IDENTITY -10000000000 10000000000 PHYS_UNIT "ms" /end CHARACTERISTIC
/begin CHARACTERISTIC FPfu_FPlo_derate_actv "FPrm_unlatch(634)" VALUE 0x001614C4 /* @ECU_Address@FPrm_unlatch@0x021BD9E8@ */ ECIPP_ALIGNMENT_FLOAT32_IEEE 10000000000 Compu_IDENTITY -10000000000 10000000000 PHYS_UNIT "ms" /end CHARACTERISTIC
/begin CHARACTERISTIC FPfu_FPlo_derate_excess "FPrm_unlatch(637)" VALUE 0x001614D0 /* @ECU_Address@FPrm_unlatch@0x021BD9F4@ */ ECIPP_ALIGNMENT_FLOAT32_IEEE 10000000000 Compu_IDENTITY -10000000000 10000000000 PHYS_UNIT "ms" /end CHARACTERISTIC
/begin CHARACTERISTIC FPfu_FPP_NeutLock_fail "FPrm_unlatch(488)" VALUE 0x0016127C /* @ECU_Address@FPrm_unlatch@0x021BD7A0@ */ ECIPP_ALIGNMENT_FLOAT32_IEEE 10000000000 Compu_IDENTITY -10000000000 10000000000 PHYS_UNIT "ms" /end CHARACTERISTIC
/begin CHARACTERISTIC FPfu_FPP1_IVS_max "FPrm_unlatch(30)" VALUE 0x00160B54 /* @ECU_Address@FPrm_unlatch@0x021BD078@ */ ECIPP_ALIGNMENT_FLOAT32_IEEE 10000000000 Compu_IDENTITY -10000000000 10000000000 PHYS_UNIT "ms" /end CHARACTERISTIC
/begin CHARACTERISTIC FPfu_FPP1_IVS_min "FPrm_unlatch(31)" VALUE 0x00160B58 /* @ECU_Address@FPrm_unlatch@0x021BD07C@ */ ECIPP_ALIGNMENT_FLOAT32_IEEE 10000000000 Compu_IDENTITY -10000000000 10000000000 PHYS_UNIT "ms" /end CHARACTERISTIC
/begin CHARACTERISTIC FPfu_FPP1_max "FPrm_unlatch(26)" VALUE 0x00160B44 /* @ECU_Address@FPrm_unlatch@0x021BD068@ */ ECIPP_ALIGNMENT_FLOAT32_IEEE 10000000000 Compu_IDENTITY -10000000000 10000000000 PHYS_UNIT "ms" /end CHARACTERISTIC
/begin CHARACTERISTIC FPfu_FPP1_min "FPrm_unlatch(27)" VALUE 0x00160B48 /* @ECU_Address@FPrm_unlatch@0x021BD06C@ */ ECIPP_ALIGNMENT_FLOAT32_IEEE 10000000000 Compu_IDENTITY -10000000000 10000000000 PHYS_UNIT "ms" /end CHARACTERISTIC
/begin CHARACTERISTIC FPfu_FPP12_IVS_max "FPrm_unlatch(135)" VALUE 0x00160CF8 /* @ECU_Address@FPrm_unlatch@0x021BD21C@ */ ECIPP_ALIGNMENT_FLOAT32_IEEE 10000000000 Compu_IDENTITY -10000000000 10000000000 PHYS_UNIT "ms" /end CHARACTERISTIC
/begin CHARACTERISTIC FPfu_FPP12_IVS_min "FPrm_unlatch(136)" VALUE 0x00160CFC /* @ECU_Address@FPrm_unlatch@0x021BD220@ */ ECIPP_ALIGNMENT_FLOAT32_IEEE 10000000000 Compu_IDENTITY -10000000000 10000000000 PHYS_UNIT "ms" /end CHARACTERISTIC
/begin CHARACTERISTIC FPfu_FPP12_OOR "FPrm_unlatch(137)" VALUE 0x00160D00 /* @ECU_Address@FPrm_unlatch@0x021BD224@ */ ECIPP_ALIGNMENT_FLOAT32_IEEE 10000000000 Compu_IDENTITY -10000000000 10000000000 PHYS_UNIT "ms" /end CHARACTERISTIC
/begin CHARACTERISTIC FPfu_FPP12IVS_TSC1 "FPrm_unlatch(564)" VALUE 0x001613AC /* @ECU_Address@FPrm_unlatch@0x021BD8D0@ */ ECIPP_ALIGNMENT_FLOAT32_IEEE 10000000000 Compu_IDENTITY -10000000000 10000000000 PHYS_UNIT "ms" /end CHARACTERISTIC
/begin CHARACTERISTIC FPfu_FPP12MM_IVSMM "FPrm_unlatch(140)" VALUE 0x00160D0C /* @ECU_Address@FPrm_unlatch@0x021BD230@ */ ECIPP_ALIGNMENT_FLOAT32_IEEE 10000000000 Compu_IDENTITY -10000000000 10000000000 PHYS_UNIT "ms" /end CHARACTERISTIC
/begin CHARACTERISTIC FPfu_FPP12pct_hi "FPrm_unlatch(34)" VALUE 0x00160B64 /* @ECU_Address@FPrm_unlatch@0x021BD088@ */ ECIPP_ALIGNMENT_FLOAT32_IEEE 10000000000 Compu_IDENTITY -10000000000 10000000000 PHYS_UNIT "ms" /end CHARACTERISTIC
/begin CHARACTERISTIC FPfu_FPP12pct_lo "FPrm_unlatch(35)" VALUE 0x00160B68 /* @ECU_Address@FPrm_unlatch@0x021BD08C@ */ ECIPP_ALIGNMENT_FLOAT32_IEEE 10000000000 Compu_IDENTITY -10000000000 10000000000 PHYS_UNIT "ms" /end CHARACTERISTIC
/begin GROUP EGR_slowdec_EC_Fault "EGR flow slow to decrease / stuck open"
 /begin REF_CHARACTERISTIC FCdc4_EGR_slowdec FCdtc_EGR_slowdec FCfmi_EGR_slowdec FCftb_EGR_slowdec FCspn_EGR_slowdec FPfl_EGR_slowdec FPfu_EGR_slowdec FPnd_EGR_slowdec FPsvr_EGR_slowdec FPsw_ext1_EGR_slowdec FPsw_EGR_slowdec /end REF_CHARACTERISTIC
/end GROUP
/begin GROUP EGR_slowinc_EC_Fault "EGR flow slow to increase / stuck closed"
 /begin REF_CHARACTERISTIC FCdc4_EGR_slowinc FCdtc_EGR_slowinc FCfmi_EGR_slowinc FCftb_EGR_slowinc FCspn_EGR_slowinc FPfl_EGR_slowinc FPfu_EGR_slowinc FPnd_EGR_slowinc FPsvr_EGR_slowinc FPsw_ext1_EGR_slowinc FPsw_EGR_slowinc /end REF_CHARACTERISTIC
/end GROUP
/begin GROUP EGR_UEGOdP_hi_EC_Fault "EGR UEGO - dP feedback mismatch high"
 /begin REF_CHARACTERISTIC FCdc4_EGR_UEGOdP_hi FCdtc_EGR_UEGOdP_hi FCfmi_EGR_UEGOdP_hi FCftb_EGR_UEGOdP_hi FCspn_EGR_UEGOdP_hi FPfl_EGR_UEGOdP_hi FPfu_EGR_UEGOdP_hi FPnd_EGR_UEGOdP_hi FPsvr_EGR_UEGOdP_hi FPsw_ext1_EGR_UEGOdP_hi FPsw_EGR_UEGOdP_hi /end REF_CHARACTERISTIC
/end GROUP
/begin GROUP EGR_UEGOdP_lo_EC_Fault "EGR UEGO - dP feedback mismatch low"
 /begin REF_CHARACTERISTIC FCdc4_EGR_UEGOdP_lo FCdtc_EGR_UEGOdP_lo FCfmi_EGR_UEGOdP_lo FCftb_EGR_UEGOdP_lo FCspn_EGR_UEGOdP_lo FPfl_EGR_UEGOdP_lo FPfu_EGR_UEGOdP_lo FPnd_EGR_UEGOdP_lo FPsvr_EGR_UEGOdP_lo FPsw_ext1_EGR_UEGOdP_lo FPsw_EGR_UEGOdP_lo /end REF_CHARACTERISTIC
/end GROUP
/begin GROUP EGR_vlv_DC_lim_EC_Fault "EGR brushed valve duty cycle limit"
 /begin REF_CHARACTERISTIC FCdc4_EGR_vlv_DC_lim FCdtc_EGR_vlv_DC_lim FCfmi_EGR_vlv_DC_lim FCftb_EGR_vlv_DC_lim FCspn_EGR_vlv_DC_lim FPfl_EGR_vlv_DC_lim FPfu_EGR_vlv_DC_lim FPnd_EGR_vlv_DC_lim FPsvr_EGR_vlv_DC_lim FPsw_ext1_EGR_vlv_DC_lim FPsw_EGR_vlv_DC_lim /end REF_CHARACTERISTIC
/end GROUP
/begin GROUP EGR_vlv_stuck_EC_Fault "EGR valve sticking"
 /begin REF_CHARACTERISTIC FCdc4_EGR_vlv_stuck FCdtc_EGR_vlv_stuck FCfmi_EGR_vlv_stuck FCftb_EGR_vlv_stuck FCspn_EGR_vlv_stuck FPfl_EGR_vlv_stuck FPfu_EGR_vlv_stuck FPnd_EGR_vlv_stuck FPsvr_EGR_vlv_stuck FPsw_ext1_EGR_vlv_stuck FPsw_EGR_vlv_stuck /end REF_CHARACTERISTIC
/end GROUP
/begin GROUP EGR_vlv_temp_hi_EC_Fault "EGR brushed valve temperature high"
 /begin REF_CHARACTERISTIC FCdc4_EGR_vlv_temp_hi FCdtc_EGR_vlv_temp_hi FCfmi_EGR_vlv_temp_hi FCftb_EGR_vlv_temp_hi FCspn_EGR_vlv_temp_hi FPfl_EGR_vlv_temp_hi FPfu_EGR_vlv_temp_hi FPnd_EGR_vlv_temp_hi FPsvr_EGR_vlv_temp_hi FPsw_ext1_EGR_vlv_temp_hi FPsw_EGR_vlv_temp_hi /end REF_CHARACTERISTIC
/end GROUP
/begin GROUP EGR_vlvCAN_commlost_EC_Fault "EGR CAN valve communication lost"
 /begin REF_CHARACTERISTIC FCdc4_EGR_vlvCAN_commlost FCdtc_EGR_vlvCAN_commlost FCfmi_EGR_vlvCAN_commlost FCftb_EGR_vlvCAN_commlost FCspn_EGR_vlvCAN_commlost FPfl_EGR_vlvCAN_commlost FPfu_EGR_vlvCAN_commlost FPnd_EGR_vlvCAN_commlost FPsvr_EGR_vlvCAN_commlost FPsw_ext1_EGR_vlvCAN_commlost FPsw_EGR_vlvCAN_commlost /end REF_CHARACTERISTIC
/end GROUP
/begin GROUP EGR_vlvCAN_lowfunc_EC_Fault "EGR CAN valve reduced functionality"
 /begin REF_CHARACTERISTIC FCdc4_EGR_vlvCAN_lowfunc FCdtc_EGR_vlvCAN_lowfunc FCfmi_EGR_vlvCAN_lowfunc FCftb_EGR_vlvCAN_lowfunc FCspn_EGR_vlvCAN_lowfunc FPfl_EGR_vlvCAN_lowfunc FPfu_EGR_vlvCAN_lowfunc FPnd_EGR_vlvCAN_lowfunc FPsvr_EGR_vlvCAN_lowfunc FPsw_ext1_EGR_vlvCAN_lowfunc FPsw_EGR_vlvCAN_lowfunc /end REF_CHARACTERISTIC
/end GROUP
/begin GROUP EGR_vlvCAN_nofunc_EC_Fault "EGR CAN valve loss of function"
 /begin REF_CHARACTERISTIC FCdc4_EGR_vlvCAN_nofunc FCdtc_EGR_vlvCAN_nofunc FCfmi_EGR_vlvCAN_nofunc FCftb_EGR_vlvCAN_nofunc FCspn_EGR_vlvCAN_nofunc FPfl_EGR_vlvCAN_nofunc FPfu_EGR_vlvCAN_nofunc FPnd_EGR_vlvCAN_nofunc FPsvr_EGR_vlvCAN_nofunc FPsw_ext1_EGR_vlvCAN_nofunc FPsw_EGR_vlvCAN_nofunc /end REF_CHARACTERISTIC
/end GROUP
/begin GROUP EGRdP_HiExp_EC_Fault "EGRdP higher than expected"
 /begin REF_CHARACTERISTIC FCdc4_EGRdP_HiExp FCdtc_EGRdP_HiExp FCfmi_EGRdP_HiExp FCftb_EGRdP_HiExp FCspn_EGRdP_HiExp FPfl_EGRdP_HiExp FPfu_EGRdP_HiExp FPnd_EGRdP_HiExp FPsvr_EGRdP_HiExp FPsw_ext1_EGRdP_HiExp FPsw_EGRdP_HiExp /end REF_CHARACTERISTIC
/end GROUP
/begin GROUP EGRdP_LoExp_EC_Fault "EGRdP lower than expected"
 /begin REF_CHARACTERISTIC FCdc4_EGRdP_LoExp FCdtc_EGRdP_LoExp FCfmi_EGRdP_LoExp FCftb_EGRdP_LoExp FCspn_EGRdP_LoExp FPfl_EGRdP_LoExp FPfu_EGRdP_LoExp FPnd_EGRdP_LoExp FPsvr_EGRdP_LoExp FPsw_ext1_EGRdP_LoExp FPsw_EGRdP_LoExp /end REF_CHARACTERISTIC
/end GROUP
/begin GROUP EGRdP_maxv_EC_Fault "EGRdP high voltage"
 /begin REF_CHARACTERISTIC FCdc4_EGRdP_maxv FCdtc_EGRdP_maxv FCfmi_EGRdP_maxv FCftb_EGRdP_maxv FCspn_EGRdP_maxv FPfl_EGRdP_maxv FPfu_EGRdP_maxv FPnd_EGRdP_maxv FPsvr_EGRdP_maxv FPsw_ext1_EGRdP_maxv FPsw_EGRdP_maxv /end REF_CHARACTERISTIC
/end GROUP
/begin GROUP EGRdP_minv_EC_Fault "EGRdP low voltage"
 /begin REF_CHARACTERISTIC FCdc4_EGRdP_minv FCdtc_EGRdP_minv FCfmi_EGRdP_minv FCftb_EGRdP_minv FCspn_EGRdP_minv FPfl_EGRdP_minv FPfu_EGRdP_minv FPnd_EGRdP_minv FPsvr_EGRdP_minv FPsw_ext1_EGRdP_minv FPsw_EGRdP_minv /end REF_CHARACTERISTIC
/end GROUP
/begin GROUP EGRflow_HiExp_EC_Fault "EGR flow higher than expected"
 /begin REF_CHARACTERISTIC FCdc4_EGRflow_HiExp FCdtc_EGRflow_HiExp FCfmi_EGRflow_HiExp FCftb_EGRflow_HiExp FCspn_EGRflow_HiExp FPfl_EGRflow_HiExp FPfu_EGRflow_HiExp FPnd_EGRflow_HiExp FPsvr_EGRflow_HiExp FPsw_ext1_EGRflow_HiExp FPsw_EGRflow_HiExp /end REF_CHARACTERISTIC
/end GROUP
/begin GROUP EGRflow_LoExp_EC_Fault "EGR flow lower than expected 1"
 /begin REF_CHARACTERISTIC FCdc4_EGRflow_LoExp FCdtc_EGRflow_LoExp FCfmi_EGRflow_LoExp FCftb_EGRflow_LoExp FCspn_EGRflow_LoExp FPfl_EGRflow_LoExp FPfu_EGRflow_LoExp FPnd_EGRflow_LoExp FPsvr_EGRflow_LoExp FPsw_ext1_EGRflow_LoExp FPsw_EGRflow_LoExp /end REF_CHARACTERISTIC
/end GROUP
/begin GROUP EGRflow_LoExp2_EC_Fault "EGR flow lower than expected 2"
 /begin REF_CHARACTERISTIC FCdc4_EGRflow_LoExp2 FCdtc_EGRflow_LoExp2 FCfmi_EGRflow_LoExp2 FCftb_EGRflow_LoExp2 FCspn_EGRflow_LoExp2 FPfl_EGRflow_LoExp2 FPfu_EGRflow_LoExp2 FPnd_EGRflow_LoExp2 FPsvr_EGRflow_LoExp2 FPsw_ext1_EGRflow_LoExp2 FPsw_EGRflow_LoExp2 /end REF_CHARACTERISTIC
/end GROUP
/begin GROUP EGRHP_maxv_EC_Fault "EGRHP high voltage"
 /begin REF_CHARACTERISTIC FCdc4_EGRHP_maxv FCdtc_EGRHP_maxv FCfmi_EGRHP_maxv FCftb_EGRHP_maxv FCspn_EGRHP_maxv FPfl_EGRHP_maxv FPfu_EGRHP_maxv FPnd_EGRHP_maxv FPsvr_EGRHP_maxv FPsw_ext1_EGRHP_maxv FPsw_EGRHP_maxv /end REF_CHARACTERISTIC
/end GROUP
/begin GROUP EGRHP_minv_EC_Fault "EGRHP low voltage"
 /begin REF_CHARACTERISTIC FCdc4_EGRHP_minv FCdtc_EGRHP_minv FCfmi_EGRHP_minv FCftb_EGRHP_minv FCspn_EGRHP_minv FPfl_EGRHP_minv FPfu_EGRHP_minv FPnd_EGRHP_minv FPsvr_EGRHP_minv FPsw_ext1_EGRHP_minv FPsw_EGRHP_minv /end REF_CHARACTERISTIC
/end GROUP
/begin GROUP EGRHP_OOR_EC_Fault "EGRHP out of range"
 /begin REF_CHARACTERISTIC FCdc4_EGRHP_OOR FCdtc_EGRHP_OOR FCfmi_EGRHP_OOR FCftb_EGRHP_OOR FCspn_EGRHP_OOR FPfl_EGRHP_OOR FPfu_EGRHP_OOR FPnd_EGRHP_OOR FPsvr_EGRHP_OOR FPsw_ext1_EGRHP_OOR FPsw_EGRHP_OOR /end REF_CHARACTERISTIC
/end GROUP
/begin GROUP EGRO_postlk_EC_Fault "EGR post-orifice leak detected"
 /begin REF_CHARACTERISTIC FCdc4_EGRO_postlk FCdtc_EGRO_postlk FCfmi_EGRO_postlk FCftb_EGRO_postlk FCspn_EGRO_postlk FPfl_EGRO_postlk FPfu_EGRO_postlk FPnd_EGRO_postlk FPsvr_EGRO_postlk FPsw_ext1_EGRO_postlk FPsw_EGRO_postlk /end REF_CHARACTERISTIC
/end GROUP
/begin GROUP EGRT_hi_EC_Fault "EGRT temperature high"
 /begin REF_CHARACTERISTIC FCdc4_EGRT_hi FCdtc_EGRT_hi FCfmi_EGRT_hi FCftb_EGRT_hi FCspn_EGRT_hi FPfl_EGRT_hi FPfu_EGRT_hi FPnd_EGRT_hi FPsvr_EGRT_hi FPsw_ext1_EGRT_hi FPsw_EGRT_hi /end REF_CHARACTERISTIC
/end GROUP
/begin GROUP EGRT_maxv_EC_Fault "EGRT high voltage"
 /begin REF_CHARACTERISTIC FCdc4_EGRT_maxv FCdtc_EGRT_maxv FCfmi_EGRT_maxv FCftb_EGRT_maxv FCspn_EGRT_maxv FPfl_EGRT_maxv FPfu_EGRT_maxv FPnd_EGRT_maxv FPsvr_EGRT_maxv FPsw_ext1_EGRT_maxv FPsw_EGRT_maxv /end REF_CHARACTERISTIC
/end GROUP
/begin GROUP EGRT_minv_EC_Fault "EGRT low voltage"
 /begin REF_CHARACTERISTIC FCdc4_EGRT_minv FCdtc_EGRT_minv FCfmi_EGRT_minv FCftb_EGRT_minv FCspn_EGRT_minv FPfl_EGRT_minv FPfu_EGRT_minv FPnd_EGRT_minv FPsvr_EGRT_minv FPsw_ext1_EGRT_minv FPsw_EGRT_minv /end REF_CHARACTERISTIC
/end GROUP
/begin GROUP EGT_dig_Hi_EC_Fault "Exhaust gas temperature high"
 /begin REF_CHARACTERISTIC FCdc4_EGT_dig_Hi FCdtc_EGT_dig_Hi FCfmi_EGT_dig_Hi FCftb_EGT_dig_Hi FCspn_EGT_dig_Hi FPfl_EGT_dig_Hi FPfu_EGT_dig_Hi FPnd_EGT_dig_Hi FPsvr_EGT_dig_Hi FPsw_ext1_EGT_dig_Hi FPsw_EGT_dig_Hi /end REF_CHARACTERISTIC
/end GROUP
/begin GROUP EGT_maxv_EC_Fault "Exhaust gas temperature high voltage"
 /begin REF_CHARACTERISTIC FCdc4_EGT_maxv FCdtc_EGT_maxv FCfmi_EGT_maxv FCftb_EGT_maxv FCspn_EGT_maxv FPfl_EGT_maxv FPfu_EGT_maxv FPnd_EGT_maxv FPsvr_EGT_maxv FPsw_ext1_EGT_maxv FPsw_EGT_maxv /end REF_CHARACTERISTIC
/end GROUP
/begin GROUP EGT_minv_EC_Fault "Exhaust gas temperature low voltage"
 /begin REF_CHARACTERISTIC FCdc4_EGT_minv FCdtc_EGT_minv FCfmi_EGT_minv FCftb_EGT_minv FCspn_EGT_minv FPfl_EGT_minv FPfu_EGT_minv FPnd_EGT_minv FPsvr_EGT_minv FPsw_ext1_EGT_minv FPsw_EGT_minv /end REF_CHARACTERISTIC
/end GROUP
/begin GROUP EMWT1_HiExp1_EC_Fault "EMWT1/2 higher than expected level 1"
 /begin REF_CHARACTERISTIC FCdc4_EMWT1_HiExp1 FCdtc_EMWT1_HiExp1 FCfmi_EMWT1_HiExp1 FCftb_EMWT1_HiExp1 FCspn_EMWT1_HiExp1 FPfl_EMWT1_HiExp1 FPfu_EMWT1_HiExp1 FPnd_EMWT1_HiExp1 FPsvr_EMWT1_HiExp1 FPsw_ext1_EMWT1_HiExp1 FPsw_EMWT1_HiExp1 /end REF_CHARACTERISTIC
/end GROUP
/begin GROUP EMWT1_HiExp2_EC_Fault "EMWT1/2 higher than expected level 2"
 /begin REF_CHARACTERISTIC FCdc4_EMWT1_HiExp2 FCdtc_EMWT1_HiExp2 FCfmi_EMWT1_HiExp2 FCftb_EMWT1_HiExp2 FCspn_EMWT1_HiExp2 FPfl_EMWT1_HiExp2 FPfu_EMWT1_HiExp2 FPnd_EMWT1_HiExp2 FPsvr_EMWT1_HiExp2 FPsw_ext1_EMWT1_HiExp2 FPsw_EMWT1_HiExp2 /end REF_CHARACTERISTIC
/end GROUP
/begin GROUP EMWT1_maxv_EC_Fault "EMWT1/2 high voltage"
 /begin REF_CHARACTERISTIC FCdc4_EMWT1_maxv FCdtc_EMWT1_maxv FCfmi_EMWT1_maxv FCftb_EMWT1_maxv FCspn_EMWT1_maxv FPfl_EMWT1_maxv FPfu_EMWT1_maxv FPnd_EMWT1_maxv FPsvr_EMWT1_maxv FPsw_ext1_EMWT1_maxv FPsw_EMWT1_maxv /end REF_CHARACTERISTIC
/end GROUP
/begin GROUP EMWT1_minv_EC_Fault "EMWT1/2 low voltage"
 /begin REF_CHARACTERISTIC FCdc4_EMWT1_minv FCdtc_EMWT1_minv FCfmi_EMWT1_minv FCftb_EMWT1_minv FCspn_EMWT1_minv FPfl_EMWT1_minv FPfu_EMWT1_minv FPnd_EMWT1_minv FPsvr_EMWT1_minv FPsw_ext1_EMWT1_minv FPsw_EMWT1_minv /end REF_CHARACTERISTIC
/end GROUP
/begin GROUP envtech_AAT_inv_EC_Fault "Environmental sensor ambient air temperature invalid"
 /begin REF_CHARACTERISTIC FCdc4_envtech_AAT_inv FCdtc_envtech_AAT_inv FCfmi_envtech_AAT_inv FCftb_envtech_AAT_inv FCspn_envtech_AAT_inv FPfl_envtech_AAT_inv FPfu_envtech_AAT_inv FPnd_envtech_AAT_inv FPsvr_envtech_AAT_inv FPsw_ext1_envtech_AAT_inv FPsw_envtech_AAT_inv /end REF_CHARACTERISTIC
/end GROUP
/begin GROUP envtech_BP_inv_EC_Fault "Environmental sensor barometric pressure invalid"
 /begin REF_CHARACTERISTIC FCdc4_envtech_BP_inv FCdtc_envtech_BP_inv FCfmi_envtech_BP_inv FCftb_envtech_BP_inv FCspn_envtech_BP_inv FPfl_envtech_BP_inv FPfu_envtech_BP_inv FPnd_envtech_BP_inv FPsvr_envtech_BP_inv FPsw_ext1_envtech_BP_inv FPsw_envtech_BP_inv /end REF_CHARACTERISTIC
/end GROUP
/begin GROUP envtech_comm_EC_Fault "Environmental sensor receipt lost"
 /begin REF_CHARACTERISTIC FCdc4_envtech_comm FCdtc_envtech_comm FCfmi_envtech_comm FCftb_envtech_comm FCspn_envtech_comm FPfl_envtech_comm FPfu_envtech_comm FPnd_envtech_comm FPsvr_envtech_comm FPsw_ext1_envtech_comm FPsw_envtech_comm /end REF_CHARACTERISTIC
/end GROUP
/begin GROUP envtech_general_EC_Fault "Environmental sensor general fault"
 /begin REF_CHARACTERISTIC FCdc4_envtech_general FCdtc_envtech_general FCfmi_envtech_general FCftb_envtech_general FCspn_envtech_general FPfl_envtech_general FPfu_envtech_general FPnd_envtech_general FPsvr_envtech_general FPsw_ext1_envtech_general FPsw_envtech_general /end REF_CHARACTERISTIC
/end GROUP
/begin GROUP envtech_RH_inv_EC_Fault "Environmental sensor relative humidity invalid"
 /begin REF_CHARACTERISTIC FCdc4_envtech_RH_inv FCdtc_envtech_RH_inv FCfmi_envtech_RH_inv FCftb_envtech_RH_inv FCspn_envtech_RH_inv FPfl_envtech_RH_inv FPfu_envtech_RH_inv FPnd_envtech_RH_inv FPsvr_envtech_RH_inv FPsw_ext1_envtech_RH_inv FPsw_envtech_RH_inv /end REF_CHARACTERISTIC
/end GROUP
/begin GROUP envtech_RH_uns_EC_Fault "Envirotech relative humidity unstable"
 /begin REF_CHARACTERISTIC FCdc4_envtech_RH_uns FCdtc_envtech_RH_uns FCfmi_envtech_RH_uns FCftb_envtech_RH_uns FCspn_envtech_RH_uns FPfl_envtech_RH_uns FPfu_envtech_RH_uns FPnd_envtech_RH_uns FPsvr_envtech_RH_uns FPsw_ext1_envtech_RH_uns FPsw_envtech_RH_uns /end REF_CHARACTERISTIC
/end GROUP
/begin GROUP ERCV_speed_OOR_EC_Fault "Electronic Rotating Crankcase Ventilation (ERCV) motor speed out-of-range"
 /begin REF_CHARACTERISTIC FCdc4_ERCV_speed_OOR FCdtc_ERCV_speed_OOR FCfmi_ERCV_speed_OOR FCftb_ERCV_speed_OOR FCspn_ERCV_speed_OOR FPfl_ERCV_speed_OOR FPfu_ERCV_speed_OOR FPnd_ERCV_speed_OOR FPsvr_ERCV_speed_OOR FPsw_ext1_ERCV_speed_OOR FPsw_ERCV_speed_OOR /end REF_CHARACTERISTIC
/end GROUP
/begin GROUP ERWT1_HiExp1_EC_Fault "ERWT1/2 higher than expected level 1"
 /begin REF_CHARACTERISTIC FCdc4_ERWT1_HiExp1 FCdtc_ERWT1_HiExp1 FCfmi_ERWT1_HiExp1 FCftb_ERWT1_HiExp1 FCspn_ERWT1_HiExp1 FPfl_ERWT1_HiExp1 FPfu_ERWT1_HiExp1 FPnd_ERWT1_HiExp1 FPsvr_ERWT1_HiExp1 FPsw_ext1_ERWT1_HiExp1 FPsw_ERWT1_HiExp1 /end REF_CHARACTERISTIC
/end GROUP
/begin GROUP ERWT1_HiExp2_EC_Fault "ERWT1/2 higher than expected level 2"
 /begin REF_CHARACTERISTIC FCdc4_ERWT1_HiExp2 FCdtc_ERWT1_HiExp2 FCfmi_ERWT1_HiExp2 FCftb_ERWT1_HiExp2 FCspn_ERWT1_HiExp2 FPfl_ERWT1_HiExp2 FPfu_ERWT1_HiExp2 FPnd_ERWT1_HiExp2 FPsvr_ERWT1_HiExp2 FPsw_ext1_ERWT1_HiExp2 FPsw_ERWT1_HiExp2 /end REF_CHARACTERISTIC
/end GROUP
/begin GROUP ERWT1_maxv_EC_Fault "ERWT1/2 high voltage"
 /begin REF_CHARACTERISTIC FCdc4_ERWT1_maxv FCdtc_ERWT1_maxv FCfmi_ERWT1_maxv FCftb_ERWT1_maxv FCspn_ERWT1_maxv FPfl_ERWT1_maxv FPfu_ERWT1_maxv FPnd_ERWT1_maxv FPsvr_ERWT1_maxv FPsw_ext1_ERWT1_maxv FPsw_ERWT1_maxv /end REF_CHARACTERISTIC
/end GROUP
/begin GROUP ERWT1_minv_EC_Fault "ERWT1/2 low voltage"
 /begin REF_CHARACTERISTIC FCdc4_ERWT1_minv FCdtc_ERWT1_minv FCfmi_ERWT1_minv FCftb_ERWT1_minv FCspn_ERWT1_minv FPfl_ERWT1_minv FPfu_ERWT1_minv FPnd_ERWT1_minv FPsvr_ERWT1_minv FPsw_ext1_ERWT1_minv FPsw_ERWT1_minv /end REF_CHARACTERISTIC
/end GROUP
/begin GROUP F1OOR_F2IVS_EC_Fault "FPP1 invalid voltage and FPP2"
 /begin REF_CHARACTERISTIC FCdc4_F1OOR_F2IVS FCdtc_F1OOR_F2IVS FCfmi_F1OOR_F2IVS FCftb_F1OOR_F2IVS FCspn_F1OOR_F2IVS FPfl_F1OOR_F2IVS FPfu_F1OOR_F2IVS FPnd_F1OOR_F2IVS FPsvr_F1OOR_F2IVS FPsw_ext1_F1OOR_F2IVS FPsw_F1OOR_F2IVS /end REF_CHARACTERISTIC
/end GROUP
/begin GROUP F2OOR_F1IVS_EC_Fault "FPP2 invalid voltage and FPP1"
 /begin REF_CHARACTERISTIC FCdc4_F2OOR_F1IVS FCdtc_F2OOR_F1IVS FCfmi_F2OOR_F1IVS FCftb_F2OOR_F1IVS FCspn_F2OOR_F1IVS FPfl_F2OOR_F1IVS FPfu_F2OOR_F1IVS FPnd_F2OOR_F1IVS FPsvr_F2OOR_F1IVS FPsw_ext1_F2OOR_F1IVS FPsw_F2OOR_F1IVS /end REF_CHARACTERISTIC
/end GROUP
/begin GROUP FCoolH2O_lo_EC_Fault "Cooling water flow"
 /begin REF_CHARACTERISTIC FCdc4_FCoolH2O_lo FCdtc_FCoolH2O_lo FCfmi_FCoolH2O_lo FCftb_FCoolH2O_lo FCspn_FCoolH2O_lo FPfl_FCoolH2O_lo FPfu_FCoolH2O_lo FPnd_FCoolH2O_lo FPsvr_FCoolH2O_lo FPsw_ext1_FCoolH2O_lo FPsw_FCoolH2O_lo /end REF_CHARACTERISTIC
/end GROUP
/begin GROUP FIMP_pct_high_EC_Fault "Fuel impurity level high"
 /begin REF_CHARACTERISTIC FCdc4_FIMP_pct_high FCdtc_FIMP_pct_high FCfmi_FIMP_pct_high FCftb_FIMP_pct_high FCspn_FIMP_pct_high FPfl_FIMP_pct_high FPfu_FIMP_pct_high FPnd_FIMP_pct_high FPsvr_FIMP_pct_high FPsw_ext1_FIMP_pct_high FPsw_FIMP_pct_high /end REF_CHARACTERISTIC
/end GROUP
/begin GROUP FIP_LoExp_EC_Fault "FIP lower than expected"
 /begin REF_CHARACTERISTIC FCdc4_FIP_LoExp FCdtc_FIP_LoExp FCfmi_FIP_LoExp FCftb_FIP_LoExp FCspn_FIP_LoExp FPfl_FIP_LoExp FPfu_FIP_LoExp FPnd_FIP_LoExp FPsvr_FIP_LoExp FPsw_ext1_FIP_LoExp FPsw_FIP_LoExp /end REF_CHARACTERISTIC
/end GROUP
/begin GROUP flash_fail_EC_Fault "Flash checksum invalid"
 /begin REF_CHARACTERISTIC FCdc4_flash_fail FCdtc_flash_fail FCfmi_flash_fail FCftb_flash_fail FCspn_flash_fail FPfl_flash_fail FPfu_flash_fail FPnd_flash_fail FPsvr_flash_fail FPsw_ext1_flash_fail FPsw_flash_fail /end REF_CHARACTERISTIC
/end GROUP
/begin GROUP FP_high_EC_Fault "Primary fuel pressure high"
 /begin REF_CHARACTERISTIC FCdc4_FP_high FCdtc_FP_high FCfmi_FP_high FCftb_FP_high FCspn_FP_high FPfl_FP_high FPfu_FP_high FPnd_FP_high FPsvr_FP_high FPsw_ext1_FP_high FPsw_FP_high /end REF_CHARACTERISTIC
/end GROUP
/begin GROUP FP_low_EC_Fault "Primary fuel pressure low"
 /begin REF_CHARACTERISTIC FCdc4_FP_low FCdtc_FP_low FCfmi_FP_low FCftb_FP_low FCspn_FP_low FPfl_FP_low FPfu_FP_low FPnd_FP_low FPsvr_FP_low FPsw_ext1_FP_low FPsw_FP_low /end REF_CHARACTERISTIC
/end GROUP
/begin GROUP FP_maxv_EC_Fault "Primary FP high voltage"
 /begin REF_CHARACTERISTIC FCdc4_FP_maxv FCdtc_FP_maxv FCfmi_FP_maxv FCftb_FP_maxv FCspn_FP_maxv FPfl_FP_maxv FPfu_FP_maxv FPnd_FP_maxv FPsvr_FP_maxv FPsw_ext1_FP_maxv FPsw_FP_maxv /end REF_CHARACTERISTIC
/end GROUP
/begin GROUP FP_minv_EC_Fault "Primary FP low voltage"
 /begin REF_CHARACTERISTIC FCdc4_FP_minv FCdtc_FP_minv FCfmi_FP_minv FCftb_FP_minv FCspn_FP_minv FPfl_FP_minv FPfu_FP_minv FPnd_FP_minv FPsvr_FP_minv FPsw_ext1_FP_minv FPsw_FP_minv /end REF_CHARACTERISTIC
/end GROUP
/begin GROUP FP2_high_EC_Fault "Secondary fuel pressure high"
 /begin REF_CHARACTERISTIC FCdc4_FP2_high FCdtc_FP2_high FCfmi_FP2_high FCftb_FP2_high FCspn_FP2_high FPfl_FP2_high FPfu_FP2_high FPnd_FP2_high FPsvr_FP2_high FPsw_ext1_FP2_high FPsw_FP2_high /end REF_CHARACTERISTIC
/end GROUP
/begin GROUP FP2_low_EC_Fault "Secondary fuel pressure low"
 /begin REF_CHARACTERISTIC FCdc4_FP2_low FCdtc_FP2_low FCfmi_FP2_low FCftb_FP2_low FCspn_FP2_low FPfl_FP2_low FPfu_FP2_low FPnd_FP2_low FPsvr_FP2_low FPsw_ext1_FP2_low FPsw_FP2_low /end REF_CHARACTERISTIC
/end GROUP
/begin GROUP FP2_maxv_EC_Fault "Secondary FP high voltage"
 /begin REF_CHARACTERISTIC FCdc4_FP2_maxv FCdtc_FP2_maxv FCfmi_FP2_maxv FCftb_FP2_maxv FCspn_FP2_maxv FPfl_FP2_maxv FPfu_FP2_maxv FPnd_FP2_maxv FPsvr_FP2_maxv FPsw_ext1_FP2_maxv FPsw_FP2_maxv /end REF_CHARACTERISTIC
/end GROUP
/begin GROUP FP2_minv_EC_Fault "Secondary FP low voltage"
 /begin REF_CHARACTERISTIC FCdc4_FP2_minv FCdtc_FP2_minv FCfmi_FP2_minv FCftb_FP2_minv FCspn_FP2_minv FPfl_FP2_minv FPfu_FP2_minv FPnd_FP2_minv FPsvr_FP2_minv FPsw_ext1_FP2_minv FPsw_FP2_minv /end REF_CHARACTERISTIC
/end GROUP
/begin GROUP FPD_off_hi_EC_Fault "Fuel pump motor shorted to power"
 /begin REF_CHARACTERISTIC FCdc4_FPD_off_hi FCdtc_FPD_off_hi FCfmi_FPD_off_hi FCftb_FPD_off_hi FCspn_FPD_off_hi FPfl_FPD_off_hi FPfu_FPD_off_hi FPnd_FPD_off_hi FPsvr_FPD_off_hi FPsw_ext1_FPD_off_hi FPsw_FPD_off_hi /end REF_CHARACTERISTIC
/end GROUP
/begin GROUP FPD_on_lo_EC_Fault "Fuel pump motor loop open or shorted to ground"
 /begin REF_CHARACTERISTIC FCdc4_FPD_on_lo FCdtc_FPD_on_lo FCfmi_FPD_on_lo FCftb_FPD_on_lo FCspn_FPD_on_lo FPfl_FPD_on_lo FPfu_FPD_on_lo FPnd_FPD_on_lo FPsvr_FPD_on_lo FPsw_ext1_FPD_on_lo FPsw_FPD_on_lo /end REF_CHARACTERISTIC
/end GROUP
/begin GROUP FPlo_derate_actv_EC_Fault "Low fuel pressure - forced limited power"
 /begin REF_CHARACTERISTIC FCdc4_FPlo_derate_actv FCdtc_FPlo_derate_actv FCfmi_FPlo_derate_actv FCftb_FPlo_derate_actv FCspn_FPlo_derate_actv FPfl_FPlo_derate_actv FPfu_FPlo_derate_actv FPnd_FPlo_derate_actv FPsvr_FPlo_derate_actv FPsw_ext1_FPlo_derate_actv FPsw_FPlo_derate_actv /end REF_CHARACTERISTIC
/end GROUP
/begin GROUP FPlo_derate_excess_EC_Fault "Low fuel pressure - forced limited power excessive duration"
 /begin REF_CHARACTERISTIC FCdc4_FPlo_derate_excess FCdtc_FPlo_derate_excess FCfmi_FPlo_derate_excess FCftb_FPlo_derate_excess FCspn_FPlo_derate_excess FPfl_FPlo_derate_excess FPfu_FPlo_derate_excess FPnd_FPlo_derate_excess FPsvr_FPlo_derate_excess FPsw_ext1_FPlo_derate_excess FPsw_FPlo_derate_excess /end REF_CHARACTERISTIC
/end GROUP
/begin GROUP FPP_NeutLock_fail_EC_Fault "FPP indicates marine handle neutral lock failed"
 /begin REF_CHARACTERISTIC FCdc4_FPP_NeutLock_fail FCdtc_FPP_NeutLock_fail FCfmi_FPP_NeutLock_fail FCftb_FPP_NeutLock_fail FCspn_FPP_NeutLock_fail FPfl_FPP_NeutLock_fail FPfu_FPP_NeutLock_fail FPnd_FPP_NeutLock_fail FPsvr_FPP_NeutLock_fail FPsw_ext1_FPP_NeutLock_fail FPsw_FPP_NeutLock_fail /end REF_CHARACTERISTIC
/end GROUP
/begin GROUP FPP1_IVS_max_EC_Fault "FPP1 higher than IVS limit"
 /begin REF_CHARACTERISTIC FCdc4_FPP1_IVS_max FCdtc_FPP1_IVS_max FCfmi_FPP1_IVS_max FCftb_FPP1_IVS_max FCspn_FPP1_IVS_max FPfl_FPP1_IVS_max FPfu_FPP1_IVS_max FPnd_FPP1_IVS_max FPsvr_FPP1_IVS_max FPsw_ext1_FPP1_IVS_max FPsw_FPP1_IVS_max /end REF_CHARACTERISTIC
/end GROUP
/begin GROUP FPP1_IVS_min_EC_Fault "FPP1 lower than IVS limit"
 /begin REF_CHARACTERISTIC FCdc4_FPP1_IVS_min FCdtc_FPP1_IVS_min FCfmi_FPP1_IVS_min FCftb_FPP1_IVS_min FCspn_FPP1_IVS_min FPfl_FPP1_IVS_min FPfu_FPP1_IVS_min FPnd_FPP1_IVS_min FPsvr_FPP1_IVS_min FPsw_ext1_FPP1_IVS_min FPsw_FPP1_IVS_min /end REF_CHARACTERISTIC
/end GROUP
/begin GROUP FPP1_max_EC_Fault "FPP1 high voltage"
 /begin REF_CHARACTERISTIC FCdc4_FPP1_max FCdtc_FPP1_max FCfmi_FPP1_max FCftb_FPP1_max FCspn_FPP1_max FPfl_FPP1_max FPfu_FPP1_max FPnd_FPP1_max FPsvr_FPP1_max FPsw_ext1_FPP1_max FPsw_FPP1_max /end REF_CHARACTERISTIC
/end GROUP
/begin GROUP FPP1_min_EC_Fault "FPP1 low voltage"
 /begin REF_CHARACTERISTIC FCdc4_FPP1_min FCdtc_FPP1_min FCfmi_FPP1_min FCftb_FPP1_min FCspn_FPP1_min FPfl_FPP1_min FPfu_FPP1_min FPnd_FPP1_min FPsvr_FPP1_min FPsw_ext1_FPP1_min FPsw_FPP1_min /end REF_CHARACTERISTIC
/end GROUP
/begin GROUP FPP12_IVS_max_EC_Fault "IVS stuck at-idle, FPP1/2 match"
 /begin REF_CHARACTERISTIC FCdc4_FPP12_IVS_max FCdtc_FPP12_IVS_max FCfmi_FPP12_IVS_max FCftb_FPP12_IVS_max FCspn_FPP12_IVS_max FPfl_FPP12_IVS_max FPfu_FPP12_IVS_max FPnd_FPP12_IVS_max FPsvr_FPP12_IVS_max FPsw_ext1_FPP12_IVS_max FPsw_FPP12_IVS_max /end REF_CHARACTERISTIC
/end GROUP
/begin GROUP FPP12_IVS_min_EC_Fault "IVS stuck off-idle, FPP1/2 match"
 /begin REF_CHARACTERISTIC FCdc4_FPP12_IVS_min FCdtc_FPP12_IVS_min FCfmi_FPP12_IVS_min FCftb_FPP12_IVS_min FCspn_FPP12_IVS_min FPfl_FPP12_IVS_min FPfu_FPP12_IVS_min FPnd_FPP12_IVS_min FPsvr_FPP12_IVS_min FPsw_ext1_FPP12_IVS_min FPsw_FPP12_IVS_min /end REF_CHARACTERISTIC
/end GROUP
/begin GROUP FPP12_OOR_EC_Fault "FPP1/2 simultaneous voltages"
 /begin REF_CHARACTERISTIC FCdc4_FPP12_OOR FCdtc_FPP12_OOR FCfmi_FPP12_OOR FCftb_FPP12_OOR FCspn_FPP12_OOR FPfl_FPP12_OOR FPfu_FPP12_OOR FPnd_FPP12_OOR FPsvr_FPP12_OOR FPsw_ext1_FPP12_OOR FPsw_FPP12_OOR /end REF_CHARACTERISTIC
/end GROUP
/begin GROUP FPP12IVS_TSC1_EC_Fault "FPP fault and J1939 TSC1 message receipt lost"
 /begin REF_CHARACTERISTIC FCdc4_FPP12IVS_TSC1 FCdtc_FPP12IVS_TSC1 FCfmi_FPP12IVS_TSC1 FCftb_FPP12IVS_TSC1 FCspn_FPP12IVS_TSC1 FPfl_FPP12IVS_TSC1 FPfu_FPP12IVS_TSC1 FPnd_FPP12IVS_TSC1 FPsvr_FPP12IVS_TSC1 FPsw_ext1_FPP12IVS_TSC1 FPsw_FPP12IVS_TSC1 /end REF_CHARACTERISTIC
/end GROUP
/begin GROUP FPP12MM_IVSMM_EC_Fault "FPP1/2 do not match each other"
 /begin REF_CHARACTERISTIC FCdc4_FPP12MM_IVSMM FCdtc_FPP12MM_IVSMM FCfmi_FPP12MM_IVSMM FCftb_FPP12MM_IVSMM FCspn_FPP12MM_IVSMM FPfl_FPP12MM_IVSMM FPfu_FPP12MM_IVSMM FPnd_FPP12MM_IVSMM FPsvr_FPP12MM_IVSMM FPsw_ext1_FPP12MM_IVSMM FPsw_FPP12MM_IVSMM /end REF_CHARACTERISTIC
/end GROUP
/begin GROUP FPP12pct_hi_EC_Fault "FPP1 higher than FPP2"
 /begin REF_CHARACTERISTIC FCdc4_FPP12pct_hi FCdtc_FPP12pct_hi FCfmi_FPP12pct_hi FCftb_FPP12pct_hi FCspn_FPP12pct_hi FPfl_FPP12pct_hi FPfu_FPP12pct_hi FPnd_FPP12pct_hi FPsvr_FPP12pct_hi FPsw_ext1_FPP12pct_hi FPsw_FPP12pct_hi /end REF_CHARACTERISTIC
/end GROUP
/begin GROUP FPP12pct_lo_EC_Fault "FPP1 lower than FPP2"
 /begin REF_CHARACTERISTIC FCdc4_FPP12pct_lo FCdtc_FPP12pct_lo FCfmi_FPP12pct_lo FCftb_FPP12pct_lo FCspn_FPP12pct_lo FPfl_FPP12pct_lo FPfu_FPP12pct_lo FPnd_FPP12pct_lo FPsvr_FPP12pct_lo FPsw_ext1_FPP12pct_lo FPsw_FPP12pct_lo /end REF_CHARACTERISTIC
/end GROUP
/end MODULE
/end PROJECT
