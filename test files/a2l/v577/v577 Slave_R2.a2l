ASAP2_VERSION 1 61
/begin PROJECT Econtrols_4G "4G Test"
/begin HEADER "4G A2L Configuration" PROJECT_NO EControls4G /* config for version control */ VERSION "$Revision: 82130 $:" /* config for version control */ /end HEADER
/begin MODULE EControls_4G_SH2A "EControls 4G"
/begin MOD_COMMON "" DEPOSIT ABSOLUTE BYTE_ORDER MSB_FIRST /end MOD_COMMON
/* Define the Record Layouts */
/begin RECORD_LAYOUT ECIPP_ALIGNMENT_UBYTE FNC_VALUES 1 UBYTE COLUMN_DIR DIRECT /end RECORD_LAYOUT
/begin RECORD_LAYOUT ECIPP_ALIGNMENT_UWORD FNC_VALUES 1 UWORD COLUMN_DIR DIRECT /end RECORD_LAYOUT
/begin RECORD_LAYOUT ECIPP_ALIGNMENT_SWORD FNC_VALUES 1 SWORD COLUMN_DIR DIRECT /end RECORD_LAYOUT
/begin RECORD_LAYOUT ECIPP_Lookup_SWORD AXIS_PTS_X 1 SWORD INDEX_INCR DIRECT /end RECORD_LAYOUT
/begin RECORD_LAYOUT ECIPP_ALIGNMENT_SLONG FNC_VALUES 1 SLONG COLUMN_DIR DIRECT /end RECORD_LAYOUT
/begin MEASUREMENT VE "VE final" UWORD Compu_VE 0 0 0 199.996948242188 ECU_ADDRESS 0x010000A0 /end MEASUREMENT
/begin COMPU_METHOD Compu_VE " " RAT_FUNC "%.1" "%" COEFFS 0 327.68 0 0 0 1 /end COMPU_METHOD
/begin MEASUREMENT gov_MAP_d "Governor MAP_d" UWORD Compu_gov_MAP_d 0 0 0 255.99609375 ECU_ADDRESS 0x010002C0 /end MEASUREMENT
/begin COMPU_METHOD Compu_gov_MAP_d " " RAT_FUNC "%.2" "psia" COEFFS 0 256 0 0 0 1 /end COMPU_METHOD
/begin MEASUREMENT gov_MAPdt_d "Governor MAPdt_d" SWORD Compu_gov_MAPdt_d 0 0 -4000 3999.8779296875 ECU_ADDRESS 0x010002C8 /end MEASUREMENT
/begin COMPU_METHOD Compu_gov_MAPdt_d " " RAT_FUNC "%.1" "psi/sec" COEFFS 0 8.192 0 0 0 1 /end COMPU_METHOD
/begin MEASUREMENT TPS_min_gov_pct "TPS_min_gov_pct" UWORD Compu_TPS_min_gov_pct 0 0 0 99.9984741210938 ECU_ADDRESS 0x010002D0 /end MEASUREMENT
/begin COMPU_METHOD Compu_TPS_min_gov_pct " " RAT_FUNC "%.1" "%" COEFFS 0 655.36 0 0 0 1 /end COMPU_METHOD
/begin MEASUREMENT TPS_max_gov_pct "TPS_max_gov_pct" UWORD Compu_TPS_max_gov_pct 0 0 0 99.9984741210938 ECU_ADDRESS 0x010002D8 /end MEASUREMENT
/begin COMPU_METHOD Compu_TPS_max_gov_pct " " RAT_FUNC "%.1" "%" COEFFS 0 655.36 0 0 0 1 /end COMPU_METHOD
/begin MEASUREMENT TPS_GovN_pct "TPS_GovN_pct" UWORD Compu_TPS_GovN_pct 0 0 0 99.9984741210938 ECU_ADDRESS 0x01000310 /end MEASUREMENT
/begin COMPU_METHOD Compu_TPS_GovN_pct " " RAT_FUNC "%.1" "%" COEFFS 0 655.36 0 0 0 1 /end COMPU_METHOD
/begin MEASUREMENT AUX_PD1_raw "AUX_PD1_raw" UWORD Compu_AUX_PD1_raw 0 0 0 5.00114468864469 ECU_ADDRESS 0x010003C0 /end MEASUREMENT
/begin COMPU_METHOD Compu_AUX_PD1_raw " " RAT_FUNC "%.3" "volts" COEFFS 0 13104 0 0 0 1 /end COMPU_METHOD
/begin MEASUREMENT AUX_PU1_raw "AUX_PU1_raw" UWORD Compu_AUX_PU1_raw 0 0 0 5.00114468864469 ECU_ADDRESS 0x010003C8 /end MEASUREMENT
/begin COMPU_METHOD Compu_AUX_PU1_raw " " RAT_FUNC "%.3" "volts" COEFFS 0 13104 0 0 0 1 /end COMPU_METHOD
/begin MEASUREMENT spkgv_mod "Spark governor adv offset" SWORD Compu_spkgv_mod 0 0 -2048 2047.9375 ECU_ADDRESS 0x010003D0 /end MEASUREMENT
/begin COMPU_METHOD Compu_spkgv_mod " " RAT_FUNC "%.1" "CAD BTDC" COEFFS 0 16 0 0 0 1 /end COMPU_METHOD
/begin MEASUREMENT gov_gain_man "RPM gain selection{gov_gain_man&0xff=0x00:Lookup}{gov_gain_man&0xff=0x01:Fixed}" UBYTE gov_gain_man_COMPU_VTAB 0 0 0 255 ECU_ADDRESS 0x01000850 BIT_MASK 0xff /end MEASUREMENT
/begin COMPU_METHOD gov_gain_man_COMPU_VTAB "Verbal Table" TAB_VERB "%.0" "list" COMPU_TAB_REF gov_gain_man_COMPU_VTAB_REF /end COMPU_METHOD
/begin COMPU_VTAB gov_gain_man_COMPU_VTAB_REF "Verbal Table" TAB_VERB 2 0x00 "Lookup" 0x01 "Fixed" DEFAULT_VALUE "UNKNOWN" /end COMPU_VTAB
/begin MEASUREMENT MAP_noload "MAP_noload" UWORD Compu_MAP_noload 0 0 0 255.99609375 ECU_ADDRESS 0x010009A0 /end MEASUREMENT
/begin COMPU_METHOD Compu_MAP_noload " " RAT_FUNC "%.2" "psia" COEFFS 0 256 0 0 0 1 /end COMPU_METHOD
/begin MEASUREMENT MAP_fullload "MAP_fullload" UWORD Compu_MAP_fullload 0 0 0 255.99609375 ECU_ADDRESS 0x010009A8 /end MEASUREMENT
/begin COMPU_METHOD Compu_MAP_fullload " " RAT_FUNC "%.2" "psia" COEFFS 0 256 0 0 0 1 /end COMPU_METHOD
/begin CHARACTERISTIC LG_gov_ena "Min governor control{LG_gov_ena&0xff=0x00:Disabled}{LG_gov_ena&0xff=0x01:Isochronous}{LG_gov_ena&0xff=0x02:Droop}" VALUE 0x00148EB0 /* @ECU_Address@LG_gov_ena@0x010009E8@ */ ECIPP_ALIGNMENT_UBYTE 255 LG_gov_ena_COMPU_VTAB 0 255 BIT_MASK 0xff /end CHARACTERISTIC
/begin COMPU_METHOD LG_gov_ena_COMPU_VTAB "Verbal Table" TAB_VERB "%.0" "list" COMPU_TAB_REF LG_gov_ena_COMPU_VTAB_REF /end COMPU_METHOD
/begin COMPU_VTAB LG_gov_ena_COMPU_VTAB_REF "Verbal Table" TAB_VERB 3 0x00 "Disabled" 0x01 "Isochronous" 0x02 "Droop" DEFAULT_VALUE "UNKNOWN" /end COMPU_VTAB
/begin CHARACTERISTIC HG_gov_ena "Max governor control{HG_gov_ena&0xff=0x00:Disabled}{HG_gov_ena&0xff=0x01:Isochronous}{HG_gov_ena&0xff=0x02:Droop}" VALUE 0x00148E90 /* @ECU_Address@HG_gov_ena@0x010009F0@ */ ECIPP_ALIGNMENT_UBYTE 255 HG_gov_ena_COMPU_VTAB 0 255 BIT_MASK 0xff /end CHARACTERISTIC
/begin COMPU_METHOD HG_gov_ena_COMPU_VTAB "Verbal Table" TAB_VERB "%.0" "list" COMPU_TAB_REF HG_gov_ena_COMPU_VTAB_REF /end COMPU_METHOD
/begin COMPU_VTAB HG_gov_ena_COMPU_VTAB_REF "Verbal Table" TAB_VERB 3 0x00 "Disabled" 0x01 "Isochronous" 0x02 "Droop" DEFAULT_VALUE "UNKNOWN" /end COMPU_VTAB
/begin MEASUREMENT Kp_gov "Kp_rpm gain" SWORD Compu_Kp_gov 0 0 -3125 3124.90463256836 ECU_ADDRESS 0x010009F8 /end MEASUREMENT
/begin COMPU_METHOD Compu_Kp_gov " " RAT_FUNC "%.1" "% / krpm" COEFFS 0 10.48576 0 0 0 1 /end COMPU_METHOD
/begin MEASUREMENT Kd_gov "Kd_rpm gain" SWORD Compu_Kd_gov 0 0 -1600 1599.951171875 ECU_ADDRESS 0x01000A00 /end MEASUREMENT
/begin COMPU_METHOD Compu_Kd_gov " " RAT_FUNC "%.2" "% / (krpm/sec)" COEFFS 0 20.48 0 0 0 1 /end COMPU_METHOD
/begin CHARACTERISTIC mingv_auth_min "Min governor authority low" VALUE 0x00148EC0 /* @ECU_Address@mingv_auth_min@0x01000A08@ */ ECIPP_ALIGNMENT_UWORD 100 Compu_mingv_auth_min 0 99.9984741210938 /end CHARACTERISTIC
/begin COMPU_METHOD Compu_mingv_auth_min " " RAT_FUNC "%.1" "%" COEFFS 0 655.36 0 0 0 1 /end COMPU_METHOD
/begin CHARACTERISTIC mingv_auth_max "Min governor authority high" VALUE 0x00148EC2 /* @ECU_Address@mingv_auth_max@0x01000A10@ */ ECIPP_ALIGNMENT_UWORD 100 Compu_mingv_auth_max 0 99.9984741210938 /end CHARACTERISTIC
/begin COMPU_METHOD Compu_mingv_auth_max " " RAT_FUNC "%.1" "%" COEFFS 0 655.36 0 0 0 1 /end COMPU_METHOD
/begin MEASUREMENT KMAPdt_gov "dMAP/dt gain" SWORD Compu_KMAPdt_gov 0 0 -1000 999.969482421875 ECU_ADDRESS 0x01000A18 /end MEASUREMENT
/begin COMPU_METHOD Compu_KMAPdt_gov " " RAT_FUNC "%.1" "1 / sec" COEFFS 0 32.768 0 0 0 1 /end COMPU_METHOD
/begin MEASUREMENT Ki_gov "Ki_rpm gain" SWORD Compu_Ki_gov 0 0 -12207.03125 12206.6587209702 ECU_ADDRESS 0x01000A20 /end MEASUREMENT
/begin COMPU_METHOD Compu_Ki_gov " " RAT_FUNC "%.1" "% / krpm / sec" COEFFS 0 2.68435456 0 0 0 1 /end COMPU_METHOD
/begin MEASUREMENT gov_I_frz "Integrator freeze" SWORD Compu_gov_I_frz 0 0 -64000 63998.046875 ECU_ADDRESS 0x01000A28 /end MEASUREMENT
/begin COMPU_METHOD Compu_gov_I_frz " " RAT_FUNC "%.0" "rpm / sec" COEFFS 0 0.512 0 0 0 1 /end COMPU_METHOD
/begin CHARACTERISTIC strt_min_idle "Single-point start init speed" VALUE 0x00147ba6 /* @ECU_Address@strt_min_idle@0x01000A90@ */ ECIPP_ALIGNMENT_UWORD 65535 Compu_strt_min_idle 0 65535 /end CHARACTERISTIC
/begin COMPU_METHOD Compu_strt_min_idle " " RAT_FUNC "%.0" "rpm" COEFFS 0 1 0 0 0 1 /end COMPU_METHOD
/begin CHARACTERISTIC strt_min_idle_dcy "Single-point start init speed decay" VALUE 0x00147ba8 /* @ECU_Address@strt_min_idle_dcy@0x01000A98@ */ ECIPP_ALIGNMENT_UWORD 1000 Compu_strt_min_idle_dcy 0 999.984741210938 /end CHARACTERISTIC
/begin COMPU_METHOD Compu_strt_min_idle_dcy " " RAT_FUNC "%.0" "rpm / sec" COEFFS 0 65.536 0 0 0 1 /end COMPU_METHOD
/begin CHARACTERISTIC strt_min_FPP "Start min FPP" VALUE 0x00147ba4 /* @ECU_Address@strt_min_FPP@0x01000AA0@ */ ECIPP_ALIGNMENT_UWORD 100 Compu_strt_min_FPP 0 99.9984741210938 /end CHARACTERISTIC
/begin COMPU_METHOD Compu_strt_min_FPP " " RAT_FUNC "%.1" "%" COEFFS 0 655.36 0 0 0 1 /end COMPU_METHOD
/begin MEASUREMENT rpmdtdz_Kd "Kd_rpm dead-zone" SWORD Compu_rpmdtdz_Kd 0 0 -64000 63998.046875 ECU_ADDRESS 0x01000BE8 /end MEASUREMENT
/begin COMPU_METHOD Compu_rpmdtdz_Kd " " RAT_FUNC "%.0" "rpm/sec" COEFFS 0 0.512 0 0 0 1 /end COMPU_METHOD
/begin MEASUREMENT rpmdz_Kp "Kp_rpm dead-zone" SWORD Compu_rpmdz_Kp 0 0 -32768 32767 ECU_ADDRESS 0x01000BF8 /end MEASUREMENT
/begin COMPU_METHOD Compu_rpmdz_Kp " " RAT_FUNC "%.0" "rpm" COEFFS 0 1 0 0 0 1 /end COMPU_METHOD
/begin CHARACTERISTIC minigv_appdlt "Min isoc approach delta" VALUE 0x00148EC8 /* @ECU_Address@minigv_appdlt@0x01000C00@ */ ECIPP_ALIGNMENT_UWORD 65535 Compu_minigv_appdlt 0 65535 /end CHARACTERISTIC
/begin COMPU_METHOD Compu_minigv_appdlt " " RAT_FUNC "%.0" "rpm" COEFFS 0 1 0 0 0 1 /end COMPU_METHOD
/begin CHARACTERISTIC maxigv_appdlt "Max igov approach delta" VALUE 0x00148EA8 /* @ECU_Address@maxigv_appdlt@0x01000C08@ */ ECIPP_ALIGNMENT_UWORD 65535 Compu_maxigv_appdlt 0 65535 /end CHARACTERISTIC
/begin COMPU_METHOD Compu_maxigv_appdlt " " RAT_FUNC "%.0" "rpm" COEFFS 0 1 0 0 0 1 /end COMPU_METHOD
/begin CHARACTERISTIC minigv_apprdt "Min isoc approach rpmdt" VALUE 0x00148ECA /* @ECU_Address@minigv_apprdt@0x01000C10@ */ ECIPP_ALIGNMENT_SWORD 63998 Compu_minigv_apprdt -64000 63998.046875 /end CHARACTERISTIC
/begin COMPU_METHOD Compu_minigv_apprdt " " RAT_FUNC "%.0" "rpm / sec" COEFFS 0 0.512 0 0 0 1 /end COMPU_METHOD
/begin CHARACTERISTIC maxigv_apprdt "Max igov approach rpmdt" VALUE 0x00148EAA /* @ECU_Address@maxigv_apprdt@0x01000C18@ */ ECIPP_ALIGNMENT_SWORD 63998 Compu_maxigv_apprdt -64000 63998.046875 /end CHARACTERISTIC
/begin COMPU_METHOD Compu_maxigv_apprdt " " RAT_FUNC "%.0" "rpm / sec" COEFFS 0 0.512 0 0 0 1 /end COMPU_METHOD
/begin CHARACTERISTIC minigv_Iinit "Min isoc approach I init" VALUE 0x00148EC6 /* @ECU_Address@minigv_Iinit@0x01000C20@ */ ECIPP_ALIGNMENT_UWORD 3200 Compu_minigv_Iinit 0 3199.951171875 /end CHARACTERISTIC
/begin COMPU_METHOD Compu_minigv_Iinit " " RAT_FUNC "%.1" "% / (krpm/sec)" COEFFS 0 20.48 0 0 0 1 /end COMPU_METHOD
/begin CHARACTERISTIC maxigv_Iinit "Max isoc approach I init" VALUE 0x00148EA6 /* @ECU_Address@maxigv_Iinit@0x01000C28@ */ ECIPP_ALIGNMENT_UWORD 3200 Compu_maxigv_Iinit 0 3199.951171875 /end CHARACTERISTIC
/begin COMPU_METHOD Compu_maxigv_Iinit " " RAT_FUNC "%.1" "% / (krpm/sec)" COEFFS 0 20.48 0 0 0 1 /end COMPU_METHOD
/begin MEASUREMENT rpmdz_Ki "Ki_rpm dead-zone" SWORD Compu_rpmdz_Ki 0 0 -32768 32767 ECU_ADDRESS 0x01000CB0 /end MEASUREMENT
/begin COMPU_METHOD Compu_rpmdz_Ki " " RAT_FUNC "%.0" "rpm" COEFFS 0 1 0 0 0 1 /end COMPU_METHOD
/begin CHARACTERISTIC Gov1_ena "Gov1 control{Gov1_ena&0xff=0x00:Disabled}{Gov1_ena&0xff=0x01:Isochronous}{Gov1_ena&0xff=0x02:Droop}" VALUE 0x00148E0C /* @ECU_Address@Gov1_ena@0x01000CB8@ */ ECIPP_ALIGNMENT_UBYTE 255 Gov1_ena_COMPU_VTAB 0 255 BIT_MASK 0xff /end CHARACTERISTIC
/begin COMPU_METHOD Gov1_ena_COMPU_VTAB "Verbal Table" TAB_VERB "%.0" "list" COMPU_TAB_REF Gov1_ena_COMPU_VTAB_REF /end COMPU_METHOD
/begin COMPU_VTAB Gov1_ena_COMPU_VTAB_REF "Verbal Table" TAB_VERB 3 0x00 "Disabled" 0x01 "Isochronous" 0x02 "Droop" DEFAULT_VALUE "UNKNOWN" /end COMPU_VTAB
/begin CHARACTERISTIC Gov2_ena "Gov2 control{Gov2_ena&0xff=0x00:Disabled}{Gov2_ena&0xff=0x01:Isochronous}{Gov2_ena&0xff=0x02:Droop}" VALUE 0x00148E38 /* @ECU_Address@Gov2_ena@0x01000CC0@ */ ECIPP_ALIGNMENT_UBYTE 255 Gov2_ena_COMPU_VTAB 0 255 BIT_MASK 0xff /end CHARACTERISTIC
/begin COMPU_METHOD Gov2_ena_COMPU_VTAB "Verbal Table" TAB_VERB "%.0" "list" COMPU_TAB_REF Gov2_ena_COMPU_VTAB_REF /end COMPU_METHOD
/begin COMPU_VTAB Gov2_ena_COMPU_VTAB_REF "Verbal Table" TAB_VERB 3 0x00 "Disabled" 0x01 "Isochronous" 0x02 "Droop" DEFAULT_VALUE "UNKNOWN" /end COMPU_VTAB
/begin CHARACTERISTIC Gov3_ena "Gov3 control{Gov3_ena&0xff=0x00:Disabled}{Gov3_ena&0xff=0x01:Isochronous}{Gov3_ena&0xff=0x02:Droop}" VALUE 0x00148E64 /* @ECU_Address@Gov3_ena@0x01000CC8@ */ ECIPP_ALIGNMENT_UBYTE 255 Gov3_ena_COMPU_VTAB 0 255 BIT_MASK 0xff /end CHARACTERISTIC
/begin COMPU_METHOD Gov3_ena_COMPU_VTAB "Verbal Table" TAB_VERB "%.0" "list" COMPU_TAB_REF Gov3_ena_COMPU_VTAB_REF /end COMPU_METHOD
/begin COMPU_VTAB Gov3_ena_COMPU_VTAB_REF "Verbal Table" TAB_VERB 3 0x00 "Disabled" 0x01 "Isochronous" 0x02 "Droop" DEFAULT_VALUE "UNKNOWN" /end COMPU_VTAB
/begin CHARACTERISTIC mindgv_I_min "Min droop integrator low" VALUE 0x00148EB8 /* @ECU_Address@mindgv_I_min@0x01000CD0@ */ ECIPP_ALIGNMENT_SWORD 800 Compu_mindgv_I_min -800 799.9755859375 /end CHARACTERISTIC
/begin COMPU_METHOD Compu_mindgv_I_min " " RAT_FUNC "%.1" "%" COEFFS 0 40.96 0 0 0 1 /end COMPU_METHOD
/begin CHARACTERISTIC mindgv_I_max "Min droop integrator high" VALUE 0x00148EBA /* @ECU_Address@mindgv_I_max@0x01000CD8@ */ ECIPP_ALIGNMENT_SWORD 800 Compu_mindgv_I_max -800 799.9755859375 /end CHARACTERISTIC
/begin COMPU_METHOD Compu_mindgv_I_max " " RAT_FUNC "%.1" "%" COEFFS 0 40.96 0 0 0 1 /end COMPU_METHOD
/begin CHARACTERISTIC minigv_I_min "Min isoc integrator low" VALUE 0x00148EBC /* @ECU_Address@minigv_I_min@0x01000CE0@ */ ECIPP_ALIGNMENT_SWORD 800 Compu_minigv_I_min -800 799.9755859375 /end CHARACTERISTIC
/begin COMPU_METHOD Compu_minigv_I_min " " RAT_FUNC "%.1" "%" COEFFS 0 40.96 0 0 0 1 /end COMPU_METHOD
/begin CHARACTERISTIC minigv_I_max "Min isoc integrator high" VALUE 0x00148EBE /* @ECU_Address@minigv_I_max@0x01000CE8@ */ ECIPP_ALIGNMENT_SWORD 800 Compu_minigv_I_max -800 799.9755859375 /end CHARACTERISTIC
/begin COMPU_METHOD Compu_minigv_I_max " " RAT_FUNC "%.1" "%" COEFFS 0 40.96 0 0 0 1 /end COMPU_METHOD
/begin CHARACTERISTIC mingv_nomload "Min droop nominal load" VALUE 0x00148EC4 /* @ECU_Address@mingv_nomload@0x01000CF0@ */ ECIPP_ALIGNMENT_UWORD 1600 Compu_mingv_nomload 0 1599.9755859375 /end CHARACTERISTIC
/begin COMPU_METHOD Compu_mingv_nomload " " RAT_FUNC "%.1" "%" COEFFS 0 40.96 0 0 0 1 /end COMPU_METHOD
/begin CHARACTERISTIC maxdgv_I_min "Max droop integrator low" VALUE 0x00148E98 /* @ECU_Address@maxdgv_I_min@0x01000CF8@ */ ECIPP_ALIGNMENT_SWORD 800 Compu_maxdgv_I_min -800 799.9755859375 /end CHARACTERISTIC
/begin COMPU_METHOD Compu_maxdgv_I_min " " RAT_FUNC "%.1" "%" COEFFS 0 40.96 0 0 0 1 /end COMPU_METHOD
/begin CHARACTERISTIC maxdgv_I_max "Max droop integrator high" VALUE 0x00148E9A /* @ECU_Address@maxdgv_I_max@0x01000D00@ */ ECIPP_ALIGNMENT_SWORD 800 Compu_maxdgv_I_max -800 799.9755859375 /end CHARACTERISTIC
/begin COMPU_METHOD Compu_maxdgv_I_max " " RAT_FUNC "%.1" "%" COEFFS 0 40.96 0 0 0 1 /end COMPU_METHOD
/begin CHARACTERISTIC maxigv_I_min "Max isoc integrator low" VALUE 0x00148E9C /* @ECU_Address@maxigv_I_min@0x01000D08@ */ ECIPP_ALIGNMENT_SWORD 800 Compu_maxigv_I_min -800 799.9755859375 /end CHARACTERISTIC
/begin COMPU_METHOD Compu_maxigv_I_min " " RAT_FUNC "%.1" "%" COEFFS 0 40.96 0 0 0 1 /end COMPU_METHOD
/begin CHARACTERISTIC maxigv_I_max "Max isoc integrator high" VALUE 0x00148E9E /* @ECU_Address@maxigv_I_max@0x01000D10@ */ ECIPP_ALIGNMENT_SWORD 800 Compu_maxigv_I_max -800 799.9755859375 /end CHARACTERISTIC
/begin COMPU_METHOD Compu_maxigv_I_max " " RAT_FUNC "%.1" "%" COEFFS 0 40.96 0 0 0 1 /end COMPU_METHOD
/begin CHARACTERISTIC maxgv_nomload "Max droop nominal load" VALUE 0x00148EA4 /* @ECU_Address@maxgv_nomload@0x01000D18@ */ ECIPP_ALIGNMENT_UWORD 1600 Compu_maxgv_nomload 0 1599.9755859375 /end CHARACTERISTIC
/begin COMPU_METHOD Compu_maxgv_nomload " " RAT_FUNC "%.1" "%" COEFFS 0 40.96 0 0 0 1 /end COMPU_METHOD
/begin CHARACTERISTIC maxgv_auth_min "Max governor authority low" VALUE 0x00148EA0 /* @ECU_Address@maxgv_auth_min@0x01000D20@ */ ECIPP_ALIGNMENT_UWORD 100 Compu_maxgv_auth_min 0 99.9984741210938 /end CHARACTERISTIC
/begin COMPU_METHOD Compu_maxgv_auth_min " " RAT_FUNC "%.1" "%" COEFFS 0 655.36 0 0 0 1 /end COMPU_METHOD
/begin CHARACTERISTIC maxgv_auth_max "Max governor authority high" VALUE 0x00148EA2 /* @ECU_Address@maxgv_auth_max@0x01000D28@ */ ECIPP_ALIGNMENT_UWORD 100 Compu_maxgv_auth_max 0 99.9984741210938 /end CHARACTERISTIC
/begin COMPU_METHOD Compu_maxgv_auth_max " " RAT_FUNC "%.1" "%" COEFFS 0 655.36 0 0 0 1 /end COMPU_METHOD
/begin CHARACTERISTIC Gov1_rpm "Gov1 target speed" VALUE 0x00148E12 /* @ECU_Address@Gov1_rpm@0x01000D30@ */ ECIPP_ALIGNMENT_UWORD 65535 Compu_Gov1_rpm 0 65535 /end CHARACTERISTIC
/begin COMPU_METHOD Compu_Gov1_rpm " " RAT_FUNC "%.0" "rpm" COEFFS 0 1 0 0 0 1 /end COMPU_METHOD
/begin CHARACTERISTIC Gov1d_I_min "Gov1 droop integrator low" VALUE 0x00148E14 /* @ECU_Address@Gov1d_I_min@0x01000D38@ */ ECIPP_ALIGNMENT_SWORD 800 Compu_Gov1d_I_min -800 799.9755859375 /end CHARACTERISTIC
/begin COMPU_METHOD Compu_Gov1d_I_min " " RAT_FUNC "%.1" "%" COEFFS 0 40.96 0 0 0 1 /end COMPU_METHOD
/begin CHARACTERISTIC Gov1d_I_max "Gov1 droop integrator high" VALUE 0x00148E16 /* @ECU_Address@Gov1d_I_max@0x01000D40@ */ ECIPP_ALIGNMENT_SWORD 800 Compu_Gov1d_I_max -800 799.9755859375 /end CHARACTERISTIC
/begin COMPU_METHOD Compu_Gov1d_I_max " " RAT_FUNC "%.1" "%" COEFFS 0 40.96 0 0 0 1 /end COMPU_METHOD
/begin CHARACTERISTIC Gov1i_I_min "Gov1 isoc integrator low" VALUE 0x00148E18 /* @ECU_Address@Gov1i_I_min@0x01000D48@ */ ECIPP_ALIGNMENT_SWORD 800 Compu_Gov1i_I_min -800 799.9755859375 /end CHARACTERISTIC
/begin COMPU_METHOD Compu_Gov1i_I_min " " RAT_FUNC "%.1" "%" COEFFS 0 40.96 0 0 0 1 /end COMPU_METHOD
/begin CHARACTERISTIC Gov1i_I_max "Gov1 isoc integrator high" VALUE 0x00148E1A /* @ECU_Address@Gov1i_I_max@0x01000D50@ */ ECIPP_ALIGNMENT_SWORD 800 Compu_Gov1i_I_max -800 799.9755859375 /end CHARACTERISTIC
/begin COMPU_METHOD Compu_Gov1i_I_max " " RAT_FUNC "%.1" "%" COEFFS 0 40.96 0 0 0 1 /end COMPU_METHOD
/begin CHARACTERISTIC Gov1_nomload "Gov1 droop nominal load" VALUE 0x00148E20 /* @ECU_Address@Gov1_nomload@0x01000D58@ */ ECIPP_ALIGNMENT_UWORD 1600 Compu_Gov1_nomload 0 1599.9755859375 /end CHARACTERISTIC
/begin COMPU_METHOD Compu_Gov1_nomload " " RAT_FUNC "%.1" "%" COEFFS 0 40.96 0 0 0 1 /end COMPU_METHOD
/begin CHARACTERISTIC Gov1_auth_min "Gov1 authority low" VALUE 0x00148E1C /* @ECU_Address@Gov1_auth_min@0x01000D60@ */ ECIPP_ALIGNMENT_UWORD 100 Compu_Gov1_auth_min 0 99.9984741210938 /end CHARACTERISTIC
/begin COMPU_METHOD Compu_Gov1_auth_min " " RAT_FUNC "%.1" "%" COEFFS 0 655.36 0 0 0 1 /end COMPU_METHOD
/begin CHARACTERISTIC Gov1_auth_max "Gov1 authority high" VALUE 0x00148E1E /* @ECU_Address@Gov1_auth_max@0x01000D68@ */ ECIPP_ALIGNMENT_UWORD 100 Compu_Gov1_auth_max 0 99.9984741210938 /end CHARACTERISTIC
/begin COMPU_METHOD Compu_Gov1_auth_max " " RAT_FUNC "%.1" "%" COEFFS 0 655.36 0 0 0 1 /end COMPU_METHOD
/begin CHARACTERISTIC Gov1i_Iinit "Gov1 isoc approach I init" VALUE 0x00148E22 /* @ECU_Address@Gov1i_Iinit@0x01000D70@ */ ECIPP_ALIGNMENT_UWORD 3200 Compu_Gov1i_Iinit 0 3199.951171875 /end CHARACTERISTIC
/begin COMPU_METHOD Compu_Gov1i_Iinit " " RAT_FUNC "%.1" "% / (krpm/sec)" COEFFS 0 20.48 0 0 0 1 /end COMPU_METHOD
/begin CHARACTERISTIC Gov1i_appdlt "Gov1 igov approach delta" VALUE 0x00148E24 /* @ECU_Address@Gov1i_appdlt@0x01000D78@ */ ECIPP_ALIGNMENT_UWORD 65535 Compu_Gov1i_appdlt 0 65535 /end CHARACTERISTIC
/begin COMPU_METHOD Compu_Gov1i_appdlt " " RAT_FUNC "%.0" "rpm" COEFFS 0 1 0 0 0 1 /end COMPU_METHOD
/begin CHARACTERISTIC Gov1i_apprdt "Gov1 igov approach rpmdt" VALUE 0x00148E26 /* @ECU_Address@Gov1i_apprdt@0x01000D80@ */ ECIPP_ALIGNMENT_SWORD 63998 Compu_Gov1i_apprdt -64000 63998.046875 /end CHARACTERISTIC
/begin COMPU_METHOD Compu_Gov1i_apprdt " " RAT_FUNC "%.0" "rpm / sec" COEFFS 0 0.512 0 0 0 1 /end COMPU_METHOD
/begin CHARACTERISTIC Gov2_rpm "Gov2 target speed" VALUE 0x00148E3E /* @ECU_Address@Gov2_rpm@0x01000D88@ */ ECIPP_ALIGNMENT_UWORD 65535 Compu_Gov2_rpm 0 65535 /end CHARACTERISTIC
/begin COMPU_METHOD Compu_Gov2_rpm " " RAT_FUNC "%.0" "rpm" COEFFS 0 1 0 0 0 1 /end COMPU_METHOD
/begin CHARACTERISTIC Gov2d_I_min "Gov2 droop integrator low" VALUE 0x00148E40 /* @ECU_Address@Gov2d_I_min@0x01000D90@ */ ECIPP_ALIGNMENT_SWORD 800 Compu_Gov2d_I_min -800 799.9755859375 /end CHARACTERISTIC
/begin COMPU_METHOD Compu_Gov2d_I_min " " RAT_FUNC "%.1" "%" COEFFS 0 40.96 0 0 0 1 /end COMPU_METHOD
/begin CHARACTERISTIC Gov2d_I_max "Gov2 droop integrator high" VALUE 0x00148E42 /* @ECU_Address@Gov2d_I_max@0x01000D98@ */ ECIPP_ALIGNMENT_SWORD 800 Compu_Gov2d_I_max -800 799.9755859375 /end CHARACTERISTIC
/begin COMPU_METHOD Compu_Gov2d_I_max " " RAT_FUNC "%.1" "%" COEFFS 0 40.96 0 0 0 1 /end COMPU_METHOD
/begin CHARACTERISTIC Gov2i_I_min "Gov2 isoc integrator low" VALUE 0x00148E44 /* @ECU_Address@Gov2i_I_min@0x01000DA0@ */ ECIPP_ALIGNMENT_SWORD 800 Compu_Gov2i_I_min -800 799.9755859375 /end CHARACTERISTIC
/begin COMPU_METHOD Compu_Gov2i_I_min " " RAT_FUNC "%.1" "%" COEFFS 0 40.96 0 0 0 1 /end COMPU_METHOD
/begin CHARACTERISTIC Gov2i_I_max "Gov2 isoc integrator high" VALUE 0x00148E46 /* @ECU_Address@Gov2i_I_max@0x01000DA8@ */ ECIPP_ALIGNMENT_SWORD 800 Compu_Gov2i_I_max -800 799.9755859375 /end CHARACTERISTIC
/begin COMPU_METHOD Compu_Gov2i_I_max " " RAT_FUNC "%.1" "%" COEFFS 0 40.96 0 0 0 1 /end COMPU_METHOD
/begin CHARACTERISTIC Gov2_nomload "Gov2 droop nominal load" VALUE 0x00148E4C /* @ECU_Address@Gov2_nomload@0x01000DB0@ */ ECIPP_ALIGNMENT_UWORD 1600 Compu_Gov2_nomload 0 1599.9755859375 /end CHARACTERISTIC
/begin COMPU_METHOD Compu_Gov2_nomload " " RAT_FUNC "%.1" "%" COEFFS 0 40.96 0 0 0 1 /end COMPU_METHOD
/begin CHARACTERISTIC Gov2_auth_min "Gov2 authority low" VALUE 0x00148E48 /* @ECU_Address@Gov2_auth_min@0x01000DB8@ */ ECIPP_ALIGNMENT_UWORD 100 Compu_Gov2_auth_min 0 99.9984741210938 /end CHARACTERISTIC
/begin COMPU_METHOD Compu_Gov2_auth_min " " RAT_FUNC "%.1" "%" COEFFS 0 655.36 0 0 0 1 /end COMPU_METHOD
/begin CHARACTERISTIC Gov2_auth_max "Gov2 authority high" VALUE 0x00148E4A /* @ECU_Address@Gov2_auth_max@0x01000DC0@ */ ECIPP_ALIGNMENT_UWORD 100 Compu_Gov2_auth_max 0 99.9984741210938 /end CHARACTERISTIC
/begin COMPU_METHOD Compu_Gov2_auth_max " " RAT_FUNC "%.1" "%" COEFFS 0 655.36 0 0 0 1 /end COMPU_METHOD
/begin CHARACTERISTIC Gov2i_Iinit "Gov2 isoc approach I init" VALUE 0x00148E4E /* @ECU_Address@Gov2i_Iinit@0x01000DC8@ */ ECIPP_ALIGNMENT_UWORD 3200 Compu_Gov2i_Iinit 0 3199.951171875 /end CHARACTERISTIC
/begin COMPU_METHOD Compu_Gov2i_Iinit " " RAT_FUNC "%.1" "% / (krpm/sec)" COEFFS 0 20.48 0 0 0 1 /end COMPU_METHOD
/begin CHARACTERISTIC Gov2i_appdlt "Gov2 igov approach delta" VALUE 0x00148E50 /* @ECU_Address@Gov2i_appdlt@0x01000DD0@ */ ECIPP_ALIGNMENT_UWORD 65535 Compu_Gov2i_appdlt 0 65535 /end CHARACTERISTIC
/begin COMPU_METHOD Compu_Gov2i_appdlt " " RAT_FUNC "%.0" "rpm" COEFFS 0 1 0 0 0 1 /end COMPU_METHOD
/begin CHARACTERISTIC Gov2i_apprdt "Gov2 igov approach rpmdt" VALUE 0x00148E52 /* @ECU_Address@Gov2i_apprdt@0x01000DD8@ */ ECIPP_ALIGNMENT_SWORD 63998 Compu_Gov2i_apprdt -64000 63998.046875 /end CHARACTERISTIC
/begin COMPU_METHOD Compu_Gov2i_apprdt " " RAT_FUNC "%.0" "rpm / sec" COEFFS 0 0.512 0 0 0 1 /end COMPU_METHOD
/begin CHARACTERISTIC Gov3_rpm "Gov3 target speed" VALUE 0x00148E6A /* @ECU_Address@Gov3_rpm@0x01000DE0@ */ ECIPP_ALIGNMENT_UWORD 65535 Compu_Gov3_rpm 0 65535 /end CHARACTERISTIC
/begin COMPU_METHOD Compu_Gov3_rpm " " RAT_FUNC "%.0" "rpm" COEFFS 0 1 0 0 0 1 /end COMPU_METHOD
/begin CHARACTERISTIC Gov3d_I_min "Gov3 droop integrator low" VALUE 0x00148E6C /* @ECU_Address@Gov3d_I_min@0x01000DE8@ */ ECIPP_ALIGNMENT_SWORD 800 Compu_Gov3d_I_min -800 799.9755859375 /end CHARACTERISTIC
/begin COMPU_METHOD Compu_Gov3d_I_min " " RAT_FUNC "%.1" "%" COEFFS 0 40.96 0 0 0 1 /end COMPU_METHOD
/begin CHARACTERISTIC Gov3d_I_max "Gov3 droop integrator high" VALUE 0x00148E6E /* @ECU_Address@Gov3d_I_max@0x01000DF0@ */ ECIPP_ALIGNMENT_SWORD 800 Compu_Gov3d_I_max -800 799.9755859375 /end CHARACTERISTIC
/begin COMPU_METHOD Compu_Gov3d_I_max " " RAT_FUNC "%.1" "%" COEFFS 0 40.96 0 0 0 1 /end COMPU_METHOD
/begin CHARACTERISTIC Gov3i_I_min "Gov3 isoc integrator low" VALUE 0x00148E70 /* @ECU_Address@Gov3i_I_min@0x01000DF8@ */ ECIPP_ALIGNMENT_SWORD 800 Compu_Gov3i_I_min -800 799.9755859375 /end CHARACTERISTIC
/begin COMPU_METHOD Compu_Gov3i_I_min " " RAT_FUNC "%.1" "%" COEFFS 0 40.96 0 0 0 1 /end COMPU_METHOD
/begin CHARACTERISTIC Gov3i_I_max "Gov3 isoc integrator high" VALUE 0x00148E72 /* @ECU_Address@Gov3i_I_max@0x01000E00@ */ ECIPP_ALIGNMENT_SWORD 800 Compu_Gov3i_I_max -800 799.9755859375 /end CHARACTERISTIC
/begin COMPU_METHOD Compu_Gov3i_I_max " " RAT_FUNC "%.1" "%" COEFFS 0 40.96 0 0 0 1 /end COMPU_METHOD
/begin CHARACTERISTIC Gov3_nomload "Gov3 droop nominal load" VALUE 0x00148E78 /* @ECU_Address@Gov3_nomload@0x01000E08@ */ ECIPP_ALIGNMENT_UWORD 1600 Compu_Gov3_nomload 0 1599.9755859375 /end CHARACTERISTIC
/begin COMPU_METHOD Compu_Gov3_nomload " " RAT_FUNC "%.1" "%" COEFFS 0 40.96 0 0 0 1 /end COMPU_METHOD
/begin CHARACTERISTIC Gov3_auth_min "Gov3 authority low" VALUE 0x00148E74 /* @ECU_Address@Gov3_auth_min@0x01000E10@ */ ECIPP_ALIGNMENT_UWORD 100 Compu_Gov3_auth_min 0 99.9984741210938 /end CHARACTERISTIC
/begin COMPU_METHOD Compu_Gov3_auth_min " " RAT_FUNC "%.1" "%" COEFFS 0 655.36 0 0 0 1 /end COMPU_METHOD
/begin CHARACTERISTIC Gov3_auth_max "Gov3 authority high" VALUE 0x00148E76 /* @ECU_Address@Gov3_auth_max@0x01000E18@ */ ECIPP_ALIGNMENT_UWORD 100 Compu_Gov3_auth_max 0 99.9984741210938 /end CHARACTERISTIC
/begin COMPU_METHOD Compu_Gov3_auth_max " " RAT_FUNC "%.1" "%" COEFFS 0 655.36 0 0 0 1 /end COMPU_METHOD
/begin CHARACTERISTIC Gov3i_Iinit "Gov3 isoc approach I init" VALUE 0x00148E7A /* @ECU_Address@Gov3i_Iinit@0x01000E20@ */ ECIPP_ALIGNMENT_UWORD 3200 Compu_Gov3i_Iinit 0 3199.951171875 /end CHARACTERISTIC
/begin COMPU_METHOD Compu_Gov3i_Iinit " " RAT_FUNC "%.1" "% / (krpm/sec)" COEFFS 0 20.48 0 0 0 1 /end COMPU_METHOD
/begin CHARACTERISTIC Gov3i_appdlt "Gov3 igov approach delta" VALUE 0x00148E7C /* @ECU_Address@Gov3i_appdlt@0x01000E28@ */ ECIPP_ALIGNMENT_UWORD 65535 Compu_Gov3i_appdlt 0 65535 /end CHARACTERISTIC
/begin COMPU_METHOD Compu_Gov3i_appdlt " " RAT_FUNC "%.0" "rpm" COEFFS 0 1 0 0 0 1 /end COMPU_METHOD
/begin CHARACTERISTIC Gov3i_apprdt "Gov3 igov approach rpmdt" VALUE 0x00148E7E /* @ECU_Address@Gov3i_apprdt@0x01000E30@ */ ECIPP_ALIGNMENT_SWORD 63998 Compu_Gov3i_apprdt -64000 63998.046875 /end CHARACTERISTIC
/begin COMPU_METHOD Compu_Gov3i_apprdt " " RAT_FUNC "%.0" "rpm / sec" COEFFS 0 0.512 0 0 0 1 /end COMPU_METHOD
/begin MEASUREMENT Kp_gov_mult "Kp ECT attenuator" UWORD Compu_Kp_gov_mult 0 0 0 15.999755859375 ECU_ADDRESS 0x01000E38 /end MEASUREMENT
/begin COMPU_METHOD Compu_Kp_gov_mult " " RAT_FUNC "%.3" "fraction" COEFFS 0 4096 0 0 0 1 /end COMPU_METHOD
/begin MEASUREMENT Ki_gov_mult "Ki ECT attenuator" UWORD Compu_Ki_gov_mult 0 0 0 15.999755859375 ECU_ADDRESS 0x01000E40 /end MEASUREMENT
/begin COMPU_METHOD Compu_Ki_gov_mult " " RAT_FUNC "%.3" "fraction" COEFFS 0 4096 0 0 0 1 /end COMPU_METHOD
/begin MEASUREMENT Kd_gov_mult "Kd ECT attenuator" UWORD Compu_Kd_gov_mult 0 0 0 15.999755859375 ECU_ADDRESS 0x01000E48 /end MEASUREMENT
/begin COMPU_METHOD Compu_Kd_gov_mult " " RAT_FUNC "%.3" "fraction" COEFFS 0 4096 0 0 0 1 /end COMPU_METHOD
/begin MEASUREMENT KMAPdt_gov_mult "KMAPdt ECT attenuator" UWORD Compu_KMAPdt_gov_mult 0 0 0 15.999755859375 ECU_ADDRESS 0x01000E50 /end MEASUREMENT
/begin COMPU_METHOD Compu_KMAPdt_gov_mult " " RAT_FUNC "%.3" "fraction" COEFFS 0 4096 0 0 0 1 /end COMPU_METHOD
/begin MEASUREMENT KMAPdtfb_gov_mult "KMAPdt FB ECT attenuator" UWORD Compu_KMAPdtfb_gov_mult 0 0 0 15.999755859375 ECU_ADDRESS 0x01000E58 /end MEASUREMENT
/begin COMPU_METHOD Compu_KMAPdtfb_gov_mult " " RAT_FUNC "%.3" "fraction" COEFFS 0 4096 0 0 0 1 /end COMPU_METHOD
/begin MEASUREMENT KMAPdtfb_gov "dMAP/dt feedback gain" SWORD Compu_KMAPdtfb_gov 0 0 -32 31.9990234375 ECU_ADDRESS 0x01000E60 /end MEASUREMENT
/begin COMPU_METHOD Compu_KMAPdtfb_gov " " RAT_FUNC "%.3" "fraction" COEFFS 0 1024 0 0 0 1 /end COMPU_METHOD
/begin CHARACTERISTIC gov_app_mode "Governor application mode{gov_app_mode&0xff=0x00:Vehicle, neutral required}{gov_app_mode&0xff=0x01:Stationary}{gov_app_mode&0xff=0x02:Vehicle, neut. req. if stationary}" VALUE 0x00148188 /* @ECU_Address@gov_app_mode@0x01000E80@ */ ECIPP_ALIGNMENT_UBYTE 255 gov_app_mode_COMPU_VTAB 0 255 BIT_MASK 0xff /end CHARACTERISTIC
/begin COMPU_METHOD gov_app_mode_COMPU_VTAB "Verbal Table" TAB_VERB "%.0" "list" COMPU_TAB_REF gov_app_mode_COMPU_VTAB_REF /end COMPU_METHOD
/begin COMPU_VTAB gov_app_mode_COMPU_VTAB_REF "Verbal Table" TAB_VERB 3 0x00 "Vehicle, neutral required" 0x01 "Stationary" 0x02 "Vehicle, neut. req. if stationary" DEFAULT_VALUE "UNKNOWN" /end COMPU_VTAB
/begin MEASUREMENT gov_nomld_ECTadd "Nominal load ECT adder" SWORD Compu_gov_nomld_ECTadd 0 0 -800 799.9755859375 ECU_ADDRESS 0x01000EE0 /end MEASUREMENT
/begin COMPU_METHOD Compu_gov_nomld_ECTadd " " RAT_FUNC "%.1" "%" COEFFS 0 40.96 0 0 0 1 /end COMPU_METHOD
/begin CHARACTERISTIC mingv_odz "Min gov output dead-zone (+/-)" VALUE 0x0014667a /* @ECU_Address@mingv_odz@0x01000F30@ */ ECIPP_ALIGNMENT_SWORD 100 Compu_mingv_odz -100 99.9969482421875 /end CHARACTERISTIC
/begin COMPU_METHOD Compu_mingv_odz " " RAT_FUNC "%.1" "%" COEFFS 0 327.68 0 0 0 1 /end COMPU_METHOD
/begin CHARACTERISTIC maxgv_odz "Max gov output dead-zone (+/-)" VALUE 0x00146676 /* @ECU_Address@maxgv_odz@0x01000F38@ */ ECIPP_ALIGNMENT_SWORD 100 Compu_maxgv_odz -100 99.9969482421875 /end CHARACTERISTIC
/begin COMPU_METHOD Compu_maxgv_odz " " RAT_FUNC "%.1" "%" COEFFS 0 327.68 0 0 0 1 /end COMPU_METHOD
/begin CHARACTERISTIC mingv_odz_wall "Min gov output dead-zone floor" VALUE 0x0014667c /* @ECU_Address@mingv_odz_wall@0x01000F40@ */ ECIPP_ALIGNMENT_SWORD 100 Compu_mingv_odz_wall -100 99.9969482421875 /end CHARACTERISTIC
/begin COMPU_METHOD Compu_mingv_odz_wall " " RAT_FUNC "%.1" "%" COEFFS 0 327.68 0 0 0 1 /end COMPU_METHOD
/begin CHARACTERISTIC maxgv_odz_wall "Max gov output dead-zone ceiling" VALUE 0x00146678 /* @ECU_Address@maxgv_odz_wall@0x01000F48@ */ ECIPP_ALIGNMENT_SWORD 100 Compu_maxgv_odz_wall -100 99.9969482421875 /end CHARACTERISTIC
/begin COMPU_METHOD Compu_maxgv_odz_wall " " RAT_FUNC "%.1" "%" COEFFS 0 327.68 0 0 0 1 /end COMPU_METHOD
/begin CHARACTERISTIC mingv_odz_tau "Min gov output dead-zone tau" VALUE 0x00147cbc /* @ECU_Address@mingv_odz_tau@0x01000F50@ */ ECIPP_ALIGNMENT_UWORD 327680 Compu_mingv_odz_tau 0.45084 327680 /end CHARACTERISTIC
/begin COMPU_METHOD Compu_mingv_odz_tau " " FORM "%.0" "ms"
 /begin FORMULA "-5 / log(1 - (X1 / 65536))" FORMULA_INV "(1 - exp(-5/X1)) * 65536" /end FORMULA
/end COMPU_METHOD
/begin CHARACTERISTIC maxgv_odz_tau "Max gov output dead-zone tau" VALUE 0x00147cb8 /* @ECU_Address@maxgv_odz_tau@0x01000F58@ */ ECIPP_ALIGNMENT_UWORD 327680 Compu_maxgv_odz_tau 0.45084 327680 /end CHARACTERISTIC
/begin COMPU_METHOD Compu_maxgv_odz_tau " " FORM "%.0" "ms"
 /begin FORMULA "-5 / log(1 - (X1 / 65536))" FORMULA_INV "(1 - exp(-5/X1)) * 65536" /end FORMULA
/end COMPU_METHOD
/begin CHARACTERISTIC gov_ntrlock_chan "Vehicle mode Gov1/2/3 interlock{gov_ntrlock_chan&0xff=0x00:IVS input}{gov_ntrlock_chan&0xff=0x01:Brake input}{gov_ntrlock_chan&0xff=0x02:Neutral/Park/Secondary}" VALUE 0x0014818f /* @ECU_Address@gov_ntrlock_chan@0x010012E8@ */ ECIPP_ALIGNMENT_UBYTE 255 gov_ntrlock_chan_COMPU_VTAB 0 255 BIT_MASK 0xff /end CHARACTERISTIC
/begin COMPU_METHOD gov_ntrlock_chan_COMPU_VTAB "Verbal Table" TAB_VERB "%.0" "list" COMPU_TAB_REF gov_ntrlock_chan_COMPU_VTAB_REF /end COMPU_METHOD
/begin COMPU_VTAB gov_ntrlock_chan_COMPU_VTAB_REF "Verbal Table" TAB_VERB 3 0x00 "IVS input" 0x01 "Brake input" 0x02 "Neutral/Park/Secondary" DEFAULT_VALUE "UNKNOWN" /end COMPU_VTAB
/begin CHARACTERISTIC mingv_TPSLP "Min Gov TPS low-pass" VALUE 0x00148EB4 /* @ECU_Address@mingv_TPSLP@0x01001758@ */ ECIPP_ALIGNMENT_UWORD 327680 Compu_mingv_TPSLP 0.45084 327680 /end CHARACTERISTIC
/begin COMPU_METHOD Compu_mingv_TPSLP " " FORM "%.1" "ms"
 /begin FORMULA "-5 / log(1 - (X1 / 65536))" FORMULA_INV "(1 - exp(-5/X1)) * 65536" /end FORMULA
/end COMPU_METHOD
/begin CHARACTERISTIC maxgv_TPSLP "Max Gov TPS low-pass" VALUE 0x00148E94 /* @ECU_Address@maxgv_TPSLP@0x01001760@ */ ECIPP_ALIGNMENT_UWORD 327680 Compu_maxgv_TPSLP 0.45084 327680 /end CHARACTERISTIC
/begin COMPU_METHOD Compu_maxgv_TPSLP " " FORM "%.1" "ms"
 /begin FORMULA "-5 / log(1 - (X1 / 65536))" FORMULA_INV "(1 - exp(-5/X1)) * 65536" /end FORMULA
/end COMPU_METHOD
/begin CHARACTERISTIC Gov1_TPSLP "Gov1 TPS low-pass" VALUE 0x00148E10 /* @ECU_Address@Gov1_TPSLP@0x01001768@ */ ECIPP_ALIGNMENT_UWORD 327680 Compu_Gov1_TPSLP 0.45084 327680 /end CHARACTERISTIC
/begin COMPU_METHOD Compu_Gov1_TPSLP " " FORM "%.1" "ms"
 /begin FORMULA "-5 / log(1 - (X1 / 65536))" FORMULA_INV "(1 - exp(-5/X1)) * 65536" /end FORMULA
/end COMPU_METHOD
/begin CHARACTERISTIC Gov2_TPSLP "Gov2 TPS low-pass" VALUE 0x00148E3C /* @ECU_Address@Gov2_TPSLP@0x01001770@ */ ECIPP_ALIGNMENT_UWORD 327680 Compu_Gov2_TPSLP 0.45084 327680 /end CHARACTERISTIC
/begin COMPU_METHOD Compu_Gov2_TPSLP " " FORM "%.1" "ms"
 /begin FORMULA "-5 / log(1 - (X1 / 65536))" FORMULA_INV "(1 - exp(-5/X1)) * 65536" /end FORMULA
/end COMPU_METHOD
/begin CHARACTERISTIC Gov3_TPSLP "Gov3 TPS low-pass" VALUE 0x00148E68 /* @ECU_Address@Gov3_TPSLP@0x01001778@ */ ECIPP_ALIGNMENT_UWORD 327680 Compu_Gov3_TPSLP 0.45084 327680 /end CHARACTERISTIC
/begin COMPU_METHOD Compu_Gov3_TPSLP " " FORM "%.1" "ms"
 /begin FORMULA "-5 / log(1 - (X1 / 65536))" FORMULA_INV "(1 - exp(-5/X1)) * 65536" /end FORMULA
/end COMPU_METHOD
/begin MEASUREMENT Imin_gov_acc "Min gov integrator" SLONG Compu_Imin_gov_acc 0 0 -800 799.999999627471 ECU_ADDRESS 0x01001828 /end MEASUREMENT
/begin COMPU_METHOD Compu_Imin_gov_acc " " RAT_FUNC "%.1" "%" COEFFS 0 2684354.56 0 0 0 1 /end COMPU_METHOD
/begin MEASUREMENT Imax_gov_acc "Max gov integrator" SLONG Compu_Imax_gov_acc 0 0 -800 799.999999627471 ECU_ADDRESS 0x01001830 /end MEASUREMENT
/begin COMPU_METHOD Compu_Imax_gov_acc " " RAT_FUNC "%.1" "%" COEFFS 0 2684354.56 0 0 0 1 /end COMPU_METHOD
/begin MEASUREMENT Imin_gov_save "Min gov saved integrator" SLONG Compu_Imin_gov_save 0 0 -800 799.999999627471 ECU_ADDRESS 0x01001838 /end MEASUREMENT
/begin COMPU_METHOD Compu_Imin_gov_save " " RAT_FUNC "%.1" "%" COEFFS 0 2684354.56 0 0 0 1 /end COMPU_METHOD
/begin MEASUREMENT Imax_gov_save "Max gov saved integrator" SLONG Compu_Imax_gov_save 0 0 -800 799.999999627471 ECU_ADDRESS 0x01001840 /end MEASUREMENT
/begin COMPU_METHOD Compu_Imax_gov_save " " RAT_FUNC "%.1" "%" COEFFS 0 2684354.56 0 0 0 1 /end COMPU_METHOD
/begin MEASUREMENT I_Gov1_acc "Gov1 integrator" SLONG Compu_I_Gov1_acc 0 0 -800 799.999999627471 ECU_ADDRESS 0x01001848 /end MEASUREMENT
/begin COMPU_METHOD Compu_I_Gov1_acc " " RAT_FUNC "%.1" "%" COEFFS 0 2684354.56 0 0 0 1 /end COMPU_METHOD
/begin MEASUREMENT I_Gov2_acc "Gov2 integrator" SLONG Compu_I_Gov2_acc 0 0 -800 799.999999627471 ECU_ADDRESS 0x01001850 /end MEASUREMENT
/begin COMPU_METHOD Compu_I_Gov2_acc " " RAT_FUNC "%.1" "%" COEFFS 0 2684354.56 0 0 0 1 /end COMPU_METHOD
/begin MEASUREMENT I_Gov3_acc "Gov3 integrator" SLONG Compu_I_Gov3_acc 0 0 -800 799.999999627471 ECU_ADDRESS 0x01001858 /end MEASUREMENT
/begin COMPU_METHOD Compu_I_Gov3_acc " " RAT_FUNC "%.1" "%" COEFFS 0 2684354.56 0 0 0 1 /end COMPU_METHOD
/begin MEASUREMENT rpmd_gov "RPM trajectory target" UWORD Compu_rpmd_gov 0 0 0 65535 ECU_ADDRESS 0x01001860 /end MEASUREMENT
/begin COMPU_METHOD Compu_rpmd_gov " " RAT_FUNC "%.0" "rpm" COEFFS 0 1 0 0 0 1 /end COMPU_METHOD
/begin MEASUREMENT rpmdtd_gov "RPMdt trajectory target" SWORD Compu_rpmdtd_gov 0 0 -64000 63998.046875 ECU_ADDRESS 0x01001868 /end MEASUREMENT
/begin COMPU_METHOD Compu_rpmdtd_gov " " RAT_FUNC "%.1" "rpm / sec" COEFFS 0 0.512 0 0 0 1 /end COMPU_METHOD
/begin CHARACTERISTIC Imin_gov_start "Min governor initial integrator" VALUE 0x00148ECC /* @ECU_Address@Imin_gov_start@0x01001870@ */ ECIPP_ALIGNMENT_SLONG 800 Compu_Imin_gov_start -800 799.999999627471 /end CHARACTERISTIC
/begin COMPU_METHOD Compu_Imin_gov_start " " RAT_FUNC "%.1" "%" COEFFS 0 2684354.56 0 0 0 1 /end COMPU_METHOD
/begin CHARACTERISTIC Imax_gov_start "Max governor initial integrator" VALUE 0x00148EAC /* @ECU_Address@Imax_gov_start@0x01001878@ */ ECIPP_ALIGNMENT_SLONG 800 Compu_Imax_gov_start -800 799.999999627471 /end CHARACTERISTIC
/begin COMPU_METHOD Compu_Imax_gov_start " " RAT_FUNC "%.1" "%" COEFFS 0 2684354.56 0 0 0 1 /end COMPU_METHOD
/begin CHARACTERISTIC I_Gov1_start "Gov1 initial integrator" VALUE 0x00148E28 /* @ECU_Address@I_Gov1_start@0x01001880@ */ ECIPP_ALIGNMENT_SLONG 800 Compu_I_Gov1_start -800 799.999999627471 /end CHARACTERISTIC
/begin COMPU_METHOD Compu_I_Gov1_start " " RAT_FUNC "%.1" "%" COEFFS 0 2684354.56 0 0 0 1 /end COMPU_METHOD
/begin CHARACTERISTIC I_Gov2_start "Gov2 initial integrator" VALUE 0x00148E54 /* @ECU_Address@I_Gov2_start@0x01001888@ */ ECIPP_ALIGNMENT_SLONG 800 Compu_I_Gov2_start -800 799.999999627471 /end CHARACTERISTIC
/begin COMPU_METHOD Compu_I_Gov2_start " " RAT_FUNC "%.1" "%" COEFFS 0 2684354.56 0 0 0 1 /end COMPU_METHOD
/begin CHARACTERISTIC I_Gov3_start "Gov3 initial integrator" VALUE 0x00148E80 /* @ECU_Address@I_Gov3_start@0x01001890@ */ ECIPP_ALIGNMENT_SLONG 800 Compu_I_Gov3_start -800 799.999999627471 /end CHARACTERISTIC
/begin COMPU_METHOD Compu_I_Gov3_start " " RAT_FUNC "%.1" "%" COEFFS 0 2684354.56 0 0 0 1 /end COMPU_METHOD
/begin CHARACTERISTIC Gov_start_wait "Gov1/2/3 delay from start" VALUE 0x0014743e /* @ECU_Address@Gov_start_wait@0x01001898@ */ ECIPP_ALIGNMENT_UWORD 66 Compu_Gov_start_wait 0 65.535 /end CHARACTERISTIC
/begin COMPU_METHOD Compu_Gov_start_wait " " RAT_FUNC "%.1" "sec" COEFFS 0 1000 0 0 0 1 /end COMPU_METHOD
/begin CHARACTERISTIC mingv_spk_Kpo "Min gov overshoot spark gain" VALUE 0x00149630 /* @ECU_Address@mingv_spk_Kpo@0x01001978@ */ ECIPP_ALIGNMENT_UWORD 128 Compu_mingv_spk_Kpo 0 127.998046875 /end CHARACTERISTIC
/begin COMPU_METHOD Compu_mingv_spk_Kpo " " RAT_FUNC "%.2" "CAD ret/rpm" COEFFS 0 512 0 0 0 1 /end COMPU_METHOD
/begin CHARACTERISTIC maxgv_spk_Kpo "Max gov overshoot spark gain" VALUE 0x00149624 /* @ECU_Address@maxgv_spk_Kpo@0x01001980@ */ ECIPP_ALIGNMENT_UWORD 128 Compu_maxgv_spk_Kpo 0 127.998046875 /end CHARACTERISTIC
/begin COMPU_METHOD Compu_maxgv_spk_Kpo " " RAT_FUNC "%.2" "CAD ret/rpm" COEFFS 0 512 0 0 0 1 /end COMPU_METHOD
/begin CHARACTERISTIC Gov1_spk_Kpo "Gov1 overshoot spark gain" VALUE 0x00148E2C /* @ECU_Address@Gov1_spk_Kpo@0x01001988@ */ ECIPP_ALIGNMENT_UWORD 128 Compu_Gov1_spk_Kpo 0 127.998046875 /end CHARACTERISTIC
/begin COMPU_METHOD Compu_Gov1_spk_Kpo " " RAT_FUNC "%.2" "CAD ret/rpm" COEFFS 0 512 0 0 0 1 /end COMPU_METHOD
/begin CHARACTERISTIC Gov2_spk_Kpo "Gov2 overshoot spark gain" VALUE 0x00148E58 /* @ECU_Address@Gov2_spk_Kpo@0x01001990@ */ ECIPP_ALIGNMENT_UWORD 128 Compu_Gov2_spk_Kpo 0 127.998046875 /end CHARACTERISTIC
/begin COMPU_METHOD Compu_Gov2_spk_Kpo " " RAT_FUNC "%.2" "CAD ret/rpm" COEFFS 0 512 0 0 0 1 /end COMPU_METHOD
/begin CHARACTERISTIC Gov3_spk_Kpo "Gov3 overshoot spark gain" VALUE 0x00148E84 /* @ECU_Address@Gov3_spk_Kpo@0x01001998@ */ ECIPP_ALIGNMENT_UWORD 128 Compu_Gov3_spk_Kpo 0 127.998046875 /end CHARACTERISTIC
/begin COMPU_METHOD Compu_Gov3_spk_Kpo " " RAT_FUNC "%.2" "CAD ret/rpm" COEFFS 0 512 0 0 0 1 /end COMPU_METHOD
/begin CHARACTERISTIC Gov3_spk_Kpu "Gov3 undershoot spark gain" VALUE 0x00148E86 /* @ECU_Address@Gov3_spk_Kpu@0x010019A0@ */ ECIPP_ALIGNMENT_UWORD 128 Compu_Gov3_spk_Kpu 0 127.998046875 /end CHARACTERISTIC
/begin COMPU_METHOD Compu_Gov3_spk_Kpu " " RAT_FUNC "%.2" "CAD adv/rpm" COEFFS 0 512 0 0 0 1 /end COMPU_METHOD
/begin CHARACTERISTIC Gov2_spk_Kpu "Gov2 undershoot spark gain" VALUE 0x00148E5A /* @ECU_Address@Gov2_spk_Kpu@0x010019A8@ */ ECIPP_ALIGNMENT_UWORD 128 Compu_Gov2_spk_Kpu 0 127.998046875 /end CHARACTERISTIC
/begin COMPU_METHOD Compu_Gov2_spk_Kpu " " RAT_FUNC "%.2" "CAD adv/rpm" COEFFS 0 512 0 0 0 1 /end COMPU_METHOD
/begin CHARACTERISTIC Gov1_spk_Kpu "Gov1 undershoot spark gain" VALUE 0x00148E2E /* @ECU_Address@Gov1_spk_Kpu@0x010019B0@ */ ECIPP_ALIGNMENT_UWORD 128 Compu_Gov1_spk_Kpu 0 127.998046875 /end CHARACTERISTIC
/begin COMPU_METHOD Compu_Gov1_spk_Kpu " " RAT_FUNC "%.2" "CAD adv/rpm" COEFFS 0 512 0 0 0 1 /end COMPU_METHOD
/begin CHARACTERISTIC maxgv_spk_Kpu "Max gov undershoot spark gain" VALUE 0x00149626 /* @ECU_Address@maxgv_spk_Kpu@0x010019B8@ */ ECIPP_ALIGNMENT_UWORD 128 Compu_maxgv_spk_Kpu 0 127.998046875 /end CHARACTERISTIC
/begin COMPU_METHOD Compu_maxgv_spk_Kpu " " RAT_FUNC "%.2" "CAD adv/rpm" COEFFS 0 512 0 0 0 1 /end COMPU_METHOD
/begin CHARACTERISTIC mingv_spk_Kpu "Min gov undershoot spark gain" VALUE 0x00149632 /* @ECU_Address@mingv_spk_Kpu@0x010019C0@ */ ECIPP_ALIGNMENT_UWORD 128 Compu_mingv_spk_Kpu 0 127.998046875 /end CHARACTERISTIC
/begin COMPU_METHOD Compu_mingv_spk_Kpu " " RAT_FUNC "%.2" "CAD adv/rpm" COEFFS 0 512 0 0 0 1 /end COMPU_METHOD
/begin CHARACTERISTIC mingv_spk_dzo "Min gov overshoot spark deadzone" VALUE 0x00149634 /* @ECU_Address@mingv_spk_dzo@0x010019C8@ */ ECIPP_ALIGNMENT_UWORD 65535 Compu_mingv_spk_dzo 0 65535 /end CHARACTERISTIC
/begin COMPU_METHOD Compu_mingv_spk_dzo " " RAT_FUNC "%.0" "rpm" COEFFS 0 1 0 0 0 1 /end COMPU_METHOD
/begin CHARACTERISTIC maxgv_spk_dzo "Max gov overshoot spark deadzone" VALUE 0x00149628 /* @ECU_Address@maxgv_spk_dzo@0x010019D0@ */ ECIPP_ALIGNMENT_UWORD 65535 Compu_maxgv_spk_dzo 0 65535 /end CHARACTERISTIC
/begin COMPU_METHOD Compu_maxgv_spk_dzo " " RAT_FUNC "%.0" "rpm" COEFFS 0 1 0 0 0 1 /end COMPU_METHOD
/begin CHARACTERISTIC Gov1_spk_dzo "Gov1 overshoot spark deadzone" VALUE 0x00148E30 /* @ECU_Address@Gov1_spk_dzo@0x010019D8@ */ ECIPP_ALIGNMENT_UWORD 65535 Compu_Gov1_spk_dzo 0 65535 /end CHARACTERISTIC
/begin COMPU_METHOD Compu_Gov1_spk_dzo " " RAT_FUNC "%.0" "rpm" COEFFS 0 1 0 0 0 1 /end COMPU_METHOD
/begin CHARACTERISTIC Gov2_spk_dzo "Gov2 overshoot spark deadzone" VALUE 0x00148E5C /* @ECU_Address@Gov2_spk_dzo@0x010019E0@ */ ECIPP_ALIGNMENT_UWORD 65535 Compu_Gov2_spk_dzo 0 65535 /end CHARACTERISTIC
/begin COMPU_METHOD Compu_Gov2_spk_dzo " " RAT_FUNC "%.0" "rpm" COEFFS 0 1 0 0 0 1 /end COMPU_METHOD
/begin CHARACTERISTIC Gov3_spk_dzo "Gov3 overshoot spark deadzone" VALUE 0x00148E88 /* @ECU_Address@Gov3_spk_dzo@0x010019E8@ */ ECIPP_ALIGNMENT_UWORD 65535 Compu_Gov3_spk_dzo 0 65535 /end CHARACTERISTIC
/begin COMPU_METHOD Compu_Gov3_spk_dzo " " RAT_FUNC "%.0" "rpm" COEFFS 0 1 0 0 0 1 /end COMPU_METHOD
/begin CHARACTERISTIC mingv_spk_dzu "Min gov undershoot spark deadzone" VALUE 0x00149636 /* @ECU_Address@mingv_spk_dzu@0x010019F0@ */ ECIPP_ALIGNMENT_UWORD 65535 Compu_mingv_spk_dzu 0 65535 /end CHARACTERISTIC
/begin COMPU_METHOD Compu_mingv_spk_dzu " " RAT_FUNC "%.0" "rpm" COEFFS 0 1 0 0 0 1 /end COMPU_METHOD
/begin CHARACTERISTIC maxgv_spk_dzu "Max gov undershoot spark deadzone" VALUE 0x0014962A /* @ECU_Address@maxgv_spk_dzu@0x010019F8@ */ ECIPP_ALIGNMENT_UWORD 65535 Compu_maxgv_spk_dzu 0 65535 /end CHARACTERISTIC
/begin COMPU_METHOD Compu_maxgv_spk_dzu " " RAT_FUNC "%.0" "rpm" COEFFS 0 1 0 0 0 1 /end COMPU_METHOD
/begin CHARACTERISTIC Gov1_spk_dzu "Gov1 undershoot spark deadzone" VALUE 0x00148E32 /* @ECU_Address@Gov1_spk_dzu@0x01001A00@ */ ECIPP_ALIGNMENT_UWORD 65535 Compu_Gov1_spk_dzu 0 65535 /end CHARACTERISTIC
/begin COMPU_METHOD Compu_Gov1_spk_dzu " " RAT_FUNC "%.0" "rpm" COEFFS 0 1 0 0 0 1 /end COMPU_METHOD
/begin CHARACTERISTIC Gov2_spk_dzu "Gov2 undershoot spark deadzone" VALUE 0x00148E5E /* @ECU_Address@Gov2_spk_dzu@0x01001A08@ */ ECIPP_ALIGNMENT_UWORD 65535 Compu_Gov2_spk_dzu 0 65535 /end CHARACTERISTIC
/begin COMPU_METHOD Compu_Gov2_spk_dzu " " RAT_FUNC "%.0" "rpm" COEFFS 0 1 0 0 0 1 /end COMPU_METHOD
/begin CHARACTERISTIC Gov3_spk_dzu "Gov3 undershoot spark deadzone" VALUE 0x00148E8A /* @ECU_Address@Gov3_spk_dzu@0x01001A10@ */ ECIPP_ALIGNMENT_UWORD 65535 Compu_Gov3_spk_dzu 0 65535 /end CHARACTERISTIC
/begin COMPU_METHOD Compu_Gov3_spk_dzu " " RAT_FUNC "%.0" "rpm" COEFFS 0 1 0 0 0 1 /end COMPU_METHOD
/begin CHARACTERISTIC mingv_spk_mxret "Min gov spark max retard" VALUE 0x00149638 /* @ECU_Address@mingv_spk_mxret@0x01001A18@ */ ECIPP_ALIGNMENT_SWORD 2048 Compu_mingv_spk_mxret -2048 2047.9375 /end CHARACTERISTIC
/begin COMPU_METHOD Compu_mingv_spk_mxret " " RAT_FUNC "%.1" "CAD ret" COEFFS 0 16 0 0 0 1 /end COMPU_METHOD
/begin CHARACTERISTIC maxgv_spk_mxret "Max gov spark max retard" VALUE 0x0014962C /* @ECU_Address@maxgv_spk_mxret@0x01001A20@ */ ECIPP_ALIGNMENT_SWORD 2048 Compu_maxgv_spk_mxret -2048 2047.9375 /end CHARACTERISTIC
/begin COMPU_METHOD Compu_maxgv_spk_mxret " " RAT_FUNC "%.1" "CAD ret" COEFFS 0 16 0 0 0 1 /end COMPU_METHOD
/begin CHARACTERISTIC Gov1_spk_mxret "Gov1 spark max retard" VALUE 0x00148E34 /* @ECU_Address@Gov1_spk_mxret@0x01001A28@ */ ECIPP_ALIGNMENT_SWORD 2048 Compu_Gov1_spk_mxret -2048 2047.9375 /end CHARACTERISTIC
/begin COMPU_METHOD Compu_Gov1_spk_mxret " " RAT_FUNC "%.1" "CAD ret" COEFFS 0 16 0 0 0 1 /end COMPU_METHOD
/begin CHARACTERISTIC Gov2_spk_mxret "Gov2 spark max retard" VALUE 0x00148E60 /* @ECU_Address@Gov2_spk_mxret@0x01001A30@ */ ECIPP_ALIGNMENT_SWORD 2048 Compu_Gov2_spk_mxret -2048 2047.9375 /end CHARACTERISTIC
/begin COMPU_METHOD Compu_Gov2_spk_mxret " " RAT_FUNC "%.1" "CAD ret" COEFFS 0 16 0 0 0 1 /end COMPU_METHOD
/begin CHARACTERISTIC Gov3_spk_mxret "Gov3 spark max retard" VALUE 0x00148E8C /* @ECU_Address@Gov3_spk_mxret@0x01001A38@ */ ECIPP_ALIGNMENT_SWORD 2048 Compu_Gov3_spk_mxret -2048 2047.9375 /end CHARACTERISTIC
/begin COMPU_METHOD Compu_Gov3_spk_mxret " " RAT_FUNC "%.1" "CAD ret" COEFFS 0 16 0 0 0 1 /end COMPU_METHOD
/begin CHARACTERISTIC mingv_spk_mxadv "Min gov spark max advance" VALUE 0x0014963A /* @ECU_Address@mingv_spk_mxadv@0x01001A40@ */ ECIPP_ALIGNMENT_SWORD 2048 Compu_mingv_spk_mxadv -2048 2047.9375 /end CHARACTERISTIC
/begin COMPU_METHOD Compu_mingv_spk_mxadv " " RAT_FUNC "%.1" "CAD adv" COEFFS 0 16 0 0 0 1 /end COMPU_METHOD
/begin CHARACTERISTIC maxgv_spk_mxadv "Max gov spark max advance" VALUE 0x0014962E /* @ECU_Address@maxgv_spk_mxadv@0x01001A48@ */ ECIPP_ALIGNMENT_SWORD 2048 Compu_maxgv_spk_mxadv -2048 2047.9375 /end CHARACTERISTIC
/begin COMPU_METHOD Compu_maxgv_spk_mxadv " " RAT_FUNC "%.1" "CAD adv" COEFFS 0 16 0 0 0 1 /end COMPU_METHOD
/begin CHARACTERISTIC Gov1_spk_mxadv "Gov1 spark max advance" VALUE 0x00148E36 /* @ECU_Address@Gov1_spk_mxadv@0x01001A50@ */ ECIPP_ALIGNMENT_SWORD 2048 Compu_Gov1_spk_mxadv -2048 2047.9375 /end CHARACTERISTIC
/begin COMPU_METHOD Compu_Gov1_spk_mxadv " " RAT_FUNC "%.1" "CAD adv" COEFFS 0 16 0 0 0 1 /end COMPU_METHOD
/begin CHARACTERISTIC Gov2_spk_mxadv "Gov2 spark max advance" VALUE 0x00148E62 /* @ECU_Address@Gov2_spk_mxadv@0x01001A58@ */ ECIPP_ALIGNMENT_SWORD 2048 Compu_Gov2_spk_mxadv -2048 2047.9375 /end CHARACTERISTIC
/begin COMPU_METHOD Compu_Gov2_spk_mxadv " " RAT_FUNC "%.1" "CAD adv" COEFFS 0 16 0 0 0 1 /end COMPU_METHOD
/begin CHARACTERISTIC Gov3_spk_mxadv "Gov3 spark max advance" VALUE 0x00148E8E /* @ECU_Address@Gov3_spk_mxadv@0x01001A60@ */ ECIPP_ALIGNMENT_SWORD 2048 Compu_Gov3_spk_mxadv -2048 2047.9375 /end CHARACTERISTIC
/begin COMPU_METHOD Compu_Gov3_spk_mxadv " " RAT_FUNC "%.1" "CAD adv" COEFFS 0 16 0 0 0 1 /end COMPU_METHOD
/begin CHARACTERISTIC gov_gain_gsln "Gasoline mode governor gains{gov_gain_gsln&0xff=0:Standard 1}{gov_gain_gsln&0xff=1:Alternate 1}{gov_gain_gsln&0xff=2:Standard 2}{gov_gain_gsln&0xff=3:Alternate 2}" VALUE 0x0014818d /* @ECU_Address@gov_gain_gsln@0x01001AD8@ */ ECIPP_ALIGNMENT_UBYTE 255 gov_gain_gsln_COMPU_VTAB 0 255 BIT_MASK 0xff /end CHARACTERISTIC
/begin COMPU_METHOD gov_gain_gsln_COMPU_VTAB "Verbal Table" TAB_VERB "%.0" "list" COMPU_TAB_REF gov_gain_gsln_COMPU_VTAB_REF /end COMPU_METHOD
/begin COMPU_VTAB gov_gain_gsln_COMPU_VTAB_REF "Verbal Table" TAB_VERB 4 0 "Standard 1" 1 "Alternate 1" 2 "Standard 2" 3 "Alternate 2" DEFAULT_VALUE "UNKNOWN" /end COMPU_VTAB
/begin CHARACTERISTIC gov_gain_LPG "LPG mode governor gains{gov_gain_LPG&0xff=0:Standard 1}{gov_gain_LPG&0xff=1:Alternate 1}{gov_gain_LPG&0xff=2:Standard 2}{gov_gain_LPG&0xff=3:Alternate 2}" VALUE 0x00148189 /* @ECU_Address@gov_gain_LPG@0x01001AE0@ */ ECIPP_ALIGNMENT_UBYTE 255 gov_gain_LPG_COMPU_VTAB 0 255 BIT_MASK 0xff /end CHARACTERISTIC
/begin COMPU_METHOD gov_gain_LPG_COMPU_VTAB "Verbal Table" TAB_VERB "%.0" "list" COMPU_TAB_REF gov_gain_LPG_COMPU_VTAB_REF /end COMPU_METHOD
/begin COMPU_VTAB gov_gain_LPG_COMPU_VTAB_REF "Verbal Table" TAB_VERB 4 0 "Standard 1" 1 "Alternate 1" 2 "Standard 2" 3 "Alternate 2" DEFAULT_VALUE "UNKNOWN" /end COMPU_VTAB
/begin CHARACTERISTIC gov_gain_NG "NG  mode governor gains{gov_gain_NG&0xff=0:Standard 1}{gov_gain_NG&0xff=1:Alternate 1}{gov_gain_NG&0xff=2:Standard 2}{gov_gain_NG&0xff=3:Alternate 2}" VALUE 0x0014818b /* @ECU_Address@gov_gain_NG@0x01001AE8@ */ ECIPP_ALIGNMENT_UBYTE 255 gov_gain_NG_COMPU_VTAB 0 255 BIT_MASK 0xff /end CHARACTERISTIC
/begin COMPU_METHOD gov_gain_NG_COMPU_VTAB "Verbal Table" TAB_VERB "%.0" "list" COMPU_TAB_REF gov_gain_NG_COMPU_VTAB_REF /end COMPU_METHOD
/begin COMPU_VTAB gov_gain_NG_COMPU_VTAB_REF "Verbal Table" TAB_VERB 4 0 "Standard 1" 1 "Alternate 1" 2 "Standard 2" 3 "Alternate 2" DEFAULT_VALUE "UNKNOWN" /end COMPU_VTAB
/begin MEASUREMENT gov_gain_slct "Active governor gain selection{gov_gain_slct&0xff=0:Standard 1}{gov_gain_slct&0xff=1:Alternate 1}{gov_gain_slct&0xff=2:Standard 2}{gov_gain_slct&0xff=3:Alternate 2}" UBYTE gov_gain_slct_COMPU_VTAB 0 0 0 255 ECU_ADDRESS 0x01001AF0 BIT_MASK 0xff /end MEASUREMENT
/begin COMPU_METHOD gov_gain_slct_COMPU_VTAB "Verbal Table" TAB_VERB "%.0" "list" COMPU_TAB_REF gov_gain_slct_COMPU_VTAB_REF /end COMPU_METHOD
/begin COMPU_VTAB gov_gain_slct_COMPU_VTAB_REF "Verbal Table" TAB_VERB 4 0 "Standard 1" 1 "Alternate 1" 2 "Standard 2" 3 "Alternate 2" DEFAULT_VALUE "UNKNOWN" /end COMPU_VTAB
/begin CHARACTERISTIC FPPSC_mode "FPP speed control rpm source{FPPSC_mode&0xff=0:Min-Max Gov range}{FPPSC_mode&0xff=1:Independent 2-point range}{FPPSC_mode&0xff=2:Independent 4-point range}" VALUE 0x00147d69 /* @ECU_Address@FPPSC_mode@0x01001AF8@ */ ECIPP_ALIGNMENT_UBYTE 255 FPPSC_mode_COMPU_VTAB 0 255 BIT_MASK 0xff /end CHARACTERISTIC
/begin COMPU_METHOD FPPSC_mode_COMPU_VTAB "Verbal Table" TAB_VERB "%.0" "list" COMPU_TAB_REF FPPSC_mode_COMPU_VTAB_REF /end COMPU_METHOD
/begin COMPU_VTAB FPPSC_mode_COMPU_VTAB_REF "Verbal Table" TAB_VERB 3 0 "Min-Max Gov range" 1 "Independent 2-point range" 2 "Independent 4-point range" DEFAULT_VALUE "UNKNOWN" /end COMPU_VTAB
/begin CHARACTERISTIC FPPSC_rpmL "FPP independent 2-pt rpm lower" VALUE 0x00146894 /* @ECU_Address@FPPSC_rpmL@0x01001B00@ */ ECIPP_ALIGNMENT_UWORD 65535 Compu_FPPSC_rpmL 0 65535 /end CHARACTERISTIC
/begin COMPU_METHOD Compu_FPPSC_rpmL " " RAT_FUNC "%.0" "rpm" COEFFS 0 1 0 0 0 1 /end COMPU_METHOD
/begin CHARACTERISTIC FPPSC_rpmH "FPP independent 2-pt rpm upper" VALUE 0x00146892 /* @ECU_Address@FPPSC_rpmH@0x01001B08@ */ ECIPP_ALIGNMENT_UWORD 65535 Compu_FPPSC_rpmH 0 65535 /end CHARACTERISTIC
/begin COMPU_METHOD Compu_FPPSC_rpmH " " RAT_FUNC "%.0" "rpm" COEFFS 0 1 0 0 0 1 /end COMPU_METHOD
/begin CHARACTERISTIC gagedrv_chan "ECT gauge driver channel{gagedrv_chan&0xff=0:Disabled}{gagedrv_chan&0xff=1:Not Available}{gagedrv_chan&0xff=2:Not Available}{gagedrv_chan&0xff=3:Aux PWM1}{gagedrv_chan&0xff=4:Aux PWM2}{gagedrv_chan&0xff=5:Aux PWM3}{gagedrv_chan&0xff=6:Aux PWM4}{gagedrv_ch" VALUE 0x00148186 /* @ECU_Address@gagedrv_chan@0x01001CC0@ */ ECIPP_ALIGNMENT_UBYTE 255 gagedrv_chan_COMPU_VTAB 0 255 BIT_MASK 0xff /end CHARACTERISTIC
/begin COMPU_METHOD gagedrv_chan_COMPU_VTAB "Verbal Table" TAB_VERB "%.0" "list" COMPU_TAB_REF gagedrv_chan_COMPU_VTAB_REF /end COMPU_METHOD
/begin COMPU_VTAB gagedrv_chan_COMPU_VTAB_REF "Verbal Table" TAB_VERB 8 0 "Disabled" 1 "Not Available" 2 "Not Available" 3 "Aux PWM1" 4 "Aux PWM2" 5 "Aux PWM3" 6 "Aux PWM4" 7 "Aux PWM5" DEFAULT_VALUE "UNKNOWN" /end COMPU_VTAB
/begin CHARACTERISTIC gagedrv_per "ECT gauge driver PWM period" VALUE 0x00147b20 /* @ECU_Address@gagedrv_per@0x01001CC8@ */ ECIPP_ALIGNMENT_UWORD 210 Compu_gagedrv_per 0 209.712 /end CHARACTERISTIC
/begin COMPU_METHOD Compu_gagedrv_per " " RAT_FUNC "%.2" "ms" COEFFS 0 312.5 0 0 0 1 /end COMPU_METHOD
/begin MEASUREMENT gagedrv_DC "ECT gauge driver duty-cycle" UWORD Compu_gagedrv_DC 0 0 0 99.9984741210938 ECU_ADDRESS 0x01001CD0 /end MEASUREMENT
/begin COMPU_METHOD Compu_gagedrv_DC " " RAT_FUNC "%.1" "%" COEFFS 0 655.36 0 0 0 1 /end COMPU_METHOD
/begin MEASUREMENT gagedrv_manual "Gauge driver mode{gagedrv_manual&0xff=0:Automatic}{gagedrv_manual&0xff=1:Manual}" UBYTE gagedrv_manual_COMPU_VTAB 0 0 0 255 ECU_ADDRESS 0x01001CD8 BIT_MASK 0xff /end MEASUREMENT
/begin COMPU_METHOD gagedrv_manual_COMPU_VTAB "Verbal Table" TAB_VERB "%.0" "list" COMPU_TAB_REF gagedrv_manual_COMPU_VTAB_REF /end COMPU_METHOD
/begin COMPU_VTAB gagedrv_manual_COMPU_VTAB_REF "Verbal Table" TAB_VERB 2 0 "Automatic" 1 "Manual" DEFAULT_VALUE "UNKNOWN" /end COMPU_VTAB
/begin CHARACTERISTIC gov_max_abslimit "Governor speed range absolute max" VALUE 0x00147b28 /* @ECU_Address@gov_max_abslimit@0x010021F0@ */ ECIPP_ALIGNMENT_UWORD 65535 Compu_gov_max_abslimit 0 65535 /end CHARACTERISTIC
/begin COMPU_METHOD Compu_gov_max_abslimit " " RAT_FUNC "%.0" "rpm" COEFFS 0 1 0 0 0 1 /end COMPU_METHOD
/begin CHARACTERISTIC gov_min_abslimit "Governor speed range absolute min" VALUE 0x00147b2a /* @ECU_Address@gov_min_abslimit@0x010021F8@ */ ECIPP_ALIGNMENT_UWORD 65535 Compu_gov_min_abslimit 0 65535 /end CHARACTERISTIC
/begin COMPU_METHOD Compu_gov_min_abslimit " " RAT_FUNC "%.0" "rpm" COEFFS 0 1 0 0 0 1 /end COMPU_METHOD
/begin MEASUREMENT Gtap_rpm "Tap up/down speed control setpoint" UWORD Compu_Gtap_rpm 0 0 0 65535 ECU_ADDRESS 0x01002268 /end MEASUREMENT
/begin COMPU_METHOD Compu_Gtap_rpm " " RAT_FUNC "%.0" "rpm" COEFFS 0 1 0 0 0 1 /end COMPU_METHOD
/begin MEASUREMENT Gtap_engaged "Tap up/down speed control status{Gtap_engaged&0xff=0:Not Active}{Gtap_engaged&0xff=1:Active}" UBYTE Gtap_engaged_COMPU_VTAB 0 0 0 255 ECU_ADDRESS 0x01002270 BIT_MASK 0xff /end MEASUREMENT
/begin COMPU_METHOD Gtap_engaged_COMPU_VTAB "Verbal Table" TAB_VERB "%.0" "list" COMPU_TAB_REF Gtap_engaged_COMPU_VTAB_REF /end COMPU_METHOD
/begin COMPU_VTAB Gtap_engaged_COMPU_VTAB_REF "Verbal Table" TAB_VERB 2 0 "Not Active" 1 "Active" DEFAULT_VALUE "UNKNOWN" /end COMPU_VTAB
/begin CHARACTERISTIC Gtap_ena "Tap up/down speed control{Gtap_ena&0xff=0:Disabled}{Gtap_ena&0xff=1:Enabled}" VALUE 0x00147da9 /* @ECU_Address@Gtap_ena@0x01002278@ */ ECIPP_ALIGNMENT_UBYTE 255 Gtap_ena_COMPU_VTAB 0 255 BIT_MASK 0xff /end CHARACTERISTIC
/begin COMPU_METHOD Gtap_ena_COMPU_VTAB "Verbal Table" TAB_VERB "%.0" "list" COMPU_TAB_REF Gtap_ena_COMPU_VTAB_REF /end COMPU_METHOD
/begin COMPU_VTAB Gtap_ena_COMPU_VTAB_REF "Verbal Table" TAB_VERB 2 0 "Disabled" 1 "Enabled" DEFAULT_VALUE "UNKNOWN" /end COMPU_VTAB
/begin CHARACTERISTIC Gtap_min_rpm "Tap up/down minimum speed" VALUE 0x00147446 /* @ECU_Address@Gtap_min_rpm@0x01002280@ */ ECIPP_ALIGNMENT_UWORD 65535 Compu_Gtap_min_rpm 0 65535 /end CHARACTERISTIC
/begin COMPU_METHOD Compu_Gtap_min_rpm " " RAT_FUNC "%.0" "rpm" COEFFS 0 1 0 0 0 1 /end COMPU_METHOD
/begin CHARACTERISTIC Gtap_max_rpm "Tap up/down maximum speed" VALUE 0x00147444 /* @ECU_Address@Gtap_max_rpm@0x01002288@ */ ECIPP_ALIGNMENT_UWORD 65535 Compu_Gtap_max_rpm 0 65535 /end CHARACTERISTIC
/begin COMPU_METHOD Compu_Gtap_max_rpm " " RAT_FUNC "%.0" "rpm" COEFFS 0 1 0 0 0 1 /end COMPU_METHOD
/begin CHARACTERISTIC Gtap_1tap_rpm "Single-tap speed step change" VALUE 0x00147442 /* @ECU_Address@Gtap_1tap_rpm@0x01002290@ */ ECIPP_ALIGNMENT_UWORD 65535 Compu_Gtap_1tap_rpm 0 65535 /end CHARACTERISTIC
/begin COMPU_METHOD Compu_Gtap_1tap_rpm " " RAT_FUNC "%.0" "rpm" COEFFS 0 1 0 0 0 1 /end COMPU_METHOD
/begin CHARACTERISTIC Gtap_ramp_delay "Button-hold delay before ramping speed" VALUE 0x00147448 /* @ECU_Address@Gtap_ramp_delay@0x01002298@ */ ECIPP_ALIGNMENT_UWORD 66 Compu_Gtap_ramp_delay 0 65.535 /end CHARACTERISTIC
/begin COMPU_METHOD Compu_Gtap_ramp_delay " " RAT_FUNC "%.3" "sec" COEFFS 0 1000 0 0 0 1 /end COMPU_METHOD
/begin CHARACTERISTIC Gtap_ramp_phase "Button-hold speed ramping phase-in" VALUE 0x0014744c /* @ECU_Address@Gtap_ramp_phase@0x010022A0@ */ ECIPP_ALIGNMENT_UWORD 66 Compu_Gtap_ramp_phase 0 65.535 /end CHARACTERISTIC
/begin COMPU_METHOD Compu_Gtap_ramp_phase " " RAT_FUNC "%.3" "sec" COEFFS 0 1000 0 0 0 1 /end COMPU_METHOD
/begin CHARACTERISTIC Gtap_ramp_final "Button-hold speed ramping max rate" VALUE 0x0014744a /* @ECU_Address@Gtap_ramp_final@0x010022A8@ */ ECIPP_ALIGNMENT_UWORD 65535 Compu_Gtap_ramp_final 0 65535 /end CHARACTERISTIC
/begin COMPU_METHOD Compu_Gtap_ramp_final " " RAT_FUNC "%.0" "rpm/sec" COEFFS 0 1 0 0 0 1 /end COMPU_METHOD
/begin MEASUREMENT AUX_PU2_raw "AUX_PU2_raw" UWORD Compu_AUX_PU2_raw 0 0 0 5.00114468864469 ECU_ADDRESS 0x01002700 /end MEASUREMENT
/begin COMPU_METHOD Compu_AUX_PU2_raw " " RAT_FUNC "%.3" "volts" COEFFS 0 13104 0 0 0 1 /end COMPU_METHOD
/begin MEASUREMENT AUX_PU3_raw "AUX_PU3_raw" UWORD Compu_AUX_PU3_raw 0 0 0 5.00114468864469 ECU_ADDRESS 0x01002708 /end MEASUREMENT
/begin COMPU_METHOD Compu_AUX_PU3_raw " " RAT_FUNC "%.3" "volts" COEFFS 0 13104 0 0 0 1 /end COMPU_METHOD
/begin MEASUREMENT AUX_PD2_raw "AUX_PD2_raw" UWORD Compu_AUX_PD2_raw 0 0 0 5.00114468864469 ECU_ADDRESS 0x01002710 /end MEASUREMENT
/begin COMPU_METHOD Compu_AUX_PD2_raw " " RAT_FUNC "%.3" "volts" COEFFS 0 13104 0 0 0 1 /end COMPU_METHOD
/begin MEASUREMENT AUX_PD3_raw "AUX_PD3_raw" UWORD Compu_AUX_PD3_raw 0 0 0 5.00114468864469 ECU_ADDRESS 0x01002718 /end MEASUREMENT
/begin COMPU_METHOD Compu_AUX_PD3_raw " " RAT_FUNC "%.3" "volts" COEFFS 0 13104 0 0 0 1 /end COMPU_METHOD
/begin CHARACTERISTIC IdleFPP_ena "FPP based idle speed control{IdleFPP_ena&0xff=0:Disabled}{IdleFPP_ena&0xff=1:Enabled}" VALUE 0x00147de3 /* @ECU_Address@IdleFPP_ena@0x01002870@ */ ECIPP_ALIGNMENT_UBYTE 255 IdleFPP_ena_COMPU_VTAB 0 255 BIT_MASK 0xff /end CHARACTERISTIC
/begin COMPU_METHOD IdleFPP_ena_COMPU_VTAB "Verbal Table" TAB_VERB "%.0" "list" COMPU_TAB_REF IdleFPP_ena_COMPU_VTAB_REF /end COMPU_METHOD
/begin COMPU_VTAB IdleFPP_ena_COMPU_VTAB_REF "Verbal Table" TAB_VERB 2 0 "Disabled" 1 "Enabled" DEFAULT_VALUE "UNKNOWN" /end COMPU_VTAB
/begin CHARACTERISTIC IdleFPP_min "FPP idle lower FPP" VALUE 0x001474d2 /* @ECU_Address@IdleFPP_min@0x01002878@ */ ECIPP_ALIGNMENT_UWORD 100 Compu_IdleFPP_min 0 99.9984741210938 /end CHARACTERISTIC
/begin COMPU_METHOD Compu_IdleFPP_min " " RAT_FUNC "%.1" "%" COEFFS 0 655.36 0 0 0 1 /end COMPU_METHOD
/begin CHARACTERISTIC IdleFPP_max "FPP idle upper FPP" VALUE 0x001474d0 /* @ECU_Address@IdleFPP_max@0x01002880@ */ ECIPP_ALIGNMENT_UWORD 100 Compu_IdleFPP_max 0 99.9984741210938 /end CHARACTERISTIC
/begin COMPU_METHOD Compu_IdleFPP_max " " RAT_FUNC "%.1" "%" COEFFS 0 655.36 0 0 0 1 /end COMPU_METHOD
/begin CHARACTERISTIC IdleFPP_rpmdelta "FPP idle speed range delta" VALUE 0x001474d4 /* @ECU_Address@IdleFPP_rpmdelta@0x01002888@ */ ECIPP_ALIGNMENT_UWORD 65535 Compu_IdleFPP_rpmdelta 0 65535 /end CHARACTERISTIC
/begin COMPU_METHOD Compu_IdleFPP_rpmdelta " " RAT_FUNC "%.0" "rpm" COEFFS 0 1 0 0 0 1 /end COMPU_METHOD
/begin CHARACTERISTIC IdleFPP_rpmmax "FPP idle maximum speed target" VALUE 0x001474d6 /* @ECU_Address@IdleFPP_rpmmax@0x01002890@ */ ECIPP_ALIGNMENT_UWORD 65535 Compu_IdleFPP_rpmmax 0 65535 /end CHARACTERISTIC
/begin COMPU_METHOD Compu_IdleFPP_rpmmax " " RAT_FUNC "%.0" "rpm" COEFFS 0 1 0 0 0 1 /end COMPU_METHOD
/begin CHARACTERISTIC IdleFPP_loadadd "FPP idle droop load delta" VALUE 0x00144330 /* @ECU_Address@IdleFPP_loadadd@0x01002898@ */ ECIPP_ALIGNMENT_SWORD 800 Compu_IdleFPP_loadadd -800 799.9755859375 /end CHARACTERISTIC
/begin COMPU_METHOD Compu_IdleFPP_loadadd " " RAT_FUNC "%.1" "%" COEFFS 0 40.96 0 0 0 1 /end COMPU_METHOD
/begin CHARACTERISTIC Gov3_gain_slct "Gov3 gain selection{Gov3_gain_slct&0xff=0:Std - Set 1}{Gov3_gain_slct&0xff=1:Alt - Set 1}{Gov3_gain_slct&0xff=2:Fuel Based}{Gov3_gain_slct&0xff=3:Std - Set 2}{Gov3_gain_slct&0xff=4:Alt - Set 2}" VALUE 0x00148E65 /* @ECU_Address@Gov3_gain_slct@0x01002C28@ */ ECIPP_ALIGNMENT_UBYTE 255 Gov3_gain_slct_COMPU_VTAB 0 255 BIT_MASK 0xff /end CHARACTERISTIC
/begin COMPU_METHOD Gov3_gain_slct_COMPU_VTAB "Verbal Table" TAB_VERB "%.0" "list" COMPU_TAB_REF Gov3_gain_slct_COMPU_VTAB_REF /end COMPU_METHOD
/begin COMPU_VTAB Gov3_gain_slct_COMPU_VTAB_REF "Verbal Table" TAB_VERB 5 0 "Std - Set 1" 1 "Alt - Set 1" 2 "Fuel Based" 3 "Std - Set 2" 4 "Alt - Set 2" DEFAULT_VALUE "UNKNOWN" /end COMPU_VTAB
/begin CHARACTERISTIC Gov2_gain_slct "Gov2 gain selection{Gov2_gain_slct&0xff=0:Std - Set 1}{Gov2_gain_slct&0xff=1:Alt - Set 1}{Gov2_gain_slct&0xff=2:Fuel Based}{Gov2_gain_slct&0xff=3:Std - Set 2}{Gov2_gain_slct&0xff=4:Alt - Set 2}" VALUE 0x00148E39 /* @ECU_Address@Gov2_gain_slct@0x01002C30@ */ ECIPP_ALIGNMENT_UBYTE 255 Gov2_gain_slct_COMPU_VTAB 0 255 BIT_MASK 0xff /end CHARACTERISTIC
/begin COMPU_METHOD Gov2_gain_slct_COMPU_VTAB "Verbal Table" TAB_VERB "%.0" "list" COMPU_TAB_REF Gov2_gain_slct_COMPU_VTAB_REF /end COMPU_METHOD
/begin COMPU_VTAB Gov2_gain_slct_COMPU_VTAB_REF "Verbal Table" TAB_VERB 5 0 "Std - Set 1" 1 "Alt - Set 1" 2 "Fuel Based" 3 "Std - Set 2" 4 "Alt - Set 2" DEFAULT_VALUE "UNKNOWN" /end COMPU_VTAB
/begin CHARACTERISTIC Gov1_gain_slct "Gov1 gain selection{Gov1_gain_slct&0xff=0:Std - Set 1}{Gov1_gain_slct&0xff=1:Alt - Set 1}{Gov1_gain_slct&0xff=2:Fuel Based}{Gov1_gain_slct&0xff=3:Std - Set 2}{Gov1_gain_slct&0xff=4:Alt - Set 2}" VALUE 0x00148E0D /* @ECU_Address@Gov1_gain_slct@0x01002C38@ */ ECIPP_ALIGNMENT_UBYTE 255 Gov1_gain_slct_COMPU_VTAB 0 255 BIT_MASK 0xff /end CHARACTERISTIC
/begin COMPU_METHOD Gov1_gain_slct_COMPU_VTAB "Verbal Table" TAB_VERB "%.0" "list" COMPU_TAB_REF Gov1_gain_slct_COMPU_VTAB_REF /end COMPU_METHOD
/begin COMPU_VTAB Gov1_gain_slct_COMPU_VTAB_REF "Verbal Table" TAB_VERB 5 0 "Std - Set 1" 1 "Alt - Set 1" 2 "Fuel Based" 3 "Std - Set 2" 4 "Alt - Set 2" DEFAULT_VALUE "UNKNOWN" /end COMPU_VTAB
/begin CHARACTERISTIC maxgv_gain_slct "MaxGv gain selection{maxgv_gain_slct&0xff=0:Std - Set 1}{maxgv_gain_slct&0xff=1:Alt - Set 1}{maxgv_gain_slct&0xff=2:Fuel Based}{maxgv_gain_slct&0xff=3:Std - Set 2}{maxgv_gain_slct&0xff=4:Alt - Set 2}" VALUE 0x00148E91 /* @ECU_Address@maxgv_gain_slct@0x01002C40@ */ ECIPP_ALIGNMENT_UBYTE 255 maxgv_gain_slct_COMPU_VTAB 0 255 BIT_MASK 0xff /end CHARACTERISTIC
/begin COMPU_METHOD maxgv_gain_slct_COMPU_VTAB "Verbal Table" TAB_VERB "%.0" "list" COMPU_TAB_REF maxgv_gain_slct_COMPU_VTAB_REF /end COMPU_METHOD
/begin COMPU_VTAB maxgv_gain_slct_COMPU_VTAB_REF "Verbal Table" TAB_VERB 5 0 "Std - Set 1" 1 "Alt - Set 1" 2 "Fuel Based" 3 "Std - Set 2" 4 "Alt - Set 2" DEFAULT_VALUE "UNKNOWN" /end COMPU_VTAB
/begin CHARACTERISTIC mingv_gain_slct "MinGv gain selection{mingv_gain_slct&0xff=0:Std - Set 1}{mingv_gain_slct&0xff=1:Alt - Set 1}{mingv_gain_slct&0xff=2:Fuel Based}{mingv_gain_slct&0xff=3:Std - Set 2}{mingv_gain_slct&0xff=4:Alt - Set 2}" VALUE 0x00148EB1 /* @ECU_Address@mingv_gain_slct@0x01002C48@ */ ECIPP_ALIGNMENT_UBYTE 255 mingv_gain_slct_COMPU_VTAB 0 255 BIT_MASK 0xff /end CHARACTERISTIC
/begin COMPU_METHOD mingv_gain_slct_COMPU_VTAB "Verbal Table" TAB_VERB "%.0" "list" COMPU_TAB_REF mingv_gain_slct_COMPU_VTAB_REF /end COMPU_METHOD
/begin COMPU_VTAB mingv_gain_slct_COMPU_VTAB_REF "Verbal Table" TAB_VERB 5 0 "Std - Set 1" 1 "Alt - Set 1" 2 "Fuel Based" 3 "Std - Set 2" 4 "Alt - Set 2" DEFAULT_VALUE "UNKNOWN" /end COMPU_VTAB
/begin CHARACTERISTIC MaxSetPt_Gov3 "User setpoint max speed parameters{MaxSetPt_Gov3&0xff=0:Default - Max Gov Params}{MaxSetPt_Gov3&0xff=1:Use Gov3 Params}" VALUE 0x00147e82 /* @ECU_Address@MaxSetPt_Gov3@0x01002C50@ */ ECIPP_ALIGNMENT_UBYTE 255 MaxSetPt_Gov3_COMPU_VTAB 0 255 BIT_MASK 0xff /end CHARACTERISTIC
/begin COMPU_METHOD MaxSetPt_Gov3_COMPU_VTAB "Verbal Table" TAB_VERB "%.0" "list" COMPU_TAB_REF MaxSetPt_Gov3_COMPU_VTAB_REF /end COMPU_METHOD
/begin COMPU_VTAB MaxSetPt_Gov3_COMPU_VTAB_REF "Verbal Table" TAB_VERB 2 0 "Default - Max Gov Params" 1 "Use Gov3 Params" DEFAULT_VALUE "UNKNOWN" /end COMPU_VTAB
/begin CHARACTERISTIC minigv_Iinit_ena "minigv_Iinit_ena{minigv_Iinit_ena&0xff=0x00:Disabled}{minigv_Iinit_ena&0xff=0x01:Enabled}" VALUE 0x00148EB2 /* @ECU_Address@minigv_Iinit_ena@0x01002C58@ */ ECIPP_ALIGNMENT_UBYTE 255 minigv_Iinit_ena_COMPU_VTAB 0 255 BIT_MASK 0xff /end CHARACTERISTIC
/begin COMPU_METHOD minigv_Iinit_ena_COMPU_VTAB "Verbal Table" TAB_VERB "%.0" "list" COMPU_TAB_REF minigv_Iinit_ena_COMPU_VTAB_REF /end COMPU_METHOD
/begin COMPU_VTAB minigv_Iinit_ena_COMPU_VTAB_REF "Verbal Table" TAB_VERB 2 0x00 "Disabled" 0x01 "Enabled" DEFAULT_VALUE "UNKNOWN" /end COMPU_VTAB
/begin CHARACTERISTIC maxigv_Iinit_ena "maxigv_Iinit_ena{maxigv_Iinit_ena&0xff=0x00:Disabled}{maxigv_Iinit_ena&0xff=0x01:Enabled}" VALUE 0x00148E92 /* @ECU_Address@maxigv_Iinit_ena@0x01002C60@ */ ECIPP_ALIGNMENT_UBYTE 255 maxigv_Iinit_ena_COMPU_VTAB 0 255 BIT_MASK 0xff /end CHARACTERISTIC
/begin COMPU_METHOD maxigv_Iinit_ena_COMPU_VTAB "Verbal Table" TAB_VERB "%.0" "list" COMPU_TAB_REF maxigv_Iinit_ena_COMPU_VTAB_REF /end COMPU_METHOD
/begin COMPU_VTAB maxigv_Iinit_ena_COMPU_VTAB_REF "Verbal Table" TAB_VERB 2 0x00 "Disabled" 0x01 "Enabled" DEFAULT_VALUE "UNKNOWN" /end COMPU_VTAB
/begin CHARACTERISTIC Gov1i_Iinit_ena "Gov1i_Iinit_ena{Gov1i_Iinit_ena&0xff=0x00:Disabled}{Gov1i_Iinit_ena&0xff=0x01:Enabled}" VALUE 0x00148E0E /* @ECU_Address@Gov1i_Iinit_ena@0x01002C68@ */ ECIPP_ALIGNMENT_UBYTE 255 Gov1i_Iinit_ena_COMPU_VTAB 0 255 BIT_MASK 0xff /end CHARACTERISTIC
/begin COMPU_METHOD Gov1i_Iinit_ena_COMPU_VTAB "Verbal Table" TAB_VERB "%.0" "list" COMPU_TAB_REF Gov1i_Iinit_ena_COMPU_VTAB_REF /end COMPU_METHOD
/begin COMPU_VTAB Gov1i_Iinit_ena_COMPU_VTAB_REF "Verbal Table" TAB_VERB 2 0x00 "Disabled" 0x01 "Enabled" DEFAULT_VALUE "UNKNOWN" /end COMPU_VTAB
/begin CHARACTERISTIC Gov2i_Iinit_ena "Gov2i_Iinit_ena{Gov2i_Iinit_ena&0xff=0x00:Disabled}{Gov2i_Iinit_ena&0xff=0x01:Enabled}" VALUE 0x00148E3A /* @ECU_Address@Gov2i_Iinit_ena@0x01002C70@ */ ECIPP_ALIGNMENT_UBYTE 255 Gov2i_Iinit_ena_COMPU_VTAB 0 255 BIT_MASK 0xff /end CHARACTERISTIC
/begin COMPU_METHOD Gov2i_Iinit_ena_COMPU_VTAB "Verbal Table" TAB_VERB "%.0" "list" COMPU_TAB_REF Gov2i_Iinit_ena_COMPU_VTAB_REF /end COMPU_METHOD
/begin COMPU_VTAB Gov2i_Iinit_ena_COMPU_VTAB_REF "Verbal Table" TAB_VERB 2 0x00 "Disabled" 0x01 "Enabled" DEFAULT_VALUE "UNKNOWN" /end COMPU_VTAB
/begin CHARACTERISTIC Gov3i_Iinit_ena "Gov3i_Iinit_ena{Gov3i_Iinit_ena&0xff=0x00:Disabled}{Gov3i_Iinit_ena&0xff=0x01:Enabled}" VALUE 0x00148E66 /* @ECU_Address@Gov3i_Iinit_ena@0x01002C78@ */ ECIPP_ALIGNMENT_UBYTE 255 Gov3i_Iinit_ena_COMPU_VTAB 0 255 BIT_MASK 0xff /end CHARACTERISTIC
/begin COMPU_METHOD Gov3i_Iinit_ena_COMPU_VTAB "Verbal Table" TAB_VERB "%.0" "list" COMPU_TAB_REF Gov3i_Iinit_ena_COMPU_VTAB_REF /end COMPU_METHOD
/begin COMPU_VTAB Gov3i_Iinit_ena_COMPU_VTAB_REF "Verbal Table" TAB_VERB 2 0x00 "Disabled" 0x01 "Enabled" DEFAULT_VALUE "UNKNOWN" /end COMPU_VTAB
/begin MEASUREMENT MaxSetPt_rpm "Max engine speed control setpoint" UWORD Compu_MaxSetPt_rpm 0 0 0 65535 ECU_ADDRESS 0x01002C80 /end MEASUREMENT
/begin COMPU_METHOD Compu_MaxSetPt_rpm " " RAT_FUNC "%.0" "rpm" COEFFS 0 1 0 0 0 1 /end COMPU_METHOD
/begin MEASUREMENT MaxSetPt_engaged "Max speed user setpoint status{MaxSetPt_engaged&0xff=0:Idle}{MaxSetPt_engaged&0xff=1:Active}" UBYTE MaxSetPt_engaged_COMPU_VTAB 0 0 0 255 ECU_ADDRESS 0x01002C88 BIT_MASK 0xff /end MEASUREMENT
/begin COMPU_METHOD MaxSetPt_engaged_COMPU_VTAB "Verbal Table" TAB_VERB "%.0" "list" COMPU_TAB_REF MaxSetPt_engaged_COMPU_VTAB_REF /end COMPU_METHOD
/begin COMPU_VTAB MaxSetPt_engaged_COMPU_VTAB_REF "Verbal Table" TAB_VERB 2 0 "Idle" 1 "Active" DEFAULT_VALUE "UNKNOWN" /end COMPU_VTAB
/begin MEASUREMENT MaxSetPt_switch "Off/RPM/RS state{MaxSetPt_switch&0xff=0:Off}{MaxSetPt_switch&0xff=1:RPM Control}{MaxSetPt_switch&0xff=2:Vehicle Speed Control}" UBYTE MaxSetPt_switch_COMPU_VTAB 0 0 0 255 ECU_ADDRESS 0x01002C90 BIT_MASK 0xff /end MEASUREMENT
/begin COMPU_METHOD MaxSetPt_switch_COMPU_VTAB "Verbal Table" TAB_VERB "%.0" "list" COMPU_TAB_REF MaxSetPt_switch_COMPU_VTAB_REF /end COMPU_METHOD
/begin COMPU_VTAB MaxSetPt_switch_COMPU_VTAB_REF "Verbal Table" TAB_VERB 3 0 "Off" 1 "RPM Control" 2 "Vehicle Speed Control" DEFAULT_VALUE "UNKNOWN" /end COMPU_VTAB
/begin CHARACTERISTIC MaxSetPt_ena "Max speed user setpoint - Primary{MaxSetPt_ena&0xff=0:Disabled}{MaxSetPt_ena&0xff=1:Enabled by Aux PU1 active=RPM}{MaxSetPt_ena&0xff=2:Enabled by Aux PU2 active=RPM}{MaxSetPt_ena&0xff=3:Enabled by Aux PU3 active=RPM}{MaxSetPt_ena&0xff=4:Enabled by Aux DIG" VALUE 0x00147e84 /* @ECU_Address@MaxSetPt_ena@0x01002C98@ */ ECIPP_ALIGNMENT_UBYTE 255 MaxSetPt_ena_COMPU_VTAB 0 255 BIT_MASK 0xff /end CHARACTERISTIC
/begin COMPU_METHOD MaxSetPt_ena_COMPU_VTAB "Verbal Table" TAB_VERB "%.0" "list" COMPU_TAB_REF MaxSetPt_ena_COMPU_VTAB_REF /end COMPU_METHOD
/begin COMPU_VTAB MaxSetPt_ena_COMPU_VTAB_REF "Verbal Table" TAB_VERB 14 0 "Disabled" 1 "Enabled by Aux PU1 active=RPM" 2 "Enabled by Aux PU2 active=RPM" 3 "Enabled by Aux PU3 active=RPM" 4 "Enabled by Aux DIG1" 5 "Enabled by Aux DIG2" 6 "Enabled by Aux DIG3" 7 "Network Switch" 8 "Software Switch" 9 "Enabled by Aux PU2 w/ DIG2=Open" 10 "Enabled by Aux PU2 w/ DIG2=Gnd" 11 "Enabled by Aux PU1 active=RS" 12 "Enabled by Aux PU2 active=RS" 13 "Enabled by Aux PU3 active=RS" DEFAULT_VALUE "UNKNOWN" /end COMPU_VTAB
/begin CHARACTERISTIC MSP_min_rpm "Minimum settable RPM" VALUE 0x0014763c /* @ECU_Address@MSP_min_rpm@0x01002CA0@ */ ECIPP_ALIGNMENT_UWORD 65535 Compu_MSP_min_rpm 0 65535 /end CHARACTERISTIC
/begin COMPU_METHOD Compu_MSP_min_rpm " " RAT_FUNC "%.0" "rpm" COEFFS 0 1 0 0 0 1 /end COMPU_METHOD
/begin CHARACTERISTIC MSP_max_rpm "Maximum settable RPM" VALUE 0x00147638 /* @ECU_Address@MSP_max_rpm@0x01002CA8@ */ ECIPP_ALIGNMENT_UWORD 65535 Compu_MSP_max_rpm 0 65535 /end CHARACTERISTIC
/begin COMPU_METHOD Compu_MSP_max_rpm " " RAT_FUNC "%.0" "rpm" COEFFS 0 1 0 0 0 1 /end COMPU_METHOD
/begin CHARACTERISTIC MSP_1tap_rpm "Single-tap RPM step change" VALUE 0x00147634 /* @ECU_Address@MSP_1tap_rpm@0x01002CB0@ */ ECIPP_ALIGNMENT_UWORD 65535 Compu_MSP_1tap_rpm 0 65535 /end CHARACTERISTIC
/begin COMPU_METHOD Compu_MSP_1tap_rpm " " RAT_FUNC "%.0" "rpm" COEFFS 0 1 0 0 0 1 /end COMPU_METHOD
/begin CHARACTERISTIC MSP_ramp_delay "Button-hold delay before ramping speed" VALUE 0x00147648 /* @ECU_Address@MSP_ramp_delay@0x01002CB8@ */ ECIPP_ALIGNMENT_UWORD 66 Compu_MSP_ramp_delay 0 65.535 /end CHARACTERISTIC
/begin COMPU_METHOD Compu_MSP_ramp_delay " " RAT_FUNC "%.3" "sec" COEFFS 0 1000 0 0 0 1 /end COMPU_METHOD
/begin CHARACTERISTIC MSP_ramp_phase "Button-hold speed ramping phase-in" VALUE 0x0014764c /* @ECU_Address@MSP_ramp_phase@0x01002CC0@ */ ECIPP_ALIGNMENT_UWORD 66 Compu_MSP_ramp_phase 0 65.535 /end CHARACTERISTIC
/begin COMPU_METHOD Compu_MSP_ramp_phase " " RAT_FUNC "%.3" "sec" COEFFS 0 1000 0 0 0 1 /end COMPU_METHOD
/begin CHARACTERISTIC MSP_ramp_final "Button-hold RPM ramping max rate" VALUE 0x0014764a /* @ECU_Address@MSP_ramp_final@0x01002CC8@ */ ECIPP_ALIGNMENT_UWORD 65535 Compu_MSP_ramp_final 0 65535 /end CHARACTERISTIC
/begin COMPU_METHOD Compu_MSP_ramp_final " " RAT_FUNC "%.0" "rpm/sec" COEFFS 0 1 0 0 0 1 /end COMPU_METHOD
/begin MEASUREMENT MSP_incdec_sw "Increase/decrease switch{MSP_incdec_sw&0xff=255:Decrease}{MSP_incdec_sw&0xff=0:-}{MSP_incdec_sw&0xff=1:Increase}" UBYTE MSP_incdec_sw_COMPU_VTAB 0 0 0 255 ECU_ADDRESS 0x01002CD0 BIT_MASK 0xff /end MEASUREMENT
/begin COMPU_METHOD MSP_incdec_sw_COMPU_VTAB "Verbal Table" TAB_VERB "%.0" "list" COMPU_TAB_REF MSP_incdec_sw_COMPU_VTAB_REF /end COMPU_METHOD
/begin COMPU_VTAB MSP_incdec_sw_COMPU_VTAB_REF "Verbal Table" TAB_VERB 3 255 "Decrease" 0 "-" 1 "Increase" DEFAULT_VALUE "UNKNOWN" /end COMPU_VTAB
/begin MEASUREMENT MSP_setclr_sw "Set/Clear switch{MSP_setclr_sw&0xff=255:Clear}{MSP_setclr_sw&0xff=0:-}{MSP_setclr_sw&0xff=1:Set}" UBYTE MSP_setclr_sw_COMPU_VTAB 0 0 0 255 ECU_ADDRESS 0x01002CD8 BIT_MASK 0xff /end MEASUREMENT
/begin COMPU_METHOD MSP_setclr_sw_COMPU_VTAB "Verbal Table" TAB_VERB "%.0" "list" COMPU_TAB_REF MSP_setclr_sw_COMPU_VTAB_REF /end COMPU_METHOD
/begin COMPU_VTAB MSP_setclr_sw_COMPU_VTAB_REF "Verbal Table" TAB_VERB 3 255 "Clear" 0 "-" 1 "Set" DEFAULT_VALUE "UNKNOWN" /end COMPU_VTAB
/begin MEASUREMENT Kiv_gov "Kiv_rpm gain" SWORD Compu_Kiv_gov 0 0 -6250 6249.80926513672 ECU_ADDRESS 0x01002D18 /end MEASUREMENT
/begin COMPU_METHOD Compu_Kiv_gov " " RAT_FUNC "%.1" "% / krpm" COEFFS 0 5.24288 0 0 0 1 /end COMPU_METHOD
/begin MEASUREMENT Kiv_gov_mult "Kiv ECT attenuator" UWORD Compu_Kiv_gov_mult 0 0 0 15.999755859375 ECU_ADDRESS 0x01002D20 /end MEASUREMENT
/begin COMPU_METHOD Compu_Kiv_gov_mult " " RAT_FUNC "%.3" "fraction" COEFFS 0 4096 0 0 0 1 /end COMPU_METHOD
/begin MEASUREMENT AUX_PUD1_raw "AUX_PUD1_raw" UWORD Compu_AUX_PUD1_raw 0 0 0 5.00114468864469 ECU_ADDRESS 0x01002E18 /end MEASUREMENT
/begin COMPU_METHOD Compu_AUX_PUD1_raw " " RAT_FUNC "%.3" "volts" COEFFS 0 13104 0 0 0 1 /end COMPU_METHOD
/begin MEASUREMENT AUX_PUD2_raw "AUX_PUD2_raw" UWORD Compu_AUX_PUD2_raw 0 0 0 5.00114468864469 ECU_ADDRESS 0x01002E20 /end MEASUREMENT
/begin COMPU_METHOD Compu_AUX_PUD2_raw " " RAT_FUNC "%.3" "volts" COEFFS 0 13104 0 0 0 1 /end COMPU_METHOD
/begin MEASUREMENT AUX_PUD3_raw "AUX_PUD3_raw" UWORD Compu_AUX_PUD3_raw 0 0 0 5.00114468864469 ECU_ADDRESS 0x01002E28 /end MEASUREMENT
/begin COMPU_METHOD Compu_AUX_PUD3_raw " " RAT_FUNC "%.3" "volts" COEFFS 0 13104 0 0 0 1 /end COMPU_METHOD
/begin CHARACTERISTIC ECTgd_ctl_type "ECT gauge driver control type{ECTgd_ctl_type&0xff=0:Duty-cycle PWM}{ECTgd_ctl_type&0xff=1:Resistance Simulation}" VALUE 0x00147d1f /* @ECU_Address@ECTgd_ctl_type@0x01002F70@ */ ECIPP_ALIGNMENT_UBYTE 255 ECTgd_ctl_type_COMPU_VTAB 0 255 BIT_MASK 0xff /end CHARACTERISTIC
/begin COMPU_METHOD ECTgd_ctl_type_COMPU_VTAB "Verbal Table" TAB_VERB "%.0" "list" COMPU_TAB_REF ECTgd_ctl_type_COMPU_VTAB_REF /end COMPU_METHOD
/begin COMPU_VTAB ECTgd_ctl_type_COMPU_VTAB_REF "Verbal Table" TAB_VERB 2 0 "Duty-cycle PWM" 1 "Resistance Simulation" DEFAULT_VALUE "UNKNOWN" /end COMPU_VTAB
/begin CHARACTERISTIC ECTgd_Rpu_tau "ECT gauge resistance ctrl tau" VALUE 0x00147bd2 /* @ECU_Address@ECTgd_Rpu_tau@0x01002F78@ */ ECIPP_ALIGNMENT_UWORD 3276795 Compu_ECTgd_Rpu_tau 4.5084 3276800 /end CHARACTERISTIC
/begin COMPU_METHOD Compu_ECTgd_Rpu_tau " " FORM "%.0" "ms"
 /begin FORMULA "-50 / log(1 - (X1 / 65536))" FORMULA_INV "(1 - exp(-50/X1)) * 65536" /end FORMULA
/end COMPU_METHOD
/begin CHARACTERISTIC Vsw_gauge_tau "Gauge excitation voltage low-pass" VALUE 0x00147ca2 /* @ECU_Address@Vsw_gauge_tau@0x01002F80@ */ ECIPP_ALIGNMENT_UWORD 327680 Compu_Vsw_gauge_tau 0.45084 327680 /end CHARACTERISTIC
/begin COMPU_METHOD Compu_Vsw_gauge_tau " " FORM "%.0" "ms"
 /begin FORMULA "-5 / log(1 - (X1 / 65536))" FORMULA_INV "(1 - exp(-5/X1)) * 65536" /end FORMULA
/end COMPU_METHOD
/begin CHARACTERISTIC ECTgd_Rpu_def "ECT gauge driver initial pullup R" VALUE 0x001467c2 /* @ECU_Address@ECTgd_Rpu_def@0x01002F88@ */ ECIPP_ALIGNMENT_UWORD 8192 Compu_ECTgd_Rpu_def 0 8191.875 /end CHARACTERISTIC
/begin COMPU_METHOD Compu_ECTgd_Rpu_def " " RAT_FUNC "%.1" "ohms" COEFFS 0 8 0 0 0 1 /end COMPU_METHOD
/begin MEASUREMENT ECTgd_Rpu "ECT gauge pullup R estimate" UWORD Compu_ECTgd_Rpu 0 0 0 8191.875 ECU_ADDRESS 0x01002F90 /end MEASUREMENT
/begin COMPU_METHOD Compu_ECTgd_Rpu " " RAT_FUNC "%.1" "ohms" COEFFS 0 8 0 0 0 1 /end COMPU_METHOD
/begin MEASUREMENT ECTgd_Rd "ECT gauge sender target R" UWORD Compu_ECTgd_Rd 0 0 0 8191.875 ECU_ADDRESS 0x01002F98 /end MEASUREMENT
/begin COMPU_METHOD Compu_ECTgd_Rd " " RAT_FUNC "%.1" "ohms" COEFFS 0 8 0 0 0 1 /end COMPU_METHOD
/begin MEASUREMENT ECTgd_Ra "ECT gauge sender actual R" UWORD Compu_ECTgd_Ra 0 0 0 8191.875 ECU_ADDRESS 0x01002FA0 /end MEASUREMENT
/begin COMPU_METHOD Compu_ECTgd_Ra " " RAT_FUNC "%.1" "ohms" COEFFS 0 8 0 0 0 1 /end COMPU_METHOD
/begin MEASUREMENT ECTgd_V_FB "ECT gauge sender voltage" UWORD Compu_ECTgd_V_FB 0 0 0 255.99609375 ECU_ADDRESS 0x01002FA8 /end MEASUREMENT
/begin COMPU_METHOD Compu_ECTgd_V_FB " " RAT_FUNC "%.2" "volts" COEFFS 0 256 0 0 0 1 /end COMPU_METHOD
/begin MEASUREMENT Vsw_gauge "Gauge excitation voltage estimate" UWORD Compu_Vsw_gauge 0 0 0 255.99609375 ECU_ADDRESS 0x01002FB0 /end MEASUREMENT
/begin COMPU_METHOD Compu_Vsw_gauge " " RAT_FUNC "%.2" "volts" COEFFS 0 256 0 0 0 1 /end COMPU_METHOD
/begin MEASUREMENT ECTgd_Id "ECT gauge driver current" UWORD Compu_ECTgd_Id 0 0 0 499.992370605469 ECU_ADDRESS 0x01002FB8 /end MEASUREMENT
/begin COMPU_METHOD Compu_ECTgd_Id " " RAT_FUNC "%.1" "mA" COEFFS 0 131.072 0 0 0 1 /end COMPU_METHOD
/begin CHARACTERISTIC OilPgd_ctl_type "OilP gauge driver control type{OilPgd_ctl_type&0xff=0:Duty-cycle PWM}{OilPgd_ctl_type&0xff=1:Resistance Simulation}" VALUE 0x00147ea7 /* @ECU_Address@OilPgd_ctl_type@0x01002FC0@ */ ECIPP_ALIGNMENT_UBYTE 255 OilPgd_ctl_type_COMPU_VTAB 0 255 BIT_MASK 0xff /end CHARACTERISTIC
/begin COMPU_METHOD OilPgd_ctl_type_COMPU_VTAB "Verbal Table" TAB_VERB "%.0" "list" COMPU_TAB_REF OilPgd_ctl_type_COMPU_VTAB_REF /end COMPU_METHOD
/begin COMPU_VTAB OilPgd_ctl_type_COMPU_VTAB_REF "Verbal Table" TAB_VERB 2 0 "Duty-cycle PWM" 1 "Resistance Simulation" DEFAULT_VALUE "UNKNOWN" /end COMPU_VTAB
/begin CHARACTERISTIC OilPgd_Rpu_tau "OilP gauge resistance ctrl tau" VALUE 0x00147c24 /* @ECU_Address@OilPgd_Rpu_tau@0x01002FC8@ */ ECIPP_ALIGNMENT_UWORD 3276795 Compu_OilPgd_Rpu_tau 4.5084 3276800 /end CHARACTERISTIC
/begin COMPU_METHOD Compu_OilPgd_Rpu_tau " " FORM "%.0" "ms"
 /begin FORMULA "-50 / log(1 - (X1 / 65536))" FORMULA_INV "(1 - exp(-50/X1)) * 65536" /end FORMULA
/end COMPU_METHOD
/begin CHARACTERISTIC OilPgd_Rpu_def "OilP gauge driver initial pullup R" VALUE 0x0014768a /* @ECU_Address@OilPgd_Rpu_def@0x01002FD0@ */ ECIPP_ALIGNMENT_UWORD 8192 Compu_OilPgd_Rpu_def 0 8191.875 /end CHARACTERISTIC
/begin COMPU_METHOD Compu_OilPgd_Rpu_def " " RAT_FUNC "%.1" "ohms" COEFFS 0 8 0 0 0 1 /end COMPU_METHOD
/begin MEASUREMENT OilPgd_Rpu "OilP gauge pullup R estimate" UWORD Compu_OilPgd_Rpu 0 0 0 8191.875 ECU_ADDRESS 0x01002FD8 /end MEASUREMENT
/begin COMPU_METHOD Compu_OilPgd_Rpu " " RAT_FUNC "%.1" "ohms" COEFFS 0 8 0 0 0 1 /end COMPU_METHOD
/begin MEASUREMENT OilPgd_Rd "OilP gauge sender target R" UWORD Compu_OilPgd_Rd 0 0 0 8191.875 ECU_ADDRESS 0x01002FE0 /end MEASUREMENT
/begin COMPU_METHOD Compu_OilPgd_Rd " " RAT_FUNC "%.1" "ohms" COEFFS 0 8 0 0 0 1 /end COMPU_METHOD
/begin MEASUREMENT OilPgd_Ra "OilP gauge sender actual R" UWORD Compu_OilPgd_Ra 0 0 0 8191.875 ECU_ADDRESS 0x01002FE8 /end MEASUREMENT
/begin COMPU_METHOD Compu_OilPgd_Ra " " RAT_FUNC "%.1" "ohms" COEFFS 0 8 0 0 0 1 /end COMPU_METHOD
/begin MEASUREMENT OilPgd_V_FB "OilP gauge sender voltage" UWORD Compu_OilPgd_V_FB 0 0 0 255.99609375 ECU_ADDRESS 0x01002FF0 /end MEASUREMENT
/begin COMPU_METHOD Compu_OilPgd_V_FB " " RAT_FUNC "%.2" "volts" COEFFS 0 256 0 0 0 1 /end COMPU_METHOD
/begin MEASUREMENT OilPgd_Id "OilP gauge driver current" UWORD Compu_OilPgd_Id 0 0 0 499.992370605469 ECU_ADDRESS 0x01002FF8 /end MEASUREMENT
/begin COMPU_METHOD Compu_OilPgd_Id " " RAT_FUNC "%.1" "mA" COEFFS 0 131.072 0 0 0 1 /end COMPU_METHOD
/begin CHARACTERISTIC OilPgd_chan "OilP gauge driver channel{OilPgd_chan&0xff=0:Disabled}{OilPgd_chan&0xff=1:Not Available}{OilPgd_chan&0xff=2:Not Available}{OilPgd_chan&0xff=3:Aux PWM1}{OilPgd_chan&0xff=4:Aux PWM2}{OilPgd_chan&0xff=5:Aux PWM3}{OilPgd_chan&0xff=6:Aux PWM4}{OilPgd_chan&0xff" VALUE 0x00147ea6 /* @ECU_Address@OilPgd_chan@0x01003000@ */ ECIPP_ALIGNMENT_UBYTE 255 OilPgd_chan_COMPU_VTAB 0 255 BIT_MASK 0xff /end CHARACTERISTIC
/begin COMPU_METHOD OilPgd_chan_COMPU_VTAB "Verbal Table" TAB_VERB "%.0" "list" COMPU_TAB_REF OilPgd_chan_COMPU_VTAB_REF /end COMPU_METHOD
/begin COMPU_VTAB OilPgd_chan_COMPU_VTAB_REF "Verbal Table" TAB_VERB 8 0 "Disabled" 1 "Not Available" 2 "Not Available" 3 "Aux PWM1" 4 "Aux PWM2" 5 "Aux PWM3" 6 "Aux PWM4" 7 "Aux PWM5" DEFAULT_VALUE "UNKNOWN" /end COMPU_VTAB
/begin CHARACTERISTIC OilPgd_per "OilP gauge driver PWM period" VALUE 0x00147690 /* @ECU_Address@OilPgd_per@0x01003008@ */ ECIPP_ALIGNMENT_UWORD 210 Compu_OilPgd_per 0 209.712 /end CHARACTERISTIC
/begin COMPU_METHOD Compu_OilPgd_per " " RAT_FUNC "%.2" "ms" COEFFS 0 312.5 0 0 0 1 /end COMPU_METHOD
/begin MEASUREMENT OilPgd_DC "OilP gauge driver duty-cycle" UWORD Compu_OilPgd_DC 0 0 0 99.9984741210938 ECU_ADDRESS 0x01003010 /end MEASUREMENT
/begin COMPU_METHOD Compu_OilPgd_DC " " RAT_FUNC "%.1" "%" COEFFS 0 655.36 0 0 0 1 /end COMPU_METHOD
/begin CHARACTERISTIC V1gd_ctl_type "Volt1 gauge driver control type{V1gd_ctl_type&0xff=0:Duty-cycle PWM}{V1gd_ctl_type&0xff=1:Resistance Simulation}" VALUE 0x001480e1 /* @ECU_Address@V1gd_ctl_type@0x01003018@ */ ECIPP_ALIGNMENT_UBYTE 255 V1gd_ctl_type_COMPU_VTAB 0 255 BIT_MASK 0xff /end CHARACTERISTIC
/begin COMPU_METHOD V1gd_ctl_type_COMPU_VTAB "Verbal Table" TAB_VERB "%.0" "list" COMPU_TAB_REF V1gd_ctl_type_COMPU_VTAB_REF /end COMPU_METHOD
/begin COMPU_VTAB V1gd_ctl_type_COMPU_VTAB_REF "Verbal Table" TAB_VERB 2 0 "Duty-cycle PWM" 1 "Resistance Simulation" DEFAULT_VALUE "UNKNOWN" /end COMPU_VTAB
/begin CHARACTERISTIC V1gd_Rpu_tau "Volt1 gauge resistance ctrl tau" VALUE 0x00147c98 /* @ECU_Address@V1gd_Rpu_tau@0x01003020@ */ ECIPP_ALIGNMENT_UWORD 3276795 Compu_V1gd_Rpu_tau 4.5084 3276800 /end CHARACTERISTIC
/begin COMPU_METHOD Compu_V1gd_Rpu_tau " " FORM "%.0" "ms"
 /begin FORMULA "-50 / log(1 - (X1 / 65536))" FORMULA_INV "(1 - exp(-50/X1)) * 65536" /end FORMULA
/end COMPU_METHOD
/begin CHARACTERISTIC V1gd_Rpu_def "Volt1 gauge driver initial pullup R" VALUE 0x001479fe /* @ECU_Address@V1gd_Rpu_def@0x01003028@ */ ECIPP_ALIGNMENT_UWORD 8192 Compu_V1gd_Rpu_def 0 8191.875 /end CHARACTERISTIC
/begin COMPU_METHOD Compu_V1gd_Rpu_def " " RAT_FUNC "%.1" "ohms" COEFFS 0 8 0 0 0 1 /end COMPU_METHOD
/begin MEASUREMENT V1gd_Rpu "Volt1 gauge pullup R estimate" UWORD Compu_V1gd_Rpu 0 0 0 8191.875 ECU_ADDRESS 0x01003030 /end MEASUREMENT
/begin COMPU_METHOD Compu_V1gd_Rpu " " RAT_FUNC "%.1" "ohms" COEFFS 0 8 0 0 0 1 /end COMPU_METHOD
/begin MEASUREMENT V1gd_Rd "Volt1 gauge sender target R" UWORD Compu_V1gd_Rd 0 0 0 8191.875 ECU_ADDRESS 0x01003038 /end MEASUREMENT
/begin COMPU_METHOD Compu_V1gd_Rd " " RAT_FUNC "%.1" "ohms" COEFFS 0 8 0 0 0 1 /end COMPU_METHOD
/begin MEASUREMENT V1gd_Ra "Volt1 gauge sender actual R" UWORD Compu_V1gd_Ra 0 0 0 8191.875 ECU_ADDRESS 0x01003040 /end MEASUREMENT
/begin COMPU_METHOD Compu_V1gd_Ra " " RAT_FUNC "%.1" "ohms" COEFFS 0 8 0 0 0 1 /end COMPU_METHOD
/begin MEASUREMENT V1gd_V_FB "Volt1 gauge sender voltage" UWORD Compu_V1gd_V_FB 0 0 0 255.99609375 ECU_ADDRESS 0x01003048 /end MEASUREMENT
/begin COMPU_METHOD Compu_V1gd_V_FB " " RAT_FUNC "%.2" "volts" COEFFS 0 256 0 0 0 1 /end COMPU_METHOD
/begin MEASUREMENT V1gd_Id "Volt1 gauge driver current" UWORD Compu_V1gd_Id 0 0 0 499.992370605469 ECU_ADDRESS 0x01003050 /end MEASUREMENT
/begin COMPU_METHOD Compu_V1gd_Id " " RAT_FUNC "%.1" "mA" COEFFS 0 131.072 0 0 0 1 /end COMPU_METHOD
/begin CHARACTERISTIC V1gd_chan "Volt1 gauge driver channel{V1gd_chan&0xff=0:Disabled}{V1gd_chan&0xff=1:Not Available}{V1gd_chan&0xff=2:Not Available}{V1gd_chan&0xff=3:Aux PWM1}{V1gd_chan&0xff=4:Aux PWM2}{V1gd_chan&0xff=5:Aux PWM3}{V1gd_chan&0xff=6:Aux PWM4}{V1gd_chan&0xff=7:Aux PWM5}" VALUE 0x001480e0 /* @ECU_Address@V1gd_chan@0x01003058@ */ ECIPP_ALIGNMENT_UBYTE 255 V1gd_chan_COMPU_VTAB 0 255 BIT_MASK 0xff /end CHARACTERISTIC
/begin COMPU_METHOD V1gd_chan_COMPU_VTAB "Verbal Table" TAB_VERB "%.0" "list" COMPU_TAB_REF V1gd_chan_COMPU_VTAB_REF /end COMPU_METHOD
/begin COMPU_VTAB V1gd_chan_COMPU_VTAB_REF "Verbal Table" TAB_VERB 8 0 "Disabled" 1 "Not Available" 2 "Not Available" 3 "Aux PWM1" 4 "Aux PWM2" 5 "Aux PWM3" 6 "Aux PWM4" 7 "Aux PWM5" DEFAULT_VALUE "UNKNOWN" /end COMPU_VTAB
/begin CHARACTERISTIC V1gd_per "Volt1 gauge driver PWM period" VALUE 0x00147a04 /* @ECU_Address@V1gd_per@0x01003060@ */ ECIPP_ALIGNMENT_UWORD 210 Compu_V1gd_per 0 209.712 /end CHARACTERISTIC
/begin COMPU_METHOD Compu_V1gd_per " " RAT_FUNC "%.2" "ms" COEFFS 0 312.5 0 0 0 1 /end COMPU_METHOD
/begin MEASUREMENT V1gd_DC "Volt1 gauge driver duty-cycle" UWORD Compu_V1gd_DC 0 0 0 99.9984741210938 ECU_ADDRESS 0x01003068 /end MEASUREMENT
/begin COMPU_METHOD Compu_V1gd_DC " " RAT_FUNC "%.1" "%" COEFFS 0 655.36 0 0 0 1 /end COMPU_METHOD
/begin MEASUREMENT V1gd_volts "Volt1 gauge driver source signal" UWORD Compu_V1gd_volts 0 0 0 255.99609375 ECU_ADDRESS 0x01003070 /end MEASUREMENT
/begin COMPU_METHOD Compu_V1gd_volts " " RAT_FUNC "%.2" "volts" COEFFS 0 256 0 0 0 1 /end COMPU_METHOD
/begin CHARACTERISTIC V1gd_input_chan "Volt1 gauge driver input source{V1gd_input_chan&0xff=0:Aux PU1}{V1gd_input_chan&0xff=1:Aux PU2}{V1gd_input_chan&0xff=2:Aux PU3}{V1gd_input_chan&0xff=3:Aux PD1}{V1gd_input_chan&0xff=4:Aux PD2}{V1gd_input_chan&0xff=5:Aux PD3}{V1gd_input_chan&0xff=6:Aux PUD1" VALUE 0x001480e3 /* @ECU_Address@V1gd_input_chan@0x01003078@ */ ECIPP_ALIGNMENT_UBYTE 255 V1gd_input_chan_COMPU_VTAB 0 255 BIT_MASK 0xff /end CHARACTERISTIC
/begin COMPU_METHOD V1gd_input_chan_COMPU_VTAB "Verbal Table" TAB_VERB "%.0" "list" COMPU_TAB_REF V1gd_input_chan_COMPU_VTAB_REF /end COMPU_METHOD
/begin COMPU_VTAB V1gd_input_chan_COMPU_VTAB_REF "Verbal Table" TAB_VERB 10 0 "Aux PU1" 1 "Aux PU2" 2 "Aux PU3" 3 "Aux PD1" 4 "Aux PD2" 5 "Aux PD3" 6 "Aux PUD1" 7 "Aux PUD2" 8 "Aux PUD3" 9 "Network Percent Rx" DEFAULT_VALUE "UNKNOWN" /end COMPU_VTAB
/begin CHARACTERISTIC ECTgd_Vexc_reg "ECT gauge excitation regulation" VALUE 0x001467c6 /* @ECU_Address@ECTgd_Vexc_reg@0x01003080@ */ ECIPP_ALIGNMENT_UWORD 256 Compu_ECTgd_Vexc_reg 0 255.99609375 /end CHARACTERISTIC
/begin COMPU_METHOD Compu_ECTgd_Vexc_reg " " RAT_FUNC "%.2" "volts" COEFFS 0 256 0 0 0 1 /end COMPU_METHOD
/begin CHARACTERISTIC OilPgd_Vexc_reg "OilP gauge excitation regulation" VALUE 0x0014768e /* @ECU_Address@OilPgd_Vexc_reg@0x01003088@ */ ECIPP_ALIGNMENT_UWORD 256 Compu_OilPgd_Vexc_reg 0 255.99609375 /end CHARACTERISTIC
/begin COMPU_METHOD Compu_OilPgd_Vexc_reg " " RAT_FUNC "%.2" "volts" COEFFS 0 256 0 0 0 1 /end COMPU_METHOD
/begin CHARACTERISTIC V1gd_Vexc_reg "Volt1 gauge excitation regulation" VALUE 0x00147a02 /* @ECU_Address@V1gd_Vexc_reg@0x01003090@ */ ECIPP_ALIGNMENT_UWORD 256 Compu_V1gd_Vexc_reg 0 255.99609375 /end CHARACTERISTIC
/begin COMPU_METHOD Compu_V1gd_Vexc_reg " " RAT_FUNC "%.2" "volts" COEFFS 0 256 0 0 0 1 /end COMPU_METHOD
/begin CHARACTERISTIC ECTgd_Vexc_ratio "ECT gauge excitation ratio" VALUE 0x001467c4 /* @ECU_Address@ECTgd_Vexc_ratio@0x01003098@ */ ECIPP_ALIGNMENT_UWORD 1 Compu_ECTgd_Vexc_ratio 0 0.999984741210938 /end CHARACTERISTIC
/begin COMPU_METHOD Compu_ECTgd_Vexc_ratio " " RAT_FUNC "%.3" "ratio" COEFFS 0 65536 0 0 0 1 /end COMPU_METHOD
/begin CHARACTERISTIC OilPgd_Vexc_ratio "OilP gauge excitation ratio" VALUE 0x0014768c /* @ECU_Address@OilPgd_Vexc_ratio@0x010030A0@ */ ECIPP_ALIGNMENT_UWORD 1 Compu_OilPgd_Vexc_ratio 0 0.999984741210938 /end CHARACTERISTIC
/begin COMPU_METHOD Compu_OilPgd_Vexc_ratio " " RAT_FUNC "%.3" "ratio" COEFFS 0 65536 0 0 0 1 /end COMPU_METHOD
/begin CHARACTERISTIC V1gd_Vexc_ratio "Volt1 gauge excitation ratio" VALUE 0x00147a00 /* @ECU_Address@V1gd_Vexc_ratio@0x010030A8@ */ ECIPP_ALIGNMENT_UWORD 1 Compu_V1gd_Vexc_ratio 0 0.999984741210938 /end CHARACTERISTIC
/begin COMPU_METHOD Compu_V1gd_Vexc_ratio " " RAT_FUNC "%.3" "ratio" COEFFS 0 65536 0 0 0 1 /end COMPU_METHOD
/begin CHARACTERISTIC MSP_set_source "Speed setpoint mode/source - Primary{MSP_set_source&0xff=0:Momentary - Gov switches}{MSP_set_source&0xff=1:Proportional - Aux PD1}{MSP_set_source&0xff=2:Proportional - Aux PD2}{MSP_set_source&0xff=3:Proportional - Aux PD3}{MSP_set_source&0xff=4:Proportion" VALUE 0x00147E7E /* @ECU_Address@MSP_set_source@0x010030B0@ */ ECIPP_ALIGNMENT_UBYTE 255 MSP_set_source_COMPU_VTAB 0 255 BIT_MASK 0xff /end CHARACTERISTIC
/begin COMPU_METHOD MSP_set_source_COMPU_VTAB "Verbal Table" TAB_VERB "%.0" "list" COMPU_TAB_REF MSP_set_source_COMPU_VTAB_REF /end COMPU_METHOD
/begin COMPU_VTAB MSP_set_source_COMPU_VTAB_REF "Verbal Table" TAB_VERB 7 0 "Momentary - Gov switches" 1 "Proportional - Aux PD1" 2 "Proportional - Aux PD2" 3 "Proportional - Aux PD3" 4 "Proportional - Aux PUD1" 5 "Proportional - Aux PUD2" 6 "Proportional - Aux PUD3" DEFAULT_VALUE "UNKNOWN" /end COMPU_VTAB
/begin CHARACTERISTIC MSP_prop_V0 "Proportional setpoint V min" VALUE 0x0014763e /* @ECU_Address@MSP_prop_V0@0x010030B8@ */ ECIPP_ALIGNMENT_UWORD 5 Compu_MSP_prop_V0 0 5.00114468864469 /end CHARACTERISTIC
/begin COMPU_METHOD Compu_MSP_prop_V0 " " RAT_FUNC "%.3" "volts" COEFFS 0 13104 0 0 0 1 /end COMPU_METHOD
/begin CHARACTERISTIC MSP_prop_V1 "Proportional setpoint V max" VALUE 0x00147640 /* @ECU_Address@MSP_prop_V1@0x010030C0@ */ ECIPP_ALIGNMENT_UWORD 5 Compu_MSP_prop_V1 0 5.00114468864469 /end CHARACTERISTIC
/begin COMPU_METHOD Compu_MSP_prop_V1 " " RAT_FUNC "%.3" "volts" COEFFS 0 13104 0 0 0 1 /end COMPU_METHOD
/begin CHARACTERISTIC MSP_prop_rpm0 "Proportional setpoint speed min" VALUE 0x00147642 /* @ECU_Address@MSP_prop_rpm0@0x010030C8@ */ ECIPP_ALIGNMENT_UWORD 65535 Compu_MSP_prop_rpm0 0 65535 /end CHARACTERISTIC
/begin COMPU_METHOD Compu_MSP_prop_rpm0 " " RAT_FUNC "%.0" "rpm" COEFFS 0 1 0 0 0 1 /end COMPU_METHOD
/begin CHARACTERISTIC MSP_prop_rpm1 "Proportional setpoint speed max" VALUE 0x00147644 /* @ECU_Address@MSP_prop_rpm1@0x010030D0@ */ ECIPP_ALIGNMENT_UWORD 65535 Compu_MSP_prop_rpm1 0 65535 /end CHARACTERISTIC
/begin COMPU_METHOD Compu_MSP_prop_rpm1 " " RAT_FUNC "%.0" "rpm" COEFFS 0 1 0 0 0 1 /end COMPU_METHOD
/begin CHARACTERISTIC MSP_prop_tau "Proportional setpoint input low-pass" VALUE 0x00147c1c /* @ECU_Address@MSP_prop_tau@0x010030D8@ */ ECIPP_ALIGNMENT_UWORD 327680 Compu_MSP_prop_tau 0.45084 327680 /end CHARACTERISTIC
/begin COMPU_METHOD Compu_MSP_prop_tau " " FORM "%.1" "ms"
 /begin FORMULA "-5 / log(1 - (X1 / 65536))" FORMULA_INV "(1 - exp(-5/X1)) * 65536" /end FORMULA
/end COMPU_METHOD
/begin CHARACTERISTIC MaxSetPt_apprdt "Initial engagement decel limit" VALUE 0x00144380 /* @ECU_Address@MaxSetPt_apprdt@0x01003110@ */ ECIPP_ALIGNMENT_SWORD 63998 Compu_MaxSetPt_apprdt -64000 63998.046875 /end CHARACTERISTIC
/begin COMPU_METHOD Compu_MaxSetPt_apprdt " " RAT_FUNC "%.0" "rpm/sec" COEFFS 0 0.512 0 0 0 1 /end COMPU_METHOD
/begin MEASUREMENT MSP_prop_V "Proportional setpoint input voltage" UWORD Compu_MSP_prop_V 0 0 0 5.00114468864469 ECU_ADDRESS 0x01003120 /end MEASUREMENT
/begin COMPU_METHOD Compu_MSP_prop_V " " RAT_FUNC "%.3" "volts" COEFFS 0 13104 0 0 0 1 /end COMPU_METHOD
/begin CHARACTERISTIC ECT_gauge_sync "ECT muti-engine gauge sync{ECT_gauge_sync&0xff=0:Disabled}{ECT_gauge_sync&0xff=1:Enabled}" VALUE 0x00147d1d /* @ECU_Address@ECT_gauge_sync@0x010036C8@ */ ECIPP_ALIGNMENT_UBYTE 255 ECT_gauge_sync_COMPU_VTAB 0 255 BIT_MASK 0xff /end CHARACTERISTIC
/begin COMPU_METHOD ECT_gauge_sync_COMPU_VTAB "Verbal Table" TAB_VERB "%.0" "list" COMPU_TAB_REF ECT_gauge_sync_COMPU_VTAB_REF /end COMPU_METHOD
/begin COMPU_VTAB ECT_gauge_sync_COMPU_VTAB_REF "Verbal Table" TAB_VERB 2 0 "Disabled" 1 "Enabled" DEFAULT_VALUE "UNKNOWN" /end COMPU_VTAB
/begin CHARACTERISTIC OILP_gauge_sync "OilP muti-engine gauge sync{OILP_gauge_sync&0xff=0:Disabled}{OILP_gauge_sync&0xff=1:Enabled}" VALUE 0x00147e9d /* @ECU_Address@OILP_gauge_sync@0x010036D0@ */ ECIPP_ALIGNMENT_UBYTE 255 OILP_gauge_sync_COMPU_VTAB 0 255 BIT_MASK 0xff /end CHARACTERISTIC
/begin COMPU_METHOD OILP_gauge_sync_COMPU_VTAB "Verbal Table" TAB_VERB "%.0" "list" COMPU_TAB_REF OILP_gauge_sync_COMPU_VTAB_REF /end COMPU_METHOD
/begin COMPU_VTAB OILP_gauge_sync_COMPU_VTAB_REF "Verbal Table" TAB_VERB 2 0 "Disabled" 1 "Enabled" DEFAULT_VALUE "UNKNOWN" /end COMPU_VTAB
/begin CHARACTERISTIC OILP_gauge_dz "OilP gauge sync deadband" VALUE 0x00144384 /* @ECU_Address@OILP_gauge_dz@0x010036D8@ */ ECIPP_ALIGNMENT_SWORD 256 Compu_OILP_gauge_dz -256 255.9921875 /end CHARACTERISTIC
/begin COMPU_METHOD Compu_OILP_gauge_dz " " RAT_FUNC "%.1" "psig" COEFFS 0 128 0 0 0 1 /end COMPU_METHOD
/begin CHARACTERISTIC ECT_gauge_dz "ECT gauge sync deadband" VALUE 0x001442b0 /* @ECU_Address@ECT_gauge_dz@0x010036E0@ */ ECIPP_ALIGNMENT_SWORD 1024 Compu_ECT_gauge_dz -1024 1023.96875 /end CHARACTERISTIC
/begin COMPU_METHOD Compu_ECT_gauge_dz " " RAT_FUNC "%.0" "deg F" COEFFS 0 32 0 0 0 1 /end COMPU_METHOD
/begin MEASUREMENT ECT_gauge_value "ECT gauge sync'd display value" UWORD Compu_ECT_gauge_value 0 0 -460 563.984375 ECU_ADDRESS 0x010036F0 /end MEASUREMENT
/begin COMPU_METHOD Compu_ECT_gauge_value " " RAT_FUNC "%.0" "deg F" COEFFS 0 64 29440 0 0 1 /end COMPU_METHOD
/begin MEASUREMENT OILP_gauge_value "OilP gauge sync'd display value" UWORD Compu_OILP_gauge_value 0 0 0 255.99609375 ECU_ADDRESS 0x010036F8 /end MEASUREMENT
/begin COMPU_METHOD Compu_OILP_gauge_value " " RAT_FUNC "%.0" "psig" COEFFS 0 256 0 0 0 1 /end COMPU_METHOD
/begin CHARACTERISTIC ECT_gauge_DHena "ECT gauge dual-helm sender{ECT_gauge_DHena&0xff=0:Disabled}{ECT_gauge_DHena&0xff=1:Enabled}{ECT_gauge_DHena&0xff=2:Aux PU1}{ECT_gauge_DHena&0xff=3:Aux PU2}{ECT_gauge_DHena&0xff=4:Aux PU3}{ECT_gauge_DHena&0xff=5:Aux PUD1}{ECT_gauge_DHena&0xff=6:Aux PUD2}{E" VALUE 0x00147d1c /* @ECU_Address@ECT_gauge_DHena@0x010037A8@ */ ECIPP_ALIGNMENT_UBYTE 255 ECT_gauge_DHena_COMPU_VTAB 0 255 BIT_MASK 0xff /end CHARACTERISTIC
/begin COMPU_METHOD ECT_gauge_DHena_COMPU_VTAB "Verbal Table" TAB_VERB "%.0" "list" COMPU_TAB_REF ECT_gauge_DHena_COMPU_VTAB_REF /end COMPU_METHOD
/begin COMPU_VTAB ECT_gauge_DHena_COMPU_VTAB_REF "Verbal Table" TAB_VERB 11 0 "Disabled" 1 "Enabled" 2 "Aux PU1" 3 "Aux PU2" 4 "Aux PU3" 5 "Aux PUD1" 6 "Aux PUD2" 7 "Aux PUD3" 8 "Aux DIG1" 9 "Aux DIG2" 10 "Aux DIG3" DEFAULT_VALUE "UNKNOWN" /end COMPU_VTAB
/begin CHARACTERISTIC OILP_gauge_DHena "OilP dual-helm gauge sender{OILP_gauge_DHena&0xff=0:Disabled}{OILP_gauge_DHena&0xff=1:Enabled}{OILP_gauge_DHena&0xff=2:Aux PU1}{OILP_gauge_DHena&0xff=3:Aux PU2}{OILP_gauge_DHena&0xff=4:Aux PU3}{OILP_gauge_DHena&0xff=5:Aux PUD1}{OILP_gauge_DHena&0xff=6:Aux" VALUE 0x00147e9c /* @ECU_Address@OILP_gauge_DHena@0x010037B0@ */ ECIPP_ALIGNMENT_UBYTE 255 OILP_gauge_DHena_COMPU_VTAB 0 255 BIT_MASK 0xff /end CHARACTERISTIC
/begin COMPU_METHOD OILP_gauge_DHena_COMPU_VTAB "Verbal Table" TAB_VERB "%.0" "list" COMPU_TAB_REF OILP_gauge_DHena_COMPU_VTAB_REF /end COMPU_METHOD
/begin COMPU_VTAB OILP_gauge_DHena_COMPU_VTAB_REF "Verbal Table" TAB_VERB 11 0 "Disabled" 1 "Enabled" 2 "Aux PU1" 3 "Aux PU2" 4 "Aux PU3" 5 "Aux PUD1" 6 "Aux PUD2" 7 "Aux PUD3" 8 "Aux DIG1" 9 "Aux DIG2" 10 "Aux DIG3" DEFAULT_VALUE "UNKNOWN" /end COMPU_VTAB
/begin CHARACTERISTIC V1gd_gauge_DHena "Volt1 dual-helm gauge sender{V1gd_gauge_DHena&0xff=0:Disabled}{V1gd_gauge_DHena&0xff=1:Enabled}{V1gd_gauge_DHena&0xff=2:Aux PU1}{V1gd_gauge_DHena&0xff=3:Aux PU2}{V1gd_gauge_DHena&0xff=4:Aux PU3}{V1gd_gauge_DHena&0xff=5:Aux PUD1}{V1gd_gauge_DHena&0xff=6:Au" VALUE 0x001480e2 /* @ECU_Address@V1gd_gauge_DHena@0x010037B8@ */ ECIPP_ALIGNMENT_UBYTE 255 V1gd_gauge_DHena_COMPU_VTAB 0 255 BIT_MASK 0xff /end CHARACTERISTIC
/begin COMPU_METHOD V1gd_gauge_DHena_COMPU_VTAB "Verbal Table" TAB_VERB "%.0" "list" COMPU_TAB_REF V1gd_gauge_DHena_COMPU_VTAB_REF /end COMPU_METHOD
/begin COMPU_VTAB V1gd_gauge_DHena_COMPU_VTAB_REF "Verbal Table" TAB_VERB 11 0 "Disabled" 1 "Enabled" 2 "Aux PU1" 3 "Aux PU2" 4 "Aux PU3" 5 "Aux PUD1" 6 "Aux PUD2" 7 "Aux PUD3" 8 "Aux DIG1" 9 "Aux DIG2" 10 "Aux DIG3" DEFAULT_VALUE "UNKNOWN" /end COMPU_VTAB
/begin MEASUREMENT ECT_gauge_DHstat "ECT gauge single/dual-helm status{ECT_gauge_DHstat&0xff=0:Single-Helm}{ECT_gauge_DHstat&0xff=1:Dual-Helm}" UBYTE ECT_gauge_DHstat_COMPU_VTAB 0 0 0 255 ECU_ADDRESS 0x01003808 BIT_MASK 0xff /end MEASUREMENT
/begin COMPU_METHOD ECT_gauge_DHstat_COMPU_VTAB "Verbal Table" TAB_VERB "%.0" "list" COMPU_TAB_REF ECT_gauge_DHstat_COMPU_VTAB_REF /end COMPU_METHOD
/begin COMPU_VTAB ECT_gauge_DHstat_COMPU_VTAB_REF "Verbal Table" TAB_VERB 2 0 "Single-Helm" 1 "Dual-Helm" DEFAULT_VALUE "UNKNOWN" /end COMPU_VTAB
/begin MEASUREMENT OILP_gauge_DHstat "OilP gauge single/dual-helm status{OILP_gauge_DHstat&0xff=0:Single-Helm}{OILP_gauge_DHstat&0xff=1:Dual-Helm}" UBYTE OILP_gauge_DHstat_COMPU_VTAB 0 0 0 255 ECU_ADDRESS 0x01003810 BIT_MASK 0xff /end MEASUREMENT
/begin COMPU_METHOD OILP_gauge_DHstat_COMPU_VTAB "Verbal Table" TAB_VERB "%.0" "list" COMPU_TAB_REF OILP_gauge_DHstat_COMPU_VTAB_REF /end COMPU_METHOD
/begin COMPU_VTAB OILP_gauge_DHstat_COMPU_VTAB_REF "Verbal Table" TAB_VERB 2 0 "Single-Helm" 1 "Dual-Helm" DEFAULT_VALUE "UNKNOWN" /end COMPU_VTAB
/begin MEASUREMENT V1gd_gauge_DHstat "Volt1 gauge single/dual-helm status{V1gd_gauge_DHstat&0xff=0:Single-Helm}{V1gd_gauge_DHstat&0xff=1:Dual-Helm}" UBYTE V1gd_gauge_DHstat_COMPU_VTAB 0 0 0 255 ECU_ADDRESS 0x01003818 BIT_MASK 0xff /end MEASUREMENT
/begin COMPU_METHOD V1gd_gauge_DHstat_COMPU_VTAB "Verbal Table" TAB_VERB "%.0" "list" COMPU_TAB_REF V1gd_gauge_DHstat_COMPU_VTAB_REF /end COMPU_METHOD
/begin COMPU_VTAB V1gd_gauge_DHstat_COMPU_VTAB_REF "Verbal Table" TAB_VERB 2 0 "Single-Helm" 1 "Dual-Helm" DEFAULT_VALUE "UNKNOWN" /end COMPU_VTAB
/begin MEASUREMENT ECTgd_Rdtbl "ECT gauge sender cal-table R" UWORD Compu_ECTgd_Rdtbl 0 0 0 8191.875 ECU_ADDRESS 0x01003860 /end MEASUREMENT
/begin COMPU_METHOD Compu_ECTgd_Rdtbl " " RAT_FUNC "%.1" "ohms" COEFFS 0 8 0 0 0 1 /end COMPU_METHOD
/begin MEASUREMENT OilPgd_Rdtbl "OilP gauge sender cal-table R" UWORD Compu_OilPgd_Rdtbl 0 0 0 8191.875 ECU_ADDRESS 0x01003868 /end MEASUREMENT
/begin COMPU_METHOD Compu_OilPgd_Rdtbl " " RAT_FUNC "%.1" "ohms" COEFFS 0 8 0 0 0 1 /end COMPU_METHOD
/begin MEASUREMENT V1gd_Rdtbl "Volt1 gauge sender cal-table R" UWORD Compu_V1gd_Rdtbl 0 0 0 8191.875 ECU_ADDRESS 0x01003870 /end MEASUREMENT
/begin COMPU_METHOD Compu_V1gd_Rdtbl " " RAT_FUNC "%.1" "ohms" COEFFS 0 8 0 0 0 1 /end COMPU_METHOD
/begin CHARACTERISTIC MSP_1tap_RS "Single-tap roadspeed step change" VALUE 0x00147632 /* @ECU_Address@MSP_1tap_RS@0x01003AF8@ */ ECIPP_ALIGNMENT_UWORD 256 Compu_MSP_1tap_RS 0 255.99609375 /end CHARACTERISTIC
/begin COMPU_METHOD Compu_MSP_1tap_RS " " RAT_FUNC "%.2" "kph" COEFFS 0 256 0 0 0 1 /end COMPU_METHOD
/begin CHARACTERISTIC MSP_rampRS_final "Button-hold roadspeed ramping max rate" VALUE 0x00147646 /* @ECU_Address@MSP_rampRS_final@0x01003B00@ */ ECIPP_ALIGNMENT_UWORD 256 Compu_MSP_rampRS_final 0 255.99609375 /end CHARACTERISTIC
/begin COMPU_METHOD Compu_MSP_rampRS_final " " RAT_FUNC "%.2" "kph/sec" COEFFS 0 256 0 0 0 1 /end COMPU_METHOD
/begin CHARACTERISTIC MSP_min_RS "Minimum settable roadspeed" VALUE 0x0014763a /* @ECU_Address@MSP_min_RS@0x01003B08@ */ ECIPP_ALIGNMENT_UWORD 256 Compu_MSP_min_RS 0 255.99609375 /end CHARACTERISTIC
/begin COMPU_METHOD Compu_MSP_min_RS " " RAT_FUNC "%.1" "kph" COEFFS 0 256 0 0 0 1 /end COMPU_METHOD
/begin CHARACTERISTIC MSP_max_RS "Maximum settable roadspeed" VALUE 0x00147636 /* @ECU_Address@MSP_max_RS@0x01003B10@ */ ECIPP_ALIGNMENT_UWORD 256 Compu_MSP_max_RS 0 255.99609375 /end CHARACTERISTIC
/begin COMPU_METHOD Compu_MSP_max_RS " " RAT_FUNC "%.1" "kph" COEFFS 0 256 0 0 0 1 /end COMPU_METHOD
/begin MEASUREMENT MSP_mode_sw "Off/RPM/RS switch{MSP_mode_sw&0xff=0:Off}{MSP_mode_sw&0xff=1:RPM Control}{MSP_mode_sw&0xff=2:Vehicle Speed Control}" UBYTE MSP_mode_sw_COMPU_VTAB 0 0 0 255 ECU_ADDRESS 0x01003B38 BIT_MASK 0xff /end MEASUREMENT
/begin COMPU_METHOD MSP_mode_sw_COMPU_VTAB "Verbal Table" TAB_VERB "%.0" "list" COMPU_TAB_REF MSP_mode_sw_COMPU_VTAB_REF /end COMPU_METHOD
/begin COMPU_VTAB MSP_mode_sw_COMPU_VTAB_REF "Verbal Table" TAB_VERB 3 0 "Off" 1 "RPM Control" 2 "Vehicle Speed Control" DEFAULT_VALUE "UNKNOWN" /end COMPU_VTAB
/begin CHARACTERISTIC MSP_setclr_HW_input "Set/Clear switch input{MSP_setclr_HW_input&0xff=0:Network / software switch}{MSP_setclr_HW_input&0xff=1:Gov1 hardware switch}{MSP_setclr_HW_input&0xff=2:Disabled}" VALUE 0x00147e80 /* @ECU_Address@MSP_setclr_HW_input@0x01003B40@ */ ECIPP_ALIGNMENT_UBYTE 255 MSP_setclr_HW_input_COMPU_VTAB 0 255 BIT_MASK 0xff /end CHARACTERISTIC
/begin COMPU_METHOD MSP_setclr_HW_input_COMPU_VTAB "Verbal Table" TAB_VERB "%.0" "list" COMPU_TAB_REF MSP_setclr_HW_input_COMPU_VTAB_REF /end COMPU_METHOD
/begin COMPU_VTAB MSP_setclr_HW_input_COMPU_VTAB_REF "Verbal Table" TAB_VERB 3 0 "Network / software switch" 1 "Gov1 hardware switch" 2 "Disabled" DEFAULT_VALUE "UNKNOWN" /end COMPU_VTAB
/begin CHARACTERISTIC MSP_incdec_HW_input "Inc/Decrement switch input{MSP_incdec_HW_input&0xff=0:Network / software switch}{MSP_incdec_HW_input&0xff=1:Gov2 hardware switch}{MSP_incdec_HW_input&0xff=2:Gov1/2 = +V hardware switches}" VALUE 0x00147e7c /* @ECU_Address@MSP_incdec_HW_input@0x01003B48@ */ ECIPP_ALIGNMENT_UBYTE 255 MSP_incdec_HW_input_COMPU_VTAB 0 255 BIT_MASK 0xff /end CHARACTERISTIC
/begin COMPU_METHOD MSP_incdec_HW_input_COMPU_VTAB "Verbal Table" TAB_VERB "%.0" "list" COMPU_TAB_REF MSP_incdec_HW_input_COMPU_VTAB_REF /end COMPU_METHOD
/begin COMPU_VTAB MSP_incdec_HW_input_COMPU_VTAB_REF "Verbal Table" TAB_VERB 3 0 "Network / software switch" 1 "Gov2 hardware switch" 2 "Gov1/2 = +V hardware switches" DEFAULT_VALUE "UNKNOWN" /end COMPU_VTAB
/begin CHARACTERISTIC MaxSetPt_keyon "Control behavior at key-on{MaxSetPt_keyon&0xff=0:Disengaged initially}{MaxSetPt_keyon&0xff=1:Engaged initially}{MaxSetPt_keyon&0xff=2:Previous state}" VALUE 0x00147e85 /* @ECU_Address@MaxSetPt_keyon@0x01003D30@ */ ECIPP_ALIGNMENT_UBYTE 255 MaxSetPt_keyon_COMPU_VTAB 0 255 BIT_MASK 0xff /end CHARACTERISTIC
/begin COMPU_METHOD MaxSetPt_keyon_COMPU_VTAB "Verbal Table" TAB_VERB "%.0" "list" COMPU_TAB_REF MaxSetPt_keyon_COMPU_VTAB_REF /end COMPU_METHOD
/begin COMPU_VTAB MaxSetPt_keyon_COMPU_VTAB_REF "Verbal Table" TAB_VERB 3 0 "Disengaged initially" 1 "Engaged initially" 2 "Previous state" DEFAULT_VALUE "UNKNOWN" /end COMPU_VTAB
/begin CHARACTERISTIC MSP2_set_source "Speed setpoint mode/source - Secondary{MSP2_set_source&0xff=0:Momentary - Gov switches}{MSP2_set_source&0xff=1:Proportional - Aux PD1}{MSP2_set_source&0xff=2:Proportional - Aux PD2}{MSP2_set_source&0xff=3:Proportional - Aux PD3}{MSP2_set_source&0xff=4:Pro" VALUE 0x00147E7F /* @ECU_Address@MSP2_set_source@0x010041A0@ */ ECIPP_ALIGNMENT_UBYTE 255 MSP2_set_source_COMPU_VTAB 0 255 BIT_MASK 0xff /end CHARACTERISTIC
/begin COMPU_METHOD MSP2_set_source_COMPU_VTAB "Verbal Table" TAB_VERB "%.0" "list" COMPU_TAB_REF MSP2_set_source_COMPU_VTAB_REF /end COMPU_METHOD
/begin COMPU_VTAB MSP2_set_source_COMPU_VTAB_REF "Verbal Table" TAB_VERB 7 0 "Momentary - Gov switches" 1 "Proportional - Aux PD1" 2 "Proportional - Aux PD2" 3 "Proportional - Aux PD3" 4 "Proportional - Aux PUD1" 5 "Proportional - Aux PUD2" 6 "Proportional - Aux PUD3" DEFAULT_VALUE "UNKNOWN" /end COMPU_VTAB
/begin CHARACTERISTIC MaxSetPt2_ena "Max speed user setpoint - Secondary{MaxSetPt2_ena&0xff=0:Disabled}{MaxSetPt2_ena&0xff=1:Enabled by Aux PU1 active=RPM}{MaxSetPt2_ena&0xff=2:Enabled by Aux PU2 active=RPM}{MaxSetPt2_ena&0xff=3:Enabled by Aux PU3 active=RPM}{MaxSetPt2_ena&0xff=4:Enabled by " VALUE 0x00147e81 /* @ECU_Address@MaxSetPt2_ena@0x010041A8@ */ ECIPP_ALIGNMENT_UBYTE 255 MaxSetPt2_ena_COMPU_VTAB 0 255 BIT_MASK 0xff /end CHARACTERISTIC
/begin COMPU_METHOD MaxSetPt2_ena_COMPU_VTAB "Verbal Table" TAB_VERB "%.0" "list" COMPU_TAB_REF MaxSetPt2_ena_COMPU_VTAB_REF /end COMPU_METHOD
/begin COMPU_VTAB MaxSetPt2_ena_COMPU_VTAB_REF "Verbal Table" TAB_VERB 14 0 "Disabled" 1 "Enabled by Aux PU1 active=RPM" 2 "Enabled by Aux PU2 active=RPM" 3 "Enabled by Aux PU3 active=RPM" 4 "Enabled by Aux DIG1" 5 "Enabled by Aux DIG2" 6 "Enabled by Aux DIG3" 7 "Network Switch" 8 "Software Switch" 9 "Enabled by Aux PU2 w/ DIG2=Open" 10 "Enabled by Aux PU2 w/ DIG2=Gnd" 11 "Enabled by Aux PU1 active=RS" 12 "Enabled by Aux PU2 active=RS" 13 "Enabled by Aux PU3 active=RS" DEFAULT_VALUE "UNKNOWN" /end COMPU_VTAB
/begin MEASUREMENT MSP_prisec "Primary/Secondary system selected{MSP_prisec&0xff=0:Primary}{MSP_prisec&0xff=1:Secondary}{MSP_prisec&0xff=2:Network Override}" UBYTE MSP_prisec_COMPU_VTAB 0 0 0 255 ECU_ADDRESS 0x010041B0 BIT_MASK 0xff /end MEASUREMENT
/begin COMPU_METHOD MSP_prisec_COMPU_VTAB "Verbal Table" TAB_VERB "%.0" "list" COMPU_TAB_REF MSP_prisec_COMPU_VTAB_REF /end COMPU_METHOD
/begin COMPU_VTAB MSP_prisec_COMPU_VTAB_REF "Verbal Table" TAB_VERB 3 0 "Primary" 1 "Secondary" 2 "Network Override" DEFAULT_VALUE "UNKNOWN" /end COMPU_VTAB
/begin MEASUREMENT TSC_ff_loadval "Current TSC1 feedforward gov load" SWORD Compu_TSC_ff_loadval 0 0 -800 799.9755859375 ECU_ADDRESS 0x01004520 /end MEASUREMENT
/begin COMPU_METHOD Compu_TSC_ff_loadval " " RAT_FUNC "%.1" "%" COEFFS 0 40.96 0 0 0 1 /end COMPU_METHOD
/begin MEASUREMENT V1gd_pctref "Volt1 gauge driver reference" UWORD Compu_V1gd_pctref 0 0 0 399.993896484375 ECU_ADDRESS 0x01004658 /end MEASUREMENT
/begin COMPU_METHOD Compu_V1gd_pctref " " RAT_FUNC "%.1" "%" COEFFS 0 163.84 0 0 0 1 /end COMPU_METHOD
/begin CHARACTERISTIC fastidle_ena "Fast idle digital input{fastidle_ena&0xff=0:Disabled}{fastidle_ena&0xff=1:Aux DIG1}{fastidle_ena&0xff=2:Aux DIG2}{fastidle_ena&0xff=3:Aux DIG3}{fastidle_ena&0xff=4:Aux DIG4}{fastidle_ena&0xff=5:Gov1 Switch Input}{fastidle_ena&0xff=6:Gov2 Switch Input}" VALUE 0x00148160 /* @ECU_Address@fastidle_ena@0x01004848@ */ ECIPP_ALIGNMENT_UBYTE 255 fastidle_ena_COMPU_VTAB 0 255 BIT_MASK 0xff /end CHARACTERISTIC
/begin COMPU_METHOD fastidle_ena_COMPU_VTAB "Verbal Table" TAB_VERB "%.0" "list" COMPU_TAB_REF fastidle_ena_COMPU_VTAB_REF /end COMPU_METHOD
/begin COMPU_VTAB fastidle_ena_COMPU_VTAB_REF "Verbal Table" TAB_VERB 7 0 "Disabled" 1 "Aux DIG1" 2 "Aux DIG2" 3 "Aux DIG3" 4 "Aux DIG4" 5 "Gov1 Switch Input" 6 "Gov2 Switch Input" DEFAULT_VALUE "UNKNOWN" /end COMPU_VTAB
/begin CHARACTERISTIC fastidle_rpm "Fast idle speed target" VALUE 0x00147af6 /* @ECU_Address@fastidle_rpm@0x01004850@ */ ECIPP_ALIGNMENT_UWORD 65535 Compu_fastidle_rpm 0 65535 /end CHARACTERISTIC
/begin COMPU_METHOD Compu_fastidle_rpm " " RAT_FUNC "%.0" "rpm" COEFFS 0 1 0 0 0 1 /end COMPU_METHOD
/begin CHARACTERISTIC fastidle_act_st "Fast idle input active state{fastidle_act_st&0xff=0:+V = Active}{fastidle_act_st&0xff=1:Gnd = Active}{fastidle_act_st&0xff=2:Open = Active}" VALUE 0x0014815f /* @ECU_Address@fastidle_act_st@0x01004858@ */ ECIPP_ALIGNMENT_UBYTE 255 fastidle_act_st_COMPU_VTAB 0 255 BIT_MASK 0xff /end CHARACTERISTIC
/begin COMPU_METHOD fastidle_act_st_COMPU_VTAB "Verbal Table" TAB_VERB "%.0" "list" COMPU_TAB_REF fastidle_act_st_COMPU_VTAB_REF /end COMPU_METHOD
/begin COMPU_VTAB fastidle_act_st_COMPU_VTAB_REF "Verbal Table" TAB_VERB 3 0 "+V = Active" 1 "Gnd = Active" 2 "Open = Active" DEFAULT_VALUE "UNKNOWN" /end COMPU_VTAB
/begin CHARACTERISTIC strt_idle_mode "Starting initial speed mode{strt_idle_mode&0xff=0:Single-Point / Zero-Hold}{strt_idle_mode&0xff=1:ECT Table-Based}" VALUE 0x001481bb /* @ECU_Address@strt_idle_mode@0x01004B60@ */ ECIPP_ALIGNMENT_UBYTE 255 strt_idle_mode_COMPU_VTAB 0 255 BIT_MASK 0xff /end CHARACTERISTIC
/begin COMPU_METHOD strt_idle_mode_COMPU_VTAB "Verbal Table" TAB_VERB "%.0" "list" COMPU_TAB_REF strt_idle_mode_COMPU_VTAB_REF /end COMPU_METHOD
/begin COMPU_VTAB strt_idle_mode_COMPU_VTAB_REF "Verbal Table" TAB_VERB 2 0 "Single-Point / Zero-Hold" 1 "ECT Table-Based" DEFAULT_VALUE "UNKNOWN" /end COMPU_VTAB
/begin MEASUREMENT strt_idle_ini "Start initial speed" UWORD Compu_strt_idle_ini 0 0 0 65535 ECU_ADDRESS 0x01004B68 /end MEASUREMENT
/begin COMPU_METHOD Compu_strt_idle_ini " " RAT_FUNC "%.0" "rpm" COEFFS 0 1 0 0 0 1 /end COMPU_METHOD
/begin MEASUREMENT strt_idle_hld "Start initial speed hold" UWORD Compu_strt_idle_hld 0 0 0 65.535 ECU_ADDRESS 0x01004B70 /end MEASUREMENT
/begin COMPU_METHOD Compu_strt_idle_hld " " RAT_FUNC "%.3" "sec" COEFFS 0 1000 0 0 0 1 /end COMPU_METHOD
/begin MEASUREMENT strt_idle_dcy "Start initial speed decay" UWORD Compu_strt_idle_dcy 0 0 0 999.984741210938 ECU_ADDRESS 0x01004B78 /end MEASUREMENT
/begin COMPU_METHOD Compu_strt_idle_dcy " " RAT_FUNC "%.0" "rpm / sec" COEFFS 0 65.536 0 0 0 1 /end COMPU_METHOD
/begin MEASUREMENT MSP_status "Max speed setpoint engagement{MSP_status&0xff=0:Off}{MSP_status&0xff=1:On - Inactive}{MSP_status&0xff=2:On - Active}{MSP_status&0xff=3:N/A}" UBYTE MSP_status_COMPU_VTAB 0 0 0 255 ECU_ADDRESS 0x01005318 BIT_MASK 0xff /end MEASUREMENT
/begin COMPU_METHOD MSP_status_COMPU_VTAB "Verbal Table" TAB_VERB "%.0" "list" COMPU_TAB_REF MSP_status_COMPU_VTAB_REF /end COMPU_METHOD
/begin COMPU_VTAB MSP_status_COMPU_VTAB_REF "Verbal Table" TAB_VERB 4 0 "Off" 1 "On - Inactive" 2 "On - Active" 3 "N/A" DEFAULT_VALUE "UNKNOWN" /end COMPU_VTAB
/begin CHARACTERISTIC FLEV_ena "FLEV fuel level monitoring{FLEV_ena&0xff=0:Disabled}{FLEV_ena&0xff=1:Enabled}" VALUE 0x00147d57 /* @ECU_Address@FLEV_ena@0x01005590@ */ ECIPP_ALIGNMENT_UBYTE 255 FLEV_ena_COMPU_VTAB 0 255 BIT_MASK 0xff /end CHARACTERISTIC
/begin COMPU_METHOD FLEV_ena_COMPU_VTAB "Verbal Table" TAB_VERB "%.0" "list" COMPU_TAB_REF FLEV_ena_COMPU_VTAB_REF /end COMPU_METHOD
/begin COMPU_VTAB FLEV_ena_COMPU_VTAB_REF "Verbal Table" TAB_VERB 2 0 "Disabled" 1 "Enabled" DEFAULT_VALUE "UNKNOWN" /end COMPU_VTAB
/begin CHARACTERISTIC FLEV_FT_crct "FLEV tank temperature correction{FLEV_FT_crct&0xff=0:Disabled}{FLEV_FT_crct&0xff=1:FTT}" VALUE 0x00147d56 /* @ECU_Address@FLEV_FT_crct@0x01005598@ */ ECIPP_ALIGNMENT_UBYTE 255 FLEV_FT_crct_COMPU_VTAB 0 255 BIT_MASK 0xff /end CHARACTERISTIC
/begin COMPU_METHOD FLEV_FT_crct_COMPU_VTAB "Verbal Table" TAB_VERB "%.0" "list" COMPU_TAB_REF FLEV_FT_crct_COMPU_VTAB_REF /end COMPU_METHOD
/begin COMPU_VTAB FLEV_FT_crct_COMPU_VTAB_REF "Verbal Table" TAB_VERB 2 0 "Disabled" 1 "FTT" DEFAULT_VALUE "UNKNOWN" /end COMPU_VTAB
/begin CHARACTERISTIC FLEV_lo_faults "FLEV low fuel fault disabling{FLEV_lo_faults&0xff=0:Disabled}{FLEV_lo_faults&0xff=1:Enabled - Legacy}{FLEV_lo_faults&0xff=2:Use Low Fuel Monitoring}" VALUE 0x00147d59 /* @ECU_Address@FLEV_lo_faults@0x010055A0@ */ ECIPP_ALIGNMENT_UBYTE 255 FLEV_lo_faults_COMPU_VTAB 0 255 BIT_MASK 0xff /end CHARACTERISTIC
/begin COMPU_METHOD FLEV_lo_faults_COMPU_VTAB "Verbal Table" TAB_VERB "%.0" "list" COMPU_TAB_REF FLEV_lo_faults_COMPU_VTAB_REF /end COMPU_METHOD
/begin COMPU_VTAB FLEV_lo_faults_COMPU_VTAB_REF "Verbal Table" TAB_VERB 3 0 "Disabled" 1 "Enabled - Legacy" 2 "Use Low Fuel Monitoring" DEFAULT_VALUE "UNKNOWN" /end COMPU_VTAB
/begin CHARACTERISTIC FLEV_lo_chan "FLEV low fuel indicator channel{FLEV_lo_chan&0xff=0:Disabled}{FLEV_lo_chan&0xff=1:Aux PWM1}{FLEV_lo_chan&0xff=2:Aux PWM2}{FLEV_lo_chan&0xff=3:Aux PWM3}{FLEV_lo_chan&0xff=4:Aux PWM4}{FLEV_lo_chan&0xff=5:Aux PWM5}" VALUE 0x00147d58 /* @ECU_Address@FLEV_lo_chan@0x010055A8@ */ ECIPP_ALIGNMENT_UBYTE 255 FLEV_lo_chan_COMPU_VTAB 0 255 BIT_MASK 0xff /end CHARACTERISTIC
/begin COMPU_METHOD FLEV_lo_chan_COMPU_VTAB "Verbal Table" TAB_VERB "%.0" "list" COMPU_TAB_REF FLEV_lo_chan_COMPU_VTAB_REF /end COMPU_METHOD
/begin COMPU_VTAB FLEV_lo_chan_COMPU_VTAB_REF "Verbal Table" TAB_VERB 6 0 "Disabled" 1 "Aux PWM1" 2 "Aux PWM2" 3 "Aux PWM3" 4 "Aux PWM4" 5 "Aux PWM5" DEFAULT_VALUE "UNKNOWN" /end COMPU_VTAB
/begin CHARACTERISTIC FLEVgd_chan "FLEV gauge driver channel{FLEVgd_chan&0xff=0:Disabled}{FLEVgd_chan&0xff=1:Aux PWM1}{FLEVgd_chan&0xff=2:Aux PWM2}{FLEVgd_chan&0xff=3:Aux PWM3}{FLEVgd_chan&0xff=4:Aux PWM4}{FLEVgd_chan&0xff=5:Aux PWM5}" VALUE 0x00147d5a /* @ECU_Address@FLEVgd_chan@0x010055B0@ */ ECIPP_ALIGNMENT_UBYTE 255 FLEVgd_chan_COMPU_VTAB 0 255 BIT_MASK 0xff /end CHARACTERISTIC
/begin COMPU_METHOD FLEVgd_chan_COMPU_VTAB "Verbal Table" TAB_VERB "%.0" "list" COMPU_TAB_REF FLEVgd_chan_COMPU_VTAB_REF /end COMPU_METHOD
/begin COMPU_VTAB FLEVgd_chan_COMPU_VTAB_REF "Verbal Table" TAB_VERB 6 0 "Disabled" 1 "Aux PWM1" 2 "Aux PWM2" 3 "Aux PWM3" 4 "Aux PWM4" 5 "Aux PWM5" DEFAULT_VALUE "UNKNOWN" /end COMPU_VTAB
/begin CHARACTERISTIC FLEV_FTstd "FLEV standard tank temperature" VALUE 0x00146872 /* @ECU_Address@FLEV_FTstd@0x010055B8@ */ ECIPP_ALIGNMENT_UWORD 564 Compu_FLEV_FTstd -460 563.984375 /end CHARACTERISTIC
/begin COMPU_METHOD Compu_FLEV_FTstd " " RAT_FUNC "%.1" "deg R" COEFFS 0 64 29440 0 0 1 /end COMPU_METHOD
/begin CHARACTERISTIC FLEV_FTP_empty "FLEV empty fuel tank pressure" VALUE 0x0014686e /* @ECU_Address@FLEV_FTP_empty@0x010055C0@ */ ECIPP_ALIGNMENT_UWORD 8192 Compu_FLEV_FTP_empty 0 8191.875 /end CHARACTERISTIC
/begin COMPU_METHOD Compu_FLEV_FTP_empty " " RAT_FUNC "%.1" "psig" COEFFS 0 8 0 0 0 1 /end COMPU_METHOD
/begin CHARACTERISTIC FLEV_FTP_full "FLEV full fuel tank pressure" VALUE 0x00146870 /* @ECU_Address@FLEV_FTP_full@0x010055C8@ */ ECIPP_ALIGNMENT_UWORD 8192 Compu_FLEV_FTP_full 0 8191.875 /end CHARACTERISTIC
/begin COMPU_METHOD Compu_FLEV_FTP_full " " RAT_FUNC "%.1" "psig" COEFFS 0 8 0 0 0 1 /end COMPU_METHOD
/begin CHARACTERISTIC FLEV_lo_trig "FLEV low fuel trigger" VALUE 0x00146878 /* @ECU_Address@FLEV_lo_trig@0x010055D0@ */ ECIPP_ALIGNMENT_UWORD 100 Compu_FLEV_lo_trig 0 99.9984741210938 /end CHARACTERISTIC
/begin COMPU_METHOD Compu_FLEV_lo_trig " " RAT_FUNC "%.1" "%" COEFFS 0 655.36 0 0 0 1 /end COMPU_METHOD
/begin CHARACTERISTIC FLEV_lo_hyst "FLEV low fuel hysteresis" VALUE 0x00146876 /* @ECU_Address@FLEV_lo_hyst@0x010055D8@ */ ECIPP_ALIGNMENT_UWORD 100 Compu_FLEV_lo_hyst 0 99.9984741210938 /end CHARACTERISTIC
/begin COMPU_METHOD Compu_FLEV_lo_hyst " " RAT_FUNC "%.1" "%" COEFFS 0 655.36 0 0 0 1 /end COMPU_METHOD
/begin CHARACTERISTIC FLEV_lo_LLpct "FLEV low fuel load-limit" VALUE 0x00146874 /* @ECU_Address@FLEV_lo_LLpct@0x010055E0@ */ ECIPP_ALIGNMENT_UWORD 400 Compu_FLEV_lo_LLpct 0 399.993896484375 /end CHARACTERISTIC
/begin COMPU_METHOD Compu_FLEV_lo_LLpct " " RAT_FUNC "%.1" "% max load" COEFFS 0 163.84 0 0 0 1 /end COMPU_METHOD
/begin CHARACTERISTIC FLEVgd_per "FLEV gauge driver PWM period" VALUE 0x0014687a /* @ECU_Address@FLEVgd_per@0x010055E8@ */ ECIPP_ALIGNMENT_UWORD 210 Compu_FLEVgd_per 0 209.712 /end CHARACTERISTIC
/begin COMPU_METHOD Compu_FLEVgd_per " " RAT_FUNC "%.1" "ms" COEFFS 0 312.5 0 0 0 1 /end COMPU_METHOD
/begin MEASUREMENT FLEV_lo_active "FLEV low fuel level" UBYTE Compu_FLEV_lo_active 0 0 0 255 ECU_ADDRESS 0x010055F0 /end MEASUREMENT
/begin COMPU_METHOD Compu_FLEV_lo_active " " RAT_FUNC "%.0" "-" COEFFS 0 1 0 0 0 1 /end COMPU_METHOD
/begin MEASUREMENT FLEV_pct "FLEV fuel level" UWORD Compu_FLEV_pct 0 0 0 99.9984741210938 ECU_ADDRESS 0x010055F8 /end MEASUREMENT
/begin COMPU_METHOD Compu_FLEV_pct " " RAT_FUNC "%.1" "%" COEFFS 0 655.36 0 0 0 1 /end COMPU_METHOD
/begin MEASUREMENT FLEVgd_DC "FLEV gauge driver duty-cycle" UWORD Compu_FLEVgd_DC 0 0 0 99.9984741210938 ECU_ADDRESS 0x01005600 /end MEASUREMENT
/begin COMPU_METHOD Compu_FLEVgd_DC " " RAT_FUNC "%.1" "%" COEFFS 0 655.36 0 0 0 1 /end COMPU_METHOD
/begin CHARACTERISTIC MaxSetPt_rtn_ena "Max set point gov interlock{MaxSetPt_rtn_ena&0xff=0:Disabled}{MaxSetPt_rtn_ena&0xff=1:Enabled}" VALUE 0x00147e86 /* @ECU_Address@MaxSetPt_rtn_ena@0x01005720@ */ ECIPP_ALIGNMENT_UBYTE 255 MaxSetPt_rtn_ena_COMPU_VTAB 0 255 BIT_MASK 0xff /end CHARACTERISTIC
/begin COMPU_METHOD MaxSetPt_rtn_ena_COMPU_VTAB "Verbal Table" TAB_VERB "%.0" "list" COMPU_TAB_REF MaxSetPt_rtn_ena_COMPU_VTAB_REF /end COMPU_METHOD
/begin COMPU_VTAB MaxSetPt_rtn_ena_COMPU_VTAB_REF "Verbal Table" TAB_VERB 2 0 "Disabled" 1 "Enabled" DEFAULT_VALUE "UNKNOWN" /end COMPU_VTAB
/begin CHARACTERISTIC secspd_sw "Secondary speed ctl engagement{secspd_sw&0xff=0:Default}{secspd_sw&0xff=1:Aux PU1=Gnd}{secspd_sw&0xff=2:Aux PU2=Gnd}{secspd_sw&0xff=3:Aux PU3=Gnd}{secspd_sw&0xff=4:Aux PUD1=+5V}{secspd_sw&0xff=5:Aux PUD2=+5V}{secspd_sw&0xff=6:Aux PUD3=+5V}{secspd_sw&0xff=" VALUE 0x001481b3 /* @ECU_Address@secspd_sw@0x01005878@ */ ECIPP_ALIGNMENT_UBYTE 255 secspd_sw_COMPU_VTAB 0 255 BIT_MASK 0xff /end CHARACTERISTIC
/begin COMPU_METHOD secspd_sw_COMPU_VTAB "Verbal Table" TAB_VERB "%.0" "list" COMPU_TAB_REF secspd_sw_COMPU_VTAB_REF /end COMPU_METHOD
/begin COMPU_VTAB secspd_sw_COMPU_VTAB_REF "Verbal Table" TAB_VERB 10 0 "Default" 1 "Aux PU1=Gnd" 2 "Aux PU2=Gnd" 3 "Aux PU3=Gnd" 4 "Aux PUD1=+5V" 5 "Aux PUD2=+5V" 6 "Aux PUD3=+5V" 7 "Aux DIG1=+V" 8 "Aux DIG2=+V" 9 "Aux DIG3=+V" DEFAULT_VALUE "UNKNOWN" /end COMPU_VTAB
/begin MEASUREMENT secspd_ena "Secondary speed control request{secspd_ena&0xff=0:Off}{secspd_ena&0xff=1:On}" UBYTE secspd_ena_COMPU_VTAB 0 0 0 255 ECU_ADDRESS 0x010058A8 BIT_MASK 0xff /end MEASUREMENT
/begin COMPU_METHOD secspd_ena_COMPU_VTAB "Verbal Table" TAB_VERB "%.0" "list" COMPU_TAB_REF secspd_ena_COMPU_VTAB_REF /end COMPU_METHOD
/begin COMPU_VTAB secspd_ena_COMPU_VTAB_REF "Verbal Table" TAB_VERB 2 0 "Off" 1 "On" DEFAULT_VALUE "UNKNOWN" /end COMPU_VTAB
/begin CHARACTERISTIC TransNeut_sw "Trans in-neutral indication{TransNeut_sw&0xff=0:Disabled}{TransNeut_sw&0xff=1:Aux PU1=Gnd}{TransNeut_sw&0xff=2:Aux PU2=Gnd}{TransNeut_sw&0xff=3:Aux PU3=Gnd}{TransNeut_sw&0xff=4:Aux PUD1=+5V}{TransNeut_sw&0xff=5:Aux PUD2=+5V}{TransNeut_sw&0xff=6:Aux PUD3=+" VALUE 0x001480cc /* @ECU_Address@TransNeut_sw@0x01005B08@ */ ECIPP_ALIGNMENT_UBYTE 255 TransNeut_sw_COMPU_VTAB 0 255 BIT_MASK 0xff /end CHARACTERISTIC
/begin COMPU_METHOD TransNeut_sw_COMPU_VTAB "Verbal Table" TAB_VERB "%.0" "list" COMPU_TAB_REF TransNeut_sw_COMPU_VTAB_REF /end COMPU_METHOD
/begin COMPU_VTAB TransNeut_sw_COMPU_VTAB_REF "Verbal Table" TAB_VERB 48 0 "Disabled" 1 "Aux PU1=Gnd" 2 "Aux PU2=Gnd" 3 "Aux PU3=Gnd" 4 "Aux PUD1=+5V" 5 "Aux PUD2=+5V" 6 "Aux PUD3=+5V" 7 "Aux DIG1" 8 "Aux DIG2" 9 "Aux DIG3" 10 "Aux PUD1=Gnd" 11 "Aux PUD2=Gnd" 12 "Aux PUD3=Gnd" 13 "Aux PD1=+5V" 14 "Aux PD2=+5V" 15 "Aux PD3=+5V" 16 "J1939 ETC2" 17 "Aux DIG4" 18 "Aux DIG5" 19 "Aux DIG6" 20 "Aux DIG7" 21 "Aux DIG8" 22 "Aux DIG9" 23 "Aux DIG10" 24 "Aux DIG11" 25 "Aux DIG12" 26 "Aux DIG13" 27 "Aux DIG14" 28 "Aux DIG15" 29 "Aux DIG16" 30 "Aux DIG17" 31 "Aux DIG18" 32 "Aux DIG19" 33 "J1939 BC2" 34 "Aux PUD4" 35 "Aux PUD5" 36 "Aux PUD6" 37 "Aux PUD7" 38 "Aux PUD8" 39 "Aux PUD9" 40 "Aux PUD10" 41 "Aux PUD11" 42 "Aux PUD12" 43 "Aux PUD13" 44 "Aux PUD14" 45 "Aux PUD15" 46 "J1939 DEC1" 47 "J1939 PGN 65473" DEFAULT_VALUE "UNKNOWN" /end COMPU_VTAB
/begin MEASUREMENT TransNeut_ena "Trans in-neutral status{TransNeut_ena&0xff=0:Invalid}{TransNeut_ena&0xff=1:Valid}" UBYTE TransNeut_ena_COMPU_VTAB 0 0 0 255 ECU_ADDRESS 0x01005B10 BIT_MASK 0xff /end MEASUREMENT
/begin COMPU_METHOD TransNeut_ena_COMPU_VTAB "Verbal Table" TAB_VERB "%.0" "list" COMPU_TAB_REF TransNeut_ena_COMPU_VTAB_REF /end COMPU_METHOD
/begin COMPU_VTAB TransNeut_ena_COMPU_VTAB_REF "Verbal Table" TAB_VERB 2 0 "Invalid" 1 "Valid" DEFAULT_VALUE "UNKNOWN" /end COMPU_VTAB
/begin CHARACTERISTIC Gtap_rpmmin_adjust "Minimum speed for setpoint adjustment" VALUE 0x0014744e /* @ECU_Address@Gtap_rpmmin_adjust@0x01005CB8@ */ ECIPP_ALIGNMENT_UWORD 65535 Compu_Gtap_rpmmin_adjust 0 65535 /end CHARACTERISTIC
/begin COMPU_METHOD Compu_Gtap_rpmmin_adjust " " RAT_FUNC "%.0" "rpm" COEFFS 0 1 0 0 0 1 /end COMPU_METHOD
/begin CHARACTERISTIC V1gd_AL_ena "Volt1 gauge driver auto-learn{V1gd_AL_ena&0xff=0:Disabled}{V1gd_AL_ena&0xff=1:2-point mode}{V1gd_AL_ena&0xff=2:3-point mode}" VALUE 0x001480df /* @ECU_Address@V1gd_AL_ena@0x01005D38@ */ ECIPP_ALIGNMENT_UBYTE 255 V1gd_AL_ena_COMPU_VTAB 0 255 BIT_MASK 0xff /end CHARACTERISTIC
/begin COMPU_METHOD V1gd_AL_ena_COMPU_VTAB "Verbal Table" TAB_VERB "%.0" "list" COMPU_TAB_REF V1gd_AL_ena_COMPU_VTAB_REF /end COMPU_METHOD
/begin COMPU_VTAB V1gd_AL_ena_COMPU_VTAB_REF "Verbal Table" TAB_VERB 3 0 "Disabled" 1 "2-point mode" 2 "3-point mode" DEFAULT_VALUE "UNKNOWN" /end COMPU_VTAB
/begin CHARACTERISTIC V1gd_AL_Rlo "Volt1 gauge AL input low R" VALUE 0x001479f2 /* @ECU_Address@V1gd_AL_Rlo@0x01005D40@ */ ECIPP_ALIGNMENT_UWORD 8192 Compu_V1gd_AL_Rlo 0 8191.875 /end CHARACTERISTIC
/begin COMPU_METHOD Compu_V1gd_AL_Rlo " " RAT_FUNC "%.1" "ohms" COEFFS 0 8 0 0 0 1 /end COMPU_METHOD
/begin CHARACTERISTIC V1gd_AL_Rhi "Volt1 gauge AL input high R" VALUE 0x001479f0 /* @ECU_Address@V1gd_AL_Rhi@0x01005D48@ */ ECIPP_ALIGNMENT_UWORD 8192 Compu_V1gd_AL_Rhi 0 8191.875 /end CHARACTERISTIC
/begin COMPU_METHOD Compu_V1gd_AL_Rhi " " RAT_FUNC "%.1" "ohms" COEFFS 0 8 0 0 0 1 /end COMPU_METHOD
/begin CHARACTERISTIC V1gd_AL_Vlo_def "Volt1 gauge AL input low init" VALUE 0x001479f8 /* @ECU_Address@V1gd_AL_Vlo_def@0x01005D50@ */ ECIPP_ALIGNMENT_UWORD 256 Compu_V1gd_AL_Vlo_def 0 255.99609375 /end CHARACTERISTIC
/begin COMPU_METHOD Compu_V1gd_AL_Vlo_def " " RAT_FUNC "%.2" "volts" COEFFS 0 256 0 0 0 1 /end COMPU_METHOD
/begin CHARACTERISTIC V1gd_AL_Vhi_def "Volt1 gauge AL input high init" VALUE 0x001479f6 /* @ECU_Address@V1gd_AL_Vhi_def@0x01005D58@ */ ECIPP_ALIGNMENT_UWORD 256 Compu_V1gd_AL_Vhi_def 0 255.99609375 /end CHARACTERISTIC
/begin COMPU_METHOD Compu_V1gd_AL_Vhi_def " " RAT_FUNC "%.2" "volts" COEFFS 0 256 0 0 0 1 /end COMPU_METHOD
/begin CHARACTERISTIC V1gd_AL_Vrate "Volt1 gauge AL max rate" VALUE 0x001479fc /* @ECU_Address@V1gd_AL_Vrate@0x01005D60@ */ ECIPP_ALIGNMENT_UWORD 5120 Compu_V1gd_AL_Vrate 0 5119.921875 /end CHARACTERISTIC
/begin COMPU_METHOD Compu_V1gd_AL_Vrate " " RAT_FUNC "%.1" "volts/sec" COEFFS 0 12.8 0 0 0 1 /end COMPU_METHOD
/begin MEASUREMENT V1gd_AL_tmr "Volt1 gauge AL disable wait" UWORD Compu_V1gd_AL_tmr 0 0 0 65.535 ECU_ADDRESS 0x01005D68 /end MEASUREMENT
/begin COMPU_METHOD Compu_V1gd_AL_tmr " " RAT_FUNC "%.1" "sec" COEFFS 0 1000 0 0 0 1 /end COMPU_METHOD
/begin MEASUREMENT V1gd_AL_Vlo "Volt1 gauge AL low limit" UWORD Compu_V1gd_AL_Vlo 0 0 0 255.99609375 ECU_ADDRESS 0x01005D70 /end MEASUREMENT
/begin COMPU_METHOD Compu_V1gd_AL_Vlo " " RAT_FUNC "%.2" "volts" COEFFS 0 256 0 0 0 1 /end COMPU_METHOD
/begin MEASUREMENT V1gd_AL_Vhi "Volt1 gauge AL high limit" UWORD Compu_V1gd_AL_Vhi 0 0 0 255.99609375 ECU_ADDRESS 0x01005D78 /end MEASUREMENT
/begin COMPU_METHOD Compu_V1gd_AL_Vhi " " RAT_FUNC "%.2" "volts" COEFFS 0 256 0 0 0 1 /end COMPU_METHOD
/begin MEASUREMENT V1gd_AL_rst "Volt1 gauge AL reset{V1gd_AL_rst&0xff=0:Idle}{V1gd_AL_rst&0xff=1:Reset}" UBYTE V1gd_AL_rst_COMPU_VTAB 0 0 0 255 ECU_ADDRESS 0x01005D80 BIT_MASK 0xff /end MEASUREMENT
/begin COMPU_METHOD V1gd_AL_rst_COMPU_VTAB "Verbal Table" TAB_VERB "%.0" "list" COMPU_TAB_REF V1gd_AL_rst_COMPU_VTAB_REF /end COMPU_METHOD
/begin COMPU_VTAB V1gd_AL_rst_COMPU_VTAB_REF "Verbal Table" TAB_VERB 2 0 "Idle" 1 "Reset" DEFAULT_VALUE "UNKNOWN" /end COMPU_VTAB
/begin CHARACTERISTIC V1gd_AL_Rmid "Volt1 gauge AL input mid R" VALUE 0x001479f4 /* @ECU_Address@V1gd_AL_Rmid@0x01005DA0@ */ ECIPP_ALIGNMENT_UWORD 8192 Compu_V1gd_AL_Rmid 0 8191.875 /end CHARACTERISTIC
/begin COMPU_METHOD Compu_V1gd_AL_Rmid " " RAT_FUNC "%.1" "ohms" COEFFS 0 8 0 0 0 1 /end COMPU_METHOD
/begin CHARACTERISTIC V1gd_AL_Vmid "Volt1 gauge AL input mid" VALUE 0x001479fa /* @ECU_Address@V1gd_AL_Vmid@0x01005DA8@ */ ECIPP_ALIGNMENT_UWORD 256 Compu_V1gd_AL_Vmid 0 255.99609375 /end CHARACTERISTIC
/begin COMPU_METHOD Compu_V1gd_AL_Vmid " " RAT_FUNC "%.2" "volts" COEFFS 0 256 0 0 0 1 /end COMPU_METHOD
/begin CHARACTERISTIC V1gd_AL_DChi "Volt1 gauge AL DC hi" VALUE 0x001479ea /* @ECU_Address@V1gd_AL_DChi@0x01005DB0@ */ ECIPP_ALIGNMENT_UWORD 400 Compu_V1gd_AL_DChi 0 399.993896484375 /end CHARACTERISTIC
/begin COMPU_METHOD Compu_V1gd_AL_DChi " " RAT_FUNC "%.1" "%" COEFFS 0 163.84 0 0 0 1 /end COMPU_METHOD
/begin CHARACTERISTIC V1gd_AL_DCmid "Volt1 gauge AL DC mid" VALUE 0x001479ee /* @ECU_Address@V1gd_AL_DCmid@0x01005DB8@ */ ECIPP_ALIGNMENT_UWORD 400 Compu_V1gd_AL_DCmid 0 399.993896484375 /end CHARACTERISTIC
/begin COMPU_METHOD Compu_V1gd_AL_DCmid " " RAT_FUNC "%.1" "%" COEFFS 0 163.84 0 0 0 1 /end COMPU_METHOD
/begin CHARACTERISTIC V1gd_AL_DClo "Volt1 gauge AL DC lo" VALUE 0x001479ec /* @ECU_Address@V1gd_AL_DClo@0x01005DC0@ */ ECIPP_ALIGNMENT_UWORD 400 Compu_V1gd_AL_DClo 0 399.993896484375 /end CHARACTERISTIC
/begin COMPU_METHOD Compu_V1gd_AL_DClo " " RAT_FUNC "%.1" "%" COEFFS 0 163.84 0 0 0 1 /end COMPU_METHOD
/begin CHARACTERISTIC veh_type "Governor application vehicle type{veh_type&0xff=0:Direct drive}{veh_type&0xff=1:Indirect drive}" VALUE 0x001481c6 /* @ECU_Address@veh_type@0x01006730@ */ ECIPP_ALIGNMENT_UBYTE 255 veh_type_COMPU_VTAB 0 255 BIT_MASK 0xff /end CHARACTERISTIC
/begin COMPU_METHOD veh_type_COMPU_VTAB "Verbal Table" TAB_VERB "%.0" "list" COMPU_TAB_REF veh_type_COMPU_VTAB_REF /end COMPU_METHOD
/begin COMPU_VTAB veh_type_COMPU_VTAB_REF "Verbal Table" TAB_VERB 2 0 "Direct drive" 1 "Indirect drive" DEFAULT_VALUE "UNKNOWN" /end COMPU_VTAB
/begin CHARACTERISTIC clutch_sw "Clutch pedal switch{clutch_sw&0xff=0:Disabled}{clutch_sw&0xff=1:Aux PU1=Gnd}{clutch_sw&0xff=2:Aux PU2=Gnd}{clutch_sw&0xff=3:Aux PU3=Gnd}{clutch_sw&0xff=4:Aux PUD1=+5V}{clutch_sw&0xff=5:Aux PUD2=+5V}{clutch_sw&0xff=6:Aux PUD3=+5V}{clutch_sw&0xff=7:Aux DIG1" VALUE 0x00148128 /* @ECU_Address@clutch_sw@0x01007280@ */ ECIPP_ALIGNMENT_UBYTE 255 clutch_sw_COMPU_VTAB 0 255 BIT_MASK 0xff /end CHARACTERISTIC
/begin COMPU_METHOD clutch_sw_COMPU_VTAB "Verbal Table" TAB_VERB "%.0" "list" COMPU_TAB_REF clutch_sw_COMPU_VTAB_REF /end COMPU_METHOD
/begin COMPU_VTAB clutch_sw_COMPU_VTAB_REF "Verbal Table" TAB_VERB 34 0 "Disabled" 1 "Aux PU1=Gnd" 2 "Aux PU2=Gnd" 3 "Aux PU3=Gnd" 4 "Aux PUD1=+5V" 5 "Aux PUD2=+5V" 6 "Aux PUD3=+5V" 7 "Aux DIG1" 8 "Aux DIG2" 9 "Aux DIG3" 10 "Aux PUD1=Gnd" 11 "Aux PUD2=Gnd" 12 "Aux PUD3=Gnd" 13 "Aux PD1=+5V" 14 "Aux PD2=+5V" 15 "Aux PD3=+5V" 16 "J1939 ETC1" 17 "J1939 CCVS" 18 "Aux DIG4" 19 "Aux DIG5" 20 "Aux DIG6" 21 "Aux DIG7" 22 "Aux DIG8" 23 "Aux DIG9" 24 "Aux DIG10" 25 "Aux DIG11" 26 "Aux DIG12" 27 "Aux DIG13" 28 "Aux DIG14" 29 "Aux DIG15" 30 "Aux DIG16" 31 "Aux DIG17" 32 "Aux DIG18" 33 "Aux DIG19" DEFAULT_VALUE "UNKNOWN" /end COMPU_VTAB
/begin MEASUREMENT clutch_depressed "Clutch pedal depressed{clutch_depressed&0xff=0:Released}{clutch_depressed&0xff=1:Depressed}" UBYTE clutch_depressed_COMPU_VTAB 0 0 0 255 ECU_ADDRESS 0x01007288 BIT_MASK 0xff /end MEASUREMENT
/begin COMPU_METHOD clutch_depressed_COMPU_VTAB "Verbal Table" TAB_VERB "%.0" "list" COMPU_TAB_REF clutch_depressed_COMPU_VTAB_REF /end COMPU_METHOD
/begin COMPU_VTAB clutch_depressed_COMPU_VTAB_REF "Verbal Table" TAB_VERB 2 0 "Released" 1 "Depressed" DEFAULT_VALUE "UNKNOWN" /end COMPU_VTAB
/begin CHARACTERISTIC strt_max_FPP "Start max FPP" VALUE 0x00147ba2 /* @ECU_Address@strt_max_FPP@0x010077F8@ */ ECIPP_ALIGNMENT_UWORD 100 Compu_strt_max_FPP 0 99.9984741210938 /end CHARACTERISTIC
/begin COMPU_METHOD Compu_strt_max_FPP " " RAT_FUNC "%.1" "%" COEFFS 0 655.36 0 0 0 1 /end COMPU_METHOD
/begin MEASUREMENT clutch_fault "Clutch fault{clutch_fault&0xff=0:NO}{clutch_fault&0xff=1:YES}" UBYTE clutch_fault_COMPU_VTAB 0 0 0 255 ECU_ADDRESS 0x01007930 BIT_MASK 0xff /end MEASUREMENT
/begin COMPU_METHOD clutch_fault_COMPU_VTAB "Verbal Table" TAB_VERB "%.0" "list" COMPU_TAB_REF clutch_fault_COMPU_VTAB_REF /end COMPU_METHOD
/begin COMPU_VTAB clutch_fault_COMPU_VTAB_REF "Verbal Table" TAB_VERB 2 0 "NO" 1 "YES" DEFAULT_VALUE "UNKNOWN" /end COMPU_VTAB
/begin CHARACTERISTIC clutch_sw_config "Clutch pedal configuration{clutch_sw_config&0xff=0:Bi-state/Tri-state open=released}{clutch_sw_config&0xff=1:Tri-state open=depressed}{clutch_sw_config&0xff=2:Aux DIG +V=released}{clutch_sw_config&0xff=3:Aux DIG +V=depressed}" VALUE 0x00148129 /* @ECU_Address@clutch_sw_config@0x01007948@ */ ECIPP_ALIGNMENT_UBYTE 255 clutch_sw_config_COMPU_VTAB 0 255 BIT_MASK 0xff /end CHARACTERISTIC
/begin COMPU_METHOD clutch_sw_config_COMPU_VTAB "Verbal Table" TAB_VERB "%.0" "list" COMPU_TAB_REF clutch_sw_config_COMPU_VTAB_REF /end COMPU_METHOD
/begin COMPU_VTAB clutch_sw_config_COMPU_VTAB_REF "Verbal Table" TAB_VERB 4 0 "Bi-state/Tri-state open=released" 1 "Tri-state open=depressed" 2 "Aux DIG +V=released" 3 "Aux DIG +V=depressed" DEFAULT_VALUE "UNKNOWN" /end COMPU_VTAB
/begin CHARACTERISTIC gov_rs_ena "Roadspeed based gains{gov_rs_ena&0xff=0:Disabled}{gov_rs_ena&0xff=1:Enabled}" VALUE 0x00148190 /* @ECU_Address@gov_rs_ena@0x0100C7B0@ */ ECIPP_ALIGNMENT_UBYTE 255 gov_rs_ena_COMPU_VTAB 0 255 BIT_MASK 0xff /end CHARACTERISTIC
/begin COMPU_METHOD gov_rs_ena_COMPU_VTAB "Verbal Table" TAB_VERB "%.0" "list" COMPU_TAB_REF gov_rs_ena_COMPU_VTAB_REF /end COMPU_METHOD
/begin COMPU_VTAB gov_rs_ena_COMPU_VTAB_REF "Verbal Table" TAB_VERB 2 0 "Disabled" 1 "Enabled" DEFAULT_VALUE "UNKNOWN" /end COMPU_VTAB
/begin CHARACTERISTIC TransNeut_sw_cfg "Trans in-neutral Aux DIG config{TransNeut_sw_cfg&0xff=0:Default}{TransNeut_sw_cfg&0xff=1:GND}{TransNeut_sw_cfg&0xff=2:GND/+V}{TransNeut_sw_cfg&0xff=3:+V}{TransNeut_sw_cfg&0xff=4:Open}" VALUE 0x001480cd /* @ECU_Address@TransNeut_sw_cfg@0x0100C7D8@ */ ECIPP_ALIGNMENT_UBYTE 255 TransNeut_sw_cfg_COMPU_VTAB 0 255 BIT_MASK 0xff /end CHARACTERISTIC
/begin COMPU_METHOD TransNeut_sw_cfg_COMPU_VTAB "Verbal Table" TAB_VERB "%.0" "list" COMPU_TAB_REF TransNeut_sw_cfg_COMPU_VTAB_REF /end COMPU_METHOD
/begin COMPU_VTAB TransNeut_sw_cfg_COMPU_VTAB_REF "Verbal Table" TAB_VERB 5 0 "Default" 1 "GND" 2 "GND/+V" 3 "+V" 4 "Open" DEFAULT_VALUE "UNKNOWN" /end COMPU_VTAB
/begin MEASUREMENT Linde_ff_loadval "Current feedforward gov load" SWORD Compu_Linde_ff_loadval 0 0 -800 799.9755859375 ECU_ADDRESS 0x0100CD60 /end MEASUREMENT
/begin COMPU_METHOD Compu_Linde_ff_loadval " " RAT_FUNC "%.1" "%" COEFFS 0 40.96 0 0 0 1 /end COMPU_METHOD
/begin CHARACTERISTIC gov_gain_gsln_dis "Gasoline mode governor gains discrete{gov_gain_gsln_dis&0xff=0:Standard 1}{gov_gain_gsln_dis&0xff=1:Alternate 1}{gov_gain_gsln_dis&0xff=2:Standard 2}{gov_gain_gsln_dis&0xff=3:Alternate 2}" VALUE 0x0014818e /* @ECU_Address@gov_gain_gsln_dis@0x0100E7C0@ */ ECIPP_ALIGNMENT_UBYTE 255 gov_gain_gsln_dis_COMPU_VTAB 0 255 BIT_MASK 0xff /end CHARACTERISTIC
/begin COMPU_METHOD gov_gain_gsln_dis_COMPU_VTAB "Verbal Table" TAB_VERB "%.0" "list" COMPU_TAB_REF gov_gain_gsln_dis_COMPU_VTAB_REF /end COMPU_METHOD
/begin COMPU_VTAB gov_gain_gsln_dis_COMPU_VTAB_REF "Verbal Table" TAB_VERB 4 0 "Standard 1" 1 "Alternate 1" 2 "Standard 2" 3 "Alternate 2" DEFAULT_VALUE "UNKNOWN" /end COMPU_VTAB
/begin CHARACTERISTIC gov_gain_LPG_dis "LPG mode governor gains descrete{gov_gain_LPG_dis&0xff=0:Standard 1}{gov_gain_LPG_dis&0xff=1:Alternate 1}{gov_gain_LPG_dis&0xff=2:Standard 2}{gov_gain_LPG_dis&0xff=3:Alternate 2}" VALUE 0x0014818a /* @ECU_Address@gov_gain_LPG_dis@0x0100E7C8@ */ ECIPP_ALIGNMENT_UBYTE 255 gov_gain_LPG_dis_COMPU_VTAB 0 255 BIT_MASK 0xff /end CHARACTERISTIC
/begin COMPU_METHOD gov_gain_LPG_dis_COMPU_VTAB "Verbal Table" TAB_VERB "%.0" "list" COMPU_TAB_REF gov_gain_LPG_dis_COMPU_VTAB_REF /end COMPU_METHOD
/begin COMPU_VTAB gov_gain_LPG_dis_COMPU_VTAB_REF "Verbal Table" TAB_VERB 4 0 "Standard 1" 1 "Alternate 1" 2 "Standard 2" 3 "Alternate 2" DEFAULT_VALUE "UNKNOWN" /end COMPU_VTAB
/begin CHARACTERISTIC gov_gain_NG_dis "NG  mode governor gains discrete{gov_gain_NG_dis&0xff=0:Standard 1}{gov_gain_NG_dis&0xff=1:Alternate 1}{gov_gain_NG_dis&0xff=2:Standard 2}{gov_gain_NG_dis&0xff=3:Alternate 2}" VALUE 0x0014818c /* @ECU_Address@gov_gain_NG_dis@0x0100E7D0@ */ ECIPP_ALIGNMENT_UBYTE 255 gov_gain_NG_dis_COMPU_VTAB 0 255 BIT_MASK 0xff /end CHARACTERISTIC
/begin COMPU_METHOD gov_gain_NG_dis_COMPU_VTAB "Verbal Table" TAB_VERB "%.0" "list" COMPU_TAB_REF gov_gain_NG_dis_COMPU_VTAB_REF /end COMPU_METHOD
/begin COMPU_VTAB gov_gain_NG_dis_COMPU_VTAB_REF "Verbal Table" TAB_VERB 4 0 "Standard 1" 1 "Alternate 1" 2 "Standard 2" 3 "Alternate 2" DEFAULT_VALUE "UNKNOWN" /end COMPU_VTAB
/begin CHARACTERISTIC Gov1_spk_att_ena "Gov1 spark attenuation{Gov1_spk_att_ena&0xff=0x00:Disabled}{Gov1_spk_att_ena&0xff=0x01:Enabled}" VALUE 0x00147da6 /* @ECU_Address@Gov1_spk_att_ena@0x01012C50@ */ ECIPP_ALIGNMENT_UBYTE 255 Gov1_spk_att_ena_COMPU_VTAB 0 255 BIT_MASK 0xff /end CHARACTERISTIC
/begin COMPU_METHOD Gov1_spk_att_ena_COMPU_VTAB "Verbal Table" TAB_VERB "%.0" "list" COMPU_TAB_REF Gov1_spk_att_ena_COMPU_VTAB_REF /end COMPU_METHOD
/begin COMPU_VTAB Gov1_spk_att_ena_COMPU_VTAB_REF "Verbal Table" TAB_VERB 2 0x00 "Disabled" 0x01 "Enabled" DEFAULT_VALUE "UNKNOWN" /end COMPU_VTAB
/begin CHARACTERISTIC Gov2_spk_att_ena "Gov2 spark attenuation{Gov2_spk_att_ena&0xff=0x00:Disabled}{Gov2_spk_att_ena&0xff=0x01:Enabled}" VALUE 0x00147da8 /* @ECU_Address@Gov2_spk_att_ena@0x01012C58@ */ ECIPP_ALIGNMENT_UBYTE 255 Gov2_spk_att_ena_COMPU_VTAB 0 255 BIT_MASK 0xff /end CHARACTERISTIC
/begin COMPU_METHOD Gov2_spk_att_ena_COMPU_VTAB "Verbal Table" TAB_VERB "%.0" "list" COMPU_TAB_REF Gov2_spk_att_ena_COMPU_VTAB_REF /end COMPU_METHOD
/begin COMPU_VTAB Gov2_spk_att_ena_COMPU_VTAB_REF "Verbal Table" TAB_VERB 2 0x00 "Disabled" 0x01 "Enabled" DEFAULT_VALUE "UNKNOWN" /end COMPU_VTAB
/begin MEASUREMENT gov_auth_max "Governor max authority" UWORD Compu_gov_auth_max 0 0 0 99.9984741210938 ECU_ADDRESS 0x01012CE0 /end MEASUREMENT
/begin COMPU_METHOD Compu_gov_auth_max " " RAT_FUNC "%.1" "%" COEFFS 0 655.36 0 0 0 1 /end COMPU_METHOD
/begin CHARACTERISTIC Gtap_setmin_wait "Tap up/down set minimum debounce" VALUE 0x00147450 /* @ECU_Address@Gtap_setmin_wait@0x01012D58@ */ ECIPP_ALIGNMENT_UWORD 65535 Compu_Gtap_setmin_wait 0 65535 /end CHARACTERISTIC
/begin COMPU_METHOD Compu_Gtap_setmin_wait " " RAT_FUNC "%.0" "ms" COEFFS 0 1 0 0 0 1 /end COMPU_METHOD
/begin CHARACTERISTIC AMT_Gov3_acc_init "AMT TSC1 Gov3 initial integrator" VALUE 0x00143c80 /* @ECU_Address@AMT_Gov3_acc_init@0x01013460@ */ ECIPP_ALIGNMENT_SLONG 800 Compu_AMT_Gov3_acc_init -800 799.999999627471 /end CHARACTERISTIC
/begin COMPU_METHOD Compu_AMT_Gov3_acc_init " " RAT_FUNC "%.1" "%" COEFFS 0 2684354.56 0 0 0 1 /end COMPU_METHOD
/begin CHARACTERISTIC AMT_select "AMT selection{AMT_select&0xff=0:Disabled}{AMT_select&0xff=1:WABCO}" VALUE 0x00147cd0 /* @ECU_Address@AMT_select@0x01013468@ */ ECIPP_ALIGNMENT_UBYTE 255 AMT_select_COMPU_VTAB 0 255 BIT_MASK 0xff /end CHARACTERISTIC
/begin COMPU_METHOD AMT_select_COMPU_VTAB "Verbal Table" TAB_VERB "%.0" "list" COMPU_TAB_REF AMT_select_COMPU_VTAB_REF /end COMPU_METHOD
/begin COMPU_VTAB AMT_select_COMPU_VTAB_REF "Verbal Table" TAB_VERB 2 0 "Disabled" 1 "WABCO" DEFAULT_VALUE "UNKNOWN" /end COMPU_VTAB
/begin CHARACTERISTIC AMT_Gov3_acc_maxload "AMT Gov3 integrator reset max load" VALUE 0x00146694 /* @ECU_Address@AMT_Gov3_acc_maxload@0x01013470@ */ ECIPP_ALIGNMENT_UWORD 100 Compu_AMT_Gov3_acc_maxload 0 99.9984741210938 /end CHARACTERISTIC
/begin COMPU_METHOD Compu_AMT_Gov3_acc_maxload " " RAT_FUNC "%.1" "%" COEFFS 0 655.36 0 0 0 1 /end COMPU_METHOD
/begin CHARACTERISTIC IPAS_mode "Idle pull away speed mode{IPAS_mode&0xff=0:Disabled}{IPAS_mode&0xff=1:Vehicle speed only}{IPAS_mode&0xff=2:Vehicle speed + parking brake}{IPAS_mode&0xff=3:Vehicle speed + parking brake + foot brake}" VALUE 0x00147ddd /* @ECU_Address@IPAS_mode@0x01013680@ */ ECIPP_ALIGNMENT_UBYTE 255 IPAS_mode_COMPU_VTAB 0 255 BIT_MASK 0xff /end CHARACTERISTIC
/begin COMPU_METHOD IPAS_mode_COMPU_VTAB "Verbal Table" TAB_VERB "%.0" "list" COMPU_TAB_REF IPAS_mode_COMPU_VTAB_REF /end COMPU_METHOD
/begin COMPU_VTAB IPAS_mode_COMPU_VTAB_REF "Verbal Table" TAB_VERB 4 0 "Disabled" 1 "Vehicle speed only" 2 "Vehicle speed + parking brake" 3 "Vehicle speed + parking brake + foot brake" DEFAULT_VALUE "UNKNOWN" /end COMPU_VTAB
/begin CHARACTERISTIC IPAS_rpm "Idle pull away speed" VALUE 0x001474c6 /* @ECU_Address@IPAS_rpm@0x01013688@ */ ECIPP_ALIGNMENT_UWORD 65535 Compu_IPAS_rpm 0 65535 /end CHARACTERISTIC
/begin COMPU_METHOD Compu_IPAS_rpm " " RAT_FUNC "%.0" "rpm" COEFFS 0 1 0 0 0 1 /end COMPU_METHOD
/begin CHARACTERISTIC IPAS_speed_on "Idle pull away engage min roadspeed" VALUE 0x001474ca /* @ECU_Address@IPAS_speed_on@0x01013690@ */ ECIPP_ALIGNMENT_UWORD 256 Compu_IPAS_speed_on 0 255.99609375 /end CHARACTERISTIC
/begin COMPU_METHOD Compu_IPAS_speed_on " " RAT_FUNC "%.1" "kph" COEFFS 0 256 0 0 0 1 /end COMPU_METHOD
/begin CHARACTERISTIC IPAS_speed_off "Idle pull away disengage max roadspeed" VALUE 0x001474c8 /* @ECU_Address@IPAS_speed_off@0x01013698@ */ ECIPP_ALIGNMENT_UWORD 256 Compu_IPAS_speed_off 0 255.99609375 /end CHARACTERISTIC
/begin COMPU_METHOD Compu_IPAS_speed_off " " RAT_FUNC "%.1" "kph" COEFFS 0 256 0 0 0 1 /end COMPU_METHOD
/begin MEASUREMENT IPAS_engaged "Idle pull away speed engaged{IPAS_engaged&0xff=0:NO}{IPAS_engaged&0xff=1:YES}" UBYTE IPAS_engaged_COMPU_VTAB 0 0 0 255 ECU_ADDRESS 0x010136A0 BIT_MASK 0xff /end MEASUREMENT
/begin COMPU_METHOD IPAS_engaged_COMPU_VTAB "Verbal Table" TAB_VERB "%.0" "list" COMPU_TAB_REF IPAS_engaged_COMPU_VTAB_REF /end COMPU_METHOD
/begin COMPU_VTAB IPAS_engaged_COMPU_VTAB_REF "Verbal Table" TAB_VERB 2 0 "NO" 1 "YES" DEFAULT_VALUE "UNKNOWN" /end COMPU_VTAB
/begin MEASUREMENT min_allspeed_rpm "FPP speed control min gov rpm" UWORD Compu_min_allspeed_rpm 0 0 0 65535 ECU_ADDRESS 0x010136A8 /end MEASUREMENT
/begin COMPU_METHOD Compu_min_allspeed_rpm " " RAT_FUNC "%.0" "rpm" COEFFS 0 1 0 0 0 1 /end COMPU_METHOD
/begin CHARACTERISTIC AMT_neut_coast_mode "AMT neutral coasting{AMT_neut_coast_mode&0xff=0:Disabled}{AMT_neut_coast_mode&0xff=1:WABCO}" VALUE 0x00147ccf /* @ECU_Address@AMT_neut_coast_mode@0x01013900@ */ ECIPP_ALIGNMENT_UBYTE 255 AMT_neut_coast_mode_COMPU_VTAB 0 255 BIT_MASK 0xff /end CHARACTERISTIC
/begin COMPU_METHOD AMT_neut_coast_mode_COMPU_VTAB "Verbal Table" TAB_VERB "%.0" "list" COMPU_TAB_REF AMT_neut_coast_mode_COMPU_VTAB_REF /end COMPU_METHOD
/begin COMPU_VTAB AMT_neut_coast_mode_COMPU_VTAB_REF "Verbal Table" TAB_VERB 2 0 "Disabled" 1 "WABCO" DEFAULT_VALUE "UNKNOWN" /end COMPU_VTAB
/begin MEASUREMENT AMT_RSC_suspend "AMT suspend cruise status{AMT_RSC_suspend&0xff=0x00:Disabled}{AMT_RSC_suspend&0xff=0x01:Inactive}{AMT_RSC_suspend&0xff=0x22:Suspended}{AMT_RSC_suspend&0xff=0x23:Resuming}{AMT_RSC_suspend&0xff=0x14:Resumed}{AMT_RSC_suspend&0xff=0x45:Cancelled}" UBYTE AMT_RSC_suspend_COMPU_VTAB 0 0 0 255 ECU_ADDRESS 0x01013908 BIT_MASK 0xff /end MEASUREMENT
/begin COMPU_METHOD AMT_RSC_suspend_COMPU_VTAB "Verbal Table" TAB_VERB "%.0" "list" COMPU_TAB_REF AMT_RSC_suspend_COMPU_VTAB_REF /end COMPU_METHOD
/begin COMPU_VTAB AMT_RSC_suspend_COMPU_VTAB_REF "Verbal Table" TAB_VERB 6 0x00 "Disabled" 0x01 "Inactive" 0x22 "Suspended" 0x23 "Resuming" 0x14 "Resumed" 0x45 "Cancelled" DEFAULT_VALUE "UNKNOWN" /end COMPU_VTAB
/begin MEASUREMENT max_gov_highidle_rpm "High idle speed" UWORD Compu_max_gov_highidle_rpm 0 0 0 65535 ECU_ADDRESS 0x01013960 /end MEASUREMENT
/begin COMPU_METHOD Compu_max_gov_highidle_rpm " " RAT_FUNC "%.0" "rpm" COEFFS 0 1 0 0 0 1 /end COMPU_METHOD
/begin COMPU_METHOD Compu_TIdle_ECT_ECT " " RAT_FUNC "%.0" "ECT (deg F)" COEFFS 0 32 14720 0 0 1 /end COMPU_METHOD
/begin CHARACTERISTIC TIdle_ECT_rpm "Idle Speed Schedule" CURVE 0x00144F8A /* @ECU_Address@TIdle_ECT_rpm@0x02042000@ */ ECIPP_ALIGNMENT_SWORD 32767 Compu_TIdle_ECT_rpm -32768 32767
 /begin AXIS_DESCR COM_AXIS NO_INPUT_QUANTITY Compu_TIdle_ECT_ECT 4 -1484 563.96875 AXIS_PTS_REF TIdle_ECT_ECT /end AXIS_DESCR
/end CHARACTERISTIC
/begin AXIS_PTS TIdle_ECT_ECT " " 0x00144F82 /* @ECU_Address@TIdle_ECT_ECT@0x02041000@ */ NO_INPUT_QUANTITY ECIPP_Lookup_SWORD 0 Compu_TIdle_ECT_ECT 4 -1484 563.96875 /end AXIS_PTS
/begin COMPU_METHOD Compu_TIdle_ECT_rpm " " RAT_FUNC "%.0" "Idle (rpm)" COEFFS 0 1 0 0 0 1 /end COMPU_METHOD
/begin COMPU_METHOD Compu_TspdK_rpm_rpm " " RAT_FUNC "%.0" "Speed (rpm)" COEFFS 0 1 0 0 0 1 /end COMPU_METHOD
/begin CHARACTERISTIC TspdK_rpm_Kp "Isochronous Speed Gains" CURVE 0x001461EE /* @ECU_Address@TspdK_rpm_Kp@0x02044000@ */ ECIPP_ALIGNMENT_SWORD 3125 Compu_TspdK_rpm_Kp -3125 3124.90463256836
 /begin AXIS_DESCR COM_AXIS NO_INPUT_QUANTITY Compu_TspdK_rpm_rpm 4 -32768 32767 AXIS_PTS_REF TspdK_rpm_rpm /end AXIS_DESCR
/end CHARACTERISTIC
/begin AXIS_PTS TspdK_rpm_rpm " " 0x0014620E /* @ECU_Address@TspdK_rpm_rpm@0x02043000@ */ NO_INPUT_QUANTITY ECIPP_Lookup_SWORD 0 Compu_TspdK_rpm_rpm 4 -32768 32767 /end AXIS_PTS
/begin COMPU_METHOD Compu_TspdK_rpm_Kp " " RAT_FUNC "%.1" "Kp rpm (%/krpm)" COEFFS 0 10.48576 0 0 0 1 /end COMPU_METHOD
/begin CHARACTERISTIC TspdK_rpm_Kd "Isochronous Speed Gains" CURVE 0x001461D6 /* @ECU_Address@TspdK_rpm_Kd@0x02045000@ */ ECIPP_ALIGNMENT_SWORD 1600 Compu_TspdK_rpm_Kd -1600 1599.951171875
 /begin AXIS_DESCR COM_AXIS NO_INPUT_QUANTITY Compu_TspdK_rpm_rpm 4 -32768 32767 AXIS_PTS_REF TspdK_rpm_rpm /end AXIS_DESCR
/end CHARACTERISTIC
/begin COMPU_METHOD Compu_TspdK_rpm_Kd " " RAT_FUNC "%.2" "Kd rpm (%/(krpm/s))" COEFFS 0 20.48 0 0 0 1 /end COMPU_METHOD
/begin CHARACTERISTIC TspdK_rpm_KMAPdt "Isochronous Speed Gains" CURVE 0x001461C6 /* @ECU_Address@TspdK_rpm_KMAPdt@0x02046000@ */ ECIPP_ALIGNMENT_SWORD 1000 Compu_TspdK_rpm_KMAPdt -1000 999.969482421875
 /begin AXIS_DESCR COM_AXIS NO_INPUT_QUANTITY Compu_TspdK_rpm_rpm 4 -32768 32767 AXIS_PTS_REF TspdK_rpm_rpm /end AXIS_DESCR
/end CHARACTERISTIC
/begin COMPU_METHOD Compu_TspdK_rpm_KMAPdt " " RAT_FUNC "%.1" "K dMAPdt (1/sec)" COEFFS 0 32.768 0 0 0 1 /end COMPU_METHOD
/begin COMPU_METHOD Compu_TspdK_ECT_ECT " " RAT_FUNC "%.0" "ECT (deg F)" COEFFS 0 32 14720 0 0 1 /end COMPU_METHOD
/begin CHARACTERISTIC TspdK_ECT_Kpm "Governor Gain Corrections" CURVE 0x001461AE /* @ECU_Address@TspdK_ECT_Kpm@0x02048000@ */ ECIPP_ALIGNMENT_SWORD 8 Compu_TspdK_ECT_Kpm -8 7.999755859375
 /begin AXIS_DESCR COM_AXIS NO_INPUT_QUANTITY Compu_TspdK_ECT_ECT 4 -1484 563.96875 AXIS_PTS_REF TspdK_ECT_ECT /end AXIS_DESCR
/end CHARACTERISTIC
/begin AXIS_PTS TspdK_ECT_ECT " " 0x0014617E /* @ECU_Address@TspdK_ECT_ECT@0x02047000@ */ NO_INPUT_QUANTITY ECIPP_Lookup_SWORD 0 Compu_TspdK_ECT_ECT 4 -1484 563.96875 /end AXIS_PTS
/begin COMPU_METHOD Compu_TspdK_ECT_Kpm " " RAT_FUNC "%.3" "Kp Multiplier" COEFFS 0 4096 0 0 0 1 /end COMPU_METHOD
/begin CHARACTERISTIC TspdK_rpm_Ki "Isochronous Speed Gains" CURVE 0x001461DE /* @ECU_Address@TspdK_rpm_Ki@0x02073000@ */ ECIPP_ALIGNMENT_SWORD 12207 Compu_TspdK_rpm_Ki -12207.03125 12206.6587209702
 /begin AXIS_DESCR COM_AXIS NO_INPUT_QUANTITY Compu_TspdK_rpm_rpm 4 -32768 32767 AXIS_PTS_REF TspdK_rpm_rpm /end AXIS_DESCR
/end CHARACTERISTIC
/begin COMPU_METHOD Compu_TspdK_rpm_Ki " " RAT_FUNC "%.1" "Ki rpm (%/krpm/s)" COEFFS 0 2.68435456 0 0 0 1 /end COMPU_METHOD
/begin CHARACTERISTIC TspdK_rpm_KMdtfb "Isochronous Speed Gains" CURVE 0x001461CE /* @ECU_Address@TspdK_rpm_KMdtfb@0x0207E000@ */ ECIPP_ALIGNMENT_SWORD 32 Compu_TspdK_rpm_KMdtfb -32 31.9990234375
 /begin AXIS_DESCR COM_AXIS NO_INPUT_QUANTITY Compu_TspdK_rpm_rpm 4 -32768 32767 AXIS_PTS_REF TspdK_rpm_rpm /end AXIS_DESCR
/end CHARACTERISTIC
/begin COMPU_METHOD Compu_TspdK_rpm_KMdtfb " " RAT_FUNC "%.3" "K dMAPdt FB (fraction)" COEFFS 0 1024 0 0 0 1 /end COMPU_METHOD
/begin CHARACTERISTIC TspdK_rpm_dzKp "Isochronous Speed Gains" CURVE 0x00146206 /* @ECU_Address@TspdK_rpm_dzKp@0x0207F000@ */ ECIPP_ALIGNMENT_SWORD 32767 Compu_TspdK_rpm_dzKp -32768 32767
 /begin AXIS_DESCR COM_AXIS NO_INPUT_QUANTITY Compu_TspdK_rpm_rpm 4 -32768 32767 AXIS_PTS_REF TspdK_rpm_rpm /end AXIS_DESCR
/end CHARACTERISTIC
/begin COMPU_METHOD Compu_TspdK_rpm_dzKp " " RAT_FUNC "%.0" "dead-zone (rpm)" COEFFS 0 1 0 0 0 1 /end COMPU_METHOD
/begin CHARACTERISTIC TspdK_rpm_dzKi "Isochronous Speed Gains" CURVE 0x001461FE /* @ECU_Address@TspdK_rpm_dzKi@0x02080000@ */ ECIPP_ALIGNMENT_SWORD 32767 Compu_TspdK_rpm_dzKi -32768 32767
 /begin AXIS_DESCR COM_AXIS NO_INPUT_QUANTITY Compu_TspdK_rpm_rpm 4 -32768 32767 AXIS_PTS_REF TspdK_rpm_rpm /end AXIS_DESCR
/end CHARACTERISTIC
/begin COMPU_METHOD Compu_TspdK_rpm_dzKi " " RAT_FUNC "%.0" "dead-zone (rpm)" COEFFS 0 1 0 0 0 1 /end COMPU_METHOD
/begin CHARACTERISTIC TspdK_rpm_dzKd "Isochronous Speed Gains" CURVE 0x001461F6 /* @ECU_Address@TspdK_rpm_dzKd@0x02081000@ */ ECIPP_ALIGNMENT_SWORD 63998 Compu_TspdK_rpm_dzKd -64000 63998.046875
 /begin AXIS_DESCR COM_AXIS NO_INPUT_QUANTITY Compu_TspdK_rpm_rpm 4 -32768 32767 AXIS_PTS_REF TspdK_rpm_rpm /end AXIS_DESCR
/end CHARACTERISTIC
/begin COMPU_METHOD Compu_TspdK_rpm_dzKd " " RAT_FUNC "%.0" "dead-zone (rpm/sec)" COEFFS 0 0.512 0 0 0 1 /end COMPU_METHOD
/begin CHARACTERISTIC TspdK_rpm_Ifrz "Isochronous Speed Gains" CURVE 0x001461BE /* @ECU_Address@TspdK_rpm_Ifrz@0x02082000@ */ ECIPP_ALIGNMENT_SWORD 63998 Compu_TspdK_rpm_Ifrz -64000 63998.046875
 /begin AXIS_DESCR COM_AXIS NO_INPUT_QUANTITY Compu_TspdK_rpm_rpm 4 -32768 32767 AXIS_PTS_REF TspdK_rpm_rpm /end AXIS_DESCR
/end CHARACTERISTIC
/begin COMPU_METHOD Compu_TspdK_rpm_Ifrz " " RAT_FUNC "%.0" "freeze (rpm/sec)" COEFFS 0 0.512 0 0 0 1 /end COMPU_METHOD
/begin COMPU_METHOD Compu_TdrpK_rpm_rpm " " RAT_FUNC "%.0" "Speed (rpm)" COEFFS 0 1 0 0 0 1 /end COMPU_METHOD
/begin CHARACTERISTIC TdrpK_rpm_Kp "Droop Speed Gains" CURVE 0x00145DD2 /* @ECU_Address@TdrpK_rpm_Kp@0x02084000@ */ ECIPP_ALIGNMENT_SWORD 3125 Compu_TdrpK_rpm_Kp -3125 3124.90463256836
 /begin AXIS_DESCR COM_AXIS NO_INPUT_QUANTITY Compu_TdrpK_rpm_rpm 4 -32768 32767 AXIS_PTS_REF TdrpK_rpm_rpm /end AXIS_DESCR
/end CHARACTERISTIC
/begin AXIS_PTS TdrpK_rpm_rpm " " 0x00145DF2 /* @ECU_Address@TdrpK_rpm_rpm@0x02083000@ */ NO_INPUT_QUANTITY ECIPP_Lookup_SWORD 0 Compu_TdrpK_rpm_rpm 4 -32768 32767 /end AXIS_PTS
/begin COMPU_METHOD Compu_TdrpK_rpm_Kp " " RAT_FUNC "%.1" "Kp rpm (%/krpm)" COEFFS 0 10.48576 0 0 0 1 /end COMPU_METHOD
/begin CHARACTERISTIC TdrpK_rpm_Kd "Droop Speed Gains" CURVE 0x00145DBA /* @ECU_Address@TdrpK_rpm_Kd@0x02085000@ */ ECIPP_ALIGNMENT_SWORD 1600 Compu_TdrpK_rpm_Kd -1600 1599.951171875
 /begin AXIS_DESCR COM_AXIS NO_INPUT_QUANTITY Compu_TdrpK_rpm_rpm 4 -32768 32767 AXIS_PTS_REF TdrpK_rpm_rpm /end AXIS_DESCR
/end CHARACTERISTIC
/begin COMPU_METHOD Compu_TdrpK_rpm_Kd " " RAT_FUNC "%.2" "Kd rpm (%/(krpm/s))" COEFFS 0 20.48 0 0 0 1 /end COMPU_METHOD
/begin CHARACTERISTIC TdrpK_rpm_Ki "Droop Speed Gains" CURVE 0x00145DC2 /* @ECU_Address@TdrpK_rpm_Ki@0x02086000@ */ ECIPP_ALIGNMENT_SWORD 12207 Compu_TdrpK_rpm_Ki -12207.03125 12206.6587209702
 /begin AXIS_DESCR COM_AXIS NO_INPUT_QUANTITY Compu_TdrpK_rpm_rpm 4 -32768 32767 AXIS_PTS_REF TdrpK_rpm_rpm /end AXIS_DESCR
/end CHARACTERISTIC
/begin COMPU_METHOD Compu_TdrpK_rpm_Ki " " RAT_FUNC "%.1" "Ki rpm (%/krpm/s)" COEFFS 0 2.68435456 0 0 0 1 /end COMPU_METHOD
/begin CHARACTERISTIC TdrpK_rpm_KMAPdt "Droop Speed Gains" CURVE 0x00145DAA /* @ECU_Address@TdrpK_rpm_KMAPdt@0x02087000@ */ ECIPP_ALIGNMENT_SWORD 1000 Compu_TdrpK_rpm_KMAPdt -1000 999.969482421875
 /begin AXIS_DESCR COM_AXIS NO_INPUT_QUANTITY Compu_TdrpK_rpm_rpm 4 -32768 32767 AXIS_PTS_REF TdrpK_rpm_rpm /end AXIS_DESCR
/end CHARACTERISTIC
/begin COMPU_METHOD Compu_TdrpK_rpm_KMAPdt " " RAT_FUNC "%.1" "K dMAPdt (1/sec)" COEFFS 0 32.768 0 0 0 1 /end COMPU_METHOD
/begin CHARACTERISTIC TdrpK_rpm_KMdtfb "Droop Speed Gains" CURVE 0x00145DB2 /* @ECU_Address@TdrpK_rpm_KMdtfb@0x02088000@ */ ECIPP_ALIGNMENT_SWORD 32 Compu_TdrpK_rpm_KMdtfb -32 31.9990234375
 /begin AXIS_DESCR COM_AXIS NO_INPUT_QUANTITY Compu_TdrpK_rpm_rpm 4 -32768 32767 AXIS_PTS_REF TdrpK_rpm_rpm /end AXIS_DESCR
/end CHARACTERISTIC
/begin COMPU_METHOD Compu_TdrpK_rpm_KMdtfb " " RAT_FUNC "%.3" "K dMAPdt FB (fraction)" COEFFS 0 1024 0 0 0 1 /end COMPU_METHOD
/begin CHARACTERISTIC TdrpK_rpm_dzKp "Droop Speed Gains" CURVE 0x00145DEA /* @ECU_Address@TdrpK_rpm_dzKp@0x02089000@ */ ECIPP_ALIGNMENT_SWORD 32767 Compu_TdrpK_rpm_dzKp -32768 32767
 /begin AXIS_DESCR COM_AXIS NO_INPUT_QUANTITY Compu_TdrpK_rpm_rpm 4 -32768 32767 AXIS_PTS_REF TdrpK_rpm_rpm /end AXIS_DESCR
/end CHARACTERISTIC
/begin COMPU_METHOD Compu_TdrpK_rpm_dzKp " " RAT_FUNC "%.0" "dead-zone (rpm)" COEFFS 0 1 0 0 0 1 /end COMPU_METHOD
/begin CHARACTERISTIC TdrpK_rpm_dzKi "Droop Speed Gains" CURVE 0x00145DE2 /* @ECU_Address@TdrpK_rpm_dzKi@0x0208A000@ */ ECIPP_ALIGNMENT_SWORD 32767 Compu_TdrpK_rpm_dzKi -32768 32767
 /begin AXIS_DESCR COM_AXIS NO_INPUT_QUANTITY Compu_TdrpK_rpm_rpm 4 -32768 32767 AXIS_PTS_REF TdrpK_rpm_rpm /end AXIS_DESCR
/end CHARACTERISTIC
/begin COMPU_METHOD Compu_TdrpK_rpm_dzKi " " RAT_FUNC "%.0" "dead-zone (rpm)" COEFFS 0 1 0 0 0 1 /end COMPU_METHOD
/begin CHARACTERISTIC TdrpK_rpm_dzKd "Droop Speed Gains" CURVE 0x00145DDA /* @ECU_Address@TdrpK_rpm_dzKd@0x0208B000@ */ ECIPP_ALIGNMENT_SWORD 63998 Compu_TdrpK_rpm_dzKd -64000 63998.046875
 /begin AXIS_DESCR COM_AXIS NO_INPUT_QUANTITY Compu_TdrpK_rpm_rpm 4 -32768 32767 AXIS_PTS_REF TdrpK_rpm_rpm /end AXIS_DESCR
/end CHARACTERISTIC
/begin COMPU_METHOD Compu_TdrpK_rpm_dzKd " " RAT_FUNC "%.0" "dead-zone (rpm/sec)" COEFFS 0 0.512 0 0 0 1 /end COMPU_METHOD
/begin CHARACTERISTIC TdrpK_rpm_Ifrz "Droop Speed Gains" CURVE 0x00145DA2 /* @ECU_Address@TdrpK_rpm_Ifrz@0x0208C000@ */ ECIPP_ALIGNMENT_SWORD 63998 Compu_TdrpK_rpm_Ifrz -64000 63998.046875
 /begin AXIS_DESCR COM_AXIS NO_INPUT_QUANTITY Compu_TdrpK_rpm_rpm 4 -32768 32767 AXIS_PTS_REF TdrpK_rpm_rpm /end AXIS_DESCR
/end CHARACTERISTIC
/begin COMPU_METHOD Compu_TdrpK_rpm_Ifrz " " RAT_FUNC "%.0" "freeze (rpm/sec)" COEFFS 0 0.512 0 0 0 1 /end COMPU_METHOD
/begin CHARACTERISTIC TspdK_ECT_Kim "Governor Gain Corrections" CURVE 0x0014619E /* @ECU_Address@TspdK_ECT_Kim@0x0208D000@ */ ECIPP_ALIGNMENT_SWORD 8 Compu_TspdK_ECT_Kim -8 7.999755859375
 /begin AXIS_DESCR COM_AXIS NO_INPUT_QUANTITY Compu_TspdK_ECT_ECT 4 -1484 563.96875 AXIS_PTS_REF TspdK_ECT_ECT /end AXIS_DESCR
/end CHARACTERISTIC
/begin COMPU_METHOD Compu_TspdK_ECT_Kim " " RAT_FUNC "%.3" "Ki Multiplier" COEFFS 0 4096 0 0 0 1 /end COMPU_METHOD
/begin CHARACTERISTIC TspdK_ECT_Kdm "Governor Gain Corrections" CURVE 0x00146196 /* @ECU_Address@TspdK_ECT_Kdm@0x0208E000@ */ ECIPP_ALIGNMENT_SWORD 8 Compu_TspdK_ECT_Kdm -8 7.999755859375
 /begin AXIS_DESCR COM_AXIS NO_INPUT_QUANTITY Compu_TspdK_ECT_ECT 4 -1484 563.96875 AXIS_PTS_REF TspdK_ECT_ECT /end AXIS_DESCR
/end CHARACTERISTIC
/begin COMPU_METHOD Compu_TspdK_ECT_Kdm " " RAT_FUNC "%.3" "Kd Multiplier" COEFFS 0 4096 0 0 0 1 /end COMPU_METHOD
/begin CHARACTERISTIC TspdK_ECT_KMdm "Governor Gain Corrections" CURVE 0x00146186 /* @ECU_Address@TspdK_ECT_KMdm@0x0208F000@ */ ECIPP_ALIGNMENT_SWORD 8 Compu_TspdK_ECT_KMdm -8 7.999755859375
 /begin AXIS_DESCR COM_AXIS NO_INPUT_QUANTITY Compu_TspdK_ECT_ECT 4 -1484 563.96875 AXIS_PTS_REF TspdK_ECT_ECT /end AXIS_DESCR
/end CHARACTERISTIC
/begin COMPU_METHOD Compu_TspdK_ECT_KMdm " " RAT_FUNC "%.3" "KMAPdt Multiplier" COEFFS 0 4096 0 0 0 1 /end COMPU_METHOD
/begin CHARACTERISTIC TspdK_ECT_KMfm "Governor Gain Corrections" CURVE 0x0014618E /* @ECU_Address@TspdK_ECT_KMfm@0x02090000@ */ ECIPP_ALIGNMENT_SWORD 8 Compu_TspdK_ECT_KMfm -8 7.999755859375
 /begin AXIS_DESCR COM_AXIS NO_INPUT_QUANTITY Compu_TspdK_ECT_ECT 4 -1484 563.96875 AXIS_PTS_REF TspdK_ECT_ECT /end AXIS_DESCR
/end CHARACTERISTIC
/begin COMPU_METHOD Compu_TspdK_ECT_KMfm " " RAT_FUNC "%.3" "KMAPdt FB Multiplier" COEFFS 0 4096 0 0 0 1 /end COMPU_METHOD
/begin CHARACTERISTIC TspdK_ECT_nomld "Governor Gain Corrections" CURVE 0x001461B6 /* @ECU_Address@TspdK_ECT_nomld@0x02091000@ */ ECIPP_ALIGNMENT_SWORD 800 Compu_TspdK_ECT_nomld -800 799.9755859375
 /begin AXIS_DESCR COM_AXIS NO_INPUT_QUANTITY Compu_TspdK_ECT_ECT 4 -1484 563.96875 AXIS_PTS_REF TspdK_ECT_ECT /end AXIS_DESCR
/end CHARACTERISTIC
/begin COMPU_METHOD Compu_TspdK_ECT_nomld " " RAT_FUNC "%.1" "Nominal Load (% adder)" COEFFS 0 40.96 0 0 0 1 /end COMPU_METHOD
/begin COMPU_METHOD Compu_Tgagedrv_ECT " " RAT_FUNC "%.1" "ECT (deg F)" COEFFS 0 32 14720 0 0 1 /end COMPU_METHOD
/begin CHARACTERISTIC Tgagedrv_DC "ECT Gauge Driver Calibration" CURVE 0x00145E06 /* @ECU_Address@Tgagedrv_DC@0x020C1000@ */ ECIPP_ALIGNMENT_SWORD 200 Compu_Tgagedrv_DC -200 199.993896484375
 /begin AXIS_DESCR COM_AXIS NO_INPUT_QUANTITY Compu_Tgagedrv_ECT 16 -1484 563.96875 AXIS_PTS_REF Tgagedrv_ECT /end AXIS_DESCR
/end CHARACTERISTIC
/begin AXIS_PTS Tgagedrv_ECT " " 0x00145E26 /* @ECU_Address@Tgagedrv_ECT@0x020C0000@ */ NO_INPUT_QUANTITY ECIPP_Lookup_SWORD 0 Compu_Tgagedrv_ECT 16 -1484 563.96875 /end AXIS_PTS
/begin COMPU_METHOD Compu_Tgagedrv_DC " " RAT_FUNC "%.1" "Duty-Cycle (%)" COEFFS 0 163.84 0 0 0 1 /end COMPU_METHOD
/begin CHARACTERISTIC TspdK_rpm_Kiv "Isochronous Speed Gains" CURVE 0x001461E6 /* @ECU_Address@TspdK_rpm_Kiv@0x020ED000@ */ ECIPP_ALIGNMENT_SWORD 6250 Compu_TspdK_rpm_Kiv -6250 6249.80926513672
 /begin AXIS_DESCR COM_AXIS NO_INPUT_QUANTITY Compu_TspdK_rpm_rpm 4 -32768 32767 AXIS_PTS_REF TspdK_rpm_rpm /end AXIS_DESCR
/end CHARACTERISTIC
/begin COMPU_METHOD Compu_TspdK_rpm_Kiv " " RAT_FUNC "%.1" "Kiv rpm (%/krpm)" COEFFS 0 5.24288 0 0 0 1 /end COMPU_METHOD
/begin CHARACTERISTIC TdrpK_rpm_Kiv "Droop Speed Gains" CURVE 0x00145DCA /* @ECU_Address@TdrpK_rpm_Kiv@0x020EE000@ */ ECIPP_ALIGNMENT_SWORD 6250 Compu_TdrpK_rpm_Kiv -6250 6249.80926513672
 /begin AXIS_DESCR COM_AXIS NO_INPUT_QUANTITY Compu_TdrpK_rpm_rpm 4 -32768 32767 AXIS_PTS_REF TdrpK_rpm_rpm /end AXIS_DESCR
/end CHARACTERISTIC
/begin COMPU_METHOD Compu_TdrpK_rpm_Kiv " " RAT_FUNC "%.1" "Kiv rpm (%/krpm)" COEFFS 0 5.24288 0 0 0 1 /end COMPU_METHOD
/begin CHARACTERISTIC TspdK_ECT_Kivm "Governor Gain Corrections" CURVE 0x001461A6 /* @ECU_Address@TspdK_ECT_Kivm@0x020F1000@ */ ECIPP_ALIGNMENT_SWORD 8 Compu_TspdK_ECT_Kivm -8 7.999755859375
 /begin AXIS_DESCR COM_AXIS NO_INPUT_QUANTITY Compu_TspdK_ECT_ECT 4 -1484 563.96875 AXIS_PTS_REF TspdK_ECT_ECT /end AXIS_DESCR
/end CHARACTERISTIC
/begin COMPU_METHOD Compu_TspdK_ECT_Kivm " " RAT_FUNC "%.3" "Kiv Multiplier" COEFFS 0 4096 0 0 0 1 /end COMPU_METHOD
/begin CHARACTERISTIC TECTgd_R "ECT Gauge Driver Calibration" CURVE 0x001447CA /* @ECU_Address@TECTgd_R@0x020F4000@ */ ECIPP_ALIGNMENT_SWORD 4096 Compu_TECTgd_R -4096 4095.875
 /begin AXIS_DESCR COM_AXIS NO_INPUT_QUANTITY Compu_Tgagedrv_ECT 16 -1484 563.96875 AXIS_PTS_REF Tgagedrv_ECT /end AXIS_DESCR
/end CHARACTERISTIC
/begin COMPU_METHOD Compu_TECTgd_R " " RAT_FUNC "%.1" "Resistance (ohms)" COEFFS 0 8 0 0 0 1 /end COMPU_METHOD
/begin COMPU_METHOD Compu_TOilPgd_OilP " " RAT_FUNC "%.1" "OilP (psig)" COEFFS 0 128 0 0 0 1 /end COMPU_METHOD
/begin CHARACTERISTIC TOilPgd_DC "OilP Gauge Driver Calibration" CURVE 0x00145324 /* @ECU_Address@TOilPgd_DC@0x020F6000@ */ ECIPP_ALIGNMENT_SWORD 200 Compu_TOilPgd_DC -200 199.993896484375
 /begin AXIS_DESCR COM_AXIS NO_INPUT_QUANTITY Compu_TOilPgd_OilP 16 -256 255.9921875 AXIS_PTS_REF TOilPgd_OilP /end AXIS_DESCR
/end CHARACTERISTIC
/begin AXIS_PTS TOilPgd_OilP " " 0x00145344 /* @ECU_Address@TOilPgd_OilP@0x020F5000@ */ NO_INPUT_QUANTITY ECIPP_Lookup_SWORD 0 Compu_TOilPgd_OilP 16 -256 255.9921875 /end AXIS_PTS
/begin COMPU_METHOD Compu_TOilPgd_DC " " RAT_FUNC "%.1" "Duty-Cycle (%)" COEFFS 0 163.84 0 0 0 1 /end COMPU_METHOD
/begin CHARACTERISTIC TOilPgd_R "OilP Gauge Driver Calibration" CURVE 0x00145364 /* @ECU_Address@TOilPgd_R@0x020F7000@ */ ECIPP_ALIGNMENT_SWORD 4096 Compu_TOilPgd_R -4096 4095.875
 /begin AXIS_DESCR COM_AXIS NO_INPUT_QUANTITY Compu_TOilPgd_OilP 16 -256 255.9921875 AXIS_PTS_REF TOilPgd_OilP /end AXIS_DESCR
/end CHARACTERISTIC
/begin COMPU_METHOD Compu_TOilPgd_R " " RAT_FUNC "%.1" "Resistance (ohms)" COEFFS 0 8 0 0 0 1 /end COMPU_METHOD
/begin COMPU_METHOD Compu_TV1gd_volts " " RAT_FUNC "%.2" "Volt1 (volts)" COEFFS 0 256 0 0 0 1 /end COMPU_METHOD
/begin CHARACTERISTIC TV1gd_DC "Volt1 Gauge Driver Calibration" CURVE 0x00145636 /* @ECU_Address@TV1gd_DC@0x020F9000@ */ ECIPP_ALIGNMENT_SWORD 200 Compu_TV1gd_DC -200 199.993896484375
 /begin AXIS_DESCR COM_AXIS NO_INPUT_QUANTITY Compu_TV1gd_volts 16 -128 127.99609375 AXIS_PTS_REF TV1gd_volts /end AXIS_DESCR
/end CHARACTERISTIC
/begin AXIS_PTS TV1gd_volts " " 0x00145676 /* @ECU_Address@TV1gd_volts@0x020F8000@ */ NO_INPUT_QUANTITY ECIPP_Lookup_SWORD 0 Compu_TV1gd_volts 16 -128 127.99609375 /end AXIS_PTS
/begin COMPU_METHOD Compu_TV1gd_DC " " RAT_FUNC "%.1" "Duty-Cycle (%)" COEFFS 0 163.84 0 0 0 1 /end COMPU_METHOD
/begin CHARACTERISTIC TV1gd_R "Volt1 Gauge Driver Calibration" CURVE 0x00145656 /* @ECU_Address@TV1gd_R@0x020FA000@ */ ECIPP_ALIGNMENT_SWORD 4096 Compu_TV1gd_R -4096 4095.875
 /begin AXIS_DESCR COM_AXIS NO_INPUT_QUANTITY Compu_TV1gd_volts 16 -128 127.99609375 AXIS_PTS_REF TV1gd_volts /end AXIS_DESCR
/end CHARACTERISTIC
/begin COMPU_METHOD Compu_TV1gd_R " " RAT_FUNC "%.1" "Resistance (ohms)" COEFFS 0 8 0 0 0 1 /end COMPU_METHOD
/begin COMPU_METHOD Compu_TStrtIdle_ECT_ECT " " RAT_FUNC "%.0" "ECT (deg F)" COEFFS 0 32 14720 0 0 1 /end COMPU_METHOD
/begin CHARACTERISTIC TStrtIdle_ECT_ini "Starting Initial Speed" CURVE 0x0014548E /* @ECU_Address@TStrtIdle_ECT_ini@0x02133000@ */ ECIPP_ALIGNMENT_SWORD 32767 Compu_TStrtIdle_ECT_ini -32768 32767
 /begin AXIS_DESCR COM_AXIS NO_INPUT_QUANTITY Compu_TStrtIdle_ECT_ECT 4 -1484 563.96875 AXIS_PTS_REF TStrtIdle_ECT_ECT /end AXIS_DESCR
/end CHARACTERISTIC
/begin AXIS_PTS TStrtIdle_ECT_ECT " " 0x00145476 /* @ECU_Address@TStrtIdle_ECT_ECT@0x02132000@ */ NO_INPUT_QUANTITY ECIPP_Lookup_SWORD 0 Compu_TStrtIdle_ECT_ECT 4 -1484 563.96875 /end AXIS_PTS
/begin COMPU_METHOD Compu_TStrtIdle_ECT_ini " " RAT_FUNC "%.0" "Initial Speed (rpm)" COEFFS 0 1 0 0 0 1 /end COMPU_METHOD
/begin CHARACTERISTIC TStrtIdle_ECT_hld "Starting Initial Speed Hold" CURVE 0x00145486 /* @ECU_Address@TStrtIdle_ECT_hld@0x02134000@ */ ECIPP_ALIGNMENT_SWORD 33 Compu_TStrtIdle_ECT_hld -32.768 32.767
 /begin AXIS_DESCR COM_AXIS NO_INPUT_QUANTITY Compu_TStrtIdle_ECT_ECT 4 -1484 563.96875 AXIS_PTS_REF TStrtIdle_ECT_ECT /end AXIS_DESCR
/end CHARACTERISTIC
/begin COMPU_METHOD Compu_TStrtIdle_ECT_hld " " RAT_FUNC "%.3" "Hold Time (sec)" COEFFS 0 1000 0 0 0 1 /end COMPU_METHOD
/begin CHARACTERISTIC TStrtIdle_ECT_dcy "Starting Initial Speed Decay" CURVE 0x0014547E /* @ECU_Address@TStrtIdle_ECT_dcy@0x02135000@ */ ECIPP_ALIGNMENT_SWORD 1000 Compu_TStrtIdle_ECT_dcy -1000 999.969482421875
 /begin AXIS_DESCR COM_AXIS NO_INPUT_QUANTITY Compu_TStrtIdle_ECT_ECT 4 -1484 563.96875 AXIS_PTS_REF TStrtIdle_ECT_ECT /end AXIS_DESCR
/end CHARACTERISTIC
/begin COMPU_METHOD Compu_TStrtIdle_ECT_dcy " " RAT_FUNC "%.0" "Decay Rate (rpm/sec)" COEFFS 0 32.768 0 0 0 1 /end COMPU_METHOD
/begin COMPU_METHOD Compu_TFLEVgd_pct " " RAT_FUNC "%.1" "Fuel level (%)" COEFFS 0 163.84 0 0 0 1 /end COMPU_METHOD
/begin CHARACTERISTIC TFLEVgd_DC "FLEV Gauge Driver Calibration" CURVE 0x001449E6 /* @ECU_Address@TFLEVgd_DC@0x02186000@ */ ECIPP_ALIGNMENT_SWORD 200 Compu_TFLEVgd_DC -200 199.993896484375
 /begin AXIS_DESCR COM_AXIS NO_INPUT_QUANTITY Compu_TFLEVgd_pct 16 -200 199.993896484375 AXIS_PTS_REF TFLEVgd_pct /end AXIS_DESCR
/end CHARACTERISTIC
/begin AXIS_PTS TFLEVgd_pct " " 0x00144A06 /* @ECU_Address@TFLEVgd_pct@0x02185000@ */ NO_INPUT_QUANTITY ECIPP_Lookup_SWORD 0 Compu_TFLEVgd_pct 16 -200 199.993896484375 /end AXIS_PTS
/begin COMPU_METHOD Compu_TFLEVgd_DC " " RAT_FUNC "%.1" "Duty-Cycle (%)" COEFFS 0 163.84 0 0 0 1 /end COMPU_METHOD
/begin COMPU_METHOD Compu_TspdK_rs_rs " " RAT_FUNC "%.0" "Speed (kph)" COEFFS 0 128 0 0 0 1 /end COMPU_METHOD
/begin CHARACTERISTIC TspdK_rs_Kpm "Governor Roadspeed Multipliers" CURVE 0x00146276 /* @ECU_Address@TspdK_rs_Kpm@0x02372000@ */ ECIPP_ALIGNMENT_SWORD 8 Compu_TspdK_rs_Kpm -8 7.999755859375
 /begin AXIS_DESCR COM_AXIS NO_INPUT_QUANTITY Compu_TspdK_rs_rs 8 -256 255.9921875 AXIS_PTS_REF TspdK_rs_rs /end AXIS_DESCR
/end CHARACTERISTIC
/begin AXIS_PTS TspdK_rs_rs " " 0x001462B6 /* @ECU_Address@TspdK_rs_rs@0x02371000@ */ NO_INPUT_QUANTITY ECIPP_Lookup_SWORD 0 Compu_TspdK_rs_rs 8 -256 255.9921875 /end AXIS_PTS
/begin COMPU_METHOD Compu_TspdK_rs_Kpm " " RAT_FUNC "%.3" "Kp Multiplier" COEFFS 0 4096 0 0 0 1 /end COMPU_METHOD
/begin CHARACTERISTIC TspdK_rs_Kim "Governor Roadspeed Multipliers" CURVE 0x00146256 /* @ECU_Address@TspdK_rs_Kim@0x02373000@ */ ECIPP_ALIGNMENT_SWORD 8 Compu_TspdK_rs_Kim -8 7.999755859375
 /begin AXIS_DESCR COM_AXIS NO_INPUT_QUANTITY Compu_TspdK_rs_rs 8 -256 255.9921875 AXIS_PTS_REF TspdK_rs_rs /end AXIS_DESCR
/end CHARACTERISTIC
/begin COMPU_METHOD Compu_TspdK_rs_Kim " " RAT_FUNC "%.3" "Ki Multiplier" COEFFS 0 4096 0 0 0 1 /end COMPU_METHOD
/begin CHARACTERISTIC TspdK_rs_Kivm "Governor Roadspeed Multipliers" CURVE 0x00146266 /* @ECU_Address@TspdK_rs_Kivm@0x02374000@ */ ECIPP_ALIGNMENT_SWORD 8 Compu_TspdK_rs_Kivm -8 7.999755859375
 /begin AXIS_DESCR COM_AXIS NO_INPUT_QUANTITY Compu_TspdK_rs_rs 8 -256 255.9921875 AXIS_PTS_REF TspdK_rs_rs /end AXIS_DESCR
/end CHARACTERISTIC
/begin COMPU_METHOD Compu_TspdK_rs_Kivm " " RAT_FUNC "%.3" "Kiv Multiplier" COEFFS 0 4096 0 0 0 1 /end COMPU_METHOD
/begin CHARACTERISTIC TspdK_rs_Kdm "Governor Roadspeed Multipliers" CURVE 0x00146246 /* @ECU_Address@TspdK_rs_Kdm@0x02375000@ */ ECIPP_ALIGNMENT_SWORD 8 Compu_TspdK_rs_Kdm -8 7.999755859375
 /begin AXIS_DESCR COM_AXIS NO_INPUT_QUANTITY Compu_TspdK_rs_rs 8 -256 255.9921875 AXIS_PTS_REF TspdK_rs_rs /end AXIS_DESCR
/end CHARACTERISTIC
/begin COMPU_METHOD Compu_TspdK_rs_Kdm " " RAT_FUNC "%.3" "Kd Multiplier" COEFFS 0 4096 0 0 0 1 /end COMPU_METHOD
/begin CHARACTERISTIC TspdK_rs_KMAPdtm "Governor Roadspeed Multipliers" CURVE 0x00146226 /* @ECU_Address@TspdK_rs_KMAPdtm@0x02376000@ */ ECIPP_ALIGNMENT_SWORD 8 Compu_TspdK_rs_KMAPdtm -8 7.999755859375
 /begin AXIS_DESCR COM_AXIS NO_INPUT_QUANTITY Compu_TspdK_rs_rs 8 -256 255.9921875 AXIS_PTS_REF TspdK_rs_rs /end AXIS_DESCR
/end CHARACTERISTIC
/begin COMPU_METHOD Compu_TspdK_rs_KMAPdtm " " RAT_FUNC "%.3" "dMAP/dt Multiplier" COEFFS 0 4096 0 0 0 1 /end COMPU_METHOD
/begin CHARACTERISTIC TspdK_rs_KMdtfbm "Governor Roadspeed Multipliers" CURVE 0x00146236 /* @ECU_Address@TspdK_rs_KMdtfbm@0x02377000@ */ ECIPP_ALIGNMENT_SWORD 8 Compu_TspdK_rs_KMdtfbm -8 7.999755859375
 /begin AXIS_DESCR COM_AXIS NO_INPUT_QUANTITY Compu_TspdK_rs_rs 8 -256 255.9921875 AXIS_PTS_REF TspdK_rs_rs /end AXIS_DESCR
/end CHARACTERISTIC
/begin COMPU_METHOD Compu_TspdK_rs_KMdtfbm " " RAT_FUNC "%.3" "dMAP/dt FB Multiplier" COEFFS 0 4096 0 0 0 1 /end COMPU_METHOD
/begin CHARACTERISTIC TspdK_rs_dzKpm "Governor Roadspeed Multipliers" CURVE 0x001462A6 /* @ECU_Address@TspdK_rs_dzKpm@0x02378000@ */ ECIPP_ALIGNMENT_SWORD 8 Compu_TspdK_rs_dzKpm -8 7.999755859375
 /begin AXIS_DESCR COM_AXIS NO_INPUT_QUANTITY Compu_TspdK_rs_rs 8 -256 255.9921875 AXIS_PTS_REF TspdK_rs_rs /end AXIS_DESCR
/end CHARACTERISTIC
/begin COMPU_METHOD Compu_TspdK_rs_dzKpm " " RAT_FUNC "%.3" "Kp dz Multiplier" COEFFS 0 4096 0 0 0 1 /end COMPU_METHOD
/begin CHARACTERISTIC TspdK_rs_dzKim "Governor Roadspeed Multipliers" CURVE 0x00146296 /* @ECU_Address@TspdK_rs_dzKim@0x02379000@ */ ECIPP_ALIGNMENT_SWORD 8 Compu_TspdK_rs_dzKim -8 7.999755859375
 /begin AXIS_DESCR COM_AXIS NO_INPUT_QUANTITY Compu_TspdK_rs_rs 8 -256 255.9921875 AXIS_PTS_REF TspdK_rs_rs /end AXIS_DESCR
/end CHARACTERISTIC
/begin COMPU_METHOD Compu_TspdK_rs_dzKim " " RAT_FUNC "%.3" "Ki dz Multiplier" COEFFS 0 4096 0 0 0 1 /end COMPU_METHOD
/begin CHARACTERISTIC TspdK_rs_dzKdm "Governor Roadspeed Multipliers" CURVE 0x00146286 /* @ECU_Address@TspdK_rs_dzKdm@0x0237A000@ */ ECIPP_ALIGNMENT_SWORD 8 Compu_TspdK_rs_dzKdm -8 7.999755859375
 /begin AXIS_DESCR COM_AXIS NO_INPUT_QUANTITY Compu_TspdK_rs_rs 8 -256 255.9921875 AXIS_PTS_REF TspdK_rs_rs /end AXIS_DESCR
/end CHARACTERISTIC
/begin COMPU_METHOD Compu_TspdK_rs_dzKdm " " RAT_FUNC "%.3" "Kd dz Multiplier" COEFFS 0 4096 0 0 0 1 /end COMPU_METHOD
/begin CHARACTERISTIC TspdK_rs_Ifrzm "Governor Roadspeed Multipliers" CURVE 0x00146216 /* @ECU_Address@TspdK_rs_Ifrzm@0x0237B000@ */ ECIPP_ALIGNMENT_SWORD 8 Compu_TspdK_rs_Ifrzm -8 7.999755859375
 /begin AXIS_DESCR COM_AXIS NO_INPUT_QUANTITY Compu_TspdK_rs_rs 8 -256 255.9921875 AXIS_PTS_REF TspdK_rs_rs /end AXIS_DESCR
/end CHARACTERISTIC
/begin COMPU_METHOD Compu_TspdK_rs_Ifrzm " " RAT_FUNC "%.3" "I Freeze Multiplier" COEFFS 0 4096 0 0 0 1 /end COMPU_METHOD
/begin CHARACTERISTIC TspdK_rs_TPSLP "Governor Roadspeed Multipliers" CURVE 0x00147C86 /* @ECU_Address@TspdK_rs_TPSLP@0x0237C000@ */ ECIPP_ALIGNMENT_UWORD 327680 Compu_TspdK_rs_TPSLP 0.45084 327680
 /begin AXIS_DESCR COM_AXIS NO_INPUT_QUANTITY Compu_TspdK_rs_rs 8 -256 255.9921875 AXIS_PTS_REF TspdK_rs_rs /end AXIS_DESCR
/end CHARACTERISTIC
/begin COMPU_METHOD Compu_TspdK_rs_TPSLP " " FORM "%.1" "TPS Output low-pass"
 /begin FORMULA "-5 / log(1 - (X1 / 65536))" FORMULA_INV "(1 - exp(-5/X1)) * 65536" /end FORMULA
/end COMPU_METHOD
/begin COMPU_METHOD Compu_TspdK2_rpm_rpm " " RAT_FUNC "%.0" "Speed (rpm)" COEFFS 0 1 0 0 0 1 /end COMPU_METHOD
/begin CHARACTERISTIC TspdK2_rpm_Kp "Isochronous Speed Gains" CURVE 0x00146156 /* @ECU_Address@TspdK2_rpm_Kp@0x02486000@ */ ECIPP_ALIGNMENT_SWORD 3125 Compu_TspdK2_rpm_Kp -3125 3124.90463256836
 /begin AXIS_DESCR COM_AXIS NO_INPUT_QUANTITY Compu_TspdK2_rpm_rpm 4 -32768 32767 AXIS_PTS_REF TspdK2_rpm_rpm /end AXIS_DESCR
/end CHARACTERISTIC
/begin AXIS_PTS TspdK2_rpm_rpm " " 0x00146176 /* @ECU_Address@TspdK2_rpm_rpm@0x02485000@ */ NO_INPUT_QUANTITY ECIPP_Lookup_SWORD 0 Compu_TspdK2_rpm_rpm 4 -32768 32767 /end AXIS_PTS
/begin COMPU_METHOD Compu_TspdK2_rpm_Kp " " RAT_FUNC "%.1" "Kp rpm (%/krpm)" COEFFS 0 10.48576 0 0 0 1 /end COMPU_METHOD
/begin CHARACTERISTIC TspdK2_rpm_Kd "Isochronous Speed Gains" CURVE 0x0014613E /* @ECU_Address@TspdK2_rpm_Kd@0x02487000@ */ ECIPP_ALIGNMENT_SWORD 1600 Compu_TspdK2_rpm_Kd -1600 1599.951171875
 /begin AXIS_DESCR COM_AXIS NO_INPUT_QUANTITY Compu_TspdK2_rpm_rpm 4 -32768 32767 AXIS_PTS_REF TspdK2_rpm_rpm /end AXIS_DESCR
/end CHARACTERISTIC
/begin COMPU_METHOD Compu_TspdK2_rpm_Kd " " RAT_FUNC "%.2" "Kd rpm (%/(krpm/s))" COEFFS 0 20.48 0 0 0 1 /end COMPU_METHOD
/begin CHARACTERISTIC TspdK2_rpm_KMAPdt "Isochronous Speed Gains" CURVE 0x0014612E /* @ECU_Address@TspdK2_rpm_KMAPdt@0x02488000@ */ ECIPP_ALIGNMENT_SWORD 1000 Compu_TspdK2_rpm_KMAPdt -1000 999.969482421875
 /begin AXIS_DESCR COM_AXIS NO_INPUT_QUANTITY Compu_TspdK2_rpm_rpm 4 -32768 32767 AXIS_PTS_REF TspdK2_rpm_rpm /end AXIS_DESCR
/end CHARACTERISTIC
/begin COMPU_METHOD Compu_TspdK2_rpm_KMAPdt " " RAT_FUNC "%.1" "K dMAPdt (1/sec)" COEFFS 0 32.768 0 0 0 1 /end COMPU_METHOD
/begin CHARACTERISTIC TspdK2_rpm_Ki "Isochronous Speed Gains" CURVE 0x00146146 /* @ECU_Address@TspdK2_rpm_Ki@0x02489000@ */ ECIPP_ALIGNMENT_SWORD 12207 Compu_TspdK2_rpm_Ki -12207.03125 12206.6587209702
 /begin AXIS_DESCR COM_AXIS NO_INPUT_QUANTITY Compu_TspdK2_rpm_rpm 4 -32768 32767 AXIS_PTS_REF TspdK2_rpm_rpm /end AXIS_DESCR
/end CHARACTERISTIC
/begin COMPU_METHOD Compu_TspdK2_rpm_Ki " " RAT_FUNC "%.1" "Ki rpm (%/krpm/s)" COEFFS 0 2.68435456 0 0 0 1 /end COMPU_METHOD
/begin CHARACTERISTIC TspdK2_rpm_KMdtfb "Isochronous Speed Gains" CURVE 0x00146136 /* @ECU_Address@TspdK2_rpm_KMdtfb@0x0248A000@ */ ECIPP_ALIGNMENT_SWORD 32 Compu_TspdK2_rpm_KMdtfb -32 31.9990234375
 /begin AXIS_DESCR COM_AXIS NO_INPUT_QUANTITY Compu_TspdK2_rpm_rpm 4 -32768 32767 AXIS_PTS_REF TspdK2_rpm_rpm /end AXIS_DESCR
/end CHARACTERISTIC
/begin COMPU_METHOD Compu_TspdK2_rpm_KMdtfb " " RAT_FUNC "%.3" "K dMAPdt FB (fraction)" COEFFS 0 1024 0 0 0 1 /end COMPU_METHOD
/begin CHARACTERISTIC TspdK2_rpm_dzKp "Isochronous Speed Gains" CURVE 0x0014616E /* @ECU_Address@TspdK2_rpm_dzKp@0x0248B000@ */ ECIPP_ALIGNMENT_SWORD 32767 Compu_TspdK2_rpm_dzKp -32768 32767
 /begin AXIS_DESCR COM_AXIS NO_INPUT_QUANTITY Compu_TspdK2_rpm_rpm 4 -32768 32767 AXIS_PTS_REF TspdK2_rpm_rpm /end AXIS_DESCR
/end CHARACTERISTIC
/begin COMPU_METHOD Compu_TspdK2_rpm_dzKp " " RAT_FUNC "%.0" "dead-zone (rpm)" COEFFS 0 1 0 0 0 1 /end COMPU_METHOD
/begin CHARACTERISTIC TspdK2_rpm_dzKi "Isochronous Speed Gains" CURVE 0x00146166 /* @ECU_Address@TspdK2_rpm_dzKi@0x0248C000@ */ ECIPP_ALIGNMENT_SWORD 32767 Compu_TspdK2_rpm_dzKi -32768 32767
 /begin AXIS_DESCR COM_AXIS NO_INPUT_QUANTITY Compu_TspdK2_rpm_rpm 4 -32768 32767 AXIS_PTS_REF TspdK2_rpm_rpm /end AXIS_DESCR
/end CHARACTERISTIC
/begin COMPU_METHOD Compu_TspdK2_rpm_dzKi " " RAT_FUNC "%.0" "dead-zone (rpm)" COEFFS 0 1 0 0 0 1 /end COMPU_METHOD
/begin CHARACTERISTIC TspdK2_rpm_dzKd "Isochronous Speed Gains" CURVE 0x0014615E /* @ECU_Address@TspdK2_rpm_dzKd@0x0248D000@ */ ECIPP_ALIGNMENT_SWORD 63998 Compu_TspdK2_rpm_dzKd -64000 63998.046875
 /begin AXIS_DESCR COM_AXIS NO_INPUT_QUANTITY Compu_TspdK2_rpm_rpm 4 -32768 32767 AXIS_PTS_REF TspdK2_rpm_rpm /end AXIS_DESCR
/end CHARACTERISTIC
/begin COMPU_METHOD Compu_TspdK2_rpm_dzKd " " RAT_FUNC "%.0" "dead-zone (rpm/sec)" COEFFS 0 0.512 0 0 0 1 /end COMPU_METHOD
/begin CHARACTERISTIC TspdK2_rpm_Ifrz "Isochronous Speed Gains" CURVE 0x00146126 /* @ECU_Address@TspdK2_rpm_Ifrz@0x0248E000@ */ ECIPP_ALIGNMENT_SWORD 63998 Compu_TspdK2_rpm_Ifrz -64000 63998.046875
 /begin AXIS_DESCR COM_AXIS NO_INPUT_QUANTITY Compu_TspdK2_rpm_rpm 4 -32768 32767 AXIS_PTS_REF TspdK2_rpm_rpm /end AXIS_DESCR
/end CHARACTERISTIC
/begin COMPU_METHOD Compu_TspdK2_rpm_Ifrz " " RAT_FUNC "%.0" "freeze (rpm/sec)" COEFFS 0 0.512 0 0 0 1 /end COMPU_METHOD
/begin CHARACTERISTIC TspdK2_rpm_Kiv "Isochronous Speed Gains" CURVE 0x0014614E /* @ECU_Address@TspdK2_rpm_Kiv@0x0248F000@ */ ECIPP_ALIGNMENT_SWORD 6250 Compu_TspdK2_rpm_Kiv -6250 6249.80926513672
 /begin AXIS_DESCR COM_AXIS NO_INPUT_QUANTITY Compu_TspdK2_rpm_rpm 4 -32768 32767 AXIS_PTS_REF TspdK2_rpm_rpm /end AXIS_DESCR
/end CHARACTERISTIC
/begin COMPU_METHOD Compu_TspdK2_rpm_Kiv " " RAT_FUNC "%.1" "Kiv rpm (%/krpm)" COEFFS 0 5.24288 0 0 0 1 /end COMPU_METHOD
/begin COMPU_METHOD Compu_TdrpK2_rpm_rpm " " RAT_FUNC "%.0" "Speed (rpm)" COEFFS 0 1 0 0 0 1 /end COMPU_METHOD
/begin CHARACTERISTIC TdrpK2_rpm_Kp "Droop Speed Gains" CURVE 0x00145D7A /* @ECU_Address@TdrpK2_rpm_Kp@0x02491000@ */ ECIPP_ALIGNMENT_SWORD 3125 Compu_TdrpK2_rpm_Kp -3125 3124.90463256836
 /begin AXIS_DESCR COM_AXIS NO_INPUT_QUANTITY Compu_TdrpK2_rpm_rpm 4 -32768 32767 AXIS_PTS_REF TdrpK2_rpm_rpm /end AXIS_DESCR
/end CHARACTERISTIC
/begin AXIS_PTS TdrpK2_rpm_rpm " " 0x00145D9A /* @ECU_Address@TdrpK2_rpm_rpm@0x02490000@ */ NO_INPUT_QUANTITY ECIPP_Lookup_SWORD 0 Compu_TdrpK2_rpm_rpm 4 -32768 32767 /end AXIS_PTS
/begin COMPU_METHOD Compu_TdrpK2_rpm_Kp " " RAT_FUNC "%.1" "Kp rpm (%/krpm)" COEFFS 0 10.48576 0 0 0 1 /end COMPU_METHOD
/begin CHARACTERISTIC TdrpK2_rpm_Kd "Droop Speed Gains" CURVE 0x00145D62 /* @ECU_Address@TdrpK2_rpm_Kd@0x02492000@ */ ECIPP_ALIGNMENT_SWORD 1600 Compu_TdrpK2_rpm_Kd -1600 1599.951171875
 /begin AXIS_DESCR COM_AXIS NO_INPUT_QUANTITY Compu_TdrpK2_rpm_rpm 4 -32768 32767 AXIS_PTS_REF TdrpK2_rpm_rpm /end AXIS_DESCR
/end CHARACTERISTIC
/begin COMPU_METHOD Compu_TdrpK2_rpm_Kd " " RAT_FUNC "%.2" "Kd rpm (%/(krpm/s))" COEFFS 0 20.48 0 0 0 1 /end COMPU_METHOD
/begin CHARACTERISTIC TdrpK2_rpm_Ki "Droop Speed Gains" CURVE 0x00145D6A /* @ECU_Address@TdrpK2_rpm_Ki@0x02493000@ */ ECIPP_ALIGNMENT_SWORD 12207 Compu_TdrpK2_rpm_Ki -12207.03125 12206.6587209702
 /begin AXIS_DESCR COM_AXIS NO_INPUT_QUANTITY Compu_TdrpK2_rpm_rpm 4 -32768 32767 AXIS_PTS_REF TdrpK2_rpm_rpm /end AXIS_DESCR
/end CHARACTERISTIC
/begin COMPU_METHOD Compu_TdrpK2_rpm_Ki " " RAT_FUNC "%.1" "Ki rpm (%/krpm/s)" COEFFS 0 2.68435456 0 0 0 1 /end COMPU_METHOD
/begin CHARACTERISTIC TdrpK2_rpm_KMAPdt "Droop Speed Gains" CURVE 0x00145D52 /* @ECU_Address@TdrpK2_rpm_KMAPdt@0x02494000@ */ ECIPP_ALIGNMENT_SWORD 1000 Compu_TdrpK2_rpm_KMAPdt -1000 999.969482421875
 /begin AXIS_DESCR COM_AXIS NO_INPUT_QUANTITY Compu_TdrpK2_rpm_rpm 4 -32768 32767 AXIS_PTS_REF TdrpK2_rpm_rpm /end AXIS_DESCR
/end CHARACTERISTIC
/begin COMPU_METHOD Compu_TdrpK2_rpm_KMAPdt " " RAT_FUNC "%.1" "K dMAPdt (1/sec)" COEFFS 0 32.768 0 0 0 1 /end COMPU_METHOD
/begin CHARACTERISTIC TdrpK2_rpm_KMdtfb "Droop Speed Gains" CURVE 0x00145D5A /* @ECU_Address@TdrpK2_rpm_KMdtfb@0x02495000@ */ ECIPP_ALIGNMENT_SWORD 32 Compu_TdrpK2_rpm_KMdtfb -32 31.9990234375
 /begin AXIS_DESCR COM_AXIS NO_INPUT_QUANTITY Compu_TdrpK2_rpm_rpm 4 -32768 32767 AXIS_PTS_REF TdrpK2_rpm_rpm /end AXIS_DESCR
/end CHARACTERISTIC
/begin COMPU_METHOD Compu_TdrpK2_rpm_KMdtfb " " RAT_FUNC "%.3" "K dMAPdt FB (fraction)" COEFFS 0 1024 0 0 0 1 /end COMPU_METHOD
/begin CHARACTERISTIC TdrpK2_rpm_dzKp "Droop Speed Gains" CURVE 0x00145D92 /* @ECU_Address@TdrpK2_rpm_dzKp@0x02496000@ */ ECIPP_ALIGNMENT_SWORD 32767 Compu_TdrpK2_rpm_dzKp -32768 32767
 /begin AXIS_DESCR COM_AXIS NO_INPUT_QUANTITY Compu_TdrpK2_rpm_rpm 4 -32768 32767 AXIS_PTS_REF TdrpK2_rpm_rpm /end AXIS_DESCR
/end CHARACTERISTIC
/begin COMPU_METHOD Compu_TdrpK2_rpm_dzKp " " RAT_FUNC "%.0" "dead-zone (rpm)" COEFFS 0 1 0 0 0 1 /end COMPU_METHOD
/begin CHARACTERISTIC TdrpK2_rpm_dzKi "Droop Speed Gains" CURVE 0x00145D8A /* @ECU_Address@TdrpK2_rpm_dzKi@0x02497000@ */ ECIPP_ALIGNMENT_SWORD 32767 Compu_TdrpK2_rpm_dzKi -32768 32767
 /begin AXIS_DESCR COM_AXIS NO_INPUT_QUANTITY Compu_TdrpK2_rpm_rpm 4 -32768 32767 AXIS_PTS_REF TdrpK2_rpm_rpm /end AXIS_DESCR
/end CHARACTERISTIC
/begin COMPU_METHOD Compu_TdrpK2_rpm_dzKi " " RAT_FUNC "%.0" "dead-zone (rpm)" COEFFS 0 1 0 0 0 1 /end COMPU_METHOD
/begin CHARACTERISTIC TdrpK2_rpm_dzKd "Droop Speed Gains" CURVE 0x00145D82 /* @ECU_Address@TdrpK2_rpm_dzKd@0x02498000@ */ ECIPP_ALIGNMENT_SWORD 63998 Compu_TdrpK2_rpm_dzKd -64000 63998.046875
 /begin AXIS_DESCR COM_AXIS NO_INPUT_QUANTITY Compu_TdrpK2_rpm_rpm 4 -32768 32767 AXIS_PTS_REF TdrpK2_rpm_rpm /end AXIS_DESCR
/end CHARACTERISTIC
/begin COMPU_METHOD Compu_TdrpK2_rpm_dzKd " " RAT_FUNC "%.0" "dead-zone (rpm/sec)" COEFFS 0 0.512 0 0 0 1 /end COMPU_METHOD
/begin CHARACTERISTIC TdrpK2_rpm_Ifrz "Droop Speed Gains" CURVE 0x00145D4A /* @ECU_Address@TdrpK2_rpm_Ifrz@0x02499000@ */ ECIPP_ALIGNMENT_SWORD 63998 Compu_TdrpK2_rpm_Ifrz -64000 63998.046875
 /begin AXIS_DESCR COM_AXIS NO_INPUT_QUANTITY Compu_TdrpK2_rpm_rpm 4 -32768 32767 AXIS_PTS_REF TdrpK2_rpm_rpm /end AXIS_DESCR
/end CHARACTERISTIC
/begin COMPU_METHOD Compu_TdrpK2_rpm_Ifrz " " RAT_FUNC "%.0" "freeze (rpm/sec)" COEFFS 0 0.512 0 0 0 1 /end COMPU_METHOD
/begin CHARACTERISTIC TdrpK2_rpm_Kiv "Droop Speed Gains" CURVE 0x00145D72 /* @ECU_Address@TdrpK2_rpm_Kiv@0x0249A000@ */ ECIPP_ALIGNMENT_SWORD 6250 Compu_TdrpK2_rpm_Kiv -6250 6249.80926513672
 /begin AXIS_DESCR COM_AXIS NO_INPUT_QUANTITY Compu_TdrpK2_rpm_rpm 4 -32768 32767 AXIS_PTS_REF TdrpK2_rpm_rpm /end AXIS_DESCR
/end CHARACTERISTIC
/begin COMPU_METHOD Compu_TdrpK2_rpm_Kiv " " RAT_FUNC "%.1" "Kiv rpm (%/krpm)" COEFFS 0 5.24288 0 0 0 1 /end COMPU_METHOD
/begin GROUP EC_GaugeDrive "ECONTROLS" ROOT
 /begin REF_CHARACTERISTIC gagedrv_chan gagedrv_per ECTgd_ctl_type ECTgd_Rpu_tau Vsw_gauge_tau ECTgd_Rpu_def OilPgd_ctl_type OilPgd_Rpu_tau OilPgd_Rpu_def OilPgd_chan OilPgd_per V1gd_ctl_type V1gd_Rpu_tau V1gd_Rpu_def V1gd_chan V1gd_per V1gd_input_chan ECTgd_Vexc_reg OilPgd_Vexc_reg V1gd_Vexc_reg ECTgd_Vexc_ratio OilPgd_Vexc_ratio V1gd_Vexc_ratio ECT_gauge_sync OILP_gauge_sync OILP_gauge_dz ECT_gauge_dz ECT_gauge_DHena OILP_gauge_DHena V1gd_gauge_DHena FLEV_ena FLEV_FT_crct FLEV_lo_faults FLEV_lo_chan FLEVgd_chan FLEV_FTstd FLEV_FTP_empty FLEV_FTP_full FLEV_lo_trig FLEV_lo_hyst FLEV_lo_LLpct FLEVgd_per V1gd_AL_ena V1gd_AL_Rlo V1gd_AL_Rhi V1gd_AL_Vlo_def V1gd_AL_Vhi_def V1gd_AL_Vrate V1gd_AL_Rmid V1gd_AL_Vmid V1gd_AL_DChi V1gd_AL_DCmid V1gd_AL_DClo Tgagedrv_DC TECTgd_R TOilPgd_DC TOilPgd_R TV1gd_DC TV1gd_R TFLEVgd_DC /end REF_CHARACTERISTIC
 /begin REF_MEASUREMENT AUX_PD1_raw AUX_PU1_raw gagedrv_DC gagedrv_manual AUX_PU2_raw AUX_PU3_raw AUX_PD2_raw AUX_PD3_raw AUX_PUD1_raw AUX_PUD2_raw AUX_PUD3_raw ECTgd_Rpu ECTgd_Rd ECTgd_Ra ECTgd_V_FB Vsw_gauge ECTgd_Id OilPgd_Rpu OilPgd_Rd OilPgd_Ra OilPgd_V_FB OilPgd_Id OilPgd_DC V1gd_Rpu V1gd_Rd V1gd_Ra V1gd_V_FB V1gd_Id V1gd_DC V1gd_volts ECT_gauge_value OILP_gauge_value ECT_gauge_DHstat OILP_gauge_DHstat V1gd_gauge_DHstat ECTgd_Rdtbl OilPgd_Rdtbl V1gd_Rdtbl V1gd_pctref FLEV_lo_active FLEV_pct FLEVgd_DC V1gd_AL_tmr V1gd_AL_Vlo V1gd_AL_Vhi V1gd_AL_rst /end REF_MEASUREMENT
/end GROUP
/begin GROUP EC_GovCal "ECONTROLS" ROOT
 /begin REF_CHARACTERISTIC LG_gov_ena HG_gov_ena mingv_auth_min mingv_auth_max strt_min_idle strt_min_idle_dcy strt_min_FPP minigv_appdlt maxigv_appdlt minigv_apprdt maxigv_apprdt minigv_Iinit maxigv_Iinit Gov1_ena Gov2_ena Gov3_ena mindgv_I_min mindgv_I_max minigv_I_min minigv_I_max mingv_nomload maxdgv_I_min maxdgv_I_max maxigv_I_min maxigv_I_max maxgv_nomload maxgv_auth_min maxgv_auth_max Gov1_rpm Gov1d_I_min Gov1d_I_max Gov1i_I_min Gov1i_I_max Gov1_nomload Gov1_auth_min Gov1_auth_max Gov1i_Iinit Gov1i_appdlt Gov1i_apprdt Gov2_rpm Gov2d_I_min Gov2d_I_max Gov2i_I_min Gov2i_I_max Gov2_nomload Gov2_auth_min Gov2_auth_max Gov2i_Iinit Gov2i_appdlt Gov2i_apprdt Gov3_rpm Gov3d_I_min Gov3d_I_max Gov3i_I_min Gov3i_I_max Gov3_nomload Gov3_auth_min Gov3_auth_max Gov3i_Iinit Gov3i_appdlt Gov3i_apprdt gov_app_mode mingv_odz maxgv_odz mingv_odz_wall maxgv_odz_wall mingv_odz_tau maxgv_odz_tau gov_ntrlock_chan mingv_TPSLP maxgv_TPSLP Gov1_TPSLP Gov2_TPSLP Gov3_TPSLP Imin_gov_start Imax_gov_start I_Gov1_start I_Gov2_start I_Gov3_start Gov_start_wait mingv_spk_Kpo maxgv_spk_Kpo Gov1_spk_Kpo Gov2_spk_Kpo Gov3_spk_Kpo Gov3_spk_Kpu Gov2_spk_Kpu Gov1_spk_Kpu maxgv_spk_Kpu mingv_spk_Kpu mingv_spk_dzo maxgv_spk_dzo Gov1_spk_dzo Gov2_spk_dzo Gov3_spk_dzo mingv_spk_dzu maxgv_spk_dzu Gov1_spk_dzu Gov2_spk_dzu Gov3_spk_dzu mingv_spk_mxret maxgv_spk_mxret Gov1_spk_mxret Gov2_spk_mxret Gov3_spk_mxret mingv_spk_mxadv maxgv_spk_mxadv Gov1_spk_mxadv Gov2_spk_mxadv Gov3_spk_mxadv gov_gain_gsln gov_gain_LPG gov_gain_NG FPPSC_mode FPPSC_rpmL FPPSC_rpmH gov_max_abslimit gov_min_abslimit Gtap_ena Gtap_min_rpm Gtap_max_rpm Gtap_1tap_rpm Gtap_ramp_delay Gtap_ramp_phase Gtap_ramp_final IdleFPP_ena IdleFPP_min IdleFPP_max IdleFPP_rpmdelta IdleFPP_rpmmax IdleFPP_loadadd Gov3_gain_slct Gov2_gain_slct Gov1_gain_slct maxgv_gain_slct mingv_gain_slct MaxSetPt_Gov3 minigv_Iinit_ena maxigv_Iinit_ena Gov1i_Iinit_ena Gov2i_Iinit_ena Gov3i_Iinit_ena MaxSetPt_ena MSP_min_rpm MSP_max_rpm MSP_1tap_rpm MSP_ramp_delay MSP_ramp_phase MSP_ramp_final MSP_set_source MSP_prop_V0 MSP_prop_V1 MSP_prop_rpm0 MSP_prop_rpm1 MSP_prop_tau MaxSetPt_apprdt MSP_1tap_RS MSP_rampRS_final MSP_min_RS MSP_max_RS MSP_setclr_HW_input MSP_incdec_HW_input MaxSetPt_keyon MSP2_set_source MaxSetPt2_ena fastidle_ena fastidle_rpm fastidle_act_st strt_idle_mode MaxSetPt_rtn_ena secspd_sw TransNeut_sw Gtap_rpmmin_adjust veh_type clutch_sw strt_max_FPP clutch_sw_config gov_rs_ena TransNeut_sw_cfg gov_gain_gsln_dis gov_gain_LPG_dis gov_gain_NG_dis Gov1_spk_att_ena Gov2_spk_att_ena Gtap_setmin_wait AMT_Gov3_acc_init AMT_select AMT_Gov3_acc_maxload IPAS_mode IPAS_rpm IPAS_speed_on IPAS_speed_off AMT_neut_coast_mode TIdle_ECT_rpm TspdK_rpm_Kp TspdK_rpm_Kd TspdK_rpm_KMAPdt TspdK_ECT_Kpm TspdK_rpm_Ki TspdK_rpm_KMdtfb TspdK_rpm_dzKp TspdK_rpm_dzKi TspdK_rpm_dzKd TspdK_rpm_Ifrz TdrpK_rpm_Kp TdrpK_rpm_Kd TdrpK_rpm_Ki TdrpK_rpm_KMAPdt TdrpK_rpm_KMdtfb TdrpK_rpm_dzKp TdrpK_rpm_dzKi TdrpK_rpm_dzKd TdrpK_rpm_Ifrz TspdK_ECT_Kim TspdK_ECT_Kdm TspdK_ECT_KMdm TspdK_ECT_KMfm TspdK_ECT_nomld TspdK_rpm_Kiv TdrpK_rpm_Kiv TspdK_ECT_Kivm TStrtIdle_ECT_ini TStrtIdle_ECT_hld TStrtIdle_ECT_dcy TspdK_rs_Kpm TspdK_rs_Kim TspdK_rs_Kivm TspdK_rs_Kdm TspdK_rs_KMAPdtm TspdK_rs_KMdtfbm TspdK_rs_dzKpm TspdK_rs_dzKim TspdK_rs_dzKdm TspdK_rs_Ifrzm TspdK_rs_TPSLP TspdK2_rpm_Kp TspdK2_rpm_Kd TspdK2_rpm_KMAPdt TspdK2_rpm_Ki TspdK2_rpm_KMdtfb TspdK2_rpm_dzKp TspdK2_rpm_dzKi TspdK2_rpm_dzKd TspdK2_rpm_Ifrz TspdK2_rpm_Kiv TdrpK2_rpm_Kp TdrpK2_rpm_Kd TdrpK2_rpm_Ki TdrpK2_rpm_KMAPdt TdrpK2_rpm_KMdtfb TdrpK2_rpm_dzKp TdrpK2_rpm_dzKi TdrpK2_rpm_dzKd TdrpK2_rpm_Ifrz TdrpK2_rpm_Kiv /end REF_CHARACTERISTIC
 /begin REF_MEASUREMENT VE gov_MAP_d gov_MAPdt_d TPS_min_gov_pct TPS_max_gov_pct TPS_GovN_pct spkgv_mod gov_gain_man MAP_noload MAP_fullload Kp_gov Kd_gov KMAPdt_gov Ki_gov gov_I_frz rpmdtdz_Kd rpmdz_Kp rpmdz_Ki Kp_gov_mult Ki_gov_mult Kd_gov_mult KMAPdt_gov_mult KMAPdtfb_gov_mult KMAPdtfb_gov gov_nomld_ECTadd Imin_gov_acc Imax_gov_acc Imin_gov_save Imax_gov_save I_Gov1_acc I_Gov2_acc I_Gov3_acc rpmd_gov rpmdtd_gov gov_gain_slct Gtap_rpm Gtap_engaged MaxSetPt_rpm MaxSetPt_engaged MaxSetPt_switch MSP_incdec_sw MSP_setclr_sw Kiv_gov Kiv_gov_mult MSP_prop_V MSP_mode_sw MSP_prisec TSC_ff_loadval strt_idle_ini strt_idle_hld strt_idle_dcy MSP_status secspd_ena TransNeut_ena clutch_depressed clutch_fault Linde_ff_loadval gov_auth_max IPAS_engaged min_allspeed_rpm AMT_RSC_suspend max_gov_highidle_rpm /end REF_MEASUREMENT
/end GROUP
/begin GROUP EC_GovCalAlt "ECONTROLS" ROOT
 /begin REF_CHARACTERISTIC LG_gov_ena HG_gov_ena mingv_auth_min mingv_auth_max strt_min_idle strt_min_idle_dcy strt_min_FPP minigv_appdlt maxigv_appdlt minigv_apprdt maxigv_apprdt minigv_Iinit maxigv_Iinit Gov1_ena Gov2_ena Gov3_ena mindgv_I_min mindgv_I_max minigv_I_min minigv_I_max mingv_nomload maxdgv_I_min maxdgv_I_max maxigv_I_min maxigv_I_max maxgv_nomload maxgv_auth_min maxgv_auth_max Gov1_rpm Gov1d_I_min Gov1d_I_max Gov1i_I_min Gov1i_I_max Gov1_nomload Gov1_auth_min Gov1_auth_max Gov1i_Iinit Gov1i_appdlt Gov1i_apprdt Gov2_rpm Gov2d_I_min Gov2d_I_max Gov2i_I_min Gov2i_I_max Gov2_nomload Gov2_auth_min Gov2_auth_max Gov2i_Iinit Gov2i_appdlt Gov2i_apprdt Gov3_rpm Gov3d_I_min Gov3d_I_max Gov3i_I_min Gov3i_I_max Gov3_nomload Gov3_auth_min Gov3_auth_max Gov3i_Iinit Gov3i_appdlt Gov3i_apprdt gov_app_mode mingv_odz maxgv_odz mingv_odz_wall maxgv_odz_wall mingv_odz_tau maxgv_odz_tau gov_ntrlock_chan mingv_TPSLP maxgv_TPSLP Gov1_TPSLP Gov2_TPSLP Gov3_TPSLP Imin_gov_start Imax_gov_start I_Gov1_start I_Gov2_start I_Gov3_start mingv_spk_Kpo maxgv_spk_Kpo Gov1_spk_Kpo Gov2_spk_Kpo Gov3_spk_Kpo Gov3_spk_Kpu Gov2_spk_Kpu Gov1_spk_Kpu maxgv_spk_Kpu mingv_spk_Kpu mingv_spk_dzo maxgv_spk_dzo Gov1_spk_dzo Gov2_spk_dzo Gov3_spk_dzo mingv_spk_dzu maxgv_spk_dzu Gov1_spk_dzu Gov2_spk_dzu Gov3_spk_dzu mingv_spk_mxret maxgv_spk_mxret Gov1_spk_mxret Gov2_spk_mxret Gov3_spk_mxret mingv_spk_mxadv maxgv_spk_mxadv Gov1_spk_mxadv Gov2_spk_mxadv Gov3_spk_mxadv gov_gain_gsln gov_gain_LPG gov_gain_NG FPPSC_mode FPPSC_rpmL FPPSC_rpmH gov_max_abslimit gov_min_abslimit Gov3_gain_slct Gov2_gain_slct Gov1_gain_slct maxgv_gain_slct mingv_gain_slct minigv_Iinit_ena maxigv_Iinit_ena Gov1i_Iinit_ena Gov2i_Iinit_ena Gov3i_Iinit_ena secspd_sw TransNeut_sw veh_type clutch_sw strt_max_FPP clutch_sw_config gov_rs_ena TransNeut_sw_cfg gov_gain_gsln_dis gov_gain_LPG_dis gov_gain_NG_dis Gov1_spk_att_ena Gov2_spk_att_ena TIdle_ECT_rpm TspdK_ECT_Kpm TspdK_ECT_Kim TspdK_ECT_Kdm TspdK_ECT_KMdm TspdK_ECT_KMfm TspdK_ECT_nomld TspdK_ECT_Kivm /end REF_CHARACTERISTIC
 /begin REF_MEASUREMENT VE gov_MAP_d gov_MAPdt_d TPS_min_gov_pct TPS_max_gov_pct TPS_GovN_pct spkgv_mod gov_gain_man MAP_noload MAP_fullload Kp_gov Kd_gov KMAPdt_gov Ki_gov gov_I_frz rpmdtdz_Kd rpmdz_Kp rpmdz_Ki Kp_gov_mult Ki_gov_mult Kd_gov_mult KMAPdt_gov_mult KMAPdtfb_gov_mult KMAPdtfb_gov gov_nomld_ECTadd Imin_gov_acc Imax_gov_acc Imin_gov_save Imax_gov_save I_Gov1_acc I_Gov2_acc I_Gov3_acc rpmd_gov rpmdtd_gov gov_gain_slct Kiv_gov Kiv_gov_mult TSC_ff_loadval secspd_ena TransNeut_ena clutch_depressed clutch_fault Linde_ff_loadval gov_auth_max min_allspeed_rpm /end REF_MEASUREMENT
/end GROUP
/begin GROUP EC_LDService "ECONTROLS" ROOT /begin REF_MEASUREMENT rpmd_gov /end REF_MEASUREMENT /end GROUP
/begin GROUP EC_Marine "ECONTROLS" ROOT /begin REF_CHARACTERISTIC ECT_gauge_sync OILP_gauge_sync OILP_gauge_dz ECT_gauge_dz /end REF_CHARACTERISTIC /begin REF_MEASUREMENT ECT_gauge_value OILP_gauge_value /end REF_MEASUREMENT /end GROUP
/begin GROUP EC_OEMEOLConf "ECONTROLS" ROOT
 /begin REF_CHARACTERISTIC Gtap_min_rpm Gtap_max_rpm MSP_prop_V0 MSP_prop_V1 MSP_prop_rpm0 MSP_prop_rpm1 /end REF_CHARACTERISTIC
 /begin REF_MEASUREMENT Gtap_rpm Gtap_engaged MaxSetPt_rpm MaxSetPt_switch MSP_prop_V MSP_status /end REF_MEASUREMENT
/end GROUP
/begin GROUP EC_Outputs "ECONTROLS" ROOT /begin REF_MEASUREMENT AUX_PD1_raw AUX_PU1_raw MSP_status FLEV_lo_active /end REF_MEASUREMENT /end GROUP
/begin GROUP EC_PowerMon "ECONTROLS" ROOT /begin REF_MEASUREMENT VE /end REF_MEASUREMENT /end GROUP
/begin GROUP EC_RawVolts "ECONTROLS" ROOT
 /begin REF_MEASUREMENT AUX_PD1_raw AUX_PU1_raw AUX_PU2_raw AUX_PU3_raw AUX_PD2_raw AUX_PD3_raw AUX_PUD1_raw AUX_PUD2_raw AUX_PUD3_raw /end REF_MEASUREMENT
/end GROUP
/begin GROUP EC_SparkCal "ECONTROLS" ROOT /begin REF_MEASUREMENT spkgv_mod /end REF_MEASUREMENT /end GROUP
/begin GROUP EC_SparkCalLP "ECONTROLS" ROOT /begin REF_MEASUREMENT spkgv_mod /end REF_MEASUREMENT /end GROUP
/begin GROUP EC_SparkCalNG "ECONTROLS" ROOT /begin REF_MEASUREMENT spkgv_mod /end REF_MEASUREMENT /end GROUP
/begin GROUP EC_SparkOfst "ECONTROLS" ROOT /begin REF_MEASUREMENT spkgv_mod /end REF_MEASUREMENT /end GROUP
/begin GROUP EC_VECal "ECONTROLS" ROOT /begin REF_MEASUREMENT VE /end REF_MEASUREMENT /end GROUP
/end MODULE
/end PROJECT
