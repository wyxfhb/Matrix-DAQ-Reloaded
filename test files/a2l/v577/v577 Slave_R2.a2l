ASAP2_VERSION 1 61
/begin PROJECT Econtrols_4G "4G Test"
/begin HEADER "4G A2L Configuration" PROJECT_NO EControls4G /* config for version control */ VERSION "$Revision: 82130 $:" /* config for version control */ /end HEADER
/begin MODULE EControls_4G_SH2A "EControls 4G"
/begin MOD_COMMON "" DEPOSIT ABSOLUTE BYTE_ORDER MSB_FIRST /end MOD_COMMON
/* Define the Record Layouts */
/begin RECORD_LAYOUT ECIPP_ALIGNMENT_UBYTE FNC_VALUES 1 UBYTE COLUMN_DIR DIRECT /end RECORD_LAYOUT
/begin RECORD_LAYOUT ECIPP_ALIGNMENT_UWORD FNC_VALUES 1 UWORD COLUMN_DIR DIRECT /end RECORD_LAYOUT
/begin RECORD_LAYOUT ECIPP_ALIGNMENT_ULONG FNC_VALUES 1 ULONG COLUMN_DIR DIRECT /end RECORD_LAYOUT
/begin RECORD_LAYOUT ECIPP_ALIGNMENT_FLOAT32_IEEE FNC_VALUES 1 FLOAT32_IEEE COLUMN_DIR DIRECT /end RECORD_LAYOUT
/begin COMPU_METHOD Compu_IDENTITY "Discrete Values " /* Identifier */ IDENTICAL "%.0" /* Format */ "-" /* Units */ /end COMPU_METHOD
/begin CHARACTERISTIC FCdc4_ADIG15_min "FCtl_DTC_0x04(398)" VALUE 0x00163EEC /* @ECU_Address@FCtl_DTC_0x04@0x024C431C@ */ ECIPP_ALIGNMENT_UWORD 65535 Compu_IDENTITY 0 65535 PHYS_UNIT "System ID + DTC" /end CHARACTERISTIC
/begin CHARACTERISTIC FCdc4_ADIG16_max "FCtl_DTC_0x04(399)" VALUE 0x00163EEE /* @ECU_Address@FCtl_DTC_0x04@0x024C431E@ */ ECIPP_ALIGNMENT_UWORD 65535 Compu_IDENTITY 0 65535 PHYS_UNIT "System ID + DTC" /end CHARACTERISTIC
/begin CHARACTERISTIC FCdc4_ADIG16_min "FCtl_DTC_0x04(400)" VALUE 0x00163EF0 /* @ECU_Address@FCtl_DTC_0x04@0x024C4320@ */ ECIPP_ALIGNMENT_UWORD 65535 Compu_IDENTITY 0 65535 PHYS_UNIT "System ID + DTC" /end CHARACTERISTIC
/begin CHARACTERISTIC FCdc4_ADIG17_max "FCtl_DTC_0x04(401)" VALUE 0x00163EF2 /* @ECU_Address@FCtl_DTC_0x04@0x024C4322@ */ ECIPP_ALIGNMENT_UWORD 65535 Compu_IDENTITY 0 65535 PHYS_UNIT "System ID + DTC" /end CHARACTERISTIC
/begin CHARACTERISTIC FCdc4_ADIG17_min "FCtl_DTC_0x04(402)" VALUE 0x00163EF4 /* @ECU_Address@FCtl_DTC_0x04@0x024C4324@ */ ECIPP_ALIGNMENT_UWORD 65535 Compu_IDENTITY 0 65535 PHYS_UNIT "System ID + DTC" /end CHARACTERISTIC
/begin CHARACTERISTIC FCdc4_ADIG18_max "FCtl_DTC_0x04(403)" VALUE 0x00163EF6 /* @ECU_Address@FCtl_DTC_0x04@0x024C4326@ */ ECIPP_ALIGNMENT_UWORD 65535 Compu_IDENTITY 0 65535 PHYS_UNIT "System ID + DTC" /end CHARACTERISTIC
/begin CHARACTERISTIC FCdc4_ADIG18_min "FCtl_DTC_0x04(404)" VALUE 0x00163EF8 /* @ECU_Address@FCtl_DTC_0x04@0x024C4328@ */ ECIPP_ALIGNMENT_UWORD 65535 Compu_IDENTITY 0 65535 PHYS_UNIT "System ID + DTC" /end CHARACTERISTIC
/begin CHARACTERISTIC FCdc4_ADIG19_max "FCtl_DTC_0x04(405)" VALUE 0x00163EFA /* @ECU_Address@FCtl_DTC_0x04@0x024C432A@ */ ECIPP_ALIGNMENT_UWORD 65535 Compu_IDENTITY 0 65535 PHYS_UNIT "System ID + DTC" /end CHARACTERISTIC
/begin CHARACTERISTIC FCdc4_ADIG19_min "FCtl_DTC_0x04(406)" VALUE 0x00163EFC /* @ECU_Address@FCtl_DTC_0x04@0x024C432C@ */ ECIPP_ALIGNMENT_UWORD 65535 Compu_IDENTITY 0 65535 PHYS_UNIT "System ID + DTC" /end CHARACTERISTIC
/begin CHARACTERISTIC FCdc4_ADIG2_max "FCtl_DTC_0x04(211)" VALUE 0x00163D76 /* @ECU_Address@FCtl_DTC_0x04@0x024C41A6@ */ ECIPP_ALIGNMENT_UWORD 65535 Compu_IDENTITY 0 65535 PHYS_UNIT "System ID + DTC" /end CHARACTERISTIC
/begin CHARACTERISTIC FCdc4_ADIG2_min "FCtl_DTC_0x04(212)" VALUE 0x00163D78 /* @ECU_Address@FCtl_DTC_0x04@0x024C41A8@ */ ECIPP_ALIGNMENT_UWORD 65535 Compu_IDENTITY 0 65535 PHYS_UNIT "System ID + DTC" /end CHARACTERISTIC
/begin CHARACTERISTIC FCdc4_ADIG20_max "FCtl_DTC_0x04(584)" VALUE 0x00164060 /* @ECU_Address@FCtl_DTC_0x04@0x024C4490@ */ ECIPP_ALIGNMENT_UWORD 65535 Compu_IDENTITY 0 65535 PHYS_UNIT "System ID + DTC" /end CHARACTERISTIC
/begin CHARACTERISTIC FCdc4_ADIG20_min "FCtl_DTC_0x04(585)" VALUE 0x00164062 /* @ECU_Address@FCtl_DTC_0x04@0x024C4492@ */ ECIPP_ALIGNMENT_UWORD 65535 Compu_IDENTITY 0 65535 PHYS_UNIT "System ID + DTC" /end CHARACTERISTIC
/begin CHARACTERISTIC FCdc4_ADIG21_max "FCtl_DTC_0x04(586)" VALUE 0x00164064 /* @ECU_Address@FCtl_DTC_0x04@0x024C4494@ */ ECIPP_ALIGNMENT_UWORD 65535 Compu_IDENTITY 0 65535 PHYS_UNIT "System ID + DTC" /end CHARACTERISTIC
/begin CHARACTERISTIC FCdc4_ADIG21_min "FCtl_DTC_0x04(587)" VALUE 0x00164066 /* @ECU_Address@FCtl_DTC_0x04@0x024C4496@ */ ECIPP_ALIGNMENT_UWORD 65535 Compu_IDENTITY 0 65535 PHYS_UNIT "System ID + DTC" /end CHARACTERISTIC
/begin CHARACTERISTIC FCdc4_ADIG22_max "FCtl_DTC_0x04(588)" VALUE 0x00164068 /* @ECU_Address@FCtl_DTC_0x04@0x024C4498@ */ ECIPP_ALIGNMENT_UWORD 65535 Compu_IDENTITY 0 65535 PHYS_UNIT "System ID + DTC" /end CHARACTERISTIC
/begin CHARACTERISTIC FCdc4_ADIG22_min "FCtl_DTC_0x04(589)" VALUE 0x0016406A /* @ECU_Address@FCtl_DTC_0x04@0x024C449A@ */ ECIPP_ALIGNMENT_UWORD 65535 Compu_IDENTITY 0 65535 PHYS_UNIT "System ID + DTC" /end CHARACTERISTIC
/begin CHARACTERISTIC FCdc4_ADIG23_max "FCtl_DTC_0x04(590)" VALUE 0x0016406C /* @ECU_Address@FCtl_DTC_0x04@0x024C449C@ */ ECIPP_ALIGNMENT_UWORD 65535 Compu_IDENTITY 0 65535 PHYS_UNIT "System ID + DTC" /end CHARACTERISTIC
/begin CHARACTERISTIC FCdc4_ADIG23_min "FCtl_DTC_0x04(591)" VALUE 0x0016406E /* @ECU_Address@FCtl_DTC_0x04@0x024C449E@ */ ECIPP_ALIGNMENT_UWORD 65535 Compu_IDENTITY 0 65535 PHYS_UNIT "System ID + DTC" /end CHARACTERISTIC
/begin CHARACTERISTIC FCdc4_ADIG24_max "FCtl_DTC_0x04(592)" VALUE 0x00164070 /* @ECU_Address@FCtl_DTC_0x04@0x024C44A0@ */ ECIPP_ALIGNMENT_UWORD 65535 Compu_IDENTITY 0 65535 PHYS_UNIT "System ID + DTC" /end CHARACTERISTIC
/begin CHARACTERISTIC FCdc4_ADIG24_min "FCtl_DTC_0x04(593)" VALUE 0x00164072 /* @ECU_Address@FCtl_DTC_0x04@0x024C44A2@ */ ECIPP_ALIGNMENT_UWORD 65535 Compu_IDENTITY 0 65535 PHYS_UNIT "System ID + DTC" /end CHARACTERISTIC
/begin CHARACTERISTIC FCdc4_ADIG25_max "FCtl_DTC_0x04(594)" VALUE 0x00164074 /* @ECU_Address@FCtl_DTC_0x04@0x024C44A4@ */ ECIPP_ALIGNMENT_UWORD 65535 Compu_IDENTITY 0 65535 PHYS_UNIT "System ID + DTC" /end CHARACTERISTIC
/begin CHARACTERISTIC FCdc4_ADIG25_min "FCtl_DTC_0x04(595)" VALUE 0x00164076 /* @ECU_Address@FCtl_DTC_0x04@0x024C44A6@ */ ECIPP_ALIGNMENT_UWORD 65535 Compu_IDENTITY 0 65535 PHYS_UNIT "System ID + DTC" /end CHARACTERISTIC
/begin CHARACTERISTIC FCdc4_ADIG3_max "FCtl_DTC_0x04(213)" VALUE 0x00163D7A /* @ECU_Address@FCtl_DTC_0x04@0x024C41AA@ */ ECIPP_ALIGNMENT_UWORD 65535 Compu_IDENTITY 0 65535 PHYS_UNIT "System ID + DTC" /end CHARACTERISTIC
/begin CHARACTERISTIC FCdc4_ADIG3_min "FCtl_DTC_0x04(214)" VALUE 0x00163D7C /* @ECU_Address@FCtl_DTC_0x04@0x024C41AC@ */ ECIPP_ALIGNMENT_UWORD 65535 Compu_IDENTITY 0 65535 PHYS_UNIT "System ID + DTC" /end CHARACTERISTIC
/begin CHARACTERISTIC FCdc4_ADIG4_max "FCtl_DTC_0x04(337)" VALUE 0x00163E72 /* @ECU_Address@FCtl_DTC_0x04@0x024C42A2@ */ ECIPP_ALIGNMENT_UWORD 65535 Compu_IDENTITY 0 65535 PHYS_UNIT "System ID + DTC" /end CHARACTERISTIC
/begin CHARACTERISTIC FCdc4_ADIG4_min "FCtl_DTC_0x04(338)" VALUE 0x00163E74 /* @ECU_Address@FCtl_DTC_0x04@0x024C42A4@ */ ECIPP_ALIGNMENT_UWORD 65535 Compu_IDENTITY 0 65535 PHYS_UNIT "System ID + DTC" /end CHARACTERISTIC
/begin CHARACTERISTIC FCdc4_ADIG5_max "FCtl_DTC_0x04(339)" VALUE 0x00163E76 /* @ECU_Address@FCtl_DTC_0x04@0x024C42A6@ */ ECIPP_ALIGNMENT_UWORD 65535 Compu_IDENTITY 0 65535 PHYS_UNIT "System ID + DTC" /end CHARACTERISTIC
/begin CHARACTERISTIC FCdc4_ADIG5_min "FCtl_DTC_0x04(340)" VALUE 0x00163E78 /* @ECU_Address@FCtl_DTC_0x04@0x024C42A8@ */ ECIPP_ALIGNMENT_UWORD 65535 Compu_IDENTITY 0 65535 PHYS_UNIT "System ID + DTC" /end CHARACTERISTIC
/begin CHARACTERISTIC FCdc4_ADIG6_max "FCtl_DTC_0x04(341)" VALUE 0x00163E7A /* @ECU_Address@FCtl_DTC_0x04@0x024C42AA@ */ ECIPP_ALIGNMENT_UWORD 65535 Compu_IDENTITY 0 65535 PHYS_UNIT "System ID + DTC" /end CHARACTERISTIC
/begin CHARACTERISTIC FCdc4_ADIG6_min "FCtl_DTC_0x04(342)" VALUE 0x00163E7C /* @ECU_Address@FCtl_DTC_0x04@0x024C42AC@ */ ECIPP_ALIGNMENT_UWORD 65535 Compu_IDENTITY 0 65535 PHYS_UNIT "System ID + DTC" /end CHARACTERISTIC
/begin CHARACTERISTIC FCdc4_ADIG7_max "FCtl_DTC_0x04(343)" VALUE 0x00163E7E /* @ECU_Address@FCtl_DTC_0x04@0x024C42AE@ */ ECIPP_ALIGNMENT_UWORD 65535 Compu_IDENTITY 0 65535 PHYS_UNIT "System ID + DTC" /end CHARACTERISTIC
/begin CHARACTERISTIC FCdc4_ADIG7_min "FCtl_DTC_0x04(344)" VALUE 0x00163E80 /* @ECU_Address@FCtl_DTC_0x04@0x024C42B0@ */ ECIPP_ALIGNMENT_UWORD 65535 Compu_IDENTITY 0 65535 PHYS_UNIT "System ID + DTC" /end CHARACTERISTIC
/begin CHARACTERISTIC FCdc4_ADIG8_max "FCtl_DTC_0x04(345)" VALUE 0x00163E82 /* @ECU_Address@FCtl_DTC_0x04@0x024C42B2@ */ ECIPP_ALIGNMENT_UWORD 65535 Compu_IDENTITY 0 65535 PHYS_UNIT "System ID + DTC" /end CHARACTERISTIC
/begin CHARACTERISTIC FCdc4_ADIG8_min "FCtl_DTC_0x04(346)" VALUE 0x00163E84 /* @ECU_Address@FCtl_DTC_0x04@0x024C42B4@ */ ECIPP_ALIGNMENT_UWORD 65535 Compu_IDENTITY 0 65535 PHYS_UNIT "System ID + DTC" /end CHARACTERISTIC
/begin CHARACTERISTIC FCdc4_ADIG9_max "FCtl_DTC_0x04(347)" VALUE 0x00163E86 /* @ECU_Address@FCtl_DTC_0x04@0x024C42B6@ */ ECIPP_ALIGNMENT_UWORD 65535 Compu_IDENTITY 0 65535 PHYS_UNIT "System ID + DTC" /end CHARACTERISTIC
/begin CHARACTERISTIC FCdc4_ADIG9_min "FCtl_DTC_0x04(348)" VALUE 0x00163E88 /* @ECU_Address@FCtl_DTC_0x04@0x024C42B8@ */ ECIPP_ALIGNMENT_UWORD 65535 Compu_IDENTITY 0 65535 PHYS_UNIT "System ID + DTC" /end CHARACTERISTIC
/begin CHARACTERISTIC FCdc4_ADloss "FCtl_DTC_0x04(103)" VALUE 0x00163C9E /* @ECU_Address@FCtl_DTC_0x04@0x024C40CE@ */ ECIPP_ALIGNMENT_UWORD 65535 Compu_IDENTITY 0 65535 PHYS_UNIT "System ID + DTC" /end CHARACTERISTIC
/begin CHARACTERISTIC FCdc4_AFILT_dP_high "FCtl_DTC_0x04(732)" VALUE 0x00164188 /* @ECU_Address@FCtl_DTC_0x04@0x024C45B8@ */ ECIPP_ALIGNMENT_UWORD 65535 Compu_IDENTITY 0 65535 PHYS_UNIT "System ID + DTC" /end CHARACTERISTIC
/begin CHARACTERISTIC FCdc4_AL_hi "FCtl_DTC_0x04(30)" VALUE 0x00163C0C /* @ECU_Address@FCtl_DTC_0x04@0x024C403C@ */ ECIPP_ALIGNMENT_UWORD 65535 Compu_IDENTITY 0 65535 PHYS_UNIT "System ID + DTC" /end CHARACTERISTIC
/begin CHARACTERISTIC FCdc4_AL_lo "FCtl_DTC_0x04(31)" VALUE 0x00163C0E /* @ECU_Address@FCtl_DTC_0x04@0x024C403E@ */ ECIPP_ALIGNMENT_UWORD 65535 Compu_IDENTITY 0 65535 PHYS_UNIT "System ID + DTC" /end CHARACTERISTIC
/begin CHARACTERISTIC FCdc4_ALLP_hi "FCtl_DTC_0x04(42)" VALUE 0x00163C24 /* @ECU_Address@FCtl_DTC_0x04@0x024C4054@ */ ECIPP_ALIGNMENT_UWORD 65535 Compu_IDENTITY 0 65535 PHYS_UNIT "System ID + DTC" /end CHARACTERISTIC
/begin CHARACTERISTIC FCdc4_ALLP_lo "FCtl_DTC_0x04(43)" VALUE 0x00163C26 /* @ECU_Address@FCtl_DTC_0x04@0x024C4056@ */ ECIPP_ALIGNMENT_UWORD 65535 Compu_IDENTITY 0 65535 PHYS_UNIT "System ID + DTC" /end CHARACTERISTIC
/begin CHARACTERISTIC FCdc4_ALNG_hi "FCtl_DTC_0x04(44)" VALUE 0x00163C28 /* @ECU_Address@FCtl_DTC_0x04@0x024C4058@ */ ECIPP_ALIGNMENT_UWORD 65535 Compu_IDENTITY 0 65535 PHYS_UNIT "System ID + DTC" /end CHARACTERISTIC
/begin CHARACTERISTIC FCdc4_ALNG_lo "FCtl_DTC_0x04(45)" VALUE 0x00163C2A /* @ECU_Address@FCtl_DTC_0x04@0x024C405A@ */ ECIPP_ALIGNMENT_UWORD 65535 Compu_IDENTITY 0 65535 PHYS_UNIT "System ID + DTC" /end CHARACTERISTIC
/begin CHARACTERISTIC FCdc4_APD1_max "FCtl_DTC_0x04(116)" VALUE 0x00163CB8 /* @ECU_Address@FCtl_DTC_0x04@0x024C40E8@ */ ECIPP_ALIGNMENT_UWORD 65535 Compu_IDENTITY 0 65535 PHYS_UNIT "System ID + DTC" /end CHARACTERISTIC
/begin CHARACTERISTIC FCdc4_APD1_min "FCtl_DTC_0x04(117)" VALUE 0x00163CBA /* @ECU_Address@FCtl_DTC_0x04@0x024C40EA@ */ ECIPP_ALIGNMENT_UWORD 65535 Compu_IDENTITY 0 65535 PHYS_UNIT "System ID + DTC" /end CHARACTERISTIC
/begin CHARACTERISTIC FCdc4_APD2_max "FCtl_DTC_0x04(229)" VALUE 0x00163D9A /* @ECU_Address@FCtl_DTC_0x04@0x024C41CA@ */ ECIPP_ALIGNMENT_UWORD 65535 Compu_IDENTITY 0 65535 PHYS_UNIT "System ID + DTC" /end CHARACTERISTIC
/begin CHARACTERISTIC FCdc4_APD2_min "FCtl_DTC_0x04(230)" VALUE 0x00163D9C /* @ECU_Address@FCtl_DTC_0x04@0x024C41CC@ */ ECIPP_ALIGNMENT_UWORD 65535 Compu_IDENTITY 0 65535 PHYS_UNIT "System ID + DTC" /end CHARACTERISTIC
/begin CHARACTERISTIC FCdc4_APD3_max "FCtl_DTC_0x04(231)" VALUE 0x00163D9E /* @ECU_Address@FCtl_DTC_0x04@0x024C41CE@ */ ECIPP_ALIGNMENT_UWORD 65535 Compu_IDENTITY 0 65535 PHYS_UNIT "System ID + DTC" /end CHARACTERISTIC
/begin CHARACTERISTIC FCdc4_APD3_min "FCtl_DTC_0x04(232)" VALUE 0x00163DA0 /* @ECU_Address@FCtl_DTC_0x04@0x024C41D0@ */ ECIPP_ALIGNMENT_UWORD 65535 Compu_IDENTITY 0 65535 PHYS_UNIT "System ID + DTC" /end CHARACTERISTIC
/begin CHARACTERISTIC FCdc4_APS1_max "FCtl_DTC_0x04(465)" VALUE 0x00163F72 /* @ECU_Address@FCtl_DTC_0x04@0x024C43A2@ */ ECIPP_ALIGNMENT_UWORD 65535 Compu_IDENTITY 0 65535 PHYS_UNIT "System ID + DTC" /end CHARACTERISTIC
/begin CHARACTERISTIC FCdc4_APS1_min "FCtl_DTC_0x04(466)" VALUE 0x00163F74 /* @ECU_Address@FCtl_DTC_0x04@0x024C43A4@ */ ECIPP_ALIGNMENT_UWORD 65535 Compu_IDENTITY 0 65535 PHYS_UNIT "System ID + DTC" /end CHARACTERISTIC
/begin CHARACTERISTIC FCdc4_APS12_OOR "FCtl_DTC_0x04(473)" VALUE 0x00163F82 /* @ECU_Address@FCtl_DTC_0x04@0x024C43B2@ */ ECIPP_ALIGNMENT_UWORD 65535 Compu_IDENTITY 0 65535 PHYS_UNIT "System ID + DTC" /end CHARACTERISTIC
/begin CHARACTERISTIC FCdc4_APS12pct_hi "FCtl_DTC_0x04(469)" VALUE 0x00163F7A /* @ECU_Address@FCtl_DTC_0x04@0x024C43AA@ */ ECIPP_ALIGNMENT_UWORD 65535 Compu_IDENTITY 0 65535 PHYS_UNIT "System ID + DTC" /end CHARACTERISTIC
/begin CHARACTERISTIC FCdc4_APS12pct_lo "FCtl_DTC_0x04(470)" VALUE 0x00163F7C /* @ECU_Address@FCtl_DTC_0x04@0x024C43AC@ */ ECIPP_ALIGNMENT_UWORD 65535 Compu_IDENTITY 0 65535 PHYS_UNIT "System ID + DTC" /end CHARACTERISTIC
/begin CHARACTERISTIC FCdc4_APS2_max "FCtl_DTC_0x04(467)" VALUE 0x00163F76 /* @ECU_Address@FCtl_DTC_0x04@0x024C43A6@ */ ECIPP_ALIGNMENT_UWORD 65535 Compu_IDENTITY 0 65535 PHYS_UNIT "System ID + DTC" /end CHARACTERISTIC
/begin CHARACTERISTIC FCdc4_APS2_min "FCtl_DTC_0x04(468)" VALUE 0x00163F78 /* @ECU_Address@FCtl_DTC_0x04@0x024C43A8@ */ ECIPP_ALIGNMENT_UWORD 65535 Compu_IDENTITY 0 65535 PHYS_UNIT "System ID + DTC" /end CHARACTERISTIC
/begin CHARACTERISTIC FCdc4_APSerr_neg "FCtl_DTC_0x04(472)" VALUE 0x00163F80 /* @ECU_Address@FCtl_DTC_0x04@0x024C43B0@ */ ECIPP_ALIGNMENT_UWORD 65535 Compu_IDENTITY 0 65535 PHYS_UNIT "System ID + DTC" /end CHARACTERISTIC
/begin CHARACTERISTIC FCdc4_APSerr_pos "FCtl_DTC_0x04(471)" VALUE 0x00163F7E /* @ECU_Address@FCtl_DTC_0x04@0x024C43AE@ */ ECIPP_ALIGNMENT_UWORD 65535 Compu_IDENTITY 0 65535 PHYS_UNIT "System ID + DTC" /end CHARACTERISTIC
/begin CHARACTERISTIC FCdc4_APU1_max "FCtl_DTC_0x04(118)" VALUE 0x00163CBC /* @ECU_Address@FCtl_DTC_0x04@0x024C40EC@ */ ECIPP_ALIGNMENT_UWORD 65535 Compu_IDENTITY 0 65535 PHYS_UNIT "System ID + DTC" /end CHARACTERISTIC
/begin CHARACTERISTIC FCdc4_APU1_min "FCtl_DTC_0x04(119)" VALUE 0x00163CBE /* @ECU_Address@FCtl_DTC_0x04@0x024C40EE@ */ ECIPP_ALIGNMENT_UWORD 65535 Compu_IDENTITY 0 65535 PHYS_UNIT "System ID + DTC" /end CHARACTERISTIC
/begin CHARACTERISTIC FCdc4_APU2_max "FCtl_DTC_0x04(120)" VALUE 0x00163CC0 /* @ECU_Address@FCtl_DTC_0x04@0x024C40F0@ */ ECIPP_ALIGNMENT_UWORD 65535 Compu_IDENTITY 0 65535 PHYS_UNIT "System ID + DTC" /end CHARACTERISTIC
/begin CHARACTERISTIC FCdc4_APU2_min "FCtl_DTC_0x04(121)" VALUE 0x00163CC2 /* @ECU_Address@FCtl_DTC_0x04@0x024C40F2@ */ ECIPP_ALIGNMENT_UWORD 65535 Compu_IDENTITY 0 65535 PHYS_UNIT "System ID + DTC" /end CHARACTERISTIC
/begin CHARACTERISTIC FCdc4_APU3_max "FCtl_DTC_0x04(201)" VALUE 0x00163D62 /* @ECU_Address@FCtl_DTC_0x04@0x024C4192@ */ ECIPP_ALIGNMENT_UWORD 65535 Compu_IDENTITY 0 65535 PHYS_UNIT "System ID + DTC" /end CHARACTERISTIC
/begin CHARACTERISTIC FCdc4_APU3_min "FCtl_DTC_0x04(202)" VALUE 0x00163D64 /* @ECU_Address@FCtl_DTC_0x04@0x024C4194@ */ ECIPP_ALIGNMENT_UWORD 65535 Compu_IDENTITY 0 65535 PHYS_UNIT "System ID + DTC" /end CHARACTERISTIC
/begin CHARACTERISTIC FCdc4_APUD1_max "FCtl_DTC_0x04(203)" VALUE 0x00163D66 /* @ECU_Address@FCtl_DTC_0x04@0x024C4196@ */ ECIPP_ALIGNMENT_UWORD 65535 Compu_IDENTITY 0 65535 PHYS_UNIT "System ID + DTC" /end CHARACTERISTIC
/begin CHARACTERISTIC FCdc4_APUD1_min "FCtl_DTC_0x04(204)" VALUE 0x00163D68 /* @ECU_Address@FCtl_DTC_0x04@0x024C4198@ */ ECIPP_ALIGNMENT_UWORD 65535 Compu_IDENTITY 0 65535 PHYS_UNIT "System ID + DTC" /end CHARACTERISTIC
/begin CHARACTERISTIC FCdc4_APUD10_max "FCtl_DTC_0x04(361)" VALUE 0x00163EA2 /* @ECU_Address@FCtl_DTC_0x04@0x024C42D2@ */ ECIPP_ALIGNMENT_UWORD 65535 Compu_IDENTITY 0 65535 PHYS_UNIT "System ID + DTC" /end CHARACTERISTIC
/begin CHARACTERISTIC FCdc4_APUD10_min "FCtl_DTC_0x04(362)" VALUE 0x00163EA4 /* @ECU_Address@FCtl_DTC_0x04@0x024C42D4@ */ ECIPP_ALIGNMENT_UWORD 65535 Compu_IDENTITY 0 65535 PHYS_UNIT "System ID + DTC" /end CHARACTERISTIC
/begin CHARACTERISTIC FCdc4_APUD11_max "FCtl_DTC_0x04(363)" VALUE 0x00163EA6 /* @ECU_Address@FCtl_DTC_0x04@0x024C42D6@ */ ECIPP_ALIGNMENT_UWORD 65535 Compu_IDENTITY 0 65535 PHYS_UNIT "System ID + DTC" /end CHARACTERISTIC
/begin CHARACTERISTIC FCdc4_APUD11_min "FCtl_DTC_0x04(364)" VALUE 0x00163EA8 /* @ECU_Address@FCtl_DTC_0x04@0x024C42D8@ */ ECIPP_ALIGNMENT_UWORD 65535 Compu_IDENTITY 0 65535 PHYS_UNIT "System ID + DTC" /end CHARACTERISTIC
/begin CHARACTERISTIC FCdc4_APUD12_max "FCtl_DTC_0x04(365)" VALUE 0x00163EAA /* @ECU_Address@FCtl_DTC_0x04@0x024C42DA@ */ ECIPP_ALIGNMENT_UWORD 65535 Compu_IDENTITY 0 65535 PHYS_UNIT "System ID + DTC" /end CHARACTERISTIC
/begin CHARACTERISTIC FPnd_ADIG15_min "FPrm_pending(307)" VALUE 0x00164BD2 /* @ECU_Address@FPrm_pending@0x021BE266@ */ ECIPP_ALIGNMENT_UWORD 65535 Compu_IDENTITY 0 65535 PHYS_UNIT "Bit Mask" /end CHARACTERISTIC
/begin CHARACTERISTIC FPnd_ADIG16_max "FPrm_pending(308)" VALUE 0x00164BD4 /* @ECU_Address@FPrm_pending@0x021BE268@ */ ECIPP_ALIGNMENT_UWORD 65535 Compu_IDENTITY 0 65535 PHYS_UNIT "Bit Mask" /end CHARACTERISTIC
/begin CHARACTERISTIC FPnd_ADIG16_min "FPrm_pending(309)" VALUE 0x00164BD6 /* @ECU_Address@FPrm_pending@0x021BE26A@ */ ECIPP_ALIGNMENT_UWORD 65535 Compu_IDENTITY 0 65535 PHYS_UNIT "Bit Mask" /end CHARACTERISTIC
/begin CHARACTERISTIC FPnd_ADIG17_max "FPrm_pending(310)" VALUE 0x00164BD8 /* @ECU_Address@FPrm_pending@0x021BE26C@ */ ECIPP_ALIGNMENT_UWORD 65535 Compu_IDENTITY 0 65535 PHYS_UNIT "Bit Mask" /end CHARACTERISTIC
/begin CHARACTERISTIC FPnd_ADIG17_min "FPrm_pending(311)" VALUE 0x00164BDA /* @ECU_Address@FPrm_pending@0x021BE26E@ */ ECIPP_ALIGNMENT_UWORD 65535 Compu_IDENTITY 0 65535 PHYS_UNIT "Bit Mask" /end CHARACTERISTIC
/begin CHARACTERISTIC FPnd_ADIG18_max "FPrm_pending(312)" VALUE 0x00164BDC /* @ECU_Address@FPrm_pending@0x021BE270@ */ ECIPP_ALIGNMENT_UWORD 65535 Compu_IDENTITY 0 65535 PHYS_UNIT "Bit Mask" /end CHARACTERISTIC
/begin CHARACTERISTIC FPnd_ADIG18_min "FPrm_pending(313)" VALUE 0x00164BDE /* @ECU_Address@FPrm_pending@0x021BE272@ */ ECIPP_ALIGNMENT_UWORD 65535 Compu_IDENTITY 0 65535 PHYS_UNIT "Bit Mask" /end CHARACTERISTIC
/begin CHARACTERISTIC FPnd_ADIG19_max "FPrm_pending(314)" VALUE 0x00164BE0 /* @ECU_Address@FPrm_pending@0x021BE274@ */ ECIPP_ALIGNMENT_UWORD 65535 Compu_IDENTITY 0 65535 PHYS_UNIT "Bit Mask" /end CHARACTERISTIC
/begin CHARACTERISTIC FPnd_ADIG19_min "FPrm_pending(315)" VALUE 0x00164BE2 /* @ECU_Address@FPrm_pending@0x021BE276@ */ ECIPP_ALIGNMENT_UWORD 65535 Compu_IDENTITY 0 65535 PHYS_UNIT "Bit Mask" /end CHARACTERISTIC
/begin CHARACTERISTIC FPnd_ADIG2_max "FPrm_pending(167)" VALUE 0x00164ABA /* @ECU_Address@FPrm_pending@0x021BE14E@ */ ECIPP_ALIGNMENT_UWORD 65535 Compu_IDENTITY 0 65535 PHYS_UNIT "Bit Mask" /end CHARACTERISTIC
/begin CHARACTERISTIC FPnd_ADIG2_min "FPrm_pending(168)" VALUE 0x00164ABC /* @ECU_Address@FPrm_pending@0x021BE150@ */ ECIPP_ALIGNMENT_UWORD 65535 Compu_IDENTITY 0 65535 PHYS_UNIT "Bit Mask" /end CHARACTERISTIC
/begin CHARACTERISTIC FPnd_ADIG20_max "FPrm_pending(438)" VALUE 0x00164CD8 /* @ECU_Address@FPrm_pending@0x021BE36C@ */ ECIPP_ALIGNMENT_UWORD 65535 Compu_IDENTITY 0 65535 PHYS_UNIT "Bit Mask" /end CHARACTERISTIC
/begin CHARACTERISTIC FPnd_ADIG20_min "FPrm_pending(439)" VALUE 0x00164CDA /* @ECU_Address@FPrm_pending@0x021BE36E@ */ ECIPP_ALIGNMENT_UWORD 65535 Compu_IDENTITY 0 65535 PHYS_UNIT "Bit Mask" /end CHARACTERISTIC
/begin CHARACTERISTIC FPnd_ADIG21_max "FPrm_pending(440)" VALUE 0x00164CDC /* @ECU_Address@FPrm_pending@0x021BE370@ */ ECIPP_ALIGNMENT_UWORD 65535 Compu_IDENTITY 0 65535 PHYS_UNIT "Bit Mask" /end CHARACTERISTIC
/begin CHARACTERISTIC FPnd_ADIG21_min "FPrm_pending(441)" VALUE 0x00164CDE /* @ECU_Address@FPrm_pending@0x021BE372@ */ ECIPP_ALIGNMENT_UWORD 65535 Compu_IDENTITY 0 65535 PHYS_UNIT "Bit Mask" /end CHARACTERISTIC
/begin CHARACTERISTIC FPnd_ADIG22_max "FPrm_pending(442)" VALUE 0x00164CE0 /* @ECU_Address@FPrm_pending@0x021BE374@ */ ECIPP_ALIGNMENT_UWORD 65535 Compu_IDENTITY 0 65535 PHYS_UNIT "Bit Mask" /end CHARACTERISTIC
/begin CHARACTERISTIC FPnd_ADIG22_min "FPrm_pending(443)" VALUE 0x00164CE2 /* @ECU_Address@FPrm_pending@0x021BE376@ */ ECIPP_ALIGNMENT_UWORD 65535 Compu_IDENTITY 0 65535 PHYS_UNIT "Bit Mask" /end CHARACTERISTIC
/begin CHARACTERISTIC FPnd_ADIG23_max "FPrm_pending(444)" VALUE 0x00164CE4 /* @ECU_Address@FPrm_pending@0x021BE378@ */ ECIPP_ALIGNMENT_UWORD 65535 Compu_IDENTITY 0 65535 PHYS_UNIT "Bit Mask" /end CHARACTERISTIC
/begin CHARACTERISTIC FPnd_ADIG23_min "FPrm_pending(445)" VALUE 0x00164CE6 /* @ECU_Address@FPrm_pending@0x021BE37A@ */ ECIPP_ALIGNMENT_UWORD 65535 Compu_IDENTITY 0 65535 PHYS_UNIT "Bit Mask" /end CHARACTERISTIC
/begin CHARACTERISTIC FPnd_ADIG24_max "FPrm_pending(446)" VALUE 0x00164CE8 /* @ECU_Address@FPrm_pending@0x021BE37C@ */ ECIPP_ALIGNMENT_UWORD 65535 Compu_IDENTITY 0 65535 PHYS_UNIT "Bit Mask" /end CHARACTERISTIC
/begin CHARACTERISTIC FPnd_ADIG24_min "FPrm_pending(447)" VALUE 0x00164CEA /* @ECU_Address@FPrm_pending@0x021BE37E@ */ ECIPP_ALIGNMENT_UWORD 65535 Compu_IDENTITY 0 65535 PHYS_UNIT "Bit Mask" /end CHARACTERISTIC
/begin CHARACTERISTIC FPnd_ADIG25_max "FPrm_pending(448)" VALUE 0x00164CEC /* @ECU_Address@FPrm_pending@0x021BE380@ */ ECIPP_ALIGNMENT_UWORD 65535 Compu_IDENTITY 0 65535 PHYS_UNIT "Bit Mask" /end CHARACTERISTIC
/begin CHARACTERISTIC FPnd_ADIG25_min "FPrm_pending(449)" VALUE 0x00164CEE /* @ECU_Address@FPrm_pending@0x021BE382@ */ ECIPP_ALIGNMENT_UWORD 65535 Compu_IDENTITY 0 65535 PHYS_UNIT "Bit Mask" /end CHARACTERISTIC
/begin CHARACTERISTIC FPnd_ADIG3_max "FPrm_pending(169)" VALUE 0x00164ABE /* @ECU_Address@FPrm_pending@0x021BE152@ */ ECIPP_ALIGNMENT_UWORD 65535 Compu_IDENTITY 0 65535 PHYS_UNIT "Bit Mask" /end CHARACTERISTIC
/begin CHARACTERISTIC FPnd_ADIG3_min "FPrm_pending(170)" VALUE 0x00164AC0 /* @ECU_Address@FPrm_pending@0x021BE154@ */ ECIPP_ALIGNMENT_UWORD 65535 Compu_IDENTITY 0 65535 PHYS_UNIT "Bit Mask" /end CHARACTERISTIC
/begin CHARACTERISTIC FPnd_ADIG4_max "FPrm_pending(246)" VALUE 0x00164B58 /* @ECU_Address@FPrm_pending@0x021BE1EC@ */ ECIPP_ALIGNMENT_UWORD 65535 Compu_IDENTITY 0 65535 PHYS_UNIT "Bit Mask" /end CHARACTERISTIC
/begin CHARACTERISTIC FPnd_ADIG4_min "FPrm_pending(247)" VALUE 0x00164B5A /* @ECU_Address@FPrm_pending@0x021BE1EE@ */ ECIPP_ALIGNMENT_UWORD 65535 Compu_IDENTITY 0 65535 PHYS_UNIT "Bit Mask" /end CHARACTERISTIC
/begin CHARACTERISTIC FPnd_ADIG5_max "FPrm_pending(248)" VALUE 0x00164B5C /* @ECU_Address@FPrm_pending@0x021BE1F0@ */ ECIPP_ALIGNMENT_UWORD 65535 Compu_IDENTITY 0 65535 PHYS_UNIT "Bit Mask" /end CHARACTERISTIC
/begin CHARACTERISTIC FPnd_ADIG5_min "FPrm_pending(249)" VALUE 0x00164B5E /* @ECU_Address@FPrm_pending@0x021BE1F2@ */ ECIPP_ALIGNMENT_UWORD 65535 Compu_IDENTITY 0 65535 PHYS_UNIT "Bit Mask" /end CHARACTERISTIC
/begin CHARACTERISTIC FPnd_ADIG6_max "FPrm_pending(250)" VALUE 0x00164B60 /* @ECU_Address@FPrm_pending@0x021BE1F4@ */ ECIPP_ALIGNMENT_UWORD 65535 Compu_IDENTITY 0 65535 PHYS_UNIT "Bit Mask" /end CHARACTERISTIC
/begin CHARACTERISTIC FPnd_ADIG6_min "FPrm_pending(251)" VALUE 0x00164B62 /* @ECU_Address@FPrm_pending@0x021BE1F6@ */ ECIPP_ALIGNMENT_UWORD 65535 Compu_IDENTITY 0 65535 PHYS_UNIT "Bit Mask" /end CHARACTERISTIC
/begin CHARACTERISTIC FPnd_ADIG7_max "FPrm_pending(252)" VALUE 0x00164B64 /* @ECU_Address@FPrm_pending@0x021BE1F8@ */ ECIPP_ALIGNMENT_UWORD 65535 Compu_IDENTITY 0 65535 PHYS_UNIT "Bit Mask" /end CHARACTERISTIC
/begin CHARACTERISTIC FPnd_ADIG7_min "FPrm_pending(253)" VALUE 0x00164B66 /* @ECU_Address@FPrm_pending@0x021BE1FA@ */ ECIPP_ALIGNMENT_UWORD 65535 Compu_IDENTITY 0 65535 PHYS_UNIT "Bit Mask" /end CHARACTERISTIC
/begin CHARACTERISTIC FPnd_ADIG8_max "FPrm_pending(254)" VALUE 0x00164B68 /* @ECU_Address@FPrm_pending@0x021BE1FC@ */ ECIPP_ALIGNMENT_UWORD 65535 Compu_IDENTITY 0 65535 PHYS_UNIT "Bit Mask" /end CHARACTERISTIC
/begin CHARACTERISTIC FPnd_ADIG8_min "FPrm_pending(255)" VALUE 0x00164B6A /* @ECU_Address@FPrm_pending@0x021BE1FE@ */ ECIPP_ALIGNMENT_UWORD 65535 Compu_IDENTITY 0 65535 PHYS_UNIT "Bit Mask" /end CHARACTERISTIC
/begin CHARACTERISTIC FPnd_ADIG9_max "FPrm_pending(256)" VALUE 0x00164B6C /* @ECU_Address@FPrm_pending@0x021BE200@ */ ECIPP_ALIGNMENT_UWORD 65535 Compu_IDENTITY 0 65535 PHYS_UNIT "Bit Mask" /end CHARACTERISTIC
/begin CHARACTERISTIC FPnd_ADIG9_min "FPrm_pending(257)" VALUE 0x00164B6E /* @ECU_Address@FPrm_pending@0x021BE202@ */ ECIPP_ALIGNMENT_UWORD 65535 Compu_IDENTITY 0 65535 PHYS_UNIT "Bit Mask" /end CHARACTERISTIC
/begin CHARACTERISTIC FPnd_ADloss "FPrm_pending(67)" VALUE 0x001649F2 /* @ECU_Address@FPrm_pending@0x021BE086@ */ ECIPP_ALIGNMENT_UWORD 65535 Compu_IDENTITY 0 65535 PHYS_UNIT "Bit Mask" /end CHARACTERISTIC
/begin CHARACTERISTIC FPnd_AFILT_dP_high "FPrm_pending(562)" VALUE 0x00164DD0 /* @ECU_Address@FPrm_pending@0x021BE464@ */ ECIPP_ALIGNMENT_UWORD 65535 Compu_IDENTITY 0 65535 PHYS_UNIT "Bit Mask" /end CHARACTERISTIC
/begin CHARACTERISTIC FPnd_AL_hi "FPrm_pending(41)" VALUE 0x001649BE /* @ECU_Address@FPrm_pending@0x021BE052@ */ ECIPP_ALIGNMENT_UWORD 65535 Compu_IDENTITY 0 65535 PHYS_UNIT "Bit Mask" /end CHARACTERISTIC
/begin CHARACTERISTIC FPnd_AL_lo "FPrm_pending(42)" VALUE 0x001649C0 /* @ECU_Address@FPrm_pending@0x021BE054@ */ ECIPP_ALIGNMENT_UWORD 65535 Compu_IDENTITY 0 65535 PHYS_UNIT "Bit Mask" /end CHARACTERISTIC
/begin CHARACTERISTIC FPnd_ALLP_hi "FPrm_pending(43)" VALUE 0x001649C2 /* @ECU_Address@FPrm_pending@0x021BE056@ */ ECIPP_ALIGNMENT_UWORD 65535 Compu_IDENTITY 0 65535 PHYS_UNIT "Bit Mask" /end CHARACTERISTIC
/begin CHARACTERISTIC FPnd_ALLP_lo "FPrm_pending(44)" VALUE 0x001649C4 /* @ECU_Address@FPrm_pending@0x021BE058@ */ ECIPP_ALIGNMENT_UWORD 65535 Compu_IDENTITY 0 65535 PHYS_UNIT "Bit Mask" /end CHARACTERISTIC
/begin CHARACTERISTIC FPnd_ALNG_hi "FPrm_pending(45)" VALUE 0x001649C6 /* @ECU_Address@FPrm_pending@0x021BE05A@ */ ECIPP_ALIGNMENT_UWORD 65535 Compu_IDENTITY 0 65535 PHYS_UNIT "Bit Mask" /end CHARACTERISTIC
/begin CHARACTERISTIC FPnd_ALNG_lo "FPrm_pending(46)" VALUE 0x001649C8 /* @ECU_Address@FPrm_pending@0x021BE05C@ */ ECIPP_ALIGNMENT_UWORD 65535 Compu_IDENTITY 0 65535 PHYS_UNIT "Bit Mask" /end CHARACTERISTIC
/begin CHARACTERISTIC FPnd_APD1_max "FPrm_pending(75)" VALUE 0x00164A02 /* @ECU_Address@FPrm_pending@0x021BE096@ */ ECIPP_ALIGNMENT_UWORD 65535 Compu_IDENTITY 0 65535 PHYS_UNIT "Bit Mask" /end CHARACTERISTIC
/begin CHARACTERISTIC FPnd_APD1_min "FPrm_pending(76)" VALUE 0x00164A04 /* @ECU_Address@FPrm_pending@0x021BE098@ */ ECIPP_ALIGNMENT_UWORD 65535 Compu_IDENTITY 0 65535 PHYS_UNIT "Bit Mask" /end CHARACTERISTIC
/begin CHARACTERISTIC FPnd_APD2_max "FPrm_pending(181)" VALUE 0x00164AD6 /* @ECU_Address@FPrm_pending@0x021BE16A@ */ ECIPP_ALIGNMENT_UWORD 65535 Compu_IDENTITY 0 65535 PHYS_UNIT "Bit Mask" /end CHARACTERISTIC
/begin CHARACTERISTIC FPnd_APD2_min "FPrm_pending(182)" VALUE 0x00164AD8 /* @ECU_Address@FPrm_pending@0x021BE16C@ */ ECIPP_ALIGNMENT_UWORD 65535 Compu_IDENTITY 0 65535 PHYS_UNIT "Bit Mask" /end CHARACTERISTIC
/begin CHARACTERISTIC FPnd_APD3_max "FPrm_pending(183)" VALUE 0x00164ADA /* @ECU_Address@FPrm_pending@0x021BE16E@ */ ECIPP_ALIGNMENT_UWORD 65535 Compu_IDENTITY 0 65535 PHYS_UNIT "Bit Mask" /end CHARACTERISTIC
/begin CHARACTERISTIC FPnd_APD3_min "FPrm_pending(184)" VALUE 0x00164ADC /* @ECU_Address@FPrm_pending@0x021BE170@ */ ECIPP_ALIGNMENT_UWORD 65535 Compu_IDENTITY 0 65535 PHYS_UNIT "Bit Mask" /end CHARACTERISTIC
/begin CHARACTERISTIC FPnd_APS1_max "FPrm_pending(362)" VALUE 0x00164C40 /* @ECU_Address@FPrm_pending@0x021BE2D4@ */ ECIPP_ALIGNMENT_UWORD 65535 Compu_IDENTITY 0 65535 PHYS_UNIT "Bit Mask" /end CHARACTERISTIC
/begin CHARACTERISTIC FPnd_APS1_min "FPrm_pending(363)" VALUE 0x00164C42 /* @ECU_Address@FPrm_pending@0x021BE2D6@ */ ECIPP_ALIGNMENT_UWORD 65535 Compu_IDENTITY 0 65535 PHYS_UNIT "Bit Mask" /end CHARACTERISTIC
/begin CHARACTERISTIC FPnd_APS12_OOR "FPrm_pending(370)" VALUE 0x00164C50 /* @ECU_Address@FPrm_pending@0x021BE2E4@ */ ECIPP_ALIGNMENT_UWORD 65535 Compu_IDENTITY 0 65535 PHYS_UNIT "Bit Mask" /end CHARACTERISTIC
/begin CHARACTERISTIC FPnd_APS12pct_hi "FPrm_pending(366)" VALUE 0x00164C48 /* @ECU_Address@FPrm_pending@0x021BE2DC@ */ ECIPP_ALIGNMENT_UWORD 65535 Compu_IDENTITY 0 65535 PHYS_UNIT "Bit Mask" /end CHARACTERISTIC
/begin CHARACTERISTIC FPnd_APS12pct_lo "FPrm_pending(367)" VALUE 0x00164C4A /* @ECU_Address@FPrm_pending@0x021BE2DE@ */ ECIPP_ALIGNMENT_UWORD 65535 Compu_IDENTITY 0 65535 PHYS_UNIT "Bit Mask" /end CHARACTERISTIC
/begin CHARACTERISTIC FPnd_APS2_max "FPrm_pending(364)" VALUE 0x00164C44 /* @ECU_Address@FPrm_pending@0x021BE2D8@ */ ECIPP_ALIGNMENT_UWORD 65535 Compu_IDENTITY 0 65535 PHYS_UNIT "Bit Mask" /end CHARACTERISTIC
/begin CHARACTERISTIC FPnd_APS2_min "FPrm_pending(365)" VALUE 0x00164C46 /* @ECU_Address@FPrm_pending@0x021BE2DA@ */ ECIPP_ALIGNMENT_UWORD 65535 Compu_IDENTITY 0 65535 PHYS_UNIT "Bit Mask" /end CHARACTERISTIC
/begin CHARACTERISTIC FPnd_APSerr_neg "FPrm_pending(369)" VALUE 0x00164C4E /* @ECU_Address@FPrm_pending@0x021BE2E2@ */ ECIPP_ALIGNMENT_UWORD 65535 Compu_IDENTITY 0 65535 PHYS_UNIT "Bit Mask" /end CHARACTERISTIC
/begin CHARACTERISTIC FPnd_APSerr_pos "FPrm_pending(368)" VALUE 0x00164C4C /* @ECU_Address@FPrm_pending@0x021BE2E0@ */ ECIPP_ALIGNMENT_UWORD 65535 Compu_IDENTITY 0 65535 PHYS_UNIT "Bit Mask" /end CHARACTERISTIC
/begin CHARACTERISTIC FPnd_APU1_max "FPrm_pending(77)" VALUE 0x00164A06 /* @ECU_Address@FPrm_pending@0x021BE09A@ */ ECIPP_ALIGNMENT_UWORD 65535 Compu_IDENTITY 0 65535 PHYS_UNIT "Bit Mask" /end CHARACTERISTIC
/begin CHARACTERISTIC FPnd_APU1_min "FPrm_pending(78)" VALUE 0x00164A08 /* @ECU_Address@FPrm_pending@0x021BE09C@ */ ECIPP_ALIGNMENT_UWORD 65535 Compu_IDENTITY 0 65535 PHYS_UNIT "Bit Mask" /end CHARACTERISTIC
/begin CHARACTERISTIC FPnd_APU2_max "FPrm_pending(79)" VALUE 0x00164A0A /* @ECU_Address@FPrm_pending@0x021BE09E@ */ ECIPP_ALIGNMENT_UWORD 65535 Compu_IDENTITY 0 65535 PHYS_UNIT "Bit Mask" /end CHARACTERISTIC
/begin CHARACTERISTIC FPnd_APU2_min "FPrm_pending(80)" VALUE 0x00164A0C /* @ECU_Address@FPrm_pending@0x021BE0A0@ */ ECIPP_ALIGNMENT_UWORD 65535 Compu_IDENTITY 0 65535 PHYS_UNIT "Bit Mask" /end CHARACTERISTIC
/begin CHARACTERISTIC FPnd_APU3_max "FPrm_pending(157)" VALUE 0x00164AA6 /* @ECU_Address@FPrm_pending@0x021BE13A@ */ ECIPP_ALIGNMENT_UWORD 65535 Compu_IDENTITY 0 65535 PHYS_UNIT "Bit Mask" /end CHARACTERISTIC
/begin CHARACTERISTIC FPnd_APU3_min "FPrm_pending(158)" VALUE 0x00164AA8 /* @ECU_Address@FPrm_pending@0x021BE13C@ */ ECIPP_ALIGNMENT_UWORD 65535 Compu_IDENTITY 0 65535 PHYS_UNIT "Bit Mask" /end CHARACTERISTIC
/begin CHARACTERISTIC FPnd_APUD1_max "FPrm_pending(159)" VALUE 0x00164AAA /* @ECU_Address@FPrm_pending@0x021BE13E@ */ ECIPP_ALIGNMENT_UWORD 65535 Compu_IDENTITY 0 65535 PHYS_UNIT "Bit Mask" /end CHARACTERISTIC
/begin CHARACTERISTIC FPnd_APUD1_min "FPrm_pending(160)" VALUE 0x00164AAC /* @ECU_Address@FPrm_pending@0x021BE140@ */ ECIPP_ALIGNMENT_UWORD 65535 Compu_IDENTITY 0 65535 PHYS_UNIT "Bit Mask" /end CHARACTERISTIC
/begin CHARACTERISTIC FPnd_APUD10_max "FPrm_pending(270)" VALUE 0x00164B88 /* @ECU_Address@FPrm_pending@0x021BE21C@ */ ECIPP_ALIGNMENT_UWORD 65535 Compu_IDENTITY 0 65535 PHYS_UNIT "Bit Mask" /end CHARACTERISTIC
/begin CHARACTERISTIC FPnd_APUD10_min "FPrm_pending(271)" VALUE 0x00164B8A /* @ECU_Address@FPrm_pending@0x021BE21E@ */ ECIPP_ALIGNMENT_UWORD 65535 Compu_IDENTITY 0 65535 PHYS_UNIT "Bit Mask" /end CHARACTERISTIC
/begin CHARACTERISTIC FPnd_APUD11_max "FPrm_pending(272)" VALUE 0x00164B8C /* @ECU_Address@FPrm_pending@0x021BE220@ */ ECIPP_ALIGNMENT_UWORD 65535 Compu_IDENTITY 0 65535 PHYS_UNIT "Bit Mask" /end CHARACTERISTIC
/begin CHARACTERISTIC FPnd_APUD11_min "FPrm_pending(273)" VALUE 0x00164B8E /* @ECU_Address@FPrm_pending@0x021BE222@ */ ECIPP_ALIGNMENT_UWORD 65535 Compu_IDENTITY 0 65535 PHYS_UNIT "Bit Mask" /end CHARACTERISTIC
/begin CHARACTERISTIC FPnd_APUD12_max "FPrm_pending(274)" VALUE 0x00164B90 /* @ECU_Address@FPrm_pending@0x021BE224@ */ ECIPP_ALIGNMENT_UWORD 65535 Compu_IDENTITY 0 65535 PHYS_UNIT "Bit Mask" /end CHARACTERISTIC
/begin CHARACTERISTIC FPsvr_ADIG15_min "FPrm_severity(307)" VALUE 0x00165F11 /* @ECU_Address@FPrm_severity@0x024B3133@ */ ECIPP_ALIGNMENT_UBYTE 255 Compu_IDENTITY 0 255 PHYS_UNIT "Severity+Class" /end CHARACTERISTIC
/begin CHARACTERISTIC FPsvr_ADIG16_max "FPrm_severity(308)" VALUE 0x00165F12 /* @ECU_Address@FPrm_severity@0x024B3134@ */ ECIPP_ALIGNMENT_UBYTE 255 Compu_IDENTITY 0 255 PHYS_UNIT "Severity+Class" /end CHARACTERISTIC
/begin CHARACTERISTIC FPsvr_ADIG16_min "FPrm_severity(309)" VALUE 0x00165F13 /* @ECU_Address@FPrm_severity@0x024B3135@ */ ECIPP_ALIGNMENT_UBYTE 255 Compu_IDENTITY 0 255 PHYS_UNIT "Severity+Class" /end CHARACTERISTIC
/begin CHARACTERISTIC FPsvr_ADIG17_max "FPrm_severity(310)" VALUE 0x00165F14 /* @ECU_Address@FPrm_severity@0x024B3136@ */ ECIPP_ALIGNMENT_UBYTE 255 Compu_IDENTITY 0 255 PHYS_UNIT "Severity+Class" /end CHARACTERISTIC
/begin CHARACTERISTIC FPsvr_ADIG17_min "FPrm_severity(311)" VALUE 0x00165F15 /* @ECU_Address@FPrm_severity@0x024B3137@ */ ECIPP_ALIGNMENT_UBYTE 255 Compu_IDENTITY 0 255 PHYS_UNIT "Severity+Class" /end CHARACTERISTIC
/begin CHARACTERISTIC FPsvr_ADIG18_max "FPrm_severity(312)" VALUE 0x00165F16 /* @ECU_Address@FPrm_severity@0x024B3138@ */ ECIPP_ALIGNMENT_UBYTE 255 Compu_IDENTITY 0 255 PHYS_UNIT "Severity+Class" /end CHARACTERISTIC
/begin CHARACTERISTIC FPsvr_ADIG18_min "FPrm_severity(313)" VALUE 0x00165F17 /* @ECU_Address@FPrm_severity@0x024B3139@ */ ECIPP_ALIGNMENT_UBYTE 255 Compu_IDENTITY 0 255 PHYS_UNIT "Severity+Class" /end CHARACTERISTIC
/begin CHARACTERISTIC FPsvr_ADIG19_max "FPrm_severity(314)" VALUE 0x00165F18 /* @ECU_Address@FPrm_severity@0x024B313A@ */ ECIPP_ALIGNMENT_UBYTE 255 Compu_IDENTITY 0 255 PHYS_UNIT "Severity+Class" /end CHARACTERISTIC
/begin CHARACTERISTIC FPsvr_ADIG19_min "FPrm_severity(315)" VALUE 0x00165F19 /* @ECU_Address@FPrm_severity@0x024B313B@ */ ECIPP_ALIGNMENT_UBYTE 255 Compu_IDENTITY 0 255 PHYS_UNIT "Severity+Class" /end CHARACTERISTIC
/begin CHARACTERISTIC FPsvr_ADIG2_max "FPrm_severity(167)" VALUE 0x00165E85 /* @ECU_Address@FPrm_severity@0x024B30A7@ */ ECIPP_ALIGNMENT_UBYTE 255 Compu_IDENTITY 0 255 PHYS_UNIT "Severity+Class" /end CHARACTERISTIC
/begin CHARACTERISTIC FPsvr_ADIG2_min "FPrm_severity(168)" VALUE 0x00165E86 /* @ECU_Address@FPrm_severity@0x024B30A8@ */ ECIPP_ALIGNMENT_UBYTE 255 Compu_IDENTITY 0 255 PHYS_UNIT "Severity+Class" /end CHARACTERISTIC
/begin CHARACTERISTIC FPsvr_ADIG20_max "FPrm_severity(438)" VALUE 0x00165F94 /* @ECU_Address@FPrm_severity@0x024B31B6@ */ ECIPP_ALIGNMENT_UBYTE 255 Compu_IDENTITY 0 255 PHYS_UNIT "Severity+Class" /end CHARACTERISTIC
/begin CHARACTERISTIC FPsvr_ADIG20_min "FPrm_severity(439)" VALUE 0x00165F95 /* @ECU_Address@FPrm_severity@0x024B31B7@ */ ECIPP_ALIGNMENT_UBYTE 255 Compu_IDENTITY 0 255 PHYS_UNIT "Severity+Class" /end CHARACTERISTIC
/begin CHARACTERISTIC FPsvr_ADIG21_max "FPrm_severity(440)" VALUE 0x00165F96 /* @ECU_Address@FPrm_severity@0x024B31B8@ */ ECIPP_ALIGNMENT_UBYTE 255 Compu_IDENTITY 0 255 PHYS_UNIT "Severity+Class" /end CHARACTERISTIC
/begin CHARACTERISTIC FPsvr_ADIG21_min "FPrm_severity(441)" VALUE 0x00165F97 /* @ECU_Address@FPrm_severity@0x024B31B9@ */ ECIPP_ALIGNMENT_UBYTE 255 Compu_IDENTITY 0 255 PHYS_UNIT "Severity+Class" /end CHARACTERISTIC
/begin CHARACTERISTIC FPsvr_ADIG22_max "FPrm_severity(442)" VALUE 0x00165F98 /* @ECU_Address@FPrm_severity@0x024B31BA@ */ ECIPP_ALIGNMENT_UBYTE 255 Compu_IDENTITY 0 255 PHYS_UNIT "Severity+Class" /end CHARACTERISTIC
/begin CHARACTERISTIC FPsvr_ADIG22_min "FPrm_severity(443)" VALUE 0x00165F99 /* @ECU_Address@FPrm_severity@0x024B31BB@ */ ECIPP_ALIGNMENT_UBYTE 255 Compu_IDENTITY 0 255 PHYS_UNIT "Severity+Class" /end CHARACTERISTIC
/begin CHARACTERISTIC FPsvr_ADIG23_max "FPrm_severity(444)" VALUE 0x00165F9A /* @ECU_Address@FPrm_severity@0x024B31BC@ */ ECIPP_ALIGNMENT_UBYTE 255 Compu_IDENTITY 0 255 PHYS_UNIT "Severity+Class" /end CHARACTERISTIC
/begin CHARACTERISTIC FPsvr_ADIG23_min "FPrm_severity(445)" VALUE 0x00165F9B /* @ECU_Address@FPrm_severity@0x024B31BD@ */ ECIPP_ALIGNMENT_UBYTE 255 Compu_IDENTITY 0 255 PHYS_UNIT "Severity+Class" /end CHARACTERISTIC
/begin CHARACTERISTIC FPsvr_ADIG24_max "FPrm_severity(446)" VALUE 0x00165F9C /* @ECU_Address@FPrm_severity@0x024B31BE@ */ ECIPP_ALIGNMENT_UBYTE 255 Compu_IDENTITY 0 255 PHYS_UNIT "Severity+Class" /end CHARACTERISTIC
/begin CHARACTERISTIC FPsvr_ADIG24_min "FPrm_severity(447)" VALUE 0x00165F9D /* @ECU_Address@FPrm_severity@0x024B31BF@ */ ECIPP_ALIGNMENT_UBYTE 255 Compu_IDENTITY 0 255 PHYS_UNIT "Severity+Class" /end CHARACTERISTIC
/begin CHARACTERISTIC FPsvr_ADIG25_max "FPrm_severity(448)" VALUE 0x00165F9E /* @ECU_Address@FPrm_severity@0x024B31C0@ */ ECIPP_ALIGNMENT_UBYTE 255 Compu_IDENTITY 0 255 PHYS_UNIT "Severity+Class" /end CHARACTERISTIC
/begin CHARACTERISTIC FPsvr_ADIG25_min "FPrm_severity(449)" VALUE 0x00165F9F /* @ECU_Address@FPrm_severity@0x024B31C1@ */ ECIPP_ALIGNMENT_UBYTE 255 Compu_IDENTITY 0 255 PHYS_UNIT "Severity+Class" /end CHARACTERISTIC
/begin CHARACTERISTIC FPsvr_ADIG3_max "FPrm_severity(169)" VALUE 0x00165E87 /* @ECU_Address@FPrm_severity@0x024B30A9@ */ ECIPP_ALIGNMENT_UBYTE 255 Compu_IDENTITY 0 255 PHYS_UNIT "Severity+Class" /end CHARACTERISTIC
/begin CHARACTERISTIC FPsvr_ADIG3_min "FPrm_severity(170)" VALUE 0x00165E88 /* @ECU_Address@FPrm_severity@0x024B30AA@ */ ECIPP_ALIGNMENT_UBYTE 255 Compu_IDENTITY 0 255 PHYS_UNIT "Severity+Class" /end CHARACTERISTIC
/begin CHARACTERISTIC FPsvr_ADIG4_max "FPrm_severity(246)" VALUE 0x00165ED4 /* @ECU_Address@FPrm_severity@0x024B30F6@ */ ECIPP_ALIGNMENT_UBYTE 255 Compu_IDENTITY 0 255 PHYS_UNIT "Severity+Class" /end CHARACTERISTIC
/begin CHARACTERISTIC FPsvr_ADIG4_min "FPrm_severity(247)" VALUE 0x00165ED5 /* @ECU_Address@FPrm_severity@0x024B30F7@ */ ECIPP_ALIGNMENT_UBYTE 255 Compu_IDENTITY 0 255 PHYS_UNIT "Severity+Class" /end CHARACTERISTIC
/begin CHARACTERISTIC FPsvr_ADIG5_max "FPrm_severity(248)" VALUE 0x00165ED6 /* @ECU_Address@FPrm_severity@0x024B30F8@ */ ECIPP_ALIGNMENT_UBYTE 255 Compu_IDENTITY 0 255 PHYS_UNIT "Severity+Class" /end CHARACTERISTIC
/begin CHARACTERISTIC FPsvr_ADIG5_min "FPrm_severity(249)" VALUE 0x00165ED7 /* @ECU_Address@FPrm_severity@0x024B30F9@ */ ECIPP_ALIGNMENT_UBYTE 255 Compu_IDENTITY 0 255 PHYS_UNIT "Severity+Class" /end CHARACTERISTIC
/begin CHARACTERISTIC FPsvr_ADIG6_max "FPrm_severity(250)" VALUE 0x00165ED8 /* @ECU_Address@FPrm_severity@0x024B30FA@ */ ECIPP_ALIGNMENT_UBYTE 255 Compu_IDENTITY 0 255 PHYS_UNIT "Severity+Class" /end CHARACTERISTIC
/begin CHARACTERISTIC FPsvr_ADIG6_min "FPrm_severity(251)" VALUE 0x00165ED9 /* @ECU_Address@FPrm_severity@0x024B30FB@ */ ECIPP_ALIGNMENT_UBYTE 255 Compu_IDENTITY 0 255 PHYS_UNIT "Severity+Class" /end CHARACTERISTIC
/begin CHARACTERISTIC FPsvr_ADIG7_max "FPrm_severity(252)" VALUE 0x00165EDA /* @ECU_Address@FPrm_severity@0x024B30FC@ */ ECIPP_ALIGNMENT_UBYTE 255 Compu_IDENTITY 0 255 PHYS_UNIT "Severity+Class" /end CHARACTERISTIC
/begin CHARACTERISTIC FPsvr_ADIG7_min "FPrm_severity(253)" VALUE 0x00165EDB /* @ECU_Address@FPrm_severity@0x024B30FD@ */ ECIPP_ALIGNMENT_UBYTE 255 Compu_IDENTITY 0 255 PHYS_UNIT "Severity+Class" /end CHARACTERISTIC
/begin CHARACTERISTIC FPsvr_ADIG8_max "FPrm_severity(254)" VALUE 0x00165EDC /* @ECU_Address@FPrm_severity@0x024B30FE@ */ ECIPP_ALIGNMENT_UBYTE 255 Compu_IDENTITY 0 255 PHYS_UNIT "Severity+Class" /end CHARACTERISTIC
/begin CHARACTERISTIC FPsvr_ADIG8_min "FPrm_severity(255)" VALUE 0x00165EDD /* @ECU_Address@FPrm_severity@0x024B30FF@ */ ECIPP_ALIGNMENT_UBYTE 255 Compu_IDENTITY 0 255 PHYS_UNIT "Severity+Class" /end CHARACTERISTIC
/begin CHARACTERISTIC FPsvr_ADIG9_max "FPrm_severity(256)" VALUE 0x00165EDE /* @ECU_Address@FPrm_severity@0x024B3100@ */ ECIPP_ALIGNMENT_UBYTE 255 Compu_IDENTITY 0 255 PHYS_UNIT "Severity+Class" /end CHARACTERISTIC
/begin CHARACTERISTIC FPsvr_ADIG9_min "FPrm_severity(257)" VALUE 0x00165EDF /* @ECU_Address@FPrm_severity@0x024B3101@ */ ECIPP_ALIGNMENT_UBYTE 255 Compu_IDENTITY 0 255 PHYS_UNIT "Severity+Class" /end CHARACTERISTIC
/begin CHARACTERISTIC FPsvr_ADloss "FPrm_severity(67)" VALUE 0x00165E21 /* @ECU_Address@FPrm_severity@0x024B3043@ */ ECIPP_ALIGNMENT_UBYTE 255 Compu_IDENTITY 0 255 PHYS_UNIT "Severity+Class" /end CHARACTERISTIC
/begin CHARACTERISTIC FPsvr_AFILT_dP_high "FPrm_severity(562)" VALUE 0x00166010 /* @ECU_Address@FPrm_severity@0x024B3232@ */ ECIPP_ALIGNMENT_UBYTE 255 Compu_IDENTITY 0 255 PHYS_UNIT "Severity+Class" /end CHARACTERISTIC
/begin CHARACTERISTIC FPsvr_AL_hi "FPrm_severity(41)" VALUE 0x00165E07 /* @ECU_Address@FPrm_severity@0x024B3029@ */ ECIPP_ALIGNMENT_UBYTE 255 Compu_IDENTITY 0 255 PHYS_UNIT "Severity+Class" /end CHARACTERISTIC
/begin CHARACTERISTIC FPsvr_AL_lo "FPrm_severity(42)" VALUE 0x00165E08 /* @ECU_Address@FPrm_severity@0x024B302A@ */ ECIPP_ALIGNMENT_UBYTE 255 Compu_IDENTITY 0 255 PHYS_UNIT "Severity+Class" /end CHARACTERISTIC
/begin CHARACTERISTIC FPsvr_ALLP_hi "FPrm_severity(43)" VALUE 0x00165E09 /* @ECU_Address@FPrm_severity@0x024B302B@ */ ECIPP_ALIGNMENT_UBYTE 255 Compu_IDENTITY 0 255 PHYS_UNIT "Severity+Class" /end CHARACTERISTIC
/begin CHARACTERISTIC FPsvr_ALLP_lo "FPrm_severity(44)" VALUE 0x00165E0A /* @ECU_Address@FPrm_severity@0x024B302C@ */ ECIPP_ALIGNMENT_UBYTE 255 Compu_IDENTITY 0 255 PHYS_UNIT "Severity+Class" /end CHARACTERISTIC
/begin CHARACTERISTIC FPsvr_ALNG_hi "FPrm_severity(45)" VALUE 0x00165E0B /* @ECU_Address@FPrm_severity@0x024B302D@ */ ECIPP_ALIGNMENT_UBYTE 255 Compu_IDENTITY 0 255 PHYS_UNIT "Severity+Class" /end CHARACTERISTIC
/begin CHARACTERISTIC FPsvr_ALNG_lo "FPrm_severity(46)" VALUE 0x00165E0C /* @ECU_Address@FPrm_severity@0x024B302E@ */ ECIPP_ALIGNMENT_UBYTE 255 Compu_IDENTITY 0 255 PHYS_UNIT "Severity+Class" /end CHARACTERISTIC
/begin CHARACTERISTIC FPsvr_APD1_max "FPrm_severity(75)" VALUE 0x00165E29 /* @ECU_Address@FPrm_severity@0x024B304B@ */ ECIPP_ALIGNMENT_UBYTE 255 Compu_IDENTITY 0 255 PHYS_UNIT "Severity+Class" /end CHARACTERISTIC
/begin CHARACTERISTIC FPsvr_APD1_min "FPrm_severity(76)" VALUE 0x00165E2A /* @ECU_Address@FPrm_severity@0x024B304C@ */ ECIPP_ALIGNMENT_UBYTE 255 Compu_IDENTITY 0 255 PHYS_UNIT "Severity+Class" /end CHARACTERISTIC
/begin CHARACTERISTIC FPsvr_APD2_max "FPrm_severity(181)" VALUE 0x00165E93 /* @ECU_Address@FPrm_severity@0x024B30B5@ */ ECIPP_ALIGNMENT_UBYTE 255 Compu_IDENTITY 0 255 PHYS_UNIT "Severity+Class" /end CHARACTERISTIC
/begin CHARACTERISTIC FPsvr_APD2_min "FPrm_severity(182)" VALUE 0x00165E94 /* @ECU_Address@FPrm_severity@0x024B30B6@ */ ECIPP_ALIGNMENT_UBYTE 255 Compu_IDENTITY 0 255 PHYS_UNIT "Severity+Class" /end CHARACTERISTIC
/begin CHARACTERISTIC FPsvr_APD3_max "FPrm_severity(183)" VALUE 0x00165E95 /* @ECU_Address@FPrm_severity@0x024B30B7@ */ ECIPP_ALIGNMENT_UBYTE 255 Compu_IDENTITY 0 255 PHYS_UNIT "Severity+Class" /end CHARACTERISTIC
/begin CHARACTERISTIC FPsvr_APD3_min "FPrm_severity(184)" VALUE 0x00165E96 /* @ECU_Address@FPrm_severity@0x024B30B8@ */ ECIPP_ALIGNMENT_UBYTE 255 Compu_IDENTITY 0 255 PHYS_UNIT "Severity+Class" /end CHARACTERISTIC
/begin CHARACTERISTIC FPsvr_APS1_max "FPrm_severity(362)" VALUE 0x00165F48 /* @ECU_Address@FPrm_severity@0x024B316A@ */ ECIPP_ALIGNMENT_UBYTE 255 Compu_IDENTITY 0 255 PHYS_UNIT "Severity+Class" /end CHARACTERISTIC
/begin CHARACTERISTIC FPsvr_APS1_min "FPrm_severity(363)" VALUE 0x00165F49 /* @ECU_Address@FPrm_severity@0x024B316B@ */ ECIPP_ALIGNMENT_UBYTE 255 Compu_IDENTITY 0 255 PHYS_UNIT "Severity+Class" /end CHARACTERISTIC
/begin CHARACTERISTIC FPsvr_APS12_OOR "FPrm_severity(370)" VALUE 0x00165F50 /* @ECU_Address@FPrm_severity@0x024B3172@ */ ECIPP_ALIGNMENT_UBYTE 255 Compu_IDENTITY 0 255 PHYS_UNIT "Severity+Class" /end CHARACTERISTIC
/begin CHARACTERISTIC FPsvr_APS12pct_hi "FPrm_severity(366)" VALUE 0x00165F4C /* @ECU_Address@FPrm_severity@0x024B316E@ */ ECIPP_ALIGNMENT_UBYTE 255 Compu_IDENTITY 0 255 PHYS_UNIT "Severity+Class" /end CHARACTERISTIC
/begin CHARACTERISTIC FPsvr_APS12pct_lo "FPrm_severity(367)" VALUE 0x00165F4D /* @ECU_Address@FPrm_severity@0x024B316F@ */ ECIPP_ALIGNMENT_UBYTE 255 Compu_IDENTITY 0 255 PHYS_UNIT "Severity+Class" /end CHARACTERISTIC
/begin CHARACTERISTIC FPsvr_APS2_max "FPrm_severity(364)" VALUE 0x00165F4A /* @ECU_Address@FPrm_severity@0x024B316C@ */ ECIPP_ALIGNMENT_UBYTE 255 Compu_IDENTITY 0 255 PHYS_UNIT "Severity+Class" /end CHARACTERISTIC
/begin CHARACTERISTIC FPsvr_APS2_min "FPrm_severity(365)" VALUE 0x00165F4B /* @ECU_Address@FPrm_severity@0x024B316D@ */ ECIPP_ALIGNMENT_UBYTE 255 Compu_IDENTITY 0 255 PHYS_UNIT "Severity+Class" /end CHARACTERISTIC
/begin CHARACTERISTIC FPsvr_APSerr_neg "FPrm_severity(369)" VALUE 0x00165F4F /* @ECU_Address@FPrm_severity@0x024B3171@ */ ECIPP_ALIGNMENT_UBYTE 255 Compu_IDENTITY 0 255 PHYS_UNIT "Severity+Class" /end CHARACTERISTIC
/begin CHARACTERISTIC FPsvr_APSerr_pos "FPrm_severity(368)" VALUE 0x00165F4E /* @ECU_Address@FPrm_severity@0x024B3170@ */ ECIPP_ALIGNMENT_UBYTE 255 Compu_IDENTITY 0 255 PHYS_UNIT "Severity+Class" /end CHARACTERISTIC
/begin CHARACTERISTIC FPsvr_APU1_max "FPrm_severity(77)" VALUE 0x00165E2B /* @ECU_Address@FPrm_severity@0x024B304D@ */ ECIPP_ALIGNMENT_UBYTE 255 Compu_IDENTITY 0 255 PHYS_UNIT "Severity+Class" /end CHARACTERISTIC
/begin CHARACTERISTIC FPsvr_APU1_min "FPrm_severity(78)" VALUE 0x00165E2C /* @ECU_Address@FPrm_severity@0x024B304E@ */ ECIPP_ALIGNMENT_UBYTE 255 Compu_IDENTITY 0 255 PHYS_UNIT "Severity+Class" /end CHARACTERISTIC
/begin CHARACTERISTIC FPsvr_APU2_max "FPrm_severity(79)" VALUE 0x00165E2D /* @ECU_Address@FPrm_severity@0x024B304F@ */ ECIPP_ALIGNMENT_UBYTE 255 Compu_IDENTITY 0 255 PHYS_UNIT "Severity+Class" /end CHARACTERISTIC
/begin CHARACTERISTIC FPsvr_APU2_min "FPrm_severity(80)" VALUE 0x00165E2E /* @ECU_Address@FPrm_severity@0x024B3050@ */ ECIPP_ALIGNMENT_UBYTE 255 Compu_IDENTITY 0 255 PHYS_UNIT "Severity+Class" /end CHARACTERISTIC
/begin CHARACTERISTIC FPsvr_APU3_max "FPrm_severity(157)" VALUE 0x00165E7B /* @ECU_Address@FPrm_severity@0x024B309D@ */ ECIPP_ALIGNMENT_UBYTE 255 Compu_IDENTITY 0 255 PHYS_UNIT "Severity+Class" /end CHARACTERISTIC
/begin CHARACTERISTIC FPsvr_APU3_min "FPrm_severity(158)" VALUE 0x00165E7C /* @ECU_Address@FPrm_severity@0x024B309E@ */ ECIPP_ALIGNMENT_UBYTE 255 Compu_IDENTITY 0 255 PHYS_UNIT "Severity+Class" /end CHARACTERISTIC
/begin CHARACTERISTIC FPsvr_APUD1_max "FPrm_severity(159)" VALUE 0x00165E7D /* @ECU_Address@FPrm_severity@0x024B309F@ */ ECIPP_ALIGNMENT_UBYTE 255 Compu_IDENTITY 0 255 PHYS_UNIT "Severity+Class" /end CHARACTERISTIC
/begin CHARACTERISTIC FPsvr_APUD1_min "FPrm_severity(160)" VALUE 0x00165E7E /* @ECU_Address@FPrm_severity@0x024B30A0@ */ ECIPP_ALIGNMENT_UBYTE 255 Compu_IDENTITY 0 255 PHYS_UNIT "Severity+Class" /end CHARACTERISTIC
/begin CHARACTERISTIC FPsvr_APUD10_max "FPrm_severity(270)" VALUE 0x00165EEC /* @ECU_Address@FPrm_severity@0x024B310E@ */ ECIPP_ALIGNMENT_UBYTE 255 Compu_IDENTITY 0 255 PHYS_UNIT "Severity+Class" /end CHARACTERISTIC
/begin CHARACTERISTIC FPsvr_APUD10_min "FPrm_severity(271)" VALUE 0x00165EED /* @ECU_Address@FPrm_severity@0x024B310F@ */ ECIPP_ALIGNMENT_UBYTE 255 Compu_IDENTITY 0 255 PHYS_UNIT "Severity+Class" /end CHARACTERISTIC
/begin CHARACTERISTIC FPsvr_APUD11_max "FPrm_severity(272)" VALUE 0x00165EEE /* @ECU_Address@FPrm_severity@0x024B3110@ */ ECIPP_ALIGNMENT_UBYTE 255 Compu_IDENTITY 0 255 PHYS_UNIT "Severity+Class" /end CHARACTERISTIC
/begin CHARACTERISTIC FPsvr_APUD11_min "FPrm_severity(273)" VALUE 0x00165EEF /* @ECU_Address@FPrm_severity@0x024B3111@ */ ECIPP_ALIGNMENT_UBYTE 255 Compu_IDENTITY 0 255 PHYS_UNIT "Severity+Class" /end CHARACTERISTIC
/begin CHARACTERISTIC FPsvr_APUD12_max "FPrm_severity(274)" VALUE 0x00165EF0 /* @ECU_Address@FPrm_severity@0x024B3112@ */ ECIPP_ALIGNMENT_UBYTE 255 Compu_IDENTITY 0 255 PHYS_UNIT "Severity+Class" /end CHARACTERISTIC
/begin CHARACTERISTIC FPsw_ADIG15_min "FPrm_switches(307)" VALUE 0x00146B42 /* @ECU_Address@FPrm_switches@0x021B9266@ */ ECIPP_ALIGNMENT_UWORD 65535 Compu_IDENTITY 0 65535 PHYS_UNIT "Enable bits" /end CHARACTERISTIC
/begin CHARACTERISTIC FPsw_ADIG16_max "FPrm_switches(308)" VALUE 0x00146B44 /* @ECU_Address@FPrm_switches@0x021B9268@ */ ECIPP_ALIGNMENT_UWORD 65535 Compu_IDENTITY 0 65535 PHYS_UNIT "Enable bits" /end CHARACTERISTIC
/begin CHARACTERISTIC FPsw_ADIG16_min "FPrm_switches(309)" VALUE 0x00146B46 /* @ECU_Address@FPrm_switches@0x021B926A@ */ ECIPP_ALIGNMENT_UWORD 65535 Compu_IDENTITY 0 65535 PHYS_UNIT "Enable bits" /end CHARACTERISTIC
/begin CHARACTERISTIC FPsw_ADIG17_max "FPrm_switches(310)" VALUE 0x00146B48 /* @ECU_Address@FPrm_switches@0x021B926C@ */ ECIPP_ALIGNMENT_UWORD 65535 Compu_IDENTITY 0 65535 PHYS_UNIT "Enable bits" /end CHARACTERISTIC
/begin CHARACTERISTIC FPsw_ADIG17_min "FPrm_switches(311)" VALUE 0x00146B4A /* @ECU_Address@FPrm_switches@0x021B926E@ */ ECIPP_ALIGNMENT_UWORD 65535 Compu_IDENTITY 0 65535 PHYS_UNIT "Enable bits" /end CHARACTERISTIC
/begin CHARACTERISTIC FPsw_ADIG18_max "FPrm_switches(312)" VALUE 0x00146B4C /* @ECU_Address@FPrm_switches@0x021B9270@ */ ECIPP_ALIGNMENT_UWORD 65535 Compu_IDENTITY 0 65535 PHYS_UNIT "Enable bits" /end CHARACTERISTIC
/begin CHARACTERISTIC FPsw_ADIG18_min "FPrm_switches(313)" VALUE 0x00146B4E /* @ECU_Address@FPrm_switches@0x021B9272@ */ ECIPP_ALIGNMENT_UWORD 65535 Compu_IDENTITY 0 65535 PHYS_UNIT "Enable bits" /end CHARACTERISTIC
/begin CHARACTERISTIC FPsw_ADIG19_max "FPrm_switches(314)" VALUE 0x00146B50 /* @ECU_Address@FPrm_switches@0x021B9274@ */ ECIPP_ALIGNMENT_UWORD 65535 Compu_IDENTITY 0 65535 PHYS_UNIT "Enable bits" /end CHARACTERISTIC
/begin CHARACTERISTIC FPsw_ADIG19_min "FPrm_switches(315)" VALUE 0x00146B52 /* @ECU_Address@FPrm_switches@0x021B9276@ */ ECIPP_ALIGNMENT_UWORD 65535 Compu_IDENTITY 0 65535 PHYS_UNIT "Enable bits" /end CHARACTERISTIC
/begin CHARACTERISTIC FPsw_ADIG2_max "FPrm_switches(167)" VALUE 0x00146A2A /* @ECU_Address@FPrm_switches@0x021B914E@ */ ECIPP_ALIGNMENT_UWORD 65535 Compu_IDENTITY 0 65535 PHYS_UNIT "Enable bits" /end CHARACTERISTIC
/begin CHARACTERISTIC FPsw_ADIG2_min "FPrm_switches(168)" VALUE 0x00146A2C /* @ECU_Address@FPrm_switches@0x021B9150@ */ ECIPP_ALIGNMENT_UWORD 65535 Compu_IDENTITY 0 65535 PHYS_UNIT "Enable bits" /end CHARACTERISTIC
/begin CHARACTERISTIC FPsw_ADIG20_max "FPrm_switches(438)" VALUE 0x00146C48 /* @ECU_Address@FPrm_switches@0x021B936C@ */ ECIPP_ALIGNMENT_UWORD 65535 Compu_IDENTITY 0 65535 PHYS_UNIT "Enable bits" /end CHARACTERISTIC
/begin CHARACTERISTIC FPsw_ADIG20_min "FPrm_switches(439)" VALUE 0x00146C4A /* @ECU_Address@FPrm_switches@0x021B936E@ */ ECIPP_ALIGNMENT_UWORD 65535 Compu_IDENTITY 0 65535 PHYS_UNIT "Enable bits" /end CHARACTERISTIC
/begin CHARACTERISTIC FPsw_ADIG21_max "FPrm_switches(440)" VALUE 0x00146C4C /* @ECU_Address@FPrm_switches@0x021B9370@ */ ECIPP_ALIGNMENT_UWORD 65535 Compu_IDENTITY 0 65535 PHYS_UNIT "Enable bits" /end CHARACTERISTIC
/begin CHARACTERISTIC FPsw_ADIG21_min "FPrm_switches(441)" VALUE 0x00146C4E /* @ECU_Address@FPrm_switches@0x021B9372@ */ ECIPP_ALIGNMENT_UWORD 65535 Compu_IDENTITY 0 65535 PHYS_UNIT "Enable bits" /end CHARACTERISTIC
/begin CHARACTERISTIC FPsw_ADIG22_max "FPrm_switches(442)" VALUE 0x00146C50 /* @ECU_Address@FPrm_switches@0x021B9374@ */ ECIPP_ALIGNMENT_UWORD 65535 Compu_IDENTITY 0 65535 PHYS_UNIT "Enable bits" /end CHARACTERISTIC
/begin CHARACTERISTIC FPsw_ADIG22_min "FPrm_switches(443)" VALUE 0x00146C52 /* @ECU_Address@FPrm_switches@0x021B9376@ */ ECIPP_ALIGNMENT_UWORD 65535 Compu_IDENTITY 0 65535 PHYS_UNIT "Enable bits" /end CHARACTERISTIC
/begin CHARACTERISTIC FPsw_ADIG23_max "FPrm_switches(444)" VALUE 0x00146C54 /* @ECU_Address@FPrm_switches@0x021B9378@ */ ECIPP_ALIGNMENT_UWORD 65535 Compu_IDENTITY 0 65535 PHYS_UNIT "Enable bits" /end CHARACTERISTIC
/begin CHARACTERISTIC FPsw_ADIG23_min "FPrm_switches(445)" VALUE 0x00146C56 /* @ECU_Address@FPrm_switches@0x021B937A@ */ ECIPP_ALIGNMENT_UWORD 65535 Compu_IDENTITY 0 65535 PHYS_UNIT "Enable bits" /end CHARACTERISTIC
/begin CHARACTERISTIC FPsw_ADIG24_max "FPrm_switches(446)" VALUE 0x00146C58 /* @ECU_Address@FPrm_switches@0x021B937C@ */ ECIPP_ALIGNMENT_UWORD 65535 Compu_IDENTITY 0 65535 PHYS_UNIT "Enable bits" /end CHARACTERISTIC
/begin CHARACTERISTIC FPsw_ADIG24_min "FPrm_switches(447)" VALUE 0x00146C5A /* @ECU_Address@FPrm_switches@0x021B937E@ */ ECIPP_ALIGNMENT_UWORD 65535 Compu_IDENTITY 0 65535 PHYS_UNIT "Enable bits" /end CHARACTERISTIC
/begin CHARACTERISTIC FPsw_ADIG25_max "FPrm_switches(448)" VALUE 0x00146C5C /* @ECU_Address@FPrm_switches@0x021B9380@ */ ECIPP_ALIGNMENT_UWORD 65535 Compu_IDENTITY 0 65535 PHYS_UNIT "Enable bits" /end CHARACTERISTIC
/begin CHARACTERISTIC FPsw_ADIG25_min "FPrm_switches(449)" VALUE 0x00146C5E /* @ECU_Address@FPrm_switches@0x021B9382@ */ ECIPP_ALIGNMENT_UWORD 65535 Compu_IDENTITY 0 65535 PHYS_UNIT "Enable bits" /end CHARACTERISTIC
/begin CHARACTERISTIC FPsw_ADIG3_max "FPrm_switches(169)" VALUE 0x00146A2E /* @ECU_Address@FPrm_switches@0x021B9152@ */ ECIPP_ALIGNMENT_UWORD 65535 Compu_IDENTITY 0 65535 PHYS_UNIT "Enable bits" /end CHARACTERISTIC
/begin CHARACTERISTIC FPsw_ADIG3_min "FPrm_switches(170)" VALUE 0x00146A30 /* @ECU_Address@FPrm_switches@0x021B9154@ */ ECIPP_ALIGNMENT_UWORD 65535 Compu_IDENTITY 0 65535 PHYS_UNIT "Enable bits" /end CHARACTERISTIC
/begin CHARACTERISTIC FPsw_ADIG4_max "FPrm_switches(246)" VALUE 0x00146AC8 /* @ECU_Address@FPrm_switches@0x021B91EC@ */ ECIPP_ALIGNMENT_UWORD 65535 Compu_IDENTITY 0 65535 PHYS_UNIT "Enable bits" /end CHARACTERISTIC
/begin CHARACTERISTIC FPsw_ADIG4_min "FPrm_switches(247)" VALUE 0x00146ACA /* @ECU_Address@FPrm_switches@0x021B91EE@ */ ECIPP_ALIGNMENT_UWORD 65535 Compu_IDENTITY 0 65535 PHYS_UNIT "Enable bits" /end CHARACTERISTIC
/begin CHARACTERISTIC FPsw_ADIG5_max "FPrm_switches(248)" VALUE 0x00146ACC /* @ECU_Address@FPrm_switches@0x021B91F0@ */ ECIPP_ALIGNMENT_UWORD 65535 Compu_IDENTITY 0 65535 PHYS_UNIT "Enable bits" /end CHARACTERISTIC
/begin CHARACTERISTIC FPsw_ADIG5_min "FPrm_switches(249)" VALUE 0x00146ACE /* @ECU_Address@FPrm_switches@0x021B91F2@ */ ECIPP_ALIGNMENT_UWORD 65535 Compu_IDENTITY 0 65535 PHYS_UNIT "Enable bits" /end CHARACTERISTIC
/begin CHARACTERISTIC FPsw_ADIG6_max "FPrm_switches(250)" VALUE 0x00146AD0 /* @ECU_Address@FPrm_switches@0x021B91F4@ */ ECIPP_ALIGNMENT_UWORD 65535 Compu_IDENTITY 0 65535 PHYS_UNIT "Enable bits" /end CHARACTERISTIC
/begin CHARACTERISTIC FPsw_ADIG6_min "FPrm_switches(251)" VALUE 0x00146AD2 /* @ECU_Address@FPrm_switches@0x021B91F6@ */ ECIPP_ALIGNMENT_UWORD 65535 Compu_IDENTITY 0 65535 PHYS_UNIT "Enable bits" /end CHARACTERISTIC
/begin CHARACTERISTIC FPsw_ADIG7_max "FPrm_switches(252)" VALUE 0x00146AD4 /* @ECU_Address@FPrm_switches@0x021B91F8@ */ ECIPP_ALIGNMENT_UWORD 65535 Compu_IDENTITY 0 65535 PHYS_UNIT "Enable bits" /end CHARACTERISTIC
/begin CHARACTERISTIC FPsw_ADIG7_min "FPrm_switches(253)" VALUE 0x00146AD6 /* @ECU_Address@FPrm_switches@0x021B91FA@ */ ECIPP_ALIGNMENT_UWORD 65535 Compu_IDENTITY 0 65535 PHYS_UNIT "Enable bits" /end CHARACTERISTIC
/begin CHARACTERISTIC FPsw_ADIG8_max "FPrm_switches(254)" VALUE 0x00146AD8 /* @ECU_Address@FPrm_switches@0x021B91FC@ */ ECIPP_ALIGNMENT_UWORD 65535 Compu_IDENTITY 0 65535 PHYS_UNIT "Enable bits" /end CHARACTERISTIC
/begin CHARACTERISTIC FPsw_ADIG8_min "FPrm_switches(255)" VALUE 0x00146ADA /* @ECU_Address@FPrm_switches@0x021B91FE@ */ ECIPP_ALIGNMENT_UWORD 65535 Compu_IDENTITY 0 65535 PHYS_UNIT "Enable bits" /end CHARACTERISTIC
/begin CHARACTERISTIC FPsw_ADIG9_max "FPrm_switches(256)" VALUE 0x00146ADC /* @ECU_Address@FPrm_switches@0x021B9200@ */ ECIPP_ALIGNMENT_UWORD 65535 Compu_IDENTITY 0 65535 PHYS_UNIT "Enable bits" /end CHARACTERISTIC
/begin CHARACTERISTIC FPsw_ADIG9_min "FPrm_switches(257)" VALUE 0x00146ADE /* @ECU_Address@FPrm_switches@0x021B9202@ */ ECIPP_ALIGNMENT_UWORD 65535 Compu_IDENTITY 0 65535 PHYS_UNIT "Enable bits" /end CHARACTERISTIC
/begin CHARACTERISTIC FPsw_ADloss "FPrm_switches(67)" VALUE 0x00146962 /* @ECU_Address@FPrm_switches@0x021B9086@ */ ECIPP_ALIGNMENT_UWORD 65535 Compu_IDENTITY 0 65535 PHYS_UNIT "Enable bits" /end CHARACTERISTIC
/begin CHARACTERISTIC FPsw_AFILT_dP_high "FPrm_switches(562)" VALUE 0x00146D40 /* @ECU_Address@FPrm_switches@0x021B9464@ */ ECIPP_ALIGNMENT_UWORD 65535 Compu_IDENTITY 0 65535 PHYS_UNIT "Enable bits" /end CHARACTERISTIC
/begin CHARACTERISTIC FPsw_AL_hi "FPrm_switches(41)" VALUE 0x0014692E /* @ECU_Address@FPrm_switches@0x021B9052@ */ ECIPP_ALIGNMENT_UWORD 65535 Compu_IDENTITY 0 65535 PHYS_UNIT "Enable bits" /end CHARACTERISTIC
/begin CHARACTERISTIC FPsw_AL_lo "FPrm_switches(42)" VALUE 0x00146930 /* @ECU_Address@FPrm_switches@0x021B9054@ */ ECIPP_ALIGNMENT_UWORD 65535 Compu_IDENTITY 0 65535 PHYS_UNIT "Enable bits" /end CHARACTERISTIC
/begin CHARACTERISTIC FPsw_ALLP_hi "FPrm_switches(43)" VALUE 0x00146932 /* @ECU_Address@FPrm_switches@0x021B9056@ */ ECIPP_ALIGNMENT_UWORD 65535 Compu_IDENTITY 0 65535 PHYS_UNIT "Enable bits" /end CHARACTERISTIC
/begin CHARACTERISTIC FPsw_ALLP_lo "FPrm_switches(44)" VALUE 0x00146934 /* @ECU_Address@FPrm_switches@0x021B9058@ */ ECIPP_ALIGNMENT_UWORD 65535 Compu_IDENTITY 0 65535 PHYS_UNIT "Enable bits" /end CHARACTERISTIC
/begin CHARACTERISTIC FPsw_ALNG_hi "FPrm_switches(45)" VALUE 0x00146936 /* @ECU_Address@FPrm_switches@0x021B905A@ */ ECIPP_ALIGNMENT_UWORD 65535 Compu_IDENTITY 0 65535 PHYS_UNIT "Enable bits" /end CHARACTERISTIC
/begin CHARACTERISTIC FPsw_ALNG_lo "FPrm_switches(46)" VALUE 0x00146938 /* @ECU_Address@FPrm_switches@0x021B905C@ */ ECIPP_ALIGNMENT_UWORD 65535 Compu_IDENTITY 0 65535 PHYS_UNIT "Enable bits" /end CHARACTERISTIC
/begin CHARACTERISTIC FPsw_APD1_max "FPrm_switches(75)" VALUE 0x00146972 /* @ECU_Address@FPrm_switches@0x021B9096@ */ ECIPP_ALIGNMENT_UWORD 65535 Compu_IDENTITY 0 65535 PHYS_UNIT "Enable bits" /end CHARACTERISTIC
/begin CHARACTERISTIC FPsw_APD1_min "FPrm_switches(76)" VALUE 0x00146974 /* @ECU_Address@FPrm_switches@0x021B9098@ */ ECIPP_ALIGNMENT_UWORD 65535 Compu_IDENTITY 0 65535 PHYS_UNIT "Enable bits" /end CHARACTERISTIC
/begin CHARACTERISTIC FPsw_APD2_max "FPrm_switches(181)" VALUE 0x00146A46 /* @ECU_Address@FPrm_switches@0x021B916A@ */ ECIPP_ALIGNMENT_UWORD 65535 Compu_IDENTITY 0 65535 PHYS_UNIT "Enable bits" /end CHARACTERISTIC
/begin CHARACTERISTIC FPsw_APD2_min "FPrm_switches(182)" VALUE 0x00146A48 /* @ECU_Address@FPrm_switches@0x021B916C@ */ ECIPP_ALIGNMENT_UWORD 65535 Compu_IDENTITY 0 65535 PHYS_UNIT "Enable bits" /end CHARACTERISTIC
/begin CHARACTERISTIC FPsw_APD3_max "FPrm_switches(183)" VALUE 0x00146A4A /* @ECU_Address@FPrm_switches@0x021B916E@ */ ECIPP_ALIGNMENT_UWORD 65535 Compu_IDENTITY 0 65535 PHYS_UNIT "Enable bits" /end CHARACTERISTIC
/begin CHARACTERISTIC FPsw_APD3_min "FPrm_switches(184)" VALUE 0x00146A4C /* @ECU_Address@FPrm_switches@0x021B9170@ */ ECIPP_ALIGNMENT_UWORD 65535 Compu_IDENTITY 0 65535 PHYS_UNIT "Enable bits" /end CHARACTERISTIC
/begin CHARACTERISTIC FPsw_APS1_max "FPrm_switches(362)" VALUE 0x00146BB0 /* @ECU_Address@FPrm_switches@0x021B92D4@ */ ECIPP_ALIGNMENT_UWORD 65535 Compu_IDENTITY 0 65535 PHYS_UNIT "Enable bits" /end CHARACTERISTIC
/begin CHARACTERISTIC FPsw_APS1_min "FPrm_switches(363)" VALUE 0x00146BB2 /* @ECU_Address@FPrm_switches@0x021B92D6@ */ ECIPP_ALIGNMENT_UWORD 65535 Compu_IDENTITY 0 65535 PHYS_UNIT "Enable bits" /end CHARACTERISTIC
/begin CHARACTERISTIC FPsw_APS12_OOR "FPrm_switches(370)" VALUE 0x00146BC0 /* @ECU_Address@FPrm_switches@0x021B92E4@ */ ECIPP_ALIGNMENT_UWORD 65535 Compu_IDENTITY 0 65535 PHYS_UNIT "Enable bits" /end CHARACTERISTIC
/begin CHARACTERISTIC FPsw_APS12pct_hi "FPrm_switches(366)" VALUE 0x00146BB8 /* @ECU_Address@FPrm_switches@0x021B92DC@ */ ECIPP_ALIGNMENT_UWORD 65535 Compu_IDENTITY 0 65535 PHYS_UNIT "Enable bits" /end CHARACTERISTIC
/begin CHARACTERISTIC FPsw_APS12pct_lo "FPrm_switches(367)" VALUE 0x00146BBA /* @ECU_Address@FPrm_switches@0x021B92DE@ */ ECIPP_ALIGNMENT_UWORD 65535 Compu_IDENTITY 0 65535 PHYS_UNIT "Enable bits" /end CHARACTERISTIC
/begin CHARACTERISTIC FPsw_APS2_max "FPrm_switches(364)" VALUE 0x00146BB4 /* @ECU_Address@FPrm_switches@0x021B92D8@ */ ECIPP_ALIGNMENT_UWORD 65535 Compu_IDENTITY 0 65535 PHYS_UNIT "Enable bits" /end CHARACTERISTIC
/begin CHARACTERISTIC FPsw_APS2_min "FPrm_switches(365)" VALUE 0x00146BB6 /* @ECU_Address@FPrm_switches@0x021B92DA@ */ ECIPP_ALIGNMENT_UWORD 65535 Compu_IDENTITY 0 65535 PHYS_UNIT "Enable bits" /end CHARACTERISTIC
/begin CHARACTERISTIC FPsw_APSerr_neg "FPrm_switches(369)" VALUE 0x00146BBE /* @ECU_Address@FPrm_switches@0x021B92E2@ */ ECIPP_ALIGNMENT_UWORD 65535 Compu_IDENTITY 0 65535 PHYS_UNIT "Enable bits" /end CHARACTERISTIC
/begin CHARACTERISTIC FPsw_APSerr_pos "FPrm_switches(368)" VALUE 0x00146BBC /* @ECU_Address@FPrm_switches@0x021B92E0@ */ ECIPP_ALIGNMENT_UWORD 65535 Compu_IDENTITY 0 65535 PHYS_UNIT "Enable bits" /end CHARACTERISTIC
/begin CHARACTERISTIC FPsw_APU1_max "FPrm_switches(77)" VALUE 0x00146976 /* @ECU_Address@FPrm_switches@0x021B909A@ */ ECIPP_ALIGNMENT_UWORD 65535 Compu_IDENTITY 0 65535 PHYS_UNIT "Enable bits" /end CHARACTERISTIC
/begin CHARACTERISTIC FPsw_APU1_min "FPrm_switches(78)" VALUE 0x00146978 /* @ECU_Address@FPrm_switches@0x021B909C@ */ ECIPP_ALIGNMENT_UWORD 65535 Compu_IDENTITY 0 65535 PHYS_UNIT "Enable bits" /end CHARACTERISTIC
/begin CHARACTERISTIC FPsw_APU2_max "FPrm_switches(79)" VALUE 0x0014697A /* @ECU_Address@FPrm_switches@0x021B909E@ */ ECIPP_ALIGNMENT_UWORD 65535 Compu_IDENTITY 0 65535 PHYS_UNIT "Enable bits" /end CHARACTERISTIC
/begin CHARACTERISTIC FPsw_APU2_min "FPrm_switches(80)" VALUE 0x0014697C /* @ECU_Address@FPrm_switches@0x021B90A0@ */ ECIPP_ALIGNMENT_UWORD 65535 Compu_IDENTITY 0 65535 PHYS_UNIT "Enable bits" /end CHARACTERISTIC
/begin CHARACTERISTIC FPsw_APU3_max "FPrm_switches(157)" VALUE 0x00146A16 /* @ECU_Address@FPrm_switches@0x021B913A@ */ ECIPP_ALIGNMENT_UWORD 65535 Compu_IDENTITY 0 65535 PHYS_UNIT "Enable bits" /end CHARACTERISTIC
/begin CHARACTERISTIC FPsw_APU3_min "FPrm_switches(158)" VALUE 0x00146A18 /* @ECU_Address@FPrm_switches@0x021B913C@ */ ECIPP_ALIGNMENT_UWORD 65535 Compu_IDENTITY 0 65535 PHYS_UNIT "Enable bits" /end CHARACTERISTIC
/begin CHARACTERISTIC FPsw_APUD1_max "FPrm_switches(159)" VALUE 0x00146A1A /* @ECU_Address@FPrm_switches@0x021B913E@ */ ECIPP_ALIGNMENT_UWORD 65535 Compu_IDENTITY 0 65535 PHYS_UNIT "Enable bits" /end CHARACTERISTIC
/begin CHARACTERISTIC FPsw_APUD1_min "FPrm_switches(160)" VALUE 0x00146A1C /* @ECU_Address@FPrm_switches@0x021B9140@ */ ECIPP_ALIGNMENT_UWORD 65535 Compu_IDENTITY 0 65535 PHYS_UNIT "Enable bits" /end CHARACTERISTIC
/begin CHARACTERISTIC FPsw_APUD10_max "FPrm_switches(270)" VALUE 0x00146AF8 /* @ECU_Address@FPrm_switches@0x021B921C@ */ ECIPP_ALIGNMENT_UWORD 65535 Compu_IDENTITY 0 65535 PHYS_UNIT "Enable bits" /end CHARACTERISTIC
/begin CHARACTERISTIC FPsw_APUD10_min "FPrm_switches(271)" VALUE 0x00146AFA /* @ECU_Address@FPrm_switches@0x021B921E@ */ ECIPP_ALIGNMENT_UWORD 65535 Compu_IDENTITY 0 65535 PHYS_UNIT "Enable bits" /end CHARACTERISTIC
/begin CHARACTERISTIC FPsw_APUD11_max "FPrm_switches(272)" VALUE 0x00146AFC /* @ECU_Address@FPrm_switches@0x021B9220@ */ ECIPP_ALIGNMENT_UWORD 65535 Compu_IDENTITY 0 65535 PHYS_UNIT "Enable bits" /end CHARACTERISTIC
/begin CHARACTERISTIC FPsw_APUD11_min "FPrm_switches(273)" VALUE 0x00146AFE /* @ECU_Address@FPrm_switches@0x021B9222@ */ ECIPP_ALIGNMENT_UWORD 65535 Compu_IDENTITY 0 65535 PHYS_UNIT "Enable bits" /end CHARACTERISTIC
/begin CHARACTERISTIC FPsw_APUD12_max "FPrm_switches(274)" VALUE 0x00146B00 /* @ECU_Address@FPrm_switches@0x021B9224@ */ ECIPP_ALIGNMENT_UWORD 65535 Compu_IDENTITY 0 65535 PHYS_UNIT "Enable bits" /end CHARACTERISTIC
/begin CHARACTERISTIC FPsw_ext1_ADIG15_min "FPrm_switches_ext1(307)" VALUE 0x001470A4 /* @ECU_Address@FPrm_switches_ext1@0x023A5266@ */ ECIPP_ALIGNMENT_UWORD 65535 Compu_IDENTITY 0 65535 PHYS_UNIT "Enable bits" /end CHARACTERISTIC
/begin CHARACTERISTIC FPsw_ext1_ADIG16_max "FPrm_switches_ext1(308)" VALUE 0x001470A6 /* @ECU_Address@FPrm_switches_ext1@0x023A5268@ */ ECIPP_ALIGNMENT_UWORD 65535 Compu_IDENTITY 0 65535 PHYS_UNIT "Enable bits" /end CHARACTERISTIC
/begin CHARACTERISTIC FPsw_ext1_ADIG16_min "FPrm_switches_ext1(309)" VALUE 0x001470A8 /* @ECU_Address@FPrm_switches_ext1@0x023A526A@ */ ECIPP_ALIGNMENT_UWORD 65535 Compu_IDENTITY 0 65535 PHYS_UNIT "Enable bits" /end CHARACTERISTIC
/begin CHARACTERISTIC FPsw_ext1_ADIG17_max "FPrm_switches_ext1(310)" VALUE 0x001470AA /* @ECU_Address@FPrm_switches_ext1@0x023A526C@ */ ECIPP_ALIGNMENT_UWORD 65535 Compu_IDENTITY 0 65535 PHYS_UNIT "Enable bits" /end CHARACTERISTIC
/begin CHARACTERISTIC FPsw_ext1_ADIG17_min "FPrm_switches_ext1(311)" VALUE 0x001470AC /* @ECU_Address@FPrm_switches_ext1@0x023A526E@ */ ECIPP_ALIGNMENT_UWORD 65535 Compu_IDENTITY 0 65535 PHYS_UNIT "Enable bits" /end CHARACTERISTIC
/begin CHARACTERISTIC FPsw_ext1_ADIG18_max "FPrm_switches_ext1(312)" VALUE 0x001470AE /* @ECU_Address@FPrm_switches_ext1@0x023A5270@ */ ECIPP_ALIGNMENT_UWORD 65535 Compu_IDENTITY 0 65535 PHYS_UNIT "Enable bits" /end CHARACTERISTIC
/begin CHARACTERISTIC FPsw_ext1_ADIG18_min "FPrm_switches_ext1(313)" VALUE 0x001470B0 /* @ECU_Address@FPrm_switches_ext1@0x023A5272@ */ ECIPP_ALIGNMENT_UWORD 65535 Compu_IDENTITY 0 65535 PHYS_UNIT "Enable bits" /end CHARACTERISTIC
/begin CHARACTERISTIC FPsw_ext1_ADIG19_max "FPrm_switches_ext1(314)" VALUE 0x001470B2 /* @ECU_Address@FPrm_switches_ext1@0x023A5274@ */ ECIPP_ALIGNMENT_UWORD 65535 Compu_IDENTITY 0 65535 PHYS_UNIT "Enable bits" /end CHARACTERISTIC
/begin CHARACTERISTIC FPsw_ext1_ADIG19_min "FPrm_switches_ext1(315)" VALUE 0x001470B4 /* @ECU_Address@FPrm_switches_ext1@0x023A5276@ */ ECIPP_ALIGNMENT_UWORD 65535 Compu_IDENTITY 0 65535 PHYS_UNIT "Enable bits" /end CHARACTERISTIC
/begin CHARACTERISTIC FPsw_ext1_ADIG2_max "FPrm_switches_ext1(167)" VALUE 0x00146F8C /* @ECU_Address@FPrm_switches_ext1@0x023A514E@ */ ECIPP_ALIGNMENT_UWORD 65535 Compu_IDENTITY 0 65535 PHYS_UNIT "Enable bits" /end CHARACTERISTIC
/begin CHARACTERISTIC FPsw_ext1_ADIG2_min "FPrm_switches_ext1(168)" VALUE 0x00146F8E /* @ECU_Address@FPrm_switches_ext1@0x023A5150@ */ ECIPP_ALIGNMENT_UWORD 65535 Compu_IDENTITY 0 65535 PHYS_UNIT "Enable bits" /end CHARACTERISTIC
/begin CHARACTERISTIC FPsw_ext1_ADIG20_max "FPrm_switches_ext1(438)" VALUE 0x001471AA /* @ECU_Address@FPrm_switches_ext1@0x023A536C@ */ ECIPP_ALIGNMENT_UWORD 65535 Compu_IDENTITY 0 65535 PHYS_UNIT "Enable bits" /end CHARACTERISTIC
/begin CHARACTERISTIC FPsw_ext1_ADIG20_min "FPrm_switches_ext1(439)" VALUE 0x001471AC /* @ECU_Address@FPrm_switches_ext1@0x023A536E@ */ ECIPP_ALIGNMENT_UWORD 65535 Compu_IDENTITY 0 65535 PHYS_UNIT "Enable bits" /end CHARACTERISTIC
/begin CHARACTERISTIC FPsw_ext1_ADIG21_max "FPrm_switches_ext1(440)" VALUE 0x001471AE /* @ECU_Address@FPrm_switches_ext1@0x023A5370@ */ ECIPP_ALIGNMENT_UWORD 65535 Compu_IDENTITY 0 65535 PHYS_UNIT "Enable bits" /end CHARACTERISTIC
/begin CHARACTERISTIC FPsw_ext1_ADIG21_min "FPrm_switches_ext1(441)" VALUE 0x001471B0 /* @ECU_Address@FPrm_switches_ext1@0x023A5372@ */ ECIPP_ALIGNMENT_UWORD 65535 Compu_IDENTITY 0 65535 PHYS_UNIT "Enable bits" /end CHARACTERISTIC
/begin CHARACTERISTIC FPsw_ext1_ADIG22_max "FPrm_switches_ext1(442)" VALUE 0x001471B2 /* @ECU_Address@FPrm_switches_ext1@0x023A5374@ */ ECIPP_ALIGNMENT_UWORD 65535 Compu_IDENTITY 0 65535 PHYS_UNIT "Enable bits" /end CHARACTERISTIC
/begin CHARACTERISTIC FPsw_ext1_ADIG22_min "FPrm_switches_ext1(443)" VALUE 0x001471B4 /* @ECU_Address@FPrm_switches_ext1@0x023A5376@ */ ECIPP_ALIGNMENT_UWORD 65535 Compu_IDENTITY 0 65535 PHYS_UNIT "Enable bits" /end CHARACTERISTIC
/begin CHARACTERISTIC FPsw_ext1_ADIG23_max "FPrm_switches_ext1(444)" VALUE 0x001471B6 /* @ECU_Address@FPrm_switches_ext1@0x023A5378@ */ ECIPP_ALIGNMENT_UWORD 65535 Compu_IDENTITY 0 65535 PHYS_UNIT "Enable bits" /end CHARACTERISTIC
/begin CHARACTERISTIC FPsw_ext1_ADIG23_min "FPrm_switches_ext1(445)" VALUE 0x001471B8 /* @ECU_Address@FPrm_switches_ext1@0x023A537A@ */ ECIPP_ALIGNMENT_UWORD 65535 Compu_IDENTITY 0 65535 PHYS_UNIT "Enable bits" /end CHARACTERISTIC
/begin CHARACTERISTIC FPsw_ext1_ADIG24_max "FPrm_switches_ext1(446)" VALUE 0x001471BA /* @ECU_Address@FPrm_switches_ext1@0x023A537C@ */ ECIPP_ALIGNMENT_UWORD 65535 Compu_IDENTITY 0 65535 PHYS_UNIT "Enable bits" /end CHARACTERISTIC
/begin CHARACTERISTIC FPsw_ext1_ADIG24_min "FPrm_switches_ext1(447)" VALUE 0x001471BC /* @ECU_Address@FPrm_switches_ext1@0x023A537E@ */ ECIPP_ALIGNMENT_UWORD 65535 Compu_IDENTITY 0 65535 PHYS_UNIT "Enable bits" /end CHARACTERISTIC
/begin CHARACTERISTIC FPsw_ext1_ADIG25_max "FPrm_switches_ext1(448)" VALUE 0x001471BE /* @ECU_Address@FPrm_switches_ext1@0x023A5380@ */ ECIPP_ALIGNMENT_UWORD 65535 Compu_IDENTITY 0 65535 PHYS_UNIT "Enable bits" /end CHARACTERISTIC
/begin CHARACTERISTIC FPsw_ext1_ADIG25_min "FPrm_switches_ext1(449)" VALUE 0x001471C0 /* @ECU_Address@FPrm_switches_ext1@0x023A5382@ */ ECIPP_ALIGNMENT_UWORD 65535 Compu_IDENTITY 0 65535 PHYS_UNIT "Enable bits" /end CHARACTERISTIC
/begin CHARACTERISTIC FPsw_ext1_ADIG3_max "FPrm_switches_ext1(169)" VALUE 0x00146F90 /* @ECU_Address@FPrm_switches_ext1@0x023A5152@ */ ECIPP_ALIGNMENT_UWORD 65535 Compu_IDENTITY 0 65535 PHYS_UNIT "Enable bits" /end CHARACTERISTIC
/begin CHARACTERISTIC FPsw_ext1_ADIG3_min "FPrm_switches_ext1(170)" VALUE 0x00146F92 /* @ECU_Address@FPrm_switches_ext1@0x023A5154@ */ ECIPP_ALIGNMENT_UWORD 65535 Compu_IDENTITY 0 65535 PHYS_UNIT "Enable bits" /end CHARACTERISTIC
/begin CHARACTERISTIC FPsw_ext1_ADIG4_max "FPrm_switches_ext1(246)" VALUE 0x0014702A /* @ECU_Address@FPrm_switches_ext1@0x023A51EC@ */ ECIPP_ALIGNMENT_UWORD 65535 Compu_IDENTITY 0 65535 PHYS_UNIT "Enable bits" /end CHARACTERISTIC
/begin CHARACTERISTIC FPsw_ext1_ADIG4_min "FPrm_switches_ext1(247)" VALUE 0x0014702C /* @ECU_Address@FPrm_switches_ext1@0x023A51EE@ */ ECIPP_ALIGNMENT_UWORD 65535 Compu_IDENTITY 0 65535 PHYS_UNIT "Enable bits" /end CHARACTERISTIC
/begin CHARACTERISTIC FPsw_ext1_ADIG5_max "FPrm_switches_ext1(248)" VALUE 0x0014702E /* @ECU_Address@FPrm_switches_ext1@0x023A51F0@ */ ECIPP_ALIGNMENT_UWORD 65535 Compu_IDENTITY 0 65535 PHYS_UNIT "Enable bits" /end CHARACTERISTIC
/begin CHARACTERISTIC FPsw_ext1_ADIG5_min "FPrm_switches_ext1(249)" VALUE 0x00147030 /* @ECU_Address@FPrm_switches_ext1@0x023A51F2@ */ ECIPP_ALIGNMENT_UWORD 65535 Compu_IDENTITY 0 65535 PHYS_UNIT "Enable bits" /end CHARACTERISTIC
/begin CHARACTERISTIC FPsw_ext1_ADIG6_max "FPrm_switches_ext1(250)" VALUE 0x00147032 /* @ECU_Address@FPrm_switches_ext1@0x023A51F4@ */ ECIPP_ALIGNMENT_UWORD 65535 Compu_IDENTITY 0 65535 PHYS_UNIT "Enable bits" /end CHARACTERISTIC
/begin CHARACTERISTIC FPsw_ext1_ADIG6_min "FPrm_switches_ext1(251)" VALUE 0x00147034 /* @ECU_Address@FPrm_switches_ext1@0x023A51F6@ */ ECIPP_ALIGNMENT_UWORD 65535 Compu_IDENTITY 0 65535 PHYS_UNIT "Enable bits" /end CHARACTERISTIC
/begin CHARACTERISTIC FPsw_ext1_ADIG7_max "FPrm_switches_ext1(252)" VALUE 0x00147036 /* @ECU_Address@FPrm_switches_ext1@0x023A51F8@ */ ECIPP_ALIGNMENT_UWORD 65535 Compu_IDENTITY 0 65535 PHYS_UNIT "Enable bits" /end CHARACTERISTIC
/begin CHARACTERISTIC FPsw_ext1_ADIG7_min "FPrm_switches_ext1(253)" VALUE 0x00147038 /* @ECU_Address@FPrm_switches_ext1@0x023A51FA@ */ ECIPP_ALIGNMENT_UWORD 65535 Compu_IDENTITY 0 65535 PHYS_UNIT "Enable bits" /end CHARACTERISTIC
/begin CHARACTERISTIC FPsw_ext1_ADIG8_max "FPrm_switches_ext1(254)" VALUE 0x0014703A /* @ECU_Address@FPrm_switches_ext1@0x023A51FC@ */ ECIPP_ALIGNMENT_UWORD 65535 Compu_IDENTITY 0 65535 PHYS_UNIT "Enable bits" /end CHARACTERISTIC
/begin CHARACTERISTIC FPsw_ext1_ADIG8_min "FPrm_switches_ext1(255)" VALUE 0x0014703C /* @ECU_Address@FPrm_switches_ext1@0x023A51FE@ */ ECIPP_ALIGNMENT_UWORD 65535 Compu_IDENTITY 0 65535 PHYS_UNIT "Enable bits" /end CHARACTERISTIC
/begin CHARACTERISTIC FPsw_ext1_ADIG9_max "FPrm_switches_ext1(256)" VALUE 0x0014703E /* @ECU_Address@FPrm_switches_ext1@0x023A5200@ */ ECIPP_ALIGNMENT_UWORD 65535 Compu_IDENTITY 0 65535 PHYS_UNIT "Enable bits" /end CHARACTERISTIC
/begin CHARACTERISTIC FPsw_ext1_ADIG9_min "FPrm_switches_ext1(257)" VALUE 0x00147040 /* @ECU_Address@FPrm_switches_ext1@0x023A5202@ */ ECIPP_ALIGNMENT_UWORD 65535 Compu_IDENTITY 0 65535 PHYS_UNIT "Enable bits" /end CHARACTERISTIC
/begin CHARACTERISTIC FPsw_ext1_ADloss "FPrm_switches_ext1(67)" VALUE 0x00146EC4 /* @ECU_Address@FPrm_switches_ext1@0x023A5086@ */ ECIPP_ALIGNMENT_UWORD 65535 Compu_IDENTITY 0 65535 PHYS_UNIT "Enable bits" /end CHARACTERISTIC
/begin CHARACTERISTIC FPsw_ext1_AFILT_dP_high "FPrm_switches_ext1(562)" VALUE 0x001472A2 /* @ECU_Address@FPrm_switches_ext1@0x023A5464@ */ ECIPP_ALIGNMENT_UWORD 65535 Compu_IDENTITY 0 65535 PHYS_UNIT "Enable bits" /end CHARACTERISTIC
/begin CHARACTERISTIC FPsw_ext1_AL_hi "FPrm_switches_ext1(41)" VALUE 0x00146E90 /* @ECU_Address@FPrm_switches_ext1@0x023A5052@ */ ECIPP_ALIGNMENT_UWORD 65535 Compu_IDENTITY 0 65535 PHYS_UNIT "Enable bits" /end CHARACTERISTIC
/begin CHARACTERISTIC FPsw_ext1_AL_lo "FPrm_switches_ext1(42)" VALUE 0x00146E92 /* @ECU_Address@FPrm_switches_ext1@0x023A5054@ */ ECIPP_ALIGNMENT_UWORD 65535 Compu_IDENTITY 0 65535 PHYS_UNIT "Enable bits" /end CHARACTERISTIC
/begin CHARACTERISTIC FPsw_ext1_ALLP_hi "FPrm_switches_ext1(43)" VALUE 0x00146E94 /* @ECU_Address@FPrm_switches_ext1@0x023A5056@ */ ECIPP_ALIGNMENT_UWORD 65535 Compu_IDENTITY 0 65535 PHYS_UNIT "Enable bits" /end CHARACTERISTIC
/begin CHARACTERISTIC FPsw_ext1_ALLP_lo "FPrm_switches_ext1(44)" VALUE 0x00146E96 /* @ECU_Address@FPrm_switches_ext1@0x023A5058@ */ ECIPP_ALIGNMENT_UWORD 65535 Compu_IDENTITY 0 65535 PHYS_UNIT "Enable bits" /end CHARACTERISTIC
/begin CHARACTERISTIC FPsw_ext1_ALNG_hi "FPrm_switches_ext1(45)" VALUE 0x00146E98 /* @ECU_Address@FPrm_switches_ext1@0x023A505A@ */ ECIPP_ALIGNMENT_UWORD 65535 Compu_IDENTITY 0 65535 PHYS_UNIT "Enable bits" /end CHARACTERISTIC
/begin CHARACTERISTIC FPsw_ext1_ALNG_lo "FPrm_switches_ext1(46)" VALUE 0x00146E9A /* @ECU_Address@FPrm_switches_ext1@0x023A505C@ */ ECIPP_ALIGNMENT_UWORD 65535 Compu_IDENTITY 0 65535 PHYS_UNIT "Enable bits" /end CHARACTERISTIC
/begin CHARACTERISTIC FPsw_ext1_APD1_max "FPrm_switches_ext1(75)" VALUE 0x00146ED4 /* @ECU_Address@FPrm_switches_ext1@0x023A5096@ */ ECIPP_ALIGNMENT_UWORD 65535 Compu_IDENTITY 0 65535 PHYS_UNIT "Enable bits" /end CHARACTERISTIC
/begin CHARACTERISTIC FPsw_ext1_APD1_min "FPrm_switches_ext1(76)" VALUE 0x00146ED6 /* @ECU_Address@FPrm_switches_ext1@0x023A5098@ */ ECIPP_ALIGNMENT_UWORD 65535 Compu_IDENTITY 0 65535 PHYS_UNIT "Enable bits" /end CHARACTERISTIC
/begin CHARACTERISTIC FPsw_ext1_APD2_max "FPrm_switches_ext1(181)" VALUE 0x00146FA8 /* @ECU_Address@FPrm_switches_ext1@0x023A516A@ */ ECIPP_ALIGNMENT_UWORD 65535 Compu_IDENTITY 0 65535 PHYS_UNIT "Enable bits" /end CHARACTERISTIC
/begin CHARACTERISTIC FPsw_ext1_APD2_min "FPrm_switches_ext1(182)" VALUE 0x00146FAA /* @ECU_Address@FPrm_switches_ext1@0x023A516C@ */ ECIPP_ALIGNMENT_UWORD 65535 Compu_IDENTITY 0 65535 PHYS_UNIT "Enable bits" /end CHARACTERISTIC
/begin CHARACTERISTIC FPsw_ext1_APD3_max "FPrm_switches_ext1(183)" VALUE 0x00146FAC /* @ECU_Address@FPrm_switches_ext1@0x023A516E@ */ ECIPP_ALIGNMENT_UWORD 65535 Compu_IDENTITY 0 65535 PHYS_UNIT "Enable bits" /end CHARACTERISTIC
/begin CHARACTERISTIC FPsw_ext1_APD3_min "FPrm_switches_ext1(184)" VALUE 0x00146FAE /* @ECU_Address@FPrm_switches_ext1@0x023A5170@ */ ECIPP_ALIGNMENT_UWORD 65535 Compu_IDENTITY 0 65535 PHYS_UNIT "Enable bits" /end CHARACTERISTIC
/begin CHARACTERISTIC FPsw_ext1_APS1_max "FPrm_switches_ext1(362)" VALUE 0x00147112 /* @ECU_Address@FPrm_switches_ext1@0x023A52D4@ */ ECIPP_ALIGNMENT_UWORD 65535 Compu_IDENTITY 0 65535 PHYS_UNIT "Enable bits" /end CHARACTERISTIC
/begin CHARACTERISTIC FPsw_ext1_APS1_min "FPrm_switches_ext1(363)" VALUE 0x00147114 /* @ECU_Address@FPrm_switches_ext1@0x023A52D6@ */ ECIPP_ALIGNMENT_UWORD 65535 Compu_IDENTITY 0 65535 PHYS_UNIT "Enable bits" /end CHARACTERISTIC
/begin CHARACTERISTIC FPsw_ext1_APS12_OOR "FPrm_switches_ext1(370)" VALUE 0x00147122 /* @ECU_Address@FPrm_switches_ext1@0x023A52E4@ */ ECIPP_ALIGNMENT_UWORD 65535 Compu_IDENTITY 0 65535 PHYS_UNIT "Enable bits" /end CHARACTERISTIC
/begin CHARACTERISTIC FPsw_ext1_APS12pct_hi "FPrm_switches_ext1(366)" VALUE 0x0014711A /* @ECU_Address@FPrm_switches_ext1@0x023A52DC@ */ ECIPP_ALIGNMENT_UWORD 65535 Compu_IDENTITY 0 65535 PHYS_UNIT "Enable bits" /end CHARACTERISTIC
/begin CHARACTERISTIC FPsw_ext1_APS12pct_lo "FPrm_switches_ext1(367)" VALUE 0x0014711C /* @ECU_Address@FPrm_switches_ext1@0x023A52DE@ */ ECIPP_ALIGNMENT_UWORD 65535 Compu_IDENTITY 0 65535 PHYS_UNIT "Enable bits" /end CHARACTERISTIC
/begin CHARACTERISTIC FPsw_ext1_APS2_max "FPrm_switches_ext1(364)" VALUE 0x00147116 /* @ECU_Address@FPrm_switches_ext1@0x023A52D8@ */ ECIPP_ALIGNMENT_UWORD 65535 Compu_IDENTITY 0 65535 PHYS_UNIT "Enable bits" /end CHARACTERISTIC
/begin CHARACTERISTIC FPsw_ext1_APS2_min "FPrm_switches_ext1(365)" VALUE 0x00147118 /* @ECU_Address@FPrm_switches_ext1@0x023A52DA@ */ ECIPP_ALIGNMENT_UWORD 65535 Compu_IDENTITY 0 65535 PHYS_UNIT "Enable bits" /end CHARACTERISTIC
/begin CHARACTERISTIC FPsw_ext1_APSerr_neg "FPrm_switches_ext1(369)" VALUE 0x00147120 /* @ECU_Address@FPrm_switches_ext1@0x023A52E2@ */ ECIPP_ALIGNMENT_UWORD 65535 Compu_IDENTITY 0 65535 PHYS_UNIT "Enable bits" /end CHARACTERISTIC
/begin CHARACTERISTIC FPsw_ext1_APSerr_pos "FPrm_switches_ext1(368)" VALUE 0x0014711E /* @ECU_Address@FPrm_switches_ext1@0x023A52E0@ */ ECIPP_ALIGNMENT_UWORD 65535 Compu_IDENTITY 0 65535 PHYS_UNIT "Enable bits" /end CHARACTERISTIC
/begin CHARACTERISTIC FPsw_ext1_APU1_max "FPrm_switches_ext1(77)" VALUE 0x00146ED8 /* @ECU_Address@FPrm_switches_ext1@0x023A509A@ */ ECIPP_ALIGNMENT_UWORD 65535 Compu_IDENTITY 0 65535 PHYS_UNIT "Enable bits" /end CHARACTERISTIC
/begin CHARACTERISTIC FPsw_ext1_APU1_min "FPrm_switches_ext1(78)" VALUE 0x00146EDA /* @ECU_Address@FPrm_switches_ext1@0x023A509C@ */ ECIPP_ALIGNMENT_UWORD 65535 Compu_IDENTITY 0 65535 PHYS_UNIT "Enable bits" /end CHARACTERISTIC
/begin CHARACTERISTIC FPsw_ext1_APU2_max "FPrm_switches_ext1(79)" VALUE 0x00146EDC /* @ECU_Address@FPrm_switches_ext1@0x023A509E@ */ ECIPP_ALIGNMENT_UWORD 65535 Compu_IDENTITY 0 65535 PHYS_UNIT "Enable bits" /end CHARACTERISTIC
/begin CHARACTERISTIC FPsw_ext1_APU2_min "FPrm_switches_ext1(80)" VALUE 0x00146EDE /* @ECU_Address@FPrm_switches_ext1@0x023A50A0@ */ ECIPP_ALIGNMENT_UWORD 65535 Compu_IDENTITY 0 65535 PHYS_UNIT "Enable bits" /end CHARACTERISTIC
/begin CHARACTERISTIC FPsw_ext1_APU3_max "FPrm_switches_ext1(157)" VALUE 0x00146F78 /* @ECU_Address@FPrm_switches_ext1@0x023A513A@ */ ECIPP_ALIGNMENT_UWORD 65535 Compu_IDENTITY 0 65535 PHYS_UNIT "Enable bits" /end CHARACTERISTIC
/begin CHARACTERISTIC FPsw_ext1_APU3_min "FPrm_switches_ext1(158)" VALUE 0x00146F7A /* @ECU_Address@FPrm_switches_ext1@0x023A513C@ */ ECIPP_ALIGNMENT_UWORD 65535 Compu_IDENTITY 0 65535 PHYS_UNIT "Enable bits" /end CHARACTERISTIC
/begin CHARACTERISTIC FPsw_ext1_APUD1_max "FPrm_switches_ext1(159)" VALUE 0x00146F7C /* @ECU_Address@FPrm_switches_ext1@0x023A513E@ */ ECIPP_ALIGNMENT_UWORD 65535 Compu_IDENTITY 0 65535 PHYS_UNIT "Enable bits" /end CHARACTERISTIC
/begin CHARACTERISTIC FPsw_ext1_APUD1_min "FPrm_switches_ext1(160)" VALUE 0x00146F7E /* @ECU_Address@FPrm_switches_ext1@0x023A5140@ */ ECIPP_ALIGNMENT_UWORD 65535 Compu_IDENTITY 0 65535 PHYS_UNIT "Enable bits" /end CHARACTERISTIC
/begin CHARACTERISTIC FPsw_ext1_APUD10_max "FPrm_switches_ext1(270)" VALUE 0x0014705A /* @ECU_Address@FPrm_switches_ext1@0x023A521C@ */ ECIPP_ALIGNMENT_UWORD 65535 Compu_IDENTITY 0 65535 PHYS_UNIT "Enable bits" /end CHARACTERISTIC
/begin CHARACTERISTIC FPsw_ext1_APUD10_min "FPrm_switches_ext1(271)" VALUE 0x0014705C /* @ECU_Address@FPrm_switches_ext1@0x023A521E@ */ ECIPP_ALIGNMENT_UWORD 65535 Compu_IDENTITY 0 65535 PHYS_UNIT "Enable bits" /end CHARACTERISTIC
/begin CHARACTERISTIC FPsw_ext1_APUD11_max "FPrm_switches_ext1(272)" VALUE 0x0014705E /* @ECU_Address@FPrm_switches_ext1@0x023A5220@ */ ECIPP_ALIGNMENT_UWORD 65535 Compu_IDENTITY 0 65535 PHYS_UNIT "Enable bits" /end CHARACTERISTIC
/begin CHARACTERISTIC FPsw_ext1_APUD11_min "FPrm_switches_ext1(273)" VALUE 0x00147060 /* @ECU_Address@FPrm_switches_ext1@0x023A5222@ */ ECIPP_ALIGNMENT_UWORD 65535 Compu_IDENTITY 0 65535 PHYS_UNIT "Enable bits" /end CHARACTERISTIC
/begin CHARACTERISTIC FPsw_ext1_APUD12_max "FPrm_switches_ext1(274)" VALUE 0x00147062 /* @ECU_Address@FPrm_switches_ext1@0x023A5224@ */ ECIPP_ALIGNMENT_UWORD 65535 Compu_IDENTITY 0 65535 PHYS_UNIT "Enable bits" /end CHARACTERISTIC
/begin CHARACTERISTIC FCdtc_ADIG15_min "FCtl_DTC(398)" VALUE 0x00163830 /* @ECU_Address@FCtl_DTC@0x021B531C@ */ ECIPP_ALIGNMENT_UWORD 65535 Compu_IDENTITY 0 65535 PHYS_UNIT "DTC" /end CHARACTERISTIC
/begin CHARACTERISTIC FCdtc_ADIG16_max "FCtl_DTC(399)" VALUE 0x00163832 /* @ECU_Address@FCtl_DTC@0x021B531E@ */ ECIPP_ALIGNMENT_UWORD 65535 Compu_IDENTITY 0 65535 PHYS_UNIT "DTC" /end CHARACTERISTIC
/begin CHARACTERISTIC FCdtc_ADIG16_min "FCtl_DTC(400)" VALUE 0x00163834 /* @ECU_Address@FCtl_DTC@0x021B5320@ */ ECIPP_ALIGNMENT_UWORD 65535 Compu_IDENTITY 0 65535 PHYS_UNIT "DTC" /end CHARACTERISTIC
/begin CHARACTERISTIC FCdtc_ADIG17_max "FCtl_DTC(401)" VALUE 0x00163836 /* @ECU_Address@FCtl_DTC@0x021B5322@ */ ECIPP_ALIGNMENT_UWORD 65535 Compu_IDENTITY 0 65535 PHYS_UNIT "DTC" /end CHARACTERISTIC
/begin CHARACTERISTIC FCdtc_ADIG17_min "FCtl_DTC(402)" VALUE 0x00163838 /* @ECU_Address@FCtl_DTC@0x021B5324@ */ ECIPP_ALIGNMENT_UWORD 65535 Compu_IDENTITY 0 65535 PHYS_UNIT "DTC" /end CHARACTERISTIC
/begin CHARACTERISTIC FCdtc_ADIG18_max "FCtl_DTC(403)" VALUE 0x0016383A /* @ECU_Address@FCtl_DTC@0x021B5326@ */ ECIPP_ALIGNMENT_UWORD 65535 Compu_IDENTITY 0 65535 PHYS_UNIT "DTC" /end CHARACTERISTIC
/begin CHARACTERISTIC FCdtc_ADIG18_min "FCtl_DTC(404)" VALUE 0x0016383C /* @ECU_Address@FCtl_DTC@0x021B5328@ */ ECIPP_ALIGNMENT_UWORD 65535 Compu_IDENTITY 0 65535 PHYS_UNIT "DTC" /end CHARACTERISTIC
/begin CHARACTERISTIC FCdtc_ADIG19_max "FCtl_DTC(405)" VALUE 0x0016383E /* @ECU_Address@FCtl_DTC@0x021B532A@ */ ECIPP_ALIGNMENT_UWORD 65535 Compu_IDENTITY 0 65535 PHYS_UNIT "DTC" /end CHARACTERISTIC
/begin CHARACTERISTIC FCdtc_ADIG19_min "FCtl_DTC(406)" VALUE 0x00163840 /* @ECU_Address@FCtl_DTC@0x021B532C@ */ ECIPP_ALIGNMENT_UWORD 65535 Compu_IDENTITY 0 65535 PHYS_UNIT "DTC" /end CHARACTERISTIC
/begin CHARACTERISTIC FCdtc_ADIG2_max "FCtl_DTC(211)" VALUE 0x001636BA /* @ECU_Address@FCtl_DTC@0x021B51A6@ */ ECIPP_ALIGNMENT_UWORD 65535 Compu_IDENTITY 0 65535 PHYS_UNIT "DTC" /end CHARACTERISTIC
/begin CHARACTERISTIC FCdtc_ADIG2_min "FCtl_DTC(212)" VALUE 0x001636BC /* @ECU_Address@FCtl_DTC@0x021B51A8@ */ ECIPP_ALIGNMENT_UWORD 65535 Compu_IDENTITY 0 65535 PHYS_UNIT "DTC" /end CHARACTERISTIC
/begin CHARACTERISTIC FCdtc_ADIG20_max "FCtl_DTC(584)" VALUE 0x001639A4 /* @ECU_Address@FCtl_DTC@0x021B5490@ */ ECIPP_ALIGNMENT_UWORD 65535 Compu_IDENTITY 0 65535 PHYS_UNIT "DTC" /end CHARACTERISTIC
/begin CHARACTERISTIC FCdtc_ADIG20_min "FCtl_DTC(585)" VALUE 0x001639A6 /* @ECU_Address@FCtl_DTC@0x021B5492@ */ ECIPP_ALIGNMENT_UWORD 65535 Compu_IDENTITY 0 65535 PHYS_UNIT "DTC" /end CHARACTERISTIC
/begin CHARACTERISTIC FCdtc_ADIG21_max "FCtl_DTC(586)" VALUE 0x001639A8 /* @ECU_Address@FCtl_DTC@0x021B5494@ */ ECIPP_ALIGNMENT_UWORD 65535 Compu_IDENTITY 0 65535 PHYS_UNIT "DTC" /end CHARACTERISTIC
/begin CHARACTERISTIC FCdtc_ADIG21_min "FCtl_DTC(587)" VALUE 0x001639AA /* @ECU_Address@FCtl_DTC@0x021B5496@ */ ECIPP_ALIGNMENT_UWORD 65535 Compu_IDENTITY 0 65535 PHYS_UNIT "DTC" /end CHARACTERISTIC
/begin CHARACTERISTIC FCdtc_ADIG22_max "FCtl_DTC(588)" VALUE 0x001639AC /* @ECU_Address@FCtl_DTC@0x021B5498@ */ ECIPP_ALIGNMENT_UWORD 65535 Compu_IDENTITY 0 65535 PHYS_UNIT "DTC" /end CHARACTERISTIC
/begin CHARACTERISTIC FCdtc_ADIG22_min "FCtl_DTC(589)" VALUE 0x001639AE /* @ECU_Address@FCtl_DTC@0x021B549A@ */ ECIPP_ALIGNMENT_UWORD 65535 Compu_IDENTITY 0 65535 PHYS_UNIT "DTC" /end CHARACTERISTIC
/begin CHARACTERISTIC FCdtc_ADIG23_max "FCtl_DTC(590)" VALUE 0x001639B0 /* @ECU_Address@FCtl_DTC@0x021B549C@ */ ECIPP_ALIGNMENT_UWORD 65535 Compu_IDENTITY 0 65535 PHYS_UNIT "DTC" /end CHARACTERISTIC
/begin CHARACTERISTIC FCdtc_ADIG23_min "FCtl_DTC(591)" VALUE 0x001639B2 /* @ECU_Address@FCtl_DTC@0x021B549E@ */ ECIPP_ALIGNMENT_UWORD 65535 Compu_IDENTITY 0 65535 PHYS_UNIT "DTC" /end CHARACTERISTIC
/begin CHARACTERISTIC FCdtc_ADIG24_max "FCtl_DTC(592)" VALUE 0x001639B4 /* @ECU_Address@FCtl_DTC@0x021B54A0@ */ ECIPP_ALIGNMENT_UWORD 65535 Compu_IDENTITY 0 65535 PHYS_UNIT "DTC" /end CHARACTERISTIC
/begin CHARACTERISTIC FCdtc_ADIG24_min "FCtl_DTC(593)" VALUE 0x001639B6 /* @ECU_Address@FCtl_DTC@0x021B54A2@ */ ECIPP_ALIGNMENT_UWORD 65535 Compu_IDENTITY 0 65535 PHYS_UNIT "DTC" /end CHARACTERISTIC
/begin CHARACTERISTIC FCdtc_ADIG25_max "FCtl_DTC(594)" VALUE 0x001639B8 /* @ECU_Address@FCtl_DTC@0x021B54A4@ */ ECIPP_ALIGNMENT_UWORD 65535 Compu_IDENTITY 0 65535 PHYS_UNIT "DTC" /end CHARACTERISTIC
/begin CHARACTERISTIC FCdtc_ADIG25_min "FCtl_DTC(595)" VALUE 0x001639BA /* @ECU_Address@FCtl_DTC@0x021B54A6@ */ ECIPP_ALIGNMENT_UWORD 65535 Compu_IDENTITY 0 65535 PHYS_UNIT "DTC" /end CHARACTERISTIC
/begin CHARACTERISTIC FCdtc_ADIG3_max "FCtl_DTC(213)" VALUE 0x001636BE /* @ECU_Address@FCtl_DTC@0x021B51AA@ */ ECIPP_ALIGNMENT_UWORD 65535 Compu_IDENTITY 0 65535 PHYS_UNIT "DTC" /end CHARACTERISTIC
/begin CHARACTERISTIC FCdtc_ADIG3_min "FCtl_DTC(214)" VALUE 0x001636C0 /* @ECU_Address@FCtl_DTC@0x021B51AC@ */ ECIPP_ALIGNMENT_UWORD 65535 Compu_IDENTITY 0 65535 PHYS_UNIT "DTC" /end CHARACTERISTIC
/begin CHARACTERISTIC FCdtc_ADIG4_max "FCtl_DTC(337)" VALUE 0x001637B6 /* @ECU_Address@FCtl_DTC@0x021B52A2@ */ ECIPP_ALIGNMENT_UWORD 65535 Compu_IDENTITY 0 65535 PHYS_UNIT "DTC" /end CHARACTERISTIC
/begin CHARACTERISTIC FCdtc_ADIG4_min "FCtl_DTC(338)" VALUE 0x001637B8 /* @ECU_Address@FCtl_DTC@0x021B52A4@ */ ECIPP_ALIGNMENT_UWORD 65535 Compu_IDENTITY 0 65535 PHYS_UNIT "DTC" /end CHARACTERISTIC
/begin CHARACTERISTIC FCdtc_ADIG5_max "FCtl_DTC(339)" VALUE 0x001637BA /* @ECU_Address@FCtl_DTC@0x021B52A6@ */ ECIPP_ALIGNMENT_UWORD 65535 Compu_IDENTITY 0 65535 PHYS_UNIT "DTC" /end CHARACTERISTIC
/begin CHARACTERISTIC FCdtc_ADIG5_min "FCtl_DTC(340)" VALUE 0x001637BC /* @ECU_Address@FCtl_DTC@0x021B52A8@ */ ECIPP_ALIGNMENT_UWORD 65535 Compu_IDENTITY 0 65535 PHYS_UNIT "DTC" /end CHARACTERISTIC
/begin CHARACTERISTIC FCdtc_ADIG6_max "FCtl_DTC(341)" VALUE 0x001637BE /* @ECU_Address@FCtl_DTC@0x021B52AA@ */ ECIPP_ALIGNMENT_UWORD 65535 Compu_IDENTITY 0 65535 PHYS_UNIT "DTC" /end CHARACTERISTIC
/begin CHARACTERISTIC FCdtc_ADIG6_min "FCtl_DTC(342)" VALUE 0x001637C0 /* @ECU_Address@FCtl_DTC@0x021B52AC@ */ ECIPP_ALIGNMENT_UWORD 65535 Compu_IDENTITY 0 65535 PHYS_UNIT "DTC" /end CHARACTERISTIC
/begin CHARACTERISTIC FCdtc_ADIG7_max "FCtl_DTC(343)" VALUE 0x001637C2 /* @ECU_Address@FCtl_DTC@0x021B52AE@ */ ECIPP_ALIGNMENT_UWORD 65535 Compu_IDENTITY 0 65535 PHYS_UNIT "DTC" /end CHARACTERISTIC
/begin CHARACTERISTIC FCdtc_ADIG7_min "FCtl_DTC(344)" VALUE 0x001637C4 /* @ECU_Address@FCtl_DTC@0x021B52B0@ */ ECIPP_ALIGNMENT_UWORD 65535 Compu_IDENTITY 0 65535 PHYS_UNIT "DTC" /end CHARACTERISTIC
/begin CHARACTERISTIC FCdtc_ADIG8_max "FCtl_DTC(345)" VALUE 0x001637C6 /* @ECU_Address@FCtl_DTC@0x021B52B2@ */ ECIPP_ALIGNMENT_UWORD 65535 Compu_IDENTITY 0 65535 PHYS_UNIT "DTC" /end CHARACTERISTIC
/begin CHARACTERISTIC FCdtc_ADIG8_min "FCtl_DTC(346)" VALUE 0x001637C8 /* @ECU_Address@FCtl_DTC@0x021B52B4@ */ ECIPP_ALIGNMENT_UWORD 65535 Compu_IDENTITY 0 65535 PHYS_UNIT "DTC" /end CHARACTERISTIC
/begin CHARACTERISTIC FCdtc_ADIG9_max "FCtl_DTC(347)" VALUE 0x001637CA /* @ECU_Address@FCtl_DTC@0x021B52B6@ */ ECIPP_ALIGNMENT_UWORD 65535 Compu_IDENTITY 0 65535 PHYS_UNIT "DTC" /end CHARACTERISTIC
/begin CHARACTERISTIC FCdtc_ADIG9_min "FCtl_DTC(348)" VALUE 0x001637CC /* @ECU_Address@FCtl_DTC@0x021B52B8@ */ ECIPP_ALIGNMENT_UWORD 65535 Compu_IDENTITY 0 65535 PHYS_UNIT "DTC" /end CHARACTERISTIC
/begin CHARACTERISTIC FCdtc_ADloss "FCtl_DTC(103)" VALUE 0x001635E2 /* @ECU_Address@FCtl_DTC@0x021B50CE@ */ ECIPP_ALIGNMENT_UWORD 65535 Compu_IDENTITY 0 65535 PHYS_UNIT "DTC" /end CHARACTERISTIC
/begin CHARACTERISTIC FCdtc_AFILT_dP_high "FCtl_DTC(732)" VALUE 0x00163ACC /* @ECU_Address@FCtl_DTC@0x021B55B8@ */ ECIPP_ALIGNMENT_UWORD 65535 Compu_IDENTITY 0 65535 PHYS_UNIT "DTC" /end CHARACTERISTIC
/begin CHARACTERISTIC FCdtc_AL_hi "FCtl_DTC(30)" VALUE 0x00163550 /* @ECU_Address@FCtl_DTC@0x021B503C@ */ ECIPP_ALIGNMENT_UWORD 65535 Compu_IDENTITY 0 65535 PHYS_UNIT "DTC" /end CHARACTERISTIC
/begin CHARACTERISTIC FCdtc_AL_lo "FCtl_DTC(31)" VALUE 0x00163552 /* @ECU_Address@FCtl_DTC@0x021B503E@ */ ECIPP_ALIGNMENT_UWORD 65535 Compu_IDENTITY 0 65535 PHYS_UNIT "DTC" /end CHARACTERISTIC
/begin CHARACTERISTIC FCdtc_ALLP_hi "FCtl_DTC(42)" VALUE 0x00163568 /* @ECU_Address@FCtl_DTC@0x021B5054@ */ ECIPP_ALIGNMENT_UWORD 65535 Compu_IDENTITY 0 65535 PHYS_UNIT "DTC" /end CHARACTERISTIC
/begin CHARACTERISTIC FCdtc_ALLP_lo "FCtl_DTC(43)" VALUE 0x0016356A /* @ECU_Address@FCtl_DTC@0x021B5056@ */ ECIPP_ALIGNMENT_UWORD 65535 Compu_IDENTITY 0 65535 PHYS_UNIT "DTC" /end CHARACTERISTIC
/begin CHARACTERISTIC FCdtc_ALNG_hi "FCtl_DTC(44)" VALUE 0x0016356C /* @ECU_Address@FCtl_DTC@0x021B5058@ */ ECIPP_ALIGNMENT_UWORD 65535 Compu_IDENTITY 0 65535 PHYS_UNIT "DTC" /end CHARACTERISTIC
/begin CHARACTERISTIC FCdtc_ALNG_lo "FCtl_DTC(45)" VALUE 0x0016356E /* @ECU_Address@FCtl_DTC@0x021B505A@ */ ECIPP_ALIGNMENT_UWORD 65535 Compu_IDENTITY 0 65535 PHYS_UNIT "DTC" /end CHARACTERISTIC
/begin CHARACTERISTIC FCdtc_APD1_max "FCtl_DTC(116)" VALUE 0x001635FC /* @ECU_Address@FCtl_DTC@0x021B50E8@ */ ECIPP_ALIGNMENT_UWORD 65535 Compu_IDENTITY 0 65535 PHYS_UNIT "DTC" /end CHARACTERISTIC
/begin CHARACTERISTIC FCdtc_APD1_min "FCtl_DTC(117)" VALUE 0x001635FE /* @ECU_Address@FCtl_DTC@0x021B50EA@ */ ECIPP_ALIGNMENT_UWORD 65535 Compu_IDENTITY 0 65535 PHYS_UNIT "DTC" /end CHARACTERISTIC
/begin CHARACTERISTIC FCdtc_APD2_max "FCtl_DTC(229)" VALUE 0x001636DE /* @ECU_Address@FCtl_DTC@0x021B51CA@ */ ECIPP_ALIGNMENT_UWORD 65535 Compu_IDENTITY 0 65535 PHYS_UNIT "DTC" /end CHARACTERISTIC
/begin CHARACTERISTIC FCdtc_APD2_min "FCtl_DTC(230)" VALUE 0x001636E0 /* @ECU_Address@FCtl_DTC@0x021B51CC@ */ ECIPP_ALIGNMENT_UWORD 65535 Compu_IDENTITY 0 65535 PHYS_UNIT "DTC" /end CHARACTERISTIC
/begin CHARACTERISTIC FCdtc_APD3_max "FCtl_DTC(231)" VALUE 0x001636E2 /* @ECU_Address@FCtl_DTC@0x021B51CE@ */ ECIPP_ALIGNMENT_UWORD 65535 Compu_IDENTITY 0 65535 PHYS_UNIT "DTC" /end CHARACTERISTIC
/begin CHARACTERISTIC FCdtc_APD3_min "FCtl_DTC(232)" VALUE 0x001636E4 /* @ECU_Address@FCtl_DTC@0x021B51D0@ */ ECIPP_ALIGNMENT_UWORD 65535 Compu_IDENTITY 0 65535 PHYS_UNIT "DTC" /end CHARACTERISTIC
/begin CHARACTERISTIC FCdtc_APS1_max "FCtl_DTC(465)" VALUE 0x001638B6 /* @ECU_Address@FCtl_DTC@0x021B53A2@ */ ECIPP_ALIGNMENT_UWORD 65535 Compu_IDENTITY 0 65535 PHYS_UNIT "DTC" /end CHARACTERISTIC
/begin CHARACTERISTIC FCdtc_APS1_min "FCtl_DTC(466)" VALUE 0x001638B8 /* @ECU_Address@FCtl_DTC@0x021B53A4@ */ ECIPP_ALIGNMENT_UWORD 65535 Compu_IDENTITY 0 65535 PHYS_UNIT "DTC" /end CHARACTERISTIC
/begin CHARACTERISTIC FCdtc_APS12_OOR "FCtl_DTC(473)" VALUE 0x001638C6 /* @ECU_Address@FCtl_DTC@0x021B53B2@ */ ECIPP_ALIGNMENT_UWORD 65535 Compu_IDENTITY 0 65535 PHYS_UNIT "DTC" /end CHARACTERISTIC
/begin CHARACTERISTIC FCdtc_APS12pct_hi "FCtl_DTC(469)" VALUE 0x001638BE /* @ECU_Address@FCtl_DTC@0x021B53AA@ */ ECIPP_ALIGNMENT_UWORD 65535 Compu_IDENTITY 0 65535 PHYS_UNIT "DTC" /end CHARACTERISTIC
/begin CHARACTERISTIC FCdtc_APS12pct_lo "FCtl_DTC(470)" VALUE 0x001638C0 /* @ECU_Address@FCtl_DTC@0x021B53AC@ */ ECIPP_ALIGNMENT_UWORD 65535 Compu_IDENTITY 0 65535 PHYS_UNIT "DTC" /end CHARACTERISTIC
/begin CHARACTERISTIC FCdtc_APS2_max "FCtl_DTC(467)" VALUE 0x001638BA /* @ECU_Address@FCtl_DTC@0x021B53A6@ */ ECIPP_ALIGNMENT_UWORD 65535 Compu_IDENTITY 0 65535 PHYS_UNIT "DTC" /end CHARACTERISTIC
/begin CHARACTERISTIC FCdtc_APS2_min "FCtl_DTC(468)" VALUE 0x001638BC /* @ECU_Address@FCtl_DTC@0x021B53A8@ */ ECIPP_ALIGNMENT_UWORD 65535 Compu_IDENTITY 0 65535 PHYS_UNIT "DTC" /end CHARACTERISTIC
/begin CHARACTERISTIC FCdtc_APSerr_neg "FCtl_DTC(472)" VALUE 0x001638C4 /* @ECU_Address@FCtl_DTC@0x021B53B0@ */ ECIPP_ALIGNMENT_UWORD 65535 Compu_IDENTITY 0 65535 PHYS_UNIT "DTC" /end CHARACTERISTIC
/begin CHARACTERISTIC FCdtc_APSerr_pos "FCtl_DTC(471)" VALUE 0x001638C2 /* @ECU_Address@FCtl_DTC@0x021B53AE@ */ ECIPP_ALIGNMENT_UWORD 65535 Compu_IDENTITY 0 65535 PHYS_UNIT "DTC" /end CHARACTERISTIC
/begin CHARACTERISTIC FCdtc_APU1_max "FCtl_DTC(118)" VALUE 0x00163600 /* @ECU_Address@FCtl_DTC@0x021B50EC@ */ ECIPP_ALIGNMENT_UWORD 65535 Compu_IDENTITY 0 65535 PHYS_UNIT "DTC" /end CHARACTERISTIC
/begin CHARACTERISTIC FCdtc_APU1_min "FCtl_DTC(119)" VALUE 0x00163602 /* @ECU_Address@FCtl_DTC@0x021B50EE@ */ ECIPP_ALIGNMENT_UWORD 65535 Compu_IDENTITY 0 65535 PHYS_UNIT "DTC" /end CHARACTERISTIC
/begin CHARACTERISTIC FCdtc_APU2_max "FCtl_DTC(120)" VALUE 0x00163604 /* @ECU_Address@FCtl_DTC@0x021B50F0@ */ ECIPP_ALIGNMENT_UWORD 65535 Compu_IDENTITY 0 65535 PHYS_UNIT "DTC" /end CHARACTERISTIC
/begin CHARACTERISTIC FCdtc_APU2_min "FCtl_DTC(121)" VALUE 0x00163606 /* @ECU_Address@FCtl_DTC@0x021B50F2@ */ ECIPP_ALIGNMENT_UWORD 65535 Compu_IDENTITY 0 65535 PHYS_UNIT "DTC" /end CHARACTERISTIC
/begin CHARACTERISTIC FCdtc_APU3_max "FCtl_DTC(201)" VALUE 0x001636A6 /* @ECU_Address@FCtl_DTC@0x021B5192@ */ ECIPP_ALIGNMENT_UWORD 65535 Compu_IDENTITY 0 65535 PHYS_UNIT "DTC" /end CHARACTERISTIC
/begin CHARACTERISTIC FCdtc_APU3_min "FCtl_DTC(202)" VALUE 0x001636A8 /* @ECU_Address@FCtl_DTC@0x021B5194@ */ ECIPP_ALIGNMENT_UWORD 65535 Compu_IDENTITY 0 65535 PHYS_UNIT "DTC" /end CHARACTERISTIC
/begin CHARACTERISTIC FCdtc_APUD1_max "FCtl_DTC(203)" VALUE 0x001636AA /* @ECU_Address@FCtl_DTC@0x021B5196@ */ ECIPP_ALIGNMENT_UWORD 65535 Compu_IDENTITY 0 65535 PHYS_UNIT "DTC" /end CHARACTERISTIC
/begin CHARACTERISTIC FCdtc_APUD1_min "FCtl_DTC(204)" VALUE 0x001636AC /* @ECU_Address@FCtl_DTC@0x021B5198@ */ ECIPP_ALIGNMENT_UWORD 65535 Compu_IDENTITY 0 65535 PHYS_UNIT "DTC" /end CHARACTERISTIC
/begin CHARACTERISTIC FCdtc_APUD10_max "FCtl_DTC(361)" VALUE 0x001637E6 /* @ECU_Address@FCtl_DTC@0x021B52D2@ */ ECIPP_ALIGNMENT_UWORD 65535 Compu_IDENTITY 0 65535 PHYS_UNIT "DTC" /end CHARACTERISTIC
/begin CHARACTERISTIC FCdtc_APUD10_min "FCtl_DTC(362)" VALUE 0x001637E8 /* @ECU_Address@FCtl_DTC@0x021B52D4@ */ ECIPP_ALIGNMENT_UWORD 65535 Compu_IDENTITY 0 65535 PHYS_UNIT "DTC" /end CHARACTERISTIC
/begin CHARACTERISTIC FCdtc_APUD11_max "FCtl_DTC(363)" VALUE 0x001637EA /* @ECU_Address@FCtl_DTC@0x021B52D6@ */ ECIPP_ALIGNMENT_UWORD 65535 Compu_IDENTITY 0 65535 PHYS_UNIT "DTC" /end CHARACTERISTIC
/begin CHARACTERISTIC FCdtc_APUD11_min "FCtl_DTC(364)" VALUE 0x001637EC /* @ECU_Address@FCtl_DTC@0x021B52D8@ */ ECIPP_ALIGNMENT_UWORD 65535 Compu_IDENTITY 0 65535 PHYS_UNIT "DTC" /end CHARACTERISTIC
/begin CHARACTERISTIC FCdtc_APUD12_max "FCtl_DTC(365)" VALUE 0x001637EE /* @ECU_Address@FCtl_DTC@0x021B52DA@ */ ECIPP_ALIGNMENT_UWORD 65535 Compu_IDENTITY 0 65535 PHYS_UNIT "DTC" /end CHARACTERISTIC
/begin CHARACTERISTIC FCfmi_ADIG15_min "FCtl_FMI(398)" VALUE 0x001652A1 /* @ECU_Address@FCtl_FMI@0x021B718E@ */ ECIPP_ALIGNMENT_UBYTE 255 Compu_IDENTITY 0 255 PHYS_UNIT "FMI" /end CHARACTERISTIC
/begin CHARACTERISTIC FCfmi_ADIG16_max "FCtl_FMI(399)" VALUE 0x001652A2 /* @ECU_Address@FCtl_FMI@0x021B718F@ */ ECIPP_ALIGNMENT_UBYTE 255 Compu_IDENTITY 0 255 PHYS_UNIT "FMI" /end CHARACTERISTIC
/begin CHARACTERISTIC FCfmi_ADIG16_min "FCtl_FMI(400)" VALUE 0x001652A3 /* @ECU_Address@FCtl_FMI@0x021B7190@ */ ECIPP_ALIGNMENT_UBYTE 255 Compu_IDENTITY 0 255 PHYS_UNIT "FMI" /end CHARACTERISTIC
/begin CHARACTERISTIC FCfmi_ADIG17_max "FCtl_FMI(401)" VALUE 0x001652A4 /* @ECU_Address@FCtl_FMI@0x021B7191@ */ ECIPP_ALIGNMENT_UBYTE 255 Compu_IDENTITY 0 255 PHYS_UNIT "FMI" /end CHARACTERISTIC
/begin CHARACTERISTIC FCfmi_ADIG17_min "FCtl_FMI(402)" VALUE 0x001652A5 /* @ECU_Address@FCtl_FMI@0x021B7192@ */ ECIPP_ALIGNMENT_UBYTE 255 Compu_IDENTITY 0 255 PHYS_UNIT "FMI" /end CHARACTERISTIC
/begin CHARACTERISTIC FCfmi_ADIG18_max "FCtl_FMI(403)" VALUE 0x001652A6 /* @ECU_Address@FCtl_FMI@0x021B7193@ */ ECIPP_ALIGNMENT_UBYTE 255 Compu_IDENTITY 0 255 PHYS_UNIT "FMI" /end CHARACTERISTIC
/begin CHARACTERISTIC FCfmi_ADIG18_min "FCtl_FMI(404)" VALUE 0x001652A7 /* @ECU_Address@FCtl_FMI@0x021B7194@ */ ECIPP_ALIGNMENT_UBYTE 255 Compu_IDENTITY 0 255 PHYS_UNIT "FMI" /end CHARACTERISTIC
/begin CHARACTERISTIC FCfmi_ADIG19_max "FCtl_FMI(405)" VALUE 0x001652A8 /* @ECU_Address@FCtl_FMI@0x021B7195@ */ ECIPP_ALIGNMENT_UBYTE 255 Compu_IDENTITY 0 255 PHYS_UNIT "FMI" /end CHARACTERISTIC
/begin CHARACTERISTIC FCfmi_ADIG19_min "FCtl_FMI(406)" VALUE 0x001652A9 /* @ECU_Address@FCtl_FMI@0x021B7196@ */ ECIPP_ALIGNMENT_UBYTE 255 Compu_IDENTITY 0 255 PHYS_UNIT "FMI" /end CHARACTERISTIC
/begin CHARACTERISTIC FCfmi_ADIG2_max "FCtl_FMI(211)" VALUE 0x001651E6 /* @ECU_Address@FCtl_FMI@0x021B70D3@ */ ECIPP_ALIGNMENT_UBYTE 255 Compu_IDENTITY 0 255 PHYS_UNIT "FMI" /end CHARACTERISTIC
/begin CHARACTERISTIC FCfmi_ADIG2_min "FCtl_FMI(212)" VALUE 0x001651E7 /* @ECU_Address@FCtl_FMI@0x021B70D4@ */ ECIPP_ALIGNMENT_UBYTE 255 Compu_IDENTITY 0 255 PHYS_UNIT "FMI" /end CHARACTERISTIC
/begin CHARACTERISTIC FCfmi_ADIG20_max "FCtl_FMI(584)" VALUE 0x0016535B /* @ECU_Address@FCtl_FMI@0x021B7248@ */ ECIPP_ALIGNMENT_UBYTE 255 Compu_IDENTITY 0 255 PHYS_UNIT "FMI" /end CHARACTERISTIC
/begin CHARACTERISTIC FCfmi_ADIG20_min "FCtl_FMI(585)" VALUE 0x0016535C /* @ECU_Address@FCtl_FMI@0x021B7249@ */ ECIPP_ALIGNMENT_UBYTE 255 Compu_IDENTITY 0 255 PHYS_UNIT "FMI" /end CHARACTERISTIC
/begin CHARACTERISTIC FCfmi_ADIG21_max "FCtl_FMI(586)" VALUE 0x0016535D /* @ECU_Address@FCtl_FMI@0x021B724A@ */ ECIPP_ALIGNMENT_UBYTE 255 Compu_IDENTITY 0 255 PHYS_UNIT "FMI" /end CHARACTERISTIC
/begin CHARACTERISTIC FCfmi_ADIG21_min "FCtl_FMI(587)" VALUE 0x0016535E /* @ECU_Address@FCtl_FMI@0x021B724B@ */ ECIPP_ALIGNMENT_UBYTE 255 Compu_IDENTITY 0 255 PHYS_UNIT "FMI" /end CHARACTERISTIC
/begin CHARACTERISTIC FCfmi_ADIG22_max "FCtl_FMI(588)" VALUE 0x0016535F /* @ECU_Address@FCtl_FMI@0x021B724C@ */ ECIPP_ALIGNMENT_UBYTE 255 Compu_IDENTITY 0 255 PHYS_UNIT "FMI" /end CHARACTERISTIC
/begin CHARACTERISTIC FCfmi_ADIG22_min "FCtl_FMI(589)" VALUE 0x00165360 /* @ECU_Address@FCtl_FMI@0x021B724D@ */ ECIPP_ALIGNMENT_UBYTE 255 Compu_IDENTITY 0 255 PHYS_UNIT "FMI" /end CHARACTERISTIC
/begin CHARACTERISTIC FCfmi_ADIG23_max "FCtl_FMI(590)" VALUE 0x00165361 /* @ECU_Address@FCtl_FMI@0x021B724E@ */ ECIPP_ALIGNMENT_UBYTE 255 Compu_IDENTITY 0 255 PHYS_UNIT "FMI" /end CHARACTERISTIC
/begin CHARACTERISTIC FCfmi_ADIG23_min "FCtl_FMI(591)" VALUE 0x00165362 /* @ECU_Address@FCtl_FMI@0x021B724F@ */ ECIPP_ALIGNMENT_UBYTE 255 Compu_IDENTITY 0 255 PHYS_UNIT "FMI" /end CHARACTERISTIC
/begin CHARACTERISTIC FCfmi_ADIG24_max "FCtl_FMI(592)" VALUE 0x00165363 /* @ECU_Address@FCtl_FMI@0x021B7250@ */ ECIPP_ALIGNMENT_UBYTE 255 Compu_IDENTITY 0 255 PHYS_UNIT "FMI" /end CHARACTERISTIC
/begin CHARACTERISTIC FCfmi_ADIG24_min "FCtl_FMI(593)" VALUE 0x00165364 /* @ECU_Address@FCtl_FMI@0x021B7251@ */ ECIPP_ALIGNMENT_UBYTE 255 Compu_IDENTITY 0 255 PHYS_UNIT "FMI" /end CHARACTERISTIC
/begin CHARACTERISTIC FCfmi_ADIG25_max "FCtl_FMI(594)" VALUE 0x00165365 /* @ECU_Address@FCtl_FMI@0x021B7252@ */ ECIPP_ALIGNMENT_UBYTE 255 Compu_IDENTITY 0 255 PHYS_UNIT "FMI" /end CHARACTERISTIC
/begin CHARACTERISTIC FCfmi_ADIG25_min "FCtl_FMI(595)" VALUE 0x00165366 /* @ECU_Address@FCtl_FMI@0x021B7253@ */ ECIPP_ALIGNMENT_UBYTE 255 Compu_IDENTITY 0 255 PHYS_UNIT "FMI" /end CHARACTERISTIC
/begin CHARACTERISTIC FCfmi_ADIG3_max "FCtl_FMI(213)" VALUE 0x001651E8 /* @ECU_Address@FCtl_FMI@0x021B70D5@ */ ECIPP_ALIGNMENT_UBYTE 255 Compu_IDENTITY 0 255 PHYS_UNIT "FMI" /end CHARACTERISTIC
/begin CHARACTERISTIC FCfmi_ADIG3_min "FCtl_FMI(214)" VALUE 0x001651E9 /* @ECU_Address@FCtl_FMI@0x021B70D6@ */ ECIPP_ALIGNMENT_UBYTE 255 Compu_IDENTITY 0 255 PHYS_UNIT "FMI" /end CHARACTERISTIC
/begin CHARACTERISTIC FCfmi_ADIG4_max "FCtl_FMI(337)" VALUE 0x00165264 /* @ECU_Address@FCtl_FMI@0x021B7151@ */ ECIPP_ALIGNMENT_UBYTE 255 Compu_IDENTITY 0 255 PHYS_UNIT "FMI" /end CHARACTERISTIC
/begin CHARACTERISTIC FCfmi_ADIG4_min "FCtl_FMI(338)" VALUE 0x00165265 /* @ECU_Address@FCtl_FMI@0x021B7152@ */ ECIPP_ALIGNMENT_UBYTE 255 Compu_IDENTITY 0 255 PHYS_UNIT "FMI" /end CHARACTERISTIC
/begin CHARACTERISTIC FCfmi_ADIG5_max "FCtl_FMI(339)" VALUE 0x00165266 /* @ECU_Address@FCtl_FMI@0x021B7153@ */ ECIPP_ALIGNMENT_UBYTE 255 Compu_IDENTITY 0 255 PHYS_UNIT "FMI" /end CHARACTERISTIC
/begin CHARACTERISTIC FCfmi_ADIG5_min "FCtl_FMI(340)" VALUE 0x00165267 /* @ECU_Address@FCtl_FMI@0x021B7154@ */ ECIPP_ALIGNMENT_UBYTE 255 Compu_IDENTITY 0 255 PHYS_UNIT "FMI" /end CHARACTERISTIC
/begin CHARACTERISTIC FCfmi_ADIG6_max "FCtl_FMI(341)" VALUE 0x00165268 /* @ECU_Address@FCtl_FMI@0x021B7155@ */ ECIPP_ALIGNMENT_UBYTE 255 Compu_IDENTITY 0 255 PHYS_UNIT "FMI" /end CHARACTERISTIC
/begin CHARACTERISTIC FCfmi_ADIG6_min "FCtl_FMI(342)" VALUE 0x00165269 /* @ECU_Address@FCtl_FMI@0x021B7156@ */ ECIPP_ALIGNMENT_UBYTE 255 Compu_IDENTITY 0 255 PHYS_UNIT "FMI" /end CHARACTERISTIC
/begin CHARACTERISTIC FCfmi_ADIG7_max "FCtl_FMI(343)" VALUE 0x0016526A /* @ECU_Address@FCtl_FMI@0x021B7157@ */ ECIPP_ALIGNMENT_UBYTE 255 Compu_IDENTITY 0 255 PHYS_UNIT "FMI" /end CHARACTERISTIC
/begin CHARACTERISTIC FCfmi_ADIG7_min "FCtl_FMI(344)" VALUE 0x0016526B /* @ECU_Address@FCtl_FMI@0x021B7158@ */ ECIPP_ALIGNMENT_UBYTE 255 Compu_IDENTITY 0 255 PHYS_UNIT "FMI" /end CHARACTERISTIC
/begin CHARACTERISTIC FCfmi_ADIG8_max "FCtl_FMI(345)" VALUE 0x0016526C /* @ECU_Address@FCtl_FMI@0x021B7159@ */ ECIPP_ALIGNMENT_UBYTE 255 Compu_IDENTITY 0 255 PHYS_UNIT "FMI" /end CHARACTERISTIC
/begin CHARACTERISTIC FCfmi_ADIG8_min "FCtl_FMI(346)" VALUE 0x0016526D /* @ECU_Address@FCtl_FMI@0x021B715A@ */ ECIPP_ALIGNMENT_UBYTE 255 Compu_IDENTITY 0 255 PHYS_UNIT "FMI" /end CHARACTERISTIC
/begin CHARACTERISTIC FCfmi_ADIG9_max "FCtl_FMI(347)" VALUE 0x0016526E /* @ECU_Address@FCtl_FMI@0x021B715B@ */ ECIPP_ALIGNMENT_UBYTE 255 Compu_IDENTITY 0 255 PHYS_UNIT "FMI" /end CHARACTERISTIC
/begin CHARACTERISTIC FCfmi_ADIG9_min "FCtl_FMI(348)" VALUE 0x0016526F /* @ECU_Address@FCtl_FMI@0x021B715C@ */ ECIPP_ALIGNMENT_UBYTE 255 Compu_IDENTITY 0 255 PHYS_UNIT "FMI" /end CHARACTERISTIC
/begin CHARACTERISTIC FCfmi_ADloss "FCtl_FMI(103)" VALUE 0x0016517A /* @ECU_Address@FCtl_FMI@0x021B7067@ */ ECIPP_ALIGNMENT_UBYTE 255 Compu_IDENTITY 0 255 PHYS_UNIT "FMI" /end CHARACTERISTIC
/begin CHARACTERISTIC FCfmi_AFILT_dP_high "FCtl_FMI(732)" VALUE 0x001653EF /* @ECU_Address@FCtl_FMI@0x021B72DC@ */ ECIPP_ALIGNMENT_UBYTE 255 Compu_IDENTITY 0 255 PHYS_UNIT "FMI" /end CHARACTERISTIC
/begin CHARACTERISTIC FCfmi_AL_hi "FCtl_FMI(30)" VALUE 0x00165131 /* @ECU_Address@FCtl_FMI@0x021B701E@ */ ECIPP_ALIGNMENT_UBYTE 255 Compu_IDENTITY 0 255 PHYS_UNIT "FMI" /end CHARACTERISTIC
/begin CHARACTERISTIC FCfmi_AL_lo "FCtl_FMI(31)" VALUE 0x00165132 /* @ECU_Address@FCtl_FMI@0x021B701F@ */ ECIPP_ALIGNMENT_UBYTE 255 Compu_IDENTITY 0 255 PHYS_UNIT "FMI" /end CHARACTERISTIC
/begin CHARACTERISTIC FCfmi_ALLP_hi "FCtl_FMI(42)" VALUE 0x0016513D /* @ECU_Address@FCtl_FMI@0x021B702A@ */ ECIPP_ALIGNMENT_UBYTE 255 Compu_IDENTITY 0 255 PHYS_UNIT "FMI" /end CHARACTERISTIC
/begin CHARACTERISTIC FCfmi_ALLP_lo "FCtl_FMI(43)" VALUE 0x0016513E /* @ECU_Address@FCtl_FMI@0x021B702B@ */ ECIPP_ALIGNMENT_UBYTE 255 Compu_IDENTITY 0 255 PHYS_UNIT "FMI" /end CHARACTERISTIC
/begin CHARACTERISTIC FCfmi_ALNG_hi "FCtl_FMI(44)" VALUE 0x0016513F /* @ECU_Address@FCtl_FMI@0x021B702C@ */ ECIPP_ALIGNMENT_UBYTE 255 Compu_IDENTITY 0 255 PHYS_UNIT "FMI" /end CHARACTERISTIC
/begin CHARACTERISTIC FCfmi_ALNG_lo "FCtl_FMI(45)" VALUE 0x00165140 /* @ECU_Address@FCtl_FMI@0x021B702D@ */ ECIPP_ALIGNMENT_UBYTE 255 Compu_IDENTITY 0 255 PHYS_UNIT "FMI" /end CHARACTERISTIC
/begin CHARACTERISTIC FCfmi_APD1_max "FCtl_FMI(116)" VALUE 0x00165187 /* @ECU_Address@FCtl_FMI@0x021B7074@ */ ECIPP_ALIGNMENT_UBYTE 255 Compu_IDENTITY 0 255 PHYS_UNIT "FMI" /end CHARACTERISTIC
/begin CHARACTERISTIC FCfmi_APD1_min "FCtl_FMI(117)" VALUE 0x00165188 /* @ECU_Address@FCtl_FMI@0x021B7075@ */ ECIPP_ALIGNMENT_UBYTE 255 Compu_IDENTITY 0 255 PHYS_UNIT "FMI" /end CHARACTERISTIC
/begin CHARACTERISTIC FCfmi_APD2_max "FCtl_FMI(229)" VALUE 0x001651F8 /* @ECU_Address@FCtl_FMI@0x021B70E5@ */ ECIPP_ALIGNMENT_UBYTE 255 Compu_IDENTITY 0 255 PHYS_UNIT "FMI" /end CHARACTERISTIC
/begin CHARACTERISTIC FCfmi_APD2_min "FCtl_FMI(230)" VALUE 0x001651F9 /* @ECU_Address@FCtl_FMI@0x021B70E6@ */ ECIPP_ALIGNMENT_UBYTE 255 Compu_IDENTITY 0 255 PHYS_UNIT "FMI" /end CHARACTERISTIC
/begin CHARACTERISTIC FCfmi_APD3_max "FCtl_FMI(231)" VALUE 0x001651FA /* @ECU_Address@FCtl_FMI@0x021B70E7@ */ ECIPP_ALIGNMENT_UBYTE 255 Compu_IDENTITY 0 255 PHYS_UNIT "FMI" /end CHARACTERISTIC
/begin CHARACTERISTIC FCfmi_APD3_min "FCtl_FMI(232)" VALUE 0x001651FB /* @ECU_Address@FCtl_FMI@0x021B70E8@ */ ECIPP_ALIGNMENT_UBYTE 255 Compu_IDENTITY 0 255 PHYS_UNIT "FMI" /end CHARACTERISTIC
/begin CHARACTERISTIC FCfmi_APS1_max "FCtl_FMI(465)" VALUE 0x001652E4 /* @ECU_Address@FCtl_FMI@0x021B71D1@ */ ECIPP_ALIGNMENT_UBYTE 255 Compu_IDENTITY 0 255 PHYS_UNIT "FMI" /end CHARACTERISTIC
/begin CHARACTERISTIC FCfmi_APS1_min "FCtl_FMI(466)" VALUE 0x001652E5 /* @ECU_Address@FCtl_FMI@0x021B71D2@ */ ECIPP_ALIGNMENT_UBYTE 255 Compu_IDENTITY 0 255 PHYS_UNIT "FMI" /end CHARACTERISTIC
/begin CHARACTERISTIC FCfmi_APS12_OOR "FCtl_FMI(473)" VALUE 0x001652EC /* @ECU_Address@FCtl_FMI@0x021B71D9@ */ ECIPP_ALIGNMENT_UBYTE 255 Compu_IDENTITY 0 255 PHYS_UNIT "FMI" /end CHARACTERISTIC
/begin CHARACTERISTIC FCfmi_APS12pct_hi "FCtl_FMI(469)" VALUE 0x001652E8 /* @ECU_Address@FCtl_FMI@0x021B71D5@ */ ECIPP_ALIGNMENT_UBYTE 255 Compu_IDENTITY 0 255 PHYS_UNIT "FMI" /end CHARACTERISTIC
/begin CHARACTERISTIC FCfmi_APS12pct_lo "FCtl_FMI(470)" VALUE 0x001652E9 /* @ECU_Address@FCtl_FMI@0x021B71D6@ */ ECIPP_ALIGNMENT_UBYTE 255 Compu_IDENTITY 0 255 PHYS_UNIT "FMI" /end CHARACTERISTIC
/begin CHARACTERISTIC FCfmi_APS2_max "FCtl_FMI(467)" VALUE 0x001652E6 /* @ECU_Address@FCtl_FMI@0x021B71D3@ */ ECIPP_ALIGNMENT_UBYTE 255 Compu_IDENTITY 0 255 PHYS_UNIT "FMI" /end CHARACTERISTIC
/begin CHARACTERISTIC FCfmi_APS2_min "FCtl_FMI(468)" VALUE 0x001652E7 /* @ECU_Address@FCtl_FMI@0x021B71D4@ */ ECIPP_ALIGNMENT_UBYTE 255 Compu_IDENTITY 0 255 PHYS_UNIT "FMI" /end CHARACTERISTIC
/begin CHARACTERISTIC FCfmi_APSerr_neg "FCtl_FMI(472)" VALUE 0x001652EB /* @ECU_Address@FCtl_FMI@0x021B71D8@ */ ECIPP_ALIGNMENT_UBYTE 255 Compu_IDENTITY 0 255 PHYS_UNIT "FMI" /end CHARACTERISTIC
/begin CHARACTERISTIC FCfmi_APSerr_pos "FCtl_FMI(471)" VALUE 0x001652EA /* @ECU_Address@FCtl_FMI@0x021B71D7@ */ ECIPP_ALIGNMENT_UBYTE 255 Compu_IDENTITY 0 255 PHYS_UNIT "FMI" /end CHARACTERISTIC
/begin CHARACTERISTIC FCfmi_APU1_max "FCtl_FMI(118)" VALUE 0x00165189 /* @ECU_Address@FCtl_FMI@0x021B7076@ */ ECIPP_ALIGNMENT_UBYTE 255 Compu_IDENTITY 0 255 PHYS_UNIT "FMI" /end CHARACTERISTIC
/begin CHARACTERISTIC FCfmi_APU1_min "FCtl_FMI(119)" VALUE 0x0016518A /* @ECU_Address@FCtl_FMI@0x021B7077@ */ ECIPP_ALIGNMENT_UBYTE 255 Compu_IDENTITY 0 255 PHYS_UNIT "FMI" /end CHARACTERISTIC
/begin CHARACTERISTIC FCfmi_APU2_max "FCtl_FMI(120)" VALUE 0x0016518B /* @ECU_Address@FCtl_FMI@0x021B7078@ */ ECIPP_ALIGNMENT_UBYTE 255 Compu_IDENTITY 0 255 PHYS_UNIT "FMI" /end CHARACTERISTIC
/begin CHARACTERISTIC FCfmi_APU2_min "FCtl_FMI(121)" VALUE 0x0016518C /* @ECU_Address@FCtl_FMI@0x021B7079@ */ ECIPP_ALIGNMENT_UBYTE 255 Compu_IDENTITY 0 255 PHYS_UNIT "FMI" /end CHARACTERISTIC
/begin CHARACTERISTIC FCfmi_APU3_max "FCtl_FMI(201)" VALUE 0x001651DC /* @ECU_Address@FCtl_FMI@0x021B70C9@ */ ECIPP_ALIGNMENT_UBYTE 255 Compu_IDENTITY 0 255 PHYS_UNIT "FMI" /end CHARACTERISTIC
/begin CHARACTERISTIC FCfmi_APU3_min "FCtl_FMI(202)" VALUE 0x001651DD /* @ECU_Address@FCtl_FMI@0x021B70CA@ */ ECIPP_ALIGNMENT_UBYTE 255 Compu_IDENTITY 0 255 PHYS_UNIT "FMI" /end CHARACTERISTIC
/begin CHARACTERISTIC FCfmi_APUD1_max "FCtl_FMI(203)" VALUE 0x001651DE /* @ECU_Address@FCtl_FMI@0x021B70CB@ */ ECIPP_ALIGNMENT_UBYTE 255 Compu_IDENTITY 0 255 PHYS_UNIT "FMI" /end CHARACTERISTIC
/begin CHARACTERISTIC FCfmi_APUD1_min "FCtl_FMI(204)" VALUE 0x001651DF /* @ECU_Address@FCtl_FMI@0x021B70CC@ */ ECIPP_ALIGNMENT_UBYTE 255 Compu_IDENTITY 0 255 PHYS_UNIT "FMI" /end CHARACTERISTIC
/begin CHARACTERISTIC FCfmi_APUD10_max "FCtl_FMI(361)" VALUE 0x0016527C /* @ECU_Address@FCtl_FMI@0x021B7169@ */ ECIPP_ALIGNMENT_UBYTE 255 Compu_IDENTITY 0 255 PHYS_UNIT "FMI" /end CHARACTERISTIC
/begin CHARACTERISTIC FCfmi_APUD10_min "FCtl_FMI(362)" VALUE 0x0016527D /* @ECU_Address@FCtl_FMI@0x021B716A@ */ ECIPP_ALIGNMENT_UBYTE 255 Compu_IDENTITY 0 255 PHYS_UNIT "FMI" /end CHARACTERISTIC
/begin CHARACTERISTIC FCfmi_APUD11_max "FCtl_FMI(363)" VALUE 0x0016527E /* @ECU_Address@FCtl_FMI@0x021B716B@ */ ECIPP_ALIGNMENT_UBYTE 255 Compu_IDENTITY 0 255 PHYS_UNIT "FMI" /end CHARACTERISTIC
/begin CHARACTERISTIC FCfmi_APUD11_min "FCtl_FMI(364)" VALUE 0x0016527F /* @ECU_Address@FCtl_FMI@0x021B716C@ */ ECIPP_ALIGNMENT_UBYTE 255 Compu_IDENTITY 0 255 PHYS_UNIT "FMI" /end CHARACTERISTIC
/begin CHARACTERISTIC FCfmi_APUD12_max "FCtl_FMI(365)" VALUE 0x00165280 /* @ECU_Address@FCtl_FMI@0x021B716D@ */ ECIPP_ALIGNMENT_UBYTE 255 Compu_IDENTITY 0 255 PHYS_UNIT "FMI" /end CHARACTERISTIC
/begin CHARACTERISTIC FCftb_ADIG15_min "FCtl_FTB_0x04(398)" VALUE 0x001655FF /* @ECU_Address@FCtl_FTB_0x04@0x024C518E@ */ ECIPP_ALIGNMENT_UBYTE 255 Compu_IDENTITY 0 255 PHYS_UNIT "FTB" /end CHARACTERISTIC
/begin CHARACTERISTIC FCftb_ADIG16_max "FCtl_FTB_0x04(399)" VALUE 0x00165600 /* @ECU_Address@FCtl_FTB_0x04@0x024C518F@ */ ECIPP_ALIGNMENT_UBYTE 255 Compu_IDENTITY 0 255 PHYS_UNIT "FTB" /end CHARACTERISTIC
/begin CHARACTERISTIC FCftb_ADIG16_min "FCtl_FTB_0x04(400)" VALUE 0x00165601 /* @ECU_Address@FCtl_FTB_0x04@0x024C5190@ */ ECIPP_ALIGNMENT_UBYTE 255 Compu_IDENTITY 0 255 PHYS_UNIT "FTB" /end CHARACTERISTIC
/begin CHARACTERISTIC FCftb_ADIG17_max "FCtl_FTB_0x04(401)" VALUE 0x00165602 /* @ECU_Address@FCtl_FTB_0x04@0x024C5191@ */ ECIPP_ALIGNMENT_UBYTE 255 Compu_IDENTITY 0 255 PHYS_UNIT "FTB" /end CHARACTERISTIC
/begin CHARACTERISTIC FCftb_ADIG17_min "FCtl_FTB_0x04(402)" VALUE 0x00165603 /* @ECU_Address@FCtl_FTB_0x04@0x024C5192@ */ ECIPP_ALIGNMENT_UBYTE 255 Compu_IDENTITY 0 255 PHYS_UNIT "FTB" /end CHARACTERISTIC
/begin CHARACTERISTIC FCftb_ADIG18_max "FCtl_FTB_0x04(403)" VALUE 0x00165604 /* @ECU_Address@FCtl_FTB_0x04@0x024C5193@ */ ECIPP_ALIGNMENT_UBYTE 255 Compu_IDENTITY 0 255 PHYS_UNIT "FTB" /end CHARACTERISTIC
/begin CHARACTERISTIC FCftb_ADIG18_min "FCtl_FTB_0x04(404)" VALUE 0x00165605 /* @ECU_Address@FCtl_FTB_0x04@0x024C5194@ */ ECIPP_ALIGNMENT_UBYTE 255 Compu_IDENTITY 0 255 PHYS_UNIT "FTB" /end CHARACTERISTIC
/begin CHARACTERISTIC FCftb_ADIG19_max "FCtl_FTB_0x04(405)" VALUE 0x00165606 /* @ECU_Address@FCtl_FTB_0x04@0x024C5195@ */ ECIPP_ALIGNMENT_UBYTE 255 Compu_IDENTITY 0 255 PHYS_UNIT "FTB" /end CHARACTERISTIC
/begin CHARACTERISTIC FCftb_ADIG19_min "FCtl_FTB_0x04(406)" VALUE 0x00165607 /* @ECU_Address@FCtl_FTB_0x04@0x024C5196@ */ ECIPP_ALIGNMENT_UBYTE 255 Compu_IDENTITY 0 255 PHYS_UNIT "FTB" /end CHARACTERISTIC
/begin CHARACTERISTIC FCftb_ADIG2_max "FCtl_FTB_0x04(211)" VALUE 0x00165544 /* @ECU_Address@FCtl_FTB_0x04@0x024C50D3@ */ ECIPP_ALIGNMENT_UBYTE 255 Compu_IDENTITY 0 255 PHYS_UNIT "FTB" /end CHARACTERISTIC
/begin CHARACTERISTIC FCftb_ADIG2_min "FCtl_FTB_0x04(212)" VALUE 0x00165545 /* @ECU_Address@FCtl_FTB_0x04@0x024C50D4@ */ ECIPP_ALIGNMENT_UBYTE 255 Compu_IDENTITY 0 255 PHYS_UNIT "FTB" /end CHARACTERISTIC
/begin CHARACTERISTIC FCftb_ADIG20_max "FCtl_FTB_0x04(584)" VALUE 0x001656B9 /* @ECU_Address@FCtl_FTB_0x04@0x024C5248@ */ ECIPP_ALIGNMENT_UBYTE 255 Compu_IDENTITY 0 255 PHYS_UNIT "FTB" /end CHARACTERISTIC
/begin CHARACTERISTIC FCftb_ADIG20_min "FCtl_FTB_0x04(585)" VALUE 0x001656BA /* @ECU_Address@FCtl_FTB_0x04@0x024C5249@ */ ECIPP_ALIGNMENT_UBYTE 255 Compu_IDENTITY 0 255 PHYS_UNIT "FTB" /end CHARACTERISTIC
/begin CHARACTERISTIC FCftb_ADIG21_max "FCtl_FTB_0x04(586)" VALUE 0x001656BB /* @ECU_Address@FCtl_FTB_0x04@0x024C524A@ */ ECIPP_ALIGNMENT_UBYTE 255 Compu_IDENTITY 0 255 PHYS_UNIT "FTB" /end CHARACTERISTIC
/begin CHARACTERISTIC FCftb_ADIG21_min "FCtl_FTB_0x04(587)" VALUE 0x001656BC /* @ECU_Address@FCtl_FTB_0x04@0x024C524B@ */ ECIPP_ALIGNMENT_UBYTE 255 Compu_IDENTITY 0 255 PHYS_UNIT "FTB" /end CHARACTERISTIC
/begin CHARACTERISTIC FCftb_ADIG22_max "FCtl_FTB_0x04(588)" VALUE 0x001656BD /* @ECU_Address@FCtl_FTB_0x04@0x024C524C@ */ ECIPP_ALIGNMENT_UBYTE 255 Compu_IDENTITY 0 255 PHYS_UNIT "FTB" /end CHARACTERISTIC
/begin CHARACTERISTIC FCftb_ADIG22_min "FCtl_FTB_0x04(589)" VALUE 0x001656BE /* @ECU_Address@FCtl_FTB_0x04@0x024C524D@ */ ECIPP_ALIGNMENT_UBYTE 255 Compu_IDENTITY 0 255 PHYS_UNIT "FTB" /end CHARACTERISTIC
/begin CHARACTERISTIC FCftb_ADIG23_max "FCtl_FTB_0x04(590)" VALUE 0x001656BF /* @ECU_Address@FCtl_FTB_0x04@0x024C524E@ */ ECIPP_ALIGNMENT_UBYTE 255 Compu_IDENTITY 0 255 PHYS_UNIT "FTB" /end CHARACTERISTIC
/begin CHARACTERISTIC FCftb_ADIG23_min "FCtl_FTB_0x04(591)" VALUE 0x001656C0 /* @ECU_Address@FCtl_FTB_0x04@0x024C524F@ */ ECIPP_ALIGNMENT_UBYTE 255 Compu_IDENTITY 0 255 PHYS_UNIT "FTB" /end CHARACTERISTIC
/begin CHARACTERISTIC FCftb_ADIG24_max "FCtl_FTB_0x04(592)" VALUE 0x001656C1 /* @ECU_Address@FCtl_FTB_0x04@0x024C5250@ */ ECIPP_ALIGNMENT_UBYTE 255 Compu_IDENTITY 0 255 PHYS_UNIT "FTB" /end CHARACTERISTIC
/begin CHARACTERISTIC FCftb_ADIG24_min "FCtl_FTB_0x04(593)" VALUE 0x001656C2 /* @ECU_Address@FCtl_FTB_0x04@0x024C5251@ */ ECIPP_ALIGNMENT_UBYTE 255 Compu_IDENTITY 0 255 PHYS_UNIT "FTB" /end CHARACTERISTIC
/begin CHARACTERISTIC FCftb_ADIG25_max "FCtl_FTB_0x04(594)" VALUE 0x001656C3 /* @ECU_Address@FCtl_FTB_0x04@0x024C5252@ */ ECIPP_ALIGNMENT_UBYTE 255 Compu_IDENTITY 0 255 PHYS_UNIT "FTB" /end CHARACTERISTIC
/begin CHARACTERISTIC FCftb_ADIG25_min "FCtl_FTB_0x04(595)" VALUE 0x001656C4 /* @ECU_Address@FCtl_FTB_0x04@0x024C5253@ */ ECIPP_ALIGNMENT_UBYTE 255 Compu_IDENTITY 0 255 PHYS_UNIT "FTB" /end CHARACTERISTIC
/begin CHARACTERISTIC FCftb_ADIG3_max "FCtl_FTB_0x04(213)" VALUE 0x00165546 /* @ECU_Address@FCtl_FTB_0x04@0x024C50D5@ */ ECIPP_ALIGNMENT_UBYTE 255 Compu_IDENTITY 0 255 PHYS_UNIT "FTB" /end CHARACTERISTIC
/begin CHARACTERISTIC FCftb_ADIG3_min "FCtl_FTB_0x04(214)" VALUE 0x00165547 /* @ECU_Address@FCtl_FTB_0x04@0x024C50D6@ */ ECIPP_ALIGNMENT_UBYTE 255 Compu_IDENTITY 0 255 PHYS_UNIT "FTB" /end CHARACTERISTIC
/begin CHARACTERISTIC FCftb_ADIG4_max "FCtl_FTB_0x04(337)" VALUE 0x001655C2 /* @ECU_Address@FCtl_FTB_0x04@0x024C5151@ */ ECIPP_ALIGNMENT_UBYTE 255 Compu_IDENTITY 0 255 PHYS_UNIT "FTB" /end CHARACTERISTIC
/begin CHARACTERISTIC FCftb_ADIG4_min "FCtl_FTB_0x04(338)" VALUE 0x001655C3 /* @ECU_Address@FCtl_FTB_0x04@0x024C5152@ */ ECIPP_ALIGNMENT_UBYTE 255 Compu_IDENTITY 0 255 PHYS_UNIT "FTB" /end CHARACTERISTIC
/begin CHARACTERISTIC FCftb_ADIG5_max "FCtl_FTB_0x04(339)" VALUE 0x001655C4 /* @ECU_Address@FCtl_FTB_0x04@0x024C5153@ */ ECIPP_ALIGNMENT_UBYTE 255 Compu_IDENTITY 0 255 PHYS_UNIT "FTB" /end CHARACTERISTIC
/begin CHARACTERISTIC FCftb_ADIG5_min "FCtl_FTB_0x04(340)" VALUE 0x001655C5 /* @ECU_Address@FCtl_FTB_0x04@0x024C5154@ */ ECIPP_ALIGNMENT_UBYTE 255 Compu_IDENTITY 0 255 PHYS_UNIT "FTB" /end CHARACTERISTIC
/begin CHARACTERISTIC FCftb_ADIG6_max "FCtl_FTB_0x04(341)" VALUE 0x001655C6 /* @ECU_Address@FCtl_FTB_0x04@0x024C5155@ */ ECIPP_ALIGNMENT_UBYTE 255 Compu_IDENTITY 0 255 PHYS_UNIT "FTB" /end CHARACTERISTIC
/begin CHARACTERISTIC FCftb_ADIG6_min "FCtl_FTB_0x04(342)" VALUE 0x001655C7 /* @ECU_Address@FCtl_FTB_0x04@0x024C5156@ */ ECIPP_ALIGNMENT_UBYTE 255 Compu_IDENTITY 0 255 PHYS_UNIT "FTB" /end CHARACTERISTIC
/begin CHARACTERISTIC FCftb_ADIG7_max "FCtl_FTB_0x04(343)" VALUE 0x001655C8 /* @ECU_Address@FCtl_FTB_0x04@0x024C5157@ */ ECIPP_ALIGNMENT_UBYTE 255 Compu_IDENTITY 0 255 PHYS_UNIT "FTB" /end CHARACTERISTIC
/begin CHARACTERISTIC FCftb_ADIG7_min "FCtl_FTB_0x04(344)" VALUE 0x001655C9 /* @ECU_Address@FCtl_FTB_0x04@0x024C5158@ */ ECIPP_ALIGNMENT_UBYTE 255 Compu_IDENTITY 0 255 PHYS_UNIT "FTB" /end CHARACTERISTIC
/begin CHARACTERISTIC FCftb_ADIG8_max "FCtl_FTB_0x04(345)" VALUE 0x001655CA /* @ECU_Address@FCtl_FTB_0x04@0x024C5159@ */ ECIPP_ALIGNMENT_UBYTE 255 Compu_IDENTITY 0 255 PHYS_UNIT "FTB" /end CHARACTERISTIC
/begin CHARACTERISTIC FCftb_ADIG8_min "FCtl_FTB_0x04(346)" VALUE 0x001655CB /* @ECU_Address@FCtl_FTB_0x04@0x024C515A@ */ ECIPP_ALIGNMENT_UBYTE 255 Compu_IDENTITY 0 255 PHYS_UNIT "FTB" /end CHARACTERISTIC
/begin CHARACTERISTIC FCftb_ADIG9_max "FCtl_FTB_0x04(347)" VALUE 0x001655CC /* @ECU_Address@FCtl_FTB_0x04@0x024C515B@ */ ECIPP_ALIGNMENT_UBYTE 255 Compu_IDENTITY 0 255 PHYS_UNIT "FTB" /end CHARACTERISTIC
/begin CHARACTERISTIC FCftb_ADIG9_min "FCtl_FTB_0x04(348)" VALUE 0x001655CD /* @ECU_Address@FCtl_FTB_0x04@0x024C515C@ */ ECIPP_ALIGNMENT_UBYTE 255 Compu_IDENTITY 0 255 PHYS_UNIT "FTB" /end CHARACTERISTIC
/begin CHARACTERISTIC FCftb_ADloss "FCtl_FTB_0x04(103)" VALUE 0x001654D8 /* @ECU_Address@FCtl_FTB_0x04@0x024C5067@ */ ECIPP_ALIGNMENT_UBYTE 255 Compu_IDENTITY 0 255 PHYS_UNIT "FTB" /end CHARACTERISTIC
/begin CHARACTERISTIC FCftb_AFILT_dP_high "FCtl_FTB_0x04(732)" VALUE 0x0016574D /* @ECU_Address@FCtl_FTB_0x04@0x024C52DC@ */ ECIPP_ALIGNMENT_UBYTE 255 Compu_IDENTITY 0 255 PHYS_UNIT "FTB" /end CHARACTERISTIC
/begin CHARACTERISTIC FCftb_AL_hi "FCtl_FTB_0x04(30)" VALUE 0x0016548F /* @ECU_Address@FCtl_FTB_0x04@0x024C501E@ */ ECIPP_ALIGNMENT_UBYTE 255 Compu_IDENTITY 0 255 PHYS_UNIT "FTB" /end CHARACTERISTIC
/begin CHARACTERISTIC FCftb_AL_lo "FCtl_FTB_0x04(31)" VALUE 0x00165490 /* @ECU_Address@FCtl_FTB_0x04@0x024C501F@ */ ECIPP_ALIGNMENT_UBYTE 255 Compu_IDENTITY 0 255 PHYS_UNIT "FTB" /end CHARACTERISTIC
/begin CHARACTERISTIC FCftb_ALLP_hi "FCtl_FTB_0x04(42)" VALUE 0x0016549B /* @ECU_Address@FCtl_FTB_0x04@0x024C502A@ */ ECIPP_ALIGNMENT_UBYTE 255 Compu_IDENTITY 0 255 PHYS_UNIT "FTB" /end CHARACTERISTIC
/begin CHARACTERISTIC FCftb_ALLP_lo "FCtl_FTB_0x04(43)" VALUE 0x0016549C /* @ECU_Address@FCtl_FTB_0x04@0x024C502B@ */ ECIPP_ALIGNMENT_UBYTE 255 Compu_IDENTITY 0 255 PHYS_UNIT "FTB" /end CHARACTERISTIC
/begin CHARACTERISTIC FCftb_ALNG_hi "FCtl_FTB_0x04(44)" VALUE 0x0016549D /* @ECU_Address@FCtl_FTB_0x04@0x024C502C@ */ ECIPP_ALIGNMENT_UBYTE 255 Compu_IDENTITY 0 255 PHYS_UNIT "FTB" /end CHARACTERISTIC
/begin CHARACTERISTIC FCftb_ALNG_lo "FCtl_FTB_0x04(45)" VALUE 0x0016549E /* @ECU_Address@FCtl_FTB_0x04@0x024C502D@ */ ECIPP_ALIGNMENT_UBYTE 255 Compu_IDENTITY 0 255 PHYS_UNIT "FTB" /end CHARACTERISTIC
/begin CHARACTERISTIC FCftb_APD1_max "FCtl_FTB_0x04(116)" VALUE 0x001654E5 /* @ECU_Address@FCtl_FTB_0x04@0x024C5074@ */ ECIPP_ALIGNMENT_UBYTE 255 Compu_IDENTITY 0 255 PHYS_UNIT "FTB" /end CHARACTERISTIC
/begin CHARACTERISTIC FCftb_APD1_min "FCtl_FTB_0x04(117)" VALUE 0x001654E6 /* @ECU_Address@FCtl_FTB_0x04@0x024C5075@ */ ECIPP_ALIGNMENT_UBYTE 255 Compu_IDENTITY 0 255 PHYS_UNIT "FTB" /end CHARACTERISTIC
/begin CHARACTERISTIC FCftb_APD2_max "FCtl_FTB_0x04(229)" VALUE 0x00165556 /* @ECU_Address@FCtl_FTB_0x04@0x024C50E5@ */ ECIPP_ALIGNMENT_UBYTE 255 Compu_IDENTITY 0 255 PHYS_UNIT "FTB" /end CHARACTERISTIC
/begin CHARACTERISTIC FCftb_APD2_min "FCtl_FTB_0x04(230)" VALUE 0x00165557 /* @ECU_Address@FCtl_FTB_0x04@0x024C50E6@ */ ECIPP_ALIGNMENT_UBYTE 255 Compu_IDENTITY 0 255 PHYS_UNIT "FTB" /end CHARACTERISTIC
/begin CHARACTERISTIC FCftb_APD3_max "FCtl_FTB_0x04(231)" VALUE 0x00165558 /* @ECU_Address@FCtl_FTB_0x04@0x024C50E7@ */ ECIPP_ALIGNMENT_UBYTE 255 Compu_IDENTITY 0 255 PHYS_UNIT "FTB" /end CHARACTERISTIC
/begin CHARACTERISTIC FCftb_APD3_min "FCtl_FTB_0x04(232)" VALUE 0x00165559 /* @ECU_Address@FCtl_FTB_0x04@0x024C50E8@ */ ECIPP_ALIGNMENT_UBYTE 255 Compu_IDENTITY 0 255 PHYS_UNIT "FTB" /end CHARACTERISTIC
/begin CHARACTERISTIC FCftb_APS1_max "FCtl_FTB_0x04(465)" VALUE 0x00165642 /* @ECU_Address@FCtl_FTB_0x04@0x024C51D1@ */ ECIPP_ALIGNMENT_UBYTE 255 Compu_IDENTITY 0 255 PHYS_UNIT "FTB" /end CHARACTERISTIC
/begin CHARACTERISTIC FCftb_APS1_min "FCtl_FTB_0x04(466)" VALUE 0x00165643 /* @ECU_Address@FCtl_FTB_0x04@0x024C51D2@ */ ECIPP_ALIGNMENT_UBYTE 255 Compu_IDENTITY 0 255 PHYS_UNIT "FTB" /end CHARACTERISTIC
/begin CHARACTERISTIC FCftb_APS12_OOR "FCtl_FTB_0x04(473)" VALUE 0x0016564A /* @ECU_Address@FCtl_FTB_0x04@0x024C51D9@ */ ECIPP_ALIGNMENT_UBYTE 255 Compu_IDENTITY 0 255 PHYS_UNIT "FTB" /end CHARACTERISTIC
/begin CHARACTERISTIC FCftb_APS12pct_hi "FCtl_FTB_0x04(469)" VALUE 0x00165646 /* @ECU_Address@FCtl_FTB_0x04@0x024C51D5@ */ ECIPP_ALIGNMENT_UBYTE 255 Compu_IDENTITY 0 255 PHYS_UNIT "FTB" /end CHARACTERISTIC
/begin CHARACTERISTIC FCftb_APS12pct_lo "FCtl_FTB_0x04(470)" VALUE 0x00165647 /* @ECU_Address@FCtl_FTB_0x04@0x024C51D6@ */ ECIPP_ALIGNMENT_UBYTE 255 Compu_IDENTITY 0 255 PHYS_UNIT "FTB" /end CHARACTERISTIC
/begin CHARACTERISTIC FCftb_APS2_max "FCtl_FTB_0x04(467)" VALUE 0x00165644 /* @ECU_Address@FCtl_FTB_0x04@0x024C51D3@ */ ECIPP_ALIGNMENT_UBYTE 255 Compu_IDENTITY 0 255 PHYS_UNIT "FTB" /end CHARACTERISTIC
/begin CHARACTERISTIC FCftb_APS2_min "FCtl_FTB_0x04(468)" VALUE 0x00165645 /* @ECU_Address@FCtl_FTB_0x04@0x024C51D4@ */ ECIPP_ALIGNMENT_UBYTE 255 Compu_IDENTITY 0 255 PHYS_UNIT "FTB" /end CHARACTERISTIC
/begin CHARACTERISTIC FCftb_APSerr_neg "FCtl_FTB_0x04(472)" VALUE 0x00165649 /* @ECU_Address@FCtl_FTB_0x04@0x024C51D8@ */ ECIPP_ALIGNMENT_UBYTE 255 Compu_IDENTITY 0 255 PHYS_UNIT "FTB" /end CHARACTERISTIC
/begin CHARACTERISTIC FCftb_APSerr_pos "FCtl_FTB_0x04(471)" VALUE 0x00165648 /* @ECU_Address@FCtl_FTB_0x04@0x024C51D7@ */ ECIPP_ALIGNMENT_UBYTE 255 Compu_IDENTITY 0 255 PHYS_UNIT "FTB" /end CHARACTERISTIC
/begin CHARACTERISTIC FCftb_APU1_max "FCtl_FTB_0x04(118)" VALUE 0x001654E7 /* @ECU_Address@FCtl_FTB_0x04@0x024C5076@ */ ECIPP_ALIGNMENT_UBYTE 255 Compu_IDENTITY 0 255 PHYS_UNIT "FTB" /end CHARACTERISTIC
/begin CHARACTERISTIC FCftb_APU1_min "FCtl_FTB_0x04(119)" VALUE 0x001654E8 /* @ECU_Address@FCtl_FTB_0x04@0x024C5077@ */ ECIPP_ALIGNMENT_UBYTE 255 Compu_IDENTITY 0 255 PHYS_UNIT "FTB" /end CHARACTERISTIC
/begin CHARACTERISTIC FCftb_APU2_max "FCtl_FTB_0x04(120)" VALUE 0x001654E9 /* @ECU_Address@FCtl_FTB_0x04@0x024C5078@ */ ECIPP_ALIGNMENT_UBYTE 255 Compu_IDENTITY 0 255 PHYS_UNIT "FTB" /end CHARACTERISTIC
/begin CHARACTERISTIC FCftb_APU2_min "FCtl_FTB_0x04(121)" VALUE 0x001654EA /* @ECU_Address@FCtl_FTB_0x04@0x024C5079@ */ ECIPP_ALIGNMENT_UBYTE 255 Compu_IDENTITY 0 255 PHYS_UNIT "FTB" /end CHARACTERISTIC
/begin CHARACTERISTIC FCftb_APU3_max "FCtl_FTB_0x04(201)" VALUE 0x0016553A /* @ECU_Address@FCtl_FTB_0x04@0x024C50C9@ */ ECIPP_ALIGNMENT_UBYTE 255 Compu_IDENTITY 0 255 PHYS_UNIT "FTB" /end CHARACTERISTIC
/begin CHARACTERISTIC FCftb_APU3_min "FCtl_FTB_0x04(202)" VALUE 0x0016553B /* @ECU_Address@FCtl_FTB_0x04@0x024C50CA@ */ ECIPP_ALIGNMENT_UBYTE 255 Compu_IDENTITY 0 255 PHYS_UNIT "FTB" /end CHARACTERISTIC
/begin CHARACTERISTIC FCftb_APUD1_max "FCtl_FTB_0x04(203)" VALUE 0x0016553C /* @ECU_Address@FCtl_FTB_0x04@0x024C50CB@ */ ECIPP_ALIGNMENT_UBYTE 255 Compu_IDENTITY 0 255 PHYS_UNIT "FTB" /end CHARACTERISTIC
/begin CHARACTERISTIC FCftb_APUD1_min "FCtl_FTB_0x04(204)" VALUE 0x0016553D /* @ECU_Address@FCtl_FTB_0x04@0x024C50CC@ */ ECIPP_ALIGNMENT_UBYTE 255 Compu_IDENTITY 0 255 PHYS_UNIT "FTB" /end CHARACTERISTIC
/begin CHARACTERISTIC FCftb_APUD10_max "FCtl_FTB_0x04(361)" VALUE 0x001655DA /* @ECU_Address@FCtl_FTB_0x04@0x024C5169@ */ ECIPP_ALIGNMENT_UBYTE 255 Compu_IDENTITY 0 255 PHYS_UNIT "FTB" /end CHARACTERISTIC
/begin CHARACTERISTIC FCftb_APUD10_min "FCtl_FTB_0x04(362)" VALUE 0x001655DB /* @ECU_Address@FCtl_FTB_0x04@0x024C516A@ */ ECIPP_ALIGNMENT_UBYTE 255 Compu_IDENTITY 0 255 PHYS_UNIT "FTB" /end CHARACTERISTIC
/begin CHARACTERISTIC FCftb_APUD11_max "FCtl_FTB_0x04(363)" VALUE 0x001655DC /* @ECU_Address@FCtl_FTB_0x04@0x024C516B@ */ ECIPP_ALIGNMENT_UBYTE 255 Compu_IDENTITY 0 255 PHYS_UNIT "FTB" /end CHARACTERISTIC
/begin CHARACTERISTIC FCftb_APUD11_min "FCtl_FTB_0x04(364)" VALUE 0x001655DD /* @ECU_Address@FCtl_FTB_0x04@0x024C516C@ */ ECIPP_ALIGNMENT_UBYTE 255 Compu_IDENTITY 0 255 PHYS_UNIT "FTB" /end CHARACTERISTIC
/begin CHARACTERISTIC FCftb_APUD12_max "FCtl_FTB_0x04(365)" VALUE 0x001655DE /* @ECU_Address@FCtl_FTB_0x04@0x024C516D@ */ ECIPP_ALIGNMENT_UBYTE 255 Compu_IDENTITY 0 255 PHYS_UNIT "FTB" /end CHARACTERISTIC
/begin CHARACTERISTIC FCspn_ADIG15_min "FCtl_SPN(398)" VALUE 0x00162314 /* @ECU_Address@FCtl_SPN@0x021B6638@ */ ECIPP_ALIGNMENT_ULONG 4294967295 Compu_IDENTITY 0 4294967295 PHYS_UNIT "SPN" /end CHARACTERISTIC
/begin CHARACTERISTIC FCspn_ADIG16_max "FCtl_SPN(399)" VALUE 0x00162318 /* @ECU_Address@FCtl_SPN@0x021B663C@ */ ECIPP_ALIGNMENT_ULONG 4294967295 Compu_IDENTITY 0 4294967295 PHYS_UNIT "SPN" /end CHARACTERISTIC
/begin CHARACTERISTIC FCspn_ADIG16_min "FCtl_SPN(400)" VALUE 0x0016231C /* @ECU_Address@FCtl_SPN@0x021B6640@ */ ECIPP_ALIGNMENT_ULONG 4294967295 Compu_IDENTITY 0 4294967295 PHYS_UNIT "SPN" /end CHARACTERISTIC
/begin CHARACTERISTIC FCspn_ADIG17_max "FCtl_SPN(401)" VALUE 0x00162320 /* @ECU_Address@FCtl_SPN@0x021B6644@ */ ECIPP_ALIGNMENT_ULONG 4294967295 Compu_IDENTITY 0 4294967295 PHYS_UNIT "SPN" /end CHARACTERISTIC
/begin CHARACTERISTIC FCspn_ADIG17_min "FCtl_SPN(402)" VALUE 0x00162324 /* @ECU_Address@FCtl_SPN@0x021B6648@ */ ECIPP_ALIGNMENT_ULONG 4294967295 Compu_IDENTITY 0 4294967295 PHYS_UNIT "SPN" /end CHARACTERISTIC
/begin CHARACTERISTIC FCspn_ADIG18_max "FCtl_SPN(403)" VALUE 0x00162328 /* @ECU_Address@FCtl_SPN@0x021B664C@ */ ECIPP_ALIGNMENT_ULONG 4294967295 Compu_IDENTITY 0 4294967295 PHYS_UNIT "SPN" /end CHARACTERISTIC
/begin CHARACTERISTIC FCspn_ADIG18_min "FCtl_SPN(404)" VALUE 0x0016232C /* @ECU_Address@FCtl_SPN@0x021B6650@ */ ECIPP_ALIGNMENT_ULONG 4294967295 Compu_IDENTITY 0 4294967295 PHYS_UNIT "SPN" /end CHARACTERISTIC
/begin CHARACTERISTIC FCspn_ADIG19_max "FCtl_SPN(405)" VALUE 0x00162330 /* @ECU_Address@FCtl_SPN@0x021B6654@ */ ECIPP_ALIGNMENT_ULONG 4294967295 Compu_IDENTITY 0 4294967295 PHYS_UNIT "SPN" /end CHARACTERISTIC
/begin CHARACTERISTIC FCspn_ADIG19_min "FCtl_SPN(406)" VALUE 0x00162334 /* @ECU_Address@FCtl_SPN@0x021B6658@ */ ECIPP_ALIGNMENT_ULONG 4294967295 Compu_IDENTITY 0 4294967295 PHYS_UNIT "SPN" /end CHARACTERISTIC
/begin CHARACTERISTIC FCspn_ADIG2_max "FCtl_SPN(211)" VALUE 0x00162028 /* @ECU_Address@FCtl_SPN@0x021B634C@ */ ECIPP_ALIGNMENT_ULONG 4294967295 Compu_IDENTITY 0 4294967295 PHYS_UNIT "SPN" /end CHARACTERISTIC
/begin CHARACTERISTIC FCspn_ADIG2_min "FCtl_SPN(212)" VALUE 0x0016202C /* @ECU_Address@FCtl_SPN@0x021B6350@ */ ECIPP_ALIGNMENT_ULONG 4294967295 Compu_IDENTITY 0 4294967295 PHYS_UNIT "SPN" /end CHARACTERISTIC
/begin CHARACTERISTIC FCspn_ADIG20_max "FCtl_SPN(584)" VALUE 0x001625FC /* @ECU_Address@FCtl_SPN@0x021B6920@ */ ECIPP_ALIGNMENT_ULONG 4294967295 Compu_IDENTITY 0 4294967295 PHYS_UNIT "SPN" /end CHARACTERISTIC
/begin CHARACTERISTIC FCspn_ADIG20_min "FCtl_SPN(585)" VALUE 0x00162600 /* @ECU_Address@FCtl_SPN@0x021B6924@ */ ECIPP_ALIGNMENT_ULONG 4294967295 Compu_IDENTITY 0 4294967295 PHYS_UNIT "SPN" /end CHARACTERISTIC
/begin CHARACTERISTIC FCspn_ADIG21_max "FCtl_SPN(586)" VALUE 0x00162604 /* @ECU_Address@FCtl_SPN@0x021B6928@ */ ECIPP_ALIGNMENT_ULONG 4294967295 Compu_IDENTITY 0 4294967295 PHYS_UNIT "SPN" /end CHARACTERISTIC
/begin CHARACTERISTIC FCspn_ADIG21_min "FCtl_SPN(587)" VALUE 0x00162608 /* @ECU_Address@FCtl_SPN@0x021B692C@ */ ECIPP_ALIGNMENT_ULONG 4294967295 Compu_IDENTITY 0 4294967295 PHYS_UNIT "SPN" /end CHARACTERISTIC
/begin CHARACTERISTIC FCspn_ADIG22_max "FCtl_SPN(588)" VALUE 0x0016260C /* @ECU_Address@FCtl_SPN@0x021B6930@ */ ECIPP_ALIGNMENT_ULONG 4294967295 Compu_IDENTITY 0 4294967295 PHYS_UNIT "SPN" /end CHARACTERISTIC
/begin CHARACTERISTIC FCspn_ADIG22_min "FCtl_SPN(589)" VALUE 0x00162610 /* @ECU_Address@FCtl_SPN@0x021B6934@ */ ECIPP_ALIGNMENT_ULONG 4294967295 Compu_IDENTITY 0 4294967295 PHYS_UNIT "SPN" /end CHARACTERISTIC
/begin CHARACTERISTIC FCspn_ADIG23_max "FCtl_SPN(590)" VALUE 0x00162614 /* @ECU_Address@FCtl_SPN@0x021B6938@ */ ECIPP_ALIGNMENT_ULONG 4294967295 Compu_IDENTITY 0 4294967295 PHYS_UNIT "SPN" /end CHARACTERISTIC
/begin CHARACTERISTIC FCspn_ADIG23_min "FCtl_SPN(591)" VALUE 0x00162618 /* @ECU_Address@FCtl_SPN@0x021B693C@ */ ECIPP_ALIGNMENT_ULONG 4294967295 Compu_IDENTITY 0 4294967295 PHYS_UNIT "SPN" /end CHARACTERISTIC
/begin CHARACTERISTIC FCspn_ADIG24_max "FCtl_SPN(592)" VALUE 0x0016261C /* @ECU_Address@FCtl_SPN@0x021B6940@ */ ECIPP_ALIGNMENT_ULONG 4294967295 Compu_IDENTITY 0 4294967295 PHYS_UNIT "SPN" /end CHARACTERISTIC
/begin CHARACTERISTIC FCspn_ADIG24_min "FCtl_SPN(593)" VALUE 0x00162620 /* @ECU_Address@FCtl_SPN@0x021B6944@ */ ECIPP_ALIGNMENT_ULONG 4294967295 Compu_IDENTITY 0 4294967295 PHYS_UNIT "SPN" /end CHARACTERISTIC
/begin CHARACTERISTIC FCspn_ADIG25_max "FCtl_SPN(594)" VALUE 0x00162624 /* @ECU_Address@FCtl_SPN@0x021B6948@ */ ECIPP_ALIGNMENT_ULONG 4294967295 Compu_IDENTITY 0 4294967295 PHYS_UNIT "SPN" /end CHARACTERISTIC
/begin CHARACTERISTIC FCspn_ADIG25_min "FCtl_SPN(595)" VALUE 0x00162628 /* @ECU_Address@FCtl_SPN@0x021B694C@ */ ECIPP_ALIGNMENT_ULONG 4294967295 Compu_IDENTITY 0 4294967295 PHYS_UNIT "SPN" /end CHARACTERISTIC
/begin CHARACTERISTIC FCspn_ADIG3_max "FCtl_SPN(213)" VALUE 0x00162030 /* @ECU_Address@FCtl_SPN@0x021B6354@ */ ECIPP_ALIGNMENT_ULONG 4294967295 Compu_IDENTITY 0 4294967295 PHYS_UNIT "SPN" /end CHARACTERISTIC
/begin CHARACTERISTIC FCspn_ADIG3_min "FCtl_SPN(214)" VALUE 0x00162034 /* @ECU_Address@FCtl_SPN@0x021B6358@ */ ECIPP_ALIGNMENT_ULONG 4294967295 Compu_IDENTITY 0 4294967295 PHYS_UNIT "SPN" /end CHARACTERISTIC
/begin CHARACTERISTIC FCspn_ADIG4_max "FCtl_SPN(337)" VALUE 0x00162220 /* @ECU_Address@FCtl_SPN@0x021B6544@ */ ECIPP_ALIGNMENT_ULONG 4294967295 Compu_IDENTITY 0 4294967295 PHYS_UNIT "SPN" /end CHARACTERISTIC
/begin CHARACTERISTIC FCspn_ADIG4_min "FCtl_SPN(338)" VALUE 0x00162224 /* @ECU_Address@FCtl_SPN@0x021B6548@ */ ECIPP_ALIGNMENT_ULONG 4294967295 Compu_IDENTITY 0 4294967295 PHYS_UNIT "SPN" /end CHARACTERISTIC
/begin CHARACTERISTIC FCspn_ADIG5_max "FCtl_SPN(339)" VALUE 0x00162228 /* @ECU_Address@FCtl_SPN@0x021B654C@ */ ECIPP_ALIGNMENT_ULONG 4294967295 Compu_IDENTITY 0 4294967295 PHYS_UNIT "SPN" /end CHARACTERISTIC
/begin CHARACTERISTIC FCspn_ADIG5_min "FCtl_SPN(340)" VALUE 0x0016222C /* @ECU_Address@FCtl_SPN@0x021B6550@ */ ECIPP_ALIGNMENT_ULONG 4294967295 Compu_IDENTITY 0 4294967295 PHYS_UNIT "SPN" /end CHARACTERISTIC
/begin CHARACTERISTIC FCspn_ADIG6_max "FCtl_SPN(341)" VALUE 0x00162230 /* @ECU_Address@FCtl_SPN@0x021B6554@ */ ECIPP_ALIGNMENT_ULONG 4294967295 Compu_IDENTITY 0 4294967295 PHYS_UNIT "SPN" /end CHARACTERISTIC
/begin CHARACTERISTIC FCspn_ADIG6_min "FCtl_SPN(342)" VALUE 0x00162234 /* @ECU_Address@FCtl_SPN@0x021B6558@ */ ECIPP_ALIGNMENT_ULONG 4294967295 Compu_IDENTITY 0 4294967295 PHYS_UNIT "SPN" /end CHARACTERISTIC
/begin CHARACTERISTIC FCspn_ADIG7_max "FCtl_SPN(343)" VALUE 0x00162238 /* @ECU_Address@FCtl_SPN@0x021B655C@ */ ECIPP_ALIGNMENT_ULONG 4294967295 Compu_IDENTITY 0 4294967295 PHYS_UNIT "SPN" /end CHARACTERISTIC
/begin CHARACTERISTIC FCspn_ADIG7_min "FCtl_SPN(344)" VALUE 0x0016223C /* @ECU_Address@FCtl_SPN@0x021B6560@ */ ECIPP_ALIGNMENT_ULONG 4294967295 Compu_IDENTITY 0 4294967295 PHYS_UNIT "SPN" /end CHARACTERISTIC
/begin CHARACTERISTIC FCspn_ADIG8_max "FCtl_SPN(345)" VALUE 0x00162240 /* @ECU_Address@FCtl_SPN@0x021B6564@ */ ECIPP_ALIGNMENT_ULONG 4294967295 Compu_IDENTITY 0 4294967295 PHYS_UNIT "SPN" /end CHARACTERISTIC
/begin CHARACTERISTIC FCspn_ADIG8_min "FCtl_SPN(346)" VALUE 0x00162244 /* @ECU_Address@FCtl_SPN@0x021B6568@ */ ECIPP_ALIGNMENT_ULONG 4294967295 Compu_IDENTITY 0 4294967295 PHYS_UNIT "SPN" /end CHARACTERISTIC
/begin CHARACTERISTIC FCspn_ADIG9_max "FCtl_SPN(347)" VALUE 0x00162248 /* @ECU_Address@FCtl_SPN@0x021B656C@ */ ECIPP_ALIGNMENT_ULONG 4294967295 Compu_IDENTITY 0 4294967295 PHYS_UNIT "SPN" /end CHARACTERISTIC
/begin CHARACTERISTIC FCspn_ADIG9_min "FCtl_SPN(348)" VALUE 0x0016224C /* @ECU_Address@FCtl_SPN@0x021B6570@ */ ECIPP_ALIGNMENT_ULONG 4294967295 Compu_IDENTITY 0 4294967295 PHYS_UNIT "SPN" /end CHARACTERISTIC
/begin CHARACTERISTIC FCspn_ADloss "FCtl_SPN(103)" VALUE 0x00161E78 /* @ECU_Address@FCtl_SPN@0x021B619C@ */ ECIPP_ALIGNMENT_ULONG 4294967295 Compu_IDENTITY 0 4294967295 PHYS_UNIT "SPN" /end CHARACTERISTIC
/begin CHARACTERISTIC FCspn_AFILT_dP_high "FCtl_SPN(732)" VALUE 0x0016284C /* @ECU_Address@FCtl_SPN@0x021B6B70@ */ ECIPP_ALIGNMENT_ULONG 4294967295 Compu_IDENTITY 0 4294967295 PHYS_UNIT "SPN" /end CHARACTERISTIC
/begin CHARACTERISTIC FCspn_AL_hi "FCtl_SPN(30)" VALUE 0x00161D54 /* @ECU_Address@FCtl_SPN@0x021B6078@ */ ECIPP_ALIGNMENT_ULONG 4294967295 Compu_IDENTITY 0 4294967295 PHYS_UNIT "SPN" /end CHARACTERISTIC
/begin CHARACTERISTIC FCspn_AL_lo "FCtl_SPN(31)" VALUE 0x00161D58 /* @ECU_Address@FCtl_SPN@0x021B607C@ */ ECIPP_ALIGNMENT_ULONG 4294967295 Compu_IDENTITY 0 4294967295 PHYS_UNIT "SPN" /end CHARACTERISTIC
/begin CHARACTERISTIC FCspn_ALLP_hi "FCtl_SPN(42)" VALUE 0x00161D84 /* @ECU_Address@FCtl_SPN@0x021B60A8@ */ ECIPP_ALIGNMENT_ULONG 4294967295 Compu_IDENTITY 0 4294967295 PHYS_UNIT "SPN" /end CHARACTERISTIC
/begin CHARACTERISTIC FCspn_ALLP_lo "FCtl_SPN(43)" VALUE 0x00161D88 /* @ECU_Address@FCtl_SPN@0x021B60AC@ */ ECIPP_ALIGNMENT_ULONG 4294967295 Compu_IDENTITY 0 4294967295 PHYS_UNIT "SPN" /end CHARACTERISTIC
/begin CHARACTERISTIC FCspn_ALNG_hi "FCtl_SPN(44)" VALUE 0x00161D8C /* @ECU_Address@FCtl_SPN@0x021B60B0@ */ ECIPP_ALIGNMENT_ULONG 4294967295 Compu_IDENTITY 0 4294967295 PHYS_UNIT "SPN" /end CHARACTERISTIC
/begin CHARACTERISTIC FCspn_ALNG_lo "FCtl_SPN(45)" VALUE 0x00161D90 /* @ECU_Address@FCtl_SPN@0x021B60B4@ */ ECIPP_ALIGNMENT_ULONG 4294967295 Compu_IDENTITY 0 4294967295 PHYS_UNIT "SPN" /end CHARACTERISTIC
/begin CHARACTERISTIC FCspn_APD1_max "FCtl_SPN(116)" VALUE 0x00161EAC /* @ECU_Address@FCtl_SPN@0x021B61D0@ */ ECIPP_ALIGNMENT_ULONG 4294967295 Compu_IDENTITY 0 4294967295 PHYS_UNIT "SPN" /end CHARACTERISTIC
/begin CHARACTERISTIC FCspn_APD1_min "FCtl_SPN(117)" VALUE 0x00161EB0 /* @ECU_Address@FCtl_SPN@0x021B61D4@ */ ECIPP_ALIGNMENT_ULONG 4294967295 Compu_IDENTITY 0 4294967295 PHYS_UNIT "SPN" /end CHARACTERISTIC
/begin CHARACTERISTIC FCspn_APD2_max "FCtl_SPN(229)" VALUE 0x00162070 /* @ECU_Address@FCtl_SPN@0x021B6394@ */ ECIPP_ALIGNMENT_ULONG 4294967295 Compu_IDENTITY 0 4294967295 PHYS_UNIT "SPN" /end CHARACTERISTIC
/begin CHARACTERISTIC FCspn_APD2_min "FCtl_SPN(230)" VALUE 0x00162074 /* @ECU_Address@FCtl_SPN@0x021B6398@ */ ECIPP_ALIGNMENT_ULONG 4294967295 Compu_IDENTITY 0 4294967295 PHYS_UNIT "SPN" /end CHARACTERISTIC
/begin CHARACTERISTIC FCspn_APD3_max "FCtl_SPN(231)" VALUE 0x00162078 /* @ECU_Address@FCtl_SPN@0x021B639C@ */ ECIPP_ALIGNMENT_ULONG 4294967295 Compu_IDENTITY 0 4294967295 PHYS_UNIT "SPN" /end CHARACTERISTIC
/begin CHARACTERISTIC FCspn_APD3_min "FCtl_SPN(232)" VALUE 0x0016207C /* @ECU_Address@FCtl_SPN@0x021B63A0@ */ ECIPP_ALIGNMENT_ULONG 4294967295 Compu_IDENTITY 0 4294967295 PHYS_UNIT "SPN" /end CHARACTERISTIC
/begin CHARACTERISTIC FCspn_APS1_max "FCtl_SPN(465)" VALUE 0x00162420 /* @ECU_Address@FCtl_SPN@0x021B6744@ */ ECIPP_ALIGNMENT_ULONG 4294967295 Compu_IDENTITY 0 4294967295 PHYS_UNIT "SPN" /end CHARACTERISTIC
/begin CHARACTERISTIC FCspn_APS1_min "FCtl_SPN(466)" VALUE 0x00162424 /* @ECU_Address@FCtl_SPN@0x021B6748@ */ ECIPP_ALIGNMENT_ULONG 4294967295 Compu_IDENTITY 0 4294967295 PHYS_UNIT "SPN" /end CHARACTERISTIC
/begin CHARACTERISTIC FCspn_APS12_OOR "FCtl_SPN(473)" VALUE 0x00162440 /* @ECU_Address@FCtl_SPN@0x021B6764@ */ ECIPP_ALIGNMENT_ULONG 4294967295 Compu_IDENTITY 0 4294967295 PHYS_UNIT "SPN" /end CHARACTERISTIC
/begin CHARACTERISTIC FCspn_APS12pct_hi "FCtl_SPN(469)" VALUE 0x00162430 /* @ECU_Address@FCtl_SPN@0x021B6754@ */ ECIPP_ALIGNMENT_ULONG 4294967295 Compu_IDENTITY 0 4294967295 PHYS_UNIT "SPN" /end CHARACTERISTIC
/begin CHARACTERISTIC FCspn_APS12pct_lo "FCtl_SPN(470)" VALUE 0x00162434 /* @ECU_Address@FCtl_SPN@0x021B6758@ */ ECIPP_ALIGNMENT_ULONG 4294967295 Compu_IDENTITY 0 4294967295 PHYS_UNIT "SPN" /end CHARACTERISTIC
/begin CHARACTERISTIC FCspn_APS2_max "FCtl_SPN(467)" VALUE 0x00162428 /* @ECU_Address@FCtl_SPN@0x021B674C@ */ ECIPP_ALIGNMENT_ULONG 4294967295 Compu_IDENTITY 0 4294967295 PHYS_UNIT "SPN" /end CHARACTERISTIC
/begin CHARACTERISTIC FCspn_APS2_min "FCtl_SPN(468)" VALUE 0x0016242C /* @ECU_Address@FCtl_SPN@0x021B6750@ */ ECIPP_ALIGNMENT_ULONG 4294967295 Compu_IDENTITY 0 4294967295 PHYS_UNIT "SPN" /end CHARACTERISTIC
/begin CHARACTERISTIC FCspn_APSerr_neg "FCtl_SPN(472)" VALUE 0x0016243C /* @ECU_Address@FCtl_SPN@0x021B6760@ */ ECIPP_ALIGNMENT_ULONG 4294967295 Compu_IDENTITY 0 4294967295 PHYS_UNIT "SPN" /end CHARACTERISTIC
/begin CHARACTERISTIC FCspn_APSerr_pos "FCtl_SPN(471)" VALUE 0x00162438 /* @ECU_Address@FCtl_SPN@0x021B675C@ */ ECIPP_ALIGNMENT_ULONG 4294967295 Compu_IDENTITY 0 4294967295 PHYS_UNIT "SPN" /end CHARACTERISTIC
/begin CHARACTERISTIC FCspn_APU1_max "FCtl_SPN(118)" VALUE 0x00161EB4 /* @ECU_Address@FCtl_SPN@0x021B61D8@ */ ECIPP_ALIGNMENT_ULONG 4294967295 Compu_IDENTITY 0 4294967295 PHYS_UNIT "SPN" /end CHARACTERISTIC
/begin CHARACTERISTIC FCspn_APU1_min "FCtl_SPN(119)" VALUE 0x00161EB8 /* @ECU_Address@FCtl_SPN@0x021B61DC@ */ ECIPP_ALIGNMENT_ULONG 4294967295 Compu_IDENTITY 0 4294967295 PHYS_UNIT "SPN" /end CHARACTERISTIC
/begin CHARACTERISTIC FCspn_APU2_max "FCtl_SPN(120)" VALUE 0x00161EBC /* @ECU_Address@FCtl_SPN@0x021B61E0@ */ ECIPP_ALIGNMENT_ULONG 4294967295 Compu_IDENTITY 0 4294967295 PHYS_UNIT "SPN" /end CHARACTERISTIC
/begin CHARACTERISTIC FCspn_APU2_min "FCtl_SPN(121)" VALUE 0x00161EC0 /* @ECU_Address@FCtl_SPN@0x021B61E4@ */ ECIPP_ALIGNMENT_ULONG 4294967295 Compu_IDENTITY 0 4294967295 PHYS_UNIT "SPN" /end CHARACTERISTIC
/begin CHARACTERISTIC FCspn_APU3_max "FCtl_SPN(201)" VALUE 0x00162000 /* @ECU_Address@FCtl_SPN@0x021B6324@ */ ECIPP_ALIGNMENT_ULONG 4294967295 Compu_IDENTITY 0 4294967295 PHYS_UNIT "SPN" /end CHARACTERISTIC
/begin CHARACTERISTIC FCspn_APU3_min "FCtl_SPN(202)" VALUE 0x00162004 /* @ECU_Address@FCtl_SPN@0x021B6328@ */ ECIPP_ALIGNMENT_ULONG 4294967295 Compu_IDENTITY 0 4294967295 PHYS_UNIT "SPN" /end CHARACTERISTIC
/begin CHARACTERISTIC FCspn_APUD1_max "FCtl_SPN(203)" VALUE 0x00162008 /* @ECU_Address@FCtl_SPN@0x021B632C@ */ ECIPP_ALIGNMENT_ULONG 4294967295 Compu_IDENTITY 0 4294967295 PHYS_UNIT "SPN" /end CHARACTERISTIC
/begin CHARACTERISTIC FCspn_APUD1_min "FCtl_SPN(204)" VALUE 0x0016200C /* @ECU_Address@FCtl_SPN@0x021B6330@ */ ECIPP_ALIGNMENT_ULONG 4294967295 Compu_IDENTITY 0 4294967295 PHYS_UNIT "SPN" /end CHARACTERISTIC
/begin CHARACTERISTIC FCspn_APUD10_max "FCtl_SPN(361)" VALUE 0x00162280 /* @ECU_Address@FCtl_SPN@0x021B65A4@ */ ECIPP_ALIGNMENT_ULONG 4294967295 Compu_IDENTITY 0 4294967295 PHYS_UNIT "SPN" /end CHARACTERISTIC
/begin CHARACTERISTIC FCspn_APUD10_min "FCtl_SPN(362)" VALUE 0x00162284 /* @ECU_Address@FCtl_SPN@0x021B65A8@ */ ECIPP_ALIGNMENT_ULONG 4294967295 Compu_IDENTITY 0 4294967295 PHYS_UNIT "SPN" /end CHARACTERISTIC
/begin CHARACTERISTIC FCspn_APUD11_max "FCtl_SPN(363)" VALUE 0x00162288 /* @ECU_Address@FCtl_SPN@0x021B65AC@ */ ECIPP_ALIGNMENT_ULONG 4294967295 Compu_IDENTITY 0 4294967295 PHYS_UNIT "SPN" /end CHARACTERISTIC
/begin CHARACTERISTIC FCspn_APUD11_min "FCtl_SPN(364)" VALUE 0x0016228C /* @ECU_Address@FCtl_SPN@0x021B65B0@ */ ECIPP_ALIGNMENT_ULONG 4294967295 Compu_IDENTITY 0 4294967295 PHYS_UNIT "SPN" /end CHARACTERISTIC
/begin CHARACTERISTIC FCspn_APUD12_max "FCtl_SPN(365)" VALUE 0x00162290 /* @ECU_Address@FCtl_SPN@0x021B65B4@ */ ECIPP_ALIGNMENT_ULONG 4294967295 Compu_IDENTITY 0 4294967295 PHYS_UNIT "SPN" /end CHARACTERISTIC
/begin CHARACTERISTIC FPfl_ADIG15_min "FPrm_latch(307)" VALUE 0x001604E4 /* @ECU_Address@FPrm_latch@0x021BB4CC@ */ ECIPP_ALIGNMENT_FLOAT32_IEEE 10000000000 Compu_IDENTITY -10000000000 10000000000 PHYS_UNIT "ms" /end CHARACTERISTIC
/begin CHARACTERISTIC FPfl_ADIG16_max "FPrm_latch(308)" VALUE 0x001604E8 /* @ECU_Address@FPrm_latch@0x021BB4D0@ */ ECIPP_ALIGNMENT_FLOAT32_IEEE 10000000000 Compu_IDENTITY -10000000000 10000000000 PHYS_UNIT "ms" /end CHARACTERISTIC
/begin CHARACTERISTIC FPfl_ADIG16_min "FPrm_latch(309)" VALUE 0x001604EC /* @ECU_Address@FPrm_latch@0x021BB4D4@ */ ECIPP_ALIGNMENT_FLOAT32_IEEE 10000000000 Compu_IDENTITY -10000000000 10000000000 PHYS_UNIT "ms" /end CHARACTERISTIC
/begin CHARACTERISTIC FPfl_ADIG17_max "FPrm_latch(310)" VALUE 0x001604F0 /* @ECU_Address@FPrm_latch@0x021BB4D8@ */ ECIPP_ALIGNMENT_FLOAT32_IEEE 10000000000 Compu_IDENTITY -10000000000 10000000000 PHYS_UNIT "ms" /end CHARACTERISTIC
/begin CHARACTERISTIC FPfl_ADIG17_min "FPrm_latch(311)" VALUE 0x001604F4 /* @ECU_Address@FPrm_latch@0x021BB4DC@ */ ECIPP_ALIGNMENT_FLOAT32_IEEE 10000000000 Compu_IDENTITY -10000000000 10000000000 PHYS_UNIT "ms" /end CHARACTERISTIC
/begin CHARACTERISTIC FPfl_ADIG18_max "FPrm_latch(312)" VALUE 0x001604F8 /* @ECU_Address@FPrm_latch@0x021BB4E0@ */ ECIPP_ALIGNMENT_FLOAT32_IEEE 10000000000 Compu_IDENTITY -10000000000 10000000000 PHYS_UNIT "ms" /end CHARACTERISTIC
/begin CHARACTERISTIC FPfl_ADIG18_min "FPrm_latch(313)" VALUE 0x001604FC /* @ECU_Address@FPrm_latch@0x021BB4E4@ */ ECIPP_ALIGNMENT_FLOAT32_IEEE 10000000000 Compu_IDENTITY -10000000000 10000000000 PHYS_UNIT "ms" /end CHARACTERISTIC
/begin CHARACTERISTIC FPfl_ADIG19_max "FPrm_latch(314)" VALUE 0x00160500 /* @ECU_Address@FPrm_latch@0x021BB4E8@ */ ECIPP_ALIGNMENT_FLOAT32_IEEE 10000000000 Compu_IDENTITY -10000000000 10000000000 PHYS_UNIT "ms" /end CHARACTERISTIC
/begin CHARACTERISTIC FPfl_ADIG19_min "FPrm_latch(315)" VALUE 0x00160504 /* @ECU_Address@FPrm_latch@0x021BB4EC@ */ ECIPP_ALIGNMENT_FLOAT32_IEEE 10000000000 Compu_IDENTITY -10000000000 10000000000 PHYS_UNIT "ms" /end CHARACTERISTIC
/begin CHARACTERISTIC FPfl_ADIG2_max "FPrm_latch(167)" VALUE 0x001602B4 /* @ECU_Address@FPrm_latch@0x021BB29C@ */ ECIPP_ALIGNMENT_FLOAT32_IEEE 10000000000 Compu_IDENTITY -10000000000 10000000000 PHYS_UNIT "ms" /end CHARACTERISTIC
/begin CHARACTERISTIC FPfl_ADIG2_min "FPrm_latch(168)" VALUE 0x001602B8 /* @ECU_Address@FPrm_latch@0x021BB2A0@ */ ECIPP_ALIGNMENT_FLOAT32_IEEE 10000000000 Compu_IDENTITY -10000000000 10000000000 PHYS_UNIT "ms" /end CHARACTERISTIC
/begin CHARACTERISTIC FPfl_ADIG20_max "FPrm_latch(438)" VALUE 0x001606F0 /* @ECU_Address@FPrm_latch@0x021BB6D8@ */ ECIPP_ALIGNMENT_FLOAT32_IEEE 10000000000 Compu_IDENTITY -10000000000 10000000000 PHYS_UNIT "ms" /end CHARACTERISTIC
/begin CHARACTERISTIC FPfl_ADIG20_min "FPrm_latch(439)" VALUE 0x001606F4 /* @ECU_Address@FPrm_latch@0x021BB6DC@ */ ECIPP_ALIGNMENT_FLOAT32_IEEE 10000000000 Compu_IDENTITY -10000000000 10000000000 PHYS_UNIT "ms" /end CHARACTERISTIC
/begin CHARACTERISTIC FPfl_ADIG21_max "FPrm_latch(440)" VALUE 0x001606F8 /* @ECU_Address@FPrm_latch@0x021BB6E0@ */ ECIPP_ALIGNMENT_FLOAT32_IEEE 10000000000 Compu_IDENTITY -10000000000 10000000000 PHYS_UNIT "ms" /end CHARACTERISTIC
/begin CHARACTERISTIC FPfl_ADIG21_min "FPrm_latch(441)" VALUE 0x001606FC /* @ECU_Address@FPrm_latch@0x021BB6E4@ */ ECIPP_ALIGNMENT_FLOAT32_IEEE 10000000000 Compu_IDENTITY -10000000000 10000000000 PHYS_UNIT "ms" /end CHARACTERISTIC
/begin CHARACTERISTIC FPfl_ADIG22_max "FPrm_latch(442)" VALUE 0x00160700 /* @ECU_Address@FPrm_latch@0x021BB6E8@ */ ECIPP_ALIGNMENT_FLOAT32_IEEE 10000000000 Compu_IDENTITY -10000000000 10000000000 PHYS_UNIT "ms" /end CHARACTERISTIC
/begin CHARACTERISTIC FPfl_ADIG22_min "FPrm_latch(443)" VALUE 0x00160704 /* @ECU_Address@FPrm_latch@0x021BB6EC@ */ ECIPP_ALIGNMENT_FLOAT32_IEEE 10000000000 Compu_IDENTITY -10000000000 10000000000 PHYS_UNIT "ms" /end CHARACTERISTIC
/begin CHARACTERISTIC FPfl_ADIG23_max "FPrm_latch(444)" VALUE 0x00160708 /* @ECU_Address@FPrm_latch@0x021BB6F0@ */ ECIPP_ALIGNMENT_FLOAT32_IEEE 10000000000 Compu_IDENTITY -10000000000 10000000000 PHYS_UNIT "ms" /end CHARACTERISTIC
/begin CHARACTERISTIC FPfl_ADIG23_min "FPrm_latch(445)" VALUE 0x0016070C /* @ECU_Address@FPrm_latch@0x021BB6F4@ */ ECIPP_ALIGNMENT_FLOAT32_IEEE 10000000000 Compu_IDENTITY -10000000000 10000000000 PHYS_UNIT "ms" /end CHARACTERISTIC
/begin CHARACTERISTIC FPfl_ADIG24_max "FPrm_latch(446)" VALUE 0x00160710 /* @ECU_Address@FPrm_latch@0x021BB6F8@ */ ECIPP_ALIGNMENT_FLOAT32_IEEE 10000000000 Compu_IDENTITY -10000000000 10000000000 PHYS_UNIT "ms" /end CHARACTERISTIC
/begin CHARACTERISTIC FPfl_ADIG24_min "FPrm_latch(447)" VALUE 0x00160714 /* @ECU_Address@FPrm_latch@0x021BB6FC@ */ ECIPP_ALIGNMENT_FLOAT32_IEEE 10000000000 Compu_IDENTITY -10000000000 10000000000 PHYS_UNIT "ms" /end CHARACTERISTIC
/begin CHARACTERISTIC FPfl_ADIG25_max "FPrm_latch(448)" VALUE 0x00160718 /* @ECU_Address@FPrm_latch@0x021BB700@ */ ECIPP_ALIGNMENT_FLOAT32_IEEE 10000000000 Compu_IDENTITY -10000000000 10000000000 PHYS_UNIT "ms" /end CHARACTERISTIC
/begin CHARACTERISTIC FPfl_ADIG25_min "FPrm_latch(449)" VALUE 0x0016071C /* @ECU_Address@FPrm_latch@0x021BB704@ */ ECIPP_ALIGNMENT_FLOAT32_IEEE 10000000000 Compu_IDENTITY -10000000000 10000000000 PHYS_UNIT "ms" /end CHARACTERISTIC
/begin CHARACTERISTIC FPfl_ADIG3_max "FPrm_latch(169)" VALUE 0x001602BC /* @ECU_Address@FPrm_latch@0x021BB2A4@ */ ECIPP_ALIGNMENT_FLOAT32_IEEE 10000000000 Compu_IDENTITY -10000000000 10000000000 PHYS_UNIT "ms" /end CHARACTERISTIC
/begin CHARACTERISTIC FPfl_ADIG3_min "FPrm_latch(170)" VALUE 0x001602C0 /* @ECU_Address@FPrm_latch@0x021BB2A8@ */ ECIPP_ALIGNMENT_FLOAT32_IEEE 10000000000 Compu_IDENTITY -10000000000 10000000000 PHYS_UNIT "ms" /end CHARACTERISTIC
/begin CHARACTERISTIC FPfl_ADIG4_max "FPrm_latch(246)" VALUE 0x001603F0 /* @ECU_Address@FPrm_latch@0x021BB3D8@ */ ECIPP_ALIGNMENT_FLOAT32_IEEE 10000000000 Compu_IDENTITY -10000000000 10000000000 PHYS_UNIT "ms" /end CHARACTERISTIC
/begin CHARACTERISTIC FPfl_ADIG4_min "FPrm_latch(247)" VALUE 0x001603F4 /* @ECU_Address@FPrm_latch@0x021BB3DC@ */ ECIPP_ALIGNMENT_FLOAT32_IEEE 10000000000 Compu_IDENTITY -10000000000 10000000000 PHYS_UNIT "ms" /end CHARACTERISTIC
/begin CHARACTERISTIC FPfl_ADIG5_max "FPrm_latch(248)" VALUE 0x001603F8 /* @ECU_Address@FPrm_latch@0x021BB3E0@ */ ECIPP_ALIGNMENT_FLOAT32_IEEE 10000000000 Compu_IDENTITY -10000000000 10000000000 PHYS_UNIT "ms" /end CHARACTERISTIC
/begin CHARACTERISTIC FPfl_ADIG5_min "FPrm_latch(249)" VALUE 0x001603FC /* @ECU_Address@FPrm_latch@0x021BB3E4@ */ ECIPP_ALIGNMENT_FLOAT32_IEEE 10000000000 Compu_IDENTITY -10000000000 10000000000 PHYS_UNIT "ms" /end CHARACTERISTIC
/begin CHARACTERISTIC FPfl_ADIG6_max "FPrm_latch(250)" VALUE 0x00160400 /* @ECU_Address@FPrm_latch@0x021BB3E8@ */ ECIPP_ALIGNMENT_FLOAT32_IEEE 10000000000 Compu_IDENTITY -10000000000 10000000000 PHYS_UNIT "ms" /end CHARACTERISTIC
/begin CHARACTERISTIC FPfl_ADIG6_min "FPrm_latch(251)" VALUE 0x00160404 /* @ECU_Address@FPrm_latch@0x021BB3EC@ */ ECIPP_ALIGNMENT_FLOAT32_IEEE 10000000000 Compu_IDENTITY -10000000000 10000000000 PHYS_UNIT "ms" /end CHARACTERISTIC
/begin CHARACTERISTIC FPfl_ADIG7_max "FPrm_latch(252)" VALUE 0x00160408 /* @ECU_Address@FPrm_latch@0x021BB3F0@ */ ECIPP_ALIGNMENT_FLOAT32_IEEE 10000000000 Compu_IDENTITY -10000000000 10000000000 PHYS_UNIT "ms" /end CHARACTERISTIC
/begin CHARACTERISTIC FPfl_ADIG7_min "FPrm_latch(253)" VALUE 0x0016040C /* @ECU_Address@FPrm_latch@0x021BB3F4@ */ ECIPP_ALIGNMENT_FLOAT32_IEEE 10000000000 Compu_IDENTITY -10000000000 10000000000 PHYS_UNIT "ms" /end CHARACTERISTIC
/begin CHARACTERISTIC FPfl_ADIG8_max "FPrm_latch(254)" VALUE 0x00160410 /* @ECU_Address@FPrm_latch@0x021BB3F8@ */ ECIPP_ALIGNMENT_FLOAT32_IEEE 10000000000 Compu_IDENTITY -10000000000 10000000000 PHYS_UNIT "ms" /end CHARACTERISTIC
/begin CHARACTERISTIC FPfl_ADIG8_min "FPrm_latch(255)" VALUE 0x00160414 /* @ECU_Address@FPrm_latch@0x021BB3FC@ */ ECIPP_ALIGNMENT_FLOAT32_IEEE 10000000000 Compu_IDENTITY -10000000000 10000000000 PHYS_UNIT "ms" /end CHARACTERISTIC
/begin CHARACTERISTIC FPfl_ADIG9_max "FPrm_latch(256)" VALUE 0x00160418 /* @ECU_Address@FPrm_latch@0x021BB400@ */ ECIPP_ALIGNMENT_FLOAT32_IEEE 10000000000 Compu_IDENTITY -10000000000 10000000000 PHYS_UNIT "ms" /end CHARACTERISTIC
/begin CHARACTERISTIC FPfl_ADIG9_min "FPrm_latch(257)" VALUE 0x0016041C /* @ECU_Address@FPrm_latch@0x021BB404@ */ ECIPP_ALIGNMENT_FLOAT32_IEEE 10000000000 Compu_IDENTITY -10000000000 10000000000 PHYS_UNIT "ms" /end CHARACTERISTIC
/begin CHARACTERISTIC FPfl_ADloss "FPrm_latch(67)" VALUE 0x00160124 /* @ECU_Address@FPrm_latch@0x021BB10C@ */ ECIPP_ALIGNMENT_FLOAT32_IEEE 10000000000 Compu_IDENTITY -10000000000 10000000000 PHYS_UNIT "ms" /end CHARACTERISTIC
/begin CHARACTERISTIC FPfl_AFILT_dP_high "FPrm_latch(562)" VALUE 0x001608E0 /* @ECU_Address@FPrm_latch@0x021BB8C8@ */ ECIPP_ALIGNMENT_FLOAT32_IEEE 10000000000 Compu_IDENTITY -10000000000 10000000000 PHYS_UNIT "ms" /end CHARACTERISTIC
/begin CHARACTERISTIC FPfl_AL_hi "FPrm_latch(41)" VALUE 0x001600BC /* @ECU_Address@FPrm_latch@0x021BB0A4@ */ ECIPP_ALIGNMENT_FLOAT32_IEEE 10000000000 Compu_IDENTITY -10000000000 10000000000 PHYS_UNIT "updates" /end CHARACTERISTIC
/begin CHARACTERISTIC FPfl_AL_lo "FPrm_latch(42)" VALUE 0x001600C0 /* @ECU_Address@FPrm_latch@0x021BB0A8@ */ ECIPP_ALIGNMENT_FLOAT32_IEEE 10000000000 Compu_IDENTITY -10000000000 10000000000 PHYS_UNIT "updates" /end CHARACTERISTIC
/begin CHARACTERISTIC FPfl_ALLP_hi "FPrm_latch(43)" VALUE 0x001600C4 /* @ECU_Address@FPrm_latch@0x021BB0AC@ */ ECIPP_ALIGNMENT_FLOAT32_IEEE 10000000000 Compu_IDENTITY -10000000000 10000000000 PHYS_UNIT "updates" /end CHARACTERISTIC
/begin CHARACTERISTIC FPfl_ALLP_lo "FPrm_latch(44)" VALUE 0x001600C8 /* @ECU_Address@FPrm_latch@0x021BB0B0@ */ ECIPP_ALIGNMENT_FLOAT32_IEEE 10000000000 Compu_IDENTITY -10000000000 10000000000 PHYS_UNIT "updates" /end CHARACTERISTIC
/begin CHARACTERISTIC FPfl_ALNG_hi "FPrm_latch(45)" VALUE 0x001600CC /* @ECU_Address@FPrm_latch@0x021BB0B4@ */ ECIPP_ALIGNMENT_FLOAT32_IEEE 10000000000 Compu_IDENTITY -10000000000 10000000000 PHYS_UNIT "updates" /end CHARACTERISTIC
/begin CHARACTERISTIC FPfl_ALNG_lo "FPrm_latch(46)" VALUE 0x001600D0 /* @ECU_Address@FPrm_latch@0x021BB0B8@ */ ECIPP_ALIGNMENT_FLOAT32_IEEE 10000000000 Compu_IDENTITY -10000000000 10000000000 PHYS_UNIT "updates" /end CHARACTERISTIC
/begin CHARACTERISTIC FPfl_APD1_max "FPrm_latch(75)" VALUE 0x00160144 /* @ECU_Address@FPrm_latch@0x021BB12C@ */ ECIPP_ALIGNMENT_FLOAT32_IEEE 10000000000 Compu_IDENTITY -10000000000 10000000000 PHYS_UNIT "ms" /end CHARACTERISTIC
/begin CHARACTERISTIC FPfl_APD1_min "FPrm_latch(76)" VALUE 0x00160148 /* @ECU_Address@FPrm_latch@0x021BB130@ */ ECIPP_ALIGNMENT_FLOAT32_IEEE 10000000000 Compu_IDENTITY -10000000000 10000000000 PHYS_UNIT "ms" /end CHARACTERISTIC
/begin CHARACTERISTIC FPfl_APD2_max "FPrm_latch(181)" VALUE 0x001602EC /* @ECU_Address@FPrm_latch@0x021BB2D4@ */ ECIPP_ALIGNMENT_FLOAT32_IEEE 10000000000 Compu_IDENTITY -10000000000 10000000000 PHYS_UNIT "ms" /end CHARACTERISTIC
/begin CHARACTERISTIC FPfl_APD2_min "FPrm_latch(182)" VALUE 0x001602F0 /* @ECU_Address@FPrm_latch@0x021BB2D8@ */ ECIPP_ALIGNMENT_FLOAT32_IEEE 10000000000 Compu_IDENTITY -10000000000 10000000000 PHYS_UNIT "ms" /end CHARACTERISTIC
/begin CHARACTERISTIC FPfl_APD3_max "FPrm_latch(183)" VALUE 0x001602F4 /* @ECU_Address@FPrm_latch@0x021BB2DC@ */ ECIPP_ALIGNMENT_FLOAT32_IEEE 10000000000 Compu_IDENTITY -10000000000 10000000000 PHYS_UNIT "ms" /end CHARACTERISTIC
/begin CHARACTERISTIC FPfl_APD3_min "FPrm_latch(184)" VALUE 0x001602F8 /* @ECU_Address@FPrm_latch@0x021BB2E0@ */ ECIPP_ALIGNMENT_FLOAT32_IEEE 10000000000 Compu_IDENTITY -10000000000 10000000000 PHYS_UNIT "ms" /end CHARACTERISTIC
/begin CHARACTERISTIC FPfl_APS1_max "FPrm_latch(362)" VALUE 0x001605C0 /* @ECU_Address@FPrm_latch@0x021BB5A8@ */ ECIPP_ALIGNMENT_FLOAT32_IEEE 10000000000 Compu_IDENTITY -10000000000 10000000000 PHYS_UNIT "ms" /end CHARACTERISTIC
/begin CHARACTERISTIC FPfl_APS1_min "FPrm_latch(363)" VALUE 0x001605C4 /* @ECU_Address@FPrm_latch@0x021BB5AC@ */ ECIPP_ALIGNMENT_FLOAT32_IEEE 10000000000 Compu_IDENTITY -10000000000 10000000000 PHYS_UNIT "ms" /end CHARACTERISTIC
/begin CHARACTERISTIC FPfl_APS12_OOR "FPrm_latch(370)" VALUE 0x001605E0 /* @ECU_Address@FPrm_latch@0x021BB5C8@ */ ECIPP_ALIGNMENT_FLOAT32_IEEE 10000000000 Compu_IDENTITY -10000000000 10000000000 PHYS_UNIT "ms" /end CHARACTERISTIC
/begin CHARACTERISTIC FPfl_APS12pct_hi "FPrm_latch(366)" VALUE 0x001605D0 /* @ECU_Address@FPrm_latch@0x021BB5B8@ */ ECIPP_ALIGNMENT_FLOAT32_IEEE 10000000000 Compu_IDENTITY -10000000000 10000000000 PHYS_UNIT "ms" /end CHARACTERISTIC
/begin CHARACTERISTIC FPfl_APS12pct_lo "FPrm_latch(367)" VALUE 0x001605D4 /* @ECU_Address@FPrm_latch@0x021BB5BC@ */ ECIPP_ALIGNMENT_FLOAT32_IEEE 10000000000 Compu_IDENTITY -10000000000 10000000000 PHYS_UNIT "ms" /end CHARACTERISTIC
/begin CHARACTERISTIC FPfl_APS2_max "FPrm_latch(364)" VALUE 0x001605C8 /* @ECU_Address@FPrm_latch@0x021BB5B0@ */ ECIPP_ALIGNMENT_FLOAT32_IEEE 10000000000 Compu_IDENTITY -10000000000 10000000000 PHYS_UNIT "ms" /end CHARACTERISTIC
/begin CHARACTERISTIC FPfl_APS2_min "FPrm_latch(365)" VALUE 0x001605CC /* @ECU_Address@FPrm_latch@0x021BB5B4@ */ ECIPP_ALIGNMENT_FLOAT32_IEEE 10000000000 Compu_IDENTITY -10000000000 10000000000 PHYS_UNIT "ms" /end CHARACTERISTIC
/begin CHARACTERISTIC FPfl_APSerr_neg "FPrm_latch(369)" VALUE 0x001605DC /* @ECU_Address@FPrm_latch@0x021BB5C4@ */ ECIPP_ALIGNMENT_FLOAT32_IEEE 10000000000 Compu_IDENTITY -10000000000 10000000000 PHYS_UNIT "ms" /end CHARACTERISTIC
/begin CHARACTERISTIC FPfl_APSerr_pos "FPrm_latch(368)" VALUE 0x001605D8 /* @ECU_Address@FPrm_latch@0x021BB5C0@ */ ECIPP_ALIGNMENT_FLOAT32_IEEE 10000000000 Compu_IDENTITY -10000000000 10000000000 PHYS_UNIT "ms" /end CHARACTERISTIC
/begin CHARACTERISTIC FPfl_APU1_max "FPrm_latch(77)" VALUE 0x0016014C /* @ECU_Address@FPrm_latch@0x021BB134@ */ ECIPP_ALIGNMENT_FLOAT32_IEEE 10000000000 Compu_IDENTITY -10000000000 10000000000 PHYS_UNIT "ms" /end CHARACTERISTIC
/begin CHARACTERISTIC FPfl_APU1_min "FPrm_latch(78)" VALUE 0x00160150 /* @ECU_Address@FPrm_latch@0x021BB138@ */ ECIPP_ALIGNMENT_FLOAT32_IEEE 10000000000 Compu_IDENTITY -10000000000 10000000000 PHYS_UNIT "ms" /end CHARACTERISTIC
/begin CHARACTERISTIC FPfl_APU2_max "FPrm_latch(79)" VALUE 0x00160154 /* @ECU_Address@FPrm_latch@0x021BB13C@ */ ECIPP_ALIGNMENT_FLOAT32_IEEE 10000000000 Compu_IDENTITY -10000000000 10000000000 PHYS_UNIT "ms" /end CHARACTERISTIC
/begin CHARACTERISTIC FPfl_APU2_min "FPrm_latch(80)" VALUE 0x00160158 /* @ECU_Address@FPrm_latch@0x021BB140@ */ ECIPP_ALIGNMENT_FLOAT32_IEEE 10000000000 Compu_IDENTITY -10000000000 10000000000 PHYS_UNIT "ms" /end CHARACTERISTIC
/begin CHARACTERISTIC FPfl_APU3_max "FPrm_latch(157)" VALUE 0x0016028C /* @ECU_Address@FPrm_latch@0x021BB274@ */ ECIPP_ALIGNMENT_FLOAT32_IEEE 10000000000 Compu_IDENTITY -10000000000 10000000000 PHYS_UNIT "ms" /end CHARACTERISTIC
/begin CHARACTERISTIC FPfl_APU3_min "FPrm_latch(158)" VALUE 0x00160290 /* @ECU_Address@FPrm_latch@0x021BB278@ */ ECIPP_ALIGNMENT_FLOAT32_IEEE 10000000000 Compu_IDENTITY -10000000000 10000000000 PHYS_UNIT "ms" /end CHARACTERISTIC
/begin CHARACTERISTIC FPfl_APUD1_max "FPrm_latch(159)" VALUE 0x00160294 /* @ECU_Address@FPrm_latch@0x021BB27C@ */ ECIPP_ALIGNMENT_FLOAT32_IEEE 10000000000 Compu_IDENTITY -10000000000 10000000000 PHYS_UNIT "ms" /end CHARACTERISTIC
/begin CHARACTERISTIC FPfl_APUD1_min "FPrm_latch(160)" VALUE 0x00160298 /* @ECU_Address@FPrm_latch@0x021BB280@ */ ECIPP_ALIGNMENT_FLOAT32_IEEE 10000000000 Compu_IDENTITY -10000000000 10000000000 PHYS_UNIT "ms" /end CHARACTERISTIC
/begin CHARACTERISTIC FPfl_APUD10_max "FPrm_latch(270)" VALUE 0x00160450 /* @ECU_Address@FPrm_latch@0x021BB438@ */ ECIPP_ALIGNMENT_FLOAT32_IEEE 10000000000 Compu_IDENTITY -10000000000 10000000000 PHYS_UNIT "ms" /end CHARACTERISTIC
/begin CHARACTERISTIC FPfl_APUD10_min "FPrm_latch(271)" VALUE 0x00160454 /* @ECU_Address@FPrm_latch@0x021BB43C@ */ ECIPP_ALIGNMENT_FLOAT32_IEEE 10000000000 Compu_IDENTITY -10000000000 10000000000 PHYS_UNIT "ms" /end CHARACTERISTIC
/begin CHARACTERISTIC FPfl_APUD11_max "FPrm_latch(272)" VALUE 0x00160458 /* @ECU_Address@FPrm_latch@0x021BB440@ */ ECIPP_ALIGNMENT_FLOAT32_IEEE 10000000000 Compu_IDENTITY -10000000000 10000000000 PHYS_UNIT "ms" /end CHARACTERISTIC
/begin CHARACTERISTIC FPfl_APUD11_min "FPrm_latch(273)" VALUE 0x0016045C /* @ECU_Address@FPrm_latch@0x021BB444@ */ ECIPP_ALIGNMENT_FLOAT32_IEEE 10000000000 Compu_IDENTITY -10000000000 10000000000 PHYS_UNIT "ms" /end CHARACTERISTIC
/begin CHARACTERISTIC FPfl_APUD12_max "FPrm_latch(274)" VALUE 0x00160460 /* @ECU_Address@FPrm_latch@0x021BB448@ */ ECIPP_ALIGNMENT_FLOAT32_IEEE 10000000000 Compu_IDENTITY -10000000000 10000000000 PHYS_UNIT "ms" /end CHARACTERISTIC
/begin CHARACTERISTIC FPfu_ADIG15_min "FPrm_unlatch(307)" VALUE 0x00160FA8 /* @ECU_Address@FPrm_unlatch@0x021BD4CC@ */ ECIPP_ALIGNMENT_FLOAT32_IEEE 10000000000 Compu_IDENTITY -10000000000 10000000000 PHYS_UNIT "ms" /end CHARACTERISTIC
/begin CHARACTERISTIC FPfu_ADIG16_max "FPrm_unlatch(308)" VALUE 0x00160FAC /* @ECU_Address@FPrm_unlatch@0x021BD4D0@ */ ECIPP_ALIGNMENT_FLOAT32_IEEE 10000000000 Compu_IDENTITY -10000000000 10000000000 PHYS_UNIT "ms" /end CHARACTERISTIC
/begin CHARACTERISTIC FPfu_ADIG16_min "FPrm_unlatch(309)" VALUE 0x00160FB0 /* @ECU_Address@FPrm_unlatch@0x021BD4D4@ */ ECIPP_ALIGNMENT_FLOAT32_IEEE 10000000000 Compu_IDENTITY -10000000000 10000000000 PHYS_UNIT "ms" /end CHARACTERISTIC
/begin CHARACTERISTIC FPfu_ADIG17_max "FPrm_unlatch(310)" VALUE 0x00160FB4 /* @ECU_Address@FPrm_unlatch@0x021BD4D8@ */ ECIPP_ALIGNMENT_FLOAT32_IEEE 10000000000 Compu_IDENTITY -10000000000 10000000000 PHYS_UNIT "ms" /end CHARACTERISTIC
/begin CHARACTERISTIC FPfu_ADIG17_min "FPrm_unlatch(311)" VALUE 0x00160FB8 /* @ECU_Address@FPrm_unlatch@0x021BD4DC@ */ ECIPP_ALIGNMENT_FLOAT32_IEEE 10000000000 Compu_IDENTITY -10000000000 10000000000 PHYS_UNIT "ms" /end CHARACTERISTIC
/begin CHARACTERISTIC FPfu_ADIG18_max "FPrm_unlatch(312)" VALUE 0x00160FBC /* @ECU_Address@FPrm_unlatch@0x021BD4E0@ */ ECIPP_ALIGNMENT_FLOAT32_IEEE 10000000000 Compu_IDENTITY -10000000000 10000000000 PHYS_UNIT "ms" /end CHARACTERISTIC
/begin CHARACTERISTIC FPfu_ADIG18_min "FPrm_unlatch(313)" VALUE 0x00160FC0 /* @ECU_Address@FPrm_unlatch@0x021BD4E4@ */ ECIPP_ALIGNMENT_FLOAT32_IEEE 10000000000 Compu_IDENTITY -10000000000 10000000000 PHYS_UNIT "ms" /end CHARACTERISTIC
/begin CHARACTERISTIC FPfu_ADIG19_max "FPrm_unlatch(314)" VALUE 0x00160FC4 /* @ECU_Address@FPrm_unlatch@0x021BD4E8@ */ ECIPP_ALIGNMENT_FLOAT32_IEEE 10000000000 Compu_IDENTITY -10000000000 10000000000 PHYS_UNIT "ms" /end CHARACTERISTIC
/begin CHARACTERISTIC FPfu_ADIG19_min "FPrm_unlatch(315)" VALUE 0x00160FC8 /* @ECU_Address@FPrm_unlatch@0x021BD4EC@ */ ECIPP_ALIGNMENT_FLOAT32_IEEE 10000000000 Compu_IDENTITY -10000000000 10000000000 PHYS_UNIT "ms" /end CHARACTERISTIC
/begin CHARACTERISTIC FPfu_ADIG2_max "FPrm_unlatch(167)" VALUE 0x00160D78 /* @ECU_Address@FPrm_unlatch@0x021BD29C@ */ ECIPP_ALIGNMENT_FLOAT32_IEEE 10000000000 Compu_IDENTITY -10000000000 10000000000 PHYS_UNIT "ms" /end CHARACTERISTIC
/begin CHARACTERISTIC FPfu_ADIG2_min "FPrm_unlatch(168)" VALUE 0x00160D7C /* @ECU_Address@FPrm_unlatch@0x021BD2A0@ */ ECIPP_ALIGNMENT_FLOAT32_IEEE 10000000000 Compu_IDENTITY -10000000000 10000000000 PHYS_UNIT "ms" /end CHARACTERISTIC
/begin CHARACTERISTIC FPfu_ADIG20_max "FPrm_unlatch(438)" VALUE 0x001611B4 /* @ECU_Address@FPrm_unlatch@0x021BD6D8@ */ ECIPP_ALIGNMENT_FLOAT32_IEEE 10000000000 Compu_IDENTITY -10000000000 10000000000 PHYS_UNIT "ms" /end CHARACTERISTIC
/begin CHARACTERISTIC FPfu_ADIG20_min "FPrm_unlatch(439)" VALUE 0x001611B8 /* @ECU_Address@FPrm_unlatch@0x021BD6DC@ */ ECIPP_ALIGNMENT_FLOAT32_IEEE 10000000000 Compu_IDENTITY -10000000000 10000000000 PHYS_UNIT "ms" /end CHARACTERISTIC
/begin CHARACTERISTIC FPfu_ADIG21_max "FPrm_unlatch(440)" VALUE 0x001611BC /* @ECU_Address@FPrm_unlatch@0x021BD6E0@ */ ECIPP_ALIGNMENT_FLOAT32_IEEE 10000000000 Compu_IDENTITY -10000000000 10000000000 PHYS_UNIT "ms" /end CHARACTERISTIC
/begin CHARACTERISTIC FPfu_ADIG21_min "FPrm_unlatch(441)" VALUE 0x001611C0 /* @ECU_Address@FPrm_unlatch@0x021BD6E4@ */ ECIPP_ALIGNMENT_FLOAT32_IEEE 10000000000 Compu_IDENTITY -10000000000 10000000000 PHYS_UNIT "ms" /end CHARACTERISTIC
/begin CHARACTERISTIC FPfu_ADIG22_max "FPrm_unlatch(442)" VALUE 0x001611C4 /* @ECU_Address@FPrm_unlatch@0x021BD6E8@ */ ECIPP_ALIGNMENT_FLOAT32_IEEE 10000000000 Compu_IDENTITY -10000000000 10000000000 PHYS_UNIT "ms" /end CHARACTERISTIC
/begin CHARACTERISTIC FPfu_ADIG22_min "FPrm_unlatch(443)" VALUE 0x001611C8 /* @ECU_Address@FPrm_unlatch@0x021BD6EC@ */ ECIPP_ALIGNMENT_FLOAT32_IEEE 10000000000 Compu_IDENTITY -10000000000 10000000000 PHYS_UNIT "ms" /end CHARACTERISTIC
/begin CHARACTERISTIC FPfu_ADIG23_max "FPrm_unlatch(444)" VALUE 0x001611CC /* @ECU_Address@FPrm_unlatch@0x021BD6F0@ */ ECIPP_ALIGNMENT_FLOAT32_IEEE 10000000000 Compu_IDENTITY -10000000000 10000000000 PHYS_UNIT "ms" /end CHARACTERISTIC
/begin CHARACTERISTIC FPfu_ADIG23_min "FPrm_unlatch(445)" VALUE 0x001611D0 /* @ECU_Address@FPrm_unlatch@0x021BD6F4@ */ ECIPP_ALIGNMENT_FLOAT32_IEEE 10000000000 Compu_IDENTITY -10000000000 10000000000 PHYS_UNIT "ms" /end CHARACTERISTIC
/begin CHARACTERISTIC FPfu_ADIG24_max "FPrm_unlatch(446)" VALUE 0x001611D4 /* @ECU_Address@FPrm_unlatch@0x021BD6F8@ */ ECIPP_ALIGNMENT_FLOAT32_IEEE 10000000000 Compu_IDENTITY -10000000000 10000000000 PHYS_UNIT "ms" /end CHARACTERISTIC
/begin CHARACTERISTIC FPfu_ADIG24_min "FPrm_unlatch(447)" VALUE 0x001611D8 /* @ECU_Address@FPrm_unlatch@0x021BD6FC@ */ ECIPP_ALIGNMENT_FLOAT32_IEEE 10000000000 Compu_IDENTITY -10000000000 10000000000 PHYS_UNIT "ms" /end CHARACTERISTIC
/begin CHARACTERISTIC FPfu_ADIG25_max "FPrm_unlatch(448)" VALUE 0x001611DC /* @ECU_Address@FPrm_unlatch@0x021BD700@ */ ECIPP_ALIGNMENT_FLOAT32_IEEE 10000000000 Compu_IDENTITY -10000000000 10000000000 PHYS_UNIT "ms" /end CHARACTERISTIC
/begin CHARACTERISTIC FPfu_ADIG25_min "FPrm_unlatch(449)" VALUE 0x001611E0 /* @ECU_Address@FPrm_unlatch@0x021BD704@ */ ECIPP_ALIGNMENT_FLOAT32_IEEE 10000000000 Compu_IDENTITY -10000000000 10000000000 PHYS_UNIT "ms" /end CHARACTERISTIC
/begin CHARACTERISTIC FPfu_ADIG3_max "FPrm_unlatch(169)" VALUE 0x00160D80 /* @ECU_Address@FPrm_unlatch@0x021BD2A4@ */ ECIPP_ALIGNMENT_FLOAT32_IEEE 10000000000 Compu_IDENTITY -10000000000 10000000000 PHYS_UNIT "ms" /end CHARACTERISTIC
/begin CHARACTERISTIC FPfu_ADIG3_min "FPrm_unlatch(170)" VALUE 0x00160D84 /* @ECU_Address@FPrm_unlatch@0x021BD2A8@ */ ECIPP_ALIGNMENT_FLOAT32_IEEE 10000000000 Compu_IDENTITY -10000000000 10000000000 PHYS_UNIT "ms" /end CHARACTERISTIC
/begin CHARACTERISTIC FPfu_ADIG4_max "FPrm_unlatch(246)" VALUE 0x00160EB4 /* @ECU_Address@FPrm_unlatch@0x021BD3D8@ */ ECIPP_ALIGNMENT_FLOAT32_IEEE 10000000000 Compu_IDENTITY -10000000000 10000000000 PHYS_UNIT "ms" /end CHARACTERISTIC
/begin CHARACTERISTIC FPfu_ADIG4_min "FPrm_unlatch(247)" VALUE 0x00160EB8 /* @ECU_Address@FPrm_unlatch@0x021BD3DC@ */ ECIPP_ALIGNMENT_FLOAT32_IEEE 10000000000 Compu_IDENTITY -10000000000 10000000000 PHYS_UNIT "ms" /end CHARACTERISTIC
/begin CHARACTERISTIC FPfu_ADIG5_max "FPrm_unlatch(248)" VALUE 0x00160EBC /* @ECU_Address@FPrm_unlatch@0x021BD3E0@ */ ECIPP_ALIGNMENT_FLOAT32_IEEE 10000000000 Compu_IDENTITY -10000000000 10000000000 PHYS_UNIT "ms" /end CHARACTERISTIC
/begin CHARACTERISTIC FPfu_ADIG5_min "FPrm_unlatch(249)" VALUE 0x00160EC0 /* @ECU_Address@FPrm_unlatch@0x021BD3E4@ */ ECIPP_ALIGNMENT_FLOAT32_IEEE 10000000000 Compu_IDENTITY -10000000000 10000000000 PHYS_UNIT "ms" /end CHARACTERISTIC
/begin CHARACTERISTIC FPfu_ADIG6_max "FPrm_unlatch(250)" VALUE 0x00160EC4 /* @ECU_Address@FPrm_unlatch@0x021BD3E8@ */ ECIPP_ALIGNMENT_FLOAT32_IEEE 10000000000 Compu_IDENTITY -10000000000 10000000000 PHYS_UNIT "ms" /end CHARACTERISTIC
/begin CHARACTERISTIC FPfu_ADIG6_min "FPrm_unlatch(251)" VALUE 0x00160EC8 /* @ECU_Address@FPrm_unlatch@0x021BD3EC@ */ ECIPP_ALIGNMENT_FLOAT32_IEEE 10000000000 Compu_IDENTITY -10000000000 10000000000 PHYS_UNIT "ms" /end CHARACTERISTIC
/begin CHARACTERISTIC FPfu_ADIG7_max "FPrm_unlatch(252)" VALUE 0x00160ECC /* @ECU_Address@FPrm_unlatch@0x021BD3F0@ */ ECIPP_ALIGNMENT_FLOAT32_IEEE 10000000000 Compu_IDENTITY -10000000000 10000000000 PHYS_UNIT "ms" /end CHARACTERISTIC
/begin CHARACTERISTIC FPfu_ADIG7_min "FPrm_unlatch(253)" VALUE 0x00160ED0 /* @ECU_Address@FPrm_unlatch@0x021BD3F4@ */ ECIPP_ALIGNMENT_FLOAT32_IEEE 10000000000 Compu_IDENTITY -10000000000 10000000000 PHYS_UNIT "ms" /end CHARACTERISTIC
/begin CHARACTERISTIC FPfu_ADIG8_max "FPrm_unlatch(254)" VALUE 0x00160ED4 /* @ECU_Address@FPrm_unlatch@0x021BD3F8@ */ ECIPP_ALIGNMENT_FLOAT32_IEEE 10000000000 Compu_IDENTITY -10000000000 10000000000 PHYS_UNIT "ms" /end CHARACTERISTIC
/begin CHARACTERISTIC FPfu_ADIG8_min "FPrm_unlatch(255)" VALUE 0x00160ED8 /* @ECU_Address@FPrm_unlatch@0x021BD3FC@ */ ECIPP_ALIGNMENT_FLOAT32_IEEE 10000000000 Compu_IDENTITY -10000000000 10000000000 PHYS_UNIT "ms" /end CHARACTERISTIC
/begin CHARACTERISTIC FPfu_ADIG9_max "FPrm_unlatch(256)" VALUE 0x00160EDC /* @ECU_Address@FPrm_unlatch@0x021BD400@ */ ECIPP_ALIGNMENT_FLOAT32_IEEE 10000000000 Compu_IDENTITY -10000000000 10000000000 PHYS_UNIT "ms" /end CHARACTERISTIC
/begin CHARACTERISTIC FPfu_ADIG9_min "FPrm_unlatch(257)" VALUE 0x00160EE0 /* @ECU_Address@FPrm_unlatch@0x021BD404@ */ ECIPP_ALIGNMENT_FLOAT32_IEEE 10000000000 Compu_IDENTITY -10000000000 10000000000 PHYS_UNIT "ms" /end CHARACTERISTIC
/begin CHARACTERISTIC FPfu_ADloss "FPrm_unlatch(67)" VALUE 0x00160BE8 /* @ECU_Address@FPrm_unlatch@0x021BD10C@ */ ECIPP_ALIGNMENT_FLOAT32_IEEE 10000000000 Compu_IDENTITY -10000000000 10000000000 PHYS_UNIT "ms" /end CHARACTERISTIC
/begin CHARACTERISTIC FPfu_AFILT_dP_high "FPrm_unlatch(562)" VALUE 0x001613A4 /* @ECU_Address@FPrm_unlatch@0x021BD8C8@ */ ECIPP_ALIGNMENT_FLOAT32_IEEE 10000000000 Compu_IDENTITY -10000000000 10000000000 PHYS_UNIT "ms" /end CHARACTERISTIC
/begin CHARACTERISTIC FPfu_AL_hi "FPrm_unlatch(41)" VALUE 0x00160B80 /* @ECU_Address@FPrm_unlatch@0x021BD0A4@ */ ECIPP_ALIGNMENT_FLOAT32_IEEE 10000000000 Compu_IDENTITY -10000000000 10000000000 PHYS_UNIT "updates" /end CHARACTERISTIC
/begin CHARACTERISTIC FPfu_AL_lo "FPrm_unlatch(42)" VALUE 0x00160B84 /* @ECU_Address@FPrm_unlatch@0x021BD0A8@ */ ECIPP_ALIGNMENT_FLOAT32_IEEE 10000000000 Compu_IDENTITY -10000000000 10000000000 PHYS_UNIT "updates" /end CHARACTERISTIC
/begin CHARACTERISTIC FPfu_ALLP_hi "FPrm_unlatch(43)" VALUE 0x00160B88 /* @ECU_Address@FPrm_unlatch@0x021BD0AC@ */ ECIPP_ALIGNMENT_FLOAT32_IEEE 10000000000 Compu_IDENTITY -10000000000 10000000000 PHYS_UNIT "updates" /end CHARACTERISTIC
/begin CHARACTERISTIC FPfu_ALLP_lo "FPrm_unlatch(44)" VALUE 0x00160B8C /* @ECU_Address@FPrm_unlatch@0x021BD0B0@ */ ECIPP_ALIGNMENT_FLOAT32_IEEE 10000000000 Compu_IDENTITY -10000000000 10000000000 PHYS_UNIT "updates" /end CHARACTERISTIC
/begin CHARACTERISTIC FPfu_ALNG_hi "FPrm_unlatch(45)" VALUE 0x00160B90 /* @ECU_Address@FPrm_unlatch@0x021BD0B4@ */ ECIPP_ALIGNMENT_FLOAT32_IEEE 10000000000 Compu_IDENTITY -10000000000 10000000000 PHYS_UNIT "updates" /end CHARACTERISTIC
/begin CHARACTERISTIC FPfu_ALNG_lo "FPrm_unlatch(46)" VALUE 0x00160B94 /* @ECU_Address@FPrm_unlatch@0x021BD0B8@ */ ECIPP_ALIGNMENT_FLOAT32_IEEE 10000000000 Compu_IDENTITY -10000000000 10000000000 PHYS_UNIT "updates" /end CHARACTERISTIC
/begin CHARACTERISTIC FPfu_APD1_max "FPrm_unlatch(75)" VALUE 0x00160C08 /* @ECU_Address@FPrm_unlatch@0x021BD12C@ */ ECIPP_ALIGNMENT_FLOAT32_IEEE 10000000000 Compu_IDENTITY -10000000000 10000000000 PHYS_UNIT "ms" /end CHARACTERISTIC
/begin CHARACTERISTIC FPfu_APD1_min "FPrm_unlatch(76)" VALUE 0x00160C0C /* @ECU_Address@FPrm_unlatch@0x021BD130@ */ ECIPP_ALIGNMENT_FLOAT32_IEEE 10000000000 Compu_IDENTITY -10000000000 10000000000 PHYS_UNIT "ms" /end CHARACTERISTIC
/begin CHARACTERISTIC FPfu_APD2_max "FPrm_unlatch(181)" VALUE 0x00160DB0 /* @ECU_Address@FPrm_unlatch@0x021BD2D4@ */ ECIPP_ALIGNMENT_FLOAT32_IEEE 10000000000 Compu_IDENTITY -10000000000 10000000000 PHYS_UNIT "ms" /end CHARACTERISTIC
/begin CHARACTERISTIC FPfu_APD2_min "FPrm_unlatch(182)" VALUE 0x00160DB4 /* @ECU_Address@FPrm_unlatch@0x021BD2D8@ */ ECIPP_ALIGNMENT_FLOAT32_IEEE 10000000000 Compu_IDENTITY -10000000000 10000000000 PHYS_UNIT "ms" /end CHARACTERISTIC
/begin CHARACTERISTIC FPfu_APD3_max "FPrm_unlatch(183)" VALUE 0x00160DB8 /* @ECU_Address@FPrm_unlatch@0x021BD2DC@ */ ECIPP_ALIGNMENT_FLOAT32_IEEE 10000000000 Compu_IDENTITY -10000000000 10000000000 PHYS_UNIT "ms" /end CHARACTERISTIC
/begin CHARACTERISTIC FPfu_APD3_min "FPrm_unlatch(184)" VALUE 0x00160DBC /* @ECU_Address@FPrm_unlatch@0x021BD2E0@ */ ECIPP_ALIGNMENT_FLOAT32_IEEE 10000000000 Compu_IDENTITY -10000000000 10000000000 PHYS_UNIT "ms" /end CHARACTERISTIC
/begin CHARACTERISTIC FPfu_APS1_max "FPrm_unlatch(362)" VALUE 0x00161084 /* @ECU_Address@FPrm_unlatch@0x021BD5A8@ */ ECIPP_ALIGNMENT_FLOAT32_IEEE 10000000000 Compu_IDENTITY -10000000000 10000000000 PHYS_UNIT "ms" /end CHARACTERISTIC
/begin CHARACTERISTIC FPfu_APS1_min "FPrm_unlatch(363)" VALUE 0x00161088 /* @ECU_Address@FPrm_unlatch@0x021BD5AC@ */ ECIPP_ALIGNMENT_FLOAT32_IEEE 10000000000 Compu_IDENTITY -10000000000 10000000000 PHYS_UNIT "ms" /end CHARACTERISTIC
/begin CHARACTERISTIC FPfu_APS12_OOR "FPrm_unlatch(370)" VALUE 0x001610A4 /* @ECU_Address@FPrm_unlatch@0x021BD5C8@ */ ECIPP_ALIGNMENT_FLOAT32_IEEE 10000000000 Compu_IDENTITY -10000000000 10000000000 PHYS_UNIT "ms" /end CHARACTERISTIC
/begin CHARACTERISTIC FPfu_APS12pct_hi "FPrm_unlatch(366)" VALUE 0x00161094 /* @ECU_Address@FPrm_unlatch@0x021BD5B8@ */ ECIPP_ALIGNMENT_FLOAT32_IEEE 10000000000 Compu_IDENTITY -10000000000 10000000000 PHYS_UNIT "ms" /end CHARACTERISTIC
/begin CHARACTERISTIC FPfu_APS12pct_lo "FPrm_unlatch(367)" VALUE 0x00161098 /* @ECU_Address@FPrm_unlatch@0x021BD5BC@ */ ECIPP_ALIGNMENT_FLOAT32_IEEE 10000000000 Compu_IDENTITY -10000000000 10000000000 PHYS_UNIT "ms" /end CHARACTERISTIC
/begin CHARACTERISTIC FPfu_APS2_max "FPrm_unlatch(364)" VALUE 0x0016108C /* @ECU_Address@FPrm_unlatch@0x021BD5B0@ */ ECIPP_ALIGNMENT_FLOAT32_IEEE 10000000000 Compu_IDENTITY -10000000000 10000000000 PHYS_UNIT "ms" /end CHARACTERISTIC
/begin CHARACTERISTIC FPfu_APS2_min "FPrm_unlatch(365)" VALUE 0x00161090 /* @ECU_Address@FPrm_unlatch@0x021BD5B4@ */ ECIPP_ALIGNMENT_FLOAT32_IEEE 10000000000 Compu_IDENTITY -10000000000 10000000000 PHYS_UNIT "ms" /end CHARACTERISTIC
/begin CHARACTERISTIC FPfu_APSerr_neg "FPrm_unlatch(369)" VALUE 0x001610A0 /* @ECU_Address@FPrm_unlatch@0x021BD5C4@ */ ECIPP_ALIGNMENT_FLOAT32_IEEE 10000000000 Compu_IDENTITY -10000000000 10000000000 PHYS_UNIT "ms" /end CHARACTERISTIC
/begin CHARACTERISTIC FPfu_APSerr_pos "FPrm_unlatch(368)" VALUE 0x0016109C /* @ECU_Address@FPrm_unlatch@0x021BD5C0@ */ ECIPP_ALIGNMENT_FLOAT32_IEEE 10000000000 Compu_IDENTITY -10000000000 10000000000 PHYS_UNIT "ms" /end CHARACTERISTIC
/begin CHARACTERISTIC FPfu_APU1_max "FPrm_unlatch(77)" VALUE 0x00160C10 /* @ECU_Address@FPrm_unlatch@0x021BD134@ */ ECIPP_ALIGNMENT_FLOAT32_IEEE 10000000000 Compu_IDENTITY -10000000000 10000000000 PHYS_UNIT "ms" /end CHARACTERISTIC
/begin CHARACTERISTIC FPfu_APU1_min "FPrm_unlatch(78)" VALUE 0x00160C14 /* @ECU_Address@FPrm_unlatch@0x021BD138@ */ ECIPP_ALIGNMENT_FLOAT32_IEEE 10000000000 Compu_IDENTITY -10000000000 10000000000 PHYS_UNIT "ms" /end CHARACTERISTIC
/begin CHARACTERISTIC FPfu_APU2_max "FPrm_unlatch(79)" VALUE 0x00160C18 /* @ECU_Address@FPrm_unlatch@0x021BD13C@ */ ECIPP_ALIGNMENT_FLOAT32_IEEE 10000000000 Compu_IDENTITY -10000000000 10000000000 PHYS_UNIT "ms" /end CHARACTERISTIC
/begin CHARACTERISTIC FPfu_APU2_min "FPrm_unlatch(80)" VALUE 0x00160C1C /* @ECU_Address@FPrm_unlatch@0x021BD140@ */ ECIPP_ALIGNMENT_FLOAT32_IEEE 10000000000 Compu_IDENTITY -10000000000 10000000000 PHYS_UNIT "ms" /end CHARACTERISTIC
/begin CHARACTERISTIC FPfu_APU3_max "FPrm_unlatch(157)" VALUE 0x00160D50 /* @ECU_Address@FPrm_unlatch@0x021BD274@ */ ECIPP_ALIGNMENT_FLOAT32_IEEE 10000000000 Compu_IDENTITY -10000000000 10000000000 PHYS_UNIT "ms" /end CHARACTERISTIC
/begin CHARACTERISTIC FPfu_APU3_min "FPrm_unlatch(158)" VALUE 0x00160D54 /* @ECU_Address@FPrm_unlatch@0x021BD278@ */ ECIPP_ALIGNMENT_FLOAT32_IEEE 10000000000 Compu_IDENTITY -10000000000 10000000000 PHYS_UNIT "ms" /end CHARACTERISTIC
/begin CHARACTERISTIC FPfu_APUD1_max "FPrm_unlatch(159)" VALUE 0x00160D58 /* @ECU_Address@FPrm_unlatch@0x021BD27C@ */ ECIPP_ALIGNMENT_FLOAT32_IEEE 10000000000 Compu_IDENTITY -10000000000 10000000000 PHYS_UNIT "ms" /end CHARACTERISTIC
/begin CHARACTERISTIC FPfu_APUD1_min "FPrm_unlatch(160)" VALUE 0x00160D5C /* @ECU_Address@FPrm_unlatch@0x021BD280@ */ ECIPP_ALIGNMENT_FLOAT32_IEEE 10000000000 Compu_IDENTITY -10000000000 10000000000 PHYS_UNIT "ms" /end CHARACTERISTIC
/begin CHARACTERISTIC FPfu_APUD10_max "FPrm_unlatch(270)" VALUE 0x00160F14 /* @ECU_Address@FPrm_unlatch@0x021BD438@ */ ECIPP_ALIGNMENT_FLOAT32_IEEE 10000000000 Compu_IDENTITY -10000000000 10000000000 PHYS_UNIT "ms" /end CHARACTERISTIC
/begin CHARACTERISTIC FPfu_APUD10_min "FPrm_unlatch(271)" VALUE 0x00160F18 /* @ECU_Address@FPrm_unlatch@0x021BD43C@ */ ECIPP_ALIGNMENT_FLOAT32_IEEE 10000000000 Compu_IDENTITY -10000000000 10000000000 PHYS_UNIT "ms" /end CHARACTERISTIC
/begin CHARACTERISTIC FPfu_APUD11_max "FPrm_unlatch(272)" VALUE 0x00160F1C /* @ECU_Address@FPrm_unlatch@0x021BD440@ */ ECIPP_ALIGNMENT_FLOAT32_IEEE 10000000000 Compu_IDENTITY -10000000000 10000000000 PHYS_UNIT "ms" /end CHARACTERISTIC
/begin CHARACTERISTIC FPfu_APUD11_min "FPrm_unlatch(273)" VALUE 0x00160F20 /* @ECU_Address@FPrm_unlatch@0x021BD444@ */ ECIPP_ALIGNMENT_FLOAT32_IEEE 10000000000 Compu_IDENTITY -10000000000 10000000000 PHYS_UNIT "ms" /end CHARACTERISTIC
/begin CHARACTERISTIC FPfu_APUD12_max "FPrm_unlatch(274)" VALUE 0x00160F24 /* @ECU_Address@FPrm_unlatch@0x021BD448@ */ ECIPP_ALIGNMENT_FLOAT32_IEEE 10000000000 Compu_IDENTITY -10000000000 10000000000 PHYS_UNIT "ms" /end CHARACTERISTIC
/begin GROUP ADIG15_min_EC_Fault "AUX digital 15 low voltage"
 /begin REF_CHARACTERISTIC FCdc4_ADIG15_min FCdtc_ADIG15_min FCfmi_ADIG15_min FCftb_ADIG15_min FCspn_ADIG15_min FPfl_ADIG15_min FPfu_ADIG15_min FPnd_ADIG15_min FPsvr_ADIG15_min FPsw_ext1_ADIG15_min FPsw_ADIG15_min /end REF_CHARACTERISTIC
/end GROUP
/begin GROUP ADIG16_max_EC_Fault "AUX digital 16 high voltage"
 /begin REF_CHARACTERISTIC FCdc4_ADIG16_max FCdtc_ADIG16_max FCfmi_ADIG16_max FCftb_ADIG16_max FCspn_ADIG16_max FPfl_ADIG16_max FPfu_ADIG16_max FPnd_ADIG16_max FPsvr_ADIG16_max FPsw_ext1_ADIG16_max FPsw_ADIG16_max /end REF_CHARACTERISTIC
/end GROUP
/begin GROUP ADIG16_min_EC_Fault "AUX digital 16 low voltage"
 /begin REF_CHARACTERISTIC FCdc4_ADIG16_min FCdtc_ADIG16_min FCfmi_ADIG16_min FCftb_ADIG16_min FCspn_ADIG16_min FPfl_ADIG16_min FPfu_ADIG16_min FPnd_ADIG16_min FPsvr_ADIG16_min FPsw_ext1_ADIG16_min FPsw_ADIG16_min /end REF_CHARACTERISTIC
/end GROUP
/begin GROUP ADIG17_max_EC_Fault "AUX digital 17 high voltage"
 /begin REF_CHARACTERISTIC FCdc4_ADIG17_max FCdtc_ADIG17_max FCfmi_ADIG17_max FCftb_ADIG17_max FCspn_ADIG17_max FPfl_ADIG17_max FPfu_ADIG17_max FPnd_ADIG17_max FPsvr_ADIG17_max FPsw_ext1_ADIG17_max FPsw_ADIG17_max /end REF_CHARACTERISTIC
/end GROUP
/begin GROUP ADIG17_min_EC_Fault "AUX digital 17 low voltage"
 /begin REF_CHARACTERISTIC FCdc4_ADIG17_min FCdtc_ADIG17_min FCfmi_ADIG17_min FCftb_ADIG17_min FCspn_ADIG17_min FPfl_ADIG17_min FPfu_ADIG17_min FPnd_ADIG17_min FPsvr_ADIG17_min FPsw_ext1_ADIG17_min FPsw_ADIG17_min /end REF_CHARACTERISTIC
/end GROUP
/begin GROUP ADIG18_max_EC_Fault "AUX digital 18 high voltage"
 /begin REF_CHARACTERISTIC FCdc4_ADIG18_max FCdtc_ADIG18_max FCfmi_ADIG18_max FCftb_ADIG18_max FCspn_ADIG18_max FPfl_ADIG18_max FPfu_ADIG18_max FPnd_ADIG18_max FPsvr_ADIG18_max FPsw_ext1_ADIG18_max FPsw_ADIG18_max /end REF_CHARACTERISTIC
/end GROUP
/begin GROUP ADIG18_min_EC_Fault "AUX digital 18 low voltage"
 /begin REF_CHARACTERISTIC FCdc4_ADIG18_min FCdtc_ADIG18_min FCfmi_ADIG18_min FCftb_ADIG18_min FCspn_ADIG18_min FPfl_ADIG18_min FPfu_ADIG18_min FPnd_ADIG18_min FPsvr_ADIG18_min FPsw_ext1_ADIG18_min FPsw_ADIG18_min /end REF_CHARACTERISTIC
/end GROUP
/begin GROUP ADIG19_max_EC_Fault "AUX digital 19 high voltage"
 /begin REF_CHARACTERISTIC FCdc4_ADIG19_max FCdtc_ADIG19_max FCfmi_ADIG19_max FCftb_ADIG19_max FCspn_ADIG19_max FPfl_ADIG19_max FPfu_ADIG19_max FPnd_ADIG19_max FPsvr_ADIG19_max FPsw_ext1_ADIG19_max FPsw_ADIG19_max /end REF_CHARACTERISTIC
/end GROUP
/begin GROUP ADIG19_min_EC_Fault "AUX digital 19 low voltage"
 /begin REF_CHARACTERISTIC FCdc4_ADIG19_min FCdtc_ADIG19_min FCfmi_ADIG19_min FCftb_ADIG19_min FCspn_ADIG19_min FPfl_ADIG19_min FPfu_ADIG19_min FPnd_ADIG19_min FPsvr_ADIG19_min FPsw_ext1_ADIG19_min FPsw_ADIG19_min /end REF_CHARACTERISTIC
/end GROUP
/begin GROUP ADIG2_max_EC_Fault "AUX digital 2 high voltage"
 /begin REF_CHARACTERISTIC FCdc4_ADIG2_max FCdtc_ADIG2_max FCfmi_ADIG2_max FCftb_ADIG2_max FCspn_ADIG2_max FPfl_ADIG2_max FPfu_ADIG2_max FPnd_ADIG2_max FPsvr_ADIG2_max FPsw_ext1_ADIG2_max FPsw_ADIG2_max /end REF_CHARACTERISTIC
/end GROUP
/begin GROUP ADIG2_min_EC_Fault "AUX digital 2 low voltage"
 /begin REF_CHARACTERISTIC FCdc4_ADIG2_min FCdtc_ADIG2_min FCfmi_ADIG2_min FCftb_ADIG2_min FCspn_ADIG2_min FPfl_ADIG2_min FPfu_ADIG2_min FPnd_ADIG2_min FPsvr_ADIG2_min FPsw_ext1_ADIG2_min FPsw_ADIG2_min /end REF_CHARACTERISTIC
/end GROUP
/begin GROUP ADIG20_max_EC_Fault "AUX digital 20 high voltage"
 /begin REF_CHARACTERISTIC FCdc4_ADIG20_max FCdtc_ADIG20_max FCfmi_ADIG20_max FCftb_ADIG20_max FCspn_ADIG20_max FPfl_ADIG20_max FPfu_ADIG20_max FPnd_ADIG20_max FPsvr_ADIG20_max FPsw_ext1_ADIG20_max FPsw_ADIG20_max /end REF_CHARACTERISTIC
/end GROUP
/begin GROUP ADIG20_min_EC_Fault "AUX digital 20 low voltage"
 /begin REF_CHARACTERISTIC FCdc4_ADIG20_min FCdtc_ADIG20_min FCfmi_ADIG20_min FCftb_ADIG20_min FCspn_ADIG20_min FPfl_ADIG20_min FPfu_ADIG20_min FPnd_ADIG20_min FPsvr_ADIG20_min FPsw_ext1_ADIG20_min FPsw_ADIG20_min /end REF_CHARACTERISTIC
/end GROUP
/begin GROUP ADIG21_max_EC_Fault "AUX digital 21 high voltage"
 /begin REF_CHARACTERISTIC FCdc4_ADIG21_max FCdtc_ADIG21_max FCfmi_ADIG21_max FCftb_ADIG21_max FCspn_ADIG21_max FPfl_ADIG21_max FPfu_ADIG21_max FPnd_ADIG21_max FPsvr_ADIG21_max FPsw_ext1_ADIG21_max FPsw_ADIG21_max /end REF_CHARACTERISTIC
/end GROUP
/begin GROUP ADIG21_min_EC_Fault "AUX digital 21 low voltage"
 /begin REF_CHARACTERISTIC FCdc4_ADIG21_min FCdtc_ADIG21_min FCfmi_ADIG21_min FCftb_ADIG21_min FCspn_ADIG21_min FPfl_ADIG21_min FPfu_ADIG21_min FPnd_ADIG21_min FPsvr_ADIG21_min FPsw_ext1_ADIG21_min FPsw_ADIG21_min /end REF_CHARACTERISTIC
/end GROUP
/begin GROUP ADIG22_max_EC_Fault "AUX digital 22 high voltage"
 /begin REF_CHARACTERISTIC FCdc4_ADIG22_max FCdtc_ADIG22_max FCfmi_ADIG22_max FCftb_ADIG22_max FCspn_ADIG22_max FPfl_ADIG22_max FPfu_ADIG22_max FPnd_ADIG22_max FPsvr_ADIG22_max FPsw_ext1_ADIG22_max FPsw_ADIG22_max /end REF_CHARACTERISTIC
/end GROUP
/begin GROUP ADIG22_min_EC_Fault "AUX digital 22 low voltage"
 /begin REF_CHARACTERISTIC FCdc4_ADIG22_min FCdtc_ADIG22_min FCfmi_ADIG22_min FCftb_ADIG22_min FCspn_ADIG22_min FPfl_ADIG22_min FPfu_ADIG22_min FPnd_ADIG22_min FPsvr_ADIG22_min FPsw_ext1_ADIG22_min FPsw_ADIG22_min /end REF_CHARACTERISTIC
/end GROUP
/begin GROUP ADIG23_max_EC_Fault "AUX digital 23 high voltage"
 /begin REF_CHARACTERISTIC FCdc4_ADIG23_max FCdtc_ADIG23_max FCfmi_ADIG23_max FCftb_ADIG23_max FCspn_ADIG23_max FPfl_ADIG23_max FPfu_ADIG23_max FPnd_ADIG23_max FPsvr_ADIG23_max FPsw_ext1_ADIG23_max FPsw_ADIG23_max /end REF_CHARACTERISTIC
/end GROUP
/begin GROUP ADIG23_min_EC_Fault "AUX digital 23 low voltage"
 /begin REF_CHARACTERISTIC FCdc4_ADIG23_min FCdtc_ADIG23_min FCfmi_ADIG23_min FCftb_ADIG23_min FCspn_ADIG23_min FPfl_ADIG23_min FPfu_ADIG23_min FPnd_ADIG23_min FPsvr_ADIG23_min FPsw_ext1_ADIG23_min FPsw_ADIG23_min /end REF_CHARACTERISTIC
/end GROUP
/begin GROUP ADIG24_max_EC_Fault "AUX digital 24 high voltage"
 /begin REF_CHARACTERISTIC FCdc4_ADIG24_max FCdtc_ADIG24_max FCfmi_ADIG24_max FCftb_ADIG24_max FCspn_ADIG24_max FPfl_ADIG24_max FPfu_ADIG24_max FPnd_ADIG24_max FPsvr_ADIG24_max FPsw_ext1_ADIG24_max FPsw_ADIG24_max /end REF_CHARACTERISTIC
/end GROUP
/begin GROUP ADIG24_min_EC_Fault "AUX digital 24 low voltage"
 /begin REF_CHARACTERISTIC FCdc4_ADIG24_min FCdtc_ADIG24_min FCfmi_ADIG24_min FCftb_ADIG24_min FCspn_ADIG24_min FPfl_ADIG24_min FPfu_ADIG24_min FPnd_ADIG24_min FPsvr_ADIG24_min FPsw_ext1_ADIG24_min FPsw_ADIG24_min /end REF_CHARACTERISTIC
/end GROUP
/begin GROUP ADIG25_max_EC_Fault "AUX digital 25 high voltage"
 /begin REF_CHARACTERISTIC FCdc4_ADIG25_max FCdtc_ADIG25_max FCfmi_ADIG25_max FCftb_ADIG25_max FCspn_ADIG25_max FPfl_ADIG25_max FPfu_ADIG25_max FPnd_ADIG25_max FPsvr_ADIG25_max FPsw_ext1_ADIG25_max FPsw_ADIG25_max /end REF_CHARACTERISTIC
/end GROUP
/begin GROUP ADIG25_min_EC_Fault "AUX digital 25 low voltage"
 /begin REF_CHARACTERISTIC FCdc4_ADIG25_min FCdtc_ADIG25_min FCfmi_ADIG25_min FCftb_ADIG25_min FCspn_ADIG25_min FPfl_ADIG25_min FPfu_ADIG25_min FPnd_ADIG25_min FPsvr_ADIG25_min FPsw_ext1_ADIG25_min FPsw_ADIG25_min /end REF_CHARACTERISTIC
/end GROUP
/begin GROUP ADIG3_max_EC_Fault "AUX digital 3 high voltage"
 /begin REF_CHARACTERISTIC FCdc4_ADIG3_max FCdtc_ADIG3_max FCfmi_ADIG3_max FCftb_ADIG3_max FCspn_ADIG3_max FPfl_ADIG3_max FPfu_ADIG3_max FPnd_ADIG3_max FPsvr_ADIG3_max FPsw_ext1_ADIG3_max FPsw_ADIG3_max /end REF_CHARACTERISTIC
/end GROUP
/begin GROUP ADIG3_min_EC_Fault "AUX digital 3 low voltage"
 /begin REF_CHARACTERISTIC FCdc4_ADIG3_min FCdtc_ADIG3_min FCfmi_ADIG3_min FCftb_ADIG3_min FCspn_ADIG3_min FPfl_ADIG3_min FPfu_ADIG3_min FPnd_ADIG3_min FPsvr_ADIG3_min FPsw_ext1_ADIG3_min FPsw_ADIG3_min /end REF_CHARACTERISTIC
/end GROUP
/begin GROUP ADIG4_max_EC_Fault "AUX digital 4 high voltage"
 /begin REF_CHARACTERISTIC FCdc4_ADIG4_max FCdtc_ADIG4_max FCfmi_ADIG4_max FCftb_ADIG4_max FCspn_ADIG4_max FPfl_ADIG4_max FPfu_ADIG4_max FPnd_ADIG4_max FPsvr_ADIG4_max FPsw_ext1_ADIG4_max FPsw_ADIG4_max /end REF_CHARACTERISTIC
/end GROUP
/begin GROUP ADIG4_min_EC_Fault "AUX digital 4 low voltage"
 /begin REF_CHARACTERISTIC FCdc4_ADIG4_min FCdtc_ADIG4_min FCfmi_ADIG4_min FCftb_ADIG4_min FCspn_ADIG4_min FPfl_ADIG4_min FPfu_ADIG4_min FPnd_ADIG4_min FPsvr_ADIG4_min FPsw_ext1_ADIG4_min FPsw_ADIG4_min /end REF_CHARACTERISTIC
/end GROUP
/begin GROUP ADIG5_max_EC_Fault "AUX digital 5 high voltage"
 /begin REF_CHARACTERISTIC FCdc4_ADIG5_max FCdtc_ADIG5_max FCfmi_ADIG5_max FCftb_ADIG5_max FCspn_ADIG5_max FPfl_ADIG5_max FPfu_ADIG5_max FPnd_ADIG5_max FPsvr_ADIG5_max FPsw_ext1_ADIG5_max FPsw_ADIG5_max /end REF_CHARACTERISTIC
/end GROUP
/begin GROUP ADIG5_min_EC_Fault "AUX digital 5 low voltage"
 /begin REF_CHARACTERISTIC FCdc4_ADIG5_min FCdtc_ADIG5_min FCfmi_ADIG5_min FCftb_ADIG5_min FCspn_ADIG5_min FPfl_ADIG5_min FPfu_ADIG5_min FPnd_ADIG5_min FPsvr_ADIG5_min FPsw_ext1_ADIG5_min FPsw_ADIG5_min /end REF_CHARACTERISTIC
/end GROUP
/begin GROUP ADIG6_max_EC_Fault "AUX digital 6 high voltage"
 /begin REF_CHARACTERISTIC FCdc4_ADIG6_max FCdtc_ADIG6_max FCfmi_ADIG6_max FCftb_ADIG6_max FCspn_ADIG6_max FPfl_ADIG6_max FPfu_ADIG6_max FPnd_ADIG6_max FPsvr_ADIG6_max FPsw_ext1_ADIG6_max FPsw_ADIG6_max /end REF_CHARACTERISTIC
/end GROUP
/begin GROUP ADIG6_min_EC_Fault "AUX digital 6 low voltage"
 /begin REF_CHARACTERISTIC FCdc4_ADIG6_min FCdtc_ADIG6_min FCfmi_ADIG6_min FCftb_ADIG6_min FCspn_ADIG6_min FPfl_ADIG6_min FPfu_ADIG6_min FPnd_ADIG6_min FPsvr_ADIG6_min FPsw_ext1_ADIG6_min FPsw_ADIG6_min /end REF_CHARACTERISTIC
/end GROUP
/begin GROUP ADIG7_max_EC_Fault "AUX digital 7 high voltage"
 /begin REF_CHARACTERISTIC FCdc4_ADIG7_max FCdtc_ADIG7_max FCfmi_ADIG7_max FCftb_ADIG7_max FCspn_ADIG7_max FPfl_ADIG7_max FPfu_ADIG7_max FPnd_ADIG7_max FPsvr_ADIG7_max FPsw_ext1_ADIG7_max FPsw_ADIG7_max /end REF_CHARACTERISTIC
/end GROUP
/begin GROUP ADIG7_min_EC_Fault "AUX digital 7 low voltage"
 /begin REF_CHARACTERISTIC FCdc4_ADIG7_min FCdtc_ADIG7_min FCfmi_ADIG7_min FCftb_ADIG7_min FCspn_ADIG7_min FPfl_ADIG7_min FPfu_ADIG7_min FPnd_ADIG7_min FPsvr_ADIG7_min FPsw_ext1_ADIG7_min FPsw_ADIG7_min /end REF_CHARACTERISTIC
/end GROUP
/begin GROUP ADIG8_max_EC_Fault "AUX digital 8 high voltage"
 /begin REF_CHARACTERISTIC FCdc4_ADIG8_max FCdtc_ADIG8_max FCfmi_ADIG8_max FCftb_ADIG8_max FCspn_ADIG8_max FPfl_ADIG8_max FPfu_ADIG8_max FPnd_ADIG8_max FPsvr_ADIG8_max FPsw_ext1_ADIG8_max FPsw_ADIG8_max /end REF_CHARACTERISTIC
/end GROUP
/begin GROUP ADIG8_min_EC_Fault "AUX digital 8 low voltage"
 /begin REF_CHARACTERISTIC FCdc4_ADIG8_min FCdtc_ADIG8_min FCfmi_ADIG8_min FCftb_ADIG8_min FCspn_ADIG8_min FPfl_ADIG8_min FPfu_ADIG8_min FPnd_ADIG8_min FPsvr_ADIG8_min FPsw_ext1_ADIG8_min FPsw_ADIG8_min /end REF_CHARACTERISTIC
/end GROUP
/begin GROUP ADIG9_max_EC_Fault "AUX digital 9 high voltage"
 /begin REF_CHARACTERISTIC FCdc4_ADIG9_max FCdtc_ADIG9_max FCfmi_ADIG9_max FCftb_ADIG9_max FCspn_ADIG9_max FPfl_ADIG9_max FPfu_ADIG9_max FPnd_ADIG9_max FPsvr_ADIG9_max FPsw_ext1_ADIG9_max FPsw_ADIG9_max /end REF_CHARACTERISTIC
/end GROUP
/begin GROUP ADIG9_min_EC_Fault "AUX digital 9 low voltage"
 /begin REF_CHARACTERISTIC FCdc4_ADIG9_min FCdtc_ADIG9_min FCfmi_ADIG9_min FCftb_ADIG9_min FCspn_ADIG9_min FPfl_ADIG9_min FPfu_ADIG9_min FPnd_ADIG9_min FPsvr_ADIG9_min FPsw_ext1_ADIG9_min FPsw_ADIG9_min /end REF_CHARACTERISTIC
/end GROUP
/begin GROUP ADloss_EC_Fault "A/D loss"
 /begin REF_CHARACTERISTIC FCdc4_ADloss FCdtc_ADloss FCfmi_ADloss FCftb_ADloss FCspn_ADloss FPfl_ADloss FPfu_ADloss FPnd_ADloss FPsvr_ADloss FPsw_ext1_ADloss FPsw_ADloss /end REF_CHARACTERISTIC
/end GROUP
/begin GROUP AFILT_dP_high_EC_Fault "Air filter differential pressure high"
 /begin REF_CHARACTERISTIC FCdc4_AFILT_dP_high FCdtc_AFILT_dP_high FCfmi_AFILT_dP_high FCftb_AFILT_dP_high FCspn_AFILT_dP_high FPfl_AFILT_dP_high FPfu_AFILT_dP_high FPnd_AFILT_dP_high FPsvr_AFILT_dP_high FPsw_ext1_AFILT_dP_high FPsw_AFILT_dP_high /end REF_CHARACTERISTIC
/end GROUP
/begin GROUP AL_hi_EC_Fault "AL high gasoline bank1"
 /begin REF_CHARACTERISTIC FCdc4_AL_hi FCdtc_AL_hi FCfmi_AL_hi FCftb_AL_hi FCspn_AL_hi FPfl_AL_hi FPfu_AL_hi FPnd_AL_hi FPsvr_AL_hi FPsw_ext1_AL_hi FPsw_AL_hi /end REF_CHARACTERISTIC
/end GROUP
/begin GROUP AL_lo_EC_Fault "AL low gasoline bank1"
 /begin REF_CHARACTERISTIC FCdc4_AL_lo FCdtc_AL_lo FCfmi_AL_lo FCftb_AL_lo FCspn_AL_lo FPfl_AL_lo FPfu_AL_lo FPnd_AL_lo FPsvr_AL_lo FPsw_ext1_AL_lo FPsw_AL_lo /end REF_CHARACTERISTIC
/end GROUP
/begin GROUP ALLP_hi_EC_Fault "AL high LPG"
 /begin REF_CHARACTERISTIC FCdc4_ALLP_hi FCdtc_ALLP_hi FCfmi_ALLP_hi FCftb_ALLP_hi FCspn_ALLP_hi FPfl_ALLP_hi FPfu_ALLP_hi FPnd_ALLP_hi FPsvr_ALLP_hi FPsw_ext1_ALLP_hi FPsw_ALLP_hi /end REF_CHARACTERISTIC
/end GROUP
/begin GROUP ALLP_lo_EC_Fault "AL low LPG"
 /begin REF_CHARACTERISTIC FCdc4_ALLP_lo FCdtc_ALLP_lo FCfmi_ALLP_lo FCftb_ALLP_lo FCspn_ALLP_lo FPfl_ALLP_lo FPfu_ALLP_lo FPnd_ALLP_lo FPsvr_ALLP_lo FPsw_ext1_ALLP_lo FPsw_ALLP_lo /end REF_CHARACTERISTIC
/end GROUP
/begin GROUP ALNG_hi_EC_Fault "AL high NG"
 /begin REF_CHARACTERISTIC FCdc4_ALNG_hi FCdtc_ALNG_hi FCfmi_ALNG_hi FCftb_ALNG_hi FCspn_ALNG_hi FPfl_ALNG_hi FPfu_ALNG_hi FPnd_ALNG_hi FPsvr_ALNG_hi FPsw_ext1_ALNG_hi FPsw_ALNG_hi /end REF_CHARACTERISTIC
/end GROUP
/begin GROUP ALNG_lo_EC_Fault "AL low NG"
 /begin REF_CHARACTERISTIC FCdc4_ALNG_lo FCdtc_ALNG_lo FCfmi_ALNG_lo FCftb_ALNG_lo FCspn_ALNG_lo FPfl_ALNG_lo FPfu_ALNG_lo FPnd_ALNG_lo FPsvr_ALNG_lo FPsw_ext1_ALNG_lo FPsw_ALNG_lo /end REF_CHARACTERISTIC
/end GROUP
/begin GROUP APD1_max_EC_Fault "AUX analog Pull-Down 1 high voltage"
 /begin REF_CHARACTERISTIC FCdc4_APD1_max FCdtc_APD1_max FCfmi_APD1_max FCftb_APD1_max FCspn_APD1_max FPfl_APD1_max FPfu_APD1_max FPnd_APD1_max FPsvr_APD1_max FPsw_ext1_APD1_max FPsw_APD1_max /end REF_CHARACTERISTIC
/end GROUP
/begin GROUP APD1_min_EC_Fault "AUX analog Pull-Down 1 low voltage"
 /begin REF_CHARACTERISTIC FCdc4_APD1_min FCdtc_APD1_min FCfmi_APD1_min FCftb_APD1_min FCspn_APD1_min FPfl_APD1_min FPfu_APD1_min FPnd_APD1_min FPsvr_APD1_min FPsw_ext1_APD1_min FPsw_APD1_min /end REF_CHARACTERISTIC
/end GROUP
/begin GROUP APD2_max_EC_Fault "AUX analog Pull-Down 2 high voltage"
 /begin REF_CHARACTERISTIC FCdc4_APD2_max FCdtc_APD2_max FCfmi_APD2_max FCftb_APD2_max FCspn_APD2_max FPfl_APD2_max FPfu_APD2_max FPnd_APD2_max FPsvr_APD2_max FPsw_ext1_APD2_max FPsw_APD2_max /end REF_CHARACTERISTIC
/end GROUP
/begin GROUP APD2_min_EC_Fault "AUX analog Pull-Down 2 low voltage"
 /begin REF_CHARACTERISTIC FCdc4_APD2_min FCdtc_APD2_min FCfmi_APD2_min FCftb_APD2_min FCspn_APD2_min FPfl_APD2_min FPfu_APD2_min FPnd_APD2_min FPsvr_APD2_min FPsw_ext1_APD2_min FPsw_APD2_min /end REF_CHARACTERISTIC
/end GROUP
/begin GROUP APD3_max_EC_Fault "AUX analog Pull-Down 3 high voltage"
 /begin REF_CHARACTERISTIC FCdc4_APD3_max FCdtc_APD3_max FCfmi_APD3_max FCftb_APD3_max FCspn_APD3_max FPfl_APD3_max FPfu_APD3_max FPnd_APD3_max FPsvr_APD3_max FPsw_ext1_APD3_max FPsw_APD3_max /end REF_CHARACTERISTIC
/end GROUP
/begin GROUP APD3_min_EC_Fault "AUX analog Pull-Down 3 low voltage"
 /begin REF_CHARACTERISTIC FCdc4_APD3_min FCdtc_APD3_min FCfmi_APD3_min FCftb_APD3_min FCspn_APD3_min FPfl_APD3_min FPfu_APD3_min FPnd_APD3_min FPsvr_APD3_min FPsw_ext1_APD3_min FPsw_APD3_min /end REF_CHARACTERISTIC
/end GROUP
/begin GROUP APS1_max_EC_Fault "APS1 high voltage"
 /begin REF_CHARACTERISTIC FCdc4_APS1_max FCdtc_APS1_max FCfmi_APS1_max FCftb_APS1_max FCspn_APS1_max FPfl_APS1_max FPfu_APS1_max FPnd_APS1_max FPsvr_APS1_max FPsw_ext1_APS1_max FPsw_APS1_max /end REF_CHARACTERISTIC
/end GROUP
/begin GROUP APS1_min_EC_Fault "APS1 low voltage"
 /begin REF_CHARACTERISTIC FCdc4_APS1_min FCdtc_APS1_min FCfmi_APS1_min FCftb_APS1_min FCspn_APS1_min FPfl_APS1_min FPfu_APS1_min FPnd_APS1_min FPsvr_APS1_min FPsw_ext1_APS1_min FPsw_APS1_min /end REF_CHARACTERISTIC
/end GROUP
/begin GROUP APS12_OOR_EC_Fault "APS1/2 simultaneous voltages"
 /begin REF_CHARACTERISTIC FCdc4_APS12_OOR FCdtc_APS12_OOR FCfmi_APS12_OOR FCftb_APS12_OOR FCspn_APS12_OOR FPfl_APS12_OOR FPfu_APS12_OOR FPnd_APS12_OOR FPsvr_APS12_OOR FPsw_ext1_APS12_OOR FPsw_APS12_OOR /end REF_CHARACTERISTIC
/end GROUP
/begin GROUP APS12pct_hi_EC_Fault "APS1 higher than APS2"
 /begin REF_CHARACTERISTIC FCdc4_APS12pct_hi FCdtc_APS12pct_hi FCfmi_APS12pct_hi FCftb_APS12pct_hi FCspn_APS12pct_hi FPfl_APS12pct_hi FPfu_APS12pct_hi FPnd_APS12pct_hi FPsvr_APS12pct_hi FPsw_ext1_APS12pct_hi FPsw_APS12pct_hi /end REF_CHARACTERISTIC
/end GROUP
/begin GROUP APS12pct_lo_EC_Fault "APS1 lower than APS2"
 /begin REF_CHARACTERISTIC FCdc4_APS12pct_lo FCdtc_APS12pct_lo FCfmi_APS12pct_lo FCftb_APS12pct_lo FCspn_APS12pct_lo FPfl_APS12pct_lo FPfu_APS12pct_lo FPnd_APS12pct_lo FPsvr_APS12pct_lo FPsw_ext1_APS12pct_lo FPsw_APS12pct_lo /end REF_CHARACTERISTIC
/end GROUP
/begin GROUP APS2_max_EC_Fault "APS2 high voltage"
 /begin REF_CHARACTERISTIC FCdc4_APS2_max FCdtc_APS2_max FCfmi_APS2_max FCftb_APS2_max FCspn_APS2_max FPfl_APS2_max FPfu_APS2_max FPnd_APS2_max FPsvr_APS2_max FPsw_ext1_APS2_max FPsw_APS2_max /end REF_CHARACTERISTIC
/end GROUP
/begin GROUP APS2_min_EC_Fault "APS2 low voltage"
 /begin REF_CHARACTERISTIC FCdc4_APS2_min FCdtc_APS2_min FCfmi_APS2_min FCftb_APS2_min FCspn_APS2_min FPfl_APS2_min FPfu_APS2_min FPnd_APS2_min FPsvr_APS2_min FPsw_ext1_APS2_min FPsw_APS2_min /end REF_CHARACTERISTIC
/end GROUP
/begin GROUP APSerr_neg_EC_Fault "Unable to reach lower APS"
 /begin REF_CHARACTERISTIC FCdc4_APSerr_neg FCdtc_APSerr_neg FCfmi_APSerr_neg FCftb_APSerr_neg FCspn_APSerr_neg FPfl_APSerr_neg FPfu_APSerr_neg FPnd_APSerr_neg FPsvr_APSerr_neg FPsw_ext1_APSerr_neg FPsw_APSerr_neg /end REF_CHARACTERISTIC
/end GROUP
/begin GROUP APSerr_pos_EC_Fault "Unable to reach higher APS"
 /begin REF_CHARACTERISTIC FCdc4_APSerr_pos FCdtc_APSerr_pos FCfmi_APSerr_pos FCftb_APSerr_pos FCspn_APSerr_pos FPfl_APSerr_pos FPfu_APSerr_pos FPnd_APSerr_pos FPsvr_APSerr_pos FPsw_ext1_APSerr_pos FPsw_APSerr_pos /end REF_CHARACTERISTIC
/end GROUP
/begin GROUP APU1_max_EC_Fault "AUX analog Pull-Up 1 high voltage"
 /begin REF_CHARACTERISTIC FCdc4_APU1_max FCdtc_APU1_max FCfmi_APU1_max FCftb_APU1_max FCspn_APU1_max FPfl_APU1_max FPfu_APU1_max FPnd_APU1_max FPsvr_APU1_max FPsw_ext1_APU1_max FPsw_APU1_max /end REF_CHARACTERISTIC
/end GROUP
/begin GROUP APU1_min_EC_Fault "AUX analog Pull-Up 1 low voltage"
 /begin REF_CHARACTERISTIC FCdc4_APU1_min FCdtc_APU1_min FCfmi_APU1_min FCftb_APU1_min FCspn_APU1_min FPfl_APU1_min FPfu_APU1_min FPnd_APU1_min FPsvr_APU1_min FPsw_ext1_APU1_min FPsw_APU1_min /end REF_CHARACTERISTIC
/end GROUP
/begin GROUP APU2_max_EC_Fault "AUX analog Pull-Up 2 high voltage"
 /begin REF_CHARACTERISTIC FCdc4_APU2_max FCdtc_APU2_max FCfmi_APU2_max FCftb_APU2_max FCspn_APU2_max FPfl_APU2_max FPfu_APU2_max FPnd_APU2_max FPsvr_APU2_max FPsw_ext1_APU2_max FPsw_APU2_max /end REF_CHARACTERISTIC
/end GROUP
/begin GROUP APU2_min_EC_Fault "AUX analog Pull-Up 2 low voltage"
 /begin REF_CHARACTERISTIC FCdc4_APU2_min FCdtc_APU2_min FCfmi_APU2_min FCftb_APU2_min FCspn_APU2_min FPfl_APU2_min FPfu_APU2_min FPnd_APU2_min FPsvr_APU2_min FPsw_ext1_APU2_min FPsw_APU2_min /end REF_CHARACTERISTIC
/end GROUP
/begin GROUP APU3_max_EC_Fault "AUX analog Pull-Up 3 high voltage"
 /begin REF_CHARACTERISTIC FCdc4_APU3_max FCdtc_APU3_max FCfmi_APU3_max FCftb_APU3_max FCspn_APU3_max FPfl_APU3_max FPfu_APU3_max FPnd_APU3_max FPsvr_APU3_max FPsw_ext1_APU3_max FPsw_APU3_max /end REF_CHARACTERISTIC
/end GROUP
/begin GROUP APU3_min_EC_Fault "AUX analog Pull-Up 3 low voltage"
 /begin REF_CHARACTERISTIC FCdc4_APU3_min FCdtc_APU3_min FCfmi_APU3_min FCftb_APU3_min FCspn_APU3_min FPfl_APU3_min FPfu_APU3_min FPnd_APU3_min FPsvr_APU3_min FPsw_ext1_APU3_min FPsw_APU3_min /end REF_CHARACTERISTIC
/end GROUP
/begin GROUP APUD1_max_EC_Fault "AUX analog Pull-Up/Down 1 high voltage"
 /begin REF_CHARACTERISTIC FCdc4_APUD1_max FCdtc_APUD1_max FCfmi_APUD1_max FCftb_APUD1_max FCspn_APUD1_max FPfl_APUD1_max FPfu_APUD1_max FPnd_APUD1_max FPsvr_APUD1_max FPsw_ext1_APUD1_max FPsw_APUD1_max /end REF_CHARACTERISTIC
/end GROUP
/begin GROUP APUD1_min_EC_Fault "AUX analog Pull-Up/Down 1 low voltage"
 /begin REF_CHARACTERISTIC FCdc4_APUD1_min FCdtc_APUD1_min FCfmi_APUD1_min FCftb_APUD1_min FCspn_APUD1_min FPfl_APUD1_min FPfu_APUD1_min FPnd_APUD1_min FPsvr_APUD1_min FPsw_ext1_APUD1_min FPsw_APUD1_min /end REF_CHARACTERISTIC
/end GROUP
/begin GROUP APUD10_max_EC_Fault "AUX analog Pull-Up/Down 10 high voltage"
 /begin REF_CHARACTERISTIC FCdc4_APUD10_max FCdtc_APUD10_max FCfmi_APUD10_max FCftb_APUD10_max FCspn_APUD10_max FPfl_APUD10_max FPfu_APUD10_max FPnd_APUD10_max FPsvr_APUD10_max FPsw_ext1_APUD10_max FPsw_APUD10_max /end REF_CHARACTERISTIC
/end GROUP
/begin GROUP APUD10_min_EC_Fault "AUX analog Pull-Up/Down 10 low voltage"
 /begin REF_CHARACTERISTIC FCdc4_APUD10_min FCdtc_APUD10_min FCfmi_APUD10_min FCftb_APUD10_min FCspn_APUD10_min FPfl_APUD10_min FPfu_APUD10_min FPnd_APUD10_min FPsvr_APUD10_min FPsw_ext1_APUD10_min FPsw_APUD10_min /end REF_CHARACTERISTIC
/end GROUP
/begin GROUP APUD11_max_EC_Fault "AUX analog Pull-Up/Down 11 high voltage"
 /begin REF_CHARACTERISTIC FCdc4_APUD11_max FCdtc_APUD11_max FCfmi_APUD11_max FCftb_APUD11_max FCspn_APUD11_max FPfl_APUD11_max FPfu_APUD11_max FPnd_APUD11_max FPsvr_APUD11_max FPsw_ext1_APUD11_max FPsw_APUD11_max /end REF_CHARACTERISTIC
/end GROUP
/begin GROUP APUD11_min_EC_Fault "AUX analog Pull-Up/Down 11 low voltage"
 /begin REF_CHARACTERISTIC FCdc4_APUD11_min FCdtc_APUD11_min FCfmi_APUD11_min FCftb_APUD11_min FCspn_APUD11_min FPfl_APUD11_min FPfu_APUD11_min FPnd_APUD11_min FPsvr_APUD11_min FPsw_ext1_APUD11_min FPsw_APUD11_min /end REF_CHARACTERISTIC
/end GROUP
/begin GROUP APUD12_max_EC_Fault "AUX analog Pull-Up/Down 12 high voltage"
 /begin REF_CHARACTERISTIC FCdc4_APUD12_max FCdtc_APUD12_max FCfmi_APUD12_max FCftb_APUD12_max FCspn_APUD12_max FPfl_APUD12_max FPfu_APUD12_max FPnd_APUD12_max FPsvr_APUD12_max FPsw_ext1_APUD12_max FPsw_APUD12_max /end REF_CHARACTERISTIC
/end GROUP
/end MODULE
/end PROJECT
