ASAP2_VERSION 1 61
/begin PROJECT Econtrols_4G "4G Test"
/begin HEADER "4G A2L Configuration" PROJECT_NO EControls4G /* config for version control */ VERSION "$Revision: 82130 $:" /* config for version control */ /end HEADER
/begin MODULE EControls_4G_SH2A "EControls 4G"
/begin MOD_COMMON "" DEPOSIT ABSOLUTE BYTE_ORDER MSB_FIRST /end MOD_COMMON
/* Define the Record Layouts */
/begin RECORD_LAYOUT ECIPP_ALIGNMENT_UBYTE FNC_VALUES 1 UBYTE COLUMN_DIR DIRECT /end RECORD_LAYOUT
/begin RECORD_LAYOUT ECIPP_ALIGNMENT_UWORD FNC_VALUES 1 UWORD COLUMN_DIR DIRECT /end RECORD_LAYOUT
/begin RECORD_LAYOUT ECIPP_ALIGNMENT_SWORD FNC_VALUES 1 SWORD COLUMN_DIR DIRECT /end RECORD_LAYOUT
/begin RECORD_LAYOUT ECIPP_Lookup_SWORD AXIS_PTS_X 1 SWORD INDEX_INCR DIRECT /end RECORD_LAYOUT
/begin RECORD_LAYOUT ECIPP_ALIGNMENT_ULONG FNC_VALUES 1 ULONG COLUMN_DIR DIRECT /end RECORD_LAYOUT
/begin RECORD_LAYOUT ECIPP_ALIGNMENT_SLONG FNC_VALUES 1 SLONG COLUMN_DIR DIRECT /end RECORD_LAYOUT
/begin RECORD_LAYOUT ECIPP_ALIGNMENT_FLOAT32_IEEE FNC_VALUES 1 FLOAT32_IEEE COLUMN_DIR DIRECT /end RECORD_LAYOUT
/begin COMPU_METHOD Compu_IDENTITY "Discrete Values " /* Identifier */ IDENTICAL "%.0" /* Format */ "-" /* Units */ /end COMPU_METHOD
/begin MEASUREMENT VEs "VE standard" UWORD Compu_VEs 0 0 0 199.996948242188 ECU_ADDRESS 0x01000098 /end MEASUREMENT
/begin COMPU_METHOD Compu_VEs " " RAT_FUNC "%.1" "%" COEFFS 0 327.68 0 0 0 1 /end COMPU_METHOD
/begin MEASUREMENT m_a_port "m_a_port" UWORD Compu_m_a_port 0 0 0 16383.75 ECU_ADDRESS 0x01000118 /end MEASUREMENT
/begin COMPU_METHOD Compu_m_a_port " " RAT_FUNC "%.0" "mg/intake" COEFFS 0 4 0 0 0 1 /end COMPU_METHOD
/begin MEASUREMENT mdot_a_throttle "mdot_a_throttle" UWORD Compu_mdot_a_throttle 0 0 0 1023.984375 ECU_ADDRESS 0x01000138 /end MEASUREMENT
/begin COMPU_METHOD Compu_mdot_a_throttle " " RAT_FUNC "%.1" "g/sec" COEFFS 0 64 0 0 0 1 /end COMPU_METHOD
/begin MEASUREMENT MAP_est "Throttle estimated MAP" UWORD Compu_MAP_est 0 0 0 255.99609375 ECU_ADDRESS 0x01000300 /end MEASUREMENT
/begin COMPU_METHOD Compu_MAP_est " " RAT_FUNC "%.2" "psia" COEFFS 0 256 0 0 0 1 /end COMPU_METHOD
/begin MEASUREMENT MAPdt_est "Throttle estimated MAPdt" SWORD Compu_MAPdt_est 0 0 -4000 3999.8779296875 ECU_ADDRESS 0x01000308 /end MEASUREMENT
/begin COMPU_METHOD Compu_MAPdt_est " " RAT_FUNC "%.1" "psi/sec" COEFFS 0 8.192 0 0 0 1 /end COMPU_METHOD
/begin CHARACTERISTIC MAT_est_xmin "IAT min contribution (MAT)" VALUE 0x001475cc /* @ECU_Address@MAT_est_xmin@0x01000820@ */ ECIPP_ALIGNMENT_UWORD 100 Compu_MAT_est_xmin 0 99.9984741210938 /end CHARACTERISTIC
/begin COMPU_METHOD Compu_MAT_est_xmin " " RAT_FUNC "%.1" "%" COEFFS 0 655.36 0 0 0 1 /end COMPU_METHOD
/begin CHARACTERISTIC MAT_est_xmax "IAT max contribution (MAT)" VALUE 0x001475ca /* @ECU_Address@MAT_est_xmax@0x01000828@ */ ECIPP_ALIGNMENT_UWORD 100 Compu_MAT_est_xmax 0 99.9984741210938 /end CHARACTERISTIC
/begin COMPU_METHOD Compu_MAT_est_xmax " " RAT_FUNC "%.1" "%" COEFFS 0 655.36 0 0 0 1 /end COMPU_METHOD
/begin CHARACTERISTIC MAT_est_tau "MAT estimation tau" VALUE 0x00147c0c /* @ECU_Address@MAT_est_tau@0x010008C0@ */ ECIPP_ALIGNMENT_UWORD 3277 Compu_MAT_est_tau 0.0045084 3276.8 /end CHARACTERISTIC
/begin COMPU_METHOD Compu_MAT_est_tau " " FORM "%.1" "sec"
 /begin FORMULA "-0.05 / log(1 - (X1 / 65536))" FORMULA_INV "(1 - exp(-0.05/X1)) * 65536" /end FORMULA
/end COMPU_METHOD
/begin CHARACTERISTIC VE_CWT_C "VE_CWT_C" VALUE 0x00147a06 /* @ECU_Address@VE_CWT_C@0x01000978@ */ ECIPP_ALIGNMENT_UWORD 400 Compu_VE_CWT_C 0 399.993896484375 /end CHARACTERISTIC
/begin COMPU_METHOD Compu_VE_CWT_C " " RAT_FUNC "%.2" "% / (g/s fuel)" COEFFS 0 163.84 0 0 0 1 /end COMPU_METHOD
/begin CHARACTERISTIC VE_CWT_tau_idle "VE_CWT_tau_idle" VALUE 0x00147a0a /* @ECU_Address@VE_CWT_tau_idle@0x01000980@ */ ECIPP_ALIGNMENT_UWORD 66 Compu_VE_CWT_tau_idle 0 65.535 /end CHARACTERISTIC
/begin COMPU_METHOD Compu_VE_CWT_tau_idle " " RAT_FUNC "%.3" "seconds" COEFFS 0 1000 0 0 0 1 /end COMPU_METHOD
/begin CHARACTERISTIC VE_CWT_rpm_idle "VE_CWT_rpm_idle" VALUE 0x00147a08 /* @ECU_Address@VE_CWT_rpm_idle@0x01000988@ */ ECIPP_ALIGNMENT_UWORD 65535 Compu_VE_CWT_rpm_idle 0 65535 /end CHARACTERISTIC
/begin COMPU_METHOD Compu_VE_CWT_rpm_idle " " RAT_FUNC "%.0" "rpm" COEFFS 0 1 0 0 0 1 /end COMPU_METHOD
/begin CHARACTERISTIC VE_CWT_max "VE CWT max limit" VALUE 0x00146572 /* @ECU_Address@VE_CWT_max@0x010009C0@ */ ECIPP_ALIGNMENT_SWORD 100 Compu_VE_CWT_max -100 99.9969482421875 /end CHARACTERISTIC
/begin COMPU_METHOD Compu_VE_CWT_max " " RAT_FUNC "%.0" "%" COEFFS 0 327.68 0 0 0 1 /end COMPU_METHOD
/begin CHARACTERISTIC VE_CWT_min "VE CWT min limit" VALUE 0x00146574 /* @ECU_Address@VE_CWT_min@0x010009C8@ */ ECIPP_ALIGNMENT_SWORD 100 Compu_VE_CWT_min -100 99.9969482421875 /end CHARACTERISTIC
/begin COMPU_METHOD Compu_VE_CWT_min " " RAT_FUNC "%.0" "%" COEFFS 0 327.68 0 0 0 1 /end COMPU_METHOD
/begin CHARACTERISTIC CHTc "CHT estimate span" VALUE 0x0014673a /* @ECU_Address@CHTc@0x01000C30@ */ ECIPP_ALIGNMENT_UWORD 1024 Compu_CHTc 0 1023.984375 /end CHARACTERISTIC
/begin COMPU_METHOD Compu_CHTc " " RAT_FUNC "%.1" "deg F" COEFFS 0 64 0 0 0 1 /end COMPU_METHOD
/begin CHARACTERISTIC CHTo "CHT estimate offset" VALUE 0x00146744 /* @ECU_Address@CHTo@0x01000C38@ */ ECIPP_ALIGNMENT_UWORD 1024 Compu_CHTo 0 1023.984375 /end CHARACTERISTIC
/begin COMPU_METHOD Compu_CHTo " " RAT_FUNC "%.1" "deg F" COEFFS 0 64 0 0 0 1 /end COMPU_METHOD
/begin CHARACTERISTIC CHTo_tau "CHT offset start tau" VALUE 0x00147bc6 /* @ECU_Address@CHTo_tau@0x01000C40@ */ ECIPP_ALIGNMENT_UWORD 3277 Compu_CHTo_tau 0.0045084 3276.8 /end CHARACTERISTIC
/begin COMPU_METHOD Compu_CHTo_tau " " FORM "%.3" "seconds"
 /begin FORMULA "-0.05 / log(1 - (X1 / 65536))" FORMULA_INV "(1 - exp(-0.05/X1)) * 65536" /end FORMULA
/end COMPU_METHOD
/begin CHARACTERISTIC CHT_tau "CHT tau" VALUE 0x00147bc4 /* @ECU_Address@CHT_tau@0x01000C48@ */ ECIPP_ALIGNMENT_UWORD 3277 Compu_CHT_tau 0.0045084 3276.8 /end CHARACTERISTIC
/begin COMPU_METHOD Compu_CHT_tau " " FORM "%.3" "seconds"
 /begin FORMULA "-0.05 / log(1 - (X1 / 65536))" FORMULA_INV "(1 - exp(-0.05/X1)) * 65536" /end FORMULA
/end COMPU_METHOD
/begin MEASUREMENT VE_EBP_crct "EBP VE correction" UWORD Compu_VE_EBP_crct 0 0 -100 99.9969482421875 ECU_ADDRESS 0x010012C8 /end MEASUREMENT
/begin COMPU_METHOD Compu_VE_EBP_crct " " RAT_FUNC "%.1" "%" COEFFS 0 327.68 32768 0 0 1 /end COMPU_METHOD
/begin MEASUREMENT VE_MAT_crct "MAT VE correction" UWORD Compu_VE_MAT_crct 0 0 -100 99.9969482421875 ECU_ADDRESS 0x010012D0 /end MEASUREMENT
/begin COMPU_METHOD Compu_VE_MAT_crct " " RAT_FUNC "%.1" "%" COEFFS 0 327.68 32768 0 0 1 /end COMPU_METHOD
/begin MEASUREMENT VE_ECT_crct "ECT VE correction" UWORD Compu_VE_ECT_crct 0 0 -100 99.9969482421875 ECU_ADDRESS 0x010012D8 /end MEASUREMENT
/begin COMPU_METHOD Compu_VE_ECT_crct " " RAT_FUNC "%.1" "%" COEFFS 0 327.68 32768 0 0 1 /end COMPU_METHOD
/begin CHARACTERISTIC SH_def "SH default" VALUE 0x00147f36 /* @ECU_Address@SH_def@0x01001AA8@ */ ECIPP_ALIGNMENT_UBYTE 62 Compu_SH_def 0 62.255859375 /end CHARACTERISTIC
/begin COMPU_METHOD Compu_SH_def " " RAT_FUNC "%.1" "g/kg" COEFFS 0 4.096 0 0 0 1 /end COMPU_METHOD
/begin CHARACTERISTIC AAT_def "AAT default" VALUE 0x00146686 /* @ECU_Address@AAT_def@0x01001AB0@ */ ECIPP_ALIGNMENT_UWORD 564 Compu_AAT_def -460 563.984375 /end CHARACTERISTIC
/begin COMPU_METHOD Compu_AAT_def " " RAT_FUNC "%.1" "deg F" COEFFS 0 64 29440 0 0 1 /end COMPU_METHOD
/begin CHARACTERISTIC EBP_gauge_def "EBP default gauge" VALUE 0x0014678e /* @ECU_Address@EBP_gauge_def@0x01001C80@ */ ECIPP_ALIGNMENT_UWORD 256 Compu_EBP_gauge_def 0 255.99609375 /end CHARACTERISTIC
/begin COMPU_METHOD Compu_EBP_gauge_def " " RAT_FUNC "%.2" "psig" COEFFS 0 256 0 0 0 1 /end COMPU_METHOD
/begin CHARACTERISTIC EBP_est_ena "EBP estimate{EBP_est_ena&0xff=0:Constant gage default}{EBP_est_ena&0xff=1:Exhaust flow rate estimate}{EBP_est_ena&0xff=2:EBP sensor}" VALUE 0x00147d16 /* @ECU_Address@EBP_est_ena@0x01001C90@ */ ECIPP_ALIGNMENT_UBYTE 255 EBP_est_ena_COMPU_VTAB 0 255 BIT_MASK 0xff /end CHARACTERISTIC
/begin COMPU_METHOD EBP_est_ena_COMPU_VTAB "Verbal Table" TAB_VERB "%.0" "list" COMPU_TAB_REF EBP_est_ena_COMPU_VTAB_REF /end COMPU_METHOD
/begin COMPU_VTAB EBP_est_ena_COMPU_VTAB_REF "Verbal Table" TAB_VERB 3 0 "Constant gage default" 1 "Exhaust flow rate estimate" 2 "EBP sensor" DEFAULT_VALUE "UNKNOWN" /end COMPU_VTAB
/begin CHARACTERISTIC EBP_C_exh "EBP flow rate constant" VALUE 0x0014678a /* @ECU_Address@EBP_C_exh@0x01001C98@ */ ECIPP_ALIGNMENT_UWORD 31 Compu_EBP_C_exh 0 30.5171124637127 /end CHARACTERISTIC
/begin COMPU_METHOD Compu_EBP_C_exh " " RAT_FUNC "%.3" "upsig / (l/s)^2" COEFFS 0 2147.483648 0 0 0 1 /end COMPU_METHOD
/begin CHARACTERISTIC RS_present "RoadSpeed input circuit{RS_present&0xff=0:Not Populated}{RS_present&0xff=1:Populated}" VALUE 0x00147f12 /* @ECU_Address@RS_present@0x01002180@ */ ECIPP_ALIGNMENT_UBYTE 255 RS_present_COMPU_VTAB 0 255 BIT_MASK 0xff /end CHARACTERISTIC
/begin COMPU_METHOD RS_present_COMPU_VTAB "Verbal Table" TAB_VERB "%.0" "list" COMPU_TAB_REF RS_present_COMPU_VTAB_REF /end COMPU_METHOD
/begin COMPU_VTAB RS_present_COMPU_VTAB_REF "Verbal Table" TAB_VERB 2 0 "Not Populated" 1 "Populated" DEFAULT_VALUE "UNKNOWN" /end COMPU_VTAB
/begin CHARACTERISTIC key_on_waitalt "Key-on stopped wait - gaseous fuel" VALUE 0x00147b54 /* @ECU_Address@key_on_waitalt@0x01002200@ */ ECIPP_ALIGNMENT_UWORD 66 Compu_key_on_waitalt 0 65.535 /end CHARACTERISTIC
/begin COMPU_METHOD Compu_key_on_waitalt " " RAT_FUNC "%.1" "seconds" COEFFS 0 1000 0 0 0 1 /end COMPU_METHOD
/begin CHARACTERISTIC ALfltG_RPMmin "and RPM >= (Fault Condition:and RPM >=)" VALUE 0x001433C8 /* @ECU_Address@ALfltG_RPMmin@0x010022B8@ */ ECIPP_ALIGNMENT_UWORD 65535 Compu_ALfltG_RPMmin 0 65535 /end CHARACTERISTIC
/begin COMPU_METHOD Compu_ALfltG_RPMmin " " RAT_FUNC "%.0" "rpm" COEFFS 0 1 0 0 0 1 /end COMPU_METHOD
/begin CHARACTERISTIC ALfltG_RPMmax "and RPM <= (Fault Condition:and RPM <=)" VALUE 0x001433C6 /* @ECU_Address@ALfltG_RPMmax@0x010022C0@ */ ECIPP_ALIGNMENT_UWORD 65535 Compu_ALfltG_RPMmax 0 65535 /end CHARACTERISTIC
/begin COMPU_METHOD Compu_ALfltG_RPMmax " " RAT_FUNC "%.0" "rpm" COEFFS 0 1 0 0 0 1 /end COMPU_METHOD
/begin CHARACTERISTIC ALfltP_RPMmin "and RPM >= (Fault Condition:and RPM >=)" VALUE 0x00141910 /* @ECU_Address@ALfltP_RPMmin@0x010022C8@ */ ECIPP_ALIGNMENT_UWORD 65535 Compu_ALfltP_RPMmin 0 65535 /end CHARACTERISTIC
/begin COMPU_METHOD Compu_ALfltP_RPMmin " " RAT_FUNC "%.0" "rpm" COEFFS 0 1 0 0 0 1 /end COMPU_METHOD
/begin CHARACTERISTIC ALfltP_RPMmax "and RPM <= (Fault Condition:and RPM <=)" VALUE 0x0014190E /* @ECU_Address@ALfltP_RPMmax@0x010022D0@ */ ECIPP_ALIGNMENT_UWORD 65535 Compu_ALfltP_RPMmax 0 65535 /end CHARACTERISTIC
/begin COMPU_METHOD Compu_ALfltP_RPMmax " " RAT_FUNC "%.0" "rpm" COEFFS 0 1 0 0 0 1 /end COMPU_METHOD
/begin CHARACTERISTIC ALfltN_RPMmin "and RPM >= (Fault Condition:and RPM >=)" VALUE 0x00142878 /* @ECU_Address@ALfltN_RPMmin@0x010022D8@ */ ECIPP_ALIGNMENT_UWORD 65535 Compu_ALfltN_RPMmin 0 65535 /end CHARACTERISTIC
/begin COMPU_METHOD Compu_ALfltN_RPMmin " " RAT_FUNC "%.0" "rpm" COEFFS 0 1 0 0 0 1 /end COMPU_METHOD
/begin CHARACTERISTIC ALfltN_RPMmax "and RPM <= (Fault Condition:and RPM <=)" VALUE 0x00142876 /* @ECU_Address@ALfltN_RPMmax@0x010022E0@ */ ECIPP_ALIGNMENT_UWORD 65535 Compu_ALfltN_RPMmax 0 65535 /end CHARACTERISTIC
/begin COMPU_METHOD Compu_ALfltN_RPMmax " " RAT_FUNC "%.0" "rpm" COEFFS 0 1 0 0 0 1 /end COMPU_METHOD
/begin CHARACTERISTIC CLfltG_RPMmin "and RPM >= (Fault Condition:and RPM >=)" VALUE 0x001433C0 /* @ECU_Address@CLfltG_RPMmin@0x010022E8@ */ ECIPP_ALIGNMENT_UWORD 65535 Compu_CLfltG_RPMmin 0 65535 /end CHARACTERISTIC
/begin COMPU_METHOD Compu_CLfltG_RPMmin " " RAT_FUNC "%.0" "rpm" COEFFS 0 1 0 0 0 1 /end COMPU_METHOD
/begin CHARACTERISTIC CLfltP_RPMmin "and RPM >= (Fault Condition:and RPM >=)" VALUE 0x00141908 /* @ECU_Address@CLfltP_RPMmin@0x010022F0@ */ ECIPP_ALIGNMENT_UWORD 65535 Compu_CLfltP_RPMmin 0 65535 /end CHARACTERISTIC
/begin COMPU_METHOD Compu_CLfltP_RPMmin " " RAT_FUNC "%.0" "rpm" COEFFS 0 1 0 0 0 1 /end COMPU_METHOD
/begin CHARACTERISTIC CLfltN_RPMmin "and RPM >= (Fault Condition:and RPM >=)" VALUE 0x00142870 /* @ECU_Address@CLfltN_RPMmin@0x010022F8@ */ ECIPP_ALIGNMENT_UWORD 65535 Compu_CLfltN_RPMmin 0 65535 /end CHARACTERISTIC
/begin COMPU_METHOD Compu_CLfltN_RPMmin " " RAT_FUNC "%.0" "rpm" COEFFS 0 1 0 0 0 1 /end COMPU_METHOD
/begin CHARACTERISTIC CLfltG_RPMmax "and RPM <= (Fault Condition:and RPM <=)" VALUE 0x001433BE /* @ECU_Address@CLfltG_RPMmax@0x01002300@ */ ECIPP_ALIGNMENT_UWORD 65535 Compu_CLfltG_RPMmax 0 65535 /end CHARACTERISTIC
/begin COMPU_METHOD Compu_CLfltG_RPMmax " " RAT_FUNC "%.0" "rpm" COEFFS 0 1 0 0 0 1 /end COMPU_METHOD
/begin CHARACTERISTIC CLfltP_RPMmax "and RPM <= (Fault Condition:and RPM <=)" VALUE 0x00141906 /* @ECU_Address@CLfltP_RPMmax@0x01002308@ */ ECIPP_ALIGNMENT_UWORD 65535 Compu_CLfltP_RPMmax 0 65535 /end CHARACTERISTIC
/begin COMPU_METHOD Compu_CLfltP_RPMmax " " RAT_FUNC "%.0" "rpm" COEFFS 0 1 0 0 0 1 /end COMPU_METHOD
/begin CHARACTERISTIC CLfltN_RPMmax "and RPM <= (Fault Condition:and RPM <=)" VALUE 0x0014286E /* @ECU_Address@CLfltN_RPMmax@0x01002310@ */ ECIPP_ALIGNMENT_UWORD 65535 Compu_CLfltN_RPMmax 0 65535 /end CHARACTERISTIC
/begin COMPU_METHOD Compu_CLfltN_RPMmax " " RAT_FUNC "%.0" "rpm" COEFFS 0 1 0 0 0 1 /end COMPU_METHOD
/begin CHARACTERISTIC ALfltG_MAPmin "and MAP >= (Fault Condition:and MAP >=)" VALUE 0x001433CC /* @ECU_Address@ALfltG_MAPmin@0x01002318@ */ ECIPP_ALIGNMENT_UWORD 256 Compu_ALfltG_MAPmin 0 255.99609375 /end CHARACTERISTIC
/begin COMPU_METHOD Compu_ALfltG_MAPmin " " RAT_FUNC "%.2" "psia" COEFFS 0 256 0 0 0 1 /end COMPU_METHOD
/begin CHARACTERISTIC ALfltP_MAPmin "and MAP >= (Fault Condition:and MAP >=)" VALUE 0x00141914 /* @ECU_Address@ALfltP_MAPmin@0x01002320@ */ ECIPP_ALIGNMENT_UWORD 256 Compu_ALfltP_MAPmin 0 255.99609375 /end CHARACTERISTIC
/begin COMPU_METHOD Compu_ALfltP_MAPmin " " RAT_FUNC "%.2" "psia" COEFFS 0 256 0 0 0 1 /end COMPU_METHOD
/begin CHARACTERISTIC ALfltN_MAPmin "and MAP >= (Fault Condition:and MAP >=)" VALUE 0x0014287C /* @ECU_Address@ALfltN_MAPmin@0x01002328@ */ ECIPP_ALIGNMENT_UWORD 256 Compu_ALfltN_MAPmin 0 255.99609375 /end CHARACTERISTIC
/begin COMPU_METHOD Compu_ALfltN_MAPmin " " RAT_FUNC "%.2" "psia" COEFFS 0 256 0 0 0 1 /end COMPU_METHOD
/begin CHARACTERISTIC ALfltG_MAPmax "and MAP <= (Fault Condition:and MAP <=)" VALUE 0x001433CA /* @ECU_Address@ALfltG_MAPmax@0x01002330@ */ ECIPP_ALIGNMENT_UWORD 256 Compu_ALfltG_MAPmax 0 255.99609375 /end CHARACTERISTIC
/begin COMPU_METHOD Compu_ALfltG_MAPmax " " RAT_FUNC "%.2" "psia" COEFFS 0 256 0 0 0 1 /end COMPU_METHOD
/begin CHARACTERISTIC ALfltP_MAPmax "and MAP <= (Fault Condition:and MAP <=)" VALUE 0x00141912 /* @ECU_Address@ALfltP_MAPmax@0x01002338@ */ ECIPP_ALIGNMENT_UWORD 256 Compu_ALfltP_MAPmax 0 255.99609375 /end CHARACTERISTIC
/begin COMPU_METHOD Compu_ALfltP_MAPmax " " RAT_FUNC "%.2" "psia" COEFFS 0 256 0 0 0 1 /end COMPU_METHOD
/begin CHARACTERISTIC ALfltN_MAPmax "and MAP <= (Fault Condition:and MAP <=)" VALUE 0x0014287A /* @ECU_Address@ALfltN_MAPmax@0x01002340@ */ ECIPP_ALIGNMENT_UWORD 256 Compu_ALfltN_MAPmax 0 255.99609375 /end CHARACTERISTIC
/begin COMPU_METHOD Compu_ALfltN_MAPmax " " RAT_FUNC "%.2" "psia" COEFFS 0 256 0 0 0 1 /end COMPU_METHOD
/begin CHARACTERISTIC CLfltG_MAPmin "and MAP >= (Fault Condition:and MAP >=)" VALUE 0x001433C4 /* @ECU_Address@CLfltG_MAPmin@0x01002348@ */ ECIPP_ALIGNMENT_UWORD 256 Compu_CLfltG_MAPmin 0 255.99609375 /end CHARACTERISTIC
/begin COMPU_METHOD Compu_CLfltG_MAPmin " " RAT_FUNC "%.2" "psia" COEFFS 0 256 0 0 0 1 /end COMPU_METHOD
/begin CHARACTERISTIC CLfltP_MAPmin "and MAP >= (Fault Condition:and MAP >=)" VALUE 0x0014190C /* @ECU_Address@CLfltP_MAPmin@0x01002350@ */ ECIPP_ALIGNMENT_UWORD 256 Compu_CLfltP_MAPmin 0 255.99609375 /end CHARACTERISTIC
/begin COMPU_METHOD Compu_CLfltP_MAPmin " " RAT_FUNC "%.2" "psia" COEFFS 0 256 0 0 0 1 /end COMPU_METHOD
/begin CHARACTERISTIC CLfltN_MAPmin "and MAP >= (Fault Condition:and MAP >=)" VALUE 0x00142874 /* @ECU_Address@CLfltN_MAPmin@0x01002358@ */ ECIPP_ALIGNMENT_UWORD 256 Compu_CLfltN_MAPmin 0 255.99609375 /end CHARACTERISTIC
/begin COMPU_METHOD Compu_CLfltN_MAPmin " " RAT_FUNC "%.2" "psia" COEFFS 0 256 0 0 0 1 /end COMPU_METHOD
/begin CHARACTERISTIC CLfltG_MAPmax "and MAP <= (Fault Condition:and MAP <=)" VALUE 0x001433C2 /* @ECU_Address@CLfltG_MAPmax@0x01002360@ */ ECIPP_ALIGNMENT_UWORD 256 Compu_CLfltG_MAPmax 0 255.99609375 /end CHARACTERISTIC
/begin COMPU_METHOD Compu_CLfltG_MAPmax " " RAT_FUNC "%.2" "psia" COEFFS 0 256 0 0 0 1 /end COMPU_METHOD
/begin CHARACTERISTIC CLfltP_MAPmax "and MAP <= (Fault Condition:and MAP <=)" VALUE 0x0014190A /* @ECU_Address@CLfltP_MAPmax@0x01002368@ */ ECIPP_ALIGNMENT_UWORD 256 Compu_CLfltP_MAPmax 0 255.99609375 /end CHARACTERISTIC
/begin COMPU_METHOD Compu_CLfltP_MAPmax " " RAT_FUNC "%.2" "psia" COEFFS 0 256 0 0 0 1 /end COMPU_METHOD
/begin CHARACTERISTIC CLfltN_MAPmax "and MAP <= (Fault Condition:and MAP <=)" VALUE 0x00142872 /* @ECU_Address@CLfltN_MAPmax@0x01002370@ */ ECIPP_ALIGNMENT_UWORD 256 Compu_CLfltN_MAPmax 0 255.99609375 /end CHARACTERISTIC
/begin COMPU_METHOD Compu_CLfltN_MAPmax " " RAT_FUNC "%.2" "psia" COEFFS 0 256 0 0 0 1 /end COMPU_METHOD
/begin CHARACTERISTIC MJ_ctl_strat "EPR control strategy{MJ_ctl_strat&0xff=0:Internal PID Only}{MJ_ctl_strat&0xff=1:Feedforward Area}" VALUE 0x00147e78 /* @ECU_Address@MJ_ctl_strat@0x01002388@ */ ECIPP_ALIGNMENT_UBYTE 255 MJ_ctl_strat_COMPU_VTAB 0 255 BIT_MASK 0xff /end CHARACTERISTIC
/begin COMPU_METHOD MJ_ctl_strat_COMPU_VTAB "Verbal Table" TAB_VERB "%.0" "list" COMPU_TAB_REF MJ_ctl_strat_COMPU_VTAB_REF /end COMPU_METHOD
/begin COMPU_VTAB MJ_ctl_strat_COMPU_VTAB_REF "Verbal Table" TAB_VERB 2 0 "Internal PID Only" 1 "Feedforward Area" DEFAULT_VALUE "UNKNOWN" /end COMPU_VTAB
/begin CHARACTERISTIC Carb_loc "Carburetor configuration{Carb_loc&0xff=0:Draw-Through}{Carb_loc&0xff=1:Blow-Through}" VALUE 0x00147d08 /* @ECU_Address@Carb_loc@0x010023A0@ */ ECIPP_ALIGNMENT_UBYTE 255 Carb_loc_COMPU_VTAB 0 255 BIT_MASK 0xff /end CHARACTERISTIC
/begin COMPU_METHOD Carb_loc_COMPU_VTAB "Verbal Table" TAB_VERB "%.0" "list" COMPU_TAB_REF Carb_loc_COMPU_VTAB_REF /end COMPU_METHOD
/begin COMPU_VTAB Carb_loc_COMPU_VTAB_REF "Verbal Table" TAB_VERB 2 0 "Draw-Through" 1 "Blow-Through" DEFAULT_VALUE "UNKNOWN" /end COMPU_VTAB
/begin CHARACTERISTIC MJ_param_comm "EPR parameter comms{MJ_param_comm&0xff=0:Disabled}{MJ_param_comm&0xff=1:Enabled}{MJ_param_comm&0xff=2:Faults only}" VALUE 0x00147e79 /* @ECU_Address@MJ_param_comm@0x01002468@ */ ECIPP_ALIGNMENT_UBYTE 255 MJ_param_comm_COMPU_VTAB 0 255 BIT_MASK 0xff /end CHARACTERISTIC
/begin COMPU_METHOD MJ_param_comm_COMPU_VTAB "Verbal Table" TAB_VERB "%.0" "list" COMPU_TAB_REF MJ_param_comm_COMPU_VTAB_REF /end COMPU_METHOD
/begin COMPU_VTAB MJ_param_comm_COMPU_VTAB_REF "Verbal Table" TAB_VERB 3 0 "Disabled" 1 "Enabled" 2 "Faults only" DEFAULT_VALUE "UNKNOWN" /end COMPU_VTAB
/begin CHARACTERISTIC key_off_valid "Key-off abs validate" VALUE 0x00144234 /* @ECU_Address@key_off_valid@0x01002490@ */ ECIPP_ALIGNMENT_ULONG 4294967295 Compu_key_off_valid 0 4294967295 /end CHARACTERISTIC
/begin COMPU_METHOD Compu_key_off_valid " " RAT_FUNC "%.0" "ms" COEFFS 0 1 0 0 0 1 /end COMPU_METHOD
/begin CHARACTERISTIC key_offrel_valid "Key-off rel validate" VALUE 0x00144238 /* @ECU_Address@key_offrel_valid@0x01002498@ */ ECIPP_ALIGNMENT_ULONG 4294967295 Compu_key_offrel_valid 0 4294967295 /end CHARACTERISTIC
/begin COMPU_METHOD Compu_key_offrel_valid " " RAT_FUNC "%.0" "ms" COEFFS 0 1 0 0 0 1 /end COMPU_METHOD
/begin CHARACTERISTIC BstTIP_Hi "TIP > TIP target + (Fault Condition:P > P target +)" VALUE 0x001466ba /* @ECU_Address@BstTIP_Hi@0x01002838@ */ ECIPP_ALIGNMENT_UWORD 256 Compu_BstTIP_Hi 0 255.99609375 /end CHARACTERISTIC
/begin COMPU_METHOD Compu_BstTIP_Hi " " RAT_FUNC "%.2" "psi" COEFFS 0 256 0 0 0 1 /end COMPU_METHOD
/begin CHARACTERISTIC BstTIP_Hi_abs "and TIP > (Fault Condition:and P >)" VALUE 0x001466bc /* @ECU_Address@BstTIP_Hi_abs@0x01002840@ */ ECIPP_ALIGNMENT_UWORD 256 Compu_BstTIP_Hi_abs 0 255.99609375 /end CHARACTERISTIC
/begin COMPU_METHOD Compu_BstTIP_Hi_abs " " RAT_FUNC "%.2" "psia" COEFFS 0 256 0 0 0 1 /end COMPU_METHOD
/begin CHARACTERISTIC BstTIP_Hi_dtdz "and dTIP/dt >= (Fault Condition:and dP/dt >=)" VALUE 0x0014424a /* @ECU_Address@BstTIP_Hi_dtdz@0x01002848@ */ ECIPP_ALIGNMENT_SWORD 512 Compu_BstTIP_Hi_dtdz -512 511.984375 /end CHARACTERISTIC
/begin COMPU_METHOD Compu_BstTIP_Hi_dtdz " " RAT_FUNC "%.1" "psi/sec" COEFFS 0 64 0 0 0 1 /end COMPU_METHOD
/begin CHARACTERISTIC BstTIP_Lo_dtdz "and dTIP/dt <= (Fault Condition:and dP/dt <=)" VALUE 0x0014424e /* @ECU_Address@BstTIP_Lo_dtdz@0x01002850@ */ ECIPP_ALIGNMENT_SWORD 512 Compu_BstTIP_Lo_dtdz -512 511.984375 /end CHARACTERISTIC
/begin COMPU_METHOD Compu_BstTIP_Lo_dtdz " " RAT_FUNC "%.1" "psi/sec" COEFFS 0 64 0 0 0 1 /end COMPU_METHOD
/begin CHARACTERISTIC BstTIP_Lo "TIP < TIP target - (Fault Condition:P < P target -)" VALUE 0x001466be /* @ECU_Address@BstTIP_Lo@0x01002858@ */ ECIPP_ALIGNMENT_UWORD 256 Compu_BstTIP_Lo 0 255.99609375 /end CHARACTERISTIC
/begin COMPU_METHOD Compu_BstTIP_Lo " " RAT_FUNC "%.2" "psi" COEFFS 0 256 0 0 0 1 /end COMPU_METHOD
/begin CHARACTERISTIC BstTIP_Lo_abs "and TIP taget > (Fault Condition:and P target >)" VALUE 0x001466d0 /* @ECU_Address@BstTIP_Lo_abs@0x01002860@ */ ECIPP_ALIGNMENT_UWORD 256 Compu_BstTIP_Lo_abs 0 255.99609375 /end CHARACTERISTIC
/begin COMPU_METHOD Compu_BstTIP_Lo_abs " " RAT_FUNC "%.2" "psia" COEFFS 0 256 0 0 0 1 /end COMPU_METHOD
/begin CHARACTERISTIC BstTIP_Lo_ECT "and ECT > (Fault Condition:and ECT >)" VALUE 0x001466ca /* @ECU_Address@BstTIP_Lo_ECT@0x01002868@ */ ECIPP_ALIGNMENT_UWORD 564 Compu_BstTIP_Lo_ECT -460 563.984375 /end CHARACTERISTIC
/begin COMPU_METHOD Compu_BstTIP_Lo_ECT " " RAT_FUNC "%.0" "deg F" COEFFS 0 64 29440 0 0 1 /end COMPU_METHOD
/begin CHARACTERISTIC TIP_act "TIP active fault TIP low (Fault Condition:TIP < (turbo) / TOP > (supercharged))" VALUE 0x0014789a /* @ECU_Address@TIP_act@0x010029A0@ */ ECIPP_ALIGNMENT_UWORD 256 Compu_TIP_act 0 255.99609375 /end CHARACTERISTIC
/begin COMPU_METHOD Compu_TIP_act " " RAT_FUNC "%.2" "psia" COEFFS 0 256 0 0 0 1 /end COMPU_METHOD
/begin CHARACTERISTIC TIP_actMAP "TIP active fault MAP min (Fault Condition:and MAP > (turbo) / MAP < (supercharged))" VALUE 0x0014789c /* @ECU_Address@TIP_actMAP@0x010029A8@ */ ECIPP_ALIGNMENT_UWORD 256 Compu_TIP_actMAP 0 255.99609375 /end CHARACTERISTIC
/begin COMPU_METHOD Compu_TIP_actMAP " " RAT_FUNC "%.2" "psia" COEFFS 0 256 0 0 0 1 /end COMPU_METHOD
/begin MEASUREMENT FRT_crct "Fuel temperature correction" UWORD Compu_FRT_crct 0 0 0 1.99996948242188 ECU_ADDRESS 0x010029C0 /end MEASUREMENT
/begin COMPU_METHOD Compu_FRT_crct " " RAT_FUNC "%.3" "fraction" COEFFS 0 32768 0 0 0 1 /end COMPU_METHOD
/begin MEASUREMENT PWPCF_deltaPW "PWPCF delta PW" SWORD Compu_PWPCF_deltaPW 0 0 -104.8576 104.8544 ECU_ADDRESS 0x010029C8 /end MEASUREMENT
/begin COMPU_METHOD Compu_PWPCF_deltaPW " " RAT_FUNC "%.2" "ms" COEFFS 0 312.5 0 0 0 1 /end COMPU_METHOD
/begin CHARACTERISTIC IAC_home_int_min "IAC homing sequence min step rate" VALUE 0x0014745a /* @ECU_Address@IAC_home_int_min@0x010033D8@ */ ECIPP_ALIGNMENT_UWORD 256 Compu_IAC_home_int_min 0 255.99609375 /end CHARACTERISTIC
/begin COMPU_METHOD Compu_IAC_home_int_min " " RAT_FUNC "%.1" "ms" COEFFS 0 256 0 0 0 1 /end COMPU_METHOD
/begin CHARACTERISTIC FPP1_5V_source "FPP1 5V excitation source{FPP1_5V_source&0xff=0:Primary - 5VE 1/a}{FPP1_5V_source&0xff=1:Secondary - 5VE 2/b}{FPP1_5V_source&0xff=2:Secondary - 5VE 2/b rescaled}" VALUE 0x00147d5d /* @ECU_Address@FPP1_5V_source@0x01003458@ */ ECIPP_ALIGNMENT_UBYTE 255 FPP1_5V_source_COMPU_VTAB 0 255 BIT_MASK 0xff /end CHARACTERISTIC
/begin COMPU_METHOD FPP1_5V_source_COMPU_VTAB "Verbal Table" TAB_VERB "%.0" "list" COMPU_TAB_REF FPP1_5V_source_COMPU_VTAB_REF /end COMPU_METHOD
/begin COMPU_VTAB FPP1_5V_source_COMPU_VTAB_REF "Verbal Table" TAB_VERB 3 0 "Primary - 5VE 1/a" 1 "Secondary - 5VE 2/b" 2 "Secondary - 5VE 2/b rescaled" DEFAULT_VALUE "UNKNOWN" /end COMPU_VTAB
/begin CHARACTERISTIC FPP2_5V_source "FPP2 5V excitation source{FPP2_5V_source&0xff=0:Primary - 5VE 1/a}{FPP2_5V_source&0xff=1:Secondary - 5VE 2/b}{FPP2_5V_source&0xff=2:Secondary - 5VE 2/b rescaled}" VALUE 0x00147d61 /* @ECU_Address@FPP2_5V_source@0x01003460@ */ ECIPP_ALIGNMENT_UBYTE 255 FPP2_5V_source_COMPU_VTAB 0 255 BIT_MASK 0xff /end CHARACTERISTIC
/begin COMPU_METHOD FPP2_5V_source_COMPU_VTAB "Verbal Table" TAB_VERB "%.0" "list" COMPU_TAB_REF FPP2_5V_source_COMPU_VTAB_REF /end COMPU_METHOD
/begin COMPU_VTAB FPP2_5V_source_COMPU_VTAB_REF "Verbal Table" TAB_VERB 3 0 "Primary - 5VE 1/a" 1 "Secondary - 5VE 2/b" 2 "Secondary - 5VE 2/b rescaled" DEFAULT_VALUE "UNKNOWN" /end COMPU_VTAB
/begin MEASUREMENT emcal_CS_16 "Emissions cal checksum16" UWORD Compu_emcal_CS_16 0 0 0 65535 ECU_ADDRESS 0x01003470 /end MEASUREMENT
/begin COMPU_METHOD Compu_emcal_CS_16 " " RAT_FUNC "%.0" "-" COEFFS 0 1 0 0 0 1 /end COMPU_METHOD
/begin MEASUREMENT totalcal_CS_16 "Total checksum16" UWORD Compu_totalcal_CS_16 0 0 0 65535 ECU_ADDRESS 0x010034B8 /end MEASUREMENT
/begin COMPU_METHOD Compu_totalcal_CS_16 " " RAT_FUNC "%.0" "-" COEFFS 0 1 0 0 0 1 /end COMPU_METHOD
/begin CHARACTERISTIC cam_pos_tau "Cam position estimation filter" VALUE 0x00147cb6 /* @ECU_Address@cam_pos_tau@0x01003570@ */ ECIPP_ALIGNMENT_UWORD 1638398 Compu_cam_pos_tau 1.6703 1638400 /end CHARACTERISTIC
/begin COMPU_METHOD Compu_cam_pos_tau " " FORM "%.0" "ms"
 /begin FORMULA "-50 / log(1.0000000000001 - (X1 / 32768))" FORMULA_INV "(1.0000000000001 - exp(-50/X1)) * 32768" /end FORMULA
/end COMPU_METHOD
/begin CHARACTERISTIC FaultCylBlock_use "Cylinder numbering request{FaultCylBlock_use&0xff=0:Firing Order}{FaultCylBlock_use&0xff=1:Block Order}" VALUE 0x00147d95 /* @ECU_Address@FaultCylBlock_use@0x01003AD0@ */ ECIPP_ALIGNMENT_UBYTE 255 FaultCylBlock_use_COMPU_VTAB 0 255 BIT_MASK 0xff /end CHARACTERISTIC
/begin COMPU_METHOD FaultCylBlock_use_COMPU_VTAB "Verbal Table" TAB_VERB "%.0" "list" COMPU_TAB_REF FaultCylBlock_use_COMPU_VTAB_REF /end COMPU_METHOD
/begin COMPU_VTAB FaultCylBlock_use_COMPU_VTAB_REF "Verbal Table" TAB_VERB 2 0 "Firing Order" 1 "Block Order" DEFAULT_VALUE "UNKNOWN" /end COMPU_VTAB
/begin CHARACTERISTIC ADIG3_max "Water intrusion input limit (Fault Condition:AUX DIG3 >)" VALUE 0x001633d6 /* @ECU_Address@ADIG3_max@0x01003D98@ */ ECIPP_ALIGNMENT_UWORD 256 Compu_ADIG3_max 0 255.99609375 /end CHARACTERISTIC
/begin COMPU_METHOD Compu_ADIG3_max " " RAT_FUNC "%.2" "volts" COEFFS 0 256 0 0 0 1 /end COMPU_METHOD
/begin CHARACTERISTIC CWT_mode "CWT compensation mode - gasoline{CWT_mode&0xff=0:Single-Point}{CWT_mode&0xff=1:1-D Table-Based}{CWT_mode&0xff=2:2-D Table-Based}" VALUE 0x00147d05 /* @ECU_Address@CWT_mode@0x01003EC0@ */ ECIPP_ALIGNMENT_UBYTE 255 CWT_mode_COMPU_VTAB 0 255 BIT_MASK 0xff /end CHARACTERISTIC
/begin COMPU_METHOD CWT_mode_COMPU_VTAB "Verbal Table" TAB_VERB "%.0" "list" COMPU_TAB_REF CWT_mode_COMPU_VTAB_REF /end COMPU_METHOD
/begin COMPU_VTAB CWT_mode_COMPU_VTAB_REF "Verbal Table" TAB_VERB 3 0 "Single-Point" 1 "1-D Table-Based" 2 "2-D Table-Based" DEFAULT_VALUE "UNKNOWN" /end COMPU_VTAB
/begin CHARACTERISTIC EMP_est "Exhaust manifold pressure estimate{EMP_est&0xff=0:EMP = EBP}{EMP_est&0xff=1:EMP = TIP + EBP_gauge}{EMP_est&0xff=2:EMP = EGRHP + dP cooler}" VALUE 0x00147d32 /* @ECU_Address@EMP_est@0x01003ED8@ */ ECIPP_ALIGNMENT_UBYTE 255 EMP_est_COMPU_VTAB 0 255 BIT_MASK 0xff /end CHARACTERISTIC
/begin COMPU_METHOD EMP_est_COMPU_VTAB "Verbal Table" TAB_VERB "%.0" "list" COMPU_TAB_REF EMP_est_COMPU_VTAB_REF /end COMPU_METHOD
/begin COMPU_VTAB EMP_est_COMPU_VTAB_REF "Verbal Table" TAB_VERB 3 0 "EMP = EBP" 1 "EMP = TIP + EBP_gauge" 2 "EMP = EGRHP + dP cooler" DEFAULT_VALUE "UNKNOWN" /end COMPU_VTAB
/begin CHARACTERISTIC EBPs_C_exh "EBP_Std flow rate constant" VALUE 0x00146792 /* @ECU_Address@EBPs_C_exh@0x01003EE0@ */ ECIPP_ALIGNMENT_UWORD 31 Compu_EBPs_C_exh 0 30.5171124637127 /end CHARACTERISTIC
/begin COMPU_METHOD Compu_EBPs_C_exh " " RAT_FUNC "%.3" "upsig / (l/s)^2" COEFFS 0 2147.483648 0 0 0 1 /end COMPU_METHOD
/begin CHARACTERISTIC EBPs_gauge_def "EBP_Std default gauge" VALUE 0x00146794 /* @ECU_Address@EBPs_gauge_def@0x01003EE8@ */ ECIPP_ALIGNMENT_UWORD 256 Compu_EBPs_gauge_def 0 255.99609375 /end CHARACTERISTIC
/begin COMPU_METHOD Compu_EBPs_gauge_def " " RAT_FUNC "%.2" "psig" COEFFS 0 256 0 0 0 1 /end COMPU_METHOD
/begin CHARACTERISTIC J1939_TSC1_loss "Loss of TSC1 after engine running >= (Fault Condition:Loss of TSC1 after engine running >=)" VALUE 0x0014750e /* @ECU_Address@J1939_TSC1_loss@0x010040F8@ */ ECIPP_ALIGNMENT_UWORD 66 Compu_J1939_TSC1_loss 0 65.535 /end CHARACTERISTIC
/begin COMPU_METHOD Compu_J1939_TSC1_loss " " RAT_FUNC "%.2" "sec" COEFFS 0 1000 0 0 0 1 /end COMPU_METHOD
/begin CHARACTERISTIC TRIM_lim_bhvP "LP trim valve +/- limit behavior{TRIM_lim_bhvP&0xff=0:Allow CL to reach hard limits}{TRIM_lim_bhvP&0xff=1:Limit CL to valve authority without fault setting}{TRIM_lim_bhvP&0xff=2:Limit CL to valve authority with fault setting}" VALUE 0x00141922 /* @ECU_Address@TRIM_lim_bhvP@0x01004370@ */ ECIPP_ALIGNMENT_UBYTE 255 TRIM_lim_bhvP_COMPU_VTAB 0 255 BIT_MASK 0xff /end CHARACTERISTIC
/begin COMPU_METHOD TRIM_lim_bhvP_COMPU_VTAB "Verbal Table" TAB_VERB "%.0" "list" COMPU_TAB_REF TRIM_lim_bhvP_COMPU_VTAB_REF /end COMPU_METHOD
/begin COMPU_VTAB TRIM_lim_bhvP_COMPU_VTAB_REF "Verbal Table" TAB_VERB 3 0 "Allow CL to reach hard limits" 1 "Limit CL to valve authority without fault setting" 2 "Limit CL to valve authority with fault setting" DEFAULT_VALUE "UNKNOWN" /end COMPU_VTAB
/begin CHARACTERISTIC TRIM_lim_bhvN "NG trim valve +/- limit behavior{TRIM_lim_bhvN&0xff=0:Allow CL to reach hard limits}{TRIM_lim_bhvN&0xff=1:Limit CL to valve authority without fault setting}{TRIM_lim_bhvN&0xff=2:Limit CL to valve authority with fault setting}" VALUE 0x0014288A /* @ECU_Address@TRIM_lim_bhvN@0x01004378@ */ ECIPP_ALIGNMENT_UBYTE 255 TRIM_lim_bhvN_COMPU_VTAB 0 255 BIT_MASK 0xff /end CHARACTERISTIC
/begin COMPU_METHOD TRIM_lim_bhvN_COMPU_VTAB "Verbal Table" TAB_VERB "%.0" "list" COMPU_TAB_REF TRIM_lim_bhvN_COMPU_VTAB_REF /end COMPU_METHOD
/begin COMPU_VTAB TRIM_lim_bhvN_COMPU_VTAB_REF "Verbal Table" TAB_VERB 3 0 "Allow CL to reach hard limits" 1 "Limit CL to valve authority without fault setting" 2 "Limit CL to valve authority with fault setting" DEFAULT_VALUE "UNKNOWN" /end COMPU_VTAB
/begin CHARACTERISTIC J1939_ETC_loss "Loss of ETC after engine running >= (Fault Condition:Loss of ETC after engine running >=)" VALUE 0x001474ec /* @ECU_Address@J1939_ETC_loss@0x01004590@ */ ECIPP_ALIGNMENT_UWORD 66 Compu_J1939_ETC_loss 0 65.535 /end CHARACTERISTIC
/begin COMPU_METHOD Compu_J1939_ETC_loss " " RAT_FUNC "%.2" "sec" COEFFS 0 1000 0 0 0 1 /end COMPU_METHOD
/begin CHARACTERISTIC ovlp_Aeff "Overlap average effective area" VALUE 0x00147b60 /* @ECU_Address@ovlp_Aeff@0x01004700@ */ ECIPP_ALIGNMENT_UWORD 1 Compu_ovlp_Aeff 0 0.999984741210938 /end CHARACTERISTIC
/begin COMPU_METHOD Compu_ovlp_Aeff " " RAT_FUNC "%.3" "in^2" COEFFS 0 65536 0 0 0 1 /end COMPU_METHOD
/begin CHARACTERISTIC ovlp_cyc_frac "Overlap duration" VALUE 0x00147b64 /* @ECU_Address@ovlp_cyc_frac@0x01004708@ */ ECIPP_ALIGNMENT_UWORD 720 Compu_ovlp_cyc_frac 0 719.989013671875 /end CHARACTERISTIC
/begin COMPU_METHOD Compu_ovlp_cyc_frac " " RAT_FUNC "%.0" "crank deg" COEFFS 0 91.0222222222222 0 0 0 1 /end COMPU_METHOD
/begin CHARACTERISTIC ovlp_EGT_def "Overlap exhaust gas temperature" VALUE 0x00147b62 /* @ECU_Address@ovlp_EGT_def@0x01004710@ */ ECIPP_ALIGNMENT_UWORD 7732 Compu_ovlp_EGT_def -460 7731.875 /end CHARACTERISTIC
/begin COMPU_METHOD Compu_ovlp_EGT_def " " RAT_FUNC "%.0" "deg F" COEFFS 0 8 3680 0 0 1 /end COMPU_METHOD
/begin MEASUREMENT ovlp_m_port "Overlap mass relative to EMP std" SWORD Compu_ovlp_m_port 0 0 -8192 8191.75 ECU_ADDRESS 0x01004718 /end MEASUREMENT
/begin COMPU_METHOD Compu_ovlp_m_port " " RAT_FUNC "%.1" "mg" COEFFS 0 4 0 0 0 1 /end COMPU_METHOD
/begin MEASUREMENT VE_ovlp_crct "Overlap VE correction" UWORD Compu_VE_ovlp_crct 0 0 -100 99.9969482421875 ECU_ADDRESS 0x01004720 /end MEASUREMENT
/begin COMPU_METHOD Compu_VE_ovlp_crct " " RAT_FUNC "%.1" "%" COEFFS 0 327.68 32768 0 0 1 /end COMPU_METHOD
/begin CHARACTERISTIC V_LPG "LPG upstream volume" VALUE 0x00147a4e /* @ECU_Address@V_LPG@0x01004B20@ */ ECIPP_ALIGNMENT_UWORD 32 Compu_V_LPG 0 31.99951171875 /end CHARACTERISTIC
/begin COMPU_METHOD Compu_V_LPG " " RAT_FUNC "%.2" "L" COEFFS 0 2048 0 0 0 1 /end COMPU_METHOD
/begin CHARACTERISTIC V_NG "NG upstream volume" VALUE 0x00147a52 /* @ECU_Address@V_NG@0x01004B28@ */ ECIPP_ALIGNMENT_UWORD 32 Compu_V_NG 0 31.99951171875 /end CHARACTERISTIC
/begin COMPU_METHOD Compu_V_NG " " RAT_FUNC "%.2" "L" COEFFS 0 2048 0 0 0 1 /end COMPU_METHOD
/begin CHARACTERISTIC key_on_wait "Key-on stopped wait - gasoline" VALUE 0x00147b52 /* @ECU_Address@key_on_wait@0x01004CB0@ */ ECIPP_ALIGNMENT_UWORD 66 Compu_key_on_wait 0 65.535 /end CHARACTERISTIC
/begin COMPU_METHOD Compu_key_on_wait " " RAT_FUNC "%.1" "seconds" COEFFS 0 1000 0 0 0 1 /end COMPU_METHOD
/begin CHARACTERISTIC fpump_key_wait "Fuel pump stopped wait - gasoline" VALUE 0x00147b02 /* @ECU_Address@fpump_key_wait@0x01004D20@ */ ECIPP_ALIGNMENT_UWORD 66 Compu_fpump_key_wait 0 65.535 /end CHARACTERISTIC
/begin COMPU_METHOD Compu_fpump_key_wait " " RAT_FUNC "%.1" "seconds" COEFFS 0 1000 0 0 0 1 /end COMPU_METHOD
/begin CHARACTERISTIC lockoff_key_wait "Lockoff stopped wait - gaseous fuel" VALUE 0x00147b5a /* @ECU_Address@lockoff_key_wait@0x01004D28@ */ ECIPP_ALIGNMENT_UWORD 66 Compu_lockoff_key_wait 0 65.535 /end CHARACTERISTIC
/begin COMPU_METHOD Compu_lockoff_key_wait " " RAT_FUNC "%.1" "seconds" COEFFS 0 1000 0 0 0 1 /end COMPU_METHOD
/begin CHARACTERISTIC LOD_WARN_force "Historic fault forced indication{LOD_WARN_force&0xff=0:Disabled}{LOD_WARN_force&0xff=1:Soft Warning}{LOD_WARN_force&0xff=2:Hard Warning} (Fault Condition:Historic fault forced indication)" VALUE 0x00147e16 /* @ECU_Address@LOD_WARN_force@0x01004F48@ */ ECIPP_ALIGNMENT_UBYTE 255 LOD_WARN_force_COMPU_VTAB 0 255 BIT_MASK 0xff /end CHARACTERISTIC
/begin COMPU_METHOD LOD_WARN_force_COMPU_VTAB "Verbal Table" TAB_VERB "%.0" "list" COMPU_TAB_REF LOD_WARN_force_COMPU_VTAB_REF /end COMPU_METHOD
/begin COMPU_VTAB LOD_WARN_force_COMPU_VTAB_REF "Verbal Table" TAB_VERB 3 0 "Disabled" 1 "Soft Warning" 2 "Hard Warning" DEFAULT_VALUE "UNKNOWN" /end COMPU_VTAB
/begin CHARACTERISTIC SWARN_bulbchk "Soft warning bulb-check time" VALUE 0x00147800 /* @ECU_Address@SWARN_bulbchk@0x01004F50@ */ ECIPP_ALIGNMENT_UWORD 65535 Compu_SWARN_bulbchk 0 65535 /end CHARACTERISTIC
/begin COMPU_METHOD Compu_SWARN_bulbchk " " RAT_FUNC "%.0" "ms" COEFFS 0 1 0 0 0 1 /end COMPU_METHOD
/begin CHARACTERISTIC HWARN_bulbchk "Hard warning bulb-check time" VALUE 0x00147452 /* @ECU_Address@HWARN_bulbchk@0x01004F58@ */ ECIPP_ALIGNMENT_UWORD 65535 Compu_HWARN_bulbchk 0 65535 /end CHARACTERISTIC
/begin COMPU_METHOD Compu_HWARN_bulbchk " " RAT_FUNC "%.0" "ms" COEFFS 0 1 0 0 0 1 /end COMPU_METHOD
/begin CHARACTERISTIC J1939_DM19_calid "J1939 DM19 calibration ID{J1939_DM19_calid&0xff=0:Calibration Model No.}{J1939_DM19_calid&0xff=1:Customer Software PN}" VALUE 0x0014856B /* @ECU_Address@J1939_DM19_calid@0x01005610@ */ ECIPP_ALIGNMENT_UBYTE 255 J1939_DM19_calid_COMPU_VTAB 0 255 BIT_MASK 0xff /end CHARACTERISTIC
/begin COMPU_METHOD J1939_DM19_calid_COMPU_VTAB "Verbal Table" TAB_VERB "%.0" "list" COMPU_TAB_REF J1939_DM19_calid_COMPU_VTAB_REF /end COMPU_METHOD
/begin COMPU_VTAB J1939_DM19_calid_COMPU_VTAB_REF "Verbal Table" TAB_VERB 2 0 "Calibration Model No." 1 "Customer Software PN" DEFAULT_VALUE "UNKNOWN" /end COMPU_VTAB
/begin CHARACTERISTIC J1939_DM5_OBDc "J1939 DM5 OBD compliance{J1939_DM5_OBDc&0xff=0:None}{J1939_DM5_OBDc&0xff=1:OBD (Federal, EPA)}{J1939_DM5_OBDc&0xff=2:OBD I}{J1939_DM5_OBDc&0xff=3:OBD, OBD II}{J1939_DM5_OBDc&0xff=4:OBD II (CARB)}{J1939_DM5_OBDc&0xff=5:OBD II (CARB 2007/8)}{J1939_DM5_OBDc&" VALUE 0x0014856A /* @ECU_Address@J1939_DM5_OBDc@0x01005618@ */ ECIPP_ALIGNMENT_UBYTE 255 J1939_DM5_OBDc_COMPU_VTAB 0 255 BIT_MASK 0xff /end CHARACTERISTIC
/begin COMPU_METHOD J1939_DM5_OBDc_COMPU_VTAB "Verbal Table" TAB_VERB "%.0" "list" COMPU_TAB_REF J1939_DM5_OBDc_COMPU_VTAB_REF /end COMPU_METHOD
/begin COMPU_VTAB J1939_DM5_OBDc_COMPU_VTAB_REF "Verbal Table" TAB_VERB 29 0 "None" 1 "OBD (Federal, EPA)" 2 "OBD I" 3 "OBD, OBD II" 4 "OBD II (CARB)" 5 "OBD II (CARB 2007/8)" 6 "OBDM" 7 "EOBD" 8 "EOBD and OBD" 9 "EOBD and OBD II" 10 "EOBD , OBD and OBD II" 11 "JOBD" 12 "JOBD and OBD II" 13 "JOBD and EOBD" 14 "JOBD, EOBD and OBD II" 15 "HD (EURO VI) B1" 16 "HD (EURO V) B2" 17 "HD (EURO EEC) C" 18 "EMD" 19 "EMD+" 20 "HD OBD P" 21 "HD OBD" 22 "World Wide Harmonized OBD" 23 "HD EOBD" 24 "EURO VI" 25 "OBD, OBD II, HD OBD" 26 "OBD, OBD II, HD OBD P" 27 "China Nationwide Stage 6 (China VI)" 28 "Brazil OBD Diesel" DEFAULT_VALUE "UNKNOWN" /end COMPU_VTAB
/begin CHARACTERISTIC Vs "Primary injection standard voltage" VALUE 0x0014904E /* @ECU_Address@Vs@0x010056F0@ */ ECIPP_ALIGNMENT_UWORD 256 Compu_Vs 0 255.99609375 /end CHARACTERISTIC
/begin COMPU_METHOD Compu_Vs " " RAT_FUNC "%.2" "volts" COEFFS 0 256 0 0 0 1 /end COMPU_METHOD
/begin CHARACTERISTIC FPin_s "Fuel pressure in std" VALUE 0x00149048 /* @ECU_Address@FPin_s@0x010056F8@ */ ECIPP_ALIGNMENT_UWORD 256 Compu_FPin_s 0 255.99609375 /end CHARACTERISTIC
/begin COMPU_METHOD Compu_FPin_s " " RAT_FUNC "%.1" "psia" COEFFS 0 256 0 0 0 1 /end COMPU_METHOD
/begin CHARACTERISTIC FPout_s "Fuel pressure out std" VALUE 0x0014904A /* @ECU_Address@FPout_s@0x01005700@ */ ECIPP_ALIGNMENT_UWORD 256 Compu_FPout_s 0 255.99609375 /end CHARACTERISTIC
/begin COMPU_METHOD Compu_FPout_s " " RAT_FUNC "%.1" "psia" COEFFS 0 256 0 0 0 1 /end COMPU_METHOD
/begin CHARACTERISTIC FP_ena "Primary fuel pressure channel{FP_ena&0xff=0:Disabled}{FP_ena&0xff=1:Default Input}{FP_ena&0xff=2:Aux PD1}{FP_ena&0xff=3:Aux PD2}{FP_ena&0xff=4:Aux PD3}{FP_ena&0xff=5:Aux PUD1}{FP_ena&0xff=6:Aux PUD2}{FP_ena&0xff=7:Aux PUD3}{FP_ena&0xff=8:Aux PUD4}{FP_ena&" VALUE 0x00149063 /* @ECU_Address@FP_ena@0x01005708@ */ ECIPP_ALIGNMENT_UBYTE 255 FP_ena_COMPU_VTAB 0 255 BIT_MASK 0xff /end CHARACTERISTIC
/begin COMPU_METHOD FP_ena_COMPU_VTAB "Verbal Table" TAB_VERB "%.0" "list" COMPU_TAB_REF FP_ena_COMPU_VTAB_REF /end COMPU_METHOD
/begin COMPU_VTAB FP_ena_COMPU_VTAB_REF "Verbal Table" TAB_VERB 11 0 "Disabled" 1 "Default Input" 2 "Aux PD1" 3 "Aux PD2" 4 "Aux PD3" 5 "Aux PUD1" 6 "Aux PUD2" 7 "Aux PUD3" 8 "Aux PUD4" 9 "Aux PUD5" 10 "SENT - CRI" DEFAULT_VALUE "UNKNOWN" /end COMPU_VTAB
/begin CHARACTERISTIC FP_abs_gage "Fuel pressure units{FP_abs_gage&0xff=0:psia}{FP_abs_gage&0xff=1:psig}" VALUE 0x00149064 /* @ECU_Address@FP_abs_gage@0x01005710@ */ ECIPP_ALIGNMENT_UBYTE 255 FP_abs_gage_COMPU_VTAB 0 255 BIT_MASK 0xff /end CHARACTERISTIC
/begin COMPU_METHOD FP_abs_gage_COMPU_VTAB "Verbal Table" TAB_VERB "%.0" "list" COMPU_TAB_REF FP_abs_gage_COMPU_VTAB_REF /end COMPU_METHOD
/begin COMPU_VTAB FP_abs_gage_COMPU_VTAB_REF "Verbal Table" TAB_VERB 2 0 "psia" 1 "psig" DEFAULT_VALUE "UNKNOWN" /end COMPU_VTAB
/begin CHARACTERISTIC adapt_ena "Adaptive control{adapt_ena&0xff=0:Disabled}{adapt_ena&0xff=1:Enabled}" VALUE 0x001480f0 /* @ECU_Address@adapt_ena@0x01005718@ */ ECIPP_ALIGNMENT_UBYTE 255 adapt_ena_COMPU_VTAB 0 255 BIT_MASK 0xff /end CHARACTERISTIC
/begin COMPU_METHOD adapt_ena_COMPU_VTAB "Verbal Table" TAB_VERB "%.0" "list" COMPU_TAB_REF adapt_ena_COMPU_VTAB_REF /end COMPU_METHOD
/begin COMPU_VTAB adapt_ena_COMPU_VTAB_REF "Verbal Table" TAB_VERB 2 0 "Disabled" 1 "Enabled" DEFAULT_VALUE "UNKNOWN" /end COMPU_VTAB
/begin CHARACTERISTIC HWARN_bulbon "Hard warning bulb check{HWARN_bulbon&0xff=0:Blink}{HWARN_bulbon&0xff=1:On}" VALUE 0x00147daa /* @ECU_Address@HWARN_bulbon@0x010058F0@ */ ECIPP_ALIGNMENT_UBYTE 255 HWARN_bulbon_COMPU_VTAB 0 255 BIT_MASK 0xff /end CHARACTERISTIC
/begin COMPU_METHOD HWARN_bulbon_COMPU_VTAB "Verbal Table" TAB_VERB "%.0" "list" COMPU_TAB_REF HWARN_bulbon_COMPU_VTAB_REF /end COMPU_METHOD
/begin COMPU_VTAB HWARN_bulbon_COMPU_VTAB_REF "Verbal Table" TAB_VERB 2 0 "Blink" 1 "On" DEFAULT_VALUE "UNKNOWN" /end COMPU_VTAB
/begin CHARACTERISTIC SWARN_bulbon "Soft warning bulb check{SWARN_bulbon&0xff=0:Blink}{SWARN_bulbon&0xff=1:On}" VALUE 0x0014805f /* @ECU_Address@SWARN_bulbon@0x010058F8@ */ ECIPP_ALIGNMENT_UBYTE 255 SWARN_bulbon_COMPU_VTAB 0 255 BIT_MASK 0xff /end CHARACTERISTIC
/begin COMPU_METHOD SWARN_bulbon_COMPU_VTAB "Verbal Table" TAB_VERB "%.0" "list" COMPU_TAB_REF SWARN_bulbon_COMPU_VTAB_REF /end COMPU_METHOD
/begin COMPU_VTAB SWARN_bulbon_COMPU_VTAB_REF "Verbal Table" TAB_VERB 2 0 "Blink" 1 "On" DEFAULT_VALUE "UNKNOWN" /end COMPU_VTAB
/begin CHARACTERISTIC fuelclr_mult "General # fuelclr_mult" VALUE 0x00147b08 /* @ECU_Address@fuelclr_mult@0x01006350@ */ ECIPP_ALIGNMENT_UWORD 1 Compu_fuelclr_mult 0 0.999984741210938 /end CHARACTERISTIC
/begin COMPU_METHOD Compu_fuelclr_mult " " RAT_FUNC "%.0" "-" COEFFS 0 65536 0 0 0 1 /end COMPU_METHOD
/begin CHARACTERISTIC CRI_V_relay "Boost-recharge transition" VALUE 0x0016c7d6 /* @ECU_Address@CRI_V_relay@0x01008810@ */ ECIPP_ALIGNMENT_UWORD 1024 Compu_CRI_V_relay 0 1023.984375 /end CHARACTERISTIC
/begin COMPU_METHOD Compu_CRI_V_relay " " RAT_FUNC "%.1" "volts" COEFFS 0 64 0 0 0 1 /end COMPU_METHOD
/begin CHARACTERISTIC MAF_ena "MAF input{MAF_ena&0xff=0:Disabled}{MAF_ena&0xff=1:Pulse in}{MAF_ena&0xff=2:Roadspeed}{MAF_ena&0xff=3:Aux DIG23 comparator}{MAF_ena&0xff=4:Aux DIG24 comparator}{MAF_ena&0xff=5:Aux DIG25 comparator}" VALUE 0x00147e52 /* @ECU_Address@MAF_ena@0x01008C28@ */ ECIPP_ALIGNMENT_UBYTE 255 MAF_ena_COMPU_VTAB 0 255 BIT_MASK 0xff /end CHARACTERISTIC
/begin COMPU_METHOD MAF_ena_COMPU_VTAB "Verbal Table" TAB_VERB "%.0" "list" COMPU_TAB_REF MAF_ena_COMPU_VTAB_REF /end COMPU_METHOD
/begin COMPU_VTAB MAF_ena_COMPU_VTAB_REF "Verbal Table" TAB_VERB 6 0 "Disabled" 1 "Pulse in" 2 "Roadspeed" 3 "Aux DIG23 comparator" 4 "Aux DIG24 comparator" 5 "Aux DIG25 comparator" DEFAULT_VALUE "UNKNOWN" /end COMPU_VTAB
/begin CHARACTERISTIC MAF_PWM_edge "MAF edge capture{MAF_PWM_edge&0xff=0:Rising edge}{MAF_PWM_edge&0xff=1:Falling edge}" VALUE 0x00147e51 /* @ECU_Address@MAF_PWM_edge@0x01008C30@ */ ECIPP_ALIGNMENT_UBYTE 255 MAF_PWM_edge_COMPU_VTAB 0 255 BIT_MASK 0xff /end CHARACTERISTIC
/begin COMPU_METHOD MAF_PWM_edge_COMPU_VTAB "Verbal Table" TAB_VERB "%.0" "list" COMPU_TAB_REF MAF_PWM_edge_COMPU_VTAB_REF /end COMPU_METHOD
/begin COMPU_VTAB MAF_PWM_edge_COMPU_VTAB_REF "Verbal Table" TAB_VERB 2 0 "Rising edge" 1 "Falling edge" DEFAULT_VALUE "UNKNOWN" /end COMPU_VTAB
/begin MEASUREMENT MAF_flow_gsec "MAF flow rate" FLOAT32_IEEE Compu_MAF_flow_gsec 0 0 -10000000000 10000000000 ECU_ADDRESS 0x01008C48 /end MEASUREMENT
/begin COMPU_METHOD Compu_MAF_flow_gsec " " RAT_FUNC "%.1" "g/sec" COEFFS 0 1 0 0 0 1 /end COMPU_METHOD
/begin CHARACTERISTIC FPin_s_I2 "Sec fuel pressure in std" VALUE 0x00149080 /* @ECU_Address@FPin_s_I2@0x01009120@ */ ECIPP_ALIGNMENT_UWORD 256 Compu_FPin_s_I2 0 255.99609375 /end CHARACTERISTIC
/begin COMPU_METHOD Compu_FPin_s_I2 " " RAT_FUNC "%.1" "psia" COEFFS 0 256 0 0 0 1 /end COMPU_METHOD
/begin CHARACTERISTIC FPout_s_I2 "Sec fuel pressure out std" VALUE 0x00149082 /* @ECU_Address@FPout_s_I2@0x01009128@ */ ECIPP_ALIGNMENT_UWORD 256 Compu_FPout_s_I2 0 255.99609375 /end CHARACTERISTIC
/begin COMPU_METHOD Compu_FPout_s_I2 " " RAT_FUNC "%.1" "psia" COEFFS 0 256 0 0 0 1 /end COMPU_METHOD
/begin CHARACTERISTIC Vs_I2 "Secondary injection standard voltage" VALUE 0x00149086 /* @ECU_Address@Vs_I2@0x01009138@ */ ECIPP_ALIGNMENT_UWORD 256 Compu_Vs_I2 0 255.99609375 /end CHARACTERISTIC
/begin COMPU_METHOD Compu_Vs_I2 " " RAT_FUNC "%.2" "volts" COEFFS 0 256 0 0 0 1 /end COMPU_METHOD
/begin CHARACTERISTIC FP_ena_I2 "Secondary fuel pressure channel{FP_ena_I2&0xff=0:Disabled}{FP_ena_I2&0xff=1:Default Input}{FP_ena_I2&0xff=2:Aux PD1}{FP_ena_I2&0xff=3:Aux PD2}{FP_ena_I2&0xff=4:Aux PD3}{FP_ena_I2&0xff=5:Aux PUD1}{FP_ena_I2&0xff=6:Aux PUD2}{FP_ena_I2&0xff=7:Aux PUD3}{FP_en" VALUE 0x0014909B /* @ECU_Address@FP_ena_I2@0x01009140@ */ ECIPP_ALIGNMENT_UBYTE 255 FP_ena_I2_COMPU_VTAB 0 255 BIT_MASK 0xff /end CHARACTERISTIC
/begin COMPU_METHOD FP_ena_I2_COMPU_VTAB "Verbal Table" TAB_VERB "%.0" "list" COMPU_TAB_REF FP_ena_I2_COMPU_VTAB_REF /end COMPU_METHOD
/begin COMPU_VTAB FP_ena_I2_COMPU_VTAB_REF "Verbal Table" TAB_VERB 11 0 "Disabled" 1 "Default Input" 2 "Aux PD1" 3 "Aux PD2" 4 "Aux PD3" 5 "Aux PUD1" 6 "Aux PUD2" 7 "Aux PUD3" 8 "Aux PUD4" 9 "Aux PUD5" 10 "SENT - CRI" DEFAULT_VALUE "UNKNOWN" /end COMPU_VTAB
/begin CHARACTERISTIC FP_abs_gage_I2 "Secondary fuel pressure units{FP_abs_gage_I2&0xff=0:psia}{FP_abs_gage_I2&0xff=1:psig}" VALUE 0x0014909C /* @ECU_Address@FP_abs_gage_I2@0x01009148@ */ ECIPP_ALIGNMENT_UBYTE 255 FP_abs_gage_I2_COMPU_VTAB 0 255 BIT_MASK 0xff /end CHARACTERISTIC
/begin COMPU_METHOD FP_abs_gage_I2_COMPU_VTAB "Verbal Table" TAB_VERB "%.0" "list" COMPU_TAB_REF FP_abs_gage_I2_COMPU_VTAB_REF /end COMPU_METHOD
/begin COMPU_VTAB FP_abs_gage_I2_COMPU_VTAB_REF "Verbal Table" TAB_VERB 2 0 "psia" 1 "psig" DEFAULT_VALUE "UNKNOWN" /end COMPU_VTAB
/begin CHARACTERISTIC FPraw_LP_I2 "Secondary FP raw filter" VALUE 0x00149092 /* @ECU_Address@FPraw_LP_I2@0x010091B0@ */ ECIPP_ALIGNMENT_UWORD 327680 Compu_FPraw_LP_I2 0.45084 327680 /end CHARACTERISTIC
/begin COMPU_METHOD Compu_FPraw_LP_I2 " " FORM "%.3" "ms"
 /begin FORMULA "-5 / log(1 - (X1 / 65536))" FORMULA_INV "(1 - exp(-5/X1)) * 65536" /end FORMULA
/end COMPU_METHOD
/begin CHARACTERISTIC AFILT_dP_C "Air filter flow rate constant" VALUE 0x00143944 /* @ECU_Address@AFILT_dP_C@0x01009268@ */ ECIPP_ALIGNMENT_FLOAT32_IEEE 10000000000 Compu_AFILT_dP_C -10000000000 10000000000 /end CHARACTERISTIC
/begin COMPU_METHOD Compu_AFILT_dP_C " " RAT_FUNC "%.1" "upsig * s^2 / g / L" COEFFS 0 0.000001 0 0 0 1 /end COMPU_METHOD
/begin CHARACTERISTIC EGR_clr_Cr_nom "EGR cooler nominal heat capacity ratio" VALUE 0x00140064 /* @ECU_Address@EGR_clr_Cr_nom@0x01009290@ */ ECIPP_ALIGNMENT_FLOAT32_IEEE 10000000000 Compu_EGR_clr_Cr_nom -10000000000 10000000000 /end CHARACTERISTIC
/begin COMPU_METHOD Compu_EGR_clr_Cr_nom " " RAT_FUNC "%.3" "-" COEFFS 0 1 0 0 0 1 /end COMPU_METHOD
/begin CHARACTERISTIC EGR_clr_eta_nom "EGR cooler nominal efficiency" VALUE 0x00140074 /* @ECU_Address@EGR_clr_eta_nom@0x010092A0@ */ ECIPP_ALIGNMENT_FLOAT32_IEEE 10000000000 Compu_EGR_clr_eta_nom -10000000000 10000000000 /end CHARACTERISTIC
/begin COMPU_METHOD Compu_EGR_clr_eta_nom " " RAT_FUNC "%.1" "%" COEFFS 0 0.01 0 0 0 1 /end COMPU_METHOD
/begin CHARACTERISTIC EGT_ena "EGT source{EGT_ena&0xff=0:Disabled}{EGT_ena&0xff=1:Aux PU1}{EGT_ena&0xff=2:Aux PU2}{EGT_ena&0xff=3:Aux PU3}{EGT_ena&0xff=4:Aux PUD1}{EGT_ena&0xff=5:Aux PUD2}{EGT_ena&0xff=6:Aux PUD3}{EGT_ena&0xff=7:EGT Input}{EGT_ena&0xff=8:Aux PUD4}{EGT_ena&0xff=9:Aux PU" VALUE 0x00147d2f /* @ECU_Address@EGT_ena@0x010093A8@ */ ECIPP_ALIGNMENT_UBYTE 255 EGT_ena_COMPU_VTAB 0 255 BIT_MASK 0xff /end CHARACTERISTIC
/begin COMPU_METHOD EGT_ena_COMPU_VTAB "Verbal Table" TAB_VERB "%.0" "list" COMPU_TAB_REF EGT_ena_COMPU_VTAB_REF /end COMPU_METHOD
/begin COMPU_VTAB EGT_ena_COMPU_VTAB_REF "Verbal Table" TAB_VERB 31 0 "Disabled" 1 "Aux PU1" 2 "Aux PU2" 3 "Aux PU3" 4 "Aux PUD1" 5 "Aux PUD2" 6 "Aux PUD3" 7 "EGT Input" 8 "Aux PUD4" 9 "Aux PUD5" 10 "Aux PUD6" 11 "Aux PUD7" 12 "Aux PUD8" 13 "Aux PUD9" 14 "Aux PUD10" 15 "Aux PUD11" 16 "Aux PUD12" 17 "Aux PUD13" 18 "Aux PUD14" 19 "Aux PUD15" 20 "Aux PUD16" 21 "Aux PUD17" 22 "Aux PUD18" 23 "Aux PUD19" 24 "Aux PUD20" 25 "Aux PUD21" 26 "Aux PUD22" 27 "Aux PUD23" 28 "Aux PUD24" 29 "Aux PUD25" 30 "CAN sourced" DEFAULT_VALUE "UNKNOWN" /end COMPU_VTAB
/begin CHARACTERISTIC TOT_ena "Turbo Tout source{TOT_ena&0xff=0:Disabled}{TOT_ena&0xff=1:Aux PU1}{TOT_ena&0xff=2:Aux PU2}{TOT_ena&0xff=3:Aux PU3}{TOT_ena&0xff=4:Aux PUD1}{TOT_ena&0xff=5:Aux PUD2}{TOT_ena&0xff=6:Aux PUD3}{TOT_ena&0xff=7:EGT Input}{TOT_ena&0xff=8:Aux PUD4}{TOT_ena&0xff=9" VALUE 0x001480a6 /* @ECU_Address@TOT_ena@0x010093D0@ */ ECIPP_ALIGNMENT_UBYTE 255 TOT_ena_COMPU_VTAB 0 255 BIT_MASK 0xff /end CHARACTERISTIC
/begin COMPU_METHOD TOT_ena_COMPU_VTAB "Verbal Table" TAB_VERB "%.0" "list" COMPU_TAB_REF TOT_ena_COMPU_VTAB_REF /end COMPU_METHOD
/begin COMPU_VTAB TOT_ena_COMPU_VTAB_REF "Verbal Table" TAB_VERB 31 0 "Disabled" 1 "Aux PU1" 2 "Aux PU2" 3 "Aux PU3" 4 "Aux PUD1" 5 "Aux PUD2" 6 "Aux PUD3" 7 "EGT Input" 8 "Aux PUD4" 9 "Aux PUD5" 10 "Aux PUD6" 11 "Aux PUD7" 12 "Aux PUD8" 13 "Aux PUD9" 14 "Aux PUD10" 15 "Aux PUD11" 16 "Aux PUD12" 17 "Aux PUD13" 18 "Aux PUD14" 19 "Aux PUD15" 20 "Aux PUD16" 21 "Aux PUD17" 22 "Aux PUD18" 23 "Aux PUD19" 24 "Aux PUD20" 25 "Aux PUD21" 26 "Aux PUD22" 27 "Aux PUD23" 28 "Aux PUD24" 29 "Aux PUD25" 30 "CAN sourced" DEFAULT_VALUE "UNKNOWN" /end COMPU_VTAB
/begin CHARACTERISTIC EMP_ena "EMP sensor{EMP_ena&0xff=0:Disabled}{EMP_ena&0xff=1:Aux PD1}{EMP_ena&0xff=2:Aux PD2}{EMP_ena&0xff=3:Aux PD3}{EMP_ena&0xff=4:Aux PUD1}{EMP_ena&0xff=5:Aux PUD2}{EMP_ena&0xff=6:Aux PUD3}{EMP_ena&0xff=7:Aux PUD4}{EMP_ena&0xff=8:Aux PUD5}{EMP_ena&0xff=9:Aux PUD" VALUE 0x00147d31 /* @ECU_Address@EMP_ena@0x01009408@ */ ECIPP_ALIGNMENT_UBYTE 255 EMP_ena_COMPU_VTAB 0 255 BIT_MASK 0xff /end CHARACTERISTIC
/begin COMPU_METHOD EMP_ena_COMPU_VTAB "Verbal Table" TAB_VERB "%.0" "list" COMPU_TAB_REF EMP_ena_COMPU_VTAB_REF /end COMPU_METHOD
/begin COMPU_VTAB EMP_ena_COMPU_VTAB_REF "Verbal Table" TAB_VERB 31 0 "Disabled" 1 "Aux PD1" 2 "Aux PD2" 3 "Aux PD3" 4 "Aux PUD1" 5 "Aux PUD2" 6 "Aux PUD3" 7 "Aux PUD4" 8 "Aux PUD5" 9 "Aux PUD6" 10 "Aux PUD7" 11 "Aux PUD8" 12 "Aux PUD9" 13 "Aux PUD10" 14 "Aux PUD11" 15 "Aux PUD12" 16 "Aux PUD13" 17 "Aux PUD14" 18 "Aux PUD15" 19 "CAN sourced" 20 "FPP2 Input" 21 "Aux PUD16" 22 "Aux PUD17" 23 "Aux PUD18" 24 "Aux PUD19" 25 "Aux PUD20" 26 "Aux PUD21" 27 "Aux PUD22" 28 "Aux PUD23" 29 "Aux PUD24" 30 "Aux PUD25" DEFAULT_VALUE "UNKNOWN" /end COMPU_VTAB
/begin CHARACTERISTIC EGR_PWM_period "EGR PWM frequency" VALUE 0x001401b4 /* @ECU_Address@EGR_PWM_period@0x01009428@ */ ECIPP_ALIGNMENT_ULONG 10000000000 Compu_EGR_PWM_period 0 10000000000 /end CHARACTERISTIC
/begin COMPU_METHOD Compu_EGR_PWM_period " " RAT_FUNC "%.0" "Hz" COEFFS 0 0 1 0 0.00000005 0 /end COMPU_METHOD
/begin CHARACTERISTIC EBP_T_select "EBP local temperature{EBP_T_select&0xff=0:EGT}{EBP_T_select&0xff=1:TOT}" VALUE 0x00147d14 /* @ECU_Address@EBP_T_select@0x010097D0@ */ ECIPP_ALIGNMENT_UBYTE 255 EBP_T_select_COMPU_VTAB 0 255 BIT_MASK 0xff /end CHARACTERISTIC
/begin COMPU_METHOD EBP_T_select_COMPU_VTAB "Verbal Table" TAB_VERB "%.0" "list" COMPU_TAB_REF EBP_T_select_COMPU_VTAB_REF /end COMPU_METHOD
/begin COMPU_VTAB EBP_T_select_COMPU_VTAB_REF "Verbal Table" TAB_VERB 2 0 "EGT" 1 "TOT" DEFAULT_VALUE "UNKNOWN" /end COMPU_VTAB
/begin CHARACTERISTIC TC_mdot_avg_tau "Turbo average flow tau" VALUE 0x00143a80 /* @ECU_Address@TC_mdot_avg_tau@0x01009840@ */ ECIPP_ALIGNMENT_FLOAT32_IEEE 10000000000 Compu_TC_mdot_avg_tau -10000000000 10000000000 /end CHARACTERISTIC
/begin COMPU_METHOD Compu_TC_mdot_avg_tau " " RAT_FUNC "%.1" "sec" COEFFS 0 1000 0 0 0 1 /end COMPU_METHOD
/begin CHARACTERISTIC TC_mdot_nom "Turbo nominal flow rate" VALUE 0x0014783a /* @ECU_Address@TC_mdot_nom@0x01009848@ */ ECIPP_ALIGNMENT_UWORD 1024 Compu_TC_mdot_nom 0 1023.984375 /end CHARACTERISTIC
/begin COMPU_METHOD Compu_TC_mdot_nom " " RAT_FUNC "%.1" "g/sec" COEFFS 0 64 0 0 0 1 /end COMPU_METHOD
/begin CHARACTERISTIC TC_mech_eta "Turbo mechanical efficiency" VALUE 0x0014783c /* @ECU_Address@TC_mech_eta@0x01009850@ */ ECIPP_ALIGNMENT_UWORD 200 Compu_TC_mech_eta 0 199.996948242188 /end CHARACTERISTIC
/begin COMPU_METHOD Compu_TC_mech_eta " " RAT_FUNC "%.1" "%" COEFFS 0 327.68 0 0 0 1 /end COMPU_METHOD
/begin CHARACTERISTIC EGR_vlv_tau "EGR PWM position feedback tau" VALUE 0x00140990 /* @ECU_Address@EGR_vlv_tau@0x01009E48@ */ ECIPP_ALIGNMENT_UWORD 327680 Compu_EGR_vlv_tau 0.45084 327680 /end CHARACTERISTIC
/begin COMPU_METHOD Compu_EGR_vlv_tau " " FORM "%.1" "ms"
 /begin FORMULA "-5 / log(1 - (X1 / 65536))" FORMULA_INV "(1 - exp(-5/X1)) * 65536" /end FORMULA
/end COMPU_METHOD
/begin MEASUREMENT m_d_port "Diluent mass inducted at port" UWORD Compu_m_d_port 0 0 0 16383.75 ECU_ADDRESS 0x0100A128 /end MEASUREMENT
/begin COMPU_METHOD Compu_m_d_port " " RAT_FUNC "%.1" "mg/intake" COEFFS 0 4 0 0 0 1 /end COMPU_METHOD
/begin MEASUREMENT mdot_d_ports_float "Diluent mass flow at port" FLOAT32_IEEE Compu_mdot_d_ports_float 0 0 -10000000000 10000000000 ECU_ADDRESS 0x0100A130 /end MEASUREMENT
/begin COMPU_METHOD Compu_mdot_d_ports_float " " RAT_FUNC "%.2" "g/sec" COEFFS 0 1 0 0 0 1 /end COMPU_METHOD
/begin CHARACTERISTIC MAF_cyl_events "MAF measuring window" VALUE 0x001439c8 /* @ECU_Address@MAF_cyl_events@0x0100A270@ */ ECIPP_ALIGNMENT_FLOAT32_IEEE 10000000000 Compu_MAF_cyl_events -10000000000 10000000000 /end CHARACTERISTIC
/begin COMPU_METHOD Compu_MAF_cyl_events " " RAT_FUNC "%.0" "cyl events" COEFFS 0 1 0 0 0 1 /end COMPU_METHOD
/begin CHARACTERISTIC MAF_flow_tau_ms "MAF low-pass tau" VALUE 0x001439cc /* @ECU_Address@MAF_flow_tau_ms@0x0100A278@ */ ECIPP_ALIGNMENT_FLOAT32_IEEE 10000000000 Compu_MAF_flow_tau_ms -10000000000 10000000000 /end CHARACTERISTIC
/begin COMPU_METHOD Compu_MAF_flow_tau_ms " " RAT_FUNC "%.1" "ms" COEFFS 0 1 0 0 0 1 /end COMPU_METHOD
/begin CHARACTERISTIC EGR_Vrelay_nominal "EGR nominal operating voltage" VALUE 0x001408b6 /* @ECU_Address@EGR_Vrelay_nominal@0x0100A300@ */ ECIPP_ALIGNMENT_UWORD 256 Compu_EGR_Vrelay_nominal 0 255.99609375 /end CHARACTERISTIC
/begin COMPU_METHOD Compu_EGR_Vrelay_nominal " " RAT_FUNC "%.1" "volts" COEFFS 0 256 0 0 0 1 /end COMPU_METHOD
/begin MEASUREMENT mdot_tot_TPSf "Total mixed flow at throttle" FLOAT32_IEEE Compu_mdot_tot_TPSf 0 0 -10000000000 10000000000 ECU_ADDRESS 0x0100A660 /end MEASUREMENT
/begin COMPU_METHOD Compu_mdot_tot_TPSf " " RAT_FUNC "%.1" "g/sec" COEFFS 0 1 0 0 0 1 /end COMPU_METHOD
/begin MEASUREMENT mdot_eng_TPSf "Port mixed flow esimated from TM" FLOAT32_IEEE Compu_mdot_eng_TPSf 0 0 -10000000000 10000000000 ECU_ADDRESS 0x0100A668 /end MEASUREMENT
/begin COMPU_METHOD Compu_mdot_eng_TPSf " " RAT_FUNC "%.1" "g/sec" COEFFS 0 1 0 0 0 1 /end COMPU_METHOD
/begin MEASUREMENT mdot_eng_Nrho "Port mixed flow from speed-density" FLOAT32_IEEE Compu_mdot_eng_Nrho 0 0 -10000000000 10000000000 ECU_ADDRESS 0x0100A670 /end MEASUREMENT
/begin COMPU_METHOD Compu_mdot_eng_Nrho " " RAT_FUNC "%.1" "g/sec" COEFFS 0 1 0 0 0 1 /end COMPU_METHOD
/begin MEASUREMENT mdot_trans_TPSf "Transient mixed flow at throttle" FLOAT32_IEEE Compu_mdot_trans_TPSf 0 0 -10000000000 10000000000 ECU_ADDRESS 0x0100A678 /end MEASUREMENT
/begin COMPU_METHOD Compu_mdot_trans_TPSf " " RAT_FUNC "%.1" "g/sec" COEFFS 0 1 0 0 0 1 /end COMPU_METHOD
/begin MEASUREMENT mdot_transdz_TPSf "Deadzoned transient flow at throttle" FLOAT32_IEEE Compu_mdot_transdz_TPSf 0 0 -10000000000 10000000000 ECU_ADDRESS 0x0100A680 /end MEASUREMENT
/begin COMPU_METHOD Compu_mdot_transdz_TPSf " " RAT_FUNC "%.1" "g/sec" COEFFS 0 1 0 0 0 1 /end COMPU_METHOD
/begin MEASUREMENT mdot_f_TBfV_dP "Valve downstream fuel volume dm/dt" FLOAT32_IEEE Compu_mdot_f_TBfV_dP 0 0 -10000000000 10000000000 ECU_ADDRESS 0x0100A688 /end MEASUREMENT
/begin COMPU_METHOD Compu_mdot_f_TBfV_dP " " RAT_FUNC "%.2" "g/sec" COEFFS 0 1 0 0 0 1 /end COMPU_METHOD
/begin MEASUREMENT PR_pseudo "MAP/TIP pseudo pressure ratio" UWORD Compu_PR_pseudo 0 0 0 1.99996948242188 ECU_ADDRESS 0x0100A698 /end MEASUREMENT
/begin COMPU_METHOD Compu_PR_pseudo " " RAT_FUNC "%.3" "PR" COEFFS 0 32768 0 0 0 1 /end COMPU_METHOD
/begin MEASUREMENT MAP_windowed "Cylinder-event averaged MAP" UWORD Compu_MAP_windowed 0 0 0 255.99609375 ECU_ADDRESS 0x0100A6A0 /end MEASUREMENT
/begin COMPU_METHOD Compu_MAP_windowed " " RAT_FUNC "%.2" "psia" COEFFS 0 256 0 0 0 1 /end COMPU_METHOD
/begin MEASUREMENT TIP_windowed "Cylinder-event averaged TIP" UWORD Compu_TIP_windowed 0 0 0 255.99609375 ECU_ADDRESS 0x0100A6A8 /end MEASUREMENT
/begin COMPU_METHOD Compu_TIP_windowed " " RAT_FUNC "%.2" "psia" COEFFS 0 256 0 0 0 1 /end COMPU_METHOD
/begin MEASUREMENT TMTPSad_pct "TM area adaptive correction" SWORD Compu_TMTPSad_pct 0 0 -100 99.9969482421875 ECU_ADDRESS 0x0100A6B0 /end MEASUREMENT
/begin COMPU_METHOD Compu_TMTPSad_pct " " RAT_FUNC "%.1" "%" COEFFS 0 327.68 0 0 0 1 /end COMPU_METHOD
/begin MEASUREMENT TMtf_trans_wgt "TM-Nrho port fueling transient weight" UWORD Compu_TMtf_trans_wgt 0 0 0 99.9984741210938 ECU_ADDRESS 0x0100A6B8 /end MEASUREMENT
/begin COMPU_METHOD Compu_TMtf_trans_wgt " " RAT_FUNC "%.1" "%" COEFFS 0 655.36 0 0 0 1 /end COMPU_METHOD
/begin MEASUREMENT TMtf_trans_dzabspct "Transient flow abs fraction at throttle" UWORD Compu_TMtf_trans_dzabspct 0 0 0 1599.9755859375 ECU_ADDRESS 0x0100A6C0 /end MEASUREMENT
/begin COMPU_METHOD Compu_TMtf_trans_dzabspct " " RAT_FUNC "%.1" "%" COEFFS 0 40.96 0 0 0 1 /end COMPU_METHOD
/begin CHARACTERISTIC mdot_trans_TPS_dzpct "Cubic deadzone limit for transient flow" VALUE 0x00147b5e /* @ECU_Address@mdot_trans_TPS_dzpct@0x0100A6C8@ */ ECIPP_ALIGNMENT_UWORD 1600 Compu_mdot_trans_TPS_dzpct 0 1599.9755859375 /end CHARACTERISTIC
/begin COMPU_METHOD Compu_mdot_trans_TPS_dzpct " " RAT_FUNC "%.1" "% port flow" COEFFS 0 40.96 0 0 0 1 /end COMPU_METHOD
/begin CHARACTERISTIC TB_fuelV "Valve downstream fuel volume" VALUE 0x00147820 /* @ECU_Address@TB_fuelV@0x0100A6D0@ */ ECIPP_ALIGNMENT_UWORD 32 Compu_TB_fuelV 0 31.99951171875 /end CHARACTERISTIC
/begin COMPU_METHOD Compu_TB_fuelV " " RAT_FUNC "%.3" "L" COEFFS 0 2048 0 0 0 1 /end COMPU_METHOD
/begin CHARACTERISTIC TMtf_TPScmd_tau_inc "TPS cmd delay increasing tau" VALUE 0x001478be /* @ECU_Address@TMtf_TPScmd_tau_inc@0x0100A6D8@ */ ECIPP_ALIGNMENT_UWORD 1024 Compu_TMtf_TPScmd_tau_inc 0 1023.984375 /end CHARACTERISTIC
/begin COMPU_METHOD Compu_TMtf_TPScmd_tau_inc " " RAT_FUNC "%.1" "ms" COEFFS 0 64 0 0 0 1 /end COMPU_METHOD
/begin CHARACTERISTIC TMtf_TPScmd_tau_dec "TPS cmd delay decreasing tau" VALUE 0x001478bc /* @ECU_Address@TMtf_TPScmd_tau_dec@0x0100A6E0@ */ ECIPP_ALIGNMENT_UWORD 1024 Compu_TMtf_TPScmd_tau_dec 0 1023.984375 /end CHARACTERISTIC
/begin COMPU_METHOD Compu_TMtf_TPScmd_tau_dec " " RAT_FUNC "%.1" "ms" COEFFS 0 64 0 0 0 1 /end COMPU_METHOD
/begin CHARACTERISTIC TMtf_trans_sldn "Decay rate from full TM to N-rho fueling" VALUE 0x001478c4 /* @ECU_Address@TMtf_trans_sldn@0x0100A6E8@ */ ECIPP_ALIGNMENT_UWORD 100 Compu_TMtf_trans_sldn 0 99.9984741210938 /end CHARACTERISTIC
/begin COMPU_METHOD Compu_TMtf_trans_sldn " " RAT_FUNC "%.1" "%/ms" COEFFS 0 655.36 0 0 0 1 /end COMPU_METHOD
/begin CHARACTERISTIC TMtf_trans_min "Lower transient for 100% N-rho fueling" VALUE 0x001478c2 /* @ECU_Address@TMtf_trans_min@0x0100A6F0@ */ ECIPP_ALIGNMENT_UWORD 1600 Compu_TMtf_trans_min 0 1599.9755859375 /end CHARACTERISTIC
/begin COMPU_METHOD Compu_TMtf_trans_min " " RAT_FUNC "%.1" "%" COEFFS 0 40.96 0 0 0 1 /end COMPU_METHOD
/begin CHARACTERISTIC TMtf_trans_max "Upper transient for 100% TM fueling" VALUE 0x001478c0 /* @ECU_Address@TMtf_trans_max@0x0100A6F8@ */ ECIPP_ALIGNMENT_UWORD 1600 Compu_TMtf_trans_max 0 1599.9755859375 /end CHARACTERISTIC
/begin COMPU_METHOD Compu_TMtf_trans_max " " RAT_FUNC "%.1" "%" COEFFS 0 40.96 0 0 0 1 /end COMPU_METHOD
/begin CHARACTERISTIC TMtf_PRov_min "Lower PR override for 100% TM fueling" VALUE 0x001478ba /* @ECU_Address@TMtf_PRov_min@0x0100A700@ */ ECIPP_ALIGNMENT_UWORD 2 Compu_TMtf_PRov_min 0 1.99996948242188 /end CHARACTERISTIC
/begin COMPU_METHOD Compu_TMtf_PRov_min " " RAT_FUNC "%.3" "PR" COEFFS 0 32768 0 0 0 1 /end COMPU_METHOD
/begin CHARACTERISTIC TMtf_PRov_max "Upper PR override for 100% N-rho fueling" VALUE 0x001478b8 /* @ECU_Address@TMtf_PRov_max@0x0100A708@ */ ECIPP_ALIGNMENT_UWORD 2 Compu_TMtf_PRov_max 0 1.99996948242188 /end CHARACTERISTIC
/begin COMPU_METHOD Compu_TMtf_PRov_max " " RAT_FUNC "%.3" "PR" COEFFS 0 32768 0 0 0 1 /end COMPU_METHOD
/begin CHARACTERISTIC TPSad_strt_wait "TM area adaptive start wait" VALUE 0x00144204 /* @ECU_Address@TPSad_strt_wait@0x0100A710@ */ ECIPP_ALIGNMENT_ULONG 4294967 Compu_TPSad_strt_wait 0 4294967.295 /end CHARACTERISTIC
/begin COMPU_METHOD Compu_TPSad_strt_wait " " RAT_FUNC "%.1" "sec" COEFFS 0 1000 0 0 0 1 /end COMPU_METHOD
/begin CHARACTERISTIC TPSad_trans_lim "TM adaptive update transient limit" VALUE 0x001478f8 /* @ECU_Address@TPSad_trans_lim@0x0100A718@ */ ECIPP_ALIGNMENT_UWORD 1600 Compu_TPSad_trans_lim 0 1599.9755859375 /end CHARACTERISTIC
/begin COMPU_METHOD Compu_TPSad_trans_lim " " RAT_FUNC "%.1" "%" COEFFS 0 40.96 0 0 0 1 /end COMPU_METHOD
/begin CHARACTERISTIC TPSad_adapt_dz "TM adaptive error deadzone" VALUE 0x001478f2 /* @ECU_Address@TPSad_adapt_dz@0x0100A720@ */ ECIPP_ALIGNMENT_UWORD 200 Compu_TPSad_adapt_dz 0 199.996948242188 /end CHARACTERISTIC
/begin COMPU_METHOD Compu_TPSad_adapt_dz " " RAT_FUNC "%.1" "%" COEFFS 0 327.68 0 0 0 1 /end COMPU_METHOD
/begin CHARACTERISTIC TPSad_Kadapt "TM adaptive gain" VALUE 0x001478e4 /* @ECU_Address@TPSad_Kadapt@0x0100A728@ */ ECIPP_ALIGNMENT_UWORD 1600 Compu_TPSad_Kadapt 0 1599.9755859375 /end CHARACTERISTIC
/begin COMPU_METHOD Compu_TPSad_Kadapt " " RAT_FUNC "%.0" "%/%/sec" COEFFS 0 40.96 0 0 0 1 /end COMPU_METHOD
/begin CHARACTERISTIC TPSad_adapt_lim "TM area adaptive +/- limit" VALUE 0x001478f4 /* @ECU_Address@TPSad_adapt_lim@0x0100A730@ */ ECIPP_ALIGNMENT_UWORD 200 Compu_TPSad_adapt_lim 0 199.996948242188 /end CHARACTERISTIC
/begin COMPU_METHOD Compu_TPSad_adapt_lim " " RAT_FUNC "%.1" "%" COEFFS 0 327.68 0 0 0 1 /end COMPU_METHOD
/begin CHARACTERISTIC TPSad_PR_max "TM adaptive PR upper limit" VALUE 0x001478ea /* @ECU_Address@TPSad_PR_max@0x0100A738@ */ ECIPP_ALIGNMENT_UWORD 2 Compu_TPSad_PR_max 0 1.99996948242188 /end CHARACTERISTIC
/begin COMPU_METHOD Compu_TPSad_PR_max " " RAT_FUNC "%.3" "PR" COEFFS 0 32768 0 0 0 1 /end COMPU_METHOD
/begin CHARACTERISTIC TPSad_MAP_min "TM adaptive MAP lower limit" VALUE 0x001478e6 /* @ECU_Address@TPSad_MAP_min@0x0100A740@ */ ECIPP_ALIGNMENT_UWORD 256 Compu_TPSad_MAP_min 0 255.99609375 /end CHARACTERISTIC
/begin COMPU_METHOD Compu_TPSad_MAP_min " " RAT_FUNC "%.2" "psia" COEFFS 0 256 0 0 0 1 /end COMPU_METHOD
/begin CHARACTERISTIC TPSad_learn_wait "TM adaptive learn wait time" VALUE 0x001478f6 /* @ECU_Address@TPSad_learn_wait@0x0100A748@ */ ECIPP_ALIGNMENT_UWORD 65535 Compu_TPSad_learn_wait 0 65535 /end CHARACTERISTIC
/begin COMPU_METHOD Compu_TPSad_learn_wait " " RAT_FUNC "%.0" "ms" COEFFS 0 1 0 0 0 1 /end COMPU_METHOD
/begin CHARACTERISTIC CFV_Preg_HiExp "CFV HiExp (actual-commanded) pressure > (Fault Condition:or CFV (actual-commanded) pressure >)" VALUE 0x00144258 /* @ECU_Address@CFV_Preg_HiExp@0x0100B158@ */ ECIPP_ALIGNMENT_SWORD 128 Compu_CFV_Preg_HiExp -128 127.99609375 /end CHARACTERISTIC
/begin COMPU_METHOD Compu_CFV_Preg_HiExp " " RAT_FUNC "%.2" "psi" COEFFS 0 256 0 0 0 1 /end COMPU_METHOD
/begin CHARACTERISTIC CFV_Preg_LoExp "CFV LoExp (actual-commanded) pressure < (Fault Condition:or CFV (actual-commanded) pressure <)" VALUE 0x0014425a /* @ECU_Address@CFV_Preg_LoExp@0x0100B160@ */ ECIPP_ALIGNMENT_SWORD 128 Compu_CFV_Preg_LoExp -128 127.99609375 /end CHARACTERISTIC
/begin COMPU_METHOD Compu_CFV_Preg_LoExp " " RAT_FUNC "%.2" "psi" COEFFS 0 256 0 0 0 1 /end COMPU_METHOD
/begin MEASUREMENT TMtf_PR_wgt "TM-MAPdt manifold filling PR weight" UWORD Compu_TMtf_PR_wgt 0 0 0 99.9984741210938 ECU_ADDRESS 0x0100B410 /end MEASUREMENT
/begin COMPU_METHOD Compu_TMtf_PR_wgt " " RAT_FUNC "%.1" "%" COEFFS 0 655.36 0 0 0 1 /end COMPU_METHOD
/begin CHARACTERISTIC TC_comp_eta_surge "Compressor efficiency - surge" VALUE 0x00147836 /* @ECU_Address@TC_comp_eta_surge@0x0100B4E0@ */ ECIPP_ALIGNMENT_UWORD 400 Compu_TC_comp_eta_surge 0 399.993896484375 /end CHARACTERISTIC
/begin COMPU_METHOD Compu_TC_comp_eta_surge " " RAT_FUNC "%.1" "%" COEFFS 0 163.84 0 0 0 1 /end COMPU_METHOD
/begin CHARACTERISTIC TC_comp_eta_choke "Compressor efficiency - choked" VALUE 0x00147834 /* @ECU_Address@TC_comp_eta_choke@0x0100B4E8@ */ ECIPP_ALIGNMENT_UWORD 400 Compu_TC_comp_eta_choke 0 399.993896484375 /end CHARACTERISTIC
/begin COMPU_METHOD Compu_TC_comp_eta_choke " " RAT_FUNC "%.1" "%" COEFFS 0 163.84 0 0 0 1 /end COMPU_METHOD
/begin CHARACTERISTIC TC_comp_Pratio_min "Compressor min surge press ratio" VALUE 0x0014782e /* @ECU_Address@TC_comp_Pratio_min@0x0100B4F0@ */ ECIPP_ALIGNMENT_UWORD 32 Compu_TC_comp_Pratio_min 0 31.99951171875 /end CHARACTERISTIC
/begin COMPU_METHOD Compu_TC_comp_Pratio_min " " RAT_FUNC "%.2" "-" COEFFS 0 2048 0 0 0 1 /end COMPU_METHOD
/begin CHARACTERISTIC TC_comp_mdotr_Ld "Compressor reference flow per liter" VALUE 0x00147838 /* @ECU_Address@TC_comp_mdotr_Ld@0x0100B930@ */ ECIPP_ALIGNMENT_UWORD 1024 Compu_TC_comp_mdotr_Ld 0 1023.984375 /end CHARACTERISTIC
/begin COMPU_METHOD Compu_TC_comp_mdotr_Ld " " RAT_FUNC "%.1" "g/sec/Ld" COEFFS 0 64 0 0 0 1 /end COMPU_METHOD
/begin CHARACTERISTIC TC_comp_Nr "Compressor reference speed" VALUE 0x0014782c /* @ECU_Address@TC_comp_Nr@0x0100B938@ */ ECIPP_ALIGNMENT_UWORD 1024 Compu_TC_comp_Nr 0 1023.984375 /end CHARACTERISTIC
/begin COMPU_METHOD Compu_TC_comp_Nr " " RAT_FUNC "%.1" "Krpm" COEFFS 0 64 0 0 0 1 /end COMPU_METHOD
/begin CHARACTERISTIC TC_comp_Pref "Compressor reference P" VALUE 0x00147830 /* @ECU_Address@TC_comp_Pref@0x0100B940@ */ ECIPP_ALIGNMENT_UWORD 256 Compu_TC_comp_Pref 0 255.99609375 /end CHARACTERISTIC
/begin COMPU_METHOD Compu_TC_comp_Pref " " RAT_FUNC "%.2" "psia" COEFFS 0 256 0 0 0 1 /end COMPU_METHOD
/begin CHARACTERISTIC TC_comp_Tref "Compressor reference T" VALUE 0x00147832 /* @ECU_Address@TC_comp_Tref@0x0100B948@ */ ECIPP_ALIGNMENT_UWORD 564 Compu_TC_comp_Tref -460 563.984375 /end CHARACTERISTIC
/begin COMPU_METHOD Compu_TC_comp_Tref " " RAT_FUNC "%.1" "deg F" COEFFS 0 64 29440 0 0 1 /end COMPU_METHOD
/begin CHARACTERISTIC TC_turb_Nr_pct "Turbine reference speed" VALUE 0x0014783e /* @ECU_Address@TC_turb_Nr_pct@0x0100B950@ */ ECIPP_ALIGNMENT_UWORD 400 Compu_TC_turb_Nr_pct 0 399.993896484375 /end CHARACTERISTIC
/begin COMPU_METHOD Compu_TC_turb_Nr_pct " " RAT_FUNC "%.1" "% comp ref" COEFFS 0 163.84 0 0 0 1 /end COMPU_METHOD
/begin CHARACTERISTIC TC_turb_Pref "Turbine reference P" VALUE 0x00147840 /* @ECU_Address@TC_turb_Pref@0x0100B958@ */ ECIPP_ALIGNMENT_UWORD 256 Compu_TC_turb_Pref 0 255.99609375 /end CHARACTERISTIC
/begin COMPU_METHOD Compu_TC_turb_Pref " " RAT_FUNC "%.2" "psia" COEFFS 0 256 0 0 0 1 /end COMPU_METHOD
/begin CHARACTERISTIC TC_turb_Tref "Turbine reference T" VALUE 0x00147842 /* @ECU_Address@TC_turb_Tref@0x0100B960@ */ ECIPP_ALIGNMENT_UWORD 564 Compu_TC_turb_Tref -460 563.984375 /end CHARACTERISTIC
/begin COMPU_METHOD Compu_TC_turb_Tref " " RAT_FUNC "%.1" "deg F" COEFFS 0 64 29440 0 0 1 /end COMPU_METHOD
/begin CHARACTERISTIC TC_turb_etamin "Turbine minimum efficiency" VALUE 0x00147844 /* @ECU_Address@TC_turb_etamin@0x0100B968@ */ ECIPP_ALIGNMENT_UWORD 400 Compu_TC_turb_etamin 0 399.993896484375 /end CHARACTERISTIC
/begin COMPU_METHOD Compu_TC_turb_etamin " " RAT_FUNC "%.1" "%" COEFFS 0 163.84 0 0 0 1 /end COMPU_METHOD
/begin CHARACTERISTIC TC_turb_mdotr_pct "Turbine reference flow" VALUE 0x00147848 /* @ECU_Address@TC_turb_mdotr_pct@0x0100B970@ */ ECIPP_ALIGNMENT_UWORD 400 Compu_TC_turb_mdotr_pct 0 399.993896484375 /end CHARACTERISTIC
/begin COMPU_METHOD Compu_TC_turb_mdotr_pct " " RAT_FUNC "%.1" "% comp ref" COEFFS 0 163.84 0 0 0 1 /end COMPU_METHOD
/begin CHARACTERISTIC TC_turb_mdot0c_pct "Full-closed corrected flow" VALUE 0x00147846 /* @ECU_Address@TC_turb_mdot0c_pct@0x0100B978@ */ ECIPP_ALIGNMENT_UWORD 400 Compu_TC_turb_mdot0c_pct 0 399.993896484375 /end CHARACTERISTIC
/begin COMPU_METHOD Compu_TC_turb_mdot0c_pct " " RAT_FUNC "%.1" "% ref" COEFFS 0 163.84 0 0 0 1 /end COMPU_METHOD
/begin MEASUREMENT m_d_pct_reqnom "Diluent request (mass fraction)" UWORD Compu_m_d_pct_reqnom 0 0 0 399.993896484375 ECU_ADDRESS 0x0100BD28 /end MEASUREMENT
/begin COMPU_METHOD Compu_m_d_pct_reqnom " " RAT_FUNC "%.2" "%" COEFFS 0 163.84 0 0 0 1 /end COMPU_METHOD
/begin MEASUREMENT mdot_filter_float "Air filter flow rate" FLOAT32_IEEE Compu_mdot_filter_float 0 0 -10000000000 10000000000 ECU_ADDRESS 0x0100CBF0 /end MEASUREMENT
/begin COMPU_METHOD Compu_mdot_filter_float " " RAT_FUNC "%.1" "g/sec" COEFFS 0 1 0 0 0 1 /end COMPU_METHOD
/begin MEASUREMENT mdot_a_intake_float "Intake flow - air" FLOAT32_IEEE Compu_mdot_a_intake_float 0 0 -10000000000 10000000000 ECU_ADDRESS 0x0100CBF8 /end MEASUREMENT
/begin COMPU_METHOD Compu_mdot_a_intake_float " " RAT_FUNC "%.1" "g/sec" COEFFS 0 1 0 0 0 1 /end COMPU_METHOD
/begin MEASUREMENT mdot_f_intake_float "Intake flow - fuel" FLOAT32_IEEE Compu_mdot_f_intake_float 0 0 -10000000000 10000000000 ECU_ADDRESS 0x0100CC00 /end MEASUREMENT
/begin COMPU_METHOD Compu_mdot_f_intake_float " " RAT_FUNC "%.2" "g/sec" COEFFS 0 1 0 0 0 1 /end COMPU_METHOD
/begin MEASUREMENT mdot_intake_float "Intake flow - total" FLOAT32_IEEE Compu_mdot_intake_float 0 0 -10000000000 10000000000 ECU_ADDRESS 0x0100CC08 /end MEASUREMENT
/begin COMPU_METHOD Compu_mdot_intake_float " " RAT_FUNC "%.1" "g/sec" COEFFS 0 1 0 0 0 1 /end COMPU_METHOD
/begin MEASUREMENT mdot_a_fill_float "Intake flow - air" FLOAT32_IEEE Compu_mdot_a_fill_float 0 0 -10000000000 10000000000 ECU_ADDRESS 0x0100CC18 /end MEASUREMENT
/begin COMPU_METHOD Compu_mdot_a_fill_float " " RAT_FUNC "%.1" "g/sec" COEFFS 0 1 0 0 0 1 /end COMPU_METHOD
/begin MEASUREMENT mdot_f_fill_float "Intake flow - fuel" FLOAT32_IEEE Compu_mdot_f_fill_float 0 0 -10000000000 10000000000 ECU_ADDRESS 0x0100CC20 /end MEASUREMENT
/begin COMPU_METHOD Compu_mdot_f_fill_float " " RAT_FUNC "%.2" "g/sec" COEFFS 0 1 0 0 0 1 /end COMPU_METHOD
/begin MEASUREMENT mdot_d_fill_float "Intake flow - diluent" FLOAT32_IEEE Compu_mdot_d_fill_float 0 0 -10000000000 10000000000 ECU_ADDRESS 0x0100CC28 /end MEASUREMENT
/begin COMPU_METHOD Compu_mdot_d_fill_float " " RAT_FUNC "%.1" "g/sec" COEFFS 0 1 0 0 0 1 /end COMPU_METHOD
/begin MEASUREMENT mdot_a_EGR_float "EGR flow - air" FLOAT32_IEEE Compu_mdot_a_EGR_float 0 0 -10000000000 10000000000 ECU_ADDRESS 0x0100CC38 /end MEASUREMENT
/begin COMPU_METHOD Compu_mdot_a_EGR_float " " RAT_FUNC "%.1" "g/sec" COEFFS 0 1 0 0 0 1 /end COMPU_METHOD
/begin MEASUREMENT mdot_f_EGR_float "EGR flow - fuel" FLOAT32_IEEE Compu_mdot_f_EGR_float 0 0 -10000000000 10000000000 ECU_ADDRESS 0x0100CC40 /end MEASUREMENT
/begin COMPU_METHOD Compu_mdot_f_EGR_float " " RAT_FUNC "%.2" "g/sec" COEFFS 0 1 0 0 0 1 /end COMPU_METHOD
/begin MEASUREMENT mdot_d_EGR_float "EGR flow - diluent" FLOAT32_IEEE Compu_mdot_d_EGR_float 0 0 -10000000000 10000000000 ECU_ADDRESS 0x0100CC48 /end MEASUREMENT
/begin COMPU_METHOD Compu_mdot_d_EGR_float " " RAT_FUNC "%.1" "g/sec" COEFFS 0 1 0 0 0 1 /end COMPU_METHOD
/begin MEASUREMENT mdot_EGR_float "EGR flow - total" FLOAT32_IEEE Compu_mdot_EGR_float 0 0 -10000000000 10000000000 ECU_ADDRESS 0x0100CC50 /end MEASUREMENT
/begin COMPU_METHOD Compu_mdot_EGR_float " " RAT_FUNC "%.1" "g/sec" COEFFS 0 1 0 0 0 1 /end COMPU_METHOD
/begin MEASUREMENT mdot_a_ivlv_float "Intake valve flow - air" FLOAT32_IEEE Compu_mdot_a_ivlv_float 0 0 -10000000000 10000000000 ECU_ADDRESS 0x0100CC58 /end MEASUREMENT
/begin COMPU_METHOD Compu_mdot_a_ivlv_float " " RAT_FUNC "%.1" "g/sec" COEFFS 0 1 0 0 0 1 /end COMPU_METHOD
/begin MEASUREMENT mdot_f_ivlv_float "Intake valve flow - fuel" FLOAT32_IEEE Compu_mdot_f_ivlv_float 0 0 -10000000000 10000000000 ECU_ADDRESS 0x0100CC60 /end MEASUREMENT
/begin COMPU_METHOD Compu_mdot_f_ivlv_float " " RAT_FUNC "%.2" "g/sec" COEFFS 0 1 0 0 0 1 /end COMPU_METHOD
/begin MEASUREMENT mdot_d_ivlv_float "Intake valve flow - diluent" FLOAT32_IEEE Compu_mdot_d_ivlv_float 0 0 -10000000000 10000000000 ECU_ADDRESS 0x0100CC68 /end MEASUREMENT
/begin COMPU_METHOD Compu_mdot_d_ivlv_float " " RAT_FUNC "%.1" "g/sec" COEFFS 0 1 0 0 0 1 /end COMPU_METHOD
/begin MEASUREMENT mdot_ivlv_float "Intake valve flow - total" FLOAT32_IEEE Compu_mdot_ivlv_float 0 0 -10000000000 10000000000 ECU_ADDRESS 0x0100CC70 /end MEASUREMENT
/begin COMPU_METHOD Compu_mdot_ivlv_float " " RAT_FUNC "%.1" "g/sec" COEFFS 0 1 0 0 0 1 /end COMPU_METHOD
/begin MEASUREMENT mdot_a_evlv_float "Exhaust valve flow - air" FLOAT32_IEEE Compu_mdot_a_evlv_float 0 0 -10000000000 10000000000 ECU_ADDRESS 0x0100CC78 /end MEASUREMENT
/begin COMPU_METHOD Compu_mdot_a_evlv_float " " RAT_FUNC "%.1" "g/sec" COEFFS 0 1 0 0 0 1 /end COMPU_METHOD
/begin MEASUREMENT mdot_f_evlv_float "Exhaust valve flow - fuel" FLOAT32_IEEE Compu_mdot_f_evlv_float 0 0 -10000000000 10000000000 ECU_ADDRESS 0x0100CC80 /end MEASUREMENT
/begin COMPU_METHOD Compu_mdot_f_evlv_float " " RAT_FUNC "%.2" "g/sec" COEFFS 0 1 0 0 0 1 /end COMPU_METHOD
/begin MEASUREMENT mdot_d_evlv_float "Exhaust valve flow - diluent" FLOAT32_IEEE Compu_mdot_d_evlv_float 0 0 -10000000000 10000000000 ECU_ADDRESS 0x0100CC88 /end MEASUREMENT
/begin COMPU_METHOD Compu_mdot_d_evlv_float " " RAT_FUNC "%.1" "g/sec" COEFFS 0 1 0 0 0 1 /end COMPU_METHOD
/begin MEASUREMENT mdot_evlv_float "Exhaust valve flow - total" FLOAT32_IEEE Compu_mdot_evlv_float 0 0 -10000000000 10000000000 ECU_ADDRESS 0x0100CC90 /end MEASUREMENT
/begin COMPU_METHOD Compu_mdot_evlv_float " " RAT_FUNC "%.1" "g/sec" COEFFS 0 1 0 0 0 1 /end COMPU_METHOD
/begin MEASUREMENT mdot_a_exhaust_float "Exhaust flow - air" FLOAT32_IEEE Compu_mdot_a_exhaust_float 0 0 -10000000000 10000000000 ECU_ADDRESS 0x0100CC98 /end MEASUREMENT
/begin COMPU_METHOD Compu_mdot_a_exhaust_float " " RAT_FUNC "%.1" "g/sec" COEFFS 0 1 0 0 0 1 /end COMPU_METHOD
/begin MEASUREMENT mdot_f_exhaust_float "Exhaust flow - fuel" FLOAT32_IEEE Compu_mdot_f_exhaust_float 0 0 -10000000000 10000000000 ECU_ADDRESS 0x0100CCA0 /end MEASUREMENT
/begin COMPU_METHOD Compu_mdot_f_exhaust_float " " RAT_FUNC "%.2" "g/sec" COEFFS 0 1 0 0 0 1 /end COMPU_METHOD
/begin MEASUREMENT mdot_d_exhaust_float "Exhaust flow - diluent" FLOAT32_IEEE Compu_mdot_d_exhaust_float 0 0 -10000000000 10000000000 ECU_ADDRESS 0x0100CCA8 /end MEASUREMENT
/begin COMPU_METHOD Compu_mdot_d_exhaust_float " " RAT_FUNC "%.1" "g/sec" COEFFS 0 1 0 0 0 1 /end COMPU_METHOD
/begin MEASUREMENT mdot_exhaust_float "Exhaust flow - total" FLOAT32_IEEE Compu_mdot_exhaust_float 0 0 -10000000000 10000000000 ECU_ADDRESS 0x0100CCB0 /end MEASUREMENT
/begin COMPU_METHOD Compu_mdot_exhaust_float " " RAT_FUNC "%.1" "g/sec" COEFFS 0 1 0 0 0 1 /end COMPU_METHOD
/begin CHARACTERISTIC IMVD_Ifb_hi "IMV high-current short-circuit detection threshold (Fault Condition:IMV raw (uncompensated) current >)" VALUE 0x0016c524 /* @ECU_Address@IMVD_Ifb_hi@0x0100CEE8@ */ ECIPP_ALIGNMENT_SWORD 32 Compu_IMVD_Ifb_hi -32 31.9990234375 /end CHARACTERISTIC
/begin COMPU_METHOD Compu_IMVD_Ifb_hi " " RAT_FUNC "%.2" "amps" COEFFS 0 1024 0 0 0 1 /end COMPU_METHOD
/begin CHARACTERISTIC IMVD_Ifb_lo "IMV low-current open-circuit detection threshold (Fault Condition:IMV raw (uncompensated) current <)" VALUE 0x0016c526 /* @ECU_Address@IMVD_Ifb_lo@0x0100CEF0@ */ ECIPP_ALIGNMENT_SWORD 32 Compu_IMVD_Ifb_lo -32 31.9990234375 /end CHARACTERISTIC
/begin COMPU_METHOD Compu_IMVD_Ifb_lo " " RAT_FUNC "%.2" "amps" COEFFS 0 1024 0 0 0 1 /end COMPU_METHOD
/begin CHARACTERISTIC IMVD_lo_Icmd "IMV open-circuit detection minimum current command (Fault Condition:Proportional-IMV:  and commanded current >)" VALUE 0x0016c7fa /* @ECU_Address@IMVD_lo_Icmd@0x0100CEF8@ */ ECIPP_ALIGNMENT_UWORD 64 Compu_IMVD_lo_Icmd 0 63.9990234375 /end CHARACTERISTIC
/begin COMPU_METHOD Compu_IMVD_lo_Icmd " " RAT_FUNC "%.2" "amps" COEFFS 0 1024 0 0 0 1 /end COMPU_METHOD
/begin CHARACTERISTIC IMVD_lo_PWcmd "IMV open-circuit detection minimum pulse-width command (Fault Condition:Pulsed-IMV:  and total pulse-width >)" VALUE 0x0016c7fc /* @ECU_Address@IMVD_lo_PWcmd@0x0100CF00@ */ ECIPP_ALIGNMENT_UWORD 65535 Compu_IMVD_lo_PWcmd 0 65535 /end CHARACTERISTIC
/begin COMPU_METHOD Compu_IMVD_lo_PWcmd " " RAT_FUNC "%.0" "us" COEFFS 0 1 0 0 0 1 /end COMPU_METHOD
/begin CHARACTERISTIC INJD_Vboost_LOtol "CRI low boost voltage (target - actual) limit (Fault Condition:and minimum boost voltage (target - actual) <)" VALUE 0x0016c81e /* @ECU_Address@INJD_Vboost_LOtol@0x0100CF08@ */ ECIPP_ALIGNMENT_UWORD 1024 Compu_INJD_Vboost_LOtol 0 1023.984375 /end CHARACTERISTIC
/begin COMPU_METHOD Compu_INJD_Vboost_LOtol " " RAT_FUNC "%.1" "volts" COEFFS 0 64 0 0 0 1 /end COMPU_METHOD
/begin CHARACTERISTIC INJD_Vboost_HItol "CRI high boost voltage (actual - target) limit (Fault Condition:and maximum boost voltage (actual - target) <)" VALUE 0x0016c81c /* @ECU_Address@INJD_Vboost_HItol@0x0100CF10@ */ ECIPP_ALIGNMENT_UWORD 1024 Compu_INJD_Vboost_HItol 0 1023.984375 /end CHARACTERISTIC
/begin COMPU_METHOD Compu_INJD_Vboost_HItol " " RAT_FUNC "%.1" "volts" COEFFS 0 64 0 0 0 1 /end COMPU_METHOD
/begin CHARACTERISTIC INJD_max_riseT "CR injector open-circuit detection max rise-time to peak current (Fault Condition:CR Injector current rise-time to peak >)" VALUE 0x0016c508 /* @ECU_Address@INJD_max_riseT@0x0100CF18@ */ ECIPP_ALIGNMENT_ULONG 214748365 Compu_INJD_max_riseT 0 214748364.75 /end CHARACTERISTIC
/begin COMPU_METHOD Compu_INJD_max_riseT " " RAT_FUNC "%.0" "us" COEFFS 0 20 0 0 0 1 /end COMPU_METHOD
/begin CHARACTERISTIC INJD_min_riseT "CR injector short-circuit detection min rise-time to peak current (Fault Condition:CR Injector current rise-time to peak <)" VALUE 0x0016c50c /* @ECU_Address@INJD_min_riseT@0x0100CF20@ */ ECIPP_ALIGNMENT_ULONG 214748365 Compu_INJD_min_riseT 0 214748364.75 /end CHARACTERISTIC
/begin COMPU_METHOD Compu_INJD_min_riseT " " RAT_FUNC "%.0" "us" COEFFS 0 20 0 0 0 1 /end COMPU_METHOD
/begin CHARACTERISTIC CRI_FPerr_high "CRI high fuel pressure diagnostic error tolerance (Fault Condition:or Common-Rail (actual - target) fuel pressure >)" VALUE 0x0016c7b6 /* @ECU_Address@CRI_FPerr_high@0x0100CF38@ */ ECIPP_ALIGNMENT_UWORD 8192 Compu_CRI_FPerr_high 0 8191.875 /end CHARACTERISTIC
/begin COMPU_METHOD Compu_CRI_FPerr_high " " RAT_FUNC "%.1" "bar" COEFFS 0 8 0 0 0 1 /end COMPU_METHOD
/begin CHARACTERISTIC CRI_FPerr_low "CRI low fuel pressure diagnostic error tolerance (Fault Condition:or Common-Rail (target - actual) fuel pressure >)" VALUE 0x0016c7b8 /* @ECU_Address@CRI_FPerr_low@0x0100CF40@ */ ECIPP_ALIGNMENT_UWORD 8192 Compu_CRI_FPerr_low 0 8191.875 /end CHARACTERISTIC
/begin COMPU_METHOD Compu_CRI_FPerr_low " " RAT_FUNC "%.1" "bar" COEFFS 0 8 0 0 0 1 /end COMPU_METHOD
/begin CHARACTERISTIC key_on_relay_force "Key-on sets RELAY on{key_on_relay_force&0xff=0:Disabled}{key_on_relay_force&0xff=1:Enabled}" VALUE 0x001481a3 /* @ECU_Address@key_on_relay_force@0x0100D798@ */ ECIPP_ALIGNMENT_UBYTE 255 key_on_relay_force_COMPU_VTAB 0 255 BIT_MASK 0xff /end CHARACTERISTIC
/begin COMPU_METHOD key_on_relay_force_COMPU_VTAB "Verbal Table" TAB_VERB "%.0" "list" COMPU_TAB_REF key_on_relay_force_COMPU_VTAB_REF /end COMPU_METHOD
/begin COMPU_VTAB key_on_relay_force_COMPU_VTAB_REF "Verbal Table" TAB_VERB 2 0 "Disabled" 1 "Enabled" DEFAULT_VALUE "UNKNOWN" /end COMPU_VTAB
/begin CHARACTERISTIC DATE_engine_defMfg "General # DATE_engine_defMfg" VALUE 0x00161ccc /* @ECU_Address@DATE_engine_defMfg@0x0100D908@ */ ECIPP_ALIGNMENT_ULONG 4294967295 Compu_DATE_engine_defMfg 0 4294967295 /end CHARACTERISTIC
/begin COMPU_METHOD Compu_DATE_engine_defMfg " " RAT_FUNC "%.0" "date" COEFFS 0 1 0 0 0 1 /end COMPU_METHOD
/begin CHARACTERISTIC EBP_mpsi_select "Exhaust back pressure units{EBP_mpsi_select&0xff=0:upsig / (l/s)^2}{EBP_mpsi_select&0xff=1:mpsig / (l/s)^2}" VALUE 0x00147d17 /* @ECU_Address@EBP_mpsi_select@0x0100D918@ */ ECIPP_ALIGNMENT_UBYTE 255 EBP_mpsi_select_COMPU_VTAB 0 255 BIT_MASK 0xff /end CHARACTERISTIC
/begin COMPU_METHOD EBP_mpsi_select_COMPU_VTAB "Verbal Table" TAB_VERB "%.0" "list" COMPU_TAB_REF EBP_mpsi_select_COMPU_VTAB_REF /end COMPU_METHOD
/begin COMPU_VTAB EBP_mpsi_select_COMPU_VTAB_REF "Verbal Table" TAB_VERB 2 0 "upsig / (l/s)^2" 1 "mpsig / (l/s)^2" DEFAULT_VALUE "UNKNOWN" /end COMPU_VTAB
/begin CHARACTERISTIC COT_ena "COT source{COT_ena&0xff=0:Disabled}{COT_ena&0xff=1:Aux PU1}{COT_ena&0xff=2:Aux PU2}{COT_ena&0xff=3:Aux PU3}{COT_ena&0xff=4:Aux PUD1}{COT_ena&0xff=5:Aux PUD2}{COT_ena&0xff=6:Aux PUD3}{COT_ena&0xff=7:EGT Input}{COT_ena&0xff=8:Aux PUD4}{COT_ena&0xff=9:Aux PU" VALUE 0x00147d01 /* @ECU_Address@COT_ena@0x0100EED8@ */ ECIPP_ALIGNMENT_UBYTE 255 COT_ena_COMPU_VTAB 0 255 BIT_MASK 0xff /end CHARACTERISTIC
/begin COMPU_METHOD COT_ena_COMPU_VTAB "Verbal Table" TAB_VERB "%.0" "list" COMPU_TAB_REF COT_ena_COMPU_VTAB_REF /end COMPU_METHOD
/begin COMPU_VTAB COT_ena_COMPU_VTAB_REF "Verbal Table" TAB_VERB 31 0 "Disabled" 1 "Aux PU1" 2 "Aux PU2" 3 "Aux PU3" 4 "Aux PUD1" 5 "Aux PUD2" 6 "Aux PUD3" 7 "EGT Input" 8 "Aux PUD4" 9 "Aux PUD5" 10 "Aux PUD6" 11 "Aux PUD7" 12 "Aux PUD8" 13 "Aux PUD9" 14 "Aux PUD10" 15 "Aux PUD11" 16 "Aux PUD12" 17 "Aux PUD13" 18 "Aux PUD14" 19 "Aux PUD15" 20 "Aux PUD16" 21 "Aux PUD17" 22 "Aux PUD18" 23 "Aux PUD19" 24 "Aux PUD20" 25 "Aux PUD21" 26 "Aux PUD22" 27 "Aux PUD23" 28 "Aux PUD24" 29 "Aux PUD25" 30 "CAN sourced" DEFAULT_VALUE "UNKNOWN" /end COMPU_VTAB
/begin CHARACTERISTIC TPSad_mode "TM adaptive mode{TPSad_mode&0xff=0:Single Mode: Area %}{TPSad_mode&0xff=1:Dual Mode: Area CdA + PR}" VALUE 0x001480ab /* @ECU_Address@TPSad_mode@0x0100F030@ */ ECIPP_ALIGNMENT_UBYTE 255 TPSad_mode_COMPU_VTAB 0 255 BIT_MASK 0xff /end CHARACTERISTIC
/begin COMPU_METHOD TPSad_mode_COMPU_VTAB "Verbal Table" TAB_VERB "%.0" "list" COMPU_TAB_REF TPSad_mode_COMPU_VTAB_REF /end COMPU_METHOD
/begin COMPU_VTAB TPSad_mode_COMPU_VTAB_REF "Verbal Table" TAB_VERB 2 0 "Single Mode: Area %" 1 "Dual Mode: Area CdA + PR" DEFAULT_VALUE "UNKNOWN" /end COMPU_VTAB
/begin CHARACTERISTIC TPSad_TPS_min "TM adapt min valve position" VALUE 0x001478f0 /* @ECU_Address@TPSad_TPS_min@0x0100F038@ */ ECIPP_ALIGNMENT_UWORD 100 Compu_TPSad_TPS_min 0 99.9984741210938 /end CHARACTERISTIC
/begin COMPU_METHOD Compu_TPSad_TPS_min " " RAT_FUNC "%.2" "% pos" COEFFS 0 655.36 0 0 0 1 /end COMPU_METHOD
/begin CHARACTERISTIC TPSad_PRadapt_sw "TM adapt CdA to PR transition start" VALUE 0x001478ec /* @ECU_Address@TPSad_PRadapt_sw@0x0100F040@ */ ECIPP_ALIGNMENT_UWORD 2 Compu_TPSad_PRadapt_sw 0 1.99996948242188 /end CHARACTERISTIC
/begin COMPU_METHOD Compu_TPSad_PRadapt_sw " " RAT_FUNC "%.3" "-" COEFFS 0 32768 0 0 0 1 /end COMPU_METHOD
/begin CHARACTERISTIC TPSad_PRadapt_swend "TM adapt CdA to PR transition end" VALUE 0x001478ee /* @ECU_Address@TPSad_PRadapt_swend@0x0100F048@ */ ECIPP_ALIGNMENT_UWORD 2 Compu_TPSad_PRadapt_swend 0 1.99996948242188 /end CHARACTERISTIC
/begin COMPU_METHOD Compu_TPSad_PRadapt_swend " " RAT_FUNC "%.3" "-" COEFFS 0 32768 0 0 0 1 /end COMPU_METHOD
/begin MEASUREMENT TPSad_PRadapt_ratio "TM adapt CdA vs. PR adaption" FLOAT32_IEEE Compu_TPSad_PRadapt_ratio 0 0 -10000000000 10000000000 ECU_ADDRESS 0x0100F050 /end MEASUREMENT
/begin COMPU_METHOD Compu_TPSad_PRadapt_ratio " " RAT_FUNC "%.2" "0=CdA, 1=PR" COEFFS 0 1 0 0 0 1 /end COMPU_METHOD
/begin CHARACTERISTIC TPSad_CdA_Kadapt "TM adapt CdA learn gain" VALUE 0x001478e0 /* @ECU_Address@TPSad_CdA_Kadapt@0x0100F058@ */ ECIPP_ALIGNMENT_UWORD 1600 Compu_TPSad_CdA_Kadapt 0 1599.9755859375 /end CHARACTERISTIC
/begin COMPU_METHOD Compu_TPSad_CdA_Kadapt " " RAT_FUNC "%.2" "% area/%/sec" COEFFS 0 40.96 0 0 0 1 /end COMPU_METHOD
/begin CHARACTERISTIC TPSad_CdA_adapt_lim "TM adapt CdA learn +/- limit" VALUE 0x001453a4 /* @ECU_Address@TPSad_CdA_adapt_lim@0x0100F060@ */ ECIPP_ALIGNMENT_SWORD 100 Compu_TPSad_CdA_adapt_lim -100 99.9969482421875 /end CHARACTERISTIC
/begin COMPU_METHOD Compu_TPSad_CdA_adapt_lim " " RAT_FUNC "%.1" "% area" COEFFS 0 327.68 0 0 0 1 /end COMPU_METHOD
/begin CHARACTERISTIC TPSad_CdA_adapt_Amin "TM adapt CdA learn +/-min area limit" VALUE 0x001478e2 /* @ECU_Address@TPSad_CdA_adapt_Amin@0x0100F068@ */ ECIPP_ALIGNMENT_UWORD 64 Compu_TPSad_CdA_adapt_Amin 0 63.9990234375 /end CHARACTERISTIC
/begin COMPU_METHOD Compu_TPSad_CdA_adapt_Amin " " RAT_FUNC "%.3" "in^2" COEFFS 0 1024 0 0 0 1 /end COMPU_METHOD
/begin MEASUREMENT TPSad_CdA_in2 "TM adapt CdA correction" FLOAT32_IEEE Compu_TPSad_CdA_in2 0 0 -10000000000 10000000000 ECU_ADDRESS 0x0100F070 /end MEASUREMENT
/begin COMPU_METHOD Compu_TPSad_CdA_in2 " " RAT_FUNC "%.3" "in^2" COEFFS 0 1 0 0 0 1 /end COMPU_METHOD
/begin CHARACTERISTIC TPSad_PR_Kadapt "TM adapt PR learn gain" VALUE 0x001478e8 /* @ECU_Address@TPSad_PR_Kadapt@0x0100F078@ */ ECIPP_ALIGNMENT_UWORD 1600 Compu_TPSad_PR_Kadapt 0 1599.9755859375 /end CHARACTERISTIC
/begin COMPU_METHOD Compu_TPSad_PR_Kadapt " " RAT_FUNC "%.2" "% PR/%/sec" COEFFS 0 40.96 0 0 0 1 /end COMPU_METHOD
/begin CHARACTERISTIC TPSad_PR_adapt_lim "TM adapt PR learn +/- limit" VALUE 0x001453a6 /* @ECU_Address@TPSad_PR_adapt_lim@0x0100F080@ */ ECIPP_ALIGNMENT_SWORD 200 Compu_TPSad_PR_adapt_lim -200 199.993896484375 /end CHARACTERISTIC
/begin COMPU_METHOD Compu_TPSad_PR_adapt_lim " " RAT_FUNC "%.1" "% PR" COEFFS 0 163.84 0 0 0 1 /end COMPU_METHOD
/begin MEASUREMENT TPSad_PR_adapt_crct "TM adapt PR correction" FLOAT32_IEEE Compu_TPSad_PR_adapt_crct 0 0 -10000000000 10000000000 ECU_ADDRESS 0x0100F098 /end MEASUREMENT
/begin COMPU_METHOD Compu_TPSad_PR_adapt_crct " " RAT_FUNC "%.1" "% PR" COEFFS 0 0.01 0 0 0 1 /end COMPU_METHOD
/begin MEASUREMENT TPSad_adapt_assist "TM adapt cal assist mode{TPSad_adapt_assist&0xff=0:Inactive}{TPSad_adapt_assist&0xff=1:Adapt Freeze Updates}{TPSad_adapt_assist&0xff=2:Adapt Freeze + Zero Crct}{TPSad_adapt_assist&0xff=3:Adapt Clear Tables}" UBYTE TPSad_adapt_assist_COMPU_VTAB 0 0 0 255 ECU_ADDRESS 0x0100F0A0 BIT_MASK 0xff /end MEASUREMENT
/begin COMPU_METHOD TPSad_adapt_assist_COMPU_VTAB "Verbal Table" TAB_VERB "%.0" "list" COMPU_TAB_REF TPSad_adapt_assist_COMPU_VTAB_REF /end COMPU_METHOD
/begin COMPU_VTAB TPSad_adapt_assist_COMPU_VTAB_REF "Verbal Table" TAB_VERB 4 0 "Inactive" 1 "Adapt Freeze Updates" 2 "Adapt Freeze + Zero Crct" 3 "Adapt Clear Tables" DEFAULT_VALUE "UNKNOWN" /end COMPU_VTAB
/begin MEASUREMENT PR_uncrct "MAP/TIP pseudo pressure ratio - raw" UWORD Compu_PR_uncrct 0 0 0 1.99996948242188 ECU_ADDRESS 0x0100F1C0 /end MEASUREMENT
/begin COMPU_METHOD Compu_PR_uncrct " " RAT_FUNC "%.3" "PR" COEFFS 0 32768 0 0 0 1 /end COMPU_METHOD
/begin MEASUREMENT TPSad_status "TM adaptive status{TPSad_status&0xff=0:Reserved}{TPSad_status&0xff=1:Inactive: Run Wait}{TPSad_status&0xff=2:Inactive: Transient}{TPSad_status&0xff=3:Inactive: PR High}{TPSad_status&0xff=4:Inactive: MAP Low}{TPSad_status&0xff=5:Inactive: Learn Wait}{TPSad" UBYTE TPSad_status_COMPU_VTAB 0 0 0 255 ECU_ADDRESS 0x0100F1C8 BIT_MASK 0xff /end MEASUREMENT
/begin COMPU_METHOD TPSad_status_COMPU_VTAB "Verbal Table" TAB_VERB "%.0" "list" COMPU_TAB_REF TPSad_status_COMPU_VTAB_REF /end COMPU_METHOD
/begin COMPU_VTAB TPSad_status_COMPU_VTAB_REF "Verbal Table" TAB_VERB 11 0 "Reserved" 1 "Inactive: Run Wait" 2 "Inactive: Transient" 3 "Inactive: PR High" 4 "Inactive: MAP Low" 5 "Inactive: Learn Wait" 6 "Inactive: Deadzone" 7 "Inactive: TPS Low" 8 "Inactive: Freeze" 9 "Active" 10 "Inactive: Fault Active" DEFAULT_VALUE "UNKNOWN" /end COMPU_VTAB
/begin CHARACTERISTIC TPSad_global_use "TM adapt for global use{TPSad_global_use&0xff=0:Inactive}{TPSad_global_use&0xff=1:Boost TPSd}" VALUE 0x001480aa /* @ECU_Address@TPSad_global_use@0x010102A8@ */ ECIPP_ALIGNMENT_UBYTE 255 TPSad_global_use_COMPU_VTAB 0 255 BIT_MASK 0xff /end CHARACTERISTIC
/begin COMPU_METHOD TPSad_global_use_COMPU_VTAB "Verbal Table" TAB_VERB "%.0" "list" COMPU_TAB_REF TPSad_global_use_COMPU_VTAB_REF /end COMPU_METHOD
/begin COMPU_VTAB TPSad_global_use_COMPU_VTAB_REF "Verbal Table" TAB_VERB 2 0 "Inactive" 1 "Boost TPSd" DEFAULT_VALUE "UNKNOWN" /end COMPU_VTAB
/begin CHARACTERISTIC CylTempSwt_chan "Cylinder temperature switch input{CylTempSwt_chan&0xff=0:Disabled}{CylTempSwt_chan&0xff=1:Aux PU1 = Gnd}{CylTempSwt_chan&0xff=2:Aux PU2 = Gnd}{CylTempSwt_chan&0xff=3:Aux PU3 = Gnd}{CylTempSwt_chan&0xff=4:Aux PUD1 = Gnd}{CylTempSwt_chan&0xff=5:Aux PUD2 = G" VALUE 0x00147d0a /* @ECU_Address@CylTempSwt_chan@0x01010D68@ */ ECIPP_ALIGNMENT_UBYTE 255 CylTempSwt_chan_COMPU_VTAB 0 255 BIT_MASK 0xff /end CHARACTERISTIC
/begin COMPU_METHOD CylTempSwt_chan_COMPU_VTAB "Verbal Table" TAB_VERB "%.0" "list" COMPU_TAB_REF CylTempSwt_chan_COMPU_VTAB_REF /end COMPU_METHOD
/begin COMPU_VTAB CylTempSwt_chan_COMPU_VTAB_REF "Verbal Table" TAB_VERB 30 0 "Disabled" 1 "Aux PU1 = Gnd" 2 "Aux PU2 = Gnd" 3 "Aux PU3 = Gnd" 4 "Aux PUD1 = Gnd" 5 "Aux PUD2 = Gnd" 6 "Aux PUD3 = Gnd" 7 "Aux PUD4 = +V" 8 "Aux PUD5 = Gnd" 9 "Aux DIG1" 10 "Aux DIG2" 11 "Aux DIG3" 12 "Aux DIG4" 13 "Aux DIG5" 14 "Aux DIG6" 15 "Aux DIG7" 16 "Aux DIG8" 17 "Aux DIG9" 18 "Aux DIG10" 19 "Aux DIG11" 20 "Aux DIG12" 21 "Aux DIG13" 22 "Aux DIG14" 23 "Aux DIG15" 24 "Aux DIG16" 25 "Aux DIG17" 26 "Aux DIG18" 27 "Aux DIG19" 28 "Gov1" 29 "Gov2" DEFAULT_VALUE "UNKNOWN" /end COMPU_VTAB
/begin CHARACTERISTIC CylTempSwt_chan_cfg "Cylinder temperature switch Aux DIG config{CylTempSwt_chan_cfg&0xff=0:Default}{CylTempSwt_chan_cfg&0xff=1:GND}{CylTempSwt_chan_cfg&0xff=2:GND/+V}{CylTempSwt_chan_cfg&0xff=3:+V}{CylTempSwt_chan_cfg&0xff=4:Open}" VALUE 0x00147d0b /* @ECU_Address@CylTempSwt_chan_cfg@0x01010D70@ */ ECIPP_ALIGNMENT_UBYTE 255 CylTempSwt_chan_cfg_COMPU_VTAB 0 255 BIT_MASK 0xff /end CHARACTERISTIC
/begin COMPU_METHOD CylTempSwt_chan_cfg_COMPU_VTAB "Verbal Table" TAB_VERB "%.0" "list" COMPU_TAB_REF CylTempSwt_chan_cfg_COMPU_VTAB_REF /end COMPU_METHOD
/begin COMPU_VTAB CylTempSwt_chan_cfg_COMPU_VTAB_REF "Verbal Table" TAB_VERB 5 0 "Default" 1 "GND" 2 "GND/+V" 3 "+V" 4 "Open" DEFAULT_VALUE "UNKNOWN" /end COMPU_VTAB
/begin CHARACTERISTIC VDS_enghrs_limit "VDS Time Limit" VALUE 0x00162b9c /* @ECU_Address@VDS_enghrs_limit@0x01010EA8@ */ ECIPP_ALIGNMENT_ULONG 1193046 Compu_VDS_enghrs_limit 0 1193046.47083333 /end CHARACTERISTIC
/begin COMPU_METHOD Compu_VDS_enghrs_limit " " RAT_FUNC "%.3" "Hours" COEFFS 0 3600 0 0 0 1 /end COMPU_METHOD
/begin CHARACTERISTIC adapt_fuel_rpm_src "Adapt RPM source{adapt_fuel_rpm_src&0xff=0:Actual RPM}{adapt_fuel_rpm_src&0xff=1:Desired RPM}" VALUE 0x0016960a /* @ECU_Address@adapt_fuel_rpm_src@0x01011918@ */ ECIPP_ALIGNMENT_UBYTE 255 adapt_fuel_rpm_src_COMPU_VTAB 0 255 BIT_MASK 0xff /end CHARACTERISTIC
/begin COMPU_METHOD adapt_fuel_rpm_src_COMPU_VTAB "Verbal Table" TAB_VERB "%.0" "list" COMPU_TAB_REF adapt_fuel_rpm_src_COMPU_VTAB_REF /end COMPU_METHOD
/begin COMPU_VTAB adapt_fuel_rpm_src_COMPU_VTAB_REF "Verbal Table" TAB_VERB 2 0 "Actual RPM" 1 "Desired RPM" DEFAULT_VALUE "UNKNOWN" /end COMPU_VTAB
/begin CHARACTERISTIC adapt_fuel_rpm_dz "Adapt disable updates RPM deadzone" VALUE 0x001650e0 /* @ECU_Address@adapt_fuel_rpm_dz@0x01011920@ */ ECIPP_ALIGNMENT_UWORD 65535 Compu_adapt_fuel_rpm_dz 0 65535 /end CHARACTERISTIC
/begin COMPU_METHOD Compu_adapt_fuel_rpm_dz " " RAT_FUNC "%.0" "rpm" COEFFS 0 1 0 0 0 1 /end COMPU_METHOD
/begin CHARACTERISTIC HWARN_lamp "Hard warning lamp{HWARN_lamp&0xff=0:Disabled}{HWARN_lamp&0xff=1:Amber Warning Lamp}{HWARN_lamp&0xff=2:Red Stop Lamp}{HWARN_lamp&0xff=3:Protect Lamp}" VALUE 0x00147dac /* @ECU_Address@HWARN_lamp@0x01011B68@ */ ECIPP_ALIGNMENT_UBYTE 255 HWARN_lamp_COMPU_VTAB 0 255 BIT_MASK 0xff /end CHARACTERISTIC
/begin COMPU_METHOD HWARN_lamp_COMPU_VTAB "Verbal Table" TAB_VERB "%.0" "list" COMPU_TAB_REF HWARN_lamp_COMPU_VTAB_REF /end COMPU_METHOD
/begin COMPU_VTAB HWARN_lamp_COMPU_VTAB_REF "Verbal Table" TAB_VERB 4 0 "Disabled" 1 "Amber Warning Lamp" 2 "Red Stop Lamp" 3 "Protect Lamp" DEFAULT_VALUE "UNKNOWN" /end COMPU_VTAB
/begin CHARACTERISTIC SWARN_lamp "Soft warning lamp{SWARN_lamp&0xff=0:Disabled}{SWARN_lamp&0xff=1:Amber Warning Lamp}{SWARN_lamp&0xff=2:Red Stop Lamp}{SWARN_lamp&0xff=3:Protect Lamp}" VALUE 0x00148061 /* @ECU_Address@SWARN_lamp@0x01011B70@ */ ECIPP_ALIGNMENT_UBYTE 255 SWARN_lamp_COMPU_VTAB 0 255 BIT_MASK 0xff /end CHARACTERISTIC
/begin COMPU_METHOD SWARN_lamp_COMPU_VTAB "Verbal Table" TAB_VERB "%.0" "list" COMPU_TAB_REF SWARN_lamp_COMPU_VTAB_REF /end COMPU_METHOD
/begin COMPU_VTAB SWARN_lamp_COMPU_VTAB_REF "Verbal Table" TAB_VERB 4 0 "Disabled" 1 "Amber Warning Lamp" 2 "Red Stop Lamp" 3 "Protect Lamp" DEFAULT_VALUE "UNKNOWN" /end COMPU_VTAB
/begin CHARACTERISTIC DERATE_lamp "Derate lamp{DERATE_lamp&0xff=0:Disabled}{DERATE_lamp&0xff=1:Amber Warning Lamp}{DERATE_lamp&0xff=2:Red Stop Lamp}{DERATE_lamp&0xff=3:Protect Lamp}" VALUE 0x00147d0f /* @ECU_Address@DERATE_lamp@0x01011B80@ */ ECIPP_ALIGNMENT_UBYTE 255 DERATE_lamp_COMPU_VTAB 0 255 BIT_MASK 0xff /end CHARACTERISTIC
/begin COMPU_METHOD DERATE_lamp_COMPU_VTAB "Verbal Table" TAB_VERB "%.0" "list" COMPU_TAB_REF DERATE_lamp_COMPU_VTAB_REF /end COMPU_METHOD
/begin COMPU_VTAB DERATE_lamp_COMPU_VTAB_REF "Verbal Table" TAB_VERB 4 0 "Disabled" 1 "Amber Warning Lamp" 2 "Red Stop Lamp" 3 "Protect Lamp" DEFAULT_VALUE "UNKNOWN" /end COMPU_VTAB
/begin CHARACTERISTIC LOWREVLIM_lamp "Low rev limit lamp{LOWREVLIM_lamp&0xff=0:Disabled}{LOWREVLIM_lamp&0xff=1:Amber Warning Lamp}{LOWREVLIM_lamp&0xff=2:Red Stop Lamp}{LOWREVLIM_lamp&0xff=3:Protect Lamp}" VALUE 0x00147e19 /* @ECU_Address@LOWREVLIM_lamp@0x01011B88@ */ ECIPP_ALIGNMENT_UBYTE 255 LOWREVLIM_lamp_COMPU_VTAB 0 255 BIT_MASK 0xff /end CHARACTERISTIC
/begin COMPU_METHOD LOWREVLIM_lamp_COMPU_VTAB "Verbal Table" TAB_VERB "%.0" "list" COMPU_TAB_REF LOWREVLIM_lamp_COMPU_VTAB_REF /end COMPU_METHOD
/begin COMPU_VTAB LOWREVLIM_lamp_COMPU_VTAB_REF "Verbal Table" TAB_VERB 4 0 "Disabled" 1 "Amber Warning Lamp" 2 "Red Stop Lamp" 3 "Protect Lamp" DEFAULT_VALUE "UNKNOWN" /end COMPU_VTAB
/begin CHARACTERISTIC SD_lamp "Shutdown active lamp{SD_lamp&0xff=0:Disabled}{SD_lamp&0xff=1:Amber Warning Lamp}{SD_lamp&0xff=2:Red Stop Lamp}{SD_lamp&0xff=3:Protect Lamp}" VALUE 0x00147f2c /* @ECU_Address@SD_lamp@0x01011B90@ */ ECIPP_ALIGNMENT_UBYTE 255 SD_lamp_COMPU_VTAB 0 255 BIT_MASK 0xff /end CHARACTERISTIC
/begin COMPU_METHOD SD_lamp_COMPU_VTAB "Verbal Table" TAB_VERB "%.0" "list" COMPU_TAB_REF SD_lamp_COMPU_VTAB_REF /end COMPU_METHOD
/begin COMPU_VTAB SD_lamp_COMPU_VTAB_REF "Verbal Table" TAB_VERB 4 0 "Disabled" 1 "Amber Warning Lamp" 2 "Red Stop Lamp" 3 "Protect Lamp" DEFAULT_VALUE "UNKNOWN" /end COMPU_VTAB
/begin CHARACTERISTIC DERATEblk_on "Derate blink on" VALUE 0x00147d11 /* @ECU_Address@DERATEblk_on@0x01011B98@ */ ECIPP_ALIGNMENT_UBYTE 12750 Compu_DERATEblk_on 0 12750 /end CHARACTERISTIC
/begin COMPU_METHOD Compu_DERATEblk_on " " RAT_FUNC "%.0" "On-Time (ms)" COEFFS 0 0.02 0 0 0 1 /end COMPU_METHOD
/begin CHARACTERISTIC LOWREVLIMblk_on "Low rev limit blink on" VALUE 0x00147e1c /* @ECU_Address@LOWREVLIMblk_on@0x01011BA0@ */ ECIPP_ALIGNMENT_UBYTE 12750 Compu_LOWREVLIMblk_on 0 12750 /end CHARACTERISTIC
/begin COMPU_METHOD Compu_LOWREVLIMblk_on " " RAT_FUNC "%.0" "On-Time (ms)" COEFFS 0 0.02 0 0 0 1 /end COMPU_METHOD
/begin CHARACTERISTIC SDblk_on "Shutdown active blink on" VALUE 0x00147f30 /* @ECU_Address@SDblk_on@0x01011BA8@ */ ECIPP_ALIGNMENT_UBYTE 12750 Compu_SDblk_on 0 12750 /end CHARACTERISTIC
/begin COMPU_METHOD Compu_SDblk_on " " RAT_FUNC "%.0" "On-Time (ms)" COEFFS 0 0.02 0 0 0 1 /end COMPU_METHOD
/begin CHARACTERISTIC DERATEblk_off "Shutdown active blink off" VALUE 0x00147d10 /* @ECU_Address@DERATEblk_off@0x01011BB0@ */ ECIPP_ALIGNMENT_UBYTE 12750 Compu_DERATEblk_off 0 12750 /end CHARACTERISTIC
/begin COMPU_METHOD Compu_DERATEblk_off " " RAT_FUNC "%.0" "Off-Time (ms)" COEFFS 0 0.02 0 0 0 1 /end COMPU_METHOD
/begin CHARACTERISTIC LOWREVLIMblk_off "Low rev limit blink off" VALUE 0x00147e1b /* @ECU_Address@LOWREVLIMblk_off@0x01011BB8@ */ ECIPP_ALIGNMENT_UBYTE 12750 Compu_LOWREVLIMblk_off 0 12750 /end CHARACTERISTIC
/begin COMPU_METHOD Compu_LOWREVLIMblk_off " " RAT_FUNC "%.0" "Off-Time (ms)" COEFFS 0 0.02 0 0 0 1 /end COMPU_METHOD
/begin CHARACTERISTIC SDblk_off "Shutdown active blink off" VALUE 0x00147f2f /* @ECU_Address@SDblk_off@0x01011BC0@ */ ECIPP_ALIGNMENT_UBYTE 12750 Compu_SDblk_off 0 12750 /end CHARACTERISTIC
/begin COMPU_METHOD Compu_SDblk_off " " RAT_FUNC "%.0" "Off-Time (ms)" COEFFS 0 0.02 0 0 0 1 /end COMPU_METHOD
/begin CHARACTERISTIC MIL_DM1_output "DM1 MIL output configuration{MIL_DM1_output&0xff=0:Legacy}{MIL_DM1_output&0xff=1:Euro VI Discriminatory MIL}" VALUE 0x00147e6d /* @ECU_Address@MIL_DM1_output@0x01011BC8@ */ ECIPP_ALIGNMENT_UBYTE 255 MIL_DM1_output_COMPU_VTAB 0 255 BIT_MASK 0xff /end CHARACTERISTIC
/begin COMPU_METHOD MIL_DM1_output_COMPU_VTAB "Verbal Table" TAB_VERB "%.0" "list" COMPU_TAB_REF MIL_DM1_output_COMPU_VTAB_REF /end COMPU_METHOD
/begin COMPU_VTAB MIL_DM1_output_COMPU_VTAB_REF "Verbal Table" TAB_VERB 2 0 "Legacy" 1 "Euro VI Discriminatory MIL" DEFAULT_VALUE "UNKNOWN" /end COMPU_VTAB
/begin CHARACTERISTIC TPSad_store_EE "TM adaptive retention memory{TPSad_store_EE&0xff=0:Battery}{TPSad_store_EE&0xff=1:Permanent}" VALUE 0x001480ac /* @ECU_Address@TPSad_store_EE@0x01012030@ */ ECIPP_ALIGNMENT_UBYTE 255 TPSad_store_EE_COMPU_VTAB 0 255 BIT_MASK 0xff /end CHARACTERISTIC
/begin COMPU_METHOD TPSad_store_EE_COMPU_VTAB "Verbal Table" TAB_VERB "%.0" "list" COMPU_TAB_REF TPSad_store_EE_COMPU_VTAB_REF /end COMPU_METHOD
/begin COMPU_VTAB TPSad_store_EE_COMPU_VTAB_REF "Verbal Table" TAB_VERB 2 0 "Battery" 1 "Permanent" DEFAULT_VALUE "UNKNOWN" /end COMPU_VTAB
/begin CHARACTERISTIC CWT_mode_LPG "CWT compensation mode - LPG{CWT_mode_LPG&0xff=0:Single-Point}{CWT_mode_LPG&0xff=1:1-D Table-Based}{CWT_mode_LPG&0xff=2:2-D Table-Based}" VALUE 0x001418c2 /* @ECU_Address@CWT_mode_LPG@0x01012C18@ */ ECIPP_ALIGNMENT_UBYTE 255 CWT_mode_LPG_COMPU_VTAB 0 255 BIT_MASK 0xff /end CHARACTERISTIC
/begin COMPU_METHOD CWT_mode_LPG_COMPU_VTAB "Verbal Table" TAB_VERB "%.0" "list" COMPU_TAB_REF CWT_mode_LPG_COMPU_VTAB_REF /end COMPU_METHOD
/begin COMPU_VTAB CWT_mode_LPG_COMPU_VTAB_REF "Verbal Table" TAB_VERB 3 0 "Single-Point" 1 "1-D Table-Based" 2 "2-D Table-Based" DEFAULT_VALUE "UNKNOWN" /end COMPU_VTAB
/begin CHARACTERISTIC CWT_mode_NG "CWT compensation mode - NG{CWT_mode_NG&0xff=0:Single-Point}{CWT_mode_NG&0xff=1:1-D Table-Based}{CWT_mode_NG&0xff=2:2-D Table-Based}" VALUE 0x0014282a /* @ECU_Address@CWT_mode_NG@0x01012C20@ */ ECIPP_ALIGNMENT_UBYTE 255 CWT_mode_NG_COMPU_VTAB 0 255 BIT_MASK 0xff /end CHARACTERISTIC
/begin COMPU_METHOD CWT_mode_NG_COMPU_VTAB "Verbal Table" TAB_VERB "%.0" "list" COMPU_TAB_REF CWT_mode_NG_COMPU_VTAB_REF /end COMPU_METHOD
/begin COMPU_VTAB CWT_mode_NG_COMPU_VTAB_REF "Verbal Table" TAB_VERB 3 0 "Single-Point" 1 "1-D Table-Based" 2 "2-D Table-Based" DEFAULT_VALUE "UNKNOWN" /end COMPU_VTAB
/begin CHARACTERISTIC TVE_VE "VE Base" MAP 0x001456B6 /* @ECU_Address@TVE_VE@0x02017000@ */ ECIPP_ALIGNMENT_SWORD 200 Compu_TVE_VE -200 199.993896484375
 /begin AXIS_DESCR COM_AXIS NO_INPUT_QUANTITY Compu_TVE_MAP 16 -128 127.99609375 AXIS_PTS_REF TVE_MAP /end AXIS_DESCR
 /begin AXIS_DESCR COM_AXIS NO_INPUT_QUANTITY Compu_TVE_rpm 16 -32768 32767 AXIS_PTS_REF TVE_rpm /end AXIS_DESCR
/end CHARACTERISTIC
/begin AXIS_PTS TVE_MAP " " 0x00145696 /* @ECU_Address@TVE_MAP@0x02018000@ */ NO_INPUT_QUANTITY ECIPP_Lookup_SWORD 0 Compu_TVE_MAP 16 -128 127.99609375 /end AXIS_PTS
/begin AXIS_PTS TVE_rpm " " 0x001458B6 /* @ECU_Address@TVE_rpm@0x02019000@ */ NO_INPUT_QUANTITY ECIPP_Lookup_SWORD 0 Compu_TVE_rpm 16 -32768 32767 /end AXIS_PTS
/begin COMPU_METHOD Compu_TVE_VE "" RAT_FUNC "%.1" "VE (%)" COEFFS 0 163.84 0 0 0 1 /end COMPU_METHOD
/begin COMPU_METHOD Compu_TVE_MAP " " RAT_FUNC "%.1" "MAP (psia)" COEFFS 0 256 0 0 0 1 /end COMPU_METHOD
/begin COMPU_METHOD Compu_TVE_rpm " " RAT_FUNC "%.0" "Speed (rpm)" COEFFS 0 1 0 0 0 1 /end COMPU_METHOD
/begin COMPU_METHOD Compu_TCWT_rpm " " RAT_FUNC "%.0" "Speed (rpm)" COEFFS 0 1 0 0 0 1 /end COMPU_METHOD
/begin CHARACTERISTIC TCWT_C_inc "CWT Inc Const" CURVE 0x001446DA /* @ECU_Address@TCWT_C_inc@0x02104000@ */ ECIPP_ALIGNMENT_SWORD 200 Compu_TCWT_C_inc -200 199.993896484375
 /begin AXIS_DESCR COM_AXIS NO_INPUT_QUANTITY Compu_TCWT_rpm 4 -32768 32767 AXIS_PTS_REF TCWT_rpm /end AXIS_DESCR
/end CHARACTERISTIC
/begin AXIS_PTS TCWT_rpm " " 0x001446E2 /* @ECU_Address@TCWT_rpm@0x02103000@ */ NO_INPUT_QUANTITY ECIPP_Lookup_SWORD 0 Compu_TCWT_rpm 4 -32768 32767 /end AXIS_PTS
/begin COMPU_METHOD Compu_TCWT_C_inc " " RAT_FUNC "%.2" "%/(g/s)" COEFFS 0 163.84 0 0 0 1 /end COMPU_METHOD
/begin CHARACTERISTIC TCWT_C_dec "CWT Dec Const" CURVE 0x001446D2 /* @ECU_Address@TCWT_C_dec@0x02105000@ */ ECIPP_ALIGNMENT_SWORD 200 Compu_TCWT_C_dec -200 199.993896484375
 /begin AXIS_DESCR COM_AXIS NO_INPUT_QUANTITY Compu_TCWT_rpm 4 -32768 32767 AXIS_PTS_REF TCWT_rpm /end AXIS_DESCR
/end CHARACTERISTIC
/begin COMPU_METHOD Compu_TCWT_C_dec " " RAT_FUNC "%.2" "%/(g/s)" COEFFS 0 163.84 0 0 0 1 /end COMPU_METHOD
/begin CHARACTERISTIC TCWT_tau_inc "CWT Inc Tau" CURVE 0x001446F2 /* @ECU_Address@TCWT_tau_inc@0x02106000@ */ ECIPP_ALIGNMENT_SWORD 33 Compu_TCWT_tau_inc -32.768 32.767
 /begin AXIS_DESCR COM_AXIS NO_INPUT_QUANTITY Compu_TCWT_rpm 4 -32768 32767 AXIS_PTS_REF TCWT_rpm /end AXIS_DESCR
/end CHARACTERISTIC
/begin COMPU_METHOD Compu_TCWT_tau_inc " " RAT_FUNC "%.3" "sec" COEFFS 0 1000 0 0 0 1 /end COMPU_METHOD
/begin CHARACTERISTIC TCWT_tau_dec "CWT Dec Tau" CURVE 0x001446EA /* @ECU_Address@TCWT_tau_dec@0x02107000@ */ ECIPP_ALIGNMENT_SWORD 33 Compu_TCWT_tau_dec -32.768 32.767
 /begin AXIS_DESCR COM_AXIS NO_INPUT_QUANTITY Compu_TCWT_rpm 4 -32768 32767 AXIS_PTS_REF TCWT_rpm /end AXIS_DESCR
/end CHARACTERISTIC
/begin COMPU_METHOD Compu_TCWT_tau_dec " " RAT_FUNC "%.3" "sec" COEFFS 0 1000 0 0 0 1 /end COMPU_METHOD
/begin COMPU_METHOD Compu_TCWT2_rpm " " RAT_FUNC "%.0" "Speed (rpm)" COEFFS 0 1 0 0 0 1 /end COMPU_METHOD
/begin COMPU_METHOD Compu_TCWT2_MAP " " RAT_FUNC "%.1" "MAP load (psia)" COEFFS 0 256 0 0 0 1 /end COMPU_METHOD
/begin CHARACTERISTIC TCWT2_pct "VE CWT 2-D Const Mult" MAP 0x001445B2 /* @ECU_Address@TCWT2_pct@0x02123000@ */ ECIPP_ALIGNMENT_SWORD 100 Compu_TCWT2_pct -100 99.9969482421875
 /begin AXIS_DESCR COM_AXIS NO_INPUT_QUANTITY Compu_TCWT2_MAP 8 -128 127.99609375 AXIS_PTS_REF TCWT2_MAP /end AXIS_DESCR
 /begin AXIS_DESCR COM_AXIS NO_INPUT_QUANTITY Compu_TCWT2_rpm 8 -32768 32767 AXIS_PTS_REF TCWT2_rpm /end AXIS_DESCR
/end CHARACTERISTIC
/begin AXIS_PTS TCWT2_MAP " " 0x00144522 /* @ECU_Address@TCWT2_MAP@0x02122000@ */ NO_INPUT_QUANTITY ECIPP_Lookup_SWORD 0 Compu_TCWT2_MAP 8 -128 127.99609375 /end AXIS_PTS
/begin AXIS_PTS TCWT2_rpm " " 0x00144632 /* @ECU_Address@TCWT2_rpm@0x02121000@ */ NO_INPUT_QUANTITY ECIPP_Lookup_SWORD 0 Compu_TCWT2_rpm 8 -32768 32767 /end AXIS_PTS
/begin COMPU_METHOD Compu_TCWT2_pct "" RAT_FUNC "%.2" "CWT 2-D (%fuel/%loadchg)" COEFFS 0 327.68 0 0 0 1 /end COMPU_METHOD
/begin CHARACTERISTIC TCWT2_tau "VE CWT 2-D Tau" MAP 0x00144652 /* @ECU_Address@TCWT2_tau@0x02124000@ */ ECIPP_ALIGNMENT_SWORD 33 Compu_TCWT2_tau -32.768 32.767
 /begin AXIS_DESCR COM_AXIS NO_INPUT_QUANTITY Compu_TCWT2_MAP 8 -128 127.99609375 AXIS_PTS_REF TCWT2_MAP /end AXIS_DESCR
 /begin AXIS_DESCR COM_AXIS NO_INPUT_QUANTITY Compu_TCWT2_rpm 8 -32768 32767 AXIS_PTS_REF TCWT2_rpm /end AXIS_DESCR
/end CHARACTERISTIC
/begin COMPU_METHOD Compu_TCWT2_tau "" RAT_FUNC "%.2" "CWT 2-D tau (sec)" COEFFS 0 1000 0 0 0 1 /end COMPU_METHOD
/begin CHARACTERISTIC TCWT2_rpmpct "VE CWT 2-D RPM-only Load Factor" CURVE 0x00144642 /* @ECU_Address@TCWT2_rpmpct@0x02125000@ */ ECIPP_ALIGNMENT_SWORD 4 Compu_TCWT2_rpmpct -4 3.9998779296875
 /begin AXIS_DESCR COM_AXIS NO_INPUT_QUANTITY Compu_TCWT2_rpm 8 -32768 32767 AXIS_PTS_REF TCWT2_rpm /end AXIS_DESCR
/end CHARACTERISTIC
/begin COMPU_METHOD Compu_TCWT2_rpmpct " " RAT_FUNC "%.3" "CWT 2-D (Load Factor)" COEFFS 0 8192 0 0 0 1 /end COMPU_METHOD
/begin CHARACTERISTIC TCWT2_loadfact "VE CWT 2-D Load Fact" MAP 0x00144532 /* @ECU_Address@TCWT2_loadfact@0x02126000@ */ ECIPP_ALIGNMENT_SWORD 4 Compu_TCWT2_loadfact -4 3.9998779296875
 /begin AXIS_DESCR COM_AXIS NO_INPUT_QUANTITY Compu_TCWT2_MAP 8 -128 127.99609375 AXIS_PTS_REF TCWT2_MAP /end AXIS_DESCR
 /begin AXIS_DESCR COM_AXIS NO_INPUT_QUANTITY Compu_TCWT2_rpm 8 -32768 32767 AXIS_PTS_REF TCWT2_rpm /end AXIS_DESCR
/end CHARACTERISTIC
/begin COMPU_METHOD Compu_TCWT2_loadfact "" RAT_FUNC "%.3" "CWT 2-D (Load Factor)" COEFFS 0 8192 0 0 0 1 /end COMPU_METHOD
/begin COMPU_METHOD Compu_TTM_TPSA_TPS " " RAT_FUNC "%.1" "Position (%)" COEFFS 0 327.68 0 0 0 1 /end COMPU_METHOD
/begin CHARACTERISTIC TTM_TPSA_A "Throttle Nominal Area" CURVE 0x0016325A /* @ECU_Address@TTM_TPSA_A@0x02146000@ */ ECIPP_ALIGNMENT_SWORD 8 Compu_TTM_TPSA_A -8 7.999755859375
 /begin AXIS_DESCR COM_AXIS NO_INPUT_QUANTITY Compu_TTM_TPSA_TPS 16 -100 99.9969482421875 AXIS_PTS_REF TTM_TPSA_TPS /end AXIS_DESCR
/end CHARACTERISTIC
/begin AXIS_PTS TTM_TPSA_TPS " " 0x0016327A /* @ECU_Address@TTM_TPSA_TPS@0x02145000@ */ NO_INPUT_QUANTITY ECIPP_Lookup_SWORD 0 Compu_TTM_TPSA_TPS 16 -100 99.9969482421875 /end AXIS_PTS
/begin COMPU_METHOD Compu_TTM_TPSA_A " " RAT_FUNC "%.3" "Area (in2)" COEFFS 0 4096 0 0 0 1 /end COMPU_METHOD
/begin CHARACTERISTIC FSS_cust_tbl_def "General # FSS_cust_tbl_def" VAL_BLK 0x001473D4 /* @ECU_Address@FSS_cust_tbl_def@0x021AF000@ */ ECIPP_ALIGNMENT_UWORD 65535 Compu_FSS_cust_tbl_def 0 65535 MATRIX_DIM 8 1 1 /end CHARACTERISTIC
/begin COMPU_METHOD Compu_FSS_cust_tbl_def " " RAT_FUNC "%.0" "-" COEFFS 0 1 0 0 0 1 /end COMPU_METHOD
/begin CHARACTERISTIC FDR_cust_tbl_def "General # FDR_cust_tbl_def" VAL_BLK 0x00146848 /* @ECU_Address@FDR_cust_tbl_def@0x021B0000@ */ ECIPP_ALIGNMENT_UWORD 65535 Compu_FDR_cust_tbl_def 0 65535 MATRIX_DIM 2 1 1 /end CHARACTERISTIC
/begin COMPU_METHOD Compu_FDR_cust_tbl_def " " RAT_FUNC "%.0" "-" COEFFS 0 1 0 0 0 1 /end COMPU_METHOD
/begin CHARACTERISTIC TMJ_KcompN_Kc "General # TMJ_KcompN_Kc" VAL_BLK 0x00162DDA /* @ECU_Address@TMJ_KcompN_Kc@0x021CC000@ */ ECIPP_ALIGNMENT_SWORD 0 Compu_TMJ_KcompN_Kc -0.5 0.499984741210938 MATRIX_DIM 32 1 1 /end CHARACTERISTIC
/begin COMPU_METHOD Compu_TMJ_KcompN_Kc " " RAT_FUNC "%.0" "-" COEFFS 0 65536 0 0 0 1 /end COMPU_METHOD
/begin CHARACTERISTIC TMJ_KcompP_Kc "General # TMJ_KcompP_Kc" VAL_BLK 0x00162E1A /* @ECU_Address@TMJ_KcompP_Kc@0x021CD000@ */ ECIPP_ALIGNMENT_SWORD 0 Compu_TMJ_KcompP_Kc -0.5 0.499984741210938 MATRIX_DIM 32 1 1 /end CHARACTERISTIC
/begin COMPU_METHOD Compu_TMJ_KcompP_Kc " " RAT_FUNC "%.0" "-" COEFFS 0 65536 0 0 0 1 /end COMPU_METHOD
/begin CHARACTERISTIC TMJ_Kcomp_PR "General # TMJ_Kcomp_PR" VAL_BLK 0x00162E5A /* @ECU_Address@TMJ_Kcomp_PR@0x021CE000@ */ ECIPP_ALIGNMENT_SWORD 0 Compu_TMJ_Kcomp_PR 0.75 0.999996185302734 MATRIX_DIM 32 1 1 /end CHARACTERISTIC
/begin COMPU_METHOD Compu_TMJ_Kcomp_PR " " RAT_FUNC "%.0" "-" COEFFS 0 262144 -229376 0 0 1 /end COMPU_METHOD
/begin CHARACTERISTIC TTM_PRKc_Kc "General # TTM_PRKc_Kc" VAL_BLK 0x0016321A /* @ECU_Address@TTM_PRKc_Kc@0x021D6000@ */ ECIPP_ALIGNMENT_SWORD 1 Compu_TTM_PRKc_Kc -1 0.999969482421875 MATRIX_DIM 16 1 1 /end CHARACTERISTIC
/begin COMPU_METHOD Compu_TTM_PRKc_Kc " " RAT_FUNC "%.0" "-" COEFFS 0 32768 0 0 0 1 /end COMPU_METHOD
/begin CHARACTERISTIC TTM_PRKc_PR "General # TTM_PRKc_PR" VAL_BLK 0x0016323A /* @ECU_Address@TTM_PRKc_PR@0x021D7000@ */ ECIPP_ALIGNMENT_SWORD 1 Compu_TTM_PRKc_PR -1 0.999969482421875 MATRIX_DIM 16 1 1 /end CHARACTERISTIC
/begin COMPU_METHOD Compu_TTM_PRKc_PR " " RAT_FUNC "%.0" "-" COEFFS 0 32768 0 0 0 1 /end COMPU_METHOD
/begin CHARACTERISTIC TVEmod_ECT_mul "General # TVEmod_ECT_mul" VAL_BLK 0x001632FA /* @ECU_Address@TVEmod_ECT_mul@0x021DB000@ */ ECIPP_ALIGNMENT_SWORD 2 Compu_TVEmod_ECT_mul -2 1.99993896484375 MATRIX_DIM 16 1 1 /end CHARACTERISTIC
/begin COMPU_METHOD Compu_TVEmod_ECT_mul " " RAT_FUNC "%.0" "-" COEFFS 0 16384 0 0 0 1 /end COMPU_METHOD
/begin CHARACTERISTIC TVEmod_MAT_mul "General # TVEmod_MAT_mul" VAL_BLK 0x0016333A /* @ECU_Address@TVEmod_MAT_mul@0x021DD000@ */ ECIPP_ALIGNMENT_SWORD 2 Compu_TVEmod_MAT_mul -2 1.99993896484375 MATRIX_DIM 16 1 1 /end CHARACTERISTIC
/begin COMPU_METHOD Compu_TVEmod_MAT_mul " " RAT_FUNC "%.0" "-" COEFFS 0 16384 0 0 0 1 /end COMPU_METHOD
/begin CHARACTERISTIC Tspkmx_ECT_CAD "General # Tspkmx_ECT_CAD" VAL_BLK 0x0014631A /* @ECU_Address@Tspkmx_ECT_CAD@0x021DE000@ */ ECIPP_ALIGNMENT_SWORD 2048 Compu_Tspkmx_ECT_CAD -2048 2047.9375 MATRIX_DIM 16 1 1 /end CHARACTERISTIC
/begin COMPU_METHOD Compu_Tspkmx_ECT_CAD " " RAT_FUNC "%.0" "CAD" COEFFS 0 16 0 0 0 1 /end COMPU_METHOD
/begin CHARACTERISTIC TFlt_xface_addr "FaultConfig # TFlt_xface_addr" VAL_BLK 0x0014855C /* @ECU_Address@TFlt_xface_addr@0x0222F000@ */ ECIPP_ALIGNMENT_UBYTE 255 Compu_TFlt_xface_addr 0 255 MATRIX_DIM 6 1 1 /end CHARACTERISTIC
/begin COMPU_METHOD Compu_TFlt_xface_addr " " RAT_FUNC "%.0" "-" COEFFS 0 1 0 0 0 1 /end COMPU_METHOD
/begin CHARACTERISTIC TFlt_xface2_addr "FaultConfig # TFlt_xface2_addr" VAL_BLK 0x001488F4 /* @ECU_Address@TFlt_xface2_addr@0x02230000@ */ ECIPP_ALIGNMENT_UBYTE 255 Compu_TFlt_xface2_addr 0 255 MATRIX_DIM 6 1 1 /end CHARACTERISTIC
/begin COMPU_METHOD Compu_TFlt_xface2_addr " " RAT_FUNC "%.0" "-" COEFFS 0 1 0 0 0 1 /end COMPU_METHOD
/begin CHARACTERISTIC TFlt_xface3_addr "FaultConfig # TFlt_xface3_addr" VAL_BLK 0x00148C8C /* @ECU_Address@TFlt_xface3_addr@0x02231000@ */ ECIPP_ALIGNMENT_UBYTE 255 Compu_TFlt_xface3_addr 0 255 MATRIX_DIM 6 1 1 /end CHARACTERISTIC
/begin COMPU_METHOD Compu_TFlt_xface3_addr " " RAT_FUNC "%.0" "-" COEFFS 0 1 0 0 0 1 /end COMPU_METHOD
/begin COMPU_METHOD Compu_TCRI_ontime_mm3 " " RAT_FUNC "%.1" "Fuel Volume (mm3/stroke)" COEFFS 0 32 0 0 0 1 /end COMPU_METHOD
/begin COMPU_METHOD Compu_TCRI_ontime_prail " " RAT_FUNC "%.0" "Prail (bar)" COEFFS 0 8 0 0 0 1 /end COMPU_METHOD
/begin CHARACTERISTIC TCRI_ontime "Injector On-Time (us)" MAP 0x00143C90 /* @ECU_Address@TCRI_ontime@0x02268000@ */ ECIPP_ALIGNMENT_SLONG 107374182 Compu_TCRI_ontime -107374182.4 107374182.35
 /begin AXIS_DESCR COM_AXIS NO_INPUT_QUANTITY Compu_TCRI_ontime_mm3 16 -1024 1023.96875 AXIS_PTS_REF TCRI_ontime_mm3 /end AXIS_DESCR
 /begin AXIS_DESCR COM_AXIS NO_INPUT_QUANTITY Compu_TCRI_ontime_prail 16 -4096 4095.875 AXIS_PTS_REF TCRI_ontime_prail /end AXIS_DESCR
/end CHARACTERISTIC
/begin AXIS_PTS TCRI_ontime_mm3 " " 0x0014442A /* @ECU_Address@TCRI_ontime_mm3@0x02266000@ */ NO_INPUT_QUANTITY ECIPP_Lookup_SWORD 0 Compu_TCRI_ontime_mm3 16 -1024 1023.96875 /end AXIS_PTS
/begin AXIS_PTS TCRI_ontime_prail " " 0x0014444A /* @ECU_Address@TCRI_ontime_prail@0x02267000@ */ NO_INPUT_QUANTITY ECIPP_Lookup_SWORD 0 Compu_TCRI_ontime_prail 16 -4096 4095.875 /end AXIS_PTS
/begin COMPU_METHOD Compu_TCRI_ontime "" RAT_FUNC "%.0" "µs" COEFFS 0 20 0 0 0 1 /end COMPU_METHOD
/begin CHARACTERISTIC TCRI_rho_diesel "Fuel # TCRI_rho_diesel" VAL_BLK 0x00162CDA /* @ECU_Address@TCRI_rho_diesel@0x02289000@ */ ECIPP_ALIGNMENT_SWORD 4 Compu_TCRI_rho_diesel -4 3.9998779296875 MATRIX_DIM 32 1 1 /end CHARACTERISTIC
/begin COMPU_METHOD Compu_TCRI_rho_diesel "" RAT_FUNC "%.0" "mg/mm3" COEFFS 0 8192 0 0 0 1 /end COMPU_METHOD
/begin COMPU_METHOD Compu_TCRI_QPT_xfpp " " RAT_FUNC "%.1" "Load Command (%)" COEFFS 0 327.68 0 0 0 1 /end COMPU_METHOD
/begin COMPU_METHOD Compu_TCRI_cld_yrpm " " RAT_FUNC "%.0" "Speed (rpm)" COEFFS 0 1 0 0 0 1 /end COMPU_METHOD
/begin COMPU_METHOD Compu_TCRI_QPT_yrpm " " RAT_FUNC "%.0" "Speed (rpm)" COEFFS 0 1 0 0 0 1 /end COMPU_METHOD
/begin COMPU_METHOD Compu_TCRI_QPT_xair " " RAT_FUNC "%.0" "Air Mass (mg/intake)" COEFFS 0 2 0 0 0 1 /end COMPU_METHOD
/begin CHARACTERISTIC TCRI_air_std "Air Mass - Standard (mg/intake)" MAP 0x00170844 /* @ECU_Address@TCRI_air_std@0x022E3000@ */ ECIPP_ALIGNMENT_SWORD 8192 Compu_TCRI_air_std -8192 8191.75
 /begin AXIS_DESCR COM_AXIS NO_INPUT_QUANTITY Compu_TCRI_QPT_xload 16 -1024 1023.96875 AXIS_PTS_REF TCRI_QPT_xload /end AXIS_DESCR
 /begin AXIS_DESCR COM_AXIS NO_INPUT_QUANTITY Compu_TCRI_QPT_yrpm 16 -32768 32767 AXIS_PTS_REF TCRI_QPT_yrpm /end AXIS_DESCR
/end CHARACTERISTIC
/begin AXIS_PTS TCRI_QPT_xload " " 0x0016C776 /* @ECU_Address@TCRI_QPT_xload@0x022EC000@ */ NO_INPUT_QUANTITY ECIPP_Lookup_SWORD 0 Compu_TCRI_QPT_xload 16 -1024 1023.96875 /end AXIS_PTS
/begin AXIS_PTS TCRI_QPT_yrpm " " 0x0016C796 /* @ECU_Address@TCRI_QPT_yrpm@0x022E1000@ */ NO_INPUT_QUANTITY ECIPP_Lookup_SWORD 0 Compu_TCRI_QPT_yrpm 16 -32768 32767 /end AXIS_PTS
/begin COMPU_METHOD Compu_TCRI_air_std "" RAT_FUNC "%.0" "mg/intake" COEFFS 0 4 0 0 0 1 /end COMPU_METHOD
/begin CHARACTERISTIC TCRI_air_alt1 "Air Mass - Alternate (mg/intake)" MAP 0x00170644 /* @ECU_Address@TCRI_air_alt1@0x022E4000@ */ ECIPP_ALIGNMENT_SWORD 8192 Compu_TCRI_air_alt1 -8192 8191.75
 /begin AXIS_DESCR COM_AXIS NO_INPUT_QUANTITY Compu_TCRI_QPT_xload 16 -1024 1023.96875 AXIS_PTS_REF TCRI_QPT_xload /end AXIS_DESCR
 /begin AXIS_DESCR COM_AXIS NO_INPUT_QUANTITY Compu_TCRI_QPT_yrpm 16 -32768 32767 AXIS_PTS_REF TCRI_QPT_yrpm /end AXIS_DESCR
/end CHARACTERISTIC
/begin COMPU_METHOD Compu_TCRI_air_alt1 "" RAT_FUNC "%.0" "mg/intake" COEFFS 0 4 0 0 0 1 /end COMPU_METHOD
/begin CHARACTERISTIC TCRI_P_cld "Fuel Pressure Base Offset (bar)" MAP 0x0016DCE4 /* @ECU_Address@TCRI_P_cld@0x022E5000@ */ ECIPP_ALIGNMENT_SWORD 4096 Compu_TCRI_P_cld -4096 4095.875
 /begin AXIS_DESCR COM_AXIS NO_INPUT_QUANTITY Compu_TCRI_cld_xload 8 -1024 1023.96875 AXIS_PTS_REF TCRI_cld_xload /end AXIS_DESCR
 /begin AXIS_DESCR COM_AXIS NO_INPUT_QUANTITY Compu_TCRI_cld_yrpm 8 -32768 32767 AXIS_PTS_REF TCRI_cld_yrpm /end AXIS_DESCR
/end CHARACTERISTIC
/begin AXIS_PTS TCRI_cld_xload " " 0x00170A84 /* @ECU_Address@TCRI_cld_xload@0x022EB000@ */ NO_INPUT_QUANTITY ECIPP_Lookup_SWORD 0 Compu_TCRI_cld_xload 8 -1024 1023.96875 /end AXIS_PTS
/begin AXIS_PTS TCRI_cld_yrpm " " 0x00170A94 /* @ECU_Address@TCRI_cld_yrpm@0x022E0000@ */ NO_INPUT_QUANTITY ECIPP_Lookup_SWORD 0 Compu_TCRI_cld_yrpm 8 -32768 32767 /end AXIS_PTS
/begin COMPU_METHOD Compu_TCRI_P_cld "" RAT_FUNC "%.0" "bar" COEFFS 0 8 0 0 0 1 /end COMPU_METHOD
/begin CHARACTERISTIC TCRI_P_std "Fuel Pressure - Standard (bar)" MAP 0x0016C576 /* @ECU_Address@TCRI_P_std@0x022E6000@ */ ECIPP_ALIGNMENT_SWORD 4096 Compu_TCRI_P_std -4096 4095.875
 /begin AXIS_DESCR COM_AXIS NO_INPUT_QUANTITY Compu_TCRI_QPT_xload 16 -1024 1023.96875 AXIS_PTS_REF TCRI_QPT_xload /end AXIS_DESCR
 /begin AXIS_DESCR COM_AXIS NO_INPUT_QUANTITY Compu_TCRI_QPT_yrpm 16 -32768 32767 AXIS_PTS_REF TCRI_QPT_yrpm /end AXIS_DESCR
/end CHARACTERISTIC
/begin COMPU_METHOD Compu_TCRI_P_std "" RAT_FUNC "%.0" "bar" COEFFS 0 8 0 0 0 1 /end COMPU_METHOD
/begin CHARACTERISTIC TCRI_P_alt1 "Fuel Pressure - Alternate (bar)" MAP 0x0016DAE4 /* @ECU_Address@TCRI_P_alt1@0x022E7000@ */ ECIPP_ALIGNMENT_SWORD 4096 Compu_TCRI_P_alt1 -4096 4095.875
 /begin AXIS_DESCR COM_AXIS NO_INPUT_QUANTITY Compu_TCRI_QPT_xload 16 -1024 1023.96875 AXIS_PTS_REF TCRI_QPT_xload /end AXIS_DESCR
 /begin AXIS_DESCR COM_AXIS NO_INPUT_QUANTITY Compu_TCRI_QPT_yrpm 16 -32768 32767 AXIS_PTS_REF TCRI_QPT_yrpm /end AXIS_DESCR
/end CHARACTERISTIC
/begin COMPU_METHOD Compu_TCRI_P_alt1 "" RAT_FUNC "%.0" "bar" COEFFS 0 8 0 0 0 1 /end COMPU_METHOD
/begin COMPU_METHOD Compu_TCRI_cld_xload " " RAT_FUNC "%.1" "Fuel Load (mg/cyl)" COEFFS 0 32 0 0 0 1 /end COMPU_METHOD
/begin COMPU_METHOD Compu_TCRI_QPT_xload " " RAT_FUNC "%.1" "Fuel Load (mg/cyl)" COEFFS 0 32 0 0 0 1 /end COMPU_METHOD
/begin CHARACTERISTIC TCRI_smk_limit "Fuel Smoke Limit (mg/cyl)" MAP 0x00170AA4 /* @ECU_Address@TCRI_smk_limit@0x022ED000@ */ ECIPP_ALIGNMENT_SWORD 1024 Compu_TCRI_smk_limit -1024 1023.96875
 /begin AXIS_DESCR COM_AXIS NO_INPUT_QUANTITY Compu_TCRI_QPT_xair 16 -16384 16383.5 AXIS_PTS_REF TCRI_QPT_xair /end AXIS_DESCR
 /begin AXIS_DESCR COM_AXIS NO_INPUT_QUANTITY Compu_TCRI_QPT_yrpm 16 -32768 32767 AXIS_PTS_REF TCRI_QPT_yrpm /end AXIS_DESCR
/end CHARACTERISTIC
/begin AXIS_PTS TCRI_QPT_xair " " 0x0016DD64 /* @ECU_Address@TCRI_QPT_xair@0x022E2000@ */ NO_INPUT_QUANTITY ECIPP_Lookup_SWORD 0 Compu_TCRI_QPT_xair 16 -16384 16383.5 /end AXIS_PTS
/begin COMPU_METHOD Compu_TCRI_smk_limit "" RAT_FUNC "%.1" "mg/cyl" COEFFS 0 32 0 0 0 1 /end COMPU_METHOD
/begin CHARACTERISTIC TCRI_Qpilot2_cld "Pilot 2 Quantity Base Offset" MAP 0x0016EB44 /* @ECU_Address@TCRI_Qpilot2_cld@0x022EE000@ */ ECIPP_ALIGNMENT_SWORD 1024 Compu_TCRI_Qpilot2_cld -1024 1023.96875
 /begin AXIS_DESCR COM_AXIS NO_INPUT_QUANTITY Compu_TCRI_cld_xload 8 -1024 1023.96875 AXIS_PTS_REF TCRI_cld_xload /end AXIS_DESCR
 /begin AXIS_DESCR COM_AXIS NO_INPUT_QUANTITY Compu_TCRI_cld_yrpm 8 -32768 32767 AXIS_PTS_REF TCRI_cld_yrpm /end AXIS_DESCR
/end CHARACTERISTIC
/begin COMPU_METHOD Compu_TCRI_Qpilot2_cld "" RAT_FUNC "%.1" "mg/stroke" COEFFS 0 32 0 0 0 1 /end COMPU_METHOD
/begin CHARACTERISTIC TCRI_Qpilot2_std "Pilot 2 Quantity - Standard" MAP 0x0016EBC4 /* @ECU_Address@TCRI_Qpilot2_std@0x022EF000@ */ ECIPP_ALIGNMENT_SWORD 1024 Compu_TCRI_Qpilot2_std -1024 1023.96875
 /begin AXIS_DESCR COM_AXIS NO_INPUT_QUANTITY Compu_TCRI_QPT_xload 16 -1024 1023.96875 AXIS_PTS_REF TCRI_QPT_xload /end AXIS_DESCR
 /begin AXIS_DESCR COM_AXIS NO_INPUT_QUANTITY Compu_TCRI_QPT_yrpm 16 -32768 32767 AXIS_PTS_REF TCRI_QPT_yrpm /end AXIS_DESCR
/end CHARACTERISTIC
/begin COMPU_METHOD Compu_TCRI_Qpilot2_std "" RAT_FUNC "%.1" "mg/stroke" COEFFS 0 32 0 0 0 1 /end COMPU_METHOD
/begin CHARACTERISTIC TCRI_Qpilot2_alt1 "Pilot 2 Quantity - Alternate" MAP 0x0016E944 /* @ECU_Address@TCRI_Qpilot2_alt1@0x022F0000@ */ ECIPP_ALIGNMENT_SWORD 1024 Compu_TCRI_Qpilot2_alt1 -1024 1023.96875
 /begin AXIS_DESCR COM_AXIS NO_INPUT_QUANTITY Compu_TCRI_QPT_xload 16 -1024 1023.96875 AXIS_PTS_REF TCRI_QPT_xload /end AXIS_DESCR
 /begin AXIS_DESCR COM_AXIS NO_INPUT_QUANTITY Compu_TCRI_QPT_yrpm 16 -32768 32767 AXIS_PTS_REF TCRI_QPT_yrpm /end AXIS_DESCR
/end CHARACTERISTIC
/begin COMPU_METHOD Compu_TCRI_Qpilot2_alt1 "" RAT_FUNC "%.1" "mg/stroke" COEFFS 0 32 0 0 0 1 /end COMPU_METHOD
/begin CHARACTERISTIC TCRI_Qpilot1_cld "Pilot 1 Quantity Base Offset" MAP 0x0016E6C4 /* @ECU_Address@TCRI_Qpilot1_cld@0x022F1000@ */ ECIPP_ALIGNMENT_SWORD 1024 Compu_TCRI_Qpilot1_cld -1024 1023.96875
 /begin AXIS_DESCR COM_AXIS NO_INPUT_QUANTITY Compu_TCRI_cld_xload 8 -1024 1023.96875 AXIS_PTS_REF TCRI_cld_xload /end AXIS_DESCR
 /begin AXIS_DESCR COM_AXIS NO_INPUT_QUANTITY Compu_TCRI_cld_yrpm 8 -32768 32767 AXIS_PTS_REF TCRI_cld_yrpm /end AXIS_DESCR
/end CHARACTERISTIC
/begin COMPU_METHOD Compu_TCRI_Qpilot1_cld "" RAT_FUNC "%.1" "mg/stroke" COEFFS 0 32 0 0 0 1 /end COMPU_METHOD
/begin CHARACTERISTIC TCRI_Qpilot1_std "Pilot 1 Quantity - Standard" MAP 0x0016E744 /* @ECU_Address@TCRI_Qpilot1_std@0x022F2000@ */ ECIPP_ALIGNMENT_SWORD 1024 Compu_TCRI_Qpilot1_std -1024 1023.96875
 /begin AXIS_DESCR COM_AXIS NO_INPUT_QUANTITY Compu_TCRI_QPT_xload 16 -1024 1023.96875 AXIS_PTS_REF TCRI_QPT_xload /end AXIS_DESCR
 /begin AXIS_DESCR COM_AXIS NO_INPUT_QUANTITY Compu_TCRI_QPT_yrpm 16 -32768 32767 AXIS_PTS_REF TCRI_QPT_yrpm /end AXIS_DESCR
/end CHARACTERISTIC
/begin COMPU_METHOD Compu_TCRI_Qpilot1_std "" RAT_FUNC "%.1" "mg/stroke" COEFFS 0 32 0 0 0 1 /end COMPU_METHOD
/begin CHARACTERISTIC TCRI_Qpilot1_alt1 "Pilot 1 Quantity - Alternate" MAP 0x0016E4C4 /* @ECU_Address@TCRI_Qpilot1_alt1@0x022F3000@ */ ECIPP_ALIGNMENT_SWORD 1024 Compu_TCRI_Qpilot1_alt1 -1024 1023.96875
 /begin AXIS_DESCR COM_AXIS NO_INPUT_QUANTITY Compu_TCRI_QPT_xload 16 -1024 1023.96875 AXIS_PTS_REF TCRI_QPT_xload /end AXIS_DESCR
 /begin AXIS_DESCR COM_AXIS NO_INPUT_QUANTITY Compu_TCRI_QPT_yrpm 16 -32768 32767 AXIS_PTS_REF TCRI_QPT_yrpm /end AXIS_DESCR
/end CHARACTERISTIC
/begin COMPU_METHOD Compu_TCRI_Qpilot1_alt1 "" RAT_FUNC "%.1" "mg/stroke" COEFFS 0 32 0 0 0 1 /end COMPU_METHOD
/begin CHARACTERISTIC TCRI_Qmain_cld "Main Quantity Base Offset (mg/stroke)" MAP 0x0016E3A4 /* @ECU_Address@TCRI_Qmain_cld@0x022F4000@ */ ECIPP_ALIGNMENT_SWORD 1024 Compu_TCRI_Qmain_cld -1024 1023.96875
 /begin AXIS_DESCR COM_AXIS NO_INPUT_QUANTITY Compu_TCRI_cld_xload 8 -1024 1023.96875 AXIS_PTS_REF TCRI_cld_xload /end AXIS_DESCR
 /begin AXIS_DESCR COM_AXIS NO_INPUT_QUANTITY Compu_TCRI_cld_yrpm 8 -32768 32767 AXIS_PTS_REF TCRI_cld_yrpm /end AXIS_DESCR
/end CHARACTERISTIC
/begin COMPU_METHOD Compu_TCRI_Qmain_cld "" RAT_FUNC "%.1" "mg/stroke" COEFFS 0 32 0 0 0 1 /end COMPU_METHOD
/begin CHARACTERISTIC TCRI_Qload_std "Fuel Load - Standard (mg/cyl)" MAP 0x0016E1A4 /* @ECU_Address@TCRI_Qload_std@0x022F5000@ */ ECIPP_ALIGNMENT_SWORD 1024 Compu_TCRI_Qload_std -1024 1023.96875
 /begin AXIS_DESCR COM_AXIS NO_INPUT_QUANTITY Compu_TCRI_QPT_xfpp 16 -100 99.9969482421875 AXIS_PTS_REF TCRI_QPT_xfpp /end AXIS_DESCR
 /begin AXIS_DESCR COM_AXIS NO_INPUT_QUANTITY Compu_TCRI_QPT_yrpm 16 -32768 32767 AXIS_PTS_REF TCRI_QPT_yrpm /end AXIS_DESCR
/end CHARACTERISTIC
/begin AXIS_PTS TCRI_QPT_xfpp " " 0x0016DD84 /* @ECU_Address@TCRI_QPT_xfpp@0x022DF000@ */ NO_INPUT_QUANTITY ECIPP_Lookup_SWORD 0 Compu_TCRI_QPT_xfpp 16 -100 99.9969482421875 /end AXIS_PTS
/begin COMPU_METHOD Compu_TCRI_Qload_std "" RAT_FUNC "%.1" "mg/cyl" COEFFS 0 32 0 0 0 1 /end COMPU_METHOD
/begin CHARACTERISTIC TCRI_Qload_alt1 "Fuel Load - Alternate 1 (mg/cyl)" MAP 0x0016DDA4 /* @ECU_Address@TCRI_Qload_alt1@0x022F6000@ */ ECIPP_ALIGNMENT_SWORD 1024 Compu_TCRI_Qload_alt1 -1024 1023.96875
 /begin AXIS_DESCR COM_AXIS NO_INPUT_QUANTITY Compu_TCRI_QPT_xfpp 16 -100 99.9969482421875 AXIS_PTS_REF TCRI_QPT_xfpp /end AXIS_DESCR
 /begin AXIS_DESCR COM_AXIS NO_INPUT_QUANTITY Compu_TCRI_QPT_yrpm 16 -32768 32767 AXIS_PTS_REF TCRI_QPT_yrpm /end AXIS_DESCR
/end CHARACTERISTIC
/begin COMPU_METHOD Compu_TCRI_Qload_alt1 "" RAT_FUNC "%.1" "mg/cyl" COEFFS 0 32 0 0 0 1 /end COMPU_METHOD
/begin CHARACTERISTIC TCRI_Qload_alt2 "Fuel Load - Alternate 2 (mg/cyl)" MAP 0x0016DFA4 /* @ECU_Address@TCRI_Qload_alt2@0x022F7000@ */ ECIPP_ALIGNMENT_SWORD 1024 Compu_TCRI_Qload_alt2 -1024 1023.96875
 /begin AXIS_DESCR COM_AXIS NO_INPUT_QUANTITY Compu_TCRI_QPT_xfpp 16 -100 99.9969482421875 AXIS_PTS_REF TCRI_QPT_xfpp /end AXIS_DESCR
 /begin AXIS_DESCR COM_AXIS NO_INPUT_QUANTITY Compu_TCRI_QPT_yrpm 16 -32768 32767 AXIS_PTS_REF TCRI_QPT_yrpm /end AXIS_DESCR
/end CHARACTERISTIC
/begin COMPU_METHOD Compu_TCRI_Qload_alt2 "" RAT_FUNC "%.1" "mg/cyl" COEFFS 0 32 0 0 0 1 /end COMPU_METHOD
/begin CHARACTERISTIC TCRI_Qpost1_std "Post 1 Quantity - Standard (mg/stroke)" MAP 0x0016F044 /* @ECU_Address@TCRI_Qpost1_std@0x022F9000@ */ ECIPP_ALIGNMENT_SWORD 1024 Compu_TCRI_Qpost1_std -1024 1023.96875
 /begin AXIS_DESCR COM_AXIS NO_INPUT_QUANTITY Compu_TCRI_QPT_xload 16 -1024 1023.96875 AXIS_PTS_REF TCRI_QPT_xload /end AXIS_DESCR
 /begin AXIS_DESCR COM_AXIS NO_INPUT_QUANTITY Compu_TCRI_QPT_yrpm 16 -32768 32767 AXIS_PTS_REF TCRI_QPT_yrpm /end AXIS_DESCR
/end CHARACTERISTIC
/begin COMPU_METHOD Compu_TCRI_Qpost1_std "" RAT_FUNC "%.1" "mg/stroke" COEFFS 0 32 0 0 0 1 /end COMPU_METHOD
/begin CHARACTERISTIC TCRI_Qpost1_alt1 "Post 1 Quantity - Alternate (mg/stroke)" MAP 0x0016EDC4 /* @ECU_Address@TCRI_Qpost1_alt1@0x022FA000@ */ ECIPP_ALIGNMENT_SWORD 1024 Compu_TCRI_Qpost1_alt1 -1024 1023.96875
 /begin AXIS_DESCR COM_AXIS NO_INPUT_QUANTITY Compu_TCRI_QPT_xload 16 -1024 1023.96875 AXIS_PTS_REF TCRI_QPT_xload /end AXIS_DESCR
 /begin AXIS_DESCR COM_AXIS NO_INPUT_QUANTITY Compu_TCRI_QPT_yrpm 16 -32768 32767 AXIS_PTS_REF TCRI_QPT_yrpm /end AXIS_DESCR
/end CHARACTERISTIC
/begin COMPU_METHOD Compu_TCRI_Qpost1_alt1 "" RAT_FUNC "%.1" "mg/stroke" COEFFS 0 32 0 0 0 1 /end COMPU_METHOD
/begin CHARACTERISTIC TCRI_Qpost2_std "Post 2 Quantity - Standard (mg/stroke)" MAP 0x0016F4C4 /* @ECU_Address@TCRI_Qpost2_std@0x022FC000@ */ ECIPP_ALIGNMENT_SWORD 1024 Compu_TCRI_Qpost2_std -1024 1023.96875
 /begin AXIS_DESCR COM_AXIS NO_INPUT_QUANTITY Compu_TCRI_QPT_xload 16 -1024 1023.96875 AXIS_PTS_REF TCRI_QPT_xload /end AXIS_DESCR
 /begin AXIS_DESCR COM_AXIS NO_INPUT_QUANTITY Compu_TCRI_QPT_yrpm 16 -32768 32767 AXIS_PTS_REF TCRI_QPT_yrpm /end AXIS_DESCR
/end CHARACTERISTIC
/begin COMPU_METHOD Compu_TCRI_Qpost2_std "" RAT_FUNC "%.1" "mg/stroke" COEFFS 0 32 0 0 0 1 /end COMPU_METHOD
/begin CHARACTERISTIC TCRI_Qpost2_alt1 "Post 2 Quantity - Alternate (mg/stroke)" MAP 0x0016F244 /* @ECU_Address@TCRI_Qpost2_alt1@0x022FD000@ */ ECIPP_ALIGNMENT_SWORD 1024 Compu_TCRI_Qpost2_alt1 -1024 1023.96875
 /begin AXIS_DESCR COM_AXIS NO_INPUT_QUANTITY Compu_TCRI_QPT_xload 16 -1024 1023.96875 AXIS_PTS_REF TCRI_QPT_xload /end AXIS_DESCR
 /begin AXIS_DESCR COM_AXIS NO_INPUT_QUANTITY Compu_TCRI_QPT_yrpm 16 -32768 32767 AXIS_PTS_REF TCRI_QPT_yrpm /end AXIS_DESCR
/end CHARACTERISTIC
/begin COMPU_METHOD Compu_TCRI_Qpost2_alt1 "" RAT_FUNC "%.1" "mg/stroke" COEFFS 0 32 0 0 0 1 /end COMPU_METHOD
/begin CHARACTERISTIC TCRI_Tpilot2_cld "Pilot 2 Timing Base Offset (CAD)" MAP 0x0016D544 /* @ECU_Address@TCRI_Tpilot2_cld@0x022FE000@ */ ECIPP_ALIGNMENT_SLONG 134217728 Compu_TCRI_Tpilot2_cld -134217728 134217727.9375
 /begin AXIS_DESCR COM_AXIS NO_INPUT_QUANTITY Compu_TCRI_cld_xload 8 -1024 1023.96875 AXIS_PTS_REF TCRI_cld_xload /end AXIS_DESCR
 /begin AXIS_DESCR COM_AXIS NO_INPUT_QUANTITY Compu_TCRI_cld_yrpm 8 -32768 32767 AXIS_PTS_REF TCRI_cld_yrpm /end AXIS_DESCR
/end CHARACTERISTIC
/begin COMPU_METHOD Compu_TCRI_Tpilot2_cld "" RAT_FUNC "%.1" "CAD" COEFFS 0 16 0 0 0 1 /end COMPU_METHOD
/begin CHARACTERISTIC TCRI_Tpilot2_std "Pilot 2 Timing - Standard (CAD BTDCC)" MAP 0x0016D644 /* @ECU_Address@TCRI_Tpilot2_std@0x022FF000@ */ ECIPP_ALIGNMENT_SLONG 134217728 Compu_TCRI_Tpilot2_std -134217728 134217727.9375
 /begin AXIS_DESCR COM_AXIS NO_INPUT_QUANTITY Compu_TCRI_QPT_xload 16 -1024 1023.96875 AXIS_PTS_REF TCRI_QPT_xload /end AXIS_DESCR
 /begin AXIS_DESCR COM_AXIS NO_INPUT_QUANTITY Compu_TCRI_QPT_yrpm 16 -32768 32767 AXIS_PTS_REF TCRI_QPT_yrpm /end AXIS_DESCR
/end CHARACTERISTIC
/begin COMPU_METHOD Compu_TCRI_Tpilot2_std "" RAT_FUNC "%.1" "CAD/BTDCC - or - µs before main" COEFFS 0 16 0 0 0 1 /end COMPU_METHOD
/begin CHARACTERISTIC TCRI_Tpilot2_alt1 "Pilot 2 Timing - Alternate (CAD BTDCC)" MAP 0x0016D144 /* @ECU_Address@TCRI_Tpilot2_alt1@0x02300000@ */ ECIPP_ALIGNMENT_SLONG 134217728 Compu_TCRI_Tpilot2_alt1 -134217728 134217727.9375
 /begin AXIS_DESCR COM_AXIS NO_INPUT_QUANTITY Compu_TCRI_QPT_xload 16 -1024 1023.96875 AXIS_PTS_REF TCRI_QPT_xload /end AXIS_DESCR
 /begin AXIS_DESCR COM_AXIS NO_INPUT_QUANTITY Compu_TCRI_QPT_yrpm 16 -32768 32767 AXIS_PTS_REF TCRI_QPT_yrpm /end AXIS_DESCR
/end CHARACTERISTIC
/begin COMPU_METHOD Compu_TCRI_Tpilot2_alt1 "" RAT_FUNC "%.1" "CAD/BTDCC" COEFFS 0 16 0 0 0 1 /end COMPU_METHOD
/begin CHARACTERISTIC TCRI_Tpilot1_std "Pilot 1 Timing - Standard (CAD BTDCC)" MAP 0x0016CD44 /* @ECU_Address@TCRI_Tpilot1_std@0x02302000@ */ ECIPP_ALIGNMENT_SLONG 134217728 Compu_TCRI_Tpilot1_std -134217728 134217727.9375
 /begin AXIS_DESCR COM_AXIS NO_INPUT_QUANTITY Compu_TCRI_QPT_xload 16 -1024 1023.96875 AXIS_PTS_REF TCRI_QPT_xload /end AXIS_DESCR
 /begin AXIS_DESCR COM_AXIS NO_INPUT_QUANTITY Compu_TCRI_QPT_yrpm 16 -32768 32767 AXIS_PTS_REF TCRI_QPT_yrpm /end AXIS_DESCR
/end CHARACTERISTIC
/begin COMPU_METHOD Compu_TCRI_Tpilot1_std "" RAT_FUNC "%.1" "CAD/BTDCC - or - µs before main" COEFFS 0 16 0 0 0 1 /end COMPU_METHOD
/begin CHARACTERISTIC TCRI_Tpilot1_alt1 "Pilot 1 Timing - Alternate (CAD BTDCC)" MAP 0x0016C844 /* @ECU_Address@TCRI_Tpilot1_alt1@0x02303000@ */ ECIPP_ALIGNMENT_SLONG 134217728 Compu_TCRI_Tpilot1_alt1 -134217728 134217727.9375
 /begin AXIS_DESCR COM_AXIS NO_INPUT_QUANTITY Compu_TCRI_QPT_xload 16 -1024 1023.96875 AXIS_PTS_REF TCRI_QPT_xload /end AXIS_DESCR
 /begin AXIS_DESCR COM_AXIS NO_INPUT_QUANTITY Compu_TCRI_QPT_yrpm 16 -32768 32767 AXIS_PTS_REF TCRI_QPT_yrpm /end AXIS_DESCR
/end CHARACTERISTIC
/begin COMPU_METHOD Compu_TCRI_Tpilot1_alt1 "" RAT_FUNC "%.1" "CAD/BTDCC" COEFFS 0 16 0 0 0 1 /end COMPU_METHOD
/begin CHARACTERISTIC TCRI_Tmain_cld "Main Timing Base Offset (CAD)" MAP 0x0016FAC4 /* @ECU_Address@TCRI_Tmain_cld@0x02304000@ */ ECIPP_ALIGNMENT_SWORD 2048 Compu_TCRI_Tmain_cld -2048 2047.9375
 /begin AXIS_DESCR COM_AXIS NO_INPUT_QUANTITY Compu_TCRI_cld_xload 8 -1024 1023.96875 AXIS_PTS_REF TCRI_cld_xload /end AXIS_DESCR
 /begin AXIS_DESCR COM_AXIS NO_INPUT_QUANTITY Compu_TCRI_cld_yrpm 8 -32768 32767 AXIS_PTS_REF TCRI_cld_yrpm /end AXIS_DESCR
/end CHARACTERISTIC
/begin COMPU_METHOD Compu_TCRI_Tmain_cld "" RAT_FUNC "%.1" "CAD" COEFFS 0 16 0 0 0 1 /end COMPU_METHOD
/begin CHARACTERISTIC TCRI_Tmain_std "Main Timing - Standard (CAD BTDCC)" MAP 0x0016FB44 /* @ECU_Address@TCRI_Tmain_std@0x02305000@ */ ECIPP_ALIGNMENT_SWORD 2048 Compu_TCRI_Tmain_std -2048 2047.9375
 /begin AXIS_DESCR COM_AXIS NO_INPUT_QUANTITY Compu_TCRI_QPT_xload 16 -1024 1023.96875 AXIS_PTS_REF TCRI_QPT_xload /end AXIS_DESCR
 /begin AXIS_DESCR COM_AXIS NO_INPUT_QUANTITY Compu_TCRI_QPT_yrpm 16 -32768 32767 AXIS_PTS_REF TCRI_QPT_yrpm /end AXIS_DESCR
/end CHARACTERISTIC
/begin COMPU_METHOD Compu_TCRI_Tmain_std "" RAT_FUNC "%.1" "CAD BTDCC" COEFFS 0 16 0 0 0 1 /end COMPU_METHOD
/begin CHARACTERISTIC TCRI_Tmain_alt1 "Main Timing - Alternate 1 (CAD BTDCC)" MAP 0x0016F6C4 /* @ECU_Address@TCRI_Tmain_alt1@0x02306000@ */ ECIPP_ALIGNMENT_SWORD 2048 Compu_TCRI_Tmain_alt1 -2048 2047.9375
 /begin AXIS_DESCR COM_AXIS NO_INPUT_QUANTITY Compu_TCRI_QPT_xload 16 -1024 1023.96875 AXIS_PTS_REF TCRI_QPT_xload /end AXIS_DESCR
 /begin AXIS_DESCR COM_AXIS NO_INPUT_QUANTITY Compu_TCRI_QPT_yrpm 16 -32768 32767 AXIS_PTS_REF TCRI_QPT_yrpm /end AXIS_DESCR
/end CHARACTERISTIC
/begin COMPU_METHOD Compu_TCRI_Tmain_alt1 "" RAT_FUNC "%.1" "CAD BTDCC" COEFFS 0 16 0 0 0 1 /end COMPU_METHOD
/begin CHARACTERISTIC TCRI_Tmain_alt2 "Main Timing - Alternate 2 (CAD BTDCC)" MAP 0x0016F8C4 /* @ECU_Address@TCRI_Tmain_alt2@0x02307000@ */ ECIPP_ALIGNMENT_SWORD 2048 Compu_TCRI_Tmain_alt2 -2048 2047.9375
 /begin AXIS_DESCR COM_AXIS NO_INPUT_QUANTITY Compu_TCRI_QPT_xload 16 -1024 1023.96875 AXIS_PTS_REF TCRI_QPT_xload /end AXIS_DESCR
 /begin AXIS_DESCR COM_AXIS NO_INPUT_QUANTITY Compu_TCRI_QPT_yrpm 16 -32768 32767 AXIS_PTS_REF TCRI_QPT_yrpm /end AXIS_DESCR
/end CHARACTERISTIC
/begin COMPU_METHOD Compu_TCRI_Tmain_alt2 "" RAT_FUNC "%.1" "CAD BTDCC" COEFFS 0 16 0 0 0 1 /end COMPU_METHOD
/begin CHARACTERISTIC TCRI_Tpost1_cld "Post 1 Timing Base Offset (CAD)" MAP 0x0016FF44 /* @ECU_Address@TCRI_Tpost1_cld@0x02308000@ */ ECIPP_ALIGNMENT_SWORD 2048 Compu_TCRI_Tpost1_cld -2048 2047.9375
 /begin AXIS_DESCR COM_AXIS NO_INPUT_QUANTITY Compu_TCRI_cld_xload 8 -1024 1023.96875 AXIS_PTS_REF TCRI_cld_xload /end AXIS_DESCR
 /begin AXIS_DESCR COM_AXIS NO_INPUT_QUANTITY Compu_TCRI_cld_yrpm 8 -32768 32767 AXIS_PTS_REF TCRI_cld_yrpm /end AXIS_DESCR
/end CHARACTERISTIC
/begin COMPU_METHOD Compu_TCRI_Tpost1_cld "" RAT_FUNC "%.1" "CAD" COEFFS 0 16 0 0 0 1 /end COMPU_METHOD
/begin CHARACTERISTIC TCRI_Tpost1_std "Post 1 Timing - Standard (CAD BTDCC)" MAP 0x0016FFC4 /* @ECU_Address@TCRI_Tpost1_std@0x02309000@ */ ECIPP_ALIGNMENT_SWORD 2048 Compu_TCRI_Tpost1_std -2048 2047.9375
 /begin AXIS_DESCR COM_AXIS NO_INPUT_QUANTITY Compu_TCRI_QPT_xload 16 -1024 1023.96875 AXIS_PTS_REF TCRI_QPT_xload /end AXIS_DESCR
 /begin AXIS_DESCR COM_AXIS NO_INPUT_QUANTITY Compu_TCRI_QPT_yrpm 16 -32768 32767 AXIS_PTS_REF TCRI_QPT_yrpm /end AXIS_DESCR
/end CHARACTERISTIC
/begin COMPU_METHOD Compu_TCRI_Tpost1_std "" RAT_FUNC "%.1" "CAD/BTDCC" COEFFS 0 16 0 0 0 1 /end COMPU_METHOD
/begin CHARACTERISTIC TCRI_Tpost1_alt1 "Post 1 Timing - Alternate (CAD BTDCC)" MAP 0x0016FD44 /* @ECU_Address@TCRI_Tpost1_alt1@0x0230A000@ */ ECIPP_ALIGNMENT_SWORD 2048 Compu_TCRI_Tpost1_alt1 -2048 2047.9375
 /begin AXIS_DESCR COM_AXIS NO_INPUT_QUANTITY Compu_TCRI_QPT_xload 16 -1024 1023.96875 AXIS_PTS_REF TCRI_QPT_xload /end AXIS_DESCR
 /begin AXIS_DESCR COM_AXIS NO_INPUT_QUANTITY Compu_TCRI_QPT_yrpm 16 -32768 32767 AXIS_PTS_REF TCRI_QPT_yrpm /end AXIS_DESCR
/end CHARACTERISTIC
/begin COMPU_METHOD Compu_TCRI_Tpost1_alt1 "" RAT_FUNC "%.1" "CAD/BTDCC" COEFFS 0 16 0 0 0 1 /end COMPU_METHOD
/begin CHARACTERISTIC TCRI_Tpost2_cld "Post 2 Timing Base Offset (CAD)" MAP 0x001703C4 /* @ECU_Address@TCRI_Tpost2_cld@0x0230B000@ */ ECIPP_ALIGNMENT_SWORD 2048 Compu_TCRI_Tpost2_cld -2048 2047.9375
 /begin AXIS_DESCR COM_AXIS NO_INPUT_QUANTITY Compu_TCRI_cld_xload 8 -1024 1023.96875 AXIS_PTS_REF TCRI_cld_xload /end AXIS_DESCR
 /begin AXIS_DESCR COM_AXIS NO_INPUT_QUANTITY Compu_TCRI_cld_yrpm 8 -32768 32767 AXIS_PTS_REF TCRI_cld_yrpm /end AXIS_DESCR
/end CHARACTERISTIC
/begin COMPU_METHOD Compu_TCRI_Tpost2_cld "" RAT_FUNC "%.1" "CAD" COEFFS 0 16 0 0 0 1 /end COMPU_METHOD
/begin CHARACTERISTIC TCRI_Tpost2_std "Post 2 Timing - Standard (CAD BTDCC)" MAP 0x00170444 /* @ECU_Address@TCRI_Tpost2_std@0x0230C000@ */ ECIPP_ALIGNMENT_SWORD 2048 Compu_TCRI_Tpost2_std -2048 2047.9375
 /begin AXIS_DESCR COM_AXIS NO_INPUT_QUANTITY Compu_TCRI_QPT_xload 16 -1024 1023.96875 AXIS_PTS_REF TCRI_QPT_xload /end AXIS_DESCR
 /begin AXIS_DESCR COM_AXIS NO_INPUT_QUANTITY Compu_TCRI_QPT_yrpm 16 -32768 32767 AXIS_PTS_REF TCRI_QPT_yrpm /end AXIS_DESCR
/end CHARACTERISTIC
/begin COMPU_METHOD Compu_TCRI_Tpost2_std "" RAT_FUNC "%.1" "CAD/BTDCC" COEFFS 0 16 0 0 0 1 /end COMPU_METHOD
/begin CHARACTERISTIC TCRI_Tpost2_alt1 "Post 2 Timing - Alternate (CAD BTDCC)" MAP 0x001701C4 /* @ECU_Address@TCRI_Tpost2_alt1@0x0230D000@ */ ECIPP_ALIGNMENT_SWORD 2048 Compu_TCRI_Tpost2_alt1 -2048 2047.9375
 /begin AXIS_DESCR COM_AXIS NO_INPUT_QUANTITY Compu_TCRI_QPT_xload 16 -1024 1023.96875 AXIS_PTS_REF TCRI_QPT_xload /end AXIS_DESCR
 /begin AXIS_DESCR COM_AXIS NO_INPUT_QUANTITY Compu_TCRI_QPT_yrpm 16 -32768 32767 AXIS_PTS_REF TCRI_QPT_yrpm /end AXIS_DESCR
/end CHARACTERISTIC
/begin COMPU_METHOD Compu_TCRI_Tpost2_alt1 "" RAT_FUNC "%.1" "CAD/BTDCC" COEFFS 0 16 0 0 0 1 /end COMPU_METHOD
/begin COMPU_METHOD Compu_TCRI_Qmin_xPrail " " RAT_FUNC "%.0" "Rail Pressure (bar)" COEFFS 0 8 0 0 0 1 /end COMPU_METHOD
/begin COMPU_METHOD Compu_TCRI_Qmin_yrpm " " RAT_FUNC "%.0" "Speed (rpm)" COEFFS 0 1 0 0 0 1 /end COMPU_METHOD
/begin CHARACTERISTIC TCRI_Qmin "Minimum Injection Quantity (mg/stroke)" MAP 0x0016E424 /* @ECU_Address@TCRI_Qmin@0x02316000@ */ ECIPP_ALIGNMENT_SWORD 256 Compu_TCRI_Qmin -256 255.9921875
 /begin AXIS_DESCR COM_AXIS NO_INPUT_QUANTITY Compu_TCRI_Qmin_xPrail 8 -4096 4095.875 AXIS_PTS_REF TCRI_Qmin_xPrail /end AXIS_DESCR
 /begin AXIS_DESCR COM_AXIS NO_INPUT_QUANTITY Compu_TCRI_Qmin_yrpm 8 -32768 32767 AXIS_PTS_REF TCRI_Qmin_yrpm /end AXIS_DESCR
/end CHARACTERISTIC
/begin AXIS_PTS TCRI_Qmin_xPrail " " 0x0016E4A4 /* @ECU_Address@TCRI_Qmin_xPrail@0x02314000@ */ NO_INPUT_QUANTITY ECIPP_Lookup_SWORD 0 Compu_TCRI_Qmin_xPrail 8 -4096 4095.875 /end AXIS_PTS
/begin AXIS_PTS TCRI_Qmin_yrpm " " 0x0016E4B4 /* @ECU_Address@TCRI_Qmin_yrpm@0x02315000@ */ NO_INPUT_QUANTITY ECIPP_Lookup_SWORD 0 Compu_TCRI_Qmin_yrpm 8 -32768 32767 /end AXIS_PTS
/begin COMPU_METHOD Compu_TCRI_Qmin "" RAT_FUNC "%.2" "mg/stroke" COEFFS 0 128 0 0 0 1 /end COMPU_METHOD
/begin CHARACTERISTIC TCRI_pulseoff_std "Forced Injection Disable - Standard" MAP 0x00171091 /* @ECU_Address@TCRI_pulseoff_std@0x0231B000@ */ ECIPP_ALIGNMENT_UBYTE 255 Compu_TCRI_pulseoff_std 0 255
 /begin AXIS_DESCR COM_AXIS NO_INPUT_QUANTITY Compu_TCRI_QPT_xload 16 -1024 1023.96875 AXIS_PTS_REF TCRI_QPT_xload /end AXIS_DESCR
 /begin AXIS_DESCR COM_AXIS NO_INPUT_QUANTITY Compu_TCRI_QPT_yrpm 16 -32768 32767 AXIS_PTS_REF TCRI_QPT_yrpm /end AXIS_DESCR
/end CHARACTERISTIC
/begin COMPU_METHOD Compu_TCRI_pulseoff_std "" RAT_FUNC "%.0" "-" COEFFS 0 1 0 0 0 1 /end COMPU_METHOD
/begin CHARACTERISTIC TCRI_pulseoff_alt1 "Forced Injection Disable - Alternate" MAP 0x00170F91 /* @ECU_Address@TCRI_pulseoff_alt1@0x0231C000@ */ ECIPP_ALIGNMENT_UBYTE 255 Compu_TCRI_pulseoff_alt1 0 255
 /begin AXIS_DESCR COM_AXIS NO_INPUT_QUANTITY Compu_TCRI_QPT_xload 16 -1024 1023.96875 AXIS_PTS_REF TCRI_QPT_xload /end AXIS_DESCR
 /begin AXIS_DESCR COM_AXIS NO_INPUT_QUANTITY Compu_TCRI_QPT_yrpm 16 -32768 32767 AXIS_PTS_REF TCRI_QPT_yrpm /end AXIS_DESCR
/end CHARACTERISTIC
/begin COMPU_METHOD Compu_TCRI_pulseoff_alt1 "" RAT_FUNC "%.0" "-" COEFFS 0 1 0 0 0 1 /end COMPU_METHOD
/begin COMPU_METHOD Compu_TDOC_Tcl_yrpm " " RAT_FUNC "%.0" "Speed (rpm)" COEFFS 0 1 0 0 0 1 /end COMPU_METHOD
/begin COMPU_METHOD Compu_TDOC_Tcl_xload " " RAT_FUNC "%.1" "Fuel Load (mg/cyl)" COEFFS 0 32 0 0 0 1 /end COMPU_METHOD
/begin CHARACTERISTIC TDOC_Tcl_std "DOC Temperature Target - Standard (deg F)" MAP 0x00170D24 /* @ECU_Address@TDOC_Tcl_std@0x02329000@ */ ECIPP_ALIGNMENT_SWORD 3636 Compu_TDOC_Tcl_std -4556 3635.875
 /begin AXIS_DESCR COM_AXIS NO_INPUT_QUANTITY Compu_TDOC_Tcl_xload 8 -1024 1023.96875 AXIS_PTS_REF TDOC_Tcl_xload /end AXIS_DESCR
 /begin AXIS_DESCR COM_AXIS NO_INPUT_QUANTITY Compu_TDOC_Tcl_yrpm 8 -32768 32767 AXIS_PTS_REF TDOC_Tcl_yrpm /end AXIS_DESCR
/end CHARACTERISTIC
/begin AXIS_PTS TDOC_Tcl_xload " " 0x00170DA4 /* @ECU_Address@TDOC_Tcl_xload@0x02328000@ */ NO_INPUT_QUANTITY ECIPP_Lookup_SWORD 0 Compu_TDOC_Tcl_xload 8 -1024 1023.96875 /end AXIS_PTS
/begin AXIS_PTS TDOC_Tcl_yrpm " " 0x00170DB4 /* @ECU_Address@TDOC_Tcl_yrpm@0x02327000@ */ NO_INPUT_QUANTITY ECIPP_Lookup_SWORD 0 Compu_TDOC_Tcl_yrpm 8 -32768 32767 /end AXIS_PTS
/begin COMPU_METHOD Compu_TDOC_Tcl_std "" RAT_FUNC "%.0" "degF" COEFFS 0 8 3680 0 0 1 /end COMPU_METHOD
/begin CHARACTERISTIC TDOC_Tcl_alt1 "DOC Temperature Target - Alternate (deg F)" MAP 0x00170CA4 /* @ECU_Address@TDOC_Tcl_alt1@0x0232A000@ */ ECIPP_ALIGNMENT_SWORD 3636 Compu_TDOC_Tcl_alt1 -4556 3635.875
 /begin AXIS_DESCR COM_AXIS NO_INPUT_QUANTITY Compu_TDOC_Tcl_xload 8 -1024 1023.96875 AXIS_PTS_REF TDOC_Tcl_xload /end AXIS_DESCR
 /begin AXIS_DESCR COM_AXIS NO_INPUT_QUANTITY Compu_TDOC_Tcl_yrpm 8 -32768 32767 AXIS_PTS_REF TDOC_Tcl_yrpm /end AXIS_DESCR
/end CHARACTERISTIC
/begin COMPU_METHOD Compu_TDOC_Tcl_alt1 "" RAT_FUNC "%.0" "degF" COEFFS 0 8 3680 0 0 1 /end COMPU_METHOD
/begin CHARACTERISTIC TTC_comp_etamax "Compressor Efficiency, Flow, and Speed" CURVE 0x0016301A /* @ECU_Address@TTC_comp_etamax@0x02336000@ */ ECIPP_ALIGNMENT_SWORD 200 Compu_TTC_comp_etamax -200 199.993896484375
 /begin AXIS_DESCR COM_AXIS NO_INPUT_QUANTITY Compu_TTC_comp_Pratio 8 -16 15.99951171875 AXIS_PTS_REF TTC_comp_Pratio /end AXIS_DESCR
/end CHARACTERISTIC
/begin AXIS_PTS TTC_comp_Pratio " " 0x00162FFA /* @ECU_Address@TTC_comp_Pratio@0x0233E000@ */ NO_INPUT_QUANTITY ECIPP_Lookup_SWORD 0 Compu_TTC_comp_Pratio 8 -16 15.99951171875 /end AXIS_PTS
/begin COMPU_METHOD Compu_TTC_comp_etamax " " RAT_FUNC "%.1" "Eta Max (%)" COEFFS 0 163.84 0 0 0 1 /end COMPU_METHOD
/begin COMPU_METHOD Compu_TTC_comp_Pratio " " RAT_FUNC "%.2" "Pratio (mult)" COEFFS 0 2048 0 0 0 1 /end COMPU_METHOD
/begin CHARACTERISTIC TTC_turb_Pratio "Air # TTC_turb_Pratio" VAL_BLK 0x001630E2 /* @ECU_Address@TTC_turb_Pratio@0x0233F000@ */ ECIPP_ALIGNMENT_SWORD 16 Compu_TTC_turb_Pratio -16 15.99951171875 MATRIX_DIM 8 1 1 /end CHARACTERISTIC
/begin COMPU_METHOD Compu_TTC_turb_Pratio " " RAT_FUNC "%.0" "-" COEFFS 0 2048 0 0 0 1 /end COMPU_METHOD
/begin CHARACTERISTIC TTC_comp_surge_pct "Compressor Efficiency, Flow, and Speed" CURVE 0x00163032 /* @ECU_Address@TTC_comp_surge_pct@0x02340000@ */ ECIPP_ALIGNMENT_SWORD 200 Compu_TTC_comp_surge_pct -200 199.993896484375
 /begin AXIS_DESCR COM_AXIS NO_INPUT_QUANTITY Compu_TTC_comp_Pratio 8 -16 15.99951171875 AXIS_PTS_REF TTC_comp_Pratio /end AXIS_DESCR
/end CHARACTERISTIC
/begin COMPU_METHOD Compu_TTC_comp_surge_pct " " RAT_FUNC "%.1" "Surge Flow (% ref)" COEFFS 0 163.84 0 0 0 1 /end COMPU_METHOD
/begin CHARACTERISTIC TTC_comp_choke_pct "Compressor Efficiency, Flow, and Speed" CURVE 0x0016300A /* @ECU_Address@TTC_comp_choke_pct@0x02341000@ */ ECIPP_ALIGNMENT_SWORD 200 Compu_TTC_comp_choke_pct -200 199.993896484375
 /begin AXIS_DESCR COM_AXIS NO_INPUT_QUANTITY Compu_TTC_comp_Pratio 8 -16 15.99951171875 AXIS_PTS_REF TTC_comp_Pratio /end AXIS_DESCR
/end CHARACTERISTIC
/begin COMPU_METHOD Compu_TTC_comp_choke_pct " " RAT_FUNC "%.1" "Choke Flow (% ref)" COEFFS 0 163.84 0 0 0 1 /end COMPU_METHOD
/begin CHARACTERISTIC TTC_comp_Npct "Air # TTC_comp_Npct" VAL_BLK 0x00162FBA /* @ECU_Address@TTC_comp_Npct@0x02343000@ */ ECIPP_ALIGNMENT_SWORD 200 Compu_TTC_comp_Npct -200 199.993896484375 MATRIX_DIM 32 1 1 /end CHARACTERISTIC
/begin COMPU_METHOD Compu_TTC_comp_Npct "" RAT_FUNC "%.0" "% ref" COEFFS 0 163.84 0 0 0 1 /end COMPU_METHOD
/begin CHARACTERISTIC TTC_turb_Nmult_neg "Air # TTC_turb_Nmult_neg" VAL_BLK 0x00163042 /* @ECU_Address@TTC_turb_Nmult_neg@0x02344000@ */ ECIPP_ALIGNMENT_SWORD 2 Compu_TTC_turb_Nmult_neg -2 1.99993896484375 MATRIX_DIM 8 1 1 /end CHARACTERISTIC
/begin COMPU_METHOD Compu_TTC_turb_Nmult_neg " " RAT_FUNC "%.0" "%/Krpm^2" COEFFS 0 16384 0 0 0 1 /end COMPU_METHOD
/begin CHARACTERISTIC TTC_turb_Nmult_pos "Air # TTC_turb_Nmult_pos" VAL_BLK 0x00163052 /* @ECU_Address@TTC_turb_Nmult_pos@0x02345000@ */ ECIPP_ALIGNMENT_SWORD 2 Compu_TTC_turb_Nmult_pos -2 1.99993896484375 MATRIX_DIM 8 1 1 /end CHARACTERISTIC
/begin COMPU_METHOD Compu_TTC_turb_Nmult_pos " " RAT_FUNC "%.0" "%/Krpm^2" COEFFS 0 16384 0 0 0 1 /end COMPU_METHOD
/begin CHARACTERISTIC TTC_turb_etamax "Air # TTC_turb_etamax" VAL_BLK 0x00163112 /* @ECU_Address@TTC_turb_etamax@0x02347000@ */ ECIPP_ALIGNMENT_SWORD 200 Compu_TTC_turb_etamax -200 199.993896484375 MATRIX_DIM 64 1 1 /end CHARACTERISTIC
/begin COMPU_METHOD Compu_TTC_turb_etamax "" RAT_FUNC "%.0" "%" COEFFS 0 163.84 0 0 0 1 /end COMPU_METHOD
/begin CHARACTERISTIC TTC_turb_Npct_etamax "Air # TTC_turb_Npct_etamax" VAL_BLK 0x00163062 /* @ECU_Address@TTC_turb_Npct_etamax@0x02348000@ */ ECIPP_ALIGNMENT_SWORD 200 Compu_TTC_turb_Npct_etamax -200 199.993896484375 MATRIX_DIM 64 1 1 /end CHARACTERISTIC
/begin COMPU_METHOD Compu_TTC_turb_Npct_etamax "" RAT_FUNC "%.0" "% ref" COEFFS 0 163.84 0 0 0 1 /end COMPU_METHOD
/begin CHARACTERISTIC TTC_turb_mdot1c_pct "Air # TTC_turb_mdot1c_pct" VAL_BLK 0x0016319A /* @ECU_Address@TTC_turb_mdot1c_pct@0x0234B000@ */ ECIPP_ALIGNMENT_SWORD 200 Compu_TTC_turb_mdot1c_pct -200 199.993896484375 MATRIX_DIM 32 1 1 /end CHARACTERISTIC
/begin COMPU_METHOD Compu_TTC_turb_mdot1c_pct "" RAT_FUNC "%.0" "% ref" COEFFS 0 163.84 0 0 0 1 /end COMPU_METHOD
/begin MEASUREMENT TTPSad_CdA_crct "Throttle Adaptive Area" FLOAT32_IEEE Compu_TTPSad_CdA_crct 0 0 -10000000000 10000000000 ECU_ADDRESS 0x024C6000 MATRIX_DIM 16 1 1 /end MEASUREMENT
/begin COMPU_METHOD Compu_TTPSad_CdA_crct " " RAT_FUNC "%.3" "Corrected Area (in2)" COEFFS 0 1 0 0 0 1 /end COMPU_METHOD
/begin CHARACTERISTIC HEX_FSS_PID_tbl "General # HEX_FSS_PID_tbl" VAL_BLK 0x00166341 /* @ECU_Address@HEX_FSS_PID_tbl@0x025B7000@ */ ECIPP_ALIGNMENT_UBYTE 255 Compu_HEX_FSS_PID_tbl 0 255 MATRIX_DIM 30 1 1 /end CHARACTERISTIC
/begin COMPU_METHOD Compu_HEX_FSS_PID_tbl " " RAT_FUNC "%.0" "-" COEFFS 0 1 0 0 0 1 /end COMPU_METHOD
/begin CHARACTERISTIC FCdc4_accel_x_max "FCtl_DTC_0x04(702)" VALUE 0x0016414C /* @ECU_Address@FCtl_DTC_0x04@0x024C457C@ */ ECIPP_ALIGNMENT_UWORD 65535 Compu_IDENTITY 0 65535 PHYS_UNIT "System ID + DTC" /end CHARACTERISTIC
/begin CHARACTERISTIC FCdc4_accel_x_min "FCtl_DTC_0x04(703)" VALUE 0x0016414E /* @ECU_Address@FCtl_DTC_0x04@0x024C457E@ */ ECIPP_ALIGNMENT_UWORD 65535 Compu_IDENTITY 0 65535 PHYS_UNIT "System ID + DTC" /end CHARACTERISTIC
/begin CHARACTERISTIC FCdc4_accel_y_max "FCtl_DTC_0x04(704)" VALUE 0x00164150 /* @ECU_Address@FCtl_DTC_0x04@0x024C4580@ */ ECIPP_ALIGNMENT_UWORD 65535 Compu_IDENTITY 0 65535 PHYS_UNIT "System ID + DTC" /end CHARACTERISTIC
/begin CHARACTERISTIC FCdc4_accel_y_min "FCtl_DTC_0x04(705)" VALUE 0x00164152 /* @ECU_Address@FCtl_DTC_0x04@0x024C4582@ */ ECIPP_ALIGNMENT_UWORD 65535 Compu_IDENTITY 0 65535 PHYS_UNIT "System ID + DTC" /end CHARACTERISTIC
/begin CHARACTERISTIC FCdc4_accel_z_max "FCtl_DTC_0x04(706)" VALUE 0x00164154 /* @ECU_Address@FCtl_DTC_0x04@0x024C4584@ */ ECIPP_ALIGNMENT_UWORD 65535 Compu_IDENTITY 0 65535 PHYS_UNIT "System ID + DTC" /end CHARACTERISTIC
/begin CHARACTERISTIC FCdc4_accel_z_min "FCtl_DTC_0x04(707)" VALUE 0x00164156 /* @ECU_Address@FCtl_DTC_0x04@0x024C4586@ */ ECIPP_ALIGNMENT_UWORD 65535 Compu_IDENTITY 0 65535 PHYS_UNIT "System ID + DTC" /end CHARACTERISTIC
/begin CHARACTERISTIC FCdc4_ADIG1_max "FCtl_DTC_0x04(209)" VALUE 0x00163D72 /* @ECU_Address@FCtl_DTC_0x04@0x024C41A2@ */ ECIPP_ALIGNMENT_UWORD 65535 Compu_IDENTITY 0 65535 PHYS_UNIT "System ID + DTC" /end CHARACTERISTIC
/begin CHARACTERISTIC FCdc4_ADIG1_min "FCtl_DTC_0x04(210)" VALUE 0x00163D74 /* @ECU_Address@FCtl_DTC_0x04@0x024C41A4@ */ ECIPP_ALIGNMENT_UWORD 65535 Compu_IDENTITY 0 65535 PHYS_UNIT "System ID + DTC" /end CHARACTERISTIC
/begin CHARACTERISTIC FCdc4_ADIG10_max "FCtl_DTC_0x04(349)" VALUE 0x00163E8A /* @ECU_Address@FCtl_DTC_0x04@0x024C42BA@ */ ECIPP_ALIGNMENT_UWORD 65535 Compu_IDENTITY 0 65535 PHYS_UNIT "System ID + DTC" /end CHARACTERISTIC
/begin CHARACTERISTIC FCdc4_ADIG10_min "FCtl_DTC_0x04(350)" VALUE 0x00163E8C /* @ECU_Address@FCtl_DTC_0x04@0x024C42BC@ */ ECIPP_ALIGNMENT_UWORD 65535 Compu_IDENTITY 0 65535 PHYS_UNIT "System ID + DTC" /end CHARACTERISTIC
/begin CHARACTERISTIC FCdc4_ADIG11_max "FCtl_DTC_0x04(354)" VALUE 0x00163E94 /* @ECU_Address@FCtl_DTC_0x04@0x024C42C4@ */ ECIPP_ALIGNMENT_UWORD 65535 Compu_IDENTITY 0 65535 PHYS_UNIT "System ID + DTC" /end CHARACTERISTIC
/begin CHARACTERISTIC FCdc4_ADIG11_min "FCtl_DTC_0x04(355)" VALUE 0x00163E96 /* @ECU_Address@FCtl_DTC_0x04@0x024C42C6@ */ ECIPP_ALIGNMENT_UWORD 65535 Compu_IDENTITY 0 65535 PHYS_UNIT "System ID + DTC" /end CHARACTERISTIC
/begin CHARACTERISTIC FCdc4_ADIG12_max "FCtl_DTC_0x04(356)" VALUE 0x00163E98 /* @ECU_Address@FCtl_DTC_0x04@0x024C42C8@ */ ECIPP_ALIGNMENT_UWORD 65535 Compu_IDENTITY 0 65535 PHYS_UNIT "System ID + DTC" /end CHARACTERISTIC
/begin CHARACTERISTIC FCdc4_ADIG12_min "FCtl_DTC_0x04(357)" VALUE 0x00163E9A /* @ECU_Address@FCtl_DTC_0x04@0x024C42CA@ */ ECIPP_ALIGNMENT_UWORD 65535 Compu_IDENTITY 0 65535 PHYS_UNIT "System ID + DTC" /end CHARACTERISTIC
/begin CHARACTERISTIC FCdc4_ADIG13_max "FCtl_DTC_0x04(393)" VALUE 0x00163EE2 /* @ECU_Address@FCtl_DTC_0x04@0x024C4312@ */ ECIPP_ALIGNMENT_UWORD 65535 Compu_IDENTITY 0 65535 PHYS_UNIT "System ID + DTC" /end CHARACTERISTIC
/begin CHARACTERISTIC FCdc4_ADIG13_min "FCtl_DTC_0x04(394)" VALUE 0x00163EE4 /* @ECU_Address@FCtl_DTC_0x04@0x024C4314@ */ ECIPP_ALIGNMENT_UWORD 65535 Compu_IDENTITY 0 65535 PHYS_UNIT "System ID + DTC" /end CHARACTERISTIC
/begin CHARACTERISTIC FCdc4_ADIG14_max "FCtl_DTC_0x04(395)" VALUE 0x00163EE6 /* @ECU_Address@FCtl_DTC_0x04@0x024C4316@ */ ECIPP_ALIGNMENT_UWORD 65535 Compu_IDENTITY 0 65535 PHYS_UNIT "System ID + DTC" /end CHARACTERISTIC
/begin CHARACTERISTIC FCdc4_ADIG14_min "FCtl_DTC_0x04(396)" VALUE 0x00163EE8 /* @ECU_Address@FCtl_DTC_0x04@0x024C4318@ */ ECIPP_ALIGNMENT_UWORD 65535 Compu_IDENTITY 0 65535 PHYS_UNIT "System ID + DTC" /end CHARACTERISTIC
/begin CHARACTERISTIC FCdc4_ADIG15_max "FCtl_DTC_0x04(397)" VALUE 0x00163EEA /* @ECU_Address@FCtl_DTC_0x04@0x024C431A@ */ ECIPP_ALIGNMENT_UWORD 65535 Compu_IDENTITY 0 65535 PHYS_UNIT "System ID + DTC" /end CHARACTERISTIC
/begin CHARACTERISTIC FPnd_accel_x_max "FPrm_pending(532)" VALUE 0x00164D94 /* @ECU_Address@FPrm_pending@0x021BE428@ */ ECIPP_ALIGNMENT_UWORD 65535 Compu_IDENTITY 0 65535 PHYS_UNIT "Bit Mask" /end CHARACTERISTIC
/begin CHARACTERISTIC FPnd_accel_x_min "FPrm_pending(533)" VALUE 0x00164D96 /* @ECU_Address@FPrm_pending@0x021BE42A@ */ ECIPP_ALIGNMENT_UWORD 65535 Compu_IDENTITY 0 65535 PHYS_UNIT "Bit Mask" /end CHARACTERISTIC
/begin CHARACTERISTIC FPnd_accel_y_max "FPrm_pending(534)" VALUE 0x00164D98 /* @ECU_Address@FPrm_pending@0x021BE42C@ */ ECIPP_ALIGNMENT_UWORD 65535 Compu_IDENTITY 0 65535 PHYS_UNIT "Bit Mask" /end CHARACTERISTIC
/begin CHARACTERISTIC FPnd_accel_y_min "FPrm_pending(535)" VALUE 0x00164D9A /* @ECU_Address@FPrm_pending@0x021BE42E@ */ ECIPP_ALIGNMENT_UWORD 65535 Compu_IDENTITY 0 65535 PHYS_UNIT "Bit Mask" /end CHARACTERISTIC
/begin CHARACTERISTIC FPnd_accel_z_max "FPrm_pending(536)" VALUE 0x00164D9C /* @ECU_Address@FPrm_pending@0x021BE430@ */ ECIPP_ALIGNMENT_UWORD 65535 Compu_IDENTITY 0 65535 PHYS_UNIT "Bit Mask" /end CHARACTERISTIC
/begin CHARACTERISTIC FPnd_accel_z_min "FPrm_pending(537)" VALUE 0x00164D9E /* @ECU_Address@FPrm_pending@0x021BE432@ */ ECIPP_ALIGNMENT_UWORD 65535 Compu_IDENTITY 0 65535 PHYS_UNIT "Bit Mask" /end CHARACTERISTIC
/begin CHARACTERISTIC FPnd_ADIG1_max "FPrm_pending(165)" VALUE 0x00164AB6 /* @ECU_Address@FPrm_pending@0x021BE14A@ */ ECIPP_ALIGNMENT_UWORD 65535 Compu_IDENTITY 0 65535 PHYS_UNIT "Bit Mask" /end CHARACTERISTIC
/begin CHARACTERISTIC FPnd_ADIG1_min "FPrm_pending(166)" VALUE 0x00164AB8 /* @ECU_Address@FPrm_pending@0x021BE14C@ */ ECIPP_ALIGNMENT_UWORD 65535 Compu_IDENTITY 0 65535 PHYS_UNIT "Bit Mask" /end CHARACTERISTIC
/begin CHARACTERISTIC FPnd_ADIG10_max "FPrm_pending(258)" VALUE 0x00164B70 /* @ECU_Address@FPrm_pending@0x021BE204@ */ ECIPP_ALIGNMENT_UWORD 65535 Compu_IDENTITY 0 65535 PHYS_UNIT "Bit Mask" /end CHARACTERISTIC
/begin CHARACTERISTIC FPnd_ADIG10_min "FPrm_pending(259)" VALUE 0x00164B72 /* @ECU_Address@FPrm_pending@0x021BE206@ */ ECIPP_ALIGNMENT_UWORD 65535 Compu_IDENTITY 0 65535 PHYS_UNIT "Bit Mask" /end CHARACTERISTIC
/begin CHARACTERISTIC FPnd_ADIG11_max "FPrm_pending(263)" VALUE 0x00164B7A /* @ECU_Address@FPrm_pending@0x021BE20E@ */ ECIPP_ALIGNMENT_UWORD 65535 Compu_IDENTITY 0 65535 PHYS_UNIT "Bit Mask" /end CHARACTERISTIC
/begin CHARACTERISTIC FPnd_ADIG11_min "FPrm_pending(264)" VALUE 0x00164B7C /* @ECU_Address@FPrm_pending@0x021BE210@ */ ECIPP_ALIGNMENT_UWORD 65535 Compu_IDENTITY 0 65535 PHYS_UNIT "Bit Mask" /end CHARACTERISTIC
/begin CHARACTERISTIC FPnd_ADIG12_max "FPrm_pending(265)" VALUE 0x00164B7E /* @ECU_Address@FPrm_pending@0x021BE212@ */ ECIPP_ALIGNMENT_UWORD 65535 Compu_IDENTITY 0 65535 PHYS_UNIT "Bit Mask" /end CHARACTERISTIC
/begin CHARACTERISTIC FPnd_ADIG12_min "FPrm_pending(266)" VALUE 0x00164B80 /* @ECU_Address@FPrm_pending@0x021BE214@ */ ECIPP_ALIGNMENT_UWORD 65535 Compu_IDENTITY 0 65535 PHYS_UNIT "Bit Mask" /end CHARACTERISTIC
/begin CHARACTERISTIC FPnd_ADIG13_max "FPrm_pending(302)" VALUE 0x00164BC8 /* @ECU_Address@FPrm_pending@0x021BE25C@ */ ECIPP_ALIGNMENT_UWORD 65535 Compu_IDENTITY 0 65535 PHYS_UNIT "Bit Mask" /end CHARACTERISTIC
/begin CHARACTERISTIC FPnd_ADIG13_min "FPrm_pending(303)" VALUE 0x00164BCA /* @ECU_Address@FPrm_pending@0x021BE25E@ */ ECIPP_ALIGNMENT_UWORD 65535 Compu_IDENTITY 0 65535 PHYS_UNIT "Bit Mask" /end CHARACTERISTIC
/begin CHARACTERISTIC FPnd_ADIG14_max "FPrm_pending(304)" VALUE 0x00164BCC /* @ECU_Address@FPrm_pending@0x021BE260@ */ ECIPP_ALIGNMENT_UWORD 65535 Compu_IDENTITY 0 65535 PHYS_UNIT "Bit Mask" /end CHARACTERISTIC
/begin CHARACTERISTIC FPnd_ADIG14_min "FPrm_pending(305)" VALUE 0x00164BCE /* @ECU_Address@FPrm_pending@0x021BE262@ */ ECIPP_ALIGNMENT_UWORD 65535 Compu_IDENTITY 0 65535 PHYS_UNIT "Bit Mask" /end CHARACTERISTIC
/begin CHARACTERISTIC FPnd_ADIG15_max "FPrm_pending(306)" VALUE 0x00164BD0 /* @ECU_Address@FPrm_pending@0x021BE264@ */ ECIPP_ALIGNMENT_UWORD 65535 Compu_IDENTITY 0 65535 PHYS_UNIT "Bit Mask" /end CHARACTERISTIC
/begin CHARACTERISTIC FPsvr_accel_x_max "FPrm_severity(532)" VALUE 0x00165FF2 /* @ECU_Address@FPrm_severity@0x024B3214@ */ ECIPP_ALIGNMENT_UBYTE 255 Compu_IDENTITY 0 255 PHYS_UNIT "Severity+Class" /end CHARACTERISTIC
/begin CHARACTERISTIC FPsvr_accel_x_min "FPrm_severity(533)" VALUE 0x00165FF3 /* @ECU_Address@FPrm_severity@0x024B3215@ */ ECIPP_ALIGNMENT_UBYTE 255 Compu_IDENTITY 0 255 PHYS_UNIT "Severity+Class" /end CHARACTERISTIC
/begin CHARACTERISTIC FPsvr_accel_y_max "FPrm_severity(534)" VALUE 0x00165FF4 /* @ECU_Address@FPrm_severity@0x024B3216@ */ ECIPP_ALIGNMENT_UBYTE 255 Compu_IDENTITY 0 255 PHYS_UNIT "Severity+Class" /end CHARACTERISTIC
/begin CHARACTERISTIC FPsvr_accel_y_min "FPrm_severity(535)" VALUE 0x00165FF5 /* @ECU_Address@FPrm_severity@0x024B3217@ */ ECIPP_ALIGNMENT_UBYTE 255 Compu_IDENTITY 0 255 PHYS_UNIT "Severity+Class" /end CHARACTERISTIC
/begin CHARACTERISTIC FPsvr_accel_z_max "FPrm_severity(536)" VALUE 0x00165FF6 /* @ECU_Address@FPrm_severity@0x024B3218@ */ ECIPP_ALIGNMENT_UBYTE 255 Compu_IDENTITY 0 255 PHYS_UNIT "Severity+Class" /end CHARACTERISTIC
/begin CHARACTERISTIC FPsvr_accel_z_min "FPrm_severity(537)" VALUE 0x00165FF7 /* @ECU_Address@FPrm_severity@0x024B3219@ */ ECIPP_ALIGNMENT_UBYTE 255 Compu_IDENTITY 0 255 PHYS_UNIT "Severity+Class" /end CHARACTERISTIC
/begin CHARACTERISTIC FPsvr_ADIG1_max "FPrm_severity(165)" VALUE 0x00165E83 /* @ECU_Address@FPrm_severity@0x024B30A5@ */ ECIPP_ALIGNMENT_UBYTE 255 Compu_IDENTITY 0 255 PHYS_UNIT "Severity+Class" /end CHARACTERISTIC
/begin CHARACTERISTIC FPsvr_ADIG1_min "FPrm_severity(166)" VALUE 0x00165E84 /* @ECU_Address@FPrm_severity@0x024B30A6@ */ ECIPP_ALIGNMENT_UBYTE 255 Compu_IDENTITY 0 255 PHYS_UNIT "Severity+Class" /end CHARACTERISTIC
/begin CHARACTERISTIC FPsvr_ADIG10_max "FPrm_severity(258)" VALUE 0x00165EE0 /* @ECU_Address@FPrm_severity@0x024B3102@ */ ECIPP_ALIGNMENT_UBYTE 255 Compu_IDENTITY 0 255 PHYS_UNIT "Severity+Class" /end CHARACTERISTIC
/begin CHARACTERISTIC FPsvr_ADIG10_min "FPrm_severity(259)" VALUE 0x00165EE1 /* @ECU_Address@FPrm_severity@0x024B3103@ */ ECIPP_ALIGNMENT_UBYTE 255 Compu_IDENTITY 0 255 PHYS_UNIT "Severity+Class" /end CHARACTERISTIC
/begin CHARACTERISTIC FPsvr_ADIG11_max "FPrm_severity(263)" VALUE 0x00165EE5 /* @ECU_Address@FPrm_severity@0x024B3107@ */ ECIPP_ALIGNMENT_UBYTE 255 Compu_IDENTITY 0 255 PHYS_UNIT "Severity+Class" /end CHARACTERISTIC
/begin CHARACTERISTIC FPsvr_ADIG11_min "FPrm_severity(264)" VALUE 0x00165EE6 /* @ECU_Address@FPrm_severity@0x024B3108@ */ ECIPP_ALIGNMENT_UBYTE 255 Compu_IDENTITY 0 255 PHYS_UNIT "Severity+Class" /end CHARACTERISTIC
/begin CHARACTERISTIC FPsvr_ADIG12_max "FPrm_severity(265)" VALUE 0x00165EE7 /* @ECU_Address@FPrm_severity@0x024B3109@ */ ECIPP_ALIGNMENT_UBYTE 255 Compu_IDENTITY 0 255 PHYS_UNIT "Severity+Class" /end CHARACTERISTIC
/begin CHARACTERISTIC FPsvr_ADIG12_min "FPrm_severity(266)" VALUE 0x00165EE8 /* @ECU_Address@FPrm_severity@0x024B310A@ */ ECIPP_ALIGNMENT_UBYTE 255 Compu_IDENTITY 0 255 PHYS_UNIT "Severity+Class" /end CHARACTERISTIC
/begin CHARACTERISTIC FPsvr_ADIG13_max "FPrm_severity(302)" VALUE 0x00165F0C /* @ECU_Address@FPrm_severity@0x024B312E@ */ ECIPP_ALIGNMENT_UBYTE 255 Compu_IDENTITY 0 255 PHYS_UNIT "Severity+Class" /end CHARACTERISTIC
/begin CHARACTERISTIC FPsvr_ADIG13_min "FPrm_severity(303)" VALUE 0x00165F0D /* @ECU_Address@FPrm_severity@0x024B312F@ */ ECIPP_ALIGNMENT_UBYTE 255 Compu_IDENTITY 0 255 PHYS_UNIT "Severity+Class" /end CHARACTERISTIC
/begin CHARACTERISTIC FPsvr_ADIG14_max "FPrm_severity(304)" VALUE 0x00165F0E /* @ECU_Address@FPrm_severity@0x024B3130@ */ ECIPP_ALIGNMENT_UBYTE 255 Compu_IDENTITY 0 255 PHYS_UNIT "Severity+Class" /end CHARACTERISTIC
/begin CHARACTERISTIC FPsvr_ADIG14_min "FPrm_severity(305)" VALUE 0x00165F0F /* @ECU_Address@FPrm_severity@0x024B3131@ */ ECIPP_ALIGNMENT_UBYTE 255 Compu_IDENTITY 0 255 PHYS_UNIT "Severity+Class" /end CHARACTERISTIC
/begin CHARACTERISTIC FPsvr_ADIG15_max "FPrm_severity(306)" VALUE 0x00165F10 /* @ECU_Address@FPrm_severity@0x024B3132@ */ ECIPP_ALIGNMENT_UBYTE 255 Compu_IDENTITY 0 255 PHYS_UNIT "Severity+Class" /end CHARACTERISTIC
/begin CHARACTERISTIC FPsw_accel_x_max "FPrm_switches(532)" VALUE 0x00146D04 /* @ECU_Address@FPrm_switches@0x021B9428@ */ ECIPP_ALIGNMENT_UWORD 65535 Compu_IDENTITY 0 65535 PHYS_UNIT "Enable bits" /end CHARACTERISTIC
/begin CHARACTERISTIC FPsw_accel_x_min "FPrm_switches(533)" VALUE 0x00146D06 /* @ECU_Address@FPrm_switches@0x021B942A@ */ ECIPP_ALIGNMENT_UWORD 65535 Compu_IDENTITY 0 65535 PHYS_UNIT "Enable bits" /end CHARACTERISTIC
/begin CHARACTERISTIC FPsw_accel_y_max "FPrm_switches(534)" VALUE 0x00146D08 /* @ECU_Address@FPrm_switches@0x021B942C@ */ ECIPP_ALIGNMENT_UWORD 65535 Compu_IDENTITY 0 65535 PHYS_UNIT "Enable bits" /end CHARACTERISTIC
/begin CHARACTERISTIC FPsw_accel_y_min "FPrm_switches(535)" VALUE 0x00146D0A /* @ECU_Address@FPrm_switches@0x021B942E@ */ ECIPP_ALIGNMENT_UWORD 65535 Compu_IDENTITY 0 65535 PHYS_UNIT "Enable bits" /end CHARACTERISTIC
/begin CHARACTERISTIC FPsw_accel_z_max "FPrm_switches(536)" VALUE 0x00146D0C /* @ECU_Address@FPrm_switches@0x021B9430@ */ ECIPP_ALIGNMENT_UWORD 65535 Compu_IDENTITY 0 65535 PHYS_UNIT "Enable bits" /end CHARACTERISTIC
/begin CHARACTERISTIC FPsw_accel_z_min "FPrm_switches(537)" VALUE 0x00146D0E /* @ECU_Address@FPrm_switches@0x021B9432@ */ ECIPP_ALIGNMENT_UWORD 65535 Compu_IDENTITY 0 65535 PHYS_UNIT "Enable bits" /end CHARACTERISTIC
/begin CHARACTERISTIC FPsw_ADIG1_max "FPrm_switches(165)" VALUE 0x00146A26 /* @ECU_Address@FPrm_switches@0x021B914A@ */ ECIPP_ALIGNMENT_UWORD 65535 Compu_IDENTITY 0 65535 PHYS_UNIT "Enable bits" /end CHARACTERISTIC
/begin CHARACTERISTIC FPsw_ADIG1_min "FPrm_switches(166)" VALUE 0x00146A28 /* @ECU_Address@FPrm_switches@0x021B914C@ */ ECIPP_ALIGNMENT_UWORD 65535 Compu_IDENTITY 0 65535 PHYS_UNIT "Enable bits" /end CHARACTERISTIC
/begin CHARACTERISTIC FPsw_ADIG10_max "FPrm_switches(258)" VALUE 0x00146AE0 /* @ECU_Address@FPrm_switches@0x021B9204@ */ ECIPP_ALIGNMENT_UWORD 65535 Compu_IDENTITY 0 65535 PHYS_UNIT "Enable bits" /end CHARACTERISTIC
/begin CHARACTERISTIC FPsw_ADIG10_min "FPrm_switches(259)" VALUE 0x00146AE2 /* @ECU_Address@FPrm_switches@0x021B9206@ */ ECIPP_ALIGNMENT_UWORD 65535 Compu_IDENTITY 0 65535 PHYS_UNIT "Enable bits" /end CHARACTERISTIC
/begin CHARACTERISTIC FPsw_ADIG11_max "FPrm_switches(263)" VALUE 0x00146AEA /* @ECU_Address@FPrm_switches@0x021B920E@ */ ECIPP_ALIGNMENT_UWORD 65535 Compu_IDENTITY 0 65535 PHYS_UNIT "Enable bits" /end CHARACTERISTIC
/begin CHARACTERISTIC FPsw_ADIG11_min "FPrm_switches(264)" VALUE 0x00146AEC /* @ECU_Address@FPrm_switches@0x021B9210@ */ ECIPP_ALIGNMENT_UWORD 65535 Compu_IDENTITY 0 65535 PHYS_UNIT "Enable bits" /end CHARACTERISTIC
/begin CHARACTERISTIC FPsw_ADIG12_max "FPrm_switches(265)" VALUE 0x00146AEE /* @ECU_Address@FPrm_switches@0x021B9212@ */ ECIPP_ALIGNMENT_UWORD 65535 Compu_IDENTITY 0 65535 PHYS_UNIT "Enable bits" /end CHARACTERISTIC
/begin CHARACTERISTIC FPsw_ADIG12_min "FPrm_switches(266)" VALUE 0x00146AF0 /* @ECU_Address@FPrm_switches@0x021B9214@ */ ECIPP_ALIGNMENT_UWORD 65535 Compu_IDENTITY 0 65535 PHYS_UNIT "Enable bits" /end CHARACTERISTIC
/begin CHARACTERISTIC FPsw_ADIG13_max "FPrm_switches(302)" VALUE 0x00146B38 /* @ECU_Address@FPrm_switches@0x021B925C@ */ ECIPP_ALIGNMENT_UWORD 65535 Compu_IDENTITY 0 65535 PHYS_UNIT "Enable bits" /end CHARACTERISTIC
/begin CHARACTERISTIC FPsw_ADIG13_min "FPrm_switches(303)" VALUE 0x00146B3A /* @ECU_Address@FPrm_switches@0x021B925E@ */ ECIPP_ALIGNMENT_UWORD 65535 Compu_IDENTITY 0 65535 PHYS_UNIT "Enable bits" /end CHARACTERISTIC
/begin CHARACTERISTIC FPsw_ADIG14_max "FPrm_switches(304)" VALUE 0x00146B3C /* @ECU_Address@FPrm_switches@0x021B9260@ */ ECIPP_ALIGNMENT_UWORD 65535 Compu_IDENTITY 0 65535 PHYS_UNIT "Enable bits" /end CHARACTERISTIC
/begin CHARACTERISTIC FPsw_ADIG14_min "FPrm_switches(305)" VALUE 0x00146B3E /* @ECU_Address@FPrm_switches@0x021B9262@ */ ECIPP_ALIGNMENT_UWORD 65535 Compu_IDENTITY 0 65535 PHYS_UNIT "Enable bits" /end CHARACTERISTIC
/begin CHARACTERISTIC FPsw_ADIG15_max "FPrm_switches(306)" VALUE 0x00146B40 /* @ECU_Address@FPrm_switches@0x021B9264@ */ ECIPP_ALIGNMENT_UWORD 65535 Compu_IDENTITY 0 65535 PHYS_UNIT "Enable bits" /end CHARACTERISTIC
/begin CHARACTERISTIC FPsw_ext1_accel_x_max "FPrm_switches_ext1(532)" VALUE 0x00147266 /* @ECU_Address@FPrm_switches_ext1@0x023A5428@ */ ECIPP_ALIGNMENT_UWORD 65535 Compu_IDENTITY 0 65535 PHYS_UNIT "Enable bits" /end CHARACTERISTIC
/begin CHARACTERISTIC FPsw_ext1_accel_x_min "FPrm_switches_ext1(533)" VALUE 0x00147268 /* @ECU_Address@FPrm_switches_ext1@0x023A542A@ */ ECIPP_ALIGNMENT_UWORD 65535 Compu_IDENTITY 0 65535 PHYS_UNIT "Enable bits" /end CHARACTERISTIC
/begin CHARACTERISTIC FPsw_ext1_accel_y_max "FPrm_switches_ext1(534)" VALUE 0x0014726A /* @ECU_Address@FPrm_switches_ext1@0x023A542C@ */ ECIPP_ALIGNMENT_UWORD 65535 Compu_IDENTITY 0 65535 PHYS_UNIT "Enable bits" /end CHARACTERISTIC
/begin CHARACTERISTIC FPsw_ext1_accel_y_min "FPrm_switches_ext1(535)" VALUE 0x0014726C /* @ECU_Address@FPrm_switches_ext1@0x023A542E@ */ ECIPP_ALIGNMENT_UWORD 65535 Compu_IDENTITY 0 65535 PHYS_UNIT "Enable bits" /end CHARACTERISTIC
/begin CHARACTERISTIC FPsw_ext1_accel_z_max "FPrm_switches_ext1(536)" VALUE 0x0014726E /* @ECU_Address@FPrm_switches_ext1@0x023A5430@ */ ECIPP_ALIGNMENT_UWORD 65535 Compu_IDENTITY 0 65535 PHYS_UNIT "Enable bits" /end CHARACTERISTIC
/begin CHARACTERISTIC FPsw_ext1_accel_z_min "FPrm_switches_ext1(537)" VALUE 0x00147270 /* @ECU_Address@FPrm_switches_ext1@0x023A5432@ */ ECIPP_ALIGNMENT_UWORD 65535 Compu_IDENTITY 0 65535 PHYS_UNIT "Enable bits" /end CHARACTERISTIC
/begin CHARACTERISTIC FPsw_ext1_ADIG1_max "FPrm_switches_ext1(165)" VALUE 0x00146F88 /* @ECU_Address@FPrm_switches_ext1@0x023A514A@ */ ECIPP_ALIGNMENT_UWORD 65535 Compu_IDENTITY 0 65535 PHYS_UNIT "Enable bits" /end CHARACTERISTIC
/begin CHARACTERISTIC FPsw_ext1_ADIG1_min "FPrm_switches_ext1(166)" VALUE 0x00146F8A /* @ECU_Address@FPrm_switches_ext1@0x023A514C@ */ ECIPP_ALIGNMENT_UWORD 65535 Compu_IDENTITY 0 65535 PHYS_UNIT "Enable bits" /end CHARACTERISTIC
/begin CHARACTERISTIC FPsw_ext1_ADIG10_max "FPrm_switches_ext1(258)" VALUE 0x00147042 /* @ECU_Address@FPrm_switches_ext1@0x023A5204@ */ ECIPP_ALIGNMENT_UWORD 65535 Compu_IDENTITY 0 65535 PHYS_UNIT "Enable bits" /end CHARACTERISTIC
/begin CHARACTERISTIC FPsw_ext1_ADIG10_min "FPrm_switches_ext1(259)" VALUE 0x00147044 /* @ECU_Address@FPrm_switches_ext1@0x023A5206@ */ ECIPP_ALIGNMENT_UWORD 65535 Compu_IDENTITY 0 65535 PHYS_UNIT "Enable bits" /end CHARACTERISTIC
/begin CHARACTERISTIC FPsw_ext1_ADIG11_max "FPrm_switches_ext1(263)" VALUE 0x0014704C /* @ECU_Address@FPrm_switches_ext1@0x023A520E@ */ ECIPP_ALIGNMENT_UWORD 65535 Compu_IDENTITY 0 65535 PHYS_UNIT "Enable bits" /end CHARACTERISTIC
/begin CHARACTERISTIC FPsw_ext1_ADIG11_min "FPrm_switches_ext1(264)" VALUE 0x0014704E /* @ECU_Address@FPrm_switches_ext1@0x023A5210@ */ ECIPP_ALIGNMENT_UWORD 65535 Compu_IDENTITY 0 65535 PHYS_UNIT "Enable bits" /end CHARACTERISTIC
/begin CHARACTERISTIC FPsw_ext1_ADIG12_max "FPrm_switches_ext1(265)" VALUE 0x00147050 /* @ECU_Address@FPrm_switches_ext1@0x023A5212@ */ ECIPP_ALIGNMENT_UWORD 65535 Compu_IDENTITY 0 65535 PHYS_UNIT "Enable bits" /end CHARACTERISTIC
/begin CHARACTERISTIC FPsw_ext1_ADIG12_min "FPrm_switches_ext1(266)" VALUE 0x00147052 /* @ECU_Address@FPrm_switches_ext1@0x023A5214@ */ ECIPP_ALIGNMENT_UWORD 65535 Compu_IDENTITY 0 65535 PHYS_UNIT "Enable bits" /end CHARACTERISTIC
/begin CHARACTERISTIC FPsw_ext1_ADIG13_max "FPrm_switches_ext1(302)" VALUE 0x0014709A /* @ECU_Address@FPrm_switches_ext1@0x023A525C@ */ ECIPP_ALIGNMENT_UWORD 65535 Compu_IDENTITY 0 65535 PHYS_UNIT "Enable bits" /end CHARACTERISTIC
/begin CHARACTERISTIC FPsw_ext1_ADIG13_min "FPrm_switches_ext1(303)" VALUE 0x0014709C /* @ECU_Address@FPrm_switches_ext1@0x023A525E@ */ ECIPP_ALIGNMENT_UWORD 65535 Compu_IDENTITY 0 65535 PHYS_UNIT "Enable bits" /end CHARACTERISTIC
/begin CHARACTERISTIC FPsw_ext1_ADIG14_max "FPrm_switches_ext1(304)" VALUE 0x0014709E /* @ECU_Address@FPrm_switches_ext1@0x023A5260@ */ ECIPP_ALIGNMENT_UWORD 65535 Compu_IDENTITY 0 65535 PHYS_UNIT "Enable bits" /end CHARACTERISTIC
/begin CHARACTERISTIC FPsw_ext1_ADIG14_min "FPrm_switches_ext1(305)" VALUE 0x001470A0 /* @ECU_Address@FPrm_switches_ext1@0x023A5262@ */ ECIPP_ALIGNMENT_UWORD 65535 Compu_IDENTITY 0 65535 PHYS_UNIT "Enable bits" /end CHARACTERISTIC
/begin CHARACTERISTIC FPsw_ext1_ADIG15_max "FPrm_switches_ext1(306)" VALUE 0x001470A2 /* @ECU_Address@FPrm_switches_ext1@0x023A5264@ */ ECIPP_ALIGNMENT_UWORD 65535 Compu_IDENTITY 0 65535 PHYS_UNIT "Enable bits" /end CHARACTERISTIC
/begin CHARACTERISTIC FCdtc_accel_x_max "FCtl_DTC(702)" VALUE 0x00163A90 /* @ECU_Address@FCtl_DTC@0x021B557C@ */ ECIPP_ALIGNMENT_UWORD 65535 Compu_IDENTITY 0 65535 PHYS_UNIT "DTC" /end CHARACTERISTIC
/begin CHARACTERISTIC FCdtc_accel_x_min "FCtl_DTC(703)" VALUE 0x00163A92 /* @ECU_Address@FCtl_DTC@0x021B557E@ */ ECIPP_ALIGNMENT_UWORD 65535 Compu_IDENTITY 0 65535 PHYS_UNIT "DTC" /end CHARACTERISTIC
/begin CHARACTERISTIC FCdtc_accel_y_max "FCtl_DTC(704)" VALUE 0x00163A94 /* @ECU_Address@FCtl_DTC@0x021B5580@ */ ECIPP_ALIGNMENT_UWORD 65535 Compu_IDENTITY 0 65535 PHYS_UNIT "DTC" /end CHARACTERISTIC
/begin CHARACTERISTIC FCdtc_accel_y_min "FCtl_DTC(705)" VALUE 0x00163A96 /* @ECU_Address@FCtl_DTC@0x021B5582@ */ ECIPP_ALIGNMENT_UWORD 65535 Compu_IDENTITY 0 65535 PHYS_UNIT "DTC" /end CHARACTERISTIC
/begin CHARACTERISTIC FCdtc_accel_z_max "FCtl_DTC(706)" VALUE 0x00163A98 /* @ECU_Address@FCtl_DTC@0x021B5584@ */ ECIPP_ALIGNMENT_UWORD 65535 Compu_IDENTITY 0 65535 PHYS_UNIT "DTC" /end CHARACTERISTIC
/begin CHARACTERISTIC FCdtc_accel_z_min "FCtl_DTC(707)" VALUE 0x00163A9A /* @ECU_Address@FCtl_DTC@0x021B5586@ */ ECIPP_ALIGNMENT_UWORD 65535 Compu_IDENTITY 0 65535 PHYS_UNIT "DTC" /end CHARACTERISTIC
/begin CHARACTERISTIC FCdtc_ADIG1_max "FCtl_DTC(209)" VALUE 0x001636B6 /* @ECU_Address@FCtl_DTC@0x021B51A2@ */ ECIPP_ALIGNMENT_UWORD 65535 Compu_IDENTITY 0 65535 PHYS_UNIT "DTC" /end CHARACTERISTIC
/begin CHARACTERISTIC FCdtc_ADIG1_min "FCtl_DTC(210)" VALUE 0x001636B8 /* @ECU_Address@FCtl_DTC@0x021B51A4@ */ ECIPP_ALIGNMENT_UWORD 65535 Compu_IDENTITY 0 65535 PHYS_UNIT "DTC" /end CHARACTERISTIC
/begin CHARACTERISTIC FCdtc_ADIG10_max "FCtl_DTC(349)" VALUE 0x001637CE /* @ECU_Address@FCtl_DTC@0x021B52BA@ */ ECIPP_ALIGNMENT_UWORD 65535 Compu_IDENTITY 0 65535 PHYS_UNIT "DTC" /end CHARACTERISTIC
/begin CHARACTERISTIC FCdtc_ADIG10_min "FCtl_DTC(350)" VALUE 0x001637D0 /* @ECU_Address@FCtl_DTC@0x021B52BC@ */ ECIPP_ALIGNMENT_UWORD 65535 Compu_IDENTITY 0 65535 PHYS_UNIT "DTC" /end CHARACTERISTIC
/begin CHARACTERISTIC FCdtc_ADIG11_max "FCtl_DTC(354)" VALUE 0x001637D8 /* @ECU_Address@FCtl_DTC@0x021B52C4@ */ ECIPP_ALIGNMENT_UWORD 65535 Compu_IDENTITY 0 65535 PHYS_UNIT "DTC" /end CHARACTERISTIC
/begin CHARACTERISTIC FCdtc_ADIG11_min "FCtl_DTC(355)" VALUE 0x001637DA /* @ECU_Address@FCtl_DTC@0x021B52C6@ */ ECIPP_ALIGNMENT_UWORD 65535 Compu_IDENTITY 0 65535 PHYS_UNIT "DTC" /end CHARACTERISTIC
/begin CHARACTERISTIC FCdtc_ADIG12_max "FCtl_DTC(356)" VALUE 0x001637DC /* @ECU_Address@FCtl_DTC@0x021B52C8@ */ ECIPP_ALIGNMENT_UWORD 65535 Compu_IDENTITY 0 65535 PHYS_UNIT "DTC" /end CHARACTERISTIC
/begin CHARACTERISTIC FCdtc_ADIG12_min "FCtl_DTC(357)" VALUE 0x001637DE /* @ECU_Address@FCtl_DTC@0x021B52CA@ */ ECIPP_ALIGNMENT_UWORD 65535 Compu_IDENTITY 0 65535 PHYS_UNIT "DTC" /end CHARACTERISTIC
/begin CHARACTERISTIC FCdtc_ADIG13_max "FCtl_DTC(393)" VALUE 0x00163826 /* @ECU_Address@FCtl_DTC@0x021B5312@ */ ECIPP_ALIGNMENT_UWORD 65535 Compu_IDENTITY 0 65535 PHYS_UNIT "DTC" /end CHARACTERISTIC
/begin CHARACTERISTIC FCdtc_ADIG13_min "FCtl_DTC(394)" VALUE 0x00163828 /* @ECU_Address@FCtl_DTC@0x021B5314@ */ ECIPP_ALIGNMENT_UWORD 65535 Compu_IDENTITY 0 65535 PHYS_UNIT "DTC" /end CHARACTERISTIC
/begin CHARACTERISTIC FCdtc_ADIG14_max "FCtl_DTC(395)" VALUE 0x0016382A /* @ECU_Address@FCtl_DTC@0x021B5316@ */ ECIPP_ALIGNMENT_UWORD 65535 Compu_IDENTITY 0 65535 PHYS_UNIT "DTC" /end CHARACTERISTIC
/begin CHARACTERISTIC FCdtc_ADIG14_min "FCtl_DTC(396)" VALUE 0x0016382C /* @ECU_Address@FCtl_DTC@0x021B5318@ */ ECIPP_ALIGNMENT_UWORD 65535 Compu_IDENTITY 0 65535 PHYS_UNIT "DTC" /end CHARACTERISTIC
/begin CHARACTERISTIC FCdtc_ADIG15_max "FCtl_DTC(397)" VALUE 0x0016382E /* @ECU_Address@FCtl_DTC@0x021B531A@ */ ECIPP_ALIGNMENT_UWORD 65535 Compu_IDENTITY 0 65535 PHYS_UNIT "DTC" /end CHARACTERISTIC
/begin CHARACTERISTIC FCfmi_accel_x_max "FCtl_FMI(702)" VALUE 0x001653D1 /* @ECU_Address@FCtl_FMI@0x021B72BE@ */ ECIPP_ALIGNMENT_UBYTE 255 Compu_IDENTITY 0 255 PHYS_UNIT "FMI" /end CHARACTERISTIC
/begin CHARACTERISTIC FCfmi_accel_x_min "FCtl_FMI(703)" VALUE 0x001653D2 /* @ECU_Address@FCtl_FMI@0x021B72BF@ */ ECIPP_ALIGNMENT_UBYTE 255 Compu_IDENTITY 0 255 PHYS_UNIT "FMI" /end CHARACTERISTIC
/begin CHARACTERISTIC FCfmi_accel_y_max "FCtl_FMI(704)" VALUE 0x001653D3 /* @ECU_Address@FCtl_FMI@0x021B72C0@ */ ECIPP_ALIGNMENT_UBYTE 255 Compu_IDENTITY 0 255 PHYS_UNIT "FMI" /end CHARACTERISTIC
/begin CHARACTERISTIC FCfmi_accel_y_min "FCtl_FMI(705)" VALUE 0x001653D4 /* @ECU_Address@FCtl_FMI@0x021B72C1@ */ ECIPP_ALIGNMENT_UBYTE 255 Compu_IDENTITY 0 255 PHYS_UNIT "FMI" /end CHARACTERISTIC
/begin CHARACTERISTIC FCfmi_accel_z_max "FCtl_FMI(706)" VALUE 0x001653D5 /* @ECU_Address@FCtl_FMI@0x021B72C2@ */ ECIPP_ALIGNMENT_UBYTE 255 Compu_IDENTITY 0 255 PHYS_UNIT "FMI" /end CHARACTERISTIC
/begin CHARACTERISTIC FCfmi_accel_z_min "FCtl_FMI(707)" VALUE 0x001653D6 /* @ECU_Address@FCtl_FMI@0x021B72C3@ */ ECIPP_ALIGNMENT_UBYTE 255 Compu_IDENTITY 0 255 PHYS_UNIT "FMI" /end CHARACTERISTIC
/begin CHARACTERISTIC FCfmi_ADIG1_max "FCtl_FMI(209)" VALUE 0x001651E4 /* @ECU_Address@FCtl_FMI@0x021B70D1@ */ ECIPP_ALIGNMENT_UBYTE 255 Compu_IDENTITY 0 255 PHYS_UNIT "FMI" /end CHARACTERISTIC
/begin CHARACTERISTIC FCfmi_ADIG1_min "FCtl_FMI(210)" VALUE 0x001651E5 /* @ECU_Address@FCtl_FMI@0x021B70D2@ */ ECIPP_ALIGNMENT_UBYTE 255 Compu_IDENTITY 0 255 PHYS_UNIT "FMI" /end CHARACTERISTIC
/begin CHARACTERISTIC FCfmi_ADIG10_max "FCtl_FMI(349)" VALUE 0x00165270 /* @ECU_Address@FCtl_FMI@0x021B715D@ */ ECIPP_ALIGNMENT_UBYTE 255 Compu_IDENTITY 0 255 PHYS_UNIT "FMI" /end CHARACTERISTIC
/begin CHARACTERISTIC FCfmi_ADIG10_min "FCtl_FMI(350)" VALUE 0x00165271 /* @ECU_Address@FCtl_FMI@0x021B715E@ */ ECIPP_ALIGNMENT_UBYTE 255 Compu_IDENTITY 0 255 PHYS_UNIT "FMI" /end CHARACTERISTIC
/begin CHARACTERISTIC FCfmi_ADIG11_max "FCtl_FMI(354)" VALUE 0x00165275 /* @ECU_Address@FCtl_FMI@0x021B7162@ */ ECIPP_ALIGNMENT_UBYTE 255 Compu_IDENTITY 0 255 PHYS_UNIT "FMI" /end CHARACTERISTIC
/begin CHARACTERISTIC FCfmi_ADIG11_min "FCtl_FMI(355)" VALUE 0x00165276 /* @ECU_Address@FCtl_FMI@0x021B7163@ */ ECIPP_ALIGNMENT_UBYTE 255 Compu_IDENTITY 0 255 PHYS_UNIT "FMI" /end CHARACTERISTIC
/begin CHARACTERISTIC FCfmi_ADIG12_max "FCtl_FMI(356)" VALUE 0x00165277 /* @ECU_Address@FCtl_FMI@0x021B7164@ */ ECIPP_ALIGNMENT_UBYTE 255 Compu_IDENTITY 0 255 PHYS_UNIT "FMI" /end CHARACTERISTIC
/begin CHARACTERISTIC FCfmi_ADIG12_min "FCtl_FMI(357)" VALUE 0x00165278 /* @ECU_Address@FCtl_FMI@0x021B7165@ */ ECIPP_ALIGNMENT_UBYTE 255 Compu_IDENTITY 0 255 PHYS_UNIT "FMI" /end CHARACTERISTIC
/begin CHARACTERISTIC FCfmi_ADIG13_max "FCtl_FMI(393)" VALUE 0x0016529C /* @ECU_Address@FCtl_FMI@0x021B7189@ */ ECIPP_ALIGNMENT_UBYTE 255 Compu_IDENTITY 0 255 PHYS_UNIT "FMI" /end CHARACTERISTIC
/begin CHARACTERISTIC FCfmi_ADIG13_min "FCtl_FMI(394)" VALUE 0x0016529D /* @ECU_Address@FCtl_FMI@0x021B718A@ */ ECIPP_ALIGNMENT_UBYTE 255 Compu_IDENTITY 0 255 PHYS_UNIT "FMI" /end CHARACTERISTIC
/begin CHARACTERISTIC FCfmi_ADIG14_max "FCtl_FMI(395)" VALUE 0x0016529E /* @ECU_Address@FCtl_FMI@0x021B718B@ */ ECIPP_ALIGNMENT_UBYTE 255 Compu_IDENTITY 0 255 PHYS_UNIT "FMI" /end CHARACTERISTIC
/begin CHARACTERISTIC FCfmi_ADIG14_min "FCtl_FMI(396)" VALUE 0x0016529F /* @ECU_Address@FCtl_FMI@0x021B718C@ */ ECIPP_ALIGNMENT_UBYTE 255 Compu_IDENTITY 0 255 PHYS_UNIT "FMI" /end CHARACTERISTIC
/begin CHARACTERISTIC FCfmi_ADIG15_max "FCtl_FMI(397)" VALUE 0x001652A0 /* @ECU_Address@FCtl_FMI@0x021B718D@ */ ECIPP_ALIGNMENT_UBYTE 255 Compu_IDENTITY 0 255 PHYS_UNIT "FMI" /end CHARACTERISTIC
/begin CHARACTERISTIC FCftb_accel_x_max "FCtl_FTB_0x04(702)" VALUE 0x0016572F /* @ECU_Address@FCtl_FTB_0x04@0x024C52BE@ */ ECIPP_ALIGNMENT_UBYTE 255 Compu_IDENTITY 0 255 PHYS_UNIT "FTB" /end CHARACTERISTIC
/begin CHARACTERISTIC FCftb_accel_x_min "FCtl_FTB_0x04(703)" VALUE 0x00165730 /* @ECU_Address@FCtl_FTB_0x04@0x024C52BF@ */ ECIPP_ALIGNMENT_UBYTE 255 Compu_IDENTITY 0 255 PHYS_UNIT "FTB" /end CHARACTERISTIC
/begin CHARACTERISTIC FCftb_accel_y_max "FCtl_FTB_0x04(704)" VALUE 0x00165731 /* @ECU_Address@FCtl_FTB_0x04@0x024C52C0@ */ ECIPP_ALIGNMENT_UBYTE 255 Compu_IDENTITY 0 255 PHYS_UNIT "FTB" /end CHARACTERISTIC
/begin CHARACTERISTIC FCftb_accel_y_min "FCtl_FTB_0x04(705)" VALUE 0x00165732 /* @ECU_Address@FCtl_FTB_0x04@0x024C52C1@ */ ECIPP_ALIGNMENT_UBYTE 255 Compu_IDENTITY 0 255 PHYS_UNIT "FTB" /end CHARACTERISTIC
/begin CHARACTERISTIC FCftb_accel_z_max "FCtl_FTB_0x04(706)" VALUE 0x00165733 /* @ECU_Address@FCtl_FTB_0x04@0x024C52C2@ */ ECIPP_ALIGNMENT_UBYTE 255 Compu_IDENTITY 0 255 PHYS_UNIT "FTB" /end CHARACTERISTIC
/begin CHARACTERISTIC FCftb_accel_z_min "FCtl_FTB_0x04(707)" VALUE 0x00165734 /* @ECU_Address@FCtl_FTB_0x04@0x024C52C3@ */ ECIPP_ALIGNMENT_UBYTE 255 Compu_IDENTITY 0 255 PHYS_UNIT "FTB" /end CHARACTERISTIC
/begin CHARACTERISTIC FCftb_ADIG1_max "FCtl_FTB_0x04(209)" VALUE 0x00165542 /* @ECU_Address@FCtl_FTB_0x04@0x024C50D1@ */ ECIPP_ALIGNMENT_UBYTE 255 Compu_IDENTITY 0 255 PHYS_UNIT "FTB" /end CHARACTERISTIC
/begin CHARACTERISTIC FCftb_ADIG1_min "FCtl_FTB_0x04(210)" VALUE 0x00165543 /* @ECU_Address@FCtl_FTB_0x04@0x024C50D2@ */ ECIPP_ALIGNMENT_UBYTE 255 Compu_IDENTITY 0 255 PHYS_UNIT "FTB" /end CHARACTERISTIC
/begin CHARACTERISTIC FCftb_ADIG10_max "FCtl_FTB_0x04(349)" VALUE 0x001655CE /* @ECU_Address@FCtl_FTB_0x04@0x024C515D@ */ ECIPP_ALIGNMENT_UBYTE 255 Compu_IDENTITY 0 255 PHYS_UNIT "FTB" /end CHARACTERISTIC
/begin CHARACTERISTIC FCftb_ADIG10_min "FCtl_FTB_0x04(350)" VALUE 0x001655CF /* @ECU_Address@FCtl_FTB_0x04@0x024C515E@ */ ECIPP_ALIGNMENT_UBYTE 255 Compu_IDENTITY 0 255 PHYS_UNIT "FTB" /end CHARACTERISTIC
/begin CHARACTERISTIC FCftb_ADIG11_max "FCtl_FTB_0x04(354)" VALUE 0x001655D3 /* @ECU_Address@FCtl_FTB_0x04@0x024C5162@ */ ECIPP_ALIGNMENT_UBYTE 255 Compu_IDENTITY 0 255 PHYS_UNIT "FTB" /end CHARACTERISTIC
/begin CHARACTERISTIC FCftb_ADIG11_min "FCtl_FTB_0x04(355)" VALUE 0x001655D4 /* @ECU_Address@FCtl_FTB_0x04@0x024C5163@ */ ECIPP_ALIGNMENT_UBYTE 255 Compu_IDENTITY 0 255 PHYS_UNIT "FTB" /end CHARACTERISTIC
/begin CHARACTERISTIC FCftb_ADIG12_max "FCtl_FTB_0x04(356)" VALUE 0x001655D5 /* @ECU_Address@FCtl_FTB_0x04@0x024C5164@ */ ECIPP_ALIGNMENT_UBYTE 255 Compu_IDENTITY 0 255 PHYS_UNIT "FTB" /end CHARACTERISTIC
/begin CHARACTERISTIC FCftb_ADIG12_min "FCtl_FTB_0x04(357)" VALUE 0x001655D6 /* @ECU_Address@FCtl_FTB_0x04@0x024C5165@ */ ECIPP_ALIGNMENT_UBYTE 255 Compu_IDENTITY 0 255 PHYS_UNIT "FTB" /end CHARACTERISTIC
/begin CHARACTERISTIC FCftb_ADIG13_max "FCtl_FTB_0x04(393)" VALUE 0x001655FA /* @ECU_Address@FCtl_FTB_0x04@0x024C5189@ */ ECIPP_ALIGNMENT_UBYTE 255 Compu_IDENTITY 0 255 PHYS_UNIT "FTB" /end CHARACTERISTIC
/begin CHARACTERISTIC FCftb_ADIG13_min "FCtl_FTB_0x04(394)" VALUE 0x001655FB /* @ECU_Address@FCtl_FTB_0x04@0x024C518A@ */ ECIPP_ALIGNMENT_UBYTE 255 Compu_IDENTITY 0 255 PHYS_UNIT "FTB" /end CHARACTERISTIC
/begin CHARACTERISTIC FCftb_ADIG14_max "FCtl_FTB_0x04(395)" VALUE 0x001655FC /* @ECU_Address@FCtl_FTB_0x04@0x024C518B@ */ ECIPP_ALIGNMENT_UBYTE 255 Compu_IDENTITY 0 255 PHYS_UNIT "FTB" /end CHARACTERISTIC
/begin CHARACTERISTIC FCftb_ADIG14_min "FCtl_FTB_0x04(396)" VALUE 0x001655FD /* @ECU_Address@FCtl_FTB_0x04@0x024C518C@ */ ECIPP_ALIGNMENT_UBYTE 255 Compu_IDENTITY 0 255 PHYS_UNIT "FTB" /end CHARACTERISTIC
/begin CHARACTERISTIC FCftb_ADIG15_max "FCtl_FTB_0x04(397)" VALUE 0x001655FE /* @ECU_Address@FCtl_FTB_0x04@0x024C518D@ */ ECIPP_ALIGNMENT_UBYTE 255 Compu_IDENTITY 0 255 PHYS_UNIT "FTB" /end CHARACTERISTIC
/begin CHARACTERISTIC FCspn_accel_x_max "FCtl_SPN(702)" VALUE 0x001627D4 /* @ECU_Address@FCtl_SPN@0x021B6AF8@ */ ECIPP_ALIGNMENT_ULONG 4294967295 Compu_IDENTITY 0 4294967295 PHYS_UNIT "SPN" /end CHARACTERISTIC
/begin CHARACTERISTIC FCspn_accel_x_min "FCtl_SPN(703)" VALUE 0x001627D8 /* @ECU_Address@FCtl_SPN@0x021B6AFC@ */ ECIPP_ALIGNMENT_ULONG 4294967295 Compu_IDENTITY 0 4294967295 PHYS_UNIT "SPN" /end CHARACTERISTIC
/begin CHARACTERISTIC FCspn_accel_y_max "FCtl_SPN(704)" VALUE 0x001627DC /* @ECU_Address@FCtl_SPN@0x021B6B00@ */ ECIPP_ALIGNMENT_ULONG 4294967295 Compu_IDENTITY 0 4294967295 PHYS_UNIT "SPN" /end CHARACTERISTIC
/begin CHARACTERISTIC FCspn_accel_y_min "FCtl_SPN(705)" VALUE 0x001627E0 /* @ECU_Address@FCtl_SPN@0x021B6B04@ */ ECIPP_ALIGNMENT_ULONG 4294967295 Compu_IDENTITY 0 4294967295 PHYS_UNIT "SPN" /end CHARACTERISTIC
/begin CHARACTERISTIC FCspn_accel_z_max "FCtl_SPN(706)" VALUE 0x001627E4 /* @ECU_Address@FCtl_SPN@0x021B6B08@ */ ECIPP_ALIGNMENT_ULONG 4294967295 Compu_IDENTITY 0 4294967295 PHYS_UNIT "SPN" /end CHARACTERISTIC
/begin CHARACTERISTIC FCspn_accel_z_min "FCtl_SPN(707)" VALUE 0x001627E8 /* @ECU_Address@FCtl_SPN@0x021B6B0C@ */ ECIPP_ALIGNMENT_ULONG 4294967295 Compu_IDENTITY 0 4294967295 PHYS_UNIT "SPN" /end CHARACTERISTIC
/begin CHARACTERISTIC FCspn_ADIG1_max "FCtl_SPN(209)" VALUE 0x00162020 /* @ECU_Address@FCtl_SPN@0x021B6344@ */ ECIPP_ALIGNMENT_ULONG 4294967295 Compu_IDENTITY 0 4294967295 PHYS_UNIT "SPN" /end CHARACTERISTIC
/begin CHARACTERISTIC FCspn_ADIG1_min "FCtl_SPN(210)" VALUE 0x00162024 /* @ECU_Address@FCtl_SPN@0x021B6348@ */ ECIPP_ALIGNMENT_ULONG 4294967295 Compu_IDENTITY 0 4294967295 PHYS_UNIT "SPN" /end CHARACTERISTIC
/begin CHARACTERISTIC FCspn_ADIG10_max "FCtl_SPN(349)" VALUE 0x00162250 /* @ECU_Address@FCtl_SPN@0x021B6574@ */ ECIPP_ALIGNMENT_ULONG 4294967295 Compu_IDENTITY 0 4294967295 PHYS_UNIT "SPN" /end CHARACTERISTIC
/begin CHARACTERISTIC FCspn_ADIG10_min "FCtl_SPN(350)" VALUE 0x00162254 /* @ECU_Address@FCtl_SPN@0x021B6578@ */ ECIPP_ALIGNMENT_ULONG 4294967295 Compu_IDENTITY 0 4294967295 PHYS_UNIT "SPN" /end CHARACTERISTIC
/begin CHARACTERISTIC FCspn_ADIG11_max "FCtl_SPN(354)" VALUE 0x00162264 /* @ECU_Address@FCtl_SPN@0x021B6588@ */ ECIPP_ALIGNMENT_ULONG 4294967295 Compu_IDENTITY 0 4294967295 PHYS_UNIT "SPN" /end CHARACTERISTIC
/begin CHARACTERISTIC FCspn_ADIG11_min "FCtl_SPN(355)" VALUE 0x00162268 /* @ECU_Address@FCtl_SPN@0x021B658C@ */ ECIPP_ALIGNMENT_ULONG 4294967295 Compu_IDENTITY 0 4294967295 PHYS_UNIT "SPN" /end CHARACTERISTIC
/begin CHARACTERISTIC FCspn_ADIG12_max "FCtl_SPN(356)" VALUE 0x0016226C /* @ECU_Address@FCtl_SPN@0x021B6590@ */ ECIPP_ALIGNMENT_ULONG 4294967295 Compu_IDENTITY 0 4294967295 PHYS_UNIT "SPN" /end CHARACTERISTIC
/begin CHARACTERISTIC FCspn_ADIG12_min "FCtl_SPN(357)" VALUE 0x00162270 /* @ECU_Address@FCtl_SPN@0x021B6594@ */ ECIPP_ALIGNMENT_ULONG 4294967295 Compu_IDENTITY 0 4294967295 PHYS_UNIT "SPN" /end CHARACTERISTIC
/begin CHARACTERISTIC FCspn_ADIG13_max "FCtl_SPN(393)" VALUE 0x00162300 /* @ECU_Address@FCtl_SPN@0x021B6624@ */ ECIPP_ALIGNMENT_ULONG 4294967295 Compu_IDENTITY 0 4294967295 PHYS_UNIT "SPN" /end CHARACTERISTIC
/begin CHARACTERISTIC FCspn_ADIG13_min "FCtl_SPN(394)" VALUE 0x00162304 /* @ECU_Address@FCtl_SPN@0x021B6628@ */ ECIPP_ALIGNMENT_ULONG 4294967295 Compu_IDENTITY 0 4294967295 PHYS_UNIT "SPN" /end CHARACTERISTIC
/begin CHARACTERISTIC FCspn_ADIG14_max "FCtl_SPN(395)" VALUE 0x00162308 /* @ECU_Address@FCtl_SPN@0x021B662C@ */ ECIPP_ALIGNMENT_ULONG 4294967295 Compu_IDENTITY 0 4294967295 PHYS_UNIT "SPN" /end CHARACTERISTIC
/begin CHARACTERISTIC FCspn_ADIG14_min "FCtl_SPN(396)" VALUE 0x0016230C /* @ECU_Address@FCtl_SPN@0x021B6630@ */ ECIPP_ALIGNMENT_ULONG 4294967295 Compu_IDENTITY 0 4294967295 PHYS_UNIT "SPN" /end CHARACTERISTIC
/begin CHARACTERISTIC FCspn_ADIG15_max "FCtl_SPN(397)" VALUE 0x00162310 /* @ECU_Address@FCtl_SPN@0x021B6634@ */ ECIPP_ALIGNMENT_ULONG 4294967295 Compu_IDENTITY 0 4294967295 PHYS_UNIT "SPN" /end CHARACTERISTIC
/begin CHARACTERISTIC FPfl_accel_x_max "FPrm_latch(532)" VALUE 0x00160868 /* @ECU_Address@FPrm_latch@0x021BB850@ */ ECIPP_ALIGNMENT_FLOAT32_IEEE 10000000000 Compu_IDENTITY -10000000000 10000000000 PHYS_UNIT "ms" /end CHARACTERISTIC
/begin CHARACTERISTIC FPfl_accel_x_min "FPrm_latch(533)" VALUE 0x0016086C /* @ECU_Address@FPrm_latch@0x021BB854@ */ ECIPP_ALIGNMENT_FLOAT32_IEEE 10000000000 Compu_IDENTITY -10000000000 10000000000 PHYS_UNIT "ms" /end CHARACTERISTIC
/begin CHARACTERISTIC FPfl_accel_y_max "FPrm_latch(534)" VALUE 0x00160870 /* @ECU_Address@FPrm_latch@0x021BB858@ */ ECIPP_ALIGNMENT_FLOAT32_IEEE 10000000000 Compu_IDENTITY -10000000000 10000000000 PHYS_UNIT "ms" /end CHARACTERISTIC
/begin CHARACTERISTIC FPfl_accel_y_min "FPrm_latch(535)" VALUE 0x00160874 /* @ECU_Address@FPrm_latch@0x021BB85C@ */ ECIPP_ALIGNMENT_FLOAT32_IEEE 10000000000 Compu_IDENTITY -10000000000 10000000000 PHYS_UNIT "ms" /end CHARACTERISTIC
/begin CHARACTERISTIC FPfl_accel_z_max "FPrm_latch(536)" VALUE 0x00160878 /* @ECU_Address@FPrm_latch@0x021BB860@ */ ECIPP_ALIGNMENT_FLOAT32_IEEE 10000000000 Compu_IDENTITY -10000000000 10000000000 PHYS_UNIT "ms" /end CHARACTERISTIC
/begin CHARACTERISTIC FPfl_accel_z_min "FPrm_latch(537)" VALUE 0x0016087C /* @ECU_Address@FPrm_latch@0x021BB864@ */ ECIPP_ALIGNMENT_FLOAT32_IEEE 10000000000 Compu_IDENTITY -10000000000 10000000000 PHYS_UNIT "ms" /end CHARACTERISTIC
/begin CHARACTERISTIC FPfl_ADIG1_max "FPrm_latch(165)" VALUE 0x001602AC /* @ECU_Address@FPrm_latch@0x021BB294@ */ ECIPP_ALIGNMENT_FLOAT32_IEEE 10000000000 Compu_IDENTITY -10000000000 10000000000 PHYS_UNIT "ms" /end CHARACTERISTIC
/begin CHARACTERISTIC FPfl_ADIG1_min "FPrm_latch(166)" VALUE 0x001602B0 /* @ECU_Address@FPrm_latch@0x021BB298@ */ ECIPP_ALIGNMENT_FLOAT32_IEEE 10000000000 Compu_IDENTITY -10000000000 10000000000 PHYS_UNIT "ms" /end CHARACTERISTIC
/begin CHARACTERISTIC FPfl_ADIG10_max "FPrm_latch(258)" VALUE 0x00160420 /* @ECU_Address@FPrm_latch@0x021BB408@ */ ECIPP_ALIGNMENT_FLOAT32_IEEE 10000000000 Compu_IDENTITY -10000000000 10000000000 PHYS_UNIT "ms" /end CHARACTERISTIC
/begin CHARACTERISTIC FPfl_ADIG10_min "FPrm_latch(259)" VALUE 0x00160424 /* @ECU_Address@FPrm_latch@0x021BB40C@ */ ECIPP_ALIGNMENT_FLOAT32_IEEE 10000000000 Compu_IDENTITY -10000000000 10000000000 PHYS_UNIT "ms" /end CHARACTERISTIC
/begin CHARACTERISTIC FPfl_ADIG11_max "FPrm_latch(263)" VALUE 0x00160434 /* @ECU_Address@FPrm_latch@0x021BB41C@ */ ECIPP_ALIGNMENT_FLOAT32_IEEE 10000000000 Compu_IDENTITY -10000000000 10000000000 PHYS_UNIT "ms" /end CHARACTERISTIC
/begin CHARACTERISTIC FPfl_ADIG11_min "FPrm_latch(264)" VALUE 0x00160438 /* @ECU_Address@FPrm_latch@0x021BB420@ */ ECIPP_ALIGNMENT_FLOAT32_IEEE 10000000000 Compu_IDENTITY -10000000000 10000000000 PHYS_UNIT "ms" /end CHARACTERISTIC
/begin CHARACTERISTIC FPfl_ADIG12_max "FPrm_latch(265)" VALUE 0x0016043C /* @ECU_Address@FPrm_latch@0x021BB424@ */ ECIPP_ALIGNMENT_FLOAT32_IEEE 10000000000 Compu_IDENTITY -10000000000 10000000000 PHYS_UNIT "ms" /end CHARACTERISTIC
/begin CHARACTERISTIC FPfl_ADIG12_min "FPrm_latch(266)" VALUE 0x00160440 /* @ECU_Address@FPrm_latch@0x021BB428@ */ ECIPP_ALIGNMENT_FLOAT32_IEEE 10000000000 Compu_IDENTITY -10000000000 10000000000 PHYS_UNIT "ms" /end CHARACTERISTIC
/begin CHARACTERISTIC FPfl_ADIG13_max "FPrm_latch(302)" VALUE 0x001604D0 /* @ECU_Address@FPrm_latch@0x021BB4B8@ */ ECIPP_ALIGNMENT_FLOAT32_IEEE 10000000000 Compu_IDENTITY -10000000000 10000000000 PHYS_UNIT "ms" /end CHARACTERISTIC
/begin CHARACTERISTIC FPfl_ADIG13_min "FPrm_latch(303)" VALUE 0x001604D4 /* @ECU_Address@FPrm_latch@0x021BB4BC@ */ ECIPP_ALIGNMENT_FLOAT32_IEEE 10000000000 Compu_IDENTITY -10000000000 10000000000 PHYS_UNIT "ms" /end CHARACTERISTIC
/begin CHARACTERISTIC FPfl_ADIG14_max "FPrm_latch(304)" VALUE 0x001604D8 /* @ECU_Address@FPrm_latch@0x021BB4C0@ */ ECIPP_ALIGNMENT_FLOAT32_IEEE 10000000000 Compu_IDENTITY -10000000000 10000000000 PHYS_UNIT "ms" /end CHARACTERISTIC
/begin CHARACTERISTIC FPfl_ADIG14_min "FPrm_latch(305)" VALUE 0x001604DC /* @ECU_Address@FPrm_latch@0x021BB4C4@ */ ECIPP_ALIGNMENT_FLOAT32_IEEE 10000000000 Compu_IDENTITY -10000000000 10000000000 PHYS_UNIT "ms" /end CHARACTERISTIC
/begin CHARACTERISTIC FPfl_ADIG15_max "FPrm_latch(306)" VALUE 0x001604E0 /* @ECU_Address@FPrm_latch@0x021BB4C8@ */ ECIPP_ALIGNMENT_FLOAT32_IEEE 10000000000 Compu_IDENTITY -10000000000 10000000000 PHYS_UNIT "ms" /end CHARACTERISTIC
/begin CHARACTERISTIC FPfu_accel_x_max "FPrm_unlatch(532)" VALUE 0x0016132C /* @ECU_Address@FPrm_unlatch@0x021BD850@ */ ECIPP_ALIGNMENT_FLOAT32_IEEE 10000000000 Compu_IDENTITY -10000000000 10000000000 PHYS_UNIT "ms" /end CHARACTERISTIC
/begin CHARACTERISTIC FPfu_accel_x_min "FPrm_unlatch(533)" VALUE 0x00161330 /* @ECU_Address@FPrm_unlatch@0x021BD854@ */ ECIPP_ALIGNMENT_FLOAT32_IEEE 10000000000 Compu_IDENTITY -10000000000 10000000000 PHYS_UNIT "ms" /end CHARACTERISTIC
/begin CHARACTERISTIC FPfu_accel_y_max "FPrm_unlatch(534)" VALUE 0x00161334 /* @ECU_Address@FPrm_unlatch@0x021BD858@ */ ECIPP_ALIGNMENT_FLOAT32_IEEE 10000000000 Compu_IDENTITY -10000000000 10000000000 PHYS_UNIT "ms" /end CHARACTERISTIC
/begin CHARACTERISTIC FPfu_accel_y_min "FPrm_unlatch(535)" VALUE 0x00161338 /* @ECU_Address@FPrm_unlatch@0x021BD85C@ */ ECIPP_ALIGNMENT_FLOAT32_IEEE 10000000000 Compu_IDENTITY -10000000000 10000000000 PHYS_UNIT "ms" /end CHARACTERISTIC
/begin CHARACTERISTIC FPfu_accel_z_max "FPrm_unlatch(536)" VALUE 0x0016133C /* @ECU_Address@FPrm_unlatch@0x021BD860@ */ ECIPP_ALIGNMENT_FLOAT32_IEEE 10000000000 Compu_IDENTITY -10000000000 10000000000 PHYS_UNIT "ms" /end CHARACTERISTIC
/begin CHARACTERISTIC FPfu_accel_z_min "FPrm_unlatch(537)" VALUE 0x00161340 /* @ECU_Address@FPrm_unlatch@0x021BD864@ */ ECIPP_ALIGNMENT_FLOAT32_IEEE 10000000000 Compu_IDENTITY -10000000000 10000000000 PHYS_UNIT "ms" /end CHARACTERISTIC
/begin CHARACTERISTIC FPfu_ADIG1_max "FPrm_unlatch(165)" VALUE 0x00160D70 /* @ECU_Address@FPrm_unlatch@0x021BD294@ */ ECIPP_ALIGNMENT_FLOAT32_IEEE 10000000000 Compu_IDENTITY -10000000000 10000000000 PHYS_UNIT "ms" /end CHARACTERISTIC
/begin CHARACTERISTIC FPfu_ADIG1_min "FPrm_unlatch(166)" VALUE 0x00160D74 /* @ECU_Address@FPrm_unlatch@0x021BD298@ */ ECIPP_ALIGNMENT_FLOAT32_IEEE 10000000000 Compu_IDENTITY -10000000000 10000000000 PHYS_UNIT "ms" /end CHARACTERISTIC
/begin CHARACTERISTIC FPfu_ADIG10_max "FPrm_unlatch(258)" VALUE 0x00160EE4 /* @ECU_Address@FPrm_unlatch@0x021BD408@ */ ECIPP_ALIGNMENT_FLOAT32_IEEE 10000000000 Compu_IDENTITY -10000000000 10000000000 PHYS_UNIT "ms" /end CHARACTERISTIC
/begin CHARACTERISTIC FPfu_ADIG10_min "FPrm_unlatch(259)" VALUE 0x00160EE8 /* @ECU_Address@FPrm_unlatch@0x021BD40C@ */ ECIPP_ALIGNMENT_FLOAT32_IEEE 10000000000 Compu_IDENTITY -10000000000 10000000000 PHYS_UNIT "ms" /end CHARACTERISTIC
/begin CHARACTERISTIC FPfu_ADIG11_max "FPrm_unlatch(263)" VALUE 0x00160EF8 /* @ECU_Address@FPrm_unlatch@0x021BD41C@ */ ECIPP_ALIGNMENT_FLOAT32_IEEE 10000000000 Compu_IDENTITY -10000000000 10000000000 PHYS_UNIT "ms" /end CHARACTERISTIC
/begin CHARACTERISTIC FPfu_ADIG11_min "FPrm_unlatch(264)" VALUE 0x00160EFC /* @ECU_Address@FPrm_unlatch@0x021BD420@ */ ECIPP_ALIGNMENT_FLOAT32_IEEE 10000000000 Compu_IDENTITY -10000000000 10000000000 PHYS_UNIT "ms" /end CHARACTERISTIC
/begin CHARACTERISTIC FPfu_ADIG12_max "FPrm_unlatch(265)" VALUE 0x00160F00 /* @ECU_Address@FPrm_unlatch@0x021BD424@ */ ECIPP_ALIGNMENT_FLOAT32_IEEE 10000000000 Compu_IDENTITY -10000000000 10000000000 PHYS_UNIT "ms" /end CHARACTERISTIC
/begin CHARACTERISTIC FPfu_ADIG12_min "FPrm_unlatch(266)" VALUE 0x00160F04 /* @ECU_Address@FPrm_unlatch@0x021BD428@ */ ECIPP_ALIGNMENT_FLOAT32_IEEE 10000000000 Compu_IDENTITY -10000000000 10000000000 PHYS_UNIT "ms" /end CHARACTERISTIC
/begin CHARACTERISTIC FPfu_ADIG13_max "FPrm_unlatch(302)" VALUE 0x00160F94 /* @ECU_Address@FPrm_unlatch@0x021BD4B8@ */ ECIPP_ALIGNMENT_FLOAT32_IEEE 10000000000 Compu_IDENTITY -10000000000 10000000000 PHYS_UNIT "ms" /end CHARACTERISTIC
/begin CHARACTERISTIC FPfu_ADIG13_min "FPrm_unlatch(303)" VALUE 0x00160F98 /* @ECU_Address@FPrm_unlatch@0x021BD4BC@ */ ECIPP_ALIGNMENT_FLOAT32_IEEE 10000000000 Compu_IDENTITY -10000000000 10000000000 PHYS_UNIT "ms" /end CHARACTERISTIC
/begin CHARACTERISTIC FPfu_ADIG14_max "FPrm_unlatch(304)" VALUE 0x00160F9C /* @ECU_Address@FPrm_unlatch@0x021BD4C0@ */ ECIPP_ALIGNMENT_FLOAT32_IEEE 10000000000 Compu_IDENTITY -10000000000 10000000000 PHYS_UNIT "ms" /end CHARACTERISTIC
/begin CHARACTERISTIC FPfu_ADIG14_min "FPrm_unlatch(305)" VALUE 0x00160FA0 /* @ECU_Address@FPrm_unlatch@0x021BD4C4@ */ ECIPP_ALIGNMENT_FLOAT32_IEEE 10000000000 Compu_IDENTITY -10000000000 10000000000 PHYS_UNIT "ms" /end CHARACTERISTIC
/begin CHARACTERISTIC FPfu_ADIG15_max "FPrm_unlatch(306)" VALUE 0x00160FA4 /* @ECU_Address@FPrm_unlatch@0x021BD4C8@ */ ECIPP_ALIGNMENT_FLOAT32_IEEE 10000000000 Compu_IDENTITY -10000000000 10000000000 PHYS_UNIT "ms" /end CHARACTERISTIC
/begin GROUP EC_VECal "ECONTROLS" ROOT
 /begin REF_CHARACTERISTIC MAT_est_xmin MAT_est_xmax MAT_est_tau VE_CWT_C VE_CWT_tau_idle VE_CWT_rpm_idle VE_CWT_max VE_CWT_min CHTc CHTo CHTo_tau CHT_tau EBP_gauge_def EBP_est_ena EBP_C_exh CWT_mode EMP_est EBPs_C_exh EBPs_gauge_def ovlp_Aeff ovlp_cyc_frac ovlp_EGT_def MAF_ena MAF_PWM_edge EMP_ena EBP_T_select MAF_cyl_events MAF_flow_tau_ms mdot_trans_TPS_dzpct TB_fuelV TMtf_TPScmd_tau_inc TMtf_TPScmd_tau_dec TMtf_trans_sldn TMtf_trans_min TMtf_trans_max TMtf_PRov_min TMtf_PRov_max TPSad_strt_wait TPSad_trans_lim TPSad_adapt_dz TPSad_Kadapt TPSad_adapt_lim TPSad_PR_max TPSad_MAP_min TPSad_learn_wait EBP_mpsi_select TPSad_mode TPSad_TPS_min TPSad_PRadapt_sw TPSad_PRadapt_swend TPSad_CdA_Kadapt TPSad_CdA_adapt_lim TPSad_CdA_adapt_Amin TPSad_PR_Kadapt TPSad_PR_adapt_lim TPSad_global_use TPSad_store_EE CWT_mode_LPG CWT_mode_NG TVE_VE TCWT_C_inc TCWT_C_dec TCWT_tau_inc TCWT_tau_dec TCWT2_pct TCWT2_tau TCWT2_rpmpct TCWT2_loadfact TTM_TPSA_A /end REF_CHARACTERISTIC
 /begin REF_MEASUREMENT VEs m_a_port mdot_a_throttle MAP_est MAPdt_est VE_EBP_crct VE_MAT_crct VE_ECT_crct FRT_crct PWPCF_deltaPW ovlp_m_port VE_ovlp_crct MAF_flow_gsec m_d_port mdot_d_ports_float mdot_tot_TPSf mdot_eng_TPSf mdot_eng_Nrho mdot_trans_TPSf mdot_transdz_TPSf mdot_f_TBfV_dP PR_pseudo MAP_windowed TIP_windowed TMTPSad_pct TMtf_trans_wgt TMtf_trans_dzabspct TMtf_PR_wgt mdot_filter_float mdot_a_intake_float mdot_f_intake_float mdot_intake_float mdot_a_fill_float mdot_f_fill_float mdot_d_fill_float mdot_a_EGR_float mdot_f_EGR_float mdot_d_EGR_float mdot_EGR_float mdot_a_ivlv_float mdot_f_ivlv_float mdot_d_ivlv_float mdot_ivlv_float mdot_a_evlv_float mdot_f_evlv_float mdot_d_evlv_float mdot_evlv_float mdot_a_exhaust_float mdot_f_exhaust_float mdot_d_exhaust_float mdot_exhaust_float TPSad_PRadapt_ratio TPSad_CdA_in2 TPSad_PR_adapt_crct TPSad_adapt_assist PR_uncrct TPSad_status TTPSad_CdA_crct /end REF_MEASUREMENT
/end GROUP
/begin GROUP EC_NONE_100 "ECONTROLS" ROOT
 /begin REF_CHARACTERISTIC SH_def AAT_def RS_present key_on_waitalt ALfltG_RPMmin ALfltG_RPMmax ALfltP_RPMmin ALfltP_RPMmax ALfltN_RPMmin ALfltN_RPMmax CLfltG_RPMmin CLfltP_RPMmin CLfltN_RPMmin CLfltG_RPMmax CLfltP_RPMmax CLfltN_RPMmax ALfltG_MAPmin ALfltP_MAPmin ALfltN_MAPmin ALfltG_MAPmax ALfltP_MAPmax ALfltN_MAPmax CLfltG_MAPmin CLfltP_MAPmin CLfltN_MAPmin CLfltG_MAPmax CLfltP_MAPmax CLfltN_MAPmax MJ_ctl_strat Carb_loc MJ_param_comm key_off_valid key_offrel_valid BstTIP_Hi BstTIP_Hi_abs BstTIP_Hi_dtdz BstTIP_Lo_dtdz BstTIP_Lo BstTIP_Lo_abs BstTIP_Lo_ECT TIP_act TIP_actMAP IAC_home_int_min FPP1_5V_source FPP2_5V_source cam_pos_tau FaultCylBlock_use ADIG3_max J1939_TSC1_loss TRIM_lim_bhvP TRIM_lim_bhvN J1939_ETC_loss V_LPG V_NG key_on_wait fpump_key_wait lockoff_key_wait LOD_WARN_force SWARN_bulbchk HWARN_bulbchk J1939_DM19_calid J1939_DM5_OBDc Vs FPin_s FPout_s FP_ena FP_abs_gage adapt_ena HWARN_bulbon SWARN_bulbon fuelclr_mult CRI_V_relay FPin_s_I2 FPout_s_I2 Vs_I2 FP_ena_I2 FP_abs_gage_I2 FPraw_LP_I2 AFILT_dP_C EGR_clr_Cr_nom EGR_clr_eta_nom EGT_ena TOT_ena EGR_PWM_period TC_mdot_avg_tau TC_mdot_nom TC_mech_eta EGR_vlv_tau EGR_Vrelay_nominal CFV_Preg_HiExp CFV_Preg_LoExp TC_comp_eta_surge TC_comp_eta_choke TC_comp_Pratio_min TC_comp_mdotr_Ld TC_comp_Nr TC_comp_Pref TC_comp_Tref TC_turb_Nr_pct TC_turb_Pref TC_turb_Tref TC_turb_etamin TC_turb_mdotr_pct TC_turb_mdot0c_pct IMVD_Ifb_hi IMVD_Ifb_lo IMVD_lo_Icmd IMVD_lo_PWcmd INJD_Vboost_LOtol INJD_Vboost_HItol INJD_max_riseT INJD_min_riseT CRI_FPerr_high CRI_FPerr_low key_on_relay_force DATE_engine_defMfg COT_ena CylTempSwt_chan CylTempSwt_chan_cfg VDS_enghrs_limit adapt_fuel_rpm_src adapt_fuel_rpm_dz HWARN_lamp SWARN_lamp DERATE_lamp LOWREVLIM_lamp SD_lamp DERATEblk_on LOWREVLIMblk_on SDblk_on DERATEblk_off LOWREVLIMblk_off SDblk_off MIL_DM1_output FSS_cust_tbl_def FDR_cust_tbl_def TMJ_KcompN_Kc TMJ_KcompP_Kc TMJ_Kcomp_PR TTM_PRKc_Kc TTM_PRKc_PR TVEmod_ECT_mul TVEmod_MAT_mul Tspkmx_ECT_CAD TFlt_xface_addr TFlt_xface2_addr TFlt_xface3_addr TCRI_ontime TCRI_rho_diesel TCRI_air_std TCRI_air_alt1 TCRI_P_cld TCRI_P_std TCRI_P_alt1 TCRI_smk_limit TCRI_Qpilot2_cld TCRI_Qpilot2_std TCRI_Qpilot2_alt1 TCRI_Qpilot1_cld TCRI_Qpilot1_std TCRI_Qpilot1_alt1 TCRI_Qmain_cld TCRI_Qload_std TCRI_Qload_alt1 TCRI_Qload_alt2 TCRI_Qpost1_std TCRI_Qpost1_alt1 TCRI_Qpost2_std TCRI_Qpost2_alt1 TCRI_Tpilot2_cld TCRI_Tpilot2_std TCRI_Tpilot2_alt1 TCRI_Tpilot1_std TCRI_Tpilot1_alt1 TCRI_Tmain_cld TCRI_Tmain_std TCRI_Tmain_alt1 TCRI_Tmain_alt2 TCRI_Tpost1_cld TCRI_Tpost1_std TCRI_Tpost1_alt1 TCRI_Tpost2_cld TCRI_Tpost2_std TCRI_Tpost2_alt1 TCRI_Qmin TCRI_pulseoff_std TCRI_pulseoff_alt1 TDOC_Tcl_std TDOC_Tcl_alt1 TTC_comp_etamax TTC_turb_Pratio TTC_comp_surge_pct TTC_comp_choke_pct TTC_comp_Npct TTC_turb_Nmult_neg TTC_turb_Nmult_pos TTC_turb_etamax TTC_turb_Npct_etamax TTC_turb_mdot1c_pct HEX_FSS_PID_tbl /end REF_CHARACTERISTIC
 /begin REF_MEASUREMENT emcal_CS_16 totalcal_CS_16 m_d_pct_reqnom /end REF_MEASUREMENT
/end GROUP
/begin GROUP accel_x_max_EC_Fault "Accelerometer X-axis out-of-range high"
 /begin REF_CHARACTERISTIC FCdc4_accel_x_max FCdtc_accel_x_max FCfmi_accel_x_max FCftb_accel_x_max FCspn_accel_x_max FPfl_accel_x_max FPfu_accel_x_max FPnd_accel_x_max FPsvr_accel_x_max FPsw_ext1_accel_x_max FPsw_accel_x_max /end REF_CHARACTERISTIC
/end GROUP
/begin GROUP accel_x_min_EC_Fault "Accelerometer X-axis out-of-range low"
 /begin REF_CHARACTERISTIC FCdc4_accel_x_min FCdtc_accel_x_min FCfmi_accel_x_min FCftb_accel_x_min FCspn_accel_x_min FPfl_accel_x_min FPfu_accel_x_min FPnd_accel_x_min FPsvr_accel_x_min FPsw_ext1_accel_x_min FPsw_accel_x_min /end REF_CHARACTERISTIC
/end GROUP
/begin GROUP accel_y_max_EC_Fault "Accelerometer Y-axis out-of-range high"
 /begin REF_CHARACTERISTIC FCdc4_accel_y_max FCdtc_accel_y_max FCfmi_accel_y_max FCftb_accel_y_max FCspn_accel_y_max FPfl_accel_y_max FPfu_accel_y_max FPnd_accel_y_max FPsvr_accel_y_max FPsw_ext1_accel_y_max FPsw_accel_y_max /end REF_CHARACTERISTIC
/end GROUP
/begin GROUP accel_y_min_EC_Fault "Accelerometer Y-axis out-of-range low"
 /begin REF_CHARACTERISTIC FCdc4_accel_y_min FCdtc_accel_y_min FCfmi_accel_y_min FCftb_accel_y_min FCspn_accel_y_min FPfl_accel_y_min FPfu_accel_y_min FPnd_accel_y_min FPsvr_accel_y_min FPsw_ext1_accel_y_min FPsw_accel_y_min /end REF_CHARACTERISTIC
/end GROUP
/begin GROUP accel_z_max_EC_Fault "Accelerometer Z-axis out-of-range high"
 /begin REF_CHARACTERISTIC FCdc4_accel_z_max FCdtc_accel_z_max FCfmi_accel_z_max FCftb_accel_z_max FCspn_accel_z_max FPfl_accel_z_max FPfu_accel_z_max FPnd_accel_z_max FPsvr_accel_z_max FPsw_ext1_accel_z_max FPsw_accel_z_max /end REF_CHARACTERISTIC
/end GROUP
/begin GROUP accel_z_min_EC_Fault "Accelerometer Z-axis out-of-range low"
 /begin REF_CHARACTERISTIC FCdc4_accel_z_min FCdtc_accel_z_min FCfmi_accel_z_min FCftb_accel_z_min FCspn_accel_z_min FPfl_accel_z_min FPfu_accel_z_min FPnd_accel_z_min FPsvr_accel_z_min FPsw_ext1_accel_z_min FPsw_accel_z_min /end REF_CHARACTERISTIC
/end GROUP
/begin GROUP ADIG1_max_EC_Fault "AUX digital 1 high voltage"
 /begin REF_CHARACTERISTIC FCdc4_ADIG1_max FCdtc_ADIG1_max FCfmi_ADIG1_max FCftb_ADIG1_max FCspn_ADIG1_max FPfl_ADIG1_max FPfu_ADIG1_max FPnd_ADIG1_max FPsvr_ADIG1_max FPsw_ext1_ADIG1_max FPsw_ADIG1_max /end REF_CHARACTERISTIC
/end GROUP
/begin GROUP ADIG1_min_EC_Fault "AUX digital 1 low voltage"
 /begin REF_CHARACTERISTIC FCdc4_ADIG1_min FCdtc_ADIG1_min FCfmi_ADIG1_min FCftb_ADIG1_min FCspn_ADIG1_min FPfl_ADIG1_min FPfu_ADIG1_min FPnd_ADIG1_min FPsvr_ADIG1_min FPsw_ext1_ADIG1_min FPsw_ADIG1_min /end REF_CHARACTERISTIC
/end GROUP
/begin GROUP ADIG10_max_EC_Fault "AUX digital 10 high voltage"
 /begin REF_CHARACTERISTIC FCdc4_ADIG10_max FCdtc_ADIG10_max FCfmi_ADIG10_max FCftb_ADIG10_max FCspn_ADIG10_max FPfl_ADIG10_max FPfu_ADIG10_max FPnd_ADIG10_max FPsvr_ADIG10_max FPsw_ext1_ADIG10_max FPsw_ADIG10_max /end REF_CHARACTERISTIC
/end GROUP
/begin GROUP ADIG10_min_EC_Fault "AUX digital 10 low voltage"
 /begin REF_CHARACTERISTIC FCdc4_ADIG10_min FCdtc_ADIG10_min FCfmi_ADIG10_min FCftb_ADIG10_min FCspn_ADIG10_min FPfl_ADIG10_min FPfu_ADIG10_min FPnd_ADIG10_min FPsvr_ADIG10_min FPsw_ext1_ADIG10_min FPsw_ADIG10_min /end REF_CHARACTERISTIC
/end GROUP
/begin GROUP ADIG11_max_EC_Fault "AUX digital 11 high voltage"
 /begin REF_CHARACTERISTIC FCdc4_ADIG11_max FCdtc_ADIG11_max FCfmi_ADIG11_max FCftb_ADIG11_max FCspn_ADIG11_max FPfl_ADIG11_max FPfu_ADIG11_max FPnd_ADIG11_max FPsvr_ADIG11_max FPsw_ext1_ADIG11_max FPsw_ADIG11_max /end REF_CHARACTERISTIC
/end GROUP
/begin GROUP ADIG11_min_EC_Fault "AUX digital 11 low voltage"
 /begin REF_CHARACTERISTIC FCdc4_ADIG11_min FCdtc_ADIG11_min FCfmi_ADIG11_min FCftb_ADIG11_min FCspn_ADIG11_min FPfl_ADIG11_min FPfu_ADIG11_min FPnd_ADIG11_min FPsvr_ADIG11_min FPsw_ext1_ADIG11_min FPsw_ADIG11_min /end REF_CHARACTERISTIC
/end GROUP
/begin GROUP ADIG12_max_EC_Fault "AUX digital 12 high voltage"
 /begin REF_CHARACTERISTIC FCdc4_ADIG12_max FCdtc_ADIG12_max FCfmi_ADIG12_max FCftb_ADIG12_max FCspn_ADIG12_max FPfl_ADIG12_max FPfu_ADIG12_max FPnd_ADIG12_max FPsvr_ADIG12_max FPsw_ext1_ADIG12_max FPsw_ADIG12_max /end REF_CHARACTERISTIC
/end GROUP
/begin GROUP ADIG12_min_EC_Fault "AUX digital 12 low voltage"
 /begin REF_CHARACTERISTIC FCdc4_ADIG12_min FCdtc_ADIG12_min FCfmi_ADIG12_min FCftb_ADIG12_min FCspn_ADIG12_min FPfl_ADIG12_min FPfu_ADIG12_min FPnd_ADIG12_min FPsvr_ADIG12_min FPsw_ext1_ADIG12_min FPsw_ADIG12_min /end REF_CHARACTERISTIC
/end GROUP
/begin GROUP ADIG13_max_EC_Fault "AUX digital 13 high voltage"
 /begin REF_CHARACTERISTIC FCdc4_ADIG13_max FCdtc_ADIG13_max FCfmi_ADIG13_max FCftb_ADIG13_max FCspn_ADIG13_max FPfl_ADIG13_max FPfu_ADIG13_max FPnd_ADIG13_max FPsvr_ADIG13_max FPsw_ext1_ADIG13_max FPsw_ADIG13_max /end REF_CHARACTERISTIC
/end GROUP
/begin GROUP ADIG13_min_EC_Fault "AUX digital 13 low voltage"
 /begin REF_CHARACTERISTIC FCdc4_ADIG13_min FCdtc_ADIG13_min FCfmi_ADIG13_min FCftb_ADIG13_min FCspn_ADIG13_min FPfl_ADIG13_min FPfu_ADIG13_min FPnd_ADIG13_min FPsvr_ADIG13_min FPsw_ext1_ADIG13_min FPsw_ADIG13_min /end REF_CHARACTERISTIC
/end GROUP
/begin GROUP ADIG14_max_EC_Fault "AUX digital 14 high voltage"
 /begin REF_CHARACTERISTIC FCdc4_ADIG14_max FCdtc_ADIG14_max FCfmi_ADIG14_max FCftb_ADIG14_max FCspn_ADIG14_max FPfl_ADIG14_max FPfu_ADIG14_max FPnd_ADIG14_max FPsvr_ADIG14_max FPsw_ext1_ADIG14_max FPsw_ADIG14_max /end REF_CHARACTERISTIC
/end GROUP
/begin GROUP ADIG14_min_EC_Fault "AUX digital 14 low voltage"
 /begin REF_CHARACTERISTIC FCdc4_ADIG14_min FCdtc_ADIG14_min FCfmi_ADIG14_min FCftb_ADIG14_min FCspn_ADIG14_min FPfl_ADIG14_min FPfu_ADIG14_min FPnd_ADIG14_min FPsvr_ADIG14_min FPsw_ext1_ADIG14_min FPsw_ADIG14_min /end REF_CHARACTERISTIC
/end GROUP
/begin GROUP ADIG15_max_EC_Fault "AUX digital 15 high voltage"
 /begin REF_CHARACTERISTIC FCdc4_ADIG15_max FCdtc_ADIG15_max FCfmi_ADIG15_max FCftb_ADIG15_max FCspn_ADIG15_max FPfl_ADIG15_max FPfu_ADIG15_max FPnd_ADIG15_max FPsvr_ADIG15_max FPsw_ext1_ADIG15_max FPsw_ADIG15_max /end REF_CHARACTERISTIC
/end GROUP
/end MODULE
/end PROJECT
