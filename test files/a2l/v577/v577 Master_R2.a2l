/*
Copyright (c) 2000-2022.
All rights reserved.  This is an unpublished work.
*/
ASAP2_VERSION 1 61
/begin PROJECT Econtrols_4G "4G Test"
/begin HEADER "4G A2L Configuration" PROJECT_NO EControls4G /* config for version control */ VERSION "$Revision: 82130 $:" /* config for version control */ /end HEADER
/begin MODULE EControls_4G_SH2A "EControls 4G"
/begin MOD_COMMON "" DEPOSIT ABSOLUTE BYTE_ORDER MSB_FIRST /end MOD_COMMON
/* Define the Record Layouts */
/begin RECORD_LAYOUT ECIPP_ALIGNMENT_UBYTE FNC_VALUES 1 UBYTE COLUMN_DIR DIRECT /end RECORD_LAYOUT
/begin RECORD_LAYOUT ECIPP_ALIGNMENT_UWORD FNC_VALUES 1 UWORD COLUMN_DIR DIRECT /end RECORD_LAYOUT
/begin RECORD_LAYOUT ECIPP_ALIGNMENT_SWORD FNC_VALUES 1 SWORD COLUMN_DIR DIRECT /end RECORD_LAYOUT
/begin RECORD_LAYOUT ECIPP_Lookup_SWORD AXIS_PTS_X 1 SWORD INDEX_INCR DIRECT /end RECORD_LAYOUT
/begin RECORD_LAYOUT ECIPP_ALIGNMENT_ULONG FNC_VALUES 1 ULONG COLUMN_DIR DIRECT /end RECORD_LAYOUT
/begin RECORD_LAYOUT ECIPP_ALIGNMENT_FLOAT32_IEEE FNC_VALUES 1 FLOAT32_IEEE COLUMN_DIR DIRECT /end RECORD_LAYOUT
/begin MEASUREMENT dwell1 "Coil1 dwell" UWORD Compu_dwell1 0 0 0 209.712 ECU_ADDRESS 0x01000060 /end MEASUREMENT
/begin COMPU_METHOD Compu_dwell1 " " RAT_FUNC "%.2" "ms" COEFFS 0 312.5 0 0 0 1 /end COMPU_METHOD
/begin MEASUREMENT dwell2 "Coil2 dwell" UWORD Compu_dwell2 0 0 0 209.712 ECU_ADDRESS 0x01000068 /end MEASUREMENT
/begin COMPU_METHOD Compu_dwell2 " " RAT_FUNC "%.2" "ms" COEFFS 0 312.5 0 0 0 1 /end COMPU_METHOD
/begin MEASUREMENT dwell3 "Coil3 dwell" UWORD Compu_dwell3 0 0 0 209.712 ECU_ADDRESS 0x01000070 /end MEASUREMENT
/begin COMPU_METHOD Compu_dwell3 " " RAT_FUNC "%.2" "ms" COEFFS 0 312.5 0 0 0 1 /end COMPU_METHOD
/begin MEASUREMENT inj_timing "Injection timing" SWORD Compu_inj_timing 0 0 -2048 2047.9375 ECU_ADDRESS 0x01000078 /end MEASUREMENT
/begin COMPU_METHOD Compu_inj_timing " " RAT_FUNC "%.0" "CAD BBDCI" COEFFS 0 16 0 0 0 1 /end COMPU_METHOD
/begin MEASUREMENT MAPdt_dz "MAPdt_dz" SWORD Compu_MAPdt_dz 0 0 -4000 3999.8779296875 ECU_ADDRESS 0x010000E8 /end MEASUREMENT
/begin COMPU_METHOD Compu_MAPdt_dz " " RAT_FUNC "%.1" "psi/sec" COEFFS 0 8.192 0 0 0 1 /end COMPU_METHOD
/begin MEASUREMENT rpmdt "rpmdt" SWORD Compu_rpmdt 0 0 -64000 63998.046875 ECU_ADDRESS 0x01000100 /end MEASUREMENT
/begin COMPU_METHOD Compu_rpmdt " " RAT_FUNC "%.0" "rpm / sec" COEFFS 0 0.512 0 0 0 1 /end COMPU_METHOD
/begin MEASUREMENT m_f_port "m_f_port" UWORD Compu_m_f_port 0 0 0 1023.984375 ECU_ADDRESS 0x01000120 /end MEASUREMENT
/begin COMPU_METHOD Compu_m_f_port " " RAT_FUNC "%.1" "mg/intake" COEFFS 0 64 0 0 0 1 /end COMPU_METHOD
/begin MEASUREMENT mdot_f_throttle "mdot_f_throttle" UWORD Compu_mdot_f_throttle 0 0 0 127.998046875 ECU_ADDRESS 0x01000140 /end MEASUREMENT
/begin COMPU_METHOD Compu_mdot_f_throttle " " RAT_FUNC "%.2" "g/sec" COEFFS 0 512 0 0 0 1 /end COMPU_METHOD
/begin MEASUREMENT EGO1_volts "EGO1" UWORD Compu_EGO1_volts 0 0 0 15.999755859375 ECU_ADDRESS 0x01000170 /end MEASUREMENT
/begin COMPU_METHOD Compu_EGO1_volts " " RAT_FUNC "%.3" "volts" COEFFS 0 4096 0 0 0 1 /end COMPU_METHOD
/begin MEASUREMENT EGO2_volts "EGO2" UWORD Compu_EGO2_volts 0 0 0 15.999755859375 ECU_ADDRESS 0x01000178 /end MEASUREMENT
/begin COMPU_METHOD Compu_EGO2_volts " " RAT_FUNC "%.3" "volts" COEFFS 0 4096 0 0 0 1 /end COMPU_METHOD
/begin MEASUREMENT EGO3_volts "EGO3" UWORD Compu_EGO3_volts 0 0 0 15.999755859375 ECU_ADDRESS 0x01000180 /end MEASUREMENT
/begin COMPU_METHOD Compu_EGO3_volts " " RAT_FUNC "%.3" "volts" COEFFS 0 4096 0 0 0 1 /end COMPU_METHOD
/begin MEASUREMENT MAPe "MAP effective" UWORD Compu_MAPe 0 0 0 255.99609375 ECU_ADDRESS 0x010001D0 /end MEASUREMENT
/begin COMPU_METHOD Compu_MAPe " " RAT_FUNC "%.2" "psia" COEFFS 0 256 0 0 0 1 /end COMPU_METHOD
/begin MEASUREMENT PW_offset_global "Pulse width offset" SWORD Compu_PW_offset_global 0 0 -104.8576 104.8544 ECU_ADDRESS 0x010002A0 /end MEASUREMENT
/begin COMPU_METHOD Compu_PW_offset_global " " RAT_FUNC "%.2" "ms" COEFFS 0 312.5 0 0 0 1 /end COMPU_METHOD
/begin MEASUREMENT eng_load "eng_load" UWORD Compu_eng_load 0 0 0 99.9984741210938 ECU_ADDRESS 0x010002A8 /end MEASUREMENT
/begin COMPU_METHOD Compu_eng_load " " RAT_FUNC "%.1" "%" COEFFS 0 655.36 0 0 0 1 /end COMPU_METHOD
/begin MEASUREMENT PWe_avg "PW (extended)" UWORD Compu_PWe_avg 0 0 0 2047.96875 ECU_ADDRESS 0x01000390 /end MEASUREMENT
/begin COMPU_METHOD Compu_PWe_avg " " RAT_FUNC "%.1" "ms" COEFFS 0 32 0 0 0 1 /end COMPU_METHOD
/begin MEASUREMENT TIP_slow "TIP slow-filtered" UWORD Compu_TIP_slow 0 0 0 255.99609375 ECU_ADDRESS 0x01000460 /end MEASUREMENT
/begin COMPU_METHOD Compu_TIP_slow " " RAT_FUNC "%.2" "psia" COEFFS 0 256 0 0 0 1 /end COMPU_METHOD
/begin MEASUREMENT MAPdt_MAPss "MAP steady-state" UWORD Compu_MAPdt_MAPss 0 0 0 255.99609375 ECU_ADDRESS 0x01000498 /end MEASUREMENT
/begin COMPU_METHOD Compu_MAPdt_MAPss " " RAT_FUNC "%.2" "psia" COEFFS 0 256 0 0 0 1 /end COMPU_METHOD
/begin MEASUREMENT FPC_dot "Fuel rail pressure derivative" SWORD Compu_FPC_dot 0 0 -512 511.984375 ECU_ADDRESS 0x010004A0 /end MEASUREMENT
/begin COMPU_METHOD Compu_FPC_dot " " RAT_FUNC "%.1" "psi/sec" COEFFS 0 64 0 0 0 1 /end COMPU_METHOD
/begin CHARACTERISTIC TFBdt_n "TFBdt window" VALUE 0x00148D3C /* @ECU_Address@TFBdt_n@0x01000808@ */ ECIPP_ALIGNMENT_UBYTE 255 Compu_TFBdt_n 0 255 /end CHARACTERISTIC
/begin COMPU_METHOD Compu_TFBdt_n " " RAT_FUNC "%.0" "ms" COEFFS 0 1 0 0 0 1 /end COMPU_METHOD
/begin CHARACTERISTIC MAPdt_n "MAPdt window" VALUE 0x00147e5a /* @ECU_Address@MAPdt_n@0x01000810@ */ ECIPP_ALIGNMENT_UBYTE 255 Compu_MAPdt_n 0 255 /end CHARACTERISTIC
/begin COMPU_METHOD Compu_MAPdt_n " " RAT_FUNC "%.0" "ms" COEFFS 0 1 0 0 0 1 /end COMPU_METHOD
/begin MEASUREMENT rpmdt_n "rpmdt window" UBYTE Compu_rpmdt_n 0 0 0 1275 ECU_ADDRESS 0x01000818 /end MEASUREMENT
/begin COMPU_METHOD Compu_rpmdt_n " " RAT_FUNC "%.0" "ms" COEFFS 0 0.2 0 0 0 1 /end COMPU_METHOD
/begin CHARACTERISTIC TPSraw_LP "TPS raw low-pass" VALUE 0x00148D3A /* @ECU_Address@TPSraw_LP@0x01000830@ */ ECIPP_ALIGNMENT_UWORD 32768 Compu_TPSraw_LP 0.045084 32768 /end CHARACTERISTIC
/begin COMPU_METHOD Compu_TPSraw_LP " " FORM "%.3" "ms"
 /begin FORMULA "-0.5 / log(1 - (X1 / 65536))" FORMULA_INV "(1 - exp(-0.5/X1)) * 65536" /end FORMULA
/end COMPU_METHOD
/begin CHARACTERISTIC MAPraw_LP "MAP raw low-pass" VALUE 0x00147c0a /* @ECU_Address@MAPraw_LP@0x01000838@ */ ECIPP_ALIGNMENT_UWORD 32768 Compu_MAPraw_LP 0.045084 32768 /end CHARACTERISTIC
/begin COMPU_METHOD Compu_MAPraw_LP " " FORM "%.3" "ms"
 /begin FORMULA "-0.5 / log(1 - (X1 / 65536))" FORMULA_INV "(1 - exp(-0.5/X1)) * 65536" /end FORMULA
/end COMPU_METHOD
/begin CHARACTERISTIC TFBdt_xLP "TFBdt post low-pass" VALUE 0x00148D3E /* @ECU_Address@TFBdt_xLP@0x01000840@ */ ECIPP_ALIGNMENT_UWORD 32768 Compu_TFBdt_xLP 0.033406 32768 /end CHARACTERISTIC
/begin COMPU_METHOD Compu_TFBdt_xLP " " FORM "%.3" "ms"
 /begin FORMULA "-1 / log(1.0000000000001 - (X1 / 32768))" FORMULA_INV "(1.0000000000001 - exp(-1/X1)) * 32768" /end FORMULA
/end COMPU_METHOD
/begin CHARACTERISTIC MAPdt_xLP "MAPdt post low-pass" VALUE 0x00147c08 /* @ECU_Address@MAPdt_xLP@0x01000848@ */ ECIPP_ALIGNMENT_UWORD 163840 Compu_MAPdt_xLP 0.16703 163840 /end CHARACTERISTIC
/begin COMPU_METHOD Compu_MAPdt_xLP " " FORM "%.3" "ms"
 /begin FORMULA "-5 / log(1.0000000000001 - (X1 / 32768))" FORMULA_INV "(1.0000000000001 - exp(-5/X1)) * 32768" /end FORMULA
/end COMPU_METHOD
/begin CHARACTERISTIC MAP_favg_n "MAP average window" VALUE 0x00147e53 /* @ECU_Address@MAP_favg_n@0x01000858@ */ ECIPP_ALIGNMENT_UBYTE 255 Compu_MAP_favg_n 0 255 /end CHARACTERISTIC
/begin COMPU_METHOD Compu_MAP_favg_n " " RAT_FUNC "%.0" "ms" COEFFS 0 1 0 0 0 1 /end COMPU_METHOD
/begin CHARACTERISTIC MAP_savg_n "MAP slow average window" VALUE 0x00147e57 /* @ECU_Address@MAP_savg_n@0x01000860@ */ ECIPP_ALIGNMENT_UBYTE 255 Compu_MAP_savg_n 0 255 /end CHARACTERISTIC
/begin COMPU_METHOD Compu_MAP_savg_n " " RAT_FUNC "%.0" "ms" COEFFS 0 1 0 0 0 1 /end COMPU_METHOD
/begin CHARACTERISTIC rpm_filt_n "rpm slow average" VALUE 0x001481b1 /* @ECU_Address@rpm_filt_n@0x01000868@ */ ECIPP_ALIGNMENT_UBYTE 1275 Compu_rpm_filt_n 0 1275 /end CHARACTERISTIC
/begin COMPU_METHOD Compu_rpm_filt_n " " RAT_FUNC "%.0" "ms" COEFFS 0 0.2 0 0 0 1 /end COMPU_METHOD
/begin CHARACTERISTIC MAPdt_crk_dz "MAPdt crank dz" VALUE 0x0014435c /* @ECU_Address@MAPdt_crk_dz@0x01000870@ */ ECIPP_ALIGNMENT_SWORD 4000 Compu_MAPdt_crk_dz -4000 3999.8779296875 /end CHARACTERISTIC
/begin COMPU_METHOD Compu_MAPdt_crk_dz " " RAT_FUNC "%.1" "psi/sec" COEFFS 0 8.192 0 0 0 1 /end COMPU_METHOD
/begin CHARACTERISTIC MAPdt_nrm_dz "MAPdt normal dz" VALUE 0x0014435e /* @ECU_Address@MAPdt_nrm_dz@0x01000878@ */ ECIPP_ALIGNMENT_SWORD 4000 Compu_MAPdt_nrm_dz -4000 3999.8779296875 /end CHARACTERISTIC
/begin COMPU_METHOD Compu_MAPdt_nrm_dz " " RAT_FUNC "%.1" "psi/sec" COEFFS 0 8.192 0 0 0 1 /end COMPU_METHOD
/begin CHARACTERISTIC MAP_CADproject "MAP_CADproject" VALUE 0x001475a6 /* @ECU_Address@MAP_CADproject@0x01000920@ */ ECIPP_ALIGNMENT_UWORD 65535 Compu_MAP_CADproject 0 65535 /end CHARACTERISTIC
/begin COMPU_METHOD Compu_MAP_CADproject " " RAT_FUNC "%.0" "CAD" COEFFS 0 1 0 0 0 1 /end COMPU_METHOD
/begin CHARACTERISTIC async_inj_ena "Asynchronous Injection{async_inj_ena&0xff=0x00:OFF}{async_inj_ena&0xff=0x01:ON}" VALUE 0x00149065 /* @ECU_Address@async_inj_ena@0x010009E0@ */ ECIPP_ALIGNMENT_UBYTE 255 async_inj_ena_COMPU_VTAB 0 255 BIT_MASK 0xff /end CHARACTERISTIC
/begin COMPU_METHOD async_inj_ena_COMPU_VTAB "Verbal Table" TAB_VERB "%.0" "list" COMPU_TAB_REF async_inj_ena_COMPU_VTAB_REF /end COMPU_METHOD
/begin COMPU_VTAB async_inj_ena_COMPU_VTAB_REF "Verbal Table" TAB_VERB 2 0x00 "OFF" 0x01 "ON" DEFAULT_VALUE "UNKNOWN" /end COMPU_VTAB
/begin CHARACTERISTIC tri_fuel_ena "Tri-Fuel Mode{tri_fuel_ena&0xff=0x00:Disabled}{tri_fuel_ena&0xff=0x01:Enabled}" VALUE 0x001481c2 /* @ECU_Address@tri_fuel_ena@0x01000BA8@ */ ECIPP_ALIGNMENT_UBYTE 255 tri_fuel_ena_COMPU_VTAB 0 255 BIT_MASK 0xff /end CHARACTERISTIC
/begin COMPU_METHOD tri_fuel_ena_COMPU_VTAB "Verbal Table" TAB_VERB "%.0" "list" COMPU_TAB_REF tri_fuel_ena_COMPU_VTAB_REF /end COMPU_METHOD
/begin COMPU_VTAB tri_fuel_ena_COMPU_VTAB_REF "Verbal Table" TAB_VERB 2 0x00 "Disabled" 0x01 "Enabled" DEFAULT_VALUE "UNKNOWN" /end COMPU_VTAB
/begin CHARACTERISTIC FPUMP_wakeup "FPUMP wakeup" VALUE 0x001468d0 /* @ECU_Address@FPUMP_wakeup@0x01000BB8@ */ ECIPP_ALIGNMENT_UWORD 65535 Compu_FPUMP_wakeup 0 65535 /end CHARACTERISTIC
/begin COMPU_METHOD Compu_FPUMP_wakeup " " RAT_FUNC "%.0" "ms" COEFFS 0 1 0 0 0 1 /end COMPU_METHOD
/begin CHARACTERISTIC LOCKOFF_wakeup "LOCKOFF wakeup" VALUE 0x00147566 /* @ECU_Address@LOCKOFF_wakeup@0x01000BC0@ */ ECIPP_ALIGNMENT_UWORD 65535 Compu_LOCKOFF_wakeup 0 65535 /end CHARACTERISTIC
/begin COMPU_METHOD Compu_LOCKOFF_wakeup " " RAT_FUNC "%.0" "ms" COEFFS 0 1 0 0 0 1 /end COMPU_METHOD
/begin CHARACTERISTIC gsln2gas_overlap "Gasoline to LP/NG overlap" VALUE 0x0014666c /* @ECU_Address@gsln2gas_overlap@0x01000BC8@ */ ECIPP_ALIGNMENT_SWORD 32767 Compu_gsln2gas_overlap -32768 32767 /end CHARACTERISTIC
/begin COMPU_METHOD Compu_gsln2gas_overlap " " RAT_FUNC "%.0" "ms" COEFFS 0 1 0 0 0 1 /end COMPU_METHOD
/begin CHARACTERISTIC gas2gsln_overlap "LP/NG to Gasoline overlap" VALUE 0x0014666a /* @ECU_Address@gas2gsln_overlap@0x01000BD0@ */ ECIPP_ALIGNMENT_SWORD 32767 Compu_gas2gsln_overlap -32768 32767 /end CHARACTERISTIC
/begin COMPU_METHOD Compu_gas2gsln_overlap " " RAT_FUNC "%.0" "ms" COEFFS 0 1 0 0 0 1 /end COMPU_METHOD
/begin CHARACTERISTIC V_LPG_off "LPG turnoff V equivalent (single value)" VALUE 0x00147a50 /* @ECU_Address@V_LPG_off@0x01000BD8@ */ ECIPP_ALIGNMENT_UWORD 32 Compu_V_LPG_off 0 31.99951171875 /end CHARACTERISTIC
/begin COMPU_METHOD Compu_V_LPG_off " " RAT_FUNC "%.2" "liters" COEFFS 0 2048 0 0 0 1 /end COMPU_METHOD
/begin CHARACTERISTIC V_NG_off "NG turnoff V equivalent" VALUE 0x00147a54 /* @ECU_Address@V_NG_off@0x01000BE0@ */ ECIPP_ALIGNMENT_UWORD 32 Compu_V_NG_off 0 31.99951171875 /end CHARACTERISTIC
/begin COMPU_METHOD Compu_V_NG_off " " RAT_FUNC "%.2" "liters" COEFFS 0 2048 0 0 0 1 /end COMPU_METHOD
/begin MEASUREMENT rpmdt_xLP "rpmdt post low-pass" UWORD Compu_rpmdt_xLP 0 0 0.16703 163840 ECU_ADDRESS 0x01000BF0 /end MEASUREMENT
/begin COMPU_METHOD Compu_rpmdt_xLP " " FORM "%.3" "ms"
 /begin FORMULA "-5 / log(1.0000000000001 - (X1 / 32768))" FORMULA_INV "(1.0000000000001 - exp(-5/X1)) * 32768" /end FORMULA
/end COMPU_METHOD
/begin MEASUREMENT inj_kill "Injector kill{inj_kill&0xff=0:Normal}{inj_kill&0xff=1:Injector 1}{inj_kill&0xff=2:Injector 2}{inj_kill&0xff=3:Injector 3}{inj_kill&0xff=4:Injector 4}{inj_kill&0xff=5:Injector 5}{inj_kill&0xff=6:Injector 6}{inj_kill&0xff=7:Injector 7}{inj_kill&0xff=8:Injec" UBYTE inj_kill_COMPU_VTAB 0 0 0 255 ECU_ADDRESS 0x01000F00 BIT_MASK 0xff /end MEASUREMENT
/begin COMPU_METHOD inj_kill_COMPU_VTAB "Verbal Table" TAB_VERB "%.0" "list" COMPU_TAB_REF inj_kill_COMPU_VTAB_REF /end COMPU_METHOD
/begin COMPU_VTAB inj_kill_COMPU_VTAB_REF "Verbal Table" TAB_VERB 11 0 "Normal" 1 "Injector 1" 2 "Injector 2" 3 "Injector 3" 4 "Injector 4" 5 "Injector 5" 6 "Injector 6" 7 "Injector 7" 8 "Injector 8" 9 "Injector 9" 10 "Injector 10" DEFAULT_VALUE "UNKNOWN" /end COMPU_VTAB
/begin MEASUREMENT spk_kill "Spark kill{spk_kill&0xff=0:Normal}{spk_kill&0xff=1:Coil 1}{spk_kill&0xff=2:Coil 2}{spk_kill&0xff=3:Coil 3}{spk_kill&0xff=4:Coil 4}{spk_kill&0xff=5:Coil 5}{spk_kill&0xff=6:Coil 6}{spk_kill&0xff=7:Coil 7}{spk_kill&0xff=8:Coil 8}{spk_kill&0xff=9:Coil 9}{spk_" UBYTE spk_kill_COMPU_VTAB 0 0 0 255 ECU_ADDRESS 0x01000F08 BIT_MASK 0xff /end MEASUREMENT
/begin COMPU_METHOD spk_kill_COMPU_VTAB "Verbal Table" TAB_VERB "%.0" "list" COMPU_TAB_REF spk_kill_COMPU_VTAB_REF /end COMPU_METHOD
/begin COMPU_VTAB spk_kill_COMPU_VTAB_REF "Verbal Table" TAB_VERB 11 0 "Normal" 1 "Coil 1" 2 "Coil 2" 3 "Coil 3" 4 "Coil 4" 5 "Coil 5" 6 "Coil 6" 7 "Coil 7" 8 "Coil 8" 9 "Coil 9" 10 "Coil 10" DEFAULT_VALUE "UNKNOWN" /end COMPU_VTAB
/begin MEASUREMENT Gov1_volt "Gov1 select voltage" UBYTE Compu_Gov1_volt 0 0 0 31.875 ECU_ADDRESS 0x010012A8 /end MEASUREMENT
/begin COMPU_METHOD Compu_Gov1_volt " " RAT_FUNC "%.1" "volts" COEFFS 0 8 0 0 0 1 /end COMPU_METHOD
/begin MEASUREMENT Gov2_volt "Gov2 select voltage" UBYTE Compu_Gov2_volt 0 0 0 31.875 ECU_ADDRESS 0x010012B0 /end MEASUREMENT
/begin COMPU_METHOD Compu_Gov2_volt " " RAT_FUNC "%.1" "volts" COEFFS 0 8 0 0 0 1 /end COMPU_METHOD
/begin MEASUREMENT OilP_volt "Oil pressure voltage" UBYTE Compu_OilP_volt 0 0 0 31.875 ECU_ADDRESS 0x010012B8 /end MEASUREMENT
/begin COMPU_METHOD Compu_OilP_volt " " RAT_FUNC "%.1" "volts" COEFFS 0 8 0 0 0 1 /end COMPU_METHOD
/begin CHARACTERISTIC FT_input_cfg "Fuel switch configuration{FT_input_cfg&0xff=0x00:Gnd=LP, Open=Gsln, +V=NG}{FT_input_cfg&0xff=0x01:Gnd=NG, Open=Gsln, +V=LP}{FT_input_cfg&0xff=0x02:Gnd/Open=Gsln, +V=LP}{FT_input_cfg&0xff=0x03:Gnd/Open=Gsln, +V=NG}{FT_input_cfg&0xff=0x04:Gasoline Only}{FT_" VALUE 0x00147d92 /* @ECU_Address@FT_input_cfg@0x010013D8@ */ ECIPP_ALIGNMENT_UBYTE 255 FT_input_cfg_COMPU_VTAB 0 255 BIT_MASK 0xff /end CHARACTERISTIC
/begin COMPU_METHOD FT_input_cfg_COMPU_VTAB "Verbal Table" TAB_VERB "%.0" "list" COMPU_TAB_REF FT_input_cfg_COMPU_VTAB_REF /end COMPU_METHOD
/begin COMPU_VTAB FT_input_cfg_COMPU_VTAB_REF "Verbal Table" TAB_VERB 11 0x00 "Gnd=LP, Open=Gsln, +V=NG" 0x01 "Gnd=NG, Open=Gsln, +V=LP" 0x02 "Gnd/Open=Gsln, +V=LP" 0x03 "Gnd/Open=Gsln, +V=NG" 0x04 "Gasoline Only" 0x05 "LP Only" 0x06 "NG Only" 0x07 "Gnd/Open=LP, +V=NG" 0x08 "Gnd/Open=NG, +V=LP" 0x09 "Gnd=LP, Open=NG, +V=Gsln" 0x0A "Gnd=Gsln, Open/+V=LP" DEFAULT_VALUE "UNKNOWN" /end COMPU_VTAB
/begin CHARACTERISTIC fuelrunout_ena "Fuel run-out feature{fuelrunout_ena&0xff=0x00:Disabled}{fuelrunout_ena&0xff=0x01:Enabled: LPG, NG}{fuelrunout_ena&0xff=0x02:Enabled: All Fuels}" VALUE 0x00148185 /* @ECU_Address@fuelrunout_ena@0x010016F8@ */ ECIPP_ALIGNMENT_UBYTE 255 fuelrunout_ena_COMPU_VTAB 0 255 BIT_MASK 0xff /end CHARACTERISTIC
/begin COMPU_METHOD fuelrunout_ena_COMPU_VTAB "Verbal Table" TAB_VERB "%.0" "list" COMPU_TAB_REF fuelrunout_ena_COMPU_VTAB_REF /end COMPU_METHOD
/begin COMPU_VTAB fuelrunout_ena_COMPU_VTAB_REF "Verbal Table" TAB_VERB 3 0x00 "Disabled" 0x01 "Enabled: LPG, NG" 0x02 "Enabled: All Fuels" DEFAULT_VALUE "UNKNOWN" /end COMPU_VTAB
/begin CHARACTERISTIC fuelrunout_max "Fuel run-out time limit" VALUE 0x00147b1e /* @ECU_Address@fuelrunout_max@0x01001700@ */ ECIPP_ALIGNMENT_UWORD 65535 Compu_fuelrunout_max 0 65535 /end CHARACTERISTIC
/begin COMPU_METHOD Compu_fuelrunout_max " " RAT_FUNC "%.0" "ms" COEFFS 0 1 0 0 0 1 /end COMPU_METHOD
/begin CHARACTERISTIC rev_lim_fuel "Fuel rev limit (Fault Condition:rpm >)" VALUE 0x00147b68 /* @ECU_Address@rev_lim_fuel@0x010018C8@ */ ECIPP_ALIGNMENT_UWORD 65535 Compu_rev_lim_fuel 0 65535 /end CHARACTERISTIC
/begin COMPU_METHOD Compu_rev_lim_fuel " " RAT_FUNC "%.0" "rpm" COEFFS 0 1 0 0 0 1 /end COMPU_METHOD
/begin CHARACTERISTIC rev_lim_spk "Spark rev limit (Fault Condition:rpm >)" VALUE 0x00147b6c /* @ECU_Address@rev_lim_spk@0x010018D0@ */ ECIPP_ALIGNMENT_UWORD 65535 Compu_rev_lim_spk 0 65535 /end CHARACTERISTIC
/begin COMPU_METHOD Compu_rev_lim_spk " " RAT_FUNC "%.0" "rpm" COEFFS 0 1 0 0 0 1 /end COMPU_METHOD
/begin CHARACTERISTIC tri_fuel_lockoff "Tri-Fuel mode LOCKOFF output{tri_fuel_lockoff&0xff=0:LPG}{tri_fuel_lockoff&0xff=1:NG}" VALUE 0x001481c3 /* @ECU_Address@tri_fuel_lockoff@0x01001B48@ */ ECIPP_ALIGNMENT_UBYTE 255 tri_fuel_lockoff_COMPU_VTAB 0 255 BIT_MASK 0xff /end CHARACTERISTIC
/begin COMPU_METHOD tri_fuel_lockoff_COMPU_VTAB "Verbal Table" TAB_VERB "%.0" "list" COMPU_TAB_REF tri_fuel_lockoff_COMPU_VTAB_REF /end COMPU_METHOD
/begin COMPU_VTAB tri_fuel_lockoff_COMPU_VTAB_REF "Verbal Table" TAB_VERB 2 0 "LPG" 1 "NG" DEFAULT_VALUE "UNKNOWN" /end COMPU_VTAB
/begin CHARACTERISTIC FPraw_LP "Primary FP raw filter" VALUE 0x0014905A /* @ECU_Address@FPraw_LP@0x01001C70@ */ ECIPP_ALIGNMENT_UWORD 327680 Compu_FPraw_LP 0.45084 327680 /end CHARACTERISTIC
/begin COMPU_METHOD Compu_FPraw_LP " " FORM "%.3" "ms"
 /begin FORMULA "-5 / log(1 - (X1 / 65536))" FORMULA_INV "(1 - exp(-5/X1)) * 65536" /end FORMULA
/end COMPU_METHOD
/begin CHARACTERISTIC TIPraw_LP "TIP raw filter" VALUE 0x00147c64 /* @ECU_Address@TIPraw_LP@0x01001C78@ */ ECIPP_ALIGNMENT_UWORD 327680 Compu_TIPraw_LP 0.45084 327680 /end CHARACTERISTIC
/begin COMPU_METHOD Compu_TIPraw_LP " " FORM "%.3" "ms"
 /begin FORMULA "-5 / log(1 - (X1 / 65536))" FORMULA_INV "(1 - exp(-5/X1)) * 65536" /end FORMULA
/end COMPU_METHOD
/begin CHARACTERISTIC gas2gsln_slew "LPG/NG to gasoline slew-in" VALUE 0x00147b26 /* @ECU_Address@gas2gsln_slew@0x01001DF0@ */ ECIPP_ALIGNMENT_UWORD 65535 Compu_gas2gsln_slew 0 65535 /end CHARACTERISTIC
/begin COMPU_METHOD Compu_gas2gsln_slew " " RAT_FUNC "%.0" "ms" COEFFS 0 1 0 0 0 1 /end COMPU_METHOD
/begin MEASUREMENT FT_gsln_slew_att "Gasoline slew-in factor" UWORD Compu_FT_gsln_slew_att 0 0 0.00152587890625 100 ECU_ADDRESS 0x01001DF8 /end MEASUREMENT
/begin COMPU_METHOD Compu_FT_gsln_slew_att " " RAT_FUNC "%.0" "%" COEFFS 0 -655.36 65536 0 0 1 /end COMPU_METHOD
/begin CHARACTERISTIC EGO_phidt_n "EGO derivative interp window" VALUE 0x00147d28 /* @ECU_Address@EGO_phidt_n@0x01002060@ */ ECIPP_ALIGNMENT_UBYTE 255 Compu_EGO_phidt_n 0 255 /end CHARACTERISTIC
/begin COMPU_METHOD Compu_EGO_phidt_n " " RAT_FUNC "%.0" "T_delay" COEFFS 0 1 0 0 0 1 /end COMPU_METHOD
/begin CHARACTERISTIC GasCarb_trim_mode "Fuel trim mode{GasCarb_trim_mode&0xff=0:PWM Valve}{GasCarb_trim_mode&0xff=1:MJ/EPR}{GasCarb_trim_mode&0xff=2:Dual DEPR Dual Mixer}" VALUE 0x00147da0 /* @ECU_Address@GasCarb_trim_mode@0x010020A0@ */ ECIPP_ALIGNMENT_UBYTE 255 GasCarb_trim_mode_COMPU_VTAB 0 255 BIT_MASK 0xff /end CHARACTERISTIC
/begin COMPU_METHOD GasCarb_trim_mode_COMPU_VTAB "Verbal Table" TAB_VERB "%.0" "list" COMPU_TAB_REF GasCarb_trim_mode_COMPU_VTAB_REF /end COMPU_METHOD
/begin COMPU_VTAB GasCarb_trim_mode_COMPU_VTAB_REF "Verbal Table" TAB_VERB 3 0 "PWM Valve" 1 "MJ/EPR" 2 "Dual DEPR Dual Mixer" DEFAULT_VALUE "UNKNOWN" /end COMPU_VTAB
/begin MEASUREMENT dwell4 "Coil4 dwell" UWORD Compu_dwell4 0 0 0 209.712 ECU_ADDRESS 0x01002210 /end MEASUREMENT
/begin COMPU_METHOD Compu_dwell4 " " RAT_FUNC "%.2" "ms" COEFFS 0 312.5 0 0 0 1 /end COMPU_METHOD
/begin MEASUREMENT dwell5 "Coil5 dwell" UWORD Compu_dwell5 0 0 0 209.712 ECU_ADDRESS 0x01002218 /end MEASUREMENT
/begin COMPU_METHOD Compu_dwell5 " " RAT_FUNC "%.2" "ms" COEFFS 0 312.5 0 0 0 1 /end COMPU_METHOD
/begin MEASUREMENT dwell6 "Coil6 dwell" UWORD Compu_dwell6 0 0 0 209.712 ECU_ADDRESS 0x01002220 /end MEASUREMENT
/begin COMPU_METHOD Compu_dwell6 " " RAT_FUNC "%.2" "ms" COEFFS 0 312.5 0 0 0 1 /end COMPU_METHOD
/begin MEASUREMENT dwell7 "Coil7 dwell" UWORD Compu_dwell7 0 0 0 209.712 ECU_ADDRESS 0x01002228 /end MEASUREMENT
/begin COMPU_METHOD Compu_dwell7 " " RAT_FUNC "%.2" "ms" COEFFS 0 312.5 0 0 0 1 /end COMPU_METHOD
/begin MEASUREMENT dwell8 "Coil8 dwell" UWORD Compu_dwell8 0 0 0 209.712 ECU_ADDRESS 0x01002230 /end MEASUREMENT
/begin COMPU_METHOD Compu_dwell8 " " RAT_FUNC "%.2" "ms" COEFFS 0 312.5 0 0 0 1 /end COMPU_METHOD
/begin MEASUREMENT dwell9 "Coil9 dwell" UWORD Compu_dwell9 0 0 0 209.712 ECU_ADDRESS 0x01002238 /end MEASUREMENT
/begin COMPU_METHOD Compu_dwell9 " " RAT_FUNC "%.0" "ms" COEFFS 0 312.5 0 0 0 1 /end COMPU_METHOD
/begin MEASUREMENT dwell10 "Coil10 dwell" UWORD Compu_dwell10 0 0 0 209.712 ECU_ADDRESS 0x01002240 /end MEASUREMENT
/begin COMPU_METHOD Compu_dwell10 " " RAT_FUNC "%.0" "ms" COEFFS 0 312.5 0 0 0 1 /end COMPU_METHOD
/begin CHARACTERISTIC WGPraw_LP "WGP feedback low-pass tau" VALUE 0x00147ca6 /* @ECU_Address@WGPraw_LP@0x01002558@ */ ECIPP_ALIGNMENT_UWORD 327680 Compu_WGPraw_LP 0.45084 327680 /end CHARACTERISTIC
/begin COMPU_METHOD Compu_WGPraw_LP " " FORM "%.1" "ms"
 /begin FORMULA "-5 / log(1 - (X1 / 65536))" FORMULA_INV "(1 - exp(-5/X1)) * 65536" /end FORMULA
/end COMPU_METHOD
/begin MEASUREMENT MAP_raw "MAP_raw" UWORD Compu_MAP_raw 0 0 0 5.00114468864469 ECU_ADDRESS 0x01002670 /end MEASUREMENT
/begin COMPU_METHOD Compu_MAP_raw " " RAT_FUNC "%.3" "volts" COEFFS 0 13104 0 0 0 1 /end COMPU_METHOD
/begin MEASUREMENT ECT_raw "ECT_raw" UWORD Compu_ECT_raw 0 0 0 5.00114468864469 ECU_ADDRESS 0x010026D0 /end MEASUREMENT
/begin COMPU_METHOD Compu_ECT_raw " " RAT_FUNC "%.3" "volts" COEFFS 0 13104 0 0 0 1 /end COMPU_METHOD
/begin MEASUREMENT IAT_raw "IAT_raw" UWORD Compu_IAT_raw 0 0 0 5.00114468864469 ECU_ADDRESS 0x010026D8 /end MEASUREMENT
/begin COMPU_METHOD Compu_IAT_raw " " RAT_FUNC "%.3" "volts" COEFFS 0 13104 0 0 0 1 /end COMPU_METHOD
/begin CHARACTERISTIC rpmdt_sLP "Slow-filtered rpmdt filter" VALUE 0x00147cbe /* @ECU_Address@rpmdt_sLP@0x01002F58@ */ ECIPP_ALIGNMENT_UWORD 163840 Compu_rpmdt_sLP 0.16703 163840 /end CHARACTERISTIC
/begin COMPU_METHOD Compu_rpmdt_sLP " " FORM "%.1" "ms"
 /begin FORMULA "-5 / log(1.0000000000001 - (X1 / 32768))" FORMULA_INV "(1.0000000000001 - exp(-5/X1)) * 32768" /end FORMULA
/end COMPU_METHOD
/begin MEASUREMENT rpmdt_slow "Slow-filtered rpmdt" SWORD Compu_rpmdt_slow 0 0 -64000 63998.046875 ECU_ADDRESS 0x01002F60 /end MEASUREMENT
/begin COMPU_METHOD Compu_rpmdt_slow " " RAT_FUNC "%.0" "rpm/sec" COEFFS 0 0.512 0 0 0 1 /end COMPU_METHOD
/begin MEASUREMENT MILout_mirror "MIL output pin{MILout_mirror&0x01=0x00:Off}{MILout_mirror&0x01=0x01:On}" UBYTE MILout_mirror_COMPU_VTAB 0 0 0 255 ECU_ADDRESS 0x01003228 BIT_MASK 0x01 /end MEASUREMENT
/begin COMPU_METHOD MILout_mirror_COMPU_VTAB "Verbal Table" TAB_VERB "%.0" "list" COMPU_TAB_REF MILout_mirror_COMPU_VTAB_REF /end COMPU_METHOD
/begin COMPU_VTAB MILout_mirror_COMPU_VTAB_REF "Verbal Table" TAB_VERB 2 0x00 "Off" 0x01 "On" DEFAULT_VALUE "UNKNOWN" /end COMPU_VTAB
/begin MEASUREMENT BUZZout_mirror "Buzzer output pin{BUZZout_mirror&0x01=0x00:Off}{BUZZout_mirror&0x01=0x01:On}" UBYTE BUZZout_mirror_COMPU_VTAB 0 0 0 255 ECU_ADDRESS 0x01003230 BIT_MASK 0x01 /end MEASUREMENT
/begin COMPU_METHOD BUZZout_mirror_COMPU_VTAB "Verbal Table" TAB_VERB "%.0" "list" COMPU_TAB_REF BUZZout_mirror_COMPU_VTAB_REF /end COMPU_METHOD
/begin COMPU_VTAB BUZZout_mirror_COMPU_VTAB_REF "Verbal Table" TAB_VERB 2 0x00 "Off" 0x01 "On" DEFAULT_VALUE "UNKNOWN" /end COMPU_VTAB
/begin MEASUREMENT SWARNout_mirror "Soft warning output pin{SWARNout_mirror&0x01=0x00:Off}{SWARNout_mirror&0x01=0x01:On}" UBYTE SWARNout_mirror_COMPU_VTAB 0 0 0 255 ECU_ADDRESS 0x01003238 BIT_MASK 0x01 /end MEASUREMENT
/begin COMPU_METHOD SWARNout_mirror_COMPU_VTAB "Verbal Table" TAB_VERB "%.0" "list" COMPU_TAB_REF SWARNout_mirror_COMPU_VTAB_REF /end COMPU_METHOD
/begin COMPU_VTAB SWARNout_mirror_COMPU_VTAB_REF "Verbal Table" TAB_VERB 2 0x00 "Off" 0x01 "On" DEFAULT_VALUE "UNKNOWN" /end COMPU_VTAB
/begin MEASUREMENT HWARNout_mirror "Hard warning output pin{HWARNout_mirror&0x01=0x00:Off}{HWARNout_mirror&0x01=0x01:On}" UBYTE HWARNout_mirror_COMPU_VTAB 0 0 0 255 ECU_ADDRESS 0x01003240 BIT_MASK 0x01 /end MEASUREMENT
/begin COMPU_METHOD HWARNout_mirror_COMPU_VTAB "Verbal Table" TAB_VERB "%.0" "list" COMPU_TAB_REF HWARNout_mirror_COMPU_VTAB_REF /end COMPU_METHOD
/begin COMPU_VTAB HWARNout_mirror_COMPU_VTAB_REF "Verbal Table" TAB_VERB 2 0x00 "Off" 0x01 "On" DEFAULT_VALUE "UNKNOWN" /end COMPU_VTAB
/begin CHARACTERISTIC MAPdt_dz_src "MAPdt normal trigger source{MAPdt_dz_src&0xff=0:Fixed Value}{MAPdt_dz_src&0xff=1:MAP Based Lookup}" VALUE 0x00147e59 /* @ECU_Address@MAPdt_dz_src@0x01003840@ */ ECIPP_ALIGNMENT_UBYTE 255 MAPdt_dz_src_COMPU_VTAB 0 255 BIT_MASK 0xff /end CHARACTERISTIC
/begin COMPU_METHOD MAPdt_dz_src_COMPU_VTAB "Verbal Table" TAB_VERB "%.0" "list" COMPU_TAB_REF MAPdt_dz_src_COMPU_VTAB_REF /end COMPU_METHOD
/begin COMPU_VTAB MAPdt_dz_src_COMPU_VTAB_REF "Verbal Table" TAB_VERB 2 0 "Fixed Value" 1 "MAP Based Lookup" DEFAULT_VALUE "UNKNOWN" /end COMPU_VTAB
/begin CHARACTERISTIC MAPdt_dz_shape "MAPdt trigger shape{MAPdt_dz_shape&0xff=0:Step Change}{MAPdt_dz_shape&0xff=1:Cubic Rolloff}" VALUE 0x00147e58 /* @ECU_Address@MAPdt_dz_shape@0x01003848@ */ ECIPP_ALIGNMENT_UBYTE 255 MAPdt_dz_shape_COMPU_VTAB 0 255 BIT_MASK 0xff /end CHARACTERISTIC
/begin COMPU_METHOD MAPdt_dz_shape_COMPU_VTAB "Verbal Table" TAB_VERB "%.0" "list" COMPU_TAB_REF MAPdt_dz_shape_COMPU_VTAB_REF /end COMPU_METHOD
/begin COMPU_VTAB MAPdt_dz_shape_COMPU_VTAB_REF "Verbal Table" TAB_VERB 2 0 "Step Change" 1 "Cubic Rolloff" DEFAULT_VALUE "UNKNOWN" /end COMPU_VTAB
/begin CHARACTERISTIC MAPdt_MAPss_tau "MAP steady-state tau for trigger lookup" VALUE 0x00147c06 /* @ECU_Address@MAPdt_MAPss_tau@0x01003850@ */ ECIPP_ALIGNMENT_UWORD 327680 Compu_MAPdt_MAPss_tau 0.45084 327680 /end CHARACTERISTIC
/begin COMPU_METHOD Compu_MAPdt_MAPss_tau " " FORM "%.1" "ms"
 /begin FORMULA "-5 / log(1 - (X1 / 65536))" FORMULA_INV "(1 - exp(-5/X1)) * 65536" /end FORMULA
/end COMPU_METHOD
/begin MEASUREMENT MAPdt_dz_acttrg "Active MAPdt trigger value" SWORD Compu_MAPdt_dz_acttrg 0 0 -4000 3999.8779296875 ECU_ADDRESS 0x01003858 /end MEASUREMENT
/begin COMPU_METHOD Compu_MAPdt_dz_acttrg " " RAT_FUNC "%.1" "psi/sec" COEFFS 0 8.192 0 0 0 1 /end COMPU_METHOD
/begin MEASUREMENT EGO4_volts "EGO4" UWORD Compu_EGO4_volts 0 0 0 15.999755859375 ECU_ADDRESS 0x010038E8 /end MEASUREMENT
/begin COMPU_METHOD Compu_EGO4_volts " " RAT_FUNC "%.3" "volts" COEFFS 0 4096 0 0 0 1 /end COMPU_METHOD
/begin MEASUREMENT FO_BO "Cylinder numbering actual{FO_BO&0xff=0:Firing Order}{FO_BO&0xff=1:Block Order}" UBYTE FO_BO_COMPU_VTAB 0 0 0 255 ECU_ADDRESS 0x01003AD8 BIT_MASK 0xff /end MEASUREMENT
/begin COMPU_METHOD FO_BO_COMPU_VTAB "Verbal Table" TAB_VERB "%.0" "list" COMPU_TAB_REF FO_BO_COMPU_VTAB_REF /end COMPU_METHOD
/begin COMPU_VTAB FO_BO_COMPU_VTAB_REF "Verbal Table" TAB_VERB 2 0 "Firing Order" 1 "Block Order" DEFAULT_VALUE "UNKNOWN" /end COMPU_VTAB
/begin CHARACTERISTIC rev_lim_fuel_drpm "Fuel rev limit proportional span" VALUE 0x00147b6a /* @ECU_Address@rev_lim_fuel_drpm@0x01003AF0@ */ ECIPP_ALIGNMENT_UWORD 65535 Compu_rev_lim_fuel_drpm 0 65535 /end CHARACTERISTIC
/begin COMPU_METHOD Compu_rev_lim_fuel_drpm " " RAT_FUNC "%.0" "delta-rpm" COEFFS 0 1 0 0 0 1 /end COMPU_METHOD
/begin CHARACTERISTIC FPC_ena "Liquid fuel pressure control{FPC_ena&0xff=0:Disabled}{FPC_ena&0xff=1:Aux PWM3}{FPC_ena&0xff=2:Aux PWM4}{FPC_ena&0xff=3:Aux PWM5}{FPC_ena&0xff=4:Aux PWM6}{FPC_ena&0xff=5:Aux PWM8}{FPC_ena&0xff=6:Aux PWM9}{FPC_ena&0xff=7:TACH Output}{FPC_ena&0xff=8:EGOH1}{F" VALUE 0x00147d5c /* @ECU_Address@FPC_ena@0x01003B58@ */ ECIPP_ALIGNMENT_UBYTE 255 FPC_ena_COMPU_VTAB 0 255 BIT_MASK 0xff /end CHARACTERISTIC
/begin COMPU_METHOD FPC_ena_COMPU_VTAB "Verbal Table" TAB_VERB "%.0" "list" COMPU_TAB_REF FPC_ena_COMPU_VTAB_REF /end COMPU_METHOD
/begin COMPU_VTAB FPC_ena_COMPU_VTAB_REF "Verbal Table" TAB_VERB 14 0 "Disabled" 1 "Aux PWM3" 2 "Aux PWM4" 3 "Aux PWM5" 4 "Aux PWM6" 5 "Aux PWM8" 6 "Aux PWM9" 7 "TACH Output" 8 "EGOH1" 9 "EGOH2" 10 "EGOH3" 11 "EGOH4" 12 "Aux PWM1" 13 "Aux PWM2" DEFAULT_VALUE "UNKNOWN" /end COMPU_VTAB
/begin CHARACTERISTIC FPC_Kp "FP feedback Kp" VALUE 0x001442f0 /* @ECU_Address@FPC_Kp@0x01003B60@ */ ECIPP_ALIGNMENT_SWORD 800 Compu_FPC_Kp -800 799.9755859375 /end CHARACTERISTIC
/begin COMPU_METHOD Compu_FPC_Kp " " RAT_FUNC "%.1" "%/psi" COEFFS 0 40.96 0 0 0 1 /end COMPU_METHOD
/begin CHARACTERISTIC FPC_Ki "FP feedback Ki" VALUE 0x001442ec /* @ECU_Address@FPC_Ki@0x01003B68@ */ ECIPP_ALIGNMENT_SWORD 400 Compu_FPC_Ki -400 399.98779296875 /end CHARACTERISTIC
/begin COMPU_METHOD Compu_FPC_Ki " " RAT_FUNC "%.1" "%/psi/sec" COEFFS 0 81.92 0 0 0 1 /end COMPU_METHOD
/begin CHARACTERISTIC FPC_Kd "FP feedback Kd" VALUE 0x001442ea /* @ECU_Address@FPC_Kd@0x01003B70@ */ ECIPP_ALIGNMENT_SWORD 200 Compu_FPC_Kd -200 199.993896484375 /end CHARACTERISTIC
/begin COMPU_METHOD Compu_FPC_Kd " " RAT_FUNC "%.2" "%/(psi/sec)" COEFFS 0 163.84 0 0 0 1 /end COMPU_METHOD
/begin CHARACTERISTIC FPC_Kiv "FP feedback Kiv" VALUE 0x001442ee /* @ECU_Address@FPC_Kiv@0x01003B78@ */ ECIPP_ALIGNMENT_SWORD 50 Compu_FPC_Kiv -50 49.9984741210938 /end CHARACTERISTIC
/begin COMPU_METHOD Compu_FPC_Kiv " " RAT_FUNC "%.2" "%/psi/sec" COEFFS 0 655.36 0 0 0 1 /end COMPU_METHOD
/begin CHARACTERISTIC FPC_dot_window "FP derivative window" VALUE 0x0014687e /* @ECU_Address@FPC_dot_window@0x01003B80@ */ ECIPP_ALIGNMENT_UWORD 65535 Compu_FPC_dot_window 0 65535 /end CHARACTERISTIC
/begin COMPU_METHOD Compu_FPC_dot_window " " RAT_FUNC "%.0" "ms" COEFFS 0 1 0 0 0 1 /end COMPU_METHOD
/begin CHARACTERISTIC FPC_dot_tau "FP derivative low-pass tau" VALUE 0x00147be2 /* @ECU_Address@FPC_dot_tau@0x01003B88@ */ ECIPP_ALIGNMENT_UWORD 163840 Compu_FPC_dot_tau 0.16703 163840 /end CHARACTERISTIC
/begin COMPU_METHOD Compu_FPC_dot_tau " " FORM "%.1" "ms"
 /begin FORMULA "-5 / log(1.0000000000001 - (X1 / 32768))" FORMULA_INV "(1.0000000000001 - exp(-5/X1)) * 32768" /end FORMULA
/end COMPU_METHOD
/begin CHARACTERISTIC FPCVmin "FPump min voltage" VALUE 0x001442e8 /* @ECU_Address@FPCVmin@0x01003B90@ */ ECIPP_ALIGNMENT_SWORD 128 Compu_FPCVmin -128 127.99609375 /end CHARACTERISTIC
/begin COMPU_METHOD Compu_FPCVmin " " RAT_FUNC "%.2" "volts" COEFFS 0 256 0 0 0 1 /end COMPU_METHOD
/begin CHARACTERISTIC FPCVmax "FPump max voltage" VALUE 0x001442e6 /* @ECU_Address@FPCVmax@0x01003B98@ */ ECIPP_ALIGNMENT_SWORD 128 Compu_FPCVmax -128 127.99609375 /end CHARACTERISTIC
/begin COMPU_METHOD Compu_FPCVmax " " RAT_FUNC "%.2" "volts" COEFFS 0 256 0 0 0 1 /end COMPU_METHOD
/begin CHARACTERISTIC FPCV_CLauth "FPump command voltage authority" VALUE 0x001442e4 /* @ECU_Address@FPCV_CLauth@0x01003BA0@ */ ECIPP_ALIGNMENT_SWORD 128 Compu_FPCV_CLauth -128 127.99609375 /end CHARACTERISTIC
/begin COMPU_METHOD Compu_FPCV_CLauth " " RAT_FUNC "%.2" "+/- volts" COEFFS 0 256 0 0 0 1 /end COMPU_METHOD
/begin CHARACTERISTIC FPC_SD_deltaP "FPump shutdown max pressure delta" VALUE 0x0014687c /* @ECU_Address@FPC_SD_deltaP@0x01003BA8@ */ ECIPP_ALIGNMENT_UWORD 256 Compu_FPC_SD_deltaP 0 255.99609375 /end CHARACTERISTIC
/begin COMPU_METHOD Compu_FPC_SD_deltaP " " RAT_FUNC "%.2" "psi delta" COEFFS 0 256 0 0 0 1 /end COMPU_METHOD
/begin CHARACTERISTIC FPCcmd_tau "FPump command low-pass" VALUE 0x00147be4 /* @ECU_Address@FPCcmd_tau@0x01003BB0@ */ ECIPP_ALIGNMENT_UWORD 163840 Compu_FPCcmd_tau 0.16703 163840 /end CHARACTERISTIC
/begin COMPU_METHOD Compu_FPCcmd_tau " " FORM "%.1" "ms"
 /begin FORMULA "-5 / log(1.0000000000001 - (X1 / 32768))" FORMULA_INV "(1.0000000000001 - exp(-5/X1)) * 32768" /end FORMULA
/end COMPU_METHOD
/begin CHARACTERISTIC FPin_a "Fuel rail pressure target" VALUE 0x0014904C /* @ECU_Address@FPin_a@0x01003BB8@ */ ECIPP_ALIGNMENT_UWORD 256 Compu_FPin_a 0 255.99609375 /end CHARACTERISTIC
/begin COMPU_METHOD Compu_FPin_a " " RAT_FUNC "%.1" "psia" COEFFS 0 256 0 0 0 1 /end COMPU_METHOD
/begin MEASUREMENT FPC_Iacc "FP feedback integrator" SWORD Compu_FPC_Iacc 0 0 -800 799.9755859375 ECU_ADDRESS 0x01003BC0 /end MEASUREMENT
/begin COMPU_METHOD Compu_FPC_Iacc " " RAT_FUNC "%.1" "%" COEFFS 0 40.96 0 0 0 1 /end COMPU_METHOD
/begin MEASUREMENT FPCcmd "FP closed-loop percent command" SWORD Compu_FPCcmd 0 0 -100 99.9969482421875 ECU_ADDRESS 0x01003BC8 /end MEASUREMENT
/begin COMPU_METHOD Compu_FPCcmd " " RAT_FUNC "%.1" "%" COEFFS 0 327.68 0 0 0 1 /end COMPU_METHOD
/begin MEASUREMENT FPCcmd_V "FP control voltage command" UWORD Compu_FPCcmd_V 0 0 0 255.99609375 ECU_ADDRESS 0x01003BD0 /end MEASUREMENT
/begin COMPU_METHOD Compu_FPCcmd_V " " RAT_FUNC "%.2" "volts" COEFFS 0 256 0 0 0 1 /end COMPU_METHOD
/begin MEASUREMENT FPCcmd_DC "FP control PWM duty-cycle command" UWORD Compu_FPCcmd_DC 0 0 0 99.9984741210938 ECU_ADDRESS 0x01003BD8 /end MEASUREMENT
/begin COMPU_METHOD Compu_FPCcmd_DC " " RAT_FUNC "%.1" "%" COEFFS 0 655.36 0 0 0 1 /end COMPU_METHOD
/begin CHARACTERISTIC FPUMP_pin "Fuel pump enable pin{FPUMP_pin&0xff=0:Disabled}{FPUMP_pin&0xff=1:Standard}{FPUMP_pin&0xff=2:Aux PWM1}{FPUMP_pin&0xff=3:Aux PWM2}{FPUMP_pin&0xff=4:Aux PWM3}{FPUMP_pin&0xff=5:Aux PWM4}{FPUMP_pin&0xff=6:Aux PWM5}{FPUMP_pin&0xff=7:Aux PWM6}{FPUMP_pin&0xff=8:E" VALUE 0x00147d79 /* @ECU_Address@FPUMP_pin@0x01003BE0@ */ ECIPP_ALIGNMENT_UBYTE 255 FPUMP_pin_COMPU_VTAB 0 255 BIT_MASK 0xff /end CHARACTERISTIC
/begin COMPU_METHOD FPUMP_pin_COMPU_VTAB "Verbal Table" TAB_VERB "%.0" "list" COMPU_TAB_REF FPUMP_pin_COMPU_VTAB_REF /end COMPU_METHOD
/begin COMPU_VTAB FPUMP_pin_COMPU_VTAB_REF "Verbal Table" TAB_VERB 12 0 "Disabled" 1 "Standard" 2 "Aux PWM1" 3 "Aux PWM2" 4 "Aux PWM3" 5 "Aux PWM4" 6 "Aux PWM5" 7 "Aux PWM6" 8 "EGOH1" 9 "EGOH2" 10 "EGOH3" 11 "EGOH4" DEFAULT_VALUE "UNKNOWN" /end COMPU_VTAB
/begin CHARACTERISTIC LOCKOFF_pin "Gaseous lockoff enable pin{LOCKOFF_pin&0xff=0:Disabled}{LOCKOFF_pin&0xff=1:Standard}{LOCKOFF_pin&0xff=2:Aux PWM1}{LOCKOFF_pin&0xff=3:Aux PWM2}{LOCKOFF_pin&0xff=4:Aux PWM3}{LOCKOFF_pin&0xff=5:Aux PWM4}{LOCKOFF_pin&0xff=6:Aux PWM5}{LOCKOFF_pin&0xff=7:Aux PW" VALUE 0x00147e15 /* @ECU_Address@LOCKOFF_pin@0x01003BE8@ */ ECIPP_ALIGNMENT_UBYTE 255 LOCKOFF_pin_COMPU_VTAB 0 255 BIT_MASK 0xff /end CHARACTERISTIC
/begin COMPU_METHOD LOCKOFF_pin_COMPU_VTAB "Verbal Table" TAB_VERB "%.0" "list" COMPU_TAB_REF LOCKOFF_pin_COMPU_VTAB_REF /end COMPU_METHOD
/begin COMPU_VTAB LOCKOFF_pin_COMPU_VTAB_REF "Verbal Table" TAB_VERB 12 0 "Disabled" 1 "Standard" 2 "Aux PWM1" 3 "Aux PWM2" 4 "Aux PWM3" 5 "Aux PWM4" 6 "Aux PWM5" 7 "Aux PWM6" 8 "EGOH1" 9 "EGOH2" 10 "EGOH3" 11 "EGOH4" DEFAULT_VALUE "UNKNOWN" /end COMPU_VTAB
/begin CHARACTERISTIC FT_input_pin "Fuel type select input pin{FT_input_pin&0xff=0:Disabled}{FT_input_pin&0xff=1:Aux DIG1}{FT_input_pin&0xff=2:Aux DIG2}{FT_input_pin&0xff=3:Aux DIG3}{FT_input_pin&0xff=4:Aux DIG4}{FT_input_pin&0xff=5:Aux DIG5}{FT_input_pin&0xff=6:Aux DIG6}{FT_input_pin&0xff=" VALUE 0x00147d93 /* @ECU_Address@FT_input_pin@0x01003BF0@ */ ECIPP_ALIGNMENT_UBYTE 255 FT_input_pin_COMPU_VTAB 0 255 BIT_MASK 0xff /end CHARACTERISTIC
/begin COMPU_METHOD FT_input_pin_COMPU_VTAB "Verbal Table" TAB_VERB "%.0" "list" COMPU_TAB_REF FT_input_pin_COMPU_VTAB_REF /end COMPU_METHOD
/begin COMPU_VTAB FT_input_pin_COMPU_VTAB_REF "Verbal Table" TAB_VERB 20 0 "Disabled" 1 "Aux DIG1" 2 "Aux DIG2" 3 "Aux DIG3" 4 "Aux DIG4" 5 "Aux DIG5" 6 "Aux DIG6" 7 "Aux DIG7" 8 "Aux DIG8" 9 "Aux DIG9" 10 "Aux DIG10" 11 "Aux DIG11" 12 "Aux DIG12" 13 "Aux DIG13" 14 "Aux DIG14" 15 "Aux DIG15" 16 "Aux DIG16" 17 "Aux DIG17" 18 "Aux DIG18" 19 "Aux DIG19" DEFAULT_VALUE "UNKNOWN" /end COMPU_VTAB
/begin CHARACTERISTIC LOCKOFF_flowwt "Gaseous lockoff fuel flow start delay" VALUE 0x0014755e /* @ECU_Address@LOCKOFF_flowwt@0x01003F48@ */ ECIPP_ALIGNMENT_UWORD 65535 Compu_LOCKOFF_flowwt 0 65535 /end CHARACTERISTIC
/begin COMPU_METHOD Compu_LOCKOFF_flowwt " " RAT_FUNC "%.0" "ms" COEFFS 0 1 0 0 0 1 /end COMPU_METHOD
/begin CHARACTERISTIC V_LPG_off_type "LPG turnoff volume type{V_LPG_off_type&0xff=0:Single Value}{V_LPG_off_type&0xff=1:ECT Based Table}{V_LPG_off_type&0xff=2:FT Based Table}" VALUE 0x001480ea /* @ECU_Address@V_LPG_off_type@0x010041B8@ */ ECIPP_ALIGNMENT_UBYTE 255 V_LPG_off_type_COMPU_VTAB 0 255 BIT_MASK 0xff /end CHARACTERISTIC
/begin COMPU_METHOD V_LPG_off_type_COMPU_VTAB "Verbal Table" TAB_VERB "%.0" "list" COMPU_TAB_REF V_LPG_off_type_COMPU_VTAB_REF /end COMPU_METHOD
/begin COMPU_VTAB V_LPG_off_type_COMPU_VTAB_REF "Verbal Table" TAB_VERB 3 0 "Single Value" 1 "ECT Based Table" 2 "FT Based Table" DEFAULT_VALUE "UNKNOWN" /end COMPU_VTAB
/begin MEASUREMENT V_LPG_off_cur "LPG turnoff V equivalent current" UWORD Compu_V_LPG_off_cur 0 0 0 31.99951171875 ECU_ADDRESS 0x010041C0 /end MEASUREMENT
/begin COMPU_METHOD Compu_V_LPG_off_cur " " RAT_FUNC "%.2" "liters" COEFFS 0 2048 0 0 0 1 /end COMPU_METHOD
/begin MEASUREMENT torque_Nm_gross "Current estimated torque" UWORD Compu_torque_Nm_gross 0 0 0 16383.75 ECU_ADDRESS 0x01004510 /end MEASUREMENT
/begin COMPU_METHOD Compu_torque_Nm_gross " " RAT_FUNC "%.1" "N-m" COEFFS 0 4 0 0 0 1 /end COMPU_METHOD
/begin MEASUREMENT torque_pct "Current estimated torque" UWORD Compu_torque_pct 0 0 0 99.9984741210938 ECU_ADDRESS 0x01004518 /end MEASUREMENT
/begin COMPU_METHOD Compu_torque_pct " " RAT_FUNC "%.1" "%" COEFFS 0 655.36 0 0 0 1 /end COMPU_METHOD
/begin CHARACTERISTIC LOD_FROmax "Fuel run-out fault time (Fault Condition:Fuel run-out engine run time >)" VALUE 0x00147568 /* @ECU_Address@LOD_FROmax@0x01004588@ */ ECIPP_ALIGNMENT_UWORD 65535 Compu_LOD_FROmax 0 65535 /end CHARACTERISTIC
/begin COMPU_METHOD Compu_LOD_FROmax " " RAT_FUNC "%.0" "ms" COEFFS 0 1 0 0 0 1 /end COMPU_METHOD
/begin CHARACTERISTIC TRIM_out_chan "Trim valve PWM output channel{TRIM_out_chan&0xff=0:Aux PWM3}{TRIM_out_chan&0xff=1:Aux PWM4}" VALUE 0x001480b5 /* @ECU_Address@TRIM_out_chan@0x01004BF8@ */ ECIPP_ALIGNMENT_UBYTE 255 TRIM_out_chan_COMPU_VTAB 0 255 BIT_MASK 0xff /end CHARACTERISTIC
/begin COMPU_METHOD TRIM_out_chan_COMPU_VTAB "Verbal Table" TAB_VERB "%.0" "list" COMPU_TAB_REF TRIM_out_chan_COMPU_VTAB_REF /end COMPU_METHOD
/begin COMPU_VTAB TRIM_out_chan_COMPU_VTAB_REF "Verbal Table" TAB_VERB 2 0 "Aux PWM3" 1 "Aux PWM4" DEFAULT_VALUE "UNKNOWN" /end COMPU_VTAB
/begin CHARACTERISTIC TRIM_fueltran_mode "TRIM/EPR fuel transition mode{TRIM_fueltran_mode&0xff=0:Fixed command value}{TRIM_fueltran_mode&0xff=1:Nominal lookup value}" VALUE 0x001480b4 /* @ECU_Address@TRIM_fueltran_mode@0x01004C00@ */ ECIPP_ALIGNMENT_UBYTE 255 TRIM_fueltran_mode_COMPU_VTAB 0 255 BIT_MASK 0xff /end CHARACTERISTIC
/begin COMPU_METHOD TRIM_fueltran_mode_COMPU_VTAB "Verbal Table" TAB_VERB "%.0" "list" COMPU_TAB_REF TRIM_fueltran_mode_COMPU_VTAB_REF /end COMPU_METHOD
/begin COMPU_VTAB TRIM_fueltran_mode_COMPU_VTAB_REF "Verbal Table" TAB_VERB 2 0 "Fixed command value" 1 "Nominal lookup value" DEFAULT_VALUE "UNKNOWN" /end COMPU_VTAB
/begin CHARACTERISTIC TRIM_ftran_DCdef "TRIM fuel transition fixed value" VALUE 0x00147906 /* @ECU_Address@TRIM_ftran_DCdef@0x01004C08@ */ ECIPP_ALIGNMENT_UWORD 100 Compu_TRIM_ftran_DCdef 0 99.9984741210938 /end CHARACTERISTIC
/begin COMPU_METHOD Compu_TRIM_ftran_DCdef " " RAT_FUNC "%.1" "% DC" COEFFS 0 655.36 0 0 0 1 /end COMPU_METHOD
/begin CHARACTERISTIC MJ_ftran_Pdef "EPR fuel transition fixed value" VALUE 0x0014437e /* @ECU_Address@MJ_ftran_Pdef@0x01004C10@ */ ECIPP_ALIGNMENT_SWORD 222 Compu_MJ_ftran_Pdef -222 221.993225097656 /end CHARACTERISTIC
/begin COMPU_METHOD Compu_MJ_ftran_Pdef " " RAT_FUNC "%.2" "in H2O" COEFFS 0 147.603603603604 0 0 0 1 /end COMPU_METHOD
/begin CHARACTERISTIC FIMP_ena "Fuel impurity compensation{FIMP_ena&0xff=0:Disabled}{FIMP_ena&0xff=1:Impure = Gsln Cal}{FIMP_ena&0xff=2:Impure = LPG Cal}{FIMP_ena&0xff=3:Impure = NG Cal}" VALUE 0x00147d4f /* @ECU_Address@FIMP_ena@0x01004DD0@ */ ECIPP_ALIGNMENT_UBYTE 255 FIMP_ena_COMPU_VTAB 0 255 BIT_MASK 0xff /end CHARACTERISTIC
/begin COMPU_METHOD FIMP_ena_COMPU_VTAB "Verbal Table" TAB_VERB "%.0" "list" COMPU_TAB_REF FIMP_ena_COMPU_VTAB_REF /end COMPU_METHOD
/begin COMPU_VTAB FIMP_ena_COMPU_VTAB_REF "Verbal Table" TAB_VERB 4 0 "Disabled" 1 "Impure = Gsln Cal" 2 "Impure = LPG Cal" 3 "Impure = NG Cal" DEFAULT_VALUE "UNKNOWN" /end COMPU_VTAB
/begin CHARACTERISTIC FIMP_type "Fuel impurity determination mode{FIMP_type&0xff=0:Constant / Default}{FIMP_type&0xff=1:LPG FTP/FTT Adapt}{FIMP_type&0xff=2:Tri-state switch input}{FIMP_type&0xff=3:External Voltage input}{FIMP_type&0xff=4:Fuel BTU input}" VALUE 0x00147d52 /* @ECU_Address@FIMP_type@0x01004DD8@ */ ECIPP_ALIGNMENT_UBYTE 255 FIMP_type_COMPU_VTAB 0 255 BIT_MASK 0xff /end CHARACTERISTIC
/begin COMPU_METHOD FIMP_type_COMPU_VTAB "Verbal Table" TAB_VERB "%.0" "list" COMPU_TAB_REF FIMP_type_COMPU_VTAB_REF /end COMPU_METHOD
/begin COMPU_VTAB FIMP_type_COMPU_VTAB_REF "Verbal Table" TAB_VERB 5 0 "Constant / Default" 1 "LPG FTP/FTT Adapt" 2 "Tri-state switch input" 3 "External Voltage input" 4 "Fuel BTU input" DEFAULT_VALUE "UNKNOWN" /end COMPU_VTAB
/begin CHARACTERISTIC FIMP_init_mode "Key-on fuel impurity reset mode{FIMP_init_mode&0xff=0:Use last value}{FIMP_init_mode&0xff=1:Reset to default}" VALUE 0x00147d51 /* @ECU_Address@FIMP_init_mode@0x01004DE0@ */ ECIPP_ALIGNMENT_UBYTE 255 FIMP_init_mode_COMPU_VTAB 0 255 BIT_MASK 0xff /end CHARACTERISTIC
/begin COMPU_METHOD FIMP_init_mode_COMPU_VTAB "Verbal Table" TAB_VERB "%.0" "list" COMPU_TAB_REF FIMP_init_mode_COMPU_VTAB_REF /end COMPU_METHOD
/begin COMPU_VTAB FIMP_init_mode_COMPU_VTAB_REF "Verbal Table" TAB_VERB 2 0 "Use last value" 1 "Reset to default" DEFAULT_VALUE "UNKNOWN" /end COMPU_VTAB
/begin CHARACTERISTIC FIMP_pct_init "Cold power-up default fuel impurity level" VALUE 0x00146864 /* @ECU_Address@FIMP_pct_init@0x01004DE8@ */ ECIPP_ALIGNMENT_UWORD 100 Compu_FIMP_pct_init 0 99.9984741210938 /end CHARACTERISTIC
/begin COMPU_METHOD Compu_FIMP_pct_init " " RAT_FUNC "%.1" "%" COEFFS 0 655.36 0 0 0 1 /end COMPU_METHOD
/begin CHARACTERISTIC FIMP_MAP_min "LPG adapt MAP min" VALUE 0x00146858 /* @ECU_Address@FIMP_MAP_min@0x01004DF0@ */ ECIPP_ALIGNMENT_UWORD 256 Compu_FIMP_MAP_min 0 255.99609375 /end CHARACTERISTIC
/begin COMPU_METHOD Compu_FIMP_MAP_min " " RAT_FUNC "%.2" "psia" COEFFS 0 256 0 0 0 1 /end COMPU_METHOD
/begin CHARACTERISTIC FIMP_MAP_max "LPG adapt MAP max" VALUE 0x00146856 /* @ECU_Address@FIMP_MAP_max@0x01004DF8@ */ ECIPP_ALIGNMENT_UWORD 256 Compu_FIMP_MAP_max 0 255.99609375 /end CHARACTERISTIC
/begin COMPU_METHOD Compu_FIMP_MAP_max " " RAT_FUNC "%.2" "psia" COEFFS 0 256 0 0 0 1 /end COMPU_METHOD
/begin CHARACTERISTIC FIMP_RPM_min "LPG adapt RPM min" VALUE 0x0014685c /* @ECU_Address@FIMP_RPM_min@0x01004E00@ */ ECIPP_ALIGNMENT_UWORD 65535 Compu_FIMP_RPM_min 0 65535 /end CHARACTERISTIC
/begin COMPU_METHOD Compu_FIMP_RPM_min " " RAT_FUNC "%.0" "rpm" COEFFS 0 1 0 0 0 1 /end COMPU_METHOD
/begin CHARACTERISTIC FIMP_RPM_max "LPG adapt RPM max" VALUE 0x0014685a /* @ECU_Address@FIMP_RPM_max@0x01004E08@ */ ECIPP_ALIGNMENT_UWORD 65535 Compu_FIMP_RPM_max 0 65535 /end CHARACTERISTIC
/begin COMPU_METHOD Compu_FIMP_RPM_max " " RAT_FUNC "%.0" "rpm" COEFFS 0 1 0 0 0 1 /end COMPU_METHOD
/begin CHARACTERISTIC FIMP_strt_wait "Fuel impurity adapt engine start wait" VALUE 0x00146866 /* @ECU_Address@FIMP_strt_wait@0x01004E10@ */ ECIPP_ALIGNMENT_UWORD 3277 Compu_FIMP_strt_wait 0 3276.75 /end CHARACTERISTIC
/begin COMPU_METHOD Compu_FIMP_strt_wait " " RAT_FUNC "%.1" "sec" COEFFS 0 20 0 0 0 1 /end COMPU_METHOD
/begin CHARACTERISTIC FIMP_wndw_wait "Fuel impurity adapt window wait" VALUE 0x00146868 /* @ECU_Address@FIMP_wndw_wait@0x01004E18@ */ ECIPP_ALIGNMENT_UWORD 3277 Compu_FIMP_wndw_wait 0 3276.75 /end CHARACTERISTIC
/begin COMPU_METHOD Compu_FIMP_wndw_wait " " RAT_FUNC "%.1" "sec" COEFFS 0 20 0 0 0 1 /end COMPU_METHOD
/begin CHARACTERISTIC FIMP_learn_tau "Fuel impurity adaptation tau" VALUE 0x00147bde /* @ECU_Address@FIMP_learn_tau@0x01004E20@ */ ECIPP_ALIGNMENT_UWORD 3277 Compu_FIMP_learn_tau 0.0045084 3276.8 /end CHARACTERISTIC
/begin COMPU_METHOD Compu_FIMP_learn_tau " " FORM "%.1" "sec"
 /begin FORMULA "-0.05 / log(1 - (X1 / 65536))" FORMULA_INV "(1 - exp(-0.05/X1)) * 65536" /end FORMULA
/end COMPU_METHOD
/begin CHARACTERISTIC FIMP_LL_strt "Load-limit fuel impurity linear start" VALUE 0x00146854 /* @ECU_Address@FIMP_LL_strt@0x01004E28@ */ ECIPP_ALIGNMENT_UWORD 100 Compu_FIMP_LL_strt 0 99.9984741210938 /end CHARACTERISTIC
/begin COMPU_METHOD Compu_FIMP_LL_strt " " RAT_FUNC "%.1" "%" COEFFS 0 655.36 0 0 0 1 /end COMPU_METHOD
/begin CHARACTERISTIC FIMP_LL_stop "Load-limit fuel impurity linear finish" VALUE 0x00146852 /* @ECU_Address@FIMP_LL_stop@0x01004E30@ */ ECIPP_ALIGNMENT_UWORD 100 Compu_FIMP_LL_stop 0 99.9984741210938 /end CHARACTERISTIC
/begin COMPU_METHOD Compu_FIMP_LL_stop " " RAT_FUNC "%.1" "%" COEFFS 0 655.36 0 0 0 1 /end COMPU_METHOD
/begin CHARACTERISTIC FTT_ena "FTT source{FTT_ena&0xff=0:Disabled}{FTT_ena&0xff=1:Aux PU1}{FTT_ena&0xff=2:Aux PU2}{FTT_ena&0xff=3:Aux PU3}{FTT_ena&0xff=4:Aux PUD1}{FTT_ena&0xff=5:Aux PUD2}{FTT_ena&0xff=6:Aux PUD3}{FTT_ena&0xff=7:EGT Input}{FTT_ena&0xff=8:Aux PUD4}{FTT_ena&0xff=9:Aux PU" VALUE 0x00147d8d /* @ECU_Address@FTT_ena@0x01004E58@ */ ECIPP_ALIGNMENT_UBYTE 255 FTT_ena_COMPU_VTAB 0 255 BIT_MASK 0xff /end CHARACTERISTIC
/begin COMPU_METHOD FTT_ena_COMPU_VTAB "Verbal Table" TAB_VERB "%.0" "list" COMPU_TAB_REF FTT_ena_COMPU_VTAB_REF /end COMPU_METHOD
/begin COMPU_VTAB FTT_ena_COMPU_VTAB_REF "Verbal Table" TAB_VERB 31 0 "Disabled" 1 "Aux PU1" 2 "Aux PU2" 3 "Aux PU3" 4 "Aux PUD1" 5 "Aux PUD2" 6 "Aux PUD3" 7 "EGT Input" 8 "Aux PUD4" 9 "Aux PUD5" 10 "Aux PUD6" 11 "Aux PUD7" 12 "Aux PUD8" 13 "Aux PUD9" 14 "Aux PUD10" 15 "Aux PUD11" 16 "Aux PUD12" 17 "Aux PUD13" 18 "Aux PUD14" 19 "Aux PUD15" 20 "Aux PUD16" 21 "Aux PUD17" 22 "Aux PUD18" 23 "Aux PUD19" 24 "Aux PUD20" 25 "Aux PUD21" 26 "Aux PUD22" 27 "Aux PUD23" 28 "Aux PUD24" 29 "Aux PUD25" 30 "CAN sourced" DEFAULT_VALUE "UNKNOWN" /end COMPU_VTAB
/begin CHARACTERISTIC FTP_ena "FTP source{FTP_ena&0xff=0:Disabled}{FTP_ena&0xff=1:Aux PD1}{FTP_ena&0xff=2:Aux PD2}{FTP_ena&0xff=3:Aux PD3}{FTP_ena&0xff=4:Aux PUD1}{FTP_ena&0xff=5:Aux PUD2}{FTP_ena&0xff=6:Aux PUD3}{FTP_ena&0xff=7:Aux PUD4}{FTP_ena&0xff=8:Aux PUD5}{FTP_ena&0xff=9:Aux PUD" VALUE 0x00147d8c /* @ECU_Address@FTP_ena@0x01004E68@ */ ECIPP_ALIGNMENT_UBYTE 255 FTP_ena_COMPU_VTAB 0 255 BIT_MASK 0xff /end CHARACTERISTIC
/begin COMPU_METHOD FTP_ena_COMPU_VTAB "Verbal Table" TAB_VERB "%.0" "list" COMPU_TAB_REF FTP_ena_COMPU_VTAB_REF /end COMPU_METHOD
/begin COMPU_VTAB FTP_ena_COMPU_VTAB_REF "Verbal Table" TAB_VERB 31 0 "Disabled" 1 "Aux PD1" 2 "Aux PD2" 3 "Aux PD3" 4 "Aux PUD1" 5 "Aux PUD2" 6 "Aux PUD3" 7 "Aux PUD4" 8 "Aux PUD5" 9 "Aux PUD6" 10 "Aux PUD7" 11 "Aux PUD8" 12 "Aux PUD9" 13 "Aux PUD10" 14 "Aux PUD11" 15 "Aux PUD12" 16 "Aux PUD13" 17 "Aux PUD14" 18 "Aux PUD15" 19 "CAN sourced" 20 "FPP2 Input" 21 "Aux PUD16" 22 "Aux PUD17" 23 "Aux PUD18" 24 "Aux PUD19" 25 "Aux PUD20" 26 "Aux PUD21" 27 "Aux PUD22" 28 "Aux PUD23" 29 "Aux PUD24" 30 "Aux PUD25" DEFAULT_VALUE "UNKNOWN" /end COMPU_VTAB
/begin MEASUREMENT FIMP_percent "Current fuel impurity" UWORD Compu_FIMP_percent 0 0 0 99.9984741210938 ECU_ADDRESS 0x01004E88 /end MEASUREMENT
/begin COMPU_METHOD Compu_FIMP_percent " " RAT_FUNC "%.1" "%" COEFFS 0 655.36 0 0 0 1 /end COMPU_METHOD
/begin MEASUREMENT FIMP_LL_pct "Current load-limit fuel impurity factor" UWORD Compu_FIMP_LL_pct 0 0 0 99.9984741210938 ECU_ADDRESS 0x01004E90 /end MEASUREMENT
/begin COMPU_METHOD Compu_FIMP_LL_pct " " RAT_FUNC "%.1" "%" COEFFS 0 655.36 0 0 0 1 /end COMPU_METHOD
/begin MEASUREMENT FIMP_pct_ss "Steady-State fuel impurity" UWORD Compu_FIMP_pct_ss 0 0 0 99.9984741210938 ECU_ADDRESS 0x01004E98 /end MEASUREMENT
/begin COMPU_METHOD Compu_FIMP_pct_ss " " RAT_FUNC "%.1" "%" COEFFS 0 655.36 0 0 0 1 /end COMPU_METHOD
/begin CHARACTERISTIC inj_timing_dz "Injection timing dead-zone" VALUE 0x0014905C /* @ECU_Address@inj_timing_dz@0x01005290@ */ ECIPP_ALIGNMENT_SWORD 2048 Compu_inj_timing_dz -2048 2047.9375 /end CHARACTERISTIC
/begin COMPU_METHOD Compu_inj_timing_dz " " RAT_FUNC "%.0" "CAD" COEFFS 0 16 0 0 0 1 /end COMPU_METHOD
/begin CHARACTERISTIC inj_timing_dz_tau "Injection timing dead-zone tau" VALUE 0x0014905E /* @ECU_Address@inj_timing_dz_tau@0x01005298@ */ ECIPP_ALIGNMENT_UWORD 163840 Compu_inj_timing_dz_tau 0.16703 163840 /end CHARACTERISTIC
/begin COMPU_METHOD Compu_inj_timing_dz_tau " " FORM "%.0" "ms"
 /begin FORMULA "-5 / log(1.0000000000001 - (X1 / 32768))" FORMULA_INV "(1.0000000000001 - exp(-5/X1)) * 32768" /end FORMULA
/end COMPU_METHOD
/begin MEASUREMENT HM_MIL_seconds "MIL total on-time" ULONG Compu_HM_MIL_seconds 0 0 0 1193046.47083333 ECU_ADDRESS 0x01005348 /end MEASUREMENT
/begin COMPU_METHOD Compu_HM_MIL_seconds " " RAT_FUNC "%.3" "hours" COEFFS 0 3600 0 0 0 1 /end COMPU_METHOD
/begin CHARACTERISTIC rev_lim_spk_drpm "Spark rev limit proportional span" VALUE 0x00147b6e /* @ECU_Address@rev_lim_spk_drpm@0x01005588@ */ ECIPP_ALIGNMENT_UWORD 65535 Compu_rev_lim_spk_drpm 0 65535 /end CHARACTERISTIC
/begin COMPU_METHOD Compu_rev_lim_spk_drpm " " RAT_FUNC "%.0" "delta-rpm" COEFFS 0 1 0 0 0 1 /end COMPU_METHOD
/begin CHARACTERISTIC FRO_key_mode "Fuel run-out key-back-on transition{FRO_key_mode&0xff=0:Ignored}{FRO_key_mode&0xff=1:Continue Running}" VALUE 0x00147d7c /* @ECU_Address@FRO_key_mode@0x01005740@ */ ECIPP_ALIGNMENT_UBYTE 255 FRO_key_mode_COMPU_VTAB 0 255 BIT_MASK 0xff /end CHARACTERISTIC
/begin COMPU_METHOD FRO_key_mode_COMPU_VTAB "Verbal Table" TAB_VERB "%.0" "list" COMPU_TAB_REF FRO_key_mode_COMPU_VTAB_REF /end COMPU_METHOD
/begin COMPU_VTAB FRO_key_mode_COMPU_VTAB_REF "Verbal Table" TAB_VERB 2 0 "Ignored" 1 "Continue Running" DEFAULT_VALUE "UNKNOWN" /end COMPU_VTAB
/begin CHARACTERISTIC FRO_shutdown_ena "Fuel run-out fault shutdown{FRO_shutdown_ena&0xff=0:Disabled}{FRO_shutdown_ena&0xff=1:Enabled}" VALUE 0x00147d7d /* @ECU_Address@FRO_shutdown_ena@0x01005CA8@ */ ECIPP_ALIGNMENT_UBYTE 255 FRO_shutdown_ena_COMPU_VTAB 0 255 BIT_MASK 0xff /end CHARACTERISTIC
/begin COMPU_METHOD FRO_shutdown_ena_COMPU_VTAB "Verbal Table" TAB_VERB "%.0" "list" COMPU_TAB_REF FRO_shutdown_ena_COMPU_VTAB_REF /end COMPU_METHOD
/begin COMPU_VTAB FRO_shutdown_ena_COMPU_VTAB_REF "Verbal Table" TAB_VERB 2 0 "Disabled" 1 "Enabled" DEFAULT_VALUE "UNKNOWN" /end COMPU_VTAB
/begin CHARACTERISTIC LOCKOFF_keyonwt "Gaseous key-on lockoff open delay" VALUE 0x00147564 /* @ECU_Address@LOCKOFF_keyonwt@0x01005DD8@ */ ECIPP_ALIGNMENT_UWORD 65535 Compu_LOCKOFF_keyonwt 0 65535 /end CHARACTERISTIC
/begin COMPU_METHOD Compu_LOCKOFF_keyonwt " " RAT_FUNC "%.0" "ms" COEFFS 0 1 0 0 0 1 /end COMPU_METHOD
/begin CHARACTERISTIC Ginj_peak_offset "Peak off-time offset" VALUE 0x0014906A /* @ECU_Address@Ginj_peak_offset@0x01006490@ */ ECIPP_ALIGNMENT_UWORD 210 Compu_Ginj_peak_offset 0 209.712 /end CHARACTERISTIC
/begin COMPU_METHOD Compu_Ginj_peak_offset " " RAT_FUNC "%.3" "ms" COEFFS 0 312.5 0 0 0 1 /end COMPU_METHOD
/begin CHARACTERISTIC FRO_gov_state_freeze "Fuel run-out governor switch freeze{FRO_gov_state_freeze&0xff=0:Disabled}{FRO_gov_state_freeze&0xff=1:Enabled}" VALUE 0x00147d7b /* @ECU_Address@FRO_gov_state_freeze@0x01006850@ */ ECIPP_ALIGNMENT_UBYTE 255 FRO_gov_state_freeze_COMPU_VTAB 0 255 BIT_MASK 0xff /end CHARACTERISTIC
/begin COMPU_METHOD FRO_gov_state_freeze_COMPU_VTAB "Verbal Table" TAB_VERB "%.0" "list" COMPU_TAB_REF FRO_gov_state_freeze_COMPU_VTAB_REF /end COMPU_METHOD
/begin COMPU_VTAB FRO_gov_state_freeze_COMPU_VTAB_REF "Verbal Table" TAB_VERB 2 0 "Disabled" 1 "Enabled" DEFAULT_VALUE "UNKNOWN" /end COMPU_VTAB
/begin CHARACTERISTIC SHIFT_dt_n "Shift feedback dt interpolation" VALUE 0x00147f32 /* @ECU_Address@SHIFT_dt_n@0x010068B0@ */ ECIPP_ALIGNMENT_UBYTE 255 Compu_SHIFT_dt_n 0 255 /end CHARACTERISTIC
/begin COMPU_METHOD Compu_SHIFT_dt_n " " RAT_FUNC "%.0" "ms (1ms sample)" COEFFS 0 1 0 0 0 1 /end COMPU_METHOD
/begin CHARACTERISTIC SHIFT_dt_LP "Shift feedback dt low-pass filter" VALUE 0x00147c2a /* @ECU_Address@SHIFT_dt_LP@0x010068B8@ */ ECIPP_ALIGNMENT_UWORD 32768 Compu_SHIFT_dt_LP 0.033406 32768 /end CHARACTERISTIC
/begin COMPU_METHOD Compu_SHIFT_dt_LP " " FORM "%.2" "ms"
 /begin FORMULA "-1 / log(1.0000000000001 - (X1 / 32768))" FORMULA_INV "(1.0000000000001 - exp(-1/X1)) * 32768" /end FORMULA
/end COMPU_METHOD
/begin CHARACTERISTIC FRO_fuelclear_ms "Fuel run-out fuel clear time" VALUE 0x001473a0 /* @ECU_Address@FRO_fuelclear_ms@0x01006A80@ */ ECIPP_ALIGNMENT_UWORD 65535 Compu_FRO_fuelclear_ms 0 65535 /end CHARACTERISTIC
/begin COMPU_METHOD Compu_FRO_fuelclear_ms " " RAT_FUNC "%.0" "ms" COEFFS 0 1 0 0 0 1 /end COMPU_METHOD
/begin MEASUREMENT inj1_on_samp "Injector 1 on low-side" UWORD Compu_inj1_on_samp 0 0 0 55.0125915750916 ECU_ADDRESS 0x01006A90 /end MEASUREMENT
/begin COMPU_METHOD Compu_inj1_on_samp " " RAT_FUNC "%.1" "volts" COEFFS 0 1191.27272727273 0 0 0 1 /end COMPU_METHOD
/begin MEASUREMENT inj2_on_samp "2" UWORD Compu_inj2_on_samp 0 0 0 55.0125915750916 ECU_ADDRESS 0x01006A98 /end MEASUREMENT
/begin COMPU_METHOD Compu_inj2_on_samp " " RAT_FUNC "%.1" "volts" COEFFS 0 1191.27272727273 0 0 0 1 /end COMPU_METHOD
/begin MEASUREMENT inj3_on_samp "3" UWORD Compu_inj3_on_samp 0 0 0 55.0125915750916 ECU_ADDRESS 0x01006AA0 /end MEASUREMENT
/begin COMPU_METHOD Compu_inj3_on_samp " " RAT_FUNC "%.1" "volts" COEFFS 0 1191.27272727273 0 0 0 1 /end COMPU_METHOD
/begin MEASUREMENT inj4_on_samp "4" UWORD Compu_inj4_on_samp 0 0 0 55.0125915750916 ECU_ADDRESS 0x01006AA8 /end MEASUREMENT
/begin COMPU_METHOD Compu_inj4_on_samp " " RAT_FUNC "%.1" "volts" COEFFS 0 1191.27272727273 0 0 0 1 /end COMPU_METHOD
/begin MEASUREMENT inj5_on_samp "5" UWORD Compu_inj5_on_samp 0 0 0 55.0125915750916 ECU_ADDRESS 0x01006AB0 /end MEASUREMENT
/begin COMPU_METHOD Compu_inj5_on_samp " " RAT_FUNC "%.1" "volts" COEFFS 0 1191.27272727273 0 0 0 1 /end COMPU_METHOD
/begin MEASUREMENT inj6_on_samp "6" UWORD Compu_inj6_on_samp 0 0 0 55.0125915750916 ECU_ADDRESS 0x01006AB8 /end MEASUREMENT
/begin COMPU_METHOD Compu_inj6_on_samp " " RAT_FUNC "%.1" "volts" COEFFS 0 1191.27272727273 0 0 0 1 /end COMPU_METHOD
/begin MEASUREMENT inj7_on_samp "7" UWORD Compu_inj7_on_samp 0 0 0 55.0125915750916 ECU_ADDRESS 0x01006AC0 /end MEASUREMENT
/begin COMPU_METHOD Compu_inj7_on_samp " " RAT_FUNC "%.1" "volts" COEFFS 0 1191.27272727273 0 0 0 1 /end COMPU_METHOD
/begin MEASUREMENT inj8_on_samp "8" UWORD Compu_inj8_on_samp 0 0 0 55.0125915750916 ECU_ADDRESS 0x01006AC8 /end MEASUREMENT
/begin COMPU_METHOD Compu_inj8_on_samp " " RAT_FUNC "%.1" "volts" COEFFS 0 1191.27272727273 0 0 0 1 /end COMPU_METHOD
/begin MEASUREMENT inj9_on_samp "9" UWORD Compu_inj9_on_samp 0 0 0 55.0125915750916 ECU_ADDRESS 0x01006AD0 /end MEASUREMENT
/begin COMPU_METHOD Compu_inj9_on_samp " " RAT_FUNC "%.1" "volts" COEFFS 0 1191.27272727273 0 0 0 1 /end COMPU_METHOD
/begin MEASUREMENT inj10_on_samp "10" UWORD Compu_inj10_on_samp 0 0 0 55.0125915750916 ECU_ADDRESS 0x01006AD8 /end MEASUREMENT
/begin COMPU_METHOD Compu_inj10_on_samp " " RAT_FUNC "%.1" "volts" COEFFS 0 1191.27272727273 0 0 0 1 /end COMPU_METHOD
/begin MEASUREMENT inj1_off_samp "Injector 1 off low-side" UWORD Compu_inj1_off_samp 0 0 0 55.0125915750916 ECU_ADDRESS 0x01006AE0 /end MEASUREMENT
/begin COMPU_METHOD Compu_inj1_off_samp " " RAT_FUNC "%.1" "volts" COEFFS 0 1191.27272727273 0 0 0 1 /end COMPU_METHOD
/begin MEASUREMENT inj2_off_samp "2" UWORD Compu_inj2_off_samp 0 0 0 55.0125915750916 ECU_ADDRESS 0x01006AE8 /end MEASUREMENT
/begin COMPU_METHOD Compu_inj2_off_samp " " RAT_FUNC "%.1" "volts" COEFFS 0 1191.27272727273 0 0 0 1 /end COMPU_METHOD
/begin MEASUREMENT inj3_off_samp "3" UWORD Compu_inj3_off_samp 0 0 0 55.0125915750916 ECU_ADDRESS 0x01006AF0 /end MEASUREMENT
/begin COMPU_METHOD Compu_inj3_off_samp " " RAT_FUNC "%.1" "volts" COEFFS 0 1191.27272727273 0 0 0 1 /end COMPU_METHOD
/begin MEASUREMENT inj4_off_samp "4" UWORD Compu_inj4_off_samp 0 0 0 55.0125915750916 ECU_ADDRESS 0x01006AF8 /end MEASUREMENT
/begin COMPU_METHOD Compu_inj4_off_samp " " RAT_FUNC "%.1" "volts" COEFFS 0 1191.27272727273 0 0 0 1 /end COMPU_METHOD
/begin MEASUREMENT inj5_off_samp "5" UWORD Compu_inj5_off_samp 0 0 0 55.0125915750916 ECU_ADDRESS 0x01006B00 /end MEASUREMENT
/begin COMPU_METHOD Compu_inj5_off_samp " " RAT_FUNC "%.1" "volts" COEFFS 0 1191.27272727273 0 0 0 1 /end COMPU_METHOD
/begin MEASUREMENT inj6_off_samp "6" UWORD Compu_inj6_off_samp 0 0 0 55.0125915750916 ECU_ADDRESS 0x01006B08 /end MEASUREMENT
/begin COMPU_METHOD Compu_inj6_off_samp " " RAT_FUNC "%.1" "volts" COEFFS 0 1191.27272727273 0 0 0 1 /end COMPU_METHOD
/begin MEASUREMENT inj7_off_samp "7" UWORD Compu_inj7_off_samp 0 0 0 55.0125915750916 ECU_ADDRESS 0x01006B10 /end MEASUREMENT
/begin COMPU_METHOD Compu_inj7_off_samp " " RAT_FUNC "%.1" "volts" COEFFS 0 1191.27272727273 0 0 0 1 /end COMPU_METHOD
/begin MEASUREMENT inj8_off_samp "8" UWORD Compu_inj8_off_samp 0 0 0 55.0125915750916 ECU_ADDRESS 0x01006B18 /end MEASUREMENT
/begin COMPU_METHOD Compu_inj8_off_samp " " RAT_FUNC "%.1" "volts" COEFFS 0 1191.27272727273 0 0 0 1 /end COMPU_METHOD
/begin MEASUREMENT inj9_off_samp "9" UWORD Compu_inj9_off_samp 0 0 0 55.0125915750916 ECU_ADDRESS 0x01006B20 /end MEASUREMENT
/begin COMPU_METHOD Compu_inj9_off_samp " " RAT_FUNC "%.1" "volts" COEFFS 0 1191.27272727273 0 0 0 1 /end COMPU_METHOD
/begin MEASUREMENT inj10_off_samp "10" UWORD Compu_inj10_off_samp 0 0 0 55.0125915750916 ECU_ADDRESS 0x01006B28 /end MEASUREMENT
/begin COMPU_METHOD Compu_inj10_off_samp " " RAT_FUNC "%.1" "volts" COEFFS 0 1191.27272727273 0 0 0 1 /end COMPU_METHOD
/begin MEASUREMENT inj1_last_falling "Injection 1 last EOI" SWORD Compu_inj1_last_falling 0 0 -2048 2047.9375 ECU_ADDRESS 0x01007148 /end MEASUREMENT
/begin COMPU_METHOD Compu_inj1_last_falling " " RAT_FUNC "%.1" "CAD BBDCI" COEFFS 0 16 0 0 0 1 /end COMPU_METHOD
/begin MEASUREMENT inj2_last_falling "Injection 2 last EOI" SWORD Compu_inj2_last_falling 0 0 -2048 2047.9375 ECU_ADDRESS 0x01007150 /end MEASUREMENT
/begin COMPU_METHOD Compu_inj2_last_falling " " RAT_FUNC "%.1" "CAD BBDCI" COEFFS 0 16 0 0 0 1 /end COMPU_METHOD
/begin MEASUREMENT inj3_last_falling "Injection 3 last EOI" SWORD Compu_inj3_last_falling 0 0 -2048 2047.9375 ECU_ADDRESS 0x01007158 /end MEASUREMENT
/begin COMPU_METHOD Compu_inj3_last_falling " " RAT_FUNC "%.1" "CAD BBDCI" COEFFS 0 16 0 0 0 1 /end COMPU_METHOD
/begin MEASUREMENT inj4_last_falling "Injection 4 last EOI" SWORD Compu_inj4_last_falling 0 0 -2048 2047.9375 ECU_ADDRESS 0x01007160 /end MEASUREMENT
/begin COMPU_METHOD Compu_inj4_last_falling " " RAT_FUNC "%.1" "CAD BBDCI" COEFFS 0 16 0 0 0 1 /end COMPU_METHOD
/begin MEASUREMENT inj5_last_falling "Injection 5 last EOI" SWORD Compu_inj5_last_falling 0 0 -2048 2047.9375 ECU_ADDRESS 0x01007168 /end MEASUREMENT
/begin COMPU_METHOD Compu_inj5_last_falling " " RAT_FUNC "%.1" "CAD BBDCI" COEFFS 0 16 0 0 0 1 /end COMPU_METHOD
/begin MEASUREMENT inj6_last_falling "Injection 6 last EOI" SWORD Compu_inj6_last_falling 0 0 -2048 2047.9375 ECU_ADDRESS 0x01007170 /end MEASUREMENT
/begin COMPU_METHOD Compu_inj6_last_falling " " RAT_FUNC "%.1" "CAD BBDCI" COEFFS 0 16 0 0 0 1 /end COMPU_METHOD
/begin MEASUREMENT inj7_last_falling "Injection 7 last EOI" SWORD Compu_inj7_last_falling 0 0 -2048 2047.9375 ECU_ADDRESS 0x01007178 /end MEASUREMENT
/begin COMPU_METHOD Compu_inj7_last_falling " " RAT_FUNC "%.1" "CAD BBDCI" COEFFS 0 16 0 0 0 1 /end COMPU_METHOD
/begin MEASUREMENT inj8_last_falling "Injection 8 last EOI" SWORD Compu_inj8_last_falling 0 0 -2048 2047.9375 ECU_ADDRESS 0x01007180 /end MEASUREMENT
/begin COMPU_METHOD Compu_inj8_last_falling " " RAT_FUNC "%.1" "CAD BBDCI" COEFFS 0 16 0 0 0 1 /end COMPU_METHOD
/begin MEASUREMENT inj9_last_falling "Injection 9 last EOI" SWORD Compu_inj9_last_falling 0 0 -2048 2047.9375 ECU_ADDRESS 0x010071C0 /end MEASUREMENT
/begin COMPU_METHOD Compu_inj9_last_falling " " RAT_FUNC "%.1" "CAD BBDCI" COEFFS 0 16 0 0 0 1 /end COMPU_METHOD
/begin MEASUREMENT inj10_last_falling "Injection 10 last EOI" SWORD Compu_inj10_last_falling 0 0 -2048 2047.9375 ECU_ADDRESS 0x010071C8 /end MEASUREMENT
/begin COMPU_METHOD Compu_inj10_last_falling " " RAT_FUNC "%.1" "CAD BBDCI" COEFFS 0 16 0 0 0 1 /end COMPU_METHOD
/begin CHARACTERISTIC LOCKOFF_hold_wait "Gaseous lockoff hold duty-cycle wait" VALUE 0x00147562 /* @ECU_Address@LOCKOFF_hold_wait@0x01007840@ */ ECIPP_ALIGNMENT_UWORD 66 Compu_LOCKOFF_hold_wait 0 65.535 /end CHARACTERISTIC
/begin COMPU_METHOD Compu_LOCKOFF_hold_wait " " RAT_FUNC "%.1" "sec" COEFFS 0 1000 0 0 0 1 /end COMPU_METHOD
/begin CHARACTERISTIC LOCKOFF_hold_DC "Gaseous lockoff hold duty-cycle" VALUE 0x00147560 /* @ECU_Address@LOCKOFF_hold_DC@0x01007848@ */ ECIPP_ALIGNMENT_UWORD 100 Compu_LOCKOFF_hold_DC 0 99.9984741210938 /end CHARACTERISTIC
/begin COMPU_METHOD Compu_LOCKOFF_hold_DC " " RAT_FUNC "%.1" "%" COEFFS 0 655.36 0 0 0 1 /end COMPU_METHOD
/begin CHARACTERISTIC CRI_V_boost "Boost voltage" VALUE 0x0016c7d4 /* @ECU_Address@CRI_V_boost@0x01008808@ */ ECIPP_ALIGNMENT_UWORD 1024 Compu_CRI_V_boost 0 1023.984375 /end CHARACTERISTIC
/begin COMPU_METHOD Compu_CRI_V_boost " " RAT_FUNC "%.1" "volts" COEFFS 0 64 0 0 0 1 /end COMPU_METHOD
/begin CHARACTERISTIC CRI_i_peak "Peak current" VALUE 0x0016c7e2 /* @ECU_Address@CRI_i_peak@0x01008818@ */ ECIPP_ALIGNMENT_UWORD 128 Compu_CRI_i_peak 0 127.998046875 /end CHARACTERISTIC
/begin COMPU_METHOD Compu_CRI_i_peak " " RAT_FUNC "%.1" "amps" COEFFS 0 512 0 0 0 1 /end COMPU_METHOD
/begin CHARACTERISTIC CRI_i_hold "Hold current" VALUE 0x0016c7de /* @ECU_Address@CRI_i_hold@0x01008820@ */ ECIPP_ALIGNMENT_UWORD 128 Compu_CRI_i_hold 0 127.998046875 /end CHARACTERISTIC
/begin COMPU_METHOD Compu_CRI_i_hold " " RAT_FUNC "%.1" "amps" COEFFS 0 512 0 0 0 1 /end COMPU_METHOD
/begin CHARACTERISTIC CRI_i_hys "Peak/Hold hysteresis" VALUE 0x0016c7e0 /* @ECU_Address@CRI_i_hys@0x01008828@ */ ECIPP_ALIGNMENT_UWORD 128 Compu_CRI_i_hys 0 127.998046875 /end CHARACTERISTIC
/begin COMPU_METHOD Compu_CRI_i_hys " " RAT_FUNC "%.2" "amps" COEFFS 0 512 0 0 0 1 /end COMPU_METHOD
/begin CHARACTERISTIC CRI_i_recharge "Boost recharge current" VALUE 0x0016c7e6 /* @ECU_Address@CRI_i_recharge@0x01008830@ */ ECIPP_ALIGNMENT_UWORD 128 Compu_CRI_i_recharge 0 127.998046875 /end CHARACTERISTIC
/begin COMPU_METHOD Compu_CRI_i_recharge " " RAT_FUNC "%.1" "amps" COEFFS 0 512 0 0 0 1 /end COMPU_METHOD
/begin CHARACTERISTIC CRI_i_HS_short "High-side short current" VALUE 0x0016c7da /* @ECU_Address@CRI_i_HS_short@0x01008838@ */ ECIPP_ALIGNMENT_UWORD 128 Compu_CRI_i_HS_short 0 127.998046875 /end CHARACTERISTIC
/begin COMPU_METHOD Compu_CRI_i_HS_short " " RAT_FUNC "%.1" "amps" COEFFS 0 512 0 0 0 1 /end COMPU_METHOD
/begin CHARACTERISTIC CRI_i_LS_short "Low-side short current" VALUE 0x0016c7dc /* @ECU_Address@CRI_i_LS_short@0x01008840@ */ ECIPP_ALIGNMENT_UWORD 128 Compu_CRI_i_LS_short 0 127.998046875 /end CHARACTERISTIC
/begin COMPU_METHOD Compu_CRI_i_LS_short " " RAT_FUNC "%.1" "amps" COEFFS 0 512 0 0 0 1 /end COMPU_METHOD
/begin CHARACTERISTIC CRI_peak_time_min "Peak min time" VALUE 0x0016c7ec /* @ECU_Address@CRI_peak_time_min@0x01008848@ */ ECIPP_ALIGNMENT_UWORD 3277 Compu_CRI_peak_time_min 0 3276.75 /end CHARACTERISTIC
/begin COMPU_METHOD Compu_CRI_peak_time_min " " RAT_FUNC "%.0" "us" COEFFS 0 20 0 0 0 1 /end COMPU_METHOD
/begin CHARACTERISTIC CRI_peak_time_max "Peak max time" VALUE 0x0016c7ea /* @ECU_Address@CRI_peak_time_max@0x01008850@ */ ECIPP_ALIGNMENT_UWORD 3277 Compu_CRI_peak_time_max 0 3276.75 /end CHARACTERISTIC
/begin COMPU_METHOD Compu_CRI_peak_time_max " " RAT_FUNC "%.0" "us" COEFFS 0 20 0 0 0 1 /end COMPU_METHOD
/begin CHARACTERISTIC CRI_hold_decay "Hold current decay" VALUE 0x0016c7d8 /* @ECU_Address@CRI_hold_decay@0x01008858@ */ ECIPP_ALIGNMENT_UWORD 3277 Compu_CRI_hold_decay 0 3276.75 /end CHARACTERISTIC
/begin COMPU_METHOD Compu_CRI_hold_decay " " RAT_FUNC "%.0" "us" COEFFS 0 20 0 0 0 1 /end COMPU_METHOD
/begin CHARACTERISTIC CRI_lift_pump_ena "Low-pressure lift pump output{CRI_lift_pump_ena&0xff=0:Disabled}{CRI_lift_pump_ena&0xff=1:Buzzer Output}{CRI_lift_pump_ena&0xff=2:MIL Output}{CRI_lift_pump_ena&0xff=3:TACH Output}{CRI_lift_pump_ena&0xff=4:Starter Output}{CRI_lift_pump_ena&0xff=5:EGOH1}{CR" VALUE 0x0016c834 /* @ECU_Address@CRI_lift_pump_ena@0x01008860@ */ ECIPP_ALIGNMENT_UBYTE 255 CRI_lift_pump_ena_COMPU_VTAB 0 255 BIT_MASK 0xff /end CHARACTERISTIC
/begin COMPU_METHOD CRI_lift_pump_ena_COMPU_VTAB "Verbal Table" TAB_VERB "%.0" "list" COMPU_TAB_REF CRI_lift_pump_ena_COMPU_VTAB_REF /end COMPU_METHOD
/begin COMPU_VTAB CRI_lift_pump_ena_COMPU_VTAB_REF "Verbal Table" TAB_VERB 32 0 "Disabled" 1 "Buzzer Output" 2 "MIL Output" 3 "TACH Output" 4 "Starter Output" 5 "EGOH1" 6 "EGOH2" 7 "EGOH3" 8 "EGOH4" 9 "Aux PWM1" 10 "Aux PWM2" 11 "Aux PWM3" 12 "Aux PWM4" 13 "Aux PWM5" 14 "Aux PWM6" 15 "Aux PWM7" 16 "Aux PWM8" 17 "Aux PWM9" 18 "Aux PWM10" 19 "Aux PWM11" 20 "Aux PWM12" 21 "Aux PWM13" 22 "Aux PWM14" 23 "Aux PWM15" 24 "Aux PWM16" 25 "Aux PWM17" 26 "Aux PWM18" 27 "Aux PWM19" 28 "Aux PWM20" 29 "Aux PWM21" 30 "Aux PWM22" 31 "Aux PWM23" DEFAULT_VALUE "UNKNOWN" /end COMPU_VTAB
/begin CHARACTERISTIC CRI_IMV_ena "IMV (inlet metering valve){CRI_IMV_ena&0xff=0:Disabled}{CRI_IMV_ena&0xff=1:Aux PWM8 i-control}{CRI_IMV_ena&0xff=2:Aux PWM9 i-control}" VALUE 0x0016c82a /* @ECU_Address@CRI_IMV_ena@0x01008868@ */ ECIPP_ALIGNMENT_UBYTE 255 CRI_IMV_ena_COMPU_VTAB 0 255 BIT_MASK 0xff /end CHARACTERISTIC
/begin COMPU_METHOD CRI_IMV_ena_COMPU_VTAB "Verbal Table" TAB_VERB "%.0" "list" COMPU_TAB_REF CRI_IMV_ena_COMPU_VTAB_REF /end COMPU_METHOD
/begin COMPU_VTAB CRI_IMV_ena_COMPU_VTAB_REF "Verbal Table" TAB_VERB 3 0 "Disabled" 1 "Aux PWM8 i-control" 2 "Aux PWM9 i-control" DEFAULT_VALUE "UNKNOWN" /end COMPU_VTAB
/begin CHARACTERISTIC CRI_IMVp_Kp "IMV rail pressure Kp gain" VALUE 0x0016c448 /* @ECU_Address@CRI_IMVp_Kp@0x01008870@ */ ECIPP_ALIGNMENT_FLOAT32_IEEE 10000000000 Compu_CRI_IMVp_Kp -10000000000 10000000000 /end CHARACTERISTIC
/begin COMPU_METHOD Compu_CRI_IMVp_Kp " " RAT_FUNC "%.1" "CTLunits/Kbar" COEFFS 0 1 0 0 0 1 /end COMPU_METHOD
/begin CHARACTERISTIC CRI_IMVp_Ki "IMV rail pressure Ki gain" VALUE 0x0016c444 /* @ECU_Address@CRI_IMVp_Ki@0x01008878@ */ ECIPP_ALIGNMENT_FLOAT32_IEEE 10000000000 Compu_CRI_IMVp_Ki -10000000000 10000000000 /end CHARACTERISTIC
/begin COMPU_METHOD Compu_CRI_IMVp_Ki " " RAT_FUNC "%.1" "CTLunits/Kbar/sec" COEFFS 0 1 0 0 0 1 /end COMPU_METHOD
/begin CHARACTERISTIC CRI_IMVp_Kd "IMV rail pressure Kd gain" VALUE 0x0016c440 /* @ECU_Address@CRI_IMVp_Kd@0x01008880@ */ ECIPP_ALIGNMENT_FLOAT32_IEEE 10000000000 Compu_CRI_IMVp_Kd -10000000000 10000000000 /end CHARACTERISTIC
/begin COMPU_METHOD Compu_CRI_IMVp_Kd " " RAT_FUNC "%.1" "CTLunits/(Kbar/sec)" COEFFS 0 1 0 0 0 1 /end COMPU_METHOD
/begin MEASUREMENT CRI_Prail_target "Rail pressure final target" UWORD Compu_CRI_Prail_target 0 0 0 8191.875 ECU_ADDRESS 0x01008888 /end MEASUREMENT
/begin COMPU_METHOD Compu_CRI_Prail_target " " RAT_FUNC "%.0" "bar" COEFFS 0 8 0 0 0 1 /end COMPU_METHOD
/begin CHARACTERISTIC CRI_Prail_ena "Rail pressure sensor{CRI_Prail_ena&0xff=0:Disabled}{CRI_Prail_ena&0xff=1:Aux PU1}{CRI_Prail_ena&0xff=2:Aux PU2}{CRI_Prail_ena&0xff=3:Aux PU3}{CRI_Prail_ena&0xff=4:Aux PD1}{CRI_Prail_ena&0xff=5:Aux PD2}{CRI_Prail_ena&0xff=6:Aux PD3}{CRI_Prail_ena&0xff=7:Au" VALUE 0x0016c831 /* @ECU_Address@CRI_Prail_ena@0x010088E8@ */ ECIPP_ALIGNMENT_UBYTE 255 CRI_Prail_ena_COMPU_VTAB 0 255 BIT_MASK 0xff /end CHARACTERISTIC
/begin COMPU_METHOD CRI_Prail_ena_COMPU_VTAB "Verbal Table" TAB_VERB "%.0" "list" COMPU_TAB_REF CRI_Prail_ena_COMPU_VTAB_REF /end COMPU_METHOD
/begin COMPU_VTAB CRI_Prail_ena_COMPU_VTAB_REF "Verbal Table" TAB_VERB 36 0 "Disabled" 1 "Aux PU1" 2 "Aux PU2" 3 "Aux PU3" 4 "Aux PD1" 5 "Aux PD2" 6 "Aux PD3" 7 "Aux PUD1" 8 "Aux PUD2" 9 "Aux PUD3" 10 "Aux PUD4" 11 "Aux PUD5" 12 "Aux PUD6" 13 "Aux PUD7" 14 "Aux PUD8" 15 "Aux PUD9" 16 "Aux PUD10" 17 "Aux PUD11" 18 "Aux PUD12" 19 "Aux PUD13" 20 "Aux PUD14" 21 "Aux PUD15" 22 "Aux PUD16" 23 "Aux PUD17" 24 "Aux PUD18" 25 "Aux PUD19" 26 "Aux PUD20" 27 "Aux PUD21" 28 "Aux PUD22" 29 "Aux PUD23" 30 "Aux PUD24" 31 "Aux PUD25" 32 "SENT1 Data1" 33 "SENT1 Data2" 34 "SENT2 Data1" 35 "SENT2 Data2" DEFAULT_VALUE "UNKNOWN" /end COMPU_VTAB
/begin CHARACTERISTIC CRI_IMV_ohms_nom "IMV resistance R nominal" VALUE 0x0016c7be /* @ECU_Address@CRI_IMV_ohms_nom@0x010089C8@ */ ECIPP_ALIGNMENT_UWORD 64 Compu_CRI_IMV_ohms_nom 0 63.9990234375 /end CHARACTERISTIC
/begin COMPU_METHOD Compu_CRI_IMV_ohms_nom " " RAT_FUNC "%.2" "ohms" COEFFS 0 1024 0 0 0 1 /end COMPU_METHOD
/begin CHARACTERISTIC CRI_IMV_mH "IMV inductance L" VALUE 0x0016c7bc /* @ECU_Address@CRI_IMV_mH@0x010089D0@ */ ECIPP_ALIGNMENT_UWORD 64 Compu_CRI_IMV_mH 0 63.9990234375 /end CHARACTERISTIC
/begin COMPU_METHOD Compu_CRI_IMV_mH " " RAT_FUNC "%.2" "mH" COEFFS 0 1024 0 0 0 1 /end COMPU_METHOD
/begin CHARACTERISTIC CRI_Prail_edot_n "Rail pressure edot interpolation" VALUE 0x0016c830 /* @ECU_Address@CRI_Prail_edot_n@0x010089E0@ */ ECIPP_ALIGNMENT_UBYTE 255 Compu_CRI_Prail_edot_n 0 255 /end CHARACTERISTIC
/begin COMPU_METHOD Compu_CRI_Prail_edot_n " " RAT_FUNC "%.0" "ms" COEFFS 0 1 0 0 0 1 /end COMPU_METHOD
/begin CHARACTERISTIC CRI_Prail_edot_LP "Rail pressure edot low-pass filter" VALUE 0x0016c824 /* @ECU_Address@CRI_Prail_edot_LP@0x010089E8@ */ ECIPP_ALIGNMENT_UWORD 65536 Compu_CRI_Prail_edot_LP 0.090168 65536 /end CHARACTERISTIC
/begin COMPU_METHOD Compu_CRI_Prail_edot_LP " " FORM "%.1" "ms"
 /begin FORMULA "-1 / log(1 - (X1 / 65536))" FORMULA_INV "(1 - exp(-1/X1)) * 65536" /end FORMULA
/end COMPU_METHOD
/begin MEASUREMENT CRI_Prail_edot "Rail pressure error derivative" FLOAT32_IEEE Compu_CRI_Prail_edot 0 0 -10000000000 10000000000 ECU_ADDRESS 0x010089F0 /end MEASUREMENT
/begin COMPU_METHOD Compu_CRI_Prail_edot " " RAT_FUNC "%.2" "Kbar/sec" COEFFS 0 1 0 0 0 1 /end COMPU_METHOD
/begin CHARACTERISTIC CRI_IMVp_acc_max "IMV rail pressure accum max" VALUE 0x0016c44c /* @ECU_Address@CRI_IMVp_acc_max@0x010089F8@ */ ECIPP_ALIGNMENT_FLOAT32_IEEE 10000000000 Compu_CRI_IMVp_acc_max -10000000000 10000000000 /end CHARACTERISTIC
/begin COMPU_METHOD Compu_CRI_IMVp_acc_max " " RAT_FUNC "%.2" "CTLunits" COEFFS 0 1 0 0 0 1 /end COMPU_METHOD
/begin CHARACTERISTIC CRI_IMVp_acc_min "IMV rail pressure accum min" VALUE 0x0016c450 /* @ECU_Address@CRI_IMVp_acc_min@0x01008A00@ */ ECIPP_ALIGNMENT_FLOAT32_IEEE 10000000000 Compu_CRI_IMVp_acc_min -10000000000 10000000000 /end CHARACTERISTIC
/begin COMPU_METHOD Compu_CRI_IMVp_acc_min " " RAT_FUNC "%.2" "CTLunits" COEFFS 0 1 0 0 0 1 /end COMPU_METHOD
/begin MEASUREMENT CRI_IMVi_cmd "IMV i-command final" UWORD Compu_CRI_IMVi_cmd 0 0 0 63.9990234375 ECU_ADDRESS 0x01008A18 /end MEASUREMENT
/begin COMPU_METHOD Compu_CRI_IMVi_cmd " " RAT_FUNC "%.2" "amps" COEFFS 0 1024 0 0 0 1 /end COMPU_METHOD
/begin MEASUREMENT CRI_IMVd_imag "IMV dither amplitude" UWORD Compu_CRI_IMVd_imag 0 0 0 63.9990234375 ECU_ADDRESS 0x01008A20 /end MEASUREMENT
/begin COMPU_METHOD Compu_CRI_IMVd_imag " " RAT_FUNC "%.2" "amps" COEFFS 0 1024 0 0 0 1 /end COMPU_METHOD
/begin MEASUREMENT CRI_IMVd_fHz "IMV dither frequency" UWORD Compu_CRI_IMVd_fHz 0 0 0 4095.9375 ECU_ADDRESS 0x01008A28 /end MEASUREMENT
/begin COMPU_METHOD Compu_CRI_IMVd_fHz " " RAT_FUNC "%.1" "Hz" COEFFS 0 16 0 0 0 1 /end COMPU_METHOD
/begin CHARACTERISTIC CRI_IMV_Vdiode "IMV recirc diode drop" VALUE 0x0016c7ba /* @ECU_Address@CRI_IMV_Vdiode@0x01008A30@ */ ECIPP_ALIGNMENT_UWORD 256 Compu_CRI_IMV_Vdiode 0 255.99609375 /end CHARACTERISTIC
/begin COMPU_METHOD Compu_CRI_IMV_Vdiode " " RAT_FUNC "%.2" "volts" COEFFS 0 256 0 0 0 1 /end COMPU_METHOD
/begin CHARACTERISTIC CRI_IMV_ohms_Ki "IMV resistance R gain" VALUE 0x0016c42c /* @ECU_Address@CRI_IMV_ohms_Ki@0x01008A40@ */ ECIPP_ALIGNMENT_FLOAT32_IEEE 10000000000 Compu_CRI_IMV_ohms_Ki -10000000000 10000000000 /end CHARACTERISTIC
/begin COMPU_METHOD Compu_CRI_IMV_ohms_Ki " " RAT_FUNC "%.2" "ohms/amp/sec" COEFFS 0 1 0 0 0 1 /end COMPU_METHOD
/begin MEASUREMENT CRI_IMV_ohms "IMV resistance R estimate" FLOAT32_IEEE Compu_CRI_IMV_ohms 0 0 -10000000000 10000000000 ECU_ADDRESS 0x01008BE0 /end MEASUREMENT
/begin COMPU_METHOD Compu_CRI_IMV_ohms " " RAT_FUNC "%.2" "ohms" COEFFS 0 1 0 0 0 1 /end COMPU_METHOD
/begin CHARACTERISTIC CRI_IMV_ohms_min "IMV resistance R min" VALUE 0x0016c434 /* @ECU_Address@CRI_IMV_ohms_min@0x01008BE8@ */ ECIPP_ALIGNMENT_FLOAT32_IEEE 10000000000 Compu_CRI_IMV_ohms_min -10000000000 10000000000 /end CHARACTERISTIC
/begin COMPU_METHOD Compu_CRI_IMV_ohms_min " " RAT_FUNC "%.2" "ohms" COEFFS 0 1 0 0 0 1 /end COMPU_METHOD
/begin CHARACTERISTIC CRI_IMV_ohms_max "IMV resistance R max" VALUE 0x0016c430 /* @ECU_Address@CRI_IMV_ohms_max@0x01008BF0@ */ ECIPP_ALIGNMENT_FLOAT32_IEEE 10000000000 Compu_CRI_IMV_ohms_max -10000000000 10000000000 /end CHARACTERISTIC
/begin COMPU_METHOD Compu_CRI_IMV_ohms_max " " RAT_FUNC "%.2" "ohms" COEFFS 0 1 0 0 0 1 /end COMPU_METHOD
/begin CHARACTERISTIC CRI_PCV_ena "PCV (pressure control valve){CRI_PCV_ena&0xff=0:Disabled}{CRI_PCV_ena&0xff=1:Aux PWM8 i-control}{CRI_PCV_ena&0xff=2:Aux PWM9 i-control}" VALUE 0x0016c82e /* @ECU_Address@CRI_PCV_ena@0x01008C20@ */ ECIPP_ALIGNMENT_UBYTE 255 CRI_PCV_ena_COMPU_VTAB 0 255 BIT_MASK 0xff /end CHARACTERISTIC
/begin COMPU_METHOD CRI_PCV_ena_COMPU_VTAB "Verbal Table" TAB_VERB "%.0" "list" COMPU_TAB_REF CRI_PCV_ena_COMPU_VTAB_REF /end COMPU_METHOD
/begin COMPU_VTAB CRI_PCV_ena_COMPU_VTAB_REF "Verbal Table" TAB_VERB 3 0 "Disabled" 1 "Aux PWM8 i-control" 2 "Aux PWM9 i-control" DEFAULT_VALUE "UNKNOWN" /end COMPU_VTAB
/begin MEASUREMENT fuel_trip_gas "Gaseous trip fuel" ULONG Compu_fuel_trip_gas 0 0 0 2147483647.5 ECU_ADDRESS 0x01008C88 /end MEASUREMENT
/begin COMPU_METHOD Compu_fuel_trip_gas " " RAT_FUNC "%.1" "kg" COEFFS 0 2 0 0 0 1 /end COMPU_METHOD
/begin CHARACTERISTIC FPin_a_I2 "Sec fuel rail pressure target" VALUE 0x00149084 /* @ECU_Address@FPin_a_I2@0x01009130@ */ ECIPP_ALIGNMENT_UWORD 256 Compu_FPin_a_I2 0 255.99609375 /end CHARACTERISTIC
/begin COMPU_METHOD Compu_FPin_a_I2 " " RAT_FUNC "%.1" "psia" COEFFS 0 256 0 0 0 1 /end COMPU_METHOD
/begin CHARACTERISTIC async_inj_ena_I2 "Sec Asynchronous Injection{async_inj_ena_I2&0xff=0x00:OFF}{async_inj_ena_I2&0xff=0x01:ON}" VALUE 0x0014909D /* @ECU_Address@async_inj_ena_I2@0x01009168@ */ ECIPP_ALIGNMENT_UBYTE 255 async_inj_ena_I2_COMPU_VTAB 0 255 BIT_MASK 0xff /end CHARACTERISTIC
/begin COMPU_METHOD async_inj_ena_I2_COMPU_VTAB "Verbal Table" TAB_VERB "%.0" "list" COMPU_TAB_REF async_inj_ena_I2_COMPU_VTAB_REF /end COMPU_METHOD
/begin COMPU_VTAB async_inj_ena_I2_COMPU_VTAB_REF "Verbal Table" TAB_VERB 2 0x00 "OFF" 0x01 "ON" DEFAULT_VALUE "UNKNOWN" /end COMPU_VTAB
/begin CHARACTERISTIC Ginj_peak_offset_I2 "Sec peak off-time offset" VALUE 0x001490A2 /* @ECU_Address@Ginj_peak_offset_I2@0x010091A8@ */ ECIPP_ALIGNMENT_UWORD 210 Compu_Ginj_peak_offset_I2 0 209.712 /end CHARACTERISTIC
/begin COMPU_METHOD Compu_Ginj_peak_offset_I2 " " RAT_FUNC "%.3" "ms" COEFFS 0 312.5 0 0 0 1 /end COMPU_METHOD
/begin CHARACTERISTIC inj_timing_dz_I2 "Sec injection timing dead-zone" VALUE 0x00149094 /* @ECU_Address@inj_timing_dz_I2@0x010091E8@ */ ECIPP_ALIGNMENT_SWORD 2048 Compu_inj_timing_dz_I2 -2048 2047.9375 /end CHARACTERISTIC
/begin COMPU_METHOD Compu_inj_timing_dz_I2 " " RAT_FUNC "%.0" "CAD" COEFFS 0 16 0 0 0 1 /end COMPU_METHOD
/begin CHARACTERISTIC inj_timing_dz_tau_I2 "Sec injection timing dead-zone tau" VALUE 0x00149096 /* @ECU_Address@inj_timing_dz_tau_I2@0x010091F0@ */ ECIPP_ALIGNMENT_UWORD 163840 Compu_inj_timing_dz_tau_I2 0.16703 163840 /end CHARACTERISTIC
/begin COMPU_METHOD Compu_inj_timing_dz_tau_I2 " " FORM "%.0" "ms"
 /begin FORMULA "-5 / log(1.0000000000001 - (X1 / 32768))" FORMULA_INV "(1.0000000000001 - exp(-5/X1)) * 32768" /end FORMULA
/end COMPU_METHOD
/begin CHARACTERISTIC strt_inj_tmng_I2 "Start secondary injection timing" VALUE 0x00149098 /* @ECU_Address@strt_inj_tmng_I2@0x010091F8@ */ ECIPP_ALIGNMENT_SWORD 2048 Compu_strt_inj_tmng_I2 -2048 2047.9375 /end CHARACTERISTIC
/begin COMPU_METHOD Compu_strt_inj_tmng_I2 " " RAT_FUNC "%.0" "CAD BBDCI" COEFFS 0 16 0 0 0 1 /end COMPU_METHOD
/begin MEASUREMENT FPin_I2 "Secondary fuel rail pressure" UWORD Compu_FPin_I2 0 0 0 255.99609375 ECU_ADDRESS 0x01009200 /end MEASUREMENT
/begin COMPU_METHOD Compu_FPin_I2 " " RAT_FUNC "%.1" "psia" COEFFS 0 256 0 0 0 1 /end COMPU_METHOD
/begin MEASUREMENT active_fuel_device "Active fuel device{active_fuel_device&0xff=0:Invalid}{active_fuel_device&0xff=1:Pulse Injection - Pri}{active_fuel_device&0xff=2:Pulse Injection - Sec}{active_fuel_device&0xff=3:Carb - MJ / EPR}{active_fuel_device&0xff=4:Carb - PWM Trim}{active_fuel_devic" UBYTE active_fuel_device_COMPU_VTAB 0 0 0 255 ECU_ADDRESS 0x01009220 BIT_MASK 0xff /end MEASUREMENT
/begin COMPU_METHOD active_fuel_device_COMPU_VTAB "Verbal Table" TAB_VERB "%.0" "list" COMPU_TAB_REF active_fuel_device_COMPU_VTAB_REF /end COMPU_METHOD
/begin COMPU_VTAB active_fuel_device_COMPU_VTAB_REF "Verbal Table" TAB_VERB 9 0 "Invalid" 1 "Pulse Injection - Pri" 2 "Pulse Injection - Sec" 3 "Carb - MJ / EPR" 4 "Carb - PWM Trim" 5 "CFV Injection" 6 "Carb - Dual EPR" 7 "MFG Injection" 8 "8 - UNKNOWN" DEFAULT_VALUE "UNKNOWN" /end COMPU_VTAB
/begin MEASUREMENT fuel_trip_liquid "Liquid trip fuel" ULONG Compu_fuel_trip_liquid 0 0 0 4294967.295 ECU_ADDRESS 0x01009260 /end MEASUREMENT
/begin COMPU_METHOD Compu_fuel_trip_liquid " " RAT_FUNC "%.3" "L" COEFFS 0 1000 0 0 0 1 /end COMPU_METHOD
/begin CHARACTERISTIC APSraw_LP "APSraw_LP" VALUE 0x00148F0E /* @ECU_Address@APSraw_LP@0x01009AB0@ */ ECIPP_ALIGNMENT_UWORD 32768 Compu_APSraw_LP 0.045084 32768 /end CHARACTERISTIC
/begin COMPU_METHOD Compu_APSraw_LP " " FORM "%.3" "ms"
 /begin FORMULA "-0.5 / log(1 - (X1 / 65536))" FORMULA_INV "(1 - exp(-0.5/X1)) * 65536" /end FORMULA
/end COMPU_METHOD
/begin CHARACTERISTIC BPSraw_LP "BPSraw_LP" VALUE 0x00148FAE /* @ECU_Address@BPSraw_LP@0x01009AB8@ */ ECIPP_ALIGNMENT_UWORD 32768 Compu_BPSraw_LP 0.045084 32768 /end CHARACTERISTIC
/begin COMPU_METHOD Compu_BPSraw_LP " " FORM "%.3" "ms"
 /begin FORMULA "-0.5 / log(1 - (X1 / 65536))" FORMULA_INV "(1 - exp(-0.5/X1)) * 65536" /end FORMULA
/end COMPU_METHOD
/begin CHARACTERISTIC AFBdt_n "AFBdt_n" VALUE 0x00148F10 /* @ECU_Address@AFBdt_n@0x01009AC0@ */ ECIPP_ALIGNMENT_UBYTE 255 Compu_AFBdt_n 0 255 /end CHARACTERISTIC
/begin COMPU_METHOD Compu_AFBdt_n " " RAT_FUNC "%.0" "ms" COEFFS 0 1 0 0 0 1 /end COMPU_METHOD
/begin CHARACTERISTIC BFBdt_n "BFBdt_n" VALUE 0x00148FB0 /* @ECU_Address@BFBdt_n@0x01009AC8@ */ ECIPP_ALIGNMENT_UBYTE 255 Compu_BFBdt_n 0 255 /end CHARACTERISTIC
/begin COMPU_METHOD Compu_BFBdt_n " " RAT_FUNC "%.0" "ms" COEFFS 0 1 0 0 0 1 /end COMPU_METHOD
/begin CHARACTERISTIC AFBdt_xLP "AFBdt_xLP" VALUE 0x00148F12 /* @ECU_Address@AFBdt_xLP@0x01009AD0@ */ ECIPP_ALIGNMENT_UWORD 32768 Compu_AFBdt_xLP 0.033406 32768 /end CHARACTERISTIC
/begin COMPU_METHOD Compu_AFBdt_xLP " " FORM "%.3" "ms"
 /begin FORMULA "-1 / log(1.0000000000001 - (X1 / 32768))" FORMULA_INV "(1.0000000000001 - exp(-1/X1)) * 32768" /end FORMULA
/end COMPU_METHOD
/begin CHARACTERISTIC BFBdt_xLP "BFBdt_xLP" VALUE 0x00148FB2 /* @ECU_Address@BFBdt_xLP@0x01009AD8@ */ ECIPP_ALIGNMENT_UWORD 32768 Compu_BFBdt_xLP 0.033406 32768 /end CHARACTERISTIC
/begin COMPU_METHOD Compu_BFBdt_xLP " " FORM "%.3" "ms"
 /begin FORMULA "-1 / log(1.0000000000001 - (X1 / 32768))" FORMULA_INV "(1.0000000000001 - exp(-1/X1)) * 32768" /end FORMULA
/end COMPU_METHOD
/begin MEASUREMENT CRI_Prail_targ_raw "Rail pressure raw target" UWORD Compu_CRI_Prail_targ_raw 0 0 0 8191.875 ECU_ADDRESS 0x0100A0E8 /end MEASUREMENT
/begin COMPU_METHOD Compu_CRI_Prail_targ_raw " " RAT_FUNC "%.0" "bar" COEFFS 0 8 0 0 0 1 /end COMPU_METHOD
/begin MEASUREMENT CRI_Prail_act_raw "Rail pressure raw actual" UWORD Compu_CRI_Prail_act_raw 0 0 0 8191.875 ECU_ADDRESS 0x0100A0F0 /end MEASUREMENT
/begin COMPU_METHOD Compu_CRI_Prail_act_raw " " RAT_FUNC "%.0" "bar" COEFFS 0 8 0 0 0 1 /end COMPU_METHOD
/begin CHARACTERISTIC CRI_ontime_min "Zero fuel pulse width" VALUE 0x0016c504 /* @ECU_Address@CRI_ontime_min@0x0100A0F8@ */ ECIPP_ALIGNMENT_ULONG 214748365 Compu_CRI_ontime_min 0 214748364.75 /end CHARACTERISTIC
/begin COMPU_METHOD Compu_CRI_ontime_min " " RAT_FUNC "%.0" "us" COEFFS 0 20 0 0 0 1 /end COMPU_METHOD
/begin CHARACTERISTIC CRI_Prail_targ_LP "Rail pressure target tau" VALUE 0x0016c826 /* @ECU_Address@CRI_Prail_targ_LP@0x0100A100@ */ ECIPP_ALIGNMENT_UWORD 65536 Compu_CRI_Prail_targ_LP 0.090168 65536 /end CHARACTERISTIC
/begin COMPU_METHOD Compu_CRI_Prail_targ_LP " " FORM "%.1" "ms"
 /begin FORMULA "-1 / log(1 - (X1 / 65536))" FORMULA_INV "(1 - exp(-1/X1)) * 65536" /end FORMULA
/end COMPU_METHOD
/begin CHARACTERISTIC CRI_Prail_act_LP "Rail pressure actual tau" VALUE 0x0016c820 /* @ECU_Address@CRI_Prail_act_LP@0x0100A108@ */ ECIPP_ALIGNMENT_UWORD 65536 Compu_CRI_Prail_act_LP 0.090168 65536 /end CHARACTERISTIC
/begin COMPU_METHOD Compu_CRI_Prail_act_LP " " FORM "%.1" "ms"
 /begin FORMULA "-1 / log(1 - (X1 / 65536))" FORMULA_INV "(1 - exp(-1/X1)) * 65536" /end FORMULA
/end COMPU_METHOD
/begin CHARACTERISTIC CRI_Prail_act_ediLP "Rail pressure actual edot tau" VALUE 0x0016c822 /* @ECU_Address@CRI_Prail_act_ediLP@0x0100A110@ */ ECIPP_ALIGNMENT_UWORD 65536 Compu_CRI_Prail_act_ediLP 0.090168 65536 /end CHARACTERISTIC
/begin COMPU_METHOD Compu_CRI_Prail_act_ediLP " " FORM "%.1" "ms"
 /begin FORMULA "-1 / log(1 - (X1 / 65536))" FORMULA_INV "(1 - exp(-1/X1)) * 65536" /end FORMULA
/end COMPU_METHOD
/begin CHARACTERISTIC CRI_IMVp_Ddz "IMV rail pressure Kd deadzone" VALUE 0x0016c438 /* @ECU_Address@CRI_IMVp_Ddz@0x0100A118@ */ ECIPP_ALIGNMENT_FLOAT32_IEEE 10000000000 Compu_CRI_IMVp_Ddz -10000000000 10000000000 /end CHARACTERISTIC
/begin COMPU_METHOD Compu_CRI_IMVp_Ddz " " RAT_FUNC "%.3" "Kbar/sec" COEFFS 0 1 0 0 0 1 /end COMPU_METHOD
/begin CHARACTERISTIC CRI_IMVp_FSO_Ifrz "IMV fuel shutoff negative I-freeze" VALUE 0x0016c43c /* @ECU_Address@CRI_IMVp_FSO_Ifrz@0x0100A120@ */ ECIPP_ALIGNMENT_FLOAT32_IEEE 10000000000 Compu_CRI_IMVp_FSO_Ifrz -10000000000 10000000000 /end CHARACTERISTIC
/begin COMPU_METHOD Compu_CRI_IMVp_FSO_Ifrz " " RAT_FUNC "%.3" "Kbar/sec" COEFFS 0 1 0 0 0 1 /end COMPU_METHOD
/begin CHARACTERISTIC CRI_ontime_max "Time-based max fuel pulse width" VALUE 0x0016c500 /* @ECU_Address@CRI_ontime_max@0x0100A258@ */ ECIPP_ALIGNMENT_ULONG 214748365 Compu_CRI_ontime_max 0 214748364.75 /end CHARACTERISTIC
/begin COMPU_METHOD Compu_CRI_ontime_max " " RAT_FUNC "%.0" "us" COEFFS 0 20 0 0 0 1 /end COMPU_METHOD
/begin CHARACTERISTIC CRI_Prail_min "Rail pressure min for injection" VALUE 0x0016c7d0 /* @ECU_Address@CRI_Prail_min@0x0100A260@ */ ECIPP_ALIGNMENT_UWORD 8192 Compu_CRI_Prail_min 0 8191.875 /end CHARACTERISTIC
/begin COMPU_METHOD Compu_CRI_Prail_min " " RAT_FUNC "%.1" "bar" COEFFS 0 8 0 0 0 1 /end COMPU_METHOD
/begin CHARACTERISTIC EMP_cyl_events "EMP window" VALUE 0x00143990 /* @ECU_Address@EMP_cyl_events@0x0100A280@ */ ECIPP_ALIGNMENT_FLOAT32_IEEE 10000000000 Compu_EMP_cyl_events -10000000000 10000000000 /end CHARACTERISTIC
/begin COMPU_METHOD Compu_EMP_cyl_events " " RAT_FUNC "%.1" "cyl events" COEFFS 0 1 0 0 0 1 /end COMPU_METHOD
/begin CHARACTERISTIC EMP_tau "EMP low-pass tau" VALUE 0x00147bd4 /* @ECU_Address@EMP_tau@0x0100A288@ */ ECIPP_ALIGNMENT_UWORD 65536 Compu_EMP_tau 0.090168 65536 /end CHARACTERISTIC
/begin COMPU_METHOD Compu_EMP_tau " " FORM "%.1" "ms"
 /begin FORMULA "-1 / log(1 - (X1 / 65536))" FORMULA_INV "(1 - exp(-1/X1)) * 65536" /end FORMULA
/end COMPU_METHOD
/begin CHARACTERISTIC EMP_slow_tau_ms "EMP slow low-pass tau" VALUE 0x00143994 /* @ECU_Address@EMP_slow_tau_ms@0x0100A290@ */ ECIPP_ALIGNMENT_FLOAT32_IEEE 10000000000 Compu_EMP_slow_tau_ms -10000000000 10000000000 /end CHARACTERISTIC
/begin COMPU_METHOD Compu_EMP_slow_tau_ms " " RAT_FUNC "%.1" "ms" COEFFS 0 1 0 0 0 1 /end COMPU_METHOD
/begin MEASUREMENT EMP "EMP" UWORD Compu_EMP 0 0 0 255.99609375 ECU_ADDRESS 0x0100A298 /end MEASUREMENT
/begin COMPU_METHOD Compu_EMP " " RAT_FUNC "%.2" "psia" COEFFS 0 256 0 0 0 1 /end COMPU_METHOD
/begin MEASUREMENT CRI_Prail_cld "Common rail P cold offset" SWORD Compu_CRI_Prail_cld 0 0 -4096 4095.875 ECU_ADDRESS 0x0100A2E8 /end MEASUREMENT
/begin COMPU_METHOD Compu_CRI_Prail_cld " " RAT_FUNC "%.1" "bar" COEFFS 0 8 0 0 0 1 /end COMPU_METHOD
/begin CHARACTERISTIC CRI_offtime_min "Injector minimum off time" VALUE 0x0016c460 /* @ECU_Address@CRI_offtime_min@0x0100A760@ */ ECIPP_ALIGNMENT_FLOAT32_IEEE 10000000000 Compu_CRI_offtime_min -10000000000 10000000000 /end CHARACTERISTIC
/begin COMPU_METHOD Compu_CRI_offtime_min " " RAT_FUNC "%.0" "us" COEFFS 0 1 0 0 0 1 /end COMPU_METHOD
/begin MEASUREMENT CRI1_V_boost_filt "Bank 1 current boost voltage" UWORD Compu_CRI1_V_boost_filt 0 0 0 1023.984375 ECU_ADDRESS 0x0100B538 /end MEASUREMENT
/begin COMPU_METHOD Compu_CRI1_V_boost_filt " " RAT_FUNC "%.1" "volts" COEFFS 0 64 0 0 0 1 /end COMPU_METHOD
/begin MEASUREMENT CRI2_V_boost_filt "Bank 2 current boost voltage" UWORD Compu_CRI2_V_boost_filt 0 0 0 1023.984375 ECU_ADDRESS 0x0100B540 /end MEASUREMENT
/begin COMPU_METHOD Compu_CRI2_V_boost_filt " " RAT_FUNC "%.1" "volts" COEFFS 0 64 0 0 0 1 /end COMPU_METHOD
/begin CHARACTERISTIC CRI_i_peak_init "Initial peak current" VALUE 0x0016c7e4 /* @ECU_Address@CRI_i_peak_init@0x0100B548@ */ ECIPP_ALIGNMENT_UWORD 128 Compu_CRI_i_peak_init 0 127.998046875 /end CHARACTERISTIC
/begin COMPU_METHOD Compu_CRI_i_peak_init " " RAT_FUNC "%.1" "amps" COEFFS 0 512 0 0 0 1 /end COMPU_METHOD
/begin CHARACTERISTIC CRI_i_PH_offset "Peak->Hold transition trigger offset" VALUE 0x0016c522 /* @ECU_Address@CRI_i_PH_offset@0x0100B550@ */ ECIPP_ALIGNMENT_SWORD 64 Compu_CRI_i_PH_offset -64 63.998046875 /end CHARACTERISTIC
/begin COMPU_METHOD Compu_CRI_i_PH_offset " " RAT_FUNC "%.2" "amps" COEFFS 0 512 0 0 0 1 /end COMPU_METHOD
/begin CHARACTERISTIC CRI_IMVi_min "IMV current command minimum" VALUE 0x0016c7c2 /* @ECU_Address@CRI_IMVi_min@0x0100B558@ */ ECIPP_ALIGNMENT_UWORD 64 Compu_CRI_IMVi_min 0 63.9990234375 /end CHARACTERISTIC
/begin COMPU_METHOD Compu_CRI_IMVi_min " " RAT_FUNC "%.2" "amps" COEFFS 0 1024 0 0 0 1 /end COMPU_METHOD
/begin CHARACTERISTIC CRI_IMVi_max "IMV current command maximum" VALUE 0x0016c7c0 /* @ECU_Address@CRI_IMVi_max@0x0100B560@ */ ECIPP_ALIGNMENT_UWORD 64 Compu_CRI_IMVi_max 0 63.9990234375 /end CHARACTERISTIC
/begin COMPU_METHOD Compu_CRI_IMVi_max " " RAT_FUNC "%.2" "amps" COEFFS 0 1024 0 0 0 1 /end COMPU_METHOD
/begin CHARACTERISTIC CRI_IMVp_NCvalve "IMV valve type{CRI_IMVp_NCvalve&0xff=0:Normally Open}{CRI_IMVp_NCvalve&0xff=1:Normally Closed}" VALUE 0x0016c82d /* @ECU_Address@CRI_IMVp_NCvalve@0x0100B568@ */ ECIPP_ALIGNMENT_UBYTE 255 CRI_IMVp_NCvalve_COMPU_VTAB 0 255 BIT_MASK 0xff /end CHARACTERISTIC
/begin COMPU_METHOD CRI_IMVp_NCvalve_COMPU_VTAB "Verbal Table" TAB_VERB "%.0" "list" COMPU_TAB_REF CRI_IMVp_NCvalve_COMPU_VTAB_REF /end COMPU_METHOD
/begin COMPU_VTAB CRI_IMVp_NCvalve_COMPU_VTAB_REF "Verbal Table" TAB_VERB 2 0 "Normally Open" 1 "Normally Closed" DEFAULT_VALUE "UNKNOWN" /end COMPU_VTAB
/begin CHARACTERISTIC CRI_IMV_pulsed "IMV valve control strategy{CRI_IMV_pulsed&0xff=0:Continuous Current}{CRI_IMV_pulsed&0xff=1:Time-Pulsed Synchronous}{CRI_IMV_pulsed&0xff=2:CAD-Pulsed Synchronous}" VALUE 0x0016c82b /* @ECU_Address@CRI_IMV_pulsed@0x0100B5E0@ */ ECIPP_ALIGNMENT_UBYTE 255 CRI_IMV_pulsed_COMPU_VTAB 0 255 BIT_MASK 0xff /end CHARACTERISTIC
/begin COMPU_METHOD CRI_IMV_pulsed_COMPU_VTAB "Verbal Table" TAB_VERB "%.0" "list" COMPU_TAB_REF CRI_IMV_pulsed_COMPU_VTAB_REF /end COMPU_METHOD
/begin COMPU_VTAB CRI_IMV_pulsed_COMPU_VTAB_REF "Verbal Table" TAB_VERB 3 0 "Continuous Current" 1 "Time-Pulsed Synchronous" 2 "CAD-Pulsed Synchronous" DEFAULT_VALUE "UNKNOWN" /end COMPU_VTAB
/begin CHARACTERISTIC IMV_pulse_phase "Pulsed-IMV end-of-pulse timing" VALUE 0x0016c528 /* @ECU_Address@IMV_pulse_phase@0x0100B5E8@ */ ECIPP_ALIGNMENT_SWORD 2048 Compu_IMV_pulse_phase -2048 2047.9375 /end CHARACTERISTIC
/begin COMPU_METHOD Compu_IMV_pulse_phase " " RAT_FUNC "%.1" "CAD BTDCC #1" COEFFS 0 16 0 0 0 1 /end COMPU_METHOD
/begin CHARACTERISTIC IMV_pulse_spacing "Pulsed-IMV pulse spacing" VALUE 0x0016c7fe /* @ECU_Address@IMV_pulse_spacing@0x0100B5F0@ */ ECIPP_ALIGNMENT_UWORD 4096 Compu_IMV_pulse_spacing 0 4095.9375 /end CHARACTERISTIC
/begin COMPU_METHOD Compu_IMV_pulse_spacing " " RAT_FUNC "%.1" "CAD" COEFFS 0 16 0 0 0 1 /end COMPU_METHOD
/begin CHARACTERISTIC IMVpulse_Ipeak "Pulsed-IMV waveform peak current" VALUE 0x0016c80a /* @ECU_Address@IMVpulse_Ipeak@0x0100B5F8@ */ ECIPP_ALIGNMENT_UWORD 64 Compu_IMVpulse_Ipeak 0 63.9990234375 /end CHARACTERISTIC
/begin COMPU_METHOD Compu_IMVpulse_Ipeak " " RAT_FUNC "%.2" "amps" COEFFS 0 1024 0 0 0 1 /end COMPU_METHOD
/begin CHARACTERISTIC IMVpulse_Ireduce "Pulsed-IMV waveform avg reduce current" VALUE 0x0016c80c /* @ECU_Address@IMVpulse_Ireduce@0x0100B600@ */ ECIPP_ALIGNMENT_UWORD 64 Compu_IMVpulse_Ireduce 0 63.9990234375 /end CHARACTERISTIC
/begin COMPU_METHOD Compu_IMVpulse_Ireduce " " RAT_FUNC "%.2" "amps" COEFFS 0 1024 0 0 0 1 /end COMPU_METHOD
/begin CHARACTERISTIC IMVpulse_Ihold "Pulsed-IMV waveform hold current" VALUE 0x0016c808 /* @ECU_Address@IMVpulse_Ihold@0x0100B608@ */ ECIPP_ALIGNMENT_UWORD 64 Compu_IMVpulse_Ihold 0 63.9990234375 /end CHARACTERISTIC
/begin COMPU_METHOD Compu_IMVpulse_Ihold " " RAT_FUNC "%.2" "amps" COEFFS 0 1024 0 0 0 1 /end COMPU_METHOD
/begin CHARACTERISTIC IMVpulse_Icushion "Pulsed-IMV waveform cushion current" VALUE 0x0016c806 /* @ECU_Address@IMVpulse_Icushion@0x0100B610@ */ ECIPP_ALIGNMENT_UWORD 64 Compu_IMVpulse_Icushion 0 63.9990234375 /end CHARACTERISTIC
/begin COMPU_METHOD Compu_IMVpulse_Icushion " " RAT_FUNC "%.2" "amps" COEFFS 0 1024 0 0 0 1 /end COMPU_METHOD
/begin CHARACTERISTIC IMVpulse_Treduce "Pulsed-IMV waveform reduce duration" VALUE 0x0016c818 /* @ECU_Address@IMVpulse_Treduce@0x0100B618@ */ ECIPP_ALIGNMENT_UWORD 65535 Compu_IMVpulse_Treduce 0 65535 /end CHARACTERISTIC
/begin COMPU_METHOD Compu_IMVpulse_Treduce " " RAT_FUNC "%.0" "us" COEFFS 0 1 0 0 0 1 /end COMPU_METHOD
/begin CHARACTERISTIC IMVpulse_Tpause "Pulsed-IMV waveform pause duration" VALUE 0x0016c814 /* @ECU_Address@IMVpulse_Tpause@0x0100B620@ */ ECIPP_ALIGNMENT_UWORD 65535 Compu_IMVpulse_Tpause 0 65535 /end CHARACTERISTIC
/begin COMPU_METHOD Compu_IMVpulse_Tpause " " RAT_FUNC "%.0" "us" COEFFS 0 1 0 0 0 1 /end COMPU_METHOD
/begin CHARACTERISTIC IMVpulse_Tcushion "Pulsed-IMV waveform cushion duration" VALUE 0x0016c80e /* @ECU_Address@IMVpulse_Tcushion@0x0100B628@ */ ECIPP_ALIGNMENT_UWORD 65535 Compu_IMVpulse_Tcushion 0 65535 /end CHARACTERISTIC
/begin COMPU_METHOD Compu_IMVpulse_Tcushion " " RAT_FUNC "%.0" "us" COEFFS 0 1 0 0 0 1 /end COMPU_METHOD
/begin CHARACTERISTIC IMVpulse_Tdecay "Pulsed-IMV waveform decay duration" VALUE 0x0016c810 /* @ECU_Address@IMVpulse_Tdecay@0x0100B630@ */ ECIPP_ALIGNMENT_UWORD 65535 Compu_IMVpulse_Tdecay 0 65535 /end CHARACTERISTIC
/begin COMPU_METHOD Compu_IMVpulse_Tdecay " " RAT_FUNC "%.0" "us" COEFFS 0 1 0 0 0 1 /end COMPU_METHOD
/begin MEASUREMENT CRI_IMVcad_final "Pulsed-IMV final CAD duration equivalent" SWORD Compu_CRI_IMVcad_final 0 0 -2048 2047.9375 ECU_ADDRESS 0x0100B638 /end MEASUREMENT
/begin COMPU_METHOD Compu_CRI_IMVcad_final " " RAT_FUNC "%.1" "CAD" COEFFS 0 16 0 0 0 1 /end COMPU_METHOD
/begin CHARACTERISTIC CRI_IMVpw_min "Pulsed-IMV effective elecrical on-time min" VALUE 0x0016c45c /* @ECU_Address@CRI_IMVpw_min@0x0100B640@ */ ECIPP_ALIGNMENT_FLOAT32_IEEE 10000000000 Compu_CRI_IMVpw_min -10000000000 10000000000 /end CHARACTERISTIC
/begin COMPU_METHOD Compu_CRI_IMVpw_min " " RAT_FUNC "%.2" "ms" COEFFS 0 1 0 0 0 1 /end COMPU_METHOD
/begin CHARACTERISTIC CRI_IMVpw_max "Pulsed-IMV effective elecrical on-time max" VALUE 0x0016c458 /* @ECU_Address@CRI_IMVpw_max@0x0100B648@ */ ECIPP_ALIGNMENT_FLOAT32_IEEE 10000000000 Compu_CRI_IMVpw_max -10000000000 10000000000 /end CHARACTERISTIC
/begin COMPU_METHOD Compu_CRI_IMVpw_max " " RAT_FUNC "%.2" "ms" COEFFS 0 1 0 0 0 1 /end COMPU_METHOD
/begin MEASUREMENT CRI_IMVpw_cmd "Pulsed-IMV effective electrical on-time command" FLOAT32_IEEE Compu_CRI_IMVpw_cmd 0 0 -10000000000 10000000000 ECU_ADDRESS 0x0100B650 /end MEASUREMENT
/begin COMPU_METHOD Compu_CRI_IMVpw_cmd " " RAT_FUNC "%.2" "ms" COEFFS 0 1 0 0 0 1 /end COMPU_METHOD
/begin MEASUREMENT CRI_IMV_PID "IMV rail pressure control PID term" FLOAT32_IEEE Compu_CRI_IMV_PID 0 0 -10000000000 10000000000 ECU_ADDRESS 0x0100B658 /end MEASUREMENT
/begin COMPU_METHOD Compu_CRI_IMV_PID " " RAT_FUNC "%.2" "CTLunits" COEFFS 0 1 0 0 0 1 /end COMPU_METHOD
/begin MEASUREMENT CRI_IMV_Iaccum "IMV rail pressure control integrator" FLOAT32_IEEE Compu_CRI_IMV_Iaccum 0 0 -10000000000 10000000000 ECU_ADDRESS 0x0100B660 /end MEASUREMENT
/begin COMPU_METHOD Compu_CRI_IMV_Iaccum " " RAT_FUNC "%.2" "CTLunits" COEFFS 0 1 0 0 0 1 /end COMPU_METHOD
/begin CHARACTERISTIC CRI_hold_recharge "Boost recharging during hold phase{CRI_hold_recharge&0xff=0x00:Disabled}{CRI_hold_recharge&0xff=0x01:Enabled}" VALUE 0x0016c833 /* @ECU_Address@CRI_hold_recharge@0x0100B668@ */ ECIPP_ALIGNMENT_UBYTE 255 CRI_hold_recharge_COMPU_VTAB 0 255 BIT_MASK 0xff /end CHARACTERISTIC
/begin COMPU_METHOD CRI_hold_recharge_COMPU_VTAB "Verbal Table" TAB_VERB "%.0" "list" COMPU_TAB_REF CRI_hold_recharge_COMPU_VTAB_REF /end COMPU_METHOD
/begin COMPU_VTAB CRI_hold_recharge_COMPU_VTAB_REF "Verbal Table" TAB_VERB 2 0x00 "Disabled" 0x01 "Enabled" DEFAULT_VALUE "UNKNOWN" /end COMPU_VTAB
/begin CHARACTERISTIC CRI_peakhold_decay "Peak-to-Hold transition wait time" VALUE 0x0016c7ee /* @ECU_Address@CRI_peakhold_decay@0x0100B670@ */ ECIPP_ALIGNMENT_UWORD 3277 Compu_CRI_peakhold_decay 0 3276.75 /end CHARACTERISTIC
/begin COMPU_METHOD Compu_CRI_peakhold_decay " " RAT_FUNC "%.0" "us" COEFFS 0 20 0 0 0 1 /end COMPU_METHOD
/begin MEASUREMENT IMVpulsetest_mode "Pulsed-IMV test pulse mode{IMVpulsetest_mode&0xff=0x00:Disabled}{IMVpulsetest_mode&0xff=0x01:Pulsing}" UBYTE IMVpulsetest_mode_COMPU_VTAB 0 0 0 255 ECU_ADDRESS 0x0100B698 BIT_MASK 0xff /end MEASUREMENT
/begin COMPU_METHOD IMVpulsetest_mode_COMPU_VTAB "Verbal Table" TAB_VERB "%.0" "list" COMPU_TAB_REF IMVpulsetest_mode_COMPU_VTAB_REF /end COMPU_METHOD
/begin COMPU_VTAB IMVpulsetest_mode_COMPU_VTAB_REF "Verbal Table" TAB_VERB 2 0x00 "Disabled" 0x01 "Pulsing" DEFAULT_VALUE "UNKNOWN" /end COMPU_VTAB
/begin MEASUREMENT IMVpulsetest_pw "Pulsed-IMV test pulse duration" UWORD Compu_IMVpulsetest_pw 0 0 0 65535 ECU_ADDRESS 0x0100B6A0 /end MEASUREMENT
/begin COMPU_METHOD Compu_IMVpulsetest_pw " " RAT_FUNC "%.0" "us" COEFFS 0 1 0 0 0 1 /end COMPU_METHOD
/begin MEASUREMENT CRI_IMVpw_total "Pulsed-IMV total on-time" FLOAT32_IEEE Compu_CRI_IMVpw_total 0 0 -10000000000 10000000000 ECU_ADDRESS 0x0100B6A8 /end MEASUREMENT
/begin COMPU_METHOD Compu_CRI_IMVpw_total " " RAT_FUNC "%.2" "ms" COEFFS 0 1 0 0 0 1 /end COMPU_METHOD
/begin CHARACTERISTIC CRI_IMVp_baseline "IMV current/on-time zero-reponse offset" VALUE 0x0016c454 /* @ECU_Address@CRI_IMVp_baseline@0x0100B6B0@ */ ECIPP_ALIGNMENT_FLOAT32_IEEE 10000000000 Compu_CRI_IMVp_baseline -10000000000 10000000000 /end CHARACTERISTIC
/begin COMPU_METHOD Compu_CRI_IMVp_baseline " " RAT_FUNC "%.2" "amps or ms" COEFFS 0 1 0 0 0 1 /end COMPU_METHOD
/begin CHARACTERISTIC CRI_Prail_targdz_LP "Rail pressure target deadzone tau" VALUE 0x0016c828 /* @ECU_Address@CRI_Prail_targdz_LP@0x0100B6B8@ */ ECIPP_ALIGNMENT_UWORD 65536 Compu_CRI_Prail_targdz_LP 0.090168 65536 /end CHARACTERISTIC
/begin COMPU_METHOD Compu_CRI_Prail_targdz_LP " " FORM "%.1" "ms"
 /begin FORMULA "-1 / log(1 - (X1 / 65536))" FORMULA_INV "(1 - exp(-1/X1)) * 65536" /end FORMULA
/end COMPU_METHOD
/begin CHARACTERISTIC CRI_Prail_targ_dz "Rail pressure target deadzone" VALUE 0x0016c7d2 /* @ECU_Address@CRI_Prail_targ_dz@0x0100B6C0@ */ ECIPP_ALIGNMENT_UWORD 8192 Compu_CRI_Prail_targ_dz 0 8191.875 /end CHARACTERISTIC
/begin COMPU_METHOD Compu_CRI_Prail_targ_dz " " RAT_FUNC "%.0" "bar" COEFFS 0 8 0 0 0 1 /end COMPU_METHOD
/begin MEASUREMENT CRI_IMVff_TLU "IMV feedforward table lookup value" FLOAT32_IEEE Compu_CRI_IMVff_TLU 0 0 -10000000000 10000000000 ECU_ADDRESS 0x0100B6C8 /end MEASUREMENT
/begin COMPU_METHOD Compu_CRI_IMVff_TLU " " RAT_FUNC "%.2" "amps or mA/mg or us/mg or CAD/mg" COEFFS 0 1 0 0 0 1 /end COMPU_METHOD
/begin MEASUREMENT CRI_IMVp_ff "IMV feedforward control adder" FLOAT32_IEEE Compu_CRI_IMVp_ff 0 0 -10000000000 10000000000 ECU_ADDRESS 0x0100B6D0 /end MEASUREMENT
/begin COMPU_METHOD Compu_CRI_IMVp_ff " " RAT_FUNC "%.2" "CTLunits" COEFFS 0 1 0 0 0 1 /end COMPU_METHOD
/begin CHARACTERISTIC CRI_IMVff_mode "IMV feedforward table mode/units{CRI_IMVff_mode&0xff=0:Disabled}{CRI_IMVff_mode&0xff=1:Amps}{CRI_IMVff_mode&0xff=2:mA / mg fuel}{CRI_IMVff_mode&0xff=3:us / mg fuel}{CRI_IMVff_mode&0xff=4:CAD / mg fuel}" VALUE 0x0016c82c /* @ECU_Address@CRI_IMVff_mode@0x0100B6D8@ */ ECIPP_ALIGNMENT_UBYTE 255 CRI_IMVff_mode_COMPU_VTAB 0 255 BIT_MASK 0xff /end CHARACTERISTIC
/begin COMPU_METHOD CRI_IMVff_mode_COMPU_VTAB "Verbal Table" TAB_VERB "%.0" "list" COMPU_TAB_REF CRI_IMVff_mode_COMPU_VTAB_REF /end COMPU_METHOD
/begin COMPU_VTAB CRI_IMVff_mode_COMPU_VTAB_REF "Verbal Table" TAB_VERB 5 0 "Disabled" 1 "Amps" 2 "mA / mg fuel" 3 "us / mg fuel" 4 "CAD / mg fuel" DEFAULT_VALUE "UNKNOWN" /end COMPU_VTAB
/begin CHARACTERISTIC IMVpulse_Tpeak_max "Pulsed-IMV waveform max peak duration" VALUE 0x0016c816 /* @ECU_Address@IMVpulse_Tpeak_max@0x0100B6E0@ */ ECIPP_ALIGNMENT_UWORD 65535 Compu_IMVpulse_Tpeak_max 0 65535 /end CHARACTERISTIC
/begin COMPU_METHOD Compu_IMVpulse_Tpeak_max " " RAT_FUNC "%.0" "us" COEFFS 0 1 0 0 0 1 /end COMPU_METHOD
/begin CHARACTERISTIC IMVpulse_Ttotal_max "Pulsed-IMV waveform max total duration" VALUE 0x0016c81a /* @ECU_Address@IMVpulse_Ttotal_max@0x0100B6E8@ */ ECIPP_ALIGNMENT_UWORD 65535 Compu_IMVpulse_Ttotal_max 0 65535 /end CHARACTERISTIC
/begin COMPU_METHOD Compu_IMVpulse_Ttotal_max " " RAT_FUNC "%.0" "us" COEFFS 0 1 0 0 0 1 /end COMPU_METHOD
/begin MEASUREMENT CRI_IMVi_FB "IMV current control feedback value" SWORD Compu_CRI_IMVi_FB 0 0 -32 31.9990234375 ECU_ADDRESS 0x0100B6F0 /end MEASUREMENT
/begin COMPU_METHOD Compu_CRI_IMVi_FB " " RAT_FUNC "%.2" "amps" COEFFS 0 1024 0 0 0 1 /end COMPU_METHOD
/begin CHARACTERISTIC MAP_global_filt "MAP global filter method{MAP_global_filt&0xff=0:Default}{MAP_global_filt&0xff=1:Cylinder Windowed}" VALUE 0x00147e56 /* @ECU_Address@MAP_global_filt@0x0100B6F8@ */ ECIPP_ALIGNMENT_UBYTE 255 MAP_global_filt_COMPU_VTAB 0 255 BIT_MASK 0xff /end CHARACTERISTIC
/begin COMPU_METHOD MAP_global_filt_COMPU_VTAB "Verbal Table" TAB_VERB "%.0" "list" COMPU_TAB_REF MAP_global_filt_COMPU_VTAB_REF /end COMPU_METHOD
/begin COMPU_VTAB MAP_global_filt_COMPU_VTAB_REF "Verbal Table" TAB_VERB 2 0 "Default" 1 "Cylinder Windowed" DEFAULT_VALUE "UNKNOWN" /end COMPU_VTAB
/begin CHARACTERISTIC TIP_global_filt "TIP global filter method{TIP_global_filt&0xff=0:Default}{TIP_global_filt&0xff=1:Cylinder Windowed}" VALUE 0x0014809e /* @ECU_Address@TIP_global_filt@0x0100B700@ */ ECIPP_ALIGNMENT_UBYTE 255 TIP_global_filt_COMPU_VTAB 0 255 BIT_MASK 0xff /end CHARACTERISTIC
/begin COMPU_METHOD TIP_global_filt_COMPU_VTAB "Verbal Table" TAB_VERB "%.0" "list" COMPU_TAB_REF TIP_global_filt_COMPU_VTAB_REF /end COMPU_METHOD
/begin COMPU_VTAB TIP_global_filt_COMPU_VTAB_REF "Verbal Table" TAB_VERB 2 0 "Default" 1 "Cylinder Windowed" DEFAULT_VALUE "UNKNOWN" /end COMPU_VTAB
/begin CHARACTERISTIC MAP_TIP_win_cyls "MAP/TIP cylinder window size" VALUE 0x001475ae /* @ECU_Address@MAP_TIP_win_cyls@0x0100B708@ */ ECIPP_ALIGNMENT_UWORD 64 Compu_MAP_TIP_win_cyls 0 63.9990234375 /end CHARACTERISTIC
/begin COMPU_METHOD Compu_MAP_TIP_win_cyls " " RAT_FUNC "%.1" "cyl events" COEFFS 0 1024 0 0 0 1 /end COMPU_METHOD
/begin CHARACTERISTIC CRI_IMV_Iinit "IMV rail pressure integrator initial value" VALUE 0x0016c428 /* @ECU_Address@CRI_IMV_Iinit@0x0100B830@ */ ECIPP_ALIGNMENT_FLOAT32_IEEE 10000000000 Compu_CRI_IMV_Iinit -10000000000 10000000000 /end CHARACTERISTIC
/begin COMPU_METHOD Compu_CRI_IMV_Iinit " " RAT_FUNC "%.2" "CTLunits" COEFFS 0 1 0 0 0 1 /end COMPU_METHOD
/begin MEASUREMENT CRI_ontime_finalmax "Final computed max pulse-width" ULONG Compu_CRI_ontime_finalmax 0 0 0 214748364.75 ECU_ADDRESS 0x0100B838 /end MEASUREMENT
/begin COMPU_METHOD Compu_CRI_ontime_finalmax " " RAT_FUNC "%.0" "us" COEFFS 0 20 0 0 0 1 /end COMPU_METHOD
/begin CHARACTERISTIC CRI_ontime_CADmax "CAD-based max fuel pulse width" VALUE 0x0016c7e8 /* @ECU_Address@CRI_ontime_CADmax@0x0100B840@ */ ECIPP_ALIGNMENT_UWORD 4096 Compu_CRI_ontime_CADmax 0 4095.9375 /end CHARACTERISTIC
/begin COMPU_METHOD Compu_CRI_ontime_CADmax " " RAT_FUNC "%.1" "CAD" COEFFS 0 16 0 0 0 1 /end COMPU_METHOD
/begin CHARACTERISTIC IMVpck_PWfixed "Pulsed-IMV cranking pre-sync fixed-time pulse" VALUE 0x0016c464 /* @ECU_Address@IMVpck_PWfixed@0x0100B848@ */ ECIPP_ALIGNMENT_FLOAT32_IEEE 10000000000 Compu_IMVpck_PWfixed -10000000000 10000000000 /end CHARACTERISTIC
/begin COMPU_METHOD Compu_IMVpck_PWfixed " " RAT_FUNC "%.2" "ms" COEFFS 0 1 0 0 0 1 /end COMPU_METHOD
/begin CHARACTERISTIC IMVpck_presync_tau "Pulsed-IMV cranking pre-sync fixed-time interval" VALUE 0x0016c468 /* @ECU_Address@IMVpck_presync_tau@0x0100B850@ */ ECIPP_ALIGNMENT_FLOAT32_IEEE 10000000000 Compu_IMVpck_presync_tau -10000000000 10000000000 /end CHARACTERISTIC
/begin COMPU_METHOD Compu_IMVpck_presync_tau " " RAT_FUNC "%.2" "ms" COEFFS 0 1 0 0 0 1 /end COMPU_METHOD
/begin CHARACTERISTIC IMVpck_pstsync_ph "Pulsed-IMV cranking post-sync fixed-CAD timing" VALUE 0x0016c52c /* @ECU_Address@IMVpck_pstsync_ph@0x0100B858@ */ ECIPP_ALIGNMENT_SWORD 2048 Compu_IMVpck_pstsync_ph -2048 2047.9375 /end CHARACTERISTIC
/begin COMPU_METHOD Compu_IMVpck_pstsync_ph " " RAT_FUNC "%.1" "CAD BTDCC #1" COEFFS 0 16 0 0 0 1 /end COMPU_METHOD
/begin CHARACTERISTIC IMVpck_Pctlhyst_pct "Pulsed-IMV cranking pressure hysterisis" VALUE 0x0016c804 /* @ECU_Address@IMVpck_Pctlhyst_pct@0x0100B860@ */ ECIPP_ALIGNMENT_UWORD 100 Compu_IMVpck_Pctlhyst_pct 0 99.9984741210938 /end CHARACTERISTIC
/begin COMPU_METHOD Compu_IMVpck_Pctlhyst_pct " " RAT_FUNC "%.1" "%" COEFFS 0 655.36 0 0 0 1 /end COMPU_METHOD
/begin MEASUREMENT IMVpck_taufix "Pulsed-IMV cranking fixed-time-interval mode{IMVpck_taufix&0xff=0:Inactive}{IMVpck_taufix&0xff=1:Active}" UBYTE IMVpck_taufix_COMPU_VTAB 0 0 0 255 ECU_ADDRESS 0x0100B868 BIT_MASK 0xff /end MEASUREMENT
/begin COMPU_METHOD IMVpck_taufix_COMPU_VTAB "Verbal Table" TAB_VERB "%.0" "list" COMPU_TAB_REF IMVpck_taufix_COMPU_VTAB_REF /end COMPU_METHOD
/begin COMPU_VTAB IMVpck_taufix_COMPU_VTAB_REF "Verbal Table" TAB_VERB 2 0 "Inactive" 1 "Active" DEFAULT_VALUE "UNKNOWN" /end COMPU_VTAB
/begin MEASUREMENT fuel_total_gas "Gaseous total fuel" ULONG Compu_fuel_total_gas 0 0 0 2147483647.5 ECU_ADDRESS 0x0100B878 /end MEASUREMENT
/begin COMPU_METHOD Compu_fuel_total_gas " " RAT_FUNC "%.1" "kg" COEFFS 0 2 0 0 0 1 /end COMPU_METHOD
/begin CHARACTERISTIC EGRdP_tau "EGRdP low-pass tau" VALUE 0x00140998 /* @ECU_Address@EGRdP_tau@0x0100BD00@ */ ECIPP_ALIGNMENT_UWORD 163840 Compu_EGRdP_tau 0.16703 163840 /end CHARACTERISTIC
/begin COMPU_METHOD Compu_EGRdP_tau " " FORM "%.0" "ms"
 /begin FORMULA "-5 / log(1.0000000000001 - (X1 / 32768))" FORMULA_INV "(1.0000000000001 - exp(-5/X1)) * 32768" /end FORMULA
/end COMPU_METHOD
/begin CHARACTERISTIC EGRHPLP_cyl_events "EGR HP/LP averaging window" VALUE 0x0014087e /* @ECU_Address@EGRHPLP_cyl_events@0x0100BD70@ */ ECIPP_ALIGNMENT_UWORD 64 Compu_EGRHPLP_cyl_events 0 63.9990234375 /end CHARACTERISTIC
/begin COMPU_METHOD Compu_EGRHPLP_cyl_events " " RAT_FUNC "%.1" "cyl events" COEFFS 0 1024 0 0 0 1 /end COMPU_METHOD
/begin CHARACTERISTIC EGRHPLP_tau "EGR HP/LP low-pass tau" VALUE 0x00140986 /* @ECU_Address@EGRHPLP_tau@0x0100BD78@ */ ECIPP_ALIGNMENT_UWORD 327680 Compu_EGRHPLP_tau 0.45084 327680 /end CHARACTERISTIC
/begin COMPU_METHOD Compu_EGRHPLP_tau " " FORM "%.1" "ms"
 /begin FORMULA "-5 / log(1 - (X1 / 65536))" FORMULA_INV "(1 - exp(-5/X1)) * 65536" /end FORMULA
/end COMPU_METHOD
/begin CHARACTERISTIC UEGOB_PI_raw_LP "UEGOB PI raw voltage tau" VALUE 0x00149424 /* @ECU_Address@UEGOB_PI_raw_LP@0x0100BF78@ */ ECIPP_ALIGNMENT_UWORD 65536 Compu_UEGOB_PI_raw_LP 0.090168 65536 /end CHARACTERISTIC
/begin COMPU_METHOD Compu_UEGOB_PI_raw_LP " " FORM "%.0" "ms"
 /begin FORMULA "-1 / log(1 - (X1 / 65536))" FORMULA_INV "(1 - exp(-1/X1)) * 65536" /end FORMULA
/end COMPU_METHOD
/begin CHARACTERISTIC UEGOB_SR_raw_LP "UEGOB SR raw voltage tau" VALUE 0x00149426 /* @ECU_Address@UEGOB_SR_raw_LP@0x0100BF80@ */ ECIPP_ALIGNMENT_UWORD 65536 Compu_UEGOB_SR_raw_LP 0.090168 65536 /end CHARACTERISTIC
/begin COMPU_METHOD Compu_UEGOB_SR_raw_LP " " FORM "%.0" "ms"
 /begin FORMULA "-1 / log(1 - (X1 / 65536))" FORMULA_INV "(1 - exp(-1/X1)) * 65536" /end FORMULA
/end COMPU_METHOD
/begin CHARACTERISTIC UEGOB_PI_Vofst_LP "UEGOB PI offset voltage tau" VALUE 0x00149428 /* @ECU_Address@UEGOB_PI_Vofst_LP@0x0100BF88@ */ ECIPP_ALIGNMENT_UWORD 327680 Compu_UEGOB_PI_Vofst_LP 0.45084 327680 /end CHARACTERISTIC
/begin COMPU_METHOD Compu_UEGOB_PI_Vofst_LP " " FORM "%.0" "ms"
 /begin FORMULA "-5 / log(1 - (X1 / 65536))" FORMULA_INV "(1 - exp(-5/X1)) * 65536" /end FORMULA
/end COMPU_METHOD
/begin CHARACTERISTIC UEGOB_SR_Vofst_LP "UEGOB SR offset voltage tau" VALUE 0x0014942A /* @ECU_Address@UEGOB_SR_Vofst_LP@0x0100BF90@ */ ECIPP_ALIGNMENT_UWORD 327680 Compu_UEGOB_SR_Vofst_LP 0.45084 327680 /end CHARACTERISTIC
/begin COMPU_METHOD Compu_UEGOB_SR_Vofst_LP " " FORM "%.0" "ms"
 /begin FORMULA "-5 / log(1 - (X1 / 65536))" FORMULA_INV "(1 - exp(-5/X1)) * 65536" /end FORMULA
/end COMPU_METHOD
/begin CHARACTERISTIC UEGOB_PI_Vout_LP "UEGOB PI final voltage tau" VALUE 0x0014942C /* @ECU_Address@UEGOB_PI_Vout_LP@0x0100BF98@ */ ECIPP_ALIGNMENT_UWORD 327680 Compu_UEGOB_PI_Vout_LP 0.45084 327680 /end CHARACTERISTIC
/begin COMPU_METHOD Compu_UEGOB_PI_Vout_LP " " FORM "%.0" "ms"
 /begin FORMULA "-5 / log(1 - (X1 / 65536))" FORMULA_INV "(1 - exp(-5/X1)) * 65536" /end FORMULA
/end COMPU_METHOD
/begin CHARACTERISTIC UEGOB_SR_Vout_LP "UEGOB SR final voltage tau" VALUE 0x0014942E /* @ECU_Address@UEGOB_SR_Vout_LP@0x0100BFA0@ */ ECIPP_ALIGNMENT_UWORD 327680 Compu_UEGOB_SR_Vout_LP 0.45084 327680 /end CHARACTERISTIC
/begin COMPU_METHOD Compu_UEGOB_SR_Vout_LP " " FORM "%.0" "ms"
 /begin FORMULA "-5 / log(1 - (X1 / 65536))" FORMULA_INV "(1 - exp(-5/X1)) * 65536" /end FORMULA
/end COMPU_METHOD
/begin CHARACTERISTIC UEGON_PI_raw_LP "UEGON PI raw voltage tau" VALUE 0x001494C0 /* @ECU_Address@UEGON_PI_raw_LP@0x0100BFB0@ */ ECIPP_ALIGNMENT_UWORD 65536 Compu_UEGON_PI_raw_LP 0.090168 65536 /end CHARACTERISTIC
/begin COMPU_METHOD Compu_UEGON_PI_raw_LP " " FORM "%.0" "ms"
 /begin FORMULA "-1 / log(1 - (X1 / 65536))" FORMULA_INV "(1 - exp(-1/X1)) * 65536" /end FORMULA
/end COMPU_METHOD
/begin CHARACTERISTIC UEGON_SR_raw_LP "UEGON SR raw voltage tau" VALUE 0x001494C2 /* @ECU_Address@UEGON_SR_raw_LP@0x0100BFB8@ */ ECIPP_ALIGNMENT_UWORD 65536 Compu_UEGON_SR_raw_LP 0.090168 65536 /end CHARACTERISTIC
/begin COMPU_METHOD Compu_UEGON_SR_raw_LP " " FORM "%.0" "ms"
 /begin FORMULA "-1 / log(1 - (X1 / 65536))" FORMULA_INV "(1 - exp(-1/X1)) * 65536" /end FORMULA
/end COMPU_METHOD
/begin CHARACTERISTIC UEGON_PI_Vofst_LP "UEGON PI offset voltage tau" VALUE 0x001494C4 /* @ECU_Address@UEGON_PI_Vofst_LP@0x0100BFC0@ */ ECIPP_ALIGNMENT_UWORD 327680 Compu_UEGON_PI_Vofst_LP 0.45084 327680 /end CHARACTERISTIC
/begin COMPU_METHOD Compu_UEGON_PI_Vofst_LP " " FORM "%.0" "ms"
 /begin FORMULA "-5 / log(1 - (X1 / 65536))" FORMULA_INV "(1 - exp(-5/X1)) * 65536" /end FORMULA
/end COMPU_METHOD
/begin CHARACTERISTIC UEGON_SR_Vofst_LP "UEGON SR offset voltage tau" VALUE 0x001494C6 /* @ECU_Address@UEGON_SR_Vofst_LP@0x0100BFC8@ */ ECIPP_ALIGNMENT_UWORD 327680 Compu_UEGON_SR_Vofst_LP 0.45084 327680 /end CHARACTERISTIC
/begin COMPU_METHOD Compu_UEGON_SR_Vofst_LP " " FORM "%.0" "ms"
 /begin FORMULA "-5 / log(1 - (X1 / 65536))" FORMULA_INV "(1 - exp(-5/X1)) * 65536" /end FORMULA
/end COMPU_METHOD
/begin CHARACTERISTIC UEGON_PI_Vout_LP "UEGON PI final voltage tau" VALUE 0x001494C8 /* @ECU_Address@UEGON_PI_Vout_LP@0x0100BFD0@ */ ECIPP_ALIGNMENT_UWORD 327680 Compu_UEGON_PI_Vout_LP 0.45084 327680 /end CHARACTERISTIC
/begin COMPU_METHOD Compu_UEGON_PI_Vout_LP " " FORM "%.0" "ms"
 /begin FORMULA "-5 / log(1 - (X1 / 65536))" FORMULA_INV "(1 - exp(-5/X1)) * 65536" /end FORMULA
/end COMPU_METHOD
/begin CHARACTERISTIC UEGON_SR_Vout_LP "UEGON SR final voltage tau" VALUE 0x001494CA /* @ECU_Address@UEGON_SR_Vout_LP@0x0100BFD8@ */ ECIPP_ALIGNMENT_UWORD 327680 Compu_UEGON_SR_Vout_LP 0.45084 327680 /end CHARACTERISTIC
/begin COMPU_METHOD Compu_UEGON_SR_Vout_LP " " FORM "%.0" "ms"
 /begin FORMULA "-5 / log(1 - (X1 / 65536))" FORMULA_INV "(1 - exp(-5/X1)) * 65536" /end FORMULA
/end COMPU_METHOD
/begin CHARACTERISTIC LOCKOFF2_pin "Secondary Gaseous lockoff enable pin{LOCKOFF2_pin&0xff=0:Disabled}{LOCKOFF2_pin&0xff=1:Not Available}{LOCKOFF2_pin&0xff=2:Aux PWM1}{LOCKOFF2_pin&0xff=3:Aux PWM2}{LOCKOFF2_pin&0xff=4:Aux PWM3}{LOCKOFF2_pin&0xff=5:Aux PWM4}{LOCKOFF2_pin&0xff=6:Aux PWM5}{LOC" VALUE 0x00147e12 /* @ECU_Address@LOCKOFF2_pin@0x0100C2C0@ */ ECIPP_ALIGNMENT_UBYTE 255 LOCKOFF2_pin_COMPU_VTAB 0 255 BIT_MASK 0xff /end CHARACTERISTIC
/begin COMPU_METHOD LOCKOFF2_pin_COMPU_VTAB "Verbal Table" TAB_VERB "%.0" "list" COMPU_TAB_REF LOCKOFF2_pin_COMPU_VTAB_REF /end COMPU_METHOD
/begin COMPU_VTAB LOCKOFF2_pin_COMPU_VTAB_REF "Verbal Table" TAB_VERB 12 0 "Disabled" 1 "Not Available" 2 "Aux PWM1" 3 "Aux PWM2" 4 "Aux PWM3" 5 "Aux PWM4" 6 "Aux PWM5" 7 "Aux PWM6" 8 "EGOH1" 9 "EGOH2" 10 "EGOH3" 11 "EGOH4" DEFAULT_VALUE "UNKNOWN" /end COMPU_VTAB
/begin CHARACTERISTIC CRI_purge "General (non green-engine) rail air purge mode{CRI_purge&0xff=0:Disabled}{CRI_purge&0xff=1:Enabled}" VALUE 0x0016c835 /* @ECU_Address@CRI_purge@0x0100C4C8@ */ ECIPP_ALIGNMENT_UBYTE 255 CRI_purge_COMPU_VTAB 0 255 BIT_MASK 0xff /end CHARACTERISTIC
/begin COMPU_METHOD CRI_purge_COMPU_VTAB "Verbal Table" TAB_VERB "%.0" "list" COMPU_TAB_REF CRI_purge_COMPU_VTAB_REF /end COMPU_METHOD
/begin COMPU_VTAB CRI_purge_COMPU_VTAB_REF "Verbal Table" TAB_VERB 2 0 "Disabled" 1 "Enabled" DEFAULT_VALUE "UNKNOWN" /end COMPU_VTAB
/begin MEASUREMENT CRI_purge_active "Rail air purge status{CRI_purge_active&0xff=0:Inactive}{CRI_purge_active&0xff=1:Fuel Pressure}{CRI_purge_active&0xff=2:Crank Time}" UBYTE CRI_purge_active_COMPU_VTAB 0 0 0 255 ECU_ADDRESS 0x0100C4D0 BIT_MASK 0xff /end MEASUREMENT
/begin COMPU_METHOD CRI_purge_active_COMPU_VTAB "Verbal Table" TAB_VERB "%.0" "list" COMPU_TAB_REF CRI_purge_active_COMPU_VTAB_REF /end COMPU_METHOD
/begin COMPU_VTAB CRI_purge_active_COMPU_VTAB_REF "Verbal Table" TAB_VERB 3 0 "Inactive" 1 "Fuel Pressure" 2 "Crank Time" DEFAULT_VALUE "UNKNOWN" /end COMPU_VTAB
/begin CHARACTERISTIC CRI_purge_Plower "Rail purge lower initiation pressure" VALUE 0x0016c7f0 /* @ECU_Address@CRI_purge_Plower@0x0100C4D8@ */ ECIPP_ALIGNMENT_UWORD 8192 Compu_CRI_purge_Plower 0 8191.875 /end CHARACTERISTIC
/begin COMPU_METHOD Compu_CRI_purge_Plower " " RAT_FUNC "%.1" "bar" COEFFS 0 8 0 0 0 1 /end COMPU_METHOD
/begin CHARACTERISTIC CRI_purge_Pupper "Rail purge upper termination pressure" VALUE 0x0016c7f2 /* @ECU_Address@CRI_purge_Pupper@0x0100C4E0@ */ ECIPP_ALIGNMENT_UWORD 8192 Compu_CRI_purge_Pupper 0 8191.875 /end CHARACTERISTIC
/begin COMPU_METHOD Compu_CRI_purge_Pupper " " RAT_FUNC "%.1" "bar" COEFFS 0 8 0 0 0 1 /end COMPU_METHOD
/begin CHARACTERISTIC CRI_purge_cycwait "General purge mode rotation validation wait" VALUE 0x0016c7f4 /* @ECU_Address@CRI_purge_cycwait@0x0100C4E8@ */ ECIPP_ALIGNMENT_UWORD 4096 Compu_CRI_purge_cycwait 0 4095.9375 /end CHARACTERISTIC
/begin COMPU_METHOD Compu_CRI_purge_cycwait " " RAT_FUNC "%.1" "cycles" COEFFS 0 16 0 0 0 1 /end COMPU_METHOD
/begin CHARACTERISTIC FT_bleedoff_ena "Bleed-off enable{FT_bleedoff_ena&0xff=0:Disabled}{FT_bleedoff_ena&0xff=1:LPG only}{FT_bleedoff_ena&0xff=2:NG only}{FT_bleedoff_ena&0xff=3:LPG or NG}" VALUE 0x00147d8e /* @ECU_Address@FT_bleedoff_ena@0x0100C820@ */ ECIPP_ALIGNMENT_UBYTE 255 FT_bleedoff_ena_COMPU_VTAB 0 255 BIT_MASK 0xff /end CHARACTERISTIC
/begin COMPU_METHOD FT_bleedoff_ena_COMPU_VTAB "Verbal Table" TAB_VERB "%.0" "list" COMPU_TAB_REF FT_bleedoff_ena_COMPU_VTAB_REF /end COMPU_METHOD
/begin COMPU_VTAB FT_bleedoff_ena_COMPU_VTAB_REF "Verbal Table" TAB_VERB 4 0 "Disabled" 1 "LPG only" 2 "NG only" 3 "LPG or NG" DEFAULT_VALUE "UNKNOWN" /end COMPU_VTAB
/begin MEASUREMENT FT_bleedoff_state "Bleed-off state{FT_bleedoff_state&0xff=0:Inactive}{FT_bleedoff_state&0xff=1:Active}" UBYTE FT_bleedoff_state_COMPU_VTAB 0 0 0 255 ECU_ADDRESS 0x0100C828 BIT_MASK 0xff /end MEASUREMENT
/begin COMPU_METHOD FT_bleedoff_state_COMPU_VTAB "Verbal Table" TAB_VERB "%.0" "list" COMPU_TAB_REF FT_bleedoff_state_COMPU_VTAB_REF /end COMPU_METHOD
/begin COMPU_VTAB FT_bleedoff_state_COMPU_VTAB_REF "Verbal Table" TAB_VERB 2 0 "Inactive" 1 "Active" DEFAULT_VALUE "UNKNOWN" /end COMPU_VTAB
/begin CHARACTERISTIC FT_bleedoff_dP_cmd "Bleed-off delta P" VALUE 0x00144312 /* @ECU_Address@FT_bleedoff_dP_cmd@0x0100C830@ */ ECIPP_ALIGNMENT_SWORD 222 Compu_FT_bleedoff_dP_cmd -222 221.993225097656 /end CHARACTERISTIC
/begin COMPU_METHOD Compu_FT_bleedoff_dP_cmd " " RAT_FUNC "%.2" "in H2O" COEFFS 0 147.603603603604 0 0 0 1 /end COMPU_METHOD
/begin CHARACTERISTIC FT_bleedoff_Ptarget "Bleed-off target" VALUE 0x00144310 /* @ECU_Address@FT_bleedoff_Ptarget@0x0100C838@ */ ECIPP_ALIGNMENT_SWORD 222 Compu_FT_bleedoff_Ptarget -222 221.993225097656 /end CHARACTERISTIC
/begin COMPU_METHOD Compu_FT_bleedoff_Ptarget " " RAT_FUNC "%.2" "in H2O" COEFFS 0 147.603603603604 0 0 0 1 /end COMPU_METHOD
/begin MEASUREMENT active_fuel_loc "Active fuel location{active_fuel_loc&0xff=0:Ports}{active_fuel_loc&0xff=1:Pre-throttle}{active_fuel_loc&0xff=2:Cylinder IVO}{active_fuel_loc&0xff=3:Cylinder TDC}{active_fuel_loc&0xff=4:Post-throttle}{active_fuel_loc&0xff=5:Air filter}" UBYTE active_fuel_loc_COMPU_VTAB 0 0 0 255 ECU_ADDRESS 0x0100CCC0 BIT_MASK 0xff /end MEASUREMENT
/begin COMPU_METHOD active_fuel_loc_COMPU_VTAB "Verbal Table" TAB_VERB "%.0" "list" COMPU_TAB_REF active_fuel_loc_COMPU_VTAB_REF /end COMPU_METHOD
/begin COMPU_VTAB active_fuel_loc_COMPU_VTAB_REF "Verbal Table" TAB_VERB 6 0 "Ports" 1 "Pre-throttle" 2 "Cylinder IVO" 3 "Cylinder TDC" 4 "Post-throttle" 5 "Air filter" DEFAULT_VALUE "UNKNOWN" /end COMPU_VTAB
/begin CHARACTERISTIC EGRdP_cyl_events "EGRdP window" VALUE 0x00140090 /* @ECU_Address@EGRdP_cyl_events@0x0100CCD8@ */ ECIPP_ALIGNMENT_FLOAT32_IEEE 10000000000 Compu_EGRdP_cyl_events -10000000000 10000000000 /end CHARACTERISTIC
/begin COMPU_METHOD Compu_EGRdP_cyl_events " " RAT_FUNC "%.1" "cyl events" COEFFS 0 1 0 0 0 1 /end COMPU_METHOD
/begin CHARACTERISTIC CRI_Prail_hyst "Rail pressure minimum hysterisis" VALUE 0x0016c7ce /* @ECU_Address@CRI_Prail_hyst@0x0100CE90@ */ ECIPP_ALIGNMENT_UWORD 8192 Compu_CRI_Prail_hyst 0 8191.875 /end CHARACTERISTIC
/begin COMPU_METHOD Compu_CRI_Prail_hyst " " RAT_FUNC "%.1" "bar" COEFFS 0 8 0 0 0 1 /end COMPU_METHOD
/begin CHARACTERISTIC IMV_varcam_mode "Pulsed-IMV variable cam drive{IMV_varcam_mode&0xff=0:Fixed Drive - N/A}{IMV_varcam_mode&0xff=1:Variable Intake Cam Drive}{IMV_varcam_mode&0xff=2:Variable Exhaust Cam Drive}" VALUE 0x0016c836 /* @ECU_Address@IMV_varcam_mode@0x0100CE98@ */ ECIPP_ALIGNMENT_UBYTE 255 IMV_varcam_mode_COMPU_VTAB 0 255 BIT_MASK 0xff /end CHARACTERISTIC
/begin COMPU_METHOD IMV_varcam_mode_COMPU_VTAB "Verbal Table" TAB_VERB "%.0" "list" COMPU_TAB_REF IMV_varcam_mode_COMPU_VTAB_REF /end COMPU_METHOD
/begin COMPU_VTAB IMV_varcam_mode_COMPU_VTAB_REF "Verbal Table" TAB_VERB 3 0 "Fixed Drive - N/A" 1 "Variable Intake Cam Drive" 2 "Variable Exhaust Cam Drive" DEFAULT_VALUE "UNKNOWN" /end COMPU_VTAB
/begin CHARACTERISTIC IMV_varcam_nom "Pulsed-IMV variable cam nominal/crank ref" VALUE 0x0016c52a /* @ECU_Address@IMV_varcam_nom@0x0100CEA0@ */ ECIPP_ALIGNMENT_SWORD 2048 Compu_IMV_varcam_nom -2048 2047.9375 /end CHARACTERISTIC
/begin COMPU_METHOD Compu_IMV_varcam_nom " " RAT_FUNC "%.1" "CAD BTDC" COEFFS 0 16 0 0 0 1 /end COMPU_METHOD
/begin CHARACTERISTIC IMVpck_CAD_cycmin "Pulsed-IMV cranking post-sync fixed-time hold" VALUE 0x0016c800 /* @ECU_Address@IMVpck_CAD_cycmin@0x0100CEA8@ */ ECIPP_ALIGNMENT_UWORD 256 Compu_IMVpck_CAD_cycmin 0 255.99609375 /end CHARACTERISTIC
/begin COMPU_METHOD Compu_IMVpck_CAD_cycmin " " RAT_FUNC "%.2" "cycles" COEFFS 0 256 0 0 0 1 /end COMPU_METHOD
/begin CHARACTERISTIC IMVpck_CADfixed "Pulsed-IMV cranking post-sync fixed-CAD pulse" VALUE 0x0016c802 /* @ECU_Address@IMVpck_CADfixed@0x0100CEB0@ */ ECIPP_ALIGNMENT_UWORD 4096 Compu_IMVpck_CADfixed 0 4095.9375 /end CHARACTERISTIC
/begin COMPU_METHOD Compu_IMVpck_CADfixed " " RAT_FUNC "%.1" "CAD" COEFFS 0 16 0 0 0 1 /end COMPU_METHOD
/begin CHARACTERISTIC CRI_Pdry_min "Dry-rail pressure minimum for injection" VALUE 0x0016c7ca /* @ECU_Address@CRI_Pdry_min@0x0100CEB8@ */ ECIPP_ALIGNMENT_UWORD 8192 Compu_CRI_Pdry_min 0 8191.875 /end CHARACTERISTIC
/begin COMPU_METHOD Compu_CRI_Pdry_min " " RAT_FUNC "%.1" "bar" COEFFS 0 8 0 0 0 1 /end COMPU_METHOD
/begin CHARACTERISTIC CRI_Pdry_hyst "Dry-rail pressure minimum hysterisis" VALUE 0x0016c7c8 /* @ECU_Address@CRI_Pdry_hyst@0x0100CEC0@ */ ECIPP_ALIGNMENT_UWORD 8192 Compu_CRI_Pdry_hyst 0 8191.875 /end CHARACTERISTIC
/begin COMPU_METHOD Compu_CRI_Pdry_hyst " " RAT_FUNC "%.1" "bar" COEFFS 0 8 0 0 0 1 /end COMPU_METHOD
/begin CHARACTERISTIC CRI_Pdry_cycwait "Dry-rail detection extended cranking trigger" VALUE 0x0016c7c6 /* @ECU_Address@CRI_Pdry_cycwait@0x0100CEC8@ */ ECIPP_ALIGNMENT_UWORD 4096 Compu_CRI_Pdry_cycwait 0 4095.9375 /end CHARACTERISTIC
/begin COMPU_METHOD Compu_CRI_Pdry_cycwait " " RAT_FUNC "%.1" "cycles" COEFFS 0 16 0 0 0 1 /end COMPU_METHOD
/begin CHARACTERISTIC CRI_Pdry_runhold "Dry-rail mode post-run hold time" VALUE 0x0016c7cc /* @ECU_Address@CRI_Pdry_runhold@0x0100CED0@ */ ECIPP_ALIGNMENT_UWORD 66 Compu_CRI_Pdry_runhold 0 65.535 /end CHARACTERISTIC
/begin COMPU_METHOD Compu_CRI_Pdry_runhold " " RAT_FUNC "%.3" "sec" COEFFS 0 1000 0 0 0 1 /end COMPU_METHOD
/begin CHARACTERISTIC CRI_ontime_drymax "Dry-rail time-based max fuel pulse width" VALUE 0x0016c4fc /* @ECU_Address@CRI_ontime_drymax@0x0100CED8@ */ ECIPP_ALIGNMENT_ULONG 214748365 Compu_CRI_ontime_drymax 0 214748364.75 /end CHARACTERISTIC
/begin COMPU_METHOD Compu_CRI_ontime_drymax " " RAT_FUNC "%.0" "us" COEFFS 0 20 0 0 0 1 /end COMPU_METHOD
/begin MEASUREMENT CRI_IMVi_raw "IMV uncompensated current feedback value" SWORD Compu_CRI_IMVi_raw 0 0 -32 31.9990234375 ECU_ADDRESS 0x0100CEE0 /end MEASUREMENT
/begin COMPU_METHOD Compu_CRI_IMVi_raw " " RAT_FUNC "%.2" "amps" COEFFS 0 1024 0 0 0 1 /end COMPU_METHOD
/begin MEASUREMENT CRI_Prail_min_a "Rail pressure minimum actual instantaneous value" UWORD Compu_CRI_Prail_min_a 0 0 0 8191.875 ECU_ADDRESS 0x0100CF28 /end MEASUREMENT
/begin COMPU_METHOD Compu_CRI_Prail_min_a " " RAT_FUNC "%.1" "bar" COEFFS 0 8 0 0 0 1 /end COMPU_METHOD
/begin CHARACTERISTIC IMVpulse_Tmx_rpmeq "Pulsed-IMV waveform rpm-equivalent max duration cranking override" VALUE 0x0016c812 /* @ECU_Address@IMVpulse_Tmx_rpmeq@0x0100CF30@ */ ECIPP_ALIGNMENT_UWORD 65535 Compu_IMVpulse_Tmx_rpmeq 0 65535 /end CHARACTERISTIC
/begin COMPU_METHOD Compu_IMVpulse_Tmx_rpmeq " " RAT_FUNC "%.0" "rpm" COEFFS 0 1 0 0 0 1 /end COMPU_METHOD
/begin MEASUREMENT CRI_last_rise_time1 "CR injector 1A peak current rise time" SLONG Compu_CRI_last_rise_time1 0 0 -107374182.4 107374182.35 ECU_ADDRESS 0x0100CF48 /end MEASUREMENT
/begin COMPU_METHOD Compu_CRI_last_rise_time1 " " RAT_FUNC "%.0" "us" COEFFS 0 20 0 0 0 1 /end COMPU_METHOD
/begin MEASUREMENT CRI_last_rise_time2 "CR injector 2A peak current rise time" SLONG Compu_CRI_last_rise_time2 0 0 -107374182.4 107374182.35 ECU_ADDRESS 0x0100CF50 /end MEASUREMENT
/begin COMPU_METHOD Compu_CRI_last_rise_time2 " " RAT_FUNC "%.0" "us" COEFFS 0 20 0 0 0 1 /end COMPU_METHOD
/begin MEASUREMENT CRI_last_rise_time3 "CR injector 1B peak current rise time" SLONG Compu_CRI_last_rise_time3 0 0 -107374182.4 107374182.35 ECU_ADDRESS 0x0100CF58 /end MEASUREMENT
/begin COMPU_METHOD Compu_CRI_last_rise_time3 " " RAT_FUNC "%.0" "us" COEFFS 0 20 0 0 0 1 /end COMPU_METHOD
/begin MEASUREMENT CRI_last_rise_time4 "CR injector 2B peak current rise time" SLONG Compu_CRI_last_rise_time4 0 0 -107374182.4 107374182.35 ECU_ADDRESS 0x0100CF60 /end MEASUREMENT
/begin COMPU_METHOD Compu_CRI_last_rise_time4 " " RAT_FUNC "%.0" "us" COEFFS 0 20 0 0 0 1 /end COMPU_METHOD
/begin MEASUREMENT CRI_last_rise_time5 "CR injector 1C peak current rise time" SLONG Compu_CRI_last_rise_time5 0 0 -107374182.4 107374182.35 ECU_ADDRESS 0x0100CF68 /end MEASUREMENT
/begin COMPU_METHOD Compu_CRI_last_rise_time5 " " RAT_FUNC "%.0" "us" COEFFS 0 20 0 0 0 1 /end COMPU_METHOD
/begin MEASUREMENT CRI_last_rise_time6 "CR injector 2C peak current rise time" SLONG Compu_CRI_last_rise_time6 0 0 -107374182.4 107374182.35 ECU_ADDRESS 0x0100CF70 /end MEASUREMENT
/begin COMPU_METHOD Compu_CRI_last_rise_time6 " " RAT_FUNC "%.0" "us" COEFFS 0 20 0 0 0 1 /end COMPU_METHOD
/begin MEASUREMENT CRI_last_rise_time7 "CR injector 1D peak current rise time" SLONG Compu_CRI_last_rise_time7 0 0 -107374182.4 107374182.35 ECU_ADDRESS 0x0100CF78 /end MEASUREMENT
/begin COMPU_METHOD Compu_CRI_last_rise_time7 " " RAT_FUNC "%.0" "us" COEFFS 0 20 0 0 0 1 /end COMPU_METHOD
/begin MEASUREMENT CRI_last_rise_time8 "CR injector 2D peak current rise time" SLONG Compu_CRI_last_rise_time8 0 0 -107374182.4 107374182.35 ECU_ADDRESS 0x0100CF80 /end MEASUREMENT
/begin COMPU_METHOD Compu_CRI_last_rise_time8 " " RAT_FUNC "%.0" "us" COEFFS 0 20 0 0 0 1 /end COMPU_METHOD
/begin CHARACTERISTIC CRI_Pdry_ena "Dry-rail detection during extended cranking{CRI_Pdry_ena&0xff=0:Disabled}{CRI_Pdry_ena&0xff=1:Enabled}" VALUE 0x0016c82f /* @ECU_Address@CRI_Pdry_ena@0x0100CF88@ */ ECIPP_ALIGNMENT_UBYTE 255 CRI_Pdry_ena_COMPU_VTAB 0 255 BIT_MASK 0xff /end CHARACTERISTIC
/begin COMPU_METHOD CRI_Pdry_ena_COMPU_VTAB "Verbal Table" TAB_VERB "%.0" "list" COMPU_TAB_REF CRI_Pdry_ena_COMPU_VTAB_REF /end COMPU_METHOD
/begin COMPU_VTAB CRI_Pdry_ena_COMPU_VTAB_REF "Verbal Table" TAB_VERB 2 0 "Disabled" 1 "Enabled" DEFAULT_VALUE "UNKNOWN" /end COMPU_VTAB
/begin MEASUREMENT CRI_IMVi_halfpeak "Pulsed-IMV current at 1/2 rise-time to peak" SWORD Compu_CRI_IMVi_halfpeak 0 0 -32 31.9990234375 ECU_ADDRESS 0x0100CF90 /end MEASUREMENT
/begin COMPU_METHOD Compu_CRI_IMVi_halfpeak " " RAT_FUNC "%.2" "amps" COEFFS 0 1024 0 0 0 1 /end COMPU_METHOD
/begin CHARACTERISTIC Ginj_cs_max_pre "Max pre-running injections" VALUE 0x0014906C /* @ECU_Address@Ginj_cs_max_pre@0x0100D480@ */ ECIPP_ALIGNMENT_UWORD 65535 Compu_Ginj_cs_max_pre 0 65535 /end CHARACTERISTIC
/begin COMPU_METHOD Compu_Ginj_cs_max_pre " " RAT_FUNC "%.0" "count" COEFFS 0 1 0 0 0 1 /end COMPU_METHOD
/begin CHARACTERISTIC Ginj_cs_max_pre_I2 "Sec max pre-running injections" VALUE 0x001490A4 /* @ECU_Address@Ginj_cs_max_pre_I2@0x0100D488@ */ ECIPP_ALIGNMENT_UWORD 65535 Compu_Ginj_cs_max_pre_I2 0 65535 /end CHARACTERISTIC
/begin COMPU_METHOD Compu_Ginj_cs_max_pre_I2 " " RAT_FUNC "%.0" "count" COEFFS 0 1 0 0 0 1 /end COMPU_METHOD
/begin CHARACTERISTIC Ginj_cs_max_post "Max post-running injections" VALUE 0x0014906E /* @ECU_Address@Ginj_cs_max_post@0x0100D490@ */ ECIPP_ALIGNMENT_UWORD 65535 Compu_Ginj_cs_max_post 0 65535 /end CHARACTERISTIC
/begin COMPU_METHOD Compu_Ginj_cs_max_post " " RAT_FUNC "%.0" "count" COEFFS 0 1 0 0 0 1 /end COMPU_METHOD
/begin CHARACTERISTIC Ginj_cs_max_post_I2 "Sec max post-running injections" VALUE 0x001490A6 /* @ECU_Address@Ginj_cs_max_post_I2@0x0100D498@ */ ECIPP_ALIGNMENT_UWORD 65535 Compu_Ginj_cs_max_post_I2 0 65535 /end CHARACTERISTIC
/begin COMPU_METHOD Compu_Ginj_cs_max_post_I2 " " RAT_FUNC "%.0" "count" COEFFS 0 1 0 0 0 1 /end COMPU_METHOD
/begin CHARACTERISTIC Ginj_cs_ect "ECT threshold" VALUE 0x00149070 /* @ECU_Address@Ginj_cs_ect@0x0100D4A0@ */ ECIPP_ALIGNMENT_UWORD 564 Compu_Ginj_cs_ect -460 563.984375 /end CHARACTERISTIC
/begin COMPU_METHOD Compu_Ginj_cs_ect " " RAT_FUNC "%.1" "deg F" COEFFS 0 64 29440 0 0 1 /end COMPU_METHOD
/begin CHARACTERISTIC Ginj_cs_ect_I2 "Sec ECT threshold" VALUE 0x001490A8 /* @ECU_Address@Ginj_cs_ect_I2@0x0100D4A8@ */ ECIPP_ALIGNMENT_UWORD 564 Compu_Ginj_cs_ect_I2 -460 563.984375 /end CHARACTERISTIC
/begin COMPU_METHOD Compu_Ginj_cs_ect_I2 " " RAT_FUNC "%.1" "deg F" COEFFS 0 64 29440 0 0 1 /end COMPU_METHOD
/begin CHARACTERISTIC Ginj_cs_ptime "Peak current hold time" VALUE 0x00149072 /* @ECU_Address@Ginj_cs_ptime@0x0100D4B0@ */ ECIPP_ALIGNMENT_UWORD 210 Compu_Ginj_cs_ptime 0 209.712 /end CHARACTERISTIC
/begin COMPU_METHOD Compu_Ginj_cs_ptime " " RAT_FUNC "%.3" "ms" COEFFS 0 312.5 0 0 0 1 /end COMPU_METHOD
/begin CHARACTERISTIC Ginj_cs_ptime_I2 "Sec peak current hold time" VALUE 0x001490AA /* @ECU_Address@Ginj_cs_ptime_I2@0x0100D4B8@ */ ECIPP_ALIGNMENT_UWORD 210 Compu_Ginj_cs_ptime_I2 0 209.712 /end CHARACTERISTIC
/begin COMPU_METHOD Compu_Ginj_cs_ptime_I2 " " RAT_FUNC "%.3" "ms" COEFFS 0 312.5 0 0 0 1 /end COMPU_METHOD
/begin MEASUREMENT Ginj_cs_active "Cold start mode active{Ginj_cs_active&0xff=0:NO}{Ginj_cs_active&0xff=1:YES}" UBYTE Ginj_cs_active_COMPU_VTAB 0 0 0 255 ECU_ADDRESS 0x0100D4D0 BIT_MASK 0xff /end MEASUREMENT
/begin COMPU_METHOD Ginj_cs_active_COMPU_VTAB "Verbal Table" TAB_VERB "%.0" "list" COMPU_TAB_REF Ginj_cs_active_COMPU_VTAB_REF /end COMPU_METHOD
/begin COMPU_VTAB Ginj_cs_active_COMPU_VTAB_REF "Verbal Table" TAB_VERB 2 0 "NO" 1 "YES" DEFAULT_VALUE "UNKNOWN" /end COMPU_VTAB
/begin MEASUREMENT inj_count_prerun "Pre-running injection count" UWORD Compu_inj_count_prerun 0 0 0 65535 ECU_ADDRESS 0x0100D4D8 /end MEASUREMENT
/begin COMPU_METHOD Compu_inj_count_prerun " " RAT_FUNC "%.0" "-" COEFFS 0 1 0 0 0 1 /end COMPU_METHOD
/begin MEASUREMENT inj_count_postrun "Post-running injection count" UWORD Compu_inj_count_postrun 0 0 0 65535 ECU_ADDRESS 0x0100D4E0 /end MEASUREMENT
/begin COMPU_METHOD Compu_inj_count_postrun " " RAT_FUNC "%.0" "-" COEFFS 0 1 0 0 0 1 /end COMPU_METHOD
/begin MEASUREMENT Ginj_peakd_avg "Avg desired peak hold time" UWORD Compu_Ginj_peakd_avg 0 0 0 209.712 ECU_ADDRESS 0x0100D4E8 /end MEASUREMENT
/begin COMPU_METHOD Compu_Ginj_peakd_avg " " RAT_FUNC "%.3" "ms" COEFFS 0 312.5 0 0 0 1 /end COMPU_METHOD
/begin MEASUREMENT Ginj_peaka_avg "Avg actual peak hold time" UWORD Compu_Ginj_peaka_avg 0 0 0 209.712 ECU_ADDRESS 0x0100D4F0 /end MEASUREMENT
/begin COMPU_METHOD Compu_Ginj_peaka_avg " " RAT_FUNC "%.3" "ms" COEFFS 0 312.5 0 0 0 1 /end COMPU_METHOD
/begin CHARACTERISTIC FT_bleedoff_delay "Bleed-off start delay" VALUE 0x00147402 /* @ECU_Address@FT_bleedoff_delay@0x0100D4F8@ */ ECIPP_ALIGNMENT_UWORD 65535 Compu_FT_bleedoff_delay 0 65535 /end CHARACTERISTIC
/begin COMPU_METHOD Compu_FT_bleedoff_delay " " RAT_FUNC "%.0" "ms" COEFFS 0 1 0 0 0 1 /end COMPU_METHOD
/begin MEASUREMENT FT_bleedoff_fuelType "Bleed-off fuel type{FT_bleedoff_fuelType&0xff=0x00:Gasoline}{FT_bleedoff_fuelType&0xff=0x01:Propane}{FT_bleedoff_fuelType&0xff=0x02:Natural Gas}" UBYTE FT_bleedoff_fuelType_COMPU_VTAB 0 0 0 255 ECU_ADDRESS 0x0100D500 BIT_MASK 0xff /end MEASUREMENT
/begin COMPU_METHOD FT_bleedoff_fuelType_COMPU_VTAB "Verbal Table" TAB_VERB "%.0" "list" COMPU_TAB_REF FT_bleedoff_fuelType_COMPU_VTAB_REF /end COMPU_METHOD
/begin COMPU_VTAB FT_bleedoff_fuelType_COMPU_VTAB_REF "Verbal Table" TAB_VERB 3 0x00 "Gasoline" 0x01 "Propane" 0x02 "Natural Gas" DEFAULT_VALUE "UNKNOWN" /end COMPU_VTAB
/begin MEASUREMENT fuel_type_keyoff "Fuel type at last key off{fuel_type_keyoff&0xff=0x00:Gasoline}{fuel_type_keyoff&0xff=0x01:Propane}{fuel_type_keyoff&0xff=0x02:Natural Gas}" UBYTE fuel_type_keyoff_COMPU_VTAB 0 0 0 255 ECU_ADDRESS 0x0100D508 BIT_MASK 0xff /end MEASUREMENT
/begin COMPU_METHOD fuel_type_keyoff_COMPU_VTAB "Verbal Table" TAB_VERB "%.0" "list" COMPU_TAB_REF fuel_type_keyoff_COMPU_VTAB_REF /end COMPU_METHOD
/begin COMPU_VTAB fuel_type_keyoff_COMPU_VTAB_REF "Verbal Table" TAB_VERB 3 0x00 "Gasoline" 0x01 "Propane" 0x02 "Natural Gas" DEFAULT_VALUE "UNKNOWN" /end COMPU_VTAB
/begin CHARACTERISTIC TBI_fuel_calc "Throttle-body injection fuel calc{TBI_fuel_calc&0xff=0:Speed-density}{TBI_fuel_calc&0xff=1:Speed-density + dMAP}{TBI_fuel_calc&0xff=2:Throttle-model based}" VALUE 0x00148087 /* @ECU_Address@TBI_fuel_calc@0x0100D600@ */ ECIPP_ALIGNMENT_UBYTE 255 TBI_fuel_calc_COMPU_VTAB 0 255 BIT_MASK 0xff /end CHARACTERISTIC
/begin COMPU_METHOD TBI_fuel_calc_COMPU_VTAB "Verbal Table" TAB_VERB "%.0" "list" COMPU_TAB_REF TBI_fuel_calc_COMPU_VTAB_REF /end COMPU_METHOD
/begin COMPU_VTAB TBI_fuel_calc_COMPU_VTAB_REF "Verbal Table" TAB_VERB 3 0 "Speed-density" 1 "Speed-density + dMAP" 2 "Throttle-model based" DEFAULT_VALUE "UNKNOWN" /end COMPU_VTAB
/begin CHARACTERISTIC CRI_IMVpw_CAD "Pulsed-IMV CAD mode desired electrical pulse" VALUE 0x0016c7c4 /* @ECU_Address@CRI_IMVpw_CAD@0x0100D668@ */ ECIPP_ALIGNMENT_UWORD 4096 Compu_CRI_IMVpw_CAD 0 4095.9375 /end CHARACTERISTIC
/begin COMPU_METHOD Compu_CRI_IMVpw_CAD " " RAT_FUNC "%.1" "CAD" COEFFS 0 16 0 0 0 1 /end COMPU_METHOD
/begin CHARACTERISTIC CRI_IMVcad_min "Pulsed-IMV CAD mode min control duration" VALUE 0x0016c51e /* @ECU_Address@CRI_IMVcad_min@0x0100D670@ */ ECIPP_ALIGNMENT_SWORD 2048 Compu_CRI_IMVcad_min -2048 2047.9375 /end CHARACTERISTIC
/begin COMPU_METHOD Compu_CRI_IMVcad_min " " RAT_FUNC "%.1" "CAD" COEFFS 0 16 0 0 0 1 /end COMPU_METHOD
/begin CHARACTERISTIC CRI_IMVcad_max "Pulsed-IMV CAD mode max control duration" VALUE 0x0016c51c /* @ECU_Address@CRI_IMVcad_max@0x0100D678@ */ ECIPP_ALIGNMENT_SWORD 2048 Compu_CRI_IMVcad_max -2048 2047.9375 /end CHARACTERISTIC
/begin COMPU_METHOD Compu_CRI_IMVcad_max " " RAT_FUNC "%.1" "CAD" COEFFS 0 16 0 0 0 1 /end COMPU_METHOD
/begin CHARACTERISTIC CRI_grneng "Green-engine rail air purge mode{CRI_grneng&0xff=0:Disabled}{CRI_grneng&0xff=1:Manual trigger only}{CRI_grneng&0xff=2:Manual or Zero-Hour trigger}" VALUE 0x0016c832 /* @ECU_Address@CRI_grneng@0x0100D680@ */ ECIPP_ALIGNMENT_UBYTE 255 CRI_grneng_COMPU_VTAB 0 255 BIT_MASK 0xff /end CHARACTERISTIC
/begin COMPU_METHOD CRI_grneng_COMPU_VTAB "Verbal Table" TAB_VERB "%.0" "list" COMPU_TAB_REF CRI_grneng_COMPU_VTAB_REF /end COMPU_METHOD
/begin COMPU_VTAB CRI_grneng_COMPU_VTAB_REF "Verbal Table" TAB_VERB 3 0 "Disabled" 1 "Manual trigger only" 2 "Manual or Zero-Hour trigger" DEFAULT_VALUE "UNKNOWN" /end COMPU_VTAB
/begin MEASUREMENT CRI_grneng_state "Green-engine rail purge state{CRI_grneng_state&0xff=0:Inactive}{CRI_grneng_state&0xff=1:Purge Requested}{CRI_grneng_state&0xff=2:Purge Active}{CRI_grneng_state&0xff=3:Purge Completed}" UBYTE CRI_grneng_state_COMPU_VTAB 0 0 0 255 ECU_ADDRESS 0x0100D688 BIT_MASK 0xff /end MEASUREMENT
/begin COMPU_METHOD CRI_grneng_state_COMPU_VTAB "Verbal Table" TAB_VERB "%.0" "list" COMPU_TAB_REF CRI_grneng_state_COMPU_VTAB_REF /end COMPU_METHOD
/begin COMPU_VTAB CRI_grneng_state_COMPU_VTAB_REF "Verbal Table" TAB_VERB 4 0 "Inactive" 1 "Purge Requested" 2 "Purge Active" 3 "Purge Completed" DEFAULT_VALUE "UNKNOWN" /end COMPU_VTAB
/begin MEASUREMENT CRI_grneng_mantrig "Green-engine rail purge trigger{CRI_grneng_mantrig&0xff=0:Disarmed}{CRI_grneng_mantrig&0xff=1:Armed}" UBYTE CRI_grneng_mantrig_COMPU_VTAB 0 0 0 255 ECU_ADDRESS 0x0100D690 BIT_MASK 0xff /end MEASUREMENT
/begin COMPU_METHOD CRI_grneng_mantrig_COMPU_VTAB "Verbal Table" TAB_VERB "%.0" "list" COMPU_TAB_REF CRI_grneng_mantrig_COMPU_VTAB_REF /end COMPU_METHOD
/begin COMPU_VTAB CRI_grneng_mantrig_COMPU_VTAB_REF "Verbal Table" TAB_VERB 2 0 "Disarmed" 1 "Armed" DEFAULT_VALUE "UNKNOWN" /end COMPU_VTAB
/begin CHARACTERISTIC CRI_purge_tout "Rail purge duration time-out" VALUE 0x0016c7f8 /* @ECU_Address@CRI_purge_tout@0x0100D698@ */ ECIPP_ALIGNMENT_UWORD 65535 Compu_CRI_purge_tout 0 65535 /end CHARACTERISTIC
/begin COMPU_METHOD Compu_CRI_purge_tout " " RAT_FUNC "%.0" "ms" COEFFS 0 1 0 0 0 1 /end COMPU_METHOD
/begin MEASUREMENT CRI_purge_tmr "Rail purge duration timer" UWORD Compu_CRI_purge_tmr 0 0 0 65535 ECU_ADDRESS 0x0100D6A0 /end MEASUREMENT
/begin COMPU_METHOD Compu_CRI_purge_tmr " " RAT_FUNC "%.0" "ms" COEFFS 0 1 0 0 0 1 /end COMPU_METHOD
/begin MEASUREMENT CRI_purge_spkdis "Rail purge spark inhibit status{CRI_purge_spkdis&0xff=0:Spark Active}{CRI_purge_spkdis&0xff=1:Spark Inhibited}" UBYTE CRI_purge_spkdis_COMPU_VTAB 0 0 0 255 ECU_ADDRESS 0x0100D760 BIT_MASK 0xff /end MEASUREMENT
/begin COMPU_METHOD CRI_purge_spkdis_COMPU_VTAB "Verbal Table" TAB_VERB "%.0" "list" COMPU_TAB_REF CRI_purge_spkdis_COMPU_VTAB_REF /end COMPU_METHOD
/begin COMPU_VTAB CRI_purge_spkdis_COMPU_VTAB_REF "Verbal Table" TAB_VERB 2 0 "Spark Active" 1 "Spark Inhibited" DEFAULT_VALUE "UNKNOWN" /end COMPU_VTAB
/begin CHARACTERISTIC CRI_purge_spkpct "Rail purge spark inhibit fraction of time-out" VALUE 0x0016c7f6 /* @ECU_Address@CRI_purge_spkpct@0x0100D768@ */ ECIPP_ALIGNMENT_UWORD 100 Compu_CRI_purge_spkpct 0 99.9984741210938 /end CHARACTERISTIC
/begin COMPU_METHOD Compu_CRI_purge_spkpct " " RAT_FUNC "%.1" "%" COEFFS 0 655.36 0 0 0 1 /end COMPU_METHOD
/begin CHARACTERISTIC J1939_GFC_ena "Gaseous usage filters{J1939_GFC_ena&0xff=0:Disabled}{J1939_GFC_ena&0xff=1:Enabled}" VALUE 0x00147def /* @ECU_Address@J1939_GFC_ena@0x0100DA98@ */ ECIPP_ALIGNMENT_UBYTE 255 J1939_GFC_ena_COMPU_VTAB 0 255 BIT_MASK 0xff /end CHARACTERISTIC
/begin COMPU_METHOD J1939_GFC_ena_COMPU_VTAB "Verbal Table" TAB_VERB "%.0" "list" COMPU_TAB_REF J1939_GFC_ena_COMPU_VTAB_REF /end COMPU_METHOD
/begin COMPU_VTAB J1939_GFC_ena_COMPU_VTAB_REF "Verbal Table" TAB_VERB 2 0 "Disabled" 1 "Enabled" DEFAULT_VALUE "UNKNOWN" /end COMPU_VTAB
/begin CHARACTERISTIC J1939_GFC_tau1 "Gaseous filter tau" VALUE 0x001474F0 /* @ECU_Address@J1939_GFC_tau1@0x0100DAA0@ */ ECIPP_ALIGNMENT_UWORD 4096 Compu_J1939_GFC_tau1 0 4095.9375 /end CHARACTERISTIC
/begin COMPU_METHOD Compu_J1939_GFC_tau1 " " RAT_FUNC "%.1" "sec" COEFFS 0 16 0 0 0 1 /end COMPU_METHOD
/begin CHARACTERISTIC J1939_GFC_tau2 "Gaseous filter tau" VALUE 0x001474F2 /* @ECU_Address@J1939_GFC_tau2@0x0100DAA8@ */ ECIPP_ALIGNMENT_UWORD 4096 Compu_J1939_GFC_tau2 0 4095.9375 /end CHARACTERISTIC
/begin COMPU_METHOD Compu_J1939_GFC_tau2 " " RAT_FUNC "%.1" "sec" COEFFS 0 16 0 0 0 1 /end COMPU_METHOD
/begin MEASUREMENT J1939_GFC_m_hr1 "Gaseous mass/hour" UWORD Compu_J1939_GFC_m_hr1 0 0 0 655.35 ECU_ADDRESS 0x0100DAB0 /end MEASUREMENT
/begin COMPU_METHOD Compu_J1939_GFC_m_hr1 " " RAT_FUNC "%.2" "kg/hr" COEFFS 0 100 0 0 0 1 /end COMPU_METHOD
/begin MEASUREMENT J1939_GFC_m_hr2 "Gaseous mass/hour" UWORD Compu_J1939_GFC_m_hr2 0 0 0 655.35 ECU_ADDRESS 0x0100DAB8 /end MEASUREMENT
/begin COMPU_METHOD Compu_J1939_GFC_m_hr2 " " RAT_FUNC "%.2" "kg/hr" COEFFS 0 100 0 0 0 1 /end COMPU_METHOD
/begin MEASUREMENT J1939_GFC_m_100km1 "Gaseous mass/100 km" UWORD Compu_J1939_GFC_m_100km1 0 0 0 655.35 ECU_ADDRESS 0x0100DAC0 /end MEASUREMENT
/begin COMPU_METHOD Compu_J1939_GFC_m_100km1 " " RAT_FUNC "%.2" "kg" COEFFS 0 100 0 0 0 1 /end COMPU_METHOD
/begin MEASUREMENT J1939_GFC_m_100km2 "Gaseous mass/100 km" UWORD Compu_J1939_GFC_m_100km2 0 0 0 655.35 ECU_ADDRESS 0x0100DAC8 /end MEASUREMENT
/begin COMPU_METHOD Compu_J1939_GFC_m_100km2 " " RAT_FUNC "%.2" "kg" COEFFS 0 100 0 0 0 1 /end COMPU_METHOD
/begin CHARACTERISTIC EGRdP_Dz "EGR dP deadzone" VALUE 0x001401e0 /* @ECU_Address@EGRdP_Dz@0x0100DF68@ */ ECIPP_ALIGNMENT_SWORD 32 Compu_EGRdP_Dz -32 31.9990234375 /end CHARACTERISTIC
/begin COMPU_METHOD Compu_EGRdP_Dz " " RAT_FUNC "%.3" "psi" COEFFS 0 1024 0 0 0 1 /end COMPU_METHOD
/begin MEASUREMENT EGRLP_inst "EGRLP instantaneous" UWORD Compu_EGRLP_inst 0 0 0 255.99609375 ECU_ADDRESS 0x0100E070 /end MEASUREMENT
/begin COMPU_METHOD Compu_EGRLP_inst " " RAT_FUNC "%.2" "psia" COEFFS 0 256 0 0 0 1 /end COMPU_METHOD
/begin MEASUREMENT EGRHP_inst "EGRHP instantaneous" UWORD Compu_EGRHP_inst 0 0 0 255.99609375 ECU_ADDRESS 0x0100E078 /end MEASUREMENT
/begin COMPU_METHOD Compu_EGRHP_inst " " RAT_FUNC "%.2" "psia" COEFFS 0 256 0 0 0 1 /end COMPU_METHOD
/begin CHARACTERISTIC CRI_IMV_HW_period "IMV hardware PWM frequency" VALUE 0x0016c510 /* @ECU_Address@CRI_IMV_HW_period@0x0100E5E8@ */ ECIPP_ALIGNMENT_ULONG 10000000000 Compu_CRI_IMV_HW_period 0 10000000000 /end CHARACTERISTIC
/begin COMPU_METHOD Compu_CRI_IMV_HW_period " " RAT_FUNC "%.0" "Hz" COEFFS 0 0 1 0 0.00000005 0 /end COMPU_METHOD
/begin CHARACTERISTIC TPScmd_dmdot_n "Throttle flow derivative window" VALUE 0x001480ad /* @ECU_Address@TPScmd_dmdot_n@0x0100F008@ */ ECIPP_ALIGNMENT_UBYTE 1275 Compu_TPScmd_dmdot_n 0 1275 /end CHARACTERISTIC
/begin COMPU_METHOD Compu_TPScmd_dmdot_n " " RAT_FUNC "%.0" "ms" COEFFS 0 0.2 0 0 0 1 /end COMPU_METHOD
/begin CHARACTERISTIC TPScmd_dmdot_Dz "Throttle flow derivative deadzone" VALUE 0x00143b78 /* @ECU_Address@TPScmd_dmdot_Dz@0x0100F010@ */ ECIPP_ALIGNMENT_FLOAT32_IEEE 10000000000 Compu_TPScmd_dmdot_Dz -10000000000 10000000000 /end CHARACTERISTIC
/begin COMPU_METHOD Compu_TPScmd_dmdot_Dz " " RAT_FUNC "%.1" "g/s/s" COEFFS 0 1 0 0 0 1 /end COMPU_METHOD
/begin CHARACTERISTIC TPScmd_dmdot_LP "Throttle flow derivative low-pass" VALUE 0x00147c68 /* @ECU_Address@TPScmd_dmdot_LP@0x0100F018@ */ ECIPP_ALIGNMENT_UWORD 327680 Compu_TPScmd_dmdot_LP 0.45084 327680 /end CHARACTERISTIC
/begin COMPU_METHOD Compu_TPScmd_dmdot_LP " " FORM "%.1" "ms"
 /begin FORMULA "-5 / log(1 - (X1 / 65536))" FORMULA_INV "(1 - exp(-5/X1)) * 65536" /end FORMULA
/end COMPU_METHOD
/begin MEASUREMENT TPScmd_dmdot "Throttle flow derivative" FLOAT32_IEEE Compu_TPScmd_dmdot 0 0 -10000000000 10000000000 ECU_ADDRESS 0x0100F020 /end MEASUREMENT
/begin COMPU_METHOD Compu_TPScmd_dmdot " " RAT_FUNC "%.1" "g/s/s" COEFFS 0 1 0 0 0 1 /end COMPU_METHOD
/begin MEASUREMENT mdot_TPScmd_f "Throttle flow estimate" FLOAT32_IEEE Compu_mdot_TPScmd_f 0 0 -10000000000 10000000000 ECU_ADDRESS 0x0100F028 /end MEASUREMENT
/begin COMPU_METHOD Compu_mdot_TPScmd_f " " RAT_FUNC "%.1" "g/sec" COEFFS 0 1 0 0 0 1 /end COMPU_METHOD
/begin CHARACTERISTIC TPSdP_ena "TPSdP sensor{TPSdP_ena&0xff=0:Disabled}{TPSdP_ena&0xff=1:Aux PD1}{TPSdP_ena&0xff=2:Aux PD2}{TPSdP_ena&0xff=3:Aux PD3}{TPSdP_ena&0xff=4:Aux PUD1}{TPSdP_ena&0xff=5:Aux PUD2}{TPSdP_ena&0xff=6:Aux PUD3}{TPSdP_ena&0xff=7:Aux PUD4}{TPSdP_ena&0xff=8:Aux PUD5}{TP" VALUE 0x001480b0 /* @ECU_Address@TPSdP_ena@0x0100F0A8@ */ ECIPP_ALIGNMENT_UBYTE 255 TPSdP_ena_COMPU_VTAB 0 255 BIT_MASK 0xff /end CHARACTERISTIC
/begin COMPU_METHOD TPSdP_ena_COMPU_VTAB "Verbal Table" TAB_VERB "%.0" "list" COMPU_TAB_REF TPSdP_ena_COMPU_VTAB_REF /end COMPU_METHOD
/begin COMPU_VTAB TPSdP_ena_COMPU_VTAB_REF "Verbal Table" TAB_VERB 31 0 "Disabled" 1 "Aux PD1" 2 "Aux PD2" 3 "Aux PD3" 4 "Aux PUD1" 5 "Aux PUD2" 6 "Aux PUD3" 7 "Aux PUD4" 8 "Aux PUD5" 9 "Aux PUD6" 10 "Aux PUD7" 11 "Aux PUD8" 12 "Aux PUD9" 13 "Aux PUD10" 14 "Aux PUD11" 15 "Aux PUD12" 16 "Aux PUD13" 17 "Aux PUD14" 18 "Aux PUD15" 19 "CAN sourced" 20 "FPP2 Input" 21 "Aux PUD16" 22 "Aux PUD17" 23 "Aux PUD18" 24 "Aux PUD19" 25 "Aux PUD20" 26 "Aux PUD21" 27 "Aux PUD22" 28 "Aux PUD23" 29 "Aux PUD24" 30 "Aux PUD25" DEFAULT_VALUE "UNKNOWN" /end COMPU_VTAB
/begin CHARACTERISTIC TPSdP_config "TPSdP configuration{TPSdP_config&0xff=0:Differential (TIP-TOP)}{TPSdP_config&0xff=1:Absolute (TOP)}" VALUE 0x001480af /* @ECU_Address@TPSdP_config@0x0100F0B8@ */ ECIPP_ALIGNMENT_UBYTE 255 TPSdP_config_COMPU_VTAB 0 255 BIT_MASK 0xff /end CHARACTERISTIC
/begin COMPU_METHOD TPSdP_config_COMPU_VTAB "Verbal Table" TAB_VERB "%.0" "list" COMPU_TAB_REF TPSdP_config_COMPU_VTAB_REF /end COMPU_METHOD
/begin COMPU_VTAB TPSdP_config_COMPU_VTAB_REF "Verbal Table" TAB_VERB 2 0 "Differential (TIP-TOP)" 1 "Absolute (TOP)" DEFAULT_VALUE "UNKNOWN" /end COMPU_VTAB
/begin CHARACTERISTIC TPSdP_cyl_events "TPSdP averaging window" VALUE 0x00143b7c /* @ECU_Address@TPSdP_cyl_events@0x0100F0C0@ */ ECIPP_ALIGNMENT_FLOAT32_IEEE 10000000000 Compu_TPSdP_cyl_events -10000000000 10000000000 /end CHARACTERISTIC
/begin COMPU_METHOD Compu_TPSdP_cyl_events " " RAT_FUNC "%.1" "cyl events" COEFFS 0 1 0 0 0 1 /end COMPU_METHOD
/begin CHARACTERISTIC TPSdP_tau "TPSdP sensor low-pass" VALUE 0x00147c6c /* @ECU_Address@TPSdP_tau@0x0100F0C8@ */ ECIPP_ALIGNMENT_UWORD 163840 Compu_TPSdP_tau 0.16703 163840 /end CHARACTERISTIC
/begin COMPU_METHOD Compu_TPSdP_tau " " FORM "%.1" "ms"
 /begin FORMULA "-5 / log(1.0000000000001 - (X1 / 32768))" FORMULA_INV "(1.0000000000001 - exp(-5/X1)) * 32768" /end FORMULA
/end COMPU_METHOD
/begin CHARACTERISTIC TPSdP_offset_keywt "TPSdP offset key-on wait" VALUE 0x001478fa /* @ECU_Address@TPSdP_offset_keywt@0x0100F0D0@ */ ECIPP_ALIGNMENT_UWORD 65535 Compu_TPSdP_offset_keywt 0 65535 /end CHARACTERISTIC
/begin COMPU_METHOD Compu_TPSdP_offset_keywt " " RAT_FUNC "%.0" "ms" COEFFS 0 1 0 0 0 1 /end COMPU_METHOD
/begin CHARACTERISTIC TPSdP_offset_strtwt "TPSdP offset start inhibit" VALUE 0x001478fc /* @ECU_Address@TPSdP_offset_strtwt@0x0100F0D8@ */ ECIPP_ALIGNMENT_UWORD 65535 Compu_TPSdP_offset_strtwt 0 65535 /end CHARACTERISTIC
/begin COMPU_METHOD Compu_TPSdP_offset_strtwt " " RAT_FUNC "%.0" "ms" COEFFS 0 1 0 0 0 1 /end COMPU_METHOD
/begin CHARACTERISTIC TPSdP_offset_tau "TPSdP offset sampling tau" VALUE 0x00147c6a /* @ECU_Address@TPSdP_offset_tau@0x0100F0E0@ */ ECIPP_ALIGNMENT_UWORD 163840 Compu_TPSdP_offset_tau 0.16703 163840 /end CHARACTERISTIC
/begin COMPU_METHOD Compu_TPSdP_offset_tau " " FORM "%.1" "ms"
 /begin FORMULA "-5 / log(1.0000000000001 - (X1 / 32768))" FORMULA_INV "(1.0000000000001 - exp(-5/X1)) * 32768" /end FORMULA
/end COMPU_METHOD
/begin CHARACTERISTIC TPSdP_offset_dPmin "TPSdP offset sample min" VALUE 0x001453aa /* @ECU_Address@TPSdP_offset_dPmin@0x0100F0E8@ */ ECIPP_ALIGNMENT_SWORD 32 Compu_TPSdP_offset_dPmin -32 31.9990234375 /end CHARACTERISTIC
/begin COMPU_METHOD Compu_TPSdP_offset_dPmin " " RAT_FUNC "%.3" "psi" COEFFS 0 1024 0 0 0 1 /end COMPU_METHOD
/begin CHARACTERISTIC TPSdP_offset_dPmax "TPSdP offset sample max" VALUE 0x001453a8 /* @ECU_Address@TPSdP_offset_dPmax@0x0100F0F0@ */ ECIPP_ALIGNMENT_SWORD 32 Compu_TPSdP_offset_dPmax -32 31.9990234375 /end CHARACTERISTIC
/begin COMPU_METHOD Compu_TPSdP_offset_dPmax " " RAT_FUNC "%.3" "psi" COEFFS 0 1024 0 0 0 1 /end COMPU_METHOD
/begin MEASUREMENT TPSdP_inst_float "TPSdP instantaneous" FLOAT32_IEEE Compu_TPSdP_inst_float 0 0 -10000000000 10000000000 ECU_ADDRESS 0x0100F100 /end MEASUREMENT
/begin COMPU_METHOD Compu_TPSdP_inst_float " " RAT_FUNC "%.3" "psi" COEFFS 0 1 0 0 0 1 /end COMPU_METHOD
/begin MEASUREMENT TPSdP_float "TPSdP cyl averaged" FLOAT32_IEEE Compu_TPSdP_float 0 0 -10000000000 10000000000 ECU_ADDRESS 0x0100F108 /end MEASUREMENT
/begin COMPU_METHOD Compu_TPSdP_float " " RAT_FUNC "%.3" "psi" COEFFS 0 1 0 0 0 1 /end COMPU_METHOD
/begin CHARACTERISTIC FIMP_LL_ena "Load-limit fuel impurity method{FIMP_LL_ena&0xff=0x00:Disabled}{FIMP_LL_ena&0xff=0x01:Linear start-to-finish}{FIMP_LL_ena&0xff=0x02:Nonlinear derate table}{FIMP_LL_ena&0xff=0x03:Speed derate tables}" VALUE 0x00147d4c /* @ECU_Address@FIMP_LL_ena@0x0100FB88@ */ ECIPP_ALIGNMENT_UBYTE 255 FIMP_LL_ena_COMPU_VTAB 0 255 BIT_MASK 0xff /end CHARACTERISTIC
/begin COMPU_METHOD FIMP_LL_ena_COMPU_VTAB "Verbal Table" TAB_VERB "%.0" "list" COMPU_TAB_REF FIMP_LL_ena_COMPU_VTAB_REF /end COMPU_METHOD
/begin COMPU_VTAB FIMP_LL_ena_COMPU_VTAB_REF "Verbal Table" TAB_VERB 4 0x00 "Disabled" 0x01 "Linear start-to-finish" 0x02 "Nonlinear derate table" 0x03 "Speed derate tables" DEFAULT_VALUE "UNKNOWN" /end COMPU_VTAB
/begin CHARACTERISTIC FIMP_BTU_pure "Fuel BTU pure" VALUE 0x00146850 /* @ECU_Address@FIMP_BTU_pure@0x0100FB90@ */ ECIPP_ALIGNMENT_UWORD 65535 Compu_FIMP_BTU_pure 0 65535 /end CHARACTERISTIC
/begin COMPU_METHOD Compu_FIMP_BTU_pure " " RAT_FUNC "%.0" "BTU / cu ft" COEFFS 0 1 0 0 0 1 /end COMPU_METHOD
/begin CHARACTERISTIC FIMP_BTU_act "Fuel BTU actual" VALUE 0x0014684c /* @ECU_Address@FIMP_BTU_act@0x0100FB98@ */ ECIPP_ALIGNMENT_UWORD 65535 Compu_FIMP_BTU_act 0 65535 /end CHARACTERISTIC
/begin COMPU_METHOD Compu_FIMP_BTU_act " " RAT_FUNC "%.0" "BTU / cu ft" COEFFS 0 1 0 0 0 1 /end COMPU_METHOD
/begin CHARACTERISTIC FIMP_BTU_imp "Fuel BTU impure" VALUE 0x0014684e /* @ECU_Address@FIMP_BTU_imp@0x0100FBA0@ */ ECIPP_ALIGNMENT_UWORD 65535 Compu_FIMP_BTU_imp 0 65535 /end CHARACTERISTIC
/begin COMPU_METHOD Compu_FIMP_BTU_imp " " RAT_FUNC "%.0" "BTU / cu ft" COEFFS 0 1 0 0 0 1 /end COMPU_METHOD
/begin CHARACTERISTIC LOCKOFF3_pin "Tri-fuel gaseous lockoff enable pin{LOCKOFF3_pin&0xff=0:Aux PWM1}{LOCKOFF3_pin&0xff=1:Aux PWM2}{LOCKOFF3_pin&0xff=2:Aux PWM3}{LOCKOFF3_pin&0xff=3:Aux PWM4}{LOCKOFF3_pin&0xff=4:Aux PWM5}{LOCKOFF3_pin&0xff=5:Aux PWM6}{LOCKOFF3_pin&0xff=6:EGOH1}{LOCKOFF3_pin" VALUE 0x00147e13 /* @ECU_Address@LOCKOFF3_pin@0x0100FCF8@ */ ECIPP_ALIGNMENT_UBYTE 255 LOCKOFF3_pin_COMPU_VTAB 0 255 BIT_MASK 0xff /end CHARACTERISTIC
/begin COMPU_METHOD LOCKOFF3_pin_COMPU_VTAB "Verbal Table" TAB_VERB "%.0" "list" COMPU_TAB_REF LOCKOFF3_pin_COMPU_VTAB_REF /end COMPU_METHOD
/begin COMPU_VTAB LOCKOFF3_pin_COMPU_VTAB_REF "Verbal Table" TAB_VERB 10 0 "Aux PWM1" 1 "Aux PWM2" 2 "Aux PWM3" 3 "Aux PWM4" 4 "Aux PWM5" 5 "Aux PWM6" 6 "EGOH1" 7 "EGOH2" 8 "EGOH3" 9 "EGOH4" DEFAULT_VALUE "UNKNOWN" /end COMPU_VTAB
/begin CHARACTERISTIC fault_SD_dis_ena "Fault shutdown inhibit{fault_SD_dis_ena&0xff=0:Disabled}{fault_SD_dis_ena&0xff=1:Aux PU1 = Gnd}{fault_SD_dis_ena&0xff=2:Aux PU2 = Gnd}{fault_SD_dis_ena&0xff=3:Aux PU3 = Gnd}{fault_SD_dis_ena&0xff=4:Aux PUD1 = Gnd}{fault_SD_dis_ena&0xff=5:Aux PUD2 = Gnd}{f" VALUE 0x00148162 /* @ECU_Address@fault_SD_dis_ena@0x010106C8@ */ ECIPP_ALIGNMENT_UBYTE 255 fault_SD_dis_ena_COMPU_VTAB 0 255 BIT_MASK 0xff /end CHARACTERISTIC
/begin COMPU_METHOD fault_SD_dis_ena_COMPU_VTAB "Verbal Table" TAB_VERB "%.0" "list" COMPU_TAB_REF fault_SD_dis_ena_COMPU_VTAB_REF /end COMPU_METHOD
/begin COMPU_VTAB fault_SD_dis_ena_COMPU_VTAB_REF "Verbal Table" TAB_VERB 31 0 "Disabled" 1 "Aux PU1 = Gnd" 2 "Aux PU2 = Gnd" 3 "Aux PU3 = Gnd" 4 "Aux PUD1 = Gnd" 5 "Aux PUD2 = Gnd" 6 "Aux PUD3 = Gnd" 7 "Aux PUD4 = +V" 8 "Aux PUD5 = Gnd" 9 "Aux DIG1" 10 "Aux DIG2" 11 "Aux DIG3" 12 "Aux DIG4" 13 "Aux DIG5" 14 "Aux DIG6" 15 "Aux DIG7" 16 "Aux DIG8" 17 "Aux DIG9" 18 "Aux DIG10" 19 "Aux DIG11" 20 "Aux DIG12" 21 "Aux DIG13" 22 "Aux DIG14" 23 "Aux DIG15" 24 "Aux DIG16" 25 "Aux DIG17" 26 "Aux DIG18" 27 "Aux DIG19" 28 "Gov1" 29 "Gov2" 30 "CAN Sourced" DEFAULT_VALUE "UNKNOWN" /end COMPU_VTAB
/begin CHARACTERISTIC fault_SD_dis_cfg "Fault shutdown inhibit Aux DIG config{fault_SD_dis_cfg&0xff=0:Default}{fault_SD_dis_cfg&0xff=1:GND}{fault_SD_dis_cfg&0xff=2:GND/+V}{fault_SD_dis_cfg&0xff=3:+V}{fault_SD_dis_cfg&0xff=4:Open}" VALUE 0x00148161 /* @ECU_Address@fault_SD_dis_cfg@0x010106D0@ */ ECIPP_ALIGNMENT_UBYTE 255 fault_SD_dis_cfg_COMPU_VTAB 0 255 BIT_MASK 0xff /end CHARACTERISTIC
/begin COMPU_METHOD fault_SD_dis_cfg_COMPU_VTAB "Verbal Table" TAB_VERB "%.0" "list" COMPU_TAB_REF fault_SD_dis_cfg_COMPU_VTAB_REF /end COMPU_METHOD
/begin COMPU_VTAB fault_SD_dis_cfg_COMPU_VTAB_REF "Verbal Table" TAB_VERB 5 0 "Default" 1 "GND" 2 "GND/+V" 3 "+V" 4 "Open" DEFAULT_VALUE "UNKNOWN" /end COMPU_VTAB
/begin MEASUREMENT SD_inhibit "Fault shutdown inhibit active" UBYTE Compu_SD_inhibit 0 0 0 255 ECU_ADDRESS 0x010106D8 /end MEASUREMENT
/begin COMPU_METHOD Compu_SD_inhibit " " RAT_FUNC "%.0" "-" COEFFS 0 1 0 0 0 1 /end COMPU_METHOD
/begin CHARACTERISTIC EGRHPLP_Dz "EGR HP/LP cubic deadzone" VALUE 0x00140040 /* @ECU_Address@EGRHPLP_Dz@0x01010758@ */ ECIPP_ALIGNMENT_FLOAT32_IEEE 10000000000 Compu_EGRHPLP_Dz -10000000000 10000000000 /end CHARACTERISTIC
/begin COMPU_METHOD Compu_EGRHPLP_Dz " " RAT_FUNC "%.2" "psi" COEFFS 0 1 0 0 0 1 /end COMPU_METHOD
/begin MEASUREMENT EGRLP_wdw "EGRLP windowed" FLOAT32_IEEE Compu_EGRLP_wdw 0 0 -10000000000 10000000000 ECU_ADDRESS 0x01010760 /end MEASUREMENT
/begin COMPU_METHOD Compu_EGRLP_wdw " " RAT_FUNC "%.2" "psia" COEFFS 0 1 0 0 0 1 /end COMPU_METHOD
/begin MEASUREMENT EGRHP_wdw "EGRHP windowed" FLOAT32_IEEE Compu_EGRHP_wdw 0 0 -10000000000 10000000000 ECU_ADDRESS 0x01010768 /end MEASUREMENT
/begin COMPU_METHOD Compu_EGRHP_wdw " " RAT_FUNC "%.2" "psia" COEFFS 0 1 0 0 0 1 /end COMPU_METHOD
/begin CHARACTERISTIC AFILTdP_tau "AFILTdP low-pass tau" VALUE 0x00147bbc /* @ECU_Address@AFILTdP_tau@0x01011428@ */ ECIPP_ALIGNMENT_UWORD 163840 Compu_AFILTdP_tau 0.16703 163840 /end CHARACTERISTIC
/begin COMPU_METHOD Compu_AFILTdP_tau " " FORM "%.0" "ms"
 /begin FORMULA "-5 / log(1.0000000000001 - (X1 / 32768))" FORMULA_INV "(1.0000000000001 - exp(-5/X1)) * 32768" /end FORMULA
/end COMPU_METHOD
/begin CHARACTERISTIC AFILTdP_Dz "AFILT dP deadzone" VALUE 0x00144248 /* @ECU_Address@AFILTdP_Dz@0x01011430@ */ ECIPP_ALIGNMENT_SWORD 32 Compu_AFILTdP_Dz -32 31.9990234375 /end CHARACTERISTIC
/begin COMPU_METHOD Compu_AFILTdP_Dz " " RAT_FUNC "%.3" "psi" COEFFS 0 1024 0 0 0 1 /end COMPU_METHOD
/begin CHARACTERISTIC AFILTdP_cyl_events "AFILTdP window" VALUE 0x00143948 /* @ECU_Address@AFILTdP_cyl_events@0x01011438@ */ ECIPP_ALIGNMENT_FLOAT32_IEEE 10000000000 Compu_AFILTdP_cyl_events -10000000000 10000000000 /end CHARACTERISTIC
/begin COMPU_METHOD Compu_AFILTdP_cyl_events " " RAT_FUNC "%.1" "cyl events" COEFFS 0 1 0 0 0 1 /end COMPU_METHOD
/begin CHARACTERISTIC BIP_enabled "BIP detection{BIP_enabled&0xff=0:Disabled}{BIP_enabled&0xff=1:Enabled on main pulse}{BIP_enabled&0xff=2:Enabled on back-side pulse}" VALUE 0x00147cdc /* @ECU_Address@BIP_enabled@0x010119B0@ */ ECIPP_ALIGNMENT_UBYTE 255 BIP_enabled_COMPU_VTAB 0 255 BIT_MASK 0xff /end CHARACTERISTIC
/begin COMPU_METHOD BIP_enabled_COMPU_VTAB "Verbal Table" TAB_VERB "%.0" "list" COMPU_TAB_REF BIP_enabled_COMPU_VTAB_REF /end COMPU_METHOD
/begin COMPU_VTAB BIP_enabled_COMPU_VTAB_REF "Verbal Table" TAB_VERB 3 0 "Disabled" 1 "Enabled on main pulse" 2 "Enabled on back-side pulse" DEFAULT_VALUE "UNKNOWN" /end COMPU_VTAB
/begin CHARACTERISTIC BIP_min "Min BIP time" VALUE 0x0014669c /* @ECU_Address@BIP_min@0x010119B8@ */ ECIPP_ALIGNMENT_UWORD 65535 Compu_BIP_min 0 65535 /end CHARACTERISTIC
/begin COMPU_METHOD Compu_BIP_min " " RAT_FUNC "%.0" "us" COEFFS 0 1 0 0 0 1 /end COMPU_METHOD
/begin CHARACTERISTIC BIP_max "Max BIP time" VALUE 0x0014669a /* @ECU_Address@BIP_max@0x010119C0@ */ ECIPP_ALIGNMENT_UWORD 65535 Compu_BIP_max 0 65535 /end CHARACTERISTIC
/begin COMPU_METHOD Compu_BIP_max " " RAT_FUNC "%.0" "us" COEFFS 0 1 0 0 0 1 /end COMPU_METHOD
/begin CHARACTERISTIC BIP_num_pulses "Num pulses per BIP scan" VALUE 0x00147cdd /* @ECU_Address@BIP_num_pulses@0x010119C8@ */ ECIPP_ALIGNMENT_UBYTE 255 Compu_BIP_num_pulses 0 255 /end CHARACTERISTIC
/begin COMPU_METHOD Compu_BIP_num_pulses " " RAT_FUNC "%.0" "-" COEFFS 0 1 0 0 0 1 /end COMPU_METHOD
/begin CHARACTERISTIC BIP_tau "BIP discrete filter constant" VALUE 0x001466a0 /* @ECU_Address@BIP_tau@0x010119D0@ */ ECIPP_ALIGNMENT_UWORD 100 Compu_BIP_tau 0 99.9984741210938 /end CHARACTERISTIC
/begin COMPU_METHOD Compu_BIP_tau " " RAT_FUNC "%.0" "%" COEFFS 0 655.36 0 0 0 1 /end COMPU_METHOD
/begin CHARACTERISTIC BIP_nom "Nominal UCV BIP" VALUE 0x0014669e /* @ECU_Address@BIP_nom@0x010119D8@ */ ECIPP_ALIGNMENT_UWORD 65535 Compu_BIP_nom 0 65535 /end CHARACTERISTIC
/begin COMPU_METHOD Compu_BIP_nom " " RAT_FUNC "%.0" "us" COEFFS 0 1 0 0 0 1 /end COMPU_METHOD
/begin CHARACTERISTIC BIP_interval_ms "BIP detection interval" VALUE 0x0014409c /* @ECU_Address@BIP_interval_ms@0x010119E0@ */ ECIPP_ALIGNMENT_ULONG 4294967 Compu_BIP_interval_ms 0 4294967.295 /end CHARACTERISTIC
/begin COMPU_METHOD Compu_BIP_interval_ms " " RAT_FUNC "%.0" "seconds" COEFFS 0 1000 0 0 0 1 /end COMPU_METHOD
/begin CHARACTERISTIC BIP_dIinj_thld "Current slope thld" VALUE 0x0014394c /* @ECU_Address@BIP_dIinj_thld@0x010119E8@ */ ECIPP_ALIGNMENT_FLOAT32_IEEE 10000000000 Compu_BIP_dIinj_thld -10000000000 10000000000 /end CHARACTERISTIC
/begin COMPU_METHOD Compu_BIP_dIinj_thld " " RAT_FUNC "%.1" "mA/us" COEFFS 0 0.001 0 0 0 1 /end COMPU_METHOD
/begin MEASUREMENT CRI_LS_PH_off "CRI LS peak-hold control{CRI_LS_PH_off&0xff=0:Fast decay (normal)}{CRI_LS_PH_off&0xff=1:Slow decay (BIP detect)}" UBYTE CRI_LS_PH_off_COMPU_VTAB 0 0 0 255 ECU_ADDRESS 0x010119F0 BIT_MASK 0xff /end MEASUREMENT
/begin COMPU_METHOD CRI_LS_PH_off_COMPU_VTAB "Verbal Table" TAB_VERB "%.0" "list" COMPU_TAB_REF CRI_LS_PH_off_COMPU_VTAB_REF /end COMPU_METHOD
/begin COMPU_VTAB CRI_LS_PH_off_COMPU_VTAB_REF "Verbal Table" TAB_VERB 2 0 "Fast decay (normal)" 1 "Slow decay (BIP detect)" DEFAULT_VALUE "UNKNOWN" /end COMPU_VTAB
/begin MEASUREMENT BIP_last_cyl1 "BIP_last_cyl1" UWORD Compu_BIP_last_cyl1 0 0 0 65535 ECU_ADDRESS 0x010119F8 /end MEASUREMENT
/begin COMPU_METHOD Compu_BIP_last_cyl1 " " RAT_FUNC "%.0" "us" COEFFS 0 1 0 0 0 1 /end COMPU_METHOD
/begin MEASUREMENT BIP_last_cyl2 "BIP_last_cyl2" UWORD Compu_BIP_last_cyl2 0 0 0 65535 ECU_ADDRESS 0x01011A00 /end MEASUREMENT
/begin COMPU_METHOD Compu_BIP_last_cyl2 " " RAT_FUNC "%.0" "us" COEFFS 0 1 0 0 0 1 /end COMPU_METHOD
/begin MEASUREMENT BIP_last_cyl3 "BIP_last_cyl3" UWORD Compu_BIP_last_cyl3 0 0 0 65535 ECU_ADDRESS 0x01011A08 /end MEASUREMENT
/begin COMPU_METHOD Compu_BIP_last_cyl3 " " RAT_FUNC "%.0" "us" COEFFS 0 1 0 0 0 1 /end COMPU_METHOD
/begin MEASUREMENT BIP_last_cyl4 "BIP_last_cyl4" UWORD Compu_BIP_last_cyl4 0 0 0 65535 ECU_ADDRESS 0x01011A10 /end MEASUREMENT
/begin COMPU_METHOD Compu_BIP_last_cyl4 " " RAT_FUNC "%.0" "us" COEFFS 0 1 0 0 0 1 /end COMPU_METHOD
/begin MEASUREMENT BIP_last_cyl5 "BIP_last_cyl5" UWORD Compu_BIP_last_cyl5 0 0 0 65535 ECU_ADDRESS 0x01011A18 /end MEASUREMENT
/begin COMPU_METHOD Compu_BIP_last_cyl5 " " RAT_FUNC "%.0" "us" COEFFS 0 1 0 0 0 1 /end COMPU_METHOD
/begin MEASUREMENT BIP_last_cyl6 "BIP_last_cyl6" UWORD Compu_BIP_last_cyl6 0 0 0 65535 ECU_ADDRESS 0x01011A20 /end MEASUREMENT
/begin COMPU_METHOD Compu_BIP_last_cyl6 " " RAT_FUNC "%.0" "us" COEFFS 0 1 0 0 0 1 /end COMPU_METHOD
/begin MEASUREMENT BIP_last_cyl7 "BIP_last_cyl7" UWORD Compu_BIP_last_cyl7 0 0 0 65535 ECU_ADDRESS 0x01011A28 /end MEASUREMENT
/begin COMPU_METHOD Compu_BIP_last_cyl7 " " RAT_FUNC "%.0" "us" COEFFS 0 1 0 0 0 1 /end COMPU_METHOD
/begin MEASUREMENT BIP_last_cyl8 "BIP_last_cyl8" UWORD Compu_BIP_last_cyl8 0 0 0 65535 ECU_ADDRESS 0x01011A30 /end MEASUREMENT
/begin COMPU_METHOD Compu_BIP_last_cyl8 " " RAT_FUNC "%.0" "us" COEFFS 0 1 0 0 0 1 /end COMPU_METHOD
/begin MEASUREMENT BIP_cyl1 "BIP_cyl1" UWORD Compu_BIP_cyl1 0 0 0 65535 ECU_ADDRESS 0x01011A38 /end MEASUREMENT
/begin COMPU_METHOD Compu_BIP_cyl1 " " RAT_FUNC "%.0" "us" COEFFS 0 1 0 0 0 1 /end COMPU_METHOD
/begin MEASUREMENT BIP_cyl2 "BIP_cyl2" UWORD Compu_BIP_cyl2 0 0 0 65535 ECU_ADDRESS 0x01011A40 /end MEASUREMENT
/begin COMPU_METHOD Compu_BIP_cyl2 " " RAT_FUNC "%.0" "us" COEFFS 0 1 0 0 0 1 /end COMPU_METHOD
/begin MEASUREMENT BIP_cyl3 "BIP_cyl3" UWORD Compu_BIP_cyl3 0 0 0 65535 ECU_ADDRESS 0x01011A48 /end MEASUREMENT
/begin COMPU_METHOD Compu_BIP_cyl3 " " RAT_FUNC "%.0" "us" COEFFS 0 1 0 0 0 1 /end COMPU_METHOD
/begin MEASUREMENT BIP_cyl4 "BIP_cyl4" UWORD Compu_BIP_cyl4 0 0 0 65535 ECU_ADDRESS 0x01011A50 /end MEASUREMENT
/begin COMPU_METHOD Compu_BIP_cyl4 " " RAT_FUNC "%.0" "us" COEFFS 0 1 0 0 0 1 /end COMPU_METHOD
/begin MEASUREMENT BIP_cyl5 "BIP_cyl5" UWORD Compu_BIP_cyl5 0 0 0 65535 ECU_ADDRESS 0x01011A58 /end MEASUREMENT
/begin COMPU_METHOD Compu_BIP_cyl5 " " RAT_FUNC "%.0" "us" COEFFS 0 1 0 0 0 1 /end COMPU_METHOD
/begin MEASUREMENT BIP_cyl6 "BIP_cyl6" UWORD Compu_BIP_cyl6 0 0 0 65535 ECU_ADDRESS 0x01011A60 /end MEASUREMENT
/begin COMPU_METHOD Compu_BIP_cyl6 " " RAT_FUNC "%.0" "us" COEFFS 0 1 0 0 0 1 /end COMPU_METHOD
/begin MEASUREMENT BIP_cyl7 "BIP_cyl7" UWORD Compu_BIP_cyl7 0 0 0 65535 ECU_ADDRESS 0x01011A68 /end MEASUREMENT
/begin COMPU_METHOD Compu_BIP_cyl7 " " RAT_FUNC "%.0" "us" COEFFS 0 1 0 0 0 1 /end COMPU_METHOD
/begin MEASUREMENT BIP_cyl8 "BIP_cyl8" UWORD Compu_BIP_cyl8 0 0 0 65535 ECU_ADDRESS 0x01011A70 /end MEASUREMENT
/begin COMPU_METHOD Compu_BIP_cyl8 " " RAT_FUNC "%.0" "us" COEFFS 0 1 0 0 0 1 /end COMPU_METHOD
/begin MEASUREMENT BIP_CAD_offset_cyl1 "BIP_CAD_offset_cyl1" SWORD Compu_BIP_CAD_offset_cyl1 0 0 -2048 2047.9375 ECU_ADDRESS 0x01011A78 /end MEASUREMENT
/begin COMPU_METHOD Compu_BIP_CAD_offset_cyl1 " " RAT_FUNC "%.2" "CAD BTDCC" COEFFS 0 16 0 0 0 1 /end COMPU_METHOD
/begin MEASUREMENT BIP_CAD_offset_cyl2 "BIP_CAD_offset_cyl2" SWORD Compu_BIP_CAD_offset_cyl2 0 0 -2048 2047.9375 ECU_ADDRESS 0x01011A80 /end MEASUREMENT
/begin COMPU_METHOD Compu_BIP_CAD_offset_cyl2 " " RAT_FUNC "%.2" "CAD BTDCC" COEFFS 0 16 0 0 0 1 /end COMPU_METHOD
/begin MEASUREMENT BIP_CAD_offset_cyl3 "BIP_CAD_offset_cyl3" SWORD Compu_BIP_CAD_offset_cyl3 0 0 -2048 2047.9375 ECU_ADDRESS 0x01011A88 /end MEASUREMENT
/begin COMPU_METHOD Compu_BIP_CAD_offset_cyl3 " " RAT_FUNC "%.2" "CAD BTDCC" COEFFS 0 16 0 0 0 1 /end COMPU_METHOD
/begin MEASUREMENT BIP_CAD_offset_cyl4 "BIP_CAD_offset_cyl4" SWORD Compu_BIP_CAD_offset_cyl4 0 0 -2048 2047.9375 ECU_ADDRESS 0x01011A90 /end MEASUREMENT
/begin COMPU_METHOD Compu_BIP_CAD_offset_cyl4 " " RAT_FUNC "%.2" "CAD BTDCC" COEFFS 0 16 0 0 0 1 /end COMPU_METHOD
/begin MEASUREMENT BIP_CAD_offset_cyl5 "BIP_CAD_offset_cyl5" SWORD Compu_BIP_CAD_offset_cyl5 0 0 -2048 2047.9375 ECU_ADDRESS 0x01011A98 /end MEASUREMENT
/begin COMPU_METHOD Compu_BIP_CAD_offset_cyl5 " " RAT_FUNC "%.2" "CAD BTDCC" COEFFS 0 16 0 0 0 1 /end COMPU_METHOD
/begin MEASUREMENT BIP_CAD_offset_cyl6 "BIP_CAD_offset_cyl6" SWORD Compu_BIP_CAD_offset_cyl6 0 0 -2048 2047.9375 ECU_ADDRESS 0x01011AA0 /end MEASUREMENT
/begin COMPU_METHOD Compu_BIP_CAD_offset_cyl6 " " RAT_FUNC "%.2" "CAD BTDCC" COEFFS 0 16 0 0 0 1 /end COMPU_METHOD
/begin MEASUREMENT BIP_CAD_offset_cyl7 "BIP_CAD_offset_cyl7" SWORD Compu_BIP_CAD_offset_cyl7 0 0 -2048 2047.9375 ECU_ADDRESS 0x01011AA8 /end MEASUREMENT
/begin COMPU_METHOD Compu_BIP_CAD_offset_cyl7 " " RAT_FUNC "%.2" "CAD BTDCC" COEFFS 0 16 0 0 0 1 /end COMPU_METHOD
/begin MEASUREMENT BIP_CAD_offset_cyl8 "BIP_CAD_offset_cyl8" SWORD Compu_BIP_CAD_offset_cyl8 0 0 -2048 2047.9375 ECU_ADDRESS 0x01011AB0 /end MEASUREMENT
/begin COMPU_METHOD Compu_BIP_CAD_offset_cyl8 " " RAT_FUNC "%.2" "CAD BTDCC" COEFFS 0 16 0 0 0 1 /end COMPU_METHOD
/begin CHARACTERISTIC LPG_NG_ovlp "LPG->NG lockoff overlap" VALUE 0x00147570 /* @ECU_Address@LPG_NG_ovlp@0x01011AB8@ */ ECIPP_ALIGNMENT_UWORD 65535 Compu_LPG_NG_ovlp 0 65535 /end CHARACTERISTIC
/begin COMPU_METHOD Compu_LPG_NG_ovlp " " RAT_FUNC "%.0" "ms" COEFFS 0 1 0 0 0 1 /end COMPU_METHOD
/begin CHARACTERISTIC NG_LPG_ovlp "NG->LPG lockoff overlap" VALUE 0x00147656 /* @ECU_Address@NG_LPG_ovlp@0x01011AC0@ */ ECIPP_ALIGNMENT_UWORD 65535 Compu_NG_LPG_ovlp 0 65535 /end CHARACTERISTIC
/begin COMPU_METHOD Compu_NG_LPG_ovlp " " RAT_FUNC "%.0" "ms" COEFFS 0 1 0 0 0 1 /end COMPU_METHOD
/begin CHARACTERISTIC LPG_NG_lockout "LPG->NG lockout time" VALUE 0x001440fc /* @ECU_Address@LPG_NG_lockout@0x01011AC8@ */ ECIPP_ALIGNMENT_ULONG 4294967 Compu_LPG_NG_lockout 0 4294967.295 /end CHARACTERISTIC
/begin COMPU_METHOD Compu_LPG_NG_lockout " " RAT_FUNC "%.0" "s" COEFFS 0 1000 0 0 0 1 /end COMPU_METHOD
/begin CHARACTERISTIC faultact_AL_dis "Fault adaptive learn disable{faultact_AL_dis&0xff=0:Fuel}{faultact_AL_dis&0xff=1:Fuel+throttle}{faultact_AL_dis&0xff=2:Fuel+throttle+EGR valve}" VALUE 0x0016c321 /* @ECU_Address@faultact_AL_dis@0x01011B50@ */ ECIPP_ALIGNMENT_UBYTE 255 faultact_AL_dis_COMPU_VTAB 0 255 BIT_MASK 0xff /end CHARACTERISTIC
/begin COMPU_METHOD faultact_AL_dis_COMPU_VTAB "Verbal Table" TAB_VERB "%.0" "list" COMPU_TAB_REF faultact_AL_dis_COMPU_VTAB_REF /end COMPU_METHOD
/begin COMPU_VTAB faultact_AL_dis_COMPU_VTAB_REF "Verbal Table" TAB_VERB 3 0 "Fuel" 1 "Fuel+throttle" 2 "Fuel+throttle+EGR valve" DEFAULT_VALUE "UNKNOWN" /end COMPU_VTAB
/begin CHARACTERISTIC FIP_LL_ena "Fuel inlet pressure load-limiting{FIP_LL_ena&0xff=0:Disabled}{FIP_LL_ena&0xff=1:Enabled}" VALUE 0x00147d53 /* @ECU_Address@FIP_LL_ena@0x01011FC8@ */ ECIPP_ALIGNMENT_UBYTE 255 FIP_LL_ena_COMPU_VTAB 0 255 BIT_MASK 0xff /end CHARACTERISTIC
/begin COMPU_METHOD FIP_LL_ena_COMPU_VTAB "Verbal Table" TAB_VERB "%.0" "list" COMPU_TAB_REF FIP_LL_ena_COMPU_VTAB_REF /end COMPU_METHOD
/begin COMPU_VTAB FIP_LL_ena_COMPU_VTAB_REF "Verbal Table" TAB_VERB 2 0 "Disabled" 1 "Enabled" DEFAULT_VALUE "UNKNOWN" /end COMPU_VTAB
/begin CHARACTERISTIC LOCKOFF4_pin "Tri-Fuel seconday gaseous lockoff{LOCKOFF4_pin&0xff=0:Disabled}{LOCKOFF4_pin&0xff=1:Secondary lockoff pin}{LOCKOFF4_pin&0xff=2:Aux PWM1}{LOCKOFF4_pin&0xff=3:Aux PWM2}{LOCKOFF4_pin&0xff=4:Aux PWM3}{LOCKOFF4_pin&0xff=5:Aux PWM4}{LOCKOFF4_pin&0xff=6:Aux PWM5" VALUE 0x00147e14 /* @ECU_Address@LOCKOFF4_pin@0x010120A8@ */ ECIPP_ALIGNMENT_UBYTE 255 LOCKOFF4_pin_COMPU_VTAB 0 255 BIT_MASK 0xff /end CHARACTERISTIC
/begin COMPU_METHOD LOCKOFF4_pin_COMPU_VTAB "Verbal Table" TAB_VERB "%.0" "list" COMPU_TAB_REF LOCKOFF4_pin_COMPU_VTAB_REF /end COMPU_METHOD
/begin COMPU_VTAB LOCKOFF4_pin_COMPU_VTAB_REF "Verbal Table" TAB_VERB 12 0 "Disabled" 1 "Secondary lockoff pin" 2 "Aux PWM1" 3 "Aux PWM2" 4 "Aux PWM3" 5 "Aux PWM4" 6 "Aux PWM5" 7 "Aux PWM6" 8 "EGOH1" 9 "EGOH2" 10 "EGOH3" 11 "EGOH4" DEFAULT_VALUE "UNKNOWN" /end COMPU_VTAB
/begin CHARACTERISTIC faultact_persist "Fault action persist mode{faultact_persist&0xff=0:Cycle}{faultact_persist&0xff=1:Fault state}" VALUE 0x00148165 /* @ECU_Address@faultact_persist@0x010120B8@ */ ECIPP_ALIGNMENT_UBYTE 255 faultact_persist_COMPU_VTAB 0 255 BIT_MASK 0xff /end CHARACTERISTIC
/begin COMPU_METHOD faultact_persist_COMPU_VTAB "Verbal Table" TAB_VERB "%.0" "list" COMPU_TAB_REF faultact_persist_COMPU_VTAB_REF /end COMPU_METHOD
/begin COMPU_VTAB faultact_persist_COMPU_VTAB_REF "Verbal Table" TAB_VERB 2 0 "Cycle" 1 "Fault state" DEFAULT_VALUE "UNKNOWN" /end COMPU_VTAB
/begin CHARACTERISTIC faultact_persist_cyc "Fault action persist cycles" VALUE 0x00148167 /* @ECU_Address@faultact_persist_cyc@0x010120C0@ */ ECIPP_ALIGNMENT_UBYTE 255 Compu_faultact_persist_cyc 0 255 /end CHARACTERISTIC
/begin COMPU_METHOD Compu_faultact_persist_cyc " " RAT_FUNC "%.0" "cycles" COEFFS 0 1 0 0 0 1 /end COMPU_METHOD
/begin CHARACTERISTIC faultact_persist_MIL "Fault action persist MIL{faultact_persist_MIL&0xff=0:Disabled}{faultact_persist_MIL&0xff=1:Enabled}" VALUE 0x00148166 /* @ECU_Address@faultact_persist_MIL@0x010120C8@ */ ECIPP_ALIGNMENT_UBYTE 255 faultact_persist_MIL_COMPU_VTAB 0 255 BIT_MASK 0xff /end CHARACTERISTIC
/begin COMPU_METHOD faultact_persist_MIL_COMPU_VTAB "Verbal Table" TAB_VERB "%.0" "list" COMPU_TAB_REF faultact_persist_MIL_COMPU_VTAB_REF /end COMPU_METHOD
/begin COMPU_VTAB faultact_persist_MIL_COMPU_VTAB_REF "Verbal Table" TAB_VERB 2 0 "Disabled" 1 "Enabled" DEFAULT_VALUE "UNKNOWN" /end COMPU_VTAB
/begin CHARACTERISTIC CRI_i_peak_init_BIP "BIP initial peak current" VALUE 0x00146766 /* @ECU_Address@CRI_i_peak_init_BIP@0x010127E8@ */ ECIPP_ALIGNMENT_UWORD 128 Compu_CRI_i_peak_init_BIP 0 127.998046875 /end CHARACTERISTIC
/begin COMPU_METHOD Compu_CRI_i_peak_init_BIP " " RAT_FUNC "%.1" "amps" COEFFS 0 512 0 0 0 1 /end COMPU_METHOD
/begin CHARACTERISTIC CRI_i_peak_BIP "BIP peak current" VALUE 0x00146764 /* @ECU_Address@CRI_i_peak_BIP@0x010127F0@ */ ECIPP_ALIGNMENT_UWORD 128 Compu_CRI_i_peak_BIP 0 127.998046875 /end CHARACTERISTIC
/begin COMPU_METHOD Compu_CRI_i_peak_BIP " " RAT_FUNC "%.1" "amps" COEFFS 0 512 0 0 0 1 /end COMPU_METHOD
/begin CHARACTERISTIC CRI_i_hold_BIP "BIP hold current" VALUE 0x00146762 /* @ECU_Address@CRI_i_hold_BIP@0x010127F8@ */ ECIPP_ALIGNMENT_UWORD 128 Compu_CRI_i_hold_BIP 0 127.998046875 /end CHARACTERISTIC
/begin COMPU_METHOD Compu_CRI_i_hold_BIP " " RAT_FUNC "%.1" "amps" COEFFS 0 512 0 0 0 1 /end COMPU_METHOD
/begin CHARACTERISTIC CRI_cad_post2_BIP "BIP back-side pulse timing" VALUE 0x00144276 /* @ECU_Address@CRI_cad_post2_BIP@0x01012800@ */ ECIPP_ALIGNMENT_SWORD 2048 Compu_CRI_cad_post2_BIP -2048 2047.9375 /end CHARACTERISTIC
/begin COMPU_METHOD Compu_CRI_cad_post2_BIP " " RAT_FUNC "%.1" "CAD BTDCC" COEFFS 0 16 0 0 0 1 /end COMPU_METHOD
/begin CHARACTERISTIC CRI_width_post2_BIP "BIP back-side pulse width" VALUE 0x001440b4 /* @ECU_Address@CRI_width_post2_BIP@0x01012808@ */ ECIPP_ALIGNMENT_ULONG 214748365 Compu_CRI_width_post2_BIP 0 214748364.75 /end CHARACTERISTIC
/begin COMPU_METHOD Compu_CRI_width_post2_BIP " " RAT_FUNC "%.0" "us" COEFFS 0 20 0 0 0 1 /end COMPU_METHOD
/begin MEASUREMENT EGRdP_wdw_dz_lp "EGRdP windowed, deadzoned, and low-passed" SWORD Compu_EGRdP_wdw_dz_lp 0 0 -32 31.9990234375 ECU_ADDRESS 0x01012998 /end MEASUREMENT
/begin COMPU_METHOD Compu_EGRdP_wdw_dz_lp " " RAT_FUNC "%.3" "psi" COEFFS 0 1024 0 0 0 1 /end COMPU_METHOD
/begin MEASUREMENT EGRHP_wdw_dz_lp "EGRHP windowed, deadzoned, and low-passed" FLOAT32_IEEE Compu_EGRHP_wdw_dz_lp 0 0 -10000000000 10000000000 ECU_ADDRESS 0x010129A0 /end MEASUREMENT
/begin COMPU_METHOD Compu_EGRHP_wdw_dz_lp " " RAT_FUNC "%.2" "psia" COEFFS 0 1 0 0 0 1 /end COMPU_METHOD
/begin MEASUREMENT EGRHP_mdl_float "EGRHP modeled" FLOAT32_IEEE Compu_EGRHP_mdl_float 0 0 -10000000000 10000000000 ECU_ADDRESS 0x010129A8 /end MEASUREMENT
/begin COMPU_METHOD Compu_EGRHP_mdl_float " " RAT_FUNC "%.2" "psia" COEFFS 0 1 0 0 0 1 /end COMPU_METHOD
/begin CHARACTERISTIC FPC_FP_source "Liquid fuel pressure source{FPC_FP_source&0xff=0:Primary}{FPC_FP_source&0xff=1:Secondary}" VALUE 0x00147d5b /* @ECU_Address@FPC_FP_source@0x010130C0@ */ ECIPP_ALIGNMENT_UBYTE 255 FPC_FP_source_COMPU_VTAB 0 255 BIT_MASK 0xff /end CHARACTERISTIC
/begin COMPU_METHOD FPC_FP_source_COMPU_VTAB "Verbal Table" TAB_VERB "%.0" "list" COMPU_TAB_REF FPC_FP_source_COMPU_VTAB_REF /end COMPU_METHOD
/begin COMPU_VTAB FPC_FP_source_COMPU_VTAB_REF "Verbal Table" TAB_VERB 2 0 "Primary" 1 "Secondary" DEFAULT_VALUE "UNKNOWN" /end COMPU_VTAB
/begin CHARACTERISTIC lockoff_keyoff_ena "LPG lockoff close at Vswitch drop{lockoff_keyoff_ena&0xff=0:Disabled}{lockoff_keyoff_ena&0xff=1:Enabled}" VALUE 0x001481a6 /* @ECU_Address@lockoff_keyoff_ena@0x01013920@ */ ECIPP_ALIGNMENT_UBYTE 255 lockoff_keyoff_ena_COMPU_VTAB 0 255 BIT_MASK 0xff /end CHARACTERISTIC
/begin COMPU_METHOD lockoff_keyoff_ena_COMPU_VTAB "Verbal Table" TAB_VERB "%.0" "list" COMPU_TAB_REF lockoff_keyoff_ena_COMPU_VTAB_REF /end COMPU_METHOD
/begin COMPU_VTAB lockoff_keyoff_ena_COMPU_VTAB_REF "Verbal Table" TAB_VERB 2 0 "Disabled" 1 "Enabled" DEFAULT_VALUE "UNKNOWN" /end COMPU_VTAB
/begin CHARACTERISTIC Tinj_CAD_CAD "Injection Timing - Primary" MAP 0x00145E46 /* @ECU_Address@Tinj_CAD_CAD@0x02014000@ */ ECIPP_ALIGNMENT_SWORD 2048 Compu_Tinj_CAD_CAD -2048 2047.9375
 /begin AXIS_DESCR COM_AXIS NO_INPUT_QUANTITY Compu_Tinj_CAD_PW 8 -104.8576 104.8544 AXIS_PTS_REF Tinj_CAD_PW /end AXIS_DESCR
 /begin AXIS_DESCR COM_AXIS NO_INPUT_QUANTITY Compu_Tinj_CAD_rpm 8 -32768 32767 AXIS_PTS_REF Tinj_CAD_rpm /end AXIS_DESCR
/end CHARACTERISTIC
/begin AXIS_PTS Tinj_CAD_PW " " 0x00145F46 /* @ECU_Address@Tinj_CAD_PW@0x02015000@ */ NO_INPUT_QUANTITY ECIPP_Lookup_SWORD 0 Compu_Tinj_CAD_PW 8 -104.8576 104.8544 /end AXIS_PTS
/begin AXIS_PTS Tinj_CAD_rpm " " 0x00145F66 /* @ECU_Address@Tinj_CAD_rpm@0x02016000@ */ NO_INPUT_QUANTITY ECIPP_Lookup_SWORD 0 Compu_Tinj_CAD_rpm 8 -32768 32767 /end AXIS_PTS
/begin COMPU_METHOD Compu_Tinj_CAD_CAD "" RAT_FUNC "%.0" "CAD BBDC Intake" COEFFS 0 16 0 0 0 1 /end COMPU_METHOD
/begin COMPU_METHOD Compu_Tinj_CAD_PW " " RAT_FUNC "%.1" "PW (ms)" COEFFS 0 312.5 0 0 0 1 /end COMPU_METHOD
/begin COMPU_METHOD Compu_Tinj_CAD_rpm " " RAT_FUNC "%.0" "Speed (rpm)" COEFFS 0 1 0 0 0 1 /end COMPU_METHOD
/begin CHARACTERISTIC Trpmdt_rpmdtn "rpmdt Filtering" CURVE 0x00145FBE /* @ECU_Address@Trpmdt_rpmdtn@0x02074000@ */ ECIPP_ALIGNMENT_SWORD 640 Compu_Trpmdt_rpmdtn -640 639.98046875
 /begin AXIS_DESCR COM_AXIS NO_INPUT_QUANTITY Compu_Trpmdt_rpm 4 -32768 32767 AXIS_PTS_REF Trpmdt_rpm /end AXIS_DESCR
/end CHARACTERISTIC
/begin AXIS_PTS Trpmdt_rpm " " 0x00145FB6 /* @ECU_Address@Trpmdt_rpm@0x0207D000@ */ NO_INPUT_QUANTITY ECIPP_Lookup_SWORD 0 Compu_Trpmdt_rpm 4 -32768 32767 /end AXIS_PTS
/begin COMPU_METHOD Compu_Trpmdt_rpmdtn " " RAT_FUNC "%.0" "rpmdt Window (5ms)" COEFFS 0 51.2 0 0 0 1 /end COMPU_METHOD
/begin CHARACTERISTIC Trpmdt_rpmdtx "rpmdt Filtering" CURVE 0x00147C6E /* @ECU_Address@Trpmdt_rpmdtx@0x02075000@ */ ECIPP_ALIGNMENT_UWORD 163840 Compu_Trpmdt_rpmdtx 0.16703 163840
 /begin AXIS_DESCR COM_AXIS NO_INPUT_QUANTITY Compu_Trpmdt_rpm 4 -32768 32767 AXIS_PTS_REF Trpmdt_rpm /end AXIS_DESCR
/end CHARACTERISTIC
/begin COMPU_METHOD Compu_Trpmdt_rpmdtx " " FORM "%.3" "rpmdt Low-Pass (ms)"
 /begin FORMULA "-5 / log(1.0000000000001 - (X1 / 32768))" FORMULA_INV "(1.0000000000001 - exp(-5/X1)) * 32768" /end FORMULA
/end COMPU_METHOD
/begin COMPU_METHOD Compu_TMAPp_rpm_rpm " " RAT_FUNC "%.0" "Speed (rpm)" COEFFS 0 1 0 0 0 1 /end COMPU_METHOD
/begin CHARACTERISTIC TMAPp_rpm_CAD "MAP Noise Phase" CURVE 0x0014519E /* @ECU_Address@TMAPp_rpm_CAD@0x02079000@ */ ECIPP_ALIGNMENT_SWORD 32767 Compu_TMAPp_rpm_CAD -32768 32767
 /begin AXIS_DESCR COM_AXIS NO_INPUT_QUANTITY Compu_TMAPp_rpm_rpm 4 -32768 32767 AXIS_PTS_REF TMAPp_rpm_rpm /end AXIS_DESCR
/end CHARACTERISTIC
/begin AXIS_PTS TMAPp_rpm_rpm " " 0x001451AE /* @ECU_Address@TMAPp_rpm_rpm@0x02078000@ */ NO_INPUT_QUANTITY ECIPP_Lookup_SWORD 0 Compu_TMAPp_rpm_rpm 4 -32768 32767 /end AXIS_PTS
/begin COMPU_METHOD Compu_TMAPp_rpm_CAD " " RAT_FUNC "%.0" "Phase (CAD)" COEFFS 0 1 0 0 0 1 /end COMPU_METHOD
/begin CHARACTERISTIC TMAPp_rpm_psi "MAP Noise P-P Magnitude" CURVE 0x001451A6 /* @ECU_Address@TMAPp_rpm_psi@0x0207A000@ */ ECIPP_ALIGNMENT_SWORD 128 Compu_TMAPp_rpm_psi -128 127.99609375
 /begin AXIS_DESCR COM_AXIS NO_INPUT_QUANTITY Compu_TMAPp_rpm_rpm 4 -32768 32767 AXIS_PTS_REF TMAPp_rpm_rpm /end AXIS_DESCR
/end CHARACTERISTIC
/begin COMPU_METHOD Compu_TMAPp_rpm_psi " " RAT_FUNC "%.2" "P-P Mag (psi)" COEFFS 0 256 0 0 0 1 /end COMPU_METHOD
/begin COMPU_METHOD Compu_Trpmdt_rpm " " RAT_FUNC "%.0" "Speed (rpm)" COEFFS 0 1 0 0 0 1 /end COMPU_METHOD
/begin COMPU_METHOD Compu_MAPdtMAP_MAP " " RAT_FUNC "%.2" "MAPss (psia)" COEFFS 0 256 0 0 0 1 /end COMPU_METHOD
/begin CHARACTERISTIC MAPdtMAP_dz "MAPdt MAP Based Trigger" CURVE 0x00144352 /* @ECU_Address@MAPdtMAP_dz@0x020FC000@ */ ECIPP_ALIGNMENT_SWORD 4000 Compu_MAPdtMAP_dz -4000 3999.8779296875
 /begin AXIS_DESCR COM_AXIS NO_INPUT_QUANTITY Compu_MAPdtMAP_MAP 4 -128 127.99609375 AXIS_PTS_REF MAPdtMAP_MAP /end AXIS_DESCR
/end CHARACTERISTIC
/begin AXIS_PTS MAPdtMAP_MAP " " 0x0014434A /* @ECU_Address@MAPdtMAP_MAP@0x020FB000@ */ NO_INPUT_QUANTITY ECIPP_Lookup_SWORD 0 Compu_MAPdtMAP_MAP 4 -128 127.99609375 /end AXIS_PTS
/begin COMPU_METHOD Compu_MAPdtMAP_dz " " RAT_FUNC "%.1" "MAPdt (psi/sec)" COEFFS 0 8.192 0 0 0 1 /end COMPU_METHOD
/begin COMPU_METHOD Compu_TFPC_mdotf " " RAT_FUNC "%.2" "fuel (g/sec)" COEFFS 0 256 0 0 0 1 /end COMPU_METHOD
/begin CHARACTERISTIC TFPC_Vnom "Fuel Pump Feedforward Voltage" CURVE 0x00144A26 /* @ECU_Address@TFPC_Vnom@0x02102000@ */ ECIPP_ALIGNMENT_SWORD 128 Compu_TFPC_Vnom -128 127.99609375
 /begin AXIS_DESCR COM_AXIS NO_INPUT_QUANTITY Compu_TFPC_mdotf 8 -128 127.99609375 AXIS_PTS_REF TFPC_mdotf /end AXIS_DESCR
/end CHARACTERISTIC
/begin AXIS_PTS TFPC_mdotf " " 0x00144A36 /* @ECU_Address@TFPC_mdotf@0x02101000@ */ NO_INPUT_QUANTITY ECIPP_Lookup_SWORD 0 Compu_TFPC_mdotf 8 -128 127.99609375 /end AXIS_PTS
/begin COMPU_METHOD Compu_TFPC_Vnom " " RAT_FUNC "%.2" "pump volts" COEFFS 0 256 0 0 0 1 /end COMPU_METHOD
/begin COMPU_METHOD Compu_TVLPGoff_T " " RAT_FUNC "%.0" "ECT/FT (deg F)" COEFFS 0 32 14720 0 0 1 /end COMPU_METHOD
/begin CHARACTERISTIC TVLPGoff_V "LPG turnoff volume equivalent (table based)" CURVE 0x001458DE /* @ECU_Address@TVLPGoff_V@0x0210D000@ */ ECIPP_ALIGNMENT_SWORD 32 Compu_TVLPGoff_V -32 31.9990234375
 /begin AXIS_DESCR COM_AXIS NO_INPUT_QUANTITY Compu_TVLPGoff_T 4 -1484 563.96875 AXIS_PTS_REF TVLPGoff_T /end AXIS_DESCR
/end CHARACTERISTIC
/begin AXIS_PTS TVLPGoff_T " " 0x001458D6 /* @ECU_Address@TVLPGoff_T@0x0210C000@ */ NO_INPUT_QUANTITY ECIPP_Lookup_SWORD 0 Compu_TVLPGoff_T 4 -1484 563.96875 /end AXIS_PTS
/begin COMPU_METHOD Compu_TVLPGoff_V " " RAT_FUNC "%.2" "LPG V (liters)" COEFFS 0 1024 0 0 0 1 /end COMPU_METHOD
/begin COMPU_METHOD Compu_TFIMPb_FTT " " RAT_FUNC "%.0" "FTT (deg F)" COEFFS 0 32 14720 0 0 1 /end COMPU_METHOD
/begin COMPU_METHOD Compu_TFIMPb_IMPpct " " RAT_FUNC "%.1" "Fuel Impurity (%)" COEFFS 0 163.84 0 0 0 1 /end COMPU_METHOD
/begin CHARACTERISTIC TFIMPb_FTP "LPG FTP/FTT Fuel Impurity Calibration" MAP 0x0014498E /* @ECU_Address@TFIMPb_FTP@0x02151000@ */ ECIPP_ALIGNMENT_SWORD 4096 Compu_TFIMPb_FTP -4096 4095.875
 /begin AXIS_DESCR COM_AXIS NO_INPUT_QUANTITY Compu_TFIMPb_IMPpct 4 -200 199.993896484375 AXIS_PTS_REF TFIMPb_IMPpct /end AXIS_DESCR
 /begin AXIS_DESCR COM_AXIS NO_INPUT_QUANTITY Compu_TFIMPb_FTT 8 -1484 563.96875 AXIS_PTS_REF TFIMPb_FTT /end AXIS_DESCR
/end CHARACTERISTIC
/begin AXIS_PTS TFIMPb_IMPpct " " 0x001449DE /* @ECU_Address@TFIMPb_IMPpct@0x02150000@ */ NO_INPUT_QUANTITY ECIPP_Lookup_SWORD 0 Compu_TFIMPb_IMPpct 4 -200 199.993896484375 /end AXIS_PTS
/begin AXIS_PTS TFIMPb_FTT " " 0x001449CE /* @ECU_Address@TFIMPb_FTT@0x0214F000@ */ NO_INPUT_QUANTITY ECIPP_Lookup_SWORD 0 Compu_TFIMPb_FTT 8 -1484 563.96875 /end AXIS_PTS
/begin COMPU_METHOD Compu_TFIMPb_FTP "" RAT_FUNC "%.1" "FTP (psia)" COEFFS 0 8 0 0 0 1 /end COMPU_METHOD
/begin CHARACTERISTIC FSS_base_tbl "FSS Base 0" VAL_BLK 0x00164EF8 /* @ECU_Address@FSS_base_tbl@0x021A9000@ */ ECIPP_ALIGNMENT_UWORD 65535 Compu_FSS_base_tbl 0 65535 MATRIX_DIM 18 1 1 /end CHARACTERISTIC
/begin COMPU_METHOD Compu_FSS_base_tbl " " RAT_FUNC "%.0" "-" COEFFS 0 1 0 0 0 1 /end COMPU_METHOD
/begin MEASUREMENT FSS_cust_tbl "FSS Custom 0" UWORD Compu_FSS_cust_tbl 0 0 0 65535 ECU_ADDRESS 0x021AA000 MATRIX_DIM 8 1 1 /end MEASUREMENT
/begin COMPU_METHOD Compu_FSS_cust_tbl " " RAT_FUNC "%.0" "-" COEFFS 0 1 0 0 0 1 /end COMPU_METHOD
/begin CHARACTERISTIC FDR_base_tbl "FDR Base 0" VAL_BLK 0x00164948 /* @ECU_Address@FDR_base_tbl@0x021AB000@ */ ECIPP_ALIGNMENT_UWORD 65535 Compu_FDR_base_tbl 0 65535 MATRIX_DIM 10 1 1 /end CHARACTERISTIC
/begin COMPU_METHOD Compu_FDR_base_tbl " " RAT_FUNC "%.0" "-" COEFFS 0 1 0 0 0 1 /end COMPU_METHOD
/begin MEASUREMENT FDR_cust_tbl "FDR Custom 0" UWORD Compu_FDR_cust_tbl 0 0 0 65535 ECU_ADDRESS 0x021AC000 MATRIX_DIM 2 1 1 /end MEASUREMENT
/begin COMPU_METHOD Compu_FDR_cust_tbl " " RAT_FUNC "%.0" "-" COEFFS 0 1 0 0 0 1 /end COMPU_METHOD
/begin COMPU_METHOD Compu_CRIPcal_V " " RAT_FUNC "%.2" "volts" COEFFS 0 6553.6 0 0 0 1 /end COMPU_METHOD
/begin CHARACTERISTIC CRIPcal_P "CRI Pressure Sensor Calibration" CURVE 0x0016C514 /* @ECU_Address@CRIPcal_P@0x0227C000@ */ ECIPP_ALIGNMENT_SWORD 4096 Compu_CRIPcal_P -4096 4095.875
 /begin AXIS_DESCR COM_AXIS NO_INPUT_QUANTITY Compu_CRIPcal_V 2 -5 4.99984741210938 AXIS_PTS_REF CRIPcal_V /end AXIS_DESCR
/end CHARACTERISTIC
/begin AXIS_PTS CRIPcal_V " " 0x0016C518 /* @ECU_Address@CRIPcal_V@0x0227B000@ */ NO_INPUT_QUANTITY ECIPP_Lookup_SWORD 0 Compu_CRIPcal_V 2 -5 4.99984741210938 /end AXIS_PTS
/begin COMPU_METHOD Compu_CRIPcal_P " " RAT_FUNC "%.1" "bar" COEFFS 0 8 0 0 0 1 /end COMPU_METHOD
/begin COMPU_METHOD Compu_TCRI_IMVi_rpm " " RAT_FUNC "%.0" "Speed (rpm)" COEFFS 0 1 0 0 0 1 /end COMPU_METHOD
/begin COMPU_METHOD Compu_TCRI_IMVi_Prail " " RAT_FUNC "%.0" "Common-Rail Pressure (bar)" COEFFS 0 8 0 0 0 1 /end COMPU_METHOD
/begin COMPU_METHOD Compu_TCRI_IMVd_icmd " " RAT_FUNC "%.2" "IMV Command (amps)" COEFFS 0 1024 0 0 0 1 /end COMPU_METHOD
/begin CHARACTERISTIC TCRI_IMVd_imag "IMV Dither Amplitude" CURVE 0x0016C546 /* @ECU_Address@TCRI_IMVd_imag@0x02281000@ */ ECIPP_ALIGNMENT_SWORD 32 Compu_TCRI_IMVd_imag -32 31.9990234375
 /begin AXIS_DESCR COM_AXIS NO_INPUT_QUANTITY Compu_TCRI_IMVd_icmd 6 -32 31.9990234375 AXIS_PTS_REF TCRI_IMVd_icmd /end AXIS_DESCR
/end CHARACTERISTIC
/begin AXIS_PTS TCRI_IMVd_icmd " " 0x0016C53A /* @ECU_Address@TCRI_IMVd_icmd@0x02280000@ */ NO_INPUT_QUANTITY ECIPP_Lookup_SWORD 0 Compu_TCRI_IMVd_icmd 6 -32 31.9990234375 /end AXIS_PTS
/begin COMPU_METHOD Compu_TCRI_IMVd_imag " " RAT_FUNC "%.2" "Dither Amplitude (amps)" COEFFS 0 1024 0 0 0 1 /end COMPU_METHOD
/begin COMPU_METHOD Compu_TCRI_IMVd_rpm " " RAT_FUNC "%.0" "Engine Speed (rpm)" COEFFS 0 1 0 0 0 1 /end COMPU_METHOD
/begin CHARACTERISTIC TCRI_IMVd_fHz "IMV Dither Frequency" CURVE 0x0016C52E /* @ECU_Address@TCRI_IMVd_fHz@0x02283000@ */ ECIPP_ALIGNMENT_SWORD 2048 Compu_TCRI_IMVd_fHz -2048 2047.9375
 /begin AXIS_DESCR COM_AXIS NO_INPUT_QUANTITY Compu_TCRI_IMVd_rpm 6 -32768 32767 AXIS_PTS_REF TCRI_IMVd_rpm /end AXIS_DESCR
/end CHARACTERISTIC
/begin AXIS_PTS TCRI_IMVd_rpm " " 0x0016C552 /* @ECU_Address@TCRI_IMVd_rpm@0x02282000@ */ NO_INPUT_QUANTITY ECIPP_Lookup_SWORD 0 Compu_TCRI_IMVd_rpm 6 -32768 32767 /end AXIS_PTS
/begin COMPU_METHOD Compu_TCRI_IMVd_fHz " " RAT_FUNC "%.1" "Dither Freq (Hz)" COEFFS 0 16 0 0 0 1 /end COMPU_METHOD
/begin CHARACTERISTIC Tinj_CAD_CAD_I2 "Injection Timing - Secondary" MAP 0x00145EC6 /* @ECU_Address@Tinj_CAD_CAD_I2@0x022A4000@ */ ECIPP_ALIGNMENT_SWORD 2048 Compu_Tinj_CAD_CAD_I2 -2048 2047.9375
 /begin AXIS_DESCR COM_AXIS NO_INPUT_QUANTITY Compu_Tinj_CAD_PW_I2 8 -104.8576 104.8544 AXIS_PTS_REF Tinj_CAD_PW_I2 /end AXIS_DESCR
 /begin AXIS_DESCR COM_AXIS NO_INPUT_QUANTITY Compu_Tinj_CAD_rpm_I2 8 -32768 32767 AXIS_PTS_REF Tinj_CAD_rpm_I2 /end AXIS_DESCR
/end CHARACTERISTIC
/begin AXIS_PTS Tinj_CAD_PW_I2 " " 0x00145F56 /* @ECU_Address@Tinj_CAD_PW_I2@0x022A5000@ */ NO_INPUT_QUANTITY ECIPP_Lookup_SWORD 0 Compu_Tinj_CAD_PW_I2 8 -104.8576 104.8544 /end AXIS_PTS
/begin AXIS_PTS Tinj_CAD_rpm_I2 " " 0x00145F76 /* @ECU_Address@Tinj_CAD_rpm_I2@0x022A6000@ */ NO_INPUT_QUANTITY ECIPP_Lookup_SWORD 0 Compu_Tinj_CAD_rpm_I2 8 -32768 32767 /end AXIS_PTS
/begin COMPU_METHOD Compu_Tinj_CAD_CAD_I2 "" RAT_FUNC "%.0" "CAD BBDC Intake" COEFFS 0 16 0 0 0 1 /end COMPU_METHOD
/begin COMPU_METHOD Compu_Tinj_CAD_PW_I2 " " RAT_FUNC "%.1" "PW (ms)" COEFFS 0 312.5 0 0 0 1 /end COMPU_METHOD
/begin COMPU_METHOD Compu_Tinj_CAD_rpm_I2 " " RAT_FUNC "%.0" "Speed (rpm)" COEFFS 0 1 0 0 0 1 /end COMPU_METHOD
/begin COMPU_METHOD Compu_TCRI_QPT_yrpm " " RAT_FUNC "%.0" "Speed (rpm)" COEFFS 0 1 0 0 0 1 /end COMPU_METHOD
/begin AXIS_PTS TCRI_QPT_yrpm " " 0x0016C796 /* @ECU_Address@TCRI_QPT_yrpm@0x022E1000@ */ NO_INPUT_QUANTITY ECIPP_Lookup_SWORD 0 Compu_TCRI_QPT_yrpm 16 -32768 32767 /end AXIS_PTS
/begin CHARACTERISTIC TCRI_IMVff "IMV Feedforward Value / Coefficient" MAP 0x0016C46C /* @ECU_Address@TCRI_IMVff@0x0233B000@ */ ECIPP_ALIGNMENT_FLOAT32_IEEE 10000000000 Compu_TCRI_IMVff -10000000000 10000000000
 /begin AXIS_DESCR COM_AXIS NO_INPUT_QUANTITY Compu_TCRI_IMVi_Prail 6 -4096 4095.875 AXIS_PTS_REF TCRI_IMVi_Prail /end AXIS_DESCR
 /begin AXIS_DESCR COM_AXIS NO_INPUT_QUANTITY Compu_TCRI_IMVi_rpm 6 -32768 32767 AXIS_PTS_REF TCRI_IMVi_rpm /end AXIS_DESCR
/end CHARACTERISTIC
/begin AXIS_PTS TCRI_IMVi_Prail " " 0x0016C55E /* @ECU_Address@TCRI_IMVi_Prail@0x0227E000@ */ NO_INPUT_QUANTITY ECIPP_Lookup_SWORD 0 Compu_TCRI_IMVi_Prail 6 -4096 4095.875 /end AXIS_PTS
/begin AXIS_PTS TCRI_IMVi_rpm " " 0x0016C56A /* @ECU_Address@TCRI_IMVi_rpm@0x0227D000@ */ NO_INPUT_QUANTITY ECIPP_Lookup_SWORD 0 Compu_TCRI_IMVi_rpm 6 -32768 32767 /end AXIS_PTS
/begin COMPU_METHOD Compu_TCRI_IMVff "" RAT_FUNC "%.2" "Amps or mA/mg or us/mg" COEFFS 0 1 0 0 0 1 /end COMPU_METHOD
/begin COMPU_METHOD Compu_TLdLimFIMP_pct " " RAT_FUNC "%.1" "FIMP (%)" COEFFS 0 327.68 0 0 0 1 /end COMPU_METHOD
/begin CHARACTERISTIC TLdLimFIMP_FIMPpct "FIMP Nonlinear Derate" CURVE 0x0014502E /* @ECU_Address@TLdLimFIMP_FIMPpct@0x02530000@ */ ECIPP_ALIGNMENT_SWORD 100 Compu_TLdLimFIMP_FIMPpct -100 99.9969482421875
 /begin AXIS_DESCR COM_AXIS NO_INPUT_QUANTITY Compu_TLdLimFIMP_pct 8 -100 99.9969482421875 AXIS_PTS_REF TLdLimFIMP_pct /end AXIS_DESCR
/end CHARACTERISTIC
/begin AXIS_PTS TLdLimFIMP_pct " " 0x0014503E /* @ECU_Address@TLdLimFIMP_pct@0x0252F000@ */ NO_INPUT_QUANTITY ECIPP_Lookup_SWORD 0 Compu_TLdLimFIMP_pct 8 -100 99.9969482421875 /end AXIS_PTS
/begin COMPU_METHOD Compu_TLdLimFIMP_FIMPpct " " RAT_FUNC "%.1" "LL (%)" COEFFS 0 327.68 0 0 0 1 /end COMPU_METHOD
/begin COMPU_METHOD Compu_TLdLimFIP " " RAT_FUNC "%.1" "FIP (psia)" COEFFS 0 16 0 0 0 1 /end COMPU_METHOD
/begin CHARACTERISTIC TLdLimFIP_pct "FIP Nonlinear Derate" CURVE 0x0014505E /* @ECU_Address@TLdLimFIP_pct@0x02619000@ */ ECIPP_ALIGNMENT_SWORD 200 Compu_TLdLimFIP_pct -200 199.993896484375
 /begin AXIS_DESCR COM_AXIS NO_INPUT_QUANTITY Compu_TLdLimFIP 8 -2048 2047.9375 AXIS_PTS_REF TLdLimFIP /end AXIS_DESCR
/end CHARACTERISTIC
/begin AXIS_PTS TLdLimFIP " " 0x0014504E /* @ECU_Address@TLdLimFIP@0x02618000@ */ NO_INPUT_QUANTITY ECIPP_Lookup_SWORD 0 Compu_TLdLimFIP 8 -2048 2047.9375 /end AXIS_PTS
/begin COMPU_METHOD Compu_TLdLimFIP_pct " " RAT_FUNC "%.1" "LL (%)" COEFFS 0 163.84 0 0 0 1 /end COMPU_METHOD
/begin GROUP EC_Faults "ECONTROLS" ROOT
 /begin REF_CHARACTERISTIC fault_SD_dis_ena fault_SD_dis_cfg faultact_AL_dis faultact_persist faultact_persist_cyc faultact_persist_MIL FSS_base_tbl FDR_base_tbl /end REF_CHARACTERISTIC
 /begin REF_MEASUREMENT dwell1 dwell2 dwell3 EGO1_volts EGO2_volts EGO3_volts eng_load PWe_avg inj_kill spk_kill Gov1_volt Gov2_volt OilP_volt dwell4 dwell5 dwell6 dwell7 dwell8 dwell9 dwell10 MAP_raw ECT_raw IAT_raw MILout_mirror BUZZout_mirror SWARNout_mirror HWARNout_mirror EGO4_volts FO_BO torque_Nm_gross torque_pct HM_MIL_seconds inj1_on_samp inj2_on_samp inj3_on_samp inj4_on_samp inj5_on_samp inj6_on_samp inj7_on_samp inj8_on_samp inj9_on_samp inj10_on_samp inj1_off_samp inj2_off_samp inj3_off_samp inj4_off_samp inj5_off_samp inj6_off_samp inj7_off_samp inj8_off_samp inj9_off_samp inj10_off_samp FPin_I2 SD_inhibit FSS_cust_tbl FDR_cust_tbl /end REF_MEASUREMENT
/end GROUP
/begin GROUP EC_FilterCal "ECONTROLS" ROOT
 /begin REF_CHARACTERISTIC TFBdt_n MAPdt_n TPSraw_LP MAPraw_LP TFBdt_xLP MAPdt_xLP MAP_favg_n MAP_savg_n rpm_filt_n MAPdt_crk_dz MAPdt_nrm_dz MAP_CADproject FPraw_LP TIPraw_LP EGO_phidt_n WGPraw_LP rpmdt_sLP MAPdt_dz_src MAPdt_dz_shape MAPdt_MAPss_tau SHIFT_dt_n SHIFT_dt_LP APSraw_LP BPSraw_LP AFBdt_n BFBdt_n AFBdt_xLP BFBdt_xLP EMP_cyl_events EMP_tau EMP_slow_tau_ms MAP_global_filt TIP_global_filt MAP_TIP_win_cyls EGRdP_tau EGRHPLP_cyl_events EGRHPLP_tau UEGOB_PI_raw_LP UEGOB_SR_raw_LP UEGOB_PI_Vofst_LP UEGOB_SR_Vofst_LP UEGOB_PI_Vout_LP UEGOB_SR_Vout_LP UEGON_PI_raw_LP UEGON_SR_raw_LP UEGON_PI_Vofst_LP UEGON_SR_Vofst_LP UEGON_PI_Vout_LP UEGON_SR_Vout_LP EGRdP_cyl_events EGRdP_Dz TPScmd_dmdot_n TPScmd_dmdot_Dz TPScmd_dmdot_LP TPSdP_ena TPSdP_config TPSdP_cyl_events TPSdP_tau TPSdP_offset_keywt TPSdP_offset_strtwt TPSdP_offset_tau TPSdP_offset_dPmin TPSdP_offset_dPmax EGRHPLP_Dz AFILTdP_tau AFILTdP_Dz AFILTdP_cyl_events Trpmdt_rpmdtn Trpmdt_rpmdtx TMAPp_rpm_CAD TMAPp_rpm_psi MAPdtMAP_dz /end REF_CHARACTERISTIC
 /begin REF_MEASUREMENT MAPdt_dz rpmdt MAPe TIP_slow MAPdt_MAPss rpmdt_n rpmdt_xLP rpmdt_slow MAPdt_dz_acttrg EMP EGRLP_inst EGRHP_inst TPScmd_dmdot mdot_TPScmd_f TPSdP_inst_float TPSdP_float EGRLP_wdw EGRHP_wdw EGRdP_wdw_dz_lp EGRHP_wdw_dz_lp EGRHP_mdl_float /end REF_MEASUREMENT
/end GROUP
/begin GROUP EC_Fuel "ECONTROLS" ROOT
 /begin REF_CHARACTERISTIC MAP_CADproject async_inj_ena tri_fuel_ena FPUMP_wakeup LOCKOFF_wakeup gsln2gas_overlap gas2gsln_overlap V_LPG_off V_NG_off FT_input_cfg fuelrunout_ena fuelrunout_max rev_lim_fuel rev_lim_spk tri_fuel_lockoff gas2gsln_slew GasCarb_trim_mode rev_lim_fuel_drpm FPC_ena FPC_Kp FPC_Ki FPC_Kd FPC_Kiv FPC_dot_window FPC_dot_tau FPCVmin FPCVmax FPCV_CLauth FPC_SD_deltaP FPCcmd_tau FPin_a FPUMP_pin LOCKOFF_pin FT_input_pin LOCKOFF_flowwt V_LPG_off_type LOD_FROmax TRIM_out_chan TRIM_fueltran_mode TRIM_ftran_DCdef MJ_ftran_Pdef FIMP_ena FIMP_type FIMP_init_mode FIMP_pct_init FIMP_MAP_min FIMP_MAP_max FIMP_RPM_min FIMP_RPM_max FIMP_strt_wait FIMP_wndw_wait FIMP_learn_tau FIMP_LL_strt FIMP_LL_stop FTT_ena FTP_ena inj_timing_dz inj_timing_dz_tau rev_lim_spk_drpm FRO_key_mode FRO_shutdown_ena LOCKOFF_keyonwt Ginj_peak_offset FRO_gov_state_freeze FRO_fuelclear_ms LOCKOFF_hold_wait LOCKOFF_hold_DC LOCKOFF2_pin FT_bleedoff_ena FT_bleedoff_dP_cmd FT_bleedoff_Ptarget Ginj_cs_max_pre Ginj_cs_max_post Ginj_cs_ect Ginj_cs_ptime FT_bleedoff_delay TBI_fuel_calc J1939_GFC_ena J1939_GFC_tau1 J1939_GFC_tau2 FIMP_LL_ena FIMP_BTU_pure FIMP_BTU_act FIMP_BTU_imp LOCKOFF3_pin LPG_NG_ovlp NG_LPG_ovlp LPG_NG_lockout FIP_LL_ena LOCKOFF4_pin FPC_FP_source lockoff_keyoff_ena Tinj_CAD_CAD TFPC_Vnom TVLPGoff_V TFIMPb_FTP TLdLimFIMP_FIMPpct TLdLimFIP_pct /end REF_CHARACTERISTIC
 /begin REF_MEASUREMENT inj_timing m_f_port mdot_f_throttle MAPe PW_offset_global PWe_avg FPC_dot FT_gsln_slew_att FPC_Iacc FPCcmd FPCcmd_V FPCcmd_DC V_LPG_off_cur FIMP_percent FIMP_LL_pct FIMP_pct_ss inj1_last_falling inj2_last_falling inj3_last_falling inj4_last_falling inj5_last_falling inj6_last_falling inj7_last_falling inj8_last_falling inj9_last_falling inj10_last_falling fuel_trip_gas FPin_I2 active_fuel_device fuel_trip_liquid fuel_total_gas FT_bleedoff_state active_fuel_loc Ginj_cs_active inj_count_prerun inj_count_postrun Ginj_peakd_avg Ginj_peaka_avg FT_bleedoff_fuelType fuel_type_keyoff J1939_GFC_m_hr1 J1939_GFC_m_hr2 J1939_GFC_m_100km1 J1939_GFC_m_100km2 /end REF_MEASUREMENT
/end GROUP
/begin GROUP EC_FuelRail "ECONTROLS" ROOT
 /begin REF_CHARACTERISTIC CRI_V_boost CRI_i_peak CRI_i_hold CRI_i_hys CRI_i_recharge CRI_i_HS_short CRI_i_LS_short CRI_peak_time_min CRI_peak_time_max CRI_hold_decay CRI_lift_pump_ena CRI_IMV_ena CRI_IMVp_Kp CRI_IMVp_Ki CRI_IMVp_Kd CRI_Prail_ena CRI_IMV_ohms_nom CRI_IMV_mH CRI_Prail_edot_n CRI_Prail_edot_LP CRI_IMVp_acc_max CRI_IMVp_acc_min CRI_IMV_Vdiode CRI_IMV_ohms_Ki CRI_IMV_ohms_min CRI_IMV_ohms_max CRI_PCV_ena CRI_ontime_min CRI_Prail_targ_LP CRI_Prail_act_LP CRI_Prail_act_ediLP CRI_IMVp_Ddz CRI_IMVp_FSO_Ifrz CRI_ontime_max CRI_Prail_min CRI_offtime_min CRI_i_peak_init CRI_i_PH_offset CRI_IMVi_min CRI_IMVi_max CRI_IMVp_NCvalve CRI_IMV_pulsed IMV_pulse_phase IMV_pulse_spacing IMVpulse_Ipeak IMVpulse_Ireduce IMVpulse_Ihold IMVpulse_Icushion IMVpulse_Treduce IMVpulse_Tpause IMVpulse_Tcushion IMVpulse_Tdecay CRI_IMVpw_min CRI_IMVpw_max CRI_hold_recharge CRI_peakhold_decay CRI_IMVp_baseline CRI_Prail_targdz_LP CRI_Prail_targ_dz CRI_IMVff_mode IMVpulse_Tpeak_max IMVpulse_Ttotal_max CRI_IMV_Iinit CRI_ontime_CADmax IMVpck_PWfixed IMVpck_presync_tau IMVpck_pstsync_ph IMVpck_Pctlhyst_pct CRI_purge CRI_purge_Plower CRI_purge_Pupper CRI_purge_cycwait CRI_Prail_hyst IMV_varcam_mode IMV_varcam_nom IMVpck_CAD_cycmin IMVpck_CADfixed CRI_Pdry_min CRI_Pdry_hyst CRI_Pdry_cycwait CRI_Pdry_runhold CRI_ontime_drymax IMVpulse_Tmx_rpmeq CRI_Pdry_ena CRI_IMVpw_CAD CRI_IMVcad_min CRI_IMVcad_max CRI_grneng CRI_purge_tout CRI_purge_spkpct CRI_IMV_HW_period BIP_enabled BIP_min BIP_max BIP_num_pulses BIP_tau BIP_nom BIP_interval_ms BIP_dIinj_thld CRI_i_peak_init_BIP CRI_i_peak_BIP CRI_i_hold_BIP CRI_cad_post2_BIP CRI_width_post2_BIP CRIPcal_P TCRI_IMVd_imag TCRI_IMVd_fHz TCRI_QPT_yrpm TCRI_IMVff /end REF_CHARACTERISTIC
 /begin REF_MEASUREMENT CRI_Prail_target CRI_Prail_edot CRI_IMVi_cmd CRI_IMVd_imag CRI_IMVd_fHz CRI_IMV_ohms CRI_Prail_targ_raw CRI_Prail_act_raw CRI_Prail_cld CRI1_V_boost_filt CRI2_V_boost_filt CRI_IMVcad_final CRI_IMVpw_cmd CRI_IMV_PID CRI_IMV_Iaccum IMVpulsetest_mode IMVpulsetest_pw CRI_IMVpw_total CRI_IMVff_TLU CRI_IMVp_ff CRI_IMVi_FB CRI_ontime_finalmax IMVpck_taufix CRI_purge_active CRI_IMVi_raw CRI_Prail_min_a CRI_last_rise_time1 CRI_last_rise_time2 CRI_last_rise_time3 CRI_last_rise_time4 CRI_last_rise_time5 CRI_last_rise_time6 CRI_last_rise_time7 CRI_last_rise_time8 CRI_IMVi_halfpeak CRI_grneng_state CRI_grneng_mantrig CRI_purge_tmr CRI_purge_spkdis CRI_LS_PH_off BIP_last_cyl1 BIP_last_cyl2 BIP_last_cyl3 BIP_last_cyl4 BIP_last_cyl5 BIP_last_cyl6 BIP_last_cyl7 BIP_last_cyl8 BIP_cyl1 BIP_cyl2 BIP_cyl3 BIP_cyl4 BIP_cyl5 BIP_cyl6 BIP_cyl7 BIP_cyl8 BIP_CAD_offset_cyl1 BIP_CAD_offset_cyl2 BIP_CAD_offset_cyl3 BIP_CAD_offset_cyl4 BIP_CAD_offset_cyl5 BIP_CAD_offset_cyl6 BIP_CAD_offset_cyl7 BIP_CAD_offset_cyl8 /end REF_MEASUREMENT
/end GROUP
/begin GROUP EC_FuelSecond "ECONTROLS" ROOT
 /begin REF_CHARACTERISTIC FPin_a_I2 async_inj_ena_I2 Ginj_peak_offset_I2 inj_timing_dz_I2 inj_timing_dz_tau_I2 strt_inj_tmng_I2 Ginj_cs_max_pre_I2 Ginj_cs_max_post_I2 Ginj_cs_ect_I2 Ginj_cs_ptime_I2 Tinj_CAD_CAD_I2 /end REF_CHARACTERISTIC
 /begin REF_MEASUREMENT inj_timing m_f_port mdot_f_throttle PW_offset_global PWe_avg inj1_last_falling inj2_last_falling inj3_last_falling inj4_last_falling inj5_last_falling inj6_last_falling inj7_last_falling inj8_last_falling inj9_last_falling inj10_last_falling FPin_I2 active_fuel_device active_fuel_loc Ginj_cs_active inj_count_prerun inj_count_postrun Ginj_peakd_avg Ginj_peaka_avg /end REF_MEASUREMENT
/end GROUP
/begin GROUP EC_GovCal "ECONTROLS" ROOT /begin REF_CHARACTERISTIC Trpmdt_rpmdtn Trpmdt_rpmdtx /end REF_CHARACTERISTIC /begin REF_MEASUREMENT rpmdt eng_load rpmdt_n rpmdt_xLP /end REF_MEASUREMENT /end GROUP
/begin GROUP EC_GovCalAlt "ECONTROLS" ROOT /begin REF_CHARACTERISTIC Trpmdt_rpmdtn Trpmdt_rpmdtx /end REF_CHARACTERISTIC /begin REF_MEASUREMENT rpmdt eng_load rpmdt_n rpmdt_xLP /end REF_MEASUREMENT /end GROUP
/begin GROUP EC_HDOBD "ECONTROLS" ROOT /begin REF_MEASUREMENT MILout_mirror /end REF_MEASUREMENT /end GROUP
/begin GROUP EC_HDService "ECONTROLS" ROOT /begin REF_MEASUREMENT fuel_trip_gas fuel_total_gas /end REF_MEASUREMENT /end GROUP
/begin GROUP EC_LDService "ECONTROLS" ROOT
 /begin REF_MEASUREMENT PWe_avg inj_kill spk_kill MILout_mirror BUZZout_mirror SWARNout_mirror HWARNout_mirror /end REF_MEASUREMENT
/end GROUP
/begin GROUP EC_LoadCal "ECONTROLS" ROOT /begin REF_MEASUREMENT torque_Nm_gross torque_pct /end REF_MEASUREMENT /end GROUP
/begin GROUP EC_Marine "ECONTROLS" ROOT /begin REF_MEASUREMENT PWe_avg /end REF_MEASUREMENT /end GROUP
/begin GROUP EC_Megajector "ECONTROLS" ROOT /begin REF_CHARACTERISTIC FT_bleedoff_Ptarget /end REF_CHARACTERISTIC
 /begin REF_MEASUREMENT active_fuel_device FT_bleedoff_state active_fuel_loc FT_bleedoff_fuelType /end REF_MEASUREMENT
/end GROUP
/begin GROUP EC_Misfire "ECONTROLS" ROOT /begin REF_MEASUREMENT inj_kill spk_kill FO_BO /end REF_MEASUREMENT /end GROUP
/begin GROUP EC_Outputs "ECONTROLS" ROOT
 /begin REF_MEASUREMENT MILout_mirror BUZZout_mirror SWARNout_mirror HWARNout_mirror /end REF_MEASUREMENT
/end GROUP
/begin GROUP EC_PhiGsln "ECONTROLS" ROOT /begin REF_MEASUREMENT PW_offset_global /end REF_MEASUREMENT /end GROUP
/begin GROUP EC_PhiLP "ECONTROLS" ROOT /begin REF_MEASUREMENT EGO1_volts EGO2_volts EGO3_volts EGO4_volts /end REF_MEASUREMENT /end GROUP
/begin GROUP EC_PhiNG "ECONTROLS" ROOT /begin REF_MEASUREMENT EGO1_volts EGO2_volts EGO3_volts EGO4_volts /end REF_MEASUREMENT /end GROUP
/begin GROUP EC_RawVolts "ECONTROLS" ROOT
 /begin REF_MEASUREMENT Gov1_volt Gov2_volt OilP_volt MAP_raw ECT_raw IAT_raw inj1_on_samp inj2_on_samp inj3_on_samp inj4_on_samp inj5_on_samp inj6_on_samp inj7_on_samp inj8_on_samp inj9_on_samp inj10_on_samp inj1_off_samp inj2_off_samp inj3_off_samp inj4_off_samp inj5_off_samp inj6_off_samp inj7_off_samp inj8_off_samp inj9_off_samp inj10_off_samp /end REF_MEASUREMENT
/end GROUP
/begin GROUP EC_Service1 "ECONTROLS" ROOT /begin REF_CHARACTERISTIC FT_input_cfg /end REF_CHARACTERISTIC /end GROUP
/begin GROUP EC_Service2 "ECONTROLS" ROOT /begin REF_MEASUREMENT EGO1_volts /end REF_MEASUREMENT /end GROUP
/begin GROUP EC_SparkCal "ECONTROLS" ROOT
 /begin REF_MEASUREMENT dwell1 dwell2 dwell3 spk_kill dwell4 dwell5 dwell6 dwell7 dwell8 dwell9 dwell10 FO_BO /end REF_MEASUREMENT
/end GROUP
/begin GROUP EC_Starting "ECONTROLS" ROOT /begin REF_CHARACTERISTIC strt_inj_tmng_I2 /end REF_CHARACTERISTIC /begin REF_MEASUREMENT m_f_port PWe_avg /end REF_MEASUREMENT /end GROUP
/begin GROUP EC_Tests "ECONTROLS" ROOT /begin REF_MEASUREMENT PWe_avg inj_kill spk_kill FO_BO /end REF_MEASUREMENT /end GROUP
/begin GROUP EC_TranCal "ECONTROLS" ROOT /begin REF_MEASUREMENT m_f_port /end REF_MEASUREMENT /end GROUP
/begin GROUP EC_VECal "ECONTROLS" ROOT /begin REF_CHARACTERISTIC MAP_CADproject /end REF_CHARACTERISTIC
 /begin REF_MEASUREMENT m_f_port mdot_f_throttle MAPe PW_offset_global FPin_I2 active_fuel_device active_fuel_loc /end REF_MEASUREMENT
/end GROUP
/end MODULE
/end PROJECT
