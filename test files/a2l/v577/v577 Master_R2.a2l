ASAP2_VERSION 1 61
/begin PROJECT Econtrols_4G "4G Test"
/begin HEADER "4G A2L Configuration" PROJECT_NO EControls4G /* config for version control */ VERSION "$Revision: 82130 $:" /* config for version control */ /end HEADER
/begin MODULE EControls_4G_SH2A "EControls 4G"
/begin MOD_COMMON "" DEPOSIT ABSOLUTE BYTE_ORDER MSB_FIRST /end MOD_COMMON
/* Define the Record Layouts */
/begin RECORD_LAYOUT ECIPP_ALIGNMENT_UBYTE FNC_VALUES 1 UBYTE COLUMN_DIR DIRECT /end RECORD_LAYOUT
/begin RECORD_LAYOUT ECIPP_ALIGNMENT_UWORD FNC_VALUES 1 UWORD COLUMN_DIR DIRECT /end RECORD_LAYOUT
/begin RECORD_LAYOUT ECIPP_ALIGNMENT_SWORD FNC_VALUES 1 SWORD COLUMN_DIR DIRECT /end RECORD_LAYOUT
/begin RECORD_LAYOUT ECIPP_Lookup_SWORD AXIS_PTS_X 1 SWORD INDEX_INCR DIRECT /end RECORD_LAYOUT
/begin RECORD_LAYOUT ECIPP_ALIGNMENT_FLOAT32_IEEE FNC_VALUES 1 FLOAT32_IEEE COLUMN_DIR DIRECT /end RECORD_LAYOUT
/begin RECORD_LAYOUT ECIPP_Lookup_FLOAT32_IEEE AXIS_PTS_X 1 FLOAT32_IEEE INDEX_INCR DIRECT /end RECORD_LAYOUT
/begin MEASUREMENT spk_adv_base "Base Spark Advance" SWORD Compu_spk_adv_base 0 0 -2048 2047.9375 ECU_ADDRESS 0x01000028 /end MEASUREMENT
/begin COMPU_METHOD Compu_spk_adv_base " " RAT_FUNC "%.1" "CAD BTDC" COEFFS 0 16 0 0 0 1 /end COMPU_METHOD
/begin MEASUREMENT spk_off_ECTvL "CHT-MAP Adv Offset" SWORD Compu_spk_off_ECTvL 0 0 -2048 2047.9375 ECU_ADDRESS 0x01000038 /end MEASUREMENT
/begin COMPU_METHOD Compu_spk_off_ECTvL " " RAT_FUNC "%.1" "CAD BTDC" COEFFS 0 16 0 0 0 1 /end COMPU_METHOD
/begin MEASUREMENT spk_off_MATvL "MAT-MAP Adv Offset" SWORD Compu_spk_off_MATvL 0 0 -2048 2047.9375 ECU_ADDRESS 0x01000040 /end MEASUREMENT
/begin COMPU_METHOD Compu_spk_off_MATvL " " RAT_FUNC "%.1" "CAD BTDC" COEFFS 0 16 0 0 0 1 /end COMPU_METHOD
/begin MEASUREMENT spk_off_ECT "CHT Adv Offset" SWORD Compu_spk_off_ECT 0 0 -2048 2047.9375 ECU_ADDRESS 0x01000048 /end MEASUREMENT
/begin COMPU_METHOD Compu_spk_off_ECT " " RAT_FUNC "%.1" "CAD BTDC" COEFFS 0 16 0 0 0 1 /end COMPU_METHOD
/begin MEASUREMENT KNK_sig_pavg "Instant KNK peak-average" UWORD Compu_KNK_sig_pavg 0 0 0 63.9990234375 ECU_ADDRESS 0x01000150 /end MEASUREMENT
/begin COMPU_METHOD Compu_KNK_sig_pavg " " RAT_FUNC "%.3" "volts" COEFFS 0 1024 0 0 0 1 /end COMPU_METHOD
/begin MEASUREMENT spk_ret_CWT "CWT retard" SWORD Compu_spk_ret_CWT 0 0 -2048 2047.9375 ECU_ADDRESS 0x01000280 /end MEASUREMENT
/begin COMPU_METHOD Compu_spk_ret_CWT " " RAT_FUNC "%.1" "CAD" COEFFS 0 16 0 0 0 1 /end COMPU_METHOD
/begin MEASUREMENT KNK_pct_latch "Instant KNK percent" UWORD Compu_KNK_pct_latch 0 0 0 99.9984741210938 ECU_ADDRESS 0x01000368 /end MEASUREMENT
/begin COMPU_METHOD Compu_KNK_pct_latch " " RAT_FUNC "%.1" "%" COEFFS 0 655.36 0 0 0 1 /end COMPU_METHOD
/begin MEASUREMENT KNK_pct_avg "Average KNK" UWORD Compu_KNK_pct_avg 0 0 0 99.9984741210938 ECU_ADDRESS 0x01000370 /end MEASUREMENT
/begin COMPU_METHOD Compu_KNK_pct_avg " " RAT_FUNC "%.1" "%" COEFFS 0 655.36 0 0 0 1 /end COMPU_METHOD
/begin MEASUREMENT KNK_pct_max "Max KNK" UWORD Compu_KNK_pct_max 0 0 0 99.9984741210938 ECU_ADDRESS 0x01000378 /end MEASUREMENT
/begin COMPU_METHOD Compu_KNK_pct_max " " RAT_FUNC "%.1" "%" COEFFS 0 655.36 0 0 0 1 /end COMPU_METHOD
/begin MEASUREMENT KNK_pct_min "Min KNK" UWORD Compu_KNK_pct_min 0 0 0 99.9984741210938 ECU_ADDRESS 0x01000380 /end MEASUREMENT
/begin COMPU_METHOD Compu_KNK_pct_min " " RAT_FUNC "%.1" "%" COEFFS 0 655.36 0 0 0 1 /end COMPU_METHOD
/begin CHARACTERISTIC FPPTPSnl_ena "FPP->TPS non-linear mode{FPPTPSnl_ena&0xff=0:Disabled}{FPPTPSnl_ena&0xff=1:Enabled - Option1}{FPPTPSnl_ena&0xff=2:Enabled - Option2}{FPPTPSnl_ena&0xff=3:Enabled - Option3}{FPPTPSnl_ena&0xff=4:Enabled - Aux PU1=Opt1/2}{FPPTPSnl_ena&0xff=5:Enabled - Aux PU2" VALUE 0x00147d6b /* @ECU_Address@FPPTPSnl_ena@0x010010C8@ */ ECIPP_ALIGNMENT_UBYTE 255 FPPTPSnl_ena_COMPU_VTAB 0 255 BIT_MASK 0xff /end CHARACTERISTIC
/begin COMPU_METHOD FPPTPSnl_ena_COMPU_VTAB "Verbal Table" TAB_VERB "%.0" "list" COMPU_TAB_REF FPPTPSnl_ena_COMPU_VTAB_REF /end COMPU_METHOD
/begin COMPU_VTAB FPPTPSnl_ena_COMPU_VTAB_REF "Verbal Table" TAB_VERB 17 0 "Disabled" 1 "Enabled - Option1" 2 "Enabled - Option2" 3 "Enabled - Option3" 4 "Enabled - Aux PU1=Opt1/2" 5 "Enabled - Aux PU2=Opt1/2" 6 "Enabled - Aux PU3=Opt1/2" 7 "Enabled - Aux DIG1=Opt1/2/3" 8 "Enabled - Aux DIG2=Opt1/2/3" 9 "Enabled - Aux DIG3=Opt1/2/3" 10 "Enabled - Transmission Selected" 11 "Enabled - Use As 3-Point Table" 12 "Enabled - Use 2D Table" 13 "Network - Default Disabled" 14 "Network - Default Option1" 15 "Network - Default Option2" 16 "Network - Default Option3" DEFAULT_VALUE "UNKNOWN" /end COMPU_VTAB
/begin CHARACTERISTIC FPPTPSnl_FPP "Option1 non-linear FPP point" VALUE 0x00147878 /* @ECU_Address@FPPTPSnl_FPP@0x010010D0@ */ ECIPP_ALIGNMENT_UWORD 100 Compu_FPPTPSnl_FPP 0 99.9984741210938 /end CHARACTERISTIC
/begin COMPU_METHOD Compu_FPPTPSnl_FPP " " RAT_FUNC "%.1" "%" COEFFS 0 655.36 0 0 0 1 /end COMPU_METHOD
/begin CHARACTERISTIC FPPTPSnl_TPS "Option1 non-linear TPS point" VALUE 0x0014787E /* @ECU_Address@FPPTPSnl_TPS@0x010010D8@ */ ECIPP_ALIGNMENT_UWORD 100 Compu_FPPTPSnl_TPS 0 99.9984741210938 /end CHARACTERISTIC
/begin COMPU_METHOD Compu_FPPTPSnl_TPS " " RAT_FUNC "%.1" "%" COEFFS 0 655.36 0 0 0 1 /end COMPU_METHOD
/begin MEASUREMENT KNK_win_dur "KNK window duration" SWORD Compu_KNK_win_dur 0 0 -16384 16383.5 ECU_ADDRESS 0x010010E0 /end MEASUREMENT
/begin COMPU_METHOD Compu_KNK_win_dur " " RAT_FUNC "%.0" "CAD" COEFFS 0 2 0 0 0 1 /end COMPU_METHOD
/begin MEASUREMENT KNK_win_start "KNK window start" SWORD Compu_KNK_win_start 0 0 -16384 16383.5 ECU_ADDRESS 0x010010E8 /end MEASUREMENT
/begin COMPU_METHOD Compu_KNK_win_start " " RAT_FUNC "%.0" "CAD BTDC" COEFFS 0 2 0 0 0 1 /end COMPU_METHOD
/begin CHARACTERISTIC KNK_enable "Knock control system{KNK_enable&0xff=0x00:Disabled}{KNK_enable&0xff=0x01:Enabled}" VALUE 0x0014391e /* @ECU_Address@KNK_enable@0x010010F0@ */ ECIPP_ALIGNMENT_UBYTE 255 KNK_enable_COMPU_VTAB 0 255 BIT_MASK 0xff /end CHARACTERISTIC
/begin COMPU_METHOD KNK_enable_COMPU_VTAB "Verbal Table" TAB_VERB "%.0" "list" COMPU_TAB_REF KNK_enable_COMPU_VTAB_REF /end COMPU_METHOD
/begin COMPU_VTAB KNK_enable_COMPU_VTAB_REF "Verbal Table" TAB_VERB 2 0x00 "Disabled" 0x01 "Enabled" DEFAULT_VALUE "UNKNOWN" /end COMPU_VTAB
/begin MEASUREMENT KNK_manual "Knock mode{KNK_manual&0xff=0x00:Automatic}{KNK_manual&0xff=0x01:Manual}" UBYTE KNK_manual_COMPU_VTAB 0 0 0 255 ECU_ADDRESS 0x010010F8 BIT_MASK 0xff /end MEASUREMENT
/begin COMPU_METHOD KNK_manual_COMPU_VTAB "Verbal Table" TAB_VERB "%.0" "list" COMPU_TAB_REF KNK_manual_COMPU_VTAB_REF /end COMPU_METHOD
/begin COMPU_VTAB KNK_manual_COMPU_VTAB_REF "Verbal Table" TAB_VERB 2 0x00 "Automatic" 0x01 "Manual" DEFAULT_VALUE "UNKNOWN" /end COMPU_VTAB
/begin MEASUREMENT KNK_100_V "KNK 100% voltage" UWORD Compu_KNK_100_V 0 0 0 63.9990234375 ECU_ADDRESS 0x01001100 /end MEASUREMENT
/begin COMPU_METHOD Compu_KNK_100_V " " RAT_FUNC "%.3" "volts" COEFFS 0 1024 0 0 0 1 /end COMPU_METHOD
/begin MEASUREMENT KNK_0_V "KNK 0% voltage" UWORD Compu_KNK_0_V 0 0 0 63.9990234375 ECU_ADDRESS 0x01001108 /end MEASUREMENT
/begin COMPU_METHOD Compu_KNK_0_V " " RAT_FUNC "%.3" "volts" COEFFS 0 1024 0 0 0 1 /end COMPU_METHOD
/begin MEASUREMENT KNK_ret_max "KNK retard max" SWORD Compu_KNK_ret_max 0 0 -64 63.998046875 ECU_ADDRESS 0x01001110 /end MEASUREMENT
/begin COMPU_METHOD Compu_KNK_ret_max " " RAT_FUNC "%.1" "CAD" COEFFS 0 512 0 0 0 1 /end COMPU_METHOD
/begin CHARACTERISTIC KNK_ret_K "KNK retard gain" VALUE 0x001438e2 /* @ECU_Address@KNK_ret_K@0x01001118@ */ ECIPP_ALIGNMENT_UWORD 128 Compu_KNK_ret_K 0 127.998046875 /end CHARACTERISTIC
/begin COMPU_METHOD Compu_KNK_ret_K " " RAT_FUNC "%.3" "CAD / cycle" COEFFS 0 512 0 0 0 1 /end COMPU_METHOD
/begin CHARACTERISTIC KNK_adv_K "KNK advance gain" VALUE 0x001438d6 /* @ECU_Address@KNK_adv_K@0x01001120@ */ ECIPP_ALIGNMENT_UWORD 128 Compu_KNK_adv_K 0 127.998046875 /end CHARACTERISTIC
/begin COMPU_METHOD Compu_KNK_adv_K " " RAT_FUNC "%.3" "CAD / cycle" COEFFS 0 512 0 0 0 1 /end COMPU_METHOD
/begin CHARACTERISTIC KNK_val_trig "Average KNK validation trigger" VALUE 0x001438e6 /* @ECU_Address@KNK_val_trig@0x01001128@ */ ECIPP_ALIGNMENT_UWORD 100 Compu_KNK_val_trig 0 99.9984741210938 /end CHARACTERISTIC
/begin COMPU_METHOD Compu_KNK_val_trig " " RAT_FUNC "%.1" "%" COEFFS 0 655.36 0 0 0 1 /end COMPU_METHOD
/begin CHARACTERISTIC KNK_val_cycles "Average KNK window" VALUE 0x0014393d /* @ECU_Address@KNK_val_cycles@0x01001130@ */ ECIPP_ALIGNMENT_UBYTE 255 Compu_KNK_val_cycles 0 255 /end CHARACTERISTIC
/begin COMPU_METHOD Compu_KNK_val_cycles " " RAT_FUNC "%.0" "cycles" COEFFS 0 1 0 0 0 1 /end COMPU_METHOD
/begin CHARACTERISTIC KNK_ECT_ena "KNK ECT enable" VALUE 0x001438d0 /* @ECU_Address@KNK_ECT_ena@0x010011A0@ */ ECIPP_ALIGNMENT_UWORD 564 Compu_KNK_ECT_ena -460 563.984375 /end CHARACTERISTIC
/begin COMPU_METHOD Compu_KNK_ECT_ena " " RAT_FUNC "%.1" "deg F" COEFFS 0 64 29440 0 0 1 /end COMPU_METHOD
/begin CHARACTERISTIC KNK_min_MAP "Knock min MAP" VALUE 0x001438e0 /* @ECU_Address@KNK_min_MAP@0x01001258@ */ ECIPP_ALIGNMENT_UWORD 256 Compu_KNK_min_MAP 0 255.99609375 /end CHARACTERISTIC
/begin COMPU_METHOD Compu_KNK_min_MAP " " RAT_FUNC "%.2" "psia" COEFFS 0 256 0 0 0 1 /end COMPU_METHOD
/begin CHARACTERISTIC KNK_max_RPM "Knock max RPM" VALUE 0x001438de /* @ECU_Address@KNK_max_RPM@0x01001260@ */ ECIPP_ALIGNMENT_UWORD 65535 Compu_KNK_max_RPM 0 65535 /end CHARACTERISTIC
/begin COMPU_METHOD Compu_KNK_max_RPM " " RAT_FUNC "%.0" "rpm" COEFFS 0 1 0 0 0 1 /end COMPU_METHOD
/begin MEASUREMENT KCYC_enable "Knock cycle-sample updates{KCYC_enable&0xff=0:Halted}{KCYC_enable&0xff=1:Active}" UBYTE KCYC_enable_COMPU_VTAB 0 0 0 255 ECU_ADDRESS 0x01002A28 BIT_MASK 0xff /end MEASUREMENT
/begin COMPU_METHOD KCYC_enable_COMPU_VTAB "Verbal Table" TAB_VERB "%.0" "list" COMPU_TAB_REF KCYC_enable_COMPU_VTAB_REF /end COMPU_METHOD
/begin COMPU_VTAB KCYC_enable_COMPU_VTAB_REF "Verbal Table" TAB_VERB 2 0 "Halted" 1 "Active" DEFAULT_VALUE "UNKNOWN" /end COMPU_VTAB
/begin CHARACTERISTIC KNK_BPF "Knock band-pass filter selection{KNK_BPF&0xff=0:Disabled}{KNK_BPF&0xff=1:2.00 KHz}{KNK_BPF&0xff=2:2.25 KHz}{KNK_BPF&0xff=3:2.50 KHz}{KNK_BPF&0xff=4:2.75 KHz}{KNK_BPF&0xff=5:3.00 KHz}{KNK_BPF&0xff=6:3.25 KHz}{KNK_BPF&0xff=7:3.50 KHz}{KNK_BPF&0xff=8:3.75 KH" VALUE 0x0014391b /* @ECU_Address@KNK_BPF@0x01002A30@ */ ECIPP_ALIGNMENT_UBYTE 255 KNK_BPF_COMPU_VTAB 0 255 BIT_MASK 0xff /end CHARACTERISTIC
/begin COMPU_METHOD KNK_BPF_COMPU_VTAB "Verbal Table" TAB_VERB "%.0" "list" COMPU_TAB_REF KNK_BPF_COMPU_VTAB_REF /end COMPU_METHOD
/begin COMPU_VTAB KNK_BPF_COMPU_VTAB_REF "Verbal Table" TAB_VERB 50 0 "Disabled" 1 "2.00 KHz" 2 "2.25 KHz" 3 "2.50 KHz" 4 "2.75 KHz" 5 "3.00 KHz" 6 "3.25 KHz" 7 "3.50 KHz" 8 "3.75 KHz" 9 "4.00 KHz" 10 "4.25 KHz" 11 "4.50 KHz" 12 "4.75 KHz" 13 "5.00 KHz" 14 "5.25 KHz" 15 "5.50 KHz" 16 "5.75 KHz" 17 "6.00 KHz" 18 "6.25 KHz" 19 "6.50 KHz" 20 "6.75 KHz" 21 "7.00 KHz" 22 "7.25 KHz" 23 "7.50 KHz" 24 "7.75 KHz" 25 "8.00 KHz" 26 "8.25 KHz" 27 "8.50 KHz" 28 "8.75 KHz" 29 "9.00 KHz" 30 "9.50 KHz" 31 "10.00 KHz" 32 "10.50 KHz" 33 "11.00 KHz" 34 "11.50 KHz" 35 "12.00 KHz" 36 "12.50 KHz" 37 "13.00 KHz" 38 "13.50 KHz" 39 "14.00 KHz" 40 "14.50 KHz" 41 "15.00 KHz" 42 "15.50 KHz" 43 "16.00 KHz" 44 "16.50 KHz" 45 "17.00 KHz" 46 "17.50 KHz" 47 "18.00 KHz" 48 "19.00 KHz" 49 "20.00 KHz" DEFAULT_VALUE "UNKNOWN" /end COMPU_VTAB
/begin MEASUREMENT KNK_SW_gain "Knock software gain" UWORD Compu_KNK_SW_gain 0 0 0 255.99609375 ECU_ADDRESS 0x01002A38 /end MEASUREMENT
/begin COMPU_METHOD Compu_KNK_SW_gain " " RAT_FUNC "%.2" "multiplier" COEFFS 0 256 0 0 0 1 /end COMPU_METHOD
/begin CHARACTERISTIC KNK_sens_cyl1 "Knock sensor assignment 1{KNK_sens_cyl1&0xff=0:Disabled}{KNK_sens_cyl1&0xff=1:Sensor 1}{KNK_sens_cyl1&0xff=2:Sensor 2}{KNK_sens_cyl1&0xff=3:Sensor 3}" VALUE 0x00143929 /* @ECU_Address@KNK_sens_cyl1@0x01002A58@ */ ECIPP_ALIGNMENT_UBYTE 255 KNK_sens_cyl1_COMPU_VTAB 0 255 BIT_MASK 0xff /end CHARACTERISTIC
/begin COMPU_METHOD KNK_sens_cyl1_COMPU_VTAB "Verbal Table" TAB_VERB "%.0" "list" COMPU_TAB_REF KNK_sens_cyl1_COMPU_VTAB_REF /end COMPU_METHOD
/begin COMPU_VTAB KNK_sens_cyl1_COMPU_VTAB_REF "Verbal Table" TAB_VERB 4 0 "Disabled" 1 "Sensor 1" 2 "Sensor 2" 3 "Sensor 3" DEFAULT_VALUE "UNKNOWN" /end COMPU_VTAB
/begin CHARACTERISTIC KNK_sens_cyl2 "Knock sensor assignment 2{KNK_sens_cyl2&0xff=0:Disabled}{KNK_sens_cyl2&0xff=1:Sensor 1}{KNK_sens_cyl2&0xff=2:Sensor 2}{KNK_sens_cyl2&0xff=3:Sensor 3}" VALUE 0x0014392A /* @ECU_Address@KNK_sens_cyl2@0x01002A60@ */ ECIPP_ALIGNMENT_UBYTE 255 KNK_sens_cyl2_COMPU_VTAB 0 255 BIT_MASK 0xff /end CHARACTERISTIC
/begin COMPU_METHOD KNK_sens_cyl2_COMPU_VTAB "Verbal Table" TAB_VERB "%.0" "list" COMPU_TAB_REF KNK_sens_cyl2_COMPU_VTAB_REF /end COMPU_METHOD
/begin COMPU_VTAB KNK_sens_cyl2_COMPU_VTAB_REF "Verbal Table" TAB_VERB 4 0 "Disabled" 1 "Sensor 1" 2 "Sensor 2" 3 "Sensor 3" DEFAULT_VALUE "UNKNOWN" /end COMPU_VTAB
/begin CHARACTERISTIC KNK_sens_cyl3 "Knock sensor assignment 3{KNK_sens_cyl3&0xff=0:Disabled}{KNK_sens_cyl3&0xff=1:Sensor 1}{KNK_sens_cyl3&0xff=2:Sensor 2}{KNK_sens_cyl3&0xff=3:Sensor 3}" VALUE 0x0014392B /* @ECU_Address@KNK_sens_cyl3@0x01002A68@ */ ECIPP_ALIGNMENT_UBYTE 255 KNK_sens_cyl3_COMPU_VTAB 0 255 BIT_MASK 0xff /end CHARACTERISTIC
/begin COMPU_METHOD KNK_sens_cyl3_COMPU_VTAB "Verbal Table" TAB_VERB "%.0" "list" COMPU_TAB_REF KNK_sens_cyl3_COMPU_VTAB_REF /end COMPU_METHOD
/begin COMPU_VTAB KNK_sens_cyl3_COMPU_VTAB_REF "Verbal Table" TAB_VERB 4 0 "Disabled" 1 "Sensor 1" 2 "Sensor 2" 3 "Sensor 3" DEFAULT_VALUE "UNKNOWN" /end COMPU_VTAB
/begin CHARACTERISTIC KNK_sens_cyl4 "Knock sensor assignment 4{KNK_sens_cyl4&0xff=0:Disabled}{KNK_sens_cyl4&0xff=1:Sensor 1}{KNK_sens_cyl4&0xff=2:Sensor 2}{KNK_sens_cyl4&0xff=3:Sensor 3}" VALUE 0x0014392C /* @ECU_Address@KNK_sens_cyl4@0x01002A70@ */ ECIPP_ALIGNMENT_UBYTE 255 KNK_sens_cyl4_COMPU_VTAB 0 255 BIT_MASK 0xff /end CHARACTERISTIC
/begin COMPU_METHOD KNK_sens_cyl4_COMPU_VTAB "Verbal Table" TAB_VERB "%.0" "list" COMPU_TAB_REF KNK_sens_cyl4_COMPU_VTAB_REF /end COMPU_METHOD
/begin COMPU_VTAB KNK_sens_cyl4_COMPU_VTAB_REF "Verbal Table" TAB_VERB 4 0 "Disabled" 1 "Sensor 1" 2 "Sensor 2" 3 "Sensor 3" DEFAULT_VALUE "UNKNOWN" /end COMPU_VTAB
/begin CHARACTERISTIC KNK_sens_cyl5 "Knock sensor assignment 5{KNK_sens_cyl5&0xff=0:Disabled}{KNK_sens_cyl5&0xff=1:Sensor 1}{KNK_sens_cyl5&0xff=2:Sensor 2}{KNK_sens_cyl5&0xff=3:Sensor 3}" VALUE 0x0014392D /* @ECU_Address@KNK_sens_cyl5@0x01002A78@ */ ECIPP_ALIGNMENT_UBYTE 255 KNK_sens_cyl5_COMPU_VTAB 0 255 BIT_MASK 0xff /end CHARACTERISTIC
/begin COMPU_METHOD KNK_sens_cyl5_COMPU_VTAB "Verbal Table" TAB_VERB "%.0" "list" COMPU_TAB_REF KNK_sens_cyl5_COMPU_VTAB_REF /end COMPU_METHOD
/begin COMPU_VTAB KNK_sens_cyl5_COMPU_VTAB_REF "Verbal Table" TAB_VERB 4 0 "Disabled" 1 "Sensor 1" 2 "Sensor 2" 3 "Sensor 3" DEFAULT_VALUE "UNKNOWN" /end COMPU_VTAB
/begin CHARACTERISTIC KNK_sens_cyl6 "Knock sensor assignment 6{KNK_sens_cyl6&0xff=0:Disabled}{KNK_sens_cyl6&0xff=1:Sensor 1}{KNK_sens_cyl6&0xff=2:Sensor 2}{KNK_sens_cyl6&0xff=3:Sensor 3}" VALUE 0x0014392E /* @ECU_Address@KNK_sens_cyl6@0x01002A80@ */ ECIPP_ALIGNMENT_UBYTE 255 KNK_sens_cyl6_COMPU_VTAB 0 255 BIT_MASK 0xff /end CHARACTERISTIC
/begin COMPU_METHOD KNK_sens_cyl6_COMPU_VTAB "Verbal Table" TAB_VERB "%.0" "list" COMPU_TAB_REF KNK_sens_cyl6_COMPU_VTAB_REF /end COMPU_METHOD
/begin COMPU_VTAB KNK_sens_cyl6_COMPU_VTAB_REF "Verbal Table" TAB_VERB 4 0 "Disabled" 1 "Sensor 1" 2 "Sensor 2" 3 "Sensor 3" DEFAULT_VALUE "UNKNOWN" /end COMPU_VTAB
/begin CHARACTERISTIC KNK_sens_cyl7 "Knock sensor assignment 7{KNK_sens_cyl7&0xff=0:Disabled}{KNK_sens_cyl7&0xff=1:Sensor 1}{KNK_sens_cyl7&0xff=2:Sensor 2}{KNK_sens_cyl7&0xff=3:Sensor 3}" VALUE 0x0014392F /* @ECU_Address@KNK_sens_cyl7@0x01002A88@ */ ECIPP_ALIGNMENT_UBYTE 255 KNK_sens_cyl7_COMPU_VTAB 0 255 BIT_MASK 0xff /end CHARACTERISTIC
/begin COMPU_METHOD KNK_sens_cyl7_COMPU_VTAB "Verbal Table" TAB_VERB "%.0" "list" COMPU_TAB_REF KNK_sens_cyl7_COMPU_VTAB_REF /end COMPU_METHOD
/begin COMPU_VTAB KNK_sens_cyl7_COMPU_VTAB_REF "Verbal Table" TAB_VERB 4 0 "Disabled" 1 "Sensor 1" 2 "Sensor 2" 3 "Sensor 3" DEFAULT_VALUE "UNKNOWN" /end COMPU_VTAB
/begin CHARACTERISTIC KNK_sens_cyl8 "Knock sensor assignment 8{KNK_sens_cyl8&0xff=0:Disabled}{KNK_sens_cyl8&0xff=1:Sensor 1}{KNK_sens_cyl8&0xff=2:Sensor 2}{KNK_sens_cyl8&0xff=3:Sensor 3}" VALUE 0x00143930 /* @ECU_Address@KNK_sens_cyl8@0x01002A90@ */ ECIPP_ALIGNMENT_UBYTE 255 KNK_sens_cyl8_COMPU_VTAB 0 255 BIT_MASK 0xff /end CHARACTERISTIC
/begin COMPU_METHOD KNK_sens_cyl8_COMPU_VTAB "Verbal Table" TAB_VERB "%.0" "list" COMPU_TAB_REF KNK_sens_cyl8_COMPU_VTAB_REF /end COMPU_METHOD
/begin COMPU_VTAB KNK_sens_cyl8_COMPU_VTAB_REF "Verbal Table" TAB_VERB 4 0 "Disabled" 1 "Sensor 1" 2 "Sensor 2" 3 "Sensor 3" DEFAULT_VALUE "UNKNOWN" /end COMPU_VTAB
/begin MEASUREMENT KNK_bg_dur "KNK backgnd duration" SWORD Compu_KNK_bg_dur 0 0 -16384 16383.5 ECU_ADDRESS 0x01002A98 /end MEASUREMENT
/begin COMPU_METHOD Compu_KNK_bg_dur " " RAT_FUNC "%.0" "CAD" COEFFS 0 2 0 0 0 1 /end COMPU_METHOD
/begin MEASUREMENT KNK_bg_start "KNK background start" SWORD Compu_KNK_bg_start 0 0 -16384 16383.5 ECU_ADDRESS 0x01002AA0 /end MEASUREMENT
/begin COMPU_METHOD Compu_KNK_bg_start " " RAT_FUNC "%.0" "CAD BTDC" COEFFS 0 2 0 0 0 1 /end COMPU_METHOD
/begin MEASUREMENT KNK_win_avg "KNK1 raw window average" UWORD Compu_KNK_win_avg 0 0 0 63.9990234375 ECU_ADDRESS 0x01002AA8 /end MEASUREMENT
/begin COMPU_METHOD Compu_KNK_win_avg " " RAT_FUNC "%.3" "volts" COEFFS 0 1024 0 0 0 1 /end COMPU_METHOD
/begin CHARACTERISTIC KNK_BPF_delay "Knock band-pass filter delay" VALUE 0x001438cc /* @ECU_Address@KNK_BPF_delay@0x01002AB0@ */ ECIPP_ALIGNMENT_UWORD 16 Compu_KNK_BPF_delay 0 15.999755859375 /end CHARACTERISTIC
/begin COMPU_METHOD Compu_KNK_BPF_delay " " RAT_FUNC "%.3" "ms" COEFFS 0 4096 0 0 0 1 /end COMPU_METHOD
/begin CHARACTERISTIC KNK_sig_pweight "Knock feedback peak weighting" VALUE 0x001438e4 /* @ECU_Address@KNK_sig_pweight@0x01002AB8@ */ ECIPP_ALIGNMENT_UWORD 100 Compu_KNK_sig_pweight 0 99.9984741210938 /end CHARACTERISTIC
/begin COMPU_METHOD Compu_KNK_sig_pweight " " RAT_FUNC "%.1" "%" COEFFS 0 655.36 0 0 0 1 /end COMPU_METHOD
/begin CHARACTERISTIC spk_ofst_maxadv "Engineering spark advance offset limit" VALUE 0x00146684 /* @ECU_Address@spk_ofst_maxadv@0x01002AC0@ */ ECIPP_ALIGNMENT_SWORD 2048 Compu_spk_ofst_maxadv -2048 2047.9375 /end CHARACTERISTIC
/begin COMPU_METHOD Compu_spk_ofst_maxadv " " RAT_FUNC "%.0" "%" COEFFS 0 16 0 0 0 1 /end COMPU_METHOD
/begin CHARACTERISTIC OCT_init "Cold power-up default octane rating" VALUE 0x001438f6 /* @ECU_Address@OCT_init@0x01002AD0@ */ ECIPP_ALIGNMENT_UWORD 100 Compu_OCT_init 0 99.9984741210938 /end CHARACTERISTIC
/begin COMPU_METHOD Compu_OCT_init " " RAT_FUNC "%.1" "%" COEFFS 0 655.36 0 0 0 1 /end COMPU_METHOD
/begin CHARACTERISTIC OCT_ret_increase "Lower knk retard for octane increase" VALUE 0x00143902 /* @ECU_Address@OCT_ret_increase@0x01002AD8@ */ ECIPP_ALIGNMENT_UWORD 128 Compu_OCT_ret_increase 0 127.998046875 /end CHARACTERISTIC
/begin COMPU_METHOD Compu_OCT_ret_increase " " RAT_FUNC "%.1" "CAD" COEFFS 0 512 0 0 0 1 /end COMPU_METHOD
/begin CHARACTERISTIC OCT_ret_decrease "Higher knk retard for proportional octane decrease" VALUE 0x00143900 /* @ECU_Address@OCT_ret_decrease@0x01002AE0@ */ ECIPP_ALIGNMENT_UWORD 128 Compu_OCT_ret_decrease 0 127.998046875 /end CHARACTERISTIC
/begin COMPU_METHOD Compu_OCT_ret_decrease " " RAT_FUNC "%.1" "CAD" COEFFS 0 512 0 0 0 1 /end COMPU_METHOD
/begin CHARACTERISTIC OCT_slew_inc "Increasing octane slew rate" VALUE 0x0014390e /* @ECU_Address@OCT_slew_inc@0x01002AE8@ */ ECIPP_ALIGNMENT_UWORD 100 Compu_OCT_slew_inc 0 99.9984741210938 /end CHARACTERISTIC
/begin COMPU_METHOD Compu_OCT_slew_inc " " RAT_FUNC "%.2" "%/sec" COEFFS 0 655.36 0 0 0 1 /end COMPU_METHOD
/begin CHARACTERISTIC OCT_slew_dec "Decreasing octane minimum Kp" VALUE 0x00143906 /* @ECU_Address@OCT_slew_dec@0x01002AF0@ */ ECIPP_ALIGNMENT_UWORD 100 Compu_OCT_slew_dec 0 99.9984741210938 /end CHARACTERISTIC
/begin COMPU_METHOD Compu_OCT_slew_dec " " RAT_FUNC "%.2" "%/sec" COEFFS 0 655.36 0 0 0 1 /end COMPU_METHOD
/begin CHARACTERISTIC OCT_update_wait "Octane adapt validation wait" VALUE 0x00143912 /* @ECU_Address@OCT_update_wait@0x01002AF8@ */ ECIPP_ALIGNMENT_UWORD 66 Compu_OCT_update_wait 0 65.535 /end CHARACTERISTIC
/begin COMPU_METHOD Compu_OCT_update_wait " " RAT_FUNC "%.1" "sec" COEFFS 0 1000 0 0 0 1 /end COMPU_METHOD
/begin CHARACTERISTIC OCT_MAPss_win "Octane adapt steady-state +/- MAP" VALUE 0x001438ea /* @ECU_Address@OCT_MAPss_win@0x01002B00@ */ ECIPP_ALIGNMENT_UWORD 256 Compu_OCT_MAPss_win 0 255.99609375 /end CHARACTERISTIC
/begin COMPU_METHOD Compu_OCT_MAPss_win " " RAT_FUNC "%.2" "psia" COEFFS 0 256 0 0 0 1 /end COMPU_METHOD
/begin CHARACTERISTIC OCT_RPMss_win "Octane adapt steady-state +/- RPM" VALUE 0x001438ec /* @ECU_Address@OCT_RPMss_win@0x01002B08@ */ ECIPP_ALIGNMENT_UWORD 65535 Compu_OCT_RPMss_win 0 65535 /end CHARACTERISTIC
/begin COMPU_METHOD Compu_OCT_RPMss_win " " RAT_FUNC "%.0" "rpm" COEFFS 0 1 0 0 0 1 /end COMPU_METHOD
/begin CHARACTERISTIC OCT_ss_tau "Octane steady-state low-pass tau" VALUE 0x00143918 /* @ECU_Address@OCT_ss_tau@0x01002B10@ */ ECIPP_ALIGNMENT_UWORD 3277 Compu_OCT_ss_tau 0.0045084 3276.8 /end CHARACTERISTIC
/begin COMPU_METHOD Compu_OCT_ss_tau " " FORM "%.1" "sec"
 /begin FORMULA "-0.05 / log(1 - (X1 / 65536))" FORMULA_INV "(1 - exp(-0.05/X1)) * 65536" /end FORMULA
/end COMPU_METHOD
/begin CHARACTERISTIC OCT_run_wait "Octane estimation engine start wait" VALUE 0x00143904 /* @ECU_Address@OCT_run_wait@0x01002B18@ */ ECIPP_ALIGNMENT_UWORD 65535 Compu_OCT_run_wait 0 65535 /end CHARACTERISTIC
/begin COMPU_METHOD Compu_OCT_run_wait " " RAT_FUNC "%.0" "sec" COEFFS 0 1 0 0 0 1 /end COMPU_METHOD
/begin CHARACTERISTIC OCT_ECT_ena "Octane estimation minimum ECT" VALUE 0x001438e8 /* @ECU_Address@OCT_ECT_ena@0x01002B20@ */ ECIPP_ALIGNMENT_UWORD 564 Compu_OCT_ECT_ena -460 563.984375 /end CHARACTERISTIC
/begin COMPU_METHOD Compu_OCT_ECT_ena " " RAT_FUNC "%.1" "deg F" COEFFS 0 64 29440 0 0 1 /end COMPU_METHOD
/begin CHARACTERISTIC OCT_min_MAP "Octane estimation minimum MAP" VALUE 0x001438fc /* @ECU_Address@OCT_min_MAP@0x01002B28@ */ ECIPP_ALIGNMENT_UWORD 256 Compu_OCT_min_MAP 0 255.99609375 /end CHARACTERISTIC
/begin COMPU_METHOD Compu_OCT_min_MAP " " RAT_FUNC "%.2" "psia" COEFFS 0 256 0 0 0 1 /end COMPU_METHOD
/begin CHARACTERISTIC OCT_max_MAP "Octane estimation maximum MAP" VALUE 0x001438f8 /* @ECU_Address@OCT_max_MAP@0x01002B30@ */ ECIPP_ALIGNMENT_UWORD 256 Compu_OCT_max_MAP 0 255.99609375 /end CHARACTERISTIC
/begin COMPU_METHOD Compu_OCT_max_MAP " " RAT_FUNC "%.2" "psia" COEFFS 0 256 0 0 0 1 /end COMPU_METHOD
/begin CHARACTERISTIC OCT_min_RPM "Octane estimation minimum RPM" VALUE 0x001438fe /* @ECU_Address@OCT_min_RPM@0x01002B38@ */ ECIPP_ALIGNMENT_UWORD 65535 Compu_OCT_min_RPM 0 65535 /end CHARACTERISTIC
/begin COMPU_METHOD Compu_OCT_min_RPM " " RAT_FUNC "%.0" "rpm" COEFFS 0 1 0 0 0 1 /end COMPU_METHOD
/begin CHARACTERISTIC OCT_max_RPM "Octane estimation maximum RPM" VALUE 0x001438fa /* @ECU_Address@OCT_max_RPM@0x01002B40@ */ ECIPP_ALIGNMENT_UWORD 65535 Compu_OCT_max_RPM 0 65535 /end CHARACTERISTIC
/begin COMPU_METHOD Compu_OCT_max_RPM " " RAT_FUNC "%.0" "rpm" COEFFS 0 1 0 0 0 1 /end COMPU_METHOD
/begin MEASUREMENT OCT_update_tmr "Octane adapt validation timer" UWORD Compu_OCT_update_tmr 0 0 0 65.535 ECU_ADDRESS 0x01002B50 /end MEASUREMENT
/begin COMPU_METHOD Compu_OCT_update_tmr " " RAT_FUNC "%.1" "sec" COEFFS 0 1000 0 0 0 1 /end COMPU_METHOD
/begin MEASUREMENT OCT_MAPss "Octane adapt steady-state MAP" UWORD Compu_OCT_MAPss 0 0 0 255.99609375 ECU_ADDRESS 0x01002B58 /end MEASUREMENT
/begin COMPU_METHOD Compu_OCT_MAPss " " RAT_FUNC "%.2" "psia" COEFFS 0 256 0 0 0 1 /end COMPU_METHOD
/begin MEASUREMENT OCT_RPMss "Octane adapt steady-state RPM" UWORD Compu_OCT_RPMss 0 0 0 65535 ECU_ADDRESS 0x01002B60 /end MEASUREMENT
/begin COMPU_METHOD Compu_OCT_RPMss " " RAT_FUNC "%.0" "rpm" COEFFS 0 1 0 0 0 1 /end COMPU_METHOD
/begin MEASUREMENT spk_adv_altOCT "High octane base advance" SWORD Compu_spk_adv_altOCT 0 0 -2048 2047.9375 ECU_ADDRESS 0x01002B68 /end MEASUREMENT
/begin COMPU_METHOD Compu_spk_adv_altOCT " " RAT_FUNC "%.1" "CAD BTDC" COEFFS 0 16 0 0 0 1 /end COMPU_METHOD
/begin MEASUREMENT spk_adv_OCTcomp "Octane compensated base advance" SWORD Compu_spk_adv_OCTcomp 0 0 -2048 2047.9375 ECU_ADDRESS 0x01002B70 /end MEASUREMENT
/begin COMPU_METHOD Compu_spk_adv_OCTcomp " " RAT_FUNC "%.1" "CAD BTDC" COEFFS 0 16 0 0 0 1 /end COMPU_METHOD
/begin CHARACTERISTIC OCT_init_mode "Key-on octane rating reset mode{OCT_init_mode&0xff=0:Use last value}{OCT_init_mode&0xff=1:Reset to default}" VALUE 0x0014393e /* @ECU_Address@OCT_init_mode@0x01002B78@ */ ECIPP_ALIGNMENT_UBYTE 255 OCT_init_mode_COMPU_VTAB 0 255 BIT_MASK 0xff /end CHARACTERISTIC
/begin COMPU_METHOD OCT_init_mode_COMPU_VTAB "Verbal Table" TAB_VERB "%.0" "list" COMPU_TAB_REF OCT_init_mode_COMPU_VTAB_REF /end COMPU_METHOD
/begin COMPU_VTAB OCT_init_mode_COMPU_VTAB_REF "Verbal Table" TAB_VERB 2 0 "Use last value" 1 "Reset to default" DEFAULT_VALUE "UNKNOWN" /end COMPU_VTAB
/begin CHARACTERISTIC FKNK_ena "Fuel-based knock control{FKNK_ena&0xff=0:Disabled}{FKNK_ena&0xff=1:Enabled}" VALUE 0x0014391a /* @ECU_Address@FKNK_ena@0x01002B80@ */ ECIPP_ALIGNMENT_UBYTE 255 FKNK_ena_COMPU_VTAB 0 255 BIT_MASK 0xff /end CHARACTERISTIC
/begin COMPU_METHOD FKNK_ena_COMPU_VTAB "Verbal Table" TAB_VERB "%.0" "list" COMPU_TAB_REF FKNK_ena_COMPU_VTAB_REF /end COMPU_METHOD
/begin COMPU_VTAB FKNK_ena_COMPU_VTAB_REF "Verbal Table" TAB_VERB 2 0 "Disabled" 1 "Enabled" DEFAULT_VALUE "UNKNOWN" /end COMPU_VTAB
/begin CHARACTERISTIC FKNK_ret_start "Fuel-based knock control initiation" VALUE 0x001438c8 /* @ECU_Address@FKNK_ret_start@0x01002B88@ */ ECIPP_ALIGNMENT_UWORD 128 Compu_FKNK_ret_start 0 127.998046875 /end CHARACTERISTIC
/begin COMPU_METHOD Compu_FKNK_ret_start " " RAT_FUNC "%.1" "CAD retard" COEFFS 0 512 0 0 0 1 /end COMPU_METHOD
/begin CHARACTERISTIC FKNK_ret_max "Fuel-based knock control completion" VALUE 0x001438c6 /* @ECU_Address@FKNK_ret_max@0x01002B90@ */ ECIPP_ALIGNMENT_UWORD 128 Compu_FKNK_ret_max 0 127.998046875 /end CHARACTERISTIC
/begin COMPU_METHOD Compu_FKNK_ret_max " " RAT_FUNC "%.1" "CAD retard" COEFFS 0 512 0 0 0 1 /end COMPU_METHOD
/begin CHARACTERISTIC FKNK_enrich_max "Maximum fuel modifier at completion" VALUE 0x001433f2 /* @ECU_Address@FKNK_enrich_max@0x01002B98@ */ ECIPP_ALIGNMENT_SWORD 200 Compu_FKNK_enrich_max -200 199.993896484375 /end CHARACTERISTIC
/begin COMPU_METHOD Compu_FKNK_enrich_max " " RAT_FUNC "%.1" "%" COEFFS 0 163.84 0 0 0 1 /end COMPU_METHOD
/begin CHARACTERISTIC FKNK_enr_inc_tau "Increasing fuel modifier low-pass tau" VALUE 0x00143916 /* @ECU_Address@FKNK_enr_inc_tau@0x01002BA0@ */ ECIPP_ALIGNMENT_UWORD 163840 Compu_FKNK_enr_inc_tau 0.16703 163840 /end CHARACTERISTIC
/begin COMPU_METHOD Compu_FKNK_enr_inc_tau " " FORM "%.0" "ms"
 /begin FORMULA "-5 / log(1.0000000000001 - (X1 / 32768))" FORMULA_INV "(1.0000000000001 - exp(-5/X1)) * 32768" /end FORMULA
/end COMPU_METHOD
/begin CHARACTERISTIC FKNK_enr_dec_tau "Decreasing fuel modifier low-pass tau" VALUE 0x00143914 /* @ECU_Address@FKNK_enr_dec_tau@0x01002BA8@ */ ECIPP_ALIGNMENT_UWORD 163840 Compu_FKNK_enr_dec_tau 0.16703 163840 /end CHARACTERISTIC
/begin COMPU_METHOD Compu_FKNK_enr_dec_tau " " FORM "%.0" "ms"
 /begin FORMULA "-5 / log(1.0000000000001 - (X1 / 32768))" FORMULA_INV "(1.0000000000001 - exp(-5/X1)) * 32768" /end FORMULA
/end COMPU_METHOD
/begin MEASUREMENT FKNK_enrich_mod "Current knock fuel modifier" SWORD Compu_FKNK_enrich_mod 0 0 -200 199.993896484375 ECU_ADDRESS 0x01002BB0 /end MEASUREMENT
/begin COMPU_METHOD Compu_FKNK_enrich_mod " " RAT_FUNC "%.1" "%" COEFFS 0 163.84 0 0 0 1 /end COMPU_METHOD
/begin CHARACTERISTIC KNK_adv_KRreti "Knock advance gain rolloff initiation" VALUE 0x001438dc /* @ECU_Address@KNK_adv_KRreti@0x01002BE8@ */ ECIPP_ALIGNMENT_UWORD 128 Compu_KNK_adv_KRreti 0 127.998046875 /end CHARACTERISTIC
/begin COMPU_METHOD Compu_KNK_adv_KRreti " " RAT_FUNC "%.3" "CAD retard" COEFFS 0 512 0 0 0 1 /end COMPU_METHOD
/begin CHARACTERISTIC KNK_adv_KRretc "Knock advance gain rolloff completion" VALUE 0x001438da /* @ECU_Address@KNK_adv_KRretc@0x01002BF0@ */ ECIPP_ALIGNMENT_UWORD 128 Compu_KNK_adv_KRretc 0 127.998046875 /end CHARACTERISTIC
/begin COMPU_METHOD Compu_KNK_adv_KRretc " " RAT_FUNC "%.3" "CAD retard" COEFFS 0 512 0 0 0 1 /end COMPU_METHOD
/begin CHARACTERISTIC KNK_adv_KRmin "Knock advance rolloff gain minimum" VALUE 0x001438d8 /* @ECU_Address@KNK_adv_KRmin@0x01002BF8@ */ ECIPP_ALIGNMENT_UWORD 128 Compu_KNK_adv_KRmin 0 127.998046875 /end CHARACTERISTIC
/begin COMPU_METHOD Compu_KNK_adv_KRmin " " RAT_FUNC "%.3" "CAD / cycle" COEFFS 0 512 0 0 0 1 /end COMPU_METHOD
/begin CHARACTERISTIC OCT_mem_type "Adaptive octane memory type{OCT_mem_type&0xff=0:Single Point}{OCT_mem_type&0xff=1:Table Based}" VALUE 0x00143940 /* @ECU_Address@OCT_mem_type@0x01002C00@ */ ECIPP_ALIGNMENT_UBYTE 255 OCT_mem_type_COMPU_VTAB 0 255 BIT_MASK 0xff /end CHARACTERISTIC
/begin COMPU_METHOD OCT_mem_type_COMPU_VTAB "Verbal Table" TAB_VERB "%.0" "list" COMPU_TAB_REF OCT_mem_type_COMPU_VTAB_REF /end COMPU_METHOD
/begin COMPU_VTAB OCT_mem_type_COMPU_VTAB_REF "Verbal Table" TAB_VERB 2 0 "Single Point" 1 "Table Based" DEFAULT_VALUE "UNKNOWN" /end COMPU_VTAB
/begin CHARACTERISTIC OCT_inc_wait "Octane increase wait time" VALUE 0x001438f2 /* @ECU_Address@OCT_inc_wait@0x010031D0@ */ ECIPP_ALIGNMENT_UWORD 66 Compu_OCT_inc_wait 0 65.535 /end CHARACTERISTIC
/begin COMPU_METHOD Compu_OCT_inc_wait " " RAT_FUNC "%.1" "sec" COEFFS 0 1000 0 0 0 1 /end COMPU_METHOD
/begin CHARACTERISTIC OCT_inc_wait_pct "Octane increase wait knock activity" VALUE 0x001438f4 /* @ECU_Address@OCT_inc_wait_pct@0x010031D8@ */ ECIPP_ALIGNMENT_UWORD 100 Compu_OCT_inc_wait_pct 0 99.9984741210938 /end CHARACTERISTIC
/begin COMPU_METHOD Compu_OCT_inc_wait_pct " " RAT_FUNC "%.1" "%" COEFFS 0 655.36 0 0 0 1 /end COMPU_METHOD
/begin MEASUREMENT OCT_inc_tmr "Octane increase wait timer" UWORD Compu_OCT_inc_tmr 0 0 0 65.535 ECU_ADDRESS 0x010031E0 /end MEASUREMENT
/begin COMPU_METHOD Compu_OCT_inc_tmr " " RAT_FUNC "%.1" "sec" COEFFS 0 1000 0 0 0 1 /end COMPU_METHOD
/begin MEASUREMENT TSTcompression "Compression test command{TSTcompression&0xff=0:Disabled}{TSTcompression&0xff=1:Active}" UBYTE TSTcompression_COMPU_VTAB 0 0 0 255 ECU_ADDRESS 0x010031F0 BIT_MASK 0xff /end MEASUREMENT
/begin COMPU_METHOD TSTcompression_COMPU_VTAB "Verbal Table" TAB_VERB "%.0" "list" COMPU_TAB_REF TSTcompression_COMPU_VTAB_REF /end COMPU_METHOD
/begin COMPU_VTAB TSTcompression_COMPU_VTAB_REF "Verbal Table" TAB_VERB 2 0 "Disabled" 1 "Active" DEFAULT_VALUE "UNKNOWN" /end COMPU_VTAB
/begin MEASUREMENT MSinj_kill "Injector kill test status{MSinj_kill&0xff=0:Test Not Started}{MSinj_kill&0xff=1:Test Running}{MSinj_kill&0xff=2:Test Finished}{MSinj_kill&0xff=3:Condition 1 Not Met}{MSinj_kill&0xff=4:Condition 2 Not Met}{MSinj_kill&0xff=5:Condition 3 Not Met}{MSinj_kill&" UBYTE MSinj_kill_COMPU_VTAB 0 0 0 255 ECU_ADDRESS 0x010032E0 BIT_MASK 0xff /end MEASUREMENT
/begin COMPU_METHOD MSinj_kill_COMPU_VTAB "Verbal Table" TAB_VERB "%.0" "list" COMPU_TAB_REF MSinj_kill_COMPU_VTAB_REF /end COMPU_METHOD
/begin COMPU_VTAB MSinj_kill_COMPU_VTAB_REF "Verbal Table" TAB_VERB 8 0 "Test Not Started" 1 "Test Running" 2 "Test Finished" 3 "Condition 1 Not Met" 4 "Condition 2 Not Met" 5 "Condition 3 Not Met" 6 "Condition 4 Not Met" 7 "Cannot Start Test" DEFAULT_VALUE "UNKNOWN" /end COMPU_VTAB
/begin MEASUREMENT MSspk_kill "Spark kill test status{MSspk_kill&0xff=0:Test Not Started}{MSspk_kill&0xff=1:Test Running}{MSspk_kill&0xff=2:Test Finished}{MSspk_kill&0xff=3:RPM Too High}{MSspk_kill&0xff=4:MAP Too High}{MSspk_kill&0xff=5:CBT Too High}{MSspk_kill&0xff=6:Condition 4 Not M" UBYTE MSspk_kill_COMPU_VTAB 0 0 0 255 ECU_ADDRESS 0x010032E8 BIT_MASK 0xff /end MEASUREMENT
/begin COMPU_METHOD MSspk_kill_COMPU_VTAB "Verbal Table" TAB_VERB "%.0" "list" COMPU_TAB_REF MSspk_kill_COMPU_VTAB_REF /end COMPU_METHOD
/begin COMPU_VTAB MSspk_kill_COMPU_VTAB_REF "Verbal Table" TAB_VERB 8 0 "Test Not Started" 1 "Test Running" 2 "Test Finished" 3 "RPM Too High" 4 "MAP Too High" 5 "CBT Too High" 6 "Condition 4 Not Met" 7 "Cannot Start Test" DEFAULT_VALUE "UNKNOWN" /end COMPU_VTAB
/begin MEASUREMENT MSinj_fire "Injector firing test status{MSinj_fire&0xff=0:Test Not Started}{MSinj_fire&0xff=1:Test Running}{MSinj_fire&0xff=2:Test Finished}{MSinj_fire&0xff=3:Condition 1 Not Met}{MSinj_fire&0xff=4:Condition 2 Not Met}{MSinj_fire&0xff=5:Condition 3 Not Met}{MSinj_fir" UBYTE MSinj_fire_COMPU_VTAB 0 0 0 255 ECU_ADDRESS 0x010032F8 BIT_MASK 0xff /end MEASUREMENT
/begin COMPU_METHOD MSinj_fire_COMPU_VTAB "Verbal Table" TAB_VERB "%.0" "list" COMPU_TAB_REF MSinj_fire_COMPU_VTAB_REF /end COMPU_METHOD
/begin COMPU_VTAB MSinj_fire_COMPU_VTAB_REF "Verbal Table" TAB_VERB 8 0 "Test Not Started" 1 "Test Running" 2 "Test Finished" 3 "Condition 1 Not Met" 4 "Condition 2 Not Met" 5 "Condition 3 Not Met" 6 "Condition 4 Not Met" 7 "Cannot Start Test" DEFAULT_VALUE "UNKNOWN" /end COMPU_VTAB
/begin MEASUREMENT MScompression "Compression test status{MScompression&0xff=0:Test Not Started}{MScompression&0xff=1:Test Running}{MScompression&0xff=2:Test Finished}{MScompression&0xff=3:Condition 1 Not Met}{MScompression&0xff=4:Condition 2 Not Met}{MScompression&0xff=5:Condition 3 Not " UBYTE MScompression_COMPU_VTAB 0 0 0 255 ECU_ADDRESS 0x01003300 BIT_MASK 0xff /end MEASUREMENT
/begin COMPU_METHOD MScompression_COMPU_VTAB "Verbal Table" TAB_VERB "%.0" "list" COMPU_TAB_REF MScompression_COMPU_VTAB_REF /end COMPU_METHOD
/begin COMPU_VTAB MScompression_COMPU_VTAB_REF "Verbal Table" TAB_VERB 8 0 "Test Not Started" 1 "Test Running" 2 "Test Finished" 3 "Condition 1 Not Met" 4 "Condition 2 Not Met" 5 "Condition 3 Not Met" 6 "Condition 4 Not Met" 7 "Cannot Start Test" DEFAULT_VALUE "UNKNOWN" /end COMPU_VTAB
/begin MEASUREMENT MSspk_fire "Spark firing test status{MSspk_fire&0xff=0:Test Not Started}{MSspk_fire&0xff=1:Test Running}{MSspk_fire&0xff=2:Test Finished}{MSspk_fire&0xff=3:Condition 1 Not Met}{MSspk_fire&0xff=4:Condition 2 Not Met}{MSspk_fire&0xff=5:Condition 3 Not Met}{MSspk_fire&0" UBYTE MSspk_fire_COMPU_VTAB 0 0 0 255 ECU_ADDRESS 0x01003308 BIT_MASK 0xff /end MEASUREMENT
/begin COMPU_METHOD MSspk_fire_COMPU_VTAB "Verbal Table" TAB_VERB "%.0" "list" COMPU_TAB_REF MSspk_fire_COMPU_VTAB_REF /end COMPU_METHOD
/begin COMPU_VTAB MSspk_fire_COMPU_VTAB_REF "Verbal Table" TAB_VERB 8 0 "Test Not Started" 1 "Test Running" 2 "Test Finished" 3 "Condition 1 Not Met" 4 "Condition 2 Not Met" 5 "Condition 3 Not Met" 6 "Condition 4 Not Met" 7 "Cannot Start Test" DEFAULT_VALUE "UNKNOWN" /end COMPU_VTAB
/begin MEASUREMENT MSDBW_test "DBW test status{MSDBW_test&0xff=0:Test Not Started}{MSDBW_test&0xff=1:Test Running}{MSDBW_test&0xff=2:Test Finished}{MSDBW_test&0xff=3:Condition 1 Not Met}{MSDBW_test&0xff=4:Condition 2 Not Met}{MSDBW_test&0xff=5:Condition 3 Not Met}{MSDBW_test&0xff=6:Con" UBYTE MSDBW_test_COMPU_VTAB 0 0 0 255 ECU_ADDRESS 0x01003310 BIT_MASK 0xff /end MEASUREMENT
/begin COMPU_METHOD MSDBW_test_COMPU_VTAB "Verbal Table" TAB_VERB "%.0" "list" COMPU_TAB_REF MSDBW_test_COMPU_VTAB_REF /end COMPU_METHOD
/begin COMPU_VTAB MSDBW_test_COMPU_VTAB_REF "Verbal Table" TAB_VERB 8 0 "Test Not Started" 1 "Test Running" 2 "Test Finished" 3 "Condition 1 Not Met" 4 "Condition 2 Not Met" 5 "Condition 3 Not Met" 6 "Condition 4 Not Met" 7 "Cannot Start Test" DEFAULT_VALUE "UNKNOWN" /end COMPU_VTAB
/begin MEASUREMENT MSmanual_ext_pwr "Manual external power test status{MSmanual_ext_pwr&0xff=0:Test Not Started}{MSmanual_ext_pwr&0xff=1:Test Running}{MSmanual_ext_pwr&0xff=2:Test Finished}{MSmanual_ext_pwr&0xff=3:Condition 1 Not Met}{MSmanual_ext_pwr&0xff=4:Condition 2 Not Met}{MSmanual_ext" UBYTE MSmanual_ext_pwr_COMPU_VTAB 0 0 0 255 ECU_ADDRESS 0x01003318 BIT_MASK 0xff /end MEASUREMENT
/begin COMPU_METHOD MSmanual_ext_pwr_COMPU_VTAB "Verbal Table" TAB_VERB "%.0" "list" COMPU_TAB_REF MSmanual_ext_pwr_COMPU_VTAB_REF /end COMPU_METHOD
/begin COMPU_VTAB MSmanual_ext_pwr_COMPU_VTAB_REF "Verbal Table" TAB_VERB 8 0 "Test Not Started" 1 "Test Running" 2 "Test Finished" 3 "Condition 1 Not Met" 4 "Condition 2 Not Met" 5 "Condition 3 Not Met" 6 "Condition 4 Not Met" 7 "Cannot Start Test" DEFAULT_VALUE "UNKNOWN" /end COMPU_VTAB
/begin MEASUREMENT TSTspk_fire "Spark firing test command{TSTspk_fire&0xff=0:Disabled}{TSTspk_fire&0xff=1:Coil 1}{TSTspk_fire&0xff=2:Coil 2}{TSTspk_fire&0xff=3:Coil 3}{TSTspk_fire&0xff=4:Coil 4}{TSTspk_fire&0xff=5:Coil 5}{TSTspk_fire&0xff=6:Coil 6}{TSTspk_fire&0xff=7:Coil 7}{TSTspk_fire" UBYTE TSTspk_fire_COMPU_VTAB 0 0 0 255 ECU_ADDRESS 0x01003370 BIT_MASK 0xff /end MEASUREMENT
/begin COMPU_METHOD TSTspk_fire_COMPU_VTAB "Verbal Table" TAB_VERB "%.0" "list" COMPU_TAB_REF TSTspk_fire_COMPU_VTAB_REF /end COMPU_METHOD
/begin COMPU_VTAB TSTspk_fire_COMPU_VTAB_REF "Verbal Table" TAB_VERB 11 0 "Disabled" 1 "Coil 1" 2 "Coil 2" 3 "Coil 3" 4 "Coil 4" 5 "Coil 5" 6 "Coil 6" 7 "Coil 7" 8 "Coil 8" 9 "Coil 9" 10 "Coil 10" DEFAULT_VALUE "UNKNOWN" /end COMPU_VTAB
/begin MEASUREMENT TSTinj_fire "Injector firing test command{TSTinj_fire&0xff=0:Disabled}{TSTinj_fire&0xff=1:Injector 1}{TSTinj_fire&0xff=2:Injector 2}{TSTinj_fire&0xff=3:Injector 3}{TSTinj_fire&0xff=4:Injector 4}{TSTinj_fire&0xff=5:Injector 5}{TSTinj_fire&0xff=6:Injector 6}{TSTinj_fire" UBYTE TSTinj_fire_COMPU_VTAB 0 0 0 255 ECU_ADDRESS 0x01003388 BIT_MASK 0xff /end MEASUREMENT
/begin COMPU_METHOD TSTinj_fire_COMPU_VTAB "Verbal Table" TAB_VERB "%.0" "list" COMPU_TAB_REF TSTinj_fire_COMPU_VTAB_REF /end COMPU_METHOD
/begin COMPU_VTAB TSTinj_fire_COMPU_VTAB_REF "Verbal Table" TAB_VERB 11 0 "Disabled" 1 "Injector 1" 2 "Injector 2" 3 "Injector 3" 4 "Injector 4" 5 "Injector 5" 6 "Injector 6" 7 "Injector 7" 8 "Injector 8" 9 "Injector 9" 10 "Injector 10" DEFAULT_VALUE "UNKNOWN" /end COMPU_VTAB
/begin MEASUREMENT KNK2_win_avg "KNK2 raw window average" UWORD Compu_KNK2_win_avg 0 0 0 63.9990234375 ECU_ADDRESS 0x010034C8 /end MEASUREMENT
/begin COMPU_METHOD Compu_KNK2_win_avg " " RAT_FUNC "%.3" "volts" COEFFS 0 1024 0 0 0 1 /end COMPU_METHOD
/begin CHARACTERISTIC FPPTPSnl2_FPP "Option2 non-linear FPP point" VALUE 0x0014787A /* @ECU_Address@FPPTPSnl2_FPP@0x01003B18@ */ ECIPP_ALIGNMENT_UWORD 100 Compu_FPPTPSnl2_FPP 0 99.9984741210938 /end CHARACTERISTIC
/begin COMPU_METHOD Compu_FPPTPSnl2_FPP " " RAT_FUNC "%.1" "%" COEFFS 0 655.36 0 0 0 1 /end COMPU_METHOD
/begin CHARACTERISTIC FPPTPSnl2_TPS "Option2 non-linear TPS point" VALUE 0x00147880 /* @ECU_Address@FPPTPSnl2_TPS@0x01003B20@ */ ECIPP_ALIGNMENT_UWORD 100 Compu_FPPTPSnl2_TPS 0 99.9984741210938 /end CHARACTERISTIC
/begin COMPU_METHOD Compu_FPPTPSnl2_TPS " " RAT_FUNC "%.1" "%" COEFFS 0 655.36 0 0 0 1 /end COMPU_METHOD
/begin CHARACTERISTIC FPPTPSnl3_FPP "Option3 non-linear FPP point" VALUE 0x0014787C /* @ECU_Address@FPPTPSnl3_FPP@0x01003B28@ */ ECIPP_ALIGNMENT_UWORD 100 Compu_FPPTPSnl3_FPP 0 99.9984741210938 /end CHARACTERISTIC
/begin COMPU_METHOD Compu_FPPTPSnl3_FPP " " RAT_FUNC "%.1" "%" COEFFS 0 655.36 0 0 0 1 /end COMPU_METHOD
/begin CHARACTERISTIC FPPTPSnl3_TPS "Option3 non-linear TPS point" VALUE 0x00147882 /* @ECU_Address@FPPTPSnl3_TPS@0x01003B30@ */ ECIPP_ALIGNMENT_UWORD 100 Compu_FPPTPSnl3_TPS 0 99.9984741210938 /end CHARACTERISTIC
/begin COMPU_METHOD Compu_FPPTPSnl3_TPS " " RAT_FUNC "%.1" "%" COEFFS 0 655.36 0 0 0 1 /end COMPU_METHOD
/begin CHARACTERISTIC load_est_type "Load estimation type{load_est_type&0xff=0:MAP based only}{load_est_type&0xff=1:MAP*VE - 1 iteration}{load_est_type&0xff=2:MAP*VE - 2 iterations}{load_est_type&0xff=3:MAP*VE - 3 iterations}{load_est_type&0xff=4:MAP*VE - 4 iterations}{load_est_type&0xff=5:M" VALUE 0x001481a5 /* @ECU_Address@load_est_type@0x01003BF8@ */ ECIPP_ALIGNMENT_UBYTE 255 load_est_type_COMPU_VTAB 0 255 BIT_MASK 0xff /end CHARACTERISTIC
/begin COMPU_METHOD load_est_type_COMPU_VTAB "Verbal Table" TAB_VERB "%.0" "list" COMPU_TAB_REF load_est_type_COMPU_VTAB_REF /end COMPU_METHOD
/begin COMPU_VTAB load_est_type_COMPU_VTAB_REF "Verbal Table" TAB_VERB 6 0 "MAP based only" 1 "MAP*VE - 1 iteration" 2 "MAP*VE - 2 iterations" 3 "MAP*VE - 3 iterations" 4 "MAP*VE - 4 iterations" 5 "MAP*VE - 5 iterations" DEFAULT_VALUE "UNKNOWN" /end COMPU_VTAB
/begin MEASUREMENT torque_Nm_max "Current estimated max torque" UWORD Compu_torque_Nm_max 0 0 0 16383.75 ECU_ADDRESS 0x01004508 /end MEASUREMENT
/begin COMPU_METHOD Compu_torque_Nm_max " " RAT_FUNC "%.1" "N-m" COEFFS 0 4 0 0 0 1 /end COMPU_METHOD
/begin MEASUREMENT AL_erase_req "Clear Adaptive Memory{AL_erase_req&0xff=0x00:Clear Adaptive}{AL_erase_req&0xff=0x01:Clearing...}" UBYTE AL_erase_req_COMPU_VTAB 0 0 0 255 ECU_ADDRESS 0x01004678 BIT_MASK 0xff /end MEASUREMENT
/begin COMPU_METHOD AL_erase_req_COMPU_VTAB "Verbal Table" TAB_VERB "%.0" "list" COMPU_TAB_REF AL_erase_req_COMPU_VTAB_REF /end COMPU_METHOD
/begin COMPU_VTAB AL_erase_req_COMPU_VTAB_REF "Verbal Table" TAB_VERB 2 0x00 "Clear Adaptive" 0x01 "Clearing..." DEFAULT_VALUE "UNKNOWN" /end COMPU_VTAB
/begin MEASUREMENT FPPTPSnl_cur "Currently active non-linear option{FPPTPSnl_cur&0xff=0:Option 1}{FPPTPSnl_cur&0xff=1:Option 2}{FPPTPSnl_cur&0xff=2:Option 3}{FPPTPSnl_cur&0xff=3:3-Point Table}{FPPTPSnl_cur&0xff=4:2D Table}{FPPTPSnl_cur&0xff=5:None}" UBYTE FPPTPSnl_cur_COMPU_VTAB 0 0 0 255 ECU_ADDRESS 0x01004B98 BIT_MASK 0xff /end MEASUREMENT
/begin COMPU_METHOD FPPTPSnl_cur_COMPU_VTAB "Verbal Table" TAB_VERB "%.0" "list" COMPU_TAB_REF FPPTPSnl_cur_COMPU_VTAB_REF /end COMPU_METHOD
/begin COMPU_VTAB FPPTPSnl_cur_COMPU_VTAB_REF "Verbal Table" TAB_VERB 6 0 "Option 1" 1 "Option 2" 2 "Option 3" 3 "3-Point Table" 4 "2D Table" 5 "None" DEFAULT_VALUE "UNKNOWN" /end COMPU_VTAB
/begin CHARACTERISTIC KNK_Ksel "Knock analog input gain selection{KNK_Ksel&0xff=0:Low Gain - Tuned Response}{KNK_Ksel&0xff=1:High Gain - Flat Response}" VALUE 0x0014391c /* @ECU_Address@KNK_Ksel@0x01004F70@ */ ECIPP_ALIGNMENT_UBYTE 255 KNK_Ksel_COMPU_VTAB 0 255 BIT_MASK 0xff /end CHARACTERISTIC
/begin COMPU_METHOD KNK_Ksel_COMPU_VTAB "Verbal Table" TAB_VERB "%.0" "list" COMPU_TAB_REF KNK_Ksel_COMPU_VTAB_REF /end COMPU_METHOD
/begin COMPU_VTAB KNK_Ksel_COMPU_VTAB_REF "Verbal Table" TAB_VERB 2 0 "Low Gain - Tuned Response" 1 "High Gain - Flat Response" DEFAULT_VALUE "UNKNOWN" /end COMPU_VTAB
/begin CHARACTERISTIC KNK_sens_cyl9 "Knock sensor assignment 9{KNK_sens_cyl9&0xff=0:Disabled}{KNK_sens_cyl9&0xff=1:Sensor 1}{KNK_sens_cyl9&0xff=2:Sensor 2}{KNK_sens_cyl9&0xff=3:Sensor 3}" VALUE 0x00143931 /* @ECU_Address@KNK_sens_cyl9@0x01004F88@ */ ECIPP_ALIGNMENT_UBYTE 255 KNK_sens_cyl9_COMPU_VTAB 0 255 BIT_MASK 0xff /end CHARACTERISTIC
/begin COMPU_METHOD KNK_sens_cyl9_COMPU_VTAB "Verbal Table" TAB_VERB "%.0" "list" COMPU_TAB_REF KNK_sens_cyl9_COMPU_VTAB_REF /end COMPU_METHOD
/begin COMPU_VTAB KNK_sens_cyl9_COMPU_VTAB_REF "Verbal Table" TAB_VERB 4 0 "Disabled" 1 "Sensor 1" 2 "Sensor 2" 3 "Sensor 3" DEFAULT_VALUE "UNKNOWN" /end COMPU_VTAB
/begin CHARACTERISTIC KNK_sens_cyl10 "Knock sensor assignment 10{KNK_sens_cyl10&0xff=0:Disabled}{KNK_sens_cyl10&0xff=1:Sensor 1}{KNK_sens_cyl10&0xff=2:Sensor 2}{KNK_sens_cyl10&0xff=3:Sensor 3}" VALUE 0x00143932 /* @ECU_Address@KNK_sens_cyl10@0x01004F90@ */ ECIPP_ALIGNMENT_UBYTE 255 KNK_sens_cyl10_COMPU_VTAB 0 255 BIT_MASK 0xff /end CHARACTERISTIC
/begin COMPU_METHOD KNK_sens_cyl10_COMPU_VTAB "Verbal Table" TAB_VERB "%.0" "list" COMPU_TAB_REF KNK_sens_cyl10_COMPU_VTAB_REF /end COMPU_METHOD
/begin COMPU_VTAB KNK_sens_cyl10_COMPU_VTAB_REF "Verbal Table" TAB_VERB 4 0 "Disabled" 1 "Sensor 1" 2 "Sensor 2" 3 "Sensor 3" DEFAULT_VALUE "UNKNOWN" /end COMPU_VTAB
/begin MEASUREMENT TransCrk_dis "Trans in-gear override active" UBYTE Compu_TransCrk_dis 0 0 0 255 ECU_ADDRESS 0x01005E68 /end MEASUREMENT
/begin COMPU_METHOD Compu_TransCrk_dis " " RAT_FUNC "%.0" "-" COEFFS 0 1 0 0 0 1 /end COMPU_METHOD
/begin CHARACTERISTIC torque_select "J1939 engine torque broadcast{torque_select&0xff=0:Engine Load}{torque_select&0xff=1:Torque Percent}" VALUE 0x001481c1 /* @ECU_Address@torque_select@0x01006748@ */ ECIPP_ALIGNMENT_UBYTE 255 torque_select_COMPU_VTAB 0 255 BIT_MASK 0xff /end CHARACTERISTIC
/begin COMPU_METHOD torque_select_COMPU_VTAB "Verbal Table" TAB_VERB "%.0" "list" COMPU_TAB_REF torque_select_COMPU_VTAB_REF /end COMPU_METHOD
/begin COMPU_VTAB torque_select_COMPU_VTAB_REF "Verbal Table" TAB_VERB 2 0 "Engine Load" 1 "Torque Percent" DEFAULT_VALUE "UNKNOWN" /end COMPU_VTAB
/begin MEASUREMENT torque_driver "Driver Demand Torque" UWORD Compu_torque_driver 0 0 0 99.9984741210938 ECU_ADDRESS 0x01006758 /end MEASUREMENT
/begin COMPU_METHOD Compu_torque_driver " " RAT_FUNC "%.1" "%" COEFFS 0 655.36 0 0 0 1 /end COMPU_METHOD
/begin MEASUREMENT torque_pct_max "Max Indicated / Ref Torque" UWORD Compu_torque_pct_max 0 0 0 99.9984741210938 ECU_ADDRESS 0x01006760 /end MEASUREMENT
/begin COMPU_METHOD Compu_torque_pct_max " " RAT_FUNC "%.1" "%" COEFFS 0 655.36 0 0 0 1 /end COMPU_METHOD
/begin MEASUREMENT torque_pct_gross "Actual Engine Pct Torque" UWORD Compu_torque_pct_gross 0 0 0 99.9984741210938 ECU_ADDRESS 0x01006768 /end MEASUREMENT
/begin COMPU_METHOD Compu_torque_pct_gross " " RAT_FUNC "%.1" "%" COEFFS 0 655.36 0 0 0 1 /end COMPU_METHOD
/begin MEASUREMENT torque_pct_fric "Friction + parasitic losses torque" UWORD Compu_torque_pct_fric 0 0 0 99.9984741210938 ECU_ADDRESS 0x01006770 /end MEASUREMENT
/begin COMPU_METHOD Compu_torque_pct_fric " " RAT_FUNC "%.1" "%" COEFFS 0 655.36 0 0 0 1 /end COMPU_METHOD
/begin MEASUREMENT coil1_adv_mod "Coil1 advance modifier" SWORD Compu_coil1_adv_mod 0 0 -2048 2047.9375 ECU_ADDRESS 0x01006B38 /end MEASUREMENT
/begin COMPU_METHOD Compu_coil1_adv_mod " " RAT_FUNC "%.1" "CAD BTDC" COEFFS 0 16 0 0 0 1 /end COMPU_METHOD
/begin MEASUREMENT coil2_adv_mod "Coil2 advance modifier" SWORD Compu_coil2_adv_mod 0 0 -2048 2047.9375 ECU_ADDRESS 0x01006B40 /end MEASUREMENT
/begin COMPU_METHOD Compu_coil2_adv_mod " " RAT_FUNC "%.1" "CAD BTDC" COEFFS 0 16 0 0 0 1 /end COMPU_METHOD
/begin MEASUREMENT coil3_adv_mod "Coil3 advance modifier" SWORD Compu_coil3_adv_mod 0 0 -2048 2047.9375 ECU_ADDRESS 0x01006B48 /end MEASUREMENT
/begin COMPU_METHOD Compu_coil3_adv_mod " " RAT_FUNC "%.1" "CAD BTDC" COEFFS 0 16 0 0 0 1 /end COMPU_METHOD
/begin MEASUREMENT coil4_adv_mod "Coil4 advance modifier" SWORD Compu_coil4_adv_mod 0 0 -2048 2047.9375 ECU_ADDRESS 0x01006B50 /end MEASUREMENT
/begin COMPU_METHOD Compu_coil4_adv_mod " " RAT_FUNC "%.1" "CAD BTDC" COEFFS 0 16 0 0 0 1 /end COMPU_METHOD
/begin MEASUREMENT coil5_adv_mod "Coil5 advance modifier" SWORD Compu_coil5_adv_mod 0 0 -2048 2047.9375 ECU_ADDRESS 0x01006B58 /end MEASUREMENT
/begin COMPU_METHOD Compu_coil5_adv_mod " " RAT_FUNC "%.1" "CAD BTDC" COEFFS 0 16 0 0 0 1 /end COMPU_METHOD
/begin MEASUREMENT coil6_adv_mod "Coil6 advance modifier" SWORD Compu_coil6_adv_mod 0 0 -2048 2047.9375 ECU_ADDRESS 0x01006B60 /end MEASUREMENT
/begin COMPU_METHOD Compu_coil6_adv_mod " " RAT_FUNC "%.1" "CAD BTDC" COEFFS 0 16 0 0 0 1 /end COMPU_METHOD
/begin MEASUREMENT coil7_adv_mod "Coil7 advance modifier" SWORD Compu_coil7_adv_mod 0 0 -2048 2047.9375 ECU_ADDRESS 0x01006B68 /end MEASUREMENT
/begin COMPU_METHOD Compu_coil7_adv_mod " " RAT_FUNC "%.1" "CAD BTDC" COEFFS 0 16 0 0 0 1 /end COMPU_METHOD
/begin MEASUREMENT coil8_adv_mod "Coil8 advance modifier" SWORD Compu_coil8_adv_mod 0 0 -2048 2047.9375 ECU_ADDRESS 0x01006B70 /end MEASUREMENT
/begin COMPU_METHOD Compu_coil8_adv_mod " " RAT_FUNC "%.1" "CAD BTDC" COEFFS 0 16 0 0 0 1 /end COMPU_METHOD
/begin MEASUREMENT coil9_adv_mod "Coil9 advance modifier" SWORD Compu_coil9_adv_mod 0 0 -2048 2047.9375 ECU_ADDRESS 0x01006B78 /end MEASUREMENT
/begin COMPU_METHOD Compu_coil9_adv_mod " " RAT_FUNC "%.1" "CAD BTDC" COEFFS 0 16 0 0 0 1 /end COMPU_METHOD
/begin MEASUREMENT coil10_adv_mod "Coil10 advance modifier" SWORD Compu_coil10_adv_mod 0 0 -2048 2047.9375 ECU_ADDRESS 0x01006B80 /end MEASUREMENT
/begin COMPU_METHOD Compu_coil10_adv_mod " " RAT_FUNC "%.1" "CAD BTDC" COEFFS 0 16 0 0 0 1 /end COMPU_METHOD
/begin MEASUREMENT drivebrake_torq_pct "Drivebrake torque pct" SWORD Compu_drivebrake_torq_pct 0 0 -200 199.993896484375 ECU_ADDRESS 0x010075E0 /end MEASUREMENT
/begin COMPU_METHOD Compu_drivebrake_torq_pct " " RAT_FUNC "%.1" "%" COEFFS 0 163.84 0 0 0 1 /end COMPU_METHOD
/begin MEASUREMENT exhbrake_torq_pct "Exhbrake torque pct" SWORD Compu_exhbrake_torq_pct 0 0 -200 199.993896484375 ECU_ADDRESS 0x010075E8 /end MEASUREMENT
/begin COMPU_METHOD Compu_exhbrake_torq_pct " " RAT_FUNC "%.1" "%" COEFFS 0 163.84 0 0 0 1 /end COMPU_METHOD
/begin MEASUREMENT drivebrake_torq_max "Drivebrake torque max" SWORD Compu_drivebrake_torq_max 0 0 -200 199.993896484375 ECU_ADDRESS 0x010075F0 /end MEASUREMENT
/begin COMPU_METHOD Compu_drivebrake_torq_max " " RAT_FUNC "%.1" "%" COEFFS 0 163.84 0 0 0 1 /end COMPU_METHOD
/begin MEASUREMENT exhbrake_torq_max "Exhbrake torque max" SWORD Compu_exhbrake_torq_max 0 0 -200 199.993896484375 ECU_ADDRESS 0x010075F8 /end MEASUREMENT
/begin COMPU_METHOD Compu_exhbrake_torq_max " " RAT_FUNC "%.1" "%" COEFFS 0 163.84 0 0 0 1 /end COMPU_METHOD
/begin MEASUREMENT eng_torque_mode "Engine torque mode{eng_torque_mode&0xff=0:None}{eng_torque_mode&0xff=1:FPP}{eng_torque_mode&0xff=2:Cruise control}{eng_torque_mode&0xff=3:Power takeoff}{eng_torque_mode&0xff=4:Roadspeed limit}{eng_torque_mode&0xff=5:ASR control}{eng_torque_mode&0xff=6:Tra" UBYTE eng_torque_mode_COMPU_VTAB 0 0 0 255 ECU_ADDRESS 0x01007640 BIT_MASK 0xff /end MEASUREMENT
/begin COMPU_METHOD eng_torque_mode_COMPU_VTAB "Verbal Table" TAB_VERB "%.0" "list" COMPU_TAB_REF eng_torque_mode_COMPU_VTAB_REF /end COMPU_METHOD
/begin COMPU_VTAB eng_torque_mode_COMPU_VTAB_REF "Verbal Table" TAB_VERB 16 0 "None" 1 "FPP" 2 "Cruise control" 3 "Power takeoff" 4 "Roadspeed limit" 5 "ASR control" 6 "Transmission" 7 "ABS control" 8 "Torque limit" 9 "Max governor" 10 "Electronic brakes" 11 "Remote FPP" 12 "Service procedure" 13 "UNDEFINED" 14 "Other" 15 "Not Available" DEFAULT_VALUE "UNKNOWN" /end COMPU_VTAB
/begin CHARACTERISTIC OCT_init_table "Cold power-up default octane mode{OCT_init_table&0xff=0:Single Point}{OCT_init_table&0xff=1:Table Based}" VALUE 0x0014393f /* @ECU_Address@OCT_init_table@0x01008558@ */ ECIPP_ALIGNMENT_UBYTE 255 OCT_init_table_COMPU_VTAB 0 255 BIT_MASK 0xff /end CHARACTERISTIC
/begin COMPU_METHOD OCT_init_table_COMPU_VTAB "Verbal Table" TAB_VERB "%.0" "list" COMPU_TAB_REF OCT_init_table_COMPU_VTAB_REF /end COMPU_METHOD
/begin COMPU_VTAB OCT_init_table_COMPU_VTAB_REF "Verbal Table" TAB_VERB 2 0 "Single Point" 1 "Table Based" DEFAULT_VALUE "UNKNOWN" /end COMPU_VTAB
/begin MEASUREMENT FPP_cmd_pstslew "FPP_cmd_pstslew" UWORD Compu_FPP_cmd_pstslew 0 0 0 99.9984741210938 ECU_ADDRESS 0x01008AC8 /end MEASUREMENT
/begin COMPU_METHOD Compu_FPP_cmd_pstslew " " RAT_FUNC "%.1" "%" COEFFS 0 655.36 0 0 0 1 /end COMPU_METHOD
/begin MEASUREMENT torque_pct_eng_dmd "Engine demand" UWORD Compu_torque_pct_eng_dmd 0 0 0 99.9984741210938 ECU_ADDRESS 0x0100C228 /end MEASUREMENT
/begin COMPU_METHOD Compu_torque_pct_eng_dmd " " RAT_FUNC "%.1" "%" COEFFS 0 655.36 0 0 0 1 /end COMPU_METHOD
/begin CHARACTERISTIC fric_cold_ena "Cold Friction{fric_cold_ena&0xff=0:Disabled}{fric_cold_ena&0xff=1:ECT}{fric_cold_ena&0xff=2:OILT}" VALUE 0x00148176 /* @ECU_Address@fric_cold_ena@0x0100C248@ */ ECIPP_ALIGNMENT_UBYTE 255 fric_cold_ena_COMPU_VTAB 0 255 BIT_MASK 0xff /end CHARACTERISTIC
/begin COMPU_METHOD fric_cold_ena_COMPU_VTAB "Verbal Table" TAB_VERB "%.0" "list" COMPU_TAB_REF fric_cold_ena_COMPU_VTAB_REF /end COMPU_METHOD
/begin COMPU_VTAB fric_cold_ena_COMPU_VTAB_REF "Verbal Table" TAB_VERB 3 0 "Disabled" 1 "ECT" 2 "OILT" DEFAULT_VALUE "UNKNOWN" /end COMPU_VTAB
/begin CHARACTERISTIC fric_cold_T "Cold Friction trigger" VALUE 0x00147b04 /* @ECU_Address@fric_cold_T@0x0100C250@ */ ECIPP_ALIGNMENT_UWORD 564 Compu_fric_cold_T -460 563.984375 /end CHARACTERISTIC
/begin COMPU_METHOD Compu_fric_cold_T " " RAT_FUNC "%.1" "deg F" COEFFS 0 64 29440 0 0 1 /end COMPU_METHOD
/begin CHARACTERISTIC fric_hot_T "Hot Friction trigger" VALUE 0x00147b06 /* @ECU_Address@fric_hot_T@0x0100C258@ */ ECIPP_ALIGNMENT_UWORD 564 Compu_fric_hot_T -460 563.984375 /end CHARACTERISTIC
/begin COMPU_METHOD Compu_fric_hot_T " " RAT_FUNC "%.1" "deg F" COEFFS 0 64 29440 0 0 1 /end COMPU_METHOD
/begin MEASUREMENT torque_tbl_fric "Friction torque" UWORD Compu_torque_tbl_fric 0 0 0 16383.75 ECU_ADDRESS 0x0100C260 /end MEASUREMENT
/begin COMPU_METHOD Compu_torque_tbl_fric " " RAT_FUNC "%.1" "N-m" COEFFS 0 4 0 0 0 1 /end COMPU_METHOD
/begin CHARACTERISTIC J1939_torque_pct_tbl "J1939 actual engine torque{J1939_torque_pct_tbl&0xff=0:Governor Tables}{J1939_torque_pct_tbl&0xff=1:J1939 Torque Tables, Net %}{J1939_torque_pct_tbl&0xff=2:J1939 Torque Tables, Net %, BP Crct}{J1939_torque_pct_tbl&0xff=3:J1939 Torque Tables, Indicated %}{" VALUE 0x00147dfa /* @ECU_Address@J1939_torque_pct_tbl@0x0100D8A0@ */ ECIPP_ALIGNMENT_UBYTE 255 J1939_torque_pct_tbl_COMPU_VTAB 0 255 BIT_MASK 0xff /end CHARACTERISTIC
/begin COMPU_METHOD J1939_torque_pct_tbl_COMPU_VTAB "Verbal Table" TAB_VERB "%.0" "list" COMPU_TAB_REF J1939_torque_pct_tbl_COMPU_VTAB_REF /end COMPU_METHOD
/begin COMPU_VTAB J1939_torque_pct_tbl_COMPU_VTAB_REF "Verbal Table" TAB_VERB 5 0 "Governor Tables" 1 "J1939 Torque Tables, Net %" 2 "J1939 Torque Tables, Net %, BP Crct" 3 "J1939 Torque Tables, Indicated %" 4 "J1939 Torque Tables, Ind. %, BP Crct" DEFAULT_VALUE "UNKNOWN" /end COMPU_VTAB
/begin MEASUREMENT torque_parasitic "Parasitic losses torque" UWORD Compu_torque_parasitic 0 0 0 16383.75 ECU_ADDRESS 0x0100DAF0 /end MEASUREMENT
/begin COMPU_METHOD Compu_torque_parasitic " " RAT_FUNC "%.1" "N-m" COEFFS 0 4 0 0 0 1 /end COMPU_METHOD
/begin CHARACTERISTIC KNK_mult_cyl1 "Knock signal multiplier 1{KNK_mult_cyl1&0xff=0:Standard}{KNK_mult_cyl1&0xff=1:Alternate A}{KNK_mult_cyl1&0xff=2:Alternate B}" VALUE 0x0014391F /* @ECU_Address@KNK_mult_cyl1@0x0100DB40@ */ ECIPP_ALIGNMENT_UBYTE 255 KNK_mult_cyl1_COMPU_VTAB 0 255 BIT_MASK 0xff /end CHARACTERISTIC
/begin COMPU_METHOD KNK_mult_cyl1_COMPU_VTAB "Verbal Table" TAB_VERB "%.0" "list" COMPU_TAB_REF KNK_mult_cyl1_COMPU_VTAB_REF /end COMPU_METHOD
/begin COMPU_VTAB KNK_mult_cyl1_COMPU_VTAB_REF "Verbal Table" TAB_VERB 3 0 "Standard" 1 "Alternate A" 2 "Alternate B" DEFAULT_VALUE "UNKNOWN" /end COMPU_VTAB
/begin CHARACTERISTIC KNK_mult_cyl2 "Knock signal multiplier 2{KNK_mult_cyl2&0xff=0:Standard}{KNK_mult_cyl2&0xff=1:Alternate A}{KNK_mult_cyl2&0xff=2:Alternate B}" VALUE 0x00143920 /* @ECU_Address@KNK_mult_cyl2@0x0100DB48@ */ ECIPP_ALIGNMENT_UBYTE 255 KNK_mult_cyl2_COMPU_VTAB 0 255 BIT_MASK 0xff /end CHARACTERISTIC
/begin COMPU_METHOD KNK_mult_cyl2_COMPU_VTAB "Verbal Table" TAB_VERB "%.0" "list" COMPU_TAB_REF KNK_mult_cyl2_COMPU_VTAB_REF /end COMPU_METHOD
/begin COMPU_VTAB KNK_mult_cyl2_COMPU_VTAB_REF "Verbal Table" TAB_VERB 3 0 "Standard" 1 "Alternate A" 2 "Alternate B" DEFAULT_VALUE "UNKNOWN" /end COMPU_VTAB
/begin CHARACTERISTIC KNK_mult_cyl3 "Knock signal multiplier 3{KNK_mult_cyl3&0xff=0:Standard}{KNK_mult_cyl3&0xff=1:Alternate A}{KNK_mult_cyl3&0xff=2:Alternate B}" VALUE 0x00143921 /* @ECU_Address@KNK_mult_cyl3@0x0100DB50@ */ ECIPP_ALIGNMENT_UBYTE 255 KNK_mult_cyl3_COMPU_VTAB 0 255 BIT_MASK 0xff /end CHARACTERISTIC
/begin COMPU_METHOD KNK_mult_cyl3_COMPU_VTAB "Verbal Table" TAB_VERB "%.0" "list" COMPU_TAB_REF KNK_mult_cyl3_COMPU_VTAB_REF /end COMPU_METHOD
/begin COMPU_VTAB KNK_mult_cyl3_COMPU_VTAB_REF "Verbal Table" TAB_VERB 3 0 "Standard" 1 "Alternate A" 2 "Alternate B" DEFAULT_VALUE "UNKNOWN" /end COMPU_VTAB
/begin CHARACTERISTIC KNK_mult_cyl4 "Knock signal multiplier 4{KNK_mult_cyl4&0xff=0:Standard}{KNK_mult_cyl4&0xff=1:Alternate A}{KNK_mult_cyl4&0xff=2:Alternate B}" VALUE 0x00143922 /* @ECU_Address@KNK_mult_cyl4@0x0100DB58@ */ ECIPP_ALIGNMENT_UBYTE 255 KNK_mult_cyl4_COMPU_VTAB 0 255 BIT_MASK 0xff /end CHARACTERISTIC
/begin COMPU_METHOD KNK_mult_cyl4_COMPU_VTAB "Verbal Table" TAB_VERB "%.0" "list" COMPU_TAB_REF KNK_mult_cyl4_COMPU_VTAB_REF /end COMPU_METHOD
/begin COMPU_VTAB KNK_mult_cyl4_COMPU_VTAB_REF "Verbal Table" TAB_VERB 3 0 "Standard" 1 "Alternate A" 2 "Alternate B" DEFAULT_VALUE "UNKNOWN" /end COMPU_VTAB
/begin CHARACTERISTIC KNK_mult_cyl5 "Knock signal multiplier 5{KNK_mult_cyl5&0xff=0:Standard}{KNK_mult_cyl5&0xff=1:Alternate A}{KNK_mult_cyl5&0xff=2:Alternate B}" VALUE 0x00143923 /* @ECU_Address@KNK_mult_cyl5@0x0100DB60@ */ ECIPP_ALIGNMENT_UBYTE 255 KNK_mult_cyl5_COMPU_VTAB 0 255 BIT_MASK 0xff /end CHARACTERISTIC
/begin COMPU_METHOD KNK_mult_cyl5_COMPU_VTAB "Verbal Table" TAB_VERB "%.0" "list" COMPU_TAB_REF KNK_mult_cyl5_COMPU_VTAB_REF /end COMPU_METHOD
/begin COMPU_VTAB KNK_mult_cyl5_COMPU_VTAB_REF "Verbal Table" TAB_VERB 3 0 "Standard" 1 "Alternate A" 2 "Alternate B" DEFAULT_VALUE "UNKNOWN" /end COMPU_VTAB
/begin CHARACTERISTIC KNK_mult_cyl6 "Knock signal multiplier 6{KNK_mult_cyl6&0xff=0:Standard}{KNK_mult_cyl6&0xff=1:Alternate A}{KNK_mult_cyl6&0xff=2:Alternate B}" VALUE 0x00143924 /* @ECU_Address@KNK_mult_cyl6@0x0100DB68@ */ ECIPP_ALIGNMENT_UBYTE 255 KNK_mult_cyl6_COMPU_VTAB 0 255 BIT_MASK 0xff /end CHARACTERISTIC
/begin COMPU_METHOD KNK_mult_cyl6_COMPU_VTAB "Verbal Table" TAB_VERB "%.0" "list" COMPU_TAB_REF KNK_mult_cyl6_COMPU_VTAB_REF /end COMPU_METHOD
/begin COMPU_VTAB KNK_mult_cyl6_COMPU_VTAB_REF "Verbal Table" TAB_VERB 3 0 "Standard" 1 "Alternate A" 2 "Alternate B" DEFAULT_VALUE "UNKNOWN" /end COMPU_VTAB
/begin CHARACTERISTIC KNK_mult_cyl7 "Knock signal multiplier 7{KNK_mult_cyl7&0xff=0:Standard}{KNK_mult_cyl7&0xff=1:Alternate A}{KNK_mult_cyl7&0xff=2:Alternate B}" VALUE 0x00143925 /* @ECU_Address@KNK_mult_cyl7@0x0100DB70@ */ ECIPP_ALIGNMENT_UBYTE 255 KNK_mult_cyl7_COMPU_VTAB 0 255 BIT_MASK 0xff /end CHARACTERISTIC
/begin COMPU_METHOD KNK_mult_cyl7_COMPU_VTAB "Verbal Table" TAB_VERB "%.0" "list" COMPU_TAB_REF KNK_mult_cyl7_COMPU_VTAB_REF /end COMPU_METHOD
/begin COMPU_VTAB KNK_mult_cyl7_COMPU_VTAB_REF "Verbal Table" TAB_VERB 3 0 "Standard" 1 "Alternate A" 2 "Alternate B" DEFAULT_VALUE "UNKNOWN" /end COMPU_VTAB
/begin CHARACTERISTIC KNK_mult_cyl8 "Knock signal multiplier 8{KNK_mult_cyl8&0xff=0:Standard}{KNK_mult_cyl8&0xff=1:Alternate A}{KNK_mult_cyl8&0xff=2:Alternate B}" VALUE 0x00143926 /* @ECU_Address@KNK_mult_cyl8@0x0100DB78@ */ ECIPP_ALIGNMENT_UBYTE 255 KNK_mult_cyl8_COMPU_VTAB 0 255 BIT_MASK 0xff /end CHARACTERISTIC
/begin COMPU_METHOD KNK_mult_cyl8_COMPU_VTAB "Verbal Table" TAB_VERB "%.0" "list" COMPU_TAB_REF KNK_mult_cyl8_COMPU_VTAB_REF /end COMPU_METHOD
/begin COMPU_VTAB KNK_mult_cyl8_COMPU_VTAB_REF "Verbal Table" TAB_VERB 3 0 "Standard" 1 "Alternate A" 2 "Alternate B" DEFAULT_VALUE "UNKNOWN" /end COMPU_VTAB
/begin CHARACTERISTIC KNK_mult_cyl9 "Knock signal multiplier 9{KNK_mult_cyl9&0xff=0:Standard}{KNK_mult_cyl9&0xff=1:Alternate A}{KNK_mult_cyl9&0xff=2:Alternate B}" VALUE 0x00143927 /* @ECU_Address@KNK_mult_cyl9@0x0100DB80@ */ ECIPP_ALIGNMENT_UBYTE 255 KNK_mult_cyl9_COMPU_VTAB 0 255 BIT_MASK 0xff /end CHARACTERISTIC
/begin COMPU_METHOD KNK_mult_cyl9_COMPU_VTAB "Verbal Table" TAB_VERB "%.0" "list" COMPU_TAB_REF KNK_mult_cyl9_COMPU_VTAB_REF /end COMPU_METHOD
/begin COMPU_VTAB KNK_mult_cyl9_COMPU_VTAB_REF "Verbal Table" TAB_VERB 3 0 "Standard" 1 "Alternate A" 2 "Alternate B" DEFAULT_VALUE "UNKNOWN" /end COMPU_VTAB
/begin CHARACTERISTIC KNK_mult_cyl10 "Knock signal multiplier 10{KNK_mult_cyl10&0xff=0:Standard}{KNK_mult_cyl10&0xff=1:Alternate A}{KNK_mult_cyl10&0xff=2:Alternate B}" VALUE 0x00143928 /* @ECU_Address@KNK_mult_cyl10@0x0100DB88@ */ ECIPP_ALIGNMENT_UBYTE 255 KNK_mult_cyl10_COMPU_VTAB 0 255 BIT_MASK 0xff /end CHARACTERISTIC
/begin COMPU_METHOD KNK_mult_cyl10_COMPU_VTAB "Verbal Table" TAB_VERB "%.0" "list" COMPU_TAB_REF KNK_mult_cyl10_COMPU_VTAB_REF /end COMPU_METHOD
/begin COMPU_VTAB KNK_mult_cyl10_COMPU_VTAB_REF "Verbal Table" TAB_VERB 3 0 "Standard" 1 "Alternate A" 2 "Alternate B" DEFAULT_VALUE "UNKNOWN" /end COMPU_VTAB
/begin CHARACTERISTIC KNK_tbl_cyl1 "Knock table select 1{KNK_tbl_cyl1&0xff=0:Standard}{KNK_tbl_cyl1&0xff=1:Alternate A}{KNK_tbl_cyl1&0xff=2:Alternate B}" VALUE 0x00143933 /* @ECU_Address@KNK_tbl_cyl1@0x0100DB90@ */ ECIPP_ALIGNMENT_UBYTE 255 KNK_tbl_cyl1_COMPU_VTAB 0 255 BIT_MASK 0xff /end CHARACTERISTIC
/begin COMPU_METHOD KNK_tbl_cyl1_COMPU_VTAB "Verbal Table" TAB_VERB "%.0" "list" COMPU_TAB_REF KNK_tbl_cyl1_COMPU_VTAB_REF /end COMPU_METHOD
/begin COMPU_VTAB KNK_tbl_cyl1_COMPU_VTAB_REF "Verbal Table" TAB_VERB 3 0 "Standard" 1 "Alternate A" 2 "Alternate B" DEFAULT_VALUE "UNKNOWN" /end COMPU_VTAB
/begin CHARACTERISTIC KNK_tbl_cyl2 "Knock table select 2{KNK_tbl_cyl2&0xff=0:Standard}{KNK_tbl_cyl2&0xff=1:Alternate A}{KNK_tbl_cyl2&0xff=2:Alternate B}" VALUE 0x00143934 /* @ECU_Address@KNK_tbl_cyl2@0x0100DB98@ */ ECIPP_ALIGNMENT_UBYTE 255 KNK_tbl_cyl2_COMPU_VTAB 0 255 BIT_MASK 0xff /end CHARACTERISTIC
/begin COMPU_METHOD KNK_tbl_cyl2_COMPU_VTAB "Verbal Table" TAB_VERB "%.0" "list" COMPU_TAB_REF KNK_tbl_cyl2_COMPU_VTAB_REF /end COMPU_METHOD
/begin COMPU_VTAB KNK_tbl_cyl2_COMPU_VTAB_REF "Verbal Table" TAB_VERB 3 0 "Standard" 1 "Alternate A" 2 "Alternate B" DEFAULT_VALUE "UNKNOWN" /end COMPU_VTAB
/begin CHARACTERISTIC KNK_tbl_cyl3 "Knock table select 3{KNK_tbl_cyl3&0xff=0:Standard}{KNK_tbl_cyl3&0xff=1:Alternate A}{KNK_tbl_cyl3&0xff=2:Alternate B}" VALUE 0x00143935 /* @ECU_Address@KNK_tbl_cyl3@0x0100DBA0@ */ ECIPP_ALIGNMENT_UBYTE 255 KNK_tbl_cyl3_COMPU_VTAB 0 255 BIT_MASK 0xff /end CHARACTERISTIC
/begin COMPU_METHOD KNK_tbl_cyl3_COMPU_VTAB "Verbal Table" TAB_VERB "%.0" "list" COMPU_TAB_REF KNK_tbl_cyl3_COMPU_VTAB_REF /end COMPU_METHOD
/begin COMPU_VTAB KNK_tbl_cyl3_COMPU_VTAB_REF "Verbal Table" TAB_VERB 3 0 "Standard" 1 "Alternate A" 2 "Alternate B" DEFAULT_VALUE "UNKNOWN" /end COMPU_VTAB
/begin CHARACTERISTIC KNK_tbl_cyl4 "Knock table select 4{KNK_tbl_cyl4&0xff=0:Standard}{KNK_tbl_cyl4&0xff=1:Alternate A}{KNK_tbl_cyl4&0xff=2:Alternate B}" VALUE 0x00143936 /* @ECU_Address@KNK_tbl_cyl4@0x0100DBA8@ */ ECIPP_ALIGNMENT_UBYTE 255 KNK_tbl_cyl4_COMPU_VTAB 0 255 BIT_MASK 0xff /end CHARACTERISTIC
/begin COMPU_METHOD KNK_tbl_cyl4_COMPU_VTAB "Verbal Table" TAB_VERB "%.0" "list" COMPU_TAB_REF KNK_tbl_cyl4_COMPU_VTAB_REF /end COMPU_METHOD
/begin COMPU_VTAB KNK_tbl_cyl4_COMPU_VTAB_REF "Verbal Table" TAB_VERB 3 0 "Standard" 1 "Alternate A" 2 "Alternate B" DEFAULT_VALUE "UNKNOWN" /end COMPU_VTAB
/begin CHARACTERISTIC KNK_tbl_cyl5 "Knock table select 5{KNK_tbl_cyl5&0xff=0:Standard}{KNK_tbl_cyl5&0xff=1:Alternate A}{KNK_tbl_cyl5&0xff=2:Alternate B}" VALUE 0x00143937 /* @ECU_Address@KNK_tbl_cyl5@0x0100DBB0@ */ ECIPP_ALIGNMENT_UBYTE 255 KNK_tbl_cyl5_COMPU_VTAB 0 255 BIT_MASK 0xff /end CHARACTERISTIC
/begin COMPU_METHOD KNK_tbl_cyl5_COMPU_VTAB "Verbal Table" TAB_VERB "%.0" "list" COMPU_TAB_REF KNK_tbl_cyl5_COMPU_VTAB_REF /end COMPU_METHOD
/begin COMPU_VTAB KNK_tbl_cyl5_COMPU_VTAB_REF "Verbal Table" TAB_VERB 3 0 "Standard" 1 "Alternate A" 2 "Alternate B" DEFAULT_VALUE "UNKNOWN" /end COMPU_VTAB
/begin CHARACTERISTIC KNK_tbl_cyl6 "Knock table select 6{KNK_tbl_cyl6&0xff=0:Standard}{KNK_tbl_cyl6&0xff=1:Alternate A}{KNK_tbl_cyl6&0xff=2:Alternate B}" VALUE 0x00143938 /* @ECU_Address@KNK_tbl_cyl6@0x0100DBB8@ */ ECIPP_ALIGNMENT_UBYTE 255 KNK_tbl_cyl6_COMPU_VTAB 0 255 BIT_MASK 0xff /end CHARACTERISTIC
/begin COMPU_METHOD KNK_tbl_cyl6_COMPU_VTAB "Verbal Table" TAB_VERB "%.0" "list" COMPU_TAB_REF KNK_tbl_cyl6_COMPU_VTAB_REF /end COMPU_METHOD
/begin COMPU_VTAB KNK_tbl_cyl6_COMPU_VTAB_REF "Verbal Table" TAB_VERB 3 0 "Standard" 1 "Alternate A" 2 "Alternate B" DEFAULT_VALUE "UNKNOWN" /end COMPU_VTAB
/begin CHARACTERISTIC KNK_tbl_cyl7 "Knock table select 7{KNK_tbl_cyl7&0xff=0:Standard}{KNK_tbl_cyl7&0xff=1:Alternate A}{KNK_tbl_cyl7&0xff=2:Alternate B}" VALUE 0x00143939 /* @ECU_Address@KNK_tbl_cyl7@0x0100DBC0@ */ ECIPP_ALIGNMENT_UBYTE 255 KNK_tbl_cyl7_COMPU_VTAB 0 255 BIT_MASK 0xff /end CHARACTERISTIC
/begin COMPU_METHOD KNK_tbl_cyl7_COMPU_VTAB "Verbal Table" TAB_VERB "%.0" "list" COMPU_TAB_REF KNK_tbl_cyl7_COMPU_VTAB_REF /end COMPU_METHOD
/begin COMPU_VTAB KNK_tbl_cyl7_COMPU_VTAB_REF "Verbal Table" TAB_VERB 3 0 "Standard" 1 "Alternate A" 2 "Alternate B" DEFAULT_VALUE "UNKNOWN" /end COMPU_VTAB
/begin CHARACTERISTIC KNK_tbl_cyl8 "Knock table select 8{KNK_tbl_cyl8&0xff=0:Standard}{KNK_tbl_cyl8&0xff=1:Alternate A}{KNK_tbl_cyl8&0xff=2:Alternate B}" VALUE 0x0014393A /* @ECU_Address@KNK_tbl_cyl8@0x0100DBC8@ */ ECIPP_ALIGNMENT_UBYTE 255 KNK_tbl_cyl8_COMPU_VTAB 0 255 BIT_MASK 0xff /end CHARACTERISTIC
/begin COMPU_METHOD KNK_tbl_cyl8_COMPU_VTAB "Verbal Table" TAB_VERB "%.0" "list" COMPU_TAB_REF KNK_tbl_cyl8_COMPU_VTAB_REF /end COMPU_METHOD
/begin COMPU_VTAB KNK_tbl_cyl8_COMPU_VTAB_REF "Verbal Table" TAB_VERB 3 0 "Standard" 1 "Alternate A" 2 "Alternate B" DEFAULT_VALUE "UNKNOWN" /end COMPU_VTAB
/begin CHARACTERISTIC KNK_tbl_cyl9 "Knock table select 9{KNK_tbl_cyl9&0xff=0:Standard}{KNK_tbl_cyl9&0xff=1:Alternate A}{KNK_tbl_cyl9&0xff=2:Alternate B}" VALUE 0x0014393B /* @ECU_Address@KNK_tbl_cyl9@0x0100DBD0@ */ ECIPP_ALIGNMENT_UBYTE 255 KNK_tbl_cyl9_COMPU_VTAB 0 255 BIT_MASK 0xff /end CHARACTERISTIC
/begin COMPU_METHOD KNK_tbl_cyl9_COMPU_VTAB "Verbal Table" TAB_VERB "%.0" "list" COMPU_TAB_REF KNK_tbl_cyl9_COMPU_VTAB_REF /end COMPU_METHOD
/begin COMPU_VTAB KNK_tbl_cyl9_COMPU_VTAB_REF "Verbal Table" TAB_VERB 3 0 "Standard" 1 "Alternate A" 2 "Alternate B" DEFAULT_VALUE "UNKNOWN" /end COMPU_VTAB
/begin CHARACTERISTIC KNK_tbl_cyl10 "Knock table select 10{KNK_tbl_cyl10&0xff=0:Standard}{KNK_tbl_cyl10&0xff=1:Alternate A}{KNK_tbl_cyl10&0xff=2:Alternate B}" VALUE 0x0014393C /* @ECU_Address@KNK_tbl_cyl10@0x0100DBD8@ */ ECIPP_ALIGNMENT_UBYTE 255 KNK_tbl_cyl10_COMPU_VTAB 0 255 BIT_MASK 0xff /end CHARACTERISTIC
/begin COMPU_METHOD KNK_tbl_cyl10_COMPU_VTAB "Verbal Table" TAB_VERB "%.0" "list" COMPU_TAB_REF KNK_tbl_cyl10_COMPU_VTAB_REF /end COMPU_METHOD
/begin COMPU_VTAB KNK_tbl_cyl10_COMPU_VTAB_REF "Verbal Table" TAB_VERB 3 0 "Standard" 1 "Alternate A" 2 "Alternate B" DEFAULT_VALUE "UNKNOWN" /end COMPU_VTAB
/begin MEASUREMENT KNK_bg_cyl1 "Knock background cylinder 1" UWORD Compu_KNK_bg_cyl1 0 0 0 99.9984741210938 ECU_ADDRESS 0x0100DBE0 /end MEASUREMENT
/begin COMPU_METHOD Compu_KNK_bg_cyl1 " " RAT_FUNC "%.2" "% FS" COEFFS 0 655.36 0 0 0 1 /end COMPU_METHOD
/begin MEASUREMENT KNK_bg_cyl2 "Knock background cylinder 2" UWORD Compu_KNK_bg_cyl2 0 0 0 99.9984741210938 ECU_ADDRESS 0x0100DBE8 /end MEASUREMENT
/begin COMPU_METHOD Compu_KNK_bg_cyl2 " " RAT_FUNC "%.2" "% FS" COEFFS 0 655.36 0 0 0 1 /end COMPU_METHOD
/begin MEASUREMENT KNK_bg_cyl3 "Knock background cylinder 3" UWORD Compu_KNK_bg_cyl3 0 0 0 99.9984741210938 ECU_ADDRESS 0x0100DBF0 /end MEASUREMENT
/begin COMPU_METHOD Compu_KNK_bg_cyl3 " " RAT_FUNC "%.2" "% FS" COEFFS 0 655.36 0 0 0 1 /end COMPU_METHOD
/begin MEASUREMENT KNK_bg_cyl4 "Knock background cylinder 4" UWORD Compu_KNK_bg_cyl4 0 0 0 99.9984741210938 ECU_ADDRESS 0x0100DBF8 /end MEASUREMENT
/begin COMPU_METHOD Compu_KNK_bg_cyl4 " " RAT_FUNC "%.2" "% FS" COEFFS 0 655.36 0 0 0 1 /end COMPU_METHOD
/begin MEASUREMENT KNK_bg_cyl5 "Knock background cylinder 5" UWORD Compu_KNK_bg_cyl5 0 0 0 99.9984741210938 ECU_ADDRESS 0x0100DC00 /end MEASUREMENT
/begin COMPU_METHOD Compu_KNK_bg_cyl5 " " RAT_FUNC "%.2" "% FS" COEFFS 0 655.36 0 0 0 1 /end COMPU_METHOD
/begin MEASUREMENT KNK_bg_cyl6 "Knock background cylinder 6" UWORD Compu_KNK_bg_cyl6 0 0 0 99.9984741210938 ECU_ADDRESS 0x0100DC08 /end MEASUREMENT
/begin COMPU_METHOD Compu_KNK_bg_cyl6 " " RAT_FUNC "%.2" "% FS" COEFFS 0 655.36 0 0 0 1 /end COMPU_METHOD
/begin MEASUREMENT KNK_bg_cyl7 "Knock background cylinder 7" UWORD Compu_KNK_bg_cyl7 0 0 0 99.9984741210938 ECU_ADDRESS 0x0100DC10 /end MEASUREMENT
/begin COMPU_METHOD Compu_KNK_bg_cyl7 " " RAT_FUNC "%.2" "% FS" COEFFS 0 655.36 0 0 0 1 /end COMPU_METHOD
/begin MEASUREMENT KNK_bg_cyl8 "Knock background cylinder 8" UWORD Compu_KNK_bg_cyl8 0 0 0 99.9984741210938 ECU_ADDRESS 0x0100DC18 /end MEASUREMENT
/begin COMPU_METHOD Compu_KNK_bg_cyl8 " " RAT_FUNC "%.2" "% FS" COEFFS 0 655.36 0 0 0 1 /end COMPU_METHOD
/begin MEASUREMENT KNK_bg_cyl9 "Knock background cylinder 9" UWORD Compu_KNK_bg_cyl9 0 0 0 99.9984741210938 ECU_ADDRESS 0x0100DC20 /end MEASUREMENT
/begin COMPU_METHOD Compu_KNK_bg_cyl9 " " RAT_FUNC "%.2" "% FS" COEFFS 0 655.36 0 0 0 1 /end COMPU_METHOD
/begin MEASUREMENT KNK_bg_cyl10 "Knock background cylinder 10" UWORD Compu_KNK_bg_cyl10 0 0 0 99.9984741210938 ECU_ADDRESS 0x0100DC28 /end MEASUREMENT
/begin COMPU_METHOD Compu_KNK_bg_cyl10 " " RAT_FUNC "%.2" "% FS" COEFFS 0 655.36 0 0 0 1 /end COMPU_METHOD
/begin MEASUREMENT KNK_win_cyl1 "Knock window cylinder 1" UWORD Compu_KNK_win_cyl1 0 0 0 99.9984741210938 ECU_ADDRESS 0x0100DC30 /end MEASUREMENT
/begin COMPU_METHOD Compu_KNK_win_cyl1 " " RAT_FUNC "%.2" "% FS" COEFFS 0 655.36 0 0 0 1 /end COMPU_METHOD
/begin MEASUREMENT KNK_win_cyl2 "Knock window cylinder 2" UWORD Compu_KNK_win_cyl2 0 0 0 99.9984741210938 ECU_ADDRESS 0x0100DC38 /end MEASUREMENT
/begin COMPU_METHOD Compu_KNK_win_cyl2 " " RAT_FUNC "%.2" "% FS" COEFFS 0 655.36 0 0 0 1 /end COMPU_METHOD
/begin MEASUREMENT KNK_win_cyl3 "Knock window cylinder 3" UWORD Compu_KNK_win_cyl3 0 0 0 99.9984741210938 ECU_ADDRESS 0x0100DC40 /end MEASUREMENT
/begin COMPU_METHOD Compu_KNK_win_cyl3 " " RAT_FUNC "%.2" "% FS" COEFFS 0 655.36 0 0 0 1 /end COMPU_METHOD
/begin MEASUREMENT KNK_win_cyl4 "Knock window cylinder 4" UWORD Compu_KNK_win_cyl4 0 0 0 99.9984741210938 ECU_ADDRESS 0x0100DC48 /end MEASUREMENT
/begin COMPU_METHOD Compu_KNK_win_cyl4 " " RAT_FUNC "%.2" "% FS" COEFFS 0 655.36 0 0 0 1 /end COMPU_METHOD
/begin MEASUREMENT KNK_win_cyl5 "Knock window cylinder 5" UWORD Compu_KNK_win_cyl5 0 0 0 99.9984741210938 ECU_ADDRESS 0x0100DC50 /end MEASUREMENT
/begin COMPU_METHOD Compu_KNK_win_cyl5 " " RAT_FUNC "%.2" "% FS" COEFFS 0 655.36 0 0 0 1 /end COMPU_METHOD
/begin MEASUREMENT KNK_win_cyl6 "Knock window cylinder 6" UWORD Compu_KNK_win_cyl6 0 0 0 99.9984741210938 ECU_ADDRESS 0x0100DC58 /end MEASUREMENT
/begin COMPU_METHOD Compu_KNK_win_cyl6 " " RAT_FUNC "%.2" "% FS" COEFFS 0 655.36 0 0 0 1 /end COMPU_METHOD
/begin MEASUREMENT KNK_win_cyl7 "Knock window cylinder 7" UWORD Compu_KNK_win_cyl7 0 0 0 99.9984741210938 ECU_ADDRESS 0x0100DC60 /end MEASUREMENT
/begin COMPU_METHOD Compu_KNK_win_cyl7 " " RAT_FUNC "%.2" "% FS" COEFFS 0 655.36 0 0 0 1 /end COMPU_METHOD
/begin MEASUREMENT KNK_win_cyl8 "Knock window cylinder 8" UWORD Compu_KNK_win_cyl8 0 0 0 99.9984741210938 ECU_ADDRESS 0x0100DC68 /end MEASUREMENT
/begin COMPU_METHOD Compu_KNK_win_cyl8 " " RAT_FUNC "%.2" "% FS" COEFFS 0 655.36 0 0 0 1 /end COMPU_METHOD
/begin MEASUREMENT KNK_win_cyl9 "Knock window cylinder 9" UWORD Compu_KNK_win_cyl9 0 0 0 99.9984741210938 ECU_ADDRESS 0x0100DC70 /end MEASUREMENT
/begin COMPU_METHOD Compu_KNK_win_cyl9 " " RAT_FUNC "%.2" "% FS" COEFFS 0 655.36 0 0 0 1 /end COMPU_METHOD
/begin MEASUREMENT KNK_win_cyl10 "Knock window cylinder 10" UWORD Compu_KNK_win_cyl10 0 0 0 99.9984741210938 ECU_ADDRESS 0x0100DC78 /end MEASUREMENT
/begin COMPU_METHOD Compu_KNK_win_cyl10 " " RAT_FUNC "%.2" "% FS" COEFFS 0 655.36 0 0 0 1 /end COMPU_METHOD
/begin MEASUREMENT KNK_sig_cyl1 "Knock signal cylinder 1" UWORD Compu_KNK_sig_cyl1 0 0 0 99.9984741210938 ECU_ADDRESS 0x0100DC80 /end MEASUREMENT
/begin COMPU_METHOD Compu_KNK_sig_cyl1 " " RAT_FUNC "%.2" "% FS" COEFFS 0 655.36 0 0 0 1 /end COMPU_METHOD
/begin MEASUREMENT KNK_sig_cyl2 "Knock signal cylinder 2" UWORD Compu_KNK_sig_cyl2 0 0 0 99.9984741210938 ECU_ADDRESS 0x0100DC88 /end MEASUREMENT
/begin COMPU_METHOD Compu_KNK_sig_cyl2 " " RAT_FUNC "%.2" "% FS" COEFFS 0 655.36 0 0 0 1 /end COMPU_METHOD
/begin MEASUREMENT KNK_sig_cyl3 "Knock signal cylinder 3" UWORD Compu_KNK_sig_cyl3 0 0 0 99.9984741210938 ECU_ADDRESS 0x0100DC90 /end MEASUREMENT
/begin COMPU_METHOD Compu_KNK_sig_cyl3 " " RAT_FUNC "%.2" "% FS" COEFFS 0 655.36 0 0 0 1 /end COMPU_METHOD
/begin MEASUREMENT KNK_sig_cyl4 "Knock signal cylinder 4" UWORD Compu_KNK_sig_cyl4 0 0 0 99.9984741210938 ECU_ADDRESS 0x0100DC98 /end MEASUREMENT
/begin COMPU_METHOD Compu_KNK_sig_cyl4 " " RAT_FUNC "%.2" "% FS" COEFFS 0 655.36 0 0 0 1 /end COMPU_METHOD
/begin MEASUREMENT KNK_sig_cyl5 "Knock signal cylinder 5" UWORD Compu_KNK_sig_cyl5 0 0 0 99.9984741210938 ECU_ADDRESS 0x0100DCA0 /end MEASUREMENT
/begin COMPU_METHOD Compu_KNK_sig_cyl5 " " RAT_FUNC "%.2" "% FS" COEFFS 0 655.36 0 0 0 1 /end COMPU_METHOD
/begin MEASUREMENT KNK_sig_cyl6 "Knock signal cylinder 6" UWORD Compu_KNK_sig_cyl6 0 0 0 99.9984741210938 ECU_ADDRESS 0x0100DCA8 /end MEASUREMENT
/begin COMPU_METHOD Compu_KNK_sig_cyl6 " " RAT_FUNC "%.2" "% FS" COEFFS 0 655.36 0 0 0 1 /end COMPU_METHOD
/begin MEASUREMENT KNK_sig_cyl7 "Knock signal cylinder 7" UWORD Compu_KNK_sig_cyl7 0 0 0 99.9984741210938 ECU_ADDRESS 0x0100DCB0 /end MEASUREMENT
/begin COMPU_METHOD Compu_KNK_sig_cyl7 " " RAT_FUNC "%.2" "% FS" COEFFS 0 655.36 0 0 0 1 /end COMPU_METHOD
/begin MEASUREMENT KNK_sig_cyl8 "Knock signal cylinder 8" UWORD Compu_KNK_sig_cyl8 0 0 0 99.9984741210938 ECU_ADDRESS 0x0100DCB8 /end MEASUREMENT
/begin COMPU_METHOD Compu_KNK_sig_cyl8 " " RAT_FUNC "%.2" "% FS" COEFFS 0 655.36 0 0 0 1 /end COMPU_METHOD
/begin MEASUREMENT KNK_sig_cyl9 "Knock signal cylinder 9" UWORD Compu_KNK_sig_cyl9 0 0 0 99.9984741210938 ECU_ADDRESS 0x0100DCC0 /end MEASUREMENT
/begin COMPU_METHOD Compu_KNK_sig_cyl9 " " RAT_FUNC "%.2" "% FS" COEFFS 0 655.36 0 0 0 1 /end COMPU_METHOD
/begin MEASUREMENT KNK_sig_cyl10 "Knock signal cylinder 10" UWORD Compu_KNK_sig_cyl10 0 0 0 99.9984741210938 ECU_ADDRESS 0x0100DCC8 /end MEASUREMENT
/begin COMPU_METHOD Compu_KNK_sig_cyl10 " " RAT_FUNC "%.2" "% FS" COEFFS 0 655.36 0 0 0 1 /end COMPU_METHOD
/begin MEASUREMENT KNK_bg_dur_AltA "Knock background duration AltA" SWORD Compu_KNK_bg_dur_AltA 0 0 -16384 16383.5 ECU_ADDRESS 0x0100DCD0 /end MEASUREMENT
/begin COMPU_METHOD Compu_KNK_bg_dur_AltA " " RAT_FUNC "%.0" "CAD" COEFFS 0 2 0 0 0 1 /end COMPU_METHOD
/begin MEASUREMENT KNK_bg_dur_AltB "Knock background duration AltB" SWORD Compu_KNK_bg_dur_AltB 0 0 -16384 16383.5 ECU_ADDRESS 0x0100DCD8 /end MEASUREMENT
/begin COMPU_METHOD Compu_KNK_bg_dur_AltB " " RAT_FUNC "%.0" "CAD" COEFFS 0 2 0 0 0 1 /end COMPU_METHOD
/begin MEASUREMENT KNK_bg_start_AltA "Knock background start AltA" SWORD Compu_KNK_bg_start_AltA 0 0 -16384 16383.5 ECU_ADDRESS 0x0100DCE0 /end MEASUREMENT
/begin COMPU_METHOD Compu_KNK_bg_start_AltA " " RAT_FUNC "%.0" "CAD BTDC" COEFFS 0 2 0 0 0 1 /end COMPU_METHOD
/begin MEASUREMENT KNK_bg_start_AltB "Knock background start AltB" SWORD Compu_KNK_bg_start_AltB 0 0 -16384 16383.5 ECU_ADDRESS 0x0100DCE8 /end MEASUREMENT
/begin COMPU_METHOD Compu_KNK_bg_start_AltB " " RAT_FUNC "%.0" "CAD BTDC" COEFFS 0 2 0 0 0 1 /end COMPU_METHOD
/begin MEASUREMENT KNK_win_dur_AltA "Knock window duration AltA" SWORD Compu_KNK_win_dur_AltA 0 0 -16384 16383.5 ECU_ADDRESS 0x0100DCF0 /end MEASUREMENT
/begin COMPU_METHOD Compu_KNK_win_dur_AltA " " RAT_FUNC "%.0" "CAD" COEFFS 0 2 0 0 0 1 /end COMPU_METHOD
/begin MEASUREMENT KNK_win_dur_AltB "Knock window duration AltB" SWORD Compu_KNK_win_dur_AltB 0 0 -16384 16383.5 ECU_ADDRESS 0x0100DCF8 /end MEASUREMENT
/begin COMPU_METHOD Compu_KNK_win_dur_AltB " " RAT_FUNC "%.0" "CAD" COEFFS 0 2 0 0 0 1 /end COMPU_METHOD
/begin MEASUREMENT KNK_win_start_AltA "Knock window start AltA" SWORD Compu_KNK_win_start_AltA 0 0 -16384 16383.5 ECU_ADDRESS 0x0100DD00 /end MEASUREMENT
/begin COMPU_METHOD Compu_KNK_win_start_AltA " " RAT_FUNC "%.0" "CAD BTDC" COEFFS 0 2 0 0 0 1 /end COMPU_METHOD
/begin MEASUREMENT KNK_win_start_AltB "Knock window start AltB" SWORD Compu_KNK_win_start_AltB 0 0 -16384 16383.5 ECU_ADDRESS 0x0100DD08 /end MEASUREMENT
/begin COMPU_METHOD Compu_KNK_win_start_AltB " " RAT_FUNC "%.0" "CAD BTDC" COEFFS 0 2 0 0 0 1 /end COMPU_METHOD
/begin MEASUREMENT KNK_mult "Knock signal multiplier" SWORD Compu_KNK_mult 0 0 -16 15.99951171875 ECU_ADDRESS 0x0100DD10 /end MEASUREMENT
/begin COMPU_METHOD Compu_KNK_mult " " RAT_FUNC "%.2" "multiplier" COEFFS 0 2048 0 0 0 1 /end COMPU_METHOD
/begin MEASUREMENT KNK_mult_AltA "Knock signal multiplier AltA" SWORD Compu_KNK_mult_AltA 0 0 -16 15.99951171875 ECU_ADDRESS 0x0100DD18 /end MEASUREMENT
/begin COMPU_METHOD Compu_KNK_mult_AltA " " RAT_FUNC "%.2" "multiplier" COEFFS 0 2048 0 0 0 1 /end COMPU_METHOD
/begin MEASUREMENT KNK_mult_AltB "Knock signal multiplier AltB" SWORD Compu_KNK_mult_AltB 0 0 -16 15.99951171875 ECU_ADDRESS 0x0100DD20 /end MEASUREMENT
/begin COMPU_METHOD Compu_KNK_mult_AltB " " RAT_FUNC "%.2" "multiplier" COEFFS 0 2048 0 0 0 1 /end COMPU_METHOD
/begin MEASUREMENT KNK_CWT_100_V "Knock 100% CWT offset" UWORD Compu_KNK_CWT_100_V 0 0 0 63.9990234375 ECU_ADDRESS 0x0100DD30 /end MEASUREMENT
/begin COMPU_METHOD Compu_KNK_CWT_100_V " " RAT_FUNC "%.3" "volts" COEFFS 0 1024 0 0 0 1 /end COMPU_METHOD
/begin MEASUREMENT KNK_CWT_0_V "Knock 0% CWT offset" UWORD Compu_KNK_CWT_0_V 0 0 0 63.9990234375 ECU_ADDRESS 0x0100DD38 /end MEASUREMENT
/begin COMPU_METHOD Compu_KNK_CWT_0_V " " RAT_FUNC "%.3" "volts" COEFFS 0 1024 0 0 0 1 /end COMPU_METHOD
/begin MEASUREMENT ECTHst_max "ECT max" UWORD Compu_ECTHst_max 0 0 -460 563.984375 ECU_ADDRESS 0x0100DD60 /end MEASUREMENT
/begin COMPU_METHOD Compu_ECTHst_max " " RAT_FUNC "%.1" "deg F" COEFFS 0 64 29440 0 0 1 /end COMPU_METHOD
/begin MEASUREMENT ECTHst_hi_HM "ECT hour meter" ULONG Compu_ECTHst_hi_HM 0 0 0 1193046.47083333 ECU_ADDRESS 0x0100DD70 /end MEASUREMENT
/begin COMPU_METHOD Compu_ECTHst_hi_HM " " RAT_FUNC "%.3" "hours" COEFFS 0 3600 0 0 0 1 /end COMPU_METHOD
/begin CHARACTERISTIC OCT_tbl_store_EE "Adaptive octane table retention{OCT_tbl_store_EE&0xff=0:Battery}{OCT_tbl_store_EE&0xff=1:Permanent}" VALUE 0x00143941 /* @ECU_Address@OCT_tbl_store_EE@0x0100E7E0@ */ ECIPP_ALIGNMENT_UBYTE 255 OCT_tbl_store_EE_COMPU_VTAB 0 255 BIT_MASK 0xff /end CHARACTERISTIC
/begin COMPU_METHOD OCT_tbl_store_EE_COMPU_VTAB "Verbal Table" TAB_VERB "%.0" "list" COMPU_TAB_REF OCT_tbl_store_EE_COMPU_VTAB_REF /end COMPU_METHOD
/begin COMPU_VTAB OCT_tbl_store_EE_COMPU_VTAB_REF "Verbal Table" TAB_VERB 2 0 "Battery" 1 "Permanent" DEFAULT_VALUE "UNKNOWN" /end COMPU_VTAB
/begin CHARACTERISTIC KNK_FSO_disabled_tm "KNK FSO disable time" VALUE 0x001438d4 /* @ECU_Address@KNK_FSO_disabled_tm@0x010102D8@ */ ECIPP_ALIGNMENT_UWORD 66 Compu_KNK_FSO_disabled_tm 0 65.535 /end CHARACTERISTIC
/begin COMPU_METHOD Compu_KNK_FSO_disabled_tm " " RAT_FUNC "%.1" "sec" COEFFS 0 1000 0 0 0 1 /end COMPU_METHOD
/begin CHARACTERISTIC KNK_CWT_mult "Knock signal CWT offset" VALUE 0x001438ce /* @ECU_Address@KNK_CWT_mult@0x010102E0@ */ ECIPP_ALIGNMENT_UWORD 128 Compu_KNK_CWT_mult 0 127.998046875 /end CHARACTERISTIC
/begin COMPU_METHOD Compu_KNK_CWT_mult " " RAT_FUNC "%.2" "multiplier" COEFFS 0 512 0 0 0 1 /end COMPU_METHOD
/begin CHARACTERISTIC KNK_FSO_debounce "KNK FSO disable debounce" VALUE 0x001438d2 /* @ECU_Address@KNK_FSO_debounce@0x010102E8@ */ ECIPP_ALIGNMENT_UWORD 66 Compu_KNK_FSO_debounce 0 65.535 /end CHARACTERISTIC
/begin COMPU_METHOD Compu_KNK_FSO_debounce " " RAT_FUNC "%.2" "sec" COEFFS 0 1000 0 0 0 1 /end COMPU_METHOD
/begin MEASUREMENT KNK_FSO_disabled "KNK FSO disabled{KNK_FSO_disabled&0xff=0:NO}{KNK_FSO_disabled&0xff=1:YES}" UBYTE KNK_FSO_disabled_COMPU_VTAB 0 0 0 255 ECU_ADDRESS 0x010102F0 BIT_MASK 0xff /end MEASUREMENT
/begin COMPU_METHOD KNK_FSO_disabled_COMPU_VTAB "Verbal Table" TAB_VERB "%.0" "list" COMPU_TAB_REF KNK_FSO_disabled_COMPU_VTAB_REF /end COMPU_METHOD
/begin COMPU_VTAB KNK_FSO_disabled_COMPU_VTAB_REF "Verbal Table" TAB_VERB 2 0 "NO" 1 "YES" DEFAULT_VALUE "UNKNOWN" /end COMPU_VTAB
/begin CHARACTERISTIC KNK_FSO_win_tm "Knock FSO peak window" VALUE 0x0014751e /* @ECU_Address@KNK_FSO_win_tm@0x01010348@ */ ECIPP_ALIGNMENT_UWORD 65535 Compu_KNK_FSO_win_tm 0 65535 /end CHARACTERISTIC
/begin COMPU_METHOD Compu_KNK_FSO_win_tm " " RAT_FUNC "%.0" "ms" COEFFS 0 1 0 0 0 1 /end COMPU_METHOD
/begin MEASUREMENT KNK_FSO_0_V "Knock 0% FSO offset" UWORD Compu_KNK_FSO_0_V 0 0 0 63.9990234375 ECU_ADDRESS 0x01010350 /end MEASUREMENT
/begin COMPU_METHOD Compu_KNK_FSO_0_V " " RAT_FUNC "%.3" "volts" COEFFS 0 1024 0 0 0 1 /end COMPU_METHOD
/begin CHARACTERISTIC KNK_FSO_win_peak_tau "Knock FSO window peak tau" VALUE 0x00147bfc /* @ECU_Address@KNK_FSO_win_peak_tau@0x01010358@ */ ECIPP_ALIGNMENT_UWORD 327680 Compu_KNK_FSO_win_peak_tau 0.45084 327680 /end CHARACTERISTIC
/begin COMPU_METHOD Compu_KNK_FSO_win_peak_tau " " FORM "%.0" "ms"
 /begin FORMULA "-5 / log(1 - (X1 / 65536))" FORMULA_INV "(1 - exp(-5/X1)) * 65536" /end FORMULA
/end COMPU_METHOD
/begin MEASUREMENT KNK_FSO_100_V "Knock 100% FSO offset" UWORD Compu_KNK_FSO_100_V 0 0 0 63.9990234375 ECU_ADDRESS 0x01010360 /end MEASUREMENT
/begin COMPU_METHOD Compu_KNK_FSO_100_V " " RAT_FUNC "%.3" "volts" COEFFS 0 1024 0 0 0 1 /end COMPU_METHOD
/begin CHARACTERISTIC KNK_FSO_min_mdot "Knock FSO exit min fuel flow" VALUE 0x0014751c /* @ECU_Address@KNK_FSO_min_mdot@0x01010368@ */ ECIPP_ALIGNMENT_UWORD 128 Compu_KNK_FSO_min_mdot 0 127.998046875 /end CHARACTERISTIC
/begin COMPU_METHOD Compu_KNK_FSO_min_mdot " " RAT_FUNC "%.2" "g/sec" COEFFS 0 512 0 0 0 1 /end COMPU_METHOD
/begin CHARACTERISTIC OCT_gsln_alt_tbl "Gasoline alternate table{OCT_gsln_alt_tbl&0xff=0:Gasoline}{OCT_gsln_alt_tbl&0xff=1:Propane}{OCT_gsln_alt_tbl&0xff=2:Natural Gas}" VALUE 0x00147E8C /* @ECU_Address@OCT_gsln_alt_tbl@0x01010420@ */ ECIPP_ALIGNMENT_UBYTE 255 OCT_gsln_alt_tbl_COMPU_VTAB 0 255 BIT_MASK 0xff /end CHARACTERISTIC
/begin COMPU_METHOD OCT_gsln_alt_tbl_COMPU_VTAB "Verbal Table" TAB_VERB "%.0" "list" COMPU_TAB_REF OCT_gsln_alt_tbl_COMPU_VTAB_REF /end COMPU_METHOD
/begin COMPU_VTAB OCT_gsln_alt_tbl_COMPU_VTAB_REF "Verbal Table" TAB_VERB 3 0 "Gasoline" 1 "Propane" 2 "Natural Gas" DEFAULT_VALUE "UNKNOWN" /end COMPU_VTAB
/begin CHARACTERISTIC OCT_gsln_ena "Gasoline octane adapt mode{OCT_gsln_ena&0xff=0:Disabled}{OCT_gsln_ena&0xff=1:High}{OCT_gsln_ena&0xff=2:Low}" VALUE 0x00147E8F /* @ECU_Address@OCT_gsln_ena@0x01010428@ */ ECIPP_ALIGNMENT_UBYTE 255 OCT_gsln_ena_COMPU_VTAB 0 255 BIT_MASK 0xff /end CHARACTERISTIC
/begin COMPU_METHOD OCT_gsln_ena_COMPU_VTAB "Verbal Table" TAB_VERB "%.0" "list" COMPU_TAB_REF OCT_gsln_ena_COMPU_VTAB_REF /end COMPU_METHOD
/begin COMPU_VTAB OCT_gsln_ena_COMPU_VTAB_REF "Verbal Table" TAB_VERB 3 0 "Disabled" 1 "High" 2 "Low" DEFAULT_VALUE "UNKNOWN" /end COMPU_VTAB
/begin CHARACTERISTIC OCT_LP_alt_tbl "LP alternate table{OCT_LP_alt_tbl&0xff=0:Gasoline}{OCT_LP_alt_tbl&0xff=1:Propane}{OCT_LP_alt_tbl&0xff=2:Natural Gas}" VALUE 0x00147E8D /* @ECU_Address@OCT_LP_alt_tbl@0x01010430@ */ ECIPP_ALIGNMENT_UBYTE 255 OCT_LP_alt_tbl_COMPU_VTAB 0 255 BIT_MASK 0xff /end CHARACTERISTIC
/begin COMPU_METHOD OCT_LP_alt_tbl_COMPU_VTAB "Verbal Table" TAB_VERB "%.0" "list" COMPU_TAB_REF OCT_LP_alt_tbl_COMPU_VTAB_REF /end COMPU_METHOD
/begin COMPU_VTAB OCT_LP_alt_tbl_COMPU_VTAB_REF "Verbal Table" TAB_VERB 3 0 "Gasoline" 1 "Propane" 2 "Natural Gas" DEFAULT_VALUE "UNKNOWN" /end COMPU_VTAB
/begin CHARACTERISTIC OCT_LP_ena "LP octane adapt mode{OCT_LP_ena&0xff=0:Disabled}{OCT_LP_ena&0xff=1:High}{OCT_LP_ena&0xff=2:Low}" VALUE 0x00147E90 /* @ECU_Address@OCT_LP_ena@0x01010438@ */ ECIPP_ALIGNMENT_UBYTE 255 OCT_LP_ena_COMPU_VTAB 0 255 BIT_MASK 0xff /end CHARACTERISTIC
/begin COMPU_METHOD OCT_LP_ena_COMPU_VTAB "Verbal Table" TAB_VERB "%.0" "list" COMPU_TAB_REF OCT_LP_ena_COMPU_VTAB_REF /end COMPU_METHOD
/begin COMPU_VTAB OCT_LP_ena_COMPU_VTAB_REF "Verbal Table" TAB_VERB 3 0 "Disabled" 1 "High" 2 "Low" DEFAULT_VALUE "UNKNOWN" /end COMPU_VTAB
/begin CHARACTERISTIC OCT_NG_alt_tbl "NG alternate table{OCT_NG_alt_tbl&0xff=0:Gasoline}{OCT_NG_alt_tbl&0xff=1:Propane}{OCT_NG_alt_tbl&0xff=2:Natural Gas}" VALUE 0x00147E8E /* @ECU_Address@OCT_NG_alt_tbl@0x01010440@ */ ECIPP_ALIGNMENT_UBYTE 255 OCT_NG_alt_tbl_COMPU_VTAB 0 255 BIT_MASK 0xff /end CHARACTERISTIC
/begin COMPU_METHOD OCT_NG_alt_tbl_COMPU_VTAB "Verbal Table" TAB_VERB "%.0" "list" COMPU_TAB_REF OCT_NG_alt_tbl_COMPU_VTAB_REF /end COMPU_METHOD
/begin COMPU_VTAB OCT_NG_alt_tbl_COMPU_VTAB_REF "Verbal Table" TAB_VERB 3 0 "Gasoline" 1 "Propane" 2 "Natural Gas" DEFAULT_VALUE "UNKNOWN" /end COMPU_VTAB
/begin CHARACTERISTIC OCT_NG_ena "NG octane adapt mode{OCT_NG_ena&0xff=0:Disabled}{OCT_NG_ena&0xff=1:High}{OCT_NG_ena&0xff=2:Low}" VALUE 0x00147E91 /* @ECU_Address@OCT_NG_ena@0x01010448@ */ ECIPP_ALIGNMENT_UBYTE 255 OCT_NG_ena_COMPU_VTAB 0 255 BIT_MASK 0xff /end CHARACTERISTIC
/begin COMPU_METHOD OCT_NG_ena_COMPU_VTAB "Verbal Table" TAB_VERB "%.0" "list" COMPU_TAB_REF OCT_NG_ena_COMPU_VTAB_REF /end COMPU_METHOD
/begin COMPU_VTAB OCT_NG_ena_COMPU_VTAB_REF "Verbal Table" TAB_VERB 3 0 "Disabled" 1 "High" 2 "Low" DEFAULT_VALUE "UNKNOWN" /end COMPU_VTAB
/begin CHARACTERISTIC OCT_phi_gsln_alt_tbl "Gasoline phi alternate table{OCT_phi_gsln_alt_tbl&0xff=0:Gasoline}{OCT_phi_gsln_alt_tbl&0xff=1:Propane}{OCT_phi_gsln_alt_tbl&0xff=2:Natural Gas}" VALUE 0x00147E92 /* @ECU_Address@OCT_phi_gsln_alt_tbl@0x01010450@ */ ECIPP_ALIGNMENT_UBYTE 255 OCT_phi_gsln_alt_tbl_COMPU_VTAB 0 255 BIT_MASK 0xff /end CHARACTERISTIC
/begin COMPU_METHOD OCT_phi_gsln_alt_tbl_COMPU_VTAB "Verbal Table" TAB_VERB "%.0" "list" COMPU_TAB_REF OCT_phi_gsln_alt_tbl_COMPU_VTAB_REF /end COMPU_METHOD
/begin COMPU_VTAB OCT_phi_gsln_alt_tbl_COMPU_VTAB_REF "Verbal Table" TAB_VERB 3 0 "Gasoline" 1 "Propane" 2 "Natural Gas" DEFAULT_VALUE "UNKNOWN" /end COMPU_VTAB
/begin CHARACTERISTIC OCT_phi_gsln_ena "Gasoline phi enable{OCT_phi_gsln_ena&0xff=0x00:Disabled}{OCT_phi_gsln_ena&0xff=0x01:Enabled}" VALUE 0x00147E95 /* @ECU_Address@OCT_phi_gsln_ena@0x01010458@ */ ECIPP_ALIGNMENT_UBYTE 255 OCT_phi_gsln_ena_COMPU_VTAB 0 255 BIT_MASK 0xff /end CHARACTERISTIC
/begin COMPU_METHOD OCT_phi_gsln_ena_COMPU_VTAB "Verbal Table" TAB_VERB "%.0" "list" COMPU_TAB_REF OCT_phi_gsln_ena_COMPU_VTAB_REF /end COMPU_METHOD
/begin COMPU_VTAB OCT_phi_gsln_ena_COMPU_VTAB_REF "Verbal Table" TAB_VERB 2 0x00 "Disabled" 0x01 "Enabled" DEFAULT_VALUE "UNKNOWN" /end COMPU_VTAB
/begin CHARACTERISTIC OCT_phi_LP_alt_tbl "LP phi alternate table{OCT_phi_LP_alt_tbl&0xff=0:Gasoline}{OCT_phi_LP_alt_tbl&0xff=1:Propane}{OCT_phi_LP_alt_tbl&0xff=2:Natural Gas}" VALUE 0x00147E93 /* @ECU_Address@OCT_phi_LP_alt_tbl@0x01010460@ */ ECIPP_ALIGNMENT_UBYTE 255 OCT_phi_LP_alt_tbl_COMPU_VTAB 0 255 BIT_MASK 0xff /end CHARACTERISTIC
/begin COMPU_METHOD OCT_phi_LP_alt_tbl_COMPU_VTAB "Verbal Table" TAB_VERB "%.0" "list" COMPU_TAB_REF OCT_phi_LP_alt_tbl_COMPU_VTAB_REF /end COMPU_METHOD
/begin COMPU_VTAB OCT_phi_LP_alt_tbl_COMPU_VTAB_REF "Verbal Table" TAB_VERB 3 0 "Gasoline" 1 "Propane" 2 "Natural Gas" DEFAULT_VALUE "UNKNOWN" /end COMPU_VTAB
/begin CHARACTERISTIC OCT_phi_LP_ena "LP phi enable{OCT_phi_LP_ena&0xff=0x00:Disabled}{OCT_phi_LP_ena&0xff=0x01:Enabled}" VALUE 0x00147E96 /* @ECU_Address@OCT_phi_LP_ena@0x01010468@ */ ECIPP_ALIGNMENT_UBYTE 255 OCT_phi_LP_ena_COMPU_VTAB 0 255 BIT_MASK 0xff /end CHARACTERISTIC
/begin COMPU_METHOD OCT_phi_LP_ena_COMPU_VTAB "Verbal Table" TAB_VERB "%.0" "list" COMPU_TAB_REF OCT_phi_LP_ena_COMPU_VTAB_REF /end COMPU_METHOD
/begin COMPU_VTAB OCT_phi_LP_ena_COMPU_VTAB_REF "Verbal Table" TAB_VERB 2 0x00 "Disabled" 0x01 "Enabled" DEFAULT_VALUE "UNKNOWN" /end COMPU_VTAB
/begin CHARACTERISTIC OCT_phi_NG_alt_tbl "NG phi alternate table{OCT_phi_NG_alt_tbl&0xff=0:Gasoline}{OCT_phi_NG_alt_tbl&0xff=1:Propane}{OCT_phi_NG_alt_tbl&0xff=2:Natural Gas}" VALUE 0x00147E94 /* @ECU_Address@OCT_phi_NG_alt_tbl@0x01010470@ */ ECIPP_ALIGNMENT_UBYTE 255 OCT_phi_NG_alt_tbl_COMPU_VTAB 0 255 BIT_MASK 0xff /end CHARACTERISTIC
/begin COMPU_METHOD OCT_phi_NG_alt_tbl_COMPU_VTAB "Verbal Table" TAB_VERB "%.0" "list" COMPU_TAB_REF OCT_phi_NG_alt_tbl_COMPU_VTAB_REF /end COMPU_METHOD
/begin COMPU_VTAB OCT_phi_NG_alt_tbl_COMPU_VTAB_REF "Verbal Table" TAB_VERB 3 0 "Gasoline" 1 "Propane" 2 "Natural Gas" DEFAULT_VALUE "UNKNOWN" /end COMPU_VTAB
/begin CHARACTERISTIC OCT_phi_NG_ena "NG phi enable{OCT_phi_NG_ena&0xff=0x00:Disabled}{OCT_phi_NG_ena&0xff=0x01:Enabled}" VALUE 0x00147E97 /* @ECU_Address@OCT_phi_NG_ena@0x01010478@ */ ECIPP_ALIGNMENT_UBYTE 255 OCT_phi_NG_ena_COMPU_VTAB 0 255 BIT_MASK 0xff /end CHARACTERISTIC
/begin COMPU_METHOD OCT_phi_NG_ena_COMPU_VTAB "Verbal Table" TAB_VERB "%.0" "list" COMPU_TAB_REF OCT_phi_NG_ena_COMPU_VTAB_REF /end COMPU_METHOD
/begin COMPU_VTAB OCT_phi_NG_ena_COMPU_VTAB_REF "Verbal Table" TAB_VERB 2 0x00 "Disabled" 0x01 "Enabled" DEFAULT_VALUE "UNKNOWN" /end COMPU_VTAB
/begin CHARACTERISTIC J1939_static_pwr "J1939 EEC4 static rated power" VALUE 0x00147516 /* @ECU_Address@J1939_static_pwr@0x010104B8@ */ ECIPP_ALIGNMENT_UWORD 4096 Compu_J1939_static_pwr 0 4095.9375 /end CHARACTERISTIC
/begin COMPU_METHOD Compu_J1939_static_pwr " " RAT_FUNC "%.1" "kW" COEFFS 0 16 0 0 0 1 /end COMPU_METHOD
/begin MEASUREMENT KNK3_win_avg "KNK3 raw window average" UWORD Compu_KNK3_win_avg 0 0 0 63.9990234375 ECU_ADDRESS 0x01012048 /end MEASUREMENT
/begin COMPU_METHOD Compu_KNK3_win_avg " " RAT_FUNC "%.3" "volts" COEFFS 0 1024 0 0 0 1 /end COMPU_METHOD
/begin CHARACTERISTIC EGR_oct_ena "EGR octane adaptation{EGR_oct_ena&0xff=0:Disabled}{EGR_oct_ena&0xff=1:Enabled}" VALUE 0x001409b0 /* @ECU_Address@EGR_oct_ena@0x01012588@ */ ECIPP_ALIGNMENT_UBYTE 255 EGR_oct_ena_COMPU_VTAB 0 255 BIT_MASK 0xff /end CHARACTERISTIC
/begin COMPU_METHOD EGR_oct_ena_COMPU_VTAB "Verbal Table" TAB_VERB "%.0" "list" COMPU_TAB_REF EGR_oct_ena_COMPU_VTAB_REF /end COMPU_METHOD
/begin COMPU_VTAB EGR_oct_ena_COMPU_VTAB_REF "Verbal Table" TAB_VERB 2 0 "Disabled" 1 "Enabled" DEFAULT_VALUE "UNKNOWN" /end COMPU_VTAB
/begin CHARACTERISTIC EGR_oct_lim "Octane rating derate threshold" VALUE 0x001408e4 /* @ECU_Address@EGR_oct_lim@0x01012590@ */ ECIPP_ALIGNMENT_UWORD 100 Compu_EGR_oct_lim 0 99.9984741210938 /end CHARACTERISTIC
/begin COMPU_METHOD Compu_EGR_oct_lim " " RAT_FUNC "%.1" "%" COEFFS 0 655.36 0 0 0 1 /end COMPU_METHOD
/begin CHARACTERISTIC EGR_oct_lim_mode "Octane rating load limit source{EGR_oct_lim_mode&0xff=0:Table 1 / Gasoline}{EGR_oct_lim_mode&0xff=1:Table 2 / LPG}{EGR_oct_lim_mode&0xff=2:Table 3 / NG}{EGR_oct_lim_mode&0xff=3:Table 4 / Power}{EGR_oct_lim_mode&0xff=4:Table 5}{EGR_oct_lim_mode&0xff=5:Tabl" VALUE 0x001409b1 /* @ECU_Address@EGR_oct_lim_mode@0x01012598@ */ ECIPP_ALIGNMENT_UBYTE 255 EGR_oct_lim_mode_COMPU_VTAB 0 255 BIT_MASK 0xff /end CHARACTERISTIC
/begin COMPU_METHOD EGR_oct_lim_mode_COMPU_VTAB "Verbal Table" TAB_VERB "%.0" "list" COMPU_TAB_REF EGR_oct_lim_mode_COMPU_VTAB_REF /end COMPU_METHOD
/begin COMPU_VTAB EGR_oct_lim_mode_COMPU_VTAB_REF "Verbal Table" TAB_VERB 8 0 "Table 1 / Gasoline" 1 "Table 2 / LPG" 2 "Table 3 / NG" 3 "Table 4 / Power" 4 "Table 5" 5 "Table 6" 6 "Table 7" 7 "Table 8" DEFAULT_VALUE "UNKNOWN" /end COMPU_VTAB
/begin CHARACTERISTIC EGR_oct_LL_tau_dec "Octane rating load limit decreasing tau" VALUE 0x0014098a /* @ECU_Address@EGR_oct_LL_tau_dec@0x010125A0@ */ ECIPP_ALIGNMENT_UWORD 3277 Compu_EGR_oct_LL_tau_dec 0.0045084 3276.8 /end CHARACTERISTIC
/begin COMPU_METHOD Compu_EGR_oct_LL_tau_dec " " FORM "%.1" "sec"
 /begin FORMULA "-0.05 / log(1 - (X1 / 65536))" FORMULA_INV "(1 - exp(-0.05/X1)) * 65536" /end FORMULA
/end COMPU_METHOD
/begin CHARACTERISTIC EGR_oct_LL_tau_inc "Octane rating load limit increasing tau" VALUE 0x0014098c /* @ECU_Address@EGR_oct_LL_tau_inc@0x010125A8@ */ ECIPP_ALIGNMENT_UWORD 3277 Compu_EGR_oct_LL_tau_inc 0.0045084 3276.8 /end CHARACTERISTIC
/begin COMPU_METHOD Compu_EGR_oct_LL_tau_inc " " FORM "%.1" "sec"
 /begin FORMULA "-0.05 / log(1 - (X1 / 65536))" FORMULA_INV "(1 - exp(-0.05/X1)) * 65536" /end FORMULA
/end COMPU_METHOD
/begin MEASUREMENT EGR_oct_LL_pct_raw "Octane rating load limit prior to slewing" UWORD Compu_EGR_oct_LL_pct_raw 0 0 0 99.9984741210938 ECU_ADDRESS 0x010125D8 /end MEASUREMENT
/begin COMPU_METHOD Compu_EGR_oct_LL_pct_raw " " RAT_FUNC "%.1" "%" COEFFS 0 655.36 0 0 0 1 /end COMPU_METHOD
/begin CHARACTERISTIC OCT_slew_dec_max "Decreasing octane maximum Kp" VALUE 0x0014390c /* @ECU_Address@OCT_slew_dec_max@0x010125E8@ */ ECIPP_ALIGNMENT_UWORD 100 Compu_OCT_slew_dec_max 0 99.9984741210938 /end CHARACTERISTIC
/begin COMPU_METHOD Compu_OCT_slew_dec_max " " RAT_FUNC "%.2" "%/sec" COEFFS 0 655.36 0 0 0 1 /end COMPU_METHOD
/begin MEASUREMENT OCT_slew_dec_cur "Decreasing octane slew rate" UWORD Compu_OCT_slew_dec_cur 0 0 0 99.9984741210938 ECU_ADDRESS 0x010125F0 /end MEASUREMENT
/begin COMPU_METHOD Compu_OCT_slew_dec_cur " " RAT_FUNC "%.2" "%/sec" COEFFS 0 655.36 0 0 0 1 /end COMPU_METHOD
/begin CHARACTERISTIC OCT_slew_inc_ss "Increasing octane steady-state slew rate" VALUE 0x00143910 /* @ECU_Address@OCT_slew_inc_ss@0x01012600@ */ ECIPP_ALIGNMENT_UWORD 100 Compu_OCT_slew_inc_ss 0 99.9984741210938 /end CHARACTERISTIC
/begin COMPU_METHOD Compu_OCT_slew_inc_ss " " RAT_FUNC "%.2" "%/sec" COEFFS 0 655.36 0 0 0 1 /end COMPU_METHOD
/begin CHARACTERISTIC MAP_fullload_BPlim "Full-load BP scaling limiting{MAP_fullload_BPlim&0xff=0:Disabled}{MAP_fullload_BPlim&0xff=1:Enabled}" VALUE 0x00147e55 /* @ECU_Address@MAP_fullload_BPlim@0x010128E8@ */ ECIPP_ALIGNMENT_UBYTE 255 MAP_fullload_BPlim_COMPU_VTAB 0 255 BIT_MASK 0xff /end CHARACTERISTIC
/begin COMPU_METHOD MAP_fullload_BPlim_COMPU_VTAB "Verbal Table" TAB_VERB "%.0" "list" COMPU_TAB_REF MAP_fullload_BPlim_COMPU_VTAB_REF /end COMPU_METHOD
/begin COMPU_VTAB MAP_fullload_BPlim_COMPU_VTAB_REF "Verbal Table" TAB_VERB 2 0 "Disabled" 1 "Enabled" DEFAULT_VALUE "UNKNOWN" /end COMPU_VTAB
/begin CHARACTERISTIC OCT_dec_knkpctinc_dz "Decreasing octane knock retard increase deadzone" VALUE 0x001438ee /* @ECU_Address@OCT_dec_knkpctinc_dz@0x01012BC0@ */ ECIPP_ALIGNMENT_UWORD 100 Compu_OCT_dec_knkpctinc_dz 0 99.9984741210938 /end CHARACTERISTIC
/begin COMPU_METHOD Compu_OCT_dec_knkpctinc_dz " " RAT_FUNC "%.2" "%/window" COEFFS 0 655.36 0 0 0 1 /end COMPU_METHOD
/begin CHARACTERISTIC OCT_dec_tm "Decreasing octane update period" VALUE 0x001438f0 /* @ECU_Address@OCT_dec_tm@0x01012BC8@ */ ECIPP_ALIGNMENT_UWORD 65535 Compu_OCT_dec_tm 0 65535 /end CHARACTERISTIC
/begin COMPU_METHOD Compu_OCT_dec_tm " " RAT_FUNC "%.0" "ms" COEFFS 0 1 0 0 0 1 /end COMPU_METHOD
/begin MEASUREMENT KNK_ret_pctinc_max "Max knock retard increase" UWORD Compu_KNK_ret_pctinc_max 0 0 0 99.9984741210938 ECU_ADDRESS 0x01012BD0 /end MEASUREMENT
/begin COMPU_METHOD Compu_KNK_ret_pctinc_max " " RAT_FUNC "%.2" "%/window" COEFFS 0 655.36 0 0 0 1 /end COMPU_METHOD
/begin MEASUREMENT OCT_adapt_reset "Octane rating reset request{OCT_adapt_reset&0xff=0:Reset}{OCT_adapt_reset&0xff=1:Resetting...}" UBYTE OCT_adapt_reset_COMPU_VTAB 0 0 0 255 ECU_ADDRESS 0x01012BD8 BIT_MASK 0xff /end MEASUREMENT
/begin COMPU_METHOD OCT_adapt_reset_COMPU_VTAB "Verbal Table" TAB_VERB "%.0" "list" COMPU_TAB_REF OCT_adapt_reset_COMPU_VTAB_REF /end COMPU_METHOD
/begin COMPU_VTAB OCT_adapt_reset_COMPU_VTAB_REF "Verbal Table" TAB_VERB 2 0 "Reset" 1 "Resetting..." DEFAULT_VALUE "UNKNOWN" /end COMPU_VTAB
/begin CHARACTERISTIC OCT_slew_dec_Kd "Decreasing octane minimum Kd" VALUE 0x00143908 /* @ECU_Address@OCT_slew_dec_Kd@0x01012BE0@ */ ECIPP_ALIGNMENT_UWORD 100 Compu_OCT_slew_dec_Kd 0 99.9984741210938 /end CHARACTERISTIC
/begin COMPU_METHOD Compu_OCT_slew_dec_Kd " " RAT_FUNC "%.2" "%/window" COEFFS 0 655.36 0 0 0 1 /end COMPU_METHOD
/begin CHARACTERISTIC KNK_MAP_mode "Knock/octane enable/fault MAP selection{KNK_MAP_mode&0xff=0:MAP}{KNK_MAP_mode&0xff=1:MAP load}" VALUE 0x0014391d /* @ECU_Address@KNK_MAP_mode@0x01012BE8@ */ ECIPP_ALIGNMENT_UBYTE 255 KNK_MAP_mode_COMPU_VTAB 0 255 BIT_MASK 0xff /end CHARACTERISTIC
/begin COMPU_METHOD KNK_MAP_mode_COMPU_VTAB "Verbal Table" TAB_VERB "%.0" "list" COMPU_TAB_REF KNK_MAP_mode_COMPU_VTAB_REF /end COMPU_METHOD
/begin COMPU_VTAB KNK_MAP_mode_COMPU_VTAB_REF "Verbal Table" TAB_VERB 2 0 "MAP" 1 "MAP load" DEFAULT_VALUE "UNKNOWN" /end COMPU_VTAB
/begin MEASUREMENT OCT_slew_inc_mode "Increasing octane slew rate mode{OCT_slew_inc_mode&0xff=1:Steady-state}{OCT_slew_inc_mode&0xff=0:Power-up}" UBYTE OCT_slew_inc_mode_COMPU_VTAB 0 0 0 255 ECU_ADDRESS 0x01012BF0 BIT_MASK 0xff /end MEASUREMENT
/begin COMPU_METHOD OCT_slew_inc_mode_COMPU_VTAB "Verbal Table" TAB_VERB "%.0" "list" COMPU_TAB_REF OCT_slew_inc_mode_COMPU_VTAB_REF /end COMPU_METHOD
/begin COMPU_VTAB OCT_slew_inc_mode_COMPU_VTAB_REF "Verbal Table" TAB_VERB 2 1 "Steady-state" 0 "Power-up" DEFAULT_VALUE "UNKNOWN" /end COMPU_VTAB
/begin CHARACTERISTIC OCT_slew_dec_Kd_max "Decreasing octane maximum Kd" VALUE 0x0014390a /* @ECU_Address@OCT_slew_dec_Kd_max@0x01012BF8@ */ ECIPP_ALIGNMENT_UWORD 100 Compu_OCT_slew_dec_Kd_max 0 99.9984741210938 /end CHARACTERISTIC
/begin COMPU_METHOD Compu_OCT_slew_dec_Kd_max " " RAT_FUNC "%.2" "%/window" COEFFS 0 655.36 0 0 0 1 /end COMPU_METHOD
/begin CHARACTERISTIC KNK_min_mode "Knock sensor open fault voltage measurement{KNK_min_mode&0xff=0:Filtered/windowed}{KNK_min_mode&0xff=1:Unfiltered/engine cycle} (Fault Condition:KNK1/2/3 sensor input measurement)" VALUE 0x00147dfc /* @ECU_Address@KNK_min_mode@0x01012C60@ */ ECIPP_ALIGNMENT_UBYTE 255 KNK_min_mode_COMPU_VTAB 0 255 BIT_MASK 0xff /end CHARACTERISTIC
/begin COMPU_METHOD KNK_min_mode_COMPU_VTAB "Verbal Table" TAB_VERB "%.0" "list" COMPU_TAB_REF KNK_min_mode_COMPU_VTAB_REF /end COMPU_METHOD
/begin COMPU_VTAB KNK_min_mode_COMPU_VTAB_REF "Verbal Table" TAB_VERB 2 0 "Filtered/windowed" 1 "Unfiltered/engine cycle" DEFAULT_VALUE "UNKNOWN" /end COMPU_VTAB
/begin MEASUREMENT KNK_raw_avg "KNK1 unfiltered average" UWORD Compu_KNK_raw_avg 0 0 0 63.9990234375 ECU_ADDRESS 0x01012C68 /end MEASUREMENT
/begin COMPU_METHOD Compu_KNK_raw_avg " " RAT_FUNC "%.3" "volts" COEFFS 0 1024 0 0 0 1 /end COMPU_METHOD
/begin MEASUREMENT KNK2_raw_avg "KNK2 unfiltered average" UWORD Compu_KNK2_raw_avg 0 0 0 63.9990234375 ECU_ADDRESS 0x01012C70 /end MEASUREMENT
/begin COMPU_METHOD Compu_KNK2_raw_avg " " RAT_FUNC "%.3" "volts" COEFFS 0 1024 0 0 0 1 /end COMPU_METHOD
/begin MEASUREMENT KNK3_raw_avg "KNK3 unfiltered average" UWORD Compu_KNK3_raw_avg 0 0 0 63.9990234375 ECU_ADDRESS 0x01012C78 /end MEASUREMENT
/begin COMPU_METHOD Compu_KNK3_raw_avg " " RAT_FUNC "%.3" "volts" COEFFS 0 1024 0 0 0 1 /end COMPU_METHOD
/begin CHARACTERISTIC J1939_rc_torque_ref "J1939 retarder config reference torque" VALUE 0x00147514 /* @ECU_Address@J1939_rc_torque_ref@0x01013038@ */ ECIPP_ALIGNMENT_UWORD 16384 Compu_J1939_rc_torque_ref 0 16383.75 /end CHARACTERISTIC
/begin COMPU_METHOD Compu_J1939_rc_torque_ref " " RAT_FUNC "%.1" "N-m" COEFFS 0 4 0 0 0 1 /end COMPU_METHOD
/begin CHARACTERISTIC J1939_exr_torque_tbl "J1939 exhaust retarder torque{J1939_exr_torque_tbl&0xff=0:Percentage}{J1939_exr_torque_tbl&0xff=1:Separate Table}" VALUE 0x00147df6 /* @ECU_Address@J1939_exr_torque_tbl@0x01013040@ */ ECIPP_ALIGNMENT_UBYTE 255 J1939_exr_torque_tbl_COMPU_VTAB 0 255 BIT_MASK 0xff /end CHARACTERISTIC
/begin COMPU_METHOD J1939_exr_torque_tbl_COMPU_VTAB "Verbal Table" TAB_VERB "%.0" "list" COMPU_TAB_REF J1939_exr_torque_tbl_COMPU_VTAB_REF /end COMPU_METHOD
/begin COMPU_VTAB J1939_exr_torque_tbl_COMPU_VTAB_REF "Verbal Table" TAB_VERB 2 0 "Percentage" 1 "Separate Table" DEFAULT_VALUE "UNKNOWN" /end COMPU_VTAB
/begin CHARACTERISTIC J1939RC_ER_pt3_rpmd "J1939 engine retarder speed at point 3" VALUE 0x001474e2 /* @ECU_Address@J1939RC_ER_pt3_rpmd@0x01013048@ */ ECIPP_ALIGNMENT_UWORD 65535 Compu_J1939RC_ER_pt3_rpmd 0 65535 /end CHARACTERISTIC
/begin COMPU_METHOD Compu_J1939RC_ER_pt3_rpmd " " RAT_FUNC "%.0" "rpm" COEFFS 0 1 0 0 0 1 /end COMPU_METHOD
/begin CHARACTERISTIC J1939RC_ER_pt4_rpmd "J1939 engine retarder speed at point 4" VALUE 0x001474e4 /* @ECU_Address@J1939RC_ER_pt4_rpmd@0x01013050@ */ ECIPP_ALIGNMENT_UWORD 65535 Compu_J1939RC_ER_pt4_rpmd 0 65535 /end CHARACTERISTIC
/begin COMPU_METHOD Compu_J1939RC_ER_pt4_rpmd " " RAT_FUNC "%.0" "rpm" COEFFS 0 1 0 0 0 1 /end COMPU_METHOD
/begin CHARACTERISTIC J1939RC_EXR_pt3_rpmd "J1939 exhaust retarder speed at point 3" VALUE 0x001474e6 /* @ECU_Address@J1939RC_EXR_pt3_rpmd@0x01013058@ */ ECIPP_ALIGNMENT_UWORD 65535 Compu_J1939RC_EXR_pt3_rpmd 0 65535 /end CHARACTERISTIC
/begin COMPU_METHOD Compu_J1939RC_EXR_pt3_rpmd " " RAT_FUNC "%.0" "rpm" COEFFS 0 1 0 0 0 1 /end COMPU_METHOD
/begin CHARACTERISTIC J1939RC_EXR_pt4_rpmd "J1939 exhaust retarder speed at point 4" VALUE 0x001474e8 /* @ECU_Address@J1939RC_EXR_pt4_rpmd@0x01013060@ */ ECIPP_ALIGNMENT_UWORD 65535 Compu_J1939RC_EXR_pt4_rpmd 0 65535 /end CHARACTERISTIC
/begin COMPU_METHOD Compu_J1939RC_EXR_pt4_rpmd " " RAT_FUNC "%.0" "rpm" COEFFS 0 1 0 0 0 1 /end COMPU_METHOD
/begin COMPU_METHOD Compu_TKNK_cal_MAP " " RAT_FUNC "%.1" "MAP load (psia)" COEFFS 0 256 0 0 0 1 /end COMPU_METHOD
/begin COMPU_METHOD Compu_TKNK_cal_rpm " " RAT_FUNC "%.0" "Speed (rpm)" COEFFS 0 1 0 0 0 1 /end COMPU_METHOD
/begin CHARACTERISTIC TKNK_start "Knock Window Start" MAP 0x0014364C /* @ECU_Address@TKNK_start@0x020A3000@ */ ECIPP_ALIGNMENT_SWORD 16384 Compu_TKNK_start -16384 16383.5
 /begin AXIS_DESCR COM_AXIS NO_INPUT_QUANTITY Compu_TKNK_cal_MAP 4 -128 127.99609375 AXIS_PTS_REF TKNK_cal_MAP /end AXIS_DESCR
 /begin AXIS_DESCR COM_AXIS NO_INPUT_QUANTITY Compu_TKNK_cal_rpm 8 -32768 32767 AXIS_PTS_REF TKNK_cal_rpm /end AXIS_DESCR
/end CHARACTERISTIC
/begin AXIS_PTS TKNK_cal_MAP " " 0x00143474 /* @ECU_Address@TKNK_cal_MAP@0x020A1000@ */ NO_INPUT_QUANTITY ECIPP_Lookup_SWORD 0 Compu_TKNK_cal_MAP 4 -128 127.99609375 /end AXIS_PTS
/begin AXIS_PTS TKNK_cal_rpm " " 0x0014347C /* @ECU_Address@TKNK_cal_rpm@0x020A2000@ */ NO_INPUT_QUANTITY ECIPP_Lookup_SWORD 0 Compu_TKNK_cal_rpm 8 -32768 32767 /end AXIS_PTS
/begin COMPU_METHOD Compu_TKNK_start "" RAT_FUNC "%.0" "CAD BTDC start" COEFFS 0 2 0 0 0 1 /end COMPU_METHOD
/begin CHARACTERISTIC TKNK_dur "Knock Window Duration" MAP 0x0014348C /* @ECU_Address@TKNK_dur@0x020A4000@ */ ECIPP_ALIGNMENT_SWORD 16384 Compu_TKNK_dur -16384 16383.5
 /begin AXIS_DESCR COM_AXIS NO_INPUT_QUANTITY Compu_TKNK_cal_MAP 4 -128 127.99609375 AXIS_PTS_REF TKNK_cal_MAP /end AXIS_DESCR
 /begin AXIS_DESCR COM_AXIS NO_INPUT_QUANTITY Compu_TKNK_cal_rpm 8 -32768 32767 AXIS_PTS_REF TKNK_cal_rpm /end AXIS_DESCR
/end CHARACTERISTIC
/begin COMPU_METHOD Compu_TKNK_dur "" RAT_FUNC "%.0" "CAD duration" COEFFS 0 2 0 0 0 1 /end COMPU_METHOD
/begin CHARACTERISTIC TKNK_100V "Knock 100% Calibration" MAP 0x00143434 /* @ECU_Address@TKNK_100V@0x020A5000@ */ ECIPP_ALIGNMENT_SWORD 32 Compu_TKNK_100V -32 31.9990234375
 /begin AXIS_DESCR COM_AXIS NO_INPUT_QUANTITY Compu_TKNK_cal_MAP 4 -128 127.99609375 AXIS_PTS_REF TKNK_cal_MAP /end AXIS_DESCR
 /begin AXIS_DESCR COM_AXIS NO_INPUT_QUANTITY Compu_TKNK_cal_rpm 8 -32768 32767 AXIS_PTS_REF TKNK_cal_rpm /end AXIS_DESCR
/end CHARACTERISTIC
/begin COMPU_METHOD Compu_TKNK_100V "" RAT_FUNC "%.3" "RMS volts" COEFFS 0 1024 0 0 0 1 /end COMPU_METHOD
/begin CHARACTERISTIC TKNK_0V "Knock 0% Calibration" MAP 0x001433F4 /* @ECU_Address@TKNK_0V@0x020A6000@ */ ECIPP_ALIGNMENT_SWORD 32 Compu_TKNK_0V -32 31.9990234375
 /begin AXIS_DESCR COM_AXIS NO_INPUT_QUANTITY Compu_TKNK_cal_MAP 4 -128 127.99609375 AXIS_PTS_REF TKNK_cal_MAP /end AXIS_DESCR
 /begin AXIS_DESCR COM_AXIS NO_INPUT_QUANTITY Compu_TKNK_cal_rpm 8 -32768 32767 AXIS_PTS_REF TKNK_cal_rpm /end AXIS_DESCR
/end CHARACTERISTIC
/begin COMPU_METHOD Compu_TKNK_0V "" RAT_FUNC "%.3" "RMS volts" COEFFS 0 1024 0 0 0 1 /end COMPU_METHOD
/begin CHARACTERISTIC TKNK_ret_max "Knock Max Retard" MAP 0x0014360C /* @ECU_Address@TKNK_ret_max@0x020A7000@ */ ECIPP_ALIGNMENT_SWORD 64 Compu_TKNK_ret_max -64 63.998046875
 /begin AXIS_DESCR COM_AXIS NO_INPUT_QUANTITY Compu_TKNK_cal_MAP 4 -128 127.99609375 AXIS_PTS_REF TKNK_cal_MAP /end AXIS_DESCR
 /begin AXIS_DESCR COM_AXIS NO_INPUT_QUANTITY Compu_TKNK_cal_rpm 8 -32768 32767 AXIS_PTS_REF TKNK_cal_rpm /end AXIS_DESCR
/end CHARACTERISTIC
/begin COMPU_METHOD Compu_TKNK_ret_max "" RAT_FUNC "%.1" "CAD retard" COEFFS 0 512 0 0 0 1 /end COMPU_METHOD
/begin CHARACTERISTIC TKNKbg_start "Knock Background Start" MAP 0x001437CC /* @ECU_Address@TKNKbg_start@0x020E3000@ */ ECIPP_ALIGNMENT_SWORD 16384 Compu_TKNKbg_start -16384 16383.5
 /begin AXIS_DESCR COM_AXIS NO_INPUT_QUANTITY Compu_TKNK_cal_MAP 4 -128 127.99609375 AXIS_PTS_REF TKNK_cal_MAP /end AXIS_DESCR
 /begin AXIS_DESCR COM_AXIS NO_INPUT_QUANTITY Compu_TKNK_cal_rpm 8 -32768 32767 AXIS_PTS_REF TKNK_cal_rpm /end AXIS_DESCR
/end CHARACTERISTIC
/begin COMPU_METHOD Compu_TKNKbg_start "" RAT_FUNC "%.0" "CAD BTDC start" COEFFS 0 2 0 0 0 1 /end COMPU_METHOD
/begin CHARACTERISTIC TKNKbg_dur "Knock Background Duration" MAP 0x0014370C /* @ECU_Address@TKNKbg_dur@0x020E4000@ */ ECIPP_ALIGNMENT_SWORD 16384 Compu_TKNKbg_dur -16384 16383.5
 /begin AXIS_DESCR COM_AXIS NO_INPUT_QUANTITY Compu_TKNK_cal_MAP 4 -128 127.99609375 AXIS_PTS_REF TKNK_cal_MAP /end AXIS_DESCR
 /begin AXIS_DESCR COM_AXIS NO_INPUT_QUANTITY Compu_TKNK_cal_rpm 8 -32768 32767 AXIS_PTS_REF TKNK_cal_rpm /end AXIS_DESCR
/end CHARACTERISTIC
/begin COMPU_METHOD Compu_TKNKbg_dur "" RAT_FUNC "%.0" "CAD duration" COEFFS 0 2 0 0 0 1 /end COMPU_METHOD
/begin COMPU_METHOD Compu_Ttrqcal_RPM " " RAT_FUNC "%.0" "Speed (rpm)" COEFFS 0 1 0 0 0 1 /end COMPU_METHOD
/begin CHARACTERISTIC Ttrqcal_MAP_0 "Gasoline MAP Torque (psia)" CURVE 0x00149648 /* @ECU_Address@Ttrqcal_MAP_0@0x0211A000@ */ ECIPP_ALIGNMENT_SWORD 128 Compu_Ttrqcal_MAP_0 -128 127.99609375
 /begin AXIS_DESCR COM_AXIS NO_INPUT_QUANTITY Compu_Ttrqcal_RPM 16 -32768 32767 AXIS_PTS_REF Ttrqcal_RPM /end AXIS_DESCR
/end CHARACTERISTIC
/begin AXIS_PTS Ttrqcal_RPM " " 0x00146482 /* @ECU_Address@Ttrqcal_RPM@0x02119000@ */ NO_INPUT_QUANTITY ECIPP_Lookup_SWORD 0 Compu_Ttrqcal_RPM 16 -32768 32767 /end AXIS_PTS
/begin COMPU_METHOD Compu_Ttrqcal_MAP_0 " " RAT_FUNC "%.2" "No Torque" COEFFS 0 256 0 0 0 1 /end COMPU_METHOD
/begin CHARACTERISTIC Ttrqcal_MAP_100 "Gasoline MAP Torque (psia)" CURVE 0x001496C8 /* @ECU_Address@Ttrqcal_MAP_100@0x0211B000@ */ ECIPP_ALIGNMENT_SWORD 128 Compu_Ttrqcal_MAP_100 -128 127.99609375
 /begin AXIS_DESCR COM_AXIS NO_INPUT_QUANTITY Compu_Ttrqcal_RPM 16 -32768 32767 AXIS_PTS_REF Ttrqcal_RPM /end AXIS_DESCR
/end CHARACTERISTIC
/begin COMPU_METHOD Compu_Ttrqcal_MAP_100 " " RAT_FUNC "%.2" "Full Torque" COEFFS 0 256 0 0 0 1 /end COMPU_METHOD
/begin CHARACTERISTIC Ttrqcal_trq_100 "Gasoline MAP Torque (psia)" CURVE 0x00149788 /* @ECU_Address@Ttrqcal_trq_100@0x0211C000@ */ ECIPP_ALIGNMENT_SWORD 8192 Compu_Ttrqcal_trq_100 -8192 8191.75
 /begin AXIS_DESCR COM_AXIS NO_INPUT_QUANTITY Compu_Ttrqcal_RPM 16 -32768 32767 AXIS_PTS_REF Ttrqcal_RPM /end AXIS_DESCR
/end CHARACTERISTIC
/begin COMPU_METHOD Compu_Ttrqcal_trq_100 " " RAT_FUNC "%.1" "Max Brake Torque" COEFFS 0 4 0 0 0 1 /end COMPU_METHOD
/begin CHARACTERISTIC Ttrqcal_fric "Gasoline MAP Torque (psia)" CURVE 0x00149748 /* @ECU_Address@Ttrqcal_fric@0x021FD000@ */ ECIPP_ALIGNMENT_SWORD 8192 Compu_Ttrqcal_fric -8192 8191.75
 /begin AXIS_DESCR COM_AXIS NO_INPUT_QUANTITY Compu_Ttrqcal_RPM 16 -32768 32767 AXIS_PTS_REF Ttrqcal_RPM /end AXIS_DESCR
/end CHARACTERISTIC
/begin COMPU_METHOD Compu_Ttrqcal_fric " " RAT_FUNC "%.2" "Friction Torque" COEFFS 0 4 0 0 0 1 /end COMPU_METHOD
/begin CHARACTERISTIC TtrqcalLP_MAP_0 "LP MAP Torque (psia)" CURVE 0x001497A8 /* @ECU_Address@TtrqcalLP_MAP_0@0x02216000@ */ ECIPP_ALIGNMENT_SWORD 128 Compu_TtrqcalLP_MAP_0 -128 127.99609375
 /begin AXIS_DESCR COM_AXIS NO_INPUT_QUANTITY Compu_Ttrqcal_RPM 16 -32768 32767 AXIS_PTS_REF Ttrqcal_RPM /end AXIS_DESCR
/end CHARACTERISTIC
/begin COMPU_METHOD Compu_TtrqcalLP_MAP_0 " " RAT_FUNC "%.2" "No Torque" COEFFS 0 256 0 0 0 1 /end COMPU_METHOD
/begin CHARACTERISTIC TtrqcalNG_MAP_0 "NG MAP Torque (psia)" CURVE 0x00149908 /* @ECU_Address@TtrqcalNG_MAP_0@0x02217000@ */ ECIPP_ALIGNMENT_SWORD 128 Compu_TtrqcalNG_MAP_0 -128 127.99609375
 /begin AXIS_DESCR COM_AXIS NO_INPUT_QUANTITY Compu_Ttrqcal_RPM 16 -32768 32767 AXIS_PTS_REF Ttrqcal_RPM /end AXIS_DESCR
/end CHARACTERISTIC
/begin COMPU_METHOD Compu_TtrqcalNG_MAP_0 " " RAT_FUNC "%.2" "No Torque" COEFFS 0 256 0 0 0 1 /end COMPU_METHOD
/begin CHARACTERISTIC Ttrqcal_MAP_low "Gasoline MAP Torque (psia)" CURVE 0x00149668 /* @ECU_Address@Ttrqcal_MAP_low@0x02218000@ */ ECIPP_ALIGNMENT_SWORD 128 Compu_Ttrqcal_MAP_low -128 127.99609375
 /begin AXIS_DESCR COM_AXIS NO_INPUT_QUANTITY Compu_Ttrqcal_RPM 16 -32768 32767 AXIS_PTS_REF Ttrqcal_RPM /end AXIS_DESCR
/end CHARACTERISTIC
/begin COMPU_METHOD Compu_Ttrqcal_MAP_low " " RAT_FUNC "%.2" "Low Torque" COEFFS 0 256 0 0 0 1 /end COMPU_METHOD
/begin CHARACTERISTIC TtrqcalLP_MAP_low "LP MAP Torque (psia)" CURVE 0x001497C8 /* @ECU_Address@TtrqcalLP_MAP_low@0x02219000@ */ ECIPP_ALIGNMENT_SWORD 128 Compu_TtrqcalLP_MAP_low -128 127.99609375
 /begin AXIS_DESCR COM_AXIS NO_INPUT_QUANTITY Compu_Ttrqcal_RPM 16 -32768 32767 AXIS_PTS_REF Ttrqcal_RPM /end AXIS_DESCR
/end CHARACTERISTIC
/begin COMPU_METHOD Compu_TtrqcalLP_MAP_low " " RAT_FUNC "%.2" "Low Torque" COEFFS 0 256 0 0 0 1 /end COMPU_METHOD
/begin CHARACTERISTIC TtrqcalNG_MAP_low "NG MAP Torque (psia)" CURVE 0x00149928 /* @ECU_Address@TtrqcalNG_MAP_low@0x0221A000@ */ ECIPP_ALIGNMENT_SWORD 128 Compu_TtrqcalNG_MAP_low -128 127.99609375
 /begin AXIS_DESCR COM_AXIS NO_INPUT_QUANTITY Compu_Ttrqcal_RPM 16 -32768 32767 AXIS_PTS_REF Ttrqcal_RPM /end AXIS_DESCR
/end CHARACTERISTIC
/begin COMPU_METHOD Compu_TtrqcalNG_MAP_low " " RAT_FUNC "%.2" "Low Torque" COEFFS 0 256 0 0 0 1 /end COMPU_METHOD
/begin CHARACTERISTIC Ttrqcal_MAP_mid "Gasoline MAP Torque (psia)" CURVE 0x00149688 /* @ECU_Address@Ttrqcal_MAP_mid@0x0221B000@ */ ECIPP_ALIGNMENT_SWORD 128 Compu_Ttrqcal_MAP_mid -128 127.99609375
 /begin AXIS_DESCR COM_AXIS NO_INPUT_QUANTITY Compu_Ttrqcal_RPM 16 -32768 32767 AXIS_PTS_REF Ttrqcal_RPM /end AXIS_DESCR
/end CHARACTERISTIC
/begin COMPU_METHOD Compu_Ttrqcal_MAP_mid " " RAT_FUNC "%.2" "Mid Torque" COEFFS 0 256 0 0 0 1 /end COMPU_METHOD
/begin CHARACTERISTIC TtrqcalLP_MAP_mid "LP MAP Torque (psia)" CURVE 0x001497E8 /* @ECU_Address@TtrqcalLP_MAP_mid@0x0221C000@ */ ECIPP_ALIGNMENT_SWORD 128 Compu_TtrqcalLP_MAP_mid -128 127.99609375
 /begin AXIS_DESCR COM_AXIS NO_INPUT_QUANTITY Compu_Ttrqcal_RPM 16 -32768 32767 AXIS_PTS_REF Ttrqcal_RPM /end AXIS_DESCR
/end CHARACTERISTIC
/begin COMPU_METHOD Compu_TtrqcalLP_MAP_mid " " RAT_FUNC "%.2" "Mid Torque" COEFFS 0 256 0 0 0 1 /end COMPU_METHOD
/begin CHARACTERISTIC TtrqcalNG_MAP_mid "NG MAP Torque (psia)" CURVE 0x00149948 /* @ECU_Address@TtrqcalNG_MAP_mid@0x0221D000@ */ ECIPP_ALIGNMENT_SWORD 128 Compu_TtrqcalNG_MAP_mid -128 127.99609375
 /begin AXIS_DESCR COM_AXIS NO_INPUT_QUANTITY Compu_Ttrqcal_RPM 16 -32768 32767 AXIS_PTS_REF Ttrqcal_RPM /end AXIS_DESCR
/end CHARACTERISTIC
/begin COMPU_METHOD Compu_TtrqcalNG_MAP_mid " " RAT_FUNC "%.2" "Mid Torque" COEFFS 0 256 0 0 0 1 /end COMPU_METHOD
/begin CHARACTERISTIC Ttrqcal_MAP_hi "Gasoline MAP Torque (psia)" CURVE 0x001496A8 /* @ECU_Address@Ttrqcal_MAP_hi@0x0221E000@ */ ECIPP_ALIGNMENT_SWORD 128 Compu_Ttrqcal_MAP_hi -128 127.99609375
 /begin AXIS_DESCR COM_AXIS NO_INPUT_QUANTITY Compu_Ttrqcal_RPM 16 -32768 32767 AXIS_PTS_REF Ttrqcal_RPM /end AXIS_DESCR
/end CHARACTERISTIC
/begin COMPU_METHOD Compu_Ttrqcal_MAP_hi " " RAT_FUNC "%.2" "High Torque" COEFFS 0 256 0 0 0 1 /end COMPU_METHOD
/begin CHARACTERISTIC TtrqcalLP_MAP_hi "LP MAP Torque (psia)" CURVE 0x00149808 /* @ECU_Address@TtrqcalLP_MAP_hi@0x0221F000@ */ ECIPP_ALIGNMENT_SWORD 128 Compu_TtrqcalLP_MAP_hi -128 127.99609375
 /begin AXIS_DESCR COM_AXIS NO_INPUT_QUANTITY Compu_Ttrqcal_RPM 16 -32768 32767 AXIS_PTS_REF Ttrqcal_RPM /end AXIS_DESCR
/end CHARACTERISTIC
/begin COMPU_METHOD Compu_TtrqcalLP_MAP_hi " " RAT_FUNC "%.2" "High Torque" COEFFS 0 256 0 0 0 1 /end COMPU_METHOD
/begin CHARACTERISTIC TtrqcalNG_MAP_hi "NG MAP Torque (psia)" CURVE 0x00149968 /* @ECU_Address@TtrqcalNG_MAP_hi@0x02220000@ */ ECIPP_ALIGNMENT_SWORD 128 Compu_TtrqcalNG_MAP_hi -128 127.99609375
 /begin AXIS_DESCR COM_AXIS NO_INPUT_QUANTITY Compu_Ttrqcal_RPM 16 -32768 32767 AXIS_PTS_REF Ttrqcal_RPM /end AXIS_DESCR
/end CHARACTERISTIC
/begin COMPU_METHOD Compu_TtrqcalNG_MAP_hi " " RAT_FUNC "%.2" "High Torque" COEFFS 0 256 0 0 0 1 /end COMPU_METHOD
/begin CHARACTERISTIC TtrqcalLP_MAP_100 "LP MAP Torque (psia)" CURVE 0x00149828 /* @ECU_Address@TtrqcalLP_MAP_100@0x02221000@ */ ECIPP_ALIGNMENT_SWORD 128 Compu_TtrqcalLP_MAP_100 -128 127.99609375
 /begin AXIS_DESCR COM_AXIS NO_INPUT_QUANTITY Compu_Ttrqcal_RPM 16 -32768 32767 AXIS_PTS_REF Ttrqcal_RPM /end AXIS_DESCR
/end CHARACTERISTIC
/begin COMPU_METHOD Compu_TtrqcalLP_MAP_100 " " RAT_FUNC "%.2" "Full Torque" COEFFS 0 256 0 0 0 1 /end COMPU_METHOD
/begin CHARACTERISTIC TtrqcalNG_MAP_100 "NG MAP Torque (psia)" CURVE 0x00149988 /* @ECU_Address@TtrqcalNG_MAP_100@0x02222000@ */ ECIPP_ALIGNMENT_SWORD 128 Compu_TtrqcalNG_MAP_100 -128 127.99609375
 /begin AXIS_DESCR COM_AXIS NO_INPUT_QUANTITY Compu_Ttrqcal_RPM 16 -32768 32767 AXIS_PTS_REF Ttrqcal_RPM /end AXIS_DESCR
/end CHARACTERISTIC
/begin COMPU_METHOD Compu_TtrqcalNG_MAP_100 " " RAT_FUNC "%.2" "Full Torque" COEFFS 0 256 0 0 0 1 /end COMPU_METHOD
/begin CHARACTERISTIC Ttrqcal_retard "Gasoline MAP Torque (psia)" CURVE 0x001496E8 /* @ECU_Address@Ttrqcal_retard@0x02223000@ */ ECIPP_ALIGNMENT_SWORD 8192 Compu_Ttrqcal_retard -8192 8191.75
 /begin AXIS_DESCR COM_AXIS NO_INPUT_QUANTITY Compu_Ttrqcal_RPM 16 -32768 32767 AXIS_PTS_REF Ttrqcal_RPM /end AXIS_DESCR
/end CHARACTERISTIC
/begin COMPU_METHOD Compu_Ttrqcal_retard " " RAT_FUNC "%.2" "Retard Torque" COEFFS 0 4 0 0 0 1 /end COMPU_METHOD
/begin CHARACTERISTIC TtrqcalLP_retard "LP MAP Torque (psia)" CURVE 0x00149848 /* @ECU_Address@TtrqcalLP_retard@0x02224000@ */ ECIPP_ALIGNMENT_SWORD 8192 Compu_TtrqcalLP_retard -8192 8191.75
 /begin AXIS_DESCR COM_AXIS NO_INPUT_QUANTITY Compu_Ttrqcal_RPM 16 -32768 32767 AXIS_PTS_REF Ttrqcal_RPM /end AXIS_DESCR
/end CHARACTERISTIC
/begin COMPU_METHOD Compu_TtrqcalLP_retard " " RAT_FUNC "%.2" "Retard Torque" COEFFS 0 4 0 0 0 1 /end COMPU_METHOD
/begin CHARACTERISTIC TtrqcalNG_retard "NG MAP Torque (psia)" CURVE 0x001499A8 /* @ECU_Address@TtrqcalNG_retard@0x02225000@ */ ECIPP_ALIGNMENT_SWORD 8192 Compu_TtrqcalNG_retard -8192 8191.75
 /begin AXIS_DESCR COM_AXIS NO_INPUT_QUANTITY Compu_Ttrqcal_RPM 16 -32768 32767 AXIS_PTS_REF Ttrqcal_RPM /end AXIS_DESCR
/end CHARACTERISTIC
/begin COMPU_METHOD Compu_TtrqcalNG_retard " " RAT_FUNC "%.2" "Retard Torque" COEFFS 0 4 0 0 0 1 /end COMPU_METHOD
/begin CHARACTERISTIC TtrqcalLP_fric "LP MAP Torque (psia)" CURVE 0x001498A8 /* @ECU_Address@TtrqcalLP_fric@0x02226000@ */ ECIPP_ALIGNMENT_SWORD 8192 Compu_TtrqcalLP_fric -8192 8191.75
 /begin AXIS_DESCR COM_AXIS NO_INPUT_QUANTITY Compu_Ttrqcal_RPM 16 -32768 32767 AXIS_PTS_REF Ttrqcal_RPM /end AXIS_DESCR
/end CHARACTERISTIC
/begin COMPU_METHOD Compu_TtrqcalLP_fric " " RAT_FUNC "%.2" "Friction Torque" COEFFS 0 4 0 0 0 1 /end COMPU_METHOD
/begin CHARACTERISTIC TtrqcalNG_fric "NG MAP Torque (psia)" CURVE 0x00149A08 /* @ECU_Address@TtrqcalNG_fric@0x02227000@ */ ECIPP_ALIGNMENT_SWORD 8192 Compu_TtrqcalNG_fric -8192 8191.75
 /begin AXIS_DESCR COM_AXIS NO_INPUT_QUANTITY Compu_Ttrqcal_RPM 16 -32768 32767 AXIS_PTS_REF Ttrqcal_RPM /end AXIS_DESCR
/end CHARACTERISTIC
/begin COMPU_METHOD Compu_TtrqcalNG_fric " " RAT_FUNC "%.2" "Friction Torque" COEFFS 0 4 0 0 0 1 /end COMPU_METHOD
/begin CHARACTERISTIC TtrqcalLP_trq_100 "LP MAP Torque (psia)" CURVE 0x001498E8 /* @ECU_Address@TtrqcalLP_trq_100@0x02228000@ */ ECIPP_ALIGNMENT_SWORD 8192 Compu_TtrqcalLP_trq_100 -8192 8191.75
 /begin AXIS_DESCR COM_AXIS NO_INPUT_QUANTITY Compu_Ttrqcal_RPM 16 -32768 32767 AXIS_PTS_REF Ttrqcal_RPM /end AXIS_DESCR
/end CHARACTERISTIC
/begin COMPU_METHOD Compu_TtrqcalLP_trq_100 " " RAT_FUNC "%.1" "Max Brake Torque" COEFFS 0 4 0 0 0 1 /end COMPU_METHOD
/begin CHARACTERISTIC TtrqcalNG_trq_100 "NG MAP Torque (psia)" CURVE 0x00149A48 /* @ECU_Address@TtrqcalNG_trq_100@0x02229000@ */ ECIPP_ALIGNMENT_SWORD 8192 Compu_TtrqcalNG_trq_100 -8192 8191.75
 /begin AXIS_DESCR COM_AXIS NO_INPUT_QUANTITY Compu_Ttrqcal_RPM 16 -32768 32767 AXIS_PTS_REF Ttrqcal_RPM /end AXIS_DESCR
/end CHARACTERISTIC
/begin COMPU_METHOD Compu_TtrqcalNG_trq_100 " " RAT_FUNC "%.1" "Max Brake Torque" COEFFS 0 4 0 0 0 1 /end COMPU_METHOD
/begin CHARACTERISTIC Ttrqcal_torqpct "Torque Percent 0" VAL_BLK 0x001464A2 /* @ECU_Address@Ttrqcal_torqpct@0x0222A000@ */ ECIPP_ALIGNMENT_SWORD 100 Compu_Ttrqcal_torqpct -100 99.9969482421875 MATRIX_DIM 5 1 1 /end CHARACTERISTIC
/begin COMPU_METHOD Compu_Ttrqcal_torqpct " " RAT_FUNC "%.1" "%" COEFFS 0 327.68 0 0 0 1 /end COMPU_METHOD
/begin CHARACTERISTIC TFPPTPS_FPP_pct "FPP->TPS Nonlinear Mapping" MAP 0x00144A6E /* @ECU_Address@TFPPTPS_FPP_pct@0x02284000@ */ ECIPP_ALIGNMENT_SWORD 100 Compu_TFPPTPS_FPP_pct -100 99.9969482421875
 /begin AXIS_DESCR COM_AXIS NO_INPUT_QUANTITY Compu_TFPPTPS_TPS_pct 12 -100 99.9969482421875 AXIS_PTS_REF TFPPTPS_TPS_pct /end AXIS_DESCR
 /begin AXIS_DESCR COM_AXIS NO_INPUT_QUANTITY Compu_TFPPTPS_rpm 12 -32768 32767 AXIS_PTS_REF TFPPTPS_rpm /end AXIS_DESCR
/end CHARACTERISTIC
/begin AXIS_PTS TFPPTPS_TPS_pct " " 0x00144B8E /* @ECU_Address@TFPPTPS_TPS_pct@0x02286000@ */ NO_INPUT_QUANTITY ECIPP_Lookup_SWORD 0 Compu_TFPPTPS_TPS_pct 12 -100 99.9969482421875 /end AXIS_PTS
/begin AXIS_PTS TFPPTPS_rpm " " 0x00144BA6 /* @ECU_Address@TFPPTPS_rpm@0x02285000@ */ NO_INPUT_QUANTITY ECIPP_Lookup_SWORD 0 Compu_TFPPTPS_rpm 12 -32768 32767 /end AXIS_PTS
/begin COMPU_METHOD Compu_TFPPTPS_FPP_pct "" RAT_FUNC "%.1" "FPP Cmd (%)" COEFFS 0 327.68 0 0 0 1 /end COMPU_METHOD
/begin COMPU_METHOD Compu_TFPPTPS_rpm " " RAT_FUNC "%.0" "Speed (rpm)" COEFFS 0 1 0 0 0 1 /end COMPU_METHOD
/begin COMPU_METHOD Compu_TFPPTPS_TPS_pct " " RAT_FUNC "%.1" "Throttle Command (%)" COEFFS 0 327.68 0 0 0 1 /end COMPU_METHOD
/begin CHARACTERISTIC Ttrqcal_fric_cold "Gasoline MAP Torque (psia)" CURVE 0x00149728 /* @ECU_Address@Ttrqcal_fric_cold@0x0235B000@ */ ECIPP_ALIGNMENT_SWORD 8192 Compu_Ttrqcal_fric_cold -8192 8191.75
 /begin AXIS_DESCR COM_AXIS NO_INPUT_QUANTITY Compu_Ttrqcal_RPM 16 -32768 32767 AXIS_PTS_REF Ttrqcal_RPM /end AXIS_DESCR
/end CHARACTERISTIC
/begin COMPU_METHOD Compu_Ttrqcal_fric_cold " " RAT_FUNC "%.2" "Cold Friction Torque" COEFFS 0 4 0 0 0 1 /end COMPU_METHOD
/begin CHARACTERISTIC TtrqcalLP_fric_cold "LP MAP Torque (psia)" CURVE 0x00149888 /* @ECU_Address@TtrqcalLP_fric_cold@0x0235C000@ */ ECIPP_ALIGNMENT_SWORD 8192 Compu_TtrqcalLP_fric_cold -8192 8191.75
 /begin AXIS_DESCR COM_AXIS NO_INPUT_QUANTITY Compu_Ttrqcal_RPM 16 -32768 32767 AXIS_PTS_REF Ttrqcal_RPM /end AXIS_DESCR
/end CHARACTERISTIC
/begin COMPU_METHOD Compu_TtrqcalLP_fric_cold " " RAT_FUNC "%.2" "Cold Friction Torque" COEFFS 0 4 0 0 0 1 /end COMPU_METHOD
/begin CHARACTERISTIC TtrqcalNG_fric_cold "NG MAP Torque (psia)" CURVE 0x001499E8 /* @ECU_Address@TtrqcalNG_fric_cold@0x0235D000@ */ ECIPP_ALIGNMENT_SWORD 8192 Compu_TtrqcalNG_fric_cold -8192 8191.75
 /begin AXIS_DESCR COM_AXIS NO_INPUT_QUANTITY Compu_Ttrqcal_RPM 16 -32768 32767 AXIS_PTS_REF Ttrqcal_RPM /end AXIS_DESCR
/end CHARACTERISTIC
/begin COMPU_METHOD Compu_TtrqcalNG_fric_cold " " RAT_FUNC "%.2" "Cold Friction Torque" COEFFS 0 4 0 0 0 1 /end COMPU_METHOD
/begin CHARACTERISTIC Ttrqcal_parasitic "Gasoline MAP Torque (psia)" CURVE 0x00149768 /* @ECU_Address@Ttrqcal_parasitic@0x023A6000@ */ ECIPP_ALIGNMENT_SWORD 8192 Compu_Ttrqcal_parasitic -8192 8191.75
 /begin AXIS_DESCR COM_AXIS NO_INPUT_QUANTITY Compu_Ttrqcal_RPM 16 -32768 32767 AXIS_PTS_REF Ttrqcal_RPM /end AXIS_DESCR
/end CHARACTERISTIC
/begin COMPU_METHOD Compu_Ttrqcal_parasitic " " RAT_FUNC "%.2" "Parasitic Losses" COEFFS 0 4 0 0 0 1 /end COMPU_METHOD
/begin CHARACTERISTIC TtrqcalLP_parasitic "LP MAP Torque (psia)" CURVE 0x001498C8 /* @ECU_Address@TtrqcalLP_parasitic@0x023A7000@ */ ECIPP_ALIGNMENT_SWORD 8192 Compu_TtrqcalLP_parasitic -8192 8191.75
 /begin AXIS_DESCR COM_AXIS NO_INPUT_QUANTITY Compu_Ttrqcal_RPM 16 -32768 32767 AXIS_PTS_REF Ttrqcal_RPM /end AXIS_DESCR
/end CHARACTERISTIC
/begin COMPU_METHOD Compu_TtrqcalLP_parasitic " " RAT_FUNC "%.2" "Parasitic Losses" COEFFS 0 4 0 0 0 1 /end COMPU_METHOD
/begin CHARACTERISTIC TtrqcalNG_parasitic "NG MAP Torque (psia)" CURVE 0x00149A28 /* @ECU_Address@TtrqcalNG_parasitic@0x023A8000@ */ ECIPP_ALIGNMENT_SWORD 8192 Compu_TtrqcalNG_parasitic -8192 8191.75
 /begin AXIS_DESCR COM_AXIS NO_INPUT_QUANTITY Compu_Ttrqcal_RPM 16 -32768 32767 AXIS_PTS_REF Ttrqcal_RPM /end AXIS_DESCR
/end CHARACTERISTIC
/begin COMPU_METHOD Compu_TtrqcalNG_parasitic " " RAT_FUNC "%.2" "Parasitic Losses" COEFFS 0 4 0 0 0 1 /end COMPU_METHOD
/begin CHARACTERISTIC TKNK_dur_AltA "Knock Window Duration - Alternate A" MAP 0x001434CC /* @ECU_Address@TKNK_dur_AltA@0x023B3000@ */ ECIPP_ALIGNMENT_SWORD 16384 Compu_TKNK_dur_AltA -16384 16383.5
 /begin AXIS_DESCR COM_AXIS NO_INPUT_QUANTITY Compu_TKNK_cal_MAP 4 -128 127.99609375 AXIS_PTS_REF TKNK_cal_MAP /end AXIS_DESCR
 /begin AXIS_DESCR COM_AXIS NO_INPUT_QUANTITY Compu_TKNK_cal_rpm 8 -32768 32767 AXIS_PTS_REF TKNK_cal_rpm /end AXIS_DESCR
/end CHARACTERISTIC
/begin COMPU_METHOD Compu_TKNK_dur_AltA "" RAT_FUNC "%.0" "CAD duration" COEFFS 0 2 0 0 0 1 /end COMPU_METHOD
/begin CHARACTERISTIC TKNK_dur_AltB "Knock Window Duration - Alternate B" MAP 0x0014350C /* @ECU_Address@TKNK_dur_AltB@0x023B4000@ */ ECIPP_ALIGNMENT_SWORD 16384 Compu_TKNK_dur_AltB -16384 16383.5
 /begin AXIS_DESCR COM_AXIS NO_INPUT_QUANTITY Compu_TKNK_cal_MAP 4 -128 127.99609375 AXIS_PTS_REF TKNK_cal_MAP /end AXIS_DESCR
 /begin AXIS_DESCR COM_AXIS NO_INPUT_QUANTITY Compu_TKNK_cal_rpm 8 -32768 32767 AXIS_PTS_REF TKNK_cal_rpm /end AXIS_DESCR
/end CHARACTERISTIC
/begin COMPU_METHOD Compu_TKNK_dur_AltB "" RAT_FUNC "%.0" "CAD duration" COEFFS 0 2 0 0 0 1 /end COMPU_METHOD
/begin CHARACTERISTIC TKNKbg_dur_AltA "Knock Background Duration - Alternate A" MAP 0x0014374C /* @ECU_Address@TKNKbg_dur_AltA@0x023B5000@ */ ECIPP_ALIGNMENT_SWORD 16384 Compu_TKNKbg_dur_AltA -16384 16383.5
 /begin AXIS_DESCR COM_AXIS NO_INPUT_QUANTITY Compu_TKNK_cal_MAP 4 -128 127.99609375 AXIS_PTS_REF TKNK_cal_MAP /end AXIS_DESCR
 /begin AXIS_DESCR COM_AXIS NO_INPUT_QUANTITY Compu_TKNK_cal_rpm 8 -32768 32767 AXIS_PTS_REF TKNK_cal_rpm /end AXIS_DESCR
/end CHARACTERISTIC
/begin COMPU_METHOD Compu_TKNKbg_dur_AltA "" RAT_FUNC "%.0" "CAD duration" COEFFS 0 2 0 0 0 1 /end COMPU_METHOD
/begin CHARACTERISTIC TKNKbg_dur_AltB "Knock Background Duration - Alternate B" MAP 0x0014378C /* @ECU_Address@TKNKbg_dur_AltB@0x023B6000@ */ ECIPP_ALIGNMENT_SWORD 16384 Compu_TKNKbg_dur_AltB -16384 16383.5
 /begin AXIS_DESCR COM_AXIS NO_INPUT_QUANTITY Compu_TKNK_cal_MAP 4 -128 127.99609375 AXIS_PTS_REF TKNK_cal_MAP /end AXIS_DESCR
 /begin AXIS_DESCR COM_AXIS NO_INPUT_QUANTITY Compu_TKNK_cal_rpm 8 -32768 32767 AXIS_PTS_REF TKNK_cal_rpm /end AXIS_DESCR
/end CHARACTERISTIC
/begin COMPU_METHOD Compu_TKNKbg_dur_AltB "" RAT_FUNC "%.0" "CAD duration" COEFFS 0 2 0 0 0 1 /end COMPU_METHOD
/begin CHARACTERISTIC TKNK_start_AltA "Knock Window Start - Alternate A" MAP 0x0014368C /* @ECU_Address@TKNK_start_AltA@0x023B7000@ */ ECIPP_ALIGNMENT_SWORD 16384 Compu_TKNK_start_AltA -16384 16383.5
 /begin AXIS_DESCR COM_AXIS NO_INPUT_QUANTITY Compu_TKNK_cal_MAP 4 -128 127.99609375 AXIS_PTS_REF TKNK_cal_MAP /end AXIS_DESCR
 /begin AXIS_DESCR COM_AXIS NO_INPUT_QUANTITY Compu_TKNK_cal_rpm 8 -32768 32767 AXIS_PTS_REF TKNK_cal_rpm /end AXIS_DESCR
/end CHARACTERISTIC
/begin COMPU_METHOD Compu_TKNK_start_AltA "" RAT_FUNC "%.0" "CAD BTDC start" COEFFS 0 2 0 0 0 1 /end COMPU_METHOD
/begin CHARACTERISTIC TKNK_start_AltB "Knock Window Start - Alternate B" MAP 0x001436CC /* @ECU_Address@TKNK_start_AltB@0x023B8000@ */ ECIPP_ALIGNMENT_SWORD 16384 Compu_TKNK_start_AltB -16384 16383.5
 /begin AXIS_DESCR COM_AXIS NO_INPUT_QUANTITY Compu_TKNK_cal_MAP 4 -128 127.99609375 AXIS_PTS_REF TKNK_cal_MAP /end AXIS_DESCR
 /begin AXIS_DESCR COM_AXIS NO_INPUT_QUANTITY Compu_TKNK_cal_rpm 8 -32768 32767 AXIS_PTS_REF TKNK_cal_rpm /end AXIS_DESCR
/end CHARACTERISTIC
/begin COMPU_METHOD Compu_TKNK_start_AltB "" RAT_FUNC "%.0" "CAD BTDC start" COEFFS 0 2 0 0 0 1 /end COMPU_METHOD
/begin CHARACTERISTIC TKNKbg_start_AltA "Knock Background Start - Alternate A" MAP 0x0014380C /* @ECU_Address@TKNKbg_start_AltA@0x023B9000@ */ ECIPP_ALIGNMENT_SWORD 16384 Compu_TKNKbg_start_AltA -16384 16383.5
 /begin AXIS_DESCR COM_AXIS NO_INPUT_QUANTITY Compu_TKNK_cal_MAP 4 -128 127.99609375 AXIS_PTS_REF TKNK_cal_MAP /end AXIS_DESCR
 /begin AXIS_DESCR COM_AXIS NO_INPUT_QUANTITY Compu_TKNK_cal_rpm 8 -32768 32767 AXIS_PTS_REF TKNK_cal_rpm /end AXIS_DESCR
/end CHARACTERISTIC
/begin COMPU_METHOD Compu_TKNKbg_start_AltA "" RAT_FUNC "%.0" "CAD BTDC start" COEFFS 0 2 0 0 0 1 /end COMPU_METHOD
/begin CHARACTERISTIC TKNKbg_start_AltB "Knock Background Start - Alternate B" MAP 0x0014384C /* @ECU_Address@TKNKbg_start_AltB@0x023BA000@ */ ECIPP_ALIGNMENT_SWORD 16384 Compu_TKNKbg_start_AltB -16384 16383.5
 /begin AXIS_DESCR COM_AXIS NO_INPUT_QUANTITY Compu_TKNK_cal_MAP 4 -128 127.99609375 AXIS_PTS_REF TKNK_cal_MAP /end AXIS_DESCR
 /begin AXIS_DESCR COM_AXIS NO_INPUT_QUANTITY Compu_TKNK_cal_rpm 8 -32768 32767 AXIS_PTS_REF TKNK_cal_rpm /end AXIS_DESCR
/end CHARACTERISTIC
/begin COMPU_METHOD Compu_TKNKbg_start_AltB "" RAT_FUNC "%.0" "CAD BTDC start" COEFFS 0 2 0 0 0 1 /end COMPU_METHOD
/begin CHARACTERISTIC TKNK_mult_AltA "Knock Signal Multiplier - Alternate A" MAP 0x0014358C /* @ECU_Address@TKNK_mult_AltA@0x023BB000@ */ ECIPP_ALIGNMENT_SWORD 16 Compu_TKNK_mult_AltA -16 15.99951171875
 /begin AXIS_DESCR COM_AXIS NO_INPUT_QUANTITY Compu_TKNK_cal_MAP 4 -128 127.99609375 AXIS_PTS_REF TKNK_cal_MAP /end AXIS_DESCR
 /begin AXIS_DESCR COM_AXIS NO_INPUT_QUANTITY Compu_TKNK_cal_rpm 8 -32768 32767 AXIS_PTS_REF TKNK_cal_rpm /end AXIS_DESCR
/end CHARACTERISTIC
/begin COMPU_METHOD Compu_TKNK_mult_AltA "" RAT_FUNC "%.2" "Signal Multiplier" COEFFS 0 2048 0 0 0 1 /end COMPU_METHOD
/begin CHARACTERISTIC TKNK_mult_AltB "Knock Signal Multiplier - Alternate B" MAP 0x001435CC /* @ECU_Address@TKNK_mult_AltB@0x023BC000@ */ ECIPP_ALIGNMENT_SWORD 16 Compu_TKNK_mult_AltB -16 15.99951171875
 /begin AXIS_DESCR COM_AXIS NO_INPUT_QUANTITY Compu_TKNK_cal_MAP 4 -128 127.99609375 AXIS_PTS_REF TKNK_cal_MAP /end AXIS_DESCR
 /begin AXIS_DESCR COM_AXIS NO_INPUT_QUANTITY Compu_TKNK_cal_rpm 8 -32768 32767 AXIS_PTS_REF TKNK_cal_rpm /end AXIS_DESCR
/end CHARACTERISTIC
/begin COMPU_METHOD Compu_TKNK_mult_AltB "" RAT_FUNC "%.2" "Signal Multiplier" COEFFS 0 2048 0 0 0 1 /end COMPU_METHOD
/begin CHARACTERISTIC TKNK_mult "Knock Signal Multiplier" MAP 0x0014354C /* @ECU_Address@TKNK_mult@0x023BD000@ */ ECIPP_ALIGNMENT_SWORD 16 Compu_TKNK_mult -16 15.99951171875
 /begin AXIS_DESCR COM_AXIS NO_INPUT_QUANTITY Compu_TKNK_cal_MAP 4 -128 127.99609375 AXIS_PTS_REF TKNK_cal_MAP /end AXIS_DESCR
 /begin AXIS_DESCR COM_AXIS NO_INPUT_QUANTITY Compu_TKNK_cal_rpm 8 -32768 32767 AXIS_PTS_REF TKNK_cal_rpm /end AXIS_DESCR
/end CHARACTERISTIC
/begin COMPU_METHOD Compu_TKNK_mult "" RAT_FUNC "%.2" "Signal Multiplier" COEFFS 0 2048 0 0 0 1 /end COMPU_METHOD
/begin MEASUREMENT ECTHst_Tbl "ECT Histogram" ULONG Compu_ECTHst_Tbl 0 0 0 1193.04647083333 ECU_ADDRESS 0x023BE000 MATRIX_DIM 8 1 1 /end MEASUREMENT
/begin COMPU_METHOD Compu_ECTHst_Tbl " " RAT_FUNC "%.3" "Time (hours)" COEFFS 0 3600000 0 0 0 1 /end COMPU_METHOD
/begin COMPU_METHOD Compu_TKNK_FSO_exit_mdot " " RAT_FUNC "%.2" "Fuel flow(g/s)" COEFFS 0 1 0 0 0 1 /end COMPU_METHOD
/begin CHARACTERISTIC TKNK_FSO_exit_tau "Knock FSO exit tau" CURVE 0x00143B24 /* @ECU_Address@TKNK_FSO_exit_tau@0x0259C000@ */ ECIPP_ALIGNMENT_FLOAT32_IEEE 10000000000 Compu_TKNK_FSO_exit_tau -10000000000 10000000000
 /begin AXIS_DESCR COM_AXIS NO_INPUT_QUANTITY Compu_TKNK_FSO_exit_mdot 4 -10000000000 10000000000 AXIS_PTS_REF TKNK_FSO_exit_mdot /end AXIS_DESCR
/end CHARACTERISTIC
/begin AXIS_PTS TKNK_FSO_exit_mdot " " 0x00143B14 /* @ECU_Address@TKNK_FSO_exit_mdot@0x0259B000@ */ NO_INPUT_QUANTITY ECIPP_Lookup_FLOAT32_IEEE 0 Compu_TKNK_FSO_exit_mdot 4 -10000000000 10000000000 /end AXIS_PTS
/begin COMPU_METHOD Compu_TKNK_FSO_exit_tau " " RAT_FUNC "%.1" "Tau (ms)" COEFFS 0 1000 0 0 0 1 /end COMPU_METHOD
/begin COMPU_METHOD Compu_TDIL_pct_oct_xaxis " " RAT_FUNC "%.1" "SI: MAP load (psia), Diesel: Fuel load (mg/cyl)" COEFFS 0 1 0 0 0 1 /end COMPU_METHOD
/begin COMPU_METHOD Compu_TDIL_pct_oct_rpm " " RAT_FUNC "%.0" "Speed (rpm)" COEFFS 0 1 0 0 0 1 /end COMPU_METHOD
/begin CHARACTERISTIC TDIL_pct_oct_ofst "EGR Octane Adaptation Diluent Offset (%)" MAP 0x001403F6 /* @ECU_Address@TDIL_pct_oct_ofst@0x02626000@ */ ECIPP_ALIGNMENT_SWORD 200 Compu_TDIL_pct_oct_ofst -200 199.993896484375
 /begin AXIS_DESCR COM_AXIS NO_INPUT_QUANTITY Compu_TDIL_pct_oct_xaxis 8 -10000000000 10000000000 AXIS_PTS_REF TDIL_pct_oct_xaxis /end AXIS_DESCR
 /begin AXIS_DESCR COM_AXIS NO_INPUT_QUANTITY Compu_TDIL_pct_oct_rpm 8 -32768 32767 AXIS_PTS_REF TDIL_pct_oct_rpm /end AXIS_DESCR
/end CHARACTERISTIC
/begin AXIS_PTS TDIL_pct_oct_xaxis " " 0x00140098 /* @ECU_Address@TDIL_pct_oct_xaxis@0x02624000@ */ NO_INPUT_QUANTITY ECIPP_Lookup_FLOAT32_IEEE 0 Compu_TDIL_pct_oct_xaxis 8 -10000000000 10000000000 /end AXIS_PTS
/begin AXIS_PTS TDIL_pct_oct_rpm " " 0x00140476 /* @ECU_Address@TDIL_pct_oct_rpm@0x02625000@ */ NO_INPUT_QUANTITY ECIPP_Lookup_SWORD 0 Compu_TDIL_pct_oct_rpm 8 -32768 32767 /end AXIS_PTS
/begin COMPU_METHOD Compu_TDIL_pct_oct_ofst "" RAT_FUNC "%.1" "EGR Octane Adaptation Diluent Offset (%)" COEFFS 0 163.84 0 0 0 1 /end COMPU_METHOD
/begin CHARACTERISTIC TEGR_spkret_oct_ofst "EGR Octane Adaptation Spark Retard (CAD)" MAP 0x001406EE /* @ECU_Address@TEGR_spkret_oct_ofst@0x02627000@ */ ECIPP_ALIGNMENT_SWORD 2048 Compu_TEGR_spkret_oct_ofst -2048 2047.9375
 /begin AXIS_DESCR COM_AXIS NO_INPUT_QUANTITY Compu_TDIL_pct_oct_xaxis 8 -10000000000 10000000000 AXIS_PTS_REF TDIL_pct_oct_xaxis /end AXIS_DESCR
 /begin AXIS_DESCR COM_AXIS NO_INPUT_QUANTITY Compu_TDIL_pct_oct_rpm 8 -32768 32767 AXIS_PTS_REF TDIL_pct_oct_rpm /end AXIS_DESCR
/end CHARACTERISTIC
/begin COMPU_METHOD Compu_TEGR_spkret_oct_ofst "" RAT_FUNC "%.1" "EGR Octane Adaptation Spark Retard (CAD)" COEFFS 0 16 0 0 0 1 /end COMPU_METHOD
/begin CHARACTERISTIC Ttrqcal_exr "Gasoline MAP Torque (psia)" CURVE 0x00149708 /* @ECU_Address@Ttrqcal_exr@0x0264F000@ */ ECIPP_ALIGNMENT_SWORD 8192 Compu_Ttrqcal_exr -8192 8191.75
 /begin AXIS_DESCR COM_AXIS NO_INPUT_QUANTITY Compu_Ttrqcal_RPM 16 -32768 32767 AXIS_PTS_REF Ttrqcal_RPM /end AXIS_DESCR
/end CHARACTERISTIC
/begin COMPU_METHOD Compu_Ttrqcal_exr " " RAT_FUNC "%.2" "Exhaust Retarder Torque" COEFFS 0 4 0 0 0 1 /end COMPU_METHOD
/begin CHARACTERISTIC TtrqcalLP_exr "LP MAP Torque (psia)" CURVE 0x00149868 /* @ECU_Address@TtrqcalLP_exr@0x02650000@ */ ECIPP_ALIGNMENT_SWORD 8192 Compu_TtrqcalLP_exr -8192 8191.75
 /begin AXIS_DESCR COM_AXIS NO_INPUT_QUANTITY Compu_Ttrqcal_RPM 16 -32768 32767 AXIS_PTS_REF Ttrqcal_RPM /end AXIS_DESCR
/end CHARACTERISTIC
/begin COMPU_METHOD Compu_TtrqcalLP_exr " " RAT_FUNC "%.2" "Exhaust Retarder Torque" COEFFS 0 4 0 0 0 1 /end COMPU_METHOD
/begin CHARACTERISTIC TtrqcalNG_exr "NG MAP Torque (psia)" CURVE 0x001499C8 /* @ECU_Address@TtrqcalNG_exr@0x02651000@ */ ECIPP_ALIGNMENT_SWORD 8192 Compu_TtrqcalNG_exr -8192 8191.75
 /begin AXIS_DESCR COM_AXIS NO_INPUT_QUANTITY Compu_Ttrqcal_RPM 16 -32768 32767 AXIS_PTS_REF Ttrqcal_RPM /end AXIS_DESCR
/end CHARACTERISTIC
/begin COMPU_METHOD Compu_TtrqcalNG_exr " " RAT_FUNC "%.2" "Exhaust Retarder Torque" COEFFS 0 4 0 0 0 1 /end COMPU_METHOD
/begin MEASUREMENT J1939RC_ER_trq "Engine Retarder Torque Curve" UBYTE Compu_J1939RC_ER_trq 0 0 -125 130 ECU_ADDRESS 0x02654000 MATRIX_DIM 5 1 1 /end MEASUREMENT
/begin COMPU_METHOD Compu_J1939RC_ER_trq " " RAT_FUNC "%.0" "Engine Retarder Torque (%)" COEFFS 0 1 125 0 0 1 /end COMPU_METHOD
/begin MEASUREMENT J1939RC_EXR_trq "Exhaust Retarder Torque Curve" UBYTE Compu_J1939RC_EXR_trq 0 0 -125 130 ECU_ADDRESS 0x02655000 MATRIX_DIM 5 1 1 /end MEASUREMENT
/begin COMPU_METHOD Compu_J1939RC_EXR_trq " " RAT_FUNC "%.0" "Exhaust Retarder Torque (%)" COEFFS 0 1 125 0 0 1 /end COMPU_METHOD
/begin GROUP EC_Knock "ECONTROLS" ROOT
 /begin REF_CHARACTERISTIC KNK_enable KNK_ret_K KNK_adv_K KNK_val_trig KNK_val_cycles KNK_ECT_ena KNK_min_MAP KNK_max_RPM KNK_BPF KNK_sens_cyl1 KNK_sens_cyl2 KNK_sens_cyl3 KNK_sens_cyl4 KNK_sens_cyl5 KNK_sens_cyl6 KNK_sens_cyl7 KNK_sens_cyl8 KNK_BPF_delay KNK_sig_pweight spk_ofst_maxadv OCT_init OCT_ret_increase OCT_ret_decrease OCT_slew_inc OCT_slew_dec OCT_update_wait OCT_MAPss_win OCT_RPMss_win OCT_ss_tau OCT_run_wait OCT_ECT_ena OCT_min_MAP OCT_max_MAP OCT_min_RPM OCT_max_RPM OCT_init_mode FKNK_ena FKNK_ret_start FKNK_ret_max FKNK_enrich_max FKNK_enr_inc_tau FKNK_enr_dec_tau KNK_adv_KRreti KNK_adv_KRretc KNK_adv_KRmin OCT_mem_type OCT_inc_wait OCT_inc_wait_pct KNK_Ksel KNK_sens_cyl9 KNK_sens_cyl10 OCT_init_table KNK_mult_cyl1 KNK_mult_cyl2 KNK_mult_cyl3 KNK_mult_cyl4 KNK_mult_cyl5 KNK_mult_cyl6 KNK_mult_cyl7 KNK_mult_cyl8 KNK_mult_cyl9 KNK_mult_cyl10 KNK_tbl_cyl1 KNK_tbl_cyl2 KNK_tbl_cyl3 KNK_tbl_cyl4 KNK_tbl_cyl5 KNK_tbl_cyl6 KNK_tbl_cyl7 KNK_tbl_cyl8 KNK_tbl_cyl9 KNK_tbl_cyl10 OCT_tbl_store_EE KNK_FSO_disabled_tm KNK_CWT_mult KNK_FSO_debounce KNK_FSO_win_tm KNK_FSO_win_peak_tau KNK_FSO_min_mdot OCT_gsln_alt_tbl OCT_gsln_ena OCT_LP_alt_tbl OCT_LP_ena OCT_NG_alt_tbl OCT_NG_ena OCT_phi_gsln_alt_tbl OCT_phi_gsln_ena OCT_phi_LP_alt_tbl OCT_phi_LP_ena OCT_phi_NG_alt_tbl OCT_phi_NG_ena EGR_oct_ena EGR_oct_lim EGR_oct_lim_mode EGR_oct_LL_tau_dec EGR_oct_LL_tau_inc OCT_slew_dec_max OCT_slew_inc_ss OCT_dec_knkpctinc_dz OCT_dec_tm OCT_slew_dec_Kd KNK_MAP_mode OCT_slew_dec_Kd_max KNK_min_mode TKNK_start TKNK_dur TKNK_100V TKNK_0V TKNK_ret_max TKNKbg_start TKNKbg_dur TKNK_dur_AltA TKNK_dur_AltB TKNKbg_dur_AltA TKNKbg_dur_AltB TKNK_start_AltA TKNK_start_AltB TKNKbg_start_AltA TKNKbg_start_AltB TKNK_mult_AltA TKNK_mult_AltB TKNK_mult TKNK_FSO_exit_tau TDIL_pct_oct_ofst TEGR_spkret_oct_ofst /end REF_CHARACTERISTIC
 /begin REF_MEASUREMENT spk_adv_base spk_off_ECTvL spk_off_MATvL spk_off_ECT KNK_sig_pavg spk_ret_CWT KNK_pct_latch KNK_pct_avg KNK_pct_max KNK_pct_min KNK_win_dur KNK_win_start KNK_manual KNK_100_V KNK_0_V KNK_ret_max KCYC_enable KNK_SW_gain KNK_bg_dur KNK_bg_start KNK_win_avg OCT_update_tmr OCT_MAPss OCT_RPMss spk_adv_altOCT spk_adv_OCTcomp FKNK_enrich_mod OCT_inc_tmr KNK2_win_avg coil1_adv_mod coil2_adv_mod coil3_adv_mod coil4_adv_mod coil5_adv_mod coil6_adv_mod coil7_adv_mod coil8_adv_mod coil9_adv_mod coil10_adv_mod KNK_bg_cyl1 KNK_bg_cyl2 KNK_bg_cyl3 KNK_bg_cyl4 KNK_bg_cyl5 KNK_bg_cyl6 KNK_bg_cyl7 KNK_bg_cyl8 KNK_bg_cyl9 KNK_bg_cyl10 KNK_win_cyl1 KNK_win_cyl2 KNK_win_cyl3 KNK_win_cyl4 KNK_win_cyl5 KNK_win_cyl6 KNK_win_cyl7 KNK_win_cyl8 KNK_win_cyl9 KNK_win_cyl10 KNK_sig_cyl1 KNK_sig_cyl2 KNK_sig_cyl3 KNK_sig_cyl4 KNK_sig_cyl5 KNK_sig_cyl6 KNK_sig_cyl7 KNK_sig_cyl8 KNK_sig_cyl9 KNK_sig_cyl10 KNK_bg_dur_AltA KNK_bg_dur_AltB KNK_bg_start_AltA KNK_bg_start_AltB KNK_win_dur_AltA KNK_win_dur_AltB KNK_win_start_AltA KNK_win_start_AltB KNK_mult KNK_mult_AltA KNK_mult_AltB KNK_CWT_100_V KNK_CWT_0_V KNK_FSO_disabled KNK_FSO_0_V KNK_FSO_100_V KNK3_win_avg EGR_oct_LL_pct_raw OCT_slew_dec_cur KNK_ret_pctinc_max OCT_adapt_reset OCT_slew_inc_mode KNK_raw_avg KNK2_raw_avg KNK3_raw_avg /end REF_MEASUREMENT
/end GROUP
/begin GROUP EC_LDService "ECONTROLS" ROOT
 /begin REF_MEASUREMENT TSTcompression MSinj_kill MSspk_kill MSinj_fire MScompression MSspk_fire MSDBW_test MSmanual_ext_pwr TSTspk_fire TSTinj_fire AL_erase_req TransCrk_dis ECTHst_max ECTHst_hi_HM ECTHst_Tbl /end REF_MEASUREMENT
/end GROUP
/begin GROUP EC_LoadCal "ECONTROLS" ROOT
 /begin REF_CHARACTERISTIC FPPTPSnl_ena FPPTPSnl_FPP FPPTPSnl_TPS FPPTPSnl2_FPP FPPTPSnl2_TPS FPPTPSnl3_FPP FPPTPSnl3_TPS load_est_type torque_select fric_cold_ena fric_cold_T fric_hot_T J1939_torque_pct_tbl J1939_static_pwr MAP_fullload_BPlim J1939_rc_torque_ref J1939_exr_torque_tbl J1939RC_ER_pt3_rpmd J1939RC_ER_pt4_rpmd J1939RC_EXR_pt3_rpmd J1939RC_EXR_pt4_rpmd Ttrqcal_MAP_0 Ttrqcal_MAP_100 Ttrqcal_trq_100 Ttrqcal_fric TtrqcalLP_MAP_0 TtrqcalNG_MAP_0 Ttrqcal_MAP_low TtrqcalLP_MAP_low TtrqcalNG_MAP_low Ttrqcal_MAP_mid TtrqcalLP_MAP_mid TtrqcalNG_MAP_mid Ttrqcal_MAP_hi TtrqcalLP_MAP_hi TtrqcalNG_MAP_hi TtrqcalLP_MAP_100 TtrqcalNG_MAP_100 Ttrqcal_retard TtrqcalLP_retard TtrqcalNG_retard TtrqcalLP_fric TtrqcalNG_fric TtrqcalLP_trq_100 TtrqcalNG_trq_100 Ttrqcal_torqpct TFPPTPS_FPP_pct Ttrqcal_fric_cold TtrqcalLP_fric_cold TtrqcalNG_fric_cold Ttrqcal_parasitic TtrqcalLP_parasitic TtrqcalNG_parasitic Ttrqcal_exr TtrqcalLP_exr TtrqcalNG_exr /end REF_CHARACTERISTIC
 /begin REF_MEASUREMENT torque_Nm_max FPPTPSnl_cur torque_driver torque_pct_max torque_pct_gross torque_pct_fric drivebrake_torq_pct exhbrake_torq_pct drivebrake_torq_max exhbrake_torq_max eng_torque_mode FPP_cmd_pstslew torque_pct_eng_dmd torque_tbl_fric torque_parasitic J1939RC_ER_trq J1939RC_EXR_trq /end REF_MEASUREMENT
/end GROUP
/begin GROUP EC_Misfire "ECONTROLS" ROOT /begin REF_MEASUREMENT MSinj_kill MSspk_kill /end REF_MEASUREMENT /end GROUP
/begin GROUP EC_Outputs "ECONTROLS" ROOT /begin REF_MEASUREMENT TransCrk_dis /end REF_MEASUREMENT /end GROUP
/begin GROUP EC_PhiGsln "ECONTROLS" ROOT /begin REF_MEASUREMENT FKNK_enrich_mod /end REF_MEASUREMENT /end GROUP
/begin GROUP EC_Service "ECONTROLS" ROOT /begin REF_MEASUREMENT ECTHst_max ECTHst_hi_HM ECTHst_Tbl /end REF_MEASUREMENT /end GROUP
/begin GROUP EC_Service1 "ECONTROLS" ROOT /begin REF_MEASUREMENT AL_erase_req /end REF_MEASUREMENT /end GROUP
/begin GROUP EC_Service2 "ECONTROLS" ROOT /begin REF_MEASUREMENT AL_erase_req /end REF_MEASUREMENT /end GROUP
/begin GROUP EC_SparkCal "ECONTROLS" ROOT /begin REF_CHARACTERISTIC KNK_enable /end REF_CHARACTERISTIC
 /begin REF_MEASUREMENT spk_adv_base spk_off_ECTvL spk_off_MATvL spk_off_ECT KNK_sig_pavg spk_ret_CWT KNK_pct_latch KNK_pct_avg spk_adv_altOCT spk_adv_OCTcomp /end REF_MEASUREMENT
/end GROUP
/begin GROUP EC_SparkCalLP "ECONTROLS" ROOT
 /begin REF_MEASUREMENT spk_adv_base spk_off_ECTvL spk_off_MATvL spk_off_ECT spk_ret_CWT spk_adv_altOCT spk_adv_OCTcomp /end REF_MEASUREMENT
/end GROUP
/begin GROUP EC_SparkCalNG "ECONTROLS" ROOT
 /begin REF_MEASUREMENT spk_adv_base spk_off_ECTvL spk_off_MATvL spk_off_ECT spk_ret_CWT spk_adv_altOCT spk_adv_OCTcomp /end REF_MEASUREMENT
/end GROUP
/begin GROUP EC_SparkOfst "ECONTROLS" ROOT
 /begin REF_MEASUREMENT spk_adv_base spk_off_ECTvL spk_off_MATvL spk_off_ECT spk_ret_CWT spk_adv_altOCT spk_adv_OCTcomp /end REF_MEASUREMENT
/end GROUP
/begin GROUP EC_Tests "ECONTROLS" ROOT
 /begin REF_MEASUREMENT TSTcompression MSinj_kill MSspk_kill MSinj_fire MScompression MSspk_fire MSDBW_test MSmanual_ext_pwr TSTspk_fire TSTinj_fire /end REF_MEASUREMENT
/end GROUP
/end MODULE
/end PROJECT
