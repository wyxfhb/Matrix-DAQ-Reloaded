/*
Copyright (c) 2000-2022.
All rights reserved.  This is an unpublished work.
*/
ASAP2_VERSION 1 61
/begin PROJECT Econtrols_4G "4G Test"
/begin HEADER "4G A2L Configuration" PROJECT_NO EControls4G /* config for version control */ VERSION "$Revision: 82130 $:" /* config for version control */ /end HEADER
/begin MODULE EControls_4G_SH2A "EControls 4G"
/begin MOD_COMMON "" DEPOSIT ABSOLUTE BYTE_ORDER MSB_FIRST /end MOD_COMMON
/* Define the Record Layouts */
/begin RECORD_LAYOUT ECIPP_ALIGNMENT_UBYTE FNC_VALUES 1 UBYTE COLUMN_DIR DIRECT /end RECORD_LAYOUT
/begin RECORD_LAYOUT ECIPP_ALIGNMENT_UWORD FNC_VALUES 1 UWORD COLUMN_DIR DIRECT /end RECORD_LAYOUT
/begin RECORD_LAYOUT ECIPP_Lookup_UWORD AXIS_PTS_X 1 UWORD INDEX_INCR DIRECT /end RECORD_LAYOUT
/begin RECORD_LAYOUT ECIPP_ALIGNMENT_SWORD FNC_VALUES 1 SWORD COLUMN_DIR DIRECT /end RECORD_LAYOUT
/begin RECORD_LAYOUT ECIPP_Lookup_SWORD AXIS_PTS_X 1 SWORD INDEX_INCR DIRECT /end RECORD_LAYOUT
/begin RECORD_LAYOUT ECIPP_ALIGNMENT_ULONG FNC_VALUES 1 ULONG COLUMN_DIR DIRECT /end RECORD_LAYOUT
/begin RECORD_LAYOUT ECIPP_ALIGNMENT_SLONG FNC_VALUES 1 SLONG COLUMN_DIR DIRECT /end RECORD_LAYOUT
/begin RECORD_LAYOUT ECIPP_ALIGNMENT_FLOAT32_IEEE FNC_VALUES 1 FLOAT32_IEEE COLUMN_DIR DIRECT /end RECORD_LAYOUT
/begin MEASUREMENT spk_adv "Total Spark Advance" SWORD Compu_spk_adv 0 0 -2048 2047.9375 ECU_ADDRESS 0x01000020 /end MEASUREMENT
/begin COMPU_METHOD Compu_spk_adv " " RAT_FUNC "%.1" "CAD BTDC" COEFFS 0 16 0 0 0 1 /end COMPU_METHOD
/begin MEASUREMENT MAPdt "MAPdt" SWORD Compu_MAPdt 0 0 -4000 3999.8779296875 ECU_ADDRESS 0x010000E0 /end MEASUREMENT
/begin COMPU_METHOD Compu_MAPdt " " RAT_FUNC "%.1" "psi/sec" COEFFS 0 8.192 0 0 0 1 /end COMPU_METHOD
/begin MEASUREMENT Phi_cmd "Phi command" UWORD Compu_Phi_cmd 0 0 0 3.99993896484375 ECU_ADDRESS 0x01000108 /end MEASUREMENT
/begin COMPU_METHOD Compu_Phi_cmd " " RAT_FUNC "%.3" "-" COEFFS 0 16384 0 0 0 1 /end COMPU_METHOD
/begin MEASUREMENT mdot_a_ports "mdot_a_ports" UWORD Compu_mdot_a_ports 0 0 0 1023.984375 ECU_ADDRESS 0x01000128 /end MEASUREMENT
/begin COMPU_METHOD Compu_mdot_a_ports " " RAT_FUNC "%.1" "g/sec" COEFFS 0 64 0 0 0 1 /end COMPU_METHOD
/begin MEASUREMENT mdot_f_ports "mdot_f_ports" UWORD Compu_mdot_f_ports 0 0 0 127.998046875 ECU_ADDRESS 0x01000130 /end MEASUREMENT
/begin COMPU_METHOD Compu_mdot_f_ports " " RAT_FUNC "%.2" "g/sec" COEFFS 0 512 0 0 0 1 /end COMPU_METHOD
/begin MEASUREMENT CL_BM1 "Closed-loop correction 1" SWORD Compu_CL_BM1 0 0 -100 99.9969482421875 ECU_ADDRESS 0x010001F8 /end MEASUREMENT
/begin COMPU_METHOD Compu_CL_BM1 " " RAT_FUNC "%.1" "%" COEFFS 0 327.68 0 0 0 1 /end COMPU_METHOD
/begin MEASUREMENT A_BM1 "Adaptive correction 1" SWORD Compu_A_BM1 0 0 -100 99.9969482421875 ECU_ADDRESS 0x01000200 /end MEASUREMENT
/begin COMPU_METHOD Compu_A_BM1 " " RAT_FUNC "%.1" "%" COEFFS 0 327.68 0 0 0 1 /end COMPU_METHOD
/begin MEASUREMENT Manual_BM "Manual_BM" SWORD Compu_Manual_BM 0 0 -100 99.9969482421875 ECU_ADDRESS 0x01000208 /end MEASUREMENT
/begin COMPU_METHOD Compu_Manual_BM " " RAT_FUNC "%.1" "%" COEFFS 0 327.68 0 0 0 1 /end COMPU_METHOD
/begin MEASUREMENT BM1_crct "Total fuel correction 1" UWORD Compu_BM1_crct 0 0 0 1.99996948242188 ECU_ADDRESS 0x01000210 /end MEASUREMENT
/begin COMPU_METHOD Compu_BM1_crct " " RAT_FUNC "%.3" "multiplier" COEFFS 0 32768 0 0 0 1 /end COMPU_METHOD
/begin MEASUREMENT CL1_perturb "CL perturbation 1" SWORD Compu_CL1_perturb 0 0 -100 99.9969482421875 ECU_ADDRESS 0x01000218 /end MEASUREMENT
/begin COMPU_METHOD Compu_CL1_perturb " " RAT_FUNC "%.1" "%" COEFFS 0 327.68 0 0 0 1 /end COMPU_METHOD
/begin MEASUREMENT CLInactiveFlag "CL Inactive Indication{CLInactiveFlag&4=4:Manual force inactive}{CLInactiveFlag&1=1:CL Ena Map = 0}{CLInactiveFlag&2=2:Phi command out-of range}{CLInactiveFlag&0=0:NONE}" UBYTE CLInactiveFlag_COMPU_VTAB 0 0 0 255 ECU_ADDRESS 0x01000220 BIT_MASK 4 /end MEASUREMENT
/begin COMPU_METHOD CLInactiveFlag_COMPU_VTAB "Verbal Table" TAB_VERB "%.0" "flag" COMPU_TAB_REF CLInactiveFlag_COMPU_VTAB_REF /end COMPU_METHOD
/begin COMPU_VTAB CLInactiveFlag_COMPU_VTAB_REF "Verbal Table" TAB_VERB 1 4 "Manual force inactive" DEFAULT_VALUE "Unsupported Bit_Mask" /end COMPU_VTAB
/begin MEASUREMENT CB1pre_DCa "Pre-cat EGO DC actual" UWORD Compu_CB1pre_DCa 0 0 0 199.996948242188 ECU_ADDRESS 0x01000228 /end MEASUREMENT
/begin COMPU_METHOD Compu_CB1pre_DCa " " RAT_FUNC "%.1" "%" COEFFS 0 327.68 0 0 0 1 /end COMPU_METHOD
/begin MEASUREMENT CB1pre_DCd "Pre-cat EGO DC desired" UWORD Compu_CB1pre_DCd 0 0 0 199.996948242188 ECU_ADDRESS 0x01000230 /end MEASUREMENT
/begin COMPU_METHOD Compu_CB1pre_DCd " " RAT_FUNC "%.1" "%" COEFFS 0 327.68 0 0 0 1 /end COMPU_METHOD
/begin MEASUREMENT CLp_E "CL1_E" UWORD Compu_CLp_E 0 0 0 199.996948242188 ECU_ADDRESS 0x01000238 /end MEASUREMENT
/begin COMPU_METHOD Compu_CLp_E " " RAT_FUNC "%.1" "%" COEFFS 0 327.68 0 0 0 1 /end COMPU_METHOD
/begin MEASUREMENT mdot_a_trans "mdot throttle air transient" SWORD Compu_mdot_a_trans 0 0 -512 511.984375 ECU_ADDRESS 0x01000250 /end MEASUREMENT
/begin COMPU_METHOD Compu_mdot_a_trans " " RAT_FUNC "%.1" "g/sec" COEFFS 0 64 0 0 0 1 /end COMPU_METHOD
/begin MEASUREMENT mdot_a_trans_pct "mdot throttle air transient relative" SWORD Compu_mdot_a_trans_pct 0 0 -800 799.9755859375 ECU_ADDRESS 0x01000258 /end MEASUREMENT
/begin COMPU_METHOD Compu_mdot_a_trans_pct " " RAT_FUNC "%.1" "%" COEFFS 0 40.96 0 0 0 1 /end COMPU_METHOD
/begin MEASUREMENT TRIM_DC "TRIM duty-cycle" UWORD Compu_TRIM_DC 0 0 0 99.9984741210938 ECU_ADDRESS 0x010002B0 /end MEASUREMENT
/begin COMPU_METHOD Compu_TRIM_DC " " RAT_FUNC "%.1" "%" COEFFS 0 655.36 0 0 0 1 /end COMPU_METHOD
/begin MEASUREMENT CL_temp_wait_tmr "CL temporary disable timer" UWORD Compu_CL_temp_wait_tmr 0 0 0 65535 ECU_ADDRESS 0x010002F0 /end MEASUREMENT
/begin COMPU_METHOD Compu_CL_temp_wait_tmr " " RAT_FUNC "%.0" "ms" COEFFS 0 1 0 0 0 1 /end COMPU_METHOD
/begin MEASUREMENT CL_BM2 "Closed-loop correction 2" SWORD Compu_CL_BM2 0 0 -100 99.9969482421875 ECU_ADDRESS 0x01000328 /end MEASUREMENT
/begin COMPU_METHOD Compu_CL_BM2 " " RAT_FUNC "%.1" "%" COEFFS 0 327.68 0 0 0 1 /end COMPU_METHOD
/begin MEASUREMENT A_BM2 "Adaptive correction 2" SWORD Compu_A_BM2 0 0 -100 99.9969482421875 ECU_ADDRESS 0x01000330 /end MEASUREMENT
/begin COMPU_METHOD Compu_A_BM2 " " RAT_FUNC "%.1" "%" COEFFS 0 327.68 0 0 0 1 /end COMPU_METHOD
/begin MEASUREMENT BM2_crct "Total fuel correction 2" UWORD Compu_BM2_crct 0 0 0 1.99996948242188 ECU_ADDRESS 0x01000338 /end MEASUREMENT
/begin COMPU_METHOD Compu_BM2_crct " " RAT_FUNC "%.3" "multiplier" COEFFS 0 32768 0 0 0 1 /end COMPU_METHOD
/begin MEASUREMENT CL2_perturb "CL perturbation 2" SWORD Compu_CL2_perturb 0 0 -100 99.9969482421875 ECU_ADDRESS 0x01000358 /end MEASUREMENT
/begin COMPU_METHOD Compu_CL2_perturb " " RAT_FUNC "%.1" "%" COEFFS 0 327.68 0 0 0 1 /end COMPU_METHOD
/begin MEASUREMENT CB2pre_DCa "Pre-cat EGO DC actual" UWORD Compu_CB2pre_DCa 0 0 0 199.996948242188 ECU_ADDRESS 0x01000360 /end MEASUREMENT
/begin COMPU_METHOD Compu_CB2pre_DCa " " RAT_FUNC "%.1" "%" COEFFS 0 327.68 0 0 0 1 /end COMPU_METHOD
/begin MEASUREMENT Phi_UEGO "UEGO phi" UWORD Compu_Phi_UEGO 0 0 0 3.99993896484375 ECU_ADDRESS 0x01000398 /end MEASUREMENT
/begin COMPU_METHOD Compu_Phi_UEGO " " RAT_FUNC "%.3" "phi" COEFFS 0 16384 0 0 0 1 /end COMPU_METHOD
/begin MEASUREMENT FPin "Fuel rail pressure" UWORD Compu_FPin 0 0 0 255.99609375 ECU_ADDRESS 0x01000420 /end MEASUREMENT
/begin COMPU_METHOD Compu_FPin " " RAT_FUNC "%.1" "psia" COEFFS 0 256 0 0 0 1 /end COMPU_METHOD
/begin MEASUREMENT MJ_P_act "EPR feedback press" SWORD Compu_MJ_P_act 0 0 -222 221.993225097656 ECU_ADDRESS 0x01000430 /end MEASUREMENT
/begin COMPU_METHOD Compu_MJ_P_act " " RAT_FUNC "%.2" "in H2O" COEFFS 0 147.603603603604 0 0 0 1 /end COMPU_METHOD
/begin MEASUREMENT MJ_P_cmd "EPR press command" SWORD Compu_MJ_P_cmd 0 0 -222 221.993225097656 ECU_ADDRESS 0x01000438 /end MEASUREMENT
/begin COMPU_METHOD Compu_MJ_P_cmd " " RAT_FUNC "%.2" "in H2O" COEFFS 0 147.603603603604 0 0 0 1 /end COMPU_METHOD
/begin MEASUREMENT MJ_A_act "Legacy EPR duty-cycle feedback" SWORD Compu_MJ_A_act 0 0 -100 99.9969482421875 ECU_ADDRESS 0x01000440 /end MEASUREMENT
/begin COMPU_METHOD Compu_MJ_A_act " " RAT_FUNC "%.3" "%" COEFFS 0 327.68 0 0 0 1 /end COMPU_METHOD
/begin MEASUREMENT MJ_A_cmd "EPR duty-cycle/pulse command" UWORD Compu_MJ_A_cmd 0 0 0 65535 ECU_ADDRESS 0x01000448 /end MEASUREMENT
/begin COMPU_METHOD Compu_MJ_A_cmd " " RAT_FUNC "%.3" "integer" COEFFS 0 1 0 0 0 1 /end COMPU_METHOD
/begin MEASUREMENT ICam_timing_a "Cam1 open actual" SWORD Compu_ICam_timing_a 0 0 -2048 2047.9375 ECU_ADDRESS 0x010004B0 /end MEASUREMENT
/begin COMPU_METHOD Compu_ICam_timing_a " " RAT_FUNC "%.1" "CAD BTDC" COEFFS 0 16 0 0 0 1 /end COMPU_METHOD
/begin MEASUREMENT ECam_timing_a "Cam2 close actual" SWORD Compu_ECam_timing_a 0 0 -2048 2047.9375 ECU_ADDRESS 0x010004B8 /end MEASUREMENT
/begin COMPU_METHOD Compu_ECam_timing_a " " RAT_FUNC "%.1" "CAD BTDC" COEFFS 0 16 0 0 0 1 /end COMPU_METHOD
/begin MEASUREMENT spk_off_global "Global Adv Offset" SWORD Compu_spk_off_global 0 0 -2048 2047.9375 ECU_ADDRESS 0x01000800 /end MEASUREMENT
/begin COMPU_METHOD Compu_spk_off_global " " RAT_FUNC "%.1" "CAD BTDC" COEFFS 0 16 0 0 0 1 /end COMPU_METHOD
/begin CHARACTERISTIC CLp_Emin "CLp_Emin" VALUE 0x00143388 /* @ECU_Address@CLp_Emin@0x01000928@ */ ECIPP_ALIGNMENT_UWORD 200 Compu_CLp_Emin 0 199.996948242188 /end CHARACTERISTIC
/begin COMPU_METHOD Compu_CLp_Emin " " RAT_FUNC "%.1" "%" COEFFS 0 327.68 0 0 0 1 /end COMPU_METHOD
/begin CHARACTERISTIC CLp_Emax "CLp_Emax" VALUE 0x00143386 /* @ECU_Address@CLp_Emax@0x01000930@ */ ECIPP_ALIGNMENT_UWORD 200 Compu_CLp_Emax 0 199.996948242188 /end CHARACTERISTIC
/begin COMPU_METHOD Compu_CLp_Emax " " RAT_FUNC "%.1" "%" COEFFS 0 327.68 0 0 0 1 /end COMPU_METHOD
/begin CHARACTERISTIC CLp_Rp_def "CLp_Rp" VALUE 0x0014338A /* @ECU_Address@CLp_Rp_def@0x01000938@ */ ECIPP_ALIGNMENT_UWORD 100 Compu_CLp_Rp_def 0 99.9984741210938 /end CHARACTERISTIC
/begin COMPU_METHOD Compu_CLp_Rp_def " " RAT_FUNC "%.1" "%" COEFFS 0 655.36 0 0 0 1 /end COMPU_METHOD
/begin CHARACTERISTIC CLp_Rn_def "CLp_Rn" VALUE 0x0014338C /* @ECU_Address@CLp_Rn_def@0x01000940@ */ ECIPP_ALIGNMENT_UWORD 100 Compu_CLp_Rn_def 0 99.9984741210938 /end CHARACTERISTIC
/begin COMPU_METHOD Compu_CLp_Rn_def " " RAT_FUNC "%.1" "%" COEFFS 0 655.36 0 0 0 1 /end COMPU_METHOD
/begin MEASUREMENT CLp_tau "CLp_tau" UWORD Compu_CLp_tau 0 0 0 65535 ECU_ADDRESS 0x01000948 /end MEASUREMENT
/begin COMPU_METHOD Compu_CLp_tau " " RAT_FUNC "%.0" "ms" COEFFS 0 1 0 0 0 1 /end COMPU_METHOD
/begin CHARACTERISTIC CLp_rich_DC "CLp_rich_DC" VALUE 0x0014675c /* @ECU_Address@CLp_rich_DC@0x01000950@ */ ECIPP_ALIGNMENT_UWORD 200 Compu_CLp_rich_DC 0 199.996948242188 /end CHARACTERISTIC
/begin COMPU_METHOD Compu_CLp_rich_DC " " RAT_FUNC "%.1" "%" COEFFS 0 327.68 0 0 0 1 /end COMPU_METHOD
/begin CHARACTERISTIC CLp_lean_DC "CLp_lean_DC" VALUE 0x0014675a /* @ECU_Address@CLp_lean_DC@0x01000958@ */ ECIPP_ALIGNMENT_UWORD 200 Compu_CLp_lean_DC 0 199.996948242188 /end CHARACTERISTIC
/begin COMPU_METHOD Compu_CLp_lean_DC " " RAT_FUNC "%.1" "%" COEFFS 0 327.68 0 0 0 1 /end COMPU_METHOD
/begin MEASUREMENT CLp_Hp "CL1_Hp" UWORD Compu_CLp_Hp 0 0 0 99.9984741210938 ECU_ADDRESS 0x01000960 /end MEASUREMENT
/begin COMPU_METHOD Compu_CLp_Hp " " RAT_FUNC "%.1" "%" COEFFS 0 655.36 0 0 0 1 /end COMPU_METHOD
/begin MEASUREMENT CLp_Hn "CL1_Hn" UWORD Compu_CLp_Hn 0 0 0 99.9984741210938 ECU_ADDRESS 0x01000968 /end MEASUREMENT
/begin COMPU_METHOD Compu_CLp_Hn " " RAT_FUNC "%.1" "%" COEFFS 0 655.36 0 0 0 1 /end COMPU_METHOD
/begin MEASUREMENT CL_ena_value "CL_ena_value" UWORD Compu_CL_ena_value 0 0 0 255.99609375 ECU_ADDRESS 0x01000970 /end MEASUREMENT
/begin COMPU_METHOD Compu_CL_ena_value " " RAT_FUNC "%.2" "logical" COEFFS 0 256 0 0 0 1 /end COMPU_METHOD
/begin CHARACTERISTIC TRIM_trig_chg "Trim disable air transient trigger" VALUE 0x001453b4 /* @ECU_Address@TRIM_trig_chg@0x01000998@ */ ECIPP_ALIGNMENT_SWORD 800 Compu_TRIM_trig_chg -800 799.9755859375 /end CHARACTERISTIC
/begin COMPU_METHOD Compu_TRIM_trig_chg " " RAT_FUNC "%.1" "%" COEFFS 0 40.96 0 0 0 1 /end COMPU_METHOD
/begin CHARACTERISTIC TRIM_period_def "TRIM period" VALUE 0x00147908 /* @ECU_Address@TRIM_period_def@0x01000A30@ */ ECIPP_ALIGNMENT_UWORD 210 Compu_TRIM_period_def 0 209.712 /end CHARACTERISTIC
/begin COMPU_METHOD Compu_TRIM_period_def " " RAT_FUNC "%.1" "ms" COEFFS 0 312.5 0 0 0 1 /end COMPU_METHOD
/begin MEASUREMENT CBT "CBT (catalyst bed temperature)" UWORD Compu_CBT 0 0 -460 7731.875 ECU_ADDRESS 0x01000A38 /end MEASUREMENT
/begin COMPU_METHOD Compu_CBT " " RAT_FUNC "%.0" "deg F" COEFFS 0 8 3680 0 0 1 /end COMPU_METHOD
/begin MEASUREMENT CTM_enrich_mod "CTM enrichment" SWORD Compu_CTM_enrich_mod 0 0 -200 199.993896484375 ECU_ADDRESS 0x01000A40 /end MEASUREMENT
/begin COMPU_METHOD Compu_CTM_enrich_mod " " RAT_FUNC "%.1" "%" COEFFS 0 163.84 0 0 0 1 /end COMPU_METHOD
/begin MEASUREMENT CTM_advance_mod "CTM spark advance" SWORD Compu_CTM_advance_mod 0 0 -2048 2047.9375 ECU_ADDRESS 0x01000A48 /end MEASUREMENT
/begin COMPU_METHOD Compu_CTM_advance_mod " " RAT_FUNC "%.1" "CAD BTDC" COEFFS 0 16 0 0 0 1 /end COMPU_METHOD
/begin CHARACTERISTIC CTM_enr "Gsln CTM max enrichment" VALUE 0x00148CCA /* @ECU_Address@CTM_enr@0x01000A50@ */ ECIPP_ALIGNMENT_SWORD 200 Compu_CTM_enr -200 199.993896484375 /end CHARACTERISTIC
/begin COMPU_METHOD Compu_CTM_enr " " RAT_FUNC "%.1" "%" COEFFS 0 163.84 0 0 0 1 /end COMPU_METHOD
/begin CHARACTERISTIC CTM_adv "Gsln CTM max spark advance" VALUE 0x00148CCC /* @ECU_Address@CTM_adv@0x01000A58@ */ ECIPP_ALIGNMENT_SWORD 2048 Compu_CTM_adv -2048 2047.9375 /end CHARACTERISTIC
/begin COMPU_METHOD Compu_CTM_adv " " RAT_FUNC "%.1" "CAD BTDC" COEFFS 0 16 0 0 0 1 /end COMPU_METHOD
/begin CHARACTERISTIC CTM_tau "Gsln CTM single-pt time constant" VALUE 0x00148CC8 /* @ECU_Address@CTM_tau@0x01000A60@ */ ECIPP_ALIGNMENT_UWORD 66 Compu_CTM_tau 0 65.535 /end CHARACTERISTIC
/begin COMPU_METHOD Compu_CTM_tau " " RAT_FUNC "%.0" "seconds" COEFFS 0 1000 0 0 0 1 /end COMPU_METHOD
/begin CHARACTERISTIC CTM_init "Gsln CTM initiation temperature" VALUE 0x00148CC4 /* @ECU_Address@CTM_init@0x01000A68@ */ ECIPP_ALIGNMENT_UWORD 7732 Compu_CTM_init -460 7731.875 /end CHARACTERISTIC
/begin COMPU_METHOD Compu_CTM_init " " RAT_FUNC "%.0" "deg F" COEFFS 0 8 3680 0 0 1 /end COMPU_METHOD
/begin CHARACTERISTIC CTM_finish "Gsln CTM finish temperature" VALUE 0x00148CC6 /* @ECU_Address@CTM_finish@0x01000A70@ */ ECIPP_ALIGNMENT_UWORD 7732 Compu_CTM_finish -460 7731.875 /end CHARACTERISTIC
/begin COMPU_METHOD Compu_CTM_finish " " RAT_FUNC "%.0" "deg F" COEFFS 0 8 3680 0 0 1 /end COMPU_METHOD
/begin CHARACTERISTIC CTM_ena "CTM control{CTM_ena&0xff=0x00:Disabled}{CTM_ena&0xff=0x01:Enabled}" VALUE 0x00147d02 /* @ECU_Address@CTM_ena@0x01000A78@ */ ECIPP_ALIGNMENT_UBYTE 255 CTM_ena_COMPU_VTAB 0 255 BIT_MASK 0xff /end CHARACTERISTIC
/begin COMPU_METHOD CTM_ena_COMPU_VTAB "Verbal Table" TAB_VERB "%.0" "list" COMPU_TAB_REF CTM_ena_COMPU_VTAB_REF /end COMPU_METHOD
/begin COMPU_VTAB CTM_ena_COMPU_VTAB_REF "Verbal Table" TAB_VERB 2 0x00 "Disabled" 0x01 "Enabled" DEFAULT_VALUE "UNKNOWN" /end COMPU_VTAB
/begin MEASUREMENT Phi_global_offset "Phi_global_offset" SWORD Compu_Phi_global_offset 0 0 -200 199.993896484375 ECU_ADDRESS 0x01000A80 /end MEASUREMENT
/begin COMPU_METHOD Compu_Phi_global_offset " " RAT_FUNC "%.1" "%" COEFFS 0 163.84 0 0 0 1 /end COMPU_METHOD
/begin CHARACTERISTIC MAPdt_CLoff "CL disable MAPdt" VALUE 0x0014435a /* @ECU_Address@MAPdt_CLoff@0x01000AB8@ */ ECIPP_ALIGNMENT_SWORD 4000 Compu_MAPdt_CLoff -4000 3999.8779296875 /end CHARACTERISTIC
/begin COMPU_METHOD Compu_MAPdt_CLoff " " RAT_FUNC "%.1" "psi/sec" COEFFS 0 8.192 0 0 0 1 /end COMPU_METHOD
/begin CHARACTERISTIC K_adapt "K adaptive learn" VALUE 0x00143392 /* @ECU_Address@K_adapt@0x01000B20@ */ ECIPP_ALIGNMENT_SWORD 100 Compu_K_adapt -100 99.9969482421875 /end CHARACTERISTIC
/begin COMPU_METHOD Compu_K_adapt " " RAT_FUNC "%.1" "%" COEFFS 0 327.68 0 0 0 1 /end COMPU_METHOD
/begin CHARACTERISTIC Adapt_pos_lim "Adapt max (Fault Condition:AL_BM >)" VALUE 0x0014338E /* @ECU_Address@Adapt_pos_lim@0x01000B28@ */ ECIPP_ALIGNMENT_SWORD 100 Compu_Adapt_pos_lim -100 99.9969482421875 /end CHARACTERISTIC
/begin COMPU_METHOD Compu_Adapt_pos_lim " " RAT_FUNC "%.1" "%" COEFFS 0 327.68 0 0 0 1 /end COMPU_METHOD
/begin CHARACTERISTIC Adapt_neg_lim "Adapt min (Fault Condition:AL_BM <)" VALUE 0x00143390 /* @ECU_Address@Adapt_neg_lim@0x01000B30@ */ ECIPP_ALIGNMENT_SWORD 100 Compu_Adapt_neg_lim -100 99.9969482421875 /end CHARACTERISTIC
/begin COMPU_METHOD Compu_Adapt_neg_lim " " RAT_FUNC "%.1" "%" COEFFS 0 327.68 0 0 0 1 /end COMPU_METHOD
/begin CHARACTERISTIC Adapt_stepmax "Adapt stepmax" VALUE 0x00143394 /* @ECU_Address@Adapt_stepmax@0x01000B38@ */ ECIPP_ALIGNMENT_UWORD 200 Compu_Adapt_stepmax 0 199.996948242188 /end CHARACTERISTIC
/begin COMPU_METHOD Compu_Adapt_stepmax " " RAT_FUNC "%.1" "%" COEFFS 0 327.68 0 0 0 1 /end COMPU_METHOD
/begin CHARACTERISTIC Adapt_dzone "Adapt deadzone" VALUE 0x00143396 /* @ECU_Address@Adapt_dzone@0x01000B40@ */ ECIPP_ALIGNMENT_UWORD 200 Compu_Adapt_dzone 0 199.996948242188 /end CHARACTERISTIC
/begin COMPU_METHOD Compu_Adapt_dzone " " RAT_FUNC "%.1" "%" COEFFS 0 327.68 0 0 0 1 /end COMPU_METHOD
/begin CHARACTERISTIC Adapt_valid "Adaptive update validation error" VALUE 0x00143398 /* @ECU_Address@Adapt_valid@0x01000B48@ */ ECIPP_ALIGNMENT_SWORD 100 Compu_Adapt_valid -100 99.9969482421875 /end CHARACTERISTIC
/begin COMPU_METHOD Compu_Adapt_valid " " RAT_FUNC "%.1" "%" COEFFS 0 327.68 0 0 0 1 /end COMPU_METHOD
/begin CHARACTERISTIC Adapt_wait "Valid adaptive cycles min" VALUE 0x0014339A /* @ECU_Address@Adapt_wait@0x01000B50@ */ ECIPP_ALIGNMENT_UBYTE 255 Compu_Adapt_wait 0 255 /end CHARACTERISTIC
/begin COMPU_METHOD Compu_Adapt_wait " " RAT_FUNC "%.0" "count" COEFFS 0 1 0 0 0 1 /end COMPU_METHOD
/begin CHARACTERISTIC K_CL_acquire "K_CL_acquire" VALUE 0x00143382 /* @ECU_Address@K_CL_acquire@0x01000B58@ */ ECIPP_ALIGNMENT_SWORD 100 Compu_K_CL_acquire -100 99.9969482421875 /end CHARACTERISTIC
/begin COMPU_METHOD Compu_K_CL_acquire " " RAT_FUNC "%.1" "%" COEFFS 0 327.68 0 0 0 1 /end COMPU_METHOD
/begin CHARACTERISTIC K_CL "K_CL_switching" VALUE 0x00143380 /* @ECU_Address@K_CL@0x01000B60@ */ ECIPP_ALIGNMENT_SWORD 100 Compu_K_CL -100 99.9969482421875 /end CHARACTERISTIC
/begin COMPU_METHOD Compu_K_CL " " RAT_FUNC "%.1" "%" COEFFS 0 327.68 0 0 0 1 /end COMPU_METHOD
/begin CHARACTERISTIC CL_BM_max "CL max (Fault Condition:CL_BM >)" VALUE 0x0014337C /* @ECU_Address@CL_BM_max@0x01000B68@ */ ECIPP_ALIGNMENT_SWORD 100 Compu_CL_BM_max -100 99.9969482421875 /end CHARACTERISTIC
/begin COMPU_METHOD Compu_CL_BM_max " " RAT_FUNC "%.1" "%" COEFFS 0 327.68 0 0 0 1 /end COMPU_METHOD
/begin CHARACTERISTIC CL_BM_min "CL min (Fault Condition:CL_BM <)" VALUE 0x0014337E /* @ECU_Address@CL_BM_min@0x01000B70@ */ ECIPP_ALIGNMENT_SWORD 100 Compu_CL_BM_min -100 99.9969482421875 /end CHARACTERISTIC
/begin COMPU_METHOD Compu_CL_BM_min " " RAT_FUNC "%.1" "%" COEFFS 0 327.68 0 0 0 1 /end COMPU_METHOD
/begin CHARACTERISTIC CL_stepmax "CL_stepmax" VALUE 0x00143384 /* @ECU_Address@CL_stepmax@0x01000B78@ */ ECIPP_ALIGNMENT_SWORD 100 Compu_CL_stepmax -100 99.9969482421875 /end CHARACTERISTIC
/begin COMPU_METHOD Compu_CL_stepmax " " RAT_FUNC "%.1" "%" COEFFS 0 327.68 0 0 0 1 /end COMPU_METHOD
/begin MEASUREMENT AL_temp_wait_tmr "AL_temp_wait_tmr" UWORD Compu_AL_temp_wait_tmr 0 0 0 65535 ECU_ADDRESS 0x01000B88 /end MEASUREMENT
/begin COMPU_METHOD Compu_AL_temp_wait_tmr " " RAT_FUNC "%.0" "ms" COEFFS 0 1 0 0 0 1 /end COMPU_METHOD
/begin MEASUREMENT Adapt1_valid_cnt "Adapt1 valid count" UBYTE Compu_Adapt1_valid_cnt 0 0 0 255 ECU_ADDRESS 0x01000B90 /end MEASUREMENT
/begin COMPU_METHOD Compu_Adapt1_valid_cnt " " RAT_FUNC "%.0" "count" COEFFS 0 1 0 0 0 1 /end COMPU_METHOD
/begin MEASUREMENT TRIM_mode "TRIM mode{TRIM_mode&0xff=0x00:Auto}{TRIM_mode&0xff=0x01:Manual}" UBYTE TRIM_mode_COMPU_VTAB 0 0 0 255 ECU_ADDRESS 0x01000BB0 BIT_MASK 0xff /end MEASUREMENT
/begin COMPU_METHOD TRIM_mode_COMPU_VTAB "Verbal Table" TAB_VERB "%.0" "list" COMPU_TAB_REF TRIM_mode_COMPU_VTAB_REF /end COMPU_METHOD
/begin COMPU_VTAB TRIM_mode_COMPU_VTAB_REF "Verbal Table" TAB_VERB 2 0x00 "Auto" 0x01 "Manual" DEFAULT_VALUE "UNKNOWN" /end COMPU_VTAB
/begin CHARACTERISTIC CTMA_enr "Alt CTM max enrichment" VALUE 0x00148CAA /* @ECU_Address@CTMA_enr@0x01000C88@ */ ECIPP_ALIGNMENT_SWORD 200 Compu_CTMA_enr -200 199.993896484375 /end CHARACTERISTIC
/begin COMPU_METHOD Compu_CTMA_enr " " RAT_FUNC "%.1" "%" COEFFS 0 163.84 0 0 0 1 /end COMPU_METHOD
/begin CHARACTERISTIC CTMA_adv "Alt CTM max spark advance" VALUE 0x00148CAC /* @ECU_Address@CTMA_adv@0x01000C90@ */ ECIPP_ALIGNMENT_SWORD 2048 Compu_CTMA_adv -2048 2047.9375 /end CHARACTERISTIC
/begin COMPU_METHOD Compu_CTMA_adv " " RAT_FUNC "%.1" "CAD BTDC" COEFFS 0 16 0 0 0 1 /end COMPU_METHOD
/begin CHARACTERISTIC CTMA_tau "Alt CTM single-pt time constant" VALUE 0x00148CA8 /* @ECU_Address@CTMA_tau@0x01000C98@ */ ECIPP_ALIGNMENT_UWORD 66 Compu_CTMA_tau 0 65.535 /end CHARACTERISTIC
/begin COMPU_METHOD Compu_CTMA_tau " " RAT_FUNC "%.0" "seconds" COEFFS 0 1000 0 0 0 1 /end COMPU_METHOD
/begin CHARACTERISTIC CTMA_init "Alt CTM initiation temperature" VALUE 0x00148CA4 /* @ECU_Address@CTMA_init@0x01000CA0@ */ ECIPP_ALIGNMENT_UWORD 7732 Compu_CTMA_init -460 7731.875 /end CHARACTERISTIC
/begin COMPU_METHOD Compu_CTMA_init " " RAT_FUNC "%.0" "deg F" COEFFS 0 8 3680 0 0 1 /end COMPU_METHOD
/begin CHARACTERISTIC CTMA_finish "Alt CTM finish temperature" VALUE 0x00148CA6 /* @ECU_Address@CTMA_finish@0x01000CA8@ */ ECIPP_ALIGNMENT_UWORD 7732 Compu_CTMA_finish -460 7731.875 /end CHARACTERISTIC
/begin COMPU_METHOD Compu_CTMA_finish " " RAT_FUNC "%.0" "deg F" COEFFS 0 8 3680 0 0 1 /end COMPU_METHOD
/begin MEASUREMENT CL_inact_force "Force CL inactive{CL_inact_force&0xff=0x00:Normal}{CL_inact_force&0xff=0x01:Force CL Inactive}" UBYTE CL_inact_force_COMPU_VTAB 0 0 0 255 ECU_ADDRESS 0x01000F10 BIT_MASK 0xff /end MEASUREMENT
/begin COMPU_METHOD CL_inact_force_COMPU_VTAB "Verbal Table" TAB_VERB "%.0" "list" COMPU_TAB_REF CL_inact_force_COMPU_VTAB_REF /end COMPU_METHOD
/begin COMPU_VTAB CL_inact_force_COMPU_VTAB_REF "Verbal Table" TAB_VERB 2 0x00 "Normal" 0x01 "Force CL Inactive" DEFAULT_VALUE "UNKNOWN" /end COMPU_VTAB
/begin CHARACTERISTIC TRIM_dis_hold "Trim disable hold time" VALUE 0x00147904 /* @ECU_Address@TRIM_dis_hold@0x01000F18@ */ ECIPP_ALIGNMENT_UWORD 65535 Compu_TRIM_dis_hold 0 65535 /end CHARACTERISTIC
/begin COMPU_METHOD Compu_TRIM_dis_hold " " RAT_FUNC "%.0" "ms" COEFFS 0 1 0 0 0 1 /end COMPU_METHOD
/begin CHARACTERISTIC mda_trans_tau "mdot throttle air transient tau" VALUE 0x00147cba /* @ECU_Address@mda_trans_tau@0x01000F28@ */ ECIPP_ALIGNMENT_UWORD 327680 Compu_mda_trans_tau 0.45084 327680 /end CHARACTERISTIC
/begin COMPU_METHOD Compu_mda_trans_tau " " FORM "%.0" "ms"
 /begin FORMULA "-5 / log(1 - (X1 / 65536))" FORMULA_INV "(1 - exp(-5/X1)) * 65536" /end FORMULA
/end COMPU_METHOD
/begin CHARACTERISTIC TRIM_trans_dis "TRIM transient compensation{TRIM_trans_dis&0xff=0x00:Enabled}{TRIM_trans_dis&0xff=0x01:Disabled}" VALUE 0x001480b6 /* @ECU_Address@TRIM_trans_dis@0x01000F70@ */ ECIPP_ALIGNMENT_UBYTE 255 TRIM_trans_dis_COMPU_VTAB 0 255 BIT_MASK 0xff /end CHARACTERISTIC
/begin COMPU_METHOD TRIM_trans_dis_COMPU_VTAB "Verbal Table" TAB_VERB "%.0" "list" COMPU_TAB_REF TRIM_trans_dis_COMPU_VTAB_REF /end COMPU_METHOD
/begin COMPU_VTAB TRIM_trans_dis_COMPU_VTAB_REF "Verbal Table" TAB_VERB 2 0x00 "Enabled" 0x01 "Disabled" DEFAULT_VALUE "UNKNOWN" /end COMPU_VTAB
/begin CHARACTERISTIC trim_nom_crkP "Trim valve cranking nominal" VALUE 0x001418aa /* @ECU_Address@trim_nom_crkP@0x01000FB0@ */ ECIPP_ALIGNMENT_SWORD 200 Compu_trim_nom_crkP -200 199.993896484375 /end CHARACTERISTIC
/begin COMPU_METHOD Compu_trim_nom_crkP " " RAT_FUNC "%.1" "%" COEFFS 0 163.84 0 0 0 1 /end COMPU_METHOD
/begin MEASUREMENT Adapt2_valid_cnt "Adapt2 valid count" UBYTE Compu_Adapt2_valid_cnt 0 0 0 255 ECU_ADDRESS 0x01000FC0 /end MEASUREMENT
/begin COMPU_METHOD Compu_Adapt2_valid_cnt " " RAT_FUNC "%.0" "count" COEFFS 0 1 0 0 0 1 /end COMPU_METHOD
/begin CHARACTERISTIC CLLP_hi "CL max (Fault Condition:CL_BM >)" VALUE 0x001418C4 /* @ECU_Address@CLLP_hi@0x01000FC8@ */ ECIPP_ALIGNMENT_SWORD 100 Compu_CLLP_hi -100 99.9969482421875 /end CHARACTERISTIC
/begin COMPU_METHOD Compu_CLLP_hi " " RAT_FUNC "%.1" "%" COEFFS 0 327.68 0 0 0 1 /end COMPU_METHOD
/begin CHARACTERISTIC CLLP_lo "CL min (Fault Condition:CL_BM <)" VALUE 0x001418C6 /* @ECU_Address@CLLP_lo@0x01000FD0@ */ ECIPP_ALIGNMENT_SWORD 100 Compu_CLLP_lo -100 99.9969482421875 /end CHARACTERISTIC
/begin COMPU_METHOD Compu_CLLP_lo " " RAT_FUNC "%.1" "%" COEFFS 0 327.68 0 0 0 1 /end COMPU_METHOD
/begin CHARACTERISTIC CLLP_K "K_CL_switching" VALUE 0x001418C8 /* @ECU_Address@CLLP_K@0x01000FD8@ */ ECIPP_ALIGNMENT_SWORD 100 Compu_CLLP_K -100 99.9969482421875 /end CHARACTERISTIC
/begin COMPU_METHOD Compu_CLLP_K " " RAT_FUNC "%.1" "%" COEFFS 0 327.68 0 0 0 1 /end COMPU_METHOD
/begin CHARACTERISTIC CLLP_K_acquire "K_CL_acquire" VALUE 0x001418CA /* @ECU_Address@CLLP_K_acquire@0x01000FE0@ */ ECIPP_ALIGNMENT_SWORD 100 Compu_CLLP_K_acquire -100 99.9969482421875 /end CHARACTERISTIC
/begin COMPU_METHOD Compu_CLLP_K_acquire " " RAT_FUNC "%.1" "%" COEFFS 0 327.68 0 0 0 1 /end COMPU_METHOD
/begin CHARACTERISTIC CLLP_stepmax "CL_stepmax" VALUE 0x001418CC /* @ECU_Address@CLLP_stepmax@0x01000FE8@ */ ECIPP_ALIGNMENT_SWORD 100 Compu_CLLP_stepmax -100 99.9969482421875 /end CHARACTERISTIC
/begin COMPU_METHOD Compu_CLLP_stepmax " " RAT_FUNC "%.1" "%" COEFFS 0 327.68 0 0 0 1 /end COMPU_METHOD
/begin CHARACTERISTIC CLpLP_Emax "CLp_Emax" VALUE 0x001418CE /* @ECU_Address@CLpLP_Emax@0x01000FF0@ */ ECIPP_ALIGNMENT_UWORD 200 Compu_CLpLP_Emax 0 199.996948242188 /end CHARACTERISTIC
/begin COMPU_METHOD Compu_CLpLP_Emax " " RAT_FUNC "%.1" "%" COEFFS 0 327.68 0 0 0 1 /end COMPU_METHOD
/begin CHARACTERISTIC CLpLP_Emin "CLp_Emin" VALUE 0x001418D0 /* @ECU_Address@CLpLP_Emin@0x01000FF8@ */ ECIPP_ALIGNMENT_UWORD 200 Compu_CLpLP_Emin 0 199.996948242188 /end CHARACTERISTIC
/begin COMPU_METHOD Compu_CLpLP_Emin " " RAT_FUNC "%.1" "%" COEFFS 0 327.68 0 0 0 1 /end COMPU_METHOD
/begin CHARACTERISTIC CLpLP_Rp_def "CLp_Rp" VALUE 0x001418D2 /* @ECU_Address@CLpLP_Rp_def@0x01001000@ */ ECIPP_ALIGNMENT_UWORD 100 Compu_CLpLP_Rp_def 0 99.9984741210938 /end CHARACTERISTIC
/begin COMPU_METHOD Compu_CLpLP_Rp_def " " RAT_FUNC "%.1" "%" COEFFS 0 655.36 0 0 0 1 /end COMPU_METHOD
/begin CHARACTERISTIC CLpLP_Rn_def "CLp_Rn" VALUE 0x001418D4 /* @ECU_Address@CLpLP_Rn_def@0x01001008@ */ ECIPP_ALIGNMENT_UWORD 100 Compu_CLpLP_Rn_def 0 99.9984741210938 /end CHARACTERISTIC
/begin COMPU_METHOD Compu_CLpLP_Rn_def " " RAT_FUNC "%.1" "%" COEFFS 0 655.36 0 0 0 1 /end COMPU_METHOD
/begin CHARACTERISTIC ALLP_hi "Adapt max (Fault Condition:AL_BM >)" VALUE 0x001418D6 /* @ECU_Address@ALLP_hi@0x01001010@ */ ECIPP_ALIGNMENT_SWORD 100 Compu_ALLP_hi -100 99.9969482421875 /end CHARACTERISTIC
/begin COMPU_METHOD Compu_ALLP_hi " " RAT_FUNC "%.1" "%" COEFFS 0 327.68 0 0 0 1 /end COMPU_METHOD
/begin CHARACTERISTIC ALLP_lo "Adapt min (Fault Condition:AL_BM <)" VALUE 0x001418D8 /* @ECU_Address@ALLP_lo@0x01001018@ */ ECIPP_ALIGNMENT_SWORD 100 Compu_ALLP_lo -100 99.9969482421875 /end CHARACTERISTIC
/begin COMPU_METHOD Compu_ALLP_lo " " RAT_FUNC "%.1" "%" COEFFS 0 327.68 0 0 0 1 /end COMPU_METHOD
/begin CHARACTERISTIC ALLP_K "K adaptive learn" VALUE 0x001418DA /* @ECU_Address@ALLP_K@0x01001020@ */ ECIPP_ALIGNMENT_SWORD 100 Compu_ALLP_K -100 99.9969482421875 /end CHARACTERISTIC
/begin COMPU_METHOD Compu_ALLP_K " " RAT_FUNC "%.1" "%" COEFFS 0 327.68 0 0 0 1 /end COMPU_METHOD
/begin CHARACTERISTIC ALLP_stepmax "Adapt stepmax" VALUE 0x001418DC /* @ECU_Address@ALLP_stepmax@0x01001028@ */ ECIPP_ALIGNMENT_UWORD 200 Compu_ALLP_stepmax 0 199.996948242188 /end CHARACTERISTIC
/begin COMPU_METHOD Compu_ALLP_stepmax " " RAT_FUNC "%.1" "%" COEFFS 0 327.68 0 0 0 1 /end COMPU_METHOD
/begin CHARACTERISTIC ALLP_dzone "Adapt deadzone" VALUE 0x001418DE /* @ECU_Address@ALLP_dzone@0x01001030@ */ ECIPP_ALIGNMENT_UWORD 200 Compu_ALLP_dzone 0 199.996948242188 /end CHARACTERISTIC
/begin COMPU_METHOD Compu_ALLP_dzone " " RAT_FUNC "%.1" "%" COEFFS 0 327.68 0 0 0 1 /end COMPU_METHOD
/begin CHARACTERISTIC ALLP_valid "Adaptive update validation error" VALUE 0x001418E0 /* @ECU_Address@ALLP_valid@0x01001038@ */ ECIPP_ALIGNMENT_SWORD 100 Compu_ALLP_valid -100 99.9969482421875 /end CHARACTERISTIC
/begin COMPU_METHOD Compu_ALLP_valid " " RAT_FUNC "%.1" "%" COEFFS 0 327.68 0 0 0 1 /end COMPU_METHOD
/begin CHARACTERISTIC ALLP_wait "Valid adaptive cycles min" VALUE 0x001418E2 /* @ECU_Address@ALLP_wait@0x01001040@ */ ECIPP_ALIGNMENT_UBYTE 255 Compu_ALLP_wait 0 255 /end CHARACTERISTIC
/begin COMPU_METHOD Compu_ALLP_wait " " RAT_FUNC "%.0" "count" COEFFS 0 1 0 0 0 1 /end COMPU_METHOD
/begin MEASUREMENT UEGO_mode "UEGO mode{UEGO_mode&0xff=0xfe:Invalid}{UEGO_mode&0xff=0xff:Fault}{UEGO_mode&0xff=0x00:Off}{UEGO_mode&0xff=0x01:Warming}{UEGO_mode&0xff=0x02:Waiting}{UEGO_mode&0xff=0x03:Active}" UBYTE UEGO_mode_COMPU_VTAB 0 0 0 255 ECU_ADDRESS 0x01001240 BIT_MASK 0xff /end MEASUREMENT
/begin COMPU_METHOD UEGO_mode_COMPU_VTAB "Verbal Table" TAB_VERB "%.0" "list" COMPU_TAB_REF UEGO_mode_COMPU_VTAB_REF /end COMPU_METHOD
/begin COMPU_VTAB UEGO_mode_COMPU_VTAB_REF "Verbal Table" TAB_VERB 6 0xfe "Invalid" 0xff "Fault" 0x00 "Off" 0x01 "Warming" 0x02 "Waiting" 0x03 "Active" DEFAULT_VALUE "UNKNOWN" /end COMPU_VTAB
/begin CHARACTERISTIC CL_dis_Gsln "Gasoline CL Control{CL_dis_Gsln&0xff=0x00:Enabled}{CL_dis_Gsln&0xff=0x01:Disabled}" VALUE 0x00147CF9 /* @ECU_Address@CL_dis_Gsln@0x010013B8@ */ ECIPP_ALIGNMENT_UBYTE 255 CL_dis_Gsln_COMPU_VTAB 0 255 BIT_MASK 0xff /end CHARACTERISTIC
/begin COMPU_METHOD CL_dis_Gsln_COMPU_VTAB "Verbal Table" TAB_VERB "%.0" "list" COMPU_TAB_REF CL_dis_Gsln_COMPU_VTAB_REF /end COMPU_METHOD
/begin COMPU_VTAB CL_dis_Gsln_COMPU_VTAB_REF "Verbal Table" TAB_VERB 2 0x00 "Enabled" 0x01 "Disabled" DEFAULT_VALUE "UNKNOWN" /end COMPU_VTAB
/begin CHARACTERISTIC CL_dis_LP "LPG CL Control{CL_dis_LP&0xff=0x00:Enabled}{CL_dis_LP&0xff=0x01:Disabled}" VALUE 0x00147CFA /* @ECU_Address@CL_dis_LP@0x010013C0@ */ ECIPP_ALIGNMENT_UBYTE 255 CL_dis_LP_COMPU_VTAB 0 255 BIT_MASK 0xff /end CHARACTERISTIC
/begin COMPU_METHOD CL_dis_LP_COMPU_VTAB "Verbal Table" TAB_VERB "%.0" "list" COMPU_TAB_REF CL_dis_LP_COMPU_VTAB_REF /end COMPU_METHOD
/begin COMPU_VTAB CL_dis_LP_COMPU_VTAB_REF "Verbal Table" TAB_VERB 2 0x00 "Enabled" 0x01 "Disabled" DEFAULT_VALUE "UNKNOWN" /end COMPU_VTAB
/begin MEASUREMENT FP_crct "Fuel pressure correction" UWORD Compu_FP_crct 0 0 0 1.99996948242188 ECU_ADDRESS 0x01001C68 /end MEASUREMENT
/begin COMPU_METHOD Compu_FP_crct " " RAT_FUNC "%.3" "fraction" COEFFS 0 32768 0 0 0 1 /end COMPU_METHOD
/begin MEASUREMENT EBP_gauge "EBP gauge" UWORD Compu_EBP_gauge 0 0 0 255.99609375 ECU_ADDRESS 0x01001C88 /end MEASUREMENT
/begin COMPU_METHOD Compu_EBP_gauge " " RAT_FUNC "%.2" "psig" COEFFS 0 256 0 0 0 1 /end COMPU_METHOD
/begin CHARACTERISTIC CTM_CL_ena "CTM CL control{CTM_CL_ena&0xff=0:Disabled}{CTM_CL_ena&0xff=1:Enabled}" VALUE 0x00148CE1 /* @ECU_Address@CTM_CL_ena@0x01001E00@ */ ECIPP_ALIGNMENT_UBYTE 255 CTM_CL_ena_COMPU_VTAB 0 255 BIT_MASK 0xff /end CHARACTERISTIC
/begin COMPU_METHOD CTM_CL_ena_COMPU_VTAB "Verbal Table" TAB_VERB "%.0" "list" COMPU_TAB_REF CTM_CL_ena_COMPU_VTAB_REF /end COMPU_METHOD
/begin COMPU_VTAB CTM_CL_ena_COMPU_VTAB_REF "Verbal Table" TAB_VERB 2 0 "Disabled" 1 "Enabled" DEFAULT_VALUE "UNKNOWN" /end COMPU_VTAB
/begin CHARACTERISTIC CTM_CL_space "CTM CL pulse spacing" VALUE 0x00148CD0 /* @ECU_Address@CTM_CL_space@0x01001E08@ */ ECIPP_ALIGNMENT_UWORD 66 Compu_CTM_CL_space 0 65.535 /end CHARACTERISTIC
/begin COMPU_METHOD Compu_CTM_CL_space " " RAT_FUNC "%.1" "sec" COEFFS 0 1000 0 0 0 1 /end COMPU_METHOD
/begin CHARACTERISTIC CTM_CL_ramp "CTM CL ramp rate" VALUE 0x00148CD4 /* @ECU_Address@CTM_CL_ramp@0x01001E10@ */ ECIPP_ALIGNMENT_UWORD 781 Compu_CTM_CL_ramp 0 781.238079071045 /end CHARACTERISTIC
/begin COMPU_METHOD Compu_CTM_CL_ramp " " RAT_FUNC "%.1" "% / sec" COEFFS 0 83.88608 0 0 0 1 /end COMPU_METHOD
/begin CHARACTERISTIC CTM_CL_UL "CTM CL max excursion" VALUE 0x00148CD6 /* @ECU_Address@CTM_CL_UL@0x01001E18@ */ ECIPP_ALIGNMENT_UWORD 200 Compu_CTM_CL_UL 0 199.996948242188 /end CHARACTERISTIC
/begin COMPU_METHOD Compu_CTM_CL_UL " " RAT_FUNC "%.1" "%" COEFFS 0 327.68 0 0 0 1 /end COMPU_METHOD
/begin MEASUREMENT CTM_CL_BM "CTM CL_BM" SWORD Compu_CTM_CL_BM 0 0 -100 99.9969482421875 ECU_ADDRESS 0x01001E20 /end MEASUREMENT
/begin COMPU_METHOD Compu_CTM_CL_BM " " RAT_FUNC "%.1" "%" COEFFS 0 327.68 0 0 0 1 /end COMPU_METHOD
/begin MEASUREMENT TRIM_nom_DC "TRIM nominal DC" UWORD Compu_TRIM_nom_DC 0 0 0 99.9984741210938 ECU_ADDRESS 0x01001E28 /end MEASUREMENT
/begin COMPU_METHOD Compu_TRIM_nom_DC " " RAT_FUNC "%.1" "%" COEFFS 0 655.36 0 0 0 1 /end COMPU_METHOD
/begin MEASUREMENT TRIM_nom_phi "TRIM nominal phi" UWORD Compu_TRIM_nom_phi 0 0 0 3.99993896484375 ECU_ADDRESS 0x01001E30 /end MEASUREMENT
/begin COMPU_METHOD Compu_TRIM_nom_phi " " RAT_FUNC "%.3" "phi" COEFFS 0 16384 0 0 0 1 /end COMPU_METHOD
/begin MEASUREMENT TRIM_sens "TRIM sensitivity" SWORD Compu_TRIM_sens 0 0 -0.2 0.199993896484375 ECU_ADDRESS 0x01001E38 /end MEASUREMENT
/begin COMPU_METHOD Compu_TRIM_sens " " RAT_FUNC "%.3" "dphi / 10% DC" COEFFS 0 163840 0 0 0 1 /end COMPU_METHOD
/begin CHARACTERISTIC CTMA_CL_ena "CTM CL control{CTMA_CL_ena&0xff=0:Disabled}{CTMA_CL_ena&0xff=1:Enabled}" VALUE 0x00148CC1 /* @ECU_Address@CTMA_CL_ena@0x01001E40@ */ ECIPP_ALIGNMENT_UBYTE 255 CTMA_CL_ena_COMPU_VTAB 0 255 BIT_MASK 0xff /end CHARACTERISTIC
/begin COMPU_METHOD CTMA_CL_ena_COMPU_VTAB "Verbal Table" TAB_VERB "%.0" "list" COMPU_TAB_REF CTMA_CL_ena_COMPU_VTAB_REF /end COMPU_METHOD
/begin COMPU_VTAB CTMA_CL_ena_COMPU_VTAB_REF "Verbal Table" TAB_VERB 2 0 "Disabled" 1 "Enabled" DEFAULT_VALUE "UNKNOWN" /end COMPU_VTAB
/begin CHARACTERISTIC CTMA_CL_space "CTM CL pulse spacing" VALUE 0x00148CB0 /* @ECU_Address@CTMA_CL_space@0x01001E48@ */ ECIPP_ALIGNMENT_UWORD 66 Compu_CTMA_CL_space 0 65.535 /end CHARACTERISTIC
/begin COMPU_METHOD Compu_CTMA_CL_space " " RAT_FUNC "%.1" "sec" COEFFS 0 1000 0 0 0 1 /end COMPU_METHOD
/begin CHARACTERISTIC CTMA_CL_ramp "CTM CL ramp rate" VALUE 0x00148CB4 /* @ECU_Address@CTMA_CL_ramp@0x01001E50@ */ ECIPP_ALIGNMENT_UWORD 781 Compu_CTMA_CL_ramp 0 781.238079071045 /end CHARACTERISTIC
/begin COMPU_METHOD Compu_CTMA_CL_ramp " " RAT_FUNC "%.1" "% / sec" COEFFS 0 83.88608 0 0 0 1 /end COMPU_METHOD
/begin CHARACTERISTIC CTMA_CL_UL "CTM CL max excursion" VALUE 0x00148CB6 /* @ECU_Address@CTMA_CL_UL@0x01001E58@ */ ECIPP_ALIGNMENT_UWORD 200 Compu_CTMA_CL_UL 0 199.996948242188 /end CHARACTERISTIC
/begin COMPU_METHOD Compu_CTMA_CL_UL " " RAT_FUNC "%.1" "%" COEFFS 0 327.68 0 0 0 1 /end COMPU_METHOD
/begin CHARACTERISTIC CTM_phi_lim "CTM phi upper limit" VALUE 0x00148CCE /* @ECU_Address@CTM_phi_lim@0x01001E60@ */ ECIPP_ALIGNMENT_UWORD 4 Compu_CTM_phi_lim 0 3.99993896484375 /end CHARACTERISTIC
/begin COMPU_METHOD Compu_CTM_phi_lim " " RAT_FUNC "%.3" "phi" COEFFS 0 16384 0 0 0 1 /end COMPU_METHOD
/begin CHARACTERISTIC CTMA_phi_lim "CTM phi upper limit" VALUE 0x00148CAE /* @ECU_Address@CTMA_phi_lim@0x01001E68@ */ ECIPP_ALIGNMENT_UWORD 4 Compu_CTMA_phi_lim 0 3.99993896484375 /end CHARACTERISTIC
/begin COMPU_METHOD Compu_CTMA_phi_lim " " RAT_FUNC "%.3" "phi" COEFFS 0 16384 0 0 0 1 /end COMPU_METHOD
/begin CHARACTERISTIC CTM_CL_tgEGO "CTM CL trigger EGO" VALUE 0x00148CDA /* @ECU_Address@CTM_CL_tgEGO@0x01001E70@ */ ECIPP_ALIGNMENT_UWORD 16000 Compu_CTM_CL_tgEGO 0 15999.755859375 /end CHARACTERISTIC
/begin COMPU_METHOD Compu_CTM_CL_tgEGO " " RAT_FUNC "%.0" "mV" COEFFS 0 4.096 0 0 0 1 /end COMPU_METHOD
/begin CHARACTERISTIC CTM_CL_tgphi "CTM CL trigger phi" VALUE 0x00148CD8 /* @ECU_Address@CTM_CL_tgphi@0x01001E78@ */ ECIPP_ALIGNMENT_UWORD 4 Compu_CTM_CL_tgphi 0 3.99993896484375 /end CHARACTERISTIC
/begin COMPU_METHOD Compu_CTM_CL_tgphi " " RAT_FUNC "%.3" "phi" COEFFS 0 16384 0 0 0 1 /end COMPU_METHOD
/begin CHARACTERISTIC CTM_CL_forcewt "CTM CL pulse force wait" VALUE 0x00148CD2 /* @ECU_Address@CTM_CL_forcewt@0x01001E80@ */ ECIPP_ALIGNMENT_UWORD 66 Compu_CTM_CL_forcewt 0 65.535 /end CHARACTERISTIC
/begin COMPU_METHOD Compu_CTM_CL_forcewt " " RAT_FUNC "%.1" "sec" COEFFS 0 1000 0 0 0 1 /end COMPU_METHOD
/begin CHARACTERISTIC CTMA_CL_tgEGO "CTM CL trigger EGO" VALUE 0x00148CBA /* @ECU_Address@CTMA_CL_tgEGO@0x01001E88@ */ ECIPP_ALIGNMENT_UWORD 16000 Compu_CTMA_CL_tgEGO 0 15999.755859375 /end CHARACTERISTIC
/begin COMPU_METHOD Compu_CTMA_CL_tgEGO " " RAT_FUNC "%.0" "mV" COEFFS 0 4.096 0 0 0 1 /end COMPU_METHOD
/begin CHARACTERISTIC CTMA_CL_tgphi "CTM CL trigger phi" VALUE 0x00148CB8 /* @ECU_Address@CTMA_CL_tgphi@0x01001E90@ */ ECIPP_ALIGNMENT_UWORD 4 Compu_CTMA_CL_tgphi 0 3.99993896484375 /end CHARACTERISTIC
/begin COMPU_METHOD Compu_CTMA_CL_tgphi " " RAT_FUNC "%.3" "phi" COEFFS 0 16384 0 0 0 1 /end COMPU_METHOD
/begin CHARACTERISTIC CTMA_CL_forcewt "CTM CL pulse force wait" VALUE 0x00148CB2 /* @ECU_Address@CTMA_CL_forcewt@0x01001E98@ */ ECIPP_ALIGNMENT_UWORD 66 Compu_CTMA_CL_forcewt 0 65.535 /end CHARACTERISTIC
/begin COMPU_METHOD Compu_CTMA_CL_forcewt " " RAT_FUNC "%.1" "sec" COEFFS 0 1000 0 0 0 1 /end COMPU_METHOD
/begin CHARACTERISTIC trim_LP_min "Trim valve minimum duty-cycle" VALUE 0x001418bc /* @ECU_Address@trim_LP_min@0x01001EA0@ */ ECIPP_ALIGNMENT_UWORD 100 Compu_trim_LP_min 0 99.9984741210938 /end CHARACTERISTIC
/begin COMPU_METHOD Compu_trim_LP_min " " RAT_FUNC "%.1" "%" COEFFS 0 655.36 0 0 0 1 /end COMPU_METHOD
/begin CHARACTERISTIC trim_LP_max "Trim valve maximum duty-cycle" VALUE 0x001418ba /* @ECU_Address@trim_LP_max@0x01001EA8@ */ ECIPP_ALIGNMENT_UWORD 100 Compu_trim_LP_max 0 99.9984741210938 /end CHARACTERISTIC
/begin COMPU_METHOD Compu_trim_LP_max " " RAT_FUNC "%.1" "%" COEFFS 0 655.36 0 0 0 1 /end COMPU_METHOD
/begin MEASUREMENT CLp_wave_RMS "CL1 perturbation wave RMS" UWORD Compu_CLp_wave_RMS 0 0 0 3.99993896484375 ECU_ADDRESS 0x01001EC8 /end MEASUREMENT
/begin COMPU_METHOD Compu_CLp_wave_RMS " " RAT_FUNC "%.3" "phi" COEFFS 0 16384 0 0 0 1 /end COMPU_METHOD
/begin MEASUREMENT CM1_RMScomp "CM1 current RMS limit" UWORD Compu_CM1_RMScomp 0 0 0 3.99993896484375 ECU_ADDRESS 0x01001ED0 /end MEASUREMENT
/begin COMPU_METHOD Compu_CM1_RMScomp " " RAT_FUNC "%.3" "phi" COEFFS 0 16384 0 0 0 1 /end COMPU_METHOD
/begin MEASUREMENT EGO1_phiFB_RMS "EGO1 RMS" UWORD Compu_EGO1_phiFB_RMS 0 0 0 3.99993896484375 ECU_ADDRESS 0x01001ED8 /end MEASUREMENT
/begin COMPU_METHOD Compu_EGO1_phiFB_RMS " " RAT_FUNC "%.3" "phi" COEFFS 0 16384 0 0 0 1 /end COMPU_METHOD
/begin MEASUREMENT EGO2_phiFB_RMS "EGO2 RMS" UWORD Compu_EGO2_phiFB_RMS 0 0 0 3.99993896484375 ECU_ADDRESS 0x01001EE0 /end MEASUREMENT
/begin COMPU_METHOD Compu_EGO2_phiFB_RMS " " RAT_FUNC "%.3" "phi" COEFFS 0 16384 0 0 0 1 /end COMPU_METHOD
/begin MEASUREMENT EGO3_phiFB_RMS "EGO3 RMS" UWORD Compu_EGO3_phiFB_RMS 0 0 0 3.99993896484375 ECU_ADDRESS 0x01001EE8 /end MEASUREMENT
/begin COMPU_METHOD Compu_EGO3_phiFB_RMS " " RAT_FUNC "%.3" "phi" COEFFS 0 16384 0 0 0 1 /end COMPU_METHOD
/begin MEASUREMENT EGO1_phiFB "EGO1 current phi" UWORD Compu_EGO1_phiFB 0 0 0 3.99993896484375 ECU_ADDRESS 0x01001EF0 /end MEASUREMENT
/begin COMPU_METHOD Compu_EGO1_phiFB " " RAT_FUNC "%.3" "phi" COEFFS 0 16384 0 0 0 1 /end COMPU_METHOD
/begin MEASUREMENT EGO2_phiFB "EGO2 current phi" UWORD Compu_EGO2_phiFB 0 0 0 3.99993896484375 ECU_ADDRESS 0x01001EF8 /end MEASUREMENT
/begin COMPU_METHOD Compu_EGO2_phiFB " " RAT_FUNC "%.3" "phi" COEFFS 0 16384 0 0 0 1 /end COMPU_METHOD
/begin MEASUREMENT EGO3_phiFB "EGO3 current phi" UWORD Compu_EGO3_phiFB 0 0 0 3.99993896484375 ECU_ADDRESS 0x01001F00 /end MEASUREMENT
/begin COMPU_METHOD Compu_EGO3_phiFB " " RAT_FUNC "%.3" "phi" COEFFS 0 16384 0 0 0 1 /end COMPU_METHOD
/begin MEASUREMENT EGO1_phiFB_avg "EGO1 average phi" UWORD Compu_EGO1_phiFB_avg 0 0 0 3.99993896484375 ECU_ADDRESS 0x01001F08 /end MEASUREMENT
/begin COMPU_METHOD Compu_EGO1_phiFB_avg " " RAT_FUNC "%.3" "phi" COEFFS 0 16384 0 0 0 1 /end COMPU_METHOD
/begin MEASUREMENT EGO2_phiFB_avg "EGO2 average phi" UWORD Compu_EGO2_phiFB_avg 0 0 0 3.99993896484375 ECU_ADDRESS 0x01001F10 /end MEASUREMENT
/begin COMPU_METHOD Compu_EGO2_phiFB_avg " " RAT_FUNC "%.3" "phi" COEFFS 0 16384 0 0 0 1 /end COMPU_METHOD
/begin MEASUREMENT EGO3_phiFB_avg "EGO3 average phi" UWORD Compu_EGO3_phiFB_avg 0 0 0 3.99993896484375 ECU_ADDRESS 0x01001F18 /end MEASUREMENT
/begin COMPU_METHOD Compu_EGO3_phiFB_avg " " RAT_FUNC "%.3" "phi" COEFFS 0 16384 0 0 0 1 /end COMPU_METHOD
/begin MEASUREMENT Phi_post_d "Target post-cat phi" UWORD Compu_Phi_post_d 0 0 0 3.99993896484375 ECU_ADDRESS 0x01001F20 /end MEASUREMENT
/begin COMPU_METHOD Compu_Phi_post_d " " RAT_FUNC "%.3" "phi" COEFFS 0 16384 0 0 0 1 /end COMPU_METHOD
/begin MEASUREMENT Phi1_post_delt "Post-cat1 phi-target offset" SWORD Compu_Phi1_post_delt 0 0 -2 1.99993896484375 ECU_ADDRESS 0x01001F28 /end MEASUREMENT
/begin COMPU_METHOD Compu_Phi1_post_delt " " RAT_FUNC "%.3" "phi" COEFFS 0 16384 0 0 0 1 /end COMPU_METHOD
/begin MEASUREMENT Phi_post_act "Post-cat phi update status{Phi_post_act&0xff=0:Inactive}{Phi_post_act&0xff=1:Active}" UBYTE Phi_post_act_COMPU_VTAB 0 0 0 255 ECU_ADDRESS 0x01001F30 BIT_MASK 0xff /end MEASUREMENT
/begin COMPU_METHOD Phi_post_act_COMPU_VTAB "Verbal Table" TAB_VERB "%.0" "list" COMPU_TAB_REF Phi_post_act_COMPU_VTAB_REF /end COMPU_METHOD
/begin COMPU_VTAB Phi_post_act_COMPU_VTAB_REF "Verbal Table" TAB_VERB 2 0 "Inactive" 1 "Active" DEFAULT_VALUE "UNKNOWN" /end COMPU_VTAB
/begin MEASUREMENT CM1_RMSsrc "CM1 RMS comparison source{CM1_RMSsrc&0xff=0:Off}{CM1_RMSsrc&0xff=1:Inactive}{CM1_RMSsrc&0xff=2:Bank 1 Pre-cat}{CM1_RMSsrc&0xff=3:Bank 2 Pre-cat}{CM1_RMSsrc&0xff=4:CL Input Wave}{CM1_RMSsrc&0xff=5:Fixed Value}" UBYTE CM1_RMSsrc_COMPU_VTAB 0 0 0 255 ECU_ADDRESS 0x01001F38 BIT_MASK 0xff /end MEASUREMENT
/begin COMPU_METHOD CM1_RMSsrc_COMPU_VTAB "Verbal Table" TAB_VERB "%.0" "list" COMPU_TAB_REF CM1_RMSsrc_COMPU_VTAB_REF /end COMPU_METHOD
/begin COMPU_VTAB CM1_RMSsrc_COMPU_VTAB_REF "Verbal Table" TAB_VERB 6 0 "Off" 1 "Inactive" 2 "Bank 1 Pre-cat" 3 "Bank 2 Pre-cat" 4 "CL Input Wave" 5 "Fixed Value" DEFAULT_VALUE "UNKNOWN" /end COMPU_VTAB
/begin CHARACTERISTIC CL_Ki_p_postcat "Ki increasing postcat" VALUE 0x001433A0 /* @ECU_Address@CL_Ki_p_postcat@0x01001F40@ */ ECIPP_ALIGNMENT_SWORD 100 Compu_CL_Ki_p_postcat -100 99.9969482421875 /end CHARACTERISTIC
/begin COMPU_METHOD Compu_CL_Ki_p_postcat " " RAT_FUNC "%.1" "% / T_delay" COEFFS 0 327.68 0 0 0 1 /end COMPU_METHOD
/begin CHARACTERISTIC CL_hi_postcat "Postcat delta-phi max" VALUE 0x001433B0 /* @ECU_Address@CL_hi_postcat@0x01001F48@ */ ECIPP_ALIGNMENT_SWORD 2 Compu_CL_hi_postcat -2 1.99993896484375 /end CHARACTERISTIC
/begin COMPU_METHOD Compu_CL_hi_postcat " " RAT_FUNC "%.3" "phi" COEFFS 0 16384 0 0 0 1 /end COMPU_METHOD
/begin CHARACTERISTIC CL_lo_postcat "Postcat delta-phi min" VALUE 0x001433B2 /* @ECU_Address@CL_lo_postcat@0x01001F50@ */ ECIPP_ALIGNMENT_SWORD 2 Compu_CL_lo_postcat -2 1.99993896484375 /end CHARACTERISTIC
/begin COMPU_METHOD Compu_CL_lo_postcat " " RAT_FUNC "%.3" "phi" COEFFS 0 16384 0 0 0 1 /end COMPU_METHOD
/begin CHARACTERISTIC CLLP_lo_postcat "Postcat delta-phi min" VALUE 0x001418FA /* @ECU_Address@CLLP_lo_postcat@0x01001F58@ */ ECIPP_ALIGNMENT_SWORD 2 Compu_CLLP_lo_postcat -2 1.99993896484375 /end CHARACTERISTIC
/begin COMPU_METHOD Compu_CLLP_lo_postcat " " RAT_FUNC "%.3" "phi" COEFFS 0 16384 0 0 0 1 /end COMPU_METHOD
/begin CHARACTERISTIC CLLP_hi_postcat "Postcat delta-phi max" VALUE 0x001418F8 /* @ECU_Address@CLLP_hi_postcat@0x01001F70@ */ ECIPP_ALIGNMENT_SWORD 2 Compu_CLLP_hi_postcat -2 1.99993896484375 /end CHARACTERISTIC
/begin COMPU_METHOD Compu_CLLP_hi_postcat " " RAT_FUNC "%.3" "phi" COEFFS 0 16384 0 0 0 1 /end COMPU_METHOD
/begin CHARACTERISTIC CLLP_Ki_p_postcat "Ki increasing postcat" VALUE 0x001418E8 /* @ECU_Address@CLLP_Ki_p_postcat@0x01001F78@ */ ECIPP_ALIGNMENT_SWORD 100 Compu_CLLP_Ki_p_postcat -100 99.9969482421875 /end CHARACTERISTIC
/begin COMPU_METHOD Compu_CLLP_Ki_p_postcat " " RAT_FUNC "%.1" "% / T_delay" COEFFS 0 327.68 0 0 0 1 /end COMPU_METHOD
/begin CHARACTERISTIC CL_postcat_ena "Gasoline postcat control{CL_postcat_ena&0xff=0:Disabled}{CL_postcat_ena&0xff=1:Post-Cat Phi}{CL_postcat_ena&0xff=2:TWC Model}" VALUE 0x0014339B /* @ECU_Address@CL_postcat_ena@0x01001F88@ */ ECIPP_ALIGNMENT_UBYTE 255 CL_postcat_ena_COMPU_VTAB 0 255 BIT_MASK 0xff /end CHARACTERISTIC
/begin COMPU_METHOD CL_postcat_ena_COMPU_VTAB "Verbal Table" TAB_VERB "%.0" "list" COMPU_TAB_REF CL_postcat_ena_COMPU_VTAB_REF /end COMPU_METHOD
/begin COMPU_VTAB CL_postcat_ena_COMPU_VTAB_REF "Verbal Table" TAB_VERB 3 0 "Disabled" 1 "Post-Cat Phi" 2 "TWC Model" DEFAULT_VALUE "UNKNOWN" /end COMPU_VTAB
/begin CHARACTERISTIC CLLP_postcat_ena "LPG postcat control{CLLP_postcat_ena&0xff=0:Disabled}{CLLP_postcat_ena&0xff=1:Post-Cat Phi}{CLLP_postcat_ena&0xff=2:TWC Model}" VALUE 0x001418E3 /* @ECU_Address@CLLP_postcat_ena@0x01001F90@ */ ECIPP_ALIGNMENT_UBYTE 255 CLLP_postcat_ena_COMPU_VTAB 0 255 BIT_MASK 0xff /end CHARACTERISTIC
/begin COMPU_METHOD CLLP_postcat_ena_COMPU_VTAB "Verbal Table" TAB_VERB "%.0" "list" COMPU_TAB_REF CLLP_postcat_ena_COMPU_VTAB_REF /end COMPU_METHOD
/begin COMPU_VTAB CLLP_postcat_ena_COMPU_VTAB_REF "Verbal Table" TAB_VERB 3 0 "Disabled" 1 "Post-Cat Phi" 2 "TWC Model" DEFAULT_VALUE "UNKNOWN" /end COMPU_VTAB
/begin CHARACTERISTIC CL_CM_min_RMS "CM fixed min RMS (Fault Condition:EGO3/4 RMS >)" VALUE 0x001433B8 /* @ECU_Address@CL_CM_min_RMS@0x01001FA0@ */ ECIPP_ALIGNMENT_UWORD 4 Compu_CL_CM_min_RMS 0 3.99993896484375 /end CHARACTERISTIC
/begin COMPU_METHOD Compu_CL_CM_min_RMS " " RAT_FUNC "%.3" "phi" COEFFS 0 16384 0 0 0 1 /end COMPU_METHOD
/begin CHARACTERISTIC CLLP_CM_min_RMS "CM fixed min RMS (Fault Condition:EGO3 RMS >)" VALUE 0x00141900 /* @ECU_Address@CLLP_CM_min_RMS@0x01001FA8@ */ ECIPP_ALIGNMENT_UWORD 4 Compu_CLLP_CM_min_RMS 0 3.99993896484375 /end CHARACTERISTIC
/begin COMPU_METHOD Compu_CLLP_CM_min_RMS " " RAT_FUNC "%.3" "phi" COEFFS 0 16384 0 0 0 1 /end COMPU_METHOD
/begin CHARACTERISTIC CLNG_CM_min_RMS "CM fixed min RMS (Fault Condition:EGO3 RMS >)" VALUE 0x00142868 /* @ECU_Address@CLNG_CM_min_RMS@0x01001FB0@ */ ECIPP_ALIGNMENT_UWORD 4 Compu_CLNG_CM_min_RMS 0 3.99993896484375 /end CHARACTERISTIC
/begin COMPU_METHOD Compu_CLNG_CM_min_RMS " " RAT_FUNC "%.3" "phi" COEFFS 0 16384 0 0 0 1 /end COMPU_METHOD
/begin CHARACTERISTIC CL_CM_waveRMSatt "CM CL wave RMS attenuation (Fault Condition:and EGO3/4 RMS > CL waveform RMS *)" VALUE 0x001433BA /* @ECU_Address@CL_CM_waveRMSatt@0x01001FB8@ */ ECIPP_ALIGNMENT_UWORD 100 Compu_CL_CM_waveRMSatt 0 99.9984741210938 /end CHARACTERISTIC
/begin COMPU_METHOD Compu_CL_CM_waveRMSatt " " RAT_FUNC "%.1" "%" COEFFS 0 655.36 0 0 0 1 /end COMPU_METHOD
/begin CHARACTERISTIC CLLP_CM_waveRMSatt "CM CL wave RMS attenuation (Fault Condition:and EGO3 RMS > CL waveform RMS *)" VALUE 0x00141902 /* @ECU_Address@CLLP_CM_waveRMSatt@0x01001FC0@ */ ECIPP_ALIGNMENT_UWORD 100 Compu_CLLP_CM_waveRMSatt 0 99.9984741210938 /end CHARACTERISTIC
/begin COMPU_METHOD Compu_CLLP_CM_waveRMSatt " " RAT_FUNC "%.1" "%" COEFFS 0 655.36 0 0 0 1 /end COMPU_METHOD
/begin CHARACTERISTIC CLNG_CM_waveRMSatt "CM CL wave RMS attenuation (Fault Condition:and EGO3 RMS > CL waveform RMS *)" VALUE 0x0014286A /* @ECU_Address@CLNG_CM_waveRMSatt@0x01001FC8@ */ ECIPP_ALIGNMENT_UWORD 100 Compu_CLNG_CM_waveRMSatt 0 99.9984741210938 /end CHARACTERISTIC
/begin COMPU_METHOD Compu_CLNG_CM_waveRMSatt " " RAT_FUNC "%.1" "%" COEFFS 0 655.36 0 0 0 1 /end COMPU_METHOD
/begin CHARACTERISTIC CL_CM_preRMSatt "CM pre-cat EGO RMS attenuation (Fault Condition:and EGO3/4 RMS > EGO1/2 RMS *)" VALUE 0x001433BC /* @ECU_Address@CL_CM_preRMSatt@0x01001FD0@ */ ECIPP_ALIGNMENT_UWORD 100 Compu_CL_CM_preRMSatt 0 99.9984741210938 /end CHARACTERISTIC
/begin COMPU_METHOD Compu_CL_CM_preRMSatt " " RAT_FUNC "%.1" "%" COEFFS 0 655.36 0 0 0 1 /end COMPU_METHOD
/begin CHARACTERISTIC CLLP_CM_preRMSatt "CM pre-cat EGO RMS attenuation (Fault Condition:and EGO3 RMS > EGO1/2 RMS *)" VALUE 0x00141904 /* @ECU_Address@CLLP_CM_preRMSatt@0x01001FD8@ */ ECIPP_ALIGNMENT_UWORD 100 Compu_CLLP_CM_preRMSatt 0 99.9984741210938 /end CHARACTERISTIC
/begin COMPU_METHOD Compu_CLLP_CM_preRMSatt " " RAT_FUNC "%.1" "%" COEFFS 0 655.36 0 0 0 1 /end COMPU_METHOD
/begin CHARACTERISTIC CLNG_CM_preRMSatt "CM pre-cat EGO RMS attenuation (Fault Condition:and EGO3 RMS > EGO1/2 RMS *)" VALUE 0x0014286C /* @ECU_Address@CLNG_CM_preRMSatt@0x01001FE0@ */ ECIPP_ALIGNMENT_UWORD 100 Compu_CLNG_CM_preRMSatt 0 99.9984741210938 /end CHARACTERISTIC
/begin COMPU_METHOD Compu_CLNG_CM_preRMSatt " " RAT_FUNC "%.1" "%" COEFFS 0 655.36 0 0 0 1 /end COMPU_METHOD
/begin CHARACTERISTIC CL_Ki_n_postcat "Ki decreasing postcat" VALUE 0x001433A2 /* @ECU_Address@CL_Ki_n_postcat@0x01001FE8@ */ ECIPP_ALIGNMENT_SWORD 100 Compu_CL_Ki_n_postcat -100 99.9969482421875 /end CHARACTERISTIC
/begin COMPU_METHOD Compu_CL_Ki_n_postcat " " RAT_FUNC "%.1" "% / T_delay" COEFFS 0 327.68 0 0 0 1 /end COMPU_METHOD
/begin CHARACTERISTIC CLLP_Ki_n_postcat "Ki decreasing postcat" VALUE 0x001418EA /* @ECU_Address@CLLP_Ki_n_postcat@0x01001FF0@ */ ECIPP_ALIGNMENT_SWORD 100 Compu_CLLP_Ki_n_postcat -100 99.9969482421875 /end CHARACTERISTIC
/begin COMPU_METHOD Compu_CLLP_Ki_n_postcat " " RAT_FUNC "%.1" "% / T_delay" COEFFS 0 327.68 0 0 0 1 /end COMPU_METHOD
/begin CHARACTERISTIC CL_Kp_p_postcat "Kp increasing postcat" VALUE 0x0014339C /* @ECU_Address@CL_Kp_p_postcat@0x01002000@ */ ECIPP_ALIGNMENT_SWORD 100 Compu_CL_Kp_p_postcat -100 99.9969482421875 /end CHARACTERISTIC
/begin COMPU_METHOD Compu_CL_Kp_p_postcat " " RAT_FUNC "%.1" "%" COEFFS 0 327.68 0 0 0 1 /end COMPU_METHOD
/begin CHARACTERISTIC CLLP_Kp_p_postcat "Kp increasing postcat" VALUE 0x001418E4 /* @ECU_Address@CLLP_Kp_p_postcat@0x01002008@ */ ECIPP_ALIGNMENT_SWORD 100 Compu_CLLP_Kp_p_postcat -100 99.9969482421875 /end CHARACTERISTIC
/begin COMPU_METHOD Compu_CLLP_Kp_p_postcat " " RAT_FUNC "%.1" "%" COEFFS 0 327.68 0 0 0 1 /end COMPU_METHOD
/begin CHARACTERISTIC CL_Kp_n_postcat "Kp decreasing postcat" VALUE 0x0014339E /* @ECU_Address@CL_Kp_n_postcat@0x01002018@ */ ECIPP_ALIGNMENT_SWORD 100 Compu_CL_Kp_n_postcat -100 99.9969482421875 /end CHARACTERISTIC
/begin COMPU_METHOD Compu_CL_Kp_n_postcat " " RAT_FUNC "%.1" "%" COEFFS 0 327.68 0 0 0 1 /end COMPU_METHOD
/begin CHARACTERISTIC CLLP_Kp_n_postcat "Kp decreasing postcat" VALUE 0x001418E6 /* @ECU_Address@CLLP_Kp_n_postcat@0x01002020@ */ ECIPP_ALIGNMENT_SWORD 100 Compu_CLLP_Kp_n_postcat -100 99.9969482421875 /end CHARACTERISTIC
/begin COMPU_METHOD Compu_CLLP_Kp_n_postcat " " RAT_FUNC "%.1" "%" COEFFS 0 327.68 0 0 0 1 /end COMPU_METHOD
/begin CHARACTERISTIC CL_Kiv_p_postcat "Kiv increasing postcat" VALUE 0x001433A4 /* @ECU_Address@CL_Kiv_p_postcat@0x01002030@ */ ECIPP_ALIGNMENT_SWORD 800 Compu_CL_Kiv_p_postcat -800 799.9755859375 /end CHARACTERISTIC
/begin COMPU_METHOD Compu_CL_Kiv_p_postcat " " RAT_FUNC "%.1" "% / T_delay^2" COEFFS 0 40.96 0 0 0 1 /end COMPU_METHOD
/begin CHARACTERISTIC CL_Kiv_n_postcat "Kiv decreasing postcat" VALUE 0x001433A6 /* @ECU_Address@CL_Kiv_n_postcat@0x01002038@ */ ECIPP_ALIGNMENT_SWORD 800 Compu_CL_Kiv_n_postcat -800 799.9755859375 /end CHARACTERISTIC
/begin COMPU_METHOD Compu_CL_Kiv_n_postcat " " RAT_FUNC "%.1" "% / T_delay^2" COEFFS 0 40.96 0 0 0 1 /end COMPU_METHOD
/begin CHARACTERISTIC CLLP_Kiv_p_postcat "Kiv increasing postcat" VALUE 0x001418EC /* @ECU_Address@CLLP_Kiv_p_postcat@0x01002040@ */ ECIPP_ALIGNMENT_SWORD 800 Compu_CLLP_Kiv_p_postcat -800 799.9755859375 /end CHARACTERISTIC
/begin COMPU_METHOD Compu_CLLP_Kiv_p_postcat " " RAT_FUNC "%.1" "% / T_delay^2" COEFFS 0 40.96 0 0 0 1 /end COMPU_METHOD
/begin CHARACTERISTIC CLLP_Kiv_n_postcat "Kiv decreasing postcat" VALUE 0x001418EE /* @ECU_Address@CLLP_Kiv_n_postcat@0x01002048@ */ ECIPP_ALIGNMENT_SWORD 800 Compu_CLLP_Kiv_n_postcat -800 799.9755859375 /end CHARACTERISTIC
/begin COMPU_METHOD Compu_CLLP_Kiv_n_postcat " " RAT_FUNC "%.1" "% / T_delay^2" COEFFS 0 40.96 0 0 0 1 /end COMPU_METHOD
/begin CHARACTERISTIC CL_phidt_hi_postcat "Postcat dphi/dt max" VALUE 0x001433B4 /* @ECU_Address@CL_phidt_hi_postcat@0x01002068@ */ ECIPP_ALIGNMENT_SWORD 0 Compu_CL_phidt_hi_postcat -0.125 0.124996185302734 /end CHARACTERISTIC
/begin COMPU_METHOD Compu_CL_phidt_hi_postcat " " RAT_FUNC "%.3" "dphi / T_delay" COEFFS 0 262144 0 0 0 1 /end COMPU_METHOD
/begin CHARACTERISTIC CL_phidt_lo_postcat "Postcat dphi/dt min" VALUE 0x001433B6 /* @ECU_Address@CL_phidt_lo_postcat@0x01002070@ */ ECIPP_ALIGNMENT_SWORD 0 Compu_CL_phidt_lo_postcat -0.125 0.124996185302734 /end CHARACTERISTIC
/begin COMPU_METHOD Compu_CL_phidt_lo_postcat " " RAT_FUNC "%.3" "dphi / T_delay" COEFFS 0 262144 0 0 0 1 /end COMPU_METHOD
/begin CHARACTERISTIC CLP_phidt_hi_postcat "Postcat dphi/dt max" VALUE 0x001418FC /* @ECU_Address@CLP_phidt_hi_postcat@0x01002078@ */ ECIPP_ALIGNMENT_SWORD 0 Compu_CLP_phidt_hi_postcat -0.125 0.124996185302734 /end CHARACTERISTIC
/begin COMPU_METHOD Compu_CLP_phidt_hi_postcat " " RAT_FUNC "%.3" "dphi / T_delay" COEFFS 0 262144 0 0 0 1 /end COMPU_METHOD
/begin CHARACTERISTIC CLP_phidt_lo_postcat "Postcat dphi/dt min" VALUE 0x001418FE /* @ECU_Address@CLP_phidt_lo_postcat@0x01002080@ */ ECIPP_ALIGNMENT_SWORD 0 Compu_CLP_phidt_lo_postcat -0.125 0.124996185302734 /end CHARACTERISTIC
/begin COMPU_METHOD Compu_CLP_phidt_lo_postcat " " RAT_FUNC "%.3" "dphi / T_delay" COEFFS 0 262144 0 0 0 1 /end COMPU_METHOD
/begin CHARACTERISTIC MJ_nom_crkP "Cranking nominal EPR setpoint" VALUE 0x001409f2 /* @ECU_Address@MJ_nom_crkP@0x010020A8@ */ ECIPP_ALIGNMENT_SWORD 222 Compu_MJ_nom_crkP -222 221.993225097656 /end CHARACTERISTIC
/begin COMPU_METHOD Compu_MJ_nom_crkP " " RAT_FUNC "%.2" "in H2O" COEFFS 0 147.603603603604 0 0 0 1 /end COMPU_METHOD
/begin CHARACTERISTIC MJ_P_minP "EPR minimum pressure" VALUE 0x001409ee /* @ECU_Address@MJ_P_minP@0x010020B0@ */ ECIPP_ALIGNMENT_SWORD 222 Compu_MJ_P_minP -222 221.993225097656 /end CHARACTERISTIC
/begin COMPU_METHOD Compu_MJ_P_minP " " RAT_FUNC "%.2" "in H2O" COEFFS 0 147.603603603604 0 0 0 1 /end COMPU_METHOD
/begin CHARACTERISTIC MJ_P_maxP "EPR maximum pressure" VALUE 0x001409ec /* @ECU_Address@MJ_P_maxP@0x010020C0@ */ ECIPP_ALIGNMENT_SWORD 222 Compu_MJ_P_maxP -222 221.993225097656 /end CHARACTERISTIC
/begin COMPU_METHOD Compu_MJ_P_maxP " " RAT_FUNC "%.2" "in H2O" COEFFS 0 147.603603603604 0 0 0 1 /end COMPU_METHOD
/begin MEASUREMENT EGO3_phiFB_dphidt "EGO3 derivative" SWORD Compu_EGO3_phiFB_dphidt 0 0 -0.125 0.124996185302734 ECU_ADDRESS 0x010020E8 /end MEASUREMENT
/begin COMPU_METHOD Compu_EGO3_phiFB_dphidt " " RAT_FUNC "%.4" "dphi / T_delay" COEFFS 0 262144 0 0 0 1 /end COMPU_METHOD
/begin MEASUREMENT MJ_P_nom "EPR nominal press" SWORD Compu_MJ_P_nom 0 0 -222 221.993225097656 ECU_ADDRESS 0x010020F0 /end MEASUREMENT
/begin COMPU_METHOD Compu_MJ_P_nom " " RAT_FUNC "%.2" "in H2O" COEFFS 0 147.603603603604 0 0 0 1 /end COMPU_METHOD
/begin MEASUREMENT Vent_P_sig "Venturi press signal" SWORD Compu_Vent_P_sig 0 0 -222 221.993225097656 ECU_ADDRESS 0x010020F8 /end MEASUREMENT
/begin COMPU_METHOD Compu_Vent_P_sig " " RAT_FUNC "%.2" "in H2O" COEFFS 0 147.603603603604 0 0 0 1 /end COMPU_METHOD
/begin MEASUREMENT Vent_dP_nom "Venturi nominal fuel driving dP" SWORD Compu_Vent_dP_nom 0 0 -222 221.993225097656 ECU_ADDRESS 0x01002100 /end MEASUREMENT
/begin COMPU_METHOD Compu_Vent_dP_nom " " RAT_FUNC "%.2" "in H2O" COEFFS 0 147.603603603604 0 0 0 1 /end COMPU_METHOD
/begin MEASUREMENT MJ_man_mode "EPR manual mode{MJ_man_mode&0xff=0:Auto}{MJ_man_mode&0xff=1:Manual Press}{MJ_man_mode&0xff=2:Manual Area}{MJ_man_mode&0xff=3:Manual Pulsed}" UBYTE MJ_man_mode_COMPU_VTAB 0 0 0 255 ECU_ADDRESS 0x01002108 BIT_MASK 0xff /end MEASUREMENT
/begin COMPU_METHOD MJ_man_mode_COMPU_VTAB "Verbal Table" TAB_VERB "%.0" "list" COMPU_TAB_REF MJ_man_mode_COMPU_VTAB_REF /end COMPU_METHOD
/begin COMPU_VTAB MJ_man_mode_COMPU_VTAB_REF "Verbal Table" TAB_VERB 4 0 "Auto" 1 "Manual Press" 2 "Manual Area" 3 "Manual Pulsed" DEFAULT_VALUE "UNKNOWN" /end COMPU_VTAB
/begin MEASUREMENT MJ_ctltype_cmd "EPR control type command{MJ_ctltype_cmd&0xff=0:Pressure Cmd}{MJ_ctltype_cmd&0xff=1:Area Cmd}{MJ_ctltype_cmd&0xff=2:PA+FF or Pulsed}{MJ_ctltype_cmd&0xff=3:Offline}" UBYTE MJ_ctltype_cmd_COMPU_VTAB 0 0 0 255 ECU_ADDRESS 0x01002110 BIT_MASK 0xff /end MEASUREMENT
/begin COMPU_METHOD MJ_ctltype_cmd_COMPU_VTAB "Verbal Table" TAB_VERB "%.0" "list" COMPU_TAB_REF MJ_ctltype_cmd_COMPU_VTAB_REF /end COMPU_METHOD
/begin COMPU_VTAB MJ_ctltype_cmd_COMPU_VTAB_REF "Verbal Table" TAB_VERB 4 0 "Pressure Cmd" 1 "Area Cmd" 2 "PA+FF or Pulsed" 3 "Offline" DEFAULT_VALUE "UNKNOWN" /end COMPU_VTAB
/begin MEASUREMENT MJ_ctltype_act "EPR control type feedback{MJ_ctltype_act&0xff=0:Pressure Cmd}{MJ_ctltype_act&0xff=1:Area Cmd}{MJ_ctltype_act&0xff=2:PA+FF or Pulsed}{MJ_ctltype_act&0xff=3:Offline}" UBYTE MJ_ctltype_act_COMPU_VTAB 0 0 0 255 ECU_ADDRESS 0x01002118 BIT_MASK 0xff /end MEASUREMENT
/begin COMPU_METHOD MJ_ctltype_act_COMPU_VTAB "Verbal Table" TAB_VERB "%.0" "list" COMPU_TAB_REF MJ_ctltype_act_COMPU_VTAB_REF /end COMPU_METHOD
/begin COMPU_VTAB MJ_ctltype_act_COMPU_VTAB_REF "Verbal Table" TAB_VERB 4 0 "Pressure Cmd" 1 "Area Cmd" 2 "PA+FF or Pulsed" 3 "Offline" DEFAULT_VALUE "UNKNOWN" /end COMPU_VTAB
/begin MEASUREMENT MJ_status "EPR status{MJ_status&0xff=0:Comm Lost}{MJ_status&0xff=1:OK}{MJ_status&0xff=2:Fault}" UBYTE MJ_status_COMPU_VTAB 0 0 0 255 ECU_ADDRESS 0x01002120 BIT_MASK 0xff /end MEASUREMENT
/begin COMPU_METHOD MJ_status_COMPU_VTAB "Verbal Table" TAB_VERB "%.0" "list" COMPU_TAB_REF MJ_status_COMPU_VTAB_REF /end COMPU_METHOD
/begin COMPU_VTAB MJ_status_COMPU_VTAB_REF "Verbal Table" TAB_VERB 3 0 "Comm Lost" 1 "OK" 2 "Fault" DEFAULT_VALUE "UNKNOWN" /end COMPU_VTAB
/begin CHARACTERISTIC MJ_Pin_P "EPR nominal inlet pressure" VALUE 0x001409f0 /* @ECU_Address@MJ_Pin_P@0x01002378@ */ ECIPP_ALIGNMENT_SWORD 222 Compu_MJ_Pin_P -222 221.993225097656 /end CHARACTERISTIC
/begin COMPU_METHOD Compu_MJ_Pin_P " " RAT_FUNC "%.2" "H2O" COEFFS 0 147.603603603604 0 0 0 1 /end COMPU_METHOD
/begin CHARACTERISTIC FT_def "Fuel temperature default" VALUE 0x00147404 /* @ECU_Address@FT_def@0x01002390@ */ ECIPP_ALIGNMENT_UWORD 564 Compu_FT_def -460 563.984375 /end CHARACTERISTIC
/begin COMPU_METHOD Compu_FT_def " " RAT_FUNC "%.1" "deg F" COEFFS 0 64 29440 0 0 1 /end COMPU_METHOD
/begin MEASUREMENT FT "Fuel regulator temperature" UWORD Compu_FT 0 0 -460 563.984375 ECU_ADDRESS 0x01002398 /end MEASUREMENT
/begin COMPU_METHOD Compu_FT " " RAT_FUNC "%.1" "deg F" COEFFS 0 64 29440 0 0 1 /end COMPU_METHOD
/begin CHARACTERISTIC EGO1delay "EGO response delay" VALUE 0x001467e0 /* @ECU_Address@EGO1delay@0x010025B8@ */ ECIPP_ALIGNMENT_UWORD 65535 Compu_EGO1delay 0 65535 /end CHARACTERISTIC
/begin COMPU_METHOD Compu_EGO1delay " " RAT_FUNC "%.0" "ms" COEFFS 0 1 0 0 0 1 /end COMPU_METHOD
/begin CHARACTERISTIC CL_temp_wait_mul "CL temp disable wait multiplier" VALUE 0x00146752 /* @ECU_Address@CL_temp_wait_mul@0x010025C0@ */ ECIPP_ALIGNMENT_UWORD 4096 Compu_CL_temp_wait_mul 0 4095.9375 /end CHARACTERISTIC
/begin COMPU_METHOD Compu_CL_temp_wait_mul " " RAT_FUNC "%.1" "multiplier" COEFFS 0 16 0 0 0 1 /end COMPU_METHOD
/begin CHARACTERISTIC AL_temp_wait_mul "AL temp disable wait multiplier" VALUE 0x00146692 /* @ECU_Address@AL_temp_wait_mul@0x010025C8@ */ ECIPP_ALIGNMENT_UWORD 4096 Compu_AL_temp_wait_mul 0 4095.9375 /end CHARACTERISTIC
/begin COMPU_METHOD Compu_AL_temp_wait_mul " " RAT_FUNC "%.1" "multiplier" COEFFS 0 16 0 0 0 1 /end COMPU_METHOD
/begin MEASUREMENT mdot_a_equcarb "Mdota carb equivalent" UWORD Compu_mdot_a_equcarb 0 0 0 1023.984375 ECU_ADDRESS 0x01002618 /end MEASUREMENT
/begin COMPU_METHOD Compu_mdot_a_equcarb " " RAT_FUNC "%.1" "g/sec" COEFFS 0 64 0 0 0 1 /end COMPU_METHOD
/begin CHARACTERISTIC FAstoich_s_G "Stoich F/A ratio standard" VALUE 0x00149612 /* @ECU_Address@FAstoich_s_G@0x01002920@ */ ECIPP_ALIGNMENT_UWORD 0 Compu_FAstoich_s_G 0 0.124998092651367 /end CHARACTERISTIC
/begin COMPU_METHOD Compu_FAstoich_s_G " " RAT_FUNC "%.5" "-" COEFFS 0 524288 0 0 0 1 /end COMPU_METHOD
/begin CHARACTERISTIC FAstoich_s_P "Stoich F/A ratio standard" VALUE 0x0014961A /* @ECU_Address@FAstoich_s_P@0x01002928@ */ ECIPP_ALIGNMENT_UWORD 0 Compu_FAstoich_s_P 0 0.124998092651367 /end CHARACTERISTIC
/begin COMPU_METHOD Compu_FAstoich_s_P " " RAT_FUNC "%.5" "-" COEFFS 0 524288 0 0 0 1 /end COMPU_METHOD
/begin CHARACTERISTIC FAstoich_a_G "Stoich F/A ratio actual" VALUE 0x00149610 /* @ECU_Address@FAstoich_a_G@0x01002938@ */ ECIPP_ALIGNMENT_UWORD 0 Compu_FAstoich_a_G 0 0.124998092651367 /end CHARACTERISTIC
/begin COMPU_METHOD Compu_FAstoich_a_G " " RAT_FUNC "%.5" "-" COEFFS 0 524288 0 0 0 1 /end COMPU_METHOD
/begin CHARACTERISTIC FAstoich_a_P "Stoich F/A ratio actual" VALUE 0x00149618 /* @ECU_Address@FAstoich_a_P@0x01002940@ */ ECIPP_ALIGNMENT_UWORD 0 Compu_FAstoich_a_P 0 0.124998092651367 /end CHARACTERISTIC
/begin COMPU_METHOD Compu_FAstoich_a_P " " RAT_FUNC "%.5" "-" COEFFS 0 524288 0 0 0 1 /end COMPU_METHOD
/begin MEASUREMENT trim_SG_FA_x "Trim fuel SG FAratio correction" UWORD Compu_trim_SG_FA_x 0 0 0 3.99993896484375 ECU_ADDRESS 0x01002950 /end MEASUREMENT
/begin COMPU_METHOD Compu_trim_SG_FA_x " " RAT_FUNC "%.3" "multiplier" COEFFS 0 16384 0 0 0 1 /end COMPU_METHOD
/begin CHARACTERISTIC SGf "Fuel specific gravity actual" VALUE 0x0014960C /* @ECU_Address@SGf@0x01002958@ */ ECIPP_ALIGNMENT_UWORD 128 Compu_SGf 0 127.998046875 /end CHARACTERISTIC
/begin COMPU_METHOD Compu_SGf " " RAT_FUNC "%.3" "-" COEFFS 0 512 0 0 0 1 /end COMPU_METHOD
/begin CHARACTERISTIC SGfs "Fuel specific gravity standard" VALUE 0x0014960E /* @ECU_Address@SGfs@0x01002960@ */ ECIPP_ALIGNMENT_UWORD 128 Compu_SGfs 0 127.998046875 /end CHARACTERISTIC
/begin COMPU_METHOD Compu_SGfs " " RAT_FUNC "%.3" "-" COEFFS 0 512 0 0 0 1 /end COMPU_METHOD
/begin CHARACTERISTIC SGf_LP "Fuel specific gravity actual" VALUE 0x00149614 /* @ECU_Address@SGf_LP@0x01002968@ */ ECIPP_ALIGNMENT_UWORD 128 Compu_SGf_LP 0 127.998046875 /end CHARACTERISTIC
/begin COMPU_METHOD Compu_SGf_LP " " RAT_FUNC "%.3" "-" COEFFS 0 512 0 0 0 1 /end COMPU_METHOD
/begin CHARACTERISTIC SGfs_LP "Fuel specific gravity standard" VALUE 0x00149616 /* @ECU_Address@SGfs_LP@0x01002970@ */ ECIPP_ALIGNMENT_UWORD 128 Compu_SGfs_LP 0 127.998046875 /end CHARACTERISTIC
/begin COMPU_METHOD Compu_SGfs_LP " " RAT_FUNC "%.3" "-" COEFFS 0 512 0 0 0 1 /end COMPU_METHOD
/begin MEASUREMENT Phi2_post_delt "Post-cat2 phi-target offset" SWORD Compu_Phi2_post_delt 0 0 -2 1.99993896484375 ECU_ADDRESS 0x010038D0 /end MEASUREMENT
/begin COMPU_METHOD Compu_Phi2_post_delt " " RAT_FUNC "%.3" "phi" COEFFS 0 16384 0 0 0 1 /end COMPU_METHOD
/begin MEASUREMENT CL2_Hp "CL2_Hp" UWORD Compu_CL2_Hp 0 0 0 99.9984741210938 ECU_ADDRESS 0x010038D8 /end MEASUREMENT
/begin COMPU_METHOD Compu_CL2_Hp " " RAT_FUNC "%.1" "%" COEFFS 0 655.36 0 0 0 1 /end COMPU_METHOD
/begin MEASUREMENT CL2_Hn "CL2_Hn" UWORD Compu_CL2_Hn 0 0 0 99.9984741210938 ECU_ADDRESS 0x010038E0 /end MEASUREMENT
/begin COMPU_METHOD Compu_CL2_Hn " " RAT_FUNC "%.1" "%" COEFFS 0 655.36 0 0 0 1 /end COMPU_METHOD
/begin MEASUREMENT CB2pre_DCd "Pre-cat EGO DC desired" UWORD Compu_CB2pre_DCd 0 0 0 199.996948242188 ECU_ADDRESS 0x010038F0 /end MEASUREMENT
/begin COMPU_METHOD Compu_CB2pre_DCd " " RAT_FUNC "%.1" "%" COEFFS 0 327.68 0 0 0 1 /end COMPU_METHOD
/begin MEASUREMENT CL2_E "CL2_E" UWORD Compu_CL2_E 0 0 0 199.996948242188 ECU_ADDRESS 0x010038F8 /end MEASUREMENT
/begin COMPU_METHOD Compu_CL2_E " " RAT_FUNC "%.1" "%" COEFFS 0 327.68 0 0 0 1 /end COMPU_METHOD
/begin MEASUREMENT EGO4_phiFB_RMS "EGO4 RMS" UWORD Compu_EGO4_phiFB_RMS 0 0 0 3.99993896484375 ECU_ADDRESS 0x01003908 /end MEASUREMENT
/begin COMPU_METHOD Compu_EGO4_phiFB_RMS " " RAT_FUNC "%.3" "phi" COEFFS 0 16384 0 0 0 1 /end COMPU_METHOD
/begin MEASUREMENT EGO4_phiFB "EGO4 current phi" UWORD Compu_EGO4_phiFB 0 0 0 3.99993896484375 ECU_ADDRESS 0x01003910 /end MEASUREMENT
/begin COMPU_METHOD Compu_EGO4_phiFB " " RAT_FUNC "%.3" "phi" COEFFS 0 16384 0 0 0 1 /end COMPU_METHOD
/begin MEASUREMENT EGO4_phiFB_avg "EGO4 average phi" UWORD Compu_EGO4_phiFB_avg 0 0 0 3.99993896484375 ECU_ADDRESS 0x01003918 /end MEASUREMENT
/begin COMPU_METHOD Compu_EGO4_phiFB_avg " " RAT_FUNC "%.3" "phi" COEFFS 0 16384 0 0 0 1 /end COMPU_METHOD
/begin MEASUREMENT CM2_RMSsrc "CM2 RMS comparison source{CM2_RMSsrc&0xff=0:Off}{CM2_RMSsrc&0xff=1:Inactive}{CM2_RMSsrc&0xff=2:Bank 1 Pre-cat}{CM2_RMSsrc&0xff=3:Bank 2 Pre-cat}{CM2_RMSsrc&0xff=4:CL Input Wave}{CM2_RMSsrc&0xff=5:Fixed Value}" UBYTE CM2_RMSsrc_COMPU_VTAB 0 0 0 255 ECU_ADDRESS 0x01003920 BIT_MASK 0xff /end MEASUREMENT
/begin COMPU_METHOD CM2_RMSsrc_COMPU_VTAB "Verbal Table" TAB_VERB "%.0" "list" COMPU_TAB_REF CM2_RMSsrc_COMPU_VTAB_REF /end COMPU_METHOD
/begin COMPU_VTAB CM2_RMSsrc_COMPU_VTAB_REF "Verbal Table" TAB_VERB 6 0 "Off" 1 "Inactive" 2 "Bank 1 Pre-cat" 3 "Bank 2 Pre-cat" 4 "CL Input Wave" 5 "Fixed Value" DEFAULT_VALUE "UNKNOWN" /end COMPU_VTAB
/begin MEASUREMENT CL2_wave_RMS "CL2 perturbation wave RMS" UWORD Compu_CL2_wave_RMS 0 0 0 3.99993896484375 ECU_ADDRESS 0x01003928 /end MEASUREMENT
/begin COMPU_METHOD Compu_CL2_wave_RMS " " RAT_FUNC "%.3" "phi" COEFFS 0 16384 0 0 0 1 /end COMPU_METHOD
/begin MEASUREMENT CM2_RMScomp "CM2 current RMS limit" UWORD Compu_CM2_RMScomp 0 0 0 3.99993896484375 ECU_ADDRESS 0x01003930 /end MEASUREMENT
/begin COMPU_METHOD Compu_CM2_RMScomp " " RAT_FUNC "%.3" "phi" COEFFS 0 16384 0 0 0 1 /end COMPU_METHOD
/begin MEASUREMENT CL_bank_mode "Pre-cat CL bank mode{CL_bank_mode&0xff=0:Disabled}{CL_bank_mode&0xff=1:Single}{CL_bank_mode&0xff=2:Dual}{CL_bank_mode&0xff=3:Average}" UBYTE CL_bank_mode_COMPU_VTAB 0 0 0 255 ECU_ADDRESS 0x01003938 BIT_MASK 0xff /end MEASUREMENT
/begin COMPU_METHOD CL_bank_mode_COMPU_VTAB "Verbal Table" TAB_VERB "%.0" "list" COMPU_TAB_REF CL_bank_mode_COMPU_VTAB_REF /end COMPU_METHOD
/begin COMPU_VTAB CL_bank_mode_COMPU_VTAB_REF "Verbal Table" TAB_VERB 4 0 "Disabled" 1 "Single" 2 "Dual" 3 "Average" DEFAULT_VALUE "UNKNOWN" /end COMPU_VTAB
/begin MEASUREMENT Cat_bank_mode "Post-cat CL bank mode{Cat_bank_mode&0xff=0:Disabled}{Cat_bank_mode&0xff=1:Single}{Cat_bank_mode&0xff=2:Dual}" UBYTE Cat_bank_mode_COMPU_VTAB 0 0 0 255 ECU_ADDRESS 0x01003940 BIT_MASK 0xff /end MEASUREMENT
/begin COMPU_METHOD Cat_bank_mode_COMPU_VTAB "Verbal Table" TAB_VERB "%.0" "list" COMPU_TAB_REF Cat_bank_mode_COMPU_VTAB_REF /end COMPU_METHOD
/begin COMPU_VTAB Cat_bank_mode_COMPU_VTAB_REF "Verbal Table" TAB_VERB 3 0 "Disabled" 1 "Single" 2 "Dual" DEFAULT_VALUE "UNKNOWN" /end COMPU_VTAB
/begin MEASUREMENT EGO4_phiFB_dphidt "EGO4 derivative" SWORD Compu_EGO4_phiFB_dphidt 0 0 -0.125 0.124996185302734 ECU_ADDRESS 0x01003948 /end MEASUREMENT
/begin COMPU_METHOD Compu_EGO4_phiFB_dphidt " " RAT_FUNC "%.4" "dphi / T_delay" COEFFS 0 262144 0 0 0 1 /end COMPU_METHOD
/begin MEASUREMENT Phi1_pre_d "Phi pre-cat1 target" UWORD Compu_Phi1_pre_d 0 0 0 3.99993896484375 ECU_ADDRESS 0x01003950 /end MEASUREMENT
/begin COMPU_METHOD Compu_Phi1_pre_d " " RAT_FUNC "%.3" "-" COEFFS 0 16384 0 0 0 1 /end COMPU_METHOD
/begin MEASUREMENT Phi2_pre_d "Phi pre-cat2 target" UWORD Compu_Phi2_pre_d 0 0 0 3.99993896484375 ECU_ADDRESS 0x01003958 /end MEASUREMENT
/begin COMPU_METHOD Compu_Phi2_pre_d " " RAT_FUNC "%.3" "-" COEFFS 0 16384 0 0 0 1 /end COMPU_METHOD
/begin MEASUREMENT MJ_VVC_Tcrct "Variable venturi FRT/IAT dP multiplier" UWORD Compu_MJ_VVC_Tcrct 0 0 0 1.99996948242188 ECU_ADDRESS 0x01003E08 /end MEASUREMENT
/begin COMPU_METHOD Compu_MJ_VVC_Tcrct " " RAT_FUNC "%.3" "-" COEFFS 0 32768 0 0 0 1 /end COMPU_METHOD
/begin MEASUREMENT MJ_P_Tnom "EPR temp corrected nominal press" SWORD Compu_MJ_P_Tnom 0 0 -222 221.993225097656 ECU_ADDRESS 0x01003E10 /end MEASUREMENT
/begin COMPU_METHOD Compu_MJ_P_Tnom " " RAT_FUNC "%.2" "in H2O" COEFFS 0 147.603603603604 0 0 0 1 /end COMPU_METHOD
/begin MEASUREMENT m_a_perL "Air mass per liter displacement" UWORD Compu_m_a_perL 0 0 0 16383.75 ECU_ADDRESS 0x01003EC8 /end MEASUREMENT
/begin COMPU_METHOD Compu_m_a_perL " " RAT_FUNC "%.0" "mg/L-disp" COEFFS 0 4 0 0 0 1 /end COMPU_METHOD
/begin CHARACTERISTIC trim_load_src "Fuel trim calibration load axis{trim_load_src&0xff=0:MAP}{trim_load_src&0xff=1:Air mass/L-displacement}" VALUE 0x001481c5 /* @ECU_Address@trim_load_src@0x01003ED0@ */ ECIPP_ALIGNMENT_UBYTE 255 trim_load_src_COMPU_VTAB 0 255 BIT_MASK 0xff /end CHARACTERISTIC
/begin COMPU_METHOD trim_load_src_COMPU_VTAB "Verbal Table" TAB_VERB "%.0" "list" COMPU_TAB_REF trim_load_src_COMPU_VTAB_REF /end COMPU_METHOD
/begin COMPU_VTAB trim_load_src_COMPU_VTAB_REF "Verbal Table" TAB_VERB 2 0 "MAP" 1 "Air mass/L-displacement" DEFAULT_VALUE "UNKNOWN" /end COMPU_VTAB
/begin CHARACTERISTIC trim_TIP_Vdot_comp "Fuel trim TIP-Vdot compensation{trim_TIP_Vdot_comp&0xff=0:Disabled}{trim_TIP_Vdot_comp&0xff=1:Enabled}" VALUE 0x001481c4 /* @ECU_Address@trim_TIP_Vdot_comp@0x010040C0@ */ ECIPP_ALIGNMENT_UBYTE 255 trim_TIP_Vdot_comp_COMPU_VTAB 0 255 BIT_MASK 0xff /end CHARACTERISTIC
/begin COMPU_METHOD trim_TIP_Vdot_comp_COMPU_VTAB "Verbal Table" TAB_VERB "%.0" "list" COMPU_TAB_REF trim_TIP_Vdot_comp_COMPU_VTAB_REF /end COMPU_METHOD
/begin COMPU_VTAB trim_TIP_Vdot_comp_COMPU_VTAB_REF "Verbal Table" TAB_VERB 2 0 "Disabled" 1 "Enabled" DEFAULT_VALUE "UNKNOWN" /end COMPU_VTAB
/begin MEASUREMENT trim_MAP_Vdc "Fuel trim Vdot comp MAP" UWORD Compu_trim_MAP_Vdc 0 0 0 255.99609375 ECU_ADDRESS 0x010040E0 /end MEASUREMENT
/begin COMPU_METHOD Compu_trim_MAP_Vdc " " RAT_FUNC "%.2" "psia" COEFFS 0 256 0 0 0 1 /end COMPU_METHOD
/begin MEASUREMENT trim_m_a_Vdc "Fuel trim Vdot comp mdot air" UWORD Compu_trim_m_a_Vdc 0 0 0 16383.75 ECU_ADDRESS 0x010040E8 /end MEASUREMENT
/begin COMPU_METHOD Compu_trim_m_a_Vdc " " RAT_FUNC "%.0" "mg/Ld" COEFFS 0 4 0 0 0 1 /end COMPU_METHOD
/begin MEASUREMENT Phi_cmd_dly "Phi command delayed" UWORD Compu_Phi_cmd_dly 0 0 0 3.99993896484375 ECU_ADDRESS 0x010040F0 /end MEASUREMENT
/begin COMPU_METHOD Compu_Phi_cmd_dly " " RAT_FUNC "%.3" "-" COEFFS 0 16384 0 0 0 1 /end COMPU_METHOD
/begin MEASUREMENT ICam_samp_BTDC "Cam1 edge sample" SWORD Compu_ICam_samp_BTDC 0 0 -2048 2047.9375 ECU_ADDRESS 0x010041C8 /end MEASUREMENT
/begin COMPU_METHOD Compu_ICam_samp_BTDC " " RAT_FUNC "%.1" "CAD BTDC" COEFFS 0 16 0 0 0 1 /end COMPU_METHOD
/begin MEASUREMENT ECam_samp_BTDC "Cam2 edge sample" SWORD Compu_ECam_samp_BTDC 0 0 -2048 2047.9375 ECU_ADDRESS 0x010041D0 /end MEASUREMENT
/begin COMPU_METHOD Compu_ECam_samp_BTDC " " RAT_FUNC "%.1" "CAD BTDC" COEFFS 0 16 0 0 0 1 /end COMPU_METHOD
/begin MEASUREMENT ICam_timing_d "Cam1 open target" SWORD Compu_ICam_timing_d 0 0 -2048 2047.9375 ECU_ADDRESS 0x010041D8 /end MEASUREMENT
/begin COMPU_METHOD Compu_ICam_timing_d " " RAT_FUNC "%.1" "CAD BTDC" COEFFS 0 16 0 0 0 1 /end COMPU_METHOD
/begin MEASUREMENT ECam_timing_d "Cam2 close target" SWORD Compu_ECam_timing_d 0 0 -2048 2047.9375 ECU_ADDRESS 0x010041E0 /end MEASUREMENT
/begin COMPU_METHOD Compu_ECam_timing_d " " RAT_FUNC "%.1" "CAD BTDC" COEFFS 0 16 0 0 0 1 /end COMPU_METHOD
/begin MEASUREMENT ICam_control "Cam1 control cmd" SWORD Compu_ICam_control 0 0 -100 99.9969482421875 ECU_ADDRESS 0x010041E8 /end MEASUREMENT
/begin COMPU_METHOD Compu_ICam_control " " RAT_FUNC "%.1" "%" COEFFS 0 327.68 0 0 0 1 /end COMPU_METHOD
/begin MEASUREMENT ICam_PWM_DC "Cam1 control PWM DC" UWORD Compu_ICam_PWM_DC 0 0 0 99.9984741210938 ECU_ADDRESS 0x010041F0 /end MEASUREMENT
/begin COMPU_METHOD Compu_ICam_PWM_DC " " RAT_FUNC "%.1" "%" COEFFS 0 655.36 0 0 0 1 /end COMPU_METHOD
/begin CHARACTERISTIC ICam_PWM_taud "ICam control PWM tau" VALUE 0x00149010 /* @ECU_Address@ICam_PWM_taud@0x010041F8@ */ ECIPP_ALIGNMENT_UWORD 210 Compu_ICam_PWM_taud 0 209.712 /end CHARACTERISTIC
/begin COMPU_METHOD Compu_ICam_PWM_taud " " RAT_FUNC "%.1" "ms" COEFFS 0 312.5 0 0 0 1 /end COMPU_METHOD
/begin MEASUREMENT ECam_control "Cam2 control cmd" SWORD Compu_ECam_control 0 0 -100 99.9969482421875 ECU_ADDRESS 0x01004200 /end MEASUREMENT
/begin COMPU_METHOD Compu_ECam_control " " RAT_FUNC "%.1" "%" COEFFS 0 327.68 0 0 0 1 /end COMPU_METHOD
/begin MEASUREMENT ECam_PWM_DC "Cam2 control PWM DC" UWORD Compu_ECam_PWM_DC 0 0 0 99.9984741210938 ECU_ADDRESS 0x01004208 /end MEASUREMENT
/begin COMPU_METHOD Compu_ECam_PWM_DC " " RAT_FUNC "%.1" "%" COEFFS 0 655.36 0 0 0 1 /end COMPU_METHOD
/begin CHARACTERISTIC ECam_PWM_taud "ECam control PWM tau" VALUE 0x00148D9C /* @ECU_Address@ECam_PWM_taud@0x01004210@ */ ECIPP_ALIGNMENT_UWORD 210 Compu_ECam_PWM_taud 0 209.712 /end CHARACTERISTIC
/begin COMPU_METHOD Compu_ECam_PWM_taud " " RAT_FUNC "%.1" "ms" COEFFS 0 312.5 0 0 0 1 /end COMPU_METHOD
/begin MEASUREMENT ICam_PWM_mode "Cam1 PWM mode{ICam_PWM_mode&0xff=0:Automatic}{ICam_PWM_mode&0xff=1:Manual Timing}{ICam_PWM_mode&0xff=2:Manual DC}" UBYTE ICam_PWM_mode_COMPU_VTAB 0 0 0 255 ECU_ADDRESS 0x01004218 BIT_MASK 0xff /end MEASUREMENT
/begin COMPU_METHOD ICam_PWM_mode_COMPU_VTAB "Verbal Table" TAB_VERB "%.0" "list" COMPU_TAB_REF ICam_PWM_mode_COMPU_VTAB_REF /end COMPU_METHOD
/begin COMPU_VTAB ICam_PWM_mode_COMPU_VTAB_REF "Verbal Table" TAB_VERB 3 0 "Automatic" 1 "Manual Timing" 2 "Manual DC" DEFAULT_VALUE "UNKNOWN" /end COMPU_VTAB
/begin MEASUREMENT ECam_PWM_mode "Cam2 PWM mode{ECam_PWM_mode&0xff=0:Automatic}{ECam_PWM_mode&0xff=1:Manual Timing}{ECam_PWM_mode&0xff=2:Manual DC}" UBYTE ECam_PWM_mode_COMPU_VTAB 0 0 0 255 ECU_ADDRESS 0x01004220 BIT_MASK 0xff /end MEASUREMENT
/begin COMPU_METHOD ECam_PWM_mode_COMPU_VTAB "Verbal Table" TAB_VERB "%.0" "list" COMPU_TAB_REF ECam_PWM_mode_COMPU_VTAB_REF /end COMPU_METHOD
/begin COMPU_VTAB ECam_PWM_mode_COMPU_VTAB_REF "Verbal Table" TAB_VERB 3 0 "Automatic" 1 "Manual Timing" 2 "Manual DC" DEFAULT_VALUE "UNKNOWN" /end COMPU_VTAB
/begin CHARACTERISTIC ICam_timing_ctrl "Cam1 / ICam timing control{ICam_timing_ctrl&0xff=0:Disabled}{ICam_timing_ctrl&0xff=1:Aux PWM1}{ICam_timing_ctrl&0xff=2:Aux PWM2}{ICam_timing_ctrl&0xff=3:Aux PWM3}{ICam_timing_ctrl&0xff=4:Aux PWM4}{ICam_timing_ctrl&0xff=5:Aux PWM5}{ICam_timing_ctrl&0xff=6:" VALUE 0x00149038 /* @ECU_Address@ICam_timing_ctrl@0x01004228@ */ ECIPP_ALIGNMENT_UBYTE 255 ICam_timing_ctrl_COMPU_VTAB 0 255 BIT_MASK 0xff /end CHARACTERISTIC
/begin COMPU_METHOD ICam_timing_ctrl_COMPU_VTAB "Verbal Table" TAB_VERB "%.0" "list" COMPU_TAB_REF ICam_timing_ctrl_COMPU_VTAB_REF /end COMPU_METHOD
/begin COMPU_VTAB ICam_timing_ctrl_COMPU_VTAB_REF "Verbal Table" TAB_VERB 11 0 "Disabled" 1 "Aux PWM1" 2 "Aux PWM2" 3 "Aux PWM3" 4 "Aux PWM4" 5 "Aux PWM5" 6 "Aux PWM6" 7 "EGOH1" 8 "EGOH2" 9 "EGOH3" 10 "EGOH4" DEFAULT_VALUE "UNKNOWN" /end COMPU_VTAB
/begin CHARACTERISTIC ECam_timing_ctrl "Cam2 / ECam timing control{ECam_timing_ctrl&0xff=0:Disabled}{ECam_timing_ctrl&0xff=1:Aux PWM1}{ECam_timing_ctrl&0xff=2:Aux PWM2}{ECam_timing_ctrl&0xff=3:Aux PWM3}{ECam_timing_ctrl&0xff=4:Aux PWM4}{ECam_timing_ctrl&0xff=5:Aux PWM5}{ECam_timing_ctrl&0xff=6:" VALUE 0x00148DC4 /* @ECU_Address@ECam_timing_ctrl@0x01004230@ */ ECIPP_ALIGNMENT_UBYTE 255 ECam_timing_ctrl_COMPU_VTAB 0 255 BIT_MASK 0xff /end CHARACTERISTIC
/begin COMPU_METHOD ECam_timing_ctrl_COMPU_VTAB "Verbal Table" TAB_VERB "%.0" "list" COMPU_TAB_REF ECam_timing_ctrl_COMPU_VTAB_REF /end COMPU_METHOD
/begin COMPU_VTAB ECam_timing_ctrl_COMPU_VTAB_REF "Verbal Table" TAB_VERB 11 0 "Disabled" 1 "Aux PWM1" 2 "Aux PWM2" 3 "Aux PWM3" 4 "Aux PWM4" 5 "Aux PWM5" 6 "Aux PWM6" 7 "EGOH1" 8 "EGOH2" 9 "EGOH3" 10 "EGOH4" DEFAULT_VALUE "UNKNOWN" /end COMPU_VTAB
/begin MEASUREMENT ICam_I_acc "Cam1 integrator value" SLONG Compu_ICam_I_acc 0 0 -3200 3199.99999850988 ECU_ADDRESS 0x01004238 /end MEASUREMENT
/begin COMPU_METHOD Compu_ICam_I_acc " " RAT_FUNC "%.1" "%" COEFFS 0 671088.64 0 0 0 1 /end COMPU_METHOD
/begin CHARACTERISTIC ICam_I_min "ICam integrator min" VALUE 0x0014902C /* @ECU_Address@ICam_I_min@0x01004240@ */ ECIPP_ALIGNMENT_SLONG 3200 Compu_ICam_I_min -3200 3199.99999850988 /end CHARACTERISTIC
/begin COMPU_METHOD Compu_ICam_I_min " " RAT_FUNC "%.1" "%" COEFFS 0 671088.64 0 0 0 1 /end COMPU_METHOD
/begin CHARACTERISTIC ICam_I_max "ICam integrator max" VALUE 0x00149028 /* @ECU_Address@ICam_I_max@0x01004248@ */ ECIPP_ALIGNMENT_SLONG 3200 Compu_ICam_I_max -3200 3199.99999850988 /end CHARACTERISTIC
/begin COMPU_METHOD Compu_ICam_I_max " " RAT_FUNC "%.1" "%" COEFFS 0 671088.64 0 0 0 1 /end COMPU_METHOD
/begin CHARACTERISTIC ECam_I_min "ECam integrator min" VALUE 0x00148DB8 /* @ECU_Address@ECam_I_min@0x01004250@ */ ECIPP_ALIGNMENT_SLONG 3200 Compu_ECam_I_min -3200 3199.99999850988 /end CHARACTERISTIC
/begin COMPU_METHOD Compu_ECam_I_min " " RAT_FUNC "%.1" "%" COEFFS 0 671088.64 0 0 0 1 /end COMPU_METHOD
/begin CHARACTERISTIC ECam_I_max "ECam integrator max" VALUE 0x00148DB4 /* @ECU_Address@ECam_I_max@0x01004258@ */ ECIPP_ALIGNMENT_SLONG 3200 Compu_ECam_I_max -3200 3199.99999850988 /end CHARACTERISTIC
/begin COMPU_METHOD Compu_ECam_I_max " " RAT_FUNC "%.1" "%" COEFFS 0 671088.64 0 0 0 1 /end COMPU_METHOD
/begin CHARACTERISTIC ICam_coil_Inom "ICam coil nominal current" VALUE 0x00149020 /* @ECU_Address@ICam_coil_Inom@0x01004290@ */ ECIPP_ALIGNMENT_UWORD 64 Compu_ICam_coil_Inom 0 63.9990234375 /end CHARACTERISTIC
/begin COMPU_METHOD Compu_ICam_coil_Inom " " RAT_FUNC "%.2" "amps" COEFFS 0 1024 0 0 0 1 /end COMPU_METHOD
/begin CHARACTERISTIC ECam_coil_Inom "ECam coil nominal current" VALUE 0x00148DAC /* @ECU_Address@ECam_coil_Inom@0x010042A8@ */ ECIPP_ALIGNMENT_UWORD 64 Compu_ECam_coil_Inom 0 63.9990234375 /end CHARACTERISTIC
/begin COMPU_METHOD Compu_ECam_coil_Inom " " RAT_FUNC "%.2" "amps" COEFFS 0 1024 0 0 0 1 /end COMPU_METHOD
/begin MEASUREMENT ICam_coil_Id "Cam1 coil desired current" UWORD Compu_ICam_coil_Id 0 0 0 63.9990234375 ECU_ADDRESS 0x010042C0 /end MEASUREMENT
/begin COMPU_METHOD Compu_ICam_coil_Id " " RAT_FUNC "%.2" "amps" COEFFS 0 1024 0 0 0 1 /end COMPU_METHOD
/begin MEASUREMENT ICam_coil_R "Cam1 coil resistance" UWORD Compu_ICam_coil_R 0 0 0 63.9990234375 ECU_ADDRESS 0x010042C8 /end MEASUREMENT
/begin COMPU_METHOD Compu_ICam_coil_R " " RAT_FUNC "%.2" "ohms" COEFFS 0 1024 0 0 0 1 /end COMPU_METHOD
/begin CHARACTERISTIC ICam_Kp "ICam Kp" VALUE 0x00149022 /* @ECU_Address@ICam_Kp@0x010042D0@ */ ECIPP_ALIGNMENT_SWORD 100 Compu_ICam_Kp -100 99.9969482421875 /end CHARACTERISTIC
/begin COMPU_METHOD Compu_ICam_Kp " " RAT_FUNC "%.1" "%/CAD" COEFFS 0 327.68 0 0 0 1 /end COMPU_METHOD
/begin CHARACTERISTIC ECam_Kp "ECam Kp" VALUE 0x00148DAE /* @ECU_Address@ECam_Kp@0x010042D8@ */ ECIPP_ALIGNMENT_SWORD 100 Compu_ECam_Kp -100 99.9969482421875 /end CHARACTERISTIC
/begin COMPU_METHOD Compu_ECam_Kp " " RAT_FUNC "%.1" "%/CAD" COEFFS 0 327.68 0 0 0 1 /end COMPU_METHOD
/begin CHARACTERISTIC ICam_Ki "ICam Ki" VALUE 0x00149024 /* @ECU_Address@ICam_Ki@0x010042E0@ */ ECIPP_ALIGNMENT_SWORD 781 Compu_ICam_Ki -781.25 781.22615814209 /end CHARACTERISTIC
/begin COMPU_METHOD Compu_ICam_Ki " " RAT_FUNC "%.1" "%/CAD/sec" COEFFS 0 41.94304 0 0 0 1 /end COMPU_METHOD
/begin CHARACTERISTIC ECam_Ki "ECam Ki" VALUE 0x00148DB0 /* @ECU_Address@ECam_Ki@0x010042E8@ */ ECIPP_ALIGNMENT_SWORD 781 Compu_ECam_Ki -781.25 781.22615814209 /end CHARACTERISTIC
/begin COMPU_METHOD Compu_ECam_Ki " " RAT_FUNC "%.1" "%/CAD/sec" COEFFS 0 41.94304 0 0 0 1 /end COMPU_METHOD
/begin MEASUREMENT ECam_I_acc "Cam2 integrator value" SLONG Compu_ECam_I_acc 0 0 -3200 3199.99999850988 ECU_ADDRESS 0x01004310 /end MEASUREMENT
/begin COMPU_METHOD Compu_ECam_I_acc " " RAT_FUNC "%.1" "%" COEFFS 0 671088.64 0 0 0 1 /end COMPU_METHOD
/begin MEASUREMENT ECam_coil_Id "Cam2 coil desired current" UWORD Compu_ECam_coil_Id 0 0 0 63.9990234375 ECU_ADDRESS 0x01004318 /end MEASUREMENT
/begin COMPU_METHOD Compu_ECam_coil_Id " " RAT_FUNC "%.2" "amps" COEFFS 0 1024 0 0 0 1 /end COMPU_METHOD
/begin MEASUREMENT ECam_coil_R "Cam2 coil resistance" UWORD Compu_ECam_coil_R 0 0 0 63.9990234375 ECU_ADDRESS 0x01004320 /end MEASUREMENT
/begin COMPU_METHOD Compu_ECam_coil_R " " RAT_FUNC "%.2" "ohms" COEFFS 0 1024 0 0 0 1 /end COMPU_METHOD
/begin MEASUREMENT CL_HW_disable "CL HW disable status{CL_HW_disable&0xff=0:CL Allowed}{CL_HW_disable&0xff=1:CL Disabled}" UBYTE CL_HW_disable_COMPU_VTAB 0 0 0 255 ECU_ADDRESS 0x01004330 BIT_MASK 0xff /end MEASUREMENT
/begin COMPU_METHOD CL_HW_disable_COMPU_VTAB "Verbal Table" TAB_VERB "%.0" "list" COMPU_TAB_REF CL_HW_disable_COMPU_VTAB_REF /end COMPU_METHOD
/begin COMPU_VTAB CL_HW_disable_COMPU_VTAB_REF "Verbal Table" TAB_VERB 2 0 "CL Allowed" 1 "CL Disabled" DEFAULT_VALUE "UNKNOWN" /end COMPU_VTAB
/begin CHARACTERISTIC CL_HW_dis_cfg "CL HW disable input config{CL_HW_dis_cfg&0xff=0:Disabled}{CL_HW_dis_cfg&0xff=1:Aux PU1}{CL_HW_dis_cfg&0xff=2:Aux PU2}{CL_HW_dis_cfg&0xff=3:Aux PU3}{CL_HW_dis_cfg&0xff=4:Aux PUD1}{CL_HW_dis_cfg&0xff=5:Aux PUD2}{CL_HW_dis_cfg&0xff=6:Aux PUD3}{CL_HW_dis_cfg&" VALUE 0x00147cf7 /* @ECU_Address@CL_HW_dis_cfg@0x01004338@ */ ECIPP_ALIGNMENT_UBYTE 255 CL_HW_dis_cfg_COMPU_VTAB 0 255 BIT_MASK 0xff /end CHARACTERISTIC
/begin COMPU_METHOD CL_HW_dis_cfg_COMPU_VTAB "Verbal Table" TAB_VERB "%.0" "list" COMPU_TAB_REF CL_HW_dis_cfg_COMPU_VTAB_REF /end COMPU_METHOD
/begin COMPU_VTAB CL_HW_dis_cfg_COMPU_VTAB_REF "Verbal Table" TAB_VERB 10 0 "Disabled" 1 "Aux PU1" 2 "Aux PU2" 3 "Aux PU3" 4 "Aux PUD1" 5 "Aux PUD2" 6 "Aux PUD3" 7 "Aux DIG1" 8 "Aux DIG2" 9 "Aux DIG3" DEFAULT_VALUE "UNKNOWN" /end COMPU_VTAB
/begin MEASUREMENT CL_fuellev_low "Low fuel monitoring status{CL_fuellev_low&0xff=0:OK}{CL_fuellev_low&0xff=1:Low Fuel}" UBYTE CL_fuellev_low_COMPU_VTAB 0 0 0 255 ECU_ADDRESS 0x01004348 BIT_MASK 0xff /end MEASUREMENT
/begin COMPU_METHOD CL_fuellev_low_COMPU_VTAB "Verbal Table" TAB_VERB "%.0" "list" COMPU_TAB_REF CL_fuellev_low_COMPU_VTAB_REF /end COMPU_METHOD
/begin COMPU_VTAB CL_fuellev_low_COMPU_VTAB_REF "Verbal Table" TAB_VERB 2 0 "OK" 1 "Low Fuel" DEFAULT_VALUE "UNKNOWN" /end COMPU_VTAB
/begin CHARACTERISTIC trim_tran_forceP "+Transient forced valve setpoint" VALUE 0x001418c0 /* @ECU_Address@trim_tran_forceP@0x01004350@ */ ECIPP_ALIGNMENT_UWORD 100 Compu_trim_tran_forceP 0 99.9984741210938 /end CHARACTERISTIC
/begin COMPU_METHOD Compu_trim_tran_forceP " " RAT_FUNC "%.1" "%" COEFFS 0 655.36 0 0 0 1 /end COMPU_METHOD
/begin CHARACTERISTIC trim_ntran_forceP "-Transient forced valve setpoint" VALUE 0x001418be /* @ECU_Address@trim_ntran_forceP@0x01004360@ */ ECIPP_ALIGNMENT_UWORD 100 Compu_trim_ntran_forceP 0 99.9984741210938 /end CHARACTERISTIC
/begin COMPU_METHOD Compu_trim_ntran_forceP " " RAT_FUNC "%.1" "%" COEFFS 0 655.36 0 0 0 1 /end COMPU_METHOD
/begin MEASUREMENT TRIM_BM "TRIM BM" SWORD Compu_TRIM_BM 0 0 -100 99.9969482421875 ECU_ADDRESS 0x01004380 /end MEASUREMENT
/begin COMPU_METHOD Compu_TRIM_BM " " RAT_FUNC "%.1" "%" COEFFS 0 327.68 0 0 0 1 /end COMPU_METHOD
/begin MEASUREMENT TRIM_min_BM "TRIM min BM" SWORD Compu_TRIM_min_BM 0 0 -100 99.9969482421875 ECU_ADDRESS 0x01004388 /end MEASUREMENT
/begin COMPU_METHOD Compu_TRIM_min_BM " " RAT_FUNC "%.1" "%" COEFFS 0 327.68 0 0 0 1 /end COMPU_METHOD
/begin MEASUREMENT TRIM_max_BM "TRIM max BM" SWORD Compu_TRIM_max_BM 0 0 -100 99.9969482421875 ECU_ADDRESS 0x01004390 /end MEASUREMENT
/begin COMPU_METHOD Compu_TRIM_max_BM " " RAT_FUNC "%.1" "%" COEFFS 0 327.68 0 0 0 1 /end COMPU_METHOD
/begin CHARACTERISTIC Cam_strt_I "Cam engine-starting current" VALUE 0x00146770 /* @ECU_Address@Cam_strt_I@0x010047C0@ */ ECIPP_ALIGNMENT_UWORD 64 Compu_Cam_strt_I 0 63.9990234375 /end CHARACTERISTIC
/begin COMPU_METHOD Compu_Cam_strt_I " " RAT_FUNC "%.2" "amps" COEFFS 0 1024 0 0 0 1 /end COMPU_METHOD
/begin CHARACTERISTIC Cam_strt_tout "Cam engine-starting base timeout" VALUE 0x001440b8 /* @ECU_Address@Cam_strt_tout@0x010047C8@ */ ECIPP_ALIGNMENT_ULONG 4294967 Compu_Cam_strt_tout 0 4294967.295 /end CHARACTERISTIC
/begin COMPU_METHOD Compu_Cam_strt_tout " " RAT_FUNC "%.3" "sec" COEFFS 0 1000 0 0 0 1 /end COMPU_METHOD
/begin MEASUREMENT CBT_ss "Steady-state catalyst bed temperature" UWORD Compu_CBT_ss 0 0 -460 7731.875 ECU_ADDRESS 0x010047D8 /end MEASUREMENT
/begin COMPU_METHOD Compu_CBT_ss " " RAT_FUNC "%.0" "deg F" COEFFS 0 8 3680 0 0 1 /end COMPU_METHOD
/begin MEASUREMENT CBT_tauactv "CTM currently active time constant" UWORD Compu_CBT_tauactv 0 0 0 1048.56 ECU_ADDRESS 0x010047E0 /end MEASUREMENT
/begin COMPU_METHOD Compu_CBT_tauactv " " RAT_FUNC "%.1" "sec" COEFFS 0 62.5 0 0 0 1 /end COMPU_METHOD
/begin MEASUREMENT CTM_dppredT "CTM pre-cat delta-phi/delta-T gain" SWORD Compu_CTM_dppredT 0 0 -0.09765625 9.76532697677612E-02 ECU_ADDRESS 0x010047E8 /end MEASUREMENT
/begin COMPU_METHOD Compu_CTM_dppredT " " RAT_FUNC "%.4" "dphi/100 F" COEFFS 0 335544.32 0 0 0 1 /end COMPU_METHOD
/begin MEASUREMENT CTM_dppre "CTM pre-cat delta-phi adjustment" SWORD Compu_CTM_dppre 0 0 -2 1.99993896484375 ECU_ADDRESS 0x010047F0 /end MEASUREMENT
/begin COMPU_METHOD Compu_CTM_dppre " " RAT_FUNC "%.3" "delta-phi" COEFFS 0 16384 0 0 0 1 /end COMPU_METHOD
/begin CHARACTERISTIC CTM_tau_source "CTM tau source{CTM_tau_source&0xff=0:Single-Point}{CTM_tau_source&0xff=1:Table-Based}" VALUE 0x00148CE2 /* @ECU_Address@CTM_tau_source@0x01004808@ */ ECIPP_ALIGNMENT_UBYTE 255 CTM_tau_source_COMPU_VTAB 0 255 BIT_MASK 0xff /end CHARACTERISTIC
/begin COMPU_METHOD CTM_tau_source_COMPU_VTAB "Verbal Table" TAB_VERB "%.0" "list" COMPU_TAB_REF CTM_tau_source_COMPU_VTAB_REF /end COMPU_METHOD
/begin COMPU_VTAB CTM_tau_source_COMPU_VTAB_REF "Verbal Table" TAB_VERB 2 0 "Single-Point" 1 "Table-Based" DEFAULT_VALUE "UNKNOWN" /end COMPU_VTAB
/begin CHARACTERISTIC CTMA_tau_source "CTM tau source{CTMA_tau_source&0xff=0:Single-Point}{CTMA_tau_source&0xff=1:Table-Based}" VALUE 0x00148CC2 /* @ECU_Address@CTMA_tau_source@0x01004810@ */ ECIPP_ALIGNMENT_UBYTE 255 CTMA_tau_source_COMPU_VTAB 0 255 BIT_MASK 0xff /end CHARACTERISTIC
/begin COMPU_METHOD CTMA_tau_source_COMPU_VTAB "Verbal Table" TAB_VERB "%.0" "list" COMPU_TAB_REF CTMA_tau_source_COMPU_VTAB_REF /end COMPU_METHOD
/begin COMPU_VTAB CTMA_tau_source_COMPU_VTAB_REF "Verbal Table" TAB_VERB 2 0 "Single-Point" 1 "Table-Based" DEFAULT_VALUE "UNKNOWN" /end COMPU_VTAB
/begin CHARACTERISTIC CL_TD_enable "CL acquire transport delay{CL_TD_enable&0xff=0:Disabled}{CL_TD_enable&0xff=1:Enabled}" VALUE 0x001433D8 /* @ECU_Address@CL_TD_enable@0x01004A48@ */ ECIPP_ALIGNMENT_UBYTE 255 CL_TD_enable_COMPU_VTAB 0 255 BIT_MASK 0xff /end CHARACTERISTIC
/begin COMPU_METHOD CL_TD_enable_COMPU_VTAB "Verbal Table" TAB_VERB "%.0" "list" COMPU_TAB_REF CL_TD_enable_COMPU_VTAB_REF /end COMPU_METHOD
/begin COMPU_VTAB CL_TD_enable_COMPU_VTAB_REF "Verbal Table" TAB_VERB 2 0 "Disabled" 1 "Enabled" DEFAULT_VALUE "UNKNOWN" /end COMPU_VTAB
/begin CHARACTERISTIC CL_TD_max_p "CL acquire max rich overshoot" VALUE 0x001433D0 /* @ECU_Address@CL_TD_max_p@0x01004A50@ */ ECIPP_ALIGNMENT_SWORD 100 Compu_CL_TD_max_p -100 99.9969482421875 /end CHARACTERISTIC
/begin COMPU_METHOD Compu_CL_TD_max_p " " RAT_FUNC "%.1" "%" COEFFS 0 327.68 0 0 0 1 /end COMPU_METHOD
/begin CHARACTERISTIC CL_TD_max_n "CL acquire max lean overshoot" VALUE 0x001433CE /* @ECU_Address@CL_TD_max_n@0x01004A58@ */ ECIPP_ALIGNMENT_SWORD 100 Compu_CL_TD_max_n -100 99.9969482421875 /end CHARACTERISTIC
/begin COMPU_METHOD Compu_CL_TD_max_n " " RAT_FUNC "%.1" "%" COEFFS 0 327.68 0 0 0 1 /end COMPU_METHOD
/begin CHARACTERISTIC CL_TD_EGOsw_ena "EGO switch acquisition mode{CL_TD_EGOsw_ena&0xff=0:Disabled}{CL_TD_EGOsw_ena&0xff=1:Enabled}" VALUE 0x001433D9 /* @ECU_Address@CL_TD_EGOsw_ena@0x01004A60@ */ ECIPP_ALIGNMENT_UBYTE 255 CL_TD_EGOsw_ena_COMPU_VTAB 0 255 BIT_MASK 0xff /end CHARACTERISTIC
/begin COMPU_METHOD CL_TD_EGOsw_ena_COMPU_VTAB "Verbal Table" TAB_VERB "%.0" "list" COMPU_TAB_REF CL_TD_EGOsw_ena_COMPU_VTAB_REF /end COMPU_METHOD
/begin COMPU_VTAB CL_TD_EGOsw_ena_COMPU_VTAB_REF "Verbal Table" TAB_VERB 2 0 "Disabled" 1 "Enabled" DEFAULT_VALUE "UNKNOWN" /end COMPU_VTAB
/begin CHARACTERISTIC CL_TD_sw_offset "EGO switch delay offset" VALUE 0x001433D2 /* @ECU_Address@CL_TD_sw_offset@0x01004A68@ */ ECIPP_ALIGNMENT_SWORD 100 Compu_CL_TD_sw_offset -100 99.9969482421875 /end CHARACTERISTIC
/begin COMPU_METHOD Compu_CL_TD_sw_offset " " RAT_FUNC "%.1" "%" COEFFS 0 327.68 0 0 0 1 /end COMPU_METHOD
/begin CHARACTERISTIC CL_TD_sw_pct "EGO switch initial step" VALUE 0x001433D4 /* @ECU_Address@CL_TD_sw_pct@0x01004A70@ */ ECIPP_ALIGNMENT_UWORD 200 Compu_CL_TD_sw_pct 0 199.996948242188 /end CHARACTERISTIC
/begin COMPU_METHOD Compu_CL_TD_sw_pct " " RAT_FUNC "%.1" "%" COEFFS 0 327.68 0 0 0 1 /end COMPU_METHOD
/begin CHARACTERISTIC CLLP_TD_enable "CL acquire transport delay{CLLP_TD_enable&0xff=0:Disabled}{CLLP_TD_enable&0xff=1:Enabled}" VALUE 0x00141920 /* @ECU_Address@CLLP_TD_enable@0x01004A78@ */ ECIPP_ALIGNMENT_UBYTE 255 CLLP_TD_enable_COMPU_VTAB 0 255 BIT_MASK 0xff /end CHARACTERISTIC
/begin COMPU_METHOD CLLP_TD_enable_COMPU_VTAB "Verbal Table" TAB_VERB "%.0" "list" COMPU_TAB_REF CLLP_TD_enable_COMPU_VTAB_REF /end COMPU_METHOD
/begin COMPU_VTAB CLLP_TD_enable_COMPU_VTAB_REF "Verbal Table" TAB_VERB 2 0 "Disabled" 1 "Enabled" DEFAULT_VALUE "UNKNOWN" /end COMPU_VTAB
/begin CHARACTERISTIC CLLP_TD_max_p "CL acquire max rich overshoot" VALUE 0x00141918 /* @ECU_Address@CLLP_TD_max_p@0x01004A80@ */ ECIPP_ALIGNMENT_SWORD 100 Compu_CLLP_TD_max_p -100 99.9969482421875 /end CHARACTERISTIC
/begin COMPU_METHOD Compu_CLLP_TD_max_p " " RAT_FUNC "%.1" "%" COEFFS 0 327.68 0 0 0 1 /end COMPU_METHOD
/begin CHARACTERISTIC CLLP_TD_max_n "CL acquire max lean overshoot" VALUE 0x00141916 /* @ECU_Address@CLLP_TD_max_n@0x01004A88@ */ ECIPP_ALIGNMENT_SWORD 100 Compu_CLLP_TD_max_n -100 99.9969482421875 /end CHARACTERISTIC
/begin COMPU_METHOD Compu_CLLP_TD_max_n " " RAT_FUNC "%.1" "%" COEFFS 0 327.68 0 0 0 1 /end COMPU_METHOD
/begin CHARACTERISTIC CLLP_TD_EGOsw_ena "EGO switch acquisition mode{CLLP_TD_EGOsw_ena&0xff=0:Disabled}{CLLP_TD_EGOsw_ena&0xff=1:Enabled}" VALUE 0x00141921 /* @ECU_Address@CLLP_TD_EGOsw_ena@0x01004A90@ */ ECIPP_ALIGNMENT_UBYTE 255 CLLP_TD_EGOsw_ena_COMPU_VTAB 0 255 BIT_MASK 0xff /end CHARACTERISTIC
/begin COMPU_METHOD CLLP_TD_EGOsw_ena_COMPU_VTAB "Verbal Table" TAB_VERB "%.0" "list" COMPU_TAB_REF CLLP_TD_EGOsw_ena_COMPU_VTAB_REF /end COMPU_METHOD
/begin COMPU_VTAB CLLP_TD_EGOsw_ena_COMPU_VTAB_REF "Verbal Table" TAB_VERB 2 0 "Disabled" 1 "Enabled" DEFAULT_VALUE "UNKNOWN" /end COMPU_VTAB
/begin CHARACTERISTIC CLLP_TD_sw_offset "EGO switch delay offset" VALUE 0x0014191A /* @ECU_Address@CLLP_TD_sw_offset@0x01004A98@ */ ECIPP_ALIGNMENT_SWORD 100 Compu_CLLP_TD_sw_offset -100 99.9969482421875 /end CHARACTERISTIC
/begin COMPU_METHOD Compu_CLLP_TD_sw_offset " " RAT_FUNC "%.1" "%" COEFFS 0 327.68 0 0 0 1 /end COMPU_METHOD
/begin CHARACTERISTIC CLLP_TD_sw_pct "EGO switch initial step" VALUE 0x0014191C /* @ECU_Address@CLLP_TD_sw_pct@0x01004AA0@ */ ECIPP_ALIGNMENT_UWORD 200 Compu_CLLP_TD_sw_pct 0 199.996948242188 /end CHARACTERISTIC
/begin COMPU_METHOD Compu_CLLP_TD_sw_pct " " RAT_FUNC "%.1" "%" COEFFS 0 327.68 0 0 0 1 /end COMPU_METHOD
/begin MEASUREMENT MAPrsc_trim "BP rescaled MAP trim index" UWORD Compu_MAPrsc_trim 0 0 0 255.99609375 ECU_ADDRESS 0x01004B38 /end MEASUREMENT
/begin COMPU_METHOD Compu_MAPrsc_trim " " RAT_FUNC "%.2" "psia" COEFFS 0 256 0 0 0 1 /end COMPU_METHOD
/begin MEASUREMENT MAPrsc_max_trim "Max MAP for BP-MAP trim rescaling" UWORD Compu_MAPrsc_max_trim 0 0 0 255.99609375 ECU_ADDRESS 0x01004B48 /end MEASUREMENT
/begin COMPU_METHOD Compu_MAPrsc_max_trim " " RAT_FUNC "%.2" "psia" COEFFS 0 256 0 0 0 1 /end COMPU_METHOD
/begin CHARACTERISTIC MAPrsc_min_trim "Min MAP for BP-MAP trim rescaling" VALUE 0x001475c6 /* @ECU_Address@MAPrsc_min_trim@0x01004B58@ */ ECIPP_ALIGNMENT_UWORD 256 Compu_MAPrsc_min_trim 0 255.99609375 /end CHARACTERISTIC
/begin COMPU_METHOD Compu_MAPrsc_min_trim " " RAT_FUNC "%.2" "psia" COEFFS 0 256 0 0 0 1 /end COMPU_METHOD
/begin CHARACTERISTIC CL_rst_postcat "Postcat inactive delta-phi reset{CL_rst_postcat&0xff=0:Do not reset}{CL_rst_postcat&0xff=1:Reset temporarily}{CL_rst_postcat&0xff=2:Reset completely}" VALUE 0x001433DB /* @ECU_Address@CL_rst_postcat@0x01005048@ */ ECIPP_ALIGNMENT_UBYTE 255 CL_rst_postcat_COMPU_VTAB 0 255 BIT_MASK 0xff /end CHARACTERISTIC
/begin COMPU_METHOD CL_rst_postcat_COMPU_VTAB "Verbal Table" TAB_VERB "%.0" "list" COMPU_TAB_REF CL_rst_postcat_COMPU_VTAB_REF /end COMPU_METHOD
/begin COMPU_VTAB CL_rst_postcat_COMPU_VTAB_REF "Verbal Table" TAB_VERB 3 0 "Do not reset" 1 "Reset temporarily" 2 "Reset completely" DEFAULT_VALUE "UNKNOWN" /end COMPU_VTAB
/begin CHARACTERISTIC CLLP_rst_postcat "Postcat inactive delta-phi reset{CLLP_rst_postcat&0xff=0:Do not reset}{CLLP_rst_postcat&0xff=1:Reset temporarily}{CLLP_rst_postcat&0xff=2:Reset completely}" VALUE 0x00141923 /* @ECU_Address@CLLP_rst_postcat@0x01005050@ */ ECIPP_ALIGNMENT_UBYTE 255 CLLP_rst_postcat_COMPU_VTAB 0 255 BIT_MASK 0xff /end CHARACTERISTIC
/begin COMPU_METHOD CLLP_rst_postcat_COMPU_VTAB "Verbal Table" TAB_VERB "%.0" "list" COMPU_TAB_REF CLLP_rst_postcat_COMPU_VTAB_REF /end COMPU_METHOD
/begin COMPU_VTAB CLLP_rst_postcat_COMPU_VTAB_REF "Verbal Table" TAB_VERB 3 0 "Do not reset" 1 "Reset temporarily" 2 "Reset completely" DEFAULT_VALUE "UNKNOWN" /end COMPU_VTAB
/begin CHARACTERISTIC CL_TD_mdota "CL acquire min port air flow rate" VALUE 0x001433D6 /* @ECU_Address@CL_TD_mdota@0x01005EB8@ */ ECIPP_ALIGNMENT_UWORD 1024 Compu_CL_TD_mdota 0 1023.984375 /end CHARACTERISTIC
/begin COMPU_METHOD Compu_CL_TD_mdota " " RAT_FUNC "%.1" "g/sec" COEFFS 0 64 0 0 0 1 /end COMPU_METHOD
/begin CHARACTERISTIC CLLP_TD_mdota "CL acquire min port air flow rate" VALUE 0x0014191E /* @ECU_Address@CLLP_TD_mdota@0x01005EC0@ */ ECIPP_ALIGNMENT_UWORD 1024 Compu_CLLP_TD_mdota 0 1023.984375 /end CHARACTERISTIC
/begin COMPU_METHOD Compu_CLLP_TD_mdota " " RAT_FUNC "%.1" "g/sec" COEFFS 0 64 0 0 0 1 /end COMPU_METHOD
/begin CHARACTERISTIC CL_control_type "CL control type{CL_control_type&0xff=0:Switching (EGO or UEGO)}{CL_control_type&0xff=1:Continuous (UEGO Only)}" VALUE 0x00147cf8 /* @ECU_Address@CL_control_type@0x01005FE0@ */ ECIPP_ALIGNMENT_UBYTE 255 CL_control_type_COMPU_VTAB 0 255 BIT_MASK 0xff /end CHARACTERISTIC
/begin COMPU_METHOD CL_control_type_COMPU_VTAB "Verbal Table" TAB_VERB "%.0" "list" COMPU_TAB_REF CL_control_type_COMPU_VTAB_REF /end COMPU_METHOD
/begin COMPU_VTAB CL_control_type_COMPU_VTAB_REF "Verbal Table" TAB_VERB 2 0 "Switching (EGO or UEGO)" 1 "Continuous (UEGO Only)" DEFAULT_VALUE "UNKNOWN" /end COMPU_VTAB
/begin CHARACTERISTIC MJ_nom_crkslwdP "Cranking final/slewed EPR setpoint" VALUE 0x001409f4 /* @ECU_Address@MJ_nom_crkslwdP@0x01006A28@ */ ECIPP_ALIGNMENT_SWORD 222 Compu_MJ_nom_crkslwdP -222 221.993225097656 /end CHARACTERISTIC
/begin COMPU_METHOD Compu_MJ_nom_crkslwdP " " RAT_FUNC "%.2" "in H2O" COEFFS 0 147.603603603604 0 0 0 1 /end COMPU_METHOD
/begin CHARACTERISTIC MJ_crk_holdP "Cranking initial EPR setpoint hold" VALUE 0x001418ac /* @ECU_Address@MJ_crk_holdP@0x01006A38@ */ ECIPP_ALIGNMENT_UWORD 256 Compu_MJ_crk_holdP 0 255.99609375 /end CHARACTERISTIC
/begin COMPU_METHOD Compu_MJ_crk_holdP " " RAT_FUNC "%.2" "cycles" COEFFS 0 256 0 0 0 1 /end COMPU_METHOD
/begin CHARACTERISTIC MJ_crk_slewP "Cranking transition EPR setpoint slew" VALUE 0x001418b0 /* @ECU_Address@MJ_crk_slewP@0x01006A40@ */ ECIPP_ALIGNMENT_UWORD 256 Compu_MJ_crk_slewP 0 255.99609375 /end CHARACTERISTIC
/begin COMPU_METHOD Compu_MJ_crk_slewP " " RAT_FUNC "%.2" "cycles" COEFFS 0 256 0 0 0 1 /end COMPU_METHOD
/begin CHARACTERISTIC MJ_crk_run_slewP "Run mode EPR maximum slew" VALUE 0x001418ae /* @ECU_Address@MJ_crk_run_slewP@0x01007830@ */ ECIPP_ALIGNMENT_UWORD 444 Compu_MJ_crk_run_slewP 0 443.993225097656 /end CHARACTERISTIC
/begin COMPU_METHOD Compu_MJ_crk_run_slewP " " RAT_FUNC "%.2" "H20" COEFFS 0 147.603603603604 0 0 0 1 /end COMPU_METHOD
/begin CHARACTERISTIC CLacq_lmt_step "Fast CL Acquire Step Limiting{CLacq_lmt_step&0xff=0:Disabled}{CLacq_lmt_step&0xff=1:Enabled}" VALUE 0x00147cfe /* @ECU_Address@CLacq_lmt_step@0x01007860@ */ ECIPP_ALIGNMENT_UBYTE 255 CLacq_lmt_step_COMPU_VTAB 0 255 BIT_MASK 0xff /end CHARACTERISTIC
/begin COMPU_METHOD CLacq_lmt_step_COMPU_VTAB "Verbal Table" TAB_VERB "%.0" "list" COMPU_TAB_REF CLacq_lmt_step_COMPU_VTAB_REF /end COMPU_METHOD
/begin COMPU_VTAB CLacq_lmt_step_COMPU_VTAB_REF "Verbal Table" TAB_VERB 2 0 "Disabled" 1 "Enabled" DEFAULT_VALUE "UNKNOWN" /end COMPU_VTAB
/begin MEASUREMENT Phi_UEGO2 "UEGO phi" UWORD Compu_Phi_UEGO2 0 0 0 3.99993896484375 ECU_ADDRESS 0x01007D50 /end MEASUREMENT
/begin COMPU_METHOD Compu_Phi_UEGO2 " " RAT_FUNC "%.3" "phi" COEFFS 0 16384 0 0 0 1 /end COMPU_METHOD
/begin MEASUREMENT UEGO2_mode "UEGO mode{UEGO2_mode&0xff=0xfe:Invalid}{UEGO2_mode&0xff=0xff:Fault}{UEGO2_mode&0xff=0x00:Off}{UEGO2_mode&0xff=0x01:Warming}{UEGO2_mode&0xff=0x02:Waiting}{UEGO2_mode&0xff=0x03:Active}" UBYTE UEGO2_mode_COMPU_VTAB 0 0 0 255 ECU_ADDRESS 0x01007D60 BIT_MASK 0xff /end MEASUREMENT
/begin COMPU_METHOD UEGO2_mode_COMPU_VTAB "Verbal Table" TAB_VERB "%.0" "list" COMPU_TAB_REF UEGO2_mode_COMPU_VTAB_REF /end COMPU_METHOD
/begin COMPU_VTAB UEGO2_mode_COMPU_VTAB_REF "Verbal Table" TAB_VERB 6 0xfe "Invalid" 0xff "Fault" 0x00 "Off" 0x01 "Warming" 0x02 "Waiting" 0x03 "Active" DEFAULT_VALUE "UNKNOWN" /end COMPU_VTAB
/begin MEASUREMENT Cam_strt_textra "Cam engine-starting additional timeout" ULONG Compu_Cam_strt_textra 0 0 0 4294967.295 ECU_ADDRESS 0x01008678 /end MEASUREMENT
/begin COMPU_METHOD Compu_Cam_strt_textra " " RAT_FUNC "%.3" "sec" COEFFS 0 1000 0 0 0 1 /end COMPU_METHOD
/begin CHARACTERISTIC Cam_pin_ena "Cam fault auto pin-unlock phase1-3 logic{Cam_pin_ena&0xff=0:Disabled}{Cam_pin_ena&0xff=1:Enabled}" VALUE 0x00147d06 /* @ECU_Address@Cam_pin_ena@0x01008680@ */ ECIPP_ALIGNMENT_UBYTE 255 Cam_pin_ena_COMPU_VTAB 0 255 BIT_MASK 0xff /end CHARACTERISTIC
/begin COMPU_METHOD Cam_pin_ena_COMPU_VTAB "Verbal Table" TAB_VERB "%.0" "list" COMPU_TAB_REF Cam_pin_ena_COMPU_VTAB_REF /end COMPU_METHOD
/begin COMPU_VTAB Cam_pin_ena_COMPU_VTAB_REF "Verbal Table" TAB_VERB 2 0 "Disabled" 1 "Enabled" DEFAULT_VALUE "UNKNOWN" /end COMPU_VTAB
/begin CHARACTERISTIC Cam_pin_tout "Cam fault phase1 start-current pulse time" VALUE 0x0014676e /* @ECU_Address@Cam_pin_tout@0x01008688@ */ ECIPP_ALIGNMENT_UWORD 65535 Compu_Cam_pin_tout 0 65535 /end CHARACTERISTIC
/begin COMPU_METHOD Compu_Cam_pin_tout " " RAT_FUNC "%.0" "ms" COEFFS 0 1 0 0 0 1 /end COMPU_METHOD
/begin MEASUREMENT IC_pin_pulse_try "Cam1 fault pin-unlock activity{IC_pin_pulse_try&0xff=0:Inactive}{IC_pin_pulse_try&0xff=1:Pulsing}" UBYTE IC_pin_pulse_try_COMPU_VTAB 0 0 0 255 ECU_ADDRESS 0x01008690 BIT_MASK 0xff /end MEASUREMENT
/begin COMPU_METHOD IC_pin_pulse_try_COMPU_VTAB "Verbal Table" TAB_VERB "%.0" "list" COMPU_TAB_REF IC_pin_pulse_try_COMPU_VTAB_REF /end COMPU_METHOD
/begin COMPU_VTAB IC_pin_pulse_try_COMPU_VTAB_REF "Verbal Table" TAB_VERB 2 0 "Inactive" 1 "Pulsing" DEFAULT_VALUE "UNKNOWN" /end COMPU_VTAB
/begin MEASUREMENT EC_pin_pulse_try "Cam2 fault pin-unlock activity{EC_pin_pulse_try&0xff=0:Inactive}{EC_pin_pulse_try&0xff=1:Pulsing}" UBYTE EC_pin_pulse_try_COMPU_VTAB 0 0 0 255 ECU_ADDRESS 0x01008698 BIT_MASK 0xff /end MEASUREMENT
/begin COMPU_METHOD EC_pin_pulse_try_COMPU_VTAB "Verbal Table" TAB_VERB "%.0" "list" COMPU_TAB_REF EC_pin_pulse_try_COMPU_VTAB_REF /end COMPU_METHOD
/begin COMPU_VTAB EC_pin_pulse_try_COMPU_VTAB_REF "Verbal Table" TAB_VERB 2 0 "Inactive" 1 "Pulsing" DEFAULT_VALUE "UNKNOWN" /end COMPU_VTAB
/begin MEASUREMENT IC_pin_pulse_arm "Cam1 fault pin-unlock logic{IC_pin_pulse_arm&0xff=0:Disarmed}{IC_pin_pulse_arm&0xff=1:Armed}" UBYTE IC_pin_pulse_arm_COMPU_VTAB 0 0 0 255 ECU_ADDRESS 0x010086A0 BIT_MASK 0xff /end MEASUREMENT
/begin COMPU_METHOD IC_pin_pulse_arm_COMPU_VTAB "Verbal Table" TAB_VERB "%.0" "list" COMPU_TAB_REF IC_pin_pulse_arm_COMPU_VTAB_REF /end COMPU_METHOD
/begin COMPU_VTAB IC_pin_pulse_arm_COMPU_VTAB_REF "Verbal Table" TAB_VERB 2 0 "Disarmed" 1 "Armed" DEFAULT_VALUE "UNKNOWN" /end COMPU_VTAB
/begin MEASUREMENT EC_pin_pulse_arm "Cam2 fault pin-unlock logic{EC_pin_pulse_arm&0xff=0:Disarmed}{EC_pin_pulse_arm&0xff=1:Armed}" UBYTE EC_pin_pulse_arm_COMPU_VTAB 0 0 0 255 ECU_ADDRESS 0x010086A8 BIT_MASK 0xff /end MEASUREMENT
/begin COMPU_METHOD EC_pin_pulse_arm_COMPU_VTAB "Verbal Table" TAB_VERB "%.0" "list" COMPU_TAB_REF EC_pin_pulse_arm_COMPU_VTAB_REF /end COMPU_METHOD
/begin COMPU_VTAB EC_pin_pulse_arm_COMPU_VTAB_REF "Verbal Table" TAB_VERB 2 0 "Disarmed" 1 "Armed" DEFAULT_VALUE "UNKNOWN" /end COMPU_VTAB
/begin CHARACTERISTIC CL_switch_type "CL switching type{CL_switch_type&0xff=0:Legacy Asymmetric (EGO or UEGO)}{CL_switch_type&0xff=1:Corrected Asymmetric (EGO or UEGO)}{CL_switch_type&0xff=2:Symmetric (UEGO Only)}" VALUE 0x00147cfd /* @ECU_Address@CL_switch_type@0x01008CA8@ */ ECIPP_ALIGNMENT_UBYTE 255 CL_switch_type_COMPU_VTAB 0 255 BIT_MASK 0xff /end CHARACTERISTIC
/begin COMPU_METHOD CL_switch_type_COMPU_VTAB "Verbal Table" TAB_VERB "%.0" "list" COMPU_TAB_REF CL_switch_type_COMPU_VTAB_REF /end COMPU_METHOD
/begin COMPU_VTAB CL_switch_type_COMPU_VTAB_REF "Verbal Table" TAB_VERB 3 0 "Legacy Asymmetric (EGO or UEGO)" 1 "Corrected Asymmetric (EGO or UEGO)" 2 "Symmetric (UEGO Only)" DEFAULT_VALUE "UNKNOWN" /end COMPU_VTAB
/begin MEASUREMENT T_delay_FB "Transport delay" UWORD Compu_T_delay_FB 0 0 0 65535 ECU_ADDRESS 0x0100B1F0 /end MEASUREMENT
/begin COMPU_METHOD Compu_T_delay_FB " " RAT_FUNC "%.0" "ms" COEFFS 0 1 0 0 0 1 /end COMPU_METHOD
/begin CHARACTERISTIC Tcambmp_dur "Cam-bump pulse duration" VALUE 0x00147964 /* @ECU_Address@Tcambmp_dur@0x0100B4A8@ */ ECIPP_ALIGNMENT_UWORD 65535 Compu_Tcambmp_dur 0 65535 /end CHARACTERISTIC
/begin COMPU_METHOD Compu_Tcambmp_dur " " RAT_FUNC "%.0" "ms" COEFFS 0 1 0 0 0 1 /end COMPU_METHOD
/begin CHARACTERISTIC Tcambmp_I "Cam-bump pulse current" VALUE 0x00147962 /* @ECU_Address@Tcambmp_I@0x0100B4B0@ */ ECIPP_ALIGNMENT_UWORD 64 Compu_Tcambmp_I 0 63.9990234375 /end CHARACTERISTIC
/begin COMPU_METHOD Compu_Tcambmp_I " " RAT_FUNC "%.2" "amps" COEFFS 0 1024 0 0 0 1 /end COMPU_METHOD
/begin CHARACTERISTIC Tcambmp_keyon "Cam-bump at key-on/engine-stopped{Tcambmp_keyon&0xff=0:Disabled}{Tcambmp_keyon&0xff=1:Enabled}" VALUE 0x001480c9 /* @ECU_Address@Tcambmp_keyon@0x0100B8C0@ */ ECIPP_ALIGNMENT_UBYTE 255 Tcambmp_keyon_COMPU_VTAB 0 255 BIT_MASK 0xff /end CHARACTERISTIC
/begin COMPU_METHOD Tcambmp_keyon_COMPU_VTAB "Verbal Table" TAB_VERB "%.0" "list" COMPU_TAB_REF Tcambmp_keyon_COMPU_VTAB_REF /end COMPU_METHOD
/begin COMPU_VTAB Tcambmp_keyon_COMPU_VTAB_REF "Verbal Table" TAB_VERB 2 0 "Disabled" 1 "Enabled" DEFAULT_VALUE "UNKNOWN" /end COMPU_VTAB
/begin CHARACTERISTIC Tcambmp_auto "Cam fault phase3 bump{Tcambmp_auto&0xff=0:Disabled}{Tcambmp_auto&0xff=1:Enabled}" VALUE 0x001480c8 /* @ECU_Address@Tcambmp_auto@0x0100B8C8@ */ ECIPP_ALIGNMENT_UBYTE 255 Tcambmp_auto_COMPU_VTAB 0 255 BIT_MASK 0xff /end CHARACTERISTIC
/begin COMPU_METHOD Tcambmp_auto_COMPU_VTAB "Verbal Table" TAB_VERB "%.0" "list" COMPU_TAB_REF Tcambmp_auto_COMPU_VTAB_REF /end COMPU_METHOD
/begin COMPU_VTAB Tcambmp_auto_COMPU_VTAB_REF "Verbal Table" TAB_VERB 2 0 "Disabled" 1 "Enabled" DEFAULT_VALUE "UNKNOWN" /end COMPU_VTAB
/begin CHARACTERISTIC Camrat_ena "Cam fault phase2 rattle{Camrat_ena&0xff=0:Disabled}{Camrat_ena&0xff=1:Enabled}" VALUE 0x00147d07 /* @ECU_Address@Camrat_ena@0x0100B8D0@ */ ECIPP_ALIGNMENT_UBYTE 255 Camrat_ena_COMPU_VTAB 0 255 BIT_MASK 0xff /end CHARACTERISTIC
/begin COMPU_METHOD Camrat_ena_COMPU_VTAB "Verbal Table" TAB_VERB "%.0" "list" COMPU_TAB_REF Camrat_ena_COMPU_VTAB_REF /end COMPU_METHOD
/begin COMPU_VTAB Camrat_ena_COMPU_VTAB_REF "Verbal Table" TAB_VERB 2 0 "Disabled" 1 "Enabled" DEFAULT_VALUE "UNKNOWN" /end COMPU_VTAB
/begin CHARACTERISTIC Camrat_pulse_cnt "Cam fault phase2 rattle pulse count" VALUE 0x0014677e /* @ECU_Address@Camrat_pulse_cnt@0x0100B8D8@ */ ECIPP_ALIGNMENT_UWORD 65535 Compu_Camrat_pulse_cnt 0 65535 /end CHARACTERISTIC
/begin COMPU_METHOD Compu_Camrat_pulse_cnt " " RAT_FUNC "%.0" "pulses" COEFFS 0 1 0 0 0 1 /end COMPU_METHOD
/begin CHARACTERISTIC Camrat_hi_time "Cam fault phase2 rattle hi-time" VALUE 0x00146778 /* @ECU_Address@Camrat_hi_time@0x0100B8E0@ */ ECIPP_ALIGNMENT_UWORD 65535 Compu_Camrat_hi_time 0 65535 /end CHARACTERISTIC
/begin COMPU_METHOD Compu_Camrat_hi_time " " RAT_FUNC "%.0" "ms" COEFFS 0 1 0 0 0 1 /end COMPU_METHOD
/begin CHARACTERISTIC Camrat_lo_time "Cam fault phase2 rattle lo-time" VALUE 0x0014677c /* @ECU_Address@Camrat_lo_time@0x0100B8E8@ */ ECIPP_ALIGNMENT_UWORD 65535 Compu_Camrat_lo_time 0 65535 /end CHARACTERISTIC
/begin COMPU_METHOD Compu_Camrat_lo_time " " RAT_FUNC "%.0" "ms" COEFFS 0 1 0 0 0 1 /end COMPU_METHOD
/begin CHARACTERISTIC Camrat_hi_start_I "Cam fault phase2 rattle hi start current" VALUE 0x00146776 /* @ECU_Address@Camrat_hi_start_I@0x0100B8F0@ */ ECIPP_ALIGNMENT_UWORD 64 Compu_Camrat_hi_start_I 0 63.9990234375 /end CHARACTERISTIC
/begin COMPU_METHOD Compu_Camrat_hi_start_I " " RAT_FUNC "%.2" "amps" COEFFS 0 1024 0 0 0 1 /end COMPU_METHOD
/begin CHARACTERISTIC Camrat_hi_end_I "Cam fault phase2 rattle hi end current" VALUE 0x00146774 /* @ECU_Address@Camrat_hi_end_I@0x0100B8F8@ */ ECIPP_ALIGNMENT_UWORD 64 Compu_Camrat_hi_end_I 0 63.9990234375 /end CHARACTERISTIC
/begin COMPU_METHOD Compu_Camrat_hi_end_I " " RAT_FUNC "%.2" "amps" COEFFS 0 1024 0 0 0 1 /end COMPU_METHOD
/begin CHARACTERISTIC Camrat_lo_I "Cam fault phase2 rattle lo current" VALUE 0x0014677a /* @ECU_Address@Camrat_lo_I@0x0100B900@ */ ECIPP_ALIGNMENT_UWORD 64 Compu_Camrat_lo_I 0 63.9990234375 /end CHARACTERISTIC
/begin COMPU_METHOD Compu_Camrat_lo_I " " RAT_FUNC "%.2" "amps" COEFFS 0 1024 0 0 0 1 /end COMPU_METHOD
/begin MEASUREMENT IC_pin_pulse_state "Cam1 fault pin-unlock state machine{IC_pin_pulse_state&0xff=0:Inactive}{IC_pin_pulse_state&0xff=1:Initiated}{IC_pin_pulse_state&0xff=2:Start-current pulse active}{IC_pin_pulse_state&0xff=3:Waiting - Cam-rattle next}{IC_pin_pulse_state&0xff=4:Cam-rattle pu" UBYTE IC_pin_pulse_state_COMPU_VTAB 0 0 0 255 ECU_ADDRESS 0x0100B908 BIT_MASK 0xff /end MEASUREMENT
/begin COMPU_METHOD IC_pin_pulse_state_COMPU_VTAB "Verbal Table" TAB_VERB "%.0" "list" COMPU_TAB_REF IC_pin_pulse_state_COMPU_VTAB_REF /end COMPU_METHOD
/begin COMPU_VTAB IC_pin_pulse_state_COMPU_VTAB_REF "Verbal Table" TAB_VERB 8 0 "Inactive" 1 "Initiated" 2 "Start-current pulse active" 3 "Waiting - Cam-rattle next" 4 "Cam-rattle pulsing low" 5 "Cam-rattle pulsing high" 6 "Waiting - Cam-bump next" 7 "Cam-bump pulse active" DEFAULT_VALUE "UNKNOWN" /end COMPU_VTAB
/begin MEASUREMENT EC_pin_pulse_state "Cam2 fault pin-unlock state machine{EC_pin_pulse_state&0xff=0:Inactive}{EC_pin_pulse_state&0xff=1:Initiated}{EC_pin_pulse_state&0xff=2:Start-current pulse active}{EC_pin_pulse_state&0xff=3:Waiting - Cam-rattle next}{EC_pin_pulse_state&0xff=4:Cam-rattle pu" UBYTE EC_pin_pulse_state_COMPU_VTAB 0 0 0 255 ECU_ADDRESS 0x0100B910 BIT_MASK 0xff /end MEASUREMENT
/begin COMPU_METHOD EC_pin_pulse_state_COMPU_VTAB "Verbal Table" TAB_VERB "%.0" "list" COMPU_TAB_REF EC_pin_pulse_state_COMPU_VTAB_REF /end COMPU_METHOD
/begin COMPU_VTAB EC_pin_pulse_state_COMPU_VTAB_REF "Verbal Table" TAB_VERB 8 0 "Inactive" 1 "Initiated" 2 "Start-current pulse active" 3 "Waiting - Cam-rattle next" 4 "Cam-rattle pulsing low" 5 "Cam-rattle pulsing high" 6 "Waiting - Cam-bump next" 7 "Cam-bump pulse active" DEFAULT_VALUE "UNKNOWN" /end COMPU_VTAB
/begin CHARACTERISTIC Camini_slew_tout "Cam post engine-start soft-start duration" VALUE 0x00146772 /* @ECU_Address@Camini_slew_tout@0x0100B980@ */ ECIPP_ALIGNMENT_UWORD 65535 Compu_Camini_slew_tout 0 65535 /end CHARACTERISTIC
/begin COMPU_METHOD Compu_Camini_slew_tout " " RAT_FUNC "%.0" "ms" COEFFS 0 1 0 0 0 1 /end COMPU_METHOD
/begin CHARACTERISTIC ECam_control_cal "Cam2 control calibration{ECam_control_cal&0xff=0:Exhaust / Normal}{ECam_control_cal&0xff=1:Intake / Cam1}" VALUE 0x00147d21 /* @ECU_Address@ECam_control_cal@0x0100BC38@ */ ECIPP_ALIGNMENT_UBYTE 255 ECam_control_cal_COMPU_VTAB 0 255 BIT_MASK 0xff /end CHARACTERISTIC
/begin COMPU_METHOD ECam_control_cal_COMPU_VTAB "Verbal Table" TAB_VERB "%.0" "list" COMPU_TAB_REF ECam_control_cal_COMPU_VTAB_REF /end COMPU_METHOD
/begin COMPU_VTAB ECam_control_cal_COMPU_VTAB_REF "Verbal Table" TAB_VERB 2 0 "Exhaust / Normal" 1 "Intake / Cam1" DEFAULT_VALUE "UNKNOWN" /end COMPU_VTAB
/begin CHARACTERISTIC T_delay_plug_flow "CL T_delay estimate{T_delay_plug_flow&0xff=0:Standard}{T_delay_plug_flow&0xff=1:Extended}" VALUE 0x001480c7 /* @ECU_Address@T_delay_plug_flow@0x0100C200@ */ ECIPP_ALIGNMENT_UBYTE 255 T_delay_plug_flow_COMPU_VTAB 0 255 BIT_MASK 0xff /end CHARACTERISTIC
/begin COMPU_METHOD T_delay_plug_flow_COMPU_VTAB "Verbal Table" TAB_VERB "%.0" "list" COMPU_TAB_REF T_delay_plug_flow_COMPU_VTAB_REF /end COMPU_METHOD
/begin COMPU_VTAB T_delay_plug_flow_COMPU_VTAB_REF "Verbal Table" TAB_VERB 2 0 "Standard" 1 "Extended" DEFAULT_VALUE "UNKNOWN" /end COMPU_VTAB
/begin CHARACTERISTIC CATdP_ena "Catalyst delta-P{CATdP_ena&0xff=0:Disabled}{CATdP_ena&0xff=1:Aux PD1}{CATdP_ena&0xff=2:Aux PD2}{CATdP_ena&0xff=3:Aux PD3}{CATdP_ena&0xff=4:Aux PUD1}{CATdP_ena&0xff=5:Aux PUD2}{CATdP_ena&0xff=6:Aux PUD3}{CATdP_ena&0xff=7:Aux PUD4}{CATdP_ena&0xff=8:Aux PUD5" VALUE 0x00147cec /* @ECU_Address@CATdP_ena@0x0100C2E8@ */ ECIPP_ALIGNMENT_UBYTE 255 CATdP_ena_COMPU_VTAB 0 255 BIT_MASK 0xff /end CHARACTERISTIC
/begin COMPU_METHOD CATdP_ena_COMPU_VTAB "Verbal Table" TAB_VERB "%.0" "list" COMPU_TAB_REF CATdP_ena_COMPU_VTAB_REF /end COMPU_METHOD
/begin COMPU_VTAB CATdP_ena_COMPU_VTAB_REF "Verbal Table" TAB_VERB 31 0 "Disabled" 1 "Aux PD1" 2 "Aux PD2" 3 "Aux PD3" 4 "Aux PUD1" 5 "Aux PUD2" 6 "Aux PUD3" 7 "Aux PUD4" 8 "Aux PUD5" 9 "Aux PUD6" 10 "Aux PUD7" 11 "Aux PUD8" 12 "Aux PUD9" 13 "Aux PUD10" 14 "Aux PUD11" 15 "Aux PUD12" 16 "Aux PUD13" 17 "Aux PUD14" 18 "Aux PUD15" 19 "CAN sourced" 20 "FPP2 Input" 21 "Aux PUD16" 22 "Aux PUD17" 23 "Aux PUD18" 24 "Aux PUD19" 25 "Aux PUD20" 26 "Aux PUD21" 27 "Aux PUD22" 28 "Aux PUD23" 29 "Aux PUD24" 30 "Aux PUD25" DEFAULT_VALUE "UNKNOWN" /end COMPU_VTAB
/begin MEASUREMENT CATdP "Catalyst delta-P value" SWORD Compu_CATdP 0 0 -32 31.9990234375 ECU_ADDRESS 0x0100C2F0 /end MEASUREMENT
/begin COMPU_METHOD Compu_CATdP " " RAT_FUNC "%.2" "psi" COEFFS 0 1024 0 0 0 1 /end COMPU_METHOD
/begin CHARACTERISTIC EBP_ena "EBP sensor{EBP_ena&0xff=0:Disabled}{EBP_ena&0xff=1:Aux PD1}{EBP_ena&0xff=2:Aux PD2}{EBP_ena&0xff=3:Aux PD3}{EBP_ena&0xff=4:Aux PUD1}{EBP_ena&0xff=5:Aux PUD2}{EBP_ena&0xff=6:Aux PUD3}{EBP_ena&0xff=7:Aux PUD4}{EBP_ena&0xff=8:Aux PUD5}{EBP_ena&0xff=9:Aux PUD" VALUE 0x00147d15 /* @ECU_Address@EBP_ena@0x0100C7F0@ */ ECIPP_ALIGNMENT_UBYTE 255 EBP_ena_COMPU_VTAB 0 255 BIT_MASK 0xff /end CHARACTERISTIC
/begin COMPU_METHOD EBP_ena_COMPU_VTAB "Verbal Table" TAB_VERB "%.0" "list" COMPU_TAB_REF EBP_ena_COMPU_VTAB_REF /end COMPU_METHOD
/begin COMPU_VTAB EBP_ena_COMPU_VTAB_REF "Verbal Table" TAB_VERB 31 0 "Disabled" 1 "Aux PD1" 2 "Aux PD2" 3 "Aux PD3" 4 "Aux PUD1" 5 "Aux PUD2" 6 "Aux PUD3" 7 "Aux PUD4" 8 "Aux PUD5" 9 "Aux PUD6" 10 "Aux PUD7" 11 "Aux PUD8" 12 "Aux PUD9" 13 "Aux PUD10" 14 "Aux PUD11" 15 "Aux PUD12" 16 "Aux PUD13" 17 "Aux PUD14" 18 "Aux PUD15" 19 "CAN sourced" 20 "FPP2 Input" 21 "Aux PUD16" 22 "Aux PUD17" 23 "Aux PUD18" 24 "Aux PUD19" 25 "Aux PUD20" 26 "Aux PUD21" 27 "Aux PUD22" 28 "Aux PUD23" 29 "Aux PUD24" 30 "Aux PUD25" DEFAULT_VALUE "UNKNOWN" /end COMPU_VTAB
/begin CHARACTERISTIC EBP_tau "EBP low-pass tau" VALUE 0x00147bd0 /* @ECU_Address@EBP_tau@0x0100C800@ */ ECIPP_ALIGNMENT_UWORD 327680 Compu_EBP_tau 0.45084 327680 /end CHARACTERISTIC
/begin COMPU_METHOD Compu_EBP_tau " " FORM "%.0" "ms"
 /begin FORMULA "-5 / log(1 - (X1 / 65536))" FORMULA_INV "(1 - exp(-5/X1)) * 65536" /end FORMULA
/end COMPU_METHOD
/begin MEASUREMENT EBP_raw "EBP raw" UWORD Compu_EBP_raw 0 0 0 255.99609375 ECU_ADDRESS 0x0100C808 /end MEASUREMENT
/begin COMPU_METHOD Compu_EBP_raw " " RAT_FUNC "%.2" "psia" COEFFS 0 256 0 0 0 1 /end COMPU_METHOD
/begin CHARACTERISTIC CATdP_P_select "Monitor source{CATdP_P_select&0xff=0:Catalyst delta-P}{CATdP_P_select&0xff=1:EBP absolute}{CATdP_P_select&0xff=2:EBP gauge}" VALUE 0x00147cea /* @ECU_Address@CATdP_P_select@0x0100C810@ */ ECIPP_ALIGNMENT_UBYTE 255 CATdP_P_select_COMPU_VTAB 0 255 BIT_MASK 0xff /end CHARACTERISTIC
/begin COMPU_METHOD CATdP_P_select_COMPU_VTAB "Verbal Table" TAB_VERB "%.0" "list" COMPU_TAB_REF CATdP_P_select_COMPU_VTAB_REF /end COMPU_METHOD
/begin COMPU_VTAB CATdP_P_select_COMPU_VTAB_REF "Verbal Table" TAB_VERB 3 0 "Catalyst delta-P" 1 "EBP absolute" 2 "EBP gauge" DEFAULT_VALUE "UNKNOWN" /end COMPU_VTAB
/begin CHARACTERISTIC CATdP_tau "CATdP low-pass" VALUE 0x00147bc0 /* @ECU_Address@CATdP_tau@0x0100C840@ */ ECIPP_ALIGNMENT_UWORD 1638398 Compu_CATdP_tau 1.6703 1638400 /end CHARACTERISTIC
/begin COMPU_METHOD Compu_CATdP_tau " " FORM "%.0" "ms"
 /begin FORMULA "-50 / log(1.0000000000001 - (X1 / 32768))" FORMULA_INV "(1.0000000000001 - exp(-50/X1)) * 32768" /end FORMULA
/end COMPU_METHOD
/begin MEASUREMENT CATdP_raw "CATdp raw" SWORD Compu_CATdP_raw 0 0 -32 31.9990234375 ECU_ADDRESS 0x0100C848 /end MEASUREMENT
/begin COMPU_METHOD Compu_CATdP_raw " " RAT_FUNC "%.2" "psi" COEFFS 0 1024 0 0 0 1 /end COMPU_METHOD
/begin MEASUREMENT EBP_acc "EBP" UWORD Compu_EBP_acc 0 0 0 255.99609375 ECU_ADDRESS 0x0100C850 /end MEASUREMENT
/begin COMPU_METHOD Compu_EBP_acc " " RAT_FUNC "%.2" "psia" COEFFS 0 256 0 0 0 1 /end COMPU_METHOD
/begin MEASUREMENT CB1pre_name "Bank 1 pre-cat  sensor name{CB1pre_name&0xff=0:Not Present}{CB1pre_name&0xff=1:EGO1}{CB1pre_name&0xff=2:EGO2}{CB1pre_name&0xff=3:EGO3}{CB1pre_name&0xff=4:EGO4}{CB1pre_name&0xff=5:UEGO1}{CB1pre_name&0xff=6:UEGO2}{CB1pre_name&0xff=7:UEGO3}{CB1pre_name&0xff=" UBYTE CB1pre_name_COMPU_VTAB 0 0 0 255 ECU_ADDRESS 0x0100CFB8 BIT_MASK 0xff /end MEASUREMENT
/begin COMPU_METHOD CB1pre_name_COMPU_VTAB "Verbal Table" TAB_VERB "%.0" "list" COMPU_TAB_REF CB1pre_name_COMPU_VTAB_REF /end COMPU_METHOD
/begin COMPU_VTAB CB1pre_name_COMPU_VTAB_REF "Verbal Table" TAB_VERB 9 0 "Not Present" 1 "EGO1" 2 "EGO2" 3 "EGO3" 4 "EGO4" 5 "UEGO1" 6 "UEGO2" 7 "UEGO3" 8 "UEGO4" DEFAULT_VALUE "UNKNOWN" /end COMPU_VTAB
/begin MEASUREMENT CB1pst_name "Bank 1 post-cat sensor name{CB1pst_name&0xff=0:Not Present}{CB1pst_name&0xff=1:EGO1}{CB1pst_name&0xff=2:EGO2}{CB1pst_name&0xff=3:EGO3}{CB1pst_name&0xff=4:EGO4}{CB1pst_name&0xff=5:UEGO1}{CB1pst_name&0xff=6:UEGO2}{CB1pst_name&0xff=7:UEGO3}{CB1pst_name&0xff=" UBYTE CB1pst_name_COMPU_VTAB 0 0 0 255 ECU_ADDRESS 0x0100CFC0 BIT_MASK 0xff /end MEASUREMENT
/begin COMPU_METHOD CB1pst_name_COMPU_VTAB "Verbal Table" TAB_VERB "%.0" "list" COMPU_TAB_REF CB1pst_name_COMPU_VTAB_REF /end COMPU_METHOD
/begin COMPU_VTAB CB1pst_name_COMPU_VTAB_REF "Verbal Table" TAB_VERB 9 0 "Not Present" 1 "EGO1" 2 "EGO2" 3 "EGO3" 4 "EGO4" 5 "UEGO1" 6 "UEGO2" 7 "UEGO3" 8 "UEGO4" DEFAULT_VALUE "UNKNOWN" /end COMPU_VTAB
/begin MEASUREMENT CB2pre_name "Bank 2 pre-cat  sensor name{CB2pre_name&0xff=0:Not Present}{CB2pre_name&0xff=1:EGO1}{CB2pre_name&0xff=2:EGO2}{CB2pre_name&0xff=3:EGO3}{CB2pre_name&0xff=4:EGO4}{CB2pre_name&0xff=5:UEGO1}{CB2pre_name&0xff=6:UEGO2}{CB2pre_name&0xff=7:UEGO3}{CB2pre_name&0xff=" UBYTE CB2pre_name_COMPU_VTAB 0 0 0 255 ECU_ADDRESS 0x0100CFC8 BIT_MASK 0xff /end MEASUREMENT
/begin COMPU_METHOD CB2pre_name_COMPU_VTAB "Verbal Table" TAB_VERB "%.0" "list" COMPU_TAB_REF CB2pre_name_COMPU_VTAB_REF /end COMPU_METHOD
/begin COMPU_VTAB CB2pre_name_COMPU_VTAB_REF "Verbal Table" TAB_VERB 9 0 "Not Present" 1 "EGO1" 2 "EGO2" 3 "EGO3" 4 "EGO4" 5 "UEGO1" 6 "UEGO2" 7 "UEGO3" 8 "UEGO4" DEFAULT_VALUE "UNKNOWN" /end COMPU_VTAB
/begin MEASUREMENT CB2pst_name "Bank 2 post-cat sensor name{CB2pst_name&0xff=0:Not Present}{CB2pst_name&0xff=1:EGO1}{CB2pst_name&0xff=2:EGO2}{CB2pst_name&0xff=3:EGO3}{CB2pst_name&0xff=4:EGO4}{CB2pst_name&0xff=5:UEGO1}{CB2pst_name&0xff=6:UEGO2}{CB2pst_name&0xff=7:UEGO3}{CB2pst_name&0xff=" UBYTE CB2pst_name_COMPU_VTAB 0 0 0 255 ECU_ADDRESS 0x0100CFD0 BIT_MASK 0xff /end MEASUREMENT
/begin COMPU_METHOD CB2pst_name_COMPU_VTAB "Verbal Table" TAB_VERB "%.0" "list" COMPU_TAB_REF CB2pst_name_COMPU_VTAB_REF /end COMPU_METHOD
/begin COMPU_VTAB CB2pst_name_COMPU_VTAB_REF "Verbal Table" TAB_VERB 9 0 "Not Present" 1 "EGO1" 2 "EGO2" 3 "EGO3" 4 "EGO4" 5 "UEGO1" 6 "UEGO2" 7 "UEGO3" 8 "UEGO4" DEFAULT_VALUE "UNKNOWN" /end COMPU_VTAB
/begin MEASUREMENT CB1pre_phiFB_RMS "Bank 1 pre-cat phi feedback RMS" UWORD Compu_CB1pre_phiFB_RMS 0 0 0 3.99993896484375 ECU_ADDRESS 0x0100CFF8 /end MEASUREMENT
/begin COMPU_METHOD Compu_CB1pre_phiFB_RMS " " RAT_FUNC "%.3" "phi" COEFFS 0 16384 0 0 0 1 /end COMPU_METHOD
/begin MEASUREMENT CB1pst_phiFB_RMS "Bank 1 post-cat phi feedback RMS" UWORD Compu_CB1pst_phiFB_RMS 0 0 0 3.99993896484375 ECU_ADDRESS 0x0100D000 /end MEASUREMENT
/begin COMPU_METHOD Compu_CB1pst_phiFB_RMS " " RAT_FUNC "%.3" "phi" COEFFS 0 16384 0 0 0 1 /end COMPU_METHOD
/begin MEASUREMENT CB2pre_phiFB_RMS "Bank 2 pre-cat phi feedback RMS" UWORD Compu_CB2pre_phiFB_RMS 0 0 0 3.99993896484375 ECU_ADDRESS 0x0100D008 /end MEASUREMENT
/begin COMPU_METHOD Compu_CB2pre_phiFB_RMS " " RAT_FUNC "%.3" "phi" COEFFS 0 16384 0 0 0 1 /end COMPU_METHOD
/begin MEASUREMENT CB2pst_phiFB_RMS "Bank 2 post-cat phi feedback RMS" UWORD Compu_CB2pst_phiFB_RMS 0 0 0 3.99993896484375 ECU_ADDRESS 0x0100D010 /end MEASUREMENT
/begin COMPU_METHOD Compu_CB2pst_phiFB_RMS " " RAT_FUNC "%.3" "phi" COEFFS 0 16384 0 0 0 1 /end COMPU_METHOD
/begin MEASUREMENT CB1pre_phiFB "Bank 1 pre-cat current phi" UWORD Compu_CB1pre_phiFB 0 0 0 3.99993896484375 ECU_ADDRESS 0x0100D018 /end MEASUREMENT
/begin COMPU_METHOD Compu_CB1pre_phiFB " " RAT_FUNC "%.3" "phi" COEFFS 0 16384 0 0 0 1 /end COMPU_METHOD
/begin MEASUREMENT CB1pst_phiFB "Bank 1 post-cat current phi" UWORD Compu_CB1pst_phiFB 0 0 0 3.99993896484375 ECU_ADDRESS 0x0100D020 /end MEASUREMENT
/begin COMPU_METHOD Compu_CB1pst_phiFB " " RAT_FUNC "%.3" "phi" COEFFS 0 16384 0 0 0 1 /end COMPU_METHOD
/begin MEASUREMENT CB2pre_phiFB "Bank 2 pre-cat current phi" UWORD Compu_CB2pre_phiFB 0 0 0 3.99993896484375 ECU_ADDRESS 0x0100D028 /end MEASUREMENT
/begin COMPU_METHOD Compu_CB2pre_phiFB " " RAT_FUNC "%.3" "phi" COEFFS 0 16384 0 0 0 1 /end COMPU_METHOD
/begin MEASUREMENT CB2pst_phiFB "Bank 2 post-cat current phi" UWORD Compu_CB2pst_phiFB 0 0 0 3.99993896484375 ECU_ADDRESS 0x0100D030 /end MEASUREMENT
/begin COMPU_METHOD Compu_CB2pst_phiFB " " RAT_FUNC "%.3" "phi" COEFFS 0 16384 0 0 0 1 /end COMPU_METHOD
/begin MEASUREMENT CB1pre_phiFB_avg "Bank 1 pre-cat average phi" UWORD Compu_CB1pre_phiFB_avg 0 0 0 3.99993896484375 ECU_ADDRESS 0x0100D038 /end MEASUREMENT
/begin COMPU_METHOD Compu_CB1pre_phiFB_avg " " RAT_FUNC "%.3" "phi" COEFFS 0 16384 0 0 0 1 /end COMPU_METHOD
/begin MEASUREMENT CB1pst_phiFB_avg "Bank 1 post-cat average phi" UWORD Compu_CB1pst_phiFB_avg 0 0 0 3.99993896484375 ECU_ADDRESS 0x0100D040 /end MEASUREMENT
/begin COMPU_METHOD Compu_CB1pst_phiFB_avg " " RAT_FUNC "%.3" "phi" COEFFS 0 16384 0 0 0 1 /end COMPU_METHOD
/begin MEASUREMENT CB2pre_phiFB_avg "Bank 2 pre-cat average phi" UWORD Compu_CB2pre_phiFB_avg 0 0 0 3.99993896484375 ECU_ADDRESS 0x0100D048 /end MEASUREMENT
/begin COMPU_METHOD Compu_CB2pre_phiFB_avg " " RAT_FUNC "%.3" "phi" COEFFS 0 16384 0 0 0 1 /end COMPU_METHOD
/begin MEASUREMENT CB2pst_phiFB_avg "Bank 2 post-cat average phi" UWORD Compu_CB2pst_phiFB_avg 0 0 0 3.99993896484375 ECU_ADDRESS 0x0100D050 /end MEASUREMENT
/begin COMPU_METHOD Compu_CB2pst_phiFB_avg " " RAT_FUNC "%.3" "phi" COEFFS 0 16384 0 0 0 1 /end COMPU_METHOD
/begin MEASUREMENT CB1pst_phiFB_dphidt "Bank 1 post-cat derivative" SWORD Compu_CB1pst_phiFB_dphidt 0 0 -0.125 0.124996185302734 ECU_ADDRESS 0x0100D058 /end MEASUREMENT
/begin COMPU_METHOD Compu_CB1pst_phiFB_dphidt " " RAT_FUNC "%.4" "dphi / T_delay" COEFFS 0 262144 0 0 0 1 /end COMPU_METHOD
/begin MEASUREMENT CB2pst_phiFB_dphidt "Bank 2 post-cat derivative" SWORD Compu_CB2pst_phiFB_dphidt 0 0 -0.125 0.124996185302734 ECU_ADDRESS 0x0100D060 /end MEASUREMENT
/begin COMPU_METHOD Compu_CB2pst_phiFB_dphidt " " RAT_FUNC "%.4" "dphi / T_delay" COEFFS 0 262144 0 0 0 1 /end COMPU_METHOD
/begin CHARACTERISTIC MJ_man_mode_rpm "EPR manual mode RPM limit" VALUE 0x0014762a /* @ECU_Address@MJ_man_mode_rpm@0x0100D0E0@ */ ECIPP_ALIGNMENT_UWORD 65535 Compu_MJ_man_mode_rpm 0 65535 /end CHARACTERISTIC
/begin COMPU_METHOD Compu_MJ_man_mode_rpm " " RAT_FUNC "%.0" "rpm" COEFFS 0 1 0 0 0 1 /end COMPU_METHOD
/begin CHARACTERISTIC MJ_man_mode_map "EPR manual mode MAP limit" VALUE 0x00147628 /* @ECU_Address@MJ_man_mode_map@0x0100D0E8@ */ ECIPP_ALIGNMENT_UWORD 256 Compu_MJ_man_mode_map 0 255.99609375 /end CHARACTERISTIC
/begin COMPU_METHOD Compu_MJ_man_mode_map " " RAT_FUNC "%.2" "psia" COEFFS 0 256 0 0 0 1 /end COMPU_METHOD
/begin MEASUREMENT UEGO3_mode "UEGO mode{UEGO3_mode&0xff=0xfe:Invalid}{UEGO3_mode&0xff=0xff:Fault}{UEGO3_mode&0xff=0x00:Off}{UEGO3_mode&0xff=0x01:Warming}{UEGO3_mode&0xff=0x02:Waiting}{UEGO3_mode&0xff=0x03:Active}" UBYTE UEGO3_mode_COMPU_VTAB 0 0 0 255 ECU_ADDRESS 0x0100E0E8 BIT_MASK 0xff /end MEASUREMENT
/begin COMPU_METHOD UEGO3_mode_COMPU_VTAB "Verbal Table" TAB_VERB "%.0" "list" COMPU_TAB_REF UEGO3_mode_COMPU_VTAB_REF /end COMPU_METHOD
/begin COMPU_VTAB UEGO3_mode_COMPU_VTAB_REF "Verbal Table" TAB_VERB 6 0xfe "Invalid" 0xff "Fault" 0x00 "Off" 0x01 "Warming" 0x02 "Waiting" 0x03 "Active" DEFAULT_VALUE "UNKNOWN" /end COMPU_VTAB
/begin MEASUREMENT Phi_UEGO3 "UEGO phi" UWORD Compu_Phi_UEGO3 0 0 0 3.99993896484375 ECU_ADDRESS 0x0100E100 /end MEASUREMENT
/begin COMPU_METHOD Compu_Phi_UEGO3 " " RAT_FUNC "%.3" "phi" COEFFS 0 16384 0 0 0 1 /end COMPU_METHOD
/begin MEASUREMENT UEGO4_mode "UEGO mode{UEGO4_mode&0xff=0xfe:Invalid}{UEGO4_mode&0xff=0xff:Fault}{UEGO4_mode&0xff=0x00:Off}{UEGO4_mode&0xff=0x01:Warming}{UEGO4_mode&0xff=0x02:Waiting}{UEGO4_mode&0xff=0x03:Active}" UBYTE UEGO4_mode_COMPU_VTAB 0 0 0 255 ECU_ADDRESS 0x0100E1C0 BIT_MASK 0xff /end MEASUREMENT
/begin COMPU_METHOD UEGO4_mode_COMPU_VTAB "Verbal Table" TAB_VERB "%.0" "list" COMPU_TAB_REF UEGO4_mode_COMPU_VTAB_REF /end COMPU_METHOD
/begin COMPU_VTAB UEGO4_mode_COMPU_VTAB_REF "Verbal Table" TAB_VERB 6 0xfe "Invalid" 0xff "Fault" 0x00 "Off" 0x01 "Warming" 0x02 "Waiting" 0x03 "Active" DEFAULT_VALUE "UNKNOWN" /end COMPU_VTAB
/begin MEASUREMENT Phi_UEGO4 "UEGO phi" UWORD Compu_Phi_UEGO4 0 0 0 3.99993896484375 ECU_ADDRESS 0x0100E1D8 /end MEASUREMENT
/begin COMPU_METHOD Compu_Phi_UEGO4 " " RAT_FUNC "%.3" "phi" COEFFS 0 16384 0 0 0 1 /end COMPU_METHOD
/begin CHARACTERISTIC adapt_store_EE "Adaptive table retention memory{adapt_store_EE&0xff=0:Battery}{adapt_store_EE&0xff=1:Permanent}" VALUE 0x001480f1 /* @ECU_Address@adapt_store_EE@0x0100E7D8@ */ ECIPP_ALIGNMENT_UBYTE 255 adapt_store_EE_COMPU_VTAB 0 255 BIT_MASK 0xff /end CHARACTERISTIC
/begin COMPU_METHOD adapt_store_EE_COMPU_VTAB "Verbal Table" TAB_VERB "%.0" "list" COMPU_TAB_REF adapt_store_EE_COMPU_VTAB_REF /end COMPU_METHOD
/begin COMPU_VTAB adapt_store_EE_COMPU_VTAB_REF "Verbal Table" TAB_VERB 2 0 "Battery" 1 "Permanent" DEFAULT_VALUE "UNKNOWN" /end COMPU_VTAB
/begin CHARACTERISTIC CLp_fastwr_ena "CL UEGO perturb disable{CLp_fastwr_ena&0xff=0:Disabled}{CLp_fastwr_ena&0xff=1:Enabled}" VALUE 0x00147cff /* @ECU_Address@CLp_fastwr_ena@0x0100EFE0@ */ ECIPP_ALIGNMENT_UBYTE 255 CLp_fastwr_ena_COMPU_VTAB 0 255 BIT_MASK 0xff /end CHARACTERISTIC
/begin COMPU_METHOD CLp_fastwr_ena_COMPU_VTAB "Verbal Table" TAB_VERB "%.0" "list" COMPU_TAB_REF CLp_fastwr_ena_COMPU_VTAB_REF /end COMPU_METHOD
/begin COMPU_VTAB CLp_fastwr_ena_COMPU_VTAB_REF "Verbal Table" TAB_VERB 2 0 "Disabled" 1 "Enabled" DEFAULT_VALUE "UNKNOWN" /end COMPU_VTAB
/begin CHARACTERISTIC CLp_fastwr_MAPdt "CL UEGO MAPdt engage" VALUE 0x0014426a /* @ECU_Address@CLp_fastwr_MAPdt@0x0100EFE8@ */ ECIPP_ALIGNMENT_SWORD 4000 Compu_CLp_fastwr_MAPdt -4000 3999.8779296875 /end CHARACTERISTIC
/begin COMPU_METHOD Compu_CLp_fastwr_MAPdt " " RAT_FUNC "%.1" "psi/sec" COEFFS 0 8.192 0 0 0 1 /end COMPU_METHOD
/begin CHARACTERISTIC CLp_fastwr_phierr "CL UEGO phi error disengage" VALUE 0x00144270 /* @ECU_Address@CLp_fastwr_phierr@0x0100EFF0@ */ ECIPP_ALIGNMENT_SWORD 100 Compu_CLp_fastwr_phierr -100 99.9969482421875 /end CHARACTERISTIC
/begin COMPU_METHOD Compu_CLp_fastwr_phierr " " RAT_FUNC "%.1" "%" COEFFS 0 327.68 0 0 0 1 /end COMPU_METHOD
/begin CHARACTERISTIC CLp_fastwr_mincyc "CL UEGO min engagement" VALUE 0x00146758 /* @ECU_Address@CLp_fastwr_mincyc@0x0100EFF8@ */ ECIPP_ALIGNMENT_UWORD 4096 Compu_CLp_fastwr_mincyc 0 4095.9375 /end CHARACTERISTIC
/begin COMPU_METHOD Compu_CLp_fastwr_mincyc " " RAT_FUNC "%.1" "eng cyc" COEFFS 0 16 0 0 0 1 /end COMPU_METHOD
/begin MEASUREMENT CLp_fastwr_status "CL UEGO status{CLp_fastwr_status&0xff=0:Inactive}{CLp_fastwr_status&0xff=1:Active: Phi Rich}{CLp_fastwr_status&0xff=2:Active: Phi Lean}{CLp_fastwr_status&0xff=3:Active: MAPdt}{CLp_fastwr_status&0xff=4:Active: TWC Diag}{CLp_fastwr_status&0xff=5:Active: TWC" UBYTE CLp_fastwr_status_COMPU_VTAB 0 0 0 255 ECU_ADDRESS 0x0100F000 BIT_MASK 0xff /end MEASUREMENT
/begin COMPU_METHOD CLp_fastwr_status_COMPU_VTAB "Verbal Table" TAB_VERB "%.0" "list" COMPU_TAB_REF CLp_fastwr_status_COMPU_VTAB_REF /end COMPU_METHOD
/begin COMPU_VTAB CLp_fastwr_status_COMPU_VTAB_REF "Verbal Table" TAB_VERB 7 0 "Inactive" 1 "Active: Phi Rich" 2 "Active: Phi Lean" 3 "Active: MAPdt" 4 "Active: TWC Diag" 5 "Active: TWC Enrich" 6 "Active: Cold Start" DEFAULT_VALUE "UNKNOWN" /end COMPU_VTAB
/begin CHARACTERISTIC CLp_fastwr_rich_err "CL UEGO rich error engage" VALUE 0x00144272 /* @ECU_Address@CLp_fastwr_rich_err@0x0100F110@ */ ECIPP_ALIGNMENT_SWORD 100 Compu_CLp_fastwr_rich_err -100 99.9969482421875 /end CHARACTERISTIC
/begin COMPU_METHOD Compu_CLp_fastwr_rich_err " " RAT_FUNC "%.1" "%" COEFFS 0 327.68 0 0 0 1 /end COMPU_METHOD
/begin CHARACTERISTIC CLp_fastwr_lean_err "CL UEGO lean error engage" VALUE 0x0014426c /* @ECU_Address@CLp_fastwr_lean_err@0x0100F118@ */ ECIPP_ALIGNMENT_SWORD 100 Compu_CLp_fastwr_lean_err -100 99.9969482421875 /end CHARACTERISTIC
/begin COMPU_METHOD Compu_CLp_fastwr_lean_err " " RAT_FUNC "%.1" "%" COEFFS 0 327.68 0 0 0 1 /end COMPU_METHOD
/begin CHARACTERISTIC CLp_fastwr_rich_step "CL UEGO rich engage initial step" VALUE 0x00144274 /* @ECU_Address@CLp_fastwr_rich_step@0x0100F120@ */ ECIPP_ALIGNMENT_SWORD 200 Compu_CLp_fastwr_rich_step -200 199.993896484375 /end CHARACTERISTIC
/begin COMPU_METHOD Compu_CLp_fastwr_rich_step " " RAT_FUNC "%.1" "%" COEFFS 0 163.84 0 0 0 1 /end COMPU_METHOD
/begin CHARACTERISTIC CLp_fastwr_lean_step "CL UEGO lean engage initial step" VALUE 0x0014426e /* @ECU_Address@CLp_fastwr_lean_step@0x0100F128@ */ ECIPP_ALIGNMENT_SWORD 200 Compu_CLp_fastwr_lean_step -200 199.993896484375 /end CHARACTERISTIC
/begin COMPU_METHOD Compu_CLp_fastwr_lean_step " " RAT_FUNC "%.1" "%" COEFFS 0 163.84 0 0 0 1 /end COMPU_METHOD
/begin CHARACTERISTIC CLp_fastwr_mdot_min "CL UEGO min port flow" VALUE 0x00146756 /* @ECU_Address@CLp_fastwr_mdot_min@0x0100F1D0@ */ ECIPP_ALIGNMENT_UWORD 1024 Compu_CLp_fastwr_mdot_min 0 1023.984375 /end CHARACTERISTIC
/begin COMPU_METHOD Compu_CLp_fastwr_mdot_min " " RAT_FUNC "%.1" "g/sec" COEFFS 0 64 0 0 0 1 /end COMPU_METHOD
/begin MEASUREMENT CL1_phi_error "CL phi error" SWORD Compu_CL1_phi_error 0 0 -100 99.9969482421875 ECU_ADDRESS 0x0100F1D8 /end MEASUREMENT
/begin COMPU_METHOD Compu_CL1_phi_error " " RAT_FUNC "%.1" "phi" COEFFS 0 327.68 0 0 0 1 /end COMPU_METHOD
/begin MEASUREMENT CL2_phi_error "CL phi error" SWORD Compu_CL2_phi_error 0 0 -100 99.9969482421875 ECU_ADDRESS 0x0100F1E0 /end MEASUREMENT
/begin COMPU_METHOD Compu_CL2_phi_error " " RAT_FUNC "%.1" "phi" COEFFS 0 327.68 0 0 0 1 /end COMPU_METHOD
/begin CHARACTERISTIC CAT1_ena "Catalyst Tin source{CAT1_ena&0xff=0:Disabled}{CAT1_ena&0xff=1:Aux PU1}{CAT1_ena&0xff=2:Aux PU2}{CAT1_ena&0xff=3:Aux PU3}{CAT1_ena&0xff=4:Aux PUD1}{CAT1_ena&0xff=5:Aux PUD2}{CAT1_ena&0xff=6:Aux PUD3}{CAT1_ena&0xff=7:EGT Input}{CAT1_ena&0xff=8:Aux PUD4}{CAT" VALUE 0x00147ce7 /* @ECU_Address@CAT1_ena@0x0100F578@ */ ECIPP_ALIGNMENT_UBYTE 255 CAT1_ena_COMPU_VTAB 0 255 BIT_MASK 0xff /end CHARACTERISTIC
/begin COMPU_METHOD CAT1_ena_COMPU_VTAB "Verbal Table" TAB_VERB "%.0" "list" COMPU_TAB_REF CAT1_ena_COMPU_VTAB_REF /end COMPU_METHOD
/begin COMPU_VTAB CAT1_ena_COMPU_VTAB_REF "Verbal Table" TAB_VERB 31 0 "Disabled" 1 "Aux PU1" 2 "Aux PU2" 3 "Aux PU3" 4 "Aux PUD1" 5 "Aux PUD2" 6 "Aux PUD3" 7 "EGT Input" 8 "Aux PUD4" 9 "Aux PUD5" 10 "Aux PUD6" 11 "Aux PUD7" 12 "Aux PUD8" 13 "Aux PUD9" 14 "Aux PUD10" 15 "Aux PUD11" 16 "Aux PUD12" 17 "Aux PUD13" 18 "Aux PUD14" 19 "Aux PUD15" 20 "Aux PUD16" 21 "Aux PUD17" 22 "Aux PUD18" 23 "Aux PUD19" 24 "Aux PUD20" 25 "Aux PUD21" 26 "Aux PUD22" 27 "Aux PUD23" 28 "Aux PUD24" 29 "Aux PUD25" 30 "CAN sourced" DEFAULT_VALUE "UNKNOWN" /end COMPU_VTAB
/begin CHARACTERISTIC CAT2_ena "Catalyst Tout source{CAT2_ena&0xff=0:Disabled}{CAT2_ena&0xff=1:Aux PU1}{CAT2_ena&0xff=2:Aux PU2}{CAT2_ena&0xff=3:Aux PU3}{CAT2_ena&0xff=4:Aux PUD1}{CAT2_ena&0xff=5:Aux PUD2}{CAT2_ena&0xff=6:Aux PUD3}{CAT2_ena&0xff=7:EGT Input}{CAT2_ena&0xff=8:Aux PUD4}{CA" VALUE 0x00147ce9 /* @ECU_Address@CAT2_ena@0x0100F580@ */ ECIPP_ALIGNMENT_UBYTE 255 CAT2_ena_COMPU_VTAB 0 255 BIT_MASK 0xff /end CHARACTERISTIC
/begin COMPU_METHOD CAT2_ena_COMPU_VTAB "Verbal Table" TAB_VERB "%.0" "list" COMPU_TAB_REF CAT2_ena_COMPU_VTAB_REF /end COMPU_METHOD
/begin COMPU_VTAB CAT2_ena_COMPU_VTAB_REF "Verbal Table" TAB_VERB 31 0 "Disabled" 1 "Aux PU1" 2 "Aux PU2" 3 "Aux PU3" 4 "Aux PUD1" 5 "Aux PUD2" 6 "Aux PUD3" 7 "EGT Input" 8 "Aux PUD4" 9 "Aux PUD5" 10 "Aux PUD6" 11 "Aux PUD7" 12 "Aux PUD8" 13 "Aux PUD9" 14 "Aux PUD10" 15 "Aux PUD11" 16 "Aux PUD12" 17 "Aux PUD13" 18 "Aux PUD14" 19 "Aux PUD15" 20 "Aux PUD16" 21 "Aux PUD17" 22 "Aux PUD18" 23 "Aux PUD19" 24 "Aux PUD20" 25 "Aux PUD21" 26 "Aux PUD22" 27 "Aux PUD23" 28 "Aux PUD24" 29 "Aux PUD25" 30 "CAN sourced" DEFAULT_VALUE "UNKNOWN" /end COMPU_VTAB
/begin MEASUREMENT CAT_Tin "Catalyst inlet temperature" UWORD Compu_CAT_Tin 0 0 -460 7731.875 ECU_ADDRESS 0x0100F5C0 /end MEASUREMENT
/begin COMPU_METHOD Compu_CAT_Tin " " RAT_FUNC "%.1" "deg F" COEFFS 0 8 3680 0 0 1 /end COMPU_METHOD
/begin MEASUREMENT CAT_Tout "Catalyst outlet temperature" UWORD Compu_CAT_Tout 0 0 -460 7731.875 ECU_ADDRESS 0x0100F5C8 /end MEASUREMENT
/begin COMPU_METHOD Compu_CAT_Tout " " RAT_FUNC "%.1" "deg F" COEFFS 0 8 3680 0 0 1 /end COMPU_METHOD
/begin CHARACTERISTIC CTM_FSO_mode "Gsln CTM FSO single-pt mode{CTM_FSO_mode&0xff=0:Disabled}{CTM_FSO_mode&0xff=1:Enabled}" VALUE 0x00148CE0 /* @ECU_Address@CTM_FSO_mode@0x01011C00@ */ ECIPP_ALIGNMENT_UBYTE 255 CTM_FSO_mode_COMPU_VTAB 0 255 BIT_MASK 0xff /end CHARACTERISTIC
/begin COMPU_METHOD CTM_FSO_mode_COMPU_VTAB "Verbal Table" TAB_VERB "%.0" "list" COMPU_TAB_REF CTM_FSO_mode_COMPU_VTAB_REF /end COMPU_METHOD
/begin COMPU_VTAB CTM_FSO_mode_COMPU_VTAB_REF "Verbal Table" TAB_VERB 2 0 "Disabled" 1 "Enabled" DEFAULT_VALUE "UNKNOWN" /end COMPU_VTAB
/begin CHARACTERISTIC CTM_FSO_CBT "Gsln CTM FSO CBT" VALUE 0x00148CDC /* @ECU_Address@CTM_FSO_CBT@0x01011C08@ */ ECIPP_ALIGNMENT_UWORD 7732 Compu_CTM_FSO_CBT -460 7731.875 /end CHARACTERISTIC
/begin COMPU_METHOD Compu_CTM_FSO_CBT " " RAT_FUNC "%.0" "deg F" COEFFS 0 8 3680 0 0 1 /end COMPU_METHOD
/begin CHARACTERISTIC CTM_FSO_tau "Gsln CTM FSO tau" VALUE 0x00148CDE /* @ECU_Address@CTM_FSO_tau@0x01011C10@ */ ECIPP_ALIGNMENT_UWORD 1049 Compu_CTM_FSO_tau 0 1048.56 /end CHARACTERISTIC
/begin COMPU_METHOD Compu_CTM_FSO_tau " " RAT_FUNC "%.1" "seconds" COEFFS 0 62.5 0 0 0 1 /end COMPU_METHOD
/begin CHARACTERISTIC CTMA_FSO_mode "Alt CTM FSO single-pt mode{CTMA_FSO_mode&0xff=0:Disabled}{CTMA_FSO_mode&0xff=1:Enabled}" VALUE 0x00148CC0 /* @ECU_Address@CTMA_FSO_mode@0x01011C18@ */ ECIPP_ALIGNMENT_UBYTE 255 CTMA_FSO_mode_COMPU_VTAB 0 255 BIT_MASK 0xff /end CHARACTERISTIC
/begin COMPU_METHOD CTMA_FSO_mode_COMPU_VTAB "Verbal Table" TAB_VERB "%.0" "list" COMPU_TAB_REF CTMA_FSO_mode_COMPU_VTAB_REF /end COMPU_METHOD
/begin COMPU_VTAB CTMA_FSO_mode_COMPU_VTAB_REF "Verbal Table" TAB_VERB 2 0 "Disabled" 1 "Enabled" DEFAULT_VALUE "UNKNOWN" /end COMPU_VTAB
/begin CHARACTERISTIC CTMA_FSO_CBT "Alt CTM FSO CBT" VALUE 0x00148CBC /* @ECU_Address@CTMA_FSO_CBT@0x01011C20@ */ ECIPP_ALIGNMENT_UWORD 7732 Compu_CTMA_FSO_CBT -460 7731.875 /end CHARACTERISTIC
/begin COMPU_METHOD Compu_CTMA_FSO_CBT " " RAT_FUNC "%.0" "deg F" COEFFS 0 8 3680 0 0 1 /end COMPU_METHOD
/begin CHARACTERISTIC CTMA_FSO_tau "Alt CTM FSO tau" VALUE 0x00148CBE /* @ECU_Address@CTMA_FSO_tau@0x01011C28@ */ ECIPP_ALIGNMENT_UWORD 1049 Compu_CTMA_FSO_tau 0 1048.56 /end CHARACTERISTIC
/begin COMPU_METHOD Compu_CTMA_FSO_tau " " RAT_FUNC "%.1" "seconds" COEFFS 0 62.5 0 0 0 1 /end COMPU_METHOD
/begin MEASUREMENT TWCmod_ROL "TWC relative oxygen level" FLOAT32_IEEE Compu_TWCmod_ROL 0 0 -10000000000 10000000000 ECU_ADDRESS 0x01011C90 /end MEASUREMENT
/begin COMPU_METHOD Compu_TWCmod_ROL " " RAT_FUNC "%.1" "%" COEFFS 0 0.01 0 0 0 1 /end COMPU_METHOD
/begin MEASUREMENT TWCmod_rho "TWC oxygen transfer fraction" FLOAT32_IEEE Compu_TWCmod_rho 0 0 -10000000000 10000000000 ECU_ADDRESS 0x01011C98 /end MEASUREMENT
/begin COMPU_METHOD Compu_TWCmod_rho " " RAT_FUNC "%.1" "-" COEFFS 0 1 0 0 0 1 /end COMPU_METHOD
/begin MEASUREMENT TWCmod_dROLdt "TWC relative oxygen level rate of change" FLOAT32_IEEE Compu_TWCmod_dROLdt 0 0 -10000000000 10000000000 ECU_ADDRESS 0x01011CA0 /end MEASUREMENT
/begin COMPU_METHOD Compu_TWCmod_dROLdt " " RAT_FUNC "%.1" "%/sec" COEFFS 0 1 0 0 0 1 /end COMPU_METHOD
/begin MEASUREMENT TWCmod_phi_post "TWC post cat phi" FLOAT32_IEEE Compu_TWCmod_phi_post 0 0 -10000000000 10000000000 ECU_ADDRESS 0x01011CA8 /end MEASUREMENT
/begin COMPU_METHOD Compu_TWCmod_phi_post " " RAT_FUNC "%.2" "-" COEFFS 0 1 0 0 0 1 /end COMPU_METHOD
/begin CHARACTERISTIC TWCmod_OSC "Fresh oxygen storage capacity" VALUE 0x00143bd4 /* @ECU_Address@TWCmod_OSC@0x01011CB0@ */ ECIPP_ALIGNMENT_FLOAT32_IEEE 10000000000 Compu_TWCmod_OSC -10000000000 10000000000 /end CHARACTERISTIC
/begin COMPU_METHOD Compu_TWCmod_OSC " " RAT_FUNC "%.1" "g" COEFFS 0 1 0 0 0 1 /end COMPU_METHOD
/begin CHARACTERISTIC TWCmod_aL "TWC lean coefficient" VALUE 0x00143bd8 /* @ECU_Address@TWCmod_aL@0x01011CB8@ */ ECIPP_ALIGNMENT_FLOAT32_IEEE 10000000000 Compu_TWCmod_aL -10000000000 10000000000 /end CHARACTERISTIC
/begin COMPU_METHOD Compu_TWCmod_aL " " RAT_FUNC "%.2" "-" COEFFS 0 1 0 0 0 1 /end COMPU_METHOD
/begin CHARACTERISTIC TWCmod_aR "TWC rich coefficient" VALUE 0x00143bdc /* @ECU_Address@TWCmod_aR@0x01011CC0@ */ ECIPP_ALIGNMENT_FLOAT32_IEEE 10000000000 Compu_TWCmod_aR -10000000000 10000000000 /end CHARACTERISTIC
/begin COMPU_METHOD Compu_TWCmod_aR " " RAT_FUNC "%.2" "-" COEFFS 0 1 0 0 0 1 /end COMPU_METHOD
/begin CHARACTERISTIC TWCmod_cL "TWC lean exponent" VALUE 0x00143be0 /* @ECU_Address@TWCmod_cL@0x01011CC8@ */ ECIPP_ALIGNMENT_FLOAT32_IEEE 10000000000 Compu_TWCmod_cL -10000000000 10000000000 /end CHARACTERISTIC
/begin COMPU_METHOD Compu_TWCmod_cL " " RAT_FUNC "%.1" "-" COEFFS 0 1 0 0 0 1 /end COMPU_METHOD
/begin CHARACTERISTIC TWCmod_cR "TWC rich exponent" VALUE 0x00143be4 /* @ECU_Address@TWCmod_cR@0x01011CD0@ */ ECIPP_ALIGNMENT_FLOAT32_IEEE 10000000000 Compu_TWCmod_cR -10000000000 10000000000 /end CHARACTERISTIC
/begin COMPU_METHOD Compu_TWCmod_cR " " RAT_FUNC "%.1" "-" COEFFS 0 1 0 0 0 1 /end COMPU_METHOD
/begin CHARACTERISTIC TWCctrl_ROL_d_def "TWC desired (fixed) ROL" VALUE 0x00143bb8 /* @ECU_Address@TWCctrl_ROL_d_def@0x01011CE0@ */ ECIPP_ALIGNMENT_FLOAT32_IEEE 10000000000 Compu_TWCctrl_ROL_d_def -10000000000 10000000000 /end CHARACTERISTIC
/begin COMPU_METHOD Compu_TWCctrl_ROL_d_def " " RAT_FUNC "%.1" "%" COEFFS 0 0.01 0 0 0 1 /end COMPU_METHOD
/begin MEASUREMENT TWCctrl_ROL_e "TWC ROL error" FLOAT32_IEEE Compu_TWCctrl_ROL_e 0 0 -10000000000 10000000000 ECU_ADDRESS 0x01011CE8 /end MEASUREMENT
/begin COMPU_METHOD Compu_TWCctrl_ROL_e " " RAT_FUNC "%.1" "%" COEFFS 0 0.01 0 0 0 1 /end COMPU_METHOD
/begin CHARACTERISTIC CL_Kp_p_ROL "Kp increasing ROL" VALUE 0x001433A8 /* @ECU_Address@CL_Kp_p_ROL@0x01011D50@ */ ECIPP_ALIGNMENT_SWORD 100 Compu_CL_Kp_p_ROL -100 99.9969482421875 /end CHARACTERISTIC
/begin COMPU_METHOD Compu_CL_Kp_p_ROL " " RAT_FUNC "%.1" "%" COEFFS 0 327.68 0 0 0 1 /end COMPU_METHOD
/begin CHARACTERISTIC CLLP_Kp_p_ROL "Kp increasing ROL" VALUE 0x001418F0 /* @ECU_Address@CLLP_Kp_p_ROL@0x01011D58@ */ ECIPP_ALIGNMENT_SWORD 100 Compu_CLLP_Kp_p_ROL -100 99.9969482421875 /end CHARACTERISTIC
/begin COMPU_METHOD Compu_CLLP_Kp_p_ROL " " RAT_FUNC "%.1" "%" COEFFS 0 327.68 0 0 0 1 /end COMPU_METHOD
/begin CHARACTERISTIC CL_Kp_n_ROL "Kp decreasing ROL" VALUE 0x001433AA /* @ECU_Address@CL_Kp_n_ROL@0x01011D68@ */ ECIPP_ALIGNMENT_SWORD 100 Compu_CL_Kp_n_ROL -100 99.9969482421875 /end CHARACTERISTIC
/begin COMPU_METHOD Compu_CL_Kp_n_ROL " " RAT_FUNC "%.1" "%" COEFFS 0 327.68 0 0 0 1 /end COMPU_METHOD
/begin CHARACTERISTIC CLLP_Kp_n_ROL "Kp decreasing ROL" VALUE 0x001418F2 /* @ECU_Address@CLLP_Kp_n_ROL@0x01011D70@ */ ECIPP_ALIGNMENT_SWORD 100 Compu_CLLP_Kp_n_ROL -100 99.9969482421875 /end CHARACTERISTIC
/begin COMPU_METHOD Compu_CLLP_Kp_n_ROL " " RAT_FUNC "%.1" "%" COEFFS 0 327.68 0 0 0 1 /end COMPU_METHOD
/begin CHARACTERISTIC CL_Ki_p_ROL "Ki increasing ROL" VALUE 0x001433AC /* @ECU_Address@CL_Ki_p_ROL@0x01011D80@ */ ECIPP_ALIGNMENT_SWORD 100 Compu_CL_Ki_p_ROL -100 99.9969482421875 /end CHARACTERISTIC
/begin COMPU_METHOD Compu_CL_Ki_p_ROL " " RAT_FUNC "%.1" "%" COEFFS 0 327.68 0 0 0 1 /end COMPU_METHOD
/begin CHARACTERISTIC CLLP_Ki_p_ROL "Ki increasing ROL" VALUE 0x001418F4 /* @ECU_Address@CLLP_Ki_p_ROL@0x01011D88@ */ ECIPP_ALIGNMENT_SWORD 100 Compu_CLLP_Ki_p_ROL -100 99.9969482421875 /end CHARACTERISTIC
/begin COMPU_METHOD Compu_CLLP_Ki_p_ROL " " RAT_FUNC "%.1" "%" COEFFS 0 327.68 0 0 0 1 /end COMPU_METHOD
/begin CHARACTERISTIC CL_Ki_n_ROL "Ki decreasing ROL" VALUE 0x001433AE /* @ECU_Address@CL_Ki_n_ROL@0x01011D98@ */ ECIPP_ALIGNMENT_SWORD 100 Compu_CL_Ki_n_ROL -100 99.9969482421875 /end CHARACTERISTIC
/begin COMPU_METHOD Compu_CL_Ki_n_ROL " " RAT_FUNC "%.1" "%" COEFFS 0 327.68 0 0 0 1 /end COMPU_METHOD
/begin CHARACTERISTIC CLLP_Ki_n_ROL "Ki decreasing ROL" VALUE 0x001418F6 /* @ECU_Address@CLLP_Ki_n_ROL@0x01011DA0@ */ ECIPP_ALIGNMENT_SWORD 100 Compu_CLLP_Ki_n_ROL -100 99.9969482421875 /end CHARACTERISTIC
/begin COMPU_METHOD Compu_CLLP_Ki_n_ROL " " RAT_FUNC "%.1" "%" COEFFS 0 327.68 0 0 0 1 /end COMPU_METHOD
/begin CHARACTERISTIC CL_ROL_win_p "ROL post-cat window upper" VALUE 0x001433DC /* @ECU_Address@CL_ROL_win_p@0x01011DB0@ */ ECIPP_ALIGNMENT_SWORD 2 Compu_CL_ROL_win_p -2 1.99993896484375 /end CHARACTERISTIC
/begin COMPU_METHOD Compu_CL_ROL_win_p " " RAT_FUNC "%.3" "-" COEFFS 0 16384 0 0 0 1 /end COMPU_METHOD
/begin CHARACTERISTIC CLLP_ROL_win_p "ROL post-cat window upper" VALUE 0x00141924 /* @ECU_Address@CLLP_ROL_win_p@0x01011DB8@ */ ECIPP_ALIGNMENT_SWORD 2 Compu_CLLP_ROL_win_p -2 1.99993896484375 /end CHARACTERISTIC
/begin COMPU_METHOD Compu_CLLP_ROL_win_p " " RAT_FUNC "%.3" "-" COEFFS 0 16384 0 0 0 1 /end COMPU_METHOD
/begin CHARACTERISTIC CL_ROL_win_n "ROL post-cat window lower" VALUE 0x001433DE /* @ECU_Address@CL_ROL_win_n@0x01011DC8@ */ ECIPP_ALIGNMENT_SWORD 2 Compu_CL_ROL_win_n -2 1.99993896484375 /end CHARACTERISTIC
/begin COMPU_METHOD Compu_CL_ROL_win_n " " RAT_FUNC "%.3" "-" COEFFS 0 16384 0 0 0 1 /end COMPU_METHOD
/begin CHARACTERISTIC CLLP_ROL_win_n "ROL post-cat window lower" VALUE 0x00141926 /* @ECU_Address@CLLP_ROL_win_n@0x01011DD0@ */ ECIPP_ALIGNMENT_SWORD 2 Compu_CLLP_ROL_win_n -2 1.99993896484375 /end CHARACTERISTIC
/begin COMPU_METHOD Compu_CLLP_ROL_win_n " " RAT_FUNC "%.3" "-" COEFFS 0 16384 0 0 0 1 /end COMPU_METHOD
/begin CHARACTERISTIC CL_ROL_res_dly "ROL ctrl resume delay" VALUE 0x001433E0 /* @ECU_Address@CL_ROL_res_dly@0x01011DE0@ */ ECIPP_ALIGNMENT_UWORD 66 Compu_CL_ROL_res_dly 0 65.535 /end CHARACTERISTIC
/begin COMPU_METHOD Compu_CL_ROL_res_dly " " RAT_FUNC "%.1" "sec" COEFFS 0 1000 0 0 0 1 /end COMPU_METHOD
/begin CHARACTERISTIC CLLP_ROL_res_dly "ROL ctrl resume delay" VALUE 0x00141928 /* @ECU_Address@CLLP_ROL_res_dly@0x01011DE8@ */ ECIPP_ALIGNMENT_UWORD 66 Compu_CLLP_ROL_res_dly 0 65.535 /end CHARACTERISTIC
/begin COMPU_METHOD Compu_CLLP_ROL_res_dly " " RAT_FUNC "%.1" "sec" COEFFS 0 1000 0 0 0 1 /end COMPU_METHOD
/begin CHARACTERISTIC CL_SS_dly "ROL SS trans delay" VALUE 0x001433E2 /* @ECU_Address@CL_SS_dly@0x01011DF8@ */ ECIPP_ALIGNMENT_UWORD 66 Compu_CL_SS_dly 0 65.535 /end CHARACTERISTIC
/begin COMPU_METHOD Compu_CL_SS_dly " " RAT_FUNC "%.1" "sec" COEFFS 0 1000 0 0 0 1 /end COMPU_METHOD
/begin CHARACTERISTIC CLLP_SS_dly "ROL SS trans delay" VALUE 0x0014192A /* @ECU_Address@CLLP_SS_dly@0x01011E00@ */ ECIPP_ALIGNMENT_UWORD 66 Compu_CLLP_SS_dly 0 65.535 /end CHARACTERISTIC
/begin COMPU_METHOD Compu_CLLP_SS_dly " " RAT_FUNC "%.1" "sec" COEFFS 0 1000 0 0 0 1 /end COMPU_METHOD
/begin MEASUREMENT TWCctrl_ROL_d "TWC desired ROL" FLOAT32_IEEE Compu_TWCctrl_ROL_d 0 0 -10000000000 10000000000 ECU_ADDRESS 0x01011E10 /end MEASUREMENT
/begin COMPU_METHOD Compu_TWCctrl_ROL_d " " RAT_FUNC "%.1" "%" COEFFS 0 0.01 0 0 0 1 /end COMPU_METHOD
/begin CHARACTERISTIC TWCdiag_mdot_min "TWC fault min port air flow" VALUE 0x0014794a /* @ECU_Address@TWCdiag_mdot_min@0x01011E18@ */ ECIPP_ALIGNMENT_UWORD 1024 Compu_TWCdiag_mdot_min 0 1023.984375 /end CHARACTERISTIC
/begin COMPU_METHOD Compu_TWCdiag_mdot_min " " RAT_FUNC "%.1" "g/sec" COEFFS 0 64 0 0 0 1 /end COMPU_METHOD
/begin CHARACTERISTIC TWCdiag_ECT_min "TWC fault min ECT" VALUE 0x00147948 /* @ECU_Address@TWCdiag_ECT_min@0x01011E20@ */ ECIPP_ALIGNMENT_UWORD 564 Compu_TWCdiag_ECT_min -460 563.984375 /end CHARACTERISTIC
/begin COMPU_METHOD Compu_TWCdiag_ECT_min " " RAT_FUNC "%.1" "deg F" COEFFS 0 64 29440 0 0 1 /end COMPU_METHOD
/begin CHARACTERISTIC TWCdiag_CBT_min "TWC fault min CBT" VALUE 0x00147946 /* @ECU_Address@TWCdiag_CBT_min@0x01011E28@ */ ECIPP_ALIGNMENT_UWORD 7732 Compu_TWCdiag_CBT_min -460 7731.875 /end CHARACTERISTIC
/begin COMPU_METHOD Compu_TWCdiag_CBT_min " " RAT_FUNC "%.0" "deg F" COEFFS 0 8 3680 0 0 1 /end COMPU_METHOD
/begin CHARACTERISTIC TWCdiag_phi_d "TWC fault pre-cat phi target" VALUE 0x0014794c /* @ECU_Address@TWCdiag_phi_d@0x01011E30@ */ ECIPP_ALIGNMENT_UWORD 4 Compu_TWCdiag_phi_d 0 3.99993896484375 /end CHARACTERISTIC
/begin COMPU_METHOD Compu_TWCdiag_phi_d " " RAT_FUNC "%.3" "phi" COEFFS 0 16384 0 0 0 1 /end COMPU_METHOD
/begin CHARACTERISTIC TWCdiag_phi_pst_thld "TWC fault post-cat phi threshold" VALUE 0x00147952 /* @ECU_Address@TWCdiag_phi_pst_thld@0x01011E38@ */ ECIPP_ALIGNMENT_UWORD 4 Compu_TWCdiag_phi_pst_thld 0 3.99993896484375 /end CHARACTERISTIC
/begin COMPU_METHOD Compu_TWCdiag_phi_pst_thld " " RAT_FUNC "%.3" "phi" COEFFS 0 16384 0 0 0 1 /end COMPU_METHOD
/begin CHARACTERISTIC TWCdiag_phi_pst_lean "TWC fault post-cat lean value" VALUE 0x00147950 /* @ECU_Address@TWCdiag_phi_pst_lean@0x01011E40@ */ ECIPP_ALIGNMENT_UWORD 4 Compu_TWCdiag_phi_pst_lean 0 3.99993896484375 /end CHARACTERISTIC
/begin COMPU_METHOD Compu_TWCdiag_phi_pst_lean " " RAT_FUNC "%.3" "phi" COEFFS 0 16384 0 0 0 1 /end COMPU_METHOD
/begin CHARACTERISTIC TWCdiag_tlean_min "TWC fault min lean time for saturation" VALUE 0x00147954 /* @ECU_Address@TWCdiag_tlean_min@0x01011E48@ */ ECIPP_ALIGNMENT_UWORD 66 Compu_TWCdiag_tlean_min 0 65.535 /end CHARACTERISTIC
/begin COMPU_METHOD Compu_TWCdiag_tlean_min " " RAT_FUNC "%.1" "sec" COEFFS 0 1000 0 0 0 1 /end COMPU_METHOD
/begin CHARACTERISTIC TWCdiag_tmon_max "TWC fault max monitor time" VALUE 0x00147956 /* @ECU_Address@TWCdiag_tmon_max@0x01011E50@ */ ECIPP_ALIGNMENT_UWORD 66 Compu_TWCdiag_tmon_max 0 65.535 /end CHARACTERISTIC
/begin COMPU_METHOD Compu_TWCdiag_tmon_max " " RAT_FUNC "%.1" "sec" COEFFS 0 1000 0 0 0 1 /end COMPU_METHOD
/begin CHARACTERISTIC TWCdiag_max_events "TWC fault max number of monitors" VALUE 0x001480c5 /* @ECU_Address@TWCdiag_max_events@0x01011E58@ */ ECIPP_ALIGNMENT_UBYTE 255 Compu_TWCdiag_max_events 0 255 /end CHARACTERISTIC
/begin COMPU_METHOD Compu_TWCdiag_max_events " " RAT_FUNC "%.0" "mon/cyc" COEFFS 0 1 0 0 0 1 /end COMPU_METHOD
/begin CHARACTERISTIC TWCdiag_K_norm "TWC fault normalization constant" VALUE 0x00143bbc /* @ECU_Address@TWCdiag_K_norm@0x01011E60@ */ ECIPP_ALIGNMENT_FLOAT32_IEEE 10000000000 Compu_TWCdiag_K_norm -10000000000 10000000000 /end CHARACTERISTIC
/begin COMPU_METHOD Compu_TWCdiag_K_norm " " RAT_FUNC "%.2" "-" COEFFS 0 1 0 0 0 1 /end COMPU_METHOD
/begin MEASUREMENT TWCdiag_state "TWC fault status{TWCdiag_state&0xff=0:Inactive}{TWCdiag_state&0xff=1:Waiting}{TWCdiag_state&0xff=2:Ready}{TWCdiag_state&0xff=3:Running}{TWCdiag_state&0xff=4:Complete}{TWCdiag_state&0xff=5:Inactive: FSO/RMT_stop}{TWCdiag_state&0xff=6:Inactive: Max Time}{TW" UBYTE TWCdiag_state_COMPU_VTAB 0 0 0 255 ECU_ADDRESS 0x01011E68 BIT_MASK 0xff /end MEASUREMENT
/begin COMPU_METHOD TWCdiag_state_COMPU_VTAB "Verbal Table" TAB_VERB "%.0" "list" COMPU_TAB_REF TWCdiag_state_COMPU_VTAB_REF /end COMPU_METHOD
/begin COMPU_VTAB TWCdiag_state_COMPU_VTAB_REF "Verbal Table" TAB_VERB 14 0 "Inactive" 1 "Waiting" 2 "Ready" 3 "Running" 4 "Complete" 5 "Inactive: FSO/RMT_stop" 6 "Inactive: Max Time" 7 "Inactive: CBT Low" 8 "Inactive: ECT Low" 9 "Inactive: Max Count" 10 "Inactive: Flow Low" 11 "Inactive: Faults" 12 "Inactive: XEGO validity" 13 "Inactive: Invalid meas." DEFAULT_VALUE "UNKNOWN" /end COMPU_VTAB
/begin MEASUREMENT TWCdiag_monitor_ms "TWC fault monitor timer" UWORD Compu_TWCdiag_monitor_ms 0 0 0 65.535 ECU_ADDRESS 0x01011E70 /end MEASUREMENT
/begin COMPU_METHOD Compu_TWCdiag_monitor_ms " " RAT_FUNC "%.1" "sec" COEFFS 0 1000 0 0 0 1 /end COMPU_METHOD
/begin MEASUREMENT TWCdiag_event_cntr "TWC fault monitor events" UBYTE Compu_TWCdiag_event_cntr 0 0 0 255 ECU_ADDRESS 0x01011E78 /end MEASUREMENT
/begin COMPU_METHOD Compu_TWCdiag_event_cntr " " RAT_FUNC "%.0" "events" COEFFS 0 1 0 0 0 1 /end COMPU_METHOD
/begin MEASUREMENT TWCdiag_OSC_est "TWC fault OSC estimate" FLOAT32_IEEE Compu_TWCdiag_OSC_est 0 0 -10000000000 10000000000 ECU_ADDRESS 0x01011E80 /end MEASUREMENT
/begin COMPU_METHOD Compu_TWCdiag_OSC_est " " RAT_FUNC "%.1" "g" COEFFS 0 1 0 0 0 1 /end COMPU_METHOD
/begin CHARACTERISTIC TWCdiag_ena "TWC fault monitoring condition{TWCdiag_ena&0xff=0:Disabled}{TWCdiag_ena&0xff=1:Fuel shutoff or remote stop}{TWCdiag_ena&0xff=2:Fuel shutoff only}{TWCdiag_ena&0xff=3:Remote stop only}" VALUE 0x001480c4 /* @ECU_Address@TWCdiag_ena@0x01011E88@ */ ECIPP_ALIGNMENT_UBYTE 255 TWCdiag_ena_COMPU_VTAB 0 255 BIT_MASK 0xff /end CHARACTERISTIC
/begin COMPU_METHOD TWCdiag_ena_COMPU_VTAB "Verbal Table" TAB_VERB "%.0" "list" COMPU_TAB_REF TWCdiag_ena_COMPU_VTAB_REF /end COMPU_METHOD
/begin COMPU_VTAB TWCdiag_ena_COMPU_VTAB_REF "Verbal Table" TAB_VERB 4 0 "Disabled" 1 "Fuel shutoff or remote stop" 2 "Fuel shutoff only" 3 "Remote stop only" DEFAULT_VALUE "UNKNOWN" /end COMPU_VTAB
/begin MEASUREMENT CL1_post_SS_status "Post-cat SS mode{CL1_post_SS_status&0xff=0:Steady-state}{CL1_post_SS_status&0xff=1:Transient}" UBYTE CL1_post_SS_status_COMPU_VTAB 0 0 0 255 ECU_ADDRESS 0x01011E90 BIT_MASK 0xff /end MEASUREMENT
/begin COMPU_METHOD CL1_post_SS_status_COMPU_VTAB "Verbal Table" TAB_VERB "%.0" "list" COMPU_TAB_REF CL1_post_SS_status_COMPU_VTAB_REF /end COMPU_METHOD
/begin COMPU_VTAB CL1_post_SS_status_COMPU_VTAB_REF "Verbal Table" TAB_VERB 2 0 "Steady-state" 1 "Transient" DEFAULT_VALUE "UNKNOWN" /end COMPU_VTAB
/begin MEASUREMENT CL1_post_phi_ROL "Post-cat control mode{CL1_post_phi_ROL&0xff=0:ROL}{CL1_post_phi_ROL&0xff=1:Post-Cat Phi}{CL1_post_phi_ROL&0xff=2:Temp ROL}{CL1_post_phi_ROL&0xff=3:Temp Post-Cat Phi}" UBYTE CL1_post_phi_ROL_COMPU_VTAB 0 0 0 255 ECU_ADDRESS 0x01011E98 BIT_MASK 0xff /end MEASUREMENT
/begin COMPU_METHOD CL1_post_phi_ROL_COMPU_VTAB "Verbal Table" TAB_VERB "%.0" "list" COMPU_TAB_REF CL1_post_phi_ROL_COMPU_VTAB_REF /end COMPU_METHOD
/begin COMPU_VTAB CL1_post_phi_ROL_COMPU_VTAB_REF "Verbal Table" TAB_VERB 4 0 "ROL" 1 "Post-Cat Phi" 2 "Temp ROL" 3 "Temp Post-Cat Phi" DEFAULT_VALUE "UNKNOWN" /end COMPU_VTAB
/begin MEASUREMENT TWCmod_ROL_avg "TWC relative oxygen level average" FLOAT32_IEEE Compu_TWCmod_ROL_avg 0 0 -10000000000 10000000000 ECU_ADDRESS 0x01011F88 /end MEASUREMENT
/begin COMPU_METHOD Compu_TWCmod_ROL_avg " " RAT_FUNC "%.1" "%" COEFFS 0 0.01 0 0 0 1 /end COMPU_METHOD
/begin CHARACTERISTIC TWCdiag_cat_temp "TWC monitor catalyst temperature selection{TWCdiag_cat_temp&0xff=0:Bed temperature (model)}{TWCdiag_cat_temp&0xff=1:Inlet temperature}{TWCdiag_cat_temp&0xff=2:Outlet temperature}" VALUE 0x001480c3 /* @ECU_Address@TWCdiag_cat_temp@0x01012268@ */ ECIPP_ALIGNMENT_UBYTE 255 TWCdiag_cat_temp_COMPU_VTAB 0 255 BIT_MASK 0xff /end CHARACTERISTIC
/begin COMPU_METHOD TWCdiag_cat_temp_COMPU_VTAB "Verbal Table" TAB_VERB "%.0" "list" COMPU_TAB_REF TWCdiag_cat_temp_COMPU_VTAB_REF /end COMPU_METHOD
/begin COMPU_VTAB TWCdiag_cat_temp_COMPU_VTAB_REF "Verbal Table" TAB_VERB 3 0 "Bed temperature (model)" 1 "Inlet temperature" 2 "Outlet temperature" DEFAULT_VALUE "UNKNOWN" /end COMPU_VTAB
/begin MEASUREMENT TWCdiag_OSC_est_avg "TWC monitor average OSC value" FLOAT32_IEEE Compu_TWCdiag_OSC_est_avg 0 0 -10000000000 10000000000 ECU_ADDRESS 0x010122B0 /end MEASUREMENT
/begin COMPU_METHOD Compu_TWCdiag_OSC_est_avg " " RAT_FUNC "%.1" "g" COEFFS 0 1 0 0 0 1 /end COMPU_METHOD
/begin CHARACTERISTIC TWCdiag_OSC_min "Minimum valid OSC" VALUE 0x00143bc8 /* @ECU_Address@TWCdiag_OSC_min@0x010122B8@ */ ECIPP_ALIGNMENT_FLOAT32_IEEE 10000000000 Compu_TWCdiag_OSC_min -10000000000 10000000000 /end CHARACTERISTIC
/begin COMPU_METHOD Compu_TWCdiag_OSC_min " " RAT_FUNC "%.1" "g" COEFFS 0 1 0 0 0 1 /end COMPU_METHOD
/begin CHARACTERISTIC TWCdiag_OSC_max "Maximum valid OSC" VALUE 0x00143bc4 /* @ECU_Address@TWCdiag_OSC_max@0x010122C0@ */ ECIPP_ALIGNMENT_FLOAT32_IEEE 10000000000 Compu_TWCdiag_OSC_max -10000000000 10000000000 /end CHARACTERISTIC
/begin COMPU_METHOD Compu_TWCdiag_OSC_max " " RAT_FUNC "%.1" "g" COEFFS 0 1 0 0 0 1 /end COMPU_METHOD
/begin CHARACTERISTIC CBT_taustopped "CTM engine stopped tau" VALUE 0x00147bc2 /* @ECU_Address@CBT_taustopped@0x01012918@ */ ECIPP_ALIGNMENT_UWORD 3277 Compu_CBT_taustopped 0.0045084 3276.8 /end CHARACTERISTIC
/begin COMPU_METHOD Compu_CBT_taustopped " " FORM "%.1" "sec"
 /begin FORMULA "-0.05 / log(1 - (X1 / 65536))" FORMULA_INV "(1 - exp(-0.05/X1)) * 65536" /end FORMULA
/end COMPU_METHOD
/begin CHARACTERISTIC TWCctrl_CBT_FSO_ena "ROL control min CBT & FSO req.{TWCctrl_CBT_FSO_ena&0xff=0:NO}{TWCctrl_CBT_FSO_ena&0xff=1:YES}" VALUE 0x001480c2 /* @ECU_Address@TWCctrl_CBT_FSO_ena@0x01012D88@ */ ECIPP_ALIGNMENT_UBYTE 255 TWCctrl_CBT_FSO_ena_COMPU_VTAB 0 255 BIT_MASK 0xff /end CHARACTERISTIC
/begin COMPU_METHOD TWCctrl_CBT_FSO_ena_COMPU_VTAB "Verbal Table" TAB_VERB "%.0" "list" COMPU_TAB_REF TWCctrl_CBT_FSO_ena_COMPU_VTAB_REF /end COMPU_METHOD
/begin COMPU_VTAB TWCctrl_CBT_FSO_ena_COMPU_VTAB_REF "Verbal Table" TAB_VERB 2 0 "NO" 1 "YES" DEFAULT_VALUE "UNKNOWN" /end COMPU_VTAB
/begin CHARACTERISTIC TWCctrl_CBT_min "ROL control min CBT threshold" VALUE 0x00147944 /* @ECU_Address@TWCctrl_CBT_min@0x01012D90@ */ ECIPP_ALIGNMENT_UWORD 7732 Compu_TWCctrl_CBT_min -460 7731.875 /end CHARACTERISTIC
/begin COMPU_METHOD Compu_TWCctrl_CBT_min " " RAT_FUNC "%.0" "deg F" COEFFS 0 8 3680 0 0 1 /end COMPU_METHOD
/begin MEASUREMENT CL1_CBT_hot "CBT threshold exceeded{CL1_CBT_hot&0xff=0:NO}{CL1_CBT_hot&0xff=1:YES}{CL1_CBT_hot&0xff=2:N/A}" UBYTE CL1_CBT_hot_COMPU_VTAB 0 0 0 255 ECU_ADDRESS 0x01012D98 BIT_MASK 0xff /end MEASUREMENT
/begin COMPU_METHOD CL1_CBT_hot_COMPU_VTAB "Verbal Table" TAB_VERB "%.0" "list" COMPU_TAB_REF CL1_CBT_hot_COMPU_VTAB_REF /end COMPU_METHOD
/begin COMPU_VTAB CL1_CBT_hot_COMPU_VTAB_REF "Verbal Table" TAB_VERB 3 0 "NO" 1 "YES" 2 "N/A" DEFAULT_VALUE "UNKNOWN" /end COMPU_VTAB
/begin MEASUREMENT CL1_FSO_occurred "Lean FSO occurred{CL1_FSO_occurred&0xff=0:NO}{CL1_FSO_occurred&0xff=1:YES}{CL1_FSO_occurred&0xff=2:N/A}" UBYTE CL1_FSO_occurred_COMPU_VTAB 0 0 0 255 ECU_ADDRESS 0x01012DA0 BIT_MASK 0xff /end MEASUREMENT
/begin COMPU_METHOD CL1_FSO_occurred_COMPU_VTAB "Verbal Table" TAB_VERB "%.0" "list" COMPU_TAB_REF CL1_FSO_occurred_COMPU_VTAB_REF /end COMPU_METHOD
/begin COMPU_VTAB CL1_FSO_occurred_COMPU_VTAB_REF "Verbal Table" TAB_VERB 3 0 "NO" 1 "YES" 2 "N/A" DEFAULT_VALUE "UNKNOWN" /end COMPU_VTAB
/begin MEASUREMENT TWCmod_ROL_dly "Relative oxygen level delayed" FLOAT32_IEEE Compu_TWCmod_ROL_dly 0 0 -10000000000 10000000000 ECU_ADDRESS 0x01013370 /end MEASUREMENT
/begin COMPU_METHOD Compu_TWCmod_ROL_dly " " RAT_FUNC "%.1" "%" COEFFS 0 0.01 0 0 0 1 /end COMPU_METHOD
/begin CHARACTERISTIC TWCdiag_phi_d_app "TWC fault pre-cat phi app tgt" VALUE 0x0014794e /* @ECU_Address@TWCdiag_phi_d_app@0x01013378@ */ ECIPP_ALIGNMENT_UWORD 4 Compu_TWCdiag_phi_d_app 0 3.99993896484375 /end CHARACTERISTIC
/begin COMPU_METHOD Compu_TWCdiag_phi_d_app " " RAT_FUNC "%.3" "phi" COEFFS 0 16384 0 0 0 1 /end COMPU_METHOD
/begin MEASUREMENT CLp_fastwr_cs_state "CL UEGO cold start state{CLp_fastwr_cs_state&0xff=0:Waiting for start}{CLp_fastwr_cs_state&0xff=1:Active}{CLp_fastwr_cs_state&0xff=10:Disabled}{CLp_fastwr_cs_state&0xff=11:Timed out}{CLp_fastwr_cs_state&0xff=12:Inactive}{CLp_fastwr_cs_state&0xff=13:Comple" UBYTE CLp_fastwr_cs_state_COMPU_VTAB 0 0 0 255 ECU_ADDRESS 0x01013800 BIT_MASK 0xff /end MEASUREMENT
/begin COMPU_METHOD CLp_fastwr_cs_state_COMPU_VTAB "Verbal Table" TAB_VERB "%.0" "list" COMPU_TAB_REF CLp_fastwr_cs_state_COMPU_VTAB_REF /end COMPU_METHOD
/begin COMPU_VTAB CLp_fastwr_cs_state_COMPU_VTAB_REF "Verbal Table" TAB_VERB 6 0 "Waiting for start" 1 "Active" 10 "Disabled" 11 "Timed out" 12 "Inactive" 13 "Complete" DEFAULT_VALUE "UNKNOWN" /end COMPU_VTAB
/begin CHARACTERISTIC CLp_fastwr_cs_CBT "CL UEGO cold start CBT" VALUE 0x00146754 /* @ECU_Address@CLp_fastwr_cs_CBT@0x01013808@ */ ECIPP_ALIGNMENT_UWORD 7732 Compu_CLp_fastwr_cs_CBT -460 7731.875 /end CHARACTERISTIC
/begin COMPU_METHOD Compu_CLp_fastwr_cs_CBT " " RAT_FUNC "%.0" "deg F" COEFFS 0 8 3680 0 0 1 /end COMPU_METHOD
/begin MEASUREMENT Phi_post_cs_state "Postcat cold start state{Phi_post_cs_state&0xff=0:Waiting for start}{Phi_post_cs_state&0xff=1:Active}{Phi_post_cs_state&0xff=10:Disabled}{Phi_post_cs_state&0xff=11:Timed out}{Phi_post_cs_state&0xff=12:Inactive}{Phi_post_cs_state&0xff=13:Complete}" UBYTE Phi_post_cs_state_COMPU_VTAB 0 0 0 255 ECU_ADDRESS 0x01013810 BIT_MASK 0xff /end MEASUREMENT
/begin COMPU_METHOD Phi_post_cs_state_COMPU_VTAB "Verbal Table" TAB_VERB "%.0" "list" COMPU_TAB_REF Phi_post_cs_state_COMPU_VTAB_REF /end COMPU_METHOD
/begin COMPU_VTAB Phi_post_cs_state_COMPU_VTAB_REF "Verbal Table" TAB_VERB 6 0 "Waiting for start" 1 "Active" 10 "Disabled" 11 "Timed out" 12 "Inactive" 13 "Complete" DEFAULT_VALUE "UNKNOWN" /end COMPU_VTAB
/begin CHARACTERISTIC Phi_post_cs_CBT "Postcat cold start CBT" VALUE 0x001476e6 /* @ECU_Address@Phi_post_cs_CBT@0x01013818@ */ ECIPP_ALIGNMENT_UWORD 7732 Compu_Phi_post_cs_CBT -460 7731.875 /end CHARACTERISTIC
/begin COMPU_METHOD Compu_Phi_post_cs_CBT " " RAT_FUNC "%.0" "deg F" COEFFS 0 8 3680 0 0 1 /end COMPU_METHOD
/begin CHARACTERISTIC CL_postcat_winpdlt "Post-cat window high delta" VALUE 0x001433EA /* @ECU_Address@CL_postcat_winpdlt@0x01013820@ */ ECIPP_ALIGNMENT_SWORD 2 Compu_CL_postcat_winpdlt -2 1.99993896484375 /end CHARACTERISTIC
/begin COMPU_METHOD Compu_CL_postcat_winpdlt " " RAT_FUNC "%.3" "-" COEFFS 0 16384 0 0 0 1 /end COMPU_METHOD
/begin CHARACTERISTIC CLLP_postcat_winpdlt "Post-cat window high delta" VALUE 0x00141932 /* @ECU_Address@CLLP_postcat_winpdlt@0x01013828@ */ ECIPP_ALIGNMENT_SWORD 2 Compu_CLLP_postcat_winpdlt -2 1.99993896484375 /end CHARACTERISTIC
/begin COMPU_METHOD Compu_CLLP_postcat_winpdlt " " RAT_FUNC "%.3" "-" COEFFS 0 16384 0 0 0 1 /end COMPU_METHOD
/begin CHARACTERISTIC CL_postcat_winndlt "Post-cat window low delta" VALUE 0x001433EC /* @ECU_Address@CL_postcat_winndlt@0x01013838@ */ ECIPP_ALIGNMENT_SWORD 2 Compu_CL_postcat_winndlt -2 1.99993896484375 /end CHARACTERISTIC
/begin COMPU_METHOD Compu_CL_postcat_winndlt " " RAT_FUNC "%.3" "-" COEFFS 0 16384 0 0 0 1 /end COMPU_METHOD
/begin CHARACTERISTIC CLLP_postcat_winndlt "Post-cat window low delta" VALUE 0x00141934 /* @ECU_Address@CLLP_postcat_winndlt@0x01013840@ */ ECIPP_ALIGNMENT_SWORD 2 Compu_CLLP_postcat_winndlt -2 1.99993896484375 /end CHARACTERISTIC
/begin COMPU_METHOD Compu_CLLP_postcat_winndlt " " RAT_FUNC "%.3" "-" COEFFS 0 16384 0 0 0 1 /end COMPU_METHOD
/begin CHARACTERISTIC CL_ROLend_fastwrtm "Post-cat Temp Phi cont CL" VALUE 0x001433EE /* @ECU_Address@CL_ROLend_fastwrtm@0x01013850@ */ ECIPP_ALIGNMENT_UWORD 66 Compu_CL_ROLend_fastwrtm 0 65.535 /end CHARACTERISTIC
/begin COMPU_METHOD Compu_CL_ROLend_fastwrtm " " RAT_FUNC "%.2" "sec" COEFFS 0 1000 0 0 0 1 /end COMPU_METHOD
/begin CHARACTERISTIC CLLP_ROLend_fastwrtm "Post-cat Temp Phi cont CL" VALUE 0x00141936 /* @ECU_Address@CLLP_ROLend_fastwrtm@0x01013858@ */ ECIPP_ALIGNMENT_UWORD 66 Compu_CLLP_ROLend_fastwrtm 0 65.535 /end CHARACTERISTIC
/begin COMPU_METHOD Compu_CLLP_ROLend_fastwrtm " " RAT_FUNC "%.2" "sec" COEFFS 0 1000 0 0 0 1 /end COMPU_METHOD
/begin CHARACTERISTIC CL_post_fastwr_tm "Post-cat Phi cont CL time" VALUE 0x001433F0 /* @ECU_Address@CL_post_fastwr_tm@0x01013868@ */ ECIPP_ALIGNMENT_UWORD 66 Compu_CL_post_fastwr_tm 0 65.535 /end CHARACTERISTIC
/begin COMPU_METHOD Compu_CL_post_fastwr_tm " " RAT_FUNC "%.2" "sec" COEFFS 0 1000 0 0 0 1 /end COMPU_METHOD
/begin CHARACTERISTIC CLLP_post_fastwr_tm "Post-cat Phi cont CL time" VALUE 0x00141938 /* @ECU_Address@CLLP_post_fastwr_tm@0x01013870@ */ ECIPP_ALIGNMENT_UWORD 66 Compu_CLLP_post_fastwr_tm 0 65.535 /end CHARACTERISTIC
/begin COMPU_METHOD Compu_CLLP_post_fastwr_tm " " RAT_FUNC "%.2" "sec" COEFFS 0 1000 0 0 0 1 /end COMPU_METHOD
/begin MEASUREMENT CL1_ROL_win_p_th "ROL window high limit" UWORD Compu_CL1_ROL_win_p_th 0 0 0 3.99993896484375 ECU_ADDRESS 0x01013880 /end MEASUREMENT
/begin COMPU_METHOD Compu_CL1_ROL_win_p_th " " RAT_FUNC "%.3" "phi" COEFFS 0 16384 0 0 0 1 /end COMPU_METHOD
/begin MEASUREMENT CL1_ROL_win_n_th "ROL window low limit" UWORD Compu_CL1_ROL_win_n_th 0 0 0 3.99993896484375 ECU_ADDRESS 0x01013888 /end MEASUREMENT
/begin COMPU_METHOD Compu_CL1_ROL_win_n_th " " RAT_FUNC "%.3" "phi" COEFFS 0 16384 0 0 0 1 /end COMPU_METHOD
/begin MEASUREMENT CL1_postcat_hi_th "Post-cat window high limit" UWORD Compu_CL1_postcat_hi_th 0 0 0 3.99993896484375 ECU_ADDRESS 0x01013890 /end MEASUREMENT
/begin COMPU_METHOD Compu_CL1_postcat_hi_th " " RAT_FUNC "%.3" "phi" COEFFS 0 16384 0 0 0 1 /end COMPU_METHOD
/begin MEASUREMENT CL1_postcat_lo_th "Post-cat window low limit" UWORD Compu_CL1_postcat_lo_th 0 0 0 3.99993896484375 ECU_ADDRESS 0x01013898 /end MEASUREMENT
/begin COMPU_METHOD Compu_CL1_postcat_lo_th " " RAT_FUNC "%.3" "phi" COEFFS 0 16384 0 0 0 1 /end COMPU_METHOD
/begin CHARACTERISTIC TWCdiag_pst_rich_rst "TWC fault post-cat thres reset{TWCdiag_pst_rich_rst&0xff=0:First monitor only}{TWCdiag_pst_rich_rst&0xff=1:Each monitor}" VALUE 0x001480c6 /* @ECU_Address@TWCdiag_pst_rich_rst@0x010138A0@ */ ECIPP_ALIGNMENT_UBYTE 255 TWCdiag_pst_rich_rst_COMPU_VTAB 0 255 BIT_MASK 0xff /end CHARACTERISTIC
/begin COMPU_METHOD TWCdiag_pst_rich_rst_COMPU_VTAB "Verbal Table" TAB_VERB "%.0" "list" COMPU_TAB_REF TWCdiag_pst_rich_rst_COMPU_VTAB_REF /end COMPU_METHOD
/begin COMPU_VTAB TWCdiag_pst_rich_rst_COMPU_VTAB_REF "Verbal Table" TAB_VERB 2 0 "First monitor only" 1 "Each monitor" DEFAULT_VALUE "UNKNOWN" /end COMPU_VTAB
/begin CHARACTERISTIC TWCmod_OSC_error_Kp "TWC OSC error Kp" VALUE 0x00147958 /* @ECU_Address@TWCmod_OSC_error_Kp@0x010138B0@ */ ECIPP_ALIGNMENT_UWORD 100 Compu_TWCmod_OSC_error_Kp 0 99.9984741210938 /end CHARACTERISTIC
/begin COMPU_METHOD Compu_TWCmod_OSC_error_Kp " " RAT_FUNC "%.1" "%/mon" COEFFS 0 655.36 0 0 0 1 /end COMPU_METHOD
/begin CHARACTERISTIC TWCdiag_OSC_marg "TWC fault diagnostic margin" VALUE 0x00143bc0 /* @ECU_Address@TWCdiag_OSC_marg@0x01013910@ */ ECIPP_ALIGNMENT_FLOAT32_IEEE 10000000000 Compu_TWCdiag_OSC_marg -10000000000 10000000000 /end CHARACTERISTIC
/begin COMPU_METHOD Compu_TWCdiag_OSC_marg " " RAT_FUNC "%.1" "g" COEFFS 0 1 0 0 0 1 /end COMPU_METHOD
/begin COMPU_METHOD Compu_TPhi_base_MAP " " RAT_FUNC "%.1" "MAP load (psia)" COEFFS 0 256 0 0 0 1 /end COMPU_METHOD
/begin COMPU_METHOD Compu_TPhi_base_rpm " " RAT_FUNC "%.0" "Speed (rpm)" COEFFS 0 1 0 0 0 1 /end COMPU_METHOD
/begin AXIS_PTS TPhi_base_MAP " " 0x00142B64 /* @ECU_Address@TPhi_base_MAP@0x0201A000@ */ NO_INPUT_QUANTITY ECIPP_Lookup_SWORD 0 Compu_TPhi_base_MAP 14 -128 127.99609375 /end AXIS_PTS
/begin AXIS_PTS TPhi_base_rpm " " 0x00142C98 /* @ECU_Address@TPhi_base_rpm@0x0201B000@ */ NO_INPUT_QUANTITY ECIPP_Lookup_SWORD 0 Compu_TPhi_base_rpm 10 -32768 32767 /end AXIS_PTS
/begin CHARACTERISTIC TCL_ena "Gasoline CL Enable Table" MAP 0x001428BC /* @ECU_Address@TCL_ena@0x02023000@ */ ECIPP_ALIGNMENT_SWORD 128 Compu_TCL_ena -128 127.99609375
 /begin AXIS_DESCR COM_AXIS NO_INPUT_QUANTITY Compu_TPhi_base_MAP 14 -128 127.99609375 AXIS_PTS_REF TPhi_base_MAP /end AXIS_DESCR
 /begin AXIS_DESCR COM_AXIS NO_INPUT_QUANTITY Compu_TPhi_base_rpm 10 -32768 32767 AXIS_PTS_REF TPhi_base_rpm /end AXIS_DESCR
/end CHARACTERISTIC
/begin COMPU_METHOD Compu_TCL_ena "" RAT_FUNC "%.0" "CL eanble (logical)" COEFFS 0 256 0 0 0 1 /end COMPU_METHOD
/begin COMPU_METHOD Compu_TCLp_tau_rpm " " RAT_FUNC "%.0" "Speed (rpm)" COEFFS 0 1 0 0 0 1 /end COMPU_METHOD
/begin COMPU_METHOD Compu_TCLp_tau_MAP " " RAT_FUNC "%.1" "MAP (psia)" COEFFS 0 256 0 0 0 1 /end COMPU_METHOD
/begin CHARACTERISTIC TCLp_tau_cyc "Gasoline CL Switching Frequency" MAP 0x00142AF4 /* @ECU_Address@TCLp_tau_cyc@0x0203A000@ */ ECIPP_ALIGNMENT_SWORD 2048 Compu_TCLp_tau_cyc -2048 2047.9375
 /begin AXIS_DESCR COM_AXIS NO_INPUT_QUANTITY Compu_TCLp_tau_MAP 4 -128 127.99609375 AXIS_PTS_REF TCLp_tau_MAP /end AXIS_DESCR
 /begin AXIS_DESCR COM_AXIS NO_INPUT_QUANTITY Compu_TCLp_tau_rpm 8 -32768 32767 AXIS_PTS_REF TCLp_tau_rpm /end AXIS_DESCR
/end CHARACTERISTIC
/begin AXIS_PTS TCLp_tau_MAP " " 0x00142AEC /* @ECU_Address@TCLp_tau_MAP@0x02039000@ */ NO_INPUT_QUANTITY ECIPP_Lookup_SWORD 0 Compu_TCLp_tau_MAP 4 -128 127.99609375 /end AXIS_PTS
/begin AXIS_PTS TCLp_tau_rpm " " 0x00142B34 /* @ECU_Address@TCLp_tau_rpm@0x02038000@ */ NO_INPUT_QUANTITY ECIPP_Lookup_SWORD 0 Compu_TCLp_tau_rpm 8 -32768 32767 /end AXIS_PTS
/begin COMPU_METHOD Compu_TCLp_tau_cyc "" RAT_FUNC "%.1" "Engine Cycles" COEFFS 0 16 0 0 0 1 /end COMPU_METHOD
/begin COMPU_METHOD Compu_TCTM_mdot_a " " RAT_FUNC "%.1" "Mdot Air (g/sec)" COEFFS 0 64 0 0 0 1 /end COMPU_METHOD
/begin CHARACTERISTIC TCTM_Temp "CBT Gasoline SS Cal" CURVE 0x001444AA /* @ECU_Address@TCTM_Temp@0x0203C000@ */ ECIPP_ALIGNMENT_SWORD 3636 Compu_TCTM_Temp -4556 3635.875
 /begin AXIS_DESCR COM_AXIS NO_INPUT_QUANTITY Compu_TCTM_mdot_a 8 -512 511.984375 AXIS_PTS_REF TCTM_mdot_a /end AXIS_DESCR
/end CHARACTERISTIC
/begin AXIS_PTS TCTM_mdot_a " " 0x001444CA /* @ECU_Address@TCTM_mdot_a@0x0203B000@ */ NO_INPUT_QUANTITY ECIPP_Lookup_SWORD 0 Compu_TCTM_mdot_a 8 -512 511.984375 /end AXIS_PTS
/begin COMPU_METHOD Compu_TCTM_Temp " " RAT_FUNC "%.0" "CBT (deg F)" COEFFS 0 8 3680 0 0 1 /end COMPU_METHOD
/begin COMPU_METHOD Compu_TCLp_tau_rpmP " " RAT_FUNC "%.0" "Speed (rpm)" COEFFS 0 1 0 0 0 1 /end COMPU_METHOD
/begin COMPU_METHOD Compu_TCLp_tau_MAPP " " RAT_FUNC "%.1" "MAP (psia)" COEFFS 0 256 0 0 0 1 /end COMPU_METHOD
/begin CHARACTERISTIC TCLp_tau_cycP "LPG CL Switching Frequency" MAP 0x00140FC2 /* @ECU_Address@TCLp_tau_cycP@0x02063000@ */ ECIPP_ALIGNMENT_SWORD 2048 Compu_TCLp_tau_cycP -2048 2047.9375
 /begin AXIS_DESCR COM_AXIS NO_INPUT_QUANTITY Compu_TCLp_tau_MAPP 4 -128 127.99609375 AXIS_PTS_REF TCLp_tau_MAPP /end AXIS_DESCR
 /begin AXIS_DESCR COM_AXIS NO_INPUT_QUANTITY Compu_TCLp_tau_rpmP 8 -32768 32767 AXIS_PTS_REF TCLp_tau_rpmP /end AXIS_DESCR
/end CHARACTERISTIC
/begin AXIS_PTS TCLp_tau_MAPP " " 0x00140FBA /* @ECU_Address@TCLp_tau_MAPP@0x02062000@ */ NO_INPUT_QUANTITY ECIPP_Lookup_SWORD 0 Compu_TCLp_tau_MAPP 4 -128 127.99609375 /end AXIS_PTS
/begin AXIS_PTS TCLp_tau_rpmP " " 0x00141002 /* @ECU_Address@TCLp_tau_rpmP@0x02061000@ */ NO_INPUT_QUANTITY ECIPP_Lookup_SWORD 0 Compu_TCLp_tau_rpmP 8 -32768 32767 /end AXIS_PTS
/begin COMPU_METHOD Compu_TCLp_tau_cycP "" RAT_FUNC "%.1" "Engine Cycles" COEFFS 0 16 0 0 0 1 /end COMPU_METHOD
/begin CHARACTERISTIC TCL_enaP "LPG CL Enable Table" MAP 0x00140D8A /* @ECU_Address@TCL_enaP@0x02067000@ */ ECIPP_ALIGNMENT_SWORD 128 Compu_TCL_enaP -128 127.99609375
 /begin AXIS_DESCR COM_AXIS NO_INPUT_QUANTITY Compu_TPhi_base_MAPP 14 -128 127.99609375 AXIS_PTS_REF TPhi_base_MAPP /end AXIS_DESCR
 /begin AXIS_DESCR COM_AXIS NO_INPUT_QUANTITY Compu_TPhi_base_rpmP 10 -32768 32767 AXIS_PTS_REF TPhi_base_rpmP /end AXIS_DESCR
/end CHARACTERISTIC
/begin AXIS_PTS TPhi_base_MAPP " " 0x00141032 /* @ECU_Address@TPhi_base_MAPP@0x02069000@ */ NO_INPUT_QUANTITY ECIPP_Lookup_SWORD 0 Compu_TPhi_base_MAPP 14 -128 127.99609375 /end AXIS_PTS
/begin AXIS_PTS TPhi_base_rpmP " " 0x00141166 /* @ECU_Address@TPhi_base_rpmP@0x0206A000@ */ NO_INPUT_QUANTITY ECIPP_Lookup_SWORD 0 Compu_TPhi_base_rpmP 10 -32768 32767 /end AXIS_PTS
/begin COMPU_METHOD Compu_TCL_enaP "" RAT_FUNC "%.0" "CL eanble (logical)" COEFFS 0 256 0 0 0 1 /end COMPU_METHOD
/begin COMPU_METHOD Compu_TPhi_base_MAPP " " RAT_FUNC "%.1" "MAP load (psia)" COEFFS 0 256 0 0 0 1 /end COMPU_METHOD
/begin COMPU_METHOD Compu_TPhi_base_rpmP " " RAT_FUNC "%.0" "Speed (rpm)" COEFFS 0 1 0 0 0 1 /end COMPU_METHOD
/begin COMPU_METHOD Compu_Ttrim_mdotaP " " RAT_FUNC "%.1" "Mdot Air (g/sec)" COEFFS 0 32 0 0 0 1 /end COMPU_METHOD
/begin COMPU_METHOD Compu_TCTMA_mdot_a " " RAT_FUNC "%.1" "Mdot Air (g/sec)" COEFFS 0 64 0 0 0 1 /end COMPU_METHOD
/begin CHARACTERISTIC TCTMA_Temp "CBT Gaseous Fuel SS Cal" CURVE 0x0014446A /* @ECU_Address@TCTMA_Temp@0x0207C000@ */ ECIPP_ALIGNMENT_SWORD 3636 Compu_TCTMA_Temp -4556 3635.875
 /begin AXIS_DESCR COM_AXIS NO_INPUT_QUANTITY Compu_TCTMA_mdot_a 8 -512 511.984375 AXIS_PTS_REF TCTMA_mdot_a /end AXIS_DESCR
/end CHARACTERISTIC
/begin AXIS_PTS TCTMA_mdot_a " " 0x0014448A /* @ECU_Address@TCTMA_mdot_a@0x0207B000@ */ NO_INPUT_QUANTITY ECIPP_Lookup_SWORD 0 Compu_TCTMA_mdot_a 8 -512 511.984375 /end AXIS_PTS
/begin COMPU_METHOD Compu_TCTMA_Temp " " RAT_FUNC "%.0" "CBT (deg F)" COEFFS 0 8 3680 0 0 1 /end COMPU_METHOD
/begin CHARACTERISTIC TCL_postcat_phigsln "Gasoline Post-Cat Phi Target Table" MAP 0x001429D4 /* @ECU_Address@TCL_postcat_phigsln@0x020C2000@ */ ECIPP_ALIGNMENT_SWORD 2 Compu_TCL_postcat_phigsln -2 1.99993896484375
 /begin AXIS_DESCR COM_AXIS NO_INPUT_QUANTITY Compu_TPhi_base_MAP 14 -128 127.99609375 AXIS_PTS_REF TPhi_base_MAP /end AXIS_DESCR
 /begin AXIS_DESCR COM_AXIS NO_INPUT_QUANTITY Compu_TPhi_base_rpm 10 -32768 32767 AXIS_PTS_REF TPhi_base_rpm /end AXIS_DESCR
/end CHARACTERISTIC
/begin COMPU_METHOD Compu_TCL_postcat_phigsln "" RAT_FUNC "%.4" "Phi-Target (phi)" COEFFS 0 16384 0 0 0 1 /end COMPU_METHOD
/begin CHARACTERISTIC Tvent_PP "LPG Venturi Signal" CURVE 0x0014189A /* @ECU_Address@Tvent_PP@0x020C5000@ */ ECIPP_ALIGNMENT_SWORD 222 Compu_Tvent_PP -222 221.993225097656
 /begin AXIS_DESCR COM_AXIS NO_INPUT_QUANTITY Compu_Ttrim_mdotaP 8 -1024 1023.96875 AXIS_PTS_REF Ttrim_mdotaP /end AXIS_DESCR
/end CHARACTERISTIC
/begin AXIS_PTS Ttrim_mdotaP " " 0x0014188A /* @ECU_Address@Ttrim_mdotaP@0x0206F000@ */ NO_INPUT_QUANTITY ECIPP_Lookup_SWORD 0 Compu_Ttrim_mdotaP 8 -1024 1023.96875 /end AXIS_PTS
/begin COMPU_METHOD Compu_Tvent_PP " " RAT_FUNC "%.2" "in H2O" COEFFS 0 147.603603603604 0 0 0 1 /end COMPU_METHOD
/begin COMPU_METHOD Compu_T2trim_nom_MAPP " " RAT_FUNC "%.1" "MAP_load (psia)" COEFFS 0 256 0 0 0 1 /end COMPU_METHOD
/begin COMPU_METHOD Compu_T2trim_nom_rpmP " " RAT_FUNC "%.0" "Speed (rpm)" COEFFS 0 1 0 0 0 1 /end COMPU_METHOD
/begin CHARACTERISTIC T2trim_nom_DCP "LPG Nominal PWM Trim Duty-Cycle" MAP 0x00140B0E /* @ECU_Address@T2trim_nom_DCP@0x020CD000@ */ ECIPP_ALIGNMENT_SWORD 200 Compu_T2trim_nom_DCP -200 199.993896484375
 /begin AXIS_DESCR COM_AXIS NO_INPUT_QUANTITY Compu_T2trim_nom_MAPP 14 -128 127.99609375 AXIS_PTS_REF T2trim_nom_MAPP /end AXIS_DESCR
 /begin AXIS_DESCR COM_AXIS NO_INPUT_QUANTITY Compu_T2trim_nom_rpmP 10 -32768 32767 AXIS_PTS_REF T2trim_nom_rpmP /end AXIS_DESCR
/end CHARACTERISTIC
/begin AXIS_PTS T2trim_nom_MAPP " " 0x00140C26 /* @ECU_Address@T2trim_nom_MAPP@0x020CB000@ */ NO_INPUT_QUANTITY ECIPP_Lookup_SWORD 0 Compu_T2trim_nom_MAPP 14 -128 127.99609375 /end AXIS_PTS
/begin AXIS_PTS T2trim_nom_rpmP " " 0x00140D76 /* @ECU_Address@T2trim_nom_rpmP@0x020CC000@ */ NO_INPUT_QUANTITY ECIPP_Lookup_SWORD 0 Compu_T2trim_nom_rpmP 10 -32768 32767 /end AXIS_PTS
/begin COMPU_METHOD Compu_T2trim_nom_DCP "" RAT_FUNC "%.1" "Nominal Duty-Cycle (%)" COEFFS 0 163.84 0 0 0 1 /end COMPU_METHOD
/begin CHARACTERISTIC T2MJ_nom_PP "LPG Nominal MegaJector Outlet Pressure" MAP 0x001409F6 /* @ECU_Address@T2MJ_nom_PP@0x020CE000@ */ ECIPP_ALIGNMENT_SWORD 222 Compu_T2MJ_nom_PP -222 221.993225097656
 /begin AXIS_DESCR COM_AXIS NO_INPUT_QUANTITY Compu_T2trim_nom_MAPP 14 -128 127.99609375 AXIS_PTS_REF T2trim_nom_MAPP /end AXIS_DESCR
 /begin AXIS_DESCR COM_AXIS NO_INPUT_QUANTITY Compu_T2trim_nom_rpmP 10 -32768 32767 AXIS_PTS_REF T2trim_nom_rpmP /end AXIS_DESCR
/end CHARACTERISTIC
/begin COMPU_METHOD Compu_T2MJ_nom_PP "" RAT_FUNC "%.2" "Nominal Phi Pressure (in H2O)" COEFFS 0 147.603603603604 0 0 0 1 /end COMPU_METHOD
/begin CHARACTERISTIC T2trim_nom_phiP "LPG Nominal Trim Phi" MAP 0x00140C5E /* @ECU_Address@T2trim_nom_phiP@0x020CF000@ */ ECIPP_ALIGNMENT_SWORD 2 Compu_T2trim_nom_phiP -2 1.99993896484375
 /begin AXIS_DESCR COM_AXIS NO_INPUT_QUANTITY Compu_T2trim_nom_MAPP 14 -128 127.99609375 AXIS_PTS_REF T2trim_nom_MAPP /end AXIS_DESCR
 /begin AXIS_DESCR COM_AXIS NO_INPUT_QUANTITY Compu_T2trim_nom_rpmP 10 -32768 32767 AXIS_PTS_REF T2trim_nom_rpmP /end AXIS_DESCR
/end CHARACTERISTIC
/begin COMPU_METHOD Compu_T2trim_nom_phiP "" RAT_FUNC "%.3" "Nominal Phi" COEFFS 0 16384 0 0 0 1 /end COMPU_METHOD
/begin CHARACTERISTIC T2trim_nom_maLP "Trim Vdot comp mdot air X-axis LPG" VAL_BLK 0x00140C42 /* @ECU_Address@T2trim_nom_maLP@0x02108000@ */ ECIPP_ALIGNMENT_SWORD 8192 Compu_T2trim_nom_maLP -8192 8191.75 MATRIX_DIM 14 1 1 /end CHARACTERISTIC
/begin COMPU_METHOD Compu_T2trim_nom_maLP " " RAT_FUNC "%.0" "mg/Ld" COEFFS 0 4 0 0 0 1 /end COMPU_METHOD
/begin COMPU_METHOD Compu_TICam_CAD_rpm " " RAT_FUNC "%.0" "Speed (rpm)" COEFFS 0 1 0 0 0 1 /end COMPU_METHOD
/begin COMPU_METHOD Compu_TICam_CAD_MAP " " RAT_FUNC "%.1" "MAP (psia)" COEFFS 0 256 0 0 0 1 /end COMPU_METHOD
/begin CHARACTERISTIC TICam_CAD_CAD "Intake Valve Timing" MAP 0x00144EBE /* @ECU_Address@TICam_CAD_CAD@0x02110000@ */ ECIPP_ALIGNMENT_SWORD 2048 Compu_TICam_CAD_CAD -2048 2047.9375
 /begin AXIS_DESCR COM_AXIS NO_INPUT_QUANTITY Compu_TICam_CAD_MAP 8 -128 127.99609375 AXIS_PTS_REF TICam_CAD_MAP /end AXIS_DESCR
 /begin AXIS_DESCR COM_AXIS NO_INPUT_QUANTITY Compu_TICam_CAD_rpm 8 -32768 32767 AXIS_PTS_REF TICam_CAD_rpm /end AXIS_DESCR
/end CHARACTERISTIC
/begin AXIS_PTS TICam_CAD_MAP " " 0x00144F3E /* @ECU_Address@TICam_CAD_MAP@0x0210F000@ */ NO_INPUT_QUANTITY ECIPP_Lookup_SWORD 0 Compu_TICam_CAD_MAP 8 -128 127.99609375 /end AXIS_PTS
/begin AXIS_PTS TICam_CAD_rpm " " 0x00144F4E /* @ECU_Address@TICam_CAD_rpm@0x0210E000@ */ NO_INPUT_QUANTITY ECIPP_Lookup_SWORD 0 Compu_TICam_CAD_rpm 8 -32768 32767 /end AXIS_PTS
/begin COMPU_METHOD Compu_TICam_CAD_CAD "" RAT_FUNC "%.1" "Open CAD BTDC" COEFFS 0 16 0 0 0 1 /end COMPU_METHOD
/begin COMPU_METHOD Compu_TECam_CAD_rpm " " RAT_FUNC "%.0" "Speed (rpm)" COEFFS 0 1 0 0 0 1 /end COMPU_METHOD
/begin COMPU_METHOD Compu_TECam_CAD_MAP " " RAT_FUNC "%.1" "MAP (psia)" COEFFS 0 256 0 0 0 1 /end COMPU_METHOD
/begin CHARACTERISTIC TECam_CAD_CAD "Exhaust Valve Timing" MAP 0x001447EA /* @ECU_Address@TECam_CAD_CAD@0x02113000@ */ ECIPP_ALIGNMENT_SWORD 2048 Compu_TECam_CAD_CAD -2048 2047.9375
 /begin AXIS_DESCR COM_AXIS NO_INPUT_QUANTITY Compu_TECam_CAD_MAP 8 -128 127.99609375 AXIS_PTS_REF TECam_CAD_MAP /end AXIS_DESCR
 /begin AXIS_DESCR COM_AXIS NO_INPUT_QUANTITY Compu_TECam_CAD_rpm 8 -32768 32767 AXIS_PTS_REF TECam_CAD_rpm /end AXIS_DESCR
/end CHARACTERISTIC
/begin AXIS_PTS TECam_CAD_MAP " " 0x0014486A /* @ECU_Address@TECam_CAD_MAP@0x02112000@ */ NO_INPUT_QUANTITY ECIPP_Lookup_SWORD 0 Compu_TECam_CAD_MAP 8 -128 127.99609375 /end AXIS_PTS
/begin AXIS_PTS TECam_CAD_rpm " " 0x0014487A /* @ECU_Address@TECam_CAD_rpm@0x02111000@ */ NO_INPUT_QUANTITY ECIPP_Lookup_SWORD 0 Compu_TECam_CAD_rpm 8 -32768 32767 /end AXIS_PTS
/begin COMPU_METHOD Compu_TECam_CAD_CAD "" RAT_FUNC "%.1" "Close CAD BTDC" COEFFS 0 16 0 0 0 1 /end COMPU_METHOD
/begin COMPU_METHOD Compu_TTVf_BMDC_DCP " " RAT_FUNC "%.1" "Duty-Cycle (%)" COEFFS 0 163.84 0 0 0 1 /end COMPU_METHOD
/begin CHARACTERISTIC TTVf_BMDC_BMP "LPG PWM Trim Sensitivity" MAP 0x001413AA /* @ECU_Address@TTVf_BMDC_BMP@0x02116000@ */ ECIPP_ALIGNMENT_SWORD 200 Compu_TTVf_BMDC_BMP -200 199.993896484375
 /begin AXIS_DESCR COM_AXIS NO_INPUT_QUANTITY Compu_TTVf_BMDC_DCP 4 0 399.993896484375 AXIS_PTS_REF TTVf_BMDC_DCP /end AXIS_DESCR
 /begin AXIS_DESCR COM_AXIS NO_INPUT_QUANTITY Compu_Ttrim_mdotaP 8 -1024 1023.96875 AXIS_PTS_REF Ttrim_mdotaP /end AXIS_DESCR
/end CHARACTERISTIC
/begin AXIS_PTS TTVf_BMDC_DCP " " 0x001418B2 /* @ECU_Address@TTVf_BMDC_DCP@0x02114000@ */ NO_INPUT_QUANTITY ECIPP_Lookup_UWORD 0 Compu_TTVf_BMDC_DCP 4 0 399.993896484375 /end AXIS_PTS
/begin COMPU_METHOD Compu_TTVf_BMDC_BMP "" RAT_FUNC "%.1" "Delta-phi from 50% DC (%)" COEFFS 0 163.84 0 0 0 1 /end COMPU_METHOD
/begin CHARACTERISTIC TCTM_tau "CBT Gasoline Tau" CURVE 0x001444DA /* @ECU_Address@TCTM_tau@0x0211D000@ */ ECIPP_ALIGNMENT_SWORD 524 Compu_TCTM_tau -524.288 524.272
 /begin AXIS_DESCR COM_AXIS NO_INPUT_QUANTITY Compu_TCTM_mdot_a 8 -512 511.984375 AXIS_PTS_REF TCTM_mdot_a /end AXIS_DESCR
/end CHARACTERISTIC
/begin COMPU_METHOD Compu_TCTM_tau " " RAT_FUNC "%.1" "Tau (sec)" COEFFS 0 62.5 0 0 0 1 /end COMPU_METHOD
/begin CHARACTERISTIC TCTM_dppredT "CBT Gasoline pre-cat dphi/dT" CURVE 0x001444BA /* @ECU_Address@TCTM_dppredT@0x0211E000@ */ ECIPP_ALIGNMENT_SWORD 0 Compu_TCTM_dppredT -0.09765625 9.76532697677612E-02
 /begin AXIS_DESCR COM_AXIS NO_INPUT_QUANTITY Compu_TCTM_mdot_a 8 -512 511.984375 AXIS_PTS_REF TCTM_mdot_a /end AXIS_DESCR
/end CHARACTERISTIC
/begin COMPU_METHOD Compu_TCTM_dppredT " " RAT_FUNC "%.4" "dphi/100 F" COEFFS 0 335544.32 0 0 0 1 /end COMPU_METHOD
/begin CHARACTERISTIC TCTMA_tau "CBT Gaseous Tau" CURVE 0x0014449A /* @ECU_Address@TCTMA_tau@0x0211F000@ */ ECIPP_ALIGNMENT_SWORD 524 Compu_TCTMA_tau -524.288 524.272
 /begin AXIS_DESCR COM_AXIS NO_INPUT_QUANTITY Compu_TCTMA_mdot_a 8 -512 511.984375 AXIS_PTS_REF TCTMA_mdot_a /end AXIS_DESCR
/end CHARACTERISTIC
/begin COMPU_METHOD Compu_TCTMA_tau " " RAT_FUNC "%.1" "Tau (sec)" COEFFS 0 62.5 0 0 0 1 /end COMPU_METHOD
/begin CHARACTERISTIC TCTMA_dppredT "CBT Gaseous pre-cat dphi/dT" CURVE 0x0014447A /* @ECU_Address@TCTMA_dppredT@0x02120000@ */ ECIPP_ALIGNMENT_SWORD 0 Compu_TCTMA_dppredT -0.09765625 9.76532697677612E-02
 /begin AXIS_DESCR COM_AXIS NO_INPUT_QUANTITY Compu_TCTMA_mdot_a 8 -512 511.984375 AXIS_PTS_REF TCTMA_mdot_a /end AXIS_DESCR
/end CHARACTERISTIC
/begin COMPU_METHOD Compu_TCTMA_dppredT " " RAT_FUNC "%.4" "dphi/100 F" COEFFS 0 335544.32 0 0 0 1 /end COMPU_METHOD
/begin COMPU_METHOD Compu_TMAPrsc_BP " " RAT_FUNC "%.2" "BP (psia)" COEFFS 0 256 0 0 0 1 /end COMPU_METHOD
/begin AXIS_PTS TMAPrsc_BP " " 0x001451B6 /* @ECU_Address@TMAPrsc_BP@0x0212E000@ */ NO_INPUT_QUANTITY ECIPP_Lookup_SWORD 0 Compu_TMAPrsc_BP 4 -128 127.99609375 /end AXIS_PTS
/begin CHARACTERISTIC TMAPrsc_max_trim "Max MAP for BP-MAP trim rescale" CURVE 0x001451C6 /* @ECU_Address@TMAPrsc_max_trim@0x02130000@ */ ECIPP_ALIGNMENT_SWORD 128 Compu_TMAPrsc_max_trim -128 127.99609375
 /begin AXIS_DESCR COM_AXIS NO_INPUT_QUANTITY Compu_TMAPrsc_BP 4 -128 127.99609375 AXIS_PTS_REF TMAPrsc_BP /end AXIS_DESCR
/end CHARACTERISTIC
/begin COMPU_METHOD Compu_TMAPrsc_max_trim " " RAT_FUNC "%.2" "Max MAP (psia)" COEFFS 0 256 0 0 0 1 /end COMPU_METHOD
/begin COMPU_METHOD Compu_TCam_strt_ECT " " RAT_FUNC "%.1" "ECT (deg F)" COEFFS 0 32 14720 0 0 1 /end COMPU_METHOD
/begin CHARACTERISTIC TCam_strt_tex "Cam Engine-Starting Additional Timeout" CURVE 0x00144702 /* @ECU_Address@TCam_strt_tex@0x02262000@ */ ECIPP_ALIGNMENT_SWORD 524 Compu_TCam_strt_tex -524.288 524.272
 /begin AXIS_DESCR COM_AXIS NO_INPUT_QUANTITY Compu_TCam_strt_ECT 4 -1484 563.96875 AXIS_PTS_REF TCam_strt_ECT /end AXIS_DESCR
/end CHARACTERISTIC
/begin AXIS_PTS TCam_strt_ECT " " 0x001446FA /* @ECU_Address@TCam_strt_ECT@0x02261000@ */ NO_INPUT_QUANTITY ECIPP_Lookup_SWORD 0 Compu_TCam_strt_ECT 4 -1484 563.96875 /end AXIS_PTS
/begin COMPU_METHOD Compu_TCam_strt_tex " " RAT_FUNC "%.2" "Additional Timeout (sec)" COEFFS 0 62.5 0 0 0 1 /end COMPU_METHOD
/begin GROUP EC_Cam "ECONTROLS" ROOT
 /begin REF_CHARACTERISTIC ICam_PWM_taud ECam_PWM_taud ICam_timing_ctrl ECam_timing_ctrl ICam_I_min ICam_I_max ECam_I_min ECam_I_max ICam_coil_Inom ECam_coil_Inom ICam_Kp ECam_Kp ICam_Ki ECam_Ki Cam_strt_I Cam_strt_tout Cam_pin_ena Cam_pin_tout Tcambmp_dur Tcambmp_I Tcambmp_keyon Tcambmp_auto Camrat_ena Camrat_pulse_cnt Camrat_hi_time Camrat_lo_time Camrat_hi_start_I Camrat_hi_end_I Camrat_lo_I Camini_slew_tout ECam_control_cal TICam_CAD_CAD TECam_CAD_CAD TCam_strt_tex /end REF_CHARACTERISTIC
 /begin REF_MEASUREMENT spk_adv Phi_cmd ICam_timing_a ECam_timing_a spk_off_global Phi_global_offset ICam_samp_BTDC ECam_samp_BTDC ICam_timing_d ECam_timing_d ICam_control ICam_PWM_DC ECam_control ECam_PWM_DC ICam_PWM_mode ECam_PWM_mode ICam_I_acc ICam_coil_Id ICam_coil_R ECam_I_acc ECam_coil_Id ECam_coil_R Cam_strt_textra IC_pin_pulse_try EC_pin_pulse_try IC_pin_pulse_arm EC_pin_pulse_arm IC_pin_pulse_state EC_pin_pulse_state /end REF_MEASUREMENT
/end GROUP
/begin GROUP EC_Catalyst "ECONTROLS" ROOT
 /begin REF_CHARACTERISTIC CTM_enr CTM_adv CTM_tau CTM_init CTM_finish CTM_ena CTMA_enr CTMA_adv CTMA_tau CTMA_init CTMA_finish CTM_CL_ena CTM_CL_space CTM_CL_ramp CTM_CL_UL CTMA_CL_ena CTMA_CL_space CTMA_CL_ramp CTMA_CL_UL CTM_phi_lim CTMA_phi_lim CTM_CL_tgEGO CTM_CL_tgphi CTM_CL_forcewt CTMA_CL_tgEGO CTMA_CL_tgphi CTMA_CL_forcewt CL_CM_min_RMS CLLP_CM_min_RMS CLNG_CM_min_RMS CL_CM_waveRMSatt CLLP_CM_waveRMSatt CLNG_CM_waveRMSatt CL_CM_preRMSatt CLLP_CM_preRMSatt CLNG_CM_preRMSatt CTM_tau_source CTMA_tau_source CATdP_ena EBP_ena EBP_tau CATdP_P_select CATdP_tau CAT1_ena CAT2_ena CTM_FSO_mode CTM_FSO_CBT CTM_FSO_tau CTMA_FSO_mode CTMA_FSO_CBT CTMA_FSO_tau TWCmod_OSC TWCmod_aL TWCmod_aR TWCmod_cL TWCmod_cR TWCdiag_mdot_min TWCdiag_ECT_min TWCdiag_CBT_min TWCdiag_phi_d TWCdiag_phi_pst_thld TWCdiag_phi_pst_lean TWCdiag_tlean_min TWCdiag_tmon_max TWCdiag_max_events TWCdiag_K_norm TWCdiag_ena TWCdiag_cat_temp TWCdiag_OSC_min TWCdiag_OSC_max CBT_taustopped TWCdiag_phi_d_app TWCdiag_pst_rich_rst TWCmod_OSC_error_Kp TWCdiag_OSC_marg TCTM_Temp TCTMA_Temp TCTM_tau TCTM_dppredT TCTMA_tau TCTMA_dppredT /end REF_CHARACTERISTIC
 /begin REF_MEASUREMENT spk_adv Phi_cmd mdot_a_ports mdot_f_ports CL_BM1 A_BM1 CL_BM2 A_BM2 spk_off_global CBT CTM_enrich_mod CTM_advance_mod Phi_global_offset EBP_gauge CTM_CL_BM CLp_wave_RMS CM1_RMScomp EGO1_phiFB_RMS EGO2_phiFB_RMS EGO3_phiFB_RMS CM1_RMSsrc EGO4_phiFB_RMS CM2_RMSsrc CL2_wave_RMS CM2_RMScomp CBT_ss CBT_tauactv CTM_dppredT CTM_dppre CATdP EBP_raw CATdP_raw EBP_acc CB1pre_name CB1pst_name CB2pre_name CB2pst_name CB1pre_phiFB_RMS CB1pst_phiFB_RMS CB2pre_phiFB_RMS CB2pst_phiFB_RMS CAT_Tin CAT_Tout TWCmod_ROL TWCmod_rho TWCmod_dROLdt TWCmod_phi_post TWCdiag_state TWCdiag_monitor_ms TWCdiag_event_cntr TWCdiag_OSC_est TWCmod_ROL_avg TWCdiag_OSC_est_avg TWCmod_ROL_dly /end REF_MEASUREMENT
/end GROUP
/begin GROUP EC_CLCalGsln "ECONTROLS" ROOT
 /begin REF_CHARACTERISTIC CLp_Emin CLp_Emax CLp_Rp_def CLp_Rn_def CLp_rich_DC CLp_lean_DC MAPdt_CLoff K_adapt Adapt_pos_lim Adapt_neg_lim Adapt_stepmax Adapt_dzone Adapt_valid Adapt_wait K_CL_acquire K_CL CL_BM_max CL_BM_min CL_stepmax CL_dis_Gsln CL_Ki_p_postcat CL_hi_postcat CL_lo_postcat CL_postcat_ena CL_Ki_n_postcat CL_Kp_p_postcat CL_Kp_n_postcat CL_Kiv_p_postcat CL_Kiv_n_postcat CL_phidt_hi_postcat CL_phidt_lo_postcat EGO1delay CL_temp_wait_mul AL_temp_wait_mul FAstoich_s_G FAstoich_a_G SGf SGfs CL_HW_dis_cfg CL_TD_enable CL_TD_max_p CL_TD_max_n CL_TD_EGOsw_ena CL_TD_sw_offset CL_TD_sw_pct CL_rst_postcat CL_TD_mdota CL_control_type CLacq_lmt_step CL_switch_type T_delay_plug_flow adapt_store_EE CLp_fastwr_ena CLp_fastwr_MAPdt CLp_fastwr_phierr CLp_fastwr_mincyc CLp_fastwr_rich_err CLp_fastwr_lean_err CLp_fastwr_rich_step CLp_fastwr_lean_step CLp_fastwr_mdot_min TWCctrl_ROL_d_def CL_Kp_p_ROL CL_Kp_n_ROL CL_Ki_p_ROL CL_Ki_n_ROL CL_ROL_win_p CL_ROL_win_n CL_ROL_res_dly CL_SS_dly TWCctrl_CBT_FSO_ena TWCctrl_CBT_min CLp_fastwr_cs_CBT Phi_post_cs_CBT CL_postcat_winpdlt CL_postcat_winndlt CL_ROLend_fastwrtm CL_post_fastwr_tm TCL_ena TCLp_tau_cyc TCL_postcat_phigsln /end REF_CHARACTERISTIC
 /begin REF_MEASUREMENT MAPdt Phi_cmd CL_BM1 A_BM1 Manual_BM BM1_crct CL1_perturb CLInactiveFlag CB1pre_DCa CB1pre_DCd CLp_E CL_temp_wait_tmr CL_BM2 A_BM2 BM2_crct CL2_perturb CB2pre_DCa Phi_UEGO FPin CLp_tau CLp_Hp CLp_Hn CL_ena_value AL_temp_wait_tmr Adapt1_valid_cnt CL_inact_force Adapt2_valid_cnt UEGO_mode FP_crct EGO1_phiFB EGO2_phiFB EGO3_phiFB EGO1_phiFB_avg EGO2_phiFB_avg EGO3_phiFB_avg Phi_post_d Phi1_post_delt Phi_post_act EGO3_phiFB_dphidt trim_SG_FA_x Phi2_post_delt CL2_Hp CL2_Hn CB2pre_DCd CL2_E EGO4_phiFB EGO4_phiFB_avg CL_bank_mode Cat_bank_mode EGO4_phiFB_dphidt Phi1_pre_d Phi2_pre_d CL_HW_disable CL_fuellev_low Phi_UEGO2 UEGO2_mode T_delay_FB CB1pre_name CB1pst_name CB2pre_name CB2pst_name CB1pre_phiFB CB1pst_phiFB CB2pre_phiFB CB2pst_phiFB CB1pre_phiFB_avg CB1pst_phiFB_avg CB2pre_phiFB_avg CB2pst_phiFB_avg CB1pst_phiFB_dphidt CB2pst_phiFB_dphidt UEGO3_mode Phi_UEGO3 UEGO4_mode Phi_UEGO4 CLp_fastwr_status CL1_phi_error CL2_phi_error TWCctrl_ROL_e TWCctrl_ROL_d CL1_post_SS_status CL1_post_phi_ROL CL1_CBT_hot CL1_FSO_occurred CLp_fastwr_cs_state Phi_post_cs_state CL1_ROL_win_p_th CL1_ROL_win_n_th CL1_postcat_hi_th CL1_postcat_lo_th /end REF_MEASUREMENT
/end GROUP
/begin GROUP EC_CLCalLP "ECONTROLS" ROOT
 /begin REF_CHARACTERISTIC CLp_rich_DC CLp_lean_DC TRIM_trig_chg TRIM_period_def MAPdt_CLoff TRIM_dis_hold mda_trans_tau TRIM_trans_dis trim_nom_crkP CLLP_hi CLLP_lo CLLP_K CLLP_K_acquire CLLP_stepmax CLpLP_Emax CLpLP_Emin CLpLP_Rp_def CLpLP_Rn_def ALLP_hi ALLP_lo ALLP_K ALLP_stepmax ALLP_dzone ALLP_valid ALLP_wait CL_dis_LP trim_LP_min trim_LP_max CLLP_lo_postcat CLLP_hi_postcat CLLP_Ki_p_postcat CLLP_postcat_ena CLLP_Ki_n_postcat CLLP_Kp_p_postcat CLLP_Kp_n_postcat CLLP_Kiv_p_postcat CLLP_Kiv_n_postcat CLP_phidt_hi_postcat CLP_phidt_lo_postcat MJ_nom_crkP MJ_P_minP MJ_P_maxP MJ_Pin_P FT_def FAstoich_s_P FAstoich_a_P SGf_LP SGfs_LP trim_load_src trim_TIP_Vdot_comp CL_HW_dis_cfg trim_tran_forceP trim_ntran_forceP CLLP_TD_enable CLLP_TD_max_p CLLP_TD_max_n CLLP_TD_EGOsw_ena CLLP_TD_sw_offset CLLP_TD_sw_pct MAPrsc_min_trim CLLP_rst_postcat CLLP_TD_mdota CL_control_type MJ_nom_crkslwdP MJ_crk_holdP MJ_crk_slewP MJ_crk_run_slewP CLacq_lmt_step CL_switch_type T_delay_plug_flow MJ_man_mode_rpm MJ_man_mode_map adapt_store_EE CLp_fastwr_ena CLp_fastwr_MAPdt CLp_fastwr_phierr CLp_fastwr_mincyc CLp_fastwr_rich_err CLp_fastwr_lean_err CLp_fastwr_rich_step CLp_fastwr_lean_step CLp_fastwr_mdot_min TWCctrl_ROL_d_def CLLP_Kp_p_ROL CLLP_Kp_n_ROL CLLP_Ki_p_ROL CLLP_Ki_n_ROL CLLP_ROL_win_p CLLP_ROL_win_n CLLP_ROL_res_dly CLLP_SS_dly TWCctrl_CBT_FSO_ena TWCctrl_CBT_min CLp_fastwr_cs_CBT Phi_post_cs_CBT CLLP_postcat_winpdlt CLLP_postcat_winndlt CLLP_ROLend_fastwrtm CLLP_post_fastwr_tm TCLp_tau_cycP TCL_enaP Tvent_PP T2trim_nom_DCP T2MJ_nom_PP T2trim_nom_phiP T2trim_nom_maLP TTVf_BMDC_BMP TMAPrsc_max_trim /end REF_CHARACTERISTIC
 /begin REF_MEASUREMENT MAPdt Phi_cmd CL_BM1 A_BM1 Manual_BM BM1_crct CL1_perturb CLInactiveFlag CB1pre_DCa CB1pre_DCd CLp_E mdot_a_trans mdot_a_trans_pct TRIM_DC CL_temp_wait_tmr CB2pre_DCa Phi_UEGO MJ_P_act MJ_P_cmd MJ_A_act MJ_A_cmd CLp_tau CLp_Hp CLp_Hn CL_ena_value AL_temp_wait_tmr Adapt1_valid_cnt TRIM_mode CL_inact_force UEGO_mode TRIM_nom_DC TRIM_nom_phi TRIM_sens Phi_post_d Phi1_post_delt Phi_post_act MJ_P_nom Vent_P_sig Vent_dP_nom MJ_man_mode MJ_ctltype_cmd MJ_ctltype_act MJ_status FT mdot_a_equcarb trim_SG_FA_x CB2pre_DCd MJ_VVC_Tcrct MJ_P_Tnom m_a_perL trim_MAP_Vdc trim_m_a_Vdc Phi_cmd_dly CL_HW_disable CL_fuellev_low TRIM_BM TRIM_min_BM TRIM_max_BM MAPrsc_trim MAPrsc_max_trim Phi_UEGO2 UEGO2_mode T_delay_FB CB1pre_name CB1pst_name CB2pre_name CB1pre_phiFB CB1pst_phiFB CB2pre_phiFB CB1pre_phiFB_avg CB1pst_phiFB_avg CB2pre_phiFB_avg CB1pst_phiFB_dphidt UEGO3_mode Phi_UEGO3 UEGO4_mode Phi_UEGO4 CLp_fastwr_status CL1_phi_error TWCctrl_ROL_e TWCctrl_ROL_d CL1_post_SS_status CL1_post_phi_ROL CL1_CBT_hot CL1_FSO_occurred CLp_fastwr_cs_state Phi_post_cs_state CL1_ROL_win_p_th CL1_ROL_win_n_th CL1_postcat_hi_th CL1_postcat_lo_th /end REF_MEASUREMENT
/end GROUP
/begin GROUP EC_CLCalNG "ECONTROLS" ROOT
 /begin REF_CHARACTERISTIC CLp_rich_DC CLp_lean_DC TRIM_trig_chg TRIM_period_def MAPdt_CLoff TRIM_dis_hold mda_trans_tau TRIM_trans_dis FT_def trim_load_src trim_TIP_Vdot_comp CL_HW_dis_cfg CL_control_type CLacq_lmt_step CL_switch_type T_delay_plug_flow MJ_man_mode_rpm MJ_man_mode_map adapt_store_EE CLp_fastwr_ena CLp_fastwr_MAPdt CLp_fastwr_phierr CLp_fastwr_mincyc CLp_fastwr_rich_err CLp_fastwr_lean_err CLp_fastwr_rich_step CLp_fastwr_lean_step CLp_fastwr_mdot_min TWCctrl_ROL_d_def TWCctrl_CBT_FSO_ena TWCctrl_CBT_min CLp_fastwr_cs_CBT Phi_post_cs_CBT /end REF_CHARACTERISTIC
 /begin REF_MEASUREMENT MAPdt Phi_cmd CL_BM1 A_BM1 Manual_BM BM1_crct CL1_perturb CLInactiveFlag CB1pre_DCa CB1pre_DCd CLp_E mdot_a_trans mdot_a_trans_pct TRIM_DC CL_temp_wait_tmr CB2pre_DCa Phi_UEGO MJ_P_act MJ_P_cmd MJ_A_act MJ_A_cmd CLp_tau CLp_Hp CLp_Hn CL_ena_value AL_temp_wait_tmr Adapt1_valid_cnt TRIM_mode CL_inact_force UEGO_mode TRIM_nom_DC TRIM_nom_phi TRIM_sens Phi_post_d Phi1_post_delt Phi_post_act MJ_P_nom Vent_P_sig Vent_dP_nom MJ_man_mode MJ_ctltype_cmd MJ_ctltype_act MJ_status FT mdot_a_equcarb trim_SG_FA_x CB2pre_DCd MJ_VVC_Tcrct MJ_P_Tnom m_a_perL trim_MAP_Vdc trim_m_a_Vdc Phi_cmd_dly CL_HW_disable CL_fuellev_low TRIM_BM TRIM_min_BM TRIM_max_BM MAPrsc_trim Phi_UEGO2 UEGO2_mode T_delay_FB CB1pre_name CB1pst_name CB2pre_name CB1pre_phiFB CB1pst_phiFB CB2pre_phiFB CB1pre_phiFB_avg CB1pst_phiFB_avg CB2pre_phiFB_avg CB1pst_phiFB_dphidt UEGO3_mode Phi_UEGO3 UEGO4_mode Phi_UEGO4 CLp_fastwr_status CL1_phi_error TWCctrl_ROL_e TWCctrl_ROL_d CL1_post_SS_status CL1_post_phi_ROL CL1_CBT_hot CL1_FSO_occurred CLp_fastwr_cs_state Phi_post_cs_state CL1_ROL_win_p_th CL1_ROL_win_n_th CL1_postcat_hi_th CL1_postcat_lo_th /end REF_MEASUREMENT
/end GROUP
/begin GROUP EC_ConfigApp "ECONTROLS" ROOT /begin REF_MEASUREMENT mdot_f_ports CL_fuellev_low /end REF_MEASUREMENT /end GROUP
/begin GROUP EC_EGOConfig "ECONTROLS" ROOT
 /begin REF_MEASUREMENT Phi_UEGO UEGO_mode Phi_UEGO2 UEGO2_mode CB1pre_name CB1pst_name CB2pre_name CB2pst_name UEGO3_mode Phi_UEGO3 UEGO4_mode Phi_UEGO4 /end REF_MEASUREMENT
/end GROUP
/begin GROUP EC_EGRCommand "ECONTROLS" ROOT /begin REF_MEASUREMENT spk_adv spk_off_global /end REF_MEASUREMENT /end GROUP
/begin GROUP EC_EGRControl "ECONTROLS" ROOT /begin REF_MEASUREMENT spk_adv spk_off_global /end REF_MEASUREMENT /end GROUP
/begin GROUP EC_Faults "ECONTROLS" ROOT
 /begin REF_MEASUREMENT spk_adv CL_BM1 A_BM1 TRIM_DC CL_BM2 A_BM2 FPin MJ_P_act MJ_P_cmd Phi1_post_delt FT /end REF_MEASUREMENT
/end GROUP
/begin GROUP EC_FilterCal "ECONTROLS" ROOT /begin REF_MEASUREMENT MAPdt /end REF_MEASUREMENT /end GROUP
/begin GROUP EC_Fuel "ECONTROLS" ROOT /begin REF_MEASUREMENT mdot_f_ports FPin CL_ena_value Phi_post_d Phi_post_act /end REF_MEASUREMENT /end GROUP
/begin GROUP EC_FuelSecond "ECONTROLS" ROOT /begin REF_MEASUREMENT mdot_f_ports /end REF_MEASUREMENT /end GROUP
/begin GROUP EC_GovCal "ECONTROLS" ROOT /begin REF_MEASUREMENT spk_adv /end REF_MEASUREMENT /end GROUP
/begin GROUP EC_GovCalAlt "ECONTROLS" ROOT /begin REF_MEASUREMENT spk_adv /end REF_MEASUREMENT /end GROUP
/begin GROUP EC_HDService "ECONTROLS" ROOT /begin REF_CHARACTERISTIC TWCmod_OSC /end REF_CHARACTERISTIC
 /begin REF_MEASUREMENT spk_adv Phi_cmd Phi_UEGO MJ_P_act MJ_P_cmd UEGO_mode FT Phi_UEGO2 Phi_UEGO3 Phi_UEGO4 /end REF_MEASUREMENT
/end GROUP
/begin GROUP EC_Knock "ECONTROLS" ROOT /begin REF_MEASUREMENT spk_adv spk_off_global CTM_advance_mod /end REF_MEASUREMENT /end GROUP
/begin GROUP EC_LDService "ECONTROLS" ROOT
 /begin REF_MEASUREMENT spk_adv CL_BM1 A_BM1 FPin MJ_P_act MJ_P_cmd MJ_A_act MJ_ctltype_cmd MJ_ctltype_act MJ_status /end REF_MEASUREMENT
/end GROUP
/begin GROUP EC_Marine "ECONTROLS" ROOT /begin REF_MEASUREMENT spk_adv /end REF_MEASUREMENT /end GROUP
/begin GROUP EC_Megajector "ECONTROLS" ROOT /begin REF_CHARACTERISTIC FT_def trim_TIP_Vdot_comp MJ_man_mode_rpm MJ_man_mode_map /end REF_CHARACTERISTIC
 /begin REF_MEASUREMENT MJ_P_act MJ_P_cmd MJ_A_act MJ_A_cmd MJ_P_nom MJ_man_mode MJ_ctltype_cmd MJ_ctltype_act MJ_status FT MJ_VVC_Tcrct MJ_P_Tnom trim_MAP_Vdc trim_m_a_Vdc /end REF_MEASUREMENT
/end GROUP
/begin GROUP EC_Misfire "ECONTROLS" ROOT /begin REF_MEASUREMENT MAPdt m_a_perL /end REF_MEASUREMENT /end GROUP
/begin GROUP EC_PhiGsln "ECONTROLS" ROOT
 /begin REF_MEASUREMENT spk_adv Phi_cmd CL_BM1 A_BM1 Manual_BM CL_BM2 A_BM2 Phi_UEGO FPin spk_off_global CTM_enrich_mod Phi_global_offset FP_crct Phi_UEGO2 Phi_UEGO3 Phi_UEGO4 /end REF_MEASUREMENT
/end GROUP
/begin GROUP EC_PhiLP "ECONTROLS" ROOT
 /begin REF_CHARACTERISTIC CLp_rich_DC CLp_lean_DC CLpLP_Emax CLpLP_Emin CLpLP_Rp_def CLpLP_Rn_def CL_dis_LP /end REF_CHARACTERISTIC
 /begin REF_MEASUREMENT Phi_cmd CL_BM1 A_BM1 Manual_BM BM1_crct CL1_perturb CLInactiveFlag CB1pre_DCa CB1pre_DCd CLp_E CB2pre_DCa Phi_UEGO CLp_Hp CLp_Hn CL_ena_value CL_inact_force Phi1_post_delt CB2pre_DCd Phi_UEGO2 Phi_UEGO3 Phi_UEGO4 /end REF_MEASUREMENT
/end GROUP
/begin GROUP EC_PhiNG "ECONTROLS" ROOT /begin REF_CHARACTERISTIC CLp_rich_DC CLp_lean_DC /end REF_CHARACTERISTIC
 /begin REF_MEASUREMENT Phi_cmd CL_BM1 A_BM1 Manual_BM BM1_crct CL1_perturb CLInactiveFlag CB1pre_DCa CB1pre_DCd CLp_E CB2pre_DCa Phi_UEGO CLp_Hp CLp_Hn CL_ena_value Phi_global_offset CL_inact_force Phi1_post_delt CB2pre_DCd Phi_UEGO2 Phi_UEGO3 Phi_UEGO4 /end REF_MEASUREMENT
/end GROUP
/begin GROUP EC_PowerMon "ECONTROLS" ROOT /begin REF_MEASUREMENT spk_adv Phi_cmd /end REF_MEASUREMENT /end GROUP
/begin GROUP EC_Service1 "ECONTROLS" ROOT /begin REF_MEASUREMENT spk_adv CL_inact_force /end REF_MEASUREMENT /end GROUP
/begin GROUP EC_Service2 "ECONTROLS" ROOT /begin REF_MEASUREMENT spk_adv CL_BM1 A_BM1 /end REF_MEASUREMENT /end GROUP
/begin GROUP EC_Simulink "ECONTROLS" ROOT /begin REF_MEASUREMENT spk_adv /end REF_MEASUREMENT /end GROUP
/begin GROUP EC_SparkCal "ECONTROLS" ROOT /begin REF_MEASUREMENT spk_adv spk_off_global CTM_advance_mod /end REF_MEASUREMENT /end GROUP
/begin GROUP EC_SparkCalLP "ECONTROLS" ROOT /begin REF_MEASUREMENT spk_adv spk_off_global CTM_advance_mod /end REF_MEASUREMENT /end GROUP
/begin GROUP EC_SparkCalNG "ECONTROLS" ROOT /begin REF_MEASUREMENT spk_adv spk_off_global CTM_advance_mod /end REF_MEASUREMENT /end GROUP
/begin GROUP EC_SparkOfst "ECONTROLS" ROOT /begin REF_MEASUREMENT spk_adv spk_off_global CTM_advance_mod /end REF_MEASUREMENT /end GROUP
/begin GROUP EC_Starting "ECONTROLS" ROOT /begin REF_MEASUREMENT spk_adv /end REF_MEASUREMENT /end GROUP
/begin GROUP EC_Tests "ECONTROLS" ROOT /begin REF_CHARACTERISTIC Tcambmp_dur Tcambmp_I MJ_man_mode_rpm MJ_man_mode_map /end REF_CHARACTERISTIC
 /begin REF_MEASUREMENT spk_adv CL_BM1 MJ_P_act MJ_P_cmd MJ_A_act MJ_A_cmd UEGO_mode MJ_man_mode MJ_ctltype_cmd MJ_ctltype_act MJ_status UEGO2_mode UEGO3_mode UEGO4_mode /end REF_MEASUREMENT
/end GROUP
/begin GROUP EC_TranCal "ECONTROLS" ROOT
 /begin REF_MEASUREMENT spk_adv mdot_f_ports Phi_cmd_dly CB1pre_name CB1pst_name CB2pre_name CB2pst_name /end REF_MEASUREMENT
/end GROUP
/begin GROUP EC_VECal "ECONTROLS" ROOT
 /begin REF_MEASUREMENT spk_adv Phi_cmd mdot_a_ports mdot_f_ports CL_BM1 A_BM1 Manual_BM CL_BM2 A_BM2 Phi_UEGO FPin spk_off_global Phi_global_offset FP_crct EBP_gauge FT m_a_perL Phi_UEGO2 CB1pre_name CB1pst_name CB2pre_name CB2pst_name Phi_UEGO3 Phi_UEGO4 /end REF_MEASUREMENT
/end GROUP
/end MODULE
/end PROJECT
