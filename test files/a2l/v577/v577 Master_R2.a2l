ASAP2_VERSION 1 61
/begin PROJECT Econtrols_4G "4G Test"
/begin HEADER "4G A2L Configuration" PROJECT_NO EControls4G /* config for version control */ VERSION "$Revision: 82130 $:" /* config for version control */ /end HEADER
/begin MODULE EControls_4G_SH2A "EControls 4G"
/begin MOD_COMMON "" DEPOSIT ABSOLUTE BYTE_ORDER MSB_FIRST /end MOD_COMMON
/* Define the Record Layouts */
/begin RECORD_LAYOUT ECIPP_ALIGNMENT_UBYTE FNC_VALUES 1 UBYTE COLUMN_DIR DIRECT /end RECORD_LAYOUT
/begin RECORD_LAYOUT ECIPP_ALIGNMENT_UWORD FNC_VALUES 1 UWORD COLUMN_DIR DIRECT /end RECORD_LAYOUT
/begin RECORD_LAYOUT ECIPP_ALIGNMENT_ULONG FNC_VALUES 1 ULONG COLUMN_DIR DIRECT /end RECORD_LAYOUT
/begin RECORD_LAYOUT ECIPP_ALIGNMENT_FLOAT32_IEEE FNC_VALUES 1 FLOAT32_IEEE COLUMN_DIR DIRECT /end RECORD_LAYOUT
/begin COMPU_METHOD Compu_IDENTITY "Discrete Values " /* Identifier */ IDENTICAL "%.0" /* Format */ "-" /* Units */ /end COMPU_METHOD
/begin CHARACTERISTIC FCdc4_PWM21_on_hiVf "FCtl_DTC_0x04(456)" VALUE 0x00163F60 /* @ECU_Address@FCtl_DTC_0x04@0x024C4390@ */ ECIPP_ALIGNMENT_UWORD 65535 Compu_IDENTITY 0 65535 PHYS_UNIT "System ID + DTC" /end CHARACTERISTIC
/begin CHARACTERISTIC FCdc4_PWM22_off_loVf "FCtl_DTC_0x04(457)" VALUE 0x00163F62 /* @ECU_Address@FCtl_DTC_0x04@0x024C4392@ */ ECIPP_ALIGNMENT_UWORD 65535 Compu_IDENTITY 0 65535 PHYS_UNIT "System ID + DTC" /end CHARACTERISTIC
/begin CHARACTERISTIC FCdc4_PWM22_on_hiVf "FCtl_DTC_0x04(458)" VALUE 0x00163F64 /* @ECU_Address@FCtl_DTC_0x04@0x024C4394@ */ ECIPP_ALIGNMENT_UWORD 65535 Compu_IDENTITY 0 65535 PHYS_UNIT "System ID + DTC" /end CHARACTERISTIC
/begin CHARACTERISTIC FCdc4_PWM23_off_loVf "FCtl_DTC_0x04(459)" VALUE 0x00163F66 /* @ECU_Address@FCtl_DTC_0x04@0x024C4396@ */ ECIPP_ALIGNMENT_UWORD 65535 Compu_IDENTITY 0 65535 PHYS_UNIT "System ID + DTC" /end CHARACTERISTIC
/begin CHARACTERISTIC FCdc4_PWM23_on_hiVf "FCtl_DTC_0x04(460)" VALUE 0x00163F68 /* @ECU_Address@FCtl_DTC_0x04@0x024C4398@ */ ECIPP_ALIGNMENT_UWORD 65535 Compu_IDENTITY 0 65535 PHYS_UNIT "System ID + DTC" /end CHARACTERISTIC
/begin CHARACTERISTIC FCdc4_PWM3_off_loVf "FCtl_DTC_0x04(193)" VALUE 0x00163D52 /* @ECU_Address@FCtl_DTC_0x04@0x024C4182@ */ ECIPP_ALIGNMENT_UWORD 65535 Compu_IDENTITY 0 65535 PHYS_UNIT "System ID + DTC" /end CHARACTERISTIC
/begin CHARACTERISTIC FCdc4_PWM3_on_hiVf "FCtl_DTC_0x04(194)" VALUE 0x00163D54 /* @ECU_Address@FCtl_DTC_0x04@0x024C4184@ */ ECIPP_ALIGNMENT_UWORD 65535 Compu_IDENTITY 0 65535 PHYS_UNIT "System ID + DTC" /end CHARACTERISTIC
/begin CHARACTERISTIC FCdc4_PWM4_off_loVf "FCtl_DTC_0x04(195)" VALUE 0x00163D56 /* @ECU_Address@FCtl_DTC_0x04@0x024C4186@ */ ECIPP_ALIGNMENT_UWORD 65535 Compu_IDENTITY 0 65535 PHYS_UNIT "System ID + DTC" /end CHARACTERISTIC
/begin CHARACTERISTIC FCdc4_PWM4_on_hiVf "FCtl_DTC_0x04(196)" VALUE 0x00163D58 /* @ECU_Address@FCtl_DTC_0x04@0x024C4188@ */ ECIPP_ALIGNMENT_UWORD 65535 Compu_IDENTITY 0 65535 PHYS_UNIT "System ID + DTC" /end CHARACTERISTIC
/begin CHARACTERISTIC FCdc4_PWM5_off_loVf "FCtl_DTC_0x04(197)" VALUE 0x00163D5A /* @ECU_Address@FCtl_DTC_0x04@0x024C418A@ */ ECIPP_ALIGNMENT_UWORD 65535 Compu_IDENTITY 0 65535 PHYS_UNIT "System ID + DTC" /end CHARACTERISTIC
/begin CHARACTERISTIC FCdc4_PWM5_on_hiVf "FCtl_DTC_0x04(198)" VALUE 0x00163D5C /* @ECU_Address@FCtl_DTC_0x04@0x024C418C@ */ ECIPP_ALIGNMENT_UWORD 65535 Compu_IDENTITY 0 65535 PHYS_UNIT "System ID + DTC" /end CHARACTERISTIC
/begin CHARACTERISTIC FCdc4_PWM6_off_loVf "FCtl_DTC_0x04(276)" VALUE 0x00163DF8 /* @ECU_Address@FCtl_DTC_0x04@0x024C4228@ */ ECIPP_ALIGNMENT_UWORD 65535 Compu_IDENTITY 0 65535 PHYS_UNIT "System ID + DTC" /end CHARACTERISTIC
/begin CHARACTERISTIC FCdc4_PWM6_on_hiVf "FCtl_DTC_0x04(277)" VALUE 0x00163DFA /* @ECU_Address@FCtl_DTC_0x04@0x024C422A@ */ ECIPP_ALIGNMENT_UWORD 65535 Compu_IDENTITY 0 65535 PHYS_UNIT "System ID + DTC" /end CHARACTERISTIC
/begin CHARACTERISTIC FCdc4_PWM7_off_loVf "FCtl_DTC_0x04(278)" VALUE 0x00163DFC /* @ECU_Address@FCtl_DTC_0x04@0x024C422C@ */ ECIPP_ALIGNMENT_UWORD 65535 Compu_IDENTITY 0 65535 PHYS_UNIT "System ID + DTC" /end CHARACTERISTIC
/begin CHARACTERISTIC FCdc4_PWM7_on_hiVf "FCtl_DTC_0x04(279)" VALUE 0x00163DFE /* @ECU_Address@FCtl_DTC_0x04@0x024C422E@ */ ECIPP_ALIGNMENT_UWORD 65535 Compu_IDENTITY 0 65535 PHYS_UNIT "System ID + DTC" /end CHARACTERISTIC
/begin CHARACTERISTIC FCdc4_PWM8_off_loVf "FCtl_DTC_0x04(283)" VALUE 0x00163E06 /* @ECU_Address@FCtl_DTC_0x04@0x024C4236@ */ ECIPP_ALIGNMENT_UWORD 65535 Compu_IDENTITY 0 65535 PHYS_UNIT "System ID + DTC" /end CHARACTERISTIC
/begin CHARACTERISTIC FCdc4_PWM8_on_hiVf "FCtl_DTC_0x04(284)" VALUE 0x00163E08 /* @ECU_Address@FCtl_DTC_0x04@0x024C4238@ */ ECIPP_ALIGNMENT_UWORD 65535 Compu_IDENTITY 0 65535 PHYS_UNIT "System ID + DTC" /end CHARACTERISTIC
/begin CHARACTERISTIC FCdc4_PWM9_off_loVf "FCtl_DTC_0x04(285)" VALUE 0x00163E0A /* @ECU_Address@FCtl_DTC_0x04@0x024C423A@ */ ECIPP_ALIGNMENT_UWORD 65535 Compu_IDENTITY 0 65535 PHYS_UNIT "System ID + DTC" /end CHARACTERISTIC
/begin CHARACTERISTIC FCdc4_PWM9_on_hiVf "FCtl_DTC_0x04(286)" VALUE 0x00163E0C /* @ECU_Address@FCtl_DTC_0x04@0x024C423C@ */ ECIPP_ALIGNMENT_UWORD 65535 Compu_IDENTITY 0 65535 PHYS_UNIT "System ID + DTC" /end CHARACTERISTIC
/begin CHARACTERISTIC FCdc4_PWMLO_off_loVf "FCtl_DTC_0x04(521)" VALUE 0x00163FE2 /* @ECU_Address@FCtl_DTC_0x04@0x024C4412@ */ ECIPP_ALIGNMENT_UWORD 65535 Compu_IDENTITY 0 65535 PHYS_UNIT "System ID + DTC" /end CHARACTERISTIC
/begin CHARACTERISTIC FCdc4_PWMLO_on_hiVf "FCtl_DTC_0x04(522)" VALUE 0x00163FE4 /* @ECU_Address@FCtl_DTC_0x04@0x024C4414@ */ ECIPP_ALIGNMENT_UWORD 65535 Compu_IDENTITY 0 65535 PHYS_UNIT "System ID + DTC" /end CHARACTERISTIC
/begin CHARACTERISTIC FCdc4_RAM_fail "FCtl_DTC_0x04(106)" VALUE 0x00163CA4 /* @ECU_Address@FCtl_DTC_0x04@0x024C40D4@ */ ECIPP_ALIGNMENT_UWORD 65535 Compu_IDENTITY 0 65535 PHYS_UNIT "System ID + DTC" /end CHARACTERISTIC
/begin CHARACTERISTIC FCdc4_relay_coilopen "FCtl_DTC_0x04(159)" VALUE 0x00163D0E /* @ECU_Address@FCtl_DTC_0x04@0x024C413E@ */ ECIPP_ALIGNMENT_UWORD 65535 Compu_IDENTITY 0 65535 PHYS_UNIT "System ID + DTC" /end CHARACTERISTIC
/begin CHARACTERISTIC FCdc4_relay_coilshort "FCtl_DTC_0x04(160)" VALUE 0x00163D10 /* @ECU_Address@FCtl_DTC_0x04@0x024C4140@ */ ECIPP_ALIGNMENT_UWORD 65535 Compu_IDENTITY 0 65535 PHYS_UNIT "System ID + DTC" /end CHARACTERISTIC
/begin CHARACTERISTIC FCdc4_relay_gndshort "FCtl_DTC_0x04(158)" VALUE 0x00163D0C /* @ECU_Address@FCtl_DTC_0x04@0x024C413C@ */ ECIPP_ALIGNMENT_UWORD 65535 Compu_IDENTITY 0 65535 PHYS_UNIT "System ID + DTC" /end CHARACTERISTIC
/begin CHARACTERISTIC FCdc4_relayoff_hiV "FCtl_DTC_0x04(431)" VALUE 0x00163F2E /* @ECU_Address@FCtl_DTC_0x04@0x024C435E@ */ ECIPP_ALIGNMENT_UWORD 65535 Compu_IDENTITY 0 65535 PHYS_UNIT "System ID + DTC" /end CHARACTERISTIC
/begin CHARACTERISTIC FCdc4_relayon_loV "FCtl_DTC_0x04(432)" VALUE 0x00163F30 /* @ECU_Address@FCtl_DTC_0x04@0x024C4360@ */ ECIPP_ALIGNMENT_UWORD 65535 Compu_IDENTITY 0 65535 PHYS_UNIT "System ID + DTC" /end CHARACTERISTIC
/begin CHARACTERISTIC FCdc4_rpm_hi_expected "FCtl_DTC_0x04(351)" VALUE 0x00163E8E /* @ECU_Address@FCtl_DTC_0x04@0x024C42BE@ */ ECIPP_ALIGNMENT_UWORD 65535 Compu_IDENTITY 0 65535 PHYS_UNIT "System ID + DTC" /end CHARACTERISTIC
/begin CHARACTERISTIC FCdc4_rpmd_gov_lo "FCtl_DTC_0x04(520)" VALUE 0x00163FE0 /* @ECU_Address@FCtl_DTC_0x04@0x024C4410@ */ ECIPP_ALIGNMENT_UWORD 65535 Compu_IDENTITY 0 65535 PHYS_UNIT "System ID + DTC" /end CHARACTERISTIC
/begin CHARACTERISTIC FCdc4_RS_discon "FCtl_DTC_0x04(691)" VALUE 0x00164136 /* @ECU_Address@FCtl_DTC_0x04@0x024C4566@ */ ECIPP_ALIGNMENT_UWORD 65535 Compu_IDENTITY 0 65535 PHYS_UNIT "System ID + DTC" /end CHARACTERISTIC
/begin CHARACTERISTIC FCdc4_RS_hiV "FCtl_DTC_0x04(599)" VALUE 0x0016407E /* @ECU_Address@FCtl_DTC_0x04@0x024C44AE@ */ ECIPP_ALIGNMENT_UWORD 65535 Compu_IDENTITY 0 65535 PHYS_UNIT "System ID + DTC" /end CHARACTERISTIC
/begin CHARACTERISTIC FCdc4_RS_loss "FCtl_DTC_0x04(220)" VALUE 0x00163D88 /* @ECU_Address@FCtl_DTC_0x04@0x024C41B8@ */ ECIPP_ALIGNMENT_UWORD 65535 Compu_IDENTITY 0 65535 PHYS_UNIT "System ID + DTC" /end CHARACTERISTIC
/begin CHARACTERISTIC FCdc4_RS_loV "FCtl_DTC_0x04(598)" VALUE 0x0016407C /* @ECU_Address@FCtl_DTC_0x04@0x024C44AC@ */ ECIPP_ALIGNMENT_UWORD 65535 Compu_IDENTITY 0 65535 PHYS_UNIT "System ID + DTC" /end CHARACTERISTIC
/begin CHARACTERISTIC FCdc4_RS485_bad_fmt "FCtl_DTC_0x04(124)" VALUE 0x00163CC8 /* @ECU_Address@FCtl_DTC_0x04@0x024C40F8@ */ ECIPP_ALIGNMENT_UWORD 65535 Compu_IDENTITY 0 65535 PHYS_UNIT "System ID + DTC" /end CHARACTERISTIC
/begin CHARACTERISTIC FCdc4_RS485_Rx_inact "FCtl_DTC_0x04(122)" VALUE 0x00163CC4 /* @ECU_Address@FCtl_DTC_0x04@0x024C40F4@ */ ECIPP_ALIGNMENT_UWORD 65535 Compu_IDENTITY 0 65535 PHYS_UNIT "System ID + DTC" /end CHARACTERISTIC
/begin CHARACTERISTIC FCdc4_RS485_Rx_noise "FCtl_DTC_0x04(123)" VALUE 0x00163CC6 /* @ECU_Address@FCtl_DTC_0x04@0x024C40F6@ */ ECIPP_ALIGNMENT_UWORD 65535 Compu_IDENTITY 0 65535 PHYS_UNIT "System ID + DTC" /end CHARACTERISTIC
/begin CHARACTERISTIC FCdc4_RS485_SD_rq "FCtl_DTC_0x04(125)" VALUE 0x00163CCA /* @ECU_Address@FCtl_DTC_0x04@0x024C40FA@ */ ECIPP_ALIGNMENT_UWORD 65535 Compu_IDENTITY 0 65535 PHYS_UNIT "System ID + DTC" /end CHARACTERISTIC
/begin CHARACTERISTIC FCdc4_RTI1 "FCtl_DTC_0x04(100)" VALUE 0x00163C98 /* @ECU_Address@FCtl_DTC_0x04@0x024C40C8@ */ ECIPP_ALIGNMENT_UWORD 65535 Compu_IDENTITY 0 65535 PHYS_UNIT "System ID + DTC" /end CHARACTERISTIC
/begin CHARACTERISTIC FCdc4_RTI2 "FCtl_DTC_0x04(101)" VALUE 0x00163C9A /* @ECU_Address@FCtl_DTC_0x04@0x024C40CA@ */ ECIPP_ALIGNMENT_UWORD 65535 Compu_IDENTITY 0 65535 PHYS_UNIT "System ID + DTC" /end CHARACTERISTIC
/begin CHARACTERISTIC FCdc4_RTI3 "FCtl_DTC_0x04(102)" VALUE 0x00163C9C /* @ECU_Address@FCtl_DTC_0x04@0x024C40CC@ */ ECIPP_ALIGNMENT_UWORD 65535 Compu_IDENTITY 0 65535 PHYS_UNIT "System ID + DTC" /end CHARACTERISTIC
/begin CHARACTERISTIC FCdc4_SHIFT_FB_OOR "FCtl_DTC_0x04(294)" VALUE 0x00163E1C /* @ECU_Address@FCtl_DTC_0x04@0x024C424C@ */ ECIPP_ALIGNMENT_UWORD 65535 Compu_IDENTITY 0 65535 PHYS_UNIT "System ID + DTC" /end CHARACTERISTIC
/begin CHARACTERISTIC FCdc4_SHIFT_intcirc_fail "FCtl_DTC_0x04(296)" VALUE 0x00163E20 /* @ECU_Address@FCtl_DTC_0x04@0x024C4250@ */ ECIPP_ALIGNMENT_UWORD 65535 Compu_IDENTITY 0 65535 PHYS_UNIT "System ID + DTC" /end CHARACTERISTIC
/begin CHARACTERISTIC FCdc4_SHIFT_shift_fail "FCtl_DTC_0x04(295)" VALUE 0x00163E1E /* @ECU_Address@FCtl_DTC_0x04@0x024C424E@ */ ECIPP_ALIGNMENT_UWORD 65535 Compu_IDENTITY 0 65535 PHYS_UNIT "System ID + DTC" /end CHARACTERISTIC
/begin CHARACTERISTIC FCdc4_SL_fuel "FCtl_DTC_0x04(109)" VALUE 0x00163CAA /* @ECU_Address@FCtl_DTC_0x04@0x024C40DA@ */ ECIPP_ALIGNMENT_UWORD 65535 Compu_IDENTITY 0 65535 PHYS_UNIT "System ID + DTC" /end CHARACTERISTIC
/begin CHARACTERISTIC FCdc4_SL_gov "FCtl_DTC_0x04(108)" VALUE 0x00163CA8 /* @ECU_Address@FCtl_DTC_0x04@0x024C40D8@ */ ECIPP_ALIGNMENT_UWORD 65535 Compu_IDENTITY 0 65535 PHYS_UNIT "System ID + DTC" /end CHARACTERISTIC
/begin CHARACTERISTIC FCdc4_SL_spk "FCtl_DTC_0x04(110)" VALUE 0x00163CAC /* @ECU_Address@FCtl_DTC_0x04@0x024C40DC@ */ ECIPP_ALIGNMENT_UWORD 65535 Compu_IDENTITY 0 65535 PHYS_UNIT "System ID + DTC" /end CHARACTERISTIC
/begin CHARACTERISTIC FCdc4_slv_MAP_hi_OOA "FCtl_DTC_0x04(837)" VALUE 0x0016425A /* @ECU_Address@FCtl_DTC_0x04@0x024C468A@ */ ECIPP_ALIGNMENT_UWORD 65535 Compu_IDENTITY 0 65535 PHYS_UNIT "System ID + DTC" /end CHARACTERISTIC
/begin CHARACTERISTIC FCdc4_slv_MAP_lo_OOA "FCtl_DTC_0x04(838)" VALUE 0x0016425C /* @ECU_Address@FCtl_DTC_0x04@0x024C468C@ */ ECIPP_ALIGNMENT_UWORD 65535 Compu_IDENTITY 0 65535 PHYS_UNIT "System ID + DTC" /end CHARACTERISTIC
/begin CHARACTERISTIC FCdc4_SPK_int_fail "FCtl_DTC_0x04(303)" VALUE 0x00163E2E /* @ECU_Address@FCtl_DTC_0x04@0x024C425E@ */ ECIPP_ALIGNMENT_UWORD 65535 Compu_IDENTITY 0 65535 PHYS_UNIT "System ID + DTC" /end CHARACTERISTIC
/begin CHARACTERISTIC FCdc4_SPK1_IGBT_T "FCtl_DTC_0x04(509)" VALUE 0x00163FCA /* @ECU_Address@FCtl_DTC_0x04@0x024C43FA@ */ ECIPP_ALIGNMENT_UWORD 65535 Compu_IDENTITY 0 65535 PHYS_UNIT "System ID + DTC" /end CHARACTERISTIC
/begin CHARACTERISTIC FCdc4_SPKD_coil_fail "FCtl_DTC_0x04(304)" VALUE 0x00163E30 /* @ECU_Address@FCtl_DTC_0x04@0x024C4260@ */ ECIPP_ALIGNMENT_UWORD 65535 Compu_IDENTITY 0 65535 PHYS_UNIT "System ID + DTC" /end CHARACTERISTIC
/begin CHARACTERISTIC FCdc4_SPKD_dw_hi "FCtl_DTC_0x04(76)" VALUE 0x00163C68 /* @ECU_Address@FCtl_DTC_0x04@0x024C4098@ */ ECIPP_ALIGNMENT_UWORD 65535 Compu_IDENTITY 0 65535 PHYS_UNIT "System ID + DTC" /end CHARACTERISTIC
/begin CHARACTERISTIC FCdc4_SPKD_dw_lo "FCtl_DTC_0x04(66)" VALUE 0x00163C54 /* @ECU_Address@FCtl_DTC_0x04@0x024C4084@ */ ECIPP_ALIGNMENT_UWORD 65535 Compu_IDENTITY 0 65535 PHYS_UNIT "System ID + DTC" /end CHARACTERISTIC
/begin CHARACTERISTIC FCdc4_SRVC_expired "FCtl_DTC_0x04(426)" VALUE 0x00163F24 /* @ECU_Address@FCtl_DTC_0x04@0x024C4354@ */ ECIPP_ALIGNMENT_UWORD 65535 Compu_IDENTITY 0 65535 PHYS_UNIT "System ID + DTC" /end CHARACTERISTIC
/begin CHARACTERISTIC FCdc4_SRVC_expired2 "FCtl_DTC_0x04(836)" VALUE 0x00164258 /* @ECU_Address@FCtl_DTC_0x04@0x024C4688@ */ ECIPP_ALIGNMENT_UWORD 65535 Compu_IDENTITY 0 65535 PHYS_UNIT "System ID + DTC" /end CHARACTERISTIC
/begin CHARACTERISTIC FCdc4_start_coilopen "FCtl_DTC_0x04(162)" VALUE 0x00163D14 /* @ECU_Address@FCtl_DTC_0x04@0x024C4144@ */ ECIPP_ALIGNMENT_UWORD 65535 Compu_IDENTITY 0 65535 PHYS_UNIT "System ID + DTC" /end CHARACTERISTIC
/begin CHARACTERISTIC FCdc4_start_coilshort "FCtl_DTC_0x04(163)" VALUE 0x00163D16 /* @ECU_Address@FCtl_DTC_0x04@0x024C4146@ */ ECIPP_ALIGNMENT_UWORD 65535 Compu_IDENTITY 0 65535 PHYS_UNIT "System ID + DTC" /end CHARACTERISTIC
/begin CHARACTERISTIC FCdc4_start_excess "FCtl_DTC_0x04(840)" VALUE 0x00164260 /* @ECU_Address@FCtl_DTC_0x04@0x024C4690@ */ ECIPP_ALIGNMENT_UWORD 65535 Compu_IDENTITY 0 65535 PHYS_UNIT "System ID + DTC" /end CHARACTERISTIC
/begin CHARACTERISTIC FCdc4_start_gndshort "FCtl_DTC_0x04(161)" VALUE 0x00163D12 /* @ECU_Address@FCtl_DTC_0x04@0x024C4142@ */ ECIPP_ALIGNMENT_UWORD 65535 Compu_IDENTITY 0 65535 PHYS_UNIT "System ID + DTC" /end CHARACTERISTIC
/begin CHARACTERISTIC FCdc4_start_stuck_active "FCtl_DTC_0x04(320)" VALUE 0x00163E50 /* @ECU_Address@FCtl_DTC_0x04@0x024C4280@ */ ECIPP_ALIGNMENT_UWORD 65535 Compu_IDENTITY 0 65535 PHYS_UNIT "System ID + DTC" /end CHARACTERISTIC
/begin CHARACTERISTIC FCdc4_SubDiagTemp "FCtl_DTC_0x04(653)" VALUE 0x001640EA /* @ECU_Address@FCtl_DTC_0x04@0x024C451A@ */ ECIPP_ALIGNMENT_UWORD 65535 Compu_IDENTITY 0 65535 PHYS_UNIT "System ID + DTC" /end CHARACTERISTIC
/begin CHARACTERISTIC FCdc4_tach_gndshort "FCtl_DTC_0x04(173)" VALUE 0x00163D2A /* @ECU_Address@FCtl_DTC_0x04@0x024C415A@ */ ECIPP_ALIGNMENT_UWORD 65535 Compu_IDENTITY 0 65535 PHYS_UNIT "System ID + DTC" /end CHARACTERISTIC
/begin CHARACTERISTIC FCdc4_tach_pwrshort "FCtl_DTC_0x04(174)" VALUE 0x00163D2C /* @ECU_Address@FCtl_DTC_0x04@0x024C415C@ */ ECIPP_ALIGNMENT_UWORD 65535 Compu_IDENTITY 0 65535 PHYS_UNIT "System ID + DTC" /end CHARACTERISTIC
/begin CHARACTERISTIC FCdc4_TAUX_dT1_max "FCtl_DTC_0x04(558)" VALUE 0x0016402C /* @ECU_Address@FCtl_DTC_0x04@0x024C445C@ */ ECIPP_ALIGNMENT_UWORD 65535 Compu_IDENTITY 0 65535 PHYS_UNIT "System ID + DTC" /end CHARACTERISTIC
/begin CHARACTERISTIC FCdc4_TAUX_dT1_min "FCtl_DTC_0x04(559)" VALUE 0x0016402E /* @ECU_Address@FCtl_DTC_0x04@0x024C445E@ */ ECIPP_ALIGNMENT_UWORD 65535 Compu_IDENTITY 0 65535 PHYS_UNIT "System ID + DTC" /end CHARACTERISTIC
/begin CHARACTERISTIC FCdc4_TAUX_dT2_max "FCtl_DTC_0x04(560)" VALUE 0x00164030 /* @ECU_Address@FCtl_DTC_0x04@0x024C4460@ */ ECIPP_ALIGNMENT_UWORD 65535 Compu_IDENTITY 0 65535 PHYS_UNIT "System ID + DTC" /end CHARACTERISTIC
/begin CHARACTERISTIC FCdc4_TAUX_dT2_min "FCtl_DTC_0x04(561)" VALUE 0x00164032 /* @ECU_Address@FCtl_DTC_0x04@0x024C4462@ */ ECIPP_ALIGNMENT_UWORD 65535 Compu_IDENTITY 0 65535 PHYS_UNIT "System ID + DTC" /end CHARACTERISTIC
/begin CHARACTERISTIC FCdc4_Taux1_derate_actv "FCtl_DTC_0x04(812)" VALUE 0x00164228 /* @ECU_Address@FCtl_DTC_0x04@0x024C4658@ */ ECIPP_ALIGNMENT_UWORD 65535 Compu_IDENTITY 0 65535 PHYS_UNIT "System ID + DTC" /end CHARACTERISTIC
/begin CHARACTERISTIC FCdc4_TAUX1_max "FCtl_DTC_0x04(550)" VALUE 0x0016401C /* @ECU_Address@FCtl_DTC_0x04@0x024C444C@ */ ECIPP_ALIGNMENT_UWORD 65535 Compu_IDENTITY 0 65535 PHYS_UNIT "System ID + DTC" /end CHARACTERISTIC
/begin CHARACTERISTIC FCdc4_TAUX1_min "FCtl_DTC_0x04(551)" VALUE 0x0016401E /* @ECU_Address@FCtl_DTC_0x04@0x024C444E@ */ ECIPP_ALIGNMENT_UWORD 65535 Compu_IDENTITY 0 65535 PHYS_UNIT "System ID + DTC" /end CHARACTERISTIC
/begin CHARACTERISTIC FCdc4_Taux2_derate_actv "FCtl_DTC_0x04(813)" VALUE 0x0016422A /* @ECU_Address@FCtl_DTC_0x04@0x024C465A@ */ ECIPP_ALIGNMENT_UWORD 65535 Compu_IDENTITY 0 65535 PHYS_UNIT "System ID + DTC" /end CHARACTERISTIC
/begin CHARACTERISTIC FPnd_PWM21_on_hiVf "FPrm_pending(353)" VALUE 0x00164C2E /* @ECU_Address@FPrm_pending@0x021BE2C2@ */ ECIPP_ALIGNMENT_UWORD 65535 Compu_IDENTITY 0 65535 PHYS_UNIT "Bit Mask" /end CHARACTERISTIC
/begin CHARACTERISTIC FPnd_PWM22_off_loVf "FPrm_pending(354)" VALUE 0x00164C30 /* @ECU_Address@FPrm_pending@0x021BE2C4@ */ ECIPP_ALIGNMENT_UWORD 65535 Compu_IDENTITY 0 65535 PHYS_UNIT "Bit Mask" /end CHARACTERISTIC
/begin CHARACTERISTIC FPnd_PWM22_on_hiVf "FPrm_pending(355)" VALUE 0x00164C32 /* @ECU_Address@FPrm_pending@0x021BE2C6@ */ ECIPP_ALIGNMENT_UWORD 65535 Compu_IDENTITY 0 65535 PHYS_UNIT "Bit Mask" /end CHARACTERISTIC
/begin CHARACTERISTIC FPnd_PWM23_off_loVf "FPrm_pending(356)" VALUE 0x00164C34 /* @ECU_Address@FPrm_pending@0x021BE2C8@ */ ECIPP_ALIGNMENT_UWORD 65535 Compu_IDENTITY 0 65535 PHYS_UNIT "Bit Mask" /end CHARACTERISTIC
/begin CHARACTERISTIC FPnd_PWM23_on_hiVf "FPrm_pending(357)" VALUE 0x00164C36 /* @ECU_Address@FPrm_pending@0x021BE2CA@ */ ECIPP_ALIGNMENT_UWORD 65535 Compu_IDENTITY 0 65535 PHYS_UNIT "Bit Mask" /end CHARACTERISTIC
/begin CHARACTERISTIC FPnd_PWM3_off_loVf "FPrm_pending(151)" VALUE 0x00164A9A /* @ECU_Address@FPrm_pending@0x021BE12E@ */ ECIPP_ALIGNMENT_UWORD 65535 Compu_IDENTITY 0 65535 PHYS_UNIT "Bit Mask" /end CHARACTERISTIC
/begin CHARACTERISTIC FPnd_PWM3_on_hiVf "FPrm_pending(152)" VALUE 0x00164A9C /* @ECU_Address@FPrm_pending@0x021BE130@ */ ECIPP_ALIGNMENT_UWORD 65535 Compu_IDENTITY 0 65535 PHYS_UNIT "Bit Mask" /end CHARACTERISTIC
/begin CHARACTERISTIC FPnd_PWM4_off_loVf "FPrm_pending(153)" VALUE 0x00164A9E /* @ECU_Address@FPrm_pending@0x021BE132@ */ ECIPP_ALIGNMENT_UWORD 65535 Compu_IDENTITY 0 65535 PHYS_UNIT "Bit Mask" /end CHARACTERISTIC
/begin CHARACTERISTIC FPnd_PWM4_on_hiVf "FPrm_pending(154)" VALUE 0x00164AA0 /* @ECU_Address@FPrm_pending@0x021BE134@ */ ECIPP_ALIGNMENT_UWORD 65535 Compu_IDENTITY 0 65535 PHYS_UNIT "Bit Mask" /end CHARACTERISTIC
/begin CHARACTERISTIC FPnd_PWM5_off_loVf "FPrm_pending(155)" VALUE 0x00164AA2 /* @ECU_Address@FPrm_pending@0x021BE136@ */ ECIPP_ALIGNMENT_UWORD 65535 Compu_IDENTITY 0 65535 PHYS_UNIT "Bit Mask" /end CHARACTERISTIC
/begin CHARACTERISTIC FPnd_PWM5_on_hiVf "FPrm_pending(156)" VALUE 0x00164AA4 /* @ECU_Address@FPrm_pending@0x021BE138@ */ ECIPP_ALIGNMENT_UWORD 65535 Compu_IDENTITY 0 65535 PHYS_UNIT "Bit Mask" /end CHARACTERISTIC
/begin CHARACTERISTIC FPnd_PWM6_off_loVf "FPrm_pending(198)" VALUE 0x00164AF8 /* @ECU_Address@FPrm_pending@0x021BE18C@ */ ECIPP_ALIGNMENT_UWORD 65535 Compu_IDENTITY 0 65535 PHYS_UNIT "Bit Mask" /end CHARACTERISTIC
/begin CHARACTERISTIC FPnd_PWM6_on_hiVf "FPrm_pending(199)" VALUE 0x00164AFA /* @ECU_Address@FPrm_pending@0x021BE18E@ */ ECIPP_ALIGNMENT_UWORD 65535 Compu_IDENTITY 0 65535 PHYS_UNIT "Bit Mask" /end CHARACTERISTIC
/begin CHARACTERISTIC FPnd_PWM7_off_loVf "FPrm_pending(200)" VALUE 0x00164AFC /* @ECU_Address@FPrm_pending@0x021BE190@ */ ECIPP_ALIGNMENT_UWORD 65535 Compu_IDENTITY 0 65535 PHYS_UNIT "Bit Mask" /end CHARACTERISTIC
/begin CHARACTERISTIC FPnd_PWM7_on_hiVf "FPrm_pending(201)" VALUE 0x00164AFE /* @ECU_Address@FPrm_pending@0x021BE192@ */ ECIPP_ALIGNMENT_UWORD 65535 Compu_IDENTITY 0 65535 PHYS_UNIT "Bit Mask" /end CHARACTERISTIC
/begin CHARACTERISTIC FPnd_PWM8_off_loVf "FPrm_pending(205)" VALUE 0x00164B06 /* @ECU_Address@FPrm_pending@0x021BE19A@ */ ECIPP_ALIGNMENT_UWORD 65535 Compu_IDENTITY 0 65535 PHYS_UNIT "Bit Mask" /end CHARACTERISTIC
/begin CHARACTERISTIC FPnd_PWM8_on_hiVf "FPrm_pending(206)" VALUE 0x00164B08 /* @ECU_Address@FPrm_pending@0x021BE19C@ */ ECIPP_ALIGNMENT_UWORD 65535 Compu_IDENTITY 0 65535 PHYS_UNIT "Bit Mask" /end CHARACTERISTIC
/begin CHARACTERISTIC FPnd_PWM9_off_loVf "FPrm_pending(207)" VALUE 0x00164B0A /* @ECU_Address@FPrm_pending@0x021BE19E@ */ ECIPP_ALIGNMENT_UWORD 65535 Compu_IDENTITY 0 65535 PHYS_UNIT "Bit Mask" /end CHARACTERISTIC
/begin CHARACTERISTIC FPnd_PWM9_on_hiVf "FPrm_pending(208)" VALUE 0x00164B0C /* @ECU_Address@FPrm_pending@0x021BE1A0@ */ ECIPP_ALIGNMENT_UWORD 65535 Compu_IDENTITY 0 65535 PHYS_UNIT "Bit Mask" /end CHARACTERISTIC
/begin CHARACTERISTIC FPnd_PWMLO_off_loVf "FPrm_pending(391)" VALUE 0x00164C7A /* @ECU_Address@FPrm_pending@0x021BE30E@ */ ECIPP_ALIGNMENT_UWORD 65535 Compu_IDENTITY 0 65535 PHYS_UNIT "Bit Mask" /end CHARACTERISTIC
/begin CHARACTERISTIC FPnd_PWMLO_on_hiVf "FPrm_pending(392)" VALUE 0x00164C7C /* @ECU_Address@FPrm_pending@0x021BE310@ */ ECIPP_ALIGNMENT_UWORD 65535 Compu_IDENTITY 0 65535 PHYS_UNIT "Bit Mask" /end CHARACTERISTIC
/begin CHARACTERISTIC FPnd_RAM_fail "FPrm_pending(70)" VALUE 0x001649F8 /* @ECU_Address@FPrm_pending@0x021BE08C@ */ ECIPP_ALIGNMENT_UWORD 65535 Compu_IDENTITY 0 65535 PHYS_UNIT "Bit Mask" /end CHARACTERISTIC
/begin CHARACTERISTIC FPnd_relay_coilopen "FPrm_pending(119)" VALUE 0x00164A5A /* @ECU_Address@FPrm_pending@0x021BE0EE@ */ ECIPP_ALIGNMENT_UWORD 65535 Compu_IDENTITY 0 65535 PHYS_UNIT "Bit Mask" /end CHARACTERISTIC
/begin CHARACTERISTIC FPnd_relay_coilshort "FPrm_pending(120)" VALUE 0x00164A5C /* @ECU_Address@FPrm_pending@0x021BE0F0@ */ ECIPP_ALIGNMENT_UWORD 65535 Compu_IDENTITY 0 65535 PHYS_UNIT "Bit Mask" /end CHARACTERISTIC
/begin CHARACTERISTIC FPnd_relay_gndshort "FPrm_pending(118)" VALUE 0x00164A58 /* @ECU_Address@FPrm_pending@0x021BE0EC@ */ ECIPP_ALIGNMENT_UWORD 65535 Compu_IDENTITY 0 65535 PHYS_UNIT "Bit Mask" /end CHARACTERISTIC
/begin CHARACTERISTIC FPnd_relayoff_hiV "FPrm_pending(328)" VALUE 0x00164BFC /* @ECU_Address@FPrm_pending@0x021BE290@ */ ECIPP_ALIGNMENT_UWORD 65535 Compu_IDENTITY 0 65535 PHYS_UNIT "Bit Mask" /end CHARACTERISTIC
/begin CHARACTERISTIC FPnd_relayon_loV "FPrm_pending(329)" VALUE 0x00164BFE /* @ECU_Address@FPrm_pending@0x021BE292@ */ ECIPP_ALIGNMENT_UWORD 65535 Compu_IDENTITY 0 65535 PHYS_UNIT "Bit Mask" /end CHARACTERISTIC
/begin CHARACTERISTIC FPnd_rpm_hi_expected "FPrm_pending(260)" VALUE 0x00164B74 /* @ECU_Address@FPrm_pending@0x021BE208@ */ ECIPP_ALIGNMENT_UWORD 65535 Compu_IDENTITY 0 65535 PHYS_UNIT "Bit Mask" /end CHARACTERISTIC
/begin CHARACTERISTIC FPnd_rpmd_gov_lo "FPrm_pending(390)" VALUE 0x00164C78 /* @ECU_Address@FPrm_pending@0x021BE30C@ */ ECIPP_ALIGNMENT_UWORD 65535 Compu_IDENTITY 0 65535 PHYS_UNIT "Bit Mask" /end CHARACTERISTIC
/begin CHARACTERISTIC FPnd_RS_discon "FPrm_pending(521)" VALUE 0x00164D7E /* @ECU_Address@FPrm_pending@0x021BE412@ */ ECIPP_ALIGNMENT_UWORD 65535 Compu_IDENTITY 0 65535 PHYS_UNIT "Bit Mask" /end CHARACTERISTIC
/begin CHARACTERISTIC FPnd_RS_hiV "FPrm_pending(453)" VALUE 0x00164CF6 /* @ECU_Address@FPrm_pending@0x021BE38A@ */ ECIPP_ALIGNMENT_UWORD 65535 Compu_IDENTITY 0 65535 PHYS_UNIT "Bit Mask" /end CHARACTERISTIC
/begin CHARACTERISTIC FPnd_RS_loss "FPrm_pending(176)" VALUE 0x00164ACC /* @ECU_Address@FPrm_pending@0x021BE160@ */ ECIPP_ALIGNMENT_UWORD 65535 Compu_IDENTITY 0 65535 PHYS_UNIT "Bit Mask" /end CHARACTERISTIC
/begin CHARACTERISTIC FPnd_RS_loV "FPrm_pending(452)" VALUE 0x00164CF4 /* @ECU_Address@FPrm_pending@0x021BE388@ */ ECIPP_ALIGNMENT_UWORD 65535 Compu_IDENTITY 0 65535 PHYS_UNIT "Bit Mask" /end CHARACTERISTIC
/begin CHARACTERISTIC FPnd_RS485_bad_fmt "FPrm_pending(83)" VALUE 0x00164A12 /* @ECU_Address@FPrm_pending@0x021BE0A6@ */ ECIPP_ALIGNMENT_UWORD 65535 Compu_IDENTITY 0 65535 PHYS_UNIT "Bit Mask" /end CHARACTERISTIC
/begin CHARACTERISTIC FPnd_RS485_Rx_inact "FPrm_pending(81)" VALUE 0x00164A0E /* @ECU_Address@FPrm_pending@0x021BE0A2@ */ ECIPP_ALIGNMENT_UWORD 65535 Compu_IDENTITY 0 65535 PHYS_UNIT "Bit Mask" /end CHARACTERISTIC
/begin CHARACTERISTIC FPnd_RS485_Rx_noise "FPrm_pending(82)" VALUE 0x00164A10 /* @ECU_Address@FPrm_pending@0x021BE0A4@ */ ECIPP_ALIGNMENT_UWORD 65535 Compu_IDENTITY 0 65535 PHYS_UNIT "Bit Mask" /end CHARACTERISTIC
/begin CHARACTERISTIC FPnd_RS485_SD_rq "FPrm_pending(84)" VALUE 0x00164A14 /* @ECU_Address@FPrm_pending@0x021BE0A8@ */ ECIPP_ALIGNMENT_UWORD 65535 Compu_IDENTITY 0 65535 PHYS_UNIT "Bit Mask" /end CHARACTERISTIC
/begin CHARACTERISTIC FPnd_RTI1 "FPrm_pending(64)" VALUE 0x001649EC /* @ECU_Address@FPrm_pending@0x021BE080@ */ ECIPP_ALIGNMENT_UWORD 65535 Compu_IDENTITY 0 65535 PHYS_UNIT "Bit Mask" /end CHARACTERISTIC
/begin CHARACTERISTIC FPnd_RTI2 "FPrm_pending(65)" VALUE 0x001649EE /* @ECU_Address@FPrm_pending@0x021BE082@ */ ECIPP_ALIGNMENT_UWORD 65535 Compu_IDENTITY 0 65535 PHYS_UNIT "Bit Mask" /end CHARACTERISTIC
/begin CHARACTERISTIC FPnd_RTI3 "FPrm_pending(66)" VALUE 0x001649F0 /* @ECU_Address@FPrm_pending@0x021BE084@ */ ECIPP_ALIGNMENT_UWORD 65535 Compu_IDENTITY 0 65535 PHYS_UNIT "Bit Mask" /end CHARACTERISTIC
/begin CHARACTERISTIC FPnd_SHIFT_FB_OOR "FPrm_pending(216)" VALUE 0x00164B1C /* @ECU_Address@FPrm_pending@0x021BE1B0@ */ ECIPP_ALIGNMENT_UWORD 65535 Compu_IDENTITY 0 65535 PHYS_UNIT "Bit Mask" /end CHARACTERISTIC
/begin CHARACTERISTIC FPnd_SHIFT_intcirc_fail "FPrm_pending(218)" VALUE 0x00164B20 /* @ECU_Address@FPrm_pending@0x021BE1B4@ */ ECIPP_ALIGNMENT_UWORD 65535 Compu_IDENTITY 0 65535 PHYS_UNIT "Bit Mask" /end CHARACTERISTIC
/begin CHARACTERISTIC FPnd_SHIFT_shift_fail "FPrm_pending(217)" VALUE 0x00164B1E /* @ECU_Address@FPrm_pending@0x021BE1B2@ */ ECIPP_ALIGNMENT_UWORD 65535 Compu_IDENTITY 0 65535 PHYS_UNIT "Bit Mask" /end CHARACTERISTIC
/begin CHARACTERISTIC FPnd_SL_fuel "FPrm_pending(38)" VALUE 0x001649B8 /* @ECU_Address@FPrm_pending@0x021BE04C@ */ ECIPP_ALIGNMENT_UWORD 65535 Compu_IDENTITY 0 65535 PHYS_UNIT "Bit Mask" /end CHARACTERISTIC
/begin CHARACTERISTIC FPnd_SL_gov "FPrm_pending(37)" VALUE 0x001649B6 /* @ECU_Address@FPrm_pending@0x021BE04A@ */ ECIPP_ALIGNMENT_UWORD 65535 Compu_IDENTITY 0 65535 PHYS_UNIT "Bit Mask" /end CHARACTERISTIC
/begin CHARACTERISTIC FPnd_SL_spk "FPrm_pending(39)" VALUE 0x001649BA /* @ECU_Address@FPrm_pending@0x021BE04E@ */ ECIPP_ALIGNMENT_UWORD 65535 Compu_IDENTITY 0 65535 PHYS_UNIT "Bit Mask" /end CHARACTERISTIC
/begin CHARACTERISTIC FPnd_slv_MAP_hi_OOA "FPrm_pending(664)" VALUE 0x00164E9C /* @ECU_Address@FPrm_pending@0x021BE530@ */ ECIPP_ALIGNMENT_UWORD 65535 Compu_IDENTITY 0 65535 PHYS_UNIT "Bit Mask" /end CHARACTERISTIC
/begin CHARACTERISTIC FPnd_slv_MAP_lo_OOA "FPrm_pending(665)" VALUE 0x00164E9E /* @ECU_Address@FPrm_pending@0x021BE532@ */ ECIPP_ALIGNMENT_UWORD 65535 Compu_IDENTITY 0 65535 PHYS_UNIT "Bit Mask" /end CHARACTERISTIC
/begin CHARACTERISTIC FPnd_SPK_int_fail "FPrm_pending(225)" VALUE 0x00164B2E /* @ECU_Address@FPrm_pending@0x021BE1C2@ */ ECIPP_ALIGNMENT_UWORD 65535 Compu_IDENTITY 0 65535 PHYS_UNIT "Bit Mask" /end CHARACTERISTIC
/begin CHARACTERISTIC FPnd_SPK1_IGBT_T "FPrm_pending(388)" VALUE 0x00164C74 /* @ECU_Address@FPrm_pending@0x021BE308@ */ ECIPP_ALIGNMENT_UWORD 65535 Compu_IDENTITY 0 65535 PHYS_UNIT "Bit Mask" /end CHARACTERISTIC
/begin CHARACTERISTIC FPnd_SPKD_coil_fail "FPrm_pending(226)" VALUE 0x00164B30 /* @ECU_Address@FPrm_pending@0x021BE1C4@ */ ECIPP_ALIGNMENT_UWORD 65535 Compu_IDENTITY 0 65535 PHYS_UNIT "Bit Mask" /end CHARACTERISTIC
/begin CHARACTERISTIC FPnd_SPKD_dw_hi "FPrm_pending(56)" VALUE 0x001649DC /* @ECU_Address@FPrm_pending@0x021BE070@ */ ECIPP_ALIGNMENT_UWORD 65535 Compu_IDENTITY 0 65535 PHYS_UNIT "Bit Mask" /end CHARACTERISTIC
/begin CHARACTERISTIC FPnd_SPKD_dw_lo "FPrm_pending(55)" VALUE 0x001649DA /* @ECU_Address@FPrm_pending@0x021BE06E@ */ ECIPP_ALIGNMENT_UWORD 65535 Compu_IDENTITY 0 65535 PHYS_UNIT "Bit Mask" /end CHARACTERISTIC
/begin CHARACTERISTIC FPnd_SRVC_expired "FPrm_pending(323)" VALUE 0x00164BF2 /* @ECU_Address@FPrm_pending@0x021BE286@ */ ECIPP_ALIGNMENT_UWORD 65535 Compu_IDENTITY 0 65535 PHYS_UNIT "Bit Mask" /end CHARACTERISTIC
/begin CHARACTERISTIC FPnd_SRVC_expired2 "FPrm_pending(663)" VALUE 0x00164E9A /* @ECU_Address@FPrm_pending@0x021BE52E@ */ ECIPP_ALIGNMENT_UWORD 65535 Compu_IDENTITY 0 65535 PHYS_UNIT "Bit Mask" /end CHARACTERISTIC
/begin CHARACTERISTIC FPnd_start_coilopen "FPrm_pending(122)" VALUE 0x00164A60 /* @ECU_Address@FPrm_pending@0x021BE0F4@ */ ECIPP_ALIGNMENT_UWORD 65535 Compu_IDENTITY 0 65535 PHYS_UNIT "Bit Mask" /end CHARACTERISTIC
/begin CHARACTERISTIC FPnd_start_coilshort "FPrm_pending(123)" VALUE 0x00164A62 /* @ECU_Address@FPrm_pending@0x021BE0F6@ */ ECIPP_ALIGNMENT_UWORD 65535 Compu_IDENTITY 0 65535 PHYS_UNIT "Bit Mask" /end CHARACTERISTIC
/begin CHARACTERISTIC FPnd_start_excess "FPrm_pending(667)" VALUE 0x00164EA2 /* @ECU_Address@FPrm_pending@0x021BE536@ */ ECIPP_ALIGNMENT_UWORD 65535 Compu_IDENTITY 0 65535 PHYS_UNIT "Bit Mask" /end CHARACTERISTIC
/begin CHARACTERISTIC FPnd_start_gndshort "FPrm_pending(121)" VALUE 0x00164A5E /* @ECU_Address@FPrm_pending@0x021BE0F2@ */ ECIPP_ALIGNMENT_UWORD 65535 Compu_IDENTITY 0 65535 PHYS_UNIT "Bit Mask" /end CHARACTERISTIC
/begin CHARACTERISTIC FPnd_start_stuck_active "FPrm_pending(229)" VALUE 0x00164B36 /* @ECU_Address@FPrm_pending@0x021BE1CA@ */ ECIPP_ALIGNMENT_UWORD 65535 Compu_IDENTITY 0 65535 PHYS_UNIT "Bit Mask" /end CHARACTERISTIC
/begin CHARACTERISTIC FPnd_SubDiagTemp "FPrm_pending(483)" VALUE 0x00164D32 /* @ECU_Address@FPrm_pending@0x021BE3C6@ */ ECIPP_ALIGNMENT_UWORD 65535 Compu_IDENTITY 0 65535 PHYS_UNIT "Bit Mask" /end CHARACTERISTIC
/begin CHARACTERISTIC FPnd_tach_gndshort "FPrm_pending(133)" VALUE 0x00164A76 /* @ECU_Address@FPrm_pending@0x021BE10A@ */ ECIPP_ALIGNMENT_UWORD 65535 Compu_IDENTITY 0 65535 PHYS_UNIT "Bit Mask" /end CHARACTERISTIC
/begin CHARACTERISTIC FPnd_tach_pwrshort "FPrm_pending(134)" VALUE 0x00164A78 /* @ECU_Address@FPrm_pending@0x021BE10C@ */ ECIPP_ALIGNMENT_UWORD 65535 Compu_IDENTITY 0 65535 PHYS_UNIT "Bit Mask" /end CHARACTERISTIC
/begin CHARACTERISTIC FPnd_TAUX_dT1_max "FPrm_pending(428)" VALUE 0x00164CC4 /* @ECU_Address@FPrm_pending@0x021BE358@ */ ECIPP_ALIGNMENT_UWORD 65535 Compu_IDENTITY 0 65535 PHYS_UNIT "Bit Mask" /end CHARACTERISTIC
/begin CHARACTERISTIC FPnd_TAUX_dT1_min "FPrm_pending(429)" VALUE 0x00164CC6 /* @ECU_Address@FPrm_pending@0x021BE35A@ */ ECIPP_ALIGNMENT_UWORD 65535 Compu_IDENTITY 0 65535 PHYS_UNIT "Bit Mask" /end CHARACTERISTIC
/begin CHARACTERISTIC FPnd_TAUX_dT2_max "FPrm_pending(430)" VALUE 0x00164CC8 /* @ECU_Address@FPrm_pending@0x021BE35C@ */ ECIPP_ALIGNMENT_UWORD 65535 Compu_IDENTITY 0 65535 PHYS_UNIT "Bit Mask" /end CHARACTERISTIC
/begin CHARACTERISTIC FPnd_TAUX_dT2_min "FPrm_pending(431)" VALUE 0x00164CCA /* @ECU_Address@FPrm_pending@0x021BE35E@ */ ECIPP_ALIGNMENT_UWORD 65535 Compu_IDENTITY 0 65535 PHYS_UNIT "Bit Mask" /end CHARACTERISTIC
/begin CHARACTERISTIC FPnd_Taux1_derate_actv "FPrm_pending(639)" VALUE 0x00164E6A /* @ECU_Address@FPrm_pending@0x021BE4FE@ */ ECIPP_ALIGNMENT_UWORD 65535 Compu_IDENTITY 0 65535 PHYS_UNIT "Bit Mask" /end CHARACTERISTIC
/begin CHARACTERISTIC FPnd_TAUX1_max "FPrm_pending(420)" VALUE 0x00164CB4 /* @ECU_Address@FPrm_pending@0x021BE348@ */ ECIPP_ALIGNMENT_UWORD 65535 Compu_IDENTITY 0 65535 PHYS_UNIT "Bit Mask" /end CHARACTERISTIC
/begin CHARACTERISTIC FPnd_TAUX1_min "FPrm_pending(421)" VALUE 0x00164CB6 /* @ECU_Address@FPrm_pending@0x021BE34A@ */ ECIPP_ALIGNMENT_UWORD 65535 Compu_IDENTITY 0 65535 PHYS_UNIT "Bit Mask" /end CHARACTERISTIC
/begin CHARACTERISTIC FPnd_Taux2_derate_actv "FPrm_pending(640)" VALUE 0x00164E6C /* @ECU_Address@FPrm_pending@0x021BE500@ */ ECIPP_ALIGNMENT_UWORD 65535 Compu_IDENTITY 0 65535 PHYS_UNIT "Bit Mask" /end CHARACTERISTIC
/begin CHARACTERISTIC FPsvr_PWM21_on_hiVf "FPrm_severity(353)" VALUE 0x00165F3F /* @ECU_Address@FPrm_severity@0x024B3161@ */ ECIPP_ALIGNMENT_UBYTE 255 Compu_IDENTITY 0 255 PHYS_UNIT "Severity+Class" /end CHARACTERISTIC
/begin CHARACTERISTIC FPsvr_PWM22_off_loVf "FPrm_severity(354)" VALUE 0x00165F40 /* @ECU_Address@FPrm_severity@0x024B3162@ */ ECIPP_ALIGNMENT_UBYTE 255 Compu_IDENTITY 0 255 PHYS_UNIT "Severity+Class" /end CHARACTERISTIC
/begin CHARACTERISTIC FPsvr_PWM22_on_hiVf "FPrm_severity(355)" VALUE 0x00165F41 /* @ECU_Address@FPrm_severity@0x024B3163@ */ ECIPP_ALIGNMENT_UBYTE 255 Compu_IDENTITY 0 255 PHYS_UNIT "Severity+Class" /end CHARACTERISTIC
/begin CHARACTERISTIC FPsvr_PWM23_off_loVf "FPrm_severity(356)" VALUE 0x00165F42 /* @ECU_Address@FPrm_severity@0x024B3164@ */ ECIPP_ALIGNMENT_UBYTE 255 Compu_IDENTITY 0 255 PHYS_UNIT "Severity+Class" /end CHARACTERISTIC
/begin CHARACTERISTIC FPsvr_PWM23_on_hiVf "FPrm_severity(357)" VALUE 0x00165F43 /* @ECU_Address@FPrm_severity@0x024B3165@ */ ECIPP_ALIGNMENT_UBYTE 255 Compu_IDENTITY 0 255 PHYS_UNIT "Severity+Class" /end CHARACTERISTIC
/begin CHARACTERISTIC FPsvr_PWM3_off_loVf "FPrm_severity(151)" VALUE 0x00165E75 /* @ECU_Address@FPrm_severity@0x024B3097@ */ ECIPP_ALIGNMENT_UBYTE 255 Compu_IDENTITY 0 255 PHYS_UNIT "Severity+Class" /end CHARACTERISTIC
/begin CHARACTERISTIC FPsvr_PWM3_on_hiVf "FPrm_severity(152)" VALUE 0x00165E76 /* @ECU_Address@FPrm_severity@0x024B3098@ */ ECIPP_ALIGNMENT_UBYTE 255 Compu_IDENTITY 0 255 PHYS_UNIT "Severity+Class" /end CHARACTERISTIC
/begin CHARACTERISTIC FPsvr_PWM4_off_loVf "FPrm_severity(153)" VALUE 0x00165E77 /* @ECU_Address@FPrm_severity@0x024B3099@ */ ECIPP_ALIGNMENT_UBYTE 255 Compu_IDENTITY 0 255 PHYS_UNIT "Severity+Class" /end CHARACTERISTIC
/begin CHARACTERISTIC FPsvr_PWM4_on_hiVf "FPrm_severity(154)" VALUE 0x00165E78 /* @ECU_Address@FPrm_severity@0x024B309A@ */ ECIPP_ALIGNMENT_UBYTE 255 Compu_IDENTITY 0 255 PHYS_UNIT "Severity+Class" /end CHARACTERISTIC
/begin CHARACTERISTIC FPsvr_PWM5_off_loVf "FPrm_severity(155)" VALUE 0x00165E79 /* @ECU_Address@FPrm_severity@0x024B309B@ */ ECIPP_ALIGNMENT_UBYTE 255 Compu_IDENTITY 0 255 PHYS_UNIT "Severity+Class" /end CHARACTERISTIC
/begin CHARACTERISTIC FPsvr_PWM5_on_hiVf "FPrm_severity(156)" VALUE 0x00165E7A /* @ECU_Address@FPrm_severity@0x024B309C@ */ ECIPP_ALIGNMENT_UBYTE 255 Compu_IDENTITY 0 255 PHYS_UNIT "Severity+Class" /end CHARACTERISTIC
/begin CHARACTERISTIC FPsvr_PWM6_off_loVf "FPrm_severity(198)" VALUE 0x00165EA4 /* @ECU_Address@FPrm_severity@0x024B30C6@ */ ECIPP_ALIGNMENT_UBYTE 255 Compu_IDENTITY 0 255 PHYS_UNIT "Severity+Class" /end CHARACTERISTIC
/begin CHARACTERISTIC FPsvr_PWM6_on_hiVf "FPrm_severity(199)" VALUE 0x00165EA5 /* @ECU_Address@FPrm_severity@0x024B30C7@ */ ECIPP_ALIGNMENT_UBYTE 255 Compu_IDENTITY 0 255 PHYS_UNIT "Severity+Class" /end CHARACTERISTIC
/begin CHARACTERISTIC FPsvr_PWM7_off_loVf "FPrm_severity(200)" VALUE 0x00165EA6 /* @ECU_Address@FPrm_severity@0x024B30C8@ */ ECIPP_ALIGNMENT_UBYTE 255 Compu_IDENTITY 0 255 PHYS_UNIT "Severity+Class" /end CHARACTERISTIC
/begin CHARACTERISTIC FPsvr_PWM7_on_hiVf "FPrm_severity(201)" VALUE 0x00165EA7 /* @ECU_Address@FPrm_severity@0x024B30C9@ */ ECIPP_ALIGNMENT_UBYTE 255 Compu_IDENTITY 0 255 PHYS_UNIT "Severity+Class" /end CHARACTERISTIC
/begin CHARACTERISTIC FPsvr_PWM8_off_loVf "FPrm_severity(205)" VALUE 0x00165EAB /* @ECU_Address@FPrm_severity@0x024B30CD@ */ ECIPP_ALIGNMENT_UBYTE 255 Compu_IDENTITY 0 255 PHYS_UNIT "Severity+Class" /end CHARACTERISTIC
/begin CHARACTERISTIC FPsvr_PWM8_on_hiVf "FPrm_severity(206)" VALUE 0x00165EAC /* @ECU_Address@FPrm_severity@0x024B30CE@ */ ECIPP_ALIGNMENT_UBYTE 255 Compu_IDENTITY 0 255 PHYS_UNIT "Severity+Class" /end CHARACTERISTIC
/begin CHARACTERISTIC FPsvr_PWM9_off_loVf "FPrm_severity(207)" VALUE 0x00165EAD /* @ECU_Address@FPrm_severity@0x024B30CF@ */ ECIPP_ALIGNMENT_UBYTE 255 Compu_IDENTITY 0 255 PHYS_UNIT "Severity+Class" /end CHARACTERISTIC
/begin CHARACTERISTIC FPsvr_PWM9_on_hiVf "FPrm_severity(208)" VALUE 0x00165EAE /* @ECU_Address@FPrm_severity@0x024B30D0@ */ ECIPP_ALIGNMENT_UBYTE 255 Compu_IDENTITY 0 255 PHYS_UNIT "Severity+Class" /end CHARACTERISTIC
/begin CHARACTERISTIC FPsvr_PWMLO_off_loVf "FPrm_severity(391)" VALUE 0x00165F65 /* @ECU_Address@FPrm_severity@0x024B3187@ */ ECIPP_ALIGNMENT_UBYTE 255 Compu_IDENTITY 0 255 PHYS_UNIT "Severity+Class" /end CHARACTERISTIC
/begin CHARACTERISTIC FPsvr_PWMLO_on_hiVf "FPrm_severity(392)" VALUE 0x00165F66 /* @ECU_Address@FPrm_severity@0x024B3188@ */ ECIPP_ALIGNMENT_UBYTE 255 Compu_IDENTITY 0 255 PHYS_UNIT "Severity+Class" /end CHARACTERISTIC
/begin CHARACTERISTIC FPsvr_RAM_fail "FPrm_severity(70)" VALUE 0x00165E24 /* @ECU_Address@FPrm_severity@0x024B3046@ */ ECIPP_ALIGNMENT_UBYTE 255 Compu_IDENTITY 0 255 PHYS_UNIT "Severity+Class" /end CHARACTERISTIC
/begin CHARACTERISTIC FPsvr_relay_coilopen "FPrm_severity(119)" VALUE 0x00165E55 /* @ECU_Address@FPrm_severity@0x024B3077@ */ ECIPP_ALIGNMENT_UBYTE 255 Compu_IDENTITY 0 255 PHYS_UNIT "Severity+Class" /end CHARACTERISTIC
/begin CHARACTERISTIC FPsvr_relay_coilshort "FPrm_severity(120)" VALUE 0x00165E56 /* @ECU_Address@FPrm_severity@0x024B3078@ */ ECIPP_ALIGNMENT_UBYTE 255 Compu_IDENTITY 0 255 PHYS_UNIT "Severity+Class" /end CHARACTERISTIC
/begin CHARACTERISTIC FPsvr_relay_gndshort "FPrm_severity(118)" VALUE 0x00165E54 /* @ECU_Address@FPrm_severity@0x024B3076@ */ ECIPP_ALIGNMENT_UBYTE 255 Compu_IDENTITY 0 255 PHYS_UNIT "Severity+Class" /end CHARACTERISTIC
/begin CHARACTERISTIC FPsvr_relayoff_hiV "FPrm_severity(328)" VALUE 0x00165F26 /* @ECU_Address@FPrm_severity@0x024B3148@ */ ECIPP_ALIGNMENT_UBYTE 255 Compu_IDENTITY 0 255 PHYS_UNIT "Severity+Class" /end CHARACTERISTIC
/begin CHARACTERISTIC FPsvr_relayon_loV "FPrm_severity(329)" VALUE 0x00165F27 /* @ECU_Address@FPrm_severity@0x024B3149@ */ ECIPP_ALIGNMENT_UBYTE 255 Compu_IDENTITY 0 255 PHYS_UNIT "Severity+Class" /end CHARACTERISTIC
/begin CHARACTERISTIC FPsvr_rpm_hi_expected "FPrm_severity(260)" VALUE 0x00165EE2 /* @ECU_Address@FPrm_severity@0x024B3104@ */ ECIPP_ALIGNMENT_UBYTE 255 Compu_IDENTITY 0 255 PHYS_UNIT "Severity+Class" /end CHARACTERISTIC
/begin CHARACTERISTIC FPsvr_rpmd_gov_lo "FPrm_severity(390)" VALUE 0x00165F64 /* @ECU_Address@FPrm_severity@0x024B3186@ */ ECIPP_ALIGNMENT_UBYTE 255 Compu_IDENTITY 0 255 PHYS_UNIT "Severity+Class" /end CHARACTERISTIC
/begin CHARACTERISTIC FPsvr_RS_discon "FPrm_severity(521)" VALUE 0x00165FE7 /* @ECU_Address@FPrm_severity@0x024B3209@ */ ECIPP_ALIGNMENT_UBYTE 255 Compu_IDENTITY 0 255 PHYS_UNIT "Severity+Class" /end CHARACTERISTIC
/begin CHARACTERISTIC FPsvr_RS_hiV "FPrm_severity(453)" VALUE 0x00165FA3 /* @ECU_Address@FPrm_severity@0x024B31C5@ */ ECIPP_ALIGNMENT_UBYTE 255 Compu_IDENTITY 0 255 PHYS_UNIT "Severity+Class" /end CHARACTERISTIC
/begin CHARACTERISTIC FPsvr_RS_loss "FPrm_severity(176)" VALUE 0x00165E8E /* @ECU_Address@FPrm_severity@0x024B30B0@ */ ECIPP_ALIGNMENT_UBYTE 255 Compu_IDENTITY 0 255 PHYS_UNIT "Severity+Class" /end CHARACTERISTIC
/begin CHARACTERISTIC FPsvr_RS_loV "FPrm_severity(452)" VALUE 0x00165FA2 /* @ECU_Address@FPrm_severity@0x024B31C4@ */ ECIPP_ALIGNMENT_UBYTE 255 Compu_IDENTITY 0 255 PHYS_UNIT "Severity+Class" /end CHARACTERISTIC
/begin CHARACTERISTIC FPsvr_RS485_bad_fmt "FPrm_severity(83)" VALUE 0x00165E31 /* @ECU_Address@FPrm_severity@0x024B3053@ */ ECIPP_ALIGNMENT_UBYTE 255 Compu_IDENTITY 0 255 PHYS_UNIT "Severity+Class" /end CHARACTERISTIC
/begin CHARACTERISTIC FPsvr_RS485_Rx_inact "FPrm_severity(81)" VALUE 0x00165E2F /* @ECU_Address@FPrm_severity@0x024B3051@ */ ECIPP_ALIGNMENT_UBYTE 255 Compu_IDENTITY 0 255 PHYS_UNIT "Severity+Class" /end CHARACTERISTIC
/begin CHARACTERISTIC FPsvr_RS485_Rx_noise "FPrm_severity(82)" VALUE 0x00165E30 /* @ECU_Address@FPrm_severity@0x024B3052@ */ ECIPP_ALIGNMENT_UBYTE 255 Compu_IDENTITY 0 255 PHYS_UNIT "Severity+Class" /end CHARACTERISTIC
/begin CHARACTERISTIC FPsvr_RS485_SD_rq "FPrm_severity(84)" VALUE 0x00165E32 /* @ECU_Address@FPrm_severity@0x024B3054@ */ ECIPP_ALIGNMENT_UBYTE 255 Compu_IDENTITY 0 255 PHYS_UNIT "Severity+Class" /end CHARACTERISTIC
/begin CHARACTERISTIC FPsvr_RTI1 "FPrm_severity(64)" VALUE 0x00165E1E /* @ECU_Address@FPrm_severity@0x024B3040@ */ ECIPP_ALIGNMENT_UBYTE 255 Compu_IDENTITY 0 255 PHYS_UNIT "Severity+Class" /end CHARACTERISTIC
/begin CHARACTERISTIC FPsvr_RTI2 "FPrm_severity(65)" VALUE 0x00165E1F /* @ECU_Address@FPrm_severity@0x024B3041@ */ ECIPP_ALIGNMENT_UBYTE 255 Compu_IDENTITY 0 255 PHYS_UNIT "Severity+Class" /end CHARACTERISTIC
/begin CHARACTERISTIC FPsvr_RTI3 "FPrm_severity(66)" VALUE 0x00165E20 /* @ECU_Address@FPrm_severity@0x024B3042@ */ ECIPP_ALIGNMENT_UBYTE 255 Compu_IDENTITY 0 255 PHYS_UNIT "Severity+Class" /end CHARACTERISTIC
/begin CHARACTERISTIC FPsvr_SHIFT_FB_OOR "FPrm_severity(216)" VALUE 0x00165EB6 /* @ECU_Address@FPrm_severity@0x024B30D8@ */ ECIPP_ALIGNMENT_UBYTE 255 Compu_IDENTITY 0 255 PHYS_UNIT "Severity+Class" /end CHARACTERISTIC
/begin CHARACTERISTIC FPsvr_SHIFT_intcirc_fail "FPrm_severity(218)" VALUE 0x00165EB8 /* @ECU_Address@FPrm_severity@0x024B30DA@ */ ECIPP_ALIGNMENT_UBYTE 255 Compu_IDENTITY 0 255 PHYS_UNIT "Severity+Class" /end CHARACTERISTIC
/begin CHARACTERISTIC FPsvr_SHIFT_shift_fail "FPrm_severity(217)" VALUE 0x00165EB7 /* @ECU_Address@FPrm_severity@0x024B30D9@ */ ECIPP_ALIGNMENT_UBYTE 255 Compu_IDENTITY 0 255 PHYS_UNIT "Severity+Class" /end CHARACTERISTIC
/begin CHARACTERISTIC FPsvr_SL_fuel "FPrm_severity(38)" VALUE 0x00165E04 /* @ECU_Address@FPrm_severity@0x024B3026@ */ ECIPP_ALIGNMENT_UBYTE 255 Compu_IDENTITY 0 255 PHYS_UNIT "Severity+Class" /end CHARACTERISTIC
/begin CHARACTERISTIC FPsvr_SL_gov "FPrm_severity(37)" VALUE 0x00165E03 /* @ECU_Address@FPrm_severity@0x024B3025@ */ ECIPP_ALIGNMENT_UBYTE 255 Compu_IDENTITY 0 255 PHYS_UNIT "Severity+Class" /end CHARACTERISTIC
/begin CHARACTERISTIC FPsvr_SL_spk "FPrm_severity(39)" VALUE 0x00165E05 /* @ECU_Address@FPrm_severity@0x024B3027@ */ ECIPP_ALIGNMENT_UBYTE 255 Compu_IDENTITY 0 255 PHYS_UNIT "Severity+Class" /end CHARACTERISTIC
/begin CHARACTERISTIC FPsvr_slv_MAP_hi_OOA "FPrm_severity(664)" VALUE 0x00166076 /* @ECU_Address@FPrm_severity@0x024B3298@ */ ECIPP_ALIGNMENT_UBYTE 255 Compu_IDENTITY 0 255 PHYS_UNIT "Severity+Class" /end CHARACTERISTIC
/begin CHARACTERISTIC FPsvr_slv_MAP_lo_OOA "FPrm_severity(665)" VALUE 0x00166077 /* @ECU_Address@FPrm_severity@0x024B3299@ */ ECIPP_ALIGNMENT_UBYTE 255 Compu_IDENTITY 0 255 PHYS_UNIT "Severity+Class" /end CHARACTERISTIC
/begin CHARACTERISTIC FPsvr_SPK_int_fail "FPrm_severity(225)" VALUE 0x00165EBF /* @ECU_Address@FPrm_severity@0x024B30E1@ */ ECIPP_ALIGNMENT_UBYTE 255 Compu_IDENTITY 0 255 PHYS_UNIT "Severity+Class" /end CHARACTERISTIC
/begin CHARACTERISTIC FPsvr_SPK1_IGBT_T "FPrm_severity(388)" VALUE 0x00165F62 /* @ECU_Address@FPrm_severity@0x024B3184@ */ ECIPP_ALIGNMENT_UBYTE 255 Compu_IDENTITY 0 255 PHYS_UNIT "Severity+Class" /end CHARACTERISTIC
/begin CHARACTERISTIC FPsvr_SPKD_coil_fail "FPrm_severity(226)" VALUE 0x00165EC0 /* @ECU_Address@FPrm_severity@0x024B30E2@ */ ECIPP_ALIGNMENT_UBYTE 255 Compu_IDENTITY 0 255 PHYS_UNIT "Severity+Class" /end CHARACTERISTIC
/begin CHARACTERISTIC FPsvr_SPKD_dw_hi "FPrm_severity(56)" VALUE 0x00165E16 /* @ECU_Address@FPrm_severity@0x024B3038@ */ ECIPP_ALIGNMENT_UBYTE 255 Compu_IDENTITY 0 255 PHYS_UNIT "Severity+Class" /end CHARACTERISTIC
/begin CHARACTERISTIC FPsvr_SPKD_dw_lo "FPrm_severity(55)" VALUE 0x00165E15 /* @ECU_Address@FPrm_severity@0x024B3037@ */ ECIPP_ALIGNMENT_UBYTE 255 Compu_IDENTITY 0 255 PHYS_UNIT "Severity+Class" /end CHARACTERISTIC
/begin CHARACTERISTIC FPsvr_SRVC_expired "FPrm_severity(323)" VALUE 0x00165F21 /* @ECU_Address@FPrm_severity@0x024B3143@ */ ECIPP_ALIGNMENT_UBYTE 255 Compu_IDENTITY 0 255 PHYS_UNIT "Severity+Class" /end CHARACTERISTIC
/begin CHARACTERISTIC FPsvr_SRVC_expired2 "FPrm_severity(663)" VALUE 0x00166075 /* @ECU_Address@FPrm_severity@0x024B3297@ */ ECIPP_ALIGNMENT_UBYTE 255 Compu_IDENTITY 0 255 PHYS_UNIT "Severity+Class" /end CHARACTERISTIC
/begin CHARACTERISTIC FPsvr_start_coilopen "FPrm_severity(122)" VALUE 0x00165E58 /* @ECU_Address@FPrm_severity@0x024B307A@ */ ECIPP_ALIGNMENT_UBYTE 255 Compu_IDENTITY 0 255 PHYS_UNIT "Severity+Class" /end CHARACTERISTIC
/begin CHARACTERISTIC FPsvr_start_coilshort "FPrm_severity(123)" VALUE 0x00165E59 /* @ECU_Address@FPrm_severity@0x024B307B@ */ ECIPP_ALIGNMENT_UBYTE 255 Compu_IDENTITY 0 255 PHYS_UNIT "Severity+Class" /end CHARACTERISTIC
/begin CHARACTERISTIC FPsvr_start_excess "FPrm_severity(667)" VALUE 0x00166079 /* @ECU_Address@FPrm_severity@0x024B329B@ */ ECIPP_ALIGNMENT_UBYTE 255 Compu_IDENTITY 0 255 PHYS_UNIT "Severity+Class" /end CHARACTERISTIC
/begin CHARACTERISTIC FPsvr_start_gndshort "FPrm_severity(121)" VALUE 0x00165E57 /* @ECU_Address@FPrm_severity@0x024B3079@ */ ECIPP_ALIGNMENT_UBYTE 255 Compu_IDENTITY 0 255 PHYS_UNIT "Severity+Class" /end CHARACTERISTIC
/begin CHARACTERISTIC FPsvr_start_stuck_active "FPrm_severity(229)" VALUE 0x00165EC3 /* @ECU_Address@FPrm_severity@0x024B30E5@ */ ECIPP_ALIGNMENT_UBYTE 255 Compu_IDENTITY 0 255 PHYS_UNIT "Severity+Class" /end CHARACTERISTIC
/begin CHARACTERISTIC FPsvr_SubDiagTemp "FPrm_severity(483)" VALUE 0x00165FC1 /* @ECU_Address@FPrm_severity@0x024B31E3@ */ ECIPP_ALIGNMENT_UBYTE 255 Compu_IDENTITY 0 255 PHYS_UNIT "Severity+Class" /end CHARACTERISTIC
/begin CHARACTERISTIC FPsvr_tach_gndshort "FPrm_severity(133)" VALUE 0x00165E63 /* @ECU_Address@FPrm_severity@0x024B3085@ */ ECIPP_ALIGNMENT_UBYTE 255 Compu_IDENTITY 0 255 PHYS_UNIT "Severity+Class" /end CHARACTERISTIC
/begin CHARACTERISTIC FPsvr_tach_pwrshort "FPrm_severity(134)" VALUE 0x00165E64 /* @ECU_Address@FPrm_severity@0x024B3086@ */ ECIPP_ALIGNMENT_UBYTE 255 Compu_IDENTITY 0 255 PHYS_UNIT "Severity+Class" /end CHARACTERISTIC
/begin CHARACTERISTIC FPsvr_TAUX_dT1_max "FPrm_severity(428)" VALUE 0x00165F8A /* @ECU_Address@FPrm_severity@0x024B31AC@ */ ECIPP_ALIGNMENT_UBYTE 255 Compu_IDENTITY 0 255 PHYS_UNIT "Severity+Class" /end CHARACTERISTIC
/begin CHARACTERISTIC FPsvr_TAUX_dT1_min "FPrm_severity(429)" VALUE 0x00165F8B /* @ECU_Address@FPrm_severity@0x024B31AD@ */ ECIPP_ALIGNMENT_UBYTE 255 Compu_IDENTITY 0 255 PHYS_UNIT "Severity+Class" /end CHARACTERISTIC
/begin CHARACTERISTIC FPsvr_TAUX_dT2_max "FPrm_severity(430)" VALUE 0x00165F8C /* @ECU_Address@FPrm_severity@0x024B31AE@ */ ECIPP_ALIGNMENT_UBYTE 255 Compu_IDENTITY 0 255 PHYS_UNIT "Severity+Class" /end CHARACTERISTIC
/begin CHARACTERISTIC FPsvr_TAUX_dT2_min "FPrm_severity(431)" VALUE 0x00165F8D /* @ECU_Address@FPrm_severity@0x024B31AF@ */ ECIPP_ALIGNMENT_UBYTE 255 Compu_IDENTITY 0 255 PHYS_UNIT "Severity+Class" /end CHARACTERISTIC
/begin CHARACTERISTIC FPsvr_Taux1_derate_actv "FPrm_severity(639)" VALUE 0x0016605D /* @ECU_Address@FPrm_severity@0x024B327F@ */ ECIPP_ALIGNMENT_UBYTE 255 Compu_IDENTITY 0 255 PHYS_UNIT "Severity+Class" /end CHARACTERISTIC
/begin CHARACTERISTIC FPsvr_TAUX1_max "FPrm_severity(420)" VALUE 0x00165F82 /* @ECU_Address@FPrm_severity@0x024B31A4@ */ ECIPP_ALIGNMENT_UBYTE 255 Compu_IDENTITY 0 255 PHYS_UNIT "Severity+Class" /end CHARACTERISTIC
/begin CHARACTERISTIC FPsvr_TAUX1_min "FPrm_severity(421)" VALUE 0x00165F83 /* @ECU_Address@FPrm_severity@0x024B31A5@ */ ECIPP_ALIGNMENT_UBYTE 255 Compu_IDENTITY 0 255 PHYS_UNIT "Severity+Class" /end CHARACTERISTIC
/begin CHARACTERISTIC FPsvr_Taux2_derate_actv "FPrm_severity(640)" VALUE 0x0016605E /* @ECU_Address@FPrm_severity@0x024B3280@ */ ECIPP_ALIGNMENT_UBYTE 255 Compu_IDENTITY 0 255 PHYS_UNIT "Severity+Class" /end CHARACTERISTIC
/begin CHARACTERISTIC FPsw_ext1_PWM21_on_hiVf "FPrm_switches_ext1(353)" VALUE 0x00147100 /* @ECU_Address@FPrm_switches_ext1@0x023A52C2@ */ ECIPP_ALIGNMENT_UWORD 65535 Compu_IDENTITY 0 65535 PHYS_UNIT "Enable bits" /end CHARACTERISTIC
/begin CHARACTERISTIC FPsw_ext1_PWM22_off_loVf "FPrm_switches_ext1(354)" VALUE 0x00147102 /* @ECU_Address@FPrm_switches_ext1@0x023A52C4@ */ ECIPP_ALIGNMENT_UWORD 65535 Compu_IDENTITY 0 65535 PHYS_UNIT "Enable bits" /end CHARACTERISTIC
/begin CHARACTERISTIC FPsw_ext1_PWM22_on_hiVf "FPrm_switches_ext1(355)" VALUE 0x00147104 /* @ECU_Address@FPrm_switches_ext1@0x023A52C6@ */ ECIPP_ALIGNMENT_UWORD 65535 Compu_IDENTITY 0 65535 PHYS_UNIT "Enable bits" /end CHARACTERISTIC
/begin CHARACTERISTIC FPsw_ext1_PWM23_off_loVf "FPrm_switches_ext1(356)" VALUE 0x00147106 /* @ECU_Address@FPrm_switches_ext1@0x023A52C8@ */ ECIPP_ALIGNMENT_UWORD 65535 Compu_IDENTITY 0 65535 PHYS_UNIT "Enable bits" /end CHARACTERISTIC
/begin CHARACTERISTIC FPsw_ext1_PWM23_on_hiVf "FPrm_switches_ext1(357)" VALUE 0x00147108 /* @ECU_Address@FPrm_switches_ext1@0x023A52CA@ */ ECIPP_ALIGNMENT_UWORD 65535 Compu_IDENTITY 0 65535 PHYS_UNIT "Enable bits" /end CHARACTERISTIC
/begin CHARACTERISTIC FPsw_ext1_PWM3_off_loVf "FPrm_switches_ext1(151)" VALUE 0x00146F6C /* @ECU_Address@FPrm_switches_ext1@0x023A512E@ */ ECIPP_ALIGNMENT_UWORD 65535 Compu_IDENTITY 0 65535 PHYS_UNIT "Enable bits" /end CHARACTERISTIC
/begin CHARACTERISTIC FPsw_ext1_PWM3_on_hiVf "FPrm_switches_ext1(152)" VALUE 0x00146F6E /* @ECU_Address@FPrm_switches_ext1@0x023A5130@ */ ECIPP_ALIGNMENT_UWORD 65535 Compu_IDENTITY 0 65535 PHYS_UNIT "Enable bits" /end CHARACTERISTIC
/begin CHARACTERISTIC FPsw_ext1_PWM4_off_loVf "FPrm_switches_ext1(153)" VALUE 0x00146F70 /* @ECU_Address@FPrm_switches_ext1@0x023A5132@ */ ECIPP_ALIGNMENT_UWORD 65535 Compu_IDENTITY 0 65535 PHYS_UNIT "Enable bits" /end CHARACTERISTIC
/begin CHARACTERISTIC FPsw_ext1_PWM4_on_hiVf "FPrm_switches_ext1(154)" VALUE 0x00146F72 /* @ECU_Address@FPrm_switches_ext1@0x023A5134@ */ ECIPP_ALIGNMENT_UWORD 65535 Compu_IDENTITY 0 65535 PHYS_UNIT "Enable bits" /end CHARACTERISTIC
/begin CHARACTERISTIC FPsw_ext1_PWM5_off_loVf "FPrm_switches_ext1(155)" VALUE 0x00146F74 /* @ECU_Address@FPrm_switches_ext1@0x023A5136@ */ ECIPP_ALIGNMENT_UWORD 65535 Compu_IDENTITY 0 65535 PHYS_UNIT "Enable bits" /end CHARACTERISTIC
/begin CHARACTERISTIC FPsw_ext1_PWM5_on_hiVf "FPrm_switches_ext1(156)" VALUE 0x00146F76 /* @ECU_Address@FPrm_switches_ext1@0x023A5138@ */ ECIPP_ALIGNMENT_UWORD 65535 Compu_IDENTITY 0 65535 PHYS_UNIT "Enable bits" /end CHARACTERISTIC
/begin CHARACTERISTIC FPsw_ext1_PWM6_off_loVf "FPrm_switches_ext1(198)" VALUE 0x00146FCA /* @ECU_Address@FPrm_switches_ext1@0x023A518C@ */ ECIPP_ALIGNMENT_UWORD 65535 Compu_IDENTITY 0 65535 PHYS_UNIT "Enable bits" /end CHARACTERISTIC
/begin CHARACTERISTIC FPsw_ext1_PWM6_on_hiVf "FPrm_switches_ext1(199)" VALUE 0x00146FCC /* @ECU_Address@FPrm_switches_ext1@0x023A518E@ */ ECIPP_ALIGNMENT_UWORD 65535 Compu_IDENTITY 0 65535 PHYS_UNIT "Enable bits" /end CHARACTERISTIC
/begin CHARACTERISTIC FPsw_ext1_PWM7_off_loVf "FPrm_switches_ext1(200)" VALUE 0x00146FCE /* @ECU_Address@FPrm_switches_ext1@0x023A5190@ */ ECIPP_ALIGNMENT_UWORD 65535 Compu_IDENTITY 0 65535 PHYS_UNIT "Enable bits" /end CHARACTERISTIC
/begin CHARACTERISTIC FPsw_ext1_PWM7_on_hiVf "FPrm_switches_ext1(201)" VALUE 0x00146FD0 /* @ECU_Address@FPrm_switches_ext1@0x023A5192@ */ ECIPP_ALIGNMENT_UWORD 65535 Compu_IDENTITY 0 65535 PHYS_UNIT "Enable bits" /end CHARACTERISTIC
/begin CHARACTERISTIC FPsw_ext1_PWM8_off_loVf "FPrm_switches_ext1(205)" VALUE 0x00146FD8 /* @ECU_Address@FPrm_switches_ext1@0x023A519A@ */ ECIPP_ALIGNMENT_UWORD 65535 Compu_IDENTITY 0 65535 PHYS_UNIT "Enable bits" /end CHARACTERISTIC
/begin CHARACTERISTIC FPsw_ext1_PWM8_on_hiVf "FPrm_switches_ext1(206)" VALUE 0x00146FDA /* @ECU_Address@FPrm_switches_ext1@0x023A519C@ */ ECIPP_ALIGNMENT_UWORD 65535 Compu_IDENTITY 0 65535 PHYS_UNIT "Enable bits" /end CHARACTERISTIC
/begin CHARACTERISTIC FPsw_ext1_PWM9_off_loVf "FPrm_switches_ext1(207)" VALUE 0x00146FDC /* @ECU_Address@FPrm_switches_ext1@0x023A519E@ */ ECIPP_ALIGNMENT_UWORD 65535 Compu_IDENTITY 0 65535 PHYS_UNIT "Enable bits" /end CHARACTERISTIC
/begin CHARACTERISTIC FPsw_ext1_PWM9_on_hiVf "FPrm_switches_ext1(208)" VALUE 0x00146FDE /* @ECU_Address@FPrm_switches_ext1@0x023A51A0@ */ ECIPP_ALIGNMENT_UWORD 65535 Compu_IDENTITY 0 65535 PHYS_UNIT "Enable bits" /end CHARACTERISTIC
/begin CHARACTERISTIC FPsw_ext1_PWMLO_off_loVf "FPrm_switches_ext1(391)" VALUE 0x0014714C /* @ECU_Address@FPrm_switches_ext1@0x023A530E@ */ ECIPP_ALIGNMENT_UWORD 65535 Compu_IDENTITY 0 65535 PHYS_UNIT "Enable bits" /end CHARACTERISTIC
/begin CHARACTERISTIC FPsw_ext1_PWMLO_on_hiVf "FPrm_switches_ext1(392)" VALUE 0x0014714E /* @ECU_Address@FPrm_switches_ext1@0x023A5310@ */ ECIPP_ALIGNMENT_UWORD 65535 Compu_IDENTITY 0 65535 PHYS_UNIT "Enable bits" /end CHARACTERISTIC
/begin CHARACTERISTIC FPsw_ext1_RAM_fail "FPrm_switches_ext1(70)" VALUE 0x00146ECA /* @ECU_Address@FPrm_switches_ext1@0x023A508C@ */ ECIPP_ALIGNMENT_UWORD 65535 Compu_IDENTITY 0 65535 PHYS_UNIT "Enable bits" /end CHARACTERISTIC
/begin CHARACTERISTIC FPsw_ext1_relay_coilopen "FPrm_switches_ext1(119)" VALUE 0x00146F2C /* @ECU_Address@FPrm_switches_ext1@0x023A50EE@ */ ECIPP_ALIGNMENT_UWORD 65535 Compu_IDENTITY 0 65535 PHYS_UNIT "Enable bits" /end CHARACTERISTIC
/begin CHARACTERISTIC FPsw_ext1_relay_coilshort "FPrm_switches_ext1(120)" VALUE 0x00146F2E /* @ECU_Address@FPrm_switches_ext1@0x023A50F0@ */ ECIPP_ALIGNMENT_UWORD 65535 Compu_IDENTITY 0 65535 PHYS_UNIT "Enable bits" /end CHARACTERISTIC
/begin CHARACTERISTIC FPsw_ext1_relay_gndshort "FPrm_switches_ext1(118)" VALUE 0x00146F2A /* @ECU_Address@FPrm_switches_ext1@0x023A50EC@ */ ECIPP_ALIGNMENT_UWORD 65535 Compu_IDENTITY 0 65535 PHYS_UNIT "Enable bits" /end CHARACTERISTIC
/begin CHARACTERISTIC FPsw_ext1_relayoff_hiV "FPrm_switches_ext1(328)" VALUE 0x001470CE /* @ECU_Address@FPrm_switches_ext1@0x023A5290@ */ ECIPP_ALIGNMENT_UWORD 65535 Compu_IDENTITY 0 65535 PHYS_UNIT "Enable bits" /end CHARACTERISTIC
/begin CHARACTERISTIC FPsw_ext1_relayon_loV "FPrm_switches_ext1(329)" VALUE 0x001470D0 /* @ECU_Address@FPrm_switches_ext1@0x023A5292@ */ ECIPP_ALIGNMENT_UWORD 65535 Compu_IDENTITY 0 65535 PHYS_UNIT "Enable bits" /end CHARACTERISTIC
/begin CHARACTERISTIC FPsw_ext1_rpm_hi_expected "FPrm_switches_ext1(260)" VALUE 0x00147046 /* @ECU_Address@FPrm_switches_ext1@0x023A5208@ */ ECIPP_ALIGNMENT_UWORD 65535 Compu_IDENTITY 0 65535 PHYS_UNIT "Enable bits" /end CHARACTERISTIC
/begin CHARACTERISTIC FPsw_ext1_rpmd_gov_lo "FPrm_switches_ext1(390)" VALUE 0x0014714A /* @ECU_Address@FPrm_switches_ext1@0x023A530C@ */ ECIPP_ALIGNMENT_UWORD 65535 Compu_IDENTITY 0 65535 PHYS_UNIT "Enable bits" /end CHARACTERISTIC
/begin CHARACTERISTIC FPsw_ext1_RS_discon "FPrm_switches_ext1(521)" VALUE 0x00147250 /* @ECU_Address@FPrm_switches_ext1@0x023A5412@ */ ECIPP_ALIGNMENT_UWORD 65535 Compu_IDENTITY 0 65535 PHYS_UNIT "Enable bits" /end CHARACTERISTIC
/begin CHARACTERISTIC FPsw_ext1_RS_hiV "FPrm_switches_ext1(453)" VALUE 0x001471C8 /* @ECU_Address@FPrm_switches_ext1@0x023A538A@ */ ECIPP_ALIGNMENT_UWORD 65535 Compu_IDENTITY 0 65535 PHYS_UNIT "Enable bits" /end CHARACTERISTIC
/begin CHARACTERISTIC FPsw_ext1_RS_loss "FPrm_switches_ext1(176)" VALUE 0x00146F9E /* @ECU_Address@FPrm_switches_ext1@0x023A5160@ */ ECIPP_ALIGNMENT_UWORD 65535 Compu_IDENTITY 0 65535 PHYS_UNIT "Enable bits" /end CHARACTERISTIC
/begin CHARACTERISTIC FPsw_ext1_RS_loV "FPrm_switches_ext1(452)" VALUE 0x001471C6 /* @ECU_Address@FPrm_switches_ext1@0x023A5388@ */ ECIPP_ALIGNMENT_UWORD 65535 Compu_IDENTITY 0 65535 PHYS_UNIT "Enable bits" /end CHARACTERISTIC
/begin CHARACTERISTIC FPsw_ext1_RS485_bad_fmt "FPrm_switches_ext1(83)" VALUE 0x00146EE4 /* @ECU_Address@FPrm_switches_ext1@0x023A50A6@ */ ECIPP_ALIGNMENT_UWORD 65535 Compu_IDENTITY 0 65535 PHYS_UNIT "Enable bits" /end CHARACTERISTIC
/begin CHARACTERISTIC FPsw_ext1_RS485_Rx_inact "FPrm_switches_ext1(81)" VALUE 0x00146EE0 /* @ECU_Address@FPrm_switches_ext1@0x023A50A2@ */ ECIPP_ALIGNMENT_UWORD 65535 Compu_IDENTITY 0 65535 PHYS_UNIT "Enable bits" /end CHARACTERISTIC
/begin CHARACTERISTIC FPsw_ext1_RS485_Rx_noise "FPrm_switches_ext1(82)" VALUE 0x00146EE2 /* @ECU_Address@FPrm_switches_ext1@0x023A50A4@ */ ECIPP_ALIGNMENT_UWORD 65535 Compu_IDENTITY 0 65535 PHYS_UNIT "Enable bits" /end CHARACTERISTIC
/begin CHARACTERISTIC FPsw_ext1_RS485_SD_rq "FPrm_switches_ext1(84)" VALUE 0x00146EE6 /* @ECU_Address@FPrm_switches_ext1@0x023A50A8@ */ ECIPP_ALIGNMENT_UWORD 65535 Compu_IDENTITY 0 65535 PHYS_UNIT "Enable bits" /end CHARACTERISTIC
/begin CHARACTERISTIC FPsw_ext1_RTI1 "FPrm_switches_ext1(64)" VALUE 0x00146EBE /* @ECU_Address@FPrm_switches_ext1@0x023A5080@ */ ECIPP_ALIGNMENT_UWORD 65535 Compu_IDENTITY 0 65535 PHYS_UNIT "Enable bits" /end CHARACTERISTIC
/begin CHARACTERISTIC FPsw_ext1_RTI2 "FPrm_switches_ext1(65)" VALUE 0x00146EC0 /* @ECU_Address@FPrm_switches_ext1@0x023A5082@ */ ECIPP_ALIGNMENT_UWORD 65535 Compu_IDENTITY 0 65535 PHYS_UNIT "Enable bits" /end CHARACTERISTIC
/begin CHARACTERISTIC FPsw_ext1_RTI3 "FPrm_switches_ext1(66)" VALUE 0x00146EC2 /* @ECU_Address@FPrm_switches_ext1@0x023A5084@ */ ECIPP_ALIGNMENT_UWORD 65535 Compu_IDENTITY 0 65535 PHYS_UNIT "Enable bits" /end CHARACTERISTIC
/begin CHARACTERISTIC FPsw_ext1_SHIFT_FB_OOR "FPrm_switches_ext1(216)" VALUE 0x00146FEE /* @ECU_Address@FPrm_switches_ext1@0x023A51B0@ */ ECIPP_ALIGNMENT_UWORD 65535 Compu_IDENTITY 0 65535 PHYS_UNIT "Enable bits" /end CHARACTERISTIC
/begin CHARACTERISTIC FPsw_ext1_SHIFT_intcirc_fail "FPrm_switches_ext1(218)" VALUE 0x00146FF2 /* @ECU_Address@FPrm_switches_ext1@0x023A51B4@ */ ECIPP_ALIGNMENT_UWORD 65535 Compu_IDENTITY 0 65535 PHYS_UNIT "Enable bits" /end CHARACTERISTIC
/begin CHARACTERISTIC FPsw_ext1_SHIFT_shift_fail "FPrm_switches_ext1(217)" VALUE 0x00146FF0 /* @ECU_Address@FPrm_switches_ext1@0x023A51B2@ */ ECIPP_ALIGNMENT_UWORD 65535 Compu_IDENTITY 0 65535 PHYS_UNIT "Enable bits" /end CHARACTERISTIC
/begin CHARACTERISTIC FPsw_ext1_SL_fuel "FPrm_switches_ext1(38)" VALUE 0x00146E8A /* @ECU_Address@FPrm_switches_ext1@0x023A504C@ */ ECIPP_ALIGNMENT_UWORD 65535 Compu_IDENTITY 0 65535 PHYS_UNIT "Enable bits" /end CHARACTERISTIC
/begin CHARACTERISTIC FPsw_ext1_SL_gov "FPrm_switches_ext1(37)" VALUE 0x00146E88 /* @ECU_Address@FPrm_switches_ext1@0x023A504A@ */ ECIPP_ALIGNMENT_UWORD 65535 Compu_IDENTITY 0 65535 PHYS_UNIT "Enable bits" /end CHARACTERISTIC
/begin CHARACTERISTIC FPsw_ext1_SL_spk "FPrm_switches_ext1(39)" VALUE 0x00146E8C /* @ECU_Address@FPrm_switches_ext1@0x023A504E@ */ ECIPP_ALIGNMENT_UWORD 65535 Compu_IDENTITY 0 65535 PHYS_UNIT "Enable bits" /end CHARACTERISTIC
/begin CHARACTERISTIC FPsw_ext1_slv_MAP_hi_OOA "FPrm_switches_ext1(664)" VALUE 0x0014736E /* @ECU_Address@FPrm_switches_ext1@0x023A5530@ */ ECIPP_ALIGNMENT_UWORD 65535 Compu_IDENTITY 0 65535 PHYS_UNIT "Enable bits" /end CHARACTERISTIC
/begin CHARACTERISTIC FPsw_ext1_slv_MAP_lo_OOA "FPrm_switches_ext1(665)" VALUE 0x00147370 /* @ECU_Address@FPrm_switches_ext1@0x023A5532@ */ ECIPP_ALIGNMENT_UWORD 65535 Compu_IDENTITY 0 65535 PHYS_UNIT "Enable bits" /end CHARACTERISTIC
/begin CHARACTERISTIC FPsw_ext1_SPK_int_fail "FPrm_switches_ext1(225)" VALUE 0x00147000 /* @ECU_Address@FPrm_switches_ext1@0x023A51C2@ */ ECIPP_ALIGNMENT_UWORD 65535 Compu_IDENTITY 0 65535 PHYS_UNIT "Enable bits" /end CHARACTERISTIC
/begin CHARACTERISTIC FPsw_ext1_SPK1_IGBT_T "FPrm_switches_ext1(388)" VALUE 0x00147146 /* @ECU_Address@FPrm_switches_ext1@0x023A5308@ */ ECIPP_ALIGNMENT_UWORD 65535 Compu_IDENTITY 0 65535 PHYS_UNIT "Enable bits" /end CHARACTERISTIC
/begin CHARACTERISTIC FPsw_ext1_SPKD_coil_fail "FPrm_switches_ext1(226)" VALUE 0x00147002 /* @ECU_Address@FPrm_switches_ext1@0x023A51C4@ */ ECIPP_ALIGNMENT_UWORD 65535 Compu_IDENTITY 0 65535 PHYS_UNIT "Enable bits" /end CHARACTERISTIC
/begin CHARACTERISTIC FPsw_ext1_SPKD_dw_hi "FPrm_switches_ext1(56)" VALUE 0x00146EAE /* @ECU_Address@FPrm_switches_ext1@0x023A5070@ */ ECIPP_ALIGNMENT_UWORD 65535 Compu_IDENTITY 0 65535 PHYS_UNIT "Enable bits" /end CHARACTERISTIC
/begin CHARACTERISTIC FPsw_ext1_SPKD_dw_lo "FPrm_switches_ext1(55)" VALUE 0x00146EAC /* @ECU_Address@FPrm_switches_ext1@0x023A506E@ */ ECIPP_ALIGNMENT_UWORD 65535 Compu_IDENTITY 0 65535 PHYS_UNIT "Enable bits" /end CHARACTERISTIC
/begin CHARACTERISTIC FPsw_ext1_SRVC_expired "FPrm_switches_ext1(323)" VALUE 0x001470C4 /* @ECU_Address@FPrm_switches_ext1@0x023A5286@ */ ECIPP_ALIGNMENT_UWORD 65535 Compu_IDENTITY 0 65535 PHYS_UNIT "Enable bits" /end CHARACTERISTIC
/begin CHARACTERISTIC FPsw_ext1_SRVC_expired2 "FPrm_switches_ext1(663)" VALUE 0x0014736C /* @ECU_Address@FPrm_switches_ext1@0x023A552E@ */ ECIPP_ALIGNMENT_UWORD 65535 Compu_IDENTITY 0 65535 PHYS_UNIT "Enable bits" /end CHARACTERISTIC
/begin CHARACTERISTIC FPsw_ext1_start_coilopen "FPrm_switches_ext1(122)" VALUE 0x00146F32 /* @ECU_Address@FPrm_switches_ext1@0x023A50F4@ */ ECIPP_ALIGNMENT_UWORD 65535 Compu_IDENTITY 0 65535 PHYS_UNIT "Enable bits" /end CHARACTERISTIC
/begin CHARACTERISTIC FPsw_ext1_start_coilshort "FPrm_switches_ext1(123)" VALUE 0x00146F34 /* @ECU_Address@FPrm_switches_ext1@0x023A50F6@ */ ECIPP_ALIGNMENT_UWORD 65535 Compu_IDENTITY 0 65535 PHYS_UNIT "Enable bits" /end CHARACTERISTIC
/begin CHARACTERISTIC FPsw_ext1_start_excess "FPrm_switches_ext1(667)" VALUE 0x00147374 /* @ECU_Address@FPrm_switches_ext1@0x023A5536@ */ ECIPP_ALIGNMENT_UWORD 65535 Compu_IDENTITY 0 65535 PHYS_UNIT "Enable bits" /end CHARACTERISTIC
/begin CHARACTERISTIC FPsw_ext1_start_gndshort "FPrm_switches_ext1(121)" VALUE 0x00146F30 /* @ECU_Address@FPrm_switches_ext1@0x023A50F2@ */ ECIPP_ALIGNMENT_UWORD 65535 Compu_IDENTITY 0 65535 PHYS_UNIT "Enable bits" /end CHARACTERISTIC
/begin CHARACTERISTIC FPsw_ext1_start_stuck_active "FPrm_switches_ext1(229)" VALUE 0x00147008 /* @ECU_Address@FPrm_switches_ext1@0x023A51CA@ */ ECIPP_ALIGNMENT_UWORD 65535 Compu_IDENTITY 0 65535 PHYS_UNIT "Enable bits" /end CHARACTERISTIC
/begin CHARACTERISTIC FPsw_ext1_SubDiagTemp "FPrm_switches_ext1(483)" VALUE 0x00147204 /* @ECU_Address@FPrm_switches_ext1@0x023A53C6@ */ ECIPP_ALIGNMENT_UWORD 65535 Compu_IDENTITY 0 65535 PHYS_UNIT "Enable bits" /end CHARACTERISTIC
/begin CHARACTERISTIC FPsw_ext1_tach_gndshort "FPrm_switches_ext1(133)" VALUE 0x00146F48 /* @ECU_Address@FPrm_switches_ext1@0x023A510A@ */ ECIPP_ALIGNMENT_UWORD 65535 Compu_IDENTITY 0 65535 PHYS_UNIT "Enable bits" /end CHARACTERISTIC
/begin CHARACTERISTIC FPsw_ext1_tach_pwrshort "FPrm_switches_ext1(134)" VALUE 0x00146F4A /* @ECU_Address@FPrm_switches_ext1@0x023A510C@ */ ECIPP_ALIGNMENT_UWORD 65535 Compu_IDENTITY 0 65535 PHYS_UNIT "Enable bits" /end CHARACTERISTIC
/begin CHARACTERISTIC FPsw_ext1_TAUX_dT1_max "FPrm_switches_ext1(428)" VALUE 0x00147196 /* @ECU_Address@FPrm_switches_ext1@0x023A5358@ */ ECIPP_ALIGNMENT_UWORD 65535 Compu_IDENTITY 0 65535 PHYS_UNIT "Enable bits" /end CHARACTERISTIC
/begin CHARACTERISTIC FPsw_ext1_TAUX_dT1_min "FPrm_switches_ext1(429)" VALUE 0x00147198 /* @ECU_Address@FPrm_switches_ext1@0x023A535A@ */ ECIPP_ALIGNMENT_UWORD 65535 Compu_IDENTITY 0 65535 PHYS_UNIT "Enable bits" /end CHARACTERISTIC
/begin CHARACTERISTIC FPsw_ext1_TAUX_dT2_max "FPrm_switches_ext1(430)" VALUE 0x0014719A /* @ECU_Address@FPrm_switches_ext1@0x023A535C@ */ ECIPP_ALIGNMENT_UWORD 65535 Compu_IDENTITY 0 65535 PHYS_UNIT "Enable bits" /end CHARACTERISTIC
/begin CHARACTERISTIC FPsw_ext1_TAUX_dT2_min "FPrm_switches_ext1(431)" VALUE 0x0014719C /* @ECU_Address@FPrm_switches_ext1@0x023A535E@ */ ECIPP_ALIGNMENT_UWORD 65535 Compu_IDENTITY 0 65535 PHYS_UNIT "Enable bits" /end CHARACTERISTIC
/begin CHARACTERISTIC FPsw_ext1_Taux1_derate_actv "FPrm_switches_ext1(639)" VALUE 0x0014733C /* @ECU_Address@FPrm_switches_ext1@0x023A54FE@ */ ECIPP_ALIGNMENT_UWORD 65535 Compu_IDENTITY 0 65535 PHYS_UNIT "Enable bits" /end CHARACTERISTIC
/begin CHARACTERISTIC FPsw_ext1_TAUX1_max "FPrm_switches_ext1(420)" VALUE 0x00147186 /* @ECU_Address@FPrm_switches_ext1@0x023A5348@ */ ECIPP_ALIGNMENT_UWORD 65535 Compu_IDENTITY 0 65535 PHYS_UNIT "Enable bits" /end CHARACTERISTIC
/begin CHARACTERISTIC FPsw_ext1_TAUX1_min "FPrm_switches_ext1(421)" VALUE 0x00147188 /* @ECU_Address@FPrm_switches_ext1@0x023A534A@ */ ECIPP_ALIGNMENT_UWORD 65535 Compu_IDENTITY 0 65535 PHYS_UNIT "Enable bits" /end CHARACTERISTIC
/begin CHARACTERISTIC FPsw_ext1_Taux2_derate_actv "FPrm_switches_ext1(640)" VALUE 0x0014733E /* @ECU_Address@FPrm_switches_ext1@0x023A5500@ */ ECIPP_ALIGNMENT_UWORD 65535 Compu_IDENTITY 0 65535 PHYS_UNIT "Enable bits" /end CHARACTERISTIC
/begin CHARACTERISTIC FPsw_PWM21_on_hiVf "FPrm_switches(353)" VALUE 0x00146B9E /* @ECU_Address@FPrm_switches@0x021B92C2@ */ ECIPP_ALIGNMENT_UWORD 65535 Compu_IDENTITY 0 65535 PHYS_UNIT "Enable bits" /end CHARACTERISTIC
/begin CHARACTERISTIC FPsw_PWM22_off_loVf "FPrm_switches(354)" VALUE 0x00146BA0 /* @ECU_Address@FPrm_switches@0x021B92C4@ */ ECIPP_ALIGNMENT_UWORD 65535 Compu_IDENTITY 0 65535 PHYS_UNIT "Enable bits" /end CHARACTERISTIC
/begin CHARACTERISTIC FPsw_PWM22_on_hiVf "FPrm_switches(355)" VALUE 0x00146BA2 /* @ECU_Address@FPrm_switches@0x021B92C6@ */ ECIPP_ALIGNMENT_UWORD 65535 Compu_IDENTITY 0 65535 PHYS_UNIT "Enable bits" /end CHARACTERISTIC
/begin CHARACTERISTIC FPsw_PWM23_off_loVf "FPrm_switches(356)" VALUE 0x00146BA4 /* @ECU_Address@FPrm_switches@0x021B92C8@ */ ECIPP_ALIGNMENT_UWORD 65535 Compu_IDENTITY 0 65535 PHYS_UNIT "Enable bits" /end CHARACTERISTIC
/begin CHARACTERISTIC FPsw_PWM23_on_hiVf "FPrm_switches(357)" VALUE 0x00146BA6 /* @ECU_Address@FPrm_switches@0x021B92CA@ */ ECIPP_ALIGNMENT_UWORD 65535 Compu_IDENTITY 0 65535 PHYS_UNIT "Enable bits" /end CHARACTERISTIC
/begin CHARACTERISTIC FPsw_PWM3_off_loVf "FPrm_switches(151)" VALUE 0x00146A0A /* @ECU_Address@FPrm_switches@0x021B912E@ */ ECIPP_ALIGNMENT_UWORD 65535 Compu_IDENTITY 0 65535 PHYS_UNIT "Enable bits" /end CHARACTERISTIC
/begin CHARACTERISTIC FPsw_PWM3_on_hiVf "FPrm_switches(152)" VALUE 0x00146A0C /* @ECU_Address@FPrm_switches@0x021B9130@ */ ECIPP_ALIGNMENT_UWORD 65535 Compu_IDENTITY 0 65535 PHYS_UNIT "Enable bits" /end CHARACTERISTIC
/begin CHARACTERISTIC FPsw_PWM4_off_loVf "FPrm_switches(153)" VALUE 0x00146A0E /* @ECU_Address@FPrm_switches@0x021B9132@ */ ECIPP_ALIGNMENT_UWORD 65535 Compu_IDENTITY 0 65535 PHYS_UNIT "Enable bits" /end CHARACTERISTIC
/begin CHARACTERISTIC FPsw_PWM4_on_hiVf "FPrm_switches(154)" VALUE 0x00146A10 /* @ECU_Address@FPrm_switches@0x021B9134@ */ ECIPP_ALIGNMENT_UWORD 65535 Compu_IDENTITY 0 65535 PHYS_UNIT "Enable bits" /end CHARACTERISTIC
/begin CHARACTERISTIC FPsw_PWM5_off_loVf "FPrm_switches(155)" VALUE 0x00146A12 /* @ECU_Address@FPrm_switches@0x021B9136@ */ ECIPP_ALIGNMENT_UWORD 65535 Compu_IDENTITY 0 65535 PHYS_UNIT "Enable bits" /end CHARACTERISTIC
/begin CHARACTERISTIC FPsw_PWM5_on_hiVf "FPrm_switches(156)" VALUE 0x00146A14 /* @ECU_Address@FPrm_switches@0x021B9138@ */ ECIPP_ALIGNMENT_UWORD 65535 Compu_IDENTITY 0 65535 PHYS_UNIT "Enable bits" /end CHARACTERISTIC
/begin CHARACTERISTIC FPsw_PWM6_off_loVf "FPrm_switches(198)" VALUE 0x00146A68 /* @ECU_Address@FPrm_switches@0x021B918C@ */ ECIPP_ALIGNMENT_UWORD 65535 Compu_IDENTITY 0 65535 PHYS_UNIT "Enable bits" /end CHARACTERISTIC
/begin CHARACTERISTIC FPsw_PWM6_on_hiVf "FPrm_switches(199)" VALUE 0x00146A6A /* @ECU_Address@FPrm_switches@0x021B918E@ */ ECIPP_ALIGNMENT_UWORD 65535 Compu_IDENTITY 0 65535 PHYS_UNIT "Enable bits" /end CHARACTERISTIC
/begin CHARACTERISTIC FPsw_PWM7_off_loVf "FPrm_switches(200)" VALUE 0x00146A6C /* @ECU_Address@FPrm_switches@0x021B9190@ */ ECIPP_ALIGNMENT_UWORD 65535 Compu_IDENTITY 0 65535 PHYS_UNIT "Enable bits" /end CHARACTERISTIC
/begin CHARACTERISTIC FPsw_PWM7_on_hiVf "FPrm_switches(201)" VALUE 0x00146A6E /* @ECU_Address@FPrm_switches@0x021B9192@ */ ECIPP_ALIGNMENT_UWORD 65535 Compu_IDENTITY 0 65535 PHYS_UNIT "Enable bits" /end CHARACTERISTIC
/begin CHARACTERISTIC FPsw_PWM8_off_loVf "FPrm_switches(205)" VALUE 0x00146A76 /* @ECU_Address@FPrm_switches@0x021B919A@ */ ECIPP_ALIGNMENT_UWORD 65535 Compu_IDENTITY 0 65535 PHYS_UNIT "Enable bits" /end CHARACTERISTIC
/begin CHARACTERISTIC FPsw_PWM8_on_hiVf "FPrm_switches(206)" VALUE 0x00146A78 /* @ECU_Address@FPrm_switches@0x021B919C@ */ ECIPP_ALIGNMENT_UWORD 65535 Compu_IDENTITY 0 65535 PHYS_UNIT "Enable bits" /end CHARACTERISTIC
/begin CHARACTERISTIC FPsw_PWM9_off_loVf "FPrm_switches(207)" VALUE 0x00146A7A /* @ECU_Address@FPrm_switches@0x021B919E@ */ ECIPP_ALIGNMENT_UWORD 65535 Compu_IDENTITY 0 65535 PHYS_UNIT "Enable bits" /end CHARACTERISTIC
/begin CHARACTERISTIC FPsw_PWM9_on_hiVf "FPrm_switches(208)" VALUE 0x00146A7C /* @ECU_Address@FPrm_switches@0x021B91A0@ */ ECIPP_ALIGNMENT_UWORD 65535 Compu_IDENTITY 0 65535 PHYS_UNIT "Enable bits" /end CHARACTERISTIC
/begin CHARACTERISTIC FPsw_PWMLO_off_loVf "FPrm_switches(391)" VALUE 0x00146BEA /* @ECU_Address@FPrm_switches@0x021B930E@ */ ECIPP_ALIGNMENT_UWORD 65535 Compu_IDENTITY 0 65535 PHYS_UNIT "Enable bits" /end CHARACTERISTIC
/begin CHARACTERISTIC FPsw_PWMLO_on_hiVf "FPrm_switches(392)" VALUE 0x00146BEC /* @ECU_Address@FPrm_switches@0x021B9310@ */ ECIPP_ALIGNMENT_UWORD 65535 Compu_IDENTITY 0 65535 PHYS_UNIT "Enable bits" /end CHARACTERISTIC
/begin CHARACTERISTIC FPsw_RAM_fail "FPrm_switches(70)" VALUE 0x00146968 /* @ECU_Address@FPrm_switches@0x021B908C@ */ ECIPP_ALIGNMENT_UWORD 65535 Compu_IDENTITY 0 65535 PHYS_UNIT "Enable bits" /end CHARACTERISTIC
/begin CHARACTERISTIC FPsw_relay_coilopen "FPrm_switches(119)" VALUE 0x001469CA /* @ECU_Address@FPrm_switches@0x021B90EE@ */ ECIPP_ALIGNMENT_UWORD 65535 Compu_IDENTITY 0 65535 PHYS_UNIT "Enable bits" /end CHARACTERISTIC
/begin CHARACTERISTIC FPsw_relay_coilshort "FPrm_switches(120)" VALUE 0x001469CC /* @ECU_Address@FPrm_switches@0x021B90F0@ */ ECIPP_ALIGNMENT_UWORD 65535 Compu_IDENTITY 0 65535 PHYS_UNIT "Enable bits" /end CHARACTERISTIC
/begin CHARACTERISTIC FPsw_relay_gndshort "FPrm_switches(118)" VALUE 0x001469C8 /* @ECU_Address@FPrm_switches@0x021B90EC@ */ ECIPP_ALIGNMENT_UWORD 65535 Compu_IDENTITY 0 65535 PHYS_UNIT "Enable bits" /end CHARACTERISTIC
/begin CHARACTERISTIC FPsw_relayoff_hiV "FPrm_switches(328)" VALUE 0x00146B6C /* @ECU_Address@FPrm_switches@0x021B9290@ */ ECIPP_ALIGNMENT_UWORD 65535 Compu_IDENTITY 0 65535 PHYS_UNIT "Enable bits" /end CHARACTERISTIC
/begin CHARACTERISTIC FPsw_relayon_loV "FPrm_switches(329)" VALUE 0x00146B6E /* @ECU_Address@FPrm_switches@0x021B9292@ */ ECIPP_ALIGNMENT_UWORD 65535 Compu_IDENTITY 0 65535 PHYS_UNIT "Enable bits" /end CHARACTERISTIC
/begin CHARACTERISTIC FPsw_rpm_hi_expected "FPrm_switches(260)" VALUE 0x00146AE4 /* @ECU_Address@FPrm_switches@0x021B9208@ */ ECIPP_ALIGNMENT_UWORD 65535 Compu_IDENTITY 0 65535 PHYS_UNIT "Enable bits" /end CHARACTERISTIC
/begin CHARACTERISTIC FPsw_rpmd_gov_lo "FPrm_switches(390)" VALUE 0x00146BE8 /* @ECU_Address@FPrm_switches@0x021B930C@ */ ECIPP_ALIGNMENT_UWORD 65535 Compu_IDENTITY 0 65535 PHYS_UNIT "Enable bits" /end CHARACTERISTIC
/begin CHARACTERISTIC FPsw_RS_discon "FPrm_switches(521)" VALUE 0x00146CEE /* @ECU_Address@FPrm_switches@0x021B9412@ */ ECIPP_ALIGNMENT_UWORD 65535 Compu_IDENTITY 0 65535 PHYS_UNIT "Enable bits" /end CHARACTERISTIC
/begin CHARACTERISTIC FPsw_RS_hiV "FPrm_switches(453)" VALUE 0x00146C66 /* @ECU_Address@FPrm_switches@0x021B938A@ */ ECIPP_ALIGNMENT_UWORD 65535 Compu_IDENTITY 0 65535 PHYS_UNIT "Enable bits" /end CHARACTERISTIC
/begin CHARACTERISTIC FPsw_RS_loss "FPrm_switches(176)" VALUE 0x00146A3C /* @ECU_Address@FPrm_switches@0x021B9160@ */ ECIPP_ALIGNMENT_UWORD 65535 Compu_IDENTITY 0 65535 PHYS_UNIT "Enable bits" /end CHARACTERISTIC
/begin CHARACTERISTIC FPsw_RS_loV "FPrm_switches(452)" VALUE 0x00146C64 /* @ECU_Address@FPrm_switches@0x021B9388@ */ ECIPP_ALIGNMENT_UWORD 65535 Compu_IDENTITY 0 65535 PHYS_UNIT "Enable bits" /end CHARACTERISTIC
/begin CHARACTERISTIC FPsw_RS485_bad_fmt "FPrm_switches(83)" VALUE 0x00146982 /* @ECU_Address@FPrm_switches@0x021B90A6@ */ ECIPP_ALIGNMENT_UWORD 65535 Compu_IDENTITY 0 65535 PHYS_UNIT "Enable bits" /end CHARACTERISTIC
/begin CHARACTERISTIC FPsw_RS485_Rx_inact "FPrm_switches(81)" VALUE 0x0014697E /* @ECU_Address@FPrm_switches@0x021B90A2@ */ ECIPP_ALIGNMENT_UWORD 65535 Compu_IDENTITY 0 65535 PHYS_UNIT "Enable bits" /end CHARACTERISTIC
/begin CHARACTERISTIC FPsw_RS485_Rx_noise "FPrm_switches(82)" VALUE 0x00146980 /* @ECU_Address@FPrm_switches@0x021B90A4@ */ ECIPP_ALIGNMENT_UWORD 65535 Compu_IDENTITY 0 65535 PHYS_UNIT "Enable bits" /end CHARACTERISTIC
/begin CHARACTERISTIC FPsw_RS485_SD_rq "FPrm_switches(84)" VALUE 0x00146984 /* @ECU_Address@FPrm_switches@0x021B90A8@ */ ECIPP_ALIGNMENT_UWORD 65535 Compu_IDENTITY 0 65535 PHYS_UNIT "Enable bits" /end CHARACTERISTIC
/begin CHARACTERISTIC FPsw_RTI1 "FPrm_switches(64)" VALUE 0x0014695C /* @ECU_Address@FPrm_switches@0x021B9080@ */ ECIPP_ALIGNMENT_UWORD 65535 Compu_IDENTITY 0 65535 PHYS_UNIT "Enable bits" /end CHARACTERISTIC
/begin CHARACTERISTIC FPsw_RTI2 "FPrm_switches(65)" VALUE 0x0014695E /* @ECU_Address@FPrm_switches@0x021B9082@ */ ECIPP_ALIGNMENT_UWORD 65535 Compu_IDENTITY 0 65535 PHYS_UNIT "Enable bits" /end CHARACTERISTIC
/begin CHARACTERISTIC FPsw_RTI3 "FPrm_switches(66)" VALUE 0x00146960 /* @ECU_Address@FPrm_switches@0x021B9084@ */ ECIPP_ALIGNMENT_UWORD 65535 Compu_IDENTITY 0 65535 PHYS_UNIT "Enable bits" /end CHARACTERISTIC
/begin CHARACTERISTIC FPsw_SHIFT_FB_OOR "FPrm_switches(216)" VALUE 0x00146A8C /* @ECU_Address@FPrm_switches@0x021B91B0@ */ ECIPP_ALIGNMENT_UWORD 65535 Compu_IDENTITY 0 65535 PHYS_UNIT "Enable bits" /end CHARACTERISTIC
/begin CHARACTERISTIC FPsw_SHIFT_intcirc_fail "FPrm_switches(218)" VALUE 0x00146A90 /* @ECU_Address@FPrm_switches@0x021B91B4@ */ ECIPP_ALIGNMENT_UWORD 65535 Compu_IDENTITY 0 65535 PHYS_UNIT "Enable bits" /end CHARACTERISTIC
/begin CHARACTERISTIC FPsw_SHIFT_shift_fail "FPrm_switches(217)" VALUE 0x00146A8E /* @ECU_Address@FPrm_switches@0x021B91B2@ */ ECIPP_ALIGNMENT_UWORD 65535 Compu_IDENTITY 0 65535 PHYS_UNIT "Enable bits" /end CHARACTERISTIC
/begin CHARACTERISTIC FPsw_SL_fuel "FPrm_switches(38)" VALUE 0x00146928 /* @ECU_Address@FPrm_switches@0x021B904C@ */ ECIPP_ALIGNMENT_UWORD 65535 Compu_IDENTITY 0 65535 PHYS_UNIT "Enable bits" /end CHARACTERISTIC
/begin CHARACTERISTIC FPsw_SL_gov "FPrm_switches(37)" VALUE 0x00146926 /* @ECU_Address@FPrm_switches@0x021B904A@ */ ECIPP_ALIGNMENT_UWORD 65535 Compu_IDENTITY 0 65535 PHYS_UNIT "Enable bits" /end CHARACTERISTIC
/begin CHARACTERISTIC FPsw_SL_spk "FPrm_switches(39)" VALUE 0x0014692A /* @ECU_Address@FPrm_switches@0x021B904E@ */ ECIPP_ALIGNMENT_UWORD 65535 Compu_IDENTITY 0 65535 PHYS_UNIT "Enable bits" /end CHARACTERISTIC
/begin CHARACTERISTIC FPsw_slv_MAP_hi_OOA "FPrm_switches(664)" VALUE 0x00146E0C /* @ECU_Address@FPrm_switches@0x021B9530@ */ ECIPP_ALIGNMENT_UWORD 65535 Compu_IDENTITY 0 65535 PHYS_UNIT "Enable bits" /end CHARACTERISTIC
/begin CHARACTERISTIC FPsw_slv_MAP_lo_OOA "FPrm_switches(665)" VALUE 0x00146E0E /* @ECU_Address@FPrm_switches@0x021B9532@ */ ECIPP_ALIGNMENT_UWORD 65535 Compu_IDENTITY 0 65535 PHYS_UNIT "Enable bits" /end CHARACTERISTIC
/begin CHARACTERISTIC FPsw_SPK_int_fail "FPrm_switches(225)" VALUE 0x00146A9E /* @ECU_Address@FPrm_switches@0x021B91C2@ */ ECIPP_ALIGNMENT_UWORD 65535 Compu_IDENTITY 0 65535 PHYS_UNIT "Enable bits" /end CHARACTERISTIC
/begin CHARACTERISTIC FPsw_SPK1_IGBT_T "FPrm_switches(388)" VALUE 0x00146BE4 /* @ECU_Address@FPrm_switches@0x021B9308@ */ ECIPP_ALIGNMENT_UWORD 65535 Compu_IDENTITY 0 65535 PHYS_UNIT "Enable bits" /end CHARACTERISTIC
/begin CHARACTERISTIC FPsw_SPKD_coil_fail "FPrm_switches(226)" VALUE 0x00146AA0 /* @ECU_Address@FPrm_switches@0x021B91C4@ */ ECIPP_ALIGNMENT_UWORD 65535 Compu_IDENTITY 0 65535 PHYS_UNIT "Enable bits" /end CHARACTERISTIC
/begin CHARACTERISTIC FPsw_SPKD_dw_hi "FPrm_switches(56)" VALUE 0x0014694C /* @ECU_Address@FPrm_switches@0x021B9070@ */ ECIPP_ALIGNMENT_UWORD 65535 Compu_IDENTITY 0 65535 PHYS_UNIT "Enable bits" /end CHARACTERISTIC
/begin CHARACTERISTIC FPsw_SPKD_dw_lo "FPrm_switches(55)" VALUE 0x0014694A /* @ECU_Address@FPrm_switches@0x021B906E@ */ ECIPP_ALIGNMENT_UWORD 65535 Compu_IDENTITY 0 65535 PHYS_UNIT "Enable bits" /end CHARACTERISTIC
/begin CHARACTERISTIC FPsw_SRVC_expired "FPrm_switches(323)" VALUE 0x00146B62 /* @ECU_Address@FPrm_switches@0x021B9286@ */ ECIPP_ALIGNMENT_UWORD 65535 Compu_IDENTITY 0 65535 PHYS_UNIT "Enable bits" /end CHARACTERISTIC
/begin CHARACTERISTIC FPsw_SRVC_expired2 "FPrm_switches(663)" VALUE 0x00146E0A /* @ECU_Address@FPrm_switches@0x021B952E@ */ ECIPP_ALIGNMENT_UWORD 65535 Compu_IDENTITY 0 65535 PHYS_UNIT "Enable bits" /end CHARACTERISTIC
/begin CHARACTERISTIC FPsw_start_coilopen "FPrm_switches(122)" VALUE 0x001469D0 /* @ECU_Address@FPrm_switches@0x021B90F4@ */ ECIPP_ALIGNMENT_UWORD 65535 Compu_IDENTITY 0 65535 PHYS_UNIT "Enable bits" /end CHARACTERISTIC
/begin CHARACTERISTIC FPsw_start_coilshort "FPrm_switches(123)" VALUE 0x001469D2 /* @ECU_Address@FPrm_switches@0x021B90F6@ */ ECIPP_ALIGNMENT_UWORD 65535 Compu_IDENTITY 0 65535 PHYS_UNIT "Enable bits" /end CHARACTERISTIC
/begin CHARACTERISTIC FPsw_start_excess "FPrm_switches(667)" VALUE 0x00146E12 /* @ECU_Address@FPrm_switches@0x021B9536@ */ ECIPP_ALIGNMENT_UWORD 65535 Compu_IDENTITY 0 65535 PHYS_UNIT "Enable bits" /end CHARACTERISTIC
/begin CHARACTERISTIC FPsw_start_gndshort "FPrm_switches(121)" VALUE 0x001469CE /* @ECU_Address@FPrm_switches@0x021B90F2@ */ ECIPP_ALIGNMENT_UWORD 65535 Compu_IDENTITY 0 65535 PHYS_UNIT "Enable bits" /end CHARACTERISTIC
/begin CHARACTERISTIC FPsw_start_stuck_active "FPrm_switches(229)" VALUE 0x00146AA6 /* @ECU_Address@FPrm_switches@0x021B91CA@ */ ECIPP_ALIGNMENT_UWORD 65535 Compu_IDENTITY 0 65535 PHYS_UNIT "Enable bits" /end CHARACTERISTIC
/begin CHARACTERISTIC FPsw_SubDiagTemp "FPrm_switches(483)" VALUE 0x00146CA2 /* @ECU_Address@FPrm_switches@0x021B93C6@ */ ECIPP_ALIGNMENT_UWORD 65535 Compu_IDENTITY 0 65535 PHYS_UNIT "Enable bits" /end CHARACTERISTIC
/begin CHARACTERISTIC FPsw_tach_gndshort "FPrm_switches(133)" VALUE 0x001469E6 /* @ECU_Address@FPrm_switches@0x021B910A@ */ ECIPP_ALIGNMENT_UWORD 65535 Compu_IDENTITY 0 65535 PHYS_UNIT "Enable bits" /end CHARACTERISTIC
/begin CHARACTERISTIC FPsw_tach_pwrshort "FPrm_switches(134)" VALUE 0x001469E8 /* @ECU_Address@FPrm_switches@0x021B910C@ */ ECIPP_ALIGNMENT_UWORD 65535 Compu_IDENTITY 0 65535 PHYS_UNIT "Enable bits" /end CHARACTERISTIC
/begin CHARACTERISTIC FPsw_TAUX_dT1_max "FPrm_switches(428)" VALUE 0x00146C34 /* @ECU_Address@FPrm_switches@0x021B9358@ */ ECIPP_ALIGNMENT_UWORD 65535 Compu_IDENTITY 0 65535 PHYS_UNIT "Enable bits" /end CHARACTERISTIC
/begin CHARACTERISTIC FPsw_TAUX_dT1_min "FPrm_switches(429)" VALUE 0x00146C36 /* @ECU_Address@FPrm_switches@0x021B935A@ */ ECIPP_ALIGNMENT_UWORD 65535 Compu_IDENTITY 0 65535 PHYS_UNIT "Enable bits" /end CHARACTERISTIC
/begin CHARACTERISTIC FPsw_TAUX_dT2_max "FPrm_switches(430)" VALUE 0x00146C38 /* @ECU_Address@FPrm_switches@0x021B935C@ */ ECIPP_ALIGNMENT_UWORD 65535 Compu_IDENTITY 0 65535 PHYS_UNIT "Enable bits" /end CHARACTERISTIC
/begin CHARACTERISTIC FPsw_TAUX_dT2_min "FPrm_switches(431)" VALUE 0x00146C3A /* @ECU_Address@FPrm_switches@0x021B935E@ */ ECIPP_ALIGNMENT_UWORD 65535 Compu_IDENTITY 0 65535 PHYS_UNIT "Enable bits" /end CHARACTERISTIC
/begin CHARACTERISTIC FPsw_Taux1_derate_actv "FPrm_switches(639)" VALUE 0x00146DDA /* @ECU_Address@FPrm_switches@0x021B94FE@ */ ECIPP_ALIGNMENT_UWORD 65535 Compu_IDENTITY 0 65535 PHYS_UNIT "Enable bits" /end CHARACTERISTIC
/begin CHARACTERISTIC FPsw_TAUX1_max "FPrm_switches(420)" VALUE 0x00146C24 /* @ECU_Address@FPrm_switches@0x021B9348@ */ ECIPP_ALIGNMENT_UWORD 65535 Compu_IDENTITY 0 65535 PHYS_UNIT "Enable bits" /end CHARACTERISTIC
/begin CHARACTERISTIC FPsw_TAUX1_min "FPrm_switches(421)" VALUE 0x00146C26 /* @ECU_Address@FPrm_switches@0x021B934A@ */ ECIPP_ALIGNMENT_UWORD 65535 Compu_IDENTITY 0 65535 PHYS_UNIT "Enable bits" /end CHARACTERISTIC
/begin CHARACTERISTIC FPsw_Taux2_derate_actv "FPrm_switches(640)" VALUE 0x00146DDC /* @ECU_Address@FPrm_switches@0x021B9500@ */ ECIPP_ALIGNMENT_UWORD 65535 Compu_IDENTITY 0 65535 PHYS_UNIT "Enable bits" /end CHARACTERISTIC
/begin CHARACTERISTIC FCdtc_PWM21_on_hiVf "FCtl_DTC(456)" VALUE 0x001638A4 /* @ECU_Address@FCtl_DTC@0x021B5390@ */ ECIPP_ALIGNMENT_UWORD 65535 Compu_IDENTITY 0 65535 PHYS_UNIT "DTC" /end CHARACTERISTIC
/begin CHARACTERISTIC FCdtc_PWM22_off_loVf "FCtl_DTC(457)" VALUE 0x001638A6 /* @ECU_Address@FCtl_DTC@0x021B5392@ */ ECIPP_ALIGNMENT_UWORD 65535 Compu_IDENTITY 0 65535 PHYS_UNIT "DTC" /end CHARACTERISTIC
/begin CHARACTERISTIC FCdtc_PWM22_on_hiVf "FCtl_DTC(458)" VALUE 0x001638A8 /* @ECU_Address@FCtl_DTC@0x021B5394@ */ ECIPP_ALIGNMENT_UWORD 65535 Compu_IDENTITY 0 65535 PHYS_UNIT "DTC" /end CHARACTERISTIC
/begin CHARACTERISTIC FCdtc_PWM23_off_loVf "FCtl_DTC(459)" VALUE 0x001638AA /* @ECU_Address@FCtl_DTC@0x021B5396@ */ ECIPP_ALIGNMENT_UWORD 65535 Compu_IDENTITY 0 65535 PHYS_UNIT "DTC" /end CHARACTERISTIC
/begin CHARACTERISTIC FCdtc_PWM23_on_hiVf "FCtl_DTC(460)" VALUE 0x001638AC /* @ECU_Address@FCtl_DTC@0x021B5398@ */ ECIPP_ALIGNMENT_UWORD 65535 Compu_IDENTITY 0 65535 PHYS_UNIT "DTC" /end CHARACTERISTIC
/begin CHARACTERISTIC FCdtc_PWM3_off_loVf "FCtl_DTC(193)" VALUE 0x00163696 /* @ECU_Address@FCtl_DTC@0x021B5182@ */ ECIPP_ALIGNMENT_UWORD 65535 Compu_IDENTITY 0 65535 PHYS_UNIT "DTC" /end CHARACTERISTIC
/begin CHARACTERISTIC FCdtc_PWM3_on_hiVf "FCtl_DTC(194)" VALUE 0x00163698 /* @ECU_Address@FCtl_DTC@0x021B5184@ */ ECIPP_ALIGNMENT_UWORD 65535 Compu_IDENTITY 0 65535 PHYS_UNIT "DTC" /end CHARACTERISTIC
/begin CHARACTERISTIC FCdtc_PWM4_off_loVf "FCtl_DTC(195)" VALUE 0x0016369A /* @ECU_Address@FCtl_DTC@0x021B5186@ */ ECIPP_ALIGNMENT_UWORD 65535 Compu_IDENTITY 0 65535 PHYS_UNIT "DTC" /end CHARACTERISTIC
/begin CHARACTERISTIC FCdtc_PWM4_on_hiVf "FCtl_DTC(196)" VALUE 0x0016369C /* @ECU_Address@FCtl_DTC@0x021B5188@ */ ECIPP_ALIGNMENT_UWORD 65535 Compu_IDENTITY 0 65535 PHYS_UNIT "DTC" /end CHARACTERISTIC
/begin CHARACTERISTIC FCdtc_PWM5_off_loVf "FCtl_DTC(197)" VALUE 0x0016369E /* @ECU_Address@FCtl_DTC@0x021B518A@ */ ECIPP_ALIGNMENT_UWORD 65535 Compu_IDENTITY 0 65535 PHYS_UNIT "DTC" /end CHARACTERISTIC
/begin CHARACTERISTIC FCdtc_PWM5_on_hiVf "FCtl_DTC(198)" VALUE 0x001636A0 /* @ECU_Address@FCtl_DTC@0x021B518C@ */ ECIPP_ALIGNMENT_UWORD 65535 Compu_IDENTITY 0 65535 PHYS_UNIT "DTC" /end CHARACTERISTIC
/begin CHARACTERISTIC FCdtc_PWM6_off_loVf "FCtl_DTC(276)" VALUE 0x0016373C /* @ECU_Address@FCtl_DTC@0x021B5228@ */ ECIPP_ALIGNMENT_UWORD 65535 Compu_IDENTITY 0 65535 PHYS_UNIT "DTC" /end CHARACTERISTIC
/begin CHARACTERISTIC FCdtc_PWM6_on_hiVf "FCtl_DTC(277)" VALUE 0x0016373E /* @ECU_Address@FCtl_DTC@0x021B522A@ */ ECIPP_ALIGNMENT_UWORD 65535 Compu_IDENTITY 0 65535 PHYS_UNIT "DTC" /end CHARACTERISTIC
/begin CHARACTERISTIC FCdtc_PWM7_off_loVf "FCtl_DTC(278)" VALUE 0x00163740 /* @ECU_Address@FCtl_DTC@0x021B522C@ */ ECIPP_ALIGNMENT_UWORD 65535 Compu_IDENTITY 0 65535 PHYS_UNIT "DTC" /end CHARACTERISTIC
/begin CHARACTERISTIC FCdtc_PWM7_on_hiVf "FCtl_DTC(279)" VALUE 0x00163742 /* @ECU_Address@FCtl_DTC@0x021B522E@ */ ECIPP_ALIGNMENT_UWORD 65535 Compu_IDENTITY 0 65535 PHYS_UNIT "DTC" /end CHARACTERISTIC
/begin CHARACTERISTIC FCdtc_PWM8_off_loVf "FCtl_DTC(283)" VALUE 0x0016374A /* @ECU_Address@FCtl_DTC@0x021B5236@ */ ECIPP_ALIGNMENT_UWORD 65535 Compu_IDENTITY 0 65535 PHYS_UNIT "DTC" /end CHARACTERISTIC
/begin CHARACTERISTIC FCdtc_PWM8_on_hiVf "FCtl_DTC(284)" VALUE 0x0016374C /* @ECU_Address@FCtl_DTC@0x021B5238@ */ ECIPP_ALIGNMENT_UWORD 65535 Compu_IDENTITY 0 65535 PHYS_UNIT "DTC" /end CHARACTERISTIC
/begin CHARACTERISTIC FCdtc_PWM9_off_loVf "FCtl_DTC(285)" VALUE 0x0016374E /* @ECU_Address@FCtl_DTC@0x021B523A@ */ ECIPP_ALIGNMENT_UWORD 65535 Compu_IDENTITY 0 65535 PHYS_UNIT "DTC" /end CHARACTERISTIC
/begin CHARACTERISTIC FCdtc_PWM9_on_hiVf "FCtl_DTC(286)" VALUE 0x00163750 /* @ECU_Address@FCtl_DTC@0x021B523C@ */ ECIPP_ALIGNMENT_UWORD 65535 Compu_IDENTITY 0 65535 PHYS_UNIT "DTC" /end CHARACTERISTIC
/begin CHARACTERISTIC FCdtc_PWMLO_off_loVf "FCtl_DTC(521)" VALUE 0x00163926 /* @ECU_Address@FCtl_DTC@0x021B5412@ */ ECIPP_ALIGNMENT_UWORD 65535 Compu_IDENTITY 0 65535 PHYS_UNIT "DTC" /end CHARACTERISTIC
/begin CHARACTERISTIC FCdtc_PWMLO_on_hiVf "FCtl_DTC(522)" VALUE 0x00163928 /* @ECU_Address@FCtl_DTC@0x021B5414@ */ ECIPP_ALIGNMENT_UWORD 65535 Compu_IDENTITY 0 65535 PHYS_UNIT "DTC" /end CHARACTERISTIC
/begin CHARACTERISTIC FCdtc_RAM_fail "FCtl_DTC(106)" VALUE 0x001635E8 /* @ECU_Address@FCtl_DTC@0x021B50D4@ */ ECIPP_ALIGNMENT_UWORD 65535 Compu_IDENTITY 0 65535 PHYS_UNIT "DTC" /end CHARACTERISTIC
/begin CHARACTERISTIC FCdtc_relay_coilopen "FCtl_DTC(159)" VALUE 0x00163652 /* @ECU_Address@FCtl_DTC@0x021B513E@ */ ECIPP_ALIGNMENT_UWORD 65535 Compu_IDENTITY 0 65535 PHYS_UNIT "DTC" /end CHARACTERISTIC
/begin CHARACTERISTIC FCdtc_relay_coilshort "FCtl_DTC(160)" VALUE 0x00163654 /* @ECU_Address@FCtl_DTC@0x021B5140@ */ ECIPP_ALIGNMENT_UWORD 65535 Compu_IDENTITY 0 65535 PHYS_UNIT "DTC" /end CHARACTERISTIC
/begin CHARACTERISTIC FCdtc_relay_gndshort "FCtl_DTC(158)" VALUE 0x00163650 /* @ECU_Address@FCtl_DTC@0x021B513C@ */ ECIPP_ALIGNMENT_UWORD 65535 Compu_IDENTITY 0 65535 PHYS_UNIT "DTC" /end CHARACTERISTIC
/begin CHARACTERISTIC FCdtc_relayoff_hiV "FCtl_DTC(431)" VALUE 0x00163872 /* @ECU_Address@FCtl_DTC@0x021B535E@ */ ECIPP_ALIGNMENT_UWORD 65535 Compu_IDENTITY 0 65535 PHYS_UNIT "DTC" /end CHARACTERISTIC
/begin CHARACTERISTIC FCdtc_relayon_loV "FCtl_DTC(432)" VALUE 0x00163874 /* @ECU_Address@FCtl_DTC@0x021B5360@ */ ECIPP_ALIGNMENT_UWORD 65535 Compu_IDENTITY 0 65535 PHYS_UNIT "DTC" /end CHARACTERISTIC
/begin CHARACTERISTIC FCdtc_rpm_hi_expected "FCtl_DTC(351)" VALUE 0x001637D2 /* @ECU_Address@FCtl_DTC@0x021B52BE@ */ ECIPP_ALIGNMENT_UWORD 65535 Compu_IDENTITY 0 65535 PHYS_UNIT "DTC" /end CHARACTERISTIC
/begin CHARACTERISTIC FCdtc_rpmd_gov_lo "FCtl_DTC(520)" VALUE 0x00163924 /* @ECU_Address@FCtl_DTC@0x021B5410@ */ ECIPP_ALIGNMENT_UWORD 65535 Compu_IDENTITY 0 65535 PHYS_UNIT "DTC" /end CHARACTERISTIC
/begin CHARACTERISTIC FCdtc_RS_discon "FCtl_DTC(691)" VALUE 0x00163A7A /* @ECU_Address@FCtl_DTC@0x021B5566@ */ ECIPP_ALIGNMENT_UWORD 65535 Compu_IDENTITY 0 65535 PHYS_UNIT "DTC" /end CHARACTERISTIC
/begin CHARACTERISTIC FCdtc_RS_hiV "FCtl_DTC(599)" VALUE 0x001639C2 /* @ECU_Address@FCtl_DTC@0x021B54AE@ */ ECIPP_ALIGNMENT_UWORD 65535 Compu_IDENTITY 0 65535 PHYS_UNIT "DTC" /end CHARACTERISTIC
/begin CHARACTERISTIC FCdtc_RS_loss "FCtl_DTC(220)" VALUE 0x001636CC /* @ECU_Address@FCtl_DTC@0x021B51B8@ */ ECIPP_ALIGNMENT_UWORD 65535 Compu_IDENTITY 0 65535 PHYS_UNIT "DTC" /end CHARACTERISTIC
/begin CHARACTERISTIC FCdtc_RS_loV "FCtl_DTC(598)" VALUE 0x001639C0 /* @ECU_Address@FCtl_DTC@0x021B54AC@ */ ECIPP_ALIGNMENT_UWORD 65535 Compu_IDENTITY 0 65535 PHYS_UNIT "DTC" /end CHARACTERISTIC
/begin CHARACTERISTIC FCdtc_RS485_bad_fmt "FCtl_DTC(124)" VALUE 0x0016360C /* @ECU_Address@FCtl_DTC@0x021B50F8@ */ ECIPP_ALIGNMENT_UWORD 65535 Compu_IDENTITY 0 65535 PHYS_UNIT "DTC" /end CHARACTERISTIC
/begin CHARACTERISTIC FCdtc_RS485_Rx_inact "FCtl_DTC(122)" VALUE 0x00163608 /* @ECU_Address@FCtl_DTC@0x021B50F4@ */ ECIPP_ALIGNMENT_UWORD 65535 Compu_IDENTITY 0 65535 PHYS_UNIT "DTC" /end CHARACTERISTIC
/begin CHARACTERISTIC FCdtc_RS485_Rx_noise "FCtl_DTC(123)" VALUE 0x0016360A /* @ECU_Address@FCtl_DTC@0x021B50F6@ */ ECIPP_ALIGNMENT_UWORD 65535 Compu_IDENTITY 0 65535 PHYS_UNIT "DTC" /end CHARACTERISTIC
/begin CHARACTERISTIC FCdtc_RS485_SD_rq "FCtl_DTC(125)" VALUE 0x0016360E /* @ECU_Address@FCtl_DTC@0x021B50FA@ */ ECIPP_ALIGNMENT_UWORD 65535 Compu_IDENTITY 0 65535 PHYS_UNIT "DTC" /end CHARACTERISTIC
/begin CHARACTERISTIC FCdtc_RTI1 "FCtl_DTC(100)" VALUE 0x001635DC /* @ECU_Address@FCtl_DTC@0x021B50C8@ */ ECIPP_ALIGNMENT_UWORD 65535 Compu_IDENTITY 0 65535 PHYS_UNIT "DTC" /end CHARACTERISTIC
/begin CHARACTERISTIC FCdtc_RTI2 "FCtl_DTC(101)" VALUE 0x001635DE /* @ECU_Address@FCtl_DTC@0x021B50CA@ */ ECIPP_ALIGNMENT_UWORD 65535 Compu_IDENTITY 0 65535 PHYS_UNIT "DTC" /end CHARACTERISTIC
/begin CHARACTERISTIC FCdtc_RTI3 "FCtl_DTC(102)" VALUE 0x001635E0 /* @ECU_Address@FCtl_DTC@0x021B50CC@ */ ECIPP_ALIGNMENT_UWORD 65535 Compu_IDENTITY 0 65535 PHYS_UNIT "DTC" /end CHARACTERISTIC
/begin CHARACTERISTIC FCdtc_SHIFT_FB_OOR "FCtl_DTC(294)" VALUE 0x00163760 /* @ECU_Address@FCtl_DTC@0x021B524C@ */ ECIPP_ALIGNMENT_UWORD 65535 Compu_IDENTITY 0 65535 PHYS_UNIT "DTC" /end CHARACTERISTIC
/begin CHARACTERISTIC FCdtc_SHIFT_intcirc_fail "FCtl_DTC(296)" VALUE 0x00163764 /* @ECU_Address@FCtl_DTC@0x021B5250@ */ ECIPP_ALIGNMENT_UWORD 65535 Compu_IDENTITY 0 65535 PHYS_UNIT "DTC" /end CHARACTERISTIC
/begin CHARACTERISTIC FCdtc_SHIFT_shift_fail "FCtl_DTC(295)" VALUE 0x00163762 /* @ECU_Address@FCtl_DTC@0x021B524E@ */ ECIPP_ALIGNMENT_UWORD 65535 Compu_IDENTITY 0 65535 PHYS_UNIT "DTC" /end CHARACTERISTIC
/begin CHARACTERISTIC FCdtc_SL_fuel "FCtl_DTC(109)" VALUE 0x001635EE /* @ECU_Address@FCtl_DTC@0x021B50DA@ */ ECIPP_ALIGNMENT_UWORD 65535 Compu_IDENTITY 0 65535 PHYS_UNIT "DTC" /end CHARACTERISTIC
/begin CHARACTERISTIC FCdtc_SL_gov "FCtl_DTC(108)" VALUE 0x001635EC /* @ECU_Address@FCtl_DTC@0x021B50D8@ */ ECIPP_ALIGNMENT_UWORD 65535 Compu_IDENTITY 0 65535 PHYS_UNIT "DTC" /end CHARACTERISTIC
/begin CHARACTERISTIC FCdtc_SL_spk "FCtl_DTC(110)" VALUE 0x001635F0 /* @ECU_Address@FCtl_DTC@0x021B50DC@ */ ECIPP_ALIGNMENT_UWORD 65535 Compu_IDENTITY 0 65535 PHYS_UNIT "DTC" /end CHARACTERISTIC
/begin CHARACTERISTIC FCdtc_slv_MAP_hi_OOA "FCtl_DTC(837)" VALUE 0x00163B9E /* @ECU_Address@FCtl_DTC@0x021B568A@ */ ECIPP_ALIGNMENT_UWORD 65535 Compu_IDENTITY 0 65535 PHYS_UNIT "DTC" /end CHARACTERISTIC
/begin CHARACTERISTIC FCdtc_slv_MAP_lo_OOA "FCtl_DTC(838)" VALUE 0x00163BA0 /* @ECU_Address@FCtl_DTC@0x021B568C@ */ ECIPP_ALIGNMENT_UWORD 65535 Compu_IDENTITY 0 65535 PHYS_UNIT "DTC" /end CHARACTERISTIC
/begin CHARACTERISTIC FCdtc_SPK_int_fail "FCtl_DTC(303)" VALUE 0x00163772 /* @ECU_Address@FCtl_DTC@0x021B525E@ */ ECIPP_ALIGNMENT_UWORD 65535 Compu_IDENTITY 0 65535 PHYS_UNIT "DTC" /end CHARACTERISTIC
/begin CHARACTERISTIC FCdtc_SPK1_IGBT_T "FCtl_DTC(509)" VALUE 0x0016390E /* @ECU_Address@FCtl_DTC@0x021B53FA@ */ ECIPP_ALIGNMENT_UWORD 65535 Compu_IDENTITY 0 65535 PHYS_UNIT "DTC" /end CHARACTERISTIC
/begin CHARACTERISTIC FCdtc_SPKD_coil_fail "FCtl_DTC(304)" VALUE 0x00163774 /* @ECU_Address@FCtl_DTC@0x021B5260@ */ ECIPP_ALIGNMENT_UWORD 65535 Compu_IDENTITY 0 65535 PHYS_UNIT "DTC" /end CHARACTERISTIC
/begin CHARACTERISTIC FCdtc_SPKD_dw_hi "FCtl_DTC(76)" VALUE 0x001635AC /* @ECU_Address@FCtl_DTC@0x021B5098@ */ ECIPP_ALIGNMENT_UWORD 65535 Compu_IDENTITY 0 65535 PHYS_UNIT "DTC" /end CHARACTERISTIC
/begin CHARACTERISTIC FCdtc_SPKD_dw_lo "FCtl_DTC(66)" VALUE 0x00163598 /* @ECU_Address@FCtl_DTC@0x021B5084@ */ ECIPP_ALIGNMENT_UWORD 65535 Compu_IDENTITY 0 65535 PHYS_UNIT "DTC" /end CHARACTERISTIC
/begin CHARACTERISTIC FCdtc_SRVC_expired "FCtl_DTC(426)" VALUE 0x00163868 /* @ECU_Address@FCtl_DTC@0x021B5354@ */ ECIPP_ALIGNMENT_UWORD 65535 Compu_IDENTITY 0 65535 PHYS_UNIT "DTC" /end CHARACTERISTIC
/begin CHARACTERISTIC FCdtc_SRVC_expired2 "FCtl_DTC(836)" VALUE 0x00163B9C /* @ECU_Address@FCtl_DTC@0x021B5688@ */ ECIPP_ALIGNMENT_UWORD 65535 Compu_IDENTITY 0 65535 PHYS_UNIT "DTC" /end CHARACTERISTIC
/begin CHARACTERISTIC FCdtc_start_coilopen "FCtl_DTC(162)" VALUE 0x00163658 /* @ECU_Address@FCtl_DTC@0x021B5144@ */ ECIPP_ALIGNMENT_UWORD 65535 Compu_IDENTITY 0 65535 PHYS_UNIT "DTC" /end CHARACTERISTIC
/begin CHARACTERISTIC FCdtc_start_coilshort "FCtl_DTC(163)" VALUE 0x0016365A /* @ECU_Address@FCtl_DTC@0x021B5146@ */ ECIPP_ALIGNMENT_UWORD 65535 Compu_IDENTITY 0 65535 PHYS_UNIT "DTC" /end CHARACTERISTIC
/begin CHARACTERISTIC FCdtc_start_excess "FCtl_DTC(840)" VALUE 0x00163BA4 /* @ECU_Address@FCtl_DTC@0x021B5690@ */ ECIPP_ALIGNMENT_UWORD 65535 Compu_IDENTITY 0 65535 PHYS_UNIT "DTC" /end CHARACTERISTIC
/begin CHARACTERISTIC FCdtc_start_gndshort "FCtl_DTC(161)" VALUE 0x00163656 /* @ECU_Address@FCtl_DTC@0x021B5142@ */ ECIPP_ALIGNMENT_UWORD 65535 Compu_IDENTITY 0 65535 PHYS_UNIT "DTC" /end CHARACTERISTIC
/begin CHARACTERISTIC FCdtc_start_stuck_active "FCtl_DTC(320)" VALUE 0x00163794 /* @ECU_Address@FCtl_DTC@0x021B5280@ */ ECIPP_ALIGNMENT_UWORD 65535 Compu_IDENTITY 0 65535 PHYS_UNIT "DTC" /end CHARACTERISTIC
/begin CHARACTERISTIC FCdtc_SubDiagTemp "FCtl_DTC(653)" VALUE 0x00163A2E /* @ECU_Address@FCtl_DTC@0x021B551A@ */ ECIPP_ALIGNMENT_UWORD 65535 Compu_IDENTITY 0 65535 PHYS_UNIT "DTC" /end CHARACTERISTIC
/begin CHARACTERISTIC FCdtc_tach_gndshort "FCtl_DTC(173)" VALUE 0x0016366E /* @ECU_Address@FCtl_DTC@0x021B515A@ */ ECIPP_ALIGNMENT_UWORD 65535 Compu_IDENTITY 0 65535 PHYS_UNIT "DTC" /end CHARACTERISTIC
/begin CHARACTERISTIC FCdtc_tach_pwrshort "FCtl_DTC(174)" VALUE 0x00163670 /* @ECU_Address@FCtl_DTC@0x021B515C@ */ ECIPP_ALIGNMENT_UWORD 65535 Compu_IDENTITY 0 65535 PHYS_UNIT "DTC" /end CHARACTERISTIC
/begin CHARACTERISTIC FCdtc_TAUX_dT1_max "FCtl_DTC(558)" VALUE 0x00163970 /* @ECU_Address@FCtl_DTC@0x021B545C@ */ ECIPP_ALIGNMENT_UWORD 65535 Compu_IDENTITY 0 65535 PHYS_UNIT "DTC" /end CHARACTERISTIC
/begin CHARACTERISTIC FCdtc_TAUX_dT1_min "FCtl_DTC(559)" VALUE 0x00163972 /* @ECU_Address@FCtl_DTC@0x021B545E@ */ ECIPP_ALIGNMENT_UWORD 65535 Compu_IDENTITY 0 65535 PHYS_UNIT "DTC" /end CHARACTERISTIC
/begin CHARACTERISTIC FCdtc_TAUX_dT2_max "FCtl_DTC(560)" VALUE 0x00163974 /* @ECU_Address@FCtl_DTC@0x021B5460@ */ ECIPP_ALIGNMENT_UWORD 65535 Compu_IDENTITY 0 65535 PHYS_UNIT "DTC" /end CHARACTERISTIC
/begin CHARACTERISTIC FCdtc_TAUX_dT2_min "FCtl_DTC(561)" VALUE 0x00163976 /* @ECU_Address@FCtl_DTC@0x021B5462@ */ ECIPP_ALIGNMENT_UWORD 65535 Compu_IDENTITY 0 65535 PHYS_UNIT "DTC" /end CHARACTERISTIC
/begin CHARACTERISTIC FCdtc_Taux1_derate_actv "FCtl_DTC(812)" VALUE 0x00163B6C /* @ECU_Address@FCtl_DTC@0x021B5658@ */ ECIPP_ALIGNMENT_UWORD 65535 Compu_IDENTITY 0 65535 PHYS_UNIT "DTC" /end CHARACTERISTIC
/begin CHARACTERISTIC FCdtc_TAUX1_max "FCtl_DTC(550)" VALUE 0x00163960 /* @ECU_Address@FCtl_DTC@0x021B544C@ */ ECIPP_ALIGNMENT_UWORD 65535 Compu_IDENTITY 0 65535 PHYS_UNIT "DTC" /end CHARACTERISTIC
/begin CHARACTERISTIC FCdtc_TAUX1_min "FCtl_DTC(551)" VALUE 0x00163962 /* @ECU_Address@FCtl_DTC@0x021B544E@ */ ECIPP_ALIGNMENT_UWORD 65535 Compu_IDENTITY 0 65535 PHYS_UNIT "DTC" /end CHARACTERISTIC
/begin CHARACTERISTIC FCdtc_Taux2_derate_actv "FCtl_DTC(813)" VALUE 0x00163B6E /* @ECU_Address@FCtl_DTC@0x021B565A@ */ ECIPP_ALIGNMENT_UWORD 65535 Compu_IDENTITY 0 65535 PHYS_UNIT "DTC" /end CHARACTERISTIC
/begin CHARACTERISTIC FCfmi_PWM21_on_hiVf "FCtl_FMI(456)" VALUE 0x001652DB /* @ECU_Address@FCtl_FMI@0x021B71C8@ */ ECIPP_ALIGNMENT_UBYTE 255 Compu_IDENTITY 0 255 PHYS_UNIT "FMI" /end CHARACTERISTIC
/begin CHARACTERISTIC FCfmi_PWM22_off_loVf "FCtl_FMI(457)" VALUE 0x001652DC /* @ECU_Address@FCtl_FMI@0x021B71C9@ */ ECIPP_ALIGNMENT_UBYTE 255 Compu_IDENTITY 0 255 PHYS_UNIT "FMI" /end CHARACTERISTIC
/begin CHARACTERISTIC FCfmi_PWM22_on_hiVf "FCtl_FMI(458)" VALUE 0x001652DD /* @ECU_Address@FCtl_FMI@0x021B71CA@ */ ECIPP_ALIGNMENT_UBYTE 255 Compu_IDENTITY 0 255 PHYS_UNIT "FMI" /end CHARACTERISTIC
/begin CHARACTERISTIC FCfmi_PWM23_off_loVf "FCtl_FMI(459)" VALUE 0x001652DE /* @ECU_Address@FCtl_FMI@0x021B71CB@ */ ECIPP_ALIGNMENT_UBYTE 255 Compu_IDENTITY 0 255 PHYS_UNIT "FMI" /end CHARACTERISTIC
/begin CHARACTERISTIC FCfmi_PWM23_on_hiVf "FCtl_FMI(460)" VALUE 0x001652DF /* @ECU_Address@FCtl_FMI@0x021B71CC@ */ ECIPP_ALIGNMENT_UBYTE 255 Compu_IDENTITY 0 255 PHYS_UNIT "FMI" /end CHARACTERISTIC
/begin CHARACTERISTIC FCfmi_PWM3_off_loVf "FCtl_FMI(193)" VALUE 0x001651D4 /* @ECU_Address@FCtl_FMI@0x021B70C1@ */ ECIPP_ALIGNMENT_UBYTE 255 Compu_IDENTITY 0 255 PHYS_UNIT "FMI" /end CHARACTERISTIC
/begin CHARACTERISTIC FCfmi_PWM3_on_hiVf "FCtl_FMI(194)" VALUE 0x001651D5 /* @ECU_Address@FCtl_FMI@0x021B70C2@ */ ECIPP_ALIGNMENT_UBYTE 255 Compu_IDENTITY 0 255 PHYS_UNIT "FMI" /end CHARACTERISTIC
/begin CHARACTERISTIC FCfmi_PWM4_off_loVf "FCtl_FMI(195)" VALUE 0x001651D6 /* @ECU_Address@FCtl_FMI@0x021B70C3@ */ ECIPP_ALIGNMENT_UBYTE 255 Compu_IDENTITY 0 255 PHYS_UNIT "FMI" /end CHARACTERISTIC
/begin CHARACTERISTIC FCfmi_PWM4_on_hiVf "FCtl_FMI(196)" VALUE 0x001651D7 /* @ECU_Address@FCtl_FMI@0x021B70C4@ */ ECIPP_ALIGNMENT_UBYTE 255 Compu_IDENTITY 0 255 PHYS_UNIT "FMI" /end CHARACTERISTIC
/begin CHARACTERISTIC FCfmi_PWM5_off_loVf "FCtl_FMI(197)" VALUE 0x001651D8 /* @ECU_Address@FCtl_FMI@0x021B70C5@ */ ECIPP_ALIGNMENT_UBYTE 255 Compu_IDENTITY 0 255 PHYS_UNIT "FMI" /end CHARACTERISTIC
/begin CHARACTERISTIC FCfmi_PWM5_on_hiVf "FCtl_FMI(198)" VALUE 0x001651D9 /* @ECU_Address@FCtl_FMI@0x021B70C6@ */ ECIPP_ALIGNMENT_UBYTE 255 Compu_IDENTITY 0 255 PHYS_UNIT "FMI" /end CHARACTERISTIC
/begin CHARACTERISTIC FCfmi_PWM6_off_loVf "FCtl_FMI(276)" VALUE 0x00165227 /* @ECU_Address@FCtl_FMI@0x021B7114@ */ ECIPP_ALIGNMENT_UBYTE 255 Compu_IDENTITY 0 255 PHYS_UNIT "FMI" /end CHARACTERISTIC
/begin CHARACTERISTIC FCfmi_PWM6_on_hiVf "FCtl_FMI(277)" VALUE 0x00165228 /* @ECU_Address@FCtl_FMI@0x021B7115@ */ ECIPP_ALIGNMENT_UBYTE 255 Compu_IDENTITY 0 255 PHYS_UNIT "FMI" /end CHARACTERISTIC
/begin CHARACTERISTIC FCfmi_PWM7_off_loVf "FCtl_FMI(278)" VALUE 0x00165229 /* @ECU_Address@FCtl_FMI@0x021B7116@ */ ECIPP_ALIGNMENT_UBYTE 255 Compu_IDENTITY 0 255 PHYS_UNIT "FMI" /end CHARACTERISTIC
/begin CHARACTERISTIC FCfmi_PWM7_on_hiVf "FCtl_FMI(279)" VALUE 0x0016522A /* @ECU_Address@FCtl_FMI@0x021B7117@ */ ECIPP_ALIGNMENT_UBYTE 255 Compu_IDENTITY 0 255 PHYS_UNIT "FMI" /end CHARACTERISTIC
/begin CHARACTERISTIC FCfmi_PWM8_off_loVf "FCtl_FMI(283)" VALUE 0x0016522E /* @ECU_Address@FCtl_FMI@0x021B711B@ */ ECIPP_ALIGNMENT_UBYTE 255 Compu_IDENTITY 0 255 PHYS_UNIT "FMI" /end CHARACTERISTIC
/begin CHARACTERISTIC FCfmi_PWM8_on_hiVf "FCtl_FMI(284)" VALUE 0x0016522F /* @ECU_Address@FCtl_FMI@0x021B711C@ */ ECIPP_ALIGNMENT_UBYTE 255 Compu_IDENTITY 0 255 PHYS_UNIT "FMI" /end CHARACTERISTIC
/begin CHARACTERISTIC FCfmi_PWM9_off_loVf "FCtl_FMI(285)" VALUE 0x00165230 /* @ECU_Address@FCtl_FMI@0x021B711D@ */ ECIPP_ALIGNMENT_UBYTE 255 Compu_IDENTITY 0 255 PHYS_UNIT "FMI" /end CHARACTERISTIC
/begin CHARACTERISTIC FCfmi_PWM9_on_hiVf "FCtl_FMI(286)" VALUE 0x00165231 /* @ECU_Address@FCtl_FMI@0x021B711E@ */ ECIPP_ALIGNMENT_UBYTE 255 Compu_IDENTITY 0 255 PHYS_UNIT "FMI" /end CHARACTERISTIC
/begin CHARACTERISTIC FCfmi_PWMLO_off_loVf "FCtl_FMI(521)" VALUE 0x0016531C /* @ECU_Address@FCtl_FMI@0x021B7209@ */ ECIPP_ALIGNMENT_UBYTE 255 Compu_IDENTITY 0 255 PHYS_UNIT "FMI" /end CHARACTERISTIC
/begin CHARACTERISTIC FCfmi_PWMLO_on_hiVf "FCtl_FMI(522)" VALUE 0x0016531D /* @ECU_Address@FCtl_FMI@0x021B720A@ */ ECIPP_ALIGNMENT_UBYTE 255 Compu_IDENTITY 0 255 PHYS_UNIT "FMI" /end CHARACTERISTIC
/begin CHARACTERISTIC FCfmi_RAM_fail "FCtl_FMI(106)" VALUE 0x0016517D /* @ECU_Address@FCtl_FMI@0x021B706A@ */ ECIPP_ALIGNMENT_UBYTE 255 Compu_IDENTITY 0 255 PHYS_UNIT "FMI" /end CHARACTERISTIC
/begin CHARACTERISTIC FCfmi_relay_coilopen "FCtl_FMI(159)" VALUE 0x001651B2 /* @ECU_Address@FCtl_FMI@0x021B709F@ */ ECIPP_ALIGNMENT_UBYTE 255 Compu_IDENTITY 0 255 PHYS_UNIT "FMI" /end CHARACTERISTIC
/begin CHARACTERISTIC FCfmi_relay_coilshort "FCtl_FMI(160)" VALUE 0x001651B3 /* @ECU_Address@FCtl_FMI@0x021B70A0@ */ ECIPP_ALIGNMENT_UBYTE 255 Compu_IDENTITY 0 255 PHYS_UNIT "FMI" /end CHARACTERISTIC
/begin CHARACTERISTIC FCfmi_relay_gndshort "FCtl_FMI(158)" VALUE 0x001651B1 /* @ECU_Address@FCtl_FMI@0x021B709E@ */ ECIPP_ALIGNMENT_UBYTE 255 Compu_IDENTITY 0 255 PHYS_UNIT "FMI" /end CHARACTERISTIC
/begin CHARACTERISTIC FCfmi_relayoff_hiV "FCtl_FMI(431)" VALUE 0x001652C2 /* @ECU_Address@FCtl_FMI@0x021B71AF@ */ ECIPP_ALIGNMENT_UBYTE 255 Compu_IDENTITY 0 255 PHYS_UNIT "FMI" /end CHARACTERISTIC
/begin CHARACTERISTIC FCfmi_relayon_loV "FCtl_FMI(432)" VALUE 0x001652C3 /* @ECU_Address@FCtl_FMI@0x021B71B0@ */ ECIPP_ALIGNMENT_UBYTE 255 Compu_IDENTITY 0 255 PHYS_UNIT "FMI" /end CHARACTERISTIC
/begin CHARACTERISTIC FCfmi_rpm_hi_expected "FCtl_FMI(351)" VALUE 0x00165272 /* @ECU_Address@FCtl_FMI@0x021B715F@ */ ECIPP_ALIGNMENT_UBYTE 255 Compu_IDENTITY 0 255 PHYS_UNIT "FMI" /end CHARACTERISTIC
/begin CHARACTERISTIC FCfmi_rpmd_gov_lo "FCtl_FMI(520)" VALUE 0x0016531B /* @ECU_Address@FCtl_FMI@0x021B7208@ */ ECIPP_ALIGNMENT_UBYTE 255 Compu_IDENTITY 0 255 PHYS_UNIT "FMI" /end CHARACTERISTIC
/begin CHARACTERISTIC FCfmi_RS_discon "FCtl_FMI(691)" VALUE 0x001653C6 /* @ECU_Address@FCtl_FMI@0x021B72B3@ */ ECIPP_ALIGNMENT_UBYTE 255 Compu_IDENTITY 0 255 PHYS_UNIT "FMI" /end CHARACTERISTIC
/begin CHARACTERISTIC FCfmi_RS_hiV "FCtl_FMI(599)" VALUE 0x0016536A /* @ECU_Address@FCtl_FMI@0x021B7257@ */ ECIPP_ALIGNMENT_UBYTE 255 Compu_IDENTITY 0 255 PHYS_UNIT "FMI" /end CHARACTERISTIC
/begin CHARACTERISTIC FCfmi_RS_loss "FCtl_FMI(220)" VALUE 0x001651EF /* @ECU_Address@FCtl_FMI@0x021B70DC@ */ ECIPP_ALIGNMENT_UBYTE 255 Compu_IDENTITY 0 255 PHYS_UNIT "FMI" /end CHARACTERISTIC
/begin CHARACTERISTIC FCfmi_RS_loV "FCtl_FMI(598)" VALUE 0x00165369 /* @ECU_Address@FCtl_FMI@0x021B7256@ */ ECIPP_ALIGNMENT_UBYTE 255 Compu_IDENTITY 0 255 PHYS_UNIT "FMI" /end CHARACTERISTIC
/begin CHARACTERISTIC FCfmi_RS485_bad_fmt "FCtl_FMI(124)" VALUE 0x0016518F /* @ECU_Address@FCtl_FMI@0x021B707C@ */ ECIPP_ALIGNMENT_UBYTE 255 Compu_IDENTITY 0 255 PHYS_UNIT "FMI" /end CHARACTERISTIC
/begin CHARACTERISTIC FCfmi_RS485_Rx_inact "FCtl_FMI(122)" VALUE 0x0016518D /* @ECU_Address@FCtl_FMI@0x021B707A@ */ ECIPP_ALIGNMENT_UBYTE 255 Compu_IDENTITY 0 255 PHYS_UNIT "FMI" /end CHARACTERISTIC
/begin CHARACTERISTIC FCfmi_RS485_Rx_noise "FCtl_FMI(123)" VALUE 0x0016518E /* @ECU_Address@FCtl_FMI@0x021B707B@ */ ECIPP_ALIGNMENT_UBYTE 255 Compu_IDENTITY 0 255 PHYS_UNIT "FMI" /end CHARACTERISTIC
/begin CHARACTERISTIC FCfmi_RS485_SD_rq "FCtl_FMI(125)" VALUE 0x00165190 /* @ECU_Address@FCtl_FMI@0x021B707D@ */ ECIPP_ALIGNMENT_UBYTE 255 Compu_IDENTITY 0 255 PHYS_UNIT "FMI" /end CHARACTERISTIC
/begin CHARACTERISTIC FCfmi_RTI1 "FCtl_FMI(100)" VALUE 0x00165177 /* @ECU_Address@FCtl_FMI@0x021B7064@ */ ECIPP_ALIGNMENT_UBYTE 255 Compu_IDENTITY 0 255 PHYS_UNIT "FMI" /end CHARACTERISTIC
/begin CHARACTERISTIC FCfmi_RTI2 "FCtl_FMI(101)" VALUE 0x00165178 /* @ECU_Address@FCtl_FMI@0x021B7065@ */ ECIPP_ALIGNMENT_UBYTE 255 Compu_IDENTITY 0 255 PHYS_UNIT "FMI" /end CHARACTERISTIC
/begin CHARACTERISTIC FCfmi_RTI3 "FCtl_FMI(102)" VALUE 0x00165179 /* @ECU_Address@FCtl_FMI@0x021B7066@ */ ECIPP_ALIGNMENT_UBYTE 255 Compu_IDENTITY 0 255 PHYS_UNIT "FMI" /end CHARACTERISTIC
/begin CHARACTERISTIC FCfmi_SHIFT_FB_OOR "FCtl_FMI(294)" VALUE 0x00165239 /* @ECU_Address@FCtl_FMI@0x021B7126@ */ ECIPP_ALIGNMENT_UBYTE 255 Compu_IDENTITY 0 255 PHYS_UNIT "FMI" /end CHARACTERISTIC
/begin CHARACTERISTIC FCfmi_SHIFT_intcirc_fail "FCtl_FMI(296)" VALUE 0x0016523B /* @ECU_Address@FCtl_FMI@0x021B7128@ */ ECIPP_ALIGNMENT_UBYTE 255 Compu_IDENTITY 0 255 PHYS_UNIT "FMI" /end CHARACTERISTIC
/begin CHARACTERISTIC FCfmi_SHIFT_shift_fail "FCtl_FMI(295)" VALUE 0x0016523A /* @ECU_Address@FCtl_FMI@0x021B7127@ */ ECIPP_ALIGNMENT_UBYTE 255 Compu_IDENTITY 0 255 PHYS_UNIT "FMI" /end CHARACTERISTIC
/begin CHARACTERISTIC FCfmi_SL_fuel "FCtl_FMI(109)" VALUE 0x00165180 /* @ECU_Address@FCtl_FMI@0x021B706D@ */ ECIPP_ALIGNMENT_UBYTE 255 Compu_IDENTITY 0 255 PHYS_UNIT "FMI" /end CHARACTERISTIC
/begin CHARACTERISTIC FCfmi_SL_gov "FCtl_FMI(108)" VALUE 0x0016517F /* @ECU_Address@FCtl_FMI@0x021B706C@ */ ECIPP_ALIGNMENT_UBYTE 255 Compu_IDENTITY 0 255 PHYS_UNIT "FMI" /end CHARACTERISTIC
/begin CHARACTERISTIC FCfmi_SL_spk "FCtl_FMI(110)" VALUE 0x00165181 /* @ECU_Address@FCtl_FMI@0x021B706E@ */ ECIPP_ALIGNMENT_UBYTE 255 Compu_IDENTITY 0 255 PHYS_UNIT "FMI" /end CHARACTERISTIC
/begin CHARACTERISTIC FCfmi_slv_MAP_hi_OOA "FCtl_FMI(837)" VALUE 0x00165458 /* @ECU_Address@FCtl_FMI@0x021B7345@ */ ECIPP_ALIGNMENT_UBYTE 255 Compu_IDENTITY 0 255 PHYS_UNIT "FMI" /end CHARACTERISTIC
/begin CHARACTERISTIC FCfmi_slv_MAP_lo_OOA "FCtl_FMI(838)" VALUE 0x00165459 /* @ECU_Address@FCtl_FMI@0x021B7346@ */ ECIPP_ALIGNMENT_UBYTE 255 Compu_IDENTITY 0 255 PHYS_UNIT "FMI" /end CHARACTERISTIC
/begin CHARACTERISTIC FCfmi_SPK_int_fail "FCtl_FMI(303)" VALUE 0x00165242 /* @ECU_Address@FCtl_FMI@0x021B712F@ */ ECIPP_ALIGNMENT_UBYTE 255 Compu_IDENTITY 0 255 PHYS_UNIT "FMI" /end CHARACTERISTIC
/begin CHARACTERISTIC FCfmi_SPK1_IGBT_T "FCtl_FMI(509)" VALUE 0x00165310 /* @ECU_Address@FCtl_FMI@0x021B71FD@ */ ECIPP_ALIGNMENT_UBYTE 255 Compu_IDENTITY 0 255 PHYS_UNIT "FMI" /end CHARACTERISTIC
/begin CHARACTERISTIC FCfmi_SPKD_coil_fail "FCtl_FMI(304)" VALUE 0x00165243 /* @ECU_Address@FCtl_FMI@0x021B7130@ */ ECIPP_ALIGNMENT_UBYTE 255 Compu_IDENTITY 0 255 PHYS_UNIT "FMI" /end CHARACTERISTIC
/begin CHARACTERISTIC FCfmi_SPKD_dw_hi "FCtl_FMI(76)" VALUE 0x0016515F /* @ECU_Address@FCtl_FMI@0x021B704C@ */ ECIPP_ALIGNMENT_UBYTE 255 Compu_IDENTITY 0 255 PHYS_UNIT "FMI" /end CHARACTERISTIC
/begin CHARACTERISTIC FCfmi_SPKD_dw_lo "FCtl_FMI(66)" VALUE 0x00165155 /* @ECU_Address@FCtl_FMI@0x021B7042@ */ ECIPP_ALIGNMENT_UBYTE 255 Compu_IDENTITY 0 255 PHYS_UNIT "FMI" /end CHARACTERISTIC
/begin CHARACTERISTIC FCfmi_SRVC_expired "FCtl_FMI(426)" VALUE 0x001652BD /* @ECU_Address@FCtl_FMI@0x021B71AA@ */ ECIPP_ALIGNMENT_UBYTE 255 Compu_IDENTITY 0 255 PHYS_UNIT "FMI" /end CHARACTERISTIC
/begin CHARACTERISTIC FCfmi_SRVC_expired2 "FCtl_FMI(836)" VALUE 0x00165457 /* @ECU_Address@FCtl_FMI@0x021B7344@ */ ECIPP_ALIGNMENT_UBYTE 255 Compu_IDENTITY 0 255 PHYS_UNIT "FMI" /end CHARACTERISTIC
/begin CHARACTERISTIC FCfmi_start_coilopen "FCtl_FMI(162)" VALUE 0x001651B5 /* @ECU_Address@FCtl_FMI@0x021B70A2@ */ ECIPP_ALIGNMENT_UBYTE 255 Compu_IDENTITY 0 255 PHYS_UNIT "FMI" /end CHARACTERISTIC
/begin CHARACTERISTIC FCfmi_start_coilshort "FCtl_FMI(163)" VALUE 0x001651B6 /* @ECU_Address@FCtl_FMI@0x021B70A3@ */ ECIPP_ALIGNMENT_UBYTE 255 Compu_IDENTITY 0 255 PHYS_UNIT "FMI" /end CHARACTERISTIC
/begin CHARACTERISTIC FCfmi_start_excess "FCtl_FMI(840)" VALUE 0x0016545B /* @ECU_Address@FCtl_FMI@0x021B7348@ */ ECIPP_ALIGNMENT_UBYTE 255 Compu_IDENTITY 0 255 PHYS_UNIT "FMI" /end CHARACTERISTIC
/begin CHARACTERISTIC FCfmi_start_gndshort "FCtl_FMI(161)" VALUE 0x001651B4 /* @ECU_Address@FCtl_FMI@0x021B70A1@ */ ECIPP_ALIGNMENT_UBYTE 255 Compu_IDENTITY 0 255 PHYS_UNIT "FMI" /end CHARACTERISTIC
/begin CHARACTERISTIC FCfmi_start_stuck_active "FCtl_FMI(320)" VALUE 0x00165253 /* @ECU_Address@FCtl_FMI@0x021B7140@ */ ECIPP_ALIGNMENT_UBYTE 255 Compu_IDENTITY 0 255 PHYS_UNIT "FMI" /end CHARACTERISTIC
/begin CHARACTERISTIC FCfmi_SubDiagTemp "FCtl_FMI(653)" VALUE 0x001653A0 /* @ECU_Address@FCtl_FMI@0x021B728D@ */ ECIPP_ALIGNMENT_UBYTE 255 Compu_IDENTITY 0 255 PHYS_UNIT "FMI" /end CHARACTERISTIC
/begin CHARACTERISTIC FCfmi_tach_gndshort "FCtl_FMI(173)" VALUE 0x001651C0 /* @ECU_Address@FCtl_FMI@0x021B70AD@ */ ECIPP_ALIGNMENT_UBYTE 255 Compu_IDENTITY 0 255 PHYS_UNIT "FMI" /end CHARACTERISTIC
/begin CHARACTERISTIC FCfmi_tach_pwrshort "FCtl_FMI(174)" VALUE 0x001651C1 /* @ECU_Address@FCtl_FMI@0x021B70AE@ */ ECIPP_ALIGNMENT_UBYTE 255 Compu_IDENTITY 0 255 PHYS_UNIT "FMI" /end CHARACTERISTIC
/begin CHARACTERISTIC FCfmi_TAUX_dT1_max "FCtl_FMI(558)" VALUE 0x00165341 /* @ECU_Address@FCtl_FMI@0x021B722E@ */ ECIPP_ALIGNMENT_UBYTE 255 Compu_IDENTITY 0 255 PHYS_UNIT "FMI" /end CHARACTERISTIC
/begin CHARACTERISTIC FCfmi_TAUX_dT1_min "FCtl_FMI(559)" VALUE 0x00165342 /* @ECU_Address@FCtl_FMI@0x021B722F@ */ ECIPP_ALIGNMENT_UBYTE 255 Compu_IDENTITY 0 255 PHYS_UNIT "FMI" /end CHARACTERISTIC
/begin CHARACTERISTIC FCfmi_TAUX_dT2_max "FCtl_FMI(560)" VALUE 0x00165343 /* @ECU_Address@FCtl_FMI@0x021B7230@ */ ECIPP_ALIGNMENT_UBYTE 255 Compu_IDENTITY 0 255 PHYS_UNIT "FMI" /end CHARACTERISTIC
/begin CHARACTERISTIC FCfmi_TAUX_dT2_min "FCtl_FMI(561)" VALUE 0x00165344 /* @ECU_Address@FCtl_FMI@0x021B7231@ */ ECIPP_ALIGNMENT_UBYTE 255 Compu_IDENTITY 0 255 PHYS_UNIT "FMI" /end CHARACTERISTIC
/begin CHARACTERISTIC FCfmi_Taux1_derate_actv "FCtl_FMI(812)" VALUE 0x0016543F /* @ECU_Address@FCtl_FMI@0x021B732C@ */ ECIPP_ALIGNMENT_UBYTE 255 Compu_IDENTITY 0 255 PHYS_UNIT "FMI" /end CHARACTERISTIC
/begin CHARACTERISTIC FCfmi_TAUX1_max "FCtl_FMI(550)" VALUE 0x00165339 /* @ECU_Address@FCtl_FMI@0x021B7226@ */ ECIPP_ALIGNMENT_UBYTE 255 Compu_IDENTITY 0 255 PHYS_UNIT "FMI" /end CHARACTERISTIC
/begin CHARACTERISTIC FCfmi_TAUX1_min "FCtl_FMI(551)" VALUE 0x0016533A /* @ECU_Address@FCtl_FMI@0x021B7227@ */ ECIPP_ALIGNMENT_UBYTE 255 Compu_IDENTITY 0 255 PHYS_UNIT "FMI" /end CHARACTERISTIC
/begin CHARACTERISTIC FCfmi_Taux2_derate_actv "FCtl_FMI(813)" VALUE 0x00165440 /* @ECU_Address@FCtl_FMI@0x021B732D@ */ ECIPP_ALIGNMENT_UBYTE 255 Compu_IDENTITY 0 255 PHYS_UNIT "FMI" /end CHARACTERISTIC
/begin CHARACTERISTIC FCftb_PWM21_on_hiVf "FCtl_FTB_0x04(456)" VALUE 0x00165639 /* @ECU_Address@FCtl_FTB_0x04@0x024C51C8@ */ ECIPP_ALIGNMENT_UBYTE 255 Compu_IDENTITY 0 255 PHYS_UNIT "FTB" /end CHARACTERISTIC
/begin CHARACTERISTIC FCftb_PWM22_off_loVf "FCtl_FTB_0x04(457)" VALUE 0x0016563A /* @ECU_Address@FCtl_FTB_0x04@0x024C51C9@ */ ECIPP_ALIGNMENT_UBYTE 255 Compu_IDENTITY 0 255 PHYS_UNIT "FTB" /end CHARACTERISTIC
/begin CHARACTERISTIC FCftb_PWM22_on_hiVf "FCtl_FTB_0x04(458)" VALUE 0x0016563B /* @ECU_Address@FCtl_FTB_0x04@0x024C51CA@ */ ECIPP_ALIGNMENT_UBYTE 255 Compu_IDENTITY 0 255 PHYS_UNIT "FTB" /end CHARACTERISTIC
/begin CHARACTERISTIC FCftb_PWM23_off_loVf "FCtl_FTB_0x04(459)" VALUE 0x0016563C /* @ECU_Address@FCtl_FTB_0x04@0x024C51CB@ */ ECIPP_ALIGNMENT_UBYTE 255 Compu_IDENTITY 0 255 PHYS_UNIT "FTB" /end CHARACTERISTIC
/begin CHARACTERISTIC FCftb_PWM23_on_hiVf "FCtl_FTB_0x04(460)" VALUE 0x0016563D /* @ECU_Address@FCtl_FTB_0x04@0x024C51CC@ */ ECIPP_ALIGNMENT_UBYTE 255 Compu_IDENTITY 0 255 PHYS_UNIT "FTB" /end CHARACTERISTIC
/begin CHARACTERISTIC FCftb_PWM3_off_loVf "FCtl_FTB_0x04(193)" VALUE 0x00165532 /* @ECU_Address@FCtl_FTB_0x04@0x024C50C1@ */ ECIPP_ALIGNMENT_UBYTE 255 Compu_IDENTITY 0 255 PHYS_UNIT "FTB" /end CHARACTERISTIC
/begin CHARACTERISTIC FCftb_PWM3_on_hiVf "FCtl_FTB_0x04(194)" VALUE 0x00165533 /* @ECU_Address@FCtl_FTB_0x04@0x024C50C2@ */ ECIPP_ALIGNMENT_UBYTE 255 Compu_IDENTITY 0 255 PHYS_UNIT "FTB" /end CHARACTERISTIC
/begin CHARACTERISTIC FCftb_PWM4_off_loVf "FCtl_FTB_0x04(195)" VALUE 0x00165534 /* @ECU_Address@FCtl_FTB_0x04@0x024C50C3@ */ ECIPP_ALIGNMENT_UBYTE 255 Compu_IDENTITY 0 255 PHYS_UNIT "FTB" /end CHARACTERISTIC
/begin CHARACTERISTIC FCftb_PWM4_on_hiVf "FCtl_FTB_0x04(196)" VALUE 0x00165535 /* @ECU_Address@FCtl_FTB_0x04@0x024C50C4@ */ ECIPP_ALIGNMENT_UBYTE 255 Compu_IDENTITY 0 255 PHYS_UNIT "FTB" /end CHARACTERISTIC
/begin CHARACTERISTIC FCftb_PWM5_off_loVf "FCtl_FTB_0x04(197)" VALUE 0x00165536 /* @ECU_Address@FCtl_FTB_0x04@0x024C50C5@ */ ECIPP_ALIGNMENT_UBYTE 255 Compu_IDENTITY 0 255 PHYS_UNIT "FTB" /end CHARACTERISTIC
/begin CHARACTERISTIC FCftb_PWM5_on_hiVf "FCtl_FTB_0x04(198)" VALUE 0x00165537 /* @ECU_Address@FCtl_FTB_0x04@0x024C50C6@ */ ECIPP_ALIGNMENT_UBYTE 255 Compu_IDENTITY 0 255 PHYS_UNIT "FTB" /end CHARACTERISTIC
/begin CHARACTERISTIC FCftb_PWM6_off_loVf "FCtl_FTB_0x04(276)" VALUE 0x00165585 /* @ECU_Address@FCtl_FTB_0x04@0x024C5114@ */ ECIPP_ALIGNMENT_UBYTE 255 Compu_IDENTITY 0 255 PHYS_UNIT "FTB" /end CHARACTERISTIC
/begin CHARACTERISTIC FCftb_PWM6_on_hiVf "FCtl_FTB_0x04(277)" VALUE 0x00165586 /* @ECU_Address@FCtl_FTB_0x04@0x024C5115@ */ ECIPP_ALIGNMENT_UBYTE 255 Compu_IDENTITY 0 255 PHYS_UNIT "FTB" /end CHARACTERISTIC
/begin CHARACTERISTIC FCftb_PWM7_off_loVf "FCtl_FTB_0x04(278)" VALUE 0x00165587 /* @ECU_Address@FCtl_FTB_0x04@0x024C5116@ */ ECIPP_ALIGNMENT_UBYTE 255 Compu_IDENTITY 0 255 PHYS_UNIT "FTB" /end CHARACTERISTIC
/begin CHARACTERISTIC FCftb_PWM7_on_hiVf "FCtl_FTB_0x04(279)" VALUE 0x00165588 /* @ECU_Address@FCtl_FTB_0x04@0x024C5117@ */ ECIPP_ALIGNMENT_UBYTE 255 Compu_IDENTITY 0 255 PHYS_UNIT "FTB" /end CHARACTERISTIC
/begin CHARACTERISTIC FCftb_PWM8_off_loVf "FCtl_FTB_0x04(283)" VALUE 0x0016558C /* @ECU_Address@FCtl_FTB_0x04@0x024C511B@ */ ECIPP_ALIGNMENT_UBYTE 255 Compu_IDENTITY 0 255 PHYS_UNIT "FTB" /end CHARACTERISTIC
/begin CHARACTERISTIC FCftb_PWM8_on_hiVf "FCtl_FTB_0x04(284)" VALUE 0x0016558D /* @ECU_Address@FCtl_FTB_0x04@0x024C511C@ */ ECIPP_ALIGNMENT_UBYTE 255 Compu_IDENTITY 0 255 PHYS_UNIT "FTB" /end CHARACTERISTIC
/begin CHARACTERISTIC FCftb_PWM9_off_loVf "FCtl_FTB_0x04(285)" VALUE 0x0016558E /* @ECU_Address@FCtl_FTB_0x04@0x024C511D@ */ ECIPP_ALIGNMENT_UBYTE 255 Compu_IDENTITY 0 255 PHYS_UNIT "FTB" /end CHARACTERISTIC
/begin CHARACTERISTIC FCftb_PWM9_on_hiVf "FCtl_FTB_0x04(286)" VALUE 0x0016558F /* @ECU_Address@FCtl_FTB_0x04@0x024C511E@ */ ECIPP_ALIGNMENT_UBYTE 255 Compu_IDENTITY 0 255 PHYS_UNIT "FTB" /end CHARACTERISTIC
/begin CHARACTERISTIC FCftb_PWMLO_off_loVf "FCtl_FTB_0x04(521)" VALUE 0x0016567A /* @ECU_Address@FCtl_FTB_0x04@0x024C5209@ */ ECIPP_ALIGNMENT_UBYTE 255 Compu_IDENTITY 0 255 PHYS_UNIT "FTB" /end CHARACTERISTIC
/begin CHARACTERISTIC FCftb_PWMLO_on_hiVf "FCtl_FTB_0x04(522)" VALUE 0x0016567B /* @ECU_Address@FCtl_FTB_0x04@0x024C520A@ */ ECIPP_ALIGNMENT_UBYTE 255 Compu_IDENTITY 0 255 PHYS_UNIT "FTB" /end CHARACTERISTIC
/begin CHARACTERISTIC FCftb_RAM_fail "FCtl_FTB_0x04(106)" VALUE 0x001654DB /* @ECU_Address@FCtl_FTB_0x04@0x024C506A@ */ ECIPP_ALIGNMENT_UBYTE 255 Compu_IDENTITY 0 255 PHYS_UNIT "FTB" /end CHARACTERISTIC
/begin CHARACTERISTIC FCftb_relay_coilopen "FCtl_FTB_0x04(159)" VALUE 0x00165510 /* @ECU_Address@FCtl_FTB_0x04@0x024C509F@ */ ECIPP_ALIGNMENT_UBYTE 255 Compu_IDENTITY 0 255 PHYS_UNIT "FTB" /end CHARACTERISTIC
/begin CHARACTERISTIC FCftb_relay_coilshort "FCtl_FTB_0x04(160)" VALUE 0x00165511 /* @ECU_Address@FCtl_FTB_0x04@0x024C50A0@ */ ECIPP_ALIGNMENT_UBYTE 255 Compu_IDENTITY 0 255 PHYS_UNIT "FTB" /end CHARACTERISTIC
/begin CHARACTERISTIC FCftb_relay_gndshort "FCtl_FTB_0x04(158)" VALUE 0x0016550F /* @ECU_Address@FCtl_FTB_0x04@0x024C509E@ */ ECIPP_ALIGNMENT_UBYTE 255 Compu_IDENTITY 0 255 PHYS_UNIT "FTB" /end CHARACTERISTIC
/begin CHARACTERISTIC FCftb_relayoff_hiV "FCtl_FTB_0x04(431)" VALUE 0x00165620 /* @ECU_Address@FCtl_FTB_0x04@0x024C51AF@ */ ECIPP_ALIGNMENT_UBYTE 255 Compu_IDENTITY 0 255 PHYS_UNIT "FTB" /end CHARACTERISTIC
/begin CHARACTERISTIC FCftb_relayon_loV "FCtl_FTB_0x04(432)" VALUE 0x00165621 /* @ECU_Address@FCtl_FTB_0x04@0x024C51B0@ */ ECIPP_ALIGNMENT_UBYTE 255 Compu_IDENTITY 0 255 PHYS_UNIT "FTB" /end CHARACTERISTIC
/begin CHARACTERISTIC FCftb_rpm_hi_expected "FCtl_FTB_0x04(351)" VALUE 0x001655D0 /* @ECU_Address@FCtl_FTB_0x04@0x024C515F@ */ ECIPP_ALIGNMENT_UBYTE 255 Compu_IDENTITY 0 255 PHYS_UNIT "FTB" /end CHARACTERISTIC
/begin CHARACTERISTIC FCftb_rpmd_gov_lo "FCtl_FTB_0x04(520)" VALUE 0x00165679 /* @ECU_Address@FCtl_FTB_0x04@0x024C5208@ */ ECIPP_ALIGNMENT_UBYTE 255 Compu_IDENTITY 0 255 PHYS_UNIT "FTB" /end CHARACTERISTIC
/begin CHARACTERISTIC FCftb_RS_discon "FCtl_FTB_0x04(691)" VALUE 0x00165724 /* @ECU_Address@FCtl_FTB_0x04@0x024C52B3@ */ ECIPP_ALIGNMENT_UBYTE 255 Compu_IDENTITY 0 255 PHYS_UNIT "FTB" /end CHARACTERISTIC
/begin CHARACTERISTIC FCftb_RS_hiV "FCtl_FTB_0x04(599)" VALUE 0x001656C8 /* @ECU_Address@FCtl_FTB_0x04@0x024C5257@ */ ECIPP_ALIGNMENT_UBYTE 255 Compu_IDENTITY 0 255 PHYS_UNIT "FTB" /end CHARACTERISTIC
/begin CHARACTERISTIC FCftb_RS_loss "FCtl_FTB_0x04(220)" VALUE 0x0016554D /* @ECU_Address@FCtl_FTB_0x04@0x024C50DC@ */ ECIPP_ALIGNMENT_UBYTE 255 Compu_IDENTITY 0 255 PHYS_UNIT "FTB" /end CHARACTERISTIC
/begin CHARACTERISTIC FCftb_RS_loV "FCtl_FTB_0x04(598)" VALUE 0x001656C7 /* @ECU_Address@FCtl_FTB_0x04@0x024C5256@ */ ECIPP_ALIGNMENT_UBYTE 255 Compu_IDENTITY 0 255 PHYS_UNIT "FTB" /end CHARACTERISTIC
/begin CHARACTERISTIC FCftb_RS485_bad_fmt "FCtl_FTB_0x04(124)" VALUE 0x001654ED /* @ECU_Address@FCtl_FTB_0x04@0x024C507C@ */ ECIPP_ALIGNMENT_UBYTE 255 Compu_IDENTITY 0 255 PHYS_UNIT "FTB" /end CHARACTERISTIC
/begin CHARACTERISTIC FCftb_RS485_Rx_inact "FCtl_FTB_0x04(122)" VALUE 0x001654EB /* @ECU_Address@FCtl_FTB_0x04@0x024C507A@ */ ECIPP_ALIGNMENT_UBYTE 255 Compu_IDENTITY 0 255 PHYS_UNIT "FTB" /end CHARACTERISTIC
/begin CHARACTERISTIC FCftb_RS485_Rx_noise "FCtl_FTB_0x04(123)" VALUE 0x001654EC /* @ECU_Address@FCtl_FTB_0x04@0x024C507B@ */ ECIPP_ALIGNMENT_UBYTE 255 Compu_IDENTITY 0 255 PHYS_UNIT "FTB" /end CHARACTERISTIC
/begin CHARACTERISTIC FCftb_RS485_SD_rq "FCtl_FTB_0x04(125)" VALUE 0x001654EE /* @ECU_Address@FCtl_FTB_0x04@0x024C507D@ */ ECIPP_ALIGNMENT_UBYTE 255 Compu_IDENTITY 0 255 PHYS_UNIT "FTB" /end CHARACTERISTIC
/begin CHARACTERISTIC FCftb_RTI1 "FCtl_FTB_0x04(100)" VALUE 0x001654D5 /* @ECU_Address@FCtl_FTB_0x04@0x024C5064@ */ ECIPP_ALIGNMENT_UBYTE 255 Compu_IDENTITY 0 255 PHYS_UNIT "FTB" /end CHARACTERISTIC
/begin CHARACTERISTIC FCftb_RTI2 "FCtl_FTB_0x04(101)" VALUE 0x001654D6 /* @ECU_Address@FCtl_FTB_0x04@0x024C5065@ */ ECIPP_ALIGNMENT_UBYTE 255 Compu_IDENTITY 0 255 PHYS_UNIT "FTB" /end CHARACTERISTIC
/begin CHARACTERISTIC FCftb_RTI3 "FCtl_FTB_0x04(102)" VALUE 0x001654D7 /* @ECU_Address@FCtl_FTB_0x04@0x024C5066@ */ ECIPP_ALIGNMENT_UBYTE 255 Compu_IDENTITY 0 255 PHYS_UNIT "FTB" /end CHARACTERISTIC
/begin CHARACTERISTIC FCftb_SHIFT_FB_OOR "FCtl_FTB_0x04(294)" VALUE 0x00165597 /* @ECU_Address@FCtl_FTB_0x04@0x024C5126@ */ ECIPP_ALIGNMENT_UBYTE 255 Compu_IDENTITY 0 255 PHYS_UNIT "FTB" /end CHARACTERISTIC
/begin CHARACTERISTIC FCftb_SHIFT_intcirc_fail "FCtl_FTB_0x04(296)" VALUE 0x00165599 /* @ECU_Address@FCtl_FTB_0x04@0x024C5128@ */ ECIPP_ALIGNMENT_UBYTE 255 Compu_IDENTITY 0 255 PHYS_UNIT "FTB" /end CHARACTERISTIC
/begin CHARACTERISTIC FCftb_SHIFT_shift_fail "FCtl_FTB_0x04(295)" VALUE 0x00165598 /* @ECU_Address@FCtl_FTB_0x04@0x024C5127@ */ ECIPP_ALIGNMENT_UBYTE 255 Compu_IDENTITY 0 255 PHYS_UNIT "FTB" /end CHARACTERISTIC
/begin CHARACTERISTIC FCftb_SL_fuel "FCtl_FTB_0x04(109)" VALUE 0x001654DE /* @ECU_Address@FCtl_FTB_0x04@0x024C506D@ */ ECIPP_ALIGNMENT_UBYTE 255 Compu_IDENTITY 0 255 PHYS_UNIT "FTB" /end CHARACTERISTIC
/begin CHARACTERISTIC FCftb_SL_gov "FCtl_FTB_0x04(108)" VALUE 0x001654DD /* @ECU_Address@FCtl_FTB_0x04@0x024C506C@ */ ECIPP_ALIGNMENT_UBYTE 255 Compu_IDENTITY 0 255 PHYS_UNIT "FTB" /end CHARACTERISTIC
/begin CHARACTERISTIC FCftb_SL_spk "FCtl_FTB_0x04(110)" VALUE 0x001654DF /* @ECU_Address@FCtl_FTB_0x04@0x024C506E@ */ ECIPP_ALIGNMENT_UBYTE 255 Compu_IDENTITY 0 255 PHYS_UNIT "FTB" /end CHARACTERISTIC
/begin CHARACTERISTIC FCftb_slv_MAP_hi_OOA "FCtl_FTB_0x04(837)" VALUE 0x001657B6 /* @ECU_Address@FCtl_FTB_0x04@0x024C5345@ */ ECIPP_ALIGNMENT_UBYTE 255 Compu_IDENTITY 0 255 PHYS_UNIT "FTB" /end CHARACTERISTIC
/begin CHARACTERISTIC FCftb_slv_MAP_lo_OOA "FCtl_FTB_0x04(838)" VALUE 0x001657B7 /* @ECU_Address@FCtl_FTB_0x04@0x024C5346@ */ ECIPP_ALIGNMENT_UBYTE 255 Compu_IDENTITY 0 255 PHYS_UNIT "FTB" /end CHARACTERISTIC
/begin CHARACTERISTIC FCftb_SPK_int_fail "FCtl_FTB_0x04(303)" VALUE 0x001655A0 /* @ECU_Address@FCtl_FTB_0x04@0x024C512F@ */ ECIPP_ALIGNMENT_UBYTE 255 Compu_IDENTITY 0 255 PHYS_UNIT "FTB" /end CHARACTERISTIC
/begin CHARACTERISTIC FCftb_SPK1_IGBT_T "FCtl_FTB_0x04(509)" VALUE 0x0016566E /* @ECU_Address@FCtl_FTB_0x04@0x024C51FD@ */ ECIPP_ALIGNMENT_UBYTE 255 Compu_IDENTITY 0 255 PHYS_UNIT "FTB" /end CHARACTERISTIC
/begin CHARACTERISTIC FCftb_SPKD_coil_fail "FCtl_FTB_0x04(304)" VALUE 0x001655A1 /* @ECU_Address@FCtl_FTB_0x04@0x024C5130@ */ ECIPP_ALIGNMENT_UBYTE 255 Compu_IDENTITY 0 255 PHYS_UNIT "FTB" /end CHARACTERISTIC
/begin CHARACTERISTIC FCftb_SPKD_dw_hi "FCtl_FTB_0x04(76)" VALUE 0x001654BD /* @ECU_Address@FCtl_FTB_0x04@0x024C504C@ */ ECIPP_ALIGNMENT_UBYTE 255 Compu_IDENTITY 0 255 PHYS_UNIT "FTB" /end CHARACTERISTIC
/begin CHARACTERISTIC FCftb_SPKD_dw_lo "FCtl_FTB_0x04(66)" VALUE 0x001654B3 /* @ECU_Address@FCtl_FTB_0x04@0x024C5042@ */ ECIPP_ALIGNMENT_UBYTE 255 Compu_IDENTITY 0 255 PHYS_UNIT "FTB" /end CHARACTERISTIC
/begin CHARACTERISTIC FCftb_SRVC_expired "FCtl_FTB_0x04(426)" VALUE 0x0016561B /* @ECU_Address@FCtl_FTB_0x04@0x024C51AA@ */ ECIPP_ALIGNMENT_UBYTE 255 Compu_IDENTITY 0 255 PHYS_UNIT "FTB" /end CHARACTERISTIC
/begin CHARACTERISTIC FCftb_SRVC_expired2 "FCtl_FTB_0x04(836)" VALUE 0x001657B5 /* @ECU_Address@FCtl_FTB_0x04@0x024C5344@ */ ECIPP_ALIGNMENT_UBYTE 255 Compu_IDENTITY 0 255 PHYS_UNIT "FTB" /end CHARACTERISTIC
/begin CHARACTERISTIC FCftb_start_coilopen "FCtl_FTB_0x04(162)" VALUE 0x00165513 /* @ECU_Address@FCtl_FTB_0x04@0x024C50A2@ */ ECIPP_ALIGNMENT_UBYTE 255 Compu_IDENTITY 0 255 PHYS_UNIT "FTB" /end CHARACTERISTIC
/begin CHARACTERISTIC FCftb_start_coilshort "FCtl_FTB_0x04(163)" VALUE 0x00165514 /* @ECU_Address@FCtl_FTB_0x04@0x024C50A3@ */ ECIPP_ALIGNMENT_UBYTE 255 Compu_IDENTITY 0 255 PHYS_UNIT "FTB" /end CHARACTERISTIC
/begin CHARACTERISTIC FCftb_start_excess "FCtl_FTB_0x04(840)" VALUE 0x001657B9 /* @ECU_Address@FCtl_FTB_0x04@0x024C5348@ */ ECIPP_ALIGNMENT_UBYTE 255 Compu_IDENTITY 0 255 PHYS_UNIT "FTB" /end CHARACTERISTIC
/begin CHARACTERISTIC FCftb_start_gndshort "FCtl_FTB_0x04(161)" VALUE 0x00165512 /* @ECU_Address@FCtl_FTB_0x04@0x024C50A1@ */ ECIPP_ALIGNMENT_UBYTE 255 Compu_IDENTITY 0 255 PHYS_UNIT "FTB" /end CHARACTERISTIC
/begin CHARACTERISTIC FCftb_start_stuck_active "FCtl_FTB_0x04(320)" VALUE 0x001655B1 /* @ECU_Address@FCtl_FTB_0x04@0x024C5140@ */ ECIPP_ALIGNMENT_UBYTE 255 Compu_IDENTITY 0 255 PHYS_UNIT "FTB" /end CHARACTERISTIC
/begin CHARACTERISTIC FCftb_SubDiagTemp "FCtl_FTB_0x04(653)" VALUE 0x001656FE /* @ECU_Address@FCtl_FTB_0x04@0x024C528D@ */ ECIPP_ALIGNMENT_UBYTE 255 Compu_IDENTITY 0 255 PHYS_UNIT "FTB" /end CHARACTERISTIC
/begin CHARACTERISTIC FCftb_tach_gndshort "FCtl_FTB_0x04(173)" VALUE 0x0016551E /* @ECU_Address@FCtl_FTB_0x04@0x024C50AD@ */ ECIPP_ALIGNMENT_UBYTE 255 Compu_IDENTITY 0 255 PHYS_UNIT "FTB" /end CHARACTERISTIC
/begin CHARACTERISTIC FCftb_tach_pwrshort "FCtl_FTB_0x04(174)" VALUE 0x0016551F /* @ECU_Address@FCtl_FTB_0x04@0x024C50AE@ */ ECIPP_ALIGNMENT_UBYTE 255 Compu_IDENTITY 0 255 PHYS_UNIT "FTB" /end CHARACTERISTIC
/begin CHARACTERISTIC FCftb_TAUX_dT1_max "FCtl_FTB_0x04(558)" VALUE 0x0016569F /* @ECU_Address@FCtl_FTB_0x04@0x024C522E@ */ ECIPP_ALIGNMENT_UBYTE 255 Compu_IDENTITY 0 255 PHYS_UNIT "FTB" /end CHARACTERISTIC
/begin CHARACTERISTIC FCftb_TAUX_dT1_min "FCtl_FTB_0x04(559)" VALUE 0x001656A0 /* @ECU_Address@FCtl_FTB_0x04@0x024C522F@ */ ECIPP_ALIGNMENT_UBYTE 255 Compu_IDENTITY 0 255 PHYS_UNIT "FTB" /end CHARACTERISTIC
/begin CHARACTERISTIC FCftb_TAUX_dT2_max "FCtl_FTB_0x04(560)" VALUE 0x001656A1 /* @ECU_Address@FCtl_FTB_0x04@0x024C5230@ */ ECIPP_ALIGNMENT_UBYTE 255 Compu_IDENTITY 0 255 PHYS_UNIT "FTB" /end CHARACTERISTIC
/begin CHARACTERISTIC FCftb_TAUX_dT2_min "FCtl_FTB_0x04(561)" VALUE 0x001656A2 /* @ECU_Address@FCtl_FTB_0x04@0x024C5231@ */ ECIPP_ALIGNMENT_UBYTE 255 Compu_IDENTITY 0 255 PHYS_UNIT "FTB" /end CHARACTERISTIC
/begin CHARACTERISTIC FCftb_Taux1_derate_actv "FCtl_FTB_0x04(812)" VALUE 0x0016579D /* @ECU_Address@FCtl_FTB_0x04@0x024C532C@ */ ECIPP_ALIGNMENT_UBYTE 255 Compu_IDENTITY 0 255 PHYS_UNIT "FTB" /end CHARACTERISTIC
/begin CHARACTERISTIC FCftb_TAUX1_max "FCtl_FTB_0x04(550)" VALUE 0x00165697 /* @ECU_Address@FCtl_FTB_0x04@0x024C5226@ */ ECIPP_ALIGNMENT_UBYTE 255 Compu_IDENTITY 0 255 PHYS_UNIT "FTB" /end CHARACTERISTIC
/begin CHARACTERISTIC FCftb_TAUX1_min "FCtl_FTB_0x04(551)" VALUE 0x00165698 /* @ECU_Address@FCtl_FTB_0x04@0x024C5227@ */ ECIPP_ALIGNMENT_UBYTE 255 Compu_IDENTITY 0 255 PHYS_UNIT "FTB" /end CHARACTERISTIC
/begin CHARACTERISTIC FCftb_Taux2_derate_actv "FCtl_FTB_0x04(813)" VALUE 0x0016579E /* @ECU_Address@FCtl_FTB_0x04@0x024C532D@ */ ECIPP_ALIGNMENT_UBYTE 255 Compu_IDENTITY 0 255 PHYS_UNIT "FTB" /end CHARACTERISTIC
/begin CHARACTERISTIC FCspn_PWM21_on_hiVf "FCtl_SPN(456)" VALUE 0x001623FC /* @ECU_Address@FCtl_SPN@0x021B6720@ */ ECIPP_ALIGNMENT_ULONG 4294967295 Compu_IDENTITY 0 4294967295 PHYS_UNIT "SPN" /end CHARACTERISTIC
/begin CHARACTERISTIC FCspn_PWM22_off_loVf "FCtl_SPN(457)" VALUE 0x00162400 /* @ECU_Address@FCtl_SPN@0x021B6724@ */ ECIPP_ALIGNMENT_ULONG 4294967295 Compu_IDENTITY 0 4294967295 PHYS_UNIT "SPN" /end CHARACTERISTIC
/begin CHARACTERISTIC FCspn_PWM22_on_hiVf "FCtl_SPN(458)" VALUE 0x00162404 /* @ECU_Address@FCtl_SPN@0x021B6728@ */ ECIPP_ALIGNMENT_ULONG 4294967295 Compu_IDENTITY 0 4294967295 PHYS_UNIT "SPN" /end CHARACTERISTIC
/begin CHARACTERISTIC FCspn_PWM23_off_loVf "FCtl_SPN(459)" VALUE 0x00162408 /* @ECU_Address@FCtl_SPN@0x021B672C@ */ ECIPP_ALIGNMENT_ULONG 4294967295 Compu_IDENTITY 0 4294967295 PHYS_UNIT "SPN" /end CHARACTERISTIC
/begin CHARACTERISTIC FCspn_PWM23_on_hiVf "FCtl_SPN(460)" VALUE 0x0016240C /* @ECU_Address@FCtl_SPN@0x021B6730@ */ ECIPP_ALIGNMENT_ULONG 4294967295 Compu_IDENTITY 0 4294967295 PHYS_UNIT "SPN" /end CHARACTERISTIC
/begin CHARACTERISTIC FCspn_PWM3_off_loVf "FCtl_SPN(193)" VALUE 0x00161FE0 /* @ECU_Address@FCtl_SPN@0x021B6304@ */ ECIPP_ALIGNMENT_ULONG 4294967295 Compu_IDENTITY 0 4294967295 PHYS_UNIT "SPN" /end CHARACTERISTIC
/begin CHARACTERISTIC FCspn_PWM3_on_hiVf "FCtl_SPN(194)" VALUE 0x00161FE4 /* @ECU_Address@FCtl_SPN@0x021B6308@ */ ECIPP_ALIGNMENT_ULONG 4294967295 Compu_IDENTITY 0 4294967295 PHYS_UNIT "SPN" /end CHARACTERISTIC
/begin CHARACTERISTIC FCspn_PWM4_off_loVf "FCtl_SPN(195)" VALUE 0x00161FE8 /* @ECU_Address@FCtl_SPN@0x021B630C@ */ ECIPP_ALIGNMENT_ULONG 4294967295 Compu_IDENTITY 0 4294967295 PHYS_UNIT "SPN" /end CHARACTERISTIC
/begin CHARACTERISTIC FCspn_PWM4_on_hiVf "FCtl_SPN(196)" VALUE 0x00161FEC /* @ECU_Address@FCtl_SPN@0x021B6310@ */ ECIPP_ALIGNMENT_ULONG 4294967295 Compu_IDENTITY 0 4294967295 PHYS_UNIT "SPN" /end CHARACTERISTIC
/begin CHARACTERISTIC FCspn_PWM5_off_loVf "FCtl_SPN(197)" VALUE 0x00161FF0 /* @ECU_Address@FCtl_SPN@0x021B6314@ */ ECIPP_ALIGNMENT_ULONG 4294967295 Compu_IDENTITY 0 4294967295 PHYS_UNIT "SPN" /end CHARACTERISTIC
/begin CHARACTERISTIC FCspn_PWM5_on_hiVf "FCtl_SPN(198)" VALUE 0x00161FF4 /* @ECU_Address@FCtl_SPN@0x021B6318@ */ ECIPP_ALIGNMENT_ULONG 4294967295 Compu_IDENTITY 0 4294967295 PHYS_UNIT "SPN" /end CHARACTERISTIC
/begin CHARACTERISTIC FCspn_PWM6_off_loVf "FCtl_SPN(276)" VALUE 0x0016212C /* @ECU_Address@FCtl_SPN@0x021B6450@ */ ECIPP_ALIGNMENT_ULONG 4294967295 Compu_IDENTITY 0 4294967295 PHYS_UNIT "SPN" /end CHARACTERISTIC
/begin CHARACTERISTIC FCspn_PWM6_on_hiVf "FCtl_SPN(277)" VALUE 0x00162130 /* @ECU_Address@FCtl_SPN@0x021B6454@ */ ECIPP_ALIGNMENT_ULONG 4294967295 Compu_IDENTITY 0 4294967295 PHYS_UNIT "SPN" /end CHARACTERISTIC
/begin CHARACTERISTIC FCspn_PWM7_off_loVf "FCtl_SPN(278)" VALUE 0x00162134 /* @ECU_Address@FCtl_SPN@0x021B6458@ */ ECIPP_ALIGNMENT_ULONG 4294967295 Compu_IDENTITY 0 4294967295 PHYS_UNIT "SPN" /end CHARACTERISTIC
/begin CHARACTERISTIC FCspn_PWM7_on_hiVf "FCtl_SPN(279)" VALUE 0x00162138 /* @ECU_Address@FCtl_SPN@0x021B645C@ */ ECIPP_ALIGNMENT_ULONG 4294967295 Compu_IDENTITY 0 4294967295 PHYS_UNIT "SPN" /end CHARACTERISTIC
/begin CHARACTERISTIC FCspn_PWM8_off_loVf "FCtl_SPN(283)" VALUE 0x00162148 /* @ECU_Address@FCtl_SPN@0x021B646C@ */ ECIPP_ALIGNMENT_ULONG 4294967295 Compu_IDENTITY 0 4294967295 PHYS_UNIT "SPN" /end CHARACTERISTIC
/begin CHARACTERISTIC FCspn_PWM8_on_hiVf "FCtl_SPN(284)" VALUE 0x0016214C /* @ECU_Address@FCtl_SPN@0x021B6470@ */ ECIPP_ALIGNMENT_ULONG 4294967295 Compu_IDENTITY 0 4294967295 PHYS_UNIT "SPN" /end CHARACTERISTIC
/begin CHARACTERISTIC FCspn_PWM9_off_loVf "FCtl_SPN(285)" VALUE 0x00162150 /* @ECU_Address@FCtl_SPN@0x021B6474@ */ ECIPP_ALIGNMENT_ULONG 4294967295 Compu_IDENTITY 0 4294967295 PHYS_UNIT "SPN" /end CHARACTERISTIC
/begin CHARACTERISTIC FCspn_PWM9_on_hiVf "FCtl_SPN(286)" VALUE 0x00162154 /* @ECU_Address@FCtl_SPN@0x021B6478@ */ ECIPP_ALIGNMENT_ULONG 4294967295 Compu_IDENTITY 0 4294967295 PHYS_UNIT "SPN" /end CHARACTERISTIC
/begin CHARACTERISTIC FCspn_PWMLO_off_loVf "FCtl_SPN(521)" VALUE 0x00162500 /* @ECU_Address@FCtl_SPN@0x021B6824@ */ ECIPP_ALIGNMENT_ULONG 4294967295 Compu_IDENTITY 0 4294967295 PHYS_UNIT "SPN" /end CHARACTERISTIC
/begin CHARACTERISTIC FCspn_PWMLO_on_hiVf "FCtl_SPN(522)" VALUE 0x00162504 /* @ECU_Address@FCtl_SPN@0x021B6828@ */ ECIPP_ALIGNMENT_ULONG 4294967295 Compu_IDENTITY 0 4294967295 PHYS_UNIT "SPN" /end CHARACTERISTIC
/begin CHARACTERISTIC FCspn_RAM_fail "FCtl_SPN(106)" VALUE 0x00161E84 /* @ECU_Address@FCtl_SPN@0x021B61A8@ */ ECIPP_ALIGNMENT_ULONG 4294967295 Compu_IDENTITY 0 4294967295 PHYS_UNIT "SPN" /end CHARACTERISTIC
/begin CHARACTERISTIC FCspn_relay_coilopen "FCtl_SPN(159)" VALUE 0x00161F58 /* @ECU_Address@FCtl_SPN@0x021B627C@ */ ECIPP_ALIGNMENT_ULONG 4294967295 Compu_IDENTITY 0 4294967295 PHYS_UNIT "SPN" /end CHARACTERISTIC
/begin CHARACTERISTIC FCspn_relay_coilshort "FCtl_SPN(160)" VALUE 0x00161F5C /* @ECU_Address@FCtl_SPN@0x021B6280@ */ ECIPP_ALIGNMENT_ULONG 4294967295 Compu_IDENTITY 0 4294967295 PHYS_UNIT "SPN" /end CHARACTERISTIC
/begin CHARACTERISTIC FCspn_relay_gndshort "FCtl_SPN(158)" VALUE 0x00161F54 /* @ECU_Address@FCtl_SPN@0x021B6278@ */ ECIPP_ALIGNMENT_ULONG 4294967295 Compu_IDENTITY 0 4294967295 PHYS_UNIT "SPN" /end CHARACTERISTIC
/begin CHARACTERISTIC FCspn_relayoff_hiV "FCtl_SPN(431)" VALUE 0x00162398 /* @ECU_Address@FCtl_SPN@0x021B66BC@ */ ECIPP_ALIGNMENT_ULONG 4294967295 Compu_IDENTITY 0 4294967295 PHYS_UNIT "SPN" /end CHARACTERISTIC
/begin CHARACTERISTIC FCspn_relayon_loV "FCtl_SPN(432)" VALUE 0x0016239C /* @ECU_Address@FCtl_SPN@0x021B66C0@ */ ECIPP_ALIGNMENT_ULONG 4294967295 Compu_IDENTITY 0 4294967295 PHYS_UNIT "SPN" /end CHARACTERISTIC
/begin CHARACTERISTIC FCspn_rpm_hi_expected "FCtl_SPN(351)" VALUE 0x00162258 /* @ECU_Address@FCtl_SPN@0x021B657C@ */ ECIPP_ALIGNMENT_ULONG 4294967295 Compu_IDENTITY 0 4294967295 PHYS_UNIT "SPN" /end CHARACTERISTIC
/begin CHARACTERISTIC FCspn_rpmd_gov_lo "FCtl_SPN(520)" VALUE 0x001624FC /* @ECU_Address@FCtl_SPN@0x021B6820@ */ ECIPP_ALIGNMENT_ULONG 4294967295 Compu_IDENTITY 0 4294967295 PHYS_UNIT "SPN" /end CHARACTERISTIC
/begin CHARACTERISTIC FCspn_RS_discon "FCtl_SPN(691)" VALUE 0x001627A8 /* @ECU_Address@FCtl_SPN@0x021B6ACC@ */ ECIPP_ALIGNMENT_ULONG 4294967295 Compu_IDENTITY 0 4294967295 PHYS_UNIT "SPN" /end CHARACTERISTIC
/begin CHARACTERISTIC FCspn_RS_hiV "FCtl_SPN(599)" VALUE 0x00162638 /* @ECU_Address@FCtl_SPN@0x021B695C@ */ ECIPP_ALIGNMENT_ULONG 4294967295 Compu_IDENTITY 0 4294967295 PHYS_UNIT "SPN" /end CHARACTERISTIC
/begin CHARACTERISTIC FCspn_RS_loss "FCtl_SPN(220)" VALUE 0x0016204C /* @ECU_Address@FCtl_SPN@0x021B6370@ */ ECIPP_ALIGNMENT_ULONG 4294967295 Compu_IDENTITY 0 4294967295 PHYS_UNIT "SPN" /end CHARACTERISTIC
/begin CHARACTERISTIC FCspn_RS_loV "FCtl_SPN(598)" VALUE 0x00162634 /* @ECU_Address@FCtl_SPN@0x021B6958@ */ ECIPP_ALIGNMENT_ULONG 4294967295 Compu_IDENTITY 0 4294967295 PHYS_UNIT "SPN" /end CHARACTERISTIC
/begin CHARACTERISTIC FCspn_RS485_bad_fmt "FCtl_SPN(124)" VALUE 0x00161ECC /* @ECU_Address@FCtl_SPN@0x021B61F0@ */ ECIPP_ALIGNMENT_ULONG 4294967295 Compu_IDENTITY 0 4294967295 PHYS_UNIT "SPN" /end CHARACTERISTIC
/begin CHARACTERISTIC FCspn_RS485_Rx_inact "FCtl_SPN(122)" VALUE 0x00161EC4 /* @ECU_Address@FCtl_SPN@0x021B61E8@ */ ECIPP_ALIGNMENT_ULONG 4294967295 Compu_IDENTITY 0 4294967295 PHYS_UNIT "SPN" /end CHARACTERISTIC
/begin CHARACTERISTIC FCspn_RS485_Rx_noise "FCtl_SPN(123)" VALUE 0x00161EC8 /* @ECU_Address@FCtl_SPN@0x021B61EC@ */ ECIPP_ALIGNMENT_ULONG 4294967295 Compu_IDENTITY 0 4294967295 PHYS_UNIT "SPN" /end CHARACTERISTIC
/begin CHARACTERISTIC FCspn_RS485_SD_rq "FCtl_SPN(125)" VALUE 0x00161ED0 /* @ECU_Address@FCtl_SPN@0x021B61F4@ */ ECIPP_ALIGNMENT_ULONG 4294967295 Compu_IDENTITY 0 4294967295 PHYS_UNIT "SPN" /end CHARACTERISTIC
/begin CHARACTERISTIC FCspn_RTI1 "FCtl_SPN(100)" VALUE 0x00161E6C /* @ECU_Address@FCtl_SPN@0x021B6190@ */ ECIPP_ALIGNMENT_ULONG 4294967295 Compu_IDENTITY 0 4294967295 PHYS_UNIT "SPN" /end CHARACTERISTIC
/begin CHARACTERISTIC FCspn_RTI2 "FCtl_SPN(101)" VALUE 0x00161E70 /* @ECU_Address@FCtl_SPN@0x021B6194@ */ ECIPP_ALIGNMENT_ULONG 4294967295 Compu_IDENTITY 0 4294967295 PHYS_UNIT "SPN" /end CHARACTERISTIC
/begin CHARACTERISTIC FCspn_RTI3 "FCtl_SPN(102)" VALUE 0x00161E74 /* @ECU_Address@FCtl_SPN@0x021B6198@ */ ECIPP_ALIGNMENT_ULONG 4294967295 Compu_IDENTITY 0 4294967295 PHYS_UNIT "SPN" /end CHARACTERISTIC
/begin CHARACTERISTIC FCspn_SHIFT_FB_OOR "FCtl_SPN(294)" VALUE 0x00162174 /* @ECU_Address@FCtl_SPN@0x021B6498@ */ ECIPP_ALIGNMENT_ULONG 4294967295 Compu_IDENTITY 0 4294967295 PHYS_UNIT "SPN" /end CHARACTERISTIC
/begin CHARACTERISTIC FCspn_SHIFT_intcirc_fail "FCtl_SPN(296)" VALUE 0x0016217C /* @ECU_Address@FCtl_SPN@0x021B64A0@ */ ECIPP_ALIGNMENT_ULONG 4294967295 Compu_IDENTITY 0 4294967295 PHYS_UNIT "SPN" /end CHARACTERISTIC
/begin CHARACTERISTIC FCspn_SHIFT_shift_fail "FCtl_SPN(295)" VALUE 0x00162178 /* @ECU_Address@FCtl_SPN@0x021B649C@ */ ECIPP_ALIGNMENT_ULONG 4294967295 Compu_IDENTITY 0 4294967295 PHYS_UNIT "SPN" /end CHARACTERISTIC
/begin CHARACTERISTIC FCspn_SL_fuel "FCtl_SPN(109)" VALUE 0x00161E90 /* @ECU_Address@FCtl_SPN@0x021B61B4@ */ ECIPP_ALIGNMENT_ULONG 4294967295 Compu_IDENTITY 0 4294967295 PHYS_UNIT "SPN" /end CHARACTERISTIC
/begin CHARACTERISTIC FCspn_SL_gov "FCtl_SPN(108)" VALUE 0x00161E8C /* @ECU_Address@FCtl_SPN@0x021B61B0@ */ ECIPP_ALIGNMENT_ULONG 4294967295 Compu_IDENTITY 0 4294967295 PHYS_UNIT "SPN" /end CHARACTERISTIC
/begin CHARACTERISTIC FCspn_SL_spk "FCtl_SPN(110)" VALUE 0x00161E94 /* @ECU_Address@FCtl_SPN@0x021B61B8@ */ ECIPP_ALIGNMENT_ULONG 4294967295 Compu_IDENTITY 0 4294967295 PHYS_UNIT "SPN" /end CHARACTERISTIC
/begin CHARACTERISTIC FCspn_slv_MAP_hi_OOA "FCtl_SPN(837)" VALUE 0x001629F0 /* @ECU_Address@FCtl_SPN@0x021B6D14@ */ ECIPP_ALIGNMENT_ULONG 4294967295 Compu_IDENTITY 0 4294967295 PHYS_UNIT "SPN" /end CHARACTERISTIC
/begin CHARACTERISTIC FCspn_slv_MAP_lo_OOA "FCtl_SPN(838)" VALUE 0x001629F4 /* @ECU_Address@FCtl_SPN@0x021B6D18@ */ ECIPP_ALIGNMENT_ULONG 4294967295 Compu_IDENTITY 0 4294967295 PHYS_UNIT "SPN" /end CHARACTERISTIC
/begin CHARACTERISTIC FCspn_SPK_int_fail "FCtl_SPN(303)" VALUE 0x00162198 /* @ECU_Address@FCtl_SPN@0x021B64BC@ */ ECIPP_ALIGNMENT_ULONG 4294967295 Compu_IDENTITY 0 4294967295 PHYS_UNIT "SPN" /end CHARACTERISTIC
/begin CHARACTERISTIC FCspn_SPK1_IGBT_T "FCtl_SPN(509)" VALUE 0x001624D0 /* @ECU_Address@FCtl_SPN@0x021B67F4@ */ ECIPP_ALIGNMENT_ULONG 4294967295 Compu_IDENTITY 0 4294967295 PHYS_UNIT "SPN" /end CHARACTERISTIC
/begin CHARACTERISTIC FCspn_SPKD_coil_fail "FCtl_SPN(304)" VALUE 0x0016219C /* @ECU_Address@FCtl_SPN@0x021B64C0@ */ ECIPP_ALIGNMENT_ULONG 4294967295 Compu_IDENTITY 0 4294967295 PHYS_UNIT "SPN" /end CHARACTERISTIC
/begin CHARACTERISTIC FCspn_SPKD_dw_hi "FCtl_SPN(76)" VALUE 0x00161E0C /* @ECU_Address@FCtl_SPN@0x021B6130@ */ ECIPP_ALIGNMENT_ULONG 4294967295 Compu_IDENTITY 0 4294967295 PHYS_UNIT "SPN" /end CHARACTERISTIC
/begin CHARACTERISTIC FCspn_SPKD_dw_lo "FCtl_SPN(66)" VALUE 0x00161DE4 /* @ECU_Address@FCtl_SPN@0x021B6108@ */ ECIPP_ALIGNMENT_ULONG 4294967295 Compu_IDENTITY 0 4294967295 PHYS_UNIT "SPN" /end CHARACTERISTIC
/begin CHARACTERISTIC FCspn_SRVC_expired "FCtl_SPN(426)" VALUE 0x00162384 /* @ECU_Address@FCtl_SPN@0x021B66A8@ */ ECIPP_ALIGNMENT_ULONG 4294967295 Compu_IDENTITY 0 4294967295 PHYS_UNIT "SPN" /end CHARACTERISTIC
/begin CHARACTERISTIC FCspn_SRVC_expired2 "FCtl_SPN(836)" VALUE 0x001629EC /* @ECU_Address@FCtl_SPN@0x021B6D10@ */ ECIPP_ALIGNMENT_ULONG 4294967295 Compu_IDENTITY 0 4294967295 PHYS_UNIT "SPN" /end CHARACTERISTIC
/begin CHARACTERISTIC FCspn_start_coilopen "FCtl_SPN(162)" VALUE 0x00161F64 /* @ECU_Address@FCtl_SPN@0x021B6288@ */ ECIPP_ALIGNMENT_ULONG 4294967295 Compu_IDENTITY 0 4294967295 PHYS_UNIT "SPN" /end CHARACTERISTIC
/begin CHARACTERISTIC FCspn_start_coilshort "FCtl_SPN(163)" VALUE 0x00161F68 /* @ECU_Address@FCtl_SPN@0x021B628C@ */ ECIPP_ALIGNMENT_ULONG 4294967295 Compu_IDENTITY 0 4294967295 PHYS_UNIT "SPN" /end CHARACTERISTIC
/begin CHARACTERISTIC FCspn_start_excess "FCtl_SPN(840)" VALUE 0x001629FC /* @ECU_Address@FCtl_SPN@0x021B6D20@ */ ECIPP_ALIGNMENT_ULONG 4294967295 Compu_IDENTITY 0 4294967295 PHYS_UNIT "SPN" /end CHARACTERISTIC
/begin CHARACTERISTIC FCspn_start_gndshort "FCtl_SPN(161)" VALUE 0x00161F60 /* @ECU_Address@FCtl_SPN@0x021B6284@ */ ECIPP_ALIGNMENT_ULONG 4294967295 Compu_IDENTITY 0 4294967295 PHYS_UNIT "SPN" /end CHARACTERISTIC
/begin CHARACTERISTIC FCspn_start_stuck_active "FCtl_SPN(320)" VALUE 0x001621DC /* @ECU_Address@FCtl_SPN@0x021B6500@ */ ECIPP_ALIGNMENT_ULONG 4294967295 Compu_IDENTITY 0 4294967295 PHYS_UNIT "SPN" /end CHARACTERISTIC
/begin CHARACTERISTIC FCspn_SubDiagTemp "FCtl_SPN(653)" VALUE 0x00162710 /* @ECU_Address@FCtl_SPN@0x021B6A34@ */ ECIPP_ALIGNMENT_ULONG 4294967295 Compu_IDENTITY 0 4294967295 PHYS_UNIT "SPN" /end CHARACTERISTIC
/begin CHARACTERISTIC FCspn_tach_gndshort "FCtl_SPN(173)" VALUE 0x00161F90 /* @ECU_Address@FCtl_SPN@0x021B62B4@ */ ECIPP_ALIGNMENT_ULONG 4294967295 Compu_IDENTITY 0 4294967295 PHYS_UNIT "SPN" /end CHARACTERISTIC
/begin CHARACTERISTIC FCspn_tach_pwrshort "FCtl_SPN(174)" VALUE 0x00161F94 /* @ECU_Address@FCtl_SPN@0x021B62B8@ */ ECIPP_ALIGNMENT_ULONG 4294967295 Compu_IDENTITY 0 4294967295 PHYS_UNIT "SPN" /end CHARACTERISTIC
/begin CHARACTERISTIC FCspn_TAUX_dT1_max "FCtl_SPN(558)" VALUE 0x00162594 /* @ECU_Address@FCtl_SPN@0x021B68B8@ */ ECIPP_ALIGNMENT_ULONG 4294967295 Compu_IDENTITY 0 4294967295 PHYS_UNIT "SPN" /end CHARACTERISTIC
/begin CHARACTERISTIC FCspn_TAUX_dT1_min "FCtl_SPN(559)" VALUE 0x00162598 /* @ECU_Address@FCtl_SPN@0x021B68BC@ */ ECIPP_ALIGNMENT_ULONG 4294967295 Compu_IDENTITY 0 4294967295 PHYS_UNIT "SPN" /end CHARACTERISTIC
/begin CHARACTERISTIC FCspn_TAUX_dT2_max "FCtl_SPN(560)" VALUE 0x0016259C /* @ECU_Address@FCtl_SPN@0x021B68C0@ */ ECIPP_ALIGNMENT_ULONG 4294967295 Compu_IDENTITY 0 4294967295 PHYS_UNIT "SPN" /end CHARACTERISTIC
/begin CHARACTERISTIC FCspn_TAUX_dT2_min "FCtl_SPN(561)" VALUE 0x001625A0 /* @ECU_Address@FCtl_SPN@0x021B68C4@ */ ECIPP_ALIGNMENT_ULONG 4294967295 Compu_IDENTITY 0 4294967295 PHYS_UNIT "SPN" /end CHARACTERISTIC
/begin CHARACTERISTIC FCspn_Taux1_derate_actv "FCtl_SPN(812)" VALUE 0x0016298C /* @ECU_Address@FCtl_SPN@0x021B6CB0@ */ ECIPP_ALIGNMENT_ULONG 4294967295 Compu_IDENTITY 0 4294967295 PHYS_UNIT "SPN" /end CHARACTERISTIC
/begin CHARACTERISTIC FCspn_TAUX1_max "FCtl_SPN(550)" VALUE 0x00162574 /* @ECU_Address@FCtl_SPN@0x021B6898@ */ ECIPP_ALIGNMENT_ULONG 4294967295 Compu_IDENTITY 0 4294967295 PHYS_UNIT "SPN" /end CHARACTERISTIC
/begin CHARACTERISTIC FCspn_TAUX1_min "FCtl_SPN(551)" VALUE 0x00162578 /* @ECU_Address@FCtl_SPN@0x021B689C@ */ ECIPP_ALIGNMENT_ULONG 4294967295 Compu_IDENTITY 0 4294967295 PHYS_UNIT "SPN" /end CHARACTERISTIC
/begin CHARACTERISTIC FCspn_Taux2_derate_actv "FCtl_SPN(813)" VALUE 0x00162990 /* @ECU_Address@FCtl_SPN@0x021B6CB4@ */ ECIPP_ALIGNMENT_ULONG 4294967295 Compu_IDENTITY 0 4294967295 PHYS_UNIT "SPN" /end CHARACTERISTIC
/begin CHARACTERISTIC FPfl_PWM21_on_hiVf "FPrm_latch(353)" VALUE 0x0016059C /* @ECU_Address@FPrm_latch@0x021BB584@ */ ECIPP_ALIGNMENT_FLOAT32_IEEE 10000000000 Compu_IDENTITY -10000000000 10000000000 PHYS_UNIT "ms" /end CHARACTERISTIC
/begin CHARACTERISTIC FPfl_PWM22_off_loVf "FPrm_latch(354)" VALUE 0x001605A0 /* @ECU_Address@FPrm_latch@0x021BB588@ */ ECIPP_ALIGNMENT_FLOAT32_IEEE 10000000000 Compu_IDENTITY -10000000000 10000000000 PHYS_UNIT "ms" /end CHARACTERISTIC
/begin CHARACTERISTIC FPfl_PWM22_on_hiVf "FPrm_latch(355)" VALUE 0x001605A4 /* @ECU_Address@FPrm_latch@0x021BB58C@ */ ECIPP_ALIGNMENT_FLOAT32_IEEE 10000000000 Compu_IDENTITY -10000000000 10000000000 PHYS_UNIT "ms" /end CHARACTERISTIC
/begin CHARACTERISTIC FPfl_PWM23_off_loVf "FPrm_latch(356)" VALUE 0x001605A8 /* @ECU_Address@FPrm_latch@0x021BB590@ */ ECIPP_ALIGNMENT_FLOAT32_IEEE 10000000000 Compu_IDENTITY -10000000000 10000000000 PHYS_UNIT "ms" /end CHARACTERISTIC
/begin CHARACTERISTIC FPfl_PWM23_on_hiVf "FPrm_latch(357)" VALUE 0x001605AC /* @ECU_Address@FPrm_latch@0x021BB594@ */ ECIPP_ALIGNMENT_FLOAT32_IEEE 10000000000 Compu_IDENTITY -10000000000 10000000000 PHYS_UNIT "ms" /end CHARACTERISTIC
/begin CHARACTERISTIC FPfl_PWM3_off_loVf "FPrm_latch(151)" VALUE 0x00160274 /* @ECU_Address@FPrm_latch@0x021BB25C@ */ ECIPP_ALIGNMENT_FLOAT32_IEEE 10000000000 Compu_IDENTITY -10000000000 10000000000 PHYS_UNIT "ms" /end CHARACTERISTIC
/begin CHARACTERISTIC FPfl_PWM3_on_hiVf "FPrm_latch(152)" VALUE 0x00160278 /* @ECU_Address@FPrm_latch@0x021BB260@ */ ECIPP_ALIGNMENT_FLOAT32_IEEE 10000000000 Compu_IDENTITY -10000000000 10000000000 PHYS_UNIT "ms" /end CHARACTERISTIC
/begin CHARACTERISTIC FPfl_PWM4_off_loVf "FPrm_latch(153)" VALUE 0x0016027C /* @ECU_Address@FPrm_latch@0x021BB264@ */ ECIPP_ALIGNMENT_FLOAT32_IEEE 10000000000 Compu_IDENTITY -10000000000 10000000000 PHYS_UNIT "ms" /end CHARACTERISTIC
/begin CHARACTERISTIC FPfl_PWM4_on_hiVf "FPrm_latch(154)" VALUE 0x00160280 /* @ECU_Address@FPrm_latch@0x021BB268@ */ ECIPP_ALIGNMENT_FLOAT32_IEEE 10000000000 Compu_IDENTITY -10000000000 10000000000 PHYS_UNIT "ms" /end CHARACTERISTIC
/begin CHARACTERISTIC FPfl_PWM5_off_loVf "FPrm_latch(155)" VALUE 0x00160284 /* @ECU_Address@FPrm_latch@0x021BB26C@ */ ECIPP_ALIGNMENT_FLOAT32_IEEE 10000000000 Compu_IDENTITY -10000000000 10000000000 PHYS_UNIT "ms" /end CHARACTERISTIC
/begin CHARACTERISTIC FPfl_PWM5_on_hiVf "FPrm_latch(156)" VALUE 0x00160288 /* @ECU_Address@FPrm_latch@0x021BB270@ */ ECIPP_ALIGNMENT_FLOAT32_IEEE 10000000000 Compu_IDENTITY -10000000000 10000000000 PHYS_UNIT "ms" /end CHARACTERISTIC
/begin CHARACTERISTIC FPfl_PWM6_off_loVf "FPrm_latch(198)" VALUE 0x00160330 /* @ECU_Address@FPrm_latch@0x021BB318@ */ ECIPP_ALIGNMENT_FLOAT32_IEEE 10000000000 Compu_IDENTITY -10000000000 10000000000 PHYS_UNIT "ms" /end CHARACTERISTIC
/begin CHARACTERISTIC FPfl_PWM6_on_hiVf "FPrm_latch(199)" VALUE 0x00160334 /* @ECU_Address@FPrm_latch@0x021BB31C@ */ ECIPP_ALIGNMENT_FLOAT32_IEEE 10000000000 Compu_IDENTITY -10000000000 10000000000 PHYS_UNIT "ms" /end CHARACTERISTIC
/begin CHARACTERISTIC FPfl_PWM7_off_loVf "FPrm_latch(200)" VALUE 0x00160338 /* @ECU_Address@FPrm_latch@0x021BB320@ */ ECIPP_ALIGNMENT_FLOAT32_IEEE 10000000000 Compu_IDENTITY -10000000000 10000000000 PHYS_UNIT "ms" /end CHARACTERISTIC
/begin CHARACTERISTIC FPfl_PWM7_on_hiVf "FPrm_latch(201)" VALUE 0x0016033C /* @ECU_Address@FPrm_latch@0x021BB324@ */ ECIPP_ALIGNMENT_FLOAT32_IEEE 10000000000 Compu_IDENTITY -10000000000 10000000000 PHYS_UNIT "ms" /end CHARACTERISTIC
/begin CHARACTERISTIC FPfl_PWM8_off_loVf "FPrm_latch(205)" VALUE 0x0016034C /* @ECU_Address@FPrm_latch@0x021BB334@ */ ECIPP_ALIGNMENT_FLOAT32_IEEE 10000000000 Compu_IDENTITY -10000000000 10000000000 PHYS_UNIT "ms" /end CHARACTERISTIC
/begin CHARACTERISTIC FPfl_PWM8_on_hiVf "FPrm_latch(206)" VALUE 0x00160350 /* @ECU_Address@FPrm_latch@0x021BB338@ */ ECIPP_ALIGNMENT_FLOAT32_IEEE 10000000000 Compu_IDENTITY -10000000000 10000000000 PHYS_UNIT "ms" /end CHARACTERISTIC
/begin CHARACTERISTIC FPfl_PWM9_off_loVf "FPrm_latch(207)" VALUE 0x00160354 /* @ECU_Address@FPrm_latch@0x021BB33C@ */ ECIPP_ALIGNMENT_FLOAT32_IEEE 10000000000 Compu_IDENTITY -10000000000 10000000000 PHYS_UNIT "ms" /end CHARACTERISTIC
/begin CHARACTERISTIC FPfl_PWM9_on_hiVf "FPrm_latch(208)" VALUE 0x00160358 /* @ECU_Address@FPrm_latch@0x021BB340@ */ ECIPP_ALIGNMENT_FLOAT32_IEEE 10000000000 Compu_IDENTITY -10000000000 10000000000 PHYS_UNIT "ms" /end CHARACTERISTIC
/begin CHARACTERISTIC FPfl_PWMLO_off_loVf "FPrm_latch(391)" VALUE 0x00160634 /* @ECU_Address@FPrm_latch@0x021BB61C@ */ ECIPP_ALIGNMENT_FLOAT32_IEEE 10000000000 Compu_IDENTITY -10000000000 10000000000 PHYS_UNIT "ms" /end CHARACTERISTIC
/begin CHARACTERISTIC FPfl_PWMLO_on_hiVf "FPrm_latch(392)" VALUE 0x00160638 /* @ECU_Address@FPrm_latch@0x021BB620@ */ ECIPP_ALIGNMENT_FLOAT32_IEEE 10000000000 Compu_IDENTITY -10000000000 10000000000 PHYS_UNIT "ms" /end CHARACTERISTIC
/begin CHARACTERISTIC FPfl_RAM_fail "FPrm_latch(70)" VALUE 0x00160130 /* @ECU_Address@FPrm_latch@0x021BB118@ */ ECIPP_ALIGNMENT_FLOAT32_IEEE 10000000000 Compu_IDENTITY -10000000000 10000000000 PHYS_UNIT "ms" /end CHARACTERISTIC
/begin CHARACTERISTIC FPfl_relay_coilopen "FPrm_latch(119)" VALUE 0x001601F4 /* @ECU_Address@FPrm_latch@0x021BB1DC@ */ ECIPP_ALIGNMENT_FLOAT32_IEEE 10000000000 Compu_IDENTITY -10000000000 10000000000 PHYS_UNIT "samples" /end CHARACTERISTIC
/begin CHARACTERISTIC FPfl_relay_coilshort "FPrm_latch(120)" VALUE 0x001601F8 /* @ECU_Address@FPrm_latch@0x021BB1E0@ */ ECIPP_ALIGNMENT_FLOAT32_IEEE 10000000000 Compu_IDENTITY -10000000000 10000000000 PHYS_UNIT "samples" /end CHARACTERISTIC
/begin CHARACTERISTIC FPfl_relay_gndshort "FPrm_latch(118)" VALUE 0x001601F0 /* @ECU_Address@FPrm_latch@0x021BB1D8@ */ ECIPP_ALIGNMENT_FLOAT32_IEEE 10000000000 Compu_IDENTITY -10000000000 10000000000 PHYS_UNIT "samples" /end CHARACTERISTIC
/begin CHARACTERISTIC FPfl_relayoff_hiV "FPrm_latch(328)" VALUE 0x00160538 /* @ECU_Address@FPrm_latch@0x021BB520@ */ ECIPP_ALIGNMENT_FLOAT32_IEEE 10000000000 Compu_IDENTITY -10000000000 10000000000 PHYS_UNIT "ms" /end CHARACTERISTIC
/begin CHARACTERISTIC FPfl_relayon_loV "FPrm_latch(329)" VALUE 0x0016053C /* @ECU_Address@FPrm_latch@0x021BB524@ */ ECIPP_ALIGNMENT_FLOAT32_IEEE 10000000000 Compu_IDENTITY -10000000000 10000000000 PHYS_UNIT "ms" /end CHARACTERISTIC
/begin CHARACTERISTIC FPfl_rpm_hi_expected "FPrm_latch(260)" VALUE 0x00160428 /* @ECU_Address@FPrm_latch@0x021BB410@ */ ECIPP_ALIGNMENT_FLOAT32_IEEE 10000000000 Compu_IDENTITY -10000000000 10000000000 PHYS_UNIT "ms" /end CHARACTERISTIC
/begin CHARACTERISTIC FPfl_rpmd_gov_lo "FPrm_latch(390)" VALUE 0x00160630 /* @ECU_Address@FPrm_latch@0x021BB618@ */ ECIPP_ALIGNMENT_FLOAT32_IEEE 10000000000 Compu_IDENTITY -10000000000 10000000000 PHYS_UNIT "ms" /end CHARACTERISTIC
/begin CHARACTERISTIC FPfl_RS_discon "FPrm_latch(521)" VALUE 0x0016083C /* @ECU_Address@FPrm_latch@0x021BB824@ */ ECIPP_ALIGNMENT_FLOAT32_IEEE 10000000000 Compu_IDENTITY -10000000000 10000000000 PHYS_UNIT "samples" /end CHARACTERISTIC
/begin CHARACTERISTIC FPfl_RS_hiV "FPrm_latch(453)" VALUE 0x0016072C /* @ECU_Address@FPrm_latch@0x021BB714@ */ ECIPP_ALIGNMENT_FLOAT32_IEEE 10000000000 Compu_IDENTITY -10000000000 10000000000 PHYS_UNIT "ms" /end CHARACTERISTIC
/begin CHARACTERISTIC FPfl_RS_loss "FPrm_latch(176)" VALUE 0x001602D8 /* @ECU_Address@FPrm_latch@0x021BB2C0@ */ ECIPP_ALIGNMENT_FLOAT32_IEEE 10000000000 Compu_IDENTITY -10000000000 10000000000 PHYS_UNIT "ms" /end CHARACTERISTIC
/begin CHARACTERISTIC FPfl_RS_loV "FPrm_latch(452)" VALUE 0x00160728 /* @ECU_Address@FPrm_latch@0x021BB710@ */ ECIPP_ALIGNMENT_FLOAT32_IEEE 10000000000 Compu_IDENTITY -10000000000 10000000000 PHYS_UNIT "ms" /end CHARACTERISTIC
/begin CHARACTERISTIC FPfl_RS485_bad_fmt "FPrm_latch(83)" VALUE 0x00160164 /* @ECU_Address@FPrm_latch@0x021BB14C@ */ ECIPP_ALIGNMENT_FLOAT32_IEEE 10000000000 Compu_IDENTITY -10000000000 10000000000 PHYS_UNIT "packets" /end CHARACTERISTIC
/begin CHARACTERISTIC FPfl_RS485_Rx_inact "FPrm_latch(81)" VALUE 0x0016015C /* @ECU_Address@FPrm_latch@0x021BB144@ */ ECIPP_ALIGNMENT_FLOAT32_IEEE 10000000000 Compu_IDENTITY -10000000000 10000000000 PHYS_UNIT "ms" /end CHARACTERISTIC
/begin CHARACTERISTIC FPfl_RS485_Rx_noise "FPrm_latch(82)" VALUE 0x00160160 /* @ECU_Address@FPrm_latch@0x021BB148@ */ ECIPP_ALIGNMENT_FLOAT32_IEEE 10000000000 Compu_IDENTITY -10000000000 10000000000 PHYS_UNIT "packets" /end CHARACTERISTIC
/begin CHARACTERISTIC FPfl_RS485_SD_rq "FPrm_latch(84)" VALUE 0x00160168 /* @ECU_Address@FPrm_latch@0x021BB150@ */ ECIPP_ALIGNMENT_FLOAT32_IEEE 10000000000 Compu_IDENTITY -10000000000 10000000000 PHYS_UNIT "ms" /end CHARACTERISTIC
/begin CHARACTERISTIC FPfl_RTI1 "FPrm_latch(64)" VALUE 0x00160118 /* @ECU_Address@FPrm_latch@0x021BB100@ */ ECIPP_ALIGNMENT_FLOAT32_IEEE 10000000000 Compu_IDENTITY -10000000000 10000000000 PHYS_UNIT "ms" /end CHARACTERISTIC
/begin CHARACTERISTIC FPfl_RTI2 "FPrm_latch(65)" VALUE 0x0016011C /* @ECU_Address@FPrm_latch@0x021BB104@ */ ECIPP_ALIGNMENT_FLOAT32_IEEE 10000000000 Compu_IDENTITY -10000000000 10000000000 PHYS_UNIT "ms" /end CHARACTERISTIC
/begin CHARACTERISTIC FPfl_RTI3 "FPrm_latch(66)" VALUE 0x00160120 /* @ECU_Address@FPrm_latch@0x021BB108@ */ ECIPP_ALIGNMENT_FLOAT32_IEEE 10000000000 Compu_IDENTITY -10000000000 10000000000 PHYS_UNIT "ms" /end CHARACTERISTIC
/begin CHARACTERISTIC FPfl_SHIFT_FB_OOR "FPrm_latch(216)" VALUE 0x00160378 /* @ECU_Address@FPrm_latch@0x021BB360@ */ ECIPP_ALIGNMENT_FLOAT32_IEEE 10000000000 Compu_IDENTITY -10000000000 10000000000 PHYS_UNIT "ms" /end CHARACTERISTIC
/begin CHARACTERISTIC FPfl_SHIFT_intcirc_fail "FPrm_latch(218)" VALUE 0x00160380 /* @ECU_Address@FPrm_latch@0x021BB368@ */ ECIPP_ALIGNMENT_FLOAT32_IEEE 10000000000 Compu_IDENTITY -10000000000 10000000000 PHYS_UNIT "ms" /end CHARACTERISTIC
/begin CHARACTERISTIC FPfl_SHIFT_shift_fail "FPrm_latch(217)" VALUE 0x0016037C /* @ECU_Address@FPrm_latch@0x021BB364@ */ ECIPP_ALIGNMENT_FLOAT32_IEEE 10000000000 Compu_IDENTITY -10000000000 10000000000 PHYS_UNIT "ms" /end CHARACTERISTIC
/begin CHARACTERISTIC FPfl_SL_fuel "FPrm_latch(38)" VALUE 0x001600B0 /* @ECU_Address@FPrm_latch@0x021BB098@ */ ECIPP_ALIGNMENT_FLOAT32_IEEE 10000000000 Compu_IDENTITY -10000000000 10000000000 PHYS_UNIT "ms" /end CHARACTERISTIC
/begin CHARACTERISTIC FPfl_SL_gov "FPrm_latch(37)" VALUE 0x001600AC /* @ECU_Address@FPrm_latch@0x021BB094@ */ ECIPP_ALIGNMENT_FLOAT32_IEEE 10000000000 Compu_IDENTITY -10000000000 10000000000 PHYS_UNIT "ms" /end CHARACTERISTIC
/begin CHARACTERISTIC FPfl_SL_spk "FPrm_latch(39)" VALUE 0x001600B4 /* @ECU_Address@FPrm_latch@0x021BB09C@ */ ECIPP_ALIGNMENT_FLOAT32_IEEE 10000000000 Compu_IDENTITY -10000000000 10000000000 PHYS_UNIT "ms" /end CHARACTERISTIC
/begin CHARACTERISTIC FPfl_slv_MAP_hi_OOA "FPrm_latch(664)" VALUE 0x00160A78 /* @ECU_Address@FPrm_latch@0x021BBA60@ */ ECIPP_ALIGNMENT_FLOAT32_IEEE 10000000000 Compu_IDENTITY -10000000000 10000000000 PHYS_UNIT "ms" /end CHARACTERISTIC
/begin CHARACTERISTIC FPfl_slv_MAP_lo_OOA "FPrm_latch(665)" VALUE 0x00160A7C /* @ECU_Address@FPrm_latch@0x021BBA64@ */ ECIPP_ALIGNMENT_FLOAT32_IEEE 10000000000 Compu_IDENTITY -10000000000 10000000000 PHYS_UNIT "ms" /end CHARACTERISTIC
/begin CHARACTERISTIC FPfl_SPK_int_fail "FPrm_latch(225)" VALUE 0x0016039C /* @ECU_Address@FPrm_latch@0x021BB384@ */ ECIPP_ALIGNMENT_FLOAT32_IEEE 10000000000 Compu_IDENTITY -10000000000 10000000000 PHYS_UNIT "sparks" /end CHARACTERISTIC
/begin CHARACTERISTIC FPfl_SPK1_IGBT_T "FPrm_latch(388)" VALUE 0x00160628 /* @ECU_Address@FPrm_latch@0x021BB610@ */ ECIPP_ALIGNMENT_FLOAT32_IEEE 10000000000 Compu_IDENTITY -10000000000 10000000000 PHYS_UNIT "ms" /end CHARACTERISTIC
/begin CHARACTERISTIC FPfl_SPKD_coil_fail "FPrm_latch(226)" VALUE 0x001603A0 /* @ECU_Address@FPrm_latch@0x021BB388@ */ ECIPP_ALIGNMENT_FLOAT32_IEEE 10000000000 Compu_IDENTITY -10000000000 10000000000 PHYS_UNIT "sparks" /end CHARACTERISTIC
/begin CHARACTERISTIC FPfl_SPKD_dw_hi "FPrm_latch(56)" VALUE 0x001600F8 /* @ECU_Address@FPrm_latch@0x021BB0E0@ */ ECIPP_ALIGNMENT_FLOAT32_IEEE 10000000000 Compu_IDENTITY -10000000000 10000000000 PHYS_UNIT "sparks" /end CHARACTERISTIC
/begin CHARACTERISTIC FPfl_SPKD_dw_lo "FPrm_latch(55)" VALUE 0x001600F4 /* @ECU_Address@FPrm_latch@0x021BB0DC@ */ ECIPP_ALIGNMENT_FLOAT32_IEEE 10000000000 Compu_IDENTITY -10000000000 10000000000 PHYS_UNIT "sparks" /end CHARACTERISTIC
/begin CHARACTERISTIC FPfl_SRVC_expired "FPrm_latch(323)" VALUE 0x00160524 /* @ECU_Address@FPrm_latch@0x021BB50C@ */ ECIPP_ALIGNMENT_FLOAT32_IEEE 10000000000 Compu_IDENTITY -10000000000 10000000000 PHYS_UNIT "ms" /end CHARACTERISTIC
/begin CHARACTERISTIC FPfl_SRVC_expired2 "FPrm_latch(663)" VALUE 0x00160A74 /* @ECU_Address@FPrm_latch@0x021BBA5C@ */ ECIPP_ALIGNMENT_FLOAT32_IEEE 10000000000 Compu_IDENTITY -10000000000 10000000000 PHYS_UNIT "ms" /end CHARACTERISTIC
/begin CHARACTERISTIC FPfl_start_coilopen "FPrm_latch(122)" VALUE 0x00160200 /* @ECU_Address@FPrm_latch@0x021BB1E8@ */ ECIPP_ALIGNMENT_FLOAT32_IEEE 10000000000 Compu_IDENTITY -10000000000 10000000000 PHYS_UNIT "samples" /end CHARACTERISTIC
/begin CHARACTERISTIC FPfl_start_coilshort "FPrm_latch(123)" VALUE 0x00160204 /* @ECU_Address@FPrm_latch@0x021BB1EC@ */ ECIPP_ALIGNMENT_FLOAT32_IEEE 10000000000 Compu_IDENTITY -10000000000 10000000000 PHYS_UNIT "samples" /end CHARACTERISTIC
/begin CHARACTERISTIC FPfl_start_excess "FPrm_latch(667)" VALUE 0x00160A84 /* @ECU_Address@FPrm_latch@0x021BBA6C@ */ ECIPP_ALIGNMENT_FLOAT32_IEEE 10000000000 Compu_IDENTITY -10000000000 10000000000 PHYS_UNIT "starts" /end CHARACTERISTIC
/begin CHARACTERISTIC FPfl_start_gndshort "FPrm_latch(121)" VALUE 0x001601FC /* @ECU_Address@FPrm_latch@0x021BB1E4@ */ ECIPP_ALIGNMENT_FLOAT32_IEEE 10000000000 Compu_IDENTITY -10000000000 10000000000 PHYS_UNIT "samples" /end CHARACTERISTIC
/begin CHARACTERISTIC FPfl_start_stuck_active "FPrm_latch(229)" VALUE 0x001603AC /* @ECU_Address@FPrm_latch@0x021BB394@ */ ECIPP_ALIGNMENT_FLOAT32_IEEE 10000000000 Compu_IDENTITY -10000000000 10000000000 PHYS_UNIT "ms" /end CHARACTERISTIC
/begin CHARACTERISTIC FPfl_SubDiagTemp "FPrm_latch(483)" VALUE 0x001607A4 /* @ECU_Address@FPrm_latch@0x021BB78C@ */ ECIPP_ALIGNMENT_FLOAT32_IEEE 10000000000 Compu_IDENTITY -10000000000 10000000000 PHYS_UNIT "ms" /end CHARACTERISTIC
/begin CHARACTERISTIC FPfl_tach_gndshort "FPrm_latch(133)" VALUE 0x0016022C /* @ECU_Address@FPrm_latch@0x021BB214@ */ ECIPP_ALIGNMENT_FLOAT32_IEEE 10000000000 Compu_IDENTITY -10000000000 10000000000 PHYS_UNIT "samples" /end CHARACTERISTIC
/begin CHARACTERISTIC FPfl_tach_pwrshort "FPrm_latch(134)" VALUE 0x00160230 /* @ECU_Address@FPrm_latch@0x021BB218@ */ ECIPP_ALIGNMENT_FLOAT32_IEEE 10000000000 Compu_IDENTITY -10000000000 10000000000 PHYS_UNIT "samples" /end CHARACTERISTIC
/begin CHARACTERISTIC FPfl_TAUX_dT1_max "FPrm_latch(428)" VALUE 0x001606C8 /* @ECU_Address@FPrm_latch@0x021BB6B0@ */ ECIPP_ALIGNMENT_FLOAT32_IEEE 10000000000 Compu_IDENTITY -10000000000 10000000000 PHYS_UNIT "ms" /end CHARACTERISTIC
/begin CHARACTERISTIC FPfl_TAUX_dT1_min "FPrm_latch(429)" VALUE 0x001606CC /* @ECU_Address@FPrm_latch@0x021BB6B4@ */ ECIPP_ALIGNMENT_FLOAT32_IEEE 10000000000 Compu_IDENTITY -10000000000 10000000000 PHYS_UNIT "ms" /end CHARACTERISTIC
/begin CHARACTERISTIC FPfl_TAUX_dT2_max "FPrm_latch(430)" VALUE 0x001606D0 /* @ECU_Address@FPrm_latch@0x021BB6B8@ */ ECIPP_ALIGNMENT_FLOAT32_IEEE 10000000000 Compu_IDENTITY -10000000000 10000000000 PHYS_UNIT "ms" /end CHARACTERISTIC
/begin CHARACTERISTIC FPfl_TAUX_dT2_min "FPrm_latch(431)" VALUE 0x001606D4 /* @ECU_Address@FPrm_latch@0x021BB6BC@ */ ECIPP_ALIGNMENT_FLOAT32_IEEE 10000000000 Compu_IDENTITY -10000000000 10000000000 PHYS_UNIT "ms" /end CHARACTERISTIC
/begin CHARACTERISTIC FPfl_Taux1_derate_actv "FPrm_latch(639)" VALUE 0x00160A14 /* @ECU_Address@FPrm_latch@0x021BB9FC@ */ ECIPP_ALIGNMENT_FLOAT32_IEEE 10000000000 Compu_IDENTITY -10000000000 10000000000 PHYS_UNIT "ms" /end CHARACTERISTIC
/begin CHARACTERISTIC FPfl_TAUX1_max "FPrm_latch(420)" VALUE 0x001606A8 /* @ECU_Address@FPrm_latch@0x021BB690@ */ ECIPP_ALIGNMENT_FLOAT32_IEEE 10000000000 Compu_IDENTITY -10000000000 10000000000 PHYS_UNIT "ms" /end CHARACTERISTIC
/begin CHARACTERISTIC FPfl_TAUX1_min "FPrm_latch(421)" VALUE 0x001606AC /* @ECU_Address@FPrm_latch@0x021BB694@ */ ECIPP_ALIGNMENT_FLOAT32_IEEE 10000000000 Compu_IDENTITY -10000000000 10000000000 PHYS_UNIT "ms" /end CHARACTERISTIC
/begin CHARACTERISTIC FPfl_Taux2_derate_actv "FPrm_latch(640)" VALUE 0x00160A18 /* @ECU_Address@FPrm_latch@0x021BBA00@ */ ECIPP_ALIGNMENT_FLOAT32_IEEE 10000000000 Compu_IDENTITY -10000000000 10000000000 PHYS_UNIT "ms" /end CHARACTERISTIC
/begin CHARACTERISTIC FPfu_PWM21_on_hiVf "FPrm_unlatch(353)" VALUE 0x00161060 /* @ECU_Address@FPrm_unlatch@0x021BD584@ */ ECIPP_ALIGNMENT_FLOAT32_IEEE 10000000000 Compu_IDENTITY -10000000000 10000000000 PHYS_UNIT "ms" /end CHARACTERISTIC
/begin CHARACTERISTIC FPfu_PWM22_off_loVf "FPrm_unlatch(354)" VALUE 0x00161064 /* @ECU_Address@FPrm_unlatch@0x021BD588@ */ ECIPP_ALIGNMENT_FLOAT32_IEEE 10000000000 Compu_IDENTITY -10000000000 10000000000 PHYS_UNIT "ms" /end CHARACTERISTIC
/begin CHARACTERISTIC FPfu_PWM22_on_hiVf "FPrm_unlatch(355)" VALUE 0x00161068 /* @ECU_Address@FPrm_unlatch@0x021BD58C@ */ ECIPP_ALIGNMENT_FLOAT32_IEEE 10000000000 Compu_IDENTITY -10000000000 10000000000 PHYS_UNIT "ms" /end CHARACTERISTIC
/begin CHARACTERISTIC FPfu_PWM23_off_loVf "FPrm_unlatch(356)" VALUE 0x0016106C /* @ECU_Address@FPrm_unlatch@0x021BD590@ */ ECIPP_ALIGNMENT_FLOAT32_IEEE 10000000000 Compu_IDENTITY -10000000000 10000000000 PHYS_UNIT "ms" /end CHARACTERISTIC
/begin CHARACTERISTIC FPfu_PWM23_on_hiVf "FPrm_unlatch(357)" VALUE 0x00161070 /* @ECU_Address@FPrm_unlatch@0x021BD594@ */ ECIPP_ALIGNMENT_FLOAT32_IEEE 10000000000 Compu_IDENTITY -10000000000 10000000000 PHYS_UNIT "ms" /end CHARACTERISTIC
/begin CHARACTERISTIC FPfu_PWM3_off_loVf "FPrm_unlatch(151)" VALUE 0x00160D38 /* @ECU_Address@FPrm_unlatch@0x021BD25C@ */ ECIPP_ALIGNMENT_FLOAT32_IEEE 10000000000 Compu_IDENTITY -10000000000 10000000000 PHYS_UNIT "ms" /end CHARACTERISTIC
/begin CHARACTERISTIC FPfu_PWM3_on_hiVf "FPrm_unlatch(152)" VALUE 0x00160D3C /* @ECU_Address@FPrm_unlatch@0x021BD260@ */ ECIPP_ALIGNMENT_FLOAT32_IEEE 10000000000 Compu_IDENTITY -10000000000 10000000000 PHYS_UNIT "ms" /end CHARACTERISTIC
/begin CHARACTERISTIC FPfu_PWM4_off_loVf "FPrm_unlatch(153)" VALUE 0x00160D40 /* @ECU_Address@FPrm_unlatch@0x021BD264@ */ ECIPP_ALIGNMENT_FLOAT32_IEEE 10000000000 Compu_IDENTITY -10000000000 10000000000 PHYS_UNIT "ms" /end CHARACTERISTIC
/begin CHARACTERISTIC FPfu_PWM4_on_hiVf "FPrm_unlatch(154)" VALUE 0x00160D44 /* @ECU_Address@FPrm_unlatch@0x021BD268@ */ ECIPP_ALIGNMENT_FLOAT32_IEEE 10000000000 Compu_IDENTITY -10000000000 10000000000 PHYS_UNIT "ms" /end CHARACTERISTIC
/begin CHARACTERISTIC FPfu_PWM5_off_loVf "FPrm_unlatch(155)" VALUE 0x00160D48 /* @ECU_Address@FPrm_unlatch@0x021BD26C@ */ ECIPP_ALIGNMENT_FLOAT32_IEEE 10000000000 Compu_IDENTITY -10000000000 10000000000 PHYS_UNIT "ms" /end CHARACTERISTIC
/begin CHARACTERISTIC FPfu_PWM5_on_hiVf "FPrm_unlatch(156)" VALUE 0x00160D4C /* @ECU_Address@FPrm_unlatch@0x021BD270@ */ ECIPP_ALIGNMENT_FLOAT32_IEEE 10000000000 Compu_IDENTITY -10000000000 10000000000 PHYS_UNIT "ms" /end CHARACTERISTIC
/begin CHARACTERISTIC FPfu_PWM6_off_loVf "FPrm_unlatch(198)" VALUE 0x00160DF4 /* @ECU_Address@FPrm_unlatch@0x021BD318@ */ ECIPP_ALIGNMENT_FLOAT32_IEEE 10000000000 Compu_IDENTITY -10000000000 10000000000 PHYS_UNIT "ms" /end CHARACTERISTIC
/begin CHARACTERISTIC FPfu_PWM6_on_hiVf "FPrm_unlatch(199)" VALUE 0x00160DF8 /* @ECU_Address@FPrm_unlatch@0x021BD31C@ */ ECIPP_ALIGNMENT_FLOAT32_IEEE 10000000000 Compu_IDENTITY -10000000000 10000000000 PHYS_UNIT "ms" /end CHARACTERISTIC
/begin CHARACTERISTIC FPfu_PWM7_off_loVf "FPrm_unlatch(200)" VALUE 0x00160DFC /* @ECU_Address@FPrm_unlatch@0x021BD320@ */ ECIPP_ALIGNMENT_FLOAT32_IEEE 10000000000 Compu_IDENTITY -10000000000 10000000000 PHYS_UNIT "ms" /end CHARACTERISTIC
/begin CHARACTERISTIC FPfu_PWM7_on_hiVf "FPrm_unlatch(201)" VALUE 0x00160E00 /* @ECU_Address@FPrm_unlatch@0x021BD324@ */ ECIPP_ALIGNMENT_FLOAT32_IEEE 10000000000 Compu_IDENTITY -10000000000 10000000000 PHYS_UNIT "ms" /end CHARACTERISTIC
/begin CHARACTERISTIC FPfu_PWM8_off_loVf "FPrm_unlatch(205)" VALUE 0x00160E10 /* @ECU_Address@FPrm_unlatch@0x021BD334@ */ ECIPP_ALIGNMENT_FLOAT32_IEEE 10000000000 Compu_IDENTITY -10000000000 10000000000 PHYS_UNIT "ms" /end CHARACTERISTIC
/begin CHARACTERISTIC FPfu_PWM8_on_hiVf "FPrm_unlatch(206)" VALUE 0x00160E14 /* @ECU_Address@FPrm_unlatch@0x021BD338@ */ ECIPP_ALIGNMENT_FLOAT32_IEEE 10000000000 Compu_IDENTITY -10000000000 10000000000 PHYS_UNIT "ms" /end CHARACTERISTIC
/begin CHARACTERISTIC FPfu_PWM9_off_loVf "FPrm_unlatch(207)" VALUE 0x00160E18 /* @ECU_Address@FPrm_unlatch@0x021BD33C@ */ ECIPP_ALIGNMENT_FLOAT32_IEEE 10000000000 Compu_IDENTITY -10000000000 10000000000 PHYS_UNIT "ms" /end CHARACTERISTIC
/begin CHARACTERISTIC FPfu_PWM9_on_hiVf "FPrm_unlatch(208)" VALUE 0x00160E1C /* @ECU_Address@FPrm_unlatch@0x021BD340@ */ ECIPP_ALIGNMENT_FLOAT32_IEEE 10000000000 Compu_IDENTITY -10000000000 10000000000 PHYS_UNIT "ms" /end CHARACTERISTIC
/begin CHARACTERISTIC FPfu_PWMLO_off_loVf "FPrm_unlatch(391)" VALUE 0x001610F8 /* @ECU_Address@FPrm_unlatch@0x021BD61C@ */ ECIPP_ALIGNMENT_FLOAT32_IEEE 10000000000 Compu_IDENTITY -10000000000 10000000000 PHYS_UNIT "ms" /end CHARACTERISTIC
/begin CHARACTERISTIC FPfu_PWMLO_on_hiVf "FPrm_unlatch(392)" VALUE 0x001610FC /* @ECU_Address@FPrm_unlatch@0x021BD620@ */ ECIPP_ALIGNMENT_FLOAT32_IEEE 10000000000 Compu_IDENTITY -10000000000 10000000000 PHYS_UNIT "ms" /end CHARACTERISTIC
/begin CHARACTERISTIC FPfu_RAM_fail "FPrm_unlatch(70)" VALUE 0x00160BF4 /* @ECU_Address@FPrm_unlatch@0x021BD118@ */ ECIPP_ALIGNMENT_FLOAT32_IEEE 10000000000 Compu_IDENTITY -10000000000 10000000000 PHYS_UNIT "ms" /end CHARACTERISTIC
/begin CHARACTERISTIC FPfu_relay_coilopen "FPrm_unlatch(119)" VALUE 0x00160CB8 /* @ECU_Address@FPrm_unlatch@0x021BD1DC@ */ ECIPP_ALIGNMENT_FLOAT32_IEEE 10000000000 Compu_IDENTITY -10000000000 10000000000 PHYS_UNIT "samples" /end CHARACTERISTIC
/begin CHARACTERISTIC FPfu_relay_coilshort "FPrm_unlatch(120)" VALUE 0x00160CBC /* @ECU_Address@FPrm_unlatch@0x021BD1E0@ */ ECIPP_ALIGNMENT_FLOAT32_IEEE 10000000000 Compu_IDENTITY -10000000000 10000000000 PHYS_UNIT "samples" /end CHARACTERISTIC
/begin CHARACTERISTIC FPfu_relay_gndshort "FPrm_unlatch(118)" VALUE 0x00160CB4 /* @ECU_Address@FPrm_unlatch@0x021BD1D8@ */ ECIPP_ALIGNMENT_FLOAT32_IEEE 10000000000 Compu_IDENTITY -10000000000 10000000000 PHYS_UNIT "samples" /end CHARACTERISTIC
/begin CHARACTERISTIC FPfu_relayoff_hiV "FPrm_unlatch(328)" VALUE 0x00160FFC /* @ECU_Address@FPrm_unlatch@0x021BD520@ */ ECIPP_ALIGNMENT_FLOAT32_IEEE 10000000000 Compu_IDENTITY -10000000000 10000000000 PHYS_UNIT "ms" /end CHARACTERISTIC
/begin CHARACTERISTIC FPfu_relayon_loV "FPrm_unlatch(329)" VALUE 0x00161000 /* @ECU_Address@FPrm_unlatch@0x021BD524@ */ ECIPP_ALIGNMENT_FLOAT32_IEEE 10000000000 Compu_IDENTITY -10000000000 10000000000 PHYS_UNIT "ms" /end CHARACTERISTIC
/begin CHARACTERISTIC FPfu_rpm_hi_expected "FPrm_unlatch(260)" VALUE 0x00160EEC /* @ECU_Address@FPrm_unlatch@0x021BD410@ */ ECIPP_ALIGNMENT_FLOAT32_IEEE 10000000000 Compu_IDENTITY -10000000000 10000000000 PHYS_UNIT "ms" /end CHARACTERISTIC
/begin CHARACTERISTIC FPfu_rpmd_gov_lo "FPrm_unlatch(390)" VALUE 0x001610F4 /* @ECU_Address@FPrm_unlatch@0x021BD618@ */ ECIPP_ALIGNMENT_FLOAT32_IEEE 10000000000 Compu_IDENTITY -10000000000 10000000000 PHYS_UNIT "ms" /end CHARACTERISTIC
/begin CHARACTERISTIC FPfu_RS_discon "FPrm_unlatch(521)" VALUE 0x00161300 /* @ECU_Address@FPrm_unlatch@0x021BD824@ */ ECIPP_ALIGNMENT_FLOAT32_IEEE 10000000000 Compu_IDENTITY -10000000000 10000000000 PHYS_UNIT "samples" /end CHARACTERISTIC
/begin CHARACTERISTIC FPfu_RS_hiV "FPrm_unlatch(453)" VALUE 0x001611F0 /* @ECU_Address@FPrm_unlatch@0x021BD714@ */ ECIPP_ALIGNMENT_FLOAT32_IEEE 10000000000 Compu_IDENTITY -10000000000 10000000000 PHYS_UNIT "ms" /end CHARACTERISTIC
/begin CHARACTERISTIC FPfu_RS_loss "FPrm_unlatch(176)" VALUE 0x00160D9C /* @ECU_Address@FPrm_unlatch@0x021BD2C0@ */ ECIPP_ALIGNMENT_FLOAT32_IEEE 10000000000 Compu_IDENTITY -10000000000 10000000000 PHYS_UNIT "ms" /end CHARACTERISTIC
/begin CHARACTERISTIC FPfu_RS_loV "FPrm_unlatch(452)" VALUE 0x001611EC /* @ECU_Address@FPrm_unlatch@0x021BD710@ */ ECIPP_ALIGNMENT_FLOAT32_IEEE 10000000000 Compu_IDENTITY -10000000000 10000000000 PHYS_UNIT "ms" /end CHARACTERISTIC
/begin CHARACTERISTIC FPfu_RS485_bad_fmt "FPrm_unlatch(83)" VALUE 0x00160C28 /* @ECU_Address@FPrm_unlatch@0x021BD14C@ */ ECIPP_ALIGNMENT_FLOAT32_IEEE 10000000000 Compu_IDENTITY -10000000000 10000000000 PHYS_UNIT "packets" /end CHARACTERISTIC
/begin CHARACTERISTIC FPfu_RS485_Rx_inact "FPrm_unlatch(81)" VALUE 0x00160C20 /* @ECU_Address@FPrm_unlatch@0x021BD144@ */ ECIPP_ALIGNMENT_FLOAT32_IEEE 10000000000 Compu_IDENTITY -10000000000 10000000000 PHYS_UNIT "ms" /end CHARACTERISTIC
/begin CHARACTERISTIC FPfu_RS485_Rx_noise "FPrm_unlatch(82)" VALUE 0x00160C24 /* @ECU_Address@FPrm_unlatch@0x021BD148@ */ ECIPP_ALIGNMENT_FLOAT32_IEEE 10000000000 Compu_IDENTITY -10000000000 10000000000 PHYS_UNIT "packets" /end CHARACTERISTIC
/begin CHARACTERISTIC FPfu_RS485_SD_rq "FPrm_unlatch(84)" VALUE 0x00160C2C /* @ECU_Address@FPrm_unlatch@0x021BD150@ */ ECIPP_ALIGNMENT_FLOAT32_IEEE 10000000000 Compu_IDENTITY -10000000000 10000000000 PHYS_UNIT "ms" /end CHARACTERISTIC
/begin CHARACTERISTIC FPfu_RTI1 "FPrm_unlatch(64)" VALUE 0x00160BDC /* @ECU_Address@FPrm_unlatch@0x021BD100@ */ ECIPP_ALIGNMENT_FLOAT32_IEEE 10000000000 Compu_IDENTITY -10000000000 10000000000 PHYS_UNIT "ms" /end CHARACTERISTIC
/begin CHARACTERISTIC FPfu_RTI2 "FPrm_unlatch(65)" VALUE 0x00160BE0 /* @ECU_Address@FPrm_unlatch@0x021BD104@ */ ECIPP_ALIGNMENT_FLOAT32_IEEE 10000000000 Compu_IDENTITY -10000000000 10000000000 PHYS_UNIT "ms" /end CHARACTERISTIC
/begin CHARACTERISTIC FPfu_RTI3 "FPrm_unlatch(66)" VALUE 0x00160BE4 /* @ECU_Address@FPrm_unlatch@0x021BD108@ */ ECIPP_ALIGNMENT_FLOAT32_IEEE 10000000000 Compu_IDENTITY -10000000000 10000000000 PHYS_UNIT "ms" /end CHARACTERISTIC
/begin CHARACTERISTIC FPfu_SHIFT_FB_OOR "FPrm_unlatch(216)" VALUE 0x00160E3C /* @ECU_Address@FPrm_unlatch@0x021BD360@ */ ECIPP_ALIGNMENT_FLOAT32_IEEE 10000000000 Compu_IDENTITY -10000000000 10000000000 PHYS_UNIT "ms" /end CHARACTERISTIC
/begin CHARACTERISTIC FPfu_SHIFT_intcirc_fail "FPrm_unlatch(218)" VALUE 0x00160E44 /* @ECU_Address@FPrm_unlatch@0x021BD368@ */ ECIPP_ALIGNMENT_FLOAT32_IEEE 10000000000 Compu_IDENTITY -10000000000 10000000000 PHYS_UNIT "ms" /end CHARACTERISTIC
/begin CHARACTERISTIC FPfu_SHIFT_shift_fail "FPrm_unlatch(217)" VALUE 0x00160E40 /* @ECU_Address@FPrm_unlatch@0x021BD364@ */ ECIPP_ALIGNMENT_FLOAT32_IEEE 10000000000 Compu_IDENTITY -10000000000 10000000000 PHYS_UNIT "ms" /end CHARACTERISTIC
/begin CHARACTERISTIC FPfu_SL_fuel "FPrm_unlatch(38)" VALUE 0x00160B74 /* @ECU_Address@FPrm_unlatch@0x021BD098@ */ ECIPP_ALIGNMENT_FLOAT32_IEEE 10000000000 Compu_IDENTITY -10000000000 10000000000 PHYS_UNIT "ms" /end CHARACTERISTIC
/begin CHARACTERISTIC FPfu_SL_gov "FPrm_unlatch(37)" VALUE 0x00160B70 /* @ECU_Address@FPrm_unlatch@0x021BD094@ */ ECIPP_ALIGNMENT_FLOAT32_IEEE 10000000000 Compu_IDENTITY -10000000000 10000000000 PHYS_UNIT "ms" /end CHARACTERISTIC
/begin CHARACTERISTIC FPfu_SL_spk "FPrm_unlatch(39)" VALUE 0x00160B78 /* @ECU_Address@FPrm_unlatch@0x021BD09C@ */ ECIPP_ALIGNMENT_FLOAT32_IEEE 10000000000 Compu_IDENTITY -10000000000 10000000000 PHYS_UNIT "ms" /end CHARACTERISTIC
/begin CHARACTERISTIC FPfu_slv_MAP_hi_OOA "FPrm_unlatch(664)" VALUE 0x0016153C /* @ECU_Address@FPrm_unlatch@0x021BDA60@ */ ECIPP_ALIGNMENT_FLOAT32_IEEE 10000000000 Compu_IDENTITY -10000000000 10000000000 PHYS_UNIT "ms" /end CHARACTERISTIC
/begin CHARACTERISTIC FPfu_slv_MAP_lo_OOA "FPrm_unlatch(665)" VALUE 0x00161540 /* @ECU_Address@FPrm_unlatch@0x021BDA64@ */ ECIPP_ALIGNMENT_FLOAT32_IEEE 10000000000 Compu_IDENTITY -10000000000 10000000000 PHYS_UNIT "ms" /end CHARACTERISTIC
/begin CHARACTERISTIC FPfu_SPK_int_fail "FPrm_unlatch(225)" VALUE 0x00160E60 /* @ECU_Address@FPrm_unlatch@0x021BD384@ */ ECIPP_ALIGNMENT_FLOAT32_IEEE 10000000000 Compu_IDENTITY -10000000000 10000000000 PHYS_UNIT "sparks" /end CHARACTERISTIC
/begin CHARACTERISTIC FPfu_SPK1_IGBT_T "FPrm_unlatch(388)" VALUE 0x001610EC /* @ECU_Address@FPrm_unlatch@0x021BD610@ */ ECIPP_ALIGNMENT_FLOAT32_IEEE 10000000000 Compu_IDENTITY -10000000000 10000000000 PHYS_UNIT "ms" /end CHARACTERISTIC
/begin CHARACTERISTIC FPfu_SPKD_coil_fail "FPrm_unlatch(226)" VALUE 0x00160E64 /* @ECU_Address@FPrm_unlatch@0x021BD388@ */ ECIPP_ALIGNMENT_FLOAT32_IEEE 10000000000 Compu_IDENTITY -10000000000 10000000000 PHYS_UNIT "sparks" /end CHARACTERISTIC
/begin CHARACTERISTIC FPfu_SPKD_dw_hi "FPrm_unlatch(56)" VALUE 0x00160BBC /* @ECU_Address@FPrm_unlatch@0x021BD0E0@ */ ECIPP_ALIGNMENT_FLOAT32_IEEE 10000000000 Compu_IDENTITY -10000000000 10000000000 PHYS_UNIT "sparks" /end CHARACTERISTIC
/begin CHARACTERISTIC FPfu_SPKD_dw_lo "FPrm_unlatch(55)" VALUE 0x00160BB8 /* @ECU_Address@FPrm_unlatch@0x021BD0DC@ */ ECIPP_ALIGNMENT_FLOAT32_IEEE 10000000000 Compu_IDENTITY -10000000000 10000000000 PHYS_UNIT "sparks" /end CHARACTERISTIC
/begin CHARACTERISTIC FPfu_SRVC_expired "FPrm_unlatch(323)" VALUE 0x00160FE8 /* @ECU_Address@FPrm_unlatch@0x021BD50C@ */ ECIPP_ALIGNMENT_FLOAT32_IEEE 10000000000 Compu_IDENTITY -10000000000 10000000000 PHYS_UNIT "ms" /end CHARACTERISTIC
/begin CHARACTERISTIC FPfu_SRVC_expired2 "FPrm_unlatch(663)" VALUE 0x00161538 /* @ECU_Address@FPrm_unlatch@0x021BDA5C@ */ ECIPP_ALIGNMENT_FLOAT32_IEEE 10000000000 Compu_IDENTITY -10000000000 10000000000 PHYS_UNIT "ms" /end CHARACTERISTIC
/begin CHARACTERISTIC FPfu_start_coilopen "FPrm_unlatch(122)" VALUE 0x00160CC4 /* @ECU_Address@FPrm_unlatch@0x021BD1E8@ */ ECIPP_ALIGNMENT_FLOAT32_IEEE 10000000000 Compu_IDENTITY -10000000000 10000000000 PHYS_UNIT "samples" /end CHARACTERISTIC
/begin CHARACTERISTIC FPfu_start_coilshort "FPrm_unlatch(123)" VALUE 0x00160CC8 /* @ECU_Address@FPrm_unlatch@0x021BD1EC@ */ ECIPP_ALIGNMENT_FLOAT32_IEEE 10000000000 Compu_IDENTITY -10000000000 10000000000 PHYS_UNIT "samples" /end CHARACTERISTIC
/begin CHARACTERISTIC FPfu_start_excess "FPrm_unlatch(667)" VALUE 0x00161548 /* @ECU_Address@FPrm_unlatch@0x021BDA6C@ */ ECIPP_ALIGNMENT_FLOAT32_IEEE 10000000000 Compu_IDENTITY -10000000000 10000000000 PHYS_UNIT "starts" /end CHARACTERISTIC
/begin CHARACTERISTIC FPfu_start_gndshort "FPrm_unlatch(121)" VALUE 0x00160CC0 /* @ECU_Address@FPrm_unlatch@0x021BD1E4@ */ ECIPP_ALIGNMENT_FLOAT32_IEEE 10000000000 Compu_IDENTITY -10000000000 10000000000 PHYS_UNIT "samples" /end CHARACTERISTIC
/begin CHARACTERISTIC FPfu_start_stuck_active "FPrm_unlatch(229)" VALUE 0x00160E70 /* @ECU_Address@FPrm_unlatch@0x021BD394@ */ ECIPP_ALIGNMENT_FLOAT32_IEEE 10000000000 Compu_IDENTITY -10000000000 10000000000 PHYS_UNIT "ms" /end CHARACTERISTIC
/begin CHARACTERISTIC FPfu_SubDiagTemp "FPrm_unlatch(483)" VALUE 0x00161268 /* @ECU_Address@FPrm_unlatch@0x021BD78C@ */ ECIPP_ALIGNMENT_FLOAT32_IEEE 10000000000 Compu_IDENTITY -10000000000 10000000000 PHYS_UNIT "ms" /end CHARACTERISTIC
/begin CHARACTERISTIC FPfu_tach_gndshort "FPrm_unlatch(133)" VALUE 0x00160CF0 /* @ECU_Address@FPrm_unlatch@0x021BD214@ */ ECIPP_ALIGNMENT_FLOAT32_IEEE 10000000000 Compu_IDENTITY -10000000000 10000000000 PHYS_UNIT "samples" /end CHARACTERISTIC
/begin CHARACTERISTIC FPfu_tach_pwrshort "FPrm_unlatch(134)" VALUE 0x00160CF4 /* @ECU_Address@FPrm_unlatch@0x021BD218@ */ ECIPP_ALIGNMENT_FLOAT32_IEEE 10000000000 Compu_IDENTITY -10000000000 10000000000 PHYS_UNIT "samples" /end CHARACTERISTIC
/begin CHARACTERISTIC FPfu_TAUX_dT1_max "FPrm_unlatch(428)" VALUE 0x0016118C /* @ECU_Address@FPrm_unlatch@0x021BD6B0@ */ ECIPP_ALIGNMENT_FLOAT32_IEEE 10000000000 Compu_IDENTITY -10000000000 10000000000 PHYS_UNIT "ms" /end CHARACTERISTIC
/begin CHARACTERISTIC FPfu_TAUX_dT1_min "FPrm_unlatch(429)" VALUE 0x00161190 /* @ECU_Address@FPrm_unlatch@0x021BD6B4@ */ ECIPP_ALIGNMENT_FLOAT32_IEEE 10000000000 Compu_IDENTITY -10000000000 10000000000 PHYS_UNIT "ms" /end CHARACTERISTIC
/begin CHARACTERISTIC FPfu_TAUX_dT2_max "FPrm_unlatch(430)" VALUE 0x00161194 /* @ECU_Address@FPrm_unlatch@0x021BD6B8@ */ ECIPP_ALIGNMENT_FLOAT32_IEEE 10000000000 Compu_IDENTITY -10000000000 10000000000 PHYS_UNIT "ms" /end CHARACTERISTIC
/begin CHARACTERISTIC FPfu_TAUX_dT2_min "FPrm_unlatch(431)" VALUE 0x00161198 /* @ECU_Address@FPrm_unlatch@0x021BD6BC@ */ ECIPP_ALIGNMENT_FLOAT32_IEEE 10000000000 Compu_IDENTITY -10000000000 10000000000 PHYS_UNIT "ms" /end CHARACTERISTIC
/begin CHARACTERISTIC FPfu_Taux1_derate_actv "FPrm_unlatch(639)" VALUE 0x001614D8 /* @ECU_Address@FPrm_unlatch@0x021BD9FC@ */ ECIPP_ALIGNMENT_FLOAT32_IEEE 10000000000 Compu_IDENTITY -10000000000 10000000000 PHYS_UNIT "ms" /end CHARACTERISTIC
/begin CHARACTERISTIC FPfu_TAUX1_max "FPrm_unlatch(420)" VALUE 0x0016116C /* @ECU_Address@FPrm_unlatch@0x021BD690@ */ ECIPP_ALIGNMENT_FLOAT32_IEEE 10000000000 Compu_IDENTITY -10000000000 10000000000 PHYS_UNIT "ms" /end CHARACTERISTIC
/begin CHARACTERISTIC FPfu_TAUX1_min "FPrm_unlatch(421)" VALUE 0x00161170 /* @ECU_Address@FPrm_unlatch@0x021BD694@ */ ECIPP_ALIGNMENT_FLOAT32_IEEE 10000000000 Compu_IDENTITY -10000000000 10000000000 PHYS_UNIT "ms" /end CHARACTERISTIC
/begin CHARACTERISTIC FPfu_Taux2_derate_actv "FPrm_unlatch(640)" VALUE 0x001614DC /* @ECU_Address@FPrm_unlatch@0x021BDA00@ */ ECIPP_ALIGNMENT_FLOAT32_IEEE 10000000000 Compu_IDENTITY -10000000000 10000000000 PHYS_UNIT "ms" /end CHARACTERISTIC
/begin GROUP PWM21_on_hiVf_EC_Fault "PWM21 short to power"
 /begin REF_CHARACTERISTIC FCdc4_PWM21_on_hiVf FCdtc_PWM21_on_hiVf FCfmi_PWM21_on_hiVf FCftb_PWM21_on_hiVf FCspn_PWM21_on_hiVf FPfl_PWM21_on_hiVf FPfu_PWM21_on_hiVf FPnd_PWM21_on_hiVf FPsvr_PWM21_on_hiVf FPsw_ext1_PWM21_on_hiVf FPsw_PWM21_on_hiVf /end REF_CHARACTERISTIC
/end GROUP
/begin GROUP PWM22_off_loVf_EC_Fault "PWM22 open / ground short"
 /begin REF_CHARACTERISTIC FCdc4_PWM22_off_loVf FCdtc_PWM22_off_loVf FCfmi_PWM22_off_loVf FCftb_PWM22_off_loVf FCspn_PWM22_off_loVf FPfl_PWM22_off_loVf FPfu_PWM22_off_loVf FPnd_PWM22_off_loVf FPsvr_PWM22_off_loVf FPsw_ext1_PWM22_off_loVf FPsw_PWM22_off_loVf /end REF_CHARACTERISTIC
/end GROUP
/begin GROUP PWM22_on_hiVf_EC_Fault "PWM22 short to power"
 /begin REF_CHARACTERISTIC FCdc4_PWM22_on_hiVf FCdtc_PWM22_on_hiVf FCfmi_PWM22_on_hiVf FCftb_PWM22_on_hiVf FCspn_PWM22_on_hiVf FPfl_PWM22_on_hiVf FPfu_PWM22_on_hiVf FPnd_PWM22_on_hiVf FPsvr_PWM22_on_hiVf FPsw_ext1_PWM22_on_hiVf FPsw_PWM22_on_hiVf /end REF_CHARACTERISTIC
/end GROUP
/begin GROUP PWM23_off_loVf_EC_Fault "PWM23 open / ground short"
 /begin REF_CHARACTERISTIC FCdc4_PWM23_off_loVf FCdtc_PWM23_off_loVf FCfmi_PWM23_off_loVf FCftb_PWM23_off_loVf FCspn_PWM23_off_loVf FPfl_PWM23_off_loVf FPfu_PWM23_off_loVf FPnd_PWM23_off_loVf FPsvr_PWM23_off_loVf FPsw_ext1_PWM23_off_loVf FPsw_PWM23_off_loVf /end REF_CHARACTERISTIC
/end GROUP
/begin GROUP PWM23_on_hiVf_EC_Fault "PWM23 short to power"
 /begin REF_CHARACTERISTIC FCdc4_PWM23_on_hiVf FCdtc_PWM23_on_hiVf FCfmi_PWM23_on_hiVf FCftb_PWM23_on_hiVf FCspn_PWM23_on_hiVf FPfl_PWM23_on_hiVf FPfu_PWM23_on_hiVf FPnd_PWM23_on_hiVf FPsvr_PWM23_on_hiVf FPsw_ext1_PWM23_on_hiVf FPsw_PWM23_on_hiVf /end REF_CHARACTERISTIC
/end GROUP
/begin GROUP PWM3_off_loVf_EC_Fault "PWM3-Gauge3 open / ground short"
 /begin REF_CHARACTERISTIC FCdc4_PWM3_off_loVf FCdtc_PWM3_off_loVf FCfmi_PWM3_off_loVf FCftb_PWM3_off_loVf FCspn_PWM3_off_loVf FPfl_PWM3_off_loVf FPfu_PWM3_off_loVf FPnd_PWM3_off_loVf FPsvr_PWM3_off_loVf FPsw_ext1_PWM3_off_loVf FPsw_PWM3_off_loVf /end REF_CHARACTERISTIC
/end GROUP
/begin GROUP PWM3_on_hiVf_EC_Fault "PWM3-Gauge3 short to power"
 /begin REF_CHARACTERISTIC FCdc4_PWM3_on_hiVf FCdtc_PWM3_on_hiVf FCfmi_PWM3_on_hiVf FCftb_PWM3_on_hiVf FCspn_PWM3_on_hiVf FPfl_PWM3_on_hiVf FPfu_PWM3_on_hiVf FPnd_PWM3_on_hiVf FPsvr_PWM3_on_hiVf FPsw_ext1_PWM3_on_hiVf FPsw_PWM3_on_hiVf /end REF_CHARACTERISTIC
/end GROUP
/begin GROUP PWM4_off_loVf_EC_Fault "PWM4-Gauge4 open / ground short"
 /begin REF_CHARACTERISTIC FCdc4_PWM4_off_loVf FCdtc_PWM4_off_loVf FCfmi_PWM4_off_loVf FCftb_PWM4_off_loVf FCspn_PWM4_off_loVf FPfl_PWM4_off_loVf FPfu_PWM4_off_loVf FPnd_PWM4_off_loVf FPsvr_PWM4_off_loVf FPsw_ext1_PWM4_off_loVf FPsw_PWM4_off_loVf /end REF_CHARACTERISTIC
/end GROUP
/begin GROUP PWM4_on_hiVf_EC_Fault "PWM4-Gauge4 short to power"
 /begin REF_CHARACTERISTIC FCdc4_PWM4_on_hiVf FCdtc_PWM4_on_hiVf FCfmi_PWM4_on_hiVf FCftb_PWM4_on_hiVf FCspn_PWM4_on_hiVf FPfl_PWM4_on_hiVf FPfu_PWM4_on_hiVf FPnd_PWM4_on_hiVf FPsvr_PWM4_on_hiVf FPsw_ext1_PWM4_on_hiVf FPsw_PWM4_on_hiVf /end REF_CHARACTERISTIC
/end GROUP
/begin GROUP PWM5_off_loVf_EC_Fault "PWM5 open / ground short"
 /begin REF_CHARACTERISTIC FCdc4_PWM5_off_loVf FCdtc_PWM5_off_loVf FCfmi_PWM5_off_loVf FCftb_PWM5_off_loVf FCspn_PWM5_off_loVf FPfl_PWM5_off_loVf FPfu_PWM5_off_loVf FPnd_PWM5_off_loVf FPsvr_PWM5_off_loVf FPsw_ext1_PWM5_off_loVf FPsw_PWM5_off_loVf /end REF_CHARACTERISTIC
/end GROUP
/begin GROUP PWM5_on_hiVf_EC_Fault "PWM5 short to power"
 /begin REF_CHARACTERISTIC FCdc4_PWM5_on_hiVf FCdtc_PWM5_on_hiVf FCfmi_PWM5_on_hiVf FCftb_PWM5_on_hiVf FCspn_PWM5_on_hiVf FPfl_PWM5_on_hiVf FPfu_PWM5_on_hiVf FPnd_PWM5_on_hiVf FPsvr_PWM5_on_hiVf FPsw_ext1_PWM5_on_hiVf FPsw_PWM5_on_hiVf /end REF_CHARACTERISTIC
/end GROUP
/begin GROUP PWM6_off_loVf_EC_Fault "PWM6 open / ground short"
 /begin REF_CHARACTERISTIC FCdc4_PWM6_off_loVf FCdtc_PWM6_off_loVf FCfmi_PWM6_off_loVf FCftb_PWM6_off_loVf FCspn_PWM6_off_loVf FPfl_PWM6_off_loVf FPfu_PWM6_off_loVf FPnd_PWM6_off_loVf FPsvr_PWM6_off_loVf FPsw_ext1_PWM6_off_loVf FPsw_PWM6_off_loVf /end REF_CHARACTERISTIC
/end GROUP
/begin GROUP PWM6_on_hiVf_EC_Fault "PWM6 short to power"
 /begin REF_CHARACTERISTIC FCdc4_PWM6_on_hiVf FCdtc_PWM6_on_hiVf FCfmi_PWM6_on_hiVf FCftb_PWM6_on_hiVf FCspn_PWM6_on_hiVf FPfl_PWM6_on_hiVf FPfu_PWM6_on_hiVf FPnd_PWM6_on_hiVf FPsvr_PWM6_on_hiVf FPsw_ext1_PWM6_on_hiVf FPsw_PWM6_on_hiVf /end REF_CHARACTERISTIC
/end GROUP
/begin GROUP PWM7_off_loVf_EC_Fault "PWM7 open / ground short"
 /begin REF_CHARACTERISTIC FCdc4_PWM7_off_loVf FCdtc_PWM7_off_loVf FCfmi_PWM7_off_loVf FCftb_PWM7_off_loVf FCspn_PWM7_off_loVf FPfl_PWM7_off_loVf FPfu_PWM7_off_loVf FPnd_PWM7_off_loVf FPsvr_PWM7_off_loVf FPsw_ext1_PWM7_off_loVf FPsw_PWM7_off_loVf /end REF_CHARACTERISTIC
/end GROUP
/begin GROUP PWM7_on_hiVf_EC_Fault "PWM7 short to power"
 /begin REF_CHARACTERISTIC FCdc4_PWM7_on_hiVf FCdtc_PWM7_on_hiVf FCfmi_PWM7_on_hiVf FCftb_PWM7_on_hiVf FCspn_PWM7_on_hiVf FPfl_PWM7_on_hiVf FPfu_PWM7_on_hiVf FPnd_PWM7_on_hiVf FPsvr_PWM7_on_hiVf FPsw_ext1_PWM7_on_hiVf FPsw_PWM7_on_hiVf /end REF_CHARACTERISTIC
/end GROUP
/begin GROUP PWM8_off_loVf_EC_Fault "PWM8 open / ground short"
 /begin REF_CHARACTERISTIC FCdc4_PWM8_off_loVf FCdtc_PWM8_off_loVf FCfmi_PWM8_off_loVf FCftb_PWM8_off_loVf FCspn_PWM8_off_loVf FPfl_PWM8_off_loVf FPfu_PWM8_off_loVf FPnd_PWM8_off_loVf FPsvr_PWM8_off_loVf FPsw_ext1_PWM8_off_loVf FPsw_PWM8_off_loVf /end REF_CHARACTERISTIC
/end GROUP
/begin GROUP PWM8_on_hiVf_EC_Fault "PWM8 short to power"
 /begin REF_CHARACTERISTIC FCdc4_PWM8_on_hiVf FCdtc_PWM8_on_hiVf FCfmi_PWM8_on_hiVf FCftb_PWM8_on_hiVf FCspn_PWM8_on_hiVf FPfl_PWM8_on_hiVf FPfu_PWM8_on_hiVf FPnd_PWM8_on_hiVf FPsvr_PWM8_on_hiVf FPsw_ext1_PWM8_on_hiVf FPsw_PWM8_on_hiVf /end REF_CHARACTERISTIC
/end GROUP
/begin GROUP PWM9_off_loVf_EC_Fault "PWM9 open / ground short"
 /begin REF_CHARACTERISTIC FCdc4_PWM9_off_loVf FCdtc_PWM9_off_loVf FCfmi_PWM9_off_loVf FCftb_PWM9_off_loVf FCspn_PWM9_off_loVf FPfl_PWM9_off_loVf FPfu_PWM9_off_loVf FPnd_PWM9_off_loVf FPsvr_PWM9_off_loVf FPsw_ext1_PWM9_off_loVf FPsw_PWM9_off_loVf /end REF_CHARACTERISTIC
/end GROUP
/begin GROUP PWM9_on_hiVf_EC_Fault "PWM9 short to power"
 /begin REF_CHARACTERISTIC FCdc4_PWM9_on_hiVf FCdtc_PWM9_on_hiVf FCfmi_PWM9_on_hiVf FCftb_PWM9_on_hiVf FCspn_PWM9_on_hiVf FPfl_PWM9_on_hiVf FPfu_PWM9_on_hiVf FPnd_PWM9_on_hiVf FPsvr_PWM9_on_hiVf FPsw_ext1_PWM9_on_hiVf FPsw_PWM9_on_hiVf /end REF_CHARACTERISTIC
/end GROUP
/begin GROUP PWMLO_off_loVf_EC_Fault "Lockoff open / ground short"
 /begin REF_CHARACTERISTIC FCdc4_PWMLO_off_loVf FCdtc_PWMLO_off_loVf FCfmi_PWMLO_off_loVf FCftb_PWMLO_off_loVf FCspn_PWMLO_off_loVf FPfl_PWMLO_off_loVf FPfu_PWMLO_off_loVf FPnd_PWMLO_off_loVf FPsvr_PWMLO_off_loVf FPsw_ext1_PWMLO_off_loVf FPsw_PWMLO_off_loVf /end REF_CHARACTERISTIC
/end GROUP
/begin GROUP PWMLO_on_hiVf_EC_Fault "Lockoff short to power"
 /begin REF_CHARACTERISTIC FCdc4_PWMLO_on_hiVf FCdtc_PWMLO_on_hiVf FCfmi_PWMLO_on_hiVf FCftb_PWMLO_on_hiVf FCspn_PWMLO_on_hiVf FPfl_PWMLO_on_hiVf FPfu_PWMLO_on_hiVf FPnd_PWMLO_on_hiVf FPsvr_PWMLO_on_hiVf FPsw_ext1_PWMLO_on_hiVf FPsw_PWMLO_on_hiVf /end REF_CHARACTERISTIC
/end GROUP
/begin GROUP RAM_fail_EC_Fault "RAM failure"
 /begin REF_CHARACTERISTIC FCdc4_RAM_fail FCdtc_RAM_fail FCfmi_RAM_fail FCftb_RAM_fail FCspn_RAM_fail FPfl_RAM_fail FPfu_RAM_fail FPnd_RAM_fail FPsvr_RAM_fail FPsw_ext1_RAM_fail FPsw_RAM_fail /end REF_CHARACTERISTIC
/end GROUP
/begin GROUP relay_coilopen_EC_Fault "Relay coil open"
 /begin REF_CHARACTERISTIC FCdc4_relay_coilopen FCdtc_relay_coilopen FCfmi_relay_coilopen FCftb_relay_coilopen FCspn_relay_coilopen FPfl_relay_coilopen FPfu_relay_coilopen FPnd_relay_coilopen FPsvr_relay_coilopen FPsw_ext1_relay_coilopen FPsw_relay_coilopen /end REF_CHARACTERISTIC
/end GROUP
/begin GROUP relay_coilshort_EC_Fault "Relay coil short to power"
 /begin REF_CHARACTERISTIC FCdc4_relay_coilshort FCdtc_relay_coilshort FCfmi_relay_coilshort FCftb_relay_coilshort FCspn_relay_coilshort FPfl_relay_coilshort FPfu_relay_coilshort FPnd_relay_coilshort FPsvr_relay_coilshort FPsw_ext1_relay_coilshort FPsw_relay_coilshort /end REF_CHARACTERISTIC
/end GROUP
/begin GROUP relay_gndshort_EC_Fault "Relay control ground short"
 /begin REF_CHARACTERISTIC FCdc4_relay_gndshort FCdtc_relay_gndshort FCfmi_relay_gndshort FCftb_relay_gndshort FCspn_relay_gndshort FPfl_relay_gndshort FPfu_relay_gndshort FPnd_relay_gndshort FPsvr_relay_gndshort FPsw_ext1_relay_gndshort FPsw_relay_gndshort /end REF_CHARACTERISTIC
/end GROUP
/begin GROUP relayoff_hiV_EC_Fault "Relay off high voltage"
 /begin REF_CHARACTERISTIC FCdc4_relayoff_hiV FCdtc_relayoff_hiV FCfmi_relayoff_hiV FCftb_relayoff_hiV FCspn_relayoff_hiV FPfl_relayoff_hiV FPfu_relayoff_hiV FPnd_relayoff_hiV FPsvr_relayoff_hiV FPsw_ext1_relayoff_hiV FPsw_relayoff_hiV /end REF_CHARACTERISTIC
/end GROUP
/begin GROUP relayon_loV_EC_Fault "Relay on low voltage"
 /begin REF_CHARACTERISTIC FCdc4_relayon_loV FCdtc_relayon_loV FCfmi_relayon_loV FCftb_relayon_loV FCspn_relayon_loV FPfl_relayon_loV FPfu_relayon_loV FPnd_relayon_loV FPsvr_relayon_loV FPsw_ext1_relayon_loV FPsw_relayon_loV /end REF_CHARACTERISTIC
/end GROUP
/begin GROUP rpm_hi_expected_EC_Fault "RPM higher than expected"
 /begin REF_CHARACTERISTIC FCdc4_rpm_hi_expected FCdtc_rpm_hi_expected FCfmi_rpm_hi_expected FCftb_rpm_hi_expected FCspn_rpm_hi_expected FPfl_rpm_hi_expected FPfu_rpm_hi_expected FPnd_rpm_hi_expected FPsvr_rpm_hi_expected FPsw_ext1_rpm_hi_expected FPsw_rpm_hi_expected /end REF_CHARACTERISTIC
/end GROUP
/begin GROUP rpmd_gov_lo_EC_Fault "Unable to achieve low target speed"
 /begin REF_CHARACTERISTIC FCdc4_rpmd_gov_lo FCdtc_rpmd_gov_lo FCfmi_rpmd_gov_lo FCftb_rpmd_gov_lo FCspn_rpmd_gov_lo FPfl_rpmd_gov_lo FPfu_rpmd_gov_lo FPnd_rpmd_gov_lo FPsvr_rpmd_gov_lo FPsw_ext1_rpmd_gov_lo FPsw_rpmd_gov_lo /end REF_CHARACTERISTIC
/end GROUP
/begin GROUP RS_discon_EC_Fault "Roadspeed sensor disconnected"
 /begin REF_CHARACTERISTIC FCdc4_RS_discon FCdtc_RS_discon FCfmi_RS_discon FCftb_RS_discon FCspn_RS_discon FPfl_RS_discon FPfu_RS_discon FPnd_RS_discon FPsvr_RS_discon FPsw_ext1_RS_discon FPsw_RS_discon /end REF_CHARACTERISTIC
/end GROUP
/begin GROUP RS_hiV_EC_Fault "Roadspeed open/short to power"
 /begin REF_CHARACTERISTIC FCdc4_RS_hiV FCdtc_RS_hiV FCfmi_RS_hiV FCftb_RS_hiV FCspn_RS_hiV FPfl_RS_hiV FPfu_RS_hiV FPnd_RS_hiV FPsvr_RS_hiV FPsw_ext1_RS_hiV FPsw_RS_hiV /end REF_CHARACTERISTIC
/end GROUP
/begin GROUP RS_loss_EC_Fault "Roadspeed loss"
 /begin REF_CHARACTERISTIC FCdc4_RS_loss FCdtc_RS_loss FCfmi_RS_loss FCftb_RS_loss FCspn_RS_loss FPfl_RS_loss FPfu_RS_loss FPnd_RS_loss FPsvr_RS_loss FPsw_ext1_RS_loss FPsw_RS_loss /end REF_CHARACTERISTIC
/end GROUP
/begin GROUP RS_loV_EC_Fault "Roadspeed short to ground"
 /begin REF_CHARACTERISTIC FCdc4_RS_loV FCdtc_RS_loV FCfmi_RS_loV FCftb_RS_loV FCspn_RS_loV FPfl_RS_loV FPfu_RS_loV FPnd_RS_loV FPsvr_RS_loV FPsw_ext1_RS_loV FPsw_RS_loV /end REF_CHARACTERISTIC
/end GROUP
/begin GROUP RS485_bad_fmt_EC_Fault "Invalid Packet Format"
 /begin REF_CHARACTERISTIC FCdc4_RS485_bad_fmt FCdtc_RS485_bad_fmt FCfmi_RS485_bad_fmt FCftb_RS485_bad_fmt FCspn_RS485_bad_fmt FPfl_RS485_bad_fmt FPfu_RS485_bad_fmt FPnd_RS485_bad_fmt FPsvr_RS485_bad_fmt FPsw_ext1_RS485_bad_fmt FPsw_RS485_bad_fmt /end REF_CHARACTERISTIC
/end GROUP
/begin GROUP RS485_Rx_inact_EC_Fault "Rx Inactive"
 /begin REF_CHARACTERISTIC FCdc4_RS485_Rx_inact FCdtc_RS485_Rx_inact FCfmi_RS485_Rx_inact FCftb_RS485_Rx_inact FCspn_RS485_Rx_inact FPfl_RS485_Rx_inact FPfu_RS485_Rx_inact FPnd_RS485_Rx_inact FPsvr_RS485_Rx_inact FPsw_ext1_RS485_Rx_inact FPsw_RS485_Rx_inact /end REF_CHARACTERISTIC
/end GROUP
/begin GROUP RS485_Rx_noise_EC_Fault "Rx Noise"
 /begin REF_CHARACTERISTIC FCdc4_RS485_Rx_noise FCdtc_RS485_Rx_noise FCfmi_RS485_Rx_noise FCftb_RS485_Rx_noise FCspn_RS485_Rx_noise FPfl_RS485_Rx_noise FPfu_RS485_Rx_noise FPnd_RS485_Rx_noise FPsvr_RS485_Rx_noise FPsw_ext1_RS485_Rx_noise FPsw_RS485_Rx_noise /end REF_CHARACTERISTIC
/end GROUP
/begin GROUP RS485_SD_rq_EC_Fault "Shutdown Request"
 /begin REF_CHARACTERISTIC FCdc4_RS485_SD_rq FCdtc_RS485_SD_rq FCfmi_RS485_SD_rq FCftb_RS485_SD_rq FCspn_RS485_SD_rq FPfl_RS485_SD_rq FPfu_RS485_SD_rq FPnd_RS485_SD_rq FPsvr_RS485_SD_rq FPsw_ext1_RS485_SD_rq FPsw_RS485_SD_rq /end REF_CHARACTERISTIC
/end GROUP
/begin GROUP RTI1_EC_Fault "RTI 1 loss"
 /begin REF_CHARACTERISTIC FCdc4_RTI1 FCdtc_RTI1 FCfmi_RTI1 FCftb_RTI1 FCspn_RTI1 FPfl_RTI1 FPfu_RTI1 FPnd_RTI1 FPsvr_RTI1 FPsw_ext1_RTI1 FPsw_RTI1 /end REF_CHARACTERISTIC
/end GROUP
/begin GROUP RTI2_EC_Fault "RTI 2 loss"
 /begin REF_CHARACTERISTIC FCdc4_RTI2 FCdtc_RTI2 FCfmi_RTI2 FCftb_RTI2 FCspn_RTI2 FPfl_RTI2 FPfu_RTI2 FPnd_RTI2 FPsvr_RTI2 FPsw_ext1_RTI2 FPsw_RTI2 /end REF_CHARACTERISTIC
/end GROUP
/begin GROUP RTI3_EC_Fault "RTI 3 loss"
 /begin REF_CHARACTERISTIC FCdc4_RTI3 FCdtc_RTI3 FCfmi_RTI3 FCftb_RTI3 FCspn_RTI3 FPfl_RTI3 FPfu_RTI3 FPnd_RTI3 FPsvr_RTI3 FPsw_ext1_RTI3 FPsw_RTI3 /end REF_CHARACTERISTIC
/end GROUP
/begin GROUP SHIFT_FB_OOR_EC_Fault "Shift feedback absent or out-of-range"
 /begin REF_CHARACTERISTIC FCdc4_SHIFT_FB_OOR FCdtc_SHIFT_FB_OOR FCfmi_SHIFT_FB_OOR FCftb_SHIFT_FB_OOR FCspn_SHIFT_FB_OOR FPfl_SHIFT_FB_OOR FPfu_SHIFT_FB_OOR FPnd_SHIFT_FB_OOR FPsvr_SHIFT_FB_OOR FPsw_ext1_SHIFT_FB_OOR FPsw_SHIFT_FB_OOR /end REF_CHARACTERISTIC
/end GROUP
/begin GROUP SHIFT_intcirc_fail_EC_Fault "Shift actuator or drive circuit failure"
 /begin REF_CHARACTERISTIC FCdc4_SHIFT_intcirc_fail FCdtc_SHIFT_intcirc_fail FCfmi_SHIFT_intcirc_fail FCftb_SHIFT_intcirc_fail FCspn_SHIFT_intcirc_fail FPfl_SHIFT_intcirc_fail FPfu_SHIFT_intcirc_fail FPnd_SHIFT_intcirc_fail FPsvr_SHIFT_intcirc_fail FPsw_ext1_SHIFT_intcirc_fail FPsw_SHIFT_intcirc_fail /end REF_CHARACTERISTIC
/end GROUP
/begin GROUP SHIFT_shift_fail_EC_Fault "Shift unable to reach desired gear"
 /begin REF_CHARACTERISTIC FCdc4_SHIFT_shift_fail FCdtc_SHIFT_shift_fail FCfmi_SHIFT_shift_fail FCftb_SHIFT_shift_fail FCspn_SHIFT_shift_fail FPfl_SHIFT_shift_fail FPfu_SHIFT_shift_fail FPnd_SHIFT_shift_fail FPsvr_SHIFT_shift_fail FPsw_ext1_SHIFT_shift_fail FPsw_SHIFT_shift_fail /end REF_CHARACTERISTIC
/end GROUP
/begin GROUP SL_fuel_EC_Fault "Fuel rev limit"
 /begin REF_CHARACTERISTIC FCdc4_SL_fuel FCdtc_SL_fuel FCfmi_SL_fuel FCftb_SL_fuel FCspn_SL_fuel FPfl_SL_fuel FPfu_SL_fuel FPnd_SL_fuel FPsvr_SL_fuel FPsw_ext1_SL_fuel FPsw_SL_fuel /end REF_CHARACTERISTIC
/end GROUP
/begin GROUP SL_gov_EC_Fault "Max govern speed override"
 /begin REF_CHARACTERISTIC FCdc4_SL_gov FCdtc_SL_gov FCfmi_SL_gov FCftb_SL_gov FCspn_SL_gov FPfl_SL_gov FPfu_SL_gov FPnd_SL_gov FPsvr_SL_gov FPsw_ext1_SL_gov FPsw_SL_gov /end REF_CHARACTERISTIC
/end GROUP
/begin GROUP SL_spk_EC_Fault "Spark rev limit"
 /begin REF_CHARACTERISTIC FCdc4_SL_spk FCdtc_SL_spk FCfmi_SL_spk FCftb_SL_spk FCspn_SL_spk FPfl_SL_spk FPfu_SL_spk FPnd_SL_spk FPsvr_SL_spk FPsw_ext1_SL_spk FPsw_SL_spk /end REF_CHARACTERISTIC
/end GROUP
/begin GROUP slv_MAP_hi_OOA_EC_Fault "Multi-ECM slave MAP high - out of authority"
 /begin REF_CHARACTERISTIC FCdc4_slv_MAP_hi_OOA FCdtc_slv_MAP_hi_OOA FCfmi_slv_MAP_hi_OOA FCftb_slv_MAP_hi_OOA FCspn_slv_MAP_hi_OOA FPfl_slv_MAP_hi_OOA FPfu_slv_MAP_hi_OOA FPnd_slv_MAP_hi_OOA FPsvr_slv_MAP_hi_OOA FPsw_ext1_slv_MAP_hi_OOA FPsw_slv_MAP_hi_OOA /end REF_CHARACTERISTIC
/end GROUP
/begin GROUP slv_MAP_lo_OOA_EC_Fault "Multi-ECM slave MAP low - out of authority"
 /begin REF_CHARACTERISTIC FCdc4_slv_MAP_lo_OOA FCdtc_slv_MAP_lo_OOA FCfmi_slv_MAP_lo_OOA FCftb_slv_MAP_lo_OOA FCspn_slv_MAP_lo_OOA FPfl_slv_MAP_lo_OOA FPfu_slv_MAP_lo_OOA FPnd_slv_MAP_lo_OOA FPsvr_slv_MAP_lo_OOA FPsw_ext1_slv_MAP_lo_OOA FPsw_slv_MAP_lo_OOA /end REF_CHARACTERISTIC
/end GROUP
/begin GROUP SPK_int_fail_EC_Fault "External Spark Module Failure"
 /begin REF_CHARACTERISTIC FCdc4_SPK_int_fail FCdtc_SPK_int_fail FCfmi_SPK_int_fail FCftb_SPK_int_fail FCspn_SPK_int_fail FPfl_SPK_int_fail FPfu_SPK_int_fail FPnd_SPK_int_fail FPsvr_SPK_int_fail FPsw_ext1_SPK_int_fail FPsw_SPK_int_fail /end REF_CHARACTERISTIC
/end GROUP
/begin GROUP SPK1_IGBT_T_EC_Fault "Spark Plug or Coil Failure"
 /begin REF_CHARACTERISTIC FCdc4_SPK1_IGBT_T FCdtc_SPK1_IGBT_T FCfmi_SPK1_IGBT_T FCftb_SPK1_IGBT_T FCspn_SPK1_IGBT_T FPfl_SPK1_IGBT_T FPfu_SPK1_IGBT_T FPnd_SPK1_IGBT_T FPsvr_SPK1_IGBT_T FPsw_ext1_SPK1_IGBT_T FPsw_SPK1_IGBT_T /end REF_CHARACTERISTIC
/end GROUP
/begin GROUP SPKD_coil_fail_EC_Fault "External Spark Module Coil Failure"
 /begin REF_CHARACTERISTIC FCdc4_SPKD_coil_fail FCdtc_SPKD_coil_fail FCfmi_SPKD_coil_fail FCftb_SPKD_coil_fail FCspn_SPKD_coil_fail FPfl_SPKD_coil_fail FPfu_SPKD_coil_fail FPnd_SPKD_coil_fail FPsvr_SPKD_coil_fail FPsw_ext1_SPKD_coil_fail FPsw_SPKD_coil_fail /end REF_CHARACTERISTIC
/end GROUP
/begin GROUP SPKD_dw_hi_EC_Fault "Primary Coil Shorted"
 /begin REF_CHARACTERISTIC FCdc4_SPKD_dw_hi FCdtc_SPKD_dw_hi FCfmi_SPKD_dw_hi FCftb_SPKD_dw_hi FCspn_SPKD_dw_hi FPfl_SPKD_dw_hi FPfu_SPKD_dw_hi FPnd_SPKD_dw_hi FPsvr_SPKD_dw_hi FPsw_ext1_SPKD_dw_hi FPsw_SPKD_dw_hi /end REF_CHARACTERISTIC
/end GROUP
/begin GROUP SPKD_dw_lo_EC_Fault "Primary Loop Open or"
 /begin REF_CHARACTERISTIC FCdc4_SPKD_dw_lo FCdtc_SPKD_dw_lo FCfmi_SPKD_dw_lo FCftb_SPKD_dw_lo FCspn_SPKD_dw_lo FPfl_SPKD_dw_lo FPfu_SPKD_dw_lo FPnd_SPKD_dw_lo FPsvr_SPKD_dw_lo FPsw_ext1_SPKD_dw_lo FPsw_SPKD_dw_lo /end REF_CHARACTERISTIC
/end GROUP
/begin GROUP SRVC_expired_EC_Fault "Service Interval Expired - Level 1"
 /begin REF_CHARACTERISTIC FCdc4_SRVC_expired FCdtc_SRVC_expired FCfmi_SRVC_expired FCftb_SRVC_expired FCspn_SRVC_expired FPfl_SRVC_expired FPfu_SRVC_expired FPnd_SRVC_expired FPsvr_SRVC_expired FPsw_ext1_SRVC_expired FPsw_SRVC_expired /end REF_CHARACTERISTIC
/end GROUP
/begin GROUP SRVC_expired2_EC_Fault "Service Interval Expired - Level 2"
 /begin REF_CHARACTERISTIC FCdc4_SRVC_expired2 FCdtc_SRVC_expired2 FCfmi_SRVC_expired2 FCftb_SRVC_expired2 FCspn_SRVC_expired2 FPfl_SRVC_expired2 FPfu_SRVC_expired2 FPnd_SRVC_expired2 FPsvr_SRVC_expired2 FPsw_ext1_SRVC_expired2 FPsw_SRVC_expired2 /end REF_CHARACTERISTIC
/end GROUP
/begin GROUP start_coilopen_EC_Fault "Start relay coil open"
 /begin REF_CHARACTERISTIC FCdc4_start_coilopen FCdtc_start_coilopen FCfmi_start_coilopen FCftb_start_coilopen FCspn_start_coilopen FPfl_start_coilopen FPfu_start_coilopen FPnd_start_coilopen FPsvr_start_coilopen FPsw_ext1_start_coilopen FPsw_start_coilopen /end REF_CHARACTERISTIC
/end GROUP
/begin GROUP start_coilshort_EC_Fault "Start relay coil short to power"
 /begin REF_CHARACTERISTIC FCdc4_start_coilshort FCdtc_start_coilshort FCfmi_start_coilshort FCftb_start_coilshort FCspn_start_coilshort FPfl_start_coilshort FPfu_start_coilshort FPnd_start_coilshort FPsvr_start_coilshort FPsw_ext1_start_coilshort FPsw_start_coilshort /end REF_CHARACTERISTIC
/end GROUP
/begin GROUP start_excess_EC_Fault "Excessive start attempts"
 /begin REF_CHARACTERISTIC FCdc4_start_excess FCdtc_start_excess FCfmi_start_excess FCftb_start_excess FCspn_start_excess FPfl_start_excess FPfu_start_excess FPnd_start_excess FPsvr_start_excess FPsw_ext1_start_excess FPsw_start_excess /end REF_CHARACTERISTIC
/end GROUP
/begin GROUP start_gndshort_EC_Fault "Start relay control ground short"
 /begin REF_CHARACTERISTIC FCdc4_start_gndshort FCdtc_start_gndshort FCfmi_start_gndshort FCftb_start_gndshort FCspn_start_gndshort FPfl_start_gndshort FPfu_start_gndshort FPnd_start_gndshort FPsvr_start_gndshort FPsw_ext1_start_gndshort FPsw_start_gndshort /end REF_CHARACTERISTIC
/end GROUP
/begin GROUP start_stuck_active_EC_Fault "Start command stuck active"
 /begin REF_CHARACTERISTIC FCdc4_start_stuck_active FCdtc_start_stuck_active FCfmi_start_stuck_active FCftb_start_stuck_active FCspn_start_stuck_active FPfl_start_stuck_active FPfu_start_stuck_active FPnd_start_stuck_active FPsvr_start_stuck_active FPsw_ext1_start_stuck_active FPsw_start_stuck_active /end REF_CHARACTERISTIC
/end GROUP
/begin GROUP SubDiagTemp_EC_Fault "ECT dropped below diagnostics temperature"
 /begin REF_CHARACTERISTIC FCdc4_SubDiagTemp FCdtc_SubDiagTemp FCfmi_SubDiagTemp FCftb_SubDiagTemp FCspn_SubDiagTemp FPfl_SubDiagTemp FPfu_SubDiagTemp FPnd_SubDiagTemp FPsvr_SubDiagTemp FPsw_ext1_SubDiagTemp FPsw_SubDiagTemp /end REF_CHARACTERISTIC
/end GROUP
/begin GROUP tach_gndshort_EC_Fault "Tach output ground short"
 /begin REF_CHARACTERISTIC FCdc4_tach_gndshort FCdtc_tach_gndshort FCfmi_tach_gndshort FCftb_tach_gndshort FCspn_tach_gndshort FPfl_tach_gndshort FPfu_tach_gndshort FPnd_tach_gndshort FPsvr_tach_gndshort FPsw_ext1_tach_gndshort FPsw_tach_gndshort /end REF_CHARACTERISTIC
/end GROUP
/begin GROUP tach_pwrshort_EC_Fault "Tach output short to power"
 /begin REF_CHARACTERISTIC FCdc4_tach_pwrshort FCdtc_tach_pwrshort FCfmi_tach_pwrshort FCftb_tach_pwrshort FCspn_tach_pwrshort FPfl_tach_pwrshort FPfu_tach_pwrshort FPnd_tach_pwrshort FPsvr_tach_pwrshort FPsw_ext1_tach_pwrshort FPsw_tach_pwrshort /end REF_CHARACTERISTIC
/end GROUP
/begin GROUP TAUX_dT1_max_EC_Fault "AUX Temperature delta T 1 high"
 /begin REF_CHARACTERISTIC FCdc4_TAUX_dT1_max FCdtc_TAUX_dT1_max FCfmi_TAUX_dT1_max FCftb_TAUX_dT1_max FCspn_TAUX_dT1_max FPfl_TAUX_dT1_max FPfu_TAUX_dT1_max FPnd_TAUX_dT1_max FPsvr_TAUX_dT1_max FPsw_ext1_TAUX_dT1_max FPsw_TAUX_dT1_max /end REF_CHARACTERISTIC
/end GROUP
/begin GROUP TAUX_dT1_min_EC_Fault "AUX Temperature delta T 1 low"
 /begin REF_CHARACTERISTIC FCdc4_TAUX_dT1_min FCdtc_TAUX_dT1_min FCfmi_TAUX_dT1_min FCftb_TAUX_dT1_min FCspn_TAUX_dT1_min FPfl_TAUX_dT1_min FPfu_TAUX_dT1_min FPnd_TAUX_dT1_min FPsvr_TAUX_dT1_min FPsw_ext1_TAUX_dT1_min FPsw_TAUX_dT1_min /end REF_CHARACTERISTIC
/end GROUP
/begin GROUP TAUX_dT2_max_EC_Fault "AUX Temperature delta T 2 high"
 /begin REF_CHARACTERISTIC FCdc4_TAUX_dT2_max FCdtc_TAUX_dT2_max FCfmi_TAUX_dT2_max FCftb_TAUX_dT2_max FCspn_TAUX_dT2_max FPfl_TAUX_dT2_max FPfu_TAUX_dT2_max FPnd_TAUX_dT2_max FPsvr_TAUX_dT2_max FPsw_ext1_TAUX_dT2_max FPsw_TAUX_dT2_max /end REF_CHARACTERISTIC
/end GROUP
/begin GROUP TAUX_dT2_min_EC_Fault "AUX Temperature delta T 2 low"
 /begin REF_CHARACTERISTIC FCdc4_TAUX_dT2_min FCdtc_TAUX_dT2_min FCfmi_TAUX_dT2_min FCftb_TAUX_dT2_min FCspn_TAUX_dT2_min FPfl_TAUX_dT2_min FPfu_TAUX_dT2_min FPnd_TAUX_dT2_min FPsvr_TAUX_dT2_min FPsw_ext1_TAUX_dT2_min FPsw_TAUX_dT2_min /end REF_CHARACTERISTIC
/end GROUP
/begin GROUP Taux1_derate_actv_EC_Fault "Auxiliary temperature 1 derate active"
 /begin REF_CHARACTERISTIC FCdc4_Taux1_derate_actv FCdtc_Taux1_derate_actv FCfmi_Taux1_derate_actv FCftb_Taux1_derate_actv FCspn_Taux1_derate_actv FPfl_Taux1_derate_actv FPfu_Taux1_derate_actv FPnd_Taux1_derate_actv FPsvr_Taux1_derate_actv FPsw_ext1_Taux1_derate_actv FPsw_Taux1_derate_actv /end REF_CHARACTERISTIC
/end GROUP
/begin GROUP TAUX1_max_EC_Fault "Auxiliary temperature 1 high"
 /begin REF_CHARACTERISTIC FCdc4_TAUX1_max FCdtc_TAUX1_max FCfmi_TAUX1_max FCftb_TAUX1_max FCspn_TAUX1_max FPfl_TAUX1_max FPfu_TAUX1_max FPnd_TAUX1_max FPsvr_TAUX1_max FPsw_ext1_TAUX1_max FPsw_TAUX1_max /end REF_CHARACTERISTIC
/end GROUP
/begin GROUP TAUX1_min_EC_Fault "Auxiliary temperature 1 low"
 /begin REF_CHARACTERISTIC FCdc4_TAUX1_min FCdtc_TAUX1_min FCfmi_TAUX1_min FCftb_TAUX1_min FCspn_TAUX1_min FPfl_TAUX1_min FPfu_TAUX1_min FPnd_TAUX1_min FPsvr_TAUX1_min FPsw_ext1_TAUX1_min FPsw_TAUX1_min /end REF_CHARACTERISTIC
/end GROUP
/begin GROUP Taux2_derate_actv_EC_Fault "Auxiliary temperature 2 derate active"
 /begin REF_CHARACTERISTIC FCdc4_Taux2_derate_actv FCdtc_Taux2_derate_actv FCfmi_Taux2_derate_actv FCftb_Taux2_derate_actv FCspn_Taux2_derate_actv FPfl_Taux2_derate_actv FPfu_Taux2_derate_actv FPnd_Taux2_derate_actv FPsvr_Taux2_derate_actv FPsw_ext1_Taux2_derate_actv FPsw_Taux2_derate_actv /end REF_CHARACTERISTIC
/end GROUP
/end MODULE
/end PROJECT
