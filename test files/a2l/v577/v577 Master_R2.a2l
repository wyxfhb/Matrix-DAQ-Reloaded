ASAP2_VERSION 1 61
/begin PROJECT Econtrols_4G "4G Test"
/begin HEADER "4G A2L Configuration" PROJECT_NO EControls4G /* config for version control */ VERSION "$Revision: 82130 $:" /* config for version control */ /end HEADER
/begin MODULE EControls_4G_SH2A "EControls 4G"
/begin MOD_COMMON "" DEPOSIT ABSOLUTE BYTE_ORDER MSB_FIRST /end MOD_COMMON
/* Define the Record Layouts */
/begin RECORD_LAYOUT ECIPP_ALIGNMENT_UBYTE FNC_VALUES 1 UBYTE COLUMN_DIR DIRECT /end RECORD_LAYOUT
/begin RECORD_LAYOUT ECIPP_ALIGNMENT_UWORD FNC_VALUES 1 UWORD COLUMN_DIR DIRECT /end RECORD_LAYOUT
/begin RECORD_LAYOUT ECIPP_ALIGNMENT_ULONG FNC_VALUES 1 ULONG COLUMN_DIR DIRECT /end RECORD_LAYOUT
/begin RECORD_LAYOUT ECIPP_ALIGNMENT_FLOAT32_IEEE FNC_VALUES 1 FLOAT32_IEEE COLUMN_DIR DIRECT /end RECORD_LAYOUT
/begin COMPU_METHOD Compu_IDENTITY "Discrete Values " /* Identifier */ IDENTICAL "%.0" /* Format */ "-" /* Units */ /end COMPU_METHOD
/begin CHARACTERISTIC FCdc4_CATout_OOR "FCtl_DTC_0x04(831)" VALUE 0x0016424E /* @ECU_Address@FCtl_DTC_0x04@0x024C467E@ */ ECIPP_ALIGNMENT_UWORD 65535 Compu_IDENTITY 0 65535 PHYS_UNIT "System ID + DTC" /end CHARACTERISTIC
/begin CHARACTERISTIC FCdc4_CFV_FP_minv "FCtl_DTC_0x04(687)" VALUE 0x0016412E /* @ECU_Address@FCtl_DTC_0x04@0x024C455E@ */ ECIPP_ALIGNMENT_UWORD 65535 Compu_IDENTITY 0 65535 PHYS_UNIT "System ID + DTC" /end CHARACTERISTIC
/begin CHARACTERISTIC FCdc4_CFV_FT_maxv "FCtl_DTC_0x04(688)" VALUE 0x00164130 /* @ECU_Address@FCtl_DTC_0x04@0x024C4560@ */ ECIPP_ALIGNMENT_UWORD 65535 Compu_IDENTITY 0 65535 PHYS_UNIT "System ID + DTC" /end CHARACTERISTIC
/begin CHARACTERISTIC FCdc4_CFV_FT_minv "FCtl_DTC_0x04(689)" VALUE 0x00164132 /* @ECU_Address@FCtl_DTC_0x04@0x024C4562@ */ ECIPP_ALIGNMENT_UWORD 65535 Compu_IDENTITY 0 65535 PHYS_UNIT "System ID + DTC" /end CHARACTERISTIC
/begin CHARACTERISTIC FCdc4_CFV_mdot_hi "FCtl_DTC_0x04(523)" VALUE 0x00163FE6 /* @ECU_Address@FCtl_DTC_0x04@0x024C4416@ */ ECIPP_ALIGNMENT_UWORD 65535 Compu_IDENTITY 0 65535 PHYS_UNIT "System ID + DTC" /end CHARACTERISTIC
/begin CHARACTERISTIC FCdc4_CFV_mdot_lo "FCtl_DTC_0x04(524)" VALUE 0x00163FE8 /* @ECU_Address@FCtl_DTC_0x04@0x024C4418@ */ ECIPP_ALIGNMENT_UWORD 65535 Compu_IDENTITY 0 65535 PHYS_UNIT "System ID + DTC" /end CHARACTERISTIC
/begin CHARACTERISTIC FCdc4_CFV_mdot_rms_hi "FCtl_DTC_0x04(679)" VALUE 0x0016411E /* @ECU_Address@FCtl_DTC_0x04@0x024C454E@ */ ECIPP_ALIGNMENT_UWORD 65535 Compu_IDENTITY 0 65535 PHYS_UNIT "System ID + DTC" /end CHARACTERISTIC
/begin CHARACTERISTIC FCdc4_CFV_pwr_loss "FCtl_DTC_0x04(830)" VALUE 0x0016424C /* @ECU_Address@FCtl_DTC_0x04@0x024C467C@ */ ECIPP_ALIGNMENT_UWORD 65535 Compu_IDENTITY 0 65535 PHYS_UNIT "System ID + DTC" /end CHARACTERISTIC
/begin CHARACTERISTIC FCdc4_CFV_RLV_fail "FCtl_DTC_0x04(535)" VALUE 0x00163FFE /* @ECU_Address@FCtl_DTC_0x04@0x024C442E@ */ ECIPP_ALIGNMENT_UWORD 65535 Compu_IDENTITY 0 65535 PHYS_UNIT "System ID + DTC" /end CHARACTERISTIC
/begin CHARACTERISTIC FCdc4_CFV_RLV_P_min "FCtl_DTC_0x04(534)" VALUE 0x00163FFC /* @ECU_Address@FCtl_DTC_0x04@0x024C442C@ */ ECIPP_ALIGNMENT_UWORD 65535 Compu_IDENTITY 0 65535 PHYS_UNIT "System ID + DTC" /end CHARACTERISTIC
/begin CHARACTERISTIC FCdc4_CHT_HiExp "FCtl_DTC_0x04(114)" VALUE 0x00163CB4 /* @ECU_Address@FCtl_DTC_0x04@0x024C40E4@ */ ECIPP_ALIGNMENT_UWORD 65535 Compu_IDENTITY 0 65535 PHYS_UNIT "System ID + DTC" /end CHARACTERISTIC
/begin CHARACTERISTIC FCdc4_CHT_HiExp2 "FCtl_DTC_0x04(115)" VALUE 0x00163CB6 /* @ECU_Address@FCtl_DTC_0x04@0x024C40E6@ */ ECIPP_ALIGNMENT_UWORD 65535 Compu_IDENTITY 0 65535 PHYS_UNIT "System ID + DTC" /end CHARACTERISTIC
/begin CHARACTERISTIC FCdc4_CL_hi "FCtl_DTC_0x04(32)" VALUE 0x00163C10 /* @ECU_Address@FCtl_DTC_0x04@0x024C4040@ */ ECIPP_ALIGNMENT_UWORD 65535 Compu_IDENTITY 0 65535 PHYS_UNIT "System ID + DTC" /end CHARACTERISTIC
/begin CHARACTERISTIC FCdc4_CL_lo "FCtl_DTC_0x04(33)" VALUE 0x00163C12 /* @ECU_Address@FCtl_DTC_0x04@0x024C4042@ */ ECIPP_ALIGNMENT_UWORD 65535 Compu_IDENTITY 0 65535 PHYS_UNIT "System ID + DTC" /end CHARACTERISTIC
/begin CHARACTERISTIC FCdc4_CL_phi_hi "FCtl_DTC_0x04(677)" VALUE 0x0016411A /* @ECU_Address@FCtl_DTC_0x04@0x024C454A@ */ ECIPP_ALIGNMENT_UWORD 65535 Compu_IDENTITY 0 65535 PHYS_UNIT "System ID + DTC" /end CHARACTERISTIC
/begin CHARACTERISTIC FCdc4_CL_phi_lo "FCtl_DTC_0x04(678)" VALUE 0x0016411C /* @ECU_Address@FCtl_DTC_0x04@0x024C454C@ */ ECIPP_ALIGNMENT_UWORD 65535 Compu_IDENTITY 0 65535 PHYS_UNIT "System ID + DTC" /end CHARACTERISTIC
/begin CHARACTERISTIC FCdc4_CLLP_hi "FCtl_DTC_0x04(36)" VALUE 0x00163C18 /* @ECU_Address@FCtl_DTC_0x04@0x024C4048@ */ ECIPP_ALIGNMENT_UWORD 65535 Compu_IDENTITY 0 65535 PHYS_UNIT "System ID + DTC" /end CHARACTERISTIC
/begin CHARACTERISTIC FCdc4_CLLP_lo "FCtl_DTC_0x04(37)" VALUE 0x00163C1A /* @ECU_Address@FCtl_DTC_0x04@0x024C404A@ */ ECIPP_ALIGNMENT_UWORD 65535 Compu_IDENTITY 0 65535 PHYS_UNIT "System ID + DTC" /end CHARACTERISTIC
/begin CHARACTERISTIC FCdc4_CLNG_hi "FCtl_DTC_0x04(38)" VALUE 0x00163C1C /* @ECU_Address@FCtl_DTC_0x04@0x024C404C@ */ ECIPP_ALIGNMENT_UWORD 65535 Compu_IDENTITY 0 65535 PHYS_UNIT "System ID + DTC" /end CHARACTERISTIC
/begin CHARACTERISTIC FCdc4_CLNG_lo "FCtl_DTC_0x04(39)" VALUE 0x00163C1E /* @ECU_Address@FCtl_DTC_0x04@0x024C404E@ */ ECIPP_ALIGNMENT_UWORD 65535 Compu_IDENTITY 0 65535 PHYS_UNIT "System ID + DTC" /end CHARACTERISTIC
/begin CHARACTERISTIC FCdc4_CM_unresp "FCtl_DTC_0x04(799)" VALUE 0x0016420E /* @ECU_Address@FCtl_DTC_0x04@0x024C463E@ */ ECIPP_ALIGNMENT_UWORD 65535 Compu_IDENTITY 0 65535 PHYS_UNIT "System ID + DTC" /end CHARACTERISTIC
/begin CHARACTERISTIC FCdc4_CMgsln_inact "FCtl_DTC_0x04(130)" VALUE 0x00163CD4 /* @ECU_Address@FCtl_DTC_0x04@0x024C4104@ */ ECIPP_ALIGNMENT_UWORD 65535 Compu_IDENTITY 0 65535 PHYS_UNIT "System ID + DTC" /end CHARACTERISTIC
/begin CHARACTERISTIC FCdc4_CMLP_inact "FCtl_DTC_0x04(131)" VALUE 0x00163CD6 /* @ECU_Address@FCtl_DTC_0x04@0x024C4106@ */ ECIPP_ALIGNMENT_UWORD 65535 Compu_IDENTITY 0 65535 PHYS_UNIT "System ID + DTC" /end CHARACTERISTIC
/begin CHARACTERISTIC FCdc4_CMNG_inact "FCtl_DTC_0x04(132)" VALUE 0x00163CD8 /* @ECU_Address@FCtl_DTC_0x04@0x024C4108@ */ ECIPP_ALIGNMENT_UWORD 65535 Compu_IDENTITY 0 65535 PHYS_UNIT "System ID + DTC" /end CHARACTERISTIC
/begin CHARACTERISTIC FCdc4_COPfail "FCtl_DTC_0x04(99)" VALUE 0x00163C96 /* @ECU_Address@FCtl_DTC_0x04@0x024C40C6@ */ ECIPP_ALIGNMENT_UWORD 65535 Compu_IDENTITY 0 65535 PHYS_UNIT "System ID + DTC" /end CHARACTERISTIC
/begin CHARACTERISTIC FCdc4_COT_hi "FCtl_DTC_0x04(657)" VALUE 0x001640F2 /* @ECU_Address@FCtl_DTC_0x04@0x024C4522@ */ ECIPP_ALIGNMENT_UWORD 65535 Compu_IDENTITY 0 65535 PHYS_UNIT "System ID + DTC" /end CHARACTERISTIC
/begin CHARACTERISTIC FCdc4_crkloss "FCtl_DTC_0x04(152)" VALUE 0x00163D00 /* @ECU_Address@FCtl_DTC_0x04@0x024C4130@ */ ECIPP_ALIGNMENT_UWORD 65535 Compu_IDENTITY 0 65535 PHYS_UNIT "System ID + DTC" /end CHARACTERISTIC
/begin CHARACTERISTIC FCdc4_crknever "FCtl_DTC_0x04(98)" VALUE 0x00163C94 /* @ECU_Address@FCtl_DTC_0x04@0x024C40C4@ */ ECIPP_ALIGNMENT_UWORD 65535 Compu_IDENTITY 0 65535 PHYS_UNIT "System ID + DTC" /end CHARACTERISTIC
/begin CHARACTERISTIC FCdc4_crknoise "FCtl_DTC_0x04(97)" VALUE 0x00163C92 /* @ECU_Address@FCtl_DTC_0x04@0x024C40C2@ */ ECIPP_ALIGNMENT_UWORD 65535 Compu_IDENTITY 0 65535 PHYS_UNIT "System ID + DTC" /end CHARACTERISTIC
/begin CHARACTERISTIC FCdc4_CVCS_discon "FCtl_DTC_0x04(747)" VALUE 0x001641A6 /* @ECU_Address@FCtl_DTC_0x04@0x024C45D6@ */ ECIPP_ALIGNMENT_UWORD 65535 Compu_IDENTITY 0 65535 PHYS_UNIT "System ID + DTC" /end CHARACTERISTIC
/begin CHARACTERISTIC FCdc4_CVDS_discon "FCtl_DTC_0x04(748)" VALUE 0x001641A8 /* @ECU_Address@FCtl_DTC_0x04@0x024C45D8@ */ ECIPP_ALIGNMENT_UWORD 65535 Compu_IDENTITY 0 65535 PHYS_UNIT "System ID + DTC" /end CHARACTERISTIC
/begin CHARACTERISTIC FCdc4_CVP1_hi "FCtl_DTC_0x04(794)" VALUE 0x00164204 /* @ECU_Address@FCtl_DTC_0x04@0x024C4634@ */ ECIPP_ALIGNMENT_UWORD 65535 Compu_IDENTITY 0 65535 PHYS_UNIT "System ID + DTC" /end CHARACTERISTIC
/begin CHARACTERISTIC FCdc4_CVP1_lo "FCtl_DTC_0x04(795)" VALUE 0x00164206 /* @ECU_Address@FCtl_DTC_0x04@0x024C4636@ */ ECIPP_ALIGNMENT_UWORD 65535 Compu_IDENTITY 0 65535 PHYS_UNIT "System ID + DTC" /end CHARACTERISTIC
/begin CHARACTERISTIC FCdc4_CVP2_hi "FCtl_DTC_0x04(796)" VALUE 0x00164208 /* @ECU_Address@FCtl_DTC_0x04@0x024C4638@ */ ECIPP_ALIGNMENT_UWORD 65535 Compu_IDENTITY 0 65535 PHYS_UNIT "System ID + DTC" /end CHARACTERISTIC
/begin CHARACTERISTIC FCdc4_CVP2_lo "FCtl_DTC_0x04(797)" VALUE 0x0016420A /* @ECU_Address@FCtl_DTC_0x04@0x024C463A@ */ ECIPP_ALIGNMENT_UWORD 65535 Compu_IDENTITY 0 65535 PHYS_UNIT "System ID + DTC" /end CHARACTERISTIC
/begin CHARACTERISTIC FCdc4_DBW_I_max "FCtl_DTC_0x04(527)" VALUE 0x00163FEE /* @ECU_Address@FCtl_DTC_0x04@0x024C441E@ */ ECIPP_ALIGNMENT_UWORD 65535 Compu_IDENTITY 0 65535 PHYS_UNIT "System ID + DTC" /end CHARACTERISTIC
/begin CHARACTERISTIC FCdc4_ECam_maxerr "FCtl_DTC_0x04(289)" VALUE 0x00163E12 /* @ECU_Address@FCtl_DTC_0x04@0x024C4242@ */ ECIPP_ALIGNMENT_UWORD 65535 Compu_IDENTITY 0 65535 PHYS_UNIT "System ID + DTC" /end CHARACTERISTIC
/begin CHARACTERISTIC FCdc4_ECL_low "FCtl_DTC_0x04(733)" VALUE 0x0016418A /* @ECU_Address@FCtl_DTC_0x04@0x024C45BA@ */ ECIPP_ALIGNMENT_UWORD 65535 Compu_IDENTITY 0 65535 PHYS_UNIT "System ID + DTC" /end CHARACTERISTIC
/begin CHARACTERISTIC FCdc4_ECT_AAT_dT_max "FCtl_DTC_0x04(842)" VALUE 0x00164264 /* @ECU_Address@FCtl_DTC_0x04@0x024C4694@ */ ECIPP_ALIGNMENT_UWORD 65535 Compu_IDENTITY 0 65535 PHYS_UNIT "System ID + DTC" /end CHARACTERISTIC
/begin CHARACTERISTIC FCdc4_ECT_derate_actv "FCtl_DTC_0x04(828)" VALUE 0x00164248 /* @ECU_Address@FCtl_DTC_0x04@0x024C4678@ */ ECIPP_ALIGNMENT_UWORD 65535 Compu_IDENTITY 0 65535 PHYS_UNIT "System ID + DTC" /end CHARACTERISTIC
/begin CHARACTERISTIC FCdc4_ECT_dT_max "FCtl_DTC_0x04(850)" VALUE 0x00164274 /* @ECU_Address@FCtl_DTC_0x04@0x024C46A4@ */ ECIPP_ALIGNMENT_UWORD 65535 Compu_IDENTITY 0 65535 PHYS_UNIT "System ID + DTC" /end CHARACTERISTIC
/begin CHARACTERISTIC FCdc4_ECT_EGRT_dT_max "FCtl_DTC_0x04(843)" VALUE 0x00164266 /* @ECU_Address@FCtl_DTC_0x04@0x024C4696@ */ ECIPP_ALIGNMENT_UWORD 65535 Compu_IDENTITY 0 65535 PHYS_UNIT "System ID + DTC" /end CHARACTERISTIC
/begin CHARACTERISTIC FCdc4_ECT_EGT_dT_max "FCtl_DTC_0x04(846)" VALUE 0x0016426C /* @ECU_Address@FCtl_DTC_0x04@0x024C469C@ */ ECIPP_ALIGNMENT_UWORD 65535 Compu_IDENTITY 0 65535 PHYS_UNIT "System ID + DTC" /end CHARACTERISTIC
/begin CHARACTERISTIC FCdc4_ECT_FT_dT_max "FCtl_DTC_0x04(844)" VALUE 0x00164268 /* @ECU_Address@FCtl_DTC_0x04@0x024C4698@ */ ECIPP_ALIGNMENT_UWORD 65535 Compu_IDENTITY 0 65535 PHYS_UNIT "System ID + DTC" /end CHARACTERISTIC
/begin CHARACTERISTIC FCdc4_ECT_HiExp "FCtl_DTC_0x04(4)" VALUE 0x00163BD8 /* @ECU_Address@FCtl_DTC_0x04@0x024C4008@ */ ECIPP_ALIGNMENT_UWORD 65535 Compu_IDENTITY 0 65535 PHYS_UNIT "System ID + DTC" /end CHARACTERISTIC
/begin CHARACTERISTIC FCdc4_ECT_HiExp2 "FCtl_DTC_0x04(86)" VALUE 0x00163C7C /* @ECU_Address@FCtl_DTC_0x04@0x024C40AC@ */ ECIPP_ALIGNMENT_UWORD 65535 Compu_IDENTITY 0 65535 PHYS_UNIT "System ID + DTC" /end CHARACTERISTIC
/begin CHARACTERISTIC FCdc4_ECT_IAT_dT_max "FCtl_DTC_0x04(841)" VALUE 0x00164262 /* @ECU_Address@FCtl_DTC_0x04@0x024C4692@ */ ECIPP_ALIGNMENT_UWORD 65535 Compu_IDENTITY 0 65535 PHYS_UNIT "System ID + DTC" /end CHARACTERISTIC
/begin CHARACTERISTIC FCdc4_ECT_LoExp "FCtl_DTC_0x04(648)" VALUE 0x001640E0 /* @ECU_Address@FCtl_DTC_0x04@0x024C4510@ */ ECIPP_ALIGNMENT_UWORD 65535 Compu_IDENTITY 0 65535 PHYS_UNIT "System ID + DTC" /end CHARACTERISTIC
/begin CHARACTERISTIC FCdc4_ECT_LoExp2 "FCtl_DTC_0x04(649)" VALUE 0x001640E2 /* @ECU_Address@FCtl_DTC_0x04@0x024C4512@ */ ECIPP_ALIGNMENT_UWORD 65535 Compu_IDENTITY 0 65535 PHYS_UNIT "System ID + DTC" /end CHARACTERISTIC
/begin CHARACTERISTIC FCdc4_ECT_maxv "FCtl_DTC_0x04(2)" VALUE 0x00163BD4 /* @ECU_Address@FCtl_DTC_0x04@0x024C4004@ */ ECIPP_ALIGNMENT_UWORD 65535 Compu_IDENTITY 0 65535 PHYS_UNIT "System ID + DTC" /end CHARACTERISTIC
/begin CHARACTERISTIC FCdc4_ECT_minv "FCtl_DTC_0x04(3)" VALUE 0x00163BD6 /* @ECU_Address@FCtl_DTC_0x04@0x024C4006@ */ ECIPP_ALIGNMENT_UWORD 65535 Compu_IDENTITY 0 65535 PHYS_UNIT "System ID + DTC" /end CHARACTERISTIC
/begin CHARACTERISTIC FCdc4_ECT_OILT_dT_max "FCtl_DTC_0x04(845)" VALUE 0x0016426A /* @ECU_Address@FCtl_DTC_0x04@0x024C469A@ */ ECIPP_ALIGNMENT_UWORD 65535 Compu_IDENTITY 0 65535 PHYS_UNIT "System ID + DTC" /end CHARACTERISTIC
/begin CHARACTERISTIC FCdc4_ECT_TAUX_dT1_max "FCtl_DTC_0x04(848)" VALUE 0x00164270 /* @ECU_Address@FCtl_DTC_0x04@0x024C46A0@ */ ECIPP_ALIGNMENT_UWORD 65535 Compu_IDENTITY 0 65535 PHYS_UNIT "System ID + DTC" /end CHARACTERISTIC
/begin CHARACTERISTIC FCdc4_ECT_TAUX_dT2_max "FCtl_DTC_0x04(849)" VALUE 0x00164272 /* @ECU_Address@FCtl_DTC_0x04@0x024C46A2@ */ ECIPP_ALIGNMENT_UWORD 65535 Compu_IDENTITY 0 65535 PHYS_UNIT "System ID + DTC" /end CHARACTERISTIC
/begin CHARACTERISTIC FCdc4_ECT_TIAT_dT_max "FCtl_DTC_0x04(847)" VALUE 0x0016426E /* @ECU_Address@FCtl_DTC_0x04@0x024C469E@ */ ECIPP_ALIGNMENT_UWORD 65535 Compu_IDENTITY 0 65535 PHYS_UNIT "System ID + DTC" /end CHARACTERISTIC
/begin CHARACTERISTIC FCdc4_EGO1_open "FCtl_DTC_0x04(111)" VALUE 0x00163CAE /* @ECU_Address@FCtl_DTC_0x04@0x024C40DE@ */ ECIPP_ALIGNMENT_UWORD 65535 Compu_IDENTITY 0 65535 PHYS_UNIT "System ID + DTC" /end CHARACTERISTIC
/begin CHARACTERISTIC FCdc4_EGO2_open "FCtl_DTC_0x04(112)" VALUE 0x00163CB0 /* @ECU_Address@FCtl_DTC_0x04@0x024C40E0@ */ ECIPP_ALIGNMENT_UWORD 65535 Compu_IDENTITY 0 65535 PHYS_UNIT "System ID + DTC" /end CHARACTERISTIC
/begin CHARACTERISTIC FCdc4_EGO3_open "FCtl_DTC_0x04(113)" VALUE 0x00163CB2 /* @ECU_Address@FCtl_DTC_0x04@0x024C40E2@ */ ECIPP_ALIGNMENT_UWORD 65535 Compu_IDENTITY 0 65535 PHYS_UNIT "System ID + DTC" /end CHARACTERISTIC
/begin CHARACTERISTIC FCdc4_EGOH1_off_open "FCtl_DTC_0x04(321)" VALUE 0x00163E52 /* @ECU_Address@FCtl_DTC_0x04@0x024C4282@ */ ECIPP_ALIGNMENT_UWORD 65535 Compu_IDENTITY 0 65535 PHYS_UNIT "System ID + DTC" /end CHARACTERISTIC
/begin CHARACTERISTIC FCdc4_EGOH1_on_short "FCtl_DTC_0x04(322)" VALUE 0x00163E54 /* @ECU_Address@FCtl_DTC_0x04@0x024C4284@ */ ECIPP_ALIGNMENT_UWORD 65535 Compu_IDENTITY 0 65535 PHYS_UNIT "System ID + DTC" /end CHARACTERISTIC
/begin CHARACTERISTIC FCdc4_EGOH2_off_open "FCtl_DTC_0x04(323)" VALUE 0x00163E56 /* @ECU_Address@FCtl_DTC_0x04@0x024C4286@ */ ECIPP_ALIGNMENT_UWORD 65535 Compu_IDENTITY 0 65535 PHYS_UNIT "System ID + DTC" /end CHARACTERISTIC
/begin CHARACTERISTIC FCdc4_EGOH2_on_short "FCtl_DTC_0x04(324)" VALUE 0x00163E58 /* @ECU_Address@FCtl_DTC_0x04@0x024C4288@ */ ECIPP_ALIGNMENT_UWORD 65535 Compu_IDENTITY 0 65535 PHYS_UNIT "System ID + DTC" /end CHARACTERISTIC
/begin CHARACTERISTIC FCdc4_EGOH3_off_open "FCtl_DTC_0x04(325)" VALUE 0x00163E5A /* @ECU_Address@FCtl_DTC_0x04@0x024C428A@ */ ECIPP_ALIGNMENT_UWORD 65535 Compu_IDENTITY 0 65535 PHYS_UNIT "System ID + DTC" /end CHARACTERISTIC
/begin CHARACTERISTIC FCdc4_EGOH3_on_short "FCtl_DTC_0x04(326)" VALUE 0x00163E5C /* @ECU_Address@FCtl_DTC_0x04@0x024C428C@ */ ECIPP_ALIGNMENT_UWORD 65535 Compu_IDENTITY 0 65535 PHYS_UNIT "System ID + DTC" /end CHARACTERISTIC
/begin CHARACTERISTIC FCdc4_EGOH4_off_open "FCtl_DTC_0x04(327)" VALUE 0x00163E5E /* @ECU_Address@FCtl_DTC_0x04@0x024C428E@ */ ECIPP_ALIGNMENT_UWORD 65535 Compu_IDENTITY 0 65535 PHYS_UNIT "System ID + DTC" /end CHARACTERISTIC
/begin CHARACTERISTIC FCdc4_EGOH4_on_short "FCtl_DTC_0x04(328)" VALUE 0x00163E60 /* @ECU_Address@FCtl_DTC_0x04@0x024C4290@ */ ECIPP_ALIGNMENT_UWORD 65535 Compu_IDENTITY 0 65535 PHYS_UNIT "System ID + DTC" /end CHARACTERISTIC
/begin CHARACTERISTIC FCdc4_EGR_clr_eta_lo "FCtl_DTC_0x04(666)" VALUE 0x00164104 /* @ECU_Address@FCtl_DTC_0x04@0x024C4534@ */ ECIPP_ALIGNMENT_UWORD 65535 Compu_IDENTITY 0 65535 PHYS_UNIT "System ID + DTC" /end CHARACTERISTIC
/begin CHARACTERISTIC FCdc4_EGR_clr_eta_lo2 "FCtl_DTC_0x04(685)" VALUE 0x0016412A /* @ECU_Address@FCtl_DTC_0x04@0x024C455A@ */ ECIPP_ALIGNMENT_UWORD 65535 Compu_IDENTITY 0 65535 PHYS_UNIT "System ID + DTC" /end CHARACTERISTIC
/begin CHARACTERISTIC FCdc4_EGR_deice_excess "FCtl_DTC_0x04(829)" VALUE 0x0016424A /* @ECU_Address@FCtl_DTC_0x04@0x024C467A@ */ ECIPP_ALIGNMENT_UWORD 65535 Compu_IDENTITY 0 65535 PHYS_UNIT "System ID + DTC" /end CHARACTERISTIC
/begin CHARACTERISTIC FCdc4_EGR_offmin_excess "FCtl_DTC_0x04(665)" VALUE 0x00164102 /* @ECU_Address@FCtl_DTC_0x04@0x024C4532@ */ ECIPP_ALIGNMENT_UWORD 65535 Compu_IDENTITY 0 65535 PHYS_UNIT "System ID + DTC" /end CHARACTERISTIC
/begin CHARACTERISTIC FCdc4_EGR_OOA_hi "FCtl_DTC_0x04(661)" VALUE 0x001640FA /* @ECU_Address@FCtl_DTC_0x04@0x024C452A@ */ ECIPP_ALIGNMENT_UWORD 65535 Compu_IDENTITY 0 65535 PHYS_UNIT "System ID + DTC" /end CHARACTERISTIC
/begin CHARACTERISTIC FCdc4_EGR_OOA_lo "FCtl_DTC_0x04(662)" VALUE 0x001640FC /* @ECU_Address@FCtl_DTC_0x04@0x024C452C@ */ ECIPP_ALIGNMENT_UWORD 65535 Compu_IDENTITY 0 65535 PHYS_UNIT "System ID + DTC" /end CHARACTERISTIC
/begin CHARACTERISTIC FPnd_CATout_OOR "FPrm_pending(658)" VALUE 0x00164E90 /* @ECU_Address@FPrm_pending@0x021BE524@ */ ECIPP_ALIGNMENT_UWORD 65535 Compu_IDENTITY 0 65535 PHYS_UNIT "Bit Mask" /end CHARACTERISTIC
/begin CHARACTERISTIC FPnd_CFV_FP_minv "FPrm_pending(517)" VALUE 0x00164D76 /* @ECU_Address@FPrm_pending@0x021BE40A@ */ ECIPP_ALIGNMENT_UWORD 65535 Compu_IDENTITY 0 65535 PHYS_UNIT "Bit Mask" /end CHARACTERISTIC
/begin CHARACTERISTIC FPnd_CFV_FT_maxv "FPrm_pending(518)" VALUE 0x00164D78 /* @ECU_Address@FPrm_pending@0x021BE40C@ */ ECIPP_ALIGNMENT_UWORD 65535 Compu_IDENTITY 0 65535 PHYS_UNIT "Bit Mask" /end CHARACTERISTIC
/begin CHARACTERISTIC FPnd_CFV_FT_minv "FPrm_pending(519)" VALUE 0x00164D7A /* @ECU_Address@FPrm_pending@0x021BE40E@ */ ECIPP_ALIGNMENT_UWORD 65535 Compu_IDENTITY 0 65535 PHYS_UNIT "Bit Mask" /end CHARACTERISTIC
/begin CHARACTERISTIC FPnd_CFV_mdot_hi "FPrm_pending(393)" VALUE 0x00164C7E /* @ECU_Address@FPrm_pending@0x021BE312@ */ ECIPP_ALIGNMENT_UWORD 65535 Compu_IDENTITY 0 65535 PHYS_UNIT "Bit Mask" /end CHARACTERISTIC
/begin CHARACTERISTIC FPnd_CFV_mdot_lo "FPrm_pending(394)" VALUE 0x00164C80 /* @ECU_Address@FPrm_pending@0x021BE314@ */ ECIPP_ALIGNMENT_UWORD 65535 Compu_IDENTITY 0 65535 PHYS_UNIT "Bit Mask" /end CHARACTERISTIC
/begin CHARACTERISTIC FPnd_CFV_mdot_rms_hi "FPrm_pending(509)" VALUE 0x00164D66 /* @ECU_Address@FPrm_pending@0x021BE3FA@ */ ECIPP_ALIGNMENT_UWORD 65535 Compu_IDENTITY 0 65535 PHYS_UNIT "Bit Mask" /end CHARACTERISTIC
/begin CHARACTERISTIC FPnd_CFV_pwr_loss "FPrm_pending(657)" VALUE 0x00164E8E /* @ECU_Address@FPrm_pending@0x021BE522@ */ ECIPP_ALIGNMENT_UWORD 65535 Compu_IDENTITY 0 65535 PHYS_UNIT "Bit Mask" /end CHARACTERISTIC
/begin CHARACTERISTIC FPnd_CFV_RLV_fail "FPrm_pending(405)" VALUE 0x00164C96 /* @ECU_Address@FPrm_pending@0x021BE32A@ */ ECIPP_ALIGNMENT_UWORD 65535 Compu_IDENTITY 0 65535 PHYS_UNIT "Bit Mask" /end CHARACTERISTIC
/begin CHARACTERISTIC FPnd_CFV_RLV_P_min "FPrm_pending(404)" VALUE 0x00164C94 /* @ECU_Address@FPrm_pending@0x021BE328@ */ ECIPP_ALIGNMENT_UWORD 65535 Compu_IDENTITY 0 65535 PHYS_UNIT "Bit Mask" /end CHARACTERISTIC
/begin CHARACTERISTIC FPnd_CHT_HiExp "FPrm_pending(73)" VALUE 0x001649FE /* @ECU_Address@FPrm_pending@0x021BE092@ */ ECIPP_ALIGNMENT_UWORD 65535 Compu_IDENTITY 0 65535 PHYS_UNIT "Bit Mask" /end CHARACTERISTIC
/begin CHARACTERISTIC FPnd_CHT_HiExp2 "FPrm_pending(74)" VALUE 0x00164A00 /* @ECU_Address@FPrm_pending@0x021BE094@ */ ECIPP_ALIGNMENT_UWORD 65535 Compu_IDENTITY 0 65535 PHYS_UNIT "Bit Mask" /end CHARACTERISTIC
/begin CHARACTERISTIC FPnd_CL_hi "FPrm_pending(47)" VALUE 0x001649CA /* @ECU_Address@FPrm_pending@0x021BE05E@ */ ECIPP_ALIGNMENT_UWORD 65535 Compu_IDENTITY 0 65535 PHYS_UNIT "Bit Mask" /end CHARACTERISTIC
/begin CHARACTERISTIC FPnd_CL_lo "FPrm_pending(48)" VALUE 0x001649CC /* @ECU_Address@FPrm_pending@0x021BE060@ */ ECIPP_ALIGNMENT_UWORD 65535 Compu_IDENTITY 0 65535 PHYS_UNIT "Bit Mask" /end CHARACTERISTIC
/begin CHARACTERISTIC FPnd_CL_phi_hi "FPrm_pending(507)" VALUE 0x00164D62 /* @ECU_Address@FPrm_pending@0x021BE3F6@ */ ECIPP_ALIGNMENT_UWORD 65535 Compu_IDENTITY 0 65535 PHYS_UNIT "Bit Mask" /end CHARACTERISTIC
/begin CHARACTERISTIC FPnd_CL_phi_lo "FPrm_pending(508)" VALUE 0x00164D64 /* @ECU_Address@FPrm_pending@0x021BE3F8@ */ ECIPP_ALIGNMENT_UWORD 65535 Compu_IDENTITY 0 65535 PHYS_UNIT "Bit Mask" /end CHARACTERISTIC
/begin CHARACTERISTIC FPnd_CLLP_hi "FPrm_pending(49)" VALUE 0x001649CE /* @ECU_Address@FPrm_pending@0x021BE062@ */ ECIPP_ALIGNMENT_UWORD 65535 Compu_IDENTITY 0 65535 PHYS_UNIT "Bit Mask" /end CHARACTERISTIC
/begin CHARACTERISTIC FPnd_CLLP_lo "FPrm_pending(50)" VALUE 0x001649D0 /* @ECU_Address@FPrm_pending@0x021BE064@ */ ECIPP_ALIGNMENT_UWORD 65535 Compu_IDENTITY 0 65535 PHYS_UNIT "Bit Mask" /end CHARACTERISTIC
/begin CHARACTERISTIC FPnd_CLNG_hi "FPrm_pending(51)" VALUE 0x001649D2 /* @ECU_Address@FPrm_pending@0x021BE066@ */ ECIPP_ALIGNMENT_UWORD 65535 Compu_IDENTITY 0 65535 PHYS_UNIT "Bit Mask" /end CHARACTERISTIC
/begin CHARACTERISTIC FPnd_CLNG_lo "FPrm_pending(52)" VALUE 0x001649D4 /* @ECU_Address@FPrm_pending@0x021BE068@ */ ECIPP_ALIGNMENT_UWORD 65535 Compu_IDENTITY 0 65535 PHYS_UNIT "Bit Mask" /end CHARACTERISTIC
/begin CHARACTERISTIC FPnd_CM_unresp "FPrm_pending(629)" VALUE 0x00164E56 /* @ECU_Address@FPrm_pending@0x021BE4EA@ */ ECIPP_ALIGNMENT_UWORD 65535 Compu_IDENTITY 0 65535 PHYS_UNIT "Bit Mask" /end CHARACTERISTIC
/begin CHARACTERISTIC FPnd_CMgsln_inact "FPrm_pending(89)" VALUE 0x00164A1E /* @ECU_Address@FPrm_pending@0x021BE0B2@ */ ECIPP_ALIGNMENT_UWORD 65535 Compu_IDENTITY 0 65535 PHYS_UNIT "Bit Mask" /end CHARACTERISTIC
/begin CHARACTERISTIC FPnd_CMLP_inact "FPrm_pending(90)" VALUE 0x00164A20 /* @ECU_Address@FPrm_pending@0x021BE0B4@ */ ECIPP_ALIGNMENT_UWORD 65535 Compu_IDENTITY 0 65535 PHYS_UNIT "Bit Mask" /end CHARACTERISTIC
/begin CHARACTERISTIC FPnd_CMNG_inact "FPrm_pending(91)" VALUE 0x00164A22 /* @ECU_Address@FPrm_pending@0x021BE0B6@ */ ECIPP_ALIGNMENT_UWORD 65535 Compu_IDENTITY 0 65535 PHYS_UNIT "Bit Mask" /end CHARACTERISTIC
/begin CHARACTERISTIC FPnd_COPfail "FPrm_pending(63)" VALUE 0x001649EA /* @ECU_Address@FPrm_pending@0x021BE07E@ */ ECIPP_ALIGNMENT_UWORD 65535 Compu_IDENTITY 0 65535 PHYS_UNIT "Bit Mask" /end CHARACTERISTIC
/begin CHARACTERISTIC FPnd_COT_hi "FPrm_pending(487)" VALUE 0x00164D3A /* @ECU_Address@FPrm_pending@0x021BE3CE@ */ ECIPP_ALIGNMENT_UWORD 65535 Compu_IDENTITY 0 65535 PHYS_UNIT "Bit Mask" /end CHARACTERISTIC
/begin CHARACTERISTIC FPnd_crkloss "FPrm_pending(112)" VALUE 0x00164A4C /* @ECU_Address@FPrm_pending@0x021BE0E0@ */ ECIPP_ALIGNMENT_UWORD 65535 Compu_IDENTITY 0 65535 PHYS_UNIT "Bit Mask" /end CHARACTERISTIC
/begin CHARACTERISTIC FPnd_crknever "FPrm_pending(62)" VALUE 0x001649E8 /* @ECU_Address@FPrm_pending@0x021BE07C@ */ ECIPP_ALIGNMENT_UWORD 65535 Compu_IDENTITY 0 65535 PHYS_UNIT "Bit Mask" /end CHARACTERISTIC
/begin CHARACTERISTIC FPnd_crknoise "FPrm_pending(61)" VALUE 0x001649E6 /* @ECU_Address@FPrm_pending@0x021BE07A@ */ ECIPP_ALIGNMENT_UWORD 65535 Compu_IDENTITY 0 65535 PHYS_UNIT "Bit Mask" /end CHARACTERISTIC
/begin CHARACTERISTIC FPnd_CVCS_discon "FPrm_pending(577)" VALUE 0x00164DEE /* @ECU_Address@FPrm_pending@0x021BE482@ */ ECIPP_ALIGNMENT_UWORD 65535 Compu_IDENTITY 0 65535 PHYS_UNIT "Bit Mask" /end CHARACTERISTIC
/begin CHARACTERISTIC FPnd_CVDS_discon "FPrm_pending(578)" VALUE 0x00164DF0 /* @ECU_Address@FPrm_pending@0x021BE484@ */ ECIPP_ALIGNMENT_UWORD 65535 Compu_IDENTITY 0 65535 PHYS_UNIT "Bit Mask" /end CHARACTERISTIC
/begin CHARACTERISTIC FPnd_CVP1_hi "FPrm_pending(624)" VALUE 0x00164E4C /* @ECU_Address@FPrm_pending@0x021BE4E0@ */ ECIPP_ALIGNMENT_UWORD 65535 Compu_IDENTITY 0 65535 PHYS_UNIT "Bit Mask" /end CHARACTERISTIC
/begin CHARACTERISTIC FPnd_CVP1_lo "FPrm_pending(625)" VALUE 0x00164E4E /* @ECU_Address@FPrm_pending@0x021BE4E2@ */ ECIPP_ALIGNMENT_UWORD 65535 Compu_IDENTITY 0 65535 PHYS_UNIT "Bit Mask" /end CHARACTERISTIC
/begin CHARACTERISTIC FPnd_CVP2_hi "FPrm_pending(626)" VALUE 0x00164E50 /* @ECU_Address@FPrm_pending@0x021BE4E4@ */ ECIPP_ALIGNMENT_UWORD 65535 Compu_IDENTITY 0 65535 PHYS_UNIT "Bit Mask" /end CHARACTERISTIC
/begin CHARACTERISTIC FPnd_CVP2_lo "FPrm_pending(627)" VALUE 0x00164E52 /* @ECU_Address@FPrm_pending@0x021BE4E6@ */ ECIPP_ALIGNMENT_UWORD 65535 Compu_IDENTITY 0 65535 PHYS_UNIT "Bit Mask" /end CHARACTERISTIC
/begin CHARACTERISTIC FPnd_DBW_I_max "FPrm_pending(397)" VALUE 0x00164C86 /* @ECU_Address@FPrm_pending@0x021BE31A@ */ ECIPP_ALIGNMENT_UWORD 65535 Compu_IDENTITY 0 65535 PHYS_UNIT "Bit Mask" /end CHARACTERISTIC
/begin CHARACTERISTIC FPnd_ECam_maxerr "FPrm_pending(211)" VALUE 0x00164B12 /* @ECU_Address@FPrm_pending@0x021BE1A6@ */ ECIPP_ALIGNMENT_UWORD 65535 Compu_IDENTITY 0 65535 PHYS_UNIT "Bit Mask" /end CHARACTERISTIC
/begin CHARACTERISTIC FPnd_ECL_low "FPrm_pending(563)" VALUE 0x00164DD2 /* @ECU_Address@FPrm_pending@0x021BE466@ */ ECIPP_ALIGNMENT_UWORD 65535 Compu_IDENTITY 0 65535 PHYS_UNIT "Bit Mask" /end CHARACTERISTIC
/begin CHARACTERISTIC FPnd_ECT_AAT_dT_max "FPrm_pending(669)" VALUE 0x00164EA6 /* @ECU_Address@FPrm_pending@0x021BE53A@ */ ECIPP_ALIGNMENT_UWORD 65535 Compu_IDENTITY 0 65535 PHYS_UNIT "Bit Mask" /end CHARACTERISTIC
/begin CHARACTERISTIC FPnd_ECT_derate_actv "FPrm_pending(655)" VALUE 0x00164E8A /* @ECU_Address@FPrm_pending@0x021BE51E@ */ ECIPP_ALIGNMENT_UWORD 65535 Compu_IDENTITY 0 65535 PHYS_UNIT "Bit Mask" /end CHARACTERISTIC
/begin CHARACTERISTIC FPnd_ECT_dT_max "FPrm_pending(677)" VALUE 0x00164EB6 /* @ECU_Address@FPrm_pending@0x021BE54A@ */ ECIPP_ALIGNMENT_UWORD 65535 Compu_IDENTITY 0 65535 PHYS_UNIT "Bit Mask" /end CHARACTERISTIC
/begin CHARACTERISTIC FPnd_ECT_EGRT_dT_max "FPrm_pending(670)" VALUE 0x00164EA8 /* @ECU_Address@FPrm_pending@0x021BE53C@ */ ECIPP_ALIGNMENT_UWORD 65535 Compu_IDENTITY 0 65535 PHYS_UNIT "Bit Mask" /end CHARACTERISTIC
/begin CHARACTERISTIC FPnd_ECT_EGT_dT_max "FPrm_pending(673)" VALUE 0x00164EAE /* @ECU_Address@FPrm_pending@0x021BE542@ */ ECIPP_ALIGNMENT_UWORD 65535 Compu_IDENTITY 0 65535 PHYS_UNIT "Bit Mask" /end CHARACTERISTIC
/begin CHARACTERISTIC FPnd_ECT_FT_dT_max "FPrm_pending(671)" VALUE 0x00164EAA /* @ECU_Address@FPrm_pending@0x021BE53E@ */ ECIPP_ALIGNMENT_UWORD 65535 Compu_IDENTITY 0 65535 PHYS_UNIT "Bit Mask" /end CHARACTERISTIC
/begin CHARACTERISTIC FPnd_ECT_HiExp "FPrm_pending(4)" VALUE 0x00164974 /* @ECU_Address@FPrm_pending@0x021BE008@ */ ECIPP_ALIGNMENT_UWORD 65535 Compu_IDENTITY 0 65535 PHYS_UNIT "Bit Mask" /end CHARACTERISTIC
/begin CHARACTERISTIC FPnd_ECT_HiExp2 "FPrm_pending(5)" VALUE 0x00164976 /* @ECU_Address@FPrm_pending@0x021BE00A@ */ ECIPP_ALIGNMENT_UWORD 65535 Compu_IDENTITY 0 65535 PHYS_UNIT "Bit Mask" /end CHARACTERISTIC
/begin CHARACTERISTIC FPnd_ECT_IAT_dT_max "FPrm_pending(668)" VALUE 0x00164EA4 /* @ECU_Address@FPrm_pending@0x021BE538@ */ ECIPP_ALIGNMENT_UWORD 65535 Compu_IDENTITY 0 65535 PHYS_UNIT "Bit Mask" /end CHARACTERISTIC
/begin CHARACTERISTIC FPnd_ECT_LoExp "FPrm_pending(478)" VALUE 0x00164D28 /* @ECU_Address@FPrm_pending@0x021BE3BC@ */ ECIPP_ALIGNMENT_UWORD 65535 Compu_IDENTITY 0 65535 PHYS_UNIT "Bit Mask" /end CHARACTERISTIC
/begin CHARACTERISTIC FPnd_ECT_LoExp2 "FPrm_pending(479)" VALUE 0x00164D2A /* @ECU_Address@FPrm_pending@0x021BE3BE@ */ ECIPP_ALIGNMENT_UWORD 65535 Compu_IDENTITY 0 65535 PHYS_UNIT "Bit Mask" /end CHARACTERISTIC
/begin CHARACTERISTIC FPnd_ECT_maxv "FPrm_pending(2)" VALUE 0x00164970 /* @ECU_Address@FPrm_pending@0x021BE004@ */ ECIPP_ALIGNMENT_UWORD 65535 Compu_IDENTITY 0 65535 PHYS_UNIT "Bit Mask" /end CHARACTERISTIC
/begin CHARACTERISTIC FPnd_ECT_minv "FPrm_pending(3)" VALUE 0x00164972 /* @ECU_Address@FPrm_pending@0x021BE006@ */ ECIPP_ALIGNMENT_UWORD 65535 Compu_IDENTITY 0 65535 PHYS_UNIT "Bit Mask" /end CHARACTERISTIC
/begin CHARACTERISTIC FPnd_ECT_OILT_dT_max "FPrm_pending(672)" VALUE 0x00164EAC /* @ECU_Address@FPrm_pending@0x021BE540@ */ ECIPP_ALIGNMENT_UWORD 65535 Compu_IDENTITY 0 65535 PHYS_UNIT "Bit Mask" /end CHARACTERISTIC
/begin CHARACTERISTIC FPnd_ECT_TAUX_dT1_max "FPrm_pending(675)" VALUE 0x00164EB2 /* @ECU_Address@FPrm_pending@0x021BE546@ */ ECIPP_ALIGNMENT_UWORD 65535 Compu_IDENTITY 0 65535 PHYS_UNIT "Bit Mask" /end CHARACTERISTIC
/begin CHARACTERISTIC FPnd_ECT_TAUX_dT2_max "FPrm_pending(676)" VALUE 0x00164EB4 /* @ECU_Address@FPrm_pending@0x021BE548@ */ ECIPP_ALIGNMENT_UWORD 65535 Compu_IDENTITY 0 65535 PHYS_UNIT "Bit Mask" /end CHARACTERISTIC
/begin CHARACTERISTIC FPnd_ECT_TIAT_dT_max "FPrm_pending(674)" VALUE 0x00164EB0 /* @ECU_Address@FPrm_pending@0x021BE544@ */ ECIPP_ALIGNMENT_UWORD 65535 Compu_IDENTITY 0 65535 PHYS_UNIT "Bit Mask" /end CHARACTERISTIC
/begin CHARACTERISTIC FPnd_EGO1_open "FPrm_pending(71)" VALUE 0x001649FA /* @ECU_Address@FPrm_pending@0x021BE08E@ */ ECIPP_ALIGNMENT_UWORD 65535 Compu_IDENTITY 0 65535 PHYS_UNIT "Bit Mask" /end CHARACTERISTIC
/begin CHARACTERISTIC FPnd_EGO2_open "FPrm_pending(100)" VALUE 0x00164A34 /* @ECU_Address@FPrm_pending@0x021BE0C8@ */ ECIPP_ALIGNMENT_UWORD 65535 Compu_IDENTITY 0 65535 PHYS_UNIT "Bit Mask" /end CHARACTERISTIC
/begin CHARACTERISTIC FPnd_EGO3_open "FPrm_pending(72)" VALUE 0x001649FC /* @ECU_Address@FPrm_pending@0x021BE090@ */ ECIPP_ALIGNMENT_UWORD 65535 Compu_IDENTITY 0 65535 PHYS_UNIT "Bit Mask" /end CHARACTERISTIC
/begin CHARACTERISTIC FPnd_EGOH1_off_open "FPrm_pending(230)" VALUE 0x00164B38 /* @ECU_Address@FPrm_pending@0x021BE1CC@ */ ECIPP_ALIGNMENT_UWORD 65535 Compu_IDENTITY 0 65535 PHYS_UNIT "Bit Mask" /end CHARACTERISTIC
/begin CHARACTERISTIC FPnd_EGOH1_on_short "FPrm_pending(231)" VALUE 0x00164B3A /* @ECU_Address@FPrm_pending@0x021BE1CE@ */ ECIPP_ALIGNMENT_UWORD 65535 Compu_IDENTITY 0 65535 PHYS_UNIT "Bit Mask" /end CHARACTERISTIC
/begin CHARACTERISTIC FPnd_EGOH2_off_open "FPrm_pending(232)" VALUE 0x00164B3C /* @ECU_Address@FPrm_pending@0x021BE1D0@ */ ECIPP_ALIGNMENT_UWORD 65535 Compu_IDENTITY 0 65535 PHYS_UNIT "Bit Mask" /end CHARACTERISTIC
/begin CHARACTERISTIC FPnd_EGOH2_on_short "FPrm_pending(233)" VALUE 0x00164B3E /* @ECU_Address@FPrm_pending@0x021BE1D2@ */ ECIPP_ALIGNMENT_UWORD 65535 Compu_IDENTITY 0 65535 PHYS_UNIT "Bit Mask" /end CHARACTERISTIC
/begin CHARACTERISTIC FPnd_EGOH3_off_open "FPrm_pending(234)" VALUE 0x00164B40 /* @ECU_Address@FPrm_pending@0x021BE1D4@ */ ECIPP_ALIGNMENT_UWORD 65535 Compu_IDENTITY 0 65535 PHYS_UNIT "Bit Mask" /end CHARACTERISTIC
/begin CHARACTERISTIC FPnd_EGOH3_on_short "FPrm_pending(235)" VALUE 0x00164B42 /* @ECU_Address@FPrm_pending@0x021BE1D6@ */ ECIPP_ALIGNMENT_UWORD 65535 Compu_IDENTITY 0 65535 PHYS_UNIT "Bit Mask" /end CHARACTERISTIC
/begin CHARACTERISTIC FPnd_EGOH4_off_open "FPrm_pending(236)" VALUE 0x00164B44 /* @ECU_Address@FPrm_pending@0x021BE1D8@ */ ECIPP_ALIGNMENT_UWORD 65535 Compu_IDENTITY 0 65535 PHYS_UNIT "Bit Mask" /end CHARACTERISTIC
/begin CHARACTERISTIC FPnd_EGOH4_on_short "FPrm_pending(237)" VALUE 0x00164B46 /* @ECU_Address@FPrm_pending@0x021BE1DA@ */ ECIPP_ALIGNMENT_UWORD 65535 Compu_IDENTITY 0 65535 PHYS_UNIT "Bit Mask" /end CHARACTERISTIC
/begin CHARACTERISTIC FPnd_EGR_clr_eta_lo "FPrm_pending(496)" VALUE 0x00164D4C /* @ECU_Address@FPrm_pending@0x021BE3E0@ */ ECIPP_ALIGNMENT_UWORD 65535 Compu_IDENTITY 0 65535 PHYS_UNIT "Bit Mask" /end CHARACTERISTIC
/begin CHARACTERISTIC FPnd_EGR_clr_eta_lo2 "FPrm_pending(515)" VALUE 0x00164D72 /* @ECU_Address@FPrm_pending@0x021BE406@ */ ECIPP_ALIGNMENT_UWORD 65535 Compu_IDENTITY 0 65535 PHYS_UNIT "Bit Mask" /end CHARACTERISTIC
/begin CHARACTERISTIC FPnd_EGR_deice_excess "FPrm_pending(656)" VALUE 0x00164E8C /* @ECU_Address@FPrm_pending@0x021BE520@ */ ECIPP_ALIGNMENT_UWORD 65535 Compu_IDENTITY 0 65535 PHYS_UNIT "Bit Mask" /end CHARACTERISTIC
/begin CHARACTERISTIC FPnd_EGR_offmin_excess "FPrm_pending(495)" VALUE 0x00164D4A /* @ECU_Address@FPrm_pending@0x021BE3DE@ */ ECIPP_ALIGNMENT_UWORD 65535 Compu_IDENTITY 0 65535 PHYS_UNIT "Bit Mask" /end CHARACTERISTIC
/begin CHARACTERISTIC FPnd_EGR_OOA_hi "FPrm_pending(491)" VALUE 0x00164D42 /* @ECU_Address@FPrm_pending@0x021BE3D6@ */ ECIPP_ALIGNMENT_UWORD 65535 Compu_IDENTITY 0 65535 PHYS_UNIT "Bit Mask" /end CHARACTERISTIC
/begin CHARACTERISTIC FPnd_EGR_OOA_lo "FPrm_pending(492)" VALUE 0x00164D44 /* @ECU_Address@FPrm_pending@0x021BE3D8@ */ ECIPP_ALIGNMENT_UWORD 65535 Compu_IDENTITY 0 65535 PHYS_UNIT "Bit Mask" /end CHARACTERISTIC
/begin CHARACTERISTIC FPsvr_CATout_OOR "FPrm_severity(658)" VALUE 0x00166070 /* @ECU_Address@FPrm_severity@0x024B3292@ */ ECIPP_ALIGNMENT_UBYTE 255 Compu_IDENTITY 0 255 PHYS_UNIT "Severity+Class" /end CHARACTERISTIC
/begin CHARACTERISTIC FPsvr_CFV_FP_minv "FPrm_severity(517)" VALUE 0x00165FE3 /* @ECU_Address@FPrm_severity@0x024B3205@ */ ECIPP_ALIGNMENT_UBYTE 255 Compu_IDENTITY 0 255 PHYS_UNIT "Severity+Class" /end CHARACTERISTIC
/begin CHARACTERISTIC FPsvr_CFV_FT_maxv "FPrm_severity(518)" VALUE 0x00165FE4 /* @ECU_Address@FPrm_severity@0x024B3206@ */ ECIPP_ALIGNMENT_UBYTE 255 Compu_IDENTITY 0 255 PHYS_UNIT "Severity+Class" /end CHARACTERISTIC
/begin CHARACTERISTIC FPsvr_CFV_FT_minv "FPrm_severity(519)" VALUE 0x00165FE5 /* @ECU_Address@FPrm_severity@0x024B3207@ */ ECIPP_ALIGNMENT_UBYTE 255 Compu_IDENTITY 0 255 PHYS_UNIT "Severity+Class" /end CHARACTERISTIC
/begin CHARACTERISTIC FPsvr_CFV_mdot_hi "FPrm_severity(393)" VALUE 0x00165F67 /* @ECU_Address@FPrm_severity@0x024B3189@ */ ECIPP_ALIGNMENT_UBYTE 255 Compu_IDENTITY 0 255 PHYS_UNIT "Severity+Class" /end CHARACTERISTIC
/begin CHARACTERISTIC FPsvr_CFV_mdot_lo "FPrm_severity(394)" VALUE 0x00165F68 /* @ECU_Address@FPrm_severity@0x024B318A@ */ ECIPP_ALIGNMENT_UBYTE 255 Compu_IDENTITY 0 255 PHYS_UNIT "Severity+Class" /end CHARACTERISTIC
/begin CHARACTERISTIC FPsvr_CFV_mdot_rms_hi "FPrm_severity(509)" VALUE 0x00165FDB /* @ECU_Address@FPrm_severity@0x024B31FD@ */ ECIPP_ALIGNMENT_UBYTE 255 Compu_IDENTITY 0 255 PHYS_UNIT "Severity+Class" /end CHARACTERISTIC
/begin CHARACTERISTIC FPsvr_CFV_pwr_loss "FPrm_severity(657)" VALUE 0x0016606F /* @ECU_Address@FPrm_severity@0x024B3291@ */ ECIPP_ALIGNMENT_UBYTE 255 Compu_IDENTITY 0 255 PHYS_UNIT "Severity+Class" /end CHARACTERISTIC
/begin CHARACTERISTIC FPsvr_CFV_RLV_fail "FPrm_severity(405)" VALUE 0x00165F73 /* @ECU_Address@FPrm_severity@0x024B3195@ */ ECIPP_ALIGNMENT_UBYTE 255 Compu_IDENTITY 0 255 PHYS_UNIT "Severity+Class" /end CHARACTERISTIC
/begin CHARACTERISTIC FPsvr_CFV_RLV_P_min "FPrm_severity(404)" VALUE 0x00165F72 /* @ECU_Address@FPrm_severity@0x024B3194@ */ ECIPP_ALIGNMENT_UBYTE 255 Compu_IDENTITY 0 255 PHYS_UNIT "Severity+Class" /end CHARACTERISTIC
/begin CHARACTERISTIC FPsvr_CHT_HiExp "FPrm_severity(73)" VALUE 0x00165E27 /* @ECU_Address@FPrm_severity@0x024B3049@ */ ECIPP_ALIGNMENT_UBYTE 255 Compu_IDENTITY 0 255 PHYS_UNIT "Severity+Class" /end CHARACTERISTIC
/begin CHARACTERISTIC FPsvr_CHT_HiExp2 "FPrm_severity(74)" VALUE 0x00165E28 /* @ECU_Address@FPrm_severity@0x024B304A@ */ ECIPP_ALIGNMENT_UBYTE 255 Compu_IDENTITY 0 255 PHYS_UNIT "Severity+Class" /end CHARACTERISTIC
/begin CHARACTERISTIC FPsvr_CL_hi "FPrm_severity(47)" VALUE 0x00165E0D /* @ECU_Address@FPrm_severity@0x024B302F@ */ ECIPP_ALIGNMENT_UBYTE 255 Compu_IDENTITY 0 255 PHYS_UNIT "Severity+Class" /end CHARACTERISTIC
/begin CHARACTERISTIC FPsvr_CL_lo "FPrm_severity(48)" VALUE 0x00165E0E /* @ECU_Address@FPrm_severity@0x024B3030@ */ ECIPP_ALIGNMENT_UBYTE 255 Compu_IDENTITY 0 255 PHYS_UNIT "Severity+Class" /end CHARACTERISTIC
/begin CHARACTERISTIC FPsvr_CL_phi_hi "FPrm_severity(507)" VALUE 0x00165FD9 /* @ECU_Address@FPrm_severity@0x024B31FB@ */ ECIPP_ALIGNMENT_UBYTE 255 Compu_IDENTITY 0 255 PHYS_UNIT "Severity+Class" /end CHARACTERISTIC
/begin CHARACTERISTIC FPsvr_CL_phi_lo "FPrm_severity(508)" VALUE 0x00165FDA /* @ECU_Address@FPrm_severity@0x024B31FC@ */ ECIPP_ALIGNMENT_UBYTE 255 Compu_IDENTITY 0 255 PHYS_UNIT "Severity+Class" /end CHARACTERISTIC
/begin CHARACTERISTIC FPsvr_CLLP_hi "FPrm_severity(49)" VALUE 0x00165E0F /* @ECU_Address@FPrm_severity@0x024B3031@ */ ECIPP_ALIGNMENT_UBYTE 255 Compu_IDENTITY 0 255 PHYS_UNIT "Severity+Class" /end CHARACTERISTIC
/begin CHARACTERISTIC FPsvr_CLLP_lo "FPrm_severity(50)" VALUE 0x00165E10 /* @ECU_Address@FPrm_severity@0x024B3032@ */ ECIPP_ALIGNMENT_UBYTE 255 Compu_IDENTITY 0 255 PHYS_UNIT "Severity+Class" /end CHARACTERISTIC
/begin CHARACTERISTIC FPsvr_CLNG_hi "FPrm_severity(51)" VALUE 0x00165E11 /* @ECU_Address@FPrm_severity@0x024B3033@ */ ECIPP_ALIGNMENT_UBYTE 255 Compu_IDENTITY 0 255 PHYS_UNIT "Severity+Class" /end CHARACTERISTIC
/begin CHARACTERISTIC FPsvr_CLNG_lo "FPrm_severity(52)" VALUE 0x00165E12 /* @ECU_Address@FPrm_severity@0x024B3034@ */ ECIPP_ALIGNMENT_UBYTE 255 Compu_IDENTITY 0 255 PHYS_UNIT "Severity+Class" /end CHARACTERISTIC
/begin CHARACTERISTIC FPsvr_CM_unresp "FPrm_severity(629)" VALUE 0x00166053 /* @ECU_Address@FPrm_severity@0x024B3275@ */ ECIPP_ALIGNMENT_UBYTE 255 Compu_IDENTITY 0 255 PHYS_UNIT "Severity+Class" /end CHARACTERISTIC
/begin CHARACTERISTIC FPsvr_CMgsln_inact "FPrm_severity(89)" VALUE 0x00165E37 /* @ECU_Address@FPrm_severity@0x024B3059@ */ ECIPP_ALIGNMENT_UBYTE 255 Compu_IDENTITY 0 255 PHYS_UNIT "Severity+Class" /end CHARACTERISTIC
/begin CHARACTERISTIC FPsvr_CMLP_inact "FPrm_severity(90)" VALUE 0x00165E38 /* @ECU_Address@FPrm_severity@0x024B305A@ */ ECIPP_ALIGNMENT_UBYTE 255 Compu_IDENTITY 0 255 PHYS_UNIT "Severity+Class" /end CHARACTERISTIC
/begin CHARACTERISTIC FPsvr_CMNG_inact "FPrm_severity(91)" VALUE 0x00165E39 /* @ECU_Address@FPrm_severity@0x024B305B@ */ ECIPP_ALIGNMENT_UBYTE 255 Compu_IDENTITY 0 255 PHYS_UNIT "Severity+Class" /end CHARACTERISTIC
/begin CHARACTERISTIC FPsvr_COPfail "FPrm_severity(63)" VALUE 0x00165E1D /* @ECU_Address@FPrm_severity@0x024B303F@ */ ECIPP_ALIGNMENT_UBYTE 255 Compu_IDENTITY 0 255 PHYS_UNIT "Severity+Class" /end CHARACTERISTIC
/begin CHARACTERISTIC FPsvr_COT_hi "FPrm_severity(487)" VALUE 0x00165FC5 /* @ECU_Address@FPrm_severity@0x024B31E7@ */ ECIPP_ALIGNMENT_UBYTE 255 Compu_IDENTITY 0 255 PHYS_UNIT "Severity+Class" /end CHARACTERISTIC
/begin CHARACTERISTIC FPsvr_crkloss "FPrm_severity(112)" VALUE 0x00165E4E /* @ECU_Address@FPrm_severity@0x024B3070@ */ ECIPP_ALIGNMENT_UBYTE 255 Compu_IDENTITY 0 255 PHYS_UNIT "Severity+Class" /end CHARACTERISTIC
/begin CHARACTERISTIC FPsvr_crknever "FPrm_severity(62)" VALUE 0x00165E1C /* @ECU_Address@FPrm_severity@0x024B303E@ */ ECIPP_ALIGNMENT_UBYTE 255 Compu_IDENTITY 0 255 PHYS_UNIT "Severity+Class" /end CHARACTERISTIC
/begin CHARACTERISTIC FPsvr_crknoise "FPrm_severity(61)" VALUE 0x00165E1B /* @ECU_Address@FPrm_severity@0x024B303D@ */ ECIPP_ALIGNMENT_UBYTE 255 Compu_IDENTITY 0 255 PHYS_UNIT "Severity+Class" /end CHARACTERISTIC
/begin CHARACTERISTIC FPsvr_CVCS_discon "FPrm_severity(577)" VALUE 0x0016601F /* @ECU_Address@FPrm_severity@0x024B3241@ */ ECIPP_ALIGNMENT_UBYTE 255 Compu_IDENTITY 0 255 PHYS_UNIT "Severity+Class" /end CHARACTERISTIC
/begin CHARACTERISTIC FPsvr_CVDS_discon "FPrm_severity(578)" VALUE 0x00166020 /* @ECU_Address@FPrm_severity@0x024B3242@ */ ECIPP_ALIGNMENT_UBYTE 255 Compu_IDENTITY 0 255 PHYS_UNIT "Severity+Class" /end CHARACTERISTIC
/begin CHARACTERISTIC FPsvr_CVP1_hi "FPrm_severity(624)" VALUE 0x0016604E /* @ECU_Address@FPrm_severity@0x024B3270@ */ ECIPP_ALIGNMENT_UBYTE 255 Compu_IDENTITY 0 255 PHYS_UNIT "Severity+Class" /end CHARACTERISTIC
/begin CHARACTERISTIC FPsvr_CVP1_lo "FPrm_severity(625)" VALUE 0x0016604F /* @ECU_Address@FPrm_severity@0x024B3271@ */ ECIPP_ALIGNMENT_UBYTE 255 Compu_IDENTITY 0 255 PHYS_UNIT "Severity+Class" /end CHARACTERISTIC
/begin CHARACTERISTIC FPsvr_CVP2_hi "FPrm_severity(626)" VALUE 0x00166050 /* @ECU_Address@FPrm_severity@0x024B3272@ */ ECIPP_ALIGNMENT_UBYTE 255 Compu_IDENTITY 0 255 PHYS_UNIT "Severity+Class" /end CHARACTERISTIC
/begin CHARACTERISTIC FPsvr_CVP2_lo "FPrm_severity(627)" VALUE 0x00166051 /* @ECU_Address@FPrm_severity@0x024B3273@ */ ECIPP_ALIGNMENT_UBYTE 255 Compu_IDENTITY 0 255 PHYS_UNIT "Severity+Class" /end CHARACTERISTIC
/begin CHARACTERISTIC FPsvr_DBW_I_max "FPrm_severity(397)" VALUE 0x00165F6B /* @ECU_Address@FPrm_severity@0x024B318D@ */ ECIPP_ALIGNMENT_UBYTE 255 Compu_IDENTITY 0 255 PHYS_UNIT "Severity+Class" /end CHARACTERISTIC
/begin CHARACTERISTIC FPsvr_ECam_maxerr "FPrm_severity(211)" VALUE 0x00165EB1 /* @ECU_Address@FPrm_severity@0x024B30D3@ */ ECIPP_ALIGNMENT_UBYTE 255 Compu_IDENTITY 0 255 PHYS_UNIT "Severity+Class" /end CHARACTERISTIC
/begin CHARACTERISTIC FPsvr_ECL_low "FPrm_severity(563)" VALUE 0x00166011 /* @ECU_Address@FPrm_severity@0x024B3233@ */ ECIPP_ALIGNMENT_UBYTE 255 Compu_IDENTITY 0 255 PHYS_UNIT "Severity+Class" /end CHARACTERISTIC
/begin CHARACTERISTIC FPsvr_ECT_AAT_dT_max "FPrm_severity(669)" VALUE 0x0016607B /* @ECU_Address@FPrm_severity@0x024B329D@ */ ECIPP_ALIGNMENT_UBYTE 255 Compu_IDENTITY 0 255 PHYS_UNIT "Severity+Class" /end CHARACTERISTIC
/begin CHARACTERISTIC FPsvr_ECT_derate_actv "FPrm_severity(655)" VALUE 0x0016606D /* @ECU_Address@FPrm_severity@0x024B328F@ */ ECIPP_ALIGNMENT_UBYTE 255 Compu_IDENTITY 0 255 PHYS_UNIT "Severity+Class" /end CHARACTERISTIC
/begin CHARACTERISTIC FPsvr_ECT_dT_max "FPrm_severity(677)" VALUE 0x00166083 /* @ECU_Address@FPrm_severity@0x024B32A5@ */ ECIPP_ALIGNMENT_UBYTE 255 Compu_IDENTITY 0 255 PHYS_UNIT "Severity+Class" /end CHARACTERISTIC
/begin CHARACTERISTIC FPsvr_ECT_EGRT_dT_max "FPrm_severity(670)" VALUE 0x0016607C /* @ECU_Address@FPrm_severity@0x024B329E@ */ ECIPP_ALIGNMENT_UBYTE 255 Compu_IDENTITY 0 255 PHYS_UNIT "Severity+Class" /end CHARACTERISTIC
/begin CHARACTERISTIC FPsvr_ECT_EGT_dT_max "FPrm_severity(673)" VALUE 0x0016607F /* @ECU_Address@FPrm_severity@0x024B32A1@ */ ECIPP_ALIGNMENT_UBYTE 255 Compu_IDENTITY 0 255 PHYS_UNIT "Severity+Class" /end CHARACTERISTIC
/begin CHARACTERISTIC FPsvr_ECT_FT_dT_max "FPrm_severity(671)" VALUE 0x0016607D /* @ECU_Address@FPrm_severity@0x024B329F@ */ ECIPP_ALIGNMENT_UBYTE 255 Compu_IDENTITY 0 255 PHYS_UNIT "Severity+Class" /end CHARACTERISTIC
/begin CHARACTERISTIC FPsvr_ECT_HiExp "FPrm_severity(4)" VALUE 0x00165DE2 /* @ECU_Address@FPrm_severity@0x024B3004@ */ ECIPP_ALIGNMENT_UBYTE 255 Compu_IDENTITY 0 255 PHYS_UNIT "Severity+Class" /end CHARACTERISTIC
/begin CHARACTERISTIC FPsvr_ECT_HiExp2 "FPrm_severity(5)" VALUE 0x00165DE3 /* @ECU_Address@FPrm_severity@0x024B3005@ */ ECIPP_ALIGNMENT_UBYTE 255 Compu_IDENTITY 0 255 PHYS_UNIT "Severity+Class" /end CHARACTERISTIC
/begin CHARACTERISTIC FPsvr_ECT_IAT_dT_max "FPrm_severity(668)" VALUE 0x0016607A /* @ECU_Address@FPrm_severity@0x024B329C@ */ ECIPP_ALIGNMENT_UBYTE 255 Compu_IDENTITY 0 255 PHYS_UNIT "Severity+Class" /end CHARACTERISTIC
/begin CHARACTERISTIC FPsvr_ECT_LoExp "FPrm_severity(478)" VALUE 0x00165FBC /* @ECU_Address@FPrm_severity@0x024B31DE@ */ ECIPP_ALIGNMENT_UBYTE 255 Compu_IDENTITY 0 255 PHYS_UNIT "Severity+Class" /end CHARACTERISTIC
/begin CHARACTERISTIC FPsvr_ECT_LoExp2 "FPrm_severity(479)" VALUE 0x00165FBD /* @ECU_Address@FPrm_severity@0x024B31DF@ */ ECIPP_ALIGNMENT_UBYTE 255 Compu_IDENTITY 0 255 PHYS_UNIT "Severity+Class" /end CHARACTERISTIC
/begin CHARACTERISTIC FPsvr_ECT_maxv "FPrm_severity(2)" VALUE 0x00165DE0 /* @ECU_Address@FPrm_severity@0x024B3002@ */ ECIPP_ALIGNMENT_UBYTE 255 Compu_IDENTITY 0 255 PHYS_UNIT "Severity+Class" /end CHARACTERISTIC
/begin CHARACTERISTIC FPsvr_ECT_minv "FPrm_severity(3)" VALUE 0x00165DE1 /* @ECU_Address@FPrm_severity@0x024B3003@ */ ECIPP_ALIGNMENT_UBYTE 255 Compu_IDENTITY 0 255 PHYS_UNIT "Severity+Class" /end CHARACTERISTIC
/begin CHARACTERISTIC FPsvr_ECT_OILT_dT_max "FPrm_severity(672)" VALUE 0x0016607E /* @ECU_Address@FPrm_severity@0x024B32A0@ */ ECIPP_ALIGNMENT_UBYTE 255 Compu_IDENTITY 0 255 PHYS_UNIT "Severity+Class" /end CHARACTERISTIC
/begin CHARACTERISTIC FPsvr_ECT_TAUX_dT1_max "FPrm_severity(675)" VALUE 0x00166081 /* @ECU_Address@FPrm_severity@0x024B32A3@ */ ECIPP_ALIGNMENT_UBYTE 255 Compu_IDENTITY 0 255 PHYS_UNIT "Severity+Class" /end CHARACTERISTIC
/begin CHARACTERISTIC FPsvr_ECT_TAUX_dT2_max "FPrm_severity(676)" VALUE 0x00166082 /* @ECU_Address@FPrm_severity@0x024B32A4@ */ ECIPP_ALIGNMENT_UBYTE 255 Compu_IDENTITY 0 255 PHYS_UNIT "Severity+Class" /end CHARACTERISTIC
/begin CHARACTERISTIC FPsvr_ECT_TIAT_dT_max "FPrm_severity(674)" VALUE 0x00166080 /* @ECU_Address@FPrm_severity@0x024B32A2@ */ ECIPP_ALIGNMENT_UBYTE 255 Compu_IDENTITY 0 255 PHYS_UNIT "Severity+Class" /end CHARACTERISTIC
/begin CHARACTERISTIC FPsvr_EGO1_open "FPrm_severity(71)" VALUE 0x00165E25 /* @ECU_Address@FPrm_severity@0x024B3047@ */ ECIPP_ALIGNMENT_UBYTE 255 Compu_IDENTITY 0 255 PHYS_UNIT "Severity+Class" /end CHARACTERISTIC
/begin CHARACTERISTIC FPsvr_EGO2_open "FPrm_severity(100)" VALUE 0x00165E42 /* @ECU_Address@FPrm_severity@0x024B3064@ */ ECIPP_ALIGNMENT_UBYTE 255 Compu_IDENTITY 0 255 PHYS_UNIT "Severity+Class" /end CHARACTERISTIC
/begin CHARACTERISTIC FPsvr_EGO3_open "FPrm_severity(72)" VALUE 0x00165E26 /* @ECU_Address@FPrm_severity@0x024B3048@ */ ECIPP_ALIGNMENT_UBYTE 255 Compu_IDENTITY 0 255 PHYS_UNIT "Severity+Class" /end CHARACTERISTIC
/begin CHARACTERISTIC FPsvr_EGOH1_off_open "FPrm_severity(230)" VALUE 0x00165EC4 /* @ECU_Address@FPrm_severity@0x024B30E6@ */ ECIPP_ALIGNMENT_UBYTE 255 Compu_IDENTITY 0 255 PHYS_UNIT "Severity+Class" /end CHARACTERISTIC
/begin CHARACTERISTIC FPsvr_EGOH1_on_short "FPrm_severity(231)" VALUE 0x00165EC5 /* @ECU_Address@FPrm_severity@0x024B30E7@ */ ECIPP_ALIGNMENT_UBYTE 255 Compu_IDENTITY 0 255 PHYS_UNIT "Severity+Class" /end CHARACTERISTIC
/begin CHARACTERISTIC FPsvr_EGOH2_off_open "FPrm_severity(232)" VALUE 0x00165EC6 /* @ECU_Address@FPrm_severity@0x024B30E8@ */ ECIPP_ALIGNMENT_UBYTE 255 Compu_IDENTITY 0 255 PHYS_UNIT "Severity+Class" /end CHARACTERISTIC
/begin CHARACTERISTIC FPsvr_EGOH2_on_short "FPrm_severity(233)" VALUE 0x00165EC7 /* @ECU_Address@FPrm_severity@0x024B30E9@ */ ECIPP_ALIGNMENT_UBYTE 255 Compu_IDENTITY 0 255 PHYS_UNIT "Severity+Class" /end CHARACTERISTIC
/begin CHARACTERISTIC FPsvr_EGOH3_off_open "FPrm_severity(234)" VALUE 0x00165EC8 /* @ECU_Address@FPrm_severity@0x024B30EA@ */ ECIPP_ALIGNMENT_UBYTE 255 Compu_IDENTITY 0 255 PHYS_UNIT "Severity+Class" /end CHARACTERISTIC
/begin CHARACTERISTIC FPsvr_EGOH3_on_short "FPrm_severity(235)" VALUE 0x00165EC9 /* @ECU_Address@FPrm_severity@0x024B30EB@ */ ECIPP_ALIGNMENT_UBYTE 255 Compu_IDENTITY 0 255 PHYS_UNIT "Severity+Class" /end CHARACTERISTIC
/begin CHARACTERISTIC FPsvr_EGOH4_off_open "FPrm_severity(236)" VALUE 0x00165ECA /* @ECU_Address@FPrm_severity@0x024B30EC@ */ ECIPP_ALIGNMENT_UBYTE 255 Compu_IDENTITY 0 255 PHYS_UNIT "Severity+Class" /end CHARACTERISTIC
/begin CHARACTERISTIC FPsvr_EGOH4_on_short "FPrm_severity(237)" VALUE 0x00165ECB /* @ECU_Address@FPrm_severity@0x024B30ED@ */ ECIPP_ALIGNMENT_UBYTE 255 Compu_IDENTITY 0 255 PHYS_UNIT "Severity+Class" /end CHARACTERISTIC
/begin CHARACTERISTIC FPsvr_EGR_clr_eta_lo "FPrm_severity(496)" VALUE 0x00165FCE /* @ECU_Address@FPrm_severity@0x024B31F0@ */ ECIPP_ALIGNMENT_UBYTE 255 Compu_IDENTITY 0 255 PHYS_UNIT "Severity+Class" /end CHARACTERISTIC
/begin CHARACTERISTIC FPsvr_EGR_clr_eta_lo2 "FPrm_severity(515)" VALUE 0x00165FE1 /* @ECU_Address@FPrm_severity@0x024B3203@ */ ECIPP_ALIGNMENT_UBYTE 255 Compu_IDENTITY 0 255 PHYS_UNIT "Severity+Class" /end CHARACTERISTIC
/begin CHARACTERISTIC FPsvr_EGR_deice_excess "FPrm_severity(656)" VALUE 0x0016606E /* @ECU_Address@FPrm_severity@0x024B3290@ */ ECIPP_ALIGNMENT_UBYTE 255 Compu_IDENTITY 0 255 PHYS_UNIT "Severity+Class" /end CHARACTERISTIC
/begin CHARACTERISTIC FPsvr_EGR_offmin_excess "FPrm_severity(495)" VALUE 0x00165FCD /* @ECU_Address@FPrm_severity@0x024B31EF@ */ ECIPP_ALIGNMENT_UBYTE 255 Compu_IDENTITY 0 255 PHYS_UNIT "Severity+Class" /end CHARACTERISTIC
/begin CHARACTERISTIC FPsvr_EGR_OOA_hi "FPrm_severity(491)" VALUE 0x00165FC9 /* @ECU_Address@FPrm_severity@0x024B31EB@ */ ECIPP_ALIGNMENT_UBYTE 255 Compu_IDENTITY 0 255 PHYS_UNIT "Severity+Class" /end CHARACTERISTIC
/begin CHARACTERISTIC FPsvr_EGR_OOA_lo "FPrm_severity(492)" VALUE 0x00165FCA /* @ECU_Address@FPrm_severity@0x024B31EC@ */ ECIPP_ALIGNMENT_UBYTE 255 Compu_IDENTITY 0 255 PHYS_UNIT "Severity+Class" /end CHARACTERISTIC
/begin CHARACTERISTIC FPsw_CATout_OOR "FPrm_switches(658)" VALUE 0x00146E00 /* @ECU_Address@FPrm_switches@0x021B9524@ */ ECIPP_ALIGNMENT_UWORD 65535 Compu_IDENTITY 0 65535 PHYS_UNIT "Enable bits" /end CHARACTERISTIC
/begin CHARACTERISTIC FPsw_CFV_FP_minv "FPrm_switches(517)" VALUE 0x00146CE6 /* @ECU_Address@FPrm_switches@0x021B940A@ */ ECIPP_ALIGNMENT_UWORD 65535 Compu_IDENTITY 0 65535 PHYS_UNIT "Enable bits" /end CHARACTERISTIC
/begin CHARACTERISTIC FPsw_CFV_FT_maxv "FPrm_switches(518)" VALUE 0x00146CE8 /* @ECU_Address@FPrm_switches@0x021B940C@ */ ECIPP_ALIGNMENT_UWORD 65535 Compu_IDENTITY 0 65535 PHYS_UNIT "Enable bits" /end CHARACTERISTIC
/begin CHARACTERISTIC FPsw_CFV_FT_minv "FPrm_switches(519)" VALUE 0x00146CEA /* @ECU_Address@FPrm_switches@0x021B940E@ */ ECIPP_ALIGNMENT_UWORD 65535 Compu_IDENTITY 0 65535 PHYS_UNIT "Enable bits" /end CHARACTERISTIC
/begin CHARACTERISTIC FPsw_CFV_mdot_hi "FPrm_switches(393)" VALUE 0x00146BEE /* @ECU_Address@FPrm_switches@0x021B9312@ */ ECIPP_ALIGNMENT_UWORD 65535 Compu_IDENTITY 0 65535 PHYS_UNIT "Enable bits" /end CHARACTERISTIC
/begin CHARACTERISTIC FPsw_CFV_mdot_lo "FPrm_switches(394)" VALUE 0x00146BF0 /* @ECU_Address@FPrm_switches@0x021B9314@ */ ECIPP_ALIGNMENT_UWORD 65535 Compu_IDENTITY 0 65535 PHYS_UNIT "Enable bits" /end CHARACTERISTIC
/begin CHARACTERISTIC FPsw_CFV_mdot_rms_hi "FPrm_switches(509)" VALUE 0x00146CD6 /* @ECU_Address@FPrm_switches@0x021B93FA@ */ ECIPP_ALIGNMENT_UWORD 65535 Compu_IDENTITY 0 65535 PHYS_UNIT "Enable bits" /end CHARACTERISTIC
/begin CHARACTERISTIC FPsw_CFV_pwr_loss "FPrm_switches(657)" VALUE 0x00146DFE /* @ECU_Address@FPrm_switches@0x021B9522@ */ ECIPP_ALIGNMENT_UWORD 65535 Compu_IDENTITY 0 65535 PHYS_UNIT "Enable bits" /end CHARACTERISTIC
/begin CHARACTERISTIC FPsw_CFV_RLV_fail "FPrm_switches(405)" VALUE 0x00146C06 /* @ECU_Address@FPrm_switches@0x021B932A@ */ ECIPP_ALIGNMENT_UWORD 65535 Compu_IDENTITY 0 65535 PHYS_UNIT "Enable bits" /end CHARACTERISTIC
/begin CHARACTERISTIC FPsw_CFV_RLV_P_min "FPrm_switches(404)" VALUE 0x00146C04 /* @ECU_Address@FPrm_switches@0x021B9328@ */ ECIPP_ALIGNMENT_UWORD 65535 Compu_IDENTITY 0 65535 PHYS_UNIT "Enable bits" /end CHARACTERISTIC
/begin CHARACTERISTIC FPsw_CHT_HiExp "FPrm_switches(73)" VALUE 0x0014696E /* @ECU_Address@FPrm_switches@0x021B9092@ */ ECIPP_ALIGNMENT_UWORD 65535 Compu_IDENTITY 0 65535 PHYS_UNIT "Enable bits" /end CHARACTERISTIC
/begin CHARACTERISTIC FPsw_CHT_HiExp2 "FPrm_switches(74)" VALUE 0x00146970 /* @ECU_Address@FPrm_switches@0x021B9094@ */ ECIPP_ALIGNMENT_UWORD 65535 Compu_IDENTITY 0 65535 PHYS_UNIT "Enable bits" /end CHARACTERISTIC
/begin CHARACTERISTIC FPsw_CL_hi "FPrm_switches(47)" VALUE 0x0014693A /* @ECU_Address@FPrm_switches@0x021B905E@ */ ECIPP_ALIGNMENT_UWORD 65535 Compu_IDENTITY 0 65535 PHYS_UNIT "Enable bits" /end CHARACTERISTIC
/begin CHARACTERISTIC FPsw_CL_lo "FPrm_switches(48)" VALUE 0x0014693C /* @ECU_Address@FPrm_switches@0x021B9060@ */ ECIPP_ALIGNMENT_UWORD 65535 Compu_IDENTITY 0 65535 PHYS_UNIT "Enable bits" /end CHARACTERISTIC
/begin CHARACTERISTIC FPsw_CL_phi_hi "FPrm_switches(507)" VALUE 0x00146CD2 /* @ECU_Address@FPrm_switches@0x021B93F6@ */ ECIPP_ALIGNMENT_UWORD 65535 Compu_IDENTITY 0 65535 PHYS_UNIT "Enable bits" /end CHARACTERISTIC
/begin CHARACTERISTIC FPsw_CL_phi_lo "FPrm_switches(508)" VALUE 0x00146CD4 /* @ECU_Address@FPrm_switches@0x021B93F8@ */ ECIPP_ALIGNMENT_UWORD 65535 Compu_IDENTITY 0 65535 PHYS_UNIT "Enable bits" /end CHARACTERISTIC
/begin CHARACTERISTIC FPsw_CLLP_hi "FPrm_switches(49)" VALUE 0x0014693E /* @ECU_Address@FPrm_switches@0x021B9062@ */ ECIPP_ALIGNMENT_UWORD 65535 Compu_IDENTITY 0 65535 PHYS_UNIT "Enable bits" /end CHARACTERISTIC
/begin CHARACTERISTIC FPsw_CLLP_lo "FPrm_switches(50)" VALUE 0x00146940 /* @ECU_Address@FPrm_switches@0x021B9064@ */ ECIPP_ALIGNMENT_UWORD 65535 Compu_IDENTITY 0 65535 PHYS_UNIT "Enable bits" /end CHARACTERISTIC
/begin CHARACTERISTIC FPsw_CLNG_hi "FPrm_switches(51)" VALUE 0x00146942 /* @ECU_Address@FPrm_switches@0x021B9066@ */ ECIPP_ALIGNMENT_UWORD 65535 Compu_IDENTITY 0 65535 PHYS_UNIT "Enable bits" /end CHARACTERISTIC
/begin CHARACTERISTIC FPsw_CLNG_lo "FPrm_switches(52)" VALUE 0x00146944 /* @ECU_Address@FPrm_switches@0x021B9068@ */ ECIPP_ALIGNMENT_UWORD 65535 Compu_IDENTITY 0 65535 PHYS_UNIT "Enable bits" /end CHARACTERISTIC
/begin CHARACTERISTIC FPsw_CM_unresp "FPrm_switches(629)" VALUE 0x00146DC6 /* @ECU_Address@FPrm_switches@0x021B94EA@ */ ECIPP_ALIGNMENT_UWORD 65535 Compu_IDENTITY 0 65535 PHYS_UNIT "Enable bits" /end CHARACTERISTIC
/begin CHARACTERISTIC FPsw_CMgsln_inact "FPrm_switches(89)" VALUE 0x0014698E /* @ECU_Address@FPrm_switches@0x021B90B2@ */ ECIPP_ALIGNMENT_UWORD 65535 Compu_IDENTITY 0 65535 PHYS_UNIT "Enable bits" /end CHARACTERISTIC
/begin CHARACTERISTIC FPsw_CMLP_inact "FPrm_switches(90)" VALUE 0x00146990 /* @ECU_Address@FPrm_switches@0x021B90B4@ */ ECIPP_ALIGNMENT_UWORD 65535 Compu_IDENTITY 0 65535 PHYS_UNIT "Enable bits" /end CHARACTERISTIC
/begin CHARACTERISTIC FPsw_CMNG_inact "FPrm_switches(91)" VALUE 0x00146992 /* @ECU_Address@FPrm_switches@0x021B90B6@ */ ECIPP_ALIGNMENT_UWORD 65535 Compu_IDENTITY 0 65535 PHYS_UNIT "Enable bits" /end CHARACTERISTIC
/begin CHARACTERISTIC FPsw_COPfail "FPrm_switches(63)" VALUE 0x0014695A /* @ECU_Address@FPrm_switches@0x021B907E@ */ ECIPP_ALIGNMENT_UWORD 65535 Compu_IDENTITY 0 65535 PHYS_UNIT "Enable bits" /end CHARACTERISTIC
/begin CHARACTERISTIC FPsw_COT_hi "FPrm_switches(487)" VALUE 0x00146CAA /* @ECU_Address@FPrm_switches@0x021B93CE@ */ ECIPP_ALIGNMENT_UWORD 65535 Compu_IDENTITY 0 65535 PHYS_UNIT "Enable bits" /end CHARACTERISTIC
/begin CHARACTERISTIC FPsw_crkloss "FPrm_switches(112)" VALUE 0x001469BC /* @ECU_Address@FPrm_switches@0x021B90E0@ */ ECIPP_ALIGNMENT_UWORD 65535 Compu_IDENTITY 0 65535 PHYS_UNIT "Enable bits" /end CHARACTERISTIC
/begin CHARACTERISTIC FPsw_crknever "FPrm_switches(62)" VALUE 0x00146958 /* @ECU_Address@FPrm_switches@0x021B907C@ */ ECIPP_ALIGNMENT_UWORD 65535 Compu_IDENTITY 0 65535 PHYS_UNIT "Enable bits" /end CHARACTERISTIC
/begin CHARACTERISTIC FPsw_crknoise "FPrm_switches(61)" VALUE 0x00146956 /* @ECU_Address@FPrm_switches@0x021B907A@ */ ECIPP_ALIGNMENT_UWORD 65535 Compu_IDENTITY 0 65535 PHYS_UNIT "Enable bits" /end CHARACTERISTIC
/begin CHARACTERISTIC FPsw_CVCS_discon "FPrm_switches(577)" VALUE 0x00146D5E /* @ECU_Address@FPrm_switches@0x021B9482@ */ ECIPP_ALIGNMENT_UWORD 65535 Compu_IDENTITY 0 65535 PHYS_UNIT "Enable bits" /end CHARACTERISTIC
/begin CHARACTERISTIC FPsw_CVDS_discon "FPrm_switches(578)" VALUE 0x00146D60 /* @ECU_Address@FPrm_switches@0x021B9484@ */ ECIPP_ALIGNMENT_UWORD 65535 Compu_IDENTITY 0 65535 PHYS_UNIT "Enable bits" /end CHARACTERISTIC
/begin CHARACTERISTIC FPsw_CVP1_hi "FPrm_switches(624)" VALUE 0x00146DBC /* @ECU_Address@FPrm_switches@0x021B94E0@ */ ECIPP_ALIGNMENT_UWORD 65535 Compu_IDENTITY 0 65535 PHYS_UNIT "Enable bits" /end CHARACTERISTIC
/begin CHARACTERISTIC FPsw_CVP1_lo "FPrm_switches(625)" VALUE 0x00146DBE /* @ECU_Address@FPrm_switches@0x021B94E2@ */ ECIPP_ALIGNMENT_UWORD 65535 Compu_IDENTITY 0 65535 PHYS_UNIT "Enable bits" /end CHARACTERISTIC
/begin CHARACTERISTIC FPsw_CVP2_hi "FPrm_switches(626)" VALUE 0x00146DC0 /* @ECU_Address@FPrm_switches@0x021B94E4@ */ ECIPP_ALIGNMENT_UWORD 65535 Compu_IDENTITY 0 65535 PHYS_UNIT "Enable bits" /end CHARACTERISTIC
/begin CHARACTERISTIC FPsw_CVP2_lo "FPrm_switches(627)" VALUE 0x00146DC2 /* @ECU_Address@FPrm_switches@0x021B94E6@ */ ECIPP_ALIGNMENT_UWORD 65535 Compu_IDENTITY 0 65535 PHYS_UNIT "Enable bits" /end CHARACTERISTIC
/begin CHARACTERISTIC FPsw_DBW_I_max "FPrm_switches(397)" VALUE 0x00146BF6 /* @ECU_Address@FPrm_switches@0x021B931A@ */ ECIPP_ALIGNMENT_UWORD 65535 Compu_IDENTITY 0 65535 PHYS_UNIT "Enable bits" /end CHARACTERISTIC
/begin CHARACTERISTIC FPsw_ECam_maxerr "FPrm_switches(211)" VALUE 0x00146A82 /* @ECU_Address@FPrm_switches@0x021B91A6@ */ ECIPP_ALIGNMENT_UWORD 65535 Compu_IDENTITY 0 65535 PHYS_UNIT "Enable bits" /end CHARACTERISTIC
/begin CHARACTERISTIC FPsw_ECL_low "FPrm_switches(563)" VALUE 0x00146D42 /* @ECU_Address@FPrm_switches@0x021B9466@ */ ECIPP_ALIGNMENT_UWORD 65535 Compu_IDENTITY 0 65535 PHYS_UNIT "Enable bits" /end CHARACTERISTIC
/begin CHARACTERISTIC FPsw_ECT_AAT_dT_max "FPrm_switches(669)" VALUE 0x00146E16 /* @ECU_Address@FPrm_switches@0x021B953A@ */ ECIPP_ALIGNMENT_UWORD 65535 Compu_IDENTITY 0 65535 PHYS_UNIT "Enable bits" /end CHARACTERISTIC
/begin CHARACTERISTIC FPsw_ECT_derate_actv "FPrm_switches(655)" VALUE 0x00146DFA /* @ECU_Address@FPrm_switches@0x021B951E@ */ ECIPP_ALIGNMENT_UWORD 65535 Compu_IDENTITY 0 65535 PHYS_UNIT "Enable bits" /end CHARACTERISTIC
/begin CHARACTERISTIC FPsw_ECT_dT_max "FPrm_switches(677)" VALUE 0x00146E26 /* @ECU_Address@FPrm_switches@0x021B954A@ */ ECIPP_ALIGNMENT_UWORD 65535 Compu_IDENTITY 0 65535 PHYS_UNIT "Enable bits" /end CHARACTERISTIC
/begin CHARACTERISTIC FPsw_ECT_EGRT_dT_max "FPrm_switches(670)" VALUE 0x00146E18 /* @ECU_Address@FPrm_switches@0x021B953C@ */ ECIPP_ALIGNMENT_UWORD 65535 Compu_IDENTITY 0 65535 PHYS_UNIT "Enable bits" /end CHARACTERISTIC
/begin CHARACTERISTIC FPsw_ECT_EGT_dT_max "FPrm_switches(673)" VALUE 0x00146E1E /* @ECU_Address@FPrm_switches@0x021B9542@ */ ECIPP_ALIGNMENT_UWORD 65535 Compu_IDENTITY 0 65535 PHYS_UNIT "Enable bits" /end CHARACTERISTIC
/begin CHARACTERISTIC FPsw_ECT_FT_dT_max "FPrm_switches(671)" VALUE 0x00146E1A /* @ECU_Address@FPrm_switches@0x021B953E@ */ ECIPP_ALIGNMENT_UWORD 65535 Compu_IDENTITY 0 65535 PHYS_UNIT "Enable bits" /end CHARACTERISTIC
/begin CHARACTERISTIC FPsw_ECT_HiExp "FPrm_switches(4)" VALUE 0x001468E4 /* @ECU_Address@FPrm_switches@0x021B9008@ */ ECIPP_ALIGNMENT_UWORD 65535 Compu_IDENTITY 0 65535 PHYS_UNIT "Enable bits" /end CHARACTERISTIC
/begin CHARACTERISTIC FPsw_ECT_HiExp2 "FPrm_switches(5)" VALUE 0x001468E6 /* @ECU_Address@FPrm_switches@0x021B900A@ */ ECIPP_ALIGNMENT_UWORD 65535 Compu_IDENTITY 0 65535 PHYS_UNIT "Enable bits" /end CHARACTERISTIC
/begin CHARACTERISTIC FPsw_ECT_IAT_dT_max "FPrm_switches(668)" VALUE 0x00146E14 /* @ECU_Address@FPrm_switches@0x021B9538@ */ ECIPP_ALIGNMENT_UWORD 65535 Compu_IDENTITY 0 65535 PHYS_UNIT "Enable bits" /end CHARACTERISTIC
/begin CHARACTERISTIC FPsw_ECT_LoExp "FPrm_switches(478)" VALUE 0x00146C98 /* @ECU_Address@FPrm_switches@0x021B93BC@ */ ECIPP_ALIGNMENT_UWORD 65535 Compu_IDENTITY 0 65535 PHYS_UNIT "Enable bits" /end CHARACTERISTIC
/begin CHARACTERISTIC FPsw_ECT_LoExp2 "FPrm_switches(479)" VALUE 0x00146C9A /* @ECU_Address@FPrm_switches@0x021B93BE@ */ ECIPP_ALIGNMENT_UWORD 65535 Compu_IDENTITY 0 65535 PHYS_UNIT "Enable bits" /end CHARACTERISTIC
/begin CHARACTERISTIC FPsw_ECT_maxv "FPrm_switches(2)" VALUE 0x001468E0 /* @ECU_Address@FPrm_switches@0x021B9004@ */ ECIPP_ALIGNMENT_UWORD 65535 Compu_IDENTITY 0 65535 PHYS_UNIT "Enable bits" /end CHARACTERISTIC
/begin CHARACTERISTIC FPsw_ECT_minv "FPrm_switches(3)" VALUE 0x001468E2 /* @ECU_Address@FPrm_switches@0x021B9006@ */ ECIPP_ALIGNMENT_UWORD 65535 Compu_IDENTITY 0 65535 PHYS_UNIT "Enable bits" /end CHARACTERISTIC
/begin CHARACTERISTIC FPsw_ECT_OILT_dT_max "FPrm_switches(672)" VALUE 0x00146E1C /* @ECU_Address@FPrm_switches@0x021B9540@ */ ECIPP_ALIGNMENT_UWORD 65535 Compu_IDENTITY 0 65535 PHYS_UNIT "Enable bits" /end CHARACTERISTIC
/begin CHARACTERISTIC FPsw_ECT_TAUX_dT1_max "FPrm_switches(675)" VALUE 0x00146E22 /* @ECU_Address@FPrm_switches@0x021B9546@ */ ECIPP_ALIGNMENT_UWORD 65535 Compu_IDENTITY 0 65535 PHYS_UNIT "Enable bits" /end CHARACTERISTIC
/begin CHARACTERISTIC FPsw_ECT_TAUX_dT2_max "FPrm_switches(676)" VALUE 0x00146E24 /* @ECU_Address@FPrm_switches@0x021B9548@ */ ECIPP_ALIGNMENT_UWORD 65535 Compu_IDENTITY 0 65535 PHYS_UNIT "Enable bits" /end CHARACTERISTIC
/begin CHARACTERISTIC FPsw_ECT_TIAT_dT_max "FPrm_switches(674)" VALUE 0x00146E20 /* @ECU_Address@FPrm_switches@0x021B9544@ */ ECIPP_ALIGNMENT_UWORD 65535 Compu_IDENTITY 0 65535 PHYS_UNIT "Enable bits" /end CHARACTERISTIC
/begin CHARACTERISTIC FPsw_EGO1_open "FPrm_switches(71)" VALUE 0x0014696A /* @ECU_Address@FPrm_switches@0x021B908E@ */ ECIPP_ALIGNMENT_UWORD 65535 Compu_IDENTITY 0 65535 PHYS_UNIT "Enable bits" /end CHARACTERISTIC
/begin CHARACTERISTIC FPsw_EGO2_open "FPrm_switches(100)" VALUE 0x001469A4 /* @ECU_Address@FPrm_switches@0x021B90C8@ */ ECIPP_ALIGNMENT_UWORD 65535 Compu_IDENTITY 0 65535 PHYS_UNIT "Enable bits" /end CHARACTERISTIC
/begin CHARACTERISTIC FPsw_EGO3_open "FPrm_switches(72)" VALUE 0x0014696C /* @ECU_Address@FPrm_switches@0x021B9090@ */ ECIPP_ALIGNMENT_UWORD 65535 Compu_IDENTITY 0 65535 PHYS_UNIT "Enable bits" /end CHARACTERISTIC
/begin CHARACTERISTIC FPsw_EGOH1_off_open "FPrm_switches(230)" VALUE 0x00146AA8 /* @ECU_Address@FPrm_switches@0x021B91CC@ */ ECIPP_ALIGNMENT_UWORD 65535 Compu_IDENTITY 0 65535 PHYS_UNIT "Enable bits" /end CHARACTERISTIC
/begin CHARACTERISTIC FPsw_EGOH1_on_short "FPrm_switches(231)" VALUE 0x00146AAA /* @ECU_Address@FPrm_switches@0x021B91CE@ */ ECIPP_ALIGNMENT_UWORD 65535 Compu_IDENTITY 0 65535 PHYS_UNIT "Enable bits" /end CHARACTERISTIC
/begin CHARACTERISTIC FPsw_EGOH2_off_open "FPrm_switches(232)" VALUE 0x00146AAC /* @ECU_Address@FPrm_switches@0x021B91D0@ */ ECIPP_ALIGNMENT_UWORD 65535 Compu_IDENTITY 0 65535 PHYS_UNIT "Enable bits" /end CHARACTERISTIC
/begin CHARACTERISTIC FPsw_EGOH2_on_short "FPrm_switches(233)" VALUE 0x00146AAE /* @ECU_Address@FPrm_switches@0x021B91D2@ */ ECIPP_ALIGNMENT_UWORD 65535 Compu_IDENTITY 0 65535 PHYS_UNIT "Enable bits" /end CHARACTERISTIC
/begin CHARACTERISTIC FPsw_EGOH3_off_open "FPrm_switches(234)" VALUE 0x00146AB0 /* @ECU_Address@FPrm_switches@0x021B91D4@ */ ECIPP_ALIGNMENT_UWORD 65535 Compu_IDENTITY 0 65535 PHYS_UNIT "Enable bits" /end CHARACTERISTIC
/begin CHARACTERISTIC FPsw_EGOH3_on_short "FPrm_switches(235)" VALUE 0x00146AB2 /* @ECU_Address@FPrm_switches@0x021B91D6@ */ ECIPP_ALIGNMENT_UWORD 65535 Compu_IDENTITY 0 65535 PHYS_UNIT "Enable bits" /end CHARACTERISTIC
/begin CHARACTERISTIC FPsw_EGOH4_off_open "FPrm_switches(236)" VALUE 0x00146AB4 /* @ECU_Address@FPrm_switches@0x021B91D8@ */ ECIPP_ALIGNMENT_UWORD 65535 Compu_IDENTITY 0 65535 PHYS_UNIT "Enable bits" /end CHARACTERISTIC
/begin CHARACTERISTIC FPsw_EGOH4_on_short "FPrm_switches(237)" VALUE 0x00146AB6 /* @ECU_Address@FPrm_switches@0x021B91DA@ */ ECIPP_ALIGNMENT_UWORD 65535 Compu_IDENTITY 0 65535 PHYS_UNIT "Enable bits" /end CHARACTERISTIC
/begin CHARACTERISTIC FPsw_EGR_clr_eta_lo "FPrm_switches(496)" VALUE 0x00146CBC /* @ECU_Address@FPrm_switches@0x021B93E0@ */ ECIPP_ALIGNMENT_UWORD 65535 Compu_IDENTITY 0 65535 PHYS_UNIT "Enable bits" /end CHARACTERISTIC
/begin CHARACTERISTIC FPsw_EGR_clr_eta_lo2 "FPrm_switches(515)" VALUE 0x00146CE2 /* @ECU_Address@FPrm_switches@0x021B9406@ */ ECIPP_ALIGNMENT_UWORD 65535 Compu_IDENTITY 0 65535 PHYS_UNIT "Enable bits" /end CHARACTERISTIC
/begin CHARACTERISTIC FPsw_EGR_deice_excess "FPrm_switches(656)" VALUE 0x00146DFC /* @ECU_Address@FPrm_switches@0x021B9520@ */ ECIPP_ALIGNMENT_UWORD 65535 Compu_IDENTITY 0 65535 PHYS_UNIT "Enable bits" /end CHARACTERISTIC
/begin CHARACTERISTIC FPsw_EGR_offmin_excess "FPrm_switches(495)" VALUE 0x00146CBA /* @ECU_Address@FPrm_switches@0x021B93DE@ */ ECIPP_ALIGNMENT_UWORD 65535 Compu_IDENTITY 0 65535 PHYS_UNIT "Enable bits" /end CHARACTERISTIC
/begin CHARACTERISTIC FPsw_EGR_OOA_hi "FPrm_switches(491)" VALUE 0x00146CB2 /* @ECU_Address@FPrm_switches@0x021B93D6@ */ ECIPP_ALIGNMENT_UWORD 65535 Compu_IDENTITY 0 65535 PHYS_UNIT "Enable bits" /end CHARACTERISTIC
/begin CHARACTERISTIC FPsw_EGR_OOA_lo "FPrm_switches(492)" VALUE 0x00146CB4 /* @ECU_Address@FPrm_switches@0x021B93D8@ */ ECIPP_ALIGNMENT_UWORD 65535 Compu_IDENTITY 0 65535 PHYS_UNIT "Enable bits" /end CHARACTERISTIC
/begin CHARACTERISTIC FPsw_ext1_CATout_OOR "FPrm_switches_ext1(658)" VALUE 0x00147362 /* @ECU_Address@FPrm_switches_ext1@0x023A5524@ */ ECIPP_ALIGNMENT_UWORD 65535 Compu_IDENTITY 0 65535 PHYS_UNIT "Enable bits" /end CHARACTERISTIC
/begin CHARACTERISTIC FPsw_ext1_CFV_FP_minv "FPrm_switches_ext1(517)" VALUE 0x00147248 /* @ECU_Address@FPrm_switches_ext1@0x023A540A@ */ ECIPP_ALIGNMENT_UWORD 65535 Compu_IDENTITY 0 65535 PHYS_UNIT "Enable bits" /end CHARACTERISTIC
/begin CHARACTERISTIC FPsw_ext1_CFV_FT_maxv "FPrm_switches_ext1(518)" VALUE 0x0014724A /* @ECU_Address@FPrm_switches_ext1@0x023A540C@ */ ECIPP_ALIGNMENT_UWORD 65535 Compu_IDENTITY 0 65535 PHYS_UNIT "Enable bits" /end CHARACTERISTIC
/begin CHARACTERISTIC FPsw_ext1_CFV_FT_minv "FPrm_switches_ext1(519)" VALUE 0x0014724C /* @ECU_Address@FPrm_switches_ext1@0x023A540E@ */ ECIPP_ALIGNMENT_UWORD 65535 Compu_IDENTITY 0 65535 PHYS_UNIT "Enable bits" /end CHARACTERISTIC
/begin CHARACTERISTIC FPsw_ext1_CFV_mdot_hi "FPrm_switches_ext1(393)" VALUE 0x00147150 /* @ECU_Address@FPrm_switches_ext1@0x023A5312@ */ ECIPP_ALIGNMENT_UWORD 65535 Compu_IDENTITY 0 65535 PHYS_UNIT "Enable bits" /end CHARACTERISTIC
/begin CHARACTERISTIC FPsw_ext1_CFV_mdot_lo "FPrm_switches_ext1(394)" VALUE 0x00147152 /* @ECU_Address@FPrm_switches_ext1@0x023A5314@ */ ECIPP_ALIGNMENT_UWORD 65535 Compu_IDENTITY 0 65535 PHYS_UNIT "Enable bits" /end CHARACTERISTIC
/begin CHARACTERISTIC FPsw_ext1_CFV_mdot_rms_hi "FPrm_switches_ext1(509)" VALUE 0x00147238 /* @ECU_Address@FPrm_switches_ext1@0x023A53FA@ */ ECIPP_ALIGNMENT_UWORD 65535 Compu_IDENTITY 0 65535 PHYS_UNIT "Enable bits" /end CHARACTERISTIC
/begin CHARACTERISTIC FPsw_ext1_CFV_pwr_loss "FPrm_switches_ext1(657)" VALUE 0x00147360 /* @ECU_Address@FPrm_switches_ext1@0x023A5522@ */ ECIPP_ALIGNMENT_UWORD 65535 Compu_IDENTITY 0 65535 PHYS_UNIT "Enable bits" /end CHARACTERISTIC
/begin CHARACTERISTIC FPsw_ext1_CFV_RLV_fail "FPrm_switches_ext1(405)" VALUE 0x00147168 /* @ECU_Address@FPrm_switches_ext1@0x023A532A@ */ ECIPP_ALIGNMENT_UWORD 65535 Compu_IDENTITY 0 65535 PHYS_UNIT "Enable bits" /end CHARACTERISTIC
/begin CHARACTERISTIC FPsw_ext1_CFV_RLV_P_min "FPrm_switches_ext1(404)" VALUE 0x00147166 /* @ECU_Address@FPrm_switches_ext1@0x023A5328@ */ ECIPP_ALIGNMENT_UWORD 65535 Compu_IDENTITY 0 65535 PHYS_UNIT "Enable bits" /end CHARACTERISTIC
/begin CHARACTERISTIC FPsw_ext1_CHT_HiExp "FPrm_switches_ext1(73)" VALUE 0x00146ED0 /* @ECU_Address@FPrm_switches_ext1@0x023A5092@ */ ECIPP_ALIGNMENT_UWORD 65535 Compu_IDENTITY 0 65535 PHYS_UNIT "Enable bits" /end CHARACTERISTIC
/begin CHARACTERISTIC FPsw_ext1_CHT_HiExp2 "FPrm_switches_ext1(74)" VALUE 0x00146ED2 /* @ECU_Address@FPrm_switches_ext1@0x023A5094@ */ ECIPP_ALIGNMENT_UWORD 65535 Compu_IDENTITY 0 65535 PHYS_UNIT "Enable bits" /end CHARACTERISTIC
/begin CHARACTERISTIC FPsw_ext1_CL_hi "FPrm_switches_ext1(47)" VALUE 0x00146E9C /* @ECU_Address@FPrm_switches_ext1@0x023A505E@ */ ECIPP_ALIGNMENT_UWORD 65535 Compu_IDENTITY 0 65535 PHYS_UNIT "Enable bits" /end CHARACTERISTIC
/begin CHARACTERISTIC FPsw_ext1_CL_lo "FPrm_switches_ext1(48)" VALUE 0x00146E9E /* @ECU_Address@FPrm_switches_ext1@0x023A5060@ */ ECIPP_ALIGNMENT_UWORD 65535 Compu_IDENTITY 0 65535 PHYS_UNIT "Enable bits" /end CHARACTERISTIC
/begin CHARACTERISTIC FPsw_ext1_CL_phi_hi "FPrm_switches_ext1(507)" VALUE 0x00147234 /* @ECU_Address@FPrm_switches_ext1@0x023A53F6@ */ ECIPP_ALIGNMENT_UWORD 65535 Compu_IDENTITY 0 65535 PHYS_UNIT "Enable bits" /end CHARACTERISTIC
/begin CHARACTERISTIC FPsw_ext1_CL_phi_lo "FPrm_switches_ext1(508)" VALUE 0x00147236 /* @ECU_Address@FPrm_switches_ext1@0x023A53F8@ */ ECIPP_ALIGNMENT_UWORD 65535 Compu_IDENTITY 0 65535 PHYS_UNIT "Enable bits" /end CHARACTERISTIC
/begin CHARACTERISTIC FPsw_ext1_CLLP_hi "FPrm_switches_ext1(49)" VALUE 0x00146EA0 /* @ECU_Address@FPrm_switches_ext1@0x023A5062@ */ ECIPP_ALIGNMENT_UWORD 65535 Compu_IDENTITY 0 65535 PHYS_UNIT "Enable bits" /end CHARACTERISTIC
/begin CHARACTERISTIC FPsw_ext1_CLLP_lo "FPrm_switches_ext1(50)" VALUE 0x00146EA2 /* @ECU_Address@FPrm_switches_ext1@0x023A5064@ */ ECIPP_ALIGNMENT_UWORD 65535 Compu_IDENTITY 0 65535 PHYS_UNIT "Enable bits" /end CHARACTERISTIC
/begin CHARACTERISTIC FPsw_ext1_CLNG_hi "FPrm_switches_ext1(51)" VALUE 0x00146EA4 /* @ECU_Address@FPrm_switches_ext1@0x023A5066@ */ ECIPP_ALIGNMENT_UWORD 65535 Compu_IDENTITY 0 65535 PHYS_UNIT "Enable bits" /end CHARACTERISTIC
/begin CHARACTERISTIC FPsw_ext1_CLNG_lo "FPrm_switches_ext1(52)" VALUE 0x00146EA6 /* @ECU_Address@FPrm_switches_ext1@0x023A5068@ */ ECIPP_ALIGNMENT_UWORD 65535 Compu_IDENTITY 0 65535 PHYS_UNIT "Enable bits" /end CHARACTERISTIC
/begin CHARACTERISTIC FPsw_ext1_CM_unresp "FPrm_switches_ext1(629)" VALUE 0x00147328 /* @ECU_Address@FPrm_switches_ext1@0x023A54EA@ */ ECIPP_ALIGNMENT_UWORD 65535 Compu_IDENTITY 0 65535 PHYS_UNIT "Enable bits" /end CHARACTERISTIC
/begin CHARACTERISTIC FPsw_ext1_CMgsln_inact "FPrm_switches_ext1(89)" VALUE 0x00146EF0 /* @ECU_Address@FPrm_switches_ext1@0x023A50B2@ */ ECIPP_ALIGNMENT_UWORD 65535 Compu_IDENTITY 0 65535 PHYS_UNIT "Enable bits" /end CHARACTERISTIC
/begin CHARACTERISTIC FPsw_ext1_CMLP_inact "FPrm_switches_ext1(90)" VALUE 0x00146EF2 /* @ECU_Address@FPrm_switches_ext1@0x023A50B4@ */ ECIPP_ALIGNMENT_UWORD 65535 Compu_IDENTITY 0 65535 PHYS_UNIT "Enable bits" /end CHARACTERISTIC
/begin CHARACTERISTIC FPsw_ext1_CMNG_inact "FPrm_switches_ext1(91)" VALUE 0x00146EF4 /* @ECU_Address@FPrm_switches_ext1@0x023A50B6@ */ ECIPP_ALIGNMENT_UWORD 65535 Compu_IDENTITY 0 65535 PHYS_UNIT "Enable bits" /end CHARACTERISTIC
/begin CHARACTERISTIC FPsw_ext1_COPfail "FPrm_switches_ext1(63)" VALUE 0x00146EBC /* @ECU_Address@FPrm_switches_ext1@0x023A507E@ */ ECIPP_ALIGNMENT_UWORD 65535 Compu_IDENTITY 0 65535 PHYS_UNIT "Enable bits" /end CHARACTERISTIC
/begin CHARACTERISTIC FPsw_ext1_COT_hi "FPrm_switches_ext1(487)" VALUE 0x0014720C /* @ECU_Address@FPrm_switches_ext1@0x023A53CE@ */ ECIPP_ALIGNMENT_UWORD 65535 Compu_IDENTITY 0 65535 PHYS_UNIT "Enable bits" /end CHARACTERISTIC
/begin CHARACTERISTIC FPsw_ext1_crkloss "FPrm_switches_ext1(112)" VALUE 0x00146F1E /* @ECU_Address@FPrm_switches_ext1@0x023A50E0@ */ ECIPP_ALIGNMENT_UWORD 65535 Compu_IDENTITY 0 65535 PHYS_UNIT "Enable bits" /end CHARACTERISTIC
/begin CHARACTERISTIC FPsw_ext1_crknever "FPrm_switches_ext1(62)" VALUE 0x00146EBA /* @ECU_Address@FPrm_switches_ext1@0x023A507C@ */ ECIPP_ALIGNMENT_UWORD 65535 Compu_IDENTITY 0 65535 PHYS_UNIT "Enable bits" /end CHARACTERISTIC
/begin CHARACTERISTIC FPsw_ext1_crknoise "FPrm_switches_ext1(61)" VALUE 0x00146EB8 /* @ECU_Address@FPrm_switches_ext1@0x023A507A@ */ ECIPP_ALIGNMENT_UWORD 65535 Compu_IDENTITY 0 65535 PHYS_UNIT "Enable bits" /end CHARACTERISTIC
/begin CHARACTERISTIC FPsw_ext1_CVCS_discon "FPrm_switches_ext1(577)" VALUE 0x001472C0 /* @ECU_Address@FPrm_switches_ext1@0x023A5482@ */ ECIPP_ALIGNMENT_UWORD 65535 Compu_IDENTITY 0 65535 PHYS_UNIT "Enable bits" /end CHARACTERISTIC
/begin CHARACTERISTIC FPsw_ext1_CVDS_discon "FPrm_switches_ext1(578)" VALUE 0x001472C2 /* @ECU_Address@FPrm_switches_ext1@0x023A5484@ */ ECIPP_ALIGNMENT_UWORD 65535 Compu_IDENTITY 0 65535 PHYS_UNIT "Enable bits" /end CHARACTERISTIC
/begin CHARACTERISTIC FPsw_ext1_CVP1_hi "FPrm_switches_ext1(624)" VALUE 0x0014731E /* @ECU_Address@FPrm_switches_ext1@0x023A54E0@ */ ECIPP_ALIGNMENT_UWORD 65535 Compu_IDENTITY 0 65535 PHYS_UNIT "Enable bits" /end CHARACTERISTIC
/begin CHARACTERISTIC FPsw_ext1_CVP1_lo "FPrm_switches_ext1(625)" VALUE 0x00147320 /* @ECU_Address@FPrm_switches_ext1@0x023A54E2@ */ ECIPP_ALIGNMENT_UWORD 65535 Compu_IDENTITY 0 65535 PHYS_UNIT "Enable bits" /end CHARACTERISTIC
/begin CHARACTERISTIC FPsw_ext1_CVP2_hi "FPrm_switches_ext1(626)" VALUE 0x00147322 /* @ECU_Address@FPrm_switches_ext1@0x023A54E4@ */ ECIPP_ALIGNMENT_UWORD 65535 Compu_IDENTITY 0 65535 PHYS_UNIT "Enable bits" /end CHARACTERISTIC
/begin CHARACTERISTIC FPsw_ext1_CVP2_lo "FPrm_switches_ext1(627)" VALUE 0x00147324 /* @ECU_Address@FPrm_switches_ext1@0x023A54E6@ */ ECIPP_ALIGNMENT_UWORD 65535 Compu_IDENTITY 0 65535 PHYS_UNIT "Enable bits" /end CHARACTERISTIC
/begin CHARACTERISTIC FPsw_ext1_DBW_I_max "FPrm_switches_ext1(397)" VALUE 0x00147158 /* @ECU_Address@FPrm_switches_ext1@0x023A531A@ */ ECIPP_ALIGNMENT_UWORD 65535 Compu_IDENTITY 0 65535 PHYS_UNIT "Enable bits" /end CHARACTERISTIC
/begin CHARACTERISTIC FPsw_ext1_ECam_maxerr "FPrm_switches_ext1(211)" VALUE 0x00146FE4 /* @ECU_Address@FPrm_switches_ext1@0x023A51A6@ */ ECIPP_ALIGNMENT_UWORD 65535 Compu_IDENTITY 0 65535 PHYS_UNIT "Enable bits" /end CHARACTERISTIC
/begin CHARACTERISTIC FPsw_ext1_ECL_low "FPrm_switches_ext1(563)" VALUE 0x001472A4 /* @ECU_Address@FPrm_switches_ext1@0x023A5466@ */ ECIPP_ALIGNMENT_UWORD 65535 Compu_IDENTITY 0 65535 PHYS_UNIT "Enable bits" /end CHARACTERISTIC
/begin CHARACTERISTIC FPsw_ext1_ECT_AAT_dT_max "FPrm_switches_ext1(669)" VALUE 0x00147378 /* @ECU_Address@FPrm_switches_ext1@0x023A553A@ */ ECIPP_ALIGNMENT_UWORD 65535 Compu_IDENTITY 0 65535 PHYS_UNIT "Enable bits" /end CHARACTERISTIC
/begin CHARACTERISTIC FPsw_ext1_ECT_derate_actv "FPrm_switches_ext1(655)" VALUE 0x0014735C /* @ECU_Address@FPrm_switches_ext1@0x023A551E@ */ ECIPP_ALIGNMENT_UWORD 65535 Compu_IDENTITY 0 65535 PHYS_UNIT "Enable bits" /end CHARACTERISTIC
/begin CHARACTERISTIC FPsw_ext1_ECT_dT_max "FPrm_switches_ext1(677)" VALUE 0x00147388 /* @ECU_Address@FPrm_switches_ext1@0x023A554A@ */ ECIPP_ALIGNMENT_UWORD 65535 Compu_IDENTITY 0 65535 PHYS_UNIT "Enable bits" /end CHARACTERISTIC
/begin CHARACTERISTIC FPsw_ext1_ECT_EGRT_dT_max "FPrm_switches_ext1(670)" VALUE 0x0014737A /* @ECU_Address@FPrm_switches_ext1@0x023A553C@ */ ECIPP_ALIGNMENT_UWORD 65535 Compu_IDENTITY 0 65535 PHYS_UNIT "Enable bits" /end CHARACTERISTIC
/begin CHARACTERISTIC FPsw_ext1_ECT_EGT_dT_max "FPrm_switches_ext1(673)" VALUE 0x00147380 /* @ECU_Address@FPrm_switches_ext1@0x023A5542@ */ ECIPP_ALIGNMENT_UWORD 65535 Compu_IDENTITY 0 65535 PHYS_UNIT "Enable bits" /end CHARACTERISTIC
/begin CHARACTERISTIC FPsw_ext1_ECT_FT_dT_max "FPrm_switches_ext1(671)" VALUE 0x0014737C /* @ECU_Address@FPrm_switches_ext1@0x023A553E@ */ ECIPP_ALIGNMENT_UWORD 65535 Compu_IDENTITY 0 65535 PHYS_UNIT "Enable bits" /end CHARACTERISTIC
/begin CHARACTERISTIC FPsw_ext1_ECT_HiExp "FPrm_switches_ext1(4)" VALUE 0x00146E46 /* @ECU_Address@FPrm_switches_ext1@0x023A5008@ */ ECIPP_ALIGNMENT_UWORD 65535 Compu_IDENTITY 0 65535 PHYS_UNIT "Enable bits" /end CHARACTERISTIC
/begin CHARACTERISTIC FPsw_ext1_ECT_HiExp2 "FPrm_switches_ext1(5)" VALUE 0x00146E48 /* @ECU_Address@FPrm_switches_ext1@0x023A500A@ */ ECIPP_ALIGNMENT_UWORD 65535 Compu_IDENTITY 0 65535 PHYS_UNIT "Enable bits" /end CHARACTERISTIC
/begin CHARACTERISTIC FPsw_ext1_ECT_IAT_dT_max "FPrm_switches_ext1(668)" VALUE 0x00147376 /* @ECU_Address@FPrm_switches_ext1@0x023A5538@ */ ECIPP_ALIGNMENT_UWORD 65535 Compu_IDENTITY 0 65535 PHYS_UNIT "Enable bits" /end CHARACTERISTIC
/begin CHARACTERISTIC FPsw_ext1_ECT_LoExp "FPrm_switches_ext1(478)" VALUE 0x001471FA /* @ECU_Address@FPrm_switches_ext1@0x023A53BC@ */ ECIPP_ALIGNMENT_UWORD 65535 Compu_IDENTITY 0 65535 PHYS_UNIT "Enable bits" /end CHARACTERISTIC
/begin CHARACTERISTIC FPsw_ext1_ECT_LoExp2 "FPrm_switches_ext1(479)" VALUE 0x001471FC /* @ECU_Address@FPrm_switches_ext1@0x023A53BE@ */ ECIPP_ALIGNMENT_UWORD 65535 Compu_IDENTITY 0 65535 PHYS_UNIT "Enable bits" /end CHARACTERISTIC
/begin CHARACTERISTIC FPsw_ext1_ECT_maxv "FPrm_switches_ext1(2)" VALUE 0x00146E42 /* @ECU_Address@FPrm_switches_ext1@0x023A5004@ */ ECIPP_ALIGNMENT_UWORD 65535 Compu_IDENTITY 0 65535 PHYS_UNIT "Enable bits" /end CHARACTERISTIC
/begin CHARACTERISTIC FPsw_ext1_ECT_minv "FPrm_switches_ext1(3)" VALUE 0x00146E44 /* @ECU_Address@FPrm_switches_ext1@0x023A5006@ */ ECIPP_ALIGNMENT_UWORD 65535 Compu_IDENTITY 0 65535 PHYS_UNIT "Enable bits" /end CHARACTERISTIC
/begin CHARACTERISTIC FPsw_ext1_ECT_OILT_dT_max "FPrm_switches_ext1(672)" VALUE 0x0014737E /* @ECU_Address@FPrm_switches_ext1@0x023A5540@ */ ECIPP_ALIGNMENT_UWORD 65535 Compu_IDENTITY 0 65535 PHYS_UNIT "Enable bits" /end CHARACTERISTIC
/begin CHARACTERISTIC FPsw_ext1_ECT_TAUX_dT1_max "FPrm_switches_ext1(675)" VALUE 0x00147384 /* @ECU_Address@FPrm_switches_ext1@0x023A5546@ */ ECIPP_ALIGNMENT_UWORD 65535 Compu_IDENTITY 0 65535 PHYS_UNIT "Enable bits" /end CHARACTERISTIC
/begin CHARACTERISTIC FPsw_ext1_ECT_TAUX_dT2_max "FPrm_switches_ext1(676)" VALUE 0x00147386 /* @ECU_Address@FPrm_switches_ext1@0x023A5548@ */ ECIPP_ALIGNMENT_UWORD 65535 Compu_IDENTITY 0 65535 PHYS_UNIT "Enable bits" /end CHARACTERISTIC
/begin CHARACTERISTIC FPsw_ext1_ECT_TIAT_dT_max "FPrm_switches_ext1(674)" VALUE 0x00147382 /* @ECU_Address@FPrm_switches_ext1@0x023A5544@ */ ECIPP_ALIGNMENT_UWORD 65535 Compu_IDENTITY 0 65535 PHYS_UNIT "Enable bits" /end CHARACTERISTIC
/begin CHARACTERISTIC FPsw_ext1_EGO1_open "FPrm_switches_ext1(71)" VALUE 0x00146ECC /* @ECU_Address@FPrm_switches_ext1@0x023A508E@ */ ECIPP_ALIGNMENT_UWORD 65535 Compu_IDENTITY 0 65535 PHYS_UNIT "Enable bits" /end CHARACTERISTIC
/begin CHARACTERISTIC FPsw_ext1_EGO2_open "FPrm_switches_ext1(100)" VALUE 0x00146F06 /* @ECU_Address@FPrm_switches_ext1@0x023A50C8@ */ ECIPP_ALIGNMENT_UWORD 65535 Compu_IDENTITY 0 65535 PHYS_UNIT "Enable bits" /end CHARACTERISTIC
/begin CHARACTERISTIC FPsw_ext1_EGO3_open "FPrm_switches_ext1(72)" VALUE 0x00146ECE /* @ECU_Address@FPrm_switches_ext1@0x023A5090@ */ ECIPP_ALIGNMENT_UWORD 65535 Compu_IDENTITY 0 65535 PHYS_UNIT "Enable bits" /end CHARACTERISTIC
/begin CHARACTERISTIC FPsw_ext1_EGOH1_off_open "FPrm_switches_ext1(230)" VALUE 0x0014700A /* @ECU_Address@FPrm_switches_ext1@0x023A51CC@ */ ECIPP_ALIGNMENT_UWORD 65535 Compu_IDENTITY 0 65535 PHYS_UNIT "Enable bits" /end CHARACTERISTIC
/begin CHARACTERISTIC FPsw_ext1_EGOH1_on_short "FPrm_switches_ext1(231)" VALUE 0x0014700C /* @ECU_Address@FPrm_switches_ext1@0x023A51CE@ */ ECIPP_ALIGNMENT_UWORD 65535 Compu_IDENTITY 0 65535 PHYS_UNIT "Enable bits" /end CHARACTERISTIC
/begin CHARACTERISTIC FPsw_ext1_EGOH2_off_open "FPrm_switches_ext1(232)" VALUE 0x0014700E /* @ECU_Address@FPrm_switches_ext1@0x023A51D0@ */ ECIPP_ALIGNMENT_UWORD 65535 Compu_IDENTITY 0 65535 PHYS_UNIT "Enable bits" /end CHARACTERISTIC
/begin CHARACTERISTIC FPsw_ext1_EGOH2_on_short "FPrm_switches_ext1(233)" VALUE 0x00147010 /* @ECU_Address@FPrm_switches_ext1@0x023A51D2@ */ ECIPP_ALIGNMENT_UWORD 65535 Compu_IDENTITY 0 65535 PHYS_UNIT "Enable bits" /end CHARACTERISTIC
/begin CHARACTERISTIC FPsw_ext1_EGOH3_off_open "FPrm_switches_ext1(234)" VALUE 0x00147012 /* @ECU_Address@FPrm_switches_ext1@0x023A51D4@ */ ECIPP_ALIGNMENT_UWORD 65535 Compu_IDENTITY 0 65535 PHYS_UNIT "Enable bits" /end CHARACTERISTIC
/begin CHARACTERISTIC FPsw_ext1_EGOH3_on_short "FPrm_switches_ext1(235)" VALUE 0x00147014 /* @ECU_Address@FPrm_switches_ext1@0x023A51D6@ */ ECIPP_ALIGNMENT_UWORD 65535 Compu_IDENTITY 0 65535 PHYS_UNIT "Enable bits" /end CHARACTERISTIC
/begin CHARACTERISTIC FPsw_ext1_EGOH4_off_open "FPrm_switches_ext1(236)" VALUE 0x00147016 /* @ECU_Address@FPrm_switches_ext1@0x023A51D8@ */ ECIPP_ALIGNMENT_UWORD 65535 Compu_IDENTITY 0 65535 PHYS_UNIT "Enable bits" /end CHARACTERISTIC
/begin CHARACTERISTIC FPsw_ext1_EGOH4_on_short "FPrm_switches_ext1(237)" VALUE 0x00147018 /* @ECU_Address@FPrm_switches_ext1@0x023A51DA@ */ ECIPP_ALIGNMENT_UWORD 65535 Compu_IDENTITY 0 65535 PHYS_UNIT "Enable bits" /end CHARACTERISTIC
/begin CHARACTERISTIC FPsw_ext1_EGR_clr_eta_lo "FPrm_switches_ext1(496)" VALUE 0x0014721E /* @ECU_Address@FPrm_switches_ext1@0x023A53E0@ */ ECIPP_ALIGNMENT_UWORD 65535 Compu_IDENTITY 0 65535 PHYS_UNIT "Enable bits" /end CHARACTERISTIC
/begin CHARACTERISTIC FPsw_ext1_EGR_clr_eta_lo2 "FPrm_switches_ext1(515)" VALUE 0x00147244 /* @ECU_Address@FPrm_switches_ext1@0x023A5406@ */ ECIPP_ALIGNMENT_UWORD 65535 Compu_IDENTITY 0 65535 PHYS_UNIT "Enable bits" /end CHARACTERISTIC
/begin CHARACTERISTIC FPsw_ext1_EGR_deice_excess "FPrm_switches_ext1(656)" VALUE 0x0014735E /* @ECU_Address@FPrm_switches_ext1@0x023A5520@ */ ECIPP_ALIGNMENT_UWORD 65535 Compu_IDENTITY 0 65535 PHYS_UNIT "Enable bits" /end CHARACTERISTIC
/begin CHARACTERISTIC FPsw_ext1_EGR_offmin_excess "FPrm_switches_ext1(495)" VALUE 0x0014721C /* @ECU_Address@FPrm_switches_ext1@0x023A53DE@ */ ECIPP_ALIGNMENT_UWORD 65535 Compu_IDENTITY 0 65535 PHYS_UNIT "Enable bits" /end CHARACTERISTIC
/begin CHARACTERISTIC FPsw_ext1_EGR_OOA_hi "FPrm_switches_ext1(491)" VALUE 0x00147214 /* @ECU_Address@FPrm_switches_ext1@0x023A53D6@ */ ECIPP_ALIGNMENT_UWORD 65535 Compu_IDENTITY 0 65535 PHYS_UNIT "Enable bits" /end CHARACTERISTIC
/begin CHARACTERISTIC FPsw_ext1_EGR_OOA_lo "FPrm_switches_ext1(492)" VALUE 0x00147216 /* @ECU_Address@FPrm_switches_ext1@0x023A53D8@ */ ECIPP_ALIGNMENT_UWORD 65535 Compu_IDENTITY 0 65535 PHYS_UNIT "Enable bits" /end CHARACTERISTIC
/begin CHARACTERISTIC FCdtc_CATout_OOR "FCtl_DTC(831)" VALUE 0x00163B92 /* @ECU_Address@FCtl_DTC@0x021B567E@ */ ECIPP_ALIGNMENT_UWORD 65535 Compu_IDENTITY 0 65535 PHYS_UNIT "DTC" /end CHARACTERISTIC
/begin CHARACTERISTIC FCdtc_CFV_FP_minv "FCtl_DTC(687)" VALUE 0x00163A72 /* @ECU_Address@FCtl_DTC@0x021B555E@ */ ECIPP_ALIGNMENT_UWORD 65535 Compu_IDENTITY 0 65535 PHYS_UNIT "DTC" /end CHARACTERISTIC
/begin CHARACTERISTIC FCdtc_CFV_FT_maxv "FCtl_DTC(688)" VALUE 0x00163A74 /* @ECU_Address@FCtl_DTC@0x021B5560@ */ ECIPP_ALIGNMENT_UWORD 65535 Compu_IDENTITY 0 65535 PHYS_UNIT "DTC" /end CHARACTERISTIC
/begin CHARACTERISTIC FCdtc_CFV_FT_minv "FCtl_DTC(689)" VALUE 0x00163A76 /* @ECU_Address@FCtl_DTC@0x021B5562@ */ ECIPP_ALIGNMENT_UWORD 65535 Compu_IDENTITY 0 65535 PHYS_UNIT "DTC" /end CHARACTERISTIC
/begin CHARACTERISTIC FCdtc_CFV_mdot_hi "FCtl_DTC(523)" VALUE 0x0016392A /* @ECU_Address@FCtl_DTC@0x021B5416@ */ ECIPP_ALIGNMENT_UWORD 65535 Compu_IDENTITY 0 65535 PHYS_UNIT "DTC" /end CHARACTERISTIC
/begin CHARACTERISTIC FCdtc_CFV_mdot_lo "FCtl_DTC(524)" VALUE 0x0016392C /* @ECU_Address@FCtl_DTC@0x021B5418@ */ ECIPP_ALIGNMENT_UWORD 65535 Compu_IDENTITY 0 65535 PHYS_UNIT "DTC" /end CHARACTERISTIC
/begin CHARACTERISTIC FCdtc_CFV_mdot_rms_hi "FCtl_DTC(679)" VALUE 0x00163A62 /* @ECU_Address@FCtl_DTC@0x021B554E@ */ ECIPP_ALIGNMENT_UWORD 65535 Compu_IDENTITY 0 65535 PHYS_UNIT "DTC" /end CHARACTERISTIC
/begin CHARACTERISTIC FCdtc_CFV_pwr_loss "FCtl_DTC(830)" VALUE 0x00163B90 /* @ECU_Address@FCtl_DTC@0x021B567C@ */ ECIPP_ALIGNMENT_UWORD 65535 Compu_IDENTITY 0 65535 PHYS_UNIT "DTC" /end CHARACTERISTIC
/begin CHARACTERISTIC FCdtc_CFV_RLV_fail "FCtl_DTC(535)" VALUE 0x00163942 /* @ECU_Address@FCtl_DTC@0x021B542E@ */ ECIPP_ALIGNMENT_UWORD 65535 Compu_IDENTITY 0 65535 PHYS_UNIT "DTC" /end CHARACTERISTIC
/begin CHARACTERISTIC FCdtc_CFV_RLV_P_min "FCtl_DTC(534)" VALUE 0x00163940 /* @ECU_Address@FCtl_DTC@0x021B542C@ */ ECIPP_ALIGNMENT_UWORD 65535 Compu_IDENTITY 0 65535 PHYS_UNIT "DTC" /end CHARACTERISTIC
/begin CHARACTERISTIC FCdtc_CHT_HiExp "FCtl_DTC(114)" VALUE 0x001635F8 /* @ECU_Address@FCtl_DTC@0x021B50E4@ */ ECIPP_ALIGNMENT_UWORD 65535 Compu_IDENTITY 0 65535 PHYS_UNIT "DTC" /end CHARACTERISTIC
/begin CHARACTERISTIC FCdtc_CHT_HiExp2 "FCtl_DTC(115)" VALUE 0x001635FA /* @ECU_Address@FCtl_DTC@0x021B50E6@ */ ECIPP_ALIGNMENT_UWORD 65535 Compu_IDENTITY 0 65535 PHYS_UNIT "DTC" /end CHARACTERISTIC
/begin CHARACTERISTIC FCdtc_CL_hi "FCtl_DTC(32)" VALUE 0x00163554 /* @ECU_Address@FCtl_DTC@0x021B5040@ */ ECIPP_ALIGNMENT_UWORD 65535 Compu_IDENTITY 0 65535 PHYS_UNIT "DTC" /end CHARACTERISTIC
/begin CHARACTERISTIC FCdtc_CL_lo "FCtl_DTC(33)" VALUE 0x00163556 /* @ECU_Address@FCtl_DTC@0x021B5042@ */ ECIPP_ALIGNMENT_UWORD 65535 Compu_IDENTITY 0 65535 PHYS_UNIT "DTC" /end CHARACTERISTIC
/begin CHARACTERISTIC FCdtc_CL_phi_hi "FCtl_DTC(677)" VALUE 0x00163A5E /* @ECU_Address@FCtl_DTC@0x021B554A@ */ ECIPP_ALIGNMENT_UWORD 65535 Compu_IDENTITY 0 65535 PHYS_UNIT "DTC" /end CHARACTERISTIC
/begin CHARACTERISTIC FCdtc_CL_phi_lo "FCtl_DTC(678)" VALUE 0x00163A60 /* @ECU_Address@FCtl_DTC@0x021B554C@ */ ECIPP_ALIGNMENT_UWORD 65535 Compu_IDENTITY 0 65535 PHYS_UNIT "DTC" /end CHARACTERISTIC
/begin CHARACTERISTIC FCdtc_CLLP_hi "FCtl_DTC(36)" VALUE 0x0016355C /* @ECU_Address@FCtl_DTC@0x021B5048@ */ ECIPP_ALIGNMENT_UWORD 65535 Compu_IDENTITY 0 65535 PHYS_UNIT "DTC" /end CHARACTERISTIC
/begin CHARACTERISTIC FCdtc_CLLP_lo "FCtl_DTC(37)" VALUE 0x0016355E /* @ECU_Address@FCtl_DTC@0x021B504A@ */ ECIPP_ALIGNMENT_UWORD 65535 Compu_IDENTITY 0 65535 PHYS_UNIT "DTC" /end CHARACTERISTIC
/begin CHARACTERISTIC FCdtc_CLNG_hi "FCtl_DTC(38)" VALUE 0x00163560 /* @ECU_Address@FCtl_DTC@0x021B504C@ */ ECIPP_ALIGNMENT_UWORD 65535 Compu_IDENTITY 0 65535 PHYS_UNIT "DTC" /end CHARACTERISTIC
/begin CHARACTERISTIC FCdtc_CLNG_lo "FCtl_DTC(39)" VALUE 0x00163562 /* @ECU_Address@FCtl_DTC@0x021B504E@ */ ECIPP_ALIGNMENT_UWORD 65535 Compu_IDENTITY 0 65535 PHYS_UNIT "DTC" /end CHARACTERISTIC
/begin CHARACTERISTIC FCdtc_CM_unresp "FCtl_DTC(799)" VALUE 0x00163B52 /* @ECU_Address@FCtl_DTC@0x021B563E@ */ ECIPP_ALIGNMENT_UWORD 65535 Compu_IDENTITY 0 65535 PHYS_UNIT "DTC" /end CHARACTERISTIC
/begin CHARACTERISTIC FCdtc_CMgsln_inact "FCtl_DTC(130)" VALUE 0x00163618 /* @ECU_Address@FCtl_DTC@0x021B5104@ */ ECIPP_ALIGNMENT_UWORD 65535 Compu_IDENTITY 0 65535 PHYS_UNIT "DTC" /end CHARACTERISTIC
/begin CHARACTERISTIC FCdtc_CMLP_inact "FCtl_DTC(131)" VALUE 0x0016361A /* @ECU_Address@FCtl_DTC@0x021B5106@ */ ECIPP_ALIGNMENT_UWORD 65535 Compu_IDENTITY 0 65535 PHYS_UNIT "DTC" /end CHARACTERISTIC
/begin CHARACTERISTIC FCdtc_CMNG_inact "FCtl_DTC(132)" VALUE 0x0016361C /* @ECU_Address@FCtl_DTC@0x021B5108@ */ ECIPP_ALIGNMENT_UWORD 65535 Compu_IDENTITY 0 65535 PHYS_UNIT "DTC" /end CHARACTERISTIC
/begin CHARACTERISTIC FCdtc_COPfail "FCtl_DTC(99)" VALUE 0x001635DA /* @ECU_Address@FCtl_DTC@0x021B50C6@ */ ECIPP_ALIGNMENT_UWORD 65535 Compu_IDENTITY 0 65535 PHYS_UNIT "DTC" /end CHARACTERISTIC
/begin CHARACTERISTIC FCdtc_COT_hi "FCtl_DTC(657)" VALUE 0x00163A36 /* @ECU_Address@FCtl_DTC@0x021B5522@ */ ECIPP_ALIGNMENT_UWORD 65535 Compu_IDENTITY 0 65535 PHYS_UNIT "DTC" /end CHARACTERISTIC
/begin CHARACTERISTIC FCdtc_crkloss "FCtl_DTC(152)" VALUE 0x00163644 /* @ECU_Address@FCtl_DTC@0x021B5130@ */ ECIPP_ALIGNMENT_UWORD 65535 Compu_IDENTITY 0 65535 PHYS_UNIT "DTC" /end CHARACTERISTIC
/begin CHARACTERISTIC FCdtc_crknever "FCtl_DTC(98)" VALUE 0x001635D8 /* @ECU_Address@FCtl_DTC@0x021B50C4@ */ ECIPP_ALIGNMENT_UWORD 65535 Compu_IDENTITY 0 65535 PHYS_UNIT "DTC" /end CHARACTERISTIC
/begin CHARACTERISTIC FCdtc_crknoise "FCtl_DTC(97)" VALUE 0x001635D6 /* @ECU_Address@FCtl_DTC@0x021B50C2@ */ ECIPP_ALIGNMENT_UWORD 65535 Compu_IDENTITY 0 65535 PHYS_UNIT "DTC" /end CHARACTERISTIC
/begin CHARACTERISTIC FCdtc_CVCS_discon "FCtl_DTC(747)" VALUE 0x00163AEA /* @ECU_Address@FCtl_DTC@0x021B55D6@ */ ECIPP_ALIGNMENT_UWORD 65535 Compu_IDENTITY 0 65535 PHYS_UNIT "DTC" /end CHARACTERISTIC
/begin CHARACTERISTIC FCdtc_CVDS_discon "FCtl_DTC(748)" VALUE 0x00163AEC /* @ECU_Address@FCtl_DTC@0x021B55D8@ */ ECIPP_ALIGNMENT_UWORD 65535 Compu_IDENTITY 0 65535 PHYS_UNIT "DTC" /end CHARACTERISTIC
/begin CHARACTERISTIC FCdtc_CVP1_hi "FCtl_DTC(794)" VALUE 0x00163B48 /* @ECU_Address@FCtl_DTC@0x021B5634@ */ ECIPP_ALIGNMENT_UWORD 65535 Compu_IDENTITY 0 65535 PHYS_UNIT "DTC" /end CHARACTERISTIC
/begin CHARACTERISTIC FCdtc_CVP1_lo "FCtl_DTC(795)" VALUE 0x00163B4A /* @ECU_Address@FCtl_DTC@0x021B5636@ */ ECIPP_ALIGNMENT_UWORD 65535 Compu_IDENTITY 0 65535 PHYS_UNIT "DTC" /end CHARACTERISTIC
/begin CHARACTERISTIC FCdtc_CVP2_hi "FCtl_DTC(796)" VALUE 0x00163B4C /* @ECU_Address@FCtl_DTC@0x021B5638@ */ ECIPP_ALIGNMENT_UWORD 65535 Compu_IDENTITY 0 65535 PHYS_UNIT "DTC" /end CHARACTERISTIC
/begin CHARACTERISTIC FCdtc_CVP2_lo "FCtl_DTC(797)" VALUE 0x00163B4E /* @ECU_Address@FCtl_DTC@0x021B563A@ */ ECIPP_ALIGNMENT_UWORD 65535 Compu_IDENTITY 0 65535 PHYS_UNIT "DTC" /end CHARACTERISTIC
/begin CHARACTERISTIC FCdtc_DBW_I_max "FCtl_DTC(527)" VALUE 0x00163932 /* @ECU_Address@FCtl_DTC@0x021B541E@ */ ECIPP_ALIGNMENT_UWORD 65535 Compu_IDENTITY 0 65535 PHYS_UNIT "DTC" /end CHARACTERISTIC
/begin CHARACTERISTIC FCdtc_ECam_maxerr "FCtl_DTC(289)" VALUE 0x00163756 /* @ECU_Address@FCtl_DTC@0x021B5242@ */ ECIPP_ALIGNMENT_UWORD 65535 Compu_IDENTITY 0 65535 PHYS_UNIT "DTC" /end CHARACTERISTIC
/begin CHARACTERISTIC FCdtc_ECL_low "FCtl_DTC(733)" VALUE 0x00163ACE /* @ECU_Address@FCtl_DTC@0x021B55BA@ */ ECIPP_ALIGNMENT_UWORD 65535 Compu_IDENTITY 0 65535 PHYS_UNIT "DTC" /end CHARACTERISTIC
/begin CHARACTERISTIC FCdtc_ECT_AAT_dT_max "FCtl_DTC(842)" VALUE 0x00163BA8 /* @ECU_Address@FCtl_DTC@0x021B5694@ */ ECIPP_ALIGNMENT_UWORD 65535 Compu_IDENTITY 0 65535 PHYS_UNIT "DTC" /end CHARACTERISTIC
/begin CHARACTERISTIC FCdtc_ECT_derate_actv "FCtl_DTC(828)" VALUE 0x00163B8C /* @ECU_Address@FCtl_DTC@0x021B5678@ */ ECIPP_ALIGNMENT_UWORD 65535 Compu_IDENTITY 0 65535 PHYS_UNIT "DTC" /end CHARACTERISTIC
/begin CHARACTERISTIC FCdtc_ECT_dT_max "FCtl_DTC(850)" VALUE 0x00163BB8 /* @ECU_Address@FCtl_DTC@0x021B56A4@ */ ECIPP_ALIGNMENT_UWORD 65535 Compu_IDENTITY 0 65535 PHYS_UNIT "DTC" /end CHARACTERISTIC
/begin CHARACTERISTIC FCdtc_ECT_EGRT_dT_max "FCtl_DTC(843)" VALUE 0x00163BAA /* @ECU_Address@FCtl_DTC@0x021B5696@ */ ECIPP_ALIGNMENT_UWORD 65535 Compu_IDENTITY 0 65535 PHYS_UNIT "DTC" /end CHARACTERISTIC
/begin CHARACTERISTIC FCdtc_ECT_EGT_dT_max "FCtl_DTC(846)" VALUE 0x00163BB0 /* @ECU_Address@FCtl_DTC@0x021B569C@ */ ECIPP_ALIGNMENT_UWORD 65535 Compu_IDENTITY 0 65535 PHYS_UNIT "DTC" /end CHARACTERISTIC
/begin CHARACTERISTIC FCdtc_ECT_FT_dT_max "FCtl_DTC(844)" VALUE 0x00163BAC /* @ECU_Address@FCtl_DTC@0x021B5698@ */ ECIPP_ALIGNMENT_UWORD 65535 Compu_IDENTITY 0 65535 PHYS_UNIT "DTC" /end CHARACTERISTIC
/begin CHARACTERISTIC FCdtc_ECT_HiExp "FCtl_DTC(4)" VALUE 0x0016351C /* @ECU_Address@FCtl_DTC@0x021B5008@ */ ECIPP_ALIGNMENT_UWORD 65535 Compu_IDENTITY 0 65535 PHYS_UNIT "DTC" /end CHARACTERISTIC
/begin CHARACTERISTIC FCdtc_ECT_HiExp2 "FCtl_DTC(86)" VALUE 0x001635C0 /* @ECU_Address@FCtl_DTC@0x021B50AC@ */ ECIPP_ALIGNMENT_UWORD 65535 Compu_IDENTITY 0 65535 PHYS_UNIT "DTC" /end CHARACTERISTIC
/begin CHARACTERISTIC FCdtc_ECT_IAT_dT_max "FCtl_DTC(841)" VALUE 0x00163BA6 /* @ECU_Address@FCtl_DTC@0x021B5692@ */ ECIPP_ALIGNMENT_UWORD 65535 Compu_IDENTITY 0 65535 PHYS_UNIT "DTC" /end CHARACTERISTIC
/begin CHARACTERISTIC FCdtc_ECT_LoExp "FCtl_DTC(648)" VALUE 0x00163A24 /* @ECU_Address@FCtl_DTC@0x021B5510@ */ ECIPP_ALIGNMENT_UWORD 65535 Compu_IDENTITY 0 65535 PHYS_UNIT "DTC" /end CHARACTERISTIC
/begin CHARACTERISTIC FCdtc_ECT_LoExp2 "FCtl_DTC(649)" VALUE 0x00163A26 /* @ECU_Address@FCtl_DTC@0x021B5512@ */ ECIPP_ALIGNMENT_UWORD 65535 Compu_IDENTITY 0 65535 PHYS_UNIT "DTC" /end CHARACTERISTIC
/begin CHARACTERISTIC FCdtc_ECT_maxv "FCtl_DTC(2)" VALUE 0x00163518 /* @ECU_Address@FCtl_DTC@0x021B5004@ */ ECIPP_ALIGNMENT_UWORD 65535 Compu_IDENTITY 0 65535 PHYS_UNIT "DTC" /end CHARACTERISTIC
/begin CHARACTERISTIC FCdtc_ECT_minv "FCtl_DTC(3)" VALUE 0x0016351A /* @ECU_Address@FCtl_DTC@0x021B5006@ */ ECIPP_ALIGNMENT_UWORD 65535 Compu_IDENTITY 0 65535 PHYS_UNIT "DTC" /end CHARACTERISTIC
/begin CHARACTERISTIC FCdtc_ECT_OILT_dT_max "FCtl_DTC(845)" VALUE 0x00163BAE /* @ECU_Address@FCtl_DTC@0x021B569A@ */ ECIPP_ALIGNMENT_UWORD 65535 Compu_IDENTITY 0 65535 PHYS_UNIT "DTC" /end CHARACTERISTIC
/begin CHARACTERISTIC FCdtc_ECT_TAUX_dT1_max "FCtl_DTC(848)" VALUE 0x00163BB4 /* @ECU_Address@FCtl_DTC@0x021B56A0@ */ ECIPP_ALIGNMENT_UWORD 65535 Compu_IDENTITY 0 65535 PHYS_UNIT "DTC" /end CHARACTERISTIC
/begin CHARACTERISTIC FCdtc_ECT_TAUX_dT2_max "FCtl_DTC(849)" VALUE 0x00163BB6 /* @ECU_Address@FCtl_DTC@0x021B56A2@ */ ECIPP_ALIGNMENT_UWORD 65535 Compu_IDENTITY 0 65535 PHYS_UNIT "DTC" /end CHARACTERISTIC
/begin CHARACTERISTIC FCdtc_ECT_TIAT_dT_max "FCtl_DTC(847)" VALUE 0x00163BB2 /* @ECU_Address@FCtl_DTC@0x021B569E@ */ ECIPP_ALIGNMENT_UWORD 65535 Compu_IDENTITY 0 65535 PHYS_UNIT "DTC" /end CHARACTERISTIC
/begin CHARACTERISTIC FCdtc_EGO1_open "FCtl_DTC(111)" VALUE 0x001635F2 /* @ECU_Address@FCtl_DTC@0x021B50DE@ */ ECIPP_ALIGNMENT_UWORD 65535 Compu_IDENTITY 0 65535 PHYS_UNIT "DTC" /end CHARACTERISTIC
/begin CHARACTERISTIC FCdtc_EGO2_open "FCtl_DTC(112)" VALUE 0x001635F4 /* @ECU_Address@FCtl_DTC@0x021B50E0@ */ ECIPP_ALIGNMENT_UWORD 65535 Compu_IDENTITY 0 65535 PHYS_UNIT "DTC" /end CHARACTERISTIC
/begin CHARACTERISTIC FCdtc_EGO3_open "FCtl_DTC(113)" VALUE 0x001635F6 /* @ECU_Address@FCtl_DTC@0x021B50E2@ */ ECIPP_ALIGNMENT_UWORD 65535 Compu_IDENTITY 0 65535 PHYS_UNIT "DTC" /end CHARACTERISTIC
/begin CHARACTERISTIC FCdtc_EGOH1_off_open "FCtl_DTC(321)" VALUE 0x00163796 /* @ECU_Address@FCtl_DTC@0x021B5282@ */ ECIPP_ALIGNMENT_UWORD 65535 Compu_IDENTITY 0 65535 PHYS_UNIT "DTC" /end CHARACTERISTIC
/begin CHARACTERISTIC FCdtc_EGOH1_on_short "FCtl_DTC(322)" VALUE 0x00163798 /* @ECU_Address@FCtl_DTC@0x021B5284@ */ ECIPP_ALIGNMENT_UWORD 65535 Compu_IDENTITY 0 65535 PHYS_UNIT "DTC" /end CHARACTERISTIC
/begin CHARACTERISTIC FCdtc_EGOH2_off_open "FCtl_DTC(323)" VALUE 0x0016379A /* @ECU_Address@FCtl_DTC@0x021B5286@ */ ECIPP_ALIGNMENT_UWORD 65535 Compu_IDENTITY 0 65535 PHYS_UNIT "DTC" /end CHARACTERISTIC
/begin CHARACTERISTIC FCdtc_EGOH2_on_short "FCtl_DTC(324)" VALUE 0x0016379C /* @ECU_Address@FCtl_DTC@0x021B5288@ */ ECIPP_ALIGNMENT_UWORD 65535 Compu_IDENTITY 0 65535 PHYS_UNIT "DTC" /end CHARACTERISTIC
/begin CHARACTERISTIC FCdtc_EGOH3_off_open "FCtl_DTC(325)" VALUE 0x0016379E /* @ECU_Address@FCtl_DTC@0x021B528A@ */ ECIPP_ALIGNMENT_UWORD 65535 Compu_IDENTITY 0 65535 PHYS_UNIT "DTC" /end CHARACTERISTIC
/begin CHARACTERISTIC FCdtc_EGOH3_on_short "FCtl_DTC(326)" VALUE 0x001637A0 /* @ECU_Address@FCtl_DTC@0x021B528C@ */ ECIPP_ALIGNMENT_UWORD 65535 Compu_IDENTITY 0 65535 PHYS_UNIT "DTC" /end CHARACTERISTIC
/begin CHARACTERISTIC FCdtc_EGOH4_off_open "FCtl_DTC(327)" VALUE 0x001637A2 /* @ECU_Address@FCtl_DTC@0x021B528E@ */ ECIPP_ALIGNMENT_UWORD 65535 Compu_IDENTITY 0 65535 PHYS_UNIT "DTC" /end CHARACTERISTIC
/begin CHARACTERISTIC FCdtc_EGOH4_on_short "FCtl_DTC(328)" VALUE 0x001637A4 /* @ECU_Address@FCtl_DTC@0x021B5290@ */ ECIPP_ALIGNMENT_UWORD 65535 Compu_IDENTITY 0 65535 PHYS_UNIT "DTC" /end CHARACTERISTIC
/begin CHARACTERISTIC FCdtc_EGR_clr_eta_lo "FCtl_DTC(666)" VALUE 0x00163A48 /* @ECU_Address@FCtl_DTC@0x021B5534@ */ ECIPP_ALIGNMENT_UWORD 65535 Compu_IDENTITY 0 65535 PHYS_UNIT "DTC" /end CHARACTERISTIC
/begin CHARACTERISTIC FCdtc_EGR_clr_eta_lo2 "FCtl_DTC(685)" VALUE 0x00163A6E /* @ECU_Address@FCtl_DTC@0x021B555A@ */ ECIPP_ALIGNMENT_UWORD 65535 Compu_IDENTITY 0 65535 PHYS_UNIT "DTC" /end CHARACTERISTIC
/begin CHARACTERISTIC FCdtc_EGR_deice_excess "FCtl_DTC(829)" VALUE 0x00163B8E /* @ECU_Address@FCtl_DTC@0x021B567A@ */ ECIPP_ALIGNMENT_UWORD 65535 Compu_IDENTITY 0 65535 PHYS_UNIT "DTC" /end CHARACTERISTIC
/begin CHARACTERISTIC FCdtc_EGR_offmin_excess "FCtl_DTC(665)" VALUE 0x00163A46 /* @ECU_Address@FCtl_DTC@0x021B5532@ */ ECIPP_ALIGNMENT_UWORD 65535 Compu_IDENTITY 0 65535 PHYS_UNIT "DTC" /end CHARACTERISTIC
/begin CHARACTERISTIC FCdtc_EGR_OOA_hi "FCtl_DTC(661)" VALUE 0x00163A3E /* @ECU_Address@FCtl_DTC@0x021B552A@ */ ECIPP_ALIGNMENT_UWORD 65535 Compu_IDENTITY 0 65535 PHYS_UNIT "DTC" /end CHARACTERISTIC
/begin CHARACTERISTIC FCdtc_EGR_OOA_lo "FCtl_DTC(662)" VALUE 0x00163A40 /* @ECU_Address@FCtl_DTC@0x021B552C@ */ ECIPP_ALIGNMENT_UWORD 65535 Compu_IDENTITY 0 65535 PHYS_UNIT "DTC" /end CHARACTERISTIC
/begin CHARACTERISTIC FCfmi_CATout_OOR "FCtl_FMI(831)" VALUE 0x00165452 /* @ECU_Address@FCtl_FMI@0x021B733F@ */ ECIPP_ALIGNMENT_UBYTE 255 Compu_IDENTITY 0 255 PHYS_UNIT "FMI" /end CHARACTERISTIC
/begin CHARACTERISTIC FCfmi_CFV_FP_minv "FCtl_FMI(687)" VALUE 0x001653C2 /* @ECU_Address@FCtl_FMI@0x021B72AF@ */ ECIPP_ALIGNMENT_UBYTE 255 Compu_IDENTITY 0 255 PHYS_UNIT "FMI" /end CHARACTERISTIC
/begin CHARACTERISTIC FCfmi_CFV_FT_maxv "FCtl_FMI(688)" VALUE 0x001653C3 /* @ECU_Address@FCtl_FMI@0x021B72B0@ */ ECIPP_ALIGNMENT_UBYTE 255 Compu_IDENTITY 0 255 PHYS_UNIT "FMI" /end CHARACTERISTIC
/begin CHARACTERISTIC FCfmi_CFV_FT_minv "FCtl_FMI(689)" VALUE 0x001653C4 /* @ECU_Address@FCtl_FMI@0x021B72B1@ */ ECIPP_ALIGNMENT_UBYTE 255 Compu_IDENTITY 0 255 PHYS_UNIT "FMI" /end CHARACTERISTIC
/begin CHARACTERISTIC FCfmi_CFV_mdot_hi "FCtl_FMI(523)" VALUE 0x0016531E /* @ECU_Address@FCtl_FMI@0x021B720B@ */ ECIPP_ALIGNMENT_UBYTE 255 Compu_IDENTITY 0 255 PHYS_UNIT "FMI" /end CHARACTERISTIC
/begin CHARACTERISTIC FCfmi_CFV_mdot_lo "FCtl_FMI(524)" VALUE 0x0016531F /* @ECU_Address@FCtl_FMI@0x021B720C@ */ ECIPP_ALIGNMENT_UBYTE 255 Compu_IDENTITY 0 255 PHYS_UNIT "FMI" /end CHARACTERISTIC
/begin CHARACTERISTIC FCfmi_CFV_mdot_rms_hi "FCtl_FMI(679)" VALUE 0x001653BA /* @ECU_Address@FCtl_FMI@0x021B72A7@ */ ECIPP_ALIGNMENT_UBYTE 255 Compu_IDENTITY 0 255 PHYS_UNIT "FMI" /end CHARACTERISTIC
/begin CHARACTERISTIC FCfmi_CFV_pwr_loss "FCtl_FMI(830)" VALUE 0x00165451 /* @ECU_Address@FCtl_FMI@0x021B733E@ */ ECIPP_ALIGNMENT_UBYTE 255 Compu_IDENTITY 0 255 PHYS_UNIT "FMI" /end CHARACTERISTIC
/begin CHARACTERISTIC FCfmi_CFV_RLV_fail "FCtl_FMI(535)" VALUE 0x0016532A /* @ECU_Address@FCtl_FMI@0x021B7217@ */ ECIPP_ALIGNMENT_UBYTE 255 Compu_IDENTITY 0 255 PHYS_UNIT "FMI" /end CHARACTERISTIC
/begin CHARACTERISTIC FCfmi_CFV_RLV_P_min "FCtl_FMI(534)" VALUE 0x00165329 /* @ECU_Address@FCtl_FMI@0x021B7216@ */ ECIPP_ALIGNMENT_UBYTE 255 Compu_IDENTITY 0 255 PHYS_UNIT "FMI" /end CHARACTERISTIC
/begin CHARACTERISTIC FCfmi_CHT_HiExp "FCtl_FMI(114)" VALUE 0x00165185 /* @ECU_Address@FCtl_FMI@0x021B7072@ */ ECIPP_ALIGNMENT_UBYTE 255 Compu_IDENTITY 0 255 PHYS_UNIT "FMI" /end CHARACTERISTIC
/begin CHARACTERISTIC FCfmi_CHT_HiExp2 "FCtl_FMI(115)" VALUE 0x00165186 /* @ECU_Address@FCtl_FMI@0x021B7073@ */ ECIPP_ALIGNMENT_UBYTE 255 Compu_IDENTITY 0 255 PHYS_UNIT "FMI" /end CHARACTERISTIC
/begin CHARACTERISTIC FCfmi_CL_hi "FCtl_FMI(32)" VALUE 0x00165133 /* @ECU_Address@FCtl_FMI@0x021B7020@ */ ECIPP_ALIGNMENT_UBYTE 255 Compu_IDENTITY 0 255 PHYS_UNIT "FMI" /end CHARACTERISTIC
/begin CHARACTERISTIC FCfmi_CL_lo "FCtl_FMI(33)" VALUE 0x00165134 /* @ECU_Address@FCtl_FMI@0x021B7021@ */ ECIPP_ALIGNMENT_UBYTE 255 Compu_IDENTITY 0 255 PHYS_UNIT "FMI" /end CHARACTERISTIC
/begin CHARACTERISTIC FCfmi_CL_phi_hi "FCtl_FMI(677)" VALUE 0x001653B8 /* @ECU_Address@FCtl_FMI@0x021B72A5@ */ ECIPP_ALIGNMENT_UBYTE 255 Compu_IDENTITY 0 255 PHYS_UNIT "FMI" /end CHARACTERISTIC
/begin CHARACTERISTIC FCfmi_CL_phi_lo "FCtl_FMI(678)" VALUE 0x001653B9 /* @ECU_Address@FCtl_FMI@0x021B72A6@ */ ECIPP_ALIGNMENT_UBYTE 255 Compu_IDENTITY 0 255 PHYS_UNIT "FMI" /end CHARACTERISTIC
/begin CHARACTERISTIC FCfmi_CLLP_hi "FCtl_FMI(36)" VALUE 0x00165137 /* @ECU_Address@FCtl_FMI@0x021B7024@ */ ECIPP_ALIGNMENT_UBYTE 255 Compu_IDENTITY 0 255 PHYS_UNIT "FMI" /end CHARACTERISTIC
/begin CHARACTERISTIC FCfmi_CLLP_lo "FCtl_FMI(37)" VALUE 0x00165138 /* @ECU_Address@FCtl_FMI@0x021B7025@ */ ECIPP_ALIGNMENT_UBYTE 255 Compu_IDENTITY 0 255 PHYS_UNIT "FMI" /end CHARACTERISTIC
/begin CHARACTERISTIC FCfmi_CLNG_hi "FCtl_FMI(38)" VALUE 0x00165139 /* @ECU_Address@FCtl_FMI@0x021B7026@ */ ECIPP_ALIGNMENT_UBYTE 255 Compu_IDENTITY 0 255 PHYS_UNIT "FMI" /end CHARACTERISTIC
/begin CHARACTERISTIC FCfmi_CLNG_lo "FCtl_FMI(39)" VALUE 0x0016513A /* @ECU_Address@FCtl_FMI@0x021B7027@ */ ECIPP_ALIGNMENT_UBYTE 255 Compu_IDENTITY 0 255 PHYS_UNIT "FMI" /end CHARACTERISTIC
/begin CHARACTERISTIC FCfmi_CM_unresp "FCtl_FMI(799)" VALUE 0x00165432 /* @ECU_Address@FCtl_FMI@0x021B731F@ */ ECIPP_ALIGNMENT_UBYTE 255 Compu_IDENTITY 0 255 PHYS_UNIT "FMI" /end CHARACTERISTIC
/begin CHARACTERISTIC FCfmi_CMgsln_inact "FCtl_FMI(130)" VALUE 0x00165195 /* @ECU_Address@FCtl_FMI@0x021B7082@ */ ECIPP_ALIGNMENT_UBYTE 255 Compu_IDENTITY 0 255 PHYS_UNIT "FMI" /end CHARACTERISTIC
/begin CHARACTERISTIC FCfmi_CMLP_inact "FCtl_FMI(131)" VALUE 0x00165196 /* @ECU_Address@FCtl_FMI@0x021B7083@ */ ECIPP_ALIGNMENT_UBYTE 255 Compu_IDENTITY 0 255 PHYS_UNIT "FMI" /end CHARACTERISTIC
/begin CHARACTERISTIC FCfmi_CMNG_inact "FCtl_FMI(132)" VALUE 0x00165197 /* @ECU_Address@FCtl_FMI@0x021B7084@ */ ECIPP_ALIGNMENT_UBYTE 255 Compu_IDENTITY 0 255 PHYS_UNIT "FMI" /end CHARACTERISTIC
/begin CHARACTERISTIC FCfmi_COPfail "FCtl_FMI(99)" VALUE 0x00165176 /* @ECU_Address@FCtl_FMI@0x021B7063@ */ ECIPP_ALIGNMENT_UBYTE 255 Compu_IDENTITY 0 255 PHYS_UNIT "FMI" /end CHARACTERISTIC
/begin CHARACTERISTIC FCfmi_COT_hi "FCtl_FMI(657)" VALUE 0x001653A4 /* @ECU_Address@FCtl_FMI@0x021B7291@ */ ECIPP_ALIGNMENT_UBYTE 255 Compu_IDENTITY 0 255 PHYS_UNIT "FMI" /end CHARACTERISTIC
/begin CHARACTERISTIC FCfmi_crkloss "FCtl_FMI(152)" VALUE 0x001651AB /* @ECU_Address@FCtl_FMI@0x021B7098@ */ ECIPP_ALIGNMENT_UBYTE 255 Compu_IDENTITY 0 255 PHYS_UNIT "FMI" /end CHARACTERISTIC
/begin CHARACTERISTIC FCfmi_crknever "FCtl_FMI(98)" VALUE 0x00165175 /* @ECU_Address@FCtl_FMI@0x021B7062@ */ ECIPP_ALIGNMENT_UBYTE 255 Compu_IDENTITY 0 255 PHYS_UNIT "FMI" /end CHARACTERISTIC
/begin CHARACTERISTIC FCfmi_crknoise "FCtl_FMI(97)" VALUE 0x00165174 /* @ECU_Address@FCtl_FMI@0x021B7061@ */ ECIPP_ALIGNMENT_UBYTE 255 Compu_IDENTITY 0 255 PHYS_UNIT "FMI" /end CHARACTERISTIC
/begin CHARACTERISTIC FCfmi_CVCS_discon "FCtl_FMI(747)" VALUE 0x001653FE /* @ECU_Address@FCtl_FMI@0x021B72EB@ */ ECIPP_ALIGNMENT_UBYTE 255 Compu_IDENTITY 0 255 PHYS_UNIT "FMI" /end CHARACTERISTIC
/begin CHARACTERISTIC FCfmi_CVDS_discon "FCtl_FMI(748)" VALUE 0x001653FF /* @ECU_Address@FCtl_FMI@0x021B72EC@ */ ECIPP_ALIGNMENT_UBYTE 255 Compu_IDENTITY 0 255 PHYS_UNIT "FMI" /end CHARACTERISTIC
/begin CHARACTERISTIC FCfmi_CVP1_hi "FCtl_FMI(794)" VALUE 0x0016542D /* @ECU_Address@FCtl_FMI@0x021B731A@ */ ECIPP_ALIGNMENT_UBYTE 255 Compu_IDENTITY 0 255 PHYS_UNIT "FMI" /end CHARACTERISTIC
/begin CHARACTERISTIC FCfmi_CVP1_lo "FCtl_FMI(795)" VALUE 0x0016542E /* @ECU_Address@FCtl_FMI@0x021B731B@ */ ECIPP_ALIGNMENT_UBYTE 255 Compu_IDENTITY 0 255 PHYS_UNIT "FMI" /end CHARACTERISTIC
/begin CHARACTERISTIC FCfmi_CVP2_hi "FCtl_FMI(796)" VALUE 0x0016542F /* @ECU_Address@FCtl_FMI@0x021B731C@ */ ECIPP_ALIGNMENT_UBYTE 255 Compu_IDENTITY 0 255 PHYS_UNIT "FMI" /end CHARACTERISTIC
/begin CHARACTERISTIC FCfmi_CVP2_lo "FCtl_FMI(797)" VALUE 0x00165430 /* @ECU_Address@FCtl_FMI@0x021B731D@ */ ECIPP_ALIGNMENT_UBYTE 255 Compu_IDENTITY 0 255 PHYS_UNIT "FMI" /end CHARACTERISTIC
/begin CHARACTERISTIC FCfmi_DBW_I_max "FCtl_FMI(527)" VALUE 0x00165322 /* @ECU_Address@FCtl_FMI@0x021B720F@ */ ECIPP_ALIGNMENT_UBYTE 255 Compu_IDENTITY 0 255 PHYS_UNIT "FMI" /end CHARACTERISTIC
/begin CHARACTERISTIC FCfmi_ECam_maxerr "FCtl_FMI(289)" VALUE 0x00165234 /* @ECU_Address@FCtl_FMI@0x021B7121@ */ ECIPP_ALIGNMENT_UBYTE 255 Compu_IDENTITY 0 255 PHYS_UNIT "FMI" /end CHARACTERISTIC
/begin CHARACTERISTIC FCfmi_ECL_low "FCtl_FMI(733)" VALUE 0x001653F0 /* @ECU_Address@FCtl_FMI@0x021B72DD@ */ ECIPP_ALIGNMENT_UBYTE 255 Compu_IDENTITY 0 255 PHYS_UNIT "FMI" /end CHARACTERISTIC
/begin CHARACTERISTIC FCfmi_ECT_AAT_dT_max "FCtl_FMI(842)" VALUE 0x0016545D /* @ECU_Address@FCtl_FMI@0x021B734A@ */ ECIPP_ALIGNMENT_UBYTE 255 Compu_IDENTITY 0 255 PHYS_UNIT "FMI" /end CHARACTERISTIC
/begin CHARACTERISTIC FCfmi_ECT_derate_actv "FCtl_FMI(828)" VALUE 0x0016544F /* @ECU_Address@FCtl_FMI@0x021B733C@ */ ECIPP_ALIGNMENT_UBYTE 255 Compu_IDENTITY 0 255 PHYS_UNIT "FMI" /end CHARACTERISTIC
/begin CHARACTERISTIC FCfmi_ECT_dT_max "FCtl_FMI(850)" VALUE 0x00165465 /* @ECU_Address@FCtl_FMI@0x021B7352@ */ ECIPP_ALIGNMENT_UBYTE 255 Compu_IDENTITY 0 255 PHYS_UNIT "FMI" /end CHARACTERISTIC
/begin CHARACTERISTIC FCfmi_ECT_EGRT_dT_max "FCtl_FMI(843)" VALUE 0x0016545E /* @ECU_Address@FCtl_FMI@0x021B734B@ */ ECIPP_ALIGNMENT_UBYTE 255 Compu_IDENTITY 0 255 PHYS_UNIT "FMI" /end CHARACTERISTIC
/begin CHARACTERISTIC FCfmi_ECT_EGT_dT_max "FCtl_FMI(846)" VALUE 0x00165461 /* @ECU_Address@FCtl_FMI@0x021B734E@ */ ECIPP_ALIGNMENT_UBYTE 255 Compu_IDENTITY 0 255 PHYS_UNIT "FMI" /end CHARACTERISTIC
/begin CHARACTERISTIC FCfmi_ECT_FT_dT_max "FCtl_FMI(844)" VALUE 0x0016545F /* @ECU_Address@FCtl_FMI@0x021B734C@ */ ECIPP_ALIGNMENT_UBYTE 255 Compu_IDENTITY 0 255 PHYS_UNIT "FMI" /end CHARACTERISTIC
/begin CHARACTERISTIC FCfmi_ECT_HiExp "FCtl_FMI(4)" VALUE 0x00165117 /* @ECU_Address@FCtl_FMI@0x021B7004@ */ ECIPP_ALIGNMENT_UBYTE 255 Compu_IDENTITY 0 255 PHYS_UNIT "FMI" /end CHARACTERISTIC
/begin CHARACTERISTIC FCfmi_ECT_HiExp2 "FCtl_FMI(86)" VALUE 0x00165169 /* @ECU_Address@FCtl_FMI@0x021B7056@ */ ECIPP_ALIGNMENT_UBYTE 255 Compu_IDENTITY 0 255 PHYS_UNIT "FMI" /end CHARACTERISTIC
/begin CHARACTERISTIC FCfmi_ECT_IAT_dT_max "FCtl_FMI(841)" VALUE 0x0016545C /* @ECU_Address@FCtl_FMI@0x021B7349@ */ ECIPP_ALIGNMENT_UBYTE 255 Compu_IDENTITY 0 255 PHYS_UNIT "FMI" /end CHARACTERISTIC
/begin CHARACTERISTIC FCfmi_ECT_LoExp "FCtl_FMI(648)" VALUE 0x0016539B /* @ECU_Address@FCtl_FMI@0x021B7288@ */ ECIPP_ALIGNMENT_UBYTE 255 Compu_IDENTITY 0 255 PHYS_UNIT "FMI" /end CHARACTERISTIC
/begin CHARACTERISTIC FCfmi_ECT_LoExp2 "FCtl_FMI(649)" VALUE 0x0016539C /* @ECU_Address@FCtl_FMI@0x021B7289@ */ ECIPP_ALIGNMENT_UBYTE 255 Compu_IDENTITY 0 255 PHYS_UNIT "FMI" /end CHARACTERISTIC
/begin CHARACTERISTIC FCfmi_ECT_maxv "FCtl_FMI(2)" VALUE 0x00165115 /* @ECU_Address@FCtl_FMI@0x021B7002@ */ ECIPP_ALIGNMENT_UBYTE 255 Compu_IDENTITY 0 255 PHYS_UNIT "FMI" /end CHARACTERISTIC
/begin CHARACTERISTIC FCfmi_ECT_minv "FCtl_FMI(3)" VALUE 0x00165116 /* @ECU_Address@FCtl_FMI@0x021B7003@ */ ECIPP_ALIGNMENT_UBYTE 255 Compu_IDENTITY 0 255 PHYS_UNIT "FMI" /end CHARACTERISTIC
/begin CHARACTERISTIC FCfmi_ECT_OILT_dT_max "FCtl_FMI(845)" VALUE 0x00165460 /* @ECU_Address@FCtl_FMI@0x021B734D@ */ ECIPP_ALIGNMENT_UBYTE 255 Compu_IDENTITY 0 255 PHYS_UNIT "FMI" /end CHARACTERISTIC
/begin CHARACTERISTIC FCfmi_ECT_TAUX_dT1_max "FCtl_FMI(848)" VALUE 0x00165463 /* @ECU_Address@FCtl_FMI@0x021B7350@ */ ECIPP_ALIGNMENT_UBYTE 255 Compu_IDENTITY 0 255 PHYS_UNIT "FMI" /end CHARACTERISTIC
/begin CHARACTERISTIC FCfmi_ECT_TAUX_dT2_max "FCtl_FMI(849)" VALUE 0x00165464 /* @ECU_Address@FCtl_FMI@0x021B7351@ */ ECIPP_ALIGNMENT_UBYTE 255 Compu_IDENTITY 0 255 PHYS_UNIT "FMI" /end CHARACTERISTIC
/begin CHARACTERISTIC FCfmi_ECT_TIAT_dT_max "FCtl_FMI(847)" VALUE 0x00165462 /* @ECU_Address@FCtl_FMI@0x021B734F@ */ ECIPP_ALIGNMENT_UBYTE 255 Compu_IDENTITY 0 255 PHYS_UNIT "FMI" /end CHARACTERISTIC
/begin CHARACTERISTIC FCfmi_EGO1_open "FCtl_FMI(111)" VALUE 0x00165182 /* @ECU_Address@FCtl_FMI@0x021B706F@ */ ECIPP_ALIGNMENT_UBYTE 255 Compu_IDENTITY 0 255 PHYS_UNIT "FMI" /end CHARACTERISTIC
/begin CHARACTERISTIC FCfmi_EGO2_open "FCtl_FMI(112)" VALUE 0x00165183 /* @ECU_Address@FCtl_FMI@0x021B7070@ */ ECIPP_ALIGNMENT_UBYTE 255 Compu_IDENTITY 0 255 PHYS_UNIT "FMI" /end CHARACTERISTIC
/begin CHARACTERISTIC FCfmi_EGO3_open "FCtl_FMI(113)" VALUE 0x00165184 /* @ECU_Address@FCtl_FMI@0x021B7071@ */ ECIPP_ALIGNMENT_UBYTE 255 Compu_IDENTITY 0 255 PHYS_UNIT "FMI" /end CHARACTERISTIC
/begin CHARACTERISTIC FCfmi_EGOH1_off_open "FCtl_FMI(321)" VALUE 0x00165254 /* @ECU_Address@FCtl_FMI@0x021B7141@ */ ECIPP_ALIGNMENT_UBYTE 255 Compu_IDENTITY 0 255 PHYS_UNIT "FMI" /end CHARACTERISTIC
/begin CHARACTERISTIC FCfmi_EGOH1_on_short "FCtl_FMI(322)" VALUE 0x00165255 /* @ECU_Address@FCtl_FMI@0x021B7142@ */ ECIPP_ALIGNMENT_UBYTE 255 Compu_IDENTITY 0 255 PHYS_UNIT "FMI" /end CHARACTERISTIC
/begin CHARACTERISTIC FCfmi_EGOH2_off_open "FCtl_FMI(323)" VALUE 0x00165256 /* @ECU_Address@FCtl_FMI@0x021B7143@ */ ECIPP_ALIGNMENT_UBYTE 255 Compu_IDENTITY 0 255 PHYS_UNIT "FMI" /end CHARACTERISTIC
/begin CHARACTERISTIC FCfmi_EGOH2_on_short "FCtl_FMI(324)" VALUE 0x00165257 /* @ECU_Address@FCtl_FMI@0x021B7144@ */ ECIPP_ALIGNMENT_UBYTE 255 Compu_IDENTITY 0 255 PHYS_UNIT "FMI" /end CHARACTERISTIC
/begin CHARACTERISTIC FCfmi_EGOH3_off_open "FCtl_FMI(325)" VALUE 0x00165258 /* @ECU_Address@FCtl_FMI@0x021B7145@ */ ECIPP_ALIGNMENT_UBYTE 255 Compu_IDENTITY 0 255 PHYS_UNIT "FMI" /end CHARACTERISTIC
/begin CHARACTERISTIC FCfmi_EGOH3_on_short "FCtl_FMI(326)" VALUE 0x00165259 /* @ECU_Address@FCtl_FMI@0x021B7146@ */ ECIPP_ALIGNMENT_UBYTE 255 Compu_IDENTITY 0 255 PHYS_UNIT "FMI" /end CHARACTERISTIC
/begin CHARACTERISTIC FCfmi_EGOH4_off_open "FCtl_FMI(327)" VALUE 0x0016525A /* @ECU_Address@FCtl_FMI@0x021B7147@ */ ECIPP_ALIGNMENT_UBYTE 255 Compu_IDENTITY 0 255 PHYS_UNIT "FMI" /end CHARACTERISTIC
/begin CHARACTERISTIC FCfmi_EGOH4_on_short "FCtl_FMI(328)" VALUE 0x0016525B /* @ECU_Address@FCtl_FMI@0x021B7148@ */ ECIPP_ALIGNMENT_UBYTE 255 Compu_IDENTITY 0 255 PHYS_UNIT "FMI" /end CHARACTERISTIC
/begin CHARACTERISTIC FCfmi_EGR_clr_eta_lo "FCtl_FMI(666)" VALUE 0x001653AD /* @ECU_Address@FCtl_FMI@0x021B729A@ */ ECIPP_ALIGNMENT_UBYTE 255 Compu_IDENTITY 0 255 PHYS_UNIT "FMI" /end CHARACTERISTIC
/begin CHARACTERISTIC FCfmi_EGR_clr_eta_lo2 "FCtl_FMI(685)" VALUE 0x001653C0 /* @ECU_Address@FCtl_FMI@0x021B72AD@ */ ECIPP_ALIGNMENT_UBYTE 255 Compu_IDENTITY 0 255 PHYS_UNIT "FMI" /end CHARACTERISTIC
/begin CHARACTERISTIC FCfmi_EGR_deice_excess "FCtl_FMI(829)" VALUE 0x00165450 /* @ECU_Address@FCtl_FMI@0x021B733D@ */ ECIPP_ALIGNMENT_UBYTE 255 Compu_IDENTITY 0 255 PHYS_UNIT "FMI" /end CHARACTERISTIC
/begin CHARACTERISTIC FCfmi_EGR_offmin_excess "FCtl_FMI(665)" VALUE 0x001653AC /* @ECU_Address@FCtl_FMI@0x021B7299@ */ ECIPP_ALIGNMENT_UBYTE 255 Compu_IDENTITY 0 255 PHYS_UNIT "FMI" /end CHARACTERISTIC
/begin CHARACTERISTIC FCfmi_EGR_OOA_hi "FCtl_FMI(661)" VALUE 0x001653A8 /* @ECU_Address@FCtl_FMI@0x021B7295@ */ ECIPP_ALIGNMENT_UBYTE 255 Compu_IDENTITY 0 255 PHYS_UNIT "FMI" /end CHARACTERISTIC
/begin CHARACTERISTIC FCfmi_EGR_OOA_lo "FCtl_FMI(662)" VALUE 0x001653A9 /* @ECU_Address@FCtl_FMI@0x021B7296@ */ ECIPP_ALIGNMENT_UBYTE 255 Compu_IDENTITY 0 255 PHYS_UNIT "FMI" /end CHARACTERISTIC
/begin CHARACTERISTIC FCftb_CATout_OOR "FCtl_FTB_0x04(831)" VALUE 0x001657B0 /* @ECU_Address@FCtl_FTB_0x04@0x024C533F@ */ ECIPP_ALIGNMENT_UBYTE 255 Compu_IDENTITY 0 255 PHYS_UNIT "FTB" /end CHARACTERISTIC
/begin CHARACTERISTIC FCftb_CFV_FP_minv "FCtl_FTB_0x04(687)" VALUE 0x00165720 /* @ECU_Address@FCtl_FTB_0x04@0x024C52AF@ */ ECIPP_ALIGNMENT_UBYTE 255 Compu_IDENTITY 0 255 PHYS_UNIT "FTB" /end CHARACTERISTIC
/begin CHARACTERISTIC FCftb_CFV_FT_maxv "FCtl_FTB_0x04(688)" VALUE 0x00165721 /* @ECU_Address@FCtl_FTB_0x04@0x024C52B0@ */ ECIPP_ALIGNMENT_UBYTE 255 Compu_IDENTITY 0 255 PHYS_UNIT "FTB" /end CHARACTERISTIC
/begin CHARACTERISTIC FCftb_CFV_FT_minv "FCtl_FTB_0x04(689)" VALUE 0x00165722 /* @ECU_Address@FCtl_FTB_0x04@0x024C52B1@ */ ECIPP_ALIGNMENT_UBYTE 255 Compu_IDENTITY 0 255 PHYS_UNIT "FTB" /end CHARACTERISTIC
/begin CHARACTERISTIC FCftb_CFV_mdot_hi "FCtl_FTB_0x04(523)" VALUE 0x0016567C /* @ECU_Address@FCtl_FTB_0x04@0x024C520B@ */ ECIPP_ALIGNMENT_UBYTE 255 Compu_IDENTITY 0 255 PHYS_UNIT "FTB" /end CHARACTERISTIC
/begin CHARACTERISTIC FCftb_CFV_mdot_lo "FCtl_FTB_0x04(524)" VALUE 0x0016567D /* @ECU_Address@FCtl_FTB_0x04@0x024C520C@ */ ECIPP_ALIGNMENT_UBYTE 255 Compu_IDENTITY 0 255 PHYS_UNIT "FTB" /end CHARACTERISTIC
/begin CHARACTERISTIC FCftb_CFV_mdot_rms_hi "FCtl_FTB_0x04(679)" VALUE 0x00165718 /* @ECU_Address@FCtl_FTB_0x04@0x024C52A7@ */ ECIPP_ALIGNMENT_UBYTE 255 Compu_IDENTITY 0 255 PHYS_UNIT "FTB" /end CHARACTERISTIC
/begin CHARACTERISTIC FCftb_CFV_pwr_loss "FCtl_FTB_0x04(830)" VALUE 0x001657AF /* @ECU_Address@FCtl_FTB_0x04@0x024C533E@ */ ECIPP_ALIGNMENT_UBYTE 255 Compu_IDENTITY 0 255 PHYS_UNIT "FTB" /end CHARACTERISTIC
/begin CHARACTERISTIC FCftb_CFV_RLV_fail "FCtl_FTB_0x04(535)" VALUE 0x00165688 /* @ECU_Address@FCtl_FTB_0x04@0x024C5217@ */ ECIPP_ALIGNMENT_UBYTE 255 Compu_IDENTITY 0 255 PHYS_UNIT "FTB" /end CHARACTERISTIC
/begin CHARACTERISTIC FCftb_CFV_RLV_P_min "FCtl_FTB_0x04(534)" VALUE 0x00165687 /* @ECU_Address@FCtl_FTB_0x04@0x024C5216@ */ ECIPP_ALIGNMENT_UBYTE 255 Compu_IDENTITY 0 255 PHYS_UNIT "FTB" /end CHARACTERISTIC
/begin CHARACTERISTIC FCftb_CHT_HiExp "FCtl_FTB_0x04(114)" VALUE 0x001654E3 /* @ECU_Address@FCtl_FTB_0x04@0x024C5072@ */ ECIPP_ALIGNMENT_UBYTE 255 Compu_IDENTITY 0 255 PHYS_UNIT "FTB" /end CHARACTERISTIC
/begin CHARACTERISTIC FCftb_CHT_HiExp2 "FCtl_FTB_0x04(115)" VALUE 0x001654E4 /* @ECU_Address@FCtl_FTB_0x04@0x024C5073@ */ ECIPP_ALIGNMENT_UBYTE 255 Compu_IDENTITY 0 255 PHYS_UNIT "FTB" /end CHARACTERISTIC
/begin CHARACTERISTIC FCftb_CL_hi "FCtl_FTB_0x04(32)" VALUE 0x00165491 /* @ECU_Address@FCtl_FTB_0x04@0x024C5020@ */ ECIPP_ALIGNMENT_UBYTE 255 Compu_IDENTITY 0 255 PHYS_UNIT "FTB" /end CHARACTERISTIC
/begin CHARACTERISTIC FCftb_CL_lo "FCtl_FTB_0x04(33)" VALUE 0x00165492 /* @ECU_Address@FCtl_FTB_0x04@0x024C5021@ */ ECIPP_ALIGNMENT_UBYTE 255 Compu_IDENTITY 0 255 PHYS_UNIT "FTB" /end CHARACTERISTIC
/begin CHARACTERISTIC FCftb_CL_phi_hi "FCtl_FTB_0x04(677)" VALUE 0x00165716 /* @ECU_Address@FCtl_FTB_0x04@0x024C52A5@ */ ECIPP_ALIGNMENT_UBYTE 255 Compu_IDENTITY 0 255 PHYS_UNIT "FTB" /end CHARACTERISTIC
/begin CHARACTERISTIC FCftb_CL_phi_lo "FCtl_FTB_0x04(678)" VALUE 0x00165717 /* @ECU_Address@FCtl_FTB_0x04@0x024C52A6@ */ ECIPP_ALIGNMENT_UBYTE 255 Compu_IDENTITY 0 255 PHYS_UNIT "FTB" /end CHARACTERISTIC
/begin CHARACTERISTIC FCftb_CLLP_hi "FCtl_FTB_0x04(36)" VALUE 0x00165495 /* @ECU_Address@FCtl_FTB_0x04@0x024C5024@ */ ECIPP_ALIGNMENT_UBYTE 255 Compu_IDENTITY 0 255 PHYS_UNIT "FTB" /end CHARACTERISTIC
/begin CHARACTERISTIC FCftb_CLLP_lo "FCtl_FTB_0x04(37)" VALUE 0x00165496 /* @ECU_Address@FCtl_FTB_0x04@0x024C5025@ */ ECIPP_ALIGNMENT_UBYTE 255 Compu_IDENTITY 0 255 PHYS_UNIT "FTB" /end CHARACTERISTIC
/begin CHARACTERISTIC FCftb_CLNG_hi "FCtl_FTB_0x04(38)" VALUE 0x00165497 /* @ECU_Address@FCtl_FTB_0x04@0x024C5026@ */ ECIPP_ALIGNMENT_UBYTE 255 Compu_IDENTITY 0 255 PHYS_UNIT "FTB" /end CHARACTERISTIC
/begin CHARACTERISTIC FCftb_CLNG_lo "FCtl_FTB_0x04(39)" VALUE 0x00165498 /* @ECU_Address@FCtl_FTB_0x04@0x024C5027@ */ ECIPP_ALIGNMENT_UBYTE 255 Compu_IDENTITY 0 255 PHYS_UNIT "FTB" /end CHARACTERISTIC
/begin CHARACTERISTIC FCftb_CM_unresp "FCtl_FTB_0x04(799)" VALUE 0x00165790 /* @ECU_Address@FCtl_FTB_0x04@0x024C531F@ */ ECIPP_ALIGNMENT_UBYTE 255 Compu_IDENTITY 0 255 PHYS_UNIT "FTB" /end CHARACTERISTIC
/begin CHARACTERISTIC FCftb_CMgsln_inact "FCtl_FTB_0x04(130)" VALUE 0x001654F3 /* @ECU_Address@FCtl_FTB_0x04@0x024C5082@ */ ECIPP_ALIGNMENT_UBYTE 255 Compu_IDENTITY 0 255 PHYS_UNIT "FTB" /end CHARACTERISTIC
/begin CHARACTERISTIC FCftb_CMLP_inact "FCtl_FTB_0x04(131)" VALUE 0x001654F4 /* @ECU_Address@FCtl_FTB_0x04@0x024C5083@ */ ECIPP_ALIGNMENT_UBYTE 255 Compu_IDENTITY 0 255 PHYS_UNIT "FTB" /end CHARACTERISTIC
/begin CHARACTERISTIC FCftb_CMNG_inact "FCtl_FTB_0x04(132)" VALUE 0x001654F5 /* @ECU_Address@FCtl_FTB_0x04@0x024C5084@ */ ECIPP_ALIGNMENT_UBYTE 255 Compu_IDENTITY 0 255 PHYS_UNIT "FTB" /end CHARACTERISTIC
/begin CHARACTERISTIC FCftb_COPfail "FCtl_FTB_0x04(99)" VALUE 0x001654D4 /* @ECU_Address@FCtl_FTB_0x04@0x024C5063@ */ ECIPP_ALIGNMENT_UBYTE 255 Compu_IDENTITY 0 255 PHYS_UNIT "FTB" /end CHARACTERISTIC
/begin CHARACTERISTIC FCftb_COT_hi "FCtl_FTB_0x04(657)" VALUE 0x00165702 /* @ECU_Address@FCtl_FTB_0x04@0x024C5291@ */ ECIPP_ALIGNMENT_UBYTE 255 Compu_IDENTITY 0 255 PHYS_UNIT "FTB" /end CHARACTERISTIC
/begin CHARACTERISTIC FCftb_crkloss "FCtl_FTB_0x04(152)" VALUE 0x00165509 /* @ECU_Address@FCtl_FTB_0x04@0x024C5098@ */ ECIPP_ALIGNMENT_UBYTE 255 Compu_IDENTITY 0 255 PHYS_UNIT "FTB" /end CHARACTERISTIC
/begin CHARACTERISTIC FCftb_crknever "FCtl_FTB_0x04(98)" VALUE 0x001654D3 /* @ECU_Address@FCtl_FTB_0x04@0x024C5062@ */ ECIPP_ALIGNMENT_UBYTE 255 Compu_IDENTITY 0 255 PHYS_UNIT "FTB" /end CHARACTERISTIC
/begin CHARACTERISTIC FCftb_crknoise "FCtl_FTB_0x04(97)" VALUE 0x001654D2 /* @ECU_Address@FCtl_FTB_0x04@0x024C5061@ */ ECIPP_ALIGNMENT_UBYTE 255 Compu_IDENTITY 0 255 PHYS_UNIT "FTB" /end CHARACTERISTIC
/begin CHARACTERISTIC FCftb_CVCS_discon "FCtl_FTB_0x04(747)" VALUE 0x0016575C /* @ECU_Address@FCtl_FTB_0x04@0x024C52EB@ */ ECIPP_ALIGNMENT_UBYTE 255 Compu_IDENTITY 0 255 PHYS_UNIT "FTB" /end CHARACTERISTIC
/begin CHARACTERISTIC FCftb_CVDS_discon "FCtl_FTB_0x04(748)" VALUE 0x0016575D /* @ECU_Address@FCtl_FTB_0x04@0x024C52EC@ */ ECIPP_ALIGNMENT_UBYTE 255 Compu_IDENTITY 0 255 PHYS_UNIT "FTB" /end CHARACTERISTIC
/begin CHARACTERISTIC FCftb_CVP1_hi "FCtl_FTB_0x04(794)" VALUE 0x0016578B /* @ECU_Address@FCtl_FTB_0x04@0x024C531A@ */ ECIPP_ALIGNMENT_UBYTE 255 Compu_IDENTITY 0 255 PHYS_UNIT "FTB" /end CHARACTERISTIC
/begin CHARACTERISTIC FCftb_CVP1_lo "FCtl_FTB_0x04(795)" VALUE 0x0016578C /* @ECU_Address@FCtl_FTB_0x04@0x024C531B@ */ ECIPP_ALIGNMENT_UBYTE 255 Compu_IDENTITY 0 255 PHYS_UNIT "FTB" /end CHARACTERISTIC
/begin CHARACTERISTIC FCftb_CVP2_hi "FCtl_FTB_0x04(796)" VALUE 0x0016578D /* @ECU_Address@FCtl_FTB_0x04@0x024C531C@ */ ECIPP_ALIGNMENT_UBYTE 255 Compu_IDENTITY 0 255 PHYS_UNIT "FTB" /end CHARACTERISTIC
/begin CHARACTERISTIC FCftb_CVP2_lo "FCtl_FTB_0x04(797)" VALUE 0x0016578E /* @ECU_Address@FCtl_FTB_0x04@0x024C531D@ */ ECIPP_ALIGNMENT_UBYTE 255 Compu_IDENTITY 0 255 PHYS_UNIT "FTB" /end CHARACTERISTIC
/begin CHARACTERISTIC FCftb_DBW_I_max "FCtl_FTB_0x04(527)" VALUE 0x00165680 /* @ECU_Address@FCtl_FTB_0x04@0x024C520F@ */ ECIPP_ALIGNMENT_UBYTE 255 Compu_IDENTITY 0 255 PHYS_UNIT "FTB" /end CHARACTERISTIC
/begin CHARACTERISTIC FCftb_ECam_maxerr "FCtl_FTB_0x04(289)" VALUE 0x00165592 /* @ECU_Address@FCtl_FTB_0x04@0x024C5121@ */ ECIPP_ALIGNMENT_UBYTE 255 Compu_IDENTITY 0 255 PHYS_UNIT "FTB" /end CHARACTERISTIC
/begin CHARACTERISTIC FCftb_ECL_low "FCtl_FTB_0x04(733)" VALUE 0x0016574E /* @ECU_Address@FCtl_FTB_0x04@0x024C52DD@ */ ECIPP_ALIGNMENT_UBYTE 255 Compu_IDENTITY 0 255 PHYS_UNIT "FTB" /end CHARACTERISTIC
/begin CHARACTERISTIC FCftb_ECT_AAT_dT_max "FCtl_FTB_0x04(842)" VALUE 0x001657BB /* @ECU_Address@FCtl_FTB_0x04@0x024C534A@ */ ECIPP_ALIGNMENT_UBYTE 255 Compu_IDENTITY 0 255 PHYS_UNIT "FTB" /end CHARACTERISTIC
/begin CHARACTERISTIC FCftb_ECT_derate_actv "FCtl_FTB_0x04(828)" VALUE 0x001657AD /* @ECU_Address@FCtl_FTB_0x04@0x024C533C@ */ ECIPP_ALIGNMENT_UBYTE 255 Compu_IDENTITY 0 255 PHYS_UNIT "FTB" /end CHARACTERISTIC
/begin CHARACTERISTIC FCftb_ECT_dT_max "FCtl_FTB_0x04(850)" VALUE 0x001657C3 /* @ECU_Address@FCtl_FTB_0x04@0x024C5352@ */ ECIPP_ALIGNMENT_UBYTE 255 Compu_IDENTITY 0 255 PHYS_UNIT "FTB" /end CHARACTERISTIC
/begin CHARACTERISTIC FCftb_ECT_EGRT_dT_max "FCtl_FTB_0x04(843)" VALUE 0x001657BC /* @ECU_Address@FCtl_FTB_0x04@0x024C534B@ */ ECIPP_ALIGNMENT_UBYTE 255 Compu_IDENTITY 0 255 PHYS_UNIT "FTB" /end CHARACTERISTIC
/begin CHARACTERISTIC FCftb_ECT_EGT_dT_max "FCtl_FTB_0x04(846)" VALUE 0x001657BF /* @ECU_Address@FCtl_FTB_0x04@0x024C534E@ */ ECIPP_ALIGNMENT_UBYTE 255 Compu_IDENTITY 0 255 PHYS_UNIT "FTB" /end CHARACTERISTIC
/begin CHARACTERISTIC FCftb_ECT_FT_dT_max "FCtl_FTB_0x04(844)" VALUE 0x001657BD /* @ECU_Address@FCtl_FTB_0x04@0x024C534C@ */ ECIPP_ALIGNMENT_UBYTE 255 Compu_IDENTITY 0 255 PHYS_UNIT "FTB" /end CHARACTERISTIC
/begin CHARACTERISTIC FCftb_ECT_HiExp "FCtl_FTB_0x04(4)" VALUE 0x00165475 /* @ECU_Address@FCtl_FTB_0x04@0x024C5004@ */ ECIPP_ALIGNMENT_UBYTE 255 Compu_IDENTITY 0 255 PHYS_UNIT "FTB" /end CHARACTERISTIC
/begin CHARACTERISTIC FCftb_ECT_HiExp2 "FCtl_FTB_0x04(86)" VALUE 0x001654C7 /* @ECU_Address@FCtl_FTB_0x04@0x024C5056@ */ ECIPP_ALIGNMENT_UBYTE 255 Compu_IDENTITY 0 255 PHYS_UNIT "FTB" /end CHARACTERISTIC
/begin CHARACTERISTIC FCftb_ECT_IAT_dT_max "FCtl_FTB_0x04(841)" VALUE 0x001657BA /* @ECU_Address@FCtl_FTB_0x04@0x024C5349@ */ ECIPP_ALIGNMENT_UBYTE 255 Compu_IDENTITY 0 255 PHYS_UNIT "FTB" /end CHARACTERISTIC
/begin CHARACTERISTIC FCftb_ECT_LoExp "FCtl_FTB_0x04(648)" VALUE 0x001656F9 /* @ECU_Address@FCtl_FTB_0x04@0x024C5288@ */ ECIPP_ALIGNMENT_UBYTE 255 Compu_IDENTITY 0 255 PHYS_UNIT "FTB" /end CHARACTERISTIC
/begin CHARACTERISTIC FCftb_ECT_LoExp2 "FCtl_FTB_0x04(649)" VALUE 0x001656FA /* @ECU_Address@FCtl_FTB_0x04@0x024C5289@ */ ECIPP_ALIGNMENT_UBYTE 255 Compu_IDENTITY 0 255 PHYS_UNIT "FTB" /end CHARACTERISTIC
/begin CHARACTERISTIC FCftb_ECT_maxv "FCtl_FTB_0x04(2)" VALUE 0x00165473 /* @ECU_Address@FCtl_FTB_0x04@0x024C5002@ */ ECIPP_ALIGNMENT_UBYTE 255 Compu_IDENTITY 0 255 PHYS_UNIT "FTB" /end CHARACTERISTIC
/begin CHARACTERISTIC FCftb_ECT_minv "FCtl_FTB_0x04(3)" VALUE 0x00165474 /* @ECU_Address@FCtl_FTB_0x04@0x024C5003@ */ ECIPP_ALIGNMENT_UBYTE 255 Compu_IDENTITY 0 255 PHYS_UNIT "FTB" /end CHARACTERISTIC
/begin CHARACTERISTIC FCftb_ECT_OILT_dT_max "FCtl_FTB_0x04(845)" VALUE 0x001657BE /* @ECU_Address@FCtl_FTB_0x04@0x024C534D@ */ ECIPP_ALIGNMENT_UBYTE 255 Compu_IDENTITY 0 255 PHYS_UNIT "FTB" /end CHARACTERISTIC
/begin CHARACTERISTIC FCftb_ECT_TAUX_dT1_max "FCtl_FTB_0x04(848)" VALUE 0x001657C1 /* @ECU_Address@FCtl_FTB_0x04@0x024C5350@ */ ECIPP_ALIGNMENT_UBYTE 255 Compu_IDENTITY 0 255 PHYS_UNIT "FTB" /end CHARACTERISTIC
/begin CHARACTERISTIC FCftb_ECT_TAUX_dT2_max "FCtl_FTB_0x04(849)" VALUE 0x001657C2 /* @ECU_Address@FCtl_FTB_0x04@0x024C5351@ */ ECIPP_ALIGNMENT_UBYTE 255 Compu_IDENTITY 0 255 PHYS_UNIT "FTB" /end CHARACTERISTIC
/begin CHARACTERISTIC FCftb_ECT_TIAT_dT_max "FCtl_FTB_0x04(847)" VALUE 0x001657C0 /* @ECU_Address@FCtl_FTB_0x04@0x024C534F@ */ ECIPP_ALIGNMENT_UBYTE 255 Compu_IDENTITY 0 255 PHYS_UNIT "FTB" /end CHARACTERISTIC
/begin CHARACTERISTIC FCftb_EGO1_open "FCtl_FTB_0x04(111)" VALUE 0x001654E0 /* @ECU_Address@FCtl_FTB_0x04@0x024C506F@ */ ECIPP_ALIGNMENT_UBYTE 255 Compu_IDENTITY 0 255 PHYS_UNIT "FTB" /end CHARACTERISTIC
/begin CHARACTERISTIC FCftb_EGO2_open "FCtl_FTB_0x04(112)" VALUE 0x001654E1 /* @ECU_Address@FCtl_FTB_0x04@0x024C5070@ */ ECIPP_ALIGNMENT_UBYTE 255 Compu_IDENTITY 0 255 PHYS_UNIT "FTB" /end CHARACTERISTIC
/begin CHARACTERISTIC FCftb_EGO3_open "FCtl_FTB_0x04(113)" VALUE 0x001654E2 /* @ECU_Address@FCtl_FTB_0x04@0x024C5071@ */ ECIPP_ALIGNMENT_UBYTE 255 Compu_IDENTITY 0 255 PHYS_UNIT "FTB" /end CHARACTERISTIC
/begin CHARACTERISTIC FCftb_EGOH1_off_open "FCtl_FTB_0x04(321)" VALUE 0x001655B2 /* @ECU_Address@FCtl_FTB_0x04@0x024C5141@ */ ECIPP_ALIGNMENT_UBYTE 255 Compu_IDENTITY 0 255 PHYS_UNIT "FTB" /end CHARACTERISTIC
/begin CHARACTERISTIC FCftb_EGOH1_on_short "FCtl_FTB_0x04(322)" VALUE 0x001655B3 /* @ECU_Address@FCtl_FTB_0x04@0x024C5142@ */ ECIPP_ALIGNMENT_UBYTE 255 Compu_IDENTITY 0 255 PHYS_UNIT "FTB" /end CHARACTERISTIC
/begin CHARACTERISTIC FCftb_EGOH2_off_open "FCtl_FTB_0x04(323)" VALUE 0x001655B4 /* @ECU_Address@FCtl_FTB_0x04@0x024C5143@ */ ECIPP_ALIGNMENT_UBYTE 255 Compu_IDENTITY 0 255 PHYS_UNIT "FTB" /end CHARACTERISTIC
/begin CHARACTERISTIC FCftb_EGOH2_on_short "FCtl_FTB_0x04(324)" VALUE 0x001655B5 /* @ECU_Address@FCtl_FTB_0x04@0x024C5144@ */ ECIPP_ALIGNMENT_UBYTE 255 Compu_IDENTITY 0 255 PHYS_UNIT "FTB" /end CHARACTERISTIC
/begin CHARACTERISTIC FCftb_EGOH3_off_open "FCtl_FTB_0x04(325)" VALUE 0x001655B6 /* @ECU_Address@FCtl_FTB_0x04@0x024C5145@ */ ECIPP_ALIGNMENT_UBYTE 255 Compu_IDENTITY 0 255 PHYS_UNIT "FTB" /end CHARACTERISTIC
/begin CHARACTERISTIC FCftb_EGOH3_on_short "FCtl_FTB_0x04(326)" VALUE 0x001655B7 /* @ECU_Address@FCtl_FTB_0x04@0x024C5146@ */ ECIPP_ALIGNMENT_UBYTE 255 Compu_IDENTITY 0 255 PHYS_UNIT "FTB" /end CHARACTERISTIC
/begin CHARACTERISTIC FCftb_EGOH4_off_open "FCtl_FTB_0x04(327)" VALUE 0x001655B8 /* @ECU_Address@FCtl_FTB_0x04@0x024C5147@ */ ECIPP_ALIGNMENT_UBYTE 255 Compu_IDENTITY 0 255 PHYS_UNIT "FTB" /end CHARACTERISTIC
/begin CHARACTERISTIC FCftb_EGOH4_on_short "FCtl_FTB_0x04(328)" VALUE 0x001655B9 /* @ECU_Address@FCtl_FTB_0x04@0x024C5148@ */ ECIPP_ALIGNMENT_UBYTE 255 Compu_IDENTITY 0 255 PHYS_UNIT "FTB" /end CHARACTERISTIC
/begin CHARACTERISTIC FCftb_EGR_clr_eta_lo "FCtl_FTB_0x04(666)" VALUE 0x0016570B /* @ECU_Address@FCtl_FTB_0x04@0x024C529A@ */ ECIPP_ALIGNMENT_UBYTE 255 Compu_IDENTITY 0 255 PHYS_UNIT "FTB" /end CHARACTERISTIC
/begin CHARACTERISTIC FCftb_EGR_clr_eta_lo2 "FCtl_FTB_0x04(685)" VALUE 0x0016571E /* @ECU_Address@FCtl_FTB_0x04@0x024C52AD@ */ ECIPP_ALIGNMENT_UBYTE 255 Compu_IDENTITY 0 255 PHYS_UNIT "FTB" /end CHARACTERISTIC
/begin CHARACTERISTIC FCftb_EGR_deice_excess "FCtl_FTB_0x04(829)" VALUE 0x001657AE /* @ECU_Address@FCtl_FTB_0x04@0x024C533D@ */ ECIPP_ALIGNMENT_UBYTE 255 Compu_IDENTITY 0 255 PHYS_UNIT "FTB" /end CHARACTERISTIC
/begin CHARACTERISTIC FCftb_EGR_offmin_excess "FCtl_FTB_0x04(665)" VALUE 0x0016570A /* @ECU_Address@FCtl_FTB_0x04@0x024C5299@ */ ECIPP_ALIGNMENT_UBYTE 255 Compu_IDENTITY 0 255 PHYS_UNIT "FTB" /end CHARACTERISTIC
/begin CHARACTERISTIC FCftb_EGR_OOA_hi "FCtl_FTB_0x04(661)" VALUE 0x00165706 /* @ECU_Address@FCtl_FTB_0x04@0x024C5295@ */ ECIPP_ALIGNMENT_UBYTE 255 Compu_IDENTITY 0 255 PHYS_UNIT "FTB" /end CHARACTERISTIC
/begin CHARACTERISTIC FCftb_EGR_OOA_lo "FCtl_FTB_0x04(662)" VALUE 0x00165707 /* @ECU_Address@FCtl_FTB_0x04@0x024C5296@ */ ECIPP_ALIGNMENT_UBYTE 255 Compu_IDENTITY 0 255 PHYS_UNIT "FTB" /end CHARACTERISTIC
/begin CHARACTERISTIC FCspn_CATout_OOR "FCtl_SPN(831)" VALUE 0x001629D8 /* @ECU_Address@FCtl_SPN@0x021B6CFC@ */ ECIPP_ALIGNMENT_ULONG 4294967295 Compu_IDENTITY 0 4294967295 PHYS_UNIT "SPN" /end CHARACTERISTIC
/begin CHARACTERISTIC FCspn_CFV_FP_minv "FCtl_SPN(687)" VALUE 0x00162798 /* @ECU_Address@FCtl_SPN@0x021B6ABC@ */ ECIPP_ALIGNMENT_ULONG 4294967295 Compu_IDENTITY 0 4294967295 PHYS_UNIT "SPN" /end CHARACTERISTIC
/begin CHARACTERISTIC FCspn_CFV_FT_maxv "FCtl_SPN(688)" VALUE 0x0016279C /* @ECU_Address@FCtl_SPN@0x021B6AC0@ */ ECIPP_ALIGNMENT_ULONG 4294967295 Compu_IDENTITY 0 4294967295 PHYS_UNIT "SPN" /end CHARACTERISTIC
/begin CHARACTERISTIC FCspn_CFV_FT_minv "FCtl_SPN(689)" VALUE 0x001627A0 /* @ECU_Address@FCtl_SPN@0x021B6AC4@ */ ECIPP_ALIGNMENT_ULONG 4294967295 Compu_IDENTITY 0 4294967295 PHYS_UNIT "SPN" /end CHARACTERISTIC
/begin CHARACTERISTIC FCspn_CFV_mdot_hi "FCtl_SPN(523)" VALUE 0x00162508 /* @ECU_Address@FCtl_SPN@0x021B682C@ */ ECIPP_ALIGNMENT_ULONG 4294967295 Compu_IDENTITY 0 4294967295 PHYS_UNIT "SPN" /end CHARACTERISTIC
/begin CHARACTERISTIC FCspn_CFV_mdot_lo "FCtl_SPN(524)" VALUE 0x0016250C /* @ECU_Address@FCtl_SPN@0x021B6830@ */ ECIPP_ALIGNMENT_ULONG 4294967295 Compu_IDENTITY 0 4294967295 PHYS_UNIT "SPN" /end CHARACTERISTIC
/begin CHARACTERISTIC FCspn_CFV_mdot_rms_hi "FCtl_SPN(679)" VALUE 0x00162778 /* @ECU_Address@FCtl_SPN@0x021B6A9C@ */ ECIPP_ALIGNMENT_ULONG 4294967295 Compu_IDENTITY 0 4294967295 PHYS_UNIT "SPN" /end CHARACTERISTIC
/begin CHARACTERISTIC FCspn_CFV_pwr_loss "FCtl_SPN(830)" VALUE 0x001629D4 /* @ECU_Address@FCtl_SPN@0x021B6CF8@ */ ECIPP_ALIGNMENT_ULONG 4294967295 Compu_IDENTITY 0 4294967295 PHYS_UNIT "SPN" /end CHARACTERISTIC
/begin CHARACTERISTIC FCspn_CFV_RLV_fail "FCtl_SPN(535)" VALUE 0x00162538 /* @ECU_Address@FCtl_SPN@0x021B685C@ */ ECIPP_ALIGNMENT_ULONG 4294967295 Compu_IDENTITY 0 4294967295 PHYS_UNIT "SPN" /end CHARACTERISTIC
/begin CHARACTERISTIC FCspn_CFV_RLV_P_min "FCtl_SPN(534)" VALUE 0x00162534 /* @ECU_Address@FCtl_SPN@0x021B6858@ */ ECIPP_ALIGNMENT_ULONG 4294967295 Compu_IDENTITY 0 4294967295 PHYS_UNIT "SPN" /end CHARACTERISTIC
/begin CHARACTERISTIC FCspn_CHT_HiExp "FCtl_SPN(114)" VALUE 0x00161EA4 /* @ECU_Address@FCtl_SPN@0x021B61C8@ */ ECIPP_ALIGNMENT_ULONG 4294967295 Compu_IDENTITY 0 4294967295 PHYS_UNIT "SPN" /end CHARACTERISTIC
/begin CHARACTERISTIC FCspn_CHT_HiExp2 "FCtl_SPN(115)" VALUE 0x00161EA8 /* @ECU_Address@FCtl_SPN@0x021B61CC@ */ ECIPP_ALIGNMENT_ULONG 4294967295 Compu_IDENTITY 0 4294967295 PHYS_UNIT "SPN" /end CHARACTERISTIC
/begin CHARACTERISTIC FCspn_CL_hi "FCtl_SPN(32)" VALUE 0x00161D5C /* @ECU_Address@FCtl_SPN@0x021B6080@ */ ECIPP_ALIGNMENT_ULONG 4294967295 Compu_IDENTITY 0 4294967295 PHYS_UNIT "SPN" /end CHARACTERISTIC
/begin CHARACTERISTIC FCspn_CL_lo "FCtl_SPN(33)" VALUE 0x00161D60 /* @ECU_Address@FCtl_SPN@0x021B6084@ */ ECIPP_ALIGNMENT_ULONG 4294967295 Compu_IDENTITY 0 4294967295 PHYS_UNIT "SPN" /end CHARACTERISTIC
/begin CHARACTERISTIC FCspn_CL_phi_hi "FCtl_SPN(677)" VALUE 0x00162770 /* @ECU_Address@FCtl_SPN@0x021B6A94@ */ ECIPP_ALIGNMENT_ULONG 4294967295 Compu_IDENTITY 0 4294967295 PHYS_UNIT "SPN" /end CHARACTERISTIC
/begin CHARACTERISTIC FCspn_CL_phi_lo "FCtl_SPN(678)" VALUE 0x00162774 /* @ECU_Address@FCtl_SPN@0x021B6A98@ */ ECIPP_ALIGNMENT_ULONG 4294967295 Compu_IDENTITY 0 4294967295 PHYS_UNIT "SPN" /end CHARACTERISTIC
/begin CHARACTERISTIC FCspn_CLLP_hi "FCtl_SPN(36)" VALUE 0x00161D6C /* @ECU_Address@FCtl_SPN@0x021B6090@ */ ECIPP_ALIGNMENT_ULONG 4294967295 Compu_IDENTITY 0 4294967295 PHYS_UNIT "SPN" /end CHARACTERISTIC
/begin CHARACTERISTIC FCspn_CLLP_lo "FCtl_SPN(37)" VALUE 0x00161D70 /* @ECU_Address@FCtl_SPN@0x021B6094@ */ ECIPP_ALIGNMENT_ULONG 4294967295 Compu_IDENTITY 0 4294967295 PHYS_UNIT "SPN" /end CHARACTERISTIC
/begin CHARACTERISTIC FCspn_CLNG_hi "FCtl_SPN(38)" VALUE 0x00161D74 /* @ECU_Address@FCtl_SPN@0x021B6098@ */ ECIPP_ALIGNMENT_ULONG 4294967295 Compu_IDENTITY 0 4294967295 PHYS_UNIT "SPN" /end CHARACTERISTIC
/begin CHARACTERISTIC FCspn_CLNG_lo "FCtl_SPN(39)" VALUE 0x00161D78 /* @ECU_Address@FCtl_SPN@0x021B609C@ */ ECIPP_ALIGNMENT_ULONG 4294967295 Compu_IDENTITY 0 4294967295 PHYS_UNIT "SPN" /end CHARACTERISTIC
/begin CHARACTERISTIC FCspn_CM_unresp "FCtl_SPN(799)" VALUE 0x00162958 /* @ECU_Address@FCtl_SPN@0x021B6C7C@ */ ECIPP_ALIGNMENT_ULONG 4294967295 Compu_IDENTITY 0 4294967295 PHYS_UNIT "SPN" /end CHARACTERISTIC
/begin CHARACTERISTIC FCspn_CMgsln_inact "FCtl_SPN(130)" VALUE 0x00161EE4 /* @ECU_Address@FCtl_SPN@0x021B6208@ */ ECIPP_ALIGNMENT_ULONG 4294967295 Compu_IDENTITY 0 4294967295 PHYS_UNIT "SPN" /end CHARACTERISTIC
/begin CHARACTERISTIC FCspn_CMLP_inact "FCtl_SPN(131)" VALUE 0x00161EE8 /* @ECU_Address@FCtl_SPN@0x021B620C@ */ ECIPP_ALIGNMENT_ULONG 4294967295 Compu_IDENTITY 0 4294967295 PHYS_UNIT "SPN" /end CHARACTERISTIC
/begin CHARACTERISTIC FCspn_CMNG_inact "FCtl_SPN(132)" VALUE 0x00161EEC /* @ECU_Address@FCtl_SPN@0x021B6210@ */ ECIPP_ALIGNMENT_ULONG 4294967295 Compu_IDENTITY 0 4294967295 PHYS_UNIT "SPN" /end CHARACTERISTIC
/begin CHARACTERISTIC FCspn_COPfail "FCtl_SPN(99)" VALUE 0x00161E68 /* @ECU_Address@FCtl_SPN@0x021B618C@ */ ECIPP_ALIGNMENT_ULONG 4294967295 Compu_IDENTITY 0 4294967295 PHYS_UNIT "SPN" /end CHARACTERISTIC
/begin CHARACTERISTIC FCspn_COT_hi "FCtl_SPN(657)" VALUE 0x00162720 /* @ECU_Address@FCtl_SPN@0x021B6A44@ */ ECIPP_ALIGNMENT_ULONG 4294967295 Compu_IDENTITY 0 4294967295 PHYS_UNIT "SPN" /end CHARACTERISTIC
/begin CHARACTERISTIC FCspn_crkloss "FCtl_SPN(152)" VALUE 0x00161F3C /* @ECU_Address@FCtl_SPN@0x021B6260@ */ ECIPP_ALIGNMENT_ULONG 4294967295 Compu_IDENTITY 0 4294967295 PHYS_UNIT "SPN" /end CHARACTERISTIC
/begin CHARACTERISTIC FCspn_crknever "FCtl_SPN(98)" VALUE 0x00161E64 /* @ECU_Address@FCtl_SPN@0x021B6188@ */ ECIPP_ALIGNMENT_ULONG 4294967295 Compu_IDENTITY 0 4294967295 PHYS_UNIT "SPN" /end CHARACTERISTIC
/begin CHARACTERISTIC FCspn_crknoise "FCtl_SPN(97)" VALUE 0x00161E60 /* @ECU_Address@FCtl_SPN@0x021B6184@ */ ECIPP_ALIGNMENT_ULONG 4294967295 Compu_IDENTITY 0 4294967295 PHYS_UNIT "SPN" /end CHARACTERISTIC
/begin CHARACTERISTIC FCspn_CVCS_discon "FCtl_SPN(747)" VALUE 0x00162888 /* @ECU_Address@FCtl_SPN@0x021B6BAC@ */ ECIPP_ALIGNMENT_ULONG 4294967295 Compu_IDENTITY 0 4294967295 PHYS_UNIT "SPN" /end CHARACTERISTIC
/begin CHARACTERISTIC FCspn_CVDS_discon "FCtl_SPN(748)" VALUE 0x0016288C /* @ECU_Address@FCtl_SPN@0x021B6BB0@ */ ECIPP_ALIGNMENT_ULONG 4294967295 Compu_IDENTITY 0 4294967295 PHYS_UNIT "SPN" /end CHARACTERISTIC
/begin CHARACTERISTIC FCspn_CVP1_hi "FCtl_SPN(794)" VALUE 0x00162944 /* @ECU_Address@FCtl_SPN@0x021B6C68@ */ ECIPP_ALIGNMENT_ULONG 4294967295 Compu_IDENTITY 0 4294967295 PHYS_UNIT "SPN" /end CHARACTERISTIC
/begin CHARACTERISTIC FCspn_CVP1_lo "FCtl_SPN(795)" VALUE 0x00162948 /* @ECU_Address@FCtl_SPN@0x021B6C6C@ */ ECIPP_ALIGNMENT_ULONG 4294967295 Compu_IDENTITY 0 4294967295 PHYS_UNIT "SPN" /end CHARACTERISTIC
/begin CHARACTERISTIC FCspn_CVP2_hi "FCtl_SPN(796)" VALUE 0x0016294C /* @ECU_Address@FCtl_SPN@0x021B6C70@ */ ECIPP_ALIGNMENT_ULONG 4294967295 Compu_IDENTITY 0 4294967295 PHYS_UNIT "SPN" /end CHARACTERISTIC
/begin CHARACTERISTIC FCspn_CVP2_lo "FCtl_SPN(797)" VALUE 0x00162950 /* @ECU_Address@FCtl_SPN@0x021B6C74@ */ ECIPP_ALIGNMENT_ULONG 4294967295 Compu_IDENTITY 0 4294967295 PHYS_UNIT "SPN" /end CHARACTERISTIC
/begin CHARACTERISTIC FCspn_DBW_I_max "FCtl_SPN(527)" VALUE 0x00162518 /* @ECU_Address@FCtl_SPN@0x021B683C@ */ ECIPP_ALIGNMENT_ULONG 4294967295 Compu_IDENTITY 0 4294967295 PHYS_UNIT "SPN" /end CHARACTERISTIC
/begin CHARACTERISTIC FCspn_ECam_maxerr "FCtl_SPN(289)" VALUE 0x00162160 /* @ECU_Address@FCtl_SPN@0x021B6484@ */ ECIPP_ALIGNMENT_ULONG 4294967295 Compu_IDENTITY 0 4294967295 PHYS_UNIT "SPN" /end CHARACTERISTIC
/begin CHARACTERISTIC FCspn_ECL_low "FCtl_SPN(733)" VALUE 0x00162850 /* @ECU_Address@FCtl_SPN@0x021B6B74@ */ ECIPP_ALIGNMENT_ULONG 4294967295 Compu_IDENTITY 0 4294967295 PHYS_UNIT "SPN" /end CHARACTERISTIC
/begin CHARACTERISTIC FCspn_ECT_AAT_dT_max "FCtl_SPN(842)" VALUE 0x00162A04 /* @ECU_Address@FCtl_SPN@0x021B6D28@ */ ECIPP_ALIGNMENT_ULONG 4294967295 Compu_IDENTITY 0 4294967295 PHYS_UNIT "SPN" /end CHARACTERISTIC
/begin CHARACTERISTIC FCspn_ECT_derate_actv "FCtl_SPN(828)" VALUE 0x001629CC /* @ECU_Address@FCtl_SPN@0x021B6CF0@ */ ECIPP_ALIGNMENT_ULONG 4294967295 Compu_IDENTITY 0 4294967295 PHYS_UNIT "SPN" /end CHARACTERISTIC
/begin CHARACTERISTIC FCspn_ECT_dT_max "FCtl_SPN(850)" VALUE 0x00162A24 /* @ECU_Address@FCtl_SPN@0x021B6D48@ */ ECIPP_ALIGNMENT_ULONG 4294967295 Compu_IDENTITY 0 4294967295 PHYS_UNIT "SPN" /end CHARACTERISTIC
/begin CHARACTERISTIC FCspn_ECT_EGRT_dT_max "FCtl_SPN(843)" VALUE 0x00162A08 /* @ECU_Address@FCtl_SPN@0x021B6D2C@ */ ECIPP_ALIGNMENT_ULONG 4294967295 Compu_IDENTITY 0 4294967295 PHYS_UNIT "SPN" /end CHARACTERISTIC
/begin CHARACTERISTIC FCspn_ECT_EGT_dT_max "FCtl_SPN(846)" VALUE 0x00162A14 /* @ECU_Address@FCtl_SPN@0x021B6D38@ */ ECIPP_ALIGNMENT_ULONG 4294967295 Compu_IDENTITY 0 4294967295 PHYS_UNIT "SPN" /end CHARACTERISTIC
/begin CHARACTERISTIC FCspn_ECT_FT_dT_max "FCtl_SPN(844)" VALUE 0x00162A0C /* @ECU_Address@FCtl_SPN@0x021B6D30@ */ ECIPP_ALIGNMENT_ULONG 4294967295 Compu_IDENTITY 0 4294967295 PHYS_UNIT "SPN" /end CHARACTERISTIC
/begin CHARACTERISTIC FCspn_ECT_HiExp "FCtl_SPN(4)" VALUE 0x00161CEC /* @ECU_Address@FCtl_SPN@0x021B6010@ */ ECIPP_ALIGNMENT_ULONG 4294967295 Compu_IDENTITY 0 4294967295 PHYS_UNIT "SPN" /end CHARACTERISTIC
/begin CHARACTERISTIC FCspn_ECT_HiExp2 "FCtl_SPN(86)" VALUE 0x00161E34 /* @ECU_Address@FCtl_SPN@0x021B6158@ */ ECIPP_ALIGNMENT_ULONG 4294967295 Compu_IDENTITY 0 4294967295 PHYS_UNIT "SPN" /end CHARACTERISTIC
/begin CHARACTERISTIC FCspn_ECT_IAT_dT_max "FCtl_SPN(841)" VALUE 0x00162A00 /* @ECU_Address@FCtl_SPN@0x021B6D24@ */ ECIPP_ALIGNMENT_ULONG 4294967295 Compu_IDENTITY 0 4294967295 PHYS_UNIT "SPN" /end CHARACTERISTIC
/begin CHARACTERISTIC FCspn_ECT_LoExp "FCtl_SPN(648)" VALUE 0x001626FC /* @ECU_Address@FCtl_SPN@0x021B6A20@ */ ECIPP_ALIGNMENT_ULONG 4294967295 Compu_IDENTITY 0 4294967295 PHYS_UNIT "SPN" /end CHARACTERISTIC
/begin CHARACTERISTIC FCspn_ECT_LoExp2 "FCtl_SPN(649)" VALUE 0x00162700 /* @ECU_Address@FCtl_SPN@0x021B6A24@ */ ECIPP_ALIGNMENT_ULONG 4294967295 Compu_IDENTITY 0 4294967295 PHYS_UNIT "SPN" /end CHARACTERISTIC
/begin CHARACTERISTIC FCspn_ECT_maxv "FCtl_SPN(2)" VALUE 0x00161CE4 /* @ECU_Address@FCtl_SPN@0x021B6008@ */ ECIPP_ALIGNMENT_ULONG 4294967295 Compu_IDENTITY 0 4294967295 PHYS_UNIT "SPN" /end CHARACTERISTIC
/begin CHARACTERISTIC FCspn_ECT_minv "FCtl_SPN(3)" VALUE 0x00161CE8 /* @ECU_Address@FCtl_SPN@0x021B600C@ */ ECIPP_ALIGNMENT_ULONG 4294967295 Compu_IDENTITY 0 4294967295 PHYS_UNIT "SPN" /end CHARACTERISTIC
/begin CHARACTERISTIC FCspn_ECT_OILT_dT_max "FCtl_SPN(845)" VALUE 0x00162A10 /* @ECU_Address@FCtl_SPN@0x021B6D34@ */ ECIPP_ALIGNMENT_ULONG 4294967295 Compu_IDENTITY 0 4294967295 PHYS_UNIT "SPN" /end CHARACTERISTIC
/begin CHARACTERISTIC FCspn_ECT_TAUX_dT1_max "FCtl_SPN(848)" VALUE 0x00162A1C /* @ECU_Address@FCtl_SPN@0x021B6D40@ */ ECIPP_ALIGNMENT_ULONG 4294967295 Compu_IDENTITY 0 4294967295 PHYS_UNIT "SPN" /end CHARACTERISTIC
/begin CHARACTERISTIC FCspn_ECT_TAUX_dT2_max "FCtl_SPN(849)" VALUE 0x00162A20 /* @ECU_Address@FCtl_SPN@0x021B6D44@ */ ECIPP_ALIGNMENT_ULONG 4294967295 Compu_IDENTITY 0 4294967295 PHYS_UNIT "SPN" /end CHARACTERISTIC
/begin CHARACTERISTIC FCspn_ECT_TIAT_dT_max "FCtl_SPN(847)" VALUE 0x00162A18 /* @ECU_Address@FCtl_SPN@0x021B6D3C@ */ ECIPP_ALIGNMENT_ULONG 4294967295 Compu_IDENTITY 0 4294967295 PHYS_UNIT "SPN" /end CHARACTERISTIC
/begin CHARACTERISTIC FCspn_EGO1_open "FCtl_SPN(111)" VALUE 0x00161E98 /* @ECU_Address@FCtl_SPN@0x021B61BC@ */ ECIPP_ALIGNMENT_ULONG 4294967295 Compu_IDENTITY 0 4294967295 PHYS_UNIT "SPN" /end CHARACTERISTIC
/begin CHARACTERISTIC FCspn_EGO2_open "FCtl_SPN(112)" VALUE 0x00161E9C /* @ECU_Address@FCtl_SPN@0x021B61C0@ */ ECIPP_ALIGNMENT_ULONG 4294967295 Compu_IDENTITY 0 4294967295 PHYS_UNIT "SPN" /end CHARACTERISTIC
/begin CHARACTERISTIC FCspn_EGO3_open "FCtl_SPN(113)" VALUE 0x00161EA0 /* @ECU_Address@FCtl_SPN@0x021B61C4@ */ ECIPP_ALIGNMENT_ULONG 4294967295 Compu_IDENTITY 0 4294967295 PHYS_UNIT "SPN" /end CHARACTERISTIC
/begin CHARACTERISTIC FCspn_EGOH1_off_open "FCtl_SPN(321)" VALUE 0x001621E0 /* @ECU_Address@FCtl_SPN@0x021B6504@ */ ECIPP_ALIGNMENT_ULONG 4294967295 Compu_IDENTITY 0 4294967295 PHYS_UNIT "SPN" /end CHARACTERISTIC
/begin CHARACTERISTIC FCspn_EGOH1_on_short "FCtl_SPN(322)" VALUE 0x001621E4 /* @ECU_Address@FCtl_SPN@0x021B6508@ */ ECIPP_ALIGNMENT_ULONG 4294967295 Compu_IDENTITY 0 4294967295 PHYS_UNIT "SPN" /end CHARACTERISTIC
/begin CHARACTERISTIC FCspn_EGOH2_off_open "FCtl_SPN(323)" VALUE 0x001621E8 /* @ECU_Address@FCtl_SPN@0x021B650C@ */ ECIPP_ALIGNMENT_ULONG 4294967295 Compu_IDENTITY 0 4294967295 PHYS_UNIT "SPN" /end CHARACTERISTIC
/begin CHARACTERISTIC FCspn_EGOH2_on_short "FCtl_SPN(324)" VALUE 0x001621EC /* @ECU_Address@FCtl_SPN@0x021B6510@ */ ECIPP_ALIGNMENT_ULONG 4294967295 Compu_IDENTITY 0 4294967295 PHYS_UNIT "SPN" /end CHARACTERISTIC
/begin CHARACTERISTIC FCspn_EGOH3_off_open "FCtl_SPN(325)" VALUE 0x001621F0 /* @ECU_Address@FCtl_SPN@0x021B6514@ */ ECIPP_ALIGNMENT_ULONG 4294967295 Compu_IDENTITY 0 4294967295 PHYS_UNIT "SPN" /end CHARACTERISTIC
/begin CHARACTERISTIC FCspn_EGOH3_on_short "FCtl_SPN(326)" VALUE 0x001621F4 /* @ECU_Address@FCtl_SPN@0x021B6518@ */ ECIPP_ALIGNMENT_ULONG 4294967295 Compu_IDENTITY 0 4294967295 PHYS_UNIT "SPN" /end CHARACTERISTIC
/begin CHARACTERISTIC FCspn_EGOH4_off_open "FCtl_SPN(327)" VALUE 0x001621F8 /* @ECU_Address@FCtl_SPN@0x021B651C@ */ ECIPP_ALIGNMENT_ULONG 4294967295 Compu_IDENTITY 0 4294967295 PHYS_UNIT "SPN" /end CHARACTERISTIC
/begin CHARACTERISTIC FCspn_EGOH4_on_short "FCtl_SPN(328)" VALUE 0x001621FC /* @ECU_Address@FCtl_SPN@0x021B6520@ */ ECIPP_ALIGNMENT_ULONG 4294967295 Compu_IDENTITY 0 4294967295 PHYS_UNIT "SPN" /end CHARACTERISTIC
/begin CHARACTERISTIC FCspn_EGR_clr_eta_lo "FCtl_SPN(666)" VALUE 0x00162744 /* @ECU_Address@FCtl_SPN@0x021B6A68@ */ ECIPP_ALIGNMENT_ULONG 4294967295 Compu_IDENTITY 0 4294967295 PHYS_UNIT "SPN" /end CHARACTERISTIC
/begin CHARACTERISTIC FCspn_EGR_clr_eta_lo2 "FCtl_SPN(685)" VALUE 0x00162790 /* @ECU_Address@FCtl_SPN@0x021B6AB4@ */ ECIPP_ALIGNMENT_ULONG 4294967295 Compu_IDENTITY 0 4294967295 PHYS_UNIT "SPN" /end CHARACTERISTIC
/begin CHARACTERISTIC FCspn_EGR_deice_excess "FCtl_SPN(829)" VALUE 0x001629D0 /* @ECU_Address@FCtl_SPN@0x021B6CF4@ */ ECIPP_ALIGNMENT_ULONG 4294967295 Compu_IDENTITY 0 4294967295 PHYS_UNIT "SPN" /end CHARACTERISTIC
/begin CHARACTERISTIC FCspn_EGR_offmin_excess "FCtl_SPN(665)" VALUE 0x00162740 /* @ECU_Address@FCtl_SPN@0x021B6A64@ */ ECIPP_ALIGNMENT_ULONG 4294967295 Compu_IDENTITY 0 4294967295 PHYS_UNIT "SPN" /end CHARACTERISTIC
/begin CHARACTERISTIC FCspn_EGR_OOA_hi "FCtl_SPN(661)" VALUE 0x00162730 /* @ECU_Address@FCtl_SPN@0x021B6A54@ */ ECIPP_ALIGNMENT_ULONG 4294967295 Compu_IDENTITY 0 4294967295 PHYS_UNIT "SPN" /end CHARACTERISTIC
/begin CHARACTERISTIC FCspn_EGR_OOA_lo "FCtl_SPN(662)" VALUE 0x00162734 /* @ECU_Address@FCtl_SPN@0x021B6A58@ */ ECIPP_ALIGNMENT_ULONG 4294967295 Compu_IDENTITY 0 4294967295 PHYS_UNIT "SPN" /end CHARACTERISTIC
/begin CHARACTERISTIC FPfl_CATout_OOR "FPrm_latch(658)" VALUE 0x00160A60 /* @ECU_Address@FPrm_latch@0x021BBA48@ */ ECIPP_ALIGNMENT_FLOAT32_IEEE 10000000000 Compu_IDENTITY -10000000000 10000000000 PHYS_UNIT "ms" /end CHARACTERISTIC
/begin CHARACTERISTIC FPfl_CFV_FP_minv "FPrm_latch(517)" VALUE 0x0016082C /* @ECU_Address@FPrm_latch@0x021BB814@ */ ECIPP_ALIGNMENT_FLOAT32_IEEE 10000000000 Compu_IDENTITY -10000000000 10000000000 PHYS_UNIT "ms" /end CHARACTERISTIC
/begin CHARACTERISTIC FPfl_CFV_FT_maxv "FPrm_latch(518)" VALUE 0x00160830 /* @ECU_Address@FPrm_latch@0x021BB818@ */ ECIPP_ALIGNMENT_FLOAT32_IEEE 10000000000 Compu_IDENTITY -10000000000 10000000000 PHYS_UNIT "ms" /end CHARACTERISTIC
/begin CHARACTERISTIC FPfl_CFV_FT_minv "FPrm_latch(519)" VALUE 0x00160834 /* @ECU_Address@FPrm_latch@0x021BB81C@ */ ECIPP_ALIGNMENT_FLOAT32_IEEE 10000000000 Compu_IDENTITY -10000000000 10000000000 PHYS_UNIT "ms" /end CHARACTERISTIC
/begin CHARACTERISTIC FPfl_CFV_mdot_hi "FPrm_latch(393)" VALUE 0x0016063C /* @ECU_Address@FPrm_latch@0x021BB624@ */ ECIPP_ALIGNMENT_FLOAT32_IEEE 10000000000 Compu_IDENTITY -10000000000 10000000000 PHYS_UNIT "ms" /end CHARACTERISTIC
/begin CHARACTERISTIC FPfl_CFV_mdot_lo "FPrm_latch(394)" VALUE 0x00160640 /* @ECU_Address@FPrm_latch@0x021BB628@ */ ECIPP_ALIGNMENT_FLOAT32_IEEE 10000000000 Compu_IDENTITY -10000000000 10000000000 PHYS_UNIT "ms" /end CHARACTERISTIC
/begin CHARACTERISTIC FPfl_CFV_mdot_rms_hi "FPrm_latch(509)" VALUE 0x0016080C /* @ECU_Address@FPrm_latch@0x021BB7F4@ */ ECIPP_ALIGNMENT_FLOAT32_IEEE 10000000000 Compu_IDENTITY -10000000000 10000000000 PHYS_UNIT "ms" /end CHARACTERISTIC
/begin CHARACTERISTIC FPfl_CFV_pwr_loss "FPrm_latch(657)" VALUE 0x00160A5C /* @ECU_Address@FPrm_latch@0x021BBA44@ */ ECIPP_ALIGNMENT_FLOAT32_IEEE 10000000000 Compu_IDENTITY -10000000000 10000000000 PHYS_UNIT "ms" /end CHARACTERISTIC
/begin CHARACTERISTIC FPfl_CFV_RLV_fail "FPrm_latch(405)" VALUE 0x0016066C /* @ECU_Address@FPrm_latch@0x021BB654@ */ ECIPP_ALIGNMENT_FLOAT32_IEEE 10000000000 Compu_IDENTITY -10000000000 10000000000 PHYS_UNIT "none" /end CHARACTERISTIC
/begin CHARACTERISTIC FPfl_CFV_RLV_P_min "FPrm_latch(404)" VALUE 0x00160668 /* @ECU_Address@FPrm_latch@0x021BB650@ */ ECIPP_ALIGNMENT_FLOAT32_IEEE 10000000000 Compu_IDENTITY -10000000000 10000000000 PHYS_UNIT "updates" /end CHARACTERISTIC
/begin CHARACTERISTIC FPfl_CHT_HiExp "FPrm_latch(73)" VALUE 0x0016013C /* @ECU_Address@FPrm_latch@0x021BB124@ */ ECIPP_ALIGNMENT_FLOAT32_IEEE 10000000000 Compu_IDENTITY -10000000000 10000000000 PHYS_UNIT "ms" /end CHARACTERISTIC
/begin CHARACTERISTIC FPfl_CHT_HiExp2 "FPrm_latch(74)" VALUE 0x00160140 /* @ECU_Address@FPrm_latch@0x021BB128@ */ ECIPP_ALIGNMENT_FLOAT32_IEEE 10000000000 Compu_IDENTITY -10000000000 10000000000 PHYS_UNIT "ms" /end CHARACTERISTIC
/begin CHARACTERISTIC FPfl_CL_hi "FPrm_latch(47)" VALUE 0x001600D4 /* @ECU_Address@FPrm_latch@0x021BB0BC@ */ ECIPP_ALIGNMENT_FLOAT32_IEEE 10000000000 Compu_IDENTITY -10000000000 10000000000 PHYS_UNIT "updates" /end CHARACTERISTIC
/begin CHARACTERISTIC FPfl_CL_lo "FPrm_latch(48)" VALUE 0x001600D8 /* @ECU_Address@FPrm_latch@0x021BB0C0@ */ ECIPP_ALIGNMENT_FLOAT32_IEEE 10000000000 Compu_IDENTITY -10000000000 10000000000 PHYS_UNIT "updates" /end CHARACTERISTIC
/begin CHARACTERISTIC FPfl_CL_phi_hi "FPrm_latch(507)" VALUE 0x00160804 /* @ECU_Address@FPrm_latch@0x021BB7EC@ */ ECIPP_ALIGNMENT_FLOAT32_IEEE 10000000000 Compu_IDENTITY -10000000000 10000000000 PHYS_UNIT "updates" /end CHARACTERISTIC
/begin CHARACTERISTIC FPfl_CL_phi_lo "FPrm_latch(508)" VALUE 0x00160808 /* @ECU_Address@FPrm_latch@0x021BB7F0@ */ ECIPP_ALIGNMENT_FLOAT32_IEEE 10000000000 Compu_IDENTITY -10000000000 10000000000 PHYS_UNIT "updates" /end CHARACTERISTIC
/begin CHARACTERISTIC FPfl_CLLP_hi "FPrm_latch(49)" VALUE 0x001600DC /* @ECU_Address@FPrm_latch@0x021BB0C4@ */ ECIPP_ALIGNMENT_FLOAT32_IEEE 10000000000 Compu_IDENTITY -10000000000 10000000000 PHYS_UNIT "updates" /end CHARACTERISTIC
/begin CHARACTERISTIC FPfl_CLLP_lo "FPrm_latch(50)" VALUE 0x001600E0 /* @ECU_Address@FPrm_latch@0x021BB0C8@ */ ECIPP_ALIGNMENT_FLOAT32_IEEE 10000000000 Compu_IDENTITY -10000000000 10000000000 PHYS_UNIT "updates" /end CHARACTERISTIC
/begin CHARACTERISTIC FPfl_CLNG_hi "FPrm_latch(51)" VALUE 0x001600E4 /* @ECU_Address@FPrm_latch@0x021BB0CC@ */ ECIPP_ALIGNMENT_FLOAT32_IEEE 10000000000 Compu_IDENTITY -10000000000 10000000000 PHYS_UNIT "updates" /end CHARACTERISTIC
/begin CHARACTERISTIC FPfl_CLNG_lo "FPrm_latch(52)" VALUE 0x001600E8 /* @ECU_Address@FPrm_latch@0x021BB0D0@ */ ECIPP_ALIGNMENT_FLOAT32_IEEE 10000000000 Compu_IDENTITY -10000000000 10000000000 PHYS_UNIT "updates" /end CHARACTERISTIC
/begin CHARACTERISTIC FPfl_CM_unresp "FPrm_latch(629)" VALUE 0x001609EC /* @ECU_Address@FPrm_latch@0x021BB9D4@ */ ECIPP_ALIGNMENT_FLOAT32_IEEE 10000000000 Compu_IDENTITY -10000000000 10000000000 PHYS_UNIT "ms" /end CHARACTERISTIC
/begin CHARACTERISTIC FPfl_CMgsln_inact "FPrm_latch(89)" VALUE 0x0016017C /* @ECU_Address@FPrm_latch@0x021BB164@ */ ECIPP_ALIGNMENT_FLOAT32_IEEE 10000000000 Compu_IDENTITY -10000000000 10000000000 PHYS_UNIT "updates" /end CHARACTERISTIC
/begin CHARACTERISTIC FPfl_CMLP_inact "FPrm_latch(90)" VALUE 0x00160180 /* @ECU_Address@FPrm_latch@0x021BB168@ */ ECIPP_ALIGNMENT_FLOAT32_IEEE 10000000000 Compu_IDENTITY -10000000000 10000000000 PHYS_UNIT "updates" /end CHARACTERISTIC
/begin CHARACTERISTIC FPfl_CMNG_inact "FPrm_latch(91)" VALUE 0x00160184 /* @ECU_Address@FPrm_latch@0x021BB16C@ */ ECIPP_ALIGNMENT_FLOAT32_IEEE 10000000000 Compu_IDENTITY -10000000000 10000000000 PHYS_UNIT "updates" /end CHARACTERISTIC
/begin CHARACTERISTIC FPfl_COPfail "FPrm_latch(63)" VALUE 0x00160114 /* @ECU_Address@FPrm_latch@0x021BB0FC@ */ ECIPP_ALIGNMENT_FLOAT32_IEEE 10000000000 Compu_IDENTITY -10000000000 10000000000 PHYS_UNIT "ms" /end CHARACTERISTIC
/begin CHARACTERISTIC FPfl_COT_hi "FPrm_latch(487)" VALUE 0x001607B4 /* @ECU_Address@FPrm_latch@0x021BB79C@ */ ECIPP_ALIGNMENT_FLOAT32_IEEE 10000000000 Compu_IDENTITY -10000000000 10000000000 PHYS_UNIT "ms" /end CHARACTERISTIC
/begin CHARACTERISTIC FPfl_crkloss "FPrm_latch(112)" VALUE 0x001601D8 /* @ECU_Address@FPrm_latch@0x021BB1C0@ */ ECIPP_ALIGNMENT_FLOAT32_IEEE 10000000000 Compu_IDENTITY -10000000000 10000000000 PHYS_UNIT "ms" /end CHARACTERISTIC
/begin CHARACTERISTIC FPfl_crknever "FPrm_latch(62)" VALUE 0x00160110 /* @ECU_Address@FPrm_latch@0x021BB0F8@ */ ECIPP_ALIGNMENT_FLOAT32_IEEE 10000000000 Compu_IDENTITY -10000000000 10000000000 PHYS_UNIT "ms" /end CHARACTERISTIC
/begin CHARACTERISTIC FPfl_crknoise "FPrm_latch(61)" VALUE 0x0016010C /* @ECU_Address@FPrm_latch@0x021BB0F4@ */ ECIPP_ALIGNMENT_FLOAT32_IEEE 10000000000 Compu_IDENTITY -10000000000 10000000000 PHYS_UNIT "ms" /end CHARACTERISTIC
/begin CHARACTERISTIC FPfl_CVCS_discon "FPrm_latch(577)" VALUE 0x0016091C /* @ECU_Address@FPrm_latch@0x021BB904@ */ ECIPP_ALIGNMENT_FLOAT32_IEEE 10000000000 Compu_IDENTITY -10000000000 10000000000 PHYS_UNIT "ms" /end CHARACTERISTIC
/begin CHARACTERISTIC FPfl_CVDS_discon "FPrm_latch(578)" VALUE 0x00160920 /* @ECU_Address@FPrm_latch@0x021BB908@ */ ECIPP_ALIGNMENT_FLOAT32_IEEE 10000000000 Compu_IDENTITY -10000000000 10000000000 PHYS_UNIT "ms" /end CHARACTERISTIC
/begin CHARACTERISTIC FPfl_CVP1_hi "FPrm_latch(624)" VALUE 0x001609D8 /* @ECU_Address@FPrm_latch@0x021BB9C0@ */ ECIPP_ALIGNMENT_FLOAT32_IEEE 10000000000 Compu_IDENTITY -10000000000 10000000000 PHYS_UNIT "ms" /end CHARACTERISTIC
/begin CHARACTERISTIC FPfl_CVP1_lo "FPrm_latch(625)" VALUE 0x001609DC /* @ECU_Address@FPrm_latch@0x021BB9C4@ */ ECIPP_ALIGNMENT_FLOAT32_IEEE 10000000000 Compu_IDENTITY -10000000000 10000000000 PHYS_UNIT "ms" /end CHARACTERISTIC
/begin CHARACTERISTIC FPfl_CVP2_hi "FPrm_latch(626)" VALUE 0x001609E0 /* @ECU_Address@FPrm_latch@0x021BB9C8@ */ ECIPP_ALIGNMENT_FLOAT32_IEEE 10000000000 Compu_IDENTITY -10000000000 10000000000 PHYS_UNIT "ms" /end CHARACTERISTIC
/begin CHARACTERISTIC FPfl_CVP2_lo "FPrm_latch(627)" VALUE 0x001609E4 /* @ECU_Address@FPrm_latch@0x021BB9CC@ */ ECIPP_ALIGNMENT_FLOAT32_IEEE 10000000000 Compu_IDENTITY -10000000000 10000000000 PHYS_UNIT "ms" /end CHARACTERISTIC
/begin CHARACTERISTIC FPfl_DBW_I_max "FPrm_latch(397)" VALUE 0x0016064C /* @ECU_Address@FPrm_latch@0x021BB634@ */ ECIPP_ALIGNMENT_FLOAT32_IEEE 10000000000 Compu_IDENTITY -10000000000 10000000000 PHYS_UNIT "ms" /end CHARACTERISTIC
/begin CHARACTERISTIC FPfl_ECam_maxerr "FPrm_latch(211)" VALUE 0x00160364 /* @ECU_Address@FPrm_latch@0x021BB34C@ */ ECIPP_ALIGNMENT_FLOAT32_IEEE 10000000000 Compu_IDENTITY -10000000000 10000000000 PHYS_UNIT "ms" /end CHARACTERISTIC
/begin CHARACTERISTIC FPfl_ECL_low "FPrm_latch(563)" VALUE 0x001608E4 /* @ECU_Address@FPrm_latch@0x021BB8CC@ */ ECIPP_ALIGNMENT_FLOAT32_IEEE 10000000000 Compu_IDENTITY -10000000000 10000000000 PHYS_UNIT "ms" /end CHARACTERISTIC
/begin CHARACTERISTIC FPfl_ECT_AAT_dT_max "FPrm_latch(669)" VALUE 0x00160A8C /* @ECU_Address@FPrm_latch@0x021BBA74@ */ ECIPP_ALIGNMENT_FLOAT32_IEEE 10000000000 Compu_IDENTITY -10000000000 10000000000 PHYS_UNIT "ms" /end CHARACTERISTIC
/begin CHARACTERISTIC FPfl_ECT_derate_actv "FPrm_latch(655)" VALUE 0x00160A54 /* @ECU_Address@FPrm_latch@0x021BBA3C@ */ ECIPP_ALIGNMENT_FLOAT32_IEEE 10000000000 Compu_IDENTITY -10000000000 10000000000 PHYS_UNIT "ms" /end CHARACTERISTIC
/begin CHARACTERISTIC FPfl_ECT_dT_max "FPrm_latch(677)" VALUE 0x00160AAC /* @ECU_Address@FPrm_latch@0x021BBA94@ */ ECIPP_ALIGNMENT_FLOAT32_IEEE 10000000000 Compu_IDENTITY -10000000000 10000000000 PHYS_UNIT "ms" /end CHARACTERISTIC
/begin CHARACTERISTIC FPfl_ECT_EGRT_dT_max "FPrm_latch(670)" VALUE 0x00160A90 /* @ECU_Address@FPrm_latch@0x021BBA78@ */ ECIPP_ALIGNMENT_FLOAT32_IEEE 10000000000 Compu_IDENTITY -10000000000 10000000000 PHYS_UNIT "ms" /end CHARACTERISTIC
/begin CHARACTERISTIC FPfl_ECT_EGT_dT_max "FPrm_latch(673)" VALUE 0x00160A9C /* @ECU_Address@FPrm_latch@0x021BBA84@ */ ECIPP_ALIGNMENT_FLOAT32_IEEE 10000000000 Compu_IDENTITY -10000000000 10000000000 PHYS_UNIT "ms" /end CHARACTERISTIC
/begin CHARACTERISTIC FPfl_ECT_FT_dT_max "FPrm_latch(671)" VALUE 0x00160A94 /* @ECU_Address@FPrm_latch@0x021BBA7C@ */ ECIPP_ALIGNMENT_FLOAT32_IEEE 10000000000 Compu_IDENTITY -10000000000 10000000000 PHYS_UNIT "ms" /end CHARACTERISTIC
/begin CHARACTERISTIC FPfl_ECT_HiExp "FPrm_latch(4)" VALUE 0x00160028 /* @ECU_Address@FPrm_latch@0x021BB010@ */ ECIPP_ALIGNMENT_FLOAT32_IEEE 10000000000 Compu_IDENTITY -10000000000 10000000000 PHYS_UNIT "ms" /end CHARACTERISTIC
/begin CHARACTERISTIC FPfl_ECT_HiExp2 "FPrm_latch(5)" VALUE 0x0016002C /* @ECU_Address@FPrm_latch@0x021BB014@ */ ECIPP_ALIGNMENT_FLOAT32_IEEE 10000000000 Compu_IDENTITY -10000000000 10000000000 PHYS_UNIT "ms" /end CHARACTERISTIC
/begin CHARACTERISTIC FPfl_ECT_IAT_dT_max "FPrm_latch(668)" VALUE 0x00160A88 /* @ECU_Address@FPrm_latch@0x021BBA70@ */ ECIPP_ALIGNMENT_FLOAT32_IEEE 10000000000 Compu_IDENTITY -10000000000 10000000000 PHYS_UNIT "ms" /end CHARACTERISTIC
/begin CHARACTERISTIC FPfl_ECT_LoExp "FPrm_latch(478)" VALUE 0x00160790 /* @ECU_Address@FPrm_latch@0x021BB778@ */ ECIPP_ALIGNMENT_FLOAT32_IEEE 10000000000 Compu_IDENTITY -10000000000 10000000000 PHYS_UNIT "ms" /end CHARACTERISTIC
/begin CHARACTERISTIC FPfl_ECT_LoExp2 "FPrm_latch(479)" VALUE 0x00160794 /* @ECU_Address@FPrm_latch@0x021BB77C@ */ ECIPP_ALIGNMENT_FLOAT32_IEEE 10000000000 Compu_IDENTITY -10000000000 10000000000 PHYS_UNIT "ms" /end CHARACTERISTIC
/begin CHARACTERISTIC FPfl_ECT_maxv "FPrm_latch(2)" VALUE 0x00160020 /* @ECU_Address@FPrm_latch@0x021BB008@ */ ECIPP_ALIGNMENT_FLOAT32_IEEE 10000000000 Compu_IDENTITY -10000000000 10000000000 PHYS_UNIT "ms" /end CHARACTERISTIC
/begin CHARACTERISTIC FPfl_ECT_minv "FPrm_latch(3)" VALUE 0x00160024 /* @ECU_Address@FPrm_latch@0x021BB00C@ */ ECIPP_ALIGNMENT_FLOAT32_IEEE 10000000000 Compu_IDENTITY -10000000000 10000000000 PHYS_UNIT "ms" /end CHARACTERISTIC
/begin CHARACTERISTIC FPfl_ECT_OILT_dT_max "FPrm_latch(672)" VALUE 0x00160A98 /* @ECU_Address@FPrm_latch@0x021BBA80@ */ ECIPP_ALIGNMENT_FLOAT32_IEEE 10000000000 Compu_IDENTITY -10000000000 10000000000 PHYS_UNIT "ms" /end CHARACTERISTIC
/begin CHARACTERISTIC FPfl_ECT_TAUX_dT1_max "FPrm_latch(675)" VALUE 0x00160AA4 /* @ECU_Address@FPrm_latch@0x021BBA8C@ */ ECIPP_ALIGNMENT_FLOAT32_IEEE 10000000000 Compu_IDENTITY -10000000000 10000000000 PHYS_UNIT "ms" /end CHARACTERISTIC
/begin CHARACTERISTIC FPfl_ECT_TAUX_dT2_max "FPrm_latch(676)" VALUE 0x00160AA8 /* @ECU_Address@FPrm_latch@0x021BBA90@ */ ECIPP_ALIGNMENT_FLOAT32_IEEE 10000000000 Compu_IDENTITY -10000000000 10000000000 PHYS_UNIT "ms" /end CHARACTERISTIC
/begin CHARACTERISTIC FPfl_ECT_TIAT_dT_max "FPrm_latch(674)" VALUE 0x00160AA0 /* @ECU_Address@FPrm_latch@0x021BBA88@ */ ECIPP_ALIGNMENT_FLOAT32_IEEE 10000000000 Compu_IDENTITY -10000000000 10000000000 PHYS_UNIT "ms" /end CHARACTERISTIC
/begin CHARACTERISTIC FPfl_EGO1_open "FPrm_latch(71)" VALUE 0x00160134 /* @ECU_Address@FPrm_latch@0x021BB11C@ */ ECIPP_ALIGNMENT_FLOAT32_IEEE 10000000000 Compu_IDENTITY -10000000000 10000000000 PHYS_UNIT "ms" /end CHARACTERISTIC
/begin CHARACTERISTIC FPfl_EGO2_open "FPrm_latch(100)" VALUE 0x001601A8 /* @ECU_Address@FPrm_latch@0x021BB190@ */ ECIPP_ALIGNMENT_FLOAT32_IEEE 10000000000 Compu_IDENTITY -10000000000 10000000000 PHYS_UNIT "ms" /end CHARACTERISTIC
/begin CHARACTERISTIC FPfl_EGO3_open "FPrm_latch(72)" VALUE 0x00160138 /* @ECU_Address@FPrm_latch@0x021BB120@ */ ECIPP_ALIGNMENT_FLOAT32_IEEE 10000000000 Compu_IDENTITY -10000000000 10000000000 PHYS_UNIT "ms" /end CHARACTERISTIC
/begin CHARACTERISTIC FPfl_EGOH1_off_open "FPrm_latch(230)" VALUE 0x001603B0 /* @ECU_Address@FPrm_latch@0x021BB398@ */ ECIPP_ALIGNMENT_FLOAT32_IEEE 10000000000 Compu_IDENTITY -10000000000 10000000000 PHYS_UNIT "ms" /end CHARACTERISTIC
/begin CHARACTERISTIC FPfl_EGOH1_on_short "FPrm_latch(231)" VALUE 0x001603B4 /* @ECU_Address@FPrm_latch@0x021BB39C@ */ ECIPP_ALIGNMENT_FLOAT32_IEEE 10000000000 Compu_IDENTITY -10000000000 10000000000 PHYS_UNIT "ms" /end CHARACTERISTIC
/begin CHARACTERISTIC FPfl_EGOH2_off_open "FPrm_latch(232)" VALUE 0x001603B8 /* @ECU_Address@FPrm_latch@0x021BB3A0@ */ ECIPP_ALIGNMENT_FLOAT32_IEEE 10000000000 Compu_IDENTITY -10000000000 10000000000 PHYS_UNIT "ms" /end CHARACTERISTIC
/begin CHARACTERISTIC FPfl_EGOH2_on_short "FPrm_latch(233)" VALUE 0x001603BC /* @ECU_Address@FPrm_latch@0x021BB3A4@ */ ECIPP_ALIGNMENT_FLOAT32_IEEE 10000000000 Compu_IDENTITY -10000000000 10000000000 PHYS_UNIT "ms" /end CHARACTERISTIC
/begin CHARACTERISTIC FPfl_EGOH3_off_open "FPrm_latch(234)" VALUE 0x001603C0 /* @ECU_Address@FPrm_latch@0x021BB3A8@ */ ECIPP_ALIGNMENT_FLOAT32_IEEE 10000000000 Compu_IDENTITY -10000000000 10000000000 PHYS_UNIT "ms" /end CHARACTERISTIC
/begin CHARACTERISTIC FPfl_EGOH3_on_short "FPrm_latch(235)" VALUE 0x001603C4 /* @ECU_Address@FPrm_latch@0x021BB3AC@ */ ECIPP_ALIGNMENT_FLOAT32_IEEE 10000000000 Compu_IDENTITY -10000000000 10000000000 PHYS_UNIT "ms" /end CHARACTERISTIC
/begin CHARACTERISTIC FPfl_EGOH4_off_open "FPrm_latch(236)" VALUE 0x001603C8 /* @ECU_Address@FPrm_latch@0x021BB3B0@ */ ECIPP_ALIGNMENT_FLOAT32_IEEE 10000000000 Compu_IDENTITY -10000000000 10000000000 PHYS_UNIT "ms" /end CHARACTERISTIC
/begin CHARACTERISTIC FPfl_EGOH4_on_short "FPrm_latch(237)" VALUE 0x001603CC /* @ECU_Address@FPrm_latch@0x021BB3B4@ */ ECIPP_ALIGNMENT_FLOAT32_IEEE 10000000000 Compu_IDENTITY -10000000000 10000000000 PHYS_UNIT "ms" /end CHARACTERISTIC
/begin CHARACTERISTIC FPfl_EGR_clr_eta_lo "FPrm_latch(496)" VALUE 0x001607D8 /* @ECU_Address@FPrm_latch@0x021BB7C0@ */ ECIPP_ALIGNMENT_FLOAT32_IEEE 10000000000 Compu_IDENTITY -10000000000 10000000000 PHYS_UNIT "ms" /end CHARACTERISTIC
/begin CHARACTERISTIC FPfl_EGR_clr_eta_lo2 "FPrm_latch(515)" VALUE 0x00160824 /* @ECU_Address@FPrm_latch@0x021BB80C@ */ ECIPP_ALIGNMENT_FLOAT32_IEEE 10000000000 Compu_IDENTITY -10000000000 10000000000 PHYS_UNIT "ms" /end CHARACTERISTIC
/begin CHARACTERISTIC FPfl_EGR_deice_excess "FPrm_latch(656)" VALUE 0x00160A58 /* @ECU_Address@FPrm_latch@0x021BBA40@ */ ECIPP_ALIGNMENT_FLOAT32_IEEE 10000000000 Compu_IDENTITY -10000000000 10000000000 PHYS_UNIT "ms" /end CHARACTERISTIC
/begin CHARACTERISTIC FPfl_EGR_offmin_excess "FPrm_latch(495)" VALUE 0x001607D4 /* @ECU_Address@FPrm_latch@0x021BB7BC@ */ ECIPP_ALIGNMENT_FLOAT32_IEEE 10000000000 Compu_IDENTITY -10000000000 10000000000 PHYS_UNIT "ms" /end CHARACTERISTIC
/begin CHARACTERISTIC FPfl_EGR_OOA_hi "FPrm_latch(491)" VALUE 0x001607C4 /* @ECU_Address@FPrm_latch@0x021BB7AC@ */ ECIPP_ALIGNMENT_FLOAT32_IEEE 10000000000 Compu_IDENTITY -10000000000 10000000000 PHYS_UNIT "ms" /end CHARACTERISTIC
/begin CHARACTERISTIC FPfl_EGR_OOA_lo "FPrm_latch(492)" VALUE 0x001607C8 /* @ECU_Address@FPrm_latch@0x021BB7B0@ */ ECIPP_ALIGNMENT_FLOAT32_IEEE 10000000000 Compu_IDENTITY -10000000000 10000000000 PHYS_UNIT "ms" /end CHARACTERISTIC
/begin CHARACTERISTIC FPfu_CATout_OOR "FPrm_unlatch(658)" VALUE 0x00161524 /* @ECU_Address@FPrm_unlatch@0x021BDA48@ */ ECIPP_ALIGNMENT_FLOAT32_IEEE 10000000000 Compu_IDENTITY -10000000000 10000000000 PHYS_UNIT "ms" /end CHARACTERISTIC
/begin CHARACTERISTIC FPfu_CFV_FP_minv "FPrm_unlatch(517)" VALUE 0x001612F0 /* @ECU_Address@FPrm_unlatch@0x021BD814@ */ ECIPP_ALIGNMENT_FLOAT32_IEEE 10000000000 Compu_IDENTITY -10000000000 10000000000 PHYS_UNIT "ms" /end CHARACTERISTIC
/begin CHARACTERISTIC FPfu_CFV_FT_maxv "FPrm_unlatch(518)" VALUE 0x001612F4 /* @ECU_Address@FPrm_unlatch@0x021BD818@ */ ECIPP_ALIGNMENT_FLOAT32_IEEE 10000000000 Compu_IDENTITY -10000000000 10000000000 PHYS_UNIT "ms" /end CHARACTERISTIC
/begin CHARACTERISTIC FPfu_CFV_FT_minv "FPrm_unlatch(519)" VALUE 0x001612F8 /* @ECU_Address@FPrm_unlatch@0x021BD81C@ */ ECIPP_ALIGNMENT_FLOAT32_IEEE 10000000000 Compu_IDENTITY -10000000000 10000000000 PHYS_UNIT "ms" /end CHARACTERISTIC
/begin CHARACTERISTIC FPfu_CFV_mdot_hi "FPrm_unlatch(393)" VALUE 0x00161100 /* @ECU_Address@FPrm_unlatch@0x021BD624@ */ ECIPP_ALIGNMENT_FLOAT32_IEEE 10000000000 Compu_IDENTITY -10000000000 10000000000 PHYS_UNIT "ms" /end CHARACTERISTIC
/begin CHARACTERISTIC FPfu_CFV_mdot_lo "FPrm_unlatch(394)" VALUE 0x00161104 /* @ECU_Address@FPrm_unlatch@0x021BD628@ */ ECIPP_ALIGNMENT_FLOAT32_IEEE 10000000000 Compu_IDENTITY -10000000000 10000000000 PHYS_UNIT "ms" /end CHARACTERISTIC
/begin CHARACTERISTIC FPfu_CFV_mdot_rms_hi "FPrm_unlatch(509)" VALUE 0x001612D0 /* @ECU_Address@FPrm_unlatch@0x021BD7F4@ */ ECIPP_ALIGNMENT_FLOAT32_IEEE 10000000000 Compu_IDENTITY -10000000000 10000000000 PHYS_UNIT "ms" /end CHARACTERISTIC
/begin CHARACTERISTIC FPfu_CFV_pwr_loss "FPrm_unlatch(657)" VALUE 0x00161520 /* @ECU_Address@FPrm_unlatch@0x021BDA44@ */ ECIPP_ALIGNMENT_FLOAT32_IEEE 10000000000 Compu_IDENTITY -10000000000 10000000000 PHYS_UNIT "ms" /end CHARACTERISTIC
/begin CHARACTERISTIC FPfu_CFV_RLV_fail "FPrm_unlatch(405)" VALUE 0x00161130 /* @ECU_Address@FPrm_unlatch@0x021BD654@ */ ECIPP_ALIGNMENT_FLOAT32_IEEE 10000000000 Compu_IDENTITY -10000000000 10000000000 PHYS_UNIT "none" /end CHARACTERISTIC
/begin CHARACTERISTIC FPfu_CFV_RLV_P_min "FPrm_unlatch(404)" VALUE 0x0016112C /* @ECU_Address@FPrm_unlatch@0x021BD650@ */ ECIPP_ALIGNMENT_FLOAT32_IEEE 10000000000 Compu_IDENTITY -10000000000 10000000000 PHYS_UNIT "updates" /end CHARACTERISTIC
/begin CHARACTERISTIC FPfu_CHT_HiExp "FPrm_unlatch(73)" VALUE 0x00160C00 /* @ECU_Address@FPrm_unlatch@0x021BD124@ */ ECIPP_ALIGNMENT_FLOAT32_IEEE 10000000000 Compu_IDENTITY -10000000000 10000000000 PHYS_UNIT "ms" /end CHARACTERISTIC
/begin CHARACTERISTIC FPfu_CHT_HiExp2 "FPrm_unlatch(74)" VALUE 0x00160C04 /* @ECU_Address@FPrm_unlatch@0x021BD128@ */ ECIPP_ALIGNMENT_FLOAT32_IEEE 10000000000 Compu_IDENTITY -10000000000 10000000000 PHYS_UNIT "ms" /end CHARACTERISTIC
/begin CHARACTERISTIC FPfu_CL_hi "FPrm_unlatch(47)" VALUE 0x00160B98 /* @ECU_Address@FPrm_unlatch@0x021BD0BC@ */ ECIPP_ALIGNMENT_FLOAT32_IEEE 10000000000 Compu_IDENTITY -10000000000 10000000000 PHYS_UNIT "updates" /end CHARACTERISTIC
/begin CHARACTERISTIC FPfu_CL_lo "FPrm_unlatch(48)" VALUE 0x00160B9C /* @ECU_Address@FPrm_unlatch@0x021BD0C0@ */ ECIPP_ALIGNMENT_FLOAT32_IEEE 10000000000 Compu_IDENTITY -10000000000 10000000000 PHYS_UNIT "updates" /end CHARACTERISTIC
/begin CHARACTERISTIC FPfu_CL_phi_hi "FPrm_unlatch(507)" VALUE 0x001612C8 /* @ECU_Address@FPrm_unlatch@0x021BD7EC@ */ ECIPP_ALIGNMENT_FLOAT32_IEEE 10000000000 Compu_IDENTITY -10000000000 10000000000 PHYS_UNIT "updates" /end CHARACTERISTIC
/begin CHARACTERISTIC FPfu_CL_phi_lo "FPrm_unlatch(508)" VALUE 0x001612CC /* @ECU_Address@FPrm_unlatch@0x021BD7F0@ */ ECIPP_ALIGNMENT_FLOAT32_IEEE 10000000000 Compu_IDENTITY -10000000000 10000000000 PHYS_UNIT "updates" /end CHARACTERISTIC
/begin CHARACTERISTIC FPfu_CLLP_hi "FPrm_unlatch(49)" VALUE 0x00160BA0 /* @ECU_Address@FPrm_unlatch@0x021BD0C4@ */ ECIPP_ALIGNMENT_FLOAT32_IEEE 10000000000 Compu_IDENTITY -10000000000 10000000000 PHYS_UNIT "updates" /end CHARACTERISTIC
/begin CHARACTERISTIC FPfu_CLLP_lo "FPrm_unlatch(50)" VALUE 0x00160BA4 /* @ECU_Address@FPrm_unlatch@0x021BD0C8@ */ ECIPP_ALIGNMENT_FLOAT32_IEEE 10000000000 Compu_IDENTITY -10000000000 10000000000 PHYS_UNIT "updates" /end CHARACTERISTIC
/begin CHARACTERISTIC FPfu_CLNG_hi "FPrm_unlatch(51)" VALUE 0x00160BA8 /* @ECU_Address@FPrm_unlatch@0x021BD0CC@ */ ECIPP_ALIGNMENT_FLOAT32_IEEE 10000000000 Compu_IDENTITY -10000000000 10000000000 PHYS_UNIT "updates" /end CHARACTERISTIC
/begin CHARACTERISTIC FPfu_CLNG_lo "FPrm_unlatch(52)" VALUE 0x00160BAC /* @ECU_Address@FPrm_unlatch@0x021BD0D0@ */ ECIPP_ALIGNMENT_FLOAT32_IEEE 10000000000 Compu_IDENTITY -10000000000 10000000000 PHYS_UNIT "updates" /end CHARACTERISTIC
/begin CHARACTERISTIC FPfu_CM_unresp "FPrm_unlatch(629)" VALUE 0x001614B0 /* @ECU_Address@FPrm_unlatch@0x021BD9D4@ */ ECIPP_ALIGNMENT_FLOAT32_IEEE 10000000000 Compu_IDENTITY -10000000000 10000000000 PHYS_UNIT "ms" /end CHARACTERISTIC
/begin CHARACTERISTIC FPfu_CMgsln_inact "FPrm_unlatch(89)" VALUE 0x00160C40 /* @ECU_Address@FPrm_unlatch@0x021BD164@ */ ECIPP_ALIGNMENT_FLOAT32_IEEE 10000000000 Compu_IDENTITY -10000000000 10000000000 PHYS_UNIT "updates" /end CHARACTERISTIC
/begin CHARACTERISTIC FPfu_CMLP_inact "FPrm_unlatch(90)" VALUE 0x00160C44 /* @ECU_Address@FPrm_unlatch@0x021BD168@ */ ECIPP_ALIGNMENT_FLOAT32_IEEE 10000000000 Compu_IDENTITY -10000000000 10000000000 PHYS_UNIT "updates" /end CHARACTERISTIC
/begin CHARACTERISTIC FPfu_CMNG_inact "FPrm_unlatch(91)" VALUE 0x00160C48 /* @ECU_Address@FPrm_unlatch@0x021BD16C@ */ ECIPP_ALIGNMENT_FLOAT32_IEEE 10000000000 Compu_IDENTITY -10000000000 10000000000 PHYS_UNIT "updates" /end CHARACTERISTIC
/begin CHARACTERISTIC FPfu_COPfail "FPrm_unlatch(63)" VALUE 0x00160BD8 /* @ECU_Address@FPrm_unlatch@0x021BD0FC@ */ ECIPP_ALIGNMENT_FLOAT32_IEEE 10000000000 Compu_IDENTITY -10000000000 10000000000 PHYS_UNIT "ms" /end CHARACTERISTIC
/begin CHARACTERISTIC FPfu_COT_hi "FPrm_unlatch(487)" VALUE 0x00161278 /* @ECU_Address@FPrm_unlatch@0x021BD79C@ */ ECIPP_ALIGNMENT_FLOAT32_IEEE 10000000000 Compu_IDENTITY -10000000000 10000000000 PHYS_UNIT "ms" /end CHARACTERISTIC
/begin CHARACTERISTIC FPfu_crkloss "FPrm_unlatch(112)" VALUE 0x00160C9C /* @ECU_Address@FPrm_unlatch@0x021BD1C0@ */ ECIPP_ALIGNMENT_FLOAT32_IEEE 10000000000 Compu_IDENTITY -10000000000 10000000000 PHYS_UNIT "ms" /end CHARACTERISTIC
/begin CHARACTERISTIC FPfu_crknever "FPrm_unlatch(62)" VALUE 0x00160BD4 /* @ECU_Address@FPrm_unlatch@0x021BD0F8@ */ ECIPP_ALIGNMENT_FLOAT32_IEEE 10000000000 Compu_IDENTITY -10000000000 10000000000 PHYS_UNIT "ms" /end CHARACTERISTIC
/begin CHARACTERISTIC FPfu_crknoise "FPrm_unlatch(61)" VALUE 0x00160BD0 /* @ECU_Address@FPrm_unlatch@0x021BD0F4@ */ ECIPP_ALIGNMENT_FLOAT32_IEEE 10000000000 Compu_IDENTITY -10000000000 10000000000 PHYS_UNIT "ms" /end CHARACTERISTIC
/begin CHARACTERISTIC FPfu_CVCS_discon "FPrm_unlatch(577)" VALUE 0x001613E0 /* @ECU_Address@FPrm_unlatch@0x021BD904@ */ ECIPP_ALIGNMENT_FLOAT32_IEEE 10000000000 Compu_IDENTITY -10000000000 10000000000 PHYS_UNIT "ms" /end CHARACTERISTIC
/begin CHARACTERISTIC FPfu_CVDS_discon "FPrm_unlatch(578)" VALUE 0x001613E4 /* @ECU_Address@FPrm_unlatch@0x021BD908@ */ ECIPP_ALIGNMENT_FLOAT32_IEEE 10000000000 Compu_IDENTITY -10000000000 10000000000 PHYS_UNIT "ms" /end CHARACTERISTIC
/begin CHARACTERISTIC FPfu_CVP1_hi "FPrm_unlatch(624)" VALUE 0x0016149C /* @ECU_Address@FPrm_unlatch@0x021BD9C0@ */ ECIPP_ALIGNMENT_FLOAT32_IEEE 10000000000 Compu_IDENTITY -10000000000 10000000000 PHYS_UNIT "ms" /end CHARACTERISTIC
/begin CHARACTERISTIC FPfu_CVP1_lo "FPrm_unlatch(625)" VALUE 0x001614A0 /* @ECU_Address@FPrm_unlatch@0x021BD9C4@ */ ECIPP_ALIGNMENT_FLOAT32_IEEE 10000000000 Compu_IDENTITY -10000000000 10000000000 PHYS_UNIT "ms" /end CHARACTERISTIC
/begin CHARACTERISTIC FPfu_CVP2_hi "FPrm_unlatch(626)" VALUE 0x001614A4 /* @ECU_Address@FPrm_unlatch@0x021BD9C8@ */ ECIPP_ALIGNMENT_FLOAT32_IEEE 10000000000 Compu_IDENTITY -10000000000 10000000000 PHYS_UNIT "ms" /end CHARACTERISTIC
/begin CHARACTERISTIC FPfu_CVP2_lo "FPrm_unlatch(627)" VALUE 0x001614A8 /* @ECU_Address@FPrm_unlatch@0x021BD9CC@ */ ECIPP_ALIGNMENT_FLOAT32_IEEE 10000000000 Compu_IDENTITY -10000000000 10000000000 PHYS_UNIT "ms" /end CHARACTERISTIC
/begin CHARACTERISTIC FPfu_DBW_I_max "FPrm_unlatch(397)" VALUE 0x00161110 /* @ECU_Address@FPrm_unlatch@0x021BD634@ */ ECIPP_ALIGNMENT_FLOAT32_IEEE 10000000000 Compu_IDENTITY -10000000000 10000000000 PHYS_UNIT "ms" /end CHARACTERISTIC
/begin CHARACTERISTIC FPfu_ECam_maxerr "FPrm_unlatch(211)" VALUE 0x00160E28 /* @ECU_Address@FPrm_unlatch@0x021BD34C@ */ ECIPP_ALIGNMENT_FLOAT32_IEEE 10000000000 Compu_IDENTITY -10000000000 10000000000 PHYS_UNIT "ms" /end CHARACTERISTIC
/begin CHARACTERISTIC FPfu_ECL_low "FPrm_unlatch(563)" VALUE 0x001613A8 /* @ECU_Address@FPrm_unlatch@0x021BD8CC@ */ ECIPP_ALIGNMENT_FLOAT32_IEEE 10000000000 Compu_IDENTITY -10000000000 10000000000 PHYS_UNIT "ms" /end CHARACTERISTIC
/begin CHARACTERISTIC FPfu_ECT_AAT_dT_max "FPrm_unlatch(669)" VALUE 0x00161550 /* @ECU_Address@FPrm_unlatch@0x021BDA74@ */ ECIPP_ALIGNMENT_FLOAT32_IEEE 10000000000 Compu_IDENTITY -10000000000 10000000000 PHYS_UNIT "ms" /end CHARACTERISTIC
/begin CHARACTERISTIC FPfu_ECT_derate_actv "FPrm_unlatch(655)" VALUE 0x00161518 /* @ECU_Address@FPrm_unlatch@0x021BDA3C@ */ ECIPP_ALIGNMENT_FLOAT32_IEEE 10000000000 Compu_IDENTITY -10000000000 10000000000 PHYS_UNIT "ms" /end CHARACTERISTIC
/begin CHARACTERISTIC FPfu_ECT_dT_max "FPrm_unlatch(677)" VALUE 0x00161570 /* @ECU_Address@FPrm_unlatch@0x021BDA94@ */ ECIPP_ALIGNMENT_FLOAT32_IEEE 10000000000 Compu_IDENTITY -10000000000 10000000000 PHYS_UNIT "ms" /end CHARACTERISTIC
/begin CHARACTERISTIC FPfu_ECT_EGRT_dT_max "FPrm_unlatch(670)" VALUE 0x00161554 /* @ECU_Address@FPrm_unlatch@0x021BDA78@ */ ECIPP_ALIGNMENT_FLOAT32_IEEE 10000000000 Compu_IDENTITY -10000000000 10000000000 PHYS_UNIT "ms" /end CHARACTERISTIC
/begin CHARACTERISTIC FPfu_ECT_EGT_dT_max "FPrm_unlatch(673)" VALUE 0x00161560 /* @ECU_Address@FPrm_unlatch@0x021BDA84@ */ ECIPP_ALIGNMENT_FLOAT32_IEEE 10000000000 Compu_IDENTITY -10000000000 10000000000 PHYS_UNIT "ms" /end CHARACTERISTIC
/begin CHARACTERISTIC FPfu_ECT_FT_dT_max "FPrm_unlatch(671)" VALUE 0x00161558 /* @ECU_Address@FPrm_unlatch@0x021BDA7C@ */ ECIPP_ALIGNMENT_FLOAT32_IEEE 10000000000 Compu_IDENTITY -10000000000 10000000000 PHYS_UNIT "ms" /end CHARACTERISTIC
/begin CHARACTERISTIC FPfu_ECT_HiExp "FPrm_unlatch(4)" VALUE 0x00160AEC /* @ECU_Address@FPrm_unlatch@0x021BD010@ */ ECIPP_ALIGNMENT_FLOAT32_IEEE 10000000000 Compu_IDENTITY -10000000000 10000000000 PHYS_UNIT "ms" /end CHARACTERISTIC
/begin CHARACTERISTIC FPfu_ECT_HiExp2 "FPrm_unlatch(5)" VALUE 0x00160AF0 /* @ECU_Address@FPrm_unlatch@0x021BD014@ */ ECIPP_ALIGNMENT_FLOAT32_IEEE 10000000000 Compu_IDENTITY -10000000000 10000000000 PHYS_UNIT "ms" /end CHARACTERISTIC
/begin CHARACTERISTIC FPfu_ECT_IAT_dT_max "FPrm_unlatch(668)" VALUE 0x0016154C /* @ECU_Address@FPrm_unlatch@0x021BDA70@ */ ECIPP_ALIGNMENT_FLOAT32_IEEE 10000000000 Compu_IDENTITY -10000000000 10000000000 PHYS_UNIT "ms" /end CHARACTERISTIC
/begin CHARACTERISTIC FPfu_ECT_LoExp "FPrm_unlatch(478)" VALUE 0x00161254 /* @ECU_Address@FPrm_unlatch@0x021BD778@ */ ECIPP_ALIGNMENT_FLOAT32_IEEE 10000000000 Compu_IDENTITY -10000000000 10000000000 PHYS_UNIT "ms" /end CHARACTERISTIC
/begin CHARACTERISTIC FPfu_ECT_LoExp2 "FPrm_unlatch(479)" VALUE 0x00161258 /* @ECU_Address@FPrm_unlatch@0x021BD77C@ */ ECIPP_ALIGNMENT_FLOAT32_IEEE 10000000000 Compu_IDENTITY -10000000000 10000000000 PHYS_UNIT "ms" /end CHARACTERISTIC
/begin CHARACTERISTIC FPfu_ECT_maxv "FPrm_unlatch(2)" VALUE 0x00160AE4 /* @ECU_Address@FPrm_unlatch@0x021BD008@ */ ECIPP_ALIGNMENT_FLOAT32_IEEE 10000000000 Compu_IDENTITY -10000000000 10000000000 PHYS_UNIT "ms" /end CHARACTERISTIC
/begin CHARACTERISTIC FPfu_ECT_minv "FPrm_unlatch(3)" VALUE 0x00160AE8 /* @ECU_Address@FPrm_unlatch@0x021BD00C@ */ ECIPP_ALIGNMENT_FLOAT32_IEEE 10000000000 Compu_IDENTITY -10000000000 10000000000 PHYS_UNIT "ms" /end CHARACTERISTIC
/begin CHARACTERISTIC FPfu_ECT_OILT_dT_max "FPrm_unlatch(672)" VALUE 0x0016155C /* @ECU_Address@FPrm_unlatch@0x021BDA80@ */ ECIPP_ALIGNMENT_FLOAT32_IEEE 10000000000 Compu_IDENTITY -10000000000 10000000000 PHYS_UNIT "ms" /end CHARACTERISTIC
/begin CHARACTERISTIC FPfu_ECT_TAUX_dT1_max "FPrm_unlatch(675)" VALUE 0x00161568 /* @ECU_Address@FPrm_unlatch@0x021BDA8C@ */ ECIPP_ALIGNMENT_FLOAT32_IEEE 10000000000 Compu_IDENTITY -10000000000 10000000000 PHYS_UNIT "ms" /end CHARACTERISTIC
/begin CHARACTERISTIC FPfu_ECT_TAUX_dT2_max "FPrm_unlatch(676)" VALUE 0x0016156C /* @ECU_Address@FPrm_unlatch@0x021BDA90@ */ ECIPP_ALIGNMENT_FLOAT32_IEEE 10000000000 Compu_IDENTITY -10000000000 10000000000 PHYS_UNIT "ms" /end CHARACTERISTIC
/begin CHARACTERISTIC FPfu_ECT_TIAT_dT_max "FPrm_unlatch(674)" VALUE 0x00161564 /* @ECU_Address@FPrm_unlatch@0x021BDA88@ */ ECIPP_ALIGNMENT_FLOAT32_IEEE 10000000000 Compu_IDENTITY -10000000000 10000000000 PHYS_UNIT "ms" /end CHARACTERISTIC
/begin CHARACTERISTIC FPfu_EGO1_open "FPrm_unlatch(71)" VALUE 0x00160BF8 /* @ECU_Address@FPrm_unlatch@0x021BD11C@ */ ECIPP_ALIGNMENT_FLOAT32_IEEE 10000000000 Compu_IDENTITY -10000000000 10000000000 PHYS_UNIT "ms" /end CHARACTERISTIC
/begin CHARACTERISTIC FPfu_EGO2_open "FPrm_unlatch(100)" VALUE 0x00160C6C /* @ECU_Address@FPrm_unlatch@0x021BD190@ */ ECIPP_ALIGNMENT_FLOAT32_IEEE 10000000000 Compu_IDENTITY -10000000000 10000000000 PHYS_UNIT "ms" /end CHARACTERISTIC
/begin CHARACTERISTIC FPfu_EGO3_open "FPrm_unlatch(72)" VALUE 0x00160BFC /* @ECU_Address@FPrm_unlatch@0x021BD120@ */ ECIPP_ALIGNMENT_FLOAT32_IEEE 10000000000 Compu_IDENTITY -10000000000 10000000000 PHYS_UNIT "ms" /end CHARACTERISTIC
/begin CHARACTERISTIC FPfu_EGOH1_off_open "FPrm_unlatch(230)" VALUE 0x00160E74 /* @ECU_Address@FPrm_unlatch@0x021BD398@ */ ECIPP_ALIGNMENT_FLOAT32_IEEE 10000000000 Compu_IDENTITY -10000000000 10000000000 PHYS_UNIT "ms" /end CHARACTERISTIC
/begin CHARACTERISTIC FPfu_EGOH1_on_short "FPrm_unlatch(231)" VALUE 0x00160E78 /* @ECU_Address@FPrm_unlatch@0x021BD39C@ */ ECIPP_ALIGNMENT_FLOAT32_IEEE 10000000000 Compu_IDENTITY -10000000000 10000000000 PHYS_UNIT "ms" /end CHARACTERISTIC
/begin CHARACTERISTIC FPfu_EGOH2_off_open "FPrm_unlatch(232)" VALUE 0x00160E7C /* @ECU_Address@FPrm_unlatch@0x021BD3A0@ */ ECIPP_ALIGNMENT_FLOAT32_IEEE 10000000000 Compu_IDENTITY -10000000000 10000000000 PHYS_UNIT "ms" /end CHARACTERISTIC
/begin CHARACTERISTIC FPfu_EGOH2_on_short "FPrm_unlatch(233)" VALUE 0x00160E80 /* @ECU_Address@FPrm_unlatch@0x021BD3A4@ */ ECIPP_ALIGNMENT_FLOAT32_IEEE 10000000000 Compu_IDENTITY -10000000000 10000000000 PHYS_UNIT "ms" /end CHARACTERISTIC
/begin CHARACTERISTIC FPfu_EGOH3_off_open "FPrm_unlatch(234)" VALUE 0x00160E84 /* @ECU_Address@FPrm_unlatch@0x021BD3A8@ */ ECIPP_ALIGNMENT_FLOAT32_IEEE 10000000000 Compu_IDENTITY -10000000000 10000000000 PHYS_UNIT "ms" /end CHARACTERISTIC
/begin CHARACTERISTIC FPfu_EGOH3_on_short "FPrm_unlatch(235)" VALUE 0x00160E88 /* @ECU_Address@FPrm_unlatch@0x021BD3AC@ */ ECIPP_ALIGNMENT_FLOAT32_IEEE 10000000000 Compu_IDENTITY -10000000000 10000000000 PHYS_UNIT "ms" /end CHARACTERISTIC
/begin CHARACTERISTIC FPfu_EGOH4_off_open "FPrm_unlatch(236)" VALUE 0x00160E8C /* @ECU_Address@FPrm_unlatch@0x021BD3B0@ */ ECIPP_ALIGNMENT_FLOAT32_IEEE 10000000000 Compu_IDENTITY -10000000000 10000000000 PHYS_UNIT "ms" /end CHARACTERISTIC
/begin CHARACTERISTIC FPfu_EGOH4_on_short "FPrm_unlatch(237)" VALUE 0x00160E90 /* @ECU_Address@FPrm_unlatch@0x021BD3B4@ */ ECIPP_ALIGNMENT_FLOAT32_IEEE 10000000000 Compu_IDENTITY -10000000000 10000000000 PHYS_UNIT "ms" /end CHARACTERISTIC
/begin CHARACTERISTIC FPfu_EGR_clr_eta_lo "FPrm_unlatch(496)" VALUE 0x0016129C /* @ECU_Address@FPrm_unlatch@0x021BD7C0@ */ ECIPP_ALIGNMENT_FLOAT32_IEEE 10000000000 Compu_IDENTITY -10000000000 10000000000 PHYS_UNIT "ms" /end CHARACTERISTIC
/begin CHARACTERISTIC FPfu_EGR_clr_eta_lo2 "FPrm_unlatch(515)" VALUE 0x001612E8 /* @ECU_Address@FPrm_unlatch@0x021BD80C@ */ ECIPP_ALIGNMENT_FLOAT32_IEEE 10000000000 Compu_IDENTITY -10000000000 10000000000 PHYS_UNIT "ms" /end CHARACTERISTIC
/begin CHARACTERISTIC FPfu_EGR_deice_excess "FPrm_unlatch(656)" VALUE 0x0016151C /* @ECU_Address@FPrm_unlatch@0x021BDA40@ */ ECIPP_ALIGNMENT_FLOAT32_IEEE 10000000000 Compu_IDENTITY -10000000000 10000000000 PHYS_UNIT "ms" /end CHARACTERISTIC
/begin CHARACTERISTIC FPfu_EGR_offmin_excess "FPrm_unlatch(495)" VALUE 0x00161298 /* @ECU_Address@FPrm_unlatch@0x021BD7BC@ */ ECIPP_ALIGNMENT_FLOAT32_IEEE 10000000000 Compu_IDENTITY -10000000000 10000000000 PHYS_UNIT "ms" /end CHARACTERISTIC
/begin CHARACTERISTIC FPfu_EGR_OOA_hi "FPrm_unlatch(491)" VALUE 0x00161288 /* @ECU_Address@FPrm_unlatch@0x021BD7AC@ */ ECIPP_ALIGNMENT_FLOAT32_IEEE 10000000000 Compu_IDENTITY -10000000000 10000000000 PHYS_UNIT "ms" /end CHARACTERISTIC
/begin CHARACTERISTIC FPfu_EGR_OOA_lo "FPrm_unlatch(492)" VALUE 0x0016128C /* @ECU_Address@FPrm_unlatch@0x021BD7B0@ */ ECIPP_ALIGNMENT_FLOAT32_IEEE 10000000000 Compu_IDENTITY -10000000000 10000000000 PHYS_UNIT "ms" /end CHARACTERISTIC
/begin GROUP CATout_OOR_EC_Fault "Catalyst outlet temperature out of range"
 /begin REF_CHARACTERISTIC FCdc4_CATout_OOR FCdtc_CATout_OOR FCfmi_CATout_OOR FCftb_CATout_OOR FCspn_CATout_OOR FPfl_CATout_OOR FPfu_CATout_OOR FPnd_CATout_OOR FPsvr_CATout_OOR FPsw_ext1_CATout_OOR FPsw_CATout_OOR /end REF_CHARACTERISTIC
/end GROUP
/begin GROUP CFV_FP_minv_EC_Fault "CFV FP low voltage"
 /begin REF_CHARACTERISTIC FCdc4_CFV_FP_minv FCdtc_CFV_FP_minv FCfmi_CFV_FP_minv FCftb_CFV_FP_minv FCspn_CFV_FP_minv FPfl_CFV_FP_minv FPfu_CFV_FP_minv FPnd_CFV_FP_minv FPsvr_CFV_FP_minv FPsw_ext1_CFV_FP_minv FPsw_CFV_FP_minv /end REF_CHARACTERISTIC
/end GROUP
/begin GROUP CFV_FT_maxv_EC_Fault "CFV FT high voltage"
 /begin REF_CHARACTERISTIC FCdc4_CFV_FT_maxv FCdtc_CFV_FT_maxv FCfmi_CFV_FT_maxv FCftb_CFV_FT_maxv FCspn_CFV_FT_maxv FPfl_CFV_FT_maxv FPfu_CFV_FT_maxv FPnd_CFV_FT_maxv FPsvr_CFV_FT_maxv FPsw_ext1_CFV_FT_maxv FPsw_CFV_FT_maxv /end REF_CHARACTERISTIC
/end GROUP
/begin GROUP CFV_FT_minv_EC_Fault "CFV FT low voltage"
 /begin REF_CHARACTERISTIC FCdc4_CFV_FT_minv FCdtc_CFV_FT_minv FCfmi_CFV_FT_minv FCftb_CFV_FT_minv FCspn_CFV_FT_minv FPfl_CFV_FT_minv FPfu_CFV_FT_minv FPnd_CFV_FT_minv FPsvr_CFV_FT_minv FPsw_ext1_CFV_FT_minv FPsw_CFV_FT_minv /end REF_CHARACTERISTIC
/end GROUP
/begin GROUP CFV_mdot_hi_EC_Fault "CFV flow higher than commanded"
 /begin REF_CHARACTERISTIC FCdc4_CFV_mdot_hi FCdtc_CFV_mdot_hi FCfmi_CFV_mdot_hi FCftb_CFV_mdot_hi FCspn_CFV_mdot_hi FPfl_CFV_mdot_hi FPfu_CFV_mdot_hi FPnd_CFV_mdot_hi FPsvr_CFV_mdot_hi FPsw_ext1_CFV_mdot_hi FPsw_CFV_mdot_hi /end REF_CHARACTERISTIC
/end GROUP
/begin GROUP CFV_mdot_lo_EC_Fault "CFV flow lower than commanded"
 /begin REF_CHARACTERISTIC FCdc4_CFV_mdot_lo FCdtc_CFV_mdot_lo FCfmi_CFV_mdot_lo FCftb_CFV_mdot_lo FCspn_CFV_mdot_lo FPfl_CFV_mdot_lo FPfu_CFV_mdot_lo FPnd_CFV_mdot_lo FPsvr_CFV_mdot_lo FPsw_ext1_CFV_mdot_lo FPsw_CFV_mdot_lo /end REF_CHARACTERISTIC
/end GROUP
/begin GROUP CFV_mdot_rms_hi_EC_Fault "CFV flow error higher than expected"
 /begin REF_CHARACTERISTIC FCdc4_CFV_mdot_rms_hi FCdtc_CFV_mdot_rms_hi FCfmi_CFV_mdot_rms_hi FCftb_CFV_mdot_rms_hi FCspn_CFV_mdot_rms_hi FPfl_CFV_mdot_rms_hi FPfu_CFV_mdot_rms_hi FPnd_CFV_mdot_rms_hi FPsvr_CFV_mdot_rms_hi FPsw_ext1_CFV_mdot_rms_hi FPsw_CFV_mdot_rms_hi /end REF_CHARACTERISTIC
/end GROUP
/begin GROUP CFV_pwr_loss_EC_Fault "CFV power loss fault detection"
 /begin REF_CHARACTERISTIC FCdc4_CFV_pwr_loss FCdtc_CFV_pwr_loss FCfmi_CFV_pwr_loss FCftb_CFV_pwr_loss FCspn_CFV_pwr_loss FPfl_CFV_pwr_loss FPfu_CFV_pwr_loss FPnd_CFV_pwr_loss FPsvr_CFV_pwr_loss FPsw_ext1_CFV_pwr_loss FPsw_CFV_pwr_loss /end REF_CHARACTERISTIC
/end GROUP
/begin GROUP CFV_RLV_fail_EC_Fault "CFV RLV test failed"
 /begin REF_CHARACTERISTIC FCdc4_CFV_RLV_fail FCdtc_CFV_RLV_fail FCfmi_CFV_RLV_fail FCftb_CFV_RLV_fail FCspn_CFV_RLV_fail FPfl_CFV_RLV_fail FPfu_CFV_RLV_fail FPnd_CFV_RLV_fail FPsvr_CFV_RLV_fail FPsw_ext1_CFV_RLV_fail FPsw_CFV_RLV_fail /end REF_CHARACTERISTIC
/end GROUP
/begin GROUP CFV_RLV_P_min_EC_Fault "CFV RLV charge pressure low"
 /begin REF_CHARACTERISTIC FCdc4_CFV_RLV_P_min FCdtc_CFV_RLV_P_min FCfmi_CFV_RLV_P_min FCftb_CFV_RLV_P_min FCspn_CFV_RLV_P_min FPfl_CFV_RLV_P_min FPfu_CFV_RLV_P_min FPnd_CFV_RLV_P_min FPsvr_CFV_RLV_P_min FPsw_ext1_CFV_RLV_P_min FPsw_CFV_RLV_P_min /end REF_CHARACTERISTIC
/end GROUP
/begin GROUP CHT_HiExp_EC_Fault "CHT higher than expected 1"
 /begin REF_CHARACTERISTIC FCdc4_CHT_HiExp FCdtc_CHT_HiExp FCfmi_CHT_HiExp FCftb_CHT_HiExp FCspn_CHT_HiExp FPfl_CHT_HiExp FPfu_CHT_HiExp FPnd_CHT_HiExp FPsvr_CHT_HiExp FPsw_ext1_CHT_HiExp FPsw_CHT_HiExp /end REF_CHARACTERISTIC
/end GROUP
/begin GROUP CHT_HiExp2_EC_Fault "CHT higher than expected 2"
 /begin REF_CHARACTERISTIC FCdc4_CHT_HiExp2 FCdtc_CHT_HiExp2 FCfmi_CHT_HiExp2 FCftb_CHT_HiExp2 FCspn_CHT_HiExp2 FPfl_CHT_HiExp2 FPfu_CHT_HiExp2 FPnd_CHT_HiExp2 FPsvr_CHT_HiExp2 FPsw_ext1_CHT_HiExp2 FPsw_CHT_HiExp2 /end REF_CHARACTERISTIC
/end GROUP
/begin GROUP CL_hi_EC_Fault "CL high gasoline bank1"
 /begin REF_CHARACTERISTIC FCdc4_CL_hi FCdtc_CL_hi FCfmi_CL_hi FCftb_CL_hi FCspn_CL_hi FPfl_CL_hi FPfu_CL_hi FPnd_CL_hi FPsvr_CL_hi FPsw_ext1_CL_hi FPsw_CL_hi /end REF_CHARACTERISTIC
/end GROUP
/begin GROUP CL_lo_EC_Fault "CL low gasoline bank1"
 /begin REF_CHARACTERISTIC FCdc4_CL_lo FCdtc_CL_lo FCfmi_CL_lo FCftb_CL_lo FCspn_CL_lo FPfl_CL_lo FPfu_CL_lo FPnd_CL_lo FPsvr_CL_lo FPsw_ext1_CL_lo FPsw_CL_lo /end REF_CHARACTERISTIC
/end GROUP
/begin GROUP CL_phi_hi_EC_Fault "CL air/fuel ratio control at limit - too rich"
 /begin REF_CHARACTERISTIC FCdc4_CL_phi_hi FCdtc_CL_phi_hi FCfmi_CL_phi_hi FCftb_CL_phi_hi FCspn_CL_phi_hi FPfl_CL_phi_hi FPfu_CL_phi_hi FPnd_CL_phi_hi FPsvr_CL_phi_hi FPsw_ext1_CL_phi_hi FPsw_CL_phi_hi /end REF_CHARACTERISTIC
/end GROUP
/begin GROUP CL_phi_lo_EC_Fault "CL air/fuel ratio control at limit - too lean"
 /begin REF_CHARACTERISTIC FCdc4_CL_phi_lo FCdtc_CL_phi_lo FCfmi_CL_phi_lo FCftb_CL_phi_lo FCspn_CL_phi_lo FPfl_CL_phi_lo FPfu_CL_phi_lo FPnd_CL_phi_lo FPsvr_CL_phi_lo FPsw_ext1_CL_phi_lo FPsw_CL_phi_lo /end REF_CHARACTERISTIC
/end GROUP
/begin GROUP CLLP_hi_EC_Fault "CL high LPG"
 /begin REF_CHARACTERISTIC FCdc4_CLLP_hi FCdtc_CLLP_hi FCfmi_CLLP_hi FCftb_CLLP_hi FCspn_CLLP_hi FPfl_CLLP_hi FPfu_CLLP_hi FPnd_CLLP_hi FPsvr_CLLP_hi FPsw_ext1_CLLP_hi FPsw_CLLP_hi /end REF_CHARACTERISTIC
/end GROUP
/begin GROUP CLLP_lo_EC_Fault "CL low LPG"
 /begin REF_CHARACTERISTIC FCdc4_CLLP_lo FCdtc_CLLP_lo FCfmi_CLLP_lo FCftb_CLLP_lo FCspn_CLLP_lo FPfl_CLLP_lo FPfu_CLLP_lo FPnd_CLLP_lo FPsvr_CLLP_lo FPsw_ext1_CLLP_lo FPsw_CLLP_lo /end REF_CHARACTERISTIC
/end GROUP
/begin GROUP CLNG_hi_EC_Fault "CL high NG"
 /begin REF_CHARACTERISTIC FCdc4_CLNG_hi FCdtc_CLNG_hi FCfmi_CLNG_hi FCftb_CLNG_hi FCspn_CLNG_hi FPfl_CLNG_hi FPfu_CLNG_hi FPnd_CLNG_hi FPsvr_CLNG_hi FPsw_ext1_CLNG_hi FPsw_CLNG_hi /end REF_CHARACTERISTIC
/end GROUP
/begin GROUP CLNG_lo_EC_Fault "CL low NG"
 /begin REF_CHARACTERISTIC FCdc4_CLNG_lo FCdtc_CLNG_lo FCfmi_CLNG_lo FCftb_CLNG_lo FCspn_CLNG_lo FPfl_CLNG_lo FPfu_CLNG_lo FPnd_CLNG_lo FPsvr_CLNG_lo FPsw_ext1_CLNG_lo FPsw_CLNG_lo /end REF_CHARACTERISTIC
/end GROUP
/begin GROUP CM_unresp_EC_Fault "Post-catalyst sensor 1 unresponsive"
 /begin REF_CHARACTERISTIC FCdc4_CM_unresp FCdtc_CM_unresp FCfmi_CM_unresp FCftb_CM_unresp FCspn_CM_unresp FPfl_CM_unresp FPfu_CM_unresp FPnd_CM_unresp FPsvr_CM_unresp FPsw_ext1_CM_unresp FPsw_CM_unresp /end REF_CHARACTERISTIC
/end GROUP
/begin GROUP CMgsln_inact_EC_Fault "Gasoline cat monitor"
 /begin REF_CHARACTERISTIC FCdc4_CMgsln_inact FCdtc_CMgsln_inact FCfmi_CMgsln_inact FCftb_CMgsln_inact FCspn_CMgsln_inact FPfl_CMgsln_inact FPfu_CMgsln_inact FPnd_CMgsln_inact FPsvr_CMgsln_inact FPsw_ext1_CMgsln_inact FPsw_CMgsln_inact /end REF_CHARACTERISTIC
/end GROUP
/begin GROUP CMLP_inact_EC_Fault "LPG cat monitor"
 /begin REF_CHARACTERISTIC FCdc4_CMLP_inact FCdtc_CMLP_inact FCfmi_CMLP_inact FCftb_CMLP_inact FCspn_CMLP_inact FPfl_CMLP_inact FPfu_CMLP_inact FPnd_CMLP_inact FPsvr_CMLP_inact FPsw_ext1_CMLP_inact FPsw_CMLP_inact /end REF_CHARACTERISTIC
/end GROUP
/begin GROUP CMNG_inact_EC_Fault "NG cat monitor"
 /begin REF_CHARACTERISTIC FCdc4_CMNG_inact FCdtc_CMNG_inact FCfmi_CMNG_inact FCftb_CMNG_inact FCspn_CMNG_inact FPfl_CMNG_inact FPfu_CMNG_inact FPnd_CMNG_inact FPsvr_CMNG_inact FPsw_ext1_CMNG_inact FPsw_CMNG_inact /end REF_CHARACTERISTIC
/end GROUP
/begin GROUP COPfail_EC_Fault "COP failure"
 /begin REF_CHARACTERISTIC FCdc4_COPfail FCdtc_COPfail FCfmi_COPfail FCftb_COPfail FCspn_COPfail FPfl_COPfail FPfu_COPfail FPnd_COPfail FPsvr_COPfail FPsw_ext1_COPfail FPsw_COPfail /end REF_CHARACTERISTIC
/end GROUP
/begin GROUP COT_hi_EC_Fault "COT higher than expected"
 /begin REF_CHARACTERISTIC FCdc4_COT_hi FCdtc_COT_hi FCfmi_COT_hi FCftb_COT_hi FCspn_COT_hi FPfl_COT_hi FPfu_COT_hi FPnd_COT_hi FPsvr_COT_hi FPsw_ext1_COT_hi FPsw_COT_hi /end REF_CHARACTERISTIC
/end GROUP
/begin GROUP crkloss_EC_Fault "Crank loss"
 /begin REF_CHARACTERISTIC FCdc4_crkloss FCdtc_crkloss FCfmi_crkloss FCftb_crkloss FCspn_crkloss FPfl_crkloss FPfu_crkloss FPnd_crkloss FPsvr_crkloss FPsw_ext1_crkloss FPsw_crkloss /end REF_CHARACTERISTIC
/end GROUP
/begin GROUP crknever_EC_Fault "Never crank synced at start"
 /begin REF_CHARACTERISTIC FCdc4_crknever FCdtc_crknever FCfmi_crknever FCftb_crknever FCspn_crknever FPfl_crknever FPfu_crknever FPnd_crknever FPsvr_crknever FPsw_ext1_crknever FPsw_crknever /end REF_CHARACTERISTIC
/end GROUP
/begin GROUP crknoise_EC_Fault "Crank sync noise"
 /begin REF_CHARACTERISTIC FCdc4_crknoise FCdtc_crknoise FCfmi_crknoise FCftb_crknoise FCspn_crknoise FPfl_crknoise FPfu_crknoise FPnd_crknoise FPsvr_crknoise FPsw_ext1_crknoise FPsw_crknoise /end REF_CHARACTERISTIC
/end GROUP
/begin GROUP CVCS_discon_EC_Fault "Crankcase ventilation clean side disconnected"
 /begin REF_CHARACTERISTIC FCdc4_CVCS_discon FCdtc_CVCS_discon FCfmi_CVCS_discon FCftb_CVCS_discon FCspn_CVCS_discon FPfl_CVCS_discon FPfu_CVCS_discon FPnd_CVCS_discon FPsvr_CVCS_discon FPsw_ext1_CVCS_discon FPsw_CVCS_discon /end REF_CHARACTERISTIC
/end GROUP
/begin GROUP CVDS_discon_EC_Fault "Crankcase ventilation dirty side disconnected"
 /begin REF_CHARACTERISTIC FCdc4_CVDS_discon FCdtc_CVDS_discon FCfmi_CVDS_discon FCftb_CVDS_discon FCspn_CVDS_discon FPfl_CVDS_discon FPfu_CVDS_discon FPnd_CVDS_discon FPsvr_CVDS_discon FPsw_ext1_CVDS_discon FPsw_CVDS_discon /end REF_CHARACTERISTIC
/end GROUP
/begin GROUP CVP1_hi_EC_Fault "Crankcase pressure 1 high"
 /begin REF_CHARACTERISTIC FCdc4_CVP1_hi FCdtc_CVP1_hi FCfmi_CVP1_hi FCftb_CVP1_hi FCspn_CVP1_hi FPfl_CVP1_hi FPfu_CVP1_hi FPnd_CVP1_hi FPsvr_CVP1_hi FPsw_ext1_CVP1_hi FPsw_CVP1_hi /end REF_CHARACTERISTIC
/end GROUP
/begin GROUP CVP1_lo_EC_Fault "Crankcase pressure 1 low"
 /begin REF_CHARACTERISTIC FCdc4_CVP1_lo FCdtc_CVP1_lo FCfmi_CVP1_lo FCftb_CVP1_lo FCspn_CVP1_lo FPfl_CVP1_lo FPfu_CVP1_lo FPnd_CVP1_lo FPsvr_CVP1_lo FPsw_ext1_CVP1_lo FPsw_CVP1_lo /end REF_CHARACTERISTIC
/end GROUP
/begin GROUP CVP2_hi_EC_Fault "Crankcase pressure 2 high"
 /begin REF_CHARACTERISTIC FCdc4_CVP2_hi FCdtc_CVP2_hi FCfmi_CVP2_hi FCftb_CVP2_hi FCspn_CVP2_hi FPfl_CVP2_hi FPfu_CVP2_hi FPnd_CVP2_hi FPsvr_CVP2_hi FPsw_ext1_CVP2_hi FPsw_CVP2_hi /end REF_CHARACTERISTIC
/end GROUP
/begin GROUP CVP2_lo_EC_Fault "Crankcase pressure 2 low"
 /begin REF_CHARACTERISTIC FCdc4_CVP2_lo FCdtc_CVP2_lo FCfmi_CVP2_lo FCftb_CVP2_lo FCspn_CVP2_lo FPfl_CVP2_lo FPfu_CVP2_lo FPnd_CVP2_lo FPsvr_CVP2_lo FPsw_ext1_CVP2_lo FPsw_CVP2_lo /end REF_CHARACTERISTIC
/end GROUP
/begin GROUP DBW_I_max_EC_Fault "DBW drive current high"
 /begin REF_CHARACTERISTIC FCdc4_DBW_I_max FCdtc_DBW_I_max FCfmi_DBW_I_max FCftb_DBW_I_max FCspn_DBW_I_max FPfl_DBW_I_max FPfu_DBW_I_max FPnd_DBW_I_max FPsvr_DBW_I_max FPsw_ext1_DBW_I_max FPsw_DBW_I_max /end REF_CHARACTERISTIC
/end GROUP
/begin GROUP ECam_maxerr_EC_Fault "Exhaust cam position"
 /begin REF_CHARACTERISTIC FCdc4_ECam_maxerr FCdtc_ECam_maxerr FCfmi_ECam_maxerr FCftb_ECam_maxerr FCspn_ECam_maxerr FPfl_ECam_maxerr FPfu_ECam_maxerr FPnd_ECam_maxerr FPsvr_ECam_maxerr FPsw_ext1_ECam_maxerr FPsw_ECam_maxerr /end REF_CHARACTERISTIC
/end GROUP
/begin GROUP ECL_low_EC_Fault "Engine coolant level low"
 /begin REF_CHARACTERISTIC FCdc4_ECL_low FCdtc_ECL_low FCfmi_ECL_low FCftb_ECL_low FCspn_ECL_low FPfl_ECL_low FPfu_ECL_low FPnd_ECL_low FPsvr_ECL_low FPsw_ext1_ECL_low FPsw_ECL_low /end REF_CHARACTERISTIC
/end GROUP
/begin GROUP ECT_AAT_dT_max_EC_Fault "ECT / AAT delta T high"
 /begin REF_CHARACTERISTIC FCdc4_ECT_AAT_dT_max FCdtc_ECT_AAT_dT_max FCfmi_ECT_AAT_dT_max FCftb_ECT_AAT_dT_max FCspn_ECT_AAT_dT_max FPfl_ECT_AAT_dT_max FPfu_ECT_AAT_dT_max FPnd_ECT_AAT_dT_max FPsvr_ECT_AAT_dT_max FPsw_ext1_ECT_AAT_dT_max FPsw_ECT_AAT_dT_max /end REF_CHARACTERISTIC
/end GROUP
/begin GROUP ECT_derate_actv_EC_Fault "ECT-based derate active"
 /begin REF_CHARACTERISTIC FCdc4_ECT_derate_actv FCdtc_ECT_derate_actv FCfmi_ECT_derate_actv FCftb_ECT_derate_actv FCspn_ECT_derate_actv FPfl_ECT_derate_actv FPfu_ECT_derate_actv FPnd_ECT_derate_actv FPsvr_ECT_derate_actv FPsw_ext1_ECT_derate_actv FPsw_ECT_derate_actv /end REF_CHARACTERISTIC
/end GROUP
/begin GROUP ECT_dT_max_EC_Fault "ECT reference out-of-range"
 /begin REF_CHARACTERISTIC FCdc4_ECT_dT_max FCdtc_ECT_dT_max FCfmi_ECT_dT_max FCftb_ECT_dT_max FCspn_ECT_dT_max FPfl_ECT_dT_max FPfu_ECT_dT_max FPnd_ECT_dT_max FPsvr_ECT_dT_max FPsw_ext1_ECT_dT_max FPsw_ECT_dT_max /end REF_CHARACTERISTIC
/end GROUP
/begin GROUP ECT_EGRT_dT_max_EC_Fault "ECT / EGRT delta T high"
 /begin REF_CHARACTERISTIC FCdc4_ECT_EGRT_dT_max FCdtc_ECT_EGRT_dT_max FCfmi_ECT_EGRT_dT_max FCftb_ECT_EGRT_dT_max FCspn_ECT_EGRT_dT_max FPfl_ECT_EGRT_dT_max FPfu_ECT_EGRT_dT_max FPnd_ECT_EGRT_dT_max FPsvr_ECT_EGRT_dT_max FPsw_ext1_ECT_EGRT_dT_max FPsw_ECT_EGRT_dT_max /end REF_CHARACTERISTIC
/end GROUP
/begin GROUP ECT_EGT_dT_max_EC_Fault "ECT / EGT delta T high"
 /begin REF_CHARACTERISTIC FCdc4_ECT_EGT_dT_max FCdtc_ECT_EGT_dT_max FCfmi_ECT_EGT_dT_max FCftb_ECT_EGT_dT_max FCspn_ECT_EGT_dT_max FPfl_ECT_EGT_dT_max FPfu_ECT_EGT_dT_max FPnd_ECT_EGT_dT_max FPsvr_ECT_EGT_dT_max FPsw_ext1_ECT_EGT_dT_max FPsw_ECT_EGT_dT_max /end REF_CHARACTERISTIC
/end GROUP
/begin GROUP ECT_FT_dT_max_EC_Fault "ECT / FT delta T high"
 /begin REF_CHARACTERISTIC FCdc4_ECT_FT_dT_max FCdtc_ECT_FT_dT_max FCfmi_ECT_FT_dT_max FCftb_ECT_FT_dT_max FCspn_ECT_FT_dT_max FPfl_ECT_FT_dT_max FPfu_ECT_FT_dT_max FPnd_ECT_FT_dT_max FPsvr_ECT_FT_dT_max FPsw_ext1_ECT_FT_dT_max FPsw_ECT_FT_dT_max /end REF_CHARACTERISTIC
/end GROUP
/begin GROUP ECT_HiExp_EC_Fault "ECT higher than expected 1"
 /begin REF_CHARACTERISTIC FCdc4_ECT_HiExp FCdtc_ECT_HiExp FCfmi_ECT_HiExp FCftb_ECT_HiExp FCspn_ECT_HiExp FPfl_ECT_HiExp FPfu_ECT_HiExp FPnd_ECT_HiExp FPsvr_ECT_HiExp FPsw_ext1_ECT_HiExp FPsw_ECT_HiExp /end REF_CHARACTERISTIC
/end GROUP
/begin GROUP ECT_HiExp2_EC_Fault "ECT higher than expected 2"
 /begin REF_CHARACTERISTIC FCdc4_ECT_HiExp2 FCdtc_ECT_HiExp2 FCfmi_ECT_HiExp2 FCftb_ECT_HiExp2 FCspn_ECT_HiExp2 FPfl_ECT_HiExp2 FPfu_ECT_HiExp2 FPnd_ECT_HiExp2 FPsvr_ECT_HiExp2 FPsw_ext1_ECT_HiExp2 FPsw_ECT_HiExp2 /end REF_CHARACTERISTIC
/end GROUP
/begin GROUP ECT_IAT_dT_max_EC_Fault "ECT / IAT delta T high"
 /begin REF_CHARACTERISTIC FCdc4_ECT_IAT_dT_max FCdtc_ECT_IAT_dT_max FCfmi_ECT_IAT_dT_max FCftb_ECT_IAT_dT_max FCspn_ECT_IAT_dT_max FPfl_ECT_IAT_dT_max FPfu_ECT_IAT_dT_max FPnd_ECT_IAT_dT_max FPsvr_ECT_IAT_dT_max FPsw_ext1_ECT_IAT_dT_max FPsw_ECT_IAT_dT_max /end REF_CHARACTERISTIC
/end GROUP
/begin GROUP ECT_LoExp_EC_Fault "ECT lower than expected 1"
 /begin REF_CHARACTERISTIC FCdc4_ECT_LoExp FCdtc_ECT_LoExp FCfmi_ECT_LoExp FCftb_ECT_LoExp FCspn_ECT_LoExp FPfl_ECT_LoExp FPfu_ECT_LoExp FPnd_ECT_LoExp FPsvr_ECT_LoExp FPsw_ext1_ECT_LoExp FPsw_ECT_LoExp /end REF_CHARACTERISTIC
/end GROUP
/begin GROUP ECT_LoExp2_EC_Fault "ECT lower than expected 2"
 /begin REF_CHARACTERISTIC FCdc4_ECT_LoExp2 FCdtc_ECT_LoExp2 FCfmi_ECT_LoExp2 FCftb_ECT_LoExp2 FCspn_ECT_LoExp2 FPfl_ECT_LoExp2 FPfu_ECT_LoExp2 FPnd_ECT_LoExp2 FPsvr_ECT_LoExp2 FPsw_ext1_ECT_LoExp2 FPsw_ECT_LoExp2 /end REF_CHARACTERISTIC
/end GROUP
/begin GROUP ECT_maxv_EC_Fault "ECT / CHT high voltage"
 /begin REF_CHARACTERISTIC FCdc4_ECT_maxv FCdtc_ECT_maxv FCfmi_ECT_maxv FCftb_ECT_maxv FCspn_ECT_maxv FPfl_ECT_maxv FPfu_ECT_maxv FPnd_ECT_maxv FPsvr_ECT_maxv FPsw_ext1_ECT_maxv FPsw_ECT_maxv /end REF_CHARACTERISTIC
/end GROUP
/begin GROUP ECT_minv_EC_Fault "ECT / CHT low voltage"
 /begin REF_CHARACTERISTIC FCdc4_ECT_minv FCdtc_ECT_minv FCfmi_ECT_minv FCftb_ECT_minv FCspn_ECT_minv FPfl_ECT_minv FPfu_ECT_minv FPnd_ECT_minv FPsvr_ECT_minv FPsw_ext1_ECT_minv FPsw_ECT_minv /end REF_CHARACTERISTIC
/end GROUP
/begin GROUP ECT_OILT_dT_max_EC_Fault "ECT / OILT delta T high"
 /begin REF_CHARACTERISTIC FCdc4_ECT_OILT_dT_max FCdtc_ECT_OILT_dT_max FCfmi_ECT_OILT_dT_max FCftb_ECT_OILT_dT_max FCspn_ECT_OILT_dT_max FPfl_ECT_OILT_dT_max FPfu_ECT_OILT_dT_max FPnd_ECT_OILT_dT_max FPsvr_ECT_OILT_dT_max FPsw_ext1_ECT_OILT_dT_max FPsw_ECT_OILT_dT_max /end REF_CHARACTERISTIC
/end GROUP
/begin GROUP ECT_TAUX_dT1_max_EC_Fault "ECT / AUX Temp delta T 1 high"
 /begin REF_CHARACTERISTIC FCdc4_ECT_TAUX_dT1_max FCdtc_ECT_TAUX_dT1_max FCfmi_ECT_TAUX_dT1_max FCftb_ECT_TAUX_dT1_max FCspn_ECT_TAUX_dT1_max FPfl_ECT_TAUX_dT1_max FPfu_ECT_TAUX_dT1_max FPnd_ECT_TAUX_dT1_max FPsvr_ECT_TAUX_dT1_max FPsw_ext1_ECT_TAUX_dT1_max FPsw_ECT_TAUX_dT1_max /end REF_CHARACTERISTIC
/end GROUP
/begin GROUP ECT_TAUX_dT2_max_EC_Fault "ECT / AUX Temp delta T 2 high"
 /begin REF_CHARACTERISTIC FCdc4_ECT_TAUX_dT2_max FCdtc_ECT_TAUX_dT2_max FCfmi_ECT_TAUX_dT2_max FCftb_ECT_TAUX_dT2_max FCspn_ECT_TAUX_dT2_max FPfl_ECT_TAUX_dT2_max FPfu_ECT_TAUX_dT2_max FPnd_ECT_TAUX_dT2_max FPsvr_ECT_TAUX_dT2_max FPsw_ext1_ECT_TAUX_dT2_max FPsw_ECT_TAUX_dT2_max /end REF_CHARACTERISTIC
/end GROUP
/begin GROUP ECT_TIAT_dT_max_EC_Fault "ECT / TIAT delta T high"
 /begin REF_CHARACTERISTIC FCdc4_ECT_TIAT_dT_max FCdtc_ECT_TIAT_dT_max FCfmi_ECT_TIAT_dT_max FCftb_ECT_TIAT_dT_max FCspn_ECT_TIAT_dT_max FPfl_ECT_TIAT_dT_max FPfu_ECT_TIAT_dT_max FPnd_ECT_TIAT_dT_max FPsvr_ECT_TIAT_dT_max FPsw_ext1_ECT_TIAT_dT_max FPsw_ECT_TIAT_dT_max /end REF_CHARACTERISTIC
/end GROUP
/begin GROUP EGO1_open_EC_Fault "EGO1 open / lazy"
 /begin REF_CHARACTERISTIC FCdc4_EGO1_open FCdtc_EGO1_open FCfmi_EGO1_open FCftb_EGO1_open FCspn_EGO1_open FPfl_EGO1_open FPfu_EGO1_open FPnd_EGO1_open FPsvr_EGO1_open FPsw_ext1_EGO1_open FPsw_EGO1_open /end REF_CHARACTERISTIC
/end GROUP
/begin GROUP EGO2_open_EC_Fault "EGO2 open / lazy"
 /begin REF_CHARACTERISTIC FCdc4_EGO2_open FCdtc_EGO2_open FCfmi_EGO2_open FCftb_EGO2_open FCspn_EGO2_open FPfl_EGO2_open FPfu_EGO2_open FPnd_EGO2_open FPsvr_EGO2_open FPsw_ext1_EGO2_open FPsw_EGO2_open /end REF_CHARACTERISTIC
/end GROUP
/begin GROUP EGO3_open_EC_Fault "EGO3 open / lazy"
 /begin REF_CHARACTERISTIC FCdc4_EGO3_open FCdtc_EGO3_open FCfmi_EGO3_open FCftb_EGO3_open FCspn_EGO3_open FPfl_EGO3_open FPfu_EGO3_open FPnd_EGO3_open FPsvr_EGO3_open FPsw_ext1_EGO3_open FPsw_EGO3_open /end REF_CHARACTERISTIC
/end GROUP
/begin GROUP EGOH1_off_open_EC_Fault "EGOH1 open / ground short"
 /begin REF_CHARACTERISTIC FCdc4_EGOH1_off_open FCdtc_EGOH1_off_open FCfmi_EGOH1_off_open FCftb_EGOH1_off_open FCspn_EGOH1_off_open FPfl_EGOH1_off_open FPfu_EGOH1_off_open FPnd_EGOH1_off_open FPsvr_EGOH1_off_open FPsw_ext1_EGOH1_off_open FPsw_EGOH1_off_open /end REF_CHARACTERISTIC
/end GROUP
/begin GROUP EGOH1_on_short_EC_Fault "EGOH1 short to power"
 /begin REF_CHARACTERISTIC FCdc4_EGOH1_on_short FCdtc_EGOH1_on_short FCfmi_EGOH1_on_short FCftb_EGOH1_on_short FCspn_EGOH1_on_short FPfl_EGOH1_on_short FPfu_EGOH1_on_short FPnd_EGOH1_on_short FPsvr_EGOH1_on_short FPsw_ext1_EGOH1_on_short FPsw_EGOH1_on_short /end REF_CHARACTERISTIC
/end GROUP
/begin GROUP EGOH2_off_open_EC_Fault "EGOH2 open / ground short"
 /begin REF_CHARACTERISTIC FCdc4_EGOH2_off_open FCdtc_EGOH2_off_open FCfmi_EGOH2_off_open FCftb_EGOH2_off_open FCspn_EGOH2_off_open FPfl_EGOH2_off_open FPfu_EGOH2_off_open FPnd_EGOH2_off_open FPsvr_EGOH2_off_open FPsw_ext1_EGOH2_off_open FPsw_EGOH2_off_open /end REF_CHARACTERISTIC
/end GROUP
/begin GROUP EGOH2_on_short_EC_Fault "EGOH2 short to power"
 /begin REF_CHARACTERISTIC FCdc4_EGOH2_on_short FCdtc_EGOH2_on_short FCfmi_EGOH2_on_short FCftb_EGOH2_on_short FCspn_EGOH2_on_short FPfl_EGOH2_on_short FPfu_EGOH2_on_short FPnd_EGOH2_on_short FPsvr_EGOH2_on_short FPsw_ext1_EGOH2_on_short FPsw_EGOH2_on_short /end REF_CHARACTERISTIC
/end GROUP
/begin GROUP EGOH3_off_open_EC_Fault "EGOH3 open / ground short"
 /begin REF_CHARACTERISTIC FCdc4_EGOH3_off_open FCdtc_EGOH3_off_open FCfmi_EGOH3_off_open FCftb_EGOH3_off_open FCspn_EGOH3_off_open FPfl_EGOH3_off_open FPfu_EGOH3_off_open FPnd_EGOH3_off_open FPsvr_EGOH3_off_open FPsw_ext1_EGOH3_off_open FPsw_EGOH3_off_open /end REF_CHARACTERISTIC
/end GROUP
/begin GROUP EGOH3_on_short_EC_Fault "EGOH3 short to power"
 /begin REF_CHARACTERISTIC FCdc4_EGOH3_on_short FCdtc_EGOH3_on_short FCfmi_EGOH3_on_short FCftb_EGOH3_on_short FCspn_EGOH3_on_short FPfl_EGOH3_on_short FPfu_EGOH3_on_short FPnd_EGOH3_on_short FPsvr_EGOH3_on_short FPsw_ext1_EGOH3_on_short FPsw_EGOH3_on_short /end REF_CHARACTERISTIC
/end GROUP
/begin GROUP EGOH4_off_open_EC_Fault "EGOH4 open / ground short"
 /begin REF_CHARACTERISTIC FCdc4_EGOH4_off_open FCdtc_EGOH4_off_open FCfmi_EGOH4_off_open FCftb_EGOH4_off_open FCspn_EGOH4_off_open FPfl_EGOH4_off_open FPfu_EGOH4_off_open FPnd_EGOH4_off_open FPsvr_EGOH4_off_open FPsw_ext1_EGOH4_off_open FPsw_EGOH4_off_open /end REF_CHARACTERISTIC
/end GROUP
/begin GROUP EGOH4_on_short_EC_Fault "EGOH4 short to power"
 /begin REF_CHARACTERISTIC FCdc4_EGOH4_on_short FCdtc_EGOH4_on_short FCfmi_EGOH4_on_short FCftb_EGOH4_on_short FCspn_EGOH4_on_short FPfl_EGOH4_on_short FPfu_EGOH4_on_short FPnd_EGOH4_on_short FPsvr_EGOH4_on_short FPsw_ext1_EGOH4_on_short FPsw_EGOH4_on_short /end REF_CHARACTERISTIC
/end GROUP
/begin GROUP EGR_clr_eta_lo_EC_Fault "EGR cooler efficiency low 1"
 /begin REF_CHARACTERISTIC FCdc4_EGR_clr_eta_lo FCdtc_EGR_clr_eta_lo FCfmi_EGR_clr_eta_lo FCftb_EGR_clr_eta_lo FCspn_EGR_clr_eta_lo FPfl_EGR_clr_eta_lo FPfu_EGR_clr_eta_lo FPnd_EGR_clr_eta_lo FPsvr_EGR_clr_eta_lo FPsw_ext1_EGR_clr_eta_lo FPsw_EGR_clr_eta_lo /end REF_CHARACTERISTIC
/end GROUP
/begin GROUP EGR_clr_eta_lo2_EC_Fault "EGR cooler efficiency low 2"
 /begin REF_CHARACTERISTIC FCdc4_EGR_clr_eta_lo2 FCdtc_EGR_clr_eta_lo2 FCfmi_EGR_clr_eta_lo2 FCftb_EGR_clr_eta_lo2 FCspn_EGR_clr_eta_lo2 FPfl_EGR_clr_eta_lo2 FPfu_EGR_clr_eta_lo2 FPnd_EGR_clr_eta_lo2 FPsvr_EGR_clr_eta_lo2 FPsw_ext1_EGR_clr_eta_lo2 FPsw_EGR_clr_eta_lo2 /end REF_CHARACTERISTIC
/end GROUP
/begin GROUP EGR_deice_excess_EC_Fault "EGR excessive de-icing operation"
 /begin REF_CHARACTERISTIC FCdc4_EGR_deice_excess FCdtc_EGR_deice_excess FCfmi_EGR_deice_excess FCftb_EGR_deice_excess FCspn_EGR_deice_excess FPfl_EGR_deice_excess FPfu_EGR_deice_excess FPnd_EGR_deice_excess FPsvr_EGR_deice_excess FPsw_ext1_EGR_deice_excess FPsw_EGR_deice_excess /end REF_CHARACTERISTIC
/end GROUP
/begin GROUP EGR_offmin_excess_EC_Fault "EGR excessive off/min table operation"
 /begin REF_CHARACTERISTIC FCdc4_EGR_offmin_excess FCdtc_EGR_offmin_excess FCfmi_EGR_offmin_excess FCftb_EGR_offmin_excess FCspn_EGR_offmin_excess FPfl_EGR_offmin_excess FPfu_EGR_offmin_excess FPnd_EGR_offmin_excess FPsvr_EGR_offmin_excess FPsw_ext1_EGR_offmin_excess FPsw_EGR_offmin_excess /end REF_CHARACTERISTIC
/end GROUP
/begin GROUP EGR_OOA_hi_EC_Fault "EGR system out-of-authority high"
 /begin REF_CHARACTERISTIC FCdc4_EGR_OOA_hi FCdtc_EGR_OOA_hi FCfmi_EGR_OOA_hi FCftb_EGR_OOA_hi FCspn_EGR_OOA_hi FPfl_EGR_OOA_hi FPfu_EGR_OOA_hi FPnd_EGR_OOA_hi FPsvr_EGR_OOA_hi FPsw_ext1_EGR_OOA_hi FPsw_EGR_OOA_hi /end REF_CHARACTERISTIC
/end GROUP
/begin GROUP EGR_OOA_lo_EC_Fault "EGR system out-of-authority low"
 /begin REF_CHARACTERISTIC FCdc4_EGR_OOA_lo FCdtc_EGR_OOA_lo FCfmi_EGR_OOA_lo FCftb_EGR_OOA_lo FCspn_EGR_OOA_lo FPfl_EGR_OOA_lo FPfu_EGR_OOA_lo FPnd_EGR_OOA_lo FPsvr_EGR_OOA_lo FPsw_ext1_EGR_OOA_lo FPsw_EGR_OOA_lo /end REF_CHARACTERISTIC
/end GROUP
/end MODULE
/end PROJECT
