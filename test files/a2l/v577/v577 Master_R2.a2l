ASAP2_VERSION 1 61
/begin PROJECT Econtrols_4G "4G Test"
/begin HEADER "4G A2L Configuration" PROJECT_NO EControls4G /* config for version control */ VERSION "$Revision: 82130 $:" /* config for version control */ /end HEADER
/begin MODULE EControls_4G_SH2A "EControls 4G"
/begin MOD_COMMON "" DEPOSIT ABSOLUTE BYTE_ORDER MSB_FIRST /end MOD_COMMON
/* Define the Record Layouts */
/begin RECORD_LAYOUT ECIPP_ALIGNMENT_UBYTE FNC_VALUES 1 UBYTE COLUMN_DIR DIRECT /end RECORD_LAYOUT
/begin RECORD_LAYOUT ECIPP_ALIGNMENT_UWORD FNC_VALUES 1 UWORD COLUMN_DIR DIRECT /end RECORD_LAYOUT
/begin RECORD_LAYOUT ECIPP_ALIGNMENT_SWORD FNC_VALUES 1 SWORD COLUMN_DIR DIRECT /end RECORD_LAYOUT
/begin RECORD_LAYOUT ECIPP_ALIGNMENT_ULONG FNC_VALUES 1 ULONG COLUMN_DIR DIRECT /end RECORD_LAYOUT
/begin RECORD_LAYOUT ECIPP_ALIGNMENT_FLOAT32_IEEE FNC_VALUES 1 FLOAT32_IEEE COLUMN_DIR DIRECT /end RECORD_LAYOUT
/begin CHARACTERISTIC PTPs "General # PTPs" VALUE 0x001476d6 /* @ECU_Address@PTPs@0x01006248@ */ ECIPP_ALIGNMENT_UWORD 256 Compu_PTPs 0 255.99609375 /end CHARACTERISTIC
/begin COMPU_METHOD Compu_PTPs " " RAT_FUNC "%.3" "psia" COEFFS 0 256 0 0 0 1 /end COMPU_METHOD
/begin CHARACTERISTIC Run_rpm "General # Run_rpm" VALUE 0x0014777c /* @ECU_Address@Run_rpm@0x01006250@ */ ECIPP_ALIGNMENT_UWORD 65535 Compu_Run_rpm 0 65535 /end CHARACTERISTIC
/begin COMPU_METHOD Compu_Run_rpm " " RAT_FUNC "%.0" "rpm" COEFFS 0 1 0 0 0 1 /end COMPU_METHOD
/begin CHARACTERISTIC TEM_V_diode "General # TEM_V_diode" VALUE 0x00148D68 /* @ECU_Address@TEM_V_diode@0x01006258@ */ ECIPP_ALIGNMENT_UWORD 256 Compu_TEM_V_diode 0 255.99609375 /end CHARACTERISTIC
/begin COMPU_METHOD Compu_TEM_V_diode " " RAT_FUNC "%.3" "volts" COEFFS 0 256 0 0 0 1 /end COMPU_METHOD
/begin CHARACTERISTIC TEM_hard_Ilim "General # TEM_hard_Ilim" VALUE 0x00148D6A /* @ECU_Address@TEM_hard_Ilim@0x01006260@ */ ECIPP_ALIGNMENT_SWORD 32 Compu_TEM_hard_Ilim -32 31.9990234375 /end CHARACTERISTIC
/begin COMPU_METHOD Compu_TEM_hard_Ilim " " RAT_FUNC "%.3" "amps" COEFFS 0 1024 0 0 0 1 /end COMPU_METHOD
/begin CHARACTERISTIC TPS_learn_full_lim "General # TPS_learn_full_lim" VALUE 0x00148D0E /* @ECU_Address@TPS_learn_full_lim@0x01006268@ */ ECIPP_ALIGNMENT_UWORD 5 Compu_TPS_learn_full_lim 0 5.00114468864469 /end CHARACTERISTIC
/begin COMPU_METHOD Compu_TPS_learn_full_lim " " RAT_FUNC "%.3" "volts" COEFFS 0 13104 0 0 0 1 /end COMPU_METHOD
/begin CHARACTERISTIC TPS_learn_full_ofst "General # TPS_learn_full_ofst" VALUE 0x00148D12 /* @ECU_Address@TPS_learn_full_ofst@0x01006270@ */ ECIPP_ALIGNMENT_UWORD 5 Compu_TPS_learn_full_ofst 0 5.00114468864469 /end CHARACTERISTIC
/begin COMPU_METHOD Compu_TPS_learn_full_ofst " " RAT_FUNC "%.3" "volts" COEFFS 0 13104 0 0 0 1 /end COMPU_METHOD
/begin CHARACTERISTIC TPS_learn_idle_lim "General # TPS_learn_idle_lim" VALUE 0x00148D08 /* @ECU_Address@TPS_learn_idle_lim@0x01006278@ */ ECIPP_ALIGNMENT_UWORD 5 Compu_TPS_learn_idle_lim 0 5.00114468864469 /end CHARACTERISTIC
/begin COMPU_METHOD Compu_TPS_learn_idle_lim " " RAT_FUNC "%.3" "volts" COEFFS 0 13104 0 0 0 1 /end COMPU_METHOD
/begin CHARACTERISTIC TPS_learn_idle_ofst "General # TPS_learn_idle_ofst" VALUE 0x00148D0C /* @ECU_Address@TPS_learn_idle_ofst@0x01006280@ */ ECIPP_ALIGNMENT_UWORD 5 Compu_TPS_learn_idle_ofst 0 5.00114468864469 /end CHARACTERISTIC
/begin COMPU_METHOD Compu_TPS_learn_idle_ofst " " RAT_FUNC "%.3" "volts" COEFFS 0 13104 0 0 0 1 /end COMPU_METHOD
/begin CHARACTERISTIC UEGO_active_ll "General # UEGO_active_ll" VALUE 0x001650ba /* @ECU_Address@UEGO_active_ll@0x01006290@ */ ECIPP_ALIGNMENT_UWORD 5 Compu_UEGO_active_ll 0 5.00114468864469 /end CHARACTERISTIC
/begin COMPU_METHOD Compu_UEGO_active_ll " " RAT_FUNC "%.3" "volts" COEFFS 0 13104 0 0 0 1 /end COMPU_METHOD
/begin CHARACTERISTIC UEGO_active_ul "General # UEGO_active_ul" VALUE 0x001650bc /* @ECU_Address@UEGO_active_ul@0x01006298@ */ ECIPP_ALIGNMENT_UWORD 5 Compu_UEGO_active_ul 0 5.00114468864469 /end CHARACTERISTIC
/begin COMPU_METHOD Compu_UEGO_active_ul " " RAT_FUNC "%.3" "volts" COEFFS 0 13104 0 0 0 1 /end COMPU_METHOD
/begin CHARACTERISTIC UEGO_fault_ll "General # UEGO_fault_ll" VALUE 0x001650be /* @ECU_Address@UEGO_fault_ll@0x010062A8@ */ ECIPP_ALIGNMENT_UWORD 5 Compu_UEGO_fault_ll 0 5.00114468864469 /end CHARACTERISTIC
/begin COMPU_METHOD Compu_UEGO_fault_ll " " RAT_FUNC "%.3" "volts" COEFFS 0 13104 0 0 0 1 /end COMPU_METHOD
/begin CHARACTERISTIC UEGO_fault_ul "General # UEGO_fault_ul" VALUE 0x001650c0 /* @ECU_Address@UEGO_fault_ul@0x010062B0@ */ ECIPP_ALIGNMENT_UWORD 5 Compu_UEGO_fault_ul 0 5.00114468864469 /end CHARACTERISTIC
/begin COMPU_METHOD Compu_UEGO_fault_ul " " RAT_FUNC "%.3" "volts" COEFFS 0 13104 0 0 0 1 /end COMPU_METHOD
/begin CHARACTERISTIC UEGO_samp_min "General # UEGO_samp_min" VALUE 0x001479d6 /* @ECU_Address@UEGO_samp_min@0x010062B8@ */ ECIPP_ALIGNMENT_UWORD 65535 Compu_UEGO_samp_min 0 65535 /end CHARACTERISTIC
/begin COMPU_METHOD Compu_UEGO_samp_min " " RAT_FUNC "%.0" "ms" COEFFS 0 1 0 0 0 1 /end COMPU_METHOD
/begin CHARACTERISTIC UEGO_wait "General # UEGO_wait" VALUE 0x001650c2 /* @ECU_Address@UEGO_wait@0x010062C0@ */ ECIPP_ALIGNMENT_UWORD 66 Compu_UEGO_wait 0 65.535 /end CHARACTERISTIC
/begin COMPU_METHOD Compu_UEGO_wait " " RAT_FUNC "%.3" "seconds" COEFFS 0 1000 0 0 0 1 /end COMPU_METHOD
/begin CHARACTERISTIC UEGO_warm_ll "General # UEGO_warm_ll" VALUE 0x001650c4 /* @ECU_Address@UEGO_warm_ll@0x010062C8@ */ ECIPP_ALIGNMENT_UWORD 5 Compu_UEGO_warm_ll 0 5.00114468864469 /end CHARACTERISTIC
/begin COMPU_METHOD Compu_UEGO_warm_ll " " RAT_FUNC "%.3" "volts" COEFFS 0 13104 0 0 0 1 /end COMPU_METHOD
/begin CHARACTERISTIC UEGO_warm_ul "General # UEGO_warm_ul" VALUE 0x001650c6 /* @ECU_Address@UEGO_warm_ul@0x010062D0@ */ ECIPP_ALIGNMENT_UWORD 5 Compu_UEGO_warm_ul 0 5.00114468864469 /end CHARACTERISTIC
/begin COMPU_METHOD Compu_UEGO_warm_ul " " RAT_FUNC "%.3" "volts" COEFFS 0 13104 0 0 0 1 /end COMPU_METHOD
/begin CHARACTERISTIC UEGOc "General # UEGOc" VALUE 0x0016338a /* @ECU_Address@UEGOc@0x010062D8@ */ ECIPP_ALIGNMENT_SWORD 0 Compu_UEGOc -0.39990234375 0.399890139698982 /end CHARACTERISTIC
/begin COMPU_METHOD Compu_UEGOc " " RAT_FUNC "%.3" "phi / volt" COEFFS 0 81940.0048840049 0 0 0 1 /end COMPU_METHOD
/begin CHARACTERISTIC UEGOo "General # UEGOo" VALUE 0x0016338c /* @ECU_Address@UEGOo@0x010062E0@ */ ECIPP_ALIGNMENT_SWORD 4 Compu_UEGOo -4 3.9998779296875 /end CHARACTERISTIC
/begin COMPU_METHOD Compu_UEGOo " " RAT_FUNC "%.3" "phi" COEFFS 0 8192 0 0 0 1 /end COMPU_METHOD
/begin CHARACTERISTIC Underspeed "General # Underspeed" VALUE 0x001479e8 /* @ECU_Address@Underspeed@0x010062E8@ */ ECIPP_ALIGNMENT_UWORD 65535 Compu_Underspeed 0 65535 /end CHARACTERISTIC
/begin COMPU_METHOD Compu_Underspeed " " RAT_FUNC "%.0" "rpm" COEFFS 0 1 0 0 0 1 /end COMPU_METHOD
/begin CHARACTERISTIC VE_CWT_adapt_max "General # VE_CWT_adapt_max" VALUE 0x0014656e /* @ECU_Address@VE_CWT_adapt_max@0x010062F0@ */ ECIPP_ALIGNMENT_SWORD 100 Compu_VE_CWT_adapt_max -100 99.9969482421875 /end CHARACTERISTIC
/begin COMPU_METHOD Compu_VE_CWT_adapt_max " " RAT_FUNC "%.3" "%" COEFFS 0 327.68 0 0 0 1 /end COMPU_METHOD
/begin CHARACTERISTIC VE_CWT_adapt_min "General # VE_CWT_adapt_min" VALUE 0x00146570 /* @ECU_Address@VE_CWT_adapt_min@0x010062F8@ */ ECIPP_ALIGNMENT_SWORD 100 Compu_VE_CWT_adapt_min -100 99.9969482421875 /end CHARACTERISTIC
/begin COMPU_METHOD Compu_VE_CWT_adapt_min " " RAT_FUNC "%.3" "%" COEFFS 0 327.68 0 0 0 1 /end COMPU_METHOD
/begin CHARACTERISTIC V_def "General # V_def" VALUE 0x00147a56 /* @ECU_Address@V_def@0x01006300@ */ ECIPP_ALIGNMENT_UWORD 256 Compu_V_def 0 255.99609375 /end CHARACTERISTIC
/begin COMPU_METHOD Compu_V_def " " RAT_FUNC "%.3" "volts" COEFFS 0 256 0 0 0 1 /end COMPU_METHOD
/begin CHARACTERISTIC WGP_abs_gage "{WGP_abs_gage&0xff=0:psia}{WGP_abs_gage&0xff=1:psig}" VALUE 0x001480ec /* @ECU_Address@WGP_abs_gage@0x01006308@ */ ECIPP_ALIGNMENT_UBYTE 255 WGP_abs_gage_COMPU_VTAB 0 255 BIT_MASK 0xff /end CHARACTERISTIC
/begin COMPU_METHOD WGP_abs_gage_COMPU_VTAB "Verbal Table" TAB_VERB "%.0" "list" COMPU_TAB_REF WGP_abs_gage_COMPU_VTAB_REF /end COMPU_METHOD
/begin COMPU_VTAB WGP_abs_gage_COMPU_VTAB_REF "Verbal Table" TAB_VERB 2 0 "psia" 1 "psig" DEFAULT_VALUE "UNKNOWN" /end COMPU_VTAB
/begin CHARACTERISTIC WGP_ena "{WGP_ena&0xff=0:Disabled}{WGP_ena&0xff=1:WGP Input}{WGP_ena&0xff=2:FP Input}{WGP_ena&0xff=3:Aux PUD1}{WGP_ena&0xff=4:Aux PUD2}{WGP_ena&0xff=5:Aux PUD3}{WGP_ena&0xff=6:Aux PUD4}{WGP_ena&0xff=7:Aux PUD5}{WGP_ena&0xff=8:Aux PUD6}{WGP_ena&0xff=9:Aux PUD7}{WGP" VALUE 0x001480ed /* @ECU_Address@WGP_ena@0x01006310@ */ ECIPP_ALIGNMENT_UBYTE 255 WGP_ena_COMPU_VTAB 0 255 BIT_MASK 0xff /end CHARACTERISTIC
/begin COMPU_METHOD WGP_ena_COMPU_VTAB "Verbal Table" TAB_VERB "%.0" "list" COMPU_TAB_REF WGP_ena_COMPU_VTAB_REF /end COMPU_METHOD
/begin COMPU_VTAB WGP_ena_COMPU_VTAB_REF "Verbal Table" TAB_VERB 31 0 "Disabled" 1 "WGP Input" 2 "FP Input" 3 "Aux PUD1" 4 "Aux PUD2" 5 "Aux PUD3" 6 "Aux PUD4" 7 "Aux PUD5" 8 "Aux PUD6" 9 "Aux PUD7" 10 "Aux PUD8" 11 "Aux PUD9" 12 "Aux PUD10" 13 "Aux PUD11" 14 "Aux PUD12" 15 "Aux PUD13" 16 "Aux PUD14" 17 "Aux PUD15" 18 "Aux PUD16" 19 "Aux PUD17" 20 "Aux PUD18" 21 "Aux PUD19" 22 "Aux PUD20" 23 "Aux PUD21" 24 "Aux PUD22" 25 "Aux PUD23" 26 "Aux PUD24" 27 "Aux PUD25" 28 "Aux PD1" 29 "Aux PD2" 30 "Aux PD3" DEFAULT_VALUE "UNKNOWN" /end COMPU_VTAB
/begin CHARACTERISTIC WGP_maxv "General # WGP_maxv (Fault Condition:WGP voltage >)" VALUE 0x00147a68 /* @ECU_Address@WGP_maxv@0x01006318@ */ ECIPP_ALIGNMENT_UWORD 5 Compu_WGP_maxv 0 5.00114468864469 /end CHARACTERISTIC
/begin COMPU_METHOD Compu_WGP_maxv " " RAT_FUNC "%.3" "volts" COEFFS 0 13104 0 0 0 1 /end COMPU_METHOD
/begin CHARACTERISTIC WGP_minv "General # WGP_minv (Fault Condition:WGP voltage <)" VALUE 0x00147a6a /* @ECU_Address@WGP_minv@0x01006320@ */ ECIPP_ALIGNMENT_UWORD 5 Compu_WGP_minv 0 5.00114468864469 /end CHARACTERISTIC
/begin COMPU_METHOD Compu_WGP_minv " " RAT_FUNC "%.3" "volts" COEFFS 0 13104 0 0 0 1 /end COMPU_METHOD
/begin CHARACTERISTIC deltaBP_MAP "General # deltaBP_MAP" VALUE 0x00147ac0 /* @ECU_Address@deltaBP_MAP@0x01006328@ */ ECIPP_ALIGNMENT_UWORD 256 Compu_deltaBP_MAP 0 255.99609375 /end CHARACTERISTIC
/begin COMPU_METHOD Compu_deltaBP_MAP " " RAT_FUNC "%.3" "psi" COEFFS 0 256 0 0 0 1 /end COMPU_METHOD
/begin CHARACTERISTIC fuel_FP_crct_ena "{fuel_FP_crct_ena&0xff=0:Off}{fuel_FP_crct_ena&0xff=1:On}" VALUE 0x00149068 /* @ECU_Address@fuel_FP_crct_ena@0x01006330@ */ ECIPP_ALIGNMENT_UBYTE 255 fuel_FP_crct_ena_COMPU_VTAB 0 255 BIT_MASK 0xff /end CHARACTERISTIC
/begin COMPU_METHOD fuel_FP_crct_ena_COMPU_VTAB "Verbal Table" TAB_VERB "%.0" "list" COMPU_TAB_REF fuel_FP_crct_ena_COMPU_VTAB_REF /end COMPU_METHOD
/begin COMPU_VTAB fuel_FP_crct_ena_COMPU_VTAB_REF "Verbal Table" TAB_VERB 2 0 "Off" 1 "On" DEFAULT_VALUE "UNKNOWN" /end COMPU_VTAB
/begin CHARACTERISTIC fuel_FT_crct_ena "{fuel_FT_crct_ena&0xff=0:Off}{fuel_FT_crct_ena&0xff=1:On}" VALUE 0x00149069 /* @ECU_Address@fuel_FT_crct_ena@0x01006338@ */ ECIPP_ALIGNMENT_UBYTE 255 fuel_FT_crct_ena_COMPU_VTAB 0 255 BIT_MASK 0xff /end CHARACTERISTIC
/begin COMPU_METHOD fuel_FT_crct_ena_COMPU_VTAB "Verbal Table" TAB_VERB "%.0" "list" COMPU_TAB_REF fuel_FT_crct_ena_COMPU_VTAB_REF /end COMPU_METHOD
/begin COMPU_VTAB fuel_FT_crct_ena_COMPU_VTAB_REF "Verbal Table" TAB_VERB 2 0 "Off" 1 "On" DEFAULT_VALUE "UNKNOWN" /end COMPU_VTAB
/begin CHARACTERISTIC fuel_MAP_crct_ena "{fuel_MAP_crct_ena&0xff=0:Off}{fuel_MAP_crct_ena&0xff=1:On}" VALUE 0x00149066 /* @ECU_Address@fuel_MAP_crct_ena@0x01006340@ */ ECIPP_ALIGNMENT_UBYTE 255 fuel_MAP_crct_ena_COMPU_VTAB 0 255 BIT_MASK 0xff /end CHARACTERISTIC
/begin COMPU_METHOD fuel_MAP_crct_ena_COMPU_VTAB "Verbal Table" TAB_VERB "%.0" "list" COMPU_TAB_REF fuel_MAP_crct_ena_COMPU_VTAB_REF /end COMPU_METHOD
/begin COMPU_VTAB fuel_MAP_crct_ena_COMPU_VTAB_REF "Verbal Table" TAB_VERB 2 0 "Off" 1 "On" DEFAULT_VALUE "UNKNOWN" /end COMPU_VTAB
/begin CHARACTERISTIC fuelclr_FPP "General # fuelclr_FPP" VALUE 0x001650ec /* @ECU_Address@fuelclr_FPP@0x01006348@ */ ECIPP_ALIGNMENT_UWORD 100 Compu_fuelclr_FPP 0 99.9984741210938 /end CHARACTERISTIC
/begin COMPU_METHOD Compu_fuelclr_FPP " " RAT_FUNC "%.3" "%" COEFFS 0 655.36 0 0 0 1 /end COMPU_METHOD
/begin CHARACTERISTIC gamma_N "General # gamma_N" VALUE 0x00147b22 /* @ECU_Address@gamma_N@0x01006358@ */ ECIPP_ALIGNMENT_UWORD 4 Compu_gamma_N 0 3.99993896484375 /end CHARACTERISTIC
/begin COMPU_METHOD Compu_gamma_N " " RAT_FUNC "%.3" "-" COEFFS 0 16384 0 0 0 1 /end COMPU_METHOD
/begin CHARACTERISTIC gamma_P "General # gamma_P" VALUE 0x00147b24 /* @ECU_Address@gamma_P@0x01006360@ */ ECIPP_ALIGNMENT_UWORD 4 Compu_gamma_P 0 3.99993896484375 /end CHARACTERISTIC
/begin COMPU_METHOD Compu_gamma_P " " RAT_FUNC "%.3" "-" COEFFS 0 16384 0 0 0 1 /end COMPU_METHOD
/begin CHARACTERISTIC inj_off_min "General # inj_off_min" VALUE 0x00149054 /* @ECU_Address@inj_off_min@0x01006368@ */ ECIPP_ALIGNMENT_UWORD 210 Compu_inj_off_min 0 209.712 /end CHARACTERISTIC
/begin COMPU_METHOD Compu_inj_off_min " " RAT_FUNC "%.3" "ms" COEFFS 0 312.5 0 0 0 1 /end COMPU_METHOD
/begin CHARACTERISTIC inj_type "{inj_type&0xff=0:Throttle-body}{inj_type&0xff=1:Multi-point - cam sync}{inj_type&0xff=2:Multi-point - crank sync}{inj_type&0xff=3:Direct in-cylinder IVO}{inj_type&0xff=4:Direct in-cylinder TDC}" VALUE 0x0014819f /* @ECU_Address@inj_type@0x01006370@ */ ECIPP_ALIGNMENT_UBYTE 255 inj_type_COMPU_VTAB 0 255 BIT_MASK 0xff /end CHARACTERISTIC
/begin COMPU_METHOD inj_type_COMPU_VTAB "Verbal Table" TAB_VERB "%.0" "list" COMPU_TAB_REF inj_type_COMPU_VTAB_REF /end COMPU_METHOD
/begin COMPU_VTAB inj_type_COMPU_VTAB_REF "Verbal Table" TAB_VERB 5 0 "Throttle-body" 1 "Multi-point - cam sync" 2 "Multi-point - crank sync" 3 "Direct in-cylinder IVO" 4 "Direct in-cylinder TDC" DEFAULT_VALUE "UNKNOWN" /end COMPU_VTAB
/begin CHARACTERISTIC key_off_sleep "General # key_off_sleep" VALUE 0x00144230 /* @ECU_Address@key_off_sleep@0x01006378@ */ ECIPP_ALIGNMENT_ULONG 4294967 Compu_key_off_sleep 0 4294967.295 /end CHARACTERISTIC
/begin COMPU_METHOD Compu_key_off_sleep " " RAT_FUNC "%.3" "seconds" COEFFS 0 1000 0 0 0 1 /end COMPU_METHOD
/begin CHARACTERISTIC key_trig_volts "General # key_trig_volts" VALUE 0x00147b56 /* @ECU_Address@key_trig_volts@0x01006380@ */ ECIPP_ALIGNMENT_UWORD 256 Compu_key_trig_volts 0 255.99609375 /end CHARACTERISTIC
/begin COMPU_METHOD Compu_key_trig_volts " " RAT_FUNC "%.3" "volts" COEFFS 0 256 0 0 0 1 /end COMPU_METHOD
/begin CHARACTERISTIC key_trigrel_volts "General # key_trigrel_volts" VALUE 0x00147b58 /* @ECU_Address@key_trigrel_volts@0x01006388@ */ ECIPP_ALIGNMENT_UWORD 256 Compu_key_trigrel_volts 0 255.99609375 /end CHARACTERISTIC
/begin COMPU_METHOD Compu_key_trigrel_volts " " RAT_FUNC "%.3" "volts" COEFFS 0 256 0 0 0 1 /end COMPU_METHOD
/begin CHARACTERISTIC r_comp "General # r_comp" VALUE 0x00147b66 /* @ECU_Address@r_comp@0x01006390@ */ ECIPP_ALIGNMENT_UWORD 32 Compu_r_comp 0 31.99951171875 /end CHARACTERISTIC
/begin COMPU_METHOD Compu_r_comp " " RAT_FUNC "%.3" "ratio" COEFFS 0 2048 0 0 0 1 /end COMPU_METHOD
/begin CHARACTERISTIC spk_max_global "General # spk_max_global" VALUE 0x00146680 /* @ECU_Address@spk_max_global@0x01006398@ */ ECIPP_ALIGNMENT_SWORD 2048 Compu_spk_max_global -2048 2047.9375 /end CHARACTERISTIC
/begin COMPU_METHOD Compu_spk_max_global " " RAT_FUNC "%.3" "CAD BTDC" COEFFS 0 16 0 0 0 1 /end COMPU_METHOD
/begin CHARACTERISTIC spk_min_global "General # spk_min_global" VALUE 0x00146682 /* @ECU_Address@spk_min_global@0x010063A0@ */ ECIPP_ALIGNMENT_SWORD 2048 Compu_spk_min_global -2048 2047.9375 /end CHARACTERISTIC
/begin COMPU_METHOD Compu_spk_min_global " " RAT_FUNC "%.3" "CAD BTDC" COEFFS 0 16 0 0 0 1 /end COMPU_METHOD
/begin CHARACTERISTIC strt_fuel_off "General # strt_fuel_off" VALUE 0x00147b9c /* @ECU_Address@strt_fuel_off@0x010063A8@ */ ECIPP_ALIGNMENT_UWORD 65535 Compu_strt_fuel_off 0 65535 /end CHARACTERISTIC
/begin COMPU_METHOD Compu_strt_fuel_off " " RAT_FUNC "%.0" "rpm" COEFFS 0 1 0 0 0 1 /end COMPU_METHOD
/begin CHARACTERISTIC strt_ign_rpm "General # strt_ign_rpm" VALUE 0x00147b9e /* @ECU_Address@strt_ign_rpm@0x010063B0@ */ ECIPP_ALIGNMENT_UWORD 65535 Compu_strt_ign_rpm 0 65535 /end CHARACTERISTIC
/begin COMPU_METHOD Compu_strt_ign_rpm " " RAT_FUNC "%.0" "rpm" COEFFS 0 1 0 0 0 1 /end COMPU_METHOD
/begin CHARACTERISTIC sw_debounce "General # sw_debounce" VALUE 0x00147baa /* @ECU_Address@sw_debounce@0x010063C0@ */ ECIPP_ALIGNMENT_UWORD 65535 Compu_sw_debounce 0 65535 /end CHARACTERISTIC
/begin COMPU_METHOD Compu_sw_debounce " " RAT_FUNC "%.0" "ms" COEFFS 0 1 0 0 0 1 /end COMPU_METHOD
/begin CHARACTERISTIC PWPCF "General # PWPCF" VALUE 0x00149058 /* @ECU_Address@PWPCF@0x010063C8@ */ ECIPP_ALIGNMENT_SWORD 0 Compu_PWPCF -0.1024 0.102396875 /end CHARACTERISTIC
/begin COMPU_METHOD Compu_PWPCF " " RAT_FUNC "%.3" "ms/psi" COEFFS 0 320000 0 0 0 1 /end COMPU_METHOD
/begin CHARACTERISTIC PW_zero "General # PW_zero" VALUE 0x00149050 /* @ECU_Address@PW_zero@0x010063D0@ */ ECIPP_ALIGNMENT_UWORD 210 Compu_PW_zero 0 209.712 /end CHARACTERISTIC
/begin COMPU_METHOD Compu_PW_zero " " RAT_FUNC "%.3" "ms" COEFFS 0 312.5 0 0 0 1 /end COMPU_METHOD
/begin CHARACTERISTIC encrypt_key_index_def "{encrypt_key_index_def&0xff=0:Impco}{encrypt_key_index_def&0xff=1:Scania}{encrypt_key_index_def&0xff=2:Hino}{encrypt_key_index_def&0xff=3:Hyundai}{encrypt_key_index_def&0xff=4:Volvo}{encrypt_key_index_def&0xff=5:Aquastar}{encrypt_key_index_def&0xff=6:PCM}" VALUE 0x00148159 /* @ECU_Address@encrypt_key_index_def@0x010063D8@ */ ECIPP_ALIGNMENT_UBYTE 255 encrypt_key_index_def_COMPU_VTAB 0 255 BIT_MASK 0xff /end CHARACTERISTIC
/begin COMPU_METHOD encrypt_key_index_def_COMPU_VTAB "Verbal Table" TAB_VERB "%.0" "list" COMPU_TAB_REF encrypt_key_index_def_COMPU_VTAB_REF /end COMPU_METHOD
/begin COMPU_VTAB encrypt_key_index_def_COMPU_VTAB_REF "Verbal Table" TAB_VERB 71 0 "Impco" 1 "Scania" 2 "Hino" 3 "Hyundai" 4 "Volvo" 5 "Aquastar" 6 "PCM" 7 "Zenith" 8 "PSI" 9 "Rotax" 10 "Shanghai" 11 "EDI" 12 "Wisconsin Motors" 13 "Yuchai Motors" 14 "EOL Tester (All Users)" 15 "ECI Only" 16 "Jehin" 17 "Linde" 18 "Still" 19 "Junhenrich" 20 "EST" 21 "Mast" 22 "Sino Truck" 23 "Amico" 24 "Demo" 25 "Kubota rev 1" 26 "Doosan" 27 "Reserved 3" 28 "Unassigned" 29 "Cummins Power Generation (CPG)" 30 "HHI" 31 "BP Support" 32 "FAW" 33 "Clark" 34 "Indmar" 35 "Ilmor" 36 "Reserved 4" 37 "YUP" 38 "Cummins Power Gen-Northern Pwr" 39 "MTU" 40 "Northern Power" 41 "Reserved 5" 42 "Graham" 43 "Indmar rev 2 Ford" 44 "Raritek" 45 "Kohler rev 1" 46 "PSI rev 2" 47 "DEUTZ" 48 "SwRI" 49 "PSI rev 3" 50 "Weichai" 51 "Graham rev 2" 52 "Kubota rev 2" 53 "CGE rev 1" 54 "Polaris" 55 "Malibu" 56 "Yanmar" 57 "ACTION" 58 "Isuzu" 59 "Reserved 12" 60 "Enovation" 61 "Hatz" 62 "Origin" 63 "Reserved 13" 64 "ChaoChai" 65 "Advantek" 66 "Toyota" 67 "Himoinsa" 68 "Kubota rev 3" 69 "LECS" 70 "Kohler rev 2" DEFAULT_VALUE "UNKNOWN" /end COMPU_VTAB
/begin CHARACTERISTIC J1939_DM5_OBDc3 "{J1939_DM5_OBDc3&0xff=0:None}{J1939_DM5_OBDc3&0xff=1:OBD (Federal, EPA)}{J1939_DM5_OBDc3&0xff=2:OBD I}{J1939_DM5_OBDc3&0xff=3:OBD, OBD II}{J1939_DM5_OBDc3&0xff=4:OBD II (CARB)}{J1939_DM5_OBDc3&0xff=5:OBD II (CARB 2007/8)}{J1939_DM5_OBDc3&0xff=6:OBDM}{J193" VALUE 0x00148C9A /* @ECU_Address@J1939_DM5_OBDc3@0x01006418@ */ ECIPP_ALIGNMENT_UBYTE 255 J1939_DM5_OBDc3_COMPU_VTAB 0 255 BIT_MASK 0xff /end CHARACTERISTIC
/begin COMPU_METHOD J1939_DM5_OBDc3_COMPU_VTAB "Verbal Table" TAB_VERB "%.0" "list" COMPU_TAB_REF J1939_DM5_OBDc3_COMPU_VTAB_REF /end COMPU_METHOD
/begin COMPU_VTAB J1939_DM5_OBDc3_COMPU_VTAB_REF "Verbal Table" TAB_VERB 29 0 "None" 1 "OBD (Federal, EPA)" 2 "OBD I" 3 "OBD, OBD II" 4 "OBD II (CARB)" 5 "OBD II (CARB 2007/8)" 6 "OBDM" 7 "EOBD" 8 "EOBD and OBD" 9 "EOBD and OBD II" 10 "EOBD , OBD and OBD II" 11 "JOBD" 12 "JOBD and OBD II" 13 "JOBD and EOBD" 14 "JOBD, EOBD and OBD II" 15 "HD (EURO VI) B1" 16 "HD (EURO V) B2" 17 "HD (EURO EEC) C" 18 "EMD" 19 "EMD+" 20 "HD OBD P" 21 "HD OBD" 22 "World Wide Harmonized OBD" 23 "HD EOBD" 24 "EURO VI" 25 "OBD, OBD II, HD OBD" 26 "OBD, OBD II, HD OBD P" 27 "China Nationwide Stage 6 (China VI)" 28 "Brazil OBD Diesel" DEFAULT_VALUE "UNKNOWN" /end COMPU_VTAB
/begin CHARACTERISTIC J1939_DM19_calid3 "{J1939_DM19_calid3&0xff=0:Calibration Model No.}{J1939_DM19_calid3&0xff=1:Customer Software PN}" VALUE 0x00148C9B /* @ECU_Address@J1939_DM19_calid3@0x01006420@ */ ECIPP_ALIGNMENT_UBYTE 255 J1939_DM19_calid3_COMPU_VTAB 0 255 BIT_MASK 0xff /end CHARACTERISTIC
/begin COMPU_METHOD J1939_DM19_calid3_COMPU_VTAB "Verbal Table" TAB_VERB "%.0" "list" COMPU_TAB_REF J1939_DM19_calid3_COMPU_VTAB_REF /end COMPU_METHOD
/begin COMPU_VTAB J1939_DM19_calid3_COMPU_VTAB_REF "Verbal Table" TAB_VERB 2 0 "Calibration Model No." 1 "Customer Software PN" DEFAULT_VALUE "UNKNOWN" /end COMPU_VTAB
/begin CHARACTERISTIC J1939_DM5_OBDc2 "{J1939_DM5_OBDc2&0xff=0:None}{J1939_DM5_OBDc2&0xff=1:OBD (Federal, EPA)}{J1939_DM5_OBDc2&0xff=2:OBD I}{J1939_DM5_OBDc2&0xff=3:OBD, OBD II}{J1939_DM5_OBDc2&0xff=4:OBD II (CARB)}{J1939_DM5_OBDc2&0xff=5:OBD II (CARB 2007/8)}{J1939_DM5_OBDc2&0xff=6:OBDM}{J193" VALUE 0x00148902 /* @ECU_Address@J1939_DM5_OBDc2@0x01006438@ */ ECIPP_ALIGNMENT_UBYTE 255 J1939_DM5_OBDc2_COMPU_VTAB 0 255 BIT_MASK 0xff /end CHARACTERISTIC
/begin COMPU_METHOD J1939_DM5_OBDc2_COMPU_VTAB "Verbal Table" TAB_VERB "%.0" "list" COMPU_TAB_REF J1939_DM5_OBDc2_COMPU_VTAB_REF /end COMPU_METHOD
/begin COMPU_VTAB J1939_DM5_OBDc2_COMPU_VTAB_REF "Verbal Table" TAB_VERB 29 0 "None" 1 "OBD (Federal, EPA)" 2 "OBD I" 3 "OBD, OBD II" 4 "OBD II (CARB)" 5 "OBD II (CARB 2007/8)" 6 "OBDM" 7 "EOBD" 8 "EOBD and OBD" 9 "EOBD and OBD II" 10 "EOBD , OBD and OBD II" 11 "JOBD" 12 "JOBD and OBD II" 13 "JOBD and EOBD" 14 "JOBD, EOBD and OBD II" 15 "HD (EURO VI) B1" 16 "HD (EURO V) B2" 17 "HD (EURO EEC) C" 18 "EMD" 19 "EMD+" 20 "HD OBD P" 21 "HD OBD" 22 "World Wide Harmonized OBD" 23 "HD EOBD" 24 "EURO VI" 25 "OBD, OBD II, HD OBD" 26 "OBD, OBD II, HD OBD P" 27 "China Nationwide Stage 6 (China VI)" 28 "Brazil OBD Diesel" DEFAULT_VALUE "UNKNOWN" /end COMPU_VTAB
/begin CHARACTERISTIC J1939_DM19_calid2 "{J1939_DM19_calid2&0xff=0:Calibration Model No.}{J1939_DM19_calid2&0xff=1:Customer Software PN}" VALUE 0x00148903 /* @ECU_Address@J1939_DM19_calid2@0x01006440@ */ ECIPP_ALIGNMENT_UBYTE 255 J1939_DM19_calid2_COMPU_VTAB 0 255 BIT_MASK 0xff /end CHARACTERISTIC
/begin COMPU_METHOD J1939_DM19_calid2_COMPU_VTAB "Verbal Table" TAB_VERB "%.0" "list" COMPU_TAB_REF J1939_DM19_calid2_COMPU_VTAB_REF /end COMPU_METHOD
/begin COMPU_VTAB J1939_DM19_calid2_COMPU_VTAB_REF "Verbal Table" TAB_VERB 2 0 "Calibration Model No." 1 "Customer Software PN" DEFAULT_VALUE "UNKNOWN" /end COMPU_VTAB
/begin CHARACTERISTIC sw_loV "IOConfig # sw_loV" VALUE 0x00147bb2 /* @ECU_Address@sw_loV@0x01006448@ */ ECIPP_ALIGNMENT_UWORD 256 Compu_sw_loV 0 255.99609375 /end CHARACTERISTIC
/begin COMPU_METHOD Compu_sw_loV " " RAT_FUNC "%.3" "volts" COEFFS 0 256 0 0 0 1 /end COMPU_METHOD
/begin CHARACTERISTIC sw_hiV "IOConfig # sw_hiV" VALUE 0x00147bae /* @ECU_Address@sw_hiV@0x01006450@ */ ECIPP_ALIGNMENT_UWORD 256 Compu_sw_hiV 0 255.99609375 /end CHARACTERISTIC
/begin COMPU_METHOD Compu_sw_hiV " " RAT_FUNC "%.3" "volts" COEFFS 0 256 0 0 0 1 /end COMPU_METHOD
/begin CHARACTERISTIC sw_loTri "IOConfig # sw_loTri" VALUE 0x00147bb0 /* @ECU_Address@sw_loTri@0x01006458@ */ ECIPP_ALIGNMENT_UWORD 256 Compu_sw_loTri 0 255.99609375 /end CHARACTERISTIC
/begin COMPU_METHOD Compu_sw_loTri " " RAT_FUNC "%.3" "volts" COEFFS 0 256 0 0 0 1 /end COMPU_METHOD
/begin CHARACTERISTIC sw_hiTri "IOConfig # sw_hiTri" VALUE 0x00147bac /* @ECU_Address@sw_hiTri@0x01006460@ */ ECIPP_ALIGNMENT_UWORD 256 Compu_sw_hiTri 0 255.99609375 /end CHARACTERISTIC
/begin COMPU_METHOD Compu_sw_hiTri " " RAT_FUNC "%.3" "volts" COEFFS 0 256 0 0 0 1 /end COMPU_METHOD
/begin CHARACTERISTIC sw_lowbat "IOConfig # sw_lowbat" VALUE 0x00147bb4 /* @ECU_Address@sw_lowbat@0x01006468@ */ ECIPP_ALIGNMENT_UWORD 256 Compu_sw_lowbat 0 255.99609375 /end CHARACTERISTIC
/begin COMPU_METHOD Compu_sw_lowbat " " RAT_FUNC "%.3" "volts" COEFFS 0 256 0 0 0 1 /end COMPU_METHOD
/begin CHARACTERISTIC camloss "FaultConfig # camloss (Fault Condition:No cam pulse in)" VALUE 0x00148125 /* @ECU_Address@camloss@0x01006478@ */ ECIPP_ALIGNMENT_UBYTE 64 Compu_camloss 0 63.75 /end CHARACTERISTIC
/begin COMPU_METHOD Compu_camloss " " RAT_FUNC "%.3" "cycles" COEFFS 0 4 0 0 0 1 /end COMPU_METHOD
/begin CHARACTERISTIC crknever "FaultConfig # crknever (Fault Condition:Cranking revs without sync >)" VALUE 0x00148131 /* @ECU_Address@crknever@0x01006480@ */ ECIPP_ALIGNMENT_UBYTE 64 Compu_crknever 0 63.75 /end CHARACTERISTIC
/begin COMPU_METHOD Compu_crknever " " RAT_FUNC "%.3" "revs" COEFFS 0 4 0 0 0 1 /end COMPU_METHOD
/begin CHARACTERISTIC ECT_vdr "IOConfig # ECT_vdr" VALUE 0x0014397c /* @ECU_Address@ECT_vdr@0x010064A0@ */ ECIPP_ALIGNMENT_FLOAT32_IEEE 10000000000 Compu_ECT_vdr -10000000000 10000000000 /end CHARACTERISTIC
/begin COMPU_METHOD Compu_ECT_vdr " " RAT_FUNC "%.3" "ohms" COEFFS 0 1 0 0 0 1 /end COMPU_METHOD
/begin CHARACTERISTIC FT_vdr "IOConfig # FT_vdr" VALUE 0x001439bc /* @ECU_Address@FT_vdr@0x010064A8@ */ ECIPP_ALIGNMENT_FLOAT32_IEEE 10000000000 Compu_FT_vdr -10000000000 10000000000 /end CHARACTERISTIC
/begin COMPU_METHOD Compu_FT_vdr " " RAT_FUNC "%.3" "ohms" COEFFS 0 1 0 0 0 1 /end COMPU_METHOD
/begin CHARACTERISTIC CHT_vdr "IOConfig # CHT_vdr" VALUE 0x00143974 /* @ECU_Address@CHT_vdr@0x010064B0@ */ ECIPP_ALIGNMENT_FLOAT32_IEEE 10000000000 Compu_CHT_vdr -10000000000 10000000000 /end CHARACTERISTIC
/begin COMPU_METHOD Compu_CHT_vdr " " RAT_FUNC "%.3" "ohms" COEFFS 0 1 0 0 0 1 /end COMPU_METHOD
/begin CHARACTERISTIC FTgaseous_vdr "IOConfig # FTgaseous_vdr" VALUE 0x001439c0 /* @ECU_Address@FTgaseous_vdr@0x010064B8@ */ ECIPP_ALIGNMENT_FLOAT32_IEEE 10000000000 Compu_FTgaseous_vdr -10000000000 10000000000 /end CHARACTERISTIC
/begin COMPU_METHOD Compu_FTgaseous_vdr " " RAT_FUNC "%.3" "ohms" COEFFS 0 1 0 0 0 1 /end COMPU_METHOD
/begin CHARACTERISTIC FTT_vdr "IOConfig # FTT_vdr" VALUE 0x001439b8 /* @ECU_Address@FTT_vdr@0x010064C0@ */ ECIPP_ALIGNMENT_FLOAT32_IEEE 10000000000 Compu_FTT_vdr -10000000000 10000000000 /end CHARACTERISTIC
/begin COMPU_METHOD Compu_FTT_vdr " " RAT_FUNC "%.3" "ohms" COEFFS 0 1 0 0 0 1 /end COMPU_METHOD
/begin CHARACTERISTIC FST_vdr "IOConfig # FST_vdr" VALUE 0x001439b4 /* @ECU_Address@FST_vdr@0x010064C8@ */ ECIPP_ALIGNMENT_FLOAT32_IEEE 10000000000 Compu_FST_vdr -10000000000 10000000000 /end CHARACTERISTIC
/begin COMPU_METHOD Compu_FST_vdr " " RAT_FUNC "%.3" "ohms" COEFFS 0 1 0 0 0 1 /end COMPU_METHOD
/begin CHARACTERISTIC EMWT_vdr "IOConfig # EMWT_vdr" VALUE 0x00143998 /* @ECU_Address@EMWT_vdr@0x010064D0@ */ ECIPP_ALIGNMENT_FLOAT32_IEEE 10000000000 Compu_EMWT_vdr -10000000000 10000000000 /end CHARACTERISTIC
/begin COMPU_METHOD Compu_EMWT_vdr " " RAT_FUNC "%.3" "ohms" COEFFS 0 1 0 0 0 1 /end COMPU_METHOD
/begin CHARACTERISTIC RPM_high_air "Air # RPM_high_air" VALUE 0x00143a1c /* @ECU_Address@RPM_high_air@0x010064D8@ */ ECIPP_ALIGNMENT_FLOAT32_IEEE 10000000000 Compu_RPM_high_air -10000000000 10000000000 /end CHARACTERISTIC
/begin COMPU_METHOD Compu_RPM_high_air " " RAT_FUNC "%.3" "rpm at high airflow" COEFFS 0 1 0 0 0 1 /end COMPU_METHOD
/begin CHARACTERISTIC VE_high_air "Air # VE_high_air" VALUE 0x00143c3c /* @ECU_Address@VE_high_air@0x010064E0@ */ ECIPP_ALIGNMENT_FLOAT32_IEEE 10000000000 Compu_VE_high_air -10000000000 10000000000 /end CHARACTERISTIC
/begin COMPU_METHOD Compu_VE_high_air " " RAT_FUNC "%.3" "% VE at high airflow" COEFFS 0 1 0 0 0 1 /end COMPU_METHOD
/begin CHARACTERISTIC MAP_high_air "Air # MAP_high_air" VALUE 0x001439d0 /* @ECU_Address@MAP_high_air@0x010064E8@ */ ECIPP_ALIGNMENT_FLOAT32_IEEE 10000000000 Compu_MAP_high_air -10000000000 10000000000 /end CHARACTERISTIC
/begin COMPU_METHOD Compu_MAP_high_air " " RAT_FUNC "%.3" "psia at high airflow" COEFFS 0 1 0 0 0 1 /end COMPU_METHOD
/begin CHARACTERISTIC HEX_MILblk_def_code "FaultConfig # HEX_MILblk_def_code" VALUE 0x00164f1c /* @ECU_Address@HEX_MILblk_def_code@0x010064F0@ */ ECIPP_ALIGNMENT_UWORD 65535 Compu_HEX_MILblk_def_code 0 65535 /end CHARACTERISTIC
/begin COMPU_METHOD Compu_HEX_MILblk_def_code " " RAT_FUNC "%.0" "-" COEFFS 0 1 0 0 0 1 /end COMPU_METHOD
/begin CHARACTERISTIC J1939_Tx2Fail "FaultConfig # J1939_Tx2Fail (Fault Condition:Tx error counter >)" VALUE 0x00148905 /* @ECU_Address@J1939_Tx2Fail@0x01006500@ */ ECIPP_ALIGNMENT_UBYTE 255 Compu_J1939_Tx2Fail 0 255 /end CHARACTERISTIC
/begin COMPU_METHOD Compu_J1939_Tx2Fail " " RAT_FUNC "%.0" "failures" COEFFS 0 1 0 0 0 1 /end COMPU_METHOD
/begin CHARACTERISTIC J1939_Rx2Fail "FaultConfig # J1939_Rx2Fail (Fault Condition:Rx error counter >)" VALUE 0x00148906 /* @ECU_Address@J1939_Rx2Fail@0x01006508@ */ ECIPP_ALIGNMENT_UBYTE 255 Compu_J1939_Rx2Fail 0 255 /end CHARACTERISTIC
/begin COMPU_METHOD Compu_J1939_Rx2Fail " " RAT_FUNC "%.0" "failures" COEFFS 0 1 0 0 0 1 /end COMPU_METHOD
/begin CHARACTERISTIC J1939_Tx3Fail "FaultConfig # J1939_Tx3Fail (Fault Condition:Tx error counter >)" VALUE 0x00148C9D /* @ECU_Address@J1939_Tx3Fail@0x01006518@ */ ECIPP_ALIGNMENT_UBYTE 255 Compu_J1939_Tx3Fail 0 255 /end CHARACTERISTIC
/begin COMPU_METHOD Compu_J1939_Tx3Fail " " RAT_FUNC "%.0" "failures" COEFFS 0 1 0 0 0 1 /end COMPU_METHOD
/begin CHARACTERISTIC J1939_Rx3Fail "FaultConfig # J1939_Rx3Fail (Fault Condition:Rx error counter >)" VALUE 0x00148C9E /* @ECU_Address@J1939_Rx3Fail@0x01006520@ */ ECIPP_ALIGNMENT_UBYTE 255 Compu_J1939_Rx3Fail 0 255 /end CHARACTERISTIC
/begin COMPU_METHOD Compu_J1939_Rx3Fail " " RAT_FUNC "%.0" "failures" COEFFS 0 1 0 0 0 1 /end COMPU_METHOD
/begin CHARACTERISTIC BP_est_ena "{BP_est_ena&0xff=0:BP = default (estimate off)}{BP_est_ena&0xff=1:MAP based estimate}{BP_est_ena&0xff=2:Environmental sensor (CAN)}{BP_est_ena&0xff=3:TOP based estimate}{BP_est_ena&0xff=4:Internal BP sensor}" VALUE 0x00147ce2 /* @ECU_Address@BP_est_ena@0x010067C8@ */ ECIPP_ALIGNMENT_UBYTE 255 BP_est_ena_COMPU_VTAB 0 255 BIT_MASK 0xff /end CHARACTERISTIC
/begin COMPU_METHOD BP_est_ena_COMPU_VTAB "Verbal Table" TAB_VERB "%.0" "list" COMPU_TAB_REF BP_est_ena_COMPU_VTAB_REF /end COMPU_METHOD
/begin COMPU_VTAB BP_est_ena_COMPU_VTAB_REF "Verbal Table" TAB_VERB 5 0 "BP = default (estimate off)" 1 "MAP based estimate" 2 "Environmental sensor (CAN)" 3 "TOP based estimate" 4 "Internal BP sensor" DEFAULT_VALUE "UNKNOWN" /end COMPU_VTAB
/begin CHARACTERISTIC IAT_HiExp_wait "FaultConfig # IAT_HiExp_wait (Fault Condition:run-time wait for all IAT HiExp faults:)" VALUE 0x001440f4 /* @ECU_Address@IAT_HiExp_wait@0x010067E0@ */ ECIPP_ALIGNMENT_ULONG 4294967 Compu_IAT_HiExp_wait 0 4294967.295 /end CHARACTERISTIC
/begin COMPU_METHOD Compu_IAT_HiExp_wait " " RAT_FUNC "%.3" "seconds" COEFFS 0 1000 0 0 0 1 /end COMPU_METHOD
/begin CHARACTERISTIC FP_low "FaultConfig # FP_low (Fault Condition:Non-Common-Rail Primary fuel pressure <)" VALUE 0x00149040 /* @ECU_Address@FP_low@0x01006800@ */ ECIPP_ALIGNMENT_UWORD 256 Compu_FP_low 0 255.99609375 /end CHARACTERISTIC
/begin COMPU_METHOD Compu_FP_low " " RAT_FUNC "%.3" "psia" COEFFS 0 256 0 0 0 1 /end COMPU_METHOD
/begin CHARACTERISTIC FP_high "FaultConfig # FP_high (Fault Condition:Non-Common-Rail Primary fuel pressure >)" VALUE 0x00149042 /* @ECU_Address@FP_high@0x01006808@ */ ECIPP_ALIGNMENT_UWORD 256 Compu_FP_high 0 255.99609375 /end CHARACTERISTIC
/begin COMPU_METHOD Compu_FP_high " " RAT_FUNC "%.3" "psia" COEFFS 0 256 0 0 0 1 /end COMPU_METHOD
/begin CHARACTERISTIC FP_highlow_wait "FaultConfig # FP_highlow_wait (Fault Condition:run time wait for fuel pressure high/low faults:)" VALUE 0x0014903C /* @ECU_Address@FP_highlow_wait@0x01006810@ */ ECIPP_ALIGNMENT_ULONG 4294967 Compu_FP_highlow_wait 0 4294967.295 /end CHARACTERISTIC
/begin COMPU_METHOD Compu_FP_highlow_wait " " RAT_FUNC "%.3" "seconds" COEFFS 0 1000 0 0 0 1 /end COMPU_METHOD
/begin CHARACTERISTIC SHIFT_FB_OOR "IOConfig # SHIFT_FB_OOR (Fault Condition:Absent shaft rotation OR shift position feedback >)" VALUE 0x00165002 /* @ECU_Address@SHIFT_FB_OOR@0x01006968@ */ ECIPP_ALIGNMENT_UWORD 5 Compu_SHIFT_FB_OOR 0 5.00114468864469 /end CHARACTERISTIC
/begin COMPU_METHOD Compu_SHIFT_FB_OOR " " RAT_FUNC "%.3" "volts" COEFFS 0 13104 0 0 0 1 /end COMPU_METHOD
/begin CHARACTERISTIC SHIFT_FB_OORlo "IOConfig # SHIFT_FB_OORlo (Fault Condition:or <)" VALUE 0x00165004 /* @ECU_Address@SHIFT_FB_OORlo@0x01006970@ */ ECIPP_ALIGNMENT_UWORD 5 Compu_SHIFT_FB_OORlo 0 5.00114468864469 /end CHARACTERISTIC
/begin COMPU_METHOD Compu_SHIFT_FB_OORlo " " RAT_FUNC "%.3" "volts" COEFFS 0 13104 0 0 0 1 /end COMPU_METHOD
/begin CHARACTERISTIC SHIFT_short_fail "IOConfig # SHIFT_short_fail (Fault Condition:or measured - estimated current >)" VALUE 0x001443a0 /* @ECU_Address@SHIFT_short_fail@0x01006978@ */ ECIPP_ALIGNMENT_SWORD 128 Compu_SHIFT_short_fail -128 127.99609375 /end CHARACTERISTIC
/begin COMPU_METHOD Compu_SHIFT_short_fail " " RAT_FUNC "%.3" "A" COEFFS 0 256 0 0 0 1 /end COMPU_METHOD
/begin CHARACTERISTIC SHIFT_open_fail "IOConfig # SHIFT_open_fail (Fault Condition:or estimated - measured current >)" VALUE 0x0014439e /* @ECU_Address@SHIFT_open_fail@0x01006980@ */ ECIPP_ALIGNMENT_SWORD 128 Compu_SHIFT_open_fail -128 127.99609375 /end CHARACTERISTIC
/begin COMPU_METHOD Compu_SHIFT_open_fail " " RAT_FUNC "%.3" "A" COEFFS 0 256 0 0 0 1 /end COMPU_METHOD
/begin CHARACTERISTIC SHIFT_intcirc_fail "IOConfig # SHIFT_intcirc_fail (Fault Condition:Internal circuit protection activates >=)" VALUE 0x00147f34 /* @ECU_Address@SHIFT_intcirc_fail@0x01006988@ */ ECIPP_ALIGNMENT_UBYTE 255 Compu_SHIFT_intcirc_fail 0 255 /end CHARACTERISTIC
/begin COMPU_METHOD Compu_SHIFT_intcirc_fail " " RAT_FUNC "%.0" "/ key-cycle" COEFFS 0 1 0 0 0 1 /end COMPU_METHOD
/begin CHARACTERISTIC FTgsln_maxT "Fuel # FTgsln_maxT (Fault Condition:or fuel temp >)" VALUE 0x00147416 /* @ECU_Address@FTgsln_maxT@0x01006A58@ */ ECIPP_ALIGNMENT_UWORD 564 Compu_FTgsln_maxT -460 563.984375 /end CHARACTERISTIC
/begin COMPU_METHOD Compu_FTgsln_maxT " " RAT_FUNC "%.3" "deg F" COEFFS 0 64 29440 0 0 1 /end COMPU_METHOD
/begin CHARACTERISTIC FTgsln_minT "Fuel # FTgsln_minT (Fault Condition:or fuel temp <)" VALUE 0x00147418 /* @ECU_Address@FTgsln_minT@0x01006A60@ */ ECIPP_ALIGNMENT_UWORD 564 Compu_FTgsln_minT -460 563.984375 /end CHARACTERISTIC
/begin COMPU_METHOD Compu_FTgsln_minT " " RAT_FUNC "%.3" "deg F" COEFFS 0 64 29440 0 0 1 /end COMPU_METHOD
/begin CHARACTERISTIC FTgasf_maxT "Fuel # FTgasf_maxT (Fault Condition:or fuel temp >)" VALUE 0x0014740c /* @ECU_Address@FTgasf_maxT@0x01006A68@ */ ECIPP_ALIGNMENT_UWORD 564 Compu_FTgasf_maxT -460 563.984375 /end CHARACTERISTIC
/begin COMPU_METHOD Compu_FTgasf_maxT " " RAT_FUNC "%.3" "deg F" COEFFS 0 64 29440 0 0 1 /end COMPU_METHOD
/begin CHARACTERISTIC FTgasf_minT "Fuel # FTgasf_minT (Fault Condition:OR fuel temp <)" VALUE 0x00147412 /* @ECU_Address@FTgasf_minT@0x01006A70@ */ ECIPP_ALIGNMENT_UWORD 564 Compu_FTgasf_minT -460 563.984375 /end CHARACTERISTIC
/begin COMPU_METHOD Compu_FTgasf_minT " " RAT_FUNC "%.3" "deg F" COEFFS 0 64 29440 0 0 1 /end COMPU_METHOD
/begin CHARACTERISTIC FT_fault_mode "{FT_fault_mode&0xff=0:Voltage only}{FT_fault_mode&0xff=1:Temp only}{FT_fault_mode&0xff=2:Voltage or temp} (Fault Condition:FT fault mode)" VALUE 0x00147d90 /* @ECU_Address@FT_fault_mode@0x01006A78@ */ ECIPP_ALIGNMENT_UBYTE 255 FT_fault_mode_COMPU_VTAB 0 255 BIT_MASK 0xff /end CHARACTERISTIC
/begin COMPU_METHOD FT_fault_mode_COMPU_VTAB "Verbal Table" TAB_VERB "%.0" "list" COMPU_TAB_REF FT_fault_mode_COMPU_VTAB_REF /end COMPU_METHOD
/begin COMPU_VTAB FT_fault_mode_COMPU_VTAB_REF "Verbal Table" TAB_VERB 3 0 "Voltage only" 1 "Temp only" 2 "Voltage or temp" DEFAULT_VALUE "UNKNOWN" /end COMPU_VTAB
/begin CHARACTERISTIC inj_count "General # inj_count" VALUE 0x0014819e /* @ECU_Address@inj_count@0x01006A88@ */ ECIPP_ALIGNMENT_UBYTE 255 Compu_inj_count 0 255 /end CHARACTERISTIC
/begin COMPU_METHOD Compu_inj_count " " RAT_FUNC "%.0" "count" COEFFS 0 1 0 0 0 1 /end COMPU_METHOD
/begin CHARACTERISTIC PW_min_extra "General # PW_min_extra" VALUE 0x00149052 /* @ECU_Address@PW_min_extra@0x01006C30@ */ ECIPP_ALIGNMENT_UWORD 210 Compu_PW_min_extra 0 209.712 /end CHARACTERISTIC
/begin COMPU_METHOD Compu_PW_min_extra " " RAT_FUNC "%.3" "ms" COEFFS 0 312.5 0 0 0 1 /end COMPU_METHOD
/begin CHARACTERISTIC PWM_I_FB_dly_us "General # PWM_I_FB_dly_us" VALUE 0x001476d8 /* @ECU_Address@PWM_I_FB_dly_us@0x01006FF8@ */ ECIPP_ALIGNMENT_UWORD 65535 Compu_PWM_I_FB_dly_us 0 65535 /end CHARACTERISTIC
/begin COMPU_METHOD Compu_PWM_I_FB_dly_us " " RAT_FUNC "%.0" "us" COEFFS 0 1 0 0 0 1 /end COMPU_METHOD
/begin CHARACTERISTIC PWM_I_peak_back_max_us "General # PWM_I_peak_back_max_us" VALUE 0x001476da /* @ECU_Address@PWM_I_peak_back_max_us@0x01007000@ */ ECIPP_ALIGNMENT_UWORD 65535 Compu_PWM_I_peak_back_max_us 0 65535 /end CHARACTERISTIC
/begin COMPU_METHOD Compu_PWM_I_peak_back_max_us " " RAT_FUNC "%.0" "us" COEFFS 0 1 0 0 0 1 /end COMPU_METHOD
/begin CHARACTERISTIC PWM1_short_loDC "FaultConfig # PWM1_short_loDC (Fault Condition:and PWM duty-cycle <)" VALUE 0x00164f8e /* @ECU_Address@PWM1_short_loDC@0x01007048@ */ ECIPP_ALIGNMENT_UWORD 100 Compu_PWM1_short_loDC 0 99.9984741210938 /end CHARACTERISTIC
/begin COMPU_METHOD Compu_PWM1_short_loDC " " RAT_FUNC "%.3" "%" COEFFS 0 655.36 0 0 0 1 /end COMPU_METHOD
/begin CHARACTERISTIC PWM3_short_loDC "FaultConfig # PWM3_short_loDC (Fault Condition:and PWM duty-cycle <)" VALUE 0x00164fc2 /* @ECU_Address@PWM3_short_loDC@0x01007050@ */ ECIPP_ALIGNMENT_UWORD 100 Compu_PWM3_short_loDC 0 99.9984741210938 /end CHARACTERISTIC
/begin COMPU_METHOD Compu_PWM3_short_loDC " " RAT_FUNC "%.3" "%" COEFFS 0 655.36 0 0 0 1 /end COMPU_METHOD
/begin CHARACTERISTIC PWM1_short_mA "FaultConfig # PWM1_short_mA (Fault Condition:OR PWM 1 current feedback >)" VALUE 0x00164f90 /* @ECU_Address@PWM1_short_mA@0x01007058@ */ ECIPP_ALIGNMENT_UWORD 65535 Compu_PWM1_short_mA 0 65535 /end CHARACTERISTIC
/begin COMPU_METHOD Compu_PWM1_short_mA " " RAT_FUNC "%.0" "mA" COEFFS 0 1 0 0 0 1 /end COMPU_METHOD
/begin CHARACTERISTIC PWM3_short_mA "FaultConfig # PWM3_short_mA (Fault Condition:OR PWM 3 current feedback >)" VALUE 0x00164fc4 /* @ECU_Address@PWM3_short_mA@0x01007060@ */ ECIPP_ALIGNMENT_UWORD 65535 Compu_PWM3_short_mA 0 65535 /end CHARACTERISTIC
/begin COMPU_METHOD Compu_PWM3_short_mA " " RAT_FUNC "%.0" "mA" COEFFS 0 1 0 0 0 1 /end COMPU_METHOD
/begin CHARACTERISTIC ICAV_pct_Ttau "FaultConfig # ICAV_pct_Ttau" VALUE 0x001474ac /* @ECU_Address@ICAV_pct_Ttau@0x01007068@ */ ECIPP_ALIGNMENT_UWORD 65535 Compu_ICAV_pct_Ttau 0 65535 /end CHARACTERISTIC
/begin COMPU_METHOD Compu_ICAV_pct_Ttau " " RAT_FUNC "%.0" "100 cycle tau" COEFFS 0 1 0 0 0 1 /end COMPU_METHOD
/begin CHARACTERISTIC ICAV_cyc_diag "FaultConfig # ICAV_cyc_diag" VALUE 0x00147496 /* @ECU_Address@ICAV_cyc_diag@0x01007070@ */ ECIPP_ALIGNMENT_UWORD 65535 Compu_ICAV_cyc_diag 0 65535 /end CHARACTERISTIC
/begin COMPU_METHOD Compu_ICAV_cyc_diag " " RAT_FUNC "%.0" "cycles" COEFFS 0 1 0 0 0 1 /end COMPU_METHOD
/begin CHARACTERISTIC SPK_int_fail_loV "Spark # SPK_int_fail_loV (Fault Condition:spark module diagnostic feedback <)" VALUE 0x001477b8 /* @ECU_Address@SPK_int_fail_loV@0x01007080@ */ ECIPP_ALIGNMENT_UWORD 5 Compu_SPK_int_fail_loV 0 5.00114468864469 /end CHARACTERISTIC
/begin COMPU_METHOD Compu_SPK_int_fail_loV " " RAT_FUNC "%.3" "volts" COEFFS 0 13104 0 0 0 1 /end COMPU_METHOD
/begin CHARACTERISTIC SPK_int_fail_hiV "Spark # SPK_int_fail_hiV (Fault Condition:or >)" VALUE 0x001477b6 /* @ECU_Address@SPK_int_fail_hiV@0x01007088@ */ ECIPP_ALIGNMENT_UWORD 5 Compu_SPK_int_fail_hiV 0 5.00114468864469 /end CHARACTERISTIC
/begin COMPU_METHOD Compu_SPK_int_fail_hiV " " RAT_FUNC "%.3" "volts" COEFFS 0 13104 0 0 0 1 /end COMPU_METHOD
/begin CHARACTERISTIC FPP_diffout_ena "{FPP_diffout_ena&0xff=0:Disabled}{FPP_diffout_ena&0xff=1:Enabled}" VALUE 0x00147d6d /* @ECU_Address@FPP_diffout_ena@0x010070A8@ */ ECIPP_ALIGNMENT_UBYTE 255 FPP_diffout_ena_COMPU_VTAB 0 255 BIT_MASK 0xff /end CHARACTERISTIC
/begin COMPU_METHOD FPP_diffout_ena_COMPU_VTAB "Verbal Table" TAB_VERB "%.0" "list" COMPU_TAB_REF FPP_diffout_ena_COMPU_VTAB_REF /end COMPU_METHOD
/begin COMPU_VTAB FPP_diffout_ena_COMPU_VTAB_REF "Verbal Table" TAB_VERB 2 0 "Disabled" 1 "Enabled" DEFAULT_VALUE "UNKNOWN" /end COMPU_VTAB
/begin CHARACTERISTIC SPK_int_fail_wt "Spark # SPK_int_fail_wt (Fault Condition:and engine run time >)" VALUE 0x001441c4 /* @ECU_Address@SPK_int_fail_wt@0x010070D8@ */ ECIPP_ALIGNMENT_ULONG 4294967 Compu_SPK_int_fail_wt 0 4294967.295 /end CHARACTERISTIC
/begin COMPU_METHOD Compu_SPK_int_fail_wt " " RAT_FUNC "%.3" "sec" COEFFS 0 1000 0 0 0 1 /end COMPU_METHOD
/begin CHARACTERISTIC SPK_coil_fail_loV "Spark # SPK_coil_fail_loV (Fault Condition:spark module diagnostic feedback <)" VALUE 0x001477b4 /* @ECU_Address@SPK_coil_fail_loV@0x010070F0@ */ ECIPP_ALIGNMENT_UWORD 5 Compu_SPK_coil_fail_loV 0 5.00114468864469 /end CHARACTERISTIC
/begin COMPU_METHOD Compu_SPK_coil_fail_loV " " RAT_FUNC "%.3" "volts" COEFFS 0 13104 0 0 0 1 /end COMPU_METHOD
/begin CHARACTERISTIC SPK_coil_fail_hiV "Spark # SPK_coil_fail_hiV (Fault Condition:and >)" VALUE 0x001477b2 /* @ECU_Address@SPK_coil_fail_hiV@0x010070F8@ */ ECIPP_ALIGNMENT_UWORD 5 Compu_SPK_coil_fail_hiV 0 5.00114468864469 /end CHARACTERISTIC
/begin COMPU_METHOD Compu_SPK_coil_fail_hiV " " RAT_FUNC "%.3" "volts" COEFFS 0 13104 0 0 0 1 /end COMPU_METHOD
/begin CHARACTERISTIC SPK_coil_fail_wt "Spark # SPK_coil_fail_wt (Fault Condition:and engine run time >)" VALUE 0x001441c0 /* @ECU_Address@SPK_coil_fail_wt@0x01007100@ */ ECIPP_ALIGNMENT_ULONG 4294967 Compu_SPK_coil_fail_wt 0 4294967.295 /end CHARACTERISTIC
/begin COMPU_METHOD Compu_SPK_coil_fail_wt " " RAT_FUNC "%.3" "sec" COEFFS 0 1000 0 0 0 1 /end COMPU_METHOD
/begin CHARACTERISTIC SPKD_open_loA "Spark # SPKD_open_loA (Fault Condition:final current <)" VALUE 0x001443aa /* @ECU_Address@SPKD_open_loA@0x01007110@ */ ECIPP_ALIGNMENT_SWORD 32 Compu_SPKD_open_loA -32 31.9990234375 /end CHARACTERISTIC
/begin COMPU_METHOD Compu_SPKD_open_loA " " RAT_FUNC "%.3" "amps" COEFFS 0 1024 0 0 0 1 /end COMPU_METHOD
/begin CHARACTERISTIC SPKD_short_hiA "Spark # SPKD_short_hiA (Fault Condition:initial current >)" VALUE 0x001443ac /* @ECU_Address@SPKD_short_hiA@0x01007118@ */ ECIPP_ALIGNMENT_SWORD 32 Compu_SPKD_short_hiA -32 31.9990234375 /end CHARACTERISTIC
/begin COMPU_METHOD Compu_SPKD_short_hiA " " RAT_FUNC "%.3" "amps" COEFFS 0 1024 0 0 0 1 /end COMPU_METHOD
/begin CHARACTERISTIC SPKD_extmod_Vmin "Spark # SPKD_extmod_Vmin (Fault Condition:External spark module voltage >)" VALUE 0x001477ae /* @ECU_Address@SPKD_extmod_Vmin@0x01007120@ */ ECIPP_ALIGNMENT_UWORD 256 Compu_SPKD_extmod_Vmin 0 255.99609375 /end CHARACTERISTIC
/begin COMPU_METHOD Compu_SPKD_extmod_Vmin " " RAT_FUNC "%.3" "volts" COEFFS 0 256 0 0 0 1 /end COMPU_METHOD
/begin CHARACTERISTIC dwell_open_crkmax "Spark # dwell_open_crkmax (Fault Condition:and crank dwell (external module only) <)" VALUE 0x00147aec /* @ECU_Address@dwell_open_crkmax@0x01007138@ */ ECIPP_ALIGNMENT_UWORD 1678 Compu_dwell_open_crkmax 0 1677.696 /end CHARACTERISTIC
/begin COMPU_METHOD Compu_dwell_open_crkmax " " RAT_FUNC "%.3" "ms" COEFFS 0 39.0625 0 0 0 1 /end COMPU_METHOD
/begin CHARACTERISTIC EGOH1_off_loVf "FaultConfig # EGOH1_off_loVf (Fault Condition:EGOH1 low-side feedback <)" VALUE 0x001634c6 /* @ECU_Address@EGOH1_off_loVf@0x010071F0@ */ ECIPP_ALIGNMENT_UWORD 100 Compu_EGOH1_off_loVf 0 99.9984741210938 /end CHARACTERISTIC
/begin COMPU_METHOD Compu_EGOH1_off_loVf " " RAT_FUNC "%.3" "% Vbat" COEFFS 0 655.36 0 0 0 1 /end COMPU_METHOD
/begin CHARACTERISTIC EGOH2_off_loVf "FaultConfig # EGOH2_off_loVf (Fault Condition:EGOH2 low-side feedback <)" VALUE 0x001634ce /* @ECU_Address@EGOH2_off_loVf@0x010071F8@ */ ECIPP_ALIGNMENT_UWORD 100 Compu_EGOH2_off_loVf 0 99.9984741210938 /end CHARACTERISTIC
/begin COMPU_METHOD Compu_EGOH2_off_loVf " " RAT_FUNC "%.3" "% Vbat" COEFFS 0 655.36 0 0 0 1 /end COMPU_METHOD
/begin CHARACTERISTIC EGOH3_off_loVf "FaultConfig # EGOH3_off_loVf (Fault Condition:EGOH3 low-side feedback <)" VALUE 0x001634d6 /* @ECU_Address@EGOH3_off_loVf@0x01007200@ */ ECIPP_ALIGNMENT_UWORD 100 Compu_EGOH3_off_loVf 0 99.9984741210938 /end CHARACTERISTIC
/begin COMPU_METHOD Compu_EGOH3_off_loVf " " RAT_FUNC "%.3" "% Vbat" COEFFS 0 655.36 0 0 0 1 /end COMPU_METHOD
/begin CHARACTERISTIC EGOH4_off_loVf "FaultConfig # EGOH4_off_loVf (Fault Condition:EGOH4 low-side feedback <)" VALUE 0x001634de /* @ECU_Address@EGOH4_off_loVf@0x01007208@ */ ECIPP_ALIGNMENT_UWORD 100 Compu_EGOH4_off_loVf 0 99.9984741210938 /end CHARACTERISTIC
/begin COMPU_METHOD Compu_EGOH4_off_loVf " " RAT_FUNC "%.3" "% Vbat" COEFFS 0 655.36 0 0 0 1 /end COMPU_METHOD
/begin CHARACTERISTIC EGOH1_on_hiVf "FaultConfig # EGOH1_on_hiVf (Fault Condition:EGOH1 low-side feedback >)" VALUE 0x001634ca /* @ECU_Address@EGOH1_on_hiVf@0x01007210@ */ ECIPP_ALIGNMENT_UWORD 100 Compu_EGOH1_on_hiVf 0 99.9984741210938 /end CHARACTERISTIC
/begin COMPU_METHOD Compu_EGOH1_on_hiVf " " RAT_FUNC "%.3" "% Vbat" COEFFS 0 655.36 0 0 0 1 /end COMPU_METHOD
/begin CHARACTERISTIC EGOH2_on_hiVf "FaultConfig # EGOH2_on_hiVf (Fault Condition:EGOH2 low-side feedback >)" VALUE 0x001634d2 /* @ECU_Address@EGOH2_on_hiVf@0x01007218@ */ ECIPP_ALIGNMENT_UWORD 100 Compu_EGOH2_on_hiVf 0 99.9984741210938 /end CHARACTERISTIC
/begin COMPU_METHOD Compu_EGOH2_on_hiVf " " RAT_FUNC "%.3" "% Vbat" COEFFS 0 655.36 0 0 0 1 /end COMPU_METHOD
/begin CHARACTERISTIC EGOH3_on_hiVf "FaultConfig # EGOH3_on_hiVf (Fault Condition:EGOH3 low-side feedback >)" VALUE 0x001634da /* @ECU_Address@EGOH3_on_hiVf@0x01007220@ */ ECIPP_ALIGNMENT_UWORD 100 Compu_EGOH3_on_hiVf 0 99.9984741210938 /end CHARACTERISTIC
/begin COMPU_METHOD Compu_EGOH3_on_hiVf " " RAT_FUNC "%.3" "% Vbat" COEFFS 0 655.36 0 0 0 1 /end COMPU_METHOD
/begin CHARACTERISTIC EGOH4_on_hiVf "FaultConfig # EGOH4_on_hiVf (Fault Condition:EGOH4 low-side feedback >)" VALUE 0x001634e2 /* @ECU_Address@EGOH4_on_hiVf@0x01007228@ */ ECIPP_ALIGNMENT_UWORD 100 Compu_EGOH4_on_hiVf 0 99.9984741210938 /end CHARACTERISTIC
/begin COMPU_METHOD Compu_EGOH4_on_hiVf " " RAT_FUNC "%.3" "% Vbat" COEFFS 0 655.36 0 0 0 1 /end COMPU_METHOD
/begin CHARACTERISTIC EGOH1_off_loDC "FaultConfig # EGOH1_off_loDC (Fault Condition:and PWM duty-cycle <)" VALUE 0x001634c4 /* @ECU_Address@EGOH1_off_loDC@0x01007230@ */ ECIPP_ALIGNMENT_UWORD 100 Compu_EGOH1_off_loDC 0 99.9984741210938 /end CHARACTERISTIC
/begin COMPU_METHOD Compu_EGOH1_off_loDC " " RAT_FUNC "%.3" "%" COEFFS 0 655.36 0 0 0 1 /end COMPU_METHOD
/begin CHARACTERISTIC EGOH2_off_loDC "FaultConfig # EGOH2_off_loDC (Fault Condition:and PWM duty-cycle <)" VALUE 0x001634cc /* @ECU_Address@EGOH2_off_loDC@0x01007238@ */ ECIPP_ALIGNMENT_UWORD 100 Compu_EGOH2_off_loDC 0 99.9984741210938 /end CHARACTERISTIC
/begin COMPU_METHOD Compu_EGOH2_off_loDC " " RAT_FUNC "%.3" "%" COEFFS 0 655.36 0 0 0 1 /end COMPU_METHOD
/begin CHARACTERISTIC EGOH3_off_loDC "FaultConfig # EGOH3_off_loDC (Fault Condition:and PWM duty-cycle <)" VALUE 0x001634d4 /* @ECU_Address@EGOH3_off_loDC@0x01007240@ */ ECIPP_ALIGNMENT_UWORD 100 Compu_EGOH3_off_loDC 0 99.9984741210938 /end CHARACTERISTIC
/begin COMPU_METHOD Compu_EGOH3_off_loDC " " RAT_FUNC "%.3" "%" COEFFS 0 655.36 0 0 0 1 /end COMPU_METHOD
/begin CHARACTERISTIC EGOH4_off_loDC "FaultConfig # EGOH4_off_loDC (Fault Condition:and PWM duty-cycle <)" VALUE 0x001634dc /* @ECU_Address@EGOH4_off_loDC@0x01007248@ */ ECIPP_ALIGNMENT_UWORD 100 Compu_EGOH4_off_loDC 0 99.9984741210938 /end CHARACTERISTIC
/begin COMPU_METHOD Compu_EGOH4_off_loDC " " RAT_FUNC "%.3" "%" COEFFS 0 655.36 0 0 0 1 /end COMPU_METHOD
/begin CHARACTERISTIC EGOH1_on_hiDC "FaultConfig # EGOH1_on_hiDC (Fault Condition:and PWM duty-cycle >)" VALUE 0x001634c8 /* @ECU_Address@EGOH1_on_hiDC@0x01007250@ */ ECIPP_ALIGNMENT_UWORD 100 Compu_EGOH1_on_hiDC 0 99.9984741210938 /end CHARACTERISTIC
/begin COMPU_METHOD Compu_EGOH1_on_hiDC " " RAT_FUNC "%.3" "%" COEFFS 0 655.36 0 0 0 1 /end COMPU_METHOD
/begin CHARACTERISTIC EGOH2_on_hiDC "FaultConfig # EGOH2_on_hiDC (Fault Condition:and PWM duty-cycle >)" VALUE 0x001634d0 /* @ECU_Address@EGOH2_on_hiDC@0x01007258@ */ ECIPP_ALIGNMENT_UWORD 100 Compu_EGOH2_on_hiDC 0 99.9984741210938 /end CHARACTERISTIC
/begin COMPU_METHOD Compu_EGOH2_on_hiDC " " RAT_FUNC "%.3" "%" COEFFS 0 655.36 0 0 0 1 /end COMPU_METHOD
/begin CHARACTERISTIC EGOH3_on_hiDC "FaultConfig # EGOH3_on_hiDC (Fault Condition:and PWM duty-cycle >)" VALUE 0x001634d8 /* @ECU_Address@EGOH3_on_hiDC@0x01007260@ */ ECIPP_ALIGNMENT_UWORD 100 Compu_EGOH3_on_hiDC 0 99.9984741210938 /end CHARACTERISTIC
/begin COMPU_METHOD Compu_EGOH3_on_hiDC " " RAT_FUNC "%.3" "%" COEFFS 0 655.36 0 0 0 1 /end COMPU_METHOD
/begin CHARACTERISTIC EGOH4_on_hiDC "FaultConfig # EGOH4_on_hiDC (Fault Condition:and PWM duty-cycle >)" VALUE 0x001634e0 /* @ECU_Address@EGOH4_on_hiDC@0x01007268@ */ ECIPP_ALIGNMENT_UWORD 100 Compu_EGOH4_on_hiDC 0 99.9984741210938 /end CHARACTERISTIC
/begin COMPU_METHOD Compu_EGOH4_on_hiDC " " RAT_FUNC "%.3" "%" COEFFS 0 655.36 0 0 0 1 /end COMPU_METHOD
/begin CHARACTERISTIC RELAY_keyoff_chk "{RELAY_keyoff_chk&0xff=0:Disabled}{RELAY_keyoff_chk&0xff=1:Enabled} (Fault Condition:Relay key-off fault checking)" VALUE 0x00147ef0 /* @ECU_Address@RELAY_keyoff_chk@0x01007270@ */ ECIPP_ALIGNMENT_UBYTE 255 RELAY_keyoff_chk_COMPU_VTAB 0 255 BIT_MASK 0xff /end CHARACTERISTIC
/begin COMPU_METHOD RELAY_keyoff_chk_COMPU_VTAB "Verbal Table" TAB_VERB "%.0" "list" COMPU_TAB_REF RELAY_keyoff_chk_COMPU_VTAB_REF /end COMPU_METHOD
/begin COMPU_VTAB RELAY_keyoff_chk_COMPU_VTAB_REF "Verbal Table" TAB_VERB 2 0 "Disabled" 1 "Enabled" DEFAULT_VALUE "UNKNOWN" /end COMPU_VTAB
/begin CHARACTERISTIC drivebrake_off_loVf "FaultConfig # drivebrake_off_loVf (Fault Condition:Low-side feedback <)" VALUE 0x001650e2 /* @ECU_Address@drivebrake_off_loVf@0x010072B8@ */ ECIPP_ALIGNMENT_UWORD 100 Compu_drivebrake_off_loVf 0 99.9984741210938 /end CHARACTERISTIC
/begin COMPU_METHOD Compu_drivebrake_off_loVf " " RAT_FUNC "%.3" "% Vbat" COEFFS 0 655.36 0 0 0 1 /end COMPU_METHOD
/begin CHARACTERISTIC drivebrake_on_hiVf "FaultConfig # drivebrake_on_hiVf (Fault Condition:Low-side feedback >)" VALUE 0x001650e4 /* @ECU_Address@drivebrake_on_hiVf@0x010072C0@ */ ECIPP_ALIGNMENT_UWORD 100 Compu_drivebrake_on_hiVf 0 99.9984741210938 /end CHARACTERISTIC
/begin COMPU_METHOD Compu_drivebrake_on_hiVf " " RAT_FUNC "%.3" "% Vbat" COEFFS 0 655.36 0 0 0 1 /end COMPU_METHOD
/begin CHARACTERISTIC UGF_run_wait "FaultConfig # UGF_run_wait (Fault Condition:or warmup period and an additional)" VALUE 0x0014421c /* @ECU_Address@UGF_run_wait@0x010076F0@ */ ECIPP_ALIGNMENT_ULONG 4294967 Compu_UGF_run_wait 0 4294967.295 /end CHARACTERISTIC
/begin COMPU_METHOD Compu_UGF_run_wait " " RAT_FUNC "%.3" "seconds" COEFFS 0 1000 0 0 0 1 /end COMPU_METHOD
/begin CHARACTERISTIC APUD5_max "FaultConfig # APUD5_max (Fault Condition:AUX analog PUD5 >)" VALUE 0x0016345a /* @ECU_Address@APUD5_max@0x010076F8@ */ ECIPP_ALIGNMENT_UWORD 5 Compu_APUD5_max 0 5.00114468864469 /end CHARACTERISTIC
/begin COMPU_METHOD Compu_APUD5_max " " RAT_FUNC "%.3" "volts" COEFFS 0 13104 0 0 0 1 /end COMPU_METHOD
/begin CHARACTERISTIC APUD5_min "FaultConfig # APUD5_min (Fault Condition:AUX analog PUD5 <)" VALUE 0x0016345c /* @ECU_Address@APUD5_min@0x01007700@ */ ECIPP_ALIGNMENT_UWORD 5 Compu_APUD5_min 0 5.00114468864469 /end CHARACTERISTIC
/begin COMPU_METHOD Compu_APUD5_min " " RAT_FUNC "%.3" "volts" COEFFS 0 13104 0 0 0 1 /end COMPU_METHOD
/begin CHARACTERISTIC APUD6_max "FaultConfig # APUD6_max (Fault Condition:AUX analog PUD6 >)" VALUE 0x0016345e /* @ECU_Address@APUD6_max@0x01007708@ */ ECIPP_ALIGNMENT_UWORD 5 Compu_APUD6_max 0 5.00114468864469 /end CHARACTERISTIC
/begin COMPU_METHOD Compu_APUD6_max " " RAT_FUNC "%.3" "volts" COEFFS 0 13104 0 0 0 1 /end COMPU_METHOD
/begin CHARACTERISTIC APUD6_min "FaultConfig # APUD6_min (Fault Condition:AUX analog PUD6 <)" VALUE 0x00163460 /* @ECU_Address@APUD6_min@0x01007710@ */ ECIPP_ALIGNMENT_UWORD 5 Compu_APUD6_min 0 5.00114468864469 /end CHARACTERISTIC
/begin COMPU_METHOD Compu_APUD6_min " " RAT_FUNC "%.3" "volts" COEFFS 0 13104 0 0 0 1 /end COMPU_METHOD
/begin CHARACTERISTIC APUD7_max "FaultConfig # APUD7_max (Fault Condition:AUX analog PUD7 >)" VALUE 0x00163462 /* @ECU_Address@APUD7_max@0x01007718@ */ ECIPP_ALIGNMENT_UWORD 5 Compu_APUD7_max 0 5.00114468864469 /end CHARACTERISTIC
/begin COMPU_METHOD Compu_APUD7_max " " RAT_FUNC "%.3" "volts" COEFFS 0 13104 0 0 0 1 /end COMPU_METHOD
/begin CHARACTERISTIC APUD7_min "FaultConfig # APUD7_min (Fault Condition:AUX analog PUD7 <)" VALUE 0x00163464 /* @ECU_Address@APUD7_min@0x01007720@ */ ECIPP_ALIGNMENT_UWORD 5 Compu_APUD7_min 0 5.00114468864469 /end CHARACTERISTIC
/begin COMPU_METHOD Compu_APUD7_min " " RAT_FUNC "%.3" "volts" COEFFS 0 13104 0 0 0 1 /end COMPU_METHOD
/begin CHARACTERISTIC ADIG4_max "FaultConfig # ADIG4_max (Fault Condition:AUX DIG4 >)" VALUE 0x001633da /* @ECU_Address@ADIG4_max@0x01007728@ */ ECIPP_ALIGNMENT_UWORD 256 Compu_ADIG4_max 0 255.99609375 /end CHARACTERISTIC
/begin COMPU_METHOD Compu_ADIG4_max " " RAT_FUNC "%.3" "volts" COEFFS 0 256 0 0 0 1 /end COMPU_METHOD
/begin CHARACTERISTIC ADIG4_min "FaultConfig # ADIG4_min (Fault Condition:AUX DIG4 <)" VALUE 0x001633dc /* @ECU_Address@ADIG4_min@0x01007730@ */ ECIPP_ALIGNMENT_UWORD 256 Compu_ADIG4_min 0 255.99609375 /end CHARACTERISTIC
/begin COMPU_METHOD Compu_ADIG4_min " " RAT_FUNC "%.3" "volts" COEFFS 0 256 0 0 0 1 /end COMPU_METHOD
/begin CHARACTERISTIC ADIG5_max "FaultConfig # ADIG5_max (Fault Condition:AUX DIG5 >)" VALUE 0x001633de /* @ECU_Address@ADIG5_max@0x01007738@ */ ECIPP_ALIGNMENT_UWORD 256 Compu_ADIG5_max 0 255.99609375 /end CHARACTERISTIC
/begin COMPU_METHOD Compu_ADIG5_max " " RAT_FUNC "%.3" "volts" COEFFS 0 256 0 0 0 1 /end COMPU_METHOD
/begin CHARACTERISTIC ADIG5_min "FaultConfig # ADIG5_min (Fault Condition:AUX DIG5 <)" VALUE 0x001633e0 /* @ECU_Address@ADIG5_min@0x01007740@ */ ECIPP_ALIGNMENT_UWORD 256 Compu_ADIG5_min 0 255.99609375 /end CHARACTERISTIC
/begin COMPU_METHOD Compu_ADIG5_min " " RAT_FUNC "%.3" "volts" COEFFS 0 256 0 0 0 1 /end COMPU_METHOD
/begin CHARACTERISTIC ADIG6_max "FaultConfig # ADIG6_max (Fault Condition:AUX DIG6 >)" VALUE 0x001633e2 /* @ECU_Address@ADIG6_max@0x01007748@ */ ECIPP_ALIGNMENT_UWORD 256 Compu_ADIG6_max 0 255.99609375 /end CHARACTERISTIC
/begin COMPU_METHOD Compu_ADIG6_max " " RAT_FUNC "%.3" "volts" COEFFS 0 256 0 0 0 1 /end COMPU_METHOD
/begin CHARACTERISTIC ADIG6_min "FaultConfig # ADIG6_min (Fault Condition:AUX DIG6 <)" VALUE 0x001633e4 /* @ECU_Address@ADIG6_min@0x01007750@ */ ECIPP_ALIGNMENT_UWORD 256 Compu_ADIG6_min 0 255.99609375 /end CHARACTERISTIC
/begin COMPU_METHOD Compu_ADIG6_min " " RAT_FUNC "%.3" "volts" COEFFS 0 256 0 0 0 1 /end COMPU_METHOD
/begin CHARACTERISTIC ADIG7_max "FaultConfig # ADIG7_max (Fault Condition:AUX DIG7 >)" VALUE 0x001633e6 /* @ECU_Address@ADIG7_max@0x01007758@ */ ECIPP_ALIGNMENT_UWORD 256 Compu_ADIG7_max 0 255.99609375 /end CHARACTERISTIC
/begin COMPU_METHOD Compu_ADIG7_max " " RAT_FUNC "%.3" "volts" COEFFS 0 256 0 0 0 1 /end COMPU_METHOD
/begin CHARACTERISTIC ADIG7_min "FaultConfig # ADIG7_min (Fault Condition:AUX DIG7 <)" VALUE 0x001633e8 /* @ECU_Address@ADIG7_min@0x01007760@ */ ECIPP_ALIGNMENT_UWORD 256 Compu_ADIG7_min 0 255.99609375 /end CHARACTERISTIC
/begin COMPU_METHOD Compu_ADIG7_min " " RAT_FUNC "%.3" "volts" COEFFS 0 256 0 0 0 1 /end COMPU_METHOD
/begin CHARACTERISTIC ADIG8_max "FaultConfig # ADIG8_max (Fault Condition:AUX DIG8 >)" VALUE 0x001633ea /* @ECU_Address@ADIG8_max@0x01007768@ */ ECIPP_ALIGNMENT_UWORD 256 Compu_ADIG8_max 0 255.99609375 /end CHARACTERISTIC
/begin COMPU_METHOD Compu_ADIG8_max " " RAT_FUNC "%.3" "volts" COEFFS 0 256 0 0 0 1 /end COMPU_METHOD
/begin CHARACTERISTIC ADIG8_min "FaultConfig # ADIG8_min (Fault Condition:AUX DIG8 <)" VALUE 0x001633ec /* @ECU_Address@ADIG8_min@0x01007770@ */ ECIPP_ALIGNMENT_UWORD 256 Compu_ADIG8_min 0 255.99609375 /end CHARACTERISTIC
/begin COMPU_METHOD Compu_ADIG8_min " " RAT_FUNC "%.3" "volts" COEFFS 0 256 0 0 0 1 /end COMPU_METHOD
/begin CHARACTERISTIC ADIG9_max "FaultConfig # ADIG9_max (Fault Condition:AUX DIG9 >)" VALUE 0x001633ee /* @ECU_Address@ADIG9_max@0x01007778@ */ ECIPP_ALIGNMENT_UWORD 256 Compu_ADIG9_max 0 255.99609375 /end CHARACTERISTIC
/begin COMPU_METHOD Compu_ADIG9_max " " RAT_FUNC "%.3" "volts" COEFFS 0 256 0 0 0 1 /end COMPU_METHOD
/begin CHARACTERISTIC ADIG9_min "FaultConfig # ADIG9_min (Fault Condition:AUX DIG9 <)" VALUE 0x001633f0 /* @ECU_Address@ADIG9_min@0x01007780@ */ ECIPP_ALIGNMENT_UWORD 256 Compu_ADIG9_min 0 255.99609375 /end CHARACTERISTIC
/begin COMPU_METHOD Compu_ADIG9_min " " RAT_FUNC "%.3" "volts" COEFFS 0 256 0 0 0 1 /end COMPU_METHOD
/begin CHARACTERISTIC ADIG10_max "FaultConfig # ADIG10_max (Fault Condition:AUX DIG10 >)" VALUE 0x0016338e /* @ECU_Address@ADIG10_max@0x01007788@ */ ECIPP_ALIGNMENT_UWORD 256 Compu_ADIG10_max 0 255.99609375 /end CHARACTERISTIC
/begin COMPU_METHOD Compu_ADIG10_max " " RAT_FUNC "%.3" "volts" COEFFS 0 256 0 0 0 1 /end COMPU_METHOD
/begin CHARACTERISTIC ADIG10_min "FaultConfig # ADIG10_min (Fault Condition:AUX DIG10 <)" VALUE 0x00163390 /* @ECU_Address@ADIG10_min@0x01007790@ */ ECIPP_ALIGNMENT_UWORD 256 Compu_ADIG10_min 0 255.99609375 /end CHARACTERISTIC
/begin COMPU_METHOD Compu_ADIG10_min " " RAT_FUNC "%.3" "volts" COEFFS 0 256 0 0 0 1 /end COMPU_METHOD
/begin CHARACTERISTIC MIL_off_loVf "FaultConfig # MIL_off_loVf (Fault Condition:Low-side feedback <)" VALUE 0x00164f2e /* @ECU_Address@MIL_off_loVf@0x01007798@ */ ECIPP_ALIGNMENT_UWORD 100 Compu_MIL_off_loVf 0 99.9984741210938 /end CHARACTERISTIC
/begin COMPU_METHOD Compu_MIL_off_loVf " " RAT_FUNC "%.3" "% Vbat" COEFFS 0 655.36 0 0 0 1 /end COMPU_METHOD
/begin CHARACTERISTIC START_off_loVf "FaultConfig # START_off_loVf (Fault Condition:Low-side feedback <)" VALUE 0x001477fa /* @ECU_Address@START_off_loVf@0x010077A0@ */ ECIPP_ALIGNMENT_UWORD 100 Compu_START_off_loVf 0 99.9984741210938 /end CHARACTERISTIC
/begin COMPU_METHOD Compu_START_off_loVf " " RAT_FUNC "%.3" "% Vbat" COEFFS 0 655.36 0 0 0 1 /end COMPU_METHOD
/begin CHARACTERISTIC TACH_off_loVf "FaultConfig # TACH_off_loVf (Fault Condition:Low-side feedback <)" VALUE 0x00165006 /* @ECU_Address@TACH_off_loVf@0x010077A8@ */ ECIPP_ALIGNMENT_UWORD 100 Compu_TACH_off_loVf 0 99.9984741210938 /end CHARACTERISTIC
/begin COMPU_METHOD Compu_TACH_off_loVf " " RAT_FUNC "%.3" "% Vbat" COEFFS 0 655.36 0 0 0 1 /end COMPU_METHOD
/begin CHARACTERISTIC RELAY_off_loVf "FaultConfig # RELAY_off_loVf (Fault Condition:Low-side feedback <)" VALUE 0x001476ee /* @ECU_Address@RELAY_off_loVf@0x010077B0@ */ ECIPP_ALIGNMENT_UWORD 100 Compu_RELAY_off_loVf 0 99.9984741210938 /end CHARACTERISTIC
/begin COMPU_METHOD Compu_RELAY_off_loVf " " RAT_FUNC "%.3" "% Vbat" COEFFS 0 655.36 0 0 0 1 /end COMPU_METHOD
/begin CHARACTERISTIC MIL_on_hiVf "FaultConfig # MIL_on_hiVf (Fault Condition:Low-side feedback >)" VALUE 0x00164f30 /* @ECU_Address@MIL_on_hiVf@0x010077B8@ */ ECIPP_ALIGNMENT_UWORD 100 Compu_MIL_on_hiVf 0 99.9984741210938 /end CHARACTERISTIC
/begin COMPU_METHOD Compu_MIL_on_hiVf " " RAT_FUNC "%.3" "% Vbat" COEFFS 0 655.36 0 0 0 1 /end COMPU_METHOD
/begin CHARACTERISTIC START_on_hiVf "FaultConfig # START_on_hiVf (Fault Condition:Output feedback >)" VALUE 0x001477fc /* @ECU_Address@START_on_hiVf@0x010077C0@ */ ECIPP_ALIGNMENT_UWORD 100 Compu_START_on_hiVf 0 99.9984741210938 /end CHARACTERISTIC
/begin COMPU_METHOD Compu_START_on_hiVf " " RAT_FUNC "%.3" "% Vbat" COEFFS 0 655.36 0 0 0 1 /end COMPU_METHOD
/begin CHARACTERISTIC TACH_on_hiVf "FaultConfig # TACH_on_hiVf (Fault Condition:Low-side feedback >)" VALUE 0x00165008 /* @ECU_Address@TACH_on_hiVf@0x010077C8@ */ ECIPP_ALIGNMENT_UWORD 100 Compu_TACH_on_hiVf 0 99.9984741210938 /end CHARACTERISTIC
/begin COMPU_METHOD Compu_TACH_on_hiVf " " RAT_FUNC "%.3" "% Vbat" COEFFS 0 655.36 0 0 0 1 /end COMPU_METHOD
/begin CHARACTERISTIC RELAY_on_hiVf "FaultConfig # RELAY_on_hiVf (Fault Condition:Low-side feedback >)" VALUE 0x001476f0 /* @ECU_Address@RELAY_on_hiVf@0x010077D0@ */ ECIPP_ALIGNMENT_UWORD 100 Compu_RELAY_on_hiVf 0 99.9984741210938 /end CHARACTERISTIC
/begin COMPU_METHOD Compu_RELAY_on_hiVf " " RAT_FUNC "%.3" "% Vbat" COEFFS 0 655.36 0 0 0 1 /end COMPU_METHOD
/begin CHARACTERISTIC fuelclr_gaseous "{fuelclr_gaseous&0xff=0:Injection only}{fuelclr_gaseous&0xff=1:Injection + Carburetion}" VALUE 0x0016c327 /* @ECU_Address@fuelclr_gaseous@0x010077E8@ */ ECIPP_ALIGNMENT_UBYTE 255 fuelclr_gaseous_COMPU_VTAB 0 255 BIT_MASK 0xff /end CHARACTERISTIC
/begin COMPU_METHOD fuelclr_gaseous_COMPU_VTAB "Verbal Table" TAB_VERB "%.0" "list" COMPU_TAB_REF fuelclr_gaseous_COMPU_VTAB_REF /end COMPU_METHOD
/begin COMPU_VTAB fuelclr_gaseous_COMPU_VTAB_REF "Verbal Table" TAB_VERB 2 0 "Injection only" 1 "Injection + Carburetion" DEFAULT_VALUE "UNKNOWN" /end COMPU_VTAB
/begin CHARACTERISTIC FP_fault_mode "{FP_fault_mode&0xff=0:Gasoline + Gaseous}{FP_fault_mode&0xff=1:Gasoline only}{FP_fault_mode&0xff=2:Gaseous only} (Fault Condition:Primary FP fault mode)" VALUE 0x00149062 /* @ECU_Address@FP_fault_mode@0x01007858@ */ ECIPP_ALIGNMENT_UBYTE 255 FP_fault_mode_COMPU_VTAB 0 255 BIT_MASK 0xff /end CHARACTERISTIC
/begin COMPU_METHOD FP_fault_mode_COMPU_VTAB "Verbal Table" TAB_VERB "%.0" "list" COMPU_TAB_REF FP_fault_mode_COMPU_VTAB_REF /end COMPU_METHOD
/begin COMPU_VTAB FP_fault_mode_COMPU_VTAB_REF "Verbal Table" TAB_VERB 3 0 "Gasoline + Gaseous" 1 "Gasoline only" 2 "Gaseous only" DEFAULT_VALUE "UNKNOWN" /end COMPU_VTAB
/begin CHARACTERISTIC rpm_hi_expected "FaultConfig # rpm_hi_expected (Fault Condition:rpm >)" VALUE 0x00147b70 /* @ECU_Address@rpm_hi_expected@0x01007868@ */ ECIPP_ALIGNMENT_UWORD 65535 Compu_rpm_hi_expected 0 65535 /end CHARACTERISTIC
/begin COMPU_METHOD Compu_rpm_hi_expected " " RAT_FUNC "%.0" "rpm" COEFFS 0 1 0 0 0 1 /end COMPU_METHOD
/begin CHARACTERISTIC RS_loss_slowPWM "{RS_loss_slowPWM&0xff=0:Not required}{RS_loss_slowPWM&0xff=1:Required} (Fault Condition:and slow PWM input validation)" VALUE 0x00147f0f /* @ECU_Address@RS_loss_slowPWM@0x01007870@ */ ECIPP_ALIGNMENT_UBYTE 255 RS_loss_slowPWM_COMPU_VTAB 0 255 BIT_MASK 0xff /end CHARACTERISTIC
/begin COMPU_METHOD RS_loss_slowPWM_COMPU_VTAB "Verbal Table" TAB_VERB "%.0" "list" COMPU_TAB_REF RS_loss_slowPWM_COMPU_VTAB_REF /end COMPU_METHOD
/begin COMPU_VTAB RS_loss_slowPWM_COMPU_VTAB_REF "Verbal Table" TAB_VERB 2 0 "Not required" 1 "Required" DEFAULT_VALUE "UNKNOWN" /end COMPU_VTAB
/begin CHARACTERISTIC FPP_atidle_start "{FPP_atidle_start&0xff=0:Not required}{FPP_atidle_start&0xff=1:Required}" VALUE 0x00147d6c /* @ECU_Address@FPP_atidle_start@0x01007888@ */ ECIPP_ALIGNMENT_UBYTE 255 FPP_atidle_start_COMPU_VTAB 0 255 BIT_MASK 0xff /end CHARACTERISTIC
/begin COMPU_METHOD FPP_atidle_start_COMPU_VTAB "Verbal Table" TAB_VERB "%.0" "list" COMPU_TAB_REF FPP_atidle_start_COMPU_VTAB_REF /end COMPU_METHOD
/begin COMPU_VTAB FPP_atidle_start_COMPU_VTAB_REF "Verbal Table" TAB_VERB 2 0 "Not required" 1 "Required" DEFAULT_VALUE "UNKNOWN" /end COMPU_VTAB
/begin CHARACTERISTIC ECT_HiExp2_wait "FaultConfig # ECT_HiExp2_wait (Fault Condition:and run-time >)" VALUE 0x001440bc /* @ECU_Address@ECT_HiExp2_wait@0x010079B8@ */ ECIPP_ALIGNMENT_ULONG 4294967 Compu_ECT_HiExp2_wait 0 4294967.295 /end CHARACTERISTIC
/begin COMPU_METHOD Compu_ECT_HiExp2_wait " " RAT_FUNC "%.3" "seconds" COEFFS 0 1000 0 0 0 1 /end COMPU_METHOD
/begin CHARACTERISTIC CHT_HiExp2_wait "FaultConfig # CHT_HiExp2_wait (Fault Condition:and run-time >)" VALUE 0x001440a8 /* @ECU_Address@CHT_HiExp2_wait@0x010079C0@ */ ECIPP_ALIGNMENT_ULONG 4294967 Compu_CHT_HiExp2_wait 0 4294967.295 /end CHARACTERISTIC
/begin COMPU_METHOD Compu_CHT_HiExp2_wait " " RAT_FUNC "%.3" "seconds" COEFFS 0 1000 0 0 0 1 /end COMPU_METHOD
/begin CHARACTERISTIC Aux_PU3_rpm_lo "FaultConfig # Aux_PU3_rpm_lo (Fault Condition:and RPM >=)" VALUE 0x00163484 /* @ECU_Address@Aux_PU3_rpm_lo@0x010079F8@ */ ECIPP_ALIGNMENT_UWORD 65535 Compu_Aux_PU3_rpm_lo 0 65535 /end CHARACTERISTIC
/begin COMPU_METHOD Compu_Aux_PU3_rpm_lo " " RAT_FUNC "%.0" "rpm" COEFFS 0 1 0 0 0 1 /end COMPU_METHOD
/begin CHARACTERISTIC Aux_PU3_rpm_hi "FaultConfig # Aux_PU3_rpm_hi (Fault Condition:and RPM <=)" VALUE 0x00163482 /* @ECU_Address@Aux_PU3_rpm_hi@0x01007A00@ */ ECIPP_ALIGNMENT_UWORD 65535 Compu_Aux_PU3_rpm_hi 0 65535 /end CHARACTERISTIC
/begin COMPU_METHOD Compu_Aux_PU3_rpm_hi " " RAT_FUNC "%.0" "rpm" COEFFS 0 1 0 0 0 1 /end COMPU_METHOD
/begin CHARACTERISTIC Aux_PU3_ECT_lo "FaultConfig # Aux_PU3_ECT_lo (Fault Condition:and ECT >=)" VALUE 0x00163480 /* @ECU_Address@Aux_PU3_ECT_lo@0x01007A08@ */ ECIPP_ALIGNMENT_UWORD 564 Compu_Aux_PU3_ECT_lo -460 563.984375 /end CHARACTERISTIC
/begin COMPU_METHOD Compu_Aux_PU3_ECT_lo " " RAT_FUNC "%.3" "deg F" COEFFS 0 64 29440 0 0 1 /end COMPU_METHOD
/begin CHARACTERISTIC Aux_DIG1_rpm_lo "FaultConfig # Aux_DIG1_rpm_lo (Fault Condition:and RPM >=)" VALUE 0x00163478 /* @ECU_Address@Aux_DIG1_rpm_lo@0x01007A10@ */ ECIPP_ALIGNMENT_UWORD 65535 Compu_Aux_DIG1_rpm_lo 0 65535 /end CHARACTERISTIC
/begin COMPU_METHOD Compu_Aux_DIG1_rpm_lo " " RAT_FUNC "%.0" "rpm" COEFFS 0 1 0 0 0 1 /end COMPU_METHOD
/begin CHARACTERISTIC Aux_DIG1_rpm_hi "FaultConfig # Aux_DIG1_rpm_hi (Fault Condition:and RPM <=)" VALUE 0x00163476 /* @ECU_Address@Aux_DIG1_rpm_hi@0x01007A18@ */ ECIPP_ALIGNMENT_UWORD 65535 Compu_Aux_DIG1_rpm_hi 0 65535 /end CHARACTERISTIC
/begin COMPU_METHOD Compu_Aux_DIG1_rpm_hi " " RAT_FUNC "%.0" "rpm" COEFFS 0 1 0 0 0 1 /end COMPU_METHOD
/begin CHARACTERISTIC Aux_DIG1_ECT_lo "FaultConfig # Aux_DIG1_ECT_lo (Fault Condition:and ECT >=)" VALUE 0x00163474 /* @ECU_Address@Aux_DIG1_ECT_lo@0x01007A20@ */ ECIPP_ALIGNMENT_UWORD 564 Compu_Aux_DIG1_ECT_lo -460 563.984375 /end CHARACTERISTIC
/begin COMPU_METHOD Compu_Aux_DIG1_ECT_lo " " RAT_FUNC "%.3" "deg F" COEFFS 0 64 29440 0 0 1 /end COMPU_METHOD
/begin CHARACTERISTIC MES_status_mstr "{MES_status_mstr&0xff=0:Master or slave}{MES_status_mstr&0xff=1:Master only}" VALUE 0x00147e63 /* @ECU_Address@MES_status_mstr@0x01007A48@ */ ECIPP_ALIGNMENT_UBYTE 255 MES_status_mstr_COMPU_VTAB 0 255 BIT_MASK 0xff /end CHARACTERISTIC
/begin COMPU_METHOD MES_status_mstr_COMPU_VTAB "Verbal Table" TAB_VERB "%.0" "list" COMPU_TAB_REF MES_status_mstr_COMPU_VTAB_REF /end COMPU_METHOD
/begin COMPU_VTAB MES_status_mstr_COMPU_VTAB_REF "Verbal Table" TAB_VERB 2 0 "Master or slave" 1 "Master only" DEFAULT_VALUE "UNKNOWN" /end COMPU_VTAB
/begin CHARACTERISTIC MSP_prop_V_mstr "{MSP_prop_V_mstr&0xff=0:Master or slave}{MSP_prop_V_mstr&0xff=1:Master only}" VALUE 0x00147e7d /* @ECU_Address@MSP_prop_V_mstr@0x01007A50@ */ ECIPP_ALIGNMENT_UBYTE 255 MSP_prop_V_mstr_COMPU_VTAB 0 255 BIT_MASK 0xff /end CHARACTERISTIC
/begin COMPU_METHOD MSP_prop_V_mstr_COMPU_VTAB "Verbal Table" TAB_VERB "%.0" "list" COMPU_TAB_REF MSP_prop_V_mstr_COMPU_VTAB_REF /end COMPU_METHOD
/begin COMPU_VTAB MSP_prop_V_mstr_COMPU_VTAB_REF "Verbal Table" TAB_VERB 2 0 "Master or slave" 1 "Master only" DEFAULT_VALUE "UNKNOWN" /end COMPU_VTAB
/begin CHARACTERISTIC MEFI_sync_status "{MEFI_sync_status&0xff=0:Not Available}{MEFI_sync_status&0xff=1:Available}" VALUE 0x00147e5d /* @ECU_Address@MEFI_sync_status@0x01007A60@ */ ECIPP_ALIGNMENT_UBYTE 255 MEFI_sync_status_COMPU_VTAB 0 255 BIT_MASK 0xff /end CHARACTERISTIC
/begin COMPU_METHOD MEFI_sync_status_COMPU_VTAB "Verbal Table" TAB_VERB "%.0" "list" COMPU_TAB_REF MEFI_sync_status_COMPU_VTAB_REF /end COMPU_METHOD
/begin COMPU_VTAB MEFI_sync_status_COMPU_VTAB_REF "Verbal Table" TAB_VERB 2 0 "Not Available" 1 "Available" DEFAULT_VALUE "UNKNOWN" /end COMPU_VTAB
/begin CHARACTERISTIC MSC_spddot_ena "{MSC_spddot_ena&0xff=0:Disabled}{MSC_spddot_ena&0xff=1:Enabled}" VALUE 0x00147e7b /* @ECU_Address@MSC_spddot_ena@0x01007BA8@ */ ECIPP_ALIGNMENT_UBYTE 255 MSC_spddot_ena_COMPU_VTAB 0 255 BIT_MASK 0xff /end CHARACTERISTIC
/begin COMPU_METHOD MSC_spddot_ena_COMPU_VTAB "Verbal Table" TAB_VERB "%.0" "list" COMPU_TAB_REF MSC_spddot_ena_COMPU_VTAB_REF /end COMPU_METHOD
/begin COMPU_VTAB MSC_spddot_ena_COMPU_VTAB_REF "Verbal Table" TAB_VERB 2 0 "Disabled" 1 "Enabled" DEFAULT_VALUE "UNKNOWN" /end COMPU_VTAB
/begin CHARACTERISTIC APUD8_max "FaultConfig # APUD8_max (Fault Condition:AUX analog PUD8 >)" VALUE 0x00163466 /* @ECU_Address@APUD8_max@0x01007C58@ */ ECIPP_ALIGNMENT_UWORD 5 Compu_APUD8_max 0 5.00114468864469 /end CHARACTERISTIC
/begin COMPU_METHOD Compu_APUD8_max " " RAT_FUNC "%.3" "volts" COEFFS 0 13104 0 0 0 1 /end COMPU_METHOD
/begin CHARACTERISTIC APUD8_min "FaultConfig # APUD8_min (Fault Condition:AUX analog PUD8 <)" VALUE 0x00163468 /* @ECU_Address@APUD8_min@0x01007C60@ */ ECIPP_ALIGNMENT_UWORD 5 Compu_APUD8_min 0 5.00114468864469 /end CHARACTERISTIC
/begin COMPU_METHOD Compu_APUD8_min " " RAT_FUNC "%.3" "volts" COEFFS 0 13104 0 0 0 1 /end COMPU_METHOD
/begin CHARACTERISTIC ADIG11_max "FaultConfig # ADIG11_max (Fault Condition:AUX DIG11 >)" VALUE 0x00163392 /* @ECU_Address@ADIG11_max@0x01007C68@ */ ECIPP_ALIGNMENT_UWORD 256 Compu_ADIG11_max 0 255.99609375 /end CHARACTERISTIC
/begin COMPU_METHOD Compu_ADIG11_max " " RAT_FUNC "%.3" "volts" COEFFS 0 256 0 0 0 1 /end COMPU_METHOD
/begin CHARACTERISTIC ADIG11_min "FaultConfig # ADIG11_min (Fault Condition:AUX DIG11 <)" VALUE 0x00163394 /* @ECU_Address@ADIG11_min@0x01007C70@ */ ECIPP_ALIGNMENT_UWORD 256 Compu_ADIG11_min 0 255.99609375 /end CHARACTERISTIC
/begin COMPU_METHOD Compu_ADIG11_min " " RAT_FUNC "%.3" "volts" COEFFS 0 256 0 0 0 1 /end COMPU_METHOD
/begin CHARACTERISTIC ADIG12_max "FaultConfig # ADIG12_max (Fault Condition:AUX DIG12 >)" VALUE 0x00163396 /* @ECU_Address@ADIG12_max@0x01007C78@ */ ECIPP_ALIGNMENT_UWORD 256 Compu_ADIG12_max 0 255.99609375 /end CHARACTERISTIC
/begin COMPU_METHOD Compu_ADIG12_max " " RAT_FUNC "%.3" "volts" COEFFS 0 256 0 0 0 1 /end COMPU_METHOD
/begin CHARACTERISTIC ADIG12_min "FaultConfig # ADIG12_min (Fault Condition:AUX DIG12 <)" VALUE 0x00163398 /* @ECU_Address@ADIG12_min@0x01007C80@ */ ECIPP_ALIGNMENT_UWORD 256 Compu_ADIG12_min 0 255.99609375 /end CHARACTERISTIC
/begin COMPU_METHOD Compu_ADIG12_min " " RAT_FUNC "%.3" "volts" COEFFS 0 256 0 0 0 1 /end COMPU_METHOD
/begin CHARACTERISTIC FPUMP_on_loVf "FaultConfig # FPUMP_on_loVf (Fault Condition:OR high-side driver on-state feedback <)" VALUE 0x001468ce /* @ECU_Address@FPUMP_on_loVf@0x01007C88@ */ ECIPP_ALIGNMENT_UWORD 100 Compu_FPUMP_on_loVf 0 99.9984741210938 /end CHARACTERISTIC
/begin COMPU_METHOD Compu_FPUMP_on_loVf " " RAT_FUNC "%.3" "% Vbat" COEFFS 0 655.36 0 0 0 1 /end COMPU_METHOD
/begin CHARACTERISTIC FPUMP_on_hiVf "FaultConfig # FPUMP_on_hiVf (Fault Condition:OR low-side driver on-state feedback >)" VALUE 0x001468cc /* @ECU_Address@FPUMP_on_hiVf@0x01007C90@ */ ECIPP_ALIGNMENT_UWORD 100 Compu_FPUMP_on_hiVf 0 99.9984741210938 /end CHARACTERISTIC
/begin COMPU_METHOD Compu_FPUMP_on_hiVf " " RAT_FUNC "%.3" "% Vbat" COEFFS 0 655.36 0 0 0 1 /end COMPU_METHOD
/begin CHARACTERISTIC FPUMP_off_hi_volt "FaultConfig # FPUMP_off_hi_volt (Fault Condition:OR high-side driver off-state feedback >)" VALUE 0x001468c8 /* @ECU_Address@FPUMP_off_hi_volt@0x01007C98@ */ ECIPP_ALIGNMENT_UWORD 256 Compu_FPUMP_off_hi_volt 0 255.99609375 /end CHARACTERISTIC
/begin COMPU_METHOD Compu_FPUMP_off_hi_volt " " RAT_FUNC "%.3" "volts" COEFFS 0 256 0 0 0 1 /end COMPU_METHOD
/begin CHARACTERISTIC START_off_hi_volt "FaultConfig # START_off_hi_volt (Fault Condition:high-side feedback >)" VALUE 0x001477f8 /* @ECU_Address@START_off_hi_volt@0x01007CA0@ */ ECIPP_ALIGNMENT_UWORD 256 Compu_START_off_hi_volt 0 255.99609375 /end CHARACTERISTIC
/begin COMPU_METHOD Compu_START_off_hi_volt " " RAT_FUNC "%.3" "volts" COEFFS 0 256 0 0 0 1 /end COMPU_METHOD
/begin CHARACTERISTIC START_on_loVf "FaultConfig # START_on_loVf (Fault Condition:High-side feedback  <)" VALUE 0x001477fe /* @ECU_Address@START_on_loVf@0x01007CA8@ */ ECIPP_ALIGNMENT_UWORD 100 Compu_START_on_loVf 0 99.9984741210938 /end CHARACTERISTIC
/begin COMPU_METHOD Compu_START_on_loVf " " RAT_FUNC "%.3" "% Vbat" COEFFS 0 655.36 0 0 0 1 /end COMPU_METHOD
/begin CHARACTERISTIC APUD9_max "FaultConfig # APUD9_max (Fault Condition:AUX analog PUD9 >)" VALUE 0x0016346a /* @ECU_Address@APUD9_max@0x01007FF8@ */ ECIPP_ALIGNMENT_UWORD 5 Compu_APUD9_max 0 5.00114468864469 /end CHARACTERISTIC
/begin COMPU_METHOD Compu_APUD9_max " " RAT_FUNC "%.3" "volts" COEFFS 0 13104 0 0 0 1 /end COMPU_METHOD
/begin CHARACTERISTIC APUD9_min "FaultConfig # APUD9_min (Fault Condition:AUX analog PUD9 <)" VALUE 0x0016346c /* @ECU_Address@APUD9_min@0x01008000@ */ ECIPP_ALIGNMENT_UWORD 5 Compu_APUD9_min 0 5.00114468864469 /end CHARACTERISTIC
/begin COMPU_METHOD Compu_APUD9_min " " RAT_FUNC "%.3" "volts" COEFFS 0 13104 0 0 0 1 /end COMPU_METHOD
/begin CHARACTERISTIC APUD10_max "FaultConfig # APUD10_max (Fault Condition:AUX analog PUD10 >)" VALUE 0x0016340a /* @ECU_Address@APUD10_max@0x01008008@ */ ECIPP_ALIGNMENT_UWORD 5 Compu_APUD10_max 0 5.00114468864469 /end CHARACTERISTIC
/begin COMPU_METHOD Compu_APUD10_max " " RAT_FUNC "%.3" "volts" COEFFS 0 13104 0 0 0 1 /end COMPU_METHOD
/begin CHARACTERISTIC APUD10_min "FaultConfig # APUD10_min (Fault Condition:AUX analog PUD10 <)" VALUE 0x0016340c /* @ECU_Address@APUD10_min@0x01008010@ */ ECIPP_ALIGNMENT_UWORD 5 Compu_APUD10_min 0 5.00114468864469 /end CHARACTERISTIC
/begin COMPU_METHOD Compu_APUD10_min " " RAT_FUNC "%.3" "volts" COEFFS 0 13104 0 0 0 1 /end COMPU_METHOD
/begin CHARACTERISTIC APUD11_max "FaultConfig # APUD11_max (Fault Condition:AUX analog PUD11 >)" VALUE 0x0016340e /* @ECU_Address@APUD11_max@0x01008018@ */ ECIPP_ALIGNMENT_UWORD 5 Compu_APUD11_max 0 5.00114468864469 /end CHARACTERISTIC
/begin COMPU_METHOD Compu_APUD11_max " " RAT_FUNC "%.3" "volts" COEFFS 0 13104 0 0 0 1 /end COMPU_METHOD
/begin CHARACTERISTIC APUD11_min "FaultConfig # APUD11_min (Fault Condition:AUX analog PUD11 <)" VALUE 0x00163410 /* @ECU_Address@APUD11_min@0x01008020@ */ ECIPP_ALIGNMENT_UWORD 5 Compu_APUD11_min 0 5.00114468864469 /end CHARACTERISTIC
/begin COMPU_METHOD Compu_APUD11_min " " RAT_FUNC "%.3" "volts" COEFFS 0 13104 0 0 0 1 /end COMPU_METHOD
/begin CHARACTERISTIC APUD12_max "FaultConfig # APUD12_max (Fault Condition:AUX analog PUD12 >)" VALUE 0x00163412 /* @ECU_Address@APUD12_max@0x01008028@ */ ECIPP_ALIGNMENT_UWORD 5 Compu_APUD12_max 0 5.00114468864469 /end CHARACTERISTIC
/begin COMPU_METHOD Compu_APUD12_max " " RAT_FUNC "%.3" "volts" COEFFS 0 13104 0 0 0 1 /end COMPU_METHOD
/begin CHARACTERISTIC APUD12_min "FaultConfig # APUD12_min (Fault Condition:AUX analog PUD12 <)" VALUE 0x00163414 /* @ECU_Address@APUD12_min@0x01008030@ */ ECIPP_ALIGNMENT_UWORD 5 Compu_APUD12_min 0 5.00114468864469 /end CHARACTERISTIC
/begin COMPU_METHOD Compu_APUD12_min " " RAT_FUNC "%.3" "volts" COEFFS 0 13104 0 0 0 1 /end COMPU_METHOD
/begin CHARACTERISTIC APUD13_max "FaultConfig # APUD13_max (Fault Condition:AUX analog PUD13 >)" VALUE 0x00163416 /* @ECU_Address@APUD13_max@0x01008038@ */ ECIPP_ALIGNMENT_UWORD 5 Compu_APUD13_max 0 5.00114468864469 /end CHARACTERISTIC
/begin COMPU_METHOD Compu_APUD13_max " " RAT_FUNC "%.3" "volts" COEFFS 0 13104 0 0 0 1 /end COMPU_METHOD
/begin CHARACTERISTIC APUD13_min "FaultConfig # APUD13_min (Fault Condition:AUX analog PUD13 <)" VALUE 0x00163418 /* @ECU_Address@APUD13_min@0x01008040@ */ ECIPP_ALIGNMENT_UWORD 5 Compu_APUD13_min 0 5.00114468864469 /end CHARACTERISTIC
/begin COMPU_METHOD Compu_APUD13_min " " RAT_FUNC "%.3" "volts" COEFFS 0 13104 0 0 0 1 /end COMPU_METHOD
/begin CHARACTERISTIC APUD14_max "FaultConfig # APUD14_max (Fault Condition:AUX analog PUD14 >)" VALUE 0x0016341a /* @ECU_Address@APUD14_max@0x01008048@ */ ECIPP_ALIGNMENT_UWORD 5 Compu_APUD14_max 0 5.00114468864469 /end CHARACTERISTIC
/begin COMPU_METHOD Compu_APUD14_max " " RAT_FUNC "%.3" "volts" COEFFS 0 13104 0 0 0 1 /end COMPU_METHOD
/begin CHARACTERISTIC APUD14_min "FaultConfig # APUD14_min (Fault Condition:AUX analog PUD14 <)" VALUE 0x0016341c /* @ECU_Address@APUD14_min@0x01008050@ */ ECIPP_ALIGNMENT_UWORD 5 Compu_APUD14_min 0 5.00114468864469 /end CHARACTERISTIC
/begin COMPU_METHOD Compu_APUD14_min " " RAT_FUNC "%.3" "volts" COEFFS 0 13104 0 0 0 1 /end COMPU_METHOD
/begin CHARACTERISTIC APUD15_max "FaultConfig # APUD15_max (Fault Condition:AUX analog PUD15 >)" VALUE 0x0016341e /* @ECU_Address@APUD15_max@0x01008058@ */ ECIPP_ALIGNMENT_UWORD 5 Compu_APUD15_max 0 5.00114468864469 /end CHARACTERISTIC
/begin COMPU_METHOD Compu_APUD15_max " " RAT_FUNC "%.3" "volts" COEFFS 0 13104 0 0 0 1 /end COMPU_METHOD
/begin CHARACTERISTIC APUD15_min "FaultConfig # APUD15_min (Fault Condition:AUX analog PUD15 <)" VALUE 0x00163420 /* @ECU_Address@APUD15_min@0x01008060@ */ ECIPP_ALIGNMENT_UWORD 5 Compu_APUD15_min 0 5.00114468864469 /end CHARACTERISTIC
/begin COMPU_METHOD Compu_APUD15_min " " RAT_FUNC "%.3" "volts" COEFFS 0 13104 0 0 0 1 /end COMPU_METHOD
/begin CHARACTERISTIC APUD16_max "FaultConfig # APUD16_max (Fault Condition:AUX analog PUD16 >)" VALUE 0x00163422 /* @ECU_Address@APUD16_max@0x01008068@ */ ECIPP_ALIGNMENT_UWORD 5 Compu_APUD16_max 0 5.00114468864469 /end CHARACTERISTIC
/begin COMPU_METHOD Compu_APUD16_max " " RAT_FUNC "%.3" "volts" COEFFS 0 13104 0 0 0 1 /end COMPU_METHOD
/begin CHARACTERISTIC APUD16_min "FaultConfig # APUD16_min (Fault Condition:AUX analog PUD16 <)" VALUE 0x00163424 /* @ECU_Address@APUD16_min@0x01008070@ */ ECIPP_ALIGNMENT_UWORD 5 Compu_APUD16_min 0 5.00114468864469 /end CHARACTERISTIC
/begin COMPU_METHOD Compu_APUD16_min " " RAT_FUNC "%.3" "volts" COEFFS 0 13104 0 0 0 1 /end COMPU_METHOD
/begin CHARACTERISTIC APUD17_max "FaultConfig # APUD17_max (Fault Condition:AUX analog PUD17 >)" VALUE 0x00163426 /* @ECU_Address@APUD17_max@0x01008078@ */ ECIPP_ALIGNMENT_UWORD 5 Compu_APUD17_max 0 5.00114468864469 /end CHARACTERISTIC
/begin COMPU_METHOD Compu_APUD17_max " " RAT_FUNC "%.3" "volts" COEFFS 0 13104 0 0 0 1 /end COMPU_METHOD
/begin CHARACTERISTIC APUD17_min "FaultConfig # APUD17_min (Fault Condition:AUX analog PUD17 <)" VALUE 0x00163428 /* @ECU_Address@APUD17_min@0x01008080@ */ ECIPP_ALIGNMENT_UWORD 5 Compu_APUD17_min 0 5.00114468864469 /end CHARACTERISTIC
/begin COMPU_METHOD Compu_APUD17_min " " RAT_FUNC "%.3" "volts" COEFFS 0 13104 0 0 0 1 /end COMPU_METHOD
/begin CHARACTERISTIC APUD18_max "FaultConfig # APUD18_max (Fault Condition:AUX analog PUD18 >)" VALUE 0x0016342a /* @ECU_Address@APUD18_max@0x01008088@ */ ECIPP_ALIGNMENT_UWORD 5 Compu_APUD18_max 0 5.00114468864469 /end CHARACTERISTIC
/begin COMPU_METHOD Compu_APUD18_max " " RAT_FUNC "%.3" "volts" COEFFS 0 13104 0 0 0 1 /end COMPU_METHOD
/begin CHARACTERISTIC APUD18_min "FaultConfig # APUD18_min (Fault Condition:AUX analog PUD18 <)" VALUE 0x0016342c /* @ECU_Address@APUD18_min@0x01008090@ */ ECIPP_ALIGNMENT_UWORD 5 Compu_APUD18_min 0 5.00114468864469 /end CHARACTERISTIC
/begin COMPU_METHOD Compu_APUD18_min " " RAT_FUNC "%.3" "volts" COEFFS 0 13104 0 0 0 1 /end COMPU_METHOD
/begin CHARACTERISTIC APUD19_max "FaultConfig # APUD19_max (Fault Condition:AUX analog PUD19 >)" VALUE 0x0016342e /* @ECU_Address@APUD19_max@0x01008098@ */ ECIPP_ALIGNMENT_UWORD 5 Compu_APUD19_max 0 5.00114468864469 /end CHARACTERISTIC
/begin COMPU_METHOD Compu_APUD19_max " " RAT_FUNC "%.3" "volts" COEFFS 0 13104 0 0 0 1 /end COMPU_METHOD
/begin CHARACTERISTIC APUD19_min "FaultConfig # APUD19_min (Fault Condition:AUX analog PUD19 <)" VALUE 0x00163430 /* @ECU_Address@APUD19_min@0x010080A0@ */ ECIPP_ALIGNMENT_UWORD 5 Compu_APUD19_min 0 5.00114468864469 /end CHARACTERISTIC
/begin COMPU_METHOD Compu_APUD19_min " " RAT_FUNC "%.3" "volts" COEFFS 0 13104 0 0 0 1 /end COMPU_METHOD
/begin CHARACTERISTIC APUD20_max "FaultConfig # APUD20_max (Fault Condition:AUX analog PUD20 >)" VALUE 0x00163436 /* @ECU_Address@APUD20_max@0x010080A8@ */ ECIPP_ALIGNMENT_UWORD 5 Compu_APUD20_max 0 5.00114468864469 /end CHARACTERISTIC
/begin COMPU_METHOD Compu_APUD20_max " " RAT_FUNC "%.3" "volts" COEFFS 0 13104 0 0 0 1 /end COMPU_METHOD
/begin CHARACTERISTIC APUD20_min "FaultConfig # APUD20_min (Fault Condition:AUX analog PUD20 <)" VALUE 0x00163438 /* @ECU_Address@APUD20_min@0x010080B0@ */ ECIPP_ALIGNMENT_UWORD 5 Compu_APUD20_min 0 5.00114468864469 /end CHARACTERISTIC
/begin COMPU_METHOD Compu_APUD20_min " " RAT_FUNC "%.3" "volts" COEFFS 0 13104 0 0 0 1 /end COMPU_METHOD
/begin CHARACTERISTIC APUD21_max "FaultConfig # APUD21_max (Fault Condition:AUX analog PUD21 >)" VALUE 0x0016343a /* @ECU_Address@APUD21_max@0x010080B8@ */ ECIPP_ALIGNMENT_UWORD 5 Compu_APUD21_max 0 5.00114468864469 /end CHARACTERISTIC
/begin COMPU_METHOD Compu_APUD21_max " " RAT_FUNC "%.3" "volts" COEFFS 0 13104 0 0 0 1 /end COMPU_METHOD
/begin CHARACTERISTIC APUD21_min "FaultConfig # APUD21_min (Fault Condition:AUX analog PUD21 <)" VALUE 0x0016343c /* @ECU_Address@APUD21_min@0x010080C0@ */ ECIPP_ALIGNMENT_UWORD 5 Compu_APUD21_min 0 5.00114468864469 /end CHARACTERISTIC
/begin COMPU_METHOD Compu_APUD21_min " " RAT_FUNC "%.3" "volts" COEFFS 0 13104 0 0 0 1 /end COMPU_METHOD
/begin CHARACTERISTIC APUD22_max "FaultConfig # APUD22_max (Fault Condition:AUX analog PUD22 >)" VALUE 0x0016343e /* @ECU_Address@APUD22_max@0x010080C8@ */ ECIPP_ALIGNMENT_UWORD 5 Compu_APUD22_max 0 5.00114468864469 /end CHARACTERISTIC
/begin COMPU_METHOD Compu_APUD22_max " " RAT_FUNC "%.3" "volts" COEFFS 0 13104 0 0 0 1 /end COMPU_METHOD
/begin CHARACTERISTIC APUD22_min "FaultConfig # APUD22_min (Fault Condition:AUX analog PUD22 <)" VALUE 0x00163440 /* @ECU_Address@APUD22_min@0x010080D0@ */ ECIPP_ALIGNMENT_UWORD 5 Compu_APUD22_min 0 5.00114468864469 /end CHARACTERISTIC
/begin COMPU_METHOD Compu_APUD22_min " " RAT_FUNC "%.3" "volts" COEFFS 0 13104 0 0 0 1 /end COMPU_METHOD
/begin CHARACTERISTIC APUD23_max "FaultConfig # APUD23_max (Fault Condition:AUX analog PUD23 >)" VALUE 0x00163442 /* @ECU_Address@APUD23_max@0x010080D8@ */ ECIPP_ALIGNMENT_UWORD 5 Compu_APUD23_max 0 5.00114468864469 /end CHARACTERISTIC
/begin COMPU_METHOD Compu_APUD23_max " " RAT_FUNC "%.3" "volts" COEFFS 0 13104 0 0 0 1 /end COMPU_METHOD
/begin CHARACTERISTIC APUD23_min "FaultConfig # APUD23_min (Fault Condition:AUX analog PUD23 <)" VALUE 0x00163444 /* @ECU_Address@APUD23_min@0x010080E0@ */ ECIPP_ALIGNMENT_UWORD 5 Compu_APUD23_min 0 5.00114468864469 /end CHARACTERISTIC
/begin COMPU_METHOD Compu_APUD23_min " " RAT_FUNC "%.3" "volts" COEFFS 0 13104 0 0 0 1 /end COMPU_METHOD
/begin CHARACTERISTIC APUD24_max "FaultConfig # APUD24_max (Fault Condition:AUX analog PUD24 >)" VALUE 0x00163446 /* @ECU_Address@APUD24_max@0x010080E8@ */ ECIPP_ALIGNMENT_UWORD 5 Compu_APUD24_max 0 5.00114468864469 /end CHARACTERISTIC
/begin COMPU_METHOD Compu_APUD24_max " " RAT_FUNC "%.3" "volts" COEFFS 0 13104 0 0 0 1 /end COMPU_METHOD
/begin CHARACTERISTIC APUD24_min "FaultConfig # APUD24_min (Fault Condition:AUX analog PUD24 <)" VALUE 0x00163448 /* @ECU_Address@APUD24_min@0x010080F0@ */ ECIPP_ALIGNMENT_UWORD 5 Compu_APUD24_min 0 5.00114468864469 /end CHARACTERISTIC
/begin COMPU_METHOD Compu_APUD24_min " " RAT_FUNC "%.3" "volts" COEFFS 0 13104 0 0 0 1 /end COMPU_METHOD
/begin CHARACTERISTIC APUD25_max "FaultConfig # APUD25_max (Fault Condition:AUX analog PUD25 >)" VALUE 0x0016344a /* @ECU_Address@APUD25_max@0x010080F8@ */ ECIPP_ALIGNMENT_UWORD 5 Compu_APUD25_max 0 5.00114468864469 /end CHARACTERISTIC
/begin COMPU_METHOD Compu_APUD25_max " " RAT_FUNC "%.3" "volts" COEFFS 0 13104 0 0 0 1 /end COMPU_METHOD
/begin CHARACTERISTIC APUD25_min "FaultConfig # APUD25_min (Fault Condition:AUX analog PUD25 <)" VALUE 0x0016344c /* @ECU_Address@APUD25_min@0x01008100@ */ ECIPP_ALIGNMENT_UWORD 5 Compu_APUD25_min 0 5.00114468864469 /end CHARACTERISTIC
/begin COMPU_METHOD Compu_APUD25_min " " RAT_FUNC "%.3" "volts" COEFFS 0 13104 0 0 0 1 /end COMPU_METHOD
/begin CHARACTERISTIC ADIG13_max "FaultConfig # ADIG13_max (Fault Condition:AUX DIG13 >)" VALUE 0x0016339a /* @ECU_Address@ADIG13_max@0x01008108@ */ ECIPP_ALIGNMENT_UWORD 256 Compu_ADIG13_max 0 255.99609375 /end CHARACTERISTIC
/begin COMPU_METHOD Compu_ADIG13_max " " RAT_FUNC "%.3" "volts" COEFFS 0 256 0 0 0 1 /end COMPU_METHOD
/begin CHARACTERISTIC ADIG13_min "FaultConfig # ADIG13_min (Fault Condition:AUX DIG13 <)" VALUE 0x0016339c /* @ECU_Address@ADIG13_min@0x01008110@ */ ECIPP_ALIGNMENT_UWORD 256 Compu_ADIG13_min 0 255.99609375 /end CHARACTERISTIC
/begin COMPU_METHOD Compu_ADIG13_min " " RAT_FUNC "%.3" "volts" COEFFS 0 256 0 0 0 1 /end COMPU_METHOD
/begin CHARACTERISTIC ADIG14_max "FaultConfig # ADIG14_max (Fault Condition:AUX DIG14 >)" VALUE 0x0016339e /* @ECU_Address@ADIG14_max@0x01008118@ */ ECIPP_ALIGNMENT_UWORD 256 Compu_ADIG14_max 0 255.99609375 /end CHARACTERISTIC
/begin COMPU_METHOD Compu_ADIG14_max " " RAT_FUNC "%.3" "volts" COEFFS 0 256 0 0 0 1 /end COMPU_METHOD
/begin CHARACTERISTIC ADIG14_min "FaultConfig # ADIG14_min (Fault Condition:AUX DIG14 <)" VALUE 0x001633a0 /* @ECU_Address@ADIG14_min@0x01008120@ */ ECIPP_ALIGNMENT_UWORD 256 Compu_ADIG14_min 0 255.99609375 /end CHARACTERISTIC
/begin COMPU_METHOD Compu_ADIG14_min " " RAT_FUNC "%.3" "volts" COEFFS 0 256 0 0 0 1 /end COMPU_METHOD
/begin CHARACTERISTIC ADIG15_max "FaultConfig # ADIG15_max (Fault Condition:AUX DIG15 >)" VALUE 0x001633a2 /* @ECU_Address@ADIG15_max@0x01008128@ */ ECIPP_ALIGNMENT_UWORD 256 Compu_ADIG15_max 0 255.99609375 /end CHARACTERISTIC
/begin COMPU_METHOD Compu_ADIG15_max " " RAT_FUNC "%.3" "volts" COEFFS 0 256 0 0 0 1 /end COMPU_METHOD
/begin CHARACTERISTIC ADIG15_min "FaultConfig # ADIG15_min (Fault Condition:AUX DIG15 <)" VALUE 0x001633a4 /* @ECU_Address@ADIG15_min@0x01008130@ */ ECIPP_ALIGNMENT_UWORD 256 Compu_ADIG15_min 0 255.99609375 /end CHARACTERISTIC
/begin COMPU_METHOD Compu_ADIG15_min " " RAT_FUNC "%.3" "volts" COEFFS 0 256 0 0 0 1 /end COMPU_METHOD
/begin CHARACTERISTIC ADIG16_max "FaultConfig # ADIG16_max (Fault Condition:AUX DIG16 >)" VALUE 0x001633a6 /* @ECU_Address@ADIG16_max@0x01008138@ */ ECIPP_ALIGNMENT_UWORD 256 Compu_ADIG16_max 0 255.99609375 /end CHARACTERISTIC
/begin COMPU_METHOD Compu_ADIG16_max " " RAT_FUNC "%.3" "volts" COEFFS 0 256 0 0 0 1 /end COMPU_METHOD
/begin CHARACTERISTIC ADIG16_min "FaultConfig # ADIG16_min (Fault Condition:AUX DIG16 <)" VALUE 0x001633a8 /* @ECU_Address@ADIG16_min@0x01008140@ */ ECIPP_ALIGNMENT_UWORD 256 Compu_ADIG16_min 0 255.99609375 /end CHARACTERISTIC
/begin COMPU_METHOD Compu_ADIG16_min " " RAT_FUNC "%.3" "volts" COEFFS 0 256 0 0 0 1 /end COMPU_METHOD
/begin CHARACTERISTIC ADIG17_max "FaultConfig # ADIG17_max (Fault Condition:AUX DIG17 >)" VALUE 0x001633aa /* @ECU_Address@ADIG17_max@0x01008148@ */ ECIPP_ALIGNMENT_UWORD 256 Compu_ADIG17_max 0 255.99609375 /end CHARACTERISTIC
/begin COMPU_METHOD Compu_ADIG17_max " " RAT_FUNC "%.3" "volts" COEFFS 0 256 0 0 0 1 /end COMPU_METHOD
/begin CHARACTERISTIC ADIG17_min "FaultConfig # ADIG17_min (Fault Condition:AUX DIG17 <)" VALUE 0x001633ac /* @ECU_Address@ADIG17_min@0x01008150@ */ ECIPP_ALIGNMENT_UWORD 256 Compu_ADIG17_min 0 255.99609375 /end CHARACTERISTIC
/begin COMPU_METHOD Compu_ADIG17_min " " RAT_FUNC "%.3" "volts" COEFFS 0 256 0 0 0 1 /end COMPU_METHOD
/begin CHARACTERISTIC ADIG18_max "FaultConfig # ADIG18_max (Fault Condition:AUX DIG18 >)" VALUE 0x001633ae /* @ECU_Address@ADIG18_max@0x01008158@ */ ECIPP_ALIGNMENT_UWORD 256 Compu_ADIG18_max 0 255.99609375 /end CHARACTERISTIC
/begin COMPU_METHOD Compu_ADIG18_max " " RAT_FUNC "%.3" "volts" COEFFS 0 256 0 0 0 1 /end COMPU_METHOD
/begin CHARACTERISTIC ADIG18_min "FaultConfig # ADIG18_min (Fault Condition:AUX DIG18 <)" VALUE 0x001633b0 /* @ECU_Address@ADIG18_min@0x01008160@ */ ECIPP_ALIGNMENT_UWORD 256 Compu_ADIG18_min 0 255.99609375 /end CHARACTERISTIC
/begin COMPU_METHOD Compu_ADIG18_min " " RAT_FUNC "%.3" "volts" COEFFS 0 256 0 0 0 1 /end COMPU_METHOD
/begin CHARACTERISTIC ADIG19_max "FaultConfig # ADIG19_max (Fault Condition:AUX DIG19 >)" VALUE 0x001633b2 /* @ECU_Address@ADIG19_max@0x01008168@ */ ECIPP_ALIGNMENT_UWORD 256 Compu_ADIG19_max 0 255.99609375 /end CHARACTERISTIC
/begin COMPU_METHOD Compu_ADIG19_max " " RAT_FUNC "%.3" "volts" COEFFS 0 256 0 0 0 1 /end COMPU_METHOD
/begin CHARACTERISTIC ADIG19_min "FaultConfig # ADIG19_min (Fault Condition:AUX DIG19 <)" VALUE 0x001633b4 /* @ECU_Address@ADIG19_min@0x01008170@ */ ECIPP_ALIGNMENT_UWORD 256 Compu_ADIG19_min 0 255.99609375 /end CHARACTERISTIC
/begin COMPU_METHOD Compu_ADIG19_min " " RAT_FUNC "%.3" "volts" COEFFS 0 256 0 0 0 1 /end COMPU_METHOD
/begin CHARACTERISTIC LowOperTemp_MAP "FaultConfig # LowOperTemp_MAP (Fault Condition:and MAP >)" VALUE 0x00147588 /* @ECU_Address@LowOperTemp_MAP@0x01008178@ */ ECIPP_ALIGNMENT_UWORD 256 Compu_LowOperTemp_MAP 0 255.99609375 /end CHARACTERISTIC
/begin COMPU_METHOD Compu_LowOperTemp_MAP " " RAT_FUNC "%.3" "psia" COEFFS 0 256 0 0 0 1 /end COMPU_METHOD
/begin CHARACTERISTIC LowOperTemp_rpm "FaultConfig # LowOperTemp_rpm (Fault Condition:and RPM >)" VALUE 0x0014758a /* @ECU_Address@LowOperTemp_rpm@0x01008190@ */ ECIPP_ALIGNMENT_UWORD 65535 Compu_LowOperTemp_rpm 0 65535 /end CHARACTERISTIC
/begin COMPU_METHOD Compu_LowOperTemp_rpm " " RAT_FUNC "%.0" "rpm" COEFFS 0 1 0 0 0 1 /end COMPU_METHOD
/begin CHARACTERISTIC UGF2_run_wait "FaultConfig # UGF2_run_wait (Fault Condition:or warmup period and an additional)" VALUE 0x00144210 /* @ECU_Address@UGF2_run_wait@0x01008198@ */ ECIPP_ALIGNMENT_ULONG 4294967 Compu_UGF2_run_wait 0 4294967.295 /end CHARACTERISTIC
/begin COMPU_METHOD Compu_UGF2_run_wait " " RAT_FUNC "%.3" "seconds" COEFFS 0 1000 0 0 0 1 /end COMPU_METHOD
/begin CHARACTERISTIC BstPtarget_Hi_abs "FaultConfig # BstPtarget_Hi_abs (Fault Condition:and P target >=)" VALUE 0x001466b8 /* @ECU_Address@BstPtarget_Hi_abs@0x010082B0@ */ ECIPP_ALIGNMENT_UWORD 256 Compu_BstPtarget_Hi_abs 0 255.99609375 /end CHARACTERISTIC
/begin COMPU_METHOD Compu_BstPtarget_Hi_abs " " RAT_FUNC "%.3" "psia" COEFFS 0 256 0 0 0 1 /end COMPU_METHOD
/begin CHARACTERISTIC Aux_DIG12_rpm_lo "FaultConfig # Aux_DIG12_rpm_lo (Fault Condition:and RPM >=)" VALUE 0x00163472 /* @ECU_Address@Aux_DIG12_rpm_lo@0x01008430@ */ ECIPP_ALIGNMENT_UWORD 65535 Compu_Aux_DIG12_rpm_lo 0 65535 /end CHARACTERISTIC
/begin COMPU_METHOD Compu_Aux_DIG12_rpm_lo " " RAT_FUNC "%.0" "rpm" COEFFS 0 1 0 0 0 1 /end COMPU_METHOD
/begin CHARACTERISTIC Aux_DIG12_rpm_hi "FaultConfig # Aux_DIG12_rpm_hi (Fault Condition:and RPM <=)" VALUE 0x00163470 /* @ECU_Address@Aux_DIG12_rpm_hi@0x01008438@ */ ECIPP_ALIGNMENT_UWORD 65535 Compu_Aux_DIG12_rpm_hi 0 65535 /end CHARACTERISTIC
/begin COMPU_METHOD Compu_Aux_DIG12_rpm_hi " " RAT_FUNC "%.0" "rpm" COEFFS 0 1 0 0 0 1 /end COMPU_METHOD
/begin CHARACTERISTIC Aux_DIG12_ECT_lo "FaultConfig # Aux_DIG12_ECT_lo (Fault Condition:and ECT >=)" VALUE 0x0016346e /* @ECU_Address@Aux_DIG12_ECT_lo@0x01008440@ */ ECIPP_ALIGNMENT_UWORD 564 Compu_Aux_DIG12_ECT_lo -460 563.984375 /end CHARACTERISTIC
/begin COMPU_METHOD Compu_Aux_DIG12_ECT_lo " " RAT_FUNC "%.3" "deg F" COEFFS 0 64 29440 0 0 1 /end COMPU_METHOD
/begin CHARACTERISTIC SPKD_crank_enabled "{SPKD_crank_enabled&0xff=0:Disabled}{SPKD_crank_enabled&0xff=1:Enabled} (Fault Condition:Diagnose faults while cranking)" VALUE 0x00147f38 /* @ECU_Address@SPKD_crank_enabled@0x01008468@ */ ECIPP_ALIGNMENT_UBYTE 255 SPKD_crank_enabled_COMPU_VTAB 0 255 BIT_MASK 0xff /end CHARACTERISTIC
/begin COMPU_METHOD SPKD_crank_enabled_COMPU_VTAB "Verbal Table" TAB_VERB "%.0" "list" COMPU_TAB_REF SPKD_crank_enabled_COMPU_VTAB_REF /end COMPU_METHOD
/begin COMPU_VTAB SPKD_crank_enabled_COMPU_VTAB_REF "Verbal Table" TAB_VERB 2 0 "Disabled" 1 "Enabled" DEFAULT_VALUE "UNKNOWN" /end COMPU_VTAB
/begin CHARACTERISTIC BUZZ_off_loVf "FaultConfig # BUZZ_off_loVf (Fault Condition:Low-side feedback <)" VALUE 0x00163486 /* @ECU_Address@BUZZ_off_loVf@0x01008478@ */ ECIPP_ALIGNMENT_UWORD 100 Compu_BUZZ_off_loVf 0 99.9984741210938 /end CHARACTERISTIC
/begin COMPU_METHOD Compu_BUZZ_off_loVf " " RAT_FUNC "%.3" "% Vbat" COEFFS 0 655.36 0 0 0 1 /end COMPU_METHOD
/begin CHARACTERISTIC BUZZ_on_hiVf "FaultConfig # BUZZ_on_hiVf (Fault Condition:Low-side feedback >)" VALUE 0x00163488 /* @ECU_Address@BUZZ_on_hiVf@0x01008480@ */ ECIPP_ALIGNMENT_UWORD 100 Compu_BUZZ_on_hiVf 0 99.9984741210938 /end CHARACTERISTIC
/begin COMPU_METHOD Compu_BUZZ_on_hiVf " " RAT_FUNC "%.3" "% Vbat" COEFFS 0 655.36 0 0 0 1 /end COMPU_METHOD
/begin CHARACTERISTIC UEGOH1_off_loVf "FaultConfig # UEGOH1_off_loVf (Fault Condition:UEGO1 heater low-side feedback <)" VALUE 0x0016509c /* @ECU_Address@UEGOH1_off_loVf@0x01008560@ */ ECIPP_ALIGNMENT_UWORD 100 Compu_UEGOH1_off_loVf 0 99.9984741210938 /end CHARACTERISTIC
/begin COMPU_METHOD Compu_UEGOH1_off_loVf " " RAT_FUNC "%.3" "% Vbat" COEFFS 0 655.36 0 0 0 1 /end COMPU_METHOD
/begin CHARACTERISTIC UEGOH2_off_loVf "FaultConfig # UEGOH2_off_loVf (Fault Condition:UEGO2 heater low-side feedback <)" VALUE 0x001650a4 /* @ECU_Address@UEGOH2_off_loVf@0x01008568@ */ ECIPP_ALIGNMENT_UWORD 100 Compu_UEGOH2_off_loVf 0 99.9984741210938 /end CHARACTERISTIC
/begin COMPU_METHOD Compu_UEGOH2_off_loVf " " RAT_FUNC "%.3" "% Vbat" COEFFS 0 655.36 0 0 0 1 /end COMPU_METHOD
/begin CHARACTERISTIC UEGOH1_on_hiVf "FaultConfig # UEGOH1_on_hiVf (Fault Condition:UEGO1 heater low-side feedback >)" VALUE 0x001650a0 /* @ECU_Address@UEGOH1_on_hiVf@0x01008570@ */ ECIPP_ALIGNMENT_UWORD 100 Compu_UEGOH1_on_hiVf 0 99.9984741210938 /end CHARACTERISTIC
/begin COMPU_METHOD Compu_UEGOH1_on_hiVf " " RAT_FUNC "%.3" "% Vbat" COEFFS 0 655.36 0 0 0 1 /end COMPU_METHOD
/begin CHARACTERISTIC UEGOH2_on_hiVf "FaultConfig # UEGOH2_on_hiVf (Fault Condition:UEGO2 heater low-side feedback >)" VALUE 0x001650a8 /* @ECU_Address@UEGOH2_on_hiVf@0x01008578@ */ ECIPP_ALIGNMENT_UWORD 100 Compu_UEGOH2_on_hiVf 0 99.9984741210938 /end CHARACTERISTIC
/begin COMPU_METHOD Compu_UEGOH2_on_hiVf " " RAT_FUNC "%.3" "% Vbat" COEFFS 0 655.36 0 0 0 1 /end COMPU_METHOD
/begin CHARACTERISTIC UEGOH1_off_loDC "FaultConfig # UEGOH1_off_loDC (Fault Condition:and PWM duty-cycle <)" VALUE 0x0016509a /* @ECU_Address@UEGOH1_off_loDC@0x01008580@ */ ECIPP_ALIGNMENT_UWORD 100 Compu_UEGOH1_off_loDC 0 99.9984741210938 /end CHARACTERISTIC
/begin COMPU_METHOD Compu_UEGOH1_off_loDC " " RAT_FUNC "%.3" "%" COEFFS 0 655.36 0 0 0 1 /end COMPU_METHOD
/begin CHARACTERISTIC UEGOH2_off_loDC "FaultConfig # UEGOH2_off_loDC (Fault Condition:and PWM duty-cycle <)" VALUE 0x001650a2 /* @ECU_Address@UEGOH2_off_loDC@0x01008588@ */ ECIPP_ALIGNMENT_UWORD 100 Compu_UEGOH2_off_loDC 0 99.9984741210938 /end CHARACTERISTIC
/begin COMPU_METHOD Compu_UEGOH2_off_loDC " " RAT_FUNC "%.3" "%" COEFFS 0 655.36 0 0 0 1 /end COMPU_METHOD
/begin CHARACTERISTIC UEGOH1_on_hiDC "FaultConfig # UEGOH1_on_hiDC (Fault Condition:and PWM duty-cycle >)" VALUE 0x0016509e /* @ECU_Address@UEGOH1_on_hiDC@0x01008590@ */ ECIPP_ALIGNMENT_UWORD 100 Compu_UEGOH1_on_hiDC 0 99.9984741210938 /end CHARACTERISTIC
/begin COMPU_METHOD Compu_UEGOH1_on_hiDC " " RAT_FUNC "%.3" "%" COEFFS 0 655.36 0 0 0 1 /end COMPU_METHOD
/begin CHARACTERISTIC UEGOH2_on_hiDC "FaultConfig # UEGOH2_on_hiDC (Fault Condition:and PWM duty-cycle >)" VALUE 0x001650a6 /* @ECU_Address@UEGOH2_on_hiDC@0x01008598@ */ ECIPP_ALIGNMENT_UWORD 100 Compu_UEGOH2_on_hiDC 0 99.9984741210938 /end CHARACTERISTIC
/begin COMPU_METHOD Compu_UEGOH2_on_hiDC " " RAT_FUNC "%.3" "%" COEFFS 0 655.36 0 0 0 1 /end COMPU_METHOD
/begin CHARACTERISTIC RELAY_off_hi_Vfb "FaultConfig # RELAY_off_hi_Vfb (Fault Condition:Relay control off with feedback >)" VALUE 0x001476ec /* @ECU_Address@RELAY_off_hi_Vfb@0x010085B0@ */ ECIPP_ALIGNMENT_UWORD 100 Compu_RELAY_off_hi_Vfb 0 99.9984741210938 /end CHARACTERISTIC
/begin COMPU_METHOD Compu_RELAY_off_hi_Vfb " " RAT_FUNC "%.3" "% Vbat" COEFFS 0 655.36 0 0 0 1 /end COMPU_METHOD
/begin CHARACTERISTIC RELAY_on_lo_Vfb "FaultConfig # RELAY_on_lo_Vfb (Fault Condition:Relay control on with feedback <)" VALUE 0x001476f2 /* @ECU_Address@RELAY_on_lo_Vfb@0x010085B8@ */ ECIPP_ALIGNMENT_UWORD 100 Compu_RELAY_on_lo_Vfb 0 99.9984741210938 /end CHARACTERISTIC
/begin COMPU_METHOD Compu_RELAY_on_lo_Vfb " " RAT_FUNC "%.3" "% Vbat" COEFFS 0 655.36 0 0 0 1 /end COMPU_METHOD
/begin CHARACTERISTIC RELAY_powered_inj "{RELAY_powered_inj&0xff=0:No}{RELAY_powered_inj&0xff=1:Yes} (Fault Condition:Injectors relay powered)" VALUE 0x00147ef2 /* @ECU_Address@RELAY_powered_inj@0x010085C0@ */ ECIPP_ALIGNMENT_UBYTE 255 RELAY_powered_inj_COMPU_VTAB 0 255 BIT_MASK 0xff /end CHARACTERISTIC
/begin COMPU_METHOD RELAY_powered_inj_COMPU_VTAB "Verbal Table" TAB_VERB "%.0" "list" COMPU_TAB_REF RELAY_powered_inj_COMPU_VTAB_REF /end COMPU_METHOD
/begin COMPU_VTAB RELAY_powered_inj_COMPU_VTAB_REF "Verbal Table" TAB_VERB 2 0 "No" 1 "Yes" DEFAULT_VALUE "UNKNOWN" /end COMPU_VTAB
/begin CHARACTERISTIC RELAY_powered_coil "{RELAY_powered_coil&0xff=0:No}{RELAY_powered_coil&0xff=1:Yes} (Fault Condition:Ignition coils relay powered)" VALUE 0x00147ef1 /* @ECU_Address@RELAY_powered_coil@0x010085C8@ */ ECIPP_ALIGNMENT_UBYTE 255 RELAY_powered_coil_COMPU_VTAB 0 255 BIT_MASK 0xff /end CHARACTERISTIC
/begin COMPU_METHOD RELAY_powered_coil_COMPU_VTAB "Verbal Table" TAB_VERB "%.0" "list" COMPU_TAB_REF RELAY_powered_coil_COMPU_VTAB_REF /end COMPU_METHOD
/begin COMPU_VTAB RELAY_powered_coil_COMPU_VTAB_REF "Verbal Table" TAB_VERB 2 0 "No" 1 "Yes" DEFAULT_VALUE "UNKNOWN" /end COMPU_VTAB
/begin CHARACTERISTIC TRANS_ratio0 "IOConfig # TRANS_ratio0" VALUE 0x001478FE /* @ECU_Address@TRANS_ratio0@0x01008CE0@ */ ECIPP_ALIGNMENT_UWORD 64 Compu_TRANS_ratio0 0 63.9990234375 /end CHARACTERISTIC
/begin COMPU_METHOD Compu_TRANS_ratio0 " " RAT_FUNC "%.3" "in/out" COEFFS 0 1024 0 0 0 1 /end COMPU_METHOD
/begin CHARACTERISTIC PWM6_short_loDC "FaultConfig # PWM6_short_loDC (Fault Condition:and PWM duty-cycle <)" VALUE 0x00164fde /* @ECU_Address@PWM6_short_loDC@0x01008DB0@ */ ECIPP_ALIGNMENT_UWORD 100 Compu_PWM6_short_loDC 0 99.9984741210938 /end CHARACTERISTIC
/begin COMPU_METHOD Compu_PWM6_short_loDC " " RAT_FUNC "%.3" "%" COEFFS 0 655.36 0 0 0 1 /end COMPU_METHOD
/begin CHARACTERISTIC PWM6_short_mA "FaultConfig # PWM6_short_mA (Fault Condition:OR PWM 6 current feedback >)" VALUE 0x00164fe0 /* @ECU_Address@PWM6_short_mA@0x01008DB8@ */ ECIPP_ALIGNMENT_UWORD 65535 Compu_PWM6_short_mA 0 65535 /end CHARACTERISTIC
/begin COMPU_METHOD Compu_PWM6_short_mA " " RAT_FUNC "%.0" "mA" COEFFS 0 1 0 0 0 1 /end COMPU_METHOD
/begin CHARACTERISTIC PWM10_off_loVf "FaultConfig # PWM10_off_loVf (Fault Condition:PWM 10 low-side feedback <)" VALUE 0x00164f38 /* @ECU_Address@PWM10_off_loVf@0x01008DC0@ */ ECIPP_ALIGNMENT_UWORD 100 Compu_PWM10_off_loVf 0 99.9984741210938 /end CHARACTERISTIC
/begin COMPU_METHOD Compu_PWM10_off_loVf " " RAT_FUNC "%.3" "% Vbat" COEFFS 0 655.36 0 0 0 1 /end COMPU_METHOD
/begin CHARACTERISTIC PWM10_on_hiVf "FaultConfig # PWM10_on_hiVf (Fault Condition:PWM 10 low-side feedback >)" VALUE 0x00164f3c /* @ECU_Address@PWM10_on_hiVf@0x01008DC8@ */ ECIPP_ALIGNMENT_UWORD 100 Compu_PWM10_on_hiVf 0 99.9984741210938 /end CHARACTERISTIC
/begin COMPU_METHOD Compu_PWM10_on_hiVf " " RAT_FUNC "%.3" "% Vbat" COEFFS 0 655.36 0 0 0 1 /end COMPU_METHOD
/begin CHARACTERISTIC PWM10_off_loDC "FaultConfig # PWM10_off_loDC (Fault Condition:and PWM duty-cycle <)" VALUE 0x00164f36 /* @ECU_Address@PWM10_off_loDC@0x01008DD0@ */ ECIPP_ALIGNMENT_UWORD 100 Compu_PWM10_off_loDC 0 99.9984741210938 /end CHARACTERISTIC
/begin COMPU_METHOD Compu_PWM10_off_loDC " " RAT_FUNC "%.3" "%" COEFFS 0 655.36 0 0 0 1 /end COMPU_METHOD
/begin CHARACTERISTIC PWM10_on_hiDC "FaultConfig # PWM10_on_hiDC (Fault Condition:and PWM duty-cycle >)" VALUE 0x00164f3a /* @ECU_Address@PWM10_on_hiDC@0x01008DD8@ */ ECIPP_ALIGNMENT_UWORD 100 Compu_PWM10_on_hiDC 0 99.9984741210938 /end CHARACTERISTIC
/begin COMPU_METHOD Compu_PWM10_on_hiDC " " RAT_FUNC "%.3" "%" COEFFS 0 655.36 0 0 0 1 /end COMPU_METHOD
/begin CHARACTERISTIC PWM11_off_loVf "FaultConfig # PWM11_off_loVf (Fault Condition:PWM 11 low-side feedback <)" VALUE 0x00164f40 /* @ECU_Address@PWM11_off_loVf@0x01008DE0@ */ ECIPP_ALIGNMENT_UWORD 100 Compu_PWM11_off_loVf 0 99.9984741210938 /end CHARACTERISTIC
/begin COMPU_METHOD Compu_PWM11_off_loVf " " RAT_FUNC "%.3" "% Vbat" COEFFS 0 655.36 0 0 0 1 /end COMPU_METHOD
/begin CHARACTERISTIC PWM11_on_hiVf "FaultConfig # PWM11_on_hiVf (Fault Condition:PWM 11 low-side feedback >)" VALUE 0x00164f44 /* @ECU_Address@PWM11_on_hiVf@0x01008DE8@ */ ECIPP_ALIGNMENT_UWORD 100 Compu_PWM11_on_hiVf 0 99.9984741210938 /end CHARACTERISTIC
/begin COMPU_METHOD Compu_PWM11_on_hiVf " " RAT_FUNC "%.3" "% Vbat" COEFFS 0 655.36 0 0 0 1 /end COMPU_METHOD
/begin CHARACTERISTIC PWM11_off_loDC "FaultConfig # PWM11_off_loDC (Fault Condition:and PWM duty-cycle <)" VALUE 0x00164f3e /* @ECU_Address@PWM11_off_loDC@0x01008DF0@ */ ECIPP_ALIGNMENT_UWORD 100 Compu_PWM11_off_loDC 0 99.9984741210938 /end CHARACTERISTIC
/begin COMPU_METHOD Compu_PWM11_off_loDC " " RAT_FUNC "%.3" "%" COEFFS 0 655.36 0 0 0 1 /end COMPU_METHOD
/begin CHARACTERISTIC PWM11_on_hiDC "FaultConfig # PWM11_on_hiDC (Fault Condition:and PWM duty-cycle >)" VALUE 0x00164f42 /* @ECU_Address@PWM11_on_hiDC@0x01008DF8@ */ ECIPP_ALIGNMENT_UWORD 100 Compu_PWM11_on_hiDC 0 99.9984741210938 /end CHARACTERISTIC
/begin COMPU_METHOD Compu_PWM11_on_hiDC " " RAT_FUNC "%.3" "%" COEFFS 0 655.36 0 0 0 1 /end COMPU_METHOD
/begin CHARACTERISTIC PWM12_off_loVf "FaultConfig # PWM12_off_loVf (Fault Condition:PWM 12 low-side feedback <)" VALUE 0x00164f48 /* @ECU_Address@PWM12_off_loVf@0x01008E00@ */ ECIPP_ALIGNMENT_UWORD 100 Compu_PWM12_off_loVf 0 99.9984741210938 /end CHARACTERISTIC
/begin COMPU_METHOD Compu_PWM12_off_loVf " " RAT_FUNC "%.3" "% Vbat" COEFFS 0 655.36 0 0 0 1 /end COMPU_METHOD
/begin CHARACTERISTIC PWM12_on_hiVf "FaultConfig # PWM12_on_hiVf (Fault Condition:PWM 12 low-side feedback >)" VALUE 0x00164f4c /* @ECU_Address@PWM12_on_hiVf@0x01008E08@ */ ECIPP_ALIGNMENT_UWORD 100 Compu_PWM12_on_hiVf 0 99.9984741210938 /end CHARACTERISTIC
/begin COMPU_METHOD Compu_PWM12_on_hiVf " " RAT_FUNC "%.3" "% Vbat" COEFFS 0 655.36 0 0 0 1 /end COMPU_METHOD
/begin CHARACTERISTIC PWM12_off_loDC "FaultConfig # PWM12_off_loDC (Fault Condition:and PWM duty-cycle <)" VALUE 0x00164f46 /* @ECU_Address@PWM12_off_loDC@0x01008E10@ */ ECIPP_ALIGNMENT_UWORD 100 Compu_PWM12_off_loDC 0 99.9984741210938 /end CHARACTERISTIC
/begin COMPU_METHOD Compu_PWM12_off_loDC " " RAT_FUNC "%.3" "%" COEFFS 0 655.36 0 0 0 1 /end COMPU_METHOD
/begin CHARACTERISTIC PWM12_on_hiDC "FaultConfig # PWM12_on_hiDC (Fault Condition:and PWM duty-cycle >)" VALUE 0x00164f4a /* @ECU_Address@PWM12_on_hiDC@0x01008E18@ */ ECIPP_ALIGNMENT_UWORD 100 Compu_PWM12_on_hiDC 0 99.9984741210938 /end CHARACTERISTIC
/begin COMPU_METHOD Compu_PWM12_on_hiDC " " RAT_FUNC "%.3" "%" COEFFS 0 655.36 0 0 0 1 /end COMPU_METHOD
/begin CHARACTERISTIC PWM13_off_loVf "FaultConfig # PWM13_off_loVf (Fault Condition:PWM 13 low-side feedback <)" VALUE 0x00164f50 /* @ECU_Address@PWM13_off_loVf@0x01008E20@ */ ECIPP_ALIGNMENT_UWORD 100 Compu_PWM13_off_loVf 0 99.9984741210938 /end CHARACTERISTIC
/begin COMPU_METHOD Compu_PWM13_off_loVf " " RAT_FUNC "%.3" "% Vbat" COEFFS 0 655.36 0 0 0 1 /end COMPU_METHOD
/begin CHARACTERISTIC PWM13_on_hiVf "FaultConfig # PWM13_on_hiVf (Fault Condition:PWM 13 low-side feedback >)" VALUE 0x00164f54 /* @ECU_Address@PWM13_on_hiVf@0x01008E28@ */ ECIPP_ALIGNMENT_UWORD 100 Compu_PWM13_on_hiVf 0 99.9984741210938 /end CHARACTERISTIC
/begin COMPU_METHOD Compu_PWM13_on_hiVf " " RAT_FUNC "%.3" "% Vbat" COEFFS 0 655.36 0 0 0 1 /end COMPU_METHOD
/begin CHARACTERISTIC PWM13_off_loDC "FaultConfig # PWM13_off_loDC (Fault Condition:and PWM duty-cycle <)" VALUE 0x00164f4e /* @ECU_Address@PWM13_off_loDC@0x01008E30@ */ ECIPP_ALIGNMENT_UWORD 100 Compu_PWM13_off_loDC 0 99.9984741210938 /end CHARACTERISTIC
/begin COMPU_METHOD Compu_PWM13_off_loDC " " RAT_FUNC "%.3" "%" COEFFS 0 655.36 0 0 0 1 /end COMPU_METHOD
/begin CHARACTERISTIC PWM13_on_hiDC "FaultConfig # PWM13_on_hiDC (Fault Condition:and PWM duty-cycle >)" VALUE 0x00164f52 /* @ECU_Address@PWM13_on_hiDC@0x01008E38@ */ ECIPP_ALIGNMENT_UWORD 100 Compu_PWM13_on_hiDC 0 99.9984741210938 /end CHARACTERISTIC
/begin COMPU_METHOD Compu_PWM13_on_hiDC " " RAT_FUNC "%.3" "%" COEFFS 0 655.36 0 0 0 1 /end COMPU_METHOD
/begin CHARACTERISTIC PWM14_off_loVf "FaultConfig # PWM14_off_loVf (Fault Condition:PWM 14 low-side feedback <)" VALUE 0x00164f58 /* @ECU_Address@PWM14_off_loVf@0x01008E40@ */ ECIPP_ALIGNMENT_UWORD 100 Compu_PWM14_off_loVf 0 99.9984741210938 /end CHARACTERISTIC
/begin COMPU_METHOD Compu_PWM14_off_loVf " " RAT_FUNC "%.3" "% Vbat" COEFFS 0 655.36 0 0 0 1 /end COMPU_METHOD
/begin CHARACTERISTIC PWM14_on_hiVf "FaultConfig # PWM14_on_hiVf (Fault Condition:PWM 14 low-side feedback >)" VALUE 0x00164f5c /* @ECU_Address@PWM14_on_hiVf@0x01008E48@ */ ECIPP_ALIGNMENT_UWORD 100 Compu_PWM14_on_hiVf 0 99.9984741210938 /end CHARACTERISTIC
/begin COMPU_METHOD Compu_PWM14_on_hiVf " " RAT_FUNC "%.3" "% Vbat" COEFFS 0 655.36 0 0 0 1 /end COMPU_METHOD
/begin CHARACTERISTIC PWM14_off_loDC "FaultConfig # PWM14_off_loDC (Fault Condition:and PWM duty-cycle <)" VALUE 0x00164f56 /* @ECU_Address@PWM14_off_loDC@0x01008E50@ */ ECIPP_ALIGNMENT_UWORD 100 Compu_PWM14_off_loDC 0 99.9984741210938 /end CHARACTERISTIC
/begin COMPU_METHOD Compu_PWM14_off_loDC " " RAT_FUNC "%.3" "%" COEFFS 0 655.36 0 0 0 1 /end COMPU_METHOD
/begin CHARACTERISTIC PWM14_on_hiDC "FaultConfig # PWM14_on_hiDC (Fault Condition:and PWM duty-cycle >)" VALUE 0x00164f5a /* @ECU_Address@PWM14_on_hiDC@0x01008E58@ */ ECIPP_ALIGNMENT_UWORD 100 Compu_PWM14_on_hiDC 0 99.9984741210938 /end CHARACTERISTIC
/begin COMPU_METHOD Compu_PWM14_on_hiDC " " RAT_FUNC "%.3" "%" COEFFS 0 655.36 0 0 0 1 /end COMPU_METHOD
/begin CHARACTERISTIC PWM15_off_loVf "FaultConfig # PWM15_off_loVf (Fault Condition:PWM 15 low-side feedback <)" VALUE 0x00164f60 /* @ECU_Address@PWM15_off_loVf@0x01008E60@ */ ECIPP_ALIGNMENT_UWORD 100 Compu_PWM15_off_loVf 0 99.9984741210938 /end CHARACTERISTIC
/begin COMPU_METHOD Compu_PWM15_off_loVf " " RAT_FUNC "%.3" "% Vbat" COEFFS 0 655.36 0 0 0 1 /end COMPU_METHOD
/begin CHARACTERISTIC PWM15_on_hiVf "FaultConfig # PWM15_on_hiVf (Fault Condition:PWM 15 low-side feedback >)" VALUE 0x00164f64 /* @ECU_Address@PWM15_on_hiVf@0x01008E68@ */ ECIPP_ALIGNMENT_UWORD 100 Compu_PWM15_on_hiVf 0 99.9984741210938 /end CHARACTERISTIC
/begin COMPU_METHOD Compu_PWM15_on_hiVf " " RAT_FUNC "%.3" "% Vbat" COEFFS 0 655.36 0 0 0 1 /end COMPU_METHOD
/begin CHARACTERISTIC PWM15_off_loDC "FaultConfig # PWM15_off_loDC (Fault Condition:and PWM duty-cycle <)" VALUE 0x00164f5e /* @ECU_Address@PWM15_off_loDC@0x01008E70@ */ ECIPP_ALIGNMENT_UWORD 100 Compu_PWM15_off_loDC 0 99.9984741210938 /end CHARACTERISTIC
/begin COMPU_METHOD Compu_PWM15_off_loDC " " RAT_FUNC "%.3" "%" COEFFS 0 655.36 0 0 0 1 /end COMPU_METHOD
/begin CHARACTERISTIC PWM15_on_hiDC "FaultConfig # PWM15_on_hiDC (Fault Condition:and PWM duty-cycle >)" VALUE 0x00164f62 /* @ECU_Address@PWM15_on_hiDC@0x01008E78@ */ ECIPP_ALIGNMENT_UWORD 100 Compu_PWM15_on_hiDC 0 99.9984741210938 /end CHARACTERISTIC
/begin COMPU_METHOD Compu_PWM15_on_hiDC " " RAT_FUNC "%.3" "%" COEFFS 0 655.36 0 0 0 1 /end COMPU_METHOD
/begin CHARACTERISTIC PWM16_off_loVf "FaultConfig # PWM16_off_loVf (Fault Condition:PWM 16 low-side feedback <)" VALUE 0x00164f68 /* @ECU_Address@PWM16_off_loVf@0x01008E80@ */ ECIPP_ALIGNMENT_UWORD 100 Compu_PWM16_off_loVf 0 99.9984741210938 /end CHARACTERISTIC
/begin COMPU_METHOD Compu_PWM16_off_loVf " " RAT_FUNC "%.3" "% Vbat" COEFFS 0 655.36 0 0 0 1 /end COMPU_METHOD
/begin CHARACTERISTIC PWM16_on_hiVf "FaultConfig # PWM16_on_hiVf (Fault Condition:PWM 16 low-side feedback >)" VALUE 0x00164f6c /* @ECU_Address@PWM16_on_hiVf@0x01008E88@ */ ECIPP_ALIGNMENT_UWORD 100 Compu_PWM16_on_hiVf 0 99.9984741210938 /end CHARACTERISTIC
/begin COMPU_METHOD Compu_PWM16_on_hiVf " " RAT_FUNC "%.3" "% Vbat" COEFFS 0 655.36 0 0 0 1 /end COMPU_METHOD
/begin CHARACTERISTIC PWM16_off_loDC "FaultConfig # PWM16_off_loDC (Fault Condition:and PWM duty-cycle <)" VALUE 0x00164f66 /* @ECU_Address@PWM16_off_loDC@0x01008E90@ */ ECIPP_ALIGNMENT_UWORD 100 Compu_PWM16_off_loDC 0 99.9984741210938 /end CHARACTERISTIC
/begin COMPU_METHOD Compu_PWM16_off_loDC " " RAT_FUNC "%.3" "%" COEFFS 0 655.36 0 0 0 1 /end COMPU_METHOD
/begin CHARACTERISTIC PWM16_on_hiDC "FaultConfig # PWM16_on_hiDC (Fault Condition:and PWM duty-cycle >)" VALUE 0x00164f6a /* @ECU_Address@PWM16_on_hiDC@0x01008E98@ */ ECIPP_ALIGNMENT_UWORD 100 Compu_PWM16_on_hiDC 0 99.9984741210938 /end CHARACTERISTIC
/begin COMPU_METHOD Compu_PWM16_on_hiDC " " RAT_FUNC "%.3" "%" COEFFS 0 655.36 0 0 0 1 /end COMPU_METHOD
/begin CHARACTERISTIC PWM17_off_loVf "FaultConfig # PWM17_off_loVf (Fault Condition:PWM 17 low-side feedback <)" VALUE 0x00164f70 /* @ECU_Address@PWM17_off_loVf@0x01008EA0@ */ ECIPP_ALIGNMENT_UWORD 100 Compu_PWM17_off_loVf 0 99.9984741210938 /end CHARACTERISTIC
/begin COMPU_METHOD Compu_PWM17_off_loVf " " RAT_FUNC "%.3" "% Vbat" COEFFS 0 655.36 0 0 0 1 /end COMPU_METHOD
/begin CHARACTERISTIC PWM17_on_hiVf "FaultConfig # PWM17_on_hiVf (Fault Condition:PWM 17 low-side feedback >)" VALUE 0x00164f74 /* @ECU_Address@PWM17_on_hiVf@0x01008EA8@ */ ECIPP_ALIGNMENT_UWORD 100 Compu_PWM17_on_hiVf 0 99.9984741210938 /end CHARACTERISTIC
/begin COMPU_METHOD Compu_PWM17_on_hiVf " " RAT_FUNC "%.3" "% Vbat" COEFFS 0 655.36 0 0 0 1 /end COMPU_METHOD
/begin CHARACTERISTIC PWM17_off_loDC "FaultConfig # PWM17_off_loDC (Fault Condition:and PWM duty-cycle <)" VALUE 0x00164f6e /* @ECU_Address@PWM17_off_loDC@0x01008EB0@ */ ECIPP_ALIGNMENT_UWORD 100 Compu_PWM17_off_loDC 0 99.9984741210938 /end CHARACTERISTIC
/begin COMPU_METHOD Compu_PWM17_off_loDC " " RAT_FUNC "%.3" "%" COEFFS 0 655.36 0 0 0 1 /end COMPU_METHOD
/begin CHARACTERISTIC PWM17_on_hiDC "FaultConfig # PWM17_on_hiDC (Fault Condition:and PWM duty-cycle >)" VALUE 0x00164f72 /* @ECU_Address@PWM17_on_hiDC@0x01008EB8@ */ ECIPP_ALIGNMENT_UWORD 100 Compu_PWM17_on_hiDC 0 99.9984741210938 /end CHARACTERISTIC
/begin COMPU_METHOD Compu_PWM17_on_hiDC " " RAT_FUNC "%.3" "%" COEFFS 0 655.36 0 0 0 1 /end COMPU_METHOD
/begin CHARACTERISTIC PWM18_off_loVf "FaultConfig # PWM18_off_loVf (Fault Condition:PWM 18 low-side feedback <)" VALUE 0x00164f78 /* @ECU_Address@PWM18_off_loVf@0x01008EC0@ */ ECIPP_ALIGNMENT_UWORD 100 Compu_PWM18_off_loVf 0 99.9984741210938 /end CHARACTERISTIC
/begin COMPU_METHOD Compu_PWM18_off_loVf " " RAT_FUNC "%.3" "% Vbat" COEFFS 0 655.36 0 0 0 1 /end COMPU_METHOD
/begin CHARACTERISTIC PWM18_on_hiVf "FaultConfig # PWM18_on_hiVf (Fault Condition:PWM 18 low-side feedback >)" VALUE 0x00164f7c /* @ECU_Address@PWM18_on_hiVf@0x01008EC8@ */ ECIPP_ALIGNMENT_UWORD 100 Compu_PWM18_on_hiVf 0 99.9984741210938 /end CHARACTERISTIC
/begin COMPU_METHOD Compu_PWM18_on_hiVf " " RAT_FUNC "%.3" "% Vbat" COEFFS 0 655.36 0 0 0 1 /end COMPU_METHOD
/begin CHARACTERISTIC PWM18_off_loDC "FaultConfig # PWM18_off_loDC (Fault Condition:and PWM duty-cycle <)" VALUE 0x00164f76 /* @ECU_Address@PWM18_off_loDC@0x01008ED0@ */ ECIPP_ALIGNMENT_UWORD 100 Compu_PWM18_off_loDC 0 99.9984741210938 /end CHARACTERISTIC
/begin COMPU_METHOD Compu_PWM18_off_loDC " " RAT_FUNC "%.3" "%" COEFFS 0 655.36 0 0 0 1 /end COMPU_METHOD
/begin CHARACTERISTIC PWM18_on_hiDC "FaultConfig # PWM18_on_hiDC (Fault Condition:and PWM duty-cycle >)" VALUE 0x00164f7a /* @ECU_Address@PWM18_on_hiDC@0x01008ED8@ */ ECIPP_ALIGNMENT_UWORD 100 Compu_PWM18_on_hiDC 0 99.9984741210938 /end CHARACTERISTIC
/begin COMPU_METHOD Compu_PWM18_on_hiDC " " RAT_FUNC "%.3" "%" COEFFS 0 655.36 0 0 0 1 /end COMPU_METHOD
/begin CHARACTERISTIC PWM19_off_loVf "FaultConfig # PWM19_off_loVf (Fault Condition:PWM 19 low-side feedback <)" VALUE 0x00164f80 /* @ECU_Address@PWM19_off_loVf@0x01008EE0@ */ ECIPP_ALIGNMENT_UWORD 100 Compu_PWM19_off_loVf 0 99.9984741210938 /end CHARACTERISTIC
/begin COMPU_METHOD Compu_PWM19_off_loVf " " RAT_FUNC "%.3" "% Vbat" COEFFS 0 655.36 0 0 0 1 /end COMPU_METHOD
/begin CHARACTERISTIC PWM19_on_hiVf "FaultConfig # PWM19_on_hiVf (Fault Condition:PWM 19 low-side feedback >)" VALUE 0x00164f84 /* @ECU_Address@PWM19_on_hiVf@0x01008EE8@ */ ECIPP_ALIGNMENT_UWORD 100 Compu_PWM19_on_hiVf 0 99.9984741210938 /end CHARACTERISTIC
/begin COMPU_METHOD Compu_PWM19_on_hiVf " " RAT_FUNC "%.3" "% Vbat" COEFFS 0 655.36 0 0 0 1 /end COMPU_METHOD
/begin CHARACTERISTIC PWM19_off_loDC "FaultConfig # PWM19_off_loDC (Fault Condition:and PWM duty-cycle <)" VALUE 0x00164f7e /* @ECU_Address@PWM19_off_loDC@0x01008EF0@ */ ECIPP_ALIGNMENT_UWORD 100 Compu_PWM19_off_loDC 0 99.9984741210938 /end CHARACTERISTIC
/begin COMPU_METHOD Compu_PWM19_off_loDC " " RAT_FUNC "%.3" "%" COEFFS 0 655.36 0 0 0 1 /end COMPU_METHOD
/begin CHARACTERISTIC PWM19_on_hiDC "FaultConfig # PWM19_on_hiDC (Fault Condition:and PWM duty-cycle >)" VALUE 0x00164f82 /* @ECU_Address@PWM19_on_hiDC@0x01008EF8@ */ ECIPP_ALIGNMENT_UWORD 100 Compu_PWM19_on_hiDC 0 99.9984741210938 /end CHARACTERISTIC
/begin COMPU_METHOD Compu_PWM19_on_hiDC " " RAT_FUNC "%.3" "%" COEFFS 0 655.36 0 0 0 1 /end COMPU_METHOD
/begin CHARACTERISTIC PWM20_off_loVf "FaultConfig # PWM20_off_loVf (Fault Condition:PWM 20 low-side feedback <)" VALUE 0x00164f94 /* @ECU_Address@PWM20_off_loVf@0x01008F00@ */ ECIPP_ALIGNMENT_UWORD 100 Compu_PWM20_off_loVf 0 99.9984741210938 /end CHARACTERISTIC
/begin COMPU_METHOD Compu_PWM20_off_loVf " " RAT_FUNC "%.3" "% Vbat" COEFFS 0 655.36 0 0 0 1 /end COMPU_METHOD
/begin CHARACTERISTIC PWM20_on_hiVf "FaultConfig # PWM20_on_hiVf (Fault Condition:PWM 20 low-side feedback >)" VALUE 0x00164f98 /* @ECU_Address@PWM20_on_hiVf@0x01008F08@ */ ECIPP_ALIGNMENT_UWORD 100 Compu_PWM20_on_hiVf 0 99.9984741210938 /end CHARACTERISTIC
/begin COMPU_METHOD Compu_PWM20_on_hiVf " " RAT_FUNC "%.3" "% Vbat" COEFFS 0 655.36 0 0 0 1 /end COMPU_METHOD
/begin CHARACTERISTIC PWM20_off_loDC "FaultConfig # PWM20_off_loDC (Fault Condition:and PWM duty-cycle <)" VALUE 0x00164f92 /* @ECU_Address@PWM20_off_loDC@0x01008F10@ */ ECIPP_ALIGNMENT_UWORD 100 Compu_PWM20_off_loDC 0 99.9984741210938 /end CHARACTERISTIC
/begin COMPU_METHOD Compu_PWM20_off_loDC " " RAT_FUNC "%.3" "%" COEFFS 0 655.36 0 0 0 1 /end COMPU_METHOD
/begin CHARACTERISTIC PWM20_on_hiDC "FaultConfig # PWM20_on_hiDC (Fault Condition:and PWM duty-cycle >)" VALUE 0x00164f96 /* @ECU_Address@PWM20_on_hiDC@0x01008F18@ */ ECIPP_ALIGNMENT_UWORD 100 Compu_PWM20_on_hiDC 0 99.9984741210938 /end CHARACTERISTIC
/begin COMPU_METHOD Compu_PWM20_on_hiDC " " RAT_FUNC "%.3" "%" COEFFS 0 655.36 0 0 0 1 /end COMPU_METHOD
/begin CHARACTERISTIC PWM21_off_loVf "FaultConfig # PWM21_off_loVf (Fault Condition:PWM 21 low-side feedback <)" VALUE 0x00164f9c /* @ECU_Address@PWM21_off_loVf@0x01008F20@ */ ECIPP_ALIGNMENT_UWORD 100 Compu_PWM21_off_loVf 0 99.9984741210938 /end CHARACTERISTIC
/begin COMPU_METHOD Compu_PWM21_off_loVf " " RAT_FUNC "%.3" "% Vbat" COEFFS 0 655.36 0 0 0 1 /end COMPU_METHOD
/begin CHARACTERISTIC PWM21_on_hiVf "FaultConfig # PWM21_on_hiVf (Fault Condition:PWM 21 low-side feedback >)" VALUE 0x00164fa0 /* @ECU_Address@PWM21_on_hiVf@0x01008F28@ */ ECIPP_ALIGNMENT_UWORD 100 Compu_PWM21_on_hiVf 0 99.9984741210938 /end CHARACTERISTIC
/begin COMPU_METHOD Compu_PWM21_on_hiVf " " RAT_FUNC "%.3" "% Vbat" COEFFS 0 655.36 0 0 0 1 /end COMPU_METHOD
/begin CHARACTERISTIC PWM21_off_loDC "FaultConfig # PWM21_off_loDC (Fault Condition:and PWM duty-cycle <)" VALUE 0x00164f9a /* @ECU_Address@PWM21_off_loDC@0x01008F30@ */ ECIPP_ALIGNMENT_UWORD 100 Compu_PWM21_off_loDC 0 99.9984741210938 /end CHARACTERISTIC
/begin COMPU_METHOD Compu_PWM21_off_loDC " " RAT_FUNC "%.3" "%" COEFFS 0 655.36 0 0 0 1 /end COMPU_METHOD
/begin CHARACTERISTIC PWM21_on_hiDC "FaultConfig # PWM21_on_hiDC (Fault Condition:and PWM duty-cycle >)" VALUE 0x00164f9e /* @ECU_Address@PWM21_on_hiDC@0x01008F38@ */ ECIPP_ALIGNMENT_UWORD 100 Compu_PWM21_on_hiDC 0 99.9984741210938 /end CHARACTERISTIC
/begin COMPU_METHOD Compu_PWM21_on_hiDC " " RAT_FUNC "%.3" "%" COEFFS 0 655.36 0 0 0 1 /end COMPU_METHOD
/begin CHARACTERISTIC PWM22_off_loVf "FaultConfig # PWM22_off_loVf (Fault Condition:PWM 22 low-side feedback <)" VALUE 0x00164fa4 /* @ECU_Address@PWM22_off_loVf@0x01008F40@ */ ECIPP_ALIGNMENT_UWORD 100 Compu_PWM22_off_loVf 0 99.9984741210938 /end CHARACTERISTIC
/begin COMPU_METHOD Compu_PWM22_off_loVf " " RAT_FUNC "%.3" "% Vbat" COEFFS 0 655.36 0 0 0 1 /end COMPU_METHOD
/begin CHARACTERISTIC PWM22_on_hiVf "FaultConfig # PWM22_on_hiVf (Fault Condition:PWM 22 low-side feedback >)" VALUE 0x00164fa8 /* @ECU_Address@PWM22_on_hiVf@0x01008F48@ */ ECIPP_ALIGNMENT_UWORD 100 Compu_PWM22_on_hiVf 0 99.9984741210938 /end CHARACTERISTIC
/begin COMPU_METHOD Compu_PWM22_on_hiVf " " RAT_FUNC "%.3" "% Vbat" COEFFS 0 655.36 0 0 0 1 /end COMPU_METHOD
/begin CHARACTERISTIC PWM22_off_loDC "FaultConfig # PWM22_off_loDC (Fault Condition:and PWM duty-cycle <)" VALUE 0x00164fa2 /* @ECU_Address@PWM22_off_loDC@0x01008F50@ */ ECIPP_ALIGNMENT_UWORD 100 Compu_PWM22_off_loDC 0 99.9984741210938 /end CHARACTERISTIC
/begin COMPU_METHOD Compu_PWM22_off_loDC " " RAT_FUNC "%.3" "%" COEFFS 0 655.36 0 0 0 1 /end COMPU_METHOD
/begin CHARACTERISTIC PWM22_on_hiDC "FaultConfig # PWM22_on_hiDC (Fault Condition:and PWM duty-cycle >)" VALUE 0x00164fa6 /* @ECU_Address@PWM22_on_hiDC@0x01008F58@ */ ECIPP_ALIGNMENT_UWORD 100 Compu_PWM22_on_hiDC 0 99.9984741210938 /end CHARACTERISTIC
/begin COMPU_METHOD Compu_PWM22_on_hiDC " " RAT_FUNC "%.3" "%" COEFFS 0 655.36 0 0 0 1 /end COMPU_METHOD
/begin CHARACTERISTIC PWM23_off_loVf "FaultConfig # PWM23_off_loVf (Fault Condition:PWM 23 low-side feedback <)" VALUE 0x00164fac /* @ECU_Address@PWM23_off_loVf@0x01008F60@ */ ECIPP_ALIGNMENT_UWORD 100 Compu_PWM23_off_loVf 0 99.9984741210938 /end CHARACTERISTIC
/begin COMPU_METHOD Compu_PWM23_off_loVf " " RAT_FUNC "%.3" "% Vbat" COEFFS 0 655.36 0 0 0 1 /end COMPU_METHOD
/begin CHARACTERISTIC PWM23_on_hiVf "FaultConfig # PWM23_on_hiVf (Fault Condition:PWM 23 low-side feedback >)" VALUE 0x00164fb0 /* @ECU_Address@PWM23_on_hiVf@0x01008F68@ */ ECIPP_ALIGNMENT_UWORD 100 Compu_PWM23_on_hiVf 0 99.9984741210938 /end CHARACTERISTIC
/begin COMPU_METHOD Compu_PWM23_on_hiVf " " RAT_FUNC "%.3" "% Vbat" COEFFS 0 655.36 0 0 0 1 /end COMPU_METHOD
/begin CHARACTERISTIC PWM23_off_loDC "FaultConfig # PWM23_off_loDC (Fault Condition:and PWM duty-cycle <)" VALUE 0x00164faa /* @ECU_Address@PWM23_off_loDC@0x01008F70@ */ ECIPP_ALIGNMENT_UWORD 100 Compu_PWM23_off_loDC 0 99.9984741210938 /end CHARACTERISTIC
/begin COMPU_METHOD Compu_PWM23_off_loDC " " RAT_FUNC "%.3" "%" COEFFS 0 655.36 0 0 0 1 /end COMPU_METHOD
/begin CHARACTERISTIC PWM23_on_hiDC "FaultConfig # PWM23_on_hiDC (Fault Condition:and PWM duty-cycle >)" VALUE 0x00164fae /* @ECU_Address@PWM23_on_hiDC@0x01008F78@ */ ECIPP_ALIGNMENT_UWORD 100 Compu_PWM23_on_hiDC 0 99.9984741210938 /end CHARACTERISTIC
/begin COMPU_METHOD Compu_PWM23_on_hiDC " " RAT_FUNC "%.3" "%" COEFFS 0 655.36 0 0 0 1 /end COMPU_METHOD
/begin CHARACTERISTIC PW_zero_I2 "General # PW_zero_I2" VALUE 0x00149088 /* @ECU_Address@PW_zero_I2@0x01009150@ */ ECIPP_ALIGNMENT_UWORD 210 Compu_PW_zero_I2 0 209.712 /end CHARACTERISTIC
/begin COMPU_METHOD Compu_PW_zero_I2 " " RAT_FUNC "%.3" "ms" COEFFS 0 312.5 0 0 0 1 /end COMPU_METHOD
/begin CHARACTERISTIC PW_min_extra_I2 "General # PW_min_extra_I2" VALUE 0x0014908A /* @ECU_Address@PW_min_extra_I2@0x01009158@ */ ECIPP_ALIGNMENT_UWORD 210 Compu_PW_min_extra_I2 0 209.712 /end CHARACTERISTIC
/begin COMPU_METHOD Compu_PW_min_extra_I2 " " RAT_FUNC "%.3" "ms" COEFFS 0 312.5 0 0 0 1 /end COMPU_METHOD
/begin CHARACTERISTIC inj_off_min_I2 "General # inj_off_min_I2" VALUE 0x0014908C /* @ECU_Address@inj_off_min_I2@0x01009160@ */ ECIPP_ALIGNMENT_UWORD 210 Compu_inj_off_min_I2 0 209.712 /end CHARACTERISTIC
/begin COMPU_METHOD Compu_inj_off_min_I2 " " RAT_FUNC "%.3" "ms" COEFFS 0 312.5 0 0 0 1 /end COMPU_METHOD
/begin CHARACTERISTIC PWPCF_I2 "General # PWPCF_I2" VALUE 0x00149090 /* @ECU_Address@PWPCF_I2@0x01009170@ */ ECIPP_ALIGNMENT_SWORD 0 Compu_PWPCF_I2 -0.1024 0.102396875 /end CHARACTERISTIC
/begin COMPU_METHOD Compu_PWPCF_I2 " " RAT_FUNC "%.3" "ms/psi" COEFFS 0 320000 0 0 0 1 /end COMPU_METHOD
/begin CHARACTERISTIC fuel_MAP_crct_ena_I2 "{fuel_MAP_crct_ena_I2&0xff=0:Off}{fuel_MAP_crct_ena_I2&0xff=1:On}" VALUE 0x0014909E /* @ECU_Address@fuel_MAP_crct_ena_I2@0x01009178@ */ ECIPP_ALIGNMENT_UBYTE 255 fuel_MAP_crct_ena_I2_COMPU_VTAB 0 255 BIT_MASK 0xff /end CHARACTERISTIC
/begin COMPU_METHOD fuel_MAP_crct_ena_I2_COMPU_VTAB "Verbal Table" TAB_VERB "%.0" "list" COMPU_TAB_REF fuel_MAP_crct_ena_I2_COMPU_VTAB_REF /end COMPU_METHOD
/begin COMPU_VTAB fuel_MAP_crct_ena_I2_COMPU_VTAB_REF "Verbal Table" TAB_VERB 2 0 "Off" 1 "On" DEFAULT_VALUE "UNKNOWN" /end COMPU_VTAB
/begin CHARACTERISTIC FPout_loc_I2 "{FPout_loc_I2&0xff=0:MAP}{FPout_loc_I2&0xff=1:TIP}" VALUE 0x0014909F /* @ECU_Address@FPout_loc_I2@0x01009180@ */ ECIPP_ALIGNMENT_UBYTE 255 FPout_loc_I2_COMPU_VTAB 0 255 BIT_MASK 0xff /end CHARACTERISTIC
/begin COMPU_METHOD FPout_loc_I2_COMPU_VTAB "Verbal Table" TAB_VERB "%.0" "list" COMPU_TAB_REF FPout_loc_I2_COMPU_VTAB_REF /end COMPU_METHOD
/begin COMPU_VTAB FPout_loc_I2_COMPU_VTAB_REF "Verbal Table" TAB_VERB 2 0 "MAP" 1 "TIP" DEFAULT_VALUE "UNKNOWN" /end COMPU_VTAB
/begin CHARACTERISTIC fuel_FP_crct_ena_I2 "{fuel_FP_crct_ena_I2&0xff=0:Off}{fuel_FP_crct_ena_I2&0xff=1:On}" VALUE 0x001490A0 /* @ECU_Address@fuel_FP_crct_ena_I2@0x01009188@ */ ECIPP_ALIGNMENT_UBYTE 255 fuel_FP_crct_ena_I2_COMPU_VTAB 0 255 BIT_MASK 0xff /end CHARACTERISTIC
/begin COMPU_METHOD fuel_FP_crct_ena_I2_COMPU_VTAB "Verbal Table" TAB_VERB "%.0" "list" COMPU_TAB_REF fuel_FP_crct_ena_I2_COMPU_VTAB_REF /end COMPU_METHOD
/begin COMPU_VTAB fuel_FP_crct_ena_I2_COMPU_VTAB_REF "Verbal Table" TAB_VERB 2 0 "Off" 1 "On" DEFAULT_VALUE "UNKNOWN" /end COMPU_VTAB
/begin CHARACTERISTIC fuel_FT_crct_ena_I2 "{fuel_FT_crct_ena_I2&0xff=0:Off}{fuel_FT_crct_ena_I2&0xff=1:On}" VALUE 0x001490A1 /* @ECU_Address@fuel_FT_crct_ena_I2@0x01009190@ */ ECIPP_ALIGNMENT_UBYTE 255 fuel_FT_crct_ena_I2_COMPU_VTAB 0 255 BIT_MASK 0xff /end CHARACTERISTIC
/begin COMPU_METHOD fuel_FT_crct_ena_I2_COMPU_VTAB "Verbal Table" TAB_VERB "%.0" "list" COMPU_TAB_REF fuel_FT_crct_ena_I2_COMPU_VTAB_REF /end COMPU_METHOD
/begin COMPU_VTAB fuel_FT_crct_ena_I2_COMPU_VTAB_REF "Verbal Table" TAB_VERB 2 0 "Off" 1 "On" DEFAULT_VALUE "UNKNOWN" /end COMPU_VTAB
/begin CHARACTERISTIC FP_maxv_I2 "FaultConfig # FP_maxv_I2 (Fault Condition:Secondary FP voltage >)" VALUE 0x0014907C /* @ECU_Address@FP_maxv_I2@0x010091B8@ */ ECIPP_ALIGNMENT_UWORD 5 Compu_FP_maxv_I2 0 5.00114468864469 /end CHARACTERISTIC
/begin COMPU_METHOD Compu_FP_maxv_I2 " " RAT_FUNC "%.3" "volts" COEFFS 0 13104 0 0 0 1 /end COMPU_METHOD
/begin CHARACTERISTIC FP_minv_I2 "FaultConfig # FP_minv_I2 (Fault Condition:Secondary FP voltage <)" VALUE 0x0014907E /* @ECU_Address@FP_minv_I2@0x010091C0@ */ ECIPP_ALIGNMENT_UWORD 5 Compu_FP_minv_I2 0 5.00114468864469 /end CHARACTERISTIC
/begin COMPU_METHOD Compu_FP_minv_I2 " " RAT_FUNC "%.3" "volts" COEFFS 0 13104 0 0 0 1 /end COMPU_METHOD
/begin CHARACTERISTIC FP_low_I2 "FaultConfig # FP_low_I2 (Fault Condition:Secondary fuel pressure <)" VALUE 0x00149078 /* @ECU_Address@FP_low_I2@0x010091C8@ */ ECIPP_ALIGNMENT_UWORD 256 Compu_FP_low_I2 0 255.99609375 /end CHARACTERISTIC
/begin COMPU_METHOD Compu_FP_low_I2 " " RAT_FUNC "%.3" "psia" COEFFS 0 256 0 0 0 1 /end COMPU_METHOD
/begin CHARACTERISTIC FP_high_I2 "FaultConfig # FP_high_I2 (Fault Condition:Secondary fuel pressure >)" VALUE 0x0014907A /* @ECU_Address@FP_high_I2@0x010091D0@ */ ECIPP_ALIGNMENT_UWORD 256 Compu_FP_high_I2 0 255.99609375 /end CHARACTERISTIC
/begin COMPU_METHOD Compu_FP_high_I2 " " RAT_FUNC "%.3" "psia" COEFFS 0 256 0 0 0 1 /end COMPU_METHOD
/begin CHARACTERISTIC FP_highlow_wait_I2 "FaultConfig # FP_highlow_wait_I2 (Fault Condition:run time wait for fuel pressure high/low faults:)" VALUE 0x00149074 /* @ECU_Address@FP_highlow_wait_I2@0x010091D8@ */ ECIPP_ALIGNMENT_ULONG 4294967 Compu_FP_highlow_wait_I2 0 4294967.295 /end CHARACTERISTIC
/begin COMPU_METHOD Compu_FP_highlow_wait_I2 " " RAT_FUNC "%.3" "seconds" COEFFS 0 1000 0 0 0 1 /end COMPU_METHOD
/begin CHARACTERISTIC FP_fault_mode_I2 "{FP_fault_mode_I2&0xff=0:Gasoline + Gaseous}{FP_fault_mode_I2&0xff=1:Gasoline only}{FP_fault_mode_I2&0xff=2:Gaseous only} (Fault Condition:Secondary FP fault mode)" VALUE 0x0014909A /* @ECU_Address@FP_fault_mode_I2@0x010091E0@ */ ECIPP_ALIGNMENT_UBYTE 255 FP_fault_mode_I2_COMPU_VTAB 0 255 BIT_MASK 0xff /end CHARACTERISTIC
/begin COMPU_METHOD FP_fault_mode_I2_COMPU_VTAB "Verbal Table" TAB_VERB "%.0" "list" COMPU_TAB_REF FP_fault_mode_I2_COMPU_VTAB_REF /end COMPU_METHOD
/begin COMPU_VTAB FP_fault_mode_I2_COMPU_VTAB_REF "Verbal Table" TAB_VERB 3 0 "Gasoline + Gaseous" 1 "Gasoline only" 2 "Gaseous only" DEFAULT_VALUE "UNKNOWN" /end COMPU_VTAB
/begin CHARACTERISTIC fuel_device_LP "{fuel_device_LP&0xff=0:Carburetion}{fuel_device_LP&0xff=1:Pulse Injection - Pri}{fuel_device_LP&0xff=2:Pulse Injection - Sec}{fuel_device_LP&0xff=3:Continuous Injection}{fuel_device_LP&0xff=4:MFG Injection}" VALUE 0x00148177 /* @ECU_Address@fuel_device_LP@0x01009210@ */ ECIPP_ALIGNMENT_UBYTE 255 fuel_device_LP_COMPU_VTAB 0 255 BIT_MASK 0xff /end CHARACTERISTIC
/begin COMPU_METHOD fuel_device_LP_COMPU_VTAB "Verbal Table" TAB_VERB "%.0" "list" COMPU_TAB_REF fuel_device_LP_COMPU_VTAB_REF /end COMPU_METHOD
/begin COMPU_VTAB fuel_device_LP_COMPU_VTAB_REF "Verbal Table" TAB_VERB 5 0 "Carburetion" 1 "Pulse Injection - Pri" 2 "Pulse Injection - Sec" 3 "Continuous Injection" 4 "MFG Injection" DEFAULT_VALUE "UNKNOWN" /end COMPU_VTAB
/begin CHARACTERISTIC fuel_device_NG "{fuel_device_NG&0xff=0:Carburetion}{fuel_device_NG&0xff=1:Pulse Injection - Pri}{fuel_device_NG&0xff=2:Pulse Injection - Sec}{fuel_device_NG&0xff=3:Continuous Injection}{fuel_device_NG&0xff=4:MFG Injection}" VALUE 0x00148178 /* @ECU_Address@fuel_device_NG@0x01009218@ */ ECIPP_ALIGNMENT_UBYTE 255 fuel_device_NG_COMPU_VTAB 0 255 BIT_MASK 0xff /end CHARACTERISTIC
/begin COMPU_METHOD fuel_device_NG_COMPU_VTAB "Verbal Table" TAB_VERB "%.0" "list" COMPU_TAB_REF fuel_device_NG_COMPU_VTAB_REF /end COMPU_METHOD
/begin COMPU_VTAB fuel_device_NG_COMPU_VTAB_REF "Verbal Table" TAB_VERB 5 0 "Carburetion" 1 "Pulse Injection - Pri" 2 "Pulse Injection - Sec" 3 "Continuous Injection" 4 "MFG Injection" DEFAULT_VALUE "UNKNOWN" /end COMPU_VTAB
/begin CHARACTERISTIC EGT_vdr "IOConfig # EGT_vdr" VALUE 0x0014398c /* @ECU_Address@EGT_vdr@0x010093D8@ */ ECIPP_ALIGNMENT_FLOAT32_IEEE 10000000000 Compu_EGT_vdr -10000000000 10000000000 /end CHARACTERISTIC
/begin COMPU_METHOD Compu_EGT_vdr " " RAT_FUNC "%.3" "ohms" COEFFS 0 1 0 0 0 1 /end COMPU_METHOD
/begin CHARACTERISTIC EGRT_vdr "IOConfig # EGRT_vdr" VALUE 0x00140050 /* @ECU_Address@EGRT_vdr@0x010093E0@ */ ECIPP_ALIGNMENT_FLOAT32_IEEE 10000000000 Compu_EGRT_vdr -10000000000 10000000000 /end CHARACTERISTIC
/begin COMPU_METHOD Compu_EGRT_vdr " " RAT_FUNC "%.3" "ohms" COEFFS 0 1 0 0 0 1 /end COMPU_METHOD
/begin CHARACTERISTIC DOCT_vdr "IOConfig # DOCT_vdr" VALUE 0x0016c838 /* @ECU_Address@DOCT_vdr@0x010093E8@ */ ECIPP_ALIGNMENT_FLOAT32_IEEE 10000000000 Compu_DOCT_vdr -10000000000 10000000000 /end CHARACTERISTIC
/begin COMPU_METHOD Compu_DOCT_vdr " " RAT_FUNC "%.3" "ohms" COEFFS 0 1 0 0 0 1 /end COMPU_METHOD
/begin CHARACTERISTIC DPFT_vdr "IOConfig # DPFT_vdr" VALUE 0x0016c83c /* @ECU_Address@DPFT_vdr@0x010093F0@ */ ECIPP_ALIGNMENT_FLOAT32_IEEE 10000000000 Compu_DPFT_vdr -10000000000 10000000000 /end CHARACTERISTIC
/begin COMPU_METHOD Compu_DPFT_vdr " " RAT_FUNC "%.3" "ohms" COEFFS 0 1 0 0 0 1 /end COMPU_METHOD
/begin CHARACTERISTIC SCRT_vdr "IOConfig # SCRT_vdr" VALUE 0x0016c840 /* @ECU_Address@SCRT_vdr@0x010093F8@ */ ECIPP_ALIGNMENT_FLOAT32_IEEE 10000000000 Compu_SCRT_vdr -10000000000 10000000000 /end CHARACTERISTIC
/begin COMPU_METHOD Compu_SCRT_vdr " " RAT_FUNC "%.3" "ohms" COEFFS 0 1 0 0 0 1 /end COMPU_METHOD
/begin CHARACTERISTIC TOT_vdr "IOConfig # TOT_vdr" VALUE 0x00143b74 /* @ECU_Address@TOT_vdr@0x01009400@ */ ECIPP_ALIGNMENT_FLOAT32_IEEE 10000000000 Compu_TOT_vdr -10000000000 10000000000 /end CHARACTERISTIC
/begin COMPU_METHOD Compu_TOT_vdr " " RAT_FUNC "%.3" "ohms" COEFFS 0 1 0 0 0 1 /end COMPU_METHOD
/begin CHARACTERISTIC EGT_Taux_cal "{EGT_Taux_cal&0xff=0:Fuel source}{EGT_Taux_cal&0xff=1:Exhaust manifold/riser}{EGT_Taux_cal&0xff=2:Aux Temp A}{EGT_Taux_cal&0xff=3:Aux Temp B}{EGT_Taux_cal&0xff=4:Aux Temp C}{EGT_Taux_cal&0xff=5:Aux Temp D}" VALUE 0x00147d2d /* @ECU_Address@EGT_Taux_cal@0x010094B8@ */ ECIPP_ALIGNMENT_UBYTE 255 EGT_Taux_cal_COMPU_VTAB 0 255 BIT_MASK 0xff /end CHARACTERISTIC
/begin COMPU_METHOD EGT_Taux_cal_COMPU_VTAB "Verbal Table" TAB_VERB "%.0" "list" COMPU_TAB_REF EGT_Taux_cal_COMPU_VTAB_REF /end COMPU_METHOD
/begin COMPU_VTAB EGT_Taux_cal_COMPU_VTAB_REF "Verbal Table" TAB_VERB 6 0 "Fuel source" 1 "Exhaust manifold/riser" 2 "Aux Temp A" 3 "Aux Temp B" 4 "Aux Temp C" 5 "Aux Temp D" DEFAULT_VALUE "UNKNOWN" /end COMPU_VTAB
/begin CHARACTERISTIC EGRT_Taux_cal "{EGRT_Taux_cal&0xff=0:Fuel source}{EGRT_Taux_cal&0xff=1:Exhaust manifold/riser}{EGRT_Taux_cal&0xff=2:Aux Temp A}{EGRT_Taux_cal&0xff=3:Aux Temp B}{EGRT_Taux_cal&0xff=4:Aux Temp C}{EGRT_Taux_cal&0xff=5:Aux Temp D}" VALUE 0x001409a7 /* @ECU_Address@EGRT_Taux_cal@0x010094C0@ */ ECIPP_ALIGNMENT_UBYTE 255 EGRT_Taux_cal_COMPU_VTAB 0 255 BIT_MASK 0xff /end CHARACTERISTIC
/begin COMPU_METHOD EGRT_Taux_cal_COMPU_VTAB "Verbal Table" TAB_VERB "%.0" "list" COMPU_TAB_REF EGRT_Taux_cal_COMPU_VTAB_REF /end COMPU_METHOD
/begin COMPU_VTAB EGRT_Taux_cal_COMPU_VTAB_REF "Verbal Table" TAB_VERB 6 0 "Fuel source" 1 "Exhaust manifold/riser" 2 "Aux Temp A" 3 "Aux Temp B" 4 "Aux Temp C" 5 "Aux Temp D" DEFAULT_VALUE "UNKNOWN" /end COMPU_VTAB
/begin CHARACTERISTIC DOCT_Taux_cal "{DOCT_Taux_cal&0xff=0:Fuel source}{DOCT_Taux_cal&0xff=1:Exhaust manifold/riser}{DOCT_Taux_cal&0xff=2:Aux Temp A}{DOCT_Taux_cal&0xff=3:Aux Temp B}{DOCT_Taux_cal&0xff=4:Aux Temp C}{DOCT_Taux_cal&0xff=5:Aux Temp D}" VALUE 0x00170f88 /* @ECU_Address@DOCT_Taux_cal@0x010094C8@ */ ECIPP_ALIGNMENT_UBYTE 255 DOCT_Taux_cal_COMPU_VTAB 0 255 BIT_MASK 0xff /end CHARACTERISTIC
/begin COMPU_METHOD DOCT_Taux_cal_COMPU_VTAB "Verbal Table" TAB_VERB "%.0" "list" COMPU_TAB_REF DOCT_Taux_cal_COMPU_VTAB_REF /end COMPU_METHOD
/begin COMPU_VTAB DOCT_Taux_cal_COMPU_VTAB_REF "Verbal Table" TAB_VERB 6 0 "Fuel source" 1 "Exhaust manifold/riser" 2 "Aux Temp A" 3 "Aux Temp B" 4 "Aux Temp C" 5 "Aux Temp D" DEFAULT_VALUE "UNKNOWN" /end COMPU_VTAB
/begin CHARACTERISTIC DPFT_Taux_cal "{DPFT_Taux_cal&0xff=0:Fuel source}{DPFT_Taux_cal&0xff=1:Exhaust manifold/riser}{DPFT_Taux_cal&0xff=2:Aux Temp A}{DPFT_Taux_cal&0xff=3:Aux Temp B}{DPFT_Taux_cal&0xff=4:Aux Temp C}{DPFT_Taux_cal&0xff=5:Aux Temp D}" VALUE 0x00170f8a /* @ECU_Address@DPFT_Taux_cal@0x010094D0@ */ ECIPP_ALIGNMENT_UBYTE 255 DPFT_Taux_cal_COMPU_VTAB 0 255 BIT_MASK 0xff /end CHARACTERISTIC
/begin COMPU_METHOD DPFT_Taux_cal_COMPU_VTAB "Verbal Table" TAB_VERB "%.0" "list" COMPU_TAB_REF DPFT_Taux_cal_COMPU_VTAB_REF /end COMPU_METHOD
/begin COMPU_VTAB DPFT_Taux_cal_COMPU_VTAB_REF "Verbal Table" TAB_VERB 6 0 "Fuel source" 1 "Exhaust manifold/riser" 2 "Aux Temp A" 3 "Aux Temp B" 4 "Aux Temp C" 5 "Aux Temp D" DEFAULT_VALUE "UNKNOWN" /end COMPU_VTAB
/begin CHARACTERISTIC SCRT_Taux_cal "{SCRT_Taux_cal&0xff=0:Fuel source}{SCRT_Taux_cal&0xff=1:Exhaust manifold/riser}{SCRT_Taux_cal&0xff=2:Aux Temp A}{SCRT_Taux_cal&0xff=3:Aux Temp B}{SCRT_Taux_cal&0xff=4:Aux Temp C}{SCRT_Taux_cal&0xff=5:Aux Temp D}" VALUE 0x00170f8e /* @ECU_Address@SCRT_Taux_cal@0x010094D8@ */ ECIPP_ALIGNMENT_UBYTE 255 SCRT_Taux_cal_COMPU_VTAB 0 255 BIT_MASK 0xff /end CHARACTERISTIC
/begin COMPU_METHOD SCRT_Taux_cal_COMPU_VTAB "Verbal Table" TAB_VERB "%.0" "list" COMPU_TAB_REF SCRT_Taux_cal_COMPU_VTAB_REF /end COMPU_METHOD
/begin COMPU_VTAB SCRT_Taux_cal_COMPU_VTAB_REF "Verbal Table" TAB_VERB 6 0 "Fuel source" 1 "Exhaust manifold/riser" 2 "Aux Temp A" 3 "Aux Temp B" 4 "Aux Temp C" 5 "Aux Temp D" DEFAULT_VALUE "UNKNOWN" /end COMPU_VTAB
/begin CHARACTERISTIC TOT_Taux_cal "{TOT_Taux_cal&0xff=0:Fuel source}{TOT_Taux_cal&0xff=1:Exhaust manifold/riser}{TOT_Taux_cal&0xff=2:Aux Temp A}{TOT_Taux_cal&0xff=3:Aux Temp B}{TOT_Taux_cal&0xff=4:Aux Temp C}{TOT_Taux_cal&0xff=5:Aux Temp D}" VALUE 0x001480a5 /* @ECU_Address@TOT_Taux_cal@0x010094E0@ */ ECIPP_ALIGNMENT_UBYTE 255 TOT_Taux_cal_COMPU_VTAB 0 255 BIT_MASK 0xff /end CHARACTERISTIC
/begin COMPU_METHOD TOT_Taux_cal_COMPU_VTAB "Verbal Table" TAB_VERB "%.0" "list" COMPU_TAB_REF TOT_Taux_cal_COMPU_VTAB_REF /end COMPU_METHOD
/begin COMPU_VTAB TOT_Taux_cal_COMPU_VTAB_REF "Verbal Table" TAB_VERB 6 0 "Fuel source" 1 "Exhaust manifold/riser" 2 "Aux Temp A" 3 "Aux Temp B" 4 "Aux Temp C" 5 "Aux Temp D" DEFAULT_VALUE "UNKNOWN" /end COMPU_VTAB
/begin CHARACTERISTIC EMWT1_Taux_cal "{EMWT1_Taux_cal&0xff=0:Fuel source}{EMWT1_Taux_cal&0xff=1:Exhaust manifold/riser}{EMWT1_Taux_cal&0xff=2:Aux Temp A}{EMWT1_Taux_cal&0xff=3:Aux Temp B}{EMWT1_Taux_cal&0xff=4:Aux Temp C}{EMWT1_Taux_cal&0xff=5:Aux Temp D}" VALUE 0x00147d34 /* @ECU_Address@EMWT1_Taux_cal@0x010094E8@ */ ECIPP_ALIGNMENT_UBYTE 255 EMWT1_Taux_cal_COMPU_VTAB 0 255 BIT_MASK 0xff /end CHARACTERISTIC
/begin COMPU_METHOD EMWT1_Taux_cal_COMPU_VTAB "Verbal Table" TAB_VERB "%.0" "list" COMPU_TAB_REF EMWT1_Taux_cal_COMPU_VTAB_REF /end COMPU_METHOD
/begin COMPU_VTAB EMWT1_Taux_cal_COMPU_VTAB_REF "Verbal Table" TAB_VERB 6 0 "Fuel source" 1 "Exhaust manifold/riser" 2 "Aux Temp A" 3 "Aux Temp B" 4 "Aux Temp C" 5 "Aux Temp D" DEFAULT_VALUE "UNKNOWN" /end COMPU_VTAB
/begin CHARACTERISTIC EMWT2_Taux_cal "{EMWT2_Taux_cal&0xff=0:Fuel source}{EMWT2_Taux_cal&0xff=1:Exhaust manifold/riser}{EMWT2_Taux_cal&0xff=2:Aux Temp A}{EMWT2_Taux_cal&0xff=3:Aux Temp B}{EMWT2_Taux_cal&0xff=4:Aux Temp C}{EMWT2_Taux_cal&0xff=5:Aux Temp D}" VALUE 0x00147d36 /* @ECU_Address@EMWT2_Taux_cal@0x010094F0@ */ ECIPP_ALIGNMENT_UBYTE 255 EMWT2_Taux_cal_COMPU_VTAB 0 255 BIT_MASK 0xff /end CHARACTERISTIC
/begin COMPU_METHOD EMWT2_Taux_cal_COMPU_VTAB "Verbal Table" TAB_VERB "%.0" "list" COMPU_TAB_REF EMWT2_Taux_cal_COMPU_VTAB_REF /end COMPU_METHOD
/begin COMPU_VTAB EMWT2_Taux_cal_COMPU_VTAB_REF "Verbal Table" TAB_VERB 6 0 "Fuel source" 1 "Exhaust manifold/riser" 2 "Aux Temp A" 3 "Aux Temp B" 4 "Aux Temp C" 5 "Aux Temp D" DEFAULT_VALUE "UNKNOWN" /end COMPU_VTAB
/begin CHARACTERISTIC ERWT1_Taux_cal "{ERWT1_Taux_cal&0xff=0:Fuel source}{ERWT1_Taux_cal&0xff=1:Exhaust manifold/riser}{ERWT1_Taux_cal&0xff=2:Aux Temp A}{ERWT1_Taux_cal&0xff=3:Aux Temp B}{ERWT1_Taux_cal&0xff=4:Aux Temp C}{ERWT1_Taux_cal&0xff=5:Aux Temp D}" VALUE 0x00147d3a /* @ECU_Address@ERWT1_Taux_cal@0x010094F8@ */ ECIPP_ALIGNMENT_UBYTE 255 ERWT1_Taux_cal_COMPU_VTAB 0 255 BIT_MASK 0xff /end CHARACTERISTIC
/begin COMPU_METHOD ERWT1_Taux_cal_COMPU_VTAB "Verbal Table" TAB_VERB "%.0" "list" COMPU_TAB_REF ERWT1_Taux_cal_COMPU_VTAB_REF /end COMPU_METHOD
/begin COMPU_VTAB ERWT1_Taux_cal_COMPU_VTAB_REF "Verbal Table" TAB_VERB 6 0 "Fuel source" 1 "Exhaust manifold/riser" 2 "Aux Temp A" 3 "Aux Temp B" 4 "Aux Temp C" 5 "Aux Temp D" DEFAULT_VALUE "UNKNOWN" /end COMPU_VTAB
/begin CHARACTERISTIC ERWT2_Taux_cal "{ERWT2_Taux_cal&0xff=0:Fuel source}{ERWT2_Taux_cal&0xff=1:Exhaust manifold/riser}{ERWT2_Taux_cal&0xff=2:Aux Temp A}{ERWT2_Taux_cal&0xff=3:Aux Temp B}{ERWT2_Taux_cal&0xff=4:Aux Temp C}{ERWT2_Taux_cal&0xff=5:Aux Temp D}" VALUE 0x00147d3c /* @ECU_Address@ERWT2_Taux_cal@0x01009500@ */ ECIPP_ALIGNMENT_UBYTE 255 ERWT2_Taux_cal_COMPU_VTAB 0 255 BIT_MASK 0xff /end CHARACTERISTIC
/begin COMPU_METHOD ERWT2_Taux_cal_COMPU_VTAB "Verbal Table" TAB_VERB "%.0" "list" COMPU_TAB_REF ERWT2_Taux_cal_COMPU_VTAB_REF /end COMPU_METHOD
/begin COMPU_VTAB ERWT2_Taux_cal_COMPU_VTAB_REF "Verbal Table" TAB_VERB 6 0 "Fuel source" 1 "Exhaust manifold/riser" 2 "Aux Temp A" 3 "Aux Temp B" 4 "Aux Temp C" 5 "Aux Temp D" DEFAULT_VALUE "UNKNOWN" /end COMPU_VTAB
/begin CHARACTERISTIC FST_Taux_cal "{FST_Taux_cal&0xff=0:Fuel source}{FST_Taux_cal&0xff=1:Exhaust manifold/riser}{FST_Taux_cal&0xff=2:Aux Temp A}{FST_Taux_cal&0xff=3:Aux Temp B}{FST_Taux_cal&0xff=4:Aux Temp C}{FST_Taux_cal&0xff=5:Aux Temp D}" VALUE 0x00147d88 /* @ECU_Address@FST_Taux_cal@0x01009508@ */ ECIPP_ALIGNMENT_UBYTE 255 FST_Taux_cal_COMPU_VTAB 0 255 BIT_MASK 0xff /end CHARACTERISTIC
/begin COMPU_METHOD FST_Taux_cal_COMPU_VTAB "Verbal Table" TAB_VERB "%.0" "list" COMPU_TAB_REF FST_Taux_cal_COMPU_VTAB_REF /end COMPU_METHOD
/begin COMPU_VTAB FST_Taux_cal_COMPU_VTAB_REF "Verbal Table" TAB_VERB 6 0 "Fuel source" 1 "Exhaust manifold/riser" 2 "Aux Temp A" 3 "Aux Temp B" 4 "Aux Temp C" 5 "Aux Temp D" DEFAULT_VALUE "UNKNOWN" /end COMPU_VTAB
/begin CHARACTERISTIC PauxA_abs_gage "{PauxA_abs_gage&0xff=0:(psia)}{PauxA_abs_gage&0xff=1:(psig)}" VALUE 0x00147ee1 /* @ECU_Address@PauxA_abs_gage@0x01009510@ */ ECIPP_ALIGNMENT_UBYTE 255 PauxA_abs_gage_COMPU_VTAB 0 255 BIT_MASK 0xff /end CHARACTERISTIC
/begin COMPU_METHOD PauxA_abs_gage_COMPU_VTAB "Verbal Table" TAB_VERB "%.0" "list" COMPU_TAB_REF PauxA_abs_gage_COMPU_VTAB_REF /end COMPU_METHOD
/begin COMPU_VTAB PauxA_abs_gage_COMPU_VTAB_REF "Verbal Table" TAB_VERB 2 0 "(psia)" 1 "(psig)" DEFAULT_VALUE "UNKNOWN" /end COMPU_VTAB
/begin CHARACTERISTIC PauxB_abs_gage "{PauxB_abs_gage&0xff=0:(psia)}{PauxB_abs_gage&0xff=1:(psig)}" VALUE 0x00147ee2 /* @ECU_Address@PauxB_abs_gage@0x01009518@ */ ECIPP_ALIGNMENT_UBYTE 255 PauxB_abs_gage_COMPU_VTAB 0 255 BIT_MASK 0xff /end CHARACTERISTIC
/begin COMPU_METHOD PauxB_abs_gage_COMPU_VTAB "Verbal Table" TAB_VERB "%.0" "list" COMPU_TAB_REF PauxB_abs_gage_COMPU_VTAB_REF /end COMPU_METHOD
/begin COMPU_VTAB PauxB_abs_gage_COMPU_VTAB_REF "Verbal Table" TAB_VERB 2 0 "(psia)" 1 "(psig)" DEFAULT_VALUE "UNKNOWN" /end COMPU_VTAB
/begin CHARACTERISTIC PauxC_abs_gage "{PauxC_abs_gage&0xff=0:(psia)}{PauxC_abs_gage&0xff=1:(psig)}" VALUE 0x00147ee3 /* @ECU_Address@PauxC_abs_gage@0x01009520@ */ ECIPP_ALIGNMENT_UBYTE 255 PauxC_abs_gage_COMPU_VTAB 0 255 BIT_MASK 0xff /end CHARACTERISTIC
/begin COMPU_METHOD PauxC_abs_gage_COMPU_VTAB "Verbal Table" TAB_VERB "%.0" "list" COMPU_TAB_REF PauxC_abs_gage_COMPU_VTAB_REF /end COMPU_METHOD
/begin COMPU_VTAB PauxC_abs_gage_COMPU_VTAB_REF "Verbal Table" TAB_VERB 2 0 "(psia)" 1 "(psig)" DEFAULT_VALUE "UNKNOWN" /end COMPU_VTAB
/begin CHARACTERISTIC PauxD_abs_gage "{PauxD_abs_gage&0xff=0:(psia)}{PauxD_abs_gage&0xff=1:(psig)}" VALUE 0x00147ee4 /* @ECU_Address@PauxD_abs_gage@0x01009528@ */ ECIPP_ALIGNMENT_UBYTE 255 PauxD_abs_gage_COMPU_VTAB 0 255 BIT_MASK 0xff /end CHARACTERISTIC
/begin COMPU_METHOD PauxD_abs_gage_COMPU_VTAB "Verbal Table" TAB_VERB "%.0" "list" COMPU_TAB_REF PauxD_abs_gage_COMPU_VTAB_REF /end COMPU_METHOD
/begin COMPU_VTAB PauxD_abs_gage_COMPU_VTAB_REF "Verbal Table" TAB_VERB 2 0 "(psia)" 1 "(psig)" DEFAULT_VALUE "UNKNOWN" /end COMPU_VTAB
/begin CHARACTERISTIC EMP_Paux_cal "{EMP_Paux_cal&0xff=0:Aux Press A}{EMP_Paux_cal&0xff=1:Aux Press B}{EMP_Paux_cal&0xff=2:Aux Press C}{EMP_Paux_cal&0xff=3:Aux Press D}" VALUE 0x00147d30 /* @ECU_Address@EMP_Paux_cal@0x01009530@ */ ECIPP_ALIGNMENT_UBYTE 255 EMP_Paux_cal_COMPU_VTAB 0 255 BIT_MASK 0xff /end CHARACTERISTIC
/begin COMPU_METHOD EMP_Paux_cal_COMPU_VTAB "Verbal Table" TAB_VERB "%.0" "list" COMPU_TAB_REF EMP_Paux_cal_COMPU_VTAB_REF /end COMPU_METHOD
/begin COMPU_VTAB EMP_Paux_cal_COMPU_VTAB_REF "Verbal Table" TAB_VERB 4 0 "Aux Press A" 1 "Aux Press B" 2 "Aux Press C" 3 "Aux Press D" DEFAULT_VALUE "UNKNOWN" /end COMPU_VTAB
/begin CHARACTERISTIC EGRdP_Paux_cal "{EGRdP_Paux_cal&0xff=0:Aux Press A}{EGRdP_Paux_cal&0xff=1:Aux Press B}{EGRdP_Paux_cal&0xff=2:Aux Press C}{EGRdP_Paux_cal&0xff=3:Aux Press D}" VALUE 0x001409b7 /* @ECU_Address@EGRdP_Paux_cal@0x01009538@ */ ECIPP_ALIGNMENT_UBYTE 255 EGRdP_Paux_cal_COMPU_VTAB 0 255 BIT_MASK 0xff /end CHARACTERISTIC
/begin COMPU_METHOD EGRdP_Paux_cal_COMPU_VTAB "Verbal Table" TAB_VERB "%.0" "list" COMPU_TAB_REF EGRdP_Paux_cal_COMPU_VTAB_REF /end COMPU_METHOD
/begin COMPU_VTAB EGRdP_Paux_cal_COMPU_VTAB_REF "Verbal Table" TAB_VERB 4 0 "Aux Press A" 1 "Aux Press B" 2 "Aux Press C" 3 "Aux Press D" DEFAULT_VALUE "UNKNOWN" /end COMPU_VTAB
/begin CHARACTERISTIC DPFdP_Paux_cal "{DPFdP_Paux_cal&0xff=0:Aux Press A}{DPFdP_Paux_cal&0xff=1:Aux Press B}{DPFdP_Paux_cal&0xff=2:Aux Press C}{DPFdP_Paux_cal&0xff=3:Aux Press D}" VALUE 0x00170f8c /* @ECU_Address@DPFdP_Paux_cal@0x01009540@ */ ECIPP_ALIGNMENT_UBYTE 255 DPFdP_Paux_cal_COMPU_VTAB 0 255 BIT_MASK 0xff /end CHARACTERISTIC
/begin COMPU_METHOD DPFdP_Paux_cal_COMPU_VTAB "Verbal Table" TAB_VERB "%.0" "list" COMPU_TAB_REF DPFdP_Paux_cal_COMPU_VTAB_REF /end COMPU_METHOD
/begin COMPU_VTAB DPFdP_Paux_cal_COMPU_VTAB_REF "Verbal Table" TAB_VERB 4 0 "Aux Press A" 1 "Aux Press B" 2 "Aux Press C" 3 "Aux Press D" DEFAULT_VALUE "UNKNOWN" /end COMPU_VTAB
/begin CHARACTERISTIC PAUX1_Paux_cal "{PAUX1_Paux_cal&0xff=0:Aux Press A}{PAUX1_Paux_cal&0xff=1:Aux Press B}{PAUX1_Paux_cal&0xff=2:Aux Press C}{PAUX1_Paux_cal&0xff=3:Aux Press D}" VALUE 0x00147EAD /* @ECU_Address@PAUX1_Paux_cal@0x01009548@ */ ECIPP_ALIGNMENT_UBYTE 255 PAUX1_Paux_cal_COMPU_VTAB 0 255 BIT_MASK 0xff /end CHARACTERISTIC
/begin COMPU_METHOD PAUX1_Paux_cal_COMPU_VTAB "Verbal Table" TAB_VERB "%.0" "list" COMPU_TAB_REF PAUX1_Paux_cal_COMPU_VTAB_REF /end COMPU_METHOD
/begin COMPU_VTAB PAUX1_Paux_cal_COMPU_VTAB_REF "Verbal Table" TAB_VERB 4 0 "Aux Press A" 1 "Aux Press B" 2 "Aux Press C" 3 "Aux Press D" DEFAULT_VALUE "UNKNOWN" /end COMPU_VTAB
/begin CHARACTERISTIC PAUX2_Paux_cal "{PAUX2_Paux_cal&0xff=0:Aux Press A}{PAUX2_Paux_cal&0xff=1:Aux Press B}{PAUX2_Paux_cal&0xff=2:Aux Press C}{PAUX2_Paux_cal&0xff=3:Aux Press D}" VALUE 0x00147EAE /* @ECU_Address@PAUX2_Paux_cal@0x01009550@ */ ECIPP_ALIGNMENT_UBYTE 255 PAUX2_Paux_cal_COMPU_VTAB 0 255 BIT_MASK 0xff /end CHARACTERISTIC
/begin COMPU_METHOD PAUX2_Paux_cal_COMPU_VTAB "Verbal Table" TAB_VERB "%.0" "list" COMPU_TAB_REF PAUX2_Paux_cal_COMPU_VTAB_REF /end COMPU_METHOD
/begin COMPU_VTAB PAUX2_Paux_cal_COMPU_VTAB_REF "Verbal Table" TAB_VERB 4 0 "Aux Press A" 1 "Aux Press B" 2 "Aux Press C" 3 "Aux Press D" DEFAULT_VALUE "UNKNOWN" /end COMPU_VTAB
/begin CHARACTERISTIC PAUX3_Paux_cal "{PAUX3_Paux_cal&0xff=0:Aux Press A}{PAUX3_Paux_cal&0xff=1:Aux Press B}{PAUX3_Paux_cal&0xff=2:Aux Press C}{PAUX3_Paux_cal&0xff=3:Aux Press D}" VALUE 0x00147EAF /* @ECU_Address@PAUX3_Paux_cal@0x01009558@ */ ECIPP_ALIGNMENT_UBYTE 255 PAUX3_Paux_cal_COMPU_VTAB 0 255 BIT_MASK 0xff /end CHARACTERISTIC
/begin COMPU_METHOD PAUX3_Paux_cal_COMPU_VTAB "Verbal Table" TAB_VERB "%.0" "list" COMPU_TAB_REF PAUX3_Paux_cal_COMPU_VTAB_REF /end COMPU_METHOD
/begin COMPU_VTAB PAUX3_Paux_cal_COMPU_VTAB_REF "Verbal Table" TAB_VERB 4 0 "Aux Press A" 1 "Aux Press B" 2 "Aux Press C" 3 "Aux Press D" DEFAULT_VALUE "UNKNOWN" /end COMPU_VTAB
/begin CHARACTERISTIC PAUX4_Paux_cal "{PAUX4_Paux_cal&0xff=0:Aux Press A}{PAUX4_Paux_cal&0xff=1:Aux Press B}{PAUX4_Paux_cal&0xff=2:Aux Press C}{PAUX4_Paux_cal&0xff=3:Aux Press D}" VALUE 0x00147EB0 /* @ECU_Address@PAUX4_Paux_cal@0x01009560@ */ ECIPP_ALIGNMENT_UBYTE 255 PAUX4_Paux_cal_COMPU_VTAB 0 255 BIT_MASK 0xff /end CHARACTERISTIC
/begin COMPU_METHOD PAUX4_Paux_cal_COMPU_VTAB "Verbal Table" TAB_VERB "%.0" "list" COMPU_TAB_REF PAUX4_Paux_cal_COMPU_VTAB_REF /end COMPU_METHOD
/begin COMPU_VTAB PAUX4_Paux_cal_COMPU_VTAB_REF "Verbal Table" TAB_VERB 4 0 "Aux Press A" 1 "Aux Press B" 2 "Aux Press C" 3 "Aux Press D" DEFAULT_VALUE "UNKNOWN" /end COMPU_VTAB
/begin CHARACTERISTIC PAUX5_Paux_cal "{PAUX5_Paux_cal&0xff=0:Aux Press A}{PAUX5_Paux_cal&0xff=1:Aux Press B}{PAUX5_Paux_cal&0xff=2:Aux Press C}{PAUX5_Paux_cal&0xff=3:Aux Press D}" VALUE 0x00147EB1 /* @ECU_Address@PAUX5_Paux_cal@0x01009568@ */ ECIPP_ALIGNMENT_UBYTE 255 PAUX5_Paux_cal_COMPU_VTAB 0 255 BIT_MASK 0xff /end CHARACTERISTIC
/begin COMPU_METHOD PAUX5_Paux_cal_COMPU_VTAB "Verbal Table" TAB_VERB "%.0" "list" COMPU_TAB_REF PAUX5_Paux_cal_COMPU_VTAB_REF /end COMPU_METHOD
/begin COMPU_VTAB PAUX5_Paux_cal_COMPU_VTAB_REF "Verbal Table" TAB_VERB 4 0 "Aux Press A" 1 "Aux Press B" 2 "Aux Press C" 3 "Aux Press D" DEFAULT_VALUE "UNKNOWN" /end COMPU_VTAB
/begin CHARACTERISTIC PAUX6_Paux_cal "{PAUX6_Paux_cal&0xff=0:Aux Press A}{PAUX6_Paux_cal&0xff=1:Aux Press B}{PAUX6_Paux_cal&0xff=2:Aux Press C}{PAUX6_Paux_cal&0xff=3:Aux Press D}" VALUE 0x00147EB2 /* @ECU_Address@PAUX6_Paux_cal@0x01009570@ */ ECIPP_ALIGNMENT_UBYTE 255 PAUX6_Paux_cal_COMPU_VTAB 0 255 BIT_MASK 0xff /end CHARACTERISTIC
/begin COMPU_METHOD PAUX6_Paux_cal_COMPU_VTAB "Verbal Table" TAB_VERB "%.0" "list" COMPU_TAB_REF PAUX6_Paux_cal_COMPU_VTAB_REF /end COMPU_METHOD
/begin COMPU_VTAB PAUX6_Paux_cal_COMPU_VTAB_REF "Verbal Table" TAB_VERB 4 0 "Aux Press A" 1 "Aux Press B" 2 "Aux Press C" 3 "Aux Press D" DEFAULT_VALUE "UNKNOWN" /end COMPU_VTAB
/begin CHARACTERISTIC PAUX7_Paux_cal "{PAUX7_Paux_cal&0xff=0:Aux Press A}{PAUX7_Paux_cal&0xff=1:Aux Press B}{PAUX7_Paux_cal&0xff=2:Aux Press C}{PAUX7_Paux_cal&0xff=3:Aux Press D}" VALUE 0x00147EB3 /* @ECU_Address@PAUX7_Paux_cal@0x01009578@ */ ECIPP_ALIGNMENT_UBYTE 255 PAUX7_Paux_cal_COMPU_VTAB 0 255 BIT_MASK 0xff /end CHARACTERISTIC
/begin COMPU_METHOD PAUX7_Paux_cal_COMPU_VTAB "Verbal Table" TAB_VERB "%.0" "list" COMPU_TAB_REF PAUX7_Paux_cal_COMPU_VTAB_REF /end COMPU_METHOD
/begin COMPU_VTAB PAUX7_Paux_cal_COMPU_VTAB_REF "Verbal Table" TAB_VERB 4 0 "Aux Press A" 1 "Aux Press B" 2 "Aux Press C" 3 "Aux Press D" DEFAULT_VALUE "UNKNOWN" /end COMPU_VTAB
/begin CHARACTERISTIC PAUX8_Paux_cal "{PAUX8_Paux_cal&0xff=0:Aux Press A}{PAUX8_Paux_cal&0xff=1:Aux Press B}{PAUX8_Paux_cal&0xff=2:Aux Press C}{PAUX8_Paux_cal&0xff=3:Aux Press D}" VALUE 0x00147EB4 /* @ECU_Address@PAUX8_Paux_cal@0x01009580@ */ ECIPP_ALIGNMENT_UBYTE 255 PAUX8_Paux_cal_COMPU_VTAB 0 255 BIT_MASK 0xff /end CHARACTERISTIC
/begin COMPU_METHOD PAUX8_Paux_cal_COMPU_VTAB "Verbal Table" TAB_VERB "%.0" "list" COMPU_TAB_REF PAUX8_Paux_cal_COMPU_VTAB_REF /end COMPU_METHOD
/begin COMPU_VTAB PAUX8_Paux_cal_COMPU_VTAB_REF "Verbal Table" TAB_VERB 4 0 "Aux Press A" 1 "Aux Press B" 2 "Aux Press C" 3 "Aux Press D" DEFAULT_VALUE "UNKNOWN" /end COMPU_VTAB
/begin CHARACTERISTIC PAUX1_ena "{PAUX1_ena&0xff=0:Disabled}{PAUX1_ena&0xff=1:Aux PD1}{PAUX1_ena&0xff=2:Aux PD2}{PAUX1_ena&0xff=3:Aux PD3}{PAUX1_ena&0xff=4:Aux PUD1}{PAUX1_ena&0xff=5:Aux PUD2}{PAUX1_ena&0xff=6:Aux PUD3}{PAUX1_ena&0xff=7:Aux PUD4}{PAUX1_ena&0xff=8:Aux PUD5}{PAUX1_ena&0xff" VALUE 0x00147EBD /* @ECU_Address@PAUX1_ena@0x01009588@ */ ECIPP_ALIGNMENT_UBYTE 255 PAUX1_ena_COMPU_VTAB 0 255 BIT_MASK 0xff /end CHARACTERISTIC
/begin COMPU_METHOD PAUX1_ena_COMPU_VTAB "Verbal Table" TAB_VERB "%.0" "list" COMPU_TAB_REF PAUX1_ena_COMPU_VTAB_REF /end COMPU_METHOD
/begin COMPU_VTAB PAUX1_ena_COMPU_VTAB_REF "Verbal Table" TAB_VERB 31 0 "Disabled" 1 "Aux PD1" 2 "Aux PD2" 3 "Aux PD3" 4 "Aux PUD1" 5 "Aux PUD2" 6 "Aux PUD3" 7 "Aux PUD4" 8 "Aux PUD5" 9 "Aux PUD6" 10 "Aux PUD7" 11 "Aux PUD8" 12 "Aux PUD9" 13 "Aux PUD10" 14 "Aux PUD11" 15 "Aux PUD12" 16 "Aux PUD13" 17 "Aux PUD14" 18 "Aux PUD15" 19 "CAN sourced" 20 "FPP2 Input" 21 "Aux PUD16" 22 "Aux PUD17" 23 "Aux PUD18" 24 "Aux PUD19" 25 "Aux PUD20" 26 "Aux PUD21" 27 "Aux PUD22" 28 "Aux PUD23" 29 "Aux PUD24" 30 "Aux PUD25" DEFAULT_VALUE "UNKNOWN" /end COMPU_VTAB
/begin CHARACTERISTIC PAUX2_ena "{PAUX2_ena&0xff=0:Disabled}{PAUX2_ena&0xff=1:Aux PD1}{PAUX2_ena&0xff=2:Aux PD2}{PAUX2_ena&0xff=3:Aux PD3}{PAUX2_ena&0xff=4:Aux PUD1}{PAUX2_ena&0xff=5:Aux PUD2}{PAUX2_ena&0xff=6:Aux PUD3}{PAUX2_ena&0xff=7:Aux PUD4}{PAUX2_ena&0xff=8:Aux PUD5}{PAUX2_ena&0xff" VALUE 0x00147EBE /* @ECU_Address@PAUX2_ena@0x01009590@ */ ECIPP_ALIGNMENT_UBYTE 255 PAUX2_ena_COMPU_VTAB 0 255 BIT_MASK 0xff /end CHARACTERISTIC
/begin COMPU_METHOD PAUX2_ena_COMPU_VTAB "Verbal Table" TAB_VERB "%.0" "list" COMPU_TAB_REF PAUX2_ena_COMPU_VTAB_REF /end COMPU_METHOD
/begin COMPU_VTAB PAUX2_ena_COMPU_VTAB_REF "Verbal Table" TAB_VERB 31 0 "Disabled" 1 "Aux PD1" 2 "Aux PD2" 3 "Aux PD3" 4 "Aux PUD1" 5 "Aux PUD2" 6 "Aux PUD3" 7 "Aux PUD4" 8 "Aux PUD5" 9 "Aux PUD6" 10 "Aux PUD7" 11 "Aux PUD8" 12 "Aux PUD9" 13 "Aux PUD10" 14 "Aux PUD11" 15 "Aux PUD12" 16 "Aux PUD13" 17 "Aux PUD14" 18 "Aux PUD15" 19 "CAN sourced" 20 "FPP2 Input" 21 "Aux PUD16" 22 "Aux PUD17" 23 "Aux PUD18" 24 "Aux PUD19" 25 "Aux PUD20" 26 "Aux PUD21" 27 "Aux PUD22" 28 "Aux PUD23" 29 "Aux PUD24" 30 "Aux PUD25" DEFAULT_VALUE "UNKNOWN" /end COMPU_VTAB
/begin CHARACTERISTIC PAUX3_ena "{PAUX3_ena&0xff=0:Disabled}{PAUX3_ena&0xff=1:Aux PD1}{PAUX3_ena&0xff=2:Aux PD2}{PAUX3_ena&0xff=3:Aux PD3}{PAUX3_ena&0xff=4:Aux PUD1}{PAUX3_ena&0xff=5:Aux PUD2}{PAUX3_ena&0xff=6:Aux PUD3}{PAUX3_ena&0xff=7:Aux PUD4}{PAUX3_ena&0xff=8:Aux PUD5}{PAUX3_ena&0xff" VALUE 0x00147EBF /* @ECU_Address@PAUX3_ena@0x01009598@ */ ECIPP_ALIGNMENT_UBYTE 255 PAUX3_ena_COMPU_VTAB 0 255 BIT_MASK 0xff /end CHARACTERISTIC
/begin COMPU_METHOD PAUX3_ena_COMPU_VTAB "Verbal Table" TAB_VERB "%.0" "list" COMPU_TAB_REF PAUX3_ena_COMPU_VTAB_REF /end COMPU_METHOD
/begin COMPU_VTAB PAUX3_ena_COMPU_VTAB_REF "Verbal Table" TAB_VERB 31 0 "Disabled" 1 "Aux PD1" 2 "Aux PD2" 3 "Aux PD3" 4 "Aux PUD1" 5 "Aux PUD2" 6 "Aux PUD3" 7 "Aux PUD4" 8 "Aux PUD5" 9 "Aux PUD6" 10 "Aux PUD7" 11 "Aux PUD8" 12 "Aux PUD9" 13 "Aux PUD10" 14 "Aux PUD11" 15 "Aux PUD12" 16 "Aux PUD13" 17 "Aux PUD14" 18 "Aux PUD15" 19 "CAN sourced" 20 "FPP2 Input" 21 "Aux PUD16" 22 "Aux PUD17" 23 "Aux PUD18" 24 "Aux PUD19" 25 "Aux PUD20" 26 "Aux PUD21" 27 "Aux PUD22" 28 "Aux PUD23" 29 "Aux PUD24" 30 "Aux PUD25" DEFAULT_VALUE "UNKNOWN" /end COMPU_VTAB
/begin CHARACTERISTIC PAUX4_ena "{PAUX4_ena&0xff=0:Disabled}{PAUX4_ena&0xff=1:Aux PD1}{PAUX4_ena&0xff=2:Aux PD2}{PAUX4_ena&0xff=3:Aux PD3}{PAUX4_ena&0xff=4:Aux PUD1}{PAUX4_ena&0xff=5:Aux PUD2}{PAUX4_ena&0xff=6:Aux PUD3}{PAUX4_ena&0xff=7:Aux PUD4}{PAUX4_ena&0xff=8:Aux PUD5}{PAUX4_ena&0xff" VALUE 0x00147EC0 /* @ECU_Address@PAUX4_ena@0x010095A0@ */ ECIPP_ALIGNMENT_UBYTE 255 PAUX4_ena_COMPU_VTAB 0 255 BIT_MASK 0xff /end CHARACTERISTIC
/begin COMPU_METHOD PAUX4_ena_COMPU_VTAB "Verbal Table" TAB_VERB "%.0" "list" COMPU_TAB_REF PAUX4_ena_COMPU_VTAB_REF /end COMPU_METHOD
/begin COMPU_VTAB PAUX4_ena_COMPU_VTAB_REF "Verbal Table" TAB_VERB 31 0 "Disabled" 1 "Aux PD1" 2 "Aux PD2" 3 "Aux PD3" 4 "Aux PUD1" 5 "Aux PUD2" 6 "Aux PUD3" 7 "Aux PUD4" 8 "Aux PUD5" 9 "Aux PUD6" 10 "Aux PUD7" 11 "Aux PUD8" 12 "Aux PUD9" 13 "Aux PUD10" 14 "Aux PUD11" 15 "Aux PUD12" 16 "Aux PUD13" 17 "Aux PUD14" 18 "Aux PUD15" 19 "CAN sourced" 20 "FPP2 Input" 21 "Aux PUD16" 22 "Aux PUD17" 23 "Aux PUD18" 24 "Aux PUD19" 25 "Aux PUD20" 26 "Aux PUD21" 27 "Aux PUD22" 28 "Aux PUD23" 29 "Aux PUD24" 30 "Aux PUD25" DEFAULT_VALUE "UNKNOWN" /end COMPU_VTAB
/begin CHARACTERISTIC PAUX5_ena "{PAUX5_ena&0xff=0:Disabled}{PAUX5_ena&0xff=1:Aux PD1}{PAUX5_ena&0xff=2:Aux PD2}{PAUX5_ena&0xff=3:Aux PD3}{PAUX5_ena&0xff=4:Aux PUD1}{PAUX5_ena&0xff=5:Aux PUD2}{PAUX5_ena&0xff=6:Aux PUD3}{PAUX5_ena&0xff=7:Aux PUD4}{PAUX5_ena&0xff=8:Aux PUD5}{PAUX5_ena&0xff" VALUE 0x00147EC1 /* @ECU_Address@PAUX5_ena@0x010095A8@ */ ECIPP_ALIGNMENT_UBYTE 255 PAUX5_ena_COMPU_VTAB 0 255 BIT_MASK 0xff /end CHARACTERISTIC
/begin COMPU_METHOD PAUX5_ena_COMPU_VTAB "Verbal Table" TAB_VERB "%.0" "list" COMPU_TAB_REF PAUX5_ena_COMPU_VTAB_REF /end COMPU_METHOD
/begin COMPU_VTAB PAUX5_ena_COMPU_VTAB_REF "Verbal Table" TAB_VERB 31 0 "Disabled" 1 "Aux PD1" 2 "Aux PD2" 3 "Aux PD3" 4 "Aux PUD1" 5 "Aux PUD2" 6 "Aux PUD3" 7 "Aux PUD4" 8 "Aux PUD5" 9 "Aux PUD6" 10 "Aux PUD7" 11 "Aux PUD8" 12 "Aux PUD9" 13 "Aux PUD10" 14 "Aux PUD11" 15 "Aux PUD12" 16 "Aux PUD13" 17 "Aux PUD14" 18 "Aux PUD15" 19 "CAN sourced" 20 "FPP2 Input" 21 "Aux PUD16" 22 "Aux PUD17" 23 "Aux PUD18" 24 "Aux PUD19" 25 "Aux PUD20" 26 "Aux PUD21" 27 "Aux PUD22" 28 "Aux PUD23" 29 "Aux PUD24" 30 "Aux PUD25" DEFAULT_VALUE "UNKNOWN" /end COMPU_VTAB
/begin CHARACTERISTIC PAUX6_ena "{PAUX6_ena&0xff=0:Disabled}{PAUX6_ena&0xff=1:Aux PD1}{PAUX6_ena&0xff=2:Aux PD2}{PAUX6_ena&0xff=3:Aux PD3}{PAUX6_ena&0xff=4:Aux PUD1}{PAUX6_ena&0xff=5:Aux PUD2}{PAUX6_ena&0xff=6:Aux PUD3}{PAUX6_ena&0xff=7:Aux PUD4}{PAUX6_ena&0xff=8:Aux PUD5}{PAUX6_ena&0xff" VALUE 0x00147EC2 /* @ECU_Address@PAUX6_ena@0x010095B0@ */ ECIPP_ALIGNMENT_UBYTE 255 PAUX6_ena_COMPU_VTAB 0 255 BIT_MASK 0xff /end CHARACTERISTIC
/begin COMPU_METHOD PAUX6_ena_COMPU_VTAB "Verbal Table" TAB_VERB "%.0" "list" COMPU_TAB_REF PAUX6_ena_COMPU_VTAB_REF /end COMPU_METHOD
/begin COMPU_VTAB PAUX6_ena_COMPU_VTAB_REF "Verbal Table" TAB_VERB 31 0 "Disabled" 1 "Aux PD1" 2 "Aux PD2" 3 "Aux PD3" 4 "Aux PUD1" 5 "Aux PUD2" 6 "Aux PUD3" 7 "Aux PUD4" 8 "Aux PUD5" 9 "Aux PUD6" 10 "Aux PUD7" 11 "Aux PUD8" 12 "Aux PUD9" 13 "Aux PUD10" 14 "Aux PUD11" 15 "Aux PUD12" 16 "Aux PUD13" 17 "Aux PUD14" 18 "Aux PUD15" 19 "CAN sourced" 20 "FPP2 Input" 21 "Aux PUD16" 22 "Aux PUD17" 23 "Aux PUD18" 24 "Aux PUD19" 25 "Aux PUD20" 26 "Aux PUD21" 27 "Aux PUD22" 28 "Aux PUD23" 29 "Aux PUD24" 30 "Aux PUD25" DEFAULT_VALUE "UNKNOWN" /end COMPU_VTAB
/begin CHARACTERISTIC PAUX7_ena "{PAUX7_ena&0xff=0:Disabled}{PAUX7_ena&0xff=1:Aux PD1}{PAUX7_ena&0xff=2:Aux PD2}{PAUX7_ena&0xff=3:Aux PD3}{PAUX7_ena&0xff=4:Aux PUD1}{PAUX7_ena&0xff=5:Aux PUD2}{PAUX7_ena&0xff=6:Aux PUD3}{PAUX7_ena&0xff=7:Aux PUD4}{PAUX7_ena&0xff=8:Aux PUD5}{PAUX7_ena&0xff" VALUE 0x00147EC3 /* @ECU_Address@PAUX7_ena@0x010095B8@ */ ECIPP_ALIGNMENT_UBYTE 255 PAUX7_ena_COMPU_VTAB 0 255 BIT_MASK 0xff /end CHARACTERISTIC
/begin COMPU_METHOD PAUX7_ena_COMPU_VTAB "Verbal Table" TAB_VERB "%.0" "list" COMPU_TAB_REF PAUX7_ena_COMPU_VTAB_REF /end COMPU_METHOD
/begin COMPU_VTAB PAUX7_ena_COMPU_VTAB_REF "Verbal Table" TAB_VERB 31 0 "Disabled" 1 "Aux PD1" 2 "Aux PD2" 3 "Aux PD3" 4 "Aux PUD1" 5 "Aux PUD2" 6 "Aux PUD3" 7 "Aux PUD4" 8 "Aux PUD5" 9 "Aux PUD6" 10 "Aux PUD7" 11 "Aux PUD8" 12 "Aux PUD9" 13 "Aux PUD10" 14 "Aux PUD11" 15 "Aux PUD12" 16 "Aux PUD13" 17 "Aux PUD14" 18 "Aux PUD15" 19 "CAN sourced" 20 "FPP2 Input" 21 "Aux PUD16" 22 "Aux PUD17" 23 "Aux PUD18" 24 "Aux PUD19" 25 "Aux PUD20" 26 "Aux PUD21" 27 "Aux PUD22" 28 "Aux PUD23" 29 "Aux PUD24" 30 "Aux PUD25" DEFAULT_VALUE "UNKNOWN" /end COMPU_VTAB
/begin CHARACTERISTIC PAUX8_ena "{PAUX8_ena&0xff=0:Disabled}{PAUX8_ena&0xff=1:Aux PD1}{PAUX8_ena&0xff=2:Aux PD2}{PAUX8_ena&0xff=3:Aux PD3}{PAUX8_ena&0xff=4:Aux PUD1}{PAUX8_ena&0xff=5:Aux PUD2}{PAUX8_ena&0xff=6:Aux PUD3}{PAUX8_ena&0xff=7:Aux PUD4}{PAUX8_ena&0xff=8:Aux PUD5}{PAUX8_ena&0xff" VALUE 0x00147EC4 /* @ECU_Address@PAUX8_ena@0x010095C0@ */ ECIPP_ALIGNMENT_UBYTE 255 PAUX8_ena_COMPU_VTAB 0 255 BIT_MASK 0xff /end CHARACTERISTIC
/begin COMPU_METHOD PAUX8_ena_COMPU_VTAB "Verbal Table" TAB_VERB "%.0" "list" COMPU_TAB_REF PAUX8_ena_COMPU_VTAB_REF /end COMPU_METHOD
/begin COMPU_VTAB PAUX8_ena_COMPU_VTAB_REF "Verbal Table" TAB_VERB 31 0 "Disabled" 1 "Aux PD1" 2 "Aux PD2" 3 "Aux PD3" 4 "Aux PUD1" 5 "Aux PUD2" 6 "Aux PUD3" 7 "Aux PUD4" 8 "Aux PUD5" 9 "Aux PUD6" 10 "Aux PUD7" 11 "Aux PUD8" 12 "Aux PUD9" 13 "Aux PUD10" 14 "Aux PUD11" 15 "Aux PUD12" 16 "Aux PUD13" 17 "Aux PUD14" 18 "Aux PUD15" 19 "CAN sourced" 20 "FPP2 Input" 21 "Aux PUD16" 22 "Aux PUD17" 23 "Aux PUD18" 24 "Aux PUD19" 25 "Aux PUD20" 26 "Aux PUD21" 27 "Aux PUD22" 28 "Aux PUD23" 29 "Aux PUD24" 30 "Aux PUD25" DEFAULT_VALUE "UNKNOWN" /end COMPU_VTAB
/begin CHARACTERISTIC TAUX1_ena "{TAUX1_ena&0xff=0:Disabled}{TAUX1_ena&0xff=1:Aux PU1}{TAUX1_ena&0xff=2:Aux PU2}{TAUX1_ena&0xff=3:Aux PU3}{TAUX1_ena&0xff=4:Aux PUD1}{TAUX1_ena&0xff=5:Aux PUD2}{TAUX1_ena&0xff=6:Aux PUD3}{TAUX1_ena&0xff=7:EGT Input}{TAUX1_ena&0xff=8:Aux PUD4}{TAUX1_ena&0xf" VALUE 0x00148077 /* @ECU_Address@TAUX1_ena@0x01009648@ */ ECIPP_ALIGNMENT_UBYTE 255 TAUX1_ena_COMPU_VTAB 0 255 BIT_MASK 0xff /end CHARACTERISTIC
/begin COMPU_METHOD TAUX1_ena_COMPU_VTAB "Verbal Table" TAB_VERB "%.0" "list" COMPU_TAB_REF TAUX1_ena_COMPU_VTAB_REF /end COMPU_METHOD
/begin COMPU_VTAB TAUX1_ena_COMPU_VTAB_REF "Verbal Table" TAB_VERB 31 0 "Disabled" 1 "Aux PU1" 2 "Aux PU2" 3 "Aux PU3" 4 "Aux PUD1" 5 "Aux PUD2" 6 "Aux PUD3" 7 "EGT Input" 8 "Aux PUD4" 9 "Aux PUD5" 10 "Aux PUD6" 11 "Aux PUD7" 12 "Aux PUD8" 13 "Aux PUD9" 14 "Aux PUD10" 15 "Aux PUD11" 16 "Aux PUD12" 17 "Aux PUD13" 18 "Aux PUD14" 19 "Aux PUD15" 20 "Aux PUD16" 21 "Aux PUD17" 22 "Aux PUD18" 23 "Aux PUD19" 24 "Aux PUD20" 25 "Aux PUD21" 26 "Aux PUD22" 27 "Aux PUD23" 28 "Aux PUD24" 29 "Aux PUD25" 30 "CAN sourced" DEFAULT_VALUE "UNKNOWN" /end COMPU_VTAB
/begin CHARACTERISTIC TAUX2_ena "{TAUX2_ena&0xff=0:Disabled}{TAUX2_ena&0xff=1:Aux PU1}{TAUX2_ena&0xff=2:Aux PU2}{TAUX2_ena&0xff=3:Aux PU3}{TAUX2_ena&0xff=4:Aux PUD1}{TAUX2_ena&0xff=5:Aux PUD2}{TAUX2_ena&0xff=6:Aux PUD3}{TAUX2_ena&0xff=7:EGT Input}{TAUX2_ena&0xff=8:Aux PUD4}{TAUX2_ena&0xf" VALUE 0x00148078 /* @ECU_Address@TAUX2_ena@0x01009650@ */ ECIPP_ALIGNMENT_UBYTE 255 TAUX2_ena_COMPU_VTAB 0 255 BIT_MASK 0xff /end CHARACTERISTIC
/begin COMPU_METHOD TAUX2_ena_COMPU_VTAB "Verbal Table" TAB_VERB "%.0" "list" COMPU_TAB_REF TAUX2_ena_COMPU_VTAB_REF /end COMPU_METHOD
/begin COMPU_VTAB TAUX2_ena_COMPU_VTAB_REF "Verbal Table" TAB_VERB 31 0 "Disabled" 1 "Aux PU1" 2 "Aux PU2" 3 "Aux PU3" 4 "Aux PUD1" 5 "Aux PUD2" 6 "Aux PUD3" 7 "EGT Input" 8 "Aux PUD4" 9 "Aux PUD5" 10 "Aux PUD6" 11 "Aux PUD7" 12 "Aux PUD8" 13 "Aux PUD9" 14 "Aux PUD10" 15 "Aux PUD11" 16 "Aux PUD12" 17 "Aux PUD13" 18 "Aux PUD14" 19 "Aux PUD15" 20 "Aux PUD16" 21 "Aux PUD17" 22 "Aux PUD18" 23 "Aux PUD19" 24 "Aux PUD20" 25 "Aux PUD21" 26 "Aux PUD22" 27 "Aux PUD23" 28 "Aux PUD24" 29 "Aux PUD25" 30 "CAN sourced" DEFAULT_VALUE "UNKNOWN" /end COMPU_VTAB
/begin CHARACTERISTIC TAUX3_ena "{TAUX3_ena&0xff=0:Disabled}{TAUX3_ena&0xff=1:Aux PU1}{TAUX3_ena&0xff=2:Aux PU2}{TAUX3_ena&0xff=3:Aux PU3}{TAUX3_ena&0xff=4:Aux PUD1}{TAUX3_ena&0xff=5:Aux PUD2}{TAUX3_ena&0xff=6:Aux PUD3}{TAUX3_ena&0xff=7:EGT Input}{TAUX3_ena&0xff=8:Aux PUD4}{TAUX3_ena&0xf" VALUE 0x00148079 /* @ECU_Address@TAUX3_ena@0x01009658@ */ ECIPP_ALIGNMENT_UBYTE 255 TAUX3_ena_COMPU_VTAB 0 255 BIT_MASK 0xff /end CHARACTERISTIC
/begin COMPU_METHOD TAUX3_ena_COMPU_VTAB "Verbal Table" TAB_VERB "%.0" "list" COMPU_TAB_REF TAUX3_ena_COMPU_VTAB_REF /end COMPU_METHOD
/begin COMPU_VTAB TAUX3_ena_COMPU_VTAB_REF "Verbal Table" TAB_VERB 31 0 "Disabled" 1 "Aux PU1" 2 "Aux PU2" 3 "Aux PU3" 4 "Aux PUD1" 5 "Aux PUD2" 6 "Aux PUD3" 7 "EGT Input" 8 "Aux PUD4" 9 "Aux PUD5" 10 "Aux PUD6" 11 "Aux PUD7" 12 "Aux PUD8" 13 "Aux PUD9" 14 "Aux PUD10" 15 "Aux PUD11" 16 "Aux PUD12" 17 "Aux PUD13" 18 "Aux PUD14" 19 "Aux PUD15" 20 "Aux PUD16" 21 "Aux PUD17" 22 "Aux PUD18" 23 "Aux PUD19" 24 "Aux PUD20" 25 "Aux PUD21" 26 "Aux PUD22" 27 "Aux PUD23" 28 "Aux PUD24" 29 "Aux PUD25" 30 "CAN sourced" DEFAULT_VALUE "UNKNOWN" /end COMPU_VTAB
/begin CHARACTERISTIC TAUX4_ena "{TAUX4_ena&0xff=0:Disabled}{TAUX4_ena&0xff=1:Aux PU1}{TAUX4_ena&0xff=2:Aux PU2}{TAUX4_ena&0xff=3:Aux PU3}{TAUX4_ena&0xff=4:Aux PUD1}{TAUX4_ena&0xff=5:Aux PUD2}{TAUX4_ena&0xff=6:Aux PUD3}{TAUX4_ena&0xff=7:EGT Input}{TAUX4_ena&0xff=8:Aux PUD4}{TAUX4_ena&0xf" VALUE 0x0014807A /* @ECU_Address@TAUX4_ena@0x01009660@ */ ECIPP_ALIGNMENT_UBYTE 255 TAUX4_ena_COMPU_VTAB 0 255 BIT_MASK 0xff /end CHARACTERISTIC
/begin COMPU_METHOD TAUX4_ena_COMPU_VTAB "Verbal Table" TAB_VERB "%.0" "list" COMPU_TAB_REF TAUX4_ena_COMPU_VTAB_REF /end COMPU_METHOD
/begin COMPU_VTAB TAUX4_ena_COMPU_VTAB_REF "Verbal Table" TAB_VERB 31 0 "Disabled" 1 "Aux PU1" 2 "Aux PU2" 3 "Aux PU3" 4 "Aux PUD1" 5 "Aux PUD2" 6 "Aux PUD3" 7 "EGT Input" 8 "Aux PUD4" 9 "Aux PUD5" 10 "Aux PUD6" 11 "Aux PUD7" 12 "Aux PUD8" 13 "Aux PUD9" 14 "Aux PUD10" 15 "Aux PUD11" 16 "Aux PUD12" 17 "Aux PUD13" 18 "Aux PUD14" 19 "Aux PUD15" 20 "Aux PUD16" 21 "Aux PUD17" 22 "Aux PUD18" 23 "Aux PUD19" 24 "Aux PUD20" 25 "Aux PUD21" 26 "Aux PUD22" 27 "Aux PUD23" 28 "Aux PUD24" 29 "Aux PUD25" 30 "CAN sourced" DEFAULT_VALUE "UNKNOWN" /end COMPU_VTAB
/begin CHARACTERISTIC TAUX5_ena "{TAUX5_ena&0xff=0:Disabled}{TAUX5_ena&0xff=1:Aux PU1}{TAUX5_ena&0xff=2:Aux PU2}{TAUX5_ena&0xff=3:Aux PU3}{TAUX5_ena&0xff=4:Aux PUD1}{TAUX5_ena&0xff=5:Aux PUD2}{TAUX5_ena&0xff=6:Aux PUD3}{TAUX5_ena&0xff=7:EGT Input}{TAUX5_ena&0xff=8:Aux PUD4}{TAUX5_ena&0xf" VALUE 0x0014807B /* @ECU_Address@TAUX5_ena@0x01009668@ */ ECIPP_ALIGNMENT_UBYTE 255 TAUX5_ena_COMPU_VTAB 0 255 BIT_MASK 0xff /end CHARACTERISTIC
/begin COMPU_METHOD TAUX5_ena_COMPU_VTAB "Verbal Table" TAB_VERB "%.0" "list" COMPU_TAB_REF TAUX5_ena_COMPU_VTAB_REF /end COMPU_METHOD
/begin COMPU_VTAB TAUX5_ena_COMPU_VTAB_REF "Verbal Table" TAB_VERB 31 0 "Disabled" 1 "Aux PU1" 2 "Aux PU2" 3 "Aux PU3" 4 "Aux PUD1" 5 "Aux PUD2" 6 "Aux PUD3" 7 "EGT Input" 8 "Aux PUD4" 9 "Aux PUD5" 10 "Aux PUD6" 11 "Aux PUD7" 12 "Aux PUD8" 13 "Aux PUD9" 14 "Aux PUD10" 15 "Aux PUD11" 16 "Aux PUD12" 17 "Aux PUD13" 18 "Aux PUD14" 19 "Aux PUD15" 20 "Aux PUD16" 21 "Aux PUD17" 22 "Aux PUD18" 23 "Aux PUD19" 24 "Aux PUD20" 25 "Aux PUD21" 26 "Aux PUD22" 27 "Aux PUD23" 28 "Aux PUD24" 29 "Aux PUD25" 30 "CAN sourced" DEFAULT_VALUE "UNKNOWN" /end COMPU_VTAB
/begin CHARACTERISTIC TAUX6_ena "{TAUX6_ena&0xff=0:Disabled}{TAUX6_ena&0xff=1:Aux PU1}{TAUX6_ena&0xff=2:Aux PU2}{TAUX6_ena&0xff=3:Aux PU3}{TAUX6_ena&0xff=4:Aux PUD1}{TAUX6_ena&0xff=5:Aux PUD2}{TAUX6_ena&0xff=6:Aux PUD3}{TAUX6_ena&0xff=7:EGT Input}{TAUX6_ena&0xff=8:Aux PUD4}{TAUX6_ena&0xf" VALUE 0x0014807C /* @ECU_Address@TAUX6_ena@0x01009670@ */ ECIPP_ALIGNMENT_UBYTE 255 TAUX6_ena_COMPU_VTAB 0 255 BIT_MASK 0xff /end CHARACTERISTIC
/begin COMPU_METHOD TAUX6_ena_COMPU_VTAB "Verbal Table" TAB_VERB "%.0" "list" COMPU_TAB_REF TAUX6_ena_COMPU_VTAB_REF /end COMPU_METHOD
/begin COMPU_VTAB TAUX6_ena_COMPU_VTAB_REF "Verbal Table" TAB_VERB 31 0 "Disabled" 1 "Aux PU1" 2 "Aux PU2" 3 "Aux PU3" 4 "Aux PUD1" 5 "Aux PUD2" 6 "Aux PUD3" 7 "EGT Input" 8 "Aux PUD4" 9 "Aux PUD5" 10 "Aux PUD6" 11 "Aux PUD7" 12 "Aux PUD8" 13 "Aux PUD9" 14 "Aux PUD10" 15 "Aux PUD11" 16 "Aux PUD12" 17 "Aux PUD13" 18 "Aux PUD14" 19 "Aux PUD15" 20 "Aux PUD16" 21 "Aux PUD17" 22 "Aux PUD18" 23 "Aux PUD19" 24 "Aux PUD20" 25 "Aux PUD21" 26 "Aux PUD22" 27 "Aux PUD23" 28 "Aux PUD24" 29 "Aux PUD25" 30 "CAN sourced" DEFAULT_VALUE "UNKNOWN" /end COMPU_VTAB
/begin CHARACTERISTIC TAUX7_ena "{TAUX7_ena&0xff=0:Disabled}{TAUX7_ena&0xff=1:Aux PU1}{TAUX7_ena&0xff=2:Aux PU2}{TAUX7_ena&0xff=3:Aux PU3}{TAUX7_ena&0xff=4:Aux PUD1}{TAUX7_ena&0xff=5:Aux PUD2}{TAUX7_ena&0xff=6:Aux PUD3}{TAUX7_ena&0xff=7:EGT Input}{TAUX7_ena&0xff=8:Aux PUD4}{TAUX7_ena&0xf" VALUE 0x0014807D /* @ECU_Address@TAUX7_ena@0x01009678@ */ ECIPP_ALIGNMENT_UBYTE 255 TAUX7_ena_COMPU_VTAB 0 255 BIT_MASK 0xff /end CHARACTERISTIC
/begin COMPU_METHOD TAUX7_ena_COMPU_VTAB "Verbal Table" TAB_VERB "%.0" "list" COMPU_TAB_REF TAUX7_ena_COMPU_VTAB_REF /end COMPU_METHOD
/begin COMPU_VTAB TAUX7_ena_COMPU_VTAB_REF "Verbal Table" TAB_VERB 31 0 "Disabled" 1 "Aux PU1" 2 "Aux PU2" 3 "Aux PU3" 4 "Aux PUD1" 5 "Aux PUD2" 6 "Aux PUD3" 7 "EGT Input" 8 "Aux PUD4" 9 "Aux PUD5" 10 "Aux PUD6" 11 "Aux PUD7" 12 "Aux PUD8" 13 "Aux PUD9" 14 "Aux PUD10" 15 "Aux PUD11" 16 "Aux PUD12" 17 "Aux PUD13" 18 "Aux PUD14" 19 "Aux PUD15" 20 "Aux PUD16" 21 "Aux PUD17" 22 "Aux PUD18" 23 "Aux PUD19" 24 "Aux PUD20" 25 "Aux PUD21" 26 "Aux PUD22" 27 "Aux PUD23" 28 "Aux PUD24" 29 "Aux PUD25" 30 "CAN sourced" DEFAULT_VALUE "UNKNOWN" /end COMPU_VTAB
/begin CHARACTERISTIC TAUX8_ena "{TAUX8_ena&0xff=0:Disabled}{TAUX8_ena&0xff=1:Aux PU1}{TAUX8_ena&0xff=2:Aux PU2}{TAUX8_ena&0xff=3:Aux PU3}{TAUX8_ena&0xff=4:Aux PUD1}{TAUX8_ena&0xff=5:Aux PUD2}{TAUX8_ena&0xff=6:Aux PUD3}{TAUX8_ena&0xff=7:EGT Input}{TAUX8_ena&0xff=8:Aux PUD4}{TAUX8_ena&0xf" VALUE 0x0014807E /* @ECU_Address@TAUX8_ena@0x01009680@ */ ECIPP_ALIGNMENT_UBYTE 255 TAUX8_ena_COMPU_VTAB 0 255 BIT_MASK 0xff /end CHARACTERISTIC
/begin COMPU_METHOD TAUX8_ena_COMPU_VTAB "Verbal Table" TAB_VERB "%.0" "list" COMPU_TAB_REF TAUX8_ena_COMPU_VTAB_REF /end COMPU_METHOD
/begin COMPU_VTAB TAUX8_ena_COMPU_VTAB_REF "Verbal Table" TAB_VERB 31 0 "Disabled" 1 "Aux PU1" 2 "Aux PU2" 3 "Aux PU3" 4 "Aux PUD1" 5 "Aux PUD2" 6 "Aux PUD3" 7 "EGT Input" 8 "Aux PUD4" 9 "Aux PUD5" 10 "Aux PUD6" 11 "Aux PUD7" 12 "Aux PUD8" 13 "Aux PUD9" 14 "Aux PUD10" 15 "Aux PUD11" 16 "Aux PUD12" 17 "Aux PUD13" 18 "Aux PUD14" 19 "Aux PUD15" 20 "Aux PUD16" 21 "Aux PUD17" 22 "Aux PUD18" 23 "Aux PUD19" 24 "Aux PUD20" 25 "Aux PUD21" 26 "Aux PUD22" 27 "Aux PUD23" 28 "Aux PUD24" 29 "Aux PUD25" 30 "CAN sourced" DEFAULT_VALUE "UNKNOWN" /end COMPU_VTAB
/begin CHARACTERISTIC TAUX1_Taux_cal "{TAUX1_Taux_cal&0xff=0:Fuel source}{TAUX1_Taux_cal&0xff=1:Exhaust manifold/riser}{TAUX1_Taux_cal&0xff=2:Aux Temp A}{TAUX1_Taux_cal&0xff=3:Aux Temp B}{TAUX1_Taux_cal&0xff=4:Aux Temp C}{TAUX1_Taux_cal&0xff=5:Aux Temp D}" VALUE 0x00148067 /* @ECU_Address@TAUX1_Taux_cal@0x01009688@ */ ECIPP_ALIGNMENT_UBYTE 255 TAUX1_Taux_cal_COMPU_VTAB 0 255 BIT_MASK 0xff /end CHARACTERISTIC
/begin COMPU_METHOD TAUX1_Taux_cal_COMPU_VTAB "Verbal Table" TAB_VERB "%.0" "list" COMPU_TAB_REF TAUX1_Taux_cal_COMPU_VTAB_REF /end COMPU_METHOD
/begin COMPU_VTAB TAUX1_Taux_cal_COMPU_VTAB_REF "Verbal Table" TAB_VERB 6 0 "Fuel source" 1 "Exhaust manifold/riser" 2 "Aux Temp A" 3 "Aux Temp B" 4 "Aux Temp C" 5 "Aux Temp D" DEFAULT_VALUE "UNKNOWN" /end COMPU_VTAB
/begin CHARACTERISTIC TAUX2_Taux_cal "{TAUX2_Taux_cal&0xff=0:Fuel source}{TAUX2_Taux_cal&0xff=1:Exhaust manifold/riser}{TAUX2_Taux_cal&0xff=2:Aux Temp A}{TAUX2_Taux_cal&0xff=3:Aux Temp B}{TAUX2_Taux_cal&0xff=4:Aux Temp C}{TAUX2_Taux_cal&0xff=5:Aux Temp D}" VALUE 0x00148068 /* @ECU_Address@TAUX2_Taux_cal@0x01009690@ */ ECIPP_ALIGNMENT_UBYTE 255 TAUX2_Taux_cal_COMPU_VTAB 0 255 BIT_MASK 0xff /end CHARACTERISTIC
/begin COMPU_METHOD TAUX2_Taux_cal_COMPU_VTAB "Verbal Table" TAB_VERB "%.0" "list" COMPU_TAB_REF TAUX2_Taux_cal_COMPU_VTAB_REF /end COMPU_METHOD
/begin COMPU_VTAB TAUX2_Taux_cal_COMPU_VTAB_REF "Verbal Table" TAB_VERB 6 0 "Fuel source" 1 "Exhaust manifold/riser" 2 "Aux Temp A" 3 "Aux Temp B" 4 "Aux Temp C" 5 "Aux Temp D" DEFAULT_VALUE "UNKNOWN" /end COMPU_VTAB
/begin CHARACTERISTIC TAUX3_Taux_cal "{TAUX3_Taux_cal&0xff=0:Fuel source}{TAUX3_Taux_cal&0xff=1:Exhaust manifold/riser}{TAUX3_Taux_cal&0xff=2:Aux Temp A}{TAUX3_Taux_cal&0xff=3:Aux Temp B}{TAUX3_Taux_cal&0xff=4:Aux Temp C}{TAUX3_Taux_cal&0xff=5:Aux Temp D}" VALUE 0x00148069 /* @ECU_Address@TAUX3_Taux_cal@0x01009698@ */ ECIPP_ALIGNMENT_UBYTE 255 TAUX3_Taux_cal_COMPU_VTAB 0 255 BIT_MASK 0xff /end CHARACTERISTIC
/begin COMPU_METHOD TAUX3_Taux_cal_COMPU_VTAB "Verbal Table" TAB_VERB "%.0" "list" COMPU_TAB_REF TAUX3_Taux_cal_COMPU_VTAB_REF /end COMPU_METHOD
/begin COMPU_VTAB TAUX3_Taux_cal_COMPU_VTAB_REF "Verbal Table" TAB_VERB 6 0 "Fuel source" 1 "Exhaust manifold/riser" 2 "Aux Temp A" 3 "Aux Temp B" 4 "Aux Temp C" 5 "Aux Temp D" DEFAULT_VALUE "UNKNOWN" /end COMPU_VTAB
/begin CHARACTERISTIC TAUX4_Taux_cal "{TAUX4_Taux_cal&0xff=0:Fuel source}{TAUX4_Taux_cal&0xff=1:Exhaust manifold/riser}{TAUX4_Taux_cal&0xff=2:Aux Temp A}{TAUX4_Taux_cal&0xff=3:Aux Temp B}{TAUX4_Taux_cal&0xff=4:Aux Temp C}{TAUX4_Taux_cal&0xff=5:Aux Temp D}" VALUE 0x0014806A /* @ECU_Address@TAUX4_Taux_cal@0x010096A0@ */ ECIPP_ALIGNMENT_UBYTE 255 TAUX4_Taux_cal_COMPU_VTAB 0 255 BIT_MASK 0xff /end CHARACTERISTIC
/begin COMPU_METHOD TAUX4_Taux_cal_COMPU_VTAB "Verbal Table" TAB_VERB "%.0" "list" COMPU_TAB_REF TAUX4_Taux_cal_COMPU_VTAB_REF /end COMPU_METHOD
/begin COMPU_VTAB TAUX4_Taux_cal_COMPU_VTAB_REF "Verbal Table" TAB_VERB 6 0 "Fuel source" 1 "Exhaust manifold/riser" 2 "Aux Temp A" 3 "Aux Temp B" 4 "Aux Temp C" 5 "Aux Temp D" DEFAULT_VALUE "UNKNOWN" /end COMPU_VTAB
/begin CHARACTERISTIC TAUX5_Taux_cal "{TAUX5_Taux_cal&0xff=0:Fuel source}{TAUX5_Taux_cal&0xff=1:Exhaust manifold/riser}{TAUX5_Taux_cal&0xff=2:Aux Temp A}{TAUX5_Taux_cal&0xff=3:Aux Temp B}{TAUX5_Taux_cal&0xff=4:Aux Temp C}{TAUX5_Taux_cal&0xff=5:Aux Temp D}" VALUE 0x0014806B /* @ECU_Address@TAUX5_Taux_cal@0x010096A8@ */ ECIPP_ALIGNMENT_UBYTE 255 TAUX5_Taux_cal_COMPU_VTAB 0 255 BIT_MASK 0xff /end CHARACTERISTIC
/begin COMPU_METHOD TAUX5_Taux_cal_COMPU_VTAB "Verbal Table" TAB_VERB "%.0" "list" COMPU_TAB_REF TAUX5_Taux_cal_COMPU_VTAB_REF /end COMPU_METHOD
/begin COMPU_VTAB TAUX5_Taux_cal_COMPU_VTAB_REF "Verbal Table" TAB_VERB 6 0 "Fuel source" 1 "Exhaust manifold/riser" 2 "Aux Temp A" 3 "Aux Temp B" 4 "Aux Temp C" 5 "Aux Temp D" DEFAULT_VALUE "UNKNOWN" /end COMPU_VTAB
/begin CHARACTERISTIC TAUX6_Taux_cal "{TAUX6_Taux_cal&0xff=0:Fuel source}{TAUX6_Taux_cal&0xff=1:Exhaust manifold/riser}{TAUX6_Taux_cal&0xff=2:Aux Temp A}{TAUX6_Taux_cal&0xff=3:Aux Temp B}{TAUX6_Taux_cal&0xff=4:Aux Temp C}{TAUX6_Taux_cal&0xff=5:Aux Temp D}" VALUE 0x0014806C /* @ECU_Address@TAUX6_Taux_cal@0x010096B0@ */ ECIPP_ALIGNMENT_UBYTE 255 TAUX6_Taux_cal_COMPU_VTAB 0 255 BIT_MASK 0xff /end CHARACTERISTIC
/begin COMPU_METHOD TAUX6_Taux_cal_COMPU_VTAB "Verbal Table" TAB_VERB "%.0" "list" COMPU_TAB_REF TAUX6_Taux_cal_COMPU_VTAB_REF /end COMPU_METHOD
/begin COMPU_VTAB TAUX6_Taux_cal_COMPU_VTAB_REF "Verbal Table" TAB_VERB 6 0 "Fuel source" 1 "Exhaust manifold/riser" 2 "Aux Temp A" 3 "Aux Temp B" 4 "Aux Temp C" 5 "Aux Temp D" DEFAULT_VALUE "UNKNOWN" /end COMPU_VTAB
/begin CHARACTERISTIC TAUX7_Taux_cal "{TAUX7_Taux_cal&0xff=0:Fuel source}{TAUX7_Taux_cal&0xff=1:Exhaust manifold/riser}{TAUX7_Taux_cal&0xff=2:Aux Temp A}{TAUX7_Taux_cal&0xff=3:Aux Temp B}{TAUX7_Taux_cal&0xff=4:Aux Temp C}{TAUX7_Taux_cal&0xff=5:Aux Temp D}" VALUE 0x0014806D /* @ECU_Address@TAUX7_Taux_cal@0x010096B8@ */ ECIPP_ALIGNMENT_UBYTE 255 TAUX7_Taux_cal_COMPU_VTAB 0 255 BIT_MASK 0xff /end CHARACTERISTIC
/begin COMPU_METHOD TAUX7_Taux_cal_COMPU_VTAB "Verbal Table" TAB_VERB "%.0" "list" COMPU_TAB_REF TAUX7_Taux_cal_COMPU_VTAB_REF /end COMPU_METHOD
/begin COMPU_VTAB TAUX7_Taux_cal_COMPU_VTAB_REF "Verbal Table" TAB_VERB 6 0 "Fuel source" 1 "Exhaust manifold/riser" 2 "Aux Temp A" 3 "Aux Temp B" 4 "Aux Temp C" 5 "Aux Temp D" DEFAULT_VALUE "UNKNOWN" /end COMPU_VTAB
/begin CHARACTERISTIC TAUX8_Taux_cal "{TAUX8_Taux_cal&0xff=0:Fuel source}{TAUX8_Taux_cal&0xff=1:Exhaust manifold/riser}{TAUX8_Taux_cal&0xff=2:Aux Temp A}{TAUX8_Taux_cal&0xff=3:Aux Temp B}{TAUX8_Taux_cal&0xff=4:Aux Temp C}{TAUX8_Taux_cal&0xff=5:Aux Temp D}" VALUE 0x0014806E /* @ECU_Address@TAUX8_Taux_cal@0x010096C0@ */ ECIPP_ALIGNMENT_UBYTE 255 TAUX8_Taux_cal_COMPU_VTAB 0 255 BIT_MASK 0xff /end CHARACTERISTIC
/begin COMPU_METHOD TAUX8_Taux_cal_COMPU_VTAB "Verbal Table" TAB_VERB "%.0" "list" COMPU_TAB_REF TAUX8_Taux_cal_COMPU_VTAB_REF /end COMPU_METHOD
/begin COMPU_VTAB TAUX8_Taux_cal_COMPU_VTAB_REF "Verbal Table" TAB_VERB 6 0 "Fuel source" 1 "Exhaust manifold/riser" 2 "Aux Temp A" 3 "Aux Temp B" 4 "Aux Temp C" 5 "Aux Temp D" DEFAULT_VALUE "UNKNOWN" /end COMPU_VTAB
/begin CHARACTERISTIC TAUX1_vdr "IOConfig # TAUX1_vdr" VALUE 0x00143A24 /* @ECU_Address@TAUX1_vdr@0x010096C8@ */ ECIPP_ALIGNMENT_FLOAT32_IEEE 10000000000 Compu_TAUX1_vdr -10000000000 10000000000 /end CHARACTERISTIC
/begin COMPU_METHOD Compu_TAUX1_vdr " " RAT_FUNC "%.3" "ohms" COEFFS 0 1 0 0 0 1 /end COMPU_METHOD
/begin CHARACTERISTIC TAUX2_vdr "IOConfig # TAUX2_vdr" VALUE 0x00143A28 /* @ECU_Address@TAUX2_vdr@0x010096D0@ */ ECIPP_ALIGNMENT_FLOAT32_IEEE 10000000000 Compu_TAUX2_vdr -10000000000 10000000000 /end CHARACTERISTIC
/begin COMPU_METHOD Compu_TAUX2_vdr " " RAT_FUNC "%.3" "ohms" COEFFS 0 1 0 0 0 1 /end COMPU_METHOD
/begin CHARACTERISTIC TAUX3_vdr "IOConfig # TAUX3_vdr" VALUE 0x00143A2C /* @ECU_Address@TAUX3_vdr@0x010096D8@ */ ECIPP_ALIGNMENT_FLOAT32_IEEE 10000000000 Compu_TAUX3_vdr -10000000000 10000000000 /end CHARACTERISTIC
/begin COMPU_METHOD Compu_TAUX3_vdr " " RAT_FUNC "%.3" "ohms" COEFFS 0 1 0 0 0 1 /end COMPU_METHOD
/begin CHARACTERISTIC TAUX4_vdr "IOConfig # TAUX4_vdr" VALUE 0x00143A30 /* @ECU_Address@TAUX4_vdr@0x010096E0@ */ ECIPP_ALIGNMENT_FLOAT32_IEEE 10000000000 Compu_TAUX4_vdr -10000000000 10000000000 /end CHARACTERISTIC
/begin COMPU_METHOD Compu_TAUX4_vdr " " RAT_FUNC "%.3" "ohms" COEFFS 0 1 0 0 0 1 /end COMPU_METHOD
/begin CHARACTERISTIC TAUX5_vdr "IOConfig # TAUX5_vdr" VALUE 0x00143A34 /* @ECU_Address@TAUX5_vdr@0x010096E8@ */ ECIPP_ALIGNMENT_FLOAT32_IEEE 10000000000 Compu_TAUX5_vdr -10000000000 10000000000 /end CHARACTERISTIC
/begin COMPU_METHOD Compu_TAUX5_vdr " " RAT_FUNC "%.3" "ohms" COEFFS 0 1 0 0 0 1 /end COMPU_METHOD
/begin CHARACTERISTIC TAUX6_vdr "IOConfig # TAUX6_vdr" VALUE 0x00143A38 /* @ECU_Address@TAUX6_vdr@0x010096F0@ */ ECIPP_ALIGNMENT_FLOAT32_IEEE 10000000000 Compu_TAUX6_vdr -10000000000 10000000000 /end CHARACTERISTIC
/begin COMPU_METHOD Compu_TAUX6_vdr " " RAT_FUNC "%.3" "ohms" COEFFS 0 1 0 0 0 1 /end COMPU_METHOD
/begin CHARACTERISTIC TAUX7_vdr "IOConfig # TAUX7_vdr" VALUE 0x00143A3C /* @ECU_Address@TAUX7_vdr@0x010096F8@ */ ECIPP_ALIGNMENT_FLOAT32_IEEE 10000000000 Compu_TAUX7_vdr -10000000000 10000000000 /end CHARACTERISTIC
/begin COMPU_METHOD Compu_TAUX7_vdr " " RAT_FUNC "%.3" "ohms" COEFFS 0 1 0 0 0 1 /end COMPU_METHOD
/begin CHARACTERISTIC TAUX8_vdr "IOConfig # TAUX8_vdr" VALUE 0x00143A40 /* @ECU_Address@TAUX8_vdr@0x01009700@ */ ECIPP_ALIGNMENT_FLOAT32_IEEE 10000000000 Compu_TAUX8_vdr -10000000000 10000000000 /end CHARACTERISTIC
/begin COMPU_METHOD Compu_TAUX8_vdr " " RAT_FUNC "%.3" "ohms" COEFFS 0 1 0 0 0 1 /end COMPU_METHOD
/begin CHARACTERISTIC EGR_clr_Tint_tau_nom "Air # EGR_clr_Tint_tau_nom" VALUE 0x00140068 /* @ECU_Address@EGR_clr_Tint_tau_nom@0x01009828@ */ ECIPP_ALIGNMENT_FLOAT32_IEEE 10000000000 Compu_EGR_clr_Tint_tau_nom -10000000000 10000000000 /end CHARACTERISTIC
/begin COMPU_METHOD Compu_EGR_clr_Tint_tau_nom " " RAT_FUNC "%.3" "sec" COEFFS 0 1000 0 0 0 1 /end COMPU_METHOD
/begin CHARACTERISTIC TC_comp_Tint_tau_nom "Air # TC_comp_Tint_tau_nom" VALUE 0x00143a7c /* @ECU_Address@TC_comp_Tint_tau_nom@0x01009830@ */ ECIPP_ALIGNMENT_FLOAT32_IEEE 10000000000 Compu_TC_comp_Tint_tau_nom -10000000000 10000000000 /end CHARACTERISTIC
/begin COMPU_METHOD Compu_TC_comp_Tint_tau_nom " " RAT_FUNC "%.3" "sec" COEFFS 0 1000 0 0 0 1 /end COMPU_METHOD
/begin CHARACTERISTIC TC_turb_Tint_tau_nom "Air # TC_turb_Tint_tau_nom" VALUE 0x00143a8c /* @ECU_Address@TC_turb_Tint_tau_nom@0x01009838@ */ ECIPP_ALIGNMENT_FLOAT32_IEEE 10000000000 Compu_TC_turb_Tint_tau_nom -10000000000 10000000000 /end CHARACTERISTIC
/begin COMPU_METHOD Compu_TC_turb_Tint_tau_nom " " RAT_FUNC "%.3" "sec" COEFFS 0 1000 0 0 0 1 /end COMPU_METHOD
/begin CHARACTERISTIC TC_comp_A_emiss "Air # TC_comp_A_emiss" VALUE 0x00143a74 /* @ECU_Address@TC_comp_A_emiss@0x01009858@ */ ECIPP_ALIGNMENT_FLOAT32_IEEE 10000000000 Compu_TC_comp_A_emiss -10000000000 10000000000 /end CHARACTERISTIC
/begin COMPU_METHOD Compu_TC_comp_A_emiss " " RAT_FUNC "%.3" "in^2" COEFFS 0 1 0 0 0 1 /end COMPU_METHOD
/begin CHARACTERISTIC TC_turb_A_emiss "Air # TC_turb_A_emiss" VALUE 0x00143a84 /* @ECU_Address@TC_turb_A_emiss@0x01009860@ */ ECIPP_ALIGNMENT_FLOAT32_IEEE 10000000000 Compu_TC_turb_A_emiss -10000000000 10000000000 /end CHARACTERISTIC
/begin COMPU_METHOD Compu_TC_turb_A_emiss " " RAT_FUNC "%.3" "in^2" COEFFS 0 1 0 0 0 1 /end COMPU_METHOD
/begin CHARACTERISTIC TC_comp_C_thermal "Air # TC_comp_C_thermal" VALUE 0x00143a78 /* @ECU_Address@TC_comp_C_thermal@0x01009868@ */ ECIPP_ALIGNMENT_FLOAT32_IEEE 10000000000 Compu_TC_comp_C_thermal -10000000000 10000000000 /end CHARACTERISTIC
/begin COMPU_METHOD Compu_TC_comp_C_thermal " " RAT_FUNC "%.3" "J/deg F" COEFFS 0 1 0 0 0 1 /end COMPU_METHOD
/begin CHARACTERISTIC TC_turb_C_thermal "Air # TC_turb_C_thermal" VALUE 0x00143a88 /* @ECU_Address@TC_turb_C_thermal@0x01009870@ */ ECIPP_ALIGNMENT_FLOAT32_IEEE 10000000000 Compu_TC_turb_C_thermal -10000000000 10000000000 /end CHARACTERISTIC
/begin COMPU_METHOD Compu_TC_turb_C_thermal " " RAT_FUNC "%.3" "J/deg F" COEFFS 0 1 0 0 0 1 /end COMPU_METHOD
/begin CHARACTERISTIC APS_learn_idle_lim "General # APS_learn_idle_lim" VALUE 0x00148EDC /* @ECU_Address@APS_learn_idle_lim@0x010098F0@ */ ECIPP_ALIGNMENT_UWORD 5 Compu_APS_learn_idle_lim 0 5.00114468864469 /end CHARACTERISTIC
/begin COMPU_METHOD Compu_APS_learn_idle_lim " " RAT_FUNC "%.3" "volts" COEFFS 0 13104 0 0 0 1 /end COMPU_METHOD
/begin CHARACTERISTIC BPS_learn_idle_lim "General # BPS_learn_idle_lim" VALUE 0x00148F7C /* @ECU_Address@BPS_learn_idle_lim@0x010098F8@ */ ECIPP_ALIGNMENT_UWORD 5 Compu_BPS_learn_idle_lim 0 5.00114468864469 /end CHARACTERISTIC
/begin COMPU_METHOD Compu_BPS_learn_idle_lim " " RAT_FUNC "%.3" "volts" COEFFS 0 13104 0 0 0 1 /end COMPU_METHOD
/begin CHARACTERISTIC APS1_idle_def "IOConfig # APS1_idle_def" VALUE 0x00148EF0 /* @ECU_Address@APS1_idle_def@0x01009900@ */ ECIPP_ALIGNMENT_FLOAT32_IEEE 10000000000 Compu_APS1_idle_def -10000000000 10000000000 /end CHARACTERISTIC
/begin COMPU_METHOD Compu_APS1_idle_def " " RAT_FUNC "%.3" "volts" COEFFS 0 1 0 0 0 1 /end COMPU_METHOD
/begin CHARACTERISTIC BPS1_idle_def "IOConfig # BPS1_idle_def" VALUE 0x00148F90 /* @ECU_Address@BPS1_idle_def@0x01009908@ */ ECIPP_ALIGNMENT_FLOAT32_IEEE 10000000000 Compu_BPS1_idle_def -10000000000 10000000000 /end CHARACTERISTIC
/begin COMPU_METHOD Compu_BPS1_idle_def " " RAT_FUNC "%.3" "volts" COEFFS 0 1 0 0 0 1 /end COMPU_METHOD
/begin CHARACTERISTIC APS1_def "IOConfig # APS1_def" VALUE 0x0016C334 /* @ECU_Address@APS1_def@0x01009910@ */ ECIPP_ALIGNMENT_UWORD 5 Compu_APS1_def 0 5.00114468864469 /end CHARACTERISTIC
/begin COMPU_METHOD Compu_APS1_def " " RAT_FUNC "%.3" "volts" COEFFS 0 13104 0 0 0 1 /end COMPU_METHOD
/begin CHARACTERISTIC BPS1_def "IOConfig # BPS1_def" VALUE 0x0016C348 /* @ECU_Address@BPS1_def@0x01009918@ */ ECIPP_ALIGNMENT_UWORD 5 Compu_BPS1_def 0 5.00114468864469 /end CHARACTERISTIC
/begin COMPU_METHOD Compu_BPS1_def " " RAT_FUNC "%.3" "volts" COEFFS 0 13104 0 0 0 1 /end COMPU_METHOD
/begin CHARACTERISTIC APS1_idle_init "IOConfig # APS1_idle_init" VALUE 0x0016C33A /* @ECU_Address@APS1_idle_init@0x01009920@ */ ECIPP_ALIGNMENT_UWORD 5 Compu_APS1_idle_init 0 5.00114468864469 /end CHARACTERISTIC
/begin COMPU_METHOD Compu_APS1_idle_init " " RAT_FUNC "%.3" "volts" COEFFS 0 13104 0 0 0 1 /end COMPU_METHOD
/begin CHARACTERISTIC BPS1_idle_init "IOConfig # BPS1_idle_init" VALUE 0x0016C34E /* @ECU_Address@BPS1_idle_init@0x01009928@ */ ECIPP_ALIGNMENT_UWORD 5 Compu_BPS1_idle_init 0 5.00114468864469 /end CHARACTERISTIC
/begin COMPU_METHOD Compu_BPS1_idle_init " " RAT_FUNC "%.3" "volts" COEFFS 0 13104 0 0 0 1 /end COMPU_METHOD
/begin CHARACTERISTIC APS1_full_init "IOConfig # APS1_full_init" VALUE 0x0016C33C /* @ECU_Address@APS1_full_init@0x01009930@ */ ECIPP_ALIGNMENT_UWORD 5 Compu_APS1_full_init 0 5.00114468864469 /end CHARACTERISTIC
/begin COMPU_METHOD Compu_APS1_full_init " " RAT_FUNC "%.3" "volts" COEFFS 0 13104 0 0 0 1 /end COMPU_METHOD
/begin CHARACTERISTIC BPS1_full_init "IOConfig # BPS1_full_init" VALUE 0x0016C350 /* @ECU_Address@BPS1_full_init@0x01009938@ */ ECIPP_ALIGNMENT_UWORD 5 Compu_BPS1_full_init 0 5.00114468864469 /end CHARACTERISTIC
/begin COMPU_METHOD Compu_BPS1_full_init " " RAT_FUNC "%.3" "volts" COEFFS 0 13104 0 0 0 1 /end COMPU_METHOD
/begin CHARACTERISTIC APS1_full_def "IOConfig # APS1_full_def" VALUE 0x00148EF4 /* @ECU_Address@APS1_full_def@0x01009940@ */ ECIPP_ALIGNMENT_FLOAT32_IEEE 10000000000 Compu_APS1_full_def -10000000000 10000000000 /end CHARACTERISTIC
/begin COMPU_METHOD Compu_APS1_full_def " " RAT_FUNC "%.3" "volts" COEFFS 0 1 0 0 0 1 /end COMPU_METHOD
/begin CHARACTERISTIC BPS1_full_def "IOConfig # BPS1_full_def" VALUE 0x00148F94 /* @ECU_Address@BPS1_full_def@0x01009948@ */ ECIPP_ALIGNMENT_FLOAT32_IEEE 10000000000 Compu_BPS1_full_def -10000000000 10000000000 /end CHARACTERISTIC
/begin COMPU_METHOD Compu_BPS1_full_def " " RAT_FUNC "%.3" "volts" COEFFS 0 1 0 0 0 1 /end COMPU_METHOD
/begin CHARACTERISTIC APS_learn_full_lim "General # APS_learn_full_lim" VALUE 0x00148EE2 /* @ECU_Address@APS_learn_full_lim@0x01009950@ */ ECIPP_ALIGNMENT_UWORD 5 Compu_APS_learn_full_lim 0 5.00114468864469 /end CHARACTERISTIC
/begin COMPU_METHOD Compu_APS_learn_full_lim " " RAT_FUNC "%.3" "volts" COEFFS 0 13104 0 0 0 1 /end COMPU_METHOD
/begin CHARACTERISTIC BPS_learn_full_lim "General # BPS_learn_full_lim" VALUE 0x00148F82 /* @ECU_Address@BPS_learn_full_lim@0x01009958@ */ ECIPP_ALIGNMENT_UWORD 5 Compu_BPS_learn_full_lim 0 5.00114468864469 /end CHARACTERISTIC
/begin COMPU_METHOD Compu_BPS_learn_full_lim " " RAT_FUNC "%.3" "volts" COEFFS 0 13104 0 0 0 1 /end COMPU_METHOD
/begin CHARACTERISTIC APS1_learn_wait "IOConfig # APS1_learn_wait" VALUE 0x0016C336 /* @ECU_Address@APS1_learn_wait@0x01009960@ */ ECIPP_ALIGNMENT_SWORD 32767 Compu_APS1_learn_wait -32768 32767 /end CHARACTERISTIC
/begin COMPU_METHOD Compu_APS1_learn_wait " " RAT_FUNC "%.0" "ms" COEFFS 0 1 0 0 0 1 /end COMPU_METHOD
/begin CHARACTERISTIC BPS1_learn_wait "IOConfig # BPS1_learn_wait" VALUE 0x0016C34A /* @ECU_Address@BPS1_learn_wait@0x01009968@ */ ECIPP_ALIGNMENT_SWORD 32767 Compu_BPS1_learn_wait -32768 32767 /end CHARACTERISTIC
/begin COMPU_METHOD Compu_BPS1_learn_wait " " RAT_FUNC "%.0" "ms" COEFFS 0 1 0 0 0 1 /end COMPU_METHOD
/begin CHARACTERISTIC APS1_learn_tau "IOConfig # APS1_learn_tau" VALUE 0x0016C338 /* @ECU_Address@APS1_learn_tau@0x01009970@ */ ECIPP_ALIGNMENT_UWORD 327680 Compu_APS1_learn_tau 0.45084 327680 /end CHARACTERISTIC
/begin COMPU_METHOD Compu_APS1_learn_tau " " FORM "%.3" "ms"
 /begin FORMULA "-5 / log(1 - (X1 / 65536))" FORMULA_INV "(1 - exp(-5/X1)) * 65536" /end FORMULA
/end COMPU_METHOD
/begin CHARACTERISTIC BPS1_learn_tau "IOConfig # BPS1_learn_tau" VALUE 0x0016C34C /* @ECU_Address@BPS1_learn_tau@0x01009978@ */ ECIPP_ALIGNMENT_UWORD 327680 Compu_BPS1_learn_tau 0.45084 327680 /end CHARACTERISTIC
/begin COMPU_METHOD Compu_BPS1_learn_tau " " FORM "%.3" "ms"
 /begin FORMULA "-5 / log(1 - (X1 / 65536))" FORMULA_INV "(1 - exp(-5/X1)) * 65536" /end FORMULA
/end COMPU_METHOD
/begin CHARACTERISTIC APS2_def "IOConfig # APS2_def" VALUE 0x0016C33E /* @ECU_Address@APS2_def@0x01009980@ */ ECIPP_ALIGNMENT_UWORD 5 Compu_APS2_def 0 5.00114468864469 /end CHARACTERISTIC
/begin COMPU_METHOD Compu_APS2_def " " RAT_FUNC "%.3" "volts" COEFFS 0 13104 0 0 0 1 /end COMPU_METHOD
/begin CHARACTERISTIC BPS2_def "IOConfig # BPS2_def" VALUE 0x0016C352 /* @ECU_Address@BPS2_def@0x01009988@ */ ECIPP_ALIGNMENT_UWORD 5 Compu_BPS2_def 0 5.00114468864469 /end CHARACTERISTIC
/begin COMPU_METHOD Compu_BPS2_def " " RAT_FUNC "%.3" "volts" COEFFS 0 13104 0 0 0 1 /end COMPU_METHOD
/begin CHARACTERISTIC APS2_idle_init "IOConfig # APS2_idle_init" VALUE 0x0016C344 /* @ECU_Address@APS2_idle_init@0x01009990@ */ ECIPP_ALIGNMENT_UWORD 5 Compu_APS2_idle_init 0 5.00114468864469 /end CHARACTERISTIC
/begin COMPU_METHOD Compu_APS2_idle_init " " RAT_FUNC "%.3" "volts" COEFFS 0 13104 0 0 0 1 /end COMPU_METHOD
/begin CHARACTERISTIC BPS2_idle_init "IOConfig # BPS2_idle_init" VALUE 0x0016C358 /* @ECU_Address@BPS2_idle_init@0x01009998@ */ ECIPP_ALIGNMENT_UWORD 5 Compu_BPS2_idle_init 0 5.00114468864469 /end CHARACTERISTIC
/begin COMPU_METHOD Compu_BPS2_idle_init " " RAT_FUNC "%.3" "volts" COEFFS 0 13104 0 0 0 1 /end COMPU_METHOD
/begin CHARACTERISTIC APS2_full_init "IOConfig # APS2_full_init" VALUE 0x0016C346 /* @ECU_Address@APS2_full_init@0x010099A0@ */ ECIPP_ALIGNMENT_UWORD 5 Compu_APS2_full_init 0 5.00114468864469 /end CHARACTERISTIC
/begin COMPU_METHOD Compu_APS2_full_init " " RAT_FUNC "%.3" "volts" COEFFS 0 13104 0 0 0 1 /end COMPU_METHOD
/begin CHARACTERISTIC BPS2_full_init "IOConfig # BPS2_full_init" VALUE 0x0016C35A /* @ECU_Address@BPS2_full_init@0x010099A8@ */ ECIPP_ALIGNMENT_UWORD 5 Compu_BPS2_full_init 0 5.00114468864469 /end CHARACTERISTIC
/begin COMPU_METHOD Compu_BPS2_full_init " " RAT_FUNC "%.3" "volts" COEFFS 0 13104 0 0 0 1 /end COMPU_METHOD
/begin CHARACTERISTIC APS2_learn_wait "IOConfig # APS2_learn_wait" VALUE 0x0016C340 /* @ECU_Address@APS2_learn_wait@0x010099B0@ */ ECIPP_ALIGNMENT_SWORD 32767 Compu_APS2_learn_wait -32768 32767 /end CHARACTERISTIC
/begin COMPU_METHOD Compu_APS2_learn_wait " " RAT_FUNC "%.0" "ms" COEFFS 0 1 0 0 0 1 /end COMPU_METHOD
/begin CHARACTERISTIC BPS2_learn_wait "IOConfig # BPS2_learn_wait" VALUE 0x0016C354 /* @ECU_Address@BPS2_learn_wait@0x010099B8@ */ ECIPP_ALIGNMENT_SWORD 32767 Compu_BPS2_learn_wait -32768 32767 /end CHARACTERISTIC
/begin COMPU_METHOD Compu_BPS2_learn_wait " " RAT_FUNC "%.0" "ms" COEFFS 0 1 0 0 0 1 /end COMPU_METHOD
/begin CHARACTERISTIC APS2_learn_tau "IOConfig # APS2_learn_tau" VALUE 0x0016C342 /* @ECU_Address@APS2_learn_tau@0x010099C0@ */ ECIPP_ALIGNMENT_UWORD 327680 Compu_APS2_learn_tau 0.45084 327680 /end CHARACTERISTIC
/begin COMPU_METHOD Compu_APS2_learn_tau " " FORM "%.3" "ms"
 /begin FORMULA "-5 / log(1 - (X1 / 65536))" FORMULA_INV "(1 - exp(-5/X1)) * 65536" /end FORMULA
/end COMPU_METHOD
/begin CHARACTERISTIC BPS2_learn_tau "IOConfig # BPS2_learn_tau" VALUE 0x0016C356 /* @ECU_Address@BPS2_learn_tau@0x010099C8@ */ ECIPP_ALIGNMENT_UWORD 327680 Compu_BPS2_learn_tau 0.45084 327680 /end CHARACTERISTIC
/begin COMPU_METHOD Compu_BPS2_learn_tau " " FORM "%.3" "ms"
 /begin FORMULA "-5 / log(1 - (X1 / 65536))" FORMULA_INV "(1 - exp(-5/X1)) * 65536" /end FORMULA
/end COMPU_METHOD
/begin CHARACTERISTIC APS_learn_idle_seek "Gov # APS_learn_idle_seek" VALUE 0x00148EDE /* @ECU_Address@APS_learn_idle_seek@0x010099D0@ */ ECIPP_ALIGNMENT_UWORD 100 Compu_APS_learn_idle_seek 0 99.9984741210938 /end CHARACTERISTIC
/begin COMPU_METHOD Compu_APS_learn_idle_seek " " RAT_FUNC "%.3" "%" COEFFS 0 655.36 0 0 0 1 /end COMPU_METHOD
/begin CHARACTERISTIC BPS_learn_idle_seek "Gov # BPS_learn_idle_seek" VALUE 0x00148F7E /* @ECU_Address@BPS_learn_idle_seek@0x010099D8@ */ ECIPP_ALIGNMENT_UWORD 100 Compu_BPS_learn_idle_seek 0 99.9984741210938 /end CHARACTERISTIC
/begin COMPU_METHOD Compu_BPS_learn_idle_seek " " RAT_FUNC "%.3" "%" COEFFS 0 655.36 0 0 0 1 /end COMPU_METHOD
/begin CHARACTERISTIC APS_learn_full_seek "Gov # APS_learn_full_seek" VALUE 0x00148EE4 /* @ECU_Address@APS_learn_full_seek@0x010099E0@ */ ECIPP_ALIGNMENT_UWORD 100 Compu_APS_learn_full_seek 0 99.9984741210938 /end CHARACTERISTIC
/begin COMPU_METHOD Compu_APS_learn_full_seek " " RAT_FUNC "%.3" "%" COEFFS 0 655.36 0 0 0 1 /end COMPU_METHOD
/begin CHARACTERISTIC BPS_learn_full_seek "Gov # BPS_learn_full_seek" VALUE 0x00148F84 /* @ECU_Address@BPS_learn_full_seek@0x010099E8@ */ ECIPP_ALIGNMENT_UWORD 100 Compu_BPS_learn_full_seek 0 99.9984741210938 /end CHARACTERISTIC
/begin COMPU_METHOD Compu_BPS_learn_full_seek " " RAT_FUNC "%.3" "%" COEFFS 0 655.36 0 0 0 1 /end COMPU_METHOD
/begin CHARACTERISTIC APS_learn_idle_ofst "General # APS_learn_idle_ofst" VALUE 0x00148EE0 /* @ECU_Address@APS_learn_idle_ofst@0x010099F0@ */ ECIPP_ALIGNMENT_UWORD 5 Compu_APS_learn_idle_ofst 0 5.00114468864469 /end CHARACTERISTIC
/begin COMPU_METHOD Compu_APS_learn_idle_ofst " " RAT_FUNC "%.3" "volts" COEFFS 0 13104 0 0 0 1 /end COMPU_METHOD
/begin CHARACTERISTIC BPS_learn_idle_ofst "General # BPS_learn_idle_ofst" VALUE 0x00148F80 /* @ECU_Address@BPS_learn_idle_ofst@0x010099F8@ */ ECIPP_ALIGNMENT_UWORD 5 Compu_BPS_learn_idle_ofst 0 5.00114468864469 /end CHARACTERISTIC
/begin COMPU_METHOD Compu_BPS_learn_idle_ofst " " RAT_FUNC "%.3" "volts" COEFFS 0 13104 0 0 0 1 /end COMPU_METHOD
/begin CHARACTERISTIC APS_learn_full_ofst "General # APS_learn_full_ofst" VALUE 0x00148EE6 /* @ECU_Address@APS_learn_full_ofst@0x01009A00@ */ ECIPP_ALIGNMENT_UWORD 5 Compu_APS_learn_full_ofst 0 5.00114468864469 /end CHARACTERISTIC
/begin COMPU_METHOD Compu_APS_learn_full_ofst " " RAT_FUNC "%.3" "volts" COEFFS 0 13104 0 0 0 1 /end COMPU_METHOD
/begin CHARACTERISTIC BPS_learn_full_ofst "General # BPS_learn_full_ofst" VALUE 0x00148F86 /* @ECU_Address@BPS_learn_full_ofst@0x01009A08@ */ ECIPP_ALIGNMENT_UWORD 5 Compu_BPS_learn_full_ofst 0 5.00114468864469 /end CHARACTERISTIC
/begin COMPU_METHOD Compu_BPS_learn_full_ofst " " RAT_FUNC "%.3" "volts" COEFFS 0 13104 0 0 0 1 /end COMPU_METHOD
/begin CHARACTERISTIC AEM_R "IOConfig # AEM_R" VALUE 0x00148F30 /* @ECU_Address@AEM_R@0x01009AE0@ */ ECIPP_ALIGNMENT_FLOAT32_IEEE 10000000000 Compu_AEM_R -10000000000 10000000000 /end CHARACTERISTIC
/begin COMPU_METHOD Compu_AEM_R " " RAT_FUNC "%.3" "ohms" COEFFS 0 1 0 0 0 1 /end COMPU_METHOD
/begin CHARACTERISTIC BEM_R "IOConfig # BEM_R" VALUE 0x00148FD0 /* @ECU_Address@BEM_R@0x01009AE8@ */ ECIPP_ALIGNMENT_FLOAT32_IEEE 10000000000 Compu_BEM_R -10000000000 10000000000 /end CHARACTERISTIC
/begin COMPU_METHOD Compu_BEM_R " " RAT_FUNC "%.3" "ohms" COEFFS 0 1 0 0 0 1 /end COMPU_METHOD
/begin CHARACTERISTIC AEM_L "IOConfig # AEM_L" VALUE 0x00148F34 /* @ECU_Address@AEM_L@0x01009AF0@ */ ECIPP_ALIGNMENT_FLOAT32_IEEE 10000000000 Compu_AEM_L -10000000000 10000000000 /end CHARACTERISTIC
/begin COMPU_METHOD Compu_AEM_L " " RAT_FUNC "%.3" "mH" COEFFS 0 1 0 0 0 1 /end COMPU_METHOD
/begin CHARACTERISTIC BEM_L "IOConfig # BEM_L" VALUE 0x00148FD4 /* @ECU_Address@BEM_L@0x01009AF8@ */ ECIPP_ALIGNMENT_FLOAT32_IEEE 10000000000 Compu_BEM_L -10000000000 10000000000 /end CHARACTERISTIC
/begin COMPU_METHOD Compu_BEM_L " " RAT_FUNC "%.3" "mH" COEFFS 0 1 0 0 0 1 /end COMPU_METHOD
/begin CHARACTERISTIC AEM_Kv "IOConfig # AEM_Kv" VALUE 0x00148F38 /* @ECU_Address@AEM_Kv@0x01009B00@ */ ECIPP_ALIGNMENT_FLOAT32_IEEE 10000000000 Compu_AEM_Kv -10000000000 10000000000 /end CHARACTERISTIC
/begin COMPU_METHOD Compu_AEM_Kv " " RAT_FUNC "%.3" "V / (100% / sec)" COEFFS 0 1 0 0 0 1 /end COMPU_METHOD
/begin CHARACTERISTIC BEM_Kv "IOConfig # BEM_Kv" VALUE 0x00148FD8 /* @ECU_Address@BEM_Kv@0x01009B08@ */ ECIPP_ALIGNMENT_FLOAT32_IEEE 10000000000 Compu_BEM_Kv -10000000000 10000000000 /end CHARACTERISTIC
/begin COMPU_METHOD Compu_BEM_Kv " " RAT_FUNC "%.3" "V / (100% / sec)" COEFFS 0 1 0 0 0 1 /end COMPU_METHOD
/begin CHARACTERISTIC AEM_V_diode "General # AEM_V_diode" VALUE 0x00148F3C /* @ECU_Address@AEM_V_diode@0x01009B10@ */ ECIPP_ALIGNMENT_UWORD 256 Compu_AEM_V_diode 0 255.99609375 /end CHARACTERISTIC
/begin COMPU_METHOD Compu_AEM_V_diode " " RAT_FUNC "%.3" "volts" COEFFS 0 256 0 0 0 1 /end COMPU_METHOD
/begin CHARACTERISTIC BEM_V_diode "General # BEM_V_diode" VALUE 0x00148FDC /* @ECU_Address@BEM_V_diode@0x01009B18@ */ ECIPP_ALIGNMENT_UWORD 256 Compu_BEM_V_diode 0 255.99609375 /end CHARACTERISTIC
/begin COMPU_METHOD Compu_BEM_V_diode " " RAT_FUNC "%.3" "volts" COEFFS 0 256 0 0 0 1 /end COMPU_METHOD
/begin CHARACTERISTIC AEM_hard_Ilim "General # AEM_hard_Ilim" VALUE 0x00148F3E /* @ECU_Address@AEM_hard_Ilim@0x01009B20@ */ ECIPP_ALIGNMENT_SWORD 32 Compu_AEM_hard_Ilim -32 31.9990234375 /end CHARACTERISTIC
/begin COMPU_METHOD Compu_AEM_hard_Ilim " " RAT_FUNC "%.3" "amps" COEFFS 0 1024 0 0 0 1 /end COMPU_METHOD
/begin CHARACTERISTIC BEM_hard_Ilim "General # BEM_hard_Ilim" VALUE 0x00148FDE /* @ECU_Address@BEM_hard_Ilim@0x01009B28@ */ ECIPP_ALIGNMENT_SWORD 32 Compu_BEM_hard_Ilim -32 31.9990234375 /end CHARACTERISTIC
/begin COMPU_METHOD Compu_BEM_hard_Ilim " " RAT_FUNC "%.3" "amps" COEFFS 0 1024 0 0 0 1 /end COMPU_METHOD
/begin CHARACTERISTIC IparkA_Ilim "General # IparkA_Ilim" VALUE 0x00148F42 /* @ECU_Address@IparkA_Ilim@0x01009B30@ */ ECIPP_ALIGNMENT_UWORD 64 Compu_IparkA_Ilim 0 63.9990234375 /end CHARACTERISTIC
/begin COMPU_METHOD Compu_IparkA_Ilim " " RAT_FUNC "%.3" "amps" COEFFS 0 1024 0 0 0 1 /end COMPU_METHOD
/begin CHARACTERISTIC IparkB_Ilim "General # IparkB_Ilim" VALUE 0x00148FE2 /* @ECU_Address@IparkB_Ilim@0x01009B38@ */ ECIPP_ALIGNMENT_UWORD 64 Compu_IparkB_Ilim 0 63.9990234375 /end CHARACTERISTIC
/begin COMPU_METHOD Compu_IparkB_Ilim " " RAT_FUNC "%.3" "amps" COEFFS 0 1024 0 0 0 1 /end COMPU_METHOD
/begin CHARACTERISTIC IparkA_Ki "General # IparkA_Ki" VALUE 0x00148F4E /* @ECU_Address@IparkA_Ki@0x01009B40@ */ ECIPP_ALIGNMENT_UWORD 3125 Compu_IparkA_Ki 0 3124.95231628418 /end CHARACTERISTIC
/begin COMPU_METHOD Compu_IparkA_Ki " " RAT_FUNC "%.3" "% / amp / sec" COEFFS 0 20.97152 0 0 0 1 /end COMPU_METHOD
/begin CHARACTERISTIC IparkB_Ki "General # IparkB_Ki" VALUE 0x00148FEE /* @ECU_Address@IparkB_Ki@0x01009B48@ */ ECIPP_ALIGNMENT_UWORD 3125 Compu_IparkB_Ki 0 3124.95231628418 /end CHARACTERISTIC
/begin COMPU_METHOD Compu_IparkB_Ki " " RAT_FUNC "%.3" "% / amp / sec" COEFFS 0 20.97152 0 0 0 1 /end COMPU_METHOD
/begin CHARACTERISTIC IparkA_dly "General # IparkA_dly" VALUE 0x00148F4C /* @ECU_Address@IparkA_dly@0x01009B50@ */ ECIPP_ALIGNMENT_UWORD 66 Compu_IparkA_dly 0 65.535 /end CHARACTERISTIC
/begin COMPU_METHOD Compu_IparkA_dly " " RAT_FUNC "%.3" "seconds" COEFFS 0 1000 0 0 0 1 /end COMPU_METHOD
/begin CHARACTERISTIC IparkB_dly "General # IparkB_dly" VALUE 0x00148FEC /* @ECU_Address@IparkB_dly@0x01009B58@ */ ECIPP_ALIGNMENT_UWORD 66 Compu_IparkB_dly 0 65.535 /end CHARACTERISTIC
/begin COMPU_METHOD Compu_IparkB_dly " " RAT_FUNC "%.3" "seconds" COEFFS 0 1000 0 0 0 1 /end COMPU_METHOD
/begin CHARACTERISTIC IparkA_ena "{IparkA_ena&0xff=0:Disabled}{IparkA_ena&0xff=1:Single-Point}{IparkA_ena&0xff=2:1-D Table-Based}" VALUE 0x00148F40 /* @ECU_Address@IparkA_ena@0x01009B60@ */ ECIPP_ALIGNMENT_UBYTE 255 IparkA_ena_COMPU_VTAB 0 255 BIT_MASK 0xff /end CHARACTERISTIC
/begin COMPU_METHOD IparkA_ena_COMPU_VTAB "Verbal Table" TAB_VERB "%.0" "list" COMPU_TAB_REF IparkA_ena_COMPU_VTAB_REF /end COMPU_METHOD
/begin COMPU_VTAB IparkA_ena_COMPU_VTAB_REF "Verbal Table" TAB_VERB 3 0 "Disabled" 1 "Single-Point" 2 "1-D Table-Based" DEFAULT_VALUE "UNKNOWN" /end COMPU_VTAB
/begin CHARACTERISTIC IparkB_ena "{IparkB_ena&0xff=0:Disabled}{IparkB_ena&0xff=1:Single-Point}{IparkB_ena&0xff=2:1-D Table-Based}" VALUE 0x00148FE0 /* @ECU_Address@IparkB_ena@0x01009B68@ */ ECIPP_ALIGNMENT_UBYTE 255 IparkB_ena_COMPU_VTAB 0 255 BIT_MASK 0xff /end CHARACTERISTIC
/begin COMPU_METHOD IparkB_ena_COMPU_VTAB "Verbal Table" TAB_VERB "%.0" "list" COMPU_TAB_REF IparkB_ena_COMPU_VTAB_REF /end COMPU_METHOD
/begin COMPU_VTAB IparkB_ena_COMPU_VTAB_REF "Verbal Table" TAB_VERB 3 0 "Disabled" 1 "Single-Point" 2 "1-D Table-Based" DEFAULT_VALUE "UNKNOWN" /end COMPU_VTAB
/begin CHARACTERISTIC IparkA_max_att "General # IparkA_max_att" VALUE 0x00148F50 /* @ECU_Address@IparkA_max_att@0x01009B70@ */ ECIPP_ALIGNMENT_SWORD 100 Compu_IparkA_max_att -100 99.9969482421875 /end CHARACTERISTIC
/begin COMPU_METHOD Compu_IparkA_max_att " " RAT_FUNC "%.3" "% decrease" COEFFS 0 327.68 0 0 0 1 /end COMPU_METHOD
/begin CHARACTERISTIC IparkB_max_att "General # IparkB_max_att" VALUE 0x00148FF0 /* @ECU_Address@IparkB_max_att@0x01009B78@ */ ECIPP_ALIGNMENT_SWORD 100 Compu_IparkB_max_att -100 99.9969482421875 /end CHARACTERISTIC
/begin COMPU_METHOD Compu_IparkB_max_att " " RAT_FUNC "%.3" "% decrease" COEFFS 0 327.68 0 0 0 1 /end COMPU_METHOD
/begin CHARACTERISTIC HBA_spring_0 "Gov # HBA_spring_0" VALUE 0x00148F52 /* @ECU_Address@HBA_spring_0@0x01009B80@ */ ECIPP_ALIGNMENT_SWORD 200 Compu_HBA_spring_0 -200 199.993896484375 /end CHARACTERISTIC
/begin COMPU_METHOD Compu_HBA_spring_0 " " RAT_FUNC "%.3" "%" COEFFS 0 163.84 0 0 0 1 /end COMPU_METHOD
/begin CHARACTERISTIC HBB_spring_0 "Gov # HBB_spring_0" VALUE 0x00148FF2 /* @ECU_Address@HBB_spring_0@0x01009B88@ */ ECIPP_ALIGNMENT_SWORD 200 Compu_HBB_spring_0 -200 199.993896484375 /end CHARACTERISTIC
/begin COMPU_METHOD Compu_HBB_spring_0 " " RAT_FUNC "%.3" "%" COEFFS 0 163.84 0 0 0 1 /end COMPU_METHOD
/begin CHARACTERISTIC HBA_spring_100 "Gov # HBA_spring_100" VALUE 0x00148F54 /* @ECU_Address@HBA_spring_100@0x01009B90@ */ ECIPP_ALIGNMENT_SWORD 200 Compu_HBA_spring_100 -200 199.993896484375 /end CHARACTERISTIC
/begin COMPU_METHOD Compu_HBA_spring_100 " " RAT_FUNC "%.3" "%" COEFFS 0 163.84 0 0 0 1 /end COMPU_METHOD
/begin CHARACTERISTIC HBB_spring_100 "Gov # HBB_spring_100" VALUE 0x00148FF4 /* @ECU_Address@HBB_spring_100@0x01009B98@ */ ECIPP_ALIGNMENT_SWORD 200 Compu_HBB_spring_100 -200 199.993896484375 /end CHARACTERISTIC
/begin COMPU_METHOD Compu_HBB_spring_100 " " RAT_FUNC "%.3" "%" COEFFS 0 163.84 0 0 0 1 /end COMPU_METHOD
/begin CHARACTERISTIC HBA_Vcomp_min "Gov # HBA_Vcomp_min" VALUE 0x00148F6A /* @ECU_Address@HBA_Vcomp_min@0x01009C40@ */ ECIPP_ALIGNMENT_UWORD 256 Compu_HBA_Vcomp_min 0 255.99609375 /end CHARACTERISTIC
/begin COMPU_METHOD Compu_HBA_Vcomp_min " " RAT_FUNC "%.3" "volts" COEFFS 0 256 0 0 0 1 /end COMPU_METHOD
/begin CHARACTERISTIC HBB_Vcomp_min "Gov # HBB_Vcomp_min" VALUE 0x0014900A /* @ECU_Address@HBB_Vcomp_min@0x01009C48@ */ ECIPP_ALIGNMENT_UWORD 256 Compu_HBB_Vcomp_min 0 255.99609375 /end CHARACTERISTIC
/begin COMPU_METHOD Compu_HBB_Vcomp_min " " RAT_FUNC "%.3" "volts" COEFFS 0 256 0 0 0 1 /end COMPU_METHOD
/begin CHARACTERISTIC HBA_Vcomp_max "Gov # HBA_Vcomp_max" VALUE 0x00148F6C /* @ECU_Address@HBA_Vcomp_max@0x01009C50@ */ ECIPP_ALIGNMENT_UWORD 256 Compu_HBA_Vcomp_max 0 255.99609375 /end CHARACTERISTIC
/begin COMPU_METHOD Compu_HBA_Vcomp_max " " RAT_FUNC "%.3" "volts" COEFFS 0 256 0 0 0 1 /end COMPU_METHOD
/begin CHARACTERISTIC HBB_Vcomp_max "Gov # HBB_Vcomp_max" VALUE 0x0014900C /* @ECU_Address@HBB_Vcomp_max@0x01009C58@ */ ECIPP_ALIGNMENT_UWORD 256 Compu_HBB_Vcomp_max 0 255.99609375 /end CHARACTERISTIC
/begin COMPU_METHOD Compu_HBB_Vcomp_max " " RAT_FUNC "%.3" "volts" COEFFS 0 256 0 0 0 1 /end COMPU_METHOD
/begin CHARACTERISTIC APS1_min "FaultConfig # APS1_min (Fault Condition:APS1 voltage <)" VALUE 0x00148F16 /* @ECU_Address@APS1_min@0x01009D80@ */ ECIPP_ALIGNMENT_UWORD 5 Compu_APS1_min 0 5.00114468864469 /end CHARACTERISTIC
/begin COMPU_METHOD Compu_APS1_min " " RAT_FUNC "%.3" "volts" COEFFS 0 13104 0 0 0 1 /end COMPU_METHOD
/begin CHARACTERISTIC APS1_max "FaultConfig # APS1_max (Fault Condition:APS1 voltage >)" VALUE 0x00148F18 /* @ECU_Address@APS1_max@0x01009D88@ */ ECIPP_ALIGNMENT_UWORD 5 Compu_APS1_max 0 5.00114468864469 /end CHARACTERISTIC
/begin COMPU_METHOD Compu_APS1_max " " RAT_FUNC "%.3" "volts" COEFFS 0 13104 0 0 0 1 /end COMPU_METHOD
/begin CHARACTERISTIC APS2_min "FaultConfig # APS2_min (Fault Condition:APS2 voltage <)" VALUE 0x00148F1A /* @ECU_Address@APS2_min@0x01009D90@ */ ECIPP_ALIGNMENT_UWORD 5 Compu_APS2_min 0 5.00114468864469 /end CHARACTERISTIC
/begin COMPU_METHOD Compu_APS2_min " " RAT_FUNC "%.3" "volts" COEFFS 0 13104 0 0 0 1 /end COMPU_METHOD
/begin CHARACTERISTIC APS2_max "FaultConfig # APS2_max (Fault Condition:APS2 voltage >)" VALUE 0x00148F1C /* @ECU_Address@APS2_max@0x01009D98@ */ ECIPP_ALIGNMENT_UWORD 5 Compu_APS2_max 0 5.00114468864469 /end CHARACTERISTIC
/begin COMPU_METHOD Compu_APS2_max " " RAT_FUNC "%.3" "volts" COEFFS 0 13104 0 0 0 1 /end COMPU_METHOD
/begin CHARACTERISTIC APS12pct_hi "FaultConfig # APS12pct_hi (Fault Condition:(APS1% - APS2%) >)" VALUE 0x00148F1E /* @ECU_Address@APS12pct_hi@0x01009DA0@ */ ECIPP_ALIGNMENT_SWORD 100 Compu_APS12pct_hi -100 99.9969482421875 /end CHARACTERISTIC
/begin COMPU_METHOD Compu_APS12pct_hi " " RAT_FUNC "%.3" "%" COEFFS 0 327.68 0 0 0 1 /end COMPU_METHOD
/begin CHARACTERISTIC APS12pct_lo "FaultConfig # APS12pct_lo (Fault Condition:(APS1% - APS2%) <)" VALUE 0x00148F20 /* @ECU_Address@APS12pct_lo@0x01009DA8@ */ ECIPP_ALIGNMENT_SWORD 100 Compu_APS12pct_lo -100 99.9969482421875 /end CHARACTERISTIC
/begin COMPU_METHOD Compu_APS12pct_lo " " RAT_FUNC "%.3" "%" COEFFS 0 327.68 0 0 0 1 /end COMPU_METHOD
/begin CHARACTERISTIC APSerr_pos "FaultConfig # APSerr_pos (Fault Condition:(target APS - actual APS) >)" VALUE 0x00148F22 /* @ECU_Address@APSerr_pos@0x01009DB0@ */ ECIPP_ALIGNMENT_SWORD 100 Compu_APSerr_pos -100 99.9969482421875 /end CHARACTERISTIC
/begin COMPU_METHOD Compu_APSerr_pos " " RAT_FUNC "%.3" "%" COEFFS 0 327.68 0 0 0 1 /end COMPU_METHOD
/begin CHARACTERISTIC APSerr_neg "FaultConfig # APSerr_neg (Fault Condition:(target APS - actual APS) <)" VALUE 0x00148F24 /* @ECU_Address@APSerr_neg@0x01009DB8@ */ ECIPP_ALIGNMENT_SWORD 100 Compu_APSerr_neg -100 99.9969482421875 /end CHARACTERISTIC
/begin COMPU_METHOD Compu_APSerr_neg " " RAT_FUNC "%.3" "%" COEFFS 0 327.68 0 0 0 1 /end COMPU_METHOD
/begin CHARACTERISTIC APSerr_wait "FaultConfig # APSerr_wait (Fault Condition:persistently longer than)" VALUE 0x00148F26 /* @ECU_Address@APSerr_wait@0x01009DC0@ */ ECIPP_ALIGNMENT_UWORD 65535 Compu_APSerr_wait 0 65535 /end CHARACTERISTIC
/begin COMPU_METHOD Compu_APSerr_wait " " RAT_FUNC "%.0" "ms" COEFFS 0 1 0 0 0 1 /end COMPU_METHOD
/begin CHARACTERISTIC APSerr_minVbat "FaultConfig # APSerr_minVbat (Fault Condition:while battery voltage >)" VALUE 0x00148F28 /* @ECU_Address@APSerr_minVbat@0x01009DC8@ */ ECIPP_ALIGNMENT_UWORD 256 Compu_APSerr_minVbat 0 255.99609375 /end CHARACTERISTIC
/begin COMPU_METHOD Compu_APSerr_minVbat " " RAT_FUNC "%.3" "volts" COEFFS 0 256 0 0 0 1 /end COMPU_METHOD
/begin CHARACTERISTIC BPS1_min "FaultConfig # BPS1_min (Fault Condition:BPS1 voltage <)" VALUE 0x00148FB6 /* @ECU_Address@BPS1_min@0x01009DD8@ */ ECIPP_ALIGNMENT_UWORD 5 Compu_BPS1_min 0 5.00114468864469 /end CHARACTERISTIC
/begin COMPU_METHOD Compu_BPS1_min " " RAT_FUNC "%.3" "volts" COEFFS 0 13104 0 0 0 1 /end COMPU_METHOD
/end MODULE
/end PROJECT
