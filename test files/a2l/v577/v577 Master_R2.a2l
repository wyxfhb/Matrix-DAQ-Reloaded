ASAP2_VERSION 1 61
/begin PROJECT Econtrols_4G "4G Test"
/begin HEADER "4G A2L Configuration" PROJECT_NO EControls4G /* config for version control */ VERSION "$Revision: 82130 $:" /* config for version control */ /end HEADER
/begin MODULE EControls_4G_SH2A "EControls 4G"
/begin MOD_COMMON "" DEPOSIT ABSOLUTE BYTE_ORDER MSB_FIRST /end MOD_COMMON
/* Define the Record Layouts */
/begin RECORD_LAYOUT ECIPP_ALIGNMENT_UBYTE FNC_VALUES 1 UBYTE COLUMN_DIR DIRECT /end RECORD_LAYOUT
/begin RECORD_LAYOUT ECIPP_ALIGNMENT_UWORD FNC_VALUES 1 UWORD COLUMN_DIR DIRECT /end RECORD_LAYOUT
/begin RECORD_LAYOUT ECIPP_ALIGNMENT_ULONG FNC_VALUES 1 ULONG COLUMN_DIR DIRECT /end RECORD_LAYOUT
/begin RECORD_LAYOUT ECIPP_Lookup_SLONG AXIS_PTS_X 1 SLONG INDEX_INCR DIRECT /end RECORD_LAYOUT
/begin COMPU_METHOD Compu_IDENTITY "Discrete Values " /* Identifier */ IDENTICAL "%.0" /* Format */ "-" /* Units */ /end COMPU_METHOD
/begin CHARACTERISTIC FCdtc_ICAVD9_miscat "FCtl_DTC(316)" VALUE 0x0016378C /* @ECU_Address@FCtl_DTC@0x021B5278@ */ ECIPP_ALIGNMENT_UWORD 65535 Compu_IDENTITY 0 65535 PHYS_UNIT "DTC" /end CHARACTERISTIC
/begin CHARACTERISTIC FCdtc_INJD10_off_lo "FCtl_DTC(55)" VALUE 0x00163582 /* @ECU_Address@FCtl_DTC@0x021B506E@ */ ECIPP_ALIGNMENT_UWORD 65535 Compu_IDENTITY 0 65535 PHYS_UNIT "DTC" /end CHARACTERISTIC
/begin CHARACTERISTIC FCdtc_INJD10_on_hi "FCtl_DTC(65)" VALUE 0x00163596 /* @ECU_Address@FCtl_DTC@0x021B5082@ */ ECIPP_ALIGNMENT_UWORD 65535 Compu_IDENTITY 0 65535 PHYS_UNIT "DTC" /end CHARACTERISTIC
/begin CHARACTERISTIC FCdtc_INJD2_boost_lo "FCtl_DTC(579)" VALUE 0x0016399A /* @ECU_Address@FCtl_DTC@0x021B5486@ */ ECIPP_ALIGNMENT_UWORD 65535 Compu_IDENTITY 0 65535 PHYS_UNIT "DTC" /end CHARACTERISTIC
/begin CHARACTERISTIC FCdtc_INJD2_HS_Ihi "FCtl_DTC(563)" VALUE 0x0016397A /* @ECU_Address@FCtl_DTC@0x021B5466@ */ ECIPP_ALIGNMENT_UWORD 65535 Compu_IDENTITY 0 65535 PHYS_UNIT "DTC" /end CHARACTERISTIC
/begin CHARACTERISTIC FCdtc_INJD2_HW_int "FCtl_DTC(581)" VALUE 0x0016399E /* @ECU_Address@FCtl_DTC@0x021B548A@ */ ECIPP_ALIGNMENT_UWORD 65535 Compu_IDENTITY 0 65535 PHYS_UNIT "DTC" /end CHARACTERISTIC
/begin CHARACTERISTIC FCdtc_INJD2_LS_Ihi "FCtl_DTC(571)" VALUE 0x0016398A /* @ECU_Address@FCtl_DTC@0x021B5476@ */ ECIPP_ALIGNMENT_UWORD 65535 Compu_IDENTITY 0 65535 PHYS_UNIT "DTC" /end CHARACTERISTIC
/begin CHARACTERISTIC FCdtc_INJD2_off_lo "FCtl_DTC(47)" VALUE 0x00163572 /* @ECU_Address@FCtl_DTC@0x021B505E@ */ ECIPP_ALIGNMENT_UWORD 65535 Compu_IDENTITY 0 65535 PHYS_UNIT "DTC" /end CHARACTERISTIC
/begin CHARACTERISTIC FCdtc_INJD2_on_hi "FCtl_DTC(57)" VALUE 0x00163586 /* @ECU_Address@FCtl_DTC@0x021B5072@ */ ECIPP_ALIGNMENT_UWORD 65535 Compu_IDENTITY 0 65535 PHYS_UNIT "DTC" /end CHARACTERISTIC
/begin CHARACTERISTIC FCdtc_INJD3_HS_Ihi "FCtl_DTC(564)" VALUE 0x0016397C /* @ECU_Address@FCtl_DTC@0x021B5468@ */ ECIPP_ALIGNMENT_UWORD 65535 Compu_IDENTITY 0 65535 PHYS_UNIT "DTC" /end CHARACTERISTIC
/begin CHARACTERISTIC FCdtc_INJD3_LS_Ihi "FCtl_DTC(572)" VALUE 0x0016398C /* @ECU_Address@FCtl_DTC@0x021B5478@ */ ECIPP_ALIGNMENT_UWORD 65535 Compu_IDENTITY 0 65535 PHYS_UNIT "DTC" /end CHARACTERISTIC
/begin CHARACTERISTIC FCdtc_INJD3_off_lo "FCtl_DTC(48)" VALUE 0x00163574 /* @ECU_Address@FCtl_DTC@0x021B5060@ */ ECIPP_ALIGNMENT_UWORD 65535 Compu_IDENTITY 0 65535 PHYS_UNIT "DTC" /end CHARACTERISTIC
/begin CHARACTERISTIC FCdtc_INJD3_on_hi "FCtl_DTC(58)" VALUE 0x00163588 /* @ECU_Address@FCtl_DTC@0x021B5074@ */ ECIPP_ALIGNMENT_UWORD 65535 Compu_IDENTITY 0 65535 PHYS_UNIT "DTC" /end CHARACTERISTIC
/begin CHARACTERISTIC FCdtc_INJD4_HS_Ihi "FCtl_DTC(565)" VALUE 0x0016397E /* @ECU_Address@FCtl_DTC@0x021B546A@ */ ECIPP_ALIGNMENT_UWORD 65535 Compu_IDENTITY 0 65535 PHYS_UNIT "DTC" /end CHARACTERISTIC
/begin CHARACTERISTIC FCdtc_INJD4_LS_Ihi "FCtl_DTC(573)" VALUE 0x0016398E /* @ECU_Address@FCtl_DTC@0x021B547A@ */ ECIPP_ALIGNMENT_UWORD 65535 Compu_IDENTITY 0 65535 PHYS_UNIT "DTC" /end CHARACTERISTIC
/begin CHARACTERISTIC FCdtc_INJD4_off_lo "FCtl_DTC(49)" VALUE 0x00163576 /* @ECU_Address@FCtl_DTC@0x021B5062@ */ ECIPP_ALIGNMENT_UWORD 65535 Compu_IDENTITY 0 65535 PHYS_UNIT "DTC" /end CHARACTERISTIC
/begin CHARACTERISTIC FCdtc_INJD4_on_hi "FCtl_DTC(59)" VALUE 0x0016358A /* @ECU_Address@FCtl_DTC@0x021B5076@ */ ECIPP_ALIGNMENT_UWORD 65535 Compu_IDENTITY 0 65535 PHYS_UNIT "DTC" /end CHARACTERISTIC
/begin CHARACTERISTIC FCdtc_INJD5_HS_Ihi "FCtl_DTC(566)" VALUE 0x00163980 /* @ECU_Address@FCtl_DTC@0x021B546C@ */ ECIPP_ALIGNMENT_UWORD 65535 Compu_IDENTITY 0 65535 PHYS_UNIT "DTC" /end CHARACTERISTIC
/begin CHARACTERISTIC FCdtc_INJD5_LS_Ihi "FCtl_DTC(574)" VALUE 0x00163990 /* @ECU_Address@FCtl_DTC@0x021B547C@ */ ECIPP_ALIGNMENT_UWORD 65535 Compu_IDENTITY 0 65535 PHYS_UNIT "DTC" /end CHARACTERISTIC
/begin CHARACTERISTIC FCdtc_INJD5_off_lo "FCtl_DTC(50)" VALUE 0x00163578 /* @ECU_Address@FCtl_DTC@0x021B5064@ */ ECIPP_ALIGNMENT_UWORD 65535 Compu_IDENTITY 0 65535 PHYS_UNIT "DTC" /end CHARACTERISTIC
/begin CHARACTERISTIC FCdtc_INJD5_on_hi "FCtl_DTC(60)" VALUE 0x0016358C /* @ECU_Address@FCtl_DTC@0x021B5078@ */ ECIPP_ALIGNMENT_UWORD 65535 Compu_IDENTITY 0 65535 PHYS_UNIT "DTC" /end CHARACTERISTIC
/begin CHARACTERISTIC FCdtc_INJD6_HS_Ihi "FCtl_DTC(567)" VALUE 0x00163982 /* @ECU_Address@FCtl_DTC@0x021B546E@ */ ECIPP_ALIGNMENT_UWORD 65535 Compu_IDENTITY 0 65535 PHYS_UNIT "DTC" /end CHARACTERISTIC
/begin CHARACTERISTIC FCdtc_INJD6_LS_Ihi "FCtl_DTC(575)" VALUE 0x00163992 /* @ECU_Address@FCtl_DTC@0x021B547E@ */ ECIPP_ALIGNMENT_UWORD 65535 Compu_IDENTITY 0 65535 PHYS_UNIT "DTC" /end CHARACTERISTIC
/begin CHARACTERISTIC FCdtc_INJD6_off_lo "FCtl_DTC(51)" VALUE 0x0016357A /* @ECU_Address@FCtl_DTC@0x021B5066@ */ ECIPP_ALIGNMENT_UWORD 65535 Compu_IDENTITY 0 65535 PHYS_UNIT "DTC" /end CHARACTERISTIC
/begin CHARACTERISTIC FCdtc_INJD6_on_hi "FCtl_DTC(61)" VALUE 0x0016358E /* @ECU_Address@FCtl_DTC@0x021B507A@ */ ECIPP_ALIGNMENT_UWORD 65535 Compu_IDENTITY 0 65535 PHYS_UNIT "DTC" /end CHARACTERISTIC
/begin CHARACTERISTIC FCdtc_INJD7_HS_Ihi "FCtl_DTC(568)" VALUE 0x00163984 /* @ECU_Address@FCtl_DTC@0x021B5470@ */ ECIPP_ALIGNMENT_UWORD 65535 Compu_IDENTITY 0 65535 PHYS_UNIT "DTC" /end CHARACTERISTIC
/begin CHARACTERISTIC FCdtc_INJD7_LS_Ihi "FCtl_DTC(576)" VALUE 0x00163994 /* @ECU_Address@FCtl_DTC@0x021B5480@ */ ECIPP_ALIGNMENT_UWORD 65535 Compu_IDENTITY 0 65535 PHYS_UNIT "DTC" /end CHARACTERISTIC
/begin CHARACTERISTIC FCdtc_INJD7_off_lo "FCtl_DTC(52)" VALUE 0x0016357C /* @ECU_Address@FCtl_DTC@0x021B5068@ */ ECIPP_ALIGNMENT_UWORD 65535 Compu_IDENTITY 0 65535 PHYS_UNIT "DTC" /end CHARACTERISTIC
/begin CHARACTERISTIC FCdtc_INJD7_on_hi "FCtl_DTC(62)" VALUE 0x00163590 /* @ECU_Address@FCtl_DTC@0x021B507C@ */ ECIPP_ALIGNMENT_UWORD 65535 Compu_IDENTITY 0 65535 PHYS_UNIT "DTC" /end CHARACTERISTIC
/begin CHARACTERISTIC FCdtc_INJD8_HS_Ihi "FCtl_DTC(569)" VALUE 0x00163986 /* @ECU_Address@FCtl_DTC@0x021B5472@ */ ECIPP_ALIGNMENT_UWORD 65535 Compu_IDENTITY 0 65535 PHYS_UNIT "DTC" /end CHARACTERISTIC
/begin CHARACTERISTIC FCdtc_INJD8_LS_Ihi "FCtl_DTC(577)" VALUE 0x00163996 /* @ECU_Address@FCtl_DTC@0x021B5482@ */ ECIPP_ALIGNMENT_UWORD 65535 Compu_IDENTITY 0 65535 PHYS_UNIT "DTC" /end CHARACTERISTIC
/begin CHARACTERISTIC FCdtc_INJD8_off_lo "FCtl_DTC(53)" VALUE 0x0016357E /* @ECU_Address@FCtl_DTC@0x021B506A@ */ ECIPP_ALIGNMENT_UWORD 65535 Compu_IDENTITY 0 65535 PHYS_UNIT "DTC" /end CHARACTERISTIC
/begin CHARACTERISTIC FCdtc_INJD8_on_hi "FCtl_DTC(63)" VALUE 0x00163592 /* @ECU_Address@FCtl_DTC@0x021B507E@ */ ECIPP_ALIGNMENT_UWORD 65535 Compu_IDENTITY 0 65535 PHYS_UNIT "DTC" /end CHARACTERISTIC
/begin CHARACTERISTIC FCdtc_INJD9_off_lo "FCtl_DTC(54)" VALUE 0x00163580 /* @ECU_Address@FCtl_DTC@0x021B506C@ */ ECIPP_ALIGNMENT_UWORD 65535 Compu_IDENTITY 0 65535 PHYS_UNIT "DTC" /end CHARACTERISTIC
/begin CHARACTERISTIC FCdtc_INJD9_on_hi "FCtl_DTC(64)" VALUE 0x00163594 /* @ECU_Address@FCtl_DTC@0x021B5080@ */ ECIPP_ALIGNMENT_UWORD 65535 Compu_IDENTITY 0 65535 PHYS_UNIT "DTC" /end CHARACTERISTIC
/begin CHARACTERISTIC FCdtc_KNK2_max "FCtl_DTC(185)" VALUE 0x00163686 /* @ECU_Address@FCtl_DTC@0x021B5172@ */ ECIPP_ALIGNMENT_UWORD 65535 Compu_IDENTITY 0 65535 PHYS_UNIT "DTC" /end CHARACTERISTIC
/begin CHARACTERISTIC FCdtc_KNK2_min "FCtl_DTC(184)" VALUE 0x00163684 /* @ECU_Address@FCtl_DTC@0x021B5170@ */ ECIPP_ALIGNMENT_UWORD 65535 Compu_IDENTITY 0 65535 PHYS_UNIT "DTC" /end CHARACTERISTIC
/begin CHARACTERISTIC FCdtc_KNK3_max "FCtl_DTC(806)" VALUE 0x00163B60 /* @ECU_Address@FCtl_DTC@0x021B564C@ */ ECIPP_ALIGNMENT_UWORD 65535 Compu_IDENTITY 0 65535 PHYS_UNIT "DTC" /end CHARACTERISTIC
/begin CHARACTERISTIC FCdtc_KNK3_min "FCtl_DTC(805)" VALUE 0x00163B5E /* @ECU_Address@FCtl_DTC@0x021B564A@ */ ECIPP_ALIGNMENT_UWORD 65535 Compu_IDENTITY 0 65535 PHYS_UNIT "DTC" /end CHARACTERISTIC
/begin CHARACTERISTIC FCdtc_SPK10_IGBT_T "FCtl_DTC(518)" VALUE 0x00163920 /* @ECU_Address@FCtl_DTC@0x021B540C@ */ ECIPP_ALIGNMENT_UWORD 65535 Compu_IDENTITY 0 65535 PHYS_UNIT "DTC" /end CHARACTERISTIC
/begin CHARACTERISTIC FCdtc_SPK2_IGBT_T "FCtl_DTC(510)" VALUE 0x00163910 /* @ECU_Address@FCtl_DTC@0x021B53FC@ */ ECIPP_ALIGNMENT_UWORD 65535 Compu_IDENTITY 0 65535 PHYS_UNIT "DTC" /end CHARACTERISTIC
/begin CHARACTERISTIC FCdtc_SPK3_IGBT_T "FCtl_DTC(511)" VALUE 0x00163912 /* @ECU_Address@FCtl_DTC@0x021B53FE@ */ ECIPP_ALIGNMENT_UWORD 65535 Compu_IDENTITY 0 65535 PHYS_UNIT "DTC" /end CHARACTERISTIC
/begin CHARACTERISTIC FCdtc_SPK4_IGBT_T "FCtl_DTC(512)" VALUE 0x00163914 /* @ECU_Address@FCtl_DTC@0x021B5400@ */ ECIPP_ALIGNMENT_UWORD 65535 Compu_IDENTITY 0 65535 PHYS_UNIT "DTC" /end CHARACTERISTIC
/begin CHARACTERISTIC FCdtc_SPK5_IGBT_T "FCtl_DTC(513)" VALUE 0x00163916 /* @ECU_Address@FCtl_DTC@0x021B5402@ */ ECIPP_ALIGNMENT_UWORD 65535 Compu_IDENTITY 0 65535 PHYS_UNIT "DTC" /end CHARACTERISTIC
/begin CHARACTERISTIC FCdtc_SPK6_IGBT_T "FCtl_DTC(514)" VALUE 0x00163918 /* @ECU_Address@FCtl_DTC@0x021B5404@ */ ECIPP_ALIGNMENT_UWORD 65535 Compu_IDENTITY 0 65535 PHYS_UNIT "DTC" /end CHARACTERISTIC
/begin CHARACTERISTIC FCdtc_SPK7_IGBT_T "FCtl_DTC(515)" VALUE 0x0016391A /* @ECU_Address@FCtl_DTC@0x021B5406@ */ ECIPP_ALIGNMENT_UWORD 65535 Compu_IDENTITY 0 65535 PHYS_UNIT "DTC" /end CHARACTERISTIC
/begin CHARACTERISTIC FCdtc_SPK8_IGBT_T "FCtl_DTC(516)" VALUE 0x0016391C /* @ECU_Address@FCtl_DTC@0x021B5408@ */ ECIPP_ALIGNMENT_UWORD 65535 Compu_IDENTITY 0 65535 PHYS_UNIT "DTC" /end CHARACTERISTIC
/begin CHARACTERISTIC FCdtc_SPK9_IGBT_T "FCtl_DTC(517)" VALUE 0x0016391E /* @ECU_Address@FCtl_DTC@0x021B540A@ */ ECIPP_ALIGNMENT_UWORD 65535 Compu_IDENTITY 0 65535 PHYS_UNIT "DTC" /end CHARACTERISTIC
/begin CHARACTERISTIC FCdtc_SPKD10_coil_fail "FCtl_DTC(313)" VALUE 0x00163786 /* @ECU_Address@FCtl_DTC@0x021B5272@ */ ECIPP_ALIGNMENT_UWORD 65535 Compu_IDENTITY 0 65535 PHYS_UNIT "DTC" /end CHARACTERISTIC
/begin CHARACTERISTIC FCdtc_SPKD10_dw_hi "FCtl_DTC(85)" VALUE 0x001635BE /* @ECU_Address@FCtl_DTC@0x021B50AA@ */ ECIPP_ALIGNMENT_UWORD 65535 Compu_IDENTITY 0 65535 PHYS_UNIT "DTC" /end CHARACTERISTIC
/begin CHARACTERISTIC FCdtc_SPKD10_dw_lo "FCtl_DTC(75)" VALUE 0x001635AA /* @ECU_Address@FCtl_DTC@0x021B5096@ */ ECIPP_ALIGNMENT_UWORD 65535 Compu_IDENTITY 0 65535 PHYS_UNIT "DTC" /end CHARACTERISTIC
/begin CHARACTERISTIC FCdtc_SPKD2_coil_fail "FCtl_DTC(305)" VALUE 0x00163776 /* @ECU_Address@FCtl_DTC@0x021B5262@ */ ECIPP_ALIGNMENT_UWORD 65535 Compu_IDENTITY 0 65535 PHYS_UNIT "DTC" /end CHARACTERISTIC
/begin CHARACTERISTIC FCdtc_SPKD2_dw_hi "FCtl_DTC(77)" VALUE 0x001635AE /* @ECU_Address@FCtl_DTC@0x021B509A@ */ ECIPP_ALIGNMENT_UWORD 65535 Compu_IDENTITY 0 65535 PHYS_UNIT "DTC" /end CHARACTERISTIC
/begin CHARACTERISTIC FCdtc_SPKD2_dw_lo "FCtl_DTC(67)" VALUE 0x0016359A /* @ECU_Address@FCtl_DTC@0x021B5086@ */ ECIPP_ALIGNMENT_UWORD 65535 Compu_IDENTITY 0 65535 PHYS_UNIT "DTC" /end CHARACTERISTIC
/begin CHARACTERISTIC FCdtc_SPKD3_coil_fail "FCtl_DTC(306)" VALUE 0x00163778 /* @ECU_Address@FCtl_DTC@0x021B5264@ */ ECIPP_ALIGNMENT_UWORD 65535 Compu_IDENTITY 0 65535 PHYS_UNIT "DTC" /end CHARACTERISTIC
/begin CHARACTERISTIC FCdtc_SPKD3_dw_hi "FCtl_DTC(78)" VALUE 0x001635B0 /* @ECU_Address@FCtl_DTC@0x021B509C@ */ ECIPP_ALIGNMENT_UWORD 65535 Compu_IDENTITY 0 65535 PHYS_UNIT "DTC" /end CHARACTERISTIC
/begin CHARACTERISTIC FCdtc_SPKD3_dw_lo "FCtl_DTC(68)" VALUE 0x0016359C /* @ECU_Address@FCtl_DTC@0x021B5088@ */ ECIPP_ALIGNMENT_UWORD 65535 Compu_IDENTITY 0 65535 PHYS_UNIT "DTC" /end CHARACTERISTIC
/begin CHARACTERISTIC FCdtc_SPKD4_coil_fail "FCtl_DTC(307)" VALUE 0x0016377A /* @ECU_Address@FCtl_DTC@0x021B5266@ */ ECIPP_ALIGNMENT_UWORD 65535 Compu_IDENTITY 0 65535 PHYS_UNIT "DTC" /end CHARACTERISTIC
/begin CHARACTERISTIC FCdtc_SPKD4_dw_hi "FCtl_DTC(79)" VALUE 0x001635B2 /* @ECU_Address@FCtl_DTC@0x021B509E@ */ ECIPP_ALIGNMENT_UWORD 65535 Compu_IDENTITY 0 65535 PHYS_UNIT "DTC" /end CHARACTERISTIC
/begin CHARACTERISTIC FCdtc_SPKD4_dw_lo "FCtl_DTC(69)" VALUE 0x0016359E /* @ECU_Address@FCtl_DTC@0x021B508A@ */ ECIPP_ALIGNMENT_UWORD 65535 Compu_IDENTITY 0 65535 PHYS_UNIT "DTC" /end CHARACTERISTIC
/begin CHARACTERISTIC FCdtc_SPKD5_coil_fail "FCtl_DTC(308)" VALUE 0x0016377C /* @ECU_Address@FCtl_DTC@0x021B5268@ */ ECIPP_ALIGNMENT_UWORD 65535 Compu_IDENTITY 0 65535 PHYS_UNIT "DTC" /end CHARACTERISTIC
/begin CHARACTERISTIC FCdtc_SPKD5_dw_hi "FCtl_DTC(80)" VALUE 0x001635B4 /* @ECU_Address@FCtl_DTC@0x021B50A0@ */ ECIPP_ALIGNMENT_UWORD 65535 Compu_IDENTITY 0 65535 PHYS_UNIT "DTC" /end CHARACTERISTIC
/begin CHARACTERISTIC FCdtc_SPKD5_dw_lo "FCtl_DTC(70)" VALUE 0x001635A0 /* @ECU_Address@FCtl_DTC@0x021B508C@ */ ECIPP_ALIGNMENT_UWORD 65535 Compu_IDENTITY 0 65535 PHYS_UNIT "DTC" /end CHARACTERISTIC
/begin CHARACTERISTIC FCdtc_SPKD6_coil_fail "FCtl_DTC(309)" VALUE 0x0016377E /* @ECU_Address@FCtl_DTC@0x021B526A@ */ ECIPP_ALIGNMENT_UWORD 65535 Compu_IDENTITY 0 65535 PHYS_UNIT "DTC" /end CHARACTERISTIC
/begin CHARACTERISTIC FCdtc_SPKD6_dw_hi "FCtl_DTC(81)" VALUE 0x001635B6 /* @ECU_Address@FCtl_DTC@0x021B50A2@ */ ECIPP_ALIGNMENT_UWORD 65535 Compu_IDENTITY 0 65535 PHYS_UNIT "DTC" /end CHARACTERISTIC
/begin CHARACTERISTIC FCdtc_SPKD6_dw_lo "FCtl_DTC(71)" VALUE 0x001635A2 /* @ECU_Address@FCtl_DTC@0x021B508E@ */ ECIPP_ALIGNMENT_UWORD 65535 Compu_IDENTITY 0 65535 PHYS_UNIT "DTC" /end CHARACTERISTIC
/begin CHARACTERISTIC FCdtc_SPKD7_coil_fail "FCtl_DTC(310)" VALUE 0x00163780 /* @ECU_Address@FCtl_DTC@0x021B526C@ */ ECIPP_ALIGNMENT_UWORD 65535 Compu_IDENTITY 0 65535 PHYS_UNIT "DTC" /end CHARACTERISTIC
/begin CHARACTERISTIC FCdtc_SPKD7_dw_hi "FCtl_DTC(82)" VALUE 0x001635B8 /* @ECU_Address@FCtl_DTC@0x021B50A4@ */ ECIPP_ALIGNMENT_UWORD 65535 Compu_IDENTITY 0 65535 PHYS_UNIT "DTC" /end CHARACTERISTIC
/begin CHARACTERISTIC FCdtc_SPKD7_dw_lo "FCtl_DTC(72)" VALUE 0x001635A4 /* @ECU_Address@FCtl_DTC@0x021B5090@ */ ECIPP_ALIGNMENT_UWORD 65535 Compu_IDENTITY 0 65535 PHYS_UNIT "DTC" /end CHARACTERISTIC
/begin CHARACTERISTIC FCdtc_SPKD8_coil_fail "FCtl_DTC(311)" VALUE 0x00163782 /* @ECU_Address@FCtl_DTC@0x021B526E@ */ ECIPP_ALIGNMENT_UWORD 65535 Compu_IDENTITY 0 65535 PHYS_UNIT "DTC" /end CHARACTERISTIC
/begin CHARACTERISTIC FCdtc_SPKD8_dw_hi "FCtl_DTC(83)" VALUE 0x001635BA /* @ECU_Address@FCtl_DTC@0x021B50A6@ */ ECIPP_ALIGNMENT_UWORD 65535 Compu_IDENTITY 0 65535 PHYS_UNIT "DTC" /end CHARACTERISTIC
/begin CHARACTERISTIC FCdtc_SPKD8_dw_lo "FCtl_DTC(73)" VALUE 0x001635A6 /* @ECU_Address@FCtl_DTC@0x021B5092@ */ ECIPP_ALIGNMENT_UWORD 65535 Compu_IDENTITY 0 65535 PHYS_UNIT "DTC" /end CHARACTERISTIC
/begin CHARACTERISTIC FCdtc_SPKD9_coil_fail "FCtl_DTC(312)" VALUE 0x00163784 /* @ECU_Address@FCtl_DTC@0x021B5270@ */ ECIPP_ALIGNMENT_UWORD 65535 Compu_IDENTITY 0 65535 PHYS_UNIT "DTC" /end CHARACTERISTIC
/begin CHARACTERISTIC FCdtc_SPKD9_dw_hi "FCtl_DTC(84)" VALUE 0x001635BC /* @ECU_Address@FCtl_DTC@0x021B50A8@ */ ECIPP_ALIGNMENT_UWORD 65535 Compu_IDENTITY 0 65535 PHYS_UNIT "DTC" /end CHARACTERISTIC
/begin CHARACTERISTIC FCdtc_SPKD9_dw_lo "FCtl_DTC(74)" VALUE 0x001635A8 /* @ECU_Address@FCtl_DTC@0x021B5094@ */ ECIPP_ALIGNMENT_UWORD 65535 Compu_IDENTITY 0 65535 PHYS_UNIT "DTC" /end CHARACTERISTIC
/begin CHARACTERISTIC FCdtc_UGF_Hv_lo "FCtl_DTC(243)" VALUE 0x001636FA /* @ECU_Address@FCtl_DTC@0x021B51E6@ */ ECIPP_ALIGNMENT_UWORD 65535 Compu_IDENTITY 0 65535 PHYS_UNIT "DTC" /end CHARACTERISTIC
/begin CHARACTERISTIC FCdtc_UGF1_PR_hi "FCtl_DTC(257)" VALUE 0x00163716 /* @ECU_Address@FCtl_DTC@0x021B5202@ */ ECIPP_ALIGNMENT_UWORD 65535 Compu_IDENTITY 0 65535 PHYS_UNIT "DTC" /end CHARACTERISTIC
/begin CHARACTERISTIC FCdtc_UGF1_PR_lo "FCtl_DTC(258)" VALUE 0x00163718 /* @ECU_Address@FCtl_DTC@0x021B5204@ */ ECIPP_ALIGNMENT_UWORD 65535 Compu_IDENTITY 0 65535 PHYS_UNIT "DTC" /end CHARACTERISTIC
/begin CHARACTERISTIC FCdtc_UGF1_PR_slow "FCtl_DTC(255)" VALUE 0x00163712 /* @ECU_Address@FCtl_DTC@0x021B51FE@ */ ECIPP_ALIGNMENT_UWORD 65535 Compu_IDENTITY 0 65535 PHYS_UNIT "DTC" /end CHARACTERISTIC
/begin CHARACTERISTIC FCdtc_UGF1_Pv_hi "FCtl_DTC(252)" VALUE 0x0016370C /* @ECU_Address@FCtl_DTC@0x021B51F8@ */ ECIPP_ALIGNMENT_UWORD 65535 Compu_IDENTITY 0 65535 PHYS_UNIT "DTC" /end CHARACTERISTIC
/begin CHARACTERISTIC FCdtc_UGF1_Pv_lo "FCtl_DTC(253)" VALUE 0x0016370E /* @ECU_Address@FCtl_DTC@0x021B51FA@ */ ECIPP_ALIGNMENT_UWORD 65535 Compu_IDENTITY 0 65535 PHYS_UNIT "DTC" /end CHARACTERISTIC
/begin CHARACTERISTIC FCdtc_UGF1_PvFB_hi "FCtl_DTC(248)" VALUE 0x00163704 /* @ECU_Address@FCtl_DTC@0x021B51F0@ */ ECIPP_ALIGNMENT_UWORD 65535 Compu_IDENTITY 0 65535 PHYS_UNIT "DTC" /end CHARACTERISTIC
/begin CHARACTERISTIC FCdtc_UGF1_PvFB_lo "FCtl_DTC(249)" VALUE 0x00163706 /* @ECU_Address@FCtl_DTC@0x021B51F2@ */ ECIPP_ALIGNMENT_UWORD 65535 Compu_IDENTITY 0 65535 PHYS_UNIT "DTC" /end CHARACTERISTIC
/begin CHARACTERISTIC FCdtc_UGF1_R_lo "FCtl_DTC(245)" VALUE 0x001636FE /* @ECU_Address@FCtl_DTC@0x021B51EA@ */ ECIPP_ALIGNMENT_UWORD 65535 Compu_IDENTITY 0 65535 PHYS_UNIT "DTC" /end CHARACTERISTIC
/begin CHARACTERISTIC FCdtc_UGF1_rtn_hi "FCtl_DTC(246)" VALUE 0x00163700 /* @ECU_Address@FCtl_DTC@0x021B51EC@ */ ECIPP_ALIGNMENT_UWORD 65535 Compu_IDENTITY 0 65535 PHYS_UNIT "DTC" /end CHARACTERISTIC
/begin CHARACTERISTIC FCdtc_UGF1_rtn_lo "FCtl_DTC(247)" VALUE 0x00163702 /* @ECU_Address@FCtl_DTC@0x021B51EE@ */ ECIPP_ALIGNMENT_UWORD 65535 Compu_IDENTITY 0 65535 PHYS_UNIT "DTC" /end CHARACTERISTIC
/begin CHARACTERISTIC FCdtc_UGF1_Sv_lo "FCtl_DTC(251)" VALUE 0x0016370A /* @ECU_Address@FCtl_DTC@0x021B51F6@ */ ECIPP_ALIGNMENT_UWORD 65535 Compu_IDENTITY 0 65535 PHYS_UNIT "DTC" /end CHARACTERISTIC
/begin CHARACTERISTIC FCdtc_UGF2_Hv_lo "FCtl_DTC(410)" VALUE 0x00163848 /* @ECU_Address@FCtl_DTC@0x021B5334@ */ ECIPP_ALIGNMENT_UWORD 65535 Compu_IDENTITY 0 65535 PHYS_UNIT "DTC" /end CHARACTERISTIC
/begin CHARACTERISTIC FCdtc_UGF2_PR_hi "FCtl_DTC(424)" VALUE 0x00163864 /* @ECU_Address@FCtl_DTC@0x021B5350@ */ ECIPP_ALIGNMENT_UWORD 65535 Compu_IDENTITY 0 65535 PHYS_UNIT "DTC" /end CHARACTERISTIC
/begin CHARACTERISTIC FCdtc_UGF2_PR_lo "FCtl_DTC(425)" VALUE 0x00163866 /* @ECU_Address@FCtl_DTC@0x021B5352@ */ ECIPP_ALIGNMENT_UWORD 65535 Compu_IDENTITY 0 65535 PHYS_UNIT "DTC" /end CHARACTERISTIC
/begin CHARACTERISTIC FCdtc_UGF2_PR_slow "FCtl_DTC(422)" VALUE 0x00163860 /* @ECU_Address@FCtl_DTC@0x021B534C@ */ ECIPP_ALIGNMENT_UWORD 65535 Compu_IDENTITY 0 65535 PHYS_UNIT "DTC" /end CHARACTERISTIC
/begin CHARACTERISTIC FCdtc_UGF2_Pv_hi "FCtl_DTC(419)" VALUE 0x0016385A /* @ECU_Address@FCtl_DTC@0x021B5346@ */ ECIPP_ALIGNMENT_UWORD 65535 Compu_IDENTITY 0 65535 PHYS_UNIT "DTC" /end CHARACTERISTIC
/begin CHARACTERISTIC FCdtc_UGF2_Pv_lo "FCtl_DTC(420)" VALUE 0x0016385C /* @ECU_Address@FCtl_DTC@0x021B5348@ */ ECIPP_ALIGNMENT_UWORD 65535 Compu_IDENTITY 0 65535 PHYS_UNIT "DTC" /end CHARACTERISTIC
/begin CHARACTERISTIC FCdtc_UGF2_PvFB_hi "FCtl_DTC(415)" VALUE 0x00163852 /* @ECU_Address@FCtl_DTC@0x021B533E@ */ ECIPP_ALIGNMENT_UWORD 65535 Compu_IDENTITY 0 65535 PHYS_UNIT "DTC" /end CHARACTERISTIC
/begin CHARACTERISTIC FCdtc_UGF2_PvFB_lo "FCtl_DTC(416)" VALUE 0x00163854 /* @ECU_Address@FCtl_DTC@0x021B5340@ */ ECIPP_ALIGNMENT_UWORD 65535 Compu_IDENTITY 0 65535 PHYS_UNIT "DTC" /end CHARACTERISTIC
/begin CHARACTERISTIC FCdtc_UGF2_R_lo "FCtl_DTC(412)" VALUE 0x0016384C /* @ECU_Address@FCtl_DTC@0x021B5338@ */ ECIPP_ALIGNMENT_UWORD 65535 Compu_IDENTITY 0 65535 PHYS_UNIT "DTC" /end CHARACTERISTIC
/begin CHARACTERISTIC FCdtc_UGF2_rtn_hi "FCtl_DTC(413)" VALUE 0x0016384E /* @ECU_Address@FCtl_DTC@0x021B533A@ */ ECIPP_ALIGNMENT_UWORD 65535 Compu_IDENTITY 0 65535 PHYS_UNIT "DTC" /end CHARACTERISTIC
/begin CHARACTERISTIC FCdtc_UGF2_rtn_lo "FCtl_DTC(414)" VALUE 0x00163850 /* @ECU_Address@FCtl_DTC@0x021B533C@ */ ECIPP_ALIGNMENT_UWORD 65535 Compu_IDENTITY 0 65535 PHYS_UNIT "DTC" /end CHARACTERISTIC
/begin CHARACTERISTIC FCdtc_UGF2_Sv_lo "FCtl_DTC(418)" VALUE 0x00163858 /* @ECU_Address@FCtl_DTC@0x021B5344@ */ ECIPP_ALIGNMENT_UWORD 65535 Compu_IDENTITY 0 65535 PHYS_UNIT "DTC" /end CHARACTERISTIC
/begin CHARACTERISTIC FCdtc_UGF3_Hv_lo "FCtl_DTC(606)" VALUE 0x001639D0 /* @ECU_Address@FCtl_DTC@0x021B54BC@ */ ECIPP_ALIGNMENT_UWORD 65535 Compu_IDENTITY 0 65535 PHYS_UNIT "DTC" /end CHARACTERISTIC
/begin CHARACTERISTIC FCdtc_UGF3_PR_hi "FCtl_DTC(620)" VALUE 0x001639EC /* @ECU_Address@FCtl_DTC@0x021B54D8@ */ ECIPP_ALIGNMENT_UWORD 65535 Compu_IDENTITY 0 65535 PHYS_UNIT "DTC" /end CHARACTERISTIC
/begin CHARACTERISTIC FCdtc_UGF3_PR_lo "FCtl_DTC(621)" VALUE 0x001639EE /* @ECU_Address@FCtl_DTC@0x021B54DA@ */ ECIPP_ALIGNMENT_UWORD 65535 Compu_IDENTITY 0 65535 PHYS_UNIT "DTC" /end CHARACTERISTIC
/begin CHARACTERISTIC FCdtc_UGF3_PR_slow "FCtl_DTC(618)" VALUE 0x001639E8 /* @ECU_Address@FCtl_DTC@0x021B54D4@ */ ECIPP_ALIGNMENT_UWORD 65535 Compu_IDENTITY 0 65535 PHYS_UNIT "DTC" /end CHARACTERISTIC
/begin CHARACTERISTIC FCdtc_UGF3_Pv_hi "FCtl_DTC(615)" VALUE 0x001639E2 /* @ECU_Address@FCtl_DTC@0x021B54CE@ */ ECIPP_ALIGNMENT_UWORD 65535 Compu_IDENTITY 0 65535 PHYS_UNIT "DTC" /end CHARACTERISTIC
/begin CHARACTERISTIC FCdtc_UGF3_Pv_lo "FCtl_DTC(616)" VALUE 0x001639E4 /* @ECU_Address@FCtl_DTC@0x021B54D0@ */ ECIPP_ALIGNMENT_UWORD 65535 Compu_IDENTITY 0 65535 PHYS_UNIT "DTC" /end CHARACTERISTIC
/begin CHARACTERISTIC FCdtc_UGF3_PvFB_hi "FCtl_DTC(611)" VALUE 0x001639DA /* @ECU_Address@FCtl_DTC@0x021B54C6@ */ ECIPP_ALIGNMENT_UWORD 65535 Compu_IDENTITY 0 65535 PHYS_UNIT "DTC" /end CHARACTERISTIC
/begin CHARACTERISTIC FCdtc_UGF3_PvFB_lo "FCtl_DTC(612)" VALUE 0x001639DC /* @ECU_Address@FCtl_DTC@0x021B54C8@ */ ECIPP_ALIGNMENT_UWORD 65535 Compu_IDENTITY 0 65535 PHYS_UNIT "DTC" /end CHARACTERISTIC
/begin CHARACTERISTIC FCdtc_UGF3_R_lo "FCtl_DTC(608)" VALUE 0x001639D4 /* @ECU_Address@FCtl_DTC@0x021B54C0@ */ ECIPP_ALIGNMENT_UWORD 65535 Compu_IDENTITY 0 65535 PHYS_UNIT "DTC" /end CHARACTERISTIC
/begin CHARACTERISTIC FCdtc_UGF3_rtn_hi "FCtl_DTC(609)" VALUE 0x001639D6 /* @ECU_Address@FCtl_DTC@0x021B54C2@ */ ECIPP_ALIGNMENT_UWORD 65535 Compu_IDENTITY 0 65535 PHYS_UNIT "DTC" /end CHARACTERISTIC
/begin CHARACTERISTIC FCdtc_UGF3_rtn_lo "FCtl_DTC(610)" VALUE 0x001639D8 /* @ECU_Address@FCtl_DTC@0x021B54C4@ */ ECIPP_ALIGNMENT_UWORD 65535 Compu_IDENTITY 0 65535 PHYS_UNIT "DTC" /end CHARACTERISTIC
/begin CHARACTERISTIC FCdtc_UGF3_Sv_lo "FCtl_DTC(614)" VALUE 0x001639E0 /* @ECU_Address@FCtl_DTC@0x021B54CC@ */ ECIPP_ALIGNMENT_UWORD 65535 Compu_IDENTITY 0 65535 PHYS_UNIT "DTC" /end CHARACTERISTIC
/begin CHARACTERISTIC FCdtc_UGF4_Hv_lo "FCtl_DTC(629)" VALUE 0x001639FE /* @ECU_Address@FCtl_DTC@0x021B54EA@ */ ECIPP_ALIGNMENT_UWORD 65535 Compu_IDENTITY 0 65535 PHYS_UNIT "DTC" /end CHARACTERISTIC
/begin CHARACTERISTIC FCdtc_UGF4_PR_hi "FCtl_DTC(643)" VALUE 0x00163A1A /* @ECU_Address@FCtl_DTC@0x021B5506@ */ ECIPP_ALIGNMENT_UWORD 65535 Compu_IDENTITY 0 65535 PHYS_UNIT "DTC" /end CHARACTERISTIC
/begin CHARACTERISTIC FCdtc_UGF4_PR_lo "FCtl_DTC(644)" VALUE 0x00163A1C /* @ECU_Address@FCtl_DTC@0x021B5508@ */ ECIPP_ALIGNMENT_UWORD 65535 Compu_IDENTITY 0 65535 PHYS_UNIT "DTC" /end CHARACTERISTIC
/begin CHARACTERISTIC FCdtc_UGF4_PR_slow "FCtl_DTC(641)" VALUE 0x00163A16 /* @ECU_Address@FCtl_DTC@0x021B5502@ */ ECIPP_ALIGNMENT_UWORD 65535 Compu_IDENTITY 0 65535 PHYS_UNIT "DTC" /end CHARACTERISTIC
/begin CHARACTERISTIC FCdtc_UGF4_Pv_hi "FCtl_DTC(638)" VALUE 0x00163A10 /* @ECU_Address@FCtl_DTC@0x021B54FC@ */ ECIPP_ALIGNMENT_UWORD 65535 Compu_IDENTITY 0 65535 PHYS_UNIT "DTC" /end CHARACTERISTIC
/begin CHARACTERISTIC FCdtc_UGF4_Pv_lo "FCtl_DTC(639)" VALUE 0x00163A12 /* @ECU_Address@FCtl_DTC@0x021B54FE@ */ ECIPP_ALIGNMENT_UWORD 65535 Compu_IDENTITY 0 65535 PHYS_UNIT "DTC" /end CHARACTERISTIC
/begin CHARACTERISTIC FCdtc_UGF4_PvFB_hi "FCtl_DTC(634)" VALUE 0x00163A08 /* @ECU_Address@FCtl_DTC@0x021B54F4@ */ ECIPP_ALIGNMENT_UWORD 65535 Compu_IDENTITY 0 65535 PHYS_UNIT "DTC" /end CHARACTERISTIC
/begin CHARACTERISTIC FCdtc_UGF4_PvFB_lo "FCtl_DTC(635)" VALUE 0x00163A0A /* @ECU_Address@FCtl_DTC@0x021B54F6@ */ ECIPP_ALIGNMENT_UWORD 65535 Compu_IDENTITY 0 65535 PHYS_UNIT "DTC" /end CHARACTERISTIC
/begin CHARACTERISTIC FCdtc_UGF4_R_lo "FCtl_DTC(631)" VALUE 0x00163A02 /* @ECU_Address@FCtl_DTC@0x021B54EE@ */ ECIPP_ALIGNMENT_UWORD 65535 Compu_IDENTITY 0 65535 PHYS_UNIT "DTC" /end CHARACTERISTIC
/begin CHARACTERISTIC FCdtc_UGF4_rtn_hi "FCtl_DTC(632)" VALUE 0x00163A04 /* @ECU_Address@FCtl_DTC@0x021B54F0@ */ ECIPP_ALIGNMENT_UWORD 65535 Compu_IDENTITY 0 65535 PHYS_UNIT "DTC" /end CHARACTERISTIC
/begin CHARACTERISTIC FCdtc_UGF4_rtn_lo "FCtl_DTC(633)" VALUE 0x00163A06 /* @ECU_Address@FCtl_DTC@0x021B54F2@ */ ECIPP_ALIGNMENT_UWORD 65535 Compu_IDENTITY 0 65535 PHYS_UNIT "DTC" /end CHARACTERISTIC
/begin CHARACTERISTIC FCdtc_UGF4_Sv_lo "FCtl_DTC(637)" VALUE 0x00163A0E /* @ECU_Address@FCtl_DTC@0x021B54FA@ */ ECIPP_ALIGNMENT_UWORD 65535 Compu_IDENTITY 0 65535 PHYS_UNIT "DTC" /end CHARACTERISTIC
/begin CHARACTERISTIC FCfmi_AL2_hi "FCtl_FMI(40)" VALUE 0x0016513B /* @ECU_Address@FCtl_FMI@0x021B7028@ */ ECIPP_ALIGNMENT_UBYTE 255 Compu_IDENTITY 0 255 PHYS_UNIT "FMI" /end CHARACTERISTIC
/begin CHARACTERISTIC FCfmi_AL2_lo "FCtl_FMI(41)" VALUE 0x0016513C /* @ECU_Address@FCtl_FMI@0x021B7029@ */ ECIPP_ALIGNMENT_UBYTE 255 Compu_IDENTITY 0 255 PHYS_UNIT "FMI" /end CHARACTERISTIC
/begin CHARACTERISTIC FCfmi_CFVxminFT "FCtl_FMI(533)" VALUE 0x00165328 /* @ECU_Address@FCtl_FMI@0x021B7215@ */ ECIPP_ALIGNMENT_UBYTE 255 Compu_IDENTITY 0 255 PHYS_UNIT "FMI" /end CHARACTERISTIC
/begin CHARACTERISTIC FCfmi_CL2_hi "FCtl_FMI(34)" VALUE 0x00165135 /* @ECU_Address@FCtl_FMI@0x021B7022@ */ ECIPP_ALIGNMENT_UBYTE 255 Compu_IDENTITY 0 255 PHYS_UNIT "FMI" /end CHARACTERISTIC
/begin CHARACTERISTIC FCfmi_CL2_lo "FCtl_FMI(35)" VALUE 0x00165136 /* @ECU_Address@FCtl_FMI@0x021B7023@ */ ECIPP_ALIGNMENT_UBYTE 255 Compu_IDENTITY 0 255 PHYS_UNIT "FMI" /end CHARACTERISTIC
/begin CHARACTERISTIC FCfmi_CM2_unresp "FCtl_FMI(800)" VALUE 0x00165433 /* @ECU_Address@FCtl_FMI@0x021B7320@ */ ECIPP_ALIGNMENT_UBYTE 255 Compu_IDENTITY 0 255 PHYS_UNIT "FMI" /end CHARACTERISTIC
/begin CHARACTERISTIC FCfmi_CM2gsln_inact "FCtl_FMI(199)" VALUE 0x001651DA /* @ECU_Address@FCtl_FMI@0x021B70C7@ */ ECIPP_ALIGNMENT_UBYTE 255 Compu_IDENTITY 0 255 PHYS_UNIT "FMI" /end CHARACTERISTIC
/begin CHARACTERISTIC FCfmi_EGO4_open "FCtl_FMI(200)" VALUE 0x001651DB /* @ECU_Address@FCtl_FMI@0x021B70C8@ */ ECIPP_ALIGNMENT_UBYTE 255 Compu_IDENTITY 0 255 PHYS_UNIT "FMI" /end CHARACTERISTIC
/begin CHARACTERISTIC FCfmi_EMWT2_HiExp1 "FCtl_FMI(226)" VALUE 0x001651F5 /* @ECU_Address@FCtl_FMI@0x021B70E2@ */ ECIPP_ALIGNMENT_UBYTE 255 Compu_IDENTITY 0 255 PHYS_UNIT "FMI" /end CHARACTERISTIC
/begin CHARACTERISTIC FCfmi_EMWT2_HiExp2 "FCtl_FMI(228)" VALUE 0x001651F7 /* @ECU_Address@FCtl_FMI@0x021B70E4@ */ ECIPP_ALIGNMENT_UBYTE 255 Compu_IDENTITY 0 255 PHYS_UNIT "FMI" /end CHARACTERISTIC
/begin CHARACTERISTIC FCfmi_EMWT2_maxv "FCtl_FMI(222)" VALUE 0x001651F1 /* @ECU_Address@FCtl_FMI@0x021B70DE@ */ ECIPP_ALIGNMENT_UBYTE 255 Compu_IDENTITY 0 255 PHYS_UNIT "FMI" /end CHARACTERISTIC
/begin CHARACTERISTIC FCfmi_EMWT2_minv "FCtl_FMI(224)" VALUE 0x001651F3 /* @ECU_Address@FCtl_FMI@0x021B70E0@ */ ECIPP_ALIGNMENT_UBYTE 255 Compu_IDENTITY 0 255 PHYS_UNIT "FMI" /end CHARACTERISTIC
/begin CHARACTERISTIC FCfmi_ERWT2_HiExp1 "FCtl_FMI(238)" VALUE 0x00165201 /* @ECU_Address@FCtl_FMI@0x021B70EE@ */ ECIPP_ALIGNMENT_UBYTE 255 Compu_IDENTITY 0 255 PHYS_UNIT "FMI" /end CHARACTERISTIC
/begin CHARACTERISTIC FCfmi_ERWT2_HiExp2 "FCtl_FMI(240)" VALUE 0x00165203 /* @ECU_Address@FCtl_FMI@0x021B70F0@ */ ECIPP_ALIGNMENT_UBYTE 255 Compu_IDENTITY 0 255 PHYS_UNIT "FMI" /end CHARACTERISTIC
/begin CHARACTERISTIC FCfmi_ERWT2_maxv "FCtl_FMI(234)" VALUE 0x001651FD /* @ECU_Address@FCtl_FMI@0x021B70EA@ */ ECIPP_ALIGNMENT_UBYTE 255 Compu_IDENTITY 0 255 PHYS_UNIT "FMI" /end CHARACTERISTIC
/begin CHARACTERISTIC FCfmi_ERWT2_minv "FCtl_FMI(236)" VALUE 0x001651FF /* @ECU_Address@FCtl_FMI@0x021B70EC@ */ ECIPP_ALIGNMENT_UBYTE 255 Compu_IDENTITY 0 255 PHYS_UNIT "FMI" /end CHARACTERISTIC
/begin CHARACTERISTIC FCfmi_GLOW10_open "FCtl_FMI(492)" VALUE 0x001652FF /* @ECU_Address@FCtl_FMI@0x021B71EC@ */ ECIPP_ALIGNMENT_UBYTE 255 Compu_IDENTITY 0 255 PHYS_UNIT "FMI" /end CHARACTERISTIC
/begin CHARACTERISTIC FCfmi_GLOW10_short "FCtl_FMI(502)" VALUE 0x00165309 /* @ECU_Address@FCtl_FMI@0x021B71F6@ */ ECIPP_ALIGNMENT_UBYTE 255 Compu_IDENTITY 0 255 PHYS_UNIT "FMI" /end CHARACTERISTIC
/begin CHARACTERISTIC FCfmi_GLOW2_open "FCtl_FMI(484)" VALUE 0x001652F7 /* @ECU_Address@FCtl_FMI@0x021B71E4@ */ ECIPP_ALIGNMENT_UBYTE 255 Compu_IDENTITY 0 255 PHYS_UNIT "FMI" /end CHARACTERISTIC
/begin CHARACTERISTIC FCfmi_GLOW2_short "FCtl_FMI(494)" VALUE 0x00165301 /* @ECU_Address@FCtl_FMI@0x021B71EE@ */ ECIPP_ALIGNMENT_UBYTE 255 Compu_IDENTITY 0 255 PHYS_UNIT "FMI" /end CHARACTERISTIC
/begin CHARACTERISTIC FCfmi_GLOW3_open "FCtl_FMI(485)" VALUE 0x001652F8 /* @ECU_Address@FCtl_FMI@0x021B71E5@ */ ECIPP_ALIGNMENT_UBYTE 255 Compu_IDENTITY 0 255 PHYS_UNIT "FMI" /end CHARACTERISTIC
/begin CHARACTERISTIC FCfmi_GLOW3_short "FCtl_FMI(495)" VALUE 0x00165302 /* @ECU_Address@FCtl_FMI@0x021B71EF@ */ ECIPP_ALIGNMENT_UBYTE 255 Compu_IDENTITY 0 255 PHYS_UNIT "FMI" /end CHARACTERISTIC
/begin CHARACTERISTIC FCfmi_GLOW4_open "FCtl_FMI(486)" VALUE 0x001652F9 /* @ECU_Address@FCtl_FMI@0x021B71E6@ */ ECIPP_ALIGNMENT_UBYTE 255 Compu_IDENTITY 0 255 PHYS_UNIT "FMI" /end CHARACTERISTIC
/begin CHARACTERISTIC FCfmi_GLOW4_short "FCtl_FMI(496)" VALUE 0x00165303 /* @ECU_Address@FCtl_FMI@0x021B71F0@ */ ECIPP_ALIGNMENT_UBYTE 255 Compu_IDENTITY 0 255 PHYS_UNIT "FMI" /end CHARACTERISTIC
/begin CHARACTERISTIC FCfmi_GLOW5_open "FCtl_FMI(487)" VALUE 0x001652FA /* @ECU_Address@FCtl_FMI@0x021B71E7@ */ ECIPP_ALIGNMENT_UBYTE 255 Compu_IDENTITY 0 255 PHYS_UNIT "FMI" /end CHARACTERISTIC
/begin CHARACTERISTIC FCfmi_GLOW5_short "FCtl_FMI(497)" VALUE 0x00165304 /* @ECU_Address@FCtl_FMI@0x021B71F1@ */ ECIPP_ALIGNMENT_UBYTE 255 Compu_IDENTITY 0 255 PHYS_UNIT "FMI" /end CHARACTERISTIC
/begin CHARACTERISTIC FCfmi_GLOW6_open "FCtl_FMI(488)" VALUE 0x001652FB /* @ECU_Address@FCtl_FMI@0x021B71E8@ */ ECIPP_ALIGNMENT_UBYTE 255 Compu_IDENTITY 0 255 PHYS_UNIT "FMI" /end CHARACTERISTIC
/begin CHARACTERISTIC FCfmi_GLOW6_short "FCtl_FMI(498)" VALUE 0x00165305 /* @ECU_Address@FCtl_FMI@0x021B71F2@ */ ECIPP_ALIGNMENT_UBYTE 255 Compu_IDENTITY 0 255 PHYS_UNIT "FMI" /end CHARACTERISTIC
/begin CHARACTERISTIC FCfmi_GLOW7_open "FCtl_FMI(489)" VALUE 0x001652FC /* @ECU_Address@FCtl_FMI@0x021B71E9@ */ ECIPP_ALIGNMENT_UBYTE 255 Compu_IDENTITY 0 255 PHYS_UNIT "FMI" /end CHARACTERISTIC
/begin CHARACTERISTIC FCfmi_GLOW7_short "FCtl_FMI(499)" VALUE 0x00165306 /* @ECU_Address@FCtl_FMI@0x021B71F3@ */ ECIPP_ALIGNMENT_UBYTE 255 Compu_IDENTITY 0 255 PHYS_UNIT "FMI" /end CHARACTERISTIC
/begin CHARACTERISTIC FCfmi_GLOW8_open "FCtl_FMI(490)" VALUE 0x001652FD /* @ECU_Address@FCtl_FMI@0x021B71EA@ */ ECIPP_ALIGNMENT_UBYTE 255 Compu_IDENTITY 0 255 PHYS_UNIT "FMI" /end CHARACTERISTIC
/begin CHARACTERISTIC FCfmi_GLOW8_short "FCtl_FMI(500)" VALUE 0x00165307 /* @ECU_Address@FCtl_FMI@0x021B71F4@ */ ECIPP_ALIGNMENT_UBYTE 255 Compu_IDENTITY 0 255 PHYS_UNIT "FMI" /end CHARACTERISTIC
/begin CHARACTERISTIC FCfmi_GLOW9_open "FCtl_FMI(491)" VALUE 0x001652FE /* @ECU_Address@FCtl_FMI@0x021B71EB@ */ ECIPP_ALIGNMENT_UBYTE 255 Compu_IDENTITY 0 255 PHYS_UNIT "FMI" /end CHARACTERISTIC
/begin CHARACTERISTIC FCfmi_GLOW9_short "FCtl_FMI(501)" VALUE 0x00165308 /* @ECU_Address@FCtl_FMI@0x021B71F5@ */ ECIPP_ALIGNMENT_UBYTE 255 Compu_IDENTITY 0 255 PHYS_UNIT "FMI" /end CHARACTERISTIC
/begin CHARACTERISTIC FCfmi_ICAVD10_mis "FCtl_FMI(315)" VALUE 0x0016524E /* @ECU_Address@FCtl_FMI@0x021B713B@ */ ECIPP_ALIGNMENT_UBYTE 255 Compu_IDENTITY 0 255 PHYS_UNIT "FMI" /end CHARACTERISTIC
/begin CHARACTERISTIC FCfmi_ICAVD10_miscat "FCtl_FMI(317)" VALUE 0x00165250 /* @ECU_Address@FCtl_FMI@0x021B713D@ */ ECIPP_ALIGNMENT_UBYTE 255 Compu_IDENTITY 0 255 PHYS_UNIT "FMI" /end CHARACTERISTIC
/begin CHARACTERISTIC FCfmi_ICAVD2_mis "FCtl_FMI(260)" VALUE 0x00165217 /* @ECU_Address@FCtl_FMI@0x021B7104@ */ ECIPP_ALIGNMENT_UBYTE 255 Compu_IDENTITY 0 255 PHYS_UNIT "FMI" /end CHARACTERISTIC
/begin CHARACTERISTIC FCfmi_ICAVD2_miscat "FCtl_FMI(268)" VALUE 0x0016521F /* @ECU_Address@FCtl_FMI@0x021B710C@ */ ECIPP_ALIGNMENT_UBYTE 255 Compu_IDENTITY 0 255 PHYS_UNIT "FMI" /end CHARACTERISTIC
/begin CHARACTERISTIC FCfmi_ICAVD3_mis "FCtl_FMI(261)" VALUE 0x00165218 /* @ECU_Address@FCtl_FMI@0x021B7105@ */ ECIPP_ALIGNMENT_UBYTE 255 Compu_IDENTITY 0 255 PHYS_UNIT "FMI" /end CHARACTERISTIC
/begin CHARACTERISTIC FCfmi_ICAVD3_miscat "FCtl_FMI(269)" VALUE 0x00165220 /* @ECU_Address@FCtl_FMI@0x021B710D@ */ ECIPP_ALIGNMENT_UBYTE 255 Compu_IDENTITY 0 255 PHYS_UNIT "FMI" /end CHARACTERISTIC
/begin CHARACTERISTIC FCfmi_ICAVD4_mis "FCtl_FMI(262)" VALUE 0x00165219 /* @ECU_Address@FCtl_FMI@0x021B7106@ */ ECIPP_ALIGNMENT_UBYTE 255 Compu_IDENTITY 0 255 PHYS_UNIT "FMI" /end CHARACTERISTIC
/begin CHARACTERISTIC FCfmi_ICAVD4_miscat "FCtl_FMI(270)" VALUE 0x00165221 /* @ECU_Address@FCtl_FMI@0x021B710E@ */ ECIPP_ALIGNMENT_UBYTE 255 Compu_IDENTITY 0 255 PHYS_UNIT "FMI" /end CHARACTERISTIC
/begin CHARACTERISTIC FCfmi_ICAVD5_mis "FCtl_FMI(263)" VALUE 0x0016521A /* @ECU_Address@FCtl_FMI@0x021B7107@ */ ECIPP_ALIGNMENT_UBYTE 255 Compu_IDENTITY 0 255 PHYS_UNIT "FMI" /end CHARACTERISTIC
/begin CHARACTERISTIC FCfmi_ICAVD5_miscat "FCtl_FMI(271)" VALUE 0x00165222 /* @ECU_Address@FCtl_FMI@0x021B710F@ */ ECIPP_ALIGNMENT_UBYTE 255 Compu_IDENTITY 0 255 PHYS_UNIT "FMI" /end CHARACTERISTIC
/begin CHARACTERISTIC FCfmi_ICAVD6_mis "FCtl_FMI(264)" VALUE 0x0016521B /* @ECU_Address@FCtl_FMI@0x021B7108@ */ ECIPP_ALIGNMENT_UBYTE 255 Compu_IDENTITY 0 255 PHYS_UNIT "FMI" /end CHARACTERISTIC
/begin CHARACTERISTIC FCfmi_ICAVD6_miscat "FCtl_FMI(272)" VALUE 0x00165223 /* @ECU_Address@FCtl_FMI@0x021B7110@ */ ECIPP_ALIGNMENT_UBYTE 255 Compu_IDENTITY 0 255 PHYS_UNIT "FMI" /end CHARACTERISTIC
/begin CHARACTERISTIC FCfmi_ICAVD7_mis "FCtl_FMI(265)" VALUE 0x0016521C /* @ECU_Address@FCtl_FMI@0x021B7109@ */ ECIPP_ALIGNMENT_UBYTE 255 Compu_IDENTITY 0 255 PHYS_UNIT "FMI" /end CHARACTERISTIC
/begin CHARACTERISTIC FCfmi_ICAVD7_miscat "FCtl_FMI(273)" VALUE 0x00165224 /* @ECU_Address@FCtl_FMI@0x021B7111@ */ ECIPP_ALIGNMENT_UBYTE 255 Compu_IDENTITY 0 255 PHYS_UNIT "FMI" /end CHARACTERISTIC
/begin CHARACTERISTIC FCfmi_ICAVD8_mis "FCtl_FMI(266)" VALUE 0x0016521D /* @ECU_Address@FCtl_FMI@0x021B710A@ */ ECIPP_ALIGNMENT_UBYTE 255 Compu_IDENTITY 0 255 PHYS_UNIT "FMI" /end CHARACTERISTIC
/begin CHARACTERISTIC FCfmi_ICAVD8_miscat "FCtl_FMI(274)" VALUE 0x00165225 /* @ECU_Address@FCtl_FMI@0x021B7112@ */ ECIPP_ALIGNMENT_UBYTE 255 Compu_IDENTITY 0 255 PHYS_UNIT "FMI" /end CHARACTERISTIC
/begin CHARACTERISTIC FCfmi_ICAVD9_mis "FCtl_FMI(314)" VALUE 0x0016524D /* @ECU_Address@FCtl_FMI@0x021B713A@ */ ECIPP_ALIGNMENT_UBYTE 255 Compu_IDENTITY 0 255 PHYS_UNIT "FMI" /end CHARACTERISTIC
/begin CHARACTERISTIC FCfmi_ICAVD9_miscat "FCtl_FMI(316)" VALUE 0x0016524F /* @ECU_Address@FCtl_FMI@0x021B713C@ */ ECIPP_ALIGNMENT_UBYTE 255 Compu_IDENTITY 0 255 PHYS_UNIT "FMI" /end CHARACTERISTIC
/begin CHARACTERISTIC FCfmi_INJD10_off_lo "FCtl_FMI(55)" VALUE 0x0016514A /* @ECU_Address@FCtl_FMI@0x021B7037@ */ ECIPP_ALIGNMENT_UBYTE 255 Compu_IDENTITY 0 255 PHYS_UNIT "FMI" /end CHARACTERISTIC
/begin CHARACTERISTIC FCfmi_INJD10_on_hi "FCtl_FMI(65)" VALUE 0x00165154 /* @ECU_Address@FCtl_FMI@0x021B7041@ */ ECIPP_ALIGNMENT_UBYTE 255 Compu_IDENTITY 0 255 PHYS_UNIT "FMI" /end CHARACTERISTIC
/begin CHARACTERISTIC FCfmi_INJD2_boost_lo "FCtl_FMI(579)" VALUE 0x00165356 /* @ECU_Address@FCtl_FMI@0x021B7243@ */ ECIPP_ALIGNMENT_UBYTE 255 Compu_IDENTITY 0 255 PHYS_UNIT "FMI" /end CHARACTERISTIC
/begin CHARACTERISTIC FCfmi_INJD2_HS_Ihi "FCtl_FMI(563)" VALUE 0x00165346 /* @ECU_Address@FCtl_FMI@0x021B7233@ */ ECIPP_ALIGNMENT_UBYTE 255 Compu_IDENTITY 0 255 PHYS_UNIT "FMI" /end CHARACTERISTIC
/begin CHARACTERISTIC FCfmi_INJD2_HW_int "FCtl_FMI(581)" VALUE 0x00165358 /* @ECU_Address@FCtl_FMI@0x021B7245@ */ ECIPP_ALIGNMENT_UBYTE 255 Compu_IDENTITY 0 255 PHYS_UNIT "FMI" /end CHARACTERISTIC
/begin CHARACTERISTIC FCfmi_INJD2_LS_Ihi "FCtl_FMI(571)" VALUE 0x0016534E /* @ECU_Address@FCtl_FMI@0x021B723B@ */ ECIPP_ALIGNMENT_UBYTE 255 Compu_IDENTITY 0 255 PHYS_UNIT "FMI" /end CHARACTERISTIC
/begin CHARACTERISTIC FCfmi_INJD2_off_lo "FCtl_FMI(47)" VALUE 0x00165142 /* @ECU_Address@FCtl_FMI@0x021B702F@ */ ECIPP_ALIGNMENT_UBYTE 255 Compu_IDENTITY 0 255 PHYS_UNIT "FMI" /end CHARACTERISTIC
/begin CHARACTERISTIC FCfmi_INJD2_on_hi "FCtl_FMI(57)" VALUE 0x0016514C /* @ECU_Address@FCtl_FMI@0x021B7039@ */ ECIPP_ALIGNMENT_UBYTE 255 Compu_IDENTITY 0 255 PHYS_UNIT "FMI" /end CHARACTERISTIC
/begin CHARACTERISTIC FCfmi_INJD3_HS_Ihi "FCtl_FMI(564)" VALUE 0x00165347 /* @ECU_Address@FCtl_FMI@0x021B7234@ */ ECIPP_ALIGNMENT_UBYTE 255 Compu_IDENTITY 0 255 PHYS_UNIT "FMI" /end CHARACTERISTIC
/begin CHARACTERISTIC FCfmi_INJD3_LS_Ihi "FCtl_FMI(572)" VALUE 0x0016534F /* @ECU_Address@FCtl_FMI@0x021B723C@ */ ECIPP_ALIGNMENT_UBYTE 255 Compu_IDENTITY 0 255 PHYS_UNIT "FMI" /end CHARACTERISTIC
/begin CHARACTERISTIC FCfmi_INJD3_off_lo "FCtl_FMI(48)" VALUE 0x00165143 /* @ECU_Address@FCtl_FMI@0x021B7030@ */ ECIPP_ALIGNMENT_UBYTE 255 Compu_IDENTITY 0 255 PHYS_UNIT "FMI" /end CHARACTERISTIC
/begin CHARACTERISTIC FCfmi_INJD3_on_hi "FCtl_FMI(58)" VALUE 0x0016514D /* @ECU_Address@FCtl_FMI@0x021B703A@ */ ECIPP_ALIGNMENT_UBYTE 255 Compu_IDENTITY 0 255 PHYS_UNIT "FMI" /end CHARACTERISTIC
/begin CHARACTERISTIC FCfmi_INJD4_HS_Ihi "FCtl_FMI(565)" VALUE 0x00165348 /* @ECU_Address@FCtl_FMI@0x021B7235@ */ ECIPP_ALIGNMENT_UBYTE 255 Compu_IDENTITY 0 255 PHYS_UNIT "FMI" /end CHARACTERISTIC
/begin CHARACTERISTIC FCfmi_INJD4_LS_Ihi "FCtl_FMI(573)" VALUE 0x00165350 /* @ECU_Address@FCtl_FMI@0x021B723D@ */ ECIPP_ALIGNMENT_UBYTE 255 Compu_IDENTITY 0 255 PHYS_UNIT "FMI" /end CHARACTERISTIC
/begin CHARACTERISTIC FCfmi_INJD4_off_lo "FCtl_FMI(49)" VALUE 0x00165144 /* @ECU_Address@FCtl_FMI@0x021B7031@ */ ECIPP_ALIGNMENT_UBYTE 255 Compu_IDENTITY 0 255 PHYS_UNIT "FMI" /end CHARACTERISTIC
/begin CHARACTERISTIC FCfmi_INJD4_on_hi "FCtl_FMI(59)" VALUE 0x0016514E /* @ECU_Address@FCtl_FMI@0x021B703B@ */ ECIPP_ALIGNMENT_UBYTE 255 Compu_IDENTITY 0 255 PHYS_UNIT "FMI" /end CHARACTERISTIC
/begin CHARACTERISTIC FCfmi_INJD5_HS_Ihi "FCtl_FMI(566)" VALUE 0x00165349 /* @ECU_Address@FCtl_FMI@0x021B7236@ */ ECIPP_ALIGNMENT_UBYTE 255 Compu_IDENTITY 0 255 PHYS_UNIT "FMI" /end CHARACTERISTIC
/begin CHARACTERISTIC FCfmi_INJD5_LS_Ihi "FCtl_FMI(574)" VALUE 0x00165351 /* @ECU_Address@FCtl_FMI@0x021B723E@ */ ECIPP_ALIGNMENT_UBYTE 255 Compu_IDENTITY 0 255 PHYS_UNIT "FMI" /end CHARACTERISTIC
/begin CHARACTERISTIC FCfmi_INJD5_off_lo "FCtl_FMI(50)" VALUE 0x00165145 /* @ECU_Address@FCtl_FMI@0x021B7032@ */ ECIPP_ALIGNMENT_UBYTE 255 Compu_IDENTITY 0 255 PHYS_UNIT "FMI" /end CHARACTERISTIC
/begin CHARACTERISTIC FCfmi_INJD5_on_hi "FCtl_FMI(60)" VALUE 0x0016514F /* @ECU_Address@FCtl_FMI@0x021B703C@ */ ECIPP_ALIGNMENT_UBYTE 255 Compu_IDENTITY 0 255 PHYS_UNIT "FMI" /end CHARACTERISTIC
/begin CHARACTERISTIC FCfmi_INJD6_HS_Ihi "FCtl_FMI(567)" VALUE 0x0016534A /* @ECU_Address@FCtl_FMI@0x021B7237@ */ ECIPP_ALIGNMENT_UBYTE 255 Compu_IDENTITY 0 255 PHYS_UNIT "FMI" /end CHARACTERISTIC
/begin CHARACTERISTIC FCfmi_INJD6_LS_Ihi "FCtl_FMI(575)" VALUE 0x00165352 /* @ECU_Address@FCtl_FMI@0x021B723F@ */ ECIPP_ALIGNMENT_UBYTE 255 Compu_IDENTITY 0 255 PHYS_UNIT "FMI" /end CHARACTERISTIC
/begin CHARACTERISTIC FCfmi_INJD6_off_lo "FCtl_FMI(51)" VALUE 0x00165146 /* @ECU_Address@FCtl_FMI@0x021B7033@ */ ECIPP_ALIGNMENT_UBYTE 255 Compu_IDENTITY 0 255 PHYS_UNIT "FMI" /end CHARACTERISTIC
/begin CHARACTERISTIC FCfmi_INJD6_on_hi "FCtl_FMI(61)" VALUE 0x00165150 /* @ECU_Address@FCtl_FMI@0x021B703D@ */ ECIPP_ALIGNMENT_UBYTE 255 Compu_IDENTITY 0 255 PHYS_UNIT "FMI" /end CHARACTERISTIC
/begin CHARACTERISTIC FCfmi_INJD7_HS_Ihi "FCtl_FMI(568)" VALUE 0x0016534B /* @ECU_Address@FCtl_FMI@0x021B7238@ */ ECIPP_ALIGNMENT_UBYTE 255 Compu_IDENTITY 0 255 PHYS_UNIT "FMI" /end CHARACTERISTIC
/begin CHARACTERISTIC FCfmi_INJD7_LS_Ihi "FCtl_FMI(576)" VALUE 0x00165353 /* @ECU_Address@FCtl_FMI@0x021B7240@ */ ECIPP_ALIGNMENT_UBYTE 255 Compu_IDENTITY 0 255 PHYS_UNIT "FMI" /end CHARACTERISTIC
/begin CHARACTERISTIC FCfmi_INJD7_off_lo "FCtl_FMI(52)" VALUE 0x00165147 /* @ECU_Address@FCtl_FMI@0x021B7034@ */ ECIPP_ALIGNMENT_UBYTE 255 Compu_IDENTITY 0 255 PHYS_UNIT "FMI" /end CHARACTERISTIC
/begin CHARACTERISTIC FCfmi_INJD7_on_hi "FCtl_FMI(62)" VALUE 0x00165151 /* @ECU_Address@FCtl_FMI@0x021B703E@ */ ECIPP_ALIGNMENT_UBYTE 255 Compu_IDENTITY 0 255 PHYS_UNIT "FMI" /end CHARACTERISTIC
/begin CHARACTERISTIC FCfmi_INJD8_HS_Ihi "FCtl_FMI(569)" VALUE 0x0016534C /* @ECU_Address@FCtl_FMI@0x021B7239@ */ ECIPP_ALIGNMENT_UBYTE 255 Compu_IDENTITY 0 255 PHYS_UNIT "FMI" /end CHARACTERISTIC
/begin CHARACTERISTIC FCfmi_INJD8_LS_Ihi "FCtl_FMI(577)" VALUE 0x00165354 /* @ECU_Address@FCtl_FMI@0x021B7241@ */ ECIPP_ALIGNMENT_UBYTE 255 Compu_IDENTITY 0 255 PHYS_UNIT "FMI" /end CHARACTERISTIC
/begin CHARACTERISTIC FCfmi_INJD8_off_lo "FCtl_FMI(53)" VALUE 0x00165148 /* @ECU_Address@FCtl_FMI@0x021B7035@ */ ECIPP_ALIGNMENT_UBYTE 255 Compu_IDENTITY 0 255 PHYS_UNIT "FMI" /end CHARACTERISTIC
/begin CHARACTERISTIC FCfmi_INJD8_on_hi "FCtl_FMI(63)" VALUE 0x00165152 /* @ECU_Address@FCtl_FMI@0x021B703F@ */ ECIPP_ALIGNMENT_UBYTE 255 Compu_IDENTITY 0 255 PHYS_UNIT "FMI" /end CHARACTERISTIC
/begin CHARACTERISTIC FCfmi_INJD9_off_lo "FCtl_FMI(54)" VALUE 0x00165149 /* @ECU_Address@FCtl_FMI@0x021B7036@ */ ECIPP_ALIGNMENT_UBYTE 255 Compu_IDENTITY 0 255 PHYS_UNIT "FMI" /end CHARACTERISTIC
/begin CHARACTERISTIC FCfmi_INJD9_on_hi "FCtl_FMI(64)" VALUE 0x00165153 /* @ECU_Address@FCtl_FMI@0x021B7040@ */ ECIPP_ALIGNMENT_UBYTE 255 Compu_IDENTITY 0 255 PHYS_UNIT "FMI" /end CHARACTERISTIC
/begin CHARACTERISTIC FCfmi_KNK2_max "FCtl_FMI(185)" VALUE 0x001651CC /* @ECU_Address@FCtl_FMI@0x021B70B9@ */ ECIPP_ALIGNMENT_UBYTE 255 Compu_IDENTITY 0 255 PHYS_UNIT "FMI" /end CHARACTERISTIC
/begin CHARACTERISTIC FCfmi_KNK2_min "FCtl_FMI(184)" VALUE 0x001651CB /* @ECU_Address@FCtl_FMI@0x021B70B8@ */ ECIPP_ALIGNMENT_UBYTE 255 Compu_IDENTITY 0 255 PHYS_UNIT "FMI" /end CHARACTERISTIC
/begin CHARACTERISTIC FCfmi_KNK3_max "FCtl_FMI(806)" VALUE 0x00165439 /* @ECU_Address@FCtl_FMI@0x021B7326@ */ ECIPP_ALIGNMENT_UBYTE 255 Compu_IDENTITY 0 255 PHYS_UNIT "FMI" /end CHARACTERISTIC
/begin CHARACTERISTIC FCfmi_KNK3_min "FCtl_FMI(805)" VALUE 0x00165438 /* @ECU_Address@FCtl_FMI@0x021B7325@ */ ECIPP_ALIGNMENT_UBYTE 255 Compu_IDENTITY 0 255 PHYS_UNIT "FMI" /end CHARACTERISTIC
/begin CHARACTERISTIC FCfmi_SPK10_IGBT_T "FCtl_FMI(518)" VALUE 0x00165319 /* @ECU_Address@FCtl_FMI@0x021B7206@ */ ECIPP_ALIGNMENT_UBYTE 255 Compu_IDENTITY 0 255 PHYS_UNIT "FMI" /end CHARACTERISTIC
/begin CHARACTERISTIC FCfmi_SPK2_IGBT_T "FCtl_FMI(510)" VALUE 0x00165311 /* @ECU_Address@FCtl_FMI@0x021B71FE@ */ ECIPP_ALIGNMENT_UBYTE 255 Compu_IDENTITY 0 255 PHYS_UNIT "FMI" /end CHARACTERISTIC
/begin CHARACTERISTIC FCfmi_SPK3_IGBT_T "FCtl_FMI(511)" VALUE 0x00165312 /* @ECU_Address@FCtl_FMI@0x021B71FF@ */ ECIPP_ALIGNMENT_UBYTE 255 Compu_IDENTITY 0 255 PHYS_UNIT "FMI" /end CHARACTERISTIC
/begin CHARACTERISTIC FCfmi_SPK4_IGBT_T "FCtl_FMI(512)" VALUE 0x00165313 /* @ECU_Address@FCtl_FMI@0x021B7200@ */ ECIPP_ALIGNMENT_UBYTE 255 Compu_IDENTITY 0 255 PHYS_UNIT "FMI" /end CHARACTERISTIC
/begin CHARACTERISTIC FCfmi_SPK5_IGBT_T "FCtl_FMI(513)" VALUE 0x00165314 /* @ECU_Address@FCtl_FMI@0x021B7201@ */ ECIPP_ALIGNMENT_UBYTE 255 Compu_IDENTITY 0 255 PHYS_UNIT "FMI" /end CHARACTERISTIC
/begin CHARACTERISTIC FCfmi_SPK6_IGBT_T "FCtl_FMI(514)" VALUE 0x00165315 /* @ECU_Address@FCtl_FMI@0x021B7202@ */ ECIPP_ALIGNMENT_UBYTE 255 Compu_IDENTITY 0 255 PHYS_UNIT "FMI" /end CHARACTERISTIC
/begin CHARACTERISTIC FCfmi_SPK7_IGBT_T "FCtl_FMI(515)" VALUE 0x00165316 /* @ECU_Address@FCtl_FMI@0x021B7203@ */ ECIPP_ALIGNMENT_UBYTE 255 Compu_IDENTITY 0 255 PHYS_UNIT "FMI" /end CHARACTERISTIC
/begin CHARACTERISTIC FCfmi_SPK8_IGBT_T "FCtl_FMI(516)" VALUE 0x00165317 /* @ECU_Address@FCtl_FMI@0x021B7204@ */ ECIPP_ALIGNMENT_UBYTE 255 Compu_IDENTITY 0 255 PHYS_UNIT "FMI" /end CHARACTERISTIC
/begin CHARACTERISTIC FCfmi_SPK9_IGBT_T "FCtl_FMI(517)" VALUE 0x00165318 /* @ECU_Address@FCtl_FMI@0x021B7205@ */ ECIPP_ALIGNMENT_UBYTE 255 Compu_IDENTITY 0 255 PHYS_UNIT "FMI" /end CHARACTERISTIC
/begin CHARACTERISTIC FCfmi_SPKD10_coil_fail "FCtl_FMI(313)" VALUE 0x0016524C /* @ECU_Address@FCtl_FMI@0x021B7139@ */ ECIPP_ALIGNMENT_UBYTE 255 Compu_IDENTITY 0 255 PHYS_UNIT "FMI" /end CHARACTERISTIC
/begin CHARACTERISTIC FCfmi_SPKD10_dw_hi "FCtl_FMI(85)" VALUE 0x00165168 /* @ECU_Address@FCtl_FMI@0x021B7055@ */ ECIPP_ALIGNMENT_UBYTE 255 Compu_IDENTITY 0 255 PHYS_UNIT "FMI" /end CHARACTERISTIC
/begin CHARACTERISTIC FCfmi_SPKD10_dw_lo "FCtl_FMI(75)" VALUE 0x0016515E /* @ECU_Address@FCtl_FMI@0x021B704B@ */ ECIPP_ALIGNMENT_UBYTE 255 Compu_IDENTITY 0 255 PHYS_UNIT "FMI" /end CHARACTERISTIC
/begin CHARACTERISTIC FCfmi_SPKD2_coil_fail "FCtl_FMI(305)" VALUE 0x00165244 /* @ECU_Address@FCtl_FMI@0x021B7131@ */ ECIPP_ALIGNMENT_UBYTE 255 Compu_IDENTITY 0 255 PHYS_UNIT "FMI" /end CHARACTERISTIC
/begin CHARACTERISTIC FCfmi_SPKD2_dw_hi "FCtl_FMI(77)" VALUE 0x00165160 /* @ECU_Address@FCtl_FMI@0x021B704D@ */ ECIPP_ALIGNMENT_UBYTE 255 Compu_IDENTITY 0 255 PHYS_UNIT "FMI" /end CHARACTERISTIC
/begin CHARACTERISTIC FCfmi_SPKD2_dw_lo "FCtl_FMI(67)" VALUE 0x00165156 /* @ECU_Address@FCtl_FMI@0x021B7043@ */ ECIPP_ALIGNMENT_UBYTE 255 Compu_IDENTITY 0 255 PHYS_UNIT "FMI" /end CHARACTERISTIC
/begin CHARACTERISTIC FCfmi_SPKD3_coil_fail "FCtl_FMI(306)" VALUE 0x00165245 /* @ECU_Address@FCtl_FMI@0x021B7132@ */ ECIPP_ALIGNMENT_UBYTE 255 Compu_IDENTITY 0 255 PHYS_UNIT "FMI" /end CHARACTERISTIC
/begin CHARACTERISTIC FCfmi_SPKD3_dw_hi "FCtl_FMI(78)" VALUE 0x00165161 /* @ECU_Address@FCtl_FMI@0x021B704E@ */ ECIPP_ALIGNMENT_UBYTE 255 Compu_IDENTITY 0 255 PHYS_UNIT "FMI" /end CHARACTERISTIC
/begin CHARACTERISTIC FCfmi_SPKD3_dw_lo "FCtl_FMI(68)" VALUE 0x00165157 /* @ECU_Address@FCtl_FMI@0x021B7044@ */ ECIPP_ALIGNMENT_UBYTE 255 Compu_IDENTITY 0 255 PHYS_UNIT "FMI" /end CHARACTERISTIC
/begin CHARACTERISTIC FCfmi_SPKD4_coil_fail "FCtl_FMI(307)" VALUE 0x00165246 /* @ECU_Address@FCtl_FMI@0x021B7133@ */ ECIPP_ALIGNMENT_UBYTE 255 Compu_IDENTITY 0 255 PHYS_UNIT "FMI" /end CHARACTERISTIC
/begin CHARACTERISTIC FCfmi_SPKD4_dw_hi "FCtl_FMI(79)" VALUE 0x00165162 /* @ECU_Address@FCtl_FMI@0x021B704F@ */ ECIPP_ALIGNMENT_UBYTE 255 Compu_IDENTITY 0 255 PHYS_UNIT "FMI" /end CHARACTERISTIC
/begin CHARACTERISTIC FCfmi_SPKD4_dw_lo "FCtl_FMI(69)" VALUE 0x00165158 /* @ECU_Address@FCtl_FMI@0x021B7045@ */ ECIPP_ALIGNMENT_UBYTE 255 Compu_IDENTITY 0 255 PHYS_UNIT "FMI" /end CHARACTERISTIC
/begin CHARACTERISTIC FCfmi_SPKD5_coil_fail "FCtl_FMI(308)" VALUE 0x00165247 /* @ECU_Address@FCtl_FMI@0x021B7134@ */ ECIPP_ALIGNMENT_UBYTE 255 Compu_IDENTITY 0 255 PHYS_UNIT "FMI" /end CHARACTERISTIC
/begin CHARACTERISTIC FCfmi_SPKD5_dw_hi "FCtl_FMI(80)" VALUE 0x00165163 /* @ECU_Address@FCtl_FMI@0x021B7050@ */ ECIPP_ALIGNMENT_UBYTE 255 Compu_IDENTITY 0 255 PHYS_UNIT "FMI" /end CHARACTERISTIC
/begin CHARACTERISTIC FCfmi_SPKD5_dw_lo "FCtl_FMI(70)" VALUE 0x00165159 /* @ECU_Address@FCtl_FMI@0x021B7046@ */ ECIPP_ALIGNMENT_UBYTE 255 Compu_IDENTITY 0 255 PHYS_UNIT "FMI" /end CHARACTERISTIC
/begin CHARACTERISTIC FCfmi_SPKD6_coil_fail "FCtl_FMI(309)" VALUE 0x00165248 /* @ECU_Address@FCtl_FMI@0x021B7135@ */ ECIPP_ALIGNMENT_UBYTE 255 Compu_IDENTITY 0 255 PHYS_UNIT "FMI" /end CHARACTERISTIC
/begin CHARACTERISTIC FCfmi_SPKD6_dw_hi "FCtl_FMI(81)" VALUE 0x00165164 /* @ECU_Address@FCtl_FMI@0x021B7051@ */ ECIPP_ALIGNMENT_UBYTE 255 Compu_IDENTITY 0 255 PHYS_UNIT "FMI" /end CHARACTERISTIC
/begin CHARACTERISTIC FCfmi_SPKD6_dw_lo "FCtl_FMI(71)" VALUE 0x0016515A /* @ECU_Address@FCtl_FMI@0x021B7047@ */ ECIPP_ALIGNMENT_UBYTE 255 Compu_IDENTITY 0 255 PHYS_UNIT "FMI" /end CHARACTERISTIC
/begin CHARACTERISTIC FCfmi_SPKD7_coil_fail "FCtl_FMI(310)" VALUE 0x00165249 /* @ECU_Address@FCtl_FMI@0x021B7136@ */ ECIPP_ALIGNMENT_UBYTE 255 Compu_IDENTITY 0 255 PHYS_UNIT "FMI" /end CHARACTERISTIC
/begin CHARACTERISTIC FCfmi_SPKD7_dw_hi "FCtl_FMI(82)" VALUE 0x00165165 /* @ECU_Address@FCtl_FMI@0x021B7052@ */ ECIPP_ALIGNMENT_UBYTE 255 Compu_IDENTITY 0 255 PHYS_UNIT "FMI" /end CHARACTERISTIC
/begin CHARACTERISTIC FCfmi_SPKD7_dw_lo "FCtl_FMI(72)" VALUE 0x0016515B /* @ECU_Address@FCtl_FMI@0x021B7048@ */ ECIPP_ALIGNMENT_UBYTE 255 Compu_IDENTITY 0 255 PHYS_UNIT "FMI" /end CHARACTERISTIC
/begin CHARACTERISTIC FCfmi_SPKD8_coil_fail "FCtl_FMI(311)" VALUE 0x0016524A /* @ECU_Address@FCtl_FMI@0x021B7137@ */ ECIPP_ALIGNMENT_UBYTE 255 Compu_IDENTITY 0 255 PHYS_UNIT "FMI" /end CHARACTERISTIC
/begin CHARACTERISTIC FCfmi_SPKD8_dw_hi "FCtl_FMI(83)" VALUE 0x00165166 /* @ECU_Address@FCtl_FMI@0x021B7053@ */ ECIPP_ALIGNMENT_UBYTE 255 Compu_IDENTITY 0 255 PHYS_UNIT "FMI" /end CHARACTERISTIC
/begin CHARACTERISTIC FCfmi_SPKD8_dw_lo "FCtl_FMI(73)" VALUE 0x0016515C /* @ECU_Address@FCtl_FMI@0x021B7049@ */ ECIPP_ALIGNMENT_UBYTE 255 Compu_IDENTITY 0 255 PHYS_UNIT "FMI" /end CHARACTERISTIC
/begin CHARACTERISTIC FCfmi_SPKD9_coil_fail "FCtl_FMI(312)" VALUE 0x0016524B /* @ECU_Address@FCtl_FMI@0x021B7138@ */ ECIPP_ALIGNMENT_UBYTE 255 Compu_IDENTITY 0 255 PHYS_UNIT "FMI" /end CHARACTERISTIC
/begin CHARACTERISTIC FCfmi_SPKD9_dw_hi "FCtl_FMI(84)" VALUE 0x00165167 /* @ECU_Address@FCtl_FMI@0x021B7054@ */ ECIPP_ALIGNMENT_UBYTE 255 Compu_IDENTITY 0 255 PHYS_UNIT "FMI" /end CHARACTERISTIC
/begin CHARACTERISTIC FCfmi_SPKD9_dw_lo "FCtl_FMI(74)" VALUE 0x0016515D /* @ECU_Address@FCtl_FMI@0x021B704A@ */ ECIPP_ALIGNMENT_UBYTE 255 Compu_IDENTITY 0 255 PHYS_UNIT "FMI" /end CHARACTERISTIC
/begin CHARACTERISTIC FCfmi_UGF_Hv_lo "FCtl_FMI(243)" VALUE 0x00165206 /* @ECU_Address@FCtl_FMI@0x021B70F3@ */ ECIPP_ALIGNMENT_UBYTE 255 Compu_IDENTITY 0 255 PHYS_UNIT "FMI" /end CHARACTERISTIC
/begin CHARACTERISTIC FCfmi_UGF1_PR_hi "FCtl_FMI(257)" VALUE 0x00165214 /* @ECU_Address@FCtl_FMI@0x021B7101@ */ ECIPP_ALIGNMENT_UBYTE 255 Compu_IDENTITY 0 255 PHYS_UNIT "FMI" /end CHARACTERISTIC
/begin CHARACTERISTIC FCfmi_UGF1_PR_lo "FCtl_FMI(258)" VALUE 0x00165215 /* @ECU_Address@FCtl_FMI@0x021B7102@ */ ECIPP_ALIGNMENT_UBYTE 255 Compu_IDENTITY 0 255 PHYS_UNIT "FMI" /end CHARACTERISTIC
/begin CHARACTERISTIC FCfmi_UGF1_PR_slow "FCtl_FMI(255)" VALUE 0x00165212 /* @ECU_Address@FCtl_FMI@0x021B70FF@ */ ECIPP_ALIGNMENT_UBYTE 255 Compu_IDENTITY 0 255 PHYS_UNIT "FMI" /end CHARACTERISTIC
/begin CHARACTERISTIC FCfmi_UGF1_Pv_hi "FCtl_FMI(252)" VALUE 0x0016520F /* @ECU_Address@FCtl_FMI@0x021B70FC@ */ ECIPP_ALIGNMENT_UBYTE 255 Compu_IDENTITY 0 255 PHYS_UNIT "FMI" /end CHARACTERISTIC
/begin CHARACTERISTIC FCfmi_UGF1_Pv_lo "FCtl_FMI(253)" VALUE 0x00165210 /* @ECU_Address@FCtl_FMI@0x021B70FD@ */ ECIPP_ALIGNMENT_UBYTE 255 Compu_IDENTITY 0 255 PHYS_UNIT "FMI" /end CHARACTERISTIC
/begin CHARACTERISTIC FCfmi_UGF1_PvFB_hi "FCtl_FMI(248)" VALUE 0x0016520B /* @ECU_Address@FCtl_FMI@0x021B70F8@ */ ECIPP_ALIGNMENT_UBYTE 255 Compu_IDENTITY 0 255 PHYS_UNIT "FMI" /end CHARACTERISTIC
/begin CHARACTERISTIC FCfmi_UGF1_PvFB_lo "FCtl_FMI(249)" VALUE 0x0016520C /* @ECU_Address@FCtl_FMI@0x021B70F9@ */ ECIPP_ALIGNMENT_UBYTE 255 Compu_IDENTITY 0 255 PHYS_UNIT "FMI" /end CHARACTERISTIC
/begin CHARACTERISTIC FCfmi_UGF1_R_lo "FCtl_FMI(245)" VALUE 0x00165208 /* @ECU_Address@FCtl_FMI@0x021B70F5@ */ ECIPP_ALIGNMENT_UBYTE 255 Compu_IDENTITY 0 255 PHYS_UNIT "FMI" /end CHARACTERISTIC
/begin CHARACTERISTIC FCfmi_UGF1_rtn_hi "FCtl_FMI(246)" VALUE 0x00165209 /* @ECU_Address@FCtl_FMI@0x021B70F6@ */ ECIPP_ALIGNMENT_UBYTE 255 Compu_IDENTITY 0 255 PHYS_UNIT "FMI" /end CHARACTERISTIC
/begin CHARACTERISTIC FCfmi_UGF1_rtn_lo "FCtl_FMI(247)" VALUE 0x0016520A /* @ECU_Address@FCtl_FMI@0x021B70F7@ */ ECIPP_ALIGNMENT_UBYTE 255 Compu_IDENTITY 0 255 PHYS_UNIT "FMI" /end CHARACTERISTIC
/begin CHARACTERISTIC FCfmi_UGF1_Sv_lo "FCtl_FMI(251)" VALUE 0x0016520E /* @ECU_Address@FCtl_FMI@0x021B70FB@ */ ECIPP_ALIGNMENT_UBYTE 255 Compu_IDENTITY 0 255 PHYS_UNIT "FMI" /end CHARACTERISTIC
/begin CHARACTERISTIC FCfmi_UGF2_Hv_lo "FCtl_FMI(410)" VALUE 0x001652AD /* @ECU_Address@FCtl_FMI@0x021B719A@ */ ECIPP_ALIGNMENT_UBYTE 255 Compu_IDENTITY 0 255 PHYS_UNIT "FMI" /end CHARACTERISTIC
/begin CHARACTERISTIC FCfmi_UGF2_PR_hi "FCtl_FMI(424)" VALUE 0x001652BB /* @ECU_Address@FCtl_FMI@0x021B71A8@ */ ECIPP_ALIGNMENT_UBYTE 255 Compu_IDENTITY 0 255 PHYS_UNIT "FMI" /end CHARACTERISTIC
/begin CHARACTERISTIC FCfmi_UGF2_PR_lo "FCtl_FMI(425)" VALUE 0x001652BC /* @ECU_Address@FCtl_FMI@0x021B71A9@ */ ECIPP_ALIGNMENT_UBYTE 255 Compu_IDENTITY 0 255 PHYS_UNIT "FMI" /end CHARACTERISTIC
/begin CHARACTERISTIC FCfmi_UGF2_PR_slow "FCtl_FMI(422)" VALUE 0x001652B9 /* @ECU_Address@FCtl_FMI@0x021B71A6@ */ ECIPP_ALIGNMENT_UBYTE 255 Compu_IDENTITY 0 255 PHYS_UNIT "FMI" /end CHARACTERISTIC
/begin CHARACTERISTIC FCfmi_UGF2_Pv_hi "FCtl_FMI(419)" VALUE 0x001652B6 /* @ECU_Address@FCtl_FMI@0x021B71A3@ */ ECIPP_ALIGNMENT_UBYTE 255 Compu_IDENTITY 0 255 PHYS_UNIT "FMI" /end CHARACTERISTIC
/begin CHARACTERISTIC FCfmi_UGF2_Pv_lo "FCtl_FMI(420)" VALUE 0x001652B7 /* @ECU_Address@FCtl_FMI@0x021B71A4@ */ ECIPP_ALIGNMENT_UBYTE 255 Compu_IDENTITY 0 255 PHYS_UNIT "FMI" /end CHARACTERISTIC
/begin CHARACTERISTIC FCfmi_UGF2_PvFB_hi "FCtl_FMI(415)" VALUE 0x001652B2 /* @ECU_Address@FCtl_FMI@0x021B719F@ */ ECIPP_ALIGNMENT_UBYTE 255 Compu_IDENTITY 0 255 PHYS_UNIT "FMI" /end CHARACTERISTIC
/begin CHARACTERISTIC FCfmi_UGF2_PvFB_lo "FCtl_FMI(416)" VALUE 0x001652B3 /* @ECU_Address@FCtl_FMI@0x021B71A0@ */ ECIPP_ALIGNMENT_UBYTE 255 Compu_IDENTITY 0 255 PHYS_UNIT "FMI" /end CHARACTERISTIC
/begin CHARACTERISTIC FCfmi_UGF2_R_lo "FCtl_FMI(412)" VALUE 0x001652AF /* @ECU_Address@FCtl_FMI@0x021B719C@ */ ECIPP_ALIGNMENT_UBYTE 255 Compu_IDENTITY 0 255 PHYS_UNIT "FMI" /end CHARACTERISTIC
/begin CHARACTERISTIC FCfmi_UGF2_rtn_hi "FCtl_FMI(413)" VALUE 0x001652B0 /* @ECU_Address@FCtl_FMI@0x021B719D@ */ ECIPP_ALIGNMENT_UBYTE 255 Compu_IDENTITY 0 255 PHYS_UNIT "FMI" /end CHARACTERISTIC
/begin CHARACTERISTIC FCfmi_UGF2_rtn_lo "FCtl_FMI(414)" VALUE 0x001652B1 /* @ECU_Address@FCtl_FMI@0x021B719E@ */ ECIPP_ALIGNMENT_UBYTE 255 Compu_IDENTITY 0 255 PHYS_UNIT "FMI" /end CHARACTERISTIC
/begin CHARACTERISTIC FCfmi_UGF2_Sv_lo "FCtl_FMI(418)" VALUE 0x001652B5 /* @ECU_Address@FCtl_FMI@0x021B71A2@ */ ECIPP_ALIGNMENT_UBYTE 255 Compu_IDENTITY 0 255 PHYS_UNIT "FMI" /end CHARACTERISTIC
/begin CHARACTERISTIC FCfmi_UGF3_Hv_lo "FCtl_FMI(606)" VALUE 0x00165371 /* @ECU_Address@FCtl_FMI@0x021B725E@ */ ECIPP_ALIGNMENT_UBYTE 255 Compu_IDENTITY 0 255 PHYS_UNIT "FMI" /end CHARACTERISTIC
/begin CHARACTERISTIC FCfmi_UGF3_PR_hi "FCtl_FMI(620)" VALUE 0x0016537F /* @ECU_Address@FCtl_FMI@0x021B726C@ */ ECIPP_ALIGNMENT_UBYTE 255 Compu_IDENTITY 0 255 PHYS_UNIT "FMI" /end CHARACTERISTIC
/begin CHARACTERISTIC FCfmi_UGF3_PR_lo "FCtl_FMI(621)" VALUE 0x00165380 /* @ECU_Address@FCtl_FMI@0x021B726D@ */ ECIPP_ALIGNMENT_UBYTE 255 Compu_IDENTITY 0 255 PHYS_UNIT "FMI" /end CHARACTERISTIC
/begin CHARACTERISTIC FCfmi_UGF3_PR_slow "FCtl_FMI(618)" VALUE 0x0016537D /* @ECU_Address@FCtl_FMI@0x021B726A@ */ ECIPP_ALIGNMENT_UBYTE 255 Compu_IDENTITY 0 255 PHYS_UNIT "FMI" /end CHARACTERISTIC
/begin CHARACTERISTIC FCfmi_UGF3_Pv_hi "FCtl_FMI(615)" VALUE 0x0016537A /* @ECU_Address@FCtl_FMI@0x021B7267@ */ ECIPP_ALIGNMENT_UBYTE 255 Compu_IDENTITY 0 255 PHYS_UNIT "FMI" /end CHARACTERISTIC
/begin CHARACTERISTIC FCfmi_UGF3_Pv_lo "FCtl_FMI(616)" VALUE 0x0016537B /* @ECU_Address@FCtl_FMI@0x021B7268@ */ ECIPP_ALIGNMENT_UBYTE 255 Compu_IDENTITY 0 255 PHYS_UNIT "FMI" /end CHARACTERISTIC
/begin CHARACTERISTIC FCfmi_UGF3_PvFB_hi "FCtl_FMI(611)" VALUE 0x00165376 /* @ECU_Address@FCtl_FMI@0x021B7263@ */ ECIPP_ALIGNMENT_UBYTE 255 Compu_IDENTITY 0 255 PHYS_UNIT "FMI" /end CHARACTERISTIC
/begin CHARACTERISTIC FCfmi_UGF3_PvFB_lo "FCtl_FMI(612)" VALUE 0x00165377 /* @ECU_Address@FCtl_FMI@0x021B7264@ */ ECIPP_ALIGNMENT_UBYTE 255 Compu_IDENTITY 0 255 PHYS_UNIT "FMI" /end CHARACTERISTIC
/begin CHARACTERISTIC FCfmi_UGF3_R_lo "FCtl_FMI(608)" VALUE 0x00165373 /* @ECU_Address@FCtl_FMI@0x021B7260@ */ ECIPP_ALIGNMENT_UBYTE 255 Compu_IDENTITY 0 255 PHYS_UNIT "FMI" /end CHARACTERISTIC
/begin CHARACTERISTIC FCfmi_UGF3_rtn_hi "FCtl_FMI(609)" VALUE 0x00165374 /* @ECU_Address@FCtl_FMI@0x021B7261@ */ ECIPP_ALIGNMENT_UBYTE 255 Compu_IDENTITY 0 255 PHYS_UNIT "FMI" /end CHARACTERISTIC
/begin CHARACTERISTIC FCfmi_UGF3_rtn_lo "FCtl_FMI(610)" VALUE 0x00165375 /* @ECU_Address@FCtl_FMI@0x021B7262@ */ ECIPP_ALIGNMENT_UBYTE 255 Compu_IDENTITY 0 255 PHYS_UNIT "FMI" /end CHARACTERISTIC
/begin CHARACTERISTIC FCfmi_UGF3_Sv_lo "FCtl_FMI(614)" VALUE 0x00165379 /* @ECU_Address@FCtl_FMI@0x021B7266@ */ ECIPP_ALIGNMENT_UBYTE 255 Compu_IDENTITY 0 255 PHYS_UNIT "FMI" /end CHARACTERISTIC
/begin CHARACTERISTIC FCfmi_UGF4_Hv_lo "FCtl_FMI(629)" VALUE 0x00165388 /* @ECU_Address@FCtl_FMI@0x021B7275@ */ ECIPP_ALIGNMENT_UBYTE 255 Compu_IDENTITY 0 255 PHYS_UNIT "FMI" /end CHARACTERISTIC
/begin CHARACTERISTIC FCfmi_UGF4_PR_hi "FCtl_FMI(643)" VALUE 0x00165396 /* @ECU_Address@FCtl_FMI@0x021B7283@ */ ECIPP_ALIGNMENT_UBYTE 255 Compu_IDENTITY 0 255 PHYS_UNIT "FMI" /end CHARACTERISTIC
/begin CHARACTERISTIC FCfmi_UGF4_PR_lo "FCtl_FMI(644)" VALUE 0x00165397 /* @ECU_Address@FCtl_FMI@0x021B7284@ */ ECIPP_ALIGNMENT_UBYTE 255 Compu_IDENTITY 0 255 PHYS_UNIT "FMI" /end CHARACTERISTIC
/begin CHARACTERISTIC FCfmi_UGF4_PR_slow "FCtl_FMI(641)" VALUE 0x00165394 /* @ECU_Address@FCtl_FMI@0x021B7281@ */ ECIPP_ALIGNMENT_UBYTE 255 Compu_IDENTITY 0 255 PHYS_UNIT "FMI" /end CHARACTERISTIC
/begin CHARACTERISTIC FCfmi_UGF4_Pv_hi "FCtl_FMI(638)" VALUE 0x00165391 /* @ECU_Address@FCtl_FMI@0x021B727E@ */ ECIPP_ALIGNMENT_UBYTE 255 Compu_IDENTITY 0 255 PHYS_UNIT "FMI" /end CHARACTERISTIC
/begin CHARACTERISTIC FCfmi_UGF4_Pv_lo "FCtl_FMI(639)" VALUE 0x00165392 /* @ECU_Address@FCtl_FMI@0x021B727F@ */ ECIPP_ALIGNMENT_UBYTE 255 Compu_IDENTITY 0 255 PHYS_UNIT "FMI" /end CHARACTERISTIC
/begin CHARACTERISTIC FCfmi_UGF4_PvFB_hi "FCtl_FMI(634)" VALUE 0x0016538D /* @ECU_Address@FCtl_FMI@0x021B727A@ */ ECIPP_ALIGNMENT_UBYTE 255 Compu_IDENTITY 0 255 PHYS_UNIT "FMI" /end CHARACTERISTIC
/begin CHARACTERISTIC FCfmi_UGF4_PvFB_lo "FCtl_FMI(635)" VALUE 0x0016538E /* @ECU_Address@FCtl_FMI@0x021B727B@ */ ECIPP_ALIGNMENT_UBYTE 255 Compu_IDENTITY 0 255 PHYS_UNIT "FMI" /end CHARACTERISTIC
/begin CHARACTERISTIC FCfmi_UGF4_R_lo "FCtl_FMI(631)" VALUE 0x0016538A /* @ECU_Address@FCtl_FMI@0x021B7277@ */ ECIPP_ALIGNMENT_UBYTE 255 Compu_IDENTITY 0 255 PHYS_UNIT "FMI" /end CHARACTERISTIC
/begin CHARACTERISTIC FCfmi_UGF4_rtn_hi "FCtl_FMI(632)" VALUE 0x0016538B /* @ECU_Address@FCtl_FMI@0x021B7278@ */ ECIPP_ALIGNMENT_UBYTE 255 Compu_IDENTITY 0 255 PHYS_UNIT "FMI" /end CHARACTERISTIC
/begin CHARACTERISTIC FCfmi_UGF4_rtn_lo "FCtl_FMI(633)" VALUE 0x0016538C /* @ECU_Address@FCtl_FMI@0x021B7279@ */ ECIPP_ALIGNMENT_UBYTE 255 Compu_IDENTITY 0 255 PHYS_UNIT "FMI" /end CHARACTERISTIC
/begin CHARACTERISTIC FCfmi_UGF4_Sv_lo "FCtl_FMI(637)" VALUE 0x00165390 /* @ECU_Address@FCtl_FMI@0x021B727D@ */ ECIPP_ALIGNMENT_UBYTE 255 Compu_IDENTITY 0 255 PHYS_UNIT "FMI" /end CHARACTERISTIC
/begin CHARACTERISTIC FCftb_AL2_hi "FCtl_FTB_0x04(40)" VALUE 0x00165499 /* @ECU_Address@FCtl_FTB_0x04@0x024C5028@ */ ECIPP_ALIGNMENT_UBYTE 255 Compu_IDENTITY 0 255 PHYS_UNIT "FTB" /end CHARACTERISTIC
/begin CHARACTERISTIC FCftb_AL2_lo "FCtl_FTB_0x04(41)" VALUE 0x0016549A /* @ECU_Address@FCtl_FTB_0x04@0x024C5029@ */ ECIPP_ALIGNMENT_UBYTE 255 Compu_IDENTITY 0 255 PHYS_UNIT "FTB" /end CHARACTERISTIC
/begin CHARACTERISTIC FCftb_CFVxminFT "FCtl_FTB_0x04(533)" VALUE 0x00165686 /* @ECU_Address@FCtl_FTB_0x04@0x024C5215@ */ ECIPP_ALIGNMENT_UBYTE 255 Compu_IDENTITY 0 255 PHYS_UNIT "FTB" /end CHARACTERISTIC
/begin CHARACTERISTIC FCftb_CL2_hi "FCtl_FTB_0x04(34)" VALUE 0x00165493 /* @ECU_Address@FCtl_FTB_0x04@0x024C5022@ */ ECIPP_ALIGNMENT_UBYTE 255 Compu_IDENTITY 0 255 PHYS_UNIT "FTB" /end CHARACTERISTIC
/begin CHARACTERISTIC FCftb_CL2_lo "FCtl_FTB_0x04(35)" VALUE 0x00165494 /* @ECU_Address@FCtl_FTB_0x04@0x024C5023@ */ ECIPP_ALIGNMENT_UBYTE 255 Compu_IDENTITY 0 255 PHYS_UNIT "FTB" /end CHARACTERISTIC
/begin CHARACTERISTIC FCftb_CM2_unresp "FCtl_FTB_0x04(800)" VALUE 0x00165791 /* @ECU_Address@FCtl_FTB_0x04@0x024C5320@ */ ECIPP_ALIGNMENT_UBYTE 255 Compu_IDENTITY 0 255 PHYS_UNIT "FTB" /end CHARACTERISTIC
/begin CHARACTERISTIC FCftb_CM2gsln_inact "FCtl_FTB_0x04(199)" VALUE 0x00165538 /* @ECU_Address@FCtl_FTB_0x04@0x024C50C7@ */ ECIPP_ALIGNMENT_UBYTE 255 Compu_IDENTITY 0 255 PHYS_UNIT "FTB" /end CHARACTERISTIC
/begin CHARACTERISTIC FCftb_EGO4_open "FCtl_FTB_0x04(200)" VALUE 0x00165539 /* @ECU_Address@FCtl_FTB_0x04@0x024C50C8@ */ ECIPP_ALIGNMENT_UBYTE 255 Compu_IDENTITY 0 255 PHYS_UNIT "FTB" /end CHARACTERISTIC
/begin CHARACTERISTIC FCftb_EMWT2_HiExp1 "FCtl_FTB_0x04(226)" VALUE 0x00165553 /* @ECU_Address@FCtl_FTB_0x04@0x024C50E2@ */ ECIPP_ALIGNMENT_UBYTE 255 Compu_IDENTITY 0 255 PHYS_UNIT "FTB" /end CHARACTERISTIC
/begin CHARACTERISTIC FCftb_EMWT2_HiExp2 "FCtl_FTB_0x04(228)" VALUE 0x00165555 /* @ECU_Address@FCtl_FTB_0x04@0x024C50E4@ */ ECIPP_ALIGNMENT_UBYTE 255 Compu_IDENTITY 0 255 PHYS_UNIT "FTB" /end CHARACTERISTIC
/begin CHARACTERISTIC FCftb_EMWT2_maxv "FCtl_FTB_0x04(222)" VALUE 0x0016554F /* @ECU_Address@FCtl_FTB_0x04@0x024C50DE@ */ ECIPP_ALIGNMENT_UBYTE 255 Compu_IDENTITY 0 255 PHYS_UNIT "FTB" /end CHARACTERISTIC
/begin CHARACTERISTIC FCftb_EMWT2_minv "FCtl_FTB_0x04(224)" VALUE 0x00165551 /* @ECU_Address@FCtl_FTB_0x04@0x024C50E0@ */ ECIPP_ALIGNMENT_UBYTE 255 Compu_IDENTITY 0 255 PHYS_UNIT "FTB" /end CHARACTERISTIC
/begin CHARACTERISTIC FCftb_ERWT2_HiExp1 "FCtl_FTB_0x04(238)" VALUE 0x0016555F /* @ECU_Address@FCtl_FTB_0x04@0x024C50EE@ */ ECIPP_ALIGNMENT_UBYTE 255 Compu_IDENTITY 0 255 PHYS_UNIT "FTB" /end CHARACTERISTIC
/begin CHARACTERISTIC FCftb_ERWT2_HiExp2 "FCtl_FTB_0x04(240)" VALUE 0x00165561 /* @ECU_Address@FCtl_FTB_0x04@0x024C50F0@ */ ECIPP_ALIGNMENT_UBYTE 255 Compu_IDENTITY 0 255 PHYS_UNIT "FTB" /end CHARACTERISTIC
/begin CHARACTERISTIC FCftb_ERWT2_maxv "FCtl_FTB_0x04(234)" VALUE 0x0016555B /* @ECU_Address@FCtl_FTB_0x04@0x024C50EA@ */ ECIPP_ALIGNMENT_UBYTE 255 Compu_IDENTITY 0 255 PHYS_UNIT "FTB" /end CHARACTERISTIC
/begin CHARACTERISTIC FCftb_ERWT2_minv "FCtl_FTB_0x04(236)" VALUE 0x0016555D /* @ECU_Address@FCtl_FTB_0x04@0x024C50EC@ */ ECIPP_ALIGNMENT_UBYTE 255 Compu_IDENTITY 0 255 PHYS_UNIT "FTB" /end CHARACTERISTIC
/begin CHARACTERISTIC FCftb_GLOW10_open "FCtl_FTB_0x04(492)" VALUE 0x0016565D /* @ECU_Address@FCtl_FTB_0x04@0x024C51EC@ */ ECIPP_ALIGNMENT_UBYTE 255 Compu_IDENTITY 0 255 PHYS_UNIT "FTB" /end CHARACTERISTIC
/begin CHARACTERISTIC FCftb_GLOW10_short "FCtl_FTB_0x04(502)" VALUE 0x00165667 /* @ECU_Address@FCtl_FTB_0x04@0x024C51F6@ */ ECIPP_ALIGNMENT_UBYTE 255 Compu_IDENTITY 0 255 PHYS_UNIT "FTB" /end CHARACTERISTIC
/begin CHARACTERISTIC FCftb_GLOW2_open "FCtl_FTB_0x04(484)" VALUE 0x00165655 /* @ECU_Address@FCtl_FTB_0x04@0x024C51E4@ */ ECIPP_ALIGNMENT_UBYTE 255 Compu_IDENTITY 0 255 PHYS_UNIT "FTB" /end CHARACTERISTIC
/begin CHARACTERISTIC FCftb_GLOW2_short "FCtl_FTB_0x04(494)" VALUE 0x0016565F /* @ECU_Address@FCtl_FTB_0x04@0x024C51EE@ */ ECIPP_ALIGNMENT_UBYTE 255 Compu_IDENTITY 0 255 PHYS_UNIT "FTB" /end CHARACTERISTIC
/begin CHARACTERISTIC FCftb_GLOW3_open "FCtl_FTB_0x04(485)" VALUE 0x00165656 /* @ECU_Address@FCtl_FTB_0x04@0x024C51E5@ */ ECIPP_ALIGNMENT_UBYTE 255 Compu_IDENTITY 0 255 PHYS_UNIT "FTB" /end CHARACTERISTIC
/begin CHARACTERISTIC FCftb_GLOW3_short "FCtl_FTB_0x04(495)" VALUE 0x00165660 /* @ECU_Address@FCtl_FTB_0x04@0x024C51EF@ */ ECIPP_ALIGNMENT_UBYTE 255 Compu_IDENTITY 0 255 PHYS_UNIT "FTB" /end CHARACTERISTIC
/begin CHARACTERISTIC FCftb_GLOW4_open "FCtl_FTB_0x04(486)" VALUE 0x00165657 /* @ECU_Address@FCtl_FTB_0x04@0x024C51E6@ */ ECIPP_ALIGNMENT_UBYTE 255 Compu_IDENTITY 0 255 PHYS_UNIT "FTB" /end CHARACTERISTIC
/begin CHARACTERISTIC FCftb_GLOW4_short "FCtl_FTB_0x04(496)" VALUE 0x00165661 /* @ECU_Address@FCtl_FTB_0x04@0x024C51F0@ */ ECIPP_ALIGNMENT_UBYTE 255 Compu_IDENTITY 0 255 PHYS_UNIT "FTB" /end CHARACTERISTIC
/begin CHARACTERISTIC FCftb_GLOW5_open "FCtl_FTB_0x04(487)" VALUE 0x00165658 /* @ECU_Address@FCtl_FTB_0x04@0x024C51E7@ */ ECIPP_ALIGNMENT_UBYTE 255 Compu_IDENTITY 0 255 PHYS_UNIT "FTB" /end CHARACTERISTIC
/begin CHARACTERISTIC FCftb_GLOW5_short "FCtl_FTB_0x04(497)" VALUE 0x00165662 /* @ECU_Address@FCtl_FTB_0x04@0x024C51F1@ */ ECIPP_ALIGNMENT_UBYTE 255 Compu_IDENTITY 0 255 PHYS_UNIT "FTB" /end CHARACTERISTIC
/begin CHARACTERISTIC FCftb_GLOW6_open "FCtl_FTB_0x04(488)" VALUE 0x00165659 /* @ECU_Address@FCtl_FTB_0x04@0x024C51E8@ */ ECIPP_ALIGNMENT_UBYTE 255 Compu_IDENTITY 0 255 PHYS_UNIT "FTB" /end CHARACTERISTIC
/begin CHARACTERISTIC FCftb_GLOW6_short "FCtl_FTB_0x04(498)" VALUE 0x00165663 /* @ECU_Address@FCtl_FTB_0x04@0x024C51F2@ */ ECIPP_ALIGNMENT_UBYTE 255 Compu_IDENTITY 0 255 PHYS_UNIT "FTB" /end CHARACTERISTIC
/begin CHARACTERISTIC FCftb_GLOW7_open "FCtl_FTB_0x04(489)" VALUE 0x0016565A /* @ECU_Address@FCtl_FTB_0x04@0x024C51E9@ */ ECIPP_ALIGNMENT_UBYTE 255 Compu_IDENTITY 0 255 PHYS_UNIT "FTB" /end CHARACTERISTIC
/begin CHARACTERISTIC FCftb_GLOW7_short "FCtl_FTB_0x04(499)" VALUE 0x00165664 /* @ECU_Address@FCtl_FTB_0x04@0x024C51F3@ */ ECIPP_ALIGNMENT_UBYTE 255 Compu_IDENTITY 0 255 PHYS_UNIT "FTB" /end CHARACTERISTIC
/begin CHARACTERISTIC FCftb_GLOW8_open "FCtl_FTB_0x04(490)" VALUE 0x0016565B /* @ECU_Address@FCtl_FTB_0x04@0x024C51EA@ */ ECIPP_ALIGNMENT_UBYTE 255 Compu_IDENTITY 0 255 PHYS_UNIT "FTB" /end CHARACTERISTIC
/begin CHARACTERISTIC FCftb_GLOW8_short "FCtl_FTB_0x04(500)" VALUE 0x00165665 /* @ECU_Address@FCtl_FTB_0x04@0x024C51F4@ */ ECIPP_ALIGNMENT_UBYTE 255 Compu_IDENTITY 0 255 PHYS_UNIT "FTB" /end CHARACTERISTIC
/begin CHARACTERISTIC FCftb_GLOW9_open "FCtl_FTB_0x04(491)" VALUE 0x0016565C /* @ECU_Address@FCtl_FTB_0x04@0x024C51EB@ */ ECIPP_ALIGNMENT_UBYTE 255 Compu_IDENTITY 0 255 PHYS_UNIT "FTB" /end CHARACTERISTIC
/begin CHARACTERISTIC FCftb_GLOW9_short "FCtl_FTB_0x04(501)" VALUE 0x00165666 /* @ECU_Address@FCtl_FTB_0x04@0x024C51F5@ */ ECIPP_ALIGNMENT_UBYTE 255 Compu_IDENTITY 0 255 PHYS_UNIT "FTB" /end CHARACTERISTIC
/begin CHARACTERISTIC FCftb_ICAVD10_mis "FCtl_FTB_0x04(315)" VALUE 0x001655AC /* @ECU_Address@FCtl_FTB_0x04@0x024C513B@ */ ECIPP_ALIGNMENT_UBYTE 255 Compu_IDENTITY 0 255 PHYS_UNIT "FTB" /end CHARACTERISTIC
/begin CHARACTERISTIC FCftb_ICAVD10_miscat "FCtl_FTB_0x04(317)" VALUE 0x001655AE /* @ECU_Address@FCtl_FTB_0x04@0x024C513D@ */ ECIPP_ALIGNMENT_UBYTE 255 Compu_IDENTITY 0 255 PHYS_UNIT "FTB" /end CHARACTERISTIC
/begin CHARACTERISTIC FCftb_ICAVD2_mis "FCtl_FTB_0x04(260)" VALUE 0x00165575 /* @ECU_Address@FCtl_FTB_0x04@0x024C5104@ */ ECIPP_ALIGNMENT_UBYTE 255 Compu_IDENTITY 0 255 PHYS_UNIT "FTB" /end CHARACTERISTIC
/begin CHARACTERISTIC FCftb_ICAVD2_miscat "FCtl_FTB_0x04(268)" VALUE 0x0016557D /* @ECU_Address@FCtl_FTB_0x04@0x024C510C@ */ ECIPP_ALIGNMENT_UBYTE 255 Compu_IDENTITY 0 255 PHYS_UNIT "FTB" /end CHARACTERISTIC
/begin CHARACTERISTIC FCftb_ICAVD3_mis "FCtl_FTB_0x04(261)" VALUE 0x00165576 /* @ECU_Address@FCtl_FTB_0x04@0x024C5105@ */ ECIPP_ALIGNMENT_UBYTE 255 Compu_IDENTITY 0 255 PHYS_UNIT "FTB" /end CHARACTERISTIC
/begin CHARACTERISTIC FCftb_ICAVD3_miscat "FCtl_FTB_0x04(269)" VALUE 0x0016557E /* @ECU_Address@FCtl_FTB_0x04@0x024C510D@ */ ECIPP_ALIGNMENT_UBYTE 255 Compu_IDENTITY 0 255 PHYS_UNIT "FTB" /end CHARACTERISTIC
/begin CHARACTERISTIC FCftb_ICAVD4_mis "FCtl_FTB_0x04(262)" VALUE 0x00165577 /* @ECU_Address@FCtl_FTB_0x04@0x024C5106@ */ ECIPP_ALIGNMENT_UBYTE 255 Compu_IDENTITY 0 255 PHYS_UNIT "FTB" /end CHARACTERISTIC
/begin CHARACTERISTIC FCftb_ICAVD4_miscat "FCtl_FTB_0x04(270)" VALUE 0x0016557F /* @ECU_Address@FCtl_FTB_0x04@0x024C510E@ */ ECIPP_ALIGNMENT_UBYTE 255 Compu_IDENTITY 0 255 PHYS_UNIT "FTB" /end CHARACTERISTIC
/begin CHARACTERISTIC FCftb_ICAVD5_mis "FCtl_FTB_0x04(263)" VALUE 0x00165578 /* @ECU_Address@FCtl_FTB_0x04@0x024C5107@ */ ECIPP_ALIGNMENT_UBYTE 255 Compu_IDENTITY 0 255 PHYS_UNIT "FTB" /end CHARACTERISTIC
/begin CHARACTERISTIC FCftb_ICAVD5_miscat "FCtl_FTB_0x04(271)" VALUE 0x00165580 /* @ECU_Address@FCtl_FTB_0x04@0x024C510F@ */ ECIPP_ALIGNMENT_UBYTE 255 Compu_IDENTITY 0 255 PHYS_UNIT "FTB" /end CHARACTERISTIC
/begin CHARACTERISTIC FCftb_ICAVD6_mis "FCtl_FTB_0x04(264)" VALUE 0x00165579 /* @ECU_Address@FCtl_FTB_0x04@0x024C5108@ */ ECIPP_ALIGNMENT_UBYTE 255 Compu_IDENTITY 0 255 PHYS_UNIT "FTB" /end CHARACTERISTIC
/begin CHARACTERISTIC FCftb_ICAVD6_miscat "FCtl_FTB_0x04(272)" VALUE 0x00165581 /* @ECU_Address@FCtl_FTB_0x04@0x024C5110@ */ ECIPP_ALIGNMENT_UBYTE 255 Compu_IDENTITY 0 255 PHYS_UNIT "FTB" /end CHARACTERISTIC
/begin CHARACTERISTIC FCftb_ICAVD7_mis "FCtl_FTB_0x04(265)" VALUE 0x0016557A /* @ECU_Address@FCtl_FTB_0x04@0x024C5109@ */ ECIPP_ALIGNMENT_UBYTE 255 Compu_IDENTITY 0 255 PHYS_UNIT "FTB" /end CHARACTERISTIC
/begin CHARACTERISTIC FCftb_ICAVD7_miscat "FCtl_FTB_0x04(273)" VALUE 0x00165582 /* @ECU_Address@FCtl_FTB_0x04@0x024C5111@ */ ECIPP_ALIGNMENT_UBYTE 255 Compu_IDENTITY 0 255 PHYS_UNIT "FTB" /end CHARACTERISTIC
/begin CHARACTERISTIC FCftb_ICAVD8_mis "FCtl_FTB_0x04(266)" VALUE 0x0016557B /* @ECU_Address@FCtl_FTB_0x04@0x024C510A@ */ ECIPP_ALIGNMENT_UBYTE 255 Compu_IDENTITY 0 255 PHYS_UNIT "FTB" /end CHARACTERISTIC
/begin CHARACTERISTIC FCftb_ICAVD8_miscat "FCtl_FTB_0x04(274)" VALUE 0x00165583 /* @ECU_Address@FCtl_FTB_0x04@0x024C5112@ */ ECIPP_ALIGNMENT_UBYTE 255 Compu_IDENTITY 0 255 PHYS_UNIT "FTB" /end CHARACTERISTIC
/begin CHARACTERISTIC FCftb_ICAVD9_mis "FCtl_FTB_0x04(314)" VALUE 0x001655AB /* @ECU_Address@FCtl_FTB_0x04@0x024C513A@ */ ECIPP_ALIGNMENT_UBYTE 255 Compu_IDENTITY 0 255 PHYS_UNIT "FTB" /end CHARACTERISTIC
/begin CHARACTERISTIC FCftb_ICAVD9_miscat "FCtl_FTB_0x04(316)" VALUE 0x001655AD /* @ECU_Address@FCtl_FTB_0x04@0x024C513C@ */ ECIPP_ALIGNMENT_UBYTE 255 Compu_IDENTITY 0 255 PHYS_UNIT "FTB" /end CHARACTERISTIC
/begin CHARACTERISTIC FCftb_INJD10_off_lo "FCtl_FTB_0x04(55)" VALUE 0x001654A8 /* @ECU_Address@FCtl_FTB_0x04@0x024C5037@ */ ECIPP_ALIGNMENT_UBYTE 255 Compu_IDENTITY 0 255 PHYS_UNIT "FTB" /end CHARACTERISTIC
/begin CHARACTERISTIC FCftb_INJD10_on_hi "FCtl_FTB_0x04(65)" VALUE 0x001654B2 /* @ECU_Address@FCtl_FTB_0x04@0x024C5041@ */ ECIPP_ALIGNMENT_UBYTE 255 Compu_IDENTITY 0 255 PHYS_UNIT "FTB" /end CHARACTERISTIC
/begin CHARACTERISTIC FCftb_INJD2_boost_lo "FCtl_FTB_0x04(579)" VALUE 0x001656B4 /* @ECU_Address@FCtl_FTB_0x04@0x024C5243@ */ ECIPP_ALIGNMENT_UBYTE 255 Compu_IDENTITY 0 255 PHYS_UNIT "FTB" /end CHARACTERISTIC
/begin CHARACTERISTIC FCftb_INJD2_HS_Ihi "FCtl_FTB_0x04(563)" VALUE 0x001656A4 /* @ECU_Address@FCtl_FTB_0x04@0x024C5233@ */ ECIPP_ALIGNMENT_UBYTE 255 Compu_IDENTITY 0 255 PHYS_UNIT "FTB" /end CHARACTERISTIC
/begin CHARACTERISTIC FCftb_INJD2_HW_int "FCtl_FTB_0x04(581)" VALUE 0x001656B6 /* @ECU_Address@FCtl_FTB_0x04@0x024C5245@ */ ECIPP_ALIGNMENT_UBYTE 255 Compu_IDENTITY 0 255 PHYS_UNIT "FTB" /end CHARACTERISTIC
/begin CHARACTERISTIC FCftb_INJD2_LS_Ihi "FCtl_FTB_0x04(571)" VALUE 0x001656AC /* @ECU_Address@FCtl_FTB_0x04@0x024C523B@ */ ECIPP_ALIGNMENT_UBYTE 255 Compu_IDENTITY 0 255 PHYS_UNIT "FTB" /end CHARACTERISTIC
/begin CHARACTERISTIC FCftb_INJD2_off_lo "FCtl_FTB_0x04(47)" VALUE 0x001654A0 /* @ECU_Address@FCtl_FTB_0x04@0x024C502F@ */ ECIPP_ALIGNMENT_UBYTE 255 Compu_IDENTITY 0 255 PHYS_UNIT "FTB" /end CHARACTERISTIC
/begin CHARACTERISTIC FCftb_INJD2_on_hi "FCtl_FTB_0x04(57)" VALUE 0x001654AA /* @ECU_Address@FCtl_FTB_0x04@0x024C5039@ */ ECIPP_ALIGNMENT_UBYTE 255 Compu_IDENTITY 0 255 PHYS_UNIT "FTB" /end CHARACTERISTIC
/begin CHARACTERISTIC FCftb_INJD3_HS_Ihi "FCtl_FTB_0x04(564)" VALUE 0x001656A5 /* @ECU_Address@FCtl_FTB_0x04@0x024C5234@ */ ECIPP_ALIGNMENT_UBYTE 255 Compu_IDENTITY 0 255 PHYS_UNIT "FTB" /end CHARACTERISTIC
/begin CHARACTERISTIC FCftb_INJD3_LS_Ihi "FCtl_FTB_0x04(572)" VALUE 0x001656AD /* @ECU_Address@FCtl_FTB_0x04@0x024C523C@ */ ECIPP_ALIGNMENT_UBYTE 255 Compu_IDENTITY 0 255 PHYS_UNIT "FTB" /end CHARACTERISTIC
/begin CHARACTERISTIC FCftb_INJD3_off_lo "FCtl_FTB_0x04(48)" VALUE 0x001654A1 /* @ECU_Address@FCtl_FTB_0x04@0x024C5030@ */ ECIPP_ALIGNMENT_UBYTE 255 Compu_IDENTITY 0 255 PHYS_UNIT "FTB" /end CHARACTERISTIC
/begin CHARACTERISTIC FCftb_INJD3_on_hi "FCtl_FTB_0x04(58)" VALUE 0x001654AB /* @ECU_Address@FCtl_FTB_0x04@0x024C503A@ */ ECIPP_ALIGNMENT_UBYTE 255 Compu_IDENTITY 0 255 PHYS_UNIT "FTB" /end CHARACTERISTIC
/begin CHARACTERISTIC FCftb_INJD4_HS_Ihi "FCtl_FTB_0x04(565)" VALUE 0x001656A6 /* @ECU_Address@FCtl_FTB_0x04@0x024C5235@ */ ECIPP_ALIGNMENT_UBYTE 255 Compu_IDENTITY 0 255 PHYS_UNIT "FTB" /end CHARACTERISTIC
/begin CHARACTERISTIC FCftb_INJD4_LS_Ihi "FCtl_FTB_0x04(573)" VALUE 0x001656AE /* @ECU_Address@FCtl_FTB_0x04@0x024C523D@ */ ECIPP_ALIGNMENT_UBYTE 255 Compu_IDENTITY 0 255 PHYS_UNIT "FTB" /end CHARACTERISTIC
/begin CHARACTERISTIC FCftb_INJD4_off_lo "FCtl_FTB_0x04(49)" VALUE 0x001654A2 /* @ECU_Address@FCtl_FTB_0x04@0x024C5031@ */ ECIPP_ALIGNMENT_UBYTE 255 Compu_IDENTITY 0 255 PHYS_UNIT "FTB" /end CHARACTERISTIC
/begin CHARACTERISTIC FCftb_INJD4_on_hi "FCtl_FTB_0x04(59)" VALUE 0x001654AC /* @ECU_Address@FCtl_FTB_0x04@0x024C503B@ */ ECIPP_ALIGNMENT_UBYTE 255 Compu_IDENTITY 0 255 PHYS_UNIT "FTB" /end CHARACTERISTIC
/begin CHARACTERISTIC FCftb_INJD5_HS_Ihi "FCtl_FTB_0x04(566)" VALUE 0x001656A7 /* @ECU_Address@FCtl_FTB_0x04@0x024C5236@ */ ECIPP_ALIGNMENT_UBYTE 255 Compu_IDENTITY 0 255 PHYS_UNIT "FTB" /end CHARACTERISTIC
/begin CHARACTERISTIC FCftb_INJD5_LS_Ihi "FCtl_FTB_0x04(574)" VALUE 0x001656AF /* @ECU_Address@FCtl_FTB_0x04@0x024C523E@ */ ECIPP_ALIGNMENT_UBYTE 255 Compu_IDENTITY 0 255 PHYS_UNIT "FTB" /end CHARACTERISTIC
/begin CHARACTERISTIC FCftb_INJD5_off_lo "FCtl_FTB_0x04(50)" VALUE 0x001654A3 /* @ECU_Address@FCtl_FTB_0x04@0x024C5032@ */ ECIPP_ALIGNMENT_UBYTE 255 Compu_IDENTITY 0 255 PHYS_UNIT "FTB" /end CHARACTERISTIC
/begin CHARACTERISTIC FCftb_INJD5_on_hi "FCtl_FTB_0x04(60)" VALUE 0x001654AD /* @ECU_Address@FCtl_FTB_0x04@0x024C503C@ */ ECIPP_ALIGNMENT_UBYTE 255 Compu_IDENTITY 0 255 PHYS_UNIT "FTB" /end CHARACTERISTIC
/begin CHARACTERISTIC FCftb_INJD6_HS_Ihi "FCtl_FTB_0x04(567)" VALUE 0x001656A8 /* @ECU_Address@FCtl_FTB_0x04@0x024C5237@ */ ECIPP_ALIGNMENT_UBYTE 255 Compu_IDENTITY 0 255 PHYS_UNIT "FTB" /end CHARACTERISTIC
/begin CHARACTERISTIC FCftb_INJD6_LS_Ihi "FCtl_FTB_0x04(575)" VALUE 0x001656B0 /* @ECU_Address@FCtl_FTB_0x04@0x024C523F@ */ ECIPP_ALIGNMENT_UBYTE 255 Compu_IDENTITY 0 255 PHYS_UNIT "FTB" /end CHARACTERISTIC
/begin CHARACTERISTIC FCftb_INJD6_off_lo "FCtl_FTB_0x04(51)" VALUE 0x001654A4 /* @ECU_Address@FCtl_FTB_0x04@0x024C5033@ */ ECIPP_ALIGNMENT_UBYTE 255 Compu_IDENTITY 0 255 PHYS_UNIT "FTB" /end CHARACTERISTIC
/begin CHARACTERISTIC FCftb_INJD6_on_hi "FCtl_FTB_0x04(61)" VALUE 0x001654AE /* @ECU_Address@FCtl_FTB_0x04@0x024C503D@ */ ECIPP_ALIGNMENT_UBYTE 255 Compu_IDENTITY 0 255 PHYS_UNIT "FTB" /end CHARACTERISTIC
/begin CHARACTERISTIC FCftb_INJD7_HS_Ihi "FCtl_FTB_0x04(568)" VALUE 0x001656A9 /* @ECU_Address@FCtl_FTB_0x04@0x024C5238@ */ ECIPP_ALIGNMENT_UBYTE 255 Compu_IDENTITY 0 255 PHYS_UNIT "FTB" /end CHARACTERISTIC
/begin CHARACTERISTIC FCftb_INJD7_LS_Ihi "FCtl_FTB_0x04(576)" VALUE 0x001656B1 /* @ECU_Address@FCtl_FTB_0x04@0x024C5240@ */ ECIPP_ALIGNMENT_UBYTE 255 Compu_IDENTITY 0 255 PHYS_UNIT "FTB" /end CHARACTERISTIC
/begin CHARACTERISTIC FCftb_INJD7_off_lo "FCtl_FTB_0x04(52)" VALUE 0x001654A5 /* @ECU_Address@FCtl_FTB_0x04@0x024C5034@ */ ECIPP_ALIGNMENT_UBYTE 255 Compu_IDENTITY 0 255 PHYS_UNIT "FTB" /end CHARACTERISTIC
/begin CHARACTERISTIC FCftb_INJD7_on_hi "FCtl_FTB_0x04(62)" VALUE 0x001654AF /* @ECU_Address@FCtl_FTB_0x04@0x024C503E@ */ ECIPP_ALIGNMENT_UBYTE 255 Compu_IDENTITY 0 255 PHYS_UNIT "FTB" /end CHARACTERISTIC
/begin CHARACTERISTIC FCftb_INJD8_HS_Ihi "FCtl_FTB_0x04(569)" VALUE 0x001656AA /* @ECU_Address@FCtl_FTB_0x04@0x024C5239@ */ ECIPP_ALIGNMENT_UBYTE 255 Compu_IDENTITY 0 255 PHYS_UNIT "FTB" /end CHARACTERISTIC
/begin CHARACTERISTIC FCftb_INJD8_LS_Ihi "FCtl_FTB_0x04(577)" VALUE 0x001656B2 /* @ECU_Address@FCtl_FTB_0x04@0x024C5241@ */ ECIPP_ALIGNMENT_UBYTE 255 Compu_IDENTITY 0 255 PHYS_UNIT "FTB" /end CHARACTERISTIC
/begin CHARACTERISTIC FCftb_INJD8_off_lo "FCtl_FTB_0x04(53)" VALUE 0x001654A6 /* @ECU_Address@FCtl_FTB_0x04@0x024C5035@ */ ECIPP_ALIGNMENT_UBYTE 255 Compu_IDENTITY 0 255 PHYS_UNIT "FTB" /end CHARACTERISTIC
/begin CHARACTERISTIC FCftb_INJD8_on_hi "FCtl_FTB_0x04(63)" VALUE 0x001654B0 /* @ECU_Address@FCtl_FTB_0x04@0x024C503F@ */ ECIPP_ALIGNMENT_UBYTE 255 Compu_IDENTITY 0 255 PHYS_UNIT "FTB" /end CHARACTERISTIC
/begin CHARACTERISTIC FCftb_INJD9_off_lo "FCtl_FTB_0x04(54)" VALUE 0x001654A7 /* @ECU_Address@FCtl_FTB_0x04@0x024C5036@ */ ECIPP_ALIGNMENT_UBYTE 255 Compu_IDENTITY 0 255 PHYS_UNIT "FTB" /end CHARACTERISTIC
/begin CHARACTERISTIC FCftb_INJD9_on_hi "FCtl_FTB_0x04(64)" VALUE 0x001654B1 /* @ECU_Address@FCtl_FTB_0x04@0x024C5040@ */ ECIPP_ALIGNMENT_UBYTE 255 Compu_IDENTITY 0 255 PHYS_UNIT "FTB" /end CHARACTERISTIC
/begin CHARACTERISTIC FCftb_KNK2_max "FCtl_FTB_0x04(185)" VALUE 0x0016552A /* @ECU_Address@FCtl_FTB_0x04@0x024C50B9@ */ ECIPP_ALIGNMENT_UBYTE 255 Compu_IDENTITY 0 255 PHYS_UNIT "FTB" /end CHARACTERISTIC
/begin CHARACTERISTIC FCftb_KNK2_min "FCtl_FTB_0x04(184)" VALUE 0x00165529 /* @ECU_Address@FCtl_FTB_0x04@0x024C50B8@ */ ECIPP_ALIGNMENT_UBYTE 255 Compu_IDENTITY 0 255 PHYS_UNIT "FTB" /end CHARACTERISTIC
/begin CHARACTERISTIC FCftb_KNK3_max "FCtl_FTB_0x04(806)" VALUE 0x00165797 /* @ECU_Address@FCtl_FTB_0x04@0x024C5326@ */ ECIPP_ALIGNMENT_UBYTE 255 Compu_IDENTITY 0 255 PHYS_UNIT "FTB" /end CHARACTERISTIC
/begin CHARACTERISTIC FCftb_KNK3_min "FCtl_FTB_0x04(805)" VALUE 0x00165796 /* @ECU_Address@FCtl_FTB_0x04@0x024C5325@ */ ECIPP_ALIGNMENT_UBYTE 255 Compu_IDENTITY 0 255 PHYS_UNIT "FTB" /end CHARACTERISTIC
/begin CHARACTERISTIC FCftb_SPK10_IGBT_T "FCtl_FTB_0x04(518)" VALUE 0x00165677 /* @ECU_Address@FCtl_FTB_0x04@0x024C5206@ */ ECIPP_ALIGNMENT_UBYTE 255 Compu_IDENTITY 0 255 PHYS_UNIT "FTB" /end CHARACTERISTIC
/begin CHARACTERISTIC FCftb_SPK2_IGBT_T "FCtl_FTB_0x04(510)" VALUE 0x0016566F /* @ECU_Address@FCtl_FTB_0x04@0x024C51FE@ */ ECIPP_ALIGNMENT_UBYTE 255 Compu_IDENTITY 0 255 PHYS_UNIT "FTB" /end CHARACTERISTIC
/begin CHARACTERISTIC FCftb_SPK3_IGBT_T "FCtl_FTB_0x04(511)" VALUE 0x00165670 /* @ECU_Address@FCtl_FTB_0x04@0x024C51FF@ */ ECIPP_ALIGNMENT_UBYTE 255 Compu_IDENTITY 0 255 PHYS_UNIT "FTB" /end CHARACTERISTIC
/begin CHARACTERISTIC FCftb_SPK4_IGBT_T "FCtl_FTB_0x04(512)" VALUE 0x00165671 /* @ECU_Address@FCtl_FTB_0x04@0x024C5200@ */ ECIPP_ALIGNMENT_UBYTE 255 Compu_IDENTITY 0 255 PHYS_UNIT "FTB" /end CHARACTERISTIC
/begin CHARACTERISTIC FCftb_SPK5_IGBT_T "FCtl_FTB_0x04(513)" VALUE 0x00165672 /* @ECU_Address@FCtl_FTB_0x04@0x024C5201@ */ ECIPP_ALIGNMENT_UBYTE 255 Compu_IDENTITY 0 255 PHYS_UNIT "FTB" /end CHARACTERISTIC
/begin CHARACTERISTIC FCftb_SPK6_IGBT_T "FCtl_FTB_0x04(514)" VALUE 0x00165673 /* @ECU_Address@FCtl_FTB_0x04@0x024C5202@ */ ECIPP_ALIGNMENT_UBYTE 255 Compu_IDENTITY 0 255 PHYS_UNIT "FTB" /end CHARACTERISTIC
/begin CHARACTERISTIC FCftb_SPK7_IGBT_T "FCtl_FTB_0x04(515)" VALUE 0x00165674 /* @ECU_Address@FCtl_FTB_0x04@0x024C5203@ */ ECIPP_ALIGNMENT_UBYTE 255 Compu_IDENTITY 0 255 PHYS_UNIT "FTB" /end CHARACTERISTIC
/begin CHARACTERISTIC FCftb_SPK8_IGBT_T "FCtl_FTB_0x04(516)" VALUE 0x00165675 /* @ECU_Address@FCtl_FTB_0x04@0x024C5204@ */ ECIPP_ALIGNMENT_UBYTE 255 Compu_IDENTITY 0 255 PHYS_UNIT "FTB" /end CHARACTERISTIC
/begin CHARACTERISTIC FCftb_SPK9_IGBT_T "FCtl_FTB_0x04(517)" VALUE 0x00165676 /* @ECU_Address@FCtl_FTB_0x04@0x024C5205@ */ ECIPP_ALIGNMENT_UBYTE 255 Compu_IDENTITY 0 255 PHYS_UNIT "FTB" /end CHARACTERISTIC
/begin CHARACTERISTIC FCftb_SPKD10_coil_fail "FCtl_FTB_0x04(313)" VALUE 0x001655AA /* @ECU_Address@FCtl_FTB_0x04@0x024C5139@ */ ECIPP_ALIGNMENT_UBYTE 255 Compu_IDENTITY 0 255 PHYS_UNIT "FTB" /end CHARACTERISTIC
/begin CHARACTERISTIC FCftb_SPKD10_dw_hi "FCtl_FTB_0x04(85)" VALUE 0x001654C6 /* @ECU_Address@FCtl_FTB_0x04@0x024C5055@ */ ECIPP_ALIGNMENT_UBYTE 255 Compu_IDENTITY 0 255 PHYS_UNIT "FTB" /end CHARACTERISTIC
/begin CHARACTERISTIC FCftb_SPKD10_dw_lo "FCtl_FTB_0x04(75)" VALUE 0x001654BC /* @ECU_Address@FCtl_FTB_0x04@0x024C504B@ */ ECIPP_ALIGNMENT_UBYTE 255 Compu_IDENTITY 0 255 PHYS_UNIT "FTB" /end CHARACTERISTIC
/begin CHARACTERISTIC FCftb_SPKD2_coil_fail "FCtl_FTB_0x04(305)" VALUE 0x001655A2 /* @ECU_Address@FCtl_FTB_0x04@0x024C5131@ */ ECIPP_ALIGNMENT_UBYTE 255 Compu_IDENTITY 0 255 PHYS_UNIT "FTB" /end CHARACTERISTIC
/begin CHARACTERISTIC FCftb_SPKD2_dw_hi "FCtl_FTB_0x04(77)" VALUE 0x001654BE /* @ECU_Address@FCtl_FTB_0x04@0x024C504D@ */ ECIPP_ALIGNMENT_UBYTE 255 Compu_IDENTITY 0 255 PHYS_UNIT "FTB" /end CHARACTERISTIC
/begin CHARACTERISTIC FCftb_SPKD2_dw_lo "FCtl_FTB_0x04(67)" VALUE 0x001654B4 /* @ECU_Address@FCtl_FTB_0x04@0x024C5043@ */ ECIPP_ALIGNMENT_UBYTE 255 Compu_IDENTITY 0 255 PHYS_UNIT "FTB" /end CHARACTERISTIC
/begin CHARACTERISTIC FCftb_SPKD3_coil_fail "FCtl_FTB_0x04(306)" VALUE 0x001655A3 /* @ECU_Address@FCtl_FTB_0x04@0x024C5132@ */ ECIPP_ALIGNMENT_UBYTE 255 Compu_IDENTITY 0 255 PHYS_UNIT "FTB" /end CHARACTERISTIC
/begin CHARACTERISTIC FCftb_SPKD3_dw_hi "FCtl_FTB_0x04(78)" VALUE 0x001654BF /* @ECU_Address@FCtl_FTB_0x04@0x024C504E@ */ ECIPP_ALIGNMENT_UBYTE 255 Compu_IDENTITY 0 255 PHYS_UNIT "FTB" /end CHARACTERISTIC
/begin CHARACTERISTIC FCftb_SPKD3_dw_lo "FCtl_FTB_0x04(68)" VALUE 0x001654B5 /* @ECU_Address@FCtl_FTB_0x04@0x024C5044@ */ ECIPP_ALIGNMENT_UBYTE 255 Compu_IDENTITY 0 255 PHYS_UNIT "FTB" /end CHARACTERISTIC
/begin CHARACTERISTIC FCftb_SPKD4_coil_fail "FCtl_FTB_0x04(307)" VALUE 0x001655A4 /* @ECU_Address@FCtl_FTB_0x04@0x024C5133@ */ ECIPP_ALIGNMENT_UBYTE 255 Compu_IDENTITY 0 255 PHYS_UNIT "FTB" /end CHARACTERISTIC
/begin CHARACTERISTIC FCftb_SPKD4_dw_hi "FCtl_FTB_0x04(79)" VALUE 0x001654C0 /* @ECU_Address@FCtl_FTB_0x04@0x024C504F@ */ ECIPP_ALIGNMENT_UBYTE 255 Compu_IDENTITY 0 255 PHYS_UNIT "FTB" /end CHARACTERISTIC
/begin CHARACTERISTIC FCftb_SPKD4_dw_lo "FCtl_FTB_0x04(69)" VALUE 0x001654B6 /* @ECU_Address@FCtl_FTB_0x04@0x024C5045@ */ ECIPP_ALIGNMENT_UBYTE 255 Compu_IDENTITY 0 255 PHYS_UNIT "FTB" /end CHARACTERISTIC
/begin CHARACTERISTIC FCftb_SPKD5_coil_fail "FCtl_FTB_0x04(308)" VALUE 0x001655A5 /* @ECU_Address@FCtl_FTB_0x04@0x024C5134@ */ ECIPP_ALIGNMENT_UBYTE 255 Compu_IDENTITY 0 255 PHYS_UNIT "FTB" /end CHARACTERISTIC
/begin CHARACTERISTIC FCftb_SPKD5_dw_hi "FCtl_FTB_0x04(80)" VALUE 0x001654C1 /* @ECU_Address@FCtl_FTB_0x04@0x024C5050@ */ ECIPP_ALIGNMENT_UBYTE 255 Compu_IDENTITY 0 255 PHYS_UNIT "FTB" /end CHARACTERISTIC
/begin CHARACTERISTIC FCftb_SPKD5_dw_lo "FCtl_FTB_0x04(70)" VALUE 0x001654B7 /* @ECU_Address@FCtl_FTB_0x04@0x024C5046@ */ ECIPP_ALIGNMENT_UBYTE 255 Compu_IDENTITY 0 255 PHYS_UNIT "FTB" /end CHARACTERISTIC
/begin CHARACTERISTIC FCftb_SPKD6_coil_fail "FCtl_FTB_0x04(309)" VALUE 0x001655A6 /* @ECU_Address@FCtl_FTB_0x04@0x024C5135@ */ ECIPP_ALIGNMENT_UBYTE 255 Compu_IDENTITY 0 255 PHYS_UNIT "FTB" /end CHARACTERISTIC
/begin CHARACTERISTIC FCftb_SPKD6_dw_hi "FCtl_FTB_0x04(81)" VALUE 0x001654C2 /* @ECU_Address@FCtl_FTB_0x04@0x024C5051@ */ ECIPP_ALIGNMENT_UBYTE 255 Compu_IDENTITY 0 255 PHYS_UNIT "FTB" /end CHARACTERISTIC
/begin CHARACTERISTIC FCftb_SPKD6_dw_lo "FCtl_FTB_0x04(71)" VALUE 0x001654B8 /* @ECU_Address@FCtl_FTB_0x04@0x024C5047@ */ ECIPP_ALIGNMENT_UBYTE 255 Compu_IDENTITY 0 255 PHYS_UNIT "FTB" /end CHARACTERISTIC
/begin CHARACTERISTIC FCftb_SPKD7_coil_fail "FCtl_FTB_0x04(310)" VALUE 0x001655A7 /* @ECU_Address@FCtl_FTB_0x04@0x024C5136@ */ ECIPP_ALIGNMENT_UBYTE 255 Compu_IDENTITY 0 255 PHYS_UNIT "FTB" /end CHARACTERISTIC
/begin CHARACTERISTIC FCftb_SPKD7_dw_hi "FCtl_FTB_0x04(82)" VALUE 0x001654C3 /* @ECU_Address@FCtl_FTB_0x04@0x024C5052@ */ ECIPP_ALIGNMENT_UBYTE 255 Compu_IDENTITY 0 255 PHYS_UNIT "FTB" /end CHARACTERISTIC
/begin CHARACTERISTIC FCftb_SPKD7_dw_lo "FCtl_FTB_0x04(72)" VALUE 0x001654B9 /* @ECU_Address@FCtl_FTB_0x04@0x024C5048@ */ ECIPP_ALIGNMENT_UBYTE 255 Compu_IDENTITY 0 255 PHYS_UNIT "FTB" /end CHARACTERISTIC
/begin CHARACTERISTIC FCftb_SPKD8_coil_fail "FCtl_FTB_0x04(311)" VALUE 0x001655A8 /* @ECU_Address@FCtl_FTB_0x04@0x024C5137@ */ ECIPP_ALIGNMENT_UBYTE 255 Compu_IDENTITY 0 255 PHYS_UNIT "FTB" /end CHARACTERISTIC
/begin CHARACTERISTIC FCftb_SPKD8_dw_hi "FCtl_FTB_0x04(83)" VALUE 0x001654C4 /* @ECU_Address@FCtl_FTB_0x04@0x024C5053@ */ ECIPP_ALIGNMENT_UBYTE 255 Compu_IDENTITY 0 255 PHYS_UNIT "FTB" /end CHARACTERISTIC
/begin CHARACTERISTIC FCftb_SPKD8_dw_lo "FCtl_FTB_0x04(73)" VALUE 0x001654BA /* @ECU_Address@FCtl_FTB_0x04@0x024C5049@ */ ECIPP_ALIGNMENT_UBYTE 255 Compu_IDENTITY 0 255 PHYS_UNIT "FTB" /end CHARACTERISTIC
/begin CHARACTERISTIC FCftb_SPKD9_coil_fail "FCtl_FTB_0x04(312)" VALUE 0x001655A9 /* @ECU_Address@FCtl_FTB_0x04@0x024C5138@ */ ECIPP_ALIGNMENT_UBYTE 255 Compu_IDENTITY 0 255 PHYS_UNIT "FTB" /end CHARACTERISTIC
/begin CHARACTERISTIC FCftb_SPKD9_dw_hi "FCtl_FTB_0x04(84)" VALUE 0x001654C5 /* @ECU_Address@FCtl_FTB_0x04@0x024C5054@ */ ECIPP_ALIGNMENT_UBYTE 255 Compu_IDENTITY 0 255 PHYS_UNIT "FTB" /end CHARACTERISTIC
/begin CHARACTERISTIC FCftb_SPKD9_dw_lo "FCtl_FTB_0x04(74)" VALUE 0x001654BB /* @ECU_Address@FCtl_FTB_0x04@0x024C504A@ */ ECIPP_ALIGNMENT_UBYTE 255 Compu_IDENTITY 0 255 PHYS_UNIT "FTB" /end CHARACTERISTIC
/begin CHARACTERISTIC FCftb_UGF_Hv_lo "FCtl_FTB_0x04(243)" VALUE 0x00165564 /* @ECU_Address@FCtl_FTB_0x04@0x024C50F3@ */ ECIPP_ALIGNMENT_UBYTE 255 Compu_IDENTITY 0 255 PHYS_UNIT "FTB" /end CHARACTERISTIC
/begin CHARACTERISTIC FCftb_UGF1_PR_hi "FCtl_FTB_0x04(257)" VALUE 0x00165572 /* @ECU_Address@FCtl_FTB_0x04@0x024C5101@ */ ECIPP_ALIGNMENT_UBYTE 255 Compu_IDENTITY 0 255 PHYS_UNIT "FTB" /end CHARACTERISTIC
/begin CHARACTERISTIC FCftb_UGF1_PR_lo "FCtl_FTB_0x04(258)" VALUE 0x00165573 /* @ECU_Address@FCtl_FTB_0x04@0x024C5102@ */ ECIPP_ALIGNMENT_UBYTE 255 Compu_IDENTITY 0 255 PHYS_UNIT "FTB" /end CHARACTERISTIC
/begin CHARACTERISTIC FCftb_UGF1_PR_slow "FCtl_FTB_0x04(255)" VALUE 0x00165570 /* @ECU_Address@FCtl_FTB_0x04@0x024C50FF@ */ ECIPP_ALIGNMENT_UBYTE 255 Compu_IDENTITY 0 255 PHYS_UNIT "FTB" /end CHARACTERISTIC
/begin CHARACTERISTIC FCftb_UGF1_Pv_hi "FCtl_FTB_0x04(252)" VALUE 0x0016556D /* @ECU_Address@FCtl_FTB_0x04@0x024C50FC@ */ ECIPP_ALIGNMENT_UBYTE 255 Compu_IDENTITY 0 255 PHYS_UNIT "FTB" /end CHARACTERISTIC
/begin CHARACTERISTIC FCftb_UGF1_Pv_lo "FCtl_FTB_0x04(253)" VALUE 0x0016556E /* @ECU_Address@FCtl_FTB_0x04@0x024C50FD@ */ ECIPP_ALIGNMENT_UBYTE 255 Compu_IDENTITY 0 255 PHYS_UNIT "FTB" /end CHARACTERISTIC
/begin CHARACTERISTIC FCftb_UGF1_PvFB_hi "FCtl_FTB_0x04(248)" VALUE 0x00165569 /* @ECU_Address@FCtl_FTB_0x04@0x024C50F8@ */ ECIPP_ALIGNMENT_UBYTE 255 Compu_IDENTITY 0 255 PHYS_UNIT "FTB" /end CHARACTERISTIC
/begin CHARACTERISTIC FCftb_UGF1_PvFB_lo "FCtl_FTB_0x04(249)" VALUE 0x0016556A /* @ECU_Address@FCtl_FTB_0x04@0x024C50F9@ */ ECIPP_ALIGNMENT_UBYTE 255 Compu_IDENTITY 0 255 PHYS_UNIT "FTB" /end CHARACTERISTIC
/begin CHARACTERISTIC FCftb_UGF1_R_lo "FCtl_FTB_0x04(245)" VALUE 0x00165566 /* @ECU_Address@FCtl_FTB_0x04@0x024C50F5@ */ ECIPP_ALIGNMENT_UBYTE 255 Compu_IDENTITY 0 255 PHYS_UNIT "FTB" /end CHARACTERISTIC
/begin CHARACTERISTIC FCftb_UGF1_rtn_hi "FCtl_FTB_0x04(246)" VALUE 0x00165567 /* @ECU_Address@FCtl_FTB_0x04@0x024C50F6@ */ ECIPP_ALIGNMENT_UBYTE 255 Compu_IDENTITY 0 255 PHYS_UNIT "FTB" /end CHARACTERISTIC
/begin CHARACTERISTIC FCftb_UGF1_rtn_lo "FCtl_FTB_0x04(247)" VALUE 0x00165568 /* @ECU_Address@FCtl_FTB_0x04@0x024C50F7@ */ ECIPP_ALIGNMENT_UBYTE 255 Compu_IDENTITY 0 255 PHYS_UNIT "FTB" /end CHARACTERISTIC
/begin CHARACTERISTIC FCftb_UGF1_Sv_lo "FCtl_FTB_0x04(251)" VALUE 0x0016556C /* @ECU_Address@FCtl_FTB_0x04@0x024C50FB@ */ ECIPP_ALIGNMENT_UBYTE 255 Compu_IDENTITY 0 255 PHYS_UNIT "FTB" /end CHARACTERISTIC
/begin CHARACTERISTIC FCftb_UGF2_Hv_lo "FCtl_FTB_0x04(410)" VALUE 0x0016560B /* @ECU_Address@FCtl_FTB_0x04@0x024C519A@ */ ECIPP_ALIGNMENT_UBYTE 255 Compu_IDENTITY 0 255 PHYS_UNIT "FTB" /end CHARACTERISTIC
/begin CHARACTERISTIC FCftb_UGF2_PR_hi "FCtl_FTB_0x04(424)" VALUE 0x00165619 /* @ECU_Address@FCtl_FTB_0x04@0x024C51A8@ */ ECIPP_ALIGNMENT_UBYTE 255 Compu_IDENTITY 0 255 PHYS_UNIT "FTB" /end CHARACTERISTIC
/begin CHARACTERISTIC FCftb_UGF2_PR_lo "FCtl_FTB_0x04(425)" VALUE 0x0016561A /* @ECU_Address@FCtl_FTB_0x04@0x024C51A9@ */ ECIPP_ALIGNMENT_UBYTE 255 Compu_IDENTITY 0 255 PHYS_UNIT "FTB" /end CHARACTERISTIC
/begin CHARACTERISTIC FCftb_UGF2_PR_slow "FCtl_FTB_0x04(422)" VALUE 0x00165617 /* @ECU_Address@FCtl_FTB_0x04@0x024C51A6@ */ ECIPP_ALIGNMENT_UBYTE 255 Compu_IDENTITY 0 255 PHYS_UNIT "FTB" /end CHARACTERISTIC
/begin CHARACTERISTIC FCftb_UGF2_Pv_hi "FCtl_FTB_0x04(419)" VALUE 0x00165614 /* @ECU_Address@FCtl_FTB_0x04@0x024C51A3@ */ ECIPP_ALIGNMENT_UBYTE 255 Compu_IDENTITY 0 255 PHYS_UNIT "FTB" /end CHARACTERISTIC
/begin CHARACTERISTIC FCftb_UGF2_Pv_lo "FCtl_FTB_0x04(420)" VALUE 0x00165615 /* @ECU_Address@FCtl_FTB_0x04@0x024C51A4@ */ ECIPP_ALIGNMENT_UBYTE 255 Compu_IDENTITY 0 255 PHYS_UNIT "FTB" /end CHARACTERISTIC
/begin CHARACTERISTIC FCftb_UGF2_PvFB_hi "FCtl_FTB_0x04(415)" VALUE 0x00165610 /* @ECU_Address@FCtl_FTB_0x04@0x024C519F@ */ ECIPP_ALIGNMENT_UBYTE 255 Compu_IDENTITY 0 255 PHYS_UNIT "FTB" /end CHARACTERISTIC
/begin CHARACTERISTIC FCftb_UGF2_PvFB_lo "FCtl_FTB_0x04(416)" VALUE 0x00165611 /* @ECU_Address@FCtl_FTB_0x04@0x024C51A0@ */ ECIPP_ALIGNMENT_UBYTE 255 Compu_IDENTITY 0 255 PHYS_UNIT "FTB" /end CHARACTERISTIC
/begin CHARACTERISTIC FCftb_UGF2_R_lo "FCtl_FTB_0x04(412)" VALUE 0x0016560D /* @ECU_Address@FCtl_FTB_0x04@0x024C519C@ */ ECIPP_ALIGNMENT_UBYTE 255 Compu_IDENTITY 0 255 PHYS_UNIT "FTB" /end CHARACTERISTIC
/begin CHARACTERISTIC FCftb_UGF2_rtn_hi "FCtl_FTB_0x04(413)" VALUE 0x0016560E /* @ECU_Address@FCtl_FTB_0x04@0x024C519D@ */ ECIPP_ALIGNMENT_UBYTE 255 Compu_IDENTITY 0 255 PHYS_UNIT "FTB" /end CHARACTERISTIC
/begin CHARACTERISTIC FCftb_UGF2_rtn_lo "FCtl_FTB_0x04(414)" VALUE 0x0016560F /* @ECU_Address@FCtl_FTB_0x04@0x024C519E@ */ ECIPP_ALIGNMENT_UBYTE 255 Compu_IDENTITY 0 255 PHYS_UNIT "FTB" /end CHARACTERISTIC
/begin CHARACTERISTIC FCftb_UGF2_Sv_lo "FCtl_FTB_0x04(418)" VALUE 0x00165613 /* @ECU_Address@FCtl_FTB_0x04@0x024C51A2@ */ ECIPP_ALIGNMENT_UBYTE 255 Compu_IDENTITY 0 255 PHYS_UNIT "FTB" /end CHARACTERISTIC
/begin CHARACTERISTIC FCftb_UGF3_Hv_lo "FCtl_FTB_0x04(606)" VALUE 0x001656CF /* @ECU_Address@FCtl_FTB_0x04@0x024C525E@ */ ECIPP_ALIGNMENT_UBYTE 255 Compu_IDENTITY 0 255 PHYS_UNIT "FTB" /end CHARACTERISTIC
/begin CHARACTERISTIC FCftb_UGF3_PR_hi "FCtl_FTB_0x04(620)" VALUE 0x001656DD /* @ECU_Address@FCtl_FTB_0x04@0x024C526C@ */ ECIPP_ALIGNMENT_UBYTE 255 Compu_IDENTITY 0 255 PHYS_UNIT "FTB" /end CHARACTERISTIC
/begin CHARACTERISTIC FCftb_UGF3_PR_lo "FCtl_FTB_0x04(621)" VALUE 0x001656DE /* @ECU_Address@FCtl_FTB_0x04@0x024C526D@ */ ECIPP_ALIGNMENT_UBYTE 255 Compu_IDENTITY 0 255 PHYS_UNIT "FTB" /end CHARACTERISTIC
/begin CHARACTERISTIC FCftb_UGF3_PR_slow "FCtl_FTB_0x04(618)" VALUE 0x001656DB /* @ECU_Address@FCtl_FTB_0x04@0x024C526A@ */ ECIPP_ALIGNMENT_UBYTE 255 Compu_IDENTITY 0 255 PHYS_UNIT "FTB" /end CHARACTERISTIC
/begin CHARACTERISTIC FCftb_UGF3_Pv_hi "FCtl_FTB_0x04(615)" VALUE 0x001656D8 /* @ECU_Address@FCtl_FTB_0x04@0x024C5267@ */ ECIPP_ALIGNMENT_UBYTE 255 Compu_IDENTITY 0 255 PHYS_UNIT "FTB" /end CHARACTERISTIC
/begin CHARACTERISTIC FCftb_UGF3_Pv_lo "FCtl_FTB_0x04(616)" VALUE 0x001656D9 /* @ECU_Address@FCtl_FTB_0x04@0x024C5268@ */ ECIPP_ALIGNMENT_UBYTE 255 Compu_IDENTITY 0 255 PHYS_UNIT "FTB" /end CHARACTERISTIC
/begin CHARACTERISTIC FCftb_UGF3_PvFB_hi "FCtl_FTB_0x04(611)" VALUE 0x001656D4 /* @ECU_Address@FCtl_FTB_0x04@0x024C5263@ */ ECIPP_ALIGNMENT_UBYTE 255 Compu_IDENTITY 0 255 PHYS_UNIT "FTB" /end CHARACTERISTIC
/begin CHARACTERISTIC FCftb_UGF3_PvFB_lo "FCtl_FTB_0x04(612)" VALUE 0x001656D5 /* @ECU_Address@FCtl_FTB_0x04@0x024C5264@ */ ECIPP_ALIGNMENT_UBYTE 255 Compu_IDENTITY 0 255 PHYS_UNIT "FTB" /end CHARACTERISTIC
/begin CHARACTERISTIC FCftb_UGF3_R_lo "FCtl_FTB_0x04(608)" VALUE 0x001656D1 /* @ECU_Address@FCtl_FTB_0x04@0x024C5260@ */ ECIPP_ALIGNMENT_UBYTE 255 Compu_IDENTITY 0 255 PHYS_UNIT "FTB" /end CHARACTERISTIC
/begin CHARACTERISTIC FCftb_UGF3_rtn_hi "FCtl_FTB_0x04(609)" VALUE 0x001656D2 /* @ECU_Address@FCtl_FTB_0x04@0x024C5261@ */ ECIPP_ALIGNMENT_UBYTE 255 Compu_IDENTITY 0 255 PHYS_UNIT "FTB" /end CHARACTERISTIC
/begin CHARACTERISTIC FCftb_UGF3_rtn_lo "FCtl_FTB_0x04(610)" VALUE 0x001656D3 /* @ECU_Address@FCtl_FTB_0x04@0x024C5262@ */ ECIPP_ALIGNMENT_UBYTE 255 Compu_IDENTITY 0 255 PHYS_UNIT "FTB" /end CHARACTERISTIC
/begin CHARACTERISTIC FCftb_UGF3_Sv_lo "FCtl_FTB_0x04(614)" VALUE 0x001656D7 /* @ECU_Address@FCtl_FTB_0x04@0x024C5266@ */ ECIPP_ALIGNMENT_UBYTE 255 Compu_IDENTITY 0 255 PHYS_UNIT "FTB" /end CHARACTERISTIC
/begin CHARACTERISTIC FCftb_UGF4_Hv_lo "FCtl_FTB_0x04(629)" VALUE 0x001656E6 /* @ECU_Address@FCtl_FTB_0x04@0x024C5275@ */ ECIPP_ALIGNMENT_UBYTE 255 Compu_IDENTITY 0 255 PHYS_UNIT "FTB" /end CHARACTERISTIC
/begin CHARACTERISTIC FCftb_UGF4_PR_hi "FCtl_FTB_0x04(643)" VALUE 0x001656F4 /* @ECU_Address@FCtl_FTB_0x04@0x024C5283@ */ ECIPP_ALIGNMENT_UBYTE 255 Compu_IDENTITY 0 255 PHYS_UNIT "FTB" /end CHARACTERISTIC
/begin CHARACTERISTIC FCftb_UGF4_PR_lo "FCtl_FTB_0x04(644)" VALUE 0x001656F5 /* @ECU_Address@FCtl_FTB_0x04@0x024C5284@ */ ECIPP_ALIGNMENT_UBYTE 255 Compu_IDENTITY 0 255 PHYS_UNIT "FTB" /end CHARACTERISTIC
/begin CHARACTERISTIC FCftb_UGF4_PR_slow "FCtl_FTB_0x04(641)" VALUE 0x001656F2 /* @ECU_Address@FCtl_FTB_0x04@0x024C5281@ */ ECIPP_ALIGNMENT_UBYTE 255 Compu_IDENTITY 0 255 PHYS_UNIT "FTB" /end CHARACTERISTIC
/begin CHARACTERISTIC FCftb_UGF4_Pv_hi "FCtl_FTB_0x04(638)" VALUE 0x001656EF /* @ECU_Address@FCtl_FTB_0x04@0x024C527E@ */ ECIPP_ALIGNMENT_UBYTE 255 Compu_IDENTITY 0 255 PHYS_UNIT "FTB" /end CHARACTERISTIC
/begin CHARACTERISTIC FCftb_UGF4_Pv_lo "FCtl_FTB_0x04(639)" VALUE 0x001656F0 /* @ECU_Address@FCtl_FTB_0x04@0x024C527F@ */ ECIPP_ALIGNMENT_UBYTE 255 Compu_IDENTITY 0 255 PHYS_UNIT "FTB" /end CHARACTERISTIC
/begin CHARACTERISTIC FCftb_UGF4_PvFB_hi "FCtl_FTB_0x04(634)" VALUE 0x001656EB /* @ECU_Address@FCtl_FTB_0x04@0x024C527A@ */ ECIPP_ALIGNMENT_UBYTE 255 Compu_IDENTITY 0 255 PHYS_UNIT "FTB" /end CHARACTERISTIC
/begin CHARACTERISTIC FCftb_UGF4_PvFB_lo "FCtl_FTB_0x04(635)" VALUE 0x001656EC /* @ECU_Address@FCtl_FTB_0x04@0x024C527B@ */ ECIPP_ALIGNMENT_UBYTE 255 Compu_IDENTITY 0 255 PHYS_UNIT "FTB" /end CHARACTERISTIC
/begin CHARACTERISTIC FCftb_UGF4_R_lo "FCtl_FTB_0x04(631)" VALUE 0x001656E8 /* @ECU_Address@FCtl_FTB_0x04@0x024C5277@ */ ECIPP_ALIGNMENT_UBYTE 255 Compu_IDENTITY 0 255 PHYS_UNIT "FTB" /end CHARACTERISTIC
/begin CHARACTERISTIC FCftb_UGF4_rtn_hi "FCtl_FTB_0x04(632)" VALUE 0x001656E9 /* @ECU_Address@FCtl_FTB_0x04@0x024C5278@ */ ECIPP_ALIGNMENT_UBYTE 255 Compu_IDENTITY 0 255 PHYS_UNIT "FTB" /end CHARACTERISTIC
/begin CHARACTERISTIC FCftb_UGF4_rtn_lo "FCtl_FTB_0x04(633)" VALUE 0x001656EA /* @ECU_Address@FCtl_FTB_0x04@0x024C5279@ */ ECIPP_ALIGNMENT_UBYTE 255 Compu_IDENTITY 0 255 PHYS_UNIT "FTB" /end CHARACTERISTIC
/begin CHARACTERISTIC FCftb_UGF4_Sv_lo "FCtl_FTB_0x04(637)" VALUE 0x001656EE /* @ECU_Address@FCtl_FTB_0x04@0x024C527D@ */ ECIPP_ALIGNMENT_UBYTE 255 Compu_IDENTITY 0 255 PHYS_UNIT "FTB" /end CHARACTERISTIC
/begin CHARACTERISTIC FCspn_AL2_hi "FCtl_SPN(40)" VALUE 0x00161D7C /* @ECU_Address@FCtl_SPN@0x021B60A0@ */ ECIPP_ALIGNMENT_ULONG 4294967295 Compu_IDENTITY 0 4294967295 PHYS_UNIT "SPN" /end CHARACTERISTIC
/begin CHARACTERISTIC FCspn_AL2_lo "FCtl_SPN(41)" VALUE 0x00161D80 /* @ECU_Address@FCtl_SPN@0x021B60A4@ */ ECIPP_ALIGNMENT_ULONG 4294967295 Compu_IDENTITY 0 4294967295 PHYS_UNIT "SPN" /end CHARACTERISTIC
/begin CHARACTERISTIC FCspn_CFVxminFT "FCtl_SPN(533)" VALUE 0x00162530 /* @ECU_Address@FCtl_SPN@0x021B6854@ */ ECIPP_ALIGNMENT_ULONG 4294967295 Compu_IDENTITY 0 4294967295 PHYS_UNIT "SPN" /end CHARACTERISTIC
/begin CHARACTERISTIC FCspn_CL2_hi "FCtl_SPN(34)" VALUE 0x00161D64 /* @ECU_Address@FCtl_SPN@0x021B6088@ */ ECIPP_ALIGNMENT_ULONG 4294967295 Compu_IDENTITY 0 4294967295 PHYS_UNIT "SPN" /end CHARACTERISTIC
/begin CHARACTERISTIC FCspn_CL2_lo "FCtl_SPN(35)" VALUE 0x00161D68 /* @ECU_Address@FCtl_SPN@0x021B608C@ */ ECIPP_ALIGNMENT_ULONG 4294967295 Compu_IDENTITY 0 4294967295 PHYS_UNIT "SPN" /end CHARACTERISTIC
/begin CHARACTERISTIC FCspn_CM2_unresp "FCtl_SPN(800)" VALUE 0x0016295C /* @ECU_Address@FCtl_SPN@0x021B6C80@ */ ECIPP_ALIGNMENT_ULONG 4294967295 Compu_IDENTITY 0 4294967295 PHYS_UNIT "SPN" /end CHARACTERISTIC
/begin CHARACTERISTIC FCspn_CM2gsln_inact "FCtl_SPN(199)" VALUE 0x00161FF8 /* @ECU_Address@FCtl_SPN@0x021B631C@ */ ECIPP_ALIGNMENT_ULONG 4294967295 Compu_IDENTITY 0 4294967295 PHYS_UNIT "SPN" /end CHARACTERISTIC
/begin CHARACTERISTIC FCspn_EGO4_open "FCtl_SPN(200)" VALUE 0x00161FFC /* @ECU_Address@FCtl_SPN@0x021B6320@ */ ECIPP_ALIGNMENT_ULONG 4294967295 Compu_IDENTITY 0 4294967295 PHYS_UNIT "SPN" /end CHARACTERISTIC
/begin CHARACTERISTIC FCspn_EMWT2_HiExp1 "FCtl_SPN(226)" VALUE 0x00162064 /* @ECU_Address@FCtl_SPN@0x021B6388@ */ ECIPP_ALIGNMENT_ULONG 4294967295 Compu_IDENTITY 0 4294967295 PHYS_UNIT "SPN" /end CHARACTERISTIC
/begin CHARACTERISTIC FCspn_EMWT2_HiExp2 "FCtl_SPN(228)" VALUE 0x0016206C /* @ECU_Address@FCtl_SPN@0x021B6390@ */ ECIPP_ALIGNMENT_ULONG 4294967295 Compu_IDENTITY 0 4294967295 PHYS_UNIT "SPN" /end CHARACTERISTIC
/begin CHARACTERISTIC FCspn_EMWT2_maxv "FCtl_SPN(222)" VALUE 0x00162054 /* @ECU_Address@FCtl_SPN@0x021B6378@ */ ECIPP_ALIGNMENT_ULONG 4294967295 Compu_IDENTITY 0 4294967295 PHYS_UNIT "SPN" /end CHARACTERISTIC
/begin CHARACTERISTIC FCspn_EMWT2_minv "FCtl_SPN(224)" VALUE 0x0016205C /* @ECU_Address@FCtl_SPN@0x021B6380@ */ ECIPP_ALIGNMENT_ULONG 4294967295 Compu_IDENTITY 0 4294967295 PHYS_UNIT "SPN" /end CHARACTERISTIC
/begin CHARACTERISTIC FCspn_ERWT2_HiExp1 "FCtl_SPN(238)" VALUE 0x00162094 /* @ECU_Address@FCtl_SPN@0x021B63B8@ */ ECIPP_ALIGNMENT_ULONG 4294967295 Compu_IDENTITY 0 4294967295 PHYS_UNIT "SPN" /end CHARACTERISTIC
/begin CHARACTERISTIC FCspn_ERWT2_HiExp2 "FCtl_SPN(240)" VALUE 0x0016209C /* @ECU_Address@FCtl_SPN@0x021B63C0@ */ ECIPP_ALIGNMENT_ULONG 4294967295 Compu_IDENTITY 0 4294967295 PHYS_UNIT "SPN" /end CHARACTERISTIC
/begin CHARACTERISTIC FCspn_ERWT2_maxv "FCtl_SPN(234)" VALUE 0x00162084 /* @ECU_Address@FCtl_SPN@0x021B63A8@ */ ECIPP_ALIGNMENT_ULONG 4294967295 Compu_IDENTITY 0 4294967295 PHYS_UNIT "SPN" /end CHARACTERISTIC
/begin CHARACTERISTIC FCspn_ERWT2_minv "FCtl_SPN(236)" VALUE 0x0016208C /* @ECU_Address@FCtl_SPN@0x021B63B0@ */ ECIPP_ALIGNMENT_ULONG 4294967295 Compu_IDENTITY 0 4294967295 PHYS_UNIT "SPN" /end CHARACTERISTIC
/begin CHARACTERISTIC FCspn_GLOW10_open "FCtl_SPN(492)" VALUE 0x0016248C /* @ECU_Address@FCtl_SPN@0x021B67B0@ */ ECIPP_ALIGNMENT_ULONG 4294967295 Compu_IDENTITY 0 4294967295 PHYS_UNIT "SPN" /end CHARACTERISTIC
/begin CHARACTERISTIC FCspn_GLOW10_short "FCtl_SPN(502)" VALUE 0x001624B4 /* @ECU_Address@FCtl_SPN@0x021B67D8@ */ ECIPP_ALIGNMENT_ULONG 4294967295 Compu_IDENTITY 0 4294967295 PHYS_UNIT "SPN" /end CHARACTERISTIC
/begin CHARACTERISTIC FCspn_GLOW2_open "FCtl_SPN(484)" VALUE 0x0016246C /* @ECU_Address@FCtl_SPN@0x021B6790@ */ ECIPP_ALIGNMENT_ULONG 4294967295 Compu_IDENTITY 0 4294967295 PHYS_UNIT "SPN" /end CHARACTERISTIC
/begin CHARACTERISTIC FCspn_GLOW2_short "FCtl_SPN(494)" VALUE 0x00162494 /* @ECU_Address@FCtl_SPN@0x021B67B8@ */ ECIPP_ALIGNMENT_ULONG 4294967295 Compu_IDENTITY 0 4294967295 PHYS_UNIT "SPN" /end CHARACTERISTIC
/begin CHARACTERISTIC FCspn_GLOW3_open "FCtl_SPN(485)" VALUE 0x00162470 /* @ECU_Address@FCtl_SPN@0x021B6794@ */ ECIPP_ALIGNMENT_ULONG 4294967295 Compu_IDENTITY 0 4294967295 PHYS_UNIT "SPN" /end CHARACTERISTIC
/begin CHARACTERISTIC FCspn_GLOW3_short "FCtl_SPN(495)" VALUE 0x00162498 /* @ECU_Address@FCtl_SPN@0x021B67BC@ */ ECIPP_ALIGNMENT_ULONG 4294967295 Compu_IDENTITY 0 4294967295 PHYS_UNIT "SPN" /end CHARACTERISTIC
/begin CHARACTERISTIC FCspn_GLOW4_open "FCtl_SPN(486)" VALUE 0x00162474 /* @ECU_Address@FCtl_SPN@0x021B6798@ */ ECIPP_ALIGNMENT_ULONG 4294967295 Compu_IDENTITY 0 4294967295 PHYS_UNIT "SPN" /end CHARACTERISTIC
/begin CHARACTERISTIC FCspn_GLOW4_short "FCtl_SPN(496)" VALUE 0x0016249C /* @ECU_Address@FCtl_SPN@0x021B67C0@ */ ECIPP_ALIGNMENT_ULONG 4294967295 Compu_IDENTITY 0 4294967295 PHYS_UNIT "SPN" /end CHARACTERISTIC
/begin CHARACTERISTIC FCspn_GLOW5_open "FCtl_SPN(487)" VALUE 0x00162478 /* @ECU_Address@FCtl_SPN@0x021B679C@ */ ECIPP_ALIGNMENT_ULONG 4294967295 Compu_IDENTITY 0 4294967295 PHYS_UNIT "SPN" /end CHARACTERISTIC
/begin CHARACTERISTIC FCspn_GLOW5_short "FCtl_SPN(497)" VALUE 0x001624A0 /* @ECU_Address@FCtl_SPN@0x021B67C4@ */ ECIPP_ALIGNMENT_ULONG 4294967295 Compu_IDENTITY 0 4294967295 PHYS_UNIT "SPN" /end CHARACTERISTIC
/begin CHARACTERISTIC FCspn_GLOW6_open "FCtl_SPN(488)" VALUE 0x0016247C /* @ECU_Address@FCtl_SPN@0x021B67A0@ */ ECIPP_ALIGNMENT_ULONG 4294967295 Compu_IDENTITY 0 4294967295 PHYS_UNIT "SPN" /end CHARACTERISTIC
/begin CHARACTERISTIC FCspn_GLOW6_short "FCtl_SPN(498)" VALUE 0x001624A4 /* @ECU_Address@FCtl_SPN@0x021B67C8@ */ ECIPP_ALIGNMENT_ULONG 4294967295 Compu_IDENTITY 0 4294967295 PHYS_UNIT "SPN" /end CHARACTERISTIC
/begin CHARACTERISTIC FCspn_GLOW7_open "FCtl_SPN(489)" VALUE 0x00162480 /* @ECU_Address@FCtl_SPN@0x021B67A4@ */ ECIPP_ALIGNMENT_ULONG 4294967295 Compu_IDENTITY 0 4294967295 PHYS_UNIT "SPN" /end CHARACTERISTIC
/begin CHARACTERISTIC FCspn_GLOW7_short "FCtl_SPN(499)" VALUE 0x001624A8 /* @ECU_Address@FCtl_SPN@0x021B67CC@ */ ECIPP_ALIGNMENT_ULONG 4294967295 Compu_IDENTITY 0 4294967295 PHYS_UNIT "SPN" /end CHARACTERISTIC
/begin CHARACTERISTIC FCspn_GLOW8_open "FCtl_SPN(490)" VALUE 0x00162484 /* @ECU_Address@FCtl_SPN@0x021B67A8@ */ ECIPP_ALIGNMENT_ULONG 4294967295 Compu_IDENTITY 0 4294967295 PHYS_UNIT "SPN" /end CHARACTERISTIC
/begin CHARACTERISTIC FCspn_GLOW8_short "FCtl_SPN(500)" VALUE 0x001624AC /* @ECU_Address@FCtl_SPN@0x021B67D0@ */ ECIPP_ALIGNMENT_ULONG 4294967295 Compu_IDENTITY 0 4294967295 PHYS_UNIT "SPN" /end CHARACTERISTIC
/begin CHARACTERISTIC FCspn_GLOW9_open "FCtl_SPN(491)" VALUE 0x00162488 /* @ECU_Address@FCtl_SPN@0x021B67AC@ */ ECIPP_ALIGNMENT_ULONG 4294967295 Compu_IDENTITY 0 4294967295 PHYS_UNIT "SPN" /end CHARACTERISTIC
/begin CHARACTERISTIC FCspn_GLOW9_short "FCtl_SPN(501)" VALUE 0x001624B0 /* @ECU_Address@FCtl_SPN@0x021B67D4@ */ ECIPP_ALIGNMENT_ULONG 4294967295 Compu_IDENTITY 0 4294967295 PHYS_UNIT "SPN" /end CHARACTERISTIC
/begin CHARACTERISTIC FCspn_ICAVD10_mis "FCtl_SPN(315)" VALUE 0x001621C8 /* @ECU_Address@FCtl_SPN@0x021B64EC@ */ ECIPP_ALIGNMENT_ULONG 4294967295 Compu_IDENTITY 0 4294967295 PHYS_UNIT "SPN" /end CHARACTERISTIC
/begin CHARACTERISTIC FCspn_ICAVD10_miscat "FCtl_SPN(317)" VALUE 0x001621D0 /* @ECU_Address@FCtl_SPN@0x021B64F4@ */ ECIPP_ALIGNMENT_ULONG 4294967295 Compu_IDENTITY 0 4294967295 PHYS_UNIT "SPN" /end CHARACTERISTIC
/begin CHARACTERISTIC FCspn_ICAVD2_mis "FCtl_SPN(260)" VALUE 0x001620EC /* @ECU_Address@FCtl_SPN@0x021B6410@ */ ECIPP_ALIGNMENT_ULONG 4294967295 Compu_IDENTITY 0 4294967295 PHYS_UNIT "SPN" /end CHARACTERISTIC
/begin CHARACTERISTIC FCspn_ICAVD2_miscat "FCtl_SPN(268)" VALUE 0x0016210C /* @ECU_Address@FCtl_SPN@0x021B6430@ */ ECIPP_ALIGNMENT_ULONG 4294967295 Compu_IDENTITY 0 4294967295 PHYS_UNIT "SPN" /end CHARACTERISTIC
/begin CHARACTERISTIC FCspn_ICAVD3_mis "FCtl_SPN(261)" VALUE 0x001620F0 /* @ECU_Address@FCtl_SPN@0x021B6414@ */ ECIPP_ALIGNMENT_ULONG 4294967295 Compu_IDENTITY 0 4294967295 PHYS_UNIT "SPN" /end CHARACTERISTIC
/begin CHARACTERISTIC FCspn_ICAVD3_miscat "FCtl_SPN(269)" VALUE 0x00162110 /* @ECU_Address@FCtl_SPN@0x021B6434@ */ ECIPP_ALIGNMENT_ULONG 4294967295 Compu_IDENTITY 0 4294967295 PHYS_UNIT "SPN" /end CHARACTERISTIC
/begin CHARACTERISTIC FCspn_ICAVD4_mis "FCtl_SPN(262)" VALUE 0x001620F4 /* @ECU_Address@FCtl_SPN@0x021B6418@ */ ECIPP_ALIGNMENT_ULONG 4294967295 Compu_IDENTITY 0 4294967295 PHYS_UNIT "SPN" /end CHARACTERISTIC
/begin CHARACTERISTIC FCspn_ICAVD4_miscat "FCtl_SPN(270)" VALUE 0x00162114 /* @ECU_Address@FCtl_SPN@0x021B6438@ */ ECIPP_ALIGNMENT_ULONG 4294967295 Compu_IDENTITY 0 4294967295 PHYS_UNIT "SPN" /end CHARACTERISTIC
/begin CHARACTERISTIC FCspn_ICAVD5_mis "FCtl_SPN(263)" VALUE 0x001620F8 /* @ECU_Address@FCtl_SPN@0x021B641C@ */ ECIPP_ALIGNMENT_ULONG 4294967295 Compu_IDENTITY 0 4294967295 PHYS_UNIT "SPN" /end CHARACTERISTIC
/begin CHARACTERISTIC FCspn_ICAVD5_miscat "FCtl_SPN(271)" VALUE 0x00162118 /* @ECU_Address@FCtl_SPN@0x021B643C@ */ ECIPP_ALIGNMENT_ULONG 4294967295 Compu_IDENTITY 0 4294967295 PHYS_UNIT "SPN" /end CHARACTERISTIC
/begin CHARACTERISTIC FCspn_ICAVD6_mis "FCtl_SPN(264)" VALUE 0x001620FC /* @ECU_Address@FCtl_SPN@0x021B6420@ */ ECIPP_ALIGNMENT_ULONG 4294967295 Compu_IDENTITY 0 4294967295 PHYS_UNIT "SPN" /end CHARACTERISTIC
/begin CHARACTERISTIC FCspn_ICAVD6_miscat "FCtl_SPN(272)" VALUE 0x0016211C /* @ECU_Address@FCtl_SPN@0x021B6440@ */ ECIPP_ALIGNMENT_ULONG 4294967295 Compu_IDENTITY 0 4294967295 PHYS_UNIT "SPN" /end CHARACTERISTIC
/begin CHARACTERISTIC FCspn_ICAVD7_mis "FCtl_SPN(265)" VALUE 0x00162100 /* @ECU_Address@FCtl_SPN@0x021B6424@ */ ECIPP_ALIGNMENT_ULONG 4294967295 Compu_IDENTITY 0 4294967295 PHYS_UNIT "SPN" /end CHARACTERISTIC
/begin CHARACTERISTIC FCspn_ICAVD7_miscat "FCtl_SPN(273)" VALUE 0x00162120 /* @ECU_Address@FCtl_SPN@0x021B6444@ */ ECIPP_ALIGNMENT_ULONG 4294967295 Compu_IDENTITY 0 4294967295 PHYS_UNIT "SPN" /end CHARACTERISTIC
/begin CHARACTERISTIC FCspn_ICAVD8_mis "FCtl_SPN(266)" VALUE 0x00162104 /* @ECU_Address@FCtl_SPN@0x021B6428@ */ ECIPP_ALIGNMENT_ULONG 4294967295 Compu_IDENTITY 0 4294967295 PHYS_UNIT "SPN" /end CHARACTERISTIC
/begin CHARACTERISTIC FCspn_ICAVD8_miscat "FCtl_SPN(274)" VALUE 0x00162124 /* @ECU_Address@FCtl_SPN@0x021B6448@ */ ECIPP_ALIGNMENT_ULONG 4294967295 Compu_IDENTITY 0 4294967295 PHYS_UNIT "SPN" /end CHARACTERISTIC
/begin CHARACTERISTIC FCspn_ICAVD9_mis "FCtl_SPN(314)" VALUE 0x001621C4 /* @ECU_Address@FCtl_SPN@0x021B64E8@ */ ECIPP_ALIGNMENT_ULONG 4294967295 Compu_IDENTITY 0 4294967295 PHYS_UNIT "SPN" /end CHARACTERISTIC
/begin CHARACTERISTIC FCspn_ICAVD9_miscat "FCtl_SPN(316)" VALUE 0x001621CC /* @ECU_Address@FCtl_SPN@0x021B64F0@ */ ECIPP_ALIGNMENT_ULONG 4294967295 Compu_IDENTITY 0 4294967295 PHYS_UNIT "SPN" /end CHARACTERISTIC
/begin CHARACTERISTIC FCspn_INJD10_off_lo "FCtl_SPN(55)" VALUE 0x00161DB8 /* @ECU_Address@FCtl_SPN@0x021B60DC@ */ ECIPP_ALIGNMENT_ULONG 4294967295 Compu_IDENTITY 0 4294967295 PHYS_UNIT "SPN" /end CHARACTERISTIC
/begin CHARACTERISTIC FCspn_INJD10_on_hi "FCtl_SPN(65)" VALUE 0x00161DE0 /* @ECU_Address@FCtl_SPN@0x021B6104@ */ ECIPP_ALIGNMENT_ULONG 4294967295 Compu_IDENTITY 0 4294967295 PHYS_UNIT "SPN" /end CHARACTERISTIC
/begin CHARACTERISTIC FCspn_INJD2_boost_lo "FCtl_SPN(579)" VALUE 0x001625E8 /* @ECU_Address@FCtl_SPN@0x021B690C@ */ ECIPP_ALIGNMENT_ULONG 4294967295 Compu_IDENTITY 0 4294967295 PHYS_UNIT "SPN" /end CHARACTERISTIC
/begin CHARACTERISTIC FCspn_INJD2_HS_Ihi "FCtl_SPN(563)" VALUE 0x001625A8 /* @ECU_Address@FCtl_SPN@0x021B68CC@ */ ECIPP_ALIGNMENT_ULONG 4294967295 Compu_IDENTITY 0 4294967295 PHYS_UNIT "SPN" /end CHARACTERISTIC
/begin CHARACTERISTIC FCspn_INJD2_HW_int "FCtl_SPN(581)" VALUE 0x001625F0 /* @ECU_Address@FCtl_SPN@0x021B6914@ */ ECIPP_ALIGNMENT_ULONG 4294967295 Compu_IDENTITY 0 4294967295 PHYS_UNIT "SPN" /end CHARACTERISTIC
/begin CHARACTERISTIC FCspn_INJD2_LS_Ihi "FCtl_SPN(571)" VALUE 0x001625C8 /* @ECU_Address@FCtl_SPN@0x021B68EC@ */ ECIPP_ALIGNMENT_ULONG 4294967295 Compu_IDENTITY 0 4294967295 PHYS_UNIT "SPN" /end CHARACTERISTIC
/begin CHARACTERISTIC FCspn_INJD2_off_lo "FCtl_SPN(47)" VALUE 0x00161D98 /* @ECU_Address@FCtl_SPN@0x021B60BC@ */ ECIPP_ALIGNMENT_ULONG 4294967295 Compu_IDENTITY 0 4294967295 PHYS_UNIT "SPN" /end CHARACTERISTIC
/begin CHARACTERISTIC FCspn_INJD2_on_hi "FCtl_SPN(57)" VALUE 0x00161DC0 /* @ECU_Address@FCtl_SPN@0x021B60E4@ */ ECIPP_ALIGNMENT_ULONG 4294967295 Compu_IDENTITY 0 4294967295 PHYS_UNIT "SPN" /end CHARACTERISTIC
/begin CHARACTERISTIC FCspn_INJD3_HS_Ihi "FCtl_SPN(564)" VALUE 0x001625AC /* @ECU_Address@FCtl_SPN@0x021B68D0@ */ ECIPP_ALIGNMENT_ULONG 4294967295 Compu_IDENTITY 0 4294967295 PHYS_UNIT "SPN" /end CHARACTERISTIC
/begin CHARACTERISTIC FCspn_INJD3_LS_Ihi "FCtl_SPN(572)" VALUE 0x001625CC /* @ECU_Address@FCtl_SPN@0x021B68F0@ */ ECIPP_ALIGNMENT_ULONG 4294967295 Compu_IDENTITY 0 4294967295 PHYS_UNIT "SPN" /end CHARACTERISTIC
/begin CHARACTERISTIC FCspn_INJD3_off_lo "FCtl_SPN(48)" VALUE 0x00161D9C /* @ECU_Address@FCtl_SPN@0x021B60C0@ */ ECIPP_ALIGNMENT_ULONG 4294967295 Compu_IDENTITY 0 4294967295 PHYS_UNIT "SPN" /end CHARACTERISTIC
/begin CHARACTERISTIC FCspn_INJD3_on_hi "FCtl_SPN(58)" VALUE 0x00161DC4 /* @ECU_Address@FCtl_SPN@0x021B60E8@ */ ECIPP_ALIGNMENT_ULONG 4294967295 Compu_IDENTITY 0 4294967295 PHYS_UNIT "SPN" /end CHARACTERISTIC
/begin CHARACTERISTIC FCspn_INJD4_HS_Ihi "FCtl_SPN(565)" VALUE 0x001625B0 /* @ECU_Address@FCtl_SPN@0x021B68D4@ */ ECIPP_ALIGNMENT_ULONG 4294967295 Compu_IDENTITY 0 4294967295 PHYS_UNIT "SPN" /end CHARACTERISTIC
/begin CHARACTERISTIC FCspn_INJD4_LS_Ihi "FCtl_SPN(573)" VALUE 0x001625D0 /* @ECU_Address@FCtl_SPN@0x021B68F4@ */ ECIPP_ALIGNMENT_ULONG 4294967295 Compu_IDENTITY 0 4294967295 PHYS_UNIT "SPN" /end CHARACTERISTIC
/begin CHARACTERISTIC FCspn_INJD4_off_lo "FCtl_SPN(49)" VALUE 0x00161DA0 /* @ECU_Address@FCtl_SPN@0x021B60C4@ */ ECIPP_ALIGNMENT_ULONG 4294967295 Compu_IDENTITY 0 4294967295 PHYS_UNIT "SPN" /end CHARACTERISTIC
/begin CHARACTERISTIC FCspn_INJD4_on_hi "FCtl_SPN(59)" VALUE 0x00161DC8 /* @ECU_Address@FCtl_SPN@0x021B60EC@ */ ECIPP_ALIGNMENT_ULONG 4294967295 Compu_IDENTITY 0 4294967295 PHYS_UNIT "SPN" /end CHARACTERISTIC
/begin CHARACTERISTIC FCspn_INJD5_HS_Ihi "FCtl_SPN(566)" VALUE 0x001625B4 /* @ECU_Address@FCtl_SPN@0x021B68D8@ */ ECIPP_ALIGNMENT_ULONG 4294967295 Compu_IDENTITY 0 4294967295 PHYS_UNIT "SPN" /end CHARACTERISTIC
/begin CHARACTERISTIC FCspn_INJD5_LS_Ihi "FCtl_SPN(574)" VALUE 0x001625D4 /* @ECU_Address@FCtl_SPN@0x021B68F8@ */ ECIPP_ALIGNMENT_ULONG 4294967295 Compu_IDENTITY 0 4294967295 PHYS_UNIT "SPN" /end CHARACTERISTIC
/begin CHARACTERISTIC FCspn_INJD5_off_lo "FCtl_SPN(50)" VALUE 0x00161DA4 /* @ECU_Address@FCtl_SPN@0x021B60C8@ */ ECIPP_ALIGNMENT_ULONG 4294967295 Compu_IDENTITY 0 4294967295 PHYS_UNIT "SPN" /end CHARACTERISTIC
/begin CHARACTERISTIC FCspn_INJD5_on_hi "FCtl_SPN(60)" VALUE 0x00161DCC /* @ECU_Address@FCtl_SPN@0x021B60F0@ */ ECIPP_ALIGNMENT_ULONG 4294967295 Compu_IDENTITY 0 4294967295 PHYS_UNIT "SPN" /end CHARACTERISTIC
/begin CHARACTERISTIC FCspn_INJD6_HS_Ihi "FCtl_SPN(567)" VALUE 0x001625B8 /* @ECU_Address@FCtl_SPN@0x021B68DC@ */ ECIPP_ALIGNMENT_ULONG 4294967295 Compu_IDENTITY 0 4294967295 PHYS_UNIT "SPN" /end CHARACTERISTIC
/begin CHARACTERISTIC FCspn_INJD6_LS_Ihi "FCtl_SPN(575)" VALUE 0x001625D8 /* @ECU_Address@FCtl_SPN@0x021B68FC@ */ ECIPP_ALIGNMENT_ULONG 4294967295 Compu_IDENTITY 0 4294967295 PHYS_UNIT "SPN" /end CHARACTERISTIC
/begin CHARACTERISTIC FCspn_INJD6_off_lo "FCtl_SPN(51)" VALUE 0x00161DA8 /* @ECU_Address@FCtl_SPN@0x021B60CC@ */ ECIPP_ALIGNMENT_ULONG 4294967295 Compu_IDENTITY 0 4294967295 PHYS_UNIT "SPN" /end CHARACTERISTIC
/begin CHARACTERISTIC FCspn_INJD6_on_hi "FCtl_SPN(61)" VALUE 0x00161DD0 /* @ECU_Address@FCtl_SPN@0x021B60F4@ */ ECIPP_ALIGNMENT_ULONG 4294967295 Compu_IDENTITY 0 4294967295 PHYS_UNIT "SPN" /end CHARACTERISTIC
/begin CHARACTERISTIC FCspn_INJD7_HS_Ihi "FCtl_SPN(568)" VALUE 0x001625BC /* @ECU_Address@FCtl_SPN@0x021B68E0@ */ ECIPP_ALIGNMENT_ULONG 4294967295 Compu_IDENTITY 0 4294967295 PHYS_UNIT "SPN" /end CHARACTERISTIC
/begin CHARACTERISTIC FCspn_INJD7_LS_Ihi "FCtl_SPN(576)" VALUE 0x001625DC /* @ECU_Address@FCtl_SPN@0x021B6900@ */ ECIPP_ALIGNMENT_ULONG 4294967295 Compu_IDENTITY 0 4294967295 PHYS_UNIT "SPN" /end CHARACTERISTIC
/begin CHARACTERISTIC FCspn_INJD7_off_lo "FCtl_SPN(52)" VALUE 0x00161DAC /* @ECU_Address@FCtl_SPN@0x021B60D0@ */ ECIPP_ALIGNMENT_ULONG 4294967295 Compu_IDENTITY 0 4294967295 PHYS_UNIT "SPN" /end CHARACTERISTIC
/begin CHARACTERISTIC FCspn_INJD7_on_hi "FCtl_SPN(62)" VALUE 0x00161DD4 /* @ECU_Address@FCtl_SPN@0x021B60F8@ */ ECIPP_ALIGNMENT_ULONG 4294967295 Compu_IDENTITY 0 4294967295 PHYS_UNIT "SPN" /end CHARACTERISTIC
/begin CHARACTERISTIC FCspn_INJD8_HS_Ihi "FCtl_SPN(569)" VALUE 0x001625C0 /* @ECU_Address@FCtl_SPN@0x021B68E4@ */ ECIPP_ALIGNMENT_ULONG 4294967295 Compu_IDENTITY 0 4294967295 PHYS_UNIT "SPN" /end CHARACTERISTIC
/begin CHARACTERISTIC FCspn_INJD8_LS_Ihi "FCtl_SPN(577)" VALUE 0x001625E0 /* @ECU_Address@FCtl_SPN@0x021B6904@ */ ECIPP_ALIGNMENT_ULONG 4294967295 Compu_IDENTITY 0 4294967295 PHYS_UNIT "SPN" /end CHARACTERISTIC
/begin CHARACTERISTIC FCspn_INJD8_off_lo "FCtl_SPN(53)" VALUE 0x00161DB0 /* @ECU_Address@FCtl_SPN@0x021B60D4@ */ ECIPP_ALIGNMENT_ULONG 4294967295 Compu_IDENTITY 0 4294967295 PHYS_UNIT "SPN" /end CHARACTERISTIC
/begin CHARACTERISTIC FCspn_INJD8_on_hi "FCtl_SPN(63)" VALUE 0x00161DD8 /* @ECU_Address@FCtl_SPN@0x021B60FC@ */ ECIPP_ALIGNMENT_ULONG 4294967295 Compu_IDENTITY 0 4294967295 PHYS_UNIT "SPN" /end CHARACTERISTIC
/begin CHARACTERISTIC FCspn_INJD9_off_lo "FCtl_SPN(54)" VALUE 0x00161DB4 /* @ECU_Address@FCtl_SPN@0x021B60D8@ */ ECIPP_ALIGNMENT_ULONG 4294967295 Compu_IDENTITY 0 4294967295 PHYS_UNIT "SPN" /end CHARACTERISTIC
/begin CHARACTERISTIC FCspn_INJD9_on_hi "FCtl_SPN(64)" VALUE 0x00161DDC /* @ECU_Address@FCtl_SPN@0x021B6100@ */ ECIPP_ALIGNMENT_ULONG 4294967295 Compu_IDENTITY 0 4294967295 PHYS_UNIT "SPN" /end CHARACTERISTIC
/begin CHARACTERISTIC FCspn_KNK2_max "FCtl_SPN(185)" VALUE 0x00161FC0 /* @ECU_Address@FCtl_SPN@0x021B62E4@ */ ECIPP_ALIGNMENT_ULONG 4294967295 Compu_IDENTITY 0 4294967295 PHYS_UNIT "SPN" /end CHARACTERISTIC
/begin CHARACTERISTIC FCspn_KNK2_min "FCtl_SPN(184)" VALUE 0x00161FBC /* @ECU_Address@FCtl_SPN@0x021B62E0@ */ ECIPP_ALIGNMENT_ULONG 4294967295 Compu_IDENTITY 0 4294967295 PHYS_UNIT "SPN" /end CHARACTERISTIC
/begin CHARACTERISTIC FCspn_KNK3_max "FCtl_SPN(806)" VALUE 0x00162974 /* @ECU_Address@FCtl_SPN@0x021B6C98@ */ ECIPP_ALIGNMENT_ULONG 4294967295 Compu_IDENTITY 0 4294967295 PHYS_UNIT "SPN" /end CHARACTERISTIC
/begin CHARACTERISTIC FCspn_KNK3_min "FCtl_SPN(805)" VALUE 0x00162970 /* @ECU_Address@FCtl_SPN@0x021B6C94@ */ ECIPP_ALIGNMENT_ULONG 4294967295 Compu_IDENTITY 0 4294967295 PHYS_UNIT "SPN" /end CHARACTERISTIC
/begin CHARACTERISTIC FCspn_SPK10_IGBT_T "FCtl_SPN(518)" VALUE 0x001624F4 /* @ECU_Address@FCtl_SPN@0x021B6818@ */ ECIPP_ALIGNMENT_ULONG 4294967295 Compu_IDENTITY 0 4294967295 PHYS_UNIT "SPN" /end CHARACTERISTIC
/begin CHARACTERISTIC FCspn_SPK2_IGBT_T "FCtl_SPN(510)" VALUE 0x001624D4 /* @ECU_Address@FCtl_SPN@0x021B67F8@ */ ECIPP_ALIGNMENT_ULONG 4294967295 Compu_IDENTITY 0 4294967295 PHYS_UNIT "SPN" /end CHARACTERISTIC
/begin CHARACTERISTIC FCspn_SPK3_IGBT_T "FCtl_SPN(511)" VALUE 0x001624D8 /* @ECU_Address@FCtl_SPN@0x021B67FC@ */ ECIPP_ALIGNMENT_ULONG 4294967295 Compu_IDENTITY 0 4294967295 PHYS_UNIT "SPN" /end CHARACTERISTIC
/begin CHARACTERISTIC FCspn_SPK4_IGBT_T "FCtl_SPN(512)" VALUE 0x001624DC /* @ECU_Address@FCtl_SPN@0x021B6800@ */ ECIPP_ALIGNMENT_ULONG 4294967295 Compu_IDENTITY 0 4294967295 PHYS_UNIT "SPN" /end CHARACTERISTIC
/begin CHARACTERISTIC FCspn_SPK5_IGBT_T "FCtl_SPN(513)" VALUE 0x001624E0 /* @ECU_Address@FCtl_SPN@0x021B6804@ */ ECIPP_ALIGNMENT_ULONG 4294967295 Compu_IDENTITY 0 4294967295 PHYS_UNIT "SPN" /end CHARACTERISTIC
/begin CHARACTERISTIC FCspn_SPK6_IGBT_T "FCtl_SPN(514)" VALUE 0x001624E4 /* @ECU_Address@FCtl_SPN@0x021B6808@ */ ECIPP_ALIGNMENT_ULONG 4294967295 Compu_IDENTITY 0 4294967295 PHYS_UNIT "SPN" /end CHARACTERISTIC
/begin CHARACTERISTIC FCspn_SPK7_IGBT_T "FCtl_SPN(515)" VALUE 0x001624E8 /* @ECU_Address@FCtl_SPN@0x021B680C@ */ ECIPP_ALIGNMENT_ULONG 4294967295 Compu_IDENTITY 0 4294967295 PHYS_UNIT "SPN" /end CHARACTERISTIC
/begin CHARACTERISTIC FCspn_SPK8_IGBT_T "FCtl_SPN(516)" VALUE 0x001624EC /* @ECU_Address@FCtl_SPN@0x021B6810@ */ ECIPP_ALIGNMENT_ULONG 4294967295 Compu_IDENTITY 0 4294967295 PHYS_UNIT "SPN" /end CHARACTERISTIC
/begin CHARACTERISTIC FCspn_SPK9_IGBT_T "FCtl_SPN(517)" VALUE 0x001624F0 /* @ECU_Address@FCtl_SPN@0x021B6814@ */ ECIPP_ALIGNMENT_ULONG 4294967295 Compu_IDENTITY 0 4294967295 PHYS_UNIT "SPN" /end CHARACTERISTIC
/begin CHARACTERISTIC FCspn_SPKD10_coil_fail "FCtl_SPN(313)" VALUE 0x001621C0 /* @ECU_Address@FCtl_SPN@0x021B64E4@ */ ECIPP_ALIGNMENT_ULONG 4294967295 Compu_IDENTITY 0 4294967295 PHYS_UNIT "SPN" /end CHARACTERISTIC
/begin CHARACTERISTIC FCspn_SPKD10_dw_hi "FCtl_SPN(85)" VALUE 0x00161E30 /* @ECU_Address@FCtl_SPN@0x021B6154@ */ ECIPP_ALIGNMENT_ULONG 4294967295 Compu_IDENTITY 0 4294967295 PHYS_UNIT "SPN" /end CHARACTERISTIC
/begin CHARACTERISTIC FCspn_SPKD10_dw_lo "FCtl_SPN(75)" VALUE 0x00161E08 /* @ECU_Address@FCtl_SPN@0x021B612C@ */ ECIPP_ALIGNMENT_ULONG 4294967295 Compu_IDENTITY 0 4294967295 PHYS_UNIT "SPN" /end CHARACTERISTIC
/begin CHARACTERISTIC FCspn_SPKD2_coil_fail "FCtl_SPN(305)" VALUE 0x001621A0 /* @ECU_Address@FCtl_SPN@0x021B64C4@ */ ECIPP_ALIGNMENT_ULONG 4294967295 Compu_IDENTITY 0 4294967295 PHYS_UNIT "SPN" /end CHARACTERISTIC
/begin CHARACTERISTIC FCspn_SPKD2_dw_hi "FCtl_SPN(77)" VALUE 0x00161E10 /* @ECU_Address@FCtl_SPN@0x021B6134@ */ ECIPP_ALIGNMENT_ULONG 4294967295 Compu_IDENTITY 0 4294967295 PHYS_UNIT "SPN" /end CHARACTERISTIC
/begin CHARACTERISTIC FCspn_SPKD2_dw_lo "FCtl_SPN(67)" VALUE 0x00161DE8 /* @ECU_Address@FCtl_SPN@0x021B610C@ */ ECIPP_ALIGNMENT_ULONG 4294967295 Compu_IDENTITY 0 4294967295 PHYS_UNIT "SPN" /end CHARACTERISTIC
/begin CHARACTERISTIC FCspn_SPKD3_coil_fail "FCtl_SPN(306)" VALUE 0x001621A4 /* @ECU_Address@FCtl_SPN@0x021B64C8@ */ ECIPP_ALIGNMENT_ULONG 4294967295 Compu_IDENTITY 0 4294967295 PHYS_UNIT "SPN" /end CHARACTERISTIC
/begin CHARACTERISTIC FCspn_SPKD3_dw_hi "FCtl_SPN(78)" VALUE 0x00161E14 /* @ECU_Address@FCtl_SPN@0x021B6138@ */ ECIPP_ALIGNMENT_ULONG 4294967295 Compu_IDENTITY 0 4294967295 PHYS_UNIT "SPN" /end CHARACTERISTIC
/begin CHARACTERISTIC FCspn_SPKD3_dw_lo "FCtl_SPN(68)" VALUE 0x00161DEC /* @ECU_Address@FCtl_SPN@0x021B6110@ */ ECIPP_ALIGNMENT_ULONG 4294967295 Compu_IDENTITY 0 4294967295 PHYS_UNIT "SPN" /end CHARACTERISTIC
/begin CHARACTERISTIC FCspn_SPKD4_coil_fail "FCtl_SPN(307)" VALUE 0x001621A8 /* @ECU_Address@FCtl_SPN@0x021B64CC@ */ ECIPP_ALIGNMENT_ULONG 4294967295 Compu_IDENTITY 0 4294967295 PHYS_UNIT "SPN" /end CHARACTERISTIC
/begin CHARACTERISTIC FCspn_SPKD4_dw_hi "FCtl_SPN(79)" VALUE 0x00161E18 /* @ECU_Address@FCtl_SPN@0x021B613C@ */ ECIPP_ALIGNMENT_ULONG 4294967295 Compu_IDENTITY 0 4294967295 PHYS_UNIT "SPN" /end CHARACTERISTIC
/begin CHARACTERISTIC FCspn_SPKD4_dw_lo "FCtl_SPN(69)" VALUE 0x00161DF0 /* @ECU_Address@FCtl_SPN@0x021B6114@ */ ECIPP_ALIGNMENT_ULONG 4294967295 Compu_IDENTITY 0 4294967295 PHYS_UNIT "SPN" /end CHARACTERISTIC
/begin CHARACTERISTIC FCspn_SPKD5_coil_fail "FCtl_SPN(308)" VALUE 0x001621AC /* @ECU_Address@FCtl_SPN@0x021B64D0@ */ ECIPP_ALIGNMENT_ULONG 4294967295 Compu_IDENTITY 0 4294967295 PHYS_UNIT "SPN" /end CHARACTERISTIC
/begin CHARACTERISTIC FCspn_SPKD5_dw_hi "FCtl_SPN(80)" VALUE 0x00161E1C /* @ECU_Address@FCtl_SPN@0x021B6140@ */ ECIPP_ALIGNMENT_ULONG 4294967295 Compu_IDENTITY 0 4294967295 PHYS_UNIT "SPN" /end CHARACTERISTIC
/begin CHARACTERISTIC FCspn_SPKD5_dw_lo "FCtl_SPN(70)" VALUE 0x00161DF4 /* @ECU_Address@FCtl_SPN@0x021B6118@ */ ECIPP_ALIGNMENT_ULONG 4294967295 Compu_IDENTITY 0 4294967295 PHYS_UNIT "SPN" /end CHARACTERISTIC
/begin CHARACTERISTIC FCspn_SPKD6_coil_fail "FCtl_SPN(309)" VALUE 0x001621B0 /* @ECU_Address@FCtl_SPN@0x021B64D4@ */ ECIPP_ALIGNMENT_ULONG 4294967295 Compu_IDENTITY 0 4294967295 PHYS_UNIT "SPN" /end CHARACTERISTIC
/begin CHARACTERISTIC FCspn_SPKD6_dw_hi "FCtl_SPN(81)" VALUE 0x00161E20 /* @ECU_Address@FCtl_SPN@0x021B6144@ */ ECIPP_ALIGNMENT_ULONG 4294967295 Compu_IDENTITY 0 4294967295 PHYS_UNIT "SPN" /end CHARACTERISTIC
/begin CHARACTERISTIC FCspn_SPKD6_dw_lo "FCtl_SPN(71)" VALUE 0x00161DF8 /* @ECU_Address@FCtl_SPN@0x021B611C@ */ ECIPP_ALIGNMENT_ULONG 4294967295 Compu_IDENTITY 0 4294967295 PHYS_UNIT "SPN" /end CHARACTERISTIC
/begin CHARACTERISTIC FCspn_SPKD7_coil_fail "FCtl_SPN(310)" VALUE 0x001621B4 /* @ECU_Address@FCtl_SPN@0x021B64D8@ */ ECIPP_ALIGNMENT_ULONG 4294967295 Compu_IDENTITY 0 4294967295 PHYS_UNIT "SPN" /end CHARACTERISTIC
/begin CHARACTERISTIC FCspn_SPKD7_dw_hi "FCtl_SPN(82)" VALUE 0x00161E24 /* @ECU_Address@FCtl_SPN@0x021B6148@ */ ECIPP_ALIGNMENT_ULONG 4294967295 Compu_IDENTITY 0 4294967295 PHYS_UNIT "SPN" /end CHARACTERISTIC
/begin CHARACTERISTIC FCspn_SPKD7_dw_lo "FCtl_SPN(72)" VALUE 0x00161DFC /* @ECU_Address@FCtl_SPN@0x021B6120@ */ ECIPP_ALIGNMENT_ULONG 4294967295 Compu_IDENTITY 0 4294967295 PHYS_UNIT "SPN" /end CHARACTERISTIC
/begin CHARACTERISTIC FCspn_SPKD8_coil_fail "FCtl_SPN(311)" VALUE 0x001621B8 /* @ECU_Address@FCtl_SPN@0x021B64DC@ */ ECIPP_ALIGNMENT_ULONG 4294967295 Compu_IDENTITY 0 4294967295 PHYS_UNIT "SPN" /end CHARACTERISTIC
/begin CHARACTERISTIC FCspn_SPKD8_dw_hi "FCtl_SPN(83)" VALUE 0x00161E28 /* @ECU_Address@FCtl_SPN@0x021B614C@ */ ECIPP_ALIGNMENT_ULONG 4294967295 Compu_IDENTITY 0 4294967295 PHYS_UNIT "SPN" /end CHARACTERISTIC
/begin CHARACTERISTIC FCspn_SPKD8_dw_lo "FCtl_SPN(73)" VALUE 0x00161E00 /* @ECU_Address@FCtl_SPN@0x021B6124@ */ ECIPP_ALIGNMENT_ULONG 4294967295 Compu_IDENTITY 0 4294967295 PHYS_UNIT "SPN" /end CHARACTERISTIC
/begin CHARACTERISTIC FCspn_SPKD9_coil_fail "FCtl_SPN(312)" VALUE 0x001621BC /* @ECU_Address@FCtl_SPN@0x021B64E0@ */ ECIPP_ALIGNMENT_ULONG 4294967295 Compu_IDENTITY 0 4294967295 PHYS_UNIT "SPN" /end CHARACTERISTIC
/begin CHARACTERISTIC FCspn_SPKD9_dw_hi "FCtl_SPN(84)" VALUE 0x00161E2C /* @ECU_Address@FCtl_SPN@0x021B6150@ */ ECIPP_ALIGNMENT_ULONG 4294967295 Compu_IDENTITY 0 4294967295 PHYS_UNIT "SPN" /end CHARACTERISTIC
/begin CHARACTERISTIC FCspn_SPKD9_dw_lo "FCtl_SPN(74)" VALUE 0x00161E04 /* @ECU_Address@FCtl_SPN@0x021B6128@ */ ECIPP_ALIGNMENT_ULONG 4294967295 Compu_IDENTITY 0 4294967295 PHYS_UNIT "SPN" /end CHARACTERISTIC
/begin CHARACTERISTIC FCspn_UGF_Hv_lo "FCtl_SPN(243)" VALUE 0x001620A8 /* @ECU_Address@FCtl_SPN@0x021B63CC@ */ ECIPP_ALIGNMENT_ULONG 4294967295 Compu_IDENTITY 0 4294967295 PHYS_UNIT "SPN" /end CHARACTERISTIC
/begin CHARACTERISTIC FCspn_UGF1_PR_hi "FCtl_SPN(257)" VALUE 0x001620E0 /* @ECU_Address@FCtl_SPN@0x021B6404@ */ ECIPP_ALIGNMENT_ULONG 4294967295 Compu_IDENTITY 0 4294967295 PHYS_UNIT "SPN" /end CHARACTERISTIC
/begin CHARACTERISTIC FCspn_UGF1_PR_lo "FCtl_SPN(258)" VALUE 0x001620E4 /* @ECU_Address@FCtl_SPN@0x021B6408@ */ ECIPP_ALIGNMENT_ULONG 4294967295 Compu_IDENTITY 0 4294967295 PHYS_UNIT "SPN" /end CHARACTERISTIC
/begin CHARACTERISTIC FCspn_UGF1_PR_slow "FCtl_SPN(255)" VALUE 0x001620D8 /* @ECU_Address@FCtl_SPN@0x021B63FC@ */ ECIPP_ALIGNMENT_ULONG 4294967295 Compu_IDENTITY 0 4294967295 PHYS_UNIT "SPN" /end CHARACTERISTIC
/begin CHARACTERISTIC FCspn_UGF1_Pv_hi "FCtl_SPN(252)" VALUE 0x001620CC /* @ECU_Address@FCtl_SPN@0x021B63F0@ */ ECIPP_ALIGNMENT_ULONG 4294967295 Compu_IDENTITY 0 4294967295 PHYS_UNIT "SPN" /end CHARACTERISTIC
/begin CHARACTERISTIC FCspn_UGF1_Pv_lo "FCtl_SPN(253)" VALUE 0x001620D0 /* @ECU_Address@FCtl_SPN@0x021B63F4@ */ ECIPP_ALIGNMENT_ULONG 4294967295 Compu_IDENTITY 0 4294967295 PHYS_UNIT "SPN" /end CHARACTERISTIC
/begin CHARACTERISTIC FCspn_UGF1_PvFB_hi "FCtl_SPN(248)" VALUE 0x001620BC /* @ECU_Address@FCtl_SPN@0x021B63E0@ */ ECIPP_ALIGNMENT_ULONG 4294967295 Compu_IDENTITY 0 4294967295 PHYS_UNIT "SPN" /end CHARACTERISTIC
/begin CHARACTERISTIC FCspn_UGF1_PvFB_lo "FCtl_SPN(249)" VALUE 0x001620C0 /* @ECU_Address@FCtl_SPN@0x021B63E4@ */ ECIPP_ALIGNMENT_ULONG 4294967295 Compu_IDENTITY 0 4294967295 PHYS_UNIT "SPN" /end CHARACTERISTIC
/begin CHARACTERISTIC FCspn_UGF1_R_lo "FCtl_SPN(245)" VALUE 0x001620B0 /* @ECU_Address@FCtl_SPN@0x021B63D4@ */ ECIPP_ALIGNMENT_ULONG 4294967295 Compu_IDENTITY 0 4294967295 PHYS_UNIT "SPN" /end CHARACTERISTIC
/begin CHARACTERISTIC FCspn_UGF1_rtn_hi "FCtl_SPN(246)" VALUE 0x001620B4 /* @ECU_Address@FCtl_SPN@0x021B63D8@ */ ECIPP_ALIGNMENT_ULONG 4294967295 Compu_IDENTITY 0 4294967295 PHYS_UNIT "SPN" /end CHARACTERISTIC
/begin CHARACTERISTIC FCspn_UGF1_rtn_lo "FCtl_SPN(247)" VALUE 0x001620B8 /* @ECU_Address@FCtl_SPN@0x021B63DC@ */ ECIPP_ALIGNMENT_ULONG 4294967295 Compu_IDENTITY 0 4294967295 PHYS_UNIT "SPN" /end CHARACTERISTIC
/begin CHARACTERISTIC FCspn_UGF1_Sv_lo "FCtl_SPN(251)" VALUE 0x001620C8 /* @ECU_Address@FCtl_SPN@0x021B63EC@ */ ECIPP_ALIGNMENT_ULONG 4294967295 Compu_IDENTITY 0 4294967295 PHYS_UNIT "SPN" /end CHARACTERISTIC
/begin CHARACTERISTIC FCspn_UGF2_Hv_lo "FCtl_SPN(410)" VALUE 0x00162344 /* @ECU_Address@FCtl_SPN@0x021B6668@ */ ECIPP_ALIGNMENT_ULONG 4294967295 Compu_IDENTITY 0 4294967295 PHYS_UNIT "SPN" /end CHARACTERISTIC
/begin CHARACTERISTIC FCspn_UGF2_PR_hi "FCtl_SPN(424)" VALUE 0x0016237C /* @ECU_Address@FCtl_SPN@0x021B66A0@ */ ECIPP_ALIGNMENT_ULONG 4294967295 Compu_IDENTITY 0 4294967295 PHYS_UNIT "SPN" /end CHARACTERISTIC
/begin CHARACTERISTIC FCspn_UGF2_PR_lo "FCtl_SPN(425)" VALUE 0x00162380 /* @ECU_Address@FCtl_SPN@0x021B66A4@ */ ECIPP_ALIGNMENT_ULONG 4294967295 Compu_IDENTITY 0 4294967295 PHYS_UNIT "SPN" /end CHARACTERISTIC
/begin CHARACTERISTIC FCspn_UGF2_PR_slow "FCtl_SPN(422)" VALUE 0x00162374 /* @ECU_Address@FCtl_SPN@0x021B6698@ */ ECIPP_ALIGNMENT_ULONG 4294967295 Compu_IDENTITY 0 4294967295 PHYS_UNIT "SPN" /end CHARACTERISTIC
/begin CHARACTERISTIC FCspn_UGF2_Pv_hi "FCtl_SPN(419)" VALUE 0x00162368 /* @ECU_Address@FCtl_SPN@0x021B668C@ */ ECIPP_ALIGNMENT_ULONG 4294967295 Compu_IDENTITY 0 4294967295 PHYS_UNIT "SPN" /end CHARACTERISTIC
/begin CHARACTERISTIC FCspn_UGF2_Pv_lo "FCtl_SPN(420)" VALUE 0x0016236C /* @ECU_Address@FCtl_SPN@0x021B6690@ */ ECIPP_ALIGNMENT_ULONG 4294967295 Compu_IDENTITY 0 4294967295 PHYS_UNIT "SPN" /end CHARACTERISTIC
/begin CHARACTERISTIC FCspn_UGF2_PvFB_hi "FCtl_SPN(415)" VALUE 0x00162358 /* @ECU_Address@FCtl_SPN@0x021B667C@ */ ECIPP_ALIGNMENT_ULONG 4294967295 Compu_IDENTITY 0 4294967295 PHYS_UNIT "SPN" /end CHARACTERISTIC
/begin CHARACTERISTIC FCspn_UGF2_PvFB_lo "FCtl_SPN(416)" VALUE 0x0016235C /* @ECU_Address@FCtl_SPN@0x021B6680@ */ ECIPP_ALIGNMENT_ULONG 4294967295 Compu_IDENTITY 0 4294967295 PHYS_UNIT "SPN" /end CHARACTERISTIC
/begin CHARACTERISTIC FCspn_UGF2_R_lo "FCtl_SPN(412)" VALUE 0x0016234C /* @ECU_Address@FCtl_SPN@0x021B6670@ */ ECIPP_ALIGNMENT_ULONG 4294967295 Compu_IDENTITY 0 4294967295 PHYS_UNIT "SPN" /end CHARACTERISTIC
/begin CHARACTERISTIC FCspn_UGF2_rtn_hi "FCtl_SPN(413)" VALUE 0x00162350 /* @ECU_Address@FCtl_SPN@0x021B6674@ */ ECIPP_ALIGNMENT_ULONG 4294967295 Compu_IDENTITY 0 4294967295 PHYS_UNIT "SPN" /end CHARACTERISTIC
/begin CHARACTERISTIC FCspn_UGF2_rtn_lo "FCtl_SPN(414)" VALUE 0x00162354 /* @ECU_Address@FCtl_SPN@0x021B6678@ */ ECIPP_ALIGNMENT_ULONG 4294967295 Compu_IDENTITY 0 4294967295 PHYS_UNIT "SPN" /end CHARACTERISTIC
/begin CHARACTERISTIC FCspn_UGF2_Sv_lo "FCtl_SPN(418)" VALUE 0x00162364 /* @ECU_Address@FCtl_SPN@0x021B6688@ */ ECIPP_ALIGNMENT_ULONG 4294967295 Compu_IDENTITY 0 4294967295 PHYS_UNIT "SPN" /end CHARACTERISTIC
/begin CHARACTERISTIC FCspn_UGF3_Hv_lo "FCtl_SPN(606)" VALUE 0x00162654 /* @ECU_Address@FCtl_SPN@0x021B6978@ */ ECIPP_ALIGNMENT_ULONG 4294967295 Compu_IDENTITY 0 4294967295 PHYS_UNIT "SPN" /end CHARACTERISTIC
/begin CHARACTERISTIC FCspn_UGF3_PR_hi "FCtl_SPN(620)" VALUE 0x0016268C /* @ECU_Address@FCtl_SPN@0x021B69B0@ */ ECIPP_ALIGNMENT_ULONG 4294967295 Compu_IDENTITY 0 4294967295 PHYS_UNIT "SPN" /end CHARACTERISTIC
/begin CHARACTERISTIC FCspn_UGF3_PR_lo "FCtl_SPN(621)" VALUE 0x00162690 /* @ECU_Address@FCtl_SPN@0x021B69B4@ */ ECIPP_ALIGNMENT_ULONG 4294967295 Compu_IDENTITY 0 4294967295 PHYS_UNIT "SPN" /end CHARACTERISTIC
/begin CHARACTERISTIC FCspn_UGF3_PR_slow "FCtl_SPN(618)" VALUE 0x00162684 /* @ECU_Address@FCtl_SPN@0x021B69A8@ */ ECIPP_ALIGNMENT_ULONG 4294967295 Compu_IDENTITY 0 4294967295 PHYS_UNIT "SPN" /end CHARACTERISTIC
/begin CHARACTERISTIC FCspn_UGF3_Pv_hi "FCtl_SPN(615)" VALUE 0x00162678 /* @ECU_Address@FCtl_SPN@0x021B699C@ */ ECIPP_ALIGNMENT_ULONG 4294967295 Compu_IDENTITY 0 4294967295 PHYS_UNIT "SPN" /end CHARACTERISTIC
/begin CHARACTERISTIC FCspn_UGF3_Pv_lo "FCtl_SPN(616)" VALUE 0x0016267C /* @ECU_Address@FCtl_SPN@0x021B69A0@ */ ECIPP_ALIGNMENT_ULONG 4294967295 Compu_IDENTITY 0 4294967295 PHYS_UNIT "SPN" /end CHARACTERISTIC
/begin CHARACTERISTIC FCspn_UGF3_PvFB_hi "FCtl_SPN(611)" VALUE 0x00162668 /* @ECU_Address@FCtl_SPN@0x021B698C@ */ ECIPP_ALIGNMENT_ULONG 4294967295 Compu_IDENTITY 0 4294967295 PHYS_UNIT "SPN" /end CHARACTERISTIC
/begin CHARACTERISTIC FCspn_UGF3_PvFB_lo "FCtl_SPN(612)" VALUE 0x0016266C /* @ECU_Address@FCtl_SPN@0x021B6990@ */ ECIPP_ALIGNMENT_ULONG 4294967295 Compu_IDENTITY 0 4294967295 PHYS_UNIT "SPN" /end CHARACTERISTIC
/begin CHARACTERISTIC FCspn_UGF3_R_lo "FCtl_SPN(608)" VALUE 0x0016265C /* @ECU_Address@FCtl_SPN@0x021B6980@ */ ECIPP_ALIGNMENT_ULONG 4294967295 Compu_IDENTITY 0 4294967295 PHYS_UNIT "SPN" /end CHARACTERISTIC
/begin CHARACTERISTIC FCspn_UGF3_rtn_hi "FCtl_SPN(609)" VALUE 0x00162660 /* @ECU_Address@FCtl_SPN@0x021B6984@ */ ECIPP_ALIGNMENT_ULONG 4294967295 Compu_IDENTITY 0 4294967295 PHYS_UNIT "SPN" /end CHARACTERISTIC
/begin CHARACTERISTIC FCspn_UGF3_rtn_lo "FCtl_SPN(610)" VALUE 0x00162664 /* @ECU_Address@FCtl_SPN@0x021B6988@ */ ECIPP_ALIGNMENT_ULONG 4294967295 Compu_IDENTITY 0 4294967295 PHYS_UNIT "SPN" /end CHARACTERISTIC
/begin CHARACTERISTIC FCspn_UGF3_Sv_lo "FCtl_SPN(614)" VALUE 0x00162674 /* @ECU_Address@FCtl_SPN@0x021B6998@ */ ECIPP_ALIGNMENT_ULONG 4294967295 Compu_IDENTITY 0 4294967295 PHYS_UNIT "SPN" /end CHARACTERISTIC
/begin CHARACTERISTIC FCspn_UGF4_Hv_lo "FCtl_SPN(629)" VALUE 0x001626B0 /* @ECU_Address@FCtl_SPN@0x021B69D4@ */ ECIPP_ALIGNMENT_ULONG 4294967295 Compu_IDENTITY 0 4294967295 PHYS_UNIT "SPN" /end CHARACTERISTIC
/begin CHARACTERISTIC FCspn_UGF4_PR_hi "FCtl_SPN(643)" VALUE 0x001626E8 /* @ECU_Address@FCtl_SPN@0x021B6A0C@ */ ECIPP_ALIGNMENT_ULONG 4294967295 Compu_IDENTITY 0 4294967295 PHYS_UNIT "SPN" /end CHARACTERISTIC
/begin CHARACTERISTIC FCspn_UGF4_PR_lo "FCtl_SPN(644)" VALUE 0x001626EC /* @ECU_Address@FCtl_SPN@0x021B6A10@ */ ECIPP_ALIGNMENT_ULONG 4294967295 Compu_IDENTITY 0 4294967295 PHYS_UNIT "SPN" /end CHARACTERISTIC
/begin CHARACTERISTIC FCspn_UGF4_PR_slow "FCtl_SPN(641)" VALUE 0x001626E0 /* @ECU_Address@FCtl_SPN@0x021B6A04@ */ ECIPP_ALIGNMENT_ULONG 4294967295 Compu_IDENTITY 0 4294967295 PHYS_UNIT "SPN" /end CHARACTERISTIC
/begin CHARACTERISTIC FCspn_UGF4_Pv_hi "FCtl_SPN(638)" VALUE 0x001626D4 /* @ECU_Address@FCtl_SPN@0x021B69F8@ */ ECIPP_ALIGNMENT_ULONG 4294967295 Compu_IDENTITY 0 4294967295 PHYS_UNIT "SPN" /end CHARACTERISTIC
/begin CHARACTERISTIC FCspn_UGF4_Pv_lo "FCtl_SPN(639)" VALUE 0x001626D8 /* @ECU_Address@FCtl_SPN@0x021B69FC@ */ ECIPP_ALIGNMENT_ULONG 4294967295 Compu_IDENTITY 0 4294967295 PHYS_UNIT "SPN" /end CHARACTERISTIC
/begin CHARACTERISTIC FCspn_UGF4_PvFB_hi "FCtl_SPN(634)" VALUE 0x001626C4 /* @ECU_Address@FCtl_SPN@0x021B69E8@ */ ECIPP_ALIGNMENT_ULONG 4294967295 Compu_IDENTITY 0 4294967295 PHYS_UNIT "SPN" /end CHARACTERISTIC
/begin CHARACTERISTIC FCspn_UGF4_PvFB_lo "FCtl_SPN(635)" VALUE 0x001626C8 /* @ECU_Address@FCtl_SPN@0x021B69EC@ */ ECIPP_ALIGNMENT_ULONG 4294967295 Compu_IDENTITY 0 4294967295 PHYS_UNIT "SPN" /end CHARACTERISTIC
/begin CHARACTERISTIC FCspn_UGF4_R_lo "FCtl_SPN(631)" VALUE 0x001626B8 /* @ECU_Address@FCtl_SPN@0x021B69DC@ */ ECIPP_ALIGNMENT_ULONG 4294967295 Compu_IDENTITY 0 4294967295 PHYS_UNIT "SPN" /end CHARACTERISTIC
/begin CHARACTERISTIC FCspn_UGF4_rtn_hi "FCtl_SPN(632)" VALUE 0x001626BC /* @ECU_Address@FCtl_SPN@0x021B69E0@ */ ECIPP_ALIGNMENT_ULONG 4294967295 Compu_IDENTITY 0 4294967295 PHYS_UNIT "SPN" /end CHARACTERISTIC
/begin CHARACTERISTIC FCspn_UGF4_rtn_lo "FCtl_SPN(633)" VALUE 0x001626C0 /* @ECU_Address@FCtl_SPN@0x021B69E4@ */ ECIPP_ALIGNMENT_ULONG 4294967295 Compu_IDENTITY 0 4294967295 PHYS_UNIT "SPN" /end CHARACTERISTIC
/begin CHARACTERISTIC FCspn_UGF4_Sv_lo "FCtl_SPN(637)" VALUE 0x001626D0 /* @ECU_Address@FCtl_SPN@0x021B69F4@ */ ECIPP_ALIGNMENT_ULONG 4294967295 Compu_IDENTITY 0 4294967295 PHYS_UNIT "SPN" /end CHARACTERISTIC
/end MODULE
/end PROJECT
