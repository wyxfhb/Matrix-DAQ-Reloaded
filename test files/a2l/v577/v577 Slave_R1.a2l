/*
Copyright (c) 2000-2022.
All rights reserved.  This is an unpublished work.
*/
ASAP2_VERSION 1 61
/begin PROJECT Econtrols_4G "4G Test"
/begin HEADER "4G A2L Configuration" PROJECT_NO EControls4G /* config for version control */ VERSION "$Revision: 82130 $:" /* config for version control */ /end HEADER
/begin MODULE EControls_4G_SH2A "EControls 4G"
/begin MOD_COMMON "" DEPOSIT ABSOLUTE BYTE_ORDER MSB_FIRST /end MOD_COMMON
/* Define the Record Layouts */
/begin RECORD_LAYOUT ECIPP_ALIGNMENT_UBYTE FNC_VALUES 1 UBYTE COLUMN_DIR DIRECT /end RECORD_LAYOUT
/begin RECORD_LAYOUT ECIPP_ALIGNMENT_UWORD FNC_VALUES 1 UWORD COLUMN_DIR DIRECT /end RECORD_LAYOUT
/begin RECORD_LAYOUT ECIPP_ALIGNMENT_SWORD FNC_VALUES 1 SWORD COLUMN_DIR DIRECT /end RECORD_LAYOUT
/begin RECORD_LAYOUT ECIPP_Lookup_SWORD AXIS_PTS_X 1 SWORD INDEX_INCR DIRECT /end RECORD_LAYOUT
/begin RECORD_LAYOUT ECIPP_ALIGNMENT_ULONG FNC_VALUES 1 ULONG COLUMN_DIR DIRECT /end RECORD_LAYOUT
/begin RECORD_LAYOUT ECIPP_ALIGNMENT_FLOAT32_IEEE FNC_VALUES 1 FLOAT32_IEEE COLUMN_DIR DIRECT /end RECORD_LAYOUT
/begin CHARACTERISTIC derate1 "Engine derate-1 TPS limit" VALUE 0x00147ac2 /* @ECU_Address@derate1@0x01001290@ */ ECIPP_ALIGNMENT_UWORD 100 Compu_derate1 0 99.9984741210938 /end CHARACTERISTIC
/begin COMPU_METHOD Compu_derate1 " " RAT_FUNC "%.1" "%" COEFFS 0 655.36 0 0 0 1 /end COMPU_METHOD
/begin CHARACTERISTIC derate2 "Engine derate-2 TPS limit" VALUE 0x00147ac6 /* @ECU_Address@derate2@0x01001648@ */ ECIPP_ALIGNMENT_UWORD 100 Compu_derate2 0 99.9984741210938 /end CHARACTERISTIC
/begin COMPU_METHOD Compu_derate2 " " RAT_FUNC "%.1" "%" COEFFS 0 655.36 0 0 0 1 /end COMPU_METHOD
/begin CHARACTERISTIC fault_rev_lim "Fault low rev limit governor" VALUE 0x00147af8 /* @ECU_Address@fault_rev_lim@0x01001650@ */ ECIPP_ALIGNMENT_UWORD 65535 Compu_fault_rev_lim 0 65535 /end CHARACTERISTIC
/begin COMPU_METHOD Compu_fault_rev_lim " " RAT_FUNC "%.0" "rpm" COEFFS 0 1 0 0 0 1 /end COMPU_METHOD
/begin CHARACTERISTIC fault_rev_limd "Fault low rev limit fuel delta" VALUE 0x00147afa /* @ECU_Address@fault_rev_limd@0x01001738@ */ ECIPP_ALIGNMENT_UWORD 65535 Compu_fault_rev_limd 0 65535 /end CHARACTERISTIC
/begin COMPU_METHOD Compu_fault_rev_limd " " RAT_FUNC "%.0" "rpm delta" COEFFS 0 1 0 0 0 1 /end COMPU_METHOD
/begin CHARACTERISTIC LoadLim_ena "Load-limiting system{LoadLim_ena&0xff=0:Disabled}{LoadLim_ena&0xff=1:Enabled - standard}{LoadLim_ena&0xff=2:Enabled - expanded}" VALUE 0x00147e3b /* @ECU_Address@LoadLim_ena@0x01001960@ */ ECIPP_ALIGNMENT_UBYTE 255 LoadLim_ena_COMPU_VTAB 0 255 BIT_MASK 0xff /end CHARACTERISTIC
/begin COMPU_METHOD LoadLim_ena_COMPU_VTAB "Verbal Table" TAB_VERB "%.0" "list" COMPU_TAB_REF LoadLim_ena_COMPU_VTAB_REF /end COMPU_METHOD
/begin COMPU_VTAB LoadLim_ena_COMPU_VTAB_REF "Verbal Table" TAB_VERB 3 0 "Disabled" 1 "Enabled - standard" 2 "Enabled - expanded" DEFAULT_VALUE "UNKNOWN" /end COMPU_VTAB
/begin MEASUREMENT LoadLim_max_pct "Load-limiting max load" UWORD Compu_LoadLim_max_pct 0 0 0 99.9984741210938 ECU_ADDRESS 0x01001968 /end MEASUREMENT
/begin COMPU_METHOD Compu_LoadLim_max_pct " " RAT_FUNC "%.1" "%" COEFFS 0 655.36 0 0 0 1 /end COMPU_METHOD
/begin MEASUREMENT LoadLim_max_TPS "Load-limiting max TPS" UWORD Compu_LoadLim_max_TPS 0 0 0 99.9984741210938 ECU_ADDRESS 0x01001970 /end MEASUREMENT
/begin COMPU_METHOD Compu_LoadLim_max_TPS " " RAT_FUNC "%.1" "%" COEFFS 0 655.36 0 0 0 1 /end COMPU_METHOD
/begin CHARACTERISTIC forced_idle_rpm "Force idle min-governor speed" VALUE 0x00147b00 /* @ECU_Address@forced_idle_rpm@0x010021D0@ */ ECIPP_ALIGNMENT_UWORD 65535 Compu_forced_idle_rpm 0 65535 /end CHARACTERISTIC
/begin COMPU_METHOD Compu_forced_idle_rpm " " RAT_FUNC "%.0" "rpm" COEFFS 0 1 0 0 0 1 /end COMPU_METHOD
/begin MEASUREMENT LOWREVLIM_fuel_rpm "Low rev limit - fuel" UWORD Compu_LOWREVLIM_fuel_rpm 0 0 0 65535 ECU_ADDRESS 0x01003258 /end MEASUREMENT
/begin COMPU_METHOD Compu_LOWREVLIM_fuel_rpm " " RAT_FUNC "%.0" "rpm" COEFFS 0 1 0 0 0 1 /end COMPU_METHOD
/begin MEASUREMENT LOWREVLIM_gov_rpm "Low rev limit - governor" UWORD Compu_LOWREVLIM_gov_rpm 0 0 0 65535 ECU_ADDRESS 0x01003260 /end MEASUREMENT
/begin COMPU_METHOD Compu_LOWREVLIM_gov_rpm " " RAT_FUNC "%.0" "rpm" COEFFS 0 1 0 0 0 1 /end COMPU_METHOD
/begin MEASUREMENT LOWREVLIM_active "Low Rev-Lim{LOWREVLIM_active&0x01=0x00:Inactive}{LOWREVLIM_active&0x01=0x01:Active}" UBYTE LOWREVLIM_active_COMPU_VTAB 0 0 0 255 ECU_ADDRESS 0x01003268 BIT_MASK 0x01 /end MEASUREMENT
/begin COMPU_METHOD LOWREVLIM_active_COMPU_VTAB "Verbal Table" TAB_VERB "%.0" "list" COMPU_TAB_REF LOWREVLIM_active_COMPU_VTAB_REF /end COMPU_METHOD
/begin COMPU_VTAB LOWREVLIM_active_COMPU_VTAB_REF "Verbal Table" TAB_VERB 2 0x00 "Inactive" 0x01 "Active" DEFAULT_VALUE "UNKNOWN" /end COMPU_VTAB
/begin CHARACTERISTIC fault_rev_lim_latch "Fault low rev limit activity duration{fault_rev_lim_latch&0xff=0:Active Fault and Engine Condition}{fault_rev_lim_latch&0xff=1:Latched for Key-Cycle}" VALUE 0x00148163 /* @ECU_Address@fault_rev_lim_latch@0x01003278@ */ ECIPP_ALIGNMENT_UBYTE 255 fault_rev_lim_latch_COMPU_VTAB 0 255 BIT_MASK 0xff /end CHARACTERISTIC
/begin COMPU_METHOD fault_rev_lim_latch_COMPU_VTAB "Verbal Table" TAB_VERB "%.0" "list" COMPU_TAB_REF fault_rev_lim_latch_COMPU_VTAB_REF /end COMPU_METHOD
/begin COMPU_VTAB fault_rev_lim_latch_COMPU_VTAB_REF "Verbal Table" TAB_VERB 2 0 "Active Fault and Engine Condition" 1 "Latched for Key-Cycle" DEFAULT_VALUE "UNKNOWN" /end COMPU_VTAB
/begin CHARACTERISTIC LOWREVLIM_slew_down "Fault low rev limit slew down" VALUE 0x0014433e /* @ECU_Address@LOWREVLIM_slew_down@0x01003280@ */ ECIPP_ALIGNMENT_SWORD 63998 Compu_LOWREVLIM_slew_down -64000 63998.046875 /end CHARACTERISTIC
/begin COMPU_METHOD Compu_LOWREVLIM_slew_down " " RAT_FUNC "%.0" "rpm/sec" COEFFS 0 0.512 0 0 0 1 /end COMPU_METHOD
/begin CHARACTERISTIC LOWREVLIM_slew_up "Fault low rev limit slew up" VALUE 0x00144340 /* @ECU_Address@LOWREVLIM_slew_up@0x01003288@ */ ECIPP_ALIGNMENT_SWORD 63998 Compu_LOWREVLIM_slew_up -64000 63998.046875 /end CHARACTERISTIC
/begin COMPU_METHOD Compu_LOWREVLIM_slew_up " " RAT_FUNC "%.0" "rpm/sec" COEFFS 0 0.512 0 0 0 1 /end COMPU_METHOD
/begin CHARACTERISTIC derate1_rev_lim "Power derate 1 max RPM (IAC mode)" VALUE 0x00147ac4 /* @ECU_Address@derate1_rev_lim@0x01003478@ */ ECIPP_ALIGNMENT_UWORD 65535 Compu_derate1_rev_lim 0 65535 /end CHARACTERISTIC
/begin COMPU_METHOD Compu_derate1_rev_lim " " RAT_FUNC "%.0" "rpm" COEFFS 0 1 0 0 0 1 /end COMPU_METHOD
/begin CHARACTERISTIC derate2_rev_lim "Power derate 2 max RPM (IAC mode)" VALUE 0x00147ac8 /* @ECU_Address@derate2_rev_lim@0x01003480@ */ ECIPP_ALIGNMENT_UWORD 65535 Compu_derate2_rev_lim 0 65535 /end CHARACTERISTIC
/begin COMPU_METHOD Compu_derate2_rev_lim " " RAT_FUNC "%.0" "rpm" COEFFS 0 1 0 0 0 1 /end COMPU_METHOD
/begin CHARACTERISTIC derate2_latch "Power derate 2 activity duration{derate2_latch&0xff=0:Active Fault and Engine Condition}{derate2_latch&0xff=1:Latched for Key-Cycle}" VALUE 0x0014813f /* @ECU_Address@derate2_latch@0x01003488@ */ ECIPP_ALIGNMENT_UBYTE 255 derate2_latch_COMPU_VTAB 0 255 BIT_MASK 0xff /end CHARACTERISTIC
/begin COMPU_METHOD derate2_latch_COMPU_VTAB "Verbal Table" TAB_VERB "%.0" "list" COMPU_TAB_REF derate2_latch_COMPU_VTAB_REF /end COMPU_METHOD
/begin COMPU_VTAB derate2_latch_COMPU_VTAB_REF "Verbal Table" TAB_VERB 2 0 "Active Fault and Engine Condition" 1 "Latched for Key-Cycle" DEFAULT_VALUE "UNKNOWN" /end COMPU_VTAB
/begin MEASUREMENT DERATE1_active "Derate1{DERATE1_active&0x01=0x00:Inactive}{DERATE1_active&0x01=0x01:Active}" UBYTE DERATE1_active_COMPU_VTAB 0 0 0 255 ECU_ADDRESS 0x01003490 BIT_MASK 0x01 /end MEASUREMENT
/begin COMPU_METHOD DERATE1_active_COMPU_VTAB "Verbal Table" TAB_VERB "%.0" "list" COMPU_TAB_REF DERATE1_active_COMPU_VTAB_REF /end COMPU_METHOD
/begin COMPU_VTAB DERATE1_active_COMPU_VTAB_REF "Verbal Table" TAB_VERB 2 0x00 "Inactive" 0x01 "Active" DEFAULT_VALUE "UNKNOWN" /end COMPU_VTAB
/begin MEASUREMENT DERATE2_active "Derate2{DERATE2_active&0x01=0x00:Inactive}{DERATE2_active&0x01=0x01:Active}" UBYTE DERATE2_active_COMPU_VTAB 0 0 0 255 ECU_ADDRESS 0x01003498 BIT_MASK 0x01 /end MEASUREMENT
/begin COMPU_METHOD DERATE2_active_COMPU_VTAB "Verbal Table" TAB_VERB "%.0" "list" COMPU_TAB_REF DERATE2_active_COMPU_VTAB_REF /end COMPU_METHOD
/begin COMPU_VTAB DERATE2_active_COMPU_VTAB_REF "Verbal Table" TAB_VERB 2 0x00 "Inactive" 0x01 "Active" DEFAULT_VALUE "UNKNOWN" /end COMPU_VTAB
/begin CHARACTERISTIC derate_unlatch_RPM "Derate release max speed" VALUE 0x00147acc /* @ECU_Address@derate_unlatch_RPM@0x010034A0@ */ ECIPP_ALIGNMENT_UWORD 65535 Compu_derate_unlatch_RPM 0 65535 /end CHARACTERISTIC
/begin COMPU_METHOD Compu_derate_unlatch_RPM " " RAT_FUNC "%.0" "rpm" COEFFS 0 1 0 0 0 1 /end COMPU_METHOD
/begin CHARACTERISTIC derate_unlatch_FPP "Derate release max FPP" VALUE 0x00147aca /* @ECU_Address@derate_unlatch_FPP@0x010034A8@ */ ECIPP_ALIGNMENT_UWORD 100 Compu_derate_unlatch_FPP 0 99.9984741210938 /end CHARACTERISTIC
/begin COMPU_METHOD Compu_derate_unlatch_FPP " " RAT_FUNC "%.1" "%" COEFFS 0 655.36 0 0 0 1 /end COMPU_METHOD
/begin CHARACTERISTIC LoadLim_Taux_src "Aux-Temperature source{LoadLim_Taux_src&0xff=0:Not Used}{LoadLim_Taux_src&0xff=1:FST}{LoadLim_Taux_src&0xff=2:FRT}{LoadLim_Taux_src&0xff=3:FT}{LoadLim_Taux_src&0xff=4:IAT}{LoadLim_Taux_src&0xff=5:MAT}" VALUE 0x00147e29 /* @ECU_Address@LoadLim_Taux_src@0x01003F50@ */ ECIPP_ALIGNMENT_UBYTE 255 LoadLim_Taux_src_COMPU_VTAB 0 255 BIT_MASK 0xff /end CHARACTERISTIC
/begin COMPU_METHOD LoadLim_Taux_src_COMPU_VTAB "Verbal Table" TAB_VERB "%.0" "list" COMPU_TAB_REF LoadLim_Taux_src_COMPU_VTAB_REF /end COMPU_METHOD
/begin COMPU_VTAB LoadLim_Taux_src_COMPU_VTAB_REF "Verbal Table" TAB_VERB 6 0 "Not Used" 1 "FST" 2 "FRT" 3 "FT" 4 "IAT" 5 "MAT" DEFAULT_VALUE "UNKNOWN" /end COMPU_VTAB
/begin MEASUREMENT LoadLim_Taux_T "Aux-Temperature" UWORD Compu_LoadLim_Taux_T 0 0 -460 563.984375 ECU_ADDRESS 0x01003F70 /end MEASUREMENT
/begin COMPU_METHOD Compu_LoadLim_Taux_T " " RAT_FUNC "%.1" "deg F" COEFFS 0 64 29440 0 0 1 /end COMPU_METHOD
/begin CHARACTERISTIC DERATE_TPS_slew_dn "Derate engagement TPS slew down" VALUE 0x00144290 /* @ECU_Address@DERATE_TPS_slew_dn@0x010052B8@ */ ECIPP_ALIGNMENT_SWORD 1562 Compu_DERATE_TPS_slew_dn -1562.5 1562.45231628418 /end CHARACTERISTIC
/begin COMPU_METHOD Compu_DERATE_TPS_slew_dn " " RAT_FUNC "%.1" "%/sec" COEFFS 0 20.97152 0 0 0 1 /end COMPU_METHOD
/begin CHARACTERISTIC DERATE_TPS_slew_up "Derate dis-engagement TPS slew up" VALUE 0x00144292 /* @ECU_Address@DERATE_TPS_slew_up@0x010052C0@ */ ECIPP_ALIGNMENT_SWORD 1562 Compu_DERATE_TPS_slew_up -1562.5 1562.45231628418 /end CHARACTERISTIC
/begin COMPU_METHOD Compu_DERATE_TPS_slew_up " " RAT_FUNC "%.1" "%/sec" COEFFS 0 20.97152 0 0 0 1 /end COMPU_METHOD
/begin CHARACTERISTIC SD_ramp_ena "Fault low rev limit shutdown ramp{SD_ramp_ena&0xff=0:Disabled}{SD_ramp_ena&0xff=1:Enabled}" VALUE 0x00147f2e /* @ECU_Address@SD_ramp_ena@0x010056A0@ */ ECIPP_ALIGNMENT_UBYTE 255 SD_ramp_ena_COMPU_VTAB 0 255 BIT_MASK 0xff /end CHARACTERISTIC
/begin COMPU_METHOD SD_ramp_ena_COMPU_VTAB "Verbal Table" TAB_VERB "%.0" "list" COMPU_TAB_REF SD_ramp_ena_COMPU_VTAB_REF /end COMPU_METHOD
/begin COMPU_VTAB SD_ramp_ena_COMPU_VTAB_REF "Verbal Table" TAB_VERB 2 0 "Disabled" 1 "Enabled" DEFAULT_VALUE "UNKNOWN" /end COMPU_VTAB
/begin CHARACTERISTIC SD_ramp_twait "Fault low rev limit shutdown idle wait" VALUE 0x00147784 /* @ECU_Address@SD_ramp_twait@0x010056A8@ */ ECIPP_ALIGNMENT_UWORD 66 Compu_SD_ramp_twait 0 65.535 /end CHARACTERISTIC
/begin COMPU_METHOD Compu_SD_ramp_twait " " RAT_FUNC "%.1" "sec" COEFFS 0 1000 0 0 0 1 /end COMPU_METHOD
/begin MEASUREMENT SD_ramp_tmr "Fault low rev limit shutdown idle time" UWORD Compu_SD_ramp_tmr 0 0 0 65.535 ECU_ADDRESS 0x010056B0 /end MEASUREMENT
/begin COMPU_METHOD Compu_SD_ramp_tmr " " RAT_FUNC "%.1" "sec" COEFFS 0 1000 0 0 0 1 /end COMPU_METHOD
/begin MEASUREMENT SD_active "Shutdown" UBYTE Compu_SD_active 0 0 0 255 ECU_ADDRESS 0x010056B8 /end MEASUREMENT
/begin COMPU_METHOD Compu_SD_active " " RAT_FUNC "%.0" "-" COEFFS 0 1 0 0 0 1 /end COMPU_METHOD
/begin CHARACTERISTIC MILblk_derate "Power derate MIL blink{MILblk_derate&0xff=0:Disabled}{MILblk_derate&0xff=1:Enabled}" VALUE 0x00147e6f /* @ECU_Address@MILblk_derate@0x010056C0@ */ ECIPP_ALIGNMENT_UBYTE 255 MILblk_derate_COMPU_VTAB 0 255 BIT_MASK 0xff /end CHARACTERISTIC
/begin COMPU_METHOD MILblk_derate_COMPU_VTAB "Verbal Table" TAB_VERB "%.0" "list" COMPU_TAB_REF MILblk_derate_COMPU_VTAB_REF /end COMPU_METHOD
/begin COMPU_VTAB MILblk_derate_COMPU_VTAB_REF "Verbal Table" TAB_VERB 2 0 "Disabled" 1 "Enabled" DEFAULT_VALUE "UNKNOWN" /end COMPU_VTAB
/begin MEASUREMENT FORCEIDLE_active "Forced Idle{FORCEIDLE_active&0x01=0x00:Inactive}{FORCEIDLE_active&0x01=0x01:Active}" UBYTE FORCEIDLE_active_COMPU_VTAB 0 0 0 255 ECU_ADDRESS 0x010056E8 BIT_MASK 0x01 /end MEASUREMENT
/begin COMPU_METHOD FORCEIDLE_active_COMPU_VTAB "Verbal Table" TAB_VERB "%.0" "list" COMPU_TAB_REF FORCEIDLE_active_COMPU_VTAB_REF /end COMPU_METHOD
/begin COMPU_VTAB FORCEIDLE_active_COMPU_VTAB_REF "Verbal Table" TAB_VERB 2 0x00 "Inactive" 0x01 "Active" DEFAULT_VALUE "UNKNOWN" /end COMPU_VTAB
/begin CHARACTERISTIC LLAdapt_ena "Load-limit adaptation{LLAdapt_ena&0xff=0:Disabled}{LLAdapt_ena&0xff=1:Enabled}" VALUE 0x00147dfd /* @ECU_Address@LLAdapt_ena@0x01005B70@ */ ECIPP_ALIGNMENT_UBYTE 255 LLAdapt_ena_COMPU_VTAB 0 255 BIT_MASK 0xff /end CHARACTERISTIC
/begin COMPU_METHOD LLAdapt_ena_COMPU_VTAB "Verbal Table" TAB_VERB "%.0" "list" COMPU_TAB_REF LLAdapt_ena_COMPU_VTAB_REF /end COMPU_METHOD
/begin COMPU_VTAB LLAdapt_ena_COMPU_VTAB_REF "Verbal Table" TAB_VERB 2 0 "Disabled" 1 "Enabled" DEFAULT_VALUE "UNKNOWN" /end COMPU_VTAB
/begin CHARACTERISTIC LLAdapt_Ki "LLAdapt Ki gain" VALUE 0x00144334 /* @ECU_Address@LLAdapt_Ki@0x01005B78@ */ ECIPP_ALIGNMENT_SWORD 64 Compu_LLAdapt_Ki -64 63.998046875 /end CHARACTERISTIC
/begin COMPU_METHOD Compu_LLAdapt_Ki " " RAT_FUNC "%.2" "%/%/sec" COEFFS 0 512 0 0 0 1 /end COMPU_METHOD
/begin CHARACTERISTIC LLAdapt_slew_lim "LLAdapt slew limit" VALUE 0x0014754c /* @ECU_Address@LLAdapt_slew_lim@0x01005B80@ */ ECIPP_ALIGNMENT_UWORD 400 Compu_LLAdapt_slew_lim 0 399.993896484375 /end CHARACTERISTIC
/begin COMPU_METHOD Compu_LLAdapt_slew_lim " " RAT_FUNC "%.1" "%/sec" COEFFS 0 163.84 0 0 0 1 /end COMPU_METHOD
/begin CHARACTERISTIC LLAdapt_dld_max "LLAdapt max offset" VALUE 0x00144336 /* @ECU_Address@LLAdapt_dld_max@0x01005B88@ */ ECIPP_ALIGNMENT_SWORD 200 Compu_LLAdapt_dld_max -200 199.993896484375 /end CHARACTERISTIC
/begin COMPU_METHOD Compu_LLAdapt_dld_max " " RAT_FUNC "%.1" "% load" COEFFS 0 163.84 0 0 0 1 /end COMPU_METHOD
/begin CHARACTERISTIC LLAdapt_dld_min "LLAdapt min offset" VALUE 0x00144338 /* @ECU_Address@LLAdapt_dld_min@0x01005B90@ */ ECIPP_ALIGNMENT_SWORD 200 Compu_LLAdapt_dld_min -200 199.993896484375 /end CHARACTERISTIC
/begin COMPU_METHOD Compu_LLAdapt_dld_min " " RAT_FUNC "%.1" "% load" COEFFS 0 163.84 0 0 0 1 /end COMPU_METHOD
/begin CHARACTERISTIC LLAdapt_frz_wait "LLAdapt freeze wait" VALUE 0x0014754a /* @ECU_Address@LLAdapt_frz_wait@0x01005B98@ */ ECIPP_ALIGNMENT_UWORD 65535 Compu_LLAdapt_frz_wait 0 65535 /end CHARACTERISTIC
/begin COMPU_METHOD Compu_LLAdapt_frz_wait " " RAT_FUNC "%.0" "ms" COEFFS 0 1 0 0 0 1 /end COMPU_METHOD
/begin MEASUREMENT LLAdapt_dload "LLAdapt adaptation offset" SWORD Compu_LLAdapt_dload 0 0 -200 199.993896484375 ECU_ADDRESS 0x01005BA0 /end MEASUREMENT
/begin COMPU_METHOD Compu_LLAdapt_dload " " RAT_FUNC "%.1" "% load" COEFFS 0 163.84 0 0 0 1 /end COMPU_METHOD
/begin CHARACTERISTIC LoadLim_mode "Load-limit default table selection{LoadLim_mode&0xff=0:Fuel based}{LoadLim_mode&0xff=1:Aux PU1}{LoadLim_mode&0xff=2:Aux PU2}{LoadLim_mode&0xff=3:Aux PU3}{LoadLim_mode&0xff=4:Aux DIG1}{LoadLim_mode&0xff=5:Aux DIG2}{LoadLim_mode&0xff=6:Aux DIG3}{LoadLim_mod" VALUE 0x00147e46 /* @ECU_Address@LoadLim_mode@0x010078B0@ */ ECIPP_ALIGNMENT_UBYTE 255 LoadLim_mode_COMPU_VTAB 0 255 BIT_MASK 0xff /end CHARACTERISTIC
/begin COMPU_METHOD LoadLim_mode_COMPU_VTAB "Verbal Table" TAB_VERB "%.0" "list" COMPU_TAB_REF LoadLim_mode_COMPU_VTAB_REF /end COMPU_METHOD
/begin COMPU_VTAB LoadLim_mode_COMPU_VTAB_REF "Verbal Table" TAB_VERB 9 0 "Fuel based" 1 "Aux PU1" 2 "Aux PU2" 3 "Aux PU3" 4 "Aux DIG1" 5 "Aux DIG2" 6 "Aux DIG3" 7 "Aux DIG4" 8 "Aux DIG5" DEFAULT_VALUE "UNKNOWN" /end COMPU_VTAB
/begin CHARACTERISTIC LoadLim_T1_volts "Load-limiting table 1 target" VALUE 0x00147578 /* @ECU_Address@LoadLim_T1_volts@0x010078B8@ */ ECIPP_ALIGNMENT_UWORD 256 Compu_LoadLim_T1_volts 0 255.99609375 /end CHARACTERISTIC
/begin COMPU_METHOD Compu_LoadLim_T1_volts " " RAT_FUNC "%.3" "volts" COEFFS 0 256 0 0 0 1 /end COMPU_METHOD
/begin CHARACTERISTIC LoadLim_T2_volts "Load-limiting table 2 target" VALUE 0x0014757a /* @ECU_Address@LoadLim_T2_volts@0x010078C0@ */ ECIPP_ALIGNMENT_UWORD 256 Compu_LoadLim_T2_volts 0 255.99609375 /end CHARACTERISTIC
/begin COMPU_METHOD Compu_LoadLim_T2_volts " " RAT_FUNC "%.3" "volts" COEFFS 0 256 0 0 0 1 /end COMPU_METHOD
/begin CHARACTERISTIC LoadLim_T3_volts "Load-limiting table 3 target" VALUE 0x0014757c /* @ECU_Address@LoadLim_T3_volts@0x010078C8@ */ ECIPP_ALIGNMENT_UWORD 256 Compu_LoadLim_T3_volts 0 255.99609375 /end CHARACTERISTIC
/begin COMPU_METHOD Compu_LoadLim_T3_volts " " RAT_FUNC "%.3" "volts" COEFFS 0 256 0 0 0 1 /end COMPU_METHOD
/begin MEASUREMENT LoadLim_T_active "Load-limit currently active table{LoadLim_T_active&0xff=0:Table 1 / Gasoline}{LoadLim_T_active&0xff=1:Table 2 / LPG}{LoadLim_T_active&0xff=2:Table 3 / NG}{LoadLim_T_active&0xff=3:Table 4 / Power}{LoadLim_T_active&0xff=4:100% Load Limit}{LoadLim_T_active&0" UBYTE LoadLim_T_active_COMPU_VTAB 0 0 0 255 ECU_ADDRESS 0x010078D0 BIT_MASK 0xff /end MEASUREMENT
/begin COMPU_METHOD LoadLim_T_active_COMPU_VTAB "Verbal Table" TAB_VERB "%.0" "list" COMPU_TAB_REF LoadLim_T_active_COMPU_VTAB_REF /end COMPU_METHOD
/begin COMPU_VTAB LoadLim_T_active_COMPU_VTAB_REF "Verbal Table" TAB_VERB 9 0 "Table 1 / Gasoline" 1 "Table 2 / LPG" 2 "Table 3 / NG" 3 "Table 4 / Power" 4 "100% Load Limit" 5 "Table 5" 6 "Table 6" 7 "Table 7" 8 "Table 8" DEFAULT_VALUE "UNKNOWN" /end COMPU_VTAB
/begin CHARACTERISTIC TEL_enable_CNHTC "Telematics system 1{TEL_enable_CNHTC&0xff=0:Disabled}{TEL_enable_CNHTC&0xff=1:Enabled}" VALUE 0x00148094 /* @ECU_Address@TEL_enable_CNHTC@0x01008D90@ */ ECIPP_ALIGNMENT_UBYTE 255 TEL_enable_CNHTC_COMPU_VTAB 0 255 BIT_MASK 0xff /end CHARACTERISTIC
/begin COMPU_METHOD TEL_enable_CNHTC_COMPU_VTAB "Verbal Table" TAB_VERB "%.0" "list" COMPU_TAB_REF TEL_enable_CNHTC_COMPU_VTAB_REF /end COMPU_METHOD
/begin COMPU_VTAB TEL_enable_CNHTC_COMPU_VTAB_REF "Verbal Table" TAB_VERB 2 0 "Disabled" 1 "Enabled" DEFAULT_VALUE "UNKNOWN" /end COMPU_VTAB
/begin MEASUREMENT TEL_derate_active "Requested telematics derate status{TEL_derate_active&0xff=0:No Derate Active}{TEL_derate_active&0xff=1:Derate-No Telematic Unit Found}{TEL_derate_active&0xff=2:Derate-Commanded by Telematics}{TEL_derate_active&0xff=6:Derate-Commanded + No Unit Req}{TEL_de" UBYTE TEL_derate_active_COMPU_VTAB 0 0 0 255 ECU_ADDRESS 0x01008DA0 BIT_MASK 0xff /end MEASUREMENT
/begin COMPU_METHOD TEL_derate_active_COMPU_VTAB "Verbal Table" TAB_VERB "%.0" "list" COMPU_TAB_REF TEL_derate_active_COMPU_VTAB_REF /end COMPU_METHOD
/begin COMPU_VTAB TEL_derate_active_COMPU_VTAB_REF "Verbal Table" TAB_VERB 6 0 "No Derate Active" 1 "Derate-No Telematic Unit Found" 2 "Derate-Commanded by Telematics" 6 "Derate-Commanded + No Unit Req" 10 "Derate-Commanded + No Unit" 14 "Derate-Commanded + No Unit" DEFAULT_VALUE "UNKNOWN" /end COMPU_VTAB
/begin MEASUREMENT TEL_bound "Telematic unit bound to this ECM{TEL_bound&0x01=0:No}{TEL_bound&0x01=1:Yes}" UBYTE TEL_bound_COMPU_VTAB 0 0 0 255 ECU_ADDRESS 0x01008DA8 BIT_MASK 0x01 /end MEASUREMENT
/begin COMPU_METHOD TEL_bound_COMPU_VTAB "Verbal Table" TAB_VERB "%.0" "list" COMPU_TAB_REF TEL_bound_COMPU_VTAB_REF /end COMPU_METHOD
/begin COMPU_VTAB TEL_bound_COMPU_VTAB_REF "Verbal Table" TAB_VERB 2 0 "No" 1 "Yes" DEFAULT_VALUE "UNKNOWN" /end COMPU_VTAB
/begin CHARACTERISTIC CRI_air_slct0 "Air mass command{CRI_air_slct0&0xff=0:Standard}{CRI_air_slct0&0xff=1:Alternate 1}{CRI_air_slct0&0xff=2:Alt 1 + Std}" VALUE 0x00170EF2 /* @ECU_Address@CRI_air_slct0@0x0100A308@ */ ECIPP_ALIGNMENT_UBYTE 255 CRI_air_slct0_COMPU_VTAB 0 255 BIT_MASK 0xff /end CHARACTERISTIC
/begin COMPU_METHOD CRI_air_slct0_COMPU_VTAB "Verbal Table" TAB_VERB "%.0" "list" COMPU_TAB_REF CRI_air_slct0_COMPU_VTAB_REF /end COMPU_METHOD
/begin COMPU_VTAB CRI_air_slct0_COMPU_VTAB_REF "Verbal Table" TAB_VERB 3 0 "Standard" 1 "Alternate 1" 2 "Alt 1 + Std" DEFAULT_VALUE "UNKNOWN" /end COMPU_VTAB
/begin CHARACTERISTIC CRI_air_slct1 "Air mass command{CRI_air_slct1&0xff=0:Standard}{CRI_air_slct1&0xff=1:Alternate 1}{CRI_air_slct1&0xff=2:Alt 1 + Std}" VALUE 0x00170EF3 /* @ECU_Address@CRI_air_slct1@0x0100A310@ */ ECIPP_ALIGNMENT_UBYTE 255 CRI_air_slct1_COMPU_VTAB 0 255 BIT_MASK 0xff /end CHARACTERISTIC
/begin COMPU_METHOD CRI_air_slct1_COMPU_VTAB "Verbal Table" TAB_VERB "%.0" "list" COMPU_TAB_REF CRI_air_slct1_COMPU_VTAB_REF /end COMPU_METHOD
/begin COMPU_VTAB CRI_air_slct1_COMPU_VTAB_REF "Verbal Table" TAB_VERB 3 0 "Standard" 1 "Alternate 1" 2 "Alt 1 + Std" DEFAULT_VALUE "UNKNOWN" /end COMPU_VTAB
/begin CHARACTERISTIC CRI_air_slct2 "Air mass command{CRI_air_slct2&0xff=0:Standard}{CRI_air_slct2&0xff=1:Alternate 1}{CRI_air_slct2&0xff=2:Alt 1 + Std}" VALUE 0x00170EF4 /* @ECU_Address@CRI_air_slct2@0x0100A318@ */ ECIPP_ALIGNMENT_UBYTE 255 CRI_air_slct2_COMPU_VTAB 0 255 BIT_MASK 0xff /end CHARACTERISTIC
/begin COMPU_METHOD CRI_air_slct2_COMPU_VTAB "Verbal Table" TAB_VERB "%.0" "list" COMPU_TAB_REF CRI_air_slct2_COMPU_VTAB_REF /end COMPU_METHOD
/begin COMPU_VTAB CRI_air_slct2_COMPU_VTAB_REF "Verbal Table" TAB_VERB 3 0 "Standard" 1 "Alternate 1" 2 "Alt 1 + Std" DEFAULT_VALUE "UNKNOWN" /end COMPU_VTAB
/begin CHARACTERISTIC CRI_air_slct3 "Air mass command{CRI_air_slct3&0xff=0:Standard}{CRI_air_slct3&0xff=1:Alternate 1}{CRI_air_slct3&0xff=2:Alt 1 + Std}" VALUE 0x00170EF5 /* @ECU_Address@CRI_air_slct3@0x0100A320@ */ ECIPP_ALIGNMENT_UBYTE 255 CRI_air_slct3_COMPU_VTAB 0 255 BIT_MASK 0xff /end CHARACTERISTIC
/begin COMPU_METHOD CRI_air_slct3_COMPU_VTAB "Verbal Table" TAB_VERB "%.0" "list" COMPU_TAB_REF CRI_air_slct3_COMPU_VTAB_REF /end COMPU_METHOD
/begin COMPU_VTAB CRI_air_slct3_COMPU_VTAB_REF "Verbal Table" TAB_VERB 3 0 "Standard" 1 "Alternate 1" 2 "Alt 1 + Std" DEFAULT_VALUE "UNKNOWN" /end COMPU_VTAB
/begin CHARACTERISTIC CRI_air_slct4 "Air mass command{CRI_air_slct4&0xff=0:Standard}{CRI_air_slct4&0xff=1:Alternate 1}{CRI_air_slct4&0xff=2:Alt 1 + Std}" VALUE 0x00170EF6 /* @ECU_Address@CRI_air_slct4@0x0100A328@ */ ECIPP_ALIGNMENT_UBYTE 255 CRI_air_slct4_COMPU_VTAB 0 255 BIT_MASK 0xff /end CHARACTERISTIC
/begin COMPU_METHOD CRI_air_slct4_COMPU_VTAB "Verbal Table" TAB_VERB "%.0" "list" COMPU_TAB_REF CRI_air_slct4_COMPU_VTAB_REF /end COMPU_METHOD
/begin COMPU_VTAB CRI_air_slct4_COMPU_VTAB_REF "Verbal Table" TAB_VERB 3 0 "Standard" 1 "Alternate 1" 2 "Alt 1 + Std" DEFAULT_VALUE "UNKNOWN" /end COMPU_VTAB
/begin CHARACTERISTIC CRI_air_slct5 "Air mass command{CRI_air_slct5&0xff=0:Standard}{CRI_air_slct5&0xff=1:Alternate 1}{CRI_air_slct5&0xff=2:Alt 1 + Std}" VALUE 0x00170EF7 /* @ECU_Address@CRI_air_slct5@0x0100A330@ */ ECIPP_ALIGNMENT_UBYTE 255 CRI_air_slct5_COMPU_VTAB 0 255 BIT_MASK 0xff /end CHARACTERISTIC
/begin COMPU_METHOD CRI_air_slct5_COMPU_VTAB "Verbal Table" TAB_VERB "%.0" "list" COMPU_TAB_REF CRI_air_slct5_COMPU_VTAB_REF /end COMPU_METHOD
/begin COMPU_VTAB CRI_air_slct5_COMPU_VTAB_REF "Verbal Table" TAB_VERB 3 0 "Standard" 1 "Alternate 1" 2 "Alt 1 + Std" DEFAULT_VALUE "UNKNOWN" /end COMPU_VTAB
/begin CHARACTERISTIC CRI_air_slct6 "Air mass command{CRI_air_slct6&0xff=0:Standard}{CRI_air_slct6&0xff=1:Alternate 1}{CRI_air_slct6&0xff=2:Alt 1 + Std}" VALUE 0x00170EF8 /* @ECU_Address@CRI_air_slct6@0x0100A338@ */ ECIPP_ALIGNMENT_UBYTE 255 CRI_air_slct6_COMPU_VTAB 0 255 BIT_MASK 0xff /end CHARACTERISTIC
/begin COMPU_METHOD CRI_air_slct6_COMPU_VTAB "Verbal Table" TAB_VERB "%.0" "list" COMPU_TAB_REF CRI_air_slct6_COMPU_VTAB_REF /end COMPU_METHOD
/begin COMPU_VTAB CRI_air_slct6_COMPU_VTAB_REF "Verbal Table" TAB_VERB 3 0 "Standard" 1 "Alternate 1" 2 "Alt 1 + Std" DEFAULT_VALUE "UNKNOWN" /end COMPU_VTAB
/begin CHARACTERISTIC CRI_air_slct7 "Air mass command{CRI_air_slct7&0xff=0:Standard}{CRI_air_slct7&0xff=1:Alternate 1}{CRI_air_slct7&0xff=2:Alt 1 + Std}" VALUE 0x00170EF9 /* @ECU_Address@CRI_air_slct7@0x0100A340@ */ ECIPP_ALIGNMENT_UBYTE 255 CRI_air_slct7_COMPU_VTAB 0 255 BIT_MASK 0xff /end CHARACTERISTIC
/begin COMPU_METHOD CRI_air_slct7_COMPU_VTAB "Verbal Table" TAB_VERB "%.0" "list" COMPU_TAB_REF CRI_air_slct7_COMPU_VTAB_REF /end COMPU_METHOD
/begin COMPU_VTAB CRI_air_slct7_COMPU_VTAB_REF "Verbal Table" TAB_VERB 3 0 "Standard" 1 "Alternate 1" 2 "Alt 1 + Std" DEFAULT_VALUE "UNKNOWN" /end COMPU_VTAB
/begin CHARACTERISTIC CRI_P_slct0 "Fuel pressure command{CRI_P_slct0&0xff=0:Standard}{CRI_P_slct0&0xff=1:Alternate 1}{CRI_P_slct0&0xff=2:Alt 1 + Std}" VALUE 0x00170E82 /* @ECU_Address@CRI_P_slct0@0x0100A348@ */ ECIPP_ALIGNMENT_UBYTE 255 CRI_P_slct0_COMPU_VTAB 0 255 BIT_MASK 0xff /end CHARACTERISTIC
/begin COMPU_METHOD CRI_P_slct0_COMPU_VTAB "Verbal Table" TAB_VERB "%.0" "list" COMPU_TAB_REF CRI_P_slct0_COMPU_VTAB_REF /end COMPU_METHOD
/begin COMPU_VTAB CRI_P_slct0_COMPU_VTAB_REF "Verbal Table" TAB_VERB 3 0 "Standard" 1 "Alternate 1" 2 "Alt 1 + Std" DEFAULT_VALUE "UNKNOWN" /end COMPU_VTAB
/begin CHARACTERISTIC CRI_P_slct1 "Fuel pressure command{CRI_P_slct1&0xff=0:Standard}{CRI_P_slct1&0xff=1:Alternate 1}{CRI_P_slct1&0xff=2:Alt 1 + Std}" VALUE 0x00170E83 /* @ECU_Address@CRI_P_slct1@0x0100A350@ */ ECIPP_ALIGNMENT_UBYTE 255 CRI_P_slct1_COMPU_VTAB 0 255 BIT_MASK 0xff /end CHARACTERISTIC
/begin COMPU_METHOD CRI_P_slct1_COMPU_VTAB "Verbal Table" TAB_VERB "%.0" "list" COMPU_TAB_REF CRI_P_slct1_COMPU_VTAB_REF /end COMPU_METHOD
/begin COMPU_VTAB CRI_P_slct1_COMPU_VTAB_REF "Verbal Table" TAB_VERB 3 0 "Standard" 1 "Alternate 1" 2 "Alt 1 + Std" DEFAULT_VALUE "UNKNOWN" /end COMPU_VTAB
/begin CHARACTERISTIC CRI_P_slct2 "Fuel pressure command{CRI_P_slct2&0xff=0:Standard}{CRI_P_slct2&0xff=1:Alternate 1}{CRI_P_slct2&0xff=2:Alt 1 + Std}" VALUE 0x00170E84 /* @ECU_Address@CRI_P_slct2@0x0100A358@ */ ECIPP_ALIGNMENT_UBYTE 255 CRI_P_slct2_COMPU_VTAB 0 255 BIT_MASK 0xff /end CHARACTERISTIC
/begin COMPU_METHOD CRI_P_slct2_COMPU_VTAB "Verbal Table" TAB_VERB "%.0" "list" COMPU_TAB_REF CRI_P_slct2_COMPU_VTAB_REF /end COMPU_METHOD
/begin COMPU_VTAB CRI_P_slct2_COMPU_VTAB_REF "Verbal Table" TAB_VERB 3 0 "Standard" 1 "Alternate 1" 2 "Alt 1 + Std" DEFAULT_VALUE "UNKNOWN" /end COMPU_VTAB
/begin CHARACTERISTIC CRI_P_slct3 "Fuel pressure command{CRI_P_slct3&0xff=0:Standard}{CRI_P_slct3&0xff=1:Alternate 1}{CRI_P_slct3&0xff=2:Alt 1 + Std}" VALUE 0x00170E85 /* @ECU_Address@CRI_P_slct3@0x0100A360@ */ ECIPP_ALIGNMENT_UBYTE 255 CRI_P_slct3_COMPU_VTAB 0 255 BIT_MASK 0xff /end CHARACTERISTIC
/begin COMPU_METHOD CRI_P_slct3_COMPU_VTAB "Verbal Table" TAB_VERB "%.0" "list" COMPU_TAB_REF CRI_P_slct3_COMPU_VTAB_REF /end COMPU_METHOD
/begin COMPU_VTAB CRI_P_slct3_COMPU_VTAB_REF "Verbal Table" TAB_VERB 3 0 "Standard" 1 "Alternate 1" 2 "Alt 1 + Std" DEFAULT_VALUE "UNKNOWN" /end COMPU_VTAB
/begin CHARACTERISTIC CRI_P_slct4 "Fuel pressure command{CRI_P_slct4&0xff=0:Standard}{CRI_P_slct4&0xff=1:Alternate 1}{CRI_P_slct4&0xff=2:Alt 1 + Std}" VALUE 0x00170E86 /* @ECU_Address@CRI_P_slct4@0x0100A368@ */ ECIPP_ALIGNMENT_UBYTE 255 CRI_P_slct4_COMPU_VTAB 0 255 BIT_MASK 0xff /end CHARACTERISTIC
/begin COMPU_METHOD CRI_P_slct4_COMPU_VTAB "Verbal Table" TAB_VERB "%.0" "list" COMPU_TAB_REF CRI_P_slct4_COMPU_VTAB_REF /end COMPU_METHOD
/begin COMPU_VTAB CRI_P_slct4_COMPU_VTAB_REF "Verbal Table" TAB_VERB 3 0 "Standard" 1 "Alternate 1" 2 "Alt 1 + Std" DEFAULT_VALUE "UNKNOWN" /end COMPU_VTAB
/begin CHARACTERISTIC CRI_P_slct5 "Fuel pressure command{CRI_P_slct5&0xff=0:Standard}{CRI_P_slct5&0xff=1:Alternate 1}{CRI_P_slct5&0xff=2:Alt 1 + Std}" VALUE 0x00170E87 /* @ECU_Address@CRI_P_slct5@0x0100A370@ */ ECIPP_ALIGNMENT_UBYTE 255 CRI_P_slct5_COMPU_VTAB 0 255 BIT_MASK 0xff /end CHARACTERISTIC
/begin COMPU_METHOD CRI_P_slct5_COMPU_VTAB "Verbal Table" TAB_VERB "%.0" "list" COMPU_TAB_REF CRI_P_slct5_COMPU_VTAB_REF /end COMPU_METHOD
/begin COMPU_VTAB CRI_P_slct5_COMPU_VTAB_REF "Verbal Table" TAB_VERB 3 0 "Standard" 1 "Alternate 1" 2 "Alt 1 + Std" DEFAULT_VALUE "UNKNOWN" /end COMPU_VTAB
/begin CHARACTERISTIC CRI_P_slct6 "Fuel pressure command{CRI_P_slct6&0xff=0:Standard}{CRI_P_slct6&0xff=1:Alternate 1}{CRI_P_slct6&0xff=2:Alt 1 + Std}" VALUE 0x00170E88 /* @ECU_Address@CRI_P_slct6@0x0100A378@ */ ECIPP_ALIGNMENT_UBYTE 255 CRI_P_slct6_COMPU_VTAB 0 255 BIT_MASK 0xff /end CHARACTERISTIC
/begin COMPU_METHOD CRI_P_slct6_COMPU_VTAB "Verbal Table" TAB_VERB "%.0" "list" COMPU_TAB_REF CRI_P_slct6_COMPU_VTAB_REF /end COMPU_METHOD
/begin COMPU_VTAB CRI_P_slct6_COMPU_VTAB_REF "Verbal Table" TAB_VERB 3 0 "Standard" 1 "Alternate 1" 2 "Alt 1 + Std" DEFAULT_VALUE "UNKNOWN" /end COMPU_VTAB
/begin CHARACTERISTIC CRI_P_slct7 "Fuel pressure command{CRI_P_slct7&0xff=0:Standard}{CRI_P_slct7&0xff=1:Alternate 1}{CRI_P_slct7&0xff=2:Alt 1 + Std}" VALUE 0x00170E89 /* @ECU_Address@CRI_P_slct7@0x0100A380@ */ ECIPP_ALIGNMENT_UBYTE 255 CRI_P_slct7_COMPU_VTAB 0 255 BIT_MASK 0xff /end CHARACTERISTIC
/begin COMPU_METHOD CRI_P_slct7_COMPU_VTAB "Verbal Table" TAB_VERB "%.0" "list" COMPU_TAB_REF CRI_P_slct7_COMPU_VTAB_REF /end COMPU_METHOD
/begin COMPU_VTAB CRI_P_slct7_COMPU_VTAB_REF "Verbal Table" TAB_VERB 3 0 "Standard" 1 "Alternate 1" 2 "Alt 1 + Std" DEFAULT_VALUE "UNKNOWN" /end COMPU_VTAB
/begin CHARACTERISTIC CRI_dilpct_slct0 "EGR diluent command{CRI_dilpct_slct0&0xff=0:Standard}{CRI_dilpct_slct0&0xff=1:Alternate 1}{CRI_dilpct_slct0&0xff=2:Alt 1 + Std}" VALUE 0x00170F06 /* @ECU_Address@CRI_dilpct_slct0@0x0100A388@ */ ECIPP_ALIGNMENT_UBYTE 255 CRI_dilpct_slct0_COMPU_VTAB 0 255 BIT_MASK 0xff /end CHARACTERISTIC
/begin COMPU_METHOD CRI_dilpct_slct0_COMPU_VTAB "Verbal Table" TAB_VERB "%.0" "list" COMPU_TAB_REF CRI_dilpct_slct0_COMPU_VTAB_REF /end COMPU_METHOD
/begin COMPU_VTAB CRI_dilpct_slct0_COMPU_VTAB_REF "Verbal Table" TAB_VERB 3 0 "Standard" 1 "Alternate 1" 2 "Alt 1 + Std" DEFAULT_VALUE "UNKNOWN" /end COMPU_VTAB
/begin CHARACTERISTIC CRI_dilpct_slct1 "EGR diluent command{CRI_dilpct_slct1&0xff=0:Standard}{CRI_dilpct_slct1&0xff=1:Alternate 1}{CRI_dilpct_slct1&0xff=2:Alt 1 + Std}" VALUE 0x00170F07 /* @ECU_Address@CRI_dilpct_slct1@0x0100A390@ */ ECIPP_ALIGNMENT_UBYTE 255 CRI_dilpct_slct1_COMPU_VTAB 0 255 BIT_MASK 0xff /end CHARACTERISTIC
/begin COMPU_METHOD CRI_dilpct_slct1_COMPU_VTAB "Verbal Table" TAB_VERB "%.0" "list" COMPU_TAB_REF CRI_dilpct_slct1_COMPU_VTAB_REF /end COMPU_METHOD
/begin COMPU_VTAB CRI_dilpct_slct1_COMPU_VTAB_REF "Verbal Table" TAB_VERB 3 0 "Standard" 1 "Alternate 1" 2 "Alt 1 + Std" DEFAULT_VALUE "UNKNOWN" /end COMPU_VTAB
/begin CHARACTERISTIC CRI_dilpct_slct2 "EGR diluent command{CRI_dilpct_slct2&0xff=0:Standard}{CRI_dilpct_slct2&0xff=1:Alternate 1}{CRI_dilpct_slct2&0xff=2:Alt 1 + Std}" VALUE 0x00170F08 /* @ECU_Address@CRI_dilpct_slct2@0x0100A398@ */ ECIPP_ALIGNMENT_UBYTE 255 CRI_dilpct_slct2_COMPU_VTAB 0 255 BIT_MASK 0xff /end CHARACTERISTIC
/begin COMPU_METHOD CRI_dilpct_slct2_COMPU_VTAB "Verbal Table" TAB_VERB "%.0" "list" COMPU_TAB_REF CRI_dilpct_slct2_COMPU_VTAB_REF /end COMPU_METHOD
/begin COMPU_VTAB CRI_dilpct_slct2_COMPU_VTAB_REF "Verbal Table" TAB_VERB 3 0 "Standard" 1 "Alternate 1" 2 "Alt 1 + Std" DEFAULT_VALUE "UNKNOWN" /end COMPU_VTAB
/begin CHARACTERISTIC CRI_dilpct_slct3 "EGR diluent command{CRI_dilpct_slct3&0xff=0:Standard}{CRI_dilpct_slct3&0xff=1:Alternate 1}{CRI_dilpct_slct3&0xff=2:Alt 1 + Std}" VALUE 0x00170F09 /* @ECU_Address@CRI_dilpct_slct3@0x0100A3A0@ */ ECIPP_ALIGNMENT_UBYTE 255 CRI_dilpct_slct3_COMPU_VTAB 0 255 BIT_MASK 0xff /end CHARACTERISTIC
/begin COMPU_METHOD CRI_dilpct_slct3_COMPU_VTAB "Verbal Table" TAB_VERB "%.0" "list" COMPU_TAB_REF CRI_dilpct_slct3_COMPU_VTAB_REF /end COMPU_METHOD
/begin COMPU_VTAB CRI_dilpct_slct3_COMPU_VTAB_REF "Verbal Table" TAB_VERB 3 0 "Standard" 1 "Alternate 1" 2 "Alt 1 + Std" DEFAULT_VALUE "UNKNOWN" /end COMPU_VTAB
/begin CHARACTERISTIC CRI_dilpct_slct4 "EGR diluent command{CRI_dilpct_slct4&0xff=0:Standard}{CRI_dilpct_slct4&0xff=1:Alternate 1}{CRI_dilpct_slct4&0xff=2:Alt 1 + Std}" VALUE 0x00170F0A /* @ECU_Address@CRI_dilpct_slct4@0x0100A3A8@ */ ECIPP_ALIGNMENT_UBYTE 255 CRI_dilpct_slct4_COMPU_VTAB 0 255 BIT_MASK 0xff /end CHARACTERISTIC
/begin COMPU_METHOD CRI_dilpct_slct4_COMPU_VTAB "Verbal Table" TAB_VERB "%.0" "list" COMPU_TAB_REF CRI_dilpct_slct4_COMPU_VTAB_REF /end COMPU_METHOD
/begin COMPU_VTAB CRI_dilpct_slct4_COMPU_VTAB_REF "Verbal Table" TAB_VERB 3 0 "Standard" 1 "Alternate 1" 2 "Alt 1 + Std" DEFAULT_VALUE "UNKNOWN" /end COMPU_VTAB
/begin CHARACTERISTIC CRI_dilpct_slct5 "EGR diluent command{CRI_dilpct_slct5&0xff=0:Standard}{CRI_dilpct_slct5&0xff=1:Alternate 1}{CRI_dilpct_slct5&0xff=2:Alt 1 + Std}" VALUE 0x00170F0B /* @ECU_Address@CRI_dilpct_slct5@0x0100A3B0@ */ ECIPP_ALIGNMENT_UBYTE 255 CRI_dilpct_slct5_COMPU_VTAB 0 255 BIT_MASK 0xff /end CHARACTERISTIC
/begin COMPU_METHOD CRI_dilpct_slct5_COMPU_VTAB "Verbal Table" TAB_VERB "%.0" "list" COMPU_TAB_REF CRI_dilpct_slct5_COMPU_VTAB_REF /end COMPU_METHOD
/begin COMPU_VTAB CRI_dilpct_slct5_COMPU_VTAB_REF "Verbal Table" TAB_VERB 3 0 "Standard" 1 "Alternate 1" 2 "Alt 1 + Std" DEFAULT_VALUE "UNKNOWN" /end COMPU_VTAB
/begin CHARACTERISTIC CRI_dilpct_slct6 "EGR diluent command{CRI_dilpct_slct6&0xff=0:Standard}{CRI_dilpct_slct6&0xff=1:Alternate 1}{CRI_dilpct_slct6&0xff=2:Alt 1 + Std}" VALUE 0x00170F0C /* @ECU_Address@CRI_dilpct_slct6@0x0100A3B8@ */ ECIPP_ALIGNMENT_UBYTE 255 CRI_dilpct_slct6_COMPU_VTAB 0 255 BIT_MASK 0xff /end CHARACTERISTIC
/begin COMPU_METHOD CRI_dilpct_slct6_COMPU_VTAB "Verbal Table" TAB_VERB "%.0" "list" COMPU_TAB_REF CRI_dilpct_slct6_COMPU_VTAB_REF /end COMPU_METHOD
/begin COMPU_VTAB CRI_dilpct_slct6_COMPU_VTAB_REF "Verbal Table" TAB_VERB 3 0 "Standard" 1 "Alternate 1" 2 "Alt 1 + Std" DEFAULT_VALUE "UNKNOWN" /end COMPU_VTAB
/begin CHARACTERISTIC CRI_dilpct_slct7 "EGR diluent command{CRI_dilpct_slct7&0xff=0:Standard}{CRI_dilpct_slct7&0xff=1:Alternate 1}{CRI_dilpct_slct7&0xff=2:Alt 1 + Std}" VALUE 0x00170F0D /* @ECU_Address@CRI_dilpct_slct7@0x0100A3C0@ */ ECIPP_ALIGNMENT_UBYTE 255 CRI_dilpct_slct7_COMPU_VTAB 0 255 BIT_MASK 0xff /end CHARACTERISTIC
/begin COMPU_METHOD CRI_dilpct_slct7_COMPU_VTAB "Verbal Table" TAB_VERB "%.0" "list" COMPU_TAB_REF CRI_dilpct_slct7_COMPU_VTAB_REF /end COMPU_METHOD
/begin COMPU_VTAB CRI_dilpct_slct7_COMPU_VTAB_REF "Verbal Table" TAB_VERB 3 0 "Standard" 1 "Alternate 1" 2 "Alt 1 + Std" DEFAULT_VALUE "UNKNOWN" /end COMPU_VTAB
/begin CHARACTERISTIC CRI_Qpilot2_slct0 "Pilot 2 injection quantity{CRI_Qpilot2_slct0&0xff=0:Standard}{CRI_Qpilot2_slct0&0xff=1:Alternate 1}{CRI_Qpilot2_slct0&0xff=2:Alt 1 + Std}" VALUE 0x00170EA0 /* @ECU_Address@CRI_Qpilot2_slct0@0x0100A3C8@ */ ECIPP_ALIGNMENT_UBYTE 255 CRI_Qpilot2_slct0_COMPU_VTAB 0 255 BIT_MASK 0xff /end CHARACTERISTIC
/begin COMPU_METHOD CRI_Qpilot2_slct0_COMPU_VTAB "Verbal Table" TAB_VERB "%.0" "list" COMPU_TAB_REF CRI_Qpilot2_slct0_COMPU_VTAB_REF /end COMPU_METHOD
/begin COMPU_VTAB CRI_Qpilot2_slct0_COMPU_VTAB_REF "Verbal Table" TAB_VERB 3 0 "Standard" 1 "Alternate 1" 2 "Alt 1 + Std" DEFAULT_VALUE "UNKNOWN" /end COMPU_VTAB
/begin CHARACTERISTIC CRI_Qpilot2_slct1 "Pilot 2 injection quantity{CRI_Qpilot2_slct1&0xff=0:Standard}{CRI_Qpilot2_slct1&0xff=1:Alternate 1}{CRI_Qpilot2_slct1&0xff=2:Alt 1 + Std}" VALUE 0x00170EA1 /* @ECU_Address@CRI_Qpilot2_slct1@0x0100A3D0@ */ ECIPP_ALIGNMENT_UBYTE 255 CRI_Qpilot2_slct1_COMPU_VTAB 0 255 BIT_MASK 0xff /end CHARACTERISTIC
/begin COMPU_METHOD CRI_Qpilot2_slct1_COMPU_VTAB "Verbal Table" TAB_VERB "%.0" "list" COMPU_TAB_REF CRI_Qpilot2_slct1_COMPU_VTAB_REF /end COMPU_METHOD
/begin COMPU_VTAB CRI_Qpilot2_slct1_COMPU_VTAB_REF "Verbal Table" TAB_VERB 3 0 "Standard" 1 "Alternate 1" 2 "Alt 1 + Std" DEFAULT_VALUE "UNKNOWN" /end COMPU_VTAB
/begin CHARACTERISTIC CRI_Qpilot2_slct2 "Pilot 2 injection quantity{CRI_Qpilot2_slct2&0xff=0:Standard}{CRI_Qpilot2_slct2&0xff=1:Alternate 1}{CRI_Qpilot2_slct2&0xff=2:Alt 1 + Std}" VALUE 0x00170EA2 /* @ECU_Address@CRI_Qpilot2_slct2@0x0100A3D8@ */ ECIPP_ALIGNMENT_UBYTE 255 CRI_Qpilot2_slct2_COMPU_VTAB 0 255 BIT_MASK 0xff /end CHARACTERISTIC
/begin COMPU_METHOD CRI_Qpilot2_slct2_COMPU_VTAB "Verbal Table" TAB_VERB "%.0" "list" COMPU_TAB_REF CRI_Qpilot2_slct2_COMPU_VTAB_REF /end COMPU_METHOD
/begin COMPU_VTAB CRI_Qpilot2_slct2_COMPU_VTAB_REF "Verbal Table" TAB_VERB 3 0 "Standard" 1 "Alternate 1" 2 "Alt 1 + Std" DEFAULT_VALUE "UNKNOWN" /end COMPU_VTAB
/begin CHARACTERISTIC CRI_Qpilot2_slct3 "Pilot 2 injection quantity{CRI_Qpilot2_slct3&0xff=0:Standard}{CRI_Qpilot2_slct3&0xff=1:Alternate 1}{CRI_Qpilot2_slct3&0xff=2:Alt 1 + Std}" VALUE 0x00170EA3 /* @ECU_Address@CRI_Qpilot2_slct3@0x0100A3E0@ */ ECIPP_ALIGNMENT_UBYTE 255 CRI_Qpilot2_slct3_COMPU_VTAB 0 255 BIT_MASK 0xff /end CHARACTERISTIC
/begin COMPU_METHOD CRI_Qpilot2_slct3_COMPU_VTAB "Verbal Table" TAB_VERB "%.0" "list" COMPU_TAB_REF CRI_Qpilot2_slct3_COMPU_VTAB_REF /end COMPU_METHOD
/begin COMPU_VTAB CRI_Qpilot2_slct3_COMPU_VTAB_REF "Verbal Table" TAB_VERB 3 0 "Standard" 1 "Alternate 1" 2 "Alt 1 + Std" DEFAULT_VALUE "UNKNOWN" /end COMPU_VTAB
/begin CHARACTERISTIC CRI_Qpilot2_slct4 "Pilot 2 injection quantity{CRI_Qpilot2_slct4&0xff=0:Standard}{CRI_Qpilot2_slct4&0xff=1:Alternate 1}{CRI_Qpilot2_slct4&0xff=2:Alt 1 + Std}" VALUE 0x00170EA4 /* @ECU_Address@CRI_Qpilot2_slct4@0x0100A3E8@ */ ECIPP_ALIGNMENT_UBYTE 255 CRI_Qpilot2_slct4_COMPU_VTAB 0 255 BIT_MASK 0xff /end CHARACTERISTIC
/begin COMPU_METHOD CRI_Qpilot2_slct4_COMPU_VTAB "Verbal Table" TAB_VERB "%.0" "list" COMPU_TAB_REF CRI_Qpilot2_slct4_COMPU_VTAB_REF /end COMPU_METHOD
/begin COMPU_VTAB CRI_Qpilot2_slct4_COMPU_VTAB_REF "Verbal Table" TAB_VERB 3 0 "Standard" 1 "Alternate 1" 2 "Alt 1 + Std" DEFAULT_VALUE "UNKNOWN" /end COMPU_VTAB
/begin CHARACTERISTIC CRI_Qpilot2_slct5 "Pilot 2 injection quantity{CRI_Qpilot2_slct5&0xff=0:Standard}{CRI_Qpilot2_slct5&0xff=1:Alternate 1}{CRI_Qpilot2_slct5&0xff=2:Alt 1 + Std}" VALUE 0x00170EA5 /* @ECU_Address@CRI_Qpilot2_slct5@0x0100A3F0@ */ ECIPP_ALIGNMENT_UBYTE 255 CRI_Qpilot2_slct5_COMPU_VTAB 0 255 BIT_MASK 0xff /end CHARACTERISTIC
/begin COMPU_METHOD CRI_Qpilot2_slct5_COMPU_VTAB "Verbal Table" TAB_VERB "%.0" "list" COMPU_TAB_REF CRI_Qpilot2_slct5_COMPU_VTAB_REF /end COMPU_METHOD
/begin COMPU_VTAB CRI_Qpilot2_slct5_COMPU_VTAB_REF "Verbal Table" TAB_VERB 3 0 "Standard" 1 "Alternate 1" 2 "Alt 1 + Std" DEFAULT_VALUE "UNKNOWN" /end COMPU_VTAB
/begin CHARACTERISTIC CRI_Qpilot2_slct6 "Pilot 2 injection quantity{CRI_Qpilot2_slct6&0xff=0:Standard}{CRI_Qpilot2_slct6&0xff=1:Alternate 1}{CRI_Qpilot2_slct6&0xff=2:Alt 1 + Std}" VALUE 0x00170EA6 /* @ECU_Address@CRI_Qpilot2_slct6@0x0100A3F8@ */ ECIPP_ALIGNMENT_UBYTE 255 CRI_Qpilot2_slct6_COMPU_VTAB 0 255 BIT_MASK 0xff /end CHARACTERISTIC
/begin COMPU_METHOD CRI_Qpilot2_slct6_COMPU_VTAB "Verbal Table" TAB_VERB "%.0" "list" COMPU_TAB_REF CRI_Qpilot2_slct6_COMPU_VTAB_REF /end COMPU_METHOD
/begin COMPU_VTAB CRI_Qpilot2_slct6_COMPU_VTAB_REF "Verbal Table" TAB_VERB 3 0 "Standard" 1 "Alternate 1" 2 "Alt 1 + Std" DEFAULT_VALUE "UNKNOWN" /end COMPU_VTAB
/begin CHARACTERISTIC CRI_Qpilot2_slct7 "Pilot 2 injection quantity{CRI_Qpilot2_slct7&0xff=0:Standard}{CRI_Qpilot2_slct7&0xff=1:Alternate 1}{CRI_Qpilot2_slct7&0xff=2:Alt 1 + Std}" VALUE 0x00170EA7 /* @ECU_Address@CRI_Qpilot2_slct7@0x0100A400@ */ ECIPP_ALIGNMENT_UBYTE 255 CRI_Qpilot2_slct7_COMPU_VTAB 0 255 BIT_MASK 0xff /end CHARACTERISTIC
/begin COMPU_METHOD CRI_Qpilot2_slct7_COMPU_VTAB "Verbal Table" TAB_VERB "%.0" "list" COMPU_TAB_REF CRI_Qpilot2_slct7_COMPU_VTAB_REF /end COMPU_METHOD
/begin COMPU_VTAB CRI_Qpilot2_slct7_COMPU_VTAB_REF "Verbal Table" TAB_VERB 3 0 "Standard" 1 "Alternate 1" 2 "Alt 1 + Std" DEFAULT_VALUE "UNKNOWN" /end COMPU_VTAB
/begin CHARACTERISTIC CRI_Qpilot1_slct0 "Pilot 1 injection quantity{CRI_Qpilot1_slct0&0xff=0:Standard}{CRI_Qpilot1_slct0&0xff=1:Alternate 1}{CRI_Qpilot1_slct0&0xff=2:Alt 1 + Std}" VALUE 0x00170E96 /* @ECU_Address@CRI_Qpilot1_slct0@0x0100A408@ */ ECIPP_ALIGNMENT_UBYTE 255 CRI_Qpilot1_slct0_COMPU_VTAB 0 255 BIT_MASK 0xff /end CHARACTERISTIC
/begin COMPU_METHOD CRI_Qpilot1_slct0_COMPU_VTAB "Verbal Table" TAB_VERB "%.0" "list" COMPU_TAB_REF CRI_Qpilot1_slct0_COMPU_VTAB_REF /end COMPU_METHOD
/begin COMPU_VTAB CRI_Qpilot1_slct0_COMPU_VTAB_REF "Verbal Table" TAB_VERB 3 0 "Standard" 1 "Alternate 1" 2 "Alt 1 + Std" DEFAULT_VALUE "UNKNOWN" /end COMPU_VTAB
/begin CHARACTERISTIC CRI_Qpilot1_slct1 "Pilot 1 injection quantity{CRI_Qpilot1_slct1&0xff=0:Standard}{CRI_Qpilot1_slct1&0xff=1:Alternate 1}{CRI_Qpilot1_slct1&0xff=2:Alt 1 + Std}" VALUE 0x00170E97 /* @ECU_Address@CRI_Qpilot1_slct1@0x0100A410@ */ ECIPP_ALIGNMENT_UBYTE 255 CRI_Qpilot1_slct1_COMPU_VTAB 0 255 BIT_MASK 0xff /end CHARACTERISTIC
/begin COMPU_METHOD CRI_Qpilot1_slct1_COMPU_VTAB "Verbal Table" TAB_VERB "%.0" "list" COMPU_TAB_REF CRI_Qpilot1_slct1_COMPU_VTAB_REF /end COMPU_METHOD
/begin COMPU_VTAB CRI_Qpilot1_slct1_COMPU_VTAB_REF "Verbal Table" TAB_VERB 3 0 "Standard" 1 "Alternate 1" 2 "Alt 1 + Std" DEFAULT_VALUE "UNKNOWN" /end COMPU_VTAB
/begin CHARACTERISTIC CRI_Qpilot1_slct2 "Pilot 1 injection quantity{CRI_Qpilot1_slct2&0xff=0:Standard}{CRI_Qpilot1_slct2&0xff=1:Alternate 1}{CRI_Qpilot1_slct2&0xff=2:Alt 1 + Std}" VALUE 0x00170E98 /* @ECU_Address@CRI_Qpilot1_slct2@0x0100A418@ */ ECIPP_ALIGNMENT_UBYTE 255 CRI_Qpilot1_slct2_COMPU_VTAB 0 255 BIT_MASK 0xff /end CHARACTERISTIC
/begin COMPU_METHOD CRI_Qpilot1_slct2_COMPU_VTAB "Verbal Table" TAB_VERB "%.0" "list" COMPU_TAB_REF CRI_Qpilot1_slct2_COMPU_VTAB_REF /end COMPU_METHOD
/begin COMPU_VTAB CRI_Qpilot1_slct2_COMPU_VTAB_REF "Verbal Table" TAB_VERB 3 0 "Standard" 1 "Alternate 1" 2 "Alt 1 + Std" DEFAULT_VALUE "UNKNOWN" /end COMPU_VTAB
/begin CHARACTERISTIC CRI_Qpilot1_slct3 "Pilot 1 injection quantity{CRI_Qpilot1_slct3&0xff=0:Standard}{CRI_Qpilot1_slct3&0xff=1:Alternate 1}{CRI_Qpilot1_slct3&0xff=2:Alt 1 + Std}" VALUE 0x00170E99 /* @ECU_Address@CRI_Qpilot1_slct3@0x0100A420@ */ ECIPP_ALIGNMENT_UBYTE 255 CRI_Qpilot1_slct3_COMPU_VTAB 0 255 BIT_MASK 0xff /end CHARACTERISTIC
/begin COMPU_METHOD CRI_Qpilot1_slct3_COMPU_VTAB "Verbal Table" TAB_VERB "%.0" "list" COMPU_TAB_REF CRI_Qpilot1_slct3_COMPU_VTAB_REF /end COMPU_METHOD
/begin COMPU_VTAB CRI_Qpilot1_slct3_COMPU_VTAB_REF "Verbal Table" TAB_VERB 3 0 "Standard" 1 "Alternate 1" 2 "Alt 1 + Std" DEFAULT_VALUE "UNKNOWN" /end COMPU_VTAB
/begin CHARACTERISTIC CRI_Qpilot1_slct4 "Pilot 1 injection quantity{CRI_Qpilot1_slct4&0xff=0:Standard}{CRI_Qpilot1_slct4&0xff=1:Alternate 1}{CRI_Qpilot1_slct4&0xff=2:Alt 1 + Std}" VALUE 0x00170E9A /* @ECU_Address@CRI_Qpilot1_slct4@0x0100A428@ */ ECIPP_ALIGNMENT_UBYTE 255 CRI_Qpilot1_slct4_COMPU_VTAB 0 255 BIT_MASK 0xff /end CHARACTERISTIC
/begin COMPU_METHOD CRI_Qpilot1_slct4_COMPU_VTAB "Verbal Table" TAB_VERB "%.0" "list" COMPU_TAB_REF CRI_Qpilot1_slct4_COMPU_VTAB_REF /end COMPU_METHOD
/begin COMPU_VTAB CRI_Qpilot1_slct4_COMPU_VTAB_REF "Verbal Table" TAB_VERB 3 0 "Standard" 1 "Alternate 1" 2 "Alt 1 + Std" DEFAULT_VALUE "UNKNOWN" /end COMPU_VTAB
/begin CHARACTERISTIC CRI_Qpilot1_slct5 "Pilot 1 injection quantity{CRI_Qpilot1_slct5&0xff=0:Standard}{CRI_Qpilot1_slct5&0xff=1:Alternate 1}{CRI_Qpilot1_slct5&0xff=2:Alt 1 + Std}" VALUE 0x00170E9B /* @ECU_Address@CRI_Qpilot1_slct5@0x0100A430@ */ ECIPP_ALIGNMENT_UBYTE 255 CRI_Qpilot1_slct5_COMPU_VTAB 0 255 BIT_MASK 0xff /end CHARACTERISTIC
/begin COMPU_METHOD CRI_Qpilot1_slct5_COMPU_VTAB "Verbal Table" TAB_VERB "%.0" "list" COMPU_TAB_REF CRI_Qpilot1_slct5_COMPU_VTAB_REF /end COMPU_METHOD
/begin COMPU_VTAB CRI_Qpilot1_slct5_COMPU_VTAB_REF "Verbal Table" TAB_VERB 3 0 "Standard" 1 "Alternate 1" 2 "Alt 1 + Std" DEFAULT_VALUE "UNKNOWN" /end COMPU_VTAB
/begin CHARACTERISTIC CRI_Qpilot1_slct6 "Pilot 1 injection quantity{CRI_Qpilot1_slct6&0xff=0:Standard}{CRI_Qpilot1_slct6&0xff=1:Alternate 1}{CRI_Qpilot1_slct6&0xff=2:Alt 1 + Std}" VALUE 0x00170E9C /* @ECU_Address@CRI_Qpilot1_slct6@0x0100A438@ */ ECIPP_ALIGNMENT_UBYTE 255 CRI_Qpilot1_slct6_COMPU_VTAB 0 255 BIT_MASK 0xff /end CHARACTERISTIC
/begin COMPU_METHOD CRI_Qpilot1_slct6_COMPU_VTAB "Verbal Table" TAB_VERB "%.0" "list" COMPU_TAB_REF CRI_Qpilot1_slct6_COMPU_VTAB_REF /end COMPU_METHOD
/begin COMPU_VTAB CRI_Qpilot1_slct6_COMPU_VTAB_REF "Verbal Table" TAB_VERB 3 0 "Standard" 1 "Alternate 1" 2 "Alt 1 + Std" DEFAULT_VALUE "UNKNOWN" /end COMPU_VTAB
/begin CHARACTERISTIC CRI_Qpilot1_slct7 "Pilot 1 injection quantity{CRI_Qpilot1_slct7&0xff=0:Standard}{CRI_Qpilot1_slct7&0xff=1:Alternate 1}{CRI_Qpilot1_slct7&0xff=2:Alt 1 + Std}" VALUE 0x00170E9D /* @ECU_Address@CRI_Qpilot1_slct7@0x0100A440@ */ ECIPP_ALIGNMENT_UBYTE 255 CRI_Qpilot1_slct7_COMPU_VTAB 0 255 BIT_MASK 0xff /end CHARACTERISTIC
/begin COMPU_METHOD CRI_Qpilot1_slct7_COMPU_VTAB "Verbal Table" TAB_VERB "%.0" "list" COMPU_TAB_REF CRI_Qpilot1_slct7_COMPU_VTAB_REF /end COMPU_METHOD
/begin COMPU_VTAB CRI_Qpilot1_slct7_COMPU_VTAB_REF "Verbal Table" TAB_VERB 3 0 "Standard" 1 "Alternate 1" 2 "Alt 1 + Std" DEFAULT_VALUE "UNKNOWN" /end COMPU_VTAB
/begin CHARACTERISTIC CRI_Qload_slct0 "Fuel load command{CRI_Qload_slct0&0xff=0:Standard}{CRI_Qload_slct0&0xff=1:Alternate 1}{CRI_Qload_slct0&0xff=2:Alt 1 + Std}{CRI_Qload_slct0&0xff=3:Alternate 2}{CRI_Qload_slct0&0xff=4:Alt 2 + Std}" VALUE 0x00170E8C /* @ECU_Address@CRI_Qload_slct0@0x0100A448@ */ ECIPP_ALIGNMENT_UBYTE 255 CRI_Qload_slct0_COMPU_VTAB 0 255 BIT_MASK 0xff /end CHARACTERISTIC
/begin COMPU_METHOD CRI_Qload_slct0_COMPU_VTAB "Verbal Table" TAB_VERB "%.0" "list" COMPU_TAB_REF CRI_Qload_slct0_COMPU_VTAB_REF /end COMPU_METHOD
/begin COMPU_VTAB CRI_Qload_slct0_COMPU_VTAB_REF "Verbal Table" TAB_VERB 5 0 "Standard" 1 "Alternate 1" 2 "Alt 1 + Std" 3 "Alternate 2" 4 "Alt 2 + Std" DEFAULT_VALUE "UNKNOWN" /end COMPU_VTAB
/begin CHARACTERISTIC CRI_Qload_slct1 "Fuel load command{CRI_Qload_slct1&0xff=0:Standard}{CRI_Qload_slct1&0xff=1:Alternate 1}{CRI_Qload_slct1&0xff=2:Alt 1 + Std}{CRI_Qload_slct1&0xff=3:Alternate 2}{CRI_Qload_slct1&0xff=4:Alt 2 + Std}" VALUE 0x00170E8D /* @ECU_Address@CRI_Qload_slct1@0x0100A450@ */ ECIPP_ALIGNMENT_UBYTE 255 CRI_Qload_slct1_COMPU_VTAB 0 255 BIT_MASK 0xff /end CHARACTERISTIC
/begin COMPU_METHOD CRI_Qload_slct1_COMPU_VTAB "Verbal Table" TAB_VERB "%.0" "list" COMPU_TAB_REF CRI_Qload_slct1_COMPU_VTAB_REF /end COMPU_METHOD
/begin COMPU_VTAB CRI_Qload_slct1_COMPU_VTAB_REF "Verbal Table" TAB_VERB 5 0 "Standard" 1 "Alternate 1" 2 "Alt 1 + Std" 3 "Alternate 2" 4 "Alt 2 + Std" DEFAULT_VALUE "UNKNOWN" /end COMPU_VTAB
/begin CHARACTERISTIC CRI_Qload_slct2 "Fuel load command{CRI_Qload_slct2&0xff=0:Standard}{CRI_Qload_slct2&0xff=1:Alternate 1}{CRI_Qload_slct2&0xff=2:Alt 1 + Std}{CRI_Qload_slct2&0xff=3:Alternate 2}{CRI_Qload_slct2&0xff=4:Alt 2 + Std}" VALUE 0x00170E8E /* @ECU_Address@CRI_Qload_slct2@0x0100A458@ */ ECIPP_ALIGNMENT_UBYTE 255 CRI_Qload_slct2_COMPU_VTAB 0 255 BIT_MASK 0xff /end CHARACTERISTIC
/begin COMPU_METHOD CRI_Qload_slct2_COMPU_VTAB "Verbal Table" TAB_VERB "%.0" "list" COMPU_TAB_REF CRI_Qload_slct2_COMPU_VTAB_REF /end COMPU_METHOD
/begin COMPU_VTAB CRI_Qload_slct2_COMPU_VTAB_REF "Verbal Table" TAB_VERB 5 0 "Standard" 1 "Alternate 1" 2 "Alt 1 + Std" 3 "Alternate 2" 4 "Alt 2 + Std" DEFAULT_VALUE "UNKNOWN" /end COMPU_VTAB
/begin CHARACTERISTIC CRI_Qload_slct3 "Fuel load command{CRI_Qload_slct3&0xff=0:Standard}{CRI_Qload_slct3&0xff=1:Alternate 1}{CRI_Qload_slct3&0xff=2:Alt 1 + Std}{CRI_Qload_slct3&0xff=3:Alternate 2}{CRI_Qload_slct3&0xff=4:Alt 2 + Std}" VALUE 0x00170E8F /* @ECU_Address@CRI_Qload_slct3@0x0100A460@ */ ECIPP_ALIGNMENT_UBYTE 255 CRI_Qload_slct3_COMPU_VTAB 0 255 BIT_MASK 0xff /end CHARACTERISTIC
/begin COMPU_METHOD CRI_Qload_slct3_COMPU_VTAB "Verbal Table" TAB_VERB "%.0" "list" COMPU_TAB_REF CRI_Qload_slct3_COMPU_VTAB_REF /end COMPU_METHOD
/begin COMPU_VTAB CRI_Qload_slct3_COMPU_VTAB_REF "Verbal Table" TAB_VERB 5 0 "Standard" 1 "Alternate 1" 2 "Alt 1 + Std" 3 "Alternate 2" 4 "Alt 2 + Std" DEFAULT_VALUE "UNKNOWN" /end COMPU_VTAB
/begin CHARACTERISTIC CRI_Qload_slct4 "Fuel load command{CRI_Qload_slct4&0xff=0:Standard}{CRI_Qload_slct4&0xff=1:Alternate 1}{CRI_Qload_slct4&0xff=2:Alt 1 + Std}{CRI_Qload_slct4&0xff=3:Alternate 2}{CRI_Qload_slct4&0xff=4:Alt 2 + Std}" VALUE 0x00170E90 /* @ECU_Address@CRI_Qload_slct4@0x0100A468@ */ ECIPP_ALIGNMENT_UBYTE 255 CRI_Qload_slct4_COMPU_VTAB 0 255 BIT_MASK 0xff /end CHARACTERISTIC
/begin COMPU_METHOD CRI_Qload_slct4_COMPU_VTAB "Verbal Table" TAB_VERB "%.0" "list" COMPU_TAB_REF CRI_Qload_slct4_COMPU_VTAB_REF /end COMPU_METHOD
/begin COMPU_VTAB CRI_Qload_slct4_COMPU_VTAB_REF "Verbal Table" TAB_VERB 5 0 "Standard" 1 "Alternate 1" 2 "Alt 1 + Std" 3 "Alternate 2" 4 "Alt 2 + Std" DEFAULT_VALUE "UNKNOWN" /end COMPU_VTAB
/begin CHARACTERISTIC CRI_Qload_slct5 "Fuel load command{CRI_Qload_slct5&0xff=0:Standard}{CRI_Qload_slct5&0xff=1:Alternate 1}{CRI_Qload_slct5&0xff=2:Alt 1 + Std}{CRI_Qload_slct5&0xff=3:Alternate 2}{CRI_Qload_slct5&0xff=4:Alt 2 + Std}" VALUE 0x00170E91 /* @ECU_Address@CRI_Qload_slct5@0x0100A470@ */ ECIPP_ALIGNMENT_UBYTE 255 CRI_Qload_slct5_COMPU_VTAB 0 255 BIT_MASK 0xff /end CHARACTERISTIC
/begin COMPU_METHOD CRI_Qload_slct5_COMPU_VTAB "Verbal Table" TAB_VERB "%.0" "list" COMPU_TAB_REF CRI_Qload_slct5_COMPU_VTAB_REF /end COMPU_METHOD
/begin COMPU_VTAB CRI_Qload_slct5_COMPU_VTAB_REF "Verbal Table" TAB_VERB 5 0 "Standard" 1 "Alternate 1" 2 "Alt 1 + Std" 3 "Alternate 2" 4 "Alt 2 + Std" DEFAULT_VALUE "UNKNOWN" /end COMPU_VTAB
/begin CHARACTERISTIC CRI_Qload_slct6 "Fuel load command{CRI_Qload_slct6&0xff=0:Standard}{CRI_Qload_slct6&0xff=1:Alternate 1}{CRI_Qload_slct6&0xff=2:Alt 1 + Std}{CRI_Qload_slct6&0xff=3:Alternate 2}{CRI_Qload_slct6&0xff=4:Alt 2 + Std}" VALUE 0x00170E92 /* @ECU_Address@CRI_Qload_slct6@0x0100A478@ */ ECIPP_ALIGNMENT_UBYTE 255 CRI_Qload_slct6_COMPU_VTAB 0 255 BIT_MASK 0xff /end CHARACTERISTIC
/begin COMPU_METHOD CRI_Qload_slct6_COMPU_VTAB "Verbal Table" TAB_VERB "%.0" "list" COMPU_TAB_REF CRI_Qload_slct6_COMPU_VTAB_REF /end COMPU_METHOD
/begin COMPU_VTAB CRI_Qload_slct6_COMPU_VTAB_REF "Verbal Table" TAB_VERB 5 0 "Standard" 1 "Alternate 1" 2 "Alt 1 + Std" 3 "Alternate 2" 4 "Alt 2 + Std" DEFAULT_VALUE "UNKNOWN" /end COMPU_VTAB
/begin CHARACTERISTIC CRI_Qload_slct7 "Fuel load command{CRI_Qload_slct7&0xff=0:Standard}{CRI_Qload_slct7&0xff=1:Alternate 1}{CRI_Qload_slct7&0xff=2:Alt 1 + Std}{CRI_Qload_slct7&0xff=3:Alternate 2}{CRI_Qload_slct7&0xff=4:Alt 2 + Std}" VALUE 0x00170E93 /* @ECU_Address@CRI_Qload_slct7@0x0100A480@ */ ECIPP_ALIGNMENT_UBYTE 255 CRI_Qload_slct7_COMPU_VTAB 0 255 BIT_MASK 0xff /end CHARACTERISTIC
/begin COMPU_METHOD CRI_Qload_slct7_COMPU_VTAB "Verbal Table" TAB_VERB "%.0" "list" COMPU_TAB_REF CRI_Qload_slct7_COMPU_VTAB_REF /end COMPU_METHOD
/begin COMPU_VTAB CRI_Qload_slct7_COMPU_VTAB_REF "Verbal Table" TAB_VERB 5 0 "Standard" 1 "Alternate 1" 2 "Alt 1 + Std" 3 "Alternate 2" 4 "Alt 2 + Std" DEFAULT_VALUE "UNKNOWN" /end COMPU_VTAB
/begin CHARACTERISTIC CRI_Qpost1_slct0 "Post 1 injection quantity{CRI_Qpost1_slct0&0xff=0:Standard}{CRI_Qpost1_slct0&0xff=1:Alternate 1}{CRI_Qpost1_slct0&0xff=2:Alt 1 + Std}" VALUE 0x00170EAA /* @ECU_Address@CRI_Qpost1_slct0@0x0100A488@ */ ECIPP_ALIGNMENT_UBYTE 255 CRI_Qpost1_slct0_COMPU_VTAB 0 255 BIT_MASK 0xff /end CHARACTERISTIC
/begin COMPU_METHOD CRI_Qpost1_slct0_COMPU_VTAB "Verbal Table" TAB_VERB "%.0" "list" COMPU_TAB_REF CRI_Qpost1_slct0_COMPU_VTAB_REF /end COMPU_METHOD
/begin COMPU_VTAB CRI_Qpost1_slct0_COMPU_VTAB_REF "Verbal Table" TAB_VERB 3 0 "Standard" 1 "Alternate 1" 2 "Alt 1 + Std" DEFAULT_VALUE "UNKNOWN" /end COMPU_VTAB
/begin CHARACTERISTIC CRI_Qpost1_slct1 "Post 1 injection quantity{CRI_Qpost1_slct1&0xff=0:Standard}{CRI_Qpost1_slct1&0xff=1:Alternate 1}{CRI_Qpost1_slct1&0xff=2:Alt 1 + Std}" VALUE 0x00170EAB /* @ECU_Address@CRI_Qpost1_slct1@0x0100A490@ */ ECIPP_ALIGNMENT_UBYTE 255 CRI_Qpost1_slct1_COMPU_VTAB 0 255 BIT_MASK 0xff /end CHARACTERISTIC
/begin COMPU_METHOD CRI_Qpost1_slct1_COMPU_VTAB "Verbal Table" TAB_VERB "%.0" "list" COMPU_TAB_REF CRI_Qpost1_slct1_COMPU_VTAB_REF /end COMPU_METHOD
/begin COMPU_VTAB CRI_Qpost1_slct1_COMPU_VTAB_REF "Verbal Table" TAB_VERB 3 0 "Standard" 1 "Alternate 1" 2 "Alt 1 + Std" DEFAULT_VALUE "UNKNOWN" /end COMPU_VTAB
/begin CHARACTERISTIC CRI_Qpost1_slct2 "Post 1 injection quantity{CRI_Qpost1_slct2&0xff=0:Standard}{CRI_Qpost1_slct2&0xff=1:Alternate 1}{CRI_Qpost1_slct2&0xff=2:Alt 1 + Std}" VALUE 0x00170EAC /* @ECU_Address@CRI_Qpost1_slct2@0x0100A498@ */ ECIPP_ALIGNMENT_UBYTE 255 CRI_Qpost1_slct2_COMPU_VTAB 0 255 BIT_MASK 0xff /end CHARACTERISTIC
/begin COMPU_METHOD CRI_Qpost1_slct2_COMPU_VTAB "Verbal Table" TAB_VERB "%.0" "list" COMPU_TAB_REF CRI_Qpost1_slct2_COMPU_VTAB_REF /end COMPU_METHOD
/begin COMPU_VTAB CRI_Qpost1_slct2_COMPU_VTAB_REF "Verbal Table" TAB_VERB 3 0 "Standard" 1 "Alternate 1" 2 "Alt 1 + Std" DEFAULT_VALUE "UNKNOWN" /end COMPU_VTAB
/begin CHARACTERISTIC CRI_Qpost1_slct3 "Post 1 injection quantity{CRI_Qpost1_slct3&0xff=0:Standard}{CRI_Qpost1_slct3&0xff=1:Alternate 1}{CRI_Qpost1_slct3&0xff=2:Alt 1 + Std}" VALUE 0x00170EAD /* @ECU_Address@CRI_Qpost1_slct3@0x0100A4A0@ */ ECIPP_ALIGNMENT_UBYTE 255 CRI_Qpost1_slct3_COMPU_VTAB 0 255 BIT_MASK 0xff /end CHARACTERISTIC
/begin COMPU_METHOD CRI_Qpost1_slct3_COMPU_VTAB "Verbal Table" TAB_VERB "%.0" "list" COMPU_TAB_REF CRI_Qpost1_slct3_COMPU_VTAB_REF /end COMPU_METHOD
/begin COMPU_VTAB CRI_Qpost1_slct3_COMPU_VTAB_REF "Verbal Table" TAB_VERB 3 0 "Standard" 1 "Alternate 1" 2 "Alt 1 + Std" DEFAULT_VALUE "UNKNOWN" /end COMPU_VTAB
/begin CHARACTERISTIC CRI_Qpost1_slct4 "Post 1 injection quantity{CRI_Qpost1_slct4&0xff=0:Standard}{CRI_Qpost1_slct4&0xff=1:Alternate 1}{CRI_Qpost1_slct4&0xff=2:Alt 1 + Std}" VALUE 0x00170EAE /* @ECU_Address@CRI_Qpost1_slct4@0x0100A4A8@ */ ECIPP_ALIGNMENT_UBYTE 255 CRI_Qpost1_slct4_COMPU_VTAB 0 255 BIT_MASK 0xff /end CHARACTERISTIC
/begin COMPU_METHOD CRI_Qpost1_slct4_COMPU_VTAB "Verbal Table" TAB_VERB "%.0" "list" COMPU_TAB_REF CRI_Qpost1_slct4_COMPU_VTAB_REF /end COMPU_METHOD
/begin COMPU_VTAB CRI_Qpost1_slct4_COMPU_VTAB_REF "Verbal Table" TAB_VERB 3 0 "Standard" 1 "Alternate 1" 2 "Alt 1 + Std" DEFAULT_VALUE "UNKNOWN" /end COMPU_VTAB
/begin CHARACTERISTIC CRI_Qpost1_slct5 "Post 1 injection quantity{CRI_Qpost1_slct5&0xff=0:Standard}{CRI_Qpost1_slct5&0xff=1:Alternate 1}{CRI_Qpost1_slct5&0xff=2:Alt 1 + Std}" VALUE 0x00170EAF /* @ECU_Address@CRI_Qpost1_slct5@0x0100A4B0@ */ ECIPP_ALIGNMENT_UBYTE 255 CRI_Qpost1_slct5_COMPU_VTAB 0 255 BIT_MASK 0xff /end CHARACTERISTIC
/begin COMPU_METHOD CRI_Qpost1_slct5_COMPU_VTAB "Verbal Table" TAB_VERB "%.0" "list" COMPU_TAB_REF CRI_Qpost1_slct5_COMPU_VTAB_REF /end COMPU_METHOD
/begin COMPU_VTAB CRI_Qpost1_slct5_COMPU_VTAB_REF "Verbal Table" TAB_VERB 3 0 "Standard" 1 "Alternate 1" 2 "Alt 1 + Std" DEFAULT_VALUE "UNKNOWN" /end COMPU_VTAB
/begin CHARACTERISTIC CRI_Qpost1_slct6 "Post 1 injection quantity{CRI_Qpost1_slct6&0xff=0:Standard}{CRI_Qpost1_slct6&0xff=1:Alternate 1}{CRI_Qpost1_slct6&0xff=2:Alt 1 + Std}" VALUE 0x00170EB0 /* @ECU_Address@CRI_Qpost1_slct6@0x0100A4B8@ */ ECIPP_ALIGNMENT_UBYTE 255 CRI_Qpost1_slct6_COMPU_VTAB 0 255 BIT_MASK 0xff /end CHARACTERISTIC
/begin COMPU_METHOD CRI_Qpost1_slct6_COMPU_VTAB "Verbal Table" TAB_VERB "%.0" "list" COMPU_TAB_REF CRI_Qpost1_slct6_COMPU_VTAB_REF /end COMPU_METHOD
/begin COMPU_VTAB CRI_Qpost1_slct6_COMPU_VTAB_REF "Verbal Table" TAB_VERB 3 0 "Standard" 1 "Alternate 1" 2 "Alt 1 + Std" DEFAULT_VALUE "UNKNOWN" /end COMPU_VTAB
/begin CHARACTERISTIC CRI_Qpost1_slct7 "Post 1 injection quantity{CRI_Qpost1_slct7&0xff=0:Standard}{CRI_Qpost1_slct7&0xff=1:Alternate 1}{CRI_Qpost1_slct7&0xff=2:Alt 1 + Std}" VALUE 0x00170EB1 /* @ECU_Address@CRI_Qpost1_slct7@0x0100A4C0@ */ ECIPP_ALIGNMENT_UBYTE 255 CRI_Qpost1_slct7_COMPU_VTAB 0 255 BIT_MASK 0xff /end CHARACTERISTIC
/begin COMPU_METHOD CRI_Qpost1_slct7_COMPU_VTAB "Verbal Table" TAB_VERB "%.0" "list" COMPU_TAB_REF CRI_Qpost1_slct7_COMPU_VTAB_REF /end COMPU_METHOD
/begin COMPU_VTAB CRI_Qpost1_slct7_COMPU_VTAB_REF "Verbal Table" TAB_VERB 3 0 "Standard" 1 "Alternate 1" 2 "Alt 1 + Std" DEFAULT_VALUE "UNKNOWN" /end COMPU_VTAB
/begin CHARACTERISTIC CRI_Qpost2_slct0 "Post 2 injection quantity{CRI_Qpost2_slct0&0xff=0:Standard}{CRI_Qpost2_slct0&0xff=1:Alternate 1}{CRI_Qpost2_slct0&0xff=2:Alt 1 + Std}" VALUE 0x00170EB4 /* @ECU_Address@CRI_Qpost2_slct0@0x0100A4C8@ */ ECIPP_ALIGNMENT_UBYTE 255 CRI_Qpost2_slct0_COMPU_VTAB 0 255 BIT_MASK 0xff /end CHARACTERISTIC
/begin COMPU_METHOD CRI_Qpost2_slct0_COMPU_VTAB "Verbal Table" TAB_VERB "%.0" "list" COMPU_TAB_REF CRI_Qpost2_slct0_COMPU_VTAB_REF /end COMPU_METHOD
/begin COMPU_VTAB CRI_Qpost2_slct0_COMPU_VTAB_REF "Verbal Table" TAB_VERB 3 0 "Standard" 1 "Alternate 1" 2 "Alt 1 + Std" DEFAULT_VALUE "UNKNOWN" /end COMPU_VTAB
/begin CHARACTERISTIC CRI_Qpost2_slct1 "Post 2 injection quantity{CRI_Qpost2_slct1&0xff=0:Standard}{CRI_Qpost2_slct1&0xff=1:Alternate 1}{CRI_Qpost2_slct1&0xff=2:Alt 1 + Std}" VALUE 0x00170EB5 /* @ECU_Address@CRI_Qpost2_slct1@0x0100A4D0@ */ ECIPP_ALIGNMENT_UBYTE 255 CRI_Qpost2_slct1_COMPU_VTAB 0 255 BIT_MASK 0xff /end CHARACTERISTIC
/begin COMPU_METHOD CRI_Qpost2_slct1_COMPU_VTAB "Verbal Table" TAB_VERB "%.0" "list" COMPU_TAB_REF CRI_Qpost2_slct1_COMPU_VTAB_REF /end COMPU_METHOD
/begin COMPU_VTAB CRI_Qpost2_slct1_COMPU_VTAB_REF "Verbal Table" TAB_VERB 3 0 "Standard" 1 "Alternate 1" 2 "Alt 1 + Std" DEFAULT_VALUE "UNKNOWN" /end COMPU_VTAB
/begin CHARACTERISTIC CRI_Qpost2_slct2 "Post 2 injection quantity{CRI_Qpost2_slct2&0xff=0:Standard}{CRI_Qpost2_slct2&0xff=1:Alternate 1}{CRI_Qpost2_slct2&0xff=2:Alt 1 + Std}" VALUE 0x00170EB6 /* @ECU_Address@CRI_Qpost2_slct2@0x0100A4D8@ */ ECIPP_ALIGNMENT_UBYTE 255 CRI_Qpost2_slct2_COMPU_VTAB 0 255 BIT_MASK 0xff /end CHARACTERISTIC
/begin COMPU_METHOD CRI_Qpost2_slct2_COMPU_VTAB "Verbal Table" TAB_VERB "%.0" "list" COMPU_TAB_REF CRI_Qpost2_slct2_COMPU_VTAB_REF /end COMPU_METHOD
/begin COMPU_VTAB CRI_Qpost2_slct2_COMPU_VTAB_REF "Verbal Table" TAB_VERB 3 0 "Standard" 1 "Alternate 1" 2 "Alt 1 + Std" DEFAULT_VALUE "UNKNOWN" /end COMPU_VTAB
/begin CHARACTERISTIC CRI_Qpost2_slct3 "Post 2 injection quantity{CRI_Qpost2_slct3&0xff=0:Standard}{CRI_Qpost2_slct3&0xff=1:Alternate 1}{CRI_Qpost2_slct3&0xff=2:Alt 1 + Std}" VALUE 0x00170EB7 /* @ECU_Address@CRI_Qpost2_slct3@0x0100A4E0@ */ ECIPP_ALIGNMENT_UBYTE 255 CRI_Qpost2_slct3_COMPU_VTAB 0 255 BIT_MASK 0xff /end CHARACTERISTIC
/begin COMPU_METHOD CRI_Qpost2_slct3_COMPU_VTAB "Verbal Table" TAB_VERB "%.0" "list" COMPU_TAB_REF CRI_Qpost2_slct3_COMPU_VTAB_REF /end COMPU_METHOD
/begin COMPU_VTAB CRI_Qpost2_slct3_COMPU_VTAB_REF "Verbal Table" TAB_VERB 3 0 "Standard" 1 "Alternate 1" 2 "Alt 1 + Std" DEFAULT_VALUE "UNKNOWN" /end COMPU_VTAB
/begin CHARACTERISTIC CRI_Qpost2_slct4 "Post 2 injection quantity{CRI_Qpost2_slct4&0xff=0:Standard}{CRI_Qpost2_slct4&0xff=1:Alternate 1}{CRI_Qpost2_slct4&0xff=2:Alt 1 + Std}" VALUE 0x00170EB8 /* @ECU_Address@CRI_Qpost2_slct4@0x0100A4E8@ */ ECIPP_ALIGNMENT_UBYTE 255 CRI_Qpost2_slct4_COMPU_VTAB 0 255 BIT_MASK 0xff /end CHARACTERISTIC
/begin COMPU_METHOD CRI_Qpost2_slct4_COMPU_VTAB "Verbal Table" TAB_VERB "%.0" "list" COMPU_TAB_REF CRI_Qpost2_slct4_COMPU_VTAB_REF /end COMPU_METHOD
/begin COMPU_VTAB CRI_Qpost2_slct4_COMPU_VTAB_REF "Verbal Table" TAB_VERB 3 0 "Standard" 1 "Alternate 1" 2 "Alt 1 + Std" DEFAULT_VALUE "UNKNOWN" /end COMPU_VTAB
/begin CHARACTERISTIC CRI_Qpost2_slct5 "Post 2 injection quantity{CRI_Qpost2_slct5&0xff=0:Standard}{CRI_Qpost2_slct5&0xff=1:Alternate 1}{CRI_Qpost2_slct5&0xff=2:Alt 1 + Std}" VALUE 0x00170EB9 /* @ECU_Address@CRI_Qpost2_slct5@0x0100A4F0@ */ ECIPP_ALIGNMENT_UBYTE 255 CRI_Qpost2_slct5_COMPU_VTAB 0 255 BIT_MASK 0xff /end CHARACTERISTIC
/begin COMPU_METHOD CRI_Qpost2_slct5_COMPU_VTAB "Verbal Table" TAB_VERB "%.0" "list" COMPU_TAB_REF CRI_Qpost2_slct5_COMPU_VTAB_REF /end COMPU_METHOD
/begin COMPU_VTAB CRI_Qpost2_slct5_COMPU_VTAB_REF "Verbal Table" TAB_VERB 3 0 "Standard" 1 "Alternate 1" 2 "Alt 1 + Std" DEFAULT_VALUE "UNKNOWN" /end COMPU_VTAB
/begin CHARACTERISTIC CRI_Qpost2_slct6 "Post 2 injection quantity{CRI_Qpost2_slct6&0xff=0:Standard}{CRI_Qpost2_slct6&0xff=1:Alternate 1}{CRI_Qpost2_slct6&0xff=2:Alt 1 + Std}" VALUE 0x00170EBA /* @ECU_Address@CRI_Qpost2_slct6@0x0100A4F8@ */ ECIPP_ALIGNMENT_UBYTE 255 CRI_Qpost2_slct6_COMPU_VTAB 0 255 BIT_MASK 0xff /end CHARACTERISTIC
/begin COMPU_METHOD CRI_Qpost2_slct6_COMPU_VTAB "Verbal Table" TAB_VERB "%.0" "list" COMPU_TAB_REF CRI_Qpost2_slct6_COMPU_VTAB_REF /end COMPU_METHOD
/begin COMPU_VTAB CRI_Qpost2_slct6_COMPU_VTAB_REF "Verbal Table" TAB_VERB 3 0 "Standard" 1 "Alternate 1" 2 "Alt 1 + Std" DEFAULT_VALUE "UNKNOWN" /end COMPU_VTAB
/begin CHARACTERISTIC CRI_Qpost2_slct7 "Post 2 injection quantity{CRI_Qpost2_slct7&0xff=0:Standard}{CRI_Qpost2_slct7&0xff=1:Alternate 1}{CRI_Qpost2_slct7&0xff=2:Alt 1 + Std}" VALUE 0x00170EBB /* @ECU_Address@CRI_Qpost2_slct7@0x0100A500@ */ ECIPP_ALIGNMENT_UBYTE 255 CRI_Qpost2_slct7_COMPU_VTAB 0 255 BIT_MASK 0xff /end CHARACTERISTIC
/begin COMPU_METHOD CRI_Qpost2_slct7_COMPU_VTAB "Verbal Table" TAB_VERB "%.0" "list" COMPU_TAB_REF CRI_Qpost2_slct7_COMPU_VTAB_REF /end COMPU_METHOD
/begin COMPU_VTAB CRI_Qpost2_slct7_COMPU_VTAB_REF "Verbal Table" TAB_VERB 3 0 "Standard" 1 "Alternate 1" 2 "Alt 1 + Std" DEFAULT_VALUE "UNKNOWN" /end COMPU_VTAB
/begin CHARACTERISTIC CRI_Tpilot2_slct0 "Pilot 2 injection timing{CRI_Tpilot2_slct0&0xff=0:Standard}{CRI_Tpilot2_slct0&0xff=1:Alternate 1}{CRI_Tpilot2_slct0&0xff=2:Alt 1 + Std}" VALUE 0x00170ED3 /* @ECU_Address@CRI_Tpilot2_slct0@0x0100A508@ */ ECIPP_ALIGNMENT_UBYTE 255 CRI_Tpilot2_slct0_COMPU_VTAB 0 255 BIT_MASK 0xff /end CHARACTERISTIC
/begin COMPU_METHOD CRI_Tpilot2_slct0_COMPU_VTAB "Verbal Table" TAB_VERB "%.0" "list" COMPU_TAB_REF CRI_Tpilot2_slct0_COMPU_VTAB_REF /end COMPU_METHOD
/begin COMPU_VTAB CRI_Tpilot2_slct0_COMPU_VTAB_REF "Verbal Table" TAB_VERB 3 0 "Standard" 1 "Alternate 1" 2 "Alt 1 + Std" DEFAULT_VALUE "UNKNOWN" /end COMPU_VTAB
/begin CHARACTERISTIC CRI_Tpilot2_slct1 "Pilot 2 injection timing{CRI_Tpilot2_slct1&0xff=0:Standard}{CRI_Tpilot2_slct1&0xff=1:Alternate 1}{CRI_Tpilot2_slct1&0xff=2:Alt 1 + Std}" VALUE 0x00170ED4 /* @ECU_Address@CRI_Tpilot2_slct1@0x0100A510@ */ ECIPP_ALIGNMENT_UBYTE 255 CRI_Tpilot2_slct1_COMPU_VTAB 0 255 BIT_MASK 0xff /end CHARACTERISTIC
/begin COMPU_METHOD CRI_Tpilot2_slct1_COMPU_VTAB "Verbal Table" TAB_VERB "%.0" "list" COMPU_TAB_REF CRI_Tpilot2_slct1_COMPU_VTAB_REF /end COMPU_METHOD
/begin COMPU_VTAB CRI_Tpilot2_slct1_COMPU_VTAB_REF "Verbal Table" TAB_VERB 3 0 "Standard" 1 "Alternate 1" 2 "Alt 1 + Std" DEFAULT_VALUE "UNKNOWN" /end COMPU_VTAB
/begin CHARACTERISTIC CRI_Tpilot2_slct2 "Pilot 2 injection timing{CRI_Tpilot2_slct2&0xff=0:Standard}{CRI_Tpilot2_slct2&0xff=1:Alternate 1}{CRI_Tpilot2_slct2&0xff=2:Alt 1 + Std}" VALUE 0x00170ED5 /* @ECU_Address@CRI_Tpilot2_slct2@0x0100A518@ */ ECIPP_ALIGNMENT_UBYTE 255 CRI_Tpilot2_slct2_COMPU_VTAB 0 255 BIT_MASK 0xff /end CHARACTERISTIC
/begin COMPU_METHOD CRI_Tpilot2_slct2_COMPU_VTAB "Verbal Table" TAB_VERB "%.0" "list" COMPU_TAB_REF CRI_Tpilot2_slct2_COMPU_VTAB_REF /end COMPU_METHOD
/begin COMPU_VTAB CRI_Tpilot2_slct2_COMPU_VTAB_REF "Verbal Table" TAB_VERB 3 0 "Standard" 1 "Alternate 1" 2 "Alt 1 + Std" DEFAULT_VALUE "UNKNOWN" /end COMPU_VTAB
/begin CHARACTERISTIC CRI_Tpilot2_slct3 "Pilot 2 injection timing{CRI_Tpilot2_slct3&0xff=0:Standard}{CRI_Tpilot2_slct3&0xff=1:Alternate 1}{CRI_Tpilot2_slct3&0xff=2:Alt 1 + Std}" VALUE 0x00170ED6 /* @ECU_Address@CRI_Tpilot2_slct3@0x0100A520@ */ ECIPP_ALIGNMENT_UBYTE 255 CRI_Tpilot2_slct3_COMPU_VTAB 0 255 BIT_MASK 0xff /end CHARACTERISTIC
/begin COMPU_METHOD CRI_Tpilot2_slct3_COMPU_VTAB "Verbal Table" TAB_VERB "%.0" "list" COMPU_TAB_REF CRI_Tpilot2_slct3_COMPU_VTAB_REF /end COMPU_METHOD
/begin COMPU_VTAB CRI_Tpilot2_slct3_COMPU_VTAB_REF "Verbal Table" TAB_VERB 3 0 "Standard" 1 "Alternate 1" 2 "Alt 1 + Std" DEFAULT_VALUE "UNKNOWN" /end COMPU_VTAB
/begin CHARACTERISTIC CRI_Tpilot2_slct4 "Pilot 2 injection timing{CRI_Tpilot2_slct4&0xff=0:Standard}{CRI_Tpilot2_slct4&0xff=1:Alternate 1}{CRI_Tpilot2_slct4&0xff=2:Alt 1 + Std}" VALUE 0x00170ED7 /* @ECU_Address@CRI_Tpilot2_slct4@0x0100A528@ */ ECIPP_ALIGNMENT_UBYTE 255 CRI_Tpilot2_slct4_COMPU_VTAB 0 255 BIT_MASK 0xff /end CHARACTERISTIC
/begin COMPU_METHOD CRI_Tpilot2_slct4_COMPU_VTAB "Verbal Table" TAB_VERB "%.0" "list" COMPU_TAB_REF CRI_Tpilot2_slct4_COMPU_VTAB_REF /end COMPU_METHOD
/begin COMPU_VTAB CRI_Tpilot2_slct4_COMPU_VTAB_REF "Verbal Table" TAB_VERB 3 0 "Standard" 1 "Alternate 1" 2 "Alt 1 + Std" DEFAULT_VALUE "UNKNOWN" /end COMPU_VTAB
/begin CHARACTERISTIC CRI_Tpilot2_slct5 "Pilot 2 injection timing{CRI_Tpilot2_slct5&0xff=0:Standard}{CRI_Tpilot2_slct5&0xff=1:Alternate 1}{CRI_Tpilot2_slct5&0xff=2:Alt 1 + Std}" VALUE 0x00170ED8 /* @ECU_Address@CRI_Tpilot2_slct5@0x0100A530@ */ ECIPP_ALIGNMENT_UBYTE 255 CRI_Tpilot2_slct5_COMPU_VTAB 0 255 BIT_MASK 0xff /end CHARACTERISTIC
/begin COMPU_METHOD CRI_Tpilot2_slct5_COMPU_VTAB "Verbal Table" TAB_VERB "%.0" "list" COMPU_TAB_REF CRI_Tpilot2_slct5_COMPU_VTAB_REF /end COMPU_METHOD
/begin COMPU_VTAB CRI_Tpilot2_slct5_COMPU_VTAB_REF "Verbal Table" TAB_VERB 3 0 "Standard" 1 "Alternate 1" 2 "Alt 1 + Std" DEFAULT_VALUE "UNKNOWN" /end COMPU_VTAB
/begin CHARACTERISTIC CRI_Tpilot2_slct6 "Pilot 2 injection timing{CRI_Tpilot2_slct6&0xff=0:Standard}{CRI_Tpilot2_slct6&0xff=1:Alternate 1}{CRI_Tpilot2_slct6&0xff=2:Alt 1 + Std}" VALUE 0x00170ED9 /* @ECU_Address@CRI_Tpilot2_slct6@0x0100A538@ */ ECIPP_ALIGNMENT_UBYTE 255 CRI_Tpilot2_slct6_COMPU_VTAB 0 255 BIT_MASK 0xff /end CHARACTERISTIC
/begin COMPU_METHOD CRI_Tpilot2_slct6_COMPU_VTAB "Verbal Table" TAB_VERB "%.0" "list" COMPU_TAB_REF CRI_Tpilot2_slct6_COMPU_VTAB_REF /end COMPU_METHOD
/begin COMPU_VTAB CRI_Tpilot2_slct6_COMPU_VTAB_REF "Verbal Table" TAB_VERB 3 0 "Standard" 1 "Alternate 1" 2 "Alt 1 + Std" DEFAULT_VALUE "UNKNOWN" /end COMPU_VTAB
/begin CHARACTERISTIC CRI_Tpilot2_slct7 "Pilot 2 injection timing{CRI_Tpilot2_slct7&0xff=0:Standard}{CRI_Tpilot2_slct7&0xff=1:Alternate 1}{CRI_Tpilot2_slct7&0xff=2:Alt 1 + Std}" VALUE 0x00170EDA /* @ECU_Address@CRI_Tpilot2_slct7@0x0100A540@ */ ECIPP_ALIGNMENT_UBYTE 255 CRI_Tpilot2_slct7_COMPU_VTAB 0 255 BIT_MASK 0xff /end CHARACTERISTIC
/begin COMPU_METHOD CRI_Tpilot2_slct7_COMPU_VTAB "Verbal Table" TAB_VERB "%.0" "list" COMPU_TAB_REF CRI_Tpilot2_slct7_COMPU_VTAB_REF /end COMPU_METHOD
/begin COMPU_VTAB CRI_Tpilot2_slct7_COMPU_VTAB_REF "Verbal Table" TAB_VERB 3 0 "Standard" 1 "Alternate 1" 2 "Alt 1 + Std" DEFAULT_VALUE "UNKNOWN" /end COMPU_VTAB
/begin CHARACTERISTIC CRI_Tpilot1_slct0 "Pilot 1 injection timing{CRI_Tpilot1_slct0&0xff=0:Standard}{CRI_Tpilot1_slct0&0xff=1:Alternate 1}{CRI_Tpilot1_slct0&0xff=2:Alt 1 + Std}" VALUE 0x00170EC8 /* @ECU_Address@CRI_Tpilot1_slct0@0x0100A548@ */ ECIPP_ALIGNMENT_UBYTE 255 CRI_Tpilot1_slct0_COMPU_VTAB 0 255 BIT_MASK 0xff /end CHARACTERISTIC
/begin COMPU_METHOD CRI_Tpilot1_slct0_COMPU_VTAB "Verbal Table" TAB_VERB "%.0" "list" COMPU_TAB_REF CRI_Tpilot1_slct0_COMPU_VTAB_REF /end COMPU_METHOD
/begin COMPU_VTAB CRI_Tpilot1_slct0_COMPU_VTAB_REF "Verbal Table" TAB_VERB 3 0 "Standard" 1 "Alternate 1" 2 "Alt 1 + Std" DEFAULT_VALUE "UNKNOWN" /end COMPU_VTAB
/begin CHARACTERISTIC CRI_Tpilot1_slct1 "Pilot 1 injection timing{CRI_Tpilot1_slct1&0xff=0:Standard}{CRI_Tpilot1_slct1&0xff=1:Alternate 1}{CRI_Tpilot1_slct1&0xff=2:Alt 1 + Std}" VALUE 0x00170EC9 /* @ECU_Address@CRI_Tpilot1_slct1@0x0100A550@ */ ECIPP_ALIGNMENT_UBYTE 255 CRI_Tpilot1_slct1_COMPU_VTAB 0 255 BIT_MASK 0xff /end CHARACTERISTIC
/begin COMPU_METHOD CRI_Tpilot1_slct1_COMPU_VTAB "Verbal Table" TAB_VERB "%.0" "list" COMPU_TAB_REF CRI_Tpilot1_slct1_COMPU_VTAB_REF /end COMPU_METHOD
/begin COMPU_VTAB CRI_Tpilot1_slct1_COMPU_VTAB_REF "Verbal Table" TAB_VERB 3 0 "Standard" 1 "Alternate 1" 2 "Alt 1 + Std" DEFAULT_VALUE "UNKNOWN" /end COMPU_VTAB
/begin CHARACTERISTIC CRI_Tpilot1_slct2 "Pilot 1 injection timing{CRI_Tpilot1_slct2&0xff=0:Standard}{CRI_Tpilot1_slct2&0xff=1:Alternate 1}{CRI_Tpilot1_slct2&0xff=2:Alt 1 + Std}" VALUE 0x00170ECA /* @ECU_Address@CRI_Tpilot1_slct2@0x0100A558@ */ ECIPP_ALIGNMENT_UBYTE 255 CRI_Tpilot1_slct2_COMPU_VTAB 0 255 BIT_MASK 0xff /end CHARACTERISTIC
/begin COMPU_METHOD CRI_Tpilot1_slct2_COMPU_VTAB "Verbal Table" TAB_VERB "%.0" "list" COMPU_TAB_REF CRI_Tpilot1_slct2_COMPU_VTAB_REF /end COMPU_METHOD
/begin COMPU_VTAB CRI_Tpilot1_slct2_COMPU_VTAB_REF "Verbal Table" TAB_VERB 3 0 "Standard" 1 "Alternate 1" 2 "Alt 1 + Std" DEFAULT_VALUE "UNKNOWN" /end COMPU_VTAB
/begin CHARACTERISTIC CRI_Tpilot1_slct3 "Pilot 1 injection timing{CRI_Tpilot1_slct3&0xff=0:Standard}{CRI_Tpilot1_slct3&0xff=1:Alternate 1}{CRI_Tpilot1_slct3&0xff=2:Alt 1 + Std}" VALUE 0x00170ECB /* @ECU_Address@CRI_Tpilot1_slct3@0x0100A560@ */ ECIPP_ALIGNMENT_UBYTE 255 CRI_Tpilot1_slct3_COMPU_VTAB 0 255 BIT_MASK 0xff /end CHARACTERISTIC
/begin COMPU_METHOD CRI_Tpilot1_slct3_COMPU_VTAB "Verbal Table" TAB_VERB "%.0" "list" COMPU_TAB_REF CRI_Tpilot1_slct3_COMPU_VTAB_REF /end COMPU_METHOD
/begin COMPU_VTAB CRI_Tpilot1_slct3_COMPU_VTAB_REF "Verbal Table" TAB_VERB 3 0 "Standard" 1 "Alternate 1" 2 "Alt 1 + Std" DEFAULT_VALUE "UNKNOWN" /end COMPU_VTAB
/begin CHARACTERISTIC CRI_Tpilot1_slct4 "Pilot 1 injection timing{CRI_Tpilot1_slct4&0xff=0:Standard}{CRI_Tpilot1_slct4&0xff=1:Alternate 1}{CRI_Tpilot1_slct4&0xff=2:Alt 1 + Std}" VALUE 0x00170ECC /* @ECU_Address@CRI_Tpilot1_slct4@0x0100A568@ */ ECIPP_ALIGNMENT_UBYTE 255 CRI_Tpilot1_slct4_COMPU_VTAB 0 255 BIT_MASK 0xff /end CHARACTERISTIC
/begin COMPU_METHOD CRI_Tpilot1_slct4_COMPU_VTAB "Verbal Table" TAB_VERB "%.0" "list" COMPU_TAB_REF CRI_Tpilot1_slct4_COMPU_VTAB_REF /end COMPU_METHOD
/begin COMPU_VTAB CRI_Tpilot1_slct4_COMPU_VTAB_REF "Verbal Table" TAB_VERB 3 0 "Standard" 1 "Alternate 1" 2 "Alt 1 + Std" DEFAULT_VALUE "UNKNOWN" /end COMPU_VTAB
/begin CHARACTERISTIC CRI_Tpilot1_slct5 "Pilot 1 injection timing{CRI_Tpilot1_slct5&0xff=0:Standard}{CRI_Tpilot1_slct5&0xff=1:Alternate 1}{CRI_Tpilot1_slct5&0xff=2:Alt 1 + Std}" VALUE 0x00170ECD /* @ECU_Address@CRI_Tpilot1_slct5@0x0100A570@ */ ECIPP_ALIGNMENT_UBYTE 255 CRI_Tpilot1_slct5_COMPU_VTAB 0 255 BIT_MASK 0xff /end CHARACTERISTIC
/begin COMPU_METHOD CRI_Tpilot1_slct5_COMPU_VTAB "Verbal Table" TAB_VERB "%.0" "list" COMPU_TAB_REF CRI_Tpilot1_slct5_COMPU_VTAB_REF /end COMPU_METHOD
/begin COMPU_VTAB CRI_Tpilot1_slct5_COMPU_VTAB_REF "Verbal Table" TAB_VERB 3 0 "Standard" 1 "Alternate 1" 2 "Alt 1 + Std" DEFAULT_VALUE "UNKNOWN" /end COMPU_VTAB
/begin CHARACTERISTIC CRI_Tpilot1_slct6 "Pilot 1 injection timing{CRI_Tpilot1_slct6&0xff=0:Standard}{CRI_Tpilot1_slct6&0xff=1:Alternate 1}{CRI_Tpilot1_slct6&0xff=2:Alt 1 + Std}" VALUE 0x00170ECE /* @ECU_Address@CRI_Tpilot1_slct6@0x0100A578@ */ ECIPP_ALIGNMENT_UBYTE 255 CRI_Tpilot1_slct6_COMPU_VTAB 0 255 BIT_MASK 0xff /end CHARACTERISTIC
/begin COMPU_METHOD CRI_Tpilot1_slct6_COMPU_VTAB "Verbal Table" TAB_VERB "%.0" "list" COMPU_TAB_REF CRI_Tpilot1_slct6_COMPU_VTAB_REF /end COMPU_METHOD
/begin COMPU_VTAB CRI_Tpilot1_slct6_COMPU_VTAB_REF "Verbal Table" TAB_VERB 3 0 "Standard" 1 "Alternate 1" 2 "Alt 1 + Std" DEFAULT_VALUE "UNKNOWN" /end COMPU_VTAB
/begin CHARACTERISTIC CRI_Tpilot1_slct7 "Pilot 1 injection timing{CRI_Tpilot1_slct7&0xff=0:Standard}{CRI_Tpilot1_slct7&0xff=1:Alternate 1}{CRI_Tpilot1_slct7&0xff=2:Alt 1 + Std}" VALUE 0x00170ECF /* @ECU_Address@CRI_Tpilot1_slct7@0x0100A580@ */ ECIPP_ALIGNMENT_UBYTE 255 CRI_Tpilot1_slct7_COMPU_VTAB 0 255 BIT_MASK 0xff /end CHARACTERISTIC
/begin COMPU_METHOD CRI_Tpilot1_slct7_COMPU_VTAB "Verbal Table" TAB_VERB "%.0" "list" COMPU_TAB_REF CRI_Tpilot1_slct7_COMPU_VTAB_REF /end COMPU_METHOD
/begin COMPU_VTAB CRI_Tpilot1_slct7_COMPU_VTAB_REF "Verbal Table" TAB_VERB 3 0 "Standard" 1 "Alternate 1" 2 "Alt 1 + Std" DEFAULT_VALUE "UNKNOWN" /end COMPU_VTAB
/begin CHARACTERISTIC CRI_Tmain_slct0 "Main injection timing{CRI_Tmain_slct0&0xff=0:Standard}{CRI_Tmain_slct0&0xff=1:Alternate 1}{CRI_Tmain_slct0&0xff=2:Alt 1 + Std}{CRI_Tmain_slct0&0xff=3:Alternate 2}{CRI_Tmain_slct0&0xff=4:Alt 2 + Std}" VALUE 0x00170EBE /* @ECU_Address@CRI_Tmain_slct0@0x0100A588@ */ ECIPP_ALIGNMENT_UBYTE 255 CRI_Tmain_slct0_COMPU_VTAB 0 255 BIT_MASK 0xff /end CHARACTERISTIC
/begin COMPU_METHOD CRI_Tmain_slct0_COMPU_VTAB "Verbal Table" TAB_VERB "%.0" "list" COMPU_TAB_REF CRI_Tmain_slct0_COMPU_VTAB_REF /end COMPU_METHOD
/begin COMPU_VTAB CRI_Tmain_slct0_COMPU_VTAB_REF "Verbal Table" TAB_VERB 5 0 "Standard" 1 "Alternate 1" 2 "Alt 1 + Std" 3 "Alternate 2" 4 "Alt 2 + Std" DEFAULT_VALUE "UNKNOWN" /end COMPU_VTAB
/begin CHARACTERISTIC CRI_Tmain_slct1 "Main injection timing{CRI_Tmain_slct1&0xff=0:Standard}{CRI_Tmain_slct1&0xff=1:Alternate 1}{CRI_Tmain_slct1&0xff=2:Alt 1 + Std}{CRI_Tmain_slct1&0xff=3:Alternate 2}{CRI_Tmain_slct1&0xff=4:Alt 2 + Std}" VALUE 0x00170EBF /* @ECU_Address@CRI_Tmain_slct1@0x0100A590@ */ ECIPP_ALIGNMENT_UBYTE 255 CRI_Tmain_slct1_COMPU_VTAB 0 255 BIT_MASK 0xff /end CHARACTERISTIC
/begin COMPU_METHOD CRI_Tmain_slct1_COMPU_VTAB "Verbal Table" TAB_VERB "%.0" "list" COMPU_TAB_REF CRI_Tmain_slct1_COMPU_VTAB_REF /end COMPU_METHOD
/begin COMPU_VTAB CRI_Tmain_slct1_COMPU_VTAB_REF "Verbal Table" TAB_VERB 5 0 "Standard" 1 "Alternate 1" 2 "Alt 1 + Std" 3 "Alternate 2" 4 "Alt 2 + Std" DEFAULT_VALUE "UNKNOWN" /end COMPU_VTAB
/begin CHARACTERISTIC CRI_Tmain_slct2 "Main injection timing{CRI_Tmain_slct2&0xff=0:Standard}{CRI_Tmain_slct2&0xff=1:Alternate 1}{CRI_Tmain_slct2&0xff=2:Alt 1 + Std}{CRI_Tmain_slct2&0xff=3:Alternate 2}{CRI_Tmain_slct2&0xff=4:Alt 2 + Std}" VALUE 0x00170EC0 /* @ECU_Address@CRI_Tmain_slct2@0x0100A598@ */ ECIPP_ALIGNMENT_UBYTE 255 CRI_Tmain_slct2_COMPU_VTAB 0 255 BIT_MASK 0xff /end CHARACTERISTIC
/begin COMPU_METHOD CRI_Tmain_slct2_COMPU_VTAB "Verbal Table" TAB_VERB "%.0" "list" COMPU_TAB_REF CRI_Tmain_slct2_COMPU_VTAB_REF /end COMPU_METHOD
/begin COMPU_VTAB CRI_Tmain_slct2_COMPU_VTAB_REF "Verbal Table" TAB_VERB 5 0 "Standard" 1 "Alternate 1" 2 "Alt 1 + Std" 3 "Alternate 2" 4 "Alt 2 + Std" DEFAULT_VALUE "UNKNOWN" /end COMPU_VTAB
/begin CHARACTERISTIC CRI_Tmain_slct3 "Main injection timing{CRI_Tmain_slct3&0xff=0:Standard}{CRI_Tmain_slct3&0xff=1:Alternate 1}{CRI_Tmain_slct3&0xff=2:Alt 1 + Std}{CRI_Tmain_slct3&0xff=3:Alternate 2}{CRI_Tmain_slct3&0xff=4:Alt 2 + Std}" VALUE 0x00170EC1 /* @ECU_Address@CRI_Tmain_slct3@0x0100A5A0@ */ ECIPP_ALIGNMENT_UBYTE 255 CRI_Tmain_slct3_COMPU_VTAB 0 255 BIT_MASK 0xff /end CHARACTERISTIC
/begin COMPU_METHOD CRI_Tmain_slct3_COMPU_VTAB "Verbal Table" TAB_VERB "%.0" "list" COMPU_TAB_REF CRI_Tmain_slct3_COMPU_VTAB_REF /end COMPU_METHOD
/begin COMPU_VTAB CRI_Tmain_slct3_COMPU_VTAB_REF "Verbal Table" TAB_VERB 5 0 "Standard" 1 "Alternate 1" 2 "Alt 1 + Std" 3 "Alternate 2" 4 "Alt 2 + Std" DEFAULT_VALUE "UNKNOWN" /end COMPU_VTAB
/begin CHARACTERISTIC CRI_Tmain_slct4 "Main injection timing{CRI_Tmain_slct4&0xff=0:Standard}{CRI_Tmain_slct4&0xff=1:Alternate 1}{CRI_Tmain_slct4&0xff=2:Alt 1 + Std}{CRI_Tmain_slct4&0xff=3:Alternate 2}{CRI_Tmain_slct4&0xff=4:Alt 2 + Std}" VALUE 0x00170EC2 /* @ECU_Address@CRI_Tmain_slct4@0x0100A5A8@ */ ECIPP_ALIGNMENT_UBYTE 255 CRI_Tmain_slct4_COMPU_VTAB 0 255 BIT_MASK 0xff /end CHARACTERISTIC
/begin COMPU_METHOD CRI_Tmain_slct4_COMPU_VTAB "Verbal Table" TAB_VERB "%.0" "list" COMPU_TAB_REF CRI_Tmain_slct4_COMPU_VTAB_REF /end COMPU_METHOD
/begin COMPU_VTAB CRI_Tmain_slct4_COMPU_VTAB_REF "Verbal Table" TAB_VERB 5 0 "Standard" 1 "Alternate 1" 2 "Alt 1 + Std" 3 "Alternate 2" 4 "Alt 2 + Std" DEFAULT_VALUE "UNKNOWN" /end COMPU_VTAB
/begin CHARACTERISTIC CRI_Tmain_slct5 "Main injection timing{CRI_Tmain_slct5&0xff=0:Standard}{CRI_Tmain_slct5&0xff=1:Alternate 1}{CRI_Tmain_slct5&0xff=2:Alt 1 + Std}{CRI_Tmain_slct5&0xff=3:Alternate 2}{CRI_Tmain_slct5&0xff=4:Alt 2 + Std}" VALUE 0x00170EC3 /* @ECU_Address@CRI_Tmain_slct5@0x0100A5B0@ */ ECIPP_ALIGNMENT_UBYTE 255 CRI_Tmain_slct5_COMPU_VTAB 0 255 BIT_MASK 0xff /end CHARACTERISTIC
/begin COMPU_METHOD CRI_Tmain_slct5_COMPU_VTAB "Verbal Table" TAB_VERB "%.0" "list" COMPU_TAB_REF CRI_Tmain_slct5_COMPU_VTAB_REF /end COMPU_METHOD
/begin COMPU_VTAB CRI_Tmain_slct5_COMPU_VTAB_REF "Verbal Table" TAB_VERB 5 0 "Standard" 1 "Alternate 1" 2 "Alt 1 + Std" 3 "Alternate 2" 4 "Alt 2 + Std" DEFAULT_VALUE "UNKNOWN" /end COMPU_VTAB
/begin CHARACTERISTIC CRI_Tmain_slct6 "Main injection timing{CRI_Tmain_slct6&0xff=0:Standard}{CRI_Tmain_slct6&0xff=1:Alternate 1}{CRI_Tmain_slct6&0xff=2:Alt 1 + Std}{CRI_Tmain_slct6&0xff=3:Alternate 2}{CRI_Tmain_slct6&0xff=4:Alt 2 + Std}" VALUE 0x00170EC4 /* @ECU_Address@CRI_Tmain_slct6@0x0100A5B8@ */ ECIPP_ALIGNMENT_UBYTE 255 CRI_Tmain_slct6_COMPU_VTAB 0 255 BIT_MASK 0xff /end CHARACTERISTIC
/begin COMPU_METHOD CRI_Tmain_slct6_COMPU_VTAB "Verbal Table" TAB_VERB "%.0" "list" COMPU_TAB_REF CRI_Tmain_slct6_COMPU_VTAB_REF /end COMPU_METHOD
/begin COMPU_VTAB CRI_Tmain_slct6_COMPU_VTAB_REF "Verbal Table" TAB_VERB 5 0 "Standard" 1 "Alternate 1" 2 "Alt 1 + Std" 3 "Alternate 2" 4 "Alt 2 + Std" DEFAULT_VALUE "UNKNOWN" /end COMPU_VTAB
/begin CHARACTERISTIC CRI_Tmain_slct7 "Main injection timing{CRI_Tmain_slct7&0xff=0:Standard}{CRI_Tmain_slct7&0xff=1:Alternate 1}{CRI_Tmain_slct7&0xff=2:Alt 1 + Std}{CRI_Tmain_slct7&0xff=3:Alternate 2}{CRI_Tmain_slct7&0xff=4:Alt 2 + Std}" VALUE 0x00170EC5 /* @ECU_Address@CRI_Tmain_slct7@0x0100A5C0@ */ ECIPP_ALIGNMENT_UBYTE 255 CRI_Tmain_slct7_COMPU_VTAB 0 255 BIT_MASK 0xff /end CHARACTERISTIC
/begin COMPU_METHOD CRI_Tmain_slct7_COMPU_VTAB "Verbal Table" TAB_VERB "%.0" "list" COMPU_TAB_REF CRI_Tmain_slct7_COMPU_VTAB_REF /end COMPU_METHOD
/begin COMPU_VTAB CRI_Tmain_slct7_COMPU_VTAB_REF "Verbal Table" TAB_VERB 5 0 "Standard" 1 "Alternate 1" 2 "Alt 1 + Std" 3 "Alternate 2" 4 "Alt 2 + Std" DEFAULT_VALUE "UNKNOWN" /end COMPU_VTAB
/begin CHARACTERISTIC CRI_Tpost1_slct0 "Post 1 injection timing{CRI_Tpost1_slct0&0xff=0:Standard}{CRI_Tpost1_slct0&0xff=1:Alternate 1}{CRI_Tpost1_slct0&0xff=2:Alt 1 + Std}" VALUE 0x00170EDE /* @ECU_Address@CRI_Tpost1_slct0@0x0100A5C8@ */ ECIPP_ALIGNMENT_UBYTE 255 CRI_Tpost1_slct0_COMPU_VTAB 0 255 BIT_MASK 0xff /end CHARACTERISTIC
/begin COMPU_METHOD CRI_Tpost1_slct0_COMPU_VTAB "Verbal Table" TAB_VERB "%.0" "list" COMPU_TAB_REF CRI_Tpost1_slct0_COMPU_VTAB_REF /end COMPU_METHOD
/begin COMPU_VTAB CRI_Tpost1_slct0_COMPU_VTAB_REF "Verbal Table" TAB_VERB 3 0 "Standard" 1 "Alternate 1" 2 "Alt 1 + Std" DEFAULT_VALUE "UNKNOWN" /end COMPU_VTAB
/begin CHARACTERISTIC CRI_Tpost1_slct1 "Post 1 injection timing{CRI_Tpost1_slct1&0xff=0:Standard}{CRI_Tpost1_slct1&0xff=1:Alternate 1}{CRI_Tpost1_slct1&0xff=2:Alt 1 + Std}" VALUE 0x00170EDF /* @ECU_Address@CRI_Tpost1_slct1@0x0100A5D0@ */ ECIPP_ALIGNMENT_UBYTE 255 CRI_Tpost1_slct1_COMPU_VTAB 0 255 BIT_MASK 0xff /end CHARACTERISTIC
/begin COMPU_METHOD CRI_Tpost1_slct1_COMPU_VTAB "Verbal Table" TAB_VERB "%.0" "list" COMPU_TAB_REF CRI_Tpost1_slct1_COMPU_VTAB_REF /end COMPU_METHOD
/begin COMPU_VTAB CRI_Tpost1_slct1_COMPU_VTAB_REF "Verbal Table" TAB_VERB 3 0 "Standard" 1 "Alternate 1" 2 "Alt 1 + Std" DEFAULT_VALUE "UNKNOWN" /end COMPU_VTAB
/begin CHARACTERISTIC CRI_Tpost1_slct2 "Post 1 injection timing{CRI_Tpost1_slct2&0xff=0:Standard}{CRI_Tpost1_slct2&0xff=1:Alternate 1}{CRI_Tpost1_slct2&0xff=2:Alt 1 + Std}" VALUE 0x00170EE0 /* @ECU_Address@CRI_Tpost1_slct2@0x0100A5D8@ */ ECIPP_ALIGNMENT_UBYTE 255 CRI_Tpost1_slct2_COMPU_VTAB 0 255 BIT_MASK 0xff /end CHARACTERISTIC
/begin COMPU_METHOD CRI_Tpost1_slct2_COMPU_VTAB "Verbal Table" TAB_VERB "%.0" "list" COMPU_TAB_REF CRI_Tpost1_slct2_COMPU_VTAB_REF /end COMPU_METHOD
/begin COMPU_VTAB CRI_Tpost1_slct2_COMPU_VTAB_REF "Verbal Table" TAB_VERB 3 0 "Standard" 1 "Alternate 1" 2 "Alt 1 + Std" DEFAULT_VALUE "UNKNOWN" /end COMPU_VTAB
/begin CHARACTERISTIC CRI_Tpost1_slct3 "Post 1 injection timing{CRI_Tpost1_slct3&0xff=0:Standard}{CRI_Tpost1_slct3&0xff=1:Alternate 1}{CRI_Tpost1_slct3&0xff=2:Alt 1 + Std}" VALUE 0x00170EE1 /* @ECU_Address@CRI_Tpost1_slct3@0x0100A5E0@ */ ECIPP_ALIGNMENT_UBYTE 255 CRI_Tpost1_slct3_COMPU_VTAB 0 255 BIT_MASK 0xff /end CHARACTERISTIC
/begin COMPU_METHOD CRI_Tpost1_slct3_COMPU_VTAB "Verbal Table" TAB_VERB "%.0" "list" COMPU_TAB_REF CRI_Tpost1_slct3_COMPU_VTAB_REF /end COMPU_METHOD
/begin COMPU_VTAB CRI_Tpost1_slct3_COMPU_VTAB_REF "Verbal Table" TAB_VERB 3 0 "Standard" 1 "Alternate 1" 2 "Alt 1 + Std" DEFAULT_VALUE "UNKNOWN" /end COMPU_VTAB
/begin CHARACTERISTIC CRI_Tpost1_slct4 "Post 1 injection timing{CRI_Tpost1_slct4&0xff=0:Standard}{CRI_Tpost1_slct4&0xff=1:Alternate 1}{CRI_Tpost1_slct4&0xff=2:Alt 1 + Std}" VALUE 0x00170EE2 /* @ECU_Address@CRI_Tpost1_slct4@0x0100A5E8@ */ ECIPP_ALIGNMENT_UBYTE 255 CRI_Tpost1_slct4_COMPU_VTAB 0 255 BIT_MASK 0xff /end CHARACTERISTIC
/begin COMPU_METHOD CRI_Tpost1_slct4_COMPU_VTAB "Verbal Table" TAB_VERB "%.0" "list" COMPU_TAB_REF CRI_Tpost1_slct4_COMPU_VTAB_REF /end COMPU_METHOD
/begin COMPU_VTAB CRI_Tpost1_slct4_COMPU_VTAB_REF "Verbal Table" TAB_VERB 3 0 "Standard" 1 "Alternate 1" 2 "Alt 1 + Std" DEFAULT_VALUE "UNKNOWN" /end COMPU_VTAB
/begin CHARACTERISTIC CRI_Tpost1_slct5 "Post 1 injection timing{CRI_Tpost1_slct5&0xff=0:Standard}{CRI_Tpost1_slct5&0xff=1:Alternate 1}{CRI_Tpost1_slct5&0xff=2:Alt 1 + Std}" VALUE 0x00170EE3 /* @ECU_Address@CRI_Tpost1_slct5@0x0100A5F0@ */ ECIPP_ALIGNMENT_UBYTE 255 CRI_Tpost1_slct5_COMPU_VTAB 0 255 BIT_MASK 0xff /end CHARACTERISTIC
/begin COMPU_METHOD CRI_Tpost1_slct5_COMPU_VTAB "Verbal Table" TAB_VERB "%.0" "list" COMPU_TAB_REF CRI_Tpost1_slct5_COMPU_VTAB_REF /end COMPU_METHOD
/begin COMPU_VTAB CRI_Tpost1_slct5_COMPU_VTAB_REF "Verbal Table" TAB_VERB 3 0 "Standard" 1 "Alternate 1" 2 "Alt 1 + Std" DEFAULT_VALUE "UNKNOWN" /end COMPU_VTAB
/begin CHARACTERISTIC CRI_Tpost1_slct6 "Post 1 injection timing{CRI_Tpost1_slct6&0xff=0:Standard}{CRI_Tpost1_slct6&0xff=1:Alternate 1}{CRI_Tpost1_slct6&0xff=2:Alt 1 + Std}" VALUE 0x00170EE4 /* @ECU_Address@CRI_Tpost1_slct6@0x0100A5F8@ */ ECIPP_ALIGNMENT_UBYTE 255 CRI_Tpost1_slct6_COMPU_VTAB 0 255 BIT_MASK 0xff /end CHARACTERISTIC
/begin COMPU_METHOD CRI_Tpost1_slct6_COMPU_VTAB "Verbal Table" TAB_VERB "%.0" "list" COMPU_TAB_REF CRI_Tpost1_slct6_COMPU_VTAB_REF /end COMPU_METHOD
/begin COMPU_VTAB CRI_Tpost1_slct6_COMPU_VTAB_REF "Verbal Table" TAB_VERB 3 0 "Standard" 1 "Alternate 1" 2 "Alt 1 + Std" DEFAULT_VALUE "UNKNOWN" /end COMPU_VTAB
/begin CHARACTERISTIC CRI_Tpost1_slct7 "Post 1 injection timing{CRI_Tpost1_slct7&0xff=0:Standard}{CRI_Tpost1_slct7&0xff=1:Alternate 1}{CRI_Tpost1_slct7&0xff=2:Alt 1 + Std}" VALUE 0x00170EE5 /* @ECU_Address@CRI_Tpost1_slct7@0x0100A600@ */ ECIPP_ALIGNMENT_UBYTE 255 CRI_Tpost1_slct7_COMPU_VTAB 0 255 BIT_MASK 0xff /end CHARACTERISTIC
/begin COMPU_METHOD CRI_Tpost1_slct7_COMPU_VTAB "Verbal Table" TAB_VERB "%.0" "list" COMPU_TAB_REF CRI_Tpost1_slct7_COMPU_VTAB_REF /end COMPU_METHOD
/begin COMPU_VTAB CRI_Tpost1_slct7_COMPU_VTAB_REF "Verbal Table" TAB_VERB 3 0 "Standard" 1 "Alternate 1" 2 "Alt 1 + Std" DEFAULT_VALUE "UNKNOWN" /end COMPU_VTAB
/begin CHARACTERISTIC CRI_Tpost2_slct0 "Post 2 injection timing{CRI_Tpost2_slct0&0xff=0:Standard}{CRI_Tpost2_slct0&0xff=1:Alternate 1}{CRI_Tpost2_slct0&0xff=2:Alt 1 + Std}" VALUE 0x00170EE8 /* @ECU_Address@CRI_Tpost2_slct0@0x0100A608@ */ ECIPP_ALIGNMENT_UBYTE 255 CRI_Tpost2_slct0_COMPU_VTAB 0 255 BIT_MASK 0xff /end CHARACTERISTIC
/begin COMPU_METHOD CRI_Tpost2_slct0_COMPU_VTAB "Verbal Table" TAB_VERB "%.0" "list" COMPU_TAB_REF CRI_Tpost2_slct0_COMPU_VTAB_REF /end COMPU_METHOD
/begin COMPU_VTAB CRI_Tpost2_slct0_COMPU_VTAB_REF "Verbal Table" TAB_VERB 3 0 "Standard" 1 "Alternate 1" 2 "Alt 1 + Std" DEFAULT_VALUE "UNKNOWN" /end COMPU_VTAB
/begin MEASUREMENT TEL_derate_type "Requested telematics derate level{TEL_derate_type&0xff=0:No Derate Active}{TEL_derate_type&0xff=1:RPM limit stage 1}{TEL_derate_type&0xff=2:RPM limit stage 2}{TEL_derate_type&0xff=3:Engine shutdown}{TEL_derate_type&0xff=4:No lease - start unlocked}{TEL_de" UBYTE TEL_derate_type_COMPU_VTAB 0 0 0 255 ECU_ADDRESS 0x0100B570 BIT_MASK 0xff /end MEASUREMENT
/begin COMPU_METHOD TEL_derate_type_COMPU_VTAB "Verbal Table" TAB_VERB "%.0" "list" COMPU_TAB_REF TEL_derate_type_COMPU_VTAB_REF /end COMPU_METHOD
/begin COMPU_VTAB TEL_derate_type_COMPU_VTAB_REF "Verbal Table" TAB_VERB 19 0 "No Derate Active" 1 "RPM limit stage 1" 2 "RPM limit stage 2" 3 "Engine shutdown" 4 "No lease - start unlocked" 5 "Leased - start unlocked" 6 "No lease - start locked" 7 "Leased - start locked" 8 "No lease - 30% torque" 9 "Leased - 30% torque" 10 "No lease - 80% torque" 11 "Leased - 80% torque" 12 "No lease - 30 km/hr limit" 13 "Leased - 30 km/hr limit" 14 "No lease - 80 km/hr limit" 15 "Leased - 80 km/hr limit" 16 "TEL TSC1 torque limit" 17 "RPM and torque limits" 18 "RPM limit" DEFAULT_VALUE "UNKNOWN" /end COMPU_VTAB
/begin CHARACTERISTIC TEL_Rx_timeout "Telematics valid message receipt timeout" VALUE 0x00149334 /* @ECU_Address@TEL_Rx_timeout@0x0100B578@ */ ECIPP_ALIGNMENT_ULONG 4294967 Compu_TEL_Rx_timeout 0 4294967.295 /end CHARACTERISTIC
/begin COMPU_METHOD Compu_TEL_Rx_timeout " " RAT_FUNC "%.1" "seconds" COEFFS 0 1000 0 0 0 1 /end COMPU_METHOD
/begin CHARACTERISTIC TEL_Rx_Tx_delay "Telematics message response delay" VALUE 0x00147876 /* @ECU_Address@TEL_Rx_Tx_delay@0x0100B580@ */ ECIPP_ALIGNMENT_UWORD 65535 Compu_TEL_Rx_Tx_delay 0 65535 /end CHARACTERISTIC
/begin COMPU_METHOD Compu_TEL_Rx_Tx_delay " " RAT_FUNC "%.0" "ms" COEFFS 0 1 0 0 0 1 /end COMPU_METHOD
/begin CHARACTERISTIC TEL_derate_nextkey "Requested telematics derates should be{TEL_derate_nextkey&0xff=0:Enforced Immediately}{TEL_derate_nextkey&0xff=1:Enforced on Next Key-Cycle}" VALUE 0x0014933D /* @ECU_Address@TEL_derate_nextkey@0x0100B588@ */ ECIPP_ALIGNMENT_UBYTE 255 TEL_derate_nextkey_COMPU_VTAB 0 255 BIT_MASK 0xff /end CHARACTERISTIC
/begin COMPU_METHOD TEL_derate_nextkey_COMPU_VTAB "Verbal Table" TAB_VERB "%.0" "list" COMPU_TAB_REF TEL_derate_nextkey_COMPU_VTAB_REF /end COMPU_METHOD
/begin COMPU_VTAB TEL_derate_nextkey_COMPU_VTAB_REF "Verbal Table" TAB_VERB 2 0 "Enforced Immediately" 1 "Enforced on Next Key-Cycle" DEFAULT_VALUE "UNKNOWN" /end COMPU_VTAB
/begin CHARACTERISTIC TEL_derate_noRx "Telematic unit disconnection derate type{TEL_derate_noRx&0xff=0:No Derate Active}{TEL_derate_noRx&0xff=1:RPM limit stage 1}{TEL_derate_noRx&0xff=2:RPM limit stage 2}{TEL_derate_noRx&0xff=3:Engine shutdown}" VALUE 0x0014933E /* @ECU_Address@TEL_derate_noRx@0x0100B590@ */ ECIPP_ALIGNMENT_UBYTE 255 TEL_derate_noRx_COMPU_VTAB 0 255 BIT_MASK 0xff /end CHARACTERISTIC
/begin COMPU_METHOD TEL_derate_noRx_COMPU_VTAB "Verbal Table" TAB_VERB "%.0" "list" COMPU_TAB_REF TEL_derate_noRx_COMPU_VTAB_REF /end COMPU_METHOD
/begin COMPU_VTAB TEL_derate_noRx_COMPU_VTAB_REF "Verbal Table" TAB_VERB 4 0 "No Derate Active" 1 "RPM limit stage 1" 2 "RPM limit stage 2" 3 "Engine shutdown" DEFAULT_VALUE "UNKNOWN" /end COMPU_VTAB
/begin MEASUREMENT EE_TEL_derate_active "Currently active telematics derate status{EE_TEL_derate_active&0xff=0:No Derate Active}{EE_TEL_derate_active&0xff=1:Derate-No Telematic Unit Found}{EE_TEL_derate_active&0xff=2:Derate-Commanded by Telematics}{EE_TEL_derate_active&0xff=6:Derate-Commanded + " UBYTE EE_TEL_derate_active_COMPU_VTAB 0 0 0 255 ECU_ADDRESS 0x0100B598 BIT_MASK 0xff /end MEASUREMENT
/begin COMPU_METHOD EE_TEL_derate_active_COMPU_VTAB "Verbal Table" TAB_VERB "%.0" "list" COMPU_TAB_REF EE_TEL_derate_active_COMPU_VTAB_REF /end COMPU_METHOD
/begin COMPU_VTAB EE_TEL_derate_active_COMPU_VTAB_REF "Verbal Table" TAB_VERB 6 0 "No Derate Active" 1 "Derate-No Telematic Unit Found" 2 "Derate-Commanded by Telematics" 6 "Derate-Commanded + No Unit Req" 10 "Derate-Commanded + No Unit" 14 "Derate-Commanded + No Unit" DEFAULT_VALUE "UNKNOWN" /end COMPU_VTAB
/begin MEASUREMENT EE_TEL_derate_type "Currently active telematics derate level{EE_TEL_derate_type&0xff=0:No Derate Active}{EE_TEL_derate_type&0xff=1:RPM limit stage 1}{EE_TEL_derate_type&0xff=2:RPM limit stage 2}{EE_TEL_derate_type&0xff=3:Engine shutdown}{EE_TEL_derate_type&0xff=4:No lease - " UBYTE EE_TEL_derate_type_COMPU_VTAB 0 0 0 255 ECU_ADDRESS 0x0100B5A0 BIT_MASK 0xff /end MEASUREMENT
/begin COMPU_METHOD EE_TEL_derate_type_COMPU_VTAB "Verbal Table" TAB_VERB "%.0" "list" COMPU_TAB_REF EE_TEL_derate_type_COMPU_VTAB_REF /end COMPU_METHOD
/begin COMPU_VTAB EE_TEL_derate_type_COMPU_VTAB_REF "Verbal Table" TAB_VERB 19 0 "No Derate Active" 1 "RPM limit stage 1" 2 "RPM limit stage 2" 3 "Engine shutdown" 4 "No lease - start unlocked" 5 "Leased - start unlocked" 6 "No lease - start locked" 7 "Leased - start locked" 8 "No lease - 30% torque" 9 "Leased - 30% torque" 10 "No lease - 80% torque" 11 "Leased - 80% torque" 12 "No lease - 30 km/hr limit" 13 "Leased - 30 km/hr limit" 14 "No lease - 80 km/hr limit" 15 "Leased - 80 km/hr limit" 16 "TEL TSC1 torque limit" 17 "RPM and torque limits" 18 "RPM limit" DEFAULT_VALUE "UNKNOWN" /end COMPU_VTAB
/begin CHARACTERISTIC TEL_rpm_lim1 "Telematics derate RPM limit stage 1" VALUE 0x00149338 /* @ECU_Address@TEL_rpm_lim1@0x0100B5A8@ */ ECIPP_ALIGNMENT_UWORD 65535 Compu_TEL_rpm_lim1 0 65535 /end CHARACTERISTIC
/begin COMPU_METHOD Compu_TEL_rpm_lim1 " " RAT_FUNC "%.0" "rpm" COEFFS 0 1 0 0 0 1 /end COMPU_METHOD
/begin CHARACTERISTIC TEL_rpm_lim2 "Telematics derate RPM limit stage 2" VALUE 0x0014933A /* @ECU_Address@TEL_rpm_lim2@0x0100B5B0@ */ ECIPP_ALIGNMENT_UWORD 65535 Compu_TEL_rpm_lim2 0 65535 /end CHARACTERISTIC
/begin COMPU_METHOD Compu_TEL_rpm_lim2 " " RAT_FUNC "%.0" "rpm" COEFFS 0 1 0 0 0 1 /end COMPU_METHOD
/begin MEASUREMENT TEL_comm_req_cnt "Telematics unit command sequence request counter" ULONG Compu_TEL_comm_req_cnt 0 0 0 4294967295 ECU_ADDRESS 0x0100B5B8 /end MEASUREMENT
/begin COMPU_METHOD Compu_TEL_comm_req_cnt " " RAT_FUNC "%.0" "messages" COEFFS 0 1 0 0 0 1 /end COMPU_METHOD
/begin MEASUREMENT TEL_comm_fail_cnt "Telematics unit message failure counter" ULONG Compu_TEL_comm_fail_cnt 0 0 0 4294967295 ECU_ADDRESS 0x0100B5C0 /end MEASUREMENT
/begin COMPU_METHOD Compu_TEL_comm_fail_cnt " " RAT_FUNC "%.0" "messages" COEFFS 0 1 0 0 0 1 /end COMPU_METHOD
/begin MEASUREMENT TEL_comm_tout_cnt "Telematics unit message timeout counter" ULONG Compu_TEL_comm_tout_cnt 0 0 0 4294967295 ECU_ADDRESS 0x0100B5C8 /end MEASUREMENT
/begin COMPU_METHOD Compu_TEL_comm_tout_cnt " " RAT_FUNC "%.0" "timeouts" COEFFS 0 1 0 0 0 1 /end COMPU_METHOD
/begin MEASUREMENT TEL_comm_good_cnt "Telematics unit command success counter" ULONG Compu_TEL_comm_good_cnt 0 0 0 4294967295 ECU_ADDRESS 0x0100B5D0 /end MEASUREMENT
/begin COMPU_METHOD Compu_TEL_comm_good_cnt " " RAT_FUNC "%.0" "messages" COEFFS 0 1 0 0 0 1 /end COMPU_METHOD
/begin MEASUREMENT TEL_link_good "Telematics unit link active and OK{TEL_link_good&0xff=0x00:OFF}{TEL_link_good&0xff=0x01:ON}" UBYTE TEL_link_good_COMPU_VTAB 0 0 0 255 ECU_ADDRESS 0x0100B5D8 BIT_MASK 0xff /end MEASUREMENT
/begin COMPU_METHOD TEL_link_good_COMPU_VTAB "Verbal Table" TAB_VERB "%.0" "list" COMPU_TAB_REF TEL_link_good_COMPU_VTAB_REF /end COMPU_METHOD
/begin COMPU_VTAB TEL_link_good_COMPU_VTAB_REF "Verbal Table" TAB_VERB 2 0x00 "OFF" 0x01 "ON" DEFAULT_VALUE "UNKNOWN" /end COMPU_VTAB
/begin CHARACTERISTIC TEL_const_a "Telematics encryption constant A" VALUE 0x00148090 /* @ECU_Address@TEL_const_a@0x0100B888@ */ ECIPP_ALIGNMENT_UBYTE 255 Compu_TEL_const_a 0 255 /end CHARACTERISTIC
/begin COMPU_METHOD Compu_TEL_const_a " " RAT_FUNC "%.0" "byte" COEFFS 0 1 0 0 0 1 /end COMPU_METHOD
/begin CHARACTERISTIC TEL_const_b "Telematics encryption constant B" VALUE 0x00148091 /* @ECU_Address@TEL_const_b@0x0100B890@ */ ECIPP_ALIGNMENT_UBYTE 255 Compu_TEL_const_b 0 255 /end CHARACTERISTIC
/begin COMPU_METHOD Compu_TEL_const_b " " RAT_FUNC "%.0" "byte" COEFFS 0 1 0 0 0 1 /end COMPU_METHOD
/begin CHARACTERISTIC TEL_const_c "Telematics encryption constant C" VALUE 0x00148092 /* @ECU_Address@TEL_const_c@0x0100B898@ */ ECIPP_ALIGNMENT_UBYTE 255 Compu_TEL_const_c 0 255 /end CHARACTERISTIC
/begin COMPU_METHOD Compu_TEL_const_c " " RAT_FUNC "%.0" "byte" COEFFS 0 1 0 0 0 1 /end COMPU_METHOD
/begin CHARACTERISTIC TEL_const_d "Telematics encryption constant D" VALUE 0x00148093 /* @ECU_Address@TEL_const_d@0x0100B8A0@ */ ECIPP_ALIGNMENT_UBYTE 255 Compu_TEL_const_d 0 255 /end CHARACTERISTIC
/begin COMPU_METHOD Compu_TEL_const_d " " RAT_FUNC "%.0" "byte" COEFFS 0 1 0 0 0 1 /end COMPU_METHOD
/begin CHARACTERISTIC LoadLim_eco_table "Load-limit economy table{LoadLim_eco_table&0xff=0:Ignored - use default}{LoadLim_eco_table&0xff=1:Use Table 1 (Gasoline)}{LoadLim_eco_table&0xff=2:Use Table 2 (LPG)}{LoadLim_eco_table&0xff=3:Use Table 3 (NG)}{LoadLim_eco_table&0xff=4:Use Table 5}{LoadLim_" VALUE 0x00147e3a /* @ECU_Address@LoadLim_eco_table@0x0100BBE0@ */ ECIPP_ALIGNMENT_UBYTE 255 LoadLim_eco_table_COMPU_VTAB 0 255 BIT_MASK 0xff /end CHARACTERISTIC
/begin COMPU_METHOD LoadLim_eco_table_COMPU_VTAB "Verbal Table" TAB_VERB "%.0" "list" COMPU_TAB_REF LoadLim_eco_table_COMPU_VTAB_REF /end COMPU_METHOD
/begin COMPU_VTAB LoadLim_eco_table_COMPU_VTAB_REF "Verbal Table" TAB_VERB 8 0 "Ignored - use default" 1 "Use Table 1 (Gasoline)" 2 "Use Table 2 (LPG)" 3 "Use Table 3 (NG)" 4 "Use Table 5" 5 "Use Table 6" 6 "Use Table 7" 7 "Use Table 8" DEFAULT_VALUE "UNKNOWN" /end COMPU_VTAB
/begin CHARACTERISTIC LoadLim_perf_input "Load-limit performance mode input{LoadLim_perf_input&0xff=0:Disabled}{LoadLim_perf_input&0xff=1:Network Select - 100% Load Limit}{LoadLim_perf_input&0xff=2:Network Select - Power Table}{LoadLim_perf_input&0xff=3:Network Select - Table 5}{LoadLim_perf_inpu" VALUE 0x00147e4f /* @ECU_Address@LoadLim_perf_input@0x0100BBE8@ */ ECIPP_ALIGNMENT_UBYTE 255 LoadLim_perf_input_COMPU_VTAB 0 255 BIT_MASK 0xff /end CHARACTERISTIC
/begin COMPU_METHOD LoadLim_perf_input_COMPU_VTAB "Verbal Table" TAB_VERB "%.0" "list" COMPU_TAB_REF LoadLim_perf_input_COMPU_VTAB_REF /end COMPU_METHOD
/begin COMPU_VTAB LoadLim_perf_input_COMPU_VTAB_REF "Verbal Table" TAB_VERB 7 0 "Disabled" 1 "Network Select - 100% Load Limit" 2 "Network Select - Power Table" 3 "Network Select - Table 5" 4 "Network Select - Table 6" 5 "Network Select - Table 7" 6 "Network Select - Table 8" DEFAULT_VALUE "UNKNOWN" /end COMPU_VTAB
/begin MEASUREMENT LoadLim_perf_stat "Load-limit performance mode status{LoadLim_perf_stat&0xff=0:N/A - Normal Operation}{LoadLim_perf_stat&0xff=1:Economy}{LoadLim_perf_stat&0xff=2:Standard}{LoadLim_perf_stat&0xff=3:Power}" UBYTE LoadLim_perf_stat_COMPU_VTAB 0 0 0 255 ECU_ADDRESS 0x0100BBF0 BIT_MASK 0xff /end MEASUREMENT
/begin COMPU_METHOD LoadLim_perf_stat_COMPU_VTAB "Verbal Table" TAB_VERB "%.0" "list" COMPU_TAB_REF LoadLim_perf_stat_COMPU_VTAB_REF /end COMPU_METHOD
/begin COMPU_VTAB LoadLim_perf_stat_COMPU_VTAB_REF "Verbal Table" TAB_VERB 4 0 "N/A - Normal Operation" 1 "Economy" 2 "Standard" 3 "Power" DEFAULT_VALUE "UNKNOWN" /end COMPU_VTAB
/begin MEASUREMENT LoadLim_dmd_pct "Load-limiting engine demand" UWORD Compu_LoadLim_dmd_pct 0 0 0 99.9984741210938 ECU_ADDRESS 0x0100C230 /end MEASUREMENT
/begin COMPU_METHOD Compu_LoadLim_dmd_pct " " RAT_FUNC "%.1" "%" COEFFS 0 655.36 0 0 0 1 /end COMPU_METHOD
/begin CHARACTERISTIC VPA_ena "Vehicle pull away derate{VPA_ena&0xff=0:Disabled}{VPA_ena&0xff=1:J1939 Aux IO}" VALUE 0x001480e4 /* @ECU_Address@VPA_ena@0x0100C858@ */ ECIPP_ALIGNMENT_UBYTE 255 VPA_ena_COMPU_VTAB 0 255 BIT_MASK 0xff /end CHARACTERISTIC
/begin COMPU_METHOD VPA_ena_COMPU_VTAB "Verbal Table" TAB_VERB "%.0" "list" COMPU_TAB_REF VPA_ena_COMPU_VTAB_REF /end COMPU_METHOD
/begin COMPU_VTAB VPA_ena_COMPU_VTAB_REF "Verbal Table" TAB_VERB 2 0 "Disabled" 1 "J1939 Aux IO" DEFAULT_VALUE "UNKNOWN" /end COMPU_VTAB
/begin MEASUREMENT VPA_derate_active "Vehicle pull away derate active{VPA_derate_active&0x01=0x00:Inactive}{VPA_derate_active&0x01=0x01:Active}" UBYTE VPA_derate_active_COMPU_VTAB 0 0 0 255 ECU_ADDRESS 0x0100C860 BIT_MASK 0x01 /end MEASUREMENT
/begin COMPU_METHOD VPA_derate_active_COMPU_VTAB "Verbal Table" TAB_VERB "%.0" "list" COMPU_TAB_REF VPA_derate_active_COMPU_VTAB_REF /end COMPU_METHOD
/begin COMPU_VTAB VPA_derate_active_COMPU_VTAB_REF "Verbal Table" TAB_VERB 2 0x00 "Inactive" 0x01 "Active" DEFAULT_VALUE "UNKNOWN" /end COMPU_VTAB
/begin CHARACTERISTIC VPA_min_speed "Vehicle pull away min engage" VALUE 0x00147a10 /* @ECU_Address@VPA_min_speed@0x0100C868@ */ ECIPP_ALIGNMENT_UWORD 256 Compu_VPA_min_speed 0 255.99609375 /end CHARACTERISTIC
/begin COMPU_METHOD Compu_VPA_min_speed " " RAT_FUNC "%.1" "km/hr" COEFFS 0 256 0 0 0 1 /end COMPU_METHOD
/begin CHARACTERISTIC VPA_max_speed "Vehicle pull away max engage" VALUE 0x00147a0e /* @ECU_Address@VPA_max_speed@0x0100C870@ */ ECIPP_ALIGNMENT_UWORD 256 Compu_VPA_max_speed 0 255.99609375 /end CHARACTERISTIC
/begin COMPU_METHOD Compu_VPA_max_speed " " RAT_FUNC "%.1" "km/hr" COEFFS 0 256 0 0 0 1 /end COMPU_METHOD
/begin CHARACTERISTIC VPA_tout "Vehicle pull away derate timeout" VALUE 0x00147a12 /* @ECU_Address@VPA_tout@0x0100C878@ */ ECIPP_ALIGNMENT_UWORD 66 Compu_VPA_tout 0 65.535 /end CHARACTERISTIC
/begin COMPU_METHOD Compu_VPA_tout " " RAT_FUNC "%.1" "sec" COEFFS 0 1000 0 0 0 1 /end COMPU_METHOD
/begin CHARACTERISTIC VPA_delay "Vehicle pull away re-engage delay" VALUE 0x00147a0c /* @ECU_Address@VPA_delay@0x0100C880@ */ ECIPP_ALIGNMENT_UWORD 66 Compu_VPA_delay 0 65.535 /end CHARACTERISTIC
/begin COMPU_METHOD Compu_VPA_delay " " RAT_FUNC "%.1" "sec" COEFFS 0 1000 0 0 0 1 /end COMPU_METHOD
/begin MEASUREMENT VPA_gear1_LED "Vehicle pull away gear 1{VPA_gear1_LED&0x01=0x00:Inactive}{VPA_gear1_LED&0x01=0x01:Active}" UBYTE VPA_gear1_LED_COMPU_VTAB 0 0 0 255 ECU_ADDRESS 0x0100C888 BIT_MASK 0x01 /end MEASUREMENT
/begin COMPU_METHOD VPA_gear1_LED_COMPU_VTAB "Verbal Table" TAB_VERB "%.0" "1st" COMPU_TAB_REF VPA_gear1_LED_COMPU_VTAB_REF /end COMPU_METHOD
/begin COMPU_VTAB VPA_gear1_LED_COMPU_VTAB_REF "Verbal Table" TAB_VERB 2 0x00 "Inactive" 0x01 "Active" DEFAULT_VALUE "UNKNOWN" /end COMPU_VTAB
/begin MEASUREMENT VPA_rev_LED "Vehicle pull away reverse{VPA_rev_LED&0x01=0x00:Inactive}{VPA_rev_LED&0x01=0x01:Active}" UBYTE VPA_rev_LED_COMPU_VTAB 0 0 0 255 ECU_ADDRESS 0x0100C890 BIT_MASK 0x01 /end MEASUREMENT
/begin COMPU_METHOD VPA_rev_LED_COMPU_VTAB "Verbal Table" TAB_VERB "%.0" "Rev" COMPU_TAB_REF VPA_rev_LED_COMPU_VTAB_REF /end COMPU_METHOD
/begin COMPU_VTAB VPA_rev_LED_COMPU_VTAB_REF "Verbal Table" TAB_VERB 2 0x00 "Inactive" 0x01 "Active" DEFAULT_VALUE "UNKNOWN" /end COMPU_VTAB
/begin CHARACTERISTIC TEL_enable_Yuchai "Telematics system 2{TEL_enable_Yuchai&0xff=0:Disabled}{TEL_enable_Yuchai&0xff=1:Enabled}" VALUE 0x00148096 /* @ECU_Address@TEL_enable_Yuchai@0x0100D8E0@ */ ECIPP_ALIGNMENT_UBYTE 255 TEL_enable_Yuchai_COMPU_VTAB 0 255 BIT_MASK 0xff /end CHARACTERISTIC
/begin COMPU_METHOD TEL_enable_Yuchai_COMPU_VTAB "Verbal Table" TAB_VERB "%.0" "list" COMPU_TAB_REF TEL_enable_Yuchai_COMPU_VTAB_REF /end COMPU_METHOD
/begin COMPU_VTAB TEL_enable_Yuchai_COMPU_VTAB_REF "Verbal Table" TAB_VERB 2 0 "Disabled" 1 "Enabled" DEFAULT_VALUE "UNKNOWN" /end COMPU_VTAB
/begin MEASUREMENT TEL_derate "Telematics derate actively enforced{TEL_derate&0xff=0x00:OFF}{TEL_derate&0xff=0x01:ON}" UBYTE TEL_derate_COMPU_VTAB 0 0 0 255 ECU_ADDRESS 0x0100D8E8 BIT_MASK 0xff /end MEASUREMENT
/begin COMPU_METHOD TEL_derate_COMPU_VTAB "Verbal Table" TAB_VERB "%.0" "list" COMPU_TAB_REF TEL_derate_COMPU_VTAB_REF /end COMPU_METHOD
/begin COMPU_VTAB TEL_derate_COMPU_VTAB_REF "Verbal Table" TAB_VERB 2 0x00 "OFF" 0x01 "ON" DEFAULT_VALUE "UNKNOWN" /end COMPU_VTAB
/begin CHARACTERISTIC LoadLim_max_gov_ena "Load-limit Max Governor speed{LoadLim_max_gov_ena&0xff=0:Disabled}{LoadLim_max_gov_ena&0xff=1:Enabled}" VALUE 0x00147e45 /* @ECU_Address@LoadLim_max_gov_ena@0x0100DB10@ */ ECIPP_ALIGNMENT_UBYTE 255 LoadLim_max_gov_ena_COMPU_VTAB 0 255 BIT_MASK 0xff /end CHARACTERISTIC
/begin COMPU_METHOD LoadLim_max_gov_ena_COMPU_VTAB "Verbal Table" TAB_VERB "%.0" "list" COMPU_TAB_REF LoadLim_max_gov_ena_COMPU_VTAB_REF /end COMPU_METHOD
/begin COMPU_VTAB LoadLim_max_gov_ena_COMPU_VTAB_REF "Verbal Table" TAB_VERB 2 0 "Disabled" 1 "Enabled" DEFAULT_VALUE "UNKNOWN" /end COMPU_VTAB
/begin MEASUREMENT LoadLim_max_gov_actv "Load-limited Max Gov{LoadLim_max_gov_actv&0xff=0:Disabled}{LoadLim_max_gov_actv&0xff=1:Enabled}" UBYTE LoadLim_max_gov_actv_COMPU_VTAB 0 0 0 255 ECU_ADDRESS 0x0100DB18 BIT_MASK 0xff /end MEASUREMENT
/begin COMPU_METHOD LoadLim_max_gov_actv_COMPU_VTAB "Verbal Table" TAB_VERB "%.0" "list" COMPU_TAB_REF LoadLim_max_gov_actv_COMPU_VTAB_REF /end COMPU_METHOD
/begin COMPU_VTAB LoadLim_max_gov_actv_COMPU_VTAB_REF "Verbal Table" TAB_VERB 2 0 "Disabled" 1 "Enabled" DEFAULT_VALUE "UNKNOWN" /end COMPU_VTAB
/begin MEASUREMENT GovMax_rpm "Load-limited Max Gov" UWORD Compu_GovMax_rpm 0 0 0 65535 ECU_ADDRESS 0x0100DB20 /end MEASUREMENT
/begin COMPU_METHOD Compu_GovMax_rpm " " RAT_FUNC "%.0" "rpm" COEFFS 0 1 0 0 0 1 /end COMPU_METHOD
/begin CHARACTERISTIC TEL_derate_actv_chan "Telematics derate active output{TEL_derate_actv_chan&0xff=0:Disabled}{TEL_derate_actv_chan&0xff=1:Aux PWM1}{TEL_derate_actv_chan&0xff=2:Aux PWM2}{TEL_derate_actv_chan&0xff=3:Aux PWM3}{TEL_derate_actv_chan&0xff=4:Aux PWM4}{TEL_derate_actv_chan&0xff=5:Aux P" VALUE 0x0014933C /* @ECU_Address@TEL_derate_actv_chan@0x0100E5E0@ */ ECIPP_ALIGNMENT_UBYTE 255 TEL_derate_actv_chan_COMPU_VTAB 0 255 BIT_MASK 0xff /end CHARACTERISTIC
/begin COMPU_METHOD TEL_derate_actv_chan_COMPU_VTAB "Verbal Table" TAB_VERB "%.0" "list" COMPU_TAB_REF TEL_derate_actv_chan_COMPU_VTAB_REF /end COMPU_METHOD
/begin COMPU_VTAB TEL_derate_actv_chan_COMPU_VTAB_REF "Verbal Table" TAB_VERB 16 0 "Disabled" 1 "Aux PWM1" 2 "Aux PWM2" 3 "Aux PWM3" 4 "Aux PWM4" 5 "Aux PWM5" 6 "Aux PWM6" 7 "Aux PWM7" 8 "Aux PWM8" 9 "Aux PWM9" 10 "Aux PWM10" 11 "Aux PWM11" 12 "Aux PWM12" 13 "Aux PWM13" 14 "Aux PWM14" 15 "Aux PWM15" DEFAULT_VALUE "UNKNOWN" /end COMPU_VTAB
/begin CHARACTERISTIC derate1_EGR_minnom "Power derate 1 EGR min/nom fraction" VALUE 0x0014087a /* @ECU_Address@derate1_EGR_minnom@0x0100F338@ */ ECIPP_ALIGNMENT_SWORD 2 Compu_derate1_EGR_minnom -2 1.99993896484375 /end CHARACTERISTIC
/begin COMPU_METHOD Compu_derate1_EGR_minnom " " RAT_FUNC "%.2" "min/nom" COEFFS 0 16384 0 0 0 1 /end COMPU_METHOD
/begin CHARACTERISTIC derate2_EGR_minnom "Power derate 2 EGR min/nom fraction" VALUE 0x0014087c /* @ECU_Address@derate2_EGR_minnom@0x0100F340@ */ ECIPP_ALIGNMENT_SWORD 2 Compu_derate2_EGR_minnom -2 1.99993896484375 /end CHARACTERISTIC
/begin COMPU_METHOD Compu_derate2_EGR_minnom " " RAT_FUNC "%.2" "min/nom" COEFFS 0 16384 0 0 0 1 /end COMPU_METHOD
/begin CHARACTERISTIC derate1_dbw_mode "Power derate 1 DBW limit source{derate1_dbw_mode&0xff=0:Power derate TPS limit}{derate1_dbw_mode&0xff=1:Table 1 / Gasoline Load-Limit}{derate1_dbw_mode&0xff=2:Table 2 / LPG Load-Limit}{derate1_dbw_mode&0xff=3:Table 3 / NG Load-Limit}{derate1_dbw_mode&0xff" VALUE 0x0014813d /* @ECU_Address@derate1_dbw_mode@0x0100FBA8@ */ ECIPP_ALIGNMENT_UBYTE 255 derate1_dbw_mode_COMPU_VTAB 0 255 BIT_MASK 0xff /end CHARACTERISTIC
/begin COMPU_METHOD derate1_dbw_mode_COMPU_VTAB "Verbal Table" TAB_VERB "%.0" "list" COMPU_TAB_REF derate1_dbw_mode_COMPU_VTAB_REF /end COMPU_METHOD
/begin COMPU_VTAB derate1_dbw_mode_COMPU_VTAB_REF "Verbal Table" TAB_VERB 9 0 "Power derate TPS limit" 1 "Table 1 / Gasoline Load-Limit" 2 "Table 2 / LPG Load-Limit" 3 "Table 3 / NG Load-Limit" 4 "Table 4 / Power Load-Limit" 5 "Table 5" 6 "Table 6" 7 "Table 7" 8 "Table 8" DEFAULT_VALUE "UNKNOWN" /end COMPU_VTAB
/begin CHARACTERISTIC derate2_dbw_mode "Power derate 2 DBW limit source{derate2_dbw_mode&0xff=0:Power derate TPS limit}{derate2_dbw_mode&0xff=1:Table 1 / Gasoline Load-Limit}{derate2_dbw_mode&0xff=2:Table 2 / LPG Load-Limit}{derate2_dbw_mode&0xff=3:Table 3 / NG Load-Limit}{derate2_dbw_mode&0xff" VALUE 0x0014813e /* @ECU_Address@derate2_dbw_mode@0x0100FBB0@ */ ECIPP_ALIGNMENT_UBYTE 255 derate2_dbw_mode_COMPU_VTAB 0 255 BIT_MASK 0xff /end CHARACTERISTIC
/begin COMPU_METHOD derate2_dbw_mode_COMPU_VTAB "Verbal Table" TAB_VERB "%.0" "list" COMPU_TAB_REF derate2_dbw_mode_COMPU_VTAB_REF /end COMPU_METHOD
/begin COMPU_VTAB derate2_dbw_mode_COMPU_VTAB_REF "Verbal Table" TAB_VERB 9 0 "Power derate TPS limit" 1 "Table 1 / Gasoline Load-Limit" 2 "Table 2 / LPG Load-Limit" 3 "Table 3 / NG Load-Limit" 4 "Table 4 / Power Load-Limit" 5 "Table 5" 6 "Table 6" 7 "Table 7" 8 "Table 8" DEFAULT_VALUE "UNKNOWN" /end COMPU_VTAB
/begin MEASUREMENT DERATE_TPSlim "Derate TPS limit" ULONG Compu_DERATE_TPSlim 0 0 0 99.9999999767169 ECU_ADDRESS 0x0100FBB8 /end MEASUREMENT
/begin COMPU_METHOD Compu_DERATE_TPSlim " " RAT_FUNC "%.2" "%" COEFFS 0 42949672.96 0 0 0 1 /end COMPU_METHOD
/begin MEASUREMENT DERATE_loadlim "Derate load limit" ULONG Compu_DERATE_loadlim 0 0 0 99.9999999767169 ECU_ADDRESS 0x0100FBC0 /end MEASUREMENT
/begin COMPU_METHOD Compu_DERATE_loadlim " " RAT_FUNC "%.2" "%" COEFFS 0 42949672.96 0 0 0 1 /end COMPU_METHOD
/begin MEASUREMENT DERATE_TPSlim_use "Derate TPS limit active{DERATE_TPSlim_use&0xff=0:Inactive}{DERATE_TPSlim_use&0xff=1:Active}" UBYTE DERATE_TPSlim_use_COMPU_VTAB 0 0 0 255 ECU_ADDRESS 0x0100FBC8 BIT_MASK 0xff /end MEASUREMENT
/begin COMPU_METHOD DERATE_TPSlim_use_COMPU_VTAB "Verbal Table" TAB_VERB "%.0" "list" COMPU_TAB_REF DERATE_TPSlim_use_COMPU_VTAB_REF /end COMPU_METHOD
/begin COMPU_VTAB DERATE_TPSlim_use_COMPU_VTAB_REF "Verbal Table" TAB_VERB 2 0 "Inactive" 1 "Active" DEFAULT_VALUE "UNKNOWN" /end COMPU_VTAB
/begin MEASUREMENT DERATE_loadlim_use "Derate load limit active{DERATE_loadlim_use&0xff=0:Inactive}{DERATE_loadlim_use&0xff=1:Active}" UBYTE DERATE_loadlim_use_COMPU_VTAB 0 0 0 255 ECU_ADDRESS 0x0100FBD0 BIT_MASK 0xff /end MEASUREMENT
/begin COMPU_METHOD DERATE_loadlim_use_COMPU_VTAB "Verbal Table" TAB_VERB "%.0" "list" COMPU_TAB_REF DERATE_loadlim_use_COMPU_VTAB_REF /end COMPU_METHOD
/begin COMPU_VTAB DERATE_loadlim_use_COMPU_VTAB_REF "Verbal Table" TAB_VERB 2 0 "Inactive" 1 "Active" DEFAULT_VALUE "UNKNOWN" /end COMPU_VTAB
/begin MEASUREMENT DERATE_loadlim_slewd "Derate load limit engage slew{DERATE_loadlim_slewd&0xff=0:Inactive}{DERATE_loadlim_slewd&0xff=1:Active}" UBYTE DERATE_loadlim_slewd_COMPU_VTAB 0 0 0 255 ECU_ADDRESS 0x0100FBD8 BIT_MASK 0xff /end MEASUREMENT
/begin COMPU_METHOD DERATE_loadlim_slewd_COMPU_VTAB "Verbal Table" TAB_VERB "%.0" "list" COMPU_TAB_REF DERATE_loadlim_slewd_COMPU_VTAB_REF /end COMPU_METHOD
/begin COMPU_VTAB DERATE_loadlim_slewd_COMPU_VTAB_REF "Verbal Table" TAB_VERB 2 0 "Inactive" 1 "Active" DEFAULT_VALUE "UNKNOWN" /end COMPU_VTAB
/begin MEASUREMENT DERATE_FPPlim_use "Derate FPP limit active{DERATE_FPPlim_use&0xff=0:Inactive}{DERATE_FPPlim_use&0xff=1:Active}" UBYTE DERATE_FPPlim_use_COMPU_VTAB 0 0 0 255 ECU_ADDRESS 0x0100FBE0 BIT_MASK 0xff /end MEASUREMENT
/begin COMPU_METHOD DERATE_FPPlim_use_COMPU_VTAB "Verbal Table" TAB_VERB "%.0" "list" COMPU_TAB_REF DERATE_FPPlim_use_COMPU_VTAB_REF /end COMPU_METHOD
/begin COMPU_VTAB DERATE_FPPlim_use_COMPU_VTAB_REF "Verbal Table" TAB_VERB 2 0 "Inactive" 1 "Active" DEFAULT_VALUE "UNKNOWN" /end COMPU_VTAB
/begin MEASUREMENT DERATE_FPPlim "Derate FPP limit" ULONG Compu_DERATE_FPPlim 0 0 0 99.9999999767169 ECU_ADDRESS 0x0100FBE8 /end MEASUREMENT
/begin COMPU_METHOD Compu_DERATE_FPPlim " " RAT_FUNC "%.2" "%" COEFFS 0 42949672.96 0 0 0 1 /end COMPU_METHOD
/begin MEASUREMENT DERATE_FPPlim_rpm "Derate FPP limit rpm equivalent" UWORD Compu_DERATE_FPPlim_rpm 0 0 0 65535 ECU_ADDRESS 0x0100FBF0 /end MEASUREMENT
/begin COMPU_METHOD Compu_DERATE_FPPlim_rpm " " RAT_FUNC "%.0" "rpm" COEFFS 0 1 0 0 0 1 /end COMPU_METHOD
/begin MEASUREMENT LOWREVLIM_use "Low rev limit active{LOWREVLIM_use&0xff=0:Inactive}{LOWREVLIM_use&0xff=1:Active}" UBYTE LOWREVLIM_use_COMPU_VTAB 0 0 0 255 ECU_ADDRESS 0x0100FBF8 BIT_MASK 0xff /end MEASUREMENT
/begin COMPU_METHOD LOWREVLIM_use_COMPU_VTAB "Verbal Table" TAB_VERB "%.0" "list" COMPU_TAB_REF LOWREVLIM_use_COMPU_VTAB_REF /end COMPU_METHOD
/begin COMPU_VTAB LOWREVLIM_use_COMPU_VTAB_REF "Verbal Table" TAB_VERB 2 0 "Inactive" 1 "Active" DEFAULT_VALUE "UNKNOWN" /end COMPU_VTAB
/begin MEASUREMENT LoadLim_max_TPS_src "Load-limiting max TPS source{LoadLim_max_TPS_src&0xff=0:Default}{LoadLim_max_TPS_src&0xff=1:CFV Fuel Temp}{LoadLim_max_TPS_src&0xff=2:Load Limiting}{LoadLim_max_TPS_src&0xff=3:Load Limiting w/FIMP}{LoadLim_max_TPS_src&0xff=4:Remote TSC1}{LoadLim_max_TPS_s" UBYTE LoadLim_max_TPS_src_COMPU_VTAB 0 0 0 255 ECU_ADDRESS 0x0100FC00 BIT_MASK 0xff /end MEASUREMENT
/begin COMPU_METHOD LoadLim_max_TPS_src_COMPU_VTAB "Verbal Table" TAB_VERB "%.0" "list" COMPU_TAB_REF LoadLim_max_TPS_src_COMPU_VTAB_REF /end COMPU_METHOD
/begin COMPU_VTAB LoadLim_max_TPS_src_COMPU_VTAB_REF "Verbal Table" TAB_VERB 20 0 "Default" 1 "CFV Fuel Temp" 2 "Load Limiting" 3 "Load Limiting w/FIMP" 4 "Remote TSC1" 5 "Derate" 6 "ECT" 7 "Aux Temp 1" 8 "Trans Shift" 9 "Low Fuel Level" 10 "PTO" 11 "EGR" 12 "Altitude" 13 "Misfire Cat Protection" 14 "Transmission Gear" 15 "Fuel Inlet Pressure" 16 "Inducement" 17 "Aux Temp 2" 18 "Low Fuel Pressure" 19 "Transmission Comm Loss" DEFAULT_VALUE "UNKNOWN" /end COMPU_VTAB
/begin CHARACTERISTIC LLTO_pct "Load-limit override" VALUE 0x00147550 /* @ECU_Address@LLTO_pct@0x01010028@ */ ECIPP_ALIGNMENT_UWORD 400 Compu_LLTO_pct 0 399.993896484375 /end CHARACTERISTIC
/begin COMPU_METHOD Compu_LLTO_pct " " RAT_FUNC "%.1" "%/LL" COEFFS 0 163.84 0 0 0 1 /end COMPU_METHOD
/begin CHARACTERISTIC LLTO_VE_CWT_crct_pct "VE CWT correction" VALUE 0x0014433a /* @ECU_Address@LLTO_VE_CWT_crct_pct@0x01010030@ */ ECIPP_ALIGNMENT_SWORD 100 Compu_LLTO_VE_CWT_crct_pct -100 99.9969482421875 /end CHARACTERISTIC
/begin COMPU_METHOD Compu_LLTO_VE_CWT_crct_pct " " RAT_FUNC "%.1" "%" COEFFS 0 327.68 0 0 0 1 /end COMPU_METHOD
/begin CHARACTERISTIC LLTO_hold_time "Hold time" VALUE 0x0014754e /* @ECU_Address@LLTO_hold_time@0x01010038@ */ ECIPP_ALIGNMENT_UWORD 66 Compu_LLTO_hold_time 0 65.535 /end CHARACTERISTIC
/begin COMPU_METHOD Compu_LLTO_hold_time " " RAT_FUNC "%.2" "sec" COEFFS 0 1000 0 0 0 1 /end COMPU_METHOD
/begin CHARACTERISTIC LLTO_slew_rate "Slew down rate" VALUE 0x00147558 /* @ECU_Address@LLTO_slew_rate@0x01010040@ */ ECIPP_ALIGNMENT_UWORD 400 Compu_LLTO_slew_rate 0 399.993896484375 /end CHARACTERISTIC
/begin COMPU_METHOD Compu_LLTO_slew_rate " " RAT_FUNC "%.1" "%/sec" COEFFS 0 163.84 0 0 0 1 /end COMPU_METHOD
/begin MEASUREMENT LLTO_state "Override state{LLTO_state&0xff=0:Off}{LLTO_state&0xff=1:Enabled}{LLTO_state&0xff=2:Active Init}{LLTO_state&0xff=3:Active}{LLTO_state&0xff=4:Hold Timer}{LLTO_state&0xff=5:Slew Init}{LLTO_state&0xff=6:Slew Down}" UBYTE LLTO_state_COMPU_VTAB 0 0 0 255 ECU_ADDRESS 0x01010048 BIT_MASK 0xff /end MEASUREMENT
/begin COMPU_METHOD LLTO_state_COMPU_VTAB "Verbal Table" TAB_VERB "%.0" "list" COMPU_TAB_REF LLTO_state_COMPU_VTAB_REF /end COMPU_METHOD
/begin COMPU_VTAB LLTO_state_COMPU_VTAB_REF "Verbal Table" TAB_VERB 7 0 "Off" 1 "Enabled" 2 "Active Init" 3 "Active" 4 "Hold Timer" 5 "Slew Init" 6 "Slew Down" DEFAULT_VALUE "UNKNOWN" /end COMPU_VTAB
/begin MEASUREMENT LLTO_hold_tmr "Hold timer" UWORD Compu_LLTO_hold_tmr 0 0 0 65.535 ECU_ADDRESS 0x01010050 /end MEASUREMENT
/begin COMPU_METHOD Compu_LLTO_hold_tmr " " RAT_FUNC "%.2" "sec" COEFFS 0 1000 0 0 0 1 /end COMPU_METHOD
/begin MEASUREMENT LLTO_pct_inc "Load-limiting max load override" UWORD Compu_LLTO_pct_inc 0 0 0 399.993896484375 ECU_ADDRESS 0x01010058 /end MEASUREMENT
/begin COMPU_METHOD Compu_LLTO_pct_inc " " RAT_FUNC "%.1" "%" COEFFS 0 163.84 0 0 0 1 /end COMPU_METHOD
/begin MEASUREMENT LLTO_actv "LLTO_actv{LLTO_actv&0xff=0x00:Off}{LLTO_actv&0xff=0x01:On}" UBYTE LLTO_actv_COMPU_VTAB 0 0 0 255 ECU_ADDRESS 0x01010060 BIT_MASK 0xff /end MEASUREMENT
/begin COMPU_METHOD LLTO_actv_COMPU_VTAB "Verbal Table" TAB_VERB "%.0" "list" COMPU_TAB_REF LLTO_actv_COMPU_VTAB_REF /end COMPU_METHOD
/begin COMPU_VTAB LLTO_actv_COMPU_VTAB_REF "Verbal Table" TAB_VERB 2 0x00 "Off" 0x01 "On" DEFAULT_VALUE "UNKNOWN" /end COMPU_VTAB
/begin CHARACTERISTIC TEL_enable_Yuchai2 "Telematics system 4{TEL_enable_Yuchai2&0xff=0:Disabled}{TEL_enable_Yuchai2&0xff=1:Enabled - message set 1}{TEL_enable_Yuchai2&0xff=2:Enabled - message set 2}" VALUE 0x00148097 /* @ECU_Address@TEL_enable_Yuchai2@0x010105D8@ */ ECIPP_ALIGNMENT_UBYTE 255 TEL_enable_Yuchai2_COMPU_VTAB 0 255 BIT_MASK 0xff /end CHARACTERISTIC
/begin COMPU_METHOD TEL_enable_Yuchai2_COMPU_VTAB "Verbal Table" TAB_VERB "%.0" "list" COMPU_TAB_REF TEL_enable_Yuchai2_COMPU_VTAB_REF /end COMPU_METHOD
/begin COMPU_VTAB TEL_enable_Yuchai2_COMPU_VTAB_REF "Verbal Table" TAB_VERB 3 0 "Disabled" 1 "Enabled - message set 1" 2 "Enabled - message set 2" DEFAULT_VALUE "UNKNOWN" /end COMPU_VTAB
/begin MEASUREMENT TEL_key_msb "Telematics encryption key MSB" ULONG Compu_TEL_key_msb 0 0 0 4294967295 ECU_ADDRESS 0x010105E0 /end MEASUREMENT
/begin COMPU_METHOD Compu_TEL_key_msb " " RAT_FUNC "%.0" "-" COEFFS 0 1 0 0 0 1 /end COMPU_METHOD
/begin MEASUREMENT TEL_key_lsb "Telematics encryption key LSB" ULONG Compu_TEL_key_lsb 0 0 0 4294967295 ECU_ADDRESS 0x010105E8 /end MEASUREMENT
/begin COMPU_METHOD Compu_TEL_key_lsb " " RAT_FUNC "%.0" "-" COEFFS 0 1 0 0 0 1 /end COMPU_METHOD
/begin CHARACTERISTIC TEL_seed_upd_rate "Telematics seed update rate" VALUE 0x001441d8 /* @ECU_Address@TEL_seed_upd_rate@0x010106E0@ */ ECIPP_ALIGNMENT_ULONG 4294967 Compu_TEL_seed_upd_rate 0 4294967.295 /end CHARACTERISTIC
/begin COMPU_METHOD Compu_TEL_seed_upd_rate " " RAT_FUNC "%.1" "seconds" COEFFS 0 1000 0 0 0 1 /end COMPU_METHOD
/begin CHARACTERISTIC LoadLim_T1_fuel "Load-limiting Table 1 fuel type{LoadLim_T1_fuel&0xff=0:Disabled}{LoadLim_T1_fuel&0xff=1:All Fuels}{LoadLim_T1_fuel&0xff=2:Gasoline}{LoadLim_T1_fuel&0xff=3:LPG}{LoadLim_T1_fuel&0xff=4:NG}" VALUE 0x00147E3C /* @ECU_Address@LoadLim_T1_fuel@0x01010800@ */ ECIPP_ALIGNMENT_UBYTE 255 LoadLim_T1_fuel_COMPU_VTAB 0 255 BIT_MASK 0xff /end CHARACTERISTIC
/begin COMPU_METHOD LoadLim_T1_fuel_COMPU_VTAB "Verbal Table" TAB_VERB "%.0" "list" COMPU_TAB_REF LoadLim_T1_fuel_COMPU_VTAB_REF /end COMPU_METHOD
/begin COMPU_VTAB LoadLim_T1_fuel_COMPU_VTAB_REF "Verbal Table" TAB_VERB 5 0 "Disabled" 1 "All Fuels" 2 "Gasoline" 3 "LPG" 4 "NG" DEFAULT_VALUE "UNKNOWN" /end COMPU_VTAB
/begin CHARACTERISTIC LoadLim_T2_fuel "Load-limiting Table 2 fuel type{LoadLim_T2_fuel&0xff=0:Disabled}{LoadLim_T2_fuel&0xff=1:All Fuels}{LoadLim_T2_fuel&0xff=2:Gasoline}{LoadLim_T2_fuel&0xff=3:LPG}{LoadLim_T2_fuel&0xff=4:NG}" VALUE 0x00147E3D /* @ECU_Address@LoadLim_T2_fuel@0x01010808@ */ ECIPP_ALIGNMENT_UBYTE 255 LoadLim_T2_fuel_COMPU_VTAB 0 255 BIT_MASK 0xff /end CHARACTERISTIC
/begin COMPU_METHOD LoadLim_T2_fuel_COMPU_VTAB "Verbal Table" TAB_VERB "%.0" "list" COMPU_TAB_REF LoadLim_T2_fuel_COMPU_VTAB_REF /end COMPU_METHOD
/begin COMPU_VTAB LoadLim_T2_fuel_COMPU_VTAB_REF "Verbal Table" TAB_VERB 5 0 "Disabled" 1 "All Fuels" 2 "Gasoline" 3 "LPG" 4 "NG" DEFAULT_VALUE "UNKNOWN" /end COMPU_VTAB
/begin CHARACTERISTIC LoadLim_T3_fuel "Load-limiting Table 3 fuel type{LoadLim_T3_fuel&0xff=0:Disabled}{LoadLim_T3_fuel&0xff=1:All Fuels}{LoadLim_T3_fuel&0xff=2:Gasoline}{LoadLim_T3_fuel&0xff=3:LPG}{LoadLim_T3_fuel&0xff=4:NG}" VALUE 0x00147E3E /* @ECU_Address@LoadLim_T3_fuel@0x01010810@ */ ECIPP_ALIGNMENT_UBYTE 255 LoadLim_T3_fuel_COMPU_VTAB 0 255 BIT_MASK 0xff /end CHARACTERISTIC
/begin COMPU_METHOD LoadLim_T3_fuel_COMPU_VTAB "Verbal Table" TAB_VERB "%.0" "list" COMPU_TAB_REF LoadLim_T3_fuel_COMPU_VTAB_REF /end COMPU_METHOD
/begin COMPU_VTAB LoadLim_T3_fuel_COMPU_VTAB_REF "Verbal Table" TAB_VERB 5 0 "Disabled" 1 "All Fuels" 2 "Gasoline" 3 "LPG" 4 "NG" DEFAULT_VALUE "UNKNOWN" /end COMPU_VTAB
/begin CHARACTERISTIC LoadLim_T4_fuel "Load-limiting Table 4 fuel type{LoadLim_T4_fuel&0xff=0:Disabled}{LoadLim_T4_fuel&0xff=1:All Fuels}{LoadLim_T4_fuel&0xff=2:Gasoline}{LoadLim_T4_fuel&0xff=3:LPG}{LoadLim_T4_fuel&0xff=4:NG}" VALUE 0x00147E3F /* @ECU_Address@LoadLim_T4_fuel@0x01010818@ */ ECIPP_ALIGNMENT_UBYTE 255 LoadLim_T4_fuel_COMPU_VTAB 0 255 BIT_MASK 0xff /end CHARACTERISTIC
/begin COMPU_METHOD LoadLim_T4_fuel_COMPU_VTAB "Verbal Table" TAB_VERB "%.0" "list" COMPU_TAB_REF LoadLim_T4_fuel_COMPU_VTAB_REF /end COMPU_METHOD
/begin COMPU_VTAB LoadLim_T4_fuel_COMPU_VTAB_REF "Verbal Table" TAB_VERB 5 0 "Disabled" 1 "All Fuels" 2 "Gasoline" 3 "LPG" 4 "NG" DEFAULT_VALUE "UNKNOWN" /end COMPU_VTAB
/begin CHARACTERISTIC LoadLim_T5_fuel "Load-limiting Table 5 fuel type{LoadLim_T5_fuel&0xff=0:Disabled}{LoadLim_T5_fuel&0xff=1:All Fuels}{LoadLim_T5_fuel&0xff=2:Gasoline}{LoadLim_T5_fuel&0xff=3:LPG}{LoadLim_T5_fuel&0xff=4:NG}" VALUE 0x00147E40 /* @ECU_Address@LoadLim_T5_fuel@0x01010820@ */ ECIPP_ALIGNMENT_UBYTE 255 LoadLim_T5_fuel_COMPU_VTAB 0 255 BIT_MASK 0xff /end CHARACTERISTIC
/begin COMPU_METHOD LoadLim_T5_fuel_COMPU_VTAB "Verbal Table" TAB_VERB "%.0" "list" COMPU_TAB_REF LoadLim_T5_fuel_COMPU_VTAB_REF /end COMPU_METHOD
/begin COMPU_VTAB LoadLim_T5_fuel_COMPU_VTAB_REF "Verbal Table" TAB_VERB 5 0 "Disabled" 1 "All Fuels" 2 "Gasoline" 3 "LPG" 4 "NG" DEFAULT_VALUE "UNKNOWN" /end COMPU_VTAB
/begin CHARACTERISTIC LoadLim_T6_fuel "Load-limiting Table 6 fuel type{LoadLim_T6_fuel&0xff=0:Disabled}{LoadLim_T6_fuel&0xff=1:All Fuels}{LoadLim_T6_fuel&0xff=2:Gasoline}{LoadLim_T6_fuel&0xff=3:LPG}{LoadLim_T6_fuel&0xff=4:NG}" VALUE 0x00147E41 /* @ECU_Address@LoadLim_T6_fuel@0x01010828@ */ ECIPP_ALIGNMENT_UBYTE 255 LoadLim_T6_fuel_COMPU_VTAB 0 255 BIT_MASK 0xff /end CHARACTERISTIC
/begin COMPU_METHOD LoadLim_T6_fuel_COMPU_VTAB "Verbal Table" TAB_VERB "%.0" "list" COMPU_TAB_REF LoadLim_T6_fuel_COMPU_VTAB_REF /end COMPU_METHOD
/begin COMPU_VTAB LoadLim_T6_fuel_COMPU_VTAB_REF "Verbal Table" TAB_VERB 5 0 "Disabled" 1 "All Fuels" 2 "Gasoline" 3 "LPG" 4 "NG" DEFAULT_VALUE "UNKNOWN" /end COMPU_VTAB
/begin CHARACTERISTIC LoadLim_T1_chan "Load-limiting Table 1 input{LoadLim_T1_chan&0xff=0:Disabled}{LoadLim_T1_chan&0xff=1:Aux PU1 = Gnd}{LoadLim_T1_chan&0xff=2:Aux PU2 = Gnd}{LoadLim_T1_chan&0xff=3:Aux PU3 = Gnd}{LoadLim_T1_chan&0xff=4:Aux PUD1 = Gnd}{LoadLim_T1_chan&0xff=5:Aux PUD2 = Gnd}{Lo" VALUE 0x00147E2A /* @ECU_Address@LoadLim_T1_chan@0x01010830@ */ ECIPP_ALIGNMENT_UBYTE 255 LoadLim_T1_chan_COMPU_VTAB 0 255 BIT_MASK 0xff /end CHARACTERISTIC
/begin COMPU_METHOD LoadLim_T1_chan_COMPU_VTAB "Verbal Table" TAB_VERB "%.0" "list" COMPU_TAB_REF LoadLim_T1_chan_COMPU_VTAB_REF /end COMPU_METHOD
/begin COMPU_VTAB LoadLim_T1_chan_COMPU_VTAB_REF "Verbal Table" TAB_VERB 30 0 "Disabled" 1 "Aux PU1 = Gnd" 2 "Aux PU2 = Gnd" 3 "Aux PU3 = Gnd" 4 "Aux PUD1 = Gnd" 5 "Aux PUD2 = Gnd" 6 "Aux PUD3 = Gnd" 7 "Aux PUD4 = +V" 8 "Aux PUD5 = Gnd" 9 "Aux DIG1" 10 "Aux DIG2" 11 "Aux DIG3" 12 "Aux DIG4" 13 "Aux DIG5" 14 "Aux DIG6" 15 "Aux DIG7" 16 "Aux DIG8" 17 "Aux DIG9" 18 "Aux DIG10" 19 "Aux DIG11" 20 "Aux DIG12" 21 "Aux DIG13" 22 "Aux DIG14" 23 "Aux DIG15" 24 "Aux DIG16" 25 "Aux DIG17" 26 "Aux DIG18" 27 "Aux DIG19" 28 "Gov1" 29 "Gov2" DEFAULT_VALUE "UNKNOWN" /end COMPU_VTAB
/begin CHARACTERISTIC LoadLim_T2_chan "Load-limiting Table 2 input{LoadLim_T2_chan&0xff=0:Disabled}{LoadLim_T2_chan&0xff=1:Aux PU1 = Gnd}{LoadLim_T2_chan&0xff=2:Aux PU2 = Gnd}{LoadLim_T2_chan&0xff=3:Aux PU3 = Gnd}{LoadLim_T2_chan&0xff=4:Aux PUD1 = Gnd}{LoadLim_T2_chan&0xff=5:Aux PUD2 = Gnd}{Lo" VALUE 0x00147E2B /* @ECU_Address@LoadLim_T2_chan@0x01010838@ */ ECIPP_ALIGNMENT_UBYTE 255 LoadLim_T2_chan_COMPU_VTAB 0 255 BIT_MASK 0xff /end CHARACTERISTIC
/begin COMPU_METHOD LoadLim_T2_chan_COMPU_VTAB "Verbal Table" TAB_VERB "%.0" "list" COMPU_TAB_REF LoadLim_T2_chan_COMPU_VTAB_REF /end COMPU_METHOD
/begin COMPU_VTAB LoadLim_T2_chan_COMPU_VTAB_REF "Verbal Table" TAB_VERB 30 0 "Disabled" 1 "Aux PU1 = Gnd" 2 "Aux PU2 = Gnd" 3 "Aux PU3 = Gnd" 4 "Aux PUD1 = Gnd" 5 "Aux PUD2 = Gnd" 6 "Aux PUD3 = Gnd" 7 "Aux PUD4 = +V" 8 "Aux PUD5 = Gnd" 9 "Aux DIG1" 10 "Aux DIG2" 11 "Aux DIG3" 12 "Aux DIG4" 13 "Aux DIG5" 14 "Aux DIG6" 15 "Aux DIG7" 16 "Aux DIG8" 17 "Aux DIG9" 18 "Aux DIG10" 19 "Aux DIG11" 20 "Aux DIG12" 21 "Aux DIG13" 22 "Aux DIG14" 23 "Aux DIG15" 24 "Aux DIG16" 25 "Aux DIG17" 26 "Aux DIG18" 27 "Aux DIG19" 28 "Gov1" 29 "Gov2" DEFAULT_VALUE "UNKNOWN" /end COMPU_VTAB
/begin CHARACTERISTIC LoadLim_T3_chan "Load-limiting Table 3 input{LoadLim_T3_chan&0xff=0:Disabled}{LoadLim_T3_chan&0xff=1:Aux PU1 = Gnd}{LoadLim_T3_chan&0xff=2:Aux PU2 = Gnd}{LoadLim_T3_chan&0xff=3:Aux PU3 = Gnd}{LoadLim_T3_chan&0xff=4:Aux PUD1 = Gnd}{LoadLim_T3_chan&0xff=5:Aux PUD2 = Gnd}{Lo" VALUE 0x00147E2C /* @ECU_Address@LoadLim_T3_chan@0x01010840@ */ ECIPP_ALIGNMENT_UBYTE 255 LoadLim_T3_chan_COMPU_VTAB 0 255 BIT_MASK 0xff /end CHARACTERISTIC
/begin COMPU_METHOD LoadLim_T3_chan_COMPU_VTAB "Verbal Table" TAB_VERB "%.0" "list" COMPU_TAB_REF LoadLim_T3_chan_COMPU_VTAB_REF /end COMPU_METHOD
/begin COMPU_VTAB LoadLim_T3_chan_COMPU_VTAB_REF "Verbal Table" TAB_VERB 30 0 "Disabled" 1 "Aux PU1 = Gnd" 2 "Aux PU2 = Gnd" 3 "Aux PU3 = Gnd" 4 "Aux PUD1 = Gnd" 5 "Aux PUD2 = Gnd" 6 "Aux PUD3 = Gnd" 7 "Aux PUD4 = +V" 8 "Aux PUD5 = Gnd" 9 "Aux DIG1" 10 "Aux DIG2" 11 "Aux DIG3" 12 "Aux DIG4" 13 "Aux DIG5" 14 "Aux DIG6" 15 "Aux DIG7" 16 "Aux DIG8" 17 "Aux DIG9" 18 "Aux DIG10" 19 "Aux DIG11" 20 "Aux DIG12" 21 "Aux DIG13" 22 "Aux DIG14" 23 "Aux DIG15" 24 "Aux DIG16" 25 "Aux DIG17" 26 "Aux DIG18" 27 "Aux DIG19" 28 "Gov1" 29 "Gov2" DEFAULT_VALUE "UNKNOWN" /end COMPU_VTAB
/begin CHARACTERISTIC LoadLim_T4_chan "Load-limiting Table 4 input{LoadLim_T4_chan&0xff=0:Disabled}{LoadLim_T4_chan&0xff=1:Aux PU1 = Gnd}{LoadLim_T4_chan&0xff=2:Aux PU2 = Gnd}{LoadLim_T4_chan&0xff=3:Aux PU3 = Gnd}{LoadLim_T4_chan&0xff=4:Aux PUD1 = Gnd}{LoadLim_T4_chan&0xff=5:Aux PUD2 = Gnd}{Lo" VALUE 0x00147E2D /* @ECU_Address@LoadLim_T4_chan@0x01010848@ */ ECIPP_ALIGNMENT_UBYTE 255 LoadLim_T4_chan_COMPU_VTAB 0 255 BIT_MASK 0xff /end CHARACTERISTIC
/begin COMPU_METHOD LoadLim_T4_chan_COMPU_VTAB "Verbal Table" TAB_VERB "%.0" "list" COMPU_TAB_REF LoadLim_T4_chan_COMPU_VTAB_REF /end COMPU_METHOD
/begin COMPU_VTAB LoadLim_T4_chan_COMPU_VTAB_REF "Verbal Table" TAB_VERB 30 0 "Disabled" 1 "Aux PU1 = Gnd" 2 "Aux PU2 = Gnd" 3 "Aux PU3 = Gnd" 4 "Aux PUD1 = Gnd" 5 "Aux PUD2 = Gnd" 6 "Aux PUD3 = Gnd" 7 "Aux PUD4 = +V" 8 "Aux PUD5 = Gnd" 9 "Aux DIG1" 10 "Aux DIG2" 11 "Aux DIG3" 12 "Aux DIG4" 13 "Aux DIG5" 14 "Aux DIG6" 15 "Aux DIG7" 16 "Aux DIG8" 17 "Aux DIG9" 18 "Aux DIG10" 19 "Aux DIG11" 20 "Aux DIG12" 21 "Aux DIG13" 22 "Aux DIG14" 23 "Aux DIG15" 24 "Aux DIG16" 25 "Aux DIG17" 26 "Aux DIG18" 27 "Aux DIG19" 28 "Gov1" 29 "Gov2" DEFAULT_VALUE "UNKNOWN" /end COMPU_VTAB
/begin CHARACTERISTIC LoadLim_T5_chan "Load-limiting Table 5 input{LoadLim_T5_chan&0xff=0:Disabled}{LoadLim_T5_chan&0xff=1:Aux PU1 = Gnd}{LoadLim_T5_chan&0xff=2:Aux PU2 = Gnd}{LoadLim_T5_chan&0xff=3:Aux PU3 = Gnd}{LoadLim_T5_chan&0xff=4:Aux PUD1 = Gnd}{LoadLim_T5_chan&0xff=5:Aux PUD2 = Gnd}{Lo" VALUE 0x00147E2E /* @ECU_Address@LoadLim_T5_chan@0x01010850@ */ ECIPP_ALIGNMENT_UBYTE 255 LoadLim_T5_chan_COMPU_VTAB 0 255 BIT_MASK 0xff /end CHARACTERISTIC
/begin COMPU_METHOD LoadLim_T5_chan_COMPU_VTAB "Verbal Table" TAB_VERB "%.0" "list" COMPU_TAB_REF LoadLim_T5_chan_COMPU_VTAB_REF /end COMPU_METHOD
/begin COMPU_VTAB LoadLim_T5_chan_COMPU_VTAB_REF "Verbal Table" TAB_VERB 30 0 "Disabled" 1 "Aux PU1 = Gnd" 2 "Aux PU2 = Gnd" 3 "Aux PU3 = Gnd" 4 "Aux PUD1 = Gnd" 5 "Aux PUD2 = Gnd" 6 "Aux PUD3 = Gnd" 7 "Aux PUD4 = +V" 8 "Aux PUD5 = Gnd" 9 "Aux DIG1" 10 "Aux DIG2" 11 "Aux DIG3" 12 "Aux DIG4" 13 "Aux DIG5" 14 "Aux DIG6" 15 "Aux DIG7" 16 "Aux DIG8" 17 "Aux DIG9" 18 "Aux DIG10" 19 "Aux DIG11" 20 "Aux DIG12" 21 "Aux DIG13" 22 "Aux DIG14" 23 "Aux DIG15" 24 "Aux DIG16" 25 "Aux DIG17" 26 "Aux DIG18" 27 "Aux DIG19" 28 "Gov1" 29 "Gov2" DEFAULT_VALUE "UNKNOWN" /end COMPU_VTAB
/begin CHARACTERISTIC LoadLim_T6_chan "Load-limiting Table 6 input{LoadLim_T6_chan&0xff=0:Disabled}{LoadLim_T6_chan&0xff=1:Aux PU1 = Gnd}{LoadLim_T6_chan&0xff=2:Aux PU2 = Gnd}{LoadLim_T6_chan&0xff=3:Aux PU3 = Gnd}{LoadLim_T6_chan&0xff=4:Aux PUD1 = Gnd}{LoadLim_T6_chan&0xff=5:Aux PUD2 = Gnd}{Lo" VALUE 0x00147E2F /* @ECU_Address@LoadLim_T6_chan@0x01010858@ */ ECIPP_ALIGNMENT_UBYTE 255 LoadLim_T6_chan_COMPU_VTAB 0 255 BIT_MASK 0xff /end CHARACTERISTIC
/begin COMPU_METHOD LoadLim_T6_chan_COMPU_VTAB "Verbal Table" TAB_VERB "%.0" "list" COMPU_TAB_REF LoadLim_T6_chan_COMPU_VTAB_REF /end COMPU_METHOD
/begin COMPU_VTAB LoadLim_T6_chan_COMPU_VTAB_REF "Verbal Table" TAB_VERB 30 0 "Disabled" 1 "Aux PU1 = Gnd" 2 "Aux PU2 = Gnd" 3 "Aux PU3 = Gnd" 4 "Aux PUD1 = Gnd" 5 "Aux PUD2 = Gnd" 6 "Aux PUD3 = Gnd" 7 "Aux PUD4 = +V" 8 "Aux PUD5 = Gnd" 9 "Aux DIG1" 10 "Aux DIG2" 11 "Aux DIG3" 12 "Aux DIG4" 13 "Aux DIG5" 14 "Aux DIG6" 15 "Aux DIG7" 16 "Aux DIG8" 17 "Aux DIG9" 18 "Aux DIG10" 19 "Aux DIG11" 20 "Aux DIG12" 21 "Aux DIG13" 22 "Aux DIG14" 23 "Aux DIG15" 24 "Aux DIG16" 25 "Aux DIG17" 26 "Aux DIG18" 27 "Aux DIG19" 28 "Gov1" 29 "Gov2" DEFAULT_VALUE "UNKNOWN" /end COMPU_VTAB
/begin CHARACTERISTIC LoadLim_T1_chan_cfg "Load-limiting Table 1 input config{LoadLim_T1_chan_cfg&0xff=0:Default}{LoadLim_T1_chan_cfg&0xff=1:DIG - GND}{LoadLim_T1_chan_cfg&0xff=2:DIG - GND/+V}{LoadLim_T1_chan_cfg&0xff=3:DIG - V+}{LoadLim_T1_chan_cfg&0xff=4:DIG - Open}{LoadLim_T1_chan_cfg&0xff=5:An" VALUE 0x00147E32 /* @ECU_Address@LoadLim_T1_chan_cfg@0x01010860@ */ ECIPP_ALIGNMENT_UBYTE 255 LoadLim_T1_chan_cfg_COMPU_VTAB 0 255 BIT_MASK 0xff /end CHARACTERISTIC
/begin COMPU_METHOD LoadLim_T1_chan_cfg_COMPU_VTAB "Verbal Table" TAB_VERB "%.0" "list" COMPU_TAB_REF LoadLim_T1_chan_cfg_COMPU_VTAB_REF /end COMPU_METHOD
/begin COMPU_VTAB LoadLim_T1_chan_cfg_COMPU_VTAB_REF "Verbal Table" TAB_VERB 9 0 "Default" 1 "DIG - GND" 2 "DIG - GND/+V" 3 "DIG - V+" 4 "DIG - Open" 5 "Analog - GND/+V" 6 "Analog - A" 7 "Analog - B" 8 "Analog - C" DEFAULT_VALUE "UNKNOWN" /end COMPU_VTAB
/begin CHARACTERISTIC LoadLim_T2_chan_cfg "Load-limiting Table 2 input config{LoadLim_T2_chan_cfg&0xff=0:Default}{LoadLim_T2_chan_cfg&0xff=1:DIG - GND}{LoadLim_T2_chan_cfg&0xff=2:DIG - GND/+V}{LoadLim_T2_chan_cfg&0xff=3:DIG - V+}{LoadLim_T2_chan_cfg&0xff=4:DIG - Open}{LoadLim_T2_chan_cfg&0xff=5:An" VALUE 0x00147E33 /* @ECU_Address@LoadLim_T2_chan_cfg@0x01010868@ */ ECIPP_ALIGNMENT_UBYTE 255 LoadLim_T2_chan_cfg_COMPU_VTAB 0 255 BIT_MASK 0xff /end CHARACTERISTIC
/begin COMPU_METHOD LoadLim_T2_chan_cfg_COMPU_VTAB "Verbal Table" TAB_VERB "%.0" "list" COMPU_TAB_REF LoadLim_T2_chan_cfg_COMPU_VTAB_REF /end COMPU_METHOD
/begin COMPU_VTAB LoadLim_T2_chan_cfg_COMPU_VTAB_REF "Verbal Table" TAB_VERB 9 0 "Default" 1 "DIG - GND" 2 "DIG - GND/+V" 3 "DIG - V+" 4 "DIG - Open" 5 "Analog - GND/+V" 6 "Analog - A" 7 "Analog - B" 8 "Analog - C" DEFAULT_VALUE "UNKNOWN" /end COMPU_VTAB
/begin CHARACTERISTIC LoadLim_T3_chan_cfg "Load-limiting Table 3 input config{LoadLim_T3_chan_cfg&0xff=0:Default}{LoadLim_T3_chan_cfg&0xff=1:DIG - GND}{LoadLim_T3_chan_cfg&0xff=2:DIG - GND/+V}{LoadLim_T3_chan_cfg&0xff=3:DIG - V+}{LoadLim_T3_chan_cfg&0xff=4:DIG - Open}{LoadLim_T3_chan_cfg&0xff=5:An" VALUE 0x00147E34 /* @ECU_Address@LoadLim_T3_chan_cfg@0x01010870@ */ ECIPP_ALIGNMENT_UBYTE 255 LoadLim_T3_chan_cfg_COMPU_VTAB 0 255 BIT_MASK 0xff /end CHARACTERISTIC
/begin COMPU_METHOD LoadLim_T3_chan_cfg_COMPU_VTAB "Verbal Table" TAB_VERB "%.0" "list" COMPU_TAB_REF LoadLim_T3_chan_cfg_COMPU_VTAB_REF /end COMPU_METHOD
/begin COMPU_VTAB LoadLim_T3_chan_cfg_COMPU_VTAB_REF "Verbal Table" TAB_VERB 9 0 "Default" 1 "DIG - GND" 2 "DIG - GND/+V" 3 "DIG - V+" 4 "DIG - Open" 5 "Analog - GND/+V" 6 "Analog - A" 7 "Analog - B" 8 "Analog - C" DEFAULT_VALUE "UNKNOWN" /end COMPU_VTAB
/begin CHARACTERISTIC LoadLim_T4_chan_cfg "Load-limiting Table 4 input config{LoadLim_T4_chan_cfg&0xff=0:Default}{LoadLim_T4_chan_cfg&0xff=1:DIG - GND}{LoadLim_T4_chan_cfg&0xff=2:DIG - GND/+V}{LoadLim_T4_chan_cfg&0xff=3:DIG - V+}{LoadLim_T4_chan_cfg&0xff=4:DIG - Open}{LoadLim_T4_chan_cfg&0xff=5:An" VALUE 0x00147E35 /* @ECU_Address@LoadLim_T4_chan_cfg@0x01010878@ */ ECIPP_ALIGNMENT_UBYTE 255 LoadLim_T4_chan_cfg_COMPU_VTAB 0 255 BIT_MASK 0xff /end CHARACTERISTIC
/begin COMPU_METHOD LoadLim_T4_chan_cfg_COMPU_VTAB "Verbal Table" TAB_VERB "%.0" "list" COMPU_TAB_REF LoadLim_T4_chan_cfg_COMPU_VTAB_REF /end COMPU_METHOD
/begin COMPU_VTAB LoadLim_T4_chan_cfg_COMPU_VTAB_REF "Verbal Table" TAB_VERB 9 0 "Default" 1 "DIG - GND" 2 "DIG - GND/+V" 3 "DIG - V+" 4 "DIG - Open" 5 "Analog - GND/+V" 6 "Analog - A" 7 "Analog - B" 8 "Analog - C" DEFAULT_VALUE "UNKNOWN" /end COMPU_VTAB
/begin CHARACTERISTIC LoadLim_T5_chan_cfg "Load-limiting Table 5 input config{LoadLim_T5_chan_cfg&0xff=0:Default}{LoadLim_T5_chan_cfg&0xff=1:DIG - GND}{LoadLim_T5_chan_cfg&0xff=2:DIG - GND/+V}{LoadLim_T5_chan_cfg&0xff=3:DIG - V+}{LoadLim_T5_chan_cfg&0xff=4:DIG - Open}{LoadLim_T5_chan_cfg&0xff=5:An" VALUE 0x00147E36 /* @ECU_Address@LoadLim_T5_chan_cfg@0x01010880@ */ ECIPP_ALIGNMENT_UBYTE 255 LoadLim_T5_chan_cfg_COMPU_VTAB 0 255 BIT_MASK 0xff /end CHARACTERISTIC
/begin COMPU_METHOD LoadLim_T5_chan_cfg_COMPU_VTAB "Verbal Table" TAB_VERB "%.0" "list" COMPU_TAB_REF LoadLim_T5_chan_cfg_COMPU_VTAB_REF /end COMPU_METHOD
/begin COMPU_VTAB LoadLim_T5_chan_cfg_COMPU_VTAB_REF "Verbal Table" TAB_VERB 9 0 "Default" 1 "DIG - GND" 2 "DIG - GND/+V" 3 "DIG - V+" 4 "DIG - Open" 5 "Analog - GND/+V" 6 "Analog - A" 7 "Analog - B" 8 "Analog - C" DEFAULT_VALUE "UNKNOWN" /end COMPU_VTAB
/begin CHARACTERISTIC LoadLim_T6_chan_cfg "Load-limiting Table 6 input config{LoadLim_T6_chan_cfg&0xff=0:Default}{LoadLim_T6_chan_cfg&0xff=1:DIG - GND}{LoadLim_T6_chan_cfg&0xff=2:DIG - GND/+V}{LoadLim_T6_chan_cfg&0xff=3:DIG - V+}{LoadLim_T6_chan_cfg&0xff=4:DIG - Open}{LoadLim_T6_chan_cfg&0xff=5:An" VALUE 0x00147E37 /* @ECU_Address@LoadLim_T6_chan_cfg@0x01010888@ */ ECIPP_ALIGNMENT_UBYTE 255 LoadLim_T6_chan_cfg_COMPU_VTAB 0 255 BIT_MASK 0xff /end CHARACTERISTIC
/begin COMPU_METHOD LoadLim_T6_chan_cfg_COMPU_VTAB "Verbal Table" TAB_VERB "%.0" "list" COMPU_TAB_REF LoadLim_T6_chan_cfg_COMPU_VTAB_REF /end COMPU_METHOD
/begin COMPU_VTAB LoadLim_T6_chan_cfg_COMPU_VTAB_REF "Verbal Table" TAB_VERB 9 0 "Default" 1 "DIG - GND" 2 "DIG - GND/+V" 3 "DIG - V+" 4 "DIG - Open" 5 "Analog - GND/+V" 6 "Analog - A" 7 "Analog - B" 8 "Analog - C" DEFAULT_VALUE "UNKNOWN" /end COMPU_VTAB
/begin CHARACTERISTIC LoadLim_T1_ntwk "Load-limiting Table 1 ntwk select{LoadLim_T1_ntwk&0xff=0:Disabled}{LoadLim_T1_ntwk&0xff=1:Table Number}{LoadLim_T1_ntwk&0xff=2:Performance}{LoadLim_T1_ntwk&0xff=3:Economy}" VALUE 0x00147E47 /* @ECU_Address@LoadLim_T1_ntwk@0x01010890@ */ ECIPP_ALIGNMENT_UBYTE 255 LoadLim_T1_ntwk_COMPU_VTAB 0 255 BIT_MASK 0xff /end CHARACTERISTIC
/begin COMPU_METHOD LoadLim_T1_ntwk_COMPU_VTAB "Verbal Table" TAB_VERB "%.0" "list" COMPU_TAB_REF LoadLim_T1_ntwk_COMPU_VTAB_REF /end COMPU_METHOD
/begin COMPU_VTAB LoadLim_T1_ntwk_COMPU_VTAB_REF "Verbal Table" TAB_VERB 4 0 "Disabled" 1 "Table Number" 2 "Performance" 3 "Economy" DEFAULT_VALUE "UNKNOWN" /end COMPU_VTAB
/begin CHARACTERISTIC LoadLim_T2_ntwk "Load-limiting Table 2 ntwk select{LoadLim_T2_ntwk&0xff=0:Disabled}{LoadLim_T2_ntwk&0xff=1:Table Number}{LoadLim_T2_ntwk&0xff=2:Performance}{LoadLim_T2_ntwk&0xff=3:Economy}" VALUE 0x00147E48 /* @ECU_Address@LoadLim_T2_ntwk@0x01010898@ */ ECIPP_ALIGNMENT_UBYTE 255 LoadLim_T2_ntwk_COMPU_VTAB 0 255 BIT_MASK 0xff /end CHARACTERISTIC
/begin COMPU_METHOD LoadLim_T2_ntwk_COMPU_VTAB "Verbal Table" TAB_VERB "%.0" "list" COMPU_TAB_REF LoadLim_T2_ntwk_COMPU_VTAB_REF /end COMPU_METHOD
/begin COMPU_VTAB LoadLim_T2_ntwk_COMPU_VTAB_REF "Verbal Table" TAB_VERB 4 0 "Disabled" 1 "Table Number" 2 "Performance" 3 "Economy" DEFAULT_VALUE "UNKNOWN" /end COMPU_VTAB
/begin CHARACTERISTIC LoadLim_T3_ntwk "Load-limiting Table 3 ntwk select{LoadLim_T3_ntwk&0xff=0:Disabled}{LoadLim_T3_ntwk&0xff=1:Table Number}{LoadLim_T3_ntwk&0xff=2:Performance}{LoadLim_T3_ntwk&0xff=3:Economy}" VALUE 0x00147E49 /* @ECU_Address@LoadLim_T3_ntwk@0x010108A0@ */ ECIPP_ALIGNMENT_UBYTE 255 LoadLim_T3_ntwk_COMPU_VTAB 0 255 BIT_MASK 0xff /end CHARACTERISTIC
/begin COMPU_METHOD LoadLim_T3_ntwk_COMPU_VTAB "Verbal Table" TAB_VERB "%.0" "list" COMPU_TAB_REF LoadLim_T3_ntwk_COMPU_VTAB_REF /end COMPU_METHOD
/begin COMPU_VTAB LoadLim_T3_ntwk_COMPU_VTAB_REF "Verbal Table" TAB_VERB 4 0 "Disabled" 1 "Table Number" 2 "Performance" 3 "Economy" DEFAULT_VALUE "UNKNOWN" /end COMPU_VTAB
/begin CHARACTERISTIC LoadLim_T4_ntwk "Load-limiting Table 4 ntwk select{LoadLim_T4_ntwk&0xff=0:Disabled}{LoadLim_T4_ntwk&0xff=1:Table Number}{LoadLim_T4_ntwk&0xff=2:Performance}{LoadLim_T4_ntwk&0xff=3:Economy}" VALUE 0x00147E4A /* @ECU_Address@LoadLim_T4_ntwk@0x010108A8@ */ ECIPP_ALIGNMENT_UBYTE 255 LoadLim_T4_ntwk_COMPU_VTAB 0 255 BIT_MASK 0xff /end CHARACTERISTIC
/begin COMPU_METHOD LoadLim_T4_ntwk_COMPU_VTAB "Verbal Table" TAB_VERB "%.0" "list" COMPU_TAB_REF LoadLim_T4_ntwk_COMPU_VTAB_REF /end COMPU_METHOD
/begin COMPU_VTAB LoadLim_T4_ntwk_COMPU_VTAB_REF "Verbal Table" TAB_VERB 4 0 "Disabled" 1 "Table Number" 2 "Performance" 3 "Economy" DEFAULT_VALUE "UNKNOWN" /end COMPU_VTAB
/begin CHARACTERISTIC LoadLim_T5_ntwk "Load-limiting Table 5 ntwk select{LoadLim_T5_ntwk&0xff=0:Disabled}{LoadLim_T5_ntwk&0xff=1:Table Number}{LoadLim_T5_ntwk&0xff=2:Performance}{LoadLim_T5_ntwk&0xff=3:Economy}" VALUE 0x00147E4B /* @ECU_Address@LoadLim_T5_ntwk@0x010108B0@ */ ECIPP_ALIGNMENT_UBYTE 255 LoadLim_T5_ntwk_COMPU_VTAB 0 255 BIT_MASK 0xff /end CHARACTERISTIC
/begin COMPU_METHOD LoadLim_T5_ntwk_COMPU_VTAB "Verbal Table" TAB_VERB "%.0" "list" COMPU_TAB_REF LoadLim_T5_ntwk_COMPU_VTAB_REF /end COMPU_METHOD
/begin COMPU_VTAB LoadLim_T5_ntwk_COMPU_VTAB_REF "Verbal Table" TAB_VERB 4 0 "Disabled" 1 "Table Number" 2 "Performance" 3 "Economy" DEFAULT_VALUE "UNKNOWN" /end COMPU_VTAB
/begin CHARACTERISTIC LoadLim_T6_ntwk "Load-limiting Table 6 ntwk select{LoadLim_T6_ntwk&0xff=0:Disabled}{LoadLim_T6_ntwk&0xff=1:Table Number}{LoadLim_T6_ntwk&0xff=2:Performance}{LoadLim_T6_ntwk&0xff=3:Economy}" VALUE 0x00147E4C /* @ECU_Address@LoadLim_T6_ntwk@0x010108B8@ */ ECIPP_ALIGNMENT_UBYTE 255 LoadLim_T6_ntwk_COMPU_VTAB 0 255 BIT_MASK 0xff /end CHARACTERISTIC
/begin COMPU_METHOD LoadLim_T6_ntwk_COMPU_VTAB "Verbal Table" TAB_VERB "%.0" "list" COMPU_TAB_REF LoadLim_T6_ntwk_COMPU_VTAB_REF /end COMPU_METHOD
/begin COMPU_VTAB LoadLim_T6_ntwk_COMPU_VTAB_REF "Verbal Table" TAB_VERB 4 0 "Disabled" 1 "Table Number" 2 "Performance" 3 "Economy" DEFAULT_VALUE "UNKNOWN" /end COMPU_VTAB
/begin CHARACTERISTIC LoadLim_A_volts "Load-limiting analog select A" VALUE 0x00147572 /* @ECU_Address@LoadLim_A_volts@0x010108C0@ */ ECIPP_ALIGNMENT_UWORD 256 Compu_LoadLim_A_volts 0 255.99609375 /end CHARACTERISTIC
/begin COMPU_METHOD Compu_LoadLim_A_volts " " RAT_FUNC "%.3" "volts" COEFFS 0 256 0 0 0 1 /end COMPU_METHOD
/begin CHARACTERISTIC LoadLim_B_volts "Load-limiting analog select B" VALUE 0x00147574 /* @ECU_Address@LoadLim_B_volts@0x010108C8@ */ ECIPP_ALIGNMENT_UWORD 256 Compu_LoadLim_B_volts 0 255.99609375 /end CHARACTERISTIC
/begin COMPU_METHOD Compu_LoadLim_B_volts " " RAT_FUNC "%.3" "volts" COEFFS 0 256 0 0 0 1 /end COMPU_METHOD
/begin CHARACTERISTIC LoadLim_C_volts "Load-limiting analog select C" VALUE 0x00147576 /* @ECU_Address@LoadLim_C_volts@0x010108D0@ */ ECIPP_ALIGNMENT_UWORD 256 Compu_LoadLim_C_volts 0 255.99609375 /end CHARACTERISTIC
/begin COMPU_METHOD Compu_LoadLim_C_volts " " RAT_FUNC "%.3" "volts" COEFFS 0 256 0 0 0 1 /end COMPU_METHOD
/begin CHARACTERISTIC TEL2_Rx_timeout "Telematics valid message receipt timeout" VALUE 0x00149340 /* @ECU_Address@TEL2_Rx_timeout@0x01011AE0@ */ ECIPP_ALIGNMENT_ULONG 4294967 Compu_TEL2_Rx_timeout 0 4294967.295 /end CHARACTERISTIC
/begin COMPU_METHOD Compu_TEL2_Rx_timeout " " RAT_FUNC "%.1" "seconds" COEFFS 0 1000 0 0 0 1 /end COMPU_METHOD
/begin CHARACTERISTIC TEL2_derate_nextkey "Requested telematics derates should be{TEL2_derate_nextkey&0xff=0:Enforced Immediately}{TEL2_derate_nextkey&0xff=1:Enforced on Next Key-Cycle}" VALUE 0x00149349 /* @ECU_Address@TEL2_derate_nextkey@0x01011AE8@ */ ECIPP_ALIGNMENT_UBYTE 255 TEL2_derate_nextkey_COMPU_VTAB 0 255 BIT_MASK 0xff /end CHARACTERISTIC
/begin COMPU_METHOD TEL2_derate_nextkey_COMPU_VTAB "Verbal Table" TAB_VERB "%.0" "list" COMPU_TAB_REF TEL2_derate_nextkey_COMPU_VTAB_REF /end COMPU_METHOD
/begin COMPU_VTAB TEL2_derate_nextkey_COMPU_VTAB_REF "Verbal Table" TAB_VERB 2 0 "Enforced Immediately" 1 "Enforced on Next Key-Cycle" DEFAULT_VALUE "UNKNOWN" /end COMPU_VTAB
/begin CHARACTERISTIC TEL2_derate_noRx "Telematic unit disconnection derate type{TEL2_derate_noRx&0xff=0:No Derate Active}{TEL2_derate_noRx&0xff=1:RPM limit stage 1}{TEL2_derate_noRx&0xff=2:RPM limit stage 2}{TEL2_derate_noRx&0xff=3:Engine shutdown}" VALUE 0x0014934A /* @ECU_Address@TEL2_derate_noRx@0x01011AF0@ */ ECIPP_ALIGNMENT_UBYTE 255 TEL2_derate_noRx_COMPU_VTAB 0 255 BIT_MASK 0xff /end CHARACTERISTIC
/begin COMPU_METHOD TEL2_derate_noRx_COMPU_VTAB "Verbal Table" TAB_VERB "%.0" "list" COMPU_TAB_REF TEL2_derate_noRx_COMPU_VTAB_REF /end COMPU_METHOD
/begin COMPU_VTAB TEL2_derate_noRx_COMPU_VTAB_REF "Verbal Table" TAB_VERB 4 0 "No Derate Active" 1 "RPM limit stage 1" 2 "RPM limit stage 2" 3 "Engine shutdown" DEFAULT_VALUE "UNKNOWN" /end COMPU_VTAB
/begin CHARACTERISTIC TEL2_rpm_lim1 "Telematics derate RPM limit stage 1" VALUE 0x00149344 /* @ECU_Address@TEL2_rpm_lim1@0x01011AF8@ */ ECIPP_ALIGNMENT_UWORD 65535 Compu_TEL2_rpm_lim1 0 65535 /end CHARACTERISTIC
/begin COMPU_METHOD Compu_TEL2_rpm_lim1 " " RAT_FUNC "%.0" "rpm" COEFFS 0 1 0 0 0 1 /end COMPU_METHOD
/begin CHARACTERISTIC TEL2_rpm_lim2 "Telematics derate RPM limit stage 2" VALUE 0x00149346 /* @ECU_Address@TEL2_rpm_lim2@0x01011B00@ */ ECIPP_ALIGNMENT_UWORD 65535 Compu_TEL2_rpm_lim2 0 65535 /end CHARACTERISTIC
/begin COMPU_METHOD Compu_TEL2_rpm_lim2 " " RAT_FUNC "%.0" "rpm" COEFFS 0 1 0 0 0 1 /end COMPU_METHOD
/begin CHARACTERISTIC TEL2_derate_act_chan "Telematics derate active output{TEL2_derate_act_chan&0xff=0:Disabled}{TEL2_derate_act_chan&0xff=1:Aux PWM1}{TEL2_derate_act_chan&0xff=2:Aux PWM2}{TEL2_derate_act_chan&0xff=3:Aux PWM3}{TEL2_derate_act_chan&0xff=4:Aux PWM4}{TEL2_derate_act_chan&0xff=5:Aux P" VALUE 0x00149348 /* @ECU_Address@TEL2_derate_act_chan@0x01011B08@ */ ECIPP_ALIGNMENT_UBYTE 255 TEL2_derate_act_chan_COMPU_VTAB 0 255 BIT_MASK 0xff /end CHARACTERISTIC
/begin COMPU_METHOD TEL2_derate_act_chan_COMPU_VTAB "Verbal Table" TAB_VERB "%.0" "list" COMPU_TAB_REF TEL2_derate_act_chan_COMPU_VTAB_REF /end COMPU_METHOD
/begin COMPU_VTAB TEL2_derate_act_chan_COMPU_VTAB_REF "Verbal Table" TAB_VERB 16 0 "Disabled" 1 "Aux PWM1" 2 "Aux PWM2" 3 "Aux PWM3" 4 "Aux PWM4" 5 "Aux PWM5" 6 "Aux PWM6" 7 "Aux PWM7" 8 "Aux PWM8" 9 "Aux PWM9" 10 "Aux PWM10" 11 "Aux PWM11" 12 "Aux PWM12" 13 "Aux PWM13" 14 "Aux PWM14" 15 "Aux PWM15" DEFAULT_VALUE "UNKNOWN" /end COMPU_VTAB
/begin CHARACTERISTIC TEL2_enable_DumpTrk "Dump Truck system{TEL2_enable_DumpTrk&0xff=0:Disabled}{TEL2_enable_DumpTrk&0xff=1:Enabled}" VALUE 0x0014808c /* @ECU_Address@TEL2_enable_DumpTrk@0x01011B10@ */ ECIPP_ALIGNMENT_UBYTE 255 TEL2_enable_DumpTrk_COMPU_VTAB 0 255 BIT_MASK 0xff /end CHARACTERISTIC
/begin COMPU_METHOD TEL2_enable_DumpTrk_COMPU_VTAB "Verbal Table" TAB_VERB "%.0" "list" COMPU_TAB_REF TEL2_enable_DumpTrk_COMPU_VTAB_REF /end COMPU_METHOD
/begin COMPU_VTAB TEL2_enable_DumpTrk_COMPU_VTAB_REF "Verbal Table" TAB_VERB 2 0 "Disabled" 1 "Enabled" DEFAULT_VALUE "UNKNOWN" /end COMPU_VTAB
/begin MEASUREMENT TEL2_link_good "Telematics unit link active and OK{TEL2_link_good&0xff=0x00:OFF}{TEL2_link_good&0xff=0x01:ON}" UBYTE TEL2_link_good_COMPU_VTAB 0 0 0 255 ECU_ADDRESS 0x01011B18 BIT_MASK 0xff /end MEASUREMENT
/begin COMPU_METHOD TEL2_link_good_COMPU_VTAB "Verbal Table" TAB_VERB "%.0" "list" COMPU_TAB_REF TEL2_link_good_COMPU_VTAB_REF /end COMPU_METHOD
/begin COMPU_VTAB TEL2_link_good_COMPU_VTAB_REF "Verbal Table" TAB_VERB 2 0x00 "OFF" 0x01 "ON" DEFAULT_VALUE "UNKNOWN" /end COMPU_VTAB
/begin MEASUREMENT TEL2_bound "Telematic unit bound to this ECM{TEL2_bound&0x02=0:No}{TEL2_bound&0x02=2:Yes}" UBYTE TEL2_bound_COMPU_VTAB 0 0 0 255 ECU_ADDRESS 0x01011B20 BIT_MASK 0x02 /end MEASUREMENT
/begin COMPU_METHOD TEL2_bound_COMPU_VTAB "Verbal Table" TAB_VERB "%.0" "list" COMPU_TAB_REF TEL2_bound_COMPU_VTAB_REF /end COMPU_METHOD
/begin COMPU_VTAB TEL2_bound_COMPU_VTAB_REF "Verbal Table" TAB_VERB 2 0 "No" 2 "Yes" DEFAULT_VALUE "UNKNOWN" /end COMPU_VTAB
/begin MEASUREMENT TEL2_derate_active "Requested telematics derate status{TEL2_derate_active&0xff=0:No Derate Active}{TEL2_derate_active&0xff=1:Derate-No Telematic Unit Found}{TEL2_derate_active&0xff=2:Derate-Commanded by Telematics}{TEL2_derate_active&0xff=6:Derate-Commanded + No Unit Req}{TE" UBYTE TEL2_derate_active_COMPU_VTAB 0 0 0 255 ECU_ADDRESS 0x01011B28 BIT_MASK 0xff /end MEASUREMENT
/begin COMPU_METHOD TEL2_derate_active_COMPU_VTAB "Verbal Table" TAB_VERB "%.0" "list" COMPU_TAB_REF TEL2_derate_active_COMPU_VTAB_REF /end COMPU_METHOD
/begin COMPU_VTAB TEL2_derate_active_COMPU_VTAB_REF "Verbal Table" TAB_VERB 6 0 "No Derate Active" 1 "Derate-No Telematic Unit Found" 2 "Derate-Commanded by Telematics" 6 "Derate-Commanded + No Unit Req" 10 "Derate-Commanded + No Unit" 14 "Derate-Commanded + No Unit" DEFAULT_VALUE "UNKNOWN" /end COMPU_VTAB
/begin MEASUREMENT TEL2_derate_type "Requested telematics derate level{TEL2_derate_type&0xff=0:No Derate Active}{TEL2_derate_type&0xff=1:RPM limit stage 1}{TEL2_derate_type&0xff=2:RPM limit stage 2}{TEL2_derate_type&0xff=3:Engine shutdown}{TEL2_derate_type&0xff=4:No lease - start unlocked}{T" UBYTE TEL2_derate_type_COMPU_VTAB 0 0 0 255 ECU_ADDRESS 0x01011B30 BIT_MASK 0xff /end MEASUREMENT
/begin COMPU_METHOD TEL2_derate_type_COMPU_VTAB "Verbal Table" TAB_VERB "%.0" "list" COMPU_TAB_REF TEL2_derate_type_COMPU_VTAB_REF /end COMPU_METHOD
/begin COMPU_VTAB TEL2_derate_type_COMPU_VTAB_REF "Verbal Table" TAB_VERB 19 0 "No Derate Active" 1 "RPM limit stage 1" 2 "RPM limit stage 2" 3 "Engine shutdown" 4 "No lease - start unlocked" 5 "Leased - start unlocked" 6 "No lease - start locked" 7 "Leased - start locked" 8 "No lease - 30% torque" 9 "Leased - 30% torque" 10 "No lease - 80% torque" 11 "Leased - 80% torque" 12 "No lease - 30 km/hr limit" 13 "Leased - 30 km/hr limit" 14 "No lease - 80 km/hr limit" 15 "Leased - 80 km/hr limit" 16 "TEL TSC1 torque limit" 17 "RPM and torque limits" 18 "RPM limit" DEFAULT_VALUE "UNKNOWN" /end COMPU_VTAB
/begin MEASUREMENT EE_TEL2_derate_actv "Currently active telematics derate status{EE_TEL2_derate_actv&0xff=0:No Derate Active}{EE_TEL2_derate_actv&0xff=1:Derate-No Telematic Unit Found}{EE_TEL2_derate_actv&0xff=2:Derate-Commanded by Telematics}{EE_TEL2_derate_actv&0xff=6:Derate-Commanded + No U" UBYTE EE_TEL2_derate_actv_COMPU_VTAB 0 0 0 255 ECU_ADDRESS 0x01011B38 BIT_MASK 0xff /end MEASUREMENT
/begin COMPU_METHOD EE_TEL2_derate_actv_COMPU_VTAB "Verbal Table" TAB_VERB "%.0" "list" COMPU_TAB_REF EE_TEL2_derate_actv_COMPU_VTAB_REF /end COMPU_METHOD
/begin COMPU_VTAB EE_TEL2_derate_actv_COMPU_VTAB_REF "Verbal Table" TAB_VERB 6 0 "No Derate Active" 1 "Derate-No Telematic Unit Found" 2 "Derate-Commanded by Telematics" 6 "Derate-Commanded + No Unit Req" 10 "Derate-Commanded + No Unit" 14 "Derate-Commanded + No Unit" DEFAULT_VALUE "UNKNOWN" /end COMPU_VTAB
/begin MEASUREMENT EE_TEL2_derate_type "Currently active telematics derate level{EE_TEL2_derate_type&0xff=0:No Derate Active}{EE_TEL2_derate_type&0xff=1:RPM limit stage 1}{EE_TEL2_derate_type&0xff=2:RPM limit stage 2}{EE_TEL2_derate_type&0xff=3:Engine shutdown}{EE_TEL2_derate_type&0xff=4:No lea" UBYTE EE_TEL2_derate_type_COMPU_VTAB 0 0 0 255 ECU_ADDRESS 0x01011B40 BIT_MASK 0xff /end MEASUREMENT
/begin COMPU_METHOD EE_TEL2_derate_type_COMPU_VTAB "Verbal Table" TAB_VERB "%.0" "list" COMPU_TAB_REF EE_TEL2_derate_type_COMPU_VTAB_REF /end COMPU_METHOD
/begin COMPU_VTAB EE_TEL2_derate_type_COMPU_VTAB_REF "Verbal Table" TAB_VERB 19 0 "No Derate Active" 1 "RPM limit stage 1" 2 "RPM limit stage 2" 3 "Engine shutdown" 4 "No lease - start unlocked" 5 "Leased - start unlocked" 6 "No lease - start locked" 7 "Leased - start locked" 8 "No lease - 30% torque" 9 "Leased - 30% torque" 10 "No lease - 80% torque" 11 "Leased - 80% torque" 12 "No lease - 30 km/hr limit" 13 "Leased - 30 km/hr limit" 14 "No lease - 80 km/hr limit" 15 "Leased - 80 km/hr limit" 16 "TEL TSC1 torque limit" 17 "RPM and torque limits" 18 "RPM limit" DEFAULT_VALUE "UNKNOWN" /end COMPU_VTAB
/begin MEASUREMENT TEL2_derate "Telematics derate actively enforced{TEL2_derate&0xff=0x00:OFF}{TEL2_derate&0xff=0x01:ON}" UBYTE TEL2_derate_COMPU_VTAB 0 0 0 255 ECU_ADDRESS 0x01011B48 BIT_MASK 0xff /end MEASUREMENT
/begin COMPU_METHOD TEL2_derate_COMPU_VTAB "Verbal Table" TAB_VERB "%.0" "list" COMPU_TAB_REF TEL2_derate_COMPU_VTAB_REF /end COMPU_METHOD
/begin COMPU_VTAB TEL2_derate_COMPU_VTAB_REF "Verbal Table" TAB_VERB 2 0x00 "OFF" 0x01 "ON" DEFAULT_VALUE "UNKNOWN" /end COMPU_VTAB
/begin CHARACTERISTIC derate1_FSO_ena "Power derate 1 FSO{derate1_FSO_ena&0xff=0:Disabled}{derate1_FSO_ena&0xff=1:Enabled}" VALUE 0x0014813c /* @ECU_Address@derate1_FSO_ena@0x01011D00@ */ ECIPP_ALIGNMENT_UBYTE 255 derate1_FSO_ena_COMPU_VTAB 0 255 BIT_MASK 0xff /end CHARACTERISTIC
/begin COMPU_METHOD derate1_FSO_ena_COMPU_VTAB "Verbal Table" TAB_VERB "%.0" "list" COMPU_TAB_REF derate1_FSO_ena_COMPU_VTAB_REF /end COMPU_METHOD
/begin COMPU_VTAB derate1_FSO_ena_COMPU_VTAB_REF "Verbal Table" TAB_VERB 2 0 "Disabled" 1 "Enabled" DEFAULT_VALUE "UNKNOWN" /end COMPU_VTAB
/begin CHARACTERISTIC LLgear_ena "Gear-based load limiting{LLgear_ena&0xff=0:Disabled}{LLgear_ena&0xff=1:Enabled}" VALUE 0x00147dff /* @ECU_Address@LLgear_ena@0x01011EB0@ */ ECIPP_ALIGNMENT_UBYTE 255 LLgear_ena_COMPU_VTAB 0 255 BIT_MASK 0xff /end CHARACTERISTIC
/begin COMPU_METHOD LLgear_ena_COMPU_VTAB "Verbal Table" TAB_VERB "%.0" "list" COMPU_TAB_REF LLgear_ena_COMPU_VTAB_REF /end COMPU_METHOD
/begin COMPU_VTAB LLgear_ena_COMPU_VTAB_REF "Verbal Table" TAB_VERB 2 0 "Disabled" 1 "Enabled" DEFAULT_VALUE "UNKNOWN" /end COMPU_VTAB
/begin CHARACTERISTIC LLgear_tire "Tire circumference" VALUE 0x0014755c /* @ECU_Address@LLgear_tire@0x01011EB8@ */ ECIPP_ALIGNMENT_UWORD 1024 Compu_LLgear_tire 0 1023.984375 /end CHARACTERISTIC
/begin COMPU_METHOD Compu_LLgear_tire " " RAT_FUNC "%.1" "cm" COEFFS 0 64 0 0 0 1 /end COMPU_METHOD
/begin CHARACTERISTIC LLgear_axle_ratio "Drive axle ratio" VALUE 0x0014755a /* @ECU_Address@LLgear_axle_ratio@0x01011EC0@ */ ECIPP_ALIGNMENT_UWORD 256 Compu_LLgear_axle_ratio 0 255.99609375 /end CHARACTERISTIC
/begin COMPU_METHOD Compu_LLgear_axle_ratio " " RAT_FUNC "%.2" "-" COEFFS 0 256 0 0 0 1 /end COMPU_METHOD
/begin CHARACTERISTIC LLgear_table1 "Load-limit source 1{LLgear_table1&0xff=0:None}{LLgear_table1&0xff=1:Table 1 / Gasoline}{LLgear_table1&0xff=2:Table 2 / LPG}{LLgear_table1&0xff=3:Table 3 / NG}{LLgear_table1&0xff=4:Table 4 / Power}{LLgear_table1&0xff=5:Table 5}{LLgear_table1&0xff=6:Table 6" VALUE 0x00147E00 /* @ECU_Address@LLgear_table1@0x01011EC8@ */ ECIPP_ALIGNMENT_UBYTE 255 LLgear_table1_COMPU_VTAB 0 255 BIT_MASK 0xff /end CHARACTERISTIC
/begin COMPU_METHOD LLgear_table1_COMPU_VTAB "Verbal Table" TAB_VERB "%.0" "list" COMPU_TAB_REF LLgear_table1_COMPU_VTAB_REF /end COMPU_METHOD
/begin COMPU_VTAB LLgear_table1_COMPU_VTAB_REF "Verbal Table" TAB_VERB 9 0 "None" 1 "Table 1 / Gasoline" 2 "Table 2 / LPG" 3 "Table 3 / NG" 4 "Table 4 / Power" 5 "Table 5" 6 "Table 6" 7 "Table 7" 8 "Table 8" DEFAULT_VALUE "UNKNOWN" /end COMPU_VTAB
/begin CHARACTERISTIC LLgear_table2 "Load-limit source 2{LLgear_table2&0xff=0:None}{LLgear_table2&0xff=1:Table 1 / Gasoline}{LLgear_table2&0xff=2:Table 2 / LPG}{LLgear_table2&0xff=3:Table 3 / NG}{LLgear_table2&0xff=4:Table 4 / Power}{LLgear_table2&0xff=5:Table 5}{LLgear_table2&0xff=6:Table 6" VALUE 0x00147E01 /* @ECU_Address@LLgear_table2@0x01011ED0@ */ ECIPP_ALIGNMENT_UBYTE 255 LLgear_table2_COMPU_VTAB 0 255 BIT_MASK 0xff /end CHARACTERISTIC
/begin COMPU_METHOD LLgear_table2_COMPU_VTAB "Verbal Table" TAB_VERB "%.0" "list" COMPU_TAB_REF LLgear_table2_COMPU_VTAB_REF /end COMPU_METHOD
/begin COMPU_VTAB LLgear_table2_COMPU_VTAB_REF "Verbal Table" TAB_VERB 9 0 "None" 1 "Table 1 / Gasoline" 2 "Table 2 / LPG" 3 "Table 3 / NG" 4 "Table 4 / Power" 5 "Table 5" 6 "Table 6" 7 "Table 7" 8 "Table 8" DEFAULT_VALUE "UNKNOWN" /end COMPU_VTAB
/begin CHARACTERISTIC LLgear_table3 "Load-limit source 3{LLgear_table3&0xff=0:None}{LLgear_table3&0xff=1:Table 1 / Gasoline}{LLgear_table3&0xff=2:Table 2 / LPG}{LLgear_table3&0xff=3:Table 3 / NG}{LLgear_table3&0xff=4:Table 4 / Power}{LLgear_table3&0xff=5:Table 5}{LLgear_table3&0xff=6:Table 6" VALUE 0x00147E02 /* @ECU_Address@LLgear_table3@0x01011ED8@ */ ECIPP_ALIGNMENT_UBYTE 255 LLgear_table3_COMPU_VTAB 0 255 BIT_MASK 0xff /end CHARACTERISTIC
/begin COMPU_METHOD LLgear_table3_COMPU_VTAB "Verbal Table" TAB_VERB "%.0" "list" COMPU_TAB_REF LLgear_table3_COMPU_VTAB_REF /end COMPU_METHOD
/begin COMPU_VTAB LLgear_table3_COMPU_VTAB_REF "Verbal Table" TAB_VERB 9 0 "None" 1 "Table 1 / Gasoline" 2 "Table 2 / LPG" 3 "Table 3 / NG" 4 "Table 4 / Power" 5 "Table 5" 6 "Table 6" 7 "Table 7" 8 "Table 8" DEFAULT_VALUE "UNKNOWN" /end COMPU_VTAB
/begin CHARACTERISTIC LLgear_table4 "Load-limit source 4{LLgear_table4&0xff=0:None}{LLgear_table4&0xff=1:Table 1 / Gasoline}{LLgear_table4&0xff=2:Table 2 / LPG}{LLgear_table4&0xff=3:Table 3 / NG}{LLgear_table4&0xff=4:Table 4 / Power}{LLgear_table4&0xff=5:Table 5}{LLgear_table4&0xff=6:Table 6" VALUE 0x00147E03 /* @ECU_Address@LLgear_table4@0x01011EE0@ */ ECIPP_ALIGNMENT_UBYTE 255 LLgear_table4_COMPU_VTAB 0 255 BIT_MASK 0xff /end CHARACTERISTIC
/begin COMPU_METHOD LLgear_table4_COMPU_VTAB "Verbal Table" TAB_VERB "%.0" "list" COMPU_TAB_REF LLgear_table4_COMPU_VTAB_REF /end COMPU_METHOD
/begin COMPU_VTAB LLgear_table4_COMPU_VTAB_REF "Verbal Table" TAB_VERB 9 0 "None" 1 "Table 1 / Gasoline" 2 "Table 2 / LPG" 3 "Table 3 / NG" 4 "Table 4 / Power" 5 "Table 5" 6 "Table 6" 7 "Table 7" 8 "Table 8" DEFAULT_VALUE "UNKNOWN" /end COMPU_VTAB
/begin CHARACTERISTIC LLgear_table5 "Load-limit source 5{LLgear_table5&0xff=0:None}{LLgear_table5&0xff=1:Table 1 / Gasoline}{LLgear_table5&0xff=2:Table 2 / LPG}{LLgear_table5&0xff=3:Table 3 / NG}{LLgear_table5&0xff=4:Table 4 / Power}{LLgear_table5&0xff=5:Table 5}{LLgear_table5&0xff=6:Table 6" VALUE 0x00147E04 /* @ECU_Address@LLgear_table5@0x01011EE8@ */ ECIPP_ALIGNMENT_UBYTE 255 LLgear_table5_COMPU_VTAB 0 255 BIT_MASK 0xff /end CHARACTERISTIC
/begin COMPU_METHOD LLgear_table5_COMPU_VTAB "Verbal Table" TAB_VERB "%.0" "list" COMPU_TAB_REF LLgear_table5_COMPU_VTAB_REF /end COMPU_METHOD
/begin COMPU_VTAB LLgear_table5_COMPU_VTAB_REF "Verbal Table" TAB_VERB 9 0 "None" 1 "Table 1 / Gasoline" 2 "Table 2 / LPG" 3 "Table 3 / NG" 4 "Table 4 / Power" 5 "Table 5" 6 "Table 6" 7 "Table 7" 8 "Table 8" DEFAULT_VALUE "UNKNOWN" /end COMPU_VTAB
/begin CHARACTERISTIC LLgear_table6 "Load-limit source 6{LLgear_table6&0xff=0:None}{LLgear_table6&0xff=1:Table 1 / Gasoline}{LLgear_table6&0xff=2:Table 2 / LPG}{LLgear_table6&0xff=3:Table 3 / NG}{LLgear_table6&0xff=4:Table 4 / Power}{LLgear_table6&0xff=5:Table 5}{LLgear_table6&0xff=6:Table 6" VALUE 0x00147E05 /* @ECU_Address@LLgear_table6@0x01011EF0@ */ ECIPP_ALIGNMENT_UBYTE 255 LLgear_table6_COMPU_VTAB 0 255 BIT_MASK 0xff /end CHARACTERISTIC
/begin COMPU_METHOD LLgear_table6_COMPU_VTAB "Verbal Table" TAB_VERB "%.0" "list" COMPU_TAB_REF LLgear_table6_COMPU_VTAB_REF /end COMPU_METHOD
/begin COMPU_VTAB LLgear_table6_COMPU_VTAB_REF "Verbal Table" TAB_VERB 9 0 "None" 1 "Table 1 / Gasoline" 2 "Table 2 / LPG" 3 "Table 3 / NG" 4 "Table 4 / Power" 5 "Table 5" 6 "Table 6" 7 "Table 7" 8 "Table 8" DEFAULT_VALUE "UNKNOWN" /end COMPU_VTAB
/begin CHARACTERISTIC LLgear_table7 "Load-limit source 7{LLgear_table7&0xff=0:None}{LLgear_table7&0xff=1:Table 1 / Gasoline}{LLgear_table7&0xff=2:Table 2 / LPG}{LLgear_table7&0xff=3:Table 3 / NG}{LLgear_table7&0xff=4:Table 4 / Power}{LLgear_table7&0xff=5:Table 5}{LLgear_table7&0xff=6:Table 6" VALUE 0x00147E06 /* @ECU_Address@LLgear_table7@0x01011EF8@ */ ECIPP_ALIGNMENT_UBYTE 255 LLgear_table7_COMPU_VTAB 0 255 BIT_MASK 0xff /end CHARACTERISTIC
/begin COMPU_METHOD LLgear_table7_COMPU_VTAB "Verbal Table" TAB_VERB "%.0" "list" COMPU_TAB_REF LLgear_table7_COMPU_VTAB_REF /end COMPU_METHOD
/begin COMPU_VTAB LLgear_table7_COMPU_VTAB_REF "Verbal Table" TAB_VERB 9 0 "None" 1 "Table 1 / Gasoline" 2 "Table 2 / LPG" 3 "Table 3 / NG" 4 "Table 4 / Power" 5 "Table 5" 6 "Table 6" 7 "Table 7" 8 "Table 8" DEFAULT_VALUE "UNKNOWN" /end COMPU_VTAB
/begin CHARACTERISTIC LLgear_table8 "Load-limit source 8{LLgear_table8&0xff=0:None}{LLgear_table8&0xff=1:Table 1 / Gasoline}{LLgear_table8&0xff=2:Table 2 / LPG}{LLgear_table8&0xff=3:Table 3 / NG}{LLgear_table8&0xff=4:Table 4 / Power}{LLgear_table8&0xff=5:Table 5}{LLgear_table8&0xff=6:Table 6" VALUE 0x00147E07 /* @ECU_Address@LLgear_table8@0x01011F00@ */ ECIPP_ALIGNMENT_UBYTE 255 LLgear_table8_COMPU_VTAB 0 255 BIT_MASK 0xff /end CHARACTERISTIC
/begin COMPU_METHOD LLgear_table8_COMPU_VTAB "Verbal Table" TAB_VERB "%.0" "list" COMPU_TAB_REF LLgear_table8_COMPU_VTAB_REF /end COMPU_METHOD
/begin COMPU_VTAB LLgear_table8_COMPU_VTAB_REF "Verbal Table" TAB_VERB 9 0 "None" 1 "Table 1 / Gasoline" 2 "Table 2 / LPG" 3 "Table 3 / NG" 4 "Table 4 / Power" 5 "Table 5" 6 "Table 6" 7 "Table 7" 8 "Table 8" DEFAULT_VALUE "UNKNOWN" /end COMPU_VTAB
/begin CHARACTERISTIC LLgear_table9 "Load-limit source 9{LLgear_table9&0xff=0:None}{LLgear_table9&0xff=1:Table 1 / Gasoline}{LLgear_table9&0xff=2:Table 2 / LPG}{LLgear_table9&0xff=3:Table 3 / NG}{LLgear_table9&0xff=4:Table 4 / Power}{LLgear_table9&0xff=5:Table 5}{LLgear_table9&0xff=6:Table 6" VALUE 0x00147E08 /* @ECU_Address@LLgear_table9@0x01011F08@ */ ECIPP_ALIGNMENT_UBYTE 255 LLgear_table9_COMPU_VTAB 0 255 BIT_MASK 0xff /end CHARACTERISTIC
/begin COMPU_METHOD LLgear_table9_COMPU_VTAB "Verbal Table" TAB_VERB "%.0" "list" COMPU_TAB_REF LLgear_table9_COMPU_VTAB_REF /end COMPU_METHOD
/begin COMPU_VTAB LLgear_table9_COMPU_VTAB_REF "Verbal Table" TAB_VERB 9 0 "None" 1 "Table 1 / Gasoline" 2 "Table 2 / LPG" 3 "Table 3 / NG" 4 "Table 4 / Power" 5 "Table 5" 6 "Table 6" 7 "Table 7" 8 "Table 8" DEFAULT_VALUE "UNKNOWN" /end COMPU_VTAB
/begin CHARACTERISTIC LLgear_table10 "Load-limit source 10{LLgear_table10&0xff=0:None}{LLgear_table10&0xff=1:Table 1 / Gasoline}{LLgear_table10&0xff=2:Table 2 / LPG}{LLgear_table10&0xff=3:Table 3 / NG}{LLgear_table10&0xff=4:Table 4 / Power}{LLgear_table10&0xff=5:Table 5}{LLgear_table10&0xff=6" VALUE 0x00147E09 /* @ECU_Address@LLgear_table10@0x01011F10@ */ ECIPP_ALIGNMENT_UBYTE 255 LLgear_table10_COMPU_VTAB 0 255 BIT_MASK 0xff /end CHARACTERISTIC
/begin COMPU_METHOD LLgear_table10_COMPU_VTAB "Verbal Table" TAB_VERB "%.0" "list" COMPU_TAB_REF LLgear_table10_COMPU_VTAB_REF /end COMPU_METHOD
/begin COMPU_VTAB LLgear_table10_COMPU_VTAB_REF "Verbal Table" TAB_VERB 9 0 "None" 1 "Table 1 / Gasoline" 2 "Table 2 / LPG" 3 "Table 3 / NG" 4 "Table 4 / Power" 5 "Table 5" 6 "Table 6" 7 "Table 7" 8 "Table 8" DEFAULT_VALUE "UNKNOWN" /end COMPU_VTAB
/begin MEASUREMENT LLgear_loadlim "Gear-based load limit" UWORD Compu_LLgear_loadlim 0 0 0 99.9984741210938 ECU_ADDRESS 0x01011F18 /end MEASUREMENT
/begin COMPU_METHOD Compu_LLgear_loadlim " " RAT_FUNC "%.1" "%" COEFFS 0 655.36 0 0 0 1 /end COMPU_METHOD
/begin MEASUREMENT LLgear_num "Current gear{LLgear_num&0xff=0:None}{LLgear_num&0xff=1:1st}{LLgear_num&0xff=2:2nd}{LLgear_num&0xff=3:3rd}{LLgear_num&0xff=4:4th}{LLgear_num&0xff=5:5th}{LLgear_num&0xff=6:6th}{LLgear_num&0xff=7:7th}{LLgear_num&0xff=8:8th}{LLgear_num&0xff=9:9th}{LLgear_num&" SBYTE LLgear_num_COMPU_VTAB 0 0 -128 127 ECU_ADDRESS 0x01011F20 BIT_MASK 0xff /end MEASUREMENT
/begin COMPU_METHOD LLgear_num_COMPU_VTAB "Verbal Table" TAB_VERB "%.0" "list" COMPU_TAB_REF LLgear_num_COMPU_VTAB_REF /end COMPU_METHOD
/begin COMPU_VTAB LLgear_num_COMPU_VTAB_REF "Verbal Table" TAB_VERB 19 0 "None" 1 "1st" 2 "2nd" 3 "3rd" 4 "4th" 5 "5th" 6 "6th" 7 "7th" 8 "8th" 9 "9th" 10 "10th" 11 "11th" 12 "12th" 13 "13th" 14 "14th" 15 "15th" 16 "16th" 0xff "R1" 0xfe "R2" DEFAULT_VALUE "UNKNOWN" /end COMPU_VTAB
/begin CHARACTERISTIC LoadLim_Taux2_src "Aux-Temperature 2 source{LoadLim_Taux2_src&0xff=0:Not Used}{LoadLim_Taux2_src&0xff=1:FST}{LoadLim_Taux2_src&0xff=2:FRT}{LoadLim_Taux2_src&0xff=3:FT}{LoadLim_Taux2_src&0xff=4:IAT}{LoadLim_Taux2_src&0xff=5:MAT}{LoadLim_Taux2_src&0xff=6:EGRT}" VALUE 0x00147e28 /* @ECU_Address@LoadLim_Taux2_src@0x010120D0@ */ ECIPP_ALIGNMENT_UBYTE 255 LoadLim_Taux2_src_COMPU_VTAB 0 255 BIT_MASK 0xff /end CHARACTERISTIC
/begin COMPU_METHOD LoadLim_Taux2_src_COMPU_VTAB "Verbal Table" TAB_VERB "%.0" "list" COMPU_TAB_REF LoadLim_Taux2_src_COMPU_VTAB_REF /end COMPU_METHOD
/begin COMPU_VTAB LoadLim_Taux2_src_COMPU_VTAB_REF "Verbal Table" TAB_VERB 7 0 "Not Used" 1 "FST" 2 "FRT" 3 "FT" 4 "IAT" 5 "MAT" 6 "EGRT" DEFAULT_VALUE "UNKNOWN" /end COMPU_VTAB
/begin MEASUREMENT LoadLim_Taux2_T "Aux-Temperature 2" UWORD Compu_LoadLim_Taux2_T 0 0 -460 7731.875 ECU_ADDRESS 0x010120D8 /end MEASUREMENT
/begin COMPU_METHOD Compu_LoadLim_Taux2_T " " RAT_FUNC "%.1" "deg F" COEFFS 0 8 3680 0 0 1 /end COMPU_METHOD
/begin CHARACTERISTIC FPlo_derate_ena "Low fuel pressure (FP) derate{FPlo_derate_ena&0xff=0:Disabled}{FPlo_derate_ena&0xff=1:Enabled}" VALUE 0x00147d7a /* @ECU_Address@FPlo_derate_ena@0x010120F8@ */ ECIPP_ALIGNMENT_UBYTE 255 FPlo_derate_ena_COMPU_VTAB 0 255 BIT_MASK 0xff /end CHARACTERISTIC
/begin COMPU_METHOD FPlo_derate_ena_COMPU_VTAB "Verbal Table" TAB_VERB "%.0" "list" COMPU_TAB_REF FPlo_derate_ena_COMPU_VTAB_REF /end COMPU_METHOD
/begin COMPU_VTAB FPlo_derate_ena_COMPU_VTAB_REF "Verbal Table" TAB_VERB 2 0 "Disabled" 1 "Enabled" DEFAULT_VALUE "UNKNOWN" /end COMPU_VTAB
/begin CHARACTERISTIC FPlo_derate_Ptau "CFV pressure error low-pass tau" VALUE 0x00147bec /* @ECU_Address@FPlo_derate_Ptau@0x01012100@ */ ECIPP_ALIGNMENT_UWORD 163840 Compu_FPlo_derate_Ptau 0.16703 163840 /end CHARACTERISTIC
/begin COMPU_METHOD Compu_FPlo_derate_Ptau " " FORM "%.0" "ms"
 /begin FORMULA "-5 / log(1.0000000000001 - (X1 / 32768))" FORMULA_INV "(1.0000000000001 - exp(-5/X1)) * 32768" /end FORMULA
/end COMPU_METHOD
/begin CHARACTERISTIC FPlo_derate_dly_on "Low FP derate engage delay" VALUE 0x001468d6 /* @ECU_Address@FPlo_derate_dly_on@0x01012108@ */ ECIPP_ALIGNMENT_UWORD 66 Compu_FPlo_derate_dly_on 0 65.535 /end CHARACTERISTIC
/begin COMPU_METHOD Compu_FPlo_derate_dly_on " " RAT_FUNC "%.1" "sec" COEFFS 0 1000 0 0 0 1 /end COMPU_METHOD
/begin CHARACTERISTIC FPlo_derate_dly_off "Low FP derate dis-engage delay" VALUE 0x001468d4 /* @ECU_Address@FPlo_derate_dly_off@0x01012110@ */ ECIPP_ALIGNMENT_UWORD 66 Compu_FPlo_derate_dly_off 0 65.535 /end CHARACTERISTIC
/begin COMPU_METHOD Compu_FPlo_derate_dly_off " " RAT_FUNC "%.1" "sec" COEFFS 0 1000 0 0 0 1 /end COMPU_METHOD
/begin CHARACTERISTIC FPlo_derate_Pon "Low FP derate engage error" VALUE 0x00144304 /* @ECU_Address@FPlo_derate_Pon@0x01012118@ */ ECIPP_ALIGNMENT_SWORD 128 Compu_FPlo_derate_Pon -128 127.99609375 /end CHARACTERISTIC
/begin COMPU_METHOD Compu_FPlo_derate_Pon " " RAT_FUNC "%.2" "psi" COEFFS 0 256 0 0 0 1 /end COMPU_METHOD
/begin CHARACTERISTIC FPlo_derate_Poff "Low FP derate dis-engage error" VALUE 0x00144302 /* @ECU_Address@FPlo_derate_Poff@0x01012120@ */ ECIPP_ALIGNMENT_SWORD 128 Compu_FPlo_derate_Poff -128 127.99609375 /end CHARACTERISTIC
/begin COMPU_METHOD Compu_FPlo_derate_Poff " " RAT_FUNC "%.2" "psi" COEFFS 0 256 0 0 0 1 /end COMPU_METHOD
/begin CHARACTERISTIC FPlo_derate_LLmin "Low FP derate load-limit minimum" VALUE 0x001468d2 /* @ECU_Address@FPlo_derate_LLmin@0x01012128@ */ ECIPP_ALIGNMENT_UWORD 100 Compu_FPlo_derate_LLmin 0 99.9984741210938 /end CHARACTERISTIC
/begin COMPU_METHOD Compu_FPlo_derate_LLmin " " RAT_FUNC "%.1" "%" COEFFS 0 655.36 0 0 0 1 /end COMPU_METHOD
/begin CHARACTERISTIC FPlo_derate_off_tau "Low FP derate dis-engage low-pass tau" VALUE 0x001439ac /* @ECU_Address@FPlo_derate_off_tau@0x01012130@ */ ECIPP_ALIGNMENT_FLOAT32_IEEE 10000000000 Compu_FPlo_derate_off_tau -10000000000 10000000000 /end CHARACTERISTIC
/begin COMPU_METHOD Compu_FPlo_derate_off_tau " " RAT_FUNC "%.1" "sec" COEFFS 0 1000 0 0 0 1 /end COMPU_METHOD
/begin CHARACTERISTIC FPlo_derate_on_tau "Low FP derate engage low-pass tau" VALUE 0x001439b0 /* @ECU_Address@FPlo_derate_on_tau@0x01012138@ */ ECIPP_ALIGNMENT_FLOAT32_IEEE 10000000000 Compu_FPlo_derate_on_tau -10000000000 10000000000 /end CHARACTERISTIC
/begin COMPU_METHOD Compu_FPlo_derate_on_tau " " RAT_FUNC "%.1" "sec" COEFFS 0 1000 0 0 0 1 /end COMPU_METHOD
/begin MEASUREMENT FPlo_derate_use "Low FP derate load-limit active" UBYTE Compu_FPlo_derate_use 0 0 0 255 ECU_ADDRESS 0x01012140 /end MEASUREMENT
/begin COMPU_METHOD Compu_FPlo_derate_use " " RAT_FUNC "%.0" "-" COEFFS 0 1 0 0 0 1 /end COMPU_METHOD
/begin MEASUREMENT FPlo_derate_loadlim "Low FP derate load-limit" UWORD Compu_FPlo_derate_loadlim 0 0 0 99.9984741210938 ECU_ADDRESS 0x01012148 /end MEASUREMENT
/begin COMPU_METHOD Compu_FPlo_derate_loadlim " " RAT_FUNC "%.2" "%" COEFFS 0 655.36 0 0 0 1 /end COMPU_METHOD
/begin MEASUREMENT CFV_P_err_acc "CFV filtered interstage pressure error" SLONG Compu_CFV_P_err_acc 0 0 -128 127.999999940395 ECU_ADDRESS 0x01012150 /end MEASUREMENT
/begin COMPU_METHOD Compu_CFV_P_err_acc " " RAT_FUNC "%.2" "psi" COEFFS 0 16777216 0 0 0 1 /end COMPU_METHOD
/begin CHARACTERISTIC LoadLim_ECT_tau "Speed adjustment low-pass tau" VALUE 0x001439c4 /* @ECU_Address@LoadLim_ECT_tau@0x01012158@ */ ECIPP_ALIGNMENT_FLOAT32_IEEE 10000000000 Compu_LoadLim_ECT_tau -10000000000 10000000000 /end CHARACTERISTIC
/begin COMPU_METHOD Compu_LoadLim_ECT_tau " " RAT_FUNC "%.1" "sec" COEFFS 0 1000 0 0 0 1 /end COMPU_METHOD
/begin MEASUREMENT FPlo_derate_tmr "Low FP derate active time" UWORD Compu_FPlo_derate_tmr 0 0 0 65535 ECU_ADDRESS 0x01012188 /end MEASUREMENT
/begin COMPU_METHOD Compu_FPlo_derate_tmr " " RAT_FUNC "%.0" "sec" COEFFS 0 1 0 0 0 1 /end COMPU_METHOD
/begin CHARACTERISTIC LLTO_multi_fuel_ena "Load-limit override multi-fuel enable{LLTO_multi_fuel_ena&0xff=0:All Fuel Types}{LLTO_multi_fuel_ena&0xff=1:Fuel Based}" VALUE 0x00147dfe /* @ECU_Address@LLTO_multi_fuel_ena@0x010124C8@ */ ECIPP_ALIGNMENT_UBYTE 255 LLTO_multi_fuel_ena_COMPU_VTAB 0 255 BIT_MASK 0xff /end CHARACTERISTIC
/begin COMPU_METHOD LLTO_multi_fuel_ena_COMPU_VTAB "Verbal Table" TAB_VERB "%.0" "list" COMPU_TAB_REF LLTO_multi_fuel_ena_COMPU_VTAB_REF /end COMPU_METHOD
/begin COMPU_VTAB LLTO_multi_fuel_ena_COMPU_VTAB_REF "Verbal Table" TAB_VERB 2 0 "All Fuel Types" 1 "Fuel Based" DEFAULT_VALUE "UNKNOWN" /end COMPU_VTAB
/begin CHARACTERISTIC LLTO_pct_gsln "Load-limit override gasoline" VALUE 0x00147556 /* @ECU_Address@LLTO_pct_gsln@0x010124D0@ */ ECIPP_ALIGNMENT_UWORD 400 Compu_LLTO_pct_gsln 0 399.993896484375 /end CHARACTERISTIC
/begin COMPU_METHOD Compu_LLTO_pct_gsln " " RAT_FUNC "%.1" "%" COEFFS 0 163.84 0 0 0 1 /end COMPU_METHOD
/begin CHARACTERISTIC LLTO_pct_LPG "Load-limit override LPG" VALUE 0x00147552 /* @ECU_Address@LLTO_pct_LPG@0x010124D8@ */ ECIPP_ALIGNMENT_UWORD 400 Compu_LLTO_pct_LPG 0 399.993896484375 /end CHARACTERISTIC
/begin COMPU_METHOD Compu_LLTO_pct_LPG " " RAT_FUNC "%.1" "%" COEFFS 0 163.84 0 0 0 1 /end COMPU_METHOD
/begin CHARACTERISTIC LLTO_pct_NG "Load-limit override NG" VALUE 0x00147554 /* @ECU_Address@LLTO_pct_NG@0x010124E0@ */ ECIPP_ALIGNMENT_UWORD 400 Compu_LLTO_pct_NG 0 399.993896484375 /end CHARACTERISTIC
/begin COMPU_METHOD Compu_LLTO_pct_NG " " RAT_FUNC "%.1" "%" COEFFS 0 163.84 0 0 0 1 /end COMPU_METHOD
/begin CHARACTERISTIC LoadLim_T7_fuel "Load-limiting Table 7 fuel type{LoadLim_T7_fuel&0xff=0:Disabled}{LoadLim_T7_fuel&0xff=1:All Fuels}{LoadLim_T7_fuel&0xff=2:Gasoline}{LoadLim_T7_fuel&0xff=3:LPG}{LoadLim_T7_fuel&0xff=4:NG}" VALUE 0x00147E42 /* @ECU_Address@LoadLim_T7_fuel@0x01012A28@ */ ECIPP_ALIGNMENT_UBYTE 255 LoadLim_T7_fuel_COMPU_VTAB 0 255 BIT_MASK 0xff /end CHARACTERISTIC
/begin COMPU_METHOD LoadLim_T7_fuel_COMPU_VTAB "Verbal Table" TAB_VERB "%.0" "list" COMPU_TAB_REF LoadLim_T7_fuel_COMPU_VTAB_REF /end COMPU_METHOD
/begin COMPU_VTAB LoadLim_T7_fuel_COMPU_VTAB_REF "Verbal Table" TAB_VERB 5 0 "Disabled" 1 "All Fuels" 2 "Gasoline" 3 "LPG" 4 "NG" DEFAULT_VALUE "UNKNOWN" /end COMPU_VTAB
/begin CHARACTERISTIC LoadLim_T8_fuel "Load-limiting Table 8 fuel type{LoadLim_T8_fuel&0xff=0:Disabled}{LoadLim_T8_fuel&0xff=1:All Fuels}{LoadLim_T8_fuel&0xff=2:Gasoline}{LoadLim_T8_fuel&0xff=3:LPG}{LoadLim_T8_fuel&0xff=4:NG}" VALUE 0x00147E43 /* @ECU_Address@LoadLim_T8_fuel@0x01012A30@ */ ECIPP_ALIGNMENT_UBYTE 255 LoadLim_T8_fuel_COMPU_VTAB 0 255 BIT_MASK 0xff /end CHARACTERISTIC
/begin COMPU_METHOD LoadLim_T8_fuel_COMPU_VTAB "Verbal Table" TAB_VERB "%.0" "list" COMPU_TAB_REF LoadLim_T8_fuel_COMPU_VTAB_REF /end COMPU_METHOD
/begin COMPU_VTAB LoadLim_T8_fuel_COMPU_VTAB_REF "Verbal Table" TAB_VERB 5 0 "Disabled" 1 "All Fuels" 2 "Gasoline" 3 "LPG" 4 "NG" DEFAULT_VALUE "UNKNOWN" /end COMPU_VTAB
/begin CHARACTERISTIC LoadLim_T7_chan "Load-limiting Table 7 input{LoadLim_T7_chan&0xff=0:Disabled}{LoadLim_T7_chan&0xff=1:Aux PU1 = Gnd}{LoadLim_T7_chan&0xff=2:Aux PU2 = Gnd}{LoadLim_T7_chan&0xff=3:Aux PU3 = Gnd}{LoadLim_T7_chan&0xff=4:Aux PUD1 = Gnd}{LoadLim_T7_chan&0xff=5:Aux PUD2 = Gnd}{Lo" VALUE 0x00147E30 /* @ECU_Address@LoadLim_T7_chan@0x01012A38@ */ ECIPP_ALIGNMENT_UBYTE 255 LoadLim_T7_chan_COMPU_VTAB 0 255 BIT_MASK 0xff /end CHARACTERISTIC
/begin COMPU_METHOD LoadLim_T7_chan_COMPU_VTAB "Verbal Table" TAB_VERB "%.0" "list" COMPU_TAB_REF LoadLim_T7_chan_COMPU_VTAB_REF /end COMPU_METHOD
/begin COMPU_VTAB LoadLim_T7_chan_COMPU_VTAB_REF "Verbal Table" TAB_VERB 30 0 "Disabled" 1 "Aux PU1 = Gnd" 2 "Aux PU2 = Gnd" 3 "Aux PU3 = Gnd" 4 "Aux PUD1 = Gnd" 5 "Aux PUD2 = Gnd" 6 "Aux PUD3 = Gnd" 7 "Aux PUD4 = +V" 8 "Aux PUD5 = Gnd" 9 "Aux DIG1" 10 "Aux DIG2" 11 "Aux DIG3" 12 "Aux DIG4" 13 "Aux DIG5" 14 "Aux DIG6" 15 "Aux DIG7" 16 "Aux DIG8" 17 "Aux DIG9" 18 "Aux DIG10" 19 "Aux DIG11" 20 "Aux DIG12" 21 "Aux DIG13" 22 "Aux DIG14" 23 "Aux DIG15" 24 "Aux DIG16" 25 "Aux DIG17" 26 "Aux DIG18" 27 "Aux DIG19" 28 "Gov1" 29 "Gov2" DEFAULT_VALUE "UNKNOWN" /end COMPU_VTAB
/begin CHARACTERISTIC LoadLim_T8_chan "Load-limiting Table 8 input{LoadLim_T8_chan&0xff=0:Disabled}{LoadLim_T8_chan&0xff=1:Aux PU1 = Gnd}{LoadLim_T8_chan&0xff=2:Aux PU2 = Gnd}{LoadLim_T8_chan&0xff=3:Aux PU3 = Gnd}{LoadLim_T8_chan&0xff=4:Aux PUD1 = Gnd}{LoadLim_T8_chan&0xff=5:Aux PUD2 = Gnd}{Lo" VALUE 0x00147E31 /* @ECU_Address@LoadLim_T8_chan@0x01012A40@ */ ECIPP_ALIGNMENT_UBYTE 255 LoadLim_T8_chan_COMPU_VTAB 0 255 BIT_MASK 0xff /end CHARACTERISTIC
/begin COMPU_METHOD LoadLim_T8_chan_COMPU_VTAB "Verbal Table" TAB_VERB "%.0" "list" COMPU_TAB_REF LoadLim_T8_chan_COMPU_VTAB_REF /end COMPU_METHOD
/begin COMPU_VTAB LoadLim_T8_chan_COMPU_VTAB_REF "Verbal Table" TAB_VERB 30 0 "Disabled" 1 "Aux PU1 = Gnd" 2 "Aux PU2 = Gnd" 3 "Aux PU3 = Gnd" 4 "Aux PUD1 = Gnd" 5 "Aux PUD2 = Gnd" 6 "Aux PUD3 = Gnd" 7 "Aux PUD4 = +V" 8 "Aux PUD5 = Gnd" 9 "Aux DIG1" 10 "Aux DIG2" 11 "Aux DIG3" 12 "Aux DIG4" 13 "Aux DIG5" 14 "Aux DIG6" 15 "Aux DIG7" 16 "Aux DIG8" 17 "Aux DIG9" 18 "Aux DIG10" 19 "Aux DIG11" 20 "Aux DIG12" 21 "Aux DIG13" 22 "Aux DIG14" 23 "Aux DIG15" 24 "Aux DIG16" 25 "Aux DIG17" 26 "Aux DIG18" 27 "Aux DIG19" 28 "Gov1" 29 "Gov2" DEFAULT_VALUE "UNKNOWN" /end COMPU_VTAB
/begin CHARACTERISTIC LoadLim_T7_chan_cfg "Load-limiting Table 7 input config{LoadLim_T7_chan_cfg&0xff=0:Default}{LoadLim_T7_chan_cfg&0xff=1:DIG - GND}{LoadLim_T7_chan_cfg&0xff=2:DIG - GND/+V}{LoadLim_T7_chan_cfg&0xff=3:DIG - V+}{LoadLim_T7_chan_cfg&0xff=4:DIG - Open}{LoadLim_T7_chan_cfg&0xff=5:An" VALUE 0x00147E38 /* @ECU_Address@LoadLim_T7_chan_cfg@0x01012A48@ */ ECIPP_ALIGNMENT_UBYTE 255 LoadLim_T7_chan_cfg_COMPU_VTAB 0 255 BIT_MASK 0xff /end CHARACTERISTIC
/begin COMPU_METHOD LoadLim_T7_chan_cfg_COMPU_VTAB "Verbal Table" TAB_VERB "%.0" "list" COMPU_TAB_REF LoadLim_T7_chan_cfg_COMPU_VTAB_REF /end COMPU_METHOD
/begin COMPU_VTAB LoadLim_T7_chan_cfg_COMPU_VTAB_REF "Verbal Table" TAB_VERB 9 0 "Default" 1 "DIG - GND" 2 "DIG - GND/+V" 3 "DIG - V+" 4 "DIG - Open" 5 "Analog - GND/+V" 6 "Analog - A" 7 "Analog - B" 8 "Analog - C" DEFAULT_VALUE "UNKNOWN" /end COMPU_VTAB
/begin CHARACTERISTIC LoadLim_T8_chan_cfg "Load-limiting Table 8 input config{LoadLim_T8_chan_cfg&0xff=0:Default}{LoadLim_T8_chan_cfg&0xff=1:DIG - GND}{LoadLim_T8_chan_cfg&0xff=2:DIG - GND/+V}{LoadLim_T8_chan_cfg&0xff=3:DIG - V+}{LoadLim_T8_chan_cfg&0xff=4:DIG - Open}{LoadLim_T8_chan_cfg&0xff=5:An" VALUE 0x00147E39 /* @ECU_Address@LoadLim_T8_chan_cfg@0x01012A50@ */ ECIPP_ALIGNMENT_UBYTE 255 LoadLim_T8_chan_cfg_COMPU_VTAB 0 255 BIT_MASK 0xff /end CHARACTERISTIC
/begin COMPU_METHOD LoadLim_T8_chan_cfg_COMPU_VTAB "Verbal Table" TAB_VERB "%.0" "list" COMPU_TAB_REF LoadLim_T8_chan_cfg_COMPU_VTAB_REF /end COMPU_METHOD
/begin COMPU_VTAB LoadLim_T8_chan_cfg_COMPU_VTAB_REF "Verbal Table" TAB_VERB 9 0 "Default" 1 "DIG - GND" 2 "DIG - GND/+V" 3 "DIG - V+" 4 "DIG - Open" 5 "Analog - GND/+V" 6 "Analog - A" 7 "Analog - B" 8 "Analog - C" DEFAULT_VALUE "UNKNOWN" /end COMPU_VTAB
/begin CHARACTERISTIC LoadLim_T7_ntwk "Load-limiting Table 7 ntwk select{LoadLim_T7_ntwk&0xff=0:Disabled}{LoadLim_T7_ntwk&0xff=1:Table Number}{LoadLim_T7_ntwk&0xff=2:Performance}{LoadLim_T7_ntwk&0xff=3:Economy}" VALUE 0x00147E4D /* @ECU_Address@LoadLim_T7_ntwk@0x01012A58@ */ ECIPP_ALIGNMENT_UBYTE 255 LoadLim_T7_ntwk_COMPU_VTAB 0 255 BIT_MASK 0xff /end CHARACTERISTIC
/begin COMPU_METHOD LoadLim_T7_ntwk_COMPU_VTAB "Verbal Table" TAB_VERB "%.0" "list" COMPU_TAB_REF LoadLim_T7_ntwk_COMPU_VTAB_REF /end COMPU_METHOD
/begin COMPU_VTAB LoadLim_T7_ntwk_COMPU_VTAB_REF "Verbal Table" TAB_VERB 4 0 "Disabled" 1 "Table Number" 2 "Performance" 3 "Economy" DEFAULT_VALUE "UNKNOWN" /end COMPU_VTAB
/begin CHARACTERISTIC LoadLim_T8_ntwk "Load-limiting Table 8 ntwk select{LoadLim_T8_ntwk&0xff=0:Disabled}{LoadLim_T8_ntwk&0xff=1:Table Number}{LoadLim_T8_ntwk&0xff=2:Performance}{LoadLim_T8_ntwk&0xff=3:Economy}" VALUE 0x00147E4E /* @ECU_Address@LoadLim_T8_ntwk@0x01012A60@ */ ECIPP_ALIGNMENT_UBYTE 255 LoadLim_T8_ntwk_COMPU_VTAB 0 255 BIT_MASK 0xff /end CHARACTERISTIC
/begin COMPU_METHOD LoadLim_T8_ntwk_COMPU_VTAB "Verbal Table" TAB_VERB "%.0" "list" COMPU_TAB_REF LoadLim_T8_ntwk_COMPU_VTAB_REF /end COMPU_METHOD
/begin COMPU_VTAB LoadLim_T8_ntwk_COMPU_VTAB_REF "Verbal Table" TAB_VERB 4 0 "Disabled" 1 "Table Number" 2 "Performance" 3 "Economy" DEFAULT_VALUE "UNKNOWN" /end COMPU_VTAB
/begin CHARACTERISTIC FPlo_derate_hybridwt "Low FP derate hybrid minimum run time" VALUE 0x001468d8 /* @ECU_Address@FPlo_derate_hybridwt@0x01012B38@ */ ECIPP_ALIGNMENT_UWORD 66 Compu_FPlo_derate_hybridwt 0 65.535 /end CHARACTERISTIC
/begin COMPU_METHOD Compu_FPlo_derate_hybridwt " " RAT_FUNC "%.1" "sec" COEFFS 0 1000 0 0 0 1 /end COMPU_METHOD
/begin CHARACTERISTIC LoadLim_gvauthTPSena "Load-limit governor authority and TPS{LoadLim_gvauthTPSena&0xff=0:Disabled}{LoadLim_gvauthTPSena&0xff=1:Enabled}" VALUE 0x00147e44 /* @ECU_Address@LoadLim_gvauthTPSena@0x01012CE8@ */ ECIPP_ALIGNMENT_UBYTE 255 LoadLim_gvauthTPSena_COMPU_VTAB 0 255 BIT_MASK 0xff /end CHARACTERISTIC
/begin COMPU_METHOD LoadLim_gvauthTPSena_COMPU_VTAB "Verbal Table" TAB_VERB "%.0" "list" COMPU_TAB_REF LoadLim_gvauthTPSena_COMPU_VTAB_REF /end COMPU_METHOD
/begin COMPU_VTAB LoadLim_gvauthTPSena_COMPU_VTAB_REF "Verbal Table" TAB_VERB 2 0 "Disabled" 1 "Enabled" DEFAULT_VALUE "UNKNOWN" /end COMPU_VTAB
/begin CHARACTERISTIC LOWREVLIM_maxgv_set "Fault low rev limit max gov settings{LOWREVLIM_maxgv_set&0xff=0:Use Min Gov settings}{LOWREVLIM_maxgv_set&0xff=1:Use Max Gov settings}{LOWREVLIM_maxgv_set&0xff=2:Use Max Gov isoc settings}{LOWREVLIM_maxgv_set&0xff=3:Use Gov1 settings}{LOWREVLIM_maxgv_set&" VALUE 0x00147e1a /* @ECU_Address@LOWREVLIM_maxgv_set@0x01012CF0@ */ ECIPP_ALIGNMENT_UBYTE 255 LOWREVLIM_maxgv_set_COMPU_VTAB 0 255 BIT_MASK 0xff /end CHARACTERISTIC
/begin COMPU_METHOD LOWREVLIM_maxgv_set_COMPU_VTAB "Verbal Table" TAB_VERB "%.0" "list" COMPU_TAB_REF LOWREVLIM_maxgv_set_COMPU_VTAB_REF /end COMPU_METHOD
/begin COMPU_VTAB LOWREVLIM_maxgv_set_COMPU_VTAB_REF "Verbal Table" TAB_VERB 6 0 "Use Min Gov settings" 1 "Use Max Gov settings" 2 "Use Max Gov isoc settings" 3 "Use Gov1 settings" 4 "Use Gov2 settings" 5 "Use Gov3 settings" DEFAULT_VALUE "UNKNOWN" /end COMPU_VTAB
/begin CHARACTERISTIC LLgear_table11 "Load-limit source 11{LLgear_table11&0xff=0:None}{LLgear_table11&0xff=1:Table 1 / Gasoline}{LLgear_table11&0xff=2:Table 2 / LPG}{LLgear_table11&0xff=3:Table 3 / NG}{LLgear_table11&0xff=4:Table 4 / Power}{LLgear_table11&0xff=5:Table 5}{LLgear_table11&0xff=6" VALUE 0x00147E0A /* @ECU_Address@LLgear_table11@0x01013318@ */ ECIPP_ALIGNMENT_UBYTE 255 LLgear_table11_COMPU_VTAB 0 255 BIT_MASK 0xff /end CHARACTERISTIC
/begin COMPU_METHOD LLgear_table11_COMPU_VTAB "Verbal Table" TAB_VERB "%.0" "list" COMPU_TAB_REF LLgear_table11_COMPU_VTAB_REF /end COMPU_METHOD
/begin COMPU_VTAB LLgear_table11_COMPU_VTAB_REF "Verbal Table" TAB_VERB 9 0 "None" 1 "Table 1 / Gasoline" 2 "Table 2 / LPG" 3 "Table 3 / NG" 4 "Table 4 / Power" 5 "Table 5" 6 "Table 6" 7 "Table 7" 8 "Table 8" DEFAULT_VALUE "UNKNOWN" /end COMPU_VTAB
/begin CHARACTERISTIC LLgear_table12 "Load-limit source 12{LLgear_table12&0xff=0:None}{LLgear_table12&0xff=1:Table 1 / Gasoline}{LLgear_table12&0xff=2:Table 2 / LPG}{LLgear_table12&0xff=3:Table 3 / NG}{LLgear_table12&0xff=4:Table 4 / Power}{LLgear_table12&0xff=5:Table 5}{LLgear_table12&0xff=6" VALUE 0x00147E0B /* @ECU_Address@LLgear_table12@0x01013320@ */ ECIPP_ALIGNMENT_UBYTE 255 LLgear_table12_COMPU_VTAB 0 255 BIT_MASK 0xff /end CHARACTERISTIC
/begin COMPU_METHOD LLgear_table12_COMPU_VTAB "Verbal Table" TAB_VERB "%.0" "list" COMPU_TAB_REF LLgear_table12_COMPU_VTAB_REF /end COMPU_METHOD
/begin COMPU_VTAB LLgear_table12_COMPU_VTAB_REF "Verbal Table" TAB_VERB 9 0 "None" 1 "Table 1 / Gasoline" 2 "Table 2 / LPG" 3 "Table 3 / NG" 4 "Table 4 / Power" 5 "Table 5" 6 "Table 6" 7 "Table 7" 8 "Table 8" DEFAULT_VALUE "UNKNOWN" /end COMPU_VTAB
/begin CHARACTERISTIC LLgear_table13 "Load-limit source 13{LLgear_table13&0xff=0:None}{LLgear_table13&0xff=1:Table 1 / Gasoline}{LLgear_table13&0xff=2:Table 2 / LPG}{LLgear_table13&0xff=3:Table 3 / NG}{LLgear_table13&0xff=4:Table 4 / Power}{LLgear_table13&0xff=5:Table 5}{LLgear_table13&0xff=6" VALUE 0x00147E0C /* @ECU_Address@LLgear_table13@0x01013328@ */ ECIPP_ALIGNMENT_UBYTE 255 LLgear_table13_COMPU_VTAB 0 255 BIT_MASK 0xff /end CHARACTERISTIC
/begin COMPU_METHOD LLgear_table13_COMPU_VTAB "Verbal Table" TAB_VERB "%.0" "list" COMPU_TAB_REF LLgear_table13_COMPU_VTAB_REF /end COMPU_METHOD
/begin COMPU_VTAB LLgear_table13_COMPU_VTAB_REF "Verbal Table" TAB_VERB 9 0 "None" 1 "Table 1 / Gasoline" 2 "Table 2 / LPG" 3 "Table 3 / NG" 4 "Table 4 / Power" 5 "Table 5" 6 "Table 6" 7 "Table 7" 8 "Table 8" DEFAULT_VALUE "UNKNOWN" /end COMPU_VTAB
/begin CHARACTERISTIC LLgear_table14 "Load-limit source 14{LLgear_table14&0xff=0:None}{LLgear_table14&0xff=1:Table 1 / Gasoline}{LLgear_table14&0xff=2:Table 2 / LPG}{LLgear_table14&0xff=3:Table 3 / NG}{LLgear_table14&0xff=4:Table 4 / Power}{LLgear_table14&0xff=5:Table 5}{LLgear_table14&0xff=6" VALUE 0x00147E0D /* @ECU_Address@LLgear_table14@0x01013330@ */ ECIPP_ALIGNMENT_UBYTE 255 LLgear_table14_COMPU_VTAB 0 255 BIT_MASK 0xff /end CHARACTERISTIC
/begin COMPU_METHOD LLgear_table14_COMPU_VTAB "Verbal Table" TAB_VERB "%.0" "list" COMPU_TAB_REF LLgear_table14_COMPU_VTAB_REF /end COMPU_METHOD
/begin COMPU_VTAB LLgear_table14_COMPU_VTAB_REF "Verbal Table" TAB_VERB 9 0 "None" 1 "Table 1 / Gasoline" 2 "Table 2 / LPG" 3 "Table 3 / NG" 4 "Table 4 / Power" 5 "Table 5" 6 "Table 6" 7 "Table 7" 8 "Table 8" DEFAULT_VALUE "UNKNOWN" /end COMPU_VTAB
/begin CHARACTERISTIC LLgear_table15 "Load-limit source 15{LLgear_table15&0xff=0:None}{LLgear_table15&0xff=1:Table 1 / Gasoline}{LLgear_table15&0xff=2:Table 2 / LPG}{LLgear_table15&0xff=3:Table 3 / NG}{LLgear_table15&0xff=4:Table 4 / Power}{LLgear_table15&0xff=5:Table 5}{LLgear_table15&0xff=6" VALUE 0x00147E0E /* @ECU_Address@LLgear_table15@0x01013338@ */ ECIPP_ALIGNMENT_UBYTE 255 LLgear_table15_COMPU_VTAB 0 255 BIT_MASK 0xff /end CHARACTERISTIC
/begin COMPU_METHOD LLgear_table15_COMPU_VTAB "Verbal Table" TAB_VERB "%.0" "list" COMPU_TAB_REF LLgear_table15_COMPU_VTAB_REF /end COMPU_METHOD
/begin COMPU_VTAB LLgear_table15_COMPU_VTAB_REF "Verbal Table" TAB_VERB 9 0 "None" 1 "Table 1 / Gasoline" 2 "Table 2 / LPG" 3 "Table 3 / NG" 4 "Table 4 / Power" 5 "Table 5" 6 "Table 6" 7 "Table 7" 8 "Table 8" DEFAULT_VALUE "UNKNOWN" /end COMPU_VTAB
/begin CHARACTERISTIC LLgear_table16 "Load-limit source 16{LLgear_table16&0xff=0:None}{LLgear_table16&0xff=1:Table 1 / Gasoline}{LLgear_table16&0xff=2:Table 2 / LPG}{LLgear_table16&0xff=3:Table 3 / NG}{LLgear_table16&0xff=4:Table 4 / Power}{LLgear_table16&0xff=5:Table 5}{LLgear_table16&0xff=6" VALUE 0x00147E0F /* @ECU_Address@LLgear_table16@0x01013340@ */ ECIPP_ALIGNMENT_UBYTE 255 LLgear_table16_COMPU_VTAB 0 255 BIT_MASK 0xff /end CHARACTERISTIC
/begin COMPU_METHOD LLgear_table16_COMPU_VTAB "Verbal Table" TAB_VERB "%.0" "list" COMPU_TAB_REF LLgear_table16_COMPU_VTAB_REF /end COMPU_METHOD
/begin COMPU_VTAB LLgear_table16_COMPU_VTAB_REF "Verbal Table" TAB_VERB 9 0 "None" 1 "Table 1 / Gasoline" 2 "Table 2 / LPG" 3 "Table 3 / NG" 4 "Table 4 / Power" 5 "Table 5" 6 "Table 6" 7 "Table 7" 8 "Table 8" DEFAULT_VALUE "UNKNOWN" /end COMPU_VTAB
/begin CHARACTERISTIC LLgear_table_rev1 "Load-limit source R1{LLgear_table_rev1&0xff=0:None}{LLgear_table_rev1&0xff=1:Table 1 / Gasoline}{LLgear_table_rev1&0xff=2:Table 2 / LPG}{LLgear_table_rev1&0xff=3:Table 3 / NG}{LLgear_table_rev1&0xff=4:Table 4 / Power}{LLgear_table_rev1&0xff=5:Table 5}{LLg" VALUE 0x00147E10 /* @ECU_Address@LLgear_table_rev1@0x01013348@ */ ECIPP_ALIGNMENT_UBYTE 255 LLgear_table_rev1_COMPU_VTAB 0 255 BIT_MASK 0xff /end CHARACTERISTIC
/begin COMPU_METHOD LLgear_table_rev1_COMPU_VTAB "Verbal Table" TAB_VERB "%.0" "list" COMPU_TAB_REF LLgear_table_rev1_COMPU_VTAB_REF /end COMPU_METHOD
/begin COMPU_VTAB LLgear_table_rev1_COMPU_VTAB_REF "Verbal Table" TAB_VERB 9 0 "None" 1 "Table 1 / Gasoline" 2 "Table 2 / LPG" 3 "Table 3 / NG" 4 "Table 4 / Power" 5 "Table 5" 6 "Table 6" 7 "Table 7" 8 "Table 8" DEFAULT_VALUE "UNKNOWN" /end COMPU_VTAB
/begin CHARACTERISTIC LLgear_table_rev2 "Load-limit source R2{LLgear_table_rev2&0xff=0:None}{LLgear_table_rev2&0xff=1:Table 1 / Gasoline}{LLgear_table_rev2&0xff=2:Table 2 / LPG}{LLgear_table_rev2&0xff=3:Table 3 / NG}{LLgear_table_rev2&0xff=4:Table 4 / Power}{LLgear_table_rev2&0xff=5:Table 5}{LLg" VALUE 0x00147E11 /* @ECU_Address@LLgear_table_rev2@0x01013350@ */ ECIPP_ALIGNMENT_UBYTE 255 LLgear_table_rev2_COMPU_VTAB 0 255 BIT_MASK 0xff /end CHARACTERISTIC
/begin COMPU_METHOD LLgear_table_rev2_COMPU_VTAB "Verbal Table" TAB_VERB "%.0" "list" COMPU_TAB_REF LLgear_table_rev2_COMPU_VTAB_REF /end COMPU_METHOD
/begin COMPU_VTAB LLgear_table_rev2_COMPU_VTAB_REF "Verbal Table" TAB_VERB 9 0 "None" 1 "Table 1 / Gasoline" 2 "Table 2 / LPG" 3 "Table 3 / NG" 4 "Table 4 / Power" 5 "Table 5" 6 "Table 6" 7 "Table 7" 8 "Table 8" DEFAULT_VALUE "UNKNOWN" /end COMPU_VTAB
/begin MEASUREMENT trans_idle_trqpctlmt "Transmission idle default torque limit" UBYTE Compu_trans_idle_trqpctlmt 0 0 -125 130 ECU_ADDRESS 0x01013600 /end MEASUREMENT
/begin COMPU_METHOD Compu_trans_idle_trqpctlmt " " RAT_FUNC "%.0" "%" COEFFS 0 1 125 0 0 1 /end COMPU_METHOD
/begin MEASUREMENT trans_offidle_trqlmt "Transmission off-idle default torque limit" UWORD Compu_trans_offidle_trqlmt 0 0 0 65535 ECU_ADDRESS 0x01013608 /end MEASUREMENT
/begin COMPU_METHOD Compu_trans_offidle_trqlmt " " RAT_FUNC "%.0" "Nm" COEFFS 0 1 0 0 0 1 /end COMPU_METHOD
/begin MEASUREMENT TEL_enable_ovrd "Telematics system override{TEL_enable_ovrd&0xff=0:Use calibration}{TEL_enable_ovrd&0xff=1:Disabled}{TEL_enable_ovrd&0xff=5:System 3 enabled}" UBYTE TEL_enable_ovrd_COMPU_VTAB 0 0 0 255 ECU_ADDRESS 0x010136D8 BIT_MASK 0xff /end MEASUREMENT
/begin COMPU_METHOD TEL_enable_ovrd_COMPU_VTAB "Verbal Table" TAB_VERB "%.0" "list" COMPU_TAB_REF TEL_enable_ovrd_COMPU_VTAB_REF /end COMPU_METHOD
/begin COMPU_VTAB TEL_enable_ovrd_COMPU_VTAB_REF "Verbal Table" TAB_VERB 3 0 "Use calibration" 1 "Disabled" 5 "System 3 enabled" DEFAULT_VALUE "UNKNOWN" /end COMPU_VTAB
/begin CHARACTERISTIC TEL3_enable "China VIb telematics system{TEL3_enable&0xff=0:Disabled}{TEL3_enable&0xff=1:FM_2}{TEL3_enable&0xff=2:TD}{TEL3_enable&0xff=3:WCM1 on request}{TEL3_enable&0xff=4:WCM1 broadcast}" VALUE 0x0014808e /* @ECU_Address@TEL3_enable@0x01013988@ */ ECIPP_ALIGNMENT_UBYTE 255 TEL3_enable_COMPU_VTAB 0 255 BIT_MASK 0xff /end CHARACTERISTIC
/begin COMPU_METHOD TEL3_enable_COMPU_VTAB "Verbal Table" TAB_VERB "%.0" "list" COMPU_TAB_REF TEL3_enable_COMPU_VTAB_REF /end COMPU_METHOD
/begin COMPU_VTAB TEL3_enable_COMPU_VTAB_REF "Verbal Table" TAB_VERB 5 0 "Disabled" 1 "FM_2" 2 "TD" 3 "WCM1 on request" 4 "WCM1 broadcast" DEFAULT_VALUE "UNKNOWN" /end COMPU_VTAB
/begin CHARACTERISTIC TEL3_keyon_wt "Telematics unit key-on wait" VALUE 0x00147872 /* @ECU_Address@TEL3_keyon_wt@0x01013990@ */ ECIPP_ALIGNMENT_UWORD 65535 Compu_TEL3_keyon_wt 0 65535 /end CHARACTERISTIC
/begin COMPU_METHOD Compu_TEL3_keyon_wt " " RAT_FUNC "%.0" "seconds" COEFFS 0 1 0 0 0 1 /end COMPU_METHOD
/begin CHARACTERISTIC TEL3_Rx_timeout "Telematics valid message receipt timeout" VALUE 0x00147870 /* @ECU_Address@TEL3_Rx_timeout@0x01013998@ */ ECIPP_ALIGNMENT_UWORD 327675 Compu_TEL3_Rx_timeout 0 327675 /end CHARACTERISTIC
/begin COMPU_METHOD Compu_TEL3_Rx_timeout " " RAT_FUNC "%.0" "ms" COEFFS 0 0.2 0 0 0 1 /end COMPU_METHOD
/begin CHARACTERISTIC TEL3_req_lim "Telematics request limit" VALUE 0x0014808f /* @ECU_Address@TEL3_req_lim@0x010139A0@ */ ECIPP_ALIGNMENT_UBYTE 255 Compu_TEL3_req_lim 0 255 /end CHARACTERISTIC
/begin COMPU_METHOD Compu_TEL3_req_lim " " RAT_FUNC "%.0" "requests" COEFFS 0 1 0 0 0 1 /end COMPU_METHOD
/begin CHARACTERISTIC TEL3_retry_wait "Telematics retry wait time" VALUE 0x00147874 /* @ECU_Address@TEL3_retry_wait@0x010139A8@ */ ECIPP_ALIGNMENT_UWORD 65535 Compu_TEL3_retry_wait 0 65535 /end CHARACTERISTIC
/begin COMPU_METHOD Compu_TEL3_retry_wait " " RAT_FUNC "%.0" "seconds" COEFFS 0 1 0 0 0 1 /end COMPU_METHOD
/begin CHARACTERISTIC TEL3_attempt_lim "Telematics communication attempt limit" VALUE 0x0014808d /* @ECU_Address@TEL3_attempt_lim@0x010139B0@ */ ECIPP_ALIGNMENT_UBYTE 255 Compu_TEL3_attempt_lim 0 255 /end CHARACTERISTIC
/begin COMPU_METHOD Compu_TEL3_attempt_lim " " RAT_FUNC "%.0" "attempts" COEFFS 0 1 0 0 0 1 /end COMPU_METHOD
/begin MEASUREMENT TEL3_link_good "Telematics unit link active and OK{TEL3_link_good&0xff=0x00:OFF}{TEL3_link_good&0xff=0x01:ON}" UBYTE TEL3_link_good_COMPU_VTAB 0 0 0 255 ECU_ADDRESS 0x010139B8 BIT_MASK 0xff /end MEASUREMENT
/begin COMPU_METHOD TEL3_link_good_COMPU_VTAB "Verbal Table" TAB_VERB "%.0" "list" COMPU_TAB_REF TEL3_link_good_COMPU_VTAB_REF /end COMPU_METHOD
/begin COMPU_VTAB TEL3_link_good_COMPU_VTAB_REF "Verbal Table" TAB_VERB 2 0x00 "OFF" 0x01 "ON" DEFAULT_VALUE "UNKNOWN" /end COMPU_VTAB
/begin MEASUREMENT TEL3_req_tmr "Telematics request wait timer" ULONG Compu_TEL3_req_tmr 0 0 0 4294967.295 ECU_ADDRESS 0x010139C0 /end MEASUREMENT
/begin COMPU_METHOD Compu_TEL3_req_tmr " " RAT_FUNC "%.1" "seconds" COEFFS 0 1000 0 0 0 1 /end COMPU_METHOD
/begin MEASUREMENT TEL3_req_cnt "Telematics request counter" UBYTE Compu_TEL3_req_cnt 0 0 0 255 ECU_ADDRESS 0x010139C8 /end MEASUREMENT
/begin COMPU_METHOD Compu_TEL3_req_cnt " " RAT_FUNC "%.0" "requests" COEFFS 0 1 0 0 0 1 /end COMPU_METHOD
/begin MEASUREMENT TEL3_attempt_cnt "Telematics communication attempt counter" UBYTE Compu_TEL3_attempt_cnt 0 0 0 255 ECU_ADDRESS 0x010139D0 /end MEASUREMENT
/begin COMPU_METHOD Compu_TEL3_attempt_cnt " " RAT_FUNC "%.0" "attempts" COEFFS 0 1 0 0 0 1 /end COMPU_METHOD
/begin MEASUREMENT TEL_state_num "Telematics processing state" UBYTE Compu_TEL_state_num 0 0 0 255 ECU_ADDRESS 0x01013BA0 /end MEASUREMENT
/begin COMPU_METHOD Compu_TEL_state_num " " RAT_FUNC "%.0" "-" COEFFS 0 1 0 0 0 1 /end COMPU_METHOD
/begin MEASUREMENT telematics_to_cnt "Telematics unit message timeouts" UBYTE Compu_telematics_to_cnt 0 0 0 255 ECU_ADDRESS 0x01013BA8 /end MEASUREMENT
/begin COMPU_METHOD Compu_telematics_to_cnt " " RAT_FUNC "%.0" "cycles" COEFFS 0 1 0 0 0 1 /end COMPU_METHOD
/begin COMPU_METHOD Compu_TLoadLim_rpm " " RAT_FUNC "%.0" "Speed (rpm)" COEFFS 0 1 0 0 0 1 /end COMPU_METHOD
/begin CHARACTERISTIC TLoadLim_NGpct "Load-Limiting NG" CURVE 0x001450CE /* @ECU_Address@TLoadLim_NGpct@0x020BD000@ */ ECIPP_ALIGNMENT_SWORD 200 Compu_TLoadLim_NGpct -200 199.993896484375
 /begin AXIS_DESCR COM_AXIS NO_INPUT_QUANTITY Compu_TLoadLim_rpm 8 -32768 32767 AXIS_PTS_REF TLoadLim_rpm /end AXIS_DESCR
/end CHARACTERISTIC
/begin AXIS_PTS TLoadLim_rpm " " 0x0014512E /* @ECU_Address@TLoadLim_rpm@0x020BC000@ */ NO_INPUT_QUANTITY ECIPP_Lookup_SWORD 0 Compu_TLoadLim_rpm 8 -32768 32767 /end AXIS_PTS
/begin COMPU_METHOD Compu_TLoadLim_NGpct " " RAT_FUNC "%.1" "Load-Limit (%)" COEFFS 0 163.84 0 0 0 1 /end COMPU_METHOD
/begin CHARACTERISTIC TLoadLim_LPGpct "Load-Limiting LPG" CURVE 0x001450BE /* @ECU_Address@TLoadLim_LPGpct@0x020BE000@ */ ECIPP_ALIGNMENT_SWORD 200 Compu_TLoadLim_LPGpct -200 199.993896484375
 /begin AXIS_DESCR COM_AXIS NO_INPUT_QUANTITY Compu_TLoadLim_rpm 8 -32768 32767 AXIS_PTS_REF TLoadLim_rpm /end AXIS_DESCR
/end CHARACTERISTIC
/begin COMPU_METHOD Compu_TLoadLim_LPGpct " " RAT_FUNC "%.1" "Load-Limit (%)" COEFFS 0 163.84 0 0 0 1 /end COMPU_METHOD
/begin CHARACTERISTIC TLoadLim_GSLNpct "Load-Limiting Gasoline" CURVE 0x001450AE /* @ECU_Address@TLoadLim_GSLNpct@0x020BF000@ */ ECIPP_ALIGNMENT_SWORD 200 Compu_TLoadLim_GSLNpct -200 199.993896484375
 /begin AXIS_DESCR COM_AXIS NO_INPUT_QUANTITY Compu_TLoadLim_rpm 8 -32768 32767 AXIS_PTS_REF TLoadLim_rpm /end AXIS_DESCR
/end CHARACTERISTIC
/begin COMPU_METHOD Compu_TLoadLim_GSLNpct " " RAT_FUNC "%.1" "Load-Limit (%)" COEFFS 0 163.84 0 0 0 1 /end COMPU_METHOD
/begin COMPU_METHOD Compu_TLdLimECT_ECT " " RAT_FUNC "%.0" "ECT (deg F)" COEFFS 0 32 14720 0 0 1 /end COMPU_METHOD
/begin CHARACTERISTIC TLdLimECT_pct "ECT Load-Limiting" CURVE 0x0014501A /* @ECU_Address@TLdLimECT_pct@0x020DF000@ */ ECIPP_ALIGNMENT_SWORD 200 Compu_TLdLimECT_pct -200 199.993896484375
 /begin AXIS_DESCR COM_AXIS NO_INPUT_QUANTITY Compu_TLdLimECT_ECT 8 -1484 563.96875 AXIS_PTS_REF TLdLimECT_ECT /end AXIS_DESCR
/end CHARACTERISTIC
/begin AXIS_PTS TLdLimECT_ECT " " 0x00144FF6 /* @ECU_Address@TLdLimECT_ECT@0x020DE000@ */ NO_INPUT_QUANTITY ECIPP_Lookup_SWORD 0 Compu_TLdLimECT_ECT 8 -1484 563.96875 /end AXIS_PTS
/begin COMPU_METHOD Compu_TLdLimECT_pct " " RAT_FUNC "%.1" "Load-Limit (%)" COEFFS 0 163.84 0 0 0 1 /end COMPU_METHOD
/begin COMPU_METHOD Compu_TLdLimTaux_T " " RAT_FUNC "%.0" "Aux Temp (deg F)" COEFFS 0 32 14720 0 0 1 /end COMPU_METHOD
/begin CHARACTERISTIC TLdLimTaux_pct "Aux-Temperature Load-Limiting" CURVE 0x0014509E /* @ECU_Address@TLdLimTaux_pct@0x0210B000@ */ ECIPP_ALIGNMENT_SWORD 200 Compu_TLdLimTaux_pct -200 199.993896484375
 /begin AXIS_DESCR COM_AXIS NO_INPUT_QUANTITY Compu_TLdLimTaux_T 8 -1484 563.96875 AXIS_PTS_REF TLdLimTaux_T /end AXIS_DESCR
/end CHARACTERISTIC
/begin AXIS_PTS TLdLimTaux_T " " 0x0014508E /* @ECU_Address@TLdLimTaux_T@0x0210A000@ */ NO_INPUT_QUANTITY ECIPP_Lookup_SWORD 0 Compu_TLdLimTaux_T 8 -1484 563.96875 /end AXIS_PTS
/begin COMPU_METHOD Compu_TLdLimTaux_pct " " RAT_FUNC "%.1" "Load-Limit (%)" COEFFS 0 163.84 0 0 0 1 /end COMPU_METHOD
/begin CHARACTERISTIC TLdLimECT_TPSpct "ECT TPS-Limiting" CURVE 0x00145006 /* @ECU_Address@TLdLimECT_TPSpct@0x02131000@ */ ECIPP_ALIGNMENT_SWORD 200 Compu_TLdLimECT_TPSpct -200 199.993896484375
 /begin AXIS_DESCR COM_AXIS NO_INPUT_QUANTITY Compu_TLdLimECT_ECT 8 -1484 563.96875 AXIS_PTS_REF TLdLimECT_ECT /end AXIS_DESCR
/end CHARACTERISTIC
/begin COMPU_METHOD Compu_TLdLimECT_TPSpct " " RAT_FUNC "%.1" "TPS-Limit (%)" COEFFS 0 163.84 0 0 0 1 /end COMPU_METHOD
/begin CHARACTERISTIC TLoadLim_PWRpct "Load-Limiting Power" CURVE 0x001450DE /* @ECU_Address@TLoadLim_PWRpct@0x023A9000@ */ ECIPP_ALIGNMENT_SWORD 200 Compu_TLoadLim_PWRpct -200 199.993896484375
 /begin AXIS_DESCR COM_AXIS NO_INPUT_QUANTITY Compu_TLoadLim_rpm 8 -32768 32767 AXIS_PTS_REF TLoadLim_rpm /end AXIS_DESCR
/end CHARACTERISTIC
/begin COMPU_METHOD Compu_TLoadLim_PWRpct " " RAT_FUNC "%.1" "Load-Limit (%)" COEFFS 0 163.84 0 0 0 1 /end COMPU_METHOD
/begin CHARACTERISTIC TLoadLim_max_gov "Max Gov" VAL_BLK 0x001478A8 /* @ECU_Address@TLoadLim_max_gov@0x023AA000@ */ ECIPP_ALIGNMENT_UWORD 65535 Compu_TLoadLim_max_gov 0 65535 MATRIX_DIM 8 1 1 /end CHARACTERISTIC
/begin COMPU_METHOD Compu_TLoadLim_max_gov " " RAT_FUNC "%.0" "rpm" COEFFS 0 1 0 0 0 1 /end COMPU_METHOD
/begin CHARACTERISTIC TLoadLim_T5_pct "Load-Limiting Table 5" CURVE 0x001450EE /* @ECU_Address@TLoadLim_T5_pct@0x025C9000@ */ ECIPP_ALIGNMENT_SWORD 200 Compu_TLoadLim_T5_pct -200 199.993896484375
 /begin AXIS_DESCR COM_AXIS NO_INPUT_QUANTITY Compu_TLoadLim_rpm 8 -32768 32767 AXIS_PTS_REF TLoadLim_rpm /end AXIS_DESCR
/end CHARACTERISTIC
/begin COMPU_METHOD Compu_TLoadLim_T5_pct " " RAT_FUNC "%.1" "Load-Limit (%)" COEFFS 0 163.84 0 0 0 1 /end COMPU_METHOD
/begin CHARACTERISTIC TLoadLim_T6_pct "Load-Limiting Table 6" CURVE 0x001450FE /* @ECU_Address@TLoadLim_T6_pct@0x025CA000@ */ ECIPP_ALIGNMENT_SWORD 200 Compu_TLoadLim_T6_pct -200 199.993896484375
 /begin AXIS_DESCR COM_AXIS NO_INPUT_QUANTITY Compu_TLoadLim_rpm 8 -32768 32767 AXIS_PTS_REF TLoadLim_rpm /end AXIS_DESCR
/end CHARACTERISTIC
/begin COMPU_METHOD Compu_TLoadLim_T6_pct " " RAT_FUNC "%.1" "Load-Limit (%)" COEFFS 0 163.84 0 0 0 1 /end COMPU_METHOD
/begin CHARACTERISTIC TLLgear_ratio "Gear ratio 1" VAL_BLK 0x00144FD2 /* @ECU_Address@TLLgear_ratio@0x02616000@ */ ECIPP_ALIGNMENT_SWORD 256 Compu_TLLgear_ratio -256 255.9921875 MATRIX_DIM 16 1 1 /end CHARACTERISTIC
/begin COMPU_METHOD Compu_TLLgear_ratio " " RAT_FUNC "%.2" "Gear Ratio" COEFFS 0 128 0 0 0 1 /end COMPU_METHOD
/begin COMPU_METHOD Compu_TLdLimTaux2_T " " RAT_FUNC "%.0" "Aux Temp (deg F)" COEFFS 0 4 1840 0 0 1 /end COMPU_METHOD
/begin CHARACTERISTIC TLdLimTaux2_pct "Aux-Temperature 2 Load-Limiting" CURVE 0x0014507E /* @ECU_Address@TLdLimTaux2_pct@0x0261B000@ */ ECIPP_ALIGNMENT_SWORD 200 Compu_TLdLimTaux2_pct -200 199.993896484375
 /begin AXIS_DESCR COM_AXIS NO_INPUT_QUANTITY Compu_TLdLimTaux2_T 8 -8652 7731.75 AXIS_PTS_REF TLdLimTaux2_T /end AXIS_DESCR
/end CHARACTERISTIC
/begin AXIS_PTS TLdLimTaux2_T " " 0x0014506E /* @ECU_Address@TLdLimTaux2_T@0x0261A000@ */ NO_INPUT_QUANTITY ECIPP_Lookup_SWORD 0 Compu_TLdLimTaux2_T 8 -8652 7731.75 /end AXIS_PTS
/begin COMPU_METHOD Compu_TLdLimTaux2_pct " " RAT_FUNC "%.1" "Load-Limit (%)" COEFFS 0 163.84 0 0 0 1 /end COMPU_METHOD
/begin COMPU_METHOD Compu_TLdLimECT_rpm " " RAT_FUNC "%.0" "Speed (rpm)" COEFFS 0 1 0 0 0 1 /end COMPU_METHOD
/begin CHARACTERISTIC TLdLimECT_mult "ECT-Based Load-Limit Speed Adjustment" CURVE 0x00145016 /* @ECU_Address@TLdLimECT_mult@0x02621000@ */ ECIPP_ALIGNMENT_SWORD 2 Compu_TLdLimECT_mult -2 1.99993896484375
 /begin AXIS_DESCR COM_AXIS NO_INPUT_QUANTITY Compu_TLdLimECT_rpm 2 -32768 32767 AXIS_PTS_REF TLdLimECT_rpm /end AXIS_DESCR
/end CHARACTERISTIC
/begin AXIS_PTS TLdLimECT_rpm " " 0x0014502A /* @ECU_Address@TLdLimECT_rpm@0x02620000@ */ NO_INPUT_QUANTITY ECIPP_Lookup_SWORD 0 Compu_TLdLimECT_rpm 2 -32768 32767 /end AXIS_PTS
/begin COMPU_METHOD Compu_TLdLimECT_mult " " RAT_FUNC "%.3" "Limit (mult)" COEFFS 0 16384 0 0 0 1 /end COMPU_METHOD
/begin CHARACTERISTIC TLoadLim_T7_pct "Load-Limiting Table 7" CURVE 0x0014510E /* @ECU_Address@TLoadLim_T7_pct@0x02643000@ */ ECIPP_ALIGNMENT_SWORD 200 Compu_TLoadLim_T7_pct -200 199.993896484375
 /begin AXIS_DESCR COM_AXIS NO_INPUT_QUANTITY Compu_TLoadLim_rpm 8 -32768 32767 AXIS_PTS_REF TLoadLim_rpm /end AXIS_DESCR
/end CHARACTERISTIC
/begin COMPU_METHOD Compu_TLoadLim_T7_pct " " RAT_FUNC "%.1" "Load-Limit (%)" COEFFS 0 163.84 0 0 0 1 /end COMPU_METHOD
/begin CHARACTERISTIC TLoadLim_T8_pct "Load-Limiting Table 8" CURVE 0x0014511E /* @ECU_Address@TLoadLim_T8_pct@0x02644000@ */ ECIPP_ALIGNMENT_SWORD 200 Compu_TLoadLim_T8_pct -200 199.993896484375
 /begin AXIS_DESCR COM_AXIS NO_INPUT_QUANTITY Compu_TLoadLim_rpm 8 -32768 32767 AXIS_PTS_REF TLoadLim_rpm /end AXIS_DESCR
/end CHARACTERISTIC
/begin COMPU_METHOD Compu_TLoadLim_T8_pct " " RAT_FUNC "%.1" "Load-Limit (%)" COEFFS 0 163.84 0 0 0 1 /end COMPU_METHOD
/begin CHARACTERISTIC TLLgear_ratio_rev "Reverse gear ratio 1" VAL_BLK 0x00144FF2 /* @ECU_Address@TLLgear_ratio_rev@0x0265C000@ */ ECIPP_ALIGNMENT_SWORD 256 Compu_TLLgear_ratio_rev -256 255.9921875 MATRIX_DIM 2 1 1 /end CHARACTERISTIC
/begin COMPU_METHOD Compu_TLLgear_ratio_rev " " RAT_FUNC "%.2" "Gear Ratio" COEFFS 0 128 0 0 0 1 /end COMPU_METHOD
/begin GROUP EC_Derate "ECONTROLS" ROOT
 /begin REF_CHARACTERISTIC derate1 derate2 fault_rev_lim fault_rev_limd LoadLim_ena forced_idle_rpm fault_rev_lim_latch LOWREVLIM_slew_down LOWREVLIM_slew_up derate1_rev_lim derate2_rev_lim derate2_latch derate_unlatch_RPM derate_unlatch_FPP LoadLim_Taux_src DERATE_TPS_slew_dn DERATE_TPS_slew_up SD_ramp_ena SD_ramp_twait MILblk_derate LLAdapt_ena LLAdapt_Ki LLAdapt_slew_lim LLAdapt_dld_max LLAdapt_dld_min LLAdapt_frz_wait LoadLim_mode LoadLim_T1_volts LoadLim_T2_volts LoadLim_T3_volts TEL_enable_CNHTC TEL_Rx_timeout TEL_Rx_Tx_delay TEL_derate_nextkey TEL_derate_noRx TEL_rpm_lim1 TEL_rpm_lim2 TEL_const_a TEL_const_b TEL_const_c TEL_const_d LoadLim_eco_table LoadLim_perf_input VPA_ena VPA_min_speed VPA_max_speed VPA_tout VPA_delay TEL_enable_Yuchai LoadLim_max_gov_ena TEL_derate_actv_chan derate1_EGR_minnom derate2_EGR_minnom derate1_dbw_mode derate2_dbw_mode LLTO_pct LLTO_VE_CWT_crct_pct LLTO_hold_time LLTO_slew_rate TEL_enable_Yuchai2 TEL_seed_upd_rate LoadLim_T1_fuel LoadLim_T2_fuel LoadLim_T3_fuel LoadLim_T4_fuel LoadLim_T5_fuel LoadLim_T6_fuel LoadLim_T1_chan LoadLim_T2_chan LoadLim_T3_chan LoadLim_T4_chan LoadLim_T5_chan LoadLim_T6_chan LoadLim_T1_chan_cfg LoadLim_T2_chan_cfg LoadLim_T3_chan_cfg LoadLim_T4_chan_cfg LoadLim_T5_chan_cfg LoadLim_T6_chan_cfg LoadLim_T1_ntwk LoadLim_T2_ntwk LoadLim_T3_ntwk LoadLim_T4_ntwk LoadLim_T5_ntwk LoadLim_T6_ntwk LoadLim_A_volts LoadLim_B_volts LoadLim_C_volts TEL2_Rx_timeout TEL2_derate_nextkey TEL2_derate_noRx TEL2_rpm_lim1 TEL2_rpm_lim2 TEL2_derate_act_chan TEL2_enable_DumpTrk derate1_FSO_ena LLgear_ena LLgear_tire LLgear_axle_ratio LLgear_table1 LLgear_table2 LLgear_table3 LLgear_table4 LLgear_table5 LLgear_table6 LLgear_table7 LLgear_table8 LLgear_table9 LLgear_table10 LoadLim_Taux2_src FPlo_derate_ena FPlo_derate_Ptau FPlo_derate_dly_on FPlo_derate_dly_off FPlo_derate_Pon FPlo_derate_Poff FPlo_derate_LLmin FPlo_derate_off_tau FPlo_derate_on_tau LoadLim_ECT_tau LLTO_multi_fuel_ena LLTO_pct_gsln LLTO_pct_LPG LLTO_pct_NG LoadLim_T7_fuel LoadLim_T8_fuel LoadLim_T7_chan LoadLim_T8_chan LoadLim_T7_chan_cfg LoadLim_T8_chan_cfg LoadLim_T7_ntwk LoadLim_T8_ntwk FPlo_derate_hybridwt LoadLim_gvauthTPSena LOWREVLIM_maxgv_set LLgear_table11 LLgear_table12 LLgear_table13 LLgear_table14 LLgear_table15 LLgear_table16 LLgear_table_rev1 LLgear_table_rev2 TEL3_enable TEL3_keyon_wt TEL3_Rx_timeout TEL3_req_lim TEL3_retry_wait TEL3_attempt_lim TLoadLim_NGpct TLoadLim_LPGpct TLoadLim_GSLNpct TLdLimECT_pct TLdLimTaux_pct TLdLimECT_TPSpct TLoadLim_PWRpct TLoadLim_max_gov TLoadLim_T5_pct TLoadLim_T6_pct TLLgear_ratio TLdLimTaux2_pct TLdLimECT_mult TLoadLim_T7_pct TLoadLim_T8_pct TLLgear_ratio_rev /end REF_CHARACTERISTIC
 /begin REF_MEASUREMENT LoadLim_max_pct LoadLim_max_TPS LOWREVLIM_fuel_rpm LOWREVLIM_gov_rpm LOWREVLIM_active DERATE1_active DERATE2_active LoadLim_Taux_T SD_ramp_tmr SD_active FORCEIDLE_active LLAdapt_dload LoadLim_T_active TEL_derate_active TEL_bound TEL_derate_type EE_TEL_derate_active EE_TEL_derate_type TEL_comm_req_cnt TEL_comm_fail_cnt TEL_comm_tout_cnt TEL_comm_good_cnt TEL_link_good LoadLim_perf_stat LoadLim_dmd_pct VPA_derate_active VPA_gear1_LED VPA_rev_LED TEL_derate LoadLim_max_gov_actv GovMax_rpm DERATE_TPSlim DERATE_loadlim DERATE_TPSlim_use DERATE_loadlim_use DERATE_loadlim_slewd DERATE_FPPlim_use DERATE_FPPlim DERATE_FPPlim_rpm LOWREVLIM_use LoadLim_max_TPS_src LLTO_state LLTO_hold_tmr LLTO_pct_inc LLTO_actv TEL_key_msb TEL_key_lsb TEL2_link_good TEL2_bound TEL2_derate_active TEL2_derate_type EE_TEL2_derate_actv EE_TEL2_derate_type TEL2_derate LLgear_loadlim LLgear_num LoadLim_Taux2_T FPlo_derate_use FPlo_derate_loadlim CFV_P_err_acc FPlo_derate_tmr trans_idle_trqpctlmt trans_offidle_trqlmt TEL_enable_ovrd TEL3_link_good TEL3_req_tmr TEL3_req_cnt TEL3_attempt_cnt TEL_state_num telematics_to_cnt /end REF_MEASUREMENT
/end GROUP
/begin GROUP EC_DieselMode "ECONTROLS" ROOT
 /begin REF_CHARACTERISTIC CRI_air_slct0 CRI_air_slct1 CRI_air_slct2 CRI_air_slct3 CRI_air_slct4 CRI_air_slct5 CRI_air_slct6 CRI_air_slct7 CRI_P_slct0 CRI_P_slct1 CRI_P_slct2 CRI_P_slct3 CRI_P_slct4 CRI_P_slct5 CRI_P_slct6 CRI_P_slct7 CRI_dilpct_slct0 CRI_dilpct_slct1 CRI_dilpct_slct2 CRI_dilpct_slct3 CRI_dilpct_slct4 CRI_dilpct_slct5 CRI_dilpct_slct6 CRI_dilpct_slct7 CRI_Qpilot2_slct0 CRI_Qpilot2_slct1 CRI_Qpilot2_slct2 CRI_Qpilot2_slct3 CRI_Qpilot2_slct4 CRI_Qpilot2_slct5 CRI_Qpilot2_slct6 CRI_Qpilot2_slct7 CRI_Qpilot1_slct0 CRI_Qpilot1_slct1 CRI_Qpilot1_slct2 CRI_Qpilot1_slct3 CRI_Qpilot1_slct4 CRI_Qpilot1_slct5 CRI_Qpilot1_slct6 CRI_Qpilot1_slct7 CRI_Qload_slct0 CRI_Qload_slct1 CRI_Qload_slct2 CRI_Qload_slct3 CRI_Qload_slct4 CRI_Qload_slct5 CRI_Qload_slct6 CRI_Qload_slct7 CRI_Qpost1_slct0 CRI_Qpost1_slct1 CRI_Qpost1_slct2 CRI_Qpost1_slct3 CRI_Qpost1_slct4 CRI_Qpost1_slct5 CRI_Qpost1_slct6 CRI_Qpost1_slct7 CRI_Qpost2_slct0 CRI_Qpost2_slct1 CRI_Qpost2_slct2 CRI_Qpost2_slct3 CRI_Qpost2_slct4 CRI_Qpost2_slct5 CRI_Qpost2_slct6 CRI_Qpost2_slct7 CRI_Tpilot2_slct0 CRI_Tpilot2_slct1 CRI_Tpilot2_slct2 CRI_Tpilot2_slct3 CRI_Tpilot2_slct4 CRI_Tpilot2_slct5 CRI_Tpilot2_slct6 CRI_Tpilot2_slct7 CRI_Tpilot1_slct0 CRI_Tpilot1_slct1 CRI_Tpilot1_slct2 CRI_Tpilot1_slct3 CRI_Tpilot1_slct4 CRI_Tpilot1_slct5 CRI_Tpilot1_slct6 CRI_Tpilot1_slct7 CRI_Tmain_slct0 CRI_Tmain_slct1 CRI_Tmain_slct2 CRI_Tmain_slct3 CRI_Tmain_slct4 CRI_Tmain_slct5 CRI_Tmain_slct6 CRI_Tmain_slct7 CRI_Tpost1_slct0 CRI_Tpost1_slct1 CRI_Tpost1_slct2 CRI_Tpost1_slct3 CRI_Tpost1_slct4 CRI_Tpost1_slct5 CRI_Tpost1_slct6 CRI_Tpost1_slct7 CRI_Tpost2_slct0 /end REF_CHARACTERISTIC
/end GROUP
/begin GROUP EC_Faults "ECONTROLS" ROOT
 /begin REF_MEASUREMENT LOWREVLIM_active DERATE1_active DERATE2_active SD_active FORCEIDLE_active /end REF_MEASUREMENT
/end GROUP
/begin GROUP EC_GovCal "ECONTROLS" ROOT /begin REF_MEASUREMENT LoadLim_max_gov_actv GovMax_rpm /end REF_MEASUREMENT /end GROUP
/begin GROUP EC_GovCalAlt "ECONTROLS" ROOT /begin REF_MEASUREMENT LoadLim_max_gov_actv GovMax_rpm /end REF_MEASUREMENT /end GROUP
/begin GROUP EC_HDService2 "ECONTROLS" ROOT
 /begin REF_MEASUREMENT LoadLim_max_pct LoadLim_max_TPS LoadLim_T_active LoadLim_perf_stat LoadLim_dmd_pct LoadLim_max_TPS_src LLTO_pct_inc LLTO_actv /end REF_MEASUREMENT
/end GROUP
/begin GROUP EC_LDService "ECONTROLS" ROOT
 /begin REF_MEASUREMENT LOWREVLIM_active DERATE1_active DERATE2_active SD_active FORCEIDLE_active /end REF_MEASUREMENT
/end GROUP
/begin GROUP EC_Marine "ECONTROLS" ROOT /begin REF_MEASUREMENT LOWREVLIM_active DERATE1_active DERATE2_active /end REF_MEASUREMENT /end GROUP
/begin GROUP EC_Outputs "ECONTROLS" ROOT /begin REF_MEASUREMENT SD_active /end REF_MEASUREMENT /end GROUP
/end MODULE
/end PROJECT
