ASAP2_VERSION 1 61
/begin PROJECT Econtrols_4G "4G Test"
/begin HEADER "4G A2L Configuration" PROJECT_NO EControls4G /* config for version control */ VERSION "$Revision: 82130 $:" /* config for version control */ /end HEADER
/begin MODULE EControls_4G_SH2A "EControls 4G"
/begin MOD_COMMON "" DEPOSIT ABSOLUTE BYTE_ORDER MSB_FIRST /end MOD_COMMON
/* Define the Record Layouts */
/begin RECORD_LAYOUT ECIPP_ALIGNMENT_UBYTE FNC_VALUES 1 UBYTE COLUMN_DIR DIRECT /end RECORD_LAYOUT
/begin RECORD_LAYOUT ECIPP_ALIGNMENT_UWORD FNC_VALUES 1 UWORD COLUMN_DIR DIRECT /end RECORD_LAYOUT
/begin RECORD_LAYOUT ECIPP_ALIGNMENT_SWORD FNC_VALUES 1 SWORD COLUMN_DIR DIRECT /end RECORD_LAYOUT
/begin RECORD_LAYOUT ECIPP_Lookup_SWORD AXIS_PTS_X 1 SWORD INDEX_INCR DIRECT /end RECORD_LAYOUT
/begin RECORD_LAYOUT ECIPP_ALIGNMENT_FLOAT32_IEEE FNC_VALUES 1 FLOAT32_IEEE COLUMN_DIR DIRECT /end RECORD_LAYOUT
/begin CHARACTERISTIC Vint_lower "Intake volume lower" VALUE 0x00147a62 /* @ECU_Address@Vint_lower@0x01001320@ */ ECIPP_ALIGNMENT_UWORD 32 Compu_Vint_lower 0 31.99951171875 /end CHARACTERISTIC
/begin COMPU_METHOD Compu_Vint_lower " " RAT_FUNC "%.2" "liters" COEFFS 0 2048 0 0 0 1 /end COMPU_METHOD
/begin CHARACTERISTIC Vint_total "Intake volume total" VALUE 0x00147a64 /* @ECU_Address@Vint_total@0x01001328@ */ ECIPP_ALIGNMENT_UWORD 32 Compu_Vint_total 0 31.99951171875 /end CHARACTERISTIC
/begin COMPU_METHOD Compu_Vint_total " " RAT_FUNC "%.2" "liters" COEFFS 0 2048 0 0 0 1 /end COMPU_METHOD
/begin CHARACTERISTIC Vexhaust "Exhaust volume total" VALUE 0x00147a60 /* @ECU_Address@Vexhaust@0x01001330@ */ ECIPP_ALIGNMENT_UWORD 32 Compu_Vexhaust 0 31.99951171875 /end CHARACTERISTIC
/begin COMPU_METHOD Compu_Vexhaust " " RAT_FUNC "%.2" "liters" COEFFS 0 2048 0 0 0 1 /end COMPU_METHOD
/begin CHARACTERISTIC OILP_trig "Oil pressure switch threshold voltage (Fault Condition:a threshold voltage of)" VALUE 0x0014766c /* @ECU_Address@OILP_trig@0x01001540@ */ ECIPP_ALIGNMENT_UWORD 5 Compu_OILP_trig 0 5.00114468864469 /end CHARACTERISTIC
/begin COMPU_METHOD Compu_OILP_trig " " RAT_FUNC "%.3" "volts" COEFFS 0 13104 0 0 0 1 /end COMPU_METHOD
/begin CHARACTERISTIC OILP_test "Oil pressure configuration{OILP_test&0xff=0x00:Low voltage = OK}{OILP_test&0xff=0x01:High voltage = OK} (Fault Condition:Oil pressure input)" VALUE 0x00147e9e /* @ECU_Address@OILP_test@0x01001550@ */ ECIPP_ALIGNMENT_UBYTE 255 OILP_test_COMPU_VTAB 0 255 BIT_MASK 0xff /end CHARACTERISTIC
/begin COMPU_METHOD OILP_test_COMPU_VTAB "Verbal Table" TAB_VERB "%.0" "list" COMPU_TAB_REF OILP_test_COMPU_VTAB_REF /end COMPU_METHOD
/begin COMPU_VTAB OILP_test_COMPU_VTAB_REF "Verbal Table" TAB_VERB 2 0x00 "Low voltage = OK" 0x01 "High voltage = OK" DEFAULT_VALUE "UNKNOWN" /end COMPU_VTAB
/begin MEASUREMENT crknoise_cnt "crknoise_cnt" UWORD Compu_crknoise_cnt 0 0 0 65535 ECU_ADDRESS 0x01001668 /end MEASUREMENT
/begin COMPU_METHOD Compu_crknoise_cnt " " RAT_FUNC "%.0" "events" COEFFS 0 1 0 0 0 1 /end COMPU_METHOD
/begin MEASUREMENT camnoise_cnt "camnoise_cnt" UWORD Compu_camnoise_cnt 0 0 0 65535 ECU_ADDRESS 0x01001670 /end MEASUREMENT
/begin COMPU_METHOD Compu_camnoise_cnt " " RAT_FUNC "%.0" "events" COEFFS 0 1 0 0 0 1 /end COMPU_METHOD
/begin MEASUREMENT sync_state "sync_state" SBYTE Compu_sync_state 0 0 -128 127 ECU_ADDRESS 0x01001678 /end MEASUREMENT
/begin COMPU_METHOD Compu_sync_state " " RAT_FUNC "%.0" "state" COEFFS 0 1 0 0 0 1 /end COMPU_METHOD
/begin MEASUREMENT crank_tooth_cnt "crank_tooth_cnt" SWORD Compu_crank_tooth_cnt 0 0 -32768 32767 ECU_ADDRESS 0x01001680 /end MEASUREMENT
/begin COMPU_METHOD Compu_crank_tooth_cnt " " RAT_FUNC "%.0" "tooth" COEFFS 0 1 0 0 0 1 /end COMPU_METHOD
/begin CHARACTERISTIC keysw_type "Key switch input type{keysw_type&0xff=0x00:Manual}{keysw_type&0xff=0x01:Automatic}" VALUE 0x001481a4 /* @ECU_Address@keysw_type@0x01001788@ */ ECIPP_ALIGNMENT_UBYTE 255 keysw_type_COMPU_VTAB 0 255 BIT_MASK 0xff /end CHARACTERISTIC
/begin COMPU_METHOD keysw_type_COMPU_VTAB "Verbal Table" TAB_VERB "%.0" "list" COMPU_TAB_REF keysw_type_COMPU_VTAB_REF /end COMPU_METHOD
/begin COMPU_VTAB keysw_type_COMPU_VTAB_REF "Verbal Table" TAB_VERB 2 0x00 "Manual" 0x01 "Automatic" DEFAULT_VALUE "UNKNOWN" /end COMPU_VTAB
/begin MEASUREMENT SH "Specific humidity" UBYTE Compu_SH 0 0 0 62.255859375 ECU_ADDRESS 0x01001A90 /end MEASUREMENT
/begin COMPU_METHOD Compu_SH " " RAT_FUNC "%.1" "g/kg" COEFFS 0 4.096 0 0 0 1 /end COMPU_METHOD
/begin MEASUREMENT MAPc "MAP sensor constant" UWORD Compu_MAPc 0 0 0 255.99609375 ECU_ADDRESS 0x01002128 /end MEASUREMENT
/begin COMPU_METHOD Compu_MAPc " " RAT_FUNC "%.2" "psi / 5V" COEFFS 0 256 0 0 0 1 /end COMPU_METHOD
/begin MEASUREMENT MAPo "MAP sensor offset" SWORD Compu_MAPo 0 0 -128 127.99609375 ECU_ADDRESS 0x01002130 /end MEASUREMENT
/begin COMPU_METHOD Compu_MAPo " " RAT_FUNC "%.2" "psia" COEFFS 0 256 0 0 0 1 /end COMPU_METHOD
/begin MEASUREMENT TIPc "TIP sensor constant" UWORD Compu_TIPc 0 0 0 255.99609375 ECU_ADDRESS 0x01002138 /end MEASUREMENT
/begin COMPU_METHOD Compu_TIPc " " RAT_FUNC "%.2" "psi / 5V" COEFFS 0 256 0 0 0 1 /end COMPU_METHOD
/begin MEASUREMENT TIPo "TIP sensor offset" SWORD Compu_TIPo 0 0 -128 127.99609375 ECU_ADDRESS 0x01002140 /end MEASUREMENT
/begin COMPU_METHOD Compu_TIPo " " RAT_FUNC "%.2" "psia" COEFFS 0 256 0 0 0 1 /end COMPU_METHOD
/begin CHARACTERISTIC TIP_ena "TIP sensor{TIP_ena&0xff=0:Estimated}{TIP_ena&0xff=1:Default input}{TIP_ena&0xff=2:Aux PD1}{TIP_ena&0xff=3:Aux PUD5}{TIP_ena&0xff=4:Aux PU1}{TIP_ena&0xff=5:Aux PU2}{TIP_ena&0xff=6:Aux PUD1}{TIP_ena&0xff=7:Aux PUD2}{TIP_ena&0xff=8:Aux PUD3}{TIP_ena&0xff=9:A" VALUE 0x0014809c /* @ECU_Address@TIP_ena@0x01002170@ */ ECIPP_ALIGNMENT_UBYTE 255 TIP_ena_COMPU_VTAB 0 255 BIT_MASK 0xff /end CHARACTERISTIC
/begin COMPU_METHOD TIP_ena_COMPU_VTAB "Verbal Table" TAB_VERB "%.0" "list" COMPU_TAB_REF TIP_ena_COMPU_VTAB_REF /end COMPU_METHOD
/begin COMPU_VTAB TIP_ena_COMPU_VTAB_REF "Verbal Table" TAB_VERB 11 0 "Estimated" 1 "Default input" 2 "Aux PD1" 3 "Aux PUD5" 4 "Aux PU1" 5 "Aux PU2" 6 "Aux PUD1" 7 "Aux PUD2" 8 "Aux PUD3" 9 "Aux PUD4" 10 "FPP2 Input" DEFAULT_VALUE "UNKNOWN" /end COMPU_VTAB
/begin CHARACTERISTIC crank_HW_cfg "crank input hardware config{crank_HW_cfg&0xff=0:Mag Pickup}{crank_HW_cfg&0xff=1:Hall - No Pullup}{crank_HW_cfg&0xff=2:Hall - With Pullup}{crank_HW_cfg&0xff=3:Disabled}" VALUE 0x00149600 /* @ECU_Address@crank_HW_cfg@0x010025E0@ */ ECIPP_ALIGNMENT_UBYTE 255 crank_HW_cfg_COMPU_VTAB 0 255 BIT_MASK 0xff /end CHARACTERISTIC
/begin COMPU_METHOD crank_HW_cfg_COMPU_VTAB "Verbal Table" TAB_VERB "%.0" "list" COMPU_TAB_REF crank_HW_cfg_COMPU_VTAB_REF /end COMPU_METHOD
/begin COMPU_VTAB crank_HW_cfg_COMPU_VTAB_REF "Verbal Table" TAB_VERB 4 0 "Mag Pickup" 1 "Hall - No Pullup" 2 "Hall - With Pullup" 3 "Disabled" DEFAULT_VALUE "UNKNOWN" /end COMPU_VTAB
/begin CHARACTERISTIC cam_HW_cfg "cam input hardware config{cam_HW_cfg&0xff=0:Mag Pickup}{cam_HW_cfg&0xff=1:Hall - No Pullup}{cam_HW_cfg&0xff=2:Hall - With Pullup}{cam_HW_cfg&0xff=3:Disabled}" VALUE 0x001494E0 /* @ECU_Address@cam_HW_cfg@0x010025E8@ */ ECIPP_ALIGNMENT_UBYTE 255 cam_HW_cfg_COMPU_VTAB 0 255 BIT_MASK 0xff /end CHARACTERISTIC
/begin COMPU_METHOD cam_HW_cfg_COMPU_VTAB "Verbal Table" TAB_VERB "%.0" "list" COMPU_TAB_REF cam_HW_cfg_COMPU_VTAB_REF /end COMPU_METHOD
/begin COMPU_VTAB cam_HW_cfg_COMPU_VTAB_REF "Verbal Table" TAB_VERB 4 0 "Mag Pickup" 1 "Hall - No Pullup" 2 "Hall - With Pullup" 3 "Disabled" DEFAULT_VALUE "UNKNOWN" /end COMPU_VTAB
/begin CHARACTERISTIC RS_HW_cfg "RS input hardware config{RS_HW_cfg&0xff=0:Mag Pickup}{RS_HW_cfg&0xff=1:Hall - No Pullup}{RS_HW_cfg&0xff=2:Hall - With Pullup}{RS_HW_cfg&0xff=3:Disabled}" VALUE 0x0014963C /* @ECU_Address@RS_HW_cfg@0x010025F0@ */ ECIPP_ALIGNMENT_UBYTE 255 RS_HW_cfg_COMPU_VTAB 0 255 BIT_MASK 0xff /end CHARACTERISTIC
/begin COMPU_METHOD RS_HW_cfg_COMPU_VTAB "Verbal Table" TAB_VERB "%.0" "list" COMPU_TAB_REF RS_HW_cfg_COMPU_VTAB_REF /end COMPU_METHOD
/begin COMPU_VTAB RS_HW_cfg_COMPU_VTAB_REF "Verbal Table" TAB_VERB 4 0 "Mag Pickup" 1 "Hall - No Pullup" 2 "Hall - With Pullup" 3 "Disabled" DEFAULT_VALUE "UNKNOWN" /end COMPU_VTAB
/begin MEASUREMENT OILPc "OilP sensor constant" UWORD Compu_OILPc 0 0 0 255.99609375 ECU_ADDRESS 0x01002BD8 /end MEASUREMENT
/begin COMPU_METHOD Compu_OILPc " " RAT_FUNC "%.2" "psi / 5V" COEFFS 0 256 0 0 0 1 /end COMPU_METHOD
/begin MEASUREMENT OILPo "OilP sensor offset" SWORD Compu_OILPo 0 0 -128 127.99609375 ECU_ADDRESS 0x01002BE0 /end MEASUREMENT
/begin COMPU_METHOD Compu_OILPo " " RAT_FUNC "%.2" "psig" COEFFS 0 256 0 0 0 1 /end COMPU_METHOD
/begin MEASUREMENT crank_cnt_diag "crank_cnt_diag" UWORD Compu_crank_cnt_diag 0 0 0 65535 ECU_ADDRESS 0x01002C10 /end MEASUREMENT
/begin COMPU_METHOD Compu_crank_cnt_diag " " RAT_FUNC "%.0" "-" COEFFS 0 1 0 0 0 1 /end COMPU_METHOD
/begin MEASUREMENT cam_cnt_diag "cam_cnt_diag" UWORD Compu_cam_cnt_diag 0 0 0 65535 ECU_ADDRESS 0x01002C18 /end MEASUREMENT
/begin COMPU_METHOD Compu_cam_cnt_diag " " RAT_FUNC "%.0" "-" COEFFS 0 1 0 0 0 1 /end COMPU_METHOD
/begin MEASUREMENT crkloss_camcnt "crkloss_camcnt" UWORD Compu_crkloss_camcnt 0 0 0 65535 ECU_ADDRESS 0x01002C20 /end MEASUREMENT
/begin COMPU_METHOD Compu_crkloss_camcnt " " RAT_FUNC "%.0" "-" COEFFS 0 1 0 0 0 1 /end COMPU_METHOD
/begin MEASUREMENT HM_RAMr_seconds "Raw (non-offset) hour meter" ULONG Compu_HM_RAMr_seconds 0 0 0 1193046.47083333 ECU_ADDRESS 0x01003548 /end MEASUREMENT
/begin COMPU_METHOD Compu_HM_RAMr_seconds " " RAT_FUNC "%.3" "hours" COEFFS 0 3600 0 0 0 1 /end COMPU_METHOD
/begin MEASUREMENT HM_RAMr_starts "Raw (non-offset) cumulative starts" ULONG Compu_HM_RAMr_starts 0 0 0 4294967295 ECU_ADDRESS 0x01003550 /end MEASUREMENT
/begin COMPU_METHOD Compu_HM_RAMr_starts " " RAT_FUNC "%.0" "starts" COEFFS 0 1 0 0 0 1 /end COMPU_METHOD
/begin MEASUREMENT HM_sec_offset "Hour meter offset" SLONG Compu_HM_sec_offset 0 0 -596523.235555556 596523.235277778 ECU_ADDRESS 0x01003558 /end MEASUREMENT
/begin COMPU_METHOD Compu_HM_sec_offset " " RAT_FUNC "%.3" "hours" COEFFS 0 3600 0 0 0 1 /end COMPU_METHOD
/begin MEASUREMENT HM_start_offset "Cumulative starts offset" SLONG Compu_HM_start_offset 0 0 -2147483648 2147483647 ECU_ADDRESS 0x01003560 /end MEASUREMENT
/begin COMPU_METHOD Compu_HM_start_offset " " RAT_FUNC "%.0" "starts" COEFFS 0 1 0 0 0 1 /end COMPU_METHOD
/begin MEASUREMENT HM_offset_write "Hour meter/starts offset write" UWORD Compu_HM_offset_write 0 0 0 65535 ECU_ADDRESS 0x01003568 /end MEASUREMENT
/begin COMPU_METHOD Compu_HM_offset_write " " RAT_FUNC "%.0" "[47392]" COEFFS 0 1 0 0 0 1 /end COMPU_METHOD
/begin CHARACTERISTIC engine_select "Multi-engine selection{engine_select&0xff=0:Master / Single}{engine_select&0xff=1:Slave 1}{engine_select&0xff=2:Slave 2}{engine_select&0xff=3:Slave 3}{engine_select&0xff=4:Aux PU1}{engine_select&0xff=5:Aux PU2}{engine_select&0xff=6:Aux PU3}{engine_select&" VALUE 0x0014815a /* @ECU_Address@engine_select@0x01003588@ */ ECIPP_ALIGNMENT_UBYTE 255 engine_select_COMPU_VTAB 0 255 BIT_MASK 0xff /end CHARACTERISTIC
/begin COMPU_METHOD engine_select_COMPU_VTAB "Verbal Table" TAB_VERB "%.0" "list" COMPU_TAB_REF engine_select_COMPU_VTAB_REF /end COMPU_METHOD
/begin COMPU_VTAB engine_select_COMPU_VTAB_REF "Verbal Table" TAB_VERB 15 0 "Master / Single" 1 "Slave 1" 2 "Slave 2" 3 "Slave 3" 4 "Aux PU1" 5 "Aux PU2" 6 "Aux PU3" 7 "Aux PUD1" 8 "Aux PUD2" 9 "Aux PUD3" 10 "Aux DIG1" 11 "Aux DIG2" 12 "Aux DIG3" 13 "Aux PUD4" 14 "Aux PUD5" DEFAULT_VALUE "UNKNOWN" /end COMPU_VTAB
/begin MEASUREMENT engine_number "Multi-engine status{engine_number&0xff=0:Master / Single}{engine_number&0xff=1:Slave 1}{engine_number&0xff=2:Slave 2}{engine_number&0xff=3:Slave 3}" UBYTE engine_number_COMPU_VTAB 0 0 0 255 ECU_ADDRESS 0x01003590 BIT_MASK 0xff /end MEASUREMENT
/begin COMPU_METHOD engine_number_COMPU_VTAB "Verbal Table" TAB_VERB "%.0" "list" COMPU_TAB_REF engine_number_COMPU_VTAB_REF /end COMPU_METHOD
/begin COMPU_VTAB engine_number_COMPU_VTAB_REF "Verbal Table" TAB_VERB 4 0 "Master / Single" 1 "Slave 1" 2 "Slave 2" 3 "Slave 3" DEFAULT_VALUE "UNKNOWN" /end COMPU_VTAB
/begin MEASUREMENT engine_SNPN_write "engine_SNPN_write" UWORD Compu_engine_SNPN_write 0 0 0 65535 ECU_ADDRESS 0x01003888 /end MEASUREMENT
/begin COMPU_METHOD Compu_engine_SNPN_write " " RAT_FUNC "%.0" "[25932]" COEFFS 0 1 0 0 0 1 /end COMPU_METHOD
/begin CHARACTERISTIC FT_ena "Gasoline fuel temp input{FT_ena&0xff=0:Disabled}{FT_ena&0xff=1:Standard Input}{FT_ena&0xff=2:Aux PU1}{FT_ena&0xff=3:Aux PU2}{FT_ena&0xff=4:Aux PU3}{FT_ena&0xff=5:Aux PUD1}{FT_ena&0xff=6:Aux PUD2}{FT_ena&0xff=7:Aux PUD3}{FT_ena&0xff=8:EGT Input}{FT_ena&0xf" VALUE 0x00147d8f /* @ECU_Address@FT_ena@0x01003E18@ */ ECIPP_ALIGNMENT_UBYTE 255 FT_ena_COMPU_VTAB 0 255 BIT_MASK 0xff /end CHARACTERISTIC
/begin COMPU_METHOD FT_ena_COMPU_VTAB "Verbal Table" TAB_VERB "%.0" "list" COMPU_TAB_REF FT_ena_COMPU_VTAB_REF /end COMPU_METHOD
/begin COMPU_VTAB FT_ena_COMPU_VTAB_REF "Verbal Table" TAB_VERB 20 0 "Disabled" 1 "Standard Input" 2 "Aux PU1" 3 "Aux PU2" 4 "Aux PU3" 5 "Aux PUD1" 6 "Aux PUD2" 7 "Aux PUD3" 8 "EGT Input" 9 "EPR sourced" 10 "Aux PUD4" 11 "Aux PUD5" 12 "Aux PUD6" 13 "Aux PUD7" 14 "Aux PUD8" 15 "Aux PUD9" 16 "Aux PUD10" 17 "SENT1 Serial" 18 "SENT2 Serial" 19 "MFG sourced" DEFAULT_VALUE "UNKNOWN" /end COMPU_VTAB
/begin CHARACTERISTIC FT_gaseous_ena "Gaseous fuel temp input{FT_gaseous_ena&0xff=0:Disabled}{FT_gaseous_ena&0xff=1:Standard Input}{FT_gaseous_ena&0xff=2:Aux PU1}{FT_gaseous_ena&0xff=3:Aux PU2}{FT_gaseous_ena&0xff=4:Aux PU3}{FT_gaseous_ena&0xff=5:Aux PUD1}{FT_gaseous_ena&0xff=6:Aux PUD2}{FT_g" VALUE 0x00147d91 /* @ECU_Address@FT_gaseous_ena@0x01003E20@ */ ECIPP_ALIGNMENT_UBYTE 255 FT_gaseous_ena_COMPU_VTAB 0 255 BIT_MASK 0xff /end CHARACTERISTIC
/begin COMPU_METHOD FT_gaseous_ena_COMPU_VTAB "Verbal Table" TAB_VERB "%.0" "list" COMPU_TAB_REF FT_gaseous_ena_COMPU_VTAB_REF /end COMPU_METHOD
/begin COMPU_VTAB FT_gaseous_ena_COMPU_VTAB_REF "Verbal Table" TAB_VERB 20 0 "Disabled" 1 "Standard Input" 2 "Aux PU1" 3 "Aux PU2" 4 "Aux PU3" 5 "Aux PUD1" 6 "Aux PUD2" 7 "Aux PUD3" 8 "EGT Input" 9 "EPR sourced" 10 "Aux PUD4" 11 "Aux PUD5" 12 "Aux PUD6" 13 "Aux PUD7" 14 "Aux PUD8" 15 "Aux PUD9" 16 "Aux PUD10" 17 "SENT1 Serial" 18 "SENT2 Serial" 19 "MFG sourced" DEFAULT_VALUE "UNKNOWN" /end COMPU_VTAB
/begin CHARACTERISTIC ReverseRotation "engine rotation direction{ReverseRotation&0xff=0:Normal - LH}{ReverseRotation&0xff=1:Reverse - RH}" VALUE 0x00147f2a /* @ECU_Address@ReverseRotation@0x01004608@ */ ECIPP_ALIGNMENT_UBYTE 255 ReverseRotation_COMPU_VTAB 0 255 BIT_MASK 0xff /end CHARACTERISTIC
/begin COMPU_METHOD ReverseRotation_COMPU_VTAB "Verbal Table" TAB_VERB "%.0" "list" COMPU_TAB_REF ReverseRotation_COMPU_VTAB_REF /end COMPU_METHOD
/begin COMPU_VTAB ReverseRotation_COMPU_VTAB_REF "Verbal Table" TAB_VERB 2 0 "Normal - LH" 1 "Reverse - RH" DEFAULT_VALUE "UNKNOWN" /end COMPU_VTAB
/begin CHARACTERISTIC cam_reqactv "required before cam sync{cam_reqactv&0xff=0:None}{cam_reqactv&0xff=1:Stuck Low Check}{cam_reqactv&0xff=2:Stuck High Check}{cam_reqactv&0xff=3:Stuck High/Low Check}{cam_reqactv&0xff=4:Force Sync if Cam Loss}" VALUE 0x00148124 /* @ECU_Address@cam_reqactv@0x010047B8@ */ ECIPP_ALIGNMENT_UBYTE 255 cam_reqactv_COMPU_VTAB 0 255 BIT_MASK 0xff /end CHARACTERISTIC
/begin COMPU_METHOD cam_reqactv_COMPU_VTAB "Verbal Table" TAB_VERB "%.0" "list" COMPU_TAB_REF cam_reqactv_COMPU_VTAB_REF /end COMPU_METHOD
/begin COMPU_VTAB cam_reqactv_COMPU_VTAB_REF "Verbal Table" TAB_VERB 5 0 "None" 1 "Stuck Low Check" 2 "Stuck High Check" 3 "Stuck High/Low Check" 4 "Force Sync if Cam Loss" DEFAULT_VALUE "UNKNOWN" /end COMPU_VTAB
/begin CHARACTERISTIC IAT_ena "IAT source{IAT_ena&0xff=0:Disabled}{IAT_ena&0xff=1:Standard Input}{IAT_ena&0xff=2:Network Source}{IAT_ena&0xff=3:Aux PU3}{IAT_ena&0xff=4:MFA sourced}" VALUE 0x00147db2 /* @ECU_Address@IAT_ena@0x01005288@ */ ECIPP_ALIGNMENT_UBYTE 255 IAT_ena_COMPU_VTAB 0 255 BIT_MASK 0xff /end CHARACTERISTIC
/begin COMPU_METHOD IAT_ena_COMPU_VTAB "Verbal Table" TAB_VERB "%.0" "list" COMPU_TAB_REF IAT_ena_COMPU_VTAB_REF /end COMPU_METHOD
/begin COMPU_VTAB IAT_ena_COMPU_VTAB_REF "Verbal Table" TAB_VERB 5 0 "Disabled" 1 "Standard Input" 2 "Network Source" 3 "Aux PU3" 4 "MFA sourced" DEFAULT_VALUE "UNKNOWN" /end COMPU_VTAB
/begin CHARACTERISTIC cam_level_sync "cam state at sync tooth{cam_level_sync&0xff=0:Ignored}{cam_level_sync&0xff=1:Low Level}{cam_level_sync&0xff=2:High Level}{cam_level_sync&0xff=3:Either Level}{cam_level_sync&0xff=4:Falling Edge}" VALUE 0x00148123 /* @ECU_Address@cam_level_sync@0x010052A0@ */ ECIPP_ALIGNMENT_UBYTE 255 cam_level_sync_COMPU_VTAB 0 255 BIT_MASK 0xff /end CHARACTERISTIC
/begin COMPU_METHOD cam_level_sync_COMPU_VTAB "Verbal Table" TAB_VERB "%.0" "list" COMPU_TAB_REF cam_level_sync_COMPU_VTAB_REF /end COMPU_METHOD
/begin COMPU_VTAB cam_level_sync_COMPU_VTAB_REF "Verbal Table" TAB_VERB 5 0 "Ignored" 1 "Low Level" 2 "High Level" 3 "Either Level" 4 "Falling Edge" DEFAULT_VALUE "UNKNOWN" /end COMPU_VTAB
/begin CHARACTERISTIC cam_capture "cam1 edge capture{cam_capture&0xff=0:Disabled}{cam_capture&0xff=1:Falling Edges}{cam_capture&0xff=2:Rising Edges}{cam_capture&0xff=3:Both Edges}" VALUE 0x001494E1 /* @ECU_Address@cam_capture@0x010052A8@ */ ECIPP_ALIGNMENT_UBYTE 255 cam_capture_COMPU_VTAB 0 255 BIT_MASK 0xff /end CHARACTERISTIC
/begin COMPU_METHOD cam_capture_COMPU_VTAB "Verbal Table" TAB_VERB "%.0" "list" COMPU_TAB_REF cam_capture_COMPU_VTAB_REF /end COMPU_METHOD
/begin COMPU_VTAB cam_capture_COMPU_VTAB_REF "Verbal Table" TAB_VERB 4 0 "Disabled" 1 "Falling Edges" 2 "Rising Edges" 3 "Both Edges" DEFAULT_VALUE "UNKNOWN" /end COMPU_VTAB
/begin CHARACTERISTIC crank_capture "crank edge capture{crank_capture&0xff=0:Disabled}{crank_capture&0xff=1:Falling Edges}{crank_capture&0xff=2:Rising Edges}{crank_capture&0xff=3:Both Edges}" VALUE 0x00149601 /* @ECU_Address@crank_capture@0x010052B0@ */ ECIPP_ALIGNMENT_UBYTE 255 crank_capture_COMPU_VTAB 0 255 BIT_MASK 0xff /end CHARACTERISTIC
/begin COMPU_METHOD crank_capture_COMPU_VTAB "Verbal Table" TAB_VERB "%.0" "list" COMPU_TAB_REF crank_capture_COMPU_VTAB_REF /end COMPU_METHOD
/begin COMPU_VTAB crank_capture_COMPU_VTAB_REF "Verbal Table" TAB_VERB 4 0 "Disabled" 1 "Falling Edges" 2 "Rising Edges" 3 "Both Edges" DEFAULT_VALUE "UNKNOWN" /end COMPU_VTAB
/begin CHARACTERISTIC sync_allow "sync allow" VALUE 0x001481be /* @ECU_Address@sync_allow@0x01006470@ */ ECIPP_ALIGNMENT_UBYTE 255 Compu_sync_allow 0 255 /end CHARACTERISTIC
/begin COMPU_METHOD Compu_sync_allow " " RAT_FUNC "%.0" "teeth" COEFFS 0 1 0 0 0 1 /end COMPU_METHOD
/begin CHARACTERISTIC CAD_sync_to_TDCC "sync to TDCC offset" VALUE 0x00144256 /* @ECU_Address@CAD_sync_to_TDCC@0x010064F8@ */ ECIPP_ALIGNMENT_SWORD 2048 Compu_CAD_sync_to_TDCC -2048 2047.9375 /end CHARACTERISTIC
/begin COMPU_METHOD Compu_CAD_sync_to_TDCC " " RAT_FUNC "%.3" "CAD" COEFFS 0 16 0 0 0 1 /end COMPU_METHOD
/begin CHARACTERISTIC CCM_type "crank-cam module{CCM_type&0xff=0:Generic 60-2 crank, hi/lo cam}{CCM_type&0xff=1:Generic 36-1-1 crank, 1 pulse cam}{CCM_type&0xff=2:GM 8-cyl distributor, hi/lo cam}{CCM_type&0xff=3:GM 6-cyl distributor, hi/lo cam}{CCM_type&0xff=4:GM 60-2 crank, 4-pulse var" VALUE 0x00147cee /* @ECU_Address@CCM_type@0x01006B30@ */ ECIPP_ALIGNMENT_UBYTE 255 CCM_type_COMPU_VTAB 0 255 BIT_MASK 0xff /end CHARACTERISTIC
/begin COMPU_METHOD CCM_type_COMPU_VTAB "Verbal Table" TAB_VERB "%.0" "list" COMPU_TAB_REF CCM_type_COMPU_VTAB_REF /end COMPU_METHOD
/begin COMPU_VTAB CCM_type_COMPU_VTAB_REF "Verbal Table" TAB_VERB 33 0 "Generic 60-2 crank, hi/lo cam" 1 "Generic 36-1-1 crank, 1 pulse cam" 2 "GM 8-cyl distributor, hi/lo cam" 3 "GM 6-cyl distributor, hi/lo cam" 4 "GM 60-2 crank, 4-pulse variable cam" 5 "Generic 60-2 crank, 6+1 cam" 6 "Generic 60-2 cam-mounted, crank input" 7 "Generic flywheel governing only" 8 "Generic 36-2 crank, hi/lo cam" 9 "Generic 36-2 cam-mounted, crank input" 10 "Generic 60-2 crank, 1 pulse cam" 11 "Generic 60-2 crank, 12+1 pulse cam" 12 "Generic 36-1 crank, 1 pulse cam" 13 "Generic 36-2-2 crank, 1 pulse cam" 14 "Generic 60-2 crank, 2+2+2+3 pulse cam" 15 "GM 24 pulse coded crank, hi/lo cam" 16 "Ford 36-1 crank, V-8 4+1+1+1 pulse variable cam" 17 "Ford 36-1 crank, V-6 3+1 pulse variable cam" 18 "Generic 60-4 crank, 6+1 cam" 19 "Generic 60-2 crank, 4+1 cam" 20 "Ford 36-1 crank, 2+3+1+1+1 cam" 21 "Generic 60-2 crank, 24 shifted pulse cam" 22 "Generic 60-2 crank, 3+1 pulse cam" 23 "Ford 36-1 crank, 4+1+1 variable cam" 24 "Ford 60-2 crank, 4 pulse (2W+2N) variable cam" 25 "Generic 60-2 crank, 8+1  pulse cam" 26 "Generic 60-2 crank, 4 variable size pulse cam" 27 "Generic 60-2-2-2 crank, 6+1 pulse cam" 28 "Generic 36-2-2 crank, coded cam" 29 "Generic 60-4 crank, 4+1 cam" 30 "Generic 60-2 crank, single-cyl, no cam sensor" 31 "Generic 60-2 crank, V-6 3+1 pulse variable cam" 32 "Generic 36-2 crank, 1 pulse cam" DEFAULT_VALUE "UNKNOWN" /end COMPU_VTAB
/begin CHARACTERISTIC cam2_HW_cfg "cam2 input hardware config{cam2_HW_cfg&0xff=0:Mag Pickup}{cam2_HW_cfg&0xff=1:Hall - No Pullup}{cam2_HW_cfg&0xff=2:Hall - With Pullup}{cam2_HW_cfg&0xff=3:Disabled}" VALUE 0x001494EC /* @ECU_Address@cam2_HW_cfg@0x01006C18@ */ ECIPP_ALIGNMENT_UBYTE 255 cam2_HW_cfg_COMPU_VTAB 0 255 BIT_MASK 0xff /end CHARACTERISTIC
/begin COMPU_METHOD cam2_HW_cfg_COMPU_VTAB "Verbal Table" TAB_VERB "%.0" "list" COMPU_TAB_REF cam2_HW_cfg_COMPU_VTAB_REF /end COMPU_METHOD
/begin COMPU_VTAB cam2_HW_cfg_COMPU_VTAB_REF "Verbal Table" TAB_VERB 4 0 "Mag Pickup" 1 "Hall - No Pullup" 2 "Hall - With Pullup" 3 "Disabled" DEFAULT_VALUE "UNKNOWN" /end COMPU_VTAB
/begin CHARACTERISTIC cam2_capture "cam2 edge capture{cam2_capture&0xff=0:Disabled}{cam2_capture&0xff=1:Falling Edges}{cam2_capture&0xff=2:Rising Edges}{cam2_capture&0xff=3:Both Edges}" VALUE 0x001494ED /* @ECU_Address@cam2_capture@0x01006C20@ */ ECIPP_ALIGNMENT_UBYTE 255 cam2_capture_COMPU_VTAB 0 255 BIT_MASK 0xff /end CHARACTERISTIC
/begin COMPU_METHOD cam2_capture_COMPU_VTAB "Verbal Table" TAB_VERB "%.0" "list" COMPU_TAB_REF cam2_capture_COMPU_VTAB_REF /end COMPU_METHOD
/begin COMPU_VTAB cam2_capture_COMPU_VTAB_REF "Verbal Table" TAB_VERB 4 0 "Disabled" 1 "Falling Edges" 2 "Rising Edges" 3 "Both Edges" DEFAULT_VALUE "UNKNOWN" /end COMPU_VTAB
/begin CHARACTERISTIC RS_capture "roadspeed edge capture{RS_capture&0xff=0:Disabled}{RS_capture&0xff=1:Falling Edges}{RS_capture&0xff=2:Rising Edges}{RS_capture&0xff=3:Both Edges}" VALUE 0x0014963D /* @ECU_Address@RS_capture@0x01006C28@ */ ECIPP_ALIGNMENT_UBYTE 255 RS_capture_COMPU_VTAB 0 255 BIT_MASK 0xff /end CHARACTERISTIC
/begin COMPU_METHOD RS_capture_COMPU_VTAB "Verbal Table" TAB_VERB "%.0" "list" COMPU_TAB_REF RS_capture_COMPU_VTAB_REF /end COMPU_METHOD
/begin COMPU_VTAB RS_capture_COMPU_VTAB_REF "Verbal Table" TAB_VERB 4 0 "Disabled" 1 "Falling Edges" 2 "Rising Edges" 3 "Both Edges" DEFAULT_VALUE "UNKNOWN" /end COMPU_VTAB
/begin CHARACTERISTIC CAD_camsync_to_TDCC "cam sync to TDCC offset" VALUE 0x00144252 /* @ECU_Address@CAD_camsync_to_TDCC@0x01006C50@ */ ECIPP_ALIGNMENT_SWORD 2048 Compu_CAD_camsync_to_TDCC -2048 2047.9375 /end CHARACTERISTIC
/begin COMPU_METHOD Compu_CAD_camsync_to_TDCC " " RAT_FUNC "%.3" "CAD" COEFFS 0 16 0 0 0 1 /end COMPU_METHOD
/begin MEASUREMENT crank_tooth_saved "Crank tooth saved{crank_tooth_saved&0xff=0:NO}{crank_tooth_saved&0xff=1:YES}" UBYTE crank_tooth_saved_COMPU_VTAB 0 0 0 255 ECU_ADDRESS 0x01007140 BIT_MASK 0xff /end MEASUREMENT
/begin COMPU_METHOD crank_tooth_saved_COMPU_VTAB "Verbal Table" TAB_VERB "%.0" "list" COMPU_TAB_REF crank_tooth_saved_COMPU_VTAB_REF /end COMPU_METHOD
/begin COMPU_VTAB crank_tooth_saved_COMPU_VTAB_REF "Verbal Table" TAB_VERB 2 0 "NO" 1 "YES" DEFAULT_VALUE "UNKNOWN" /end COMPU_VTAB
/begin CHARACTERISTIC crank_mag_inc_tau "crank mag trig inc tau" VALUE 0x00149604 /* @ECU_Address@crank_mag_inc_tau@0x01007560@ */ ECIPP_ALIGNMENT_UWORD 41943 Compu_crank_mag_inc_tau 0.0006557704 41943.04 /end CHARACTERISTIC
/begin COMPU_METHOD Compu_crank_mag_inc_tau " " FORM "%.1" "ms"
 /begin FORMULA "-0.01 / log(1 - (X1 / 4194304))" FORMULA_INV "(1 - exp(-0.01/X1)) * 4194304" /end FORMULA
/end COMPU_METHOD
/begin CHARACTERISTIC crank_mag_dec_tau "crank mag trig dec tau" VALUE 0x00149606 /* @ECU_Address@crank_mag_dec_tau@0x01007568@ */ ECIPP_ALIGNMENT_UWORD 41943 Compu_crank_mag_dec_tau 0.0006557704 41943.04 /end CHARACTERISTIC
/begin COMPU_METHOD Compu_crank_mag_dec_tau " " FORM "%.1" "ms"
 /begin FORMULA "-0.01 / log(1 - (X1 / 4194304))" FORMULA_INV "(1 - exp(-0.01/X1)) * 4194304" /end FORMULA
/end COMPU_METHOD
/begin CHARACTERISTIC cam1_mag_inc_tau "cam1 mag trig inc tau" VALUE 0x001494E4 /* @ECU_Address@cam1_mag_inc_tau@0x01007570@ */ ECIPP_ALIGNMENT_UWORD 41943 Compu_cam1_mag_inc_tau 0.0006557704 41943.04 /end CHARACTERISTIC
/begin COMPU_METHOD Compu_cam1_mag_inc_tau " " FORM "%.1" "ms"
 /begin FORMULA "-0.01 / log(1 - (X1 / 4194304))" FORMULA_INV "(1 - exp(-0.01/X1)) * 4194304" /end FORMULA
/end COMPU_METHOD
/begin CHARACTERISTIC cam1_mag_dec_tau "cam1 mag trig dec tau" VALUE 0x001494E6 /* @ECU_Address@cam1_mag_dec_tau@0x01007578@ */ ECIPP_ALIGNMENT_UWORD 41943 Compu_cam1_mag_dec_tau 0.0006557704 41943.04 /end CHARACTERISTIC
/begin COMPU_METHOD Compu_cam1_mag_dec_tau " " FORM "%.1" "ms"
 /begin FORMULA "-0.01 / log(1 - (X1 / 4194304))" FORMULA_INV "(1 - exp(-0.01/X1)) * 4194304" /end FORMULA
/end COMPU_METHOD
/begin CHARACTERISTIC cam2_mag_inc_tau "cam2 mag trig inc tau" VALUE 0x001494F0 /* @ECU_Address@cam2_mag_inc_tau@0x01007580@ */ ECIPP_ALIGNMENT_UWORD 41943 Compu_cam2_mag_inc_tau 0.0006557704 41943.04 /end CHARACTERISTIC
/begin COMPU_METHOD Compu_cam2_mag_inc_tau " " FORM "%.1" "ms"
 /begin FORMULA "-0.01 / log(1 - (X1 / 4194304))" FORMULA_INV "(1 - exp(-0.01/X1)) * 4194304" /end FORMULA
/end COMPU_METHOD
/begin CHARACTERISTIC cam2_mag_dec_tau "cam2 mag trig dec tau" VALUE 0x001494F2 /* @ECU_Address@cam2_mag_dec_tau@0x01007588@ */ ECIPP_ALIGNMENT_UWORD 41943 Compu_cam2_mag_dec_tau 0.0006557704 41943.04 /end CHARACTERISTIC
/begin COMPU_METHOD Compu_cam2_mag_dec_tau " " FORM "%.1" "ms"
 /begin FORMULA "-0.01 / log(1 - (X1 / 4194304))" FORMULA_INV "(1 - exp(-0.01/X1)) * 4194304" /end FORMULA
/end COMPU_METHOD
/begin CHARACTERISTIC rs_mag_inc_tau "rs mag trig inc tau" VALUE 0x00149640 /* @ECU_Address@rs_mag_inc_tau@0x01007590@ */ ECIPP_ALIGNMENT_UWORD 41943 Compu_rs_mag_inc_tau 0.0006557704 41943.04 /end CHARACTERISTIC
/begin COMPU_METHOD Compu_rs_mag_inc_tau " " FORM "%.1" "ms"
 /begin FORMULA "-0.01 / log(1 - (X1 / 4194304))" FORMULA_INV "(1 - exp(-0.01/X1)) * 4194304" /end FORMULA
/end COMPU_METHOD
/begin CHARACTERISTIC rs_mag_dec_tau "rs mag trig dec tau" VALUE 0x00149642 /* @ECU_Address@rs_mag_dec_tau@0x01007598@ */ ECIPP_ALIGNMENT_UWORD 41943 Compu_rs_mag_dec_tau 0.0006557704 41943.04 /end CHARACTERISTIC
/begin COMPU_METHOD Compu_rs_mag_dec_tau " " FORM "%.1" "ms"
 /begin FORMULA "-0.01 / log(1 - (X1 / 4194304))" FORMULA_INV "(1 - exp(-0.01/X1)) * 4194304" /end FORMULA
/end COMPU_METHOD
/begin CHARACTERISTIC crank_mag_trig_min "crank mag trig min" VALUE 0x00149602 /* @ECU_Address@crank_mag_trig_min@0x010075A0@ */ ECIPP_ALIGNMENT_UWORD 64 Compu_crank_mag_trig_min 0 63.9990234375 /end CHARACTERISTIC
/begin COMPU_METHOD Compu_crank_mag_trig_min " " RAT_FUNC "%.3" "volts" COEFFS 0 1024 0 0 0 1 /end COMPU_METHOD
/begin CHARACTERISTIC cam1_mag_trig_min "cam1 mag trig min" VALUE 0x001494E2 /* @ECU_Address@cam1_mag_trig_min@0x010075A8@ */ ECIPP_ALIGNMENT_UWORD 64 Compu_cam1_mag_trig_min 0 63.9990234375 /end CHARACTERISTIC
/begin COMPU_METHOD Compu_cam1_mag_trig_min " " RAT_FUNC "%.3" "volts" COEFFS 0 1024 0 0 0 1 /end COMPU_METHOD
/begin CHARACTERISTIC cam2_mag_trig_min "cam2 mag trig min" VALUE 0x001494EE /* @ECU_Address@cam2_mag_trig_min@0x010075B0@ */ ECIPP_ALIGNMENT_UWORD 64 Compu_cam2_mag_trig_min 0 63.9990234375 /end CHARACTERISTIC
/begin COMPU_METHOD Compu_cam2_mag_trig_min " " RAT_FUNC "%.3" "volts" COEFFS 0 1024 0 0 0 1 /end COMPU_METHOD
/begin CHARACTERISTIC rs_mag_trig_min "rs mag trig min" VALUE 0x0014963E /* @ECU_Address@rs_mag_trig_min@0x010075B8@ */ ECIPP_ALIGNMENT_UWORD 64 Compu_rs_mag_trig_min 0 63.9990234375 /end CHARACTERISTIC
/begin COMPU_METHOD Compu_rs_mag_trig_min " " RAT_FUNC "%.3" "volts" COEFFS 0 1024 0 0 0 1 /end COMPU_METHOD
/begin CHARACTERISTIC crank_mag_maxpct "crank mag trig max" VALUE 0x00149608 /* @ECU_Address@crank_mag_maxpct@0x010075C0@ */ ECIPP_ALIGNMENT_UWORD 100 Compu_crank_mag_maxpct 0 99.9984741210938 /end CHARACTERISTIC
/begin COMPU_METHOD Compu_crank_mag_maxpct " " RAT_FUNC "%.1" "%" COEFFS 0 655.36 0 0 0 1 /end COMPU_METHOD
/begin CHARACTERISTIC cam1_mag_maxpct "cam1 mag trig max" VALUE 0x001494E8 /* @ECU_Address@cam1_mag_maxpct@0x010075C8@ */ ECIPP_ALIGNMENT_UWORD 100 Compu_cam1_mag_maxpct 0 99.9984741210938 /end CHARACTERISTIC
/begin COMPU_METHOD Compu_cam1_mag_maxpct " " RAT_FUNC "%.1" "%" COEFFS 0 655.36 0 0 0 1 /end COMPU_METHOD
/begin CHARACTERISTIC cam2_mag_maxpct "cam2 mag trig max" VALUE 0x001494F4 /* @ECU_Address@cam2_mag_maxpct@0x010075D0@ */ ECIPP_ALIGNMENT_UWORD 100 Compu_cam2_mag_maxpct 0 99.9984741210938 /end CHARACTERISTIC
/begin COMPU_METHOD Compu_cam2_mag_maxpct " " RAT_FUNC "%.1" "%" COEFFS 0 655.36 0 0 0 1 /end COMPU_METHOD
/begin CHARACTERISTIC rs_mag_maxpct "rs mag trig max" VALUE 0x00149644 /* @ECU_Address@rs_mag_maxpct@0x010075D8@ */ ECIPP_ALIGNMENT_UWORD 100 Compu_rs_mag_maxpct 0 99.9984741210938 /end CHARACTERISTIC
/begin COMPU_METHOD Compu_rs_mag_maxpct " " RAT_FUNC "%.1" "%" COEFFS 0 655.36 0 0 0 1 /end COMPU_METHOD
/begin CHARACTERISTIC CAD_crankcam_extra "Crank-cam extra/missing/other" VALUE 0x00144254 /* @ECU_Address@CAD_crankcam_extra@0x01007658@ */ ECIPP_ALIGNMENT_SWORD 2048 Compu_CAD_crankcam_extra -2048 2047.9375 /end CHARACTERISTIC
/begin COMPU_METHOD Compu_CAD_crankcam_extra " " RAT_FUNC "%.2" "CAD" COEFFS 0 16 0 0 0 1 /end COMPU_METHOD
/begin MEASUREMENT crank_rise_trigger "crank rising trig level" FLOAT32_IEEE Compu_crank_rise_trigger 0 0 -10000000000 10000000000 ECU_ADDRESS 0x01007660 /end MEASUREMENT
/begin COMPU_METHOD Compu_crank_rise_trigger " " RAT_FUNC "%.3" "volts" COEFFS 0 1 0 0 0 1 /end COMPU_METHOD
/begin MEASUREMENT cam1_rise_trigger "cam1 rising trig level" FLOAT32_IEEE Compu_cam1_rise_trigger 0 0 -10000000000 10000000000 ECU_ADDRESS 0x01007668 /end MEASUREMENT
/begin COMPU_METHOD Compu_cam1_rise_trigger " " RAT_FUNC "%.3" "volts" COEFFS 0 1 0 0 0 1 /end COMPU_METHOD
/begin MEASUREMENT cam2_rise_trigger "cam2 rising trig level" FLOAT32_IEEE Compu_cam2_rise_trigger 0 0 -10000000000 10000000000 ECU_ADDRESS 0x01007670 /end MEASUREMENT
/begin COMPU_METHOD Compu_cam2_rise_trigger " " RAT_FUNC "%.3" "volts" COEFFS 0 1 0 0 0 1 /end COMPU_METHOD
/begin MEASUREMENT rs_rise_trigger "RS rising trig level" FLOAT32_IEEE Compu_rs_rise_trigger 0 0 -10000000000 10000000000 ECU_ADDRESS 0x01007678 /end MEASUREMENT
/begin COMPU_METHOD Compu_rs_rise_trigger " " RAT_FUNC "%.3" "volts" COEFFS 0 1 0 0 0 1 /end COMPU_METHOD
/begin CHARACTERISTIC crank_min_pw "crank min pulse width" VALUE 0x0014960A /* @ECU_Address@crank_min_pw@0x01007D18@ */ ECIPP_ALIGNMENT_UBYTE 6 Compu_crank_min_pw 0 6.375 /end CHARACTERISTIC
/begin COMPU_METHOD Compu_crank_min_pw " " RAT_FUNC "%.1" "us" COEFFS 0 40 0 0 0 1 /end COMPU_METHOD
/begin CHARACTERISTIC cam1_min_pw "cam1 min pulse width" VALUE 0x001494EA /* @ECU_Address@cam1_min_pw@0x01007D20@ */ ECIPP_ALIGNMENT_UBYTE 6 Compu_cam1_min_pw 0 6.375 /end CHARACTERISTIC
/begin COMPU_METHOD Compu_cam1_min_pw " " RAT_FUNC "%.1" "us" COEFFS 0 40 0 0 0 1 /end COMPU_METHOD
/begin CHARACTERISTIC cam2_min_pw "cam2 min pulse width" VALUE 0x001494F6 /* @ECU_Address@cam2_min_pw@0x01007D28@ */ ECIPP_ALIGNMENT_UBYTE 6 Compu_cam2_min_pw 0 6.375 /end CHARACTERISTIC
/begin COMPU_METHOD Compu_cam2_min_pw " " RAT_FUNC "%.1" "us" COEFFS 0 40 0 0 0 1 /end COMPU_METHOD
/begin CHARACTERISTIC rs_min_pw "rs min pulse width" VALUE 0x00149646 /* @ECU_Address@rs_min_pw@0x01007D30@ */ ECIPP_ALIGNMENT_UBYTE 6 Compu_rs_min_pw 0 6.375 /end CHARACTERISTIC
/begin COMPU_METHOD Compu_rs_min_pw " " RAT_FUNC "%.1" "us" COEFFS 0 40 0 0 0 1 /end COMPU_METHOD
/begin CHARACTERISTIC TIP_est_ena "TIP pressure estimate{TIP_est_ena&0xff=0:TIP = BP}{TIP_est_ena&0xff=1:TIP = MAP}{TIP_est_ena&0xff=2:Intake flow rate estimate}{TIP_est_ena&0xff=3:Throttle model estimate}" VALUE 0x0014809d /* @ECU_Address@TIP_est_ena@0x01008AF0@ */ ECIPP_ALIGNMENT_UBYTE 255 TIP_est_ena_COMPU_VTAB 0 255 BIT_MASK 0xff /end CHARACTERISTIC
/begin COMPU_METHOD TIP_est_ena_COMPU_VTAB "Verbal Table" TAB_VERB "%.0" "list" COMPU_TAB_REF TIP_est_ena_COMPU_VTAB_REF /end COMPU_METHOD
/begin COMPU_VTAB TIP_est_ena_COMPU_VTAB_REF "Verbal Table" TAB_VERB 4 0 "TIP = BP" 1 "TIP = MAP" 2 "Intake flow rate estimate" 3 "Throttle model estimate" DEFAULT_VALUE "UNKNOWN" /end COMPU_VTAB
/begin CHARACTERISTIC TIP_gauge_def "TIP default gage pressure" VALUE 0x001478a0 /* @ECU_Address@TIP_gauge_def@0x01008AF8@ */ ECIPP_ALIGNMENT_UWORD 256 Compu_TIP_gauge_def 0 255.99609375 /end CHARACTERISTIC
/begin COMPU_METHOD Compu_TIP_gauge_def " " RAT_FUNC "%.2" "psig" COEFFS 0 256 0 0 0 1 /end COMPU_METHOD
/begin CHARACTERISTIC TIP_C_int "TIP flow rate constant" VALUE 0x00147898 /* @ECU_Address@TIP_C_int@0x01008B00@ */ ECIPP_ALIGNMENT_UWORD 31 Compu_TIP_C_int 0 30.5171124637127 /end CHARACTERISTIC
/begin COMPU_METHOD Compu_TIP_C_int " " RAT_FUNC "%.3" "upsig / (l/s)^2" COEFFS 0 2147.483648 0 0 0 1 /end COMPU_METHOD
/begin MEASUREMENT RS_odom_total "Odometer" ULONG Compu_RS_odom_total 0 0 0 536870911.875 ECU_ADDRESS 0x01009258 /end MEASUREMENT
/begin COMPU_METHOD Compu_RS_odom_total " " RAT_FUNC "%.1" "km" COEFFS 0 8 0 0 0 1 /end COMPU_METHOD
/begin CHARACTERISTIC engine_stall_manual "engine stall speed manual" VALUE 0x00147af0 /* @ECU_Address@engine_stall_manual@0x0100B8B8@ */ ECIPP_ALIGNMENT_UWORD 65535 Compu_engine_stall_manual 0 65535 /end CHARACTERISTIC
/begin COMPU_METHOD Compu_engine_stall_manual " " RAT_FUNC "%.0" "rpm" COEFFS 0 1 0 0 0 1 /end COMPU_METHOD
/begin CHARACTERISTIC RS_input_redirect "roadspeed input redirect{RS_input_redirect&0xff=0:Normal - no redirect}{RS_input_redirect&0xff=1:Redirect to Cam1}{RS_input_redirect&0xff=2:Redirect to Cam2}" VALUE 0x00147f0d /* @ECU_Address@RS_input_redirect@0x0100BCB8@ */ ECIPP_ALIGNMENT_UBYTE 255 RS_input_redirect_COMPU_VTAB 0 255 BIT_MASK 0xff /end CHARACTERISTIC
/begin COMPU_METHOD RS_input_redirect_COMPU_VTAB "Verbal Table" TAB_VERB "%.0" "list" COMPU_TAB_REF RS_input_redirect_COMPU_VTAB_REF /end COMPU_METHOD
/begin COMPU_VTAB RS_input_redirect_COMPU_VTAB_REF "Verbal Table" TAB_VERB 3 0 "Normal - no redirect" 1 "Redirect to Cam1" 2 "Redirect to Cam2" DEFAULT_VALUE "UNKNOWN" /end COMPU_VTAB
/begin CHARACTERISTIC PPEG_EBP_enable "Pressure offset pegging{PPEG_EBP_enable&0xff=0:Disabled}{PPEG_EBP_enable&0xff=1:Ref = BP}{PPEG_EBP_enable&0xff=2:Ref = MAP}" VALUE 0x0014914E /* @ECU_Address@PPEG_EBP_enable@0x0100C8B0@ */ ECIPP_ALIGNMENT_UBYTE 255 PPEG_EBP_enable_COMPU_VTAB 0 255 BIT_MASK 0xff /end CHARACTERISTIC
/begin COMPU_METHOD PPEG_EBP_enable_COMPU_VTAB "Verbal Table" TAB_VERB "%.0" "list" COMPU_TAB_REF PPEG_EBP_enable_COMPU_VTAB_REF /end COMPU_METHOD
/begin COMPU_VTAB PPEG_EBP_enable_COMPU_VTAB_REF "Verbal Table" TAB_VERB 3 0 "Disabled" 1 "Ref = BP" 2 "Ref = MAP" DEFAULT_VALUE "UNKNOWN" /end COMPU_VTAB
/begin CHARACTERISTIC PPEG_EBP_keyon_wt "Key-on wait" VALUE 0x00149150 /* @ECU_Address@PPEG_EBP_keyon_wt@0x0100C8B8@ */ ECIPP_ALIGNMENT_UWORD 65535 Compu_PPEG_EBP_keyon_wt 0 65535 /end CHARACTERISTIC
/begin COMPU_METHOD Compu_PPEG_EBP_keyon_wt " " RAT_FUNC "%.0" "ms" COEFFS 0 1 0 0 0 1 /end COMPU_METHOD
/begin CHARACTERISTIC PPEG_EBP_valid_wt "Invalid pressure wait" VALUE 0x00149156 /* @ECU_Address@PPEG_EBP_valid_wt@0x0100C8C0@ */ ECIPP_ALIGNMENT_UWORD 65535 Compu_PPEG_EBP_valid_wt 0 65535 /end CHARACTERISTIC
/begin COMPU_METHOD Compu_PPEG_EBP_valid_wt " " RAT_FUNC "%.0" "ms" COEFFS 0 1 0 0 0 1 /end COMPU_METHOD
/begin CHARACTERISTIC PPEG_EBP_start_wt "Start inhibit period" VALUE 0x00149158 /* @ECU_Address@PPEG_EBP_start_wt@0x0100C8C8@ */ ECIPP_ALIGNMENT_UWORD 65535 Compu_PPEG_EBP_start_wt 0 65535 /end CHARACTERISTIC
/begin COMPU_METHOD Compu_PPEG_EBP_start_wt " " RAT_FUNC "%.0" "ms" COEFFS 0 1 0 0 0 1 /end COMPU_METHOD
/begin CHARACTERISTIC PPEG_EBP_tau "Offset low-pass tau" VALUE 0x0014915A /* @ECU_Address@PPEG_EBP_tau@0x0100C8D0@ */ ECIPP_ALIGNMENT_UWORD 163840 Compu_PPEG_EBP_tau 0.16703 163840 /end CHARACTERISTIC
/begin COMPU_METHOD Compu_PPEG_EBP_tau " " FORM "%.0" "ms"
 /begin FORMULA "-5 / log(1.0000000000001 - (X1 / 32768))" FORMULA_INV "(1.0000000000001 - exp(-5/X1)) * 32768" /end FORMULA
/end COMPU_METHOD
/begin CHARACTERISTIC PPEG_EBP_mdot_max "Max total port flow" VALUE 0x0014915C /* @ECU_Address@PPEG_EBP_mdot_max@0x0100C8D8@ */ ECIPP_ALIGNMENT_UWORD 1024 Compu_PPEG_EBP_mdot_max 0 1023.984375 /end CHARACTERISTIC
/begin COMPU_METHOD Compu_PPEG_EBP_mdot_max " " RAT_FUNC "%.1" "g/sec" COEFFS 0 64 0 0 0 1 /end COMPU_METHOD
/begin CHARACTERISTIC PPEG_EBP_Nmax "Max engine speed" VALUE 0x0014915E /* @ECU_Address@PPEG_EBP_Nmax@0x0100C8E0@ */ ECIPP_ALIGNMENT_UWORD 65535 Compu_PPEG_EBP_Nmax 0 65535 /end CHARACTERISTIC
/begin COMPU_METHOD Compu_PPEG_EBP_Nmax " " RAT_FUNC "%.0" "rpm" COEFFS 0 1 0 0 0 1 /end COMPU_METHOD
/begin CHARACTERISTIC PPEG_EBP_EEstore "Behavior at power on{PPEG_EBP_EEstore&0xff=0:Zero}{PPEG_EBP_EEstore&0xff=1:Restore}" VALUE 0x00149160 /* @ECU_Address@PPEG_EBP_EEstore@0x0100C8E8@ */ ECIPP_ALIGNMENT_UBYTE 255 PPEG_EBP_EEstore_COMPU_VTAB 0 255 BIT_MASK 0xff /end CHARACTERISTIC
/begin COMPU_METHOD PPEG_EBP_EEstore_COMPU_VTAB "Verbal Table" TAB_VERB "%.0" "list" COMPU_TAB_REF PPEG_EBP_EEstore_COMPU_VTAB_REF /end COMPU_METHOD
/begin COMPU_VTAB PPEG_EBP_EEstore_COMPU_VTAB_REF "Verbal Table" TAB_VERB 2 0 "Zero" 1 "Restore" DEFAULT_VALUE "UNKNOWN" /end COMPU_VTAB
/begin CHARACTERISTIC PPEG_EBP_Pref_min "Reference pressure min" VALUE 0x00149162 /* @ECU_Address@PPEG_EBP_Pref_min@0x0100C8F0@ */ ECIPP_ALIGNMENT_UWORD 256 Compu_PPEG_EBP_Pref_min 0 255.99609375 /end CHARACTERISTIC
/begin COMPU_METHOD Compu_PPEG_EBP_Pref_min " " RAT_FUNC "%.2" "psia" COEFFS 0 256 0 0 0 1 /end COMPU_METHOD
/begin CHARACTERISTIC PPEG_EBP_Pref_max "Reference pressure max" VALUE 0x00149164 /* @ECU_Address@PPEG_EBP_Pref_max@0x0100C8F8@ */ ECIPP_ALIGNMENT_UWORD 256 Compu_PPEG_EBP_Pref_max 0 255.99609375 /end CHARACTERISTIC
/begin COMPU_METHOD Compu_PPEG_EBP_Pref_max " " RAT_FUNC "%.2" "psia" COEFFS 0 256 0 0 0 1 /end COMPU_METHOD
/begin CHARACTERISTIC PPEG_EBP_ofst_max "Max allowed offset" VALUE 0x00149166 /* @ECU_Address@PPEG_EBP_ofst_max@0x0100C900@ */ ECIPP_ALIGNMENT_SWORD 128 Compu_PPEG_EBP_ofst_max -128 127.99609375 /end CHARACTERISTIC
/begin COMPU_METHOD Compu_PPEG_EBP_ofst_max " " RAT_FUNC "%.2" "psi" COEFFS 0 256 0 0 0 1 /end COMPU_METHOD
/begin MEASUREMENT PPEG_EBP_offset "Pressure offset" SWORD Compu_PPEG_EBP_offset 0 0 -128 127.99609375 ECU_ADDRESS 0x0100C908 /end MEASUREMENT
/begin COMPU_METHOD Compu_PPEG_EBP_offset " " RAT_FUNC "%.2" "psi" COEFFS 0 256 0 0 0 1 /end COMPU_METHOD
/begin CHARACTERISTIC PPEG_TIP_enable "TIP peg offset{PPEG_TIP_enable&0xff=0:Disabled}{PPEG_TIP_enable&0xff=1:Ref = BP}{PPEG_TIP_enable&0xff=2:Ref = MAP}" VALUE 0x001491B6 /* @ECU_Address@PPEG_TIP_enable@0x0100C910@ */ ECIPP_ALIGNMENT_UBYTE 255 PPEG_TIP_enable_COMPU_VTAB 0 255 BIT_MASK 0xff /end CHARACTERISTIC
/begin COMPU_METHOD PPEG_TIP_enable_COMPU_VTAB "Verbal Table" TAB_VERB "%.0" "list" COMPU_TAB_REF PPEG_TIP_enable_COMPU_VTAB_REF /end COMPU_METHOD
/begin COMPU_VTAB PPEG_TIP_enable_COMPU_VTAB_REF "Verbal Table" TAB_VERB 3 0 "Disabled" 1 "Ref = BP" 2 "Ref = MAP" DEFAULT_VALUE "UNKNOWN" /end COMPU_VTAB
/begin CHARACTERISTIC PPEG_TIP_keyon_wt "TIP peg key-on wait" VALUE 0x001491B8 /* @ECU_Address@PPEG_TIP_keyon_wt@0x0100C918@ */ ECIPP_ALIGNMENT_UWORD 65535 Compu_PPEG_TIP_keyon_wt 0 65535 /end CHARACTERISTIC
/begin COMPU_METHOD Compu_PPEG_TIP_keyon_wt " " RAT_FUNC "%.0" "ms" COEFFS 0 1 0 0 0 1 /end COMPU_METHOD
/begin CHARACTERISTIC PPEG_TIP_valid_wt "TIP peg invalid reset" VALUE 0x001491BE /* @ECU_Address@PPEG_TIP_valid_wt@0x0100C920@ */ ECIPP_ALIGNMENT_UWORD 65535 Compu_PPEG_TIP_valid_wt 0 65535 /end CHARACTERISTIC
/begin COMPU_METHOD Compu_PPEG_TIP_valid_wt " " RAT_FUNC "%.0" "ms" COEFFS 0 1 0 0 0 1 /end COMPU_METHOD
/begin CHARACTERISTIC PPEG_TIP_start_wt "TIP peg start inhibit" VALUE 0x001491C0 /* @ECU_Address@PPEG_TIP_start_wt@0x0100C928@ */ ECIPP_ALIGNMENT_UWORD 65535 Compu_PPEG_TIP_start_wt 0 65535 /end CHARACTERISTIC
/begin COMPU_METHOD Compu_PPEG_TIP_start_wt " " RAT_FUNC "%.0" "ms" COEFFS 0 1 0 0 0 1 /end COMPU_METHOD
/begin CHARACTERISTIC PPEG_TIP_tau "TIP peg low-pass" VALUE 0x001491C2 /* @ECU_Address@PPEG_TIP_tau@0x0100C930@ */ ECIPP_ALIGNMENT_UWORD 163840 Compu_PPEG_TIP_tau 0.16703 163840 /end CHARACTERISTIC
/begin COMPU_METHOD Compu_PPEG_TIP_tau " " FORM "%.0" "ms"
 /begin FORMULA "-5 / log(1.0000000000001 - (X1 / 32768))" FORMULA_INV "(1.0000000000001 - exp(-5/X1)) * 32768" /end FORMULA
/end COMPU_METHOD
/begin CHARACTERISTIC PPEG_TIP_mdot_max "TIP peg max port flow" VALUE 0x001491C4 /* @ECU_Address@PPEG_TIP_mdot_max@0x0100C938@ */ ECIPP_ALIGNMENT_UWORD 1024 Compu_PPEG_TIP_mdot_max 0 1023.984375 /end CHARACTERISTIC
/begin COMPU_METHOD Compu_PPEG_TIP_mdot_max " " RAT_FUNC "%.1" "g/sec" COEFFS 0 64 0 0 0 1 /end COMPU_METHOD
/begin CHARACTERISTIC PPEG_TIP_Nmax "TIP peg engine speed" VALUE 0x001491C6 /* @ECU_Address@PPEG_TIP_Nmax@0x0100C940@ */ ECIPP_ALIGNMENT_UWORD 65535 Compu_PPEG_TIP_Nmax 0 65535 /end CHARACTERISTIC
/begin COMPU_METHOD Compu_PPEG_TIP_Nmax " " RAT_FUNC "%.0" "rpm" COEFFS 0 1 0 0 0 1 /end COMPU_METHOD
/begin CHARACTERISTIC PPEG_TIP_EEstore "TIP peg EE restore{PPEG_TIP_EEstore&0xff=0:Zero}{PPEG_TIP_EEstore&0xff=1:Restore}" VALUE 0x001491C8 /* @ECU_Address@PPEG_TIP_EEstore@0x0100C948@ */ ECIPP_ALIGNMENT_UBYTE 255 PPEG_TIP_EEstore_COMPU_VTAB 0 255 BIT_MASK 0xff /end CHARACTERISTIC
/begin COMPU_METHOD PPEG_TIP_EEstore_COMPU_VTAB "Verbal Table" TAB_VERB "%.0" "list" COMPU_TAB_REF PPEG_TIP_EEstore_COMPU_VTAB_REF /end COMPU_METHOD
/begin COMPU_VTAB PPEG_TIP_EEstore_COMPU_VTAB_REF "Verbal Table" TAB_VERB 2 0 "Zero" 1 "Restore" DEFAULT_VALUE "UNKNOWN" /end COMPU_VTAB
/begin CHARACTERISTIC PPEG_TIP_Pref_min "TIP peg ref P min" VALUE 0x001491CA /* @ECU_Address@PPEG_TIP_Pref_min@0x0100C950@ */ ECIPP_ALIGNMENT_UWORD 256 Compu_PPEG_TIP_Pref_min 0 255.99609375 /end CHARACTERISTIC
/begin COMPU_METHOD Compu_PPEG_TIP_Pref_min " " RAT_FUNC "%.2" "psia" COEFFS 0 256 0 0 0 1 /end COMPU_METHOD
/begin CHARACTERISTIC PPEG_TIP_Pref_max "TIP peg ref P max" VALUE 0x001491CC /* @ECU_Address@PPEG_TIP_Pref_max@0x0100C958@ */ ECIPP_ALIGNMENT_UWORD 256 Compu_PPEG_TIP_Pref_max 0 255.99609375 /end CHARACTERISTIC
/begin COMPU_METHOD Compu_PPEG_TIP_Pref_max " " RAT_FUNC "%.2" "psia" COEFFS 0 256 0 0 0 1 /end COMPU_METHOD
/begin CHARACTERISTIC PPEG_TIP_ofst_max "TIP peg max offset" VALUE 0x001491CE /* @ECU_Address@PPEG_TIP_ofst_max@0x0100C960@ */ ECIPP_ALIGNMENT_SWORD 128 Compu_PPEG_TIP_ofst_max -128 127.99609375 /end CHARACTERISTIC
/begin COMPU_METHOD Compu_PPEG_TIP_ofst_max " " RAT_FUNC "%.2" "psi" COEFFS 0 256 0 0 0 1 /end COMPU_METHOD
/begin MEASUREMENT PPEG_TIP_offset "TIP peg offset" SWORD Compu_PPEG_TIP_offset 0 0 -128 127.99609375 ECU_ADDRESS 0x0100C968 /end MEASUREMENT
/begin COMPU_METHOD Compu_PPEG_TIP_offset " " RAT_FUNC "%.2" "psi" COEFFS 0 256 0 0 0 1 /end COMPU_METHOD
/begin CHARACTERISTIC PPEG_EGRHP_enable "EGRHP peg offset{PPEG_EGRHP_enable&0xff=0:Disabled}{PPEG_EGRHP_enable&0xff=1:Ref = BP}{PPEG_EGRHP_enable&0xff=2:Ref = MAP}" VALUE 0x00149168 /* @ECU_Address@PPEG_EGRHP_enable@0x0100C970@ */ ECIPP_ALIGNMENT_UBYTE 255 PPEG_EGRHP_enable_COMPU_VTAB 0 255 BIT_MASK 0xff /end CHARACTERISTIC
/begin COMPU_METHOD PPEG_EGRHP_enable_COMPU_VTAB "Verbal Table" TAB_VERB "%.0" "list" COMPU_TAB_REF PPEG_EGRHP_enable_COMPU_VTAB_REF /end COMPU_METHOD
/begin COMPU_VTAB PPEG_EGRHP_enable_COMPU_VTAB_REF "Verbal Table" TAB_VERB 3 0 "Disabled" 1 "Ref = BP" 2 "Ref = MAP" DEFAULT_VALUE "UNKNOWN" /end COMPU_VTAB
/begin CHARACTERISTIC PPEG_EGRHP_keyon_wt "EGRHP peg key-on wait" VALUE 0x0014916A /* @ECU_Address@PPEG_EGRHP_keyon_wt@0x0100C978@ */ ECIPP_ALIGNMENT_UWORD 65535 Compu_PPEG_EGRHP_keyon_wt 0 65535 /end CHARACTERISTIC
/begin COMPU_METHOD Compu_PPEG_EGRHP_keyon_wt " " RAT_FUNC "%.0" "ms" COEFFS 0 1 0 0 0 1 /end COMPU_METHOD
/begin CHARACTERISTIC PPEG_EGRHP_valid_wt "EGRHP peg invalid reset" VALUE 0x00149170 /* @ECU_Address@PPEG_EGRHP_valid_wt@0x0100C980@ */ ECIPP_ALIGNMENT_UWORD 65535 Compu_PPEG_EGRHP_valid_wt 0 65535 /end CHARACTERISTIC
/begin COMPU_METHOD Compu_PPEG_EGRHP_valid_wt " " RAT_FUNC "%.0" "ms" COEFFS 0 1 0 0 0 1 /end COMPU_METHOD
/begin CHARACTERISTIC PPEG_EGRHP_start_wt "EGRHP peg start inhibit" VALUE 0x00149172 /* @ECU_Address@PPEG_EGRHP_start_wt@0x0100C988@ */ ECIPP_ALIGNMENT_UWORD 65535 Compu_PPEG_EGRHP_start_wt 0 65535 /end CHARACTERISTIC
/begin COMPU_METHOD Compu_PPEG_EGRHP_start_wt " " RAT_FUNC "%.0" "ms" COEFFS 0 1 0 0 0 1 /end COMPU_METHOD
/begin CHARACTERISTIC PPEG_EGRHP_tau "EGRHP peg low-pass" VALUE 0x00149174 /* @ECU_Address@PPEG_EGRHP_tau@0x0100C990@ */ ECIPP_ALIGNMENT_UWORD 163840 Compu_PPEG_EGRHP_tau 0.16703 163840 /end CHARACTERISTIC
/begin COMPU_METHOD Compu_PPEG_EGRHP_tau " " FORM "%.0" "ms"
 /begin FORMULA "-5 / log(1.0000000000001 - (X1 / 32768))" FORMULA_INV "(1.0000000000001 - exp(-5/X1)) * 32768" /end FORMULA
/end COMPU_METHOD
/begin CHARACTERISTIC PPEG_EGRHP_mdot_max "EGRHP peg max port flow" VALUE 0x00149176 /* @ECU_Address@PPEG_EGRHP_mdot_max@0x0100C998@ */ ECIPP_ALIGNMENT_UWORD 1024 Compu_PPEG_EGRHP_mdot_max 0 1023.984375 /end CHARACTERISTIC
/begin COMPU_METHOD Compu_PPEG_EGRHP_mdot_max " " RAT_FUNC "%.1" "g/sec" COEFFS 0 64 0 0 0 1 /end COMPU_METHOD
/begin CHARACTERISTIC PPEG_EGRHP_Nmax "EGRHP peg engine speed" VALUE 0x00149178 /* @ECU_Address@PPEG_EGRHP_Nmax@0x0100C9A0@ */ ECIPP_ALIGNMENT_UWORD 65535 Compu_PPEG_EGRHP_Nmax 0 65535 /end CHARACTERISTIC
/begin COMPU_METHOD Compu_PPEG_EGRHP_Nmax " " RAT_FUNC "%.0" "rpm" COEFFS 0 1 0 0 0 1 /end COMPU_METHOD
/begin CHARACTERISTIC PPEG_EGRHP_EEstore "EGRHP peg EE restore{PPEG_EGRHP_EEstore&0xff=0:Zero}{PPEG_EGRHP_EEstore&0xff=1:Restore}" VALUE 0x0014917A /* @ECU_Address@PPEG_EGRHP_EEstore@0x0100C9A8@ */ ECIPP_ALIGNMENT_UBYTE 255 PPEG_EGRHP_EEstore_COMPU_VTAB 0 255 BIT_MASK 0xff /end CHARACTERISTIC
/begin COMPU_METHOD PPEG_EGRHP_EEstore_COMPU_VTAB "Verbal Table" TAB_VERB "%.0" "list" COMPU_TAB_REF PPEG_EGRHP_EEstore_COMPU_VTAB_REF /end COMPU_METHOD
/begin COMPU_VTAB PPEG_EGRHP_EEstore_COMPU_VTAB_REF "Verbal Table" TAB_VERB 2 0 "Zero" 1 "Restore" DEFAULT_VALUE "UNKNOWN" /end COMPU_VTAB
/begin CHARACTERISTIC PPEG_EGRHP_Pref_min "EGRHP peg ref P min" VALUE 0x0014917C /* @ECU_Address@PPEG_EGRHP_Pref_min@0x0100C9B0@ */ ECIPP_ALIGNMENT_UWORD 256 Compu_PPEG_EGRHP_Pref_min 0 255.99609375 /end CHARACTERISTIC
/begin COMPU_METHOD Compu_PPEG_EGRHP_Pref_min " " RAT_FUNC "%.2" "psia" COEFFS 0 256 0 0 0 1 /end COMPU_METHOD
/begin CHARACTERISTIC PPEG_EGRHP_Pref_max "EGRHP peg ref P max" VALUE 0x0014917E /* @ECU_Address@PPEG_EGRHP_Pref_max@0x0100C9B8@ */ ECIPP_ALIGNMENT_UWORD 256 Compu_PPEG_EGRHP_Pref_max 0 255.99609375 /end CHARACTERISTIC
/begin COMPU_METHOD Compu_PPEG_EGRHP_Pref_max " " RAT_FUNC "%.2" "psia" COEFFS 0 256 0 0 0 1 /end COMPU_METHOD
/begin CHARACTERISTIC PPEG_EGRHP_ofst_max "EGRHP peg max offset" VALUE 0x00149180 /* @ECU_Address@PPEG_EGRHP_ofst_max@0x0100C9C0@ */ ECIPP_ALIGNMENT_SWORD 128 Compu_PPEG_EGRHP_ofst_max -128 127.99609375 /end CHARACTERISTIC
/begin COMPU_METHOD Compu_PPEG_EGRHP_ofst_max " " RAT_FUNC "%.2" "psi" COEFFS 0 256 0 0 0 1 /end COMPU_METHOD
/begin MEASUREMENT PPEG_EGRHP_offset "EGRHP peg offset" SWORD Compu_PPEG_EGRHP_offset 0 0 -128 127.99609375 ECU_ADDRESS 0x0100C9C8 /end MEASUREMENT
/begin COMPU_METHOD Compu_PPEG_EGRHP_offset " " RAT_FUNC "%.2" "psi" COEFFS 0 256 0 0 0 1 /end COMPU_METHOD
/begin CHARACTERISTIC PPEG_BP_enable "BP peg offset{PPEG_BP_enable&0xff=0:Disabled}{PPEG_BP_enable&0xff=1:Ref = BP}{PPEG_BP_enable&0xff=2:Ref = MAP}" VALUE 0x00149100 /* @ECU_Address@PPEG_BP_enable@0x0100C9D0@ */ ECIPP_ALIGNMENT_UBYTE 255 PPEG_BP_enable_COMPU_VTAB 0 255 BIT_MASK 0xff /end CHARACTERISTIC
/begin COMPU_METHOD PPEG_BP_enable_COMPU_VTAB "Verbal Table" TAB_VERB "%.0" "list" COMPU_TAB_REF PPEG_BP_enable_COMPU_VTAB_REF /end COMPU_METHOD
/begin COMPU_VTAB PPEG_BP_enable_COMPU_VTAB_REF "Verbal Table" TAB_VERB 3 0 "Disabled" 1 "Ref = BP" 2 "Ref = MAP" DEFAULT_VALUE "UNKNOWN" /end COMPU_VTAB
/begin CHARACTERISTIC PPEG_BP_keyon_wt "BP peg key-on wait" VALUE 0x00149102 /* @ECU_Address@PPEG_BP_keyon_wt@0x0100C9D8@ */ ECIPP_ALIGNMENT_UWORD 65535 Compu_PPEG_BP_keyon_wt 0 65535 /end CHARACTERISTIC
/begin COMPU_METHOD Compu_PPEG_BP_keyon_wt " " RAT_FUNC "%.0" "ms" COEFFS 0 1 0 0 0 1 /end COMPU_METHOD
/begin CHARACTERISTIC PPEG_BP_valid_wt "BP peg invalid reset" VALUE 0x00149108 /* @ECU_Address@PPEG_BP_valid_wt@0x0100C9E0@ */ ECIPP_ALIGNMENT_UWORD 65535 Compu_PPEG_BP_valid_wt 0 65535 /end CHARACTERISTIC
/begin COMPU_METHOD Compu_PPEG_BP_valid_wt " " RAT_FUNC "%.0" "ms" COEFFS 0 1 0 0 0 1 /end COMPU_METHOD
/begin CHARACTERISTIC PPEG_BP_start_wt "BP peg start inhibit" VALUE 0x0014910A /* @ECU_Address@PPEG_BP_start_wt@0x0100C9E8@ */ ECIPP_ALIGNMENT_UWORD 65535 Compu_PPEG_BP_start_wt 0 65535 /end CHARACTERISTIC
/begin COMPU_METHOD Compu_PPEG_BP_start_wt " " RAT_FUNC "%.0" "ms" COEFFS 0 1 0 0 0 1 /end COMPU_METHOD
/begin CHARACTERISTIC PPEG_BP_tau "BP peg low-pass" VALUE 0x0014910C /* @ECU_Address@PPEG_BP_tau@0x0100C9F0@ */ ECIPP_ALIGNMENT_UWORD 163840 Compu_PPEG_BP_tau 0.16703 163840 /end CHARACTERISTIC
/begin COMPU_METHOD Compu_PPEG_BP_tau " " FORM "%.0" "ms"
 /begin FORMULA "-5 / log(1.0000000000001 - (X1 / 32768))" FORMULA_INV "(1.0000000000001 - exp(-5/X1)) * 32768" /end FORMULA
/end COMPU_METHOD
/begin CHARACTERISTIC PPEG_BP_mdot_max "BP peg max port flow" VALUE 0x0014910E /* @ECU_Address@PPEG_BP_mdot_max@0x0100C9F8@ */ ECIPP_ALIGNMENT_UWORD 1024 Compu_PPEG_BP_mdot_max 0 1023.984375 /end CHARACTERISTIC
/begin COMPU_METHOD Compu_PPEG_BP_mdot_max " " RAT_FUNC "%.1" "g/sec" COEFFS 0 64 0 0 0 1 /end COMPU_METHOD
/begin CHARACTERISTIC PPEG_BP_Nmax "BP peg engine speed" VALUE 0x00149110 /* @ECU_Address@PPEG_BP_Nmax@0x0100CA00@ */ ECIPP_ALIGNMENT_UWORD 65535 Compu_PPEG_BP_Nmax 0 65535 /end CHARACTERISTIC
/begin COMPU_METHOD Compu_PPEG_BP_Nmax " " RAT_FUNC "%.0" "rpm" COEFFS 0 1 0 0 0 1 /end COMPU_METHOD
/begin CHARACTERISTIC PPEG_BP_EEstore "BP peg EE restore{PPEG_BP_EEstore&0xff=0:Zero}{PPEG_BP_EEstore&0xff=1:Restore}" VALUE 0x00149112 /* @ECU_Address@PPEG_BP_EEstore@0x0100CA08@ */ ECIPP_ALIGNMENT_UBYTE 255 PPEG_BP_EEstore_COMPU_VTAB 0 255 BIT_MASK 0xff /end CHARACTERISTIC
/begin COMPU_METHOD PPEG_BP_EEstore_COMPU_VTAB "Verbal Table" TAB_VERB "%.0" "list" COMPU_TAB_REF PPEG_BP_EEstore_COMPU_VTAB_REF /end COMPU_METHOD
/begin COMPU_VTAB PPEG_BP_EEstore_COMPU_VTAB_REF "Verbal Table" TAB_VERB 2 0 "Zero" 1 "Restore" DEFAULT_VALUE "UNKNOWN" /end COMPU_VTAB
/begin CHARACTERISTIC PPEG_BP_Pref_min "BP peg ref P min" VALUE 0x00149114 /* @ECU_Address@PPEG_BP_Pref_min@0x0100CA10@ */ ECIPP_ALIGNMENT_UWORD 256 Compu_PPEG_BP_Pref_min 0 255.99609375 /end CHARACTERISTIC
/begin COMPU_METHOD Compu_PPEG_BP_Pref_min " " RAT_FUNC "%.2" "psia" COEFFS 0 256 0 0 0 1 /end COMPU_METHOD
/begin CHARACTERISTIC PPEG_BP_Pref_max "BP peg ref P max" VALUE 0x00149116 /* @ECU_Address@PPEG_BP_Pref_max@0x0100CA18@ */ ECIPP_ALIGNMENT_UWORD 256 Compu_PPEG_BP_Pref_max 0 255.99609375 /end CHARACTERISTIC
/begin COMPU_METHOD Compu_PPEG_BP_Pref_max " " RAT_FUNC "%.2" "psia" COEFFS 0 256 0 0 0 1 /end COMPU_METHOD
/begin CHARACTERISTIC PPEG_BP_ofst_max "BP peg max offset" VALUE 0x00149118 /* @ECU_Address@PPEG_BP_ofst_max@0x0100CA20@ */ ECIPP_ALIGNMENT_SWORD 128 Compu_PPEG_BP_ofst_max -128 127.99609375 /end CHARACTERISTIC
/begin COMPU_METHOD Compu_PPEG_BP_ofst_max " " RAT_FUNC "%.2" "psi" COEFFS 0 256 0 0 0 1 /end COMPU_METHOD
/begin MEASUREMENT PPEG_BP_offset "BP peg offset" SWORD Compu_PPEG_BP_offset 0 0 -128 127.99609375 ECU_ADDRESS 0x0100CA28 /end MEASUREMENT
/begin COMPU_METHOD Compu_PPEG_BP_offset " " RAT_FUNC "%.2" "psi" COEFFS 0 256 0 0 0 1 /end COMPU_METHOD
/begin MEASUREMENT PPEG_EBP_state "Pressure pegging status{PPEG_EBP_state&0xff=0:Inactive}{PPEG_EBP_state&0xff=1:Key-on wait}{PPEG_EBP_state&0xff=2:Sampling}{PPEG_EBP_state&0xff=3:Ref P high}{PPEG_EBP_state&0xff=4:Ref P low}{PPEG_EBP_state&0xff=5:Flow high}{PPEG_EBP_state&0xff=6:RPM high}{" UBYTE PPEG_EBP_state_COMPU_VTAB 0 0 0 255 ECU_ADDRESS 0x0100CA30 BIT_MASK 0xff /end MEASUREMENT
/begin COMPU_METHOD PPEG_EBP_state_COMPU_VTAB "Verbal Table" TAB_VERB "%.0" "list" COMPU_TAB_REF PPEG_EBP_state_COMPU_VTAB_REF /end COMPU_METHOD
/begin COMPU_VTAB PPEG_EBP_state_COMPU_VTAB_REF "Verbal Table" TAB_VERB 20 0 "Inactive" 1 "Key-on wait" 2 "Sampling" 3 "Ref P high" 4 "Ref P low" 5 "Flow high" 6 "RPM high" 7 "Key cycle wait - start" 8 "Time elapsed" 9 "Invalid" 10 "Reserved - 10" 11 "Reserved - 11" 12 "Reserved - 12" 13 "Reserved - 13" 14 "Reserved - 14" 15 "Key cycle wait - end" 16 "ECT Low" 17 "Key-off clear" 18 "EGR de-icing" 19 "Possibly frozen" DEFAULT_VALUE "UNKNOWN" /end COMPU_VTAB
/begin MEASUREMENT PPEG_TIP_state "TIP pegging status{PPEG_TIP_state&0xff=0:Inactive}{PPEG_TIP_state&0xff=1:Key-on wait}{PPEG_TIP_state&0xff=2:Sampling}{PPEG_TIP_state&0xff=3:Ref P high}{PPEG_TIP_state&0xff=4:Ref P low}{PPEG_TIP_state&0xff=5:Flow high}{PPEG_TIP_state&0xff=6:RPM high}{PPEG_" UBYTE PPEG_TIP_state_COMPU_VTAB 0 0 0 255 ECU_ADDRESS 0x0100CA38 BIT_MASK 0xff /end MEASUREMENT
/begin COMPU_METHOD PPEG_TIP_state_COMPU_VTAB "Verbal Table" TAB_VERB "%.0" "list" COMPU_TAB_REF PPEG_TIP_state_COMPU_VTAB_REF /end COMPU_METHOD
/begin COMPU_VTAB PPEG_TIP_state_COMPU_VTAB_REF "Verbal Table" TAB_VERB 20 0 "Inactive" 1 "Key-on wait" 2 "Sampling" 3 "Ref P high" 4 "Ref P low" 5 "Flow high" 6 "RPM high" 7 "Key cycle wait - start" 8 "Time elapsed" 9 "Invalid" 10 "Reserved - 10" 11 "Reserved - 11" 12 "Reserved - 12" 13 "Reserved - 13" 14 "Reserved - 14" 15 "Key cycle wait - end" 16 "ECT Low" 17 "Key-off clear" 18 "EGR de-icing" 19 "Possibly frozen" DEFAULT_VALUE "UNKNOWN" /end COMPU_VTAB
/begin MEASUREMENT PPEG_EGRHP_state "EGRHP pegging status{PPEG_EGRHP_state&0xff=0:Inactive}{PPEG_EGRHP_state&0xff=1:Key-on wait}{PPEG_EGRHP_state&0xff=2:Sampling}{PPEG_EGRHP_state&0xff=3:Ref P high}{PPEG_EGRHP_state&0xff=4:Ref P low}{PPEG_EGRHP_state&0xff=5:Flow high}{PPEG_EGRHP_state&0xff=6" UBYTE PPEG_EGRHP_state_COMPU_VTAB 0 0 0 255 ECU_ADDRESS 0x0100CA40 BIT_MASK 0xff /end MEASUREMENT
/begin COMPU_METHOD PPEG_EGRHP_state_COMPU_VTAB "Verbal Table" TAB_VERB "%.0" "list" COMPU_TAB_REF PPEG_EGRHP_state_COMPU_VTAB_REF /end COMPU_METHOD
/begin COMPU_VTAB PPEG_EGRHP_state_COMPU_VTAB_REF "Verbal Table" TAB_VERB 20 0 "Inactive" 1 "Key-on wait" 2 "Sampling" 3 "Ref P high" 4 "Ref P low" 5 "Flow high" 6 "RPM high" 7 "Key cycle wait - start" 8 "Time elapsed" 9 "Invalid" 10 "Reserved - 10" 11 "Reserved - 11" 12 "Reserved - 12" 13 "Reserved - 13" 14 "Reserved - 14" 15 "Key cycle wait - end" 16 "ECT Low" 17 "Key-off clear" 18 "EGR de-icing" 19 "Possibly frozen" DEFAULT_VALUE "UNKNOWN" /end COMPU_VTAB
/begin MEASUREMENT PPEG_BP_state "BP pegging status{PPEG_BP_state&0xff=0:Inactive}{PPEG_BP_state&0xff=1:Key-on wait}{PPEG_BP_state&0xff=2:Sampling}{PPEG_BP_state&0xff=3:Ref P high}{PPEG_BP_state&0xff=4:Ref P low}{PPEG_BP_state&0xff=5:Flow high}{PPEG_BP_state&0xff=6:RPM high}{PPEG_BP_state" UBYTE PPEG_BP_state_COMPU_VTAB 0 0 0 255 ECU_ADDRESS 0x0100CA48 BIT_MASK 0xff /end MEASUREMENT
/begin COMPU_METHOD PPEG_BP_state_COMPU_VTAB "Verbal Table" TAB_VERB "%.0" "list" COMPU_TAB_REF PPEG_BP_state_COMPU_VTAB_REF /end COMPU_METHOD
/begin COMPU_VTAB PPEG_BP_state_COMPU_VTAB_REF "Verbal Table" TAB_VERB 20 0 "Inactive" 1 "Key-on wait" 2 "Sampling" 3 "Ref P high" 4 "Ref P low" 5 "Flow high" 6 "RPM high" 7 "Key cycle wait - start" 8 "Time elapsed" 9 "Invalid" 10 "Reserved - 10" 11 "Reserved - 11" 12 "Reserved - 12" 13 "Reserved - 13" 14 "Reserved - 14" 15 "Key cycle wait - end" 16 "ECT Low" 17 "Key-off clear" 18 "EGR de-icing" 19 "Possibly frozen" DEFAULT_VALUE "UNKNOWN" /end COMPU_VTAB
/begin MEASUREMENT mdot_ports_float "Port flow - total" FLOAT32_IEEE Compu_mdot_ports_float 0 0 -10000000000 10000000000 ECU_ADDRESS 0x0100CCB8 /end MEASUREMENT
/begin COMPU_METHOD Compu_mdot_ports_float " " RAT_FUNC "%.1" "g/sec" COEFFS 0 1 0 0 0 1 /end COMPU_METHOD
/begin CHARACTERISTIC PPEG_EGRLP_enable "EGRLP peg offset{PPEG_EGRLP_enable&0xff=0:Disabled}{PPEG_EGRLP_enable&0xff=1:Ref = BP}{PPEG_EGRLP_enable&0xff=2:Ref = MAP}" VALUE 0x00149182 /* @ECU_Address@PPEG_EGRLP_enable@0x0100DE40@ */ ECIPP_ALIGNMENT_UBYTE 255 PPEG_EGRLP_enable_COMPU_VTAB 0 255 BIT_MASK 0xff /end CHARACTERISTIC
/begin COMPU_METHOD PPEG_EGRLP_enable_COMPU_VTAB "Verbal Table" TAB_VERB "%.0" "list" COMPU_TAB_REF PPEG_EGRLP_enable_COMPU_VTAB_REF /end COMPU_METHOD
/begin COMPU_VTAB PPEG_EGRLP_enable_COMPU_VTAB_REF "Verbal Table" TAB_VERB 3 0 "Disabled" 1 "Ref = BP" 2 "Ref = MAP" DEFAULT_VALUE "UNKNOWN" /end COMPU_VTAB
/begin CHARACTERISTIC PPEG_EGRLP_keyon_wt "EGRLP peg key-on wait" VALUE 0x00149184 /* @ECU_Address@PPEG_EGRLP_keyon_wt@0x0100DE48@ */ ECIPP_ALIGNMENT_UWORD 65535 Compu_PPEG_EGRLP_keyon_wt 0 65535 /end CHARACTERISTIC
/begin COMPU_METHOD Compu_PPEG_EGRLP_keyon_wt " " RAT_FUNC "%.0" "ms" COEFFS 0 1 0 0 0 1 /end COMPU_METHOD
/begin CHARACTERISTIC PPEG_EGRLP_valid_wt "EGRLP peg invalid reset" VALUE 0x0014918A /* @ECU_Address@PPEG_EGRLP_valid_wt@0x0100DE50@ */ ECIPP_ALIGNMENT_UWORD 65535 Compu_PPEG_EGRLP_valid_wt 0 65535 /end CHARACTERISTIC
/begin COMPU_METHOD Compu_PPEG_EGRLP_valid_wt " " RAT_FUNC "%.0" "ms" COEFFS 0 1 0 0 0 1 /end COMPU_METHOD
/begin CHARACTERISTIC PPEG_EGRLP_start_wt "EGRLP peg start inhibit" VALUE 0x0014918C /* @ECU_Address@PPEG_EGRLP_start_wt@0x0100DE58@ */ ECIPP_ALIGNMENT_UWORD 65535 Compu_PPEG_EGRLP_start_wt 0 65535 /end CHARACTERISTIC
/begin COMPU_METHOD Compu_PPEG_EGRLP_start_wt " " RAT_FUNC "%.0" "ms" COEFFS 0 1 0 0 0 1 /end COMPU_METHOD
/begin CHARACTERISTIC PPEG_EGRLP_tau "EGRLP peg low-pass" VALUE 0x0014918E /* @ECU_Address@PPEG_EGRLP_tau@0x0100DE60@ */ ECIPP_ALIGNMENT_UWORD 163840 Compu_PPEG_EGRLP_tau 0.16703 163840 /end CHARACTERISTIC
/begin COMPU_METHOD Compu_PPEG_EGRLP_tau " " FORM "%.0" "ms"
 /begin FORMULA "-5 / log(1.0000000000001 - (X1 / 32768))" FORMULA_INV "(1.0000000000001 - exp(-5/X1)) * 32768" /end FORMULA
/end COMPU_METHOD
/begin CHARACTERISTIC PPEG_EGRLP_mdot_max "EGRLP peg max port flow" VALUE 0x00149190 /* @ECU_Address@PPEG_EGRLP_mdot_max@0x0100DE68@ */ ECIPP_ALIGNMENT_UWORD 1024 Compu_PPEG_EGRLP_mdot_max 0 1023.984375 /end CHARACTERISTIC
/begin COMPU_METHOD Compu_PPEG_EGRLP_mdot_max " " RAT_FUNC "%.1" "g/sec" COEFFS 0 64 0 0 0 1 /end COMPU_METHOD
/begin CHARACTERISTIC PPEG_EGRLP_Nmax "EGRLP peg engine speed" VALUE 0x00149192 /* @ECU_Address@PPEG_EGRLP_Nmax@0x0100DE70@ */ ECIPP_ALIGNMENT_UWORD 65535 Compu_PPEG_EGRLP_Nmax 0 65535 /end CHARACTERISTIC
/begin COMPU_METHOD Compu_PPEG_EGRLP_Nmax " " RAT_FUNC "%.0" "rpm" COEFFS 0 1 0 0 0 1 /end COMPU_METHOD
/begin CHARACTERISTIC PPEG_EGRLP_EEstore "EGRLP peg EE restore{PPEG_EGRLP_EEstore&0xff=0:Zero}{PPEG_EGRLP_EEstore&0xff=1:Restore}" VALUE 0x00149194 /* @ECU_Address@PPEG_EGRLP_EEstore@0x0100DE78@ */ ECIPP_ALIGNMENT_UBYTE 255 PPEG_EGRLP_EEstore_COMPU_VTAB 0 255 BIT_MASK 0xff /end CHARACTERISTIC
/begin COMPU_METHOD PPEG_EGRLP_EEstore_COMPU_VTAB "Verbal Table" TAB_VERB "%.0" "list" COMPU_TAB_REF PPEG_EGRLP_EEstore_COMPU_VTAB_REF /end COMPU_METHOD
/begin COMPU_VTAB PPEG_EGRLP_EEstore_COMPU_VTAB_REF "Verbal Table" TAB_VERB 2 0 "Zero" 1 "Restore" DEFAULT_VALUE "UNKNOWN" /end COMPU_VTAB
/begin CHARACTERISTIC PPEG_EGRLP_Pref_min "EGRLP peg ref P min" VALUE 0x00149196 /* @ECU_Address@PPEG_EGRLP_Pref_min@0x0100DE80@ */ ECIPP_ALIGNMENT_UWORD 256 Compu_PPEG_EGRLP_Pref_min 0 255.99609375 /end CHARACTERISTIC
/begin COMPU_METHOD Compu_PPEG_EGRLP_Pref_min " " RAT_FUNC "%.2" "psia" COEFFS 0 256 0 0 0 1 /end COMPU_METHOD
/begin CHARACTERISTIC PPEG_EGRLP_Pref_max "EGRLP peg ref P max" VALUE 0x00149198 /* @ECU_Address@PPEG_EGRLP_Pref_max@0x0100DE88@ */ ECIPP_ALIGNMENT_UWORD 256 Compu_PPEG_EGRLP_Pref_max 0 255.99609375 /end CHARACTERISTIC
/begin COMPU_METHOD Compu_PPEG_EGRLP_Pref_max " " RAT_FUNC "%.2" "psia" COEFFS 0 256 0 0 0 1 /end COMPU_METHOD
/begin CHARACTERISTIC PPEG_EGRLP_ofst_max "EGRLP peg max offset" VALUE 0x0014919A /* @ECU_Address@PPEG_EGRLP_ofst_max@0x0100DE90@ */ ECIPP_ALIGNMENT_SWORD 128 Compu_PPEG_EGRLP_ofst_max -128 127.99609375 /end CHARACTERISTIC
/begin COMPU_METHOD Compu_PPEG_EGRLP_ofst_max " " RAT_FUNC "%.2" "psi" COEFFS 0 256 0 0 0 1 /end COMPU_METHOD
/begin MEASUREMENT PPEG_EGRLP_offset "EGRLP peg offset" SWORD Compu_PPEG_EGRLP_offset 0 0 -128 127.99609375 ECU_ADDRESS 0x0100DE98 /end MEASUREMENT
/begin COMPU_METHOD Compu_PPEG_EGRLP_offset " " RAT_FUNC "%.2" "psi" COEFFS 0 256 0 0 0 1 /end COMPU_METHOD
/begin MEASUREMENT PPEG_EGRLP_state "EGRLP pegging status{PPEG_EGRLP_state&0xff=0:Inactive}{PPEG_EGRLP_state&0xff=1:Key-on wait}{PPEG_EGRLP_state&0xff=2:Sampling}{PPEG_EGRLP_state&0xff=3:Ref P high}{PPEG_EGRLP_state&0xff=4:Ref P low}{PPEG_EGRLP_state&0xff=5:Flow high}{PPEG_EGRLP_state&0xff=6" UBYTE PPEG_EGRLP_state_COMPU_VTAB 0 0 0 255 ECU_ADDRESS 0x0100DEA0 BIT_MASK 0xff /end MEASUREMENT
/begin COMPU_METHOD PPEG_EGRLP_state_COMPU_VTAB "Verbal Table" TAB_VERB "%.0" "list" COMPU_TAB_REF PPEG_EGRLP_state_COMPU_VTAB_REF /end COMPU_METHOD
/begin COMPU_VTAB PPEG_EGRLP_state_COMPU_VTAB_REF "Verbal Table" TAB_VERB 20 0 "Inactive" 1 "Key-on wait" 2 "Sampling" 3 "Ref P high" 4 "Ref P low" 5 "Flow high" 6 "RPM high" 7 "Key cycle wait - start" 8 "Time elapsed" 9 "Invalid" 10 "Reserved - 10" 11 "Reserved - 11" 12 "Reserved - 12" 13 "Reserved - 13" 14 "Reserved - 14" 15 "Key cycle wait - end" 16 "ECT Low" 17 "Key-off clear" 18 "EGR de-icing" 19 "Possibly frozen" DEFAULT_VALUE "UNKNOWN" /end COMPU_VTAB
/begin CHARACTERISTIC cam_level_trust "cam level constant trust" VALUE 0x001465a6 /* @ECU_Address@cam_level_trust@0x0100E768@ */ ECIPP_ALIGNMENT_SWORD 2048 Compu_cam_level_trust -2048 2047.9375 /end CHARACTERISTIC
/begin COMPU_METHOD Compu_cam_level_trust " " RAT_FUNC "%.0" "CAD" COEFFS 0 16 0 0 0 1 /end COMPU_METHOD
/begin CHARACTERISTIC TIAT_ena "TIAT source{TIAT_ena&0xff=0:Disabled}{TIAT_ena&0xff=1:Aux PU1}{TIAT_ena&0xff=2:Aux PU2}{TIAT_ena&0xff=3:Aux PU3}{TIAT_ena&0xff=4:Aux PUD1}{TIAT_ena&0xff=5:Aux PUD2}{TIAT_ena&0xff=6:Aux PUD3}{TIAT_ena&0xff=7:EGT Input}{TIAT_ena&0xff=8:Aux PUD4}{TIAT_ena&0x" VALUE 0x00148099 /* @ECU_Address@TIAT_ena@0x0100EEF0@ */ ECIPP_ALIGNMENT_UBYTE 255 TIAT_ena_COMPU_VTAB 0 255 BIT_MASK 0xff /end CHARACTERISTIC
/begin COMPU_METHOD TIAT_ena_COMPU_VTAB "Verbal Table" TAB_VERB "%.0" "list" COMPU_TAB_REF TIAT_ena_COMPU_VTAB_REF /end COMPU_METHOD
/begin COMPU_VTAB TIAT_ena_COMPU_VTAB_REF "Verbal Table" TAB_VERB 31 0 "Disabled" 1 "Aux PU1" 2 "Aux PU2" 3 "Aux PU3" 4 "Aux PUD1" 5 "Aux PUD2" 6 "Aux PUD3" 7 "EGT Input" 8 "Aux PUD4" 9 "Aux PUD5" 10 "Aux PUD6" 11 "Aux PUD7" 12 "Aux PUD8" 13 "Aux PUD9" 14 "Aux PUD10" 15 "Aux PUD11" 16 "Aux PUD12" 17 "Aux PUD13" 18 "Aux PUD14" 19 "Aux PUD15" 20 "Aux PUD16" 21 "Aux PUD17" 22 "Aux PUD18" 23 "Aux PUD19" 24 "Aux PUD20" 25 "Aux PUD21" 26 "Aux PUD22" 27 "Aux PUD23" 28 "Aux PUD24" 29 "Aux PUD25" 30 "CAN sourced" DEFAULT_VALUE "UNKNOWN" /end COMPU_VTAB
/begin CHARACTERISTIC PPEG_EGRwrP_enable "EGRwrP peg offset{PPEG_EGRwrP_enable&0xff=0:Disabled}{PPEG_EGRwrP_enable&0xff=1:Ref = BP}{PPEG_EGRwrP_enable&0xff=2:Ref = MAP}" VALUE 0x0014919C /* @ECU_Address@PPEG_EGRwrP_enable@0x0100F398@ */ ECIPP_ALIGNMENT_UBYTE 255 PPEG_EGRwrP_enable_COMPU_VTAB 0 255 BIT_MASK 0xff /end CHARACTERISTIC
/begin COMPU_METHOD PPEG_EGRwrP_enable_COMPU_VTAB "Verbal Table" TAB_VERB "%.0" "list" COMPU_TAB_REF PPEG_EGRwrP_enable_COMPU_VTAB_REF /end COMPU_METHOD
/begin COMPU_VTAB PPEG_EGRwrP_enable_COMPU_VTAB_REF "Verbal Table" TAB_VERB 3 0 "Disabled" 1 "Ref = BP" 2 "Ref = MAP" DEFAULT_VALUE "UNKNOWN" /end COMPU_VTAB
/begin CHARACTERISTIC PPEG_EGRwrP_keyon_wt "EGRwrP peg key-on wait" VALUE 0x0014919E /* @ECU_Address@PPEG_EGRwrP_keyon_wt@0x0100F3A0@ */ ECIPP_ALIGNMENT_UWORD 65535 Compu_PPEG_EGRwrP_keyon_wt 0 65535 /end CHARACTERISTIC
/begin COMPU_METHOD Compu_PPEG_EGRwrP_keyon_wt " " RAT_FUNC "%.0" "ms" COEFFS 0 1 0 0 0 1 /end COMPU_METHOD
/begin CHARACTERISTIC PPEG_EGRwrP_valid_wt "EGRwrP peg invalid reset" VALUE 0x001491A4 /* @ECU_Address@PPEG_EGRwrP_valid_wt@0x0100F3A8@ */ ECIPP_ALIGNMENT_UWORD 65535 Compu_PPEG_EGRwrP_valid_wt 0 65535 /end CHARACTERISTIC
/begin COMPU_METHOD Compu_PPEG_EGRwrP_valid_wt " " RAT_FUNC "%.0" "ms" COEFFS 0 1 0 0 0 1 /end COMPU_METHOD
/begin CHARACTERISTIC PPEG_EGRwrP_start_wt "EGRwrP peg start inhibit" VALUE 0x001491A6 /* @ECU_Address@PPEG_EGRwrP_start_wt@0x0100F3B0@ */ ECIPP_ALIGNMENT_UWORD 65535 Compu_PPEG_EGRwrP_start_wt 0 65535 /end CHARACTERISTIC
/begin COMPU_METHOD Compu_PPEG_EGRwrP_start_wt " " RAT_FUNC "%.0" "ms" COEFFS 0 1 0 0 0 1 /end COMPU_METHOD
/begin CHARACTERISTIC PPEG_EGRwrP_tau "EGRwrP peg low-pass" VALUE 0x001491A8 /* @ECU_Address@PPEG_EGRwrP_tau@0x0100F3B8@ */ ECIPP_ALIGNMENT_UWORD 163840 Compu_PPEG_EGRwrP_tau 0.16703 163840 /end CHARACTERISTIC
/begin COMPU_METHOD Compu_PPEG_EGRwrP_tau " " FORM "%.0" "ms"
 /begin FORMULA "-5 / log(1.0000000000001 - (X1 / 32768))" FORMULA_INV "(1.0000000000001 - exp(-5/X1)) * 32768" /end FORMULA
/end COMPU_METHOD
/begin CHARACTERISTIC PPEG_EGRwrP_mdot_max "EGRwrP peg max port flow" VALUE 0x001491AA /* @ECU_Address@PPEG_EGRwrP_mdot_max@0x0100F3C0@ */ ECIPP_ALIGNMENT_UWORD 1024 Compu_PPEG_EGRwrP_mdot_max 0 1023.984375 /end CHARACTERISTIC
/begin COMPU_METHOD Compu_PPEG_EGRwrP_mdot_max " " RAT_FUNC "%.1" "g/sec" COEFFS 0 64 0 0 0 1 /end COMPU_METHOD
/begin CHARACTERISTIC PPEG_EGRwrP_Nmax "EGRwrP peg engine speed" VALUE 0x001491AC /* @ECU_Address@PPEG_EGRwrP_Nmax@0x0100F3C8@ */ ECIPP_ALIGNMENT_UWORD 65535 Compu_PPEG_EGRwrP_Nmax 0 65535 /end CHARACTERISTIC
/begin COMPU_METHOD Compu_PPEG_EGRwrP_Nmax " " RAT_FUNC "%.0" "rpm" COEFFS 0 1 0 0 0 1 /end COMPU_METHOD
/begin CHARACTERISTIC PPEG_EGRwrP_EEstore "EGRwrP peg EE restore{PPEG_EGRwrP_EEstore&0xff=0:Zero}{PPEG_EGRwrP_EEstore&0xff=1:Restore}" VALUE 0x001491AE /* @ECU_Address@PPEG_EGRwrP_EEstore@0x0100F3D0@ */ ECIPP_ALIGNMENT_UBYTE 255 PPEG_EGRwrP_EEstore_COMPU_VTAB 0 255 BIT_MASK 0xff /end CHARACTERISTIC
/begin COMPU_METHOD PPEG_EGRwrP_EEstore_COMPU_VTAB "Verbal Table" TAB_VERB "%.0" "list" COMPU_TAB_REF PPEG_EGRwrP_EEstore_COMPU_VTAB_REF /end COMPU_METHOD
/begin COMPU_VTAB PPEG_EGRwrP_EEstore_COMPU_VTAB_REF "Verbal Table" TAB_VERB 2 0 "Zero" 1 "Restore" DEFAULT_VALUE "UNKNOWN" /end COMPU_VTAB
/begin CHARACTERISTIC PPEG_EGRwrP_Pref_min "EGRwrP peg ref P min" VALUE 0x001491B0 /* @ECU_Address@PPEG_EGRwrP_Pref_min@0x0100F3D8@ */ ECIPP_ALIGNMENT_UWORD 256 Compu_PPEG_EGRwrP_Pref_min 0 255.99609375 /end CHARACTERISTIC
/begin COMPU_METHOD Compu_PPEG_EGRwrP_Pref_min " " RAT_FUNC "%.2" "psia" COEFFS 0 256 0 0 0 1 /end COMPU_METHOD
/begin CHARACTERISTIC PPEG_EGRwrP_Pref_max "EGRwrP peg ref P max" VALUE 0x001491B2 /* @ECU_Address@PPEG_EGRwrP_Pref_max@0x0100F3E0@ */ ECIPP_ALIGNMENT_UWORD 256 Compu_PPEG_EGRwrP_Pref_max 0 255.99609375 /end CHARACTERISTIC
/begin COMPU_METHOD Compu_PPEG_EGRwrP_Pref_max " " RAT_FUNC "%.2" "psia" COEFFS 0 256 0 0 0 1 /end COMPU_METHOD
/begin CHARACTERISTIC PPEG_EGRwrP_ofst_max "EGRwrP peg max offset" VALUE 0x001491B4 /* @ECU_Address@PPEG_EGRwrP_ofst_max@0x0100F3E8@ */ ECIPP_ALIGNMENT_SWORD 128 Compu_PPEG_EGRwrP_ofst_max -128 127.99609375 /end CHARACTERISTIC
/begin COMPU_METHOD Compu_PPEG_EGRwrP_ofst_max " " RAT_FUNC "%.2" "psi" COEFFS 0 256 0 0 0 1 /end COMPU_METHOD
/begin MEASUREMENT PPEG_EGRwrP_offset "EGRwrP peg offset" SWORD Compu_PPEG_EGRwrP_offset 0 0 -128 127.99609375 ECU_ADDRESS 0x0100F3F0 /end MEASUREMENT
/begin COMPU_METHOD Compu_PPEG_EGRwrP_offset " " RAT_FUNC "%.2" "psi" COEFFS 0 256 0 0 0 1 /end COMPU_METHOD
/begin MEASUREMENT PPEG_EGRwrP_state "EGRwrP peg state{PPEG_EGRwrP_state&0xff=0:Inactive}{PPEG_EGRwrP_state&0xff=1:Key-on wait}{PPEG_EGRwrP_state&0xff=2:Sampling}{PPEG_EGRwrP_state&0xff=3:Ref P high}{PPEG_EGRwrP_state&0xff=4:Ref P low}{PPEG_EGRwrP_state&0xff=5:Flow high}{PPEG_EGRwrP_state&0xf" UBYTE PPEG_EGRwrP_state_COMPU_VTAB 0 0 0 255 ECU_ADDRESS 0x0100F3F8 BIT_MASK 0xff /end MEASUREMENT
/begin COMPU_METHOD PPEG_EGRwrP_state_COMPU_VTAB "Verbal Table" TAB_VERB "%.0" "list" COMPU_TAB_REF PPEG_EGRwrP_state_COMPU_VTAB_REF /end COMPU_METHOD
/begin COMPU_VTAB PPEG_EGRwrP_state_COMPU_VTAB_REF "Verbal Table" TAB_VERB 20 0 "Inactive" 1 "Key-on wait" 2 "Sampling" 3 "Ref P high" 4 "Ref P low" 5 "Flow high" 6 "RPM high" 7 "Key cycle wait - start" 8 "Time elapsed" 9 "Invalid" 10 "Reserved - 10" 11 "Reserved - 11" 12 "Reserved - 12" 13 "Reserved - 13" 14 "Reserved - 14" 15 "Key cycle wait - end" 16 "ECT Low" 17 "Key-off clear" 18 "EGR de-icing" 19 "Possibly frozen" DEFAULT_VALUE "UNKNOWN" /end COMPU_VTAB
/begin CHARACTERISTIC key_off_clr_ena "Key-off clear with relay on{key_off_clr_ena&0xff=0:Disabled}{key_off_clr_ena&0xff=1:Enabled}" VALUE 0x001481a2 /* @ECU_Address@key_off_clr_ena@0x0100F7F0@ */ ECIPP_ALIGNMENT_UBYTE 255 key_off_clr_ena_COMPU_VTAB 0 255 BIT_MASK 0xff /end CHARACTERISTIC
/begin COMPU_METHOD key_off_clr_ena_COMPU_VTAB "Verbal Table" TAB_VERB "%.0" "list" COMPU_TAB_REF key_off_clr_ena_COMPU_VTAB_REF /end COMPU_METHOD
/begin COMPU_VTAB key_off_clr_ena_COMPU_VTAB_REF "Verbal Table" TAB_VERB 2 0 "Disabled" 1 "Enabled" DEFAULT_VALUE "UNKNOWN" /end COMPU_VTAB
/begin CHARACTERISTIC key_off_clr_wt "Key-off clear wait" VALUE 0x00147b50 /* @ECU_Address@key_off_clr_wt@0x0100F7F8@ */ ECIPP_ALIGNMENT_UWORD 65535 Compu_key_off_clr_wt 0 65535 /end CHARACTERISTIC
/begin COMPU_METHOD Compu_key_off_clr_wt " " RAT_FUNC "%.0" "ms" COEFFS 0 1 0 0 0 1 /end COMPU_METHOD
/begin CHARACTERISTIC key_off_clr_hold "Key-off clear hold" VALUE 0x00147b4e /* @ECU_Address@key_off_clr_hold@0x0100F800@ */ ECIPP_ALIGNMENT_UWORD 66 Compu_key_off_clr_hold 0 65.535 /end CHARACTERISTIC
/begin COMPU_METHOD Compu_key_off_clr_hold " " RAT_FUNC "%.1" "sec" COEFFS 0 1000 0 0 0 1 /end COMPU_METHOD
/begin CHARACTERISTIC key_off_clr_TPS "Key-off clear TPS command" VALUE 0x00147b4c /* @ECU_Address@key_off_clr_TPS@0x0100F808@ */ ECIPP_ALIGNMENT_UWORD 100 Compu_key_off_clr_TPS 0 99.9984741210938 /end CHARACTERISTIC
/begin COMPU_METHOD Compu_key_off_clr_TPS " " RAT_FUNC "%.1" "%" COEFFS 0 655.36 0 0 0 1 /end COMPU_METHOD
/begin CHARACTERISTIC key_off_clr_EGR "Key-off clear EGR command" VALUE 0x00147b48 /* @ECU_Address@key_off_clr_EGR@0x0100F810@ */ ECIPP_ALIGNMENT_UWORD 100 Compu_key_off_clr_EGR 0 99.9984741210938 /end CHARACTERISTIC
/begin COMPU_METHOD Compu_key_off_clr_EGR " " RAT_FUNC "%.1" "%" COEFFS 0 655.36 0 0 0 1 /end COMPU_METHOD
/begin MEASUREMENT key_off_clr_active "Key-off clear active" UWORD Compu_key_off_clr_active 0 0 0 65.535 ECU_ADDRESS 0x0100F818 /end MEASUREMENT
/begin COMPU_METHOD Compu_key_off_clr_active " " RAT_FUNC "%.1" "sec" COEFFS 0 1000 0 0 0 1 /end COMPU_METHOD
/begin CHARACTERISTIC PPEG_BP_keyX_wt "BP key-off wait" VALUE 0x00149104 /* @ECU_Address@PPEG_BP_keyX_wt@0x0100F820@ */ ECIPP_ALIGNMENT_UWORD 65535 Compu_PPEG_BP_keyX_wt 0 65535 /end CHARACTERISTIC
/begin COMPU_METHOD Compu_PPEG_BP_keyX_wt " " RAT_FUNC "%.0" "ms" COEFFS 0 1 0 0 0 1 /end COMPU_METHOD
/begin CHARACTERISTIC PPEG_EBP_keyX_wt "EBP key-off wait" VALUE 0x00149152 /* @ECU_Address@PPEG_EBP_keyX_wt@0x0100F828@ */ ECIPP_ALIGNMENT_UWORD 65535 Compu_PPEG_EBP_keyX_wt 0 65535 /end CHARACTERISTIC
/begin COMPU_METHOD Compu_PPEG_EBP_keyX_wt " " RAT_FUNC "%.0" "ms" COEFFS 0 1 0 0 0 1 /end COMPU_METHOD
/begin CHARACTERISTIC PPEG_EGRLP_keyX_wt "EGRLP key-off wait" VALUE 0x00149186 /* @ECU_Address@PPEG_EGRLP_keyX_wt@0x0100F830@ */ ECIPP_ALIGNMENT_UWORD 65535 Compu_PPEG_EGRLP_keyX_wt 0 65535 /end CHARACTERISTIC
/begin COMPU_METHOD Compu_PPEG_EGRLP_keyX_wt " " RAT_FUNC "%.0" "ms" COEFFS 0 1 0 0 0 1 /end COMPU_METHOD
/begin CHARACTERISTIC PPEG_EGRHP_keyX_wt "EGRHP key-off wait" VALUE 0x0014916C /* @ECU_Address@PPEG_EGRHP_keyX_wt@0x0100F838@ */ ECIPP_ALIGNMENT_UWORD 65535 Compu_PPEG_EGRHP_keyX_wt 0 65535 /end CHARACTERISTIC
/begin COMPU_METHOD Compu_PPEG_EGRHP_keyX_wt " " RAT_FUNC "%.0" "ms" COEFFS 0 1 0 0 0 1 /end COMPU_METHOD
/begin CHARACTERISTIC PPEG_TIP_keyX_wt "TIP key-off wait" VALUE 0x001491BA /* @ECU_Address@PPEG_TIP_keyX_wt@0x0100F840@ */ ECIPP_ALIGNMENT_UWORD 65535 Compu_PPEG_TIP_keyX_wt 0 65535 /end CHARACTERISTIC
/begin COMPU_METHOD Compu_PPEG_TIP_keyX_wt " " RAT_FUNC "%.0" "ms" COEFFS 0 1 0 0 0 1 /end COMPU_METHOD
/begin CHARACTERISTIC PPEG_EGRwrP_keyX_wt "EGRwrP key-off wait" VALUE 0x001491A0 /* @ECU_Address@PPEG_EGRwrP_keyX_wt@0x0100F848@ */ ECIPP_ALIGNMENT_UWORD 65535 Compu_PPEG_EGRwrP_keyX_wt 0 65535 /end CHARACTERISTIC
/begin COMPU_METHOD Compu_PPEG_EGRwrP_keyX_wt " " RAT_FUNC "%.0" "ms" COEFFS 0 1 0 0 0 1 /end COMPU_METHOD
/begin CHARACTERISTIC PPEG_BP_ECT_ena "BP ECT enable" VALUE 0x00149106 /* @ECU_Address@PPEG_BP_ECT_ena@0x0100F850@ */ ECIPP_ALIGNMENT_UWORD 564 Compu_PPEG_BP_ECT_ena -460 563.984375 /end CHARACTERISTIC
/begin COMPU_METHOD Compu_PPEG_BP_ECT_ena " " RAT_FUNC "%.1" "deg F" COEFFS 0 64 29440 0 0 1 /end COMPU_METHOD
/begin CHARACTERISTIC PPEG_EBP_ECT_ena "EBP ECT enable" VALUE 0x00149154 /* @ECU_Address@PPEG_EBP_ECT_ena@0x0100F858@ */ ECIPP_ALIGNMENT_UWORD 564 Compu_PPEG_EBP_ECT_ena -460 563.984375 /end CHARACTERISTIC
/begin COMPU_METHOD Compu_PPEG_EBP_ECT_ena " " RAT_FUNC "%.1" "deg F" COEFFS 0 64 29440 0 0 1 /end COMPU_METHOD
/begin CHARACTERISTIC PPEG_EGRLP_ECT_ena "EGRLP ECT enable" VALUE 0x00149188 /* @ECU_Address@PPEG_EGRLP_ECT_ena@0x0100F860@ */ ECIPP_ALIGNMENT_UWORD 564 Compu_PPEG_EGRLP_ECT_ena -460 563.984375 /end CHARACTERISTIC
/begin COMPU_METHOD Compu_PPEG_EGRLP_ECT_ena " " RAT_FUNC "%.1" "deg F" COEFFS 0 64 29440 0 0 1 /end COMPU_METHOD
/begin CHARACTERISTIC PPEG_EGRHP_ECT_ena "EGRHP ECT enable" VALUE 0x0014916E /* @ECU_Address@PPEG_EGRHP_ECT_ena@0x0100F868@ */ ECIPP_ALIGNMENT_UWORD 564 Compu_PPEG_EGRHP_ECT_ena -460 563.984375 /end CHARACTERISTIC
/begin COMPU_METHOD Compu_PPEG_EGRHP_ECT_ena " " RAT_FUNC "%.1" "deg F" COEFFS 0 64 29440 0 0 1 /end COMPU_METHOD
/begin CHARACTERISTIC PPEG_TIP_ECT_ena "TIP ECT enable" VALUE 0x001491BC /* @ECU_Address@PPEG_TIP_ECT_ena@0x0100F870@ */ ECIPP_ALIGNMENT_UWORD 564 Compu_PPEG_TIP_ECT_ena -460 563.984375 /end CHARACTERISTIC
/begin COMPU_METHOD Compu_PPEG_TIP_ECT_ena " " RAT_FUNC "%.1" "deg F" COEFFS 0 64 29440 0 0 1 /end COMPU_METHOD
/begin CHARACTERISTIC PPEG_EGRwrP_ECT_ena "EGRwrP ECT enable" VALUE 0x001491A2 /* @ECU_Address@PPEG_EGRwrP_ECT_ena@0x0100F878@ */ ECIPP_ALIGNMENT_UWORD 564 Compu_PPEG_EGRwrP_ECT_ena -460 563.984375 /end CHARACTERISTIC
/begin COMPU_METHOD Compu_PPEG_EGRwrP_ECT_ena " " RAT_FUNC "%.1" "deg F" COEFFS 0 64 29440 0 0 1 /end COMPU_METHOD
/begin CHARACTERISTIC crank_gap_large_x "crank gap (large) margin multiplier" VALUE 0x00147aa8 /* @ECU_Address@crank_gap_large_x@0x0100F880@ */ ECIPP_ALIGNMENT_UWORD 256 Compu_crank_gap_large_x 0 255.99609375 /end CHARACTERISTIC
/begin COMPU_METHOD Compu_crank_gap_large_x " " RAT_FUNC "%.2" "-" COEFFS 0 256 0 0 0 1 /end COMPU_METHOD
/begin MEASUREMENT DATE_engine_mfg_int "Engine manufacture date int" ULONG Compu_DATE_engine_mfg_int 0 0 0 4294967295 ECU_ADDRESS 0x0100FB50 /end MEASUREMENT
/begin COMPU_METHOD Compu_DATE_engine_mfg_int " " RAT_FUNC "%.0" "-" COEFFS 0 1 0 0 0 1 /end COMPU_METHOD
/begin CHARACTERISTIC FIP_ena "FIP sensor{FIP_ena&0xff=0:Disabled}{FIP_ena&0xff=1:Aux PD1}{FIP_ena&0xff=2:Aux PD2}{FIP_ena&0xff=3:Aux PD3}{FIP_ena&0xff=4:Aux PUD1}{FIP_ena&0xff=5:Aux PUD2}{FIP_ena&0xff=6:Aux PUD3}{FIP_ena&0xff=7:Aux PUD4}{FIP_ena&0xff=8:Aux PUD5}{FIP_ena&0xff=9:Aux PUD" VALUE 0x00147d55 /* @ECU_Address@FIP_ena@0x0100FD00@ */ ECIPP_ALIGNMENT_UBYTE 255 FIP_ena_COMPU_VTAB 0 255 BIT_MASK 0xff /end CHARACTERISTIC
/begin COMPU_METHOD FIP_ena_COMPU_VTAB "Verbal Table" TAB_VERB "%.0" "list" COMPU_TAB_REF FIP_ena_COMPU_VTAB_REF /end COMPU_METHOD
/begin COMPU_VTAB FIP_ena_COMPU_VTAB_REF "Verbal Table" TAB_VERB 31 0 "Disabled" 1 "Aux PD1" 2 "Aux PD2" 3 "Aux PD3" 4 "Aux PUD1" 5 "Aux PUD2" 6 "Aux PUD3" 7 "Aux PUD4" 8 "Aux PUD5" 9 "Aux PUD6" 10 "Aux PUD7" 11 "Aux PUD8" 12 "Aux PUD9" 13 "Aux PUD10" 14 "Aux PUD11" 15 "Aux PUD12" 16 "Aux PUD13" 17 "Aux PUD14" 18 "Aux PUD15" 19 "CAN sourced" 20 "FPP2 Input" 21 "Aux PUD16" 22 "Aux PUD17" 23 "Aux PUD18" 24 "Aux PUD19" 25 "Aux PUD20" 26 "Aux PUD21" 27 "Aux PUD22" 28 "Aux PUD23" 29 "Aux PUD24" 30 "Aux PUD25" DEFAULT_VALUE "UNKNOWN" /end COMPU_VTAB
/begin CHARACTERISTIC FIP_tau "FIP raw low-pass" VALUE 0x00147be0 /* @ECU_Address@FIP_tau@0x0100FD10@ */ ECIPP_ALIGNMENT_UWORD 327680 Compu_FIP_tau 0.45084 327680 /end CHARACTERISTIC
/begin COMPU_METHOD Compu_FIP_tau " " FORM "%.0" "ms"
 /begin FORMULA "-5 / log(1 - (X1 / 65536))" FORMULA_INV "(1 - exp(-5/X1)) * 65536" /end FORMULA
/end COMPU_METHOD
/begin MEASUREMENT FIP_raw "FIP raw" UWORD Compu_FIP_raw 0 0 0 255.99609375 ECU_ADDRESS 0x0100FD18 /end MEASUREMENT
/begin COMPU_METHOD Compu_FIP_raw " " RAT_FUNC "%.2" "psia" COEFFS 0 256 0 0 0 1 /end COMPU_METHOD
/begin MEASUREMENT FIP "FIP" UWORD Compu_FIP 0 0 0 255.99609375 ECU_ADDRESS 0x0100FD20 /end MEASUREMENT
/begin COMPU_METHOD Compu_FIP " " RAT_FUNC "%.2" "psia" COEFFS 0 256 0 0 0 1 /end COMPU_METHOD
/begin CHARACTERISTIC FIP_def "FIP default" VALUE 0x0014686c /* @ECU_Address@FIP_def@0x0100FD28@ */ ECIPP_ALIGNMENT_UWORD 256 Compu_FIP_def 0 255.99609375 /end CHARACTERISTIC
/begin COMPU_METHOD Compu_FIP_def " " RAT_FUNC "%.2" "psia" COEFFS 0 256 0 0 0 1 /end COMPU_METHOD
/begin CHARACTERISTIC cam1_input_redirect "cam1 input redirect{cam1_input_redirect&0xff=0:Normal - no redirect}{cam1_input_redirect&0xff=1:Redirect to Cam2}" VALUE 0x00148120 /* @ECU_Address@cam1_input_redirect@0x01010160@ */ ECIPP_ALIGNMENT_UBYTE 255 cam1_input_redirect_COMPU_VTAB 0 255 BIT_MASK 0xff /end CHARACTERISTIC
/begin COMPU_METHOD cam1_input_redirect_COMPU_VTAB "Verbal Table" TAB_VERB "%.0" "list" COMPU_TAB_REF cam1_input_redirect_COMPU_VTAB_REF /end COMPU_METHOD
/begin COMPU_VTAB cam1_input_redirect_COMPU_VTAB_REF "Verbal Table" TAB_VERB 2 0 "Normal - no redirect" 1 "Redirect to Cam2" DEFAULT_VALUE "UNKNOWN" /end COMPU_VTAB
/begin CHARACTERISTIC cam2_input_redirect "cam2 input redirect{cam2_input_redirect&0xff=0:Normal - no redirect}{cam2_input_redirect&0xff=1:Redirect to Cam1}" VALUE 0x00148121 /* @ECU_Address@cam2_input_redirect@0x01010168@ */ ECIPP_ALIGNMENT_UBYTE 255 cam2_input_redirect_COMPU_VTAB 0 255 BIT_MASK 0xff /end CHARACTERISTIC
/begin COMPU_METHOD cam2_input_redirect_COMPU_VTAB "Verbal Table" TAB_VERB "%.0" "list" COMPU_TAB_REF cam2_input_redirect_COMPU_VTAB_REF /end COMPU_METHOD
/begin COMPU_VTAB cam2_input_redirect_COMPU_VTAB_REF "Verbal Table" TAB_VERB 2 0 "Normal - no redirect" 1 "Redirect to Cam1" DEFAULT_VALUE "UNKNOWN" /end COMPU_VTAB
/begin CHARACTERISTIC key_off_clr_EGR_cnt "Key-off clear EGR cycles" VALUE 0x001481a0 /* @ECU_Address@key_off_clr_EGR_cnt@0x01010990@ */ ECIPP_ALIGNMENT_UBYTE 255 Compu_key_off_clr_EGR_cnt 0 255 /end CHARACTERISTIC
/begin COMPU_METHOD Compu_key_off_clr_EGR_cnt " " RAT_FUNC "%.0" "-" COEFFS 0 1 0 0 0 1 /end COMPU_METHOD
/begin CHARACTERISTIC crank_skip_teeth "crank skip teeth" VALUE 0x0014812f /* @ECU_Address@crank_skip_teeth@0x01010B08@ */ ECIPP_ALIGNMENT_UBYTE 255 Compu_crank_skip_teeth 0 255 /end CHARACTERISTIC
/begin COMPU_METHOD Compu_crank_skip_teeth " " RAT_FUNC "%.0" "teeth" COEFFS 0 1 0 0 0 1 /end COMPU_METHOD
/begin CHARACTERISTIC PPEG_CVP1_enable "CVP1 peg offset{PPEG_CVP1_enable&0xff=0:Disabled}{PPEG_CVP1_enable&0xff=1:Enabled}" VALUE 0x0014911A /* @ECU_Address@PPEG_CVP1_enable@0x01010B40@ */ ECIPP_ALIGNMENT_UBYTE 255 PPEG_CVP1_enable_COMPU_VTAB 0 255 BIT_MASK 0xff /end CHARACTERISTIC
/begin COMPU_METHOD PPEG_CVP1_enable_COMPU_VTAB "Verbal Table" TAB_VERB "%.0" "list" COMPU_TAB_REF PPEG_CVP1_enable_COMPU_VTAB_REF /end COMPU_METHOD
/begin COMPU_VTAB PPEG_CVP1_enable_COMPU_VTAB_REF "Verbal Table" TAB_VERB 2 0 "Disabled" 1 "Enabled" DEFAULT_VALUE "UNKNOWN" /end COMPU_VTAB
/begin CHARACTERISTIC PPEG_CVP1_keyon_wt "CVP1 peg key-on wait" VALUE 0x0014911C /* @ECU_Address@PPEG_CVP1_keyon_wt@0x01010B48@ */ ECIPP_ALIGNMENT_UWORD 65535 Compu_PPEG_CVP1_keyon_wt 0 65535 /end CHARACTERISTIC
/begin COMPU_METHOD Compu_PPEG_CVP1_keyon_wt " " RAT_FUNC "%.0" "ms" COEFFS 0 1 0 0 0 1 /end COMPU_METHOD
/begin CHARACTERISTIC PPEG_CVP1_keyX_wt "CVP1 peg key-off wait" VALUE 0x0014911E /* @ECU_Address@PPEG_CVP1_keyX_wt@0x01010B50@ */ ECIPP_ALIGNMENT_UWORD 65535 Compu_PPEG_CVP1_keyX_wt 0 65535 /end CHARACTERISTIC
/begin COMPU_METHOD Compu_PPEG_CVP1_keyX_wt " " RAT_FUNC "%.0" "ms" COEFFS 0 1 0 0 0 1 /end COMPU_METHOD
/begin CHARACTERISTIC PPEG_CVP1_ECT_ena "CVP1 peg ECT enable" VALUE 0x00149120 /* @ECU_Address@PPEG_CVP1_ECT_ena@0x01010B58@ */ ECIPP_ALIGNMENT_UWORD 564 Compu_PPEG_CVP1_ECT_ena -460 563.984375 /end CHARACTERISTIC
/begin COMPU_METHOD Compu_PPEG_CVP1_ECT_ena " " RAT_FUNC "%.1" "deg F" COEFFS 0 64 29440 0 0 1 /end COMPU_METHOD
/begin CHARACTERISTIC PPEG_CVP1_valid_wt "CVP1 peg invalid reset" VALUE 0x00149122 /* @ECU_Address@PPEG_CVP1_valid_wt@0x01010B60@ */ ECIPP_ALIGNMENT_UWORD 65535 Compu_PPEG_CVP1_valid_wt 0 65535 /end CHARACTERISTIC
/begin COMPU_METHOD Compu_PPEG_CVP1_valid_wt " " RAT_FUNC "%.0" "ms" COEFFS 0 1 0 0 0 1 /end COMPU_METHOD
/begin CHARACTERISTIC PPEG_CVP1_start_wt "CVP1 peg start inhibit" VALUE 0x00149124 /* @ECU_Address@PPEG_CVP1_start_wt@0x01010B68@ */ ECIPP_ALIGNMENT_UWORD 65535 Compu_PPEG_CVP1_start_wt 0 65535 /end CHARACTERISTIC
/begin COMPU_METHOD Compu_PPEG_CVP1_start_wt " " RAT_FUNC "%.0" "ms" COEFFS 0 1 0 0 0 1 /end COMPU_METHOD
/begin CHARACTERISTIC PPEG_CVP1_tau "CVP1 peg low-pass" VALUE 0x00149126 /* @ECU_Address@PPEG_CVP1_tau@0x01010B70@ */ ECIPP_ALIGNMENT_UWORD 163840 Compu_PPEG_CVP1_tau 0.16703 163840 /end CHARACTERISTIC
/begin COMPU_METHOD Compu_PPEG_CVP1_tau " " FORM "%.0" "ms"
 /begin FORMULA "-5 / log(1.0000000000001 - (X1 / 32768))" FORMULA_INV "(1.0000000000001 - exp(-5/X1)) * 32768" /end FORMULA
/end COMPU_METHOD
/begin CHARACTERISTIC PPEG_CVP1_mdot_max "CVP1 peg max port flow" VALUE 0x00149128 /* @ECU_Address@PPEG_CVP1_mdot_max@0x01010B78@ */ ECIPP_ALIGNMENT_UWORD 1024 Compu_PPEG_CVP1_mdot_max 0 1023.984375 /end CHARACTERISTIC
/begin COMPU_METHOD Compu_PPEG_CVP1_mdot_max " " RAT_FUNC "%.1" "g/sec" COEFFS 0 64 0 0 0 1 /end COMPU_METHOD
/begin CHARACTERISTIC PPEG_CVP1_Nmax "CVP1 peg engine speed" VALUE 0x0014912A /* @ECU_Address@PPEG_CVP1_Nmax@0x01010B80@ */ ECIPP_ALIGNMENT_UWORD 65535 Compu_PPEG_CVP1_Nmax 0 65535 /end CHARACTERISTIC
/begin COMPU_METHOD Compu_PPEG_CVP1_Nmax " " RAT_FUNC "%.0" "rpm" COEFFS 0 1 0 0 0 1 /end COMPU_METHOD
/begin CHARACTERISTIC PPEG_CVP1_EEstore "CVP1 peg EE restore{PPEG_CVP1_EEstore&0xff=0:Zero}{PPEG_CVP1_EEstore&0xff=1:Restore}" VALUE 0x0014912C /* @ECU_Address@PPEG_CVP1_EEstore@0x01010B88@ */ ECIPP_ALIGNMENT_UBYTE 255 PPEG_CVP1_EEstore_COMPU_VTAB 0 255 BIT_MASK 0xff /end CHARACTERISTIC
/begin COMPU_METHOD PPEG_CVP1_EEstore_COMPU_VTAB "Verbal Table" TAB_VERB "%.0" "list" COMPU_TAB_REF PPEG_CVP1_EEstore_COMPU_VTAB_REF /end COMPU_METHOD
/begin COMPU_VTAB PPEG_CVP1_EEstore_COMPU_VTAB_REF "Verbal Table" TAB_VERB 2 0 "Zero" 1 "Restore" DEFAULT_VALUE "UNKNOWN" /end COMPU_VTAB
/begin CHARACTERISTIC PPEG_CVP1_Pref_min "CVP1 peg ref P min" VALUE 0x0014912E /* @ECU_Address@PPEG_CVP1_Pref_min@0x01010B90@ */ ECIPP_ALIGNMENT_UWORD 256 Compu_PPEG_CVP1_Pref_min 0 255.99609375 /end CHARACTERISTIC
/begin COMPU_METHOD Compu_PPEG_CVP1_Pref_min " " RAT_FUNC "%.2" "psia" COEFFS 0 256 0 0 0 1 /end COMPU_METHOD
/begin CHARACTERISTIC PPEG_CVP1_Pref_max "CVP1 peg ref P max" VALUE 0x00149130 /* @ECU_Address@PPEG_CVP1_Pref_max@0x01010B98@ */ ECIPP_ALIGNMENT_UWORD 256 Compu_PPEG_CVP1_Pref_max 0 255.99609375 /end CHARACTERISTIC
/begin COMPU_METHOD Compu_PPEG_CVP1_Pref_max " " RAT_FUNC "%.2" "psia" COEFFS 0 256 0 0 0 1 /end COMPU_METHOD
/begin CHARACTERISTIC PPEG_CVP1_ofst_max "CVP1 peg max offset" VALUE 0x00149132 /* @ECU_Address@PPEG_CVP1_ofst_max@0x01010BA0@ */ ECIPP_ALIGNMENT_SWORD 128 Compu_PPEG_CVP1_ofst_max -128 127.99609375 /end CHARACTERISTIC
/begin COMPU_METHOD Compu_PPEG_CVP1_ofst_max " " RAT_FUNC "%.2" "psi" COEFFS 0 256 0 0 0 1 /end COMPU_METHOD
/begin MEASUREMENT PPEG_CVP1_offset "CVP1 peg offset" SWORD Compu_PPEG_CVP1_offset 0 0 -128 127.99609375 ECU_ADDRESS 0x01010BA8 /end MEASUREMENT
/begin COMPU_METHOD Compu_PPEG_CVP1_offset " " RAT_FUNC "%.2" "psi" COEFFS 0 256 0 0 0 1 /end COMPU_METHOD
/begin MEASUREMENT PPEG_CVP1_state "CVP1 peg state{PPEG_CVP1_state&0xff=0:Inactive}{PPEG_CVP1_state&0xff=1:Key-on wait}{PPEG_CVP1_state&0xff=2:Sampling}{PPEG_CVP1_state&0xff=3:Ref P high}{PPEG_CVP1_state&0xff=4:Ref P low}{PPEG_CVP1_state&0xff=5:Flow high}{PPEG_CVP1_state&0xff=6:RPM high}{PP" UBYTE PPEG_CVP1_state_COMPU_VTAB 0 0 0 255 ECU_ADDRESS 0x01010BB0 BIT_MASK 0xff /end MEASUREMENT
/begin COMPU_METHOD PPEG_CVP1_state_COMPU_VTAB "Verbal Table" TAB_VERB "%.0" "list" COMPU_TAB_REF PPEG_CVP1_state_COMPU_VTAB_REF /end COMPU_METHOD
/begin COMPU_VTAB PPEG_CVP1_state_COMPU_VTAB_REF "Verbal Table" TAB_VERB 20 0 "Inactive" 1 "Key-on wait" 2 "Sampling" 3 "Ref P high" 4 "Ref P low" 5 "Flow high" 6 "RPM high" 7 "Key cycle wait - start" 8 "Time elapsed" 9 "Invalid" 10 "Reserved - 10" 11 "Reserved - 11" 12 "Reserved - 12" 13 "Reserved - 13" 14 "Reserved - 14" 15 "Key cycle wait - end" 16 "ECT Low" 17 "Key-off clear" 18 "EGR de-icing" 19 "Possibly frozen" DEFAULT_VALUE "UNKNOWN" /end COMPU_VTAB
/begin CHARACTERISTIC PPEG_CVP2_enable "CVP2 peg offset{PPEG_CVP2_enable&0xff=0:Disabled}{PPEG_CVP2_enable&0xff=1:Enabled}" VALUE 0x00149134 /* @ECU_Address@PPEG_CVP2_enable@0x01010BB8@ */ ECIPP_ALIGNMENT_UBYTE 255 PPEG_CVP2_enable_COMPU_VTAB 0 255 BIT_MASK 0xff /end CHARACTERISTIC
/begin COMPU_METHOD PPEG_CVP2_enable_COMPU_VTAB "Verbal Table" TAB_VERB "%.0" "list" COMPU_TAB_REF PPEG_CVP2_enable_COMPU_VTAB_REF /end COMPU_METHOD
/begin COMPU_VTAB PPEG_CVP2_enable_COMPU_VTAB_REF "Verbal Table" TAB_VERB 2 0 "Disabled" 1 "Enabled" DEFAULT_VALUE "UNKNOWN" /end COMPU_VTAB
/begin CHARACTERISTIC PPEG_CVP2_keyon_wt "CVP2 peg key-on wait" VALUE 0x00149136 /* @ECU_Address@PPEG_CVP2_keyon_wt@0x01010BC0@ */ ECIPP_ALIGNMENT_UWORD 65535 Compu_PPEG_CVP2_keyon_wt 0 65535 /end CHARACTERISTIC
/begin COMPU_METHOD Compu_PPEG_CVP2_keyon_wt " " RAT_FUNC "%.0" "ms" COEFFS 0 1 0 0 0 1 /end COMPU_METHOD
/begin CHARACTERISTIC PPEG_CVP2_keyX_wt "CVP2 peg key-off wait" VALUE 0x00149138 /* @ECU_Address@PPEG_CVP2_keyX_wt@0x01010BC8@ */ ECIPP_ALIGNMENT_UWORD 65535 Compu_PPEG_CVP2_keyX_wt 0 65535 /end CHARACTERISTIC
/begin COMPU_METHOD Compu_PPEG_CVP2_keyX_wt " " RAT_FUNC "%.0" "ms" COEFFS 0 1 0 0 0 1 /end COMPU_METHOD
/begin CHARACTERISTIC PPEG_CVP2_ECT_ena "CVP2 peg ECT enable" VALUE 0x0014913A /* @ECU_Address@PPEG_CVP2_ECT_ena@0x01010BD0@ */ ECIPP_ALIGNMENT_UWORD 564 Compu_PPEG_CVP2_ECT_ena -460 563.984375 /end CHARACTERISTIC
/begin COMPU_METHOD Compu_PPEG_CVP2_ECT_ena " " RAT_FUNC "%.1" "deg F" COEFFS 0 64 29440 0 0 1 /end COMPU_METHOD
/begin CHARACTERISTIC PPEG_CVP2_valid_wt "CVP2 peg invalid reset" VALUE 0x0014913C /* @ECU_Address@PPEG_CVP2_valid_wt@0x01010BD8@ */ ECIPP_ALIGNMENT_UWORD 65535 Compu_PPEG_CVP2_valid_wt 0 65535 /end CHARACTERISTIC
/begin COMPU_METHOD Compu_PPEG_CVP2_valid_wt " " RAT_FUNC "%.0" "ms" COEFFS 0 1 0 0 0 1 /end COMPU_METHOD
/begin CHARACTERISTIC PPEG_CVP2_start_wt "CVP2 peg start inhibit" VALUE 0x0014913E /* @ECU_Address@PPEG_CVP2_start_wt@0x01010BE0@ */ ECIPP_ALIGNMENT_UWORD 65535 Compu_PPEG_CVP2_start_wt 0 65535 /end CHARACTERISTIC
/begin COMPU_METHOD Compu_PPEG_CVP2_start_wt " " RAT_FUNC "%.0" "ms" COEFFS 0 1 0 0 0 1 /end COMPU_METHOD
/begin CHARACTERISTIC PPEG_CVP2_tau "CVP2 peg low-pass" VALUE 0x00149140 /* @ECU_Address@PPEG_CVP2_tau@0x01010BE8@ */ ECIPP_ALIGNMENT_UWORD 163840 Compu_PPEG_CVP2_tau 0.16703 163840 /end CHARACTERISTIC
/begin COMPU_METHOD Compu_PPEG_CVP2_tau " " FORM "%.0" "ms"
 /begin FORMULA "-5 / log(1.0000000000001 - (X1 / 32768))" FORMULA_INV "(1.0000000000001 - exp(-5/X1)) * 32768" /end FORMULA
/end COMPU_METHOD
/begin CHARACTERISTIC PPEG_CVP2_mdot_max "CVP2 peg max port flow" VALUE 0x00149142 /* @ECU_Address@PPEG_CVP2_mdot_max@0x01010BF0@ */ ECIPP_ALIGNMENT_UWORD 1024 Compu_PPEG_CVP2_mdot_max 0 1023.984375 /end CHARACTERISTIC
/begin COMPU_METHOD Compu_PPEG_CVP2_mdot_max " " RAT_FUNC "%.1" "g/sec" COEFFS 0 64 0 0 0 1 /end COMPU_METHOD
/begin CHARACTERISTIC PPEG_CVP2_Nmax "CVP2 peg engine speed" VALUE 0x00149144 /* @ECU_Address@PPEG_CVP2_Nmax@0x01010BF8@ */ ECIPP_ALIGNMENT_UWORD 65535 Compu_PPEG_CVP2_Nmax 0 65535 /end CHARACTERISTIC
/begin COMPU_METHOD Compu_PPEG_CVP2_Nmax " " RAT_FUNC "%.0" "rpm" COEFFS 0 1 0 0 0 1 /end COMPU_METHOD
/begin CHARACTERISTIC PPEG_CVP2_EEstore "CVP2 peg EE restore{PPEG_CVP2_EEstore&0xff=0:Zero}{PPEG_CVP2_EEstore&0xff=1:Restore}" VALUE 0x00149146 /* @ECU_Address@PPEG_CVP2_EEstore@0x01010C00@ */ ECIPP_ALIGNMENT_UBYTE 255 PPEG_CVP2_EEstore_COMPU_VTAB 0 255 BIT_MASK 0xff /end CHARACTERISTIC
/begin COMPU_METHOD PPEG_CVP2_EEstore_COMPU_VTAB "Verbal Table" TAB_VERB "%.0" "list" COMPU_TAB_REF PPEG_CVP2_EEstore_COMPU_VTAB_REF /end COMPU_METHOD
/begin COMPU_VTAB PPEG_CVP2_EEstore_COMPU_VTAB_REF "Verbal Table" TAB_VERB 2 0 "Zero" 1 "Restore" DEFAULT_VALUE "UNKNOWN" /end COMPU_VTAB
/begin CHARACTERISTIC PPEG_CVP2_Pref_min "CVP2 peg ref P min" VALUE 0x00149148 /* @ECU_Address@PPEG_CVP2_Pref_min@0x01010C08@ */ ECIPP_ALIGNMENT_UWORD 256 Compu_PPEG_CVP2_Pref_min 0 255.99609375 /end CHARACTERISTIC
/begin COMPU_METHOD Compu_PPEG_CVP2_Pref_min " " RAT_FUNC "%.2" "psia" COEFFS 0 256 0 0 0 1 /end COMPU_METHOD
/begin CHARACTERISTIC PPEG_CVP2_Pref_max "CVP2 peg ref P max" VALUE 0x0014914A /* @ECU_Address@PPEG_CVP2_Pref_max@0x01010C10@ */ ECIPP_ALIGNMENT_UWORD 256 Compu_PPEG_CVP2_Pref_max 0 255.99609375 /end CHARACTERISTIC
/begin COMPU_METHOD Compu_PPEG_CVP2_Pref_max " " RAT_FUNC "%.2" "psia" COEFFS 0 256 0 0 0 1 /end COMPU_METHOD
/begin CHARACTERISTIC PPEG_CVP2_ofst_max "CVP2 peg max offset" VALUE 0x0014914C /* @ECU_Address@PPEG_CVP2_ofst_max@0x01010C18@ */ ECIPP_ALIGNMENT_SWORD 128 Compu_PPEG_CVP2_ofst_max -128 127.99609375 /end CHARACTERISTIC
/begin COMPU_METHOD Compu_PPEG_CVP2_ofst_max " " RAT_FUNC "%.2" "psi" COEFFS 0 256 0 0 0 1 /end COMPU_METHOD
/begin MEASUREMENT PPEG_CVP2_offset "CVP2 peg offset" SWORD Compu_PPEG_CVP2_offset 0 0 -128 127.99609375 ECU_ADDRESS 0x01010C20 /end MEASUREMENT
/begin COMPU_METHOD Compu_PPEG_CVP2_offset " " RAT_FUNC "%.2" "psi" COEFFS 0 256 0 0 0 1 /end COMPU_METHOD
/begin MEASUREMENT PPEG_CVP2_state "CVP2 peg state{PPEG_CVP2_state&0xff=0:Inactive}{PPEG_CVP2_state&0xff=1:Key-on wait}{PPEG_CVP2_state&0xff=2:Sampling}{PPEG_CVP2_state&0xff=3:Ref P high}{PPEG_CVP2_state&0xff=4:Ref P low}{PPEG_CVP2_state&0xff=5:Flow high}{PPEG_CVP2_state&0xff=6:RPM high}{PP" UBYTE PPEG_CVP2_state_COMPU_VTAB 0 0 0 255 ECU_ADDRESS 0x01010C28 BIT_MASK 0xff /end MEASUREMENT
/begin COMPU_METHOD PPEG_CVP2_state_COMPU_VTAB "Verbal Table" TAB_VERB "%.0" "list" COMPU_TAB_REF PPEG_CVP2_state_COMPU_VTAB_REF /end COMPU_METHOD
/begin COMPU_VTAB PPEG_CVP2_state_COMPU_VTAB_REF "Verbal Table" TAB_VERB 20 0 "Inactive" 1 "Key-on wait" 2 "Sampling" 3 "Ref P high" 4 "Ref P low" 5 "Flow high" 6 "RPM high" 7 "Key cycle wait - start" 8 "Time elapsed" 9 "Invalid" 10 "Reserved - 10" 11 "Reserved - 11" 12 "Reserved - 12" 13 "Reserved - 13" 14 "Reserved - 14" 15 "Key cycle wait - end" 16 "ECT Low" 17 "Key-off clear" 18 "EGR de-icing" 19 "Possibly frozen" DEFAULT_VALUE "UNKNOWN" /end COMPU_VTAB
/begin CHARACTERISTIC CVCSP_ena "CVCSP sensor input{CVCSP_ena&0xff=0:Disabled}{CVCSP_ena&0xff=1:Aux PD1}{CVCSP_ena&0xff=2:Aux PD2}{CVCSP_ena&0xff=3:Aux PD3}{CVCSP_ena&0xff=4:Aux PUD1}{CVCSP_ena&0xff=5:Aux PUD2}{CVCSP_ena&0xff=6:Aux PUD3}{CVCSP_ena&0xff=7:Aux PUD4}{CVCSP_ena&0xff=8:Aux PU" VALUE 0x00148CE4 /* @ECU_Address@CVCSP_ena@0x01010C40@ */ ECIPP_ALIGNMENT_UBYTE 255 CVCSP_ena_COMPU_VTAB 0 255 BIT_MASK 0xff /end CHARACTERISTIC
/begin COMPU_METHOD CVCSP_ena_COMPU_VTAB "Verbal Table" TAB_VERB "%.0" "list" COMPU_TAB_REF CVCSP_ena_COMPU_VTAB_REF /end COMPU_METHOD
/begin COMPU_VTAB CVCSP_ena_COMPU_VTAB_REF "Verbal Table" TAB_VERB 31 0 "Disabled" 1 "Aux PD1" 2 "Aux PD2" 3 "Aux PD3" 4 "Aux PUD1" 5 "Aux PUD2" 6 "Aux PUD3" 7 "Aux PUD4" 8 "Aux PUD5" 9 "Aux PUD6" 10 "Aux PUD7" 11 "Aux PUD8" 12 "Aux PUD9" 13 "Aux PUD10" 14 "Aux PUD11" 15 "Aux PUD12" 16 "Aux PUD13" 17 "Aux PUD14" 18 "Aux PUD15" 19 "CAN sourced" 20 "FPP2 Input" 21 "Aux PUD16" 22 "Aux PUD17" 23 "Aux PUD18" 24 "Aux PUD19" 25 "Aux PUD20" 26 "Aux PUD21" 27 "Aux PUD22" 28 "Aux PUD23" 29 "Aux PUD24" 30 "Aux PUD25" DEFAULT_VALUE "UNKNOWN" /end COMPU_VTAB
/begin CHARACTERISTIC CVCSP_tau "CVCSP raw low-pass" VALUE 0x00148CE8 /* @ECU_Address@CVCSP_tau@0x01010C50@ */ ECIPP_ALIGNMENT_UWORD 163840 Compu_CVCSP_tau 0.16703 163840 /end CHARACTERISTIC
/begin COMPU_METHOD Compu_CVCSP_tau " " FORM "%.0" "ms"
 /begin FORMULA "-5 / log(1.0000000000001 - (X1 / 32768))" FORMULA_INV "(1.0000000000001 - exp(-5/X1)) * 32768" /end FORMULA
/end COMPU_METHOD
/begin CHARACTERISTIC CVCSP_type "CVCSP type{CVCSP_type&0xff=0:Absolute}{CVCSP_type&0xff=1:Differential}" VALUE 0x00148CE6 /* @ECU_Address@CVCSP_type@0x01010C58@ */ ECIPP_ALIGNMENT_UBYTE 255 CVCSP_type_COMPU_VTAB 0 255 BIT_MASK 0xff /end CHARACTERISTIC
/begin COMPU_METHOD CVCSP_type_COMPU_VTAB "Verbal Table" TAB_VERB "%.0" "list" COMPU_TAB_REF CVCSP_type_COMPU_VTAB_REF /end COMPU_METHOD
/begin COMPU_VTAB CVCSP_type_COMPU_VTAB_REF "Verbal Table" TAB_VERB 2 0 "Absolute" 1 "Differential" DEFAULT_VALUE "UNKNOWN" /end COMPU_VTAB
/begin CHARACTERISTIC CVDSP_ena "CVDSP sensor input{CVDSP_ena&0xff=0:Disabled}{CVDSP_ena&0xff=1:Aux PD1}{CVDSP_ena&0xff=2:Aux PD2}{CVDSP_ena&0xff=3:Aux PD3}{CVDSP_ena&0xff=4:Aux PUD1}{CVDSP_ena&0xff=5:Aux PUD2}{CVDSP_ena&0xff=6:Aux PUD3}{CVDSP_ena&0xff=7:Aux PUD4}{CVDSP_ena&0xff=8:Aux PU" VALUE 0x00148CEA /* @ECU_Address@CVDSP_ena@0x01010C60@ */ ECIPP_ALIGNMENT_UBYTE 255 CVDSP_ena_COMPU_VTAB 0 255 BIT_MASK 0xff /end CHARACTERISTIC
/begin COMPU_METHOD CVDSP_ena_COMPU_VTAB "Verbal Table" TAB_VERB "%.0" "list" COMPU_TAB_REF CVDSP_ena_COMPU_VTAB_REF /end COMPU_METHOD
/begin COMPU_VTAB CVDSP_ena_COMPU_VTAB_REF "Verbal Table" TAB_VERB 31 0 "Disabled" 1 "Aux PD1" 2 "Aux PD2" 3 "Aux PD3" 4 "Aux PUD1" 5 "Aux PUD2" 6 "Aux PUD3" 7 "Aux PUD4" 8 "Aux PUD5" 9 "Aux PUD6" 10 "Aux PUD7" 11 "Aux PUD8" 12 "Aux PUD9" 13 "Aux PUD10" 14 "Aux PUD11" 15 "Aux PUD12" 16 "Aux PUD13" 17 "Aux PUD14" 18 "Aux PUD15" 19 "CAN sourced" 20 "FPP2 Input" 21 "Aux PUD16" 22 "Aux PUD17" 23 "Aux PUD18" 24 "Aux PUD19" 25 "Aux PUD20" 26 "Aux PUD21" 27 "Aux PUD22" 28 "Aux PUD23" 29 "Aux PUD24" 30 "Aux PUD25" DEFAULT_VALUE "UNKNOWN" /end COMPU_VTAB
/begin CHARACTERISTIC CVDSP_tau "CVDSP raw low-pass" VALUE 0x00148CEE /* @ECU_Address@CVDSP_tau@0x01010C70@ */ ECIPP_ALIGNMENT_UWORD 163840 Compu_CVDSP_tau 0.16703 163840 /end CHARACTERISTIC
/begin COMPU_METHOD Compu_CVDSP_tau " " FORM "%.0" "ms"
 /begin FORMULA "-5 / log(1.0000000000001 - (X1 / 32768))" FORMULA_INV "(1.0000000000001 - exp(-5/X1)) * 32768" /end FORMULA
/end COMPU_METHOD
/begin CHARACTERISTIC CVDSP_type "CVDSP type{CVDSP_type&0xff=0:Absolute}{CVDSP_type&0xff=1:Differential}" VALUE 0x00148CEC /* @ECU_Address@CVDSP_type@0x01010C78@ */ ECIPP_ALIGNMENT_UBYTE 255 CVDSP_type_COMPU_VTAB 0 255 BIT_MASK 0xff /end CHARACTERISTIC
/begin COMPU_METHOD CVDSP_type_COMPU_VTAB "Verbal Table" TAB_VERB "%.0" "list" COMPU_TAB_REF CVDSP_type_COMPU_VTAB_REF /end COMPU_METHOD
/begin COMPU_VTAB CVDSP_type_COMPU_VTAB_REF "Verbal Table" TAB_VERB 2 0 "Absolute" 1 "Differential" DEFAULT_VALUE "UNKNOWN" /end COMPU_VTAB
/begin CHARACTERISTIC CVPAUX1_ena "CVPAUX1 sensor input{CVPAUX1_ena&0xff=0:Disabled}{CVPAUX1_ena&0xff=1:Aux PD1}{CVPAUX1_ena&0xff=2:Aux PD2}{CVPAUX1_ena&0xff=3:Aux PD3}{CVPAUX1_ena&0xff=4:Aux PUD1}{CVPAUX1_ena&0xff=5:Aux PUD2}{CVPAUX1_ena&0xff=6:Aux PUD3}{CVPAUX1_ena&0xff=7:Aux PUD4}{CVPAU" VALUE 0x00148CF0 /* @ECU_Address@CVPAUX1_ena@0x01010C80@ */ ECIPP_ALIGNMENT_UBYTE 255 CVPAUX1_ena_COMPU_VTAB 0 255 BIT_MASK 0xff /end CHARACTERISTIC
/begin COMPU_METHOD CVPAUX1_ena_COMPU_VTAB "Verbal Table" TAB_VERB "%.0" "list" COMPU_TAB_REF CVPAUX1_ena_COMPU_VTAB_REF /end COMPU_METHOD
/begin COMPU_VTAB CVPAUX1_ena_COMPU_VTAB_REF "Verbal Table" TAB_VERB 31 0 "Disabled" 1 "Aux PD1" 2 "Aux PD2" 3 "Aux PD3" 4 "Aux PUD1" 5 "Aux PUD2" 6 "Aux PUD3" 7 "Aux PUD4" 8 "Aux PUD5" 9 "Aux PUD6" 10 "Aux PUD7" 11 "Aux PUD8" 12 "Aux PUD9" 13 "Aux PUD10" 14 "Aux PUD11" 15 "Aux PUD12" 16 "Aux PUD13" 17 "Aux PUD14" 18 "Aux PUD15" 19 "CAN sourced" 20 "FPP2 Input" 21 "Aux PUD16" 22 "Aux PUD17" 23 "Aux PUD18" 24 "Aux PUD19" 25 "Aux PUD20" 26 "Aux PUD21" 27 "Aux PUD22" 28 "Aux PUD23" 29 "Aux PUD24" 30 "Aux PUD25" DEFAULT_VALUE "UNKNOWN" /end COMPU_VTAB
/begin CHARACTERISTIC CVPAUX1_tau "CVPAUX1 raw low-pass" VALUE 0x00148CF4 /* @ECU_Address@CVPAUX1_tau@0x01010C90@ */ ECIPP_ALIGNMENT_UWORD 163840 Compu_CVPAUX1_tau 0.16703 163840 /end CHARACTERISTIC
/begin COMPU_METHOD Compu_CVPAUX1_tau " " FORM "%.0" "ms"
 /begin FORMULA "-5 / log(1.0000000000001 - (X1 / 32768))" FORMULA_INV "(1.0000000000001 - exp(-5/X1)) * 32768" /end FORMULA
/end COMPU_METHOD
/begin CHARACTERISTIC CVPAUX1_type "CVPAUX1 type{CVPAUX1_type&0xff=0:Absolute}{CVPAUX1_type&0xff=1:Differential}" VALUE 0x00148CF2 /* @ECU_Address@CVPAUX1_type@0x01010C98@ */ ECIPP_ALIGNMENT_UBYTE 255 CVPAUX1_type_COMPU_VTAB 0 255 BIT_MASK 0xff /end CHARACTERISTIC
/begin COMPU_METHOD CVPAUX1_type_COMPU_VTAB "Verbal Table" TAB_VERB "%.0" "list" COMPU_TAB_REF CVPAUX1_type_COMPU_VTAB_REF /end COMPU_METHOD
/begin COMPU_VTAB CVPAUX1_type_COMPU_VTAB_REF "Verbal Table" TAB_VERB 2 0 "Absolute" 1 "Differential" DEFAULT_VALUE "UNKNOWN" /end COMPU_VTAB
/begin CHARACTERISTIC CVPAUX2_ena "CVPAUX2 sensor input{CVPAUX2_ena&0xff=0:Disabled}{CVPAUX2_ena&0xff=1:Aux PD1}{CVPAUX2_ena&0xff=2:Aux PD2}{CVPAUX2_ena&0xff=3:Aux PD3}{CVPAUX2_ena&0xff=4:Aux PUD1}{CVPAUX2_ena&0xff=5:Aux PUD2}{CVPAUX2_ena&0xff=6:Aux PUD3}{CVPAUX2_ena&0xff=7:Aux PUD4}{CVPAU" VALUE 0x00148CF6 /* @ECU_Address@CVPAUX2_ena@0x01010CA0@ */ ECIPP_ALIGNMENT_UBYTE 255 CVPAUX2_ena_COMPU_VTAB 0 255 BIT_MASK 0xff /end CHARACTERISTIC
/begin COMPU_METHOD CVPAUX2_ena_COMPU_VTAB "Verbal Table" TAB_VERB "%.0" "list" COMPU_TAB_REF CVPAUX2_ena_COMPU_VTAB_REF /end COMPU_METHOD
/begin COMPU_VTAB CVPAUX2_ena_COMPU_VTAB_REF "Verbal Table" TAB_VERB 31 0 "Disabled" 1 "Aux PD1" 2 "Aux PD2" 3 "Aux PD3" 4 "Aux PUD1" 5 "Aux PUD2" 6 "Aux PUD3" 7 "Aux PUD4" 8 "Aux PUD5" 9 "Aux PUD6" 10 "Aux PUD7" 11 "Aux PUD8" 12 "Aux PUD9" 13 "Aux PUD10" 14 "Aux PUD11" 15 "Aux PUD12" 16 "Aux PUD13" 17 "Aux PUD14" 18 "Aux PUD15" 19 "CAN sourced" 20 "FPP2 Input" 21 "Aux PUD16" 22 "Aux PUD17" 23 "Aux PUD18" 24 "Aux PUD19" 25 "Aux PUD20" 26 "Aux PUD21" 27 "Aux PUD22" 28 "Aux PUD23" 29 "Aux PUD24" 30 "Aux PUD25" DEFAULT_VALUE "UNKNOWN" /end COMPU_VTAB
/begin CHARACTERISTIC CVPAUX2_tau "CVPAUX2 raw low-pass" VALUE 0x00148CFA /* @ECU_Address@CVPAUX2_tau@0x01010CB0@ */ ECIPP_ALIGNMENT_UWORD 163840 Compu_CVPAUX2_tau 0.16703 163840 /end CHARACTERISTIC
/begin COMPU_METHOD Compu_CVPAUX2_tau " " FORM "%.0" "ms"
 /begin FORMULA "-5 / log(1.0000000000001 - (X1 / 32768))" FORMULA_INV "(1.0000000000001 - exp(-5/X1)) * 32768" /end FORMULA
/end COMPU_METHOD
/begin CHARACTERISTIC CVPAUX2_type "CVPAUX2 type{CVPAUX2_type&0xff=0:Absolute}{CVPAUX2_type&0xff=1:Differential}" VALUE 0x00148CF8 /* @ECU_Address@CVPAUX2_type@0x01010CB8@ */ ECIPP_ALIGNMENT_UBYTE 255 CVPAUX2_type_COMPU_VTAB 0 255 BIT_MASK 0xff /end CHARACTERISTIC
/begin COMPU_METHOD CVPAUX2_type_COMPU_VTAB "Verbal Table" TAB_VERB "%.0" "list" COMPU_TAB_REF CVPAUX2_type_COMPU_VTAB_REF /end COMPU_METHOD
/begin COMPU_VTAB CVPAUX2_type_COMPU_VTAB_REF "Verbal Table" TAB_VERB 2 0 "Absolute" 1 "Differential" DEFAULT_VALUE "UNKNOWN" /end COMPU_VTAB
/begin MEASUREMENT CVP1 "CVP1" SWORD Compu_CVP1 0 0 -32 31.9990234375 ECU_ADDRESS 0x01010CD0 /end MEASUREMENT
/begin COMPU_METHOD Compu_CVP1 " " RAT_FUNC "%.4" "psia" COEFFS 0 1024 0 0 0 1 /end COMPU_METHOD
/begin MEASUREMENT CVP1_raw "CVP1 raw" SWORD Compu_CVP1_raw 0 0 -32 31.9990234375 ECU_ADDRESS 0x01010CD8 /end MEASUREMENT
/begin COMPU_METHOD Compu_CVP1_raw " " RAT_FUNC "%.4" "psia" COEFFS 0 1024 0 0 0 1 /end COMPU_METHOD
/begin MEASUREMENT CVP1_location "CVP1 location{CVP1_location&0xff=0:None}{CVP1_location&0xff=1:Clean Side}{CVP1_location&0xff=2:Dirty Side}{CVP1_location&0xff=3:Aux 1 pressure}{CVP1_location&0xff=4:Aux 2 pressure}" UBYTE CVP1_location_COMPU_VTAB 0 0 0 255 ECU_ADDRESS 0x01010CE8 BIT_MASK 0xff /end MEASUREMENT
/begin COMPU_METHOD CVP1_location_COMPU_VTAB "Verbal Table" TAB_VERB "%.0" "list" COMPU_TAB_REF CVP1_location_COMPU_VTAB_REF /end COMPU_METHOD
/begin COMPU_VTAB CVP1_location_COMPU_VTAB_REF "Verbal Table" TAB_VERB 5 0 "None" 1 "Clean Side" 2 "Dirty Side" 3 "Aux 1 pressure" 4 "Aux 2 pressure" DEFAULT_VALUE "UNKNOWN" /end COMPU_VTAB
/begin MEASUREMENT CVP2 "CVP2" SWORD Compu_CVP2 0 0 -32 31.9990234375 ECU_ADDRESS 0x01010CF0 /end MEASUREMENT
/begin COMPU_METHOD Compu_CVP2 " " RAT_FUNC "%.4" "psia" COEFFS 0 1024 0 0 0 1 /end COMPU_METHOD
/begin MEASUREMENT CVP2_raw "CVP2 raw" SWORD Compu_CVP2_raw 0 0 -32 31.9990234375 ECU_ADDRESS 0x01010CF8 /end MEASUREMENT
/begin COMPU_METHOD Compu_CVP2_raw " " RAT_FUNC "%.4" "psia" COEFFS 0 1024 0 0 0 1 /end COMPU_METHOD
/begin MEASUREMENT CVP2_location "CVP2 location{CVP2_location&0xff=0:None}{CVP2_location&0xff=1:Clean Side}{CVP2_location&0xff=2:Dirty Side}{CVP2_location&0xff=3:Aux 1 pressure}{CVP2_location&0xff=4:Aux 2 pressure}" UBYTE CVP2_location_COMPU_VTAB 0 0 0 255 ECU_ADDRESS 0x01010D08 BIT_MASK 0xff /end MEASUREMENT
/begin COMPU_METHOD CVP2_location_COMPU_VTAB "Verbal Table" TAB_VERB "%.0" "list" COMPU_TAB_REF CVP2_location_COMPU_VTAB_REF /end COMPU_METHOD
/begin COMPU_VTAB CVP2_location_COMPU_VTAB_REF "Verbal Table" TAB_VERB 5 0 "None" 1 "Clean Side" 2 "Dirty Side" 3 "Aux 1 pressure" 4 "Aux 2 pressure" DEFAULT_VALUE "UNKNOWN" /end COMPU_VTAB
/begin MEASUREMENT accel_flt "Filtered crankshaft acceleration" SWORD Compu_accel_flt 0 0 -32768 32767 ECU_ADDRESS 0x01010D50 /end MEASUREMENT
/begin COMPU_METHOD Compu_accel_flt " " RAT_FUNC "%.0" "rpm/s" COEFFS 0 1 0 0 0 1 /end COMPU_METHOD
/begin CHARACTERISTIC accel_flt_thd "Engine sync crankshaft accel thld" VALUE 0x0014658c /* @ECU_Address@accel_flt_thd@0x01010D58@ */ ECIPP_ALIGNMENT_SWORD 32767 Compu_accel_flt_thd -32768 32767 /end CHARACTERISTIC
/begin COMPU_METHOD Compu_accel_flt_thd " " RAT_FUNC "%.0" "rpm/s" COEFFS 0 1 0 0 0 1 /end COMPU_METHOD
/begin CHARACTERISTIC key_off_clr_EGR_V "Key-off clear EGR close" VALUE 0x00147b4a /* @ECU_Address@key_off_clr_EGR_V@0x01010EC0@ */ ECIPP_ALIGNMENT_UWORD 5 Compu_key_off_clr_EGR_V 0 5.00114468864469 /end CHARACTERISTIC
/begin COMPU_METHOD Compu_key_off_clr_EGR_V " " RAT_FUNC "%.2" "volts" COEFFS 0 13104 0 0 0 1 /end COMPU_METHOD
/begin CHARACTERISTIC key_off_clr_EGR_DC "Key-off clear EGR zero DC" VALUE 0x00146674 /* @ECU_Address@key_off_clr_EGR_DC@0x01010EC8@ */ ECIPP_ALIGNMENT_SWORD 100 Compu_key_off_clr_EGR_DC -100 99.9969482421875 /end CHARACTERISTIC
/begin COMPU_METHOD Compu_key_off_clr_EGR_DC " " RAT_FUNC "%.1" "%" COEFFS 0 327.68 0 0 0 1 /end COMPU_METHOD
/begin CHARACTERISTIC swap_crank_cam "Crank-cam input swap{swap_crank_cam&0xff=0:NO}{swap_crank_cam&0xff=1:YES}" VALUE 0x001481bd /* @ECU_Address@swap_crank_cam@0x01011928@ */ ECIPP_ALIGNMENT_UBYTE 255 swap_crank_cam_COMPU_VTAB 0 255 BIT_MASK 0xff /end CHARACTERISTIC
/begin COMPU_METHOD swap_crank_cam_COMPU_VTAB "Verbal Table" TAB_VERB "%.0" "list" COMPU_TAB_REF swap_crank_cam_COMPU_VTAB_REF /end COMPU_METHOD
/begin COMPU_VTAB swap_crank_cam_COMPU_VTAB_REF "Verbal Table" TAB_VERB 2 0 "NO" 1 "YES" DEFAULT_VALUE "UNKNOWN" /end COMPU_VTAB
/begin CHARACTERISTIC TPS_learn_ena "Key-off learn TPS idle/full{TPS_learn_ena&0xff=0:Disabled}{TPS_learn_ena&0xff=1:Enabled}" VALUE 0x001480a9 /* @ECU_Address@TPS_learn_ena@0x01011938@ */ ECIPP_ALIGNMENT_UBYTE 255 TPS_learn_ena_COMPU_VTAB 0 255 BIT_MASK 0xff /end CHARACTERISTIC
/begin COMPU_METHOD TPS_learn_ena_COMPU_VTAB "Verbal Table" TAB_VERB "%.0" "list" COMPU_TAB_REF TPS_learn_ena_COMPU_VTAB_REF /end COMPU_METHOD
/begin COMPU_VTAB TPS_learn_ena_COMPU_VTAB_REF "Verbal Table" TAB_VERB 2 0 "Disabled" 1 "Enabled" DEFAULT_VALUE "UNKNOWN" /end COMPU_VTAB
/begin CHARACTERISTIC key_off_clr_EGR_ena "Key-off clear/zero EGR{key_off_clr_EGR_ena&0xff=0:Disabled}{key_off_clr_EGR_ena&0xff=1:Enabled}" VALUE 0x001481a1 /* @ECU_Address@key_off_clr_EGR_ena@0x01011940@ */ ECIPP_ALIGNMENT_UBYTE 255 key_off_clr_EGR_ena_COMPU_VTAB 0 255 BIT_MASK 0xff /end CHARACTERISTIC
/begin COMPU_METHOD key_off_clr_EGR_ena_COMPU_VTAB "Verbal Table" TAB_VERB "%.0" "list" COMPU_TAB_REF key_off_clr_EGR_ena_COMPU_VTAB_REF /end COMPU_METHOD
/begin COMPU_VTAB key_off_clr_EGR_ena_COMPU_VTAB_REF "Verbal Table" TAB_VERB 2 0 "Disabled" 1 "Enabled" DEFAULT_VALUE "UNKNOWN" /end COMPU_VTAB
/begin CHARACTERISTIC TPS_learn_cmd_init "Key-off learn TPS init" VALUE 0x001478dc /* @ECU_Address@TPS_learn_cmd_init@0x01011948@ */ ECIPP_ALIGNMENT_UWORD 100 Compu_TPS_learn_cmd_init 0 99.9984741210938 /end CHARACTERISTIC
/begin COMPU_METHOD Compu_TPS_learn_cmd_init " " RAT_FUNC "%.1" "%" COEFFS 0 655.36 0 0 0 1 /end COMPU_METHOD
/begin CHARACTERISTIC TPS_learn_cmd_slew "Key-off learn TPS slew" VALUE 0x001478de /* @ECU_Address@TPS_learn_cmd_slew@0x01011950@ */ ECIPP_ALIGNMENT_UWORD 20000 Compu_TPS_learn_cmd_slew 0 19999.6948242188 /end CHARACTERISTIC
/begin COMPU_METHOD Compu_TPS_learn_cmd_slew " " RAT_FUNC "%.1" "%/sec" COEFFS 0 3.2768 0 0 0 1 /end COMPU_METHOD
/begin MEASUREMENT crank_cnt_diag_crk "crank_cnt_diag_crk" UWORD Compu_crank_cnt_diag_crk 0 0 0 65535 ECU_ADDRESS 0x01012080 /end MEASUREMENT
/begin COMPU_METHOD Compu_crank_cnt_diag_crk " " RAT_FUNC "%.0" "events" COEFFS 0 1 0 0 0 1 /end COMPU_METHOD
/begin MEASUREMENT Ecrank_cnt_diag_crk "Ecrank_cnt_diag_crk" UWORD Compu_Ecrank_cnt_diag_crk 0 0 0 65535 ECU_ADDRESS 0x01012098 /end MEASUREMENT
/begin COMPU_METHOD Compu_Ecrank_cnt_diag_crk " " RAT_FUNC "%.0" "events" COEFFS 0 1 0 0 0 1 /end COMPU_METHOD
/begin CHARACTERISTIC EV_AAT_mdp_dTrg "Port flow - total - delta trig (Fault Condition:Change in total port flow >)" VALUE 0x0014683a /* @ECU_Address@EV_AAT_mdp_dTrg@0x010121A0@ */ ECIPP_ALIGNMENT_UWORD 100 Compu_EV_AAT_mdp_dTrg 0 99.9984741210938 /end CHARACTERISTIC
/begin COMPU_METHOD Compu_EV_AAT_mdp_dTrg " " RAT_FUNC "%.1" "%" COEFFS 0 655.36 0 0 0 1 /end COMPU_METHOD
/begin MEASUREMENT EV_AAT_mdp_trig "AAT rationality triggered{EV_AAT_mdp_trig&0xff=0:No}{EV_AAT_mdp_trig&0xff=1:Yes}" UBYTE EV_AAT_mdp_trig_COMPU_VTAB 0 0 0 255 ECU_ADDRESS 0x010121A8 BIT_MASK 0xff /end MEASUREMENT
/begin COMPU_METHOD EV_AAT_mdp_trig_COMPU_VTAB "Verbal Table" TAB_VERB "%.0" "list" COMPU_TAB_REF EV_AAT_mdp_trig_COMPU_VTAB_REF /end COMPU_METHOD
/begin COMPU_VTAB EV_AAT_mdp_trig_COMPU_VTAB_REF "Verbal Table" TAB_VERB 2 0 "No" 1 "Yes" DEFAULT_VALUE "UNKNOWN" /end COMPU_VTAB
/begin MEASUREMENT EV_AAT_mdp_dAct "Port flow - total - delta act" UWORD Compu_EV_AAT_mdp_dAct 0 0 0 99.9984741210938 ECU_ADDRESS 0x010121B0 /end MEASUREMENT
/begin COMPU_METHOD Compu_EV_AAT_mdp_dAct " " RAT_FUNC "%.1" "%" COEFFS 0 655.36 0 0 0 1 /end COMPU_METHOD
/begin MEASUREMENT RMT_BP "Remote BP" UWORD Compu_RMT_BP 0 0 0 255.99609375 ECU_ADDRESS 0x010121B8 /end MEASUREMENT
/begin COMPU_METHOD Compu_RMT_BP " " RAT_FUNC "%.2" "psia" COEFFS 0 256 0 0 0 1 /end COMPU_METHOD
/begin MEASUREMENT EV_AAT_at_fault_def "AAT at fault default{EV_AAT_at_fault_def&0xff=0:No}{EV_AAT_at_fault_def&0xff=1:Yes}" UBYTE EV_AAT_at_fault_def_COMPU_VTAB 0 0 0 255 ECU_ADDRESS 0x010121C0 BIT_MASK 0xff /end MEASUREMENT
/begin COMPU_METHOD EV_AAT_at_fault_def_COMPU_VTAB "Verbal Table" TAB_VERB "%.0" "list" COMPU_TAB_REF EV_AAT_at_fault_def_COMPU_VTAB_REF /end COMPU_METHOD
/begin COMPU_VTAB EV_AAT_at_fault_def_COMPU_VTAB_REF "Verbal Table" TAB_VERB 2 0 "No" 1 "Yes" DEFAULT_VALUE "UNKNOWN" /end COMPU_VTAB
/begin MEASUREMENT EV_comm_active "Envirotech comm active{EV_comm_active&0xff=0:No}{EV_comm_active&0xff=1:Yes}" UBYTE EV_comm_active_COMPU_VTAB 0 0 0 255 ECU_ADDRESS 0x010121C8 BIT_MASK 0xff /end MEASUREMENT
/begin COMPU_METHOD EV_comm_active_COMPU_VTAB "Verbal Table" TAB_VERB "%.0" "list" COMPU_TAB_REF EV_comm_active_COMPU_VTAB_REF /end COMPU_METHOD
/begin COMPU_VTAB EV_comm_active_COMPU_VTAB_REF "Verbal Table" TAB_VERB 2 0 "No" 1 "Yes" DEFAULT_VALUE "UNKNOWN" /end COMPU_VTAB
/begin MEASUREMENT RMT_SH "Remote SH" UBYTE Compu_RMT_SH 0 0 0 62.255859375 ECU_ADDRESS 0x010121D0 /end MEASUREMENT
/begin COMPU_METHOD Compu_RMT_SH " " RAT_FUNC "%.1" "g/kg" COEFFS 0 4.096 0 0 0 1 /end COMPU_METHOD
/begin MEASUREMENT RMT_RH "Remote RH" UBYTE Compu_RMT_RH 0 0 0 99.609375 ECU_ADDRESS 0x010121D8 /end MEASUREMENT
/begin COMPU_METHOD Compu_RMT_RH " " RAT_FUNC "%.1" "%" COEFFS 0 2.56 0 0 0 1 /end COMPU_METHOD
/begin MEASUREMENT EV_version "Envirotech version{EV_version&0xff=0:Unavailable}{EV_version&0xff=1:SPN not allowed}{EV_version&0xff=2:Envirotech 2 (HC08)}{EV_version&0xff=3:Envirotech 3 (RH850)}" UBYTE EV_version_COMPU_VTAB 0 0 0 255 ECU_ADDRESS 0x010121E0 BIT_MASK 0xff /end MEASUREMENT
/begin COMPU_METHOD EV_version_COMPU_VTAB "Verbal Table" TAB_VERB "%.0" "list" COMPU_TAB_REF EV_version_COMPU_VTAB_REF /end COMPU_METHOD
/begin COMPU_VTAB EV_version_COMPU_VTAB_REF "Verbal Table" TAB_VERB 4 0 "Unavailable" 1 "SPN not allowed" 2 "Envirotech 2 (HC08)" 3 "Envirotech 3 (RH850)" DEFAULT_VALUE "UNKNOWN" /end COMPU_VTAB
/begin MEASUREMENT EV_RH_AAT_avg "AAT - LP" FLOAT32_IEEE Compu_EV_RH_AAT_avg 0 0 -10000000000 10000000000 ECU_ADDRESS 0x010121E8 /end MEASUREMENT
/begin COMPU_METHOD Compu_EV_RH_AAT_avg " " RAT_FUNC "%.1" "deg F" COEFFS 0 1 459.67 0 0 1 /end COMPU_METHOD
/begin CHARACTERISTIC EV_RH_AAT_tau "AAT - LP tau (Fault Condition:using AAT low pass of)" VALUE 0x001439a0 /* @ECU_Address@EV_RH_AAT_tau@0x010121F0@ */ ECIPP_ALIGNMENT_FLOAT32_IEEE 10000000000 Compu_EV_RH_AAT_tau -10000000000 10000000000 /end CHARACTERISTIC
/begin COMPU_METHOD Compu_EV_RH_AAT_tau " " RAT_FUNC "%.1" "seconds" COEFFS 0 1000 0 0 0 1 /end COMPU_METHOD
/begin CHARACTERISTIC EV_RH_AAT_dTrg "AAT - delta trig (Fault Condition:Change in AAT >)" VALUE 0x0014683c /* @ECU_Address@EV_RH_AAT_dTrg@0x010121F8@ */ ECIPP_ALIGNMENT_UWORD 1024 Compu_EV_RH_AAT_dTrg 0 1023.984375 /end CHARACTERISTIC
/begin COMPU_METHOD Compu_EV_RH_AAT_dTrg " " RAT_FUNC "%.1" "deg F" COEFFS 0 64 0 0 0 1 /end COMPU_METHOD
/begin MEASUREMENT EV_RH_AAT_trig "RH rationality triggered{EV_RH_AAT_trig&0xff=0:No}{EV_RH_AAT_trig&0xff=1:Yes}" UBYTE EV_RH_AAT_trig_COMPU_VTAB 0 0 0 255 ECU_ADDRESS 0x01012200 BIT_MASK 0xff /end MEASUREMENT
/begin COMPU_METHOD EV_RH_AAT_trig_COMPU_VTAB "Verbal Table" TAB_VERB "%.0" "list" COMPU_TAB_REF EV_RH_AAT_trig_COMPU_VTAB_REF /end COMPU_METHOD
/begin COMPU_VTAB EV_RH_AAT_trig_COMPU_VTAB_REF "Verbal Table" TAB_VERB 2 0 "No" 1 "Yes" DEFAULT_VALUE "UNKNOWN" /end COMPU_VTAB
/begin MEASUREMENT EV_RH_AAT_dAct "AAT - delta act" UWORD Compu_EV_RH_AAT_dAct 0 0 0 1023.984375 ECU_ADDRESS 0x01012208 /end MEASUREMENT
/begin COMPU_METHOD Compu_EV_RH_AAT_dAct " " RAT_FUNC "%.1" "deg F" COEFFS 0 64 0 0 0 1 /end COMPU_METHOD
/begin MEASUREMENT EV_RH_at_fault_def "RH at fault default{EV_RH_at_fault_def&0xff=0:No}{EV_RH_at_fault_def&0xff=1:Yes}" UBYTE EV_RH_at_fault_def_COMPU_VTAB 0 0 0 255 ECU_ADDRESS 0x01012210 BIT_MASK 0xff /end MEASUREMENT
/begin COMPU_METHOD EV_RH_at_fault_def_COMPU_VTAB "Verbal Table" TAB_VERB "%.0" "list" COMPU_TAB_REF EV_RH_at_fault_def_COMPU_VTAB_REF /end COMPU_METHOD
/begin COMPU_VTAB EV_RH_at_fault_def_COMPU_VTAB_REF "Verbal Table" TAB_VERB 2 0 "No" 1 "Yes" DEFAULT_VALUE "UNKNOWN" /end COMPU_VTAB
/begin MEASUREMENT EV_RH_faulted_SH "SH when faulted" UBYTE Compu_EV_RH_faulted_SH 0 0 0 62.255859375 ECU_ADDRESS 0x01012218 /end MEASUREMENT
/begin COMPU_METHOD Compu_EV_RH_faulted_SH " " RAT_FUNC "%.1" "g/kg" COEFFS 0 4.096 0 0 0 1 /end COMPU_METHOD
/begin CHARACTERISTIC EV_RH_max_SH "Maximum SH (Fault Condition:Specific humidity (SH) >)" VALUE 0x00147d43 /* @ECU_Address@EV_RH_max_SH@0x01012220@ */ ECIPP_ALIGNMENT_UBYTE 62 Compu_EV_RH_max_SH 0 62.255859375 /end CHARACTERISTIC
/begin COMPU_METHOD Compu_EV_RH_max_SH " " RAT_FUNC "%.1" "g/kg" COEFFS 0 4.096 0 0 0 1 /end COMPU_METHOD
/begin MEASUREMENT EV_RH_near_zero_SH "SH near zero" UBYTE Compu_EV_RH_near_zero_SH 0 0 0 62.255859375 ECU_ADDRESS 0x01012228 /end MEASUREMENT
/begin COMPU_METHOD Compu_EV_RH_near_zero_SH " " RAT_FUNC "%.1" "g/kg" COEFFS 0 4.096 0 0 0 1 /end COMPU_METHOD
/begin MEASUREMENT EV_RH_unstable_SH "SH when unstable" UBYTE Compu_EV_RH_unstable_SH 0 0 0 62.255859375 ECU_ADDRESS 0x01012230 /end MEASUREMENT
/begin COMPU_METHOD Compu_EV_RH_unstable_SH " " RAT_FUNC "%.1" "g/kg" COEFFS 0 4.096 0 0 0 1 /end COMPU_METHOD
/begin MEASUREMENT EV_RH_near_zero "RH near zero{EV_RH_near_zero&0xff=0:No}{EV_RH_near_zero&0xff=1:Yes}" UBYTE EV_RH_near_zero_COMPU_VTAB 0 0 0 255 ECU_ADDRESS 0x01012238 BIT_MASK 0xff /end MEASUREMENT
/begin COMPU_METHOD EV_RH_near_zero_COMPU_VTAB "Verbal Table" TAB_VERB "%.0" "list" COMPU_TAB_REF EV_RH_near_zero_COMPU_VTAB_REF /end COMPU_METHOD
/begin COMPU_VTAB EV_RH_near_zero_COMPU_VTAB_REF "Verbal Table" TAB_VERB 2 0 "No" 1 "Yes" DEFAULT_VALUE "UNKNOWN" /end COMPU_VTAB
/begin MEASUREMENT EV_RH_at_unstable "RH at unstable{EV_RH_at_unstable&0xff=0:No}{EV_RH_at_unstable&0xff=1:Yes}" UBYTE EV_RH_at_unstable_COMPU_VTAB 0 0 0 255 ECU_ADDRESS 0x01012240 BIT_MASK 0xff /end MEASUREMENT
/begin COMPU_METHOD EV_RH_at_unstable_COMPU_VTAB "Verbal Table" TAB_VERB "%.0" "list" COMPU_TAB_REF EV_RH_at_unstable_COMPU_VTAB_REF /end COMPU_METHOD
/begin COMPU_VTAB EV_RH_at_unstable_COMPU_VTAB_REF "Verbal Table" TAB_VERB 2 0 "No" 1 "Yes" DEFAULT_VALUE "UNKNOWN" /end COMPU_VTAB
/begin MEASUREMENT EV_RH_uns_state "RH unstable state{EV_RH_uns_state&0xff=0:Idle}{EV_RH_uns_state&0xff=1:Near zero}{EV_RH_uns_state&0xff=2:Unstable}" UBYTE EV_RH_uns_state_COMPU_VTAB 0 0 0 255 ECU_ADDRESS 0x01012248 BIT_MASK 0xff /end MEASUREMENT
/begin COMPU_METHOD EV_RH_uns_state_COMPU_VTAB "Verbal Table" TAB_VERB "%.0" "list" COMPU_TAB_REF EV_RH_uns_state_COMPU_VTAB_REF /end COMPU_METHOD
/begin COMPU_VTAB EV_RH_uns_state_COMPU_VTAB_REF "Verbal Table" TAB_VERB 3 0 "Idle" 1 "Near zero" 2 "Unstable" DEFAULT_VALUE "UNKNOWN" /end COMPU_VTAB
/begin MEASUREMENT EV_SH "Remote SH - adjusted" UBYTE Compu_EV_SH 0 0 0 62.255859375 ECU_ADDRESS 0x01012250 /end MEASUREMENT
/begin COMPU_METHOD Compu_EV_SH " " RAT_FUNC "%.1" "g/kg" COEFFS 0 4.096 0 0 0 1 /end COMPU_METHOD
/begin CHARACTERISTIC TPS_KOC_sweep_ena "Key-off clear TPS sweep{TPS_KOC_sweep_ena&0xff=0:Disabled}{TPS_KOC_sweep_ena&0xff=1:Enabled}" VALUE 0x001480a8 /* @ECU_Address@TPS_KOC_sweep_ena@0x010126E0@ */ ECIPP_ALIGNMENT_UBYTE 255 TPS_KOC_sweep_ena_COMPU_VTAB 0 255 BIT_MASK 0xff /end CHARACTERISTIC
/begin COMPU_METHOD TPS_KOC_sweep_ena_COMPU_VTAB "Verbal Table" TAB_VERB "%.0" "list" COMPU_TAB_REF TPS_KOC_sweep_ena_COMPU_VTAB_REF /end COMPU_METHOD
/begin COMPU_VTAB TPS_KOC_sweep_ena_COMPU_VTAB_REF "Verbal Table" TAB_VERB 2 0 "Disabled" 1 "Enabled" DEFAULT_VALUE "UNKNOWN" /end COMPU_VTAB
/begin CHARACTERISTIC TPS_KOC_sweep_cnt "TPS sweep count" VALUE 0x001480a7 /* @ECU_Address@TPS_KOC_sweep_cnt@0x010126E8@ */ ECIPP_ALIGNMENT_UBYTE 255 Compu_TPS_KOC_sweep_cnt 0 255 /end CHARACTERISTIC
/begin COMPU_METHOD Compu_TPS_KOC_sweep_cnt " " RAT_FUNC "%.0" "-" COEFFS 0 1 0 0 0 1 /end COMPU_METHOD
/begin CHARACTERISTIC TPS_KOC_sweep_close "TPS sweep close cmd" VALUE 0x001478d6 /* @ECU_Address@TPS_KOC_sweep_close@0x010126F0@ */ ECIPP_ALIGNMENT_UWORD 100 Compu_TPS_KOC_sweep_close 0 99.9984741210938 /end CHARACTERISTIC
/begin COMPU_METHOD Compu_TPS_KOC_sweep_close " " RAT_FUNC "%.1" "%" COEFFS 0 655.36 0 0 0 1 /end COMPU_METHOD
/begin CHARACTERISTIC TPS_KOC_sweep_open "TPS sweep open cmd" VALUE 0x001478da /* @ECU_Address@TPS_KOC_sweep_open@0x010126F8@ */ ECIPP_ALIGNMENT_UWORD 100 Compu_TPS_KOC_sweep_open 0 99.9984741210938 /end CHARACTERISTIC
/begin COMPU_METHOD Compu_TPS_KOC_sweep_open " " RAT_FUNC "%.1" "%" COEFFS 0 655.36 0 0 0 1 /end COMPU_METHOD
/begin CHARACTERISTIC TPS_KOC_sweep_hold "TPS sweep hold time" VALUE 0x001478d8 /* @ECU_Address@TPS_KOC_sweep_hold@0x01012700@ */ ECIPP_ALIGNMENT_UWORD 65535 Compu_TPS_KOC_sweep_hold 0 65535 /end CHARACTERISTIC
/begin COMPU_METHOD Compu_TPS_KOC_sweep_hold " " RAT_FUNC "%.0" "ms" COEFFS 0 1 0 0 0 1 /end COMPU_METHOD
/begin MEASUREMENT EV_AAT_mdp_avg "Port flow - total - LP" FLOAT32_IEEE Compu_EV_AAT_mdp_avg 0 0 -10000000000 10000000000 ECU_ADDRESS 0x01012738 /end MEASUREMENT
/begin COMPU_METHOD Compu_EV_AAT_mdp_avg " " RAT_FUNC "%.1" "g/sec" COEFFS 0 1 0 0 0 1 /end COMPU_METHOD
/begin CHARACTERISTIC EV_AAT_mdp_tau "Port flow - total - LP tau (Fault Condition:using port flow low pass of)" VALUE 0x0014399c /* @ECU_Address@EV_AAT_mdp_tau@0x01012740@ */ ECIPP_ALIGNMENT_FLOAT32_IEEE 10000000000 Compu_EV_AAT_mdp_tau -10000000000 10000000000 /end CHARACTERISTIC
/begin COMPU_METHOD Compu_EV_AAT_mdp_tau " " RAT_FUNC "%.1" "seconds" COEFFS 0 1000 0 0 0 1 /end COMPU_METHOD
/begin CHARACTERISTIC EV_RH_inv_err_margin "SH error margin{EV_RH_inv_err_margin&0xff=0:0.244 g/kg}{EV_RH_inv_err_margin&0xff=1:0.488 g/kg}{EV_RH_inv_err_margin&0xff=2:0.732 g/kg}{EV_RH_inv_err_margin&0xff=3:0.977 g/kg} (Fault Condition:and SH error margin of)" VALUE 0x00147d42 /* @ECU_Address@EV_RH_inv_err_margin@0x01012748@ */ ECIPP_ALIGNMENT_UBYTE 255 EV_RH_inv_err_margin_COMPU_VTAB 0 255 BIT_MASK 0xff /end CHARACTERISTIC
/begin COMPU_METHOD EV_RH_inv_err_margin_COMPU_VTAB "Verbal Table" TAB_VERB "%.0" "list" COMPU_TAB_REF EV_RH_inv_err_margin_COMPU_VTAB_REF /end COMPU_METHOD
/begin COMPU_VTAB EV_RH_inv_err_margin_COMPU_VTAB_REF "Verbal Table" TAB_VERB 4 0 "0.244 g/kg" 1 "0.488 g/kg" 2 "0.732 g/kg" 3 "0.977 g/kg" DEFAULT_VALUE "UNKNOWN" /end COMPU_VTAB
/begin CHARACTERISTIC EV_RH_uns_err_margin "SH error margin{EV_RH_uns_err_margin&0xff=0:0.244 g/kg}{EV_RH_uns_err_margin&0xff=1:0.488 g/kg}{EV_RH_uns_err_margin&0xff=2:0.732 g/kg}{EV_RH_uns_err_margin&0xff=3:0.977 g/kg}" VALUE 0x00147d44 /* @ECU_Address@EV_RH_uns_err_margin@0x01012750@ */ ECIPP_ALIGNMENT_UBYTE 255 EV_RH_uns_err_margin_COMPU_VTAB 0 255 BIT_MASK 0xff /end CHARACTERISTIC
/begin COMPU_METHOD EV_RH_uns_err_margin_COMPU_VTAB "Verbal Table" TAB_VERB "%.0" "list" COMPU_TAB_REF EV_RH_uns_err_margin_COMPU_VTAB_REF /end COMPU_METHOD
/begin COMPU_VTAB EV_RH_uns_err_margin_COMPU_VTAB_REF "Verbal Table" TAB_VERB 4 0 "0.244 g/kg" 1 "0.488 g/kg" 2 "0.732 g/kg" 3 "0.977 g/kg" DEFAULT_VALUE "UNKNOWN" /end COMPU_VTAB
/begin MEASUREMENT EV_AAT_fault_def "AAT fault default" UWORD Compu_EV_AAT_fault_def 0 0 -459.67 564.314375 ECU_ADDRESS 0x01012758 /end MEASUREMENT
/begin COMPU_METHOD Compu_EV_AAT_fault_def " " RAT_FUNC "%.3" "deg F" COEFFS 0 64 29418.88 0 0 1 /end COMPU_METHOD
/begin MEASUREMENT EV_RH_inv_fault_def "RH fault default" UBYTE Compu_EV_RH_inv_fault_def 0 0 0 99.609375 ECU_ADDRESS 0x01012760 /end MEASUREMENT
/begin COMPU_METHOD Compu_EV_RH_inv_fault_def " " RAT_FUNC "%.1" "%" COEFFS 0 2.56 0 0 0 1 /end COMPU_METHOD
/begin MEASUREMENT EV_AAT "Envirotech air temperature" UWORD Compu_EV_AAT 0 0 -459.67 564.314375 ECU_ADDRESS 0x01012780 /end MEASUREMENT
/begin COMPU_METHOD Compu_EV_AAT " " RAT_FUNC "%.1" "deg F" COEFFS 0 64 29418.88 0 0 1 /end COMPU_METHOD
/begin MEASUREMENT EV_RH_uns_latch_pct "RH unstable latch percent" FLOAT32_IEEE Compu_EV_RH_uns_latch_pct 0 0 -10000000000 10000000000 ECU_ADDRESS 0x01012D68 /end MEASUREMENT
/begin COMPU_METHOD Compu_EV_RH_uns_latch_pct " " RAT_FUNC "%.1" "%" COEFFS 0 0.01 0 0 0 1 /end COMPU_METHOD
/begin MEASUREMENT EV_RH_unstable "RH unstable latch state{EV_RH_unstable&0xff=0:NO}{EV_RH_unstable&0xff=1:YES}" UBYTE EV_RH_unstable_COMPU_VTAB 0 0 0 255 ECU_ADDRESS 0x01012D80 BIT_MASK 0xff /end MEASUREMENT
/begin COMPU_METHOD EV_RH_unstable_COMPU_VTAB "Verbal Table" TAB_VERB "%.0" "list" COMPU_TAB_REF EV_RH_unstable_COMPU_VTAB_REF /end COMPU_METHOD
/begin COMPU_VTAB EV_RH_unstable_COMPU_VTAB_REF "Verbal Table" TAB_VERB 2 0 "NO" 1 "YES" DEFAULT_VALUE "UNKNOWN" /end COMPU_VTAB
/begin CHARACTERISTIC TIP_def_select "TIP default{TIP_def_select&0xff=0:TIP = BP}{TIP_def_select&0xff=1:TIP estimate}" VALUE 0x0014809b /* @ECU_Address@TIP_def_select@0x01013028@ */ ECIPP_ALIGNMENT_UBYTE 255 TIP_def_select_COMPU_VTAB 0 255 BIT_MASK 0xff /end CHARACTERISTIC
/begin COMPU_METHOD TIP_def_select_COMPU_VTAB "Verbal Table" TAB_VERB "%.0" "list" COMPU_TAB_REF TIP_def_select_COMPU_VTAB_REF /end COMPU_METHOD
/begin COMPU_VTAB TIP_def_select_COMPU_VTAB_REF "Verbal Table" TAB_VERB 2 0 "TIP = BP" 1 "TIP estimate" DEFAULT_VALUE "UNKNOWN" /end COMPU_VTAB
/begin COMPU_METHOD Compu_MAPcal_V " " RAT_FUNC "%.3" "volts" COEFFS 0 6553.6 0 0 0 1 /end COMPU_METHOD
/begin CHARACTERISTIC MAPcal_P "MAP Sensor Calibration" CURVE 0x00144342 /* @ECU_Address@MAPcal_P@0x020C8000@ */ ECIPP_ALIGNMENT_SWORD 128 Compu_MAPcal_P -128 127.99609375
 /begin AXIS_DESCR COM_AXIS NO_INPUT_QUANTITY Compu_MAPcal_V 2 -5 4.99984741210938 AXIS_PTS_REF MAPcal_V /end AXIS_DESCR
/end CHARACTERISTIC
/begin AXIS_PTS MAPcal_V " " 0x00144346 /* @ECU_Address@MAPcal_V@0x020C7000@ */ NO_INPUT_QUANTITY ECIPP_Lookup_SWORD 0 Compu_MAPcal_V 2 -5 4.99984741210938 /end AXIS_PTS
/begin COMPU_METHOD Compu_MAPcal_P " " RAT_FUNC "%.2" "psia" COEFFS 0 256 0 0 0 1 /end COMPU_METHOD
/begin COMPU_METHOD Compu_TIPcal_V " " RAT_FUNC "%.3" "volts" COEFFS 0 6553.6 0 0 0 1 /end COMPU_METHOD
/begin CHARACTERISTIC TIPcal_P "TIP Sensor Calibration" CURVE 0x00144F7A /* @ECU_Address@TIPcal_P@0x020CA000@ */ ECIPP_ALIGNMENT_SWORD 128 Compu_TIPcal_P -128 127.99609375
 /begin AXIS_DESCR COM_AXIS NO_INPUT_QUANTITY Compu_TIPcal_V 2 -5 4.99984741210938 AXIS_PTS_REF TIPcal_V /end AXIS_DESCR
/end CHARACTERISTIC
/begin AXIS_PTS TIPcal_V " " 0x00144F7E /* @ECU_Address@TIPcal_V@0x020C9000@ */ NO_INPUT_QUANTITY ECIPP_Lookup_SWORD 0 Compu_TIPcal_V 2 -5 4.99984741210938 /end AXIS_PTS
/begin COMPU_METHOD Compu_TIPcal_P " " RAT_FUNC "%.2" "psia" COEFFS 0 256 0 0 0 1 /end COMPU_METHOD
/begin COMPU_METHOD Compu_OilPcal_V " " RAT_FUNC "%.3" "volts" COEFFS 0 6553.6 0 0 0 1 /end COMPU_METHOD
/begin CHARACTERISTIC OilPcal_P "OilP Sensor Calibration" CURVE 0x00144386 /* @ECU_Address@OilPcal_P@0x020E9000@ */ ECIPP_ALIGNMENT_SWORD 128 Compu_OilPcal_P -128 127.99609375
 /begin AXIS_DESCR COM_AXIS NO_INPUT_QUANTITY Compu_OilPcal_V 2 -5 4.99984741210938 AXIS_PTS_REF OilPcal_V /end AXIS_DESCR
/end CHARACTERISTIC
/begin AXIS_PTS OilPcal_V " " 0x0014438A /* @ECU_Address@OilPcal_V@0x020E8000@ */ NO_INPUT_QUANTITY ECIPP_Lookup_SWORD 0 Compu_OilPcal_V 2 -5 4.99984741210938 /end AXIS_PTS
/begin COMPU_METHOD Compu_OilPcal_P " " RAT_FUNC "%.2" "psia" COEFFS 0 256 0 0 0 1 /end COMPU_METHOD
/begin GROUP EC_ConfigEng "ECONTROLS" ROOT
 /begin REF_CHARACTERISTIC Vint_lower Vint_total Vexhaust OILP_trig OILP_test keysw_type TIP_ena crank_HW_cfg cam_HW_cfg RS_HW_cfg engine_select FT_ena FT_gaseous_ena ReverseRotation cam_reqactv IAT_ena cam_level_sync cam_capture crank_capture sync_allow CAD_sync_to_TDCC CCM_type cam2_HW_cfg cam2_capture RS_capture CAD_camsync_to_TDCC crank_mag_inc_tau crank_mag_dec_tau cam1_mag_inc_tau cam1_mag_dec_tau cam2_mag_inc_tau cam2_mag_dec_tau rs_mag_inc_tau rs_mag_dec_tau crank_mag_trig_min cam1_mag_trig_min cam2_mag_trig_min rs_mag_trig_min crank_mag_maxpct cam1_mag_maxpct cam2_mag_maxpct rs_mag_maxpct CAD_crankcam_extra crank_min_pw cam1_min_pw cam2_min_pw rs_min_pw TIP_est_ena TIP_gauge_def TIP_C_int engine_stall_manual RS_input_redirect PPEG_EBP_enable PPEG_EBP_keyon_wt PPEG_EBP_valid_wt PPEG_EBP_start_wt PPEG_EBP_tau PPEG_EBP_mdot_max PPEG_EBP_Nmax PPEG_EBP_EEstore PPEG_EBP_Pref_min PPEG_EBP_Pref_max PPEG_EBP_ofst_max PPEG_TIP_enable PPEG_TIP_keyon_wt PPEG_TIP_valid_wt PPEG_TIP_start_wt PPEG_TIP_tau PPEG_TIP_mdot_max PPEG_TIP_Nmax PPEG_TIP_EEstore PPEG_TIP_Pref_min PPEG_TIP_Pref_max PPEG_TIP_ofst_max PPEG_EGRHP_enable PPEG_EGRHP_keyon_wt PPEG_EGRHP_valid_wt PPEG_EGRHP_start_wt PPEG_EGRHP_tau PPEG_EGRHP_mdot_max PPEG_EGRHP_Nmax PPEG_EGRHP_EEstore PPEG_EGRHP_Pref_min PPEG_EGRHP_Pref_max PPEG_EGRHP_ofst_max PPEG_BP_enable PPEG_BP_keyon_wt PPEG_BP_valid_wt PPEG_BP_start_wt PPEG_BP_tau PPEG_BP_mdot_max PPEG_BP_Nmax PPEG_BP_EEstore PPEG_BP_Pref_min PPEG_BP_Pref_max PPEG_BP_ofst_max PPEG_EGRLP_enable PPEG_EGRLP_keyon_wt PPEG_EGRLP_valid_wt PPEG_EGRLP_start_wt PPEG_EGRLP_tau PPEG_EGRLP_mdot_max PPEG_EGRLP_Nmax PPEG_EGRLP_EEstore PPEG_EGRLP_Pref_min PPEG_EGRLP_Pref_max PPEG_EGRLP_ofst_max cam_level_trust TIAT_ena PPEG_EGRwrP_enable PPEG_EGRwrP_keyon_wt PPEG_EGRwrP_valid_wt PPEG_EGRwrP_start_wt PPEG_EGRwrP_tau PPEG_EGRwrP_mdot_max PPEG_EGRwrP_Nmax PPEG_EGRwrP_EEstore PPEG_EGRwrP_Pref_min PPEG_EGRwrP_Pref_max PPEG_EGRwrP_ofst_max key_off_clr_ena key_off_clr_wt key_off_clr_hold key_off_clr_TPS key_off_clr_EGR PPEG_BP_keyX_wt PPEG_EBP_keyX_wt PPEG_EGRLP_keyX_wt PPEG_EGRHP_keyX_wt PPEG_TIP_keyX_wt PPEG_EGRwrP_keyX_wt PPEG_BP_ECT_ena PPEG_EBP_ECT_ena PPEG_EGRLP_ECT_ena PPEG_EGRHP_ECT_ena PPEG_TIP_ECT_ena PPEG_EGRwrP_ECT_ena crank_gap_large_x FIP_ena FIP_tau FIP_def cam1_input_redirect cam2_input_redirect key_off_clr_EGR_cnt crank_skip_teeth PPEG_CVP1_enable PPEG_CVP1_keyon_wt PPEG_CVP1_keyX_wt PPEG_CVP1_ECT_ena PPEG_CVP1_valid_wt PPEG_CVP1_start_wt PPEG_CVP1_tau PPEG_CVP1_mdot_max PPEG_CVP1_Nmax PPEG_CVP1_EEstore PPEG_CVP1_Pref_min PPEG_CVP1_Pref_max PPEG_CVP1_ofst_max PPEG_CVP2_enable PPEG_CVP2_keyon_wt PPEG_CVP2_keyX_wt PPEG_CVP2_ECT_ena PPEG_CVP2_valid_wt PPEG_CVP2_start_wt PPEG_CVP2_tau PPEG_CVP2_mdot_max PPEG_CVP2_Nmax PPEG_CVP2_EEstore PPEG_CVP2_Pref_min PPEG_CVP2_Pref_max PPEG_CVP2_ofst_max CVCSP_ena CVCSP_tau CVCSP_type CVDSP_ena CVDSP_tau CVDSP_type CVPAUX1_ena CVPAUX1_tau CVPAUX1_type CVPAUX2_ena CVPAUX2_tau CVPAUX2_type accel_flt_thd key_off_clr_EGR_V key_off_clr_EGR_DC swap_crank_cam TPS_learn_ena key_off_clr_EGR_ena TPS_learn_cmd_init TPS_learn_cmd_slew EV_AAT_mdp_dTrg EV_RH_AAT_tau EV_RH_AAT_dTrg EV_RH_max_SH TPS_KOC_sweep_ena TPS_KOC_sweep_cnt TPS_KOC_sweep_close TPS_KOC_sweep_open TPS_KOC_sweep_hold EV_AAT_mdp_tau EV_RH_inv_err_margin EV_RH_uns_err_margin TIP_def_select MAPcal_P TIPcal_P OilPcal_P /end REF_CHARACTERISTIC
 /begin REF_MEASUREMENT crknoise_cnt camnoise_cnt sync_state crank_tooth_cnt SH MAPc MAPo TIPc TIPo OILPc OILPo crank_cnt_diag cam_cnt_diag crkloss_camcnt HM_RAMr_seconds HM_RAMr_starts HM_sec_offset HM_start_offset HM_offset_write engine_number engine_SNPN_write crank_tooth_saved crank_rise_trigger cam1_rise_trigger cam2_rise_trigger rs_rise_trigger RS_odom_total PPEG_EBP_offset PPEG_TIP_offset PPEG_EGRHP_offset PPEG_BP_offset PPEG_EBP_state PPEG_TIP_state PPEG_EGRHP_state PPEG_BP_state mdot_ports_float PPEG_EGRLP_offset PPEG_EGRLP_state PPEG_EGRwrP_offset PPEG_EGRwrP_state key_off_clr_active DATE_engine_mfg_int FIP_raw FIP PPEG_CVP1_offset PPEG_CVP1_state PPEG_CVP2_offset PPEG_CVP2_state CVP1 CVP1_raw CVP1_location CVP2 CVP2_raw CVP2_location accel_flt crank_cnt_diag_crk Ecrank_cnt_diag_crk EV_AAT_mdp_trig EV_AAT_mdp_dAct RMT_BP EV_AAT_at_fault_def EV_comm_active RMT_SH RMT_RH EV_version EV_RH_AAT_avg EV_RH_AAT_trig EV_RH_AAT_dAct EV_RH_at_fault_def EV_RH_faulted_SH EV_RH_near_zero_SH EV_RH_unstable_SH EV_RH_near_zero EV_RH_at_unstable EV_RH_uns_state EV_SH EV_AAT_mdp_avg EV_AAT_fault_def EV_RH_inv_fault_def EV_AAT EV_RH_uns_latch_pct EV_RH_unstable /end REF_MEASUREMENT
/end GROUP
/begin GROUP EC_EGRCommand "ECONTROLS" ROOT /begin REF_MEASUREMENT SH mdot_ports_float /end REF_MEASUREMENT /end GROUP
/begin GROUP EC_FaultCfg "ECONTROLS" ROOT /begin REF_MEASUREMENT CVP1 CVP2 /end REF_MEASUREMENT /end GROUP
/begin GROUP EC_Faults "ECONTROLS" ROOT /begin REF_CHARACTERISTIC OILP_test /end REF_CHARACTERISTIC /end GROUP
/begin GROUP EC_Fuel "ECONTROLS" ROOT /begin REF_MEASUREMENT FIP /end REF_MEASUREMENT /end GROUP
/begin GROUP EC_HDService "ECONTROLS" ROOT /begin REF_MEASUREMENT SH RS_odom_total DATE_engine_mfg_int EV_AAT /end REF_MEASUREMENT /end GROUP
/begin GROUP EC_LDService "ECONTROLS" ROOT /begin REF_MEASUREMENT sync_state /end REF_MEASUREMENT /end GROUP
/begin GROUP EC_Marine "ECONTROLS" ROOT /begin REF_CHARACTERISTIC engine_select /end REF_CHARACTERISTIC /begin REF_MEASUREMENT engine_number /end REF_MEASUREMENT /end GROUP
/begin GROUP EC_Megajector "ECONTROLS" ROOT /begin REF_MEASUREMENT FIP /end REF_MEASUREMENT /end GROUP
/begin GROUP EC_PhiNG "ECONTROLS" ROOT /begin REF_MEASUREMENT SH /end REF_MEASUREMENT /end GROUP
/begin GROUP EC_PowerMon "ECONTROLS" ROOT /begin REF_MEASUREMENT SH /end REF_MEASUREMENT /end GROUP
/begin GROUP EC_Starting "ECONTROLS" ROOT /begin REF_MEASUREMENT sync_state /end REF_MEASUREMENT /end GROUP
/begin GROUP EC_Tests "ECONTROLS" ROOT /begin REF_CHARACTERISTIC OILP_test /end REF_CHARACTERISTIC /end GROUP
/begin GROUP EC_VECal "ECONTROLS" ROOT /begin REF_MEASUREMENT mdot_ports_float /end REF_MEASUREMENT /end GROUP
/end MODULE
/end PROJECT
