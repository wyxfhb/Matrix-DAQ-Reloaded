ASAP2_VERSION 1 61
/begin PROJECT Econtrols_4G "4G Test"
/begin HEADER "4G A2L Configuration" PROJECT_NO EControls4G /* config for version control */ VERSION "$Revision: 82130 $:" /* config for version control */ /end HEADER
/begin MODULE EControls_4G_SH2A "EControls 4G"
/begin MOD_COMMON "" DEPOSIT ABSOLUTE BYTE_ORDER MSB_FIRST /end MOD_COMMON
/* Define the Record Layouts */
/begin RECORD_LAYOUT ECIPP_ALIGNMENT_UBYTE FNC_VALUES 1 UBYTE COLUMN_DIR DIRECT /end RECORD_LAYOUT
/begin RECORD_LAYOUT ECIPP_ALIGNMENT_UWORD FNC_VALUES 1 UWORD COLUMN_DIR DIRECT /end RECORD_LAYOUT
/begin RECORD_LAYOUT ECIPP_ALIGNMENT_SWORD FNC_VALUES 1 SWORD COLUMN_DIR DIRECT /end RECORD_LAYOUT
/begin RECORD_LAYOUT ECIPP_Lookup_SWORD AXIS_PTS_X 1 SWORD INDEX_INCR DIRECT /end RECORD_LAYOUT
/begin RECORD_LAYOUT ECIPP_ALIGNMENT_ULONG FNC_VALUES 1 ULONG COLUMN_DIR DIRECT /end RECORD_LAYOUT
/begin RECORD_LAYOUT ECIPP_ALIGNMENT_FLOAT32_IEEE FNC_VALUES 1 FLOAT32_IEEE COLUMN_DIR DIRECT /end RECORD_LAYOUT
/* Define generic COMPU_METHODS used in the A2L */ /* NOTE: most of the parameters from ECIPP use unique/specific COMPU_METHODS */
/begin COMPU_METHOD Compu_ECIPP_STRINGS "ECIPP Strings " /* Identifier */ RAT_FUNC "%.0" /* Format */ "ASCII" /* Units */ COEFFS 0 1 0 0 0 1 /end COMPU_METHOD
/begin MEASUREMENT spk_max_ECT "CHT Max Advance" SWORD Compu_spk_max_ECT 0 0 -2048 2047.9375 ECU_ADDRESS 0x01000030 /end MEASUREMENT
/begin COMPU_METHOD Compu_spk_max_ECT " " RAT_FUNC "%.1" "CAD BTDC" COEFFS 0 16 0 0 0 1 /end COMPU_METHOD
/begin MEASUREMENT dwell_OL "Base dwell" UWORD Compu_dwell_OL 0 0 0 209.712 ECU_ADDRESS 0x01000058 /end MEASUREMENT
/begin COMPU_METHOD Compu_dwell_OL " " RAT_FUNC "%.2" "ms" COEFFS 0 312.5 0 0 0 1 /end COMPU_METHOD
/begin MEASUREMENT VE_CWT_crct_pct "VE_CWT_crct_pct" SWORD Compu_VE_CWT_crct_pct 0 0 -100 99.9969482421875 ECU_ADDRESS 0x01000240 /end MEASUREMENT
/begin COMPU_METHOD Compu_VE_CWT_crct_pct " " RAT_FUNC "%.1" "%" COEFFS 0 327.68 0 0 0 1 /end COMPU_METHOD
/begin MEASUREMENT RS_dot "Road speed derivative" SWORD Compu_RS_dot 0 0 -32 31.9990234375 ECU_ADDRESS 0x01000490 /end MEASUREMENT
/begin COMPU_METHOD Compu_RS_dot " " RAT_FUNC "%.2" "km/hr/sec" COEFFS 0 1024 0 0 0 1 /end COMPU_METHOD
/begin MEASUREMENT RS_dot_dz "Road speed derivative w/ deadzone" SWORD Compu_RS_dot_dz 0 0 -32 31.9990234375 ECU_ADDRESS 0x010004A8 /end MEASUREMENT
/begin COMPU_METHOD Compu_RS_dot_dz " " RAT_FUNC "%.2" "km/hr/sec" COEFFS 0 1024 0 0 0 1 /end COMPU_METHOD
/begin CHARACTERISTIC CWTretLP_posC "CWT+ retard - LPG" VALUE 0x00144286 /* @ECU_Address@CWTretLP_posC@0x01000EA8@ */ ECIPP_ALIGNMENT_SWORD 82 Compu_CWTretLP_posC -81.92 81.9175 /end CHARACTERISTIC
/begin COMPU_METHOD Compu_CWTretLP_posC " " RAT_FUNC "%.1" "CAD / %" COEFFS 0 400 0 0 0 1 /end COMPU_METHOD
/begin CHARACTERISTIC CWTretLP_negC "CWT- retard - LPG" VALUE 0x0014427E /* @ECU_Address@CWTretLP_negC@0x01000EC0@ */ ECIPP_ALIGNMENT_SWORD 82 Compu_CWTretLP_negC -81.92 81.9175 /end CHARACTERISTIC
/begin COMPU_METHOD Compu_CWTretLP_negC " " RAT_FUNC "%.1" "CAD / %" COEFFS 0 400 0 0 0 1 /end COMPU_METHOD
/begin CHARACTERISTIC CWTret_poslim "CWT+ retard limit" VALUE 0x0014428a /* @ECU_Address@CWTret_poslim@0x01000ED0@ */ ECIPP_ALIGNMENT_SWORD 2048 Compu_CWTret_poslim -2048 2047.9375 /end CHARACTERISTIC
/begin COMPU_METHOD Compu_CWTret_poslim " " RAT_FUNC "%.1" "CAD" COEFFS 0 16 0 0 0 1 /end COMPU_METHOD
/begin CHARACTERISTIC CWTret_neglim "CWT- retard limit" VALUE 0x00144282 /* @ECU_Address@CWTret_neglim@0x01000ED8@ */ ECIPP_ALIGNMENT_SWORD 2048 Compu_CWTret_neglim -2048 2047.9375 /end CHARACTERISTIC
/begin COMPU_METHOD Compu_CWTret_neglim " " RAT_FUNC "%.1" "CAD" COEFFS 0 16 0 0 0 1 /end COMPU_METHOD
/begin CHARACTERISTIC spk_adv_dz "Spk Adv dead-zone" VALUE 0x0014667e /* @ECU_Address@spk_adv_dz@0x01000F60@ */ ECIPP_ALIGNMENT_SWORD 2048 Compu_spk_adv_dz -2048 2047.9375 /end CHARACTERISTIC
/begin COMPU_METHOD Compu_spk_adv_dz " " RAT_FUNC "%.1" "CAD" COEFFS 0 16 0 0 0 1 /end COMPU_METHOD
/begin CHARACTERISTIC spk_adv_dz_tau "Spk Adv dead-zone tau" VALUE 0x00147cc2 /* @ECU_Address@spk_adv_dz_tau@0x01000F68@ */ ECIPP_ALIGNMENT_UWORD 163840 Compu_spk_adv_dz_tau 0.16703 163840 /end CHARACTERISTIC
/begin COMPU_METHOD Compu_spk_adv_dz_tau " " FORM "%.0" "ms"
 /begin FORMULA "-5 / log(1.0000000000001 - (X1 / 32768))" FORMULA_INV "(1.0000000000001 - exp(-5/X1)) * 32768" /end FORMULA
/end COMPU_METHOD
/begin CHARACTERISTIC dwell_adpt_ena "Dwell current control{dwell_adpt_ena&0xff=0x00:Disabled}{dwell_adpt_ena&0xff=0x01:Adaptive Dwell}{dwell_adpt_ena&0xff=0x02:Monitor Only}" VALUE 0x00148146 /* @ECU_Address@dwell_adpt_ena@0x01001268@ */ ECIPP_ALIGNMENT_UBYTE 255 dwell_adpt_ena_COMPU_VTAB 0 255 BIT_MASK 0xff /end CHARACTERISTIC
/begin COMPU_METHOD dwell_adpt_ena_COMPU_VTAB "Verbal Table" TAB_VERB "%.0" "list" COMPU_TAB_REF dwell_adpt_ena_COMPU_VTAB_REF /end COMPU_METHOD
/begin COMPU_VTAB dwell_adpt_ena_COMPU_VTAB_REF "Verbal Table" TAB_VERB 3 0x00 "Disabled" 0x01 "Adaptive Dwell" 0x02 "Monitor Only" DEFAULT_VALUE "UNKNOWN" /end COMPU_VTAB
/begin CHARACTERISTIC dwell_a_min "Min adaptive dwell delta" VALUE 0x001465e0 /* @ECU_Address@dwell_a_min@0x01001270@ */ ECIPP_ALIGNMENT_SWORD 105 Compu_dwell_a_min -104.8576 104.8544 /end CHARACTERISTIC
/begin COMPU_METHOD Compu_dwell_a_min " " RAT_FUNC "%.3" "ms" COEFFS 0 312.5 0 0 0 1 /end COMPU_METHOD
/begin CHARACTERISTIC dwell_a_max "Max adaptive dwell delta" VALUE 0x001465de /* @ECU_Address@dwell_a_max@0x01001278@ */ ECIPP_ALIGNMENT_SWORD 105 Compu_dwell_a_max -104.8576 104.8544 /end CHARACTERISTIC
/begin COMPU_METHOD Compu_dwell_a_max " " RAT_FUNC "%.3" "ms" COEFFS 0 312.5 0 0 0 1 /end COMPU_METHOD
/begin CHARACTERISTIC dwell_inc_K "Adaptive dwell gain" VALUE 0x001465e4 /* @ECU_Address@dwell_inc_K@0x01001280@ */ ECIPP_ALIGNMENT_SWORD 10 Compu_dwell_inc_K -10.48576 10.48544 /end CHARACTERISTIC
/begin COMPU_METHOD Compu_dwell_inc_K " " RAT_FUNC "%.3" "ms/volt" COEFFS 0 3125 0 0 0 1 /end COMPU_METHOD
/begin CHARACTERISTIC dwell_inc_max "Adaptive dwell step max" VALUE 0x001465e6 /* @ECU_Address@dwell_inc_max@0x01001288@ */ ECIPP_ALIGNMENT_SWORD 105 Compu_dwell_inc_max -104.8576 104.8544 /end CHARACTERISTIC
/begin COMPU_METHOD Compu_dwell_inc_max " " RAT_FUNC "%.3" "ms" COEFFS 0 312.5 0 0 0 1 /end COMPU_METHOD
/begin MEASUREMENT RS_dt "Roadspeed pulse time" UWORD Compu_RS_dt 0 0 0 209.712 ECU_ADDRESS 0x01001688 /end MEASUREMENT
/begin COMPU_METHOD Compu_RS_dt " " RAT_FUNC "%.2" "ms" COEFFS 0 312.5 0 0 0 1 /end COMPU_METHOD
/begin MEASUREMENT dwell1_adapt "Coil1 dwell adapt" SWORD Compu_dwell1_adapt 0 0 -104.8576 104.8544 ECU_ADDRESS 0x01002188 /end MEASUREMENT
/begin COMPU_METHOD Compu_dwell1_adapt " " RAT_FUNC "%.2" "ms" COEFFS 0 312.5 0 0 0 1 /end COMPU_METHOD
/begin MEASUREMENT dwell2_adapt "Coil2 dwell adapt" SWORD Compu_dwell2_adapt 0 0 -104.8576 104.8544 ECU_ADDRESS 0x01002190 /end MEASUREMENT
/begin COMPU_METHOD Compu_dwell2_adapt " " RAT_FUNC "%.2" "ms" COEFFS 0 312.5 0 0 0 1 /end COMPU_METHOD
/begin MEASUREMENT dwell3_adapt "Coil3 dwell adapt" SWORD Compu_dwell3_adapt 0 0 -104.8576 104.8544 ECU_ADDRESS 0x01002198 /end MEASUREMENT
/begin COMPU_METHOD Compu_dwell3_adapt " " RAT_FUNC "%.2" "ms" COEFFS 0 312.5 0 0 0 1 /end COMPU_METHOD
/begin CHARACTERISTIC RS_pulse_space "Roadspeed pulse spacing filter" VALUE 0x0014773c /* @ECU_Address@RS_pulse_space@0x01003138@ */ ECIPP_ALIGNMENT_UWORD 210 Compu_RS_pulse_space 0 209.712 /end CHARACTERISTIC
/begin COMPU_METHOD Compu_RS_pulse_space " " RAT_FUNC "%.3" "ms" COEFFS 0 312.5 0 0 0 1 /end COMPU_METHOD
/begin MEASUREMENT RS_pulse_cnt "Roadspeed pulse accumulator" UWORD Compu_RS_pulse_cnt 0 0 0 65535 ECU_ADDRESS 0x01003140 /end MEASUREMENT
/begin COMPU_METHOD Compu_RS_pulse_cnt " " RAT_FUNC "%.0" "pulses" COEFFS 0 1 0 0 0 1 /end COMPU_METHOD
/begin MEASUREMENT RS_max_load "Roadspeed control output limit" UWORD Compu_RS_max_load 0 0 0 99.9984741210938 ECU_ADDRESS 0x01003148 /end MEASUREMENT
/begin COMPU_METHOD Compu_RS_max_load " " RAT_FUNC "%.1" "% load/RPM" COEFFS 0 655.36 0 0 0 1 /end COMPU_METHOD
/begin MEASUREMENT RS_max_TPS "Roadspeed TPS control TPS limit" UWORD Compu_RS_max_TPS 0 0 0 99.9984741210938 ECU_ADDRESS 0x01003150 /end MEASUREMENT
/begin COMPU_METHOD Compu_RS_max_TPS " " RAT_FUNC "%.1" "%" COEFFS 0 655.36 0 0 0 1 /end COMPU_METHOD
/begin MEASUREMENT RS_Iacc "Roadspeed control integrator" SWORD Compu_RS_Iacc 0 0 -800 799.9755859375 ECU_ADDRESS 0x01003158 /end MEASUREMENT
/begin COMPU_METHOD Compu_RS_Iacc " " RAT_FUNC "%.1" "% load/RPM" COEFFS 0 40.96 0 0 0 1 /end COMPU_METHOD
/begin CHARACTERISTIC RS_hist_avg_t "Roadspeed speed averaging window" VALUE 0x00147724 /* @ECU_Address@RS_hist_avg_t@0x01003168@ */ ECIPP_ALIGNMENT_UWORD 65535 Compu_RS_hist_avg_t 0 65535 /end CHARACTERISTIC
/begin COMPU_METHOD Compu_RS_hist_avg_t " " RAT_FUNC "%.0" "ms" COEFFS 0 1 0 0 0 1 /end COMPU_METHOD
/begin CHARACTERISTIC RS_hist_tout "Roadspeed speed zeroing time" VALUE 0x00147726 /* @ECU_Address@RS_hist_tout@0x01003170@ */ ECIPP_ALIGNMENT_UWORD 65535 Compu_RS_hist_tout 0 65535 /end CHARACTERISTIC
/begin COMPU_METHOD Compu_RS_hist_tout " " RAT_FUNC "%.0" "ms" COEFFS 0 1 0 0 0 1 /end COMPU_METHOD
/begin CHARACTERISTIC RS_dot_window "Roadspeed acceleration window" VALUE 0x001491D8 /* @ECU_Address@RS_dot_window@0x01003178@ */ ECIPP_ALIGNMENT_UWORD 65535 Compu_RS_dot_window 0 65535 /end CHARACTERISTIC
/begin COMPU_METHOD Compu_RS_dot_window " " RAT_FUNC "%.0" "ms" COEFFS 0 1 0 0 0 1 /end COMPU_METHOD
/begin CHARACTERISTIC RS_speed_tau "Roadspeed speed input low-pass" VALUE 0x001491D4 /* @ECU_Address@RS_speed_tau@0x01003180@ */ ECIPP_ALIGNMENT_UWORD 327680 Compu_RS_speed_tau 0.45084 327680 /end CHARACTERISTIC
/begin COMPU_METHOD Compu_RS_speed_tau " " FORM "%.1" "ms"
 /begin FORMULA "-5 / log(1 - (X1 / 65536))" FORMULA_INV "(1 - exp(-5/X1)) * 65536" /end FORMULA
/end COMPU_METHOD
/begin CHARACTERISTIC RS_TPS_tau "Roadspeed control output low-pass" VALUE 0x001491EA /* @ECU_Address@RS_TPS_tau@0x01003188@ */ ECIPP_ALIGNMENT_UWORD 327680 Compu_RS_TPS_tau 0.45084 327680 /end CHARACTERISTIC
/begin COMPU_METHOD Compu_RS_TPS_tau " " FORM "%.1" "ms"
 /begin FORMULA "-5 / log(1 - (X1 / 65536))" FORMULA_INV "(1 - exp(-5/X1)) * 65536" /end FORMULA
/end COMPU_METHOD
/begin CHARACTERISTIC RS_dot_tau "Roadspeed acceleration low-pass" VALUE 0x001491D6 /* @ECU_Address@RS_dot_tau@0x01003190@ */ ECIPP_ALIGNMENT_UWORD 163840 Compu_RS_dot_tau 0.16703 163840 /end CHARACTERISTIC
/begin COMPU_METHOD Compu_RS_dot_tau " " FORM "%.1" "ms"
 /begin FORMULA "-5 / log(1.0000000000001 - (X1 / 32768))" FORMULA_INV "(1.0000000000001 - exp(-5/X1)) * 32768" /end FORMULA
/end COMPU_METHOD
/begin CHARACTERISTIC RS_Kp "Roadspeed control Kp" VALUE 0x001491DC /* @ECU_Address@RS_Kp@0x01003198@ */ ECIPP_ALIGNMENT_SWORD 800 Compu_RS_Kp -800 799.9755859375 /end CHARACTERISTIC
/begin COMPU_METHOD Compu_RS_Kp " " RAT_FUNC "%.1" "% / (km/hr)" COEFFS 0 40.96 0 0 0 1 /end COMPU_METHOD
/begin CHARACTERISTIC RS_Ki "Roadspeed control Ki" VALUE 0x001491E2 /* @ECU_Address@RS_Ki@0x010031A0@ */ ECIPP_ALIGNMENT_SWORD 400 Compu_RS_Ki -400 399.98779296875 /end CHARACTERISTIC
/begin COMPU_METHOD Compu_RS_Ki " " RAT_FUNC "%.1" "% / (km/hr) / sec" COEFFS 0 81.92 0 0 0 1 /end COMPU_METHOD
/begin CHARACTERISTIC RS_Kd "Roadspeed control Kd / Kd_decel" VALUE 0x001491E4 /* @ECU_Address@RS_Kd@0x010031A8@ */ ECIPP_ALIGNMENT_SWORD 3200 Compu_RS_Kd -3200 3199.90234375 /end CHARACTERISTIC
/begin COMPU_METHOD Compu_RS_Kd " " RAT_FUNC "%.1" "% / (km/hr) * sec" COEFFS 0 10.24 0 0 0 1 /end COMPU_METHOD
/begin CHARACTERISTIC RS_Kiv "Roadspeed control Kiv" VALUE 0x001491E8 /* @ECU_Address@RS_Kiv@0x010031B0@ */ ECIPP_ALIGNMENT_SWORD 800 Compu_RS_Kiv -800 799.9755859375 /end CHARACTERISTIC
/begin COMPU_METHOD Compu_RS_Kiv " " RAT_FUNC "%.1" "% / (km/hr)" COEFFS 0 40.96 0 0 0 1 /end COMPU_METHOD
/begin CHARACTERISTIC RS_rpm_nom "Roadspeed limit nominal rpm" VALUE 0x0014773e /* @ECU_Address@RS_rpm_nom@0x010031B8@ */ ECIPP_ALIGNMENT_UWORD 65535 Compu_RS_rpm_nom 0 65535 /end CHARACTERISTIC
/begin COMPU_METHOD Compu_RS_rpm_nom " " RAT_FUNC "%.0" "rpm" COEFFS 0 1 0 0 0 1 /end COMPU_METHOD
/begin CHARACTERISTIC RS_HW_switch "Roadspeed hardware input enable{RS_HW_switch&0xff=0:Not Required}{RS_HW_switch&0xff=1:Aux PU1}{RS_HW_switch&0xff=2:Aux PU2}{RS_HW_switch&0xff=3:Aux PU3}{RS_HW_switch&0xff=4:Aux DIG1=Open/Gnd}{RS_HW_switch&0xff=5:Aux DIG2=Open/Gnd}{RS_HW_switch&0xff=6:Aux " VALUE 0x00147f08 /* @ECU_Address@RS_HW_switch@0x010031C8@ */ ECIPP_ALIGNMENT_UBYTE 255 RS_HW_switch_COMPU_VTAB 0 255 BIT_MASK 0xff /end CHARACTERISTIC
/begin COMPU_METHOD RS_HW_switch_COMPU_VTAB "Verbal Table" TAB_VERB "%.0" "list" COMPU_TAB_REF RS_HW_switch_COMPU_VTAB_REF /end COMPU_METHOD
/begin COMPU_VTAB RS_HW_switch_COMPU_VTAB_REF "Verbal Table" TAB_VERB 8 0 "Not Required" 1 "Aux PU1" 2 "Aux PU2" 3 "Aux PU3" 4 "Aux DIG1=Open/Gnd" 5 "Aux DIG2=Open/Gnd" 6 "Aux DIG3=Open/Gnd" 7 "Aux DIG4=Gnd" DEFAULT_VALUE "UNKNOWN" /end COMPU_VTAB
/begin CHARACTERISTIC RS_source "Roadspeed signal source{RS_source&0xff=0:Pulse Input}{RS_source&0xff=1:GPS Comm}{RS_source&0xff=2:J1939 Comm}" VALUE 0x001491D1 /* @ECU_Address@RS_source@0x01003EF0@ */ ECIPP_ALIGNMENT_UBYTE 255 RS_source_COMPU_VTAB 0 255 BIT_MASK 0xff /end CHARACTERISTIC
/begin COMPU_METHOD RS_source_COMPU_VTAB "Verbal Table" TAB_VERB "%.0" "list" COMPU_TAB_REF RS_source_COMPU_VTAB_REF /end COMPU_METHOD
/begin COMPU_VTAB RS_source_COMPU_VTAB_REF "Verbal Table" TAB_VERB 3 0 "Pulse Input" 1 "GPS Comm" 2 "J1939 Comm" DEFAULT_VALUE "UNKNOWN" /end COMPU_VTAB
/begin MEASUREMENT GPS_ENZdot_tmr "GPS speed info wait timer" UWORD Compu_GPS_ENZdot_tmr 0 0 0 65535 ECU_ADDRESS 0x01003EF8 /end MEASUREMENT
/begin COMPU_METHOD Compu_GPS_ENZdot_tmr " " RAT_FUNC "%.0" "ms" COEFFS 0 1 0 0 0 1 /end COMPU_METHOD
/begin MEASUREMENT GPS_Edot "GPS east velocity" SWORD Compu_GPS_Edot 0 0 -512 511.984375 ECU_ADDRESS 0x01003F00 /end MEASUREMENT
/begin COMPU_METHOD Compu_GPS_Edot " " RAT_FUNC "%.1" "km/hr" COEFFS 0 64 0 0 0 1 /end COMPU_METHOD
/begin MEASUREMENT GPS_Ndot "GPS north velocity" SWORD Compu_GPS_Ndot 0 0 -512 511.984375 ECU_ADDRESS 0x01003F08 /end MEASUREMENT
/begin COMPU_METHOD Compu_GPS_Ndot " " RAT_FUNC "%.1" "km/hr" COEFFS 0 64 0 0 0 1 /end COMPU_METHOD
/begin MEASUREMENT GPS_ENZdot_st "GPS speed state{GPS_ENZdot_st&0xff=0:Offline}{GPS_ENZdot_st&0xff=1:Valid}{GPS_ENZdot_st&0xff=2:Error}{GPS_ENZdot_st&0xff=3:Disconnected}{GPS_ENZdot_st&0xff=4:Unacquired}" UBYTE GPS_ENZdot_st_COMPU_VTAB 0 0 0 255 ECU_ADDRESS 0x01003F10 BIT_MASK 0xff /end MEASUREMENT
/begin COMPU_METHOD GPS_ENZdot_st_COMPU_VTAB "Verbal Table" TAB_VERB "%.0" "list" COMPU_TAB_REF GPS_ENZdot_st_COMPU_VTAB_REF /end COMPU_METHOD
/begin COMPU_VTAB GPS_ENZdot_st_COMPU_VTAB_REF "Verbal Table" TAB_VERB 5 0 "Offline" 1 "Valid" 2 "Error" 3 "Disconnected" 4 "Unacquired" DEFAULT_VALUE "UNKNOWN" /end COMPU_VTAB
/begin MEASUREMENT GPS_ENspeed "GPS total speed" UWORD Compu_GPS_ENspeed 0 0 0 255.99609375 ECU_ADDRESS 0x01003F18 /end MEASUREMENT
/begin COMPU_METHOD Compu_GPS_ENspeed " " RAT_FUNC "%.1" "km/hr" COEFFS 0 256 0 0 0 1 /end COMPU_METHOD
/begin CHARACTERISTIC RS_dot_dzlim "Roadspeed acceleration deadzone" VALUE 0x001491DA /* @ECU_Address@RS_dot_dzlim@0x01003F20@ */ ECIPP_ALIGNMENT_SWORD 32 Compu_RS_dot_dzlim -32 31.9990234375 /end CHARACTERISTIC
/begin COMPU_METHOD Compu_RS_dot_dzlim " " RAT_FUNC "%.1" "km/hr/sec" COEFFS 0 1024 0 0 0 1 /end COMPU_METHOD
/begin MEASUREMENT MaxSetPt_RS "RPM-based control roadspeed limt" UWORD Compu_MaxSetPt_RS 0 0 0 255.99609375 ECU_ADDRESS 0x01003F30 /end MEASUREMENT
/begin COMPU_METHOD Compu_MaxSetPt_RS " " RAT_FUNC "%.1" "km/hr" COEFFS 0 256 0 0 0 1 /end COMPU_METHOD
/begin CHARACTERISTIC slowPWMin_ena "Slow PWM input{slowPWMin_ena&0xff=0:Disabled}{slowPWMin_ena&0xff=1:Aux PU1}{slowPWMin_ena&0xff=2:Aux PU2}{slowPWMin_ena&0xff=3:Aux PU3}{slowPWMin_ena&0xff=4:Aux PUD1}{slowPWMin_ena&0xff=5:Aux PUD2}{slowPWMin_ena&0xff=6:Aux PUD3}{slowPWMin_ena&0xff=7:Aux D" VALUE 0x001481b4 /* @ECU_Address@slowPWMin_ena@0x01004100@ */ ECIPP_ALIGNMENT_UBYTE 255 slowPWMin_ena_COMPU_VTAB 0 255 BIT_MASK 0xff /end CHARACTERISTIC
/begin COMPU_METHOD slowPWMin_ena_COMPU_VTAB "Verbal Table" TAB_VERB "%.0" "list" COMPU_TAB_REF slowPWMin_ena_COMPU_VTAB_REF /end COMPU_METHOD
/begin COMPU_VTAB slowPWMin_ena_COMPU_VTAB_REF "Verbal Table" TAB_VERB 10 0 "Disabled" 1 "Aux PU1" 2 "Aux PU2" 3 "Aux PU3" 4 "Aux PUD1" 5 "Aux PUD2" 6 "Aux PUD3" 7 "Aux DIG1" 8 "Aux DIG2" 9 "Aux DIG3" DEFAULT_VALUE "UNKNOWN" /end COMPU_VTAB
/begin CHARACTERISTIC slowPWMin_per_edge "Period computation edge definition{slowPWMin_per_edge&0xff=0:Falling-To-Falling Edge}{slowPWMin_per_edge&0xff=1:Rising-To-Rising Edge}" VALUE 0x001481b5 /* @ECU_Address@slowPWMin_per_edge@0x01004108@ */ ECIPP_ALIGNMENT_UBYTE 255 slowPWMin_per_edge_COMPU_VTAB 0 255 BIT_MASK 0xff /end CHARACTERISTIC
/begin COMPU_METHOD slowPWMin_per_edge_COMPU_VTAB "Verbal Table" TAB_VERB "%.0" "list" COMPU_TAB_REF slowPWMin_per_edge_COMPU_VTAB_REF /end COMPU_METHOD
/begin COMPU_VTAB slowPWMin_per_edge_COMPU_VTAB_REF "Verbal Table" TAB_VERB 2 0 "Falling-To-Falling Edge" 1 "Rising-To-Rising Edge" DEFAULT_VALUE "UNKNOWN" /end COMPU_VTAB
/begin CHARACTERISTIC slowPWMin_tout "Lost signal timeout" VALUE 0x00147b82 /* @ECU_Address@slowPWMin_tout@0x01004110@ */ ECIPP_ALIGNMENT_UWORD 65535 Compu_slowPWMin_tout 0 65535 /end CHARACTERISTIC
/begin COMPU_METHOD Compu_slowPWMin_tout " " RAT_FUNC "%.0" "ms" COEFFS 0 1 0 0 0 1 /end COMPU_METHOD
/begin MEASUREMENT slowPWMin_period "Slow PWM input period" UWORD Compu_slowPWMin_period 0 0 0 65535 ECU_ADDRESS 0x01004118 /end MEASUREMENT
/begin COMPU_METHOD Compu_slowPWMin_period " " RAT_FUNC "%.0" "ms" COEFFS 0 1 0 0 0 1 /end COMPU_METHOD
/begin MEASUREMENT slowPWMin_DC "Slow PWM input duty-cycle" UWORD Compu_slowPWMin_DC 0 0 0 99.9984741210938 ECU_ADDRESS 0x01004120 /end MEASUREMENT
/begin COMPU_METHOD Compu_slowPWMin_DC " " RAT_FUNC "%.1" "%" COEFFS 0 655.36 0 0 0 1 /end COMPU_METHOD
/begin CHARACTERISTIC RS_setsrc "Roadspeed setpoint source{RS_setsrc&0xff=0:Fixed Value}{RS_setsrc&0xff=1:Network Setpoint}{RS_setsrc&0xff=2:Aux PD1 Proportional}{RS_setsrc&0xff=3:Aux PD2 Proportional}{RS_setsrc&0xff=4:Aux PD3 Proportional}{RS_setsrc&0xff=5:Aux PUD1 Proportional}{RS_sets" VALUE 0x00147f13 /* @ECU_Address@RS_setsrc@0x01004128@ */ ECIPP_ALIGNMENT_UBYTE 255 RS_setsrc_COMPU_VTAB 0 255 BIT_MASK 0xff /end CHARACTERISTIC
/begin COMPU_METHOD RS_setsrc_COMPU_VTAB "Verbal Table" TAB_VERB "%.0" "list" COMPU_TAB_REF RS_setsrc_COMPU_VTAB_REF /end COMPU_METHOD
/begin COMPU_VTAB RS_setsrc_COMPU_VTAB_REF "Verbal Table" TAB_VERB 9 0 "Fixed Value" 1 "Network Setpoint" 2 "Aux PD1 Proportional" 3 "Aux PD2 Proportional" 4 "Aux PD3 Proportional" 5 "Aux PUD1 Proportional" 6 "Aux PUD2 Proportional" 7 "Aux PUD3 Proportional" 8 "Gov 1/2/3 Select" DEFAULT_VALUE "UNKNOWN" /end COMPU_VTAB
/begin CHARACTERISTIC sPWMi_DC_lo "Duty-cycle valid if >=" VALUE 0x00147b7a /* @ECU_Address@sPWMi_DC_lo@0x01004130@ */ ECIPP_ALIGNMENT_UWORD 100 Compu_sPWMi_DC_lo 0 99.9984741210938 /end CHARACTERISTIC
/begin COMPU_METHOD Compu_sPWMi_DC_lo " " RAT_FUNC "%.1" "%" COEFFS 0 655.36 0 0 0 1 /end COMPU_METHOD
/begin CHARACTERISTIC sPWMi_DC_hi "Duty-cycle valid if <=" VALUE 0x00147b78 /* @ECU_Address@sPWMi_DC_hi@0x01004138@ */ ECIPP_ALIGNMENT_UWORD 100 Compu_sPWMi_DC_hi 0 99.9984741210938 /end CHARACTERISTIC
/begin COMPU_METHOD Compu_sPWMi_DC_hi " " RAT_FUNC "%.1" "%" COEFFS 0 655.36 0 0 0 1 /end COMPU_METHOD
/begin CHARACTERISTIC sPWMi_per_lo "Period valid if >=" VALUE 0x00147b7e /* @ECU_Address@sPWMi_per_lo@0x01004140@ */ ECIPP_ALIGNMENT_UWORD 65535 Compu_sPWMi_per_lo 0 65535 /end CHARACTERISTIC
/begin COMPU_METHOD Compu_sPWMi_per_lo " " RAT_FUNC "%.0" "ms" COEFFS 0 1 0 0 0 1 /end COMPU_METHOD
/begin CHARACTERISTIC sPWMi_per_hi "Period valid if <=" VALUE 0x00147b7c /* @ECU_Address@sPWMi_per_hi@0x01004148@ */ ECIPP_ALIGNMENT_UWORD 65535 Compu_sPWMi_per_hi 0 65535 /end CHARACTERISTIC
/begin COMPU_METHOD Compu_sPWMi_per_hi " " RAT_FUNC "%.0" "ms" COEFFS 0 1 0 0 0 1 /end COMPU_METHOD
/begin CHARACTERISTIC RS_setsrc_valid "Proportional setpoint redundant validation{RS_setsrc_valid&0xff=0:None Required}{RS_setsrc_valid&0xff=1:Slow PWM Input Valid}" VALUE 0x00147f14 /* @ECU_Address@RS_setsrc_valid@0x01004150@ */ ECIPP_ALIGNMENT_UBYTE 255 RS_setsrc_valid_COMPU_VTAB 0 255 BIT_MASK 0xff /end CHARACTERISTIC
/begin COMPU_METHOD RS_setsrc_valid_COMPU_VTAB "Verbal Table" TAB_VERB "%.0" "list" COMPU_TAB_REF RS_setsrc_valid_COMPU_VTAB_REF /end COMPU_METHOD
/begin COMPU_VTAB RS_setsrc_valid_COMPU_VTAB_REF "Verbal Table" TAB_VERB 2 0 "None Required" 1 "Slow PWM Input Valid" DEFAULT_VALUE "UNKNOWN" /end COMPU_VTAB
/begin MEASUREMENT slowPWMin_valid "Slow PWM input waveform status{slowPWMin_valid&0xff=0:Invalid}{slowPWMin_valid&0xff=1:Valid}" UBYTE slowPWMin_valid_COMPU_VTAB 0 0 0 255 ECU_ADDRESS 0x01004160 BIT_MASK 0xff /end MEASUREMENT
/begin COMPU_METHOD slowPWMin_valid_COMPU_VTAB "Verbal Table" TAB_VERB "%.0" "list" COMPU_TAB_REF slowPWMin_valid_COMPU_VTAB_REF /end COMPU_METHOD
/begin COMPU_VTAB slowPWMin_valid_COMPU_VTAB_REF "Verbal Table" TAB_VERB 2 0 "Invalid" 1 "Valid" DEFAULT_VALUE "UNKNOWN" /end COMPU_VTAB
/begin CHARACTERISTIC RS_prop_tau "Proportional setpoint input low-pass" VALUE 0x00147c26 /* @ECU_Address@RS_prop_tau@0x01004198@ */ ECIPP_ALIGNMENT_UWORD 327680 Compu_RS_prop_tau 0.45084 327680 /end CHARACTERISTIC
/begin COMPU_METHOD Compu_RS_prop_tau " " FORM "%.1" "ms"
 /begin FORMULA "-5 / log(1 - (X1 / 65536))" FORMULA_INV "(1 - exp(-5/X1)) * 65536" /end FORMULA
/end COMPU_METHOD
/begin MEASUREMENT Aqua_setpt_mode "Aquastar setpoint mode{Aqua_setpt_mode&0xff=0:Off}{Aqua_setpt_mode&0xff=1:Vehicle Speed}{Aqua_setpt_mode&0xff=2:Engine RPM}{Aqua_setpt_mode&0xff=3:Not Available}" UBYTE Aqua_setpt_mode_COMPU_VTAB 0 0 0 255 ECU_ADDRESS 0x010045D8 BIT_MASK 0xff /end MEASUREMENT
/begin COMPU_METHOD Aqua_setpt_mode_COMPU_VTAB "Verbal Table" TAB_VERB "%.0" "list" COMPU_TAB_REF Aqua_setpt_mode_COMPU_VTAB_REF /end COMPU_METHOD
/begin COMPU_VTAB Aqua_setpt_mode_COMPU_VTAB_REF "Verbal Table" TAB_VERB 4 0 "Off" 1 "Vehicle Speed" 2 "Engine RPM" 3 "Not Available" DEFAULT_VALUE "UNKNOWN" /end COMPU_VTAB
/begin MEASUREMENT Aqua_setpt_speed "Aquastar ground speed setpoint" UWORD Compu_Aqua_setpt_speed 0 0 0 255.99609375 ECU_ADDRESS 0x010045E0 /end MEASUREMENT
/begin COMPU_METHOD Compu_Aqua_setpt_speed " " RAT_FUNC "%.1" "km/hr" COEFFS 0 256 0 0 0 1 /end COMPU_METHOD
/begin MEASUREMENT Aqua_setpt_rpm "Aquastar engine rpm setpoint" UWORD Compu_Aqua_setpt_rpm 0 0 0 65535 ECU_ADDRESS 0x010045E8 /end MEASUREMENT
/begin COMPU_METHOD Compu_Aqua_setpt_rpm " " RAT_FUNC "%.0" "rpm" COEFFS 0 1 0 0 0 1 /end COMPU_METHOD
/begin MEASUREMENT Aqua_ENdot "Aquastar vehicle speed" SWORD Compu_Aqua_ENdot 0 0 -512 511.984375 ECU_ADDRESS 0x010045F0 /end MEASUREMENT
/begin COMPU_METHOD Compu_Aqua_ENdot " " RAT_FUNC "%.1" "km/hr" COEFFS 0 64 0 0 0 1 /end COMPU_METHOD
/begin MEASUREMENT Aqua_fwdaccel "Aquastar vehicle acceleration" SWORD Compu_Aqua_fwdaccel 0 0 -32 31.9990234375 ECU_ADDRESS 0x010045F8 /end MEASUREMENT
/begin COMPU_METHOD Compu_Aqua_fwdaccel " " RAT_FUNC "%.2" "km/hr/sec" COEFFS 0 1024 0 0 0 1 /end COMPU_METHOD
/begin MEASUREMENT Aqua_fwdaccel_st "Aquastar vehicle acceleration state{Aqua_fwdaccel_st&0xff=0:Offline}{Aqua_fwdaccel_st&0xff=1:Valid}{Aqua_fwdaccel_st&0xff=2:Error}{Aqua_fwdaccel_st&0xff=3:Disconnected}{Aqua_fwdaccel_st&0xff=4:Unacquired}" UBYTE Aqua_fwdaccel_st_COMPU_VTAB 0 0 0 255 ECU_ADDRESS 0x01004600 BIT_MASK 0xff /end MEASUREMENT
/begin COMPU_METHOD Aqua_fwdaccel_st_COMPU_VTAB "Verbal Table" TAB_VERB "%.0" "list" COMPU_TAB_REF Aqua_fwdaccel_st_COMPU_VTAB_REF /end COMPU_METHOD
/begin COMPU_VTAB Aqua_fwdaccel_st_COMPU_VTAB_REF "Verbal Table" TAB_VERB 5 0 "Offline" 1 "Valid" 2 "Error" 3 "Disconnected" 4 "Unacquired" DEFAULT_VALUE "UNKNOWN" /end COMPU_VTAB
/begin CHARACTERISTIC RS_rpmtol_Ifrz "Roadspeed RPM control error Int freeze" VALUE 0x00147740 /* @ECU_Address@RS_rpmtol_Ifrz@0x01004610@ */ ECIPP_ALIGNMENT_UWORD 65535 Compu_RS_rpmtol_Ifrz 0 65535 /end CHARACTERISTIC
/begin COMPU_METHOD Compu_RS_rpmtol_Ifrz " " RAT_FUNC "%.0" "rpm" COEFFS 0 1 0 0 0 1 /end COMPU_METHOD
/begin CHARACTERISTIC RS_Kivapp_RS0 "Roadspeed approach Kiv zero error" VALUE 0x001491EE /* @ECU_Address@RS_Kivapp_RS0@0x01004618@ */ ECIPP_ALIGNMENT_UWORD 256 Compu_RS_Kivapp_RS0 0 255.99609375 /end CHARACTERISTIC
/begin COMPU_METHOD Compu_RS_Kivapp_RS0 " " RAT_FUNC "%.1" "km/hr" COEFFS 0 256 0 0 0 1 /end COMPU_METHOD
/begin CHARACTERISTIC RS_Kivapp_RS100 "Roadspeed approach Kiv full error" VALUE 0x001491F0 /* @ECU_Address@RS_Kivapp_RS100@0x01004620@ */ ECIPP_ALIGNMENT_UWORD 256 Compu_RS_Kivapp_RS100 0 255.99609375 /end CHARACTERISTIC
/begin COMPU_METHOD Compu_RS_Kivapp_RS100 " " RAT_FUNC "%.1" "km/hr" COEFFS 0 256 0 0 0 1 /end COMPU_METHOD
/begin CHARACTERISTIC RS_Kivapp_add "Roadspeed approach Kiv adder" VALUE 0x001491EC /* @ECU_Address@RS_Kivapp_add@0x01004628@ */ ECIPP_ALIGNMENT_UWORD 1600 Compu_RS_Kivapp_add 0 1599.9755859375 /end CHARACTERISTIC
/begin COMPU_METHOD Compu_RS_Kivapp_add " " RAT_FUNC "%.1" "% / (km/hr)" COEFFS 0 40.96 0 0 0 1 /end COMPU_METHOD
/begin MEASUREMENT AL_nonzero "Adaptive Learn State{AL_nonzero&0x01=0x00:Cleared}{AL_nonzero&0x01=0x01:Non-Zero}" UBYTE AL_nonzero_COMPU_VTAB 0 0 0 255 ECU_ADDRESS 0x01004670 BIT_MASK 0x01 /end MEASUREMENT
/begin COMPU_METHOD AL_nonzero_COMPU_VTAB "Verbal Table" TAB_VERB "%.0" "list" COMPU_TAB_REF AL_nonzero_COMPU_VTAB_REF /end COMPU_METHOD
/begin COMPU_VTAB AL_nonzero_COMPU_VTAB_REF "Verbal Table" TAB_VERB 2 0x00 "Cleared" 0x01 "Non-Zero" DEFAULT_VALUE "UNKNOWN" /end COMPU_VTAB
/begin MEASUREMENT TRIM_EGO_ajlean "Lean{TRIM_EGO_ajlean&0x01=0x00:OFF}{TRIM_EGO_ajlean&0x01=0x01:ON}" UBYTE TRIM_EGO_ajlean_COMPU_VTAB 0 0 0 255 ECU_ADDRESS 0x01004680 BIT_MASK 0x01 /end MEASUREMENT
/begin COMPU_METHOD TRIM_EGO_ajlean_COMPU_VTAB "Verbal Table" TAB_VERB "%.0" "list" COMPU_TAB_REF TRIM_EGO_ajlean_COMPU_VTAB_REF /end COMPU_METHOD
/begin COMPU_VTAB TRIM_EGO_ajlean_COMPU_VTAB_REF "Verbal Table" TAB_VERB 2 0x00 "OFF" 0x01 "ON" DEFAULT_VALUE "UNKNOWN" /end COMPU_VTAB
/begin MEASUREMENT TRIM_EGO_ajstoc "Stoich{TRIM_EGO_ajstoc&0x02=0x00:OFF}{TRIM_EGO_ajstoc&0x02=0x02:ON}" UBYTE TRIM_EGO_ajstoc_COMPU_VTAB 0 0 0 255 ECU_ADDRESS 0x01004688 BIT_MASK 0x02 /end MEASUREMENT
/begin COMPU_METHOD TRIM_EGO_ajstoc_COMPU_VTAB "Verbal Table" TAB_VERB "%.0" "list" COMPU_TAB_REF TRIM_EGO_ajstoc_COMPU_VTAB_REF /end COMPU_METHOD
/begin COMPU_VTAB TRIM_EGO_ajstoc_COMPU_VTAB_REF "Verbal Table" TAB_VERB 2 0x00 "OFF" 0x02 "ON" DEFAULT_VALUE "UNKNOWN" /end COMPU_VTAB
/begin MEASUREMENT TRIM_EGO_ajrich "Rich{TRIM_EGO_ajrich&0x04=0x00:OFF}{TRIM_EGO_ajrich&0x04=0x04:ON}" UBYTE TRIM_EGO_ajrich_COMPU_VTAB 0 0 0 255 ECU_ADDRESS 0x01004690 BIT_MASK 0x04 /end MEASUREMENT
/begin COMPU_METHOD TRIM_EGO_ajrich_COMPU_VTAB "Verbal Table" TAB_VERB "%.0" "list" COMPU_TAB_REF TRIM_EGO_ajrich_COMPU_VTAB_REF /end COMPU_METHOD
/begin COMPU_VTAB TRIM_EGO_ajrich_COMPU_VTAB_REF "Verbal Table" TAB_VERB 2 0x00 "OFF" 0x04 "ON" DEFAULT_VALUE "UNKNOWN" /end COMPU_VTAB
/begin MEASUREMENT TRIM_EGO_avg "TRIM_EGO_avg" UWORD Compu_TRIM_EGO_avg 0 0 0 15.999755859375 ECU_ADDRESS 0x01004698 /end MEASUREMENT
/begin COMPU_METHOD Compu_TRIM_EGO_avg " " RAT_FUNC "%.3" "volts" COEFFS 0 4096 0 0 0 1 /end COMPU_METHOD
/begin CHARACTERISTIC RSovsc_ena "Roadspeed overshoot control{RSovsc_ena&0xff=0:Disabled}{RSovsc_ena&0xff=1:Enabled}" VALUE 0x001491D2 /* @ECU_Address@RSovsc_ena@0x01004788@ */ ECIPP_ALIGNMENT_UBYTE 255 RSovsc_ena_COMPU_VTAB 0 255 BIT_MASK 0xff /end CHARACTERISTIC
/begin COMPU_METHOD RSovsc_ena_COMPU_VTAB "Verbal Table" TAB_VERB "%.0" "list" COMPU_TAB_REF RSovsc_ena_COMPU_VTAB_REF /end COMPU_METHOD
/begin COMPU_VTAB RSovsc_ena_COMPU_VTAB_REF "Verbal Table" TAB_VERB 2 0 "Disabled" 1 "Enabled" DEFAULT_VALUE "UNKNOWN" /end COMPU_VTAB
/begin MEASUREMENT RSovsc_armed "Roadspeed overshoot control status{RSovsc_armed&0xff=0:Disarmed}{RSovsc_armed&0xff=1:Armed}{RSovsc_armed&0xff=2:Active}{RSovsc_armed&0xff=3:Phase-Out}" UBYTE RSovsc_armed_COMPU_VTAB 0 0 0 255 ECU_ADDRESS 0x01004790 BIT_MASK 0xff /end MEASUREMENT
/begin COMPU_METHOD RSovsc_armed_COMPU_VTAB "Verbal Table" TAB_VERB "%.0" "list" COMPU_TAB_REF RSovsc_armed_COMPU_VTAB_REF /end COMPU_METHOD
/begin COMPU_VTAB RSovsc_armed_COMPU_VTAB_REF "Verbal Table" TAB_VERB 4 0 "Disarmed" 1 "Armed" 2 "Active" 3 "Phase-Out" DEFAULT_VALUE "UNKNOWN" /end COMPU_VTAB
/begin CHARACTERISTIC RSovsc_Kiv "Single-point overshoot control Kiv" VALUE 0x00149200 /* @ECU_Address@RSovsc_Kiv@0x01004798@ */ ECIPP_ALIGNMENT_SWORD 800 Compu_RSovsc_Kiv -800 799.9755859375 /end CHARACTERISTIC
/begin COMPU_METHOD Compu_RSovsc_Kiv " " RAT_FUNC "%.1" "% / (km/hr)" COEFFS 0 40.96 0 0 0 1 /end COMPU_METHOD
/begin CHARACTERISTIC RSovsc_dIlim "Single-point overshoot control rate limit" VALUE 0x001491FC /* @ECU_Address@RSovsc_dIlim@0x010047A0@ */ ECIPP_ALIGNMENT_ULONG 320000 Compu_RSovsc_dIlim 0 319999.999925494 /end CHARACTERISTIC
/begin COMPU_METHOD Compu_RSovsc_dIlim " " RAT_FUNC "%.1" "% / sec" COEFFS 0 13421.7728 0 0 0 1 /end COMPU_METHOD
/begin CHARACTERISTIC RSovsc_deng "Roadspeed overshoot control engage" VALUE 0x001491F2 /* @ECU_Address@RSovsc_deng@0x010047A8@ */ ECIPP_ALIGNMENT_UWORD 256 Compu_RSovsc_deng 0 255.99609375 /end CHARACTERISTIC
/begin COMPU_METHOD Compu_RSovsc_deng " " RAT_FUNC "%.1" "km/hr" COEFFS 0 256 0 0 0 1 /end COMPU_METHOD
/begin CHARACTERISTIC RSovsc_denghyst "Roadspeed overshoot control hysterisis" VALUE 0x001491F4 /* @ECU_Address@RSovsc_denghyst@0x010047B0@ */ ECIPP_ALIGNMENT_UWORD 256 Compu_RSovsc_denghyst 0 255.99609375 /end CHARACTERISTIC
/begin COMPU_METHOD Compu_RSovsc_denghyst " " RAT_FUNC "%.1" "km/hr" COEFFS 0 256 0 0 0 1 /end COMPU_METHOD
/begin CHARACTERISTIC RS_Kd_accel "Roadspeed control Kd_accel" VALUE 0x001491E6 /* @ECU_Address@RS_Kd_accel@0x010047D0@ */ ECIPP_ALIGNMENT_SWORD 3200 Compu_RS_Kd_accel -3200 3199.90234375 /end CHARACTERISTIC
/begin COMPU_METHOD Compu_RS_Kd_accel " " RAT_FUNC "%.1" "% / (km/hr) * sec" COEFFS 0 10.24 0 0 0 1 /end COMPU_METHOD
/begin CHARACTERISTIC RS_loss "Roadspeed input < (Fault Condition:Roadspeed input <)" VALUE 0x0014772a /* @ECU_Address@RS_loss@0x01004818@ */ ECIPP_ALIGNMENT_UWORD 256 Compu_RS_loss 0 255.99609375 /end CHARACTERISTIC
/begin COMPU_METHOD Compu_RS_loss " " RAT_FUNC "%.1" "km/hr" COEFFS 0 256 0 0 0 1 /end COMPU_METHOD
/begin CHARACTERISTIC RS_loss_RPM "and engine speed > (Fault Condition:and engine speed >)" VALUE 0x0014772e /* @ECU_Address@RS_loss_RPM@0x01004820@ */ ECIPP_ALIGNMENT_UWORD 65535 Compu_RS_loss_RPM 0 65535 /end CHARACTERISTIC
/begin COMPU_METHOD Compu_RS_loss_RPM " " RAT_FUNC "%.0" "rpm" COEFFS 0 1 0 0 0 1 /end COMPU_METHOD
/begin CHARACTERISTIC RS_loss_MAP "and MAP > (Fault Condition:and MAP >)" VALUE 0x0014772c /* @ECU_Address@RS_loss_MAP@0x01004828@ */ ECIPP_ALIGNMENT_UWORD 256 Compu_RS_loss_MAP 0 255.99609375 /end CHARACTERISTIC
/begin COMPU_METHOD Compu_RS_loss_MAP " " RAT_FUNC "%.2" "psia" COEFFS 0 256 0 0 0 1 /end COMPU_METHOD
/begin CHARACTERISTIC RSdrop_rpm_arm "engine speed > (Fault Condition:engine speed >)" VALUE 0x0014774c /* @ECU_Address@RSdrop_rpm_arm@0x01004860@ */ ECIPP_ALIGNMENT_UWORD 65535 Compu_RSdrop_rpm_arm 0 65535 /end CHARACTERISTIC
/begin COMPU_METHOD Compu_RSdrop_rpm_arm " " RAT_FUNC "%.0" "rpm" COEFFS 0 1 0 0 0 1 /end COMPU_METHOD
/begin CHARACTERISTIC RSdrop_kph_arm "with initial roadspeed > (Fault Condition:with initial roadspeed >)" VALUE 0x00147748 /* @ECU_Address@RSdrop_kph_arm@0x01004868@ */ ECIPP_ALIGNMENT_UWORD 256 Compu_RSdrop_kph_arm 0 255.99609375 /end CHARACTERISTIC
/begin COMPU_METHOD Compu_RSdrop_kph_arm " " RAT_FUNC "%.1" "km/hr" COEFFS 0 256 0 0 0 1 /end COMPU_METHOD
/begin CHARACTERISTIC RSdrop_tout_arm "for at least (Fault Condition:for at least)" VALUE 0x0014774e /* @ECU_Address@RSdrop_tout_arm@0x01004870@ */ ECIPP_ALIGNMENT_UWORD 65535 Compu_RSdrop_tout_arm 0 65535 /end CHARACTERISTIC
/begin COMPU_METHOD Compu_RSdrop_tout_arm " " RAT_FUNC "%.0" "ms" COEFFS 0 1 0 0 0 1 /end COMPU_METHOD
/begin CHARACTERISTIC RSdrop_kph_trig "followed by roadspeed <= (Fault Condition:followed by roadspeed <=)" VALUE 0x0014774a /* @ECU_Address@RSdrop_kph_trig@0x01004878@ */ ECIPP_ALIGNMENT_UWORD 256 Compu_RSdrop_kph_trig 0 255.99609375 /end CHARACTERISTIC
/begin COMPU_METHOD Compu_RSdrop_kph_trig " " RAT_FUNC "%.1" "km/hr" COEFFS 0 256 0 0 0 1 /end COMPU_METHOD
/begin CHARACTERISTIC RSdrop_tout_trig "for at least (Fault Condition:for at least)" VALUE 0x00147752 /* @ECU_Address@RSdrop_tout_trig@0x01004880@ */ ECIPP_ALIGNMENT_UWORD 65535 Compu_RSdrop_tout_trig 0 65535 /end CHARACTERISTIC
/begin COMPU_METHOD Compu_RSdrop_tout_trig " " RAT_FUNC "%.0" "ms" COEFFS 0 1 0 0 0 1 /end COMPU_METHOD
/begin CHARACTERISTIC RSdrop_tout_disarm "after dropping roadspeed faster than (Fault Condition:after dropping roadspeed faster than)" VALUE 0x00147750 /* @ECU_Address@RSdrop_tout_disarm@0x01004888@ */ ECIPP_ALIGNMENT_UWORD 65535 Compu_RSdrop_tout_disarm 0 65535 /end CHARACTERISTIC
/begin COMPU_METHOD Compu_RSdrop_tout_disarm " " RAT_FUNC "%.0" "ms" COEFFS 0 1 0 0 0 1 /end COMPU_METHOD
/begin MEASUREMENT RSdrop_status "Roadspeed dropout detection{RSdrop_status&0xff=0:Disarmed}{RSdrop_status&0xff=1:Armed - Monitoring}{RSdrop_status&0xff=2:Dropout Detected}" UBYTE RSdrop_status_COMPU_VTAB 0 0 0 255 ECU_ADDRESS 0x01004890 BIT_MASK 0xff /end MEASUREMENT
/begin COMPU_METHOD RSdrop_status_COMPU_VTAB "Verbal Table" TAB_VERB "%.0" "list" COMPU_TAB_REF RSdrop_status_COMPU_VTAB_REF /end COMPU_METHOD
/begin COMPU_VTAB RSdrop_status_COMPU_VTAB_REF "Verbal Table" TAB_VERB 3 0 "Disarmed" 1 "Armed - Monitoring" 2 "Dropout Detected" DEFAULT_VALUE "UNKNOWN" /end COMPU_VTAB
/begin CHARACTERISTIC RSovsc_table "Roadspeed overshoot gain selection{RSovsc_table&0xff=0:Single Point}{RSovsc_table&0xff=1:Table Based}" VALUE 0x001491D3 /* @ECU_Address@RSovsc_table@0x01004BA0@ */ ECIPP_ALIGNMENT_UBYTE 255 RSovsc_table_COMPU_VTAB 0 255 BIT_MASK 0xff /end CHARACTERISTIC
/begin COMPU_METHOD RSovsc_table_COMPU_VTAB "Verbal Table" TAB_VERB "%.0" "list" COMPU_TAB_REF RSovsc_table_COMPU_VTAB_REF /end COMPU_METHOD
/begin COMPU_VTAB RSovsc_table_COMPU_VTAB_REF "Verbal Table" TAB_VERB 2 0 "Single Point" 1 "Table Based" DEFAULT_VALUE "UNKNOWN" /end COMPU_VTAB
/begin MEASUREMENT RSovsc_Kiv_a "Roadspeed overshoot control Kiv" SWORD Compu_RSovsc_Kiv_a 0 0 -800 799.9755859375 ECU_ADDRESS 0x01004BA8 /end MEASUREMENT
/begin COMPU_METHOD Compu_RSovsc_Kiv_a " " RAT_FUNC "%.1" "% / (km/hr)" COEFFS 0 40.96 0 0 0 1 /end COMPU_METHOD
/begin MEASUREMENT RSovsc_dIlim_a "Roadspeed overshoot control rate limit" ULONG Compu_RSovsc_dIlim_a 0 0 0 319999.999925494 ECU_ADDRESS 0x01004BB0 /end MEASUREMENT
/begin COMPU_METHOD Compu_RSovsc_dIlim_a " " RAT_FUNC "%.1" "% / sec" COEFFS 0 13421.7728 0 0 0 1 /end COMPU_METHOD
/begin MEASUREMENT spk_adv_crk "Crank spark timing value" SWORD Compu_spk_adv_crk 0 0 -2048 2047.9375 ECU_ADDRESS 0x01004BB8 /end MEASUREMENT
/begin COMPU_METHOD Compu_spk_adv_crk " " RAT_FUNC "%.1" "CAD BTDC" COEFFS 0 16 0 0 0 1 /end COMPU_METHOD
/begin MEASUREMENT CrkTT_dcy_t "Crank spark timing transition decay" UWORD Compu_CrkTT_dcy_t 0 0 0 1048.56 ECU_ADDRESS 0x01004BD0 /end MEASUREMENT
/begin COMPU_METHOD Compu_CrkTT_dcy_t " " RAT_FUNC "%.1" "sec" COEFFS 0 62.5 0 0 0 1 /end COMPU_METHOD
/begin MEASUREMENT Aqua_gain_ndx "Aquastar gain selection{Aqua_gain_ndx&0xff=0:A - Normal}{Aqua_gain_ndx&0xff=1:B - Symmetric Low}{Aqua_gain_ndx&0xff=2:C - Reversed A}{Aqua_gain_ndx&0xff=3:Jmp - Symmetric Hi}" UBYTE Aqua_gain_ndx_COMPU_VTAB 0 0 0 255 ECU_ADDRESS 0x01004C20 BIT_MASK 0xff /end MEASUREMENT
/begin COMPU_METHOD Aqua_gain_ndx_COMPU_VTAB "Verbal Table" TAB_VERB "%.0" "list" COMPU_TAB_REF Aqua_gain_ndx_COMPU_VTAB_REF /end COMPU_METHOD
/begin COMPU_VTAB Aqua_gain_ndx_COMPU_VTAB_REF "Verbal Table" TAB_VERB 4 0 "A - Normal" 1 "B - Symmetric Low" 2 "C - Reversed A" 3 "Jmp - Symmetric Hi" DEFAULT_VALUE "UNKNOWN" /end COMPU_VTAB
/begin MEASUREMENT Aqua_spddotd_dis "Roadspeed desired acceleration calculation{Aqua_spddotd_dis&0xff=0:Enabled}{Aqua_spddotd_dis&0xff=1:Disabled}" UBYTE Aqua_spddotd_dis_COMPU_VTAB 0 0 0 255 ECU_ADDRESS 0x01004C90 BIT_MASK 0xff /end MEASUREMENT
/begin COMPU_METHOD Aqua_spddotd_dis_COMPU_VTAB "Verbal Table" TAB_VERB "%.0" "list" COMPU_TAB_REF Aqua_spddotd_dis_COMPU_VTAB_REF /end COMPU_METHOD
/begin COMPU_VTAB Aqua_spddotd_dis_COMPU_VTAB_REF "Verbal Table" TAB_VERB 2 0 "Enabled" 1 "Disabled" DEFAULT_VALUE "UNKNOWN" /end COMPU_VTAB
/begin CHARACTERISTIC RSovsc_Kiv_phout "Roadspeed overshoot Kiv phase-out" VALUE 0x001491F8 /* @ECU_Address@RSovsc_Kiv_phout@0x01004F00@ */ ECIPP_ALIGNMENT_UWORD 66 Compu_RSovsc_Kiv_phout 0 65.535 /end CHARACTERISTIC
/begin COMPU_METHOD Compu_RSovsc_Kiv_phout " " RAT_FUNC "%.1" "sec" COEFFS 0 1000 0 0 0 1 /end COMPU_METHOD
/begin CHARACTERISTIC RS_dot_ovsc_tau "Roadspeed overshoot decel detect tau" VALUE 0x001491F6 /* @ECU_Address@RS_dot_ovsc_tau@0x01004F08@ */ ECIPP_ALIGNMENT_UWORD 163840 Compu_RS_dot_ovsc_tau 0.16703 163840 /end CHARACTERISTIC
/begin COMPU_METHOD Compu_RS_dot_ovsc_tau " " FORM "%.1" "ms"
 /begin FORMULA "-5 / log(1.0000000000001 - (X1 / 32768))" FORMULA_INV "(1.0000000000001 - exp(-5/X1)) * 32768" /end FORMULA
/end COMPU_METHOD
/begin MEASUREMENT RSP_selected "Currently active control parameters{RSP_selected&0xff=0:Set 1}{RSP_selected&0xff=1:Set 2}{RSP_selected&0xff=2:Set 3}" UBYTE RSP_selected_COMPU_VTAB 0 0 0 255 ECU_ADDRESS 0x010053E0 BIT_MASK 0xff /end MEASUREMENT
/begin COMPU_METHOD RSP_selected_COMPU_VTAB "Verbal Table" TAB_VERB "%.0" "list" COMPU_TAB_REF RSP_selected_COMPU_VTAB_REF /end COMPU_METHOD
/begin COMPU_VTAB RSP_selected_COMPU_VTAB_REF "Verbal Table" TAB_VERB 3 0 "Set 1" 1 "Set 2" 2 "Set 3" DEFAULT_VALUE "UNKNOWN" /end COMPU_VTAB
/begin CHARACTERISTIC RS_gainset "Control parameter set selection{RS_gainset&0xff=0:Disabled}{RS_gainset&0xff=1:Default}{RS_gainset&0xff=2:MSP HW}{RS_gainset&0xff=3:MSP Aqua}{RS_gainset&0xff=4:MSP MSC}{RS_gainset&0xff=5:GPS}{RS_gainset&0xff=6:No GPS}{RS_gainset&0xff=7:Net Cfg1}{RS_gainset" VALUE 0x001491D0 /* @ECU_Address@RS_gainset@0x010053E8@ */ ECIPP_ALIGNMENT_UBYTE 255 RS_gainset_COMPU_VTAB 0 255 BIT_MASK 0xff /end CHARACTERISTIC
/begin COMPU_METHOD RS_gainset_COMPU_VTAB "Verbal Table" TAB_VERB "%.0" "list" COMPU_TAB_REF RS_gainset_COMPU_VTAB_REF /end COMPU_METHOD
/begin COMPU_VTAB RS_gainset_COMPU_VTAB_REF "Verbal Table" TAB_VERB 10 0 "Disabled" 1 "Default" 2 "MSP HW" 3 "MSP Aqua" 4 "MSP MSC" 5 "GPS" 6 "No GPS" 7 "Net Cfg1" 8 "Net Cfg2" 9 "Net Cfg3" DEFAULT_VALUE "UNKNOWN" /end COMPU_VTAB
/begin CHARACTERISTIC RS2_gainset "Control parameter set selection 2{RS2_gainset&0xff=0:Disabled}{RS2_gainset&0xff=1:Default}{RS2_gainset&0xff=2:MSP HW}{RS2_gainset&0xff=3:MSP Aqua}{RS2_gainset&0xff=4:MSP MSC}{RS2_gainset&0xff=5:GPS}{RS2_gainset&0xff=6:No GPS}{RS2_gainset&0xff=7:Net Cfg1}{" VALUE 0x0014921C /* @ECU_Address@RS2_gainset@0x010053F0@ */ ECIPP_ALIGNMENT_UBYTE 255 RS2_gainset_COMPU_VTAB 0 255 BIT_MASK 0xff /end CHARACTERISTIC
/begin COMPU_METHOD RS2_gainset_COMPU_VTAB "Verbal Table" TAB_VERB "%.0" "list" COMPU_TAB_REF RS2_gainset_COMPU_VTAB_REF /end COMPU_METHOD
/begin COMPU_VTAB RS2_gainset_COMPU_VTAB_REF "Verbal Table" TAB_VERB 10 0 "Disabled" 1 "Default" 2 "MSP HW" 3 "MSP Aqua" 4 "MSP MSC" 5 "GPS" 6 "No GPS" 7 "Net Cfg1" 8 "Net Cfg2" 9 "Net Cfg3" DEFAULT_VALUE "UNKNOWN" /end COMPU_VTAB
/begin CHARACTERISTIC RS2_source "Roadspeed2 signal source{RS2_source&0xff=0:Pulse Input}{RS2_source&0xff=1:GPS Comm}{RS2_source&0xff=2:J1939 Comm}" VALUE 0x0014921D /* @ECU_Address@RS2_source@0x010053F8@ */ ECIPP_ALIGNMENT_UBYTE 255 RS2_source_COMPU_VTAB 0 255 BIT_MASK 0xff /end CHARACTERISTIC
/begin COMPU_METHOD RS2_source_COMPU_VTAB "Verbal Table" TAB_VERB "%.0" "list" COMPU_TAB_REF RS2_source_COMPU_VTAB_REF /end COMPU_METHOD
/begin COMPU_VTAB RS2_source_COMPU_VTAB_REF "Verbal Table" TAB_VERB 3 0 "Pulse Input" 1 "GPS Comm" 2 "J1939 Comm" DEFAULT_VALUE "UNKNOWN" /end COMPU_VTAB
/begin CHARACTERISTIC RS2ovsc_ena "Roadspeed2 overshoot control{RS2ovsc_ena&0xff=0:Disabled}{RS2ovsc_ena&0xff=1:Enabled}" VALUE 0x0014921E /* @ECU_Address@RS2ovsc_ena@0x01005400@ */ ECIPP_ALIGNMENT_UBYTE 255 RS2ovsc_ena_COMPU_VTAB 0 255 BIT_MASK 0xff /end CHARACTERISTIC
/begin COMPU_METHOD RS2ovsc_ena_COMPU_VTAB "Verbal Table" TAB_VERB "%.0" "list" COMPU_TAB_REF RS2ovsc_ena_COMPU_VTAB_REF /end COMPU_METHOD
/begin COMPU_VTAB RS2ovsc_ena_COMPU_VTAB_REF "Verbal Table" TAB_VERB 2 0 "Disabled" 1 "Enabled" DEFAULT_VALUE "UNKNOWN" /end COMPU_VTAB
/begin CHARACTERISTIC RS2ovsc_table "Roadspeed2 overshoot gain selection{RS2ovsc_table&0xff=0:Single Point}{RS2ovsc_table&0xff=1:Table Based}" VALUE 0x0014921F /* @ECU_Address@RS2ovsc_table@0x01005408@ */ ECIPP_ALIGNMENT_UBYTE 255 RS2ovsc_table_COMPU_VTAB 0 255 BIT_MASK 0xff /end CHARACTERISTIC
/begin COMPU_METHOD RS2ovsc_table_COMPU_VTAB "Verbal Table" TAB_VERB "%.0" "list" COMPU_TAB_REF RS2ovsc_table_COMPU_VTAB_REF /end COMPU_METHOD
/begin COMPU_VTAB RS2ovsc_table_COMPU_VTAB_REF "Verbal Table" TAB_VERB 2 0 "Single Point" 1 "Table Based" DEFAULT_VALUE "UNKNOWN" /end COMPU_VTAB
/begin CHARACTERISTIC RS2_speed_tau "Roadspeed2 speed input low-pass" VALUE 0x00149220 /* @ECU_Address@RS2_speed_tau@0x01005410@ */ ECIPP_ALIGNMENT_UWORD 327680 Compu_RS2_speed_tau 0.45084 327680 /end CHARACTERISTIC
/begin COMPU_METHOD Compu_RS2_speed_tau " " FORM "%.1" "ms"
 /begin FORMULA "-5 / log(1 - (X1 / 65536))" FORMULA_INV "(1 - exp(-5/X1)) * 65536" /end FORMULA
/end COMPU_METHOD
/begin CHARACTERISTIC RS2_dot_tau "Roadspeed2 acceleration low-pass" VALUE 0x00149222 /* @ECU_Address@RS2_dot_tau@0x01005418@ */ ECIPP_ALIGNMENT_UWORD 163840 Compu_RS2_dot_tau 0.16703 163840 /end CHARACTERISTIC
/begin COMPU_METHOD Compu_RS2_dot_tau " " FORM "%.1" "ms"
 /begin FORMULA "-5 / log(1.0000000000001 - (X1 / 32768))" FORMULA_INV "(1.0000000000001 - exp(-5/X1)) * 32768" /end FORMULA
/end COMPU_METHOD
/begin CHARACTERISTIC RS2_dot_window "Roadspeed2 acceleration window" VALUE 0x00149224 /* @ECU_Address@RS2_dot_window@0x01005420@ */ ECIPP_ALIGNMENT_UWORD 65535 Compu_RS2_dot_window 0 65535 /end CHARACTERISTIC
/begin COMPU_METHOD Compu_RS2_dot_window " " RAT_FUNC "%.0" "ms" COEFFS 0 1 0 0 0 1 /end COMPU_METHOD
/begin CHARACTERISTIC RS2_dot_dzlim "Roadspeed2 acceleration deadzone" VALUE 0x00149226 /* @ECU_Address@RS2_dot_dzlim@0x01005428@ */ ECIPP_ALIGNMENT_SWORD 32 Compu_RS2_dot_dzlim -32 31.9990234375 /end CHARACTERISTIC
/begin COMPU_METHOD Compu_RS2_dot_dzlim " " RAT_FUNC "%.1" "km/hr/sec" COEFFS 0 1024 0 0 0 1 /end COMPU_METHOD
/begin CHARACTERISTIC RS2_Kp "Roadspeed2 control Kp" VALUE 0x00149228 /* @ECU_Address@RS2_Kp@0x01005430@ */ ECIPP_ALIGNMENT_SWORD 800 Compu_RS2_Kp -800 799.9755859375 /end CHARACTERISTIC
/begin COMPU_METHOD Compu_RS2_Kp " " RAT_FUNC "%.1" "% / (km/hr)" COEFFS 0 40.96 0 0 0 1 /end COMPU_METHOD
/begin CHARACTERISTIC RS2_Ki "Roadspeed2 control Ki" VALUE 0x0014922E /* @ECU_Address@RS2_Ki@0x01005438@ */ ECIPP_ALIGNMENT_SWORD 400 Compu_RS2_Ki -400 399.98779296875 /end CHARACTERISTIC
/begin COMPU_METHOD Compu_RS2_Ki " " RAT_FUNC "%.1" "% / (km/hr) / sec" COEFFS 0 81.92 0 0 0 1 /end COMPU_METHOD
/begin CHARACTERISTIC RS2_Kd "Roadspeed2 control Kd / Kd_decel" VALUE 0x00149230 /* @ECU_Address@RS2_Kd@0x01005440@ */ ECIPP_ALIGNMENT_SWORD 3200 Compu_RS2_Kd -3200 3199.90234375 /end CHARACTERISTIC
/begin COMPU_METHOD Compu_RS2_Kd " " RAT_FUNC "%.1" "% / (km/hr) * sec" COEFFS 0 10.24 0 0 0 1 /end COMPU_METHOD
/begin CHARACTERISTIC RS2_Kd_accel "Roadspeed2 control Kd_accel" VALUE 0x00149232 /* @ECU_Address@RS2_Kd_accel@0x01005448@ */ ECIPP_ALIGNMENT_SWORD 3200 Compu_RS2_Kd_accel -3200 3199.90234375 /end CHARACTERISTIC
/begin COMPU_METHOD Compu_RS2_Kd_accel " " RAT_FUNC "%.1" "% / (km/hr) * sec" COEFFS 0 10.24 0 0 0 1 /end COMPU_METHOD
/begin CHARACTERISTIC RS2_Kiv "Roadspeed2 control Kiv" VALUE 0x00149234 /* @ECU_Address@RS2_Kiv@0x01005450@ */ ECIPP_ALIGNMENT_SWORD 800 Compu_RS2_Kiv -800 799.9755859375 /end CHARACTERISTIC
/begin COMPU_METHOD Compu_RS2_Kiv " " RAT_FUNC "%.1" "% / (km/hr)" COEFFS 0 40.96 0 0 0 1 /end COMPU_METHOD
/begin CHARACTERISTIC RS2_TPS_tau "Roadspeed2 control output low-pass" VALUE 0x00149236 /* @ECU_Address@RS2_TPS_tau@0x01005458@ */ ECIPP_ALIGNMENT_UWORD 327680 Compu_RS2_TPS_tau 0.45084 327680 /end CHARACTERISTIC
/begin COMPU_METHOD Compu_RS2_TPS_tau " " FORM "%.1" "ms"
 /begin FORMULA "-5 / log(1 - (X1 / 65536))" FORMULA_INV "(1 - exp(-5/X1)) * 65536" /end FORMULA
/end COMPU_METHOD
/begin CHARACTERISTIC RS2_Kivapp_add "Roadspeed2 approach Kiv adder" VALUE 0x00149238 /* @ECU_Address@RS2_Kivapp_add@0x01005460@ */ ECIPP_ALIGNMENT_UWORD 1600 Compu_RS2_Kivapp_add 0 1599.9755859375 /end CHARACTERISTIC
/begin COMPU_METHOD Compu_RS2_Kivapp_add " " RAT_FUNC "%.1" "% / (km/hr)" COEFFS 0 40.96 0 0 0 1 /end COMPU_METHOD
/begin CHARACTERISTIC RS2_Kivapp_RS0 "Roadspeed2 approach Kiv zero error" VALUE 0x0014923A /* @ECU_Address@RS2_Kivapp_RS0@0x01005468@ */ ECIPP_ALIGNMENT_UWORD 256 Compu_RS2_Kivapp_RS0 0 255.99609375 /end CHARACTERISTIC
/begin COMPU_METHOD Compu_RS2_Kivapp_RS0 " " RAT_FUNC "%.1" "km/hr" COEFFS 0 256 0 0 0 1 /end COMPU_METHOD
/begin CHARACTERISTIC RS2_Kivapp_RS100 "Roadspeed2 approach Kiv full error" VALUE 0x0014923C /* @ECU_Address@RS2_Kivapp_RS100@0x01005470@ */ ECIPP_ALIGNMENT_UWORD 256 Compu_RS2_Kivapp_RS100 0 255.99609375 /end CHARACTERISTIC
/begin COMPU_METHOD Compu_RS2_Kivapp_RS100 " " RAT_FUNC "%.1" "km/hr" COEFFS 0 256 0 0 0 1 /end COMPU_METHOD
/begin CHARACTERISTIC RS2ovsc_deng "Roadspeed2 overshoot control engage" VALUE 0x0014923E /* @ECU_Address@RS2ovsc_deng@0x01005478@ */ ECIPP_ALIGNMENT_UWORD 256 Compu_RS2ovsc_deng 0 255.99609375 /end CHARACTERISTIC
/begin COMPU_METHOD Compu_RS2ovsc_deng " " RAT_FUNC "%.1" "km/hr" COEFFS 0 256 0 0 0 1 /end COMPU_METHOD
/begin CHARACTERISTIC RS2ovsc_denghyst "Roadspeed2 overshoot control hysterisis" VALUE 0x00149240 /* @ECU_Address@RS2ovsc_denghyst@0x01005480@ */ ECIPP_ALIGNMENT_UWORD 256 Compu_RS2ovsc_denghyst 0 255.99609375 /end CHARACTERISTIC
/begin COMPU_METHOD Compu_RS2ovsc_denghyst " " RAT_FUNC "%.1" "km/hr" COEFFS 0 256 0 0 0 1 /end COMPU_METHOD
/begin CHARACTERISTIC RS2_dot_ovsc_tau "Roadspeed2 overshoot decel detect tau" VALUE 0x00149242 /* @ECU_Address@RS2_dot_ovsc_tau@0x01005488@ */ ECIPP_ALIGNMENT_UWORD 163840 Compu_RS2_dot_ovsc_tau 0.16703 163840 /end CHARACTERISTIC
/begin COMPU_METHOD Compu_RS2_dot_ovsc_tau " " FORM "%.1" "ms"
 /begin FORMULA "-5 / log(1.0000000000001 - (X1 / 32768))" FORMULA_INV "(1.0000000000001 - exp(-5/X1)) * 32768" /end FORMULA
/end COMPU_METHOD
/begin CHARACTERISTIC RS2ovsc_Kiv_phout "Roadspeed2 overshoot Kiv phase-out" VALUE 0x00149244 /* @ECU_Address@RS2ovsc_Kiv_phout@0x01005490@ */ ECIPP_ALIGNMENT_UWORD 66 Compu_RS2ovsc_Kiv_phout 0 65.535 /end CHARACTERISTIC
/begin COMPU_METHOD Compu_RS2ovsc_Kiv_phout " " RAT_FUNC "%.1" "sec" COEFFS 0 1000 0 0 0 1 /end COMPU_METHOD
/begin CHARACTERISTIC RS2ovsc_dIlim "RS2 Single-point overshoot control rate limit" VALUE 0x00149248 /* @ECU_Address@RS2ovsc_dIlim@0x01005498@ */ ECIPP_ALIGNMENT_ULONG 320000 Compu_RS2ovsc_dIlim 0 319999.999925494 /end CHARACTERISTIC
/begin COMPU_METHOD Compu_RS2ovsc_dIlim " " RAT_FUNC "%.1" "% / sec" COEFFS 0 13421.7728 0 0 0 1 /end COMPU_METHOD
/begin CHARACTERISTIC RS2ovsc_Kiv "RS2 Single-point overshoot control Kiv" VALUE 0x0014924C /* @ECU_Address@RS2ovsc_Kiv@0x010054A0@ */ ECIPP_ALIGNMENT_SWORD 800 Compu_RS2ovsc_Kiv -800 799.9755859375 /end CHARACTERISTIC
/begin COMPU_METHOD Compu_RS2ovsc_Kiv " " RAT_FUNC "%.1" "% / (km/hr)" COEFFS 0 40.96 0 0 0 1 /end COMPU_METHOD
/begin CHARACTERISTIC RS3_gainset "Control parameter set selection 3{RS3_gainset&0xff=0:Disabled}{RS3_gainset&0xff=1:Default}{RS3_gainset&0xff=2:MSP HW}{RS3_gainset&0xff=3:MSP Aqua}{RS3_gainset&0xff=4:MSP MSC}{RS3_gainset&0xff=5:GPS}{RS3_gainset&0xff=6:No GPS}{RS3_gainset&0xff=7:Net Cfg1}{" VALUE 0x00149268 /* @ECU_Address@RS3_gainset@0x010054A8@ */ ECIPP_ALIGNMENT_UBYTE 255 RS3_gainset_COMPU_VTAB 0 255 BIT_MASK 0xff /end CHARACTERISTIC
/begin COMPU_METHOD RS3_gainset_COMPU_VTAB "Verbal Table" TAB_VERB "%.0" "list" COMPU_TAB_REF RS3_gainset_COMPU_VTAB_REF /end COMPU_METHOD
/begin COMPU_VTAB RS3_gainset_COMPU_VTAB_REF "Verbal Table" TAB_VERB 10 0 "Disabled" 1 "Default" 2 "MSP HW" 3 "MSP Aqua" 4 "MSP MSC" 5 "GPS" 6 "No GPS" 7 "Net Cfg1" 8 "Net Cfg2" 9 "Net Cfg3" DEFAULT_VALUE "UNKNOWN" /end COMPU_VTAB
/begin CHARACTERISTIC RS3_source "Roadspeed3 signal source{RS3_source&0xff=0:Pulse Input}{RS3_source&0xff=1:GPS Comm}{RS3_source&0xff=2:J1939 Comm}" VALUE 0x00149269 /* @ECU_Address@RS3_source@0x010054B0@ */ ECIPP_ALIGNMENT_UBYTE 255 RS3_source_COMPU_VTAB 0 255 BIT_MASK 0xff /end CHARACTERISTIC
/begin COMPU_METHOD RS3_source_COMPU_VTAB "Verbal Table" TAB_VERB "%.0" "list" COMPU_TAB_REF RS3_source_COMPU_VTAB_REF /end COMPU_METHOD
/begin COMPU_VTAB RS3_source_COMPU_VTAB_REF "Verbal Table" TAB_VERB 3 0 "Pulse Input" 1 "GPS Comm" 2 "J1939 Comm" DEFAULT_VALUE "UNKNOWN" /end COMPU_VTAB
/begin CHARACTERISTIC RS3ovsc_ena "Roadspeed3 overshoot control{RS3ovsc_ena&0xff=0:Disabled}{RS3ovsc_ena&0xff=1:Enabled}" VALUE 0x0014926A /* @ECU_Address@RS3ovsc_ena@0x010054B8@ */ ECIPP_ALIGNMENT_UBYTE 255 RS3ovsc_ena_COMPU_VTAB 0 255 BIT_MASK 0xff /end CHARACTERISTIC
/begin COMPU_METHOD RS3ovsc_ena_COMPU_VTAB "Verbal Table" TAB_VERB "%.0" "list" COMPU_TAB_REF RS3ovsc_ena_COMPU_VTAB_REF /end COMPU_METHOD
/begin COMPU_VTAB RS3ovsc_ena_COMPU_VTAB_REF "Verbal Table" TAB_VERB 2 0 "Disabled" 1 "Enabled" DEFAULT_VALUE "UNKNOWN" /end COMPU_VTAB
/begin CHARACTERISTIC RS3ovsc_table "Roadspeed3 overshoot gain selection{RS3ovsc_table&0xff=0:Single Point}{RS3ovsc_table&0xff=1:Table Based}" VALUE 0x0014926B /* @ECU_Address@RS3ovsc_table@0x010054C0@ */ ECIPP_ALIGNMENT_UBYTE 255 RS3ovsc_table_COMPU_VTAB 0 255 BIT_MASK 0xff /end CHARACTERISTIC
/begin COMPU_METHOD RS3ovsc_table_COMPU_VTAB "Verbal Table" TAB_VERB "%.0" "list" COMPU_TAB_REF RS3ovsc_table_COMPU_VTAB_REF /end COMPU_METHOD
/begin COMPU_VTAB RS3ovsc_table_COMPU_VTAB_REF "Verbal Table" TAB_VERB 2 0 "Single Point" 1 "Table Based" DEFAULT_VALUE "UNKNOWN" /end COMPU_VTAB
/begin CHARACTERISTIC RS3_speed_tau "Roadspeed3 speed input low-pass" VALUE 0x0014926C /* @ECU_Address@RS3_speed_tau@0x010054C8@ */ ECIPP_ALIGNMENT_UWORD 327680 Compu_RS3_speed_tau 0.45084 327680 /end CHARACTERISTIC
/begin COMPU_METHOD Compu_RS3_speed_tau " " FORM "%.1" "ms"
 /begin FORMULA "-5 / log(1 - (X1 / 65536))" FORMULA_INV "(1 - exp(-5/X1)) * 65536" /end FORMULA
/end COMPU_METHOD
/begin CHARACTERISTIC RS3_dot_tau "Roadspeed3 acceleration low-pass" VALUE 0x0014926E /* @ECU_Address@RS3_dot_tau@0x010054D0@ */ ECIPP_ALIGNMENT_UWORD 163840 Compu_RS3_dot_tau 0.16703 163840 /end CHARACTERISTIC
/begin COMPU_METHOD Compu_RS3_dot_tau " " FORM "%.1" "ms"
 /begin FORMULA "-5 / log(1.0000000000001 - (X1 / 32768))" FORMULA_INV "(1.0000000000001 - exp(-5/X1)) * 32768" /end FORMULA
/end COMPU_METHOD
/begin CHARACTERISTIC RS3_dot_window "Roadspeed3 acceleration window" VALUE 0x00149270 /* @ECU_Address@RS3_dot_window@0x010054D8@ */ ECIPP_ALIGNMENT_UWORD 65535 Compu_RS3_dot_window 0 65535 /end CHARACTERISTIC
/begin COMPU_METHOD Compu_RS3_dot_window " " RAT_FUNC "%.0" "ms" COEFFS 0 1 0 0 0 1 /end COMPU_METHOD
/begin CHARACTERISTIC RS3_dot_dzlim "Roadspeed3 acceleration deadzone" VALUE 0x00149272 /* @ECU_Address@RS3_dot_dzlim@0x010054E0@ */ ECIPP_ALIGNMENT_SWORD 32 Compu_RS3_dot_dzlim -32 31.9990234375 /end CHARACTERISTIC
/begin COMPU_METHOD Compu_RS3_dot_dzlim " " RAT_FUNC "%.1" "km/hr/sec" COEFFS 0 1024 0 0 0 1 /end COMPU_METHOD
/begin CHARACTERISTIC RS3_Kp "Roadspeed3 control Kp" VALUE 0x00149274 /* @ECU_Address@RS3_Kp@0x010054E8@ */ ECIPP_ALIGNMENT_SWORD 800 Compu_RS3_Kp -800 799.9755859375 /end CHARACTERISTIC
/begin COMPU_METHOD Compu_RS3_Kp " " RAT_FUNC "%.1" "% / (km/hr)" COEFFS 0 40.96 0 0 0 1 /end COMPU_METHOD
/begin CHARACTERISTIC RS3_Ki "Roadspeed3 control Ki" VALUE 0x0014927A /* @ECU_Address@RS3_Ki@0x010054F0@ */ ECIPP_ALIGNMENT_SWORD 400 Compu_RS3_Ki -400 399.98779296875 /end CHARACTERISTIC
/begin COMPU_METHOD Compu_RS3_Ki " " RAT_FUNC "%.1" "% / (km/hr) / sec" COEFFS 0 81.92 0 0 0 1 /end COMPU_METHOD
/begin CHARACTERISTIC RS3_Kd "Roadspeed3 control Kd / Kd_decel" VALUE 0x0014927C /* @ECU_Address@RS3_Kd@0x010054F8@ */ ECIPP_ALIGNMENT_SWORD 3200 Compu_RS3_Kd -3200 3199.90234375 /end CHARACTERISTIC
/begin COMPU_METHOD Compu_RS3_Kd " " RAT_FUNC "%.1" "% / (km/hr) * sec" COEFFS 0 10.24 0 0 0 1 /end COMPU_METHOD
/begin CHARACTERISTIC RS3_Kd_accel "Roadspeed3 control Kd_accel" VALUE 0x0014927E /* @ECU_Address@RS3_Kd_accel@0x01005500@ */ ECIPP_ALIGNMENT_SWORD 3200 Compu_RS3_Kd_accel -3200 3199.90234375 /end CHARACTERISTIC
/begin COMPU_METHOD Compu_RS3_Kd_accel " " RAT_FUNC "%.1" "% / (km/hr) * sec" COEFFS 0 10.24 0 0 0 1 /end COMPU_METHOD
/begin CHARACTERISTIC RS3_Kiv "Roadspeed3 control Kiv" VALUE 0x00149280 /* @ECU_Address@RS3_Kiv@0x01005508@ */ ECIPP_ALIGNMENT_SWORD 800 Compu_RS3_Kiv -800 799.9755859375 /end CHARACTERISTIC
/begin COMPU_METHOD Compu_RS3_Kiv " " RAT_FUNC "%.1" "% / (km/hr)" COEFFS 0 40.96 0 0 0 1 /end COMPU_METHOD
/begin CHARACTERISTIC RS3_TPS_tau "Roadspeed3 control output low-pass" VALUE 0x00149282 /* @ECU_Address@RS3_TPS_tau@0x01005510@ */ ECIPP_ALIGNMENT_UWORD 327680 Compu_RS3_TPS_tau 0.45084 327680 /end CHARACTERISTIC
/begin COMPU_METHOD Compu_RS3_TPS_tau " " FORM "%.1" "ms"
 /begin FORMULA "-5 / log(1 - (X1 / 65536))" FORMULA_INV "(1 - exp(-5/X1)) * 65536" /end FORMULA
/end COMPU_METHOD
/begin CHARACTERISTIC RS3_Kivapp_add "Roadspeed3 approach Kiv adder" VALUE 0x00149284 /* @ECU_Address@RS3_Kivapp_add@0x01005518@ */ ECIPP_ALIGNMENT_UWORD 1600 Compu_RS3_Kivapp_add 0 1599.9755859375 /end CHARACTERISTIC
/begin COMPU_METHOD Compu_RS3_Kivapp_add " " RAT_FUNC "%.1" "% / (km/hr)" COEFFS 0 40.96 0 0 0 1 /end COMPU_METHOD
/begin CHARACTERISTIC RS3_Kivapp_RS0 "Roadspeed3 approach Kiv zero error" VALUE 0x00149286 /* @ECU_Address@RS3_Kivapp_RS0@0x01005520@ */ ECIPP_ALIGNMENT_UWORD 256 Compu_RS3_Kivapp_RS0 0 255.99609375 /end CHARACTERISTIC
/begin COMPU_METHOD Compu_RS3_Kivapp_RS0 " " RAT_FUNC "%.1" "km/hr" COEFFS 0 256 0 0 0 1 /end COMPU_METHOD
/begin CHARACTERISTIC RS3_Kivapp_RS100 "Roadspeed3 approach Kiv full error" VALUE 0x00149288 /* @ECU_Address@RS3_Kivapp_RS100@0x01005528@ */ ECIPP_ALIGNMENT_UWORD 256 Compu_RS3_Kivapp_RS100 0 255.99609375 /end CHARACTERISTIC
/begin COMPU_METHOD Compu_RS3_Kivapp_RS100 " " RAT_FUNC "%.1" "km/hr" COEFFS 0 256 0 0 0 1 /end COMPU_METHOD
/begin CHARACTERISTIC RS3ovsc_deng "Roadspeed3 overshoot control engage" VALUE 0x0014928A /* @ECU_Address@RS3ovsc_deng@0x01005530@ */ ECIPP_ALIGNMENT_UWORD 256 Compu_RS3ovsc_deng 0 255.99609375 /end CHARACTERISTIC
/begin COMPU_METHOD Compu_RS3ovsc_deng " " RAT_FUNC "%.1" "km/hr" COEFFS 0 256 0 0 0 1 /end COMPU_METHOD
/begin CHARACTERISTIC RS3ovsc_denghyst "Roadspeed3 overshoot control hysterisis" VALUE 0x0014928C /* @ECU_Address@RS3ovsc_denghyst@0x01005538@ */ ECIPP_ALIGNMENT_UWORD 256 Compu_RS3ovsc_denghyst 0 255.99609375 /end CHARACTERISTIC
/begin COMPU_METHOD Compu_RS3ovsc_denghyst " " RAT_FUNC "%.1" "km/hr" COEFFS 0 256 0 0 0 1 /end COMPU_METHOD
/begin CHARACTERISTIC RS3_dot_ovsc_tau "Roadspeed3 overshoot decel detect tau" VALUE 0x0014928E /* @ECU_Address@RS3_dot_ovsc_tau@0x01005540@ */ ECIPP_ALIGNMENT_UWORD 163840 Compu_RS3_dot_ovsc_tau 0.16703 163840 /end CHARACTERISTIC
/begin COMPU_METHOD Compu_RS3_dot_ovsc_tau " " FORM "%.1" "ms"
 /begin FORMULA "-5 / log(1.0000000000001 - (X1 / 32768))" FORMULA_INV "(1.0000000000001 - exp(-5/X1)) * 32768" /end FORMULA
/end COMPU_METHOD
/begin CHARACTERISTIC RS3ovsc_Kiv_phout "Roadspeed3 overshoot Kiv phase-out" VALUE 0x00149290 /* @ECU_Address@RS3ovsc_Kiv_phout@0x01005548@ */ ECIPP_ALIGNMENT_UWORD 66 Compu_RS3ovsc_Kiv_phout 0 65.535 /end CHARACTERISTIC
/begin COMPU_METHOD Compu_RS3ovsc_Kiv_phout " " RAT_FUNC "%.1" "sec" COEFFS 0 1000 0 0 0 1 /end COMPU_METHOD
/begin CHARACTERISTIC RS3ovsc_dIlim "RS3 Single-point overshoot control rate limit" VALUE 0x00149294 /* @ECU_Address@RS3ovsc_dIlim@0x01005550@ */ ECIPP_ALIGNMENT_ULONG 320000 Compu_RS3ovsc_dIlim 0 319999.999925494 /end CHARACTERISTIC
/begin COMPU_METHOD Compu_RS3ovsc_dIlim " " RAT_FUNC "%.1" "% / sec" COEFFS 0 13421.7728 0 0 0 1 /end COMPU_METHOD
/begin CHARACTERISTIC RS3ovsc_Kiv "RS3 Single-point overshoot control Kiv" VALUE 0x00149298 /* @ECU_Address@RS3ovsc_Kiv@0x01005558@ */ ECIPP_ALIGNMENT_SWORD 800 Compu_RS3ovsc_Kiv -800 799.9755859375 /end CHARACTERISTIC
/begin COMPU_METHOD Compu_RS3ovsc_Kiv " " RAT_FUNC "%.1" "% / (km/hr)" COEFFS 0 40.96 0 0 0 1 /end COMPU_METHOD
/begin MEASUREMENT svn_remote_compiled "Remote compiled{svn_remote_compiled&0x01=0x00:NO}{svn_remote_compiled&0x01=0x01:YES}" UBYTE svn_remote_compiled_COMPU_VTAB 0 0 0 255 ECU_ADDRESS 0x01006680 BIT_MASK 0x01 /end MEASUREMENT
/begin COMPU_METHOD svn_remote_compiled_COMPU_VTAB "Verbal Table" TAB_VERB "%.0" "list" COMPU_TAB_REF svn_remote_compiled_COMPU_VTAB_REF /end COMPU_METHOD
/begin COMPU_VTAB svn_remote_compiled_COMPU_VTAB_REF "Verbal Table" TAB_VERB 2 0x00 "NO" 0x01 "YES" DEFAULT_VALUE "UNKNOWN" /end COMPU_VTAB
/begin MEASUREMENT svn_mixed "SVN mixed revisions{svn_mixed&0x02=0x00:NO}{svn_mixed&0x02=0x02:YES}" UBYTE svn_mixed_COMPU_VTAB 0 0 0 255 ECU_ADDRESS 0x01006688 BIT_MASK 0x02 /end MEASUREMENT
/begin COMPU_METHOD svn_mixed_COMPU_VTAB "Verbal Table" TAB_VERB "%.0" "list" COMPU_TAB_REF svn_mixed_COMPU_VTAB_REF /end COMPU_METHOD
/begin COMPU_VTAB svn_mixed_COMPU_VTAB_REF "Verbal Table" TAB_VERB 2 0x00 "NO" 0x02 "YES" DEFAULT_VALUE "UNKNOWN" /end COMPU_VTAB
/begin MEASUREMENT svn_modified "SVN modified{svn_modified&0x04=0x00:NO}{svn_modified&0x04=0x04:YES}" UBYTE svn_modified_COMPU_VTAB 0 0 0 255 ECU_ADDRESS 0x01006690 BIT_MASK 0x04 /end MEASUREMENT
/begin COMPU_METHOD svn_modified_COMPU_VTAB "Verbal Table" TAB_VERB "%.0" "list" COMPU_TAB_REF svn_modified_COMPU_VTAB_REF /end COMPU_METHOD
/begin COMPU_VTAB svn_modified_COMPU_VTAB_REF "Verbal Table" TAB_VERB 2 0x00 "NO" 0x04 "YES" DEFAULT_VALUE "UNKNOWN" /end COMPU_VTAB
/begin MEASUREMENT svn_compile_date_str "SVN compile date str" ULONG Compu_svn_compile_date_str 0 0 0 4294967295 ECU_ADDRESS 0x01006698 /end MEASUREMENT
/begin COMPU_METHOD Compu_svn_compile_date_str " " RAT_FUNC "%.0" "-" COEFFS 0 1 0 0 0 1 /end COMPU_METHOD
/begin CHARACTERISTIC dwell_d_amp "Dwell target" VALUE 0x001465e2 /* @ECU_Address@dwell_d_amp@0x010069E0@ */ ECIPP_ALIGNMENT_SWORD 32 Compu_dwell_d_amp -32 31.9990234375 /end CHARACTERISTIC
/begin COMPU_METHOD Compu_dwell_d_amp " " RAT_FUNC "%.3" "amps" COEFFS 0 1024 0 0 0 1 /end COMPU_METHOD
/begin CHARACTERISTIC dwell_def "Dwell default" VALUE 0x00147ae4 /* @ECU_Address@dwell_def@0x010069E8@ */ ECIPP_ALIGNMENT_UWORD 210 Compu_dwell_def 0 209.712 /end CHARACTERISTIC
/begin COMPU_METHOD Compu_dwell_def " " RAT_FUNC "%.2" "ms" COEFFS 0 312.5 0 0 0 1 /end COMPU_METHOD
/begin CHARACTERISTIC dwell_min "Dwell min" VALUE 0x00147ae8 /* @ECU_Address@dwell_min@0x010069F0@ */ ECIPP_ALIGNMENT_UWORD 210 Compu_dwell_min 0 209.712 /end CHARACTERISTIC
/begin COMPU_METHOD Compu_dwell_min " " RAT_FUNC "%.2" "ms" COEFFS 0 312.5 0 0 0 1 /end COMPU_METHOD
/begin CHARACTERISTIC dwell_max "Dwell max" VALUE 0x00147ae6 /* @ECU_Address@dwell_max@0x010069F8@ */ ECIPP_ALIGNMENT_UWORD 210 Compu_dwell_max 0 209.712 /end CHARACTERISTIC
/begin COMPU_METHOD Compu_dwell_max " " RAT_FUNC "%.2" "ms" COEFFS 0 312.5 0 0 0 1 /end COMPU_METHOD
/begin CHARACTERISTIC dwell_shorted "Shorted primary coil dwell" VALUE 0x00147aee /* @ECU_Address@dwell_shorted@0x01006A00@ */ ECIPP_ALIGNMENT_UWORD 210 Compu_dwell_shorted 0 209.712 /end CHARACTERISTIC
/begin COMPU_METHOD Compu_dwell_shorted " " RAT_FUNC "%.2" "ms" COEFFS 0 312.5 0 0 0 1 /end COMPU_METHOD
/begin CHARACTERISTIC spk_min_dissipate "Minimum coil dissipation time" VALUE 0x00147b8c /* @ECU_Address@spk_min_dissipate@0x01006A08@ */ ECIPP_ALIGNMENT_UWORD 210 Compu_spk_min_dissipate 0 209.712 /end CHARACTERISTIC
/begin COMPU_METHOD Compu_spk_min_dissipate " " RAT_FUNC "%.2" "ms" COEFFS 0 312.5 0 0 0 1 /end COMPU_METHOD
/begin CHARACTERISTIC dwell_crk_add "Dwell crank extra" VALUE 0x00147ae0 /* @ECU_Address@dwell_crk_add@0x01006A10@ */ ECIPP_ALIGNMENT_UWORD 210 Compu_dwell_crk_add 0 209.712 /end CHARACTERISTIC
/begin COMPU_METHOD Compu_dwell_crk_add " " RAT_FUNC "%.2" "ms" COEFFS 0 312.5 0 0 0 1 /end COMPU_METHOD
/begin CHARACTERISTIC dwell_crk_rpm "Dwell crank rpm" VALUE 0x00147ae2 /* @ECU_Address@dwell_crk_rpm@0x01006A18@ */ ECIPP_ALIGNMENT_UWORD 65535 Compu_dwell_crk_rpm 0 65535 /end CHARACTERISTIC
/begin COMPU_METHOD Compu_dwell_crk_rpm " " RAT_FUNC "%.0" "rpm" COEFFS 0 1 0 0 0 1 /end COMPU_METHOD
/begin CHARACTERISTIC dwell_min_Vbat "Dwell adapt min battery voltage" VALUE 0x00147aea /* @ECU_Address@dwell_min_Vbat@0x01006A20@ */ ECIPP_ALIGNMENT_UWORD 256 Compu_dwell_min_Vbat 0 255.99609375 /end CHARACTERISTIC
/begin COMPU_METHOD Compu_dwell_min_Vbat " " RAT_FUNC "%.1" "volts" COEFFS 0 256 0 0 0 1 /end COMPU_METHOD
/begin MEASUREMENT coil1_drv_latch "Coil1 (FO) drive" UWORD Compu_coil1_drv_latch 0 0 0 100.022893772894 ECU_ADDRESS 0x01006BD8 /end MEASUREMENT
/begin COMPU_METHOD Compu_coil1_drv_latch " " RAT_FUNC "%.1" "% FS" COEFFS 0 655.2 0 0 0 1 /end COMPU_METHOD
/begin MEASUREMENT coil2_drv_latch "Coil2 (FO) drive" UWORD Compu_coil2_drv_latch 0 0 0 100.022893772894 ECU_ADDRESS 0x01006BE0 /end MEASUREMENT
/begin COMPU_METHOD Compu_coil2_drv_latch " " RAT_FUNC "%.1" "% FS" COEFFS 0 655.2 0 0 0 1 /end COMPU_METHOD
/begin MEASUREMENT coil3_drv_latch "Coil3 (FO) drive" UWORD Compu_coil3_drv_latch 0 0 0 100.022893772894 ECU_ADDRESS 0x01006BE8 /end MEASUREMENT
/begin COMPU_METHOD Compu_coil3_drv_latch " " RAT_FUNC "%.1" "% FS" COEFFS 0 655.2 0 0 0 1 /end COMPU_METHOD
/begin MEASUREMENT coil4_drv_latch "Coil4 (FO) drive" UWORD Compu_coil4_drv_latch 0 0 0 100.022893772894 ECU_ADDRESS 0x01006BF0 /end MEASUREMENT
/begin COMPU_METHOD Compu_coil4_drv_latch " " RAT_FUNC "%.1" "% FS" COEFFS 0 655.2 0 0 0 1 /end COMPU_METHOD
/begin MEASUREMENT coil5_drv_latch "Coil5 (FO) drive" UWORD Compu_coil5_drv_latch 0 0 0 100.022893772894 ECU_ADDRESS 0x01006BF8 /end MEASUREMENT
/begin COMPU_METHOD Compu_coil5_drv_latch " " RAT_FUNC "%.1" "% FS" COEFFS 0 655.2 0 0 0 1 /end COMPU_METHOD
/begin MEASUREMENT coil6_drv_latch "Coil6 (FO) drive" UWORD Compu_coil6_drv_latch 0 0 0 100.022893772894 ECU_ADDRESS 0x01006C00 /end MEASUREMENT
/begin COMPU_METHOD Compu_coil6_drv_latch " " RAT_FUNC "%.1" "% FS" COEFFS 0 655.2 0 0 0 1 /end COMPU_METHOD
/begin MEASUREMENT coil7_drv_latch "Coil7 (FO) drive" UWORD Compu_coil7_drv_latch 0 0 0 100.022893772894 ECU_ADDRESS 0x01006C08 /end MEASUREMENT
/begin COMPU_METHOD Compu_coil7_drv_latch " " RAT_FUNC "%.1" "% FS" COEFFS 0 655.2 0 0 0 1 /end COMPU_METHOD
/begin MEASUREMENT coil8_drv_latch "Coil8 (FO) drive" UWORD Compu_coil8_drv_latch 0 0 0 100.022893772894 ECU_ADDRESS 0x01006C10 /end MEASUREMENT
/begin COMPU_METHOD Compu_coil8_drv_latch " " RAT_FUNC "%.1" "% FS" COEFFS 0 655.2 0 0 0 1 /end COMPU_METHOD
/begin CHARACTERISTIC dwell_a_prefire_samp "Dwell adapt pre-fire samp" VALUE 0x00147ade /* @ECU_Address@dwell_a_prefire_samp@0x01007078@ */ ECIPP_ALIGNMENT_UWORD 13107 Compu_dwell_a_prefire_samp 0 13107 /end CHARACTERISTIC
/begin COMPU_METHOD Compu_dwell_a_prefire_samp " " RAT_FUNC "%.1" "us" COEFFS 0 5 0 0 0 1 /end COMPU_METHOD
/begin CHARACTERISTIC dwell_crk_max_accel "Dwell override max accel" VALUE 0x00143c48 /* @ECU_Address@dwell_crk_max_accel@0x01007098@ */ ECIPP_ALIGNMENT_FLOAT32_IEEE 10000000000 Compu_dwell_crk_max_accel -10000000000 10000000000 /end CHARACTERISTIC
/begin COMPU_METHOD Compu_dwell_crk_max_accel " " RAT_FUNC "%.3" "rpm/ms" COEFFS 0 0.00000006144 0 0 0 1 /end COMPU_METHOD
/begin MEASUREMENT dwell_crk_min "Dwell crank min" UWORD Compu_dwell_crk_min 0 0 0 1677.696 ECU_ADDRESS 0x010070A0 /end MEASUREMENT
/begin COMPU_METHOD Compu_dwell_crk_min " " RAT_FUNC "%.2" "ms" COEFFS 0 39.0625 0 0 0 1 /end COMPU_METHOD
/begin MEASUREMENT dwell4_adapt "Coil4 dwell adapt" SWORD Compu_dwell4_adapt 0 0 -104.8576 104.8544 ECU_ADDRESS 0x010070B0 /end MEASUREMENT
/begin COMPU_METHOD Compu_dwell4_adapt " " RAT_FUNC "%.2" "ms" COEFFS 0 312.5 0 0 0 1 /end COMPU_METHOD
/begin MEASUREMENT dwell5_adapt "Coil5 dwell adapt" SWORD Compu_dwell5_adapt 0 0 -104.8576 104.8544 ECU_ADDRESS 0x010070B8 /end MEASUREMENT
/begin COMPU_METHOD Compu_dwell5_adapt " " RAT_FUNC "%.2" "ms" COEFFS 0 312.5 0 0 0 1 /end COMPU_METHOD
/begin MEASUREMENT dwell6_adapt "Coil6 dwell adapt" SWORD Compu_dwell6_adapt 0 0 -104.8576 104.8544 ECU_ADDRESS 0x010070C0 /end MEASUREMENT
/begin COMPU_METHOD Compu_dwell6_adapt " " RAT_FUNC "%.2" "ms" COEFFS 0 312.5 0 0 0 1 /end COMPU_METHOD
/begin MEASUREMENT dwell7_adapt "Coil7 dwell adapt" SWORD Compu_dwell7_adapt 0 0 -104.8576 104.8544 ECU_ADDRESS 0x010070C8 /end MEASUREMENT
/begin COMPU_METHOD Compu_dwell7_adapt " " RAT_FUNC "%.2" "ms" COEFFS 0 312.5 0 0 0 1 /end COMPU_METHOD
/begin MEASUREMENT dwell8_adapt "Coil8 dwell adapt" SWORD Compu_dwell8_adapt 0 0 -104.8576 104.8544 ECU_ADDRESS 0x010070D0 /end MEASUREMENT
/begin COMPU_METHOD Compu_dwell8_adapt " " RAT_FUNC "%.2" "ms" COEFFS 0 312.5 0 0 0 1 /end COMPU_METHOD
/begin MEASUREMENT dwell_samp_cnt "Dwell adapt samples" UWORD Compu_dwell_samp_cnt 0 0 0 65535 ECU_ADDRESS 0x010070E0 /end MEASUREMENT
/begin COMPU_METHOD Compu_dwell_samp_cnt " " RAT_FUNC "%.0" "-" COEFFS 0 1 0 0 0 1 /end COMPU_METHOD
/begin MEASUREMENT dwell_extmod_cnt "Dwell ext module samples" UWORD Compu_dwell_extmod_cnt 0 0 0 65535 ECU_ADDRESS 0x010070E8 /end MEASUREMENT
/begin COMPU_METHOD Compu_dwell_extmod_cnt " " RAT_FUNC "%.0" "-" COEFFS 0 1 0 0 0 1 /end COMPU_METHOD
/begin MEASUREMENT dwell_open_i "Dwell open current samp" UWORD Compu_dwell_open_i 0 0 0 63.9990234375 ECU_ADDRESS 0x01007108 /end MEASUREMENT
/begin COMPU_METHOD Compu_dwell_open_i " " RAT_FUNC "%.3" "amps" COEFFS 0 1024 0 0 0 1 /end COMPU_METHOD
/begin CHARACTERISTIC SPKD_short_trig "Dwell diagnose post-rise samp (Fault Condition:sample delay from rising edge)" VALUE 0x001477b0 /* @ECU_Address@SPKD_short_trig@0x01007128@ */ ECIPP_ALIGNMENT_UWORD 13107 Compu_SPKD_short_trig 0 13107 /end CHARACTERISTIC
/begin COMPU_METHOD Compu_SPKD_short_trig " " RAT_FUNC "%.1" "us" COEFFS 0 5 0 0 0 1 /end COMPU_METHOD
/begin MEASUREMENT dwell_short_i "Dwell short current samp" UWORD Compu_dwell_short_i 0 0 0 63.9990234375 ECU_ADDRESS 0x01007130 /end MEASUREMENT
/begin COMPU_METHOD Compu_dwell_short_i " " RAT_FUNC "%.3" "amps" COEFFS 0 1024 0 0 0 1 /end COMPU_METHOD
/begin MEASUREMENT coil9_drv_latch "Coil9 (FO) drive" UWORD Compu_coil9_drv_latch 0 0 0 100.022893772894 ECU_ADDRESS 0x010071D0 /end MEASUREMENT
/begin COMPU_METHOD Compu_coil9_drv_latch " " RAT_FUNC "%.1" "% FS" COEFFS 0 655.2 0 0 0 1 /end COMPU_METHOD
/begin MEASUREMENT coil10_drv_latch "Coil10 (FO) drive" UWORD Compu_coil10_drv_latch 0 0 0 100.022893772894 ECU_ADDRESS 0x010071D8 /end MEASUREMENT
/begin COMPU_METHOD Compu_coil10_drv_latch " " RAT_FUNC "%.1" "% FS" COEFFS 0 655.2 0 0 0 1 /end COMPU_METHOD
/begin MEASUREMENT dwell9_adapt "Coil9 dwell adapt" SWORD Compu_dwell9_adapt 0 0 -104.8576 104.8544 ECU_ADDRESS 0x010071E0 /end MEASUREMENT
/begin COMPU_METHOD Compu_dwell9_adapt " " RAT_FUNC "%.2" "ms" COEFFS 0 312.5 0 0 0 1 /end COMPU_METHOD
/begin MEASUREMENT dwell10_adapt "Coil10 dwell adapt" SWORD Compu_dwell10_adapt 0 0 -104.8576 104.8544 ECU_ADDRESS 0x010071E8 /end MEASUREMENT
/begin COMPU_METHOD Compu_dwell10_adapt " " RAT_FUNC "%.2" "ms" COEFFS 0 312.5 0 0 0 1 /end COMPU_METHOD
/begin CHARACTERISTIC RSC_enable_chan "Cruise enable input{RSC_enable_chan&0xff=0:Disabled}{RSC_enable_chan&0xff=1:Aux PU1 = Gnd}{RSC_enable_chan&0xff=2:Aux PU2 = Gnd}{RSC_enable_chan&0xff=3:Aux PU3 = Gnd}{RSC_enable_chan&0xff=4:Aux PUD1 = Gnd}{RSC_enable_chan&0xff=5:Aux PUD2 = Gnd}{RSC_enable" VALUE 0x00147efd /* @ECU_Address@RSC_enable_chan@0x01007370@ */ ECIPP_ALIGNMENT_UBYTE 255 RSC_enable_chan_COMPU_VTAB 0 255 BIT_MASK 0xff /end CHARACTERISTIC
/begin COMPU_METHOD RSC_enable_chan_COMPU_VTAB "Verbal Table" TAB_VERB "%.0" "list" COMPU_TAB_REF RSC_enable_chan_COMPU_VTAB_REF /end COMPU_METHOD
/begin COMPU_VTAB RSC_enable_chan_COMPU_VTAB_REF "Verbal Table" TAB_VERB 32 0 "Disabled" 1 "Aux PU1 = Gnd" 2 "Aux PU2 = Gnd" 3 "Aux PU3 = Gnd" 4 "Aux PUD1 = Gnd" 5 "Aux PUD2 = Gnd" 6 "Aux PUD3 = Gnd" 7 "Aux PUD4 = +V" 8 "Aux PUD5 = Gnd" 9 "Aux DIG1" 10 "Aux DIG2" 11 "Aux DIG3" 12 "Aux DIG4" 13 "Aux DIG5" 14 "Aux DIG6" 15 "Aux DIG7" 16 "Aux DIG8" 17 "Aux DIG9" 18 "Aux DIG10" 19 "Aux DIG11" 20 "Aux DIG12" 21 "Aux DIG13" 22 "Aux DIG14" 23 "Aux DIG15" 24 "Aux DIG16" 25 "Aux DIG17" 26 "Aux DIG18" 27 "Aux DIG19" 28 "Gov1" 29 "Gov2" 30 "CAN sourced" 31 "Always enabled" DEFAULT_VALUE "UNKNOWN" /end COMPU_VTAB
/begin CHARACTERISTIC RSC_resume_chan "Cruise resume input{RSC_resume_chan&0xff=0:Disabled}{RSC_resume_chan&0xff=1:Aux PU1 = Gnd}{RSC_resume_chan&0xff=2:Aux PU2 = Gnd}{RSC_resume_chan&0xff=3:Aux PU3 = Gnd}{RSC_resume_chan&0xff=4:Aux PUD1 = Gnd}{RSC_resume_chan&0xff=5:Aux PUD2 = Gnd}{RSC_resume" VALUE 0x00147f01 /* @ECU_Address@RSC_resume_chan@0x01007378@ */ ECIPP_ALIGNMENT_UBYTE 255 RSC_resume_chan_COMPU_VTAB 0 255 BIT_MASK 0xff /end CHARACTERISTIC
/begin COMPU_METHOD RSC_resume_chan_COMPU_VTAB "Verbal Table" TAB_VERB "%.0" "list" COMPU_TAB_REF RSC_resume_chan_COMPU_VTAB_REF /end COMPU_METHOD
/begin COMPU_VTAB RSC_resume_chan_COMPU_VTAB_REF "Verbal Table" TAB_VERB 31 0 "Disabled" 1 "Aux PU1 = Gnd" 2 "Aux PU2 = Gnd" 3 "Aux PU3 = Gnd" 4 "Aux PUD1 = Gnd" 5 "Aux PUD2 = Gnd" 6 "Aux PUD3 = Gnd" 7 "Aux PUD4 = +V" 8 "Aux PUD5 = Gnd" 9 "Aux DIG1" 10 "Aux DIG2" 11 "Aux DIG3" 12 "Aux DIG4" 13 "Aux DIG5" 14 "Aux DIG6" 15 "Aux DIG7" 16 "Aux DIG8" 17 "Aux DIG9" 18 "Aux DIG10" 19 "Aux DIG11" 20 "Aux DIG12" 21 "Aux DIG13" 22 "Aux DIG14" 23 "Aux DIG15" 24 "Aux DIG16" 25 "Aux DIG17" 26 "Aux DIG18" 27 "Aux DIG19" 28 "Gov1" 29 "Gov2" 30 "CAN sourced" DEFAULT_VALUE "UNKNOWN" /end COMPU_VTAB
/begin CHARACTERISTIC RSC_setinc_chan "Cruise set/inc input{RSC_setinc_chan&0xff=0:Disabled}{RSC_setinc_chan&0xff=1:Aux PU1 = Gnd}{RSC_setinc_chan&0xff=2:Aux PU2 = Gnd}{RSC_setinc_chan&0xff=3:Aux PU3 = Gnd}{RSC_setinc_chan&0xff=4:Aux PUD1 = Gnd}{RSC_setinc_chan&0xff=5:Aux PUD2 = Gnd}{RSC_setin" VALUE 0x00147f06 /* @ECU_Address@RSC_setinc_chan@0x01007380@ */ ECIPP_ALIGNMENT_UBYTE 255 RSC_setinc_chan_COMPU_VTAB 0 255 BIT_MASK 0xff /end CHARACTERISTIC
/begin COMPU_METHOD RSC_setinc_chan_COMPU_VTAB "Verbal Table" TAB_VERB "%.0" "list" COMPU_TAB_REF RSC_setinc_chan_COMPU_VTAB_REF /end COMPU_METHOD
/begin COMPU_VTAB RSC_setinc_chan_COMPU_VTAB_REF "Verbal Table" TAB_VERB 31 0 "Disabled" 1 "Aux PU1 = Gnd" 2 "Aux PU2 = Gnd" 3 "Aux PU3 = Gnd" 4 "Aux PUD1 = Gnd" 5 "Aux PUD2 = Gnd" 6 "Aux PUD3 = Gnd" 7 "Aux PUD4 = +V" 8 "Aux PUD5 = Gnd" 9 "Aux DIG1" 10 "Aux DIG2" 11 "Aux DIG3" 12 "Aux DIG4" 13 "Aux DIG5" 14 "Aux DIG6" 15 "Aux DIG7" 16 "Aux DIG8" 17 "Aux DIG9" 18 "Aux DIG10" 19 "Aux DIG11" 20 "Aux DIG12" 21 "Aux DIG13" 22 "Aux DIG14" 23 "Aux DIG15" 24 "Aux DIG16" 25 "Aux DIG17" 26 "Aux DIG18" 27 "Aux DIG19" 28 "Gov1" 29 "Gov2" 30 "CAN sourced" DEFAULT_VALUE "UNKNOWN" /end COMPU_VTAB
/begin CHARACTERISTIC RSC_setdec_chan "Cruise set/dec input{RSC_setdec_chan&0xff=0:Disabled}{RSC_setdec_chan&0xff=1:Aux PU1 = Gnd}{RSC_setdec_chan&0xff=2:Aux PU2 = Gnd}{RSC_setdec_chan&0xff=3:Aux PU3 = Gnd}{RSC_setdec_chan&0xff=4:Aux PUD1 = Gnd}{RSC_setdec_chan&0xff=5:Aux PUD2 = Gnd}{RSC_setde" VALUE 0x00147f04 /* @ECU_Address@RSC_setdec_chan@0x01007388@ */ ECIPP_ALIGNMENT_UBYTE 255 RSC_setdec_chan_COMPU_VTAB 0 255 BIT_MASK 0xff /end CHARACTERISTIC
/begin COMPU_METHOD RSC_setdec_chan_COMPU_VTAB "Verbal Table" TAB_VERB "%.0" "list" COMPU_TAB_REF RSC_setdec_chan_COMPU_VTAB_REF /end COMPU_METHOD
/begin COMPU_VTAB RSC_setdec_chan_COMPU_VTAB_REF "Verbal Table" TAB_VERB 31 0 "Disabled" 1 "Aux PU1 = Gnd" 2 "Aux PU2 = Gnd" 3 "Aux PU3 = Gnd" 4 "Aux PUD1 = Gnd" 5 "Aux PUD2 = Gnd" 6 "Aux PUD3 = Gnd" 7 "Aux PUD4 = +V" 8 "Aux PUD5 = Gnd" 9 "Aux DIG1" 10 "Aux DIG2" 11 "Aux DIG3" 12 "Aux DIG4" 13 "Aux DIG5" 14 "Aux DIG6" 15 "Aux DIG7" 16 "Aux DIG8" 17 "Aux DIG9" 18 "Aux DIG10" 19 "Aux DIG11" 20 "Aux DIG12" 21 "Aux DIG13" 22 "Aux DIG14" 23 "Aux DIG15" 24 "Aux DIG16" 25 "Aux DIG17" 26 "Aux DIG18" 27 "Aux DIG19" 28 "Gov1" 29 "Gov2" 30 "CAN sourced" DEFAULT_VALUE "UNKNOWN" /end COMPU_VTAB
/begin CHARACTERISTIC RSC_enable_moment "Cruise enable input type{RSC_enable_moment&0xff=0:Toggle switch}{RSC_enable_moment&0xff=1:Momentary switch}" VALUE 0x00147efe /* @ECU_Address@RSC_enable_moment@0x01007390@ */ ECIPP_ALIGNMENT_UBYTE 255 RSC_enable_moment_COMPU_VTAB 0 255 BIT_MASK 0xff /end CHARACTERISTIC
/begin COMPU_METHOD RSC_enable_moment_COMPU_VTAB "Verbal Table" TAB_VERB "%.0" "list" COMPU_TAB_REF RSC_enable_moment_COMPU_VTAB_REF /end COMPU_METHOD
/begin COMPU_VTAB RSC_enable_moment_COMPU_VTAB_REF "Verbal Table" TAB_VERB 2 0 "Toggle switch" 1 "Momentary switch" DEFAULT_VALUE "UNKNOWN" /end COMPU_VTAB
/begin CHARACTERISTIC RSC_setinc_wait "Cruise set/inc ramp wait" VALUE 0x00147718 /* @ECU_Address@RSC_setinc_wait@0x01007398@ */ ECIPP_ALIGNMENT_UWORD 65535 Compu_RSC_setinc_wait 0 65535 /end CHARACTERISTIC
/begin COMPU_METHOD Compu_RSC_setinc_wait " " RAT_FUNC "%.0" "ms" COEFFS 0 1 0 0 0 1 /end COMPU_METHOD
/begin CHARACTERISTIC RSC_setdec_wait "Cruise set/dec ramp wait" VALUE 0x00147712 /* @ECU_Address@RSC_setdec_wait@0x010073A0@ */ ECIPP_ALIGNMENT_UWORD 65535 Compu_RSC_setdec_wait 0 65535 /end CHARACTERISTIC
/begin COMPU_METHOD Compu_RSC_setdec_wait " " RAT_FUNC "%.0" "ms" COEFFS 0 1 0 0 0 1 /end COMPU_METHOD
/begin CHARACTERISTIC RSC_resume_ramp "Cruise resume ramp rate" VALUE 0x0014770c /* @ECU_Address@RSC_resume_ramp@0x010073A8@ */ ECIPP_ALIGNMENT_UWORD 256 Compu_RSC_resume_ramp 0 255.99609375 /end CHARACTERISTIC
/begin COMPU_METHOD Compu_RSC_resume_ramp " " RAT_FUNC "%.2" "kph/sec" COEFFS 0 256 0 0 0 1 /end COMPU_METHOD
/begin CHARACTERISTIC RSC_setinc_tap "Cruise set/inc tap step" VALUE 0x00147716 /* @ECU_Address@RSC_setinc_tap@0x010073B0@ */ ECIPP_ALIGNMENT_UWORD 256 Compu_RSC_setinc_tap 0 255.99609375 /end CHARACTERISTIC
/begin COMPU_METHOD Compu_RSC_setinc_tap " " RAT_FUNC "%.2" "kph" COEFFS 0 256 0 0 0 1 /end COMPU_METHOD
/begin CHARACTERISTIC RSC_setinc_ramp "Cruise set/inc ramp rate" VALUE 0x00147714 /* @ECU_Address@RSC_setinc_ramp@0x010073B8@ */ ECIPP_ALIGNMENT_UWORD 256 Compu_RSC_setinc_ramp 0 255.99609375 /end CHARACTERISTIC
/begin COMPU_METHOD Compu_RSC_setinc_ramp " " RAT_FUNC "%.2" "kph/sec" COEFFS 0 256 0 0 0 1 /end COMPU_METHOD
/begin CHARACTERISTIC RSC_setdec_tap "Cruise set/dec tap step" VALUE 0x00147710 /* @ECU_Address@RSC_setdec_tap@0x010073C0@ */ ECIPP_ALIGNMENT_UWORD 256 Compu_RSC_setdec_tap 0 255.99609375 /end CHARACTERISTIC
/begin COMPU_METHOD Compu_RSC_setdec_tap " " RAT_FUNC "%.2" "kph" COEFFS 0 256 0 0 0 1 /end COMPU_METHOD
/begin CHARACTERISTIC RSC_setdec_ramp "Cruise set/dec ramp rate" VALUE 0x0014770e /* @ECU_Address@RSC_setdec_ramp@0x010073C8@ */ ECIPP_ALIGNMENT_UWORD 256 Compu_RSC_setdec_ramp 0 255.99609375 /end CHARACTERISTIC
/begin COMPU_METHOD Compu_RSC_setdec_ramp " " RAT_FUNC "%.2" "kph/sec" COEFFS 0 256 0 0 0 1 /end COMPU_METHOD
/begin CHARACTERISTIC RSC_min_kph "Cruise min roadspeed" VALUE 0x00147708 /* @ECU_Address@RSC_min_kph@0x010073D0@ */ ECIPP_ALIGNMENT_UWORD 256 Compu_RSC_min_kph 0 255.99609375 /end CHARACTERISTIC
/begin COMPU_METHOD Compu_RSC_min_kph " " RAT_FUNC "%.1" "kph" COEFFS 0 256 0 0 0 1 /end COMPU_METHOD
/begin CHARACTERISTIC RSC_max_kph "Cruise max roadspeet" VALUE 0x00147706 /* @ECU_Address@RSC_max_kph@0x010073D8@ */ ECIPP_ALIGNMENT_UWORD 256 Compu_RSC_max_kph 0 255.99609375 /end CHARACTERISTIC
/begin COMPU_METHOD Compu_RSC_max_kph " " RAT_FUNC "%.1" "kph" COEFFS 0 256 0 0 0 1 /end COMPU_METHOD
/begin MEASUREMENT RSC_speed_accum "Cruise control final target" ULONG Compu_RSC_speed_accum 0 0 0 255.999999940395 ECU_ADDRESS 0x010073E0 /end MEASUREMENT
/begin COMPU_METHOD Compu_RSC_speed_accum " " RAT_FUNC "%.1" "kph" COEFFS 0 16777216 0 0 0 1 /end COMPU_METHOD
/begin MEASUREMENT RSC_speed_slew "Cruise control instant target" ULONG Compu_RSC_speed_slew 0 0 0 255.999999940395 ECU_ADDRESS 0x010073E8 /end MEASUREMENT
/begin COMPU_METHOD Compu_RSC_speed_slew " " RAT_FUNC "%.1" "kph" COEFFS 0 16777216 0 0 0 1 /end COMPU_METHOD
/begin MEASUREMENT RSC_engaged "Cruise control engaged{RSC_engaged&0xff=0:Not engaged}{RSC_engaged&0xff=1:Engaged}" UBYTE RSC_engaged_COMPU_VTAB 0 0 0 255 ECU_ADDRESS 0x010073F0 BIT_MASK 0xff /end MEASUREMENT
/begin COMPU_METHOD RSC_engaged_COMPU_VTAB "Verbal Table" TAB_VERB "%.0" "list" COMPU_TAB_REF RSC_engaged_COMPU_VTAB_REF /end COMPU_METHOD
/begin COMPU_VTAB RSC_engaged_COMPU_VTAB_REF "Verbal Table" TAB_VERB 2 0 "Not engaged" 1 "Engaged" DEFAULT_VALUE "UNKNOWN" /end COMPU_VTAB
/begin MEASUREMENT RSC_enabled "Cruise control enabled{RSC_enabled&0xff=0:Disabled}{RSC_enabled&0xff=1:Enabled}" UBYTE RSC_enabled_COMPU_VTAB 0 0 0 255 ECU_ADDRESS 0x010073F8 BIT_MASK 0xff /end MEASUREMENT
/begin COMPU_METHOD RSC_enabled_COMPU_VTAB "Verbal Table" TAB_VERB "%.0" "list" COMPU_TAB_REF RSC_enabled_COMPU_VTAB_REF /end COMPU_METHOD
/begin COMPU_VTAB RSC_enabled_COMPU_VTAB_REF "Verbal Table" TAB_VERB 2 0 "Disabled" 1 "Enabled" DEFAULT_VALUE "UNKNOWN" /end COMPU_VTAB
/begin CHARACTERISTIC RSC_engaged_light "Cruise engaged light{RSC_engaged_light&0xff=0:Disabled}{RSC_engaged_light&0xff=1:Buzzer Output}{RSC_engaged_light&0xff=2:MIL Output}{RSC_engaged_light&0xff=3:TACH Output}{RSC_engaged_light&0xff=4:Starter Output}{RSC_engaged_light&0xff=5:EGOH1}{RSC_engaged" VALUE 0x00147eff /* @ECU_Address@RSC_engaged_light@0x01007680@ */ ECIPP_ALIGNMENT_UBYTE 255 RSC_engaged_light_COMPU_VTAB 0 255 BIT_MASK 0xff /end CHARACTERISTIC
/begin COMPU_METHOD RSC_engaged_light_COMPU_VTAB "Verbal Table" TAB_VERB "%.0" "list" COMPU_TAB_REF RSC_engaged_light_COMPU_VTAB_REF /end COMPU_METHOD
/begin COMPU_VTAB RSC_engaged_light_COMPU_VTAB_REF "Verbal Table" TAB_VERB 32 0 "Disabled" 1 "Buzzer Output" 2 "MIL Output" 3 "TACH Output" 4 "Starter Output" 5 "EGOH1" 6 "EGOH2" 7 "EGOH3" 8 "EGOH4" 9 "Aux PWM1" 10 "Aux PWM2" 11 "Aux PWM3" 12 "Aux PWM4" 13 "Aux PWM5" 14 "Aux PWM6" 15 "Aux PWM7" 16 "Aux PWM8" 17 "Aux PWM9" 18 "Aux PWM10" 19 "Aux PWM11" 20 "Aux PWM12" 21 "Aux PWM13" 22 "Aux PWM14" 23 "Aux PWM15" 24 "Aux PWM16" 25 "Aux PWM17" 26 "Aux PWM18" 27 "Aux PWM19" 28 "Aux PWM20" 29 "Aux PWM21" 30 "Aux PWM22" 31 "Aux PWM23" DEFAULT_VALUE "UNKNOWN" /end COMPU_VTAB
/begin CHARACTERISTIC RS_kph_crct_ena "Roadspeed nonlinear correction{RS_kph_crct_ena&0xff=0:Disabled}{RS_kph_crct_ena&0xff=1:Enabled}" VALUE 0x00147f0e /* @ECU_Address@RS_kph_crct_ena@0x010077D8@ */ ECIPP_ALIGNMENT_UBYTE 255 RS_kph_crct_ena_COMPU_VTAB 0 255 BIT_MASK 0xff /end CHARACTERISTIC
/begin COMPU_METHOD RS_kph_crct_ena_COMPU_VTAB "Verbal Table" TAB_VERB "%.0" "list" COMPU_TAB_REF RS_kph_crct_ena_COMPU_VTAB_REF /end COMPU_METHOD
/begin COMPU_VTAB RS_kph_crct_ena_COMPU_VTAB_REF "Verbal Table" TAB_VERB 2 0 "Disabled" 1 "Enabled" DEFAULT_VALUE "UNKNOWN" /end COMPU_VTAB
/begin MEASUREMENT RS_speed_meas_acc "Road speed measured" ULONG Compu_RS_speed_meas_acc 0 0 0 255.999999940395 ECU_ADDRESS 0x010077E0 /end MEASUREMENT
/begin COMPU_METHOD Compu_RS_speed_meas_acc " " RAT_FUNC "%.1" "km/hr" COEFFS 0 16777216 0 0 0 1 /end COMPU_METHOD
/begin MEASUREMENT RS_min_FPP "Roadspeed min FPP command" ULONG Compu_RS_min_FPP 0 0 0 99.9999999767169 ECU_ADDRESS 0x01007890 /end MEASUREMENT
/begin COMPU_METHOD Compu_RS_min_FPP " " RAT_FUNC "%.1" "%" COEFFS 0 42949672.96 0 0 0 1 /end COMPU_METHOD
/begin MEASUREMENT RS_OOA_state "Roadspeed authority status{RS_OOA_state&0xff=0xff:Request < TPS}{RS_OOA_state&0xff=0x00:In Authority}{RS_OOA_state&0xff=0x01:Request > TPS}" UBYTE RS_OOA_state_COMPU_VTAB 0 0 0 255 ECU_ADDRESS 0x01007898 BIT_MASK 0xff /end MEASUREMENT
/begin COMPU_METHOD RS_OOA_state_COMPU_VTAB "Verbal Table" TAB_VERB "%.0" "list" COMPU_TAB_REF RS_OOA_state_COMPU_VTAB_REF /end COMPU_METHOD
/begin COMPU_VTAB RS_OOA_state_COMPU_VTAB_REF "Verbal Table" TAB_VERB 3 0xff "Request < TPS" 0x00 "In Authority" 0x01 "Request > TPS" DEFAULT_VALUE "UNKNOWN" /end COMPU_VTAB
/begin MEASUREMENT RSC_CCVS_status "Roadspeed cruise status{RSC_CCVS_status&0xff=0x00:Disabled}{RSC_CCVS_status&0xff=0x01:Holding}{RSC_CCVS_status&0xff=0x02:Accelerating}{RSC_CCVS_status&0xff=0x03:Decelerating}{RSC_CCVS_status&0xff=0x04:Resuming}{RSC_CCVS_status&0xff=0x05:Setting}{RSC_CCVS_" UBYTE RSC_CCVS_status_COMPU_VTAB 0 0 0 255 ECU_ADDRESS 0x010078A0 BIT_MASK 0xff /end MEASUREMENT
/begin COMPU_METHOD RSC_CCVS_status_COMPU_VTAB "Verbal Table" TAB_VERB "%.0" "list" COMPU_TAB_REF RSC_CCVS_status_COMPU_VTAB_REF /end COMPU_METHOD
/begin COMPU_VTAB RSC_CCVS_status_COMPU_VTAB_REF "Verbal Table" TAB_VERB 7 0x00 "Disabled" 0x01 "Holding" 0x02 "Accelerating" 0x03 "Decelerating" 0x04 "Resuming" 0x05 "Setting" 0x06 "User Override" DEFAULT_VALUE "UNKNOWN" /end COMPU_VTAB
/begin MEASUREMENT RS_max_FPP "Roadspeed max FPP command" ULONG Compu_RS_max_FPP 0 0 0 99.9999999767169 ECU_ADDRESS 0x010078A8 /end MEASUREMENT
/begin COMPU_METHOD Compu_RS_max_FPP " " RAT_FUNC "%.1" "%" COEFFS 0 42949672.96 0 0 0 1 /end COMPU_METHOD
/begin CHARACTERISTIC RSC_disable_kph "Cruise disengage speed limit" VALUE 0x00147700 /* @ECU_Address@RSC_disable_kph@0x010078E8@ */ ECIPP_ALIGNMENT_UWORD 256 Compu_RSC_disable_kph 0 255.99609375 /end CHARACTERISTIC
/begin COMPU_METHOD Compu_RSC_disable_kph " " RAT_FUNC "%.1" "kph" COEFFS 0 256 0 0 0 1 /end COMPU_METHOD
/begin CHARACTERISTIC RSC_retard_braking "Cruise retarder braking behavior{RSC_retard_braking&0xff=0:Not allowed}{RSC_retard_braking&0xff=1:Allowed}" VALUE 0x00147f02 /* @ECU_Address@RSC_retard_braking@0x01007940@ */ ECIPP_ALIGNMENT_UBYTE 255 RSC_retard_braking_COMPU_VTAB 0 255 BIT_MASK 0xff /end CHARACTERISTIC
/begin COMPU_METHOD RSC_retard_braking_COMPU_VTAB "Verbal Table" TAB_VERB "%.0" "list" COMPU_TAB_REF RSC_retard_braking_COMPU_VTAB_REF /end COMPU_METHOD
/begin COMPU_VTAB RSC_retard_braking_COMPU_VTAB_REF "Verbal Table" TAB_VERB 2 0 "Not allowed" 1 "Allowed" DEFAULT_VALUE "UNKNOWN" /end COMPU_VTAB
/begin MEASUREMENT RS_FPPmin_Iacc "Roadspeed control integrator" SWORD Compu_RS_FPPmin_Iacc 0 0 -800 799.9755859375 ECU_ADDRESS 0x01007958 /end MEASUREMENT
/begin COMPU_METHOD Compu_RS_FPPmin_Iacc " " RAT_FUNC "%.1" "% load/RPM" COEFFS 0 40.96 0 0 0 1 /end COMPU_METHOD
/begin MEASUREMENT RS_FPPmax_Iacc "Roadspeed control integrator" SWORD Compu_RS_FPPmax_Iacc 0 0 -800 799.9755859375 ECU_ADDRESS 0x01007960 /end MEASUREMENT
/begin COMPU_METHOD Compu_RS_FPPmax_Iacc " " RAT_FUNC "%.1" "% load/RPM" COEFFS 0 40.96 0 0 0 1 /end COMPU_METHOD
/begin CHARACTERISTIC RS_Kp_dz "Roadspeed velocity Kp deadzone" VALUE 0x001491E0 /* @ECU_Address@RS_Kp_dz@0x01007988@ */ ECIPP_ALIGNMENT_SWORD 128 Compu_RS_Kp_dz -128 127.99609375 /end CHARACTERISTIC
/begin COMPU_METHOD Compu_RS_Kp_dz " " RAT_FUNC "%.1" "km/hr" COEFFS 0 256 0 0 0 1 /end COMPU_METHOD
/begin CHARACTERISTIC RS2_Kp_dz "Roadspeed2 velocity Kp deadzone" VALUE 0x0014922C /* @ECU_Address@RS2_Kp_dz@0x01007990@ */ ECIPP_ALIGNMENT_SWORD 128 Compu_RS2_Kp_dz -128 127.99609375 /end CHARACTERISTIC
/begin COMPU_METHOD Compu_RS2_Kp_dz " " RAT_FUNC "%.1" "km/hr" COEFFS 0 256 0 0 0 1 /end COMPU_METHOD
/begin CHARACTERISTIC RS3_Kp_dz "Roadspeed3 velocity Kp deadzone" VALUE 0x00149278 /* @ECU_Address@RS3_Kp_dz@0x01007998@ */ ECIPP_ALIGNMENT_SWORD 128 Compu_RS3_Kp_dz -128 127.99609375 /end CHARACTERISTIC
/begin COMPU_METHOD Compu_RS3_Kp_dz " " RAT_FUNC "%.1" "km/hr" COEFFS 0 256 0 0 0 1 /end COMPU_METHOD
/begin CHARACTERISTIC RS_Kp_dz_tout "Roadspeed velocity Kp deadzone timeout" VALUE 0x001491DE /* @ECU_Address@RS_Kp_dz_tout@0x010079A0@ */ ECIPP_ALIGNMENT_UWORD 65535 Compu_RS_Kp_dz_tout 0 65535 /end CHARACTERISTIC
/begin COMPU_METHOD Compu_RS_Kp_dz_tout " " RAT_FUNC "%.0" "ms" COEFFS 0 1 0 0 0 1 /end COMPU_METHOD
/begin CHARACTERISTIC RS2_Kp_dz_tout "Roadspeed2 velocity Kp deadzone timeout" VALUE 0x0014922A /* @ECU_Address@RS2_Kp_dz_tout@0x010079A8@ */ ECIPP_ALIGNMENT_UWORD 65535 Compu_RS2_Kp_dz_tout 0 65535 /end CHARACTERISTIC
/begin COMPU_METHOD Compu_RS2_Kp_dz_tout " " RAT_FUNC "%.0" "ms" COEFFS 0 1 0 0 0 1 /end COMPU_METHOD
/begin CHARACTERISTIC RS3_Kp_dz_tout "Roadspeed3 velocity Kp deadzone timeout" VALUE 0x00149276 /* @ECU_Address@RS3_Kp_dz_tout@0x010079B0@ */ ECIPP_ALIGNMENT_UWORD 65535 Compu_RS3_Kp_dz_tout 0 65535 /end CHARACTERISTIC
/begin COMPU_METHOD Compu_RS3_Kp_dz_tout " " RAT_FUNC "%.0" "ms" COEFFS 0 1 0 0 0 1 /end COMPU_METHOD
/begin CHARACTERISTIC RS_speed_CAN_tau "Roadspeed CAN additional low-pass" VALUE 0x00147c28 /* @ECU_Address@RS_speed_CAN_tau@0x01007A30@ */ ECIPP_ALIGNMENT_UWORD 327680 Compu_RS_speed_CAN_tau 0.45084 327680 /end CHARACTERISTIC
/begin COMPU_METHOD Compu_RS_speed_CAN_tau " " FORM "%.1" "ms"
 /begin FORMULA "-5 / log(1 - (X1 / 65536))" FORMULA_INV "(1 - exp(-5/X1)) * 65536" /end FORMULA
/end COMPU_METHOD
/begin MEASUREMENT RS_speed_CAN "Road speed CAN published speed" UWORD Compu_RS_speed_CAN 0 0 0 255.99609375 ECU_ADDRESS 0x01007A38 /end MEASUREMENT
/begin COMPU_METHOD Compu_RS_speed_CAN " " RAT_FUNC "%.1" "km/hr" COEFFS 0 256 0 0 0 1 /end COMPU_METHOD
/begin CHARACTERISTIC KNKHst_percent_trig "Knock histogram percent trigger" VALUE 0x00147518 /* @ECU_Address@KNKHst_percent_trig@0x01008320@ */ ECIPP_ALIGNMENT_UWORD 100 Compu_KNKHst_percent_trig 0 99.9984741210938 /end CHARACTERISTIC
/begin COMPU_METHOD Compu_KNKHst_percent_trig " " RAT_FUNC "%.1" "%" COEFFS 0 655.36 0 0 0 1 /end COMPU_METHOD
/begin CHARACTERISTIC KNKHst_retard_trig "Knock histogram retard trigger" VALUE 0x0014751a /* @ECU_Address@KNKHst_retard_trig@0x01008328@ */ ECIPP_ALIGNMENT_UWORD 128 Compu_KNKHst_retard_trig 0 127.998046875 /end CHARACTERISTIC
/begin COMPU_METHOD Compu_KNKHst_retard_trig " " RAT_FUNC "%.1" "CAD" COEFFS 0 512 0 0 0 1 /end COMPU_METHOD
/begin CHARACTERISTIC KNKHst_trig_mode "Knock histogram trigger mode{KNKHst_trig_mode&0xff=0:Disabled}{KNKHst_trig_mode&0xff=1:Knock Retard}{KNKHst_trig_mode&0xff=2:Knock Percent}" VALUE 0x00147dfb /* @ECU_Address@KNKHst_trig_mode@0x01008330@ */ ECIPP_ALIGNMENT_UBYTE 255 KNKHst_trig_mode_COMPU_VTAB 0 255 BIT_MASK 0xff /end CHARACTERISTIC
/begin COMPU_METHOD KNKHst_trig_mode_COMPU_VTAB "Verbal Table" TAB_VERB "%.0" "list" COMPU_TAB_REF KNKHst_trig_mode_COMPU_VTAB_REF /end COMPU_METHOD
/begin COMPU_VTAB KNKHst_trig_mode_COMPU_VTAB_REF "Verbal Table" TAB_VERB 3 0 "Disabled" 1 "Knock Retard" 2 "Knock Percent" DEFAULT_VALUE "UNKNOWN" /end COMPU_VTAB
/begin MEASUREMENT KNKHst_reset_request "Knock histogram reset{KNKHst_reset_request&0xff=0:Inactive}{KNKHst_reset_request&0xff=1:Reset Histogram}" UBYTE KNKHst_reset_request_COMPU_VTAB 0 0 0 255 ECU_ADDRESS 0x01008338 BIT_MASK 0xff /end MEASUREMENT
/begin COMPU_METHOD KNKHst_reset_request_COMPU_VTAB "Verbal Table" TAB_VERB "%.0" "list" COMPU_TAB_REF KNKHst_reset_request_COMPU_VTAB_REF /end COMPU_METHOD
/begin COMPU_VTAB KNKHst_reset_request_COMPU_VTAB_REF "Verbal Table" TAB_VERB 2 0 "Inactive" 1 "Reset Histogram" DEFAULT_VALUE "UNKNOWN" /end COMPU_VTAB
/begin CHARACTERISTIC dwell_sense1_source "Dwell source firing index 1{dwell_sense1_source&0xff=0:Default}{dwell_sense1_source&0xff=1:SPK_MON1}{dwell_sense1_source&0xff=2:SPK_MON2}" VALUE 0x00148147 /* @ECU_Address@dwell_sense1_source@0x01008340@ */ ECIPP_ALIGNMENT_UBYTE 255 dwell_sense1_source_COMPU_VTAB 0 255 BIT_MASK 0xff /end CHARACTERISTIC
/begin COMPU_METHOD dwell_sense1_source_COMPU_VTAB "Verbal Table" TAB_VERB "%.0" "list" COMPU_TAB_REF dwell_sense1_source_COMPU_VTAB_REF /end COMPU_METHOD
/begin COMPU_VTAB dwell_sense1_source_COMPU_VTAB_REF "Verbal Table" TAB_VERB 3 0 "Default" 1 "SPK_MON1" 2 "SPK_MON2" DEFAULT_VALUE "UNKNOWN" /end COMPU_VTAB
/begin CHARACTERISTIC dwell_sense2_source "Dwell source firing index 2{dwell_sense2_source&0xff=0:Default}{dwell_sense2_source&0xff=1:SPK_MON1}{dwell_sense2_source&0xff=2:SPK_MON2}" VALUE 0x00148148 /* @ECU_Address@dwell_sense2_source@0x01008348@ */ ECIPP_ALIGNMENT_UBYTE 255 dwell_sense2_source_COMPU_VTAB 0 255 BIT_MASK 0xff /end CHARACTERISTIC
/begin COMPU_METHOD dwell_sense2_source_COMPU_VTAB "Verbal Table" TAB_VERB "%.0" "list" COMPU_TAB_REF dwell_sense2_source_COMPU_VTAB_REF /end COMPU_METHOD
/begin COMPU_VTAB dwell_sense2_source_COMPU_VTAB_REF "Verbal Table" TAB_VERB 3 0 "Default" 1 "SPK_MON1" 2 "SPK_MON2" DEFAULT_VALUE "UNKNOWN" /end COMPU_VTAB
/begin CHARACTERISTIC dwell_sense3_source "Dwell source firing index 3{dwell_sense3_source&0xff=0:Default}{dwell_sense3_source&0xff=1:SPK_MON1}{dwell_sense3_source&0xff=2:SPK_MON2}" VALUE 0x00148149 /* @ECU_Address@dwell_sense3_source@0x01008350@ */ ECIPP_ALIGNMENT_UBYTE 255 dwell_sense3_source_COMPU_VTAB 0 255 BIT_MASK 0xff /end CHARACTERISTIC
/begin COMPU_METHOD dwell_sense3_source_COMPU_VTAB "Verbal Table" TAB_VERB "%.0" "list" COMPU_TAB_REF dwell_sense3_source_COMPU_VTAB_REF /end COMPU_METHOD
/begin COMPU_VTAB dwell_sense3_source_COMPU_VTAB_REF "Verbal Table" TAB_VERB 3 0 "Default" 1 "SPK_MON1" 2 "SPK_MON2" DEFAULT_VALUE "UNKNOWN" /end COMPU_VTAB
/begin CHARACTERISTIC dwell_sense4_source "Dwell source firing index 4{dwell_sense4_source&0xff=0:Default}{dwell_sense4_source&0xff=1:SPK_MON1}{dwell_sense4_source&0xff=2:SPK_MON2}" VALUE 0x0014814A /* @ECU_Address@dwell_sense4_source@0x01008358@ */ ECIPP_ALIGNMENT_UBYTE 255 dwell_sense4_source_COMPU_VTAB 0 255 BIT_MASK 0xff /end CHARACTERISTIC
/begin COMPU_METHOD dwell_sense4_source_COMPU_VTAB "Verbal Table" TAB_VERB "%.0" "list" COMPU_TAB_REF dwell_sense4_source_COMPU_VTAB_REF /end COMPU_METHOD
/begin COMPU_VTAB dwell_sense4_source_COMPU_VTAB_REF "Verbal Table" TAB_VERB 3 0 "Default" 1 "SPK_MON1" 2 "SPK_MON2" DEFAULT_VALUE "UNKNOWN" /end COMPU_VTAB
/begin CHARACTERISTIC dwell_sense5_source "Dwell source firing index 5{dwell_sense5_source&0xff=0:Default}{dwell_sense5_source&0xff=1:SPK_MON1}{dwell_sense5_source&0xff=2:SPK_MON2}" VALUE 0x0014814B /* @ECU_Address@dwell_sense5_source@0x01008360@ */ ECIPP_ALIGNMENT_UBYTE 255 dwell_sense5_source_COMPU_VTAB 0 255 BIT_MASK 0xff /end CHARACTERISTIC
/begin COMPU_METHOD dwell_sense5_source_COMPU_VTAB "Verbal Table" TAB_VERB "%.0" "list" COMPU_TAB_REF dwell_sense5_source_COMPU_VTAB_REF /end COMPU_METHOD
/begin COMPU_VTAB dwell_sense5_source_COMPU_VTAB_REF "Verbal Table" TAB_VERB 3 0 "Default" 1 "SPK_MON1" 2 "SPK_MON2" DEFAULT_VALUE "UNKNOWN" /end COMPU_VTAB
/begin CHARACTERISTIC dwell_sense6_source "Dwell source firing index 6{dwell_sense6_source&0xff=0:Default}{dwell_sense6_source&0xff=1:SPK_MON1}{dwell_sense6_source&0xff=2:SPK_MON2}" VALUE 0x0014814C /* @ECU_Address@dwell_sense6_source@0x01008368@ */ ECIPP_ALIGNMENT_UBYTE 255 dwell_sense6_source_COMPU_VTAB 0 255 BIT_MASK 0xff /end CHARACTERISTIC
/begin COMPU_METHOD dwell_sense6_source_COMPU_VTAB "Verbal Table" TAB_VERB "%.0" "list" COMPU_TAB_REF dwell_sense6_source_COMPU_VTAB_REF /end COMPU_METHOD
/begin COMPU_VTAB dwell_sense6_source_COMPU_VTAB_REF "Verbal Table" TAB_VERB 3 0 "Default" 1 "SPK_MON1" 2 "SPK_MON2" DEFAULT_VALUE "UNKNOWN" /end COMPU_VTAB
/begin CHARACTERISTIC dwell_sense7_source "Dwell source firing index 7{dwell_sense7_source&0xff=0:Default}{dwell_sense7_source&0xff=1:SPK_MON1}{dwell_sense7_source&0xff=2:SPK_MON2}" VALUE 0x0014814D /* @ECU_Address@dwell_sense7_source@0x01008370@ */ ECIPP_ALIGNMENT_UBYTE 255 dwell_sense7_source_COMPU_VTAB 0 255 BIT_MASK 0xff /end CHARACTERISTIC
/begin COMPU_METHOD dwell_sense7_source_COMPU_VTAB "Verbal Table" TAB_VERB "%.0" "list" COMPU_TAB_REF dwell_sense7_source_COMPU_VTAB_REF /end COMPU_METHOD
/begin COMPU_VTAB dwell_sense7_source_COMPU_VTAB_REF "Verbal Table" TAB_VERB 3 0 "Default" 1 "SPK_MON1" 2 "SPK_MON2" DEFAULT_VALUE "UNKNOWN" /end COMPU_VTAB
/begin CHARACTERISTIC dwell_sense8_source "Dwell source firing index 8{dwell_sense8_source&0xff=0:Default}{dwell_sense8_source&0xff=1:SPK_MON1}{dwell_sense8_source&0xff=2:SPK_MON2}" VALUE 0x0014814E /* @ECU_Address@dwell_sense8_source@0x01008378@ */ ECIPP_ALIGNMENT_UBYTE 255 dwell_sense8_source_COMPU_VTAB 0 255 BIT_MASK 0xff /end CHARACTERISTIC
/begin COMPU_METHOD dwell_sense8_source_COMPU_VTAB "Verbal Table" TAB_VERB "%.0" "list" COMPU_TAB_REF dwell_sense8_source_COMPU_VTAB_REF /end COMPU_METHOD
/begin COMPU_VTAB dwell_sense8_source_COMPU_VTAB_REF "Verbal Table" TAB_VERB 3 0 "Default" 1 "SPK_MON1" 2 "SPK_MON2" DEFAULT_VALUE "UNKNOWN" /end COMPU_VTAB
/begin CHARACTERISTIC dwell_sense9_source "Dwell source firing index 9{dwell_sense9_source&0xff=0:Default}{dwell_sense9_source&0xff=1:SPK_MON1}{dwell_sense9_source&0xff=2:SPK_MON2}" VALUE 0x0014814F /* @ECU_Address@dwell_sense9_source@0x01008380@ */ ECIPP_ALIGNMENT_UBYTE 255 dwell_sense9_source_COMPU_VTAB 0 255 BIT_MASK 0xff /end CHARACTERISTIC
/begin COMPU_METHOD dwell_sense9_source_COMPU_VTAB "Verbal Table" TAB_VERB "%.0" "list" COMPU_TAB_REF dwell_sense9_source_COMPU_VTAB_REF /end COMPU_METHOD
/begin COMPU_VTAB dwell_sense9_source_COMPU_VTAB_REF "Verbal Table" TAB_VERB 3 0 "Default" 1 "SPK_MON1" 2 "SPK_MON2" DEFAULT_VALUE "UNKNOWN" /end COMPU_VTAB
/begin CHARACTERISTIC dwell_sense10_source "Dwell source firing index 10{dwell_sense10_source&0xff=0:Default}{dwell_sense10_source&0xff=1:SPK_MON1}{dwell_sense10_source&0xff=2:SPK_MON2}" VALUE 0x00148150 /* @ECU_Address@dwell_sense10_source@0x01008388@ */ ECIPP_ALIGNMENT_UBYTE 255 dwell_sense10_source_COMPU_VTAB 0 255 BIT_MASK 0xff /end CHARACTERISTIC
/begin COMPU_METHOD dwell_sense10_source_COMPU_VTAB "Verbal Table" TAB_VERB "%.0" "list" COMPU_TAB_REF dwell_sense10_source_COMPU_VTAB_REF /end COMPU_METHOD
/begin COMPU_VTAB dwell_sense10_source_COMPU_VTAB_REF "Verbal Table" TAB_VERB 3 0 "Default" 1 "SPK_MON1" 2 "SPK_MON2" DEFAULT_VALUE "UNKNOWN" /end COMPU_VTAB
/begin CHARACTERISTIC SRVC_mode "Service notification mode{SRVC_mode&0xff=0:Disabled}{SRVC_mode&0xff=1:Fixed interval (hours)}{SRVC_mode&0xff=2:Speed/load based}{SRVC_mode&0xff=3:Fixed interval (kms)}" VALUE 0x00147f3c /* @ECU_Address@SRVC_mode@0x01008408@ */ ECIPP_ALIGNMENT_UBYTE 255 SRVC_mode_COMPU_VTAB 0 255 BIT_MASK 0xff /end CHARACTERISTIC
/begin COMPU_METHOD SRVC_mode_COMPU_VTAB "Verbal Table" TAB_VERB "%.0" "list" COMPU_TAB_REF SRVC_mode_COMPU_VTAB_REF /end COMPU_METHOD
/begin COMPU_VTAB SRVC_mode_COMPU_VTAB_REF "Verbal Table" TAB_VERB 4 0 "Disabled" 1 "Fixed interval (hours)" 2 "Speed/load based" 3 "Fixed interval (kms)" DEFAULT_VALUE "UNKNOWN" /end COMPU_VTAB
/begin CHARACTERISTIC SRVC_fixed_interval "Service fixed interval (hours)" VALUE 0x001477c2 /* @ECU_Address@SRVC_fixed_interval@0x01008410@ */ ECIPP_ALIGNMENT_UWORD 32768 Compu_SRVC_fixed_interval 0 32767.5 /end CHARACTERISTIC
/begin COMPU_METHOD Compu_SRVC_fixed_interval " " RAT_FUNC "%.1" "hours" COEFFS 0 2 0 0 0 1 /end COMPU_METHOD
/begin MEASUREMENT SRVC_update_key "Service update key" UWORD Compu_SRVC_update_key 0 0 0 65535 ECU_ADDRESS 0x01008418 /end MEASUREMENT
/begin COMPU_METHOD Compu_SRVC_update_key " " RAT_FUNC "%.0" "[23130]" COEFFS 0 1 0 0 0 1 /end COMPU_METHOD
/begin MEASUREMENT SRVC_update_status "Service update status{SRVC_update_status&0xff=0:Inactive}{SRVC_update_status&0xff=1:In progress...}{SRVC_update_status&0xff=2:Completed}{SRVC_update_status&0xff=3:Reset Request}" UBYTE SRVC_update_status_COMPU_VTAB 0 0 0 255 ECU_ADDRESS 0x01008420 BIT_MASK 0xff /end MEASUREMENT
/begin COMPU_METHOD SRVC_update_status_COMPU_VTAB "Verbal Table" TAB_VERB "%.0" "list" COMPU_TAB_REF SRVC_update_status_COMPU_VTAB_REF /end COMPU_METHOD
/begin COMPU_VTAB SRVC_update_status_COMPU_VTAB_REF "Verbal Table" TAB_VERB 4 0 "Inactive" 1 "In progress..." 2 "Completed" 3 "Reset Request" DEFAULT_VALUE "UNKNOWN" /end COMPU_VTAB
/begin MEASUREMENT SRVC_pct_accum "Service interval used" ULONG Compu_SRVC_pct_accum 0 0 0 99.9999999767169 ECU_ADDRESS 0x01008428 /end MEASUREMENT
/begin COMPU_METHOD Compu_SRVC_pct_accum " " RAT_FUNC "%.1" "%" COEFFS 0 42949672.96 0 0 0 1 /end COMPU_METHOD
/begin CHARACTERISTIC spkmon_min_dissipate "Dwell current sampling dissipation" VALUE 0x00147b92 /* @ECU_Address@spkmon_min_dissipate@0x01008CC8@ */ ECIPP_ALIGNMENT_UWORD 13107 Compu_spkmon_min_dissipate 0 13107 /end CHARACTERISTIC
/begin COMPU_METHOD Compu_spkmon_min_dissipate " " RAT_FUNC "%.0" "ms" COEFFS 0 5 0 0 0 1 /end COMPU_METHOD
/begin CHARACTERISTIC SPK_IGBT_T_Timer "Spark kill overtemp (Fault Condition:Spark plug or coil fault countdown timer)" VALUE 0x00147f39 /* @ECU_Address@SPK_IGBT_T_Timer@0x0100B918@ */ ECIPP_ALIGNMENT_UBYTE 255 Compu_SPK_IGBT_T_Timer 0 255 /end CHARACTERISTIC
/begin COMPU_METHOD Compu_SPK_IGBT_T_Timer " " RAT_FUNC "%.1" "secs" COEFFS 0 1 0 0 0 1 /end COMPU_METHOD
/begin MEASUREMENT RS_freq_raw "Unfiltered roadspeed pulse input frequency" FLOAT32_IEEE Compu_RS_freq_raw 0 0 -10000000000 10000000000 ECU_ADDRESS 0x0100B988 /end MEASUREMENT
/begin COMPU_METHOD Compu_RS_freq_raw " " RAT_FUNC "%.3" "Hz" COEFFS 0 1 0 0 0 1 /end COMPU_METHOD
/begin CHARACTERISTIC C2ASpd_ena "Cam2 Aux Speed input function{C2ASpd_ena&0xff=0:Disabled}{C2ASpd_ena&0xff=1:Enabled}" VALUE 0x00147ce5 /* @ECU_Address@C2ASpd_ena@0x0100BC18@ */ ECIPP_ALIGNMENT_UBYTE 255 C2ASpd_ena_COMPU_VTAB 0 255 BIT_MASK 0xff /end CHARACTERISTIC
/begin COMPU_METHOD C2ASpd_ena_COMPU_VTAB "Verbal Table" TAB_VERB "%.0" "list" COMPU_TAB_REF C2ASpd_ena_COMPU_VTAB_REF /end COMPU_METHOD
/begin COMPU_VTAB C2ASpd_ena_COMPU_VTAB_REF "Verbal Table" TAB_VERB 2 0 "Disabled" 1 "Enabled" DEFAULT_VALUE "UNKNOWN" /end COMPU_VTAB
/begin CHARACTERISTIC C2ASpd_hist_avg_t "Cam2 Aux Speed averaging window" VALUE 0x001466d8 /* @ECU_Address@C2ASpd_hist_avg_t@0x0100BC20@ */ ECIPP_ALIGNMENT_UWORD 65535 Compu_C2ASpd_hist_avg_t 0 65535 /end CHARACTERISTIC
/begin COMPU_METHOD Compu_C2ASpd_hist_avg_t " " RAT_FUNC "%.0" "ms" COEFFS 0 1 0 0 0 1 /end COMPU_METHOD
/begin CHARACTERISTIC C2ASpd_hist_tout "Cam2 Aux Speed zeroing time" VALUE 0x001466da /* @ECU_Address@C2ASpd_hist_tout@0x0100BC28@ */ ECIPP_ALIGNMENT_UWORD 65535 Compu_C2ASpd_hist_tout 0 65535 /end CHARACTERISTIC
/begin COMPU_METHOD Compu_C2ASpd_hist_tout " " RAT_FUNC "%.0" "ms" COEFFS 0 1 0 0 0 1 /end COMPU_METHOD
/begin MEASUREMENT C2ASpd_freq_raw "Cam2 Aux Speed pulse input frequency" FLOAT32_IEEE Compu_C2ASpd_freq_raw 0 0 -10000000000 10000000000 ECU_ADDRESS 0x0100BC30 /end MEASUREMENT
/begin COMPU_METHOD Compu_C2ASpd_freq_raw " " RAT_FUNC "%.3" "Hz" COEFFS 0 1 0 0 0 1 /end COMPU_METHOD
/begin MEASUREMENT dwell_d_amp_ls "Dwell adapt target adjusted" SWORD Compu_dwell_d_amp_ls 0 0 -32 31.9990234375 ECU_ADDRESS 0x0100C050 /end MEASUREMENT
/begin COMPU_METHOD Compu_dwell_d_amp_ls " " RAT_FUNC "%.3" "amps" COEFFS 0 1024 0 0 0 1 /end COMPU_METHOD
/begin CHARACTERISTIC RS_Iacc_init "Initial Integrator" VALUE 0x0014438e /* @ECU_Address@RS_Iacc_init@0x0100C340@ */ ECIPP_ALIGNMENT_SWORD 800 Compu_RS_Iacc_init -800 799.9755859375 /end CHARACTERISTIC
/begin COMPU_METHOD Compu_RS_Iacc_init " " RAT_FUNC "%.1" "% load/RPM" COEFFS 0 40.96 0 0 0 1 /end COMPU_METHOD
/begin CHARACTERISTIC RSC_enable_cfg "Cruise enable Aux DIG config{RSC_enable_cfg&0xff=0:Default}{RSC_enable_cfg&0xff=1:GND}{RSC_enable_cfg&0xff=2:GND/+V}{RSC_enable_cfg&0xff=3:+V}{RSC_enable_cfg&0xff=4:Open}" VALUE 0x00147efc /* @ECU_Address@RSC_enable_cfg@0x0100C7B8@ */ ECIPP_ALIGNMENT_UBYTE 255 RSC_enable_cfg_COMPU_VTAB 0 255 BIT_MASK 0xff /end CHARACTERISTIC
/begin COMPU_METHOD RSC_enable_cfg_COMPU_VTAB "Verbal Table" TAB_VERB "%.0" "list" COMPU_TAB_REF RSC_enable_cfg_COMPU_VTAB_REF /end COMPU_METHOD
/begin COMPU_VTAB RSC_enable_cfg_COMPU_VTAB_REF "Verbal Table" TAB_VERB 5 0 "Default" 1 "GND" 2 "GND/+V" 3 "+V" 4 "Open" DEFAULT_VALUE "UNKNOWN" /end COMPU_VTAB
/begin CHARACTERISTIC RSC_setinc_cfg "Cruise set/inc input Aux DIG config{RSC_setinc_cfg&0xff=0:Default}{RSC_setinc_cfg&0xff=1:GND}{RSC_setinc_cfg&0xff=2:GND/+V}{RSC_setinc_cfg&0xff=3:+V}{RSC_setinc_cfg&0xff=4:Open}" VALUE 0x00147f05 /* @ECU_Address@RSC_setinc_cfg@0x0100C7C0@ */ ECIPP_ALIGNMENT_UBYTE 255 RSC_setinc_cfg_COMPU_VTAB 0 255 BIT_MASK 0xff /end CHARACTERISTIC
/begin COMPU_METHOD RSC_setinc_cfg_COMPU_VTAB "Verbal Table" TAB_VERB "%.0" "list" COMPU_TAB_REF RSC_setinc_cfg_COMPU_VTAB_REF /end COMPU_METHOD
/begin COMPU_VTAB RSC_setinc_cfg_COMPU_VTAB_REF "Verbal Table" TAB_VERB 5 0 "Default" 1 "GND" 2 "GND/+V" 3 "+V" 4 "Open" DEFAULT_VALUE "UNKNOWN" /end COMPU_VTAB
/begin CHARACTERISTIC RSC_setdec_cfg "Cruise set/dec input Aux DIG config{RSC_setdec_cfg&0xff=0:Default}{RSC_setdec_cfg&0xff=1:GND}{RSC_setdec_cfg&0xff=2:GND/+V}{RSC_setdec_cfg&0xff=3:+V}{RSC_setdec_cfg&0xff=4:Open}" VALUE 0x00147f03 /* @ECU_Address@RSC_setdec_cfg@0x0100C7C8@ */ ECIPP_ALIGNMENT_UBYTE 255 RSC_setdec_cfg_COMPU_VTAB 0 255 BIT_MASK 0xff /end CHARACTERISTIC
/begin COMPU_METHOD RSC_setdec_cfg_COMPU_VTAB "Verbal Table" TAB_VERB "%.0" "list" COMPU_TAB_REF RSC_setdec_cfg_COMPU_VTAB_REF /end COMPU_METHOD
/begin COMPU_VTAB RSC_setdec_cfg_COMPU_VTAB_REF "Verbal Table" TAB_VERB 5 0 "Default" 1 "GND" 2 "GND/+V" 3 "+V" 4 "Open" DEFAULT_VALUE "UNKNOWN" /end COMPU_VTAB
/begin CHARACTERISTIC RSC_resume_cfg "Cruise resume input Aux DIG config{RSC_resume_cfg&0xff=0:Default}{RSC_resume_cfg&0xff=1:GND}{RSC_resume_cfg&0xff=2:GND/+V}{RSC_resume_cfg&0xff=3:+V}{RSC_resume_cfg&0xff=4:Open}" VALUE 0x00147f00 /* @ECU_Address@RSC_resume_cfg@0x0100C7D0@ */ ECIPP_ALIGNMENT_UBYTE 255 RSC_resume_cfg_COMPU_VTAB 0 255 BIT_MASK 0xff /end CHARACTERISTIC
/begin COMPU_METHOD RSC_resume_cfg_COMPU_VTAB "Verbal Table" TAB_VERB "%.0" "list" COMPU_TAB_REF RSC_resume_cfg_COMPU_VTAB_REF /end COMPU_METHOD
/begin COMPU_VTAB RSC_resume_cfg_COMPU_VTAB_REF "Verbal Table" TAB_VERB 5 0 "Default" 1 "GND" 2 "GND/+V" 3 "+V" 4 "Open" DEFAULT_VALUE "UNKNOWN" /end COMPU_VTAB
/begin CHARACTERISTIC MEFI_RS_source_ena "MEFI command packet roadspeed source selection{MEFI_RS_source_ena&0xff=0:Disabled}{MEFI_RS_source_ena&0xff=1:Enabled}" VALUE 0x00147e5c /* @ECU_Address@MEFI_RS_source_ena@0x0100D0D0@ */ ECIPP_ALIGNMENT_UBYTE 255 MEFI_RS_source_ena_COMPU_VTAB 0 255 BIT_MASK 0xff /end CHARACTERISTIC
/begin COMPU_METHOD MEFI_RS_source_ena_COMPU_VTAB "Verbal Table" TAB_VERB "%.0" "list" COMPU_TAB_REF MEFI_RS_source_ena_COMPU_VTAB_REF /end COMPU_METHOD
/begin COMPU_VTAB MEFI_RS_source_ena_COMPU_VTAB_REF "Verbal Table" TAB_VERB 2 0 "Disabled" 1 "Enabled" DEFAULT_VALUE "UNKNOWN" /end COMPU_VTAB
/begin MEASUREMENT MEFI_RS_source_req "MEFI command packet roadspeed source request{MEFI_RS_source_req&0xff=0:N/A - Default}{MEFI_RS_source_req&0xff=1:Paddlewheel / Pulse Input}{MEFI_RS_source_req&0xff=2:ZeroOff GPS}{MEFI_RS_source_req&0xff=3:Generic J1939 GPS}" UBYTE MEFI_RS_source_req_COMPU_VTAB 0 0 0 255 ECU_ADDRESS 0x0100D0D8 BIT_MASK 0xff /end MEASUREMENT
/begin COMPU_METHOD MEFI_RS_source_req_COMPU_VTAB "Verbal Table" TAB_VERB "%.0" "list" COMPU_TAB_REF MEFI_RS_source_req_COMPU_VTAB_REF /end COMPU_METHOD
/begin COMPU_VTAB MEFI_RS_source_req_COMPU_VTAB_REF "Verbal Table" TAB_VERB 4 0 "N/A - Default" 1 "Paddlewheel / Pulse Input" 2 "ZeroOff GPS" 3 "Generic J1939 GPS" DEFAULT_VALUE "UNKNOWN" /end COMPU_VTAB
/begin CHARACTERISTIC RSC_disable_chan "Cruise disable input{RSC_disable_chan&0xff=0:Disabled}{RSC_disable_chan&0xff=1:Aux PU1 = Gnd}{RSC_disable_chan&0xff=2:Aux PU2 = Gnd}{RSC_disable_chan&0xff=3:Aux PU3 = Gnd}{RSC_disable_chan&0xff=4:Aux PUD1 = Gnd}{RSC_disable_chan&0xff=5:Aux PUD2 = Gnd}{RSC" VALUE 0x00147efb /* @ECU_Address@RSC_disable_chan@0x0100D788@ */ ECIPP_ALIGNMENT_UBYTE 255 RSC_disable_chan_COMPU_VTAB 0 255 BIT_MASK 0xff /end CHARACTERISTIC
/begin COMPU_METHOD RSC_disable_chan_COMPU_VTAB "Verbal Table" TAB_VERB "%.0" "list" COMPU_TAB_REF RSC_disable_chan_COMPU_VTAB_REF /end COMPU_METHOD
/begin COMPU_VTAB RSC_disable_chan_COMPU_VTAB_REF "Verbal Table" TAB_VERB 30 0 "Disabled" 1 "Aux PU1 = Gnd" 2 "Aux PU2 = Gnd" 3 "Aux PU3 = Gnd" 4 "Aux PUD1 = Gnd" 5 "Aux PUD2 = Gnd" 6 "Aux PUD3 = Gnd" 7 "Aux PUD4 = +V" 8 "Aux PUD5 = Gnd" 9 "Aux DIG1" 10 "Aux DIG2" 11 "Aux DIG3" 12 "Aux DIG4" 13 "Aux DIG5" 14 "Aux DIG6" 15 "Aux DIG7" 16 "Aux DIG8" 17 "Aux DIG9" 18 "Aux DIG10" 19 "Aux DIG11" 20 "Aux DIG12" 21 "Aux DIG13" 22 "Aux DIG14" 23 "Aux DIG15" 24 "Aux DIG16" 25 "Aux DIG17" 26 "Aux DIG18" 27 "Aux DIG19" 28 "Gov1" 29 "Gov2" DEFAULT_VALUE "UNKNOWN" /end COMPU_VTAB
/begin CHARACTERISTIC RSC_disable_cfg "Cruise disable Aux DIG config{RSC_disable_cfg&0xff=0:Default}{RSC_disable_cfg&0xff=1:GND}{RSC_disable_cfg&0xff=2:GND/+V}{RSC_disable_cfg&0xff=3:+V}{RSC_disable_cfg&0xff=4:Open}" VALUE 0x00147efa /* @ECU_Address@RSC_disable_cfg@0x0100D790@ */ ECIPP_ALIGNMENT_UBYTE 255 RSC_disable_cfg_COMPU_VTAB 0 255 BIT_MASK 0xff /end CHARACTERISTIC
/begin COMPU_METHOD RSC_disable_cfg_COMPU_VTAB "Verbal Table" TAB_VERB "%.0" "list" COMPU_TAB_REF RSC_disable_cfg_COMPU_VTAB_REF /end COMPU_METHOD
/begin COMPU_VTAB RSC_disable_cfg_COMPU_VTAB_REF "Verbal Table" TAB_VERB 5 0 "Default" 1 "GND" 2 "GND/+V" 3 "+V" 4 "Open" DEFAULT_VALUE "UNKNOWN" /end COMPU_VTAB
/begin CHARACTERISTIC ECTHst_ena "ECT histogram{ECTHst_ena&0xff=0:Disabled}{ECTHst_ena&0xff=1:Enabled}" VALUE 0x00147d1b /* @ECU_Address@ECTHst_ena@0x0100DD48@ */ ECIPP_ALIGNMENT_UBYTE 255 ECTHst_ena_COMPU_VTAB 0 255 BIT_MASK 0xff /end CHARACTERISTIC
/begin COMPU_METHOD ECTHst_ena_COMPU_VTAB "Verbal Table" TAB_VERB "%.0" "list" COMPU_TAB_REF ECTHst_ena_COMPU_VTAB_REF /end COMPU_METHOD
/begin COMPU_VTAB ECTHst_ena_COMPU_VTAB_REF "Verbal Table" TAB_VERB 2 0 "Disabled" 1 "Enabled" DEFAULT_VALUE "UNKNOWN" /end COMPU_VTAB
/begin MEASUREMENT ECTHst_reset_usr "ECT histogram reset" UWORD Compu_ECTHst_reset_usr 0 0 0 65535 ECU_ADDRESS 0x0100DD58 /end MEASUREMENT
/begin COMPU_METHOD Compu_ECTHst_reset_usr " " RAT_FUNC "%.0" "-" COEFFS 0 1 0 0 0 1 /end COMPU_METHOD
/begin CHARACTERISTIC ECTHst_hi_trig "ECT hour meter trigger" VALUE 0x00146796 /* @ECU_Address@ECTHst_hi_trig@0x0100DD68@ */ ECIPP_ALIGNMENT_UWORD 564 Compu_ECTHst_hi_trig -460 563.984375 /end CHARACTERISTIC
/begin COMPU_METHOD Compu_ECTHst_hi_trig " " RAT_FUNC "%.1" "deg F" COEFFS 0 64 29440 0 0 1 /end COMPU_METHOD
/begin CHARACTERISTIC RS_speed_Llim "Roadspeed network setpoint lower-limit" VALUE 0x00147742 /* @ECU_Address@RS_speed_Llim@0x0100DD78@ */ ECIPP_ALIGNMENT_UWORD 256 Compu_RS_speed_Llim 0 255.99609375 /end CHARACTERISTIC
/begin COMPU_METHOD Compu_RS_speed_Llim " " RAT_FUNC "%.1" "km/hr" COEFFS 0 256 0 0 0 1 /end COMPU_METHOD
/begin CHARACTERISTIC RS_speed_Ulim "Roadspeed network setpoint upper-limit" VALUE 0x00147744 /* @ECU_Address@RS_speed_Ulim@0x0100DD80@ */ ECIPP_ALIGNMENT_UWORD 256 Compu_RS_speed_Ulim 0 255.99609375 /end CHARACTERISTIC
/begin COMPU_METHOD Compu_RS_speed_Ulim " " RAT_FUNC "%.1" "km/hr" COEFFS 0 256 0 0 0 1 /end COMPU_METHOD
/begin CHARACTERISTIC RS_ppkm_Ulim "Roadspeed pulse cal upper-limit" VALUE 0x00147732 /* @ECU_Address@RS_ppkm_Ulim@0x0100DD88@ */ ECIPP_ALIGNMENT_UWORD 1048560 Compu_RS_ppkm_Ulim 0 1048560 /end CHARACTERISTIC
/begin COMPU_METHOD Compu_RS_ppkm_Ulim " " RAT_FUNC "%.1" "pulses/km" COEFFS 0 0.0625 0 0 0 1 /end COMPU_METHOD
/begin CHARACTERISTIC RS_loV "Roadspeed internal 0-5V low voltage (Fault Condition:No pulse activity and internal 0-5V input <)" VALUE 0x00147728 /* @ECU_Address@RS_loV@0x0100DD90@ */ ECIPP_ALIGNMENT_UWORD 5 Compu_RS_loV 0 5.00114468864469 /end CHARACTERISTIC
/begin COMPU_METHOD Compu_RS_loV " " RAT_FUNC "%.3" "volts" COEFFS 0 13104 0 0 0 1 /end COMPU_METHOD
/begin CHARACTERISTIC RS_hiV "Roadspeed internal 0-5V high voltage (Fault Condition:No pulse activity and internal 0-5V input >)" VALUE 0x00147722 /* @ECU_Address@RS_hiV@0x0100DD98@ */ ECIPP_ALIGNMENT_UWORD 5 Compu_RS_hiV 0 5.00114468864469 /end CHARACTERISTIC
/begin COMPU_METHOD Compu_RS_hiV " " RAT_FUNC "%.3" "volts" COEFFS 0 13104 0 0 0 1 /end COMPU_METHOD
/begin MEASUREMENT RMT_RS_pulses_per_km "Roadspeed network pulse calibration" UWORD Compu_RMT_RS_pulses_per_km 0 0 0 1048560 ECU_ADDRESS 0x0100DDA8 /end MEASUREMENT
/begin COMPU_METHOD Compu_RMT_RS_pulses_per_km " " RAT_FUNC "%.1" "pulses/km" COEFFS 0 0.0625 0 0 0 1 /end COMPU_METHOD
/begin MEASUREMENT RMT_RS_speed_1 "Roadspeed network speed target 1" UWORD Compu_RMT_RS_speed_1 0 0 0 255.99609375 ECU_ADDRESS 0x0100DDB0 /end MEASUREMENT
/begin COMPU_METHOD Compu_RMT_RS_speed_1 " " RAT_FUNC "%.1" "km/hr" COEFFS 0 256 0 0 0 1 /end COMPU_METHOD
/begin MEASUREMENT RMT_RS_speed_2 "Roadspeed network speed target 2" UWORD Compu_RMT_RS_speed_2 0 0 0 255.99609375 ECU_ADDRESS 0x0100DDB8 /end MEASUREMENT
/begin COMPU_METHOD Compu_RMT_RS_speed_2 " " RAT_FUNC "%.1" "km/hr" COEFFS 0 256 0 0 0 1 /end COMPU_METHOD
/begin MEASUREMENT RMT_RS_mode "Roadspeed network target mode{RMT_RS_mode&0xff=255:Not Available}{RMT_RS_mode&0xff=0:Gov Select Target}{RMT_RS_mode&0xff=1:Remote Target 1}{RMT_RS_mode&0xff=2:Remote Target 2}" UBYTE RMT_RS_mode_COMPU_VTAB 0 0 0 255 ECU_ADDRESS 0x0100DDC0 BIT_MASK 0xff /end MEASUREMENT
/begin COMPU_METHOD RMT_RS_mode_COMPU_VTAB "Verbal Table" TAB_VERB "%.0" "list" COMPU_TAB_REF RMT_RS_mode_COMPU_VTAB_REF /end COMPU_METHOD
/begin COMPU_VTAB RMT_RS_mode_COMPU_VTAB_REF "Verbal Table" TAB_VERB 4 255 "Not Available" 0 "Gov Select Target" 1 "Remote Target 1" 2 "Remote Target 2" DEFAULT_VALUE "UNKNOWN" /end COMPU_VTAB
/begin CHARACTERISTIC RSC_disable_by_RBC "Cruise disabled by retarder braking{RSC_disable_by_RBC&0xff=0:No}{RSC_disable_by_RBC&0xff=1:Yes}" VALUE 0x00147ef9 /* @ECU_Address@RSC_disable_by_RBC@0x0100E5A8@ */ ECIPP_ALIGNMENT_UBYTE 255 RSC_disable_by_RBC_COMPU_VTAB 0 255 BIT_MASK 0xff /end CHARACTERISTIC
/begin COMPU_METHOD RSC_disable_by_RBC_COMPU_VTAB "Verbal Table" TAB_VERB "%.0" "list" COMPU_TAB_REF RSC_disable_by_RBC_COMPU_VTAB_REF /end COMPU_METHOD
/begin COMPU_VTAB RSC_disable_by_RBC_COMPU_VTAB_REF "Verbal Table" TAB_VERB 2 0 "No" 1 "Yes" DEFAULT_VALUE "UNKNOWN" /end COMPU_VTAB
/begin MEASUREMENT RS_dir "Roadspeed direction{RS_dir&0xff=0:Not Available}{RS_dir&0xff=1:Error}{RS_dir&0xff=2:Stopped}{RS_dir&0xff=3:Waiting}{RS_dir&0xff=4:Fwd or Reverse}{RS_dir&0xff=5:Forward}{RS_dir&0xff=6:Reverse}" UBYTE RS_dir_COMPU_VTAB 0 0 0 255 ECU_ADDRESS 0x0100F218 BIT_MASK 0xff /end MEASUREMENT
/begin COMPU_METHOD RS_dir_COMPU_VTAB "Verbal Table" TAB_VERB "%.0" "list" COMPU_TAB_REF RS_dir_COMPU_VTAB_REF /end COMPU_METHOD
/begin COMPU_VTAB RS_dir_COMPU_VTAB_REF "Verbal Table" TAB_VERB 7 0 "Not Available" 1 "Error" 2 "Stopped" 3 "Waiting" 4 "Fwd or Reverse" 5 "Forward" 6 "Reverse" DEFAULT_VALUE "UNKNOWN" /end COMPU_VTAB
/begin CHARACTERISTIC RS_pattern "Roadspeed pulse pattern{RS_pattern&0xff=0:Uniform Non-Directional}{RS_pattern&0xff=1:Directional 5+6+7}{RS_pattern&0xff=2:Directional 7+6+5}" VALUE 0x00147f11 /* @ECU_Address@RS_pattern@0x0100F220@ */ ECIPP_ALIGNMENT_UBYTE 255 RS_pattern_COMPU_VTAB 0 255 BIT_MASK 0xff /end CHARACTERISTIC
/begin COMPU_METHOD RS_pattern_COMPU_VTAB "Verbal Table" TAB_VERB "%.0" "list" COMPU_TAB_REF RS_pattern_COMPU_VTAB_REF /end COMPU_METHOD
/begin COMPU_VTAB RS_pattern_COMPU_VTAB_REF "Verbal Table" TAB_VERB 3 0 "Uniform Non-Directional" 1 "Directional 5+6+7" 2 "Directional 7+6+5" DEFAULT_VALUE "UNKNOWN" /end COMPU_VTAB
/begin CHARACTERISTIC RS_disc_tmr "Sample rate (Fault Condition:No pulse activity at sample rate of:)" VALUE 0x0014411c /* @ECU_Address@RS_disc_tmr@0x0100FC10@ */ ECIPP_ALIGNMENT_ULONG 4294967 Compu_RS_disc_tmr 0 4294967.295 /end CHARACTERISTIC
/begin COMPU_METHOD Compu_RS_disc_tmr " " RAT_FUNC "%.3" "sec" COEFFS 0 1000 0 0 0 1 /end COMPU_METHOD
/begin CHARACTERISTIC RS_disc_thr "Offset (Fault Condition:AND input RS sensor offset voltage >)" VALUE 0x00147720 /* @ECU_Address@RS_disc_thr@0x0100FC18@ */ ECIPP_ALIGNMENT_UWORD 5 Compu_RS_disc_thr 0 5.00114468864469 /end CHARACTERISTIC
/begin COMPU_METHOD Compu_RS_disc_thr " " RAT_FUNC "%.3" "volts" COEFFS 0 13104 0 0 0 1 /end COMPU_METHOD
/begin MEASUREMENT RS_disc_ana "RS_ana_raw during Mag test" UWORD Compu_RS_disc_ana 0 0 0 5.00114468864469 ECU_ADDRESS 0x0100FC20 /end MEASUREMENT
/begin COMPU_METHOD Compu_RS_disc_ana " " RAT_FUNC "%.3" "volts" COEFFS 0 13104 0 0 0 1 /end COMPU_METHOD
/begin MEASUREMENT RS_disc_calc "Threshold voltage" UWORD Compu_RS_disc_calc 0 0 0 5.00114468864469 ECU_ADDRESS 0x0100FC28 /end MEASUREMENT
/begin COMPU_METHOD Compu_RS_disc_calc " " RAT_FUNC "%.3" "volts" COEFFS 0 13104 0 0 0 1 /end COMPU_METHOD
/begin CHARACTERISTIC RS_disc_rpm "Engine speed < (Fault Condition:AND engine speed <)" VALUE 0x0014771e /* @ECU_Address@RS_disc_rpm@0x0100FC30@ */ ECIPP_ALIGNMENT_UWORD 65535 Compu_RS_disc_rpm 0 65535 /end CHARACTERISTIC
/begin COMPU_METHOD Compu_RS_disc_rpm " " RAT_FUNC "%.0" "rpm" COEFFS 0 1 0 0 0 1 /end COMPU_METHOD
/begin CHARACTERISTIC RS_GPS_UA_tout "GPS unacquired control set switch" VALUE 0x0014771a /* @ECU_Address@RS_GPS_UA_tout@0x0100FC50@ */ ECIPP_ALIGNMENT_UWORD 65535 Compu_RS_GPS_UA_tout 0 65535 /end CHARACTERISTIC
/begin COMPU_METHOD Compu_RS_GPS_UA_tout " " RAT_FUNC "%.0" "ms" COEFFS 0 1 0 0 0 1 /end COMPU_METHOD
/begin CHARACTERISTIC RS_disc_ena "Enable test{RS_disc_ena&0xff=0:Disabled}{RS_disc_ena&0xff=1:Always enabled}{RS_disc_ena&0xff=2:Active RS HW input}{RS_disc_ena&0xff=3:Active CAN setpoint} (Fault Condition:Roadspeed sensor disconnected testing:)" VALUE 0x00147f0b /* @ECU_Address@RS_disc_ena@0x0100FC88@ */ ECIPP_ALIGNMENT_UBYTE 255 RS_disc_ena_COMPU_VTAB 0 255 BIT_MASK 0xff /end CHARACTERISTIC
/begin COMPU_METHOD RS_disc_ena_COMPU_VTAB "Verbal Table" TAB_VERB "%.0" "list" COMPU_TAB_REF RS_disc_ena_COMPU_VTAB_REF /end COMPU_METHOD
/begin COMPU_VTAB RS_disc_ena_COMPU_VTAB_REF "Verbal Table" TAB_VERB 4 0 "Disabled" 1 "Always enabled" 2 "Active RS HW input" 3 "Active CAN setpoint" DEFAULT_VALUE "UNKNOWN" /end COMPU_VTAB
/begin CHARACTERISTIC RS_disc_Vbat "Vbat >= (Fault Condition:while battery voltage >)" VALUE 0x0014771c /* @ECU_Address@RS_disc_Vbat@0x0100FC90@ */ ECIPP_ALIGNMENT_UWORD 256 Compu_RS_disc_Vbat 0 255.99609375 /end CHARACTERISTIC
/begin COMPU_METHOD Compu_RS_disc_Vbat " " RAT_FUNC "%.1" "volts" COEFFS 0 256 0 0 0 1 /end COMPU_METHOD
/begin MEASUREMENT enov_slnk_u8_1 "enov_slnk_u8_1" UBYTE Compu_enov_slnk_u8_1 0 0 0 255 ECU_ADDRESS 0x0100FD30 /end MEASUREMENT
/begin COMPU_METHOD Compu_enov_slnk_u8_1 " " RAT_FUNC "%.0" "-" COEFFS 0 1 0 0 0 1 /end COMPU_METHOD
/begin MEASUREMENT enov_slnk_u8_2 "enov_slnk_u8_2" UBYTE Compu_enov_slnk_u8_2 0 0 0 255 ECU_ADDRESS 0x0100FD38 /end MEASUREMENT
/begin COMPU_METHOD Compu_enov_slnk_u8_2 " " RAT_FUNC "%.0" "-" COEFFS 0 1 0 0 0 1 /end COMPU_METHOD
/begin MEASUREMENT enov_slnk_u8_3 "enov_slnk_u8_3" UBYTE Compu_enov_slnk_u8_3 0 0 0 255 ECU_ADDRESS 0x0100FD40 /end MEASUREMENT
/begin COMPU_METHOD Compu_enov_slnk_u8_3 " " RAT_FUNC "%.0" "-" COEFFS 0 1 0 0 0 1 /end COMPU_METHOD
/begin MEASUREMENT enov_slnk_u8_4 "enov_slnk_u8_4" UBYTE Compu_enov_slnk_u8_4 0 0 0 255 ECU_ADDRESS 0x0100FD48 /end MEASUREMENT
/begin COMPU_METHOD Compu_enov_slnk_u8_4 " " RAT_FUNC "%.0" "-" COEFFS 0 1 0 0 0 1 /end COMPU_METHOD
/begin MEASUREMENT enov_slnk_u8_5 "enov_slnk_u8_5" UBYTE Compu_enov_slnk_u8_5 0 0 0 255 ECU_ADDRESS 0x0100FD50 /end MEASUREMENT
/begin COMPU_METHOD Compu_enov_slnk_u8_5 " " RAT_FUNC "%.0" "-" COEFFS 0 1 0 0 0 1 /end COMPU_METHOD
/begin MEASUREMENT enov_slnk_u8_6 "enov_slnk_u8_6" UBYTE Compu_enov_slnk_u8_6 0 0 0 255 ECU_ADDRESS 0x0100FD58 /end MEASUREMENT
/begin COMPU_METHOD Compu_enov_slnk_u8_6 " " RAT_FUNC "%.0" "-" COEFFS 0 1 0 0 0 1 /end COMPU_METHOD
/begin MEASUREMENT enov_slnk_u8_7 "enov_slnk_u8_7" UBYTE Compu_enov_slnk_u8_7 0 0 0 255 ECU_ADDRESS 0x0100FD60 /end MEASUREMENT
/begin COMPU_METHOD Compu_enov_slnk_u8_7 " " RAT_FUNC "%.0" "-" COEFFS 0 1 0 0 0 1 /end COMPU_METHOD
/begin MEASUREMENT enov_slnk_u8_8 "enov_slnk_u8_8" UBYTE Compu_enov_slnk_u8_8 0 0 0 255 ECU_ADDRESS 0x0100FD68 /end MEASUREMENT
/begin COMPU_METHOD Compu_enov_slnk_u8_8 " " RAT_FUNC "%.0" "-" COEFFS 0 1 0 0 0 1 /end COMPU_METHOD
/begin MEASUREMENT enov_slnk_u8_9 "enov_slnk_u8_9" UBYTE Compu_enov_slnk_u8_9 0 0 0 255 ECU_ADDRESS 0x0100FD70 /end MEASUREMENT
/begin COMPU_METHOD Compu_enov_slnk_u8_9 " " RAT_FUNC "%.0" "-" COEFFS 0 1 0 0 0 1 /end COMPU_METHOD
/begin MEASUREMENT enov_slnk_u8_10 "enov_slnk_u8_10" UBYTE Compu_enov_slnk_u8_10 0 0 0 255 ECU_ADDRESS 0x0100FD78 /end MEASUREMENT
/begin COMPU_METHOD Compu_enov_slnk_u8_10 " " RAT_FUNC "%.0" "-" COEFFS 0 1 0 0 0 1 /end COMPU_METHOD
/begin MEASUREMENT enov_slnk_u8_11 "enov_slnk_u8_11" UBYTE Compu_enov_slnk_u8_11 0 0 0 255 ECU_ADDRESS 0x0100FD80 /end MEASUREMENT
/begin COMPU_METHOD Compu_enov_slnk_u8_11 " " RAT_FUNC "%.0" "-" COEFFS 0 1 0 0 0 1 /end COMPU_METHOD
/begin MEASUREMENT enov_slnk_u8_12 "enov_slnk_u8_12" UBYTE Compu_enov_slnk_u8_12 0 0 0 255 ECU_ADDRESS 0x0100FD88 /end MEASUREMENT
/begin COMPU_METHOD Compu_enov_slnk_u8_12 " " RAT_FUNC "%.0" "-" COEFFS 0 1 0 0 0 1 /end COMPU_METHOD
/begin MEASUREMENT enov_slnk_u8_13 "enov_slnk_u8_13" UBYTE Compu_enov_slnk_u8_13 0 0 0 255 ECU_ADDRESS 0x0100FD90 /end MEASUREMENT
/begin COMPU_METHOD Compu_enov_slnk_u8_13 " " RAT_FUNC "%.0" "-" COEFFS 0 1 0 0 0 1 /end COMPU_METHOD
/begin MEASUREMENT enov_slnk_u8_14 "enov_slnk_u8_14" UBYTE Compu_enov_slnk_u8_14 0 0 0 255 ECU_ADDRESS 0x0100FD98 /end MEASUREMENT
/begin COMPU_METHOD Compu_enov_slnk_u8_14 " " RAT_FUNC "%.0" "-" COEFFS 0 1 0 0 0 1 /end COMPU_METHOD
/begin MEASUREMENT enov_slnk_u8_15 "enov_slnk_u8_15" UBYTE Compu_enov_slnk_u8_15 0 0 0 255 ECU_ADDRESS 0x0100FDA0 /end MEASUREMENT
/begin COMPU_METHOD Compu_enov_slnk_u8_15 " " RAT_FUNC "%.0" "-" COEFFS 0 1 0 0 0 1 /end COMPU_METHOD
/begin MEASUREMENT enov_slnk_u8_16 "enov_slnk_u8_16" UBYTE Compu_enov_slnk_u8_16 0 0 0 255 ECU_ADDRESS 0x0100FDA8 /end MEASUREMENT
/begin COMPU_METHOD Compu_enov_slnk_u8_16 " " RAT_FUNC "%.0" "-" COEFFS 0 1 0 0 0 1 /end COMPU_METHOD
/begin MEASUREMENT enov_slnk_u8_17 "enov_slnk_u8_17" UBYTE Compu_enov_slnk_u8_17 0 0 0 255 ECU_ADDRESS 0x0100FDB0 /end MEASUREMENT
/begin COMPU_METHOD Compu_enov_slnk_u8_17 " " RAT_FUNC "%.0" "-" COEFFS 0 1 0 0 0 1 /end COMPU_METHOD
/begin MEASUREMENT enov_slnk_u8_18 "enov_slnk_u8_18" UBYTE Compu_enov_slnk_u8_18 0 0 0 255 ECU_ADDRESS 0x0100FDB8 /end MEASUREMENT
/begin COMPU_METHOD Compu_enov_slnk_u8_18 " " RAT_FUNC "%.0" "-" COEFFS 0 1 0 0 0 1 /end COMPU_METHOD
/begin MEASUREMENT enov_slnk_u8_19 "enov_slnk_u8_19" UBYTE Compu_enov_slnk_u8_19 0 0 0 255 ECU_ADDRESS 0x0100FDC0 /end MEASUREMENT
/begin COMPU_METHOD Compu_enov_slnk_u8_19 " " RAT_FUNC "%.0" "-" COEFFS 0 1 0 0 0 1 /end COMPU_METHOD
/begin MEASUREMENT enov_slnk_u8_20 "enov_slnk_u8_20" UBYTE Compu_enov_slnk_u8_20 0 0 0 255 ECU_ADDRESS 0x0100FDC8 /end MEASUREMENT
/begin COMPU_METHOD Compu_enov_slnk_u8_20 " " RAT_FUNC "%.0" "-" COEFFS 0 1 0 0 0 1 /end COMPU_METHOD
/begin MEASUREMENT enov_slnk_f_1 "enov_slnk_f_1" FLOAT32_IEEE Compu_enov_slnk_f_1 0 0 -10000000000 10000000000 ECU_ADDRESS 0x0100FDD0 /end MEASUREMENT
/begin COMPU_METHOD Compu_enov_slnk_f_1 " " RAT_FUNC "%.3" "-" COEFFS 0 1 0 0 0 1 /end COMPU_METHOD
/begin MEASUREMENT enov_slnk_f_2 "enov_slnk_f_2" FLOAT32_IEEE Compu_enov_slnk_f_2 0 0 -10000000000 10000000000 ECU_ADDRESS 0x0100FDD8 /end MEASUREMENT
/begin COMPU_METHOD Compu_enov_slnk_f_2 " " RAT_FUNC "%.3" "-" COEFFS 0 1 0 0 0 1 /end COMPU_METHOD
/begin MEASUREMENT enov_slnk_f_3 "enov_slnk_f_3" FLOAT32_IEEE Compu_enov_slnk_f_3 0 0 -10000000000 10000000000 ECU_ADDRESS 0x0100FDE0 /end MEASUREMENT
/begin COMPU_METHOD Compu_enov_slnk_f_3 " " RAT_FUNC "%.3" "-" COEFFS 0 1 0 0 0 1 /end COMPU_METHOD
/begin MEASUREMENT enov_slnk_f_4 "enov_slnk_f_4" FLOAT32_IEEE Compu_enov_slnk_f_4 0 0 -10000000000 10000000000 ECU_ADDRESS 0x0100FDE8 /end MEASUREMENT
/begin COMPU_METHOD Compu_enov_slnk_f_4 " " RAT_FUNC "%.3" "-" COEFFS 0 1 0 0 0 1 /end COMPU_METHOD
/begin MEASUREMENT enov_slnk_f_5 "enov_slnk_f_5" FLOAT32_IEEE Compu_enov_slnk_f_5 0 0 -10000000000 10000000000 ECU_ADDRESS 0x0100FDF0 /end MEASUREMENT
/begin COMPU_METHOD Compu_enov_slnk_f_5 " " RAT_FUNC "%.3" "-" COEFFS 0 1 0 0 0 1 /end COMPU_METHOD
/begin MEASUREMENT enov_slnk_f_6 "enov_slnk_f_6" FLOAT32_IEEE Compu_enov_slnk_f_6 0 0 -10000000000 10000000000 ECU_ADDRESS 0x0100FDF8 /end MEASUREMENT
/begin COMPU_METHOD Compu_enov_slnk_f_6 " " RAT_FUNC "%.3" "-" COEFFS 0 1 0 0 0 1 /end COMPU_METHOD
/begin MEASUREMENT enov_slnk_f_7 "enov_slnk_f_7" FLOAT32_IEEE Compu_enov_slnk_f_7 0 0 -10000000000 10000000000 ECU_ADDRESS 0x0100FE00 /end MEASUREMENT
/begin COMPU_METHOD Compu_enov_slnk_f_7 " " RAT_FUNC "%.3" "-" COEFFS 0 1 0 0 0 1 /end COMPU_METHOD
/begin MEASUREMENT enov_slnk_f_8 "enov_slnk_f_8" FLOAT32_IEEE Compu_enov_slnk_f_8 0 0 -10000000000 10000000000 ECU_ADDRESS 0x0100FE08 /end MEASUREMENT
/begin COMPU_METHOD Compu_enov_slnk_f_8 " " RAT_FUNC "%.3" "-" COEFFS 0 1 0 0 0 1 /end COMPU_METHOD
/begin MEASUREMENT enov_slnk_f_9 "enov_slnk_f_9" FLOAT32_IEEE Compu_enov_slnk_f_9 0 0 -10000000000 10000000000 ECU_ADDRESS 0x0100FE10 /end MEASUREMENT
/begin COMPU_METHOD Compu_enov_slnk_f_9 " " RAT_FUNC "%.3" "-" COEFFS 0 1 0 0 0 1 /end COMPU_METHOD
/begin MEASUREMENT enov_slnk_f_10 "enov_slnk_f_10" FLOAT32_IEEE Compu_enov_slnk_f_10 0 0 -10000000000 10000000000 ECU_ADDRESS 0x0100FE18 /end MEASUREMENT
/begin COMPU_METHOD Compu_enov_slnk_f_10 " " RAT_FUNC "%.3" "-" COEFFS 0 1 0 0 0 1 /end COMPU_METHOD
/begin MEASUREMENT enov_slnk_f_11 "enov_slnk_f_11" FLOAT32_IEEE Compu_enov_slnk_f_11 0 0 -10000000000 10000000000 ECU_ADDRESS 0x0100FE20 /end MEASUREMENT
/begin COMPU_METHOD Compu_enov_slnk_f_11 " " RAT_FUNC "%.3" "-" COEFFS 0 1 0 0 0 1 /end COMPU_METHOD
/begin MEASUREMENT enov_slnk_f_12 "enov_slnk_f_12" FLOAT32_IEEE Compu_enov_slnk_f_12 0 0 -10000000000 10000000000 ECU_ADDRESS 0x0100FE28 /end MEASUREMENT
/begin COMPU_METHOD Compu_enov_slnk_f_12 " " RAT_FUNC "%.3" "-" COEFFS 0 1 0 0 0 1 /end COMPU_METHOD
/begin MEASUREMENT enov_slnk_f_13 "enov_slnk_f_13" FLOAT32_IEEE Compu_enov_slnk_f_13 0 0 -10000000000 10000000000 ECU_ADDRESS 0x0100FE30 /end MEASUREMENT
/begin COMPU_METHOD Compu_enov_slnk_f_13 " " RAT_FUNC "%.3" "-" COEFFS 0 1 0 0 0 1 /end COMPU_METHOD
/begin MEASUREMENT enov_slnk_f_14 "enov_slnk_f_14" FLOAT32_IEEE Compu_enov_slnk_f_14 0 0 -10000000000 10000000000 ECU_ADDRESS 0x0100FE38 /end MEASUREMENT
/begin COMPU_METHOD Compu_enov_slnk_f_14 " " RAT_FUNC "%.3" "-" COEFFS 0 1 0 0 0 1 /end COMPU_METHOD
/begin MEASUREMENT enov_slnk_f_15 "enov_slnk_f_15" FLOAT32_IEEE Compu_enov_slnk_f_15 0 0 -10000000000 10000000000 ECU_ADDRESS 0x0100FE40 /end MEASUREMENT
/begin COMPU_METHOD Compu_enov_slnk_f_15 " " RAT_FUNC "%.3" "-" COEFFS 0 1 0 0 0 1 /end COMPU_METHOD
/begin MEASUREMENT enov_slnk_f_16 "enov_slnk_f_16" FLOAT32_IEEE Compu_enov_slnk_f_16 0 0 -10000000000 10000000000 ECU_ADDRESS 0x0100FE48 /end MEASUREMENT
/begin COMPU_METHOD Compu_enov_slnk_f_16 " " RAT_FUNC "%.3" "-" COEFFS 0 1 0 0 0 1 /end COMPU_METHOD
/begin MEASUREMENT enov_slnk_f_17 "enov_slnk_f_17" FLOAT32_IEEE Compu_enov_slnk_f_17 0 0 -10000000000 10000000000 ECU_ADDRESS 0x0100FE50 /end MEASUREMENT
/begin COMPU_METHOD Compu_enov_slnk_f_17 " " RAT_FUNC "%.3" "-" COEFFS 0 1 0 0 0 1 /end COMPU_METHOD
/begin MEASUREMENT enov_slnk_f_18 "enov_slnk_f_18" FLOAT32_IEEE Compu_enov_slnk_f_18 0 0 -10000000000 10000000000 ECU_ADDRESS 0x0100FE58 /end MEASUREMENT
/begin COMPU_METHOD Compu_enov_slnk_f_18 " " RAT_FUNC "%.3" "-" COEFFS 0 1 0 0 0 1 /end COMPU_METHOD
/begin MEASUREMENT enov_slnk_f_19 "enov_slnk_f_19" FLOAT32_IEEE Compu_enov_slnk_f_19 0 0 -10000000000 10000000000 ECU_ADDRESS 0x0100FE60 /end MEASUREMENT
/begin COMPU_METHOD Compu_enov_slnk_f_19 " " RAT_FUNC "%.3" "-" COEFFS 0 1 0 0 0 1 /end COMPU_METHOD
/begin MEASUREMENT enov_slnk_f_20 "enov_slnk_f_20" FLOAT32_IEEE Compu_enov_slnk_f_20 0 0 -10000000000 10000000000 ECU_ADDRESS 0x0100FE68 /end MEASUREMENT
/begin COMPU_METHOD Compu_enov_slnk_f_20 " " RAT_FUNC "%.3" "-" COEFFS 0 1 0 0 0 1 /end COMPU_METHOD
/begin MEASUREMENT slnk_invalid_fsh_adr "Invalid flash access" ULONG Compu_slnk_invalid_fsh_adr 0 0 0 4294967295 ECU_ADDRESS 0x0100FE70 /end MEASUREMENT
/begin COMPU_METHOD Compu_slnk_invalid_fsh_adr " " RAT_FUNC "%.0" "address" COEFFS 0 1 0 0 0 1 /end COMPU_METHOD
/begin MEASUREMENT slnk_invalid_fsh_cnt "Invalid flash access" UBYTE Compu_slnk_invalid_fsh_cnt 0 0 0 255 ECU_ADDRESS 0x0100FE78 /end MEASUREMENT
/begin COMPU_METHOD Compu_slnk_invalid_fsh_cnt " " RAT_FUNC "%.0" "count" COEFFS 0 1 0 0 0 1 /end COMPU_METHOD
/begin MEASUREMENT slnk_invalid_reg_adr "Invalid register access" ULONG Compu_slnk_invalid_reg_adr 0 0 0 4294967295 ECU_ADDRESS 0x0100FE80 /end MEASUREMENT
/begin COMPU_METHOD Compu_slnk_invalid_reg_adr " " RAT_FUNC "%.0" "address" COEFFS 0 1 0 0 0 1 /end COMPU_METHOD
/begin MEASUREMENT slnk_invalid_reg_cnt "Invalid register access" UBYTE Compu_slnk_invalid_reg_cnt 0 0 0 255 ECU_ADDRESS 0x0100FE88 /end MEASUREMENT
/begin COMPU_METHOD Compu_slnk_invalid_reg_cnt " " RAT_FUNC "%.0" "count" COEFFS 0 1 0 0 0 1 /end COMPU_METHOD
/begin MEASUREMENT slnk_invalid_RAM_adr "Invalid RAM access" ULONG Compu_slnk_invalid_RAM_adr 0 0 0 4294967295 ECU_ADDRESS 0x0100FE90 /end MEASUREMENT
/begin COMPU_METHOD Compu_slnk_invalid_RAM_adr " " RAT_FUNC "%.0" "address" COEFFS 0 1 0 0 0 1 /end COMPU_METHOD
/begin MEASUREMENT slnk_invalid_RAM_cnt "Invalid RAM access" UBYTE Compu_slnk_invalid_RAM_cnt 0 0 0 255 ECU_ADDRESS 0x0100FE98 /end MEASUREMENT
/begin COMPU_METHOD Compu_slnk_invalid_RAM_cnt " " RAT_FUNC "%.0" "count" COEFFS 0 1 0 0 0 1 /end COMPU_METHOD
/begin MEASUREMENT enov_slnk_1ms_live "Task 1ms - Live{enov_slnk_1ms_live&0xff=0:NO}{enov_slnk_1ms_live&0xff=1:YES}" UBYTE enov_slnk_1ms_live_COMPU_VTAB 0 0 0 255 ECU_ADDRESS 0x0100FEA8 BIT_MASK 0xff /end MEASUREMENT
/begin COMPU_METHOD enov_slnk_1ms_live_COMPU_VTAB "Verbal Table" TAB_VERB "%.0" "list" COMPU_TAB_REF enov_slnk_1ms_live_COMPU_VTAB_REF /end COMPU_METHOD
/begin COMPU_VTAB enov_slnk_1ms_live_COMPU_VTAB_REF "Verbal Table" TAB_VERB 2 0 "NO" 1 "YES" DEFAULT_VALUE "UNKNOWN" /end COMPU_VTAB
/begin MEASUREMENT enov_slnk_1ms_oruns "Task 1ms - Overruns" UBYTE Compu_enov_slnk_1ms_oruns 0 0 0 255 ECU_ADDRESS 0x0100FEB0 /end MEASUREMENT
/begin COMPU_METHOD Compu_enov_slnk_1ms_oruns " " RAT_FUNC "%.0" "-" COEFFS 0 1 0 0 0 1 /end COMPU_METHOD
/begin MEASUREMENT enov_slnk_1ms_inst "Task 1ms - Inst (ms)" UWORD Compu_enov_slnk_1ms_inst 0 0 0 209.712 ECU_ADDRESS 0x0100FEB8 /end MEASUREMENT
/begin COMPU_METHOD Compu_enov_slnk_1ms_inst " " RAT_FUNC "%.3" "ms" COEFFS 0 312.5 0 0 0 1 /end COMPU_METHOD
/begin MEASUREMENT enov_slnk_1ms_max "Task 1ms - Max (ms)" UWORD Compu_enov_slnk_1ms_max 0 0 0 209.712 ECU_ADDRESS 0x0100FEC0 /end MEASUREMENT
/begin COMPU_METHOD Compu_enov_slnk_1ms_max " " RAT_FUNC "%.3" "ms" COEFFS 0 312.5 0 0 0 1 /end COMPU_METHOD
/begin MEASUREMENT enov_slnk_5ms_live "Task 5ms - Live{enov_slnk_5ms_live&0xff=0:NO}{enov_slnk_5ms_live&0xff=1:YES}" UBYTE enov_slnk_5ms_live_COMPU_VTAB 0 0 0 255 ECU_ADDRESS 0x0100FED0 BIT_MASK 0xff /end MEASUREMENT
/begin COMPU_METHOD enov_slnk_5ms_live_COMPU_VTAB "Verbal Table" TAB_VERB "%.0" "list" COMPU_TAB_REF enov_slnk_5ms_live_COMPU_VTAB_REF /end COMPU_METHOD
/begin COMPU_VTAB enov_slnk_5ms_live_COMPU_VTAB_REF "Verbal Table" TAB_VERB 2 0 "NO" 1 "YES" DEFAULT_VALUE "UNKNOWN" /end COMPU_VTAB
/begin MEASUREMENT enov_slnk_5ms_oruns "Task 5ms - Overruns" UBYTE Compu_enov_slnk_5ms_oruns 0 0 0 255 ECU_ADDRESS 0x0100FED8 /end MEASUREMENT
/begin COMPU_METHOD Compu_enov_slnk_5ms_oruns " " RAT_FUNC "%.0" "-" COEFFS 0 1 0 0 0 1 /end COMPU_METHOD
/begin MEASUREMENT enov_slnk_5ms_inst "Task 5ms - Inst (ms)" UWORD Compu_enov_slnk_5ms_inst 0 0 0 209.712 ECU_ADDRESS 0x0100FEE0 /end MEASUREMENT
/begin COMPU_METHOD Compu_enov_slnk_5ms_inst " " RAT_FUNC "%.3" "ms" COEFFS 0 312.5 0 0 0 1 /end COMPU_METHOD
/begin MEASUREMENT enov_slnk_5ms_max "Task 5ms - Max (ms)" UWORD Compu_enov_slnk_5ms_max 0 0 0 209.712 ECU_ADDRESS 0x0100FEE8 /end MEASUREMENT
/begin COMPU_METHOD Compu_enov_slnk_5ms_max " " RAT_FUNC "%.3" "ms" COEFFS 0 312.5 0 0 0 1 /end COMPU_METHOD
/begin MEASUREMENT enov_slnk_50ms_live "Task 50ms - Live{enov_slnk_50ms_live&0xff=0:NO}{enov_slnk_50ms_live&0xff=1:YES}" UBYTE enov_slnk_50ms_live_COMPU_VTAB 0 0 0 255 ECU_ADDRESS 0x0100FEF8 BIT_MASK 0xff /end MEASUREMENT
/begin COMPU_METHOD enov_slnk_50ms_live_COMPU_VTAB "Verbal Table" TAB_VERB "%.0" "list" COMPU_TAB_REF enov_slnk_50ms_live_COMPU_VTAB_REF /end COMPU_METHOD
/begin COMPU_VTAB enov_slnk_50ms_live_COMPU_VTAB_REF "Verbal Table" TAB_VERB 2 0 "NO" 1 "YES" DEFAULT_VALUE "UNKNOWN" /end COMPU_VTAB
/begin MEASUREMENT enov_slnk_50ms_oruns "Task 50ms - Overruns" UBYTE Compu_enov_slnk_50ms_oruns 0 0 0 255 ECU_ADDRESS 0x0100FF00 /end MEASUREMENT
/begin COMPU_METHOD Compu_enov_slnk_50ms_oruns " " RAT_FUNC "%.0" "-" COEFFS 0 1 0 0 0 1 /end COMPU_METHOD
/begin MEASUREMENT enov_slnk_50ms_inst "Task 50ms - Inst (ms)" UWORD Compu_enov_slnk_50ms_inst 0 0 0 209.712 ECU_ADDRESS 0x0100FF08 /end MEASUREMENT
/begin COMPU_METHOD Compu_enov_slnk_50ms_inst " " RAT_FUNC "%.3" "ms" COEFFS 0 312.5 0 0 0 1 /end COMPU_METHOD
/begin MEASUREMENT enov_slnk_50ms_max "Task 50ms - Max (ms)" UWORD Compu_enov_slnk_50ms_max 0 0 0 209.712 ECU_ADDRESS 0x0100FF10 /end MEASUREMENT
/begin COMPU_METHOD Compu_enov_slnk_50ms_max " " RAT_FUNC "%.3" "ms" COEFFS 0 312.5 0 0 0 1 /end COMPU_METHOD
/begin MEASUREMENT enov_slnk_fsh_bytes "Flash consumption - Bytes" ULONG Compu_enov_slnk_fsh_bytes 0 0 0 4294967295 ECU_ADDRESS 0x0100FF18 /end MEASUREMENT
/begin COMPU_METHOD Compu_enov_slnk_fsh_bytes " " RAT_FUNC "%.0" "bytes" COEFFS 0 1 0 0 0 1 /end COMPU_METHOD
/begin MEASUREMENT enov_slnk_fsh_pct "Flash consumption - % Alloc" UWORD Compu_enov_slnk_fsh_pct 0 0 0 399.993896484375 ECU_ADDRESS 0x0100FF20 /end MEASUREMENT
/begin COMPU_METHOD Compu_enov_slnk_fsh_pct " " RAT_FUNC "%.1" "%" COEFFS 0 163.84 0 0 0 1 /end COMPU_METHOD
/begin MEASUREMENT enov_slnk_RAM_bytes "RAM consumption - Bytes" ULONG Compu_enov_slnk_RAM_bytes 0 0 0 4294967295 ECU_ADDRESS 0x0100FF28 /end MEASUREMENT
/begin COMPU_METHOD Compu_enov_slnk_RAM_bytes " " RAT_FUNC "%.0" "bytes" COEFFS 0 1 0 0 0 1 /end COMPU_METHOD
/begin MEASUREMENT enov_slnk_RAM_pct "RAM consumption - % Alloc" UWORD Compu_enov_slnk_RAM_pct 0 0 0 399.993896484375 ECU_ADDRESS 0x0100FF30 /end MEASUREMENT
/begin COMPU_METHOD Compu_enov_slnk_RAM_pct " " RAT_FUNC "%.1" "%" COEFFS 0 163.84 0 0 0 1 /end COMPU_METHOD
/begin MEASUREMENT FPP_allspeed_rpm "FPP allspeed rpm" UWORD Compu_FPP_allspeed_rpm 0 0 0 65535 ECU_ADDRESS 0x01010108 /end MEASUREMENT
/begin COMPU_METHOD Compu_FPP_allspeed_rpm " " RAT_FUNC "%.0" "rpm" COEFFS 0 1 0 0 0 1 /end COMPU_METHOD
/begin MEASUREMENT allspeed_rpm "Final allspeed rpm" UWORD Compu_allspeed_rpm 0 0 0 65535 ECU_ADDRESS 0x01010110 /end MEASUREMENT
/begin COMPU_METHOD Compu_allspeed_rpm " " RAT_FUNC "%.0" "rpm" COEFFS 0 1 0 0 0 1 /end COMPU_METHOD
/begin MEASUREMENT RS_max_allspeed_rpm "Roadspeed max allspeed rpm" UWORD Compu_RS_max_allspeed_rpm 0 0 0 65535 ECU_ADDRESS 0x01010118 /end MEASUREMENT
/begin COMPU_METHOD Compu_RS_max_allspeed_rpm " " RAT_FUNC "%.0" "rpm" COEFFS 0 1 0 0 0 1 /end COMPU_METHOD
/begin CHARACTERISTIC RS_max_allspeed_ena "Roadspeed RPM-based all-speed limit{RS_max_allspeed_ena&0xff=0:Disabled}{RS_max_allspeed_ena&0xff=1:Enabled}" VALUE 0x00147f10 /* @ECU_Address@RS_max_allspeed_ena@0x01010120@ */ ECIPP_ALIGNMENT_UBYTE 255 RS_max_allspeed_ena_COMPU_VTAB 0 255 BIT_MASK 0xff /end CHARACTERISTIC
/begin COMPU_METHOD RS_max_allspeed_ena_COMPU_VTAB "Verbal Table" TAB_VERB "%.0" "list" COMPU_TAB_REF RS_max_allspeed_ena_COMPU_VTAB_REF /end COMPU_METHOD
/begin COMPU_VTAB RS_max_allspeed_ena_COMPU_VTAB_REF "Verbal Table" TAB_VERB 2 0 "Disabled" 1 "Enabled" DEFAULT_VALUE "UNKNOWN" /end COMPU_VTAB
/begin MEASUREMENT RS_max_allspeed_use "Roadspeed max allspeed rpm in-use{RS_max_allspeed_use&0xff=0:Inactive}{RS_max_allspeed_use&0xff=1:Active}" UBYTE RS_max_allspeed_use_COMPU_VTAB 0 0 0 255 ECU_ADDRESS 0x01010128 BIT_MASK 0xff /end MEASUREMENT
/begin COMPU_METHOD RS_max_allspeed_use_COMPU_VTAB "Verbal Table" TAB_VERB "%.0" "list" COMPU_TAB_REF RS_max_allspeed_use_COMPU_VTAB_REF /end COMPU_METHOD
/begin COMPU_VTAB RS_max_allspeed_use_COMPU_VTAB_REF "Verbal Table" TAB_VERB 2 0 "Inactive" 1 "Active" DEFAULT_VALUE "UNKNOWN" /end COMPU_VTAB
/begin MEASUREMENT enov_slnk_1ms_allwd "Task 1ms - Allowed (ms)" UWORD Compu_enov_slnk_1ms_allwd 0 0 0 209.712 ECU_ADDRESS 0x01010270 /end MEASUREMENT
/begin COMPU_METHOD Compu_enov_slnk_1ms_allwd " " RAT_FUNC "%.3" "-" COEFFS 0 312.5 0 0 0 1 /end COMPU_METHOD
/begin MEASUREMENT enov_slnk_5ms_allwd "Task 5ms - Allowed (ms)" UWORD Compu_enov_slnk_5ms_allwd 0 0 0 209.712 ECU_ADDRESS 0x01010278 /end MEASUREMENT
/begin COMPU_METHOD Compu_enov_slnk_5ms_allwd " " RAT_FUNC "%.3" "-" COEFFS 0 312.5 0 0 0 1 /end COMPU_METHOD
/begin MEASUREMENT enov_slnk_50ms_allwd "Task 50ms - Allowed (ms)" UWORD Compu_enov_slnk_50ms_allwd 0 0 0 209.712 ECU_ADDRESS 0x01010280 /end MEASUREMENT
/begin COMPU_METHOD Compu_enov_slnk_50ms_allwd " " RAT_FUNC "%.3" "-" COEFFS 0 312.5 0 0 0 1 /end COMPU_METHOD
/begin MEASUREMENT enov_slnk_1ms_pct "Task 1ms - Max (%)" UWORD Compu_enov_slnk_1ms_pct 0 0 0 399.993896484375 ECU_ADDRESS 0x01010288 /end MEASUREMENT
/begin COMPU_METHOD Compu_enov_slnk_1ms_pct " " RAT_FUNC "%.1" "-" COEFFS 0 163.84 0 0 0 1 /end COMPU_METHOD
/begin MEASUREMENT enov_slnk_5ms_pct "Task 5ms - Max (%)" UWORD Compu_enov_slnk_5ms_pct 0 0 0 399.993896484375 ECU_ADDRESS 0x01010290 /end MEASUREMENT
/begin COMPU_METHOD Compu_enov_slnk_5ms_pct " " RAT_FUNC "%.1" "-" COEFFS 0 163.84 0 0 0 1 /end COMPU_METHOD
/begin MEASUREMENT enov_slnk_50ms_pct "Task 50ms - Max (%)" UWORD Compu_enov_slnk_50ms_pct 0 0 0 399.993896484375 ECU_ADDRESS 0x01010298 /end MEASUREMENT
/begin COMPU_METHOD Compu_enov_slnk_50ms_pct " " RAT_FUNC "%.1" "-" COEFFS 0 163.84 0 0 0 1 /end COMPU_METHOD
/begin MEASUREMENT enov_slnk_revision "Simulink interface revision" UWORD Compu_enov_slnk_revision 0 0 0 65535 ECU_ADDRESS 0x01010310 /end MEASUREMENT
/begin COMPU_METHOD Compu_enov_slnk_revision " " RAT_FUNC "%.0" "-" COEFFS 0 1 0 0 0 1 /end COMPU_METHOD
/begin CHARACTERISTIC slnk_nvm_reprog_clr "Clear NVM after reprogramming{slnk_nvm_reprog_clr&0xff=0:Disabled}{slnk_nvm_reprog_clr&0xff=1:Enabled}" VALUE 0x0016c331 /* @ECU_Address@slnk_nvm_reprog_clr@0x01010370@ */ ECIPP_ALIGNMENT_UBYTE 255 slnk_nvm_reprog_clr_COMPU_VTAB 0 255 BIT_MASK 0xff /end CHARACTERISTIC
/begin COMPU_METHOD slnk_nvm_reprog_clr_COMPU_VTAB "Verbal Table" TAB_VERB "%.0" "list" COMPU_TAB_REF slnk_nvm_reprog_clr_COMPU_VTAB_REF /end COMPU_METHOD
/begin COMPU_VTAB slnk_nvm_reprog_clr_COMPU_VTAB_REF "Verbal Table" TAB_VERB 2 0 "Disabled" 1 "Enabled" DEFAULT_VALUE "UNKNOWN" /end COMPU_VTAB
/begin CHARACTERISTIC slnk_nvm_wr_period "Persist NVM changes every" VALUE 0x00162ba0 /* @ECU_Address@slnk_nvm_wr_period@0x01010378@ */ ECIPP_ALIGNMENT_ULONG 4294967295 Compu_slnk_nvm_wr_period 0 4294967295 /end CHARACTERISTIC
/begin COMPU_METHOD Compu_slnk_nvm_wr_period " " RAT_FUNC "%.0" "ms" COEFFS 0 1 0 0 0 1 /end COMPU_METHOD
/begin CHARACTERISTIC RangeHst_mode1 "Range history mode 1{RangeHst_mode1&0xff=0:Disabled}{RangeHst_mode1&0xff=1:Event Counter}{RangeHst_mode1&0xff=2:Event Timer}" VALUE 0x00147F16 /* @ECU_Address@RangeHst_mode1@0x01010A08@ */ ECIPP_ALIGNMENT_UBYTE 255 RangeHst_mode1_COMPU_VTAB 0 255 BIT_MASK 0xff /end CHARACTERISTIC
/begin COMPU_METHOD RangeHst_mode1_COMPU_VTAB "Verbal Table" TAB_VERB "%.0" "list" COMPU_TAB_REF RangeHst_mode1_COMPU_VTAB_REF /end COMPU_METHOD
/begin COMPU_VTAB RangeHst_mode1_COMPU_VTAB_REF "Verbal Table" TAB_VERB 3 0 "Disabled" 1 "Event Counter" 2 "Event Timer" DEFAULT_VALUE "UNKNOWN" /end COMPU_VTAB
/begin CHARACTERISTIC RangeHst_mode2 "Range history mode 2{RangeHst_mode2&0xff=0:Disabled}{RangeHst_mode2&0xff=1:Event Counter}{RangeHst_mode2&0xff=2:Event Timer}" VALUE 0x00147F17 /* @ECU_Address@RangeHst_mode2@0x01010A10@ */ ECIPP_ALIGNMENT_UBYTE 255 RangeHst_mode2_COMPU_VTAB 0 255 BIT_MASK 0xff /end CHARACTERISTIC
/begin COMPU_METHOD RangeHst_mode2_COMPU_VTAB "Verbal Table" TAB_VERB "%.0" "list" COMPU_TAB_REF RangeHst_mode2_COMPU_VTAB_REF /end COMPU_METHOD
/begin COMPU_VTAB RangeHst_mode2_COMPU_VTAB_REF "Verbal Table" TAB_VERB 3 0 "Disabled" 1 "Event Counter" 2 "Event Timer" DEFAULT_VALUE "UNKNOWN" /end COMPU_VTAB
/begin CHARACTERISTIC RangeHst_mode3 "Range history mode 3{RangeHst_mode3&0xff=0:Disabled}{RangeHst_mode3&0xff=1:Event Counter}{RangeHst_mode3&0xff=2:Event Timer}" VALUE 0x00147F18 /* @ECU_Address@RangeHst_mode3@0x01010A18@ */ ECIPP_ALIGNMENT_UBYTE 255 RangeHst_mode3_COMPU_VTAB 0 255 BIT_MASK 0xff /end CHARACTERISTIC
/begin COMPU_METHOD RangeHst_mode3_COMPU_VTAB "Verbal Table" TAB_VERB "%.0" "list" COMPU_TAB_REF RangeHst_mode3_COMPU_VTAB_REF /end COMPU_METHOD
/begin COMPU_VTAB RangeHst_mode3_COMPU_VTAB_REF "Verbal Table" TAB_VERB 3 0 "Disabled" 1 "Event Counter" 2 "Event Timer" DEFAULT_VALUE "UNKNOWN" /end COMPU_VTAB
/begin CHARACTERISTIC RangeHst_mode4 "Range history mode 4{RangeHst_mode4&0xff=0:Disabled}{RangeHst_mode4&0xff=1:Event Counter}{RangeHst_mode4&0xff=2:Event Timer}" VALUE 0x00147F19 /* @ECU_Address@RangeHst_mode4@0x01010A20@ */ ECIPP_ALIGNMENT_UBYTE 255 RangeHst_mode4_COMPU_VTAB 0 255 BIT_MASK 0xff /end CHARACTERISTIC
/begin COMPU_METHOD RangeHst_mode4_COMPU_VTAB "Verbal Table" TAB_VERB "%.0" "list" COMPU_TAB_REF RangeHst_mode4_COMPU_VTAB_REF /end COMPU_METHOD
/begin COMPU_VTAB RangeHst_mode4_COMPU_VTAB_REF "Verbal Table" TAB_VERB 3 0 "Disabled" 1 "Event Counter" 2 "Event Timer" DEFAULT_VALUE "UNKNOWN" /end COMPU_VTAB
/begin CHARACTERISTIC RangeHst_mode5 "Range history mode 5{RangeHst_mode5&0xff=0:Disabled}{RangeHst_mode5&0xff=1:Event Counter}{RangeHst_mode5&0xff=2:Event Timer}" VALUE 0x00147F1A /* @ECU_Address@RangeHst_mode5@0x01010A28@ */ ECIPP_ALIGNMENT_UBYTE 255 RangeHst_mode5_COMPU_VTAB 0 255 BIT_MASK 0xff /end CHARACTERISTIC
/begin COMPU_METHOD RangeHst_mode5_COMPU_VTAB "Verbal Table" TAB_VERB "%.0" "list" COMPU_TAB_REF RangeHst_mode5_COMPU_VTAB_REF /end COMPU_METHOD
/begin COMPU_VTAB RangeHst_mode5_COMPU_VTAB_REF "Verbal Table" TAB_VERB 3 0 "Disabled" 1 "Event Counter" 2 "Event Timer" DEFAULT_VALUE "UNKNOWN" /end COMPU_VTAB
/begin CHARACTERISTIC RangeHst_mode6 "Range history mode 6{RangeHst_mode6&0xff=0:Disabled}{RangeHst_mode6&0xff=1:Event Counter}{RangeHst_mode6&0xff=2:Event Timer}" VALUE 0x00147F1B /* @ECU_Address@RangeHst_mode6@0x01010A30@ */ ECIPP_ALIGNMENT_UBYTE 255 RangeHst_mode6_COMPU_VTAB 0 255 BIT_MASK 0xff /end CHARACTERISTIC
/begin COMPU_METHOD RangeHst_mode6_COMPU_VTAB "Verbal Table" TAB_VERB "%.0" "list" COMPU_TAB_REF RangeHst_mode6_COMPU_VTAB_REF /end COMPU_METHOD
/begin COMPU_VTAB RangeHst_mode6_COMPU_VTAB_REF "Verbal Table" TAB_VERB 3 0 "Disabled" 1 "Event Counter" 2 "Event Timer" DEFAULT_VALUE "UNKNOWN" /end COMPU_VTAB
/begin CHARACTERISTIC RangeHst_mode7 "Range history mode 7{RangeHst_mode7&0xff=0:Disabled}{RangeHst_mode7&0xff=1:Event Counter}{RangeHst_mode7&0xff=2:Event Timer}" VALUE 0x00147F1C /* @ECU_Address@RangeHst_mode7@0x01010A38@ */ ECIPP_ALIGNMENT_UBYTE 255 RangeHst_mode7_COMPU_VTAB 0 255 BIT_MASK 0xff /end CHARACTERISTIC
/begin COMPU_METHOD RangeHst_mode7_COMPU_VTAB "Verbal Table" TAB_VERB "%.0" "list" COMPU_TAB_REF RangeHst_mode7_COMPU_VTAB_REF /end COMPU_METHOD
/begin COMPU_VTAB RangeHst_mode7_COMPU_VTAB_REF "Verbal Table" TAB_VERB 3 0 "Disabled" 1 "Event Counter" 2 "Event Timer" DEFAULT_VALUE "UNKNOWN" /end COMPU_VTAB
/begin CHARACTERISTIC RangeHst_mode8 "Range history mode 8{RangeHst_mode8&0xff=0:Disabled}{RangeHst_mode8&0xff=1:Event Counter}{RangeHst_mode8&0xff=2:Event Timer}" VALUE 0x00147F1D /* @ECU_Address@RangeHst_mode8@0x01010A40@ */ ECIPP_ALIGNMENT_UBYTE 255 RangeHst_mode8_COMPU_VTAB 0 255 BIT_MASK 0xff /end CHARACTERISTIC
/begin COMPU_METHOD RangeHst_mode8_COMPU_VTAB "Verbal Table" TAB_VERB "%.0" "list" COMPU_TAB_REF RangeHst_mode8_COMPU_VTAB_REF /end COMPU_METHOD
/begin COMPU_VTAB RangeHst_mode8_COMPU_VTAB_REF "Verbal Table" TAB_VERB 3 0 "Disabled" 1 "Event Counter" 2 "Event Timer" DEFAULT_VALUE "UNKNOWN" /end COMPU_VTAB
/begin CHARACTERISTIC RangeHst_mode9 "Range history mode 9{RangeHst_mode9&0xff=0:Disabled}{RangeHst_mode9&0xff=1:Event Counter}{RangeHst_mode9&0xff=2:Event Timer}" VALUE 0x00147F1E /* @ECU_Address@RangeHst_mode9@0x01010A48@ */ ECIPP_ALIGNMENT_UBYTE 255 RangeHst_mode9_COMPU_VTAB 0 255 BIT_MASK 0xff /end CHARACTERISTIC
/begin COMPU_METHOD RangeHst_mode9_COMPU_VTAB "Verbal Table" TAB_VERB "%.0" "list" COMPU_TAB_REF RangeHst_mode9_COMPU_VTAB_REF /end COMPU_METHOD
/begin COMPU_VTAB RangeHst_mode9_COMPU_VTAB_REF "Verbal Table" TAB_VERB 3 0 "Disabled" 1 "Event Counter" 2 "Event Timer" DEFAULT_VALUE "UNKNOWN" /end COMPU_VTAB
/begin CHARACTERISTIC RangeHst_mode10 "Range history mode 10{RangeHst_mode10&0xff=0:Disabled}{RangeHst_mode10&0xff=1:Event Counter}{RangeHst_mode10&0xff=2:Event Timer}" VALUE 0x00147F1F /* @ECU_Address@RangeHst_mode10@0x01010A50@ */ ECIPP_ALIGNMENT_UBYTE 255 RangeHst_mode10_COMPU_VTAB 0 255 BIT_MASK 0xff /end CHARACTERISTIC
/begin COMPU_METHOD RangeHst_mode10_COMPU_VTAB "Verbal Table" TAB_VERB "%.0" "list" COMPU_TAB_REF RangeHst_mode10_COMPU_VTAB_REF /end COMPU_METHOD
/begin COMPU_VTAB RangeHst_mode10_COMPU_VTAB_REF "Verbal Table" TAB_VERB 3 0 "Disabled" 1 "Event Counter" 2 "Event Timer" DEFAULT_VALUE "UNKNOWN" /end COMPU_VTAB
/begin CHARACTERISTIC RangeHst_mode11 "Range history mode 11{RangeHst_mode11&0xff=0:Disabled}{RangeHst_mode11&0xff=1:Event Counter}{RangeHst_mode11&0xff=2:Event Timer}" VALUE 0x00147F20 /* @ECU_Address@RangeHst_mode11@0x01010A58@ */ ECIPP_ALIGNMENT_UBYTE 255 RangeHst_mode11_COMPU_VTAB 0 255 BIT_MASK 0xff /end CHARACTERISTIC
/begin COMPU_METHOD RangeHst_mode11_COMPU_VTAB "Verbal Table" TAB_VERB "%.0" "list" COMPU_TAB_REF RangeHst_mode11_COMPU_VTAB_REF /end COMPU_METHOD
/begin COMPU_VTAB RangeHst_mode11_COMPU_VTAB_REF "Verbal Table" TAB_VERB 3 0 "Disabled" 1 "Event Counter" 2 "Event Timer" DEFAULT_VALUE "UNKNOWN" /end COMPU_VTAB
/begin CHARACTERISTIC RangeHst_mode12 "Range history mode 12{RangeHst_mode12&0xff=0:Disabled}{RangeHst_mode12&0xff=1:Event Counter}{RangeHst_mode12&0xff=2:Event Timer}" VALUE 0x00147F21 /* @ECU_Address@RangeHst_mode12@0x01010A60@ */ ECIPP_ALIGNMENT_UBYTE 255 RangeHst_mode12_COMPU_VTAB 0 255 BIT_MASK 0xff /end CHARACTERISTIC
/begin COMPU_METHOD RangeHst_mode12_COMPU_VTAB "Verbal Table" TAB_VERB "%.0" "list" COMPU_TAB_REF RangeHst_mode12_COMPU_VTAB_REF /end COMPU_METHOD
/begin COMPU_VTAB RangeHst_mode12_COMPU_VTAB_REF "Verbal Table" TAB_VERB 3 0 "Disabled" 1 "Event Counter" 2 "Event Timer" DEFAULT_VALUE "UNKNOWN" /end COMPU_VTAB
/begin CHARACTERISTIC RangeHst_mode13 "Range history mode 13{RangeHst_mode13&0xff=0:Disabled}{RangeHst_mode13&0xff=1:Event Counter}{RangeHst_mode13&0xff=2:Event Timer}" VALUE 0x00147F22 /* @ECU_Address@RangeHst_mode13@0x01010A68@ */ ECIPP_ALIGNMENT_UBYTE 255 RangeHst_mode13_COMPU_VTAB 0 255 BIT_MASK 0xff /end CHARACTERISTIC
/begin COMPU_METHOD RangeHst_mode13_COMPU_VTAB "Verbal Table" TAB_VERB "%.0" "list" COMPU_TAB_REF RangeHst_mode13_COMPU_VTAB_REF /end COMPU_METHOD
/begin COMPU_VTAB RangeHst_mode13_COMPU_VTAB_REF "Verbal Table" TAB_VERB 3 0 "Disabled" 1 "Event Counter" 2 "Event Timer" DEFAULT_VALUE "UNKNOWN" /end COMPU_VTAB
/begin CHARACTERISTIC RangeHst_mode14 "Range history mode 14{RangeHst_mode14&0xff=0:Disabled}{RangeHst_mode14&0xff=1:Event Counter}{RangeHst_mode14&0xff=2:Event Timer}" VALUE 0x00147F23 /* @ECU_Address@RangeHst_mode14@0x01010A70@ */ ECIPP_ALIGNMENT_UBYTE 255 RangeHst_mode14_COMPU_VTAB 0 255 BIT_MASK 0xff /end CHARACTERISTIC
/begin COMPU_METHOD RangeHst_mode14_COMPU_VTAB "Verbal Table" TAB_VERB "%.0" "list" COMPU_TAB_REF RangeHst_mode14_COMPU_VTAB_REF /end COMPU_METHOD
/begin COMPU_VTAB RangeHst_mode14_COMPU_VTAB_REF "Verbal Table" TAB_VERB 3 0 "Disabled" 1 "Event Counter" 2 "Event Timer" DEFAULT_VALUE "UNKNOWN" /end COMPU_VTAB
/begin CHARACTERISTIC RangeHst_mode15 "Range history mode 15{RangeHst_mode15&0xff=0:Disabled}{RangeHst_mode15&0xff=1:Event Counter}{RangeHst_mode15&0xff=2:Event Timer}" VALUE 0x00147F24 /* @ECU_Address@RangeHst_mode15@0x01010A78@ */ ECIPP_ALIGNMENT_UBYTE 255 RangeHst_mode15_COMPU_VTAB 0 255 BIT_MASK 0xff /end CHARACTERISTIC
/begin COMPU_METHOD RangeHst_mode15_COMPU_VTAB "Verbal Table" TAB_VERB "%.0" "list" COMPU_TAB_REF RangeHst_mode15_COMPU_VTAB_REF /end COMPU_METHOD
/begin COMPU_VTAB RangeHst_mode15_COMPU_VTAB_REF "Verbal Table" TAB_VERB 3 0 "Disabled" 1 "Event Counter" 2 "Event Timer" DEFAULT_VALUE "UNKNOWN" /end COMPU_VTAB
/begin CHARACTERISTIC RangeHst_mode16 "Range history mode 16{RangeHst_mode16&0xff=0:Disabled}{RangeHst_mode16&0xff=1:Event Counter}{RangeHst_mode16&0xff=2:Event Timer}" VALUE 0x00147F25 /* @ECU_Address@RangeHst_mode16@0x01010A80@ */ ECIPP_ALIGNMENT_UBYTE 255 RangeHst_mode16_COMPU_VTAB 0 255 BIT_MASK 0xff /end CHARACTERISTIC
/begin COMPU_METHOD RangeHst_mode16_COMPU_VTAB "Verbal Table" TAB_VERB "%.0" "list" COMPU_TAB_REF RangeHst_mode16_COMPU_VTAB_REF /end COMPU_METHOD
/begin COMPU_VTAB RangeHst_mode16_COMPU_VTAB_REF "Verbal Table" TAB_VERB 3 0 "Disabled" 1 "Event Counter" 2 "Event Timer" DEFAULT_VALUE "UNKNOWN" /end COMPU_VTAB
/begin CHARACTERISTIC RangeHst_mode17 "Range history mode 17{RangeHst_mode17&0xff=0:Disabled}{RangeHst_mode17&0xff=1:Event Counter}{RangeHst_mode17&0xff=2:Event Timer}" VALUE 0x00147F26 /* @ECU_Address@RangeHst_mode17@0x01010A88@ */ ECIPP_ALIGNMENT_UBYTE 255 RangeHst_mode17_COMPU_VTAB 0 255 BIT_MASK 0xff /end CHARACTERISTIC
/begin COMPU_METHOD RangeHst_mode17_COMPU_VTAB "Verbal Table" TAB_VERB "%.0" "list" COMPU_TAB_REF RangeHst_mode17_COMPU_VTAB_REF /end COMPU_METHOD
/begin COMPU_VTAB RangeHst_mode17_COMPU_VTAB_REF "Verbal Table" TAB_VERB 3 0 "Disabled" 1 "Event Counter" 2 "Event Timer" DEFAULT_VALUE "UNKNOWN" /end COMPU_VTAB
/begin CHARACTERISTIC RangeHst_mode18 "Range history mode 18{RangeHst_mode18&0xff=0:Disabled}{RangeHst_mode18&0xff=1:Event Counter}{RangeHst_mode18&0xff=2:Event Timer}" VALUE 0x00147F27 /* @ECU_Address@RangeHst_mode18@0x01010A90@ */ ECIPP_ALIGNMENT_UBYTE 255 RangeHst_mode18_COMPU_VTAB 0 255 BIT_MASK 0xff /end CHARACTERISTIC
/begin COMPU_METHOD RangeHst_mode18_COMPU_VTAB "Verbal Table" TAB_VERB "%.0" "list" COMPU_TAB_REF RangeHst_mode18_COMPU_VTAB_REF /end COMPU_METHOD
/begin COMPU_VTAB RangeHst_mode18_COMPU_VTAB_REF "Verbal Table" TAB_VERB 3 0 "Disabled" 1 "Event Counter" 2 "Event Timer" DEFAULT_VALUE "UNKNOWN" /end COMPU_VTAB
/begin CHARACTERISTIC RangeHst_mode19 "Range history mode 19{RangeHst_mode19&0xff=0:Disabled}{RangeHst_mode19&0xff=1:Event Counter}{RangeHst_mode19&0xff=2:Event Timer}" VALUE 0x00147F28 /* @ECU_Address@RangeHst_mode19@0x01010A98@ */ ECIPP_ALIGNMENT_UBYTE 255 RangeHst_mode19_COMPU_VTAB 0 255 BIT_MASK 0xff /end CHARACTERISTIC
/begin COMPU_METHOD RangeHst_mode19_COMPU_VTAB "Verbal Table" TAB_VERB "%.0" "list" COMPU_TAB_REF RangeHst_mode19_COMPU_VTAB_REF /end COMPU_METHOD
/begin COMPU_VTAB RangeHst_mode19_COMPU_VTAB_REF "Verbal Table" TAB_VERB 3 0 "Disabled" 1 "Event Counter" 2 "Event Timer" DEFAULT_VALUE "UNKNOWN" /end COMPU_VTAB
/begin CHARACTERISTIC RangeHst_mode20 "Range history mode 20{RangeHst_mode20&0xff=0:Disabled}{RangeHst_mode20&0xff=1:Event Counter}{RangeHst_mode20&0xff=2:Event Timer}" VALUE 0x00147F29 /* @ECU_Address@RangeHst_mode20@0x01010AA0@ */ ECIPP_ALIGNMENT_UBYTE 255 RangeHst_mode20_COMPU_VTAB 0 255 BIT_MASK 0xff /end CHARACTERISTIC
/begin COMPU_METHOD RangeHst_mode20_COMPU_VTAB "Verbal Table" TAB_VERB "%.0" "list" COMPU_TAB_REF RangeHst_mode20_COMPU_VTAB_REF /end COMPU_METHOD
/begin COMPU_VTAB RangeHst_mode20_COMPU_VTAB_REF "Verbal Table" TAB_VERB 3 0 "Disabled" 1 "Event Counter" 2 "Event Timer" DEFAULT_VALUE "UNKNOWN" /end COMPU_VTAB
/begin CHARACTERISTIC RangeHst_cntr_upd "Event counter sample time{RangeHst_cntr_upd&0xff=0:50 ms}{RangeHst_cntr_upd&0xff=1:100 ms}{RangeHst_cntr_upd&0xff=2:250 ms}{RangeHst_cntr_upd&0xff=3:500 ms}{RangeHst_cntr_upd&0xff=4:1000 ms}{RangeHst_cntr_upd&0xff=5:5000 ms}" VALUE 0x00147f15 /* @ECU_Address@RangeHst_cntr_upd@0x01012028@ */ ECIPP_ALIGNMENT_UBYTE 255 RangeHst_cntr_upd_COMPU_VTAB 0 255 BIT_MASK 0xff /end CHARACTERISTIC
/begin COMPU_METHOD RangeHst_cntr_upd_COMPU_VTAB "Verbal Table" TAB_VERB "%.0" "list" COMPU_TAB_REF RangeHst_cntr_upd_COMPU_VTAB_REF /end COMPU_METHOD
/begin COMPU_VTAB RangeHst_cntr_upd_COMPU_VTAB_REF "Verbal Table" TAB_VERB 6 0 "50 ms" 1 "100 ms" 2 "250 ms" 3 "500 ms" 4 "1000 ms" 5 "5000 ms" DEFAULT_VALUE "UNKNOWN" /end COMPU_VTAB
/begin CHARACTERISTIC RS_TPS_bstld_crct "Roadspeed TPS control boost load adjustment{RS_TPS_bstld_crct&0xff=0:Disabled}{RS_TPS_bstld_crct&0xff=1:Enabled}" VALUE 0x00147f0a /* @ECU_Address@RS_TPS_bstld_crct@0x010124E8@ */ ECIPP_ALIGNMENT_UBYTE 255 RS_TPS_bstld_crct_COMPU_VTAB 0 255 BIT_MASK 0xff /end CHARACTERISTIC
/begin COMPU_METHOD RS_TPS_bstld_crct_COMPU_VTAB "Verbal Table" TAB_VERB "%.0" "list" COMPU_TAB_REF RS_TPS_bstld_crct_COMPU_VTAB_REF /end COMPU_METHOD
/begin COMPU_VTAB RS_TPS_bstld_crct_COMPU_VTAB_REF "Verbal Table" TAB_VERB 2 0 "Disabled" 1 "Enabled" DEFAULT_VALUE "UNKNOWN" /end COMPU_VTAB
/begin CHARACTERISTIC RSC_disable_2inputs "Cruise disabled by simultaneous input{RSC_disable_2inputs&0xff=0:Disabled}{RSC_disable_2inputs&0xff=1:Enabled}" VALUE 0x00147ef8 /* @ECU_Address@RSC_disable_2inputs@0x01012530@ */ ECIPP_ALIGNMENT_UBYTE 255 RSC_disable_2inputs_COMPU_VTAB 0 255 BIT_MASK 0xff /end CHARACTERISTIC
/begin COMPU_METHOD RSC_disable_2inputs_COMPU_VTAB "Verbal Table" TAB_VERB "%.0" "list" COMPU_TAB_REF RSC_disable_2inputs_COMPU_VTAB_REF /end COMPU_METHOD
/begin COMPU_VTAB RSC_disable_2inputs_COMPU_VTAB_REF "Verbal Table" TAB_VERB 2 0 "Disabled" 1 "Enabled" DEFAULT_VALUE "UNKNOWN" /end COMPU_VTAB
/begin CHARACTERISTIC RSC_disable_rpm "Cruise disengage engine speed limit" VALUE 0x00147702 /* @ECU_Address@RSC_disable_rpm@0x01012538@ */ ECIPP_ALIGNMENT_UWORD 65535 Compu_RSC_disable_rpm 0 65535 /end CHARACTERISTIC
/begin COMPU_METHOD Compu_RSC_disable_rpm " " RAT_FUNC "%.0" "rpm" COEFFS 0 1 0 0 0 1 /end COMPU_METHOD
/begin CHARACTERISTIC RSC_ramp_time_max "Cruise maximum ramp time" VALUE 0x0014770a /* @ECU_Address@RSC_ramp_time_max@0x01012540@ */ ECIPP_ALIGNMENT_UWORD 66 Compu_RSC_ramp_time_max 0 65.535 /end CHARACTERISTIC
/begin COMPU_METHOD Compu_RSC_ramp_time_max " " RAT_FUNC "%.1" "sec" COEFFS 0 1000 0 0 0 1 /end COMPU_METHOD
/begin CHARACTERISTIC RSC_error_pct "Cruise persistent error limit" VALUE 0x00147704 /* @ECU_Address@RSC_error_pct@0x01012548@ */ ECIPP_ALIGNMENT_UWORD 100 Compu_RSC_error_pct 0 99.9984741210938 /end CHARACTERISTIC
/begin COMPU_METHOD Compu_RSC_error_pct " " RAT_FUNC "%.1" "%" COEFFS 0 655.36 0 0 0 1 /end COMPU_METHOD
/begin CHARACTERISTIC RSC_error_wait "Cruise persistent error disengage time" VALUE 0x00144118 /* @ECU_Address@RSC_error_wait@0x01012550@ */ ECIPP_ALIGNMENT_ULONG 4294967 Compu_RSC_error_wait 0 4294967.295 /end CHARACTERISTIC
/begin COMPU_METHOD Compu_RSC_error_wait " " RAT_FUNC "%.1" "sec" COEFFS 0 1000 0 0 0 1 /end COMPU_METHOD
/begin CHARACTERISTIC RSC_CAN_set_sw "Cruise CAN set switch behavior{RSC_CAN_set_sw&0xff=0:Engage only}{RSC_CAN_set_sw&0xff=1:Engage + disengage}{RSC_CAN_set_sw&0xff=2:Disengage only}" VALUE 0x00147ef7 /* @ECU_Address@RSC_CAN_set_sw@0x01012778@ */ ECIPP_ALIGNMENT_UBYTE 255 RSC_CAN_set_sw_COMPU_VTAB 0 255 BIT_MASK 0xff /end CHARACTERISTIC
/begin COMPU_METHOD RSC_CAN_set_sw_COMPU_VTAB "Verbal Table" TAB_VERB "%.0" "list" COMPU_TAB_REF RSC_CAN_set_sw_COMPU_VTAB_REF /end COMPU_METHOD
/begin COMPU_VTAB RSC_CAN_set_sw_COMPU_VTAB_REF "Verbal Table" TAB_VERB 3 0 "Engage only" 1 "Engage + disengage" 2 "Disengage only" DEFAULT_VALUE "UNKNOWN" /end COMPU_VTAB
/begin CHARACTERISTIC RS_TPS_FPPlim_ena "Roadspeed TPS control FPP limiting{RS_TPS_FPPlim_ena&0xff=0:Disabled}{RS_TPS_FPPlim_ena&0xff=1:Enabled}" VALUE 0x00147f09 /* @ECU_Address@RS_TPS_FPPlim_ena@0x01012910@ */ ECIPP_ALIGNMENT_UBYTE 255 RS_TPS_FPPlim_ena_COMPU_VTAB 0 255 BIT_MASK 0xff /end CHARACTERISTIC
/begin COMPU_METHOD RS_TPS_FPPlim_ena_COMPU_VTAB "Verbal Table" TAB_VERB "%.0" "list" COMPU_TAB_REF RS_TPS_FPPlim_ena_COMPU_VTAB_REF /end COMPU_METHOD
/begin COMPU_VTAB RS_TPS_FPPlim_ena_COMPU_VTAB_REF "Verbal Table" TAB_VERB 2 0 "Disabled" 1 "Enabled" DEFAULT_VALUE "UNKNOWN" /end COMPU_VTAB
/begin CHARACTERISTIC reset_learn_reprog "Auto-learn after reprogramming{reset_learn_reprog&0xff=0:Disabled}{reset_learn_reprog&0xff=1:Enabled}" VALUE 0x001481b0 /* @ECU_Address@reset_learn_reprog@0x01012928@ */ ECIPP_ALIGNMENT_UBYTE 255 reset_learn_reprog_COMPU_VTAB 0 255 BIT_MASK 0xff /end CHARACTERISTIC
/begin COMPU_METHOD reset_learn_reprog_COMPU_VTAB "Verbal Table" TAB_VERB "%.0" "list" COMPU_TAB_REF reset_learn_reprog_COMPU_VTAB_REF /end COMPU_METHOD
/begin COMPU_VTAB reset_learn_reprog_COMPU_VTAB_REF "Verbal Table" TAB_VERB 2 0 "Disabled" 1 "Enabled" DEFAULT_VALUE "UNKNOWN" /end COMPU_VTAB
/begin MEASUREMENT reset_learn_active "Learn active timer" UWORD Compu_reset_learn_active 0 0 0 65.535 ECU_ADDRESS 0x01012938 /end MEASUREMENT
/begin COMPU_METHOD Compu_reset_learn_active " " RAT_FUNC "%.1" "sec" COEFFS 0 1000 0 0 0 1 /end COMPU_METHOD
/begin MEASUREMENT reset_learn_action "Manual learn action{reset_learn_action&0xff=0x00:None}{reset_learn_action&0xff=0x01:Learn TPS idle/full}{reset_learn_action&0xff=0x02:Learn EGR zero}{reset_learn_action&0xff=0x04:Learn pressure offsets}{reset_learn_action&0xff=0x07:Learn all}" UBYTE reset_learn_action_COMPU_VTAB 0 0 0 255 ECU_ADDRESS 0x01012940 BIT_MASK 0xff /end MEASUREMENT
/begin COMPU_METHOD reset_learn_action_COMPU_VTAB "Verbal Table" TAB_VERB "%.0" "list" COMPU_TAB_REF reset_learn_action_COMPU_VTAB_REF /end COMPU_METHOD
/begin COMPU_VTAB reset_learn_action_COMPU_VTAB_REF "Verbal Table" TAB_VERB 5 0x00 "None" 0x01 "Learn TPS idle/full" 0x02 "Learn EGR zero" 0x04 "Learn pressure offsets" 0x07 "Learn all" DEFAULT_VALUE "UNKNOWN" /end COMPU_VTAB
/begin MEASUREMENT reset_learn_state "Learn state{reset_learn_state&0xff=0:Idle}{reset_learn_state&0xff=1:Inactive: key-off clr disabled}{reset_learn_state&0xff=2:Inactive: conditions invalid}{reset_learn_state&0xff=3:Active: reprogramming learn}{reset_learn_state&0xff=4:Active: manual learn}" UBYTE reset_learn_state_COMPU_VTAB 0 0 0 255 ECU_ADDRESS 0x01012948 BIT_MASK 0xff /end MEASUREMENT
/begin COMPU_METHOD reset_learn_state_COMPU_VTAB "Verbal Table" TAB_VERB "%.0" "list" COMPU_TAB_REF reset_learn_state_COMPU_VTAB_REF /end COMPU_METHOD
/begin COMPU_VTAB reset_learn_state_COMPU_VTAB_REF "Verbal Table" TAB_VERB 7 0 "Idle" 1 "Inactive: key-off clr disabled" 2 "Inactive: conditions invalid" 3 "Active: reprogramming learn" 4 "Active: manual learn" 5 "Active: EGRdP offset learn" 6 "Learn complete" DEFAULT_VALUE "UNKNOWN" /end COMPU_VTAB
/begin CHARACTERISTIC RS_CAN_source "Roadspeed CAN signal source{RS_CAN_source&0xff=0:Most recent message}{RS_CAN_source&0xff=1:J1939 TCO1}{RS_CAN_source&0xff=2:J1939 CCVS1 or PGN 65473}" VALUE 0x00147f07 /* @ECU_Address@RS_CAN_source@0x01012CD8@ */ ECIPP_ALIGNMENT_UBYTE 255 RS_CAN_source_COMPU_VTAB 0 255 BIT_MASK 0xff /end CHARACTERISTIC
/begin COMPU_METHOD RS_CAN_source_COMPU_VTAB "Verbal Table" TAB_VERB "%.0" "list" COMPU_TAB_REF RS_CAN_source_COMPU_VTAB_REF /end COMPU_METHOD
/begin COMPU_VTAB RS_CAN_source_COMPU_VTAB_REF "Verbal Table" TAB_VERB 3 0 "Most recent message" 1 "J1939 TCO1" 2 "J1939 CCVS1 or PGN 65473" DEFAULT_VALUE "UNKNOWN" /end COMPU_VTAB
/begin CHARACTERISTIC SRVC_fixed_int_km_L1 "Service fixed interval (kms) - level 1" VALUE 0x001477be /* @ECU_Address@SRVC_fixed_int_km_L1@0x010131E8@ */ ECIPP_ALIGNMENT_UWORD 327675 Compu_SRVC_fixed_int_km_L1 0 327675 /end CHARACTERISTIC
/begin COMPU_METHOD Compu_SRVC_fixed_int_km_L1 " " RAT_FUNC "%.0" "km" COEFFS 0 0.2 0 0 0 1 /end COMPU_METHOD
/begin CHARACTERISTIC SRVC_fixed_int_km_L2 "Service fixed interval (kms) - level 2" VALUE 0x001477c0 /* @ECU_Address@SRVC_fixed_int_km_L2@0x010131F0@ */ ECIPP_ALIGNMENT_UWORD 327675 Compu_SRVC_fixed_int_km_L2 0 327675 /end CHARACTERISTIC
/begin COMPU_METHOD Compu_SRVC_fixed_int_km_L2 " " RAT_FUNC "%.0" "km" COEFFS 0 0.2 0 0 0 1 /end COMPU_METHOD
/begin MEASUREMENT SRVC_km_rem "Service distance remaining" SLONG Compu_SRVC_km_rem 0 0 -268435456 268435455.875 ECU_ADDRESS 0x010131F8 /end MEASUREMENT
/begin COMPU_METHOD Compu_SRVC_km_rem " " RAT_FUNC "%.1" "km" COEFFS 0 8 0 0 0 1 /end COMPU_METHOD
/begin CHARACTERISTIC RS_max_load_inc_slew "Max load inc slew rate after RS loss" VALUE 0x00147730 /* @ECU_Address@RS_max_load_inc_slew@0x010137B8@ */ ECIPP_ALIGNMENT_UWORD 20000 Compu_RS_max_load_inc_slew 0 19999.6948242188 /end CHARACTERISTIC
/begin COMPU_METHOD Compu_RS_max_load_inc_slew " " RAT_FUNC "%.1" "%/sec" COEFFS 0 3.2768 0 0 0 1 /end COMPU_METHOD
/begin CHARACTERISTIC IBF_mode "Intake backfire detection mode{IBF_mode&0xff=0:Disabled}{IBF_mode&0xff=1:IATdt}{IBF_mode&0xff=2:MAP}" VALUE 0x00147db4 /* @ECU_Address@IBF_mode@0x01013A78@ */ ECIPP_ALIGNMENT_UBYTE 255 IBF_mode_COMPU_VTAB 0 255 BIT_MASK 0xff /end CHARACTERISTIC
/begin COMPU_METHOD IBF_mode_COMPU_VTAB "Verbal Table" TAB_VERB "%.0" "list" COMPU_TAB_REF IBF_mode_COMPU_VTAB_REF /end COMPU_METHOD
/begin COMPU_VTAB IBF_mode_COMPU_VTAB_REF "Verbal Table" TAB_VERB 3 0 "Disabled" 1 "IATdt" 2 "MAP" DEFAULT_VALUE "UNKNOWN" /end COMPU_VTAB
/begin MEASUREMENT IATdt "IATdt" SWORD Compu_IATdt 0 0 -256 255.9921875 ECU_ADDRESS 0x01013A80 /end MEASUREMENT
/begin COMPU_METHOD Compu_IATdt " " RAT_FUNC "%.1" "deg F/sec" COEFFS 0 128 0 0 0 1 /end COMPU_METHOD
/begin MEASUREMENT IATdt_key_cyc_max "IATdt max (key cycle)" SWORD Compu_IATdt_key_cyc_max 0 0 -256 255.9921875 ECU_ADDRESS 0x01013A88 /end MEASUREMENT
/begin COMPU_METHOD Compu_IATdt_key_cyc_max " " RAT_FUNC "%.1" "deg F/sec" COEFFS 0 128 0 0 0 1 /end COMPU_METHOD
/begin CHARACTERISTIC IBF_IATdt_lim "Intake backfire IATdt limit" VALUE 0x00144318 /* @ECU_Address@IBF_IATdt_lim@0x01013A90@ */ ECIPP_ALIGNMENT_SWORD 256 Compu_IBF_IATdt_lim -256 255.9921875 /end CHARACTERISTIC
/begin COMPU_METHOD Compu_IBF_IATdt_lim " " RAT_FUNC "%.1" "deg F/sec" COEFFS 0 128 0 0 0 1 /end COMPU_METHOD
/begin CHARACTERISTIC IBF_MAP_lim "Intake backfire MAP limit" VALUE 0x0014747c /* @ECU_Address@IBF_MAP_lim@0x01013A98@ */ ECIPP_ALIGNMENT_UWORD 256 Compu_IBF_MAP_lim 0 255.99609375 /end CHARACTERISTIC
/begin COMPU_METHOD Compu_IBF_MAP_lim " " RAT_FUNC "%.1" "psia" COEFFS 0 256 0 0 0 1 /end COMPU_METHOD
/begin CHARACTERISTIC IBF_latch_tm "Intake backfire latch time" VALUE 0x0014747e /* @ECU_Address@IBF_latch_tm@0x01013AA0@ */ ECIPP_ALIGNMENT_UWORD 65535 Compu_IBF_latch_tm 0 65535 /end CHARACTERISTIC
/begin COMPU_METHOD Compu_IBF_latch_tm " " RAT_FUNC "%.0" "ms" COEFFS 0 1 0 0 0 1 /end COMPU_METHOD
/begin CHARACTERISTIC IBF_unlatch_tm "Intake backfire unlatch time" VALUE 0x00147480 /* @ECU_Address@IBF_unlatch_tm@0x01013AA8@ */ ECIPP_ALIGNMENT_UWORD 65535 Compu_IBF_unlatch_tm 0 65535 /end CHARACTERISTIC
/begin COMPU_METHOD Compu_IBF_unlatch_tm " " RAT_FUNC "%.0" "ms" COEFFS 0 1 0 0 0 1 /end COMPU_METHOD
/begin MEASUREMENT IBF_action_request "Intake backfire action request{IBF_action_request&0xff=0:Press to select action...}{IBF_action_request&0xff=1:Reset Recent Histograms}" UBYTE IBF_action_request_COMPU_VTAB 0 0 0 255 ECU_ADDRESS 0x01013AB0 BIT_MASK 0xff /end MEASUREMENT
/begin COMPU_METHOD IBF_action_request_COMPU_VTAB "Verbal Table" TAB_VERB "%.0" "list" COMPU_TAB_REF IBF_action_request_COMPU_VTAB_REF /end COMPU_METHOD
/begin COMPU_VTAB IBF_action_request_COMPU_VTAB_REF "Verbal Table" TAB_VERB 2 0 "Press to select action..." 1 "Reset Recent Histograms" DEFAULT_VALUE "UNKNOWN" /end COMPU_VTAB
/begin MEASUREMENT HstIBF_total "Total intake backfires (recent)" UWORD Compu_HstIBF_total 0 0 0 65535 ECU_ADDRESS 0x01013AB8 /end MEASUREMENT
/begin COMPU_METHOD Compu_HstIBF_total " " RAT_FUNC "%.0" "occurrences" COEFFS 0 1 0 0 0 1 /end COMPU_METHOD
/begin MEASUREMENT HstIBF_LT_total "Total intake backfires (lifetime)" UWORD Compu_HstIBF_LT_total 0 0 0 65535 ECU_ADDRESS 0x01013AC0 /end MEASUREMENT
/begin COMPU_METHOD Compu_HstIBF_LT_total " " RAT_FUNC "%.0" "occurrences" COEFFS 0 1 0 0 0 1 /end COMPU_METHOD
/begin MEASUREMENT HstIBF_time "Cumulative time since reset" ULONG Compu_HstIBF_time 0 0 0 1193046.47083333 ECU_ADDRESS 0x01013AC8 /end MEASUREMENT
/begin COMPU_METHOD Compu_HstIBF_time " " RAT_FUNC "%.3" "hours" COEFFS 0 3600 0 0 0 1 /end COMPU_METHOD
/begin CHARACTERISTIC Tspka_base_CAD "Gasoline Base Spark Advance" MAP 0x00142EDC /* @ECU_Address@Tspka_base_CAD@0x02011000@ */ ECIPP_ALIGNMENT_SWORD 2048 Compu_Tspka_base_CAD -2048 2047.9375
 /begin AXIS_DESCR COM_AXIS NO_INPUT_QUANTITY Compu_Tspka_base_MAP 16 -128 127.99609375 AXIS_PTS_REF Tspka_base_MAP /end AXIS_DESCR
 /begin AXIS_DESCR COM_AXIS NO_INPUT_QUANTITY Compu_Tspka_base_rpm 16 -32768 32767 AXIS_PTS_REF Tspka_base_rpm /end AXIS_DESCR
/end CHARACTERISTIC
/begin AXIS_PTS Tspka_base_MAP " " 0x001430DC /* @ECU_Address@Tspka_base_MAP@0x02012000@ */ NO_INPUT_QUANTITY ECIPP_Lookup_SWORD 0 Compu_Tspka_base_MAP 16 -128 127.99609375 /end AXIS_PTS
/begin AXIS_PTS Tspka_base_rpm " " 0x001430FC /* @ECU_Address@Tspka_base_rpm@0x02013000@ */ NO_INPUT_QUANTITY ECIPP_Lookup_SWORD 0 Compu_Tspka_base_rpm 16 -32768 32767 /end AXIS_PTS
/begin COMPU_METHOD Compu_Tspka_base_CAD "" RAT_FUNC "%.1" "CAD BTDC" COEFFS 0 16 0 0 0 1 /end COMPU_METHOD
/begin COMPU_METHOD Compu_Tspka_base_MAP " " RAT_FUNC "%.1" "MAP load (psia)" COEFFS 0 256 0 0 0 1 /end COMPU_METHOD
/begin COMPU_METHOD Compu_Tspka_base_rpm " " RAT_FUNC "%.0" "Speed (rpm)" COEFFS 0 1 0 0 0 1 /end COMPU_METHOD
/begin CHARACTERISTIC Tspka_baseP_CAD "LPG Base Spark Advance" MAP 0x001413EA /* @ECU_Address@Tspka_baseP_CAD@0x02052000@ */ ECIPP_ALIGNMENT_SWORD 2048 Compu_Tspka_baseP_CAD -2048 2047.9375
 /begin AXIS_DESCR COM_AXIS NO_INPUT_QUANTITY Compu_Tspka_baseP_MAP 16 -128 127.99609375 AXIS_PTS_REF Tspka_baseP_MAP /end AXIS_DESCR
 /begin AXIS_DESCR COM_AXIS NO_INPUT_QUANTITY Compu_Tspka_baseP_rpm 16 -32768 32767 AXIS_PTS_REF Tspka_baseP_rpm /end AXIS_DESCR
/end CHARACTERISTIC
/begin AXIS_PTS Tspka_baseP_MAP " " 0x001415EA /* @ECU_Address@Tspka_baseP_MAP@0x02053000@ */ NO_INPUT_QUANTITY ECIPP_Lookup_SWORD 0 Compu_Tspka_baseP_MAP 16 -128 127.99609375 /end AXIS_PTS
/begin AXIS_PTS Tspka_baseP_rpm " " 0x0014160A /* @ECU_Address@Tspka_baseP_rpm@0x02054000@ */ NO_INPUT_QUANTITY ECIPP_Lookup_SWORD 0 Compu_Tspka_baseP_rpm 16 -32768 32767 /end AXIS_PTS
/begin COMPU_METHOD Compu_Tspka_baseP_CAD "" RAT_FUNC "%.1" "CAD BTDC" COEFFS 0 16 0 0 0 1 /end COMPU_METHOD
/begin COMPU_METHOD Compu_Tspka_baseP_MAP " " RAT_FUNC "%.1" "MAP load (psia)" COEFFS 0 256 0 0 0 1 /end COMPU_METHOD
/begin COMPU_METHOD Compu_Tspka_baseP_rpm " " RAT_FUNC "%.0" "Speed (rpm)" COEFFS 0 1 0 0 0 1 /end COMPU_METHOD
/begin COMPU_METHOD Compu_Tspko_ECTvLP_ECT " " RAT_FUNC "%.0" "CHT (deg F)" COEFFS 0 32 14720 0 0 1 /end COMPU_METHOD
/begin COMPU_METHOD Compu_Tspko_ECTvLP_MAP " " RAT_FUNC "%.1" "MAP load (psia)" COEFFS 0 256 0 0 0 1 /end COMPU_METHOD
/begin CHARACTERISTIC Tspko_ECTvLP_CAD "LPG CHT Spark Offset" MAP 0x0014162A /* @ECU_Address@Tspko_ECTvLP_CAD@0x02057000@ */ ECIPP_ALIGNMENT_SWORD 2048 Compu_Tspko_ECTvLP_CAD -2048 2047.9375
 /begin AXIS_DESCR COM_AXIS NO_INPUT_QUANTITY Compu_Tspko_ECTvLP_MAP 8 -128 127.99609375 AXIS_PTS_REF Tspko_ECTvLP_MAP /end AXIS_DESCR
 /begin AXIS_DESCR COM_AXIS NO_INPUT_QUANTITY Compu_Tspko_ECTvLP_ECT 16 -1484 563.96875 AXIS_PTS_REF Tspko_ECTvLP_ECT /end AXIS_DESCR
/end CHARACTERISTIC
/begin AXIS_PTS Tspko_ECTvLP_MAP " " 0x0014174A /* @ECU_Address@Tspko_ECTvLP_MAP@0x02056000@ */ NO_INPUT_QUANTITY ECIPP_Lookup_SWORD 0 Compu_Tspko_ECTvLP_MAP 8 -128 127.99609375 /end AXIS_PTS
/begin AXIS_PTS Tspko_ECTvLP_ECT " " 0x0014172A /* @ECU_Address@Tspko_ECTvLP_ECT@0x02055000@ */ NO_INPUT_QUANTITY ECIPP_Lookup_SWORD 0 Compu_Tspko_ECTvLP_ECT 16 -1484 563.96875 /end AXIS_PTS
/begin COMPU_METHOD Compu_Tspko_ECTvLP_CAD "" RAT_FUNC "%.1" "CAD" COEFFS 0 16 0 0 0 1 /end COMPU_METHOD
/begin COMPU_METHOD Compu_Tspko_MATvLP_MAT " " RAT_FUNC "%.0" "MAT (deg F)" COEFFS 0 32 14720 0 0 1 /end COMPU_METHOD
/begin COMPU_METHOD Compu_Tspko_MATvLP_MAP " " RAT_FUNC "%.1" "MAP load (psia)" COEFFS 0 256 0 0 0 1 /end COMPU_METHOD
/begin CHARACTERISTIC Tspko_MATvLP_CAD "LPG MAT Spark Offset" MAP 0x0014175A /* @ECU_Address@Tspko_MATvLP_CAD@0x0205A000@ */ ECIPP_ALIGNMENT_SWORD 2048 Compu_Tspko_MATvLP_CAD -2048 2047.9375
 /begin AXIS_DESCR COM_AXIS NO_INPUT_QUANTITY Compu_Tspko_MATvLP_MAP 8 -128 127.99609375 AXIS_PTS_REF Tspko_MATvLP_MAP /end AXIS_DESCR
 /begin AXIS_DESCR COM_AXIS NO_INPUT_QUANTITY Compu_Tspko_MATvLP_MAT 16 -1484 563.96875 AXIS_PTS_REF Tspko_MATvLP_MAT /end AXIS_DESCR
/end CHARACTERISTIC
/begin AXIS_PTS Tspko_MATvLP_MAP " " 0x0014185A /* @ECU_Address@Tspko_MATvLP_MAP@0x02059000@ */ NO_INPUT_QUANTITY ECIPP_Lookup_SWORD 0 Compu_Tspko_MATvLP_MAP 8 -128 127.99609375 /end AXIS_PTS
/begin AXIS_PTS Tspko_MATvLP_MAT " " 0x0014186A /* @ECU_Address@Tspko_MATvLP_MAT@0x02058000@ */ NO_INPUT_QUANTITY ECIPP_Lookup_SWORD 0 Compu_Tspko_MATvLP_MAT 16 -1484 563.96875 /end AXIS_PTS
/begin COMPU_METHOD Compu_Tspko_MATvLP_CAD "" RAT_FUNC "%.1" "CAD" COEFFS 0 16 0 0 0 1 /end COMPU_METHOD
/begin COMPU_METHOD Compu_TRSovsc_RS " " RAT_FUNC "%.1" "Speed (kph)" COEFFS 0 128 0 0 0 1 /end COMPU_METHOD
/begin CHARACTERISTIC TRSovsc_Kiv "Roadspeed overshoot control Kiv" CURVE 0x0014920A /* @ECU_Address@TRSovsc_Kiv@0x02137000@ */ ECIPP_ALIGNMENT_SWORD 800 Compu_TRSovsc_Kiv -800 799.9755859375
 /begin AXIS_DESCR COM_AXIS NO_INPUT_QUANTITY Compu_TRSovsc_RS 4 -256 255.9921875 AXIS_PTS_REF TRSovsc_RS /end AXIS_DESCR
/end CHARACTERISTIC
/begin AXIS_PTS TRSovsc_RS " " 0x00149202 /* @ECU_Address@TRSovsc_RS@0x02136000@ */ NO_INPUT_QUANTITY ECIPP_Lookup_SWORD 0 Compu_TRSovsc_RS 4 -256 255.9921875 /end AXIS_PTS
/begin COMPU_METHOD Compu_TRSovsc_Kiv " " RAT_FUNC "%.1" "Kiv (%/kph)" COEFFS 0 40.96 0 0 0 1 /end COMPU_METHOD
/begin CHARACTERISTIC TRSovsc_dIlim "Roadspeed overshoot control dIlim" CURVE 0x00149212 /* @ECU_Address@TRSovsc_dIlim@0x02138000@ */ ECIPP_ALIGNMENT_SWORD 625 Compu_TRSovsc_dIlim -625 624.980926513672
 /begin AXIS_DESCR COM_AXIS NO_INPUT_QUANTITY Compu_TRSovsc_RS 4 -256 255.9921875 AXIS_PTS_REF TRSovsc_RS /end AXIS_DESCR
/end CHARACTERISTIC
/begin COMPU_METHOD Compu_TRSovsc_dIlim " " RAT_FUNC "%.1" "Rate Limit (%/sec)" COEFFS 0 52.4288 0 0 0 1 /end COMPU_METHOD
/begin COMPU_METHOD Compu_TRS2ovsc_RS " " RAT_FUNC "%.1" "Speed (kph)" COEFFS 0 128 0 0 0 1 /end COMPU_METHOD
/begin CHARACTERISTIC TRS2ovsc_Kiv "Roadspeed2 overshoot control Kiv" CURVE 0x00149256 /* @ECU_Address@TRS2ovsc_Kiv@0x02180000@ */ ECIPP_ALIGNMENT_SWORD 800 Compu_TRS2ovsc_Kiv -800 799.9755859375
 /begin AXIS_DESCR COM_AXIS NO_INPUT_QUANTITY Compu_TRS2ovsc_RS 4 -256 255.9921875 AXIS_PTS_REF TRS2ovsc_RS /end AXIS_DESCR
/end CHARACTERISTIC
/begin AXIS_PTS TRS2ovsc_RS " " 0x0014924E /* @ECU_Address@TRS2ovsc_RS@0x0217F000@ */ NO_INPUT_QUANTITY ECIPP_Lookup_SWORD 0 Compu_TRS2ovsc_RS 4 -256 255.9921875 /end AXIS_PTS
/begin COMPU_METHOD Compu_TRS2ovsc_Kiv " " RAT_FUNC "%.1" "Kiv (%/kph)" COEFFS 0 40.96 0 0 0 1 /end COMPU_METHOD
/begin CHARACTERISTIC TRS2ovsc_dIlim "Roadspeed2 overshoot control dIlim" CURVE 0x0014925E /* @ECU_Address@TRS2ovsc_dIlim@0x02181000@ */ ECIPP_ALIGNMENT_SWORD 625 Compu_TRS2ovsc_dIlim -625 624.980926513672
 /begin AXIS_DESCR COM_AXIS NO_INPUT_QUANTITY Compu_TRS2ovsc_RS 4 -256 255.9921875 AXIS_PTS_REF TRS2ovsc_RS /end AXIS_DESCR
/end CHARACTERISTIC
/begin COMPU_METHOD Compu_TRS2ovsc_dIlim " " RAT_FUNC "%.1" "Rate Limit (%/sec)" COEFFS 0 52.4288 0 0 0 1 /end COMPU_METHOD
/begin COMPU_METHOD Compu_TRS3ovsc_RS " " RAT_FUNC "%.1" "Speed (kph)" COEFFS 0 128 0 0 0 1 /end COMPU_METHOD
/begin CHARACTERISTIC TRS3ovsc_Kiv "Roadspeed3 overshoot control Kiv" CURVE 0x001492A2 /* @ECU_Address@TRS3ovsc_Kiv@0x02183000@ */ ECIPP_ALIGNMENT_SWORD 800 Compu_TRS3ovsc_Kiv -800 799.9755859375
 /begin AXIS_DESCR COM_AXIS NO_INPUT_QUANTITY Compu_TRS3ovsc_RS 4 -256 255.9921875 AXIS_PTS_REF TRS3ovsc_RS /end AXIS_DESCR
/end CHARACTERISTIC
/begin AXIS_PTS TRS3ovsc_RS " " 0x0014929A /* @ECU_Address@TRS3ovsc_RS@0x02182000@ */ NO_INPUT_QUANTITY ECIPP_Lookup_SWORD 0 Compu_TRS3ovsc_RS 4 -256 255.9921875 /end AXIS_PTS
/begin COMPU_METHOD Compu_TRS3ovsc_Kiv " " RAT_FUNC "%.1" "Kiv (%/kph)" COEFFS 0 40.96 0 0 0 1 /end COMPU_METHOD
/begin CHARACTERISTIC TRS3ovsc_dIlim "Roadspeed3 overshoot control dIlim" CURVE 0x001492AA /* @ECU_Address@TRS3ovsc_dIlim@0x02184000@ */ ECIPP_ALIGNMENT_SWORD 625 Compu_TRS3ovsc_dIlim -625 624.980926513672
 /begin AXIS_DESCR COM_AXIS NO_INPUT_QUANTITY Compu_TRS3ovsc_RS 4 -256 255.9921875 AXIS_PTS_REF TRS3ovsc_RS /end AXIS_DESCR
/end CHARACTERISTIC
/begin COMPU_METHOD Compu_TRS3ovsc_dIlim " " RAT_FUNC "%.1" "Rate Limit (%/sec)" COEFFS 0 52.4288 0 0 0 1 /end COMPU_METHOD
/begin COMPU_METHOD Compu_dwell_Vbat_tbl " " RAT_FUNC "%.2" "Vbat (volts)" COEFFS 0 256 0 0 0 1 /end COMPU_METHOD
/begin CHARACTERISTIC dwell_nom_tbl "Nominal dwell schedule" CURVE 0x00146648 /* @ECU_Address@dwell_nom_tbl@0x02201000@ */ ECIPP_ALIGNMENT_SWORD 105 Compu_dwell_nom_tbl -104.8576 104.8544
 /begin AXIS_DESCR COM_AXIS NO_INPUT_QUANTITY Compu_dwell_Vbat_tbl 16 -128 127.99609375 AXIS_PTS_REF dwell_Vbat_tbl /end AXIS_DESCR
/end CHARACTERISTIC
/begin AXIS_PTS dwell_Vbat_tbl " " 0x001465BE /* @ECU_Address@dwell_Vbat_tbl@0x02200000@ */ NO_INPUT_QUANTITY ECIPP_Lookup_SWORD 0 Compu_dwell_Vbat_tbl 16 -128 127.99609375 /end AXIS_PTS
/begin COMPU_METHOD Compu_dwell_nom_tbl " " RAT_FUNC "%.2" "Dwell (ms)" COEFFS 0 312.5 0 0 0 1 /end COMPU_METHOD
/begin MEASUREMENT dwell_extmod_coils "Coil1 ext diag sample" UWORD Compu_dwell_extmod_coils 0 0 0 5.00114468864469 ECU_ADDRESS 0x0220B000 MATRIX_DIM 10 1 1 /end MEASUREMENT
/begin COMPU_METHOD Compu_dwell_extmod_coils " " RAT_FUNC "%.3" "V" COEFFS 0 13104 0 0 0 1 /end COMPU_METHOD
/begin COMPU_METHOD Compu_TRS_kph_meas " " RAT_FUNC "%.1" "Measured kph" COEFFS 0 128 0 0 0 1 /end COMPU_METHOD
/begin CHARACTERISTIC TRS_kph_act "Roadspeed nonlinear correction" CURVE 0x001453B6 /* @ECU_Address@TRS_kph_act@0x0222E000@ */ ECIPP_ALIGNMENT_SWORD 256 Compu_TRS_kph_act -256 255.9921875
 /begin AXIS_DESCR COM_AXIS NO_INPUT_QUANTITY Compu_TRS_kph_meas 6 -256 255.9921875 AXIS_PTS_REF TRS_kph_meas /end AXIS_DESCR
/end CHARACTERISTIC
/begin AXIS_PTS TRS_kph_meas " " 0x001453C2 /* @ECU_Address@TRS_kph_meas@0x0222D000@ */ NO_INPUT_QUANTITY ECIPP_Lookup_SWORD 0 Compu_TRS_kph_meas 6 -256 255.9921875 /end AXIS_PTS
/begin COMPU_METHOD Compu_TRS_kph_act " " RAT_FUNC "%.1" "Actual kph" COEFFS 0 128 0 0 0 1 /end COMPU_METHOD
/begin MEASUREMENT KNKHst_Tbl "Knock Intensity Histogram" ULONG Compu_KNKHst_Tbl 0 0 0 4294967.295 ECU_ADDRESS 0x02239000 MATRIX_DIM 36 1 1 /end MEASUREMENT
/begin COMPU_METHOD Compu_KNKHst_Tbl " " RAT_FUNC "%.1" "Time in Knock (sec)" COEFFS 0 1000 0 0 0 1 /end COMPU_METHOD
/begin COMPU_METHOD Compu_TSRVC_rpm " " RAT_FUNC "%.0" "Speed (rpm)" COEFFS 0 1 0 0 0 1 /end COMPU_METHOD
/begin COMPU_METHOD Compu_TSRVC_MAP " " RAT_FUNC "%.1" "MAP (psia)" COEFFS 0 256 0 0 0 1 /end COMPU_METHOD
/begin CHARACTERISTIC TSRVC_intervals "Service Notification Calibration" MAP 0x0014541A /* @ECU_Address@TSRVC_intervals@0x0225A000@ */ ECIPP_ALIGNMENT_SWORD 16384 Compu_TSRVC_intervals -16384 16383.5
 /begin AXIS_DESCR COM_AXIS NO_INPUT_QUANTITY Compu_TSRVC_MAP 6 -128 127.99609375 AXIS_PTS_REF TSRVC_MAP /end AXIS_DESCR
 /begin AXIS_DESCR COM_AXIS NO_INPUT_QUANTITY Compu_TSRVC_rpm 6 -32768 32767 AXIS_PTS_REF TSRVC_rpm /end AXIS_DESCR
/end CHARACTERISTIC
/begin AXIS_PTS TSRVC_MAP " " 0x0014540E /* @ECU_Address@TSRVC_MAP@0x02259000@ */ NO_INPUT_QUANTITY ECIPP_Lookup_SWORD 0 Compu_TSRVC_MAP 6 -128 127.99609375 /end AXIS_PTS
/begin AXIS_PTS TSRVC_rpm " " 0x00145462 /* @ECU_Address@TSRVC_rpm@0x02258000@ */ NO_INPUT_QUANTITY ECIPP_Lookup_SWORD 0 Compu_TSRVC_rpm 6 -32768 32767 /end AXIS_PTS
/begin COMPU_METHOD Compu_TSRVC_intervals "" RAT_FUNC "%.1" "Speed/Load Service Intervals (hours)" COEFFS 0 2 0 0 0 1 /end COMPU_METHOD
/begin MEASUREMENT SPK_IGBT_T "Spk_IGBT_T 0" UWORD Compu_SPK_IGBT_T 0 0 -460 65075 ECU_ADDRESS 0x0233D000 MATRIX_DIM 11 1 1 /end MEASUREMENT
/begin COMPU_METHOD Compu_SPK_IGBT_T " " RAT_FUNC "%.0" "deg F" COEFFS 0 1 460 0 0 1 /end COMPU_METHOD
/begin COMPU_METHOD Compu_dwell_ls_mult_MAP " " RAT_FUNC "%.1" "MAP load (psia)" COEFFS 0 256 0 0 0 1 /end COMPU_METHOD
/begin COMPU_METHOD Compu_dwell_ls_mult_rpm " " RAT_FUNC "%.0" "Speed (rpm)" COEFFS 0 1 0 0 0 1 /end COMPU_METHOD
/begin CHARACTERISTIC dwell_ls_mult "Dwell Adapt Target Multiplier" MAP 0x001465E8 /* @ECU_Address@dwell_ls_mult@0x02354000@ */ ECIPP_ALIGNMENT_SWORD 32 Compu_dwell_ls_mult -32 31.9990234375
 /begin AXIS_DESCR COM_AXIS NO_INPUT_QUANTITY Compu_dwell_ls_mult_MAP 6 -128 127.99609375 AXIS_PTS_REF dwell_ls_mult_MAP /end AXIS_DESCR
 /begin AXIS_DESCR COM_AXIS NO_INPUT_QUANTITY Compu_dwell_ls_mult_rpm 6 -32768 32767 AXIS_PTS_REF dwell_ls_mult_rpm /end AXIS_DESCR
/end CHARACTERISTIC
/begin AXIS_PTS dwell_ls_mult_MAP " " 0x00146630 /* @ECU_Address@dwell_ls_mult_MAP@0x02352000@ */ NO_INPUT_QUANTITY ECIPP_Lookup_SWORD 0 Compu_dwell_ls_mult_MAP 6 -128 127.99609375 /end AXIS_PTS
/begin AXIS_PTS dwell_ls_mult_rpm " " 0x0014663C /* @ECU_Address@dwell_ls_mult_rpm@0x02353000@ */ NO_INPUT_QUANTITY ECIPP_Lookup_SWORD 0 Compu_dwell_ls_mult_rpm 6 -32768 32767 /end AXIS_PTS
/begin COMPU_METHOD Compu_dwell_ls_mult "" RAT_FUNC "%.3" "Dwell Multiplier" COEFFS 0 1024 0 0 0 1 /end COMPU_METHOD
/begin MEASUREMENT STR_enov_slnk_u8_1 "simulink_u8_1" UBYTE Compu_ECIPP_STRINGS 0 0 0 255 ECU_ADDRESS 0x0255B000 MATRIX_DIM 24 1 1 /end MEASUREMENT
/begin MEASUREMENT STR_enov_slnk_u8_2 "simulink_u8_2" UBYTE Compu_ECIPP_STRINGS 0 0 0 255 ECU_ADDRESS 0x0255C000 MATRIX_DIM 24 1 1 /end MEASUREMENT
/begin MEASUREMENT STR_enov_slnk_u8_3 "simulink_u8_3" UBYTE Compu_ECIPP_STRINGS 0 0 0 255 ECU_ADDRESS 0x0255D000 MATRIX_DIM 24 1 1 /end MEASUREMENT
/begin MEASUREMENT STR_enov_slnk_u8_4 "simulink_u8_4" UBYTE Compu_ECIPP_STRINGS 0 0 0 255 ECU_ADDRESS 0x0255E000 MATRIX_DIM 24 1 1 /end MEASUREMENT
/begin MEASUREMENT STR_enov_slnk_u8_5 "simulink_u8_5" UBYTE Compu_ECIPP_STRINGS 0 0 0 255 ECU_ADDRESS 0x0255F000 MATRIX_DIM 24 1 1 /end MEASUREMENT
/begin MEASUREMENT STR_enov_slnk_u8_6 "simulink_u8_6" UBYTE Compu_ECIPP_STRINGS 0 0 0 255 ECU_ADDRESS 0x02560000 MATRIX_DIM 24 1 1 /end MEASUREMENT
/begin MEASUREMENT STR_enov_slnk_u8_7 "simulink_u8_7" UBYTE Compu_ECIPP_STRINGS 0 0 0 255 ECU_ADDRESS 0x02561000 MATRIX_DIM 24 1 1 /end MEASUREMENT
/begin MEASUREMENT STR_enov_slnk_u8_8 "simulink_u8_8" UBYTE Compu_ECIPP_STRINGS 0 0 0 255 ECU_ADDRESS 0x02562000 MATRIX_DIM 24 1 1 /end MEASUREMENT
/begin MEASUREMENT STR_enov_slnk_u8_9 "simulink_u8_9" UBYTE Compu_ECIPP_STRINGS 0 0 0 255 ECU_ADDRESS 0x02563000 MATRIX_DIM 24 1 1 /end MEASUREMENT
/begin MEASUREMENT STR_enov_slnk_u8_10 "simulink_u8_10" UBYTE Compu_ECIPP_STRINGS 0 0 0 255 ECU_ADDRESS 0x02564000 MATRIX_DIM 24 1 1 /end MEASUREMENT
/begin MEASUREMENT STR_enov_slnk_u8_11 "simulink_u8_11" UBYTE Compu_ECIPP_STRINGS 0 0 0 255 ECU_ADDRESS 0x02565000 MATRIX_DIM 24 1 1 /end MEASUREMENT
/begin MEASUREMENT STR_enov_slnk_u8_12 "simulink_u8_12" UBYTE Compu_ECIPP_STRINGS 0 0 0 255 ECU_ADDRESS 0x02566000 MATRIX_DIM 24 1 1 /end MEASUREMENT
/begin MEASUREMENT STR_enov_slnk_u8_13 "simulink_u8_13" UBYTE Compu_ECIPP_STRINGS 0 0 0 255 ECU_ADDRESS 0x02567000 MATRIX_DIM 24 1 1 /end MEASUREMENT
/begin MEASUREMENT STR_enov_slnk_u8_14 "simulink_u8_14" UBYTE Compu_ECIPP_STRINGS 0 0 0 255 ECU_ADDRESS 0x02568000 MATRIX_DIM 24 1 1 /end MEASUREMENT
/begin MEASUREMENT STR_enov_slnk_u8_15 "simulink_u8_15" UBYTE Compu_ECIPP_STRINGS 0 0 0 255 ECU_ADDRESS 0x02569000 MATRIX_DIM 24 1 1 /end MEASUREMENT
/begin MEASUREMENT STR_enov_slnk_u8_16 "simulink_u8_16" UBYTE Compu_ECIPP_STRINGS 0 0 0 255 ECU_ADDRESS 0x0256A000 MATRIX_DIM 24 1 1 /end MEASUREMENT
/begin MEASUREMENT STR_enov_slnk_u8_17 "simulink_u8_17" UBYTE Compu_ECIPP_STRINGS 0 0 0 255 ECU_ADDRESS 0x0256B000 MATRIX_DIM 24 1 1 /end MEASUREMENT
/begin MEASUREMENT STR_enov_slnk_u8_18 "simulink_u8_18" UBYTE Compu_ECIPP_STRINGS 0 0 0 255 ECU_ADDRESS 0x0256C000 MATRIX_DIM 24 1 1 /end MEASUREMENT
/begin MEASUREMENT STR_enov_slnk_u8_19 "simulink_u8_19" UBYTE Compu_ECIPP_STRINGS 0 0 0 255 ECU_ADDRESS 0x0256D000 MATRIX_DIM 24 1 1 /end MEASUREMENT
/begin MEASUREMENT STR_enov_slnk_u8_20 "simulink_u8_20" UBYTE Compu_ECIPP_STRINGS 0 0 0 255 ECU_ADDRESS 0x0256E000 MATRIX_DIM 24 1 1 /end MEASUREMENT
/begin MEASUREMENT STR_enov_slnk_f_1 "simulink_float_1" UBYTE Compu_ECIPP_STRINGS 0 0 0 255 ECU_ADDRESS 0x0256F000 MATRIX_DIM 24 1 1 /end MEASUREMENT
/begin MEASUREMENT STR_enov_slnk_f_2 "simulink_float_2" UBYTE Compu_ECIPP_STRINGS 0 0 0 255 ECU_ADDRESS 0x02570000 MATRIX_DIM 24 1 1 /end MEASUREMENT
/begin MEASUREMENT STR_enov_slnk_f_3 "simulink_float_3" UBYTE Compu_ECIPP_STRINGS 0 0 0 255 ECU_ADDRESS 0x02571000 MATRIX_DIM 24 1 1 /end MEASUREMENT
/begin MEASUREMENT STR_enov_slnk_f_4 "simulink_float_4" UBYTE Compu_ECIPP_STRINGS 0 0 0 255 ECU_ADDRESS 0x02572000 MATRIX_DIM 24 1 1 /end MEASUREMENT
/begin MEASUREMENT STR_enov_slnk_f_5 "simulink_float_5" UBYTE Compu_ECIPP_STRINGS 0 0 0 255 ECU_ADDRESS 0x02573000 MATRIX_DIM 24 1 1 /end MEASUREMENT
/begin MEASUREMENT STR_enov_slnk_f_6 "simulink_float_6" UBYTE Compu_ECIPP_STRINGS 0 0 0 255 ECU_ADDRESS 0x02574000 MATRIX_DIM 24 1 1 /end MEASUREMENT
/begin MEASUREMENT STR_enov_slnk_f_7 "simulink_float_7" UBYTE Compu_ECIPP_STRINGS 0 0 0 255 ECU_ADDRESS 0x02575000 MATRIX_DIM 24 1 1 /end MEASUREMENT
/begin MEASUREMENT STR_enov_slnk_f_8 "simulink_float_8" UBYTE Compu_ECIPP_STRINGS 0 0 0 255 ECU_ADDRESS 0x02576000 MATRIX_DIM 24 1 1 /end MEASUREMENT
/begin MEASUREMENT STR_enov_slnk_f_9 "simulink_float_9" UBYTE Compu_ECIPP_STRINGS 0 0 0 255 ECU_ADDRESS 0x02577000 MATRIX_DIM 24 1 1 /end MEASUREMENT
/begin MEASUREMENT STR_enov_slnk_f_10 "simulink_float_10" UBYTE Compu_ECIPP_STRINGS 0 0 0 255 ECU_ADDRESS 0x02578000 MATRIX_DIM 24 1 1 /end MEASUREMENT
/begin MEASUREMENT STR_enov_slnk_f_11 "simulink_float_11" UBYTE Compu_ECIPP_STRINGS 0 0 0 255 ECU_ADDRESS 0x02579000 MATRIX_DIM 24 1 1 /end MEASUREMENT
/begin MEASUREMENT STR_enov_slnk_f_12 "simulink_float_12" UBYTE Compu_ECIPP_STRINGS 0 0 0 255 ECU_ADDRESS 0x0257A000 MATRIX_DIM 24 1 1 /end MEASUREMENT
/begin MEASUREMENT STR_enov_slnk_f_13 "simulink_float_13" UBYTE Compu_ECIPP_STRINGS 0 0 0 255 ECU_ADDRESS 0x0257B000 MATRIX_DIM 24 1 1 /end MEASUREMENT
/begin MEASUREMENT STR_enov_slnk_f_14 "simulink_float_14" UBYTE Compu_ECIPP_STRINGS 0 0 0 255 ECU_ADDRESS 0x0257C000 MATRIX_DIM 24 1 1 /end MEASUREMENT
/begin MEASUREMENT STR_enov_slnk_f_15 "simulink_float_15" UBYTE Compu_ECIPP_STRINGS 0 0 0 255 ECU_ADDRESS 0x0257D000 MATRIX_DIM 24 1 1 /end MEASUREMENT
/begin MEASUREMENT STR_enov_slnk_f_16 "simulink_float_16" UBYTE Compu_ECIPP_STRINGS 0 0 0 255 ECU_ADDRESS 0x0257E000 MATRIX_DIM 24 1 1 /end MEASUREMENT
/begin MEASUREMENT STR_enov_slnk_f_17 "simulink_float_17" UBYTE Compu_ECIPP_STRINGS 0 0 0 255 ECU_ADDRESS 0x0257F000 MATRIX_DIM 24 1 1 /end MEASUREMENT
/begin MEASUREMENT STR_enov_slnk_f_18 "simulink_float_18" UBYTE Compu_ECIPP_STRINGS 0 0 0 255 ECU_ADDRESS 0x02580000 MATRIX_DIM 24 1 1 /end MEASUREMENT
/begin MEASUREMENT STR_enov_slnk_f_19 "simulink_float_19" UBYTE Compu_ECIPP_STRINGS 0 0 0 255 ECU_ADDRESS 0x02581000 MATRIX_DIM 24 1 1 /end MEASUREMENT
/begin MEASUREMENT STR_enov_slnk_f_20 "simulink_float_20" UBYTE Compu_ECIPP_STRINGS 0 0 0 255 ECU_ADDRESS 0x02582000 MATRIX_DIM 24 1 1 /end MEASUREMENT
/begin MEASUREMENT HstSL_expTbl "Speed-Load Histogram" ULONG Compu_HstSL_expTbl 0 0 0 59652.3235416667 ECU_ADDRESS 0x025AC000 MATRIX_DIM 72 1 1 /end MEASUREMENT
/begin COMPU_METHOD Compu_HstSL_expTbl " " RAT_FUNC "%.3" "Operating Time (hours)" COEFFS 0 72000 0 0 0 1 /end COMPU_METHOD
/begin CHARACTERISTIC RangeHst_ECIPP_ndx "Range history ECIPP index 1" VAL_BLK 0x00147754 /* @ECU_Address@RangeHst_ECIPP_ndx@0x025D5000@ */ ECIPP_ALIGNMENT_UWORD 65535 Compu_RangeHst_ECIPP_ndx 0 65535 MATRIX_DIM 20 1 1 /end CHARACTERISTIC
/begin COMPU_METHOD Compu_RangeHst_ECIPP_ndx " " RAT_FUNC "%.0" "-" COEFFS 0 1 0 0 0 1 /end COMPU_METHOD
/begin CHARACTERISTIC RangeHst_min "Range history minimum 1" VAL_BLK 0x00144170 /* @ECU_Address@RangeHst_min@0x025D6000@ */ ECIPP_ALIGNMENT_ULONG 4294967295 Compu_RangeHst_min 0 4294967295 MATRIX_DIM 20 1 1 /end CHARACTERISTIC
/begin COMPU_METHOD Compu_RangeHst_min " " RAT_FUNC "%.0" "-" COEFFS 0 1 0 0 0 1 /end COMPU_METHOD
/begin CHARACTERISTIC RangeHst_max "Range history maximum 1" VAL_BLK 0x00144120 /* @ECU_Address@RangeHst_max@0x025D7000@ */ ECIPP_ALIGNMENT_ULONG 4294967295 Compu_RangeHst_max 0 4294967295 MATRIX_DIM 20 1 1 /end CHARACTERISTIC
/begin COMPU_METHOD Compu_RangeHst_max " " RAT_FUNC "%.0" "-" COEFFS 0 1 0 0 0 1 /end COMPU_METHOD
/begin MEASUREMENT RangeHst_cnt "Range history counter/timer 1" ULONG Compu_RangeHst_cnt 0 0 0 4294967295 ECU_ADDRESS 0x025D8000 MATRIX_DIM 20 1 1 /end MEASUREMENT
/begin COMPU_METHOD Compu_RangeHst_cnt " " RAT_FUNC "%.0" "-" COEFFS 0 1 0 0 0 1 /end COMPU_METHOD
/begin MEASUREMENT cal_grp_cksums "Group Checksum" ULONG Compu_cal_grp_cksums 0 0 0 4294967295 ECU_ADDRESS 0x025FD000 MATRIX_DIM 8 1 1 /end MEASUREMENT
/begin COMPU_METHOD Compu_cal_grp_cksums " " RAT_FUNC "%.0" "-" COEFFS 0 1 0 0 0 1 /end COMPU_METHOD
/begin CHARACTERISTIC cal_grp_revisions "Group Revisoin" VAL_BLK 0x00148117 /* @ECU_Address@cal_grp_revisions@0x025FE000@ */ ECIPP_ALIGNMENT_UBYTE 255 Compu_cal_grp_revisions 0 255 MATRIX_DIM 8 1 1 /end CHARACTERISTIC
/begin COMPU_METHOD Compu_cal_grp_revisions " " RAT_FUNC "%.0" "Rev" COEFFS 0 1 0 0 0 1 /end COMPU_METHOD
/begin CHARACTERISTIC STR_cal_grp_name1 "Group 1" ASCII 0x001693D8 /* @ECU_Address@STR_cal_grp_name1@0x02602000@ */ ECIPP_ALIGNMENT_UBYTE 255 Compu_ECIPP_STRINGS 0 255 MATRIX_DIM 11 1 1 /end CHARACTERISTIC
/begin CHARACTERISTIC STR_cal_grp_name2 "Group 2" ASCII 0x001693E4 /* @ECU_Address@STR_cal_grp_name2@0x02603000@ */ ECIPP_ALIGNMENT_UBYTE 255 Compu_ECIPP_STRINGS 0 255 MATRIX_DIM 11 1 1 /end CHARACTERISTIC
/begin CHARACTERISTIC STR_cal_grp_name3 "Group 3" ASCII 0x001693F0 /* @ECU_Address@STR_cal_grp_name3@0x02604000@ */ ECIPP_ALIGNMENT_UBYTE 255 Compu_ECIPP_STRINGS 0 255 MATRIX_DIM 11 1 1 /end CHARACTERISTIC
/begin CHARACTERISTIC STR_cal_grp_name4 "Group 4" ASCII 0x001693FC /* @ECU_Address@STR_cal_grp_name4@0x02605000@ */ ECIPP_ALIGNMENT_UBYTE 255 Compu_ECIPP_STRINGS 0 255 MATRIX_DIM 11 1 1 /end CHARACTERISTIC
/begin CHARACTERISTIC STR_cal_grp_name5 "Group 5" ASCII 0x00169408 /* @ECU_Address@STR_cal_grp_name5@0x02606000@ */ ECIPP_ALIGNMENT_UBYTE 255 Compu_ECIPP_STRINGS 0 255 MATRIX_DIM 11 1 1 /end CHARACTERISTIC
/begin CHARACTERISTIC STR_cal_grp_name6 "Group 6" ASCII 0x00169414 /* @ECU_Address@STR_cal_grp_name6@0x02607000@ */ ECIPP_ALIGNMENT_UBYTE 255 Compu_ECIPP_STRINGS 0 255 MATRIX_DIM 11 1 1 /end CHARACTERISTIC
/begin CHARACTERISTIC STR_cal_grp_name7 "Group 7" ASCII 0x00169420 /* @ECU_Address@STR_cal_grp_name7@0x02608000@ */ ECIPP_ALIGNMENT_UBYTE 255 Compu_ECIPP_STRINGS 0 255 MATRIX_DIM 11 1 1 /end CHARACTERISTIC
/begin CHARACTERISTIC STR_cal_grp_name8 "Group 8" ASCII 0x0016942C /* @ECU_Address@STR_cal_grp_name8@0x02609000@ */ ECIPP_ALIGNMENT_UBYTE 255 Compu_ECIPP_STRINGS 0 255 MATRIX_DIM 11 1 1 /end CHARACTERISTIC
/begin CHARACTERISTIC cal_grp_locked "Group Locked{cal_grp_locked&0xff=0:No}{cal_grp_locked&0xff=1:Yes}" VAL_BLK 0x0014810F /* @ECU_Address@cal_grp_locked@0x0260A000@ */ ECIPP_ALIGNMENT_UBYTE 255 cal_grp_locked_COMPU_VTAB 0 255 MATRIX_DIM 8 1 1 BIT_MASK 0xff /end CHARACTERISTIC
/begin COMPU_METHOD cal_grp_locked_COMPU_VTAB "Verbal Table" TAB_VERB "%.0" "list" COMPU_TAB_REF cal_grp_locked_COMPU_VTAB_REF /end COMPU_METHOD
/begin COMPU_VTAB cal_grp_locked_COMPU_VTAB_REF "Verbal Table" TAB_VERB 2 0 "No" 1 "Yes" DEFAULT_VALUE "UNKNOWN" /end COMPU_VTAB
/begin MEASUREMENT cal_grp_cksum_ee "Group Checksum" ULONG Compu_cal_grp_cksum_ee 0 0 0 4294967295 ECU_ADDRESS 0x0260C000 MATRIX_DIM 8 1 1 /end MEASUREMENT
/begin COMPU_METHOD Compu_cal_grp_cksum_ee " " RAT_FUNC "%.0" "-" COEFFS 0 1 0 0 0 1 /end COMPU_METHOD
/begin MEASUREMENT cal_grp_rev_ee "Group Revisoin" UBYTE Compu_cal_grp_rev_ee 0 0 0 255 ECU_ADDRESS 0x0260D000 MATRIX_DIM 8 1 1 /end MEASUREMENT
/begin COMPU_METHOD Compu_cal_grp_rev_ee " " RAT_FUNC "%.0" "-" COEFFS 0 1 0 0 0 1 /end COMPU_METHOD
/begin MEASUREMENT cal_grp_lock_ee "Group Locked{cal_grp_lock_ee&0xff=0:No}{cal_grp_lock_ee&0xff=1:Yes}" UBYTE cal_grp_lock_ee_COMPU_VTAB 0 0 0 255 ECU_ADDRESS 0x0260E000 MATRIX_DIM 8 1 1 BIT_MASK 0xff /end MEASUREMENT
/begin COMPU_METHOD cal_grp_lock_ee_COMPU_VTAB "Verbal Table" TAB_VERB "%.0" "list" COMPU_TAB_REF cal_grp_lock_ee_COMPU_VTAB_REF /end COMPU_METHOD
/begin COMPU_VTAB cal_grp_lock_ee_COMPU_VTAB_REF "Verbal Table" TAB_VERB 2 0 "No" 1 "Yes" DEFAULT_VALUE "UNKNOWN" /end COMPU_VTAB
/begin MEASUREMENT cal_grp_cksum_hst1 "Group Checksum" ULONG Compu_cal_grp_cksum_hst1 0 0 0 4294967295 ECU_ADDRESS 0x0260F000 MATRIX_DIM 8 1 1 /end MEASUREMENT
/begin COMPU_METHOD Compu_cal_grp_cksum_hst1 " " RAT_FUNC "%.0" "-" COEFFS 0 1 0 0 0 1 /end COMPU_METHOD
/begin MEASUREMENT cal_grp_rev_hst1 "Group Revisoin" UBYTE Compu_cal_grp_rev_hst1 0 0 0 255 ECU_ADDRESS 0x02610000 MATRIX_DIM 8 1 1 /end MEASUREMENT
/begin COMPU_METHOD Compu_cal_grp_rev_hst1 " " RAT_FUNC "%.0" "-" COEFFS 0 1 0 0 0 1 /end COMPU_METHOD
/begin MEASUREMENT cal_grp_lock_hst1 "Group Locked{cal_grp_lock_hst1&0xff=0:No}{cal_grp_lock_hst1&0xff=1:Yes}" UBYTE cal_grp_lock_hst1_COMPU_VTAB 0 0 0 255 ECU_ADDRESS 0x02611000 MATRIX_DIM 8 1 1 BIT_MASK 0xff /end MEASUREMENT
/begin COMPU_METHOD cal_grp_lock_hst1_COMPU_VTAB "Verbal Table" TAB_VERB "%.0" "list" COMPU_TAB_REF cal_grp_lock_hst1_COMPU_VTAB_REF /end COMPU_METHOD
/begin COMPU_VTAB cal_grp_lock_hst1_COMPU_VTAB_REF "Verbal Table" TAB_VERB 2 0 "No" 1 "Yes" DEFAULT_VALUE "UNKNOWN" /end COMPU_VTAB
/begin MEASUREMENT cal_grp_cksum_hst2 "Group Checksum" ULONG Compu_cal_grp_cksum_hst2 0 0 0 4294967295 ECU_ADDRESS 0x02612000 MATRIX_DIM 8 1 1 /end MEASUREMENT
/begin COMPU_METHOD Compu_cal_grp_cksum_hst2 " " RAT_FUNC "%.0" "-" COEFFS 0 1 0 0 0 1 /end COMPU_METHOD
/begin MEASUREMENT cal_grp_rev_hst2 "Group Revisoin" UBYTE Compu_cal_grp_rev_hst2 0 0 0 255 ECU_ADDRESS 0x02613000 MATRIX_DIM 8 1 1 /end MEASUREMENT
/begin COMPU_METHOD Compu_cal_grp_rev_hst2 " " RAT_FUNC "%.0" "-" COEFFS 0 1 0 0 0 1 /end COMPU_METHOD
/begin MEASUREMENT cal_grp_lock_hst2 "Group Locked{cal_grp_lock_hst2&0xff=0:No}{cal_grp_lock_hst2&0xff=1:Yes}" UBYTE cal_grp_lock_hst2_COMPU_VTAB 0 0 0 255 ECU_ADDRESS 0x02614000 MATRIX_DIM 8 1 1 BIT_MASK 0xff /end MEASUREMENT
/begin COMPU_METHOD cal_grp_lock_hst2_COMPU_VTAB "Verbal Table" TAB_VERB "%.0" "list" COMPU_TAB_REF cal_grp_lock_hst2_COMPU_VTAB_REF /end COMPU_METHOD
/begin COMPU_VTAB cal_grp_lock_hst2_COMPU_VTAB_REF "Verbal Table" TAB_VERB 2 0 "No" 1 "Yes" DEFAULT_VALUE "UNKNOWN" /end COMPU_VTAB
/begin MEASUREMENT cal_grp_valid "Valid Calibration Group{cal_grp_valid&0xff=0:No}{cal_grp_valid&0xff=1:Yes}" UBYTE cal_grp_valid_COMPU_VTAB 0 0 0 255 ECU_ADDRESS 0x02615000 MATRIX_DIM 8 1 1 BIT_MASK 0xff /end MEASUREMENT
/begin COMPU_METHOD cal_grp_valid_COMPU_VTAB "Verbal Table" TAB_VERB "%.0" "list" COMPU_TAB_REF cal_grp_valid_COMPU_VTAB_REF /end COMPU_METHOD
/begin COMPU_VTAB cal_grp_valid_COMPU_VTAB_REF "Verbal Table" TAB_VERB 2 0 "No" 1 "Yes" DEFAULT_VALUE "UNKNOWN" /end COMPU_VTAB
/begin MEASUREMENT cal_grp_hrs_ee "Hour Last Commit" ULONG Compu_cal_grp_hrs_ee 0 0 0 1193046.47083333 ECU_ADDRESS 0x02639000 MATRIX_DIM 3 1 1 /end MEASUREMENT
/begin COMPU_METHOD Compu_cal_grp_hrs_ee " " RAT_FUNC "%.3" "-" COEFFS 0 3600 0 0 0 1 /end COMPU_METHOD
/begin COMPU_METHOD Compu_TspkMATMAPrmultLPrpm " " RAT_FUNC "%.0" "Speed (rpm)" COEFFS 0 1 0 0 0 1 /end COMPU_METHOD
/begin CHARACTERISTIC TspkMATMAPrmultLP "LPG MAT Spark Retard Attenuation" CURVE 0x0014799E /* @ECU_Address@TspkMATMAPrmultLP@0x0266E000@ */ ECIPP_ALIGNMENT_UWORD 100 Compu_TspkMATMAPrmultLP 0 99.9984741210938
 /begin AXIS_DESCR COM_AXIS NO_INPUT_QUANTITY Compu_TspkMATMAPrmultLPrpm 6 -32768 32767 AXIS_PTS_REF TspkMATMAPrmultLPrpm /end AXIS_DESCR
/end CHARACTERISTIC
/begin AXIS_PTS TspkMATMAPrmultLPrpm " " 0x001462C6 /* @ECU_Address@TspkMATMAPrmultLPrpm@0x0266D000@ */ NO_INPUT_QUANTITY ECIPP_Lookup_SWORD 0 Compu_TspkMATMAPrmultLPrpm 6 -32768 32767 /end AXIS_PTS
/begin COMPU_METHOD Compu_TspkMATMAPrmultLP " " RAT_FUNC "%.1" "% CAD" COEFFS 0 655.36 0 0 0 1 /end COMPU_METHOD
/begin MEASUREMENT THstIBF_occ "Intake Backfire Histogram (Recent)" UBYTE Compu_THstIBF_occ 0 0 0 255 ECU_ADDRESS 0x02677000 MATRIX_DIM 30 1 1 /end MEASUREMENT
/begin COMPU_METHOD Compu_THstIBF_occ " " RAT_FUNC "%.0" "Intake Backfire Occurrences" COEFFS 0 1 0 0 0 1 /end COMPU_METHOD
/begin MEASUREMENT THstIBF_LT_occ "Intake Backfire Histogram (Lifetime)" UBYTE Compu_THstIBF_LT_occ 0 0 0 255 ECU_ADDRESS 0x02678000 MATRIX_DIM 30 1 1 /end MEASUREMENT
/begin COMPU_METHOD Compu_THstIBF_LT_occ " " RAT_FUNC "%.0" "Intake Backfire Occurrences" COEFFS 0 1 0 0 0 1 /end COMPU_METHOD
/begin MEASUREMENT THrsIBF_occ "Historical Intake Backfire Events" UBYTE Compu_THrsIBF_occ 0 0 0 255 ECU_ADDRESS 0x0267B000 MATRIX_DIM 4 1 1 /end MEASUREMENT
/begin COMPU_METHOD Compu_THrsIBF_occ " " RAT_FUNC "%.0" "Occurrences" COEFFS 0 1 0 0 0 1 /end COMPU_METHOD
/begin GROUP EC_Roadspeed "ECONTROLS" ROOT
 /begin REF_CHARACTERISTIC RS_pulse_space RS_hist_avg_t RS_hist_tout RS_dot_window RS_speed_tau RS_TPS_tau RS_dot_tau RS_Kp RS_Ki RS_Kd RS_Kiv RS_rpm_nom RS_HW_switch RS_source RS_dot_dzlim slowPWMin_ena slowPWMin_per_edge slowPWMin_tout RS_setsrc sPWMi_DC_lo sPWMi_DC_hi sPWMi_per_lo sPWMi_per_hi RS_setsrc_valid RS_prop_tau RS_rpmtol_Ifrz RS_Kivapp_RS0 RS_Kivapp_RS100 RS_Kivapp_add RSovsc_ena RSovsc_Kiv RSovsc_dIlim RSovsc_deng RSovsc_denghyst RS_Kd_accel RS_loss RS_loss_RPM RS_loss_MAP RSdrop_rpm_arm RSdrop_kph_arm RSdrop_tout_arm RSdrop_kph_trig RSdrop_tout_trig RSdrop_tout_disarm RSovsc_table RSovsc_Kiv_phout RS_dot_ovsc_tau RS_gainset RS2_gainset RS2_source RS2ovsc_ena RS2ovsc_table RS2_speed_tau RS2_dot_tau RS2_dot_window RS2_dot_dzlim RS2_Kp RS2_Ki RS2_Kd RS2_Kd_accel RS2_Kiv RS2_TPS_tau RS2_Kivapp_add RS2_Kivapp_RS0 RS2_Kivapp_RS100 RS2ovsc_deng RS2ovsc_denghyst RS2_dot_ovsc_tau RS2ovsc_Kiv_phout RS2ovsc_dIlim RS2ovsc_Kiv RS3_gainset RS3_source RS3ovsc_ena RS3ovsc_table RS3_speed_tau RS3_dot_tau RS3_dot_window RS3_dot_dzlim RS3_Kp RS3_Ki RS3_Kd RS3_Kd_accel RS3_Kiv RS3_TPS_tau RS3_Kivapp_add RS3_Kivapp_RS0 RS3_Kivapp_RS100 RS3ovsc_deng RS3ovsc_denghyst RS3_dot_ovsc_tau RS3ovsc_Kiv_phout RS3ovsc_dIlim RS3ovsc_Kiv RSC_enable_chan RSC_resume_chan RSC_setinc_chan RSC_setdec_chan RSC_enable_moment RSC_setinc_wait RSC_setdec_wait RSC_resume_ramp RSC_setinc_tap RSC_setinc_ramp RSC_setdec_tap RSC_setdec_ramp RSC_min_kph RSC_max_kph RSC_engaged_light RS_kph_crct_ena RSC_disable_kph RSC_retard_braking RS_Kp_dz RS2_Kp_dz RS3_Kp_dz RS_Kp_dz_tout RS2_Kp_dz_tout RS3_Kp_dz_tout RS_speed_CAN_tau C2ASpd_ena C2ASpd_hist_avg_t C2ASpd_hist_tout RS_Iacc_init RSC_enable_cfg RSC_setinc_cfg RSC_setdec_cfg RSC_resume_cfg MEFI_RS_source_ena RSC_disable_chan RSC_disable_cfg RS_speed_Llim RS_speed_Ulim RS_ppkm_Ulim RS_loV RS_hiV RSC_disable_by_RBC RS_pattern RS_disc_tmr RS_disc_thr RS_disc_rpm RS_GPS_UA_tout RS_disc_ena RS_disc_Vbat RS_max_allspeed_ena RS_TPS_bstld_crct RSC_disable_2inputs RSC_disable_rpm RSC_ramp_time_max RSC_error_pct RSC_error_wait RSC_CAN_set_sw RS_TPS_FPPlim_ena RS_CAN_source RS_max_load_inc_slew TRSovsc_Kiv TRSovsc_dIlim TRS2ovsc_Kiv TRS2ovsc_dIlim TRS3ovsc_Kiv TRS3ovsc_dIlim TRS_kph_act /end REF_CHARACTERISTIC
 /begin REF_MEASUREMENT RS_dot RS_dot_dz RS_dt RS_pulse_cnt RS_max_load RS_max_TPS RS_Iacc GPS_ENZdot_tmr GPS_Edot GPS_Ndot GPS_ENZdot_st GPS_ENspeed MaxSetPt_RS slowPWMin_period slowPWMin_DC slowPWMin_valid Aqua_setpt_mode Aqua_setpt_speed Aqua_setpt_rpm Aqua_ENdot Aqua_fwdaccel Aqua_fwdaccel_st RSovsc_armed RSdrop_status RSovsc_Kiv_a RSovsc_dIlim_a Aqua_gain_ndx Aqua_spddotd_dis RSP_selected RSC_speed_accum RSC_speed_slew RSC_engaged RSC_enabled RS_speed_meas_acc RS_min_FPP RS_OOA_state RSC_CCVS_status RS_max_FPP RS_FPPmin_Iacc RS_FPPmax_Iacc RS_speed_CAN RS_freq_raw C2ASpd_freq_raw MEFI_RS_source_req RMT_RS_pulses_per_km RMT_RS_speed_1 RMT_RS_speed_2 RMT_RS_mode RS_dir RS_disc_ana RS_disc_calc FPP_allspeed_rpm allspeed_rpm RS_max_allspeed_rpm RS_max_allspeed_use /end REF_MEASUREMENT
/end GROUP
/begin GROUP EC_Service "ECONTROLS" ROOT
 /begin REF_CHARACTERISTIC KNKHst_percent_trig KNKHst_retard_trig KNKHst_trig_mode SRVC_mode SRVC_fixed_interval ECTHst_ena ECTHst_hi_trig RangeHst_mode1 RangeHst_mode2 RangeHst_mode3 RangeHst_mode4 RangeHst_mode5 RangeHst_mode6 RangeHst_mode7 RangeHst_mode8 RangeHst_mode9 RangeHst_mode10 RangeHst_mode11 RangeHst_mode12 RangeHst_mode13 RangeHst_mode14 RangeHst_mode15 RangeHst_mode16 RangeHst_mode17 RangeHst_mode18 RangeHst_mode19 RangeHst_mode20 RangeHst_cntr_upd reset_learn_reprog SRVC_fixed_int_km_L1 SRVC_fixed_int_km_L2 IBF_mode IBF_IATdt_lim IBF_MAP_lim IBF_latch_tm IBF_unlatch_tm TSRVC_intervals RangeHst_ECIPP_ndx RangeHst_min RangeHst_max cal_grp_revisions STR_cal_grp_name1 STR_cal_grp_name2 STR_cal_grp_name3 STR_cal_grp_name4 STR_cal_grp_name5 STR_cal_grp_name6 STR_cal_grp_name7 STR_cal_grp_name8 cal_grp_locked /end REF_CHARACTERISTIC
 /begin REF_MEASUREMENT KNKHst_reset_request SRVC_update_key SRVC_update_status SRVC_pct_accum ECTHst_reset_usr reset_learn_active reset_learn_action reset_learn_state SRVC_km_rem IATdt IATdt_key_cyc_max IBF_action_request HstIBF_total HstIBF_LT_total HstIBF_time KNKHst_Tbl HstSL_expTbl RangeHst_cnt cal_grp_cksums cal_grp_cksum_ee cal_grp_rev_ee cal_grp_lock_ee cal_grp_cksum_hst1 cal_grp_rev_hst1 cal_grp_lock_hst1 cal_grp_cksum_hst2 cal_grp_rev_hst2 cal_grp_lock_hst2 cal_grp_valid cal_grp_hrs_ee THstIBF_occ THstIBF_LT_occ THrsIBF_occ /end REF_MEASUREMENT
/end GROUP
/begin GROUP EC_Service1 "ECONTROLS" ROOT
 /begin REF_MEASUREMENT AL_nonzero TRIM_EGO_ajlean TRIM_EGO_ajstoc TRIM_EGO_ajrich TRIM_EGO_avg /end REF_MEASUREMENT
/end GROUP
/begin GROUP EC_Simulink "ECONTROLS" ROOT /begin REF_CHARACTERISTIC slnk_nvm_reprog_clr slnk_nvm_wr_period /end REF_CHARACTERISTIC
 /begin REF_MEASUREMENT svn_remote_compiled svn_mixed svn_modified svn_compile_date_str enov_slnk_u8_1 enov_slnk_u8_2 enov_slnk_u8_3 enov_slnk_u8_4 enov_slnk_u8_5 enov_slnk_u8_6 enov_slnk_u8_7 enov_slnk_u8_8 enov_slnk_u8_9 enov_slnk_u8_10 enov_slnk_u8_11 enov_slnk_u8_12 enov_slnk_u8_13 enov_slnk_u8_14 enov_slnk_u8_15 enov_slnk_u8_16 enov_slnk_u8_17 enov_slnk_u8_18 enov_slnk_u8_19 enov_slnk_u8_20 enov_slnk_f_1 enov_slnk_f_2 enov_slnk_f_3 enov_slnk_f_4 enov_slnk_f_5 enov_slnk_f_6 enov_slnk_f_7 enov_slnk_f_8 enov_slnk_f_9 enov_slnk_f_10 enov_slnk_f_11 enov_slnk_f_12 enov_slnk_f_13 enov_slnk_f_14 enov_slnk_f_15 enov_slnk_f_16 enov_slnk_f_17 enov_slnk_f_18 enov_slnk_f_19 enov_slnk_f_20 slnk_invalid_fsh_adr slnk_invalid_fsh_cnt slnk_invalid_reg_adr slnk_invalid_reg_cnt slnk_invalid_RAM_adr slnk_invalid_RAM_cnt enov_slnk_1ms_live enov_slnk_1ms_oruns enov_slnk_1ms_inst enov_slnk_1ms_max enov_slnk_5ms_live enov_slnk_5ms_oruns enov_slnk_5ms_inst enov_slnk_5ms_max enov_slnk_50ms_live enov_slnk_50ms_oruns enov_slnk_50ms_inst enov_slnk_50ms_max enov_slnk_fsh_bytes enov_slnk_fsh_pct enov_slnk_RAM_bytes enov_slnk_RAM_pct enov_slnk_1ms_allwd enov_slnk_5ms_allwd enov_slnk_50ms_allwd enov_slnk_1ms_pct enov_slnk_5ms_pct enov_slnk_50ms_pct enov_slnk_revision STR_enov_slnk_u8_1 STR_enov_slnk_u8_2 STR_enov_slnk_u8_3 STR_enov_slnk_u8_4 STR_enov_slnk_u8_5 STR_enov_slnk_u8_6 STR_enov_slnk_u8_7 STR_enov_slnk_u8_8 STR_enov_slnk_u8_9 STR_enov_slnk_u8_10 STR_enov_slnk_u8_11 STR_enov_slnk_u8_12 STR_enov_slnk_u8_13 STR_enov_slnk_u8_14 STR_enov_slnk_u8_15 STR_enov_slnk_u8_16 STR_enov_slnk_u8_17 STR_enov_slnk_u8_18 STR_enov_slnk_u8_19 STR_enov_slnk_u8_20 STR_enov_slnk_f_1 STR_enov_slnk_f_2 STR_enov_slnk_f_3 STR_enov_slnk_f_4 STR_enov_slnk_f_5 STR_enov_slnk_f_6 STR_enov_slnk_f_7 STR_enov_slnk_f_8 STR_enov_slnk_f_9 STR_enov_slnk_f_10 STR_enov_slnk_f_11 STR_enov_slnk_f_12 STR_enov_slnk_f_13 STR_enov_slnk_f_14 STR_enov_slnk_f_15 STR_enov_slnk_f_16 STR_enov_slnk_f_17 STR_enov_slnk_f_18 STR_enov_slnk_f_19 STR_enov_slnk_f_20 /end REF_MEASUREMENT
/end GROUP
/begin GROUP EC_SparkCal "ECONTROLS" ROOT
 /begin REF_CHARACTERISTIC spk_adv_dz spk_adv_dz_tau dwell_adpt_ena dwell_a_min dwell_a_max dwell_inc_K dwell_inc_max dwell_d_amp dwell_def dwell_min dwell_max dwell_shorted spk_min_dissipate dwell_crk_add dwell_crk_rpm dwell_min_Vbat dwell_a_prefire_samp dwell_crk_max_accel SPKD_short_trig dwell_sense1_source dwell_sense2_source dwell_sense3_source dwell_sense4_source dwell_sense5_source dwell_sense6_source dwell_sense7_source dwell_sense8_source dwell_sense9_source dwell_sense10_source spkmon_min_dissipate SPK_IGBT_T_Timer Tspka_base_CAD dwell_nom_tbl dwell_ls_mult /end REF_CHARACTERISTIC
 /begin REF_MEASUREMENT spk_max_ECT dwell_OL dwell1_adapt dwell2_adapt dwell3_adapt spk_adv_crk CrkTT_dcy_t coil1_drv_latch coil2_drv_latch coil3_drv_latch coil4_drv_latch coil5_drv_latch coil6_drv_latch coil7_drv_latch coil8_drv_latch dwell_crk_min dwell4_adapt dwell5_adapt dwell6_adapt dwell7_adapt dwell8_adapt dwell_samp_cnt dwell_extmod_cnt dwell_open_i dwell_short_i coil9_drv_latch coil10_drv_latch dwell9_adapt dwell10_adapt dwell_d_amp_ls dwell_extmod_coils SPK_IGBT_T /end REF_MEASUREMENT
/end GROUP
/begin GROUP EC_SparkCalLP "ECONTROLS" ROOT
 /begin REF_CHARACTERISTIC CWTretLP_posC CWTretLP_negC CWTret_poslim CWTret_neglim Tspka_baseP_CAD Tspko_ECTvLP_CAD Tspko_MATvLP_CAD TspkMATMAPrmultLP /end REF_CHARACTERISTIC
 /begin REF_MEASUREMENT spk_max_ECT VE_CWT_crct_pct /end REF_MEASUREMENT
/end GROUP
/begin GROUP EC_SparkCalNG "ECONTROLS" ROOT /begin REF_CHARACTERISTIC CWTret_poslim CWTret_neglim /end REF_CHARACTERISTIC /begin REF_MEASUREMENT spk_max_ECT VE_CWT_crct_pct /end REF_MEASUREMENT /end GROUP
/begin GROUP EC_SparkOfst "ECONTROLS" ROOT /begin REF_CHARACTERISTIC CWTretLP_posC CWTretLP_negC CWTret_poslim CWTret_neglim /end REF_CHARACTERISTIC /begin REF_MEASUREMENT spk_max_ECT VE_CWT_crct_pct /end REF_MEASUREMENT /end GROUP
/begin GROUP EC_Starting "ECONTROLS" ROOT /begin REF_MEASUREMENT spk_adv_crk CrkTT_dcy_t /end REF_MEASUREMENT /end GROUP
/begin GROUP EC_VECal "ECONTROLS" ROOT /begin REF_MEASUREMENT VE_CWT_crct_pct /end REF_MEASUREMENT /end GROUP
/end MODULE
/end PROJECT
