ASAP2_VERSION 1 61
/begin PROJECT Econtrols_4G "4G Test"
/begin HEADER "4G A2L Configuration" PROJECT_NO EControls4G /* config for version control */ VERSION "$Revision: 82130 $:" /* config for version control */ /end HEADER
/begin MODULE EControls_4G_SH2A "EControls 4G"
/begin MOD_COMMON "" DEPOSIT ABSOLUTE BYTE_ORDER MSB_FIRST /end MOD_COMMON
/* Define the Record Layouts */
/begin RECORD_LAYOUT ECIPP_ALIGNMENT_UBYTE FNC_VALUES 1 UBYTE COLUMN_DIR DIRECT /end RECORD_LAYOUT
/begin RECORD_LAYOUT ECIPP_ALIGNMENT_UWORD FNC_VALUES 1 UWORD COLUMN_DIR DIRECT /end RECORD_LAYOUT
/begin RECORD_LAYOUT ECIPP_ALIGNMENT_ULONG FNC_VALUES 1 ULONG COLUMN_DIR DIRECT /end RECORD_LAYOUT
/begin RECORD_LAYOUT ECIPP_ALIGNMENT_FLOAT32_IEEE FNC_VALUES 1 FLOAT32_IEEE COLUMN_DIR DIRECT /end RECORD_LAYOUT
/begin COMPU_METHOD Compu_IDENTITY "Discrete Values " /* Identifier */ IDENTICAL "%.0" /* Format */ "-" /* Units */ /end COMPU_METHOD
/begin CHARACTERISTIC FCdc4_TAUX2_max "FCtl_DTC_0x04(552)" VALUE 0x00164020 /* @ECU_Address@FCtl_DTC_0x04@0x024C4450@ */ ECIPP_ALIGNMENT_UWORD 65535 Compu_IDENTITY 0 65535 PHYS_UNIT "System ID + DTC" /end CHARACTERISTIC
/begin CHARACTERISTIC FCdc4_TAUX2_min "FCtl_DTC_0x04(553)" VALUE 0x00164022 /* @ECU_Address@FCtl_DTC_0x04@0x024C4452@ */ ECIPP_ALIGNMENT_UWORD 65535 Compu_IDENTITY 0 65535 PHYS_UNIT "System ID + DTC" /end CHARACTERISTIC
/begin CHARACTERISTIC FCdc4_TAUX3_max "FCtl_DTC_0x04(554)" VALUE 0x00164024 /* @ECU_Address@FCtl_DTC_0x04@0x024C4454@ */ ECIPP_ALIGNMENT_UWORD 65535 Compu_IDENTITY 0 65535 PHYS_UNIT "System ID + DTC" /end CHARACTERISTIC
/begin CHARACTERISTIC FCdc4_TAUX3_min "FCtl_DTC_0x04(555)" VALUE 0x00164026 /* @ECU_Address@FCtl_DTC_0x04@0x024C4456@ */ ECIPP_ALIGNMENT_UWORD 65535 Compu_IDENTITY 0 65535 PHYS_UNIT "System ID + DTC" /end CHARACTERISTIC
/begin CHARACTERISTIC FCdc4_TAUX4_max "FCtl_DTC_0x04(556)" VALUE 0x00164028 /* @ECU_Address@FCtl_DTC_0x04@0x024C4458@ */ ECIPP_ALIGNMENT_UWORD 65535 Compu_IDENTITY 0 65535 PHYS_UNIT "System ID + DTC" /end CHARACTERISTIC
/begin CHARACTERISTIC FCdc4_TAUX4_min "FCtl_DTC_0x04(557)" VALUE 0x0016402A /* @ECU_Address@FCtl_DTC_0x04@0x024C445A@ */ ECIPP_ALIGNMENT_UWORD 65535 Compu_IDENTITY 0 65535 PHYS_UNIT "System ID + DTC" /end CHARACTERISTIC
/begin CHARACTERISTIC FCdc4_TEL_derate_actv "FCtl_DTC_0x04(647)" VALUE 0x001640DE /* @ECU_Address@FCtl_DTC_0x04@0x024C450E@ */ ECIPP_ALIGNMENT_UWORD 65535 Compu_IDENTITY 0 65535 PHYS_UNIT "System ID + DTC" /end CHARACTERISTIC
/begin CHARACTERISTIC FCdc4_TEL_dis "FCtl_DTC_0x04(854)" VALUE 0x0016427C /* @ECU_Address@FCtl_DTC_0x04@0x024C46AC@ */ ECIPP_ALIGNMENT_UWORD 65535 Compu_IDENTITY 0 65535 PHYS_UNIT "System ID + DTC" /end CHARACTERISTIC
/begin CHARACTERISTIC FCdc4_TEL_intF "FCtl_DTC_0x04(855)" VALUE 0x0016427E /* @ECU_Address@FCtl_DTC_0x04@0x024C46AE@ */ ECIPP_ALIGNMENT_UWORD 65535 Compu_IDENTITY 0 65535 PHYS_UNIT "System ID + DTC" /end CHARACTERISTIC
/begin CHARACTERISTIC FCdc4_TEL_key_invalid "FCtl_DTC_0x04(821)" VALUE 0x0016423A /* @ECU_Address@FCtl_DTC_0x04@0x024C466A@ */ ECIPP_ALIGNMENT_UWORD 65535 Compu_IDENTITY 0 65535 PHYS_UNIT "System ID + DTC" /end CHARACTERISTIC
/begin CHARACTERISTIC FCdc4_TEL_key_to "FCtl_DTC_0x04(820)" VALUE 0x00164238 /* @ECU_Address@FCtl_DTC_0x04@0x024C4668@ */ ECIPP_ALIGNMENT_UWORD 65535 Compu_IDENTITY 0 65535 PHYS_UNIT "System ID + DTC" /end CHARACTERISTIC
/begin CHARACTERISTIC FCdc4_TEL_req_to "FCtl_DTC_0x04(819)" VALUE 0x00164236 /* @ECU_Address@FCtl_DTC_0x04@0x024C4666@ */ ECIPP_ALIGNMENT_UWORD 65535 Compu_IDENTITY 0 65535 PHYS_UNIT "System ID + DTC" /end CHARACTERISTIC
/begin CHARACTERISTIC FCdc4_TEL_RPM_cmd "FCtl_DTC_0x04(822)" VALUE 0x0016423C /* @ECU_Address@FCtl_DTC_0x04@0x024C466C@ */ ECIPP_ALIGNMENT_UWORD 65535 Compu_IDENTITY 0 65535 PHYS_UNIT "System ID + DTC" /end CHARACTERISTIC
/begin CHARACTERISTIC FCdc4_TEL_RPM_psv "FCtl_DTC_0x04(825)" VALUE 0x00164242 /* @ECU_Address@FCtl_DTC_0x04@0x024C4672@ */ ECIPP_ALIGNMENT_UWORD 65535 Compu_IDENTITY 0 65535 PHYS_UNIT "System ID + DTC" /end CHARACTERISTIC
/begin CHARACTERISTIC FCdc4_TEL_shutdown_cmd "FCtl_DTC_0x04(824)" VALUE 0x00164240 /* @ECU_Address@FCtl_DTC_0x04@0x024C4670@ */ ECIPP_ALIGNMENT_UWORD 65535 Compu_IDENTITY 0 65535 PHYS_UNIT "System ID + DTC" /end CHARACTERISTIC
/begin CHARACTERISTIC FCdc4_TEL_shutdown_psv "FCtl_DTC_0x04(827)" VALUE 0x00164246 /* @ECU_Address@FCtl_DTC_0x04@0x024C4676@ */ ECIPP_ALIGNMENT_UWORD 65535 Compu_IDENTITY 0 65535 PHYS_UNIT "System ID + DTC" /end CHARACTERISTIC
/begin CHARACTERISTIC FCdc4_TEL_torq_cmd "FCtl_DTC_0x04(823)" VALUE 0x0016423E /* @ECU_Address@FCtl_DTC_0x04@0x024C466E@ */ ECIPP_ALIGNMENT_UWORD 65535 Compu_IDENTITY 0 65535 PHYS_UNIT "System ID + DTC" /end CHARACTERISTIC
/begin CHARACTERISTIC FCdc4_TEL_torq_psv "FCtl_DTC_0x04(826)" VALUE 0x00164244 /* @ECU_Address@FCtl_DTC_0x04@0x024C4674@ */ ECIPP_ALIGNMENT_UWORD 65535 Compu_IDENTITY 0 65535 PHYS_UNIT "System ID + DTC" /end CHARACTERISTIC
/begin CHARACTERISTIC FCdc4_TIP_act "FCtl_DTC_0x04(145)" VALUE 0x00163CF2 /* @ECU_Address@FCtl_DTC_0x04@0x024C4122@ */ ECIPP_ALIGNMENT_UWORD 65535 Compu_IDENTITY 0 65535 PHYS_UNIT "System ID + DTC" /end CHARACTERISTIC
/begin CHARACTERISTIC FCdc4_TIP_maxv "FCtl_DTC_0x04(126)" VALUE 0x00163CCC /* @ECU_Address@FCtl_DTC_0x04@0x024C40FC@ */ ECIPP_ALIGNMENT_UWORD 65535 Compu_IDENTITY 0 65535 PHYS_UNIT "System ID + DTC" /end CHARACTERISTIC
/begin CHARACTERISTIC FCdc4_TIP_minv "FCtl_DTC_0x04(127)" VALUE 0x00163CCE /* @ECU_Address@FCtl_DTC_0x04@0x024C40FE@ */ ECIPP_ALIGNMENT_UWORD 65535 Compu_IDENTITY 0 65535 PHYS_UNIT "System ID + DTC" /end CHARACTERISTIC
/begin CHARACTERISTIC FCdc4_TPS1_max "FCtl_DTC_0x04(13)" VALUE 0x00163BEA /* @ECU_Address@FCtl_DTC_0x04@0x024C401A@ */ ECIPP_ALIGNMENT_UWORD 65535 Compu_IDENTITY 0 65535 PHYS_UNIT "System ID + DTC" /end CHARACTERISTIC
/begin CHARACTERISTIC FCdc4_TPS1_min "FCtl_DTC_0x04(14)" VALUE 0x00163BEC /* @ECU_Address@FCtl_DTC_0x04@0x024C401C@ */ ECIPP_ALIGNMENT_UWORD 65535 Compu_IDENTITY 0 65535 PHYS_UNIT "System ID + DTC" /end CHARACTERISTIC
/begin CHARACTERISTIC FCdc4_TPS12_OOR "FCtl_DTC_0x04(186)" VALUE 0x00163D44 /* @ECU_Address@FCtl_DTC_0x04@0x024C4174@ */ ECIPP_ALIGNMENT_UWORD 65535 Compu_IDENTITY 0 65535 PHYS_UNIT "System ID + DTC" /end CHARACTERISTIC
/begin CHARACTERISTIC FCdc4_TPS12pct_hi "FCtl_DTC_0x04(17)" VALUE 0x00163BF2 /* @ECU_Address@FCtl_DTC_0x04@0x024C4022@ */ ECIPP_ALIGNMENT_UWORD 65535 Compu_IDENTITY 0 65535 PHYS_UNIT "System ID + DTC" /end CHARACTERISTIC
/begin CHARACTERISTIC FCdc4_TPS12pct_lo "FCtl_DTC_0x04(18)" VALUE 0x00163BF4 /* @ECU_Address@FCtl_DTC_0x04@0x024C4024@ */ ECIPP_ALIGNMENT_UWORD 65535 Compu_IDENTITY 0 65535 PHYS_UNIT "System ID + DTC" /end CHARACTERISTIC
/begin CHARACTERISTIC FCdc4_TPS2_max "FCtl_DTC_0x04(15)" VALUE 0x00163BEE /* @ECU_Address@FCtl_DTC_0x04@0x024C401E@ */ ECIPP_ALIGNMENT_UWORD 65535 Compu_IDENTITY 0 65535 PHYS_UNIT "System ID + DTC" /end CHARACTERISTIC
/begin CHARACTERISTIC FCdc4_TPS2_min "FCtl_DTC_0x04(16)" VALUE 0x00163BF0 /* @ECU_Address@FCtl_DTC_0x04@0x024C4020@ */ ECIPP_ALIGNMENT_UWORD 65535 Compu_IDENTITY 0 65535 PHYS_UNIT "System ID + DTC" /end CHARACTERISTIC
/begin CHARACTERISTIC FCdc4_TPSerr_neg "FCtl_DTC_0x04(91)" VALUE 0x00163C86 /* @ECU_Address@FCtl_DTC_0x04@0x024C40B6@ */ ECIPP_ALIGNMENT_UWORD 65535 Compu_IDENTITY 0 65535 PHYS_UNIT "System ID + DTC" /end CHARACTERISTIC
/begin CHARACTERISTIC FCdc4_TPSerr_pos "FCtl_DTC_0x04(90)" VALUE 0x00163C84 /* @ECU_Address@FCtl_DTC_0x04@0x024C40B4@ */ ECIPP_ALIGNMENT_UWORD 65535 Compu_IDENTITY 0 65535 PHYS_UNIT "System ID + DTC" /end CHARACTERISTIC
/begin CHARACTERISTIC FCdc4_TRANS_comm "FCtl_DTC_0x04(851)" VALUE 0x00164276 /* @ECU_Address@FCtl_DTC_0x04@0x024C46A6@ */ ECIPP_ALIGNMENT_UWORD 65535 Compu_IDENTITY 0 65535 PHYS_UNIT "System ID + DTC" /end CHARACTERISTIC
/begin CHARACTERISTIC FCdc4_TRANS_fuel_inh "FCtl_DTC_0x04(852)" VALUE 0x00164278 /* @ECU_Address@FCtl_DTC_0x04@0x024C46A8@ */ ECIPP_ALIGNMENT_UWORD 65535 Compu_IDENTITY 0 65535 PHYS_UNIT "System ID + DTC" /end CHARACTERISTIC
/begin CHARACTERISTIC FCdc4_TWCDiag_OSC_lo "FCtl_DTC_0x04(804)" VALUE 0x00164218 /* @ECU_Address@FCtl_DTC_0x04@0x024C4648@ */ ECIPP_ALIGNMENT_UWORD 65535 Compu_IDENTITY 0 65535 PHYS_UNIT "System ID + DTC" /end CHARACTERISTIC
/begin CHARACTERISTIC FCdc4_UEGOH1_off_open "FCtl_DTC_0x04(427)" VALUE 0x00163F26 /* @ECU_Address@FCtl_DTC_0x04@0x024C4356@ */ ECIPP_ALIGNMENT_UWORD 65535 Compu_IDENTITY 0 65535 PHYS_UNIT "System ID + DTC" /end CHARACTERISTIC
/begin CHARACTERISTIC FCdc4_UEGOH1_on_short "FCtl_DTC_0x04(428)" VALUE 0x00163F28 /* @ECU_Address@FCtl_DTC_0x04@0x024C4358@ */ ECIPP_ALIGNMENT_UWORD 65535 Compu_IDENTITY 0 65535 PHYS_UNIT "System ID + DTC" /end CHARACTERISTIC
/begin CHARACTERISTIC FCdc4_UEGOH2_off_open "FCtl_DTC_0x04(429)" VALUE 0x00163F2A /* @ECU_Address@FCtl_DTC_0x04@0x024C435A@ */ ECIPP_ALIGNMENT_UWORD 65535 Compu_IDENTITY 0 65535 PHYS_UNIT "System ID + DTC" /end CHARACTERISTIC
/begin CHARACTERISTIC FCdc4_UEGOH2_on_short "FCtl_DTC_0x04(430)" VALUE 0x00163F2C /* @ECU_Address@FCtl_DTC_0x04@0x024C435C@ */ ECIPP_ALIGNMENT_UWORD 65535 Compu_IDENTITY 0 65535 PHYS_UNIT "System ID + DTC" /end CHARACTERISTIC
/begin CHARACTERISTIC FCdc4_UEGOH3_off_open "FCtl_DTC_0x04(622)" VALUE 0x001640AC /* @ECU_Address@FCtl_DTC_0x04@0x024C44DC@ */ ECIPP_ALIGNMENT_UWORD 65535 Compu_IDENTITY 0 65535 PHYS_UNIT "System ID + DTC" /end CHARACTERISTIC
/begin CHARACTERISTIC FCdc4_UEGOH3_on_short "FCtl_DTC_0x04(623)" VALUE 0x001640AE /* @ECU_Address@FCtl_DTC_0x04@0x024C44DE@ */ ECIPP_ALIGNMENT_UWORD 65535 Compu_IDENTITY 0 65535 PHYS_UNIT "System ID + DTC" /end CHARACTERISTIC
/begin CHARACTERISTIC FCdc4_UEGOH4_off_open "FCtl_DTC_0x04(645)" VALUE 0x001640DA /* @ECU_Address@FCtl_DTC_0x04@0x024C450A@ */ ECIPP_ALIGNMENT_UWORD 65535 Compu_IDENTITY 0 65535 PHYS_UNIT "System ID + DTC" /end CHARACTERISTIC
/begin CHARACTERISTIC FCdc4_UEGOH4_on_short "FCtl_DTC_0x04(646)" VALUE 0x001640DC /* @ECU_Address@FCtl_DTC_0x04@0x024C450C@ */ ECIPP_ALIGNMENT_UWORD 65535 Compu_IDENTITY 0 65535 PHYS_UNIT "System ID + DTC" /end CHARACTERISTIC
/begin CHARACTERISTIC FCdc4_UGF_Hv_hi "FCtl_DTC_0x04(242)" VALUE 0x00163DB4 /* @ECU_Address@FCtl_DTC_0x04@0x024C41E4@ */ ECIPP_ALIGNMENT_UWORD 65535 Compu_IDENTITY 0 65535 PHYS_UNIT "System ID + DTC" /end CHARACTERISTIC
/begin CHARACTERISTIC FCdc4_UGF_internal "FCtl_DTC_0x04(241)" VALUE 0x00163DB2 /* @ECU_Address@FCtl_DTC_0x04@0x024C41E2@ */ ECIPP_ALIGNMENT_UWORD 65535 Compu_IDENTITY 0 65535 PHYS_UNIT "System ID + DTC" /end CHARACTERISTIC
/begin CHARACTERISTIC FCdc4_UGF_lowsupply "FCtl_DTC_0x04(530)" VALUE 0x00163FF4 /* @ECU_Address@FCtl_DTC_0x04@0x024C4424@ */ ECIPP_ALIGNMENT_UWORD 65535 Compu_IDENTITY 0 65535 PHYS_UNIT "System ID + DTC" /end CHARACTERISTIC
/begin CHARACTERISTIC FCdc4_UGF1_comm_lost "FCtl_DTC_0x04(680)" VALUE 0x00164120 /* @ECU_Address@FCtl_DTC_0x04@0x024C4550@ */ ECIPP_ALIGNMENT_UWORD 65535 Compu_IDENTITY 0 65535 PHYS_UNIT "System ID + DTC" /end CHARACTERISTIC
/begin CHARACTERISTIC FCdc4_UGF1_drifttl2 "FCtl_DTC_0x04(536)" VALUE 0x00164000 /* @ECU_Address@FCtl_DTC_0x04@0x024C4430@ */ ECIPP_ALIGNMENT_UWORD 65535 Compu_IDENTITY 0 65535 PHYS_UNIT "System ID + DTC" /end CHARACTERISTIC
/begin CHARACTERISTIC FCdc4_UGF1_drifttol "FCtl_DTC_0x04(505)" VALUE 0x00163FC2 /* @ECU_Address@FCtl_DTC_0x04@0x024C43F2@ */ ECIPP_ALIGNMENT_UWORD 65535 Compu_IDENTITY 0 65535 PHYS_UNIT "System ID + DTC" /end CHARACTERISTIC
/begin CHARACTERISTIC FCdc4_UGF1_R_hi "FCtl_DTC_0x04(244)" VALUE 0x00163DB8 /* @ECU_Address@FCtl_DTC_0x04@0x024C41E8@ */ ECIPP_ALIGNMENT_UWORD 65535 Compu_IDENTITY 0 65535 PHYS_UNIT "System ID + DTC" /end CHARACTERISTIC
/begin CHARACTERISTIC FCdc4_UGF1_SR_hi "FCtl_DTC_0x04(256)" VALUE 0x00163DD0 /* @ECU_Address@FCtl_DTC_0x04@0x024C4200@ */ ECIPP_ALIGNMENT_UWORD 65535 Compu_IDENTITY 0 65535 PHYS_UNIT "System ID + DTC" /end CHARACTERISTIC
/begin CHARACTERISTIC FCdc4_UGF1_SR_slow "FCtl_DTC_0x04(254)" VALUE 0x00163DCC /* @ECU_Address@FCtl_DTC_0x04@0x024C41FC@ */ ECIPP_ALIGNMENT_UWORD 65535 Compu_IDENTITY 0 65535 PHYS_UNIT "System ID + DTC" /end CHARACTERISTIC
/begin CHARACTERISTIC FCdc4_UGF1_Sv_hi "FCtl_DTC_0x04(250)" VALUE 0x00163DC4 /* @ECU_Address@FCtl_DTC_0x04@0x024C41F4@ */ ECIPP_ALIGNMENT_UWORD 65535 Compu_IDENTITY 0 65535 PHYS_UNIT "System ID + DTC" /end CHARACTERISTIC
/begin CHARACTERISTIC FCdc4_UGF2_comm_lost "FCtl_DTC_0x04(681)" VALUE 0x00164122 /* @ECU_Address@FCtl_DTC_0x04@0x024C4552@ */ ECIPP_ALIGNMENT_UWORD 65535 Compu_IDENTITY 0 65535 PHYS_UNIT "System ID + DTC" /end CHARACTERISTIC
/begin CHARACTERISTIC FCdc4_UGF2_drifttl2 "FCtl_DTC_0x04(537)" VALUE 0x00164002 /* @ECU_Address@FCtl_DTC_0x04@0x024C4432@ */ ECIPP_ALIGNMENT_UWORD 65535 Compu_IDENTITY 0 65535 PHYS_UNIT "System ID + DTC" /end CHARACTERISTIC
/begin CHARACTERISTIC FCdc4_UGF2_drifttol "FCtl_DTC_0x04(506)" VALUE 0x00163FC4 /* @ECU_Address@FCtl_DTC_0x04@0x024C43F4@ */ ECIPP_ALIGNMENT_UWORD 65535 Compu_IDENTITY 0 65535 PHYS_UNIT "System ID + DTC" /end CHARACTERISTIC
/begin CHARACTERISTIC FCdc4_UGF2_Hv_hi "FCtl_DTC_0x04(409)" VALUE 0x00163F02 /* @ECU_Address@FCtl_DTC_0x04@0x024C4332@ */ ECIPP_ALIGNMENT_UWORD 65535 Compu_IDENTITY 0 65535 PHYS_UNIT "System ID + DTC" /end CHARACTERISTIC
/begin CHARACTERISTIC FCdc4_UGF2_internal "FCtl_DTC_0x04(408)" VALUE 0x00163F00 /* @ECU_Address@FCtl_DTC_0x04@0x024C4330@ */ ECIPP_ALIGNMENT_UWORD 65535 Compu_IDENTITY 0 65535 PHYS_UNIT "System ID + DTC" /end CHARACTERISTIC
/begin CHARACTERISTIC FCdc4_UGF2_lowsupply "FCtl_DTC_0x04(531)" VALUE 0x00163FF6 /* @ECU_Address@FCtl_DTC_0x04@0x024C4426@ */ ECIPP_ALIGNMENT_UWORD 65535 Compu_IDENTITY 0 65535 PHYS_UNIT "System ID + DTC" /end CHARACTERISTIC
/begin CHARACTERISTIC FCdc4_UGF2_R_hi "FCtl_DTC_0x04(411)" VALUE 0x00163F06 /* @ECU_Address@FCtl_DTC_0x04@0x024C4336@ */ ECIPP_ALIGNMENT_UWORD 65535 Compu_IDENTITY 0 65535 PHYS_UNIT "System ID + DTC" /end CHARACTERISTIC
/begin CHARACTERISTIC FCdc4_UGF2_SR_hi "FCtl_DTC_0x04(423)" VALUE 0x00163F1E /* @ECU_Address@FCtl_DTC_0x04@0x024C434E@ */ ECIPP_ALIGNMENT_UWORD 65535 Compu_IDENTITY 0 65535 PHYS_UNIT "System ID + DTC" /end CHARACTERISTIC
/begin CHARACTERISTIC FCdc4_UGF2_SR_slow "FCtl_DTC_0x04(421)" VALUE 0x00163F1A /* @ECU_Address@FCtl_DTC_0x04@0x024C434A@ */ ECIPP_ALIGNMENT_UWORD 65535 Compu_IDENTITY 0 65535 PHYS_UNIT "System ID + DTC" /end CHARACTERISTIC
/begin CHARACTERISTIC FCdc4_UGF2_Sv_hi "FCtl_DTC_0x04(417)" VALUE 0x00163F12 /* @ECU_Address@FCtl_DTC_0x04@0x024C4342@ */ ECIPP_ALIGNMENT_UWORD 65535 Compu_IDENTITY 0 65535 PHYS_UNIT "System ID + DTC" /end CHARACTERISTIC
/begin CHARACTERISTIC FCdc4_UGF3_comm_lost "FCtl_DTC_0x04(682)" VALUE 0x00164124 /* @ECU_Address@FCtl_DTC_0x04@0x024C4554@ */ ECIPP_ALIGNMENT_UWORD 65535 Compu_IDENTITY 0 65535 PHYS_UNIT "System ID + DTC" /end CHARACTERISTIC
/begin CHARACTERISTIC FCdc4_UGF3_drifttl2 "FCtl_DTC_0x04(604)" VALUE 0x00164088 /* @ECU_Address@FCtl_DTC_0x04@0x024C44B8@ */ ECIPP_ALIGNMENT_UWORD 65535 Compu_IDENTITY 0 65535 PHYS_UNIT "System ID + DTC" /end CHARACTERISTIC
/begin CHARACTERISTIC FCdc4_UGF3_drifttol "FCtl_DTC_0x04(603)" VALUE 0x00164086 /* @ECU_Address@FCtl_DTC_0x04@0x024C44B6@ */ ECIPP_ALIGNMENT_UWORD 65535 Compu_IDENTITY 0 65535 PHYS_UNIT "System ID + DTC" /end CHARACTERISTIC
/begin CHARACTERISTIC FCdc4_UGF3_Hv_hi "FCtl_DTC_0x04(605)" VALUE 0x0016408A /* @ECU_Address@FCtl_DTC_0x04@0x024C44BA@ */ ECIPP_ALIGNMENT_UWORD 65535 Compu_IDENTITY 0 65535 PHYS_UNIT "System ID + DTC" /end CHARACTERISTIC
/begin CHARACTERISTIC FCdc4_UGF3_internal "FCtl_DTC_0x04(601)" VALUE 0x00164082 /* @ECU_Address@FCtl_DTC_0x04@0x024C44B2@ */ ECIPP_ALIGNMENT_UWORD 65535 Compu_IDENTITY 0 65535 PHYS_UNIT "System ID + DTC" /end CHARACTERISTIC
/begin CHARACTERISTIC FCdc4_UGF3_lowsupply "FCtl_DTC_0x04(602)" VALUE 0x00164084 /* @ECU_Address@FCtl_DTC_0x04@0x024C44B4@ */ ECIPP_ALIGNMENT_UWORD 65535 Compu_IDENTITY 0 65535 PHYS_UNIT "System ID + DTC" /end CHARACTERISTIC
/begin CHARACTERISTIC FCdc4_UGF3_R_hi "FCtl_DTC_0x04(607)" VALUE 0x0016408E /* @ECU_Address@FCtl_DTC_0x04@0x024C44BE@ */ ECIPP_ALIGNMENT_UWORD 65535 Compu_IDENTITY 0 65535 PHYS_UNIT "System ID + DTC" /end CHARACTERISTIC
/begin CHARACTERISTIC FCdc4_UGF3_SR_hi "FCtl_DTC_0x04(619)" VALUE 0x001640A6 /* @ECU_Address@FCtl_DTC_0x04@0x024C44D6@ */ ECIPP_ALIGNMENT_UWORD 65535 Compu_IDENTITY 0 65535 PHYS_UNIT "System ID + DTC" /end CHARACTERISTIC
/begin CHARACTERISTIC FCdc4_UGF3_SR_slow "FCtl_DTC_0x04(617)" VALUE 0x001640A2 /* @ECU_Address@FCtl_DTC_0x04@0x024C44D2@ */ ECIPP_ALIGNMENT_UWORD 65535 Compu_IDENTITY 0 65535 PHYS_UNIT "System ID + DTC" /end CHARACTERISTIC
/begin CHARACTERISTIC FCdc4_UGF3_Sv_hi "FCtl_DTC_0x04(613)" VALUE 0x0016409A /* @ECU_Address@FCtl_DTC_0x04@0x024C44CA@ */ ECIPP_ALIGNMENT_UWORD 65535 Compu_IDENTITY 0 65535 PHYS_UNIT "System ID + DTC" /end CHARACTERISTIC
/begin CHARACTERISTIC FCdc4_UGF4_comm_lost "FCtl_DTC_0x04(683)" VALUE 0x00164126 /* @ECU_Address@FCtl_DTC_0x04@0x024C4556@ */ ECIPP_ALIGNMENT_UWORD 65535 Compu_IDENTITY 0 65535 PHYS_UNIT "System ID + DTC" /end CHARACTERISTIC
/begin CHARACTERISTIC FPnd_TAUX2_max "FPrm_pending(422)" VALUE 0x00164CB8 /* @ECU_Address@FPrm_pending@0x021BE34C@ */ ECIPP_ALIGNMENT_UWORD 65535 Compu_IDENTITY 0 65535 PHYS_UNIT "Bit Mask" /end CHARACTERISTIC
/begin CHARACTERISTIC FPnd_TAUX2_min "FPrm_pending(423)" VALUE 0x00164CBA /* @ECU_Address@FPrm_pending@0x021BE34E@ */ ECIPP_ALIGNMENT_UWORD 65535 Compu_IDENTITY 0 65535 PHYS_UNIT "Bit Mask" /end CHARACTERISTIC
/begin CHARACTERISTIC FPnd_TAUX3_max "FPrm_pending(424)" VALUE 0x00164CBC /* @ECU_Address@FPrm_pending@0x021BE350@ */ ECIPP_ALIGNMENT_UWORD 65535 Compu_IDENTITY 0 65535 PHYS_UNIT "Bit Mask" /end CHARACTERISTIC
/begin CHARACTERISTIC FPnd_TAUX3_min "FPrm_pending(425)" VALUE 0x00164CBE /* @ECU_Address@FPrm_pending@0x021BE352@ */ ECIPP_ALIGNMENT_UWORD 65535 Compu_IDENTITY 0 65535 PHYS_UNIT "Bit Mask" /end CHARACTERISTIC
/begin CHARACTERISTIC FPnd_TAUX4_max "FPrm_pending(426)" VALUE 0x00164CC0 /* @ECU_Address@FPrm_pending@0x021BE354@ */ ECIPP_ALIGNMENT_UWORD 65535 Compu_IDENTITY 0 65535 PHYS_UNIT "Bit Mask" /end CHARACTERISTIC
/begin CHARACTERISTIC FPnd_TAUX4_min "FPrm_pending(427)" VALUE 0x00164CC2 /* @ECU_Address@FPrm_pending@0x021BE356@ */ ECIPP_ALIGNMENT_UWORD 65535 Compu_IDENTITY 0 65535 PHYS_UNIT "Bit Mask" /end CHARACTERISTIC
/begin CHARACTERISTIC FPnd_TEL_derate_actv "FPrm_pending(477)" VALUE 0x00164D26 /* @ECU_Address@FPrm_pending@0x021BE3BA@ */ ECIPP_ALIGNMENT_UWORD 65535 Compu_IDENTITY 0 65535 PHYS_UNIT "Bit Mask" /end CHARACTERISTIC
/begin CHARACTERISTIC FPnd_TEL_dis "FPrm_pending(681)" VALUE 0x00164EBE /* @ECU_Address@FPrm_pending@0x021BE552@ */ ECIPP_ALIGNMENT_UWORD 65535 Compu_IDENTITY 0 65535 PHYS_UNIT "Bit Mask" /end CHARACTERISTIC
/begin CHARACTERISTIC FPnd_TEL_intF "FPrm_pending(682)" VALUE 0x00164EC0 /* @ECU_Address@FPrm_pending@0x021BE554@ */ ECIPP_ALIGNMENT_UWORD 65535 Compu_IDENTITY 0 65535 PHYS_UNIT "Bit Mask" /end CHARACTERISTIC
/begin CHARACTERISTIC FPnd_TEL_key_invalid "FPrm_pending(648)" VALUE 0x00164E7C /* @ECU_Address@FPrm_pending@0x021BE510@ */ ECIPP_ALIGNMENT_UWORD 65535 Compu_IDENTITY 0 65535 PHYS_UNIT "Bit Mask" /end CHARACTERISTIC
/begin CHARACTERISTIC FPnd_TEL_key_to "FPrm_pending(647)" VALUE 0x00164E7A /* @ECU_Address@FPrm_pending@0x021BE50E@ */ ECIPP_ALIGNMENT_UWORD 65535 Compu_IDENTITY 0 65535 PHYS_UNIT "Bit Mask" /end CHARACTERISTIC
/begin CHARACTERISTIC FPnd_TEL_req_to "FPrm_pending(646)" VALUE 0x00164E78 /* @ECU_Address@FPrm_pending@0x021BE50C@ */ ECIPP_ALIGNMENT_UWORD 65535 Compu_IDENTITY 0 65535 PHYS_UNIT "Bit Mask" /end CHARACTERISTIC
/begin CHARACTERISTIC FPnd_TEL_RPM_cmd "FPrm_pending(649)" VALUE 0x00164E7E /* @ECU_Address@FPrm_pending@0x021BE512@ */ ECIPP_ALIGNMENT_UWORD 65535 Compu_IDENTITY 0 65535 PHYS_UNIT "Bit Mask" /end CHARACTERISTIC
/begin CHARACTERISTIC FPnd_TEL_RPM_psv "FPrm_pending(652)" VALUE 0x00164E84 /* @ECU_Address@FPrm_pending@0x021BE518@ */ ECIPP_ALIGNMENT_UWORD 65535 Compu_IDENTITY 0 65535 PHYS_UNIT "Bit Mask" /end CHARACTERISTIC
/begin CHARACTERISTIC FPnd_TEL_shutdown_cmd "FPrm_pending(651)" VALUE 0x00164E82 /* @ECU_Address@FPrm_pending@0x021BE516@ */ ECIPP_ALIGNMENT_UWORD 65535 Compu_IDENTITY 0 65535 PHYS_UNIT "Bit Mask" /end CHARACTERISTIC
/begin CHARACTERISTIC FPnd_TEL_shutdown_psv "FPrm_pending(654)" VALUE 0x00164E88 /* @ECU_Address@FPrm_pending@0x021BE51C@ */ ECIPP_ALIGNMENT_UWORD 65535 Compu_IDENTITY 0 65535 PHYS_UNIT "Bit Mask" /end CHARACTERISTIC
/begin CHARACTERISTIC FPnd_TEL_torq_cmd "FPrm_pending(650)" VALUE 0x00164E80 /* @ECU_Address@FPrm_pending@0x021BE514@ */ ECIPP_ALIGNMENT_UWORD 65535 Compu_IDENTITY 0 65535 PHYS_UNIT "Bit Mask" /end CHARACTERISTIC
/begin CHARACTERISTIC FPnd_TEL_torq_psv "FPrm_pending(653)" VALUE 0x00164E86 /* @ECU_Address@FPrm_pending@0x021BE51A@ */ ECIPP_ALIGNMENT_UWORD 65535 Compu_IDENTITY 0 65535 PHYS_UNIT "Bit Mask" /end CHARACTERISTIC
/begin CHARACTERISTIC FPnd_TIP_act "FPrm_pending(105)" VALUE 0x00164A3E /* @ECU_Address@FPrm_pending@0x021BE0D2@ */ ECIPP_ALIGNMENT_UWORD 65535 Compu_IDENTITY 0 65535 PHYS_UNIT "Bit Mask" /end CHARACTERISTIC
/begin CHARACTERISTIC FPnd_TIP_maxv "FPrm_pending(85)" VALUE 0x00164A16 /* @ECU_Address@FPrm_pending@0x021BE0AA@ */ ECIPP_ALIGNMENT_UWORD 65535 Compu_IDENTITY 0 65535 PHYS_UNIT "Bit Mask" /end CHARACTERISTIC
/begin CHARACTERISTIC FPnd_TIP_minv "FPrm_pending(86)" VALUE 0x00164A18 /* @ECU_Address@FPrm_pending@0x021BE0AC@ */ ECIPP_ALIGNMENT_UWORD 65535 Compu_IDENTITY 0 65535 PHYS_UNIT "Bit Mask" /end CHARACTERISTIC
/begin CHARACTERISTIC FPnd_TPS1_max "FPrm_pending(18)" VALUE 0x00164990 /* @ECU_Address@FPrm_pending@0x021BE024@ */ ECIPP_ALIGNMENT_UWORD 65535 Compu_IDENTITY 0 65535 PHYS_UNIT "Bit Mask" /end CHARACTERISTIC
/begin CHARACTERISTIC FPnd_TPS1_min "FPrm_pending(19)" VALUE 0x00164992 /* @ECU_Address@FPrm_pending@0x021BE026@ */ ECIPP_ALIGNMENT_UWORD 65535 Compu_IDENTITY 0 65535 PHYS_UNIT "Bit Mask" /end CHARACTERISTIC
/begin CHARACTERISTIC FPnd_TPS12_OOR "FPrm_pending(144)" VALUE 0x00164A8C /* @ECU_Address@FPrm_pending@0x021BE120@ */ ECIPP_ALIGNMENT_UWORD 65535 Compu_IDENTITY 0 65535 PHYS_UNIT "Bit Mask" /end CHARACTERISTIC
/begin CHARACTERISTIC FPnd_TPS12pct_hi "FPrm_pending(22)" VALUE 0x00164998 /* @ECU_Address@FPrm_pending@0x021BE02C@ */ ECIPP_ALIGNMENT_UWORD 65535 Compu_IDENTITY 0 65535 PHYS_UNIT "Bit Mask" /end CHARACTERISTIC
/begin CHARACTERISTIC FPnd_TPS12pct_lo "FPrm_pending(23)" VALUE 0x0016499A /* @ECU_Address@FPrm_pending@0x021BE02E@ */ ECIPP_ALIGNMENT_UWORD 65535 Compu_IDENTITY 0 65535 PHYS_UNIT "Bit Mask" /end CHARACTERISTIC
/begin CHARACTERISTIC FPnd_TPS2_max "FPrm_pending(20)" VALUE 0x00164994 /* @ECU_Address@FPrm_pending@0x021BE028@ */ ECIPP_ALIGNMENT_UWORD 65535 Compu_IDENTITY 0 65535 PHYS_UNIT "Bit Mask" /end CHARACTERISTIC
/begin CHARACTERISTIC FPnd_TPS2_min "FPrm_pending(21)" VALUE 0x00164996 /* @ECU_Address@FPrm_pending@0x021BE02A@ */ ECIPP_ALIGNMENT_UWORD 65535 Compu_IDENTITY 0 65535 PHYS_UNIT "Bit Mask" /end CHARACTERISTIC
/begin CHARACTERISTIC FPnd_TPSerr_neg "FPrm_pending(25)" VALUE 0x0016499E /* @ECU_Address@FPrm_pending@0x021BE032@ */ ECIPP_ALIGNMENT_UWORD 65535 Compu_IDENTITY 0 65535 PHYS_UNIT "Bit Mask" /end CHARACTERISTIC
/begin CHARACTERISTIC FPnd_TPSerr_pos "FPrm_pending(24)" VALUE 0x0016499C /* @ECU_Address@FPrm_pending@0x021BE030@ */ ECIPP_ALIGNMENT_UWORD 65535 Compu_IDENTITY 0 65535 PHYS_UNIT "Bit Mask" /end CHARACTERISTIC
/begin CHARACTERISTIC FPnd_TRANS_comm "FPrm_pending(678)" VALUE 0x00164EB8 /* @ECU_Address@FPrm_pending@0x021BE54C@ */ ECIPP_ALIGNMENT_UWORD 65535 Compu_IDENTITY 0 65535 PHYS_UNIT "Bit Mask" /end CHARACTERISTIC
/begin CHARACTERISTIC FPnd_TRANS_fuel_inh "FPrm_pending(679)" VALUE 0x00164EBA /* @ECU_Address@FPrm_pending@0x021BE54E@ */ ECIPP_ALIGNMENT_UWORD 65535 Compu_IDENTITY 0 65535 PHYS_UNIT "Bit Mask" /end CHARACTERISTIC
/begin CHARACTERISTIC FPnd_TWCDiag_OSC_lo "FPrm_pending(633)" VALUE 0x00164E5E /* @ECU_Address@FPrm_pending@0x021BE4F2@ */ ECIPP_ALIGNMENT_UWORD 65535 Compu_IDENTITY 0 65535 PHYS_UNIT "Bit Mask" /end CHARACTERISTIC
/begin CHARACTERISTIC FPnd_UEGOH1_off_open "FPrm_pending(324)" VALUE 0x00164BF4 /* @ECU_Address@FPrm_pending@0x021BE288@ */ ECIPP_ALIGNMENT_UWORD 65535 Compu_IDENTITY 0 65535 PHYS_UNIT "Bit Mask" /end CHARACTERISTIC
/begin CHARACTERISTIC FPnd_UEGOH1_on_short "FPrm_pending(325)" VALUE 0x00164BF6 /* @ECU_Address@FPrm_pending@0x021BE28A@ */ ECIPP_ALIGNMENT_UWORD 65535 Compu_IDENTITY 0 65535 PHYS_UNIT "Bit Mask" /end CHARACTERISTIC
/begin CHARACTERISTIC FPnd_UEGOH2_off_open "FPrm_pending(326)" VALUE 0x00164BF8 /* @ECU_Address@FPrm_pending@0x021BE28C@ */ ECIPP_ALIGNMENT_UWORD 65535 Compu_IDENTITY 0 65535 PHYS_UNIT "Bit Mask" /end CHARACTERISTIC
/begin CHARACTERISTIC FPnd_UEGOH2_on_short "FPrm_pending(327)" VALUE 0x00164BFA /* @ECU_Address@FPrm_pending@0x021BE28E@ */ ECIPP_ALIGNMENT_UWORD 65535 Compu_IDENTITY 0 65535 PHYS_UNIT "Bit Mask" /end CHARACTERISTIC
/begin CHARACTERISTIC FPnd_UEGOH3_off_open "FPrm_pending(464)" VALUE 0x00164D0C /* @ECU_Address@FPrm_pending@0x021BE3A0@ */ ECIPP_ALIGNMENT_UWORD 65535 Compu_IDENTITY 0 65535 PHYS_UNIT "Bit Mask" /end CHARACTERISTIC
/begin CHARACTERISTIC FPnd_UEGOH3_on_short "FPrm_pending(465)" VALUE 0x00164D0E /* @ECU_Address@FPrm_pending@0x021BE3A2@ */ ECIPP_ALIGNMENT_UWORD 65535 Compu_IDENTITY 0 65535 PHYS_UNIT "Bit Mask" /end CHARACTERISTIC
/begin CHARACTERISTIC FPnd_UEGOH4_off_open "FPrm_pending(475)" VALUE 0x00164D22 /* @ECU_Address@FPrm_pending@0x021BE3B6@ */ ECIPP_ALIGNMENT_UWORD 65535 Compu_IDENTITY 0 65535 PHYS_UNIT "Bit Mask" /end CHARACTERISTIC
/begin CHARACTERISTIC FPnd_UEGOH4_on_short "FPrm_pending(476)" VALUE 0x00164D24 /* @ECU_Address@FPrm_pending@0x021BE3B8@ */ ECIPP_ALIGNMENT_UWORD 65535 Compu_IDENTITY 0 65535 PHYS_UNIT "Bit Mask" /end CHARACTERISTIC
/begin CHARACTERISTIC FPnd_UGF_Hv_hi "FPrm_pending(190)" VALUE 0x00164AE8 /* @ECU_Address@FPrm_pending@0x021BE17C@ */ ECIPP_ALIGNMENT_UWORD 65535 Compu_IDENTITY 0 65535 PHYS_UNIT "Bit Mask" /end CHARACTERISTIC
/begin CHARACTERISTIC FPnd_UGF_internal "FPrm_pending(189)" VALUE 0x00164AE6 /* @ECU_Address@FPrm_pending@0x021BE17A@ */ ECIPP_ALIGNMENT_UWORD 65535 Compu_IDENTITY 0 65535 PHYS_UNIT "Bit Mask" /end CHARACTERISTIC
/begin CHARACTERISTIC FPnd_UGF_lowsupply "FPrm_pending(400)" VALUE 0x00164C8C /* @ECU_Address@FPrm_pending@0x021BE320@ */ ECIPP_ALIGNMENT_UWORD 65535 Compu_IDENTITY 0 65535 PHYS_UNIT "Bit Mask" /end CHARACTERISTIC
/begin CHARACTERISTIC FPnd_UGF1_comm_lost "FPrm_pending(510)" VALUE 0x00164D68 /* @ECU_Address@FPrm_pending@0x021BE3FC@ */ ECIPP_ALIGNMENT_UWORD 65535 Compu_IDENTITY 0 65535 PHYS_UNIT "Bit Mask" /end CHARACTERISTIC
/begin CHARACTERISTIC FPnd_UGF1_drifttl2 "FPrm_pending(406)" VALUE 0x00164C98 /* @ECU_Address@FPrm_pending@0x021BE32C@ */ ECIPP_ALIGNMENT_UWORD 65535 Compu_IDENTITY 0 65535 PHYS_UNIT "Bit Mask" /end CHARACTERISTIC
/begin CHARACTERISTIC FPnd_UGF1_drifttol "FPrm_pending(384)" VALUE 0x00164C6C /* @ECU_Address@FPrm_pending@0x021BE300@ */ ECIPP_ALIGNMENT_UWORD 65535 Compu_IDENTITY 0 65535 PHYS_UNIT "Bit Mask" /end CHARACTERISTIC
/begin CHARACTERISTIC FPnd_UGF1_R_hi "FPrm_pending(191)" VALUE 0x00164AEA /* @ECU_Address@FPrm_pending@0x021BE17E@ */ ECIPP_ALIGNMENT_UWORD 65535 Compu_IDENTITY 0 65535 PHYS_UNIT "Bit Mask" /end CHARACTERISTIC
/begin CHARACTERISTIC FPnd_UGF1_SR_hi "FPrm_pending(194)" VALUE 0x00164AF0 /* @ECU_Address@FPrm_pending@0x021BE184@ */ ECIPP_ALIGNMENT_UWORD 65535 Compu_IDENTITY 0 65535 PHYS_UNIT "Bit Mask" /end CHARACTERISTIC
/begin CHARACTERISTIC FPnd_UGF1_SR_slow "FPrm_pending(193)" VALUE 0x00164AEE /* @ECU_Address@FPrm_pending@0x021BE182@ */ ECIPP_ALIGNMENT_UWORD 65535 Compu_IDENTITY 0 65535 PHYS_UNIT "Bit Mask" /end CHARACTERISTIC
/begin CHARACTERISTIC FPnd_UGF1_Sv_hi "FPrm_pending(192)" VALUE 0x00164AEC /* @ECU_Address@FPrm_pending@0x021BE180@ */ ECIPP_ALIGNMENT_UWORD 65535 Compu_IDENTITY 0 65535 PHYS_UNIT "Bit Mask" /end CHARACTERISTIC
/begin CHARACTERISTIC FPnd_UGF2_comm_lost "FPrm_pending(511)" VALUE 0x00164D6A /* @ECU_Address@FPrm_pending@0x021BE3FE@ */ ECIPP_ALIGNMENT_UWORD 65535 Compu_IDENTITY 0 65535 PHYS_UNIT "Bit Mask" /end CHARACTERISTIC
/begin CHARACTERISTIC FPnd_UGF2_drifttl2 "FPrm_pending(407)" VALUE 0x00164C9A /* @ECU_Address@FPrm_pending@0x021BE32E@ */ ECIPP_ALIGNMENT_UWORD 65535 Compu_IDENTITY 0 65535 PHYS_UNIT "Bit Mask" /end CHARACTERISTIC
/begin CHARACTERISTIC FPnd_UGF2_drifttol "FPrm_pending(385)" VALUE 0x00164C6E /* @ECU_Address@FPrm_pending@0x021BE302@ */ ECIPP_ALIGNMENT_UWORD 65535 Compu_IDENTITY 0 65535 PHYS_UNIT "Bit Mask" /end CHARACTERISTIC
/begin CHARACTERISTIC FPnd_UGF2_Hv_hi "FPrm_pending(318)" VALUE 0x00164BE8 /* @ECU_Address@FPrm_pending@0x021BE27C@ */ ECIPP_ALIGNMENT_UWORD 65535 Compu_IDENTITY 0 65535 PHYS_UNIT "Bit Mask" /end CHARACTERISTIC
/begin CHARACTERISTIC FPnd_UGF2_internal "FPrm_pending(317)" VALUE 0x00164BE6 /* @ECU_Address@FPrm_pending@0x021BE27A@ */ ECIPP_ALIGNMENT_UWORD 65535 Compu_IDENTITY 0 65535 PHYS_UNIT "Bit Mask" /end CHARACTERISTIC
/begin CHARACTERISTIC FPnd_UGF2_lowsupply "FPrm_pending(401)" VALUE 0x00164C8E /* @ECU_Address@FPrm_pending@0x021BE322@ */ ECIPP_ALIGNMENT_UWORD 65535 Compu_IDENTITY 0 65535 PHYS_UNIT "Bit Mask" /end CHARACTERISTIC
/begin CHARACTERISTIC FPnd_UGF2_R_hi "FPrm_pending(319)" VALUE 0x00164BEA /* @ECU_Address@FPrm_pending@0x021BE27E@ */ ECIPP_ALIGNMENT_UWORD 65535 Compu_IDENTITY 0 65535 PHYS_UNIT "Bit Mask" /end CHARACTERISTIC
/begin CHARACTERISTIC FPnd_UGF2_SR_hi "FPrm_pending(322)" VALUE 0x00164BF0 /* @ECU_Address@FPrm_pending@0x021BE284@ */ ECIPP_ALIGNMENT_UWORD 65535 Compu_IDENTITY 0 65535 PHYS_UNIT "Bit Mask" /end CHARACTERISTIC
/begin CHARACTERISTIC FPnd_UGF2_SR_slow "FPrm_pending(321)" VALUE 0x00164BEE /* @ECU_Address@FPrm_pending@0x021BE282@ */ ECIPP_ALIGNMENT_UWORD 65535 Compu_IDENTITY 0 65535 PHYS_UNIT "Bit Mask" /end CHARACTERISTIC
/begin CHARACTERISTIC FPnd_UGF2_Sv_hi "FPrm_pending(320)" VALUE 0x00164BEC /* @ECU_Address@FPrm_pending@0x021BE280@ */ ECIPP_ALIGNMENT_UWORD 65535 Compu_IDENTITY 0 65535 PHYS_UNIT "Bit Mask" /end CHARACTERISTIC
/begin CHARACTERISTIC FPnd_UGF3_comm_lost "FPrm_pending(512)" VALUE 0x00164D6C /* @ECU_Address@FPrm_pending@0x021BE400@ */ ECIPP_ALIGNMENT_UWORD 65535 Compu_IDENTITY 0 65535 PHYS_UNIT "Bit Mask" /end CHARACTERISTIC
/begin CHARACTERISTIC FPnd_UGF3_drifttl2 "FPrm_pending(458)" VALUE 0x00164D00 /* @ECU_Address@FPrm_pending@0x021BE394@ */ ECIPP_ALIGNMENT_UWORD 65535 Compu_IDENTITY 0 65535 PHYS_UNIT "Bit Mask" /end CHARACTERISTIC
/begin CHARACTERISTIC FPnd_UGF3_drifttol "FPrm_pending(457)" VALUE 0x00164CFE /* @ECU_Address@FPrm_pending@0x021BE392@ */ ECIPP_ALIGNMENT_UWORD 65535 Compu_IDENTITY 0 65535 PHYS_UNIT "Bit Mask" /end CHARACTERISTIC
/begin CHARACTERISTIC FPnd_UGF3_Hv_hi "FPrm_pending(459)" VALUE 0x00164D02 /* @ECU_Address@FPrm_pending@0x021BE396@ */ ECIPP_ALIGNMENT_UWORD 65535 Compu_IDENTITY 0 65535 PHYS_UNIT "Bit Mask" /end CHARACTERISTIC
/begin CHARACTERISTIC FPnd_UGF3_internal "FPrm_pending(455)" VALUE 0x00164CFA /* @ECU_Address@FPrm_pending@0x021BE38E@ */ ECIPP_ALIGNMENT_UWORD 65535 Compu_IDENTITY 0 65535 PHYS_UNIT "Bit Mask" /end CHARACTERISTIC
/begin CHARACTERISTIC FPnd_UGF3_lowsupply "FPrm_pending(456)" VALUE 0x00164CFC /* @ECU_Address@FPrm_pending@0x021BE390@ */ ECIPP_ALIGNMENT_UWORD 65535 Compu_IDENTITY 0 65535 PHYS_UNIT "Bit Mask" /end CHARACTERISTIC
/begin CHARACTERISTIC FPnd_UGF3_R_hi "FPrm_pending(460)" VALUE 0x00164D04 /* @ECU_Address@FPrm_pending@0x021BE398@ */ ECIPP_ALIGNMENT_UWORD 65535 Compu_IDENTITY 0 65535 PHYS_UNIT "Bit Mask" /end CHARACTERISTIC
/begin CHARACTERISTIC FPnd_UGF3_SR_hi "FPrm_pending(463)" VALUE 0x00164D0A /* @ECU_Address@FPrm_pending@0x021BE39E@ */ ECIPP_ALIGNMENT_UWORD 65535 Compu_IDENTITY 0 65535 PHYS_UNIT "Bit Mask" /end CHARACTERISTIC
/begin CHARACTERISTIC FPnd_UGF3_SR_slow "FPrm_pending(462)" VALUE 0x00164D08 /* @ECU_Address@FPrm_pending@0x021BE39C@ */ ECIPP_ALIGNMENT_UWORD 65535 Compu_IDENTITY 0 65535 PHYS_UNIT "Bit Mask" /end CHARACTERISTIC
/begin CHARACTERISTIC FPnd_UGF3_Sv_hi "FPrm_pending(461)" VALUE 0x00164D06 /* @ECU_Address@FPrm_pending@0x021BE39A@ */ ECIPP_ALIGNMENT_UWORD 65535 Compu_IDENTITY 0 65535 PHYS_UNIT "Bit Mask" /end CHARACTERISTIC
/begin CHARACTERISTIC FPnd_UGF4_comm_lost "FPrm_pending(513)" VALUE 0x00164D6E /* @ECU_Address@FPrm_pending@0x021BE402@ */ ECIPP_ALIGNMENT_UWORD 65535 Compu_IDENTITY 0 65535 PHYS_UNIT "Bit Mask" /end CHARACTERISTIC
/begin CHARACTERISTIC FPsvr_TAUX2_max "FPrm_severity(422)" VALUE 0x00165F84 /* @ECU_Address@FPrm_severity@0x024B31A6@ */ ECIPP_ALIGNMENT_UBYTE 255 Compu_IDENTITY 0 255 PHYS_UNIT "Severity+Class" /end CHARACTERISTIC
/begin CHARACTERISTIC FPsvr_TAUX2_min "FPrm_severity(423)" VALUE 0x00165F85 /* @ECU_Address@FPrm_severity@0x024B31A7@ */ ECIPP_ALIGNMENT_UBYTE 255 Compu_IDENTITY 0 255 PHYS_UNIT "Severity+Class" /end CHARACTERISTIC
/begin CHARACTERISTIC FPsvr_TAUX3_max "FPrm_severity(424)" VALUE 0x00165F86 /* @ECU_Address@FPrm_severity@0x024B31A8@ */ ECIPP_ALIGNMENT_UBYTE 255 Compu_IDENTITY 0 255 PHYS_UNIT "Severity+Class" /end CHARACTERISTIC
/begin CHARACTERISTIC FPsvr_TAUX3_min "FPrm_severity(425)" VALUE 0x00165F87 /* @ECU_Address@FPrm_severity@0x024B31A9@ */ ECIPP_ALIGNMENT_UBYTE 255 Compu_IDENTITY 0 255 PHYS_UNIT "Severity+Class" /end CHARACTERISTIC
/begin CHARACTERISTIC FPsvr_TAUX4_max "FPrm_severity(426)" VALUE 0x00165F88 /* @ECU_Address@FPrm_severity@0x024B31AA@ */ ECIPP_ALIGNMENT_UBYTE 255 Compu_IDENTITY 0 255 PHYS_UNIT "Severity+Class" /end CHARACTERISTIC
/begin CHARACTERISTIC FPsvr_TAUX4_min "FPrm_severity(427)" VALUE 0x00165F89 /* @ECU_Address@FPrm_severity@0x024B31AB@ */ ECIPP_ALIGNMENT_UBYTE 255 Compu_IDENTITY 0 255 PHYS_UNIT "Severity+Class" /end CHARACTERISTIC
/begin CHARACTERISTIC FPsvr_TEL_derate_actv "FPrm_severity(477)" VALUE 0x00165FBB /* @ECU_Address@FPrm_severity@0x024B31DD@ */ ECIPP_ALIGNMENT_UBYTE 255 Compu_IDENTITY 0 255 PHYS_UNIT "Severity+Class" /end CHARACTERISTIC
/begin CHARACTERISTIC FPsvr_TEL_dis "FPrm_severity(681)" VALUE 0x00166087 /* @ECU_Address@FPrm_severity@0x024B32A9@ */ ECIPP_ALIGNMENT_UBYTE 255 Compu_IDENTITY 0 255 PHYS_UNIT "Severity+Class" /end CHARACTERISTIC
/begin CHARACTERISTIC FPsvr_TEL_intF "FPrm_severity(682)" VALUE 0x00166088 /* @ECU_Address@FPrm_severity@0x024B32AA@ */ ECIPP_ALIGNMENT_UBYTE 255 Compu_IDENTITY 0 255 PHYS_UNIT "Severity+Class" /end CHARACTERISTIC
/begin CHARACTERISTIC FPsvr_TEL_key_invalid "FPrm_severity(648)" VALUE 0x00166066 /* @ECU_Address@FPrm_severity@0x024B3288@ */ ECIPP_ALIGNMENT_UBYTE 255 Compu_IDENTITY 0 255 PHYS_UNIT "Severity+Class" /end CHARACTERISTIC
/begin CHARACTERISTIC FPsvr_TEL_key_to "FPrm_severity(647)" VALUE 0x00166065 /* @ECU_Address@FPrm_severity@0x024B3287@ */ ECIPP_ALIGNMENT_UBYTE 255 Compu_IDENTITY 0 255 PHYS_UNIT "Severity+Class" /end CHARACTERISTIC
/begin CHARACTERISTIC FPsvr_TEL_req_to "FPrm_severity(646)" VALUE 0x00166064 /* @ECU_Address@FPrm_severity@0x024B3286@ */ ECIPP_ALIGNMENT_UBYTE 255 Compu_IDENTITY 0 255 PHYS_UNIT "Severity+Class" /end CHARACTERISTIC
/begin CHARACTERISTIC FPsvr_TEL_RPM_cmd "FPrm_severity(649)" VALUE 0x00166067 /* @ECU_Address@FPrm_severity@0x024B3289@ */ ECIPP_ALIGNMENT_UBYTE 255 Compu_IDENTITY 0 255 PHYS_UNIT "Severity+Class" /end CHARACTERISTIC
/begin CHARACTERISTIC FPsvr_TEL_RPM_psv "FPrm_severity(652)" VALUE 0x0016606A /* @ECU_Address@FPrm_severity@0x024B328C@ */ ECIPP_ALIGNMENT_UBYTE 255 Compu_IDENTITY 0 255 PHYS_UNIT "Severity+Class" /end CHARACTERISTIC
/begin CHARACTERISTIC FPsvr_TEL_shutdown_cmd "FPrm_severity(651)" VALUE 0x00166069 /* @ECU_Address@FPrm_severity@0x024B328B@ */ ECIPP_ALIGNMENT_UBYTE 255 Compu_IDENTITY 0 255 PHYS_UNIT "Severity+Class" /end CHARACTERISTIC
/begin CHARACTERISTIC FPsvr_TEL_shutdown_psv "FPrm_severity(654)" VALUE 0x0016606C /* @ECU_Address@FPrm_severity@0x024B328E@ */ ECIPP_ALIGNMENT_UBYTE 255 Compu_IDENTITY 0 255 PHYS_UNIT "Severity+Class" /end CHARACTERISTIC
/begin CHARACTERISTIC FPsvr_TEL_torq_cmd "FPrm_severity(650)" VALUE 0x00166068 /* @ECU_Address@FPrm_severity@0x024B328A@ */ ECIPP_ALIGNMENT_UBYTE 255 Compu_IDENTITY 0 255 PHYS_UNIT "Severity+Class" /end CHARACTERISTIC
/begin CHARACTERISTIC FPsvr_TEL_torq_psv "FPrm_severity(653)" VALUE 0x0016606B /* @ECU_Address@FPrm_severity@0x024B328D@ */ ECIPP_ALIGNMENT_UBYTE 255 Compu_IDENTITY 0 255 PHYS_UNIT "Severity+Class" /end CHARACTERISTIC
/begin CHARACTERISTIC FPsvr_TIP_act "FPrm_severity(105)" VALUE 0x00165E47 /* @ECU_Address@FPrm_severity@0x024B3069@ */ ECIPP_ALIGNMENT_UBYTE 255 Compu_IDENTITY 0 255 PHYS_UNIT "Severity+Class" /end CHARACTERISTIC
/begin CHARACTERISTIC FPsvr_TIP_maxv "FPrm_severity(85)" VALUE 0x00165E33 /* @ECU_Address@FPrm_severity@0x024B3055@ */ ECIPP_ALIGNMENT_UBYTE 255 Compu_IDENTITY 0 255 PHYS_UNIT "Severity+Class" /end CHARACTERISTIC
/begin CHARACTERISTIC FPsvr_TIP_minv "FPrm_severity(86)" VALUE 0x00165E34 /* @ECU_Address@FPrm_severity@0x024B3056@ */ ECIPP_ALIGNMENT_UBYTE 255 Compu_IDENTITY 0 255 PHYS_UNIT "Severity+Class" /end CHARACTERISTIC
/begin CHARACTERISTIC FPsvr_TPS1_max "FPrm_severity(18)" VALUE 0x00165DF0 /* @ECU_Address@FPrm_severity@0x024B3012@ */ ECIPP_ALIGNMENT_UBYTE 255 Compu_IDENTITY 0 255 PHYS_UNIT "Severity+Class" /end CHARACTERISTIC
/begin CHARACTERISTIC FPsvr_TPS1_min "FPrm_severity(19)" VALUE 0x00165DF1 /* @ECU_Address@FPrm_severity@0x024B3013@ */ ECIPP_ALIGNMENT_UBYTE 255 Compu_IDENTITY 0 255 PHYS_UNIT "Severity+Class" /end CHARACTERISTIC
/begin CHARACTERISTIC FPsvr_TPS12_OOR "FPrm_severity(144)" VALUE 0x00165E6E /* @ECU_Address@FPrm_severity@0x024B3090@ */ ECIPP_ALIGNMENT_UBYTE 255 Compu_IDENTITY 0 255 PHYS_UNIT "Severity+Class" /end CHARACTERISTIC
/begin CHARACTERISTIC FPsvr_TPS12pct_hi "FPrm_severity(22)" VALUE 0x00165DF4 /* @ECU_Address@FPrm_severity@0x024B3016@ */ ECIPP_ALIGNMENT_UBYTE 255 Compu_IDENTITY 0 255 PHYS_UNIT "Severity+Class" /end CHARACTERISTIC
/begin CHARACTERISTIC FPsvr_TPS12pct_lo "FPrm_severity(23)" VALUE 0x00165DF5 /* @ECU_Address@FPrm_severity@0x024B3017@ */ ECIPP_ALIGNMENT_UBYTE 255 Compu_IDENTITY 0 255 PHYS_UNIT "Severity+Class" /end CHARACTERISTIC
/begin CHARACTERISTIC FPsvr_TPS2_max "FPrm_severity(20)" VALUE 0x00165DF2 /* @ECU_Address@FPrm_severity@0x024B3014@ */ ECIPP_ALIGNMENT_UBYTE 255 Compu_IDENTITY 0 255 PHYS_UNIT "Severity+Class" /end CHARACTERISTIC
/begin CHARACTERISTIC FPsvr_TPS2_min "FPrm_severity(21)" VALUE 0x00165DF3 /* @ECU_Address@FPrm_severity@0x024B3015@ */ ECIPP_ALIGNMENT_UBYTE 255 Compu_IDENTITY 0 255 PHYS_UNIT "Severity+Class" /end CHARACTERISTIC
/begin CHARACTERISTIC FPsvr_TPSerr_neg "FPrm_severity(25)" VALUE 0x00165DF7 /* @ECU_Address@FPrm_severity@0x024B3019@ */ ECIPP_ALIGNMENT_UBYTE 255 Compu_IDENTITY 0 255 PHYS_UNIT "Severity+Class" /end CHARACTERISTIC
/begin CHARACTERISTIC FPsvr_TPSerr_pos "FPrm_severity(24)" VALUE 0x00165DF6 /* @ECU_Address@FPrm_severity@0x024B3018@ */ ECIPP_ALIGNMENT_UBYTE 255 Compu_IDENTITY 0 255 PHYS_UNIT "Severity+Class" /end CHARACTERISTIC
/begin CHARACTERISTIC FPsvr_TRANS_comm "FPrm_severity(678)" VALUE 0x00166084 /* @ECU_Address@FPrm_severity@0x024B32A6@ */ ECIPP_ALIGNMENT_UBYTE 255 Compu_IDENTITY 0 255 PHYS_UNIT "Severity+Class" /end CHARACTERISTIC
/begin CHARACTERISTIC FPsvr_TRANS_fuel_inh "FPrm_severity(679)" VALUE 0x00166085 /* @ECU_Address@FPrm_severity@0x024B32A7@ */ ECIPP_ALIGNMENT_UBYTE 255 Compu_IDENTITY 0 255 PHYS_UNIT "Severity+Class" /end CHARACTERISTIC
/begin CHARACTERISTIC FPsvr_TWCDiag_OSC_lo "FPrm_severity(633)" VALUE 0x00166057 /* @ECU_Address@FPrm_severity@0x024B3279@ */ ECIPP_ALIGNMENT_UBYTE 255 Compu_IDENTITY 0 255 PHYS_UNIT "Severity+Class" /end CHARACTERISTIC
/begin CHARACTERISTIC FPsvr_UEGOH1_off_open "FPrm_severity(324)" VALUE 0x00165F22 /* @ECU_Address@FPrm_severity@0x024B3144@ */ ECIPP_ALIGNMENT_UBYTE 255 Compu_IDENTITY 0 255 PHYS_UNIT "Severity+Class" /end CHARACTERISTIC
/begin CHARACTERISTIC FPsvr_UEGOH1_on_short "FPrm_severity(325)" VALUE 0x00165F23 /* @ECU_Address@FPrm_severity@0x024B3145@ */ ECIPP_ALIGNMENT_UBYTE 255 Compu_IDENTITY 0 255 PHYS_UNIT "Severity+Class" /end CHARACTERISTIC
/begin CHARACTERISTIC FPsvr_UEGOH2_off_open "FPrm_severity(326)" VALUE 0x00165F24 /* @ECU_Address@FPrm_severity@0x024B3146@ */ ECIPP_ALIGNMENT_UBYTE 255 Compu_IDENTITY 0 255 PHYS_UNIT "Severity+Class" /end CHARACTERISTIC
/begin CHARACTERISTIC FPsvr_UEGOH2_on_short "FPrm_severity(327)" VALUE 0x00165F25 /* @ECU_Address@FPrm_severity@0x024B3147@ */ ECIPP_ALIGNMENT_UBYTE 255 Compu_IDENTITY 0 255 PHYS_UNIT "Severity+Class" /end CHARACTERISTIC
/begin CHARACTERISTIC FPsvr_UEGOH3_off_open "FPrm_severity(464)" VALUE 0x00165FAE /* @ECU_Address@FPrm_severity@0x024B31D0@ */ ECIPP_ALIGNMENT_UBYTE 255 Compu_IDENTITY 0 255 PHYS_UNIT "Severity+Class" /end CHARACTERISTIC
/begin CHARACTERISTIC FPsvr_UEGOH3_on_short "FPrm_severity(465)" VALUE 0x00165FAF /* @ECU_Address@FPrm_severity@0x024B31D1@ */ ECIPP_ALIGNMENT_UBYTE 255 Compu_IDENTITY 0 255 PHYS_UNIT "Severity+Class" /end CHARACTERISTIC
/begin CHARACTERISTIC FPsvr_UEGOH4_off_open "FPrm_severity(475)" VALUE 0x00165FB9 /* @ECU_Address@FPrm_severity@0x024B31DB@ */ ECIPP_ALIGNMENT_UBYTE 255 Compu_IDENTITY 0 255 PHYS_UNIT "Severity+Class" /end CHARACTERISTIC
/begin CHARACTERISTIC FPsvr_UEGOH4_on_short "FPrm_severity(476)" VALUE 0x00165FBA /* @ECU_Address@FPrm_severity@0x024B31DC@ */ ECIPP_ALIGNMENT_UBYTE 255 Compu_IDENTITY 0 255 PHYS_UNIT "Severity+Class" /end CHARACTERISTIC
/begin CHARACTERISTIC FPsvr_UGF_Hv_hi "FPrm_severity(190)" VALUE 0x00165E9C /* @ECU_Address@FPrm_severity@0x024B30BE@ */ ECIPP_ALIGNMENT_UBYTE 255 Compu_IDENTITY 0 255 PHYS_UNIT "Severity+Class" /end CHARACTERISTIC
/begin CHARACTERISTIC FPsvr_UGF_internal "FPrm_severity(189)" VALUE 0x00165E9B /* @ECU_Address@FPrm_severity@0x024B30BD@ */ ECIPP_ALIGNMENT_UBYTE 255 Compu_IDENTITY 0 255 PHYS_UNIT "Severity+Class" /end CHARACTERISTIC
/begin CHARACTERISTIC FPsvr_UGF_lowsupply "FPrm_severity(400)" VALUE 0x00165F6E /* @ECU_Address@FPrm_severity@0x024B3190@ */ ECIPP_ALIGNMENT_UBYTE 255 Compu_IDENTITY 0 255 PHYS_UNIT "Severity+Class" /end CHARACTERISTIC
/begin CHARACTERISTIC FPsvr_UGF1_comm_lost "FPrm_severity(510)" VALUE 0x00165FDC /* @ECU_Address@FPrm_severity@0x024B31FE@ */ ECIPP_ALIGNMENT_UBYTE 255 Compu_IDENTITY 0 255 PHYS_UNIT "Severity+Class" /end CHARACTERISTIC
/begin CHARACTERISTIC FPsvr_UGF1_drifttl2 "FPrm_severity(406)" VALUE 0x00165F74 /* @ECU_Address@FPrm_severity@0x024B3196@ */ ECIPP_ALIGNMENT_UBYTE 255 Compu_IDENTITY 0 255 PHYS_UNIT "Severity+Class" /end CHARACTERISTIC
/begin CHARACTERISTIC FPsvr_UGF1_drifttol "FPrm_severity(384)" VALUE 0x00165F5E /* @ECU_Address@FPrm_severity@0x024B3180@ */ ECIPP_ALIGNMENT_UBYTE 255 Compu_IDENTITY 0 255 PHYS_UNIT "Severity+Class" /end CHARACTERISTIC
/begin CHARACTERISTIC FPsvr_UGF1_R_hi "FPrm_severity(191)" VALUE 0x00165E9D /* @ECU_Address@FPrm_severity@0x024B30BF@ */ ECIPP_ALIGNMENT_UBYTE 255 Compu_IDENTITY 0 255 PHYS_UNIT "Severity+Class" /end CHARACTERISTIC
/begin CHARACTERISTIC FPsvr_UGF1_SR_hi "FPrm_severity(194)" VALUE 0x00165EA0 /* @ECU_Address@FPrm_severity@0x024B30C2@ */ ECIPP_ALIGNMENT_UBYTE 255 Compu_IDENTITY 0 255 PHYS_UNIT "Severity+Class" /end CHARACTERISTIC
/begin CHARACTERISTIC FPsvr_UGF1_SR_slow "FPrm_severity(193)" VALUE 0x00165E9F /* @ECU_Address@FPrm_severity@0x024B30C1@ */ ECIPP_ALIGNMENT_UBYTE 255 Compu_IDENTITY 0 255 PHYS_UNIT "Severity+Class" /end CHARACTERISTIC
/begin CHARACTERISTIC FPsvr_UGF1_Sv_hi "FPrm_severity(192)" VALUE 0x00165E9E /* @ECU_Address@FPrm_severity@0x024B30C0@ */ ECIPP_ALIGNMENT_UBYTE 255 Compu_IDENTITY 0 255 PHYS_UNIT "Severity+Class" /end CHARACTERISTIC
/begin CHARACTERISTIC FPsvr_UGF2_comm_lost "FPrm_severity(511)" VALUE 0x00165FDD /* @ECU_Address@FPrm_severity@0x024B31FF@ */ ECIPP_ALIGNMENT_UBYTE 255 Compu_IDENTITY 0 255 PHYS_UNIT "Severity+Class" /end CHARACTERISTIC
/begin CHARACTERISTIC FPsvr_UGF2_drifttl2 "FPrm_severity(407)" VALUE 0x00165F75 /* @ECU_Address@FPrm_severity@0x024B3197@ */ ECIPP_ALIGNMENT_UBYTE 255 Compu_IDENTITY 0 255 PHYS_UNIT "Severity+Class" /end CHARACTERISTIC
/begin CHARACTERISTIC FPsvr_UGF2_drifttol "FPrm_severity(385)" VALUE 0x00165F5F /* @ECU_Address@FPrm_severity@0x024B3181@ */ ECIPP_ALIGNMENT_UBYTE 255 Compu_IDENTITY 0 255 PHYS_UNIT "Severity+Class" /end CHARACTERISTIC
/begin CHARACTERISTIC FPsvr_UGF2_Hv_hi "FPrm_severity(318)" VALUE 0x00165F1C /* @ECU_Address@FPrm_severity@0x024B313E@ */ ECIPP_ALIGNMENT_UBYTE 255 Compu_IDENTITY 0 255 PHYS_UNIT "Severity+Class" /end CHARACTERISTIC
/begin CHARACTERISTIC FPsvr_UGF2_internal "FPrm_severity(317)" VALUE 0x00165F1B /* @ECU_Address@FPrm_severity@0x024B313D@ */ ECIPP_ALIGNMENT_UBYTE 255 Compu_IDENTITY 0 255 PHYS_UNIT "Severity+Class" /end CHARACTERISTIC
/begin CHARACTERISTIC FPsvr_UGF2_lowsupply "FPrm_severity(401)" VALUE 0x00165F6F /* @ECU_Address@FPrm_severity@0x024B3191@ */ ECIPP_ALIGNMENT_UBYTE 255 Compu_IDENTITY 0 255 PHYS_UNIT "Severity+Class" /end CHARACTERISTIC
/begin CHARACTERISTIC FPsvr_UGF2_R_hi "FPrm_severity(319)" VALUE 0x00165F1D /* @ECU_Address@FPrm_severity@0x024B313F@ */ ECIPP_ALIGNMENT_UBYTE 255 Compu_IDENTITY 0 255 PHYS_UNIT "Severity+Class" /end CHARACTERISTIC
/begin CHARACTERISTIC FPsvr_UGF2_SR_hi "FPrm_severity(322)" VALUE 0x00165F20 /* @ECU_Address@FPrm_severity@0x024B3142@ */ ECIPP_ALIGNMENT_UBYTE 255 Compu_IDENTITY 0 255 PHYS_UNIT "Severity+Class" /end CHARACTERISTIC
/begin CHARACTERISTIC FPsvr_UGF2_SR_slow "FPrm_severity(321)" VALUE 0x00165F1F /* @ECU_Address@FPrm_severity@0x024B3141@ */ ECIPP_ALIGNMENT_UBYTE 255 Compu_IDENTITY 0 255 PHYS_UNIT "Severity+Class" /end CHARACTERISTIC
/begin CHARACTERISTIC FPsvr_UGF2_Sv_hi "FPrm_severity(320)" VALUE 0x00165F1E /* @ECU_Address@FPrm_severity@0x024B3140@ */ ECIPP_ALIGNMENT_UBYTE 255 Compu_IDENTITY 0 255 PHYS_UNIT "Severity+Class" /end CHARACTERISTIC
/begin CHARACTERISTIC FPsvr_UGF3_comm_lost "FPrm_severity(512)" VALUE 0x00165FDE /* @ECU_Address@FPrm_severity@0x024B3200@ */ ECIPP_ALIGNMENT_UBYTE 255 Compu_IDENTITY 0 255 PHYS_UNIT "Severity+Class" /end CHARACTERISTIC
/begin CHARACTERISTIC FPsvr_UGF3_drifttl2 "FPrm_severity(458)" VALUE 0x00165FA8 /* @ECU_Address@FPrm_severity@0x024B31CA@ */ ECIPP_ALIGNMENT_UBYTE 255 Compu_IDENTITY 0 255 PHYS_UNIT "Severity+Class" /end CHARACTERISTIC
/begin CHARACTERISTIC FPsvr_UGF3_drifttol "FPrm_severity(457)" VALUE 0x00165FA7 /* @ECU_Address@FPrm_severity@0x024B31C9@ */ ECIPP_ALIGNMENT_UBYTE 255 Compu_IDENTITY 0 255 PHYS_UNIT "Severity+Class" /end CHARACTERISTIC
/begin CHARACTERISTIC FPsvr_UGF3_Hv_hi "FPrm_severity(459)" VALUE 0x00165FA9 /* @ECU_Address@FPrm_severity@0x024B31CB@ */ ECIPP_ALIGNMENT_UBYTE 255 Compu_IDENTITY 0 255 PHYS_UNIT "Severity+Class" /end CHARACTERISTIC
/begin CHARACTERISTIC FPsvr_UGF3_internal "FPrm_severity(455)" VALUE 0x00165FA5 /* @ECU_Address@FPrm_severity@0x024B31C7@ */ ECIPP_ALIGNMENT_UBYTE 255 Compu_IDENTITY 0 255 PHYS_UNIT "Severity+Class" /end CHARACTERISTIC
/begin CHARACTERISTIC FPsvr_UGF3_lowsupply "FPrm_severity(456)" VALUE 0x00165FA6 /* @ECU_Address@FPrm_severity@0x024B31C8@ */ ECIPP_ALIGNMENT_UBYTE 255 Compu_IDENTITY 0 255 PHYS_UNIT "Severity+Class" /end CHARACTERISTIC
/begin CHARACTERISTIC FPsvr_UGF3_R_hi "FPrm_severity(460)" VALUE 0x00165FAA /* @ECU_Address@FPrm_severity@0x024B31CC@ */ ECIPP_ALIGNMENT_UBYTE 255 Compu_IDENTITY 0 255 PHYS_UNIT "Severity+Class" /end CHARACTERISTIC
/begin CHARACTERISTIC FPsvr_UGF3_SR_hi "FPrm_severity(463)" VALUE 0x00165FAD /* @ECU_Address@FPrm_severity@0x024B31CF@ */ ECIPP_ALIGNMENT_UBYTE 255 Compu_IDENTITY 0 255 PHYS_UNIT "Severity+Class" /end CHARACTERISTIC
/begin CHARACTERISTIC FPsvr_UGF3_SR_slow "FPrm_severity(462)" VALUE 0x00165FAC /* @ECU_Address@FPrm_severity@0x024B31CE@ */ ECIPP_ALIGNMENT_UBYTE 255 Compu_IDENTITY 0 255 PHYS_UNIT "Severity+Class" /end CHARACTERISTIC
/begin CHARACTERISTIC FPsvr_UGF3_Sv_hi "FPrm_severity(461)" VALUE 0x00165FAB /* @ECU_Address@FPrm_severity@0x024B31CD@ */ ECIPP_ALIGNMENT_UBYTE 255 Compu_IDENTITY 0 255 PHYS_UNIT "Severity+Class" /end CHARACTERISTIC
/begin CHARACTERISTIC FPsvr_UGF4_comm_lost "FPrm_severity(513)" VALUE 0x00165FDF /* @ECU_Address@FPrm_severity@0x024B3201@ */ ECIPP_ALIGNMENT_UBYTE 255 Compu_IDENTITY 0 255 PHYS_UNIT "Severity+Class" /end CHARACTERISTIC
/begin CHARACTERISTIC FPsw_ext1_TAUX2_max "FPrm_switches_ext1(422)" VALUE 0x0014718A /* @ECU_Address@FPrm_switches_ext1@0x023A534C@ */ ECIPP_ALIGNMENT_UWORD 65535 Compu_IDENTITY 0 65535 PHYS_UNIT "Enable bits" /end CHARACTERISTIC
/begin CHARACTERISTIC FPsw_ext1_TAUX2_min "FPrm_switches_ext1(423)" VALUE 0x0014718C /* @ECU_Address@FPrm_switches_ext1@0x023A534E@ */ ECIPP_ALIGNMENT_UWORD 65535 Compu_IDENTITY 0 65535 PHYS_UNIT "Enable bits" /end CHARACTERISTIC
/begin CHARACTERISTIC FPsw_ext1_TAUX3_max "FPrm_switches_ext1(424)" VALUE 0x0014718E /* @ECU_Address@FPrm_switches_ext1@0x023A5350@ */ ECIPP_ALIGNMENT_UWORD 65535 Compu_IDENTITY 0 65535 PHYS_UNIT "Enable bits" /end CHARACTERISTIC
/begin CHARACTERISTIC FPsw_ext1_TAUX3_min "FPrm_switches_ext1(425)" VALUE 0x00147190 /* @ECU_Address@FPrm_switches_ext1@0x023A5352@ */ ECIPP_ALIGNMENT_UWORD 65535 Compu_IDENTITY 0 65535 PHYS_UNIT "Enable bits" /end CHARACTERISTIC
/begin CHARACTERISTIC FPsw_ext1_TAUX4_max "FPrm_switches_ext1(426)" VALUE 0x00147192 /* @ECU_Address@FPrm_switches_ext1@0x023A5354@ */ ECIPP_ALIGNMENT_UWORD 65535 Compu_IDENTITY 0 65535 PHYS_UNIT "Enable bits" /end CHARACTERISTIC
/begin CHARACTERISTIC FPsw_ext1_TAUX4_min "FPrm_switches_ext1(427)" VALUE 0x00147194 /* @ECU_Address@FPrm_switches_ext1@0x023A5356@ */ ECIPP_ALIGNMENT_UWORD 65535 Compu_IDENTITY 0 65535 PHYS_UNIT "Enable bits" /end CHARACTERISTIC
/begin CHARACTERISTIC FPsw_ext1_TEL_derate_actv "FPrm_switches_ext1(477)" VALUE 0x001471F8 /* @ECU_Address@FPrm_switches_ext1@0x023A53BA@ */ ECIPP_ALIGNMENT_UWORD 65535 Compu_IDENTITY 0 65535 PHYS_UNIT "Enable bits" /end CHARACTERISTIC
/begin CHARACTERISTIC FPsw_ext1_TEL_dis "FPrm_switches_ext1(681)" VALUE 0x00147390 /* @ECU_Address@FPrm_switches_ext1@0x023A5552@ */ ECIPP_ALIGNMENT_UWORD 65535 Compu_IDENTITY 0 65535 PHYS_UNIT "Enable bits" /end CHARACTERISTIC
/begin CHARACTERISTIC FPsw_ext1_TEL_intF "FPrm_switches_ext1(682)" VALUE 0x00147392 /* @ECU_Address@FPrm_switches_ext1@0x023A5554@ */ ECIPP_ALIGNMENT_UWORD 65535 Compu_IDENTITY 0 65535 PHYS_UNIT "Enable bits" /end CHARACTERISTIC
/begin CHARACTERISTIC FPsw_ext1_TEL_key_invalid "FPrm_switches_ext1(648)" VALUE 0x0014734E /* @ECU_Address@FPrm_switches_ext1@0x023A5510@ */ ECIPP_ALIGNMENT_UWORD 65535 Compu_IDENTITY 0 65535 PHYS_UNIT "Enable bits" /end CHARACTERISTIC
/begin CHARACTERISTIC FPsw_ext1_TEL_key_to "FPrm_switches_ext1(647)" VALUE 0x0014734C /* @ECU_Address@FPrm_switches_ext1@0x023A550E@ */ ECIPP_ALIGNMENT_UWORD 65535 Compu_IDENTITY 0 65535 PHYS_UNIT "Enable bits" /end CHARACTERISTIC
/begin CHARACTERISTIC FPsw_ext1_TEL_req_to "FPrm_switches_ext1(646)" VALUE 0x0014734A /* @ECU_Address@FPrm_switches_ext1@0x023A550C@ */ ECIPP_ALIGNMENT_UWORD 65535 Compu_IDENTITY 0 65535 PHYS_UNIT "Enable bits" /end CHARACTERISTIC
/begin CHARACTERISTIC FPsw_ext1_TEL_RPM_cmd "FPrm_switches_ext1(649)" VALUE 0x00147350 /* @ECU_Address@FPrm_switches_ext1@0x023A5512@ */ ECIPP_ALIGNMENT_UWORD 65535 Compu_IDENTITY 0 65535 PHYS_UNIT "Enable bits" /end CHARACTERISTIC
/begin CHARACTERISTIC FPsw_ext1_TEL_RPM_psv "FPrm_switches_ext1(652)" VALUE 0x00147356 /* @ECU_Address@FPrm_switches_ext1@0x023A5518@ */ ECIPP_ALIGNMENT_UWORD 65535 Compu_IDENTITY 0 65535 PHYS_UNIT "Enable bits" /end CHARACTERISTIC
/begin CHARACTERISTIC FPsw_ext1_TEL_shutdown_cmd "FPrm_switches_ext1(651)" VALUE 0x00147354 /* @ECU_Address@FPrm_switches_ext1@0x023A5516@ */ ECIPP_ALIGNMENT_UWORD 65535 Compu_IDENTITY 0 65535 PHYS_UNIT "Enable bits" /end CHARACTERISTIC
/begin CHARACTERISTIC FPsw_ext1_TEL_shutdown_psv "FPrm_switches_ext1(654)" VALUE 0x0014735A /* @ECU_Address@FPrm_switches_ext1@0x023A551C@ */ ECIPP_ALIGNMENT_UWORD 65535 Compu_IDENTITY 0 65535 PHYS_UNIT "Enable bits" /end CHARACTERISTIC
/begin CHARACTERISTIC FPsw_ext1_TEL_torq_cmd "FPrm_switches_ext1(650)" VALUE 0x00147352 /* @ECU_Address@FPrm_switches_ext1@0x023A5514@ */ ECIPP_ALIGNMENT_UWORD 65535 Compu_IDENTITY 0 65535 PHYS_UNIT "Enable bits" /end CHARACTERISTIC
/begin CHARACTERISTIC FPsw_ext1_TEL_torq_psv "FPrm_switches_ext1(653)" VALUE 0x00147358 /* @ECU_Address@FPrm_switches_ext1@0x023A551A@ */ ECIPP_ALIGNMENT_UWORD 65535 Compu_IDENTITY 0 65535 PHYS_UNIT "Enable bits" /end CHARACTERISTIC
/begin CHARACTERISTIC FPsw_ext1_TIP_act "FPrm_switches_ext1(105)" VALUE 0x00146F10 /* @ECU_Address@FPrm_switches_ext1@0x023A50D2@ */ ECIPP_ALIGNMENT_UWORD 65535 Compu_IDENTITY 0 65535 PHYS_UNIT "Enable bits" /end CHARACTERISTIC
/begin CHARACTERISTIC FPsw_ext1_TIP_maxv "FPrm_switches_ext1(85)" VALUE 0x00146EE8 /* @ECU_Address@FPrm_switches_ext1@0x023A50AA@ */ ECIPP_ALIGNMENT_UWORD 65535 Compu_IDENTITY 0 65535 PHYS_UNIT "Enable bits" /end CHARACTERISTIC
/begin CHARACTERISTIC FPsw_ext1_TIP_minv "FPrm_switches_ext1(86)" VALUE 0x00146EEA /* @ECU_Address@FPrm_switches_ext1@0x023A50AC@ */ ECIPP_ALIGNMENT_UWORD 65535 Compu_IDENTITY 0 65535 PHYS_UNIT "Enable bits" /end CHARACTERISTIC
/begin CHARACTERISTIC FPsw_ext1_TPS1_max "FPrm_switches_ext1(18)" VALUE 0x00146E62 /* @ECU_Address@FPrm_switches_ext1@0x023A5024@ */ ECIPP_ALIGNMENT_UWORD 65535 Compu_IDENTITY 0 65535 PHYS_UNIT "Enable bits" /end CHARACTERISTIC
/begin CHARACTERISTIC FPsw_ext1_TPS1_min "FPrm_switches_ext1(19)" VALUE 0x00146E64 /* @ECU_Address@FPrm_switches_ext1@0x023A5026@ */ ECIPP_ALIGNMENT_UWORD 65535 Compu_IDENTITY 0 65535 PHYS_UNIT "Enable bits" /end CHARACTERISTIC
/begin CHARACTERISTIC FPsw_ext1_TPS12_OOR "FPrm_switches_ext1(144)" VALUE 0x00146F5E /* @ECU_Address@FPrm_switches_ext1@0x023A5120@ */ ECIPP_ALIGNMENT_UWORD 65535 Compu_IDENTITY 0 65535 PHYS_UNIT "Enable bits" /end CHARACTERISTIC
/begin CHARACTERISTIC FPsw_ext1_TPS12pct_hi "FPrm_switches_ext1(22)" VALUE 0x00146E6A /* @ECU_Address@FPrm_switches_ext1@0x023A502C@ */ ECIPP_ALIGNMENT_UWORD 65535 Compu_IDENTITY 0 65535 PHYS_UNIT "Enable bits" /end CHARACTERISTIC
/begin CHARACTERISTIC FPsw_ext1_TPS12pct_lo "FPrm_switches_ext1(23)" VALUE 0x00146E6C /* @ECU_Address@FPrm_switches_ext1@0x023A502E@ */ ECIPP_ALIGNMENT_UWORD 65535 Compu_IDENTITY 0 65535 PHYS_UNIT "Enable bits" /end CHARACTERISTIC
/begin CHARACTERISTIC FPsw_ext1_TPS2_max "FPrm_switches_ext1(20)" VALUE 0x00146E66 /* @ECU_Address@FPrm_switches_ext1@0x023A5028@ */ ECIPP_ALIGNMENT_UWORD 65535 Compu_IDENTITY 0 65535 PHYS_UNIT "Enable bits" /end CHARACTERISTIC
/begin CHARACTERISTIC FPsw_ext1_TPS2_min "FPrm_switches_ext1(21)" VALUE 0x00146E68 /* @ECU_Address@FPrm_switches_ext1@0x023A502A@ */ ECIPP_ALIGNMENT_UWORD 65535 Compu_IDENTITY 0 65535 PHYS_UNIT "Enable bits" /end CHARACTERISTIC
/begin CHARACTERISTIC FPsw_ext1_TPSerr_neg "FPrm_switches_ext1(25)" VALUE 0x00146E70 /* @ECU_Address@FPrm_switches_ext1@0x023A5032@ */ ECIPP_ALIGNMENT_UWORD 65535 Compu_IDENTITY 0 65535 PHYS_UNIT "Enable bits" /end CHARACTERISTIC
/begin CHARACTERISTIC FPsw_ext1_TPSerr_pos "FPrm_switches_ext1(24)" VALUE 0x00146E6E /* @ECU_Address@FPrm_switches_ext1@0x023A5030@ */ ECIPP_ALIGNMENT_UWORD 65535 Compu_IDENTITY 0 65535 PHYS_UNIT "Enable bits" /end CHARACTERISTIC
/begin CHARACTERISTIC FPsw_ext1_TRANS_comm "FPrm_switches_ext1(678)" VALUE 0x0014738A /* @ECU_Address@FPrm_switches_ext1@0x023A554C@ */ ECIPP_ALIGNMENT_UWORD 65535 Compu_IDENTITY 0 65535 PHYS_UNIT "Enable bits" /end CHARACTERISTIC
/begin CHARACTERISTIC FPsw_ext1_TRANS_fuel_inh "FPrm_switches_ext1(679)" VALUE 0x0014738C /* @ECU_Address@FPrm_switches_ext1@0x023A554E@ */ ECIPP_ALIGNMENT_UWORD 65535 Compu_IDENTITY 0 65535 PHYS_UNIT "Enable bits" /end CHARACTERISTIC
/begin CHARACTERISTIC FPsw_ext1_TWCDiag_OSC_lo "FPrm_switches_ext1(633)" VALUE 0x00147330 /* @ECU_Address@FPrm_switches_ext1@0x023A54F2@ */ ECIPP_ALIGNMENT_UWORD 65535 Compu_IDENTITY 0 65535 PHYS_UNIT "Enable bits" /end CHARACTERISTIC
/begin CHARACTERISTIC FPsw_ext1_UEGOH1_off_open "FPrm_switches_ext1(324)" VALUE 0x001470C6 /* @ECU_Address@FPrm_switches_ext1@0x023A5288@ */ ECIPP_ALIGNMENT_UWORD 65535 Compu_IDENTITY 0 65535 PHYS_UNIT "Enable bits" /end CHARACTERISTIC
/begin CHARACTERISTIC FPsw_ext1_UEGOH1_on_short "FPrm_switches_ext1(325)" VALUE 0x001470C8 /* @ECU_Address@FPrm_switches_ext1@0x023A528A@ */ ECIPP_ALIGNMENT_UWORD 65535 Compu_IDENTITY 0 65535 PHYS_UNIT "Enable bits" /end CHARACTERISTIC
/begin CHARACTERISTIC FPsw_ext1_UEGOH2_off_open "FPrm_switches_ext1(326)" VALUE 0x001470CA /* @ECU_Address@FPrm_switches_ext1@0x023A528C@ */ ECIPP_ALIGNMENT_UWORD 65535 Compu_IDENTITY 0 65535 PHYS_UNIT "Enable bits" /end CHARACTERISTIC
/begin CHARACTERISTIC FPsw_ext1_UEGOH2_on_short "FPrm_switches_ext1(327)" VALUE 0x001470CC /* @ECU_Address@FPrm_switches_ext1@0x023A528E@ */ ECIPP_ALIGNMENT_UWORD 65535 Compu_IDENTITY 0 65535 PHYS_UNIT "Enable bits" /end CHARACTERISTIC
/begin CHARACTERISTIC FPsw_ext1_UEGOH3_off_open "FPrm_switches_ext1(464)" VALUE 0x001471DE /* @ECU_Address@FPrm_switches_ext1@0x023A53A0@ */ ECIPP_ALIGNMENT_UWORD 65535 Compu_IDENTITY 0 65535 PHYS_UNIT "Enable bits" /end CHARACTERISTIC
/begin CHARACTERISTIC FPsw_ext1_UEGOH3_on_short "FPrm_switches_ext1(465)" VALUE 0x001471E0 /* @ECU_Address@FPrm_switches_ext1@0x023A53A2@ */ ECIPP_ALIGNMENT_UWORD 65535 Compu_IDENTITY 0 65535 PHYS_UNIT "Enable bits" /end CHARACTERISTIC
/begin CHARACTERISTIC FPsw_ext1_UEGOH4_off_open "FPrm_switches_ext1(475)" VALUE 0x001471F4 /* @ECU_Address@FPrm_switches_ext1@0x023A53B6@ */ ECIPP_ALIGNMENT_UWORD 65535 Compu_IDENTITY 0 65535 PHYS_UNIT "Enable bits" /end CHARACTERISTIC
/begin CHARACTERISTIC FPsw_ext1_UEGOH4_on_short "FPrm_switches_ext1(476)" VALUE 0x001471F6 /* @ECU_Address@FPrm_switches_ext1@0x023A53B8@ */ ECIPP_ALIGNMENT_UWORD 65535 Compu_IDENTITY 0 65535 PHYS_UNIT "Enable bits" /end CHARACTERISTIC
/begin CHARACTERISTIC FPsw_ext1_UGF_Hv_hi "FPrm_switches_ext1(190)" VALUE 0x00146FBA /* @ECU_Address@FPrm_switches_ext1@0x023A517C@ */ ECIPP_ALIGNMENT_UWORD 65535 Compu_IDENTITY 0 65535 PHYS_UNIT "Enable bits" /end CHARACTERISTIC
/begin CHARACTERISTIC FPsw_ext1_UGF_internal "FPrm_switches_ext1(189)" VALUE 0x00146FB8 /* @ECU_Address@FPrm_switches_ext1@0x023A517A@ */ ECIPP_ALIGNMENT_UWORD 65535 Compu_IDENTITY 0 65535 PHYS_UNIT "Enable bits" /end CHARACTERISTIC
/begin CHARACTERISTIC FPsw_ext1_UGF_lowsupply "FPrm_switches_ext1(400)" VALUE 0x0014715E /* @ECU_Address@FPrm_switches_ext1@0x023A5320@ */ ECIPP_ALIGNMENT_UWORD 65535 Compu_IDENTITY 0 65535 PHYS_UNIT "Enable bits" /end CHARACTERISTIC
/begin CHARACTERISTIC FPsw_ext1_UGF1_comm_lost "FPrm_switches_ext1(510)" VALUE 0x0014723A /* @ECU_Address@FPrm_switches_ext1@0x023A53FC@ */ ECIPP_ALIGNMENT_UWORD 65535 Compu_IDENTITY 0 65535 PHYS_UNIT "Enable bits" /end CHARACTERISTIC
/begin CHARACTERISTIC FPsw_ext1_UGF1_drifttl2 "FPrm_switches_ext1(406)" VALUE 0x0014716A /* @ECU_Address@FPrm_switches_ext1@0x023A532C@ */ ECIPP_ALIGNMENT_UWORD 65535 Compu_IDENTITY 0 65535 PHYS_UNIT "Enable bits" /end CHARACTERISTIC
/begin CHARACTERISTIC FPsw_ext1_UGF1_drifttol "FPrm_switches_ext1(384)" VALUE 0x0014713E /* @ECU_Address@FPrm_switches_ext1@0x023A5300@ */ ECIPP_ALIGNMENT_UWORD 65535 Compu_IDENTITY 0 65535 PHYS_UNIT "Enable bits" /end CHARACTERISTIC
/begin CHARACTERISTIC FPsw_ext1_UGF1_R_hi "FPrm_switches_ext1(191)" VALUE 0x00146FBC /* @ECU_Address@FPrm_switches_ext1@0x023A517E@ */ ECIPP_ALIGNMENT_UWORD 65535 Compu_IDENTITY 0 65535 PHYS_UNIT "Enable bits" /end CHARACTERISTIC
/begin CHARACTERISTIC FPsw_ext1_UGF1_SR_hi "FPrm_switches_ext1(194)" VALUE 0x00146FC2 /* @ECU_Address@FPrm_switches_ext1@0x023A5184@ */ ECIPP_ALIGNMENT_UWORD 65535 Compu_IDENTITY 0 65535 PHYS_UNIT "Enable bits" /end CHARACTERISTIC
/begin CHARACTERISTIC FPsw_ext1_UGF1_SR_slow "FPrm_switches_ext1(193)" VALUE 0x00146FC0 /* @ECU_Address@FPrm_switches_ext1@0x023A5182@ */ ECIPP_ALIGNMENT_UWORD 65535 Compu_IDENTITY 0 65535 PHYS_UNIT "Enable bits" /end CHARACTERISTIC
/begin CHARACTERISTIC FPsw_ext1_UGF1_Sv_hi "FPrm_switches_ext1(192)" VALUE 0x00146FBE /* @ECU_Address@FPrm_switches_ext1@0x023A5180@ */ ECIPP_ALIGNMENT_UWORD 65535 Compu_IDENTITY 0 65535 PHYS_UNIT "Enable bits" /end CHARACTERISTIC
/begin CHARACTERISTIC FPsw_ext1_UGF2_comm_lost "FPrm_switches_ext1(511)" VALUE 0x0014723C /* @ECU_Address@FPrm_switches_ext1@0x023A53FE@ */ ECIPP_ALIGNMENT_UWORD 65535 Compu_IDENTITY 0 65535 PHYS_UNIT "Enable bits" /end CHARACTERISTIC
/begin CHARACTERISTIC FPsw_ext1_UGF2_drifttl2 "FPrm_switches_ext1(407)" VALUE 0x0014716C /* @ECU_Address@FPrm_switches_ext1@0x023A532E@ */ ECIPP_ALIGNMENT_UWORD 65535 Compu_IDENTITY 0 65535 PHYS_UNIT "Enable bits" /end CHARACTERISTIC
/begin CHARACTERISTIC FPsw_ext1_UGF2_drifttol "FPrm_switches_ext1(385)" VALUE 0x00147140 /* @ECU_Address@FPrm_switches_ext1@0x023A5302@ */ ECIPP_ALIGNMENT_UWORD 65535 Compu_IDENTITY 0 65535 PHYS_UNIT "Enable bits" /end CHARACTERISTIC
/begin CHARACTERISTIC FPsw_ext1_UGF2_Hv_hi "FPrm_switches_ext1(318)" VALUE 0x001470BA /* @ECU_Address@FPrm_switches_ext1@0x023A527C@ */ ECIPP_ALIGNMENT_UWORD 65535 Compu_IDENTITY 0 65535 PHYS_UNIT "Enable bits" /end CHARACTERISTIC
/begin CHARACTERISTIC FPsw_ext1_UGF2_internal "FPrm_switches_ext1(317)" VALUE 0x001470B8 /* @ECU_Address@FPrm_switches_ext1@0x023A527A@ */ ECIPP_ALIGNMENT_UWORD 65535 Compu_IDENTITY 0 65535 PHYS_UNIT "Enable bits" /end CHARACTERISTIC
/begin CHARACTERISTIC FPsw_ext1_UGF2_lowsupply "FPrm_switches_ext1(401)" VALUE 0x00147160 /* @ECU_Address@FPrm_switches_ext1@0x023A5322@ */ ECIPP_ALIGNMENT_UWORD 65535 Compu_IDENTITY 0 65535 PHYS_UNIT "Enable bits" /end CHARACTERISTIC
/begin CHARACTERISTIC FPsw_ext1_UGF2_R_hi "FPrm_switches_ext1(319)" VALUE 0x001470BC /* @ECU_Address@FPrm_switches_ext1@0x023A527E@ */ ECIPP_ALIGNMENT_UWORD 65535 Compu_IDENTITY 0 65535 PHYS_UNIT "Enable bits" /end CHARACTERISTIC
/begin CHARACTERISTIC FPsw_ext1_UGF2_SR_hi "FPrm_switches_ext1(322)" VALUE 0x001470C2 /* @ECU_Address@FPrm_switches_ext1@0x023A5284@ */ ECIPP_ALIGNMENT_UWORD 65535 Compu_IDENTITY 0 65535 PHYS_UNIT "Enable bits" /end CHARACTERISTIC
/begin CHARACTERISTIC FPsw_ext1_UGF2_SR_slow "FPrm_switches_ext1(321)" VALUE 0x001470C0 /* @ECU_Address@FPrm_switches_ext1@0x023A5282@ */ ECIPP_ALIGNMENT_UWORD 65535 Compu_IDENTITY 0 65535 PHYS_UNIT "Enable bits" /end CHARACTERISTIC
/begin CHARACTERISTIC FPsw_ext1_UGF2_Sv_hi "FPrm_switches_ext1(320)" VALUE 0x001470BE /* @ECU_Address@FPrm_switches_ext1@0x023A5280@ */ ECIPP_ALIGNMENT_UWORD 65535 Compu_IDENTITY 0 65535 PHYS_UNIT "Enable bits" /end CHARACTERISTIC
/begin CHARACTERISTIC FPsw_ext1_UGF3_comm_lost "FPrm_switches_ext1(512)" VALUE 0x0014723E /* @ECU_Address@FPrm_switches_ext1@0x023A5400@ */ ECIPP_ALIGNMENT_UWORD 65535 Compu_IDENTITY 0 65535 PHYS_UNIT "Enable bits" /end CHARACTERISTIC
/begin CHARACTERISTIC FPsw_ext1_UGF3_drifttl2 "FPrm_switches_ext1(458)" VALUE 0x001471D2 /* @ECU_Address@FPrm_switches_ext1@0x023A5394@ */ ECIPP_ALIGNMENT_UWORD 65535 Compu_IDENTITY 0 65535 PHYS_UNIT "Enable bits" /end CHARACTERISTIC
/begin CHARACTERISTIC FPsw_ext1_UGF3_drifttol "FPrm_switches_ext1(457)" VALUE 0x001471D0 /* @ECU_Address@FPrm_switches_ext1@0x023A5392@ */ ECIPP_ALIGNMENT_UWORD 65535 Compu_IDENTITY 0 65535 PHYS_UNIT "Enable bits" /end CHARACTERISTIC
/begin CHARACTERISTIC FPsw_ext1_UGF3_Hv_hi "FPrm_switches_ext1(459)" VALUE 0x001471D4 /* @ECU_Address@FPrm_switches_ext1@0x023A5396@ */ ECIPP_ALIGNMENT_UWORD 65535 Compu_IDENTITY 0 65535 PHYS_UNIT "Enable bits" /end CHARACTERISTIC
/begin CHARACTERISTIC FPsw_ext1_UGF3_internal "FPrm_switches_ext1(455)" VALUE 0x001471CC /* @ECU_Address@FPrm_switches_ext1@0x023A538E@ */ ECIPP_ALIGNMENT_UWORD 65535 Compu_IDENTITY 0 65535 PHYS_UNIT "Enable bits" /end CHARACTERISTIC
/begin CHARACTERISTIC FPsw_ext1_UGF3_lowsupply "FPrm_switches_ext1(456)" VALUE 0x001471CE /* @ECU_Address@FPrm_switches_ext1@0x023A5390@ */ ECIPP_ALIGNMENT_UWORD 65535 Compu_IDENTITY 0 65535 PHYS_UNIT "Enable bits" /end CHARACTERISTIC
/begin CHARACTERISTIC FPsw_ext1_UGF3_R_hi "FPrm_switches_ext1(460)" VALUE 0x001471D6 /* @ECU_Address@FPrm_switches_ext1@0x023A5398@ */ ECIPP_ALIGNMENT_UWORD 65535 Compu_IDENTITY 0 65535 PHYS_UNIT "Enable bits" /end CHARACTERISTIC
/begin CHARACTERISTIC FPsw_ext1_UGF3_SR_hi "FPrm_switches_ext1(463)" VALUE 0x001471DC /* @ECU_Address@FPrm_switches_ext1@0x023A539E@ */ ECIPP_ALIGNMENT_UWORD 65535 Compu_IDENTITY 0 65535 PHYS_UNIT "Enable bits" /end CHARACTERISTIC
/begin CHARACTERISTIC FPsw_ext1_UGF3_SR_slow "FPrm_switches_ext1(462)" VALUE 0x001471DA /* @ECU_Address@FPrm_switches_ext1@0x023A539C@ */ ECIPP_ALIGNMENT_UWORD 65535 Compu_IDENTITY 0 65535 PHYS_UNIT "Enable bits" /end CHARACTERISTIC
/begin CHARACTERISTIC FPsw_ext1_UGF3_Sv_hi "FPrm_switches_ext1(461)" VALUE 0x001471D8 /* @ECU_Address@FPrm_switches_ext1@0x023A539A@ */ ECIPP_ALIGNMENT_UWORD 65535 Compu_IDENTITY 0 65535 PHYS_UNIT "Enable bits" /end CHARACTERISTIC
/begin CHARACTERISTIC FPsw_ext1_UGF4_comm_lost "FPrm_switches_ext1(513)" VALUE 0x00147240 /* @ECU_Address@FPrm_switches_ext1@0x023A5402@ */ ECIPP_ALIGNMENT_UWORD 65535 Compu_IDENTITY 0 65535 PHYS_UNIT "Enable bits" /end CHARACTERISTIC
/begin CHARACTERISTIC FPsw_TAUX2_max "FPrm_switches(422)" VALUE 0x00146C28 /* @ECU_Address@FPrm_switches@0x021B934C@ */ ECIPP_ALIGNMENT_UWORD 65535 Compu_IDENTITY 0 65535 PHYS_UNIT "Enable bits" /end CHARACTERISTIC
/begin CHARACTERISTIC FPsw_TAUX2_min "FPrm_switches(423)" VALUE 0x00146C2A /* @ECU_Address@FPrm_switches@0x021B934E@ */ ECIPP_ALIGNMENT_UWORD 65535 Compu_IDENTITY 0 65535 PHYS_UNIT "Enable bits" /end CHARACTERISTIC
/begin CHARACTERISTIC FPsw_TAUX3_max "FPrm_switches(424)" VALUE 0x00146C2C /* @ECU_Address@FPrm_switches@0x021B9350@ */ ECIPP_ALIGNMENT_UWORD 65535 Compu_IDENTITY 0 65535 PHYS_UNIT "Enable bits" /end CHARACTERISTIC
/begin CHARACTERISTIC FPsw_TAUX3_min "FPrm_switches(425)" VALUE 0x00146C2E /* @ECU_Address@FPrm_switches@0x021B9352@ */ ECIPP_ALIGNMENT_UWORD 65535 Compu_IDENTITY 0 65535 PHYS_UNIT "Enable bits" /end CHARACTERISTIC
/begin CHARACTERISTIC FPsw_TAUX4_max "FPrm_switches(426)" VALUE 0x00146C30 /* @ECU_Address@FPrm_switches@0x021B9354@ */ ECIPP_ALIGNMENT_UWORD 65535 Compu_IDENTITY 0 65535 PHYS_UNIT "Enable bits" /end CHARACTERISTIC
/begin CHARACTERISTIC FPsw_TAUX4_min "FPrm_switches(427)" VALUE 0x00146C32 /* @ECU_Address@FPrm_switches@0x021B9356@ */ ECIPP_ALIGNMENT_UWORD 65535 Compu_IDENTITY 0 65535 PHYS_UNIT "Enable bits" /end CHARACTERISTIC
/begin CHARACTERISTIC FPsw_TEL_derate_actv "FPrm_switches(477)" VALUE 0x00146C96 /* @ECU_Address@FPrm_switches@0x021B93BA@ */ ECIPP_ALIGNMENT_UWORD 65535 Compu_IDENTITY 0 65535 PHYS_UNIT "Enable bits" /end CHARACTERISTIC
/begin CHARACTERISTIC FPsw_TEL_dis "FPrm_switches(681)" VALUE 0x00146E2E /* @ECU_Address@FPrm_switches@0x021B9552@ */ ECIPP_ALIGNMENT_UWORD 65535 Compu_IDENTITY 0 65535 PHYS_UNIT "Enable bits" /end CHARACTERISTIC
/begin CHARACTERISTIC FPsw_TEL_intF "FPrm_switches(682)" VALUE 0x00146E30 /* @ECU_Address@FPrm_switches@0x021B9554@ */ ECIPP_ALIGNMENT_UWORD 65535 Compu_IDENTITY 0 65535 PHYS_UNIT "Enable bits" /end CHARACTERISTIC
/begin CHARACTERISTIC FPsw_TEL_key_invalid "FPrm_switches(648)" VALUE 0x00146DEC /* @ECU_Address@FPrm_switches@0x021B9510@ */ ECIPP_ALIGNMENT_UWORD 65535 Compu_IDENTITY 0 65535 PHYS_UNIT "Enable bits" /end CHARACTERISTIC
/begin CHARACTERISTIC FPsw_TEL_key_to "FPrm_switches(647)" VALUE 0x00146DEA /* @ECU_Address@FPrm_switches@0x021B950E@ */ ECIPP_ALIGNMENT_UWORD 65535 Compu_IDENTITY 0 65535 PHYS_UNIT "Enable bits" /end CHARACTERISTIC
/begin CHARACTERISTIC FPsw_TEL_req_to "FPrm_switches(646)" VALUE 0x00146DE8 /* @ECU_Address@FPrm_switches@0x021B950C@ */ ECIPP_ALIGNMENT_UWORD 65535 Compu_IDENTITY 0 65535 PHYS_UNIT "Enable bits" /end CHARACTERISTIC
/begin CHARACTERISTIC FPsw_TEL_RPM_cmd "FPrm_switches(649)" VALUE 0x00146DEE /* @ECU_Address@FPrm_switches@0x021B9512@ */ ECIPP_ALIGNMENT_UWORD 65535 Compu_IDENTITY 0 65535 PHYS_UNIT "Enable bits" /end CHARACTERISTIC
/begin CHARACTERISTIC FPsw_TEL_RPM_psv "FPrm_switches(652)" VALUE 0x00146DF4 /* @ECU_Address@FPrm_switches@0x021B9518@ */ ECIPP_ALIGNMENT_UWORD 65535 Compu_IDENTITY 0 65535 PHYS_UNIT "Enable bits" /end CHARACTERISTIC
/begin CHARACTERISTIC FPsw_TEL_shutdown_cmd "FPrm_switches(651)" VALUE 0x00146DF2 /* @ECU_Address@FPrm_switches@0x021B9516@ */ ECIPP_ALIGNMENT_UWORD 65535 Compu_IDENTITY 0 65535 PHYS_UNIT "Enable bits" /end CHARACTERISTIC
/begin CHARACTERISTIC FPsw_TEL_shutdown_psv "FPrm_switches(654)" VALUE 0x00146DF8 /* @ECU_Address@FPrm_switches@0x021B951C@ */ ECIPP_ALIGNMENT_UWORD 65535 Compu_IDENTITY 0 65535 PHYS_UNIT "Enable bits" /end CHARACTERISTIC
/begin CHARACTERISTIC FPsw_TEL_torq_cmd "FPrm_switches(650)" VALUE 0x00146DF0 /* @ECU_Address@FPrm_switches@0x021B9514@ */ ECIPP_ALIGNMENT_UWORD 65535 Compu_IDENTITY 0 65535 PHYS_UNIT "Enable bits" /end CHARACTERISTIC
/begin CHARACTERISTIC FPsw_TEL_torq_psv "FPrm_switches(653)" VALUE 0x00146DF6 /* @ECU_Address@FPrm_switches@0x021B951A@ */ ECIPP_ALIGNMENT_UWORD 65535 Compu_IDENTITY 0 65535 PHYS_UNIT "Enable bits" /end CHARACTERISTIC
/begin CHARACTERISTIC FPsw_TIP_act "FPrm_switches(105)" VALUE 0x001469AE /* @ECU_Address@FPrm_switches@0x021B90D2@ */ ECIPP_ALIGNMENT_UWORD 65535 Compu_IDENTITY 0 65535 PHYS_UNIT "Enable bits" /end CHARACTERISTIC
/begin CHARACTERISTIC FPsw_TIP_maxv "FPrm_switches(85)" VALUE 0x00146986 /* @ECU_Address@FPrm_switches@0x021B90AA@ */ ECIPP_ALIGNMENT_UWORD 65535 Compu_IDENTITY 0 65535 PHYS_UNIT "Enable bits" /end CHARACTERISTIC
/begin CHARACTERISTIC FPsw_TIP_minv "FPrm_switches(86)" VALUE 0x00146988 /* @ECU_Address@FPrm_switches@0x021B90AC@ */ ECIPP_ALIGNMENT_UWORD 65535 Compu_IDENTITY 0 65535 PHYS_UNIT "Enable bits" /end CHARACTERISTIC
/begin CHARACTERISTIC FPsw_TPS1_max "FPrm_switches(18)" VALUE 0x00146900 /* @ECU_Address@FPrm_switches@0x021B9024@ */ ECIPP_ALIGNMENT_UWORD 65535 Compu_IDENTITY 0 65535 PHYS_UNIT "Enable bits" /end CHARACTERISTIC
/begin CHARACTERISTIC FPsw_TPS1_min "FPrm_switches(19)" VALUE 0x00146902 /* @ECU_Address@FPrm_switches@0x021B9026@ */ ECIPP_ALIGNMENT_UWORD 65535 Compu_IDENTITY 0 65535 PHYS_UNIT "Enable bits" /end CHARACTERISTIC
/begin CHARACTERISTIC FPsw_TPS12_OOR "FPrm_switches(144)" VALUE 0x001469FC /* @ECU_Address@FPrm_switches@0x021B9120@ */ ECIPP_ALIGNMENT_UWORD 65535 Compu_IDENTITY 0 65535 PHYS_UNIT "Enable bits" /end CHARACTERISTIC
/begin CHARACTERISTIC FPsw_TPS12pct_hi "FPrm_switches(22)" VALUE 0x00146908 /* @ECU_Address@FPrm_switches@0x021B902C@ */ ECIPP_ALIGNMENT_UWORD 65535 Compu_IDENTITY 0 65535 PHYS_UNIT "Enable bits" /end CHARACTERISTIC
/begin CHARACTERISTIC FPsw_TPS12pct_lo "FPrm_switches(23)" VALUE 0x0014690A /* @ECU_Address@FPrm_switches@0x021B902E@ */ ECIPP_ALIGNMENT_UWORD 65535 Compu_IDENTITY 0 65535 PHYS_UNIT "Enable bits" /end CHARACTERISTIC
/begin CHARACTERISTIC FPsw_TPS2_max "FPrm_switches(20)" VALUE 0x00146904 /* @ECU_Address@FPrm_switches@0x021B9028@ */ ECIPP_ALIGNMENT_UWORD 65535 Compu_IDENTITY 0 65535 PHYS_UNIT "Enable bits" /end CHARACTERISTIC
/begin CHARACTERISTIC FPsw_TPS2_min "FPrm_switches(21)" VALUE 0x00146906 /* @ECU_Address@FPrm_switches@0x021B902A@ */ ECIPP_ALIGNMENT_UWORD 65535 Compu_IDENTITY 0 65535 PHYS_UNIT "Enable bits" /end CHARACTERISTIC
/begin CHARACTERISTIC FPsw_TPSerr_neg "FPrm_switches(25)" VALUE 0x0014690E /* @ECU_Address@FPrm_switches@0x021B9032@ */ ECIPP_ALIGNMENT_UWORD 65535 Compu_IDENTITY 0 65535 PHYS_UNIT "Enable bits" /end CHARACTERISTIC
/begin CHARACTERISTIC FPsw_TPSerr_pos "FPrm_switches(24)" VALUE 0x0014690C /* @ECU_Address@FPrm_switches@0x021B9030@ */ ECIPP_ALIGNMENT_UWORD 65535 Compu_IDENTITY 0 65535 PHYS_UNIT "Enable bits" /end CHARACTERISTIC
/begin CHARACTERISTIC FPsw_TRANS_comm "FPrm_switches(678)" VALUE 0x00146E28 /* @ECU_Address@FPrm_switches@0x021B954C@ */ ECIPP_ALIGNMENT_UWORD 65535 Compu_IDENTITY 0 65535 PHYS_UNIT "Enable bits" /end CHARACTERISTIC
/begin CHARACTERISTIC FPsw_TRANS_fuel_inh "FPrm_switches(679)" VALUE 0x00146E2A /* @ECU_Address@FPrm_switches@0x021B954E@ */ ECIPP_ALIGNMENT_UWORD 65535 Compu_IDENTITY 0 65535 PHYS_UNIT "Enable bits" /end CHARACTERISTIC
/begin CHARACTERISTIC FPsw_TWCDiag_OSC_lo "FPrm_switches(633)" VALUE 0x00146DCE /* @ECU_Address@FPrm_switches@0x021B94F2@ */ ECIPP_ALIGNMENT_UWORD 65535 Compu_IDENTITY 0 65535 PHYS_UNIT "Enable bits" /end CHARACTERISTIC
/begin CHARACTERISTIC FPsw_UEGOH1_off_open "FPrm_switches(324)" VALUE 0x00146B64 /* @ECU_Address@FPrm_switches@0x021B9288@ */ ECIPP_ALIGNMENT_UWORD 65535 Compu_IDENTITY 0 65535 PHYS_UNIT "Enable bits" /end CHARACTERISTIC
/begin CHARACTERISTIC FPsw_UEGOH1_on_short "FPrm_switches(325)" VALUE 0x00146B66 /* @ECU_Address@FPrm_switches@0x021B928A@ */ ECIPP_ALIGNMENT_UWORD 65535 Compu_IDENTITY 0 65535 PHYS_UNIT "Enable bits" /end CHARACTERISTIC
/begin CHARACTERISTIC FPsw_UEGOH2_off_open "FPrm_switches(326)" VALUE 0x00146B68 /* @ECU_Address@FPrm_switches@0x021B928C@ */ ECIPP_ALIGNMENT_UWORD 65535 Compu_IDENTITY 0 65535 PHYS_UNIT "Enable bits" /end CHARACTERISTIC
/begin CHARACTERISTIC FPsw_UEGOH2_on_short "FPrm_switches(327)" VALUE 0x00146B6A /* @ECU_Address@FPrm_switches@0x021B928E@ */ ECIPP_ALIGNMENT_UWORD 65535 Compu_IDENTITY 0 65535 PHYS_UNIT "Enable bits" /end CHARACTERISTIC
/begin CHARACTERISTIC FPsw_UEGOH3_off_open "FPrm_switches(464)" VALUE 0x00146C7C /* @ECU_Address@FPrm_switches@0x021B93A0@ */ ECIPP_ALIGNMENT_UWORD 65535 Compu_IDENTITY 0 65535 PHYS_UNIT "Enable bits" /end CHARACTERISTIC
/begin CHARACTERISTIC FPsw_UEGOH3_on_short "FPrm_switches(465)" VALUE 0x00146C7E /* @ECU_Address@FPrm_switches@0x021B93A2@ */ ECIPP_ALIGNMENT_UWORD 65535 Compu_IDENTITY 0 65535 PHYS_UNIT "Enable bits" /end CHARACTERISTIC
/begin CHARACTERISTIC FPsw_UEGOH4_off_open "FPrm_switches(475)" VALUE 0x00146C92 /* @ECU_Address@FPrm_switches@0x021B93B6@ */ ECIPP_ALIGNMENT_UWORD 65535 Compu_IDENTITY 0 65535 PHYS_UNIT "Enable bits" /end CHARACTERISTIC
/begin CHARACTERISTIC FPsw_UEGOH4_on_short "FPrm_switches(476)" VALUE 0x00146C94 /* @ECU_Address@FPrm_switches@0x021B93B8@ */ ECIPP_ALIGNMENT_UWORD 65535 Compu_IDENTITY 0 65535 PHYS_UNIT "Enable bits" /end CHARACTERISTIC
/begin CHARACTERISTIC FPsw_UGF_Hv_hi "FPrm_switches(190)" VALUE 0x00146A58 /* @ECU_Address@FPrm_switches@0x021B917C@ */ ECIPP_ALIGNMENT_UWORD 65535 Compu_IDENTITY 0 65535 PHYS_UNIT "Enable bits" /end CHARACTERISTIC
/begin CHARACTERISTIC FPsw_UGF_internal "FPrm_switches(189)" VALUE 0x00146A56 /* @ECU_Address@FPrm_switches@0x021B917A@ */ ECIPP_ALIGNMENT_UWORD 65535 Compu_IDENTITY 0 65535 PHYS_UNIT "Enable bits" /end CHARACTERISTIC
/begin CHARACTERISTIC FPsw_UGF_lowsupply "FPrm_switches(400)" VALUE 0x00146BFC /* @ECU_Address@FPrm_switches@0x021B9320@ */ ECIPP_ALIGNMENT_UWORD 65535 Compu_IDENTITY 0 65535 PHYS_UNIT "Enable bits" /end CHARACTERISTIC
/begin CHARACTERISTIC FPsw_UGF1_comm_lost "FPrm_switches(510)" VALUE 0x00146CD8 /* @ECU_Address@FPrm_switches@0x021B93FC@ */ ECIPP_ALIGNMENT_UWORD 65535 Compu_IDENTITY 0 65535 PHYS_UNIT "Enable bits" /end CHARACTERISTIC
/begin CHARACTERISTIC FPsw_UGF1_drifttl2 "FPrm_switches(406)" VALUE 0x00146C08 /* @ECU_Address@FPrm_switches@0x021B932C@ */ ECIPP_ALIGNMENT_UWORD 65535 Compu_IDENTITY 0 65535 PHYS_UNIT "Enable bits" /end CHARACTERISTIC
/begin CHARACTERISTIC FPsw_UGF1_drifttol "FPrm_switches(384)" VALUE 0x00146BDC /* @ECU_Address@FPrm_switches@0x021B9300@ */ ECIPP_ALIGNMENT_UWORD 65535 Compu_IDENTITY 0 65535 PHYS_UNIT "Enable bits" /end CHARACTERISTIC
/begin CHARACTERISTIC FPsw_UGF1_R_hi "FPrm_switches(191)" VALUE 0x00146A5A /* @ECU_Address@FPrm_switches@0x021B917E@ */ ECIPP_ALIGNMENT_UWORD 65535 Compu_IDENTITY 0 65535 PHYS_UNIT "Enable bits" /end CHARACTERISTIC
/begin CHARACTERISTIC FPsw_UGF1_SR_hi "FPrm_switches(194)" VALUE 0x00146A60 /* @ECU_Address@FPrm_switches@0x021B9184@ */ ECIPP_ALIGNMENT_UWORD 65535 Compu_IDENTITY 0 65535 PHYS_UNIT "Enable bits" /end CHARACTERISTIC
/begin CHARACTERISTIC FPsw_UGF1_SR_slow "FPrm_switches(193)" VALUE 0x00146A5E /* @ECU_Address@FPrm_switches@0x021B9182@ */ ECIPP_ALIGNMENT_UWORD 65535 Compu_IDENTITY 0 65535 PHYS_UNIT "Enable bits" /end CHARACTERISTIC
/begin CHARACTERISTIC FPsw_UGF1_Sv_hi "FPrm_switches(192)" VALUE 0x00146A5C /* @ECU_Address@FPrm_switches@0x021B9180@ */ ECIPP_ALIGNMENT_UWORD 65535 Compu_IDENTITY 0 65535 PHYS_UNIT "Enable bits" /end CHARACTERISTIC
/begin CHARACTERISTIC FPsw_UGF2_comm_lost "FPrm_switches(511)" VALUE 0x00146CDA /* @ECU_Address@FPrm_switches@0x021B93FE@ */ ECIPP_ALIGNMENT_UWORD 65535 Compu_IDENTITY 0 65535 PHYS_UNIT "Enable bits" /end CHARACTERISTIC
/begin CHARACTERISTIC FPsw_UGF2_drifttl2 "FPrm_switches(407)" VALUE 0x00146C0A /* @ECU_Address@FPrm_switches@0x021B932E@ */ ECIPP_ALIGNMENT_UWORD 65535 Compu_IDENTITY 0 65535 PHYS_UNIT "Enable bits" /end CHARACTERISTIC
/begin CHARACTERISTIC FPsw_UGF2_drifttol "FPrm_switches(385)" VALUE 0x00146BDE /* @ECU_Address@FPrm_switches@0x021B9302@ */ ECIPP_ALIGNMENT_UWORD 65535 Compu_IDENTITY 0 65535 PHYS_UNIT "Enable bits" /end CHARACTERISTIC
/begin CHARACTERISTIC FPsw_UGF2_Hv_hi "FPrm_switches(318)" VALUE 0x00146B58 /* @ECU_Address@FPrm_switches@0x021B927C@ */ ECIPP_ALIGNMENT_UWORD 65535 Compu_IDENTITY 0 65535 PHYS_UNIT "Enable bits" /end CHARACTERISTIC
/begin CHARACTERISTIC FPsw_UGF2_internal "FPrm_switches(317)" VALUE 0x00146B56 /* @ECU_Address@FPrm_switches@0x021B927A@ */ ECIPP_ALIGNMENT_UWORD 65535 Compu_IDENTITY 0 65535 PHYS_UNIT "Enable bits" /end CHARACTERISTIC
/begin CHARACTERISTIC FPsw_UGF2_lowsupply "FPrm_switches(401)" VALUE 0x00146BFE /* @ECU_Address@FPrm_switches@0x021B9322@ */ ECIPP_ALIGNMENT_UWORD 65535 Compu_IDENTITY 0 65535 PHYS_UNIT "Enable bits" /end CHARACTERISTIC
/begin CHARACTERISTIC FPsw_UGF2_R_hi "FPrm_switches(319)" VALUE 0x00146B5A /* @ECU_Address@FPrm_switches@0x021B927E@ */ ECIPP_ALIGNMENT_UWORD 65535 Compu_IDENTITY 0 65535 PHYS_UNIT "Enable bits" /end CHARACTERISTIC
/begin CHARACTERISTIC FPsw_UGF2_SR_hi "FPrm_switches(322)" VALUE 0x00146B60 /* @ECU_Address@FPrm_switches@0x021B9284@ */ ECIPP_ALIGNMENT_UWORD 65535 Compu_IDENTITY 0 65535 PHYS_UNIT "Enable bits" /end CHARACTERISTIC
/begin CHARACTERISTIC FPsw_UGF2_SR_slow "FPrm_switches(321)" VALUE 0x00146B5E /* @ECU_Address@FPrm_switches@0x021B9282@ */ ECIPP_ALIGNMENT_UWORD 65535 Compu_IDENTITY 0 65535 PHYS_UNIT "Enable bits" /end CHARACTERISTIC
/begin CHARACTERISTIC FPsw_UGF2_Sv_hi "FPrm_switches(320)" VALUE 0x00146B5C /* @ECU_Address@FPrm_switches@0x021B9280@ */ ECIPP_ALIGNMENT_UWORD 65535 Compu_IDENTITY 0 65535 PHYS_UNIT "Enable bits" /end CHARACTERISTIC
/begin CHARACTERISTIC FPsw_UGF3_comm_lost "FPrm_switches(512)" VALUE 0x00146CDC /* @ECU_Address@FPrm_switches@0x021B9400@ */ ECIPP_ALIGNMENT_UWORD 65535 Compu_IDENTITY 0 65535 PHYS_UNIT "Enable bits" /end CHARACTERISTIC
/begin CHARACTERISTIC FPsw_UGF3_drifttl2 "FPrm_switches(458)" VALUE 0x00146C70 /* @ECU_Address@FPrm_switches@0x021B9394@ */ ECIPP_ALIGNMENT_UWORD 65535 Compu_IDENTITY 0 65535 PHYS_UNIT "Enable bits" /end CHARACTERISTIC
/begin CHARACTERISTIC FPsw_UGF3_drifttol "FPrm_switches(457)" VALUE 0x00146C6E /* @ECU_Address@FPrm_switches@0x021B9392@ */ ECIPP_ALIGNMENT_UWORD 65535 Compu_IDENTITY 0 65535 PHYS_UNIT "Enable bits" /end CHARACTERISTIC
/begin CHARACTERISTIC FPsw_UGF3_Hv_hi "FPrm_switches(459)" VALUE 0x00146C72 /* @ECU_Address@FPrm_switches@0x021B9396@ */ ECIPP_ALIGNMENT_UWORD 65535 Compu_IDENTITY 0 65535 PHYS_UNIT "Enable bits" /end CHARACTERISTIC
/begin CHARACTERISTIC FPsw_UGF3_internal "FPrm_switches(455)" VALUE 0x00146C6A /* @ECU_Address@FPrm_switches@0x021B938E@ */ ECIPP_ALIGNMENT_UWORD 65535 Compu_IDENTITY 0 65535 PHYS_UNIT "Enable bits" /end CHARACTERISTIC
/begin CHARACTERISTIC FPsw_UGF3_lowsupply "FPrm_switches(456)" VALUE 0x00146C6C /* @ECU_Address@FPrm_switches@0x021B9390@ */ ECIPP_ALIGNMENT_UWORD 65535 Compu_IDENTITY 0 65535 PHYS_UNIT "Enable bits" /end CHARACTERISTIC
/begin CHARACTERISTIC FPsw_UGF3_R_hi "FPrm_switches(460)" VALUE 0x00146C74 /* @ECU_Address@FPrm_switches@0x021B9398@ */ ECIPP_ALIGNMENT_UWORD 65535 Compu_IDENTITY 0 65535 PHYS_UNIT "Enable bits" /end CHARACTERISTIC
/begin CHARACTERISTIC FPsw_UGF3_SR_hi "FPrm_switches(463)" VALUE 0x00146C7A /* @ECU_Address@FPrm_switches@0x021B939E@ */ ECIPP_ALIGNMENT_UWORD 65535 Compu_IDENTITY 0 65535 PHYS_UNIT "Enable bits" /end CHARACTERISTIC
/begin CHARACTERISTIC FPsw_UGF3_SR_slow "FPrm_switches(462)" VALUE 0x00146C78 /* @ECU_Address@FPrm_switches@0x021B939C@ */ ECIPP_ALIGNMENT_UWORD 65535 Compu_IDENTITY 0 65535 PHYS_UNIT "Enable bits" /end CHARACTERISTIC
/begin CHARACTERISTIC FPsw_UGF3_Sv_hi "FPrm_switches(461)" VALUE 0x00146C76 /* @ECU_Address@FPrm_switches@0x021B939A@ */ ECIPP_ALIGNMENT_UWORD 65535 Compu_IDENTITY 0 65535 PHYS_UNIT "Enable bits" /end CHARACTERISTIC
/begin CHARACTERISTIC FPsw_UGF4_comm_lost "FPrm_switches(513)" VALUE 0x00146CDE /* @ECU_Address@FPrm_switches@0x021B9402@ */ ECIPP_ALIGNMENT_UWORD 65535 Compu_IDENTITY 0 65535 PHYS_UNIT "Enable bits" /end CHARACTERISTIC
/begin CHARACTERISTIC FCdtc_TAUX2_max "FCtl_DTC(552)" VALUE 0x00163964 /* @ECU_Address@FCtl_DTC@0x021B5450@ */ ECIPP_ALIGNMENT_UWORD 65535 Compu_IDENTITY 0 65535 PHYS_UNIT "DTC" /end CHARACTERISTIC
/begin CHARACTERISTIC FCdtc_TAUX2_min "FCtl_DTC(553)" VALUE 0x00163966 /* @ECU_Address@FCtl_DTC@0x021B5452@ */ ECIPP_ALIGNMENT_UWORD 65535 Compu_IDENTITY 0 65535 PHYS_UNIT "DTC" /end CHARACTERISTIC
/begin CHARACTERISTIC FCdtc_TAUX3_max "FCtl_DTC(554)" VALUE 0x00163968 /* @ECU_Address@FCtl_DTC@0x021B5454@ */ ECIPP_ALIGNMENT_UWORD 65535 Compu_IDENTITY 0 65535 PHYS_UNIT "DTC" /end CHARACTERISTIC
/begin CHARACTERISTIC FCdtc_TAUX3_min "FCtl_DTC(555)" VALUE 0x0016396A /* @ECU_Address@FCtl_DTC@0x021B5456@ */ ECIPP_ALIGNMENT_UWORD 65535 Compu_IDENTITY 0 65535 PHYS_UNIT "DTC" /end CHARACTERISTIC
/begin CHARACTERISTIC FCdtc_TAUX4_max "FCtl_DTC(556)" VALUE 0x0016396C /* @ECU_Address@FCtl_DTC@0x021B5458@ */ ECIPP_ALIGNMENT_UWORD 65535 Compu_IDENTITY 0 65535 PHYS_UNIT "DTC" /end CHARACTERISTIC
/begin CHARACTERISTIC FCdtc_TAUX4_min "FCtl_DTC(557)" VALUE 0x0016396E /* @ECU_Address@FCtl_DTC@0x021B545A@ */ ECIPP_ALIGNMENT_UWORD 65535 Compu_IDENTITY 0 65535 PHYS_UNIT "DTC" /end CHARACTERISTIC
/begin CHARACTERISTIC FCdtc_TEL_derate_actv "FCtl_DTC(647)" VALUE 0x00163A22 /* @ECU_Address@FCtl_DTC@0x021B550E@ */ ECIPP_ALIGNMENT_UWORD 65535 Compu_IDENTITY 0 65535 PHYS_UNIT "DTC" /end CHARACTERISTIC
/begin CHARACTERISTIC FCdtc_TEL_dis "FCtl_DTC(854)" VALUE 0x00163BC0 /* @ECU_Address@FCtl_DTC@0x021B56AC@ */ ECIPP_ALIGNMENT_UWORD 65535 Compu_IDENTITY 0 65535 PHYS_UNIT "DTC" /end CHARACTERISTIC
/begin CHARACTERISTIC FCdtc_TEL_intF "FCtl_DTC(855)" VALUE 0x00163BC2 /* @ECU_Address@FCtl_DTC@0x021B56AE@ */ ECIPP_ALIGNMENT_UWORD 65535 Compu_IDENTITY 0 65535 PHYS_UNIT "DTC" /end CHARACTERISTIC
/begin CHARACTERISTIC FCdtc_TEL_key_invalid "FCtl_DTC(821)" VALUE 0x00163B7E /* @ECU_Address@FCtl_DTC@0x021B566A@ */ ECIPP_ALIGNMENT_UWORD 65535 Compu_IDENTITY 0 65535 PHYS_UNIT "DTC" /end CHARACTERISTIC
/begin CHARACTERISTIC FCdtc_TEL_key_to "FCtl_DTC(820)" VALUE 0x00163B7C /* @ECU_Address@FCtl_DTC@0x021B5668@ */ ECIPP_ALIGNMENT_UWORD 65535 Compu_IDENTITY 0 65535 PHYS_UNIT "DTC" /end CHARACTERISTIC
/begin CHARACTERISTIC FCdtc_TEL_req_to "FCtl_DTC(819)" VALUE 0x00163B7A /* @ECU_Address@FCtl_DTC@0x021B5666@ */ ECIPP_ALIGNMENT_UWORD 65535 Compu_IDENTITY 0 65535 PHYS_UNIT "DTC" /end CHARACTERISTIC
/begin CHARACTERISTIC FCdtc_TEL_RPM_cmd "FCtl_DTC(822)" VALUE 0x00163B80 /* @ECU_Address@FCtl_DTC@0x021B566C@ */ ECIPP_ALIGNMENT_UWORD 65535 Compu_IDENTITY 0 65535 PHYS_UNIT "DTC" /end CHARACTERISTIC
/begin CHARACTERISTIC FCdtc_TEL_RPM_psv "FCtl_DTC(825)" VALUE 0x00163B86 /* @ECU_Address@FCtl_DTC@0x021B5672@ */ ECIPP_ALIGNMENT_UWORD 65535 Compu_IDENTITY 0 65535 PHYS_UNIT "DTC" /end CHARACTERISTIC
/begin CHARACTERISTIC FCdtc_TEL_shutdown_cmd "FCtl_DTC(824)" VALUE 0x00163B84 /* @ECU_Address@FCtl_DTC@0x021B5670@ */ ECIPP_ALIGNMENT_UWORD 65535 Compu_IDENTITY 0 65535 PHYS_UNIT "DTC" /end CHARACTERISTIC
/begin CHARACTERISTIC FCdtc_TEL_shutdown_psv "FCtl_DTC(827)" VALUE 0x00163B8A /* @ECU_Address@FCtl_DTC@0x021B5676@ */ ECIPP_ALIGNMENT_UWORD 65535 Compu_IDENTITY 0 65535 PHYS_UNIT "DTC" /end CHARACTERISTIC
/begin CHARACTERISTIC FCdtc_TEL_torq_cmd "FCtl_DTC(823)" VALUE 0x00163B82 /* @ECU_Address@FCtl_DTC@0x021B566E@ */ ECIPP_ALIGNMENT_UWORD 65535 Compu_IDENTITY 0 65535 PHYS_UNIT "DTC" /end CHARACTERISTIC
/begin CHARACTERISTIC FCdtc_TEL_torq_psv "FCtl_DTC(826)" VALUE 0x00163B88 /* @ECU_Address@FCtl_DTC@0x021B5674@ */ ECIPP_ALIGNMENT_UWORD 65535 Compu_IDENTITY 0 65535 PHYS_UNIT "DTC" /end CHARACTERISTIC
/begin CHARACTERISTIC FCdtc_TIP_act "FCtl_DTC(145)" VALUE 0x00163636 /* @ECU_Address@FCtl_DTC@0x021B5122@ */ ECIPP_ALIGNMENT_UWORD 65535 Compu_IDENTITY 0 65535 PHYS_UNIT "DTC" /end CHARACTERISTIC
/begin CHARACTERISTIC FCdtc_TIP_maxv "FCtl_DTC(126)" VALUE 0x00163610 /* @ECU_Address@FCtl_DTC@0x021B50FC@ */ ECIPP_ALIGNMENT_UWORD 65535 Compu_IDENTITY 0 65535 PHYS_UNIT "DTC" /end CHARACTERISTIC
/begin CHARACTERISTIC FCdtc_TIP_minv "FCtl_DTC(127)" VALUE 0x00163612 /* @ECU_Address@FCtl_DTC@0x021B50FE@ */ ECIPP_ALIGNMENT_UWORD 65535 Compu_IDENTITY 0 65535 PHYS_UNIT "DTC" /end CHARACTERISTIC
/begin CHARACTERISTIC FCdtc_TPS1_max "FCtl_DTC(13)" VALUE 0x0016352E /* @ECU_Address@FCtl_DTC@0x021B501A@ */ ECIPP_ALIGNMENT_UWORD 65535 Compu_IDENTITY 0 65535 PHYS_UNIT "DTC" /end CHARACTERISTIC
/begin CHARACTERISTIC FCdtc_TPS1_min "FCtl_DTC(14)" VALUE 0x00163530 /* @ECU_Address@FCtl_DTC@0x021B501C@ */ ECIPP_ALIGNMENT_UWORD 65535 Compu_IDENTITY 0 65535 PHYS_UNIT "DTC" /end CHARACTERISTIC
/begin CHARACTERISTIC FCdtc_TPS12_OOR "FCtl_DTC(186)" VALUE 0x00163688 /* @ECU_Address@FCtl_DTC@0x021B5174@ */ ECIPP_ALIGNMENT_UWORD 65535 Compu_IDENTITY 0 65535 PHYS_UNIT "DTC" /end CHARACTERISTIC
/begin CHARACTERISTIC FCdtc_TPS12pct_hi "FCtl_DTC(17)" VALUE 0x00163536 /* @ECU_Address@FCtl_DTC@0x021B5022@ */ ECIPP_ALIGNMENT_UWORD 65535 Compu_IDENTITY 0 65535 PHYS_UNIT "DTC" /end CHARACTERISTIC
/begin CHARACTERISTIC FCdtc_TPS12pct_lo "FCtl_DTC(18)" VALUE 0x00163538 /* @ECU_Address@FCtl_DTC@0x021B5024@ */ ECIPP_ALIGNMENT_UWORD 65535 Compu_IDENTITY 0 65535 PHYS_UNIT "DTC" /end CHARACTERISTIC
/begin CHARACTERISTIC FCdtc_TPS2_max "FCtl_DTC(15)" VALUE 0x00163532 /* @ECU_Address@FCtl_DTC@0x021B501E@ */ ECIPP_ALIGNMENT_UWORD 65535 Compu_IDENTITY 0 65535 PHYS_UNIT "DTC" /end CHARACTERISTIC
/begin CHARACTERISTIC FCdtc_TPS2_min "FCtl_DTC(16)" VALUE 0x00163534 /* @ECU_Address@FCtl_DTC@0x021B5020@ */ ECIPP_ALIGNMENT_UWORD 65535 Compu_IDENTITY 0 65535 PHYS_UNIT "DTC" /end CHARACTERISTIC
/begin CHARACTERISTIC FCdtc_TPSerr_neg "FCtl_DTC(91)" VALUE 0x001635CA /* @ECU_Address@FCtl_DTC@0x021B50B6@ */ ECIPP_ALIGNMENT_UWORD 65535 Compu_IDENTITY 0 65535 PHYS_UNIT "DTC" /end CHARACTERISTIC
/begin CHARACTERISTIC FCdtc_TPSerr_pos "FCtl_DTC(90)" VALUE 0x001635C8 /* @ECU_Address@FCtl_DTC@0x021B50B4@ */ ECIPP_ALIGNMENT_UWORD 65535 Compu_IDENTITY 0 65535 PHYS_UNIT "DTC" /end CHARACTERISTIC
/begin CHARACTERISTIC FCdtc_TRANS_comm "FCtl_DTC(851)" VALUE 0x00163BBA /* @ECU_Address@FCtl_DTC@0x021B56A6@ */ ECIPP_ALIGNMENT_UWORD 65535 Compu_IDENTITY 0 65535 PHYS_UNIT "DTC" /end CHARACTERISTIC
/begin CHARACTERISTIC FCdtc_TRANS_fuel_inh "FCtl_DTC(852)" VALUE 0x00163BBC /* @ECU_Address@FCtl_DTC@0x021B56A8@ */ ECIPP_ALIGNMENT_UWORD 65535 Compu_IDENTITY 0 65535 PHYS_UNIT "DTC" /end CHARACTERISTIC
/begin CHARACTERISTIC FCdtc_TWCDiag_OSC_lo "FCtl_DTC(804)" VALUE 0x00163B5C /* @ECU_Address@FCtl_DTC@0x021B5648@ */ ECIPP_ALIGNMENT_UWORD 65535 Compu_IDENTITY 0 65535 PHYS_UNIT "DTC" /end CHARACTERISTIC
/begin CHARACTERISTIC FCdtc_UEGOH1_off_open "FCtl_DTC(427)" VALUE 0x0016386A /* @ECU_Address@FCtl_DTC@0x021B5356@ */ ECIPP_ALIGNMENT_UWORD 65535 Compu_IDENTITY 0 65535 PHYS_UNIT "DTC" /end CHARACTERISTIC
/begin CHARACTERISTIC FCdtc_UEGOH1_on_short "FCtl_DTC(428)" VALUE 0x0016386C /* @ECU_Address@FCtl_DTC@0x021B5358@ */ ECIPP_ALIGNMENT_UWORD 65535 Compu_IDENTITY 0 65535 PHYS_UNIT "DTC" /end CHARACTERISTIC
/begin CHARACTERISTIC FCdtc_UEGOH2_off_open "FCtl_DTC(429)" VALUE 0x0016386E /* @ECU_Address@FCtl_DTC@0x021B535A@ */ ECIPP_ALIGNMENT_UWORD 65535 Compu_IDENTITY 0 65535 PHYS_UNIT "DTC" /end CHARACTERISTIC
/begin CHARACTERISTIC FCdtc_UEGOH2_on_short "FCtl_DTC(430)" VALUE 0x00163870 /* @ECU_Address@FCtl_DTC@0x021B535C@ */ ECIPP_ALIGNMENT_UWORD 65535 Compu_IDENTITY 0 65535 PHYS_UNIT "DTC" /end CHARACTERISTIC
/begin CHARACTERISTIC FCdtc_UEGOH3_off_open "FCtl_DTC(622)" VALUE 0x001639F0 /* @ECU_Address@FCtl_DTC@0x021B54DC@ */ ECIPP_ALIGNMENT_UWORD 65535 Compu_IDENTITY 0 65535 PHYS_UNIT "DTC" /end CHARACTERISTIC
/begin CHARACTERISTIC FCdtc_UEGOH3_on_short "FCtl_DTC(623)" VALUE 0x001639F2 /* @ECU_Address@FCtl_DTC@0x021B54DE@ */ ECIPP_ALIGNMENT_UWORD 65535 Compu_IDENTITY 0 65535 PHYS_UNIT "DTC" /end CHARACTERISTIC
/begin CHARACTERISTIC FCdtc_UEGOH4_off_open "FCtl_DTC(645)" VALUE 0x00163A1E /* @ECU_Address@FCtl_DTC@0x021B550A@ */ ECIPP_ALIGNMENT_UWORD 65535 Compu_IDENTITY 0 65535 PHYS_UNIT "DTC" /end CHARACTERISTIC
/begin CHARACTERISTIC FCdtc_UEGOH4_on_short "FCtl_DTC(646)" VALUE 0x00163A20 /* @ECU_Address@FCtl_DTC@0x021B550C@ */ ECIPP_ALIGNMENT_UWORD 65535 Compu_IDENTITY 0 65535 PHYS_UNIT "DTC" /end CHARACTERISTIC
/begin CHARACTERISTIC FCdtc_UGF_Hv_hi "FCtl_DTC(242)" VALUE 0x001636F8 /* @ECU_Address@FCtl_DTC@0x021B51E4@ */ ECIPP_ALIGNMENT_UWORD 65535 Compu_IDENTITY 0 65535 PHYS_UNIT "DTC" /end CHARACTERISTIC
/begin CHARACTERISTIC FCdtc_UGF_internal "FCtl_DTC(241)" VALUE 0x001636F6 /* @ECU_Address@FCtl_DTC@0x021B51E2@ */ ECIPP_ALIGNMENT_UWORD 65535 Compu_IDENTITY 0 65535 PHYS_UNIT "DTC" /end CHARACTERISTIC
/begin CHARACTERISTIC FCdtc_UGF_lowsupply "FCtl_DTC(530)" VALUE 0x00163938 /* @ECU_Address@FCtl_DTC@0x021B5424@ */ ECIPP_ALIGNMENT_UWORD 65535 Compu_IDENTITY 0 65535 PHYS_UNIT "DTC" /end CHARACTERISTIC
/begin CHARACTERISTIC FCdtc_UGF1_comm_lost "FCtl_DTC(680)" VALUE 0x00163A64 /* @ECU_Address@FCtl_DTC@0x021B5550@ */ ECIPP_ALIGNMENT_UWORD 65535 Compu_IDENTITY 0 65535 PHYS_UNIT "DTC" /end CHARACTERISTIC
/begin CHARACTERISTIC FCdtc_UGF1_drifttl2 "FCtl_DTC(536)" VALUE 0x00163944 /* @ECU_Address@FCtl_DTC@0x021B5430@ */ ECIPP_ALIGNMENT_UWORD 65535 Compu_IDENTITY 0 65535 PHYS_UNIT "DTC" /end CHARACTERISTIC
/begin CHARACTERISTIC FCdtc_UGF1_drifttol "FCtl_DTC(505)" VALUE 0x00163906 /* @ECU_Address@FCtl_DTC@0x021B53F2@ */ ECIPP_ALIGNMENT_UWORD 65535 Compu_IDENTITY 0 65535 PHYS_UNIT "DTC" /end CHARACTERISTIC
/begin CHARACTERISTIC FCdtc_UGF1_R_hi "FCtl_DTC(244)" VALUE 0x001636FC /* @ECU_Address@FCtl_DTC@0x021B51E8@ */ ECIPP_ALIGNMENT_UWORD 65535 Compu_IDENTITY 0 65535 PHYS_UNIT "DTC" /end CHARACTERISTIC
/begin CHARACTERISTIC FCdtc_UGF1_SR_hi "FCtl_DTC(256)" VALUE 0x00163714 /* @ECU_Address@FCtl_DTC@0x021B5200@ */ ECIPP_ALIGNMENT_UWORD 65535 Compu_IDENTITY 0 65535 PHYS_UNIT "DTC" /end CHARACTERISTIC
/begin CHARACTERISTIC FCdtc_UGF1_SR_slow "FCtl_DTC(254)" VALUE 0x00163710 /* @ECU_Address@FCtl_DTC@0x021B51FC@ */ ECIPP_ALIGNMENT_UWORD 65535 Compu_IDENTITY 0 65535 PHYS_UNIT "DTC" /end CHARACTERISTIC
/begin CHARACTERISTIC FCdtc_UGF1_Sv_hi "FCtl_DTC(250)" VALUE 0x00163708 /* @ECU_Address@FCtl_DTC@0x021B51F4@ */ ECIPP_ALIGNMENT_UWORD 65535 Compu_IDENTITY 0 65535 PHYS_UNIT "DTC" /end CHARACTERISTIC
/begin CHARACTERISTIC FCdtc_UGF2_comm_lost "FCtl_DTC(681)" VALUE 0x00163A66 /* @ECU_Address@FCtl_DTC@0x021B5552@ */ ECIPP_ALIGNMENT_UWORD 65535 Compu_IDENTITY 0 65535 PHYS_UNIT "DTC" /end CHARACTERISTIC
/begin CHARACTERISTIC FCdtc_UGF2_drifttl2 "FCtl_DTC(537)" VALUE 0x00163946 /* @ECU_Address@FCtl_DTC@0x021B5432@ */ ECIPP_ALIGNMENT_UWORD 65535 Compu_IDENTITY 0 65535 PHYS_UNIT "DTC" /end CHARACTERISTIC
/begin CHARACTERISTIC FCdtc_UGF2_drifttol "FCtl_DTC(506)" VALUE 0x00163908 /* @ECU_Address@FCtl_DTC@0x021B53F4@ */ ECIPP_ALIGNMENT_UWORD 65535 Compu_IDENTITY 0 65535 PHYS_UNIT "DTC" /end CHARACTERISTIC
/begin CHARACTERISTIC FCdtc_UGF2_Hv_hi "FCtl_DTC(409)" VALUE 0x00163846 /* @ECU_Address@FCtl_DTC@0x021B5332@ */ ECIPP_ALIGNMENT_UWORD 65535 Compu_IDENTITY 0 65535 PHYS_UNIT "DTC" /end CHARACTERISTIC
/begin CHARACTERISTIC FCdtc_UGF2_internal "FCtl_DTC(408)" VALUE 0x00163844 /* @ECU_Address@FCtl_DTC@0x021B5330@ */ ECIPP_ALIGNMENT_UWORD 65535 Compu_IDENTITY 0 65535 PHYS_UNIT "DTC" /end CHARACTERISTIC
/begin CHARACTERISTIC FCdtc_UGF2_lowsupply "FCtl_DTC(531)" VALUE 0x0016393A /* @ECU_Address@FCtl_DTC@0x021B5426@ */ ECIPP_ALIGNMENT_UWORD 65535 Compu_IDENTITY 0 65535 PHYS_UNIT "DTC" /end CHARACTERISTIC
/begin CHARACTERISTIC FCdtc_UGF2_R_hi "FCtl_DTC(411)" VALUE 0x0016384A /* @ECU_Address@FCtl_DTC@0x021B5336@ */ ECIPP_ALIGNMENT_UWORD 65535 Compu_IDENTITY 0 65535 PHYS_UNIT "DTC" /end CHARACTERISTIC
/begin CHARACTERISTIC FCdtc_UGF2_SR_hi "FCtl_DTC(423)" VALUE 0x00163862 /* @ECU_Address@FCtl_DTC@0x021B534E@ */ ECIPP_ALIGNMENT_UWORD 65535 Compu_IDENTITY 0 65535 PHYS_UNIT "DTC" /end CHARACTERISTIC
/begin CHARACTERISTIC FCdtc_UGF2_SR_slow "FCtl_DTC(421)" VALUE 0x0016385E /* @ECU_Address@FCtl_DTC@0x021B534A@ */ ECIPP_ALIGNMENT_UWORD 65535 Compu_IDENTITY 0 65535 PHYS_UNIT "DTC" /end CHARACTERISTIC
/begin CHARACTERISTIC FCdtc_UGF2_Sv_hi "FCtl_DTC(417)" VALUE 0x00163856 /* @ECU_Address@FCtl_DTC@0x021B5342@ */ ECIPP_ALIGNMENT_UWORD 65535 Compu_IDENTITY 0 65535 PHYS_UNIT "DTC" /end CHARACTERISTIC
/begin CHARACTERISTIC FCdtc_UGF3_comm_lost "FCtl_DTC(682)" VALUE 0x00163A68 /* @ECU_Address@FCtl_DTC@0x021B5554@ */ ECIPP_ALIGNMENT_UWORD 65535 Compu_IDENTITY 0 65535 PHYS_UNIT "DTC" /end CHARACTERISTIC
/begin CHARACTERISTIC FCdtc_UGF3_drifttl2 "FCtl_DTC(604)" VALUE 0x001639CC /* @ECU_Address@FCtl_DTC@0x021B54B8@ */ ECIPP_ALIGNMENT_UWORD 65535 Compu_IDENTITY 0 65535 PHYS_UNIT "DTC" /end CHARACTERISTIC
/begin CHARACTERISTIC FCdtc_UGF3_drifttol "FCtl_DTC(603)" VALUE 0x001639CA /* @ECU_Address@FCtl_DTC@0x021B54B6@ */ ECIPP_ALIGNMENT_UWORD 65535 Compu_IDENTITY 0 65535 PHYS_UNIT "DTC" /end CHARACTERISTIC
/begin CHARACTERISTIC FCdtc_UGF3_Hv_hi "FCtl_DTC(605)" VALUE 0x001639CE /* @ECU_Address@FCtl_DTC@0x021B54BA@ */ ECIPP_ALIGNMENT_UWORD 65535 Compu_IDENTITY 0 65535 PHYS_UNIT "DTC" /end CHARACTERISTIC
/begin CHARACTERISTIC FCdtc_UGF3_internal "FCtl_DTC(601)" VALUE 0x001639C6 /* @ECU_Address@FCtl_DTC@0x021B54B2@ */ ECIPP_ALIGNMENT_UWORD 65535 Compu_IDENTITY 0 65535 PHYS_UNIT "DTC" /end CHARACTERISTIC
/begin CHARACTERISTIC FCdtc_UGF3_lowsupply "FCtl_DTC(602)" VALUE 0x001639C8 /* @ECU_Address@FCtl_DTC@0x021B54B4@ */ ECIPP_ALIGNMENT_UWORD 65535 Compu_IDENTITY 0 65535 PHYS_UNIT "DTC" /end CHARACTERISTIC
/begin CHARACTERISTIC FCdtc_UGF3_R_hi "FCtl_DTC(607)" VALUE 0x001639D2 /* @ECU_Address@FCtl_DTC@0x021B54BE@ */ ECIPP_ALIGNMENT_UWORD 65535 Compu_IDENTITY 0 65535 PHYS_UNIT "DTC" /end CHARACTERISTIC
/begin CHARACTERISTIC FCdtc_UGF3_SR_hi "FCtl_DTC(619)" VALUE 0x001639EA /* @ECU_Address@FCtl_DTC@0x021B54D6@ */ ECIPP_ALIGNMENT_UWORD 65535 Compu_IDENTITY 0 65535 PHYS_UNIT "DTC" /end CHARACTERISTIC
/begin CHARACTERISTIC FCdtc_UGF3_SR_slow "FCtl_DTC(617)" VALUE 0x001639E6 /* @ECU_Address@FCtl_DTC@0x021B54D2@ */ ECIPP_ALIGNMENT_UWORD 65535 Compu_IDENTITY 0 65535 PHYS_UNIT "DTC" /end CHARACTERISTIC
/begin CHARACTERISTIC FCdtc_UGF3_Sv_hi "FCtl_DTC(613)" VALUE 0x001639DE /* @ECU_Address@FCtl_DTC@0x021B54CA@ */ ECIPP_ALIGNMENT_UWORD 65535 Compu_IDENTITY 0 65535 PHYS_UNIT "DTC" /end CHARACTERISTIC
/begin CHARACTERISTIC FCdtc_UGF4_comm_lost "FCtl_DTC(683)" VALUE 0x00163A6A /* @ECU_Address@FCtl_DTC@0x021B5556@ */ ECIPP_ALIGNMENT_UWORD 65535 Compu_IDENTITY 0 65535 PHYS_UNIT "DTC" /end CHARACTERISTIC
/begin CHARACTERISTIC FCfmi_TAUX2_max "FCtl_FMI(552)" VALUE 0x0016533B /* @ECU_Address@FCtl_FMI@0x021B7228@ */ ECIPP_ALIGNMENT_UBYTE 255 Compu_IDENTITY 0 255 PHYS_UNIT "FMI" /end CHARACTERISTIC
/begin CHARACTERISTIC FCfmi_TAUX2_min "FCtl_FMI(553)" VALUE 0x0016533C /* @ECU_Address@FCtl_FMI@0x021B7229@ */ ECIPP_ALIGNMENT_UBYTE 255 Compu_IDENTITY 0 255 PHYS_UNIT "FMI" /end CHARACTERISTIC
/begin CHARACTERISTIC FCfmi_TAUX3_max "FCtl_FMI(554)" VALUE 0x0016533D /* @ECU_Address@FCtl_FMI@0x021B722A@ */ ECIPP_ALIGNMENT_UBYTE 255 Compu_IDENTITY 0 255 PHYS_UNIT "FMI" /end CHARACTERISTIC
/begin CHARACTERISTIC FCfmi_TAUX3_min "FCtl_FMI(555)" VALUE 0x0016533E /* @ECU_Address@FCtl_FMI@0x021B722B@ */ ECIPP_ALIGNMENT_UBYTE 255 Compu_IDENTITY 0 255 PHYS_UNIT "FMI" /end CHARACTERISTIC
/begin CHARACTERISTIC FCfmi_TAUX4_max "FCtl_FMI(556)" VALUE 0x0016533F /* @ECU_Address@FCtl_FMI@0x021B722C@ */ ECIPP_ALIGNMENT_UBYTE 255 Compu_IDENTITY 0 255 PHYS_UNIT "FMI" /end CHARACTERISTIC
/begin CHARACTERISTIC FCfmi_TAUX4_min "FCtl_FMI(557)" VALUE 0x00165340 /* @ECU_Address@FCtl_FMI@0x021B722D@ */ ECIPP_ALIGNMENT_UBYTE 255 Compu_IDENTITY 0 255 PHYS_UNIT "FMI" /end CHARACTERISTIC
/begin CHARACTERISTIC FCfmi_TEL_derate_actv "FCtl_FMI(647)" VALUE 0x0016539A /* @ECU_Address@FCtl_FMI@0x021B7287@ */ ECIPP_ALIGNMENT_UBYTE 255 Compu_IDENTITY 0 255 PHYS_UNIT "FMI" /end CHARACTERISTIC
/begin CHARACTERISTIC FCfmi_TEL_dis "FCtl_FMI(854)" VALUE 0x00165469 /* @ECU_Address@FCtl_FMI@0x021B7356@ */ ECIPP_ALIGNMENT_UBYTE 255 Compu_IDENTITY 0 255 PHYS_UNIT "FMI" /end CHARACTERISTIC
/begin CHARACTERISTIC FCfmi_TEL_intF "FCtl_FMI(855)" VALUE 0x0016546A /* @ECU_Address@FCtl_FMI@0x021B7357@ */ ECIPP_ALIGNMENT_UBYTE 255 Compu_IDENTITY 0 255 PHYS_UNIT "FMI" /end CHARACTERISTIC
/begin CHARACTERISTIC FCfmi_TEL_key_invalid "FCtl_FMI(821)" VALUE 0x00165448 /* @ECU_Address@FCtl_FMI@0x021B7335@ */ ECIPP_ALIGNMENT_UBYTE 255 Compu_IDENTITY 0 255 PHYS_UNIT "FMI" /end CHARACTERISTIC
/begin CHARACTERISTIC FCfmi_TEL_key_to "FCtl_FMI(820)" VALUE 0x00165447 /* @ECU_Address@FCtl_FMI@0x021B7334@ */ ECIPP_ALIGNMENT_UBYTE 255 Compu_IDENTITY 0 255 PHYS_UNIT "FMI" /end CHARACTERISTIC
/begin CHARACTERISTIC FCfmi_TEL_req_to "FCtl_FMI(819)" VALUE 0x00165446 /* @ECU_Address@FCtl_FMI@0x021B7333@ */ ECIPP_ALIGNMENT_UBYTE 255 Compu_IDENTITY 0 255 PHYS_UNIT "FMI" /end CHARACTERISTIC
/begin CHARACTERISTIC FCfmi_TEL_RPM_cmd "FCtl_FMI(822)" VALUE 0x00165449 /* @ECU_Address@FCtl_FMI@0x021B7336@ */ ECIPP_ALIGNMENT_UBYTE 255 Compu_IDENTITY 0 255 PHYS_UNIT "FMI" /end CHARACTERISTIC
/begin CHARACTERISTIC FCfmi_TEL_RPM_psv "FCtl_FMI(825)" VALUE 0x0016544C /* @ECU_Address@FCtl_FMI@0x021B7339@ */ ECIPP_ALIGNMENT_UBYTE 255 Compu_IDENTITY 0 255 PHYS_UNIT "FMI" /end CHARACTERISTIC
/begin CHARACTERISTIC FCfmi_TEL_shutdown_cmd "FCtl_FMI(824)" VALUE 0x0016544B /* @ECU_Address@FCtl_FMI@0x021B7338@ */ ECIPP_ALIGNMENT_UBYTE 255 Compu_IDENTITY 0 255 PHYS_UNIT "FMI" /end CHARACTERISTIC
/begin CHARACTERISTIC FCfmi_TEL_shutdown_psv "FCtl_FMI(827)" VALUE 0x0016544E /* @ECU_Address@FCtl_FMI@0x021B733B@ */ ECIPP_ALIGNMENT_UBYTE 255 Compu_IDENTITY 0 255 PHYS_UNIT "FMI" /end CHARACTERISTIC
/begin CHARACTERISTIC FCfmi_TEL_torq_cmd "FCtl_FMI(823)" VALUE 0x0016544A /* @ECU_Address@FCtl_FMI@0x021B7337@ */ ECIPP_ALIGNMENT_UBYTE 255 Compu_IDENTITY 0 255 PHYS_UNIT "FMI" /end CHARACTERISTIC
/begin CHARACTERISTIC FCfmi_TEL_torq_psv "FCtl_FMI(826)" VALUE 0x0016544D /* @ECU_Address@FCtl_FMI@0x021B733A@ */ ECIPP_ALIGNMENT_UBYTE 255 Compu_IDENTITY 0 255 PHYS_UNIT "FMI" /end CHARACTERISTIC
/begin CHARACTERISTIC FCfmi_TIP_act "FCtl_FMI(145)" VALUE 0x001651A4 /* @ECU_Address@FCtl_FMI@0x021B7091@ */ ECIPP_ALIGNMENT_UBYTE 255 Compu_IDENTITY 0 255 PHYS_UNIT "FMI" /end CHARACTERISTIC
/begin CHARACTERISTIC FCfmi_TIP_maxv "FCtl_FMI(126)" VALUE 0x00165191 /* @ECU_Address@FCtl_FMI@0x021B707E@ */ ECIPP_ALIGNMENT_UBYTE 255 Compu_IDENTITY 0 255 PHYS_UNIT "FMI" /end CHARACTERISTIC
/begin CHARACTERISTIC FCfmi_TIP_minv "FCtl_FMI(127)" VALUE 0x00165192 /* @ECU_Address@FCtl_FMI@0x021B707F@ */ ECIPP_ALIGNMENT_UBYTE 255 Compu_IDENTITY 0 255 PHYS_UNIT "FMI" /end CHARACTERISTIC
/begin CHARACTERISTIC FCfmi_TPS1_max "FCtl_FMI(13)" VALUE 0x00165120 /* @ECU_Address@FCtl_FMI@0x021B700D@ */ ECIPP_ALIGNMENT_UBYTE 255 Compu_IDENTITY 0 255 PHYS_UNIT "FMI" /end CHARACTERISTIC
/begin CHARACTERISTIC FCfmi_TPS1_min "FCtl_FMI(14)" VALUE 0x00165121 /* @ECU_Address@FCtl_FMI@0x021B700E@ */ ECIPP_ALIGNMENT_UBYTE 255 Compu_IDENTITY 0 255 PHYS_UNIT "FMI" /end CHARACTERISTIC
/begin CHARACTERISTIC FCfmi_TPS12_OOR "FCtl_FMI(186)" VALUE 0x001651CD /* @ECU_Address@FCtl_FMI@0x021B70BA@ */ ECIPP_ALIGNMENT_UBYTE 255 Compu_IDENTITY 0 255 PHYS_UNIT "FMI" /end CHARACTERISTIC
/begin CHARACTERISTIC FCfmi_TPS12pct_hi "FCtl_FMI(17)" VALUE 0x00165124 /* @ECU_Address@FCtl_FMI@0x021B7011@ */ ECIPP_ALIGNMENT_UBYTE 255 Compu_IDENTITY 0 255 PHYS_UNIT "FMI" /end CHARACTERISTIC
/begin CHARACTERISTIC FCfmi_TPS12pct_lo "FCtl_FMI(18)" VALUE 0x00165125 /* @ECU_Address@FCtl_FMI@0x021B7012@ */ ECIPP_ALIGNMENT_UBYTE 255 Compu_IDENTITY 0 255 PHYS_UNIT "FMI" /end CHARACTERISTIC
/begin CHARACTERISTIC FCfmi_TPS2_max "FCtl_FMI(15)" VALUE 0x00165122 /* @ECU_Address@FCtl_FMI@0x021B700F@ */ ECIPP_ALIGNMENT_UBYTE 255 Compu_IDENTITY 0 255 PHYS_UNIT "FMI" /end CHARACTERISTIC
/begin CHARACTERISTIC FCfmi_TPS2_min "FCtl_FMI(16)" VALUE 0x00165123 /* @ECU_Address@FCtl_FMI@0x021B7010@ */ ECIPP_ALIGNMENT_UBYTE 255 Compu_IDENTITY 0 255 PHYS_UNIT "FMI" /end CHARACTERISTIC
/begin CHARACTERISTIC FCfmi_TPSerr_neg "FCtl_FMI(91)" VALUE 0x0016516E /* @ECU_Address@FCtl_FMI@0x021B705B@ */ ECIPP_ALIGNMENT_UBYTE 255 Compu_IDENTITY 0 255 PHYS_UNIT "FMI" /end CHARACTERISTIC
/begin CHARACTERISTIC FCfmi_TPSerr_pos "FCtl_FMI(90)" VALUE 0x0016516D /* @ECU_Address@FCtl_FMI@0x021B705A@ */ ECIPP_ALIGNMENT_UBYTE 255 Compu_IDENTITY 0 255 PHYS_UNIT "FMI" /end CHARACTERISTIC
/begin CHARACTERISTIC FCfmi_TRANS_comm "FCtl_FMI(851)" VALUE 0x00165466 /* @ECU_Address@FCtl_FMI@0x021B7353@ */ ECIPP_ALIGNMENT_UBYTE 255 Compu_IDENTITY 0 255 PHYS_UNIT "FMI" /end CHARACTERISTIC
/begin CHARACTERISTIC FCfmi_TRANS_fuel_inh "FCtl_FMI(852)" VALUE 0x00165467 /* @ECU_Address@FCtl_FMI@0x021B7354@ */ ECIPP_ALIGNMENT_UBYTE 255 Compu_IDENTITY 0 255 PHYS_UNIT "FMI" /end CHARACTERISTIC
/begin CHARACTERISTIC FCfmi_TWCDiag_OSC_lo "FCtl_FMI(804)" VALUE 0x00165437 /* @ECU_Address@FCtl_FMI@0x021B7324@ */ ECIPP_ALIGNMENT_UBYTE 255 Compu_IDENTITY 0 255 PHYS_UNIT "FMI" /end CHARACTERISTIC
/begin CHARACTERISTIC FCfmi_UEGOH1_off_open "FCtl_FMI(427)" VALUE 0x001652BE /* @ECU_Address@FCtl_FMI@0x021B71AB@ */ ECIPP_ALIGNMENT_UBYTE 255 Compu_IDENTITY 0 255 PHYS_UNIT "FMI" /end CHARACTERISTIC
/begin CHARACTERISTIC FCfmi_UEGOH1_on_short "FCtl_FMI(428)" VALUE 0x001652BF /* @ECU_Address@FCtl_FMI@0x021B71AC@ */ ECIPP_ALIGNMENT_UBYTE 255 Compu_IDENTITY 0 255 PHYS_UNIT "FMI" /end CHARACTERISTIC
/begin CHARACTERISTIC FCfmi_UEGOH2_off_open "FCtl_FMI(429)" VALUE 0x001652C0 /* @ECU_Address@FCtl_FMI@0x021B71AD@ */ ECIPP_ALIGNMENT_UBYTE 255 Compu_IDENTITY 0 255 PHYS_UNIT "FMI" /end CHARACTERISTIC
/begin CHARACTERISTIC FCfmi_UEGOH2_on_short "FCtl_FMI(430)" VALUE 0x001652C1 /* @ECU_Address@FCtl_FMI@0x021B71AE@ */ ECIPP_ALIGNMENT_UBYTE 255 Compu_IDENTITY 0 255 PHYS_UNIT "FMI" /end CHARACTERISTIC
/begin CHARACTERISTIC FCfmi_UEGOH3_off_open "FCtl_FMI(622)" VALUE 0x00165381 /* @ECU_Address@FCtl_FMI@0x021B726E@ */ ECIPP_ALIGNMENT_UBYTE 255 Compu_IDENTITY 0 255 PHYS_UNIT "FMI" /end CHARACTERISTIC
/begin CHARACTERISTIC FCfmi_UEGOH3_on_short "FCtl_FMI(623)" VALUE 0x00165382 /* @ECU_Address@FCtl_FMI@0x021B726F@ */ ECIPP_ALIGNMENT_UBYTE 255 Compu_IDENTITY 0 255 PHYS_UNIT "FMI" /end CHARACTERISTIC
/begin CHARACTERISTIC FCfmi_UEGOH4_off_open "FCtl_FMI(645)" VALUE 0x00165398 /* @ECU_Address@FCtl_FMI@0x021B7285@ */ ECIPP_ALIGNMENT_UBYTE 255 Compu_IDENTITY 0 255 PHYS_UNIT "FMI" /end CHARACTERISTIC
/begin CHARACTERISTIC FCfmi_UEGOH4_on_short "FCtl_FMI(646)" VALUE 0x00165399 /* @ECU_Address@FCtl_FMI@0x021B7286@ */ ECIPP_ALIGNMENT_UBYTE 255 Compu_IDENTITY 0 255 PHYS_UNIT "FMI" /end CHARACTERISTIC
/begin CHARACTERISTIC FCfmi_UGF_Hv_hi "FCtl_FMI(242)" VALUE 0x00165205 /* @ECU_Address@FCtl_FMI@0x021B70F2@ */ ECIPP_ALIGNMENT_UBYTE 255 Compu_IDENTITY 0 255 PHYS_UNIT "FMI" /end CHARACTERISTIC
/begin CHARACTERISTIC FCfmi_UGF_internal "FCtl_FMI(241)" VALUE 0x00165204 /* @ECU_Address@FCtl_FMI@0x021B70F1@ */ ECIPP_ALIGNMENT_UBYTE 255 Compu_IDENTITY 0 255 PHYS_UNIT "FMI" /end CHARACTERISTIC
/begin CHARACTERISTIC FCfmi_UGF_lowsupply "FCtl_FMI(530)" VALUE 0x00165325 /* @ECU_Address@FCtl_FMI@0x021B7212@ */ ECIPP_ALIGNMENT_UBYTE 255 Compu_IDENTITY 0 255 PHYS_UNIT "FMI" /end CHARACTERISTIC
/begin CHARACTERISTIC FCfmi_UGF1_comm_lost "FCtl_FMI(680)" VALUE 0x001653BB /* @ECU_Address@FCtl_FMI@0x021B72A8@ */ ECIPP_ALIGNMENT_UBYTE 255 Compu_IDENTITY 0 255 PHYS_UNIT "FMI" /end CHARACTERISTIC
/begin CHARACTERISTIC FCfmi_UGF1_drifttl2 "FCtl_FMI(536)" VALUE 0x0016532B /* @ECU_Address@FCtl_FMI@0x021B7218@ */ ECIPP_ALIGNMENT_UBYTE 255 Compu_IDENTITY 0 255 PHYS_UNIT "FMI" /end CHARACTERISTIC
/begin CHARACTERISTIC FCfmi_UGF1_drifttol "FCtl_FMI(505)" VALUE 0x0016530C /* @ECU_Address@FCtl_FMI@0x021B71F9@ */ ECIPP_ALIGNMENT_UBYTE 255 Compu_IDENTITY 0 255 PHYS_UNIT "FMI" /end CHARACTERISTIC
/begin CHARACTERISTIC FCfmi_UGF1_R_hi "FCtl_FMI(244)" VALUE 0x00165207 /* @ECU_Address@FCtl_FMI@0x021B70F4@ */ ECIPP_ALIGNMENT_UBYTE 255 Compu_IDENTITY 0 255 PHYS_UNIT "FMI" /end CHARACTERISTIC
/begin CHARACTERISTIC FCfmi_UGF1_SR_hi "FCtl_FMI(256)" VALUE 0x00165213 /* @ECU_Address@FCtl_FMI@0x021B7100@ */ ECIPP_ALIGNMENT_UBYTE 255 Compu_IDENTITY 0 255 PHYS_UNIT "FMI" /end CHARACTERISTIC
/begin CHARACTERISTIC FCfmi_UGF1_SR_slow "FCtl_FMI(254)" VALUE 0x00165211 /* @ECU_Address@FCtl_FMI@0x021B70FE@ */ ECIPP_ALIGNMENT_UBYTE 255 Compu_IDENTITY 0 255 PHYS_UNIT "FMI" /end CHARACTERISTIC
/begin CHARACTERISTIC FCfmi_UGF1_Sv_hi "FCtl_FMI(250)" VALUE 0x0016520D /* @ECU_Address@FCtl_FMI@0x021B70FA@ */ ECIPP_ALIGNMENT_UBYTE 255 Compu_IDENTITY 0 255 PHYS_UNIT "FMI" /end CHARACTERISTIC
/begin CHARACTERISTIC FCfmi_UGF2_comm_lost "FCtl_FMI(681)" VALUE 0x001653BC /* @ECU_Address@FCtl_FMI@0x021B72A9@ */ ECIPP_ALIGNMENT_UBYTE 255 Compu_IDENTITY 0 255 PHYS_UNIT "FMI" /end CHARACTERISTIC
/begin CHARACTERISTIC FCfmi_UGF2_drifttl2 "FCtl_FMI(537)" VALUE 0x0016532C /* @ECU_Address@FCtl_FMI@0x021B7219@ */ ECIPP_ALIGNMENT_UBYTE 255 Compu_IDENTITY 0 255 PHYS_UNIT "FMI" /end CHARACTERISTIC
/begin CHARACTERISTIC FCfmi_UGF2_drifttol "FCtl_FMI(506)" VALUE 0x0016530D /* @ECU_Address@FCtl_FMI@0x021B71FA@ */ ECIPP_ALIGNMENT_UBYTE 255 Compu_IDENTITY 0 255 PHYS_UNIT "FMI" /end CHARACTERISTIC
/begin CHARACTERISTIC FCfmi_UGF2_Hv_hi "FCtl_FMI(409)" VALUE 0x001652AC /* @ECU_Address@FCtl_FMI@0x021B7199@ */ ECIPP_ALIGNMENT_UBYTE 255 Compu_IDENTITY 0 255 PHYS_UNIT "FMI" /end CHARACTERISTIC
/begin CHARACTERISTIC FCfmi_UGF2_internal "FCtl_FMI(408)" VALUE 0x001652AB /* @ECU_Address@FCtl_FMI@0x021B7198@ */ ECIPP_ALIGNMENT_UBYTE 255 Compu_IDENTITY 0 255 PHYS_UNIT "FMI" /end CHARACTERISTIC
/begin CHARACTERISTIC FCfmi_UGF2_lowsupply "FCtl_FMI(531)" VALUE 0x00165326 /* @ECU_Address@FCtl_FMI@0x021B7213@ */ ECIPP_ALIGNMENT_UBYTE 255 Compu_IDENTITY 0 255 PHYS_UNIT "FMI" /end CHARACTERISTIC
/begin CHARACTERISTIC FCfmi_UGF2_R_hi "FCtl_FMI(411)" VALUE 0x001652AE /* @ECU_Address@FCtl_FMI@0x021B719B@ */ ECIPP_ALIGNMENT_UBYTE 255 Compu_IDENTITY 0 255 PHYS_UNIT "FMI" /end CHARACTERISTIC
/begin CHARACTERISTIC FCfmi_UGF2_SR_hi "FCtl_FMI(423)" VALUE 0x001652BA /* @ECU_Address@FCtl_FMI@0x021B71A7@ */ ECIPP_ALIGNMENT_UBYTE 255 Compu_IDENTITY 0 255 PHYS_UNIT "FMI" /end CHARACTERISTIC
/begin CHARACTERISTIC FCfmi_UGF2_SR_slow "FCtl_FMI(421)" VALUE 0x001652B8 /* @ECU_Address@FCtl_FMI@0x021B71A5@ */ ECIPP_ALIGNMENT_UBYTE 255 Compu_IDENTITY 0 255 PHYS_UNIT "FMI" /end CHARACTERISTIC
/begin CHARACTERISTIC FCfmi_UGF2_Sv_hi "FCtl_FMI(417)" VALUE 0x001652B4 /* @ECU_Address@FCtl_FMI@0x021B71A1@ */ ECIPP_ALIGNMENT_UBYTE 255 Compu_IDENTITY 0 255 PHYS_UNIT "FMI" /end CHARACTERISTIC
/begin CHARACTERISTIC FCfmi_UGF3_comm_lost "FCtl_FMI(682)" VALUE 0x001653BD /* @ECU_Address@FCtl_FMI@0x021B72AA@ */ ECIPP_ALIGNMENT_UBYTE 255 Compu_IDENTITY 0 255 PHYS_UNIT "FMI" /end CHARACTERISTIC
/begin CHARACTERISTIC FCfmi_UGF3_drifttl2 "FCtl_FMI(604)" VALUE 0x0016536F /* @ECU_Address@FCtl_FMI@0x021B725C@ */ ECIPP_ALIGNMENT_UBYTE 255 Compu_IDENTITY 0 255 PHYS_UNIT "FMI" /end CHARACTERISTIC
/begin CHARACTERISTIC FCfmi_UGF3_drifttol "FCtl_FMI(603)" VALUE 0x0016536E /* @ECU_Address@FCtl_FMI@0x021B725B@ */ ECIPP_ALIGNMENT_UBYTE 255 Compu_IDENTITY 0 255 PHYS_UNIT "FMI" /end CHARACTERISTIC
/begin CHARACTERISTIC FCfmi_UGF3_Hv_hi "FCtl_FMI(605)" VALUE 0x00165370 /* @ECU_Address@FCtl_FMI@0x021B725D@ */ ECIPP_ALIGNMENT_UBYTE 255 Compu_IDENTITY 0 255 PHYS_UNIT "FMI" /end CHARACTERISTIC
/begin CHARACTERISTIC FCfmi_UGF3_internal "FCtl_FMI(601)" VALUE 0x0016536C /* @ECU_Address@FCtl_FMI@0x021B7259@ */ ECIPP_ALIGNMENT_UBYTE 255 Compu_IDENTITY 0 255 PHYS_UNIT "FMI" /end CHARACTERISTIC
/begin CHARACTERISTIC FCfmi_UGF3_lowsupply "FCtl_FMI(602)" VALUE 0x0016536D /* @ECU_Address@FCtl_FMI@0x021B725A@ */ ECIPP_ALIGNMENT_UBYTE 255 Compu_IDENTITY 0 255 PHYS_UNIT "FMI" /end CHARACTERISTIC
/begin CHARACTERISTIC FCfmi_UGF3_R_hi "FCtl_FMI(607)" VALUE 0x00165372 /* @ECU_Address@FCtl_FMI@0x021B725F@ */ ECIPP_ALIGNMENT_UBYTE 255 Compu_IDENTITY 0 255 PHYS_UNIT "FMI" /end CHARACTERISTIC
/begin CHARACTERISTIC FCfmi_UGF3_SR_hi "FCtl_FMI(619)" VALUE 0x0016537E /* @ECU_Address@FCtl_FMI@0x021B726B@ */ ECIPP_ALIGNMENT_UBYTE 255 Compu_IDENTITY 0 255 PHYS_UNIT "FMI" /end CHARACTERISTIC
/begin CHARACTERISTIC FCfmi_UGF3_SR_slow "FCtl_FMI(617)" VALUE 0x0016537C /* @ECU_Address@FCtl_FMI@0x021B7269@ */ ECIPP_ALIGNMENT_UBYTE 255 Compu_IDENTITY 0 255 PHYS_UNIT "FMI" /end CHARACTERISTIC
/begin CHARACTERISTIC FCfmi_UGF3_Sv_hi "FCtl_FMI(613)" VALUE 0x00165378 /* @ECU_Address@FCtl_FMI@0x021B7265@ */ ECIPP_ALIGNMENT_UBYTE 255 Compu_IDENTITY 0 255 PHYS_UNIT "FMI" /end CHARACTERISTIC
/begin CHARACTERISTIC FCfmi_UGF4_comm_lost "FCtl_FMI(683)" VALUE 0x001653BE /* @ECU_Address@FCtl_FMI@0x021B72AB@ */ ECIPP_ALIGNMENT_UBYTE 255 Compu_IDENTITY 0 255 PHYS_UNIT "FMI" /end CHARACTERISTIC
/begin CHARACTERISTIC FCftb_TAUX2_max "FCtl_FTB_0x04(552)" VALUE 0x00165699 /* @ECU_Address@FCtl_FTB_0x04@0x024C5228@ */ ECIPP_ALIGNMENT_UBYTE 255 Compu_IDENTITY 0 255 PHYS_UNIT "FTB" /end CHARACTERISTIC
/begin CHARACTERISTIC FCftb_TAUX2_min "FCtl_FTB_0x04(553)" VALUE 0x0016569A /* @ECU_Address@FCtl_FTB_0x04@0x024C5229@ */ ECIPP_ALIGNMENT_UBYTE 255 Compu_IDENTITY 0 255 PHYS_UNIT "FTB" /end CHARACTERISTIC
/begin CHARACTERISTIC FCftb_TAUX3_max "FCtl_FTB_0x04(554)" VALUE 0x0016569B /* @ECU_Address@FCtl_FTB_0x04@0x024C522A@ */ ECIPP_ALIGNMENT_UBYTE 255 Compu_IDENTITY 0 255 PHYS_UNIT "FTB" /end CHARACTERISTIC
/begin CHARACTERISTIC FCftb_TAUX3_min "FCtl_FTB_0x04(555)" VALUE 0x0016569C /* @ECU_Address@FCtl_FTB_0x04@0x024C522B@ */ ECIPP_ALIGNMENT_UBYTE 255 Compu_IDENTITY 0 255 PHYS_UNIT "FTB" /end CHARACTERISTIC
/begin CHARACTERISTIC FCftb_TAUX4_max "FCtl_FTB_0x04(556)" VALUE 0x0016569D /* @ECU_Address@FCtl_FTB_0x04@0x024C522C@ */ ECIPP_ALIGNMENT_UBYTE 255 Compu_IDENTITY 0 255 PHYS_UNIT "FTB" /end CHARACTERISTIC
/begin CHARACTERISTIC FCftb_TAUX4_min "FCtl_FTB_0x04(557)" VALUE 0x0016569E /* @ECU_Address@FCtl_FTB_0x04@0x024C522D@ */ ECIPP_ALIGNMENT_UBYTE 255 Compu_IDENTITY 0 255 PHYS_UNIT "FTB" /end CHARACTERISTIC
/begin CHARACTERISTIC FCftb_TEL_derate_actv "FCtl_FTB_0x04(647)" VALUE 0x001656F8 /* @ECU_Address@FCtl_FTB_0x04@0x024C5287@ */ ECIPP_ALIGNMENT_UBYTE 255 Compu_IDENTITY 0 255 PHYS_UNIT "FTB" /end CHARACTERISTIC
/begin CHARACTERISTIC FCftb_TEL_dis "FCtl_FTB_0x04(854)" VALUE 0x001657C7 /* @ECU_Address@FCtl_FTB_0x04@0x024C5356@ */ ECIPP_ALIGNMENT_UBYTE 255 Compu_IDENTITY 0 255 PHYS_UNIT "FTB" /end CHARACTERISTIC
/begin CHARACTERISTIC FCftb_TEL_intF "FCtl_FTB_0x04(855)" VALUE 0x001657C8 /* @ECU_Address@FCtl_FTB_0x04@0x024C5357@ */ ECIPP_ALIGNMENT_UBYTE 255 Compu_IDENTITY 0 255 PHYS_UNIT "FTB" /end CHARACTERISTIC
/begin CHARACTERISTIC FCftb_TEL_key_invalid "FCtl_FTB_0x04(821)" VALUE 0x001657A6 /* @ECU_Address@FCtl_FTB_0x04@0x024C5335@ */ ECIPP_ALIGNMENT_UBYTE 255 Compu_IDENTITY 0 255 PHYS_UNIT "FTB" /end CHARACTERISTIC
/begin CHARACTERISTIC FCftb_TEL_key_to "FCtl_FTB_0x04(820)" VALUE 0x001657A5 /* @ECU_Address@FCtl_FTB_0x04@0x024C5334@ */ ECIPP_ALIGNMENT_UBYTE 255 Compu_IDENTITY 0 255 PHYS_UNIT "FTB" /end CHARACTERISTIC
/begin CHARACTERISTIC FCftb_TEL_req_to "FCtl_FTB_0x04(819)" VALUE 0x001657A4 /* @ECU_Address@FCtl_FTB_0x04@0x024C5333@ */ ECIPP_ALIGNMENT_UBYTE 255 Compu_IDENTITY 0 255 PHYS_UNIT "FTB" /end CHARACTERISTIC
/begin CHARACTERISTIC FCftb_TEL_RPM_cmd "FCtl_FTB_0x04(822)" VALUE 0x001657A7 /* @ECU_Address@FCtl_FTB_0x04@0x024C5336@ */ ECIPP_ALIGNMENT_UBYTE 255 Compu_IDENTITY 0 255 PHYS_UNIT "FTB" /end CHARACTERISTIC
/begin CHARACTERISTIC FCftb_TEL_RPM_psv "FCtl_FTB_0x04(825)" VALUE 0x001657AA /* @ECU_Address@FCtl_FTB_0x04@0x024C5339@ */ ECIPP_ALIGNMENT_UBYTE 255 Compu_IDENTITY 0 255 PHYS_UNIT "FTB" /end CHARACTERISTIC
/begin CHARACTERISTIC FCftb_TEL_shutdown_cmd "FCtl_FTB_0x04(824)" VALUE 0x001657A9 /* @ECU_Address@FCtl_FTB_0x04@0x024C5338@ */ ECIPP_ALIGNMENT_UBYTE 255 Compu_IDENTITY 0 255 PHYS_UNIT "FTB" /end CHARACTERISTIC
/begin CHARACTERISTIC FCftb_TEL_shutdown_psv "FCtl_FTB_0x04(827)" VALUE 0x001657AC /* @ECU_Address@FCtl_FTB_0x04@0x024C533B@ */ ECIPP_ALIGNMENT_UBYTE 255 Compu_IDENTITY 0 255 PHYS_UNIT "FTB" /end CHARACTERISTIC
/begin CHARACTERISTIC FCftb_TEL_torq_cmd "FCtl_FTB_0x04(823)" VALUE 0x001657A8 /* @ECU_Address@FCtl_FTB_0x04@0x024C5337@ */ ECIPP_ALIGNMENT_UBYTE 255 Compu_IDENTITY 0 255 PHYS_UNIT "FTB" /end CHARACTERISTIC
/begin CHARACTERISTIC FCftb_TEL_torq_psv "FCtl_FTB_0x04(826)" VALUE 0x001657AB /* @ECU_Address@FCtl_FTB_0x04@0x024C533A@ */ ECIPP_ALIGNMENT_UBYTE 255 Compu_IDENTITY 0 255 PHYS_UNIT "FTB" /end CHARACTERISTIC
/begin CHARACTERISTIC FCftb_TIP_act "FCtl_FTB_0x04(145)" VALUE 0x00165502 /* @ECU_Address@FCtl_FTB_0x04@0x024C5091@ */ ECIPP_ALIGNMENT_UBYTE 255 Compu_IDENTITY 0 255 PHYS_UNIT "FTB" /end CHARACTERISTIC
/begin CHARACTERISTIC FCftb_TIP_maxv "FCtl_FTB_0x04(126)" VALUE 0x001654EF /* @ECU_Address@FCtl_FTB_0x04@0x024C507E@ */ ECIPP_ALIGNMENT_UBYTE 255 Compu_IDENTITY 0 255 PHYS_UNIT "FTB" /end CHARACTERISTIC
/begin CHARACTERISTIC FCftb_TIP_minv "FCtl_FTB_0x04(127)" VALUE 0x001654F0 /* @ECU_Address@FCtl_FTB_0x04@0x024C507F@ */ ECIPP_ALIGNMENT_UBYTE 255 Compu_IDENTITY 0 255 PHYS_UNIT "FTB" /end CHARACTERISTIC
/begin CHARACTERISTIC FCftb_TPS1_max "FCtl_FTB_0x04(13)" VALUE 0x0016547E /* @ECU_Address@FCtl_FTB_0x04@0x024C500D@ */ ECIPP_ALIGNMENT_UBYTE 255 Compu_IDENTITY 0 255 PHYS_UNIT "FTB" /end CHARACTERISTIC
/begin CHARACTERISTIC FCftb_TPS1_min "FCtl_FTB_0x04(14)" VALUE 0x0016547F /* @ECU_Address@FCtl_FTB_0x04@0x024C500E@ */ ECIPP_ALIGNMENT_UBYTE 255 Compu_IDENTITY 0 255 PHYS_UNIT "FTB" /end CHARACTERISTIC
/begin CHARACTERISTIC FCftb_TPS12_OOR "FCtl_FTB_0x04(186)" VALUE 0x0016552B /* @ECU_Address@FCtl_FTB_0x04@0x024C50BA@ */ ECIPP_ALIGNMENT_UBYTE 255 Compu_IDENTITY 0 255 PHYS_UNIT "FTB" /end CHARACTERISTIC
/begin CHARACTERISTIC FCftb_TPS12pct_hi "FCtl_FTB_0x04(17)" VALUE 0x00165482 /* @ECU_Address@FCtl_FTB_0x04@0x024C5011@ */ ECIPP_ALIGNMENT_UBYTE 255 Compu_IDENTITY 0 255 PHYS_UNIT "FTB" /end CHARACTERISTIC
/begin CHARACTERISTIC FCftb_TPS12pct_lo "FCtl_FTB_0x04(18)" VALUE 0x00165483 /* @ECU_Address@FCtl_FTB_0x04@0x024C5012@ */ ECIPP_ALIGNMENT_UBYTE 255 Compu_IDENTITY 0 255 PHYS_UNIT "FTB" /end CHARACTERISTIC
/begin CHARACTERISTIC FCftb_TPS2_max "FCtl_FTB_0x04(15)" VALUE 0x00165480 /* @ECU_Address@FCtl_FTB_0x04@0x024C500F@ */ ECIPP_ALIGNMENT_UBYTE 255 Compu_IDENTITY 0 255 PHYS_UNIT "FTB" /end CHARACTERISTIC
/begin CHARACTERISTIC FCftb_TPS2_min "FCtl_FTB_0x04(16)" VALUE 0x00165481 /* @ECU_Address@FCtl_FTB_0x04@0x024C5010@ */ ECIPP_ALIGNMENT_UBYTE 255 Compu_IDENTITY 0 255 PHYS_UNIT "FTB" /end CHARACTERISTIC
/begin CHARACTERISTIC FCftb_TPSerr_neg "FCtl_FTB_0x04(91)" VALUE 0x001654CC /* @ECU_Address@FCtl_FTB_0x04@0x024C505B@ */ ECIPP_ALIGNMENT_UBYTE 255 Compu_IDENTITY 0 255 PHYS_UNIT "FTB" /end CHARACTERISTIC
/begin CHARACTERISTIC FCftb_TPSerr_pos "FCtl_FTB_0x04(90)" VALUE 0x001654CB /* @ECU_Address@FCtl_FTB_0x04@0x024C505A@ */ ECIPP_ALIGNMENT_UBYTE 255 Compu_IDENTITY 0 255 PHYS_UNIT "FTB" /end CHARACTERISTIC
/begin CHARACTERISTIC FCftb_TRANS_comm "FCtl_FTB_0x04(851)" VALUE 0x001657C4 /* @ECU_Address@FCtl_FTB_0x04@0x024C5353@ */ ECIPP_ALIGNMENT_UBYTE 255 Compu_IDENTITY 0 255 PHYS_UNIT "FTB" /end CHARACTERISTIC
/begin CHARACTERISTIC FCftb_TRANS_fuel_inh "FCtl_FTB_0x04(852)" VALUE 0x001657C5 /* @ECU_Address@FCtl_FTB_0x04@0x024C5354@ */ ECIPP_ALIGNMENT_UBYTE 255 Compu_IDENTITY 0 255 PHYS_UNIT "FTB" /end CHARACTERISTIC
/begin CHARACTERISTIC FCftb_TWCDiag_OSC_lo "FCtl_FTB_0x04(804)" VALUE 0x00165795 /* @ECU_Address@FCtl_FTB_0x04@0x024C5324@ */ ECIPP_ALIGNMENT_UBYTE 255 Compu_IDENTITY 0 255 PHYS_UNIT "FTB" /end CHARACTERISTIC
/begin CHARACTERISTIC FCftb_UEGOH1_off_open "FCtl_FTB_0x04(427)" VALUE 0x0016561C /* @ECU_Address@FCtl_FTB_0x04@0x024C51AB@ */ ECIPP_ALIGNMENT_UBYTE 255 Compu_IDENTITY 0 255 PHYS_UNIT "FTB" /end CHARACTERISTIC
/begin CHARACTERISTIC FCftb_UEGOH1_on_short "FCtl_FTB_0x04(428)" VALUE 0x0016561D /* @ECU_Address@FCtl_FTB_0x04@0x024C51AC@ */ ECIPP_ALIGNMENT_UBYTE 255 Compu_IDENTITY 0 255 PHYS_UNIT "FTB" /end CHARACTERISTIC
/begin CHARACTERISTIC FCftb_UEGOH2_off_open "FCtl_FTB_0x04(429)" VALUE 0x0016561E /* @ECU_Address@FCtl_FTB_0x04@0x024C51AD@ */ ECIPP_ALIGNMENT_UBYTE 255 Compu_IDENTITY 0 255 PHYS_UNIT "FTB" /end CHARACTERISTIC
/begin CHARACTERISTIC FCftb_UEGOH2_on_short "FCtl_FTB_0x04(430)" VALUE 0x0016561F /* @ECU_Address@FCtl_FTB_0x04@0x024C51AE@ */ ECIPP_ALIGNMENT_UBYTE 255 Compu_IDENTITY 0 255 PHYS_UNIT "FTB" /end CHARACTERISTIC
/begin CHARACTERISTIC FCftb_UEGOH3_off_open "FCtl_FTB_0x04(622)" VALUE 0x001656DF /* @ECU_Address@FCtl_FTB_0x04@0x024C526E@ */ ECIPP_ALIGNMENT_UBYTE 255 Compu_IDENTITY 0 255 PHYS_UNIT "FTB" /end CHARACTERISTIC
/begin CHARACTERISTIC FCftb_UEGOH3_on_short "FCtl_FTB_0x04(623)" VALUE 0x001656E0 /* @ECU_Address@FCtl_FTB_0x04@0x024C526F@ */ ECIPP_ALIGNMENT_UBYTE 255 Compu_IDENTITY 0 255 PHYS_UNIT "FTB" /end CHARACTERISTIC
/begin CHARACTERISTIC FCftb_UEGOH4_off_open "FCtl_FTB_0x04(645)" VALUE 0x001656F6 /* @ECU_Address@FCtl_FTB_0x04@0x024C5285@ */ ECIPP_ALIGNMENT_UBYTE 255 Compu_IDENTITY 0 255 PHYS_UNIT "FTB" /end CHARACTERISTIC
/begin CHARACTERISTIC FCftb_UEGOH4_on_short "FCtl_FTB_0x04(646)" VALUE 0x001656F7 /* @ECU_Address@FCtl_FTB_0x04@0x024C5286@ */ ECIPP_ALIGNMENT_UBYTE 255 Compu_IDENTITY 0 255 PHYS_UNIT "FTB" /end CHARACTERISTIC
/begin CHARACTERISTIC FCftb_UGF_Hv_hi "FCtl_FTB_0x04(242)" VALUE 0x00165563 /* @ECU_Address@FCtl_FTB_0x04@0x024C50F2@ */ ECIPP_ALIGNMENT_UBYTE 255 Compu_IDENTITY 0 255 PHYS_UNIT "FTB" /end CHARACTERISTIC
/begin CHARACTERISTIC FCftb_UGF_internal "FCtl_FTB_0x04(241)" VALUE 0x00165562 /* @ECU_Address@FCtl_FTB_0x04@0x024C50F1@ */ ECIPP_ALIGNMENT_UBYTE 255 Compu_IDENTITY 0 255 PHYS_UNIT "FTB" /end CHARACTERISTIC
/begin CHARACTERISTIC FCftb_UGF_lowsupply "FCtl_FTB_0x04(530)" VALUE 0x00165683 /* @ECU_Address@FCtl_FTB_0x04@0x024C5212@ */ ECIPP_ALIGNMENT_UBYTE 255 Compu_IDENTITY 0 255 PHYS_UNIT "FTB" /end CHARACTERISTIC
/begin CHARACTERISTIC FCftb_UGF1_comm_lost "FCtl_FTB_0x04(680)" VALUE 0x00165719 /* @ECU_Address@FCtl_FTB_0x04@0x024C52A8@ */ ECIPP_ALIGNMENT_UBYTE 255 Compu_IDENTITY 0 255 PHYS_UNIT "FTB" /end CHARACTERISTIC
/begin CHARACTERISTIC FCftb_UGF1_drifttl2 "FCtl_FTB_0x04(536)" VALUE 0x00165689 /* @ECU_Address@FCtl_FTB_0x04@0x024C5218@ */ ECIPP_ALIGNMENT_UBYTE 255 Compu_IDENTITY 0 255 PHYS_UNIT "FTB" /end CHARACTERISTIC
/begin CHARACTERISTIC FCftb_UGF1_drifttol "FCtl_FTB_0x04(505)" VALUE 0x0016566A /* @ECU_Address@FCtl_FTB_0x04@0x024C51F9@ */ ECIPP_ALIGNMENT_UBYTE 255 Compu_IDENTITY 0 255 PHYS_UNIT "FTB" /end CHARACTERISTIC
/begin CHARACTERISTIC FCftb_UGF1_R_hi "FCtl_FTB_0x04(244)" VALUE 0x00165565 /* @ECU_Address@FCtl_FTB_0x04@0x024C50F4@ */ ECIPP_ALIGNMENT_UBYTE 255 Compu_IDENTITY 0 255 PHYS_UNIT "FTB" /end CHARACTERISTIC
/begin CHARACTERISTIC FCftb_UGF1_SR_hi "FCtl_FTB_0x04(256)" VALUE 0x00165571 /* @ECU_Address@FCtl_FTB_0x04@0x024C5100@ */ ECIPP_ALIGNMENT_UBYTE 255 Compu_IDENTITY 0 255 PHYS_UNIT "FTB" /end CHARACTERISTIC
/begin CHARACTERISTIC FCftb_UGF1_SR_slow "FCtl_FTB_0x04(254)" VALUE 0x0016556F /* @ECU_Address@FCtl_FTB_0x04@0x024C50FE@ */ ECIPP_ALIGNMENT_UBYTE 255 Compu_IDENTITY 0 255 PHYS_UNIT "FTB" /end CHARACTERISTIC
/begin CHARACTERISTIC FCftb_UGF1_Sv_hi "FCtl_FTB_0x04(250)" VALUE 0x0016556B /* @ECU_Address@FCtl_FTB_0x04@0x024C50FA@ */ ECIPP_ALIGNMENT_UBYTE 255 Compu_IDENTITY 0 255 PHYS_UNIT "FTB" /end CHARACTERISTIC
/begin CHARACTERISTIC FCftb_UGF2_comm_lost "FCtl_FTB_0x04(681)" VALUE 0x0016571A /* @ECU_Address@FCtl_FTB_0x04@0x024C52A9@ */ ECIPP_ALIGNMENT_UBYTE 255 Compu_IDENTITY 0 255 PHYS_UNIT "FTB" /end CHARACTERISTIC
/begin CHARACTERISTIC FCftb_UGF2_drifttl2 "FCtl_FTB_0x04(537)" VALUE 0x0016568A /* @ECU_Address@FCtl_FTB_0x04@0x024C5219@ */ ECIPP_ALIGNMENT_UBYTE 255 Compu_IDENTITY 0 255 PHYS_UNIT "FTB" /end CHARACTERISTIC
/begin CHARACTERISTIC FCftb_UGF2_drifttol "FCtl_FTB_0x04(506)" VALUE 0x0016566B /* @ECU_Address@FCtl_FTB_0x04@0x024C51FA@ */ ECIPP_ALIGNMENT_UBYTE 255 Compu_IDENTITY 0 255 PHYS_UNIT "FTB" /end CHARACTERISTIC
/begin CHARACTERISTIC FCftb_UGF2_Hv_hi "FCtl_FTB_0x04(409)" VALUE 0x0016560A /* @ECU_Address@FCtl_FTB_0x04@0x024C5199@ */ ECIPP_ALIGNMENT_UBYTE 255 Compu_IDENTITY 0 255 PHYS_UNIT "FTB" /end CHARACTERISTIC
/begin CHARACTERISTIC FCftb_UGF2_internal "FCtl_FTB_0x04(408)" VALUE 0x00165609 /* @ECU_Address@FCtl_FTB_0x04@0x024C5198@ */ ECIPP_ALIGNMENT_UBYTE 255 Compu_IDENTITY 0 255 PHYS_UNIT "FTB" /end CHARACTERISTIC
/begin CHARACTERISTIC FCftb_UGF2_lowsupply "FCtl_FTB_0x04(531)" VALUE 0x00165684 /* @ECU_Address@FCtl_FTB_0x04@0x024C5213@ */ ECIPP_ALIGNMENT_UBYTE 255 Compu_IDENTITY 0 255 PHYS_UNIT "FTB" /end CHARACTERISTIC
/begin CHARACTERISTIC FCftb_UGF2_R_hi "FCtl_FTB_0x04(411)" VALUE 0x0016560C /* @ECU_Address@FCtl_FTB_0x04@0x024C519B@ */ ECIPP_ALIGNMENT_UBYTE 255 Compu_IDENTITY 0 255 PHYS_UNIT "FTB" /end CHARACTERISTIC
/begin CHARACTERISTIC FCftb_UGF2_SR_hi "FCtl_FTB_0x04(423)" VALUE 0x00165618 /* @ECU_Address@FCtl_FTB_0x04@0x024C51A7@ */ ECIPP_ALIGNMENT_UBYTE 255 Compu_IDENTITY 0 255 PHYS_UNIT "FTB" /end CHARACTERISTIC
/begin CHARACTERISTIC FCftb_UGF2_SR_slow "FCtl_FTB_0x04(421)" VALUE 0x00165616 /* @ECU_Address@FCtl_FTB_0x04@0x024C51A5@ */ ECIPP_ALIGNMENT_UBYTE 255 Compu_IDENTITY 0 255 PHYS_UNIT "FTB" /end CHARACTERISTIC
/begin CHARACTERISTIC FCftb_UGF2_Sv_hi "FCtl_FTB_0x04(417)" VALUE 0x00165612 /* @ECU_Address@FCtl_FTB_0x04@0x024C51A1@ */ ECIPP_ALIGNMENT_UBYTE 255 Compu_IDENTITY 0 255 PHYS_UNIT "FTB" /end CHARACTERISTIC
/begin CHARACTERISTIC FCftb_UGF3_comm_lost "FCtl_FTB_0x04(682)" VALUE 0x0016571B /* @ECU_Address@FCtl_FTB_0x04@0x024C52AA@ */ ECIPP_ALIGNMENT_UBYTE 255 Compu_IDENTITY 0 255 PHYS_UNIT "FTB" /end CHARACTERISTIC
/begin CHARACTERISTIC FCftb_UGF3_drifttl2 "FCtl_FTB_0x04(604)" VALUE 0x001656CD /* @ECU_Address@FCtl_FTB_0x04@0x024C525C@ */ ECIPP_ALIGNMENT_UBYTE 255 Compu_IDENTITY 0 255 PHYS_UNIT "FTB" /end CHARACTERISTIC
/begin CHARACTERISTIC FCftb_UGF3_drifttol "FCtl_FTB_0x04(603)" VALUE 0x001656CC /* @ECU_Address@FCtl_FTB_0x04@0x024C525B@ */ ECIPP_ALIGNMENT_UBYTE 255 Compu_IDENTITY 0 255 PHYS_UNIT "FTB" /end CHARACTERISTIC
/begin CHARACTERISTIC FCftb_UGF3_Hv_hi "FCtl_FTB_0x04(605)" VALUE 0x001656CE /* @ECU_Address@FCtl_FTB_0x04@0x024C525D@ */ ECIPP_ALIGNMENT_UBYTE 255 Compu_IDENTITY 0 255 PHYS_UNIT "FTB" /end CHARACTERISTIC
/begin CHARACTERISTIC FCftb_UGF3_internal "FCtl_FTB_0x04(601)" VALUE 0x001656CA /* @ECU_Address@FCtl_FTB_0x04@0x024C5259@ */ ECIPP_ALIGNMENT_UBYTE 255 Compu_IDENTITY 0 255 PHYS_UNIT "FTB" /end CHARACTERISTIC
/begin CHARACTERISTIC FCftb_UGF3_lowsupply "FCtl_FTB_0x04(602)" VALUE 0x001656CB /* @ECU_Address@FCtl_FTB_0x04@0x024C525A@ */ ECIPP_ALIGNMENT_UBYTE 255 Compu_IDENTITY 0 255 PHYS_UNIT "FTB" /end CHARACTERISTIC
/begin CHARACTERISTIC FCftb_UGF3_R_hi "FCtl_FTB_0x04(607)" VALUE 0x001656D0 /* @ECU_Address@FCtl_FTB_0x04@0x024C525F@ */ ECIPP_ALIGNMENT_UBYTE 255 Compu_IDENTITY 0 255 PHYS_UNIT "FTB" /end CHARACTERISTIC
/begin CHARACTERISTIC FCftb_UGF3_SR_hi "FCtl_FTB_0x04(619)" VALUE 0x001656DC /* @ECU_Address@FCtl_FTB_0x04@0x024C526B@ */ ECIPP_ALIGNMENT_UBYTE 255 Compu_IDENTITY 0 255 PHYS_UNIT "FTB" /end CHARACTERISTIC
/begin CHARACTERISTIC FCftb_UGF3_SR_slow "FCtl_FTB_0x04(617)" VALUE 0x001656DA /* @ECU_Address@FCtl_FTB_0x04@0x024C5269@ */ ECIPP_ALIGNMENT_UBYTE 255 Compu_IDENTITY 0 255 PHYS_UNIT "FTB" /end CHARACTERISTIC
/begin CHARACTERISTIC FCftb_UGF3_Sv_hi "FCtl_FTB_0x04(613)" VALUE 0x001656D6 /* @ECU_Address@FCtl_FTB_0x04@0x024C5265@ */ ECIPP_ALIGNMENT_UBYTE 255 Compu_IDENTITY 0 255 PHYS_UNIT "FTB" /end CHARACTERISTIC
/begin CHARACTERISTIC FCftb_UGF4_comm_lost "FCtl_FTB_0x04(683)" VALUE 0x0016571C /* @ECU_Address@FCtl_FTB_0x04@0x024C52AB@ */ ECIPP_ALIGNMENT_UBYTE 255 Compu_IDENTITY 0 255 PHYS_UNIT "FTB" /end CHARACTERISTIC
/begin CHARACTERISTIC FCspn_TAUX2_max "FCtl_SPN(552)" VALUE 0x0016257C /* @ECU_Address@FCtl_SPN@0x021B68A0@ */ ECIPP_ALIGNMENT_ULONG 4294967295 Compu_IDENTITY 0 4294967295 PHYS_UNIT "SPN" /end CHARACTERISTIC
/begin CHARACTERISTIC FCspn_TAUX2_min "FCtl_SPN(553)" VALUE 0x00162580 /* @ECU_Address@FCtl_SPN@0x021B68A4@ */ ECIPP_ALIGNMENT_ULONG 4294967295 Compu_IDENTITY 0 4294967295 PHYS_UNIT "SPN" /end CHARACTERISTIC
/begin CHARACTERISTIC FCspn_TAUX3_max "FCtl_SPN(554)" VALUE 0x00162584 /* @ECU_Address@FCtl_SPN@0x021B68A8@ */ ECIPP_ALIGNMENT_ULONG 4294967295 Compu_IDENTITY 0 4294967295 PHYS_UNIT "SPN" /end CHARACTERISTIC
/begin CHARACTERISTIC FCspn_TAUX3_min "FCtl_SPN(555)" VALUE 0x00162588 /* @ECU_Address@FCtl_SPN@0x021B68AC@ */ ECIPP_ALIGNMENT_ULONG 4294967295 Compu_IDENTITY 0 4294967295 PHYS_UNIT "SPN" /end CHARACTERISTIC
/begin CHARACTERISTIC FCspn_TAUX4_max "FCtl_SPN(556)" VALUE 0x0016258C /* @ECU_Address@FCtl_SPN@0x021B68B0@ */ ECIPP_ALIGNMENT_ULONG 4294967295 Compu_IDENTITY 0 4294967295 PHYS_UNIT "SPN" /end CHARACTERISTIC
/begin CHARACTERISTIC FCspn_TAUX4_min "FCtl_SPN(557)" VALUE 0x00162590 /* @ECU_Address@FCtl_SPN@0x021B68B4@ */ ECIPP_ALIGNMENT_ULONG 4294967295 Compu_IDENTITY 0 4294967295 PHYS_UNIT "SPN" /end CHARACTERISTIC
/begin CHARACTERISTIC FCspn_TEL_derate_actv "FCtl_SPN(647)" VALUE 0x001626F8 /* @ECU_Address@FCtl_SPN@0x021B6A1C@ */ ECIPP_ALIGNMENT_ULONG 4294967295 Compu_IDENTITY 0 4294967295 PHYS_UNIT "SPN" /end CHARACTERISTIC
/begin CHARACTERISTIC FCspn_TEL_dis "FCtl_SPN(854)" VALUE 0x00162A34 /* @ECU_Address@FCtl_SPN@0x021B6D58@ */ ECIPP_ALIGNMENT_ULONG 4294967295 Compu_IDENTITY 0 4294967295 PHYS_UNIT "SPN" /end CHARACTERISTIC
/begin CHARACTERISTIC FCspn_TEL_intF "FCtl_SPN(855)" VALUE 0x00162A38 /* @ECU_Address@FCtl_SPN@0x021B6D5C@ */ ECIPP_ALIGNMENT_ULONG 4294967295 Compu_IDENTITY 0 4294967295 PHYS_UNIT "SPN" /end CHARACTERISTIC
/begin CHARACTERISTIC FCspn_TEL_key_invalid "FCtl_SPN(821)" VALUE 0x001629B0 /* @ECU_Address@FCtl_SPN@0x021B6CD4@ */ ECIPP_ALIGNMENT_ULONG 4294967295 Compu_IDENTITY 0 4294967295 PHYS_UNIT "SPN" /end CHARACTERISTIC
/begin CHARACTERISTIC FCspn_TEL_key_to "FCtl_SPN(820)" VALUE 0x001629AC /* @ECU_Address@FCtl_SPN@0x021B6CD0@ */ ECIPP_ALIGNMENT_ULONG 4294967295 Compu_IDENTITY 0 4294967295 PHYS_UNIT "SPN" /end CHARACTERISTIC
/begin CHARACTERISTIC FCspn_TEL_req_to "FCtl_SPN(819)" VALUE 0x001629A8 /* @ECU_Address@FCtl_SPN@0x021B6CCC@ */ ECIPP_ALIGNMENT_ULONG 4294967295 Compu_IDENTITY 0 4294967295 PHYS_UNIT "SPN" /end CHARACTERISTIC
/begin CHARACTERISTIC FCspn_TEL_RPM_cmd "FCtl_SPN(822)" VALUE 0x001629B4 /* @ECU_Address@FCtl_SPN@0x021B6CD8@ */ ECIPP_ALIGNMENT_ULONG 4294967295 Compu_IDENTITY 0 4294967295 PHYS_UNIT "SPN" /end CHARACTERISTIC
/begin CHARACTERISTIC FCspn_TEL_RPM_psv "FCtl_SPN(825)" VALUE 0x001629C0 /* @ECU_Address@FCtl_SPN@0x021B6CE4@ */ ECIPP_ALIGNMENT_ULONG 4294967295 Compu_IDENTITY 0 4294967295 PHYS_UNIT "SPN" /end CHARACTERISTIC
/begin CHARACTERISTIC FCspn_TEL_shutdown_cmd "FCtl_SPN(824)" VALUE 0x001629BC /* @ECU_Address@FCtl_SPN@0x021B6CE0@ */ ECIPP_ALIGNMENT_ULONG 4294967295 Compu_IDENTITY 0 4294967295 PHYS_UNIT "SPN" /end CHARACTERISTIC
/begin CHARACTERISTIC FCspn_TEL_shutdown_psv "FCtl_SPN(827)" VALUE 0x001629C8 /* @ECU_Address@FCtl_SPN@0x021B6CEC@ */ ECIPP_ALIGNMENT_ULONG 4294967295 Compu_IDENTITY 0 4294967295 PHYS_UNIT "SPN" /end CHARACTERISTIC
/begin CHARACTERISTIC FCspn_TEL_torq_cmd "FCtl_SPN(823)" VALUE 0x001629B8 /* @ECU_Address@FCtl_SPN@0x021B6CDC@ */ ECIPP_ALIGNMENT_ULONG 4294967295 Compu_IDENTITY 0 4294967295 PHYS_UNIT "SPN" /end CHARACTERISTIC
/begin CHARACTERISTIC FCspn_TEL_torq_psv "FCtl_SPN(826)" VALUE 0x001629C4 /* @ECU_Address@FCtl_SPN@0x021B6CE8@ */ ECIPP_ALIGNMENT_ULONG 4294967295 Compu_IDENTITY 0 4294967295 PHYS_UNIT "SPN" /end CHARACTERISTIC
/begin CHARACTERISTIC FCspn_TIP_act "FCtl_SPN(145)" VALUE 0x00161F20 /* @ECU_Address@FCtl_SPN@0x021B6244@ */ ECIPP_ALIGNMENT_ULONG 4294967295 Compu_IDENTITY 0 4294967295 PHYS_UNIT "SPN" /end CHARACTERISTIC
/begin CHARACTERISTIC FCspn_TIP_maxv "FCtl_SPN(126)" VALUE 0x00161ED4 /* @ECU_Address@FCtl_SPN@0x021B61F8@ */ ECIPP_ALIGNMENT_ULONG 4294967295 Compu_IDENTITY 0 4294967295 PHYS_UNIT "SPN" /end CHARACTERISTIC
/begin CHARACTERISTIC FCspn_TIP_minv "FCtl_SPN(127)" VALUE 0x00161ED8 /* @ECU_Address@FCtl_SPN@0x021B61FC@ */ ECIPP_ALIGNMENT_ULONG 4294967295 Compu_IDENTITY 0 4294967295 PHYS_UNIT "SPN" /end CHARACTERISTIC
/begin CHARACTERISTIC FCspn_TPS1_max "FCtl_SPN(13)" VALUE 0x00161D10 /* @ECU_Address@FCtl_SPN@0x021B6034@ */ ECIPP_ALIGNMENT_ULONG 4294967295 Compu_IDENTITY 0 4294967295 PHYS_UNIT "SPN" /end CHARACTERISTIC
/begin CHARACTERISTIC FCspn_TPS1_min "FCtl_SPN(14)" VALUE 0x00161D14 /* @ECU_Address@FCtl_SPN@0x021B6038@ */ ECIPP_ALIGNMENT_ULONG 4294967295 Compu_IDENTITY 0 4294967295 PHYS_UNIT "SPN" /end CHARACTERISTIC
/begin CHARACTERISTIC FCspn_TPS12_OOR "FCtl_SPN(186)" VALUE 0x00161FC4 /* @ECU_Address@FCtl_SPN@0x021B62E8@ */ ECIPP_ALIGNMENT_ULONG 4294967295 Compu_IDENTITY 0 4294967295 PHYS_UNIT "SPN" /end CHARACTERISTIC
/begin CHARACTERISTIC FCspn_TPS12pct_hi "FCtl_SPN(17)" VALUE 0x00161D20 /* @ECU_Address@FCtl_SPN@0x021B6044@ */ ECIPP_ALIGNMENT_ULONG 4294967295 Compu_IDENTITY 0 4294967295 PHYS_UNIT "SPN" /end CHARACTERISTIC
/begin CHARACTERISTIC FCspn_TPS12pct_lo "FCtl_SPN(18)" VALUE 0x00161D24 /* @ECU_Address@FCtl_SPN@0x021B6048@ */ ECIPP_ALIGNMENT_ULONG 4294967295 Compu_IDENTITY 0 4294967295 PHYS_UNIT "SPN" /end CHARACTERISTIC
/begin CHARACTERISTIC FCspn_TPS2_max "FCtl_SPN(15)" VALUE 0x00161D18 /* @ECU_Address@FCtl_SPN@0x021B603C@ */ ECIPP_ALIGNMENT_ULONG 4294967295 Compu_IDENTITY 0 4294967295 PHYS_UNIT "SPN" /end CHARACTERISTIC
/begin CHARACTERISTIC FCspn_TPS2_min "FCtl_SPN(16)" VALUE 0x00161D1C /* @ECU_Address@FCtl_SPN@0x021B6040@ */ ECIPP_ALIGNMENT_ULONG 4294967295 Compu_IDENTITY 0 4294967295 PHYS_UNIT "SPN" /end CHARACTERISTIC
/begin CHARACTERISTIC FCspn_TPSerr_neg "FCtl_SPN(91)" VALUE 0x00161E48 /* @ECU_Address@FCtl_SPN@0x021B616C@ */ ECIPP_ALIGNMENT_ULONG 4294967295 Compu_IDENTITY 0 4294967295 PHYS_UNIT "SPN" /end CHARACTERISTIC
/begin CHARACTERISTIC FCspn_TPSerr_pos "FCtl_SPN(90)" VALUE 0x00161E44 /* @ECU_Address@FCtl_SPN@0x021B6168@ */ ECIPP_ALIGNMENT_ULONG 4294967295 Compu_IDENTITY 0 4294967295 PHYS_UNIT "SPN" /end CHARACTERISTIC
/begin CHARACTERISTIC FCspn_TRANS_comm "FCtl_SPN(851)" VALUE 0x00162A28 /* @ECU_Address@FCtl_SPN@0x021B6D4C@ */ ECIPP_ALIGNMENT_ULONG 4294967295 Compu_IDENTITY 0 4294967295 PHYS_UNIT "SPN" /end CHARACTERISTIC
/begin CHARACTERISTIC FCspn_TRANS_fuel_inh "FCtl_SPN(852)" VALUE 0x00162A2C /* @ECU_Address@FCtl_SPN@0x021B6D50@ */ ECIPP_ALIGNMENT_ULONG 4294967295 Compu_IDENTITY 0 4294967295 PHYS_UNIT "SPN" /end CHARACTERISTIC
/begin CHARACTERISTIC FCspn_TWCDiag_OSC_lo "FCtl_SPN(804)" VALUE 0x0016296C /* @ECU_Address@FCtl_SPN@0x021B6C90@ */ ECIPP_ALIGNMENT_ULONG 4294967295 Compu_IDENTITY 0 4294967295 PHYS_UNIT "SPN" /end CHARACTERISTIC
/begin CHARACTERISTIC FCspn_UEGOH1_off_open "FCtl_SPN(427)" VALUE 0x00162388 /* @ECU_Address@FCtl_SPN@0x021B66AC@ */ ECIPP_ALIGNMENT_ULONG 4294967295 Compu_IDENTITY 0 4294967295 PHYS_UNIT "SPN" /end CHARACTERISTIC
/begin CHARACTERISTIC FCspn_UEGOH1_on_short "FCtl_SPN(428)" VALUE 0x0016238C /* @ECU_Address@FCtl_SPN@0x021B66B0@ */ ECIPP_ALIGNMENT_ULONG 4294967295 Compu_IDENTITY 0 4294967295 PHYS_UNIT "SPN" /end CHARACTERISTIC
/begin CHARACTERISTIC FCspn_UEGOH2_off_open "FCtl_SPN(429)" VALUE 0x00162390 /* @ECU_Address@FCtl_SPN@0x021B66B4@ */ ECIPP_ALIGNMENT_ULONG 4294967295 Compu_IDENTITY 0 4294967295 PHYS_UNIT "SPN" /end CHARACTERISTIC
/begin CHARACTERISTIC FCspn_UEGOH2_on_short "FCtl_SPN(430)" VALUE 0x00162394 /* @ECU_Address@FCtl_SPN@0x021B66B8@ */ ECIPP_ALIGNMENT_ULONG 4294967295 Compu_IDENTITY 0 4294967295 PHYS_UNIT "SPN" /end CHARACTERISTIC
/begin CHARACTERISTIC FCspn_UEGOH3_off_open "FCtl_SPN(622)" VALUE 0x00162694 /* @ECU_Address@FCtl_SPN@0x021B69B8@ */ ECIPP_ALIGNMENT_ULONG 4294967295 Compu_IDENTITY 0 4294967295 PHYS_UNIT "SPN" /end CHARACTERISTIC
/begin CHARACTERISTIC FCspn_UEGOH3_on_short "FCtl_SPN(623)" VALUE 0x00162698 /* @ECU_Address@FCtl_SPN@0x021B69BC@ */ ECIPP_ALIGNMENT_ULONG 4294967295 Compu_IDENTITY 0 4294967295 PHYS_UNIT "SPN" /end CHARACTERISTIC
/begin CHARACTERISTIC FCspn_UEGOH4_off_open "FCtl_SPN(645)" VALUE 0x001626F0 /* @ECU_Address@FCtl_SPN@0x021B6A14@ */ ECIPP_ALIGNMENT_ULONG 4294967295 Compu_IDENTITY 0 4294967295 PHYS_UNIT "SPN" /end CHARACTERISTIC
/begin CHARACTERISTIC FCspn_UEGOH4_on_short "FCtl_SPN(646)" VALUE 0x001626F4 /* @ECU_Address@FCtl_SPN@0x021B6A18@ */ ECIPP_ALIGNMENT_ULONG 4294967295 Compu_IDENTITY 0 4294967295 PHYS_UNIT "SPN" /end CHARACTERISTIC
/begin CHARACTERISTIC FCspn_UGF_Hv_hi "FCtl_SPN(242)" VALUE 0x001620A4 /* @ECU_Address@FCtl_SPN@0x021B63C8@ */ ECIPP_ALIGNMENT_ULONG 4294967295 Compu_IDENTITY 0 4294967295 PHYS_UNIT "SPN" /end CHARACTERISTIC
/begin CHARACTERISTIC FCspn_UGF_internal "FCtl_SPN(241)" VALUE 0x001620A0 /* @ECU_Address@FCtl_SPN@0x021B63C4@ */ ECIPP_ALIGNMENT_ULONG 4294967295 Compu_IDENTITY 0 4294967295 PHYS_UNIT "SPN" /end CHARACTERISTIC
/begin CHARACTERISTIC FCspn_UGF_lowsupply "FCtl_SPN(530)" VALUE 0x00162524 /* @ECU_Address@FCtl_SPN@0x021B6848@ */ ECIPP_ALIGNMENT_ULONG 4294967295 Compu_IDENTITY 0 4294967295 PHYS_UNIT "SPN" /end CHARACTERISTIC
/begin CHARACTERISTIC FCspn_UGF1_comm_lost "FCtl_SPN(680)" VALUE 0x0016277C /* @ECU_Address@FCtl_SPN@0x021B6AA0@ */ ECIPP_ALIGNMENT_ULONG 4294967295 Compu_IDENTITY 0 4294967295 PHYS_UNIT "SPN" /end CHARACTERISTIC
/begin CHARACTERISTIC FCspn_UGF1_drifttl2 "FCtl_SPN(536)" VALUE 0x0016253C /* @ECU_Address@FCtl_SPN@0x021B6860@ */ ECIPP_ALIGNMENT_ULONG 4294967295 Compu_IDENTITY 0 4294967295 PHYS_UNIT "SPN" /end CHARACTERISTIC
/begin CHARACTERISTIC FCspn_UGF1_drifttol "FCtl_SPN(505)" VALUE 0x001624C0 /* @ECU_Address@FCtl_SPN@0x021B67E4@ */ ECIPP_ALIGNMENT_ULONG 4294967295 Compu_IDENTITY 0 4294967295 PHYS_UNIT "SPN" /end CHARACTERISTIC
/begin CHARACTERISTIC FCspn_UGF1_R_hi "FCtl_SPN(244)" VALUE 0x001620AC /* @ECU_Address@FCtl_SPN@0x021B63D0@ */ ECIPP_ALIGNMENT_ULONG 4294967295 Compu_IDENTITY 0 4294967295 PHYS_UNIT "SPN" /end CHARACTERISTIC
/begin CHARACTERISTIC FCspn_UGF1_SR_hi "FCtl_SPN(256)" VALUE 0x001620DC /* @ECU_Address@FCtl_SPN@0x021B6400@ */ ECIPP_ALIGNMENT_ULONG 4294967295 Compu_IDENTITY 0 4294967295 PHYS_UNIT "SPN" /end CHARACTERISTIC
/begin CHARACTERISTIC FCspn_UGF1_SR_slow "FCtl_SPN(254)" VALUE 0x001620D4 /* @ECU_Address@FCtl_SPN@0x021B63F8@ */ ECIPP_ALIGNMENT_ULONG 4294967295 Compu_IDENTITY 0 4294967295 PHYS_UNIT "SPN" /end CHARACTERISTIC
/begin CHARACTERISTIC FCspn_UGF1_Sv_hi "FCtl_SPN(250)" VALUE 0x001620C4 /* @ECU_Address@FCtl_SPN@0x021B63E8@ */ ECIPP_ALIGNMENT_ULONG 4294967295 Compu_IDENTITY 0 4294967295 PHYS_UNIT "SPN" /end CHARACTERISTIC
/begin CHARACTERISTIC FCspn_UGF2_comm_lost "FCtl_SPN(681)" VALUE 0x00162780 /* @ECU_Address@FCtl_SPN@0x021B6AA4@ */ ECIPP_ALIGNMENT_ULONG 4294967295 Compu_IDENTITY 0 4294967295 PHYS_UNIT "SPN" /end CHARACTERISTIC
/begin CHARACTERISTIC FCspn_UGF2_drifttl2 "FCtl_SPN(537)" VALUE 0x00162540 /* @ECU_Address@FCtl_SPN@0x021B6864@ */ ECIPP_ALIGNMENT_ULONG 4294967295 Compu_IDENTITY 0 4294967295 PHYS_UNIT "SPN" /end CHARACTERISTIC
/begin CHARACTERISTIC FCspn_UGF2_drifttol "FCtl_SPN(506)" VALUE 0x001624C4 /* @ECU_Address@FCtl_SPN@0x021B67E8@ */ ECIPP_ALIGNMENT_ULONG 4294967295 Compu_IDENTITY 0 4294967295 PHYS_UNIT "SPN" /end CHARACTERISTIC
/begin CHARACTERISTIC FCspn_UGF2_Hv_hi "FCtl_SPN(409)" VALUE 0x00162340 /* @ECU_Address@FCtl_SPN@0x021B6664@ */ ECIPP_ALIGNMENT_ULONG 4294967295 Compu_IDENTITY 0 4294967295 PHYS_UNIT "SPN" /end CHARACTERISTIC
/begin CHARACTERISTIC FCspn_UGF2_internal "FCtl_SPN(408)" VALUE 0x0016233C /* @ECU_Address@FCtl_SPN@0x021B6660@ */ ECIPP_ALIGNMENT_ULONG 4294967295 Compu_IDENTITY 0 4294967295 PHYS_UNIT "SPN" /end CHARACTERISTIC
/begin CHARACTERISTIC FCspn_UGF2_lowsupply "FCtl_SPN(531)" VALUE 0x00162528 /* @ECU_Address@FCtl_SPN@0x021B684C@ */ ECIPP_ALIGNMENT_ULONG 4294967295 Compu_IDENTITY 0 4294967295 PHYS_UNIT "SPN" /end CHARACTERISTIC
/begin CHARACTERISTIC FCspn_UGF2_R_hi "FCtl_SPN(411)" VALUE 0x00162348 /* @ECU_Address@FCtl_SPN@0x021B666C@ */ ECIPP_ALIGNMENT_ULONG 4294967295 Compu_IDENTITY 0 4294967295 PHYS_UNIT "SPN" /end CHARACTERISTIC
/begin CHARACTERISTIC FCspn_UGF2_SR_hi "FCtl_SPN(423)" VALUE 0x00162378 /* @ECU_Address@FCtl_SPN@0x021B669C@ */ ECIPP_ALIGNMENT_ULONG 4294967295 Compu_IDENTITY 0 4294967295 PHYS_UNIT "SPN" /end CHARACTERISTIC
/begin CHARACTERISTIC FCspn_UGF2_SR_slow "FCtl_SPN(421)" VALUE 0x00162370 /* @ECU_Address@FCtl_SPN@0x021B6694@ */ ECIPP_ALIGNMENT_ULONG 4294967295 Compu_IDENTITY 0 4294967295 PHYS_UNIT "SPN" /end CHARACTERISTIC
/begin CHARACTERISTIC FCspn_UGF2_Sv_hi "FCtl_SPN(417)" VALUE 0x00162360 /* @ECU_Address@FCtl_SPN@0x021B6684@ */ ECIPP_ALIGNMENT_ULONG 4294967295 Compu_IDENTITY 0 4294967295 PHYS_UNIT "SPN" /end CHARACTERISTIC
/begin CHARACTERISTIC FCspn_UGF3_comm_lost "FCtl_SPN(682)" VALUE 0x00162784 /* @ECU_Address@FCtl_SPN@0x021B6AA8@ */ ECIPP_ALIGNMENT_ULONG 4294967295 Compu_IDENTITY 0 4294967295 PHYS_UNIT "SPN" /end CHARACTERISTIC
/begin CHARACTERISTIC FCspn_UGF3_drifttl2 "FCtl_SPN(604)" VALUE 0x0016264C /* @ECU_Address@FCtl_SPN@0x021B6970@ */ ECIPP_ALIGNMENT_ULONG 4294967295 Compu_IDENTITY 0 4294967295 PHYS_UNIT "SPN" /end CHARACTERISTIC
/begin CHARACTERISTIC FCspn_UGF3_drifttol "FCtl_SPN(603)" VALUE 0x00162648 /* @ECU_Address@FCtl_SPN@0x021B696C@ */ ECIPP_ALIGNMENT_ULONG 4294967295 Compu_IDENTITY 0 4294967295 PHYS_UNIT "SPN" /end CHARACTERISTIC
/begin CHARACTERISTIC FCspn_UGF3_Hv_hi "FCtl_SPN(605)" VALUE 0x00162650 /* @ECU_Address@FCtl_SPN@0x021B6974@ */ ECIPP_ALIGNMENT_ULONG 4294967295 Compu_IDENTITY 0 4294967295 PHYS_UNIT "SPN" /end CHARACTERISTIC
/begin CHARACTERISTIC FCspn_UGF3_internal "FCtl_SPN(601)" VALUE 0x00162640 /* @ECU_Address@FCtl_SPN@0x021B6964@ */ ECIPP_ALIGNMENT_ULONG 4294967295 Compu_IDENTITY 0 4294967295 PHYS_UNIT "SPN" /end CHARACTERISTIC
/begin CHARACTERISTIC FCspn_UGF3_lowsupply "FCtl_SPN(602)" VALUE 0x00162644 /* @ECU_Address@FCtl_SPN@0x021B6968@ */ ECIPP_ALIGNMENT_ULONG 4294967295 Compu_IDENTITY 0 4294967295 PHYS_UNIT "SPN" /end CHARACTERISTIC
/begin CHARACTERISTIC FCspn_UGF3_R_hi "FCtl_SPN(607)" VALUE 0x00162658 /* @ECU_Address@FCtl_SPN@0x021B697C@ */ ECIPP_ALIGNMENT_ULONG 4294967295 Compu_IDENTITY 0 4294967295 PHYS_UNIT "SPN" /end CHARACTERISTIC
/begin CHARACTERISTIC FCspn_UGF3_SR_hi "FCtl_SPN(619)" VALUE 0x00162688 /* @ECU_Address@FCtl_SPN@0x021B69AC@ */ ECIPP_ALIGNMENT_ULONG 4294967295 Compu_IDENTITY 0 4294967295 PHYS_UNIT "SPN" /end CHARACTERISTIC
/begin CHARACTERISTIC FCspn_UGF3_SR_slow "FCtl_SPN(617)" VALUE 0x00162680 /* @ECU_Address@FCtl_SPN@0x021B69A4@ */ ECIPP_ALIGNMENT_ULONG 4294967295 Compu_IDENTITY 0 4294967295 PHYS_UNIT "SPN" /end CHARACTERISTIC
/begin CHARACTERISTIC FCspn_UGF3_Sv_hi "FCtl_SPN(613)" VALUE 0x00162670 /* @ECU_Address@FCtl_SPN@0x021B6994@ */ ECIPP_ALIGNMENT_ULONG 4294967295 Compu_IDENTITY 0 4294967295 PHYS_UNIT "SPN" /end CHARACTERISTIC
/begin CHARACTERISTIC FCspn_UGF4_comm_lost "FCtl_SPN(683)" VALUE 0x00162788 /* @ECU_Address@FCtl_SPN@0x021B6AAC@ */ ECIPP_ALIGNMENT_ULONG 4294967295 Compu_IDENTITY 0 4294967295 PHYS_UNIT "SPN" /end CHARACTERISTIC
/begin CHARACTERISTIC FPfl_TAUX2_max "FPrm_latch(422)" VALUE 0x001606B0 /* @ECU_Address@FPrm_latch@0x021BB698@ */ ECIPP_ALIGNMENT_FLOAT32_IEEE 10000000000 Compu_IDENTITY -10000000000 10000000000 PHYS_UNIT "ms" /end CHARACTERISTIC
/begin CHARACTERISTIC FPfl_TAUX2_min "FPrm_latch(423)" VALUE 0x001606B4 /* @ECU_Address@FPrm_latch@0x021BB69C@ */ ECIPP_ALIGNMENT_FLOAT32_IEEE 10000000000 Compu_IDENTITY -10000000000 10000000000 PHYS_UNIT "ms" /end CHARACTERISTIC
/begin CHARACTERISTIC FPfl_TAUX3_max "FPrm_latch(424)" VALUE 0x001606B8 /* @ECU_Address@FPrm_latch@0x021BB6A0@ */ ECIPP_ALIGNMENT_FLOAT32_IEEE 10000000000 Compu_IDENTITY -10000000000 10000000000 PHYS_UNIT "ms" /end CHARACTERISTIC
/begin CHARACTERISTIC FPfl_TAUX3_min "FPrm_latch(425)" VALUE 0x001606BC /* @ECU_Address@FPrm_latch@0x021BB6A4@ */ ECIPP_ALIGNMENT_FLOAT32_IEEE 10000000000 Compu_IDENTITY -10000000000 10000000000 PHYS_UNIT "ms" /end CHARACTERISTIC
/begin CHARACTERISTIC FPfl_TAUX4_max "FPrm_latch(426)" VALUE 0x001606C0 /* @ECU_Address@FPrm_latch@0x021BB6A8@ */ ECIPP_ALIGNMENT_FLOAT32_IEEE 10000000000 Compu_IDENTITY -10000000000 10000000000 PHYS_UNIT "ms" /end CHARACTERISTIC
/begin CHARACTERISTIC FPfl_TAUX4_min "FPrm_latch(427)" VALUE 0x001606C4 /* @ECU_Address@FPrm_latch@0x021BB6AC@ */ ECIPP_ALIGNMENT_FLOAT32_IEEE 10000000000 Compu_IDENTITY -10000000000 10000000000 PHYS_UNIT "ms" /end CHARACTERISTIC
/begin CHARACTERISTIC FPfl_TEL_derate_actv "FPrm_latch(477)" VALUE 0x0016078C /* @ECU_Address@FPrm_latch@0x021BB774@ */ ECIPP_ALIGNMENT_FLOAT32_IEEE 10000000000 Compu_IDENTITY -10000000000 10000000000 PHYS_UNIT "ms" /end CHARACTERISTIC
/begin CHARACTERISTIC FPfl_TEL_dis "FPrm_latch(681)" VALUE 0x00160ABC /* @ECU_Address@FPrm_latch@0x021BBAA4@ */ ECIPP_ALIGNMENT_FLOAT32_IEEE 10000000000 Compu_IDENTITY -10000000000 10000000000 PHYS_UNIT "ms" /end CHARACTERISTIC
/begin CHARACTERISTIC FPfl_TEL_intF "FPrm_latch(682)" VALUE 0x00160AC0 /* @ECU_Address@FPrm_latch@0x021BBAA8@ */ ECIPP_ALIGNMENT_FLOAT32_IEEE 10000000000 Compu_IDENTITY -10000000000 10000000000 PHYS_UNIT "ms" /end CHARACTERISTIC
/begin CHARACTERISTIC FPfl_TEL_key_invalid "FPrm_latch(648)" VALUE 0x00160A38 /* @ECU_Address@FPrm_latch@0x021BBA20@ */ ECIPP_ALIGNMENT_FLOAT32_IEEE 10000000000 Compu_IDENTITY -10000000000 10000000000 PHYS_UNIT "ms" /end CHARACTERISTIC
/begin CHARACTERISTIC FPfl_TEL_key_to "FPrm_latch(647)" VALUE 0x00160A34 /* @ECU_Address@FPrm_latch@0x021BBA1C@ */ ECIPP_ALIGNMENT_FLOAT32_IEEE 10000000000 Compu_IDENTITY -10000000000 10000000000 PHYS_UNIT "ms" /end CHARACTERISTIC
/begin CHARACTERISTIC FPfl_TEL_req_to "FPrm_latch(646)" VALUE 0x00160A30 /* @ECU_Address@FPrm_latch@0x021BBA18@ */ ECIPP_ALIGNMENT_FLOAT32_IEEE 10000000000 Compu_IDENTITY -10000000000 10000000000 PHYS_UNIT "ms" /end CHARACTERISTIC
/begin CHARACTERISTIC FPfl_TEL_RPM_cmd "FPrm_latch(649)" VALUE 0x00160A3C /* @ECU_Address@FPrm_latch@0x021BBA24@ */ ECIPP_ALIGNMENT_FLOAT32_IEEE 10000000000 Compu_IDENTITY -10000000000 10000000000 PHYS_UNIT "ms" /end CHARACTERISTIC
/begin CHARACTERISTIC FPfl_TEL_RPM_psv "FPrm_latch(652)" VALUE 0x00160A48 /* @ECU_Address@FPrm_latch@0x021BBA30@ */ ECIPP_ALIGNMENT_FLOAT32_IEEE 10000000000 Compu_IDENTITY -10000000000 10000000000 PHYS_UNIT "ms" /end CHARACTERISTIC
/begin CHARACTERISTIC FPfl_TEL_shutdown_cmd "FPrm_latch(651)" VALUE 0x00160A44 /* @ECU_Address@FPrm_latch@0x021BBA2C@ */ ECIPP_ALIGNMENT_FLOAT32_IEEE 10000000000 Compu_IDENTITY -10000000000 10000000000 PHYS_UNIT "ms" /end CHARACTERISTIC
/begin CHARACTERISTIC FPfl_TEL_shutdown_psv "FPrm_latch(654)" VALUE 0x00160A50 /* @ECU_Address@FPrm_latch@0x021BBA38@ */ ECIPP_ALIGNMENT_FLOAT32_IEEE 10000000000 Compu_IDENTITY -10000000000 10000000000 PHYS_UNIT "ms" /end CHARACTERISTIC
/begin CHARACTERISTIC FPfl_TEL_torq_cmd "FPrm_latch(650)" VALUE 0x00160A40 /* @ECU_Address@FPrm_latch@0x021BBA28@ */ ECIPP_ALIGNMENT_FLOAT32_IEEE 10000000000 Compu_IDENTITY -10000000000 10000000000 PHYS_UNIT "ms" /end CHARACTERISTIC
/begin CHARACTERISTIC FPfl_TEL_torq_psv "FPrm_latch(653)" VALUE 0x00160A4C /* @ECU_Address@FPrm_latch@0x021BBA34@ */ ECIPP_ALIGNMENT_FLOAT32_IEEE 10000000000 Compu_IDENTITY -10000000000 10000000000 PHYS_UNIT "ms" /end CHARACTERISTIC
/begin CHARACTERISTIC FPfl_TIP_act "FPrm_latch(105)" VALUE 0x001601BC /* @ECU_Address@FPrm_latch@0x021BB1A4@ */ ECIPP_ALIGNMENT_FLOAT32_IEEE 10000000000 Compu_IDENTITY -10000000000 10000000000 PHYS_UNIT "ms" /end CHARACTERISTIC
/begin CHARACTERISTIC FPfl_TIP_maxv "FPrm_latch(85)" VALUE 0x0016016C /* @ECU_Address@FPrm_latch@0x021BB154@ */ ECIPP_ALIGNMENT_FLOAT32_IEEE 10000000000 Compu_IDENTITY -10000000000 10000000000 PHYS_UNIT "ms" /end CHARACTERISTIC
/begin CHARACTERISTIC FPfl_TIP_minv "FPrm_latch(86)" VALUE 0x00160170 /* @ECU_Address@FPrm_latch@0x021BB158@ */ ECIPP_ALIGNMENT_FLOAT32_IEEE 10000000000 Compu_IDENTITY -10000000000 10000000000 PHYS_UNIT "ms" /end CHARACTERISTIC
/begin CHARACTERISTIC FPfl_TPS1_max "FPrm_latch(18)" VALUE 0x00160060 /* @ECU_Address@FPrm_latch@0x021BB048@ */ ECIPP_ALIGNMENT_FLOAT32_IEEE 10000000000 Compu_IDENTITY -10000000000 10000000000 PHYS_UNIT "ms" /end CHARACTERISTIC
/begin CHARACTERISTIC FPfl_TPS1_min "FPrm_latch(19)" VALUE 0x00160064 /* @ECU_Address@FPrm_latch@0x021BB04C@ */ ECIPP_ALIGNMENT_FLOAT32_IEEE 10000000000 Compu_IDENTITY -10000000000 10000000000 PHYS_UNIT "ms" /end CHARACTERISTIC
/begin CHARACTERISTIC FPfl_TPS12_OOR "FPrm_latch(144)" VALUE 0x00160258 /* @ECU_Address@FPrm_latch@0x021BB240@ */ ECIPP_ALIGNMENT_FLOAT32_IEEE 10000000000 Compu_IDENTITY -10000000000 10000000000 PHYS_UNIT "ms" /end CHARACTERISTIC
/begin CHARACTERISTIC FPfl_TPS12pct_hi "FPrm_latch(22)" VALUE 0x00160070 /* @ECU_Address@FPrm_latch@0x021BB058@ */ ECIPP_ALIGNMENT_FLOAT32_IEEE 10000000000 Compu_IDENTITY -10000000000 10000000000 PHYS_UNIT "ms" /end CHARACTERISTIC
/begin CHARACTERISTIC FPfl_TPS12pct_lo "FPrm_latch(23)" VALUE 0x00160074 /* @ECU_Address@FPrm_latch@0x021BB05C@ */ ECIPP_ALIGNMENT_FLOAT32_IEEE 10000000000 Compu_IDENTITY -10000000000 10000000000 PHYS_UNIT "ms" /end CHARACTERISTIC
/begin CHARACTERISTIC FPfl_TPS2_max "FPrm_latch(20)" VALUE 0x00160068 /* @ECU_Address@FPrm_latch@0x021BB050@ */ ECIPP_ALIGNMENT_FLOAT32_IEEE 10000000000 Compu_IDENTITY -10000000000 10000000000 PHYS_UNIT "ms" /end CHARACTERISTIC
/begin CHARACTERISTIC FPfl_TPS2_min "FPrm_latch(21)" VALUE 0x0016006C /* @ECU_Address@FPrm_latch@0x021BB054@ */ ECIPP_ALIGNMENT_FLOAT32_IEEE 10000000000 Compu_IDENTITY -10000000000 10000000000 PHYS_UNIT "ms" /end CHARACTERISTIC
/begin CHARACTERISTIC FPfl_TPSerr_neg "FPrm_latch(25)" VALUE 0x0016007C /* @ECU_Address@FPrm_latch@0x021BB064@ */ ECIPP_ALIGNMENT_FLOAT32_IEEE 10000000000 Compu_IDENTITY -10000000000 10000000000 PHYS_UNIT "ms" /end CHARACTERISTIC
/begin CHARACTERISTIC FPfl_TPSerr_pos "FPrm_latch(24)" VALUE 0x00160078 /* @ECU_Address@FPrm_latch@0x021BB060@ */ ECIPP_ALIGNMENT_FLOAT32_IEEE 10000000000 Compu_IDENTITY -10000000000 10000000000 PHYS_UNIT "ms" /end CHARACTERISTIC
/begin CHARACTERISTIC FPfl_TRANS_comm "FPrm_latch(678)" VALUE 0x00160AB0 /* @ECU_Address@FPrm_latch@0x021BBA98@ */ ECIPP_ALIGNMENT_FLOAT32_IEEE 10000000000 Compu_IDENTITY -10000000000 10000000000 PHYS_UNIT "ms" /end CHARACTERISTIC
/begin CHARACTERISTIC FPfl_TRANS_fuel_inh "FPrm_latch(679)" VALUE 0x00160AB4 /* @ECU_Address@FPrm_latch@0x021BBA9C@ */ ECIPP_ALIGNMENT_FLOAT32_IEEE 10000000000 Compu_IDENTITY -10000000000 10000000000 PHYS_UNIT "ms" /end CHARACTERISTIC
/begin CHARACTERISTIC FPfl_TWCDiag_OSC_lo "FPrm_latch(633)" VALUE 0x001609FC /* @ECU_Address@FPrm_latch@0x021BB9E4@ */ ECIPP_ALIGNMENT_FLOAT32_IEEE 10000000000 Compu_IDENTITY -10000000000 10000000000 PHYS_UNIT "samples" /end CHARACTERISTIC
/begin CHARACTERISTIC FPfl_UEGOH1_off_open "FPrm_latch(324)" VALUE 0x00160528 /* @ECU_Address@FPrm_latch@0x021BB510@ */ ECIPP_ALIGNMENT_FLOAT32_IEEE 10000000000 Compu_IDENTITY -10000000000 10000000000 PHYS_UNIT "ms" /end CHARACTERISTIC
/begin CHARACTERISTIC FPfl_UEGOH1_on_short "FPrm_latch(325)" VALUE 0x0016052C /* @ECU_Address@FPrm_latch@0x021BB514@ */ ECIPP_ALIGNMENT_FLOAT32_IEEE 10000000000 Compu_IDENTITY -10000000000 10000000000 PHYS_UNIT "ms" /end CHARACTERISTIC
/begin CHARACTERISTIC FPfl_UEGOH2_off_open "FPrm_latch(326)" VALUE 0x00160530 /* @ECU_Address@FPrm_latch@0x021BB518@ */ ECIPP_ALIGNMENT_FLOAT32_IEEE 10000000000 Compu_IDENTITY -10000000000 10000000000 PHYS_UNIT "ms" /end CHARACTERISTIC
/begin CHARACTERISTIC FPfl_UEGOH2_on_short "FPrm_latch(327)" VALUE 0x00160534 /* @ECU_Address@FPrm_latch@0x021BB51C@ */ ECIPP_ALIGNMENT_FLOAT32_IEEE 10000000000 Compu_IDENTITY -10000000000 10000000000 PHYS_UNIT "ms" /end CHARACTERISTIC
/begin CHARACTERISTIC FPfl_UEGOH3_off_open "FPrm_latch(464)" VALUE 0x00160758 /* @ECU_Address@FPrm_latch@0x021BB740@ */ ECIPP_ALIGNMENT_FLOAT32_IEEE 10000000000 Compu_IDENTITY -10000000000 10000000000 PHYS_UNIT "ms" /end CHARACTERISTIC
/begin CHARACTERISTIC FPfl_UEGOH3_on_short "FPrm_latch(465)" VALUE 0x0016075C /* @ECU_Address@FPrm_latch@0x021BB744@ */ ECIPP_ALIGNMENT_FLOAT32_IEEE 10000000000 Compu_IDENTITY -10000000000 10000000000 PHYS_UNIT "ms" /end CHARACTERISTIC
/begin CHARACTERISTIC FPfl_UEGOH4_off_open "FPrm_latch(475)" VALUE 0x00160784 /* @ECU_Address@FPrm_latch@0x021BB76C@ */ ECIPP_ALIGNMENT_FLOAT32_IEEE 10000000000 Compu_IDENTITY -10000000000 10000000000 PHYS_UNIT "ms" /end CHARACTERISTIC
/begin CHARACTERISTIC FPfl_UEGOH4_on_short "FPrm_latch(476)" VALUE 0x00160788 /* @ECU_Address@FPrm_latch@0x021BB770@ */ ECIPP_ALIGNMENT_FLOAT32_IEEE 10000000000 Compu_IDENTITY -10000000000 10000000000 PHYS_UNIT "ms" /end CHARACTERISTIC
/begin CHARACTERISTIC FPfl_UGF_Hv_hi "FPrm_latch(190)" VALUE 0x00160310 /* @ECU_Address@FPrm_latch@0x021BB2F8@ */ ECIPP_ALIGNMENT_FLOAT32_IEEE 10000000000 Compu_IDENTITY -10000000000 10000000000 PHYS_UNIT "ms" /end CHARACTERISTIC
/begin CHARACTERISTIC FPfl_UGF_internal "FPrm_latch(189)" VALUE 0x0016030C /* @ECU_Address@FPrm_latch@0x021BB2F4@ */ ECIPP_ALIGNMENT_FLOAT32_IEEE 10000000000 Compu_IDENTITY -10000000000 10000000000 PHYS_UNIT "ms" /end CHARACTERISTIC
/begin CHARACTERISTIC FPfl_UGF_lowsupply "FPrm_latch(400)" VALUE 0x00160658 /* @ECU_Address@FPrm_latch@0x021BB640@ */ ECIPP_ALIGNMENT_FLOAT32_IEEE 10000000000 Compu_IDENTITY -10000000000 10000000000 PHYS_UNIT "ms" /end CHARACTERISTIC
/begin CHARACTERISTIC FPfl_UGF1_comm_lost "FPrm_latch(510)" VALUE 0x00160810 /* @ECU_Address@FPrm_latch@0x021BB7F8@ */ ECIPP_ALIGNMENT_FLOAT32_IEEE 10000000000 Compu_IDENTITY -10000000000 10000000000 PHYS_UNIT "ms" /end CHARACTERISTIC
/begin CHARACTERISTIC FPfl_UGF1_drifttl2 "FPrm_latch(406)" VALUE 0x00160670 /* @ECU_Address@FPrm_latch@0x021BB658@ */ ECIPP_ALIGNMENT_FLOAT32_IEEE 10000000000 Compu_IDENTITY -10000000000 10000000000 PHYS_UNIT "ms" /end CHARACTERISTIC
/begin CHARACTERISTIC FPfl_UGF1_drifttol "FPrm_latch(384)" VALUE 0x00160618 /* @ECU_Address@FPrm_latch@0x021BB600@ */ ECIPP_ALIGNMENT_FLOAT32_IEEE 10000000000 Compu_IDENTITY -10000000000 10000000000 PHYS_UNIT "ms" /end CHARACTERISTIC
/begin CHARACTERISTIC FPfl_UGF1_R_hi "FPrm_latch(191)" VALUE 0x00160314 /* @ECU_Address@FPrm_latch@0x021BB2FC@ */ ECIPP_ALIGNMENT_FLOAT32_IEEE 10000000000 Compu_IDENTITY -10000000000 10000000000 PHYS_UNIT "ms" /end CHARACTERISTIC
/begin CHARACTERISTIC FPfl_UGF1_SR_hi "FPrm_latch(194)" VALUE 0x00160320 /* @ECU_Address@FPrm_latch@0x021BB308@ */ ECIPP_ALIGNMENT_FLOAT32_IEEE 10000000000 Compu_IDENTITY -10000000000 10000000000 PHYS_UNIT "ms" /end CHARACTERISTIC
/begin CHARACTERISTIC FPfl_UGF1_SR_slow "FPrm_latch(193)" VALUE 0x0016031C /* @ECU_Address@FPrm_latch@0x021BB304@ */ ECIPP_ALIGNMENT_FLOAT32_IEEE 10000000000 Compu_IDENTITY -10000000000 10000000000 PHYS_UNIT "ms" /end CHARACTERISTIC
/begin CHARACTERISTIC FPfl_UGF1_Sv_hi "FPrm_latch(192)" VALUE 0x00160318 /* @ECU_Address@FPrm_latch@0x021BB300@ */ ECIPP_ALIGNMENT_FLOAT32_IEEE 10000000000 Compu_IDENTITY -10000000000 10000000000 PHYS_UNIT "ms" /end CHARACTERISTIC
/begin CHARACTERISTIC FPfl_UGF2_comm_lost "FPrm_latch(511)" VALUE 0x00160814 /* @ECU_Address@FPrm_latch@0x021BB7FC@ */ ECIPP_ALIGNMENT_FLOAT32_IEEE 10000000000 Compu_IDENTITY -10000000000 10000000000 PHYS_UNIT "ms" /end CHARACTERISTIC
/begin CHARACTERISTIC FPfl_UGF2_drifttl2 "FPrm_latch(407)" VALUE 0x00160674 /* @ECU_Address@FPrm_latch@0x021BB65C@ */ ECIPP_ALIGNMENT_FLOAT32_IEEE 10000000000 Compu_IDENTITY -10000000000 10000000000 PHYS_UNIT "ms" /end CHARACTERISTIC
/begin CHARACTERISTIC FPfl_UGF2_drifttol "FPrm_latch(385)" VALUE 0x0016061C /* @ECU_Address@FPrm_latch@0x021BB604@ */ ECIPP_ALIGNMENT_FLOAT32_IEEE 10000000000 Compu_IDENTITY -10000000000 10000000000 PHYS_UNIT "ms" /end CHARACTERISTIC
/begin CHARACTERISTIC FPfl_UGF2_Hv_hi "FPrm_latch(318)" VALUE 0x00160510 /* @ECU_Address@FPrm_latch@0x021BB4F8@ */ ECIPP_ALIGNMENT_FLOAT32_IEEE 10000000000 Compu_IDENTITY -10000000000 10000000000 PHYS_UNIT "ms" /end CHARACTERISTIC
/begin CHARACTERISTIC FPfl_UGF2_internal "FPrm_latch(317)" VALUE 0x0016050C /* @ECU_Address@FPrm_latch@0x021BB4F4@ */ ECIPP_ALIGNMENT_FLOAT32_IEEE 10000000000 Compu_IDENTITY -10000000000 10000000000 PHYS_UNIT "ms" /end CHARACTERISTIC
/begin CHARACTERISTIC FPfl_UGF2_lowsupply "FPrm_latch(401)" VALUE 0x0016065C /* @ECU_Address@FPrm_latch@0x021BB644@ */ ECIPP_ALIGNMENT_FLOAT32_IEEE 10000000000 Compu_IDENTITY -10000000000 10000000000 PHYS_UNIT "ms" /end CHARACTERISTIC
/begin CHARACTERISTIC FPfl_UGF2_R_hi "FPrm_latch(319)" VALUE 0x00160514 /* @ECU_Address@FPrm_latch@0x021BB4FC@ */ ECIPP_ALIGNMENT_FLOAT32_IEEE 10000000000 Compu_IDENTITY -10000000000 10000000000 PHYS_UNIT "ms" /end CHARACTERISTIC
/begin CHARACTERISTIC FPfl_UGF2_SR_hi "FPrm_latch(322)" VALUE 0x00160520 /* @ECU_Address@FPrm_latch@0x021BB508@ */ ECIPP_ALIGNMENT_FLOAT32_IEEE 10000000000 Compu_IDENTITY -10000000000 10000000000 PHYS_UNIT "ms" /end CHARACTERISTIC
/begin CHARACTERISTIC FPfl_UGF2_SR_slow "FPrm_latch(321)" VALUE 0x0016051C /* @ECU_Address@FPrm_latch@0x021BB504@ */ ECIPP_ALIGNMENT_FLOAT32_IEEE 10000000000 Compu_IDENTITY -10000000000 10000000000 PHYS_UNIT "ms" /end CHARACTERISTIC
/begin CHARACTERISTIC FPfl_UGF2_Sv_hi "FPrm_latch(320)" VALUE 0x00160518 /* @ECU_Address@FPrm_latch@0x021BB500@ */ ECIPP_ALIGNMENT_FLOAT32_IEEE 10000000000 Compu_IDENTITY -10000000000 10000000000 PHYS_UNIT "ms" /end CHARACTERISTIC
/begin CHARACTERISTIC FPfl_UGF3_comm_lost "FPrm_latch(512)" VALUE 0x00160818 /* @ECU_Address@FPrm_latch@0x021BB800@ */ ECIPP_ALIGNMENT_FLOAT32_IEEE 10000000000 Compu_IDENTITY -10000000000 10000000000 PHYS_UNIT "ms" /end CHARACTERISTIC
/begin CHARACTERISTIC FPfl_UGF3_drifttl2 "FPrm_latch(458)" VALUE 0x00160740 /* @ECU_Address@FPrm_latch@0x021BB728@ */ ECIPP_ALIGNMENT_FLOAT32_IEEE 10000000000 Compu_IDENTITY -10000000000 10000000000 PHYS_UNIT "ms" /end CHARACTERISTIC
/begin CHARACTERISTIC FPfl_UGF3_drifttol "FPrm_latch(457)" VALUE 0x0016073C /* @ECU_Address@FPrm_latch@0x021BB724@ */ ECIPP_ALIGNMENT_FLOAT32_IEEE 10000000000 Compu_IDENTITY -10000000000 10000000000 PHYS_UNIT "ms" /end CHARACTERISTIC
/begin CHARACTERISTIC FPfl_UGF3_Hv_hi "FPrm_latch(459)" VALUE 0x00160744 /* @ECU_Address@FPrm_latch@0x021BB72C@ */ ECIPP_ALIGNMENT_FLOAT32_IEEE 10000000000 Compu_IDENTITY -10000000000 10000000000 PHYS_UNIT "ms" /end CHARACTERISTIC
/begin CHARACTERISTIC FPfl_UGF3_internal "FPrm_latch(455)" VALUE 0x00160734 /* @ECU_Address@FPrm_latch@0x021BB71C@ */ ECIPP_ALIGNMENT_FLOAT32_IEEE 10000000000 Compu_IDENTITY -10000000000 10000000000 PHYS_UNIT "ms" /end CHARACTERISTIC
/begin CHARACTERISTIC FPfl_UGF3_lowsupply "FPrm_latch(456)" VALUE 0x00160738 /* @ECU_Address@FPrm_latch@0x021BB720@ */ ECIPP_ALIGNMENT_FLOAT32_IEEE 10000000000 Compu_IDENTITY -10000000000 10000000000 PHYS_UNIT "ms" /end CHARACTERISTIC
/begin CHARACTERISTIC FPfl_UGF3_R_hi "FPrm_latch(460)" VALUE 0x00160748 /* @ECU_Address@FPrm_latch@0x021BB730@ */ ECIPP_ALIGNMENT_FLOAT32_IEEE 10000000000 Compu_IDENTITY -10000000000 10000000000 PHYS_UNIT "ms" /end CHARACTERISTIC
/begin CHARACTERISTIC FPfl_UGF3_SR_hi "FPrm_latch(463)" VALUE 0x00160754 /* @ECU_Address@FPrm_latch@0x021BB73C@ */ ECIPP_ALIGNMENT_FLOAT32_IEEE 10000000000 Compu_IDENTITY -10000000000 10000000000 PHYS_UNIT "ms" /end CHARACTERISTIC
/begin CHARACTERISTIC FPfl_UGF3_SR_slow "FPrm_latch(462)" VALUE 0x00160750 /* @ECU_Address@FPrm_latch@0x021BB738@ */ ECIPP_ALIGNMENT_FLOAT32_IEEE 10000000000 Compu_IDENTITY -10000000000 10000000000 PHYS_UNIT "ms" /end CHARACTERISTIC
/begin CHARACTERISTIC FPfl_UGF3_Sv_hi "FPrm_latch(461)" VALUE 0x0016074C /* @ECU_Address@FPrm_latch@0x021BB734@ */ ECIPP_ALIGNMENT_FLOAT32_IEEE 10000000000 Compu_IDENTITY -10000000000 10000000000 PHYS_UNIT "ms" /end CHARACTERISTIC
/begin CHARACTERISTIC FPfl_UGF4_comm_lost "FPrm_latch(513)" VALUE 0x0016081C /* @ECU_Address@FPrm_latch@0x021BB804@ */ ECIPP_ALIGNMENT_FLOAT32_IEEE 10000000000 Compu_IDENTITY -10000000000 10000000000 PHYS_UNIT "ms" /end CHARACTERISTIC
/begin CHARACTERISTIC FPfu_TAUX2_max "FPrm_unlatch(422)" VALUE 0x00161174 /* @ECU_Address@FPrm_unlatch@0x021BD698@ */ ECIPP_ALIGNMENT_FLOAT32_IEEE 10000000000 Compu_IDENTITY -10000000000 10000000000 PHYS_UNIT "ms" /end CHARACTERISTIC
/begin CHARACTERISTIC FPfu_TAUX2_min "FPrm_unlatch(423)" VALUE 0x00161178 /* @ECU_Address@FPrm_unlatch@0x021BD69C@ */ ECIPP_ALIGNMENT_FLOAT32_IEEE 10000000000 Compu_IDENTITY -10000000000 10000000000 PHYS_UNIT "ms" /end CHARACTERISTIC
/begin CHARACTERISTIC FPfu_TAUX3_max "FPrm_unlatch(424)" VALUE 0x0016117C /* @ECU_Address@FPrm_unlatch@0x021BD6A0@ */ ECIPP_ALIGNMENT_FLOAT32_IEEE 10000000000 Compu_IDENTITY -10000000000 10000000000 PHYS_UNIT "ms" /end CHARACTERISTIC
/begin CHARACTERISTIC FPfu_TAUX3_min "FPrm_unlatch(425)" VALUE 0x00161180 /* @ECU_Address@FPrm_unlatch@0x021BD6A4@ */ ECIPP_ALIGNMENT_FLOAT32_IEEE 10000000000 Compu_IDENTITY -10000000000 10000000000 PHYS_UNIT "ms" /end CHARACTERISTIC
/begin CHARACTERISTIC FPfu_TAUX4_max "FPrm_unlatch(426)" VALUE 0x00161184 /* @ECU_Address@FPrm_unlatch@0x021BD6A8@ */ ECIPP_ALIGNMENT_FLOAT32_IEEE 10000000000 Compu_IDENTITY -10000000000 10000000000 PHYS_UNIT "ms" /end CHARACTERISTIC
/begin CHARACTERISTIC FPfu_TAUX4_min "FPrm_unlatch(427)" VALUE 0x00161188 /* @ECU_Address@FPrm_unlatch@0x021BD6AC@ */ ECIPP_ALIGNMENT_FLOAT32_IEEE 10000000000 Compu_IDENTITY -10000000000 10000000000 PHYS_UNIT "ms" /end CHARACTERISTIC
/begin CHARACTERISTIC FPfu_TEL_derate_actv "FPrm_unlatch(477)" VALUE 0x00161250 /* @ECU_Address@FPrm_unlatch@0x021BD774@ */ ECIPP_ALIGNMENT_FLOAT32_IEEE 10000000000 Compu_IDENTITY -10000000000 10000000000 PHYS_UNIT "ms" /end CHARACTERISTIC
/begin CHARACTERISTIC FPfu_TEL_dis "FPrm_unlatch(681)" VALUE 0x00161580 /* @ECU_Address@FPrm_unlatch@0x021BDAA4@ */ ECIPP_ALIGNMENT_FLOAT32_IEEE 10000000000 Compu_IDENTITY -10000000000 10000000000 PHYS_UNIT "ms" /end CHARACTERISTIC
/begin CHARACTERISTIC FPfu_TEL_intF "FPrm_unlatch(682)" VALUE 0x00161584 /* @ECU_Address@FPrm_unlatch@0x021BDAA8@ */ ECIPP_ALIGNMENT_FLOAT32_IEEE 10000000000 Compu_IDENTITY -10000000000 10000000000 PHYS_UNIT "ms" /end CHARACTERISTIC
/begin CHARACTERISTIC FPfu_TEL_key_invalid "FPrm_unlatch(648)" VALUE 0x001614FC /* @ECU_Address@FPrm_unlatch@0x021BDA20@ */ ECIPP_ALIGNMENT_FLOAT32_IEEE 10000000000 Compu_IDENTITY -10000000000 10000000000 PHYS_UNIT "ms" /end CHARACTERISTIC
/begin CHARACTERISTIC FPfu_TEL_key_to "FPrm_unlatch(647)" VALUE 0x001614F8 /* @ECU_Address@FPrm_unlatch@0x021BDA1C@ */ ECIPP_ALIGNMENT_FLOAT32_IEEE 10000000000 Compu_IDENTITY -10000000000 10000000000 PHYS_UNIT "ms" /end CHARACTERISTIC
/begin CHARACTERISTIC FPfu_TEL_req_to "FPrm_unlatch(646)" VALUE 0x001614F4 /* @ECU_Address@FPrm_unlatch@0x021BDA18@ */ ECIPP_ALIGNMENT_FLOAT32_IEEE 10000000000 Compu_IDENTITY -10000000000 10000000000 PHYS_UNIT "ms" /end CHARACTERISTIC
/begin CHARACTERISTIC FPfu_TEL_RPM_cmd "FPrm_unlatch(649)" VALUE 0x00161500 /* @ECU_Address@FPrm_unlatch@0x021BDA24@ */ ECIPP_ALIGNMENT_FLOAT32_IEEE 10000000000 Compu_IDENTITY -10000000000 10000000000 PHYS_UNIT "ms" /end CHARACTERISTIC
/begin CHARACTERISTIC FPfu_TEL_RPM_psv "FPrm_unlatch(652)" VALUE 0x0016150C /* @ECU_Address@FPrm_unlatch@0x021BDA30@ */ ECIPP_ALIGNMENT_FLOAT32_IEEE 10000000000 Compu_IDENTITY -10000000000 10000000000 PHYS_UNIT "ms" /end CHARACTERISTIC
/begin CHARACTERISTIC FPfu_TEL_shutdown_cmd "FPrm_unlatch(651)" VALUE 0x00161508 /* @ECU_Address@FPrm_unlatch@0x021BDA2C@ */ ECIPP_ALIGNMENT_FLOAT32_IEEE 10000000000 Compu_IDENTITY -10000000000 10000000000 PHYS_UNIT "ms" /end CHARACTERISTIC
/begin CHARACTERISTIC FPfu_TEL_shutdown_psv "FPrm_unlatch(654)" VALUE 0x00161514 /* @ECU_Address@FPrm_unlatch@0x021BDA38@ */ ECIPP_ALIGNMENT_FLOAT32_IEEE 10000000000 Compu_IDENTITY -10000000000 10000000000 PHYS_UNIT "ms" /end CHARACTERISTIC
/begin CHARACTERISTIC FPfu_TEL_torq_cmd "FPrm_unlatch(650)" VALUE 0x00161504 /* @ECU_Address@FPrm_unlatch@0x021BDA28@ */ ECIPP_ALIGNMENT_FLOAT32_IEEE 10000000000 Compu_IDENTITY -10000000000 10000000000 PHYS_UNIT "ms" /end CHARACTERISTIC
/begin CHARACTERISTIC FPfu_TEL_torq_psv "FPrm_unlatch(653)" VALUE 0x00161510 /* @ECU_Address@FPrm_unlatch@0x021BDA34@ */ ECIPP_ALIGNMENT_FLOAT32_IEEE 10000000000 Compu_IDENTITY -10000000000 10000000000 PHYS_UNIT "ms" /end CHARACTERISTIC
/begin CHARACTERISTIC FPfu_TIP_act "FPrm_unlatch(105)" VALUE 0x00160C80 /* @ECU_Address@FPrm_unlatch@0x021BD1A4@ */ ECIPP_ALIGNMENT_FLOAT32_IEEE 10000000000 Compu_IDENTITY -10000000000 10000000000 PHYS_UNIT "ms" /end CHARACTERISTIC
/begin CHARACTERISTIC FPfu_TIP_maxv "FPrm_unlatch(85)" VALUE 0x00160C30 /* @ECU_Address@FPrm_unlatch@0x021BD154@ */ ECIPP_ALIGNMENT_FLOAT32_IEEE 10000000000 Compu_IDENTITY -10000000000 10000000000 PHYS_UNIT "ms" /end CHARACTERISTIC
/begin CHARACTERISTIC FPfu_TIP_minv "FPrm_unlatch(86)" VALUE 0x00160C34 /* @ECU_Address@FPrm_unlatch@0x021BD158@ */ ECIPP_ALIGNMENT_FLOAT32_IEEE 10000000000 Compu_IDENTITY -10000000000 10000000000 PHYS_UNIT "ms" /end CHARACTERISTIC
/begin CHARACTERISTIC FPfu_TPS1_max "FPrm_unlatch(18)" VALUE 0x00160B24 /* @ECU_Address@FPrm_unlatch@0x021BD048@ */ ECIPP_ALIGNMENT_FLOAT32_IEEE 10000000000 Compu_IDENTITY -10000000000 10000000000 PHYS_UNIT "ms" /end CHARACTERISTIC
/begin CHARACTERISTIC FPfu_TPS1_min "FPrm_unlatch(19)" VALUE 0x00160B28 /* @ECU_Address@FPrm_unlatch@0x021BD04C@ */ ECIPP_ALIGNMENT_FLOAT32_IEEE 10000000000 Compu_IDENTITY -10000000000 10000000000 PHYS_UNIT "ms" /end CHARACTERISTIC
/begin CHARACTERISTIC FPfu_TPS12_OOR "FPrm_unlatch(144)" VALUE 0x00160D1C /* @ECU_Address@FPrm_unlatch@0x021BD240@ */ ECIPP_ALIGNMENT_FLOAT32_IEEE 10000000000 Compu_IDENTITY -10000000000 10000000000 PHYS_UNIT "ms" /end CHARACTERISTIC
/begin CHARACTERISTIC FPfu_TPS12pct_hi "FPrm_unlatch(22)" VALUE 0x00160B34 /* @ECU_Address@FPrm_unlatch@0x021BD058@ */ ECIPP_ALIGNMENT_FLOAT32_IEEE 10000000000 Compu_IDENTITY -10000000000 10000000000 PHYS_UNIT "ms" /end CHARACTERISTIC
/begin CHARACTERISTIC FPfu_TPS12pct_lo "FPrm_unlatch(23)" VALUE 0x00160B38 /* @ECU_Address@FPrm_unlatch@0x021BD05C@ */ ECIPP_ALIGNMENT_FLOAT32_IEEE 10000000000 Compu_IDENTITY -10000000000 10000000000 PHYS_UNIT "ms" /end CHARACTERISTIC
/begin CHARACTERISTIC FPfu_TPS2_max "FPrm_unlatch(20)" VALUE 0x00160B2C /* @ECU_Address@FPrm_unlatch@0x021BD050@ */ ECIPP_ALIGNMENT_FLOAT32_IEEE 10000000000 Compu_IDENTITY -10000000000 10000000000 PHYS_UNIT "ms" /end CHARACTERISTIC
/begin CHARACTERISTIC FPfu_TPS2_min "FPrm_unlatch(21)" VALUE 0x00160B30 /* @ECU_Address@FPrm_unlatch@0x021BD054@ */ ECIPP_ALIGNMENT_FLOAT32_IEEE 10000000000 Compu_IDENTITY -10000000000 10000000000 PHYS_UNIT "ms" /end CHARACTERISTIC
/begin CHARACTERISTIC FPfu_TPSerr_neg "FPrm_unlatch(25)" VALUE 0x00160B40 /* @ECU_Address@FPrm_unlatch@0x021BD064@ */ ECIPP_ALIGNMENT_FLOAT32_IEEE 10000000000 Compu_IDENTITY -10000000000 10000000000 PHYS_UNIT "ms" /end CHARACTERISTIC
/begin CHARACTERISTIC FPfu_TPSerr_pos "FPrm_unlatch(24)" VALUE 0x00160B3C /* @ECU_Address@FPrm_unlatch@0x021BD060@ */ ECIPP_ALIGNMENT_FLOAT32_IEEE 10000000000 Compu_IDENTITY -10000000000 10000000000 PHYS_UNIT "ms" /end CHARACTERISTIC
/begin CHARACTERISTIC FPfu_TRANS_comm "FPrm_unlatch(678)" VALUE 0x00161574 /* @ECU_Address@FPrm_unlatch@0x021BDA98@ */ ECIPP_ALIGNMENT_FLOAT32_IEEE 10000000000 Compu_IDENTITY -10000000000 10000000000 PHYS_UNIT "ms" /end CHARACTERISTIC
/begin CHARACTERISTIC FPfu_TRANS_fuel_inh "FPrm_unlatch(679)" VALUE 0x00161578 /* @ECU_Address@FPrm_unlatch@0x021BDA9C@ */ ECIPP_ALIGNMENT_FLOAT32_IEEE 10000000000 Compu_IDENTITY -10000000000 10000000000 PHYS_UNIT "ms" /end CHARACTERISTIC
/begin CHARACTERISTIC FPfu_TWCDiag_OSC_lo "FPrm_unlatch(633)" VALUE 0x001614C0 /* @ECU_Address@FPrm_unlatch@0x021BD9E4@ */ ECIPP_ALIGNMENT_FLOAT32_IEEE 10000000000 Compu_IDENTITY -10000000000 10000000000 PHYS_UNIT "samples" /end CHARACTERISTIC
/begin CHARACTERISTIC FPfu_UEGOH1_off_open "FPrm_unlatch(324)" VALUE 0x00160FEC /* @ECU_Address@FPrm_unlatch@0x021BD510@ */ ECIPP_ALIGNMENT_FLOAT32_IEEE 10000000000 Compu_IDENTITY -10000000000 10000000000 PHYS_UNIT "ms" /end CHARACTERISTIC
/begin CHARACTERISTIC FPfu_UEGOH1_on_short "FPrm_unlatch(325)" VALUE 0x00160FF0 /* @ECU_Address@FPrm_unlatch@0x021BD514@ */ ECIPP_ALIGNMENT_FLOAT32_IEEE 10000000000 Compu_IDENTITY -10000000000 10000000000 PHYS_UNIT "ms" /end CHARACTERISTIC
/begin CHARACTERISTIC FPfu_UEGOH2_off_open "FPrm_unlatch(326)" VALUE 0x00160FF4 /* @ECU_Address@FPrm_unlatch@0x021BD518@ */ ECIPP_ALIGNMENT_FLOAT32_IEEE 10000000000 Compu_IDENTITY -10000000000 10000000000 PHYS_UNIT "ms" /end CHARACTERISTIC
/begin CHARACTERISTIC FPfu_UEGOH2_on_short "FPrm_unlatch(327)" VALUE 0x00160FF8 /* @ECU_Address@FPrm_unlatch@0x021BD51C@ */ ECIPP_ALIGNMENT_FLOAT32_IEEE 10000000000 Compu_IDENTITY -10000000000 10000000000 PHYS_UNIT "ms" /end CHARACTERISTIC
/begin CHARACTERISTIC FPfu_UEGOH3_off_open "FPrm_unlatch(464)" VALUE 0x0016121C /* @ECU_Address@FPrm_unlatch@0x021BD740@ */ ECIPP_ALIGNMENT_FLOAT32_IEEE 10000000000 Compu_IDENTITY -10000000000 10000000000 PHYS_UNIT "ms" /end CHARACTERISTIC
/begin CHARACTERISTIC FPfu_UEGOH3_on_short "FPrm_unlatch(465)" VALUE 0x00161220 /* @ECU_Address@FPrm_unlatch@0x021BD744@ */ ECIPP_ALIGNMENT_FLOAT32_IEEE 10000000000 Compu_IDENTITY -10000000000 10000000000 PHYS_UNIT "ms" /end CHARACTERISTIC
/begin CHARACTERISTIC FPfu_UEGOH4_off_open "FPrm_unlatch(475)" VALUE 0x00161248 /* @ECU_Address@FPrm_unlatch@0x021BD76C@ */ ECIPP_ALIGNMENT_FLOAT32_IEEE 10000000000 Compu_IDENTITY -10000000000 10000000000 PHYS_UNIT "ms" /end CHARACTERISTIC
/begin CHARACTERISTIC FPfu_UEGOH4_on_short "FPrm_unlatch(476)" VALUE 0x0016124C /* @ECU_Address@FPrm_unlatch@0x021BD770@ */ ECIPP_ALIGNMENT_FLOAT32_IEEE 10000000000 Compu_IDENTITY -10000000000 10000000000 PHYS_UNIT "ms" /end CHARACTERISTIC
/begin CHARACTERISTIC FPfu_UGF_Hv_hi "FPrm_unlatch(190)" VALUE 0x00160DD4 /* @ECU_Address@FPrm_unlatch@0x021BD2F8@ */ ECIPP_ALIGNMENT_FLOAT32_IEEE 10000000000 Compu_IDENTITY -10000000000 10000000000 PHYS_UNIT "ms" /end CHARACTERISTIC
/begin CHARACTERISTIC FPfu_UGF_internal "FPrm_unlatch(189)" VALUE 0x00160DD0 /* @ECU_Address@FPrm_unlatch@0x021BD2F4@ */ ECIPP_ALIGNMENT_FLOAT32_IEEE 10000000000 Compu_IDENTITY -10000000000 10000000000 PHYS_UNIT "ms" /end CHARACTERISTIC
/begin CHARACTERISTIC FPfu_UGF_lowsupply "FPrm_unlatch(400)" VALUE 0x0016111C /* @ECU_Address@FPrm_unlatch@0x021BD640@ */ ECIPP_ALIGNMENT_FLOAT32_IEEE 10000000000 Compu_IDENTITY -10000000000 10000000000 PHYS_UNIT "ms" /end CHARACTERISTIC
/begin CHARACTERISTIC FPfu_UGF1_comm_lost "FPrm_unlatch(510)" VALUE 0x001612D4 /* @ECU_Address@FPrm_unlatch@0x021BD7F8@ */ ECIPP_ALIGNMENT_FLOAT32_IEEE 10000000000 Compu_IDENTITY -10000000000 10000000000 PHYS_UNIT "ms" /end CHARACTERISTIC
/begin CHARACTERISTIC FPfu_UGF1_drifttl2 "FPrm_unlatch(406)" VALUE 0x00161134 /* @ECU_Address@FPrm_unlatch@0x021BD658@ */ ECIPP_ALIGNMENT_FLOAT32_IEEE 10000000000 Compu_IDENTITY -10000000000 10000000000 PHYS_UNIT "ms" /end CHARACTERISTIC
/begin CHARACTERISTIC FPfu_UGF1_drifttol "FPrm_unlatch(384)" VALUE 0x001610DC /* @ECU_Address@FPrm_unlatch@0x021BD600@ */ ECIPP_ALIGNMENT_FLOAT32_IEEE 10000000000 Compu_IDENTITY -10000000000 10000000000 PHYS_UNIT "ms" /end CHARACTERISTIC
/begin CHARACTERISTIC FPfu_UGF1_R_hi "FPrm_unlatch(191)" VALUE 0x00160DD8 /* @ECU_Address@FPrm_unlatch@0x021BD2FC@ */ ECIPP_ALIGNMENT_FLOAT32_IEEE 10000000000 Compu_IDENTITY -10000000000 10000000000 PHYS_UNIT "ms" /end CHARACTERISTIC
/begin CHARACTERISTIC FPfu_UGF1_SR_hi "FPrm_unlatch(194)" VALUE 0x00160DE4 /* @ECU_Address@FPrm_unlatch@0x021BD308@ */ ECIPP_ALIGNMENT_FLOAT32_IEEE 10000000000 Compu_IDENTITY -10000000000 10000000000 PHYS_UNIT "ms" /end CHARACTERISTIC
/begin CHARACTERISTIC FPfu_UGF1_SR_slow "FPrm_unlatch(193)" VALUE 0x00160DE0 /* @ECU_Address@FPrm_unlatch@0x021BD304@ */ ECIPP_ALIGNMENT_FLOAT32_IEEE 10000000000 Compu_IDENTITY -10000000000 10000000000 PHYS_UNIT "ms" /end CHARACTERISTIC
/begin CHARACTERISTIC FPfu_UGF1_Sv_hi "FPrm_unlatch(192)" VALUE 0x00160DDC /* @ECU_Address@FPrm_unlatch@0x021BD300@ */ ECIPP_ALIGNMENT_FLOAT32_IEEE 10000000000 Compu_IDENTITY -10000000000 10000000000 PHYS_UNIT "ms" /end CHARACTERISTIC
/begin CHARACTERISTIC FPfu_UGF2_comm_lost "FPrm_unlatch(511)" VALUE 0x001612D8 /* @ECU_Address@FPrm_unlatch@0x021BD7FC@ */ ECIPP_ALIGNMENT_FLOAT32_IEEE 10000000000 Compu_IDENTITY -10000000000 10000000000 PHYS_UNIT "ms" /end CHARACTERISTIC
/begin CHARACTERISTIC FPfu_UGF2_drifttl2 "FPrm_unlatch(407)" VALUE 0x00161138 /* @ECU_Address@FPrm_unlatch@0x021BD65C@ */ ECIPP_ALIGNMENT_FLOAT32_IEEE 10000000000 Compu_IDENTITY -10000000000 10000000000 PHYS_UNIT "ms" /end CHARACTERISTIC
/begin CHARACTERISTIC FPfu_UGF2_drifttol "FPrm_unlatch(385)" VALUE 0x001610E0 /* @ECU_Address@FPrm_unlatch@0x021BD604@ */ ECIPP_ALIGNMENT_FLOAT32_IEEE 10000000000 Compu_IDENTITY -10000000000 10000000000 PHYS_UNIT "ms" /end CHARACTERISTIC
/begin CHARACTERISTIC FPfu_UGF2_Hv_hi "FPrm_unlatch(318)" VALUE 0x00160FD4 /* @ECU_Address@FPrm_unlatch@0x021BD4F8@ */ ECIPP_ALIGNMENT_FLOAT32_IEEE 10000000000 Compu_IDENTITY -10000000000 10000000000 PHYS_UNIT "ms" /end CHARACTERISTIC
/begin CHARACTERISTIC FPfu_UGF2_internal "FPrm_unlatch(317)" VALUE 0x00160FD0 /* @ECU_Address@FPrm_unlatch@0x021BD4F4@ */ ECIPP_ALIGNMENT_FLOAT32_IEEE 10000000000 Compu_IDENTITY -10000000000 10000000000 PHYS_UNIT "ms" /end CHARACTERISTIC
/begin CHARACTERISTIC FPfu_UGF2_lowsupply "FPrm_unlatch(401)" VALUE 0x00161120 /* @ECU_Address@FPrm_unlatch@0x021BD644@ */ ECIPP_ALIGNMENT_FLOAT32_IEEE 10000000000 Compu_IDENTITY -10000000000 10000000000 PHYS_UNIT "ms" /end CHARACTERISTIC
/begin CHARACTERISTIC FPfu_UGF2_R_hi "FPrm_unlatch(319)" VALUE 0x00160FD8 /* @ECU_Address@FPrm_unlatch@0x021BD4FC@ */ ECIPP_ALIGNMENT_FLOAT32_IEEE 10000000000 Compu_IDENTITY -10000000000 10000000000 PHYS_UNIT "ms" /end CHARACTERISTIC
/begin CHARACTERISTIC FPfu_UGF2_SR_hi "FPrm_unlatch(322)" VALUE 0x00160FE4 /* @ECU_Address@FPrm_unlatch@0x021BD508@ */ ECIPP_ALIGNMENT_FLOAT32_IEEE 10000000000 Compu_IDENTITY -10000000000 10000000000 PHYS_UNIT "ms" /end CHARACTERISTIC
/begin CHARACTERISTIC FPfu_UGF2_SR_slow "FPrm_unlatch(321)" VALUE 0x00160FE0 /* @ECU_Address@FPrm_unlatch@0x021BD504@ */ ECIPP_ALIGNMENT_FLOAT32_IEEE 10000000000 Compu_IDENTITY -10000000000 10000000000 PHYS_UNIT "ms" /end CHARACTERISTIC
/begin CHARACTERISTIC FPfu_UGF2_Sv_hi "FPrm_unlatch(320)" VALUE 0x00160FDC /* @ECU_Address@FPrm_unlatch@0x021BD500@ */ ECIPP_ALIGNMENT_FLOAT32_IEEE 10000000000 Compu_IDENTITY -10000000000 10000000000 PHYS_UNIT "ms" /end CHARACTERISTIC
/begin CHARACTERISTIC FPfu_UGF3_comm_lost "FPrm_unlatch(512)" VALUE 0x001612DC /* @ECU_Address@FPrm_unlatch@0x021BD800@ */ ECIPP_ALIGNMENT_FLOAT32_IEEE 10000000000 Compu_IDENTITY -10000000000 10000000000 PHYS_UNIT "ms" /end CHARACTERISTIC
/begin CHARACTERISTIC FPfu_UGF3_drifttl2 "FPrm_unlatch(458)" VALUE 0x00161204 /* @ECU_Address@FPrm_unlatch@0x021BD728@ */ ECIPP_ALIGNMENT_FLOAT32_IEEE 10000000000 Compu_IDENTITY -10000000000 10000000000 PHYS_UNIT "ms" /end CHARACTERISTIC
/begin CHARACTERISTIC FPfu_UGF3_drifttol "FPrm_unlatch(457)" VALUE 0x00161200 /* @ECU_Address@FPrm_unlatch@0x021BD724@ */ ECIPP_ALIGNMENT_FLOAT32_IEEE 10000000000 Compu_IDENTITY -10000000000 10000000000 PHYS_UNIT "ms" /end CHARACTERISTIC
/begin CHARACTERISTIC FPfu_UGF3_Hv_hi "FPrm_unlatch(459)" VALUE 0x00161208 /* @ECU_Address@FPrm_unlatch@0x021BD72C@ */ ECIPP_ALIGNMENT_FLOAT32_IEEE 10000000000 Compu_IDENTITY -10000000000 10000000000 PHYS_UNIT "ms" /end CHARACTERISTIC
/begin CHARACTERISTIC FPfu_UGF3_internal "FPrm_unlatch(455)" VALUE 0x001611F8 /* @ECU_Address@FPrm_unlatch@0x021BD71C@ */ ECIPP_ALIGNMENT_FLOAT32_IEEE 10000000000 Compu_IDENTITY -10000000000 10000000000 PHYS_UNIT "ms" /end CHARACTERISTIC
/begin CHARACTERISTIC FPfu_UGF3_lowsupply "FPrm_unlatch(456)" VALUE 0x001611FC /* @ECU_Address@FPrm_unlatch@0x021BD720@ */ ECIPP_ALIGNMENT_FLOAT32_IEEE 10000000000 Compu_IDENTITY -10000000000 10000000000 PHYS_UNIT "ms" /end CHARACTERISTIC
/begin CHARACTERISTIC FPfu_UGF3_R_hi "FPrm_unlatch(460)" VALUE 0x0016120C /* @ECU_Address@FPrm_unlatch@0x021BD730@ */ ECIPP_ALIGNMENT_FLOAT32_IEEE 10000000000 Compu_IDENTITY -10000000000 10000000000 PHYS_UNIT "ms" /end CHARACTERISTIC
/begin CHARACTERISTIC FPfu_UGF3_SR_hi "FPrm_unlatch(463)" VALUE 0x00161218 /* @ECU_Address@FPrm_unlatch@0x021BD73C@ */ ECIPP_ALIGNMENT_FLOAT32_IEEE 10000000000 Compu_IDENTITY -10000000000 10000000000 PHYS_UNIT "ms" /end CHARACTERISTIC
/begin CHARACTERISTIC FPfu_UGF3_SR_slow "FPrm_unlatch(462)" VALUE 0x00161214 /* @ECU_Address@FPrm_unlatch@0x021BD738@ */ ECIPP_ALIGNMENT_FLOAT32_IEEE 10000000000 Compu_IDENTITY -10000000000 10000000000 PHYS_UNIT "ms" /end CHARACTERISTIC
/begin CHARACTERISTIC FPfu_UGF3_Sv_hi "FPrm_unlatch(461)" VALUE 0x00161210 /* @ECU_Address@FPrm_unlatch@0x021BD734@ */ ECIPP_ALIGNMENT_FLOAT32_IEEE 10000000000 Compu_IDENTITY -10000000000 10000000000 PHYS_UNIT "ms" /end CHARACTERISTIC
/begin CHARACTERISTIC FPfu_UGF4_comm_lost "FPrm_unlatch(513)" VALUE 0x001612E0 /* @ECU_Address@FPrm_unlatch@0x021BD804@ */ ECIPP_ALIGNMENT_FLOAT32_IEEE 10000000000 Compu_IDENTITY -10000000000 10000000000 PHYS_UNIT "ms" /end CHARACTERISTIC
/begin GROUP TAUX2_max_EC_Fault "Auxiliary temperature 2 high"
 /begin REF_CHARACTERISTIC FCdc4_TAUX2_max FCdtc_TAUX2_max FCfmi_TAUX2_max FCftb_TAUX2_max FCspn_TAUX2_max FPfl_TAUX2_max FPfu_TAUX2_max FPnd_TAUX2_max FPsvr_TAUX2_max FPsw_ext1_TAUX2_max FPsw_TAUX2_max /end REF_CHARACTERISTIC
/end GROUP
/begin GROUP TAUX2_min_EC_Fault "Auxiliary temperature 2 low"
 /begin REF_CHARACTERISTIC FCdc4_TAUX2_min FCdtc_TAUX2_min FCfmi_TAUX2_min FCftb_TAUX2_min FCspn_TAUX2_min FPfl_TAUX2_min FPfu_TAUX2_min FPnd_TAUX2_min FPsvr_TAUX2_min FPsw_ext1_TAUX2_min FPsw_TAUX2_min /end REF_CHARACTERISTIC
/end GROUP
/begin GROUP TAUX3_max_EC_Fault "Auxiliary temperature 3 high"
 /begin REF_CHARACTERISTIC FCdc4_TAUX3_max FCdtc_TAUX3_max FCfmi_TAUX3_max FCftb_TAUX3_max FCspn_TAUX3_max FPfl_TAUX3_max FPfu_TAUX3_max FPnd_TAUX3_max FPsvr_TAUX3_max FPsw_ext1_TAUX3_max FPsw_TAUX3_max /end REF_CHARACTERISTIC
/end GROUP
/begin GROUP TAUX3_min_EC_Fault "Auxiliary temperature 3 low"
 /begin REF_CHARACTERISTIC FCdc4_TAUX3_min FCdtc_TAUX3_min FCfmi_TAUX3_min FCftb_TAUX3_min FCspn_TAUX3_min FPfl_TAUX3_min FPfu_TAUX3_min FPnd_TAUX3_min FPsvr_TAUX3_min FPsw_ext1_TAUX3_min FPsw_TAUX3_min /end REF_CHARACTERISTIC
/end GROUP
/begin GROUP TAUX4_max_EC_Fault "Auxiliary temperature 4 high"
 /begin REF_CHARACTERISTIC FCdc4_TAUX4_max FCdtc_TAUX4_max FCfmi_TAUX4_max FCftb_TAUX4_max FCspn_TAUX4_max FPfl_TAUX4_max FPfu_TAUX4_max FPnd_TAUX4_max FPsvr_TAUX4_max FPsw_ext1_TAUX4_max FPsw_TAUX4_max /end REF_CHARACTERISTIC
/end GROUP
/begin GROUP TAUX4_min_EC_Fault "Auxiliary temperature 4 low"
 /begin REF_CHARACTERISTIC FCdc4_TAUX4_min FCdtc_TAUX4_min FCfmi_TAUX4_min FCftb_TAUX4_min FCspn_TAUX4_min FPfl_TAUX4_min FPfu_TAUX4_min FPnd_TAUX4_min FPsvr_TAUX4_min FPsw_ext1_TAUX4_min FPsw_TAUX4_min /end REF_CHARACTERISTIC
/end GROUP
/begin GROUP TEL_derate_actv_EC_Fault "Telematics derate active"
 /begin REF_CHARACTERISTIC FCdc4_TEL_derate_actv FCdtc_TEL_derate_actv FCfmi_TEL_derate_actv FCftb_TEL_derate_actv FCspn_TEL_derate_actv FPfl_TEL_derate_actv FPfu_TEL_derate_actv FPnd_TEL_derate_actv FPsvr_TEL_derate_actv FPsw_ext1_TEL_derate_actv FPsw_TEL_derate_actv /end REF_CHARACTERISTIC
/end GROUP
/begin GROUP TEL_dis_EC_Fault "Telematics unit disconnected"
 /begin REF_CHARACTERISTIC FCdc4_TEL_dis FCdtc_TEL_dis FCfmi_TEL_dis FCftb_TEL_dis FCspn_TEL_dis FPfl_TEL_dis FPfu_TEL_dis FPnd_TEL_dis FPsvr_TEL_dis FPsw_ext1_TEL_dis FPsw_TEL_dis /end REF_CHARACTERISTIC
/end GROUP
/begin GROUP TEL_intF_EC_Fault "Telematics unit internal fault"
 /begin REF_CHARACTERISTIC FCdc4_TEL_intF FCdtc_TEL_intF FCfmi_TEL_intF FCftb_TEL_intF FCspn_TEL_intF FPfl_TEL_intF FPfu_TEL_intF FPnd_TEL_intF FPsvr_TEL_intF FPsw_ext1_TEL_intF FPsw_TEL_intF /end REF_CHARACTERISTIC
/end GROUP
/begin GROUP TEL_key_invalid_EC_Fault "Telematics invalid key"
 /begin REF_CHARACTERISTIC FCdc4_TEL_key_invalid FCdtc_TEL_key_invalid FCfmi_TEL_key_invalid FCftb_TEL_key_invalid FCspn_TEL_key_invalid FPfl_TEL_key_invalid FPfu_TEL_key_invalid FPnd_TEL_key_invalid FPsvr_TEL_key_invalid FPsw_ext1_TEL_key_invalid FPsw_TEL_key_invalid /end REF_CHARACTERISTIC
/end GROUP
/begin GROUP TEL_key_to_EC_Fault "Telematics timeout waiting for key"
 /begin REF_CHARACTERISTIC FCdc4_TEL_key_to FCdtc_TEL_key_to FCfmi_TEL_key_to FCftb_TEL_key_to FCspn_TEL_key_to FPfl_TEL_key_to FPfu_TEL_key_to FPnd_TEL_key_to FPsvr_TEL_key_to FPsw_ext1_TEL_key_to FPsw_TEL_key_to /end REF_CHARACTERISTIC
/end GROUP
/begin GROUP TEL_req_to_EC_Fault "Telematics timeout waiting for request"
 /begin REF_CHARACTERISTIC FCdc4_TEL_req_to FCdtc_TEL_req_to FCfmi_TEL_req_to FCftb_TEL_req_to FCspn_TEL_req_to FPfl_TEL_req_to FPfu_TEL_req_to FPnd_TEL_req_to FPsvr_TEL_req_to FPsw_ext1_TEL_req_to FPsw_TEL_req_to /end REF_CHARACTERISTIC
/end GROUP
/begin GROUP TEL_RPM_cmd_EC_Fault "Telematics commanded RPM limit"
 /begin REF_CHARACTERISTIC FCdc4_TEL_RPM_cmd FCdtc_TEL_RPM_cmd FCfmi_TEL_RPM_cmd FCftb_TEL_RPM_cmd FCspn_TEL_RPM_cmd FPfl_TEL_RPM_cmd FPfu_TEL_RPM_cmd FPnd_TEL_RPM_cmd FPsvr_TEL_RPM_cmd FPsw_ext1_TEL_RPM_cmd FPsw_TEL_RPM_cmd /end REF_CHARACTERISTIC
/end GROUP
/begin GROUP TEL_RPM_psv_EC_Fault "Telematics passive RPM limit"
 /begin REF_CHARACTERISTIC FCdc4_TEL_RPM_psv FCdtc_TEL_RPM_psv FCfmi_TEL_RPM_psv FCftb_TEL_RPM_psv FCspn_TEL_RPM_psv FPfl_TEL_RPM_psv FPfu_TEL_RPM_psv FPnd_TEL_RPM_psv FPsvr_TEL_RPM_psv FPsw_ext1_TEL_RPM_psv FPsw_TEL_RPM_psv /end REF_CHARACTERISTIC
/end GROUP
/begin GROUP TEL_shutdown_cmd_EC_Fault "Telematics commanded engine shut-down"
 /begin REF_CHARACTERISTIC FCdc4_TEL_shutdown_cmd FCdtc_TEL_shutdown_cmd FCfmi_TEL_shutdown_cmd FCftb_TEL_shutdown_cmd FCspn_TEL_shutdown_cmd FPfl_TEL_shutdown_cmd FPfu_TEL_shutdown_cmd FPnd_TEL_shutdown_cmd FPsvr_TEL_shutdown_cmd FPsw_ext1_TEL_shutdown_cmd FPsw_TEL_shutdown_cmd /end REF_CHARACTERISTIC
/end GROUP
/begin GROUP TEL_shutdown_psv_EC_Fault "Telematics passive shut-down"
 /begin REF_CHARACTERISTIC FCdc4_TEL_shutdown_psv FCdtc_TEL_shutdown_psv FCfmi_TEL_shutdown_psv FCftb_TEL_shutdown_psv FCspn_TEL_shutdown_psv FPfl_TEL_shutdown_psv FPfu_TEL_shutdown_psv FPnd_TEL_shutdown_psv FPsvr_TEL_shutdown_psv FPsw_ext1_TEL_shutdown_psv FPsw_TEL_shutdown_psv /end REF_CHARACTERISTIC
/end GROUP
/begin GROUP TEL_torq_cmd_EC_Fault "Telematics commanded torque limit"
 /begin REF_CHARACTERISTIC FCdc4_TEL_torq_cmd FCdtc_TEL_torq_cmd FCfmi_TEL_torq_cmd FCftb_TEL_torq_cmd FCspn_TEL_torq_cmd FPfl_TEL_torq_cmd FPfu_TEL_torq_cmd FPnd_TEL_torq_cmd FPsvr_TEL_torq_cmd FPsw_ext1_TEL_torq_cmd FPsw_TEL_torq_cmd /end REF_CHARACTERISTIC
/end GROUP
/begin GROUP TEL_torq_psv_EC_Fault "Telematics passive torque limit"
 /begin REF_CHARACTERISTIC FCdc4_TEL_torq_psv FCdtc_TEL_torq_psv FCfmi_TEL_torq_psv FCftb_TEL_torq_psv FCspn_TEL_torq_psv FPfl_TEL_torq_psv FPfu_TEL_torq_psv FPnd_TEL_torq_psv FPsvr_TEL_torq_psv FPsw_ext1_TEL_torq_psv FPsw_TEL_torq_psv /end REF_CHARACTERISTIC
/end GROUP
/begin GROUP TIP_act_EC_Fault "TIP/TOP active"
 /begin REF_CHARACTERISTIC FCdc4_TIP_act FCdtc_TIP_act FCfmi_TIP_act FCftb_TIP_act FCspn_TIP_act FPfl_TIP_act FPfu_TIP_act FPnd_TIP_act FPsvr_TIP_act FPsw_ext1_TIP_act FPsw_TIP_act /end REF_CHARACTERISTIC
/end GROUP
/begin GROUP TIP_maxv_EC_Fault "TIP/TOP high voltage"
 /begin REF_CHARACTERISTIC FCdc4_TIP_maxv FCdtc_TIP_maxv FCfmi_TIP_maxv FCftb_TIP_maxv FCspn_TIP_maxv FPfl_TIP_maxv FPfu_TIP_maxv FPnd_TIP_maxv FPsvr_TIP_maxv FPsw_ext1_TIP_maxv FPsw_TIP_maxv /end REF_CHARACTERISTIC
/end GROUP
/begin GROUP TIP_minv_EC_Fault "TIP/TOP low voltage"
 /begin REF_CHARACTERISTIC FCdc4_TIP_minv FCdtc_TIP_minv FCfmi_TIP_minv FCftb_TIP_minv FCspn_TIP_minv FPfl_TIP_minv FPfu_TIP_minv FPnd_TIP_minv FPsvr_TIP_minv FPsw_ext1_TIP_minv FPsw_TIP_minv /end REF_CHARACTERISTIC
/end GROUP
/begin GROUP TPS1_max_EC_Fault "TPS1 high voltage"
 /begin REF_CHARACTERISTIC FCdc4_TPS1_max FCdtc_TPS1_max FCfmi_TPS1_max FCftb_TPS1_max FCspn_TPS1_max FPfl_TPS1_max FPfu_TPS1_max FPnd_TPS1_max FPsvr_TPS1_max FPsw_ext1_TPS1_max FPsw_TPS1_max /end REF_CHARACTERISTIC
/end GROUP
/begin GROUP TPS1_min_EC_Fault "TPS1 low voltage"
 /begin REF_CHARACTERISTIC FCdc4_TPS1_min FCdtc_TPS1_min FCfmi_TPS1_min FCftb_TPS1_min FCspn_TPS1_min FPfl_TPS1_min FPfu_TPS1_min FPnd_TPS1_min FPsvr_TPS1_min FPsw_ext1_TPS1_min FPsw_TPS1_min /end REF_CHARACTERISTIC
/end GROUP
/begin GROUP TPS12_OOR_EC_Fault "TPS1/2 simultaneous voltages"
 /begin REF_CHARACTERISTIC FCdc4_TPS12_OOR FCdtc_TPS12_OOR FCfmi_TPS12_OOR FCftb_TPS12_OOR FCspn_TPS12_OOR FPfl_TPS12_OOR FPfu_TPS12_OOR FPnd_TPS12_OOR FPsvr_TPS12_OOR FPsw_ext1_TPS12_OOR FPsw_TPS12_OOR /end REF_CHARACTERISTIC
/end GROUP
/begin GROUP TPS12pct_hi_EC_Fault "TPS1 higher than TPS2"
 /begin REF_CHARACTERISTIC FCdc4_TPS12pct_hi FCdtc_TPS12pct_hi FCfmi_TPS12pct_hi FCftb_TPS12pct_hi FCspn_TPS12pct_hi FPfl_TPS12pct_hi FPfu_TPS12pct_hi FPnd_TPS12pct_hi FPsvr_TPS12pct_hi FPsw_ext1_TPS12pct_hi FPsw_TPS12pct_hi /end REF_CHARACTERISTIC
/end GROUP
/begin GROUP TPS12pct_lo_EC_Fault "TPS1 lower than TPS2"
 /begin REF_CHARACTERISTIC FCdc4_TPS12pct_lo FCdtc_TPS12pct_lo FCfmi_TPS12pct_lo FCftb_TPS12pct_lo FCspn_TPS12pct_lo FPfl_TPS12pct_lo FPfu_TPS12pct_lo FPnd_TPS12pct_lo FPsvr_TPS12pct_lo FPsw_ext1_TPS12pct_lo FPsw_TPS12pct_lo /end REF_CHARACTERISTIC
/end GROUP
/begin GROUP TPS2_max_EC_Fault "TPS2 high voltage"
 /begin REF_CHARACTERISTIC FCdc4_TPS2_max FCdtc_TPS2_max FCfmi_TPS2_max FCftb_TPS2_max FCspn_TPS2_max FPfl_TPS2_max FPfu_TPS2_max FPnd_TPS2_max FPsvr_TPS2_max FPsw_ext1_TPS2_max FPsw_TPS2_max /end REF_CHARACTERISTIC
/end GROUP
/begin GROUP TPS2_min_EC_Fault "TPS2 low voltage"
 /begin REF_CHARACTERISTIC FCdc4_TPS2_min FCdtc_TPS2_min FCfmi_TPS2_min FCftb_TPS2_min FCspn_TPS2_min FPfl_TPS2_min FPfu_TPS2_min FPnd_TPS2_min FPsvr_TPS2_min FPsw_ext1_TPS2_min FPsw_TPS2_min /end REF_CHARACTERISTIC
/end GROUP
/begin GROUP TPSerr_neg_EC_Fault "Unable to reach lower TPS"
 /begin REF_CHARACTERISTIC FCdc4_TPSerr_neg FCdtc_TPSerr_neg FCfmi_TPSerr_neg FCftb_TPSerr_neg FCspn_TPSerr_neg FPfl_TPSerr_neg FPfu_TPSerr_neg FPnd_TPSerr_neg FPsvr_TPSerr_neg FPsw_ext1_TPSerr_neg FPsw_TPSerr_neg /end REF_CHARACTERISTIC
/end GROUP
/begin GROUP TPSerr_pos_EC_Fault "Unable to reach higher TPS"
 /begin REF_CHARACTERISTIC FCdc4_TPSerr_pos FCdtc_TPSerr_pos FCfmi_TPSerr_pos FCftb_TPSerr_pos FCspn_TPSerr_pos FPfl_TPSerr_pos FPfu_TPSerr_pos FPnd_TPSerr_pos FPsvr_TPSerr_pos FPsw_ext1_TPSerr_pos FPsw_TPSerr_pos /end REF_CHARACTERISTIC
/end GROUP
/begin GROUP TRANS_comm_EC_Fault "Transmission communication lost"
 /begin REF_CHARACTERISTIC FCdc4_TRANS_comm FCdtc_TRANS_comm FCfmi_TRANS_comm FCftb_TRANS_comm FCspn_TRANS_comm FPfl_TRANS_comm FPfu_TRANS_comm FPnd_TRANS_comm FPsvr_TRANS_comm FPsw_ext1_TRANS_comm FPsw_TRANS_comm /end REF_CHARACTERISTIC
/end GROUP
/begin GROUP TRANS_fuel_inh_EC_Fault "Transmission inhibiting fueling"
 /begin REF_CHARACTERISTIC FCdc4_TRANS_fuel_inh FCdtc_TRANS_fuel_inh FCfmi_TRANS_fuel_inh FCftb_TRANS_fuel_inh FCspn_TRANS_fuel_inh FPfl_TRANS_fuel_inh FPfu_TRANS_fuel_inh FPnd_TRANS_fuel_inh FPsvr_TRANS_fuel_inh FPsw_ext1_TRANS_fuel_inh FPsw_TRANS_fuel_inh /end REF_CHARACTERISTIC
/end GROUP
/begin GROUP TWCDiag_OSC_lo_EC_Fault "TWC oxygen storage monitor"
 /begin REF_CHARACTERISTIC FCdc4_TWCDiag_OSC_lo FCdtc_TWCDiag_OSC_lo FCfmi_TWCDiag_OSC_lo FCftb_TWCDiag_OSC_lo FCspn_TWCDiag_OSC_lo FPfl_TWCDiag_OSC_lo FPfu_TWCDiag_OSC_lo FPnd_TWCDiag_OSC_lo FPsvr_TWCDiag_OSC_lo FPsw_ext1_TWCDiag_OSC_lo FPsw_TWCDiag_OSC_lo /end REF_CHARACTERISTIC
/end GROUP
/begin GROUP UEGOH1_off_open_EC_Fault "UEGO1 heater open / ground short"
 /begin REF_CHARACTERISTIC FCdc4_UEGOH1_off_open FCdtc_UEGOH1_off_open FCfmi_UEGOH1_off_open FCftb_UEGOH1_off_open FCspn_UEGOH1_off_open FPfl_UEGOH1_off_open FPfu_UEGOH1_off_open FPnd_UEGOH1_off_open FPsvr_UEGOH1_off_open FPsw_ext1_UEGOH1_off_open FPsw_UEGOH1_off_open /end REF_CHARACTERISTIC
/end GROUP
/begin GROUP UEGOH1_on_short_EC_Fault "UEGO1 heater short to power"
 /begin REF_CHARACTERISTIC FCdc4_UEGOH1_on_short FCdtc_UEGOH1_on_short FCfmi_UEGOH1_on_short FCftb_UEGOH1_on_short FCspn_UEGOH1_on_short FPfl_UEGOH1_on_short FPfu_UEGOH1_on_short FPnd_UEGOH1_on_short FPsvr_UEGOH1_on_short FPsw_ext1_UEGOH1_on_short FPsw_UEGOH1_on_short /end REF_CHARACTERISTIC
/end GROUP
/begin GROUP UEGOH2_off_open_EC_Fault "UEGO2 heater open / ground short"
 /begin REF_CHARACTERISTIC FCdc4_UEGOH2_off_open FCdtc_UEGOH2_off_open FCfmi_UEGOH2_off_open FCftb_UEGOH2_off_open FCspn_UEGOH2_off_open FPfl_UEGOH2_off_open FPfu_UEGOH2_off_open FPnd_UEGOH2_off_open FPsvr_UEGOH2_off_open FPsw_ext1_UEGOH2_off_open FPsw_UEGOH2_off_open /end REF_CHARACTERISTIC
/end GROUP
/begin GROUP UEGOH2_on_short_EC_Fault "UEGO2 heater short to power"
 /begin REF_CHARACTERISTIC FCdc4_UEGOH2_on_short FCdtc_UEGOH2_on_short FCfmi_UEGOH2_on_short FCftb_UEGOH2_on_short FCspn_UEGOH2_on_short FPfl_UEGOH2_on_short FPfu_UEGOH2_on_short FPnd_UEGOH2_on_short FPsvr_UEGOH2_on_short FPsw_ext1_UEGOH2_on_short FPsw_UEGOH2_on_short /end REF_CHARACTERISTIC
/end GROUP
/begin GROUP UEGOH3_off_open_EC_Fault "UEGO3 heater open / ground short"
 /begin REF_CHARACTERISTIC FCdc4_UEGOH3_off_open FCdtc_UEGOH3_off_open FCfmi_UEGOH3_off_open FCftb_UEGOH3_off_open FCspn_UEGOH3_off_open FPfl_UEGOH3_off_open FPfu_UEGOH3_off_open FPnd_UEGOH3_off_open FPsvr_UEGOH3_off_open FPsw_ext1_UEGOH3_off_open FPsw_UEGOH3_off_open /end REF_CHARACTERISTIC
/end GROUP
/begin GROUP UEGOH3_on_short_EC_Fault "UEGO3 heater short to power"
 /begin REF_CHARACTERISTIC FCdc4_UEGOH3_on_short FCdtc_UEGOH3_on_short FCfmi_UEGOH3_on_short FCftb_UEGOH3_on_short FCspn_UEGOH3_on_short FPfl_UEGOH3_on_short FPfu_UEGOH3_on_short FPnd_UEGOH3_on_short FPsvr_UEGOH3_on_short FPsw_ext1_UEGOH3_on_short FPsw_UEGOH3_on_short /end REF_CHARACTERISTIC
/end GROUP
/begin GROUP UEGOH4_off_open_EC_Fault "UEGO4 heater open / ground short"
 /begin REF_CHARACTERISTIC FCdc4_UEGOH4_off_open FCdtc_UEGOH4_off_open FCfmi_UEGOH4_off_open FCftb_UEGOH4_off_open FCspn_UEGOH4_off_open FPfl_UEGOH4_off_open FPfu_UEGOH4_off_open FPnd_UEGOH4_off_open FPsvr_UEGOH4_off_open FPsw_ext1_UEGOH4_off_open FPsw_UEGOH4_off_open /end REF_CHARACTERISTIC
/end GROUP
/begin GROUP UEGOH4_on_short_EC_Fault "UEGO4 heater short to power"
 /begin REF_CHARACTERISTIC FCdc4_UEGOH4_on_short FCdtc_UEGOH4_on_short FCfmi_UEGOH4_on_short FCftb_UEGOH4_on_short FCspn_UEGOH4_on_short FPfl_UEGOH4_on_short FPfu_UEGOH4_on_short FPnd_UEGOH4_on_short FPsvr_UEGOH4_on_short FPsw_ext1_UEGOH4_on_short FPsw_UEGOH4_on_short /end REF_CHARACTERISTIC
/end GROUP
/begin GROUP UGF_Hv_hi_EC_Fault "UEGO1 heater supply high voltage"
 /begin REF_CHARACTERISTIC FCdc4_UGF_Hv_hi FCdtc_UGF_Hv_hi FCfmi_UGF_Hv_hi FCftb_UGF_Hv_hi FCspn_UGF_Hv_hi FPfl_UGF_Hv_hi FPfu_UGF_Hv_hi FPnd_UGF_Hv_hi FPsvr_UGF_Hv_hi FPsw_ext1_UGF_Hv_hi FPsw_UGF_Hv_hi /end REF_CHARACTERISTIC
/end GROUP
/begin GROUP UGF_internal_EC_Fault "UEGO1 internal processor fault"
 /begin REF_CHARACTERISTIC FCdc4_UGF_internal FCdtc_UGF_internal FCfmi_UGF_internal FCftb_UGF_internal FCspn_UGF_internal FPfl_UGF_internal FPfu_UGF_internal FPnd_UGF_internal FPsvr_UGF_internal FPsw_ext1_UGF_internal FPsw_UGF_internal /end REF_CHARACTERISTIC
/end GROUP
/begin GROUP UGF_lowsupply_EC_Fault "UEGO1 internal supply voltage low"
 /begin REF_CHARACTERISTIC FCdc4_UGF_lowsupply FCdtc_UGF_lowsupply FCfmi_UGF_lowsupply FCftb_UGF_lowsupply FCspn_UGF_lowsupply FPfl_UGF_lowsupply FPfu_UGF_lowsupply FPnd_UGF_lowsupply FPsvr_UGF_lowsupply FPsw_ext1_UGF_lowsupply FPsw_UGF_lowsupply /end REF_CHARACTERISTIC
/end GROUP
/begin GROUP UGF1_comm_lost_EC_Fault "UEGO1 CAN sensor communication lost"
 /begin REF_CHARACTERISTIC FCdc4_UGF1_comm_lost FCdtc_UGF1_comm_lost FCfmi_UGF1_comm_lost FCftb_UGF1_comm_lost FCspn_UGF1_comm_lost FPfl_UGF1_comm_lost FPfu_UGF1_comm_lost FPnd_UGF1_comm_lost FPsvr_UGF1_comm_lost FPsw_ext1_UGF1_comm_lost FPsw_UGF1_comm_lost /end REF_CHARACTERISTIC
/end GROUP
/begin GROUP UGF1_drifttl2_EC_Fault "UEGO1 drift is out-of-tolerance - level 2"
 /begin REF_CHARACTERISTIC FCdc4_UGF1_drifttl2 FCdtc_UGF1_drifttl2 FCfmi_UGF1_drifttl2 FCftb_UGF1_drifttl2 FCspn_UGF1_drifttl2 FPfl_UGF1_drifttl2 FPfu_UGF1_drifttl2 FPnd_UGF1_drifttl2 FPsvr_UGF1_drifttl2 FPsw_ext1_UGF1_drifttl2 FPsw_UGF1_drifttl2 /end REF_CHARACTERISTIC
/end GROUP
/begin GROUP UGF1_drifttol_EC_Fault "UEGO1 drift is out-of-tolerance"
 /begin REF_CHARACTERISTIC FCdc4_UGF1_drifttol FCdtc_UGF1_drifttol FCfmi_UGF1_drifttol FCftb_UGF1_drifttol FCspn_UGF1_drifttol FPfl_UGF1_drifttol FPfu_UGF1_drifttol FPnd_UGF1_drifttol FPsvr_UGF1_drifttol FPsw_ext1_UGF1_drifttol FPsw_UGF1_drifttol /end REF_CHARACTERISTIC
/end GROUP
/begin GROUP UGF1_R_hi_EC_Fault "UEGO1 cal resistor voltage high"
 /begin REF_CHARACTERISTIC FCdc4_UGF1_R_hi FCdtc_UGF1_R_hi FCfmi_UGF1_R_hi FCftb_UGF1_R_hi FCspn_UGF1_R_hi FPfl_UGF1_R_hi FPfu_UGF1_R_hi FPnd_UGF1_R_hi FPsvr_UGF1_R_hi FPsw_ext1_UGF1_R_hi FPsw_UGF1_R_hi /end REF_CHARACTERISTIC
/end GROUP
/begin GROUP UGF1_SR_hi_EC_Fault "UEGO1 sense cell impedance high"
 /begin REF_CHARACTERISTIC FCdc4_UGF1_SR_hi FCdtc_UGF1_SR_hi FCfmi_UGF1_SR_hi FCftb_UGF1_SR_hi FCspn_UGF1_SR_hi FPfl_UGF1_SR_hi FPfu_UGF1_SR_hi FPnd_UGF1_SR_hi FPsvr_UGF1_SR_hi FPsw_ext1_UGF1_SR_hi FPsw_UGF1_SR_hi /end REF_CHARACTERISTIC
/end GROUP
/begin GROUP UGF1_SR_slow_EC_Fault "UEGO1 sense cell slow to warm up"
 /begin REF_CHARACTERISTIC FCdc4_UGF1_SR_slow FCdtc_UGF1_SR_slow FCfmi_UGF1_SR_slow FCftb_UGF1_SR_slow FCspn_UGF1_SR_slow FPfl_UGF1_SR_slow FPfu_UGF1_SR_slow FPnd_UGF1_SR_slow FPsvr_UGF1_SR_slow FPsw_ext1_UGF1_SR_slow FPsw_UGF1_SR_slow /end REF_CHARACTERISTIC
/end GROUP
/begin GROUP UGF1_Sv_hi_EC_Fault "UEGO1 sense cell voltage high"
 /begin REF_CHARACTERISTIC FCdc4_UGF1_Sv_hi FCdtc_UGF1_Sv_hi FCfmi_UGF1_Sv_hi FCftb_UGF1_Sv_hi FCspn_UGF1_Sv_hi FPfl_UGF1_Sv_hi FPfu_UGF1_Sv_hi FPnd_UGF1_Sv_hi FPsvr_UGF1_Sv_hi FPsw_ext1_UGF1_Sv_hi FPsw_UGF1_Sv_hi /end REF_CHARACTERISTIC
/end GROUP
/begin GROUP UGF2_comm_lost_EC_Fault "UEGO2 CAN sensor communication lost"
 /begin REF_CHARACTERISTIC FCdc4_UGF2_comm_lost FCdtc_UGF2_comm_lost FCfmi_UGF2_comm_lost FCftb_UGF2_comm_lost FCspn_UGF2_comm_lost FPfl_UGF2_comm_lost FPfu_UGF2_comm_lost FPnd_UGF2_comm_lost FPsvr_UGF2_comm_lost FPsw_ext1_UGF2_comm_lost FPsw_UGF2_comm_lost /end REF_CHARACTERISTIC
/end GROUP
/begin GROUP UGF2_drifttl2_EC_Fault "UEGO2 drift is out-of-tolerance - level 2"
 /begin REF_CHARACTERISTIC FCdc4_UGF2_drifttl2 FCdtc_UGF2_drifttl2 FCfmi_UGF2_drifttl2 FCftb_UGF2_drifttl2 FCspn_UGF2_drifttl2 FPfl_UGF2_drifttl2 FPfu_UGF2_drifttl2 FPnd_UGF2_drifttl2 FPsvr_UGF2_drifttl2 FPsw_ext1_UGF2_drifttl2 FPsw_UGF2_drifttl2 /end REF_CHARACTERISTIC
/end GROUP
/begin GROUP UGF2_drifttol_EC_Fault "UEGO2 drift is out-of-tolerance"
 /begin REF_CHARACTERISTIC FCdc4_UGF2_drifttol FCdtc_UGF2_drifttol FCfmi_UGF2_drifttol FCftb_UGF2_drifttol FCspn_UGF2_drifttol FPfl_UGF2_drifttol FPfu_UGF2_drifttol FPnd_UGF2_drifttol FPsvr_UGF2_drifttol FPsw_ext1_UGF2_drifttol FPsw_UGF2_drifttol /end REF_CHARACTERISTIC
/end GROUP
/begin GROUP UGF2_Hv_hi_EC_Fault "UEGO2 heater supply high voltage"
 /begin REF_CHARACTERISTIC FCdc4_UGF2_Hv_hi FCdtc_UGF2_Hv_hi FCfmi_UGF2_Hv_hi FCftb_UGF2_Hv_hi FCspn_UGF2_Hv_hi FPfl_UGF2_Hv_hi FPfu_UGF2_Hv_hi FPnd_UGF2_Hv_hi FPsvr_UGF2_Hv_hi FPsw_ext1_UGF2_Hv_hi FPsw_UGF2_Hv_hi /end REF_CHARACTERISTIC
/end GROUP
/begin GROUP UGF2_internal_EC_Fault "UEGO2 internal processor fault"
 /begin REF_CHARACTERISTIC FCdc4_UGF2_internal FCdtc_UGF2_internal FCfmi_UGF2_internal FCftb_UGF2_internal FCspn_UGF2_internal FPfl_UGF2_internal FPfu_UGF2_internal FPnd_UGF2_internal FPsvr_UGF2_internal FPsw_ext1_UGF2_internal FPsw_UGF2_internal /end REF_CHARACTERISTIC
/end GROUP
/begin GROUP UGF2_lowsupply_EC_Fault "UEGO2 internal supply voltage low"
 /begin REF_CHARACTERISTIC FCdc4_UGF2_lowsupply FCdtc_UGF2_lowsupply FCfmi_UGF2_lowsupply FCftb_UGF2_lowsupply FCspn_UGF2_lowsupply FPfl_UGF2_lowsupply FPfu_UGF2_lowsupply FPnd_UGF2_lowsupply FPsvr_UGF2_lowsupply FPsw_ext1_UGF2_lowsupply FPsw_UGF2_lowsupply /end REF_CHARACTERISTIC
/end GROUP
/begin GROUP UGF2_R_hi_EC_Fault "UEGO2 cal resistor voltage high"
 /begin REF_CHARACTERISTIC FCdc4_UGF2_R_hi FCdtc_UGF2_R_hi FCfmi_UGF2_R_hi FCftb_UGF2_R_hi FCspn_UGF2_R_hi FPfl_UGF2_R_hi FPfu_UGF2_R_hi FPnd_UGF2_R_hi FPsvr_UGF2_R_hi FPsw_ext1_UGF2_R_hi FPsw_UGF2_R_hi /end REF_CHARACTERISTIC
/end GROUP
/begin GROUP UGF2_SR_hi_EC_Fault "UEGO2 sense cell impedance high"
 /begin REF_CHARACTERISTIC FCdc4_UGF2_SR_hi FCdtc_UGF2_SR_hi FCfmi_UGF2_SR_hi FCftb_UGF2_SR_hi FCspn_UGF2_SR_hi FPfl_UGF2_SR_hi FPfu_UGF2_SR_hi FPnd_UGF2_SR_hi FPsvr_UGF2_SR_hi FPsw_ext1_UGF2_SR_hi FPsw_UGF2_SR_hi /end REF_CHARACTERISTIC
/end GROUP
/begin GROUP UGF2_SR_slow_EC_Fault "UEGO2 sense cell slow to warm up"
 /begin REF_CHARACTERISTIC FCdc4_UGF2_SR_slow FCdtc_UGF2_SR_slow FCfmi_UGF2_SR_slow FCftb_UGF2_SR_slow FCspn_UGF2_SR_slow FPfl_UGF2_SR_slow FPfu_UGF2_SR_slow FPnd_UGF2_SR_slow FPsvr_UGF2_SR_slow FPsw_ext1_UGF2_SR_slow FPsw_UGF2_SR_slow /end REF_CHARACTERISTIC
/end GROUP
/begin GROUP UGF2_Sv_hi_EC_Fault "UEGO2 sense cell voltage high"
 /begin REF_CHARACTERISTIC FCdc4_UGF2_Sv_hi FCdtc_UGF2_Sv_hi FCfmi_UGF2_Sv_hi FCftb_UGF2_Sv_hi FCspn_UGF2_Sv_hi FPfl_UGF2_Sv_hi FPfu_UGF2_Sv_hi FPnd_UGF2_Sv_hi FPsvr_UGF2_Sv_hi FPsw_ext1_UGF2_Sv_hi FPsw_UGF2_Sv_hi /end REF_CHARACTERISTIC
/end GROUP
/begin GROUP UGF3_comm_lost_EC_Fault "UEGO3 CAN sensor communication lost"
 /begin REF_CHARACTERISTIC FCdc4_UGF3_comm_lost FCdtc_UGF3_comm_lost FCfmi_UGF3_comm_lost FCftb_UGF3_comm_lost FCspn_UGF3_comm_lost FPfl_UGF3_comm_lost FPfu_UGF3_comm_lost FPnd_UGF3_comm_lost FPsvr_UGF3_comm_lost FPsw_ext1_UGF3_comm_lost FPsw_UGF3_comm_lost /end REF_CHARACTERISTIC
/end GROUP
/begin GROUP UGF3_drifttl2_EC_Fault "UEGO3 drift is out-of-tolerance - level 2"
 /begin REF_CHARACTERISTIC FCdc4_UGF3_drifttl2 FCdtc_UGF3_drifttl2 FCfmi_UGF3_drifttl2 FCftb_UGF3_drifttl2 FCspn_UGF3_drifttl2 FPfl_UGF3_drifttl2 FPfu_UGF3_drifttl2 FPnd_UGF3_drifttl2 FPsvr_UGF3_drifttl2 FPsw_ext1_UGF3_drifttl2 FPsw_UGF3_drifttl2 /end REF_CHARACTERISTIC
/end GROUP
/begin GROUP UGF3_drifttol_EC_Fault "UEGO3 drift is out-of-tolerance"
 /begin REF_CHARACTERISTIC FCdc4_UGF3_drifttol FCdtc_UGF3_drifttol FCfmi_UGF3_drifttol FCftb_UGF3_drifttol FCspn_UGF3_drifttol FPfl_UGF3_drifttol FPfu_UGF3_drifttol FPnd_UGF3_drifttol FPsvr_UGF3_drifttol FPsw_ext1_UGF3_drifttol FPsw_UGF3_drifttol /end REF_CHARACTERISTIC
/end GROUP
/begin GROUP UGF3_Hv_hi_EC_Fault "UEGO3 heater supply high voltage"
 /begin REF_CHARACTERISTIC FCdc4_UGF3_Hv_hi FCdtc_UGF3_Hv_hi FCfmi_UGF3_Hv_hi FCftb_UGF3_Hv_hi FCspn_UGF3_Hv_hi FPfl_UGF3_Hv_hi FPfu_UGF3_Hv_hi FPnd_UGF3_Hv_hi FPsvr_UGF3_Hv_hi FPsw_ext1_UGF3_Hv_hi FPsw_UGF3_Hv_hi /end REF_CHARACTERISTIC
/end GROUP
/begin GROUP UGF3_internal_EC_Fault "UEGO3 internal processor fault"
 /begin REF_CHARACTERISTIC FCdc4_UGF3_internal FCdtc_UGF3_internal FCfmi_UGF3_internal FCftb_UGF3_internal FCspn_UGF3_internal FPfl_UGF3_internal FPfu_UGF3_internal FPnd_UGF3_internal FPsvr_UGF3_internal FPsw_ext1_UGF3_internal FPsw_UGF3_internal /end REF_CHARACTERISTIC
/end GROUP
/begin GROUP UGF3_lowsupply_EC_Fault "UEGO3 internal supply voltage low"
 /begin REF_CHARACTERISTIC FCdc4_UGF3_lowsupply FCdtc_UGF3_lowsupply FCfmi_UGF3_lowsupply FCftb_UGF3_lowsupply FCspn_UGF3_lowsupply FPfl_UGF3_lowsupply FPfu_UGF3_lowsupply FPnd_UGF3_lowsupply FPsvr_UGF3_lowsupply FPsw_ext1_UGF3_lowsupply FPsw_UGF3_lowsupply /end REF_CHARACTERISTIC
/end GROUP
/begin GROUP UGF3_R_hi_EC_Fault "UEGO3 cal resistor voltage high"
 /begin REF_CHARACTERISTIC FCdc4_UGF3_R_hi FCdtc_UGF3_R_hi FCfmi_UGF3_R_hi FCftb_UGF3_R_hi FCspn_UGF3_R_hi FPfl_UGF3_R_hi FPfu_UGF3_R_hi FPnd_UGF3_R_hi FPsvr_UGF3_R_hi FPsw_ext1_UGF3_R_hi FPsw_UGF3_R_hi /end REF_CHARACTERISTIC
/end GROUP
/begin GROUP UGF3_SR_hi_EC_Fault "UEGO3 sense cell impedance high"
 /begin REF_CHARACTERISTIC FCdc4_UGF3_SR_hi FCdtc_UGF3_SR_hi FCfmi_UGF3_SR_hi FCftb_UGF3_SR_hi FCspn_UGF3_SR_hi FPfl_UGF3_SR_hi FPfu_UGF3_SR_hi FPnd_UGF3_SR_hi FPsvr_UGF3_SR_hi FPsw_ext1_UGF3_SR_hi FPsw_UGF3_SR_hi /end REF_CHARACTERISTIC
/end GROUP
/begin GROUP UGF3_SR_slow_EC_Fault "UEGO3 sense cell slow to warm up"
 /begin REF_CHARACTERISTIC FCdc4_UGF3_SR_slow FCdtc_UGF3_SR_slow FCfmi_UGF3_SR_slow FCftb_UGF3_SR_slow FCspn_UGF3_SR_slow FPfl_UGF3_SR_slow FPfu_UGF3_SR_slow FPnd_UGF3_SR_slow FPsvr_UGF3_SR_slow FPsw_ext1_UGF3_SR_slow FPsw_UGF3_SR_slow /end REF_CHARACTERISTIC
/end GROUP
/begin GROUP UGF3_Sv_hi_EC_Fault "UEGO3 sense cell voltage high"
 /begin REF_CHARACTERISTIC FCdc4_UGF3_Sv_hi FCdtc_UGF3_Sv_hi FCfmi_UGF3_Sv_hi FCftb_UGF3_Sv_hi FCspn_UGF3_Sv_hi FPfl_UGF3_Sv_hi FPfu_UGF3_Sv_hi FPnd_UGF3_Sv_hi FPsvr_UGF3_Sv_hi FPsw_ext1_UGF3_Sv_hi FPsw_UGF3_Sv_hi /end REF_CHARACTERISTIC
/end GROUP
/begin GROUP UGF4_comm_lost_EC_Fault "UEGO4 CAN sensor communication lost"
 /begin REF_CHARACTERISTIC FCdc4_UGF4_comm_lost FCdtc_UGF4_comm_lost FCfmi_UGF4_comm_lost FCftb_UGF4_comm_lost FCspn_UGF4_comm_lost FPfl_UGF4_comm_lost FPfu_UGF4_comm_lost FPnd_UGF4_comm_lost FPsvr_UGF4_comm_lost FPsw_ext1_UGF4_comm_lost FPsw_UGF4_comm_lost /end REF_CHARACTERISTIC
/end GROUP
/end MODULE
/end PROJECT
