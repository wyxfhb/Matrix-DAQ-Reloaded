ASAP2_VERSION 1 61
/begin PROJECT Econtrols_4G "4G Test"
/begin HEADER "4G A2L Configuration" PROJECT_NO EControls4G /* config for version control */ VERSION "$Revision: 82130 $:" /* config for version control */ /end HEADER
/begin MODULE EControls_4G_SH2A "EControls 4G"
/begin MOD_COMMON "" DEPOSIT ABSOLUTE BYTE_ORDER MSB_FIRST /end MOD_COMMON
/* Define the Record Layouts */
/begin RECORD_LAYOUT ECIPP_ALIGNMENT_UBYTE FNC_VALUES 1 UBYTE COLUMN_DIR DIRECT /end RECORD_LAYOUT
/begin RECORD_LAYOUT ECIPP_ALIGNMENT_UWORD FNC_VALUES 1 UWORD COLUMN_DIR DIRECT /end RECORD_LAYOUT
/begin RECORD_LAYOUT ECIPP_ALIGNMENT_SWORD FNC_VALUES 1 SWORD COLUMN_DIR DIRECT /end RECORD_LAYOUT
/begin RECORD_LAYOUT ECIPP_Lookup_SWORD AXIS_PTS_X 1 SWORD INDEX_INCR DIRECT /end RECORD_LAYOUT
/begin RECORD_LAYOUT ECIPP_ALIGNMENT_ULONG FNC_VALUES 1 ULONG COLUMN_DIR DIRECT /end RECORD_LAYOUT
/begin RECORD_LAYOUT ECIPP_ALIGNMENT_FLOAT32_IEEE FNC_VALUES 1 FLOAT32_IEEE COLUMN_DIR DIRECT /end RECORD_LAYOUT
/begin RECORD_LAYOUT ECIPP_Lookup_FLOAT32_IEEE AXIS_PTS_X 1 FLOAT32_IEEE INDEX_INCR DIRECT /end RECORD_LAYOUT
/begin MEASUREMENT OCT_adapt "Current octane rating" UWORD Compu_OCT_adapt 0 0 0 99.9984741210938 ECU_ADDRESS 0x01002B48 /end MEASUREMENT
/begin COMPU_METHOD Compu_OCT_adapt " " RAT_FUNC "%.1" "%" COEFFS 0 655.36 0 0 0 1 /end COMPU_METHOD
/begin CHARACTERISTIC OilP_loP "Oil pressure sender low-presure (Fault Condition:Stage 2: oil pressure <)" VALUE 0x0014767e /* @ECU_Address@OilP_loP@0x01002BC8@ */ ECIPP_ALIGNMENT_UWORD 256 Compu_OilP_loP 0 255.99609375 /end CHARACTERISTIC
/begin COMPU_METHOD Compu_OilP_loP " " RAT_FUNC "%.1" "psig" COEFFS 0 256 0 0 0 1 /end COMPU_METHOD
/begin CHARACTERISTIC OilP_hiP "Oil pressure sender high-presure (Fault Condition:Oil pressure >)" VALUE 0x0014767a /* @ECU_Address@OilP_hiP@0x01002BD0@ */ ECIPP_ALIGNMENT_UWORD 256 Compu_OilP_hiP 0 255.99609375 /end CHARACTERISTIC
/begin COMPU_METHOD Compu_OilP_hiP " " RAT_FUNC "%.1" "psig" COEFFS 0 256 0 0 0 1 /end COMPU_METHOD
/begin CHARACTERISTIC OilP_loP2 "Oil pressure sender low-presure (Fault Condition:Stage 2: oil pressure <)" VALUE 0x00147680 /* @ECU_Address@OilP_loP2@0x01005A20@ */ ECIPP_ALIGNMENT_UWORD 256 Compu_OilP_loP2 0 255.99609375 /end CHARACTERISTIC
/begin COMPU_METHOD Compu_OilP_loP2 " " RAT_FUNC "%.1" "psig" COEFFS 0 256 0 0 0 1 /end COMPU_METHOD
/begin CHARACTERISTIC OilP_loRPM "Oil pressure low engine speed (Fault Condition:For RPM > lower limit AND RPM <=)" VALUE 0x00147682 /* @ECU_Address@OilP_loRPM@0x01005A28@ */ ECIPP_ALIGNMENT_UWORD 65535 Compu_OilP_loRPM 0 65535 /end CHARACTERISTIC
/begin COMPU_METHOD Compu_OilP_loRPM " " RAT_FUNC "%.0" "rpm" COEFFS 0 1 0 0 0 1 /end COMPU_METHOD
/begin CHARACTERISTIC OilP_loRPM2 "Oil pressure low engine speed (Fault Condition:For RPM >=)" VALUE 0x00147684 /* @ECU_Address@OilP_loRPM2@0x01005A30@ */ ECIPP_ALIGNMENT_UWORD 65535 Compu_OilP_loRPM2 0 65535 /end CHARACTERISTIC
/begin COMPU_METHOD Compu_OilP_loRPM2 " " RAT_FUNC "%.0" "rpm" COEFFS 0 1 0 0 0 1 /end COMPU_METHOD
/begin CHARACTERISTIC ECT_CL_ena "Closed loop enable ECT" VALUE 0x0014679a /* @ECU_Address@ECT_CL_ena@0x01006010@ */ ECIPP_ALIGNMENT_UWORD 564 Compu_ECT_CL_ena -460 563.984375 /end CHARACTERISTIC
/begin COMPU_METHOD Compu_ECT_CL_ena " " RAT_FUNC "%.1" "deg F" COEFFS 0 64 29440 0 0 1 /end COMPU_METHOD
/begin CHARACTERISTIC OilP_maxV "Oil pressure sensor maximum voltage (Fault Condition:Oil presure sensor voltage >)" VALUE 0x00147686 /* @ECU_Address@OilP_maxV@0x01006230@ */ ECIPP_ALIGNMENT_UWORD 5 Compu_OilP_maxV 0 5.00114468864469 /end CHARACTERISTIC
/begin COMPU_METHOD Compu_OilP_maxV " " RAT_FUNC "%.3" "volts" COEFFS 0 13104 0 0 0 1 /end COMPU_METHOD
/begin CHARACTERISTIC OilP_minV "Oil pressure sensor minimum voltage (Fault Condition:Oil pressure sensor voltage <)" VALUE 0x00147688 /* @ECU_Address@OilP_minV@0x01006238@ */ ECIPP_ALIGNMENT_UWORD 5 Compu_OilP_minV 0 5.00114468864469 /end CHARACTERISTIC
/begin COMPU_METHOD Compu_OilP_minV " " RAT_FUNC "%.3" "volts" COEFFS 0 13104 0 0 0 1 /end COMPU_METHOD
/begin CHARACTERISTIC OilP2_loP "Oil pressure sender low-pressure 1 stage 2 (Fault Condition:Stage 1: oil pressure <)" VALUE 0x00147676 /* @ECU_Address@OilP2_loP@0x01006858@ */ ECIPP_ALIGNMENT_UWORD 256 Compu_OilP2_loP 0 255.99609375 /end CHARACTERISTIC
/begin COMPU_METHOD Compu_OilP2_loP " " RAT_FUNC "%.1" "psig" COEFFS 0 256 0 0 0 1 /end COMPU_METHOD
/begin CHARACTERISTIC OilP2_loP2 "Oil pressure sender low-pressure 2 stage 2 (Fault Condition:Stage 1: oil pressure <)" VALUE 0x00147678 /* @ECU_Address@OilP2_loP2@0x01006860@ */ ECIPP_ALIGNMENT_UWORD 256 Compu_OilP2_loP2 0 255.99609375 /end CHARACTERISTIC
/begin COMPU_METHOD Compu_OilP2_loP2 " " RAT_FUNC "%.1" "psig" COEFFS 0 256 0 0 0 1 /end COMPU_METHOD
/begin CHARACTERISTIC LowOperTemp_ECT "Operating ECT threshold (Fault Condition:ECT >=)" VALUE 0x00147586 /* @ECU_Address@LowOperTemp_ECT@0x01008188@ */ ECIPP_ALIGNMENT_UWORD 564 Compu_LowOperTemp_ECT -460 563.984375 /end CHARACTERISTIC
/begin COMPU_METHOD Compu_LowOperTemp_ECT " " RAT_FUNC "%.1" "deg F" COEFFS 0 64 29440 0 0 1 /end COMPU_METHOD
/begin CHARACTERISTIC EGR_clr_dP_C "EGR cooler flow rate delta-P scaling" VALUE 0x0014006c /* @ECU_Address@EGR_clr_dP_C@0x01009278@ */ ECIPP_ALIGNMENT_FLOAT32_IEEE 10000000000 Compu_EGR_clr_dP_C -10000000000 10000000000 /end CHARACTERISTIC
/begin COMPU_METHOD Compu_EGR_clr_dP_C " " RAT_FUNC "%.1" "upsig * s^2 / g / L" COEFFS 0 0.000001 0 0 0 1 /end COMPU_METHOD
/begin MEASUREMENT EGRdP "EGR delta-P" SWORD Compu_EGRdP 0 0 -32 31.9990234375 ECU_ADDRESS 0x010092E8 /end MEASUREMENT
/begin COMPU_METHOD Compu_EGRdP " " RAT_FUNC "%.3" "psig" COEFFS 0 1024 0 0 0 1 /end COMPU_METHOD
/begin MEASUREMENT EGRT "EGRT" UWORD Compu_EGRT 0 0 -460 7731.875 ECU_ADDRESS 0x01009328 /end MEASUREMENT
/begin COMPU_METHOD Compu_EGRT " " RAT_FUNC "%.1" "deg F" COEFFS 0 8 3680 0 0 1 /end COMPU_METHOD
/begin CHARACTERISTIC EGRT_ena "EGRT source{EGRT_ena&0xff=0:Disabled}{EGRT_ena&0xff=1:Aux PU1}{EGRT_ena&0xff=2:Aux PU2}{EGRT_ena&0xff=3:Aux PU3}{EGRT_ena&0xff=4:Aux PUD1}{EGRT_ena&0xff=5:Aux PUD2}{EGRT_ena&0xff=6:Aux PUD3}{EGRT_ena&0xff=7:EGT Input}{EGRT_ena&0xff=8:Aux PUD4}{EGRT_ena&0x" VALUE 0x001409a8 /* @ECU_Address@EGRT_ena@0x010093B0@ */ ECIPP_ALIGNMENT_UBYTE 255 EGRT_ena_COMPU_VTAB 0 255 BIT_MASK 0xff /end CHARACTERISTIC
/begin COMPU_METHOD EGRT_ena_COMPU_VTAB "Verbal Table" TAB_VERB "%.0" "list" COMPU_TAB_REF EGRT_ena_COMPU_VTAB_REF /end COMPU_METHOD
/begin COMPU_VTAB EGRT_ena_COMPU_VTAB_REF "Verbal Table" TAB_VERB 31 0 "Disabled" 1 "Aux PU1" 2 "Aux PU2" 3 "Aux PU3" 4 "Aux PUD1" 5 "Aux PUD2" 6 "Aux PUD3" 7 "EGT Input" 8 "Aux PUD4" 9 "Aux PUD5" 10 "Aux PUD6" 11 "Aux PUD7" 12 "Aux PUD8" 13 "Aux PUD9" 14 "Aux PUD10" 15 "Aux PUD11" 16 "Aux PUD12" 17 "Aux PUD13" 18 "Aux PUD14" 19 "Aux PUD15" 20 "Aux PUD16" 21 "Aux PUD17" 22 "Aux PUD18" 23 "Aux PUD19" 24 "Aux PUD20" 25 "Aux PUD21" 26 "Aux PUD22" 27 "Aux PUD23" 28 "Aux PUD24" 29 "Aux PUD25" 30 "CAN sourced" DEFAULT_VALUE "UNKNOWN" /end COMPU_VTAB
/begin CHARACTERISTIC EGRdP_ena "EGR delta-P sensor{EGRdP_ena&0xff=0:Disabled}{EGRdP_ena&0xff=1:Aux PD1}{EGRdP_ena&0xff=2:Aux PD2}{EGRdP_ena&0xff=3:Aux PD3}{EGRdP_ena&0xff=4:Aux PUD1}{EGRdP_ena&0xff=5:Aux PUD2}{EGRdP_ena&0xff=6:Aux PUD3}{EGRdP_ena&0xff=7:Aux PUD4}{EGRdP_ena&0xff=8:Aux PU" VALUE 0x001409b8 /* @ECU_Address@EGRdP_ena@0x01009410@ */ ECIPP_ALIGNMENT_UBYTE 255 EGRdP_ena_COMPU_VTAB 0 255 BIT_MASK 0xff /end CHARACTERISTIC
/begin COMPU_METHOD EGRdP_ena_COMPU_VTAB "Verbal Table" TAB_VERB "%.0" "list" COMPU_TAB_REF EGRdP_ena_COMPU_VTAB_REF /end COMPU_METHOD
/begin COMPU_VTAB EGRdP_ena_COMPU_VTAB_REF "Verbal Table" TAB_VERB 31 0 "Disabled" 1 "Aux PD1" 2 "Aux PD2" 3 "Aux PD3" 4 "Aux PUD1" 5 "Aux PUD2" 6 "Aux PUD3" 7 "Aux PUD4" 8 "Aux PUD5" 9 "Aux PUD6" 10 "Aux PUD7" 11 "Aux PUD8" 12 "Aux PUD9" 13 "Aux PUD10" 14 "Aux PUD11" 15 "Aux PUD12" 16 "Aux PUD13" 17 "Aux PUD14" 18 "Aux PUD15" 19 "CAN sourced" 20 "FPP2 Input" 21 "Aux PUD16" 22 "Aux PUD17" 23 "Aux PUD18" 24 "Aux PUD19" 25 "Aux PUD20" 26 "Aux PUD21" 27 "Aux PUD22" 28 "Aux PUD23" 29 "Aux PUD24" 30 "Aux PUD25" DEFAULT_VALUE "UNKNOWN" /end COMPU_VTAB
/begin CHARACTERISTIC EGR_channel "EGR output channel{EGR_channel&0xff=0:Disabled}{EGR_channel&0xff=1:H-bridge A}{EGR_channel&0xff=2:H-bridge B}{EGR_channel&0xff=3:Aux PWM1}{EGR_channel&0xff=4:Aux PWM2}{EGR_channel&0xff=5:Aux PWM3}{EGR_channel&0xff=6:Aux PWM4}{EGR_channel&0xff=7:Aux PWM5}{" VALUE 0x001409aa /* @ECU_Address@EGR_channel@0x01009420@ */ ECIPP_ALIGNMENT_UBYTE 255 EGR_channel_COMPU_VTAB 0 255 BIT_MASK 0xff /end CHARACTERISTIC
/begin COMPU_METHOD EGR_channel_COMPU_VTAB "Verbal Table" TAB_VERB "%.0" "list" COMPU_TAB_REF EGR_channel_COMPU_VTAB_REF /end COMPU_METHOD
/begin COMPU_VTAB EGR_channel_COMPU_VTAB_REF "Verbal Table" TAB_VERB 27 0 "Disabled" 1 "H-bridge A" 2 "H-bridge B" 3 "Aux PWM1" 4 "Aux PWM2" 5 "Aux PWM3" 6 "Aux PWM4" 7 "Aux PWM5" 8 "Aux PWM6" 9 "Aux PWM7" 10 "Aux PWM8" 11 "Aux PWM9" 12 "Aux PWM10" 13 "Aux PWM11" 14 "Aux PWM12" 15 "Aux PWM13" 16 "Aux PWM14" 17 "Aux PWM15" 18 "Aux PWM16" 19 "Aux PWM17" 20 "Aux PWM18" 21 "Aux PWM19" 22 "Aux PWM20" 23 "Aux PWM21" 24 "Aux PWM22" 25 "Aux PWM23" 26 "CAN based" DEFAULT_VALUE "UNKNOWN" /end COMPU_VTAB
/begin CHARACTERISTIC EGR_min_DC "EGR min position / DC" VALUE 0x001408de /* @ECU_Address@EGR_min_DC@0x01009430@ */ ECIPP_ALIGNMENT_UWORD 100 Compu_EGR_min_DC 0 99.9984741210938 /end CHARACTERISTIC
/begin COMPU_METHOD Compu_EGR_min_DC " " RAT_FUNC "%.1" "%" COEFFS 0 655.36 0 0 0 1 /end COMPU_METHOD
/begin CHARACTERISTIC EGR_max_DC "EGR max position / DC" VALUE 0x001408dc /* @ECU_Address@EGR_max_DC@0x01009438@ */ ECIPP_ALIGNMENT_UWORD 100 Compu_EGR_max_DC 0 99.9984741210938 /end CHARACTERISTIC
/begin COMPU_METHOD Compu_EGR_max_DC " " RAT_FUNC "%.1" "%" COEFFS 0 655.36 0 0 0 1 /end COMPU_METHOD
/begin MEASUREMENT m_d_pct_cmd "Diluent mass fraction cmd" UWORD Compu_m_d_pct_cmd 0 0 0 399.993896484375 ECU_ADDRESS 0x010098A0 /end MEASUREMENT
/begin COMPU_METHOD Compu_m_d_pct_cmd " " RAT_FUNC "%.1" "%" COEFFS 0 163.84 0 0 0 1 /end COMPU_METHOD
/begin MEASUREMENT EGR_vlv_cmd "EGR valve command" UWORD Compu_EGR_vlv_cmd 0 0 0 99.9984741210938 ECU_ADDRESS 0x01009FA8 /end MEASUREMENT
/begin COMPU_METHOD Compu_EGR_vlv_cmd " " RAT_FUNC "%.1" "%" COEFFS 0 655.36 0 0 0 1 /end COMPU_METHOD
/begin MEASUREMENT EGR_ctl_status "EGR control status{EGR_ctl_status&0xff=0:Disabled}{EGR_ctl_status&0xff=1:Inactive: run time}{EGR_ctl_status&0xff=2:Inactive: ECT low}{EGR_ctl_status&0xff=3:Inactive: ECT high}{EGR_ctl_status&0xff=4:Inactive: IAT low}{EGR_ctl_status&0xff=5:Inactive: IAT hi" UBYTE EGR_ctl_status_COMPU_VTAB 0 0 0 255 ECU_ADDRESS 0x0100A140 BIT_MASK 0xff /end MEASUREMENT
/begin COMPU_METHOD EGR_ctl_status_COMPU_VTAB "Verbal Table" TAB_VERB "%.0" "list" COMPU_TAB_REF EGR_ctl_status_COMPU_VTAB_REF /end COMPU_METHOD
/begin COMPU_VTAB EGR_ctl_status_COMPU_VTAB_REF "Verbal Table" TAB_VERB 7 0 "Disabled" 1 "Inactive: run time" 2 "Inactive: ECT low" 3 "Inactive: ECT high" 4 "Inactive: IAT low" 5 "Inactive: IAT high" 6 "Active" DEFAULT_VALUE "UNKNOWN" /end COMPU_VTAB
/begin MEASUREMENT EGR_vlv_act "EGR valve measured position" UWORD Compu_EGR_vlv_act 0 0 0 99.9984741210938 ECU_ADDRESS 0x0100A160 /end MEASUREMENT
/begin COMPU_METHOD Compu_EGR_vlv_act " " RAT_FUNC "%.1" "%" COEFFS 0 655.36 0 0 0 1 /end COMPU_METHOD
/begin CHARACTERISTIC EGRad_mdot_min "EGR CL adaptive min EGR flow" VALUE 0x00140908 /* @ECU_Address@EGRad_mdot_min@0x0100A180@ */ ECIPP_ALIGNMENT_UWORD 1024 Compu_EGRad_mdot_min 0 1023.984375 /end CHARACTERISTIC
/begin COMPU_METHOD Compu_EGRad_mdot_min " " RAT_FUNC "%.2" "g/sec" COEFFS 0 64 0 0 0 1 /end COMPU_METHOD
/begin CHARACTERISTIC EGRad_MAF_min "EGR CL adaptive min MAF flow" VALUE 0x001408f6 /* @ECU_Address@EGRad_MAF_min@0x0100A188@ */ ECIPP_ALIGNMENT_UWORD 1024 Compu_EGRad_MAF_min 0 1023.984375 /end CHARACTERISTIC
/begin COMPU_METHOD Compu_EGRad_MAF_min " " RAT_FUNC "%.2" "g/sec" COEFFS 0 64 0 0 0 1 /end COMPU_METHOD
/begin MEASUREMENT EGRLP_float "EGR valve outlet pressure" FLOAT32_IEEE Compu_EGRLP_float 0 0 -10000000000 10000000000 ECU_ADDRESS 0x0100A190 /end MEASUREMENT
/begin COMPU_METHOD Compu_EGRLP_float " " RAT_FUNC "%.2" "psia" COEFFS 0 1 0 0 0 1 /end COMPU_METHOD
/begin MEASUREMENT EGR_vlv_min_dP "EGR valve minimum delta-P" SWORD Compu_EGR_vlv_min_dP 0 0 -128 127.99609375 ECU_ADDRESS 0x0100A228 /end MEASUREMENT
/begin COMPU_METHOD Compu_EGR_vlv_min_dP " " RAT_FUNC "%.2" "psi" COEFFS 0 256 0 0 0 1 /end COMPU_METHOD
/begin MEASUREMENT EGR_vlv_act_dP "EGR valve actual delta-P" SWORD Compu_EGR_vlv_act_dP 0 0 -128 127.99609375 ECU_ADDRESS 0x0100A230 /end MEASUREMENT
/begin COMPU_METHOD Compu_EGR_vlv_act_dP " " RAT_FUNC "%.2" "psi" COEFFS 0 256 0 0 0 1 /end COMPU_METHOD
/begin MEASUREMENT manual_EGR_mode "Manual EGR mode{manual_EGR_mode&0xff=0:Inactive}{manual_EGR_mode&0xff=1:m_d_pct_cmd}{manual_EGR_mode&0xff=2:mdot_EGR_cmd (SS)}{manual_EGR_mode&0xff=3:MAF command (SS)}{manual_EGR_mode&0xff=4:EGR_vlv_pct (SS)}{manual_EGR_mode&0xff=5:Min/Nom Split}{manual_E" UBYTE manual_EGR_mode_COMPU_VTAB 0 0 0 255 ECU_ADDRESS 0x0100A2A8 BIT_MASK 0xff /end MEASUREMENT
/begin COMPU_METHOD manual_EGR_mode_COMPU_VTAB "Verbal Table" TAB_VERB "%.0" "list" COMPU_TAB_REF manual_EGR_mode_COMPU_VTAB_REF /end COMPU_METHOD
/begin COMPU_VTAB manual_EGR_mode_COMPU_VTAB_REF "Verbal Table" TAB_VERB 7 0 "Inactive" 1 "m_d_pct_cmd" 2 "mdot_EGR_cmd (SS)" 3 "MAF command (SS)" 4 "EGR_vlv_pct (SS)" 5 "Min/Nom Split" 6 "EGR_vlv_pct" DEFAULT_VALUE "UNKNOWN" /end COMPU_VTAB
/begin MEASUREMENT manual_EGR_cmd1 "Manual EGR command 1" FLOAT32_IEEE Compu_manual_EGR_cmd1 0 0 -10000000000 10000000000 ECU_ADDRESS 0x0100A2C0 /end MEASUREMENT
/begin COMPU_METHOD Compu_manual_EGR_cmd1 " " RAT_FUNC "%.2" "-" COEFFS 0 1 0 0 0 1 /end COMPU_METHOD
/begin MEASUREMENT DIL_pct_xval "DIL_pct_xval" FLOAT32_IEEE Compu_DIL_pct_xval 0 0 -10000000000 10000000000 ECU_ADDRESS 0x0100A2D8 /end MEASUREMENT
/begin COMPU_METHOD Compu_DIL_pct_xval " " RAT_FUNC "%.1" "-" COEFFS 0 1 0 0 0 1 /end COMPU_METHOD
/begin CHARACTERISTIC EGRHP_ena "EGR valve inlet pressure sensor{EGRHP_ena&0xff=0:Disabled}{EGRHP_ena&0xff=1:Aux PD1}{EGRHP_ena&0xff=2:Aux PD2}{EGRHP_ena&0xff=3:Aux PD3}{EGRHP_ena&0xff=4:Aux PUD1}{EGRHP_ena&0xff=5:Aux PUD2}{EGRHP_ena&0xff=6:Aux PUD3}{EGRHP_ena&0xff=7:Aux PUD4}{EGRHP_ena&" VALUE 0x001409a4 /* @ECU_Address@EGRHP_ena@0x0100BBA0@ */ ECIPP_ALIGNMENT_UBYTE 255 EGRHP_ena_COMPU_VTAB 0 255 BIT_MASK 0xff /end CHARACTERISTIC
/begin COMPU_METHOD EGRHP_ena_COMPU_VTAB "Verbal Table" TAB_VERB "%.0" "list" COMPU_TAB_REF EGRHP_ena_COMPU_VTAB_REF /end COMPU_METHOD
/begin COMPU_VTAB EGRHP_ena_COMPU_VTAB_REF "Verbal Table" TAB_VERB 31 0 "Disabled" 1 "Aux PD1" 2 "Aux PD2" 3 "Aux PD3" 4 "Aux PUD1" 5 "Aux PUD2" 6 "Aux PUD3" 7 "Aux PUD4" 8 "Aux PUD5" 9 "Aux PUD6" 10 "Aux PUD7" 11 "Aux PUD8" 12 "Aux PUD9" 13 "Aux PUD10" 14 "Aux PUD11" 15 "Aux PUD12" 16 "Aux PUD13" 17 "Aux PUD14" 18 "Aux PUD15" 19 "CAN sourced" 20 "FPP2 Input" 21 "Aux PUD16" 22 "Aux PUD17" 23 "Aux PUD18" 24 "Aux PUD19" 25 "Aux PUD20" 26 "Aux PUD21" 27 "Aux PUD22" 28 "Aux PUD23" 29 "Aux PUD24" 30 "Aux PUD25" DEFAULT_VALUE "UNKNOWN" /end COMPU_VTAB
/begin CHARACTERISTIC EGR_vent_location "EGR venturi location{EGR_vent_location&0xff=0:None}{EGR_vent_location&0xff=1:Pre-valve}" VALUE 0x001409b2 /* @ECU_Address@EGR_vent_location@0x0100BBD0@ */ ECIPP_ALIGNMENT_UBYTE 255 EGR_vent_location_COMPU_VTAB 0 255 BIT_MASK 0xff /end CHARACTERISTIC
/begin COMPU_METHOD EGR_vent_location_COMPU_VTAB "Verbal Table" TAB_VERB "%.0" "list" COMPU_TAB_REF EGR_vent_location_COMPU_VTAB_REF /end COMPU_METHOD
/begin COMPU_VTAB EGR_vent_location_COMPU_VTAB_REF "Verbal Table" TAB_VERB 2 0 "None" 1 "Pre-valve" DEFAULT_VALUE "UNKNOWN" /end COMPU_VTAB
/begin CHARACTERISTIC EGR_vent_CdA "EGR venturi effective area" VALUE 0x001408f2 /* @ECU_Address@EGR_vent_CdA@0x0100BBD8@ */ ECIPP_ALIGNMENT_UWORD 4 Compu_EGR_vent_CdA 0 3.99993896484375 /end CHARACTERISTIC
/begin COMPU_METHOD Compu_EGR_vent_CdA " " RAT_FUNC "%.3" "in^2" COEFFS 0 16384 0 0 0 1 /end COMPU_METHOD
/begin CHARACTERISTIC EGRLP_ena "EGR valve outlet pressure sensor{EGRLP_ena&0xff=0:Disabled}{EGRLP_ena&0xff=1:Aux PD1}{EGRLP_ena&0xff=2:Aux PD2}{EGRLP_ena&0xff=3:Aux PD3}{EGRLP_ena&0xff=4:Aux PUD1}{EGRLP_ena&0xff=5:Aux PUD2}{EGRLP_ena&0xff=6:Aux PUD3}{EGRLP_ena&0xff=7:Aux PUD4}{EGRLP_ena" VALUE 0x001409a6 /* @ECU_Address@EGRLP_ena@0x0100BC48@ */ ECIPP_ALIGNMENT_UBYTE 255 EGRLP_ena_COMPU_VTAB 0 255 BIT_MASK 0xff /end CHARACTERISTIC
/begin COMPU_METHOD EGRLP_ena_COMPU_VTAB "Verbal Table" TAB_VERB "%.0" "list" COMPU_TAB_REF EGRLP_ena_COMPU_VTAB_REF /end COMPU_METHOD
/begin COMPU_VTAB EGRLP_ena_COMPU_VTAB_REF "Verbal Table" TAB_VERB 31 0 "Disabled" 1 "Aux PD1" 2 "Aux PD2" 3 "Aux PD3" 4 "Aux PUD1" 5 "Aux PUD2" 6 "Aux PUD3" 7 "Aux PUD4" 8 "Aux PUD5" 9 "Aux PUD6" 10 "Aux PUD7" 11 "Aux PUD8" 12 "Aux PUD9" 13 "Aux PUD10" 14 "Aux PUD11" 15 "Aux PUD12" 16 "Aux PUD13" 17 "Aux PUD14" 18 "Aux PUD15" 19 "CAN sourced" 20 "FPP2 Input" 21 "Aux PUD16" 22 "Aux PUD17" 23 "Aux PUD18" 24 "Aux PUD19" 25 "Aux PUD20" 26 "Aux PUD21" 27 "Aux PUD22" 28 "Aux PUD23" 29 "Aux PUD24" 30 "Aux PUD25" DEFAULT_VALUE "UNKNOWN" /end COMPU_VTAB
/begin MEASUREMENT EGRdP_inst "EGRdP sensor instantaneous" SWORD Compu_EGRdP_inst 0 0 -32 31.9990234375 ECU_ADDRESS 0x0100BCC0 /end MEASUREMENT
/begin COMPU_METHOD Compu_EGRdP_inst " " RAT_FUNC "%.3" "psi" COEFFS 0 1024 0 0 0 1 /end COMPU_METHOD
/begin MEASUREMENT EGRdP_offset "EGRdP sensor offset" SWORD Compu_EGRdP_offset 0 0 -32 31.9990234375 ECU_ADDRESS 0x0100BCC8 /end MEASUREMENT
/begin COMPU_METHOD Compu_EGRdP_offset " " RAT_FUNC "%.3" "psi" COEFFS 0 1024 0 0 0 1 /end COMPU_METHOD
/begin MEASUREMENT EGRdP_offset_state "EGRdP offset sampling{EGRdP_offset_state&0xff=0:Disabled}{EGRdP_offset_state&0xff=1:Inactive: key-on wait}{EGRdP_offset_state&0xff=2:Inactive: ECT low}{EGRdP_offset_state&0xff=3:Inactive: dP error}{EGRdP_offset_state&0xff=4:Inactive: EGR on}{EGRdP_offset_" UBYTE EGRdP_offset_state_COMPU_VTAB 0 0 0 255 ECU_ADDRESS 0x0100BCD0 BIT_MASK 0xff /end MEASUREMENT
/begin COMPU_METHOD EGRdP_offset_state_COMPU_VTAB "Verbal Table" TAB_VERB "%.0" "list" COMPU_TAB_REF EGRdP_offset_state_COMPU_VTAB_REF /end COMPU_METHOD
/begin COMPU_VTAB EGRdP_offset_state_COMPU_VTAB_REF "Verbal Table" TAB_VERB 22 0 "Disabled" 1 "Inactive: key-on wait" 2 "Inactive: ECT low" 3 "Inactive: dP error" 4 "Inactive: EGR on" 5 "Inactive: valve open" 6 "Inactive: stabilizing" 7 "Active: sampling" 8 "Inactive: sample high" 9 "Inactive: sample low" 10 "Inactive: pulsations" 11 "Inactive: key-off" 12 "Inactive: start allowed" 13 "Inactive: key-off allowed" 14 "Inactive: key-off wait" 15 "Inactive: key-off done" 16 "Inactive: de-icing" 17 "Inactive: reset learn wait" 18 "Inactive: reset learn abort" 19 "Inactive: reset learn done" 20 "Inactive: untrusted" 21 "Inactive: valve stuck" DEFAULT_VALUE "UNKNOWN" /end COMPU_VTAB
/begin CHARACTERISTIC EGRdP_offset_learn "EGRdP offset learn{EGRdP_offset_learn&0xff=0:Disabled}{EGRdP_offset_learn&0xff=1:Enabled}{EGRdP_offset_learn&0xff=2:Start Inhibit Only}{EGRdP_offset_learn&0xff=3:Key-Off Clear Only}" VALUE 0x001409b9 /* @ECU_Address@EGRdP_offset_learn@0x0100BCD8@ */ ECIPP_ALIGNMENT_UBYTE 255 EGRdP_offset_learn_COMPU_VTAB 0 255 BIT_MASK 0xff /end CHARACTERISTIC
/begin COMPU_METHOD EGRdP_offset_learn_COMPU_VTAB "Verbal Table" TAB_VERB "%.0" "list" COMPU_TAB_REF EGRdP_offset_learn_COMPU_VTAB_REF /end COMPU_METHOD
/begin COMPU_VTAB EGRdP_offset_learn_COMPU_VTAB_REF "Verbal Table" TAB_VERB 4 0 "Disabled" 1 "Enabled" 2 "Start Inhibit Only" 3 "Key-Off Clear Only" DEFAULT_VALUE "UNKNOWN" /end COMPU_VTAB
/begin CHARACTERISTIC EGRdP_offset_ECT "EGRdP offset ECT min" VALUE 0x0014090e /* @ECU_Address@EGRdP_offset_ECT@0x0100BCE0@ */ ECIPP_ALIGNMENT_UWORD 564 Compu_EGRdP_offset_ECT -460 563.984375 /end CHARACTERISTIC
/begin COMPU_METHOD Compu_EGRdP_offset_ECT " " RAT_FUNC "%.1" "deg F" COEFFS 0 64 29440 0 0 1 /end COMPU_METHOD
/begin CHARACTERISTIC EGRdP_offset_vlvmax "EGRdP offset valve max" VALUE 0x00140918 /* @ECU_Address@EGRdP_offset_vlvmax@0x0100BCE8@ */ ECIPP_ALIGNMENT_UWORD 100 Compu_EGRdP_offset_vlvmax 0 99.9984741210938 /end CHARACTERISTIC
/begin COMPU_METHOD Compu_EGRdP_offset_vlvmax " " RAT_FUNC "%.1" "%" COEFFS 0 655.36 0 0 0 1 /end COMPU_METHOD
/begin CHARACTERISTIC EGRdP_offset_flowwt "EGRdP offset stabilization wait" VALUE 0x00140912 /* @ECU_Address@EGRdP_offset_flowwt@0x0100BCF0@ */ ECIPP_ALIGNMENT_UWORD 66 Compu_EGRdP_offset_flowwt 0 65.535 /end CHARACTERISTIC
/begin COMPU_METHOD Compu_EGRdP_offset_flowwt " " RAT_FUNC "%.1" "sec" COEFFS 0 1000 0 0 0 1 /end COMPU_METHOD
/begin CHARACTERISTIC m_d_pct_cmd_tau "Diluent command low-pass" VALUE 0x001409a0 /* @ECU_Address@m_d_pct_cmd_tau@0x0100BD10@ */ ECIPP_ALIGNMENT_UWORD 163840 Compu_m_d_pct_cmd_tau 0.16703 163840 /end CHARACTERISTIC
/begin COMPU_METHOD Compu_m_d_pct_cmd_tau " " FORM "%.0" "ms"
 /begin FORMULA "-5 / log(1.0000000000001 - (X1 / 32768))" FORMULA_INV "(1.0000000000001 - exp(-5/X1)) * 32768" /end FORMULA
/end COMPU_METHOD
/begin CHARACTERISTIC m_d_pct_cmd_dz "Diluent command deadzone" VALUE 0x0014097e /* @ECU_Address@m_d_pct_cmd_dz@0x0100BD18@ */ ECIPP_ALIGNMENT_UWORD 400 Compu_m_d_pct_cmd_dz 0 399.993896484375 /end CHARACTERISTIC
/begin COMPU_METHOD Compu_m_d_pct_cmd_dz " " RAT_FUNC "%.1" "%" COEFFS 0 163.84 0 0 0 1 /end COMPU_METHOD
/begin MEASUREMENT EGR_clr_dP "EGR cooler pressure loss" UWORD Compu_EGR_clr_dP 0 0 0 255.99609375 ECU_ADDRESS 0x0100BD20 /end MEASUREMENT
/begin COMPU_METHOD Compu_EGR_clr_dP " " RAT_FUNC "%.3" "psi" COEFFS 0 256 0 0 0 1 /end COMPU_METHOD
/begin CHARACTERISTIC EGRdP_offset_dPmin "EGRdP offset sample min" VALUE 0x001401e6 /* @ECU_Address@EGRdP_offset_dPmin@0x0100BD30@ */ ECIPP_ALIGNMENT_SWORD 32 Compu_EGRdP_offset_dPmin -32 31.9990234375 /end CHARACTERISTIC
/begin COMPU_METHOD Compu_EGRdP_offset_dPmin " " RAT_FUNC "%.3" "psi" COEFFS 0 1024 0 0 0 1 /end COMPU_METHOD
/begin CHARACTERISTIC EGRdP_offset_dPmax "EGRdP offset sample max" VALUE 0x001401e4 /* @ECU_Address@EGRdP_offset_dPmax@0x0100BD38@ */ ECIPP_ALIGNMENT_SWORD 32 Compu_EGRdP_offset_dPmax -32 31.9990234375 /end CHARACTERISTIC
/begin COMPU_METHOD Compu_EGRdP_offset_dPmax " " RAT_FUNC "%.3" "psi" COEFFS 0 1024 0 0 0 1 /end COMPU_METHOD
/begin CHARACTERISTIC EGRdP_offset_tau "EGRdP offset sampling tau" VALUE 0x00140996 /* @ECU_Address@EGRdP_offset_tau@0x0100BD50@ */ ECIPP_ALIGNMENT_UWORD 1638 Compu_EGRdP_offset_tau 0.0016703 1638.4 /end CHARACTERISTIC
/begin COMPU_METHOD Compu_EGRdP_offset_tau " " FORM "%.1" "sec"
 /begin FORMULA "-0.05 / log(1.0000000000001 - (X1 / 32768))" FORMULA_INV "(1.0000000000001 - exp(-0.05/X1)) * 32768" /end FORMULA
/end COMPU_METHOD
/begin MEASUREMENT EGR_FB_source "EGR measured flow source{EGR_FB_source&0xff=0:None}{EGR_FB_source&0xff=1:Venturi + dP}{EGR_FB_source&0xff=2:Valve + dP}{EGR_FB_source&0xff=3:MAF sensor}{EGR_FB_source&0xff=4:UEGO sensor}{EGR_FB_source&0xff=5:UEGO + Venturi dP}" UBYTE EGR_FB_source_COMPU_VTAB 0 0 0 255 ECU_ADDRESS 0x0100BD58 BIT_MASK 0xff /end MEASUREMENT
/begin COMPU_METHOD EGR_FB_source_COMPU_VTAB "Verbal Table" TAB_VERB "%.0" "list" COMPU_TAB_REF EGR_FB_source_COMPU_VTAB_REF /end COMPU_METHOD
/begin COMPU_VTAB EGR_FB_source_COMPU_VTAB_REF "Verbal Table" TAB_VERB 6 0 "None" 1 "Venturi + dP" 2 "Valve + dP" 3 "MAF sensor" 4 "UEGO sensor" 5 "UEGO + Venturi dP" DEFAULT_VALUE "UNKNOWN" /end COMPU_VTAB
/begin CHARACTERISTIC EGRad_ena "EGR CL adaptive area updates{EGRad_ena&0xff=0:Disabled}{EGRad_ena&0xff=1:CL Enabled}{EGRad_ena&0xff=2:CL+Adapt Enabled}" VALUE 0x001409b4 /* @ECU_Address@EGRad_ena@0x0100BD60@ */ ECIPP_ALIGNMENT_UBYTE 255 EGRad_ena_COMPU_VTAB 0 255 BIT_MASK 0xff /end CHARACTERISTIC
/begin COMPU_METHOD EGRad_ena_COMPU_VTAB "Verbal Table" TAB_VERB "%.0" "list" COMPU_TAB_REF EGRad_ena_COMPU_VTAB_REF /end COMPU_METHOD
/begin COMPU_VTAB EGRad_ena_COMPU_VTAB_REF "Verbal Table" TAB_VERB 3 0 "Disabled" 1 "CL Enabled" 2 "CL+Adapt Enabled" DEFAULT_VALUE "UNKNOWN" /end COMPU_VTAB
/begin MEASUREMENT EGRad_CL_status "EGR CL status{EGRad_CL_status&0xff=0:Inactive: Disabled}{EGRad_CL_status&0xff=1:Active}{EGRad_CL_status&0xff=2:Inactive: EGR off}{EGRad_CL_status&0xff=3:Inactive: Low EGR Flow}{EGRad_CL_status&0xff=4:Inactive: Low MAF Flow}{EGRad_CL_status&0xff=5:Inactive" UBYTE EGRad_CL_status_COMPU_VTAB 0 0 0 255 ECU_ADDRESS 0x0100BD68 BIT_MASK 0xff /end MEASUREMENT
/begin COMPU_METHOD EGRad_CL_status_COMPU_VTAB "Verbal Table" TAB_VERB "%.0" "list" COMPU_TAB_REF EGRad_CL_status_COMPU_VTAB_REF /end COMPU_METHOD
/begin COMPU_VTAB EGRad_CL_status_COMPU_VTAB_REF "Verbal Table" TAB_VERB 28 0 "Inactive: Disabled" 1 "Active" 2 "Inactive: EGR off" 3 "Inactive: Low EGR Flow" 4 "Inactive: Low MAF Flow" 5 "Inactive: Run Time Wait" 6 "Inactive: Min Position" 7 "Inactive: Stabilizing" 8 "Active" 9 "Active" 10 "Active" 11 "Active" 12 "Active" 13 "Active" 14 "Active" 15 "Active" 16 "Inactive: Transient" 17 "Inactive: Min Valve Lmt" 18 "Inactive: Max Valve Lmt" 19 "Inactive: PR high" 20 "Active" 21 "Inactive: Valve Slew" 22 "Inactive: FSO" 23 "Inactive: FB Source" 24 "Inactive: MAP Transient" 25 "Active" 26 "Inactive: EGR De-icing" 27 "Inactive: Valve Stuck" DEFAULT_VALUE "UNKNOWN" /end COMPU_VTAB
/begin MEASUREMENT EGRHP_float "EGRHP" FLOAT32_IEEE Compu_EGRHP_float 0 0 -10000000000 10000000000 ECU_ADDRESS 0x0100BD88 /end MEASUREMENT
/begin COMPU_METHOD Compu_EGRHP_float " " RAT_FUNC "%.2" "psia" COEFFS 0 1 0 0 0 1 /end COMPU_METHOD
/begin CHARACTERISTIC EGRad_strt_wait "EGR CL adaptive start wait" VALUE 0x001401b0 /* @ECU_Address@EGRad_strt_wait@0x0100BDB8@ */ ECIPP_ALIGNMENT_ULONG 4294967 Compu_EGRad_strt_wait 0 4294967.295 /end CHARACTERISTIC
/begin COMPU_METHOD Compu_EGRad_strt_wait " " RAT_FUNC "%.1" "sec" COEFFS 0 1000 0 0 0 1 /end COMPU_METHOD
/begin CHARACTERISTIC EGRad_adapt_dz "EGR adaptive error deadzone" VALUE 0x00140902 /* @ECU_Address@EGRad_adapt_dz@0x0100BDC0@ */ ECIPP_ALIGNMENT_UWORD 200 Compu_EGRad_adapt_dz 0 199.996948242188 /end CHARACTERISTIC
/begin COMPU_METHOD Compu_EGRad_adapt_dz " " RAT_FUNC "%.2" "% error" COEFFS 0 327.68 0 0 0 1 /end COMPU_METHOD
/begin CHARACTERISTIC EGRad_Kadapt "EGR adaptive learn gain" VALUE 0x001408f4 /* @ECU_Address@EGRad_Kadapt@0x0100BDC8@ */ ECIPP_ALIGNMENT_UWORD 1600 Compu_EGRad_Kadapt 0 1599.9755859375 /end CHARACTERISTIC
/begin COMPU_METHOD Compu_EGRad_Kadapt " " RAT_FUNC "%.1" "%/%/sec" COEFFS 0 40.96 0 0 0 1 /end COMPU_METHOD
/begin CHARACTERISTIC EGRad_adapt_lim "EGR adaptive learn +/- limit" VALUE 0x001401da /* @ECU_Address@EGRad_adapt_lim@0x0100BDD0@ */ ECIPP_ALIGNMENT_SWORD 100 Compu_EGRad_adapt_lim -100 99.9969482421875 /end CHARACTERISTIC
/begin COMPU_METHOD Compu_EGRad_adapt_lim " " RAT_FUNC "%.1" "% area" COEFFS 0 327.68 0 0 0 1 /end COMPU_METHOD
/begin CHARACTERISTIC EGRad_stable_wait "EGR CL adaptive stabilization wait" VALUE 0x0014090a /* @ECU_Address@EGRad_stable_wait@0x0100BDE8@ */ ECIPP_ALIGNMENT_UWORD 65535 Compu_EGRad_stable_wait 0 65535 /end CHARACTERISTIC
/begin COMPU_METHOD Compu_EGRad_stable_wait " " RAT_FUNC "%.0" "ms" COEFFS 0 1 0 0 0 1 /end COMPU_METHOD
/begin MEASUREMENT EGR_PRf_pseudo "EGR valve pseudo PR" FLOAT32_IEEE Compu_EGR_PRf_pseudo 0 0 -10000000000 10000000000 ECU_ADDRESS 0x0100BE08 /end MEASUREMENT
/begin COMPU_METHOD Compu_EGR_PRf_pseudo " " RAT_FUNC "%.3" "EGRLP/EGRHP" COEFFS 0 1 0 0 0 1 /end COMPU_METHOD
/begin MEASUREMENT EGR_vent_Pin "EGR vent inlet pressure" FLOAT32_IEEE Compu_EGR_vent_Pin 0 0 -10000000000 10000000000 ECU_ADDRESS 0x0100CBE0 /end MEASUREMENT
/begin COMPU_METHOD Compu_EGR_vent_Pin " " RAT_FUNC "%.0" "psia" COEFFS 0 1 0 0 0 1 /end COMPU_METHOD
/begin MEASUREMENT mdot_mix_fill_float "Intake flow - total" FLOAT32_IEEE Compu_mdot_mix_fill_float 0 0 -10000000000 10000000000 ECU_ADDRESS 0x0100CC30 /end MEASUREMENT
/begin COMPU_METHOD Compu_mdot_mix_fill_float " " RAT_FUNC "%.1" "g/sec" COEFFS 0 1 0 0 0 1 /end COMPU_METHOD
/begin CHARACTERISTIC EGRad_TPS_min "EGR adaptive min position" VALUE 0x001408fe /* @ECU_Address@EGRad_TPS_min@0x0100CCD0@ */ ECIPP_ALIGNMENT_UWORD 100 Compu_EGRad_TPS_min 0 99.9984741210938 /end CHARACTERISTIC
/begin COMPU_METHOD Compu_EGRad_TPS_min " " RAT_FUNC "%.2" "%" COEFFS 0 655.36 0 0 0 1 /end COMPU_METHOD
/begin CHARACTERISTIC EGRad_adapt_valid "EGR adaptive error valid" VALUE 0x00140904 /* @ECU_Address@EGRad_adapt_valid@0x0100CCF0@ */ ECIPP_ALIGNMENT_UWORD 200 Compu_EGRad_adapt_valid 0 199.996948242188 /end CHARACTERISTIC
/begin COMPU_METHOD Compu_EGRad_adapt_valid " " RAT_FUNC "%.2" "%" COEFFS 0 327.68 0 0 0 1 /end COMPU_METHOD
/begin MEASUREMENT EGRad_CL_pct "EGR CL correction" FLOAT32_IEEE Compu_EGRad_CL_pct 0 0 -10000000000 10000000000 ECU_ADDRESS 0x0100CCF8 /end MEASUREMENT
/begin COMPU_METHOD Compu_EGRad_CL_pct " " RAT_FUNC "%.1" "%" COEFFS 0 0.01 0 0 0 1 /end COMPU_METHOD
/begin CHARACTERISTIC EGRad_adapt_wait "EGR adaptive stabilization wait" VALUE 0x00140906 /* @ECU_Address@EGRad_adapt_wait@0x0100CD00@ */ ECIPP_ALIGNMENT_UWORD 65535 Compu_EGRad_adapt_wait 0 65535 /end CHARACTERISTIC
/begin COMPU_METHOD Compu_EGRad_adapt_wait " " RAT_FUNC "%.0" "ms" COEFFS 0 1 0 0 0 1 /end COMPU_METHOD
/begin MEASUREMENT EGRad_adapt_status "EGR adaptive area status{EGRad_adapt_status&0xff=0:Inactive: Disabled}{EGRad_adapt_status&0xff=1:Active}{EGRad_adapt_status&0xff=2:Inactive: EGR off}{EGRad_adapt_status&0xff=3:Inactive: Low EGR Flow}{EGRad_adapt_status&0xff=4:Inactive: Low MAF Flow}{EGRad" UBYTE EGRad_adapt_status_COMPU_VTAB 0 0 0 255 ECU_ADDRESS 0x0100CD08 BIT_MASK 0xff /end MEASUREMENT
/begin COMPU_METHOD EGRad_adapt_status_COMPU_VTAB "Verbal Table" TAB_VERB "%.0" "list" COMPU_TAB_REF EGRad_adapt_status_COMPU_VTAB_REF /end COMPU_METHOD
/begin COMPU_VTAB EGRad_adapt_status_COMPU_VTAB_REF "Verbal Table" TAB_VERB 28 0 "Inactive: Disabled" 1 "Active" 2 "Inactive: EGR off" 3 "Inactive: Low EGR Flow" 4 "Inactive: Low MAF Flow" 5 "Inactive: Run Time Wait" 6 "Inactive: Low Position" 7 "Inactive: Stabilizing" 8 "Inactive: PR High" 9 "Inactive: EGRLP Low" 10 "Inactive: Converging" 11 "Inactive: Stabilizing" 12 "Inactive: Deadzone" 13 "Inactive: Low EGR Flow" 14 "Inactive: Low MAF Flow" 15 "Inactive: Low Position" 16 "Inactive: EGR Transient" 17 "Inactive: Min Valve Lmt" 18 "Inactive: Max Valve Lmt" 19 "Inactive: PR high" 20 "Inactive: Disabled" 21 "Inactive: Valve Slew" 22 "Inactive: FSO" 23 "Inactive: FB Source" 24 "Inactive: MAP Transient" 25 "Inactive: Fault Active" 26 "Inactive: EGR de-icing" 27 "Inactive: Valve Stuck" DEFAULT_VALUE "UNKNOWN" /end COMPU_VTAB
/begin MEASUREMENT manual_EGR_tau "EGR manual command tau" FLOAT32_IEEE Compu_manual_EGR_tau 0 0 -10000000000 10000000000 ECU_ADDRESS 0x0100CD10 /end MEASUREMENT
/begin COMPU_METHOD Compu_manual_EGR_tau " " RAT_FUNC "%.0" "ms" COEFFS 0 1 0 0 0 1 /end COMPU_METHOD
/begin CHARACTERISTIC EGR_mindil_cmdtbl "Min diluent mass frac command{EGR_mindil_cmdtbl&0xff=0:None}{EGR_mindil_cmdtbl&0xff=1:Alternate Table}" VALUE 0x001409ae /* @ECU_Address@EGR_mindil_cmdtbl@0x0100D2F8@ */ ECIPP_ALIGNMENT_UBYTE 255 EGR_mindil_cmdtbl_COMPU_VTAB 0 255 BIT_MASK 0xff /end CHARACTERISTIC
/begin COMPU_METHOD EGR_mindil_cmdtbl_COMPU_VTAB "Verbal Table" TAB_VERB "%.0" "list" COMPU_TAB_REF EGR_mindil_cmdtbl_COMPU_VTAB_REF /end COMPU_METHOD
/begin COMPU_VTAB EGR_mindil_cmdtbl_COMPU_VTAB_REF "Verbal Table" TAB_VERB 2 0 "None" 1 "Alternate Table" DEFAULT_VALUE "UNKNOWN" /end COMPU_VTAB
/begin CHARACTERISTIC EGR_mindil_spktbl "Min diluent spark command{EGR_mindil_spktbl&0xff=0:None}{EGR_mindil_spktbl&0xff=1:Gasoline Base}{EGR_mindil_spktbl&0xff=2:LPG Base}{EGR_mindil_spktbl&0xff=3:NG Base}" VALUE 0x001409af /* @ECU_Address@EGR_mindil_spktbl@0x0100D300@ */ ECIPP_ALIGNMENT_UBYTE 255 EGR_mindil_spktbl_COMPU_VTAB 0 255 BIT_MASK 0xff /end CHARACTERISTIC
/begin COMPU_METHOD EGR_mindil_spktbl_COMPU_VTAB "Verbal Table" TAB_VERB "%.0" "list" COMPU_TAB_REF EGR_mindil_spktbl_COMPU_VTAB_REF /end COMPU_METHOD
/begin COMPU_VTAB EGR_mindil_spktbl_COMPU_VTAB_REF "Verbal Table" TAB_VERB 4 0 "None" 1 "Gasoline Base" 2 "LPG Base" 3 "NG Base" DEFAULT_VALUE "UNKNOWN" /end COMPU_VTAB
/begin MEASUREMENT m_d_pct_reqmin "Min diluent command request" UWORD Compu_m_d_pct_reqmin 0 0 0 399.993896484375 ECU_ADDRESS 0x0100D308 /end MEASUREMENT
/begin COMPU_METHOD Compu_m_d_pct_reqmin " " RAT_FUNC "%.1" "%" COEFFS 0 163.84 0 0 0 1 /end COMPU_METHOD
/begin MEASUREMENT m_d_pct_min "Min diluent command" UWORD Compu_m_d_pct_min 0 0 0 399.993896484375 ECU_ADDRESS 0x0100D310 /end MEASUREMENT
/begin COMPU_METHOD Compu_m_d_pct_min " " RAT_FUNC "%.1" "%" COEFFS 0 163.84 0 0 0 1 /end COMPU_METHOD
/begin MEASUREMENT m_d_pct_nom "Nom diluent command" UWORD Compu_m_d_pct_nom 0 0 0 399.993896484375 ECU_ADDRESS 0x0100D318 /end MEASUREMENT
/begin COMPU_METHOD Compu_m_d_pct_nom " " RAT_FUNC "%.1" "%" COEFFS 0 163.84 0 0 0 1 /end COMPU_METHOD
/begin MEASUREMENT EGR_minnom_frac "Minimum/nominal command split" FLOAT32_IEEE Compu_EGR_minnom_frac 0 0 -10000000000 10000000000 ECU_ADDRESS 0x0100D320 /end MEASUREMENT
/begin COMPU_METHOD Compu_EGR_minnom_frac " " RAT_FUNC "%.2" "-" COEFFS 0 1 0 0 0 1 /end COMPU_METHOD
/begin MEASUREMENT EGR_spkadv_min "Minimum diluent spark timing" SWORD Compu_EGR_spkadv_min 0 0 -2048 2047.9375 ECU_ADDRESS 0x0100D328 /end MEASUREMENT
/begin COMPU_METHOD Compu_EGR_spkadv_min " " RAT_FUNC "%.1" "CAD" COEFFS 0 16 0 0 0 1 /end COMPU_METHOD
/begin MEASUREMENT EGR_spkadv_nom "Nominal diluent spark timing" SWORD Compu_EGR_spkadv_nom 0 0 -2048 2047.9375 ECU_ADDRESS 0x0100D330 /end MEASUREMENT
/begin COMPU_METHOD Compu_EGR_spkadv_nom " " RAT_FUNC "%.1" "CAD" COEFFS 0 16 0 0 0 1 /end COMPU_METHOD
/begin MEASUREMENT EGR_retard "EGR spark timing offset" SWORD Compu_EGR_retard 0 0 -2048 2047.9375 ECU_ADDRESS 0x0100D348 /end MEASUREMENT
/begin COMPU_METHOD Compu_EGR_retard " " RAT_FUNC "%.1" "CAD" COEFFS 0 16 0 0 0 1 /end COMPU_METHOD
/begin CHARACTERISTIC EGRad_adapt_Amin "EGR adaptive learn +/- min A limit" VALUE 0x00140900 /* @ECU_Address@EGRad_adapt_Amin@0x0100D3C0@ */ ECIPP_ALIGNMENT_UWORD 64 Compu_EGRad_adapt_Amin 0 63.9990234375 /end CHARACTERISTIC
/begin COMPU_METHOD Compu_EGRad_adapt_Amin " " RAT_FUNC "%.3" "in^2" COEFFS 0 1024 0 0 0 1 /end COMPU_METHOD
/begin MEASUREMENT EGRad_CdA_in2 "EGR adaptive correction" FLOAT32_IEEE Compu_EGRad_CdA_in2 0 0 -10000000000 10000000000 ECU_ADDRESS 0x0100D3C8 /end MEASUREMENT
/begin COMPU_METHOD Compu_EGRad_CdA_in2 " " RAT_FUNC "%.3" "in^2" COEFFS 0 1 0 0 0 1 /end COMPU_METHOD
/begin MEASUREMENT m_d_pct_act "EGR measured diluent" UWORD Compu_m_d_pct_act 0 0 0 399.993896484375 ECU_ADDRESS 0x0100D3D8 /end MEASUREMENT
/begin COMPU_METHOD Compu_m_d_pct_act " " RAT_FUNC "%.1" "%" COEFFS 0 163.84 0 0 0 1 /end COMPU_METHOD
/begin CHARACTERISTIC EGRdP_offset_dPpls "EGRdP offset pulsation limit" VALUE 0x001401e8 /* @ECU_Address@EGRdP_offset_dPpls@0x0100D3E0@ */ ECIPP_ALIGNMENT_SWORD 32 Compu_EGRdP_offset_dPpls -32 31.9990234375 /end CHARACTERISTIC
/begin COMPU_METHOD Compu_EGRdP_offset_dPpls " " RAT_FUNC "%.3" "psi" COEFFS 0 1024 0 0 0 1 /end COMPU_METHOD
/begin CHARACTERISTIC EGRdP_offset_keywt "EGRdP offset key-on wait" VALUE 0x00140914 /* @ECU_Address@EGRdP_offset_keywt@0x0100D3F0@ */ ECIPP_ALIGNMENT_UWORD 65535 Compu_EGRdP_offset_keywt 0 65535 /end CHARACTERISTIC
/begin COMPU_METHOD Compu_EGRdP_offset_keywt " " RAT_FUNC "%.0" "ms" COEFFS 0 1 0 0 0 1 /end COMPU_METHOD
/begin MEASUREMENT mdot_EGR_act "EGR delta-P calculated flow" SWORD Compu_mdot_EGR_act 0 0 -512 511.984375 ECU_ADDRESS 0x0100D3F8 /end MEASUREMENT
/begin COMPU_METHOD Compu_mdot_EGR_act " " RAT_FUNC "%.1" "g/sec" COEFFS 0 64 0 0 0 1 /end COMPU_METHOD
/begin CHARACTERISTIC EGRwrP_ena "EGR UEGO P sensor{EGRwrP_ena&0xff=0:Disabled}{EGRwrP_ena&0xff=1:Aux PD1}{EGRwrP_ena&0xff=2:Aux PD2}{EGRwrP_ena&0xff=3:Aux PD3}{EGRwrP_ena&0xff=4:Aux PUD1}{EGRwrP_ena&0xff=5:Aux PUD2}{EGRwrP_ena&0xff=6:Aux PUD3}{EGRwrP_ena&0xff=7:Aux PUD4}{EGRwrP_ena&0xff=" VALUE 0x001409bb /* @ECU_Address@EGRwrP_ena@0x0100DDC8@ */ ECIPP_ALIGNMENT_UBYTE 255 EGRwrP_ena_COMPU_VTAB 0 255 BIT_MASK 0xff /end CHARACTERISTIC
/begin COMPU_METHOD EGRwrP_ena_COMPU_VTAB "Verbal Table" TAB_VERB "%.0" "list" COMPU_TAB_REF EGRwrP_ena_COMPU_VTAB_REF /end COMPU_METHOD
/begin COMPU_VTAB EGRwrP_ena_COMPU_VTAB_REF "Verbal Table" TAB_VERB 31 0 "Disabled" 1 "Aux PD1" 2 "Aux PD2" 3 "Aux PD3" 4 "Aux PUD1" 5 "Aux PUD2" 6 "Aux PUD3" 7 "Aux PUD4" 8 "Aux PUD5" 9 "Aux PUD6" 10 "Aux PUD7" 11 "Aux PUD8" 12 "Aux PUD9" 13 "Aux PUD10" 14 "Aux PUD11" 15 "Aux PUD12" 16 "Aux PUD13" 17 "Aux PUD14" 18 "Aux PUD15" 19 "CAN sourced" 20 "FPP2 Input" 21 "Aux PUD16" 22 "Aux PUD17" 23 "Aux PUD18" 24 "Aux PUD19" 25 "Aux PUD20" 26 "Aux PUD21" 27 "Aux PUD22" 28 "Aux PUD23" 29 "Aux PUD24" 30 "Aux PUD25" DEFAULT_VALUE "UNKNOWN" /end COMPU_VTAB
/begin MEASUREMENT EGRwrP_float "EGR UEGO P" FLOAT32_IEEE Compu_EGRwrP_float 0 0 -10000000000 10000000000 ECU_ADDRESS 0x0100DDE8 /end MEASUREMENT
/begin COMPU_METHOD Compu_EGRwrP_float " " RAT_FUNC "%.2" "psia" COEFFS 0 1 0 0 0 1 /end COMPU_METHOD
/begin CHARACTERISTIC EGRwr_flowctl_dPint "EGR UEGO flow to intake:       MAP >= BP +" VALUE 0x001401f2 /* @ECU_Address@EGRwr_flowctl_dPint@0x0100DDF0@ */ ECIPP_ALIGNMENT_SWORD 128 Compu_EGRwr_flowctl_dPint -128 127.99609375 /end CHARACTERISTIC
/begin COMPU_METHOD Compu_EGRwr_flowctl_dPint " " RAT_FUNC "%.2" "psi" COEFFS 0 256 0 0 0 1 /end COMPU_METHOD
/begin CHARACTERISTIC EGRwr_flowctl_dPmix "EGR UEGO flow to fuel mixer: MAP <= BP +" VALUE 0x001401f4 /* @ECU_Address@EGRwr_flowctl_dPmix@0x0100DDF8@ */ ECIPP_ALIGNMENT_SWORD 128 Compu_EGRwr_flowctl_dPmix -128 127.99609375 /end CHARACTERISTIC
/begin COMPU_METHOD Compu_EGRwr_flowctl_dPmix " " RAT_FUNC "%.2" "psi" COEFFS 0 256 0 0 0 1 /end COMPU_METHOD
/begin CHARACTERISTIC EGRwr_flowctl_dPdft "EGR UEGO drift cal allowed:  MAP <= BP -" VALUE 0x001401f0 /* @ECU_Address@EGRwr_flowctl_dPdft@0x0100DE08@ */ ECIPP_ALIGNMENT_SWORD 128 Compu_EGRwr_flowctl_dPdft -128 127.99609375 /end CHARACTERISTIC
/begin COMPU_METHOD Compu_EGRwr_flowctl_dPdft " " RAT_FUNC "%.2" "psi" COEFFS 0 256 0 0 0 1 /end COMPU_METHOD
/begin MEASUREMENT mdot_EGR_MAF "EGR measured flow - MAF" SWORD Compu_mdot_EGR_MAF 0 0 -512 511.984375 ECU_ADDRESS 0x0100DE10 /end MEASUREMENT
/begin COMPU_METHOD Compu_mdot_EGR_MAF " " RAT_FUNC "%.2" "g/sec" COEFFS 0 64 0 0 0 1 /end COMPU_METHOD
/begin MEASUREMENT mdot_EGR_dP "EGR measured flow - dP" SWORD Compu_mdot_EGR_dP 0 0 -512 511.984375 ECU_ADDRESS 0x0100DE18 /end MEASUREMENT
/begin COMPU_METHOD Compu_mdot_EGR_dP " " RAT_FUNC "%.2" "g/sec" COEFFS 0 64 0 0 0 1 /end COMPU_METHOD
/begin MEASUREMENT mdot_EGR_UEGO "EGR measured flow - UEGO" SWORD Compu_mdot_EGR_UEGO 0 0 -512 511.984375 ECU_ADDRESS 0x0100DE20 /end MEASUREMENT
/begin COMPU_METHOD Compu_mdot_EGR_UEGO " " RAT_FUNC "%.2" "g/sec" COEFFS 0 64 0 0 0 1 /end COMPU_METHOD
/begin MEASUREMENT m_d_pct_MAF "EGR measured diluent - MAF" UWORD Compu_m_d_pct_MAF 0 0 0 399.993896484375 ECU_ADDRESS 0x0100DE28 /end MEASUREMENT
/begin COMPU_METHOD Compu_m_d_pct_MAF " " RAT_FUNC "%.1" "%" COEFFS 0 163.84 0 0 0 1 /end COMPU_METHOD
/begin MEASUREMENT m_d_pct_dP "EGR measured diluent - dP" UWORD Compu_m_d_pct_dP 0 0 0 399.993896484375 ECU_ADDRESS 0x0100DE30 /end MEASUREMENT
/begin COMPU_METHOD Compu_m_d_pct_dP " " RAT_FUNC "%.1" "%" COEFFS 0 163.84 0 0 0 1 /end COMPU_METHOD
/begin MEASUREMENT m_d_pct_UEGO "EGR measured diluent - UEGO" UWORD Compu_m_d_pct_UEGO 0 0 0 399.993896484375 ECU_ADDRESS 0x0100DE38 /end MEASUREMENT
/begin COMPU_METHOD Compu_m_d_pct_UEGO " " RAT_FUNC "%.1" "%" COEFFS 0 163.84 0 0 0 1 /end COMPU_METHOD
/begin MEASUREMENT EGR_FB_status_MAF "EGR FB status - MAF{EGR_FB_status_MAF&0xff=0:Disabled}{EGR_FB_status_MAF&0xff=1:Inactive - Fault}{EGR_FB_status_MAF&0xff=2:Inactive - Oper Cond}{EGR_FB_status_MAF&0xff=3:Inactive - 3}{EGR_FB_status_MAF&0xff=4:Inactive - 4}{EGR_FB_status_MAF&0xff=5:Inactiv" UBYTE EGR_FB_status_MAF_COMPU_VTAB 0 0 0 255 ECU_ADDRESS 0x0100DEA8 BIT_MASK 0xff /end MEASUREMENT
/begin COMPU_METHOD EGR_FB_status_MAF_COMPU_VTAB "Verbal Table" TAB_VERB "%.0" "list" COMPU_TAB_REF EGR_FB_status_MAF_COMPU_VTAB_REF /end COMPU_METHOD
/begin COMPU_VTAB EGR_FB_status_MAF_COMPU_VTAB_REF "Verbal Table" TAB_VERB 8 0 "Disabled" 1 "Inactive - Fault" 2 "Inactive - Oper Cond" 3 "Inactive - 3" 4 "Inactive - 4" 5 "Inactive - 5" 6 "Inactive - 6" 7 "Active" DEFAULT_VALUE "UNKNOWN" /end COMPU_VTAB
/begin MEASUREMENT EGR_FB_status_dP "EGR FB status - dP{EGR_FB_status_dP&0xff=0:Disabled}{EGR_FB_status_dP&0xff=1:Inactive - Fault}{EGR_FB_status_dP&0xff=2:Inactive - Oper Cond}{EGR_FB_status_dP&0xff=3:Inactive - 3}{EGR_FB_status_dP&0xff=4:Inactive - 4}{EGR_FB_status_dP&0xff=5:Inactive - 5}{" UBYTE EGR_FB_status_dP_COMPU_VTAB 0 0 0 255 ECU_ADDRESS 0x0100DEB0 BIT_MASK 0xff /end MEASUREMENT
/begin COMPU_METHOD EGR_FB_status_dP_COMPU_VTAB "Verbal Table" TAB_VERB "%.0" "list" COMPU_TAB_REF EGR_FB_status_dP_COMPU_VTAB_REF /end COMPU_METHOD
/begin COMPU_VTAB EGR_FB_status_dP_COMPU_VTAB_REF "Verbal Table" TAB_VERB 8 0 "Disabled" 1 "Inactive - Fault" 2 "Inactive - Oper Cond" 3 "Inactive - 3" 4 "Inactive - 4" 5 "Inactive - 5" 6 "Inactive - 6" 7 "Active" DEFAULT_VALUE "UNKNOWN" /end COMPU_VTAB
/begin MEASUREMENT EGR_FB_status_UEGO "EGR FB status - UEGO{EGR_FB_status_UEGO&0xff=0:Disabled}{EGR_FB_status_UEGO&0xff=1:Inactive - Fault}{EGR_FB_status_UEGO&0xff=2:Inactive - Oper Cond}{EGR_FB_status_UEGO&0xff=3:Inactive - 3}{EGR_FB_status_UEGO&0xff=4:Inactive - 4}{EGR_FB_status_UEGO&0xff=5:" UBYTE EGR_FB_status_UEGO_COMPU_VTAB 0 0 0 255 ECU_ADDRESS 0x0100DEB8 BIT_MASK 0xff /end MEASUREMENT
/begin COMPU_METHOD EGR_FB_status_UEGO_COMPU_VTAB "Verbal Table" TAB_VERB "%.0" "list" COMPU_TAB_REF EGR_FB_status_UEGO_COMPU_VTAB_REF /end COMPU_METHOD
/begin COMPU_VTAB EGR_FB_status_UEGO_COMPU_VTAB_REF "Verbal Table" TAB_VERB 8 0 "Disabled" 1 "Inactive - Fault" 2 "Inactive - Oper Cond" 3 "Inactive - 3" 4 "Inactive - 4" 5 "Inactive - 5" 6 "Inactive - 6" 7 "Active" DEFAULT_VALUE "UNKNOWN" /end COMPU_VTAB
/begin MEASUREMENT EGRwr_drift_status "EGR drift compensation status{EGRwr_drift_status&0xff=0:Off: UEGO Inactive}{EGRwr_drift_status&0xff=1:Off: Key-Cycle Timeout}{EGRwr_drift_status&0xff=2:Off: MAP High}{EGRwr_drift_status&0xff=3:Not Allowed+Active}{EGRwr_drift_status&0xff=4:Off: FSO TPS Ope" UBYTE EGRwr_drift_status_COMPU_VTAB 0 0 0 255 ECU_ADDRESS 0x0100DEC0 BIT_MASK 0xff /end MEASUREMENT
/begin COMPU_METHOD EGRwr_drift_status_COMPU_VTAB "Verbal Table" TAB_VERB "%.0" "list" COMPU_TAB_REF EGRwr_drift_status_COMPU_VTAB_REF /end COMPU_METHOD
/begin COMPU_VTAB EGRwr_drift_status_COMPU_VTAB_REF "Verbal Table" TAB_VERB 12 0 "Off: UEGO Inactive" 1 "Off: Key-Cycle Timeout" 2 "Off: MAP High" 3 "Not Allowed+Active" 4 "Off: FSO TPS Open Req" 5 "Reserved - 5" 6 "Reserved - 6" 7 "Reserved - 7" 8 "Reserved - 8" 9 "Reserved - 9" 10 "Allowed+Inactive" 11 "Allowed+Active" DEFAULT_VALUE "UNKNOWN" /end COMPU_VTAB
/begin CHARACTERISTIC EGR_nomdil_SHref "Nom cmd reference humidity" VALUE 0x001408e2 /* @ECU_Address@EGR_nomdil_SHref@0x0100DED8@ */ ECIPP_ALIGNMENT_UWORD 250 Compu_EGR_nomdil_SHref 0 249.996185302734 /end CHARACTERISTIC
/begin COMPU_METHOD Compu_EGR_nomdil_SHref " " RAT_FUNC "%.1" "g/kg" COEFFS 0 262.144 0 0 0 1 /end COMPU_METHOD
/begin CHARACTERISTIC EGR_mindil_SHref "Min cmd reference humidity" VALUE 0x001408e0 /* @ECU_Address@EGR_mindil_SHref@0x0100DEE0@ */ ECIPP_ALIGNMENT_UWORD 250 Compu_EGR_mindil_SHref 0 249.996185302734 /end CHARACTERISTIC
/begin COMPU_METHOD Compu_EGR_mindil_SHref " " RAT_FUNC "%.1" "g/kg" COEFFS 0 262.144 0 0 0 1 /end COMPU_METHOD
/begin MEASUREMENT EGRad_CLadapt_assist "EGR CL/adaptive assist{EGRad_CLadapt_assist&0xff=0:Inactive}{EGRad_CLadapt_assist&0xff=1:Adapt Freeze Updates}{EGRad_CLadapt_assist&0xff=2:Adapt Freeze + Zero Crct}{EGRad_CLadapt_assist&0xff=3:Adapt Clear Tables}" UBYTE EGRad_CLadapt_assist_COMPU_VTAB 0 0 0 255 ECU_ADDRESS 0x0100DF20 BIT_MASK 0xff /end MEASUREMENT
/begin COMPU_METHOD EGRad_CLadapt_assist_COMPU_VTAB "Verbal Table" TAB_VERB "%.0" "list" COMPU_TAB_REF EGRad_CLadapt_assist_COMPU_VTAB_REF /end COMPU_METHOD
/begin COMPU_VTAB EGRad_CLadapt_assist_COMPU_VTAB_REF "Verbal Table" TAB_VERB 4 0 "Inactive" 1 "Adapt Freeze Updates" 2 "Adapt Freeze + Zero Crct" 3 "Adapt Clear Tables" DEFAULT_VALUE "UNKNOWN" /end COMPU_VTAB
/begin CHARACTERISTIC EGRwr_mdpct_mult "EGR UEGO determined EGR% mult" VALUE 0x00140094 /* @ECU_Address@EGRwr_mdpct_mult@0x0100DF28@ */ ECIPP_ALIGNMENT_FLOAT32_IEEE 10000000000 Compu_EGRwr_mdpct_mult -10000000000 10000000000 /end CHARACTERISTIC
/begin COMPU_METHOD Compu_EGRwr_mdpct_mult " " RAT_FUNC "%.4" "-" COEFFS 0 1 0 0 0 1 /end COMPU_METHOD
/begin CHARACTERISTIC EGR_PR_vlv_max "EGR valve PR maximum" VALUE 0x001408ae /* @ECU_Address@EGR_PR_vlv_max@0x0100DF48@ */ ECIPP_ALIGNMENT_UWORD 1 Compu_EGR_PR_vlv_max 0 0.999984741210938 /end CHARACTERISTIC
/begin COMPU_METHOD Compu_EGR_PR_vlv_max " " RAT_FUNC "%.3" "-" COEFFS 0 65536 0 0 0 1 /end COMPU_METHOD
/begin MEASUREMENT EGR_PRf_actual "EGR valve actual PR" FLOAT32_IEEE Compu_EGR_PRf_actual 0 0 -10000000000 10000000000 ECU_ADDRESS 0x0100DF58 /end MEASUREMENT
/begin COMPU_METHOD Compu_EGR_PRf_actual " " RAT_FUNC "%.3" "-" COEFFS 0 1 0 0 0 1 /end COMPU_METHOD
/begin MEASUREMENT EGR_minnom_ECT "Minimum/nominal ECT request" SWORD Compu_EGR_minnom_ECT 0 0 -2 1.99993896484375 ECU_ADDRESS 0x0100DF60 /end MEASUREMENT
/begin COMPU_METHOD Compu_EGR_minnom_ECT " " RAT_FUNC "%.2" "-" COEFFS 0 16384 0 0 0 1 /end COMPU_METHOD
/begin MEASUREMENT manual_EGR_cmd2 "EGR manual mode command 2" FLOAT32_IEEE Compu_manual_EGR_cmd2 0 0 -10000000000 10000000000 ECU_ADDRESS 0x0100DF70 /end MEASUREMENT
/begin COMPU_METHOD Compu_manual_EGR_cmd2 " " RAT_FUNC "%.2" "-" COEFFS 0 1 0 0 0 1 /end COMPU_METHOD
/begin MEASUREMENT manual_EGR_toggle "EGR manual mode toggle" UWORD Compu_manual_EGR_toggle 0 0 0 65535 ECU_ADDRESS 0x0100DF78 /end MEASUREMENT
/begin COMPU_METHOD Compu_manual_EGR_toggle " " RAT_FUNC "%.0" "ms" COEFFS 0 1 0 0 0 1 /end COMPU_METHOD
/begin MEASUREMENT manual_EGR_slct "EGR manual mode select{manual_EGR_slct&0xff=0:Command 1}{manual_EGR_slct&0xff=1:Command 2}{manual_EGR_slct&0xff=2:Toggle Command}" UBYTE manual_EGR_slct_COMPU_VTAB 0 0 0 255 ECU_ADDRESS 0x0100DF80 BIT_MASK 0xff /end MEASUREMENT
/begin COMPU_METHOD manual_EGR_slct_COMPU_VTAB "Verbal Table" TAB_VERB "%.0" "list" COMPU_TAB_REF manual_EGR_slct_COMPU_VTAB_REF /end COMPU_METHOD
/begin COMPU_VTAB manual_EGR_slct_COMPU_VTAB_REF "Verbal Table" TAB_VERB 3 0 "Command 1" 1 "Command 2" 2 "Toggle Command" DEFAULT_VALUE "UNKNOWN" /end COMPU_VTAB
/begin MEASUREMENT EGRwr_UEGO_fbpct "EGR UEGO feedback pct" UWORD Compu_EGRwr_UEGO_fbpct 0 0 0 99.9984741210938 ECU_ADDRESS 0x0100DF88 /end MEASUREMENT
/begin COMPU_METHOD Compu_EGRwr_UEGO_fbpct " " RAT_FUNC "%.1" "%" COEFFS 0 655.36 0 0 0 1 /end COMPU_METHOD
/begin CHARACTERISTIC EGR_pstvlv_V "EGR valve downstream volume" VALUE 0x001408ea /* @ECU_Address@EGR_pstvlv_V@0x0100DFA8@ */ ECIPP_ALIGNMENT_UWORD 32 Compu_EGR_pstvlv_V 0 31.99951171875 /end CHARACTERISTIC
/begin COMPU_METHOD Compu_EGR_pstvlv_V " " RAT_FUNC "%.3" "L" COEFFS 0 2048 0 0 0 1 /end COMPU_METHOD
/begin MEASUREMENT mdot_mix_fill_TPS "Manifold filling - throttle model" FLOAT32_IEEE Compu_mdot_mix_fill_TPS 0 0 -10000000000 10000000000 ECU_ADDRESS 0x0100DFB8 /end MEASUREMENT
/begin COMPU_METHOD Compu_mdot_mix_fill_TPS " " RAT_FUNC "%.1" "g/sec" COEFFS 0 1 0 0 0 1 /end COMPU_METHOD
/begin MEASUREMENT mdot_mix_fill_EGR "Manifold filling - final" FLOAT32_IEEE Compu_mdot_mix_fill_EGR 0 0 -10000000000 10000000000 ECU_ADDRESS 0x0100DFC0 /end MEASUREMENT
/begin COMPU_METHOD Compu_mdot_mix_fill_EGR " " RAT_FUNC "%.1" "g/sec" COEFFS 0 1 0 0 0 1 /end COMPU_METHOD
/begin MEASUREMENT mdot_mix_EGR "Total mixture flow for EGR calcs" FLOAT32_IEEE Compu_mdot_mix_EGR 0 0 -10000000000 10000000000 ECU_ADDRESS 0x0100DFC8 /end MEASUREMENT
/begin COMPU_METHOD Compu_mdot_mix_EGR " " RAT_FUNC "%.1" "g/sec" COEFFS 0 1 0 0 0 1 /end COMPU_METHOD
/begin MEASUREMENT mdot_EGR_VdP "EGR post-volume dm/dt" FLOAT32_IEEE Compu_mdot_EGR_VdP 0 0 -10000000000 10000000000 ECU_ADDRESS 0x0100DFD0 /end MEASUREMENT
/begin COMPU_METHOD Compu_mdot_EGR_VdP " " RAT_FUNC "%.2" "g/sec" COEFFS 0 1 0 0 0 1 /end COMPU_METHOD
/begin CHARACTERISTIC EFMA_map_dP_C "EFMA to MAP delta-P scaling" VALUE 0x00140024 /* @ECU_Address@EFMA_map_dP_C@0x0100DFE0@ */ ECIPP_ALIGNMENT_FLOAT32_IEEE 10000000000 Compu_EFMA_map_dP_C -10000000000 10000000000 /end CHARACTERISTIC
/begin COMPU_METHOD Compu_EFMA_map_dP_C " " RAT_FUNC "%.1" "upsig * s^2 / g / L" COEFFS 0 0.000001 0 0 0 1 /end COMPU_METHOD
/begin MEASUREMENT EGRad_cmdact_err "EGR command - actual difference" FLOAT32_IEEE Compu_EGRad_cmdact_err 0 0 -10000000000 10000000000 ECU_ADDRESS 0x0100DFF8 /end MEASUREMENT
/begin COMPU_METHOD Compu_EGRad_cmdact_err " " RAT_FUNC "%.2" "%" COEFFS 0 0.01 0 0 0 1 /end COMPU_METHOD
/begin CHARACTERISTIC EGRwrP_tau "EGR UEGO P low-pass tau" VALUE 0x0014099a /* @ECU_Address@EGRwrP_tau@0x0100E058@ */ ECIPP_ALIGNMENT_UWORD 327680 Compu_EGRwrP_tau 0.45084 327680 /end CHARACTERISTIC
/begin COMPU_METHOD Compu_EGRwrP_tau " " FORM "%.1" "ms"
 /begin FORMULA "-5 / log(1 - (X1 / 65536))" FORMULA_INV "(1 - exp(-5/X1)) * 65536" /end FORMULA
/end COMPU_METHOD
/begin MEASUREMENT EGR_minnom_runwt "Min/Nom run-time wait request" SWORD Compu_EGR_minnom_runwt 0 0 -2 1.99993896484375 ECU_ADDRESS 0x0100E060 /end MEASUREMENT
/begin COMPU_METHOD Compu_EGR_minnom_runwt " " RAT_FUNC "%.2" "-" COEFFS 0 16384 0 0 0 1 /end COMPU_METHOD
/begin MEASUREMENT EGRad_CL_actlmt "EGR CL active integral/final limit" FLOAT32_IEEE Compu_EGRad_CL_actlmt 0 0 -10000000000 10000000000 ECU_ADDRESS 0x0100E088 /end MEASUREMENT
/begin COMPU_METHOD Compu_EGRad_CL_actlmt " " RAT_FUNC "%.2" "%" COEFFS 0 0.01 0 0 0 1 /end COMPU_METHOD
/begin CHARACTERISTIC EGRad_PRadapt_sw "EGR adaptive CdA to PR transition start" VALUE 0x001408fa /* @ECU_Address@EGRad_PRadapt_sw@0x0100E098@ */ ECIPP_ALIGNMENT_UWORD 2 Compu_EGRad_PRadapt_sw 0 1.99996948242188 /end CHARACTERISTIC
/begin COMPU_METHOD Compu_EGRad_PRadapt_sw " " RAT_FUNC "%.3" "PR" COEFFS 0 32768 0 0 0 1 /end COMPU_METHOD
/begin CHARACTERISTIC EGRad_PR_Kadapt "EGR adaptive PR learn gain" VALUE 0x001408f8 /* @ECU_Address@EGRad_PR_Kadapt@0x0100E0A0@ */ ECIPP_ALIGNMENT_UWORD 1600 Compu_EGRad_PR_Kadapt 0 1599.9755859375 /end CHARACTERISTIC
/begin COMPU_METHOD Compu_EGRad_PR_Kadapt " " RAT_FUNC "%.1" "% PR/%/sec" COEFFS 0 40.96 0 0 0 1 /end COMPU_METHOD
/begin CHARACTERISTIC EGRad_PR_adapt_lim "EGR adaptive PR learn +/- limit" VALUE 0x001401d8 /* @ECU_Address@EGRad_PR_adapt_lim@0x0100E0A8@ */ ECIPP_ALIGNMENT_SWORD 200 Compu_EGRad_PR_adapt_lim -200 199.993896484375 /end CHARACTERISTIC
/begin COMPU_METHOD Compu_EGRad_PR_adapt_lim " " RAT_FUNC "%.1" "% PR" COEFFS 0 163.84 0 0 0 1 /end COMPU_METHOD
/begin MEASUREMENT EGRad_PR_adapt_crct "EGR adaptive PR correction" FLOAT32_IEEE Compu_EGRad_PR_adapt_crct 0 0 -10000000000 10000000000 ECU_ADDRESS 0x0100E0B0 /end MEASUREMENT
/begin COMPU_METHOD Compu_EGRad_PR_adapt_crct " " RAT_FUNC "%.2" "% PR" COEFFS 0 0.01 0 0 0 1 /end COMPU_METHOD
/begin CHARACTERISTIC EGR_tau_MAF_ms "EGR measured flow low-pass - MAF" VALUE 0x0014007c /* @ECU_Address@EGR_tau_MAF_ms@0x0100E0B8@ */ ECIPP_ALIGNMENT_FLOAT32_IEEE 10000000000 Compu_EGR_tau_MAF_ms -10000000000 10000000000 /end CHARACTERISTIC
/begin COMPU_METHOD Compu_EGR_tau_MAF_ms " " RAT_FUNC "%.1" "ms" COEFFS 0 1 0 0 0 1 /end COMPU_METHOD
/begin CHARACTERISTIC EGR_tau_dP_ms "EGR measured flow low-pass - dP" VALUE 0x00140084 /* @ECU_Address@EGR_tau_dP_ms@0x0100E0C0@ */ ECIPP_ALIGNMENT_FLOAT32_IEEE 10000000000 Compu_EGR_tau_dP_ms -10000000000 10000000000 /end CHARACTERISTIC
/begin COMPU_METHOD Compu_EGR_tau_dP_ms " " RAT_FUNC "%.1" "ms" COEFFS 0 1 0 0 0 1 /end COMPU_METHOD
/begin CHARACTERISTIC EGR_tau_UEGO_ms "EGR measured flow low-pass - UEGO" VALUE 0x00140080 /* @ECU_Address@EGR_tau_UEGO_ms@0x0100E0C8@ */ ECIPP_ALIGNMENT_FLOAT32_IEEE 10000000000 Compu_EGR_tau_UEGO_ms -10000000000 10000000000 /end CHARACTERISTIC
/begin COMPU_METHOD Compu_EGR_tau_UEGO_ms " " RAT_FUNC "%.1" "ms" COEFFS 0 1 0 0 0 1 /end COMPU_METHOD
/begin CHARACTERISTIC EGRad_PRadapt_swend "EGR adaptive CdA to PR transition end" VALUE 0x001408fc /* @ECU_Address@EGRad_PRadapt_swend@0x0100E2A0@ */ ECIPP_ALIGNMENT_UWORD 2 Compu_EGRad_PRadapt_swend 0 1.99996948242188 /end CHARACTERISTIC
/begin COMPU_METHOD Compu_EGRad_PRadapt_swend " " RAT_FUNC "%.3" "PR" COEFFS 0 32768 0 0 0 1 /end COMPU_METHOD
/begin CHARACTERISTIC EGR_vlv_dP_tau "EGR valve actual dP tau" VALUE 0x0014098e /* @ECU_Address@EGR_vlv_dP_tau@0x0100E2B8@ */ ECIPP_ALIGNMENT_UWORD 163840 Compu_EGR_vlv_dP_tau 0.16703 163840 /end CHARACTERISTIC
/begin COMPU_METHOD Compu_EGR_vlv_dP_tau " " FORM "%.0" "ms"
 /begin FORMULA "-5 / log(1.0000000000001 - (X1 / 32768))" FORMULA_INV "(1.0000000000001 - exp(-5/X1)) * 32768" /end FORMULA
/end COMPU_METHOD
/begin MEASUREMENT EGRad_PRadapt_ratio "EGR adapt CdA vs. PR adaption" FLOAT32_IEEE Compu_EGRad_PRadapt_ratio 0 0 -10000000000 10000000000 ECU_ADDRESS 0x0100E2C8 /end MEASUREMENT
/begin COMPU_METHOD Compu_EGRad_PRadapt_ratio " " RAT_FUNC "%.2" "0=CdA, 1=PR" COEFFS 0 1 0 0 0 1 /end COMPU_METHOD
/begin MEASUREMENT EGRad_cmdact_ss_err "EGR command - actual steady-state difference" FLOAT32_IEEE Compu_EGRad_cmdact_ss_err 0 0 -10000000000 10000000000 ECU_ADDRESS 0x0100E2D8 /end MEASUREMENT
/begin COMPU_METHOD Compu_EGRad_cmdact_ss_err " " RAT_FUNC "%.2" "%" COEFFS 0 0.01 0 0 0 1 /end COMPU_METHOD
/begin CHARACTERISTIC EGRad_cmdact_ss_itau "EGR CL steady-state error increasing tau" VALUE 0x00140994 /* @ECU_Address@EGRad_cmdact_ss_itau@0x0100E2E0@ */ ECIPP_ALIGNMENT_UWORD 327680 Compu_EGRad_cmdact_ss_itau 0.45084 327680 /end CHARACTERISTIC
/begin COMPU_METHOD Compu_EGRad_cmdact_ss_itau " " FORM "%.0" "ms"
 /begin FORMULA "-5 / log(1 - (X1 / 65536))" FORMULA_INV "(1 - exp(-5/X1)) * 65536" /end FORMULA
/end COMPU_METHOD
/begin CHARACTERISTIC EGRad_cmdact_ss_dtau "EGR CL steady-state error decreasing tau" VALUE 0x00140992 /* @ECU_Address@EGRad_cmdact_ss_dtau@0x0100E2E8@ */ ECIPP_ALIGNMENT_UWORD 327680 Compu_EGRad_cmdact_ss_dtau 0.45084 327680 /end CHARACTERISTIC
/begin COMPU_METHOD Compu_EGRad_cmdact_ss_dtau " " FORM "%.0" "ms"
 /begin FORMULA "-5 / log(1 - (X1 / 65536))" FORMULA_INV "(1 - exp(-5/X1)) * 65536" /end FORMULA
/end COMPU_METHOD
/begin CHARACTERISTIC EGR_spkextrap_amin "Extrapolated spark adv min sensitivity" VALUE 0x001401d0 /* @ECU_Address@EGR_spkextrap_amin@0x0100E2F0@ */ ECIPP_ALIGNMENT_SWORD 41 Compu_EGR_spkextrap_amin -40.96 40.95875 /end CHARACTERISTIC
/begin COMPU_METHOD Compu_EGR_spkextrap_amin " " RAT_FUNC "%.1" "CAD/% dil" COEFFS 0 800 0 0 0 1 /end COMPU_METHOD
/begin CHARACTERISTIC EGR_spkextrap_amax "Extrapolated spark adv max slope" VALUE 0x001401ce /* @ECU_Address@EGR_spkextrap_amax@0x0100E2F8@ */ ECIPP_ALIGNMENT_SWORD 41 Compu_EGR_spkextrap_amax -40.96 40.95875 /end CHARACTERISTIC
/begin COMPU_METHOD Compu_EGR_spkextrap_amax " " RAT_FUNC "%.1" "CAD/% dil" COEFFS 0 800 0 0 0 1 /end COMPU_METHOD
/begin CHARACTERISTIC EGR_spkextrap_rmin "Extrapolated spark ret min sensitivity" VALUE 0x001401d6 /* @ECU_Address@EGR_spkextrap_rmin@0x0100E300@ */ ECIPP_ALIGNMENT_SWORD 41 Compu_EGR_spkextrap_rmin -40.96 40.95875 /end CHARACTERISTIC
/begin COMPU_METHOD Compu_EGR_spkextrap_rmin " " RAT_FUNC "%.1" "CAD/% dil" COEFFS 0 800 0 0 0 1 /end COMPU_METHOD
/begin CHARACTERISTIC EGR_spkextrap_rmax "Extrapolated spark ret max sensitivity" VALUE 0x001401d4 /* @ECU_Address@EGR_spkextrap_rmax@0x0100E308@ */ ECIPP_ALIGNMENT_SWORD 41 Compu_EGR_spkextrap_rmax -40.96 40.95875 /end CHARACTERISTIC
/begin COMPU_METHOD Compu_EGR_spkextrap_rmax " " RAT_FUNC "%.1" "CAD/% dil" COEFFS 0 800 0 0 0 1 /end COMPU_METHOD
/begin MEASUREMENT EGR_spkextrap_sens "Extrapolated spark actual sensitivity" SWORD Compu_EGR_spkextrap_sens 0 0 -40.96 40.95875 ECU_ADDRESS 0x0100E310 /end MEASUREMENT
/begin COMPU_METHOD Compu_EGR_spkextrap_sens " " RAT_FUNC "%.2" "CAD/% dil" COEFFS 0 800 0 0 0 1 /end COMPU_METHOD
/begin CHARACTERISTIC EGR_spkextrap_advlmt "Extrapolated spark advance limit" VALUE 0x001401cc /* @ECU_Address@EGR_spkextrap_advlmt@0x0100E318@ */ ECIPP_ALIGNMENT_SWORD 2048 Compu_EGR_spkextrap_advlmt -2048 2047.9375 /end CHARACTERISTIC
/begin COMPU_METHOD Compu_EGR_spkextrap_advlmt " " RAT_FUNC "%.1" "CAD" COEFFS 0 16 0 0 0 1 /end COMPU_METHOD
/begin CHARACTERISTIC EGR_spkextrap_retlmt "Extrapolated spark retard limit" VALUE 0x001401d2 /* @ECU_Address@EGR_spkextrap_retlmt@0x0100E320@ */ ECIPP_ALIGNMENT_SWORD 2048 Compu_EGR_spkextrap_retlmt -2048 2047.9375 /end CHARACTERISTIC
/begin COMPU_METHOD Compu_EGR_spkextrap_retlmt " " RAT_FUNC "%.1" "CAD" COEFFS 0 16 0 0 0 1 /end COMPU_METHOD
/begin MEASUREMENT EGR_spkextrap_ret "Extrapolated spark retard" SWORD Compu_EGR_spkextrap_ret 0 0 -2048 2047.9375 ECU_ADDRESS 0x0100E328 /end MEASUREMENT
/begin COMPU_METHOD Compu_EGR_spkextrap_ret " " RAT_FUNC "%.1" "CAD" COEFFS 0 16 0 0 0 1 /end COMPU_METHOD
/begin MEASUREMENT m_d_pct_spk "EGR diluent @ TDC for retard" UWORD Compu_m_d_pct_spk 0 0 0 399.993896484375 ECU_ADDRESS 0x0100E358 /end MEASUREMENT
/begin COMPU_METHOD Compu_m_d_pct_spk " " RAT_FUNC "%.1" "%" COEFFS 0 163.84 0 0 0 1 /end COMPU_METHOD
/begin CHARACTERISTIC m_d_pct_cmd_OFF "Diluent command 'off' limit" VALUE 0x0014097a /* @ECU_Address@m_d_pct_cmd_OFF@0x0100E530@ */ ECIPP_ALIGNMENT_UWORD 400 Compu_m_d_pct_cmd_OFF 0 399.993896484375 /end CHARACTERISTIC
/begin COMPU_METHOD Compu_m_d_pct_cmd_OFF " " RAT_FUNC "%.1" "%" COEFFS 0 163.84 0 0 0 1 /end COMPU_METHOD
/begin CHARACTERISTIC m_d_pct_cmd_ON "Diluent command 'on' limit" VALUE 0x0014097c /* @ECU_Address@m_d_pct_cmd_ON@0x0100E538@ */ ECIPP_ALIGNMENT_UWORD 400 Compu_m_d_pct_cmd_ON 0 399.993896484375 /end CHARACTERISTIC
/begin COMPU_METHOD Compu_m_d_pct_cmd_ON " " RAT_FUNC "%.1" "%" COEFFS 0 163.84 0 0 0 1 /end COMPU_METHOD
/begin CHARACTERISTIC EGRdP_offset_strtwt "EGRdP offset start inhibit" VALUE 0x00140916 /* @ECU_Address@EGRdP_offset_strtwt@0x0100E548@ */ ECIPP_ALIGNMENT_UWORD 65535 Compu_EGRdP_offset_strtwt 0 65535 /end CHARACTERISTIC
/begin COMPU_METHOD Compu_EGRdP_offset_strtwt " " RAT_FUNC "%.0" "ms" COEFFS 0 1 0 0 0 1 /end COMPU_METHOD
/begin MEASUREMENT EGR_minnom_raw "Min/Nom fraction prior to slewing" FLOAT32_IEEE Compu_EGR_minnom_raw 0 0 -10000000000 10000000000 ECU_ADDRESS 0x0100E550 /end MEASUREMENT
/begin COMPU_METHOD Compu_EGR_minnom_raw " " RAT_FUNC "%.2" "-" COEFFS 0 1 0 0 0 1 /end COMPU_METHOD
/begin CHARACTERISTIC EGR_minnom_pslew "Off->Min->Nom slew rate limit" VALUE 0x001401a8 /* @ECU_Address@EGR_minnom_pslew@0x0100E558@ */ ECIPP_ALIGNMENT_FLOAT32_IEEE 10000000000 Compu_EGR_minnom_pslew -10000000000 10000000000 /end CHARACTERISTIC
/begin COMPU_METHOD Compu_EGR_minnom_pslew " " RAT_FUNC "%.3" "sec/frac" COEFFS 0 0 1 0 1000 0 /end COMPU_METHOD
/begin CHARACTERISTIC EGR_minnom_nslew "Nom->Min->Off slew rate limit" VALUE 0x001401a4 /* @ECU_Address@EGR_minnom_nslew@0x0100E560@ */ ECIPP_ALIGNMENT_FLOAT32_IEEE 10000000000 Compu_EGR_minnom_nslew -10000000000 10000000000 /end CHARACTERISTIC
/begin COMPU_METHOD Compu_EGR_minnom_nslew " " RAT_FUNC "%.3" "sec/frac" COEFFS 0 0 1 0 1000 0 /end COMPU_METHOD
/begin MEASUREMENT m_d_pct_FL "Full load diluent command" UWORD Compu_m_d_pct_FL 0 0 0 399.993896484375 ECU_ADDRESS 0x0100E568 /end MEASUREMENT
/begin COMPU_METHOD Compu_m_d_pct_FL " " RAT_FUNC "%.1" "%" COEFFS 0 163.84 0 0 0 1 /end COMPU_METHOD
/begin MEASUREMENT m_d_pct_LL "Off/Min limited diluent command" UWORD Compu_m_d_pct_LL 0 0 0 399.993896484375 ECU_ADDRESS 0x0100E570 /end MEASUREMENT
/begin COMPU_METHOD Compu_m_d_pct_LL " " RAT_FUNC "%.1" "%" COEFFS 0 163.84 0 0 0 1 /end COMPU_METHOD
/begin MEASUREMENT EGR_MAPload_LL "Off/Min limited MAP load" UWORD Compu_EGR_MAPload_LL 0 0 0 255.99609375 ECU_ADDRESS 0x0100E578 /end MEASUREMENT
/begin COMPU_METHOD Compu_EGR_MAPload_LL " " RAT_FUNC "%.1" "psi" COEFFS 0 256 0 0 0 1 /end COMPU_METHOD
/begin MEASUREMENT LoadLim_EGR_pct "EGR off/min load limit" UWORD Compu_LoadLim_EGR_pct 0 0 0 99.9984741210938 ECU_ADDRESS 0x0100E580 /end MEASUREMENT
/begin COMPU_METHOD Compu_LoadLim_EGR_pct " " RAT_FUNC "%.1" "%" COEFFS 0 655.36 0 0 0 1 /end COMPU_METHOD
/begin CHARACTERISTIC EFMA_fmix_dP_C "EFMA fuel mixer dP scaling" VALUE 0x0014001c /* @ECU_Address@EFMA_fmix_dP_C@0x0100E600@ */ ECIPP_ALIGNMENT_FLOAT32_IEEE 10000000000 Compu_EFMA_fmix_dP_C -10000000000 10000000000 /end CHARACTERISTIC
/begin COMPU_METHOD Compu_EFMA_fmix_dP_C " " RAT_FUNC "%.1" "upsig * s^2 / g / L" COEFFS 0 0.000001 0 0 0 1 /end COMPU_METHOD
/begin CHARACTERISTIC EFMA_emix_dP_C "EFMA EGR mixer dP scaling" VALUE 0x00140014 /* @ECU_Address@EFMA_emix_dP_C@0x0100E608@ */ ECIPP_ALIGNMENT_FLOAT32_IEEE 10000000000 Compu_EFMA_emix_dP_C -10000000000 10000000000 /end CHARACTERISTIC
/begin COMPU_METHOD Compu_EFMA_emix_dP_C " " RAT_FUNC "%.1" "upsig * s^2 / g / L" COEFFS 0 0.000001 0 0 0 1 /end COMPU_METHOD
/begin CHARACTERISTIC EGRO_vlv_dP_C "EGRO to valve delta-P scaling" VALUE 0x00140048 /* @ECU_Address@EGRO_vlv_dP_C@0x0100E610@ */ ECIPP_ALIGNMENT_FLOAT32_IEEE 10000000000 Compu_EGRO_vlv_dP_C -10000000000 10000000000 /end CHARACTERISTIC
/begin COMPU_METHOD Compu_EGRO_vlv_dP_C " " RAT_FUNC "%.1" "upsig * s^2 / g / L" COEFFS 0 0.000001 0 0 0 1 /end COMPU_METHOD
/begin CHARACTERISTIC EFMA_map_dP_nom "EFMA to MAP nominal dP" VALUE 0x00140028 /* @ECU_Address@EFMA_map_dP_nom@0x0100E618@ */ ECIPP_ALIGNMENT_FLOAT32_IEEE 10000000000 Compu_EFMA_map_dP_nom -10000000000 10000000000 /end CHARACTERISTIC
/begin COMPU_METHOD Compu_EFMA_map_dP_nom " " RAT_FUNC "%.2" "psi" COEFFS 0 1 0 0 0 1 /end COMPU_METHOD
/begin CHARACTERISTIC EFMA_fmix_dP_nom "EFMA fuel mixer nominal dP" VALUE 0x00140020 /* @ECU_Address@EFMA_fmix_dP_nom@0x0100E620@ */ ECIPP_ALIGNMENT_FLOAT32_IEEE 10000000000 Compu_EFMA_fmix_dP_nom -10000000000 10000000000 /end CHARACTERISTIC
/begin COMPU_METHOD Compu_EFMA_fmix_dP_nom " " RAT_FUNC "%.2" "psi" COEFFS 0 1 0 0 0 1 /end COMPU_METHOD
/begin CHARACTERISTIC EFMA_emix_dP_nom "EFMA EGR mixer nominal dP" VALUE 0x00140018 /* @ECU_Address@EFMA_emix_dP_nom@0x0100E628@ */ ECIPP_ALIGNMENT_FLOAT32_IEEE 10000000000 Compu_EFMA_emix_dP_nom -10000000000 10000000000 /end CHARACTERISTIC
/begin COMPU_METHOD Compu_EFMA_emix_dP_nom " " RAT_FUNC "%.2" "psi" COEFFS 0 1 0 0 0 1 /end COMPU_METHOD
/begin CHARACTERISTIC EGRO_vlv_dP_nom "EGRO to valve nominal dP" VALUE 0x0014004c /* @ECU_Address@EGRO_vlv_dP_nom@0x0100E630@ */ ECIPP_ALIGNMENT_FLOAT32_IEEE 10000000000 Compu_EGRO_vlv_dP_nom -10000000000 10000000000 /end CHARACTERISTIC
/begin COMPU_METHOD Compu_EGRO_vlv_dP_nom " " RAT_FUNC "%.2" "psi" COEFFS 0 1 0 0 0 1 /end COMPU_METHOD
/begin CHARACTERISTIC EGR_clr_dP_nom "EGR cooler nominal dP" VALUE 0x00140070 /* @ECU_Address@EGR_clr_dP_nom@0x0100E638@ */ ECIPP_ALIGNMENT_FLOAT32_IEEE 10000000000 Compu_EGR_clr_dP_nom -10000000000 10000000000 /end CHARACTERISTIC
/begin COMPU_METHOD Compu_EGR_clr_dP_nom " " RAT_FUNC "%.2" "psi" COEFFS 0 1 0 0 0 1 /end COMPU_METHOD
/begin MEASUREMENT EFMA_map_dP "EFMA to MAP pressure drop" FLOAT32_IEEE Compu_EFMA_map_dP 0 0 -10000000000 10000000000 ECU_ADDRESS 0x0100E640 /end MEASUREMENT
/begin COMPU_METHOD Compu_EFMA_map_dP " " RAT_FUNC "%.2" "psi" COEFFS 0 1 0 0 0 1 /end COMPU_METHOD
/begin MEASUREMENT EFMA_fmix_dP "EFMA fuel mixer P drop" FLOAT32_IEEE Compu_EFMA_fmix_dP 0 0 -10000000000 10000000000 ECU_ADDRESS 0x0100E648 /end MEASUREMENT
/begin COMPU_METHOD Compu_EFMA_fmix_dP " " RAT_FUNC "%.2" "psi" COEFFS 0 1 0 0 0 1 /end COMPU_METHOD
/begin MEASUREMENT EFMA_emix_dP "EFMA EGR mixer P drop" FLOAT32_IEEE Compu_EFMA_emix_dP 0 0 -10000000000 10000000000 ECU_ADDRESS 0x0100E650 /end MEASUREMENT
/begin COMPU_METHOD Compu_EFMA_emix_dP " " RAT_FUNC "%.2" "psi" COEFFS 0 1 0 0 0 1 /end COMPU_METHOD
/begin MEASUREMENT EGRO_vlv_dP "EGRO to valve dP" FLOAT32_IEEE Compu_EGRO_vlv_dP 0 0 -10000000000 10000000000 ECU_ADDRESS 0x0100E658 /end MEASUREMENT
/begin COMPU_METHOD Compu_EGRO_vlv_dP " " RAT_FUNC "%.2" "psi" COEFFS 0 1 0 0 0 1 /end COMPU_METHOD
/begin MEASUREMENT EFMA_emix_P "EFMA EGR mixer Pout" FLOAT32_IEEE Compu_EFMA_emix_P 0 0 -10000000000 10000000000 ECU_ADDRESS 0x0100E660 /end MEASUREMENT
/begin COMPU_METHOD Compu_EFMA_emix_P " " RAT_FUNC "%.2" "psia" COEFFS 0 1 0 0 0 1 /end COMPU_METHOD
/begin MEASUREMENT EFMA_fmix_P "EFMA fuel mixer Pout" FLOAT32_IEEE Compu_EFMA_fmix_P 0 0 -10000000000 10000000000 ECU_ADDRESS 0x0100E668 /end MEASUREMENT
/begin COMPU_METHOD Compu_EFMA_fmix_P " " RAT_FUNC "%.2" "psia" COEFFS 0 1 0 0 0 1 /end COMPU_METHOD
/begin MEASUREMENT EGR_vent_Pout "EGR orifice assembly Pout" FLOAT32_IEEE Compu_EGR_vent_Pout 0 0 -10000000000 10000000000 ECU_ADDRESS 0x0100E670 /end MEASUREMENT
/begin COMPU_METHOD Compu_EGR_vent_Pout " " RAT_FUNC "%.2" "psia" COEFFS 0 1 0 0 0 1 /end COMPU_METHOD
/begin MEASUREMENT TOP "Throttle outlet pressure" UWORD Compu_TOP 0 0 0 255.99609375 ECU_ADDRESS 0x0100E678 /end MEASUREMENT
/begin COMPU_METHOD Compu_TOP " " RAT_FUNC "%.2" "psia" COEFFS 0 256 0 0 0 1 /end COMPU_METHOD
/begin CHARACTERISTIC EGR_TPSdP_Dz "EGR valve dP limiting TPSdP deadzone" VALUE 0x00140054 /* @ECU_Address@EGR_TPSdP_Dz@0x0100E688@ */ ECIPP_ALIGNMENT_FLOAT32_IEEE 10000000000 Compu_EGR_TPSdP_Dz -10000000000 10000000000 /end CHARACTERISTIC
/begin COMPU_METHOD Compu_EGR_TPSdP_Dz " " RAT_FUNC "%.2" "psi" COEFFS 0 1 0 0 0 1 /end COMPU_METHOD
/begin CHARACTERISTIC EGR_TPSdP_limiting "EGR valve dP limiting{EGR_TPSdP_limiting&0xff=0:Disabled}{EGR_TPSdP_limiting&0xff=1:Enabled}" VALUE 0x001409a9 /* @ECU_Address@EGR_TPSdP_limiting@0x0100E698@ */ ECIPP_ALIGNMENT_UBYTE 255 EGR_TPSdP_limiting_COMPU_VTAB 0 255 BIT_MASK 0xff /end CHARACTERISTIC
/begin COMPU_METHOD EGR_TPSdP_limiting_COMPU_VTAB "Verbal Table" TAB_VERB "%.0" "list" COMPU_TAB_REF EGR_TPSdP_limiting_COMPU_VTAB_REF /end COMPU_METHOD
/begin COMPU_VTAB EGR_TPSdP_limiting_COMPU_VTAB_REF "Verbal Table" TAB_VERB 2 0 "Disabled" 1 "Enabled" DEFAULT_VALUE "UNKNOWN" /end COMPU_VTAB
/begin CHARACTERISTIC EGRwr_mount_type "EGR UEGO mount type{EGRwr_mount_type&0xff=0:Remote Mount}{EGRwr_mount_type&0xff=1:Direct Mount}" VALUE 0x001409bc /* @ECU_Address@EGRwr_mount_type@0x0100E6A0@ */ ECIPP_ALIGNMENT_UBYTE 255 EGRwr_mount_type_COMPU_VTAB 0 255 BIT_MASK 0xff /end CHARACTERISTIC
/begin COMPU_METHOD EGRwr_mount_type_COMPU_VTAB "Verbal Table" TAB_VERB "%.0" "list" COMPU_TAB_REF EGRwr_mount_type_COMPU_VTAB_REF /end COMPU_METHOD
/begin COMPU_VTAB EGRwr_mount_type_COMPU_VTAB_REF "Verbal Table" TAB_VERB 2 0 "Remote Mount" 1 "Direct Mount" DEFAULT_VALUE "UNKNOWN" /end COMPU_VTAB
/begin CHARACTERISTIC ECT_nom "Nominal ECT" VALUE 0x001467bc /* @ECU_Address@ECT_nom@0x0100E6B0@ */ ECIPP_ALIGNMENT_UWORD 564 Compu_ECT_nom -460 563.984375 /end CHARACTERISTIC
/begin COMPU_METHOD Compu_ECT_nom " " RAT_FUNC "%.1" "deg F" COEFFS 0 64 29440 0 0 1 /end COMPU_METHOD
/begin CHARACTERISTIC ECT_nom_min "Nominal ECT threshold" VALUE 0x001467be /* @ECU_Address@ECT_nom_min@0x0100E6B8@ */ ECIPP_ALIGNMENT_UWORD 564 Compu_ECT_nom_min -460 563.984375 /end CHARACTERISTIC
/begin COMPU_METHOD Compu_ECT_nom_min " " RAT_FUNC "%.1" "deg F" COEFFS 0 64 29440 0 0 1 /end COMPU_METHOD
/begin CHARACTERISTIC ECTmon_diag_hyst "Maintain diag temp hysteresis" VALUE 0x001467cc /* @ECU_Address@ECTmon_diag_hyst@0x0100E6C0@ */ ECIPP_ALIGNMENT_UWORD 564 Compu_ECTmon_diag_hyst -460 563.984375 /end CHARACTERISTIC
/begin COMPU_METHOD Compu_ECTmon_diag_hyst " " RAT_FUNC "%.1" "deg F" COEFFS 0 64 29440 0 0 1 /end COMPU_METHOD
/begin CHARACTERISTIC ECTmon_AAT "Monitor enable air temperature" VALUE 0x001467c8 /* @ECU_Address@ECTmon_AAT@0x0100E6C8@ */ ECIPP_ALIGNMENT_UWORD 564 Compu_ECTmon_AAT -460 563.984375 /end CHARACTERISTIC
/begin COMPU_METHOD Compu_ECTmon_AAT " " RAT_FUNC "%.1" "deg F" COEFFS 0 64 29440 0 0 1 /end COMPU_METHOD
/begin CHARACTERISTIC ECTmon_delta "Monitor enable ECT increase" VALUE 0x001467ca /* @ECU_Address@ECTmon_delta@0x0100E6D0@ */ ECIPP_ALIGNMENT_UWORD 564 Compu_ECTmon_delta -460 563.984375 /end CHARACTERISTIC
/begin COMPU_METHOD Compu_ECTmon_delta " " RAT_FUNC "%.1" "deg F" COEFFS 0 64 29440 0 0 1 /end COMPU_METHOD
/begin MEASUREMENT ECT_diag_min "Diagnostics enable ECT" UWORD Compu_ECT_diag_min 0 0 -460 563.984375 ECU_ADDRESS 0x0100E750 /end MEASUREMENT
/begin COMPU_METHOD Compu_ECT_diag_min " " RAT_FUNC "%.1" "deg F" COEFFS 0 64 29440 0 0 1 /end COMPU_METHOD
/begin MEASUREMENT ECTmon_state "Monitor status{ECTmon_state&0xff=0:Inactive}{ECTmon_state&0xff=1:Disabled - ECT fault}{ECTmon_state&0xff=2:Disabled - AAT fault}{ECTmon_state&0xff=3:Disabled - Low AAT}{ECTmon_state&0xff=4:Disabled - Warm ECT}{ECTmon_state&0xff=5:Monitor start wait}{ECTmo" UBYTE ECTmon_state_COMPU_VTAB 0 0 0 255 ECU_ADDRESS 0x0100E760 BIT_MASK 0xff /end MEASUREMENT
/begin COMPU_METHOD ECTmon_state_COMPU_VTAB "Verbal Table" TAB_VERB "%.0" "list" COMPU_TAB_REF ECTmon_state_COMPU_VTAB_REF /end COMPU_METHOD
/begin COMPU_VTAB ECTmon_state_COMPU_VTAB_REF "Verbal Table" TAB_VERB 7 0 "Inactive" 1 "Disabled - ECT fault" 2 "Disabled - AAT fault" 3 "Disabled - Low AAT" 4 "Disabled - Warm ECT" 5 "Monitor start wait" 6 "Active" DEFAULT_VALUE "UNKNOWN" /end COMPU_VTAB
/begin MEASUREMENT m_d_pct_cmd_dly "EGR transport-delayed command" UWORD Compu_m_d_pct_cmd_dly 0 0 0 399.993896484375 ECU_ADDRESS 0x0100E848 /end MEASUREMENT
/begin COMPU_METHOD Compu_m_d_pct_cmd_dly " " RAT_FUNC "%.1" "% dil" COEFFS 0 163.84 0 0 0 1 /end COMPU_METHOD
/begin MEASUREMENT fm_mon_ena "Fault monitor{fm_mon_ena&0xff=0:Disabled}{fm_mon_ena&0xff=1:Enabled}" UBYTE fm_mon_ena_COMPU_VTAB 0 0 0 255 ECU_ADDRESS 0x0100E908 BIT_MASK 0xff /end MEASUREMENT
/begin COMPU_METHOD fm_mon_ena_COMPU_VTAB "Verbal Table" TAB_VERB "%.0" "list" COMPU_TAB_REF fm_mon_ena_COMPU_VTAB_REF /end COMPU_METHOD
/begin COMPU_VTAB fm_mon_ena_COMPU_VTAB_REF "Verbal Table" TAB_VERB 2 0 "Disabled" 1 "Enabled" DEFAULT_VALUE "UNKNOWN" /end COMPU_VTAB
/begin MEASUREMENT fm_mon_fctl_ndx "Fault index" UWORD Compu_fm_mon_fctl_ndx 0 0 0 65535 ECU_ADDRESS 0x0100E910 /end MEASUREMENT
/begin COMPU_METHOD Compu_fm_mon_fctl_ndx " " RAT_FUNC "%.0" "-" COEFFS 0 1 0 0 0 1 /end COMPU_METHOD
/begin MEASUREMENT fm_mon_TF "Test failed{fm_mon_TF&0x01=0x00:No}{fm_mon_TF&0x01=0x01:Yes}" UBYTE fm_mon_TF_COMPU_VTAB 0 0 0 255 ECU_ADDRESS 0x0100E918 BIT_MASK 0x01 /end MEASUREMENT
/begin COMPU_METHOD fm_mon_TF_COMPU_VTAB "Verbal Table" TAB_VERB "%.0" "list" COMPU_TAB_REF fm_mon_TF_COMPU_VTAB_REF /end COMPU_METHOD
/begin COMPU_VTAB fm_mon_TF_COMPU_VTAB_REF "Verbal Table" TAB_VERB 2 0x00 "No" 0x01 "Yes" DEFAULT_VALUE "UNKNOWN" /end COMPU_VTAB
/begin MEASUREMENT fm_mon_TFTOC "Test failed this cycle{fm_mon_TFTOC&0x02=0x00:No}{fm_mon_TFTOC&0x02=0x02:Yes}" UBYTE fm_mon_TFTOC_COMPU_VTAB 0 0 0 255 ECU_ADDRESS 0x0100E920 BIT_MASK 0x02 /end MEASUREMENT
/begin COMPU_METHOD fm_mon_TFTOC_COMPU_VTAB "Verbal Table" TAB_VERB "%.0" "list" COMPU_TAB_REF fm_mon_TFTOC_COMPU_VTAB_REF /end COMPU_METHOD
/begin COMPU_VTAB fm_mon_TFTOC_COMPU_VTAB_REF "Verbal Table" TAB_VERB 2 0x00 "No" 0x02 "Yes" DEFAULT_VALUE "UNKNOWN" /end COMPU_VTAB
/begin MEASUREMENT fm_mon_PDTC "Pending DTC{fm_mon_PDTC&0x04=0x00:No}{fm_mon_PDTC&0x04=0x04:Yes}" UBYTE fm_mon_PDTC_COMPU_VTAB 0 0 0 255 ECU_ADDRESS 0x0100E928 BIT_MASK 0x04 /end MEASUREMENT
/begin COMPU_METHOD fm_mon_PDTC_COMPU_VTAB "Verbal Table" TAB_VERB "%.0" "list" COMPU_TAB_REF fm_mon_PDTC_COMPU_VTAB_REF /end COMPU_METHOD
/begin COMPU_VTAB fm_mon_PDTC_COMPU_VTAB_REF "Verbal Table" TAB_VERB 2 0x00 "No" 0x04 "Yes" DEFAULT_VALUE "UNKNOWN" /end COMPU_VTAB
/begin MEASUREMENT fm_mon_CDTC "Confirmed DTC{fm_mon_CDTC&0x08=0x00:No}{fm_mon_CDTC&0x08=0x08:Yes}" UBYTE fm_mon_CDTC_COMPU_VTAB 0 0 0 255 ECU_ADDRESS 0x0100E930 BIT_MASK 0x08 /end MEASUREMENT
/begin COMPU_METHOD fm_mon_CDTC_COMPU_VTAB "Verbal Table" TAB_VERB "%.0" "list" COMPU_TAB_REF fm_mon_CDTC_COMPU_VTAB_REF /end COMPU_METHOD
/begin COMPU_VTAB fm_mon_CDTC_COMPU_VTAB_REF "Verbal Table" TAB_VERB 2 0x00 "No" 0x08 "Yes" DEFAULT_VALUE "UNKNOWN" /end COMPU_VTAB
/begin MEASUREMENT fm_mon_TNCSLC "Test not completed since clear{fm_mon_TNCSLC&0x10=0x00:No}{fm_mon_TNCSLC&0x10=0x10:Yes}" UBYTE fm_mon_TNCSLC_COMPU_VTAB 0 0 0 255 ECU_ADDRESS 0x0100E938 BIT_MASK 0xFF /end MEASUREMENT
/begin COMPU_METHOD fm_mon_TNCSLC_COMPU_VTAB "Verbal Table" TAB_VERB "%.0" "list" COMPU_TAB_REF fm_mon_TNCSLC_COMPU_VTAB_REF /end COMPU_METHOD
/begin COMPU_VTAB fm_mon_TNCSLC_COMPU_VTAB_REF "Verbal Table" TAB_VERB 2 0x00 "No" 0x10 "Yes" DEFAULT_VALUE "Unsupported Bit_Shift" /end COMPU_VTAB
/begin MEASUREMENT fm_mon_TFSLC "Test failed since clear{fm_mon_TFSLC&0x20=0x00:No}{fm_mon_TFSLC&0x20=0x20:Yes}" UBYTE fm_mon_TFSLC_COMPU_VTAB 0 0 0 255 ECU_ADDRESS 0x0100E940 BIT_MASK 0x20 /end MEASUREMENT
/begin COMPU_METHOD fm_mon_TFSLC_COMPU_VTAB "Verbal Table" TAB_VERB "%.0" "list" COMPU_TAB_REF fm_mon_TFSLC_COMPU_VTAB_REF /end COMPU_METHOD
/begin COMPU_VTAB fm_mon_TFSLC_COMPU_VTAB_REF "Verbal Table" TAB_VERB 2 0x00 "No" 0x20 "Yes" DEFAULT_VALUE "UNKNOWN" /end COMPU_VTAB
/begin MEASUREMENT fm_mon_TNCTOC "Test not completed this cycle{fm_mon_TNCTOC&0x40=0x00:No}{fm_mon_TNCTOC&0x40=0x40:Yes}" UBYTE fm_mon_TNCTOC_COMPU_VTAB 0 0 0 255 ECU_ADDRESS 0x0100E948 BIT_MASK 0x40 /end MEASUREMENT
/begin COMPU_METHOD fm_mon_TNCTOC_COMPU_VTAB "Verbal Table" TAB_VERB "%.0" "list" COMPU_TAB_REF fm_mon_TNCTOC_COMPU_VTAB_REF /end COMPU_METHOD
/begin COMPU_VTAB fm_mon_TNCTOC_COMPU_VTAB_REF "Verbal Table" TAB_VERB 2 0x00 "No" 0x40 "Yes" DEFAULT_VALUE "UNKNOWN" /end COMPU_VTAB
/begin MEASUREMENT fm_mon_WIR "Warning indicator requested{fm_mon_WIR&0x80=0x00:No}{fm_mon_WIR&0x80=0x80:Yes}" UBYTE fm_mon_WIR_COMPU_VTAB 0 0 0 255 ECU_ADDRESS 0x0100E950 BIT_MASK 0xFF /end MEASUREMENT
/begin COMPU_METHOD fm_mon_WIR_COMPU_VTAB "Verbal Table" TAB_VERB "%.0" "list" COMPU_TAB_REF fm_mon_WIR_COMPU_VTAB_REF /end COMPU_METHOD
/begin COMPU_VTAB fm_mon_WIR_COMPU_VTAB_REF "Verbal Table" TAB_VERB 2 0x00 "No" 0x80 "Yes" DEFAULT_VALUE "Unsupported Bit_Shift" /end COMPU_VTAB
/begin MEASUREMENT fm_mon_potential "Potential{fm_mon_potential&0xff=0:No}{fm_mon_potential&0xff=1:Yes}" UBYTE fm_mon_potential_COMPU_VTAB 0 0 0 255 ECU_ADDRESS 0x0100E958 BIT_MASK 0xff /end MEASUREMENT
/begin COMPU_METHOD fm_mon_potential_COMPU_VTAB "Verbal Table" TAB_VERB "%.0" "list" COMPU_TAB_REF fm_mon_potential_COMPU_VTAB_REF /end COMPU_METHOD
/begin COMPU_VTAB fm_mon_potential_COMPU_VTAB_REF "Verbal Table" TAB_VERB 2 0 "No" 1 "Yes" DEFAULT_VALUE "UNKNOWN" /end COMPU_VTAB
/begin MEASUREMENT fm_mon_pending "Pending{fm_mon_pending&0xff=0:No}{fm_mon_pending&0xff=1:Yes}" UBYTE fm_mon_pending_COMPU_VTAB 0 0 0 255 ECU_ADDRESS 0x0100E960 BIT_MASK 0xff /end MEASUREMENT
/begin COMPU_METHOD fm_mon_pending_COMPU_VTAB "Verbal Table" TAB_VERB "%.0" "list" COMPU_TAB_REF fm_mon_pending_COMPU_VTAB_REF /end COMPU_METHOD
/begin COMPU_VTAB fm_mon_pending_COMPU_VTAB_REF "Verbal Table" TAB_VERB 2 0 "No" 1 "Yes" DEFAULT_VALUE "UNKNOWN" /end COMPU_VTAB
/begin MEASUREMENT fm_mon_confact "Confirmed active{fm_mon_confact&0xff=0:No}{fm_mon_confact&0xff=1:Yes}" UBYTE fm_mon_confact_COMPU_VTAB 0 0 0 255 ECU_ADDRESS 0x0100E968 BIT_MASK 0xff /end MEASUREMENT
/begin COMPU_METHOD fm_mon_confact_COMPU_VTAB "Verbal Table" TAB_VERB "%.0" "list" COMPU_TAB_REF fm_mon_confact_COMPU_VTAB_REF /end COMPU_METHOD
/begin COMPU_VTAB fm_mon_confact_COMPU_VTAB_REF "Verbal Table" TAB_VERB 2 0 "No" 1 "Yes" DEFAULT_VALUE "UNKNOWN" /end COMPU_VTAB
/begin MEASUREMENT fm_mon_prevact "Previously active{fm_mon_prevact&0xff=0:No}{fm_mon_prevact&0xff=1:Yes}" UBYTE fm_mon_prevact_COMPU_VTAB 0 0 0 255 ECU_ADDRESS 0x0100E970 BIT_MASK 0xff /end MEASUREMENT
/begin COMPU_METHOD fm_mon_prevact_COMPU_VTAB "Verbal Table" TAB_VERB "%.0" "list" COMPU_TAB_REF fm_mon_prevact_COMPU_VTAB_REF /end COMPU_METHOD
/begin COMPU_VTAB fm_mon_prevact_COMPU_VTAB_REF "Verbal Table" TAB_VERB 2 0 "No" 1 "Yes" DEFAULT_VALUE "UNKNOWN" /end COMPU_VTAB
/begin MEASUREMENT fm_mon_permanent "Permanent{fm_mon_permanent&0xff=0:No}{fm_mon_permanent&0xff=1:Yes}" UBYTE fm_mon_permanent_COMPU_VTAB 0 0 0 255 ECU_ADDRESS 0x0100E978 BIT_MASK 0xff /end MEASUREMENT
/begin COMPU_METHOD fm_mon_permanent_COMPU_VTAB "Verbal Table" TAB_VERB "%.0" "list" COMPU_TAB_REF fm_mon_permanent_COMPU_VTAB_REF /end COMPU_METHOD
/begin COMPU_VTAB fm_mon_permanent_COMPU_VTAB_REF "Verbal Table" TAB_VERB 2 0 "No" 1 "Yes" DEFAULT_VALUE "UNKNOWN" /end COMPU_VTAB
/begin MEASUREMENT fm_mon_mil_type "MIL state{fm_mon_mil_type&0xff=0:Off}{fm_mon_mil_type&0xff=1:On-demand}{fm_mon_mil_type&0xff=2:Short}{fm_mon_mil_type&0xff=3:Continuous}" UBYTE fm_mon_mil_type_COMPU_VTAB 0 0 0 255 ECU_ADDRESS 0x0100E980 BIT_MASK 0xff /end MEASUREMENT
/begin COMPU_METHOD fm_mon_mil_type_COMPU_VTAB "Verbal Table" TAB_VERB "%.0" "list" COMPU_TAB_REF fm_mon_mil_type_COMPU_VTAB_REF /end COMPU_METHOD
/begin COMPU_VTAB fm_mon_mil_type_COMPU_VTAB_REF "Verbal Table" TAB_VERB 4 0 "Off" 1 "On-demand" 2 "Short" 3 "Continuous" DEFAULT_VALUE "UNKNOWN" /end COMPU_VTAB
/begin MEASUREMENT fm_mon_mil_cnt "MIL countdown" UBYTE Compu_fm_mon_mil_cnt 0 0 0 255 ECU_ADDRESS 0x0100E988 /end MEASUREMENT
/begin COMPU_METHOD Compu_fm_mon_mil_cnt " " RAT_FUNC "%.0" "cycles" COEFFS 0 1 0 0 0 1 /end COMPU_METHOD
/begin MEASUREMENT fm_mon_cycles_cnt "Cycles as prev active" UBYTE Compu_fm_mon_cycles_cnt 0 0 0 255 ECU_ADDRESS 0x0100E990 /end MEASUREMENT
/begin COMPU_METHOD Compu_fm_mon_cycles_cnt " " RAT_FUNC "%.0" "cycles" COEFFS 0 1 0 0 0 1 /end COMPU_METHOD
/begin MEASUREMENT fm_mon_sec_prevact "Engine hours as prev active" ULONG Compu_fm_mon_sec_prevact 0 0 0 1193046.47083333 ECU_ADDRESS 0x0100E998 /end MEASUREMENT
/begin COMPU_METHOD Compu_fm_mon_sec_prevact " " RAT_FUNC "%.2" "hours" COEFFS 0 3600 0 0 0 1 /end COMPU_METHOD
/begin MEASUREMENT fm_mon_act_cnt "Fault counter" UWORD Compu_fm_mon_act_cnt 0 0 0 99.9984741210938 ECU_ADDRESS 0x0100EE50 /end MEASUREMENT
/begin COMPU_METHOD Compu_fm_mon_act_cnt " " RAT_FUNC "%.1" "%" COEFFS 0 655.36 0 0 0 1 /end COMPU_METHOD
/begin MEASUREMENT fm_mon_con_cnt "Diagnostic conclusion" UWORD Compu_fm_mon_con_cnt 0 0 0 99.9984741210938 ECU_ADDRESS 0x0100EE58 /end MEASUREMENT
/begin COMPU_METHOD Compu_fm_mon_con_cnt " " RAT_FUNC "%.1" "%" COEFFS 0 655.36 0 0 0 1 /end COMPU_METHOD
/begin CHARACTERISTIC COT_hi_hyst "COT high fault hysteresis" VALUE 0x00146760 /* @ECU_Address@COT_hi_hyst@0x0100EE90@ */ ECIPP_ALIGNMENT_UWORD 7732 Compu_COT_hi_hyst -460 7731.875 /end CHARACTERISTIC
/begin COMPU_METHOD Compu_COT_hi_hyst " " RAT_FUNC "%.1" "deg F" COEFFS 0 8 3680 0 0 1 /end COMPU_METHOD
/begin MEASUREMENT TIAT "Throttle inlet temperature" UWORD Compu_TIAT 0 0 -460 7731.875 ECU_ADDRESS 0x0100EF08 /end MEASUREMENT
/begin COMPU_METHOD Compu_TIAT " " RAT_FUNC "%.1" "deg F" COEFFS 0 8 3680 0 0 1 /end COMPU_METHOD
/begin MEASUREMENT mdot_EGR_min "EGR min table requested flow" UWORD Compu_mdot_EGR_min 0 0 0 1023.984375 ECU_ADDRESS 0x0100EFD0 /end MEASUREMENT
/begin COMPU_METHOD Compu_mdot_EGR_min " " RAT_FUNC "%.2" "g/sec" COEFFS 0 64 0 0 0 1 /end COMPU_METHOD
/begin MEASUREMENT mdot_EGR_nom "EGR nom table requested flow" UWORD Compu_mdot_EGR_nom 0 0 0 1023.984375 ECU_ADDRESS 0x0100EFD8 /end MEASUREMENT
/begin COMPU_METHOD Compu_mdot_EGR_nom " " RAT_FUNC "%.2" "g/sec" COEFFS 0 64 0 0 0 1 /end COMPU_METHOD
/begin CHARACTERISTIC EGRfb_minnom_MAF "EGR feedback based min/nom operation" VALUE 0x001401ea /* @ECU_Address@EGRfb_minnom_MAF@0x0100F348@ */ ECIPP_ALIGNMENT_SWORD 2 Compu_EGRfb_minnom_MAF -2 1.99993896484375 /end CHARACTERISTIC
/begin COMPU_METHOD Compu_EGRfb_minnom_MAF " " RAT_FUNC "%.2" "frac" COEFFS 0 16384 0 0 0 1 /end COMPU_METHOD
/begin CHARACTERISTIC EGRfb_minnom_dP "EGR feedback based min/nom operation" VALUE 0x001401ee /* @ECU_Address@EGRfb_minnom_dP@0x0100F350@ */ ECIPP_ALIGNMENT_SWORD 2 Compu_EGRfb_minnom_dP -2 1.99993896484375 /end CHARACTERISTIC
/begin COMPU_METHOD Compu_EGRfb_minnom_dP " " RAT_FUNC "%.2" "frac" COEFFS 0 16384 0 0 0 1 /end COMPU_METHOD
/begin CHARACTERISTIC EGRfb_minnom_UEGO "EGR feedback based min/nom operation" VALUE 0x001401ec /* @ECU_Address@EGRfb_minnom_UEGO@0x0100F358@ */ ECIPP_ALIGNMENT_SWORD 2 Compu_EGRfb_minnom_UEGO -2 1.99993896484375 /end CHARACTERISTIC
/begin COMPU_METHOD Compu_EGRfb_minnom_UEGO " " RAT_FUNC "%.2" "frac" COEFFS 0 16384 0 0 0 1 /end COMPU_METHOD
/begin CHARACTERISTIC EGRfb_LL_openloop "EGR feedback based load-limit - open-loop" VALUE 0x00140924 /* @ECU_Address@EGRfb_LL_openloop@0x0100F360@ */ ECIPP_ALIGNMENT_UWORD 100 Compu_EGRfb_LL_openloop 0 99.9984741210938 /end CHARACTERISTIC
/begin COMPU_METHOD Compu_EGRfb_LL_openloop " " RAT_FUNC "%.1" "%" COEFFS 0 655.36 0 0 0 1 /end COMPU_METHOD
/begin CHARACTERISTIC EGRfb_LL_MAF "EGR feedback based load-limit - MAF" VALUE 0x0014091e /* @ECU_Address@EGRfb_LL_MAF@0x0100F368@ */ ECIPP_ALIGNMENT_UWORD 100 Compu_EGRfb_LL_MAF 0 99.9984741210938 /end CHARACTERISTIC
/begin COMPU_METHOD Compu_EGRfb_LL_MAF " " RAT_FUNC "%.1" "%" COEFFS 0 655.36 0 0 0 1 /end COMPU_METHOD
/begin CHARACTERISTIC EGRfb_LL_dP "EGR feedback based load-limit - dP" VALUE 0x00140922 /* @ECU_Address@EGRfb_LL_dP@0x0100F370@ */ ECIPP_ALIGNMENT_UWORD 100 Compu_EGRfb_LL_dP 0 99.9984741210938 /end CHARACTERISTIC
/begin COMPU_METHOD Compu_EGRfb_LL_dP " " RAT_FUNC "%.1" "%" COEFFS 0 655.36 0 0 0 1 /end COMPU_METHOD
/begin CHARACTERISTIC EGRfb_LL_UEGO "EGR feedback based load-limit - UEGO" VALUE 0x00140920 /* @ECU_Address@EGRfb_LL_UEGO@0x0100F378@ */ ECIPP_ALIGNMENT_UWORD 100 Compu_EGRfb_LL_UEGO 0 99.9984741210938 /end CHARACTERISTIC
/begin COMPU_METHOD Compu_EGRfb_LL_UEGO " " RAT_FUNC "%.1" "%" COEFFS 0 655.36 0 0 0 1 /end COMPU_METHOD
/begin MEASUREMENT m_d_pct_cmdmdl "EGR diluent modeled - command" SWORD Compu_m_d_pct_cmdmdl 0 0 -200 199.993896484375 ECU_ADDRESS 0x0100F380 /end MEASUREMENT
/begin COMPU_METHOD Compu_m_d_pct_cmdmdl " " RAT_FUNC "%.1" "%" COEFFS 0 163.84 0 0 0 1 /end COMPU_METHOD
/begin MEASUREMENT EGR_minnom_derate "Min/Nom derate request" SWORD Compu_EGR_minnom_derate 0 0 -2 1.99993896484375 ECU_ADDRESS 0x0100F388 /end MEASUREMENT
/begin COMPU_METHOD Compu_EGR_minnom_derate " " RAT_FUNC "%.2" "-" COEFFS 0 16384 0 0 0 1 /end COMPU_METHOD
/begin MEASUREMENT EGR_minnom_FB "Min/Nom FB type request" SWORD Compu_EGR_minnom_FB 0 0 -2 1.99993896484375 ECU_ADDRESS 0x0100F390 /end MEASUREMENT
/begin COMPU_METHOD Compu_EGR_minnom_FB " " RAT_FUNC "%.2" "-" COEFFS 0 16384 0 0 0 1 /end COMPU_METHOD
/begin MEASUREMENT fault_maxact_pct0 "Max active percent 0" UWORD Compu_fault_maxact_pct0 0 0 0 399.993896484375 ECU_ADDRESS 0x0100F470 /end MEASUREMENT
/begin COMPU_METHOD Compu_fault_maxact_pct0 " " RAT_FUNC "%.1" "%" COEFFS 0 163.84 0 0 0 1 /end COMPU_METHOD
/begin MEASUREMENT fault_maxact_pct1 "Max active percent 1" UWORD Compu_fault_maxact_pct1 0 0 0 399.993896484375 ECU_ADDRESS 0x0100F478 /end MEASUREMENT
/begin COMPU_METHOD Compu_fault_maxact_pct1 " " RAT_FUNC "%.1" "%" COEFFS 0 163.84 0 0 0 1 /end COMPU_METHOD
/begin MEASUREMENT fault_maxact_pct2 "Max active percent 2" UWORD Compu_fault_maxact_pct2 0 0 0 399.993896484375 ECU_ADDRESS 0x0100F480 /end MEASUREMENT
/begin COMPU_METHOD Compu_fault_maxact_pct2 " " RAT_FUNC "%.1" "%" COEFFS 0 163.84 0 0 0 1 /end COMPU_METHOD
/begin MEASUREMENT fault_maxact_pct3 "Max active percent 3" UWORD Compu_fault_maxact_pct3 0 0 0 399.993896484375 ECU_ADDRESS 0x0100F488 /end MEASUREMENT
/begin COMPU_METHOD Compu_fault_maxact_pct3 " " RAT_FUNC "%.1" "%" COEFFS 0 163.84 0 0 0 1 /end COMPU_METHOD
/begin MEASUREMENT fault_maxact_pct4 "Max active percent 4" UWORD Compu_fault_maxact_pct4 0 0 0 399.993896484375 ECU_ADDRESS 0x0100F490 /end MEASUREMENT
/begin COMPU_METHOD Compu_fault_maxact_pct4 " " RAT_FUNC "%.1" "%" COEFFS 0 163.84 0 0 0 1 /end COMPU_METHOD
/begin MEASUREMENT fault_maxact_pct5 "Max active percent 5" UWORD Compu_fault_maxact_pct5 0 0 0 399.993896484375 ECU_ADDRESS 0x0100F498 /end MEASUREMENT
/begin COMPU_METHOD Compu_fault_maxact_pct5 " " RAT_FUNC "%.1" "%" COEFFS 0 163.84 0 0 0 1 /end COMPU_METHOD
/begin MEASUREMENT fault_maxact_pct6 "Max active percent 6" UWORD Compu_fault_maxact_pct6 0 0 0 399.993896484375 ECU_ADDRESS 0x0100F4A0 /end MEASUREMENT
/begin COMPU_METHOD Compu_fault_maxact_pct6 " " RAT_FUNC "%.1" "%" COEFFS 0 163.84 0 0 0 1 /end COMPU_METHOD
/begin MEASUREMENT fault_maxact_pct7 "Max active percent 7" UWORD Compu_fault_maxact_pct7 0 0 0 399.993896484375 ECU_ADDRESS 0x0100F4A8 /end MEASUREMENT
/begin COMPU_METHOD Compu_fault_maxact_pct7 " " RAT_FUNC "%.1" "%" COEFFS 0 163.84 0 0 0 1 /end COMPU_METHOD
/begin MEASUREMENT fault_maxact_flt0 "Max active fault 0" UWORD Compu_fault_maxact_flt0 0 0 0 65535 ECU_ADDRESS 0x0100F4B0 /end MEASUREMENT
/begin COMPU_METHOD Compu_fault_maxact_flt0 " " RAT_FUNC "%.0" "fault index" COEFFS 0 1 0 0 0 1 /end COMPU_METHOD
/begin MEASUREMENT fault_maxact_flt1 "Max active fault 1" UWORD Compu_fault_maxact_flt1 0 0 0 65535 ECU_ADDRESS 0x0100F4B8 /end MEASUREMENT
/begin COMPU_METHOD Compu_fault_maxact_flt1 " " RAT_FUNC "%.0" "fault index" COEFFS 0 1 0 0 0 1 /end COMPU_METHOD
/begin MEASUREMENT fault_maxact_flt2 "Max active fault 2" UWORD Compu_fault_maxact_flt2 0 0 0 65535 ECU_ADDRESS 0x0100F4C0 /end MEASUREMENT
/begin COMPU_METHOD Compu_fault_maxact_flt2 " " RAT_FUNC "%.0" "fault index" COEFFS 0 1 0 0 0 1 /end COMPU_METHOD
/begin MEASUREMENT fault_maxact_flt3 "Max active fault 3" UWORD Compu_fault_maxact_flt3 0 0 0 65535 ECU_ADDRESS 0x0100F4C8 /end MEASUREMENT
/begin COMPU_METHOD Compu_fault_maxact_flt3 " " RAT_FUNC "%.0" "fault index" COEFFS 0 1 0 0 0 1 /end COMPU_METHOD
/begin MEASUREMENT fault_maxact_flt4 "Max active fault 4" UWORD Compu_fault_maxact_flt4 0 0 0 65535 ECU_ADDRESS 0x0100F4D0 /end MEASUREMENT
/begin COMPU_METHOD Compu_fault_maxact_flt4 " " RAT_FUNC "%.0" "fault index" COEFFS 0 1 0 0 0 1 /end COMPU_METHOD
/begin MEASUREMENT fault_maxact_flt5 "Max active fault 5" UWORD Compu_fault_maxact_flt5 0 0 0 65535 ECU_ADDRESS 0x0100F4D8 /end MEASUREMENT
/begin COMPU_METHOD Compu_fault_maxact_flt5 " " RAT_FUNC "%.0" "fault index" COEFFS 0 1 0 0 0 1 /end COMPU_METHOD
/begin MEASUREMENT fault_maxact_flt6 "Max active fault 6" UWORD Compu_fault_maxact_flt6 0 0 0 65535 ECU_ADDRESS 0x0100F4E0 /end MEASUREMENT
/begin COMPU_METHOD Compu_fault_maxact_flt6 " " RAT_FUNC "%.0" "fault index" COEFFS 0 1 0 0 0 1 /end COMPU_METHOD
/begin MEASUREMENT fault_maxact_flt7 "Max active fault 7" UWORD Compu_fault_maxact_flt7 0 0 0 65535 ECU_ADDRESS 0x0100F4E8 /end MEASUREMENT
/begin COMPU_METHOD Compu_fault_maxact_flt7 " " RAT_FUNC "%.0" "fault index" COEFFS 0 1 0 0 0 1 /end COMPU_METHOD
/begin MEASUREMENT fault_maxact_valid "Max active fault status{fault_maxact_valid&0xff=0:Reset}{fault_maxact_valid&0xff=1:Tracking}" UBYTE fault_maxact_valid_COMPU_VTAB 0 0 0 255 ECU_ADDRESS 0x0100F4F0 BIT_MASK 0xff /end MEASUREMENT
/begin COMPU_METHOD fault_maxact_valid_COMPU_VTAB "Verbal Table" TAB_VERB "%.0" "list" COMPU_TAB_REF fault_maxact_valid_COMPU_VTAB_REF /end COMPU_METHOD
/begin COMPU_VTAB fault_maxact_valid_COMPU_VTAB_REF "Verbal Table" TAB_VERB 2 0 "Reset" 1 "Tracking" DEFAULT_VALUE "UNKNOWN" /end COMPU_VTAB
/begin MEASUREMENT fault_maxact_pct8 "Max active percent 8" UWORD Compu_fault_maxact_pct8 0 0 0 399.993896484375 ECU_ADDRESS 0x0100F690 /end MEASUREMENT
/begin COMPU_METHOD Compu_fault_maxact_pct8 " " RAT_FUNC "%.1" "%" COEFFS 0 163.84 0 0 0 1 /end COMPU_METHOD
/begin MEASUREMENT fault_maxact_pct9 "Max active percent 9" UWORD Compu_fault_maxact_pct9 0 0 0 399.993896484375 ECU_ADDRESS 0x0100F698 /end MEASUREMENT
/begin COMPU_METHOD Compu_fault_maxact_pct9 " " RAT_FUNC "%.1" "%" COEFFS 0 163.84 0 0 0 1 /end COMPU_METHOD
/begin MEASUREMENT fault_maxact_pct10 "Max active percent 10" UWORD Compu_fault_maxact_pct10 0 0 0 399.993896484375 ECU_ADDRESS 0x0100F6A0 /end MEASUREMENT
/begin COMPU_METHOD Compu_fault_maxact_pct10 " " RAT_FUNC "%.1" "%" COEFFS 0 163.84 0 0 0 1 /end COMPU_METHOD
/begin MEASUREMENT fault_maxact_pct11 "Max active percent 11" UWORD Compu_fault_maxact_pct11 0 0 0 399.993896484375 ECU_ADDRESS 0x0100F6A8 /end MEASUREMENT
/begin COMPU_METHOD Compu_fault_maxact_pct11 " " RAT_FUNC "%.1" "%" COEFFS 0 163.84 0 0 0 1 /end COMPU_METHOD
/begin MEASUREMENT fault_maxact_pct12 "Max active percent 12" UWORD Compu_fault_maxact_pct12 0 0 0 399.993896484375 ECU_ADDRESS 0x0100F6B0 /end MEASUREMENT
/begin COMPU_METHOD Compu_fault_maxact_pct12 " " RAT_FUNC "%.1" "%" COEFFS 0 163.84 0 0 0 1 /end COMPU_METHOD
/begin MEASUREMENT fault_maxact_pct13 "Max active percent 13" UWORD Compu_fault_maxact_pct13 0 0 0 399.993896484375 ECU_ADDRESS 0x0100F6B8 /end MEASUREMENT
/begin COMPU_METHOD Compu_fault_maxact_pct13 " " RAT_FUNC "%.1" "%" COEFFS 0 163.84 0 0 0 1 /end COMPU_METHOD
/begin MEASUREMENT fault_maxact_pct14 "Max active percent 14" UWORD Compu_fault_maxact_pct14 0 0 0 399.993896484375 ECU_ADDRESS 0x0100F6C0 /end MEASUREMENT
/begin COMPU_METHOD Compu_fault_maxact_pct14 " " RAT_FUNC "%.1" "%" COEFFS 0 163.84 0 0 0 1 /end COMPU_METHOD
/begin MEASUREMENT fault_maxact_pct15 "Max active percent 15" UWORD Compu_fault_maxact_pct15 0 0 0 399.993896484375 ECU_ADDRESS 0x0100F6C8 /end MEASUREMENT
/begin COMPU_METHOD Compu_fault_maxact_pct15 " " RAT_FUNC "%.1" "%" COEFFS 0 163.84 0 0 0 1 /end COMPU_METHOD
/begin MEASUREMENT fault_maxact_pct16 "Max active percent 16" UWORD Compu_fault_maxact_pct16 0 0 0 399.993896484375 ECU_ADDRESS 0x0100F6D0 /end MEASUREMENT
/begin COMPU_METHOD Compu_fault_maxact_pct16 " " RAT_FUNC "%.1" "%" COEFFS 0 163.84 0 0 0 1 /end COMPU_METHOD
/begin MEASUREMENT fault_maxact_pct17 "Max active percent 17" UWORD Compu_fault_maxact_pct17 0 0 0 399.993896484375 ECU_ADDRESS 0x0100F6D8 /end MEASUREMENT
/begin COMPU_METHOD Compu_fault_maxact_pct17 " " RAT_FUNC "%.1" "%" COEFFS 0 163.84 0 0 0 1 /end COMPU_METHOD
/begin MEASUREMENT fault_maxact_pct18 "Max active percent 18" UWORD Compu_fault_maxact_pct18 0 0 0 399.993896484375 ECU_ADDRESS 0x0100F6E0 /end MEASUREMENT
/begin COMPU_METHOD Compu_fault_maxact_pct18 " " RAT_FUNC "%.1" "%" COEFFS 0 163.84 0 0 0 1 /end COMPU_METHOD
/begin MEASUREMENT fault_maxact_pct19 "Max active percent 19" UWORD Compu_fault_maxact_pct19 0 0 0 399.993896484375 ECU_ADDRESS 0x0100F6E8 /end MEASUREMENT
/begin COMPU_METHOD Compu_fault_maxact_pct19 " " RAT_FUNC "%.1" "%" COEFFS 0 163.84 0 0 0 1 /end COMPU_METHOD
/begin MEASUREMENT fault_maxact_pct20 "Max active percent 20" UWORD Compu_fault_maxact_pct20 0 0 0 399.993896484375 ECU_ADDRESS 0x0100F6F0 /end MEASUREMENT
/begin COMPU_METHOD Compu_fault_maxact_pct20 " " RAT_FUNC "%.1" "%" COEFFS 0 163.84 0 0 0 1 /end COMPU_METHOD
/begin MEASUREMENT fault_maxact_pct21 "Max active percent 21" UWORD Compu_fault_maxact_pct21 0 0 0 399.993896484375 ECU_ADDRESS 0x0100F6F8 /end MEASUREMENT
/begin COMPU_METHOD Compu_fault_maxact_pct21 " " RAT_FUNC "%.1" "%" COEFFS 0 163.84 0 0 0 1 /end COMPU_METHOD
/begin MEASUREMENT fault_maxact_pct22 "Max active percent 22" UWORD Compu_fault_maxact_pct22 0 0 0 399.993896484375 ECU_ADDRESS 0x0100F700 /end MEASUREMENT
/begin COMPU_METHOD Compu_fault_maxact_pct22 " " RAT_FUNC "%.1" "%" COEFFS 0 163.84 0 0 0 1 /end COMPU_METHOD
/begin MEASUREMENT fault_maxact_pct23 "Max active percent 23" UWORD Compu_fault_maxact_pct23 0 0 0 399.993896484375 ECU_ADDRESS 0x0100F708 /end MEASUREMENT
/begin COMPU_METHOD Compu_fault_maxact_pct23 " " RAT_FUNC "%.1" "%" COEFFS 0 163.84 0 0 0 1 /end COMPU_METHOD
/begin MEASUREMENT fault_maxact_pct24 "Max active percent 24" UWORD Compu_fault_maxact_pct24 0 0 0 399.993896484375 ECU_ADDRESS 0x0100F710 /end MEASUREMENT
/begin COMPU_METHOD Compu_fault_maxact_pct24 " " RAT_FUNC "%.1" "%" COEFFS 0 163.84 0 0 0 1 /end COMPU_METHOD
/begin MEASUREMENT fault_maxact_pct25 "Max active percent 25" UWORD Compu_fault_maxact_pct25 0 0 0 399.993896484375 ECU_ADDRESS 0x0100F718 /end MEASUREMENT
/begin COMPU_METHOD Compu_fault_maxact_pct25 " " RAT_FUNC "%.1" "%" COEFFS 0 163.84 0 0 0 1 /end COMPU_METHOD
/begin MEASUREMENT fault_maxact_pct26 "Max active percent 26" UWORD Compu_fault_maxact_pct26 0 0 0 399.993896484375 ECU_ADDRESS 0x0100F720 /end MEASUREMENT
/begin COMPU_METHOD Compu_fault_maxact_pct26 " " RAT_FUNC "%.1" "%" COEFFS 0 163.84 0 0 0 1 /end COMPU_METHOD
/begin MEASUREMENT fault_maxact_pct27 "Max active percent 27" UWORD Compu_fault_maxact_pct27 0 0 0 399.993896484375 ECU_ADDRESS 0x0100F728 /end MEASUREMENT
/begin COMPU_METHOD Compu_fault_maxact_pct27 " " RAT_FUNC "%.1" "%" COEFFS 0 163.84 0 0 0 1 /end COMPU_METHOD
/begin MEASUREMENT fault_maxact_pct28 "Max active percent 28" UWORD Compu_fault_maxact_pct28 0 0 0 399.993896484375 ECU_ADDRESS 0x0100F730 /end MEASUREMENT
/begin COMPU_METHOD Compu_fault_maxact_pct28 " " RAT_FUNC "%.1" "%" COEFFS 0 163.84 0 0 0 1 /end COMPU_METHOD
/begin MEASUREMENT fault_maxact_pct29 "Max active percent 29" UWORD Compu_fault_maxact_pct29 0 0 0 399.993896484375 ECU_ADDRESS 0x0100F738 /end MEASUREMENT
/begin COMPU_METHOD Compu_fault_maxact_pct29 " " RAT_FUNC "%.1" "%" COEFFS 0 163.84 0 0 0 1 /end COMPU_METHOD
/begin MEASUREMENT fault_maxact_flt8 "Max active fault 8" UWORD Compu_fault_maxact_flt8 0 0 0 65535 ECU_ADDRESS 0x0100F740 /end MEASUREMENT
/begin COMPU_METHOD Compu_fault_maxact_flt8 " " RAT_FUNC "%.0" "fault index" COEFFS 0 1 0 0 0 1 /end COMPU_METHOD
/begin MEASUREMENT fault_maxact_flt9 "Max active fault 9" UWORD Compu_fault_maxact_flt9 0 0 0 65535 ECU_ADDRESS 0x0100F748 /end MEASUREMENT
/begin COMPU_METHOD Compu_fault_maxact_flt9 " " RAT_FUNC "%.0" "fault index" COEFFS 0 1 0 0 0 1 /end COMPU_METHOD
/begin MEASUREMENT fault_maxact_flt10 "Max active fault 10" UWORD Compu_fault_maxact_flt10 0 0 0 65535 ECU_ADDRESS 0x0100F750 /end MEASUREMENT
/begin COMPU_METHOD Compu_fault_maxact_flt10 " " RAT_FUNC "%.0" "fault index" COEFFS 0 1 0 0 0 1 /end COMPU_METHOD
/begin MEASUREMENT fault_maxact_flt11 "Max active fault 11" UWORD Compu_fault_maxact_flt11 0 0 0 65535 ECU_ADDRESS 0x0100F758 /end MEASUREMENT
/begin COMPU_METHOD Compu_fault_maxact_flt11 " " RAT_FUNC "%.0" "fault index" COEFFS 0 1 0 0 0 1 /end COMPU_METHOD
/begin MEASUREMENT fault_maxact_flt12 "Max active fault 12" UWORD Compu_fault_maxact_flt12 0 0 0 65535 ECU_ADDRESS 0x0100F760 /end MEASUREMENT
/begin COMPU_METHOD Compu_fault_maxact_flt12 " " RAT_FUNC "%.0" "fault index" COEFFS 0 1 0 0 0 1 /end COMPU_METHOD
/begin MEASUREMENT fault_maxact_flt13 "Max active fault 13" UWORD Compu_fault_maxact_flt13 0 0 0 65535 ECU_ADDRESS 0x0100F768 /end MEASUREMENT
/begin COMPU_METHOD Compu_fault_maxact_flt13 " " RAT_FUNC "%.0" "fault index" COEFFS 0 1 0 0 0 1 /end COMPU_METHOD
/begin MEASUREMENT fault_maxact_flt14 "Max active fault 14" UWORD Compu_fault_maxact_flt14 0 0 0 65535 ECU_ADDRESS 0x0100F770 /end MEASUREMENT
/begin COMPU_METHOD Compu_fault_maxact_flt14 " " RAT_FUNC "%.0" "fault index" COEFFS 0 1 0 0 0 1 /end COMPU_METHOD
/begin MEASUREMENT fault_maxact_flt15 "Max active fault 15" UWORD Compu_fault_maxact_flt15 0 0 0 65535 ECU_ADDRESS 0x0100F778 /end MEASUREMENT
/begin COMPU_METHOD Compu_fault_maxact_flt15 " " RAT_FUNC "%.0" "fault index" COEFFS 0 1 0 0 0 1 /end COMPU_METHOD
/begin MEASUREMENT fault_maxact_flt16 "Max active fault 16" UWORD Compu_fault_maxact_flt16 0 0 0 65535 ECU_ADDRESS 0x0100F780 /end MEASUREMENT
/begin COMPU_METHOD Compu_fault_maxact_flt16 " " RAT_FUNC "%.0" "fault index" COEFFS 0 1 0 0 0 1 /end COMPU_METHOD
/begin MEASUREMENT fault_maxact_flt17 "Max active fault 17" UWORD Compu_fault_maxact_flt17 0 0 0 65535 ECU_ADDRESS 0x0100F788 /end MEASUREMENT
/begin COMPU_METHOD Compu_fault_maxact_flt17 " " RAT_FUNC "%.0" "fault index" COEFFS 0 1 0 0 0 1 /end COMPU_METHOD
/begin MEASUREMENT fault_maxact_flt18 "Max active fault 18" UWORD Compu_fault_maxact_flt18 0 0 0 65535 ECU_ADDRESS 0x0100F790 /end MEASUREMENT
/begin COMPU_METHOD Compu_fault_maxact_flt18 " " RAT_FUNC "%.0" "fault index" COEFFS 0 1 0 0 0 1 /end COMPU_METHOD
/begin MEASUREMENT fault_maxact_flt19 "Max active fault 19" UWORD Compu_fault_maxact_flt19 0 0 0 65535 ECU_ADDRESS 0x0100F798 /end MEASUREMENT
/begin COMPU_METHOD Compu_fault_maxact_flt19 " " RAT_FUNC "%.0" "fault index" COEFFS 0 1 0 0 0 1 /end COMPU_METHOD
/begin MEASUREMENT fault_maxact_flt20 "Max active fault 20" UWORD Compu_fault_maxact_flt20 0 0 0 65535 ECU_ADDRESS 0x0100F7A0 /end MEASUREMENT
/begin COMPU_METHOD Compu_fault_maxact_flt20 " " RAT_FUNC "%.0" "fault index" COEFFS 0 1 0 0 0 1 /end COMPU_METHOD
/begin MEASUREMENT fault_maxact_flt21 "Max active fault 21" UWORD Compu_fault_maxact_flt21 0 0 0 65535 ECU_ADDRESS 0x0100F7A8 /end MEASUREMENT
/begin COMPU_METHOD Compu_fault_maxact_flt21 " " RAT_FUNC "%.0" "fault index" COEFFS 0 1 0 0 0 1 /end COMPU_METHOD
/begin MEASUREMENT fault_maxact_flt22 "Max active fault 22" UWORD Compu_fault_maxact_flt22 0 0 0 65535 ECU_ADDRESS 0x0100F7B0 /end MEASUREMENT
/begin COMPU_METHOD Compu_fault_maxact_flt22 " " RAT_FUNC "%.0" "fault index" COEFFS 0 1 0 0 0 1 /end COMPU_METHOD
/begin MEASUREMENT fault_maxact_flt23 "Max active fault 23" UWORD Compu_fault_maxact_flt23 0 0 0 65535 ECU_ADDRESS 0x0100F7B8 /end MEASUREMENT
/begin COMPU_METHOD Compu_fault_maxact_flt23 " " RAT_FUNC "%.0" "fault index" COEFFS 0 1 0 0 0 1 /end COMPU_METHOD
/begin MEASUREMENT fault_maxact_flt24 "Max active fault 24" UWORD Compu_fault_maxact_flt24 0 0 0 65535 ECU_ADDRESS 0x0100F7C0 /end MEASUREMENT
/begin COMPU_METHOD Compu_fault_maxact_flt24 " " RAT_FUNC "%.0" "fault index" COEFFS 0 1 0 0 0 1 /end COMPU_METHOD
/begin MEASUREMENT fault_maxact_flt25 "Max active fault 25" UWORD Compu_fault_maxact_flt25 0 0 0 65535 ECU_ADDRESS 0x0100F7C8 /end MEASUREMENT
/begin COMPU_METHOD Compu_fault_maxact_flt25 " " RAT_FUNC "%.0" "fault index" COEFFS 0 1 0 0 0 1 /end COMPU_METHOD
/begin MEASUREMENT fault_maxact_flt26 "Max active fault 26" UWORD Compu_fault_maxact_flt26 0 0 0 65535 ECU_ADDRESS 0x0100F7D0 /end MEASUREMENT
/begin COMPU_METHOD Compu_fault_maxact_flt26 " " RAT_FUNC "%.0" "fault index" COEFFS 0 1 0 0 0 1 /end COMPU_METHOD
/begin MEASUREMENT fault_maxact_flt27 "Max active fault 27" UWORD Compu_fault_maxact_flt27 0 0 0 65535 ECU_ADDRESS 0x0100F7D8 /end MEASUREMENT
/begin COMPU_METHOD Compu_fault_maxact_flt27 " " RAT_FUNC "%.0" "fault index" COEFFS 0 1 0 0 0 1 /end COMPU_METHOD
/begin MEASUREMENT fault_maxact_flt28 "Max active fault 28" UWORD Compu_fault_maxact_flt28 0 0 0 65535 ECU_ADDRESS 0x0100F7E0 /end MEASUREMENT
/begin COMPU_METHOD Compu_fault_maxact_flt28 " " RAT_FUNC "%.0" "fault index" COEFFS 0 1 0 0 0 1 /end COMPU_METHOD
/begin MEASUREMENT fault_maxact_flt29 "Max active fault 29" UWORD Compu_fault_maxact_flt29 0 0 0 65535 ECU_ADDRESS 0x0100F7E8 /end MEASUREMENT
/begin COMPU_METHOD Compu_fault_maxact_flt29 " " RAT_FUNC "%.0" "fault index" COEFFS 0 1 0 0 0 1 /end COMPU_METHOD
/begin CHARACTERISTIC EGRwrT_ena "EGR Wide Range Temperature{EGRwrT_ena&0xff=0:Disabled}{EGRwrT_ena&0xff=1:Aux PU1}{EGRwrT_ena&0xff=2:Aux PU2}{EGRwrT_ena&0xff=3:Aux PU3}{EGRwrT_ena&0xff=4:Aux PUD1}{EGRwrT_ena&0xff=5:Aux PUD2}{EGRwrT_ena&0xff=6:Aux PUD3}{EGRwrT_ena&0xff=7:EGT Input}{EGRwrT" VALUE 0x00147d2c /* @ECU_Address@EGRwrT_ena@0x0100F918@ */ ECIPP_ALIGNMENT_UBYTE 255 EGRwrT_ena_COMPU_VTAB 0 255 BIT_MASK 0xff /end CHARACTERISTIC
/begin COMPU_METHOD EGRwrT_ena_COMPU_VTAB "Verbal Table" TAB_VERB "%.0" "list" COMPU_TAB_REF EGRwrT_ena_COMPU_VTAB_REF /end COMPU_METHOD
/begin COMPU_VTAB EGRwrT_ena_COMPU_VTAB_REF "Verbal Table" TAB_VERB 31 0 "Disabled" 1 "Aux PU1" 2 "Aux PU2" 3 "Aux PU3" 4 "Aux PUD1" 5 "Aux PUD2" 6 "Aux PUD3" 7 "EGT Input" 8 "Aux PUD4" 9 "Aux PUD5" 10 "Aux PUD6" 11 "Aux PUD7" 12 "Aux PUD8" 13 "Aux PUD9" 14 "Aux PUD10" 15 "Aux PUD11" 16 "Aux PUD12" 17 "Aux PUD13" 18 "Aux PUD14" 19 "Aux PUD15" 20 "Aux PUD16" 21 "Aux PUD17" 22 "Aux PUD18" 23 "Aux PUD19" 24 "Aux PUD20" 25 "Aux PUD21" 26 "Aux PUD22" 27 "Aux PUD23" 28 "Aux PUD24" 29 "Aux PUD25" 30 "CAN sourced" DEFAULT_VALUE "UNKNOWN" /end COMPU_VTAB
/begin MEASUREMENT EGRwrT_float "EGR UEGO T" FLOAT32_IEEE Compu_EGRwrT_float 0 0 -10000000000 10000000000 ECU_ADDRESS 0x0100F930 /end MEASUREMENT
/begin COMPU_METHOD Compu_EGRwrT_float " " RAT_FUNC "%.2" "deg F" COEFFS 0 1 460 0 0 1 /end COMPU_METHOD
/begin CHARACTERISTIC EGRwr_UEGO_slew "EGR UEGO engage slew rate" VALUE 0x00146810 /* @ECU_Address@EGRwr_UEGO_slew@0x010102A0@ */ ECIPP_ALIGNMENT_UWORD 20000 Compu_EGRwr_UEGO_slew 0 19999.6948242188 /end CHARACTERISTIC
/begin COMPU_METHOD Compu_EGRwr_UEGO_slew " " RAT_FUNC "%.0" "%/sec" COEFFS 0 3.2768 0 0 0 1 /end COMPU_METHOD
/begin MEASUREMENT EGR_vent_Mx_mult "EGR orifice flow correction" SWORD Compu_EGR_vent_Mx_mult 0 0 -4 3.9998779296875 ECU_ADDRESS 0x01010710 /end MEASUREMENT
/begin COMPU_METHOD Compu_EGR_vent_Mx_mult " " RAT_FUNC "%.2" "mult" COEFFS 0 8192 0 0 0 1 /end COMPU_METHOD
/begin MEASUREMENT m_d_pct_act_dry "EGR diluent actual (dry)" FLOAT32_IEEE Compu_m_d_pct_act_dry 0 0 -10000000000 10000000000 ECU_ADDRESS 0x01010718 /end MEASUREMENT
/begin COMPU_METHOD Compu_m_d_pct_act_dry " " RAT_FUNC "%.2" "%" COEFFS 0 0.01 0 0 0 1 /end COMPU_METHOD
/begin CHARACTERISTIC EGRad_CL_K "EGR CL update gain" VALUE 0x0014008c /* @ECU_Address@EGRad_CL_K@0x01010770@ */ ECIPP_ALIGNMENT_FLOAT32_IEEE 10000000000 Compu_EGRad_CL_K -10000000000 10000000000 /end CHARACTERISTIC
/begin COMPU_METHOD Compu_EGRad_CL_K " " RAT_FUNC "%.2" "% / TD" COEFFS 0 0.01 0 0 0 1 /end COMPU_METHOD
/begin CHARACTERISTIC EGRad_CL_valid_cnt "EGR CL valid updates reqd" VALUE 0x001409b3 /* @ECU_Address@EGRad_CL_valid_cnt@0x01010778@ */ ECIPP_ALIGNMENT_UBYTE 255 Compu_EGRad_CL_valid_cnt 0 255 /end CHARACTERISTIC
/begin COMPU_METHOD Compu_EGRad_CL_valid_cnt " " RAT_FUNC "%.0" "updates" COEFFS 0 1 0 0 0 1 /end COMPU_METHOD
/begin CHARACTERISTIC EGRad_tran_dMAP "EGR CL disabling: MAP" VALUE 0x001401dc /* @ECU_Address@EGRad_tran_dMAP@0x01010780@ */ ECIPP_ALIGNMENT_SWORD 256 Compu_EGRad_tran_dMAP -256 255.9921875 /end CHARACTERISTIC
/begin COMPU_METHOD Compu_EGRad_tran_dMAP " " RAT_FUNC "%.1" "psia" COEFFS 0 128 0 0 0 1 /end COMPU_METHOD
/begin CHARACTERISTIC EGRad_tran_dmdpct "EGR CL disabling: diluent cmd" VALUE 0x001401de /* @ECU_Address@EGRad_tran_dmdpct@0x01010788@ */ ECIPP_ALIGNMENT_SWORD 400 Compu_EGRad_tran_dmdpct -400 399.98779296875 /end CHARACTERISTIC
/begin COMPU_METHOD Compu_EGRad_tran_dmdpct " " RAT_FUNC "%.2" "% diluent" COEFFS 0 81.92 0 0 0 1 /end COMPU_METHOD
/begin MEASUREMENT EGRad_CL_updates "EGR CL valid updates actual" UBYTE Compu_EGRad_CL_updates 0 0 0 255 ECU_ADDRESS 0x01010790 /end MEASUREMENT
/begin COMPU_METHOD Compu_EGRad_CL_updates " " RAT_FUNC "%.0" "updates" COEFFS 0 1 0 0 0 1 /end COMPU_METHOD
/begin CHARACTERISTIC EGR_TPSdP_tau_inc "EGR TPSdP inc low-pass" VALUE 0x00140060 /* @ECU_Address@EGR_TPSdP_tau_inc@0x01010798@ */ ECIPP_ALIGNMENT_FLOAT32_IEEE 10000000000 Compu_EGR_TPSdP_tau_inc -10000000000 10000000000 /end CHARACTERISTIC
/begin COMPU_METHOD Compu_EGR_TPSdP_tau_inc " " RAT_FUNC "%.0" "ms" COEFFS 0 1 0 0 0 1 /end COMPU_METHOD
/begin CHARACTERISTIC EGR_TPSdP_tau_dec "EGR TPSdP dec low-pass" VALUE 0x0014005c /* @ECU_Address@EGR_TPSdP_tau_dec@0x010107A0@ */ ECIPP_ALIGNMENT_FLOAT32_IEEE 10000000000 Compu_EGR_TPSdP_tau_dec -10000000000 10000000000 /end CHARACTERISTIC
/begin COMPU_METHOD Compu_EGR_TPSdP_tau_dec " " RAT_FUNC "%.1" "sec" COEFFS 0 1000 0 0 0 1 /end COMPU_METHOD
/begin CHARACTERISTIC EGR_TPSdP_Ktrans "EGR TPSdP flow cmd gain" VALUE 0x00140058 /* @ECU_Address@EGR_TPSdP_Ktrans@0x010107A8@ */ ECIPP_ALIGNMENT_FLOAT32_IEEE 10000000000 Compu_EGR_TPSdP_Ktrans -10000000000 10000000000 /end CHARACTERISTIC
/begin COMPU_METHOD Compu_EGR_TPSdP_Ktrans " " RAT_FUNC "%.2" "psi/(g/s^2)" COEFFS 0 1 0 0 0 1 /end COMPU_METHOD
/begin CHARACTERISTIC EGR_TPSdP_max "EGR TPSdP maximum" VALUE 0x001408b0 /* @ECU_Address@EGR_TPSdP_max@0x010107B0@ */ ECIPP_ALIGNMENT_UWORD 256 Compu_EGR_TPSdP_max 0 255.99609375 /end CHARACTERISTIC
/begin COMPU_METHOD Compu_EGR_TPSdP_max " " RAT_FUNC "%.2" "psi" COEFFS 0 256 0 0 0 1 /end COMPU_METHOD
/begin CHARACTERISTIC EGR_dmdot_cmd_n "EGR flow command dt window" VALUE 0x001409ad /* @ECU_Address@EGR_dmdot_cmd_n@0x010107B8@ */ ECIPP_ALIGNMENT_UBYTE 1275 Compu_EGR_dmdot_cmd_n 0 1275 /end CHARACTERISTIC
/begin COMPU_METHOD Compu_EGR_dmdot_cmd_n " " RAT_FUNC "%.0" "ms" COEFFS 0 0.2 0 0 0 1 /end COMPU_METHOD
/begin CHARACTERISTIC EGR_dmdot_cmd_tau "EGR flow command dt low-pass" VALUE 0x00140988 /* @ECU_Address@EGR_dmdot_cmd_tau@0x010107C0@ */ ECIPP_ALIGNMENT_UWORD 327680 Compu_EGR_dmdot_cmd_tau 0.45084 327680 /end CHARACTERISTIC
/begin COMPU_METHOD Compu_EGR_dmdot_cmd_tau " " FORM "%.0" "ms"
 /begin FORMULA "-5 / log(1 - (X1 / 65536))" FORMULA_INV "(1 - exp(-5/X1)) * 65536" /end FORMULA
/end COMPU_METHOD
/begin CHARACTERISTIC EGR_dmdot_cmd_dz "EGR flow command dt deadzone" VALUE 0x00140078 /* @ECU_Address@EGR_dmdot_cmd_dz@0x010107C8@ */ ECIPP_ALIGNMENT_FLOAT32_IEEE 10000000000 Compu_EGR_dmdot_cmd_dz -10000000000 10000000000 /end CHARACTERISTIC
/begin COMPU_METHOD Compu_EGR_dmdot_cmd_dz " " RAT_FUNC "%.1" "g/sec^2" COEFFS 0 1 0 0 0 1 /end COMPU_METHOD
/begin MEASUREMENT mdot_EGR_cmd "EGR commanded flow" FLOAT32_IEEE Compu_mdot_EGR_cmd 0 0 -10000000000 10000000000 ECU_ADDRESS 0x010107D0 /end MEASUREMENT
/begin COMPU_METHOD Compu_mdot_EGR_cmd " " RAT_FUNC "%.2" "g/sec" COEFFS 0 1 0 0 0 1 /end COMPU_METHOD
/begin MEASUREMENT EGR_dmdot_cmd "EGR flow derivative" FLOAT32_IEEE Compu_EGR_dmdot_cmd 0 0 -10000000000 10000000000 ECU_ADDRESS 0x010107D8 /end MEASUREMENT
/begin COMPU_METHOD Compu_EGR_dmdot_cmd " " RAT_FUNC "%.1" "g/sec^2" COEFFS 0 1 0 0 0 1 /end COMPU_METHOD
/begin CHARACTERISTIC EGRad_CL_Dz "EGR CL deadzone" VALUE 0x00140088 /* @ECU_Address@EGRad_CL_Dz@0x010107E0@ */ ECIPP_ALIGNMENT_FLOAT32_IEEE 10000000000 Compu_EGRad_CL_Dz -10000000000 10000000000 /end CHARACTERISTIC
/begin COMPU_METHOD Compu_EGRad_CL_Dz " " RAT_FUNC "%.2" "%" COEFFS 0 0.01 0 0 0 1 /end COMPU_METHOD
/begin MEASUREMENT VE_EGR_ofst "EGR VE offset" SWORD Compu_VE_EGR_ofst 0 0 -100 99.9969482421875 ECU_ADDRESS 0x010107E8 /end MEASUREMENT
/begin COMPU_METHOD Compu_VE_EGR_ofst " " RAT_FUNC "%.1" "%" COEFFS 0 327.68 0 0 0 1 /end COMPU_METHOD
/begin MEASUREMENT EGRdP_min "EGRdP minimum" SWORD Compu_EGRdP_min 0 0 -32 31.9990234375 ECU_ADDRESS 0x010107F0 /end MEASUREMENT
/begin COMPU_METHOD Compu_EGRdP_min " " RAT_FUNC "%.3" "psi" COEFFS 0 1024 0 0 0 1 /end COMPU_METHOD
/begin MEASUREMENT EGRdP_max "EGRdP maximum" SWORD Compu_EGRdP_max 0 0 -32 31.9990234375 ECU_ADDRESS 0x010107F8 /end MEASUREMENT
/begin COMPU_METHOD Compu_EGRdP_max " " RAT_FUNC "%.3" "psi" COEFFS 0 1024 0 0 0 1 /end COMPU_METHOD
/begin MEASUREMENT EGR_vlv_temp_est "Estimated EGR valve temperature" FLOAT32_IEEE Compu_EGR_vlv_temp_est 0 0 -10000000000 10000000000 ECU_ADDRESS 0x01010988 /end MEASUREMENT
/begin COMPU_METHOD Compu_EGR_vlv_temp_est " " RAT_FUNC "%.1" "deg C" COEFFS 0 1 0 0 0 1 /end COMPU_METHOD
/begin CHARACTERISTIC EGR_vlv_zero_dz "EGR valve zero deadzone" VALUE 0x0014680c /* @ECU_Address@EGR_vlv_zero_dz@0x01010998@ */ ECIPP_ALIGNMENT_UWORD 5 Compu_EGR_vlv_zero_dz 0 5.00114468864469 /end CHARACTERISTIC
/begin COMPU_METHOD Compu_EGR_vlv_zero_dz " " RAT_FUNC "%.3" "volts" COEFFS 0 13104 0 0 0 1 /end COMPU_METHOD
/begin CHARACTERISTIC EGR_vlv_dPos_max "EGR valve position delta max" VALUE 0x0014680a /* @ECU_Address@EGR_vlv_dPos_max@0x010109A0@ */ ECIPP_ALIGNMENT_UWORD 5 Compu_EGR_vlv_dPos_max 0 5.00114468864469 /end CHARACTERISTIC
/begin COMPU_METHOD Compu_EGR_vlv_dPos_max " " RAT_FUNC "%.3" "volts" COEFFS 0 13104 0 0 0 1 /end COMPU_METHOD
/begin CHARACTERISTIC CVdP_dP1_location "CV sensor location 1{CVdP_dP1_location&0xff=0:None}{CVdP_dP1_location&0xff=1:Clean Side}{CVdP_dP1_location&0xff=2:Dirty Side}{CVdP_dP1_location&0xff=3:Aux 1 pressure}{CVdP_dP1_location&0xff=4:Aux 2 pressure}" VALUE 0x00147d03 /* @ECU_Address@CVdP_dP1_location@0x01010CC0@ */ ECIPP_ALIGNMENT_UBYTE 255 CVdP_dP1_location_COMPU_VTAB 0 255 BIT_MASK 0xff /end CHARACTERISTIC
/begin COMPU_METHOD CVdP_dP1_location_COMPU_VTAB "Verbal Table" TAB_VERB "%.0" "list" COMPU_TAB_REF CVdP_dP1_location_COMPU_VTAB_REF /end COMPU_METHOD
/begin COMPU_VTAB CVdP_dP1_location_COMPU_VTAB_REF "Verbal Table" TAB_VERB 5 0 "None" 1 "Clean Side" 2 "Dirty Side" 3 "Aux 1 pressure" 4 "Aux 2 pressure" DEFAULT_VALUE "UNKNOWN" /end COMPU_VTAB
/begin CHARACTERISTIC CVdP_dP2_location "CV sensor location 2{CVdP_dP2_location&0xff=0:None}{CVdP_dP2_location&0xff=1:Clean Side}{CVdP_dP2_location&0xff=2:Dirty Side}{CVdP_dP2_location&0xff=3:Aux 1 pressure}{CVdP_dP2_location&0xff=4:Aux 2 pressure}" VALUE 0x00147d04 /* @ECU_Address@CVdP_dP2_location@0x01010CC8@ */ ECIPP_ALIGNMENT_UBYTE 255 CVdP_dP2_location_COMPU_VTAB 0 255 BIT_MASK 0xff /end CHARACTERISTIC
/begin COMPU_METHOD CVdP_dP2_location_COMPU_VTAB "Verbal Table" TAB_VERB "%.0" "list" COMPU_TAB_REF CVdP_dP2_location_COMPU_VTAB_REF /end COMPU_METHOD
/begin COMPU_VTAB CVdP_dP2_location_COMPU_VTAB_REF "Verbal Table" TAB_VERB 5 0 "None" 1 "Clean Side" 2 "Dirty Side" 3 "Aux 1 pressure" 4 "Aux 2 pressure" DEFAULT_VALUE "UNKNOWN" /end COMPU_VTAB
/begin MEASUREMENT CVdP_dP1_d "Expected pressure" SWORD Compu_CVdP_dP1_d 0 0 -32 31.9990234375 ECU_ADDRESS 0x01010D78 /end MEASUREMENT
/begin COMPU_METHOD Compu_CVdP_dP1_d " " RAT_FUNC "%.4" "psi" COEFFS 0 1024 0 0 0 1 /end COMPU_METHOD
/begin MEASUREMENT CVdP_dP2_d "Expected pressure" SWORD Compu_CVdP_dP2_d 0 0 -32 31.9990234375 ECU_ADDRESS 0x01010D80 /end MEASUREMENT
/begin COMPU_METHOD Compu_CVdP_dP2_d " " RAT_FUNC "%.4" "psi" COEFFS 0 1024 0 0 0 1 /end COMPU_METHOD
/begin MEASUREMENT CVdP_dP1_pcta "Actual/expected" FLOAT32_IEEE Compu_CVdP_dP1_pcta 0 0 -10000000000 10000000000 ECU_ADDRESS 0x01010D88 /end MEASUREMENT
/begin COMPU_METHOD Compu_CVdP_dP1_pcta " " RAT_FUNC "%.0" "%" COEFFS 0 0.01 0 0 0 1 /end COMPU_METHOD
/begin MEASUREMENT CVdP_dP2_pcta "Actual/expected" FLOAT32_IEEE Compu_CVdP_dP2_pcta 0 0 -10000000000 10000000000 ECU_ADDRESS 0x01010D90 /end MEASUREMENT
/begin COMPU_METHOD Compu_CVdP_dP2_pcta " " RAT_FUNC "%.0" "%" COEFFS 0 0.01 0 0 0 1 /end COMPU_METHOD
/begin MEASUREMENT mdot_EGRv_mdl "Modeled EGR flow" FLOAT32_IEEE Compu_mdot_EGRv_mdl 0 0 -10000000000 10000000000 ECU_ADDRESS 0x01010E40 /end MEASUREMENT
/begin COMPU_METHOD Compu_mdot_EGRv_mdl " " RAT_FUNC "%.2" "g/sec" COEFFS 0 1 0 0 0 1 /end COMPU_METHOD
/begin CHARACTERISTIC EGRdP_offset_clrdly "EGRdP offset key-off clear wait" VALUE 0x0014680e /* @ECU_Address@EGRdP_offset_clrdly@0x01010E48@ */ ECIPP_ALIGNMENT_UWORD 65535 Compu_EGRdP_offset_clrdly 0 65535 /end CHARACTERISTIC
/begin COMPU_METHOD Compu_EGRdP_offset_clrdly " " RAT_FUNC "%.0" "ms" COEFFS 0 1 0 0 0 1 /end COMPU_METHOD
/begin CHARACTERISTIC FDC_ena "FDC mode{FDC_ena&0xff=0:Disabled}{FDC_ena&0xff=1:Enabled}" VALUE 0x00147d4b /* @ECU_Address@FDC_ena@0x01011F30@ */ ECIPP_ALIGNMENT_UBYTE 255 FDC_ena_COMPU_VTAB 0 255 BIT_MASK 0xff /end CHARACTERISTIC
/begin COMPU_METHOD FDC_ena_COMPU_VTAB "Verbal Table" TAB_VERB "%.0" "list" COMPU_TAB_REF FDC_ena_COMPU_VTAB_REF /end COMPU_METHOD
/begin COMPU_VTAB FDC_ena_COMPU_VTAB_REF "Verbal Table" TAB_VERB 2 0 "Disabled" 1 "Enabled" DEFAULT_VALUE "UNKNOWN" /end COMPU_VTAB
/begin CHARACTERISTIC FDC_rpm_min "FDC RPM minimum" VALUE 0x00146846 /* @ECU_Address@FDC_rpm_min@0x01011F38@ */ ECIPP_ALIGNMENT_UWORD 65535 Compu_FDC_rpm_min 0 65535 /end CHARACTERISTIC
/begin COMPU_METHOD Compu_FDC_rpm_min " " RAT_FUNC "%.0" "rpm" COEFFS 0 1 0 0 0 1 /end COMPU_METHOD
/begin CHARACTERISTIC FDC_load_off "FDC load cmd = 0% comp" VALUE 0x00146842 /* @ECU_Address@FDC_load_off@0x01011F40@ */ ECIPP_ALIGNMENT_UWORD 100 Compu_FDC_load_off 0 99.9984741210938 /end CHARACTERISTIC
/begin COMPU_METHOD Compu_FDC_load_off " " RAT_FUNC "%.1" "% load" COEFFS 0 655.36 0 0 0 1 /end COMPU_METHOD
/begin CHARACTERISTIC FDC_load_on "FDC load cmd = 100% comp" VALUE 0x00146844 /* @ECU_Address@FDC_load_on@0x01011F48@ */ ECIPP_ALIGNMENT_UWORD 100 Compu_FDC_load_on 0 99.9984741210938 /end CHARACTERISTIC
/begin COMPU_METHOD Compu_FDC_load_on " " RAT_FUNC "%.1" "% load" COEFFS 0 655.36 0 0 0 1 /end COMPU_METHOD
/begin CHARACTERISTIC FDC_CLAL_ref "FDC fuel CL+AL = 100% comp" VALUE 0x0014683e /* @ECU_Address@FDC_CLAL_ref@0x01011F50@ */ ECIPP_ALIGNMENT_UWORD 200 Compu_FDC_CLAL_ref 0 199.996948242188 /end CHARACTERISTIC
/begin COMPU_METHOD Compu_FDC_CLAL_ref " " RAT_FUNC "%.1" "%" COEFFS 0 327.68 0 0 0 1 /end COMPU_METHOD
/begin CHARACTERISTIC FDC_EGR_max "FDC EGR cmd offset max" VALUE 0x00146840 /* @ECU_Address@FDC_EGR_max@0x01011F58@ */ ECIPP_ALIGNMENT_UWORD 400 Compu_FDC_EGR_max 0 399.993896484375 /end CHARACTERISTIC
/begin COMPU_METHOD Compu_FDC_EGR_max " " RAT_FUNC "%.2" "% dil" COEFFS 0 163.84 0 0 0 1 /end COMPU_METHOD
/begin CHARACTERISTIC FDC_comp_inc_LP "FDC compensation inc LP" VALUE 0x00147bda /* @ECU_Address@FDC_comp_inc_LP@0x01011F60@ */ ECIPP_ALIGNMENT_UWORD 3277 Compu_FDC_comp_inc_LP 0.0045084 3276.8 /end CHARACTERISTIC
/begin COMPU_METHOD Compu_FDC_comp_inc_LP " " FORM "%.1" "sec"
 /begin FORMULA "-0.05 / log(1 - (X1 / 65536))" FORMULA_INV "(1 - exp(-0.05/X1)) * 65536" /end FORMULA
/end COMPU_METHOD
/begin CHARACTERISTIC FDC_comp_dec_LP "FDC compensation dec LP" VALUE 0x00147bd8 /* @ECU_Address@FDC_comp_dec_LP@0x01011F68@ */ ECIPP_ALIGNMENT_UWORD 3277 Compu_FDC_comp_dec_LP 0.0045084 3276.8 /end CHARACTERISTIC
/begin COMPU_METHOD Compu_FDC_comp_dec_LP " " FORM "%.1" "sec"
 /begin FORMULA "-0.05 / log(1 - (X1 / 65536))" FORMULA_INV "(1 - exp(-0.05/X1)) * 65536" /end FORMULA
/end COMPU_METHOD
/begin MEASUREMENT FDC_comp_pct "FDC compensation" FLOAT32_IEEE Compu_FDC_comp_pct 0 0 -10000000000 10000000000 ECU_ADDRESS 0x01011F70 /end MEASUREMENT
/begin COMPU_METHOD Compu_FDC_comp_pct " " RAT_FUNC "%.1" "%" COEFFS 0 0.01 0 0 0 1 /end COMPU_METHOD
/begin MEASUREMENT FDC_EGR_ofst "FDC EGR offset" FLOAT32_IEEE Compu_FDC_EGR_ofst 0 0 -10000000000 10000000000 ECU_ADDRESS 0x01011F78 /end MEASUREMENT
/begin COMPU_METHOD Compu_FDC_EGR_ofst " " RAT_FUNC "%.2" "% dil" COEFFS 0 0.01 0 0 0 1 /end COMPU_METHOD
/begin CHARACTERISTIC ECTmon_warm_wait "Warm engine monitor start wait" VALUE 0x001440cc /* @ECU_Address@ECTmon_warm_wait@0x01011F80@ */ ECIPP_ALIGNMENT_ULONG 4294967 Compu_ECTmon_warm_wait 0 4294967.295 /end CHARACTERISTIC
/begin COMPU_METHOD Compu_ECTmon_warm_wait " " RAT_FUNC "%.0" "sec" COEFFS 0 1000 0 0 0 1 /end COMPU_METHOD
/begin MEASUREMENT ECTmon_CL_wait "CL ECT warm-up time" ULONG Compu_ECTmon_CL_wait 0 0 0 4294967.295 ECU_ADDRESS 0x01011FE8 /end MEASUREMENT
/begin COMPU_METHOD Compu_ECTmon_CL_wait " " RAT_FUNC "%.1" "sec" COEFFS 0 1000 0 0 0 1 /end COMPU_METHOD
/begin MEASUREMENT ECTmon_CL_tmr "CL ECT warm-up timer" ULONG Compu_ECTmon_CL_tmr 0 0 0 4294967.295 ECU_ADDRESS 0x01011FF0 /end MEASUREMENT
/begin COMPU_METHOD Compu_ECTmon_CL_tmr " " RAT_FUNC "%.1" "sec" COEFFS 0 1000 0 0 0 1 /end COMPU_METHOD
/begin MEASUREMENT ECTmon_oper_wait "Operating ECT warm-up time" ULONG Compu_ECTmon_oper_wait 0 0 0 4294967.295 ECU_ADDRESS 0x01011FF8 /end MEASUREMENT
/begin COMPU_METHOD Compu_ECTmon_oper_wait " " RAT_FUNC "%.1" "sec" COEFFS 0 1000 0 0 0 1 /end COMPU_METHOD
/begin MEASUREMENT ECTmon_oper_tmr "Operating ECT warm-up timer" ULONG Compu_ECTmon_oper_tmr 0 0 0 4294967.295 ECU_ADDRESS 0x01012000 /end MEASUREMENT
/begin COMPU_METHOD Compu_ECTmon_oper_tmr " " RAT_FUNC "%.1" "sec" COEFFS 0 1000 0 0 0 1 /end COMPU_METHOD
/begin MEASUREMENT ECTmon_diag_wait "Diagnostics ECT warm-up time" ULONG Compu_ECTmon_diag_wait 0 0 0 4294967.295 ECU_ADDRESS 0x01012008 /end MEASUREMENT
/begin COMPU_METHOD Compu_ECTmon_diag_wait " " RAT_FUNC "%.1" "sec" COEFFS 0 1000 0 0 0 1 /end COMPU_METHOD
/begin MEASUREMENT ECTmon_diag_tmr "Diagnostics ECT warm-up timer" ULONG Compu_ECTmon_diag_tmr 0 0 0 4294967.295 ECU_ADDRESS 0x01012010 /end MEASUREMENT
/begin COMPU_METHOD Compu_ECTmon_diag_tmr " " RAT_FUNC "%.1" "sec" COEFFS 0 1000 0 0 0 1 /end COMPU_METHOD
/begin CHARACTERISTIC EGRad_store_EE "EGR adaptive retention memory{EGRad_store_EE&0xff=0:Battery}{EGRad_store_EE&0xff=1:Permanent}" VALUE 0x001409b5 /* @ECU_Address@EGRad_store_EE@0x01012038@ */ ECIPP_ALIGNMENT_UBYTE 255 EGRad_store_EE_COMPU_VTAB 0 255 BIT_MASK 0xff /end CHARACTERISTIC
/begin COMPU_METHOD EGRad_store_EE_COMPU_VTAB "Verbal Table" TAB_VERB "%.0" "list" COMPU_TAB_REF EGRad_store_EE_COMPU_VTAB_REF /end COMPU_METHOD
/begin COMPU_VTAB EGRad_store_EE_COMPU_VTAB_REF "Verbal Table" TAB_VERB 2 0 "Battery" 1 "Permanent" DEFAULT_VALUE "UNKNOWN" /end COMPU_VTAB
/begin MEASUREMENT fault_maxact_pct30 "Max active percent 30" UWORD Compu_fault_maxact_pct30 0 0 0 399.993896484375 ECU_ADDRESS 0x010122E0 /end MEASUREMENT
/begin COMPU_METHOD Compu_fault_maxact_pct30 " " RAT_FUNC "%.1" "%" COEFFS 0 163.84 0 0 0 1 /end COMPU_METHOD
/begin MEASUREMENT fault_maxact_pct31 "Max active percent 31" UWORD Compu_fault_maxact_pct31 0 0 0 399.993896484375 ECU_ADDRESS 0x010122E8 /end MEASUREMENT
/begin COMPU_METHOD Compu_fault_maxact_pct31 " " RAT_FUNC "%.1" "%" COEFFS 0 163.84 0 0 0 1 /end COMPU_METHOD
/begin MEASUREMENT fault_maxact_pct32 "Max active percent 32" UWORD Compu_fault_maxact_pct32 0 0 0 399.993896484375 ECU_ADDRESS 0x010122F0 /end MEASUREMENT
/begin COMPU_METHOD Compu_fault_maxact_pct32 " " RAT_FUNC "%.1" "%" COEFFS 0 163.84 0 0 0 1 /end COMPU_METHOD
/begin MEASUREMENT fault_maxact_pct33 "Max active percent 33" UWORD Compu_fault_maxact_pct33 0 0 0 399.993896484375 ECU_ADDRESS 0x010122F8 /end MEASUREMENT
/begin COMPU_METHOD Compu_fault_maxact_pct33 " " RAT_FUNC "%.1" "%" COEFFS 0 163.84 0 0 0 1 /end COMPU_METHOD
/begin MEASUREMENT fault_maxact_pct34 "Max active percent 34" UWORD Compu_fault_maxact_pct34 0 0 0 399.993896484375 ECU_ADDRESS 0x01012300 /end MEASUREMENT
/begin COMPU_METHOD Compu_fault_maxact_pct34 " " RAT_FUNC "%.1" "%" COEFFS 0 163.84 0 0 0 1 /end COMPU_METHOD
/begin MEASUREMENT fault_maxact_pct35 "Max active percent 35" UWORD Compu_fault_maxact_pct35 0 0 0 399.993896484375 ECU_ADDRESS 0x01012308 /end MEASUREMENT
/begin COMPU_METHOD Compu_fault_maxact_pct35 " " RAT_FUNC "%.1" "%" COEFFS 0 163.84 0 0 0 1 /end COMPU_METHOD
/begin MEASUREMENT fault_maxact_pct36 "Max active percent 36" UWORD Compu_fault_maxact_pct36 0 0 0 399.993896484375 ECU_ADDRESS 0x01012310 /end MEASUREMENT
/begin COMPU_METHOD Compu_fault_maxact_pct36 " " RAT_FUNC "%.1" "%" COEFFS 0 163.84 0 0 0 1 /end COMPU_METHOD
/begin MEASUREMENT fault_maxact_pct37 "Max active percent 37" UWORD Compu_fault_maxact_pct37 0 0 0 399.993896484375 ECU_ADDRESS 0x01012318 /end MEASUREMENT
/begin COMPU_METHOD Compu_fault_maxact_pct37 " " RAT_FUNC "%.1" "%" COEFFS 0 163.84 0 0 0 1 /end COMPU_METHOD
/begin MEASUREMENT fault_maxact_pct38 "Max active percent 38" UWORD Compu_fault_maxact_pct38 0 0 0 399.993896484375 ECU_ADDRESS 0x01012320 /end MEASUREMENT
/begin COMPU_METHOD Compu_fault_maxact_pct38 " " RAT_FUNC "%.1" "%" COEFFS 0 163.84 0 0 0 1 /end COMPU_METHOD
/begin MEASUREMENT fault_maxact_pct39 "Max active percent 39" UWORD Compu_fault_maxact_pct39 0 0 0 399.993896484375 ECU_ADDRESS 0x01012328 /end MEASUREMENT
/begin COMPU_METHOD Compu_fault_maxact_pct39 " " RAT_FUNC "%.1" "%" COEFFS 0 163.84 0 0 0 1 /end COMPU_METHOD
/begin MEASUREMENT fault_maxact_pct40 "Max active percent 40" UWORD Compu_fault_maxact_pct40 0 0 0 399.993896484375 ECU_ADDRESS 0x01012330 /end MEASUREMENT
/begin COMPU_METHOD Compu_fault_maxact_pct40 " " RAT_FUNC "%.1" "%" COEFFS 0 163.84 0 0 0 1 /end COMPU_METHOD
/begin MEASUREMENT fault_maxact_pct41 "Max active percent 41" UWORD Compu_fault_maxact_pct41 0 0 0 399.993896484375 ECU_ADDRESS 0x01012338 /end MEASUREMENT
/begin COMPU_METHOD Compu_fault_maxact_pct41 " " RAT_FUNC "%.1" "%" COEFFS 0 163.84 0 0 0 1 /end COMPU_METHOD
/begin MEASUREMENT fault_maxact_pct42 "Max active percent 42" UWORD Compu_fault_maxact_pct42 0 0 0 399.993896484375 ECU_ADDRESS 0x01012340 /end MEASUREMENT
/begin COMPU_METHOD Compu_fault_maxact_pct42 " " RAT_FUNC "%.1" "%" COEFFS 0 163.84 0 0 0 1 /end COMPU_METHOD
/begin MEASUREMENT fault_maxact_pct43 "Max active percent 43" UWORD Compu_fault_maxact_pct43 0 0 0 399.993896484375 ECU_ADDRESS 0x01012348 /end MEASUREMENT
/begin COMPU_METHOD Compu_fault_maxact_pct43 " " RAT_FUNC "%.1" "%" COEFFS 0 163.84 0 0 0 1 /end COMPU_METHOD
/begin MEASUREMENT fault_maxact_pct44 "Max active percent 44" UWORD Compu_fault_maxact_pct44 0 0 0 399.993896484375 ECU_ADDRESS 0x01012350 /end MEASUREMENT
/begin COMPU_METHOD Compu_fault_maxact_pct44 " " RAT_FUNC "%.1" "%" COEFFS 0 163.84 0 0 0 1 /end COMPU_METHOD
/begin MEASUREMENT fault_maxact_pct45 "Max active percent 45" UWORD Compu_fault_maxact_pct45 0 0 0 399.993896484375 ECU_ADDRESS 0x01012358 /end MEASUREMENT
/begin COMPU_METHOD Compu_fault_maxact_pct45 " " RAT_FUNC "%.1" "%" COEFFS 0 163.84 0 0 0 1 /end COMPU_METHOD
/begin MEASUREMENT fault_maxact_pct46 "Max active percent 46" UWORD Compu_fault_maxact_pct46 0 0 0 399.993896484375 ECU_ADDRESS 0x01012360 /end MEASUREMENT
/begin COMPU_METHOD Compu_fault_maxact_pct46 " " RAT_FUNC "%.1" "%" COEFFS 0 163.84 0 0 0 1 /end COMPU_METHOD
/begin MEASUREMENT fault_maxact_pct47 "Max active percent 47" UWORD Compu_fault_maxact_pct47 0 0 0 399.993896484375 ECU_ADDRESS 0x01012368 /end MEASUREMENT
/begin COMPU_METHOD Compu_fault_maxact_pct47 " " RAT_FUNC "%.1" "%" COEFFS 0 163.84 0 0 0 1 /end COMPU_METHOD
/begin MEASUREMENT fault_maxact_pct48 "Max active percent 48" UWORD Compu_fault_maxact_pct48 0 0 0 399.993896484375 ECU_ADDRESS 0x01012370 /end MEASUREMENT
/begin COMPU_METHOD Compu_fault_maxact_pct48 " " RAT_FUNC "%.1" "%" COEFFS 0 163.84 0 0 0 1 /end COMPU_METHOD
/begin MEASUREMENT fault_maxact_pct49 "Max active percent 49" UWORD Compu_fault_maxact_pct49 0 0 0 399.993896484375 ECU_ADDRESS 0x01012378 /end MEASUREMENT
/begin COMPU_METHOD Compu_fault_maxact_pct49 " " RAT_FUNC "%.1" "%" COEFFS 0 163.84 0 0 0 1 /end COMPU_METHOD
/begin MEASUREMENT fault_maxact_pct50 "Max active percent 50" UWORD Compu_fault_maxact_pct50 0 0 0 399.993896484375 ECU_ADDRESS 0x01012380 /end MEASUREMENT
/begin COMPU_METHOD Compu_fault_maxact_pct50 " " RAT_FUNC "%.1" "%" COEFFS 0 163.84 0 0 0 1 /end COMPU_METHOD
/begin MEASUREMENT fault_maxact_pct51 "Max active percent 51" UWORD Compu_fault_maxact_pct51 0 0 0 399.993896484375 ECU_ADDRESS 0x01012388 /end MEASUREMENT
/begin COMPU_METHOD Compu_fault_maxact_pct51 " " RAT_FUNC "%.1" "%" COEFFS 0 163.84 0 0 0 1 /end COMPU_METHOD
/begin MEASUREMENT fault_maxact_pct52 "Max active percent 52" UWORD Compu_fault_maxact_pct52 0 0 0 399.993896484375 ECU_ADDRESS 0x01012390 /end MEASUREMENT
/begin COMPU_METHOD Compu_fault_maxact_pct52 " " RAT_FUNC "%.1" "%" COEFFS 0 163.84 0 0 0 1 /end COMPU_METHOD
/begin MEASUREMENT fault_maxact_pct53 "Max active percent 53" UWORD Compu_fault_maxact_pct53 0 0 0 399.993896484375 ECU_ADDRESS 0x01012398 /end MEASUREMENT
/begin COMPU_METHOD Compu_fault_maxact_pct53 " " RAT_FUNC "%.1" "%" COEFFS 0 163.84 0 0 0 1 /end COMPU_METHOD
/begin MEASUREMENT fault_maxact_pct54 "Max active percent 54" UWORD Compu_fault_maxact_pct54 0 0 0 399.993896484375 ECU_ADDRESS 0x010123A0 /end MEASUREMENT
/begin COMPU_METHOD Compu_fault_maxact_pct54 " " RAT_FUNC "%.1" "%" COEFFS 0 163.84 0 0 0 1 /end COMPU_METHOD
/begin MEASUREMENT fault_maxact_pct55 "Max active percent 55" UWORD Compu_fault_maxact_pct55 0 0 0 399.993896484375 ECU_ADDRESS 0x010123A8 /end MEASUREMENT
/begin COMPU_METHOD Compu_fault_maxact_pct55 " " RAT_FUNC "%.1" "%" COEFFS 0 163.84 0 0 0 1 /end COMPU_METHOD
/begin MEASUREMENT fault_maxact_pct56 "Max active percent 56" UWORD Compu_fault_maxact_pct56 0 0 0 399.993896484375 ECU_ADDRESS 0x010123B0 /end MEASUREMENT
/begin COMPU_METHOD Compu_fault_maxact_pct56 " " RAT_FUNC "%.1" "%" COEFFS 0 163.84 0 0 0 1 /end COMPU_METHOD
/begin MEASUREMENT fault_maxact_pct57 "Max active percent 57" UWORD Compu_fault_maxact_pct57 0 0 0 399.993896484375 ECU_ADDRESS 0x010123B8 /end MEASUREMENT
/begin COMPU_METHOD Compu_fault_maxact_pct57 " " RAT_FUNC "%.1" "%" COEFFS 0 163.84 0 0 0 1 /end COMPU_METHOD
/begin MEASUREMENT fault_maxact_pct58 "Max active percent 58" UWORD Compu_fault_maxact_pct58 0 0 0 399.993896484375 ECU_ADDRESS 0x010123C0 /end MEASUREMENT
/begin COMPU_METHOD Compu_fault_maxact_pct58 " " RAT_FUNC "%.1" "%" COEFFS 0 163.84 0 0 0 1 /end COMPU_METHOD
/begin MEASUREMENT fault_maxact_pct59 "Max active percent 59" UWORD Compu_fault_maxact_pct59 0 0 0 399.993896484375 ECU_ADDRESS 0x010123C8 /end MEASUREMENT
/begin COMPU_METHOD Compu_fault_maxact_pct59 " " RAT_FUNC "%.1" "%" COEFFS 0 163.84 0 0 0 1 /end COMPU_METHOD
/begin MEASUREMENT fault_maxact_flt30 "Max active fault 30" UWORD Compu_fault_maxact_flt30 0 0 0 65535 ECU_ADDRESS 0x010123D0 /end MEASUREMENT
/begin COMPU_METHOD Compu_fault_maxact_flt30 " " RAT_FUNC "%.0" "fault index" COEFFS 0 1 0 0 0 1 /end COMPU_METHOD
/begin MEASUREMENT fault_maxact_flt31 "Max active fault 31" UWORD Compu_fault_maxact_flt31 0 0 0 65535 ECU_ADDRESS 0x010123D8 /end MEASUREMENT
/begin COMPU_METHOD Compu_fault_maxact_flt31 " " RAT_FUNC "%.0" "fault index" COEFFS 0 1 0 0 0 1 /end COMPU_METHOD
/begin MEASUREMENT fault_maxact_flt32 "Max active fault 32" UWORD Compu_fault_maxact_flt32 0 0 0 65535 ECU_ADDRESS 0x010123E0 /end MEASUREMENT
/begin COMPU_METHOD Compu_fault_maxact_flt32 " " RAT_FUNC "%.0" "fault index" COEFFS 0 1 0 0 0 1 /end COMPU_METHOD
/begin MEASUREMENT fault_maxact_flt33 "Max active fault 33" UWORD Compu_fault_maxact_flt33 0 0 0 65535 ECU_ADDRESS 0x010123E8 /end MEASUREMENT
/begin COMPU_METHOD Compu_fault_maxact_flt33 " " RAT_FUNC "%.0" "fault index" COEFFS 0 1 0 0 0 1 /end COMPU_METHOD
/begin MEASUREMENT fault_maxact_flt34 "Max active fault 34" UWORD Compu_fault_maxact_flt34 0 0 0 65535 ECU_ADDRESS 0x010123F0 /end MEASUREMENT
/begin COMPU_METHOD Compu_fault_maxact_flt34 " " RAT_FUNC "%.0" "fault index" COEFFS 0 1 0 0 0 1 /end COMPU_METHOD
/begin MEASUREMENT fault_maxact_flt35 "Max active fault 35" UWORD Compu_fault_maxact_flt35 0 0 0 65535 ECU_ADDRESS 0x010123F8 /end MEASUREMENT
/begin COMPU_METHOD Compu_fault_maxact_flt35 " " RAT_FUNC "%.0" "fault index" COEFFS 0 1 0 0 0 1 /end COMPU_METHOD
/begin MEASUREMENT fault_maxact_flt36 "Max active fault 36" UWORD Compu_fault_maxact_flt36 0 0 0 65535 ECU_ADDRESS 0x01012400 /end MEASUREMENT
/begin COMPU_METHOD Compu_fault_maxact_flt36 " " RAT_FUNC "%.0" "fault index" COEFFS 0 1 0 0 0 1 /end COMPU_METHOD
/begin MEASUREMENT fault_maxact_flt37 "Max active fault 37" UWORD Compu_fault_maxact_flt37 0 0 0 65535 ECU_ADDRESS 0x01012408 /end MEASUREMENT
/begin COMPU_METHOD Compu_fault_maxact_flt37 " " RAT_FUNC "%.0" "fault index" COEFFS 0 1 0 0 0 1 /end COMPU_METHOD
/begin MEASUREMENT fault_maxact_flt38 "Max active fault 38" UWORD Compu_fault_maxact_flt38 0 0 0 65535 ECU_ADDRESS 0x01012410 /end MEASUREMENT
/begin COMPU_METHOD Compu_fault_maxact_flt38 " " RAT_FUNC "%.0" "fault index" COEFFS 0 1 0 0 0 1 /end COMPU_METHOD
/begin MEASUREMENT fault_maxact_flt39 "Max active fault 39" UWORD Compu_fault_maxact_flt39 0 0 0 65535 ECU_ADDRESS 0x01012418 /end MEASUREMENT
/begin COMPU_METHOD Compu_fault_maxact_flt39 " " RAT_FUNC "%.0" "fault index" COEFFS 0 1 0 0 0 1 /end COMPU_METHOD
/begin MEASUREMENT fault_maxact_flt40 "Max active fault 40" UWORD Compu_fault_maxact_flt40 0 0 0 65535 ECU_ADDRESS 0x01012420 /end MEASUREMENT
/begin COMPU_METHOD Compu_fault_maxact_flt40 " " RAT_FUNC "%.0" "fault index" COEFFS 0 1 0 0 0 1 /end COMPU_METHOD
/begin MEASUREMENT fault_maxact_flt41 "Max active fault 41" UWORD Compu_fault_maxact_flt41 0 0 0 65535 ECU_ADDRESS 0x01012428 /end MEASUREMENT
/begin COMPU_METHOD Compu_fault_maxact_flt41 " " RAT_FUNC "%.0" "fault index" COEFFS 0 1 0 0 0 1 /end COMPU_METHOD
/begin MEASUREMENT fault_maxact_flt42 "Max active fault 42" UWORD Compu_fault_maxact_flt42 0 0 0 65535 ECU_ADDRESS 0x01012430 /end MEASUREMENT
/begin COMPU_METHOD Compu_fault_maxact_flt42 " " RAT_FUNC "%.0" "fault index" COEFFS 0 1 0 0 0 1 /end COMPU_METHOD
/begin MEASUREMENT fault_maxact_flt43 "Max active fault 43" UWORD Compu_fault_maxact_flt43 0 0 0 65535 ECU_ADDRESS 0x01012438 /end MEASUREMENT
/begin COMPU_METHOD Compu_fault_maxact_flt43 " " RAT_FUNC "%.0" "fault index" COEFFS 0 1 0 0 0 1 /end COMPU_METHOD
/begin MEASUREMENT fault_maxact_flt44 "Max active fault 44" UWORD Compu_fault_maxact_flt44 0 0 0 65535 ECU_ADDRESS 0x01012440 /end MEASUREMENT
/begin COMPU_METHOD Compu_fault_maxact_flt44 " " RAT_FUNC "%.0" "fault index" COEFFS 0 1 0 0 0 1 /end COMPU_METHOD
/begin MEASUREMENT fault_maxact_flt45 "Max active fault 45" UWORD Compu_fault_maxact_flt45 0 0 0 65535 ECU_ADDRESS 0x01012448 /end MEASUREMENT
/begin COMPU_METHOD Compu_fault_maxact_flt45 " " RAT_FUNC "%.0" "fault index" COEFFS 0 1 0 0 0 1 /end COMPU_METHOD
/begin MEASUREMENT fault_maxact_flt46 "Max active fault 46" UWORD Compu_fault_maxact_flt46 0 0 0 65535 ECU_ADDRESS 0x01012450 /end MEASUREMENT
/begin COMPU_METHOD Compu_fault_maxact_flt46 " " RAT_FUNC "%.0" "fault index" COEFFS 0 1 0 0 0 1 /end COMPU_METHOD
/begin MEASUREMENT fault_maxact_flt47 "Max active fault 47" UWORD Compu_fault_maxact_flt47 0 0 0 65535 ECU_ADDRESS 0x01012458 /end MEASUREMENT
/begin COMPU_METHOD Compu_fault_maxact_flt47 " " RAT_FUNC "%.0" "fault index" COEFFS 0 1 0 0 0 1 /end COMPU_METHOD
/begin MEASUREMENT fault_maxact_flt48 "Max active fault 48" UWORD Compu_fault_maxact_flt48 0 0 0 65535 ECU_ADDRESS 0x01012460 /end MEASUREMENT
/begin COMPU_METHOD Compu_fault_maxact_flt48 " " RAT_FUNC "%.0" "fault index" COEFFS 0 1 0 0 0 1 /end COMPU_METHOD
/begin MEASUREMENT fault_maxact_flt49 "Max active fault 49" UWORD Compu_fault_maxact_flt49 0 0 0 65535 ECU_ADDRESS 0x01012468 /end MEASUREMENT
/begin COMPU_METHOD Compu_fault_maxact_flt49 " " RAT_FUNC "%.0" "fault index" COEFFS 0 1 0 0 0 1 /end COMPU_METHOD
/begin MEASUREMENT fault_maxact_flt50 "Max active fault 50" UWORD Compu_fault_maxact_flt50 0 0 0 65535 ECU_ADDRESS 0x01012470 /end MEASUREMENT
/begin COMPU_METHOD Compu_fault_maxact_flt50 " " RAT_FUNC "%.0" "fault index" COEFFS 0 1 0 0 0 1 /end COMPU_METHOD
/begin MEASUREMENT fault_maxact_flt51 "Max active fault 51" UWORD Compu_fault_maxact_flt51 0 0 0 65535 ECU_ADDRESS 0x01012478 /end MEASUREMENT
/begin COMPU_METHOD Compu_fault_maxact_flt51 " " RAT_FUNC "%.0" "fault index" COEFFS 0 1 0 0 0 1 /end COMPU_METHOD
/begin MEASUREMENT fault_maxact_flt52 "Max active fault 52" UWORD Compu_fault_maxact_flt52 0 0 0 65535 ECU_ADDRESS 0x01012480 /end MEASUREMENT
/begin COMPU_METHOD Compu_fault_maxact_flt52 " " RAT_FUNC "%.0" "fault index" COEFFS 0 1 0 0 0 1 /end COMPU_METHOD
/begin MEASUREMENT fault_maxact_flt53 "Max active fault 53" UWORD Compu_fault_maxact_flt53 0 0 0 65535 ECU_ADDRESS 0x01012488 /end MEASUREMENT
/begin COMPU_METHOD Compu_fault_maxact_flt53 " " RAT_FUNC "%.0" "fault index" COEFFS 0 1 0 0 0 1 /end COMPU_METHOD
/begin MEASUREMENT fault_maxact_flt54 "Max active fault 54" UWORD Compu_fault_maxact_flt54 0 0 0 65535 ECU_ADDRESS 0x01012490 /end MEASUREMENT
/begin COMPU_METHOD Compu_fault_maxact_flt54 " " RAT_FUNC "%.0" "fault index" COEFFS 0 1 0 0 0 1 /end COMPU_METHOD
/begin MEASUREMENT fault_maxact_flt55 "Max active fault 55" UWORD Compu_fault_maxact_flt55 0 0 0 65535 ECU_ADDRESS 0x01012498 /end MEASUREMENT
/begin COMPU_METHOD Compu_fault_maxact_flt55 " " RAT_FUNC "%.0" "fault index" COEFFS 0 1 0 0 0 1 /end COMPU_METHOD
/begin MEASUREMENT fault_maxact_flt56 "Max active fault 56" UWORD Compu_fault_maxact_flt56 0 0 0 65535 ECU_ADDRESS 0x010124A0 /end MEASUREMENT
/begin COMPU_METHOD Compu_fault_maxact_flt56 " " RAT_FUNC "%.0" "fault index" COEFFS 0 1 0 0 0 1 /end COMPU_METHOD
/begin MEASUREMENT fault_maxact_flt57 "Max active fault 57" UWORD Compu_fault_maxact_flt57 0 0 0 65535 ECU_ADDRESS 0x010124A8 /end MEASUREMENT
/begin COMPU_METHOD Compu_fault_maxact_flt57 " " RAT_FUNC "%.0" "fault index" COEFFS 0 1 0 0 0 1 /end COMPU_METHOD
/begin MEASUREMENT fault_maxact_flt58 "Max active fault 58" UWORD Compu_fault_maxact_flt58 0 0 0 65535 ECU_ADDRESS 0x010124B0 /end MEASUREMENT
/begin COMPU_METHOD Compu_fault_maxact_flt58 " " RAT_FUNC "%.0" "fault index" COEFFS 0 1 0 0 0 1 /end COMPU_METHOD
/begin MEASUREMENT fault_maxact_flt59 "Max active fault 59" UWORD Compu_fault_maxact_flt59 0 0 0 65535 ECU_ADDRESS 0x010124B8 /end MEASUREMENT
/begin COMPU_METHOD Compu_fault_maxact_flt59 " " RAT_FUNC "%.0" "fault index" COEFFS 0 1 0 0 0 1 /end COMPU_METHOD
/begin MEASUREMENT fault_maxact_pctmin "Table entry minimum latch" UWORD Compu_fault_maxact_pctmin 0 0 0 399.993896484375 ECU_ADDRESS 0x010124C0 /end MEASUREMENT
/begin COMPU_METHOD Compu_fault_maxact_pctmin " " RAT_FUNC "%.1" "%" COEFFS 0 163.84 0 0 0 1 /end COMPU_METHOD
/begin MEASUREMENT m_d_pct_octmin "Octane-compensated min diluent command request" UWORD Compu_m_d_pct_octmin 0 0 0 399.993896484375 ECU_ADDRESS 0x010125C0 /end MEASUREMENT
/begin COMPU_METHOD Compu_m_d_pct_octmin " " RAT_FUNC "%.1" "%" COEFFS 0 163.84 0 0 0 1 /end COMPU_METHOD
/begin MEASUREMENT m_d_pct_octnom "Octane-compensated nom diluent command request" UWORD Compu_m_d_pct_octnom 0 0 0 399.993896484375 ECU_ADDRESS 0x010125C8 /end MEASUREMENT
/begin COMPU_METHOD Compu_m_d_pct_octnom " " RAT_FUNC "%.1" "%" COEFFS 0 163.84 0 0 0 1 /end COMPU_METHOD
/begin MEASUREMENT EGR_oct_retard "Additional spark retard for octane adaptation" SWORD Compu_EGR_oct_retard 0 0 -2048 2047.9375 ECU_ADDRESS 0x010125D0 /end MEASUREMENT
/begin COMPU_METHOD Compu_EGR_oct_retard " " RAT_FUNC "%.1" "CAD ret" COEFFS 0 16 0 0 0 1 /end COMPU_METHOD
/begin MEASUREMENT EGR_oct_LL_pct "Octane rating load limit" UWORD Compu_EGR_oct_LL_pct 0 0 0 99.9984741210938 ECU_ADDRESS 0x010125E0 /end MEASUREMENT
/begin COMPU_METHOD Compu_EGR_oct_LL_pct " " RAT_FUNC "%.1" "%" COEFFS 0 655.36 0 0 0 1 /end COMPU_METHOD
/begin MEASUREMENT m_d_pct_oct_ofst "Additional EGR diluent for octane adaptation" SWORD Compu_m_d_pct_oct_ofst 0 0 -200 199.993896484375 ECU_ADDRESS 0x010125F8 /end MEASUREMENT
/begin COMPU_METHOD Compu_m_d_pct_oct_ofst " " RAT_FUNC "%.1" "%" COEFFS 0 163.84 0 0 0 1 /end COMPU_METHOD
/begin CHARACTERISTIC EGRdP_offset_clrtime "EGRdP offset key-off clear time" VALUE 0x00140910 /* @ECU_Address@EGRdP_offset_clrtime@0x01012708@ */ ECIPP_ALIGNMENT_UWORD 66 Compu_EGRdP_offset_clrtime 0 65.535 /end CHARACTERISTIC
/begin COMPU_METHOD Compu_EGRdP_offset_clrtime " " RAT_FUNC "%.1" "sec" COEFFS 0 1000 0 0 0 1 /end COMPU_METHOD
/begin CHARACTERISTIC EGRdP_HiExp_tbl_pct "EGRdP higher fault margin" VALUE 0x0014090c /* @ECU_Address@EGRdP_HiExp_tbl_pct@0x01012718@ */ ECIPP_ALIGNMENT_UWORD 400 Compu_EGRdP_HiExp_tbl_pct 0 399.993896484375 /end CHARACTERISTIC
/begin COMPU_METHOD Compu_EGRdP_HiExp_tbl_pct " " RAT_FUNC "%.1" "%" COEFFS 0 163.84 0 0 0 1 /end COMPU_METHOD
/begin CHARACTERISTIC EGRdP_HiExp_dP_min "EGRdP higher fault dP min" VALUE 0x001401e2 /* @ECU_Address@EGRdP_HiExp_dP_min@0x01012728@ */ ECIPP_ALIGNMENT_SWORD 32 Compu_EGRdP_HiExp_dP_min -32 31.9990234375 /end CHARACTERISTIC
/begin COMPU_METHOD Compu_EGRdP_HiExp_dP_min " " RAT_FUNC "%.3" "psi" COEFFS 0 1024 0 0 0 1 /end COMPU_METHOD
/begin MEASUREMENT EGR_deice_state "EGR de-icing state{EGR_deice_state&0xff=0xce:Inactive: foot pedal in use}{EGR_deice_state&0xff=0xcf:Inactive: fuel shutoff active}{EGR_deice_state&0xff=0xd0:Inactive: PTO active}{EGR_deice_state&0xff=0xd1:Inactive: clutch depressed}{EGR_deice_state&0xff=0" SBYTE EGR_deice_state_COMPU_VTAB 0 0 -127 128 ECU_ADDRESS 0x01012888 BIT_MASK 0xff /end MEASUREMENT
/begin COMPU_METHOD EGR_deice_state_COMPU_VTAB "Verbal Table" TAB_VERB "%.0" "list" COMPU_TAB_REF EGR_deice_state_COMPU_VTAB_REF /end COMPU_METHOD
/begin COMPU_VTAB EGR_deice_state_COMPU_VTAB_REF "Verbal Table" TAB_VERB 23 0xce "Inactive: foot pedal in use" 0xcf "Inactive: fuel shutoff active" 0xd0 "Inactive: PTO active" 0xd1 "Inactive: clutch depressed" 0xd2 "Inactive: clutch state unknown" 0xd3 "Inactive: brake pedal depressed" 0xd4 "Inactive: brake pedal state unknown" 0xd5 "Inactive: vehicle in motion" 0xd6 "Inactive: vehicle speed unknown" 0xd7 "Inactive: transmission in gear" 0xd8 "Inactive: secondary speed control active" 0xeb "Inactive: engine not running" 0xec "Inactive: run time wait not satisfied" 0xfe "Inactive: primary wait not satisfied" 0xff "Inactive: secondary wait not satisfied" 0x00 "Disabled" 0x01 "Active: increasing speed" 0x02 "Active: pre-purge delay" 0x03 "Active: post-purge delay" 0x04 "Active: returning to idle" 0x05 "Active" 0x06 "Active: IAT low" 0xe2 "Inactive: other diagnostic running" DEFAULT_VALUE "UNKNOWN" /end COMPU_VTAB
/begin CHARACTERISTIC EGR_deice_idle_tm "EGR de-icing primary idle time" VALUE 0x001408c6 /* @ECU_Address@EGR_deice_idle_tm@0x01012890@ */ ECIPP_ALIGNMENT_UWORD 65535 Compu_EGR_deice_idle_tm 0 65535 /end CHARACTERISTIC
/begin COMPU_METHOD Compu_EGR_deice_idle_tm " " RAT_FUNC "%.0" "sec" COEFFS 0 1 0 0 0 1 /end COMPU_METHOD
/begin CHARACTERISTIC EGR_deice_retidle_tm "EGR de-icing secondary idle time" VALUE 0x001408ce /* @ECU_Address@EGR_deice_retidle_tm@0x01012898@ */ ECIPP_ALIGNMENT_UWORD 65535 Compu_EGR_deice_retidle_tm 0 65535 /end CHARACTERISTIC
/begin COMPU_METHOD Compu_EGR_deice_retidle_tm " " RAT_FUNC "%.0" "sec" COEFFS 0 1 0 0 0 1 /end COMPU_METHOD
/begin CHARACTERISTIC EGR_deice_purge_tm "EGR de-icing purge time at target IAT" VALUE 0x001408cc /* @ECU_Address@EGR_deice_purge_tm@0x010128A0@ */ ECIPP_ALIGNMENT_UWORD 65535 Compu_EGR_deice_purge_tm 0 65535 /end CHARACTERISTIC
/begin COMPU_METHOD Compu_EGR_deice_purge_tm " " RAT_FUNC "%.0" "sec" COEFFS 0 1 0 0 0 1 /end COMPU_METHOD
/begin MEASUREMENT EGR_deice_wait_tm "EGR de-icing current wait time" ULONG Compu_EGR_deice_wait_tm 0 0 0 16777215.9960938 ECU_ADDRESS 0x010128A8 /end MEASUREMENT
/begin COMPU_METHOD Compu_EGR_deice_wait_tm " " RAT_FUNC "%.1" "sec" COEFFS 0 256 0 0 0 1 /end COMPU_METHOD
/begin MEASUREMENT EGR_deice_tmr "EGR de-icing current wait timer" ULONG Compu_EGR_deice_tmr 0 0 0 4294967.295 ECU_ADDRESS 0x010128B0 /end MEASUREMENT
/begin COMPU_METHOD Compu_EGR_deice_tmr " " RAT_FUNC "%.1" "sec" COEFFS 0 1000 0 0 0 1 /end COMPU_METHOD
/begin CHARACTERISTIC EGR_deice_rpm "EGR de-icing purge speed" VALUE 0x001408d0 /* @ECU_Address@EGR_deice_rpm@0x010128B8@ */ ECIPP_ALIGNMENT_UWORD 65535 Compu_EGR_deice_rpm 0 65535 /end CHARACTERISTIC
/begin COMPU_METHOD Compu_EGR_deice_rpm " " RAT_FUNC "%.0" "rpm" COEFFS 0 1 0 0 0 1 /end COMPU_METHOD
/begin CHARACTERISTIC EGR_deice_AAT_max "EGR de-icing maximum ambient air temperature" VALUE 0x001408c4 /* @ECU_Address@EGR_deice_AAT_max@0x010128C0@ */ ECIPP_ALIGNMENT_UWORD 564 Compu_EGR_deice_AAT_max -460 563.984375 /end CHARACTERISTIC
/begin COMPU_METHOD Compu_EGR_deice_AAT_max " " RAT_FUNC "%.1" "deg F" COEFFS 0 64 29440 0 0 1 /end COMPU_METHOD
/begin CHARACTERISTIC EGR_deice_pct_cmd "EGR de-icing purge % diluent" VALUE 0x001408c8 /* @ECU_Address@EGR_deice_pct_cmd@0x010128C8@ */ ECIPP_ALIGNMENT_UWORD 400 Compu_EGR_deice_pct_cmd 0 399.993896484375 /end CHARACTERISTIC
/begin COMPU_METHOD Compu_EGR_deice_pct_cmd " " RAT_FUNC "%.1" "%" COEFFS 0 163.84 0 0 0 1 /end COMPU_METHOD
/begin CHARACTERISTIC EGR_deice_rpm_rate "EGR de-icing purge speed ramp rate" VALUE 0x001408d2 /* @ECU_Address@EGR_deice_rpm_rate@0x010128F0@ */ ECIPP_ALIGNMENT_UWORD 65535 Compu_EGR_deice_rpm_rate 0 65535 /end CHARACTERISTIC
/begin COMPU_METHOD Compu_EGR_deice_rpm_rate " " RAT_FUNC "%.0" "rpm/s" COEFFS 0 1 0 0 0 1 /end COMPU_METHOD
/begin CHARACTERISTIC EGR_deice_pre_tm "EGR de-icing pre-purge delay" VALUE 0x001409ac /* @ECU_Address@EGR_deice_pre_tm@0x010128F8@ */ ECIPP_ALIGNMENT_UBYTE 255 Compu_EGR_deice_pre_tm 0 255 /end CHARACTERISTIC
/begin COMPU_METHOD Compu_EGR_deice_pre_tm " " RAT_FUNC "%.0" "sec" COEFFS 0 1 0 0 0 1 /end COMPU_METHOD
/begin CHARACTERISTIC EGR_deice_post_tm "EGR de-icing post-purge delay" VALUE 0x001409ab /* @ECU_Address@EGR_deice_post_tm@0x01012900@ */ ECIPP_ALIGNMENT_UBYTE 255 Compu_EGR_deice_post_tm 0 255 /end CHARACTERISTIC
/begin COMPU_METHOD Compu_EGR_deice_post_tm " " RAT_FUNC "%.0" "sec" COEFFS 0 1 0 0 0 1 /end COMPU_METHOD
/begin CHARACTERISTIC EGR_deice_purge_IAT "EGR de-icing purge target IAT" VALUE 0x001408ca /* @ECU_Address@EGR_deice_purge_IAT@0x01012908@ */ ECIPP_ALIGNMENT_UWORD 564 Compu_EGR_deice_purge_IAT -460 563.984375 /end CHARACTERISTIC
/begin COMPU_METHOD Compu_EGR_deice_purge_IAT " " RAT_FUNC "%.1" "deg F" COEFFS 0 64 29440 0 0 1 /end COMPU_METHOD
/begin MEASUREMENT EGR_sensor_trust "EGR sensor trust{EGR_sensor_trust&0xff=0xb0:Untrusted: de-icing}{EGR_sensor_trust&0xff=0xc0:Untrusted: ECT low}{EGR_sensor_trust&0xff=0xd0:EGRdP untrusted}{EGR_sensor_trust&0xff=0xe0:EGRHP untrusted}{EGR_sensor_trust&0xff=0xf0:Untrusted}{EGR_sensor_trust&" SBYTE EGR_sensor_trust_COMPU_VTAB 0 0 -127 128 ECU_ADDRESS 0x01012920 BIT_MASK 0xff /end MEASUREMENT
/begin COMPU_METHOD EGR_sensor_trust_COMPU_VTAB "Verbal Table" TAB_VERB "%.0" "list" COMPU_TAB_REF EGR_sensor_trust_COMPU_VTAB_REF /end COMPU_METHOD
/begin COMPU_VTAB EGR_sensor_trust_COMPU_VTAB_REF "Verbal Table" TAB_VERB 8 0xb0 "Untrusted: de-icing" 0xc0 "Untrusted: ECT low" 0xd0 "EGRdP untrusted" 0xe0 "EGRHP untrusted" 0xf0 "Untrusted" 0x00 "Trust pending" 0x10 "Trusted" 0x20 "Trusted until next key cycle" DEFAULT_VALUE "UNKNOWN" /end COMPU_VTAB
/begin CHARACTERISTIC EGRdP_trust_zero_dz "EGRdP trust deadzone" VALUE 0x0014091c /* @ECU_Address@EGRdP_trust_zero_dz@0x010129B0@ */ ECIPP_ALIGNMENT_UWORD 64 Compu_EGRdP_trust_zero_dz 0 63.9990234375 /end CHARACTERISTIC
/begin COMPU_METHOD Compu_EGRdP_trust_zero_dz " " RAT_FUNC "%.3" "psi" COEFFS 0 1024 0 0 0 1 /end COMPU_METHOD
/begin CHARACTERISTIC EGRdP_trust_latch_tm "EGRdP trust latch time" VALUE 0x0014091a /* @ECU_Address@EGRdP_trust_latch_tm@0x010129B8@ */ ECIPP_ALIGNMENT_UWORD 65535 Compu_EGRdP_trust_latch_tm 0 65535 /end CHARACTERISTIC
/begin COMPU_METHOD Compu_EGRdP_trust_latch_tm " " RAT_FUNC "%.0" "sec" COEFFS 0 1 0 0 0 1 /end COMPU_METHOD
/begin MEASUREMENT EGRdP_trust_pct "EGRdP trust level" UWORD Compu_EGRdP_trust_pct 0 0 0 99.9984741210938 ECU_ADDRESS 0x010129C0 /end MEASUREMENT
/begin COMPU_METHOD Compu_EGRdP_trust_pct " " RAT_FUNC "%.1" "%" COEFFS 0 655.36 0 0 0 1 /end COMPU_METHOD
/begin MEASUREMENT EGRHP_trust_mdl_err "EGRHP trust model error" UWORD Compu_EGRHP_trust_mdl_err 0 0 0 255.99609375 ECU_ADDRESS 0x010129C8 /end MEASUREMENT
/begin COMPU_METHOD Compu_EGRHP_trust_mdl_err " " RAT_FUNC "%.2" "psi" COEFFS 0 256 0 0 0 1 /end COMPU_METHOD
/begin CHARACTERISTIC EGRHP_trust_mdl_dz "EGRHP trust model error deadzone" VALUE 0x00140884 /* @ECU_Address@EGRHP_trust_mdl_dz@0x010129D0@ */ ECIPP_ALIGNMENT_UWORD 256 Compu_EGRHP_trust_mdl_dz 0 255.99609375 /end CHARACTERISTIC
/begin COMPU_METHOD Compu_EGRHP_trust_mdl_dz " " RAT_FUNC "%.2" "psi" COEFFS 0 256 0 0 0 1 /end COMPU_METHOD
/begin CHARACTERISTIC EGRHP_trust_latch_tm "EGRHP trust latch time" VALUE 0x00140882 /* @ECU_Address@EGRHP_trust_latch_tm@0x010129D8@ */ ECIPP_ALIGNMENT_UWORD 65535 Compu_EGRHP_trust_latch_tm 0 65535 /end CHARACTERISTIC
/begin COMPU_METHOD Compu_EGRHP_trust_latch_tm " " RAT_FUNC "%.0" "sec" COEFFS 0 1 0 0 0 1 /end COMPU_METHOD
/begin CHARACTERISTIC EGRHP_trust_unlatcht "EGRHP trust unlatch time" VALUE 0x00140886 /* @ECU_Address@EGRHP_trust_unlatcht@0x010129E0@ */ ECIPP_ALIGNMENT_UWORD 65535 Compu_EGRHP_trust_unlatcht 0 65535 /end CHARACTERISTIC
/begin COMPU_METHOD Compu_EGRHP_trust_unlatcht " " RAT_FUNC "%.0" "sec" COEFFS 0 1 0 0 0 1 /end COMPU_METHOD
/begin MEASUREMENT EGRHP_trust_pct "EGRHP trust level" UWORD Compu_EGRHP_trust_pct 0 0 0 99.9984741210938 ECU_ADDRESS 0x010129E8 /end MEASUREMENT
/begin COMPU_METHOD Compu_EGRHP_trust_pct " " RAT_FUNC "%.1" "%" COEFFS 0 655.36 0 0 0 1 /end COMPU_METHOD
/begin CHARACTERISTIC EGR_senstrst_flt_tm "EGR sensor trustworthiness fault delay" VALUE 0x001401ac /* @ECU_Address@EGR_senstrst_flt_tm@0x010129F0@ */ ECIPP_ALIGNMENT_ULONG 4294967 Compu_EGR_senstrst_flt_tm 0 4294967.295 /end CHARACTERISTIC
/begin COMPU_METHOD Compu_EGR_senstrst_flt_tm " " RAT_FUNC "%.1" "sec" COEFFS 0 1000 0 0 0 1 /end COMPU_METHOD
/begin MEASUREMENT EGR_senstrst_flt_tmr "EGR sensor trustworthiness fault timer" ULONG Compu_EGR_senstrst_flt_tmr 0 0 0 4294967.295 ECU_ADDRESS 0x010129F8 /end MEASUREMENT
/begin COMPU_METHOD Compu_EGR_senstrst_flt_tmr " " RAT_FUNC "%.1" "sec" COEFFS 0 1000 0 0 0 1 /end COMPU_METHOD
/begin CHARACTERISTIC EGR_senstrst_ECTfrac "EGR sensor trustworthiness ECT min/nom threshold" VALUE 0x001401c6 /* @ECU_Address@EGR_senstrst_ECTfrac@0x01012A00@ */ ECIPP_ALIGNMENT_SWORD 2 Compu_EGR_senstrst_ECTfrac -2 1.99993896484375 /end CHARACTERISTIC
/begin COMPU_METHOD Compu_EGR_senstrst_ECTfrac " " RAT_FUNC "%.2" "-" COEFFS 0 16384 0 0 0 1 /end COMPU_METHOD
/begin MEASUREMENT EGR_minnom_senstrst "EGR sensor trustworthiness min/nom request" SWORD Compu_EGR_minnom_senstrst 0 0 -2 1.99993896484375 ECU_ADDRESS 0x01012A08 /end MEASUREMENT
/begin COMPU_METHOD Compu_EGR_minnom_senstrst " " RAT_FUNC "%.2" "-" COEFFS 0 16384 0 0 0 1 /end COMPU_METHOD
/begin CHARACTERISTIC mdot_EGR_ON "Diluent flow command 'on' limit" VALUE 0x00140982 /* @ECU_Address@mdot_EGR_ON@0x01012A10@ */ ECIPP_ALIGNMENT_UWORD 1024 Compu_mdot_EGR_ON 0 1023.984375 /end CHARACTERISTIC
/begin COMPU_METHOD Compu_mdot_EGR_ON " " RAT_FUNC "%.2" "g/sec" COEFFS 0 64 0 0 0 1 /end COMPU_METHOD
/begin CHARACTERISTIC mdot_EGR_OFF "Diluent flow command 'off' limit" VALUE 0x00140980 /* @ECU_Address@mdot_EGR_OFF@0x01012A18@ */ ECIPP_ALIGNMENT_UWORD 1024 Compu_mdot_EGR_OFF 0 1023.984375 /end CHARACTERISTIC
/begin COMPU_METHOD Compu_mdot_EGR_OFF " " RAT_FUNC "%.2" "g/sec" COEFFS 0 64 0 0 0 1 /end COMPU_METHOD
/begin CHARACTERISTIC mdot_EGR_ON_cold "Cold diluent flow command 'on' limit" VALUE 0x00140984 /* @ECU_Address@mdot_EGR_ON_cold@0x01012B18@ */ ECIPP_ALIGNMENT_UWORD 1024 Compu_mdot_EGR_ON_cold 0 1023.984375 /end CHARACTERISTIC
/begin COMPU_METHOD Compu_mdot_EGR_ON_cold " " RAT_FUNC "%.2" "g/sec" COEFFS 0 64 0 0 0 1 /end COMPU_METHOD
/begin CHARACTERISTIC EGR_ON_cold_IAT "Max. IAT for cold diluent flow command 'on' limit" VALUE 0x001408aa /* @ECU_Address@EGR_ON_cold_IAT@0x01012B20@ */ ECIPP_ALIGNMENT_UWORD 564 Compu_EGR_ON_cold_IAT -460 563.984375 /end CHARACTERISTIC
/begin COMPU_METHOD Compu_EGR_ON_cold_IAT " " RAT_FUNC "%.1" "deg F" COEFFS 0 64 29440 0 0 1 /end COMPU_METHOD
/begin CHARACTERISTIC EGR_initpct_reduct "EGR initial % command reduction" VALUE 0x001408da /* @ECU_Address@EGR_initpct_reduct@0x01012D00@ */ ECIPP_ALIGNMENT_UWORD 100 Compu_EGR_initpct_reduct 0 99.9984741210938 /end CHARACTERISTIC
/begin COMPU_METHOD Compu_EGR_initpct_reduct " " RAT_FUNC "%.1" "%" COEFFS 0 655.36 0 0 0 1 /end COMPU_METHOD
/begin MEASUREMENT EGR_initpct_accmd "Acc flow for % cmd reduct" ULONG Compu_EGR_initpct_accmd 0 0 0 67.108863984375 ECU_ADDRESS 0x01012D08 /end MEASUREMENT
/begin COMPU_METHOD Compu_EGR_initpct_accmd " " RAT_FUNC "%.2" "kg" COEFFS 0 64000000 0 0 0 1 /end COMPU_METHOD
/begin CHARACTERISTIC EGR_initpct_accmdmax "Max acc flow for % cmd reduct" VALUE 0x001408d8 /* @ECU_Address@EGR_initpct_accmdmax@0x01012D10@ */ ECIPP_ALIGNMENT_UWORD 64 Compu_EGR_initpct_accmdmax 0 63.9990234375 /end CHARACTERISTIC
/begin COMPU_METHOD Compu_EGR_initpct_accmdmax " " RAT_FUNC "%.2" "kg" COEFFS 0 1024 0 0 0 1 /end COMPU_METHOD
/begin MEASUREMENT m_d_pct_req_lp "EGR diluent request" UWORD Compu_m_d_pct_req_lp 0 0 0 399.993896484375 ECU_ADDRESS 0x01012D18 /end MEASUREMENT
/begin COMPU_METHOD Compu_m_d_pct_req_lp " " RAT_FUNC "%.1" "% dil" COEFFS 0 163.84 0 0 0 1 /end COMPU_METHOD
/begin MEASUREMENT mdot_EGR_req "EGR requested flow" FLOAT32_IEEE Compu_mdot_EGR_req 0 0 -10000000000 10000000000 ECU_ADDRESS 0x01012D20 /end MEASUREMENT
/begin COMPU_METHOD Compu_mdot_EGR_req " " RAT_FUNC "%.2" "g/sec" COEFFS 0 1 0 0 0 1 /end COMPU_METHOD
/begin CHARACTERISTIC mdot_EGR_inc_max "EGR flow max inc cmd slew rate" VALUE 0x001401a0 /* @ECU_Address@mdot_EGR_inc_max@0x01012D28@ */ ECIPP_ALIGNMENT_FLOAT32_IEEE 10000000000 Compu_mdot_EGR_inc_max -10000000000 10000000000 /end CHARACTERISTIC
/begin COMPU_METHOD Compu_mdot_EGR_inc_max " " RAT_FUNC "%.1" "g/sec/sec" COEFFS 0 1 0 0 0 1 /end COMPU_METHOD
/begin CHARACTERISTIC EGR_spkex_pdspanmin "Nom-min for average spk sens" VALUE 0x001408ee /* @ECU_Address@EGR_spkex_pdspanmin@0x01012D30@ */ ECIPP_ALIGNMENT_UWORD 400 Compu_EGR_spkex_pdspanmin 0 399.993896484375 /end CHARACTERISTIC
/begin COMPU_METHOD Compu_EGR_spkex_pdspanmin " " RAT_FUNC "%.1" "% dil" COEFFS 0 163.84 0 0 0 1 /end COMPU_METHOD
/begin CHARACTERISTIC EGR_spkex_pdspanmax "Nom-min for calculated spk sens" VALUE 0x001408ec /* @ECU_Address@EGR_spkex_pdspanmax@0x01012D38@ */ ECIPP_ALIGNMENT_UWORD 400 Compu_EGR_spkex_pdspanmax 0 399.993896484375 /end CHARACTERISTIC
/begin COMPU_METHOD Compu_EGR_spkex_pdspanmax " " RAT_FUNC "%.1" "% dil" COEFFS 0 163.84 0 0 0 1 /end COMPU_METHOD
/begin MEASUREMENT mdot_EGR_zero_tmr "Zero flow timer for % cmd reduct" ULONG Compu_mdot_EGR_zero_tmr 0 0 0 4294967.295 ECU_ADDRESS 0x01012D40 /end MEASUREMENT
/begin COMPU_METHOD Compu_mdot_EGR_zero_tmr " " RAT_FUNC "%.1" "sec" COEFFS 0 1000 0 0 0 1 /end COMPU_METHOD
/begin CHARACTERISTIC EGR_initpct_0md_tm "0 flow time for inc % cmd reduct" VALUE 0x001408d6 /* @ECU_Address@EGR_initpct_0md_tm@0x01012D48@ */ ECIPP_ALIGNMENT_UWORD 65535 Compu_EGR_initpct_0md_tm 0 65535 /end CHARACTERISTIC
/begin COMPU_METHOD Compu_EGR_initpct_0md_tm " " RAT_FUNC "%.0" "sec" COEFFS 0 1 0 0 0 1 /end COMPU_METHOD
/begin CHARACTERISTIC EGR_initpct_0md_slew "% cmd reduct inc rate at 0 flow" VALUE 0x001408d4 /* @ECU_Address@EGR_initpct_0md_slew@0x01012D50@ */ ECIPP_ALIGNMENT_UWORD 100 Compu_EGR_initpct_0md_slew 0 99.9984741210938 /end CHARACTERISTIC
/begin COMPU_METHOD Compu_EGR_initpct_0md_slew " " RAT_FUNC "%.1" "%/sec" COEFFS 0 655.36 0 0 0 1 /end COMPU_METHOD
/begin MEASUREMENT EGR_stuckvlv_state "Stuck EGR valve diagnostic state{EGR_stuckvlv_state&0xff=0:Inactive}{EGR_stuckvlv_state&0xff=1:Inactive: de-icing}{EGR_stuckvlv_state&0xff=2:Monitoring}{EGR_stuckvlv_state&0xff=10:Monitoring: DC high}{EGR_stuckvlv_state&0xff=20:Active: resting}{EGR_stuckv" UBYTE EGR_stuckvlv_state_COMPU_VTAB 0 0 0 255 ECU_ADDRESS 0x01012F18 BIT_MASK 0xff /end MEASUREMENT
/begin COMPU_METHOD EGR_stuckvlv_state_COMPU_VTAB "Verbal Table" TAB_VERB "%.0" "list" COMPU_TAB_REF EGR_stuckvlv_state_COMPU_VTAB_REF /end COMPU_METHOD
/begin COMPU_VTAB EGR_stuckvlv_state_COMPU_VTAB_REF "Verbal Table" TAB_VERB 9 0 "Inactive" 1 "Inactive: de-icing" 2 "Monitoring" 10 "Monitoring: DC high" 20 "Active: resting" 21 "Active: closing valve" 22 "Active: opening valve" 30 "Stuck" 31 "Stuck: key-off" DEFAULT_VALUE "UNKNOWN" /end COMPU_VTAB
/begin MEASUREMENT EGR_stuckvlv_dc_lp "Stuck EGR valve low-passed duty cycle" SWORD Compu_EGR_stuckvlv_dc_lp 0 0 -100 99.9969482421875 ECU_ADDRESS 0x01012F20 /end MEASUREMENT
/begin COMPU_METHOD Compu_EGR_stuckvlv_dc_lp " " RAT_FUNC "%.1" "%" COEFFS 0 327.68 0 0 0 1 /end COMPU_METHOD
/begin MEASUREMENT EGR_stuckvlv_tmr_max "Stuck EGR valve peak time outside thresholds" UWORD Compu_EGR_stuckvlv_tmr_max 0 0 0 65535 ECU_ADDRESS 0x01012F28 /end MEASUREMENT
/begin COMPU_METHOD Compu_EGR_stuckvlv_tmr_max " " RAT_FUNC "%.0" "ms" COEFFS 0 1 0 0 0 1 /end COMPU_METHOD
/begin MEASUREMENT RTC_sec_epoch "Current date/time" ULONG Compu_RTC_sec_epoch 0 0 951868672 9004932350.125 ECU_ADDRESS 0x010134C8 /end MEASUREMENT
/begin COMPU_METHOD Compu_RTC_sec_epoch " " RAT_FUNC "%.0" "-" COEFFS 0 0.533333333333333 -507663291.733333 0 0 1 /end COMPU_METHOD
/begin MEASUREMENT TRAT_engstop_rtc "Last engine stop date/time" ULONG Compu_TRAT_engstop_rtc 0 0 951868672 9004932350.125 ECU_ADDRESS 0x010134D0 /end MEASUREMENT
/begin COMPU_METHOD Compu_TRAT_engstop_rtc " " RAT_FUNC "%.0" "-" COEFFS 0 0.533333333333333 -507663291.733333 0 0 1 /end COMPU_METHOD
/begin MEASUREMENT TRAT_state "Temperature rationality state{TRAT_state&0xff=0:Disabled}{TRAT_state&0xff=1:Armed}{TRAT_state&0xff=10:Enabled}{TRAT_state&0xff=11:Active: crank delay}{TRAT_state&0xff=12:Active: sampling}{TRAT_state&0xff=13:Active: awaiting diagnostics}{TRAT_state&0xff=20" UBYTE TRAT_state_COMPU_VTAB 0 0 0 255 ECU_ADDRESS 0x010134E0 BIT_MASK 0xff /end MEASUREMENT
/begin COMPU_METHOD TRAT_state_COMPU_VTAB "Verbal Table" TAB_VERB "%.0" "list" COMPU_TAB_REF TRAT_state_COMPU_VTAB_REF /end COMPU_METHOD
/begin COMPU_VTAB TRAT_state_COMPU_VTAB_REF "Verbal Table" TAB_VERB 16 0 "Disabled" 1 "Armed" 10 "Enabled" 11 "Active: crank delay" 12 "Active: sampling" 13 "Active: awaiting diagnostics" 20 "Inactive: key off" 21 "Inactive: insufficient cooling time" 22 "Inactive: AAT low" 23 "Inactive: AAT unavailable" 30 "Inactive: crank time limit" 31 "Inactive for key cycle" 32 "Complete" 40 "Failed: out of range" 41 "Failed: ECT out of range" 42 "Diagnostics failed" DEFAULT_VALUE "UNKNOWN" /end COMPU_VTAB
/begin MEASUREMENT TRAT_tmr "Temperature rationality timer" UWORD Compu_TRAT_tmr 0 0 0 65.535 ECU_ADDRESS 0x010134E8 /end MEASUREMENT
/begin COMPU_METHOD Compu_TRAT_tmr " " RAT_FUNC "%.1" "-" COEFFS 0 1000 0 0 0 1 /end COMPU_METHOD
/begin MEASUREMENT TRAT_ECT_state "Temp. rationality ECT sampling state{TRAT_ECT_state&0xff=0:Disabled}{TRAT_ECT_state&0xff=1:Sampling}{TRAT_ECT_state&0xff=2:Awaiting diagnostics}{TRAT_ECT_state&0xff=10:Inactive}{TRAT_ECT_state&0xff=11:Aborted}{TRAT_ECT_state&0xff=12:Diagnostics failed}{TR" UBYTE TRAT_ECT_state_COMPU_VTAB 0 0 0 255 ECU_ADDRESS 0x01013508 BIT_MASK 0xff /end MEASUREMENT
/begin COMPU_METHOD TRAT_ECT_state_COMPU_VTAB "Verbal Table" TAB_VERB "%.0" "list" COMPU_TAB_REF TRAT_ECT_state_COMPU_VTAB_REF /end COMPU_METHOD
/begin COMPU_VTAB TRAT_ECT_state_COMPU_VTAB_REF "Verbal Table" TAB_VERB 9 0 "Disabled" 1 "Sampling" 2 "Awaiting diagnostics" 10 "Inactive" 11 "Aborted" 12 "Diagnostics failed" 13 "Out of range" 14 "Complete" 15 "Sampling time expired" DEFAULT_VALUE "UNKNOWN" /end COMPU_VTAB
/begin MEASUREMENT TRAT_ECT_avg "Temp. rationality ECT average" UWORD Compu_TRAT_ECT_avg 0 0 -460 563.984375 ECU_ADDRESS 0x01013510 /end MEASUREMENT
/begin COMPU_METHOD Compu_TRAT_ECT_avg " " RAT_FUNC "%.1" "-" COEFFS 0 64 29440 0 0 1 /end COMPU_METHOD
/begin MEASUREMENT TRAT_IAT_state "Temp. rationality IAT sampling state{TRAT_IAT_state&0xff=0:Disabled}{TRAT_IAT_state&0xff=1:Sampling}{TRAT_IAT_state&0xff=2:Awaiting diagnostics}{TRAT_IAT_state&0xff=10:Inactive}{TRAT_IAT_state&0xff=11:Aborted}{TRAT_IAT_state&0xff=12:Diagnostics failed}{TR" UBYTE TRAT_IAT_state_COMPU_VTAB 0 0 0 255 ECU_ADDRESS 0x01013520 BIT_MASK 0xff /end MEASUREMENT
/begin COMPU_METHOD TRAT_IAT_state_COMPU_VTAB "Verbal Table" TAB_VERB "%.0" "list" COMPU_TAB_REF TRAT_IAT_state_COMPU_VTAB_REF /end COMPU_METHOD
/begin COMPU_VTAB TRAT_IAT_state_COMPU_VTAB_REF "Verbal Table" TAB_VERB 9 0 "Disabled" 1 "Sampling" 2 "Awaiting diagnostics" 10 "Inactive" 11 "Aborted" 12 "Diagnostics failed" 13 "Out of range" 14 "Complete" 15 "Sampling time expired" DEFAULT_VALUE "UNKNOWN" /end COMPU_VTAB
/begin MEASUREMENT TRAT_IAT_avg "Temp. rationality IAT average" UWORD Compu_TRAT_IAT_avg 0 0 -460 563.984375 ECU_ADDRESS 0x01013528 /end MEASUREMENT
/begin COMPU_METHOD Compu_TRAT_IAT_avg " " RAT_FUNC "%.1" "-" COEFFS 0 64 29440 0 0 1 /end COMPU_METHOD
/begin MEASUREMENT TRAT_AAT_state "Temp. rationality AAT sampling state{TRAT_AAT_state&0xff=0:Disabled}{TRAT_AAT_state&0xff=1:Sampling}{TRAT_AAT_state&0xff=2:Awaiting diagnostics}{TRAT_AAT_state&0xff=10:Inactive}{TRAT_AAT_state&0xff=11:Aborted}{TRAT_AAT_state&0xff=12:Diagnostics failed}{TR" UBYTE TRAT_AAT_state_COMPU_VTAB 0 0 0 255 ECU_ADDRESS 0x01013538 BIT_MASK 0xff /end MEASUREMENT
/begin COMPU_METHOD TRAT_AAT_state_COMPU_VTAB "Verbal Table" TAB_VERB "%.0" "list" COMPU_TAB_REF TRAT_AAT_state_COMPU_VTAB_REF /end COMPU_METHOD
/begin COMPU_VTAB TRAT_AAT_state_COMPU_VTAB_REF "Verbal Table" TAB_VERB 9 0 "Disabled" 1 "Sampling" 2 "Awaiting diagnostics" 10 "Inactive" 11 "Aborted" 12 "Diagnostics failed" 13 "Out of range" 14 "Complete" 15 "Sampling time expired" DEFAULT_VALUE "UNKNOWN" /end COMPU_VTAB
/begin MEASUREMENT TRAT_AAT_avg "Temp. rationality AAT average" UWORD Compu_TRAT_AAT_avg 0 0 -460 563.984375 ECU_ADDRESS 0x01013540 /end MEASUREMENT
/begin COMPU_METHOD Compu_TRAT_AAT_avg " " RAT_FUNC "%.1" "-" COEFFS 0 64 29440 0 0 1 /end COMPU_METHOD
/begin MEASUREMENT TRAT_EGRT_state "Temp. rationality EGRT sampling state{TRAT_EGRT_state&0xff=0:Disabled}{TRAT_EGRT_state&0xff=1:Sampling}{TRAT_EGRT_state&0xff=2:Awaiting diagnostics}{TRAT_EGRT_state&0xff=10:Inactive}{TRAT_EGRT_state&0xff=11:Aborted}{TRAT_EGRT_state&0xff=12:Diagnostics fai" UBYTE TRAT_EGRT_state_COMPU_VTAB 0 0 0 255 ECU_ADDRESS 0x01013550 BIT_MASK 0xff /end MEASUREMENT
/begin COMPU_METHOD TRAT_EGRT_state_COMPU_VTAB "Verbal Table" TAB_VERB "%.0" "list" COMPU_TAB_REF TRAT_EGRT_state_COMPU_VTAB_REF /end COMPU_METHOD
/begin COMPU_VTAB TRAT_EGRT_state_COMPU_VTAB_REF "Verbal Table" TAB_VERB 9 0 "Disabled" 1 "Sampling" 2 "Awaiting diagnostics" 10 "Inactive" 11 "Aborted" 12 "Diagnostics failed" 13 "Out of range" 14 "Complete" 15 "Sampling time expired" DEFAULT_VALUE "UNKNOWN" /end COMPU_VTAB
/begin MEASUREMENT TRAT_EGRT_avg "Temp. rationality EGRT average" UWORD Compu_TRAT_EGRT_avg 0 0 -460 7731.875 ECU_ADDRESS 0x01013558 /end MEASUREMENT
/begin COMPU_METHOD Compu_TRAT_EGRT_avg " " RAT_FUNC "%.1" "-" COEFFS 0 8 3680 0 0 1 /end COMPU_METHOD
/begin MEASUREMENT TRAT_FT_state "Temp. rationality FT sampling state{TRAT_FT_state&0xff=0:Disabled}{TRAT_FT_state&0xff=1:Sampling}{TRAT_FT_state&0xff=2:Awaiting diagnostics}{TRAT_FT_state&0xff=10:Inactive}{TRAT_FT_state&0xff=11:Aborted}{TRAT_FT_state&0xff=12:Diagnostics failed}{TRAT_FT_s" UBYTE TRAT_FT_state_COMPU_VTAB 0 0 0 255 ECU_ADDRESS 0x01013568 BIT_MASK 0xff /end MEASUREMENT
/begin COMPU_METHOD TRAT_FT_state_COMPU_VTAB "Verbal Table" TAB_VERB "%.0" "list" COMPU_TAB_REF TRAT_FT_state_COMPU_VTAB_REF /end COMPU_METHOD
/begin COMPU_VTAB TRAT_FT_state_COMPU_VTAB_REF "Verbal Table" TAB_VERB 9 0 "Disabled" 1 "Sampling" 2 "Awaiting diagnostics" 10 "Inactive" 11 "Aborted" 12 "Diagnostics failed" 13 "Out of range" 14 "Complete" 15 "Sampling time expired" DEFAULT_VALUE "UNKNOWN" /end COMPU_VTAB
/begin MEASUREMENT TRAT_FT_avg "Temp. rationality FT average" UWORD Compu_TRAT_FT_avg 0 0 -460 563.984375 ECU_ADDRESS 0x01013570 /end MEASUREMENT
/begin COMPU_METHOD Compu_TRAT_FT_avg " " RAT_FUNC "%.1" "-" COEFFS 0 64 29440 0 0 1 /end COMPU_METHOD
/begin MEASUREMENT TRAT_OILT_state "Temp. rationality OILT sampling state{TRAT_OILT_state&0xff=0:Disabled}{TRAT_OILT_state&0xff=1:Sampling}{TRAT_OILT_state&0xff=2:Awaiting diagnostics}{TRAT_OILT_state&0xff=10:Inactive}{TRAT_OILT_state&0xff=11:Aborted}{TRAT_OILT_state&0xff=12:Diagnostics fai" UBYTE TRAT_OILT_state_COMPU_VTAB 0 0 0 255 ECU_ADDRESS 0x01013580 BIT_MASK 0xff /end MEASUREMENT
/begin COMPU_METHOD TRAT_OILT_state_COMPU_VTAB "Verbal Table" TAB_VERB "%.0" "list" COMPU_TAB_REF TRAT_OILT_state_COMPU_VTAB_REF /end COMPU_METHOD
/begin COMPU_VTAB TRAT_OILT_state_COMPU_VTAB_REF "Verbal Table" TAB_VERB 9 0 "Disabled" 1 "Sampling" 2 "Awaiting diagnostics" 10 "Inactive" 11 "Aborted" 12 "Diagnostics failed" 13 "Out of range" 14 "Complete" 15 "Sampling time expired" DEFAULT_VALUE "UNKNOWN" /end COMPU_VTAB
/begin MEASUREMENT TRAT_OILT_avg "Temp. rationality OILT average" UWORD Compu_TRAT_OILT_avg 0 0 -460 7731.875 ECU_ADDRESS 0x01013588 /end MEASUREMENT
/begin COMPU_METHOD Compu_TRAT_OILT_avg " " RAT_FUNC "%.1" "-" COEFFS 0 8 3680 0 0 1 /end COMPU_METHOD
/begin MEASUREMENT TRAT_EGT_state "Temp. rationality EGT sampling state{TRAT_EGT_state&0xff=0:Disabled}{TRAT_EGT_state&0xff=1:Sampling}{TRAT_EGT_state&0xff=2:Awaiting diagnostics}{TRAT_EGT_state&0xff=10:Inactive}{TRAT_EGT_state&0xff=11:Aborted}{TRAT_EGT_state&0xff=12:Diagnostics failed}{TR" UBYTE TRAT_EGT_state_COMPU_VTAB 0 0 0 255 ECU_ADDRESS 0x01013598 BIT_MASK 0xff /end MEASUREMENT
/begin COMPU_METHOD TRAT_EGT_state_COMPU_VTAB "Verbal Table" TAB_VERB "%.0" "list" COMPU_TAB_REF TRAT_EGT_state_COMPU_VTAB_REF /end COMPU_METHOD
/begin COMPU_VTAB TRAT_EGT_state_COMPU_VTAB_REF "Verbal Table" TAB_VERB 9 0 "Disabled" 1 "Sampling" 2 "Awaiting diagnostics" 10 "Inactive" 11 "Aborted" 12 "Diagnostics failed" 13 "Out of range" 14 "Complete" 15 "Sampling time expired" DEFAULT_VALUE "UNKNOWN" /end COMPU_VTAB
/begin MEASUREMENT TRAT_EGT_avg "Temp. rationality EGT average" UWORD Compu_TRAT_EGT_avg 0 0 -460 7731.875 ECU_ADDRESS 0x010135A0 /end MEASUREMENT
/begin COMPU_METHOD Compu_TRAT_EGT_avg " " RAT_FUNC "%.1" "-" COEFFS 0 8 3680 0 0 1 /end COMPU_METHOD
/begin MEASUREMENT TRAT_TIAT_state "Temp. rationality TIAT sampling state{TRAT_TIAT_state&0xff=0:Disabled}{TRAT_TIAT_state&0xff=1:Sampling}{TRAT_TIAT_state&0xff=2:Awaiting diagnostics}{TRAT_TIAT_state&0xff=10:Inactive}{TRAT_TIAT_state&0xff=11:Aborted}{TRAT_TIAT_state&0xff=12:Diagnostics fai" UBYTE TRAT_TIAT_state_COMPU_VTAB 0 0 0 255 ECU_ADDRESS 0x010135B0 BIT_MASK 0xff /end MEASUREMENT
/begin COMPU_METHOD TRAT_TIAT_state_COMPU_VTAB "Verbal Table" TAB_VERB "%.0" "list" COMPU_TAB_REF TRAT_TIAT_state_COMPU_VTAB_REF /end COMPU_METHOD
/begin COMPU_VTAB TRAT_TIAT_state_COMPU_VTAB_REF "Verbal Table" TAB_VERB 9 0 "Disabled" 1 "Sampling" 2 "Awaiting diagnostics" 10 "Inactive" 11 "Aborted" 12 "Diagnostics failed" 13 "Out of range" 14 "Complete" 15 "Sampling time expired" DEFAULT_VALUE "UNKNOWN" /end COMPU_VTAB
/begin MEASUREMENT TRAT_TIAT_avg "Temp. rationality TIAT average" UWORD Compu_TRAT_TIAT_avg 0 0 -460 7731.875 ECU_ADDRESS 0x010135B8 /end MEASUREMENT
/begin COMPU_METHOD Compu_TRAT_TIAT_avg " " RAT_FUNC "%.1" "-" COEFFS 0 8 3680 0 0 1 /end COMPU_METHOD
/begin CHARACTERISTIC TRAT_TAUX_n1 "Temp. rationality TAUX sensor #1 (Fault Condition:where AUX Temperature X is TAUX)" VALUE 0x00169606 /* @ECU_Address@TRAT_TAUX_n1@0x010135C8@ */ ECIPP_ALIGNMENT_UBYTE 255 Compu_TRAT_TAUX_n1 1 256 /end CHARACTERISTIC
/begin COMPU_METHOD Compu_TRAT_TAUX_n1 " " RAT_FUNC "%.0" "-" COEFFS 0 1 -1 0 0 1 /end COMPU_METHOD
/begin MEASUREMENT TRAT_TAUX_n1_state "Temp. rationality TAUX #1 sampling state{TRAT_TAUX_n1_state&0xff=0:Disabled}{TRAT_TAUX_n1_state&0xff=1:Sampling}{TRAT_TAUX_n1_state&0xff=2:Awaiting diagnostics}{TRAT_TAUX_n1_state&0xff=10:Inactive}{TRAT_TAUX_n1_state&0xff=11:Aborted}{TRAT_TAUX_n1_state&0x" UBYTE TRAT_TAUX_n1_state_COMPU_VTAB 0 0 0 255 ECU_ADDRESS 0x010135D0 BIT_MASK 0xff /end MEASUREMENT
/begin COMPU_METHOD TRAT_TAUX_n1_state_COMPU_VTAB "Verbal Table" TAB_VERB "%.0" "list" COMPU_TAB_REF TRAT_TAUX_n1_state_COMPU_VTAB_REF /end COMPU_METHOD
/begin COMPU_VTAB TRAT_TAUX_n1_state_COMPU_VTAB_REF "Verbal Table" TAB_VERB 9 0 "Disabled" 1 "Sampling" 2 "Awaiting diagnostics" 10 "Inactive" 11 "Aborted" 12 "Diagnostics failed" 13 "Out of range" 14 "Complete" 15 "Sampling time expired" DEFAULT_VALUE "UNKNOWN" /end COMPU_VTAB
/begin MEASUREMENT TRAT_TAUX_n1_avg "Temp. rationality TAUX #1 average" UWORD Compu_TRAT_TAUX_n1_avg 0 0 -460 7731.875 ECU_ADDRESS 0x010135D8 /end MEASUREMENT
/begin COMPU_METHOD Compu_TRAT_TAUX_n1_avg " " RAT_FUNC "%.1" "-" COEFFS 0 8 3680 0 0 1 /end COMPU_METHOD
/begin CHARACTERISTIC TRAT_TAUX_n2 "Temp. rationality TAUX sensor #2 (Fault Condition:where AUX Temperature X is TAUX)" VALUE 0x00169607 /* @ECU_Address@TRAT_TAUX_n2@0x010135E8@ */ ECIPP_ALIGNMENT_UBYTE 255 Compu_TRAT_TAUX_n2 1 256 /end CHARACTERISTIC
/begin COMPU_METHOD Compu_TRAT_TAUX_n2 " " RAT_FUNC "%.0" "-" COEFFS 0 1 -1 0 0 1 /end COMPU_METHOD
/begin MEASUREMENT TRAT_TAUX_n2_state "Temp. rationality TAUX #2 sampling state{TRAT_TAUX_n2_state&0xff=0:Disabled}{TRAT_TAUX_n2_state&0xff=1:Sampling}{TRAT_TAUX_n2_state&0xff=2:Awaiting diagnostics}{TRAT_TAUX_n2_state&0xff=10:Inactive}{TRAT_TAUX_n2_state&0xff=11:Aborted}{TRAT_TAUX_n2_state&0x" UBYTE TRAT_TAUX_n2_state_COMPU_VTAB 0 0 0 255 ECU_ADDRESS 0x010135F0 BIT_MASK 0xff /end MEASUREMENT
/begin COMPU_METHOD TRAT_TAUX_n2_state_COMPU_VTAB "Verbal Table" TAB_VERB "%.0" "list" COMPU_TAB_REF TRAT_TAUX_n2_state_COMPU_VTAB_REF /end COMPU_METHOD
/begin COMPU_VTAB TRAT_TAUX_n2_state_COMPU_VTAB_REF "Verbal Table" TAB_VERB 9 0 "Disabled" 1 "Sampling" 2 "Awaiting diagnostics" 10 "Inactive" 11 "Aborted" 12 "Diagnostics failed" 13 "Out of range" 14 "Complete" 15 "Sampling time expired" DEFAULT_VALUE "UNKNOWN" /end COMPU_VTAB
/begin MEASUREMENT TRAT_TAUX_n2_avg "Temp. rationality TAUX #2 average" UWORD Compu_TRAT_TAUX_n2_avg 0 0 -460 7731.875 ECU_ADDRESS 0x010135F8 /end MEASUREMENT
/begin COMPU_METHOD Compu_TRAT_TAUX_n2_avg " " RAT_FUNC "%.1" "-" COEFFS 0 8 3680 0 0 1 /end COMPU_METHOD
/begin CHARACTERISTIC EFMA_venturi_dP_ena "Venturi EGR mixer enable{EFMA_venturi_dP_ena&0xff=0:Disabled}{EFMA_venturi_dP_ena&0xff=1:Enabled}" VALUE 0x001409a2 /* @ECU_Address@EFMA_venturi_dP_ena@0x010139D8@ */ ECIPP_ALIGNMENT_UBYTE 255 EFMA_venturi_dP_ena_COMPU_VTAB 0 255 BIT_MASK 0xff /end CHARACTERISTIC
/begin COMPU_METHOD EFMA_venturi_dP_ena_COMPU_VTAB "Verbal Table" TAB_VERB "%.0" "list" COMPU_TAB_REF EFMA_venturi_dP_ena_COMPU_VTAB_REF /end COMPU_METHOD
/begin COMPU_VTAB EFMA_venturi_dP_ena_COMPU_VTAB_REF "Verbal Table" TAB_VERB 2 0 "Disabled" 1 "Enabled" DEFAULT_VALUE "UNKNOWN" /end COMPU_VTAB
/begin CHARACTERISTIC EFMA_venturi_dP_C1 "Venturi EGR mixer MAP dP scaling" VALUE 0x0014002c /* @ECU_Address@EFMA_venturi_dP_C1@0x010139E0@ */ ECIPP_ALIGNMENT_FLOAT32_IEEE 10000000000 Compu_EFMA_venturi_dP_C1 -10000000000 10000000000 /end CHARACTERISTIC
/begin COMPU_METHOD Compu_EFMA_venturi_dP_C1 " " RAT_FUNC "%.4" "-" COEFFS 0 1 0 0 0 1 /end COMPU_METHOD
/begin CHARACTERISTIC EFMA_venturi_dP_C2 "Venturi EGR mixer throttle flow dP scaling" VALUE 0x00140030 /* @ECU_Address@EFMA_venturi_dP_C2@0x010139E8@ */ ECIPP_ALIGNMENT_FLOAT32_IEEE 10000000000 Compu_EFMA_venturi_dP_C2 -10000000000 10000000000 /end CHARACTERISTIC
/begin COMPU_METHOD Compu_EFMA_venturi_dP_C2 " " RAT_FUNC "%.4" "mpsi-s/g" COEFFS 0 0.001 0 0 0 1 /end COMPU_METHOD
/begin CHARACTERISTIC EFMA_venturi_dP_C3 "Venturi EGR mixer throttle flow^2 dP scaling" VALUE 0x00140034 /* @ECU_Address@EFMA_venturi_dP_C3@0x010139F0@ */ ECIPP_ALIGNMENT_FLOAT32_IEEE 10000000000 Compu_EFMA_venturi_dP_C3 -10000000000 10000000000 /end CHARACTERISTIC
/begin COMPU_METHOD Compu_EFMA_venturi_dP_C3 " " RAT_FUNC "%.4" "upsi-s^2/g^2" COEFFS 0 0.000001 0 0 0 1 /end COMPU_METHOD
/begin CHARACTERISTIC EFMA_venturi_dP_C4 "Venturi EGR mixer EGR flow dP scaling" VALUE 0x00140038 /* @ECU_Address@EFMA_venturi_dP_C4@0x010139F8@ */ ECIPP_ALIGNMENT_FLOAT32_IEEE 10000000000 Compu_EFMA_venturi_dP_C4 -10000000000 10000000000 /end CHARACTERISTIC
/begin COMPU_METHOD Compu_EFMA_venturi_dP_C4 " " RAT_FUNC "%.4" "mpsi-s/g" COEFFS 0 0.001 0 0 0 1 /end COMPU_METHOD
/begin CHARACTERISTIC EFMA_venturi_dP_C5 "Venturi EGR mixer EGR flow^2 dP scaling" VALUE 0x0014003c /* @ECU_Address@EFMA_venturi_dP_C5@0x01013A00@ */ ECIPP_ALIGNMENT_FLOAT32_IEEE 10000000000 Compu_EFMA_venturi_dP_C5 -10000000000 10000000000 /end CHARACTERISTIC
/begin COMPU_METHOD Compu_EFMA_venturi_dP_C5 " " RAT_FUNC "%.4" "upsi-s^2/g^2" COEFFS 0 0.000001 0 0 0 1 /end COMPU_METHOD
/begin COMPU_METHOD Compu_TTM_EGRA_TPS " " RAT_FUNC "%.1" "Position (%)" COEFFS 0 0.01 0 0 0 1 /end COMPU_METHOD
/begin CHARACTERISTIC TTM_EGRA_A "EGR Valve Nominal Area" CURVE 0x00140158 /* @ECU_Address@TTM_EGRA_A@0x022B9000@ */ ECIPP_ALIGNMENT_FLOAT32_IEEE 10000000000 Compu_TTM_EGRA_A -10000000000 10000000000
 /begin AXIS_DESCR COM_AXIS NO_INPUT_QUANTITY Compu_TTM_EGRA_TPS 16 -10000000000 10000000000 AXIS_PTS_REF TTM_EGRA_TPS /end AXIS_DESCR
/end CHARACTERISTIC
/begin AXIS_PTS TTM_EGRA_TPS " " 0x00161C80 /* @ECU_Address@TTM_EGRA_TPS@0x022B8000@ */ NO_INPUT_QUANTITY ECIPP_Lookup_FLOAT32_IEEE 0 Compu_TTM_EGRA_TPS 16 -10000000000 10000000000 /end AXIS_PTS
/begin COMPU_METHOD Compu_TTM_EGRA_A " " RAT_FUNC "%.3" "Area (in2)" COEFFS 0 1 0 0 0 1 /end COMPU_METHOD
/begin CHARACTERISTIC TDIL_pct_std "Diluent Mass Fraction - Standard (%)" MAP 0x001404A6 /* @ECU_Address@TDIL_pct_std@0x022DA000@ */ ECIPP_ALIGNMENT_SWORD 200 Compu_TDIL_pct_std -200 199.993896484375
 /begin AXIS_DESCR COM_AXIS NO_INPUT_QUANTITY Compu_TDIL_pct_xaxis 16 -10000000000 10000000000 AXIS_PTS_REF TDIL_pct_xaxis /end AXIS_DESCR
 /begin AXIS_DESCR COM_AXIS NO_INPUT_QUANTITY Compu_TDIL_pct_rpm 16 -32768 32767 AXIS_PTS_REF TDIL_pct_rpm /end AXIS_DESCR
/end CHARACTERISTIC
/begin AXIS_PTS TDIL_pct_xaxis " " 0x001400B8 /* @ECU_Address@TDIL_pct_xaxis@0x022DC000@ */ NO_INPUT_QUANTITY ECIPP_Lookup_FLOAT32_IEEE 0 Compu_TDIL_pct_xaxis 16 -10000000000 10000000000 /end AXIS_PTS
/begin AXIS_PTS TDIL_pct_rpm " " 0x00140486 /* @ECU_Address@TDIL_pct_rpm@0x022DD000@ */ NO_INPUT_QUANTITY ECIPP_Lookup_SWORD 0 Compu_TDIL_pct_rpm 16 -32768 32767 /end AXIS_PTS
/begin COMPU_METHOD Compu_TDIL_pct_std "" RAT_FUNC "%.1" "-" COEFFS 0 163.84 0 0 0 1 /end COMPU_METHOD
/begin CHARACTERISTIC TDIL_pct_alt "Diluent Mass Fraction - Alternate (%)" MAP 0x001401F6 /* @ECU_Address@TDIL_pct_alt@0x022DB000@ */ ECIPP_ALIGNMENT_SWORD 200 Compu_TDIL_pct_alt -200 199.993896484375
 /begin AXIS_DESCR COM_AXIS NO_INPUT_QUANTITY Compu_TDIL_pct_xaxis 16 -10000000000 10000000000 AXIS_PTS_REF TDIL_pct_xaxis /end AXIS_DESCR
 /begin AXIS_DESCR COM_AXIS NO_INPUT_QUANTITY Compu_TDIL_pct_rpm 16 -32768 32767 AXIS_PTS_REF TDIL_pct_rpm /end AXIS_DESCR
/end CHARACTERISTIC
/begin COMPU_METHOD Compu_TDIL_pct_alt "" RAT_FUNC "%.1" "-" COEFFS 0 163.84 0 0 0 1 /end COMPU_METHOD
/begin COMPU_METHOD Compu_TDIL_pct_xaxis " " RAT_FUNC "%.1" "-" COEFFS 0 1 0 0 0 1 /end COMPU_METHOD
/begin COMPU_METHOD Compu_TDIL_pct_rpm " " RAT_FUNC "%.0" "Speed (rpm)" COEFFS 0 1 0 0 0 1 /end COMPU_METHOD
/begin MEASUREMENT TEGRad_CdA_crct "EGR Valve Adaptive Area" FLOAT32_IEEE Compu_TEGRad_CdA_crct 0 0 -10000000000 10000000000 ECU_ADDRESS 0x0238B000 MATRIX_DIM 16 1 1 /end MEASUREMENT
/begin COMPU_METHOD Compu_TEGRad_CdA_crct " " RAT_FUNC "%.3" "Corrected Area (in2)" COEFFS 0 1 0 0 0 1 /end COMPU_METHOD
/begin COMPU_METHOD Compu_TEGR_ECT_ECT " " RAT_FUNC "%.1" "ECT (deg F)" COEFFS 0 32 14720 0 0 1 /end COMPU_METHOD
/begin CHARACTERISTIC TEGR_ECT_minnom "EGR ECT Enabling" CURVE 0x001406B2 /* @ECU_Address@TEGR_ECT_minnom@0x023C3000@ */ ECIPP_ALIGNMENT_SWORD 2 Compu_TEGR_ECT_minnom -2 1.99993896484375
 /begin AXIS_DESCR COM_AXIS NO_INPUT_QUANTITY Compu_TEGR_ECT_ECT 6 -1484 563.96875 AXIS_PTS_REF TEGR_ECT_ECT /end AXIS_DESCR
/end CHARACTERISTIC
/begin AXIS_PTS TEGR_ECT_ECT " " 0x001406A6 /* @ECU_Address@TEGR_ECT_ECT@0x023C2000@ */ NO_INPUT_QUANTITY ECIPP_Lookup_SWORD 0 Compu_TEGR_ECT_ECT 6 -1484 563.96875 /end AXIS_PTS
/begin COMPU_METHOD Compu_TEGR_ECT_minnom " " RAT_FUNC "%.2" "Off/Min/Nom" COEFFS 0 16384 0 0 0 1 /end COMPU_METHOD
/begin COMPU_METHOD Compu_TEGR_runwt_sec " " RAT_FUNC "%.1" "Run Time (sec)" COEFFS 0 16 0 0 0 1 /end COMPU_METHOD
/begin CHARACTERISTIC TEGR_runwt_minnom "EGR Run Time Wait" CURVE 0x001406D6 /* @ECU_Address@TEGR_runwt_minnom@0x023C7000@ */ ECIPP_ALIGNMENT_SWORD 2 Compu_TEGR_runwt_minnom -2 1.99993896484375
 /begin AXIS_DESCR COM_AXIS NO_INPUT_QUANTITY Compu_TEGR_runwt_sec 6 -2048 2047.9375 AXIS_PTS_REF TEGR_runwt_sec /end AXIS_DESCR
/end CHARACTERISTIC
/begin AXIS_PTS TEGR_runwt_sec " " 0x001406E2 /* @ECU_Address@TEGR_runwt_sec@0x023C6000@ */ NO_INPUT_QUANTITY ECIPP_Lookup_SWORD 0 Compu_TEGR_runwt_sec 6 -2048 2047.9375 /end AXIS_PTS
/begin COMPU_METHOD Compu_TEGR_runwt_minnom " " RAT_FUNC "%.2" "Off/Min/Nom" COEFFS 0 16384 0 0 0 1 /end COMPU_METHOD
/begin COMPU_METHOD Compu_TEGRad_CL_vlvpct " " RAT_FUNC "%.1" "EGR Valve Cmd (%)" COEFFS 0 327.68 0 0 0 1 /end COMPU_METHOD
/begin CHARACTERISTIC TEGRad_CL_lim "EGR Closed-Loop Limit" CURVE 0x00140816 /* @ECU_Address@TEGRad_CL_lim@0x023D0000@ */ ECIPP_ALIGNMENT_SWORD 100 Compu_TEGRad_CL_lim -100 99.9969482421875
 /begin AXIS_DESCR COM_AXIS NO_INPUT_QUANTITY Compu_TEGRad_CL_vlvpct 4 -100 99.9969482421875 AXIS_PTS_REF TEGRad_CL_vlvpct /end AXIS_DESCR
/end CHARACTERISTIC
/begin AXIS_PTS TEGRad_CL_vlvpct " " 0x0014081E /* @ECU_Address@TEGRad_CL_vlvpct@0x023CF000@ */ NO_INPUT_QUANTITY ECIPP_Lookup_SWORD 0 Compu_TEGRad_CL_vlvpct 4 -100 99.9969482421875 /end AXIS_PTS
/begin COMPU_METHOD Compu_TEGRad_CL_lim " " RAT_FUNC "%.1" "EGR CL Limit (% dil)" COEFFS 0 327.68 0 0 0 1 /end COMPU_METHOD
/begin COMPU_METHOD Compu_TEGR_vlvdP_mdot " " RAT_FUNC "%.1" "EGR Flow (g/s)" COEFFS 0 64 0 0 0 1 /end COMPU_METHOD
/begin CHARACTERISTIC TEGR_vlvdP_dP "EGR Valve Min dP" CURVE 0x001407FE /* @ECU_Address@TEGR_vlvdP_dP@0x0247E000@ */ ECIPP_ALIGNMENT_SWORD 128 Compu_TEGR_vlvdP_dP -128 127.99609375
 /begin AXIS_DESCR COM_AXIS NO_INPUT_QUANTITY Compu_TEGR_vlvdP_mdot 6 -512 511.984375 AXIS_PTS_REF TEGR_vlvdP_mdot /end AXIS_DESCR
/end CHARACTERISTIC
/begin AXIS_PTS TEGR_vlvdP_mdot " " 0x0014080A /* @ECU_Address@TEGR_vlvdP_mdot@0x0247D000@ */ NO_INPUT_QUANTITY ECIPP_Lookup_SWORD 0 Compu_TEGR_vlvdP_mdot 6 -512 511.984375 /end AXIS_PTS
/begin COMPU_METHOD Compu_TEGR_vlvdP_dP " " RAT_FUNC "%.2" "Min Valve dP (psi)" COEFFS 0 256 0 0 0 1 /end COMPU_METHOD
/begin COMPU_METHOD Compu_TOperTempWUT_ECT " " RAT_FUNC "%.1" "ECT (deg F)" COEFFS 0 32 14720 0 0 1 /end COMPU_METHOD
/begin CHARACTERISTIC TOperTempWUT_wait "ECT Threshold Warm-up Time" CURVE 0x00145394 /* @ECU_Address@TOperTempWUT_wait@0x02480000@ */ ECIPP_ALIGNMENT_SWORD 32767 Compu_TOperTempWUT_wait -32768 32767
 /begin AXIS_DESCR COM_AXIS NO_INPUT_QUANTITY Compu_TOperTempWUT_ECT 8 -1484 563.96875 AXIS_PTS_REF TOperTempWUT_ECT /end AXIS_DESCR
/end CHARACTERISTIC
/begin AXIS_PTS TOperTempWUT_ECT " " 0x00145384 /* @ECU_Address@TOperTempWUT_ECT@0x0247F000@ */ NO_INPUT_QUANTITY ECIPP_Lookup_SWORD 0 Compu_TOperTempWUT_ECT 8 -1484 563.96875 /end AXIS_PTS
/begin COMPU_METHOD Compu_TOperTempWUT_wait " " RAT_FUNC "%.0" "Time (sec)" COEFFS 0 1 0 0 0 1 /end COMPU_METHOD
/begin COMPU_METHOD Compu_TCLTempWUT_ECT " " RAT_FUNC "%.1" "ECT (deg F)" COEFFS 0 32 14720 0 0 1 /end COMPU_METHOD
/begin CHARACTERISTIC TCLTempWUT_wait "Closed Loop Temp Warm-up Time" CURVE 0x00144422 /* @ECU_Address@TCLTempWUT_wait@0x02482000@ */ ECIPP_ALIGNMENT_SWORD 32767 Compu_TCLTempWUT_wait -32768 32767
 /begin AXIS_DESCR COM_AXIS NO_INPUT_QUANTITY Compu_TCLTempWUT_ECT 4 -1484 563.96875 AXIS_PTS_REF TCLTempWUT_ECT /end AXIS_DESCR
/end CHARACTERISTIC
/begin AXIS_PTS TCLTempWUT_ECT " " 0x0014441A /* @ECU_Address@TCLTempWUT_ECT@0x02481000@ */ NO_INPUT_QUANTITY ECIPP_Lookup_SWORD 0 Compu_TCLTempWUT_ECT 4 -1484 563.96875 /end AXIS_PTS
/begin COMPU_METHOD Compu_TCLTempWUT_wait " " RAT_FUNC "%.0" "Time (sec)" COEFFS 0 1 0 0 0 1 /end COMPU_METHOD
/begin COMPU_METHOD Compu_TDiagTempWUT_ECT " " RAT_FUNC "%.1" "ECT (deg F)" COEFFS 0 32 14720 0 0 1 /end COMPU_METHOD
/begin CHARACTERISTIC TDiagTempWUT_wait "Diag Enable Temp Warm-up Time" CURVE 0x001447BA /* @ECU_Address@TDiagTempWUT_wait@0x02484000@ */ ECIPP_ALIGNMENT_SWORD 32767 Compu_TDiagTempWUT_wait -32768 32767
 /begin AXIS_DESCR COM_AXIS NO_INPUT_QUANTITY Compu_TDiagTempWUT_ECT 8 -1484 563.96875 AXIS_PTS_REF TDiagTempWUT_ECT /end AXIS_DESCR
/end CHARACTERISTIC
/begin AXIS_PTS TDiagTempWUT_ECT " " 0x001447AA /* @ECU_Address@TDiagTempWUT_ECT@0x02483000@ */ NO_INPUT_QUANTITY ECIPP_Lookup_SWORD 0 Compu_TDiagTempWUT_ECT 8 -1484 563.96875 /end AXIS_PTS
/begin COMPU_METHOD Compu_TDiagTempWUT_wait " " RAT_FUNC "%.0" "Time (sec)" COEFFS 0 1 0 0 0 1 /end COMPU_METHOD
/begin MEASUREMENT FaultTblSecInit "FSS Init Time 1" ULONG Compu_FaultTblSecInit 0 0 0 1193046.47083333 ECU_ADDRESS 0x024B7000 MATRIX_DIM 31 1 1 /end MEASUREMENT
/begin COMPU_METHOD Compu_FaultTblSecInit " " RAT_FUNC "%.3" "-" COEFFS 0 3600 0 0 0 1 /end COMPU_METHOD
/begin MEASUREMENT FaultTblSecLast "FSS Last Time 1" ULONG Compu_FaultTblSecLast 0 0 0 1193046.47083333 ECU_ADDRESS 0x024B8000 MATRIX_DIM 31 1 1 /end MEASUREMENT
/begin COMPU_METHOD Compu_FaultTblSecLast " " RAT_FUNC "%.3" "-" COEFFS 0 3600 0 0 0 1 /end COMPU_METHOD
/begin MEASUREMENT FaultTblSecPrevAct "FSS PrevAct Time 1" ULONG Compu_FaultTblSecPrevAct 0 0 0 1193046.47083333 ECU_ADDRESS 0x024B9000 MATRIX_DIM 31 1 1 /end MEASUREMENT
/begin COMPU_METHOD Compu_FaultTblSecPrevAct " " RAT_FUNC "%.3" "-" COEFFS 0 3600 0 0 0 1 /end COMPU_METHOD
/begin MEASUREMENT FaultTblOCC "FSS Occurrence Count 1" UBYTE Compu_FaultTblOCC 0 0 0 255 ECU_ADDRESS 0x024BA000 MATRIX_DIM 31 1 1 /end MEASUREMENT
/begin COMPU_METHOD Compu_FaultTblOCC " " RAT_FUNC "%.0" "-" COEFFS 0 1 0 0 0 1 /end COMPU_METHOD
/begin MEASUREMENT FaultTblMILCntdown "FSS MIL Countdown 1" UBYTE Compu_FaultTblMILCntdown 0 0 0 255 ECU_ADDRESS 0x024BB000 MATRIX_DIM 31 1 1 /end MEASUREMENT
/begin COMPU_METHOD Compu_FaultTblMILCntdown " " RAT_FUNC "%.0" "-" COEFFS 0 1 0 0 0 1 /end COMPU_METHOD
/begin MEASUREMENT fss_fault_ndx "FSS Fault Index 1" UWORD Compu_fss_fault_ndx 0 0 0 65535 ECU_ADDRESS 0x024BC000 MATRIX_DIM 31 1 1 /end MEASUREMENT
/begin COMPU_METHOD Compu_fss_fault_ndx " " RAT_FUNC "%.0" "-" COEFFS 0 1 0 0 0 1 /end COMPU_METHOD
/begin MEASUREMENT fss_fault_rank "FSS Fault Rank 1" UBYTE Compu_fss_fault_rank 0 0 0 255 ECU_ADDRESS 0x024BD000 MATRIX_DIM 31 1 1 /end MEASUREMENT
/begin COMPU_METHOD Compu_fss_fault_rank " " RAT_FUNC "%.0" "-" COEFFS 0 1 0 0 0 1 /end COMPU_METHOD
/begin MEASUREMENT fss_fault_dtc "FSS Fault DTC 1" UWORD Compu_fss_fault_dtc 0 0 0 65535 ECU_ADDRESS 0x024BE000 MATRIX_DIM 31 1 1 /end MEASUREMENT
/begin COMPU_METHOD Compu_fss_fault_dtc " " RAT_FUNC "%.0" "-" COEFFS 0 1 0 0 0 1 /end COMPU_METHOD
/begin COMPU_METHOD Compu_TmdotCOTth_mdota " " RAT_FUNC "%.1" "Mass Flow (g/s)" COEFFS 0 32 0 0 0 1 /end COMPU_METHOD
/begin CHARACTERISTIC TmdotCOTth_COT "Air Mass Flow-Based COT Thresholds" CURVE 0x00145F86 /* @ECU_Address@TmdotCOTth_COT@0x024C3000@ */ ECIPP_ALIGNMENT_SWORD 7732 Compu_TmdotCOTth_COT -8652 7731.75
 /begin AXIS_DESCR COM_AXIS NO_INPUT_QUANTITY Compu_TmdotCOTth_mdota 4 -1024 1023.96875 AXIS_PTS_REF TmdotCOTth_mdota /end AXIS_DESCR
/end CHARACTERISTIC
/begin AXIS_PTS TmdotCOTth_mdota " " 0x00145F8E /* @ECU_Address@TmdotCOTth_mdota@0x024C2000@ */ NO_INPUT_QUANTITY ECIPP_Lookup_SWORD 0 Compu_TmdotCOTth_mdota 4 -1024 1023.96875 /end AXIS_PTS
/begin COMPU_METHOD Compu_TmdotCOTth_COT " " RAT_FUNC "%.1" "COT (deg F)" COEFFS 0 4 1840 0 0 1 /end COMPU_METHOD
/begin CHARACTERISTIC TEGR_vent_Mx_mult "EGR Orifice Flow Rate Correction" MAP 0x0014076E /* @ECU_Address@TEGR_vent_Mx_mult@0x025C0000@ */ ECIPP_ALIGNMENT_SWORD 4 Compu_TEGR_vent_Mx_mult -4 3.9998779296875
 /begin AXIS_DESCR COM_AXIS NO_INPUT_QUANTITY Compu_TEGR_vent_Mx_load 8 -10000000000 10000000000 AXIS_PTS_REF TEGR_vent_Mx_load /end AXIS_DESCR
 /begin AXIS_DESCR COM_AXIS NO_INPUT_QUANTITY Compu_TEGR_vent_Mx_rpm 8 -32768 32767 AXIS_PTS_REF TEGR_vent_Mx_rpm /end AXIS_DESCR
/end CHARACTERISTIC
/begin AXIS_PTS TEGR_vent_Mx_load " " 0x00140128 /* @ECU_Address@TEGR_vent_Mx_load@0x025C1000@ */ NO_INPUT_QUANTITY ECIPP_Lookup_FLOAT32_IEEE 0 Compu_TEGR_vent_Mx_load 8 -10000000000 10000000000 /end AXIS_PTS
/begin AXIS_PTS TEGR_vent_Mx_rpm " " 0x001407EE /* @ECU_Address@TEGR_vent_Mx_rpm@0x025C2000@ */ NO_INPUT_QUANTITY ECIPP_Lookup_SWORD 0 Compu_TEGR_vent_Mx_rpm 8 -32768 32767 /end AXIS_PTS
/begin COMPU_METHOD Compu_TEGR_vent_Mx_mult "" RAT_FUNC "%.2" "Flow Correction (multiplier)" COEFFS 0 8192 0 0 0 1 /end COMPU_METHOD
/begin COMPU_METHOD Compu_TEGR_vent_Mx_load " " RAT_FUNC "%.2" "Load Cmd (%)" COEFFS 0 1 0 0 0 1 /end COMPU_METHOD
/begin COMPU_METHOD Compu_TEGR_vent_Mx_rpm " " RAT_FUNC "%.0" "Speed (rpm)" COEFFS 0 1 0 0 0 1 /end COMPU_METHOD
/begin COMPU_METHOD Compu_TEGR_vlv_PR " " RAT_FUNC "%.3" "Actual PR" COEFFS 0 1 0 0 0 1 /end COMPU_METHOD
/begin CHARACTERISTIC TEGR_vlv_PR_Dz "EGR valve PR Dz" CURVE 0x00140150 /* @ECU_Address@TEGR_vlv_PR_Dz@0x025C4000@ */ ECIPP_ALIGNMENT_FLOAT32_IEEE 10000000000 Compu_TEGR_vlv_PR_Dz -10000000000 10000000000
 /begin AXIS_DESCR COM_AXIS NO_INPUT_QUANTITY Compu_TEGR_vlv_PR 2 -10000000000 10000000000 AXIS_PTS_REF TEGR_vlv_PR /end AXIS_DESCR
/end CHARACTERISTIC
/begin AXIS_PTS TEGR_vlv_PR " " 0x00140148 /* @ECU_Address@TEGR_vlv_PR@0x025C3000@ */ NO_INPUT_QUANTITY ECIPP_Lookup_FLOAT32_IEEE 0 Compu_TEGR_vlv_PR 2 -10000000000 10000000000 /end AXIS_PTS
/begin COMPU_METHOD Compu_TEGR_vlv_PR_Dz " " RAT_FUNC "%.3" "PR Dz" COEFFS 0 1 0 0 0 1 /end COMPU_METHOD
/begin CHARACTERISTIC TEGR_vlv_PR_tau "EGR valve PR Tau" CURVE 0x0014099C /* @ECU_Address@TEGR_vlv_PR_tau@0x025C5000@ */ ECIPP_ALIGNMENT_UWORD 327680 Compu_TEGR_vlv_PR_tau 0.45084 327680
 /begin AXIS_DESCR COM_AXIS NO_INPUT_QUANTITY Compu_TEGR_vlv_PR 2 -10000000000 10000000000 AXIS_PTS_REF TEGR_vlv_PR /end AXIS_DESCR
/end CHARACTERISTIC
/begin COMPU_METHOD Compu_TEGR_vlv_PR_tau " " FORM "%.0" "PR tau [ms]"
 /begin FORMULA "-5 / log(1 - (X1 / 65536))" FORMULA_INV "(1 - exp(-5/X1)) * 65536" /end FORMULA
/end COMPU_METHOD
/begin COMPU_METHOD Compu_TEGR_VE_mdcmd " " RAT_FUNC "%.1" "EGR Cmd dNom(%)" COEFFS 0 163.84 0 0 0 1 /end COMPU_METHOD
/begin CHARACTERISTIC TEGR_VE_offset "EGR VE Offset" CURVE 0x001448D6 /* @ECU_Address@TEGR_VE_offset@0x025C8000@ */ ECIPP_ALIGNMENT_SWORD 100 Compu_TEGR_VE_offset -100 99.9969482421875
 /begin AXIS_DESCR COM_AXIS NO_INPUT_QUANTITY Compu_TEGR_VE_mdcmd 6 -200 199.993896484375 AXIS_PTS_REF TEGR_VE_mdcmd /end AXIS_DESCR
/end CHARACTERISTIC
/begin AXIS_PTS TEGR_VE_mdcmd " " 0x001448CA /* @ECU_Address@TEGR_VE_mdcmd@0x025C7000@ */ NO_INPUT_QUANTITY ECIPP_Lookup_SWORD 0 Compu_TEGR_VE_mdcmd 6 -200 199.993896484375 /end AXIS_PTS
/begin COMPU_METHOD Compu_TEGR_VE_offset " " RAT_FUNC "%.1" "VE Offset (%)" COEFFS 0 327.68 0 0 0 1 /end COMPU_METHOD
/begin COMPU_METHOD Compu_TCVdP_mdot_a " " RAT_FUNC "%.1" "Mass Flow (g/s)" COEFFS 0 64 0 0 0 1 /end COMPU_METHOD
/begin CHARACTERISTIC TCVdP_dP1 "Crankcase Expected Pressure Drop" CURVE 0x001444F2 /* @ECU_Address@TCVdP_dP1@0x025E0000@ */ ECIPP_ALIGNMENT_SWORD 32 Compu_TCVdP_dP1 -32 31.9990234375
 /begin AXIS_DESCR COM_AXIS NO_INPUT_QUANTITY Compu_TCVdP_mdot_a 8 -512 511.984375 AXIS_PTS_REF TCVdP_mdot_a /end AXIS_DESCR
/end CHARACTERISTIC
/begin AXIS_PTS TCVdP_mdot_a " " 0x00144512 /* @ECU_Address@TCVdP_mdot_a@0x025DF000@ */ NO_INPUT_QUANTITY ECIPP_Lookup_SWORD 0 Compu_TCVdP_mdot_a 8 -512 511.984375 /end AXIS_PTS
/begin COMPU_METHOD Compu_TCVdP_dP1 " " RAT_FUNC "%.4" "Pressure drop 1 (psi)" COEFFS 0 1024 0 0 0 1 /end COMPU_METHOD
/begin CHARACTERISTIC TCVdP_dP2 "Crankcase Expected Pressure Drop" CURVE 0x00144502 /* @ECU_Address@TCVdP_dP2@0x025E1000@ */ ECIPP_ALIGNMENT_SWORD 32 Compu_TCVdP_dP2 -32 31.9990234375
 /begin AXIS_DESCR COM_AXIS NO_INPUT_QUANTITY Compu_TCVdP_mdot_a 8 -512 511.984375 AXIS_PTS_REF TCVdP_mdot_a /end AXIS_DESCR
/end CHARACTERISTIC
/begin COMPU_METHOD Compu_TCVdP_dP2 " " RAT_FUNC "%.4" "Pressure drop 2 (psi)" COEFFS 0 1024 0 0 0 1 /end COMPU_METHOD
/begin COMPU_METHOD Compu_TEGRO_postlk_vlvdP " " RAT_FUNC "%.1" "EGR Valve dP (psi)" COEFFS 0 256 0 0 0 1 /end COMPU_METHOD
/begin CHARACTERISTIC TEGRO_postlk_EGRdP "EGR Orifice Expected Pressure Change" CURVE 0x001448B2 /* @ECU_Address@TEGRO_postlk_EGRdP@0x02623000@ */ ECIPP_ALIGNMENT_SWORD 32 Compu_TEGRO_postlk_EGRdP -32 31.9990234375
 /begin AXIS_DESCR COM_AXIS NO_INPUT_QUANTITY Compu_TEGRO_postlk_vlvdP 6 -128 127.99609375 AXIS_PTS_REF TEGRO_postlk_vlvdP /end AXIS_DESCR
/end CHARACTERISTIC
/begin AXIS_PTS TEGRO_postlk_vlvdP " " 0x001448BE /* @ECU_Address@TEGRO_postlk_vlvdP@0x02622000@ */ NO_INPUT_QUANTITY ECIPP_Lookup_SWORD 0 Compu_TEGRO_postlk_vlvdP 6 -128 127.99609375 /end AXIS_PTS
/begin COMPU_METHOD Compu_TEGRO_postlk_EGRdP " " RAT_FUNC "%.3" "EGRdP (psi)" COEFFS 0 1024 0 0 0 1 /end COMPU_METHOD
/begin COMPU_METHOD Compu_TEGRdP_HiExp_mdota " " RAT_FUNC "%.1" "Air Flow (g/sec)" COEFFS 0 64 0 0 0 1 /end COMPU_METHOD
/begin CHARACTERISTIC TEGRdP_HiExp_EGRdP "Air Mass Flow-Based Expected EGRdP" CURVE 0x0014084A /* @ECU_Address@TEGRdP_HiExp_EGRdP@0x02636000@ */ ECIPP_ALIGNMENT_SWORD 32 Compu_TEGRdP_HiExp_EGRdP -32 31.9990234375
 /begin AXIS_DESCR COM_AXIS NO_INPUT_QUANTITY Compu_TEGRdP_HiExp_mdota 6 -512 511.984375 AXIS_PTS_REF TEGRdP_HiExp_mdota /end AXIS_DESCR
/end CHARACTERISTIC
/begin AXIS_PTS TEGRdP_HiExp_mdota " " 0x00140856 /* @ECU_Address@TEGRdP_HiExp_mdota@0x02635000@ */ NO_INPUT_QUANTITY ECIPP_Lookup_SWORD 0 Compu_TEGRdP_HiExp_mdota 6 -512 511.984375 /end AXIS_PTS
/begin COMPU_METHOD Compu_TEGRdP_HiExp_EGRdP " " RAT_FUNC "%.3" "EGRdP (psi)" COEFFS 0 1024 0 0 0 1 /end COMPU_METHOD
/begin COMPU_METHOD Compu_TOILP_wait_ECT " " RAT_FUNC "%.1" "ECT (deg F)" COEFFS 0 1 460 0 0 1 /end COMPU_METHOD
/begin CHARACTERISTIC TOILP_wait_time "Low Oil Pressure Faults Run Time Wait" CURVE 0x00143B64 /* @ECU_Address@TOILP_wait_time@0x02638000@ */ ECIPP_ALIGNMENT_FLOAT32_IEEE 10000000000 Compu_TOILP_wait_time -10000000000 10000000000
 /begin AXIS_DESCR COM_AXIS NO_INPUT_QUANTITY Compu_TOILP_wait_ECT 4 -10000000000 10000000000 AXIS_PTS_REF TOILP_wait_ECT /end AXIS_DESCR
/end CHARACTERISTIC
/begin AXIS_PTS TOILP_wait_ECT " " 0x00143B54 /* @ECU_Address@TOILP_wait_ECT@0x02637000@ */ NO_INPUT_QUANTITY ECIPP_Lookup_FLOAT32_IEEE 0 Compu_TOILP_wait_ECT 4 -10000000000 10000000000 /end AXIS_PTS
/begin COMPU_METHOD Compu_TOILP_wait_time " " RAT_FUNC "%.1" "Run time wait (sec)" COEFFS 0 1000 0 0 0 1 /end COMPU_METHOD
/begin COMPU_METHOD Compu_TOILP_hiP_wait_ECT " " RAT_FUNC "%.1" "ECT (deg F)" COEFFS 0 1 460 0 0 1 /end COMPU_METHOD
/begin CHARACTERISTIC TOILP_hiP_wait_time "High Oil Pressure Faults Run Time Wait" CURVE 0x00143B44 /* @ECU_Address@TOILP_hiP_wait_time@0x0263E000@ */ ECIPP_ALIGNMENT_FLOAT32_IEEE 10000000000 Compu_TOILP_hiP_wait_time -10000000000 10000000000
 /begin AXIS_DESCR COM_AXIS NO_INPUT_QUANTITY Compu_TOILP_hiP_wait_ECT 4 -10000000000 10000000000 AXIS_PTS_REF TOILP_hiP_wait_ECT /end AXIS_DESCR
/end CHARACTERISTIC
/begin AXIS_PTS TOILP_hiP_wait_ECT " " 0x00143B34 /* @ECU_Address@TOILP_hiP_wait_ECT@0x0263D000@ */ NO_INPUT_QUANTITY ECIPP_Lookup_FLOAT32_IEEE 0 Compu_TOILP_hiP_wait_ECT 4 -10000000000 10000000000 /end AXIS_PTS
/begin COMPU_METHOD Compu_TOILP_hiP_wait_time " " RAT_FUNC "%.1" "Run time wait (sec)" COEFFS 0 1000 0 0 0 1 /end COMPU_METHOD
/begin COMPU_METHOD Compu_TEGR_deice_AAT " " RAT_FUNC "%.1" "Ambient Temp (deg F)" COEFFS 0 32 14720 0 0 1 /end COMPU_METHOD
/begin CHARACTERISTIC TEGR_deice_tm_mult "EGR De-icing Primary Idle Time Multiplier" CURVE 0x00140938 /* @ECU_Address@TEGR_deice_tm_mult@0x02640000@ */ ECIPP_ALIGNMENT_UWORD 256 Compu_TEGR_deice_tm_mult 0 255.99609375
 /begin AXIS_DESCR COM_AXIS NO_INPUT_QUANTITY Compu_TEGR_deice_AAT 6 -1484 563.96875 AXIS_PTS_REF TEGR_deice_AAT /end AXIS_DESCR
/end CHARACTERISTIC
/begin AXIS_PTS TEGR_deice_AAT " " 0x001406BE /* @ECU_Address@TEGR_deice_AAT@0x0263F000@ */ NO_INPUT_QUANTITY ECIPP_Lookup_SWORD 0 Compu_TEGR_deice_AAT 6 -1484 563.96875 /end AXIS_PTS
/begin COMPU_METHOD Compu_TEGR_deice_tm_mult " " RAT_FUNC "%.1" "Time Multiplier" COEFFS 0 256 0 0 0 1 /end COMPU_METHOD
/begin COMPU_METHOD Compu_TEGR_deice_IAT " " RAT_FUNC "%.1" "Intake Temp (deg F)" COEFFS 0 32 14720 0 0 1 /end COMPU_METHOD
/begin CHARACTERISTIC TEGR_deice_rettmmult "EGR De-icing Secondary Idle Time Multiplier" CURVE 0x0014092C /* @ECU_Address@TEGR_deice_rettmmult@0x02642000@ */ ECIPP_ALIGNMENT_UWORD 256 Compu_TEGR_deice_rettmmult 0 255.99609375
 /begin AXIS_DESCR COM_AXIS NO_INPUT_QUANTITY Compu_TEGR_deice_IAT 6 -1484 563.96875 AXIS_PTS_REF TEGR_deice_IAT /end AXIS_DESCR
/end CHARACTERISTIC
/begin AXIS_PTS TEGR_deice_IAT " " 0x001406CA /* @ECU_Address@TEGR_deice_IAT@0x02641000@ */ NO_INPUT_QUANTITY ECIPP_Lookup_SWORD 0 Compu_TEGR_deice_IAT 6 -1484 563.96875 /end AXIS_PTS
/begin COMPU_METHOD Compu_TEGR_deice_rettmmult " " RAT_FUNC "%.1" "Time Multiplier" COEFFS 0 256 0 0 0 1 /end COMPU_METHOD
/begin COMPU_METHOD Compu_TBstTIP_Lo_MAP " " RAT_FUNC "%.1" "MAP (psia)" COEFFS 0 256 0 0 0 1 /end COMPU_METHOD
/begin CHARACTERISTIC TBstTIP_Lo_TIPd "Boost Pressure Control Expected TIP" CURVE 0x00144412 /* @ECU_Address@TBstTIP_Lo_TIPd@0x0264C000@ */ ECIPP_ALIGNMENT_SWORD 128 Compu_TBstTIP_Lo_TIPd -128 127.99609375
 /begin AXIS_DESCR COM_AXIS NO_INPUT_QUANTITY Compu_TBstTIP_Lo_MAP 4 -128 127.99609375 AXIS_PTS_REF TBstTIP_Lo_MAP /end AXIS_DESCR
/end CHARACTERISTIC
/begin AXIS_PTS TBstTIP_Lo_MAP " " 0x0014440A /* @ECU_Address@TBstTIP_Lo_MAP@0x0264B000@ */ NO_INPUT_QUANTITY ECIPP_Lookup_SWORD 0 Compu_TBstTIP_Lo_MAP 4 -128 127.99609375 /end AXIS_PTS
/begin COMPU_METHOD Compu_TBstTIP_Lo_TIPd " " RAT_FUNC "%.2" "TIP Target (psia)" COEFFS 0 256 0 0 0 1 /end COMPU_METHOD
/begin COMPU_METHOD Compu_TCVdP_AAT " " RAT_FUNC "%.1" "AAT (deg F)" COEFFS 0 32 14720 0 0 1 /end COMPU_METHOD
/begin CHARACTERISTIC TCVdP_run_wait "Crankcase Ventilation Pressure Diagnostics Run Time Wait" CURVE 0x00147822 /* @ECU_Address@TCVdP_run_wait@0x0264E000@ */ ECIPP_ALIGNMENT_UWORD 65535 Compu_TCVdP_run_wait 0 65535
 /begin AXIS_DESCR COM_AXIS NO_INPUT_QUANTITY Compu_TCVdP_AAT 4 -1484 563.96875 AXIS_PTS_REF TCVdP_AAT /end AXIS_DESCR
/end CHARACTERISTIC
/begin AXIS_PTS TCVdP_AAT " " 0x001444EA /* @ECU_Address@TCVdP_AAT@0x0264D000@ */ NO_INPUT_QUANTITY ECIPP_Lookup_SWORD 0 Compu_TCVdP_AAT 4 -1484 563.96875 /end AXIS_PTS
/begin COMPU_METHOD Compu_TCVdP_run_wait " " RAT_FUNC "%.0" "Run time wait (sec)" COEFFS 0 1 0 0 0 1 /end COMPU_METHOD
/begin GROUP EC_EGRCommand "ECONTROLS" ROOT
 /begin REF_CHARACTERISTIC EGR_clr_dP_C EGRT_ena EGR_channel EGR_min_DC EGR_max_DC EGRHP_ena EGRLP_ena m_d_pct_cmd_tau m_d_pct_cmd_dz EGR_mindil_cmdtbl EGR_mindil_spktbl EGR_nomdil_SHref EGR_mindil_SHref EGR_PR_vlv_max EGR_pstvlv_V EFMA_map_dP_C EGR_vlv_dP_tau EGR_spkextrap_amin EGR_spkextrap_amax EGR_spkextrap_rmin EGR_spkextrap_rmax EGR_spkextrap_advlmt EGR_spkextrap_retlmt m_d_pct_cmd_OFF m_d_pct_cmd_ON EGR_minnom_pslew EGR_minnom_nslew EFMA_fmix_dP_C EFMA_emix_dP_C EGRO_vlv_dP_C EFMA_map_dP_nom EFMA_fmix_dP_nom EFMA_emix_dP_nom EGRO_vlv_dP_nom EGR_clr_dP_nom EGR_TPSdP_Dz EGR_TPSdP_limiting EGR_TPSdP_tau_inc EGR_TPSdP_tau_dec EGR_TPSdP_Ktrans EGR_TPSdP_max EGR_dmdot_cmd_n EGR_dmdot_cmd_tau EGR_dmdot_cmd_dz EGR_vlv_zero_dz EGR_vlv_dPos_max FDC_ena FDC_rpm_min FDC_load_off FDC_load_on FDC_CLAL_ref FDC_EGR_max FDC_comp_inc_LP FDC_comp_dec_LP EGR_deice_idle_tm EGR_deice_retidle_tm EGR_deice_purge_tm EGR_deice_rpm EGR_deice_AAT_max EGR_deice_pct_cmd EGR_deice_rpm_rate EGR_deice_pre_tm EGR_deice_post_tm EGR_deice_purge_IAT EGRdP_trust_zero_dz EGRdP_trust_latch_tm EGRHP_trust_mdl_dz EGRHP_trust_latch_tm EGRHP_trust_unlatcht EGR_senstrst_flt_tm EGR_senstrst_ECTfrac mdot_EGR_ON mdot_EGR_OFF mdot_EGR_ON_cold EGR_ON_cold_IAT EGR_initpct_reduct EGR_initpct_accmdmax mdot_EGR_inc_max EGR_spkex_pdspanmin EGR_spkex_pdspanmax EGR_initpct_0md_tm EGR_initpct_0md_slew EFMA_venturi_dP_ena EFMA_venturi_dP_C1 EFMA_venturi_dP_C2 EFMA_venturi_dP_C3 EFMA_venturi_dP_C4 EFMA_venturi_dP_C5 TDIL_pct_std TDIL_pct_alt TEGR_ECT_minnom TEGR_runwt_minnom TEGR_vlvdP_dP TEGR_vlv_PR_Dz TEGR_vlv_PR_tau TEGR_VE_offset TEGR_deice_tm_mult TEGR_deice_rettmmult /end REF_CHARACTERISTIC
 /begin REF_MEASUREMENT OCT_adapt EGRT m_d_pct_cmd EGR_vlv_cmd EGR_ctl_status EGR_vlv_act EGRLP_float EGR_vlv_min_dP EGR_vlv_act_dP manual_EGR_mode manual_EGR_cmd1 DIL_pct_xval EGR_clr_dP EGRHP_float EGR_PRf_pseudo mdot_mix_fill_float manual_EGR_tau m_d_pct_reqmin m_d_pct_min m_d_pct_nom EGR_minnom_frac EGR_spkadv_min EGR_spkadv_nom EGR_retard m_d_pct_act mdot_EGR_act EGR_PRf_actual EGR_minnom_ECT manual_EGR_cmd2 manual_EGR_toggle manual_EGR_slct mdot_mix_fill_TPS mdot_mix_fill_EGR mdot_mix_EGR mdot_EGR_VdP EGR_minnom_runwt EGR_spkextrap_sens EGR_spkextrap_ret m_d_pct_spk EGR_minnom_raw m_d_pct_FL m_d_pct_LL EGR_MAPload_LL LoadLim_EGR_pct EFMA_map_dP EFMA_fmix_dP EFMA_emix_dP EGRO_vlv_dP EFMA_emix_P EFMA_fmix_P TOP mdot_EGR_min mdot_EGR_nom EGR_minnom_derate EGR_minnom_FB m_d_pct_act_dry mdot_EGR_cmd EGR_dmdot_cmd VE_EGR_ofst EGR_vlv_temp_est FDC_comp_pct FDC_EGR_ofst m_d_pct_octmin m_d_pct_octnom EGR_oct_retard EGR_oct_LL_pct m_d_pct_oct_ofst EGR_deice_state EGR_deice_wait_tm EGR_deice_tmr EGR_sensor_trust EGRdP_trust_pct EGRHP_trust_mdl_err EGRHP_trust_pct EGR_senstrst_flt_tmr EGR_minnom_senstrst EGR_initpct_accmd m_d_pct_req_lp mdot_EGR_req mdot_EGR_zero_tmr /end REF_MEASUREMENT
/end GROUP
/begin GROUP EC_EGRControl "ECONTROLS" ROOT
 /begin REF_CHARACTERISTIC EGRdP_ena EGRad_mdot_min EGRad_MAF_min EGR_vent_location EGR_vent_CdA EGRdP_offset_learn EGRdP_offset_ECT EGRdP_offset_vlvmax EGRdP_offset_flowwt EGRdP_offset_dPmin EGRdP_offset_dPmax EGRdP_offset_tau EGRad_ena EGRad_strt_wait EGRad_adapt_dz EGRad_Kadapt EGRad_adapt_lim EGRad_stable_wait EGRad_TPS_min EGRad_adapt_valid EGRad_adapt_wait EGRad_adapt_Amin EGRdP_offset_dPpls EGRdP_offset_keywt EGRwrP_ena EGRwr_flowctl_dPint EGRwr_flowctl_dPmix EGRwr_flowctl_dPdft EGRwr_mdpct_mult EGRwrP_tau EGRad_PRadapt_sw EGRad_PR_Kadapt EGRad_PR_adapt_lim EGR_tau_MAF_ms EGR_tau_dP_ms EGR_tau_UEGO_ms EGRad_PRadapt_swend EGRad_cmdact_ss_itau EGRad_cmdact_ss_dtau EGRdP_offset_strtwt EGRwr_mount_type EGRfb_minnom_MAF EGRfb_minnom_dP EGRfb_minnom_UEGO EGRfb_LL_openloop EGRfb_LL_MAF EGRfb_LL_dP EGRfb_LL_UEGO EGRwrT_ena EGRwr_UEGO_slew EGRad_CL_K EGRad_CL_valid_cnt EGRad_tran_dMAP EGRad_tran_dmdpct EGRad_CL_Dz EGRdP_offset_clrdly EGRad_store_EE EGRdP_offset_clrtime TTM_EGRA_A TEGRad_CL_lim TEGR_vent_Mx_mult /end REF_CHARACTERISTIC
 /begin REF_MEASUREMENT EGRdP m_d_pct_cmd EGR_vlv_cmd EGR_vlv_act EGRdP_inst EGRdP_offset EGRdP_offset_state EGR_FB_source EGRad_CL_status EGR_vent_Pin EGRad_CL_pct EGRad_adapt_status EGRad_CdA_in2 m_d_pct_act mdot_EGR_act EGRwrP_float mdot_EGR_MAF mdot_EGR_dP mdot_EGR_UEGO m_d_pct_MAF m_d_pct_dP m_d_pct_UEGO EGR_FB_status_MAF EGR_FB_status_dP EGR_FB_status_UEGO EGRwr_drift_status EGRad_CLadapt_assist EGRwr_UEGO_fbpct EGRad_cmdact_err EGRad_CL_actlmt EGRad_PR_adapt_crct EGRad_PRadapt_ratio EGRad_cmdact_ss_err EGR_vent_Pout m_d_pct_cmd_dly m_d_pct_cmdmdl EGRwrT_float EGR_vent_Mx_mult m_d_pct_act_dry EGRad_CL_updates EGRdP_min EGRdP_max mdot_EGRv_mdl EGR_sensor_trust EGR_stuckvlv_state EGR_stuckvlv_dc_lp EGR_stuckvlv_tmr_max TEGRad_CdA_crct /end REF_MEASUREMENT
/end GROUP
/begin GROUP EC_FaultCfg "ECONTROLS" ROOT
 /begin REF_CHARACTERISTIC OilP_loP OilP_hiP OilP_loP2 OilP_loRPM OilP_loRPM2 ECT_CL_ena OilP_maxV OilP_minV OilP2_loP OilP2_loP2 LowOperTemp_ECT ECT_nom ECT_nom_min ECTmon_diag_hyst ECTmon_AAT ECTmon_delta COT_hi_hyst CVdP_dP1_location CVdP_dP2_location ECTmon_warm_wait EGRdP_HiExp_tbl_pct EGRdP_HiExp_dP_min TRAT_TAUX_n1 TRAT_TAUX_n2 TOperTempWUT_wait TCLTempWUT_wait TDiagTempWUT_wait TmdotCOTth_COT TCVdP_dP1 TCVdP_dP2 TEGRO_postlk_EGRdP TEGRdP_HiExp_EGRdP TOILP_wait_time TOILP_hiP_wait_time TBstTIP_Lo_TIPd TCVdP_run_wait /end REF_CHARACTERISTIC
 /begin REF_MEASUREMENT ECT_diag_min ECTmon_state TIAT CVdP_dP1_d CVdP_dP2_d CVdP_dP1_pcta CVdP_dP2_pcta ECTmon_CL_wait ECTmon_CL_tmr ECTmon_oper_wait ECTmon_oper_tmr ECTmon_diag_wait ECTmon_diag_tmr RTC_sec_epoch TRAT_engstop_rtc TRAT_state TRAT_tmr TRAT_ECT_state TRAT_ECT_avg TRAT_IAT_state TRAT_IAT_avg TRAT_AAT_state TRAT_AAT_avg TRAT_EGRT_state TRAT_EGRT_avg TRAT_FT_state TRAT_FT_avg TRAT_OILT_state TRAT_OILT_avg TRAT_EGT_state TRAT_EGT_avg TRAT_TIAT_state TRAT_TIAT_avg TRAT_TAUX_n1_state TRAT_TAUX_n1_avg TRAT_TAUX_n2_state TRAT_TAUX_n2_avg /end REF_MEASUREMENT
/end GROUP
/begin GROUP EC_FaultMon "ECONTROLS" ROOT
 /begin REF_MEASUREMENT fm_mon_ena fm_mon_fctl_ndx fm_mon_TF fm_mon_TFTOC fm_mon_PDTC fm_mon_CDTC fm_mon_TNCSLC fm_mon_TFSLC fm_mon_TNCTOC fm_mon_WIR fm_mon_potential fm_mon_pending fm_mon_confact fm_mon_prevact fm_mon_permanent fm_mon_mil_type fm_mon_mil_cnt fm_mon_cycles_cnt fm_mon_sec_prevact fm_mon_act_cnt fm_mon_con_cnt fault_maxact_pct0 fault_maxact_pct1 fault_maxact_pct2 fault_maxact_pct3 fault_maxact_pct4 fault_maxact_pct5 fault_maxact_pct6 fault_maxact_pct7 fault_maxact_flt0 fault_maxact_flt1 fault_maxact_flt2 fault_maxact_flt3 fault_maxact_flt4 fault_maxact_flt5 fault_maxact_flt6 fault_maxact_flt7 fault_maxact_valid fault_maxact_pct8 fault_maxact_pct9 fault_maxact_pct10 fault_maxact_pct11 fault_maxact_pct12 fault_maxact_pct13 fault_maxact_pct14 fault_maxact_pct15 fault_maxact_pct16 fault_maxact_pct17 fault_maxact_pct18 fault_maxact_pct19 fault_maxact_pct20 fault_maxact_pct21 fault_maxact_pct22 fault_maxact_pct23 fault_maxact_pct24 fault_maxact_pct25 fault_maxact_pct26 fault_maxact_pct27 fault_maxact_pct28 fault_maxact_pct29 fault_maxact_flt8 fault_maxact_flt9 fault_maxact_flt10 fault_maxact_flt11 fault_maxact_flt12 fault_maxact_flt13 fault_maxact_flt14 fault_maxact_flt15 fault_maxact_flt16 fault_maxact_flt17 fault_maxact_flt18 fault_maxact_flt19 fault_maxact_flt20 fault_maxact_flt21 fault_maxact_flt22 fault_maxact_flt23 fault_maxact_flt24 fault_maxact_flt25 fault_maxact_flt26 fault_maxact_flt27 fault_maxact_flt28 fault_maxact_flt29 fault_maxact_pct30 fault_maxact_pct31 fault_maxact_pct32 fault_maxact_pct33 fault_maxact_pct34 fault_maxact_pct35 fault_maxact_pct36 fault_maxact_pct37 fault_maxact_pct38 fault_maxact_pct39 fault_maxact_pct40 fault_maxact_pct41 fault_maxact_pct42 fault_maxact_pct43 fault_maxact_pct44 fault_maxact_pct45 fault_maxact_pct46 fault_maxact_pct47 fault_maxact_pct48 fault_maxact_pct49 fault_maxact_pct50 fault_maxact_pct51 fault_maxact_pct52 fault_maxact_pct53 fault_maxact_pct54 fault_maxact_pct55 fault_maxact_pct56 fault_maxact_pct57 fault_maxact_pct58 fault_maxact_pct59 fault_maxact_flt30 fault_maxact_flt31 fault_maxact_flt32 fault_maxact_flt33 fault_maxact_flt34 fault_maxact_flt35 fault_maxact_flt36 fault_maxact_flt37 fault_maxact_flt38 fault_maxact_flt39 fault_maxact_flt40 fault_maxact_flt41 fault_maxact_flt42 fault_maxact_flt43 fault_maxact_flt44 fault_maxact_flt45 fault_maxact_flt46 fault_maxact_flt47 fault_maxact_flt48 fault_maxact_flt49 fault_maxact_flt50 fault_maxact_flt51 fault_maxact_flt52 fault_maxact_flt53 fault_maxact_flt54 fault_maxact_flt55 fault_maxact_flt56 fault_maxact_flt57 fault_maxact_flt58 fault_maxact_flt59 fault_maxact_pctmin FaultTblSecInit FaultTblSecLast FaultTblSecPrevAct FaultTblOCC FaultTblMILCntdown fss_fault_ndx fss_fault_rank fss_fault_dtc /end REF_MEASUREMENT
/end GROUP
/begin GROUP EC_FilterCal "ECONTROLS" ROOT /begin REF_MEASUREMENT EGRdP EGRLP_float EGRHP_float /end REF_MEASUREMENT /end GROUP
/begin GROUP EC_HDService2 "ECONTROLS" ROOT
 /begin REF_MEASUREMENT OCT_adapt EGRdP m_d_pct_cmd EGR_vlv_cmd EGR_ctl_status EGR_vlv_act EGRdP_offset EGRdP_offset_state m_d_pct_act mdot_EGR_act m_d_pct_act_dry mdot_EGR_cmd EGR_vlv_temp_est EGR_stuckvlv_state /end REF_MEASUREMENT
/end GROUP
/begin GROUP EC_Knock "ECONTROLS" ROOT /begin REF_MEASUREMENT OCT_adapt EGR_oct_retard EGR_oct_LL_pct m_d_pct_oct_ofst /end REF_MEASUREMENT /end GROUP
/begin GROUP EC_PhiGsln "ECONTROLS" ROOT /begin REF_MEASUREMENT OCT_adapt /end REF_MEASUREMENT /end GROUP
/begin GROUP EC_SparkCal "ECONTROLS" ROOT /begin REF_MEASUREMENT OCT_adapt EGR_retard /end REF_MEASUREMENT /end GROUP
/begin GROUP EC_SparkCalLP "ECONTROLS" ROOT /begin REF_MEASUREMENT EGR_retard /end REF_MEASUREMENT /end GROUP
/begin GROUP EC_SparkCalNG "ECONTROLS" ROOT /begin REF_MEASUREMENT EGR_retard /end REF_MEASUREMENT /end GROUP
/begin GROUP EC_SparkOfst "ECONTROLS" ROOT /begin REF_MEASUREMENT EGR_retard /end REF_MEASUREMENT /end GROUP
/begin GROUP EC_Tests "ECONTROLS" ROOT
 /begin REF_MEASUREMENT EGR_vlv_cmd EGR_vlv_act manual_EGR_cmd1 manual_EGR_cmd2 manual_EGR_toggle manual_EGR_slct /end REF_MEASUREMENT
/end GROUP
/begin GROUP EC_VECal "ECONTROLS" ROOT /begin REF_MEASUREMENT mdot_mix_fill_float VE_EGR_ofst /end REF_MEASUREMENT /end GROUP
/end MODULE
/end PROJECT
