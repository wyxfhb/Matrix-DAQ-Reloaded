ASAP2_VERSION 1 61
/begin PROJECT Econtrols_4G "4G Test"
/begin HEADER "4G A2L Configuration" PROJECT_NO EControls4G /* config for version control */ VERSION "$Revision: 82130 $:" /* config for version control */ /end HEADER
/begin MODULE EControls_4G_SH2A "EControls 4G"
/begin MOD_COMMON "" DEPOSIT ABSOLUTE BYTE_ORDER MSB_FIRST /end MOD_COMMON
/* Define the Record Layouts */
/begin RECORD_LAYOUT ECIPP_ALIGNMENT_UBYTE FNC_VALUES 1 UBYTE COLUMN_DIR DIRECT /end RECORD_LAYOUT
/begin RECORD_LAYOUT ECIPP_ALIGNMENT_UWORD FNC_VALUES 1 UWORD COLUMN_DIR DIRECT /end RECORD_LAYOUT
/begin RECORD_LAYOUT ECIPP_ALIGNMENT_ULONG FNC_VALUES 1 ULONG COLUMN_DIR DIRECT /end RECORD_LAYOUT
/* Define generic COMPU_METHODS used in the A2L */ /* NOTE: most of the parameters from ECIPP use unique/specific COMPU_METHODS */
/begin COMPU_METHOD Compu_ECIPP_STRINGS "ECIPP Strings " /* Identifier */ RAT_FUNC "%.0" /* Format */ "ASCII" /* Units */ COEFFS 0 1 0 0 0 1 /end COMPU_METHOD
/begin MEASUREMENT EGT "EGT" UWORD Compu_EGT 0 0 -460 7731.875 ECU_ADDRESS 0x010001E0 /end MEASUREMENT
/begin COMPU_METHOD Compu_EGT " " RAT_FUNC "%.1" "deg F" COEFFS 0 8 3680 0 0 1 /end COMPU_METHOD
/begin MEASUREMENT Vdot_exhaust "Exhaust volume flow rate" UWORD Compu_Vdot_exhaust 0 0 0 8191.875 ECU_ADDRESS 0x01001CA8 /end MEASUREMENT
/begin COMPU_METHOD Compu_Vdot_exhaust " " RAT_FUNC "%.1" "l / s" COEFFS 0 8 0 0 0 1 /end COMPU_METHOD
/begin MEASUREMENT EMP_slow "EMP" UWORD Compu_EMP_slow 0 0 0 255.99609375 ECU_ADDRESS 0x010092E0 /end MEASUREMENT
/begin COMPU_METHOD Compu_EMP_slow " " RAT_FUNC "%.2" "psia" COEFFS 0 256 0 0 0 1 /end COMPU_METHOD
/begin MEASUREMENT DPFdP "DPF delta-P" SWORD Compu_DPFdP 0 0 -32 31.9990234375 ECU_ADDRESS 0x010092F0 /end MEASUREMENT
/begin COMPU_METHOD Compu_DPFdP " " RAT_FUNC "%.3" "psig" COEFFS 0 1024 0 0 0 1 /end COMPU_METHOD
/begin MEASUREMENT TOT "Turbine Tout" UWORD Compu_TOT 0 0 -460 7731.875 ECU_ADDRESS 0x01009320 /end MEASUREMENT
/begin COMPU_METHOD Compu_TOT " " RAT_FUNC "%.1" "deg F" COEFFS 0 8 3680 0 0 1 /end COMPU_METHOD
/begin MEASUREMENT DOCT "DOCT" UWORD Compu_DOCT 0 0 -460 7731.875 ECU_ADDRESS 0x01009330 /end MEASUREMENT
/begin COMPU_METHOD Compu_DOCT " " RAT_FUNC "%.1" "deg F" COEFFS 0 8 3680 0 0 1 /end COMPU_METHOD
/begin MEASUREMENT DPFT "DPFT" UWORD Compu_DPFT 0 0 -460 7731.875 ECU_ADDRESS 0x01009338 /end MEASUREMENT
/begin COMPU_METHOD Compu_DPFT " " RAT_FUNC "%.1" "deg F" COEFFS 0 8 3680 0 0 1 /end COMPU_METHOD
/begin MEASUREMENT SCRT "SCRT" UWORD Compu_SCRT 0 0 -460 7731.875 ECU_ADDRESS 0x01009340 /end MEASUREMENT
/begin COMPU_METHOD Compu_SCRT " " RAT_FUNC "%.1" "deg F" COEFFS 0 8 3680 0 0 1 /end COMPU_METHOD
/begin CHARACTERISTIC DOCT_ena "DOCT source{DOCT_ena&0xff=0:Disabled}{DOCT_ena&0xff=1:Aux PU1}{DOCT_ena&0xff=2:Aux PU2}{DOCT_ena&0xff=3:Aux PU3}{DOCT_ena&0xff=4:Aux PUD1}{DOCT_ena&0xff=5:Aux PUD2}{DOCT_ena&0xff=6:Aux PUD3}{DOCT_ena&0xff=7:EGT Input}{DOCT_ena&0xff=8:Aux PUD4}{DOCT_ena&0x" VALUE 0x00170f89 /* @ECU_Address@DOCT_ena@0x010093B8@ */ ECIPP_ALIGNMENT_UBYTE 255 DOCT_ena_COMPU_VTAB 0 255 BIT_MASK 0xff /end CHARACTERISTIC
/begin COMPU_METHOD DOCT_ena_COMPU_VTAB "Verbal Table" TAB_VERB "%.0" "list" COMPU_TAB_REF DOCT_ena_COMPU_VTAB_REF /end COMPU_METHOD
/begin COMPU_VTAB DOCT_ena_COMPU_VTAB_REF "Verbal Table" TAB_VERB 31 0 "Disabled" 1 "Aux PU1" 2 "Aux PU2" 3 "Aux PU3" 4 "Aux PUD1" 5 "Aux PUD2" 6 "Aux PUD3" 7 "EGT Input" 8 "Aux PUD4" 9 "Aux PUD5" 10 "Aux PUD6" 11 "Aux PUD7" 12 "Aux PUD8" 13 "Aux PUD9" 14 "Aux PUD10" 15 "Aux PUD11" 16 "Aux PUD12" 17 "Aux PUD13" 18 "Aux PUD14" 19 "Aux PUD15" 20 "Aux PUD16" 21 "Aux PUD17" 22 "Aux PUD18" 23 "Aux PUD19" 24 "Aux PUD20" 25 "Aux PUD21" 26 "Aux PUD22" 27 "Aux PUD23" 28 "Aux PUD24" 29 "Aux PUD25" 30 "CAN sourced" DEFAULT_VALUE "UNKNOWN" /end COMPU_VTAB
/begin CHARACTERISTIC DPFT_ena "DPFT source{DPFT_ena&0xff=0:Disabled}{DPFT_ena&0xff=1:Aux PU1}{DPFT_ena&0xff=2:Aux PU2}{DPFT_ena&0xff=3:Aux PU3}{DPFT_ena&0xff=4:Aux PUD1}{DPFT_ena&0xff=5:Aux PUD2}{DPFT_ena&0xff=6:Aux PUD3}{DPFT_ena&0xff=7:EGT Input}{DPFT_ena&0xff=8:Aux PUD4}{DPFT_ena&0x" VALUE 0x00170f8b /* @ECU_Address@DPFT_ena@0x010093C0@ */ ECIPP_ALIGNMENT_UBYTE 255 DPFT_ena_COMPU_VTAB 0 255 BIT_MASK 0xff /end CHARACTERISTIC
/begin COMPU_METHOD DPFT_ena_COMPU_VTAB "Verbal Table" TAB_VERB "%.0" "list" COMPU_TAB_REF DPFT_ena_COMPU_VTAB_REF /end COMPU_METHOD
/begin COMPU_VTAB DPFT_ena_COMPU_VTAB_REF "Verbal Table" TAB_VERB 31 0 "Disabled" 1 "Aux PU1" 2 "Aux PU2" 3 "Aux PU3" 4 "Aux PUD1" 5 "Aux PUD2" 6 "Aux PUD3" 7 "EGT Input" 8 "Aux PUD4" 9 "Aux PUD5" 10 "Aux PUD6" 11 "Aux PUD7" 12 "Aux PUD8" 13 "Aux PUD9" 14 "Aux PUD10" 15 "Aux PUD11" 16 "Aux PUD12" 17 "Aux PUD13" 18 "Aux PUD14" 19 "Aux PUD15" 20 "Aux PUD16" 21 "Aux PUD17" 22 "Aux PUD18" 23 "Aux PUD19" 24 "Aux PUD20" 25 "Aux PUD21" 26 "Aux PUD22" 27 "Aux PUD23" 28 "Aux PUD24" 29 "Aux PUD25" 30 "CAN sourced" DEFAULT_VALUE "UNKNOWN" /end COMPU_VTAB
/begin CHARACTERISTIC SCRT_ena "SCRT source{SCRT_ena&0xff=0:Disabled}{SCRT_ena&0xff=1:Aux PU1}{SCRT_ena&0xff=2:Aux PU2}{SCRT_ena&0xff=3:Aux PU3}{SCRT_ena&0xff=4:Aux PUD1}{SCRT_ena&0xff=5:Aux PUD2}{SCRT_ena&0xff=6:Aux PUD3}{SCRT_ena&0xff=7:EGT Input}{SCRT_ena&0xff=8:Aux PUD4}{SCRT_ena&0x" VALUE 0x00170f8f /* @ECU_Address@SCRT_ena@0x010093C8@ */ ECIPP_ALIGNMENT_UBYTE 255 SCRT_ena_COMPU_VTAB 0 255 BIT_MASK 0xff /end CHARACTERISTIC
/begin COMPU_METHOD SCRT_ena_COMPU_VTAB "Verbal Table" TAB_VERB "%.0" "list" COMPU_TAB_REF SCRT_ena_COMPU_VTAB_REF /end COMPU_METHOD
/begin COMPU_VTAB SCRT_ena_COMPU_VTAB_REF "Verbal Table" TAB_VERB 31 0 "Disabled" 1 "Aux PU1" 2 "Aux PU2" 3 "Aux PU3" 4 "Aux PUD1" 5 "Aux PUD2" 6 "Aux PUD3" 7 "EGT Input" 8 "Aux PUD4" 9 "Aux PUD5" 10 "Aux PUD6" 11 "Aux PUD7" 12 "Aux PUD8" 13 "Aux PUD9" 14 "Aux PUD10" 15 "Aux PUD11" 16 "Aux PUD12" 17 "Aux PUD13" 18 "Aux PUD14" 19 "Aux PUD15" 20 "Aux PUD16" 21 "Aux PUD17" 22 "Aux PUD18" 23 "Aux PUD19" 24 "Aux PUD20" 25 "Aux PUD21" 26 "Aux PUD22" 27 "Aux PUD23" 28 "Aux PUD24" 29 "Aux PUD25" 30 "CAN sourced" DEFAULT_VALUE "UNKNOWN" /end COMPU_VTAB
/begin CHARACTERISTIC DPFdP_ena "DPF delta-P sensor{DPFdP_ena&0xff=0:Disabled}{DPFdP_ena&0xff=1:Aux PD1}{DPFdP_ena&0xff=2:Aux PD2}{DPFdP_ena&0xff=3:Aux PD3}{DPFdP_ena&0xff=4:Aux PUD1}{DPFdP_ena&0xff=5:Aux PUD2}{DPFdP_ena&0xff=6:Aux PUD3}{DPFdP_ena&0xff=7:Aux PUD4}{DPFdP_ena&0xff=8:Aux PU" VALUE 0x00170f8d /* @ECU_Address@DPFdP_ena@0x01009418@ */ ECIPP_ALIGNMENT_UBYTE 255 DPFdP_ena_COMPU_VTAB 0 255 BIT_MASK 0xff /end CHARACTERISTIC
/begin COMPU_METHOD DPFdP_ena_COMPU_VTAB "Verbal Table" TAB_VERB "%.0" "list" COMPU_TAB_REF DPFdP_ena_COMPU_VTAB_REF /end COMPU_METHOD
/begin COMPU_VTAB DPFdP_ena_COMPU_VTAB_REF "Verbal Table" TAB_VERB 31 0 "Disabled" 1 "Aux PD1" 2 "Aux PD2" 3 "Aux PD3" 4 "Aux PUD1" 5 "Aux PUD2" 6 "Aux PUD3" 7 "Aux PUD4" 8 "Aux PUD5" 9 "Aux PUD6" 10 "Aux PUD7" 11 "Aux PUD8" 12 "Aux PUD9" 13 "Aux PUD10" 14 "Aux PUD11" 15 "Aux PUD12" 16 "Aux PUD13" 17 "Aux PUD14" 18 "Aux PUD15" 19 "CAN sourced" 20 "FPP2 Input" 21 "Aux PUD16" 22 "Aux PUD17" 23 "Aux PUD18" 24 "Aux PUD19" 25 "Aux PUD20" 26 "Aux PUD21" 27 "Aux PUD22" 28 "Aux PUD23" 29 "Aux PUD24" 30 "Aux PUD25" DEFAULT_VALUE "UNKNOWN" /end COMPU_VTAB
/begin CHARACTERISTIC DPF_V_init "DPF initial volume" VALUE 0x00170e66 /* @ECU_Address@DPF_V_init@0x01009878@ */ ECIPP_ALIGNMENT_UWORD 32 Compu_DPF_V_init 0 31.99951171875 /end CHARACTERISTIC
/begin COMPU_METHOD Compu_DPF_V_init " " RAT_FUNC "%.2" "L" COEFFS 0 2048 0 0 0 1 /end COMPU_METHOD
/begin MEASUREMENT DPF_regen_active "DPF regen status{DPF_regen_active&0xff=0:Inactive}{DPF_regen_active&0xff=1:Active}" UBYTE DPF_regen_active_COMPU_VTAB 0 0 0 255 ECU_ADDRESS 0x01009880 BIT_MASK 0xff /end MEASUREMENT
/begin COMPU_METHOD DPF_regen_active_COMPU_VTAB "Verbal Table" TAB_VERB "%.0" "list" COMPU_TAB_REF DPF_regen_active_COMPU_VTAB_REF /end COMPU_METHOD
/begin COMPU_VTAB DPF_regen_active_COMPU_VTAB_REF "Verbal Table" TAB_VERB 2 0 "Inactive" 1 "Active" DEFAULT_VALUE "UNKNOWN" /end COMPU_VTAB
/begin MEASUREMENT DPF_soot_grams "DPF total soot accumulated" ULONG Compu_DPF_soot_grams 0 0 0 511.999999880791 ECU_ADDRESS 0x01009888 /end MEASUREMENT
/begin COMPU_METHOD Compu_DPF_soot_grams " " RAT_FUNC "%.1" "grams" COEFFS 0 8388608 0 0 0 1 /end COMPU_METHOD
/begin MEASUREMENT DPF_soot_g_per_L "DPF soot loading" UWORD Compu_DPF_soot_g_per_L 0 0 0 63.9990234375 ECU_ADDRESS 0x01009890 /end MEASUREMENT
/begin COMPU_METHOD Compu_DPF_soot_g_per_L " " RAT_FUNC "%.1" "g/L" COEFFS 0 1024 0 0 0 1 /end COMPU_METHOD
/begin MEASUREMENT DPF_soot_mg_sec "DPF soot loading rate" SWORD Compu_DPF_soot_mg_sec 0 0 -64 63.998046875 ECU_ADDRESS 0x01009898 /end MEASUREMENT
/begin COMPU_METHOD Compu_DPF_soot_mg_sec " " RAT_FUNC "%.2" "mg/sec" COEFFS 0 512 0 0 0 1 /end COMPU_METHOD
/begin MEASUREMENT mdot_ports_cmd "Port flow command" UWORD Compu_mdot_ports_cmd 0 0 0 1023.984375 ECU_ADDRESS 0x01009FB8 /end MEASUREMENT
/begin COMPU_METHOD Compu_mdot_ports_cmd " " RAT_FUNC "%.1" "g/sec" COEFFS 0 64 0 0 0 1 /end COMPU_METHOD
/begin CHARACTERISTIC CRI_Tpost2_slct1 "Post 2 injection timing{CRI_Tpost2_slct1&0xff=0:Standard}{CRI_Tpost2_slct1&0xff=1:Alternate 1}{CRI_Tpost2_slct1&0xff=2:Alt 1 + Std}" VALUE 0x00170EE9 /* @ECU_Address@CRI_Tpost2_slct1@0x0100A610@ */ ECIPP_ALIGNMENT_UBYTE 255 CRI_Tpost2_slct1_COMPU_VTAB 0 255 BIT_MASK 0xff /end CHARACTERISTIC
/begin COMPU_METHOD CRI_Tpost2_slct1_COMPU_VTAB "Verbal Table" TAB_VERB "%.0" "list" COMPU_TAB_REF CRI_Tpost2_slct1_COMPU_VTAB_REF /end COMPU_METHOD
/begin COMPU_VTAB CRI_Tpost2_slct1_COMPU_VTAB_REF "Verbal Table" TAB_VERB 3 0 "Standard" 1 "Alternate 1" 2 "Alt 1 + Std" DEFAULT_VALUE "UNKNOWN" /end COMPU_VTAB
/begin CHARACTERISTIC CRI_Tpost2_slct2 "Post 2 injection timing{CRI_Tpost2_slct2&0xff=0:Standard}{CRI_Tpost2_slct2&0xff=1:Alternate 1}{CRI_Tpost2_slct2&0xff=2:Alt 1 + Std}" VALUE 0x00170EEA /* @ECU_Address@CRI_Tpost2_slct2@0x0100A618@ */ ECIPP_ALIGNMENT_UBYTE 255 CRI_Tpost2_slct2_COMPU_VTAB 0 255 BIT_MASK 0xff /end CHARACTERISTIC
/begin COMPU_METHOD CRI_Tpost2_slct2_COMPU_VTAB "Verbal Table" TAB_VERB "%.0" "list" COMPU_TAB_REF CRI_Tpost2_slct2_COMPU_VTAB_REF /end COMPU_METHOD
/begin COMPU_VTAB CRI_Tpost2_slct2_COMPU_VTAB_REF "Verbal Table" TAB_VERB 3 0 "Standard" 1 "Alternate 1" 2 "Alt 1 + Std" DEFAULT_VALUE "UNKNOWN" /end COMPU_VTAB
/begin CHARACTERISTIC CRI_Tpost2_slct3 "Post 2 injection timing{CRI_Tpost2_slct3&0xff=0:Standard}{CRI_Tpost2_slct3&0xff=1:Alternate 1}{CRI_Tpost2_slct3&0xff=2:Alt 1 + Std}" VALUE 0x00170EEB /* @ECU_Address@CRI_Tpost2_slct3@0x0100A620@ */ ECIPP_ALIGNMENT_UBYTE 255 CRI_Tpost2_slct3_COMPU_VTAB 0 255 BIT_MASK 0xff /end CHARACTERISTIC
/begin COMPU_METHOD CRI_Tpost2_slct3_COMPU_VTAB "Verbal Table" TAB_VERB "%.0" "list" COMPU_TAB_REF CRI_Tpost2_slct3_COMPU_VTAB_REF /end COMPU_METHOD
/begin COMPU_VTAB CRI_Tpost2_slct3_COMPU_VTAB_REF "Verbal Table" TAB_VERB 3 0 "Standard" 1 "Alternate 1" 2 "Alt 1 + Std" DEFAULT_VALUE "UNKNOWN" /end COMPU_VTAB
/begin CHARACTERISTIC CRI_Tpost2_slct4 "Post 2 injection timing{CRI_Tpost2_slct4&0xff=0:Standard}{CRI_Tpost2_slct4&0xff=1:Alternate 1}{CRI_Tpost2_slct4&0xff=2:Alt 1 + Std}" VALUE 0x00170EEC /* @ECU_Address@CRI_Tpost2_slct4@0x0100A628@ */ ECIPP_ALIGNMENT_UBYTE 255 CRI_Tpost2_slct4_COMPU_VTAB 0 255 BIT_MASK 0xff /end CHARACTERISTIC
/begin COMPU_METHOD CRI_Tpost2_slct4_COMPU_VTAB "Verbal Table" TAB_VERB "%.0" "list" COMPU_TAB_REF CRI_Tpost2_slct4_COMPU_VTAB_REF /end COMPU_METHOD
/begin COMPU_VTAB CRI_Tpost2_slct4_COMPU_VTAB_REF "Verbal Table" TAB_VERB 3 0 "Standard" 1 "Alternate 1" 2 "Alt 1 + Std" DEFAULT_VALUE "UNKNOWN" /end COMPU_VTAB
/begin CHARACTERISTIC CRI_Tpost2_slct5 "Post 2 injection timing{CRI_Tpost2_slct5&0xff=0:Standard}{CRI_Tpost2_slct5&0xff=1:Alternate 1}{CRI_Tpost2_slct5&0xff=2:Alt 1 + Std}" VALUE 0x00170EED /* @ECU_Address@CRI_Tpost2_slct5@0x0100A630@ */ ECIPP_ALIGNMENT_UBYTE 255 CRI_Tpost2_slct5_COMPU_VTAB 0 255 BIT_MASK 0xff /end CHARACTERISTIC
/begin COMPU_METHOD CRI_Tpost2_slct5_COMPU_VTAB "Verbal Table" TAB_VERB "%.0" "list" COMPU_TAB_REF CRI_Tpost2_slct5_COMPU_VTAB_REF /end COMPU_METHOD
/begin COMPU_VTAB CRI_Tpost2_slct5_COMPU_VTAB_REF "Verbal Table" TAB_VERB 3 0 "Standard" 1 "Alternate 1" 2 "Alt 1 + Std" DEFAULT_VALUE "UNKNOWN" /end COMPU_VTAB
/begin CHARACTERISTIC CRI_Tpost2_slct6 "Post 2 injection timing{CRI_Tpost2_slct6&0xff=0:Standard}{CRI_Tpost2_slct6&0xff=1:Alternate 1}{CRI_Tpost2_slct6&0xff=2:Alt 1 + Std}" VALUE 0x00170EEE /* @ECU_Address@CRI_Tpost2_slct6@0x0100A638@ */ ECIPP_ALIGNMENT_UBYTE 255 CRI_Tpost2_slct6_COMPU_VTAB 0 255 BIT_MASK 0xff /end CHARACTERISTIC
/begin COMPU_METHOD CRI_Tpost2_slct6_COMPU_VTAB "Verbal Table" TAB_VERB "%.0" "list" COMPU_TAB_REF CRI_Tpost2_slct6_COMPU_VTAB_REF /end COMPU_METHOD
/begin COMPU_VTAB CRI_Tpost2_slct6_COMPU_VTAB_REF "Verbal Table" TAB_VERB 3 0 "Standard" 1 "Alternate 1" 2 "Alt 1 + Std" DEFAULT_VALUE "UNKNOWN" /end COMPU_VTAB
/begin CHARACTERISTIC CRI_Tpost2_slct7 "Post 2 injection timing{CRI_Tpost2_slct7&0xff=0:Standard}{CRI_Tpost2_slct7&0xff=1:Alternate 1}{CRI_Tpost2_slct7&0xff=2:Alt 1 + Std}" VALUE 0x00170EEF /* @ECU_Address@CRI_Tpost2_slct7@0x0100A640@ */ ECIPP_ALIGNMENT_UBYTE 255 CRI_Tpost2_slct7_COMPU_VTAB 0 255 BIT_MASK 0xff /end CHARACTERISTIC
/begin COMPU_METHOD CRI_Tpost2_slct7_COMPU_VTAB "Verbal Table" TAB_VERB "%.0" "list" COMPU_TAB_REF CRI_Tpost2_slct7_COMPU_VTAB_REF /end COMPU_METHOD
/begin COMPU_VTAB CRI_Tpost2_slct7_COMPU_VTAB_REF "Verbal Table" TAB_VERB 3 0 "Standard" 1 "Alternate 1" 2 "Alt 1 + Std" DEFAULT_VALUE "UNKNOWN" /end COMPU_VTAB
/begin MEASUREMENT CRI_active_mode "Active mode" UBYTE Compu_CRI_active_mode 0 0 0 255 ECU_ADDRESS 0x0100A648 /end MEASUREMENT
/begin COMPU_METHOD Compu_CRI_active_mode " " RAT_FUNC "%.0" "-" COEFFS 0 1 0 0 0 1 /end COMPU_METHOD
/begin CHARACTERISTIC CRI_pilot1_priority0 "Pilot 1/2 conflict priority{CRI_pilot1_priority0&0xff=0:Pilot 1}{CRI_pilot1_priority0&0xff=1:Pilot 2}" VALUE 0x00170F74 /* @ECU_Address@CRI_pilot1_priority0@0x0100A7A8@ */ ECIPP_ALIGNMENT_UBYTE 255 CRI_pilot1_priority0_COMPU_VTAB 0 255 BIT_MASK 0xff /end CHARACTERISTIC
/begin COMPU_METHOD CRI_pilot1_priority0_COMPU_VTAB "Verbal Table" TAB_VERB "%.0" "list" COMPU_TAB_REF CRI_pilot1_priority0_COMPU_VTAB_REF /end COMPU_METHOD
/begin COMPU_VTAB CRI_pilot1_priority0_COMPU_VTAB_REF "Verbal Table" TAB_VERB 2 0 "Pilot 1" 1 "Pilot 2" DEFAULT_VALUE "UNKNOWN" /end COMPU_VTAB
/begin CHARACTERISTIC CRI_pulseoff_slct0 "Forced injection disabling table{CRI_pulseoff_slct0&0xff=0:None}{CRI_pulseoff_slct0&0xff=1:Standard}{CRI_pulseoff_slct0&0xff=2:Alternate 1}{CRI_pulseoff_slct0&0xff=3:Alt 1 or Std}" VALUE 0x00170F7E /* @ECU_Address@CRI_pulseoff_slct0@0x0100A7B0@ */ ECIPP_ALIGNMENT_UBYTE 255 CRI_pulseoff_slct0_COMPU_VTAB 0 255 BIT_MASK 0xff /end CHARACTERISTIC
/begin COMPU_METHOD CRI_pulseoff_slct0_COMPU_VTAB "Verbal Table" TAB_VERB "%.0" "list" COMPU_TAB_REF CRI_pulseoff_slct0_COMPU_VTAB_REF /end COMPU_METHOD
/begin COMPU_VTAB CRI_pulseoff_slct0_COMPU_VTAB_REF "Verbal Table" TAB_VERB 4 0 "None" 1 "Standard" 2 "Alternate 1" 3 "Alt 1 or Std" DEFAULT_VALUE "UNKNOWN" /end COMPU_VTAB
/begin CHARACTERISTIC CRI_pulseoff_slct1 "Forced injection disabling table{CRI_pulseoff_slct1&0xff=0:None}{CRI_pulseoff_slct1&0xff=1:Standard}{CRI_pulseoff_slct1&0xff=2:Alternate 1}{CRI_pulseoff_slct1&0xff=3:Alt 1 or Std}" VALUE 0x00170F7F /* @ECU_Address@CRI_pulseoff_slct1@0x0100A7B8@ */ ECIPP_ALIGNMENT_UBYTE 255 CRI_pulseoff_slct1_COMPU_VTAB 0 255 BIT_MASK 0xff /end CHARACTERISTIC
/begin COMPU_METHOD CRI_pulseoff_slct1_COMPU_VTAB "Verbal Table" TAB_VERB "%.0" "list" COMPU_TAB_REF CRI_pulseoff_slct1_COMPU_VTAB_REF /end COMPU_METHOD
/begin COMPU_VTAB CRI_pulseoff_slct1_COMPU_VTAB_REF "Verbal Table" TAB_VERB 4 0 "None" 1 "Standard" 2 "Alternate 1" 3 "Alt 1 or Std" DEFAULT_VALUE "UNKNOWN" /end COMPU_VTAB
/begin CHARACTERISTIC CRI_pulseoff_slct2 "Forced injection disabling table{CRI_pulseoff_slct2&0xff=0:None}{CRI_pulseoff_slct2&0xff=1:Standard}{CRI_pulseoff_slct2&0xff=2:Alternate 1}{CRI_pulseoff_slct2&0xff=3:Alt 1 or Std}" VALUE 0x00170F80 /* @ECU_Address@CRI_pulseoff_slct2@0x0100A7C0@ */ ECIPP_ALIGNMENT_UBYTE 255 CRI_pulseoff_slct2_COMPU_VTAB 0 255 BIT_MASK 0xff /end CHARACTERISTIC
/begin COMPU_METHOD CRI_pulseoff_slct2_COMPU_VTAB "Verbal Table" TAB_VERB "%.0" "list" COMPU_TAB_REF CRI_pulseoff_slct2_COMPU_VTAB_REF /end COMPU_METHOD
/begin COMPU_VTAB CRI_pulseoff_slct2_COMPU_VTAB_REF "Verbal Table" TAB_VERB 4 0 "None" 1 "Standard" 2 "Alternate 1" 3 "Alt 1 or Std" DEFAULT_VALUE "UNKNOWN" /end COMPU_VTAB
/begin CHARACTERISTIC CRI_pulseoff_slct3 "Forced injection disabling table{CRI_pulseoff_slct3&0xff=0:None}{CRI_pulseoff_slct3&0xff=1:Standard}{CRI_pulseoff_slct3&0xff=2:Alternate 1}{CRI_pulseoff_slct3&0xff=3:Alt 1 or Std}" VALUE 0x00170F81 /* @ECU_Address@CRI_pulseoff_slct3@0x0100A7C8@ */ ECIPP_ALIGNMENT_UBYTE 255 CRI_pulseoff_slct3_COMPU_VTAB 0 255 BIT_MASK 0xff /end CHARACTERISTIC
/begin COMPU_METHOD CRI_pulseoff_slct3_COMPU_VTAB "Verbal Table" TAB_VERB "%.0" "list" COMPU_TAB_REF CRI_pulseoff_slct3_COMPU_VTAB_REF /end COMPU_METHOD
/begin COMPU_VTAB CRI_pulseoff_slct3_COMPU_VTAB_REF "Verbal Table" TAB_VERB 4 0 "None" 1 "Standard" 2 "Alternate 1" 3 "Alt 1 or Std" DEFAULT_VALUE "UNKNOWN" /end COMPU_VTAB
/begin CHARACTERISTIC CRI_pulseoff_slct4 "Forced injection disabling table{CRI_pulseoff_slct4&0xff=0:None}{CRI_pulseoff_slct4&0xff=1:Standard}{CRI_pulseoff_slct4&0xff=2:Alternate 1}{CRI_pulseoff_slct4&0xff=3:Alt 1 or Std}" VALUE 0x00170F82 /* @ECU_Address@CRI_pulseoff_slct4@0x0100A7D0@ */ ECIPP_ALIGNMENT_UBYTE 255 CRI_pulseoff_slct4_COMPU_VTAB 0 255 BIT_MASK 0xff /end CHARACTERISTIC
/begin COMPU_METHOD CRI_pulseoff_slct4_COMPU_VTAB "Verbal Table" TAB_VERB "%.0" "list" COMPU_TAB_REF CRI_pulseoff_slct4_COMPU_VTAB_REF /end COMPU_METHOD
/begin COMPU_VTAB CRI_pulseoff_slct4_COMPU_VTAB_REF "Verbal Table" TAB_VERB 4 0 "None" 1 "Standard" 2 "Alternate 1" 3 "Alt 1 or Std" DEFAULT_VALUE "UNKNOWN" /end COMPU_VTAB
/begin CHARACTERISTIC CRI_pulseoff_slct5 "Forced injection disabling table{CRI_pulseoff_slct5&0xff=0:None}{CRI_pulseoff_slct5&0xff=1:Standard}{CRI_pulseoff_slct5&0xff=2:Alternate 1}{CRI_pulseoff_slct5&0xff=3:Alt 1 or Std}" VALUE 0x00170F83 /* @ECU_Address@CRI_pulseoff_slct5@0x0100A7D8@ */ ECIPP_ALIGNMENT_UBYTE 255 CRI_pulseoff_slct5_COMPU_VTAB 0 255 BIT_MASK 0xff /end CHARACTERISTIC
/begin COMPU_METHOD CRI_pulseoff_slct5_COMPU_VTAB "Verbal Table" TAB_VERB "%.0" "list" COMPU_TAB_REF CRI_pulseoff_slct5_COMPU_VTAB_REF /end COMPU_METHOD
/begin COMPU_VTAB CRI_pulseoff_slct5_COMPU_VTAB_REF "Verbal Table" TAB_VERB 4 0 "None" 1 "Standard" 2 "Alternate 1" 3 "Alt 1 or Std" DEFAULT_VALUE "UNKNOWN" /end COMPU_VTAB
/begin CHARACTERISTIC CRI_pulseoff_slct6 "Forced injection disabling table{CRI_pulseoff_slct6&0xff=0:None}{CRI_pulseoff_slct6&0xff=1:Standard}{CRI_pulseoff_slct6&0xff=2:Alternate 1}{CRI_pulseoff_slct6&0xff=3:Alt 1 or Std}" VALUE 0x00170F84 /* @ECU_Address@CRI_pulseoff_slct6@0x0100A7E0@ */ ECIPP_ALIGNMENT_UBYTE 255 CRI_pulseoff_slct6_COMPU_VTAB 0 255 BIT_MASK 0xff /end CHARACTERISTIC
/begin COMPU_METHOD CRI_pulseoff_slct6_COMPU_VTAB "Verbal Table" TAB_VERB "%.0" "list" COMPU_TAB_REF CRI_pulseoff_slct6_COMPU_VTAB_REF /end COMPU_METHOD
/begin COMPU_VTAB CRI_pulseoff_slct6_COMPU_VTAB_REF "Verbal Table" TAB_VERB 4 0 "None" 1 "Standard" 2 "Alternate 1" 3 "Alt 1 or Std" DEFAULT_VALUE "UNKNOWN" /end COMPU_VTAB
/begin CHARACTERISTIC CRI_pulseoff_slct7 "Forced injection disabling table{CRI_pulseoff_slct7&0xff=0:None}{CRI_pulseoff_slct7&0xff=1:Standard}{CRI_pulseoff_slct7&0xff=2:Alternate 1}{CRI_pulseoff_slct7&0xff=3:Alt 1 or Std}" VALUE 0x00170F85 /* @ECU_Address@CRI_pulseoff_slct7@0x0100A7E8@ */ ECIPP_ALIGNMENT_UBYTE 255 CRI_pulseoff_slct7_COMPU_VTAB 0 255 BIT_MASK 0xff /end CHARACTERISTIC
/begin COMPU_METHOD CRI_pulseoff_slct7_COMPU_VTAB "Verbal Table" TAB_VERB "%.0" "list" COMPU_TAB_REF CRI_pulseoff_slct7_COMPU_VTAB_REF /end COMPU_METHOD
/begin COMPU_VTAB CRI_pulseoff_slct7_COMPU_VTAB_REF "Verbal Table" TAB_VERB 4 0 "None" 1 "Standard" 2 "Alternate 1" 3 "Alt 1 or Std" DEFAULT_VALUE "UNKNOWN" /end COMPU_VTAB
/begin CHARACTERISTIC CRI_bst_dP_scalar0 "Boost EMP throttle delta-P scalar" VALUE 0x00170DC4 /* @ECU_Address@CRI_bst_dP_scalar0@0x0100A7F0@ */ ECIPP_ALIGNMENT_UWORD 256 Compu_CRI_bst_dP_scalar0 0 255.99609375 /end CHARACTERISTIC
/begin COMPU_METHOD Compu_CRI_bst_dP_scalar0 " " RAT_FUNC "%.2" "psi" COEFFS 0 256 0 0 0 1 /end COMPU_METHOD
/begin CHARACTERISTIC CRI_bst_dP_slct0 "Boost EMP throttle delta-P command{CRI_bst_dP_slct0&0xff=0:Scalar (below)}{CRI_bst_dP_slct0&0xff=1:Boost 2D Cmd}" VALUE 0x00170EFC /* @ECU_Address@CRI_bst_dP_slct0@0x0100A7F8@ */ ECIPP_ALIGNMENT_UBYTE 255 CRI_bst_dP_slct0_COMPU_VTAB 0 255 BIT_MASK 0xff /end CHARACTERISTIC
/begin COMPU_METHOD CRI_bst_dP_slct0_COMPU_VTAB "Verbal Table" TAB_VERB "%.0" "list" COMPU_TAB_REF CRI_bst_dP_slct0_COMPU_VTAB_REF /end COMPU_METHOD
/begin COMPU_VTAB CRI_bst_dP_slct0_COMPU_VTAB_REF "Verbal Table" TAB_VERB 2 0 "Scalar (below)" 1 "Boost 2D Cmd" DEFAULT_VALUE "UNKNOWN" /end COMPU_VTAB
/begin CHARACTERISTIC CRI_bst_dP_slct1 "Boost EMP throttle delta-P command{CRI_bst_dP_slct1&0xff=0:Scalar (below)}{CRI_bst_dP_slct1&0xff=1:Boost 2D Cmd}" VALUE 0x00170EFD /* @ECU_Address@CRI_bst_dP_slct1@0x0100A800@ */ ECIPP_ALIGNMENT_UBYTE 255 CRI_bst_dP_slct1_COMPU_VTAB 0 255 BIT_MASK 0xff /end CHARACTERISTIC
/begin COMPU_METHOD CRI_bst_dP_slct1_COMPU_VTAB "Verbal Table" TAB_VERB "%.0" "list" COMPU_TAB_REF CRI_bst_dP_slct1_COMPU_VTAB_REF /end COMPU_METHOD
/begin COMPU_VTAB CRI_bst_dP_slct1_COMPU_VTAB_REF "Verbal Table" TAB_VERB 2 0 "Scalar (below)" 1 "Boost 2D Cmd" DEFAULT_VALUE "UNKNOWN" /end COMPU_VTAB
/begin CHARACTERISTIC CRI_bst_dP_slct2 "Boost EMP throttle delta-P command{CRI_bst_dP_slct2&0xff=0:Scalar (below)}{CRI_bst_dP_slct2&0xff=1:Boost 2D Cmd}" VALUE 0x00170EFE /* @ECU_Address@CRI_bst_dP_slct2@0x0100A808@ */ ECIPP_ALIGNMENT_UBYTE 255 CRI_bst_dP_slct2_COMPU_VTAB 0 255 BIT_MASK 0xff /end CHARACTERISTIC
/begin COMPU_METHOD CRI_bst_dP_slct2_COMPU_VTAB "Verbal Table" TAB_VERB "%.0" "list" COMPU_TAB_REF CRI_bst_dP_slct2_COMPU_VTAB_REF /end COMPU_METHOD
/begin COMPU_VTAB CRI_bst_dP_slct2_COMPU_VTAB_REF "Verbal Table" TAB_VERB 2 0 "Scalar (below)" 1 "Boost 2D Cmd" DEFAULT_VALUE "UNKNOWN" /end COMPU_VTAB
/begin CHARACTERISTIC CRI_bst_dP_slct3 "Boost EMP throttle delta-P command{CRI_bst_dP_slct3&0xff=0:Scalar (below)}{CRI_bst_dP_slct3&0xff=1:Boost 2D Cmd}" VALUE 0x00170EFF /* @ECU_Address@CRI_bst_dP_slct3@0x0100A810@ */ ECIPP_ALIGNMENT_UBYTE 255 CRI_bst_dP_slct3_COMPU_VTAB 0 255 BIT_MASK 0xff /end CHARACTERISTIC
/begin COMPU_METHOD CRI_bst_dP_slct3_COMPU_VTAB "Verbal Table" TAB_VERB "%.0" "list" COMPU_TAB_REF CRI_bst_dP_slct3_COMPU_VTAB_REF /end COMPU_METHOD
/begin COMPU_VTAB CRI_bst_dP_slct3_COMPU_VTAB_REF "Verbal Table" TAB_VERB 2 0 "Scalar (below)" 1 "Boost 2D Cmd" DEFAULT_VALUE "UNKNOWN" /end COMPU_VTAB
/begin CHARACTERISTIC CRI_bst_dP_slct4 "Boost EMP throttle delta-P command{CRI_bst_dP_slct4&0xff=0:Scalar (below)}{CRI_bst_dP_slct4&0xff=1:Boost 2D Cmd}" VALUE 0x00170F00 /* @ECU_Address@CRI_bst_dP_slct4@0x0100A818@ */ ECIPP_ALIGNMENT_UBYTE 255 CRI_bst_dP_slct4_COMPU_VTAB 0 255 BIT_MASK 0xff /end CHARACTERISTIC
/begin COMPU_METHOD CRI_bst_dP_slct4_COMPU_VTAB "Verbal Table" TAB_VERB "%.0" "list" COMPU_TAB_REF CRI_bst_dP_slct4_COMPU_VTAB_REF /end COMPU_METHOD
/begin COMPU_VTAB CRI_bst_dP_slct4_COMPU_VTAB_REF "Verbal Table" TAB_VERB 2 0 "Scalar (below)" 1 "Boost 2D Cmd" DEFAULT_VALUE "UNKNOWN" /end COMPU_VTAB
/begin CHARACTERISTIC CRI_bst_dP_slct5 "Boost EMP throttle delta-P command{CRI_bst_dP_slct5&0xff=0:Scalar (below)}{CRI_bst_dP_slct5&0xff=1:Boost 2D Cmd}" VALUE 0x00170F01 /* @ECU_Address@CRI_bst_dP_slct5@0x0100A820@ */ ECIPP_ALIGNMENT_UBYTE 255 CRI_bst_dP_slct5_COMPU_VTAB 0 255 BIT_MASK 0xff /end CHARACTERISTIC
/begin COMPU_METHOD CRI_bst_dP_slct5_COMPU_VTAB "Verbal Table" TAB_VERB "%.0" "list" COMPU_TAB_REF CRI_bst_dP_slct5_COMPU_VTAB_REF /end COMPU_METHOD
/begin COMPU_VTAB CRI_bst_dP_slct5_COMPU_VTAB_REF "Verbal Table" TAB_VERB 2 0 "Scalar (below)" 1 "Boost 2D Cmd" DEFAULT_VALUE "UNKNOWN" /end COMPU_VTAB
/begin CHARACTERISTIC CRI_bst_dP_slct6 "Boost EMP throttle delta-P command{CRI_bst_dP_slct6&0xff=0:Scalar (below)}{CRI_bst_dP_slct6&0xff=1:Boost 2D Cmd}" VALUE 0x00170F02 /* @ECU_Address@CRI_bst_dP_slct6@0x0100A828@ */ ECIPP_ALIGNMENT_UBYTE 255 CRI_bst_dP_slct6_COMPU_VTAB 0 255 BIT_MASK 0xff /end CHARACTERISTIC
/begin COMPU_METHOD CRI_bst_dP_slct6_COMPU_VTAB "Verbal Table" TAB_VERB "%.0" "list" COMPU_TAB_REF CRI_bst_dP_slct6_COMPU_VTAB_REF /end COMPU_METHOD
/begin COMPU_VTAB CRI_bst_dP_slct6_COMPU_VTAB_REF "Verbal Table" TAB_VERB 2 0 "Scalar (below)" 1 "Boost 2D Cmd" DEFAULT_VALUE "UNKNOWN" /end COMPU_VTAB
/begin CHARACTERISTIC CRI_bst_dP_slct7 "Boost EMP throttle delta-P command{CRI_bst_dP_slct7&0xff=0:Scalar (below)}{CRI_bst_dP_slct7&0xff=1:Boost 2D Cmd}" VALUE 0x00170F03 /* @ECU_Address@CRI_bst_dP_slct7@0x0100A830@ */ ECIPP_ALIGNMENT_UBYTE 255 CRI_bst_dP_slct7_COMPU_VTAB 0 255 BIT_MASK 0xff /end CHARACTERISTIC
/begin COMPU_METHOD CRI_bst_dP_slct7_COMPU_VTAB "Verbal Table" TAB_VERB "%.0" "list" COMPU_TAB_REF CRI_bst_dP_slct7_COMPU_VTAB_REF /end COMPU_METHOD
/begin COMPU_VTAB CRI_bst_dP_slct7_COMPU_VTAB_REF "Verbal Table" TAB_VERB 2 0 "Scalar (below)" 1 "Boost 2D Cmd" DEFAULT_VALUE "UNKNOWN" /end COMPU_VTAB
/begin CHARACTERISTIC CRI_EGR_dP_slct0 "EGR minimum delta-P command{CRI_EGR_dP_slct0&0xff=0:Standard}{CRI_EGR_dP_slct0&0xff=1:Alternate 1}{CRI_EGR_dP_slct0&0xff=2:Alt 1 + Std}" VALUE 0x00170E78 /* @ECU_Address@CRI_EGR_dP_slct0@0x0100A838@ */ ECIPP_ALIGNMENT_UBYTE 255 CRI_EGR_dP_slct0_COMPU_VTAB 0 255 BIT_MASK 0xff /end CHARACTERISTIC
/begin COMPU_METHOD CRI_EGR_dP_slct0_COMPU_VTAB "Verbal Table" TAB_VERB "%.0" "list" COMPU_TAB_REF CRI_EGR_dP_slct0_COMPU_VTAB_REF /end COMPU_METHOD
/begin COMPU_VTAB CRI_EGR_dP_slct0_COMPU_VTAB_REF "Verbal Table" TAB_VERB 3 0 "Standard" 1 "Alternate 1" 2 "Alt 1 + Std" DEFAULT_VALUE "UNKNOWN" /end COMPU_VTAB
/begin CHARACTERISTIC CRI_EGR_dP_slct1 "EGR minimum delta-P command{CRI_EGR_dP_slct1&0xff=0:Standard}{CRI_EGR_dP_slct1&0xff=1:Alternate 1}{CRI_EGR_dP_slct1&0xff=2:Alt 1 + Std}" VALUE 0x00170E79 /* @ECU_Address@CRI_EGR_dP_slct1@0x0100A840@ */ ECIPP_ALIGNMENT_UBYTE 255 CRI_EGR_dP_slct1_COMPU_VTAB 0 255 BIT_MASK 0xff /end CHARACTERISTIC
/begin COMPU_METHOD CRI_EGR_dP_slct1_COMPU_VTAB "Verbal Table" TAB_VERB "%.0" "list" COMPU_TAB_REF CRI_EGR_dP_slct1_COMPU_VTAB_REF /end COMPU_METHOD
/begin COMPU_VTAB CRI_EGR_dP_slct1_COMPU_VTAB_REF "Verbal Table" TAB_VERB 3 0 "Standard" 1 "Alternate 1" 2 "Alt 1 + Std" DEFAULT_VALUE "UNKNOWN" /end COMPU_VTAB
/begin CHARACTERISTIC CRI_EGR_dP_slct2 "EGR minimum delta-P command{CRI_EGR_dP_slct2&0xff=0:Standard}{CRI_EGR_dP_slct2&0xff=1:Alternate 1}{CRI_EGR_dP_slct2&0xff=2:Alt 1 + Std}" VALUE 0x00170E7A /* @ECU_Address@CRI_EGR_dP_slct2@0x0100A848@ */ ECIPP_ALIGNMENT_UBYTE 255 CRI_EGR_dP_slct2_COMPU_VTAB 0 255 BIT_MASK 0xff /end CHARACTERISTIC
/begin COMPU_METHOD CRI_EGR_dP_slct2_COMPU_VTAB "Verbal Table" TAB_VERB "%.0" "list" COMPU_TAB_REF CRI_EGR_dP_slct2_COMPU_VTAB_REF /end COMPU_METHOD
/begin COMPU_VTAB CRI_EGR_dP_slct2_COMPU_VTAB_REF "Verbal Table" TAB_VERB 3 0 "Standard" 1 "Alternate 1" 2 "Alt 1 + Std" DEFAULT_VALUE "UNKNOWN" /end COMPU_VTAB
/begin CHARACTERISTIC CRI_EGR_dP_slct3 "EGR minimum delta-P command{CRI_EGR_dP_slct3&0xff=0:Standard}{CRI_EGR_dP_slct3&0xff=1:Alternate 1}{CRI_EGR_dP_slct3&0xff=2:Alt 1 + Std}" VALUE 0x00170E7B /* @ECU_Address@CRI_EGR_dP_slct3@0x0100A850@ */ ECIPP_ALIGNMENT_UBYTE 255 CRI_EGR_dP_slct3_COMPU_VTAB 0 255 BIT_MASK 0xff /end CHARACTERISTIC
/begin COMPU_METHOD CRI_EGR_dP_slct3_COMPU_VTAB "Verbal Table" TAB_VERB "%.0" "list" COMPU_TAB_REF CRI_EGR_dP_slct3_COMPU_VTAB_REF /end COMPU_METHOD
/begin COMPU_VTAB CRI_EGR_dP_slct3_COMPU_VTAB_REF "Verbal Table" TAB_VERB 3 0 "Standard" 1 "Alternate 1" 2 "Alt 1 + Std" DEFAULT_VALUE "UNKNOWN" /end COMPU_VTAB
/begin CHARACTERISTIC CRI_EGR_dP_slct4 "EGR minimum delta-P command{CRI_EGR_dP_slct4&0xff=0:Standard}{CRI_EGR_dP_slct4&0xff=1:Alternate 1}{CRI_EGR_dP_slct4&0xff=2:Alt 1 + Std}" VALUE 0x00170E7C /* @ECU_Address@CRI_EGR_dP_slct4@0x0100A858@ */ ECIPP_ALIGNMENT_UBYTE 255 CRI_EGR_dP_slct4_COMPU_VTAB 0 255 BIT_MASK 0xff /end CHARACTERISTIC
/begin COMPU_METHOD CRI_EGR_dP_slct4_COMPU_VTAB "Verbal Table" TAB_VERB "%.0" "list" COMPU_TAB_REF CRI_EGR_dP_slct4_COMPU_VTAB_REF /end COMPU_METHOD
/begin COMPU_VTAB CRI_EGR_dP_slct4_COMPU_VTAB_REF "Verbal Table" TAB_VERB 3 0 "Standard" 1 "Alternate 1" 2 "Alt 1 + Std" DEFAULT_VALUE "UNKNOWN" /end COMPU_VTAB
/begin CHARACTERISTIC CRI_EGR_dP_slct5 "EGR minimum delta-P command{CRI_EGR_dP_slct5&0xff=0:Standard}{CRI_EGR_dP_slct5&0xff=1:Alternate 1}{CRI_EGR_dP_slct5&0xff=2:Alt 1 + Std}" VALUE 0x00170E7D /* @ECU_Address@CRI_EGR_dP_slct5@0x0100A860@ */ ECIPP_ALIGNMENT_UBYTE 255 CRI_EGR_dP_slct5_COMPU_VTAB 0 255 BIT_MASK 0xff /end CHARACTERISTIC
/begin COMPU_METHOD CRI_EGR_dP_slct5_COMPU_VTAB "Verbal Table" TAB_VERB "%.0" "list" COMPU_TAB_REF CRI_EGR_dP_slct5_COMPU_VTAB_REF /end COMPU_METHOD
/begin COMPU_VTAB CRI_EGR_dP_slct5_COMPU_VTAB_REF "Verbal Table" TAB_VERB 3 0 "Standard" 1 "Alternate 1" 2 "Alt 1 + Std" DEFAULT_VALUE "UNKNOWN" /end COMPU_VTAB
/begin CHARACTERISTIC CRI_EGR_dP_slct6 "EGR minimum delta-P command{CRI_EGR_dP_slct6&0xff=0:Standard}{CRI_EGR_dP_slct6&0xff=1:Alternate 1}{CRI_EGR_dP_slct6&0xff=2:Alt 1 + Std}" VALUE 0x00170E7E /* @ECU_Address@CRI_EGR_dP_slct6@0x0100A868@ */ ECIPP_ALIGNMENT_UBYTE 255 CRI_EGR_dP_slct6_COMPU_VTAB 0 255 BIT_MASK 0xff /end CHARACTERISTIC
/begin COMPU_METHOD CRI_EGR_dP_slct6_COMPU_VTAB "Verbal Table" TAB_VERB "%.0" "list" COMPU_TAB_REF CRI_EGR_dP_slct6_COMPU_VTAB_REF /end COMPU_METHOD
/begin COMPU_VTAB CRI_EGR_dP_slct6_COMPU_VTAB_REF "Verbal Table" TAB_VERB 3 0 "Standard" 1 "Alternate 1" 2 "Alt 1 + Std" DEFAULT_VALUE "UNKNOWN" /end COMPU_VTAB
/begin CHARACTERISTIC CRI_EGR_dP_slct7 "EGR minimum delta-P command{CRI_EGR_dP_slct7&0xff=0:Standard}{CRI_EGR_dP_slct7&0xff=1:Alternate 1}{CRI_EGR_dP_slct7&0xff=2:Alt 1 + Std}" VALUE 0x00170E7F /* @ECU_Address@CRI_EGR_dP_slct7@0x0100A870@ */ ECIPP_ALIGNMENT_UBYTE 255 CRI_EGR_dP_slct7_COMPU_VTAB 0 255 BIT_MASK 0xff /end CHARACTERISTIC
/begin COMPU_METHOD CRI_EGR_dP_slct7_COMPU_VTAB "Verbal Table" TAB_VERB "%.0" "list" COMPU_TAB_REF CRI_EGR_dP_slct7_COMPU_VTAB_REF /end COMPU_METHOD
/begin COMPU_VTAB CRI_EGR_dP_slct7_COMPU_VTAB_REF "Verbal Table" TAB_VERB 3 0 "Standard" 1 "Alternate 1" 2 "Alt 1 + Std" DEFAULT_VALUE "UNKNOWN" /end COMPU_VTAB
/begin CHARACTERISTIC CRI_air_slct8 "Air mass command{CRI_air_slct8&0xff=0:Standard}{CRI_air_slct8&0xff=1:Alternate 1}{CRI_air_slct8&0xff=2:Alt 1 + Std}" VALUE 0x00170EFA /* @ECU_Address@CRI_air_slct8@0x0100A878@ */ ECIPP_ALIGNMENT_UBYTE 255 CRI_air_slct8_COMPU_VTAB 0 255 BIT_MASK 0xff /end CHARACTERISTIC
/begin COMPU_METHOD CRI_air_slct8_COMPU_VTAB "Verbal Table" TAB_VERB "%.0" "list" COMPU_TAB_REF CRI_air_slct8_COMPU_VTAB_REF /end COMPU_METHOD
/begin COMPU_VTAB CRI_air_slct8_COMPU_VTAB_REF "Verbal Table" TAB_VERB 3 0 "Standard" 1 "Alternate 1" 2 "Alt 1 + Std" DEFAULT_VALUE "UNKNOWN" /end COMPU_VTAB
/begin CHARACTERISTIC CRI_P_slct8 "Fuel pressure command{CRI_P_slct8&0xff=0:Standard}{CRI_P_slct8&0xff=1:Alternate 1}{CRI_P_slct8&0xff=2:Alt 1 + Std}" VALUE 0x00170E8A /* @ECU_Address@CRI_P_slct8@0x0100A880@ */ ECIPP_ALIGNMENT_UBYTE 255 CRI_P_slct8_COMPU_VTAB 0 255 BIT_MASK 0xff /end CHARACTERISTIC
/begin COMPU_METHOD CRI_P_slct8_COMPU_VTAB "Verbal Table" TAB_VERB "%.0" "list" COMPU_TAB_REF CRI_P_slct8_COMPU_VTAB_REF /end COMPU_METHOD
/begin COMPU_VTAB CRI_P_slct8_COMPU_VTAB_REF "Verbal Table" TAB_VERB 3 0 "Standard" 1 "Alternate 1" 2 "Alt 1 + Std" DEFAULT_VALUE "UNKNOWN" /end COMPU_VTAB
/begin CHARACTERISTIC CRI_dilpct_slct8 "EGR diluent command{CRI_dilpct_slct8&0xff=0:Standard}{CRI_dilpct_slct8&0xff=1:Alternate 1}{CRI_dilpct_slct8&0xff=2:Alt 1 + Std}" VALUE 0x00170F0E /* @ECU_Address@CRI_dilpct_slct8@0x0100A888@ */ ECIPP_ALIGNMENT_UBYTE 255 CRI_dilpct_slct8_COMPU_VTAB 0 255 BIT_MASK 0xff /end CHARACTERISTIC
/begin COMPU_METHOD CRI_dilpct_slct8_COMPU_VTAB "Verbal Table" TAB_VERB "%.0" "list" COMPU_TAB_REF CRI_dilpct_slct8_COMPU_VTAB_REF /end COMPU_METHOD
/begin COMPU_VTAB CRI_dilpct_slct8_COMPU_VTAB_REF "Verbal Table" TAB_VERB 3 0 "Standard" 1 "Alternate 1" 2 "Alt 1 + Std" DEFAULT_VALUE "UNKNOWN" /end COMPU_VTAB
/begin CHARACTERISTIC CRI_Qpilot2_slct8 "Pilot 2 injection quantity{CRI_Qpilot2_slct8&0xff=0:Standard}{CRI_Qpilot2_slct8&0xff=1:Alternate 1}{CRI_Qpilot2_slct8&0xff=2:Alt 1 + Std}" VALUE 0x00170EA8 /* @ECU_Address@CRI_Qpilot2_slct8@0x0100A890@ */ ECIPP_ALIGNMENT_UBYTE 255 CRI_Qpilot2_slct8_COMPU_VTAB 0 255 BIT_MASK 0xff /end CHARACTERISTIC
/begin COMPU_METHOD CRI_Qpilot2_slct8_COMPU_VTAB "Verbal Table" TAB_VERB "%.0" "list" COMPU_TAB_REF CRI_Qpilot2_slct8_COMPU_VTAB_REF /end COMPU_METHOD
/begin COMPU_VTAB CRI_Qpilot2_slct8_COMPU_VTAB_REF "Verbal Table" TAB_VERB 3 0 "Standard" 1 "Alternate 1" 2 "Alt 1 + Std" DEFAULT_VALUE "UNKNOWN" /end COMPU_VTAB
/begin CHARACTERISTIC CRI_Qpilot1_slct8 "Pilot 1 injection quantity{CRI_Qpilot1_slct8&0xff=0:Standard}{CRI_Qpilot1_slct8&0xff=1:Alternate 1}{CRI_Qpilot1_slct8&0xff=2:Alt 1 + Std}" VALUE 0x00170E9E /* @ECU_Address@CRI_Qpilot1_slct8@0x0100A898@ */ ECIPP_ALIGNMENT_UBYTE 255 CRI_Qpilot1_slct8_COMPU_VTAB 0 255 BIT_MASK 0xff /end CHARACTERISTIC
/begin COMPU_METHOD CRI_Qpilot1_slct8_COMPU_VTAB "Verbal Table" TAB_VERB "%.0" "list" COMPU_TAB_REF CRI_Qpilot1_slct8_COMPU_VTAB_REF /end COMPU_METHOD
/begin COMPU_VTAB CRI_Qpilot1_slct8_COMPU_VTAB_REF "Verbal Table" TAB_VERB 3 0 "Standard" 1 "Alternate 1" 2 "Alt 1 + Std" DEFAULT_VALUE "UNKNOWN" /end COMPU_VTAB
/begin CHARACTERISTIC CRI_Qload_slct8 "Fuel load command{CRI_Qload_slct8&0xff=0:Standard}{CRI_Qload_slct8&0xff=1:Alternate 1}{CRI_Qload_slct8&0xff=2:Alt 1 + Std}{CRI_Qload_slct8&0xff=3:Alternate 2}{CRI_Qload_slct8&0xff=4:Alt 2 + Std}" VALUE 0x00170E94 /* @ECU_Address@CRI_Qload_slct8@0x0100A8A0@ */ ECIPP_ALIGNMENT_UBYTE 255 CRI_Qload_slct8_COMPU_VTAB 0 255 BIT_MASK 0xff /end CHARACTERISTIC
/begin COMPU_METHOD CRI_Qload_slct8_COMPU_VTAB "Verbal Table" TAB_VERB "%.0" "list" COMPU_TAB_REF CRI_Qload_slct8_COMPU_VTAB_REF /end COMPU_METHOD
/begin COMPU_VTAB CRI_Qload_slct8_COMPU_VTAB_REF "Verbal Table" TAB_VERB 5 0 "Standard" 1 "Alternate 1" 2 "Alt 1 + Std" 3 "Alternate 2" 4 "Alt 2 + Std" DEFAULT_VALUE "UNKNOWN" /end COMPU_VTAB
/begin CHARACTERISTIC CRI_Qpost1_slct8 "Post 1 injection quantity{CRI_Qpost1_slct8&0xff=0:Standard}{CRI_Qpost1_slct8&0xff=1:Alternate 1}{CRI_Qpost1_slct8&0xff=2:Alt 1 + Std}" VALUE 0x00170EB2 /* @ECU_Address@CRI_Qpost1_slct8@0x0100A8A8@ */ ECIPP_ALIGNMENT_UBYTE 255 CRI_Qpost1_slct8_COMPU_VTAB 0 255 BIT_MASK 0xff /end CHARACTERISTIC
/begin COMPU_METHOD CRI_Qpost1_slct8_COMPU_VTAB "Verbal Table" TAB_VERB "%.0" "list" COMPU_TAB_REF CRI_Qpost1_slct8_COMPU_VTAB_REF /end COMPU_METHOD
/begin COMPU_VTAB CRI_Qpost1_slct8_COMPU_VTAB_REF "Verbal Table" TAB_VERB 3 0 "Standard" 1 "Alternate 1" 2 "Alt 1 + Std" DEFAULT_VALUE "UNKNOWN" /end COMPU_VTAB
/begin CHARACTERISTIC CRI_Qpost2_slct8 "Post 2 injection quantity{CRI_Qpost2_slct8&0xff=0:Standard}{CRI_Qpost2_slct8&0xff=1:Alternate 1}{CRI_Qpost2_slct8&0xff=2:Alt 1 + Std}" VALUE 0x00170EBC /* @ECU_Address@CRI_Qpost2_slct8@0x0100A8B0@ */ ECIPP_ALIGNMENT_UBYTE 255 CRI_Qpost2_slct8_COMPU_VTAB 0 255 BIT_MASK 0xff /end CHARACTERISTIC
/begin COMPU_METHOD CRI_Qpost2_slct8_COMPU_VTAB "Verbal Table" TAB_VERB "%.0" "list" COMPU_TAB_REF CRI_Qpost2_slct8_COMPU_VTAB_REF /end COMPU_METHOD
/begin COMPU_VTAB CRI_Qpost2_slct8_COMPU_VTAB_REF "Verbal Table" TAB_VERB 3 0 "Standard" 1 "Alternate 1" 2 "Alt 1 + Std" DEFAULT_VALUE "UNKNOWN" /end COMPU_VTAB
/begin CHARACTERISTIC CRI_Tpilot2_slct8 "Pilot 2 injection timing{CRI_Tpilot2_slct8&0xff=0:Standard}{CRI_Tpilot2_slct8&0xff=1:Alternate 1}{CRI_Tpilot2_slct8&0xff=2:Alt 1 + Std}" VALUE 0x00170EDB /* @ECU_Address@CRI_Tpilot2_slct8@0x0100A8B8@ */ ECIPP_ALIGNMENT_UBYTE 255 CRI_Tpilot2_slct8_COMPU_VTAB 0 255 BIT_MASK 0xff /end CHARACTERISTIC
/begin COMPU_METHOD CRI_Tpilot2_slct8_COMPU_VTAB "Verbal Table" TAB_VERB "%.0" "list" COMPU_TAB_REF CRI_Tpilot2_slct8_COMPU_VTAB_REF /end COMPU_METHOD
/begin COMPU_VTAB CRI_Tpilot2_slct8_COMPU_VTAB_REF "Verbal Table" TAB_VERB 3 0 "Standard" 1 "Alternate 1" 2 "Alt 1 + Std" DEFAULT_VALUE "UNKNOWN" /end COMPU_VTAB
/begin CHARACTERISTIC CRI_Tpilot1_slct8 "Pilot 1 injection timing{CRI_Tpilot1_slct8&0xff=0:Standard}{CRI_Tpilot1_slct8&0xff=1:Alternate 1}{CRI_Tpilot1_slct8&0xff=2:Alt 1 + Std}" VALUE 0x00170ED0 /* @ECU_Address@CRI_Tpilot1_slct8@0x0100A8C0@ */ ECIPP_ALIGNMENT_UBYTE 255 CRI_Tpilot1_slct8_COMPU_VTAB 0 255 BIT_MASK 0xff /end CHARACTERISTIC
/begin COMPU_METHOD CRI_Tpilot1_slct8_COMPU_VTAB "Verbal Table" TAB_VERB "%.0" "list" COMPU_TAB_REF CRI_Tpilot1_slct8_COMPU_VTAB_REF /end COMPU_METHOD
/begin COMPU_VTAB CRI_Tpilot1_slct8_COMPU_VTAB_REF "Verbal Table" TAB_VERB 3 0 "Standard" 1 "Alternate 1" 2 "Alt 1 + Std" DEFAULT_VALUE "UNKNOWN" /end COMPU_VTAB
/begin CHARACTERISTIC CRI_Tmain_slct8 "Main injection timing{CRI_Tmain_slct8&0xff=0:Standard}{CRI_Tmain_slct8&0xff=1:Alternate 1}{CRI_Tmain_slct8&0xff=2:Alt 1 + Std}{CRI_Tmain_slct8&0xff=3:Alternate 2}{CRI_Tmain_slct8&0xff=4:Alt 2 + Std}" VALUE 0x00170EC6 /* @ECU_Address@CRI_Tmain_slct8@0x0100A8C8@ */ ECIPP_ALIGNMENT_UBYTE 255 CRI_Tmain_slct8_COMPU_VTAB 0 255 BIT_MASK 0xff /end CHARACTERISTIC
/begin COMPU_METHOD CRI_Tmain_slct8_COMPU_VTAB "Verbal Table" TAB_VERB "%.0" "list" COMPU_TAB_REF CRI_Tmain_slct8_COMPU_VTAB_REF /end COMPU_METHOD
/begin COMPU_VTAB CRI_Tmain_slct8_COMPU_VTAB_REF "Verbal Table" TAB_VERB 5 0 "Standard" 1 "Alternate 1" 2 "Alt 1 + Std" 3 "Alternate 2" 4 "Alt 2 + Std" DEFAULT_VALUE "UNKNOWN" /end COMPU_VTAB
/begin CHARACTERISTIC CRI_Tpost1_slct8 "Post 1 injection timing{CRI_Tpost1_slct8&0xff=0:Standard}{CRI_Tpost1_slct8&0xff=1:Alternate 1}{CRI_Tpost1_slct8&0xff=2:Alt 1 + Std}" VALUE 0x00170EE6 /* @ECU_Address@CRI_Tpost1_slct8@0x0100A8D0@ */ ECIPP_ALIGNMENT_UBYTE 255 CRI_Tpost1_slct8_COMPU_VTAB 0 255 BIT_MASK 0xff /end CHARACTERISTIC
/begin COMPU_METHOD CRI_Tpost1_slct8_COMPU_VTAB "Verbal Table" TAB_VERB "%.0" "list" COMPU_TAB_REF CRI_Tpost1_slct8_COMPU_VTAB_REF /end COMPU_METHOD
/begin COMPU_VTAB CRI_Tpost1_slct8_COMPU_VTAB_REF "Verbal Table" TAB_VERB 3 0 "Standard" 1 "Alternate 1" 2 "Alt 1 + Std" DEFAULT_VALUE "UNKNOWN" /end COMPU_VTAB
/begin CHARACTERISTIC CRI_Tpost2_slct8 "Post 2 injection timing{CRI_Tpost2_slct8&0xff=0:Standard}{CRI_Tpost2_slct8&0xff=1:Alternate 1}{CRI_Tpost2_slct8&0xff=2:Alt 1 + Std}" VALUE 0x00170EF0 /* @ECU_Address@CRI_Tpost2_slct8@0x0100A8D8@ */ ECIPP_ALIGNMENT_UBYTE 255 CRI_Tpost2_slct8_COMPU_VTAB 0 255 BIT_MASK 0xff /end CHARACTERISTIC
/begin COMPU_METHOD CRI_Tpost2_slct8_COMPU_VTAB "Verbal Table" TAB_VERB "%.0" "list" COMPU_TAB_REF CRI_Tpost2_slct8_COMPU_VTAB_REF /end COMPU_METHOD
/begin COMPU_VTAB CRI_Tpost2_slct8_COMPU_VTAB_REF "Verbal Table" TAB_VERB 3 0 "Standard" 1 "Alternate 1" 2 "Alt 1 + Std" DEFAULT_VALUE "UNKNOWN" /end COMPU_VTAB
/begin CHARACTERISTIC CRI_pulseoff_slct8 "Forced injection disabling table{CRI_pulseoff_slct8&0xff=0:None}{CRI_pulseoff_slct8&0xff=1:Standard}{CRI_pulseoff_slct8&0xff=2:Alternate 1}{CRI_pulseoff_slct8&0xff=3:Alt 1 or Std}" VALUE 0x00170F86 /* @ECU_Address@CRI_pulseoff_slct8@0x0100A8E0@ */ ECIPP_ALIGNMENT_UBYTE 255 CRI_pulseoff_slct8_COMPU_VTAB 0 255 BIT_MASK 0xff /end CHARACTERISTIC
/begin COMPU_METHOD CRI_pulseoff_slct8_COMPU_VTAB "Verbal Table" TAB_VERB "%.0" "list" COMPU_TAB_REF CRI_pulseoff_slct8_COMPU_VTAB_REF /end COMPU_METHOD
/begin COMPU_VTAB CRI_pulseoff_slct8_COMPU_VTAB_REF "Verbal Table" TAB_VERB 4 0 "None" 1 "Standard" 2 "Alternate 1" 3 "Alt 1 or Std" DEFAULT_VALUE "UNKNOWN" /end COMPU_VTAB
/begin CHARACTERISTIC CRI_bst_dP_slct8 "Boost EMP throttle delta-P command{CRI_bst_dP_slct8&0xff=0:Scalar (below)}{CRI_bst_dP_slct8&0xff=1:Boost 2D Cmd}" VALUE 0x00170F04 /* @ECU_Address@CRI_bst_dP_slct8@0x0100A8E8@ */ ECIPP_ALIGNMENT_UBYTE 255 CRI_bst_dP_slct8_COMPU_VTAB 0 255 BIT_MASK 0xff /end CHARACTERISTIC
/begin COMPU_METHOD CRI_bst_dP_slct8_COMPU_VTAB "Verbal Table" TAB_VERB "%.0" "list" COMPU_TAB_REF CRI_bst_dP_slct8_COMPU_VTAB_REF /end COMPU_METHOD
/begin COMPU_VTAB CRI_bst_dP_slct8_COMPU_VTAB_REF "Verbal Table" TAB_VERB 2 0 "Scalar (below)" 1 "Boost 2D Cmd" DEFAULT_VALUE "UNKNOWN" /end COMPU_VTAB
/begin CHARACTERISTIC CRI_EGR_dP_slct8 "EGR minimum delta-P command{CRI_EGR_dP_slct8&0xff=0:Standard}{CRI_EGR_dP_slct8&0xff=1:Alternate 1}{CRI_EGR_dP_slct8&0xff=2:Alt 1 + Std}" VALUE 0x00170E80 /* @ECU_Address@CRI_EGR_dP_slct8@0x0100A8F0@ */ ECIPP_ALIGNMENT_UBYTE 255 CRI_EGR_dP_slct8_COMPU_VTAB 0 255 BIT_MASK 0xff /end CHARACTERISTIC
/begin COMPU_METHOD CRI_EGR_dP_slct8_COMPU_VTAB "Verbal Table" TAB_VERB "%.0" "list" COMPU_TAB_REF CRI_EGR_dP_slct8_COMPU_VTAB_REF /end COMPU_METHOD
/begin COMPU_VTAB CRI_EGR_dP_slct8_COMPU_VTAB_REF "Verbal Table" TAB_VERB 3 0 "Standard" 1 "Alternate 1" 2 "Alt 1 + Std" DEFAULT_VALUE "UNKNOWN" /end COMPU_VTAB
/begin CHARACTERISTIC CRI_air_slct9 "Air mass command{CRI_air_slct9&0xff=0:Standard}{CRI_air_slct9&0xff=1:Alternate 1}{CRI_air_slct9&0xff=2:Alt 1 + Std}" VALUE 0x00170EFB /* @ECU_Address@CRI_air_slct9@0x0100A8F8@ */ ECIPP_ALIGNMENT_UBYTE 255 CRI_air_slct9_COMPU_VTAB 0 255 BIT_MASK 0xff /end CHARACTERISTIC
/begin COMPU_METHOD CRI_air_slct9_COMPU_VTAB "Verbal Table" TAB_VERB "%.0" "list" COMPU_TAB_REF CRI_air_slct9_COMPU_VTAB_REF /end COMPU_METHOD
/begin COMPU_VTAB CRI_air_slct9_COMPU_VTAB_REF "Verbal Table" TAB_VERB 3 0 "Standard" 1 "Alternate 1" 2 "Alt 1 + Std" DEFAULT_VALUE "UNKNOWN" /end COMPU_VTAB
/begin CHARACTERISTIC CRI_P_slct9 "Fuel pressure command{CRI_P_slct9&0xff=0:Standard}{CRI_P_slct9&0xff=1:Alternate 1}{CRI_P_slct9&0xff=2:Alt 1 + Std}" VALUE 0x00170E8B /* @ECU_Address@CRI_P_slct9@0x0100A900@ */ ECIPP_ALIGNMENT_UBYTE 255 CRI_P_slct9_COMPU_VTAB 0 255 BIT_MASK 0xff /end CHARACTERISTIC
/begin COMPU_METHOD CRI_P_slct9_COMPU_VTAB "Verbal Table" TAB_VERB "%.0" "list" COMPU_TAB_REF CRI_P_slct9_COMPU_VTAB_REF /end COMPU_METHOD
/begin COMPU_VTAB CRI_P_slct9_COMPU_VTAB_REF "Verbal Table" TAB_VERB 3 0 "Standard" 1 "Alternate 1" 2 "Alt 1 + Std" DEFAULT_VALUE "UNKNOWN" /end COMPU_VTAB
/begin CHARACTERISTIC CRI_dilpct_slct9 "EGR diluent command{CRI_dilpct_slct9&0xff=0:Standard}{CRI_dilpct_slct9&0xff=1:Alternate 1}{CRI_dilpct_slct9&0xff=2:Alt 1 + Std}" VALUE 0x00170F0F /* @ECU_Address@CRI_dilpct_slct9@0x0100A908@ */ ECIPP_ALIGNMENT_UBYTE 255 CRI_dilpct_slct9_COMPU_VTAB 0 255 BIT_MASK 0xff /end CHARACTERISTIC
/begin COMPU_METHOD CRI_dilpct_slct9_COMPU_VTAB "Verbal Table" TAB_VERB "%.0" "list" COMPU_TAB_REF CRI_dilpct_slct9_COMPU_VTAB_REF /end COMPU_METHOD
/begin COMPU_VTAB CRI_dilpct_slct9_COMPU_VTAB_REF "Verbal Table" TAB_VERB 3 0 "Standard" 1 "Alternate 1" 2 "Alt 1 + Std" DEFAULT_VALUE "UNKNOWN" /end COMPU_VTAB
/begin CHARACTERISTIC CRI_Qpilot2_slct9 "Pilot 2 injection quantity{CRI_Qpilot2_slct9&0xff=0:Standard}{CRI_Qpilot2_slct9&0xff=1:Alternate 1}{CRI_Qpilot2_slct9&0xff=2:Alt 1 + Std}" VALUE 0x00170EA9 /* @ECU_Address@CRI_Qpilot2_slct9@0x0100A910@ */ ECIPP_ALIGNMENT_UBYTE 255 CRI_Qpilot2_slct9_COMPU_VTAB 0 255 BIT_MASK 0xff /end CHARACTERISTIC
/begin COMPU_METHOD CRI_Qpilot2_slct9_COMPU_VTAB "Verbal Table" TAB_VERB "%.0" "list" COMPU_TAB_REF CRI_Qpilot2_slct9_COMPU_VTAB_REF /end COMPU_METHOD
/begin COMPU_VTAB CRI_Qpilot2_slct9_COMPU_VTAB_REF "Verbal Table" TAB_VERB 3 0 "Standard" 1 "Alternate 1" 2 "Alt 1 + Std" DEFAULT_VALUE "UNKNOWN" /end COMPU_VTAB
/begin CHARACTERISTIC CRI_Qpilot1_slct9 "Pilot 1 injection quantity{CRI_Qpilot1_slct9&0xff=0:Standard}{CRI_Qpilot1_slct9&0xff=1:Alternate 1}{CRI_Qpilot1_slct9&0xff=2:Alt 1 + Std}" VALUE 0x00170E9F /* @ECU_Address@CRI_Qpilot1_slct9@0x0100A918@ */ ECIPP_ALIGNMENT_UBYTE 255 CRI_Qpilot1_slct9_COMPU_VTAB 0 255 BIT_MASK 0xff /end CHARACTERISTIC
/begin COMPU_METHOD CRI_Qpilot1_slct9_COMPU_VTAB "Verbal Table" TAB_VERB "%.0" "list" COMPU_TAB_REF CRI_Qpilot1_slct9_COMPU_VTAB_REF /end COMPU_METHOD
/begin COMPU_VTAB CRI_Qpilot1_slct9_COMPU_VTAB_REF "Verbal Table" TAB_VERB 3 0 "Standard" 1 "Alternate 1" 2 "Alt 1 + Std" DEFAULT_VALUE "UNKNOWN" /end COMPU_VTAB
/begin CHARACTERISTIC CRI_Qload_slct9 "Fuel load command{CRI_Qload_slct9&0xff=0:Standard}{CRI_Qload_slct9&0xff=1:Alternate 1}{CRI_Qload_slct9&0xff=2:Alt 1 + Std}{CRI_Qload_slct9&0xff=3:Alternate 2}{CRI_Qload_slct9&0xff=4:Alt 2 + Std}" VALUE 0x00170E95 /* @ECU_Address@CRI_Qload_slct9@0x0100A920@ */ ECIPP_ALIGNMENT_UBYTE 255 CRI_Qload_slct9_COMPU_VTAB 0 255 BIT_MASK 0xff /end CHARACTERISTIC
/begin COMPU_METHOD CRI_Qload_slct9_COMPU_VTAB "Verbal Table" TAB_VERB "%.0" "list" COMPU_TAB_REF CRI_Qload_slct9_COMPU_VTAB_REF /end COMPU_METHOD
/begin COMPU_VTAB CRI_Qload_slct9_COMPU_VTAB_REF "Verbal Table" TAB_VERB 5 0 "Standard" 1 "Alternate 1" 2 "Alt 1 + Std" 3 "Alternate 2" 4 "Alt 2 + Std" DEFAULT_VALUE "UNKNOWN" /end COMPU_VTAB
/begin CHARACTERISTIC CRI_Qpost1_slct9 "Post 1 injection quantity{CRI_Qpost1_slct9&0xff=0:Standard}{CRI_Qpost1_slct9&0xff=1:Alternate 1}{CRI_Qpost1_slct9&0xff=2:Alt 1 + Std}" VALUE 0x00170EB3 /* @ECU_Address@CRI_Qpost1_slct9@0x0100A928@ */ ECIPP_ALIGNMENT_UBYTE 255 CRI_Qpost1_slct9_COMPU_VTAB 0 255 BIT_MASK 0xff /end CHARACTERISTIC
/begin COMPU_METHOD CRI_Qpost1_slct9_COMPU_VTAB "Verbal Table" TAB_VERB "%.0" "list" COMPU_TAB_REF CRI_Qpost1_slct9_COMPU_VTAB_REF /end COMPU_METHOD
/begin COMPU_VTAB CRI_Qpost1_slct9_COMPU_VTAB_REF "Verbal Table" TAB_VERB 3 0 "Standard" 1 "Alternate 1" 2 "Alt 1 + Std" DEFAULT_VALUE "UNKNOWN" /end COMPU_VTAB
/begin CHARACTERISTIC CRI_Qpost2_slct9 "Post 2 injection quantity{CRI_Qpost2_slct9&0xff=0:Standard}{CRI_Qpost2_slct9&0xff=1:Alternate 1}{CRI_Qpost2_slct9&0xff=2:Alt 1 + Std}" VALUE 0x00170EBD /* @ECU_Address@CRI_Qpost2_slct9@0x0100A930@ */ ECIPP_ALIGNMENT_UBYTE 255 CRI_Qpost2_slct9_COMPU_VTAB 0 255 BIT_MASK 0xff /end CHARACTERISTIC
/begin COMPU_METHOD CRI_Qpost2_slct9_COMPU_VTAB "Verbal Table" TAB_VERB "%.0" "list" COMPU_TAB_REF CRI_Qpost2_slct9_COMPU_VTAB_REF /end COMPU_METHOD
/begin COMPU_VTAB CRI_Qpost2_slct9_COMPU_VTAB_REF "Verbal Table" TAB_VERB 3 0 "Standard" 1 "Alternate 1" 2 "Alt 1 + Std" DEFAULT_VALUE "UNKNOWN" /end COMPU_VTAB
/begin CHARACTERISTIC CRI_Tpilot2_slct9 "Pilot 2 injection timing{CRI_Tpilot2_slct9&0xff=0:Standard}{CRI_Tpilot2_slct9&0xff=1:Alternate 1}{CRI_Tpilot2_slct9&0xff=2:Alt 1 + Std}" VALUE 0x00170EDC /* @ECU_Address@CRI_Tpilot2_slct9@0x0100A938@ */ ECIPP_ALIGNMENT_UBYTE 255 CRI_Tpilot2_slct9_COMPU_VTAB 0 255 BIT_MASK 0xff /end CHARACTERISTIC
/begin COMPU_METHOD CRI_Tpilot2_slct9_COMPU_VTAB "Verbal Table" TAB_VERB "%.0" "list" COMPU_TAB_REF CRI_Tpilot2_slct9_COMPU_VTAB_REF /end COMPU_METHOD
/begin COMPU_VTAB CRI_Tpilot2_slct9_COMPU_VTAB_REF "Verbal Table" TAB_VERB 3 0 "Standard" 1 "Alternate 1" 2 "Alt 1 + Std" DEFAULT_VALUE "UNKNOWN" /end COMPU_VTAB
/begin CHARACTERISTIC CRI_Tpilot1_slct9 "Pilot 1 injection timing{CRI_Tpilot1_slct9&0xff=0:Standard}{CRI_Tpilot1_slct9&0xff=1:Alternate 1}{CRI_Tpilot1_slct9&0xff=2:Alt 1 + Std}" VALUE 0x00170ED1 /* @ECU_Address@CRI_Tpilot1_slct9@0x0100A940@ */ ECIPP_ALIGNMENT_UBYTE 255 CRI_Tpilot1_slct9_COMPU_VTAB 0 255 BIT_MASK 0xff /end CHARACTERISTIC
/begin COMPU_METHOD CRI_Tpilot1_slct9_COMPU_VTAB "Verbal Table" TAB_VERB "%.0" "list" COMPU_TAB_REF CRI_Tpilot1_slct9_COMPU_VTAB_REF /end COMPU_METHOD
/begin COMPU_VTAB CRI_Tpilot1_slct9_COMPU_VTAB_REF "Verbal Table" TAB_VERB 3 0 "Standard" 1 "Alternate 1" 2 "Alt 1 + Std" DEFAULT_VALUE "UNKNOWN" /end COMPU_VTAB
/begin CHARACTERISTIC CRI_Tmain_slct9 "Main injection timing{CRI_Tmain_slct9&0xff=0:Standard}{CRI_Tmain_slct9&0xff=1:Alternate 1}{CRI_Tmain_slct9&0xff=2:Alt 1 + Std}{CRI_Tmain_slct9&0xff=3:Alternate 2}{CRI_Tmain_slct9&0xff=4:Alt 2 + Std}" VALUE 0x00170EC7 /* @ECU_Address@CRI_Tmain_slct9@0x0100A948@ */ ECIPP_ALIGNMENT_UBYTE 255 CRI_Tmain_slct9_COMPU_VTAB 0 255 BIT_MASK 0xff /end CHARACTERISTIC
/begin COMPU_METHOD CRI_Tmain_slct9_COMPU_VTAB "Verbal Table" TAB_VERB "%.0" "list" COMPU_TAB_REF CRI_Tmain_slct9_COMPU_VTAB_REF /end COMPU_METHOD
/begin COMPU_VTAB CRI_Tmain_slct9_COMPU_VTAB_REF "Verbal Table" TAB_VERB 5 0 "Standard" 1 "Alternate 1" 2 "Alt 1 + Std" 3 "Alternate 2" 4 "Alt 2 + Std" DEFAULT_VALUE "UNKNOWN" /end COMPU_VTAB
/begin CHARACTERISTIC CRI_Tpost1_slct9 "Post 1 injection timing{CRI_Tpost1_slct9&0xff=0:Standard}{CRI_Tpost1_slct9&0xff=1:Alternate 1}{CRI_Tpost1_slct9&0xff=2:Alt 1 + Std}" VALUE 0x00170EE7 /* @ECU_Address@CRI_Tpost1_slct9@0x0100A950@ */ ECIPP_ALIGNMENT_UBYTE 255 CRI_Tpost1_slct9_COMPU_VTAB 0 255 BIT_MASK 0xff /end CHARACTERISTIC
/begin COMPU_METHOD CRI_Tpost1_slct9_COMPU_VTAB "Verbal Table" TAB_VERB "%.0" "list" COMPU_TAB_REF CRI_Tpost1_slct9_COMPU_VTAB_REF /end COMPU_METHOD
/begin COMPU_VTAB CRI_Tpost1_slct9_COMPU_VTAB_REF "Verbal Table" TAB_VERB 3 0 "Standard" 1 "Alternate 1" 2 "Alt 1 + Std" DEFAULT_VALUE "UNKNOWN" /end COMPU_VTAB
/begin CHARACTERISTIC CRI_Tpost2_slct9 "Post 2 injection timing{CRI_Tpost2_slct9&0xff=0:Standard}{CRI_Tpost2_slct9&0xff=1:Alternate 1}{CRI_Tpost2_slct9&0xff=2:Alt 1 + Std}" VALUE 0x00170EF1 /* @ECU_Address@CRI_Tpost2_slct9@0x0100A958@ */ ECIPP_ALIGNMENT_UBYTE 255 CRI_Tpost2_slct9_COMPU_VTAB 0 255 BIT_MASK 0xff /end CHARACTERISTIC
/begin COMPU_METHOD CRI_Tpost2_slct9_COMPU_VTAB "Verbal Table" TAB_VERB "%.0" "list" COMPU_TAB_REF CRI_Tpost2_slct9_COMPU_VTAB_REF /end COMPU_METHOD
/begin COMPU_VTAB CRI_Tpost2_slct9_COMPU_VTAB_REF "Verbal Table" TAB_VERB 3 0 "Standard" 1 "Alternate 1" 2 "Alt 1 + Std" DEFAULT_VALUE "UNKNOWN" /end COMPU_VTAB
/begin CHARACTERISTIC CRI_pulseoff_slct9 "Forced injection disabling table{CRI_pulseoff_slct9&0xff=0:None}{CRI_pulseoff_slct9&0xff=1:Standard}{CRI_pulseoff_slct9&0xff=2:Alternate 1}{CRI_pulseoff_slct9&0xff=3:Alt 1 or Std}" VALUE 0x00170F87 /* @ECU_Address@CRI_pulseoff_slct9@0x0100A960@ */ ECIPP_ALIGNMENT_UBYTE 255 CRI_pulseoff_slct9_COMPU_VTAB 0 255 BIT_MASK 0xff /end CHARACTERISTIC
/begin COMPU_METHOD CRI_pulseoff_slct9_COMPU_VTAB "Verbal Table" TAB_VERB "%.0" "list" COMPU_TAB_REF CRI_pulseoff_slct9_COMPU_VTAB_REF /end COMPU_METHOD
/begin COMPU_VTAB CRI_pulseoff_slct9_COMPU_VTAB_REF "Verbal Table" TAB_VERB 4 0 "None" 1 "Standard" 2 "Alternate 1" 3 "Alt 1 or Std" DEFAULT_VALUE "UNKNOWN" /end COMPU_VTAB
/begin CHARACTERISTIC CRI_bst_dP_slct9 "Boost EMP throttle delta-P command{CRI_bst_dP_slct9&0xff=0:Scalar (below)}{CRI_bst_dP_slct9&0xff=1:Boost 2D Cmd}" VALUE 0x00170F05 /* @ECU_Address@CRI_bst_dP_slct9@0x0100A968@ */ ECIPP_ALIGNMENT_UBYTE 255 CRI_bst_dP_slct9_COMPU_VTAB 0 255 BIT_MASK 0xff /end CHARACTERISTIC
/begin COMPU_METHOD CRI_bst_dP_slct9_COMPU_VTAB "Verbal Table" TAB_VERB "%.0" "list" COMPU_TAB_REF CRI_bst_dP_slct9_COMPU_VTAB_REF /end COMPU_METHOD
/begin COMPU_VTAB CRI_bst_dP_slct9_COMPU_VTAB_REF "Verbal Table" TAB_VERB 2 0 "Scalar (below)" 1 "Boost 2D Cmd" DEFAULT_VALUE "UNKNOWN" /end COMPU_VTAB
/begin CHARACTERISTIC CRI_EGR_dP_slct9 "EGR minimum delta-P command{CRI_EGR_dP_slct9&0xff=0:Standard}{CRI_EGR_dP_slct9&0xff=1:Alternate 1}{CRI_EGR_dP_slct9&0xff=2:Alt 1 + Std}" VALUE 0x00170E81 /* @ECU_Address@CRI_EGR_dP_slct9@0x0100A970@ */ ECIPP_ALIGNMENT_UBYTE 255 CRI_EGR_dP_slct9_COMPU_VTAB 0 255 BIT_MASK 0xff /end CHARACTERISTIC
/begin COMPU_METHOD CRI_EGR_dP_slct9_COMPU_VTAB "Verbal Table" TAB_VERB "%.0" "list" COMPU_TAB_REF CRI_EGR_dP_slct9_COMPU_VTAB_REF /end COMPU_METHOD
/begin COMPU_VTAB CRI_EGR_dP_slct9_COMPU_VTAB_REF "Verbal Table" TAB_VERB 3 0 "Standard" 1 "Alternate 1" 2 "Alt 1 + Std" DEFAULT_VALUE "UNKNOWN" /end COMPU_VTAB
/begin CHARACTERISTIC CRI_bst_dP_scalar1 "Boost EMP throttle delta-P scalar" VALUE 0x00170DC6 /* @ECU_Address@CRI_bst_dP_scalar1@0x0100A978@ */ ECIPP_ALIGNMENT_UWORD 256 Compu_CRI_bst_dP_scalar1 0 255.99609375 /end CHARACTERISTIC
/begin COMPU_METHOD Compu_CRI_bst_dP_scalar1 " " RAT_FUNC "%.2" "psi" COEFFS 0 256 0 0 0 1 /end COMPU_METHOD
/begin CHARACTERISTIC CRI_bst_dP_scalar2 "Boost EMP throttle delta-P scalar" VALUE 0x00170DC8 /* @ECU_Address@CRI_bst_dP_scalar2@0x0100A980@ */ ECIPP_ALIGNMENT_UWORD 256 Compu_CRI_bst_dP_scalar2 0 255.99609375 /end CHARACTERISTIC
/begin COMPU_METHOD Compu_CRI_bst_dP_scalar2 " " RAT_FUNC "%.2" "psi" COEFFS 0 256 0 0 0 1 /end COMPU_METHOD
/begin CHARACTERISTIC CRI_bst_dP_scalar3 "Boost EMP throttle delta-P scalar" VALUE 0x00170DCA /* @ECU_Address@CRI_bst_dP_scalar3@0x0100A988@ */ ECIPP_ALIGNMENT_UWORD 256 Compu_CRI_bst_dP_scalar3 0 255.99609375 /end CHARACTERISTIC
/begin COMPU_METHOD Compu_CRI_bst_dP_scalar3 " " RAT_FUNC "%.2" "psi" COEFFS 0 256 0 0 0 1 /end COMPU_METHOD
/begin CHARACTERISTIC CRI_bst_dP_scalar4 "Boost EMP throttle delta-P scalar" VALUE 0x00170DCC /* @ECU_Address@CRI_bst_dP_scalar4@0x0100A990@ */ ECIPP_ALIGNMENT_UWORD 256 Compu_CRI_bst_dP_scalar4 0 255.99609375 /end CHARACTERISTIC
/begin COMPU_METHOD Compu_CRI_bst_dP_scalar4 " " RAT_FUNC "%.2" "psi" COEFFS 0 256 0 0 0 1 /end COMPU_METHOD
/begin CHARACTERISTIC CRI_bst_dP_scalar5 "Boost EMP throttle delta-P scalar" VALUE 0x00170DCE /* @ECU_Address@CRI_bst_dP_scalar5@0x0100A998@ */ ECIPP_ALIGNMENT_UWORD 256 Compu_CRI_bst_dP_scalar5 0 255.99609375 /end CHARACTERISTIC
/begin COMPU_METHOD Compu_CRI_bst_dP_scalar5 " " RAT_FUNC "%.2" "psi" COEFFS 0 256 0 0 0 1 /end COMPU_METHOD
/begin CHARACTERISTIC CRI_bst_dP_scalar6 "Boost EMP throttle delta-P scalar" VALUE 0x00170DD0 /* @ECU_Address@CRI_bst_dP_scalar6@0x0100A9A0@ */ ECIPP_ALIGNMENT_UWORD 256 Compu_CRI_bst_dP_scalar6 0 255.99609375 /end CHARACTERISTIC
/begin COMPU_METHOD Compu_CRI_bst_dP_scalar6 " " RAT_FUNC "%.2" "psi" COEFFS 0 256 0 0 0 1 /end COMPU_METHOD
/begin CHARACTERISTIC CRI_bst_dP_scalar7 "Boost EMP throttle delta-P scalar" VALUE 0x00170DD2 /* @ECU_Address@CRI_bst_dP_scalar7@0x0100A9A8@ */ ECIPP_ALIGNMENT_UWORD 256 Compu_CRI_bst_dP_scalar7 0 255.99609375 /end CHARACTERISTIC
/begin COMPU_METHOD Compu_CRI_bst_dP_scalar7 " " RAT_FUNC "%.2" "psi" COEFFS 0 256 0 0 0 1 /end COMPU_METHOD
/begin CHARACTERISTIC CRI_bst_dP_scalar8 "Boost EMP throttle delta-P scalar" VALUE 0x00170DD4 /* @ECU_Address@CRI_bst_dP_scalar8@0x0100A9B0@ */ ECIPP_ALIGNMENT_UWORD 256 Compu_CRI_bst_dP_scalar8 0 255.99609375 /end CHARACTERISTIC
/begin COMPU_METHOD Compu_CRI_bst_dP_scalar8 " " RAT_FUNC "%.2" "psi" COEFFS 0 256 0 0 0 1 /end COMPU_METHOD
/begin CHARACTERISTIC CRI_bst_dP_scalar9 "Boost EMP throttle delta-P scalar" VALUE 0x00170DD6 /* @ECU_Address@CRI_bst_dP_scalar9@0x0100A9B8@ */ ECIPP_ALIGNMENT_UWORD 256 Compu_CRI_bst_dP_scalar9 0 255.99609375 /end CHARACTERISTIC
/begin COMPU_METHOD Compu_CRI_bst_dP_scalar9 " " RAT_FUNC "%.2" "psi" COEFFS 0 256 0 0 0 1 /end COMPU_METHOD
/begin CHARACTERISTIC CRI_pilot1_priority1 "Pilot 1/2 conflict priority{CRI_pilot1_priority1&0xff=0:Pilot 1}{CRI_pilot1_priority1&0xff=1:Pilot 2}" VALUE 0x00170F75 /* @ECU_Address@CRI_pilot1_priority1@0x0100A9C0@ */ ECIPP_ALIGNMENT_UBYTE 255 CRI_pilot1_priority1_COMPU_VTAB 0 255 BIT_MASK 0xff /end CHARACTERISTIC
/begin COMPU_METHOD CRI_pilot1_priority1_COMPU_VTAB "Verbal Table" TAB_VERB "%.0" "list" COMPU_TAB_REF CRI_pilot1_priority1_COMPU_VTAB_REF /end COMPU_METHOD
/begin COMPU_VTAB CRI_pilot1_priority1_COMPU_VTAB_REF "Verbal Table" TAB_VERB 2 0 "Pilot 1" 1 "Pilot 2" DEFAULT_VALUE "UNKNOWN" /end COMPU_VTAB
/begin CHARACTERISTIC CRI_pilot1_priority2 "Pilot 1/2 conflict priority{CRI_pilot1_priority2&0xff=0:Pilot 1}{CRI_pilot1_priority2&0xff=1:Pilot 2}" VALUE 0x00170F76 /* @ECU_Address@CRI_pilot1_priority2@0x0100A9C8@ */ ECIPP_ALIGNMENT_UBYTE 255 CRI_pilot1_priority2_COMPU_VTAB 0 255 BIT_MASK 0xff /end CHARACTERISTIC
/begin COMPU_METHOD CRI_pilot1_priority2_COMPU_VTAB "Verbal Table" TAB_VERB "%.0" "list" COMPU_TAB_REF CRI_pilot1_priority2_COMPU_VTAB_REF /end COMPU_METHOD
/begin COMPU_VTAB CRI_pilot1_priority2_COMPU_VTAB_REF "Verbal Table" TAB_VERB 2 0 "Pilot 1" 1 "Pilot 2" DEFAULT_VALUE "UNKNOWN" /end COMPU_VTAB
/begin CHARACTERISTIC CRI_pilot1_priority3 "Pilot 1/2 conflict priority{CRI_pilot1_priority3&0xff=0:Pilot 1}{CRI_pilot1_priority3&0xff=1:Pilot 2}" VALUE 0x00170F77 /* @ECU_Address@CRI_pilot1_priority3@0x0100A9D0@ */ ECIPP_ALIGNMENT_UBYTE 255 CRI_pilot1_priority3_COMPU_VTAB 0 255 BIT_MASK 0xff /end CHARACTERISTIC
/begin COMPU_METHOD CRI_pilot1_priority3_COMPU_VTAB "Verbal Table" TAB_VERB "%.0" "list" COMPU_TAB_REF CRI_pilot1_priority3_COMPU_VTAB_REF /end COMPU_METHOD
/begin COMPU_VTAB CRI_pilot1_priority3_COMPU_VTAB_REF "Verbal Table" TAB_VERB 2 0 "Pilot 1" 1 "Pilot 2" DEFAULT_VALUE "UNKNOWN" /end COMPU_VTAB
/begin CHARACTERISTIC CRI_pilot1_priority4 "Pilot 1/2 conflict priority{CRI_pilot1_priority4&0xff=0:Pilot 1}{CRI_pilot1_priority4&0xff=1:Pilot 2}" VALUE 0x00170F78 /* @ECU_Address@CRI_pilot1_priority4@0x0100A9D8@ */ ECIPP_ALIGNMENT_UBYTE 255 CRI_pilot1_priority4_COMPU_VTAB 0 255 BIT_MASK 0xff /end CHARACTERISTIC
/begin COMPU_METHOD CRI_pilot1_priority4_COMPU_VTAB "Verbal Table" TAB_VERB "%.0" "list" COMPU_TAB_REF CRI_pilot1_priority4_COMPU_VTAB_REF /end COMPU_METHOD
/begin COMPU_VTAB CRI_pilot1_priority4_COMPU_VTAB_REF "Verbal Table" TAB_VERB 2 0 "Pilot 1" 1 "Pilot 2" DEFAULT_VALUE "UNKNOWN" /end COMPU_VTAB
/begin CHARACTERISTIC CRI_pilot1_priority5 "Pilot 1/2 conflict priority{CRI_pilot1_priority5&0xff=0:Pilot 1}{CRI_pilot1_priority5&0xff=1:Pilot 2}" VALUE 0x00170F79 /* @ECU_Address@CRI_pilot1_priority5@0x0100A9E0@ */ ECIPP_ALIGNMENT_UBYTE 255 CRI_pilot1_priority5_COMPU_VTAB 0 255 BIT_MASK 0xff /end CHARACTERISTIC
/begin COMPU_METHOD CRI_pilot1_priority5_COMPU_VTAB "Verbal Table" TAB_VERB "%.0" "list" COMPU_TAB_REF CRI_pilot1_priority5_COMPU_VTAB_REF /end COMPU_METHOD
/begin COMPU_VTAB CRI_pilot1_priority5_COMPU_VTAB_REF "Verbal Table" TAB_VERB 2 0 "Pilot 1" 1 "Pilot 2" DEFAULT_VALUE "UNKNOWN" /end COMPU_VTAB
/begin CHARACTERISTIC CRI_pilot1_priority6 "Pilot 1/2 conflict priority{CRI_pilot1_priority6&0xff=0:Pilot 1}{CRI_pilot1_priority6&0xff=1:Pilot 2}" VALUE 0x00170F7A /* @ECU_Address@CRI_pilot1_priority6@0x0100A9E8@ */ ECIPP_ALIGNMENT_UBYTE 255 CRI_pilot1_priority6_COMPU_VTAB 0 255 BIT_MASK 0xff /end CHARACTERISTIC
/begin COMPU_METHOD CRI_pilot1_priority6_COMPU_VTAB "Verbal Table" TAB_VERB "%.0" "list" COMPU_TAB_REF CRI_pilot1_priority6_COMPU_VTAB_REF /end COMPU_METHOD
/begin COMPU_VTAB CRI_pilot1_priority6_COMPU_VTAB_REF "Verbal Table" TAB_VERB 2 0 "Pilot 1" 1 "Pilot 2" DEFAULT_VALUE "UNKNOWN" /end COMPU_VTAB
/begin CHARACTERISTIC CRI_pilot1_priority7 "Pilot 1/2 conflict priority{CRI_pilot1_priority7&0xff=0:Pilot 1}{CRI_pilot1_priority7&0xff=1:Pilot 2}" VALUE 0x00170F7B /* @ECU_Address@CRI_pilot1_priority7@0x0100A9F0@ */ ECIPP_ALIGNMENT_UBYTE 255 CRI_pilot1_priority7_COMPU_VTAB 0 255 BIT_MASK 0xff /end CHARACTERISTIC
/begin COMPU_METHOD CRI_pilot1_priority7_COMPU_VTAB "Verbal Table" TAB_VERB "%.0" "list" COMPU_TAB_REF CRI_pilot1_priority7_COMPU_VTAB_REF /end COMPU_METHOD
/begin COMPU_VTAB CRI_pilot1_priority7_COMPU_VTAB_REF "Verbal Table" TAB_VERB 2 0 "Pilot 1" 1 "Pilot 2" DEFAULT_VALUE "UNKNOWN" /end COMPU_VTAB
/begin CHARACTERISTIC CRI_pilot1_priority8 "Pilot 1/2 conflict priority{CRI_pilot1_priority8&0xff=0:Pilot 1}{CRI_pilot1_priority8&0xff=1:Pilot 2}" VALUE 0x00170F7C /* @ECU_Address@CRI_pilot1_priority8@0x0100A9F8@ */ ECIPP_ALIGNMENT_UBYTE 255 CRI_pilot1_priority8_COMPU_VTAB 0 255 BIT_MASK 0xff /end CHARACTERISTIC
/begin COMPU_METHOD CRI_pilot1_priority8_COMPU_VTAB "Verbal Table" TAB_VERB "%.0" "list" COMPU_TAB_REF CRI_pilot1_priority8_COMPU_VTAB_REF /end COMPU_METHOD
/begin COMPU_VTAB CRI_pilot1_priority8_COMPU_VTAB_REF "Verbal Table" TAB_VERB 2 0 "Pilot 1" 1 "Pilot 2" DEFAULT_VALUE "UNKNOWN" /end COMPU_VTAB
/begin CHARACTERISTIC CRI_pilot1_priority9 "Pilot 1/2 conflict priority{CRI_pilot1_priority9&0xff=0:Pilot 1}{CRI_pilot1_priority9&0xff=1:Pilot 2}" VALUE 0x00170F7D /* @ECU_Address@CRI_pilot1_priority9@0x0100AA00@ */ ECIPP_ALIGNMENT_UBYTE 255 CRI_pilot1_priority9_COMPU_VTAB 0 255 BIT_MASK 0xff /end CHARACTERISTIC
/begin COMPU_METHOD CRI_pilot1_priority9_COMPU_VTAB "Verbal Table" TAB_VERB "%.0" "list" COMPU_TAB_REF CRI_pilot1_priority9_COMPU_VTAB_REF /end COMPU_METHOD
/begin COMPU_VTAB CRI_pilot1_priority9_COMPU_VTAB_REF "Verbal Table" TAB_VERB 2 0 "Pilot 1" 1 "Pilot 2" DEFAULT_VALUE "UNKNOWN" /end COMPU_VTAB
/begin CHARACTERISTIC CRI_DOC_Tcl_slct0 "DOC closed-loop T control{CRI_DOC_Tcl_slct0&0xff=0:Disabled}{CRI_DOC_Tcl_slct0&0xff=1:Standard}{CRI_DOC_Tcl_slct0&0xff=2:Alternate 1}{CRI_DOC_Tcl_slct0&0xff=3:Alt 1 + Std}" VALUE 0x00170E6E /* @ECU_Address@CRI_DOC_Tcl_slct0@0x0100AA08@ */ ECIPP_ALIGNMENT_UBYTE 255 CRI_DOC_Tcl_slct0_COMPU_VTAB 0 255 BIT_MASK 0xff /end CHARACTERISTIC
/begin COMPU_METHOD CRI_DOC_Tcl_slct0_COMPU_VTAB "Verbal Table" TAB_VERB "%.0" "list" COMPU_TAB_REF CRI_DOC_Tcl_slct0_COMPU_VTAB_REF /end COMPU_METHOD
/begin COMPU_VTAB CRI_DOC_Tcl_slct0_COMPU_VTAB_REF "Verbal Table" TAB_VERB 4 0 "Disabled" 1 "Standard" 2 "Alternate 1" 3 "Alt 1 + Std" DEFAULT_VALUE "UNKNOWN" /end COMPU_VTAB
/begin CHARACTERISTIC CRI_DOC_Tcl_slct1 "DOC closed-loop T control{CRI_DOC_Tcl_slct1&0xff=0:Disabled}{CRI_DOC_Tcl_slct1&0xff=1:Standard}{CRI_DOC_Tcl_slct1&0xff=2:Alternate 1}{CRI_DOC_Tcl_slct1&0xff=3:Alt 1 + Std}" VALUE 0x00170E6F /* @ECU_Address@CRI_DOC_Tcl_slct1@0x0100AA10@ */ ECIPP_ALIGNMENT_UBYTE 255 CRI_DOC_Tcl_slct1_COMPU_VTAB 0 255 BIT_MASK 0xff /end CHARACTERISTIC
/begin COMPU_METHOD CRI_DOC_Tcl_slct1_COMPU_VTAB "Verbal Table" TAB_VERB "%.0" "list" COMPU_TAB_REF CRI_DOC_Tcl_slct1_COMPU_VTAB_REF /end COMPU_METHOD
/begin COMPU_VTAB CRI_DOC_Tcl_slct1_COMPU_VTAB_REF "Verbal Table" TAB_VERB 4 0 "Disabled" 1 "Standard" 2 "Alternate 1" 3 "Alt 1 + Std" DEFAULT_VALUE "UNKNOWN" /end COMPU_VTAB
/begin CHARACTERISTIC CRI_DOC_Tcl_slct2 "DOC closed-loop T control{CRI_DOC_Tcl_slct2&0xff=0:Disabled}{CRI_DOC_Tcl_slct2&0xff=1:Standard}{CRI_DOC_Tcl_slct2&0xff=2:Alternate 1}{CRI_DOC_Tcl_slct2&0xff=3:Alt 1 + Std}" VALUE 0x00170E70 /* @ECU_Address@CRI_DOC_Tcl_slct2@0x0100AA18@ */ ECIPP_ALIGNMENT_UBYTE 255 CRI_DOC_Tcl_slct2_COMPU_VTAB 0 255 BIT_MASK 0xff /end CHARACTERISTIC
/begin COMPU_METHOD CRI_DOC_Tcl_slct2_COMPU_VTAB "Verbal Table" TAB_VERB "%.0" "list" COMPU_TAB_REF CRI_DOC_Tcl_slct2_COMPU_VTAB_REF /end COMPU_METHOD
/begin COMPU_VTAB CRI_DOC_Tcl_slct2_COMPU_VTAB_REF "Verbal Table" TAB_VERB 4 0 "Disabled" 1 "Standard" 2 "Alternate 1" 3 "Alt 1 + Std" DEFAULT_VALUE "UNKNOWN" /end COMPU_VTAB
/begin CHARACTERISTIC CRI_DOC_Tcl_slct3 "DOC closed-loop T control{CRI_DOC_Tcl_slct3&0xff=0:Disabled}{CRI_DOC_Tcl_slct3&0xff=1:Standard}{CRI_DOC_Tcl_slct3&0xff=2:Alternate 1}{CRI_DOC_Tcl_slct3&0xff=3:Alt 1 + Std}" VALUE 0x00170E71 /* @ECU_Address@CRI_DOC_Tcl_slct3@0x0100AA20@ */ ECIPP_ALIGNMENT_UBYTE 255 CRI_DOC_Tcl_slct3_COMPU_VTAB 0 255 BIT_MASK 0xff /end CHARACTERISTIC
/begin COMPU_METHOD CRI_DOC_Tcl_slct3_COMPU_VTAB "Verbal Table" TAB_VERB "%.0" "list" COMPU_TAB_REF CRI_DOC_Tcl_slct3_COMPU_VTAB_REF /end COMPU_METHOD
/begin COMPU_VTAB CRI_DOC_Tcl_slct3_COMPU_VTAB_REF "Verbal Table" TAB_VERB 4 0 "Disabled" 1 "Standard" 2 "Alternate 1" 3 "Alt 1 + Std" DEFAULT_VALUE "UNKNOWN" /end COMPU_VTAB
/begin CHARACTERISTIC CRI_DOC_Tcl_slct4 "DOC closed-loop T control{CRI_DOC_Tcl_slct4&0xff=0:Disabled}{CRI_DOC_Tcl_slct4&0xff=1:Standard}{CRI_DOC_Tcl_slct4&0xff=2:Alternate 1}{CRI_DOC_Tcl_slct4&0xff=3:Alt 1 + Std}" VALUE 0x00170E72 /* @ECU_Address@CRI_DOC_Tcl_slct4@0x0100AA28@ */ ECIPP_ALIGNMENT_UBYTE 255 CRI_DOC_Tcl_slct4_COMPU_VTAB 0 255 BIT_MASK 0xff /end CHARACTERISTIC
/begin COMPU_METHOD CRI_DOC_Tcl_slct4_COMPU_VTAB "Verbal Table" TAB_VERB "%.0" "list" COMPU_TAB_REF CRI_DOC_Tcl_slct4_COMPU_VTAB_REF /end COMPU_METHOD
/begin COMPU_VTAB CRI_DOC_Tcl_slct4_COMPU_VTAB_REF "Verbal Table" TAB_VERB 4 0 "Disabled" 1 "Standard" 2 "Alternate 1" 3 "Alt 1 + Std" DEFAULT_VALUE "UNKNOWN" /end COMPU_VTAB
/begin CHARACTERISTIC CRI_DOC_Tcl_slct5 "DOC closed-loop T control{CRI_DOC_Tcl_slct5&0xff=0:Disabled}{CRI_DOC_Tcl_slct5&0xff=1:Standard}{CRI_DOC_Tcl_slct5&0xff=2:Alternate 1}{CRI_DOC_Tcl_slct5&0xff=3:Alt 1 + Std}" VALUE 0x00170E73 /* @ECU_Address@CRI_DOC_Tcl_slct5@0x0100AA30@ */ ECIPP_ALIGNMENT_UBYTE 255 CRI_DOC_Tcl_slct5_COMPU_VTAB 0 255 BIT_MASK 0xff /end CHARACTERISTIC
/begin COMPU_METHOD CRI_DOC_Tcl_slct5_COMPU_VTAB "Verbal Table" TAB_VERB "%.0" "list" COMPU_TAB_REF CRI_DOC_Tcl_slct5_COMPU_VTAB_REF /end COMPU_METHOD
/begin COMPU_VTAB CRI_DOC_Tcl_slct5_COMPU_VTAB_REF "Verbal Table" TAB_VERB 4 0 "Disabled" 1 "Standard" 2 "Alternate 1" 3 "Alt 1 + Std" DEFAULT_VALUE "UNKNOWN" /end COMPU_VTAB
/begin CHARACTERISTIC CRI_DOC_Tcl_slct6 "DOC closed-loop T control{CRI_DOC_Tcl_slct6&0xff=0:Disabled}{CRI_DOC_Tcl_slct6&0xff=1:Standard}{CRI_DOC_Tcl_slct6&0xff=2:Alternate 1}{CRI_DOC_Tcl_slct6&0xff=3:Alt 1 + Std}" VALUE 0x00170E74 /* @ECU_Address@CRI_DOC_Tcl_slct6@0x0100AA38@ */ ECIPP_ALIGNMENT_UBYTE 255 CRI_DOC_Tcl_slct6_COMPU_VTAB 0 255 BIT_MASK 0xff /end CHARACTERISTIC
/begin COMPU_METHOD CRI_DOC_Tcl_slct6_COMPU_VTAB "Verbal Table" TAB_VERB "%.0" "list" COMPU_TAB_REF CRI_DOC_Tcl_slct6_COMPU_VTAB_REF /end COMPU_METHOD
/begin COMPU_VTAB CRI_DOC_Tcl_slct6_COMPU_VTAB_REF "Verbal Table" TAB_VERB 4 0 "Disabled" 1 "Standard" 2 "Alternate 1" 3 "Alt 1 + Std" DEFAULT_VALUE "UNKNOWN" /end COMPU_VTAB
/begin CHARACTERISTIC CRI_DOC_Tcl_slct7 "DOC closed-loop T control{CRI_DOC_Tcl_slct7&0xff=0:Disabled}{CRI_DOC_Tcl_slct7&0xff=1:Standard}{CRI_DOC_Tcl_slct7&0xff=2:Alternate 1}{CRI_DOC_Tcl_slct7&0xff=3:Alt 1 + Std}" VALUE 0x00170E75 /* @ECU_Address@CRI_DOC_Tcl_slct7@0x0100AA40@ */ ECIPP_ALIGNMENT_UBYTE 255 CRI_DOC_Tcl_slct7_COMPU_VTAB 0 255 BIT_MASK 0xff /end CHARACTERISTIC
/begin COMPU_METHOD CRI_DOC_Tcl_slct7_COMPU_VTAB "Verbal Table" TAB_VERB "%.0" "list" COMPU_TAB_REF CRI_DOC_Tcl_slct7_COMPU_VTAB_REF /end COMPU_METHOD
/begin COMPU_VTAB CRI_DOC_Tcl_slct7_COMPU_VTAB_REF "Verbal Table" TAB_VERB 4 0 "Disabled" 1 "Standard" 2 "Alternate 1" 3 "Alt 1 + Std" DEFAULT_VALUE "UNKNOWN" /end COMPU_VTAB
/begin CHARACTERISTIC CRI_DOC_Tcl_slct8 "DOC closed-loop T control{CRI_DOC_Tcl_slct8&0xff=0:Disabled}{CRI_DOC_Tcl_slct8&0xff=1:Standard}{CRI_DOC_Tcl_slct8&0xff=2:Alternate 1}{CRI_DOC_Tcl_slct8&0xff=3:Alt 1 + Std}" VALUE 0x00170E76 /* @ECU_Address@CRI_DOC_Tcl_slct8@0x0100AA48@ */ ECIPP_ALIGNMENT_UBYTE 255 CRI_DOC_Tcl_slct8_COMPU_VTAB 0 255 BIT_MASK 0xff /end CHARACTERISTIC
/begin COMPU_METHOD CRI_DOC_Tcl_slct8_COMPU_VTAB "Verbal Table" TAB_VERB "%.0" "list" COMPU_TAB_REF CRI_DOC_Tcl_slct8_COMPU_VTAB_REF /end COMPU_METHOD
/begin COMPU_VTAB CRI_DOC_Tcl_slct8_COMPU_VTAB_REF "Verbal Table" TAB_VERB 4 0 "Disabled" 1 "Standard" 2 "Alternate 1" 3 "Alt 1 + Std" DEFAULT_VALUE "UNKNOWN" /end COMPU_VTAB
/begin CHARACTERISTIC CRI_DOC_Tcl_slct9 "DOC closed-loop T control{CRI_DOC_Tcl_slct9&0xff=0:Disabled}{CRI_DOC_Tcl_slct9&0xff=1:Standard}{CRI_DOC_Tcl_slct9&0xff=2:Alternate 1}{CRI_DOC_Tcl_slct9&0xff=3:Alt 1 + Std}" VALUE 0x00170E77 /* @ECU_Address@CRI_DOC_Tcl_slct9@0x0100AA50@ */ ECIPP_ALIGNMENT_UBYTE 255 CRI_DOC_Tcl_slct9_COMPU_VTAB 0 255 BIT_MASK 0xff /end CHARACTERISTIC
/begin COMPU_METHOD CRI_DOC_Tcl_slct9_COMPU_VTAB "Verbal Table" TAB_VERB "%.0" "list" COMPU_TAB_REF CRI_DOC_Tcl_slct9_COMPU_VTAB_REF /end COMPU_METHOD
/begin COMPU_VTAB CRI_DOC_Tcl_slct9_COMPU_VTAB_REF "Verbal Table" TAB_VERB 4 0 "Disabled" 1 "Standard" 2 "Alternate 1" 3 "Alt 1 + Std" DEFAULT_VALUE "UNKNOWN" /end COMPU_VTAB
/begin CHARACTERISTIC CRI_mchk_RPM0 "Enter this mode if RPM is{CRI_mchk_RPM0&0xff=0:X}{CRI_mchk_RPM0&0xff=1:<}{CRI_mchk_RPM0&0xff=2:>}{CRI_mchk_RPM0&0xff=3:<=}{CRI_mchk_RPM0&0xff=4:>=}{CRI_mchk_RPM0&0xff=5:=}{CRI_mchk_RPM0&0xff=6:<>}" VALUE 0x00170F38 /* @ECU_Address@CRI_mchk_RPM0@0x0100AA58@ */ ECIPP_ALIGNMENT_UBYTE 255 CRI_mchk_RPM0_COMPU_VTAB 0 255 BIT_MASK 0xff /end CHARACTERISTIC
/begin COMPU_METHOD CRI_mchk_RPM0_COMPU_VTAB "Verbal Table" TAB_VERB "%.0" "list" COMPU_TAB_REF CRI_mchk_RPM0_COMPU_VTAB_REF /end COMPU_METHOD
/begin COMPU_VTAB CRI_mchk_RPM0_COMPU_VTAB_REF "Verbal Table" TAB_VERB 7 0 "X" 1 "<" 2 ">" 3 "<=" 4 ">=" 5 "=" 6 "<>" DEFAULT_VALUE "UNKNOWN" /end COMPU_VTAB
/begin CHARACTERISTIC CRI_mchk_RPM1 "Enter this mode if RPM is{CRI_mchk_RPM1&0xff=0:X}{CRI_mchk_RPM1&0xff=1:<}{CRI_mchk_RPM1&0xff=2:>}{CRI_mchk_RPM1&0xff=3:<=}{CRI_mchk_RPM1&0xff=4:>=}{CRI_mchk_RPM1&0xff=5:=}{CRI_mchk_RPM1&0xff=6:<>}" VALUE 0x00170F39 /* @ECU_Address@CRI_mchk_RPM1@0x0100AA60@ */ ECIPP_ALIGNMENT_UBYTE 255 CRI_mchk_RPM1_COMPU_VTAB 0 255 BIT_MASK 0xff /end CHARACTERISTIC
/begin COMPU_METHOD CRI_mchk_RPM1_COMPU_VTAB "Verbal Table" TAB_VERB "%.0" "list" COMPU_TAB_REF CRI_mchk_RPM1_COMPU_VTAB_REF /end COMPU_METHOD
/begin COMPU_VTAB CRI_mchk_RPM1_COMPU_VTAB_REF "Verbal Table" TAB_VERB 7 0 "X" 1 "<" 2 ">" 3 "<=" 4 ">=" 5 "=" 6 "<>" DEFAULT_VALUE "UNKNOWN" /end COMPU_VTAB
/begin CHARACTERISTIC CRI_mchk_RPM2 "Enter this mode if RPM is{CRI_mchk_RPM2&0xff=0:X}{CRI_mchk_RPM2&0xff=1:<}{CRI_mchk_RPM2&0xff=2:>}{CRI_mchk_RPM2&0xff=3:<=}{CRI_mchk_RPM2&0xff=4:>=}{CRI_mchk_RPM2&0xff=5:=}{CRI_mchk_RPM2&0xff=6:<>}" VALUE 0x00170F3A /* @ECU_Address@CRI_mchk_RPM2@0x0100AA68@ */ ECIPP_ALIGNMENT_UBYTE 255 CRI_mchk_RPM2_COMPU_VTAB 0 255 BIT_MASK 0xff /end CHARACTERISTIC
/begin COMPU_METHOD CRI_mchk_RPM2_COMPU_VTAB "Verbal Table" TAB_VERB "%.0" "list" COMPU_TAB_REF CRI_mchk_RPM2_COMPU_VTAB_REF /end COMPU_METHOD
/begin COMPU_VTAB CRI_mchk_RPM2_COMPU_VTAB_REF "Verbal Table" TAB_VERB 7 0 "X" 1 "<" 2 ">" 3 "<=" 4 ">=" 5 "=" 6 "<>" DEFAULT_VALUE "UNKNOWN" /end COMPU_VTAB
/begin CHARACTERISTIC CRI_mchk_RPM3 "Enter this mode if RPM is{CRI_mchk_RPM3&0xff=0:X}{CRI_mchk_RPM3&0xff=1:<}{CRI_mchk_RPM3&0xff=2:>}{CRI_mchk_RPM3&0xff=3:<=}{CRI_mchk_RPM3&0xff=4:>=}{CRI_mchk_RPM3&0xff=5:=}{CRI_mchk_RPM3&0xff=6:<>}" VALUE 0x00170F3B /* @ECU_Address@CRI_mchk_RPM3@0x0100AA70@ */ ECIPP_ALIGNMENT_UBYTE 255 CRI_mchk_RPM3_COMPU_VTAB 0 255 BIT_MASK 0xff /end CHARACTERISTIC
/begin COMPU_METHOD CRI_mchk_RPM3_COMPU_VTAB "Verbal Table" TAB_VERB "%.0" "list" COMPU_TAB_REF CRI_mchk_RPM3_COMPU_VTAB_REF /end COMPU_METHOD
/begin COMPU_VTAB CRI_mchk_RPM3_COMPU_VTAB_REF "Verbal Table" TAB_VERB 7 0 "X" 1 "<" 2 ">" 3 "<=" 4 ">=" 5 "=" 6 "<>" DEFAULT_VALUE "UNKNOWN" /end COMPU_VTAB
/begin CHARACTERISTIC CRI_mchk_RPM4 "Enter this mode if RPM is{CRI_mchk_RPM4&0xff=0:X}{CRI_mchk_RPM4&0xff=1:<}{CRI_mchk_RPM4&0xff=2:>}{CRI_mchk_RPM4&0xff=3:<=}{CRI_mchk_RPM4&0xff=4:>=}{CRI_mchk_RPM4&0xff=5:=}{CRI_mchk_RPM4&0xff=6:<>}" VALUE 0x00170F3C /* @ECU_Address@CRI_mchk_RPM4@0x0100AA78@ */ ECIPP_ALIGNMENT_UBYTE 255 CRI_mchk_RPM4_COMPU_VTAB 0 255 BIT_MASK 0xff /end CHARACTERISTIC
/begin COMPU_METHOD CRI_mchk_RPM4_COMPU_VTAB "Verbal Table" TAB_VERB "%.0" "list" COMPU_TAB_REF CRI_mchk_RPM4_COMPU_VTAB_REF /end COMPU_METHOD
/begin COMPU_VTAB CRI_mchk_RPM4_COMPU_VTAB_REF "Verbal Table" TAB_VERB 7 0 "X" 1 "<" 2 ">" 3 "<=" 4 ">=" 5 "=" 6 "<>" DEFAULT_VALUE "UNKNOWN" /end COMPU_VTAB
/begin CHARACTERISTIC CRI_mchk_RPM5 "Enter this mode if RPM is{CRI_mchk_RPM5&0xff=0:X}{CRI_mchk_RPM5&0xff=1:<}{CRI_mchk_RPM5&0xff=2:>}{CRI_mchk_RPM5&0xff=3:<=}{CRI_mchk_RPM5&0xff=4:>=}{CRI_mchk_RPM5&0xff=5:=}{CRI_mchk_RPM5&0xff=6:<>}" VALUE 0x00170F3D /* @ECU_Address@CRI_mchk_RPM5@0x0100AA80@ */ ECIPP_ALIGNMENT_UBYTE 255 CRI_mchk_RPM5_COMPU_VTAB 0 255 BIT_MASK 0xff /end CHARACTERISTIC
/begin COMPU_METHOD CRI_mchk_RPM5_COMPU_VTAB "Verbal Table" TAB_VERB "%.0" "list" COMPU_TAB_REF CRI_mchk_RPM5_COMPU_VTAB_REF /end COMPU_METHOD
/begin COMPU_VTAB CRI_mchk_RPM5_COMPU_VTAB_REF "Verbal Table" TAB_VERB 7 0 "X" 1 "<" 2 ">" 3 "<=" 4 ">=" 5 "=" 6 "<>" DEFAULT_VALUE "UNKNOWN" /end COMPU_VTAB
/begin CHARACTERISTIC CRI_mchk_RPM6 "Enter this mode if RPM is{CRI_mchk_RPM6&0xff=0:X}{CRI_mchk_RPM6&0xff=1:<}{CRI_mchk_RPM6&0xff=2:>}{CRI_mchk_RPM6&0xff=3:<=}{CRI_mchk_RPM6&0xff=4:>=}{CRI_mchk_RPM6&0xff=5:=}{CRI_mchk_RPM6&0xff=6:<>}" VALUE 0x00170F3E /* @ECU_Address@CRI_mchk_RPM6@0x0100AA88@ */ ECIPP_ALIGNMENT_UBYTE 255 CRI_mchk_RPM6_COMPU_VTAB 0 255 BIT_MASK 0xff /end CHARACTERISTIC
/begin COMPU_METHOD CRI_mchk_RPM6_COMPU_VTAB "Verbal Table" TAB_VERB "%.0" "list" COMPU_TAB_REF CRI_mchk_RPM6_COMPU_VTAB_REF /end COMPU_METHOD
/begin COMPU_VTAB CRI_mchk_RPM6_COMPU_VTAB_REF "Verbal Table" TAB_VERB 7 0 "X" 1 "<" 2 ">" 3 "<=" 4 ">=" 5 "=" 6 "<>" DEFAULT_VALUE "UNKNOWN" /end COMPU_VTAB
/begin CHARACTERISTIC CRI_mchk_RPM7 "Enter this mode if RPM is{CRI_mchk_RPM7&0xff=0:X}{CRI_mchk_RPM7&0xff=1:<}{CRI_mchk_RPM7&0xff=2:>}{CRI_mchk_RPM7&0xff=3:<=}{CRI_mchk_RPM7&0xff=4:>=}{CRI_mchk_RPM7&0xff=5:=}{CRI_mchk_RPM7&0xff=6:<>}" VALUE 0x00170F3F /* @ECU_Address@CRI_mchk_RPM7@0x0100AA90@ */ ECIPP_ALIGNMENT_UBYTE 255 CRI_mchk_RPM7_COMPU_VTAB 0 255 BIT_MASK 0xff /end CHARACTERISTIC
/begin COMPU_METHOD CRI_mchk_RPM7_COMPU_VTAB "Verbal Table" TAB_VERB "%.0" "list" COMPU_TAB_REF CRI_mchk_RPM7_COMPU_VTAB_REF /end COMPU_METHOD
/begin COMPU_VTAB CRI_mchk_RPM7_COMPU_VTAB_REF "Verbal Table" TAB_VERB 7 0 "X" 1 "<" 2 ">" 3 "<=" 4 ">=" 5 "=" 6 "<>" DEFAULT_VALUE "UNKNOWN" /end COMPU_VTAB
/begin CHARACTERISTIC CRI_mchk_RPM8 "Enter this mode if RPM is{CRI_mchk_RPM8&0xff=0:X}{CRI_mchk_RPM8&0xff=1:<}{CRI_mchk_RPM8&0xff=2:>}{CRI_mchk_RPM8&0xff=3:<=}{CRI_mchk_RPM8&0xff=4:>=}{CRI_mchk_RPM8&0xff=5:=}{CRI_mchk_RPM8&0xff=6:<>}" VALUE 0x00170F40 /* @ECU_Address@CRI_mchk_RPM8@0x0100AA98@ */ ECIPP_ALIGNMENT_UBYTE 255 CRI_mchk_RPM8_COMPU_VTAB 0 255 BIT_MASK 0xff /end CHARACTERISTIC
/begin COMPU_METHOD CRI_mchk_RPM8_COMPU_VTAB "Verbal Table" TAB_VERB "%.0" "list" COMPU_TAB_REF CRI_mchk_RPM8_COMPU_VTAB_REF /end COMPU_METHOD
/begin COMPU_VTAB CRI_mchk_RPM8_COMPU_VTAB_REF "Verbal Table" TAB_VERB 7 0 "X" 1 "<" 2 ">" 3 "<=" 4 ">=" 5 "=" 6 "<>" DEFAULT_VALUE "UNKNOWN" /end COMPU_VTAB
/begin CHARACTERISTIC CRI_mchk_RPM9 "Enter this mode if RPM is{CRI_mchk_RPM9&0xff=0:X}{CRI_mchk_RPM9&0xff=1:<}{CRI_mchk_RPM9&0xff=2:>}{CRI_mchk_RPM9&0xff=3:<=}{CRI_mchk_RPM9&0xff=4:>=}{CRI_mchk_RPM9&0xff=5:=}{CRI_mchk_RPM9&0xff=6:<>}" VALUE 0x00170F41 /* @ECU_Address@CRI_mchk_RPM9@0x0100AAA0@ */ ECIPP_ALIGNMENT_UBYTE 255 CRI_mchk_RPM9_COMPU_VTAB 0 255 BIT_MASK 0xff /end CHARACTERISTIC
/begin COMPU_METHOD CRI_mchk_RPM9_COMPU_VTAB "Verbal Table" TAB_VERB "%.0" "list" COMPU_TAB_REF CRI_mchk_RPM9_COMPU_VTAB_REF /end COMPU_METHOD
/begin COMPU_VTAB CRI_mchk_RPM9_COMPU_VTAB_REF "Verbal Table" TAB_VERB 7 0 "X" 1 "<" 2 ">" 3 "<=" 4 ">=" 5 "=" 6 "<>" DEFAULT_VALUE "UNKNOWN" /end COMPU_VTAB
/begin CHARACTERISTIC CRI_mchk_ECT0 "and ECT is{CRI_mchk_ECT0&0xff=0:X}{CRI_mchk_ECT0&0xff=1:<}{CRI_mchk_ECT0&0xff=2:>}{CRI_mchk_ECT0&0xff=3:<=}{CRI_mchk_ECT0&0xff=4:>=}{CRI_mchk_ECT0&0xff=5:=}{CRI_mchk_ECT0&0xff=6:<>}" VALUE 0x00170F24 /* @ECU_Address@CRI_mchk_ECT0@0x0100AAA8@ */ ECIPP_ALIGNMENT_UBYTE 255 CRI_mchk_ECT0_COMPU_VTAB 0 255 BIT_MASK 0xff /end CHARACTERISTIC
/begin COMPU_METHOD CRI_mchk_ECT0_COMPU_VTAB "Verbal Table" TAB_VERB "%.0" "list" COMPU_TAB_REF CRI_mchk_ECT0_COMPU_VTAB_REF /end COMPU_METHOD
/begin COMPU_VTAB CRI_mchk_ECT0_COMPU_VTAB_REF "Verbal Table" TAB_VERB 7 0 "X" 1 "<" 2 ">" 3 "<=" 4 ">=" 5 "=" 6 "<>" DEFAULT_VALUE "UNKNOWN" /end COMPU_VTAB
/begin CHARACTERISTIC CRI_mchk_ECT1 "and ECT is{CRI_mchk_ECT1&0xff=0:X}{CRI_mchk_ECT1&0xff=1:<}{CRI_mchk_ECT1&0xff=2:>}{CRI_mchk_ECT1&0xff=3:<=}{CRI_mchk_ECT1&0xff=4:>=}{CRI_mchk_ECT1&0xff=5:=}{CRI_mchk_ECT1&0xff=6:<>}" VALUE 0x00170F25 /* @ECU_Address@CRI_mchk_ECT1@0x0100AAB0@ */ ECIPP_ALIGNMENT_UBYTE 255 CRI_mchk_ECT1_COMPU_VTAB 0 255 BIT_MASK 0xff /end CHARACTERISTIC
/begin COMPU_METHOD CRI_mchk_ECT1_COMPU_VTAB "Verbal Table" TAB_VERB "%.0" "list" COMPU_TAB_REF CRI_mchk_ECT1_COMPU_VTAB_REF /end COMPU_METHOD
/begin COMPU_VTAB CRI_mchk_ECT1_COMPU_VTAB_REF "Verbal Table" TAB_VERB 7 0 "X" 1 "<" 2 ">" 3 "<=" 4 ">=" 5 "=" 6 "<>" DEFAULT_VALUE "UNKNOWN" /end COMPU_VTAB
/begin CHARACTERISTIC CRI_mchk_ECT2 "and ECT is{CRI_mchk_ECT2&0xff=0:X}{CRI_mchk_ECT2&0xff=1:<}{CRI_mchk_ECT2&0xff=2:>}{CRI_mchk_ECT2&0xff=3:<=}{CRI_mchk_ECT2&0xff=4:>=}{CRI_mchk_ECT2&0xff=5:=}{CRI_mchk_ECT2&0xff=6:<>}" VALUE 0x00170F26 /* @ECU_Address@CRI_mchk_ECT2@0x0100AAB8@ */ ECIPP_ALIGNMENT_UBYTE 255 CRI_mchk_ECT2_COMPU_VTAB 0 255 BIT_MASK 0xff /end CHARACTERISTIC
/begin COMPU_METHOD CRI_mchk_ECT2_COMPU_VTAB "Verbal Table" TAB_VERB "%.0" "list" COMPU_TAB_REF CRI_mchk_ECT2_COMPU_VTAB_REF /end COMPU_METHOD
/begin COMPU_VTAB CRI_mchk_ECT2_COMPU_VTAB_REF "Verbal Table" TAB_VERB 7 0 "X" 1 "<" 2 ">" 3 "<=" 4 ">=" 5 "=" 6 "<>" DEFAULT_VALUE "UNKNOWN" /end COMPU_VTAB
/begin CHARACTERISTIC CRI_mchk_ECT3 "and ECT is{CRI_mchk_ECT3&0xff=0:X}{CRI_mchk_ECT3&0xff=1:<}{CRI_mchk_ECT3&0xff=2:>}{CRI_mchk_ECT3&0xff=3:<=}{CRI_mchk_ECT3&0xff=4:>=}{CRI_mchk_ECT3&0xff=5:=}{CRI_mchk_ECT3&0xff=6:<>}" VALUE 0x00170F27 /* @ECU_Address@CRI_mchk_ECT3@0x0100AAC0@ */ ECIPP_ALIGNMENT_UBYTE 255 CRI_mchk_ECT3_COMPU_VTAB 0 255 BIT_MASK 0xff /end CHARACTERISTIC
/begin COMPU_METHOD CRI_mchk_ECT3_COMPU_VTAB "Verbal Table" TAB_VERB "%.0" "list" COMPU_TAB_REF CRI_mchk_ECT3_COMPU_VTAB_REF /end COMPU_METHOD
/begin COMPU_VTAB CRI_mchk_ECT3_COMPU_VTAB_REF "Verbal Table" TAB_VERB 7 0 "X" 1 "<" 2 ">" 3 "<=" 4 ">=" 5 "=" 6 "<>" DEFAULT_VALUE "UNKNOWN" /end COMPU_VTAB
/begin CHARACTERISTIC CRI_mchk_ECT4 "and ECT is{CRI_mchk_ECT4&0xff=0:X}{CRI_mchk_ECT4&0xff=1:<}{CRI_mchk_ECT4&0xff=2:>}{CRI_mchk_ECT4&0xff=3:<=}{CRI_mchk_ECT4&0xff=4:>=}{CRI_mchk_ECT4&0xff=5:=}{CRI_mchk_ECT4&0xff=6:<>}" VALUE 0x00170F28 /* @ECU_Address@CRI_mchk_ECT4@0x0100AAC8@ */ ECIPP_ALIGNMENT_UBYTE 255 CRI_mchk_ECT4_COMPU_VTAB 0 255 BIT_MASK 0xff /end CHARACTERISTIC
/begin COMPU_METHOD CRI_mchk_ECT4_COMPU_VTAB "Verbal Table" TAB_VERB "%.0" "list" COMPU_TAB_REF CRI_mchk_ECT4_COMPU_VTAB_REF /end COMPU_METHOD
/begin COMPU_VTAB CRI_mchk_ECT4_COMPU_VTAB_REF "Verbal Table" TAB_VERB 7 0 "X" 1 "<" 2 ">" 3 "<=" 4 ">=" 5 "=" 6 "<>" DEFAULT_VALUE "UNKNOWN" /end COMPU_VTAB
/begin CHARACTERISTIC CRI_mchk_ECT5 "and ECT is{CRI_mchk_ECT5&0xff=0:X}{CRI_mchk_ECT5&0xff=1:<}{CRI_mchk_ECT5&0xff=2:>}{CRI_mchk_ECT5&0xff=3:<=}{CRI_mchk_ECT5&0xff=4:>=}{CRI_mchk_ECT5&0xff=5:=}{CRI_mchk_ECT5&0xff=6:<>}" VALUE 0x00170F29 /* @ECU_Address@CRI_mchk_ECT5@0x0100AAD0@ */ ECIPP_ALIGNMENT_UBYTE 255 CRI_mchk_ECT5_COMPU_VTAB 0 255 BIT_MASK 0xff /end CHARACTERISTIC
/begin COMPU_METHOD CRI_mchk_ECT5_COMPU_VTAB "Verbal Table" TAB_VERB "%.0" "list" COMPU_TAB_REF CRI_mchk_ECT5_COMPU_VTAB_REF /end COMPU_METHOD
/begin COMPU_VTAB CRI_mchk_ECT5_COMPU_VTAB_REF "Verbal Table" TAB_VERB 7 0 "X" 1 "<" 2 ">" 3 "<=" 4 ">=" 5 "=" 6 "<>" DEFAULT_VALUE "UNKNOWN" /end COMPU_VTAB
/begin CHARACTERISTIC CRI_mchk_ECT6 "and ECT is{CRI_mchk_ECT6&0xff=0:X}{CRI_mchk_ECT6&0xff=1:<}{CRI_mchk_ECT6&0xff=2:>}{CRI_mchk_ECT6&0xff=3:<=}{CRI_mchk_ECT6&0xff=4:>=}{CRI_mchk_ECT6&0xff=5:=}{CRI_mchk_ECT6&0xff=6:<>}" VALUE 0x00170F2A /* @ECU_Address@CRI_mchk_ECT6@0x0100AAD8@ */ ECIPP_ALIGNMENT_UBYTE 255 CRI_mchk_ECT6_COMPU_VTAB 0 255 BIT_MASK 0xff /end CHARACTERISTIC
/begin COMPU_METHOD CRI_mchk_ECT6_COMPU_VTAB "Verbal Table" TAB_VERB "%.0" "list" COMPU_TAB_REF CRI_mchk_ECT6_COMPU_VTAB_REF /end COMPU_METHOD
/begin COMPU_VTAB CRI_mchk_ECT6_COMPU_VTAB_REF "Verbal Table" TAB_VERB 7 0 "X" 1 "<" 2 ">" 3 "<=" 4 ">=" 5 "=" 6 "<>" DEFAULT_VALUE "UNKNOWN" /end COMPU_VTAB
/begin CHARACTERISTIC CRI_mchk_ECT7 "and ECT is{CRI_mchk_ECT7&0xff=0:X}{CRI_mchk_ECT7&0xff=1:<}{CRI_mchk_ECT7&0xff=2:>}{CRI_mchk_ECT7&0xff=3:<=}{CRI_mchk_ECT7&0xff=4:>=}{CRI_mchk_ECT7&0xff=5:=}{CRI_mchk_ECT7&0xff=6:<>}" VALUE 0x00170F2B /* @ECU_Address@CRI_mchk_ECT7@0x0100AAE0@ */ ECIPP_ALIGNMENT_UBYTE 255 CRI_mchk_ECT7_COMPU_VTAB 0 255 BIT_MASK 0xff /end CHARACTERISTIC
/begin COMPU_METHOD CRI_mchk_ECT7_COMPU_VTAB "Verbal Table" TAB_VERB "%.0" "list" COMPU_TAB_REF CRI_mchk_ECT7_COMPU_VTAB_REF /end COMPU_METHOD
/begin COMPU_VTAB CRI_mchk_ECT7_COMPU_VTAB_REF "Verbal Table" TAB_VERB 7 0 "X" 1 "<" 2 ">" 3 "<=" 4 ">=" 5 "=" 6 "<>" DEFAULT_VALUE "UNKNOWN" /end COMPU_VTAB
/begin CHARACTERISTIC CRI_mchk_ECT8 "and ECT is{CRI_mchk_ECT8&0xff=0:X}{CRI_mchk_ECT8&0xff=1:<}{CRI_mchk_ECT8&0xff=2:>}{CRI_mchk_ECT8&0xff=3:<=}{CRI_mchk_ECT8&0xff=4:>=}{CRI_mchk_ECT8&0xff=5:=}{CRI_mchk_ECT8&0xff=6:<>}" VALUE 0x00170F2C /* @ECU_Address@CRI_mchk_ECT8@0x0100AAE8@ */ ECIPP_ALIGNMENT_UBYTE 255 CRI_mchk_ECT8_COMPU_VTAB 0 255 BIT_MASK 0xff /end CHARACTERISTIC
/begin COMPU_METHOD CRI_mchk_ECT8_COMPU_VTAB "Verbal Table" TAB_VERB "%.0" "list" COMPU_TAB_REF CRI_mchk_ECT8_COMPU_VTAB_REF /end COMPU_METHOD
/begin COMPU_VTAB CRI_mchk_ECT8_COMPU_VTAB_REF "Verbal Table" TAB_VERB 7 0 "X" 1 "<" 2 ">" 3 "<=" 4 ">=" 5 "=" 6 "<>" DEFAULT_VALUE "UNKNOWN" /end COMPU_VTAB
/begin CHARACTERISTIC CRI_mchk_ECT9 "and ECT is{CRI_mchk_ECT9&0xff=0:X}{CRI_mchk_ECT9&0xff=1:<}{CRI_mchk_ECT9&0xff=2:>}{CRI_mchk_ECT9&0xff=3:<=}{CRI_mchk_ECT9&0xff=4:>=}{CRI_mchk_ECT9&0xff=5:=}{CRI_mchk_ECT9&0xff=6:<>}" VALUE 0x00170F2D /* @ECU_Address@CRI_mchk_ECT9@0x0100AAF0@ */ ECIPP_ALIGNMENT_UBYTE 255 CRI_mchk_ECT9_COMPU_VTAB 0 255 BIT_MASK 0xff /end CHARACTERISTIC
/begin COMPU_METHOD CRI_mchk_ECT9_COMPU_VTAB "Verbal Table" TAB_VERB "%.0" "list" COMPU_TAB_REF CRI_mchk_ECT9_COMPU_VTAB_REF /end COMPU_METHOD
/begin COMPU_VTAB CRI_mchk_ECT9_COMPU_VTAB_REF "Verbal Table" TAB_VERB 7 0 "X" 1 "<" 2 ">" 3 "<=" 4 ">=" 5 "=" 6 "<>" DEFAULT_VALUE "UNKNOWN" /end COMPU_VTAB
/begin CHARACTERISTIC CRI_mchk_IAT0 "and IAT is{CRI_mchk_IAT0&0xff=0:X}{CRI_mchk_IAT0&0xff=1:<}{CRI_mchk_IAT0&0xff=2:>}{CRI_mchk_IAT0&0xff=3:<=}{CRI_mchk_IAT0&0xff=4:>=}{CRI_mchk_IAT0&0xff=5:=}{CRI_mchk_IAT0&0xff=6:<>}" VALUE 0x00170F2E /* @ECU_Address@CRI_mchk_IAT0@0x0100AAF8@ */ ECIPP_ALIGNMENT_UBYTE 255 CRI_mchk_IAT0_COMPU_VTAB 0 255 BIT_MASK 0xff /end CHARACTERISTIC
/begin COMPU_METHOD CRI_mchk_IAT0_COMPU_VTAB "Verbal Table" TAB_VERB "%.0" "list" COMPU_TAB_REF CRI_mchk_IAT0_COMPU_VTAB_REF /end COMPU_METHOD
/begin COMPU_VTAB CRI_mchk_IAT0_COMPU_VTAB_REF "Verbal Table" TAB_VERB 7 0 "X" 1 "<" 2 ">" 3 "<=" 4 ">=" 5 "=" 6 "<>" DEFAULT_VALUE "UNKNOWN" /end COMPU_VTAB
/begin CHARACTERISTIC CRI_mchk_IAT1 "and IAT is{CRI_mchk_IAT1&0xff=0:X}{CRI_mchk_IAT1&0xff=1:<}{CRI_mchk_IAT1&0xff=2:>}{CRI_mchk_IAT1&0xff=3:<=}{CRI_mchk_IAT1&0xff=4:>=}{CRI_mchk_IAT1&0xff=5:=}{CRI_mchk_IAT1&0xff=6:<>}" VALUE 0x00170F2F /* @ECU_Address@CRI_mchk_IAT1@0x0100AB00@ */ ECIPP_ALIGNMENT_UBYTE 255 CRI_mchk_IAT1_COMPU_VTAB 0 255 BIT_MASK 0xff /end CHARACTERISTIC
/begin COMPU_METHOD CRI_mchk_IAT1_COMPU_VTAB "Verbal Table" TAB_VERB "%.0" "list" COMPU_TAB_REF CRI_mchk_IAT1_COMPU_VTAB_REF /end COMPU_METHOD
/begin COMPU_VTAB CRI_mchk_IAT1_COMPU_VTAB_REF "Verbal Table" TAB_VERB 7 0 "X" 1 "<" 2 ">" 3 "<=" 4 ">=" 5 "=" 6 "<>" DEFAULT_VALUE "UNKNOWN" /end COMPU_VTAB
/begin CHARACTERISTIC CRI_mchk_IAT2 "and IAT is{CRI_mchk_IAT2&0xff=0:X}{CRI_mchk_IAT2&0xff=1:<}{CRI_mchk_IAT2&0xff=2:>}{CRI_mchk_IAT2&0xff=3:<=}{CRI_mchk_IAT2&0xff=4:>=}{CRI_mchk_IAT2&0xff=5:=}{CRI_mchk_IAT2&0xff=6:<>}" VALUE 0x00170F30 /* @ECU_Address@CRI_mchk_IAT2@0x0100AB08@ */ ECIPP_ALIGNMENT_UBYTE 255 CRI_mchk_IAT2_COMPU_VTAB 0 255 BIT_MASK 0xff /end CHARACTERISTIC
/begin COMPU_METHOD CRI_mchk_IAT2_COMPU_VTAB "Verbal Table" TAB_VERB "%.0" "list" COMPU_TAB_REF CRI_mchk_IAT2_COMPU_VTAB_REF /end COMPU_METHOD
/begin COMPU_VTAB CRI_mchk_IAT2_COMPU_VTAB_REF "Verbal Table" TAB_VERB 7 0 "X" 1 "<" 2 ">" 3 "<=" 4 ">=" 5 "=" 6 "<>" DEFAULT_VALUE "UNKNOWN" /end COMPU_VTAB
/begin CHARACTERISTIC CRI_mchk_IAT3 "and IAT is{CRI_mchk_IAT3&0xff=0:X}{CRI_mchk_IAT3&0xff=1:<}{CRI_mchk_IAT3&0xff=2:>}{CRI_mchk_IAT3&0xff=3:<=}{CRI_mchk_IAT3&0xff=4:>=}{CRI_mchk_IAT3&0xff=5:=}{CRI_mchk_IAT3&0xff=6:<>}" VALUE 0x00170F31 /* @ECU_Address@CRI_mchk_IAT3@0x0100AB10@ */ ECIPP_ALIGNMENT_UBYTE 255 CRI_mchk_IAT3_COMPU_VTAB 0 255 BIT_MASK 0xff /end CHARACTERISTIC
/begin COMPU_METHOD CRI_mchk_IAT3_COMPU_VTAB "Verbal Table" TAB_VERB "%.0" "list" COMPU_TAB_REF CRI_mchk_IAT3_COMPU_VTAB_REF /end COMPU_METHOD
/begin COMPU_VTAB CRI_mchk_IAT3_COMPU_VTAB_REF "Verbal Table" TAB_VERB 7 0 "X" 1 "<" 2 ">" 3 "<=" 4 ">=" 5 "=" 6 "<>" DEFAULT_VALUE "UNKNOWN" /end COMPU_VTAB
/begin CHARACTERISTIC CRI_mchk_IAT4 "and IAT is{CRI_mchk_IAT4&0xff=0:X}{CRI_mchk_IAT4&0xff=1:<}{CRI_mchk_IAT4&0xff=2:>}{CRI_mchk_IAT4&0xff=3:<=}{CRI_mchk_IAT4&0xff=4:>=}{CRI_mchk_IAT4&0xff=5:=}{CRI_mchk_IAT4&0xff=6:<>}" VALUE 0x00170F32 /* @ECU_Address@CRI_mchk_IAT4@0x0100AB18@ */ ECIPP_ALIGNMENT_UBYTE 255 CRI_mchk_IAT4_COMPU_VTAB 0 255 BIT_MASK 0xff /end CHARACTERISTIC
/begin COMPU_METHOD CRI_mchk_IAT4_COMPU_VTAB "Verbal Table" TAB_VERB "%.0" "list" COMPU_TAB_REF CRI_mchk_IAT4_COMPU_VTAB_REF /end COMPU_METHOD
/begin COMPU_VTAB CRI_mchk_IAT4_COMPU_VTAB_REF "Verbal Table" TAB_VERB 7 0 "X" 1 "<" 2 ">" 3 "<=" 4 ">=" 5 "=" 6 "<>" DEFAULT_VALUE "UNKNOWN" /end COMPU_VTAB
/begin CHARACTERISTIC CRI_mchk_IAT5 "and IAT is{CRI_mchk_IAT5&0xff=0:X}{CRI_mchk_IAT5&0xff=1:<}{CRI_mchk_IAT5&0xff=2:>}{CRI_mchk_IAT5&0xff=3:<=}{CRI_mchk_IAT5&0xff=4:>=}{CRI_mchk_IAT5&0xff=5:=}{CRI_mchk_IAT5&0xff=6:<>}" VALUE 0x00170F33 /* @ECU_Address@CRI_mchk_IAT5@0x0100AB20@ */ ECIPP_ALIGNMENT_UBYTE 255 CRI_mchk_IAT5_COMPU_VTAB 0 255 BIT_MASK 0xff /end CHARACTERISTIC
/begin COMPU_METHOD CRI_mchk_IAT5_COMPU_VTAB "Verbal Table" TAB_VERB "%.0" "list" COMPU_TAB_REF CRI_mchk_IAT5_COMPU_VTAB_REF /end COMPU_METHOD
/begin COMPU_VTAB CRI_mchk_IAT5_COMPU_VTAB_REF "Verbal Table" TAB_VERB 7 0 "X" 1 "<" 2 ">" 3 "<=" 4 ">=" 5 "=" 6 "<>" DEFAULT_VALUE "UNKNOWN" /end COMPU_VTAB
/begin CHARACTERISTIC CRI_mchk_IAT6 "and IAT is{CRI_mchk_IAT6&0xff=0:X}{CRI_mchk_IAT6&0xff=1:<}{CRI_mchk_IAT6&0xff=2:>}{CRI_mchk_IAT6&0xff=3:<=}{CRI_mchk_IAT6&0xff=4:>=}{CRI_mchk_IAT6&0xff=5:=}{CRI_mchk_IAT6&0xff=6:<>}" VALUE 0x00170F34 /* @ECU_Address@CRI_mchk_IAT6@0x0100AB28@ */ ECIPP_ALIGNMENT_UBYTE 255 CRI_mchk_IAT6_COMPU_VTAB 0 255 BIT_MASK 0xff /end CHARACTERISTIC
/begin COMPU_METHOD CRI_mchk_IAT6_COMPU_VTAB "Verbal Table" TAB_VERB "%.0" "list" COMPU_TAB_REF CRI_mchk_IAT6_COMPU_VTAB_REF /end COMPU_METHOD
/begin COMPU_VTAB CRI_mchk_IAT6_COMPU_VTAB_REF "Verbal Table" TAB_VERB 7 0 "X" 1 "<" 2 ">" 3 "<=" 4 ">=" 5 "=" 6 "<>" DEFAULT_VALUE "UNKNOWN" /end COMPU_VTAB
/begin CHARACTERISTIC CRI_mchk_IAT7 "and IAT is{CRI_mchk_IAT7&0xff=0:X}{CRI_mchk_IAT7&0xff=1:<}{CRI_mchk_IAT7&0xff=2:>}{CRI_mchk_IAT7&0xff=3:<=}{CRI_mchk_IAT7&0xff=4:>=}{CRI_mchk_IAT7&0xff=5:=}{CRI_mchk_IAT7&0xff=6:<>}" VALUE 0x00170F35 /* @ECU_Address@CRI_mchk_IAT7@0x0100AB30@ */ ECIPP_ALIGNMENT_UBYTE 255 CRI_mchk_IAT7_COMPU_VTAB 0 255 BIT_MASK 0xff /end CHARACTERISTIC
/begin COMPU_METHOD CRI_mchk_IAT7_COMPU_VTAB "Verbal Table" TAB_VERB "%.0" "list" COMPU_TAB_REF CRI_mchk_IAT7_COMPU_VTAB_REF /end COMPU_METHOD
/begin COMPU_VTAB CRI_mchk_IAT7_COMPU_VTAB_REF "Verbal Table" TAB_VERB 7 0 "X" 1 "<" 2 ">" 3 "<=" 4 ">=" 5 "=" 6 "<>" DEFAULT_VALUE "UNKNOWN" /end COMPU_VTAB
/begin CHARACTERISTIC CRI_mchk_IAT8 "and IAT is{CRI_mchk_IAT8&0xff=0:X}{CRI_mchk_IAT8&0xff=1:<}{CRI_mchk_IAT8&0xff=2:>}{CRI_mchk_IAT8&0xff=3:<=}{CRI_mchk_IAT8&0xff=4:>=}{CRI_mchk_IAT8&0xff=5:=}{CRI_mchk_IAT8&0xff=6:<>}" VALUE 0x00170F36 /* @ECU_Address@CRI_mchk_IAT8@0x0100AB38@ */ ECIPP_ALIGNMENT_UBYTE 255 CRI_mchk_IAT8_COMPU_VTAB 0 255 BIT_MASK 0xff /end CHARACTERISTIC
/begin COMPU_METHOD CRI_mchk_IAT8_COMPU_VTAB "Verbal Table" TAB_VERB "%.0" "list" COMPU_TAB_REF CRI_mchk_IAT8_COMPU_VTAB_REF /end COMPU_METHOD
/begin COMPU_VTAB CRI_mchk_IAT8_COMPU_VTAB_REF "Verbal Table" TAB_VERB 7 0 "X" 1 "<" 2 ">" 3 "<=" 4 ">=" 5 "=" 6 "<>" DEFAULT_VALUE "UNKNOWN" /end COMPU_VTAB
/begin CHARACTERISTIC CRI_mchk_IAT9 "and IAT is{CRI_mchk_IAT9&0xff=0:X}{CRI_mchk_IAT9&0xff=1:<}{CRI_mchk_IAT9&0xff=2:>}{CRI_mchk_IAT9&0xff=3:<=}{CRI_mchk_IAT9&0xff=4:>=}{CRI_mchk_IAT9&0xff=5:=}{CRI_mchk_IAT9&0xff=6:<>}" VALUE 0x00170F37 /* @ECU_Address@CRI_mchk_IAT9@0x0100AB40@ */ ECIPP_ALIGNMENT_UBYTE 255 CRI_mchk_IAT9_COMPU_VTAB 0 255 BIT_MASK 0xff /end CHARACTERISTIC
/begin COMPU_METHOD CRI_mchk_IAT9_COMPU_VTAB "Verbal Table" TAB_VERB "%.0" "list" COMPU_TAB_REF CRI_mchk_IAT9_COMPU_VTAB_REF /end COMPU_METHOD
/begin COMPU_VTAB CRI_mchk_IAT9_COMPU_VTAB_REF "Verbal Table" TAB_VERB 7 0 "X" 1 "<" 2 ">" 3 "<=" 4 ">=" 5 "=" 6 "<>" DEFAULT_VALUE "UNKNOWN" /end COMPU_VTAB
/begin CHARACTERISTIC CRI_mchk_DOCT0 "and DOCT is{CRI_mchk_DOCT0&0xff=0:X}{CRI_mchk_DOCT0&0xff=1:<}{CRI_mchk_DOCT0&0xff=2:>}{CRI_mchk_DOCT0&0xff=3:<=}{CRI_mchk_DOCT0&0xff=4:>=}{CRI_mchk_DOCT0&0xff=5:=}{CRI_mchk_DOCT0&0xff=6:<>}" VALUE 0x00170F10 /* @ECU_Address@CRI_mchk_DOCT0@0x0100AB48@ */ ECIPP_ALIGNMENT_UBYTE 255 CRI_mchk_DOCT0_COMPU_VTAB 0 255 BIT_MASK 0xff /end CHARACTERISTIC
/begin COMPU_METHOD CRI_mchk_DOCT0_COMPU_VTAB "Verbal Table" TAB_VERB "%.0" "list" COMPU_TAB_REF CRI_mchk_DOCT0_COMPU_VTAB_REF /end COMPU_METHOD
/begin COMPU_VTAB CRI_mchk_DOCT0_COMPU_VTAB_REF "Verbal Table" TAB_VERB 7 0 "X" 1 "<" 2 ">" 3 "<=" 4 ">=" 5 "=" 6 "<>" DEFAULT_VALUE "UNKNOWN" /end COMPU_VTAB
/begin CHARACTERISTIC CRI_mchk_DOCT1 "and DOCT is{CRI_mchk_DOCT1&0xff=0:X}{CRI_mchk_DOCT1&0xff=1:<}{CRI_mchk_DOCT1&0xff=2:>}{CRI_mchk_DOCT1&0xff=3:<=}{CRI_mchk_DOCT1&0xff=4:>=}{CRI_mchk_DOCT1&0xff=5:=}{CRI_mchk_DOCT1&0xff=6:<>}" VALUE 0x00170F11 /* @ECU_Address@CRI_mchk_DOCT1@0x0100AB50@ */ ECIPP_ALIGNMENT_UBYTE 255 CRI_mchk_DOCT1_COMPU_VTAB 0 255 BIT_MASK 0xff /end CHARACTERISTIC
/begin COMPU_METHOD CRI_mchk_DOCT1_COMPU_VTAB "Verbal Table" TAB_VERB "%.0" "list" COMPU_TAB_REF CRI_mchk_DOCT1_COMPU_VTAB_REF /end COMPU_METHOD
/begin COMPU_VTAB CRI_mchk_DOCT1_COMPU_VTAB_REF "Verbal Table" TAB_VERB 7 0 "X" 1 "<" 2 ">" 3 "<=" 4 ">=" 5 "=" 6 "<>" DEFAULT_VALUE "UNKNOWN" /end COMPU_VTAB
/begin CHARACTERISTIC CRI_mchk_DOCT2 "and DOCT is{CRI_mchk_DOCT2&0xff=0:X}{CRI_mchk_DOCT2&0xff=1:<}{CRI_mchk_DOCT2&0xff=2:>}{CRI_mchk_DOCT2&0xff=3:<=}{CRI_mchk_DOCT2&0xff=4:>=}{CRI_mchk_DOCT2&0xff=5:=}{CRI_mchk_DOCT2&0xff=6:<>}" VALUE 0x00170F12 /* @ECU_Address@CRI_mchk_DOCT2@0x0100AB58@ */ ECIPP_ALIGNMENT_UBYTE 255 CRI_mchk_DOCT2_COMPU_VTAB 0 255 BIT_MASK 0xff /end CHARACTERISTIC
/begin COMPU_METHOD CRI_mchk_DOCT2_COMPU_VTAB "Verbal Table" TAB_VERB "%.0" "list" COMPU_TAB_REF CRI_mchk_DOCT2_COMPU_VTAB_REF /end COMPU_METHOD
/begin COMPU_VTAB CRI_mchk_DOCT2_COMPU_VTAB_REF "Verbal Table" TAB_VERB 7 0 "X" 1 "<" 2 ">" 3 "<=" 4 ">=" 5 "=" 6 "<>" DEFAULT_VALUE "UNKNOWN" /end COMPU_VTAB
/begin CHARACTERISTIC CRI_mchk_DOCT3 "and DOCT is{CRI_mchk_DOCT3&0xff=0:X}{CRI_mchk_DOCT3&0xff=1:<}{CRI_mchk_DOCT3&0xff=2:>}{CRI_mchk_DOCT3&0xff=3:<=}{CRI_mchk_DOCT3&0xff=4:>=}{CRI_mchk_DOCT3&0xff=5:=}{CRI_mchk_DOCT3&0xff=6:<>}" VALUE 0x00170F13 /* @ECU_Address@CRI_mchk_DOCT3@0x0100AB60@ */ ECIPP_ALIGNMENT_UBYTE 255 CRI_mchk_DOCT3_COMPU_VTAB 0 255 BIT_MASK 0xff /end CHARACTERISTIC
/begin COMPU_METHOD CRI_mchk_DOCT3_COMPU_VTAB "Verbal Table" TAB_VERB "%.0" "list" COMPU_TAB_REF CRI_mchk_DOCT3_COMPU_VTAB_REF /end COMPU_METHOD
/begin COMPU_VTAB CRI_mchk_DOCT3_COMPU_VTAB_REF "Verbal Table" TAB_VERB 7 0 "X" 1 "<" 2 ">" 3 "<=" 4 ">=" 5 "=" 6 "<>" DEFAULT_VALUE "UNKNOWN" /end COMPU_VTAB
/begin CHARACTERISTIC CRI_mchk_DOCT4 "and DOCT is{CRI_mchk_DOCT4&0xff=0:X}{CRI_mchk_DOCT4&0xff=1:<}{CRI_mchk_DOCT4&0xff=2:>}{CRI_mchk_DOCT4&0xff=3:<=}{CRI_mchk_DOCT4&0xff=4:>=}{CRI_mchk_DOCT4&0xff=5:=}{CRI_mchk_DOCT4&0xff=6:<>}" VALUE 0x00170F14 /* @ECU_Address@CRI_mchk_DOCT4@0x0100AB68@ */ ECIPP_ALIGNMENT_UBYTE 255 CRI_mchk_DOCT4_COMPU_VTAB 0 255 BIT_MASK 0xff /end CHARACTERISTIC
/begin COMPU_METHOD CRI_mchk_DOCT4_COMPU_VTAB "Verbal Table" TAB_VERB "%.0" "list" COMPU_TAB_REF CRI_mchk_DOCT4_COMPU_VTAB_REF /end COMPU_METHOD
/begin COMPU_VTAB CRI_mchk_DOCT4_COMPU_VTAB_REF "Verbal Table" TAB_VERB 7 0 "X" 1 "<" 2 ">" 3 "<=" 4 ">=" 5 "=" 6 "<>" DEFAULT_VALUE "UNKNOWN" /end COMPU_VTAB
/begin CHARACTERISTIC CRI_mchk_DOCT5 "and DOCT is{CRI_mchk_DOCT5&0xff=0:X}{CRI_mchk_DOCT5&0xff=1:<}{CRI_mchk_DOCT5&0xff=2:>}{CRI_mchk_DOCT5&0xff=3:<=}{CRI_mchk_DOCT5&0xff=4:>=}{CRI_mchk_DOCT5&0xff=5:=}{CRI_mchk_DOCT5&0xff=6:<>}" VALUE 0x00170F15 /* @ECU_Address@CRI_mchk_DOCT5@0x0100AB70@ */ ECIPP_ALIGNMENT_UBYTE 255 CRI_mchk_DOCT5_COMPU_VTAB 0 255 BIT_MASK 0xff /end CHARACTERISTIC
/begin COMPU_METHOD CRI_mchk_DOCT5_COMPU_VTAB "Verbal Table" TAB_VERB "%.0" "list" COMPU_TAB_REF CRI_mchk_DOCT5_COMPU_VTAB_REF /end COMPU_METHOD
/begin COMPU_VTAB CRI_mchk_DOCT5_COMPU_VTAB_REF "Verbal Table" TAB_VERB 7 0 "X" 1 "<" 2 ">" 3 "<=" 4 ">=" 5 "=" 6 "<>" DEFAULT_VALUE "UNKNOWN" /end COMPU_VTAB
/begin CHARACTERISTIC CRI_mchk_DOCT6 "and DOCT is{CRI_mchk_DOCT6&0xff=0:X}{CRI_mchk_DOCT6&0xff=1:<}{CRI_mchk_DOCT6&0xff=2:>}{CRI_mchk_DOCT6&0xff=3:<=}{CRI_mchk_DOCT6&0xff=4:>=}{CRI_mchk_DOCT6&0xff=5:=}{CRI_mchk_DOCT6&0xff=6:<>}" VALUE 0x00170F16 /* @ECU_Address@CRI_mchk_DOCT6@0x0100AB78@ */ ECIPP_ALIGNMENT_UBYTE 255 CRI_mchk_DOCT6_COMPU_VTAB 0 255 BIT_MASK 0xff /end CHARACTERISTIC
/begin COMPU_METHOD CRI_mchk_DOCT6_COMPU_VTAB "Verbal Table" TAB_VERB "%.0" "list" COMPU_TAB_REF CRI_mchk_DOCT6_COMPU_VTAB_REF /end COMPU_METHOD
/begin COMPU_VTAB CRI_mchk_DOCT6_COMPU_VTAB_REF "Verbal Table" TAB_VERB 7 0 "X" 1 "<" 2 ">" 3 "<=" 4 ">=" 5 "=" 6 "<>" DEFAULT_VALUE "UNKNOWN" /end COMPU_VTAB
/begin CHARACTERISTIC CRI_mchk_DOCT7 "and DOCT is{CRI_mchk_DOCT7&0xff=0:X}{CRI_mchk_DOCT7&0xff=1:<}{CRI_mchk_DOCT7&0xff=2:>}{CRI_mchk_DOCT7&0xff=3:<=}{CRI_mchk_DOCT7&0xff=4:>=}{CRI_mchk_DOCT7&0xff=5:=}{CRI_mchk_DOCT7&0xff=6:<>}" VALUE 0x00170F17 /* @ECU_Address@CRI_mchk_DOCT7@0x0100AB80@ */ ECIPP_ALIGNMENT_UBYTE 255 CRI_mchk_DOCT7_COMPU_VTAB 0 255 BIT_MASK 0xff /end CHARACTERISTIC
/begin COMPU_METHOD CRI_mchk_DOCT7_COMPU_VTAB "Verbal Table" TAB_VERB "%.0" "list" COMPU_TAB_REF CRI_mchk_DOCT7_COMPU_VTAB_REF /end COMPU_METHOD
/begin COMPU_VTAB CRI_mchk_DOCT7_COMPU_VTAB_REF "Verbal Table" TAB_VERB 7 0 "X" 1 "<" 2 ">" 3 "<=" 4 ">=" 5 "=" 6 "<>" DEFAULT_VALUE "UNKNOWN" /end COMPU_VTAB
/begin CHARACTERISTIC CRI_mchk_DOCT8 "and DOCT is{CRI_mchk_DOCT8&0xff=0:X}{CRI_mchk_DOCT8&0xff=1:<}{CRI_mchk_DOCT8&0xff=2:>}{CRI_mchk_DOCT8&0xff=3:<=}{CRI_mchk_DOCT8&0xff=4:>=}{CRI_mchk_DOCT8&0xff=5:=}{CRI_mchk_DOCT8&0xff=6:<>}" VALUE 0x00170F18 /* @ECU_Address@CRI_mchk_DOCT8@0x0100AB88@ */ ECIPP_ALIGNMENT_UBYTE 255 CRI_mchk_DOCT8_COMPU_VTAB 0 255 BIT_MASK 0xff /end CHARACTERISTIC
/begin COMPU_METHOD CRI_mchk_DOCT8_COMPU_VTAB "Verbal Table" TAB_VERB "%.0" "list" COMPU_TAB_REF CRI_mchk_DOCT8_COMPU_VTAB_REF /end COMPU_METHOD
/begin COMPU_VTAB CRI_mchk_DOCT8_COMPU_VTAB_REF "Verbal Table" TAB_VERB 7 0 "X" 1 "<" 2 ">" 3 "<=" 4 ">=" 5 "=" 6 "<>" DEFAULT_VALUE "UNKNOWN" /end COMPU_VTAB
/begin CHARACTERISTIC CRI_mchk_DOCT9 "and DOCT is{CRI_mchk_DOCT9&0xff=0:X}{CRI_mchk_DOCT9&0xff=1:<}{CRI_mchk_DOCT9&0xff=2:>}{CRI_mchk_DOCT9&0xff=3:<=}{CRI_mchk_DOCT9&0xff=4:>=}{CRI_mchk_DOCT9&0xff=5:=}{CRI_mchk_DOCT9&0xff=6:<>}" VALUE 0x00170F19 /* @ECU_Address@CRI_mchk_DOCT9@0x0100AB90@ */ ECIPP_ALIGNMENT_UBYTE 255 CRI_mchk_DOCT9_COMPU_VTAB 0 255 BIT_MASK 0xff /end CHARACTERISTIC
/begin COMPU_METHOD CRI_mchk_DOCT9_COMPU_VTAB "Verbal Table" TAB_VERB "%.0" "list" COMPU_TAB_REF CRI_mchk_DOCT9_COMPU_VTAB_REF /end COMPU_METHOD
/begin COMPU_VTAB CRI_mchk_DOCT9_COMPU_VTAB_REF "Verbal Table" TAB_VERB 7 0 "X" 1 "<" 2 ">" 3 "<=" 4 ">=" 5 "=" 6 "<>" DEFAULT_VALUE "UNKNOWN" /end COMPU_VTAB
/begin CHARACTERISTIC CRI_mchk_DPFT0 "and DPFT is{CRI_mchk_DPFT0&0xff=0:X}{CRI_mchk_DPFT0&0xff=1:<}{CRI_mchk_DPFT0&0xff=2:>}{CRI_mchk_DPFT0&0xff=3:<=}{CRI_mchk_DPFT0&0xff=4:>=}{CRI_mchk_DPFT0&0xff=5:=}{CRI_mchk_DPFT0&0xff=6:<>}" VALUE 0x00170F1A /* @ECU_Address@CRI_mchk_DPFT0@0x0100AB98@ */ ECIPP_ALIGNMENT_UBYTE 255 CRI_mchk_DPFT0_COMPU_VTAB 0 255 BIT_MASK 0xff /end CHARACTERISTIC
/begin COMPU_METHOD CRI_mchk_DPFT0_COMPU_VTAB "Verbal Table" TAB_VERB "%.0" "list" COMPU_TAB_REF CRI_mchk_DPFT0_COMPU_VTAB_REF /end COMPU_METHOD
/begin COMPU_VTAB CRI_mchk_DPFT0_COMPU_VTAB_REF "Verbal Table" TAB_VERB 7 0 "X" 1 "<" 2 ">" 3 "<=" 4 ">=" 5 "=" 6 "<>" DEFAULT_VALUE "UNKNOWN" /end COMPU_VTAB
/begin CHARACTERISTIC CRI_mchk_DPFT1 "and DPFT is{CRI_mchk_DPFT1&0xff=0:X}{CRI_mchk_DPFT1&0xff=1:<}{CRI_mchk_DPFT1&0xff=2:>}{CRI_mchk_DPFT1&0xff=3:<=}{CRI_mchk_DPFT1&0xff=4:>=}{CRI_mchk_DPFT1&0xff=5:=}{CRI_mchk_DPFT1&0xff=6:<>}" VALUE 0x00170F1B /* @ECU_Address@CRI_mchk_DPFT1@0x0100ABA0@ */ ECIPP_ALIGNMENT_UBYTE 255 CRI_mchk_DPFT1_COMPU_VTAB 0 255 BIT_MASK 0xff /end CHARACTERISTIC
/begin COMPU_METHOD CRI_mchk_DPFT1_COMPU_VTAB "Verbal Table" TAB_VERB "%.0" "list" COMPU_TAB_REF CRI_mchk_DPFT1_COMPU_VTAB_REF /end COMPU_METHOD
/begin COMPU_VTAB CRI_mchk_DPFT1_COMPU_VTAB_REF "Verbal Table" TAB_VERB 7 0 "X" 1 "<" 2 ">" 3 "<=" 4 ">=" 5 "=" 6 "<>" DEFAULT_VALUE "UNKNOWN" /end COMPU_VTAB
/begin CHARACTERISTIC CRI_mchk_DPFT2 "and DPFT is{CRI_mchk_DPFT2&0xff=0:X}{CRI_mchk_DPFT2&0xff=1:<}{CRI_mchk_DPFT2&0xff=2:>}{CRI_mchk_DPFT2&0xff=3:<=}{CRI_mchk_DPFT2&0xff=4:>=}{CRI_mchk_DPFT2&0xff=5:=}{CRI_mchk_DPFT2&0xff=6:<>}" VALUE 0x00170F1C /* @ECU_Address@CRI_mchk_DPFT2@0x0100ABA8@ */ ECIPP_ALIGNMENT_UBYTE 255 CRI_mchk_DPFT2_COMPU_VTAB 0 255 BIT_MASK 0xff /end CHARACTERISTIC
/begin COMPU_METHOD CRI_mchk_DPFT2_COMPU_VTAB "Verbal Table" TAB_VERB "%.0" "list" COMPU_TAB_REF CRI_mchk_DPFT2_COMPU_VTAB_REF /end COMPU_METHOD
/begin COMPU_VTAB CRI_mchk_DPFT2_COMPU_VTAB_REF "Verbal Table" TAB_VERB 7 0 "X" 1 "<" 2 ">" 3 "<=" 4 ">=" 5 "=" 6 "<>" DEFAULT_VALUE "UNKNOWN" /end COMPU_VTAB
/begin CHARACTERISTIC CRI_mchk_DPFT3 "and DPFT is{CRI_mchk_DPFT3&0xff=0:X}{CRI_mchk_DPFT3&0xff=1:<}{CRI_mchk_DPFT3&0xff=2:>}{CRI_mchk_DPFT3&0xff=3:<=}{CRI_mchk_DPFT3&0xff=4:>=}{CRI_mchk_DPFT3&0xff=5:=}{CRI_mchk_DPFT3&0xff=6:<>}" VALUE 0x00170F1D /* @ECU_Address@CRI_mchk_DPFT3@0x0100ABB0@ */ ECIPP_ALIGNMENT_UBYTE 255 CRI_mchk_DPFT3_COMPU_VTAB 0 255 BIT_MASK 0xff /end CHARACTERISTIC
/begin COMPU_METHOD CRI_mchk_DPFT3_COMPU_VTAB "Verbal Table" TAB_VERB "%.0" "list" COMPU_TAB_REF CRI_mchk_DPFT3_COMPU_VTAB_REF /end COMPU_METHOD
/begin COMPU_VTAB CRI_mchk_DPFT3_COMPU_VTAB_REF "Verbal Table" TAB_VERB 7 0 "X" 1 "<" 2 ">" 3 "<=" 4 ">=" 5 "=" 6 "<>" DEFAULT_VALUE "UNKNOWN" /end COMPU_VTAB
/begin CHARACTERISTIC CRI_mchk_DPFT4 "and DPFT is{CRI_mchk_DPFT4&0xff=0:X}{CRI_mchk_DPFT4&0xff=1:<}{CRI_mchk_DPFT4&0xff=2:>}{CRI_mchk_DPFT4&0xff=3:<=}{CRI_mchk_DPFT4&0xff=4:>=}{CRI_mchk_DPFT4&0xff=5:=}{CRI_mchk_DPFT4&0xff=6:<>}" VALUE 0x00170F1E /* @ECU_Address@CRI_mchk_DPFT4@0x0100ABB8@ */ ECIPP_ALIGNMENT_UBYTE 255 CRI_mchk_DPFT4_COMPU_VTAB 0 255 BIT_MASK 0xff /end CHARACTERISTIC
/begin COMPU_METHOD CRI_mchk_DPFT4_COMPU_VTAB "Verbal Table" TAB_VERB "%.0" "list" COMPU_TAB_REF CRI_mchk_DPFT4_COMPU_VTAB_REF /end COMPU_METHOD
/begin COMPU_VTAB CRI_mchk_DPFT4_COMPU_VTAB_REF "Verbal Table" TAB_VERB 7 0 "X" 1 "<" 2 ">" 3 "<=" 4 ">=" 5 "=" 6 "<>" DEFAULT_VALUE "UNKNOWN" /end COMPU_VTAB
/begin CHARACTERISTIC CRI_mchk_DPFT5 "and DPFT is{CRI_mchk_DPFT5&0xff=0:X}{CRI_mchk_DPFT5&0xff=1:<}{CRI_mchk_DPFT5&0xff=2:>}{CRI_mchk_DPFT5&0xff=3:<=}{CRI_mchk_DPFT5&0xff=4:>=}{CRI_mchk_DPFT5&0xff=5:=}{CRI_mchk_DPFT5&0xff=6:<>}" VALUE 0x00170F1F /* @ECU_Address@CRI_mchk_DPFT5@0x0100ABC0@ */ ECIPP_ALIGNMENT_UBYTE 255 CRI_mchk_DPFT5_COMPU_VTAB 0 255 BIT_MASK 0xff /end CHARACTERISTIC
/begin COMPU_METHOD CRI_mchk_DPFT5_COMPU_VTAB "Verbal Table" TAB_VERB "%.0" "list" COMPU_TAB_REF CRI_mchk_DPFT5_COMPU_VTAB_REF /end COMPU_METHOD
/begin COMPU_VTAB CRI_mchk_DPFT5_COMPU_VTAB_REF "Verbal Table" TAB_VERB 7 0 "X" 1 "<" 2 ">" 3 "<=" 4 ">=" 5 "=" 6 "<>" DEFAULT_VALUE "UNKNOWN" /end COMPU_VTAB
/begin CHARACTERISTIC CRI_mchk_DPFT6 "and DPFT is{CRI_mchk_DPFT6&0xff=0:X}{CRI_mchk_DPFT6&0xff=1:<}{CRI_mchk_DPFT6&0xff=2:>}{CRI_mchk_DPFT6&0xff=3:<=}{CRI_mchk_DPFT6&0xff=4:>=}{CRI_mchk_DPFT6&0xff=5:=}{CRI_mchk_DPFT6&0xff=6:<>}" VALUE 0x00170F20 /* @ECU_Address@CRI_mchk_DPFT6@0x0100ABC8@ */ ECIPP_ALIGNMENT_UBYTE 255 CRI_mchk_DPFT6_COMPU_VTAB 0 255 BIT_MASK 0xff /end CHARACTERISTIC
/begin COMPU_METHOD CRI_mchk_DPFT6_COMPU_VTAB "Verbal Table" TAB_VERB "%.0" "list" COMPU_TAB_REF CRI_mchk_DPFT6_COMPU_VTAB_REF /end COMPU_METHOD
/begin COMPU_VTAB CRI_mchk_DPFT6_COMPU_VTAB_REF "Verbal Table" TAB_VERB 7 0 "X" 1 "<" 2 ">" 3 "<=" 4 ">=" 5 "=" 6 "<>" DEFAULT_VALUE "UNKNOWN" /end COMPU_VTAB
/begin CHARACTERISTIC CRI_mchk_DPFT7 "and DPFT is{CRI_mchk_DPFT7&0xff=0:X}{CRI_mchk_DPFT7&0xff=1:<}{CRI_mchk_DPFT7&0xff=2:>}{CRI_mchk_DPFT7&0xff=3:<=}{CRI_mchk_DPFT7&0xff=4:>=}{CRI_mchk_DPFT7&0xff=5:=}{CRI_mchk_DPFT7&0xff=6:<>}" VALUE 0x00170F21 /* @ECU_Address@CRI_mchk_DPFT7@0x0100ABD0@ */ ECIPP_ALIGNMENT_UBYTE 255 CRI_mchk_DPFT7_COMPU_VTAB 0 255 BIT_MASK 0xff /end CHARACTERISTIC
/begin COMPU_METHOD CRI_mchk_DPFT7_COMPU_VTAB "Verbal Table" TAB_VERB "%.0" "list" COMPU_TAB_REF CRI_mchk_DPFT7_COMPU_VTAB_REF /end COMPU_METHOD
/begin COMPU_VTAB CRI_mchk_DPFT7_COMPU_VTAB_REF "Verbal Table" TAB_VERB 7 0 "X" 1 "<" 2 ">" 3 "<=" 4 ">=" 5 "=" 6 "<>" DEFAULT_VALUE "UNKNOWN" /end COMPU_VTAB
/begin CHARACTERISTIC CRI_mchk_DPFT8 "and DPFT is{CRI_mchk_DPFT8&0xff=0:X}{CRI_mchk_DPFT8&0xff=1:<}{CRI_mchk_DPFT8&0xff=2:>}{CRI_mchk_DPFT8&0xff=3:<=}{CRI_mchk_DPFT8&0xff=4:>=}{CRI_mchk_DPFT8&0xff=5:=}{CRI_mchk_DPFT8&0xff=6:<>}" VALUE 0x00170F22 /* @ECU_Address@CRI_mchk_DPFT8@0x0100ABD8@ */ ECIPP_ALIGNMENT_UBYTE 255 CRI_mchk_DPFT8_COMPU_VTAB 0 255 BIT_MASK 0xff /end CHARACTERISTIC
/begin COMPU_METHOD CRI_mchk_DPFT8_COMPU_VTAB "Verbal Table" TAB_VERB "%.0" "list" COMPU_TAB_REF CRI_mchk_DPFT8_COMPU_VTAB_REF /end COMPU_METHOD
/begin COMPU_VTAB CRI_mchk_DPFT8_COMPU_VTAB_REF "Verbal Table" TAB_VERB 7 0 "X" 1 "<" 2 ">" 3 "<=" 4 ">=" 5 "=" 6 "<>" DEFAULT_VALUE "UNKNOWN" /end COMPU_VTAB
/begin CHARACTERISTIC CRI_mchk_DPFT9 "and DPFT is{CRI_mchk_DPFT9&0xff=0:X}{CRI_mchk_DPFT9&0xff=1:<}{CRI_mchk_DPFT9&0xff=2:>}{CRI_mchk_DPFT9&0xff=3:<=}{CRI_mchk_DPFT9&0xff=4:>=}{CRI_mchk_DPFT9&0xff=5:=}{CRI_mchk_DPFT9&0xff=6:<>}" VALUE 0x00170F23 /* @ECU_Address@CRI_mchk_DPFT9@0x0100ABE0@ */ ECIPP_ALIGNMENT_UBYTE 255 CRI_mchk_DPFT9_COMPU_VTAB 0 255 BIT_MASK 0xff /end CHARACTERISTIC
/begin COMPU_METHOD CRI_mchk_DPFT9_COMPU_VTAB "Verbal Table" TAB_VERB "%.0" "list" COMPU_TAB_REF CRI_mchk_DPFT9_COMPU_VTAB_REF /end COMPU_METHOD
/begin COMPU_VTAB CRI_mchk_DPFT9_COMPU_VTAB_REF "Verbal Table" TAB_VERB 7 0 "X" 1 "<" 2 ">" 3 "<=" 4 ">=" 5 "=" 6 "<>" DEFAULT_VALUE "UNKNOWN" /end COMPU_VTAB
/begin CHARACTERISTIC CRI_mchk_soot0 "and soot loading is{CRI_mchk_soot0&0xff=0:X}{CRI_mchk_soot0&0xff=1:<}{CRI_mchk_soot0&0xff=2:>}{CRI_mchk_soot0&0xff=3:<=}{CRI_mchk_soot0&0xff=4:>=}{CRI_mchk_soot0&0xff=5:=}{CRI_mchk_soot0&0xff=6:<>}" VALUE 0x00170F4C /* @ECU_Address@CRI_mchk_soot0@0x0100ABE8@ */ ECIPP_ALIGNMENT_UBYTE 255 CRI_mchk_soot0_COMPU_VTAB 0 255 BIT_MASK 0xff /end CHARACTERISTIC
/begin COMPU_METHOD CRI_mchk_soot0_COMPU_VTAB "Verbal Table" TAB_VERB "%.0" "list" COMPU_TAB_REF CRI_mchk_soot0_COMPU_VTAB_REF /end COMPU_METHOD
/begin COMPU_VTAB CRI_mchk_soot0_COMPU_VTAB_REF "Verbal Table" TAB_VERB 7 0 "X" 1 "<" 2 ">" 3 "<=" 4 ">=" 5 "=" 6 "<>" DEFAULT_VALUE "UNKNOWN" /end COMPU_VTAB
/begin CHARACTERISTIC CRI_mchk_soot1 "and soot loading is{CRI_mchk_soot1&0xff=0:X}{CRI_mchk_soot1&0xff=1:<}{CRI_mchk_soot1&0xff=2:>}{CRI_mchk_soot1&0xff=3:<=}{CRI_mchk_soot1&0xff=4:>=}{CRI_mchk_soot1&0xff=5:=}{CRI_mchk_soot1&0xff=6:<>}" VALUE 0x00170F4D /* @ECU_Address@CRI_mchk_soot1@0x0100ABF0@ */ ECIPP_ALIGNMENT_UBYTE 255 CRI_mchk_soot1_COMPU_VTAB 0 255 BIT_MASK 0xff /end CHARACTERISTIC
/begin COMPU_METHOD CRI_mchk_soot1_COMPU_VTAB "Verbal Table" TAB_VERB "%.0" "list" COMPU_TAB_REF CRI_mchk_soot1_COMPU_VTAB_REF /end COMPU_METHOD
/begin COMPU_VTAB CRI_mchk_soot1_COMPU_VTAB_REF "Verbal Table" TAB_VERB 7 0 "X" 1 "<" 2 ">" 3 "<=" 4 ">=" 5 "=" 6 "<>" DEFAULT_VALUE "UNKNOWN" /end COMPU_VTAB
/begin CHARACTERISTIC CRI_mchk_soot2 "and soot loading is{CRI_mchk_soot2&0xff=0:X}{CRI_mchk_soot2&0xff=1:<}{CRI_mchk_soot2&0xff=2:>}{CRI_mchk_soot2&0xff=3:<=}{CRI_mchk_soot2&0xff=4:>=}{CRI_mchk_soot2&0xff=5:=}{CRI_mchk_soot2&0xff=6:<>}" VALUE 0x00170F4E /* @ECU_Address@CRI_mchk_soot2@0x0100ABF8@ */ ECIPP_ALIGNMENT_UBYTE 255 CRI_mchk_soot2_COMPU_VTAB 0 255 BIT_MASK 0xff /end CHARACTERISTIC
/begin COMPU_METHOD CRI_mchk_soot2_COMPU_VTAB "Verbal Table" TAB_VERB "%.0" "list" COMPU_TAB_REF CRI_mchk_soot2_COMPU_VTAB_REF /end COMPU_METHOD
/begin COMPU_VTAB CRI_mchk_soot2_COMPU_VTAB_REF "Verbal Table" TAB_VERB 7 0 "X" 1 "<" 2 ">" 3 "<=" 4 ">=" 5 "=" 6 "<>" DEFAULT_VALUE "UNKNOWN" /end COMPU_VTAB
/begin CHARACTERISTIC CRI_mchk_soot3 "and soot loading is{CRI_mchk_soot3&0xff=0:X}{CRI_mchk_soot3&0xff=1:<}{CRI_mchk_soot3&0xff=2:>}{CRI_mchk_soot3&0xff=3:<=}{CRI_mchk_soot3&0xff=4:>=}{CRI_mchk_soot3&0xff=5:=}{CRI_mchk_soot3&0xff=6:<>}" VALUE 0x00170F4F /* @ECU_Address@CRI_mchk_soot3@0x0100AC00@ */ ECIPP_ALIGNMENT_UBYTE 255 CRI_mchk_soot3_COMPU_VTAB 0 255 BIT_MASK 0xff /end CHARACTERISTIC
/begin COMPU_METHOD CRI_mchk_soot3_COMPU_VTAB "Verbal Table" TAB_VERB "%.0" "list" COMPU_TAB_REF CRI_mchk_soot3_COMPU_VTAB_REF /end COMPU_METHOD
/begin COMPU_VTAB CRI_mchk_soot3_COMPU_VTAB_REF "Verbal Table" TAB_VERB 7 0 "X" 1 "<" 2 ">" 3 "<=" 4 ">=" 5 "=" 6 "<>" DEFAULT_VALUE "UNKNOWN" /end COMPU_VTAB
/begin CHARACTERISTIC CRI_mchk_soot4 "and soot loading is{CRI_mchk_soot4&0xff=0:X}{CRI_mchk_soot4&0xff=1:<}{CRI_mchk_soot4&0xff=2:>}{CRI_mchk_soot4&0xff=3:<=}{CRI_mchk_soot4&0xff=4:>=}{CRI_mchk_soot4&0xff=5:=}{CRI_mchk_soot4&0xff=6:<>}" VALUE 0x00170F50 /* @ECU_Address@CRI_mchk_soot4@0x0100AC08@ */ ECIPP_ALIGNMENT_UBYTE 255 CRI_mchk_soot4_COMPU_VTAB 0 255 BIT_MASK 0xff /end CHARACTERISTIC
/begin COMPU_METHOD CRI_mchk_soot4_COMPU_VTAB "Verbal Table" TAB_VERB "%.0" "list" COMPU_TAB_REF CRI_mchk_soot4_COMPU_VTAB_REF /end COMPU_METHOD
/begin COMPU_VTAB CRI_mchk_soot4_COMPU_VTAB_REF "Verbal Table" TAB_VERB 7 0 "X" 1 "<" 2 ">" 3 "<=" 4 ">=" 5 "=" 6 "<>" DEFAULT_VALUE "UNKNOWN" /end COMPU_VTAB
/begin CHARACTERISTIC CRI_mchk_soot5 "and soot loading is{CRI_mchk_soot5&0xff=0:X}{CRI_mchk_soot5&0xff=1:<}{CRI_mchk_soot5&0xff=2:>}{CRI_mchk_soot5&0xff=3:<=}{CRI_mchk_soot5&0xff=4:>=}{CRI_mchk_soot5&0xff=5:=}{CRI_mchk_soot5&0xff=6:<>}" VALUE 0x00170F51 /* @ECU_Address@CRI_mchk_soot5@0x0100AC10@ */ ECIPP_ALIGNMENT_UBYTE 255 CRI_mchk_soot5_COMPU_VTAB 0 255 BIT_MASK 0xff /end CHARACTERISTIC
/begin COMPU_METHOD CRI_mchk_soot5_COMPU_VTAB "Verbal Table" TAB_VERB "%.0" "list" COMPU_TAB_REF CRI_mchk_soot5_COMPU_VTAB_REF /end COMPU_METHOD
/begin COMPU_VTAB CRI_mchk_soot5_COMPU_VTAB_REF "Verbal Table" TAB_VERB 7 0 "X" 1 "<" 2 ">" 3 "<=" 4 ">=" 5 "=" 6 "<>" DEFAULT_VALUE "UNKNOWN" /end COMPU_VTAB
/begin CHARACTERISTIC CRI_mchk_soot6 "and soot loading is{CRI_mchk_soot6&0xff=0:X}{CRI_mchk_soot6&0xff=1:<}{CRI_mchk_soot6&0xff=2:>}{CRI_mchk_soot6&0xff=3:<=}{CRI_mchk_soot6&0xff=4:>=}{CRI_mchk_soot6&0xff=5:=}{CRI_mchk_soot6&0xff=6:<>}" VALUE 0x00170F52 /* @ECU_Address@CRI_mchk_soot6@0x0100AC18@ */ ECIPP_ALIGNMENT_UBYTE 255 CRI_mchk_soot6_COMPU_VTAB 0 255 BIT_MASK 0xff /end CHARACTERISTIC
/begin COMPU_METHOD CRI_mchk_soot6_COMPU_VTAB "Verbal Table" TAB_VERB "%.0" "list" COMPU_TAB_REF CRI_mchk_soot6_COMPU_VTAB_REF /end COMPU_METHOD
/begin COMPU_VTAB CRI_mchk_soot6_COMPU_VTAB_REF "Verbal Table" TAB_VERB 7 0 "X" 1 "<" 2 ">" 3 "<=" 4 ">=" 5 "=" 6 "<>" DEFAULT_VALUE "UNKNOWN" /end COMPU_VTAB
/begin CHARACTERISTIC CRI_mchk_soot7 "and soot loading is{CRI_mchk_soot7&0xff=0:X}{CRI_mchk_soot7&0xff=1:<}{CRI_mchk_soot7&0xff=2:>}{CRI_mchk_soot7&0xff=3:<=}{CRI_mchk_soot7&0xff=4:>=}{CRI_mchk_soot7&0xff=5:=}{CRI_mchk_soot7&0xff=6:<>}" VALUE 0x00170F53 /* @ECU_Address@CRI_mchk_soot7@0x0100AC20@ */ ECIPP_ALIGNMENT_UBYTE 255 CRI_mchk_soot7_COMPU_VTAB 0 255 BIT_MASK 0xff /end CHARACTERISTIC
/begin COMPU_METHOD CRI_mchk_soot7_COMPU_VTAB "Verbal Table" TAB_VERB "%.0" "list" COMPU_TAB_REF CRI_mchk_soot7_COMPU_VTAB_REF /end COMPU_METHOD
/begin COMPU_VTAB CRI_mchk_soot7_COMPU_VTAB_REF "Verbal Table" TAB_VERB 7 0 "X" 1 "<" 2 ">" 3 "<=" 4 ">=" 5 "=" 6 "<>" DEFAULT_VALUE "UNKNOWN" /end COMPU_VTAB
/begin CHARACTERISTIC CRI_mchk_soot8 "and soot loading is{CRI_mchk_soot8&0xff=0:X}{CRI_mchk_soot8&0xff=1:<}{CRI_mchk_soot8&0xff=2:>}{CRI_mchk_soot8&0xff=3:<=}{CRI_mchk_soot8&0xff=4:>=}{CRI_mchk_soot8&0xff=5:=}{CRI_mchk_soot8&0xff=6:<>}" VALUE 0x00170F54 /* @ECU_Address@CRI_mchk_soot8@0x0100AC28@ */ ECIPP_ALIGNMENT_UBYTE 255 CRI_mchk_soot8_COMPU_VTAB 0 255 BIT_MASK 0xff /end CHARACTERISTIC
/begin COMPU_METHOD CRI_mchk_soot8_COMPU_VTAB "Verbal Table" TAB_VERB "%.0" "list" COMPU_TAB_REF CRI_mchk_soot8_COMPU_VTAB_REF /end COMPU_METHOD
/begin COMPU_VTAB CRI_mchk_soot8_COMPU_VTAB_REF "Verbal Table" TAB_VERB 7 0 "X" 1 "<" 2 ">" 3 "<=" 4 ">=" 5 "=" 6 "<>" DEFAULT_VALUE "UNKNOWN" /end COMPU_VTAB
/begin CHARACTERISTIC CRI_mchk_soot9 "and soot loading is{CRI_mchk_soot9&0xff=0:X}{CRI_mchk_soot9&0xff=1:<}{CRI_mchk_soot9&0xff=2:>}{CRI_mchk_soot9&0xff=3:<=}{CRI_mchk_soot9&0xff=4:>=}{CRI_mchk_soot9&0xff=5:=}{CRI_mchk_soot9&0xff=6:<>}" VALUE 0x00170F55 /* @ECU_Address@CRI_mchk_soot9@0x0100AC30@ */ ECIPP_ALIGNMENT_UBYTE 255 CRI_mchk_soot9_COMPU_VTAB 0 255 BIT_MASK 0xff /end CHARACTERISTIC
/begin COMPU_METHOD CRI_mchk_soot9_COMPU_VTAB "Verbal Table" TAB_VERB "%.0" "list" COMPU_TAB_REF CRI_mchk_soot9_COMPU_VTAB_REF /end COMPU_METHOD
/begin COMPU_VTAB CRI_mchk_soot9_COMPU_VTAB_REF "Verbal Table" TAB_VERB 7 0 "X" 1 "<" 2 ">" 3 "<=" 4 ">=" 5 "=" 6 "<>" DEFAULT_VALUE "UNKNOWN" /end COMPU_VTAB
/begin CHARACTERISTIC CRI_mchk_RS_speed0 "and vehicle speed is{CRI_mchk_RS_speed0&0xff=0:X}{CRI_mchk_RS_speed0&0xff=1:<}{CRI_mchk_RS_speed0&0xff=2:>}{CRI_mchk_RS_speed0&0xff=3:<=}{CRI_mchk_RS_speed0&0xff=4:>=}{CRI_mchk_RS_speed0&0xff=5:=}{CRI_mchk_RS_speed0&0xff=6:<>}" VALUE 0x00170F42 /* @ECU_Address@CRI_mchk_RS_speed0@0x0100AC38@ */ ECIPP_ALIGNMENT_UBYTE 255 CRI_mchk_RS_speed0_COMPU_VTAB 0 255 BIT_MASK 0xff /end CHARACTERISTIC
/begin COMPU_METHOD CRI_mchk_RS_speed0_COMPU_VTAB "Verbal Table" TAB_VERB "%.0" "list" COMPU_TAB_REF CRI_mchk_RS_speed0_COMPU_VTAB_REF /end COMPU_METHOD
/begin COMPU_VTAB CRI_mchk_RS_speed0_COMPU_VTAB_REF "Verbal Table" TAB_VERB 7 0 "X" 1 "<" 2 ">" 3 "<=" 4 ">=" 5 "=" 6 "<>" DEFAULT_VALUE "UNKNOWN" /end COMPU_VTAB
/begin CHARACTERISTIC CRI_mchk_RS_speed1 "and vehicle speed is{CRI_mchk_RS_speed1&0xff=0:X}{CRI_mchk_RS_speed1&0xff=1:<}{CRI_mchk_RS_speed1&0xff=2:>}{CRI_mchk_RS_speed1&0xff=3:<=}{CRI_mchk_RS_speed1&0xff=4:>=}{CRI_mchk_RS_speed1&0xff=5:=}{CRI_mchk_RS_speed1&0xff=6:<>}" VALUE 0x00170F43 /* @ECU_Address@CRI_mchk_RS_speed1@0x0100AC40@ */ ECIPP_ALIGNMENT_UBYTE 255 CRI_mchk_RS_speed1_COMPU_VTAB 0 255 BIT_MASK 0xff /end CHARACTERISTIC
/begin COMPU_METHOD CRI_mchk_RS_speed1_COMPU_VTAB "Verbal Table" TAB_VERB "%.0" "list" COMPU_TAB_REF CRI_mchk_RS_speed1_COMPU_VTAB_REF /end COMPU_METHOD
/begin COMPU_VTAB CRI_mchk_RS_speed1_COMPU_VTAB_REF "Verbal Table" TAB_VERB 7 0 "X" 1 "<" 2 ">" 3 "<=" 4 ">=" 5 "=" 6 "<>" DEFAULT_VALUE "UNKNOWN" /end COMPU_VTAB
/begin CHARACTERISTIC CRI_mchk_RS_speed2 "and vehicle speed is{CRI_mchk_RS_speed2&0xff=0:X}{CRI_mchk_RS_speed2&0xff=1:<}{CRI_mchk_RS_speed2&0xff=2:>}{CRI_mchk_RS_speed2&0xff=3:<=}{CRI_mchk_RS_speed2&0xff=4:>=}{CRI_mchk_RS_speed2&0xff=5:=}{CRI_mchk_RS_speed2&0xff=6:<>}" VALUE 0x00170F44 /* @ECU_Address@CRI_mchk_RS_speed2@0x0100AC48@ */ ECIPP_ALIGNMENT_UBYTE 255 CRI_mchk_RS_speed2_COMPU_VTAB 0 255 BIT_MASK 0xff /end CHARACTERISTIC
/begin COMPU_METHOD CRI_mchk_RS_speed2_COMPU_VTAB "Verbal Table" TAB_VERB "%.0" "list" COMPU_TAB_REF CRI_mchk_RS_speed2_COMPU_VTAB_REF /end COMPU_METHOD
/begin COMPU_VTAB CRI_mchk_RS_speed2_COMPU_VTAB_REF "Verbal Table" TAB_VERB 7 0 "X" 1 "<" 2 ">" 3 "<=" 4 ">=" 5 "=" 6 "<>" DEFAULT_VALUE "UNKNOWN" /end COMPU_VTAB
/begin CHARACTERISTIC CRI_mchk_RS_speed3 "and vehicle speed is{CRI_mchk_RS_speed3&0xff=0:X}{CRI_mchk_RS_speed3&0xff=1:<}{CRI_mchk_RS_speed3&0xff=2:>}{CRI_mchk_RS_speed3&0xff=3:<=}{CRI_mchk_RS_speed3&0xff=4:>=}{CRI_mchk_RS_speed3&0xff=5:=}{CRI_mchk_RS_speed3&0xff=6:<>}" VALUE 0x00170F45 /* @ECU_Address@CRI_mchk_RS_speed3@0x0100AC50@ */ ECIPP_ALIGNMENT_UBYTE 255 CRI_mchk_RS_speed3_COMPU_VTAB 0 255 BIT_MASK 0xff /end CHARACTERISTIC
/begin COMPU_METHOD CRI_mchk_RS_speed3_COMPU_VTAB "Verbal Table" TAB_VERB "%.0" "list" COMPU_TAB_REF CRI_mchk_RS_speed3_COMPU_VTAB_REF /end COMPU_METHOD
/begin COMPU_VTAB CRI_mchk_RS_speed3_COMPU_VTAB_REF "Verbal Table" TAB_VERB 7 0 "X" 1 "<" 2 ">" 3 "<=" 4 ">=" 5 "=" 6 "<>" DEFAULT_VALUE "UNKNOWN" /end COMPU_VTAB
/begin CHARACTERISTIC CRI_mchk_RS_speed4 "and vehicle speed is{CRI_mchk_RS_speed4&0xff=0:X}{CRI_mchk_RS_speed4&0xff=1:<}{CRI_mchk_RS_speed4&0xff=2:>}{CRI_mchk_RS_speed4&0xff=3:<=}{CRI_mchk_RS_speed4&0xff=4:>=}{CRI_mchk_RS_speed4&0xff=5:=}{CRI_mchk_RS_speed4&0xff=6:<>}" VALUE 0x00170F46 /* @ECU_Address@CRI_mchk_RS_speed4@0x0100AC58@ */ ECIPP_ALIGNMENT_UBYTE 255 CRI_mchk_RS_speed4_COMPU_VTAB 0 255 BIT_MASK 0xff /end CHARACTERISTIC
/begin COMPU_METHOD CRI_mchk_RS_speed4_COMPU_VTAB "Verbal Table" TAB_VERB "%.0" "list" COMPU_TAB_REF CRI_mchk_RS_speed4_COMPU_VTAB_REF /end COMPU_METHOD
/begin COMPU_VTAB CRI_mchk_RS_speed4_COMPU_VTAB_REF "Verbal Table" TAB_VERB 7 0 "X" 1 "<" 2 ">" 3 "<=" 4 ">=" 5 "=" 6 "<>" DEFAULT_VALUE "UNKNOWN" /end COMPU_VTAB
/begin CHARACTERISTIC CRI_mchk_RS_speed5 "and vehicle speed is{CRI_mchk_RS_speed5&0xff=0:X}{CRI_mchk_RS_speed5&0xff=1:<}{CRI_mchk_RS_speed5&0xff=2:>}{CRI_mchk_RS_speed5&0xff=3:<=}{CRI_mchk_RS_speed5&0xff=4:>=}{CRI_mchk_RS_speed5&0xff=5:=}{CRI_mchk_RS_speed5&0xff=6:<>}" VALUE 0x00170F47 /* @ECU_Address@CRI_mchk_RS_speed5@0x0100AC60@ */ ECIPP_ALIGNMENT_UBYTE 255 CRI_mchk_RS_speed5_COMPU_VTAB 0 255 BIT_MASK 0xff /end CHARACTERISTIC
/begin COMPU_METHOD CRI_mchk_RS_speed5_COMPU_VTAB "Verbal Table" TAB_VERB "%.0" "list" COMPU_TAB_REF CRI_mchk_RS_speed5_COMPU_VTAB_REF /end COMPU_METHOD
/begin COMPU_VTAB CRI_mchk_RS_speed5_COMPU_VTAB_REF "Verbal Table" TAB_VERB 7 0 "X" 1 "<" 2 ">" 3 "<=" 4 ">=" 5 "=" 6 "<>" DEFAULT_VALUE "UNKNOWN" /end COMPU_VTAB
/begin CHARACTERISTIC CRI_mchk_RS_speed6 "and vehicle speed is{CRI_mchk_RS_speed6&0xff=0:X}{CRI_mchk_RS_speed6&0xff=1:<}{CRI_mchk_RS_speed6&0xff=2:>}{CRI_mchk_RS_speed6&0xff=3:<=}{CRI_mchk_RS_speed6&0xff=4:>=}{CRI_mchk_RS_speed6&0xff=5:=}{CRI_mchk_RS_speed6&0xff=6:<>}" VALUE 0x00170F48 /* @ECU_Address@CRI_mchk_RS_speed6@0x0100AC68@ */ ECIPP_ALIGNMENT_UBYTE 255 CRI_mchk_RS_speed6_COMPU_VTAB 0 255 BIT_MASK 0xff /end CHARACTERISTIC
/begin COMPU_METHOD CRI_mchk_RS_speed6_COMPU_VTAB "Verbal Table" TAB_VERB "%.0" "list" COMPU_TAB_REF CRI_mchk_RS_speed6_COMPU_VTAB_REF /end COMPU_METHOD
/begin COMPU_VTAB CRI_mchk_RS_speed6_COMPU_VTAB_REF "Verbal Table" TAB_VERB 7 0 "X" 1 "<" 2 ">" 3 "<=" 4 ">=" 5 "=" 6 "<>" DEFAULT_VALUE "UNKNOWN" /end COMPU_VTAB
/begin CHARACTERISTIC CRI_mchk_RS_speed7 "and vehicle speed is{CRI_mchk_RS_speed7&0xff=0:X}{CRI_mchk_RS_speed7&0xff=1:<}{CRI_mchk_RS_speed7&0xff=2:>}{CRI_mchk_RS_speed7&0xff=3:<=}{CRI_mchk_RS_speed7&0xff=4:>=}{CRI_mchk_RS_speed7&0xff=5:=}{CRI_mchk_RS_speed7&0xff=6:<>}" VALUE 0x00170F49 /* @ECU_Address@CRI_mchk_RS_speed7@0x0100AC70@ */ ECIPP_ALIGNMENT_UBYTE 255 CRI_mchk_RS_speed7_COMPU_VTAB 0 255 BIT_MASK 0xff /end CHARACTERISTIC
/begin COMPU_METHOD CRI_mchk_RS_speed7_COMPU_VTAB "Verbal Table" TAB_VERB "%.0" "list" COMPU_TAB_REF CRI_mchk_RS_speed7_COMPU_VTAB_REF /end COMPU_METHOD
/begin COMPU_VTAB CRI_mchk_RS_speed7_COMPU_VTAB_REF "Verbal Table" TAB_VERB 7 0 "X" 1 "<" 2 ">" 3 "<=" 4 ">=" 5 "=" 6 "<>" DEFAULT_VALUE "UNKNOWN" /end COMPU_VTAB
/begin CHARACTERISTIC CRI_mchk_RS_speed8 "and vehicle speed is{CRI_mchk_RS_speed8&0xff=0:X}{CRI_mchk_RS_speed8&0xff=1:<}{CRI_mchk_RS_speed8&0xff=2:>}{CRI_mchk_RS_speed8&0xff=3:<=}{CRI_mchk_RS_speed8&0xff=4:>=}{CRI_mchk_RS_speed8&0xff=5:=}{CRI_mchk_RS_speed8&0xff=6:<>}" VALUE 0x00170F4A /* @ECU_Address@CRI_mchk_RS_speed8@0x0100AC78@ */ ECIPP_ALIGNMENT_UBYTE 255 CRI_mchk_RS_speed8_COMPU_VTAB 0 255 BIT_MASK 0xff /end CHARACTERISTIC
/begin COMPU_METHOD CRI_mchk_RS_speed8_COMPU_VTAB "Verbal Table" TAB_VERB "%.0" "list" COMPU_TAB_REF CRI_mchk_RS_speed8_COMPU_VTAB_REF /end COMPU_METHOD
/begin COMPU_VTAB CRI_mchk_RS_speed8_COMPU_VTAB_REF "Verbal Table" TAB_VERB 7 0 "X" 1 "<" 2 ">" 3 "<=" 4 ">=" 5 "=" 6 "<>" DEFAULT_VALUE "UNKNOWN" /end COMPU_VTAB
/begin CHARACTERISTIC CRI_mchk_RS_speed9 "and vehicle speed is{CRI_mchk_RS_speed9&0xff=0:X}{CRI_mchk_RS_speed9&0xff=1:<}{CRI_mchk_RS_speed9&0xff=2:>}{CRI_mchk_RS_speed9&0xff=3:<=}{CRI_mchk_RS_speed9&0xff=4:>=}{CRI_mchk_RS_speed9&0xff=5:=}{CRI_mchk_RS_speed9&0xff=6:<>}" VALUE 0x00170F4B /* @ECU_Address@CRI_mchk_RS_speed9@0x0100AC80@ */ ECIPP_ALIGNMENT_UBYTE 255 CRI_mchk_RS_speed9_COMPU_VTAB 0 255 BIT_MASK 0xff /end CHARACTERISTIC
/begin COMPU_METHOD CRI_mchk_RS_speed9_COMPU_VTAB "Verbal Table" TAB_VERB "%.0" "list" COMPU_TAB_REF CRI_mchk_RS_speed9_COMPU_VTAB_REF /end COMPU_METHOD
/begin COMPU_VTAB CRI_mchk_RS_speed9_COMPU_VTAB_REF "Verbal Table" TAB_VERB 7 0 "X" 1 "<" 2 ">" 3 "<=" 4 ">=" 5 "=" 6 "<>" DEFAULT_VALUE "UNKNOWN" /end COMPU_VTAB
/begin CHARACTERISTIC CRI_mlmt_RPM0 "RPM limit" VALUE 0x00170E28 /* @ECU_Address@CRI_mlmt_RPM0@0x0100AC88@ */ ECIPP_ALIGNMENT_UWORD 65535 Compu_CRI_mlmt_RPM0 0 65535 /end CHARACTERISTIC
/begin COMPU_METHOD Compu_CRI_mlmt_RPM0 " " RAT_FUNC "%.0" "rpm" COEFFS 0 1 0 0 0 1 /end COMPU_METHOD
/begin CHARACTERISTIC CRI_mlmt_RPM1 "RPM limit" VALUE 0x00170E2A /* @ECU_Address@CRI_mlmt_RPM1@0x0100AC90@ */ ECIPP_ALIGNMENT_UWORD 65535 Compu_CRI_mlmt_RPM1 0 65535 /end CHARACTERISTIC
/begin COMPU_METHOD Compu_CRI_mlmt_RPM1 " " RAT_FUNC "%.0" "rpm" COEFFS 0 1 0 0 0 1 /end COMPU_METHOD
/begin CHARACTERISTIC CRI_mlmt_RPM2 "RPM limit" VALUE 0x00170E2C /* @ECU_Address@CRI_mlmt_RPM2@0x0100AC98@ */ ECIPP_ALIGNMENT_UWORD 65535 Compu_CRI_mlmt_RPM2 0 65535 /end CHARACTERISTIC
/begin COMPU_METHOD Compu_CRI_mlmt_RPM2 " " RAT_FUNC "%.0" "rpm" COEFFS 0 1 0 0 0 1 /end COMPU_METHOD
/begin CHARACTERISTIC CRI_mlmt_RPM3 "RPM limit" VALUE 0x00170E2E /* @ECU_Address@CRI_mlmt_RPM3@0x0100ACA0@ */ ECIPP_ALIGNMENT_UWORD 65535 Compu_CRI_mlmt_RPM3 0 65535 /end CHARACTERISTIC
/begin COMPU_METHOD Compu_CRI_mlmt_RPM3 " " RAT_FUNC "%.0" "rpm" COEFFS 0 1 0 0 0 1 /end COMPU_METHOD
/begin CHARACTERISTIC CRI_mlmt_RPM4 "RPM limit" VALUE 0x00170E30 /* @ECU_Address@CRI_mlmt_RPM4@0x0100ACA8@ */ ECIPP_ALIGNMENT_UWORD 65535 Compu_CRI_mlmt_RPM4 0 65535 /end CHARACTERISTIC
/begin COMPU_METHOD Compu_CRI_mlmt_RPM4 " " RAT_FUNC "%.0" "rpm" COEFFS 0 1 0 0 0 1 /end COMPU_METHOD
/begin CHARACTERISTIC CRI_mlmt_RPM5 "RPM limit" VALUE 0x00170E32 /* @ECU_Address@CRI_mlmt_RPM5@0x0100ACB0@ */ ECIPP_ALIGNMENT_UWORD 65535 Compu_CRI_mlmt_RPM5 0 65535 /end CHARACTERISTIC
/begin COMPU_METHOD Compu_CRI_mlmt_RPM5 " " RAT_FUNC "%.0" "rpm" COEFFS 0 1 0 0 0 1 /end COMPU_METHOD
/begin CHARACTERISTIC CRI_mlmt_RPM6 "RPM limit" VALUE 0x00170E34 /* @ECU_Address@CRI_mlmt_RPM6@0x0100ACB8@ */ ECIPP_ALIGNMENT_UWORD 65535 Compu_CRI_mlmt_RPM6 0 65535 /end CHARACTERISTIC
/begin COMPU_METHOD Compu_CRI_mlmt_RPM6 " " RAT_FUNC "%.0" "rpm" COEFFS 0 1 0 0 0 1 /end COMPU_METHOD
/begin CHARACTERISTIC CRI_mlmt_RPM7 "RPM limit" VALUE 0x00170E36 /* @ECU_Address@CRI_mlmt_RPM7@0x0100ACC0@ */ ECIPP_ALIGNMENT_UWORD 65535 Compu_CRI_mlmt_RPM7 0 65535 /end CHARACTERISTIC
/begin COMPU_METHOD Compu_CRI_mlmt_RPM7 " " RAT_FUNC "%.0" "rpm" COEFFS 0 1 0 0 0 1 /end COMPU_METHOD
/begin CHARACTERISTIC CRI_mlmt_RPM8 "RPM limit" VALUE 0x00170E38 /* @ECU_Address@CRI_mlmt_RPM8@0x0100ACC8@ */ ECIPP_ALIGNMENT_UWORD 65535 Compu_CRI_mlmt_RPM8 0 65535 /end CHARACTERISTIC
/begin COMPU_METHOD Compu_CRI_mlmt_RPM8 " " RAT_FUNC "%.0" "rpm" COEFFS 0 1 0 0 0 1 /end COMPU_METHOD
/begin CHARACTERISTIC CRI_mlmt_RPM9 "RPM limit" VALUE 0x00170E3A /* @ECU_Address@CRI_mlmt_RPM9@0x0100ACD0@ */ ECIPP_ALIGNMENT_UWORD 65535 Compu_CRI_mlmt_RPM9 0 65535 /end CHARACTERISTIC
/begin COMPU_METHOD Compu_CRI_mlmt_RPM9 " " RAT_FUNC "%.0" "rpm" COEFFS 0 1 0 0 0 1 /end COMPU_METHOD
/begin CHARACTERISTIC CRI_mlmt_ECT0 "ECT limit" VALUE 0x00170E00 /* @ECU_Address@CRI_mlmt_ECT0@0x0100ACD8@ */ ECIPP_ALIGNMENT_UWORD 564 Compu_CRI_mlmt_ECT0 -460 563.984375 /end CHARACTERISTIC
/begin COMPU_METHOD Compu_CRI_mlmt_ECT0 " " RAT_FUNC "%.1" "deg F" COEFFS 0 64 29440 0 0 1 /end COMPU_METHOD
/begin CHARACTERISTIC CRI_mlmt_ECT1 "ECT limit" VALUE 0x00170E02 /* @ECU_Address@CRI_mlmt_ECT1@0x0100ACE0@ */ ECIPP_ALIGNMENT_UWORD 564 Compu_CRI_mlmt_ECT1 -460 563.984375 /end CHARACTERISTIC
/begin COMPU_METHOD Compu_CRI_mlmt_ECT1 " " RAT_FUNC "%.1" "deg F" COEFFS 0 64 29440 0 0 1 /end COMPU_METHOD
/begin CHARACTERISTIC CRI_mlmt_ECT2 "ECT limit" VALUE 0x00170E04 /* @ECU_Address@CRI_mlmt_ECT2@0x0100ACE8@ */ ECIPP_ALIGNMENT_UWORD 564 Compu_CRI_mlmt_ECT2 -460 563.984375 /end CHARACTERISTIC
/begin COMPU_METHOD Compu_CRI_mlmt_ECT2 " " RAT_FUNC "%.1" "deg F" COEFFS 0 64 29440 0 0 1 /end COMPU_METHOD
/begin CHARACTERISTIC CRI_mlmt_ECT3 "ECT limit" VALUE 0x00170E06 /* @ECU_Address@CRI_mlmt_ECT3@0x0100ACF0@ */ ECIPP_ALIGNMENT_UWORD 564 Compu_CRI_mlmt_ECT3 -460 563.984375 /end CHARACTERISTIC
/begin COMPU_METHOD Compu_CRI_mlmt_ECT3 " " RAT_FUNC "%.1" "deg F" COEFFS 0 64 29440 0 0 1 /end COMPU_METHOD
/begin CHARACTERISTIC CRI_mlmt_ECT4 "ECT limit" VALUE 0x00170E08 /* @ECU_Address@CRI_mlmt_ECT4@0x0100ACF8@ */ ECIPP_ALIGNMENT_UWORD 564 Compu_CRI_mlmt_ECT4 -460 563.984375 /end CHARACTERISTIC
/begin COMPU_METHOD Compu_CRI_mlmt_ECT4 " " RAT_FUNC "%.1" "deg F" COEFFS 0 64 29440 0 0 1 /end COMPU_METHOD
/begin CHARACTERISTIC CRI_mlmt_ECT5 "ECT limit" VALUE 0x00170E0A /* @ECU_Address@CRI_mlmt_ECT5@0x0100AD00@ */ ECIPP_ALIGNMENT_UWORD 564 Compu_CRI_mlmt_ECT5 -460 563.984375 /end CHARACTERISTIC
/begin COMPU_METHOD Compu_CRI_mlmt_ECT5 " " RAT_FUNC "%.1" "deg F" COEFFS 0 64 29440 0 0 1 /end COMPU_METHOD
/begin CHARACTERISTIC CRI_mlmt_ECT6 "ECT limit" VALUE 0x00170E0C /* @ECU_Address@CRI_mlmt_ECT6@0x0100AD08@ */ ECIPP_ALIGNMENT_UWORD 564 Compu_CRI_mlmt_ECT6 -460 563.984375 /end CHARACTERISTIC
/begin COMPU_METHOD Compu_CRI_mlmt_ECT6 " " RAT_FUNC "%.1" "deg F" COEFFS 0 64 29440 0 0 1 /end COMPU_METHOD
/begin CHARACTERISTIC CRI_mlmt_ECT7 "ECT limit" VALUE 0x00170E0E /* @ECU_Address@CRI_mlmt_ECT7@0x0100AD10@ */ ECIPP_ALIGNMENT_UWORD 564 Compu_CRI_mlmt_ECT7 -460 563.984375 /end CHARACTERISTIC
/begin COMPU_METHOD Compu_CRI_mlmt_ECT7 " " RAT_FUNC "%.1" "deg F" COEFFS 0 64 29440 0 0 1 /end COMPU_METHOD
/begin CHARACTERISTIC CRI_mlmt_ECT8 "ECT limit" VALUE 0x00170E10 /* @ECU_Address@CRI_mlmt_ECT8@0x0100AD18@ */ ECIPP_ALIGNMENT_UWORD 564 Compu_CRI_mlmt_ECT8 -460 563.984375 /end CHARACTERISTIC
/begin COMPU_METHOD Compu_CRI_mlmt_ECT8 " " RAT_FUNC "%.1" "deg F" COEFFS 0 64 29440 0 0 1 /end COMPU_METHOD
/begin CHARACTERISTIC CRI_mlmt_ECT9 "ECT limit" VALUE 0x00170E12 /* @ECU_Address@CRI_mlmt_ECT9@0x0100AD20@ */ ECIPP_ALIGNMENT_UWORD 564 Compu_CRI_mlmt_ECT9 -460 563.984375 /end CHARACTERISTIC
/begin COMPU_METHOD Compu_CRI_mlmt_ECT9 " " RAT_FUNC "%.1" "deg F" COEFFS 0 64 29440 0 0 1 /end COMPU_METHOD
/begin CHARACTERISTIC CRI_mlmt_IAT0 "IAT limit" VALUE 0x00170E14 /* @ECU_Address@CRI_mlmt_IAT0@0x0100AD28@ */ ECIPP_ALIGNMENT_UWORD 564 Compu_CRI_mlmt_IAT0 -460 563.984375 /end CHARACTERISTIC
/begin COMPU_METHOD Compu_CRI_mlmt_IAT0 " " RAT_FUNC "%.1" "deg F" COEFFS 0 64 29440 0 0 1 /end COMPU_METHOD
/begin CHARACTERISTIC CRI_mlmt_IAT1 "IAT limit" VALUE 0x00170E16 /* @ECU_Address@CRI_mlmt_IAT1@0x0100AD30@ */ ECIPP_ALIGNMENT_UWORD 564 Compu_CRI_mlmt_IAT1 -460 563.984375 /end CHARACTERISTIC
/begin COMPU_METHOD Compu_CRI_mlmt_IAT1 " " RAT_FUNC "%.1" "deg F" COEFFS 0 64 29440 0 0 1 /end COMPU_METHOD
/begin CHARACTERISTIC CRI_mlmt_IAT2 "IAT limit" VALUE 0x00170E18 /* @ECU_Address@CRI_mlmt_IAT2@0x0100AD38@ */ ECIPP_ALIGNMENT_UWORD 564 Compu_CRI_mlmt_IAT2 -460 563.984375 /end CHARACTERISTIC
/begin COMPU_METHOD Compu_CRI_mlmt_IAT2 " " RAT_FUNC "%.1" "deg F" COEFFS 0 64 29440 0 0 1 /end COMPU_METHOD
/begin CHARACTERISTIC CRI_mlmt_IAT3 "IAT limit" VALUE 0x00170E1A /* @ECU_Address@CRI_mlmt_IAT3@0x0100AD40@ */ ECIPP_ALIGNMENT_UWORD 564 Compu_CRI_mlmt_IAT3 -460 563.984375 /end CHARACTERISTIC
/begin COMPU_METHOD Compu_CRI_mlmt_IAT3 " " RAT_FUNC "%.1" "deg F" COEFFS 0 64 29440 0 0 1 /end COMPU_METHOD
/begin CHARACTERISTIC CRI_mlmt_IAT4 "IAT limit" VALUE 0x00170E1C /* @ECU_Address@CRI_mlmt_IAT4@0x0100AD48@ */ ECIPP_ALIGNMENT_UWORD 564 Compu_CRI_mlmt_IAT4 -460 563.984375 /end CHARACTERISTIC
/begin COMPU_METHOD Compu_CRI_mlmt_IAT4 " " RAT_FUNC "%.1" "deg F" COEFFS 0 64 29440 0 0 1 /end COMPU_METHOD
/begin CHARACTERISTIC CRI_mlmt_IAT5 "IAT limit" VALUE 0x00170E1E /* @ECU_Address@CRI_mlmt_IAT5@0x0100AD50@ */ ECIPP_ALIGNMENT_UWORD 564 Compu_CRI_mlmt_IAT5 -460 563.984375 /end CHARACTERISTIC
/begin COMPU_METHOD Compu_CRI_mlmt_IAT5 " " RAT_FUNC "%.1" "deg F" COEFFS 0 64 29440 0 0 1 /end COMPU_METHOD
/begin CHARACTERISTIC CRI_mlmt_IAT6 "IAT limit" VALUE 0x00170E20 /* @ECU_Address@CRI_mlmt_IAT6@0x0100AD58@ */ ECIPP_ALIGNMENT_UWORD 564 Compu_CRI_mlmt_IAT6 -460 563.984375 /end CHARACTERISTIC
/begin COMPU_METHOD Compu_CRI_mlmt_IAT6 " " RAT_FUNC "%.1" "deg F" COEFFS 0 64 29440 0 0 1 /end COMPU_METHOD
/begin CHARACTERISTIC CRI_mlmt_IAT7 "IAT limit" VALUE 0x00170E22 /* @ECU_Address@CRI_mlmt_IAT7@0x0100AD60@ */ ECIPP_ALIGNMENT_UWORD 564 Compu_CRI_mlmt_IAT7 -460 563.984375 /end CHARACTERISTIC
/begin COMPU_METHOD Compu_CRI_mlmt_IAT7 " " RAT_FUNC "%.1" "deg F" COEFFS 0 64 29440 0 0 1 /end COMPU_METHOD
/begin CHARACTERISTIC CRI_mlmt_IAT8 "IAT limit" VALUE 0x00170E24 /* @ECU_Address@CRI_mlmt_IAT8@0x0100AD68@ */ ECIPP_ALIGNMENT_UWORD 564 Compu_CRI_mlmt_IAT8 -460 563.984375 /end CHARACTERISTIC
/begin COMPU_METHOD Compu_CRI_mlmt_IAT8 " " RAT_FUNC "%.1" "deg F" COEFFS 0 64 29440 0 0 1 /end COMPU_METHOD
/begin CHARACTERISTIC CRI_mlmt_IAT9 "IAT limit" VALUE 0x00170E26 /* @ECU_Address@CRI_mlmt_IAT9@0x0100AD70@ */ ECIPP_ALIGNMENT_UWORD 564 Compu_CRI_mlmt_IAT9 -460 563.984375 /end CHARACTERISTIC
/begin COMPU_METHOD Compu_CRI_mlmt_IAT9 " " RAT_FUNC "%.1" "deg F" COEFFS 0 64 29440 0 0 1 /end COMPU_METHOD
/begin CHARACTERISTIC CRI_mlmt_DOCT0 "DOCT limit" VALUE 0x00170DD8 /* @ECU_Address@CRI_mlmt_DOCT0@0x0100AD78@ */ ECIPP_ALIGNMENT_UWORD 7732 Compu_CRI_mlmt_DOCT0 -460 7731.875 /end CHARACTERISTIC
/begin COMPU_METHOD Compu_CRI_mlmt_DOCT0 " " RAT_FUNC "%.0" "deg F" COEFFS 0 8 3680 0 0 1 /end COMPU_METHOD
/begin CHARACTERISTIC CRI_mlmt_DOCT1 "DOCT limit" VALUE 0x00170DDA /* @ECU_Address@CRI_mlmt_DOCT1@0x0100AD80@ */ ECIPP_ALIGNMENT_UWORD 7732 Compu_CRI_mlmt_DOCT1 -460 7731.875 /end CHARACTERISTIC
/begin COMPU_METHOD Compu_CRI_mlmt_DOCT1 " " RAT_FUNC "%.0" "deg F" COEFFS 0 8 3680 0 0 1 /end COMPU_METHOD
/begin CHARACTERISTIC CRI_mlmt_DOCT2 "DOCT limit" VALUE 0x00170DDC /* @ECU_Address@CRI_mlmt_DOCT2@0x0100AD88@ */ ECIPP_ALIGNMENT_UWORD 7732 Compu_CRI_mlmt_DOCT2 -460 7731.875 /end CHARACTERISTIC
/begin COMPU_METHOD Compu_CRI_mlmt_DOCT2 " " RAT_FUNC "%.0" "deg F" COEFFS 0 8 3680 0 0 1 /end COMPU_METHOD
/begin CHARACTERISTIC CRI_mlmt_DOCT3 "DOCT limit" VALUE 0x00170DDE /* @ECU_Address@CRI_mlmt_DOCT3@0x0100AD90@ */ ECIPP_ALIGNMENT_UWORD 7732 Compu_CRI_mlmt_DOCT3 -460 7731.875 /end CHARACTERISTIC
/begin COMPU_METHOD Compu_CRI_mlmt_DOCT3 " " RAT_FUNC "%.0" "deg F" COEFFS 0 8 3680 0 0 1 /end COMPU_METHOD
/begin CHARACTERISTIC CRI_mlmt_DOCT4 "DOCT limit" VALUE 0x00170DE0 /* @ECU_Address@CRI_mlmt_DOCT4@0x0100AD98@ */ ECIPP_ALIGNMENT_UWORD 7732 Compu_CRI_mlmt_DOCT4 -460 7731.875 /end CHARACTERISTIC
/begin COMPU_METHOD Compu_CRI_mlmt_DOCT4 " " RAT_FUNC "%.0" "deg F" COEFFS 0 8 3680 0 0 1 /end COMPU_METHOD
/begin CHARACTERISTIC CRI_mlmt_DOCT5 "DOCT limit" VALUE 0x00170DE2 /* @ECU_Address@CRI_mlmt_DOCT5@0x0100ADA0@ */ ECIPP_ALIGNMENT_UWORD 7732 Compu_CRI_mlmt_DOCT5 -460 7731.875 /end CHARACTERISTIC
/begin COMPU_METHOD Compu_CRI_mlmt_DOCT5 " " RAT_FUNC "%.0" "deg F" COEFFS 0 8 3680 0 0 1 /end COMPU_METHOD
/begin CHARACTERISTIC CRI_mlmt_DOCT6 "DOCT limit" VALUE 0x00170DE4 /* @ECU_Address@CRI_mlmt_DOCT6@0x0100ADA8@ */ ECIPP_ALIGNMENT_UWORD 7732 Compu_CRI_mlmt_DOCT6 -460 7731.875 /end CHARACTERISTIC
/begin COMPU_METHOD Compu_CRI_mlmt_DOCT6 " " RAT_FUNC "%.0" "deg F" COEFFS 0 8 3680 0 0 1 /end COMPU_METHOD
/begin CHARACTERISTIC CRI_mlmt_DOCT7 "DOCT limit" VALUE 0x00170DE6 /* @ECU_Address@CRI_mlmt_DOCT7@0x0100ADB0@ */ ECIPP_ALIGNMENT_UWORD 7732 Compu_CRI_mlmt_DOCT7 -460 7731.875 /end CHARACTERISTIC
/begin COMPU_METHOD Compu_CRI_mlmt_DOCT7 " " RAT_FUNC "%.0" "deg F" COEFFS 0 8 3680 0 0 1 /end COMPU_METHOD
/begin CHARACTERISTIC CRI_mlmt_DOCT8 "DOCT limit" VALUE 0x00170DE8 /* @ECU_Address@CRI_mlmt_DOCT8@0x0100ADB8@ */ ECIPP_ALIGNMENT_UWORD 7732 Compu_CRI_mlmt_DOCT8 -460 7731.875 /end CHARACTERISTIC
/begin COMPU_METHOD Compu_CRI_mlmt_DOCT8 " " RAT_FUNC "%.0" "deg F" COEFFS 0 8 3680 0 0 1 /end COMPU_METHOD
/begin CHARACTERISTIC CRI_mlmt_DOCT9 "DOCT limit" VALUE 0x00170DEA /* @ECU_Address@CRI_mlmt_DOCT9@0x0100ADC0@ */ ECIPP_ALIGNMENT_UWORD 7732 Compu_CRI_mlmt_DOCT9 -460 7731.875 /end CHARACTERISTIC
/begin COMPU_METHOD Compu_CRI_mlmt_DOCT9 " " RAT_FUNC "%.0" "deg F" COEFFS 0 8 3680 0 0 1 /end COMPU_METHOD
/begin CHARACTERISTIC CRI_mlmt_DPFT0 "DPFT limit" VALUE 0x00170DEC /* @ECU_Address@CRI_mlmt_DPFT0@0x0100ADC8@ */ ECIPP_ALIGNMENT_UWORD 7732 Compu_CRI_mlmt_DPFT0 -460 7731.875 /end CHARACTERISTIC
/begin COMPU_METHOD Compu_CRI_mlmt_DPFT0 " " RAT_FUNC "%.0" "deg F" COEFFS 0 8 3680 0 0 1 /end COMPU_METHOD
/begin CHARACTERISTIC CRI_mlmt_DPFT1 "DPFT limit" VALUE 0x00170DEE /* @ECU_Address@CRI_mlmt_DPFT1@0x0100ADD0@ */ ECIPP_ALIGNMENT_UWORD 7732 Compu_CRI_mlmt_DPFT1 -460 7731.875 /end CHARACTERISTIC
/begin COMPU_METHOD Compu_CRI_mlmt_DPFT1 " " RAT_FUNC "%.0" "deg F" COEFFS 0 8 3680 0 0 1 /end COMPU_METHOD
/begin CHARACTERISTIC CRI_mlmt_DPFT2 "DPFT limit" VALUE 0x00170DF0 /* @ECU_Address@CRI_mlmt_DPFT2@0x0100ADD8@ */ ECIPP_ALIGNMENT_UWORD 7732 Compu_CRI_mlmt_DPFT2 -460 7731.875 /end CHARACTERISTIC
/begin COMPU_METHOD Compu_CRI_mlmt_DPFT2 " " RAT_FUNC "%.0" "deg F" COEFFS 0 8 3680 0 0 1 /end COMPU_METHOD
/begin CHARACTERISTIC CRI_mlmt_DPFT3 "DPFT limit" VALUE 0x00170DF2 /* @ECU_Address@CRI_mlmt_DPFT3@0x0100ADE0@ */ ECIPP_ALIGNMENT_UWORD 7732 Compu_CRI_mlmt_DPFT3 -460 7731.875 /end CHARACTERISTIC
/begin COMPU_METHOD Compu_CRI_mlmt_DPFT3 " " RAT_FUNC "%.0" "deg F" COEFFS 0 8 3680 0 0 1 /end COMPU_METHOD
/begin CHARACTERISTIC CRI_mlmt_DPFT4 "DPFT limit" VALUE 0x00170DF4 /* @ECU_Address@CRI_mlmt_DPFT4@0x0100ADE8@ */ ECIPP_ALIGNMENT_UWORD 7732 Compu_CRI_mlmt_DPFT4 -460 7731.875 /end CHARACTERISTIC
/begin COMPU_METHOD Compu_CRI_mlmt_DPFT4 " " RAT_FUNC "%.0" "deg F" COEFFS 0 8 3680 0 0 1 /end COMPU_METHOD
/begin CHARACTERISTIC CRI_mlmt_DPFT5 "DPFT limit" VALUE 0x00170DF6 /* @ECU_Address@CRI_mlmt_DPFT5@0x0100ADF0@ */ ECIPP_ALIGNMENT_UWORD 7732 Compu_CRI_mlmt_DPFT5 -460 7731.875 /end CHARACTERISTIC
/begin COMPU_METHOD Compu_CRI_mlmt_DPFT5 " " RAT_FUNC "%.0" "deg F" COEFFS 0 8 3680 0 0 1 /end COMPU_METHOD
/begin CHARACTERISTIC CRI_mlmt_DPFT6 "DPFT limit" VALUE 0x00170DF8 /* @ECU_Address@CRI_mlmt_DPFT6@0x0100ADF8@ */ ECIPP_ALIGNMENT_UWORD 7732 Compu_CRI_mlmt_DPFT6 -460 7731.875 /end CHARACTERISTIC
/begin COMPU_METHOD Compu_CRI_mlmt_DPFT6 " " RAT_FUNC "%.0" "deg F" COEFFS 0 8 3680 0 0 1 /end COMPU_METHOD
/begin CHARACTERISTIC CRI_mlmt_DPFT7 "DPFT limit" VALUE 0x00170DFA /* @ECU_Address@CRI_mlmt_DPFT7@0x0100AE00@ */ ECIPP_ALIGNMENT_UWORD 7732 Compu_CRI_mlmt_DPFT7 -460 7731.875 /end CHARACTERISTIC
/begin COMPU_METHOD Compu_CRI_mlmt_DPFT7 " " RAT_FUNC "%.0" "deg F" COEFFS 0 8 3680 0 0 1 /end COMPU_METHOD
/begin CHARACTERISTIC CRI_mlmt_DPFT8 "DPFT limit" VALUE 0x00170DFC /* @ECU_Address@CRI_mlmt_DPFT8@0x0100AE08@ */ ECIPP_ALIGNMENT_UWORD 7732 Compu_CRI_mlmt_DPFT8 -460 7731.875 /end CHARACTERISTIC
/begin COMPU_METHOD Compu_CRI_mlmt_DPFT8 " " RAT_FUNC "%.0" "deg F" COEFFS 0 8 3680 0 0 1 /end COMPU_METHOD
/begin CHARACTERISTIC CRI_mlmt_DPFT9 "DPFT limit" VALUE 0x00170DFE /* @ECU_Address@CRI_mlmt_DPFT9@0x0100AE10@ */ ECIPP_ALIGNMENT_UWORD 7732 Compu_CRI_mlmt_DPFT9 -460 7731.875 /end CHARACTERISTIC
/begin COMPU_METHOD Compu_CRI_mlmt_DPFT9 " " RAT_FUNC "%.0" "deg F" COEFFS 0 8 3680 0 0 1 /end COMPU_METHOD
/begin CHARACTERISTIC CRI_mlmt_soot0 "Soot loading limit" VALUE 0x00170E50 /* @ECU_Address@CRI_mlmt_soot0@0x0100AE18@ */ ECIPP_ALIGNMENT_UWORD 64 Compu_CRI_mlmt_soot0 0 63.9990234375 /end CHARACTERISTIC
/begin COMPU_METHOD Compu_CRI_mlmt_soot0 " " RAT_FUNC "%.1" "g/L" COEFFS 0 1024 0 0 0 1 /end COMPU_METHOD
/begin CHARACTERISTIC CRI_mlmt_soot1 "Soot loading limit" VALUE 0x00170E52 /* @ECU_Address@CRI_mlmt_soot1@0x0100AE20@ */ ECIPP_ALIGNMENT_UWORD 64 Compu_CRI_mlmt_soot1 0 63.9990234375 /end CHARACTERISTIC
/begin COMPU_METHOD Compu_CRI_mlmt_soot1 " " RAT_FUNC "%.1" "g/L" COEFFS 0 1024 0 0 0 1 /end COMPU_METHOD
/begin CHARACTERISTIC CRI_mlmt_soot2 "Soot loading limit" VALUE 0x00170E54 /* @ECU_Address@CRI_mlmt_soot2@0x0100AE28@ */ ECIPP_ALIGNMENT_UWORD 64 Compu_CRI_mlmt_soot2 0 63.9990234375 /end CHARACTERISTIC
/begin COMPU_METHOD Compu_CRI_mlmt_soot2 " " RAT_FUNC "%.1" "g/L" COEFFS 0 1024 0 0 0 1 /end COMPU_METHOD
/begin CHARACTERISTIC CRI_mlmt_soot3 "Soot loading limit" VALUE 0x00170E56 /* @ECU_Address@CRI_mlmt_soot3@0x0100AE30@ */ ECIPP_ALIGNMENT_UWORD 64 Compu_CRI_mlmt_soot3 0 63.9990234375 /end CHARACTERISTIC
/begin COMPU_METHOD Compu_CRI_mlmt_soot3 " " RAT_FUNC "%.1" "g/L" COEFFS 0 1024 0 0 0 1 /end COMPU_METHOD
/begin CHARACTERISTIC CRI_mlmt_soot4 "Soot loading limit" VALUE 0x00170E58 /* @ECU_Address@CRI_mlmt_soot4@0x0100AE38@ */ ECIPP_ALIGNMENT_UWORD 64 Compu_CRI_mlmt_soot4 0 63.9990234375 /end CHARACTERISTIC
/begin COMPU_METHOD Compu_CRI_mlmt_soot4 " " RAT_FUNC "%.1" "g/L" COEFFS 0 1024 0 0 0 1 /end COMPU_METHOD
/begin CHARACTERISTIC CRI_mlmt_soot5 "Soot loading limit" VALUE 0x00170E5A /* @ECU_Address@CRI_mlmt_soot5@0x0100AE40@ */ ECIPP_ALIGNMENT_UWORD 64 Compu_CRI_mlmt_soot5 0 63.9990234375 /end CHARACTERISTIC
/begin COMPU_METHOD Compu_CRI_mlmt_soot5 " " RAT_FUNC "%.1" "g/L" COEFFS 0 1024 0 0 0 1 /end COMPU_METHOD
/begin CHARACTERISTIC CRI_mlmt_soot6 "Soot loading limit" VALUE 0x00170E5C /* @ECU_Address@CRI_mlmt_soot6@0x0100AE48@ */ ECIPP_ALIGNMENT_UWORD 64 Compu_CRI_mlmt_soot6 0 63.9990234375 /end CHARACTERISTIC
/begin COMPU_METHOD Compu_CRI_mlmt_soot6 " " RAT_FUNC "%.1" "g/L" COEFFS 0 1024 0 0 0 1 /end COMPU_METHOD
/begin CHARACTERISTIC CRI_mlmt_soot7 "Soot loading limit" VALUE 0x00170E5E /* @ECU_Address@CRI_mlmt_soot7@0x0100AE50@ */ ECIPP_ALIGNMENT_UWORD 64 Compu_CRI_mlmt_soot7 0 63.9990234375 /end CHARACTERISTIC
/begin COMPU_METHOD Compu_CRI_mlmt_soot7 " " RAT_FUNC "%.1" "g/L" COEFFS 0 1024 0 0 0 1 /end COMPU_METHOD
/begin CHARACTERISTIC CRI_mlmt_soot8 "Soot loading limit" VALUE 0x00170E60 /* @ECU_Address@CRI_mlmt_soot8@0x0100AE58@ */ ECIPP_ALIGNMENT_UWORD 64 Compu_CRI_mlmt_soot8 0 63.9990234375 /end CHARACTERISTIC
/begin COMPU_METHOD Compu_CRI_mlmt_soot8 " " RAT_FUNC "%.1" "g/L" COEFFS 0 1024 0 0 0 1 /end COMPU_METHOD
/begin CHARACTERISTIC CRI_mlmt_soot9 "Soot loading limit" VALUE 0x00170E62 /* @ECU_Address@CRI_mlmt_soot9@0x0100AE60@ */ ECIPP_ALIGNMENT_UWORD 64 Compu_CRI_mlmt_soot9 0 63.9990234375 /end CHARACTERISTIC
/begin COMPU_METHOD Compu_CRI_mlmt_soot9 " " RAT_FUNC "%.1" "g/L" COEFFS 0 1024 0 0 0 1 /end COMPU_METHOD
/begin CHARACTERISTIC CRI_mlmt_RS_speed0 "RS speed limit" VALUE 0x00170E3C /* @ECU_Address@CRI_mlmt_RS_speed0@0x0100AE68@ */ ECIPP_ALIGNMENT_UWORD 256 Compu_CRI_mlmt_RS_speed0 0 255.99609375 /end CHARACTERISTIC
/begin COMPU_METHOD Compu_CRI_mlmt_RS_speed0 " " RAT_FUNC "%.1" "km/hr" COEFFS 0 256 0 0 0 1 /end COMPU_METHOD
/begin CHARACTERISTIC CRI_mlmt_RS_speed1 "RS speed limit" VALUE 0x00170E3E /* @ECU_Address@CRI_mlmt_RS_speed1@0x0100AE70@ */ ECIPP_ALIGNMENT_UWORD 256 Compu_CRI_mlmt_RS_speed1 0 255.99609375 /end CHARACTERISTIC
/begin COMPU_METHOD Compu_CRI_mlmt_RS_speed1 " " RAT_FUNC "%.1" "km/hr" COEFFS 0 256 0 0 0 1 /end COMPU_METHOD
/begin CHARACTERISTIC CRI_mlmt_RS_speed2 "RS speed limit" VALUE 0x00170E40 /* @ECU_Address@CRI_mlmt_RS_speed2@0x0100AE78@ */ ECIPP_ALIGNMENT_UWORD 256 Compu_CRI_mlmt_RS_speed2 0 255.99609375 /end CHARACTERISTIC
/begin COMPU_METHOD Compu_CRI_mlmt_RS_speed2 " " RAT_FUNC "%.1" "km/hr" COEFFS 0 256 0 0 0 1 /end COMPU_METHOD
/begin CHARACTERISTIC CRI_mlmt_RS_speed3 "RS speed limit" VALUE 0x00170E42 /* @ECU_Address@CRI_mlmt_RS_speed3@0x0100AE80@ */ ECIPP_ALIGNMENT_UWORD 256 Compu_CRI_mlmt_RS_speed3 0 255.99609375 /end CHARACTERISTIC
/begin COMPU_METHOD Compu_CRI_mlmt_RS_speed3 " " RAT_FUNC "%.1" "km/hr" COEFFS 0 256 0 0 0 1 /end COMPU_METHOD
/begin CHARACTERISTIC CRI_mlmt_RS_speed4 "RS speed limit" VALUE 0x00170E44 /* @ECU_Address@CRI_mlmt_RS_speed4@0x0100AE88@ */ ECIPP_ALIGNMENT_UWORD 256 Compu_CRI_mlmt_RS_speed4 0 255.99609375 /end CHARACTERISTIC
/begin COMPU_METHOD Compu_CRI_mlmt_RS_speed4 " " RAT_FUNC "%.1" "km/hr" COEFFS 0 256 0 0 0 1 /end COMPU_METHOD
/begin CHARACTERISTIC CRI_mlmt_RS_speed5 "RS speed limit" VALUE 0x00170E46 /* @ECU_Address@CRI_mlmt_RS_speed5@0x0100AE90@ */ ECIPP_ALIGNMENT_UWORD 256 Compu_CRI_mlmt_RS_speed5 0 255.99609375 /end CHARACTERISTIC
/begin COMPU_METHOD Compu_CRI_mlmt_RS_speed5 " " RAT_FUNC "%.1" "km/hr" COEFFS 0 256 0 0 0 1 /end COMPU_METHOD
/begin CHARACTERISTIC CRI_mlmt_RS_speed6 "RS speed limit" VALUE 0x00170E48 /* @ECU_Address@CRI_mlmt_RS_speed6@0x0100AE98@ */ ECIPP_ALIGNMENT_UWORD 256 Compu_CRI_mlmt_RS_speed6 0 255.99609375 /end CHARACTERISTIC
/begin COMPU_METHOD Compu_CRI_mlmt_RS_speed6 " " RAT_FUNC "%.1" "km/hr" COEFFS 0 256 0 0 0 1 /end COMPU_METHOD
/begin CHARACTERISTIC CRI_mlmt_RS_speed7 "RS speed limit" VALUE 0x00170E4A /* @ECU_Address@CRI_mlmt_RS_speed7@0x0100AEA0@ */ ECIPP_ALIGNMENT_UWORD 256 Compu_CRI_mlmt_RS_speed7 0 255.99609375 /end CHARACTERISTIC
/begin COMPU_METHOD Compu_CRI_mlmt_RS_speed7 " " RAT_FUNC "%.1" "km/hr" COEFFS 0 256 0 0 0 1 /end COMPU_METHOD
/begin CHARACTERISTIC CRI_mlmt_RS_speed8 "RS speed limit" VALUE 0x00170E4C /* @ECU_Address@CRI_mlmt_RS_speed8@0x0100AEA8@ */ ECIPP_ALIGNMENT_UWORD 256 Compu_CRI_mlmt_RS_speed8 0 255.99609375 /end CHARACTERISTIC
/begin COMPU_METHOD Compu_CRI_mlmt_RS_speed8 " " RAT_FUNC "%.1" "km/hr" COEFFS 0 256 0 0 0 1 /end COMPU_METHOD
/begin CHARACTERISTIC CRI_mlmt_RS_speed9 "RS speed limit" VALUE 0x00170E4E /* @ECU_Address@CRI_mlmt_RS_speed9@0x0100AEB0@ */ ECIPP_ALIGNMENT_UWORD 256 Compu_CRI_mlmt_RS_speed9 0 255.99609375 /end CHARACTERISTIC
/begin COMPU_METHOD Compu_CRI_mlmt_RS_speed9 " " RAT_FUNC "%.1" "km/hr" COEFFS 0 256 0 0 0 1 /end COMPU_METHOD
/begin CHARACTERISTIC CRI_mchk_persist0 "for persistently longer than" VALUE 0x0016DA44 /* @ECU_Address@CRI_mchk_persist0@0x0100AEB8@ */ ECIPP_ALIGNMENT_ULONG 4294967 Compu_CRI_mchk_persist0 0 4294967.295 /end CHARACTERISTIC
/begin COMPU_METHOD Compu_CRI_mchk_persist0 " " RAT_FUNC "%.1" "sec" COEFFS 0 1000 0 0 0 1 /end COMPU_METHOD
/begin CHARACTERISTIC CRI_mchk_persist1 "for persistently longer than" VALUE 0x0016DA48 /* @ECU_Address@CRI_mchk_persist1@0x0100AEC0@ */ ECIPP_ALIGNMENT_ULONG 4294967 Compu_CRI_mchk_persist1 0 4294967.295 /end CHARACTERISTIC
/begin COMPU_METHOD Compu_CRI_mchk_persist1 " " RAT_FUNC "%.1" "sec" COEFFS 0 1000 0 0 0 1 /end COMPU_METHOD
/begin CHARACTERISTIC CRI_mchk_persist2 "for persistently longer than" VALUE 0x0016DA4C /* @ECU_Address@CRI_mchk_persist2@0x0100AEC8@ */ ECIPP_ALIGNMENT_ULONG 4294967 Compu_CRI_mchk_persist2 0 4294967.295 /end CHARACTERISTIC
/begin COMPU_METHOD Compu_CRI_mchk_persist2 " " RAT_FUNC "%.1" "sec" COEFFS 0 1000 0 0 0 1 /end COMPU_METHOD
/begin CHARACTERISTIC CRI_mchk_persist3 "for persistently longer than" VALUE 0x0016DA50 /* @ECU_Address@CRI_mchk_persist3@0x0100AED0@ */ ECIPP_ALIGNMENT_ULONG 4294967 Compu_CRI_mchk_persist3 0 4294967.295 /end CHARACTERISTIC
/begin COMPU_METHOD Compu_CRI_mchk_persist3 " " RAT_FUNC "%.1" "sec" COEFFS 0 1000 0 0 0 1 /end COMPU_METHOD
/begin CHARACTERISTIC CRI_mchk_persist4 "for persistently longer than" VALUE 0x0016DA54 /* @ECU_Address@CRI_mchk_persist4@0x0100AED8@ */ ECIPP_ALIGNMENT_ULONG 4294967 Compu_CRI_mchk_persist4 0 4294967.295 /end CHARACTERISTIC
/begin COMPU_METHOD Compu_CRI_mchk_persist4 " " RAT_FUNC "%.1" "sec" COEFFS 0 1000 0 0 0 1 /end COMPU_METHOD
/begin CHARACTERISTIC CRI_mchk_persist5 "for persistently longer than" VALUE 0x0016DA58 /* @ECU_Address@CRI_mchk_persist5@0x0100AEE0@ */ ECIPP_ALIGNMENT_ULONG 4294967 Compu_CRI_mchk_persist5 0 4294967.295 /end CHARACTERISTIC
/begin COMPU_METHOD Compu_CRI_mchk_persist5 " " RAT_FUNC "%.1" "sec" COEFFS 0 1000 0 0 0 1 /end COMPU_METHOD
/begin CHARACTERISTIC CRI_mchk_persist6 "for persistently longer than" VALUE 0x0016DA5C /* @ECU_Address@CRI_mchk_persist6@0x0100AEE8@ */ ECIPP_ALIGNMENT_ULONG 4294967 Compu_CRI_mchk_persist6 0 4294967.295 /end CHARACTERISTIC
/begin COMPU_METHOD Compu_CRI_mchk_persist6 " " RAT_FUNC "%.1" "sec" COEFFS 0 1000 0 0 0 1 /end COMPU_METHOD
/begin CHARACTERISTIC CRI_mchk_persist7 "for persistently longer than" VALUE 0x0016DA60 /* @ECU_Address@CRI_mchk_persist7@0x0100AEF0@ */ ECIPP_ALIGNMENT_ULONG 4294967 Compu_CRI_mchk_persist7 0 4294967.295 /end CHARACTERISTIC
/begin COMPU_METHOD Compu_CRI_mchk_persist7 " " RAT_FUNC "%.1" "sec" COEFFS 0 1000 0 0 0 1 /end COMPU_METHOD
/begin CHARACTERISTIC CRI_mchk_persist8 "for persistently longer than" VALUE 0x0016DA64 /* @ECU_Address@CRI_mchk_persist8@0x0100AEF8@ */ ECIPP_ALIGNMENT_ULONG 4294967 Compu_CRI_mchk_persist8 0 4294967.295 /end CHARACTERISTIC
/begin COMPU_METHOD Compu_CRI_mchk_persist8 " " RAT_FUNC "%.1" "sec" COEFFS 0 1000 0 0 0 1 /end COMPU_METHOD
/begin CHARACTERISTIC CRI_mchk_persist9 "for persistently longer than" VALUE 0x0016DA68 /* @ECU_Address@CRI_mchk_persist9@0x0100AF00@ */ ECIPP_ALIGNMENT_ULONG 4294967 Compu_CRI_mchk_persist9 0 4294967.295 /end CHARACTERISTIC
/begin COMPU_METHOD Compu_CRI_mchk_persist9 " " RAT_FUNC "%.1" "sec" COEFFS 0 1000 0 0 0 1 /end COMPU_METHOD
/begin CHARACTERISTIC CRI_mtranA_chk0 "Check for transitioning to{CRI_mtranA_chk0&0xff=0:Inactive}{CRI_mtranA_chk0&0xff=1:Mode 0}{CRI_mtranA_chk0&0xff=2:Mode 1}{CRI_mtranA_chk0&0xff=3:Mode 2}{CRI_mtranA_chk0&0xff=4:Mode 3}{CRI_mtranA_chk0&0xff=5:Mode 4}{CRI_mtranA_chk0&0xff=6:Mode 5}{CRI_mtran" VALUE 0x00170F56 /* @ECU_Address@CRI_mtranA_chk0@0x0100AF08@ */ ECIPP_ALIGNMENT_UBYTE 255 CRI_mtranA_chk0_COMPU_VTAB 0 255 BIT_MASK 0xff /end CHARACTERISTIC
/begin COMPU_METHOD CRI_mtranA_chk0_COMPU_VTAB "Verbal Table" TAB_VERB "%.0" "list" COMPU_TAB_REF CRI_mtranA_chk0_COMPU_VTAB_REF /end COMPU_METHOD
/begin COMPU_VTAB CRI_mtranA_chk0_COMPU_VTAB_REF "Verbal Table" TAB_VERB 11 0 "Inactive" 1 "Mode 0" 2 "Mode 1" 3 "Mode 2" 4 "Mode 3" 5 "Mode 4" 6 "Mode 5" 7 "Mode 6" 8 "Mode 7" 9 "Mode 8" 10 "Mode 9" DEFAULT_VALUE "UNKNOWN" /end COMPU_VTAB
/begin CHARACTERISTIC CRI_mtranA_chk1 "Check for transitioning to{CRI_mtranA_chk1&0xff=0:Inactive}{CRI_mtranA_chk1&0xff=1:Mode 0}{CRI_mtranA_chk1&0xff=2:Mode 1}{CRI_mtranA_chk1&0xff=3:Mode 2}{CRI_mtranA_chk1&0xff=4:Mode 3}{CRI_mtranA_chk1&0xff=5:Mode 4}{CRI_mtranA_chk1&0xff=6:Mode 5}{CRI_mtran" VALUE 0x00170F57 /* @ECU_Address@CRI_mtranA_chk1@0x0100AF10@ */ ECIPP_ALIGNMENT_UBYTE 255 CRI_mtranA_chk1_COMPU_VTAB 0 255 BIT_MASK 0xff /end CHARACTERISTIC
/begin COMPU_METHOD CRI_mtranA_chk1_COMPU_VTAB "Verbal Table" TAB_VERB "%.0" "list" COMPU_TAB_REF CRI_mtranA_chk1_COMPU_VTAB_REF /end COMPU_METHOD
/begin COMPU_VTAB CRI_mtranA_chk1_COMPU_VTAB_REF "Verbal Table" TAB_VERB 11 0 "Inactive" 1 "Mode 0" 2 "Mode 1" 3 "Mode 2" 4 "Mode 3" 5 "Mode 4" 6 "Mode 5" 7 "Mode 6" 8 "Mode 7" 9 "Mode 8" 10 "Mode 9" DEFAULT_VALUE "UNKNOWN" /end COMPU_VTAB
/begin CHARACTERISTIC CRI_mtranA_chk2 "Check for transitioning to{CRI_mtranA_chk2&0xff=0:Inactive}{CRI_mtranA_chk2&0xff=1:Mode 0}{CRI_mtranA_chk2&0xff=2:Mode 1}{CRI_mtranA_chk2&0xff=3:Mode 2}{CRI_mtranA_chk2&0xff=4:Mode 3}{CRI_mtranA_chk2&0xff=5:Mode 4}{CRI_mtranA_chk2&0xff=6:Mode 5}{CRI_mtran" VALUE 0x00170F58 /* @ECU_Address@CRI_mtranA_chk2@0x0100AF18@ */ ECIPP_ALIGNMENT_UBYTE 255 CRI_mtranA_chk2_COMPU_VTAB 0 255 BIT_MASK 0xff /end CHARACTERISTIC
/begin COMPU_METHOD CRI_mtranA_chk2_COMPU_VTAB "Verbal Table" TAB_VERB "%.0" "list" COMPU_TAB_REF CRI_mtranA_chk2_COMPU_VTAB_REF /end COMPU_METHOD
/begin COMPU_VTAB CRI_mtranA_chk2_COMPU_VTAB_REF "Verbal Table" TAB_VERB 11 0 "Inactive" 1 "Mode 0" 2 "Mode 1" 3 "Mode 2" 4 "Mode 3" 5 "Mode 4" 6 "Mode 5" 7 "Mode 6" 8 "Mode 7" 9 "Mode 8" 10 "Mode 9" DEFAULT_VALUE "UNKNOWN" /end COMPU_VTAB
/begin CHARACTERISTIC CRI_mtranA_chk3 "Check for transitioning to{CRI_mtranA_chk3&0xff=0:Inactive}{CRI_mtranA_chk3&0xff=1:Mode 0}{CRI_mtranA_chk3&0xff=2:Mode 1}{CRI_mtranA_chk3&0xff=3:Mode 2}{CRI_mtranA_chk3&0xff=4:Mode 3}{CRI_mtranA_chk3&0xff=5:Mode 4}{CRI_mtranA_chk3&0xff=6:Mode 5}{CRI_mtran" VALUE 0x00170F59 /* @ECU_Address@CRI_mtranA_chk3@0x0100AF20@ */ ECIPP_ALIGNMENT_UBYTE 255 CRI_mtranA_chk3_COMPU_VTAB 0 255 BIT_MASK 0xff /end CHARACTERISTIC
/begin COMPU_METHOD CRI_mtranA_chk3_COMPU_VTAB "Verbal Table" TAB_VERB "%.0" "list" COMPU_TAB_REF CRI_mtranA_chk3_COMPU_VTAB_REF /end COMPU_METHOD
/begin COMPU_VTAB CRI_mtranA_chk3_COMPU_VTAB_REF "Verbal Table" TAB_VERB 11 0 "Inactive" 1 "Mode 0" 2 "Mode 1" 3 "Mode 2" 4 "Mode 3" 5 "Mode 4" 6 "Mode 5" 7 "Mode 6" 8 "Mode 7" 9 "Mode 8" 10 "Mode 9" DEFAULT_VALUE "UNKNOWN" /end COMPU_VTAB
/begin CHARACTERISTIC CRI_mtranA_chk4 "Check for transitioning to{CRI_mtranA_chk4&0xff=0:Inactive}{CRI_mtranA_chk4&0xff=1:Mode 0}{CRI_mtranA_chk4&0xff=2:Mode 1}{CRI_mtranA_chk4&0xff=3:Mode 2}{CRI_mtranA_chk4&0xff=4:Mode 3}{CRI_mtranA_chk4&0xff=5:Mode 4}{CRI_mtranA_chk4&0xff=6:Mode 5}{CRI_mtran" VALUE 0x00170F5A /* @ECU_Address@CRI_mtranA_chk4@0x0100AF28@ */ ECIPP_ALIGNMENT_UBYTE 255 CRI_mtranA_chk4_COMPU_VTAB 0 255 BIT_MASK 0xff /end CHARACTERISTIC
/begin COMPU_METHOD CRI_mtranA_chk4_COMPU_VTAB "Verbal Table" TAB_VERB "%.0" "list" COMPU_TAB_REF CRI_mtranA_chk4_COMPU_VTAB_REF /end COMPU_METHOD
/begin COMPU_VTAB CRI_mtranA_chk4_COMPU_VTAB_REF "Verbal Table" TAB_VERB 11 0 "Inactive" 1 "Mode 0" 2 "Mode 1" 3 "Mode 2" 4 "Mode 3" 5 "Mode 4" 6 "Mode 5" 7 "Mode 6" 8 "Mode 7" 9 "Mode 8" 10 "Mode 9" DEFAULT_VALUE "UNKNOWN" /end COMPU_VTAB
/begin CHARACTERISTIC CRI_mtranA_chk5 "Check for transitioning to{CRI_mtranA_chk5&0xff=0:Inactive}{CRI_mtranA_chk5&0xff=1:Mode 0}{CRI_mtranA_chk5&0xff=2:Mode 1}{CRI_mtranA_chk5&0xff=3:Mode 2}{CRI_mtranA_chk5&0xff=4:Mode 3}{CRI_mtranA_chk5&0xff=5:Mode 4}{CRI_mtranA_chk5&0xff=6:Mode 5}{CRI_mtran" VALUE 0x00170F5B /* @ECU_Address@CRI_mtranA_chk5@0x0100AF30@ */ ECIPP_ALIGNMENT_UBYTE 255 CRI_mtranA_chk5_COMPU_VTAB 0 255 BIT_MASK 0xff /end CHARACTERISTIC
/begin COMPU_METHOD CRI_mtranA_chk5_COMPU_VTAB "Verbal Table" TAB_VERB "%.0" "list" COMPU_TAB_REF CRI_mtranA_chk5_COMPU_VTAB_REF /end COMPU_METHOD
/begin COMPU_VTAB CRI_mtranA_chk5_COMPU_VTAB_REF "Verbal Table" TAB_VERB 11 0 "Inactive" 1 "Mode 0" 2 "Mode 1" 3 "Mode 2" 4 "Mode 3" 5 "Mode 4" 6 "Mode 5" 7 "Mode 6" 8 "Mode 7" 9 "Mode 8" 10 "Mode 9" DEFAULT_VALUE "UNKNOWN" /end COMPU_VTAB
/begin CHARACTERISTIC CRI_mtranA_chk6 "Check for transitioning to{CRI_mtranA_chk6&0xff=0:Inactive}{CRI_mtranA_chk6&0xff=1:Mode 0}{CRI_mtranA_chk6&0xff=2:Mode 1}{CRI_mtranA_chk6&0xff=3:Mode 2}{CRI_mtranA_chk6&0xff=4:Mode 3}{CRI_mtranA_chk6&0xff=5:Mode 4}{CRI_mtranA_chk6&0xff=6:Mode 5}{CRI_mtran" VALUE 0x00170F5C /* @ECU_Address@CRI_mtranA_chk6@0x0100AF38@ */ ECIPP_ALIGNMENT_UBYTE 255 CRI_mtranA_chk6_COMPU_VTAB 0 255 BIT_MASK 0xff /end CHARACTERISTIC
/begin COMPU_METHOD CRI_mtranA_chk6_COMPU_VTAB "Verbal Table" TAB_VERB "%.0" "list" COMPU_TAB_REF CRI_mtranA_chk6_COMPU_VTAB_REF /end COMPU_METHOD
/begin COMPU_VTAB CRI_mtranA_chk6_COMPU_VTAB_REF "Verbal Table" TAB_VERB 11 0 "Inactive" 1 "Mode 0" 2 "Mode 1" 3 "Mode 2" 4 "Mode 3" 5 "Mode 4" 6 "Mode 5" 7 "Mode 6" 8 "Mode 7" 9 "Mode 8" 10 "Mode 9" DEFAULT_VALUE "UNKNOWN" /end COMPU_VTAB
/begin CHARACTERISTIC CRI_mtranA_chk7 "Check for transitioning to{CRI_mtranA_chk7&0xff=0:Inactive}{CRI_mtranA_chk7&0xff=1:Mode 0}{CRI_mtranA_chk7&0xff=2:Mode 1}{CRI_mtranA_chk7&0xff=3:Mode 2}{CRI_mtranA_chk7&0xff=4:Mode 3}{CRI_mtranA_chk7&0xff=5:Mode 4}{CRI_mtranA_chk7&0xff=6:Mode 5}{CRI_mtran" VALUE 0x00170F5D /* @ECU_Address@CRI_mtranA_chk7@0x0100AF40@ */ ECIPP_ALIGNMENT_UBYTE 255 CRI_mtranA_chk7_COMPU_VTAB 0 255 BIT_MASK 0xff /end CHARACTERISTIC
/begin COMPU_METHOD CRI_mtranA_chk7_COMPU_VTAB "Verbal Table" TAB_VERB "%.0" "list" COMPU_TAB_REF CRI_mtranA_chk7_COMPU_VTAB_REF /end COMPU_METHOD
/begin COMPU_VTAB CRI_mtranA_chk7_COMPU_VTAB_REF "Verbal Table" TAB_VERB 11 0 "Inactive" 1 "Mode 0" 2 "Mode 1" 3 "Mode 2" 4 "Mode 3" 5 "Mode 4" 6 "Mode 5" 7 "Mode 6" 8 "Mode 7" 9 "Mode 8" 10 "Mode 9" DEFAULT_VALUE "UNKNOWN" /end COMPU_VTAB
/begin CHARACTERISTIC CRI_mtranA_chk8 "Check for transitioning to{CRI_mtranA_chk8&0xff=0:Inactive}{CRI_mtranA_chk8&0xff=1:Mode 0}{CRI_mtranA_chk8&0xff=2:Mode 1}{CRI_mtranA_chk8&0xff=3:Mode 2}{CRI_mtranA_chk8&0xff=4:Mode 3}{CRI_mtranA_chk8&0xff=5:Mode 4}{CRI_mtranA_chk8&0xff=6:Mode 5}{CRI_mtran" VALUE 0x00170F5E /* @ECU_Address@CRI_mtranA_chk8@0x0100AF48@ */ ECIPP_ALIGNMENT_UBYTE 255 CRI_mtranA_chk8_COMPU_VTAB 0 255 BIT_MASK 0xff /end CHARACTERISTIC
/begin COMPU_METHOD CRI_mtranA_chk8_COMPU_VTAB "Verbal Table" TAB_VERB "%.0" "list" COMPU_TAB_REF CRI_mtranA_chk8_COMPU_VTAB_REF /end COMPU_METHOD
/begin COMPU_VTAB CRI_mtranA_chk8_COMPU_VTAB_REF "Verbal Table" TAB_VERB 11 0 "Inactive" 1 "Mode 0" 2 "Mode 1" 3 "Mode 2" 4 "Mode 3" 5 "Mode 4" 6 "Mode 5" 7 "Mode 6" 8 "Mode 7" 9 "Mode 8" 10 "Mode 9" DEFAULT_VALUE "UNKNOWN" /end COMPU_VTAB
/begin CHARACTERISTIC CRI_mtranA_chk9 "Check for transitioning to{CRI_mtranA_chk9&0xff=0:Inactive}{CRI_mtranA_chk9&0xff=1:Mode 0}{CRI_mtranA_chk9&0xff=2:Mode 1}{CRI_mtranA_chk9&0xff=3:Mode 2}{CRI_mtranA_chk9&0xff=4:Mode 3}{CRI_mtranA_chk9&0xff=5:Mode 4}{CRI_mtranA_chk9&0xff=6:Mode 5}{CRI_mtran" VALUE 0x00170F5F /* @ECU_Address@CRI_mtranA_chk9@0x0100AF50@ */ ECIPP_ALIGNMENT_UBYTE 255 CRI_mtranA_chk9_COMPU_VTAB 0 255 BIT_MASK 0xff /end CHARACTERISTIC
/begin COMPU_METHOD CRI_mtranA_chk9_COMPU_VTAB "Verbal Table" TAB_VERB "%.0" "list" COMPU_TAB_REF CRI_mtranA_chk9_COMPU_VTAB_REF /end COMPU_METHOD
/begin COMPU_VTAB CRI_mtranA_chk9_COMPU_VTAB_REF "Verbal Table" TAB_VERB 11 0 "Inactive" 1 "Mode 0" 2 "Mode 1" 3 "Mode 2" 4 "Mode 3" 5 "Mode 4" 6 "Mode 5" 7 "Mode 6" 8 "Mode 7" 9 "Mode 8" 10 "Mode 9" DEFAULT_VALUE "UNKNOWN" /end COMPU_VTAB
/begin CHARACTERISTIC CRI_mtranB_chk0 "then check for transitioning to{CRI_mtranB_chk0&0xff=0:Inactive}{CRI_mtranB_chk0&0xff=1:Mode 0}{CRI_mtranB_chk0&0xff=2:Mode 1}{CRI_mtranB_chk0&0xff=3:Mode 2}{CRI_mtranB_chk0&0xff=4:Mode 3}{CRI_mtranB_chk0&0xff=5:Mode 4}{CRI_mtranB_chk0&0xff=6:Mode 5}{CRI_" VALUE 0x00170F60 /* @ECU_Address@CRI_mtranB_chk0@0x0100AF58@ */ ECIPP_ALIGNMENT_UBYTE 255 CRI_mtranB_chk0_COMPU_VTAB 0 255 BIT_MASK 0xff /end CHARACTERISTIC
/begin COMPU_METHOD CRI_mtranB_chk0_COMPU_VTAB "Verbal Table" TAB_VERB "%.0" "list" COMPU_TAB_REF CRI_mtranB_chk0_COMPU_VTAB_REF /end COMPU_METHOD
/begin COMPU_VTAB CRI_mtranB_chk0_COMPU_VTAB_REF "Verbal Table" TAB_VERB 11 0 "Inactive" 1 "Mode 0" 2 "Mode 1" 3 "Mode 2" 4 "Mode 3" 5 "Mode 4" 6 "Mode 5" 7 "Mode 6" 8 "Mode 7" 9 "Mode 8" 10 "Mode 9" DEFAULT_VALUE "UNKNOWN" /end COMPU_VTAB
/begin CHARACTERISTIC CRI_mtranB_chk1 "then check for transitioning to{CRI_mtranB_chk1&0xff=0:Inactive}{CRI_mtranB_chk1&0xff=1:Mode 0}{CRI_mtranB_chk1&0xff=2:Mode 1}{CRI_mtranB_chk1&0xff=3:Mode 2}{CRI_mtranB_chk1&0xff=4:Mode 3}{CRI_mtranB_chk1&0xff=5:Mode 4}{CRI_mtranB_chk1&0xff=6:Mode 5}{CRI_" VALUE 0x00170F61 /* @ECU_Address@CRI_mtranB_chk1@0x0100AF60@ */ ECIPP_ALIGNMENT_UBYTE 255 CRI_mtranB_chk1_COMPU_VTAB 0 255 BIT_MASK 0xff /end CHARACTERISTIC
/begin COMPU_METHOD CRI_mtranB_chk1_COMPU_VTAB "Verbal Table" TAB_VERB "%.0" "list" COMPU_TAB_REF CRI_mtranB_chk1_COMPU_VTAB_REF /end COMPU_METHOD
/begin COMPU_VTAB CRI_mtranB_chk1_COMPU_VTAB_REF "Verbal Table" TAB_VERB 11 0 "Inactive" 1 "Mode 0" 2 "Mode 1" 3 "Mode 2" 4 "Mode 3" 5 "Mode 4" 6 "Mode 5" 7 "Mode 6" 8 "Mode 7" 9 "Mode 8" 10 "Mode 9" DEFAULT_VALUE "UNKNOWN" /end COMPU_VTAB
/begin CHARACTERISTIC CRI_mtranB_chk2 "then check for transitioning to{CRI_mtranB_chk2&0xff=0:Inactive}{CRI_mtranB_chk2&0xff=1:Mode 0}{CRI_mtranB_chk2&0xff=2:Mode 1}{CRI_mtranB_chk2&0xff=3:Mode 2}{CRI_mtranB_chk2&0xff=4:Mode 3}{CRI_mtranB_chk2&0xff=5:Mode 4}{CRI_mtranB_chk2&0xff=6:Mode 5}{CRI_" VALUE 0x00170F62 /* @ECU_Address@CRI_mtranB_chk2@0x0100AF68@ */ ECIPP_ALIGNMENT_UBYTE 255 CRI_mtranB_chk2_COMPU_VTAB 0 255 BIT_MASK 0xff /end CHARACTERISTIC
/begin COMPU_METHOD CRI_mtranB_chk2_COMPU_VTAB "Verbal Table" TAB_VERB "%.0" "list" COMPU_TAB_REF CRI_mtranB_chk2_COMPU_VTAB_REF /end COMPU_METHOD
/begin COMPU_VTAB CRI_mtranB_chk2_COMPU_VTAB_REF "Verbal Table" TAB_VERB 11 0 "Inactive" 1 "Mode 0" 2 "Mode 1" 3 "Mode 2" 4 "Mode 3" 5 "Mode 4" 6 "Mode 5" 7 "Mode 6" 8 "Mode 7" 9 "Mode 8" 10 "Mode 9" DEFAULT_VALUE "UNKNOWN" /end COMPU_VTAB
/begin CHARACTERISTIC CRI_mtranB_chk3 "then check for transitioning to{CRI_mtranB_chk3&0xff=0:Inactive}{CRI_mtranB_chk3&0xff=1:Mode 0}{CRI_mtranB_chk3&0xff=2:Mode 1}{CRI_mtranB_chk3&0xff=3:Mode 2}{CRI_mtranB_chk3&0xff=4:Mode 3}{CRI_mtranB_chk3&0xff=5:Mode 4}{CRI_mtranB_chk3&0xff=6:Mode 5}{CRI_" VALUE 0x00170F63 /* @ECU_Address@CRI_mtranB_chk3@0x0100AF70@ */ ECIPP_ALIGNMENT_UBYTE 255 CRI_mtranB_chk3_COMPU_VTAB 0 255 BIT_MASK 0xff /end CHARACTERISTIC
/begin COMPU_METHOD CRI_mtranB_chk3_COMPU_VTAB "Verbal Table" TAB_VERB "%.0" "list" COMPU_TAB_REF CRI_mtranB_chk3_COMPU_VTAB_REF /end COMPU_METHOD
/begin COMPU_VTAB CRI_mtranB_chk3_COMPU_VTAB_REF "Verbal Table" TAB_VERB 11 0 "Inactive" 1 "Mode 0" 2 "Mode 1" 3 "Mode 2" 4 "Mode 3" 5 "Mode 4" 6 "Mode 5" 7 "Mode 6" 8 "Mode 7" 9 "Mode 8" 10 "Mode 9" DEFAULT_VALUE "UNKNOWN" /end COMPU_VTAB
/begin CHARACTERISTIC CRI_mtranB_chk4 "then check for transitioning to{CRI_mtranB_chk4&0xff=0:Inactive}{CRI_mtranB_chk4&0xff=1:Mode 0}{CRI_mtranB_chk4&0xff=2:Mode 1}{CRI_mtranB_chk4&0xff=3:Mode 2}{CRI_mtranB_chk4&0xff=4:Mode 3}{CRI_mtranB_chk4&0xff=5:Mode 4}{CRI_mtranB_chk4&0xff=6:Mode 5}{CRI_" VALUE 0x00170F64 /* @ECU_Address@CRI_mtranB_chk4@0x0100AF78@ */ ECIPP_ALIGNMENT_UBYTE 255 CRI_mtranB_chk4_COMPU_VTAB 0 255 BIT_MASK 0xff /end CHARACTERISTIC
/begin COMPU_METHOD CRI_mtranB_chk4_COMPU_VTAB "Verbal Table" TAB_VERB "%.0" "list" COMPU_TAB_REF CRI_mtranB_chk4_COMPU_VTAB_REF /end COMPU_METHOD
/begin COMPU_VTAB CRI_mtranB_chk4_COMPU_VTAB_REF "Verbal Table" TAB_VERB 11 0 "Inactive" 1 "Mode 0" 2 "Mode 1" 3 "Mode 2" 4 "Mode 3" 5 "Mode 4" 6 "Mode 5" 7 "Mode 6" 8 "Mode 7" 9 "Mode 8" 10 "Mode 9" DEFAULT_VALUE "UNKNOWN" /end COMPU_VTAB
/begin CHARACTERISTIC CRI_mtranB_chk5 "then check for transitioning to{CRI_mtranB_chk5&0xff=0:Inactive}{CRI_mtranB_chk5&0xff=1:Mode 0}{CRI_mtranB_chk5&0xff=2:Mode 1}{CRI_mtranB_chk5&0xff=3:Mode 2}{CRI_mtranB_chk5&0xff=4:Mode 3}{CRI_mtranB_chk5&0xff=5:Mode 4}{CRI_mtranB_chk5&0xff=6:Mode 5}{CRI_" VALUE 0x00170F65 /* @ECU_Address@CRI_mtranB_chk5@0x0100AF80@ */ ECIPP_ALIGNMENT_UBYTE 255 CRI_mtranB_chk5_COMPU_VTAB 0 255 BIT_MASK 0xff /end CHARACTERISTIC
/begin COMPU_METHOD CRI_mtranB_chk5_COMPU_VTAB "Verbal Table" TAB_VERB "%.0" "list" COMPU_TAB_REF CRI_mtranB_chk5_COMPU_VTAB_REF /end COMPU_METHOD
/begin COMPU_VTAB CRI_mtranB_chk5_COMPU_VTAB_REF "Verbal Table" TAB_VERB 11 0 "Inactive" 1 "Mode 0" 2 "Mode 1" 3 "Mode 2" 4 "Mode 3" 5 "Mode 4" 6 "Mode 5" 7 "Mode 6" 8 "Mode 7" 9 "Mode 8" 10 "Mode 9" DEFAULT_VALUE "UNKNOWN" /end COMPU_VTAB
/begin CHARACTERISTIC CRI_mtranB_chk6 "then check for transitioning to{CRI_mtranB_chk6&0xff=0:Inactive}{CRI_mtranB_chk6&0xff=1:Mode 0}{CRI_mtranB_chk6&0xff=2:Mode 1}{CRI_mtranB_chk6&0xff=3:Mode 2}{CRI_mtranB_chk6&0xff=4:Mode 3}{CRI_mtranB_chk6&0xff=5:Mode 4}{CRI_mtranB_chk6&0xff=6:Mode 5}{CRI_" VALUE 0x00170F66 /* @ECU_Address@CRI_mtranB_chk6@0x0100AF88@ */ ECIPP_ALIGNMENT_UBYTE 255 CRI_mtranB_chk6_COMPU_VTAB 0 255 BIT_MASK 0xff /end CHARACTERISTIC
/begin COMPU_METHOD CRI_mtranB_chk6_COMPU_VTAB "Verbal Table" TAB_VERB "%.0" "list" COMPU_TAB_REF CRI_mtranB_chk6_COMPU_VTAB_REF /end COMPU_METHOD
/begin COMPU_VTAB CRI_mtranB_chk6_COMPU_VTAB_REF "Verbal Table" TAB_VERB 11 0 "Inactive" 1 "Mode 0" 2 "Mode 1" 3 "Mode 2" 4 "Mode 3" 5 "Mode 4" 6 "Mode 5" 7 "Mode 6" 8 "Mode 7" 9 "Mode 8" 10 "Mode 9" DEFAULT_VALUE "UNKNOWN" /end COMPU_VTAB
/begin CHARACTERISTIC CRI_mtranB_chk7 "then check for transitioning to{CRI_mtranB_chk7&0xff=0:Inactive}{CRI_mtranB_chk7&0xff=1:Mode 0}{CRI_mtranB_chk7&0xff=2:Mode 1}{CRI_mtranB_chk7&0xff=3:Mode 2}{CRI_mtranB_chk7&0xff=4:Mode 3}{CRI_mtranB_chk7&0xff=5:Mode 4}{CRI_mtranB_chk7&0xff=6:Mode 5}{CRI_" VALUE 0x00170F67 /* @ECU_Address@CRI_mtranB_chk7@0x0100AF90@ */ ECIPP_ALIGNMENT_UBYTE 255 CRI_mtranB_chk7_COMPU_VTAB 0 255 BIT_MASK 0xff /end CHARACTERISTIC
/begin COMPU_METHOD CRI_mtranB_chk7_COMPU_VTAB "Verbal Table" TAB_VERB "%.0" "list" COMPU_TAB_REF CRI_mtranB_chk7_COMPU_VTAB_REF /end COMPU_METHOD
/begin COMPU_VTAB CRI_mtranB_chk7_COMPU_VTAB_REF "Verbal Table" TAB_VERB 11 0 "Inactive" 1 "Mode 0" 2 "Mode 1" 3 "Mode 2" 4 "Mode 3" 5 "Mode 4" 6 "Mode 5" 7 "Mode 6" 8 "Mode 7" 9 "Mode 8" 10 "Mode 9" DEFAULT_VALUE "UNKNOWN" /end COMPU_VTAB
/begin CHARACTERISTIC CRI_mtranB_chk8 "then check for transitioning to{CRI_mtranB_chk8&0xff=0:Inactive}{CRI_mtranB_chk8&0xff=1:Mode 0}{CRI_mtranB_chk8&0xff=2:Mode 1}{CRI_mtranB_chk8&0xff=3:Mode 2}{CRI_mtranB_chk8&0xff=4:Mode 3}{CRI_mtranB_chk8&0xff=5:Mode 4}{CRI_mtranB_chk8&0xff=6:Mode 5}{CRI_" VALUE 0x00170F68 /* @ECU_Address@CRI_mtranB_chk8@0x0100AF98@ */ ECIPP_ALIGNMENT_UBYTE 255 CRI_mtranB_chk8_COMPU_VTAB 0 255 BIT_MASK 0xff /end CHARACTERISTIC
/begin COMPU_METHOD CRI_mtranB_chk8_COMPU_VTAB "Verbal Table" TAB_VERB "%.0" "list" COMPU_TAB_REF CRI_mtranB_chk8_COMPU_VTAB_REF /end COMPU_METHOD
/begin COMPU_VTAB CRI_mtranB_chk8_COMPU_VTAB_REF "Verbal Table" TAB_VERB 11 0 "Inactive" 1 "Mode 0" 2 "Mode 1" 3 "Mode 2" 4 "Mode 3" 5 "Mode 4" 6 "Mode 5" 7 "Mode 6" 8 "Mode 7" 9 "Mode 8" 10 "Mode 9" DEFAULT_VALUE "UNKNOWN" /end COMPU_VTAB
/begin CHARACTERISTIC CRI_mtranB_chk9 "then check for transitioning to{CRI_mtranB_chk9&0xff=0:Inactive}{CRI_mtranB_chk9&0xff=1:Mode 0}{CRI_mtranB_chk9&0xff=2:Mode 1}{CRI_mtranB_chk9&0xff=3:Mode 2}{CRI_mtranB_chk9&0xff=4:Mode 3}{CRI_mtranB_chk9&0xff=5:Mode 4}{CRI_mtranB_chk9&0xff=6:Mode 5}{CRI_" VALUE 0x00170F69 /* @ECU_Address@CRI_mtranB_chk9@0x0100AFA0@ */ ECIPP_ALIGNMENT_UBYTE 255 CRI_mtranB_chk9_COMPU_VTAB 0 255 BIT_MASK 0xff /end CHARACTERISTIC
/begin COMPU_METHOD CRI_mtranB_chk9_COMPU_VTAB "Verbal Table" TAB_VERB "%.0" "list" COMPU_TAB_REF CRI_mtranB_chk9_COMPU_VTAB_REF /end COMPU_METHOD
/begin COMPU_VTAB CRI_mtranB_chk9_COMPU_VTAB_REF "Verbal Table" TAB_VERB 11 0 "Inactive" 1 "Mode 0" 2 "Mode 1" 3 "Mode 2" 4 "Mode 3" 5 "Mode 4" 6 "Mode 5" 7 "Mode 6" 8 "Mode 7" 9 "Mode 8" 10 "Mode 9" DEFAULT_VALUE "UNKNOWN" /end COMPU_VTAB
/begin CHARACTERISTIC CRI_mtranC_chk0 "then check for transitioning to{CRI_mtranC_chk0&0xff=0:Inactive}{CRI_mtranC_chk0&0xff=1:Mode 0}{CRI_mtranC_chk0&0xff=2:Mode 1}{CRI_mtranC_chk0&0xff=3:Mode 2}{CRI_mtranC_chk0&0xff=4:Mode 3}{CRI_mtranC_chk0&0xff=5:Mode 4}{CRI_mtranC_chk0&0xff=6:Mode 5}{CRI_" VALUE 0x00170F6A /* @ECU_Address@CRI_mtranC_chk0@0x0100AFA8@ */ ECIPP_ALIGNMENT_UBYTE 255 CRI_mtranC_chk0_COMPU_VTAB 0 255 BIT_MASK 0xff /end CHARACTERISTIC
/begin COMPU_METHOD CRI_mtranC_chk0_COMPU_VTAB "Verbal Table" TAB_VERB "%.0" "list" COMPU_TAB_REF CRI_mtranC_chk0_COMPU_VTAB_REF /end COMPU_METHOD
/begin COMPU_VTAB CRI_mtranC_chk0_COMPU_VTAB_REF "Verbal Table" TAB_VERB 11 0 "Inactive" 1 "Mode 0" 2 "Mode 1" 3 "Mode 2" 4 "Mode 3" 5 "Mode 4" 6 "Mode 5" 7 "Mode 6" 8 "Mode 7" 9 "Mode 8" 10 "Mode 9" DEFAULT_VALUE "UNKNOWN" /end COMPU_VTAB
/begin CHARACTERISTIC CRI_mtranC_chk1 "then check for transitioning to{CRI_mtranC_chk1&0xff=0:Inactive}{CRI_mtranC_chk1&0xff=1:Mode 0}{CRI_mtranC_chk1&0xff=2:Mode 1}{CRI_mtranC_chk1&0xff=3:Mode 2}{CRI_mtranC_chk1&0xff=4:Mode 3}{CRI_mtranC_chk1&0xff=5:Mode 4}{CRI_mtranC_chk1&0xff=6:Mode 5}{CRI_" VALUE 0x00170F6B /* @ECU_Address@CRI_mtranC_chk1@0x0100AFB0@ */ ECIPP_ALIGNMENT_UBYTE 255 CRI_mtranC_chk1_COMPU_VTAB 0 255 BIT_MASK 0xff /end CHARACTERISTIC
/begin COMPU_METHOD CRI_mtranC_chk1_COMPU_VTAB "Verbal Table" TAB_VERB "%.0" "list" COMPU_TAB_REF CRI_mtranC_chk1_COMPU_VTAB_REF /end COMPU_METHOD
/begin COMPU_VTAB CRI_mtranC_chk1_COMPU_VTAB_REF "Verbal Table" TAB_VERB 11 0 "Inactive" 1 "Mode 0" 2 "Mode 1" 3 "Mode 2" 4 "Mode 3" 5 "Mode 4" 6 "Mode 5" 7 "Mode 6" 8 "Mode 7" 9 "Mode 8" 10 "Mode 9" DEFAULT_VALUE "UNKNOWN" /end COMPU_VTAB
/begin CHARACTERISTIC CRI_mtranC_chk2 "then check for transitioning to{CRI_mtranC_chk2&0xff=0:Inactive}{CRI_mtranC_chk2&0xff=1:Mode 0}{CRI_mtranC_chk2&0xff=2:Mode 1}{CRI_mtranC_chk2&0xff=3:Mode 2}{CRI_mtranC_chk2&0xff=4:Mode 3}{CRI_mtranC_chk2&0xff=5:Mode 4}{CRI_mtranC_chk2&0xff=6:Mode 5}{CRI_" VALUE 0x00170F6C /* @ECU_Address@CRI_mtranC_chk2@0x0100AFB8@ */ ECIPP_ALIGNMENT_UBYTE 255 CRI_mtranC_chk2_COMPU_VTAB 0 255 BIT_MASK 0xff /end CHARACTERISTIC
/begin COMPU_METHOD CRI_mtranC_chk2_COMPU_VTAB "Verbal Table" TAB_VERB "%.0" "list" COMPU_TAB_REF CRI_mtranC_chk2_COMPU_VTAB_REF /end COMPU_METHOD
/begin COMPU_VTAB CRI_mtranC_chk2_COMPU_VTAB_REF "Verbal Table" TAB_VERB 11 0 "Inactive" 1 "Mode 0" 2 "Mode 1" 3 "Mode 2" 4 "Mode 3" 5 "Mode 4" 6 "Mode 5" 7 "Mode 6" 8 "Mode 7" 9 "Mode 8" 10 "Mode 9" DEFAULT_VALUE "UNKNOWN" /end COMPU_VTAB
/begin CHARACTERISTIC CRI_mtranC_chk3 "then check for transitioning to{CRI_mtranC_chk3&0xff=0:Inactive}{CRI_mtranC_chk3&0xff=1:Mode 0}{CRI_mtranC_chk3&0xff=2:Mode 1}{CRI_mtranC_chk3&0xff=3:Mode 2}{CRI_mtranC_chk3&0xff=4:Mode 3}{CRI_mtranC_chk3&0xff=5:Mode 4}{CRI_mtranC_chk3&0xff=6:Mode 5}{CRI_" VALUE 0x00170F6D /* @ECU_Address@CRI_mtranC_chk3@0x0100AFC0@ */ ECIPP_ALIGNMENT_UBYTE 255 CRI_mtranC_chk3_COMPU_VTAB 0 255 BIT_MASK 0xff /end CHARACTERISTIC
/begin COMPU_METHOD CRI_mtranC_chk3_COMPU_VTAB "Verbal Table" TAB_VERB "%.0" "list" COMPU_TAB_REF CRI_mtranC_chk3_COMPU_VTAB_REF /end COMPU_METHOD
/begin COMPU_VTAB CRI_mtranC_chk3_COMPU_VTAB_REF "Verbal Table" TAB_VERB 11 0 "Inactive" 1 "Mode 0" 2 "Mode 1" 3 "Mode 2" 4 "Mode 3" 5 "Mode 4" 6 "Mode 5" 7 "Mode 6" 8 "Mode 7" 9 "Mode 8" 10 "Mode 9" DEFAULT_VALUE "UNKNOWN" /end COMPU_VTAB
/begin CHARACTERISTIC CRI_mtranC_chk4 "then check for transitioning to{CRI_mtranC_chk4&0xff=0:Inactive}{CRI_mtranC_chk4&0xff=1:Mode 0}{CRI_mtranC_chk4&0xff=2:Mode 1}{CRI_mtranC_chk4&0xff=3:Mode 2}{CRI_mtranC_chk4&0xff=4:Mode 3}{CRI_mtranC_chk4&0xff=5:Mode 4}{CRI_mtranC_chk4&0xff=6:Mode 5}{CRI_" VALUE 0x00170F6E /* @ECU_Address@CRI_mtranC_chk4@0x0100AFC8@ */ ECIPP_ALIGNMENT_UBYTE 255 CRI_mtranC_chk4_COMPU_VTAB 0 255 BIT_MASK 0xff /end CHARACTERISTIC
/begin COMPU_METHOD CRI_mtranC_chk4_COMPU_VTAB "Verbal Table" TAB_VERB "%.0" "list" COMPU_TAB_REF CRI_mtranC_chk4_COMPU_VTAB_REF /end COMPU_METHOD
/begin COMPU_VTAB CRI_mtranC_chk4_COMPU_VTAB_REF "Verbal Table" TAB_VERB 11 0 "Inactive" 1 "Mode 0" 2 "Mode 1" 3 "Mode 2" 4 "Mode 3" 5 "Mode 4" 6 "Mode 5" 7 "Mode 6" 8 "Mode 7" 9 "Mode 8" 10 "Mode 9" DEFAULT_VALUE "UNKNOWN" /end COMPU_VTAB
/begin CHARACTERISTIC CRI_mtranC_chk5 "then check for transitioning to{CRI_mtranC_chk5&0xff=0:Inactive}{CRI_mtranC_chk5&0xff=1:Mode 0}{CRI_mtranC_chk5&0xff=2:Mode 1}{CRI_mtranC_chk5&0xff=3:Mode 2}{CRI_mtranC_chk5&0xff=4:Mode 3}{CRI_mtranC_chk5&0xff=5:Mode 4}{CRI_mtranC_chk5&0xff=6:Mode 5}{CRI_" VALUE 0x00170F6F /* @ECU_Address@CRI_mtranC_chk5@0x0100AFD0@ */ ECIPP_ALIGNMENT_UBYTE 255 CRI_mtranC_chk5_COMPU_VTAB 0 255 BIT_MASK 0xff /end CHARACTERISTIC
/begin COMPU_METHOD CRI_mtranC_chk5_COMPU_VTAB "Verbal Table" TAB_VERB "%.0" "list" COMPU_TAB_REF CRI_mtranC_chk5_COMPU_VTAB_REF /end COMPU_METHOD
/begin COMPU_VTAB CRI_mtranC_chk5_COMPU_VTAB_REF "Verbal Table" TAB_VERB 11 0 "Inactive" 1 "Mode 0" 2 "Mode 1" 3 "Mode 2" 4 "Mode 3" 5 "Mode 4" 6 "Mode 5" 7 "Mode 6" 8 "Mode 7" 9 "Mode 8" 10 "Mode 9" DEFAULT_VALUE "UNKNOWN" /end COMPU_VTAB
/begin CHARACTERISTIC CRI_mtranC_chk6 "then check for transitioning to{CRI_mtranC_chk6&0xff=0:Inactive}{CRI_mtranC_chk6&0xff=1:Mode 0}{CRI_mtranC_chk6&0xff=2:Mode 1}{CRI_mtranC_chk6&0xff=3:Mode 2}{CRI_mtranC_chk6&0xff=4:Mode 3}{CRI_mtranC_chk6&0xff=5:Mode 4}{CRI_mtranC_chk6&0xff=6:Mode 5}{CRI_" VALUE 0x00170F70 /* @ECU_Address@CRI_mtranC_chk6@0x0100AFD8@ */ ECIPP_ALIGNMENT_UBYTE 255 CRI_mtranC_chk6_COMPU_VTAB 0 255 BIT_MASK 0xff /end CHARACTERISTIC
/begin COMPU_METHOD CRI_mtranC_chk6_COMPU_VTAB "Verbal Table" TAB_VERB "%.0" "list" COMPU_TAB_REF CRI_mtranC_chk6_COMPU_VTAB_REF /end COMPU_METHOD
/begin COMPU_VTAB CRI_mtranC_chk6_COMPU_VTAB_REF "Verbal Table" TAB_VERB 11 0 "Inactive" 1 "Mode 0" 2 "Mode 1" 3 "Mode 2" 4 "Mode 3" 5 "Mode 4" 6 "Mode 5" 7 "Mode 6" 8 "Mode 7" 9 "Mode 8" 10 "Mode 9" DEFAULT_VALUE "UNKNOWN" /end COMPU_VTAB
/begin CHARACTERISTIC CRI_mtranC_chk7 "then check for transitioning to{CRI_mtranC_chk7&0xff=0:Inactive}{CRI_mtranC_chk7&0xff=1:Mode 0}{CRI_mtranC_chk7&0xff=2:Mode 1}{CRI_mtranC_chk7&0xff=3:Mode 2}{CRI_mtranC_chk7&0xff=4:Mode 3}{CRI_mtranC_chk7&0xff=5:Mode 4}{CRI_mtranC_chk7&0xff=6:Mode 5}{CRI_" VALUE 0x00170F71 /* @ECU_Address@CRI_mtranC_chk7@0x0100AFE0@ */ ECIPP_ALIGNMENT_UBYTE 255 CRI_mtranC_chk7_COMPU_VTAB 0 255 BIT_MASK 0xff /end CHARACTERISTIC
/begin COMPU_METHOD CRI_mtranC_chk7_COMPU_VTAB "Verbal Table" TAB_VERB "%.0" "list" COMPU_TAB_REF CRI_mtranC_chk7_COMPU_VTAB_REF /end COMPU_METHOD
/begin COMPU_VTAB CRI_mtranC_chk7_COMPU_VTAB_REF "Verbal Table" TAB_VERB 11 0 "Inactive" 1 "Mode 0" 2 "Mode 1" 3 "Mode 2" 4 "Mode 3" 5 "Mode 4" 6 "Mode 5" 7 "Mode 6" 8 "Mode 7" 9 "Mode 8" 10 "Mode 9" DEFAULT_VALUE "UNKNOWN" /end COMPU_VTAB
/begin CHARACTERISTIC CRI_mtranC_chk8 "then check for transitioning to{CRI_mtranC_chk8&0xff=0:Inactive}{CRI_mtranC_chk8&0xff=1:Mode 0}{CRI_mtranC_chk8&0xff=2:Mode 1}{CRI_mtranC_chk8&0xff=3:Mode 2}{CRI_mtranC_chk8&0xff=4:Mode 3}{CRI_mtranC_chk8&0xff=5:Mode 4}{CRI_mtranC_chk8&0xff=6:Mode 5}{CRI_" VALUE 0x00170F72 /* @ECU_Address@CRI_mtranC_chk8@0x0100AFE8@ */ ECIPP_ALIGNMENT_UBYTE 255 CRI_mtranC_chk8_COMPU_VTAB 0 255 BIT_MASK 0xff /end CHARACTERISTIC
/begin COMPU_METHOD CRI_mtranC_chk8_COMPU_VTAB "Verbal Table" TAB_VERB "%.0" "list" COMPU_TAB_REF CRI_mtranC_chk8_COMPU_VTAB_REF /end COMPU_METHOD
/begin COMPU_VTAB CRI_mtranC_chk8_COMPU_VTAB_REF "Verbal Table" TAB_VERB 11 0 "Inactive" 1 "Mode 0" 2 "Mode 1" 3 "Mode 2" 4 "Mode 3" 5 "Mode 4" 6 "Mode 5" 7 "Mode 6" 8 "Mode 7" 9 "Mode 8" 10 "Mode 9" DEFAULT_VALUE "UNKNOWN" /end COMPU_VTAB
/begin CHARACTERISTIC CRI_mtranC_chk9 "then check for transitioning to{CRI_mtranC_chk9&0xff=0:Inactive}{CRI_mtranC_chk9&0xff=1:Mode 0}{CRI_mtranC_chk9&0xff=2:Mode 1}{CRI_mtranC_chk9&0xff=3:Mode 2}{CRI_mtranC_chk9&0xff=4:Mode 3}{CRI_mtranC_chk9&0xff=5:Mode 4}{CRI_mtranC_chk9&0xff=6:Mode 5}{CRI_" VALUE 0x00170F73 /* @ECU_Address@CRI_mtranC_chk9@0x0100AFF0@ */ ECIPP_ALIGNMENT_UBYTE 255 CRI_mtranC_chk9_COMPU_VTAB 0 255 BIT_MASK 0xff /end CHARACTERISTIC
/begin COMPU_METHOD CRI_mtranC_chk9_COMPU_VTAB "Verbal Table" TAB_VERB "%.0" "list" COMPU_TAB_REF CRI_mtranC_chk9_COMPU_VTAB_REF /end COMPU_METHOD
/begin COMPU_VTAB CRI_mtranC_chk9_COMPU_VTAB_REF "Verbal Table" TAB_VERB 11 0 "Inactive" 1 "Mode 0" 2 "Mode 1" 3 "Mode 2" 4 "Mode 3" 5 "Mode 4" 6 "Mode 5" 7 "Mode 6" 8 "Mode 7" 9 "Mode 8" 10 "Mode 9" DEFAULT_VALUE "UNKNOWN" /end COMPU_VTAB
/begin CHARACTERISTIC CRI_mtranA_persist0 "after being in this mode for" VALUE 0x0016DA6C /* @ECU_Address@CRI_mtranA_persist0@0x0100AFF8@ */ ECIPP_ALIGNMENT_ULONG 4294967 Compu_CRI_mtranA_persist0 0 4294967.295 /end CHARACTERISTIC
/begin COMPU_METHOD Compu_CRI_mtranA_persist0 " " RAT_FUNC "%.1" "sec" COEFFS 0 1000 0 0 0 1 /end COMPU_METHOD
/begin CHARACTERISTIC CRI_mtranA_persist1 "after being in this mode for" VALUE 0x0016DA70 /* @ECU_Address@CRI_mtranA_persist1@0x0100B000@ */ ECIPP_ALIGNMENT_ULONG 4294967 Compu_CRI_mtranA_persist1 0 4294967.295 /end CHARACTERISTIC
/begin COMPU_METHOD Compu_CRI_mtranA_persist1 " " RAT_FUNC "%.1" "sec" COEFFS 0 1000 0 0 0 1 /end COMPU_METHOD
/begin CHARACTERISTIC CRI_mtranA_persist2 "after being in this mode for" VALUE 0x0016DA74 /* @ECU_Address@CRI_mtranA_persist2@0x0100B008@ */ ECIPP_ALIGNMENT_ULONG 4294967 Compu_CRI_mtranA_persist2 0 4294967.295 /end CHARACTERISTIC
/begin COMPU_METHOD Compu_CRI_mtranA_persist2 " " RAT_FUNC "%.1" "sec" COEFFS 0 1000 0 0 0 1 /end COMPU_METHOD
/begin CHARACTERISTIC CRI_mtranA_persist3 "after being in this mode for" VALUE 0x0016DA78 /* @ECU_Address@CRI_mtranA_persist3@0x0100B010@ */ ECIPP_ALIGNMENT_ULONG 4294967 Compu_CRI_mtranA_persist3 0 4294967.295 /end CHARACTERISTIC
/begin COMPU_METHOD Compu_CRI_mtranA_persist3 " " RAT_FUNC "%.1" "sec" COEFFS 0 1000 0 0 0 1 /end COMPU_METHOD
/begin CHARACTERISTIC CRI_mtranA_persist4 "after being in this mode for" VALUE 0x0016DA7C /* @ECU_Address@CRI_mtranA_persist4@0x0100B018@ */ ECIPP_ALIGNMENT_ULONG 4294967 Compu_CRI_mtranA_persist4 0 4294967.295 /end CHARACTERISTIC
/begin COMPU_METHOD Compu_CRI_mtranA_persist4 " " RAT_FUNC "%.1" "sec" COEFFS 0 1000 0 0 0 1 /end COMPU_METHOD
/begin CHARACTERISTIC CRI_mtranA_persist5 "after being in this mode for" VALUE 0x0016DA80 /* @ECU_Address@CRI_mtranA_persist5@0x0100B020@ */ ECIPP_ALIGNMENT_ULONG 4294967 Compu_CRI_mtranA_persist5 0 4294967.295 /end CHARACTERISTIC
/begin COMPU_METHOD Compu_CRI_mtranA_persist5 " " RAT_FUNC "%.1" "sec" COEFFS 0 1000 0 0 0 1 /end COMPU_METHOD
/begin CHARACTERISTIC CRI_mtranA_persist6 "after being in this mode for" VALUE 0x0016DA84 /* @ECU_Address@CRI_mtranA_persist6@0x0100B028@ */ ECIPP_ALIGNMENT_ULONG 4294967 Compu_CRI_mtranA_persist6 0 4294967.295 /end CHARACTERISTIC
/begin COMPU_METHOD Compu_CRI_mtranA_persist6 " " RAT_FUNC "%.1" "sec" COEFFS 0 1000 0 0 0 1 /end COMPU_METHOD
/begin CHARACTERISTIC CRI_mtranA_persist7 "after being in this mode for" VALUE 0x0016DA88 /* @ECU_Address@CRI_mtranA_persist7@0x0100B030@ */ ECIPP_ALIGNMENT_ULONG 4294967 Compu_CRI_mtranA_persist7 0 4294967.295 /end CHARACTERISTIC
/begin COMPU_METHOD Compu_CRI_mtranA_persist7 " " RAT_FUNC "%.1" "sec" COEFFS 0 1000 0 0 0 1 /end COMPU_METHOD
/begin CHARACTERISTIC CRI_mtranA_persist8 "after being in this mode for" VALUE 0x0016DA8C /* @ECU_Address@CRI_mtranA_persist8@0x0100B038@ */ ECIPP_ALIGNMENT_ULONG 4294967 Compu_CRI_mtranA_persist8 0 4294967.295 /end CHARACTERISTIC
/begin COMPU_METHOD Compu_CRI_mtranA_persist8 " " RAT_FUNC "%.1" "sec" COEFFS 0 1000 0 0 0 1 /end COMPU_METHOD
/begin CHARACTERISTIC CRI_mtranA_persist9 "after being in this mode for" VALUE 0x0016DA90 /* @ECU_Address@CRI_mtranA_persist9@0x0100B040@ */ ECIPP_ALIGNMENT_ULONG 4294967 Compu_CRI_mtranA_persist9 0 4294967.295 /end CHARACTERISTIC
/begin COMPU_METHOD Compu_CRI_mtranA_persist9 " " RAT_FUNC "%.1" "sec" COEFFS 0 1000 0 0 0 1 /end COMPU_METHOD
/begin CHARACTERISTIC CRI_mtranB_persist0 "after being in this mode for" VALUE 0x0016DA94 /* @ECU_Address@CRI_mtranB_persist0@0x0100B048@ */ ECIPP_ALIGNMENT_ULONG 4294967 Compu_CRI_mtranB_persist0 0 4294967.295 /end CHARACTERISTIC
/begin COMPU_METHOD Compu_CRI_mtranB_persist0 " " RAT_FUNC "%.1" "sec" COEFFS 0 1000 0 0 0 1 /end COMPU_METHOD
/begin CHARACTERISTIC CRI_mtranB_persist1 "after being in this mode for" VALUE 0x0016DA98 /* @ECU_Address@CRI_mtranB_persist1@0x0100B050@ */ ECIPP_ALIGNMENT_ULONG 4294967 Compu_CRI_mtranB_persist1 0 4294967.295 /end CHARACTERISTIC
/begin COMPU_METHOD Compu_CRI_mtranB_persist1 " " RAT_FUNC "%.1" "sec" COEFFS 0 1000 0 0 0 1 /end COMPU_METHOD
/begin CHARACTERISTIC CRI_mtranB_persist2 "after being in this mode for" VALUE 0x0016DA9C /* @ECU_Address@CRI_mtranB_persist2@0x0100B058@ */ ECIPP_ALIGNMENT_ULONG 4294967 Compu_CRI_mtranB_persist2 0 4294967.295 /end CHARACTERISTIC
/begin COMPU_METHOD Compu_CRI_mtranB_persist2 " " RAT_FUNC "%.1" "sec" COEFFS 0 1000 0 0 0 1 /end COMPU_METHOD
/begin CHARACTERISTIC CRI_mtranB_persist3 "after being in this mode for" VALUE 0x0016DAA0 /* @ECU_Address@CRI_mtranB_persist3@0x0100B060@ */ ECIPP_ALIGNMENT_ULONG 4294967 Compu_CRI_mtranB_persist3 0 4294967.295 /end CHARACTERISTIC
/begin COMPU_METHOD Compu_CRI_mtranB_persist3 " " RAT_FUNC "%.1" "sec" COEFFS 0 1000 0 0 0 1 /end COMPU_METHOD
/begin CHARACTERISTIC CRI_mtranB_persist4 "after being in this mode for" VALUE 0x0016DAA4 /* @ECU_Address@CRI_mtranB_persist4@0x0100B068@ */ ECIPP_ALIGNMENT_ULONG 4294967 Compu_CRI_mtranB_persist4 0 4294967.295 /end CHARACTERISTIC
/begin COMPU_METHOD Compu_CRI_mtranB_persist4 " " RAT_FUNC "%.1" "sec" COEFFS 0 1000 0 0 0 1 /end COMPU_METHOD
/begin CHARACTERISTIC CRI_mtranB_persist5 "after being in this mode for" VALUE 0x0016DAA8 /* @ECU_Address@CRI_mtranB_persist5@0x0100B070@ */ ECIPP_ALIGNMENT_ULONG 4294967 Compu_CRI_mtranB_persist5 0 4294967.295 /end CHARACTERISTIC
/begin COMPU_METHOD Compu_CRI_mtranB_persist5 " " RAT_FUNC "%.1" "sec" COEFFS 0 1000 0 0 0 1 /end COMPU_METHOD
/begin CHARACTERISTIC CRI_mtranB_persist6 "after being in this mode for" VALUE 0x0016DAAC /* @ECU_Address@CRI_mtranB_persist6@0x0100B078@ */ ECIPP_ALIGNMENT_ULONG 4294967 Compu_CRI_mtranB_persist6 0 4294967.295 /end CHARACTERISTIC
/begin COMPU_METHOD Compu_CRI_mtranB_persist6 " " RAT_FUNC "%.1" "sec" COEFFS 0 1000 0 0 0 1 /end COMPU_METHOD
/begin CHARACTERISTIC CRI_mtranB_persist7 "after being in this mode for" VALUE 0x0016DAB0 /* @ECU_Address@CRI_mtranB_persist7@0x0100B080@ */ ECIPP_ALIGNMENT_ULONG 4294967 Compu_CRI_mtranB_persist7 0 4294967.295 /end CHARACTERISTIC
/begin COMPU_METHOD Compu_CRI_mtranB_persist7 " " RAT_FUNC "%.1" "sec" COEFFS 0 1000 0 0 0 1 /end COMPU_METHOD
/begin CHARACTERISTIC CRI_mtranB_persist8 "after being in this mode for" VALUE 0x0016DAB4 /* @ECU_Address@CRI_mtranB_persist8@0x0100B088@ */ ECIPP_ALIGNMENT_ULONG 4294967 Compu_CRI_mtranB_persist8 0 4294967.295 /end CHARACTERISTIC
/begin COMPU_METHOD Compu_CRI_mtranB_persist8 " " RAT_FUNC "%.1" "sec" COEFFS 0 1000 0 0 0 1 /end COMPU_METHOD
/begin CHARACTERISTIC CRI_mtranB_persist9 "after being in this mode for" VALUE 0x0016DAB8 /* @ECU_Address@CRI_mtranB_persist9@0x0100B090@ */ ECIPP_ALIGNMENT_ULONG 4294967 Compu_CRI_mtranB_persist9 0 4294967.295 /end CHARACTERISTIC
/begin COMPU_METHOD Compu_CRI_mtranB_persist9 " " RAT_FUNC "%.1" "sec" COEFFS 0 1000 0 0 0 1 /end COMPU_METHOD
/begin CHARACTERISTIC CRI_mtranC_persist0 "after being in this mode for" VALUE 0x0016DABC /* @ECU_Address@CRI_mtranC_persist0@0x0100B098@ */ ECIPP_ALIGNMENT_ULONG 4294967 Compu_CRI_mtranC_persist0 0 4294967.295 /end CHARACTERISTIC
/begin COMPU_METHOD Compu_CRI_mtranC_persist0 " " RAT_FUNC "%.1" "sec" COEFFS 0 1000 0 0 0 1 /end COMPU_METHOD
/begin CHARACTERISTIC CRI_mtranC_persist1 "after being in this mode for" VALUE 0x0016DAC0 /* @ECU_Address@CRI_mtranC_persist1@0x0100B0A0@ */ ECIPP_ALIGNMENT_ULONG 4294967 Compu_CRI_mtranC_persist1 0 4294967.295 /end CHARACTERISTIC
/begin COMPU_METHOD Compu_CRI_mtranC_persist1 " " RAT_FUNC "%.1" "sec" COEFFS 0 1000 0 0 0 1 /end COMPU_METHOD
/begin CHARACTERISTIC CRI_mtranC_persist2 "after being in this mode for" VALUE 0x0016DAC4 /* @ECU_Address@CRI_mtranC_persist2@0x0100B0A8@ */ ECIPP_ALIGNMENT_ULONG 4294967 Compu_CRI_mtranC_persist2 0 4294967.295 /end CHARACTERISTIC
/begin COMPU_METHOD Compu_CRI_mtranC_persist2 " " RAT_FUNC "%.1" "sec" COEFFS 0 1000 0 0 0 1 /end COMPU_METHOD
/begin CHARACTERISTIC CRI_mtranC_persist3 "after being in this mode for" VALUE 0x0016DAC8 /* @ECU_Address@CRI_mtranC_persist3@0x0100B0B0@ */ ECIPP_ALIGNMENT_ULONG 4294967 Compu_CRI_mtranC_persist3 0 4294967.295 /end CHARACTERISTIC
/begin COMPU_METHOD Compu_CRI_mtranC_persist3 " " RAT_FUNC "%.1" "sec" COEFFS 0 1000 0 0 0 1 /end COMPU_METHOD
/begin CHARACTERISTIC CRI_mtranC_persist4 "after being in this mode for" VALUE 0x0016DACC /* @ECU_Address@CRI_mtranC_persist4@0x0100B0B8@ */ ECIPP_ALIGNMENT_ULONG 4294967 Compu_CRI_mtranC_persist4 0 4294967.295 /end CHARACTERISTIC
/begin COMPU_METHOD Compu_CRI_mtranC_persist4 " " RAT_FUNC "%.1" "sec" COEFFS 0 1000 0 0 0 1 /end COMPU_METHOD
/begin CHARACTERISTIC CRI_mtranC_persist5 "after being in this mode for" VALUE 0x0016DAD0 /* @ECU_Address@CRI_mtranC_persist5@0x0100B0C0@ */ ECIPP_ALIGNMENT_ULONG 4294967 Compu_CRI_mtranC_persist5 0 4294967.295 /end CHARACTERISTIC
/begin COMPU_METHOD Compu_CRI_mtranC_persist5 " " RAT_FUNC "%.1" "sec" COEFFS 0 1000 0 0 0 1 /end COMPU_METHOD
/begin CHARACTERISTIC CRI_mtranC_persist6 "after being in this mode for" VALUE 0x0016DAD4 /* @ECU_Address@CRI_mtranC_persist6@0x0100B0C8@ */ ECIPP_ALIGNMENT_ULONG 4294967 Compu_CRI_mtranC_persist6 0 4294967.295 /end CHARACTERISTIC
/begin COMPU_METHOD Compu_CRI_mtranC_persist6 " " RAT_FUNC "%.1" "sec" COEFFS 0 1000 0 0 0 1 /end COMPU_METHOD
/begin CHARACTERISTIC CRI_mtranC_persist7 "after being in this mode for" VALUE 0x0016DAD8 /* @ECU_Address@CRI_mtranC_persist7@0x0100B0D0@ */ ECIPP_ALIGNMENT_ULONG 4294967 Compu_CRI_mtranC_persist7 0 4294967.295 /end CHARACTERISTIC
/begin COMPU_METHOD Compu_CRI_mtranC_persist7 " " RAT_FUNC "%.1" "sec" COEFFS 0 1000 0 0 0 1 /end COMPU_METHOD
/begin CHARACTERISTIC CRI_mtranC_persist8 "after being in this mode for" VALUE 0x0016DADC /* @ECU_Address@CRI_mtranC_persist8@0x0100B0D8@ */ ECIPP_ALIGNMENT_ULONG 4294967 Compu_CRI_mtranC_persist8 0 4294967.295 /end CHARACTERISTIC
/begin COMPU_METHOD Compu_CRI_mtranC_persist8 " " RAT_FUNC "%.1" "sec" COEFFS 0 1000 0 0 0 1 /end COMPU_METHOD
/begin CHARACTERISTIC CRI_mtranC_persist9 "after being in this mode for" VALUE 0x0016DAE0 /* @ECU_Address@CRI_mtranC_persist9@0x0100B0E0@ */ ECIPP_ALIGNMENT_ULONG 4294967 Compu_CRI_mtranC_persist9 0 4294967.295 /end CHARACTERISTIC
/begin COMPU_METHOD Compu_CRI_mtranC_persist9 " " RAT_FUNC "%.1" "sec" COEFFS 0 1000 0 0 0 1 /end COMPU_METHOD
/begin CHARACTERISTIC STR_CRI_mode_0 "Mode 0" ASCII 0x00166384 /* @ECU_Address@STR_CRI_mode_0@0x0231D000@ */ ECIPP_ALIGNMENT_UBYTE 255 Compu_ECIPP_STRINGS 0 255 MATRIX_DIM 19 1 1 /end CHARACTERISTIC
/begin CHARACTERISTIC STR_CRI_mode_1 "Mode 1" ASCII 0x00166398 /* @ECU_Address@STR_CRI_mode_1@0x0231E000@ */ ECIPP_ALIGNMENT_UBYTE 255 Compu_ECIPP_STRINGS 0 255 MATRIX_DIM 19 1 1 /end CHARACTERISTIC
/begin CHARACTERISTIC STR_CRI_mode_2 "Mode 2" ASCII 0x001663AC /* @ECU_Address@STR_CRI_mode_2@0x0231F000@ */ ECIPP_ALIGNMENT_UBYTE 255 Compu_ECIPP_STRINGS 0 255 MATRIX_DIM 19 1 1 /end CHARACTERISTIC
/begin CHARACTERISTIC STR_CRI_mode_3 "Mode 3" ASCII 0x001663C0 /* @ECU_Address@STR_CRI_mode_3@0x02320000@ */ ECIPP_ALIGNMENT_UBYTE 255 Compu_ECIPP_STRINGS 0 255 MATRIX_DIM 19 1 1 /end CHARACTERISTIC
/begin CHARACTERISTIC STR_CRI_mode_4 "Mode 4" ASCII 0x001663D4 /* @ECU_Address@STR_CRI_mode_4@0x02321000@ */ ECIPP_ALIGNMENT_UBYTE 255 Compu_ECIPP_STRINGS 0 255 MATRIX_DIM 19 1 1 /end CHARACTERISTIC
/begin CHARACTERISTIC STR_CRI_mode_5 "Mode 5" ASCII 0x001663E8 /* @ECU_Address@STR_CRI_mode_5@0x02322000@ */ ECIPP_ALIGNMENT_UBYTE 255 Compu_ECIPP_STRINGS 0 255 MATRIX_DIM 19 1 1 /end CHARACTERISTIC
/begin CHARACTERISTIC STR_CRI_mode_6 "Mode 6" ASCII 0x001663FC /* @ECU_Address@STR_CRI_mode_6@0x02323000@ */ ECIPP_ALIGNMENT_UBYTE 255 Compu_ECIPP_STRINGS 0 255 MATRIX_DIM 19 1 1 /end CHARACTERISTIC
/begin CHARACTERISTIC STR_CRI_mode_7 "Mode 7" ASCII 0x00166410 /* @ECU_Address@STR_CRI_mode_7@0x02324000@ */ ECIPP_ALIGNMENT_UBYTE 255 Compu_ECIPP_STRINGS 0 255 MATRIX_DIM 19 1 1 /end CHARACTERISTIC
/begin CHARACTERISTIC STR_CRI_mode_8 "Mode 8" ASCII 0x00166424 /* @ECU_Address@STR_CRI_mode_8@0x02325000@ */ ECIPP_ALIGNMENT_UBYTE 255 Compu_ECIPP_STRINGS 0 255 MATRIX_DIM 19 1 1 /end CHARACTERISTIC
/begin CHARACTERISTIC STR_CRI_mode_9 "Mode 9" ASCII 0x00166438 /* @ECU_Address@STR_CRI_mode_9@0x02326000@ */ ECIPP_ALIGNMENT_UBYTE 255 Compu_ECIPP_STRINGS 0 255 MATRIX_DIM 19 1 1 /end CHARACTERISTIC
/begin GROUP EC_DieselMode "ECONTROLS" ROOT
 /begin REF_CHARACTERISTIC CRI_Tpost2_slct1 CRI_Tpost2_slct2 CRI_Tpost2_slct3 CRI_Tpost2_slct4 CRI_Tpost2_slct5 CRI_Tpost2_slct6 CRI_Tpost2_slct7 CRI_pilot1_priority0 CRI_pulseoff_slct0 CRI_pulseoff_slct1 CRI_pulseoff_slct2 CRI_pulseoff_slct3 CRI_pulseoff_slct4 CRI_pulseoff_slct5 CRI_pulseoff_slct6 CRI_pulseoff_slct7 CRI_bst_dP_scalar0 CRI_bst_dP_slct0 CRI_bst_dP_slct1 CRI_bst_dP_slct2 CRI_bst_dP_slct3 CRI_bst_dP_slct4 CRI_bst_dP_slct5 CRI_bst_dP_slct6 CRI_bst_dP_slct7 CRI_EGR_dP_slct0 CRI_EGR_dP_slct1 CRI_EGR_dP_slct2 CRI_EGR_dP_slct3 CRI_EGR_dP_slct4 CRI_EGR_dP_slct5 CRI_EGR_dP_slct6 CRI_EGR_dP_slct7 CRI_air_slct8 CRI_P_slct8 CRI_dilpct_slct8 CRI_Qpilot2_slct8 CRI_Qpilot1_slct8 CRI_Qload_slct8 CRI_Qpost1_slct8 CRI_Qpost2_slct8 CRI_Tpilot2_slct8 CRI_Tpilot1_slct8 CRI_Tmain_slct8 CRI_Tpost1_slct8 CRI_Tpost2_slct8 CRI_pulseoff_slct8 CRI_bst_dP_slct8 CRI_EGR_dP_slct8 CRI_air_slct9 CRI_P_slct9 CRI_dilpct_slct9 CRI_Qpilot2_slct9 CRI_Qpilot1_slct9 CRI_Qload_slct9 CRI_Qpost1_slct9 CRI_Qpost2_slct9 CRI_Tpilot2_slct9 CRI_Tpilot1_slct9 CRI_Tmain_slct9 CRI_Tpost1_slct9 CRI_Tpost2_slct9 CRI_pulseoff_slct9 CRI_bst_dP_slct9 CRI_EGR_dP_slct9 CRI_bst_dP_scalar1 CRI_bst_dP_scalar2 CRI_bst_dP_scalar3 CRI_bst_dP_scalar4 CRI_bst_dP_scalar5 CRI_bst_dP_scalar6 CRI_bst_dP_scalar7 CRI_bst_dP_scalar8 CRI_bst_dP_scalar9 CRI_pilot1_priority1 CRI_pilot1_priority2 CRI_pilot1_priority3 CRI_pilot1_priority4 CRI_pilot1_priority5 CRI_pilot1_priority6 CRI_pilot1_priority7 CRI_pilot1_priority8 CRI_pilot1_priority9 CRI_DOC_Tcl_slct0 CRI_DOC_Tcl_slct1 CRI_DOC_Tcl_slct2 CRI_DOC_Tcl_slct3 CRI_DOC_Tcl_slct4 CRI_DOC_Tcl_slct5 CRI_DOC_Tcl_slct6 CRI_DOC_Tcl_slct7 CRI_DOC_Tcl_slct8 CRI_DOC_Tcl_slct9 CRI_mchk_RPM0 CRI_mchk_RPM1 CRI_mchk_RPM2 CRI_mchk_RPM3 CRI_mchk_RPM4 CRI_mchk_RPM5 CRI_mchk_RPM6 CRI_mchk_RPM7 CRI_mchk_RPM8 CRI_mchk_RPM9 CRI_mchk_ECT0 CRI_mchk_ECT1 CRI_mchk_ECT2 CRI_mchk_ECT3 CRI_mchk_ECT4 CRI_mchk_ECT5 CRI_mchk_ECT6 CRI_mchk_ECT7 CRI_mchk_ECT8 CRI_mchk_ECT9 CRI_mchk_IAT0 CRI_mchk_IAT1 CRI_mchk_IAT2 CRI_mchk_IAT3 CRI_mchk_IAT4 CRI_mchk_IAT5 CRI_mchk_IAT6 CRI_mchk_IAT7 CRI_mchk_IAT8 CRI_mchk_IAT9 CRI_mchk_DOCT0 CRI_mchk_DOCT1 CRI_mchk_DOCT2 CRI_mchk_DOCT3 CRI_mchk_DOCT4 CRI_mchk_DOCT5 CRI_mchk_DOCT6 CRI_mchk_DOCT7 CRI_mchk_DOCT8 CRI_mchk_DOCT9 CRI_mchk_DPFT0 CRI_mchk_DPFT1 CRI_mchk_DPFT2 CRI_mchk_DPFT3 CRI_mchk_DPFT4 CRI_mchk_DPFT5 CRI_mchk_DPFT6 CRI_mchk_DPFT7 CRI_mchk_DPFT8 CRI_mchk_DPFT9 CRI_mchk_soot0 CRI_mchk_soot1 CRI_mchk_soot2 CRI_mchk_soot3 CRI_mchk_soot4 CRI_mchk_soot5 CRI_mchk_soot6 CRI_mchk_soot7 CRI_mchk_soot8 CRI_mchk_soot9 CRI_mchk_RS_speed0 CRI_mchk_RS_speed1 CRI_mchk_RS_speed2 CRI_mchk_RS_speed3 CRI_mchk_RS_speed4 CRI_mchk_RS_speed5 CRI_mchk_RS_speed6 CRI_mchk_RS_speed7 CRI_mchk_RS_speed8 CRI_mchk_RS_speed9 CRI_mlmt_RPM0 CRI_mlmt_RPM1 CRI_mlmt_RPM2 CRI_mlmt_RPM3 CRI_mlmt_RPM4 CRI_mlmt_RPM5 CRI_mlmt_RPM6 CRI_mlmt_RPM7 CRI_mlmt_RPM8 CRI_mlmt_RPM9 CRI_mlmt_ECT0 CRI_mlmt_ECT1 CRI_mlmt_ECT2 CRI_mlmt_ECT3 CRI_mlmt_ECT4 CRI_mlmt_ECT5 CRI_mlmt_ECT6 CRI_mlmt_ECT7 CRI_mlmt_ECT8 CRI_mlmt_ECT9 CRI_mlmt_IAT0 CRI_mlmt_IAT1 CRI_mlmt_IAT2 CRI_mlmt_IAT3 CRI_mlmt_IAT4 CRI_mlmt_IAT5 CRI_mlmt_IAT6 CRI_mlmt_IAT7 CRI_mlmt_IAT8 CRI_mlmt_IAT9 CRI_mlmt_DOCT0 CRI_mlmt_DOCT1 CRI_mlmt_DOCT2 CRI_mlmt_DOCT3 CRI_mlmt_DOCT4 CRI_mlmt_DOCT5 CRI_mlmt_DOCT6 CRI_mlmt_DOCT7 CRI_mlmt_DOCT8 CRI_mlmt_DOCT9 CRI_mlmt_DPFT0 CRI_mlmt_DPFT1 CRI_mlmt_DPFT2 CRI_mlmt_DPFT3 CRI_mlmt_DPFT4 CRI_mlmt_DPFT5 CRI_mlmt_DPFT6 CRI_mlmt_DPFT7 CRI_mlmt_DPFT8 CRI_mlmt_DPFT9 CRI_mlmt_soot0 CRI_mlmt_soot1 CRI_mlmt_soot2 CRI_mlmt_soot3 CRI_mlmt_soot4 CRI_mlmt_soot5 CRI_mlmt_soot6 CRI_mlmt_soot7 CRI_mlmt_soot8 CRI_mlmt_soot9 CRI_mlmt_RS_speed0 CRI_mlmt_RS_speed1 CRI_mlmt_RS_speed2 CRI_mlmt_RS_speed3 CRI_mlmt_RS_speed4 CRI_mlmt_RS_speed5 CRI_mlmt_RS_speed6 CRI_mlmt_RS_speed7 CRI_mlmt_RS_speed8 CRI_mlmt_RS_speed9 CRI_mchk_persist0 CRI_mchk_persist1 CRI_mchk_persist2 CRI_mchk_persist3 CRI_mchk_persist4 CRI_mchk_persist5 CRI_mchk_persist6 CRI_mchk_persist7 CRI_mchk_persist8 CRI_mchk_persist9 CRI_mtranA_chk0 CRI_mtranA_chk1 CRI_mtranA_chk2 CRI_mtranA_chk3 CRI_mtranA_chk4 CRI_mtranA_chk5 CRI_mtranA_chk6 CRI_mtranA_chk7 CRI_mtranA_chk8 CRI_mtranA_chk9 CRI_mtranB_chk0 CRI_mtranB_chk1 CRI_mtranB_chk2 CRI_mtranB_chk3 CRI_mtranB_chk4 CRI_mtranB_chk5 CRI_mtranB_chk6 CRI_mtranB_chk7 CRI_mtranB_chk8 CRI_mtranB_chk9 CRI_mtranC_chk0 CRI_mtranC_chk1 CRI_mtranC_chk2 CRI_mtranC_chk3 CRI_mtranC_chk4 CRI_mtranC_chk5 CRI_mtranC_chk6 CRI_mtranC_chk7 CRI_mtranC_chk8 CRI_mtranC_chk9 CRI_mtranA_persist0 CRI_mtranA_persist1 CRI_mtranA_persist2 CRI_mtranA_persist3 CRI_mtranA_persist4 CRI_mtranA_persist5 CRI_mtranA_persist6 CRI_mtranA_persist7 CRI_mtranA_persist8 CRI_mtranA_persist9 CRI_mtranB_persist0 CRI_mtranB_persist1 CRI_mtranB_persist2 CRI_mtranB_persist3 CRI_mtranB_persist4 CRI_mtranB_persist5 CRI_mtranB_persist6 CRI_mtranB_persist7 CRI_mtranB_persist8 CRI_mtranB_persist9 CRI_mtranC_persist0 CRI_mtranC_persist1 CRI_mtranC_persist2 CRI_mtranC_persist3 CRI_mtranC_persist4 CRI_mtranC_persist5 CRI_mtranC_persist6 CRI_mtranC_persist7 CRI_mtranC_persist8 CRI_mtranC_persist9 STR_CRI_mode_0 STR_CRI_mode_1 STR_CRI_mode_2 STR_CRI_mode_3 STR_CRI_mode_4 STR_CRI_mode_5 STR_CRI_mode_6 STR_CRI_mode_7 STR_CRI_mode_8 STR_CRI_mode_9 /end REF_CHARACTERISTIC
 /begin REF_MEASUREMENT mdot_ports_cmd CRI_active_mode /end REF_MEASUREMENT
/end GROUP
/begin GROUP EC_DPF "ECONTROLS" ROOT /begin REF_CHARACTERISTIC DOCT_ena DPFT_ena SCRT_ena DPFdP_ena DPF_V_init /end REF_CHARACTERISTIC
 /begin REF_MEASUREMENT EGT Vdot_exhaust EMP_slow DPFdP TOT DOCT DPFT SCRT DPF_regen_active DPF_soot_grams DPF_soot_g_per_L DPF_soot_mg_sec /end REF_MEASUREMENT
/end GROUP
/begin GROUP EC_FilterCal "ECONTROLS" ROOT /begin REF_MEASUREMENT EMP_slow /end REF_MEASUREMENT /end GROUP
/begin GROUP EC_VECal "ECONTROLS" ROOT /begin REF_MEASUREMENT Vdot_exhaust EMP_slow /end REF_MEASUREMENT /end GROUP
/end MODULE
/end PROJECT
