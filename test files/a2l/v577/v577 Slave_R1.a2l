ASAP2_VERSION 1 61
/begin PROJECT Econtrols_4G "4G Test"
/begin HEADER "4G A2L Configuration" PROJECT_NO EControls4G /* config for version control */ VERSION "$Revision: 82130 $:" /* config for version control */ /end HEADER
/begin MODULE EControls_4G_SH2A "EControls 4G"
/begin MOD_COMMON "" DEPOSIT ABSOLUTE BYTE_ORDER MSB_FIRST /end MOD_COMMON
/* Define the Record Layouts */
/begin RECORD_LAYOUT ECIPP_ALIGNMENT_UBYTE FNC_VALUES 1 UBYTE COLUMN_DIR DIRECT /end RECORD_LAYOUT
/begin RECORD_LAYOUT ECIPP_ALIGNMENT_UWORD FNC_VALUES 1 UWORD COLUMN_DIR DIRECT /end RECORD_LAYOUT
/begin RECORD_LAYOUT ECIPP_ALIGNMENT_ULONG FNC_VALUES 1 ULONG COLUMN_DIR DIRECT /end RECORD_LAYOUT
/begin RECORD_LAYOUT ECIPP_ALIGNMENT_FLOAT32_IEEE FNC_VALUES 1 FLOAT32_IEEE COLUMN_DIR DIRECT /end RECORD_LAYOUT
/begin COMPU_METHOD Compu_IDENTITY "Discrete Values " /* Identifier */ IDENTICAL "%.0" /* Format */ "-" /* Units */ /end COMPU_METHOD
/begin CHARACTERISTIC FCdc4_MJ_Pe_HiExp "FCtl_DTC_0x04(133)" VALUE 0x00163CDA /* @ECU_Address@FCtl_DTC_0x04@0x024C410A@ */ ECIPP_ALIGNMENT_UWORD 65535 Compu_IDENTITY 0 65535 PHYS_UNIT "System ID + DTC" /end CHARACTERISTIC
/begin CHARACTERISTIC FCdc4_MJ_Pe_LoExp "FCtl_DTC_0x04(134)" VALUE 0x00163CDC /* @ECU_Address@FCtl_DTC_0x04@0x024C410C@ */ ECIPP_ALIGNMENT_UWORD 65535 Compu_IDENTITY 0 65535 PHYS_UNIT "System ID + DTC" /end CHARACTERISTIC
/begin CHARACTERISTIC FCdc4_MJ2_comm_tout "FCtl_DTC_0x04(726)" VALUE 0x0016417C /* @ECU_Address@FCtl_DTC_0x04@0x024C45AC@ */ ECIPP_ALIGNMENT_UWORD 65535 Compu_IDENTITY 0 65535 PHYS_UNIT "System ID + DTC" /end CHARACTERISTIC
/begin CHARACTERISTIC FCdc4_MJ2_intF_act "FCtl_DTC_0x04(729)" VALUE 0x00164182 /* @ECU_Address@FCtl_DTC_0x04@0x024C45B2@ */ ECIPP_ALIGNMENT_UWORD 65535 Compu_IDENTITY 0 65535 PHYS_UNIT "System ID + DTC" /end CHARACTERISTIC
/begin CHARACTERISTIC FCdc4_MJ2_intF_circ "FCtl_DTC_0x04(730)" VALUE 0x00164184 /* @ECU_Address@FCtl_DTC_0x04@0x024C45B4@ */ ECIPP_ALIGNMENT_UWORD 65535 Compu_IDENTITY 0 65535 PHYS_UNIT "System ID + DTC" /end CHARACTERISTIC
/begin CHARACTERISTIC FCdc4_MJ2_intF_comm "FCtl_DTC_0x04(731)" VALUE 0x00164186 /* @ECU_Address@FCtl_DTC_0x04@0x024C45B6@ */ ECIPP_ALIGNMENT_UWORD 65535 Compu_IDENTITY 0 65535 PHYS_UNIT "System ID + DTC" /end CHARACTERISTIC
/begin CHARACTERISTIC FCdc4_MJ2_intF_Vhi "FCtl_DTC_0x04(727)" VALUE 0x0016417E /* @ECU_Address@FCtl_DTC_0x04@0x024C45AE@ */ ECIPP_ALIGNMENT_UWORD 65535 Compu_IDENTITY 0 65535 PHYS_UNIT "System ID + DTC" /end CHARACTERISTIC
/begin CHARACTERISTIC FCdc4_MJ2_intF_Vlo "FCtl_DTC_0x04(728)" VALUE 0x00164180 /* @ECU_Address@FCtl_DTC_0x04@0x024C45B0@ */ ECIPP_ALIGNMENT_UWORD 65535 Compu_IDENTITY 0 65535 PHYS_UNIT "System ID + DTC" /end CHARACTERISTIC
/begin CHARACTERISTIC FCdc4_MJ2_Pe_HiExp "FCtl_DTC_0x04(724)" VALUE 0x00164178 /* @ECU_Address@FCtl_DTC_0x04@0x024C45A8@ */ ECIPP_ALIGNMENT_UWORD 65535 Compu_IDENTITY 0 65535 PHYS_UNIT "System ID + DTC" /end CHARACTERISTIC
/begin CHARACTERISTIC FCdc4_MJ2_Pe_LoExp "FCtl_DTC_0x04(725)" VALUE 0x0016417A /* @ECU_Address@FCtl_DTC_0x04@0x024C45AA@ */ ECIPP_ALIGNMENT_UWORD 65535 Compu_IDENTITY 0 65535 PHYS_UNIT "System ID + DTC" /end CHARACTERISTIC
/begin CHARACTERISTIC FCdc4_NOx_hi "FCtl_DTC_0x04(793)" VALUE 0x00164202 /* @ECU_Address@FCtl_DTC_0x04@0x024C4632@ */ ECIPP_ALIGNMENT_UWORD 65535 Compu_IDENTITY 0 65535 PHYS_UNIT "System ID + DTC" /end CHARACTERISTIC
/begin CHARACTERISTIC FCdc4_OilP_hiP "FCtl_DTC_0x04(149)" VALUE 0x00163CFA /* @ECU_Address@FCtl_DTC_0x04@0x024C412A@ */ ECIPP_ALIGNMENT_UWORD 65535 Compu_IDENTITY 0 65535 PHYS_UNIT "System ID + DTC" /end CHARACTERISTIC
/begin CHARACTERISTIC FCdc4_OilP_loP "FCtl_DTC_0x04(148)" VALUE 0x00163CF8 /* @ECU_Address@FCtl_DTC_0x04@0x024C4128@ */ ECIPP_ALIGNMENT_UWORD 65535 Compu_IDENTITY 0 65535 PHYS_UNIT "System ID + DTC" /end CHARACTERISTIC
/begin CHARACTERISTIC FCdc4_OilP_maxV "FCtl_DTC_0x04(150)" VALUE 0x00163CFC /* @ECU_Address@FCtl_DTC_0x04@0x024C412C@ */ ECIPP_ALIGNMENT_UWORD 65535 Compu_IDENTITY 0 65535 PHYS_UNIT "System ID + DTC" /end CHARACTERISTIC
/begin CHARACTERISTIC FCdc4_OilP_minV "FCtl_DTC_0x04(151)" VALUE 0x00163CFE /* @ECU_Address@FCtl_DTC_0x04@0x024C412E@ */ ECIPP_ALIGNMENT_UWORD 65535 Compu_IDENTITY 0 65535 PHYS_UNIT "System ID + DTC" /end CHARACTERISTIC
/begin CHARACTERISTIC FCdc4_OILP_test "FCtl_DTC_0x04(29)" VALUE 0x00163C0A /* @ECU_Address@FCtl_DTC_0x04@0x024C403A@ */ ECIPP_ALIGNMENT_UWORD 65535 Compu_IDENTITY 0 65535 PHYS_UNIT "System ID + DTC" /end CHARACTERISTIC
/begin CHARACTERISTIC FCdc4_OilP2_loP "FCtl_DTC_0x04(293)" VALUE 0x00163E1A /* @ECU_Address@FCtl_DTC_0x04@0x024C424A@ */ ECIPP_ALIGNMENT_UWORD 65535 Compu_IDENTITY 0 65535 PHYS_UNIT "System ID + DTC" /end CHARACTERISTIC
/begin CHARACTERISTIC FCdc4_OILTL_loss "FCtl_DTC_0x04(737)" VALUE 0x00164192 /* @ECU_Address@FCtl_DTC_0x04@0x024C45C2@ */ ECIPP_ALIGNMENT_UWORD 65535 Compu_IDENTITY 0 65535 PHYS_UNIT "System ID + DTC" /end CHARACTERISTIC
/begin CHARACTERISTIC FCdc4_OILTL_Lvl_lo "FCtl_DTC_0x04(741)" VALUE 0x0016419A /* @ECU_Address@FCtl_DTC_0x04@0x024C45CA@ */ ECIPP_ALIGNMENT_UWORD 65535 Compu_IDENTITY 0 65535 PHYS_UNIT "System ID + DTC" /end CHARACTERISTIC
/begin CHARACTERISTIC FCdc4_OILTL_Lvl_OOR "FCtl_DTC_0x04(739)" VALUE 0x00164196 /* @ECU_Address@FCtl_DTC_0x04@0x024C45C6@ */ ECIPP_ALIGNMENT_UWORD 65535 Compu_IDENTITY 0 65535 PHYS_UNIT "System ID + DTC" /end CHARACTERISTIC
/begin CHARACTERISTIC FCdc4_OILTL_T_hi "FCtl_DTC_0x04(742)" VALUE 0x0016419C /* @ECU_Address@FCtl_DTC_0x04@0x024C45CC@ */ ECIPP_ALIGNMENT_UWORD 65535 Compu_IDENTITY 0 65535 PHYS_UNIT "System ID + DTC" /end CHARACTERISTIC
/begin CHARACTERISTIC FCdc4_OILTL_T_OOR "FCtl_DTC_0x04(740)" VALUE 0x00164198 /* @ECU_Address@FCtl_DTC_0x04@0x024C45C8@ */ ECIPP_ALIGNMENT_UWORD 65535 Compu_IDENTITY 0 65535 PHYS_UNIT "System ID + DTC" /end CHARACTERISTIC
/begin CHARACTERISTIC FCdc4_OILTL_V_OOR "FCtl_DTC_0x04(738)" VALUE 0x00164194 /* @ECU_Address@FCtl_DTC_0x04@0x024C45C4@ */ ECIPP_ALIGNMENT_UWORD 65535 Compu_IDENTITY 0 65535 PHYS_UNIT "System ID + DTC" /end CHARACTERISTIC
/begin CHARACTERISTIC FCdc4_PAUX_dP1_max "FCtl_DTC_0x04(546)" VALUE 0x00164014 /* @ECU_Address@FCtl_DTC_0x04@0x024C4444@ */ ECIPP_ALIGNMENT_UWORD 65535 Compu_IDENTITY 0 65535 PHYS_UNIT "System ID + DTC" /end CHARACTERISTIC
/begin CHARACTERISTIC FCdc4_PAUX_dP1_min "FCtl_DTC_0x04(547)" VALUE 0x00164016 /* @ECU_Address@FCtl_DTC_0x04@0x024C4446@ */ ECIPP_ALIGNMENT_UWORD 65535 Compu_IDENTITY 0 65535 PHYS_UNIT "System ID + DTC" /end CHARACTERISTIC
/begin CHARACTERISTIC FCdc4_PAUX_dP2_max "FCtl_DTC_0x04(548)" VALUE 0x00164018 /* @ECU_Address@FCtl_DTC_0x04@0x024C4448@ */ ECIPP_ALIGNMENT_UWORD 65535 Compu_IDENTITY 0 65535 PHYS_UNIT "System ID + DTC" /end CHARACTERISTIC
/begin CHARACTERISTIC FCdc4_PAUX_dP2_min "FCtl_DTC_0x04(549)" VALUE 0x0016401A /* @ECU_Address@FCtl_DTC_0x04@0x024C444A@ */ ECIPP_ALIGNMENT_UWORD 65535 Compu_IDENTITY 0 65535 PHYS_UNIT "System ID + DTC" /end CHARACTERISTIC
/begin CHARACTERISTIC FCdc4_PAUX1_max "FCtl_DTC_0x04(538)" VALUE 0x00164004 /* @ECU_Address@FCtl_DTC_0x04@0x024C4434@ */ ECIPP_ALIGNMENT_UWORD 65535 Compu_IDENTITY 0 65535 PHYS_UNIT "System ID + DTC" /end CHARACTERISTIC
/begin CHARACTERISTIC FCdc4_PAUX1_min "FCtl_DTC_0x04(539)" VALUE 0x00164006 /* @ECU_Address@FCtl_DTC_0x04@0x024C4436@ */ ECIPP_ALIGNMENT_UWORD 65535 Compu_IDENTITY 0 65535 PHYS_UNIT "System ID + DTC" /end CHARACTERISTIC
/begin CHARACTERISTIC FCdc4_PAUX2_max "FCtl_DTC_0x04(540)" VALUE 0x00164008 /* @ECU_Address@FCtl_DTC_0x04@0x024C4438@ */ ECIPP_ALIGNMENT_UWORD 65535 Compu_IDENTITY 0 65535 PHYS_UNIT "System ID + DTC" /end CHARACTERISTIC
/begin CHARACTERISTIC FCdc4_PAUX2_min "FCtl_DTC_0x04(541)" VALUE 0x0016400A /* @ECU_Address@FCtl_DTC_0x04@0x024C443A@ */ ECIPP_ALIGNMENT_UWORD 65535 Compu_IDENTITY 0 65535 PHYS_UNIT "System ID + DTC" /end CHARACTERISTIC
/begin CHARACTERISTIC FCdc4_PAUX3_max "FCtl_DTC_0x04(542)" VALUE 0x0016400C /* @ECU_Address@FCtl_DTC_0x04@0x024C443C@ */ ECIPP_ALIGNMENT_UWORD 65535 Compu_IDENTITY 0 65535 PHYS_UNIT "System ID + DTC" /end CHARACTERISTIC
/begin CHARACTERISTIC FCdc4_PAUX3_min "FCtl_DTC_0x04(543)" VALUE 0x0016400E /* @ECU_Address@FCtl_DTC_0x04@0x024C443E@ */ ECIPP_ALIGNMENT_UWORD 65535 Compu_IDENTITY 0 65535 PHYS_UNIT "System ID + DTC" /end CHARACTERISTIC
/begin CHARACTERISTIC FCdc4_PAUX4_max "FCtl_DTC_0x04(544)" VALUE 0x00164010 /* @ECU_Address@FCtl_DTC_0x04@0x024C4440@ */ ECIPP_ALIGNMENT_UWORD 65535 Compu_IDENTITY 0 65535 PHYS_UNIT "System ID + DTC" /end CHARACTERISTIC
/begin CHARACTERISTIC FCdc4_PAUX4_min "FCtl_DTC_0x04(545)" VALUE 0x00164012 /* @ECU_Address@FCtl_DTC_0x04@0x024C4442@ */ ECIPP_ALIGNMENT_UWORD 65535 Compu_IDENTITY 0 65535 PHYS_UNIT "System ID + DTC" /end CHARACTERISTIC
/begin CHARACTERISTIC FCdc4_PPEG_BP "FCtl_DTC_0x04(670)" VALUE 0x0016410C /* @ECU_Address@FCtl_DTC_0x04@0x024C453C@ */ ECIPP_ALIGNMENT_UWORD 65535 Compu_IDENTITY 0 65535 PHYS_UNIT "System ID + DTC" /end CHARACTERISTIC
/begin CHARACTERISTIC FCdc4_PPEG_CVP1 "FCtl_DTC_0x04(745)" VALUE 0x001641A2 /* @ECU_Address@FCtl_DTC_0x04@0x024C45D2@ */ ECIPP_ALIGNMENT_UWORD 65535 Compu_IDENTITY 0 65535 PHYS_UNIT "System ID + DTC" /end CHARACTERISTIC
/begin CHARACTERISTIC FCdc4_PPEG_CVP2 "FCtl_DTC_0x04(746)" VALUE 0x001641A4 /* @ECU_Address@FCtl_DTC_0x04@0x024C45D4@ */ ECIPP_ALIGNMENT_UWORD 65535 Compu_IDENTITY 0 65535 PHYS_UNIT "System ID + DTC" /end CHARACTERISTIC
/begin CHARACTERISTIC FCdc4_PPEG_EBP "FCtl_DTC_0x04(671)" VALUE 0x0016410E /* @ECU_Address@FCtl_DTC_0x04@0x024C453E@ */ ECIPP_ALIGNMENT_UWORD 65535 Compu_IDENTITY 0 65535 PHYS_UNIT "System ID + DTC" /end CHARACTERISTIC
/begin CHARACTERISTIC FCdc4_PPEG_EGRdP "FCtl_DTC_0x04(756)" VALUE 0x001641B8 /* @ECU_Address@FCtl_DTC_0x04@0x024C45E8@ */ ECIPP_ALIGNMENT_UWORD 65535 Compu_IDENTITY 0 65535 PHYS_UNIT "System ID + DTC" /end CHARACTERISTIC
/begin CHARACTERISTIC FCdc4_PPEG_EGRHP "FCtl_DTC_0x04(673)" VALUE 0x00164112 /* @ECU_Address@FCtl_DTC_0x04@0x024C4542@ */ ECIPP_ALIGNMENT_UWORD 65535 Compu_IDENTITY 0 65535 PHYS_UNIT "System ID + DTC" /end CHARACTERISTIC
/begin CHARACTERISTIC FCdc4_PPEG_EGRLP "FCtl_DTC_0x04(672)" VALUE 0x00164110 /* @ECU_Address@FCtl_DTC_0x04@0x024C4540@ */ ECIPP_ALIGNMENT_UWORD 65535 Compu_IDENTITY 0 65535 PHYS_UNIT "System ID + DTC" /end CHARACTERISTIC
/begin CHARACTERISTIC FCdc4_PPEG_EGRwrP "FCtl_DTC_0x04(675)" VALUE 0x00164116 /* @ECU_Address@FCtl_DTC_0x04@0x024C4546@ */ ECIPP_ALIGNMENT_UWORD 65535 Compu_IDENTITY 0 65535 PHYS_UNIT "System ID + DTC" /end CHARACTERISTIC
/begin CHARACTERISTIC FCdc4_PPEG_MAP "FCtl_DTC_0x04(676)" VALUE 0x00164118 /* @ECU_Address@FCtl_DTC_0x04@0x024C4548@ */ ECIPP_ALIGNMENT_UWORD 65535 Compu_IDENTITY 0 65535 PHYS_UNIT "System ID + DTC" /end CHARACTERISTIC
/begin CHARACTERISTIC FCdc4_PPEG_TIP "FCtl_DTC_0x04(674)" VALUE 0x00164114 /* @ECU_Address@FCtl_DTC_0x04@0x024C4544@ */ ECIPP_ALIGNMENT_UWORD 65535 Compu_IDENTITY 0 65535 PHYS_UNIT "System ID + DTC" /end CHARACTERISTIC
/begin CHARACTERISTIC FCdc4_PWM1_off_loVf "FCtl_DTC_0x04(189)" VALUE 0x00163D4A /* @ECU_Address@FCtl_DTC_0x04@0x024C417A@ */ ECIPP_ALIGNMENT_UWORD 65535 Compu_IDENTITY 0 65535 PHYS_UNIT "System ID + DTC" /end CHARACTERISTIC
/begin CHARACTERISTIC FCdc4_PWM1_on_hiVf "FCtl_DTC_0x04(190)" VALUE 0x00163D4C /* @ECU_Address@FCtl_DTC_0x04@0x024C417C@ */ ECIPP_ALIGNMENT_UWORD 65535 Compu_IDENTITY 0 65535 PHYS_UNIT "System ID + DTC" /end CHARACTERISTIC
/begin CHARACTERISTIC FCdc4_PWM10_off_loVf "FCtl_DTC_0x04(433)" VALUE 0x00163F32 /* @ECU_Address@FCtl_DTC_0x04@0x024C4362@ */ ECIPP_ALIGNMENT_UWORD 65535 Compu_IDENTITY 0 65535 PHYS_UNIT "System ID + DTC" /end CHARACTERISTIC
/begin CHARACTERISTIC FCdc4_PWM10_on_hiVf "FCtl_DTC_0x04(434)" VALUE 0x00163F34 /* @ECU_Address@FCtl_DTC_0x04@0x024C4364@ */ ECIPP_ALIGNMENT_UWORD 65535 Compu_IDENTITY 0 65535 PHYS_UNIT "System ID + DTC" /end CHARACTERISTIC
/begin CHARACTERISTIC FCdc4_PWM11_off_loVf "FCtl_DTC_0x04(435)" VALUE 0x00163F36 /* @ECU_Address@FCtl_DTC_0x04@0x024C4366@ */ ECIPP_ALIGNMENT_UWORD 65535 Compu_IDENTITY 0 65535 PHYS_UNIT "System ID + DTC" /end CHARACTERISTIC
/begin CHARACTERISTIC FCdc4_PWM11_on_hiVf "FCtl_DTC_0x04(436)" VALUE 0x00163F38 /* @ECU_Address@FCtl_DTC_0x04@0x024C4368@ */ ECIPP_ALIGNMENT_UWORD 65535 Compu_IDENTITY 0 65535 PHYS_UNIT "System ID + DTC" /end CHARACTERISTIC
/begin CHARACTERISTIC FCdc4_PWM12_off_loVf "FCtl_DTC_0x04(437)" VALUE 0x00163F3A /* @ECU_Address@FCtl_DTC_0x04@0x024C436A@ */ ECIPP_ALIGNMENT_UWORD 65535 Compu_IDENTITY 0 65535 PHYS_UNIT "System ID + DTC" /end CHARACTERISTIC
/begin CHARACTERISTIC FCdc4_PWM12_on_hiVf "FCtl_DTC_0x04(438)" VALUE 0x00163F3C /* @ECU_Address@FCtl_DTC_0x04@0x024C436C@ */ ECIPP_ALIGNMENT_UWORD 65535 Compu_IDENTITY 0 65535 PHYS_UNIT "System ID + DTC" /end CHARACTERISTIC
/begin CHARACTERISTIC FCdc4_PWM13_off_loVf "FCtl_DTC_0x04(439)" VALUE 0x00163F3E /* @ECU_Address@FCtl_DTC_0x04@0x024C436E@ */ ECIPP_ALIGNMENT_UWORD 65535 Compu_IDENTITY 0 65535 PHYS_UNIT "System ID + DTC" /end CHARACTERISTIC
/begin CHARACTERISTIC FCdc4_PWM13_on_hiVf "FCtl_DTC_0x04(440)" VALUE 0x00163F40 /* @ECU_Address@FCtl_DTC_0x04@0x024C4370@ */ ECIPP_ALIGNMENT_UWORD 65535 Compu_IDENTITY 0 65535 PHYS_UNIT "System ID + DTC" /end CHARACTERISTIC
/begin CHARACTERISTIC FCdc4_PWM14_off_loVf "FCtl_DTC_0x04(441)" VALUE 0x00163F42 /* @ECU_Address@FCtl_DTC_0x04@0x024C4372@ */ ECIPP_ALIGNMENT_UWORD 65535 Compu_IDENTITY 0 65535 PHYS_UNIT "System ID + DTC" /end CHARACTERISTIC
/begin CHARACTERISTIC FCdc4_PWM14_on_hiVf "FCtl_DTC_0x04(442)" VALUE 0x00163F44 /* @ECU_Address@FCtl_DTC_0x04@0x024C4374@ */ ECIPP_ALIGNMENT_UWORD 65535 Compu_IDENTITY 0 65535 PHYS_UNIT "System ID + DTC" /end CHARACTERISTIC
/begin CHARACTERISTIC FCdc4_PWM15_off_loVf "FCtl_DTC_0x04(443)" VALUE 0x00163F46 /* @ECU_Address@FCtl_DTC_0x04@0x024C4376@ */ ECIPP_ALIGNMENT_UWORD 65535 Compu_IDENTITY 0 65535 PHYS_UNIT "System ID + DTC" /end CHARACTERISTIC
/begin CHARACTERISTIC FCdc4_PWM15_on_hiVf "FCtl_DTC_0x04(444)" VALUE 0x00163F48 /* @ECU_Address@FCtl_DTC_0x04@0x024C4378@ */ ECIPP_ALIGNMENT_UWORD 65535 Compu_IDENTITY 0 65535 PHYS_UNIT "System ID + DTC" /end CHARACTERISTIC
/begin CHARACTERISTIC FCdc4_PWM16_off_loVf "FCtl_DTC_0x04(445)" VALUE 0x00163F4A /* @ECU_Address@FCtl_DTC_0x04@0x024C437A@ */ ECIPP_ALIGNMENT_UWORD 65535 Compu_IDENTITY 0 65535 PHYS_UNIT "System ID + DTC" /end CHARACTERISTIC
/begin CHARACTERISTIC FCdc4_PWM16_on_hiVf "FCtl_DTC_0x04(446)" VALUE 0x00163F4C /* @ECU_Address@FCtl_DTC_0x04@0x024C437C@ */ ECIPP_ALIGNMENT_UWORD 65535 Compu_IDENTITY 0 65535 PHYS_UNIT "System ID + DTC" /end CHARACTERISTIC
/begin CHARACTERISTIC FCdc4_PWM17_off_loVf "FCtl_DTC_0x04(447)" VALUE 0x00163F4E /* @ECU_Address@FCtl_DTC_0x04@0x024C437E@ */ ECIPP_ALIGNMENT_UWORD 65535 Compu_IDENTITY 0 65535 PHYS_UNIT "System ID + DTC" /end CHARACTERISTIC
/begin CHARACTERISTIC FCdc4_PWM17_on_hiVf "FCtl_DTC_0x04(448)" VALUE 0x00163F50 /* @ECU_Address@FCtl_DTC_0x04@0x024C4380@ */ ECIPP_ALIGNMENT_UWORD 65535 Compu_IDENTITY 0 65535 PHYS_UNIT "System ID + DTC" /end CHARACTERISTIC
/begin CHARACTERISTIC FCdc4_PWM18_off_loVf "FCtl_DTC_0x04(449)" VALUE 0x00163F52 /* @ECU_Address@FCtl_DTC_0x04@0x024C4382@ */ ECIPP_ALIGNMENT_UWORD 65535 Compu_IDENTITY 0 65535 PHYS_UNIT "System ID + DTC" /end CHARACTERISTIC
/begin CHARACTERISTIC FCdc4_PWM18_on_hiVf "FCtl_DTC_0x04(450)" VALUE 0x00163F54 /* @ECU_Address@FCtl_DTC_0x04@0x024C4384@ */ ECIPP_ALIGNMENT_UWORD 65535 Compu_IDENTITY 0 65535 PHYS_UNIT "System ID + DTC" /end CHARACTERISTIC
/begin CHARACTERISTIC FCdc4_PWM19_off_loVf "FCtl_DTC_0x04(451)" VALUE 0x00163F56 /* @ECU_Address@FCtl_DTC_0x04@0x024C4386@ */ ECIPP_ALIGNMENT_UWORD 65535 Compu_IDENTITY 0 65535 PHYS_UNIT "System ID + DTC" /end CHARACTERISTIC
/begin CHARACTERISTIC FCdc4_PWM19_on_hiVf "FCtl_DTC_0x04(452)" VALUE 0x00163F58 /* @ECU_Address@FCtl_DTC_0x04@0x024C4388@ */ ECIPP_ALIGNMENT_UWORD 65535 Compu_IDENTITY 0 65535 PHYS_UNIT "System ID + DTC" /end CHARACTERISTIC
/begin CHARACTERISTIC FCdc4_PWM2_off_loVf "FCtl_DTC_0x04(191)" VALUE 0x00163D4E /* @ECU_Address@FCtl_DTC_0x04@0x024C417E@ */ ECIPP_ALIGNMENT_UWORD 65535 Compu_IDENTITY 0 65535 PHYS_UNIT "System ID + DTC" /end CHARACTERISTIC
/begin CHARACTERISTIC FCdc4_PWM2_on_hiVf "FCtl_DTC_0x04(192)" VALUE 0x00163D50 /* @ECU_Address@FCtl_DTC_0x04@0x024C4180@ */ ECIPP_ALIGNMENT_UWORD 65535 Compu_IDENTITY 0 65535 PHYS_UNIT "System ID + DTC" /end CHARACTERISTIC
/begin CHARACTERISTIC FCdc4_PWM20_off_loVf "FCtl_DTC_0x04(453)" VALUE 0x00163F5A /* @ECU_Address@FCtl_DTC_0x04@0x024C438A@ */ ECIPP_ALIGNMENT_UWORD 65535 Compu_IDENTITY 0 65535 PHYS_UNIT "System ID + DTC" /end CHARACTERISTIC
/begin CHARACTERISTIC FCdc4_PWM20_on_hiVf "FCtl_DTC_0x04(454)" VALUE 0x00163F5C /* @ECU_Address@FCtl_DTC_0x04@0x024C438C@ */ ECIPP_ALIGNMENT_UWORD 65535 Compu_IDENTITY 0 65535 PHYS_UNIT "System ID + DTC" /end CHARACTERISTIC
/begin CHARACTERISTIC FCdc4_PWM21_off_loVf "FCtl_DTC_0x04(455)" VALUE 0x00163F5E /* @ECU_Address@FCtl_DTC_0x04@0x024C438E@ */ ECIPP_ALIGNMENT_UWORD 65535 Compu_IDENTITY 0 65535 PHYS_UNIT "System ID + DTC" /end CHARACTERISTIC
/begin CHARACTERISTIC FPnd_MJ_Pe_HiExp "FPrm_pending(92)" VALUE 0x00164A24 /* @ECU_Address@FPrm_pending@0x021BE0B8@ */ ECIPP_ALIGNMENT_UWORD 65535 Compu_IDENTITY 0 65535 PHYS_UNIT "Bit Mask" /end CHARACTERISTIC
/begin CHARACTERISTIC FPnd_MJ_Pe_LoExp "FPrm_pending(93)" VALUE 0x00164A26 /* @ECU_Address@FPrm_pending@0x021BE0BA@ */ ECIPP_ALIGNMENT_UWORD 65535 Compu_IDENTITY 0 65535 PHYS_UNIT "Bit Mask" /end CHARACTERISTIC
/begin CHARACTERISTIC FPnd_MJ2_comm_tout "FPrm_pending(556)" VALUE 0x00164DC4 /* @ECU_Address@FPrm_pending@0x021BE458@ */ ECIPP_ALIGNMENT_UWORD 65535 Compu_IDENTITY 0 65535 PHYS_UNIT "Bit Mask" /end CHARACTERISTIC
/begin CHARACTERISTIC FPnd_MJ2_intF_act "FPrm_pending(559)" VALUE 0x00164DCA /* @ECU_Address@FPrm_pending@0x021BE45E@ */ ECIPP_ALIGNMENT_UWORD 65535 Compu_IDENTITY 0 65535 PHYS_UNIT "Bit Mask" /end CHARACTERISTIC
/begin CHARACTERISTIC FPnd_MJ2_intF_circ "FPrm_pending(560)" VALUE 0x00164DCC /* @ECU_Address@FPrm_pending@0x021BE460@ */ ECIPP_ALIGNMENT_UWORD 65535 Compu_IDENTITY 0 65535 PHYS_UNIT "Bit Mask" /end CHARACTERISTIC
/begin CHARACTERISTIC FPnd_MJ2_intF_comm "FPrm_pending(561)" VALUE 0x00164DCE /* @ECU_Address@FPrm_pending@0x021BE462@ */ ECIPP_ALIGNMENT_UWORD 65535 Compu_IDENTITY 0 65535 PHYS_UNIT "Bit Mask" /end CHARACTERISTIC
/begin CHARACTERISTIC FPnd_MJ2_intF_Vhi "FPrm_pending(557)" VALUE 0x00164DC6 /* @ECU_Address@FPrm_pending@0x021BE45A@ */ ECIPP_ALIGNMENT_UWORD 65535 Compu_IDENTITY 0 65535 PHYS_UNIT "Bit Mask" /end CHARACTERISTIC
/begin CHARACTERISTIC FPnd_MJ2_intF_Vlo "FPrm_pending(558)" VALUE 0x00164DC8 /* @ECU_Address@FPrm_pending@0x021BE45C@ */ ECIPP_ALIGNMENT_UWORD 65535 Compu_IDENTITY 0 65535 PHYS_UNIT "Bit Mask" /end CHARACTERISTIC
/begin CHARACTERISTIC FPnd_MJ2_Pe_HiExp "FPrm_pending(554)" VALUE 0x00164DC0 /* @ECU_Address@FPrm_pending@0x021BE454@ */ ECIPP_ALIGNMENT_UWORD 65535 Compu_IDENTITY 0 65535 PHYS_UNIT "Bit Mask" /end CHARACTERISTIC
/begin CHARACTERISTIC FPnd_MJ2_Pe_LoExp "FPrm_pending(555)" VALUE 0x00164DC2 /* @ECU_Address@FPrm_pending@0x021BE456@ */ ECIPP_ALIGNMENT_UWORD 65535 Compu_IDENTITY 0 65535 PHYS_UNIT "Bit Mask" /end CHARACTERISTIC
/begin CHARACTERISTIC FPnd_NOx_hi "FPrm_pending(623)" VALUE 0x00164E4A /* @ECU_Address@FPrm_pending@0x021BE4DE@ */ ECIPP_ALIGNMENT_UWORD 65535 Compu_IDENTITY 0 65535 PHYS_UNIT "Bit Mask" /end CHARACTERISTIC
/begin CHARACTERISTIC FPnd_OilP_hiP "FPrm_pending(109)" VALUE 0x00164A46 /* @ECU_Address@FPrm_pending@0x021BE0DA@ */ ECIPP_ALIGNMENT_UWORD 65535 Compu_IDENTITY 0 65535 PHYS_UNIT "Bit Mask" /end CHARACTERISTIC
/begin CHARACTERISTIC FPnd_OilP_loP "FPrm_pending(108)" VALUE 0x00164A44 /* @ECU_Address@FPrm_pending@0x021BE0D8@ */ ECIPP_ALIGNMENT_UWORD 65535 Compu_IDENTITY 0 65535 PHYS_UNIT "Bit Mask" /end CHARACTERISTIC
/begin CHARACTERISTIC FPnd_OilP_maxV "FPrm_pending(110)" VALUE 0x00164A48 /* @ECU_Address@FPrm_pending@0x021BE0DC@ */ ECIPP_ALIGNMENT_UWORD 65535 Compu_IDENTITY 0 65535 PHYS_UNIT "Bit Mask" /end CHARACTERISTIC
/begin CHARACTERISTIC FPnd_OilP_minV "FPrm_pending(111)" VALUE 0x00164A4A /* @ECU_Address@FPrm_pending@0x021BE0DE@ */ ECIPP_ALIGNMENT_UWORD 65535 Compu_IDENTITY 0 65535 PHYS_UNIT "Bit Mask" /end CHARACTERISTIC
/begin CHARACTERISTIC FPnd_OILP_test "FPrm_pending(40)" VALUE 0x001649BC /* @ECU_Address@FPrm_pending@0x021BE050@ */ ECIPP_ALIGNMENT_UWORD 65535 Compu_IDENTITY 0 65535 PHYS_UNIT "Bit Mask" /end CHARACTERISTIC
/begin CHARACTERISTIC FPnd_OilP2_loP "FPrm_pending(215)" VALUE 0x00164B1A /* @ECU_Address@FPrm_pending@0x021BE1AE@ */ ECIPP_ALIGNMENT_UWORD 65535 Compu_IDENTITY 0 65535 PHYS_UNIT "Bit Mask" /end CHARACTERISTIC
/begin CHARACTERISTIC FPnd_OILTL_loss "FPrm_pending(567)" VALUE 0x00164DDA /* @ECU_Address@FPrm_pending@0x021BE46E@ */ ECIPP_ALIGNMENT_UWORD 65535 Compu_IDENTITY 0 65535 PHYS_UNIT "Bit Mask" /end CHARACTERISTIC
/begin CHARACTERISTIC FPnd_OILTL_Lvl_lo "FPrm_pending(571)" VALUE 0x00164DE2 /* @ECU_Address@FPrm_pending@0x021BE476@ */ ECIPP_ALIGNMENT_UWORD 65535 Compu_IDENTITY 0 65535 PHYS_UNIT "Bit Mask" /end CHARACTERISTIC
/begin CHARACTERISTIC FPnd_OILTL_Lvl_OOR "FPrm_pending(569)" VALUE 0x00164DDE /* @ECU_Address@FPrm_pending@0x021BE472@ */ ECIPP_ALIGNMENT_UWORD 65535 Compu_IDENTITY 0 65535 PHYS_UNIT "Bit Mask" /end CHARACTERISTIC
/begin CHARACTERISTIC FPnd_OILTL_T_hi "FPrm_pending(572)" VALUE 0x00164DE4 /* @ECU_Address@FPrm_pending@0x021BE478@ */ ECIPP_ALIGNMENT_UWORD 65535 Compu_IDENTITY 0 65535 PHYS_UNIT "Bit Mask" /end CHARACTERISTIC
/begin CHARACTERISTIC FPnd_OILTL_T_OOR "FPrm_pending(570)" VALUE 0x00164DE0 /* @ECU_Address@FPrm_pending@0x021BE474@ */ ECIPP_ALIGNMENT_UWORD 65535 Compu_IDENTITY 0 65535 PHYS_UNIT "Bit Mask" /end CHARACTERISTIC
/begin CHARACTERISTIC FPnd_OILTL_V_OOR "FPrm_pending(568)" VALUE 0x00164DDC /* @ECU_Address@FPrm_pending@0x021BE470@ */ ECIPP_ALIGNMENT_UWORD 65535 Compu_IDENTITY 0 65535 PHYS_UNIT "Bit Mask" /end CHARACTERISTIC
/begin CHARACTERISTIC FPnd_PAUX_dP1_max "FPrm_pending(416)" VALUE 0x00164CAC /* @ECU_Address@FPrm_pending@0x021BE340@ */ ECIPP_ALIGNMENT_UWORD 65535 Compu_IDENTITY 0 65535 PHYS_UNIT "Bit Mask" /end CHARACTERISTIC
/begin CHARACTERISTIC FPnd_PAUX_dP1_min "FPrm_pending(417)" VALUE 0x00164CAE /* @ECU_Address@FPrm_pending@0x021BE342@ */ ECIPP_ALIGNMENT_UWORD 65535 Compu_IDENTITY 0 65535 PHYS_UNIT "Bit Mask" /end CHARACTERISTIC
/begin CHARACTERISTIC FPnd_PAUX_dP2_max "FPrm_pending(418)" VALUE 0x00164CB0 /* @ECU_Address@FPrm_pending@0x021BE344@ */ ECIPP_ALIGNMENT_UWORD 65535 Compu_IDENTITY 0 65535 PHYS_UNIT "Bit Mask" /end CHARACTERISTIC
/begin CHARACTERISTIC FPnd_PAUX_dP2_min "FPrm_pending(419)" VALUE 0x00164CB2 /* @ECU_Address@FPrm_pending@0x021BE346@ */ ECIPP_ALIGNMENT_UWORD 65535 Compu_IDENTITY 0 65535 PHYS_UNIT "Bit Mask" /end CHARACTERISTIC
/begin CHARACTERISTIC FPnd_PAUX1_max "FPrm_pending(408)" VALUE 0x00164C9C /* @ECU_Address@FPrm_pending@0x021BE330@ */ ECIPP_ALIGNMENT_UWORD 65535 Compu_IDENTITY 0 65535 PHYS_UNIT "Bit Mask" /end CHARACTERISTIC
/begin CHARACTERISTIC FPnd_PAUX1_min "FPrm_pending(409)" VALUE 0x00164C9E /* @ECU_Address@FPrm_pending@0x021BE332@ */ ECIPP_ALIGNMENT_UWORD 65535 Compu_IDENTITY 0 65535 PHYS_UNIT "Bit Mask" /end CHARACTERISTIC
/begin CHARACTERISTIC FPnd_PAUX2_max "FPrm_pending(410)" VALUE 0x00164CA0 /* @ECU_Address@FPrm_pending@0x021BE334@ */ ECIPP_ALIGNMENT_UWORD 65535 Compu_IDENTITY 0 65535 PHYS_UNIT "Bit Mask" /end CHARACTERISTIC
/begin CHARACTERISTIC FPnd_PAUX2_min "FPrm_pending(411)" VALUE 0x00164CA2 /* @ECU_Address@FPrm_pending@0x021BE336@ */ ECIPP_ALIGNMENT_UWORD 65535 Compu_IDENTITY 0 65535 PHYS_UNIT "Bit Mask" /end CHARACTERISTIC
/begin CHARACTERISTIC FPnd_PAUX3_max "FPrm_pending(412)" VALUE 0x00164CA4 /* @ECU_Address@FPrm_pending@0x021BE338@ */ ECIPP_ALIGNMENT_UWORD 65535 Compu_IDENTITY 0 65535 PHYS_UNIT "Bit Mask" /end CHARACTERISTIC
/begin CHARACTERISTIC FPnd_PAUX3_min "FPrm_pending(413)" VALUE 0x00164CA6 /* @ECU_Address@FPrm_pending@0x021BE33A@ */ ECIPP_ALIGNMENT_UWORD 65535 Compu_IDENTITY 0 65535 PHYS_UNIT "Bit Mask" /end CHARACTERISTIC
/begin CHARACTERISTIC FPnd_PAUX4_max "FPrm_pending(414)" VALUE 0x00164CA8 /* @ECU_Address@FPrm_pending@0x021BE33C@ */ ECIPP_ALIGNMENT_UWORD 65535 Compu_IDENTITY 0 65535 PHYS_UNIT "Bit Mask" /end CHARACTERISTIC
/begin CHARACTERISTIC FPnd_PAUX4_min "FPrm_pending(415)" VALUE 0x00164CAA /* @ECU_Address@FPrm_pending@0x021BE33E@ */ ECIPP_ALIGNMENT_UWORD 65535 Compu_IDENTITY 0 65535 PHYS_UNIT "Bit Mask" /end CHARACTERISTIC
/begin CHARACTERISTIC FPnd_PPEG_BP "FPrm_pending(500)" VALUE 0x00164D54 /* @ECU_Address@FPrm_pending@0x021BE3E8@ */ ECIPP_ALIGNMENT_UWORD 65535 Compu_IDENTITY 0 65535 PHYS_UNIT "Bit Mask" /end CHARACTERISTIC
/begin CHARACTERISTIC FPnd_PPEG_CVP1 "FPrm_pending(575)" VALUE 0x00164DEA /* @ECU_Address@FPrm_pending@0x021BE47E@ */ ECIPP_ALIGNMENT_UWORD 65535 Compu_IDENTITY 0 65535 PHYS_UNIT "Bit Mask" /end CHARACTERISTIC
/begin CHARACTERISTIC FPnd_PPEG_CVP2 "FPrm_pending(576)" VALUE 0x00164DEC /* @ECU_Address@FPrm_pending@0x021BE480@ */ ECIPP_ALIGNMENT_UWORD 65535 Compu_IDENTITY 0 65535 PHYS_UNIT "Bit Mask" /end CHARACTERISTIC
/begin CHARACTERISTIC FPnd_PPEG_EBP "FPrm_pending(501)" VALUE 0x00164D56 /* @ECU_Address@FPrm_pending@0x021BE3EA@ */ ECIPP_ALIGNMENT_UWORD 65535 Compu_IDENTITY 0 65535 PHYS_UNIT "Bit Mask" /end CHARACTERISTIC
/begin CHARACTERISTIC FPnd_PPEG_EGRdP "FPrm_pending(586)" VALUE 0x00164E00 /* @ECU_Address@FPrm_pending@0x021BE494@ */ ECIPP_ALIGNMENT_UWORD 65535 Compu_IDENTITY 0 65535 PHYS_UNIT "Bit Mask" /end CHARACTERISTIC
/begin CHARACTERISTIC FPnd_PPEG_EGRHP "FPrm_pending(503)" VALUE 0x00164D5A /* @ECU_Address@FPrm_pending@0x021BE3EE@ */ ECIPP_ALIGNMENT_UWORD 65535 Compu_IDENTITY 0 65535 PHYS_UNIT "Bit Mask" /end CHARACTERISTIC
/begin CHARACTERISTIC FPnd_PPEG_EGRLP "FPrm_pending(502)" VALUE 0x00164D58 /* @ECU_Address@FPrm_pending@0x021BE3EC@ */ ECIPP_ALIGNMENT_UWORD 65535 Compu_IDENTITY 0 65535 PHYS_UNIT "Bit Mask" /end CHARACTERISTIC
/begin CHARACTERISTIC FPnd_PPEG_EGRwrP "FPrm_pending(505)" VALUE 0x00164D5E /* @ECU_Address@FPrm_pending@0x021BE3F2@ */ ECIPP_ALIGNMENT_UWORD 65535 Compu_IDENTITY 0 65535 PHYS_UNIT "Bit Mask" /end CHARACTERISTIC
/begin CHARACTERISTIC FPnd_PPEG_MAP "FPrm_pending(506)" VALUE 0x00164D60 /* @ECU_Address@FPrm_pending@0x021BE3F4@ */ ECIPP_ALIGNMENT_UWORD 65535 Compu_IDENTITY 0 65535 PHYS_UNIT "Bit Mask" /end CHARACTERISTIC
/begin CHARACTERISTIC FPnd_PPEG_TIP "FPrm_pending(504)" VALUE 0x00164D5C /* @ECU_Address@FPrm_pending@0x021BE3F0@ */ ECIPP_ALIGNMENT_UWORD 65535 Compu_IDENTITY 0 65535 PHYS_UNIT "Bit Mask" /end CHARACTERISTIC
/begin CHARACTERISTIC FPnd_PWM1_off_loVf "FPrm_pending(147)" VALUE 0x00164A92 /* @ECU_Address@FPrm_pending@0x021BE126@ */ ECIPP_ALIGNMENT_UWORD 65535 Compu_IDENTITY 0 65535 PHYS_UNIT "Bit Mask" /end CHARACTERISTIC
/begin CHARACTERISTIC FPnd_PWM1_on_hiVf "FPrm_pending(148)" VALUE 0x00164A94 /* @ECU_Address@FPrm_pending@0x021BE128@ */ ECIPP_ALIGNMENT_UWORD 65535 Compu_IDENTITY 0 65535 PHYS_UNIT "Bit Mask" /end CHARACTERISTIC
/begin CHARACTERISTIC FPnd_PWM10_off_loVf "FPrm_pending(330)" VALUE 0x00164C00 /* @ECU_Address@FPrm_pending@0x021BE294@ */ ECIPP_ALIGNMENT_UWORD 65535 Compu_IDENTITY 0 65535 PHYS_UNIT "Bit Mask" /end CHARACTERISTIC
/begin CHARACTERISTIC FPnd_PWM10_on_hiVf "FPrm_pending(331)" VALUE 0x00164C02 /* @ECU_Address@FPrm_pending@0x021BE296@ */ ECIPP_ALIGNMENT_UWORD 65535 Compu_IDENTITY 0 65535 PHYS_UNIT "Bit Mask" /end CHARACTERISTIC
/begin CHARACTERISTIC FPnd_PWM11_off_loVf "FPrm_pending(332)" VALUE 0x00164C04 /* @ECU_Address@FPrm_pending@0x021BE298@ */ ECIPP_ALIGNMENT_UWORD 65535 Compu_IDENTITY 0 65535 PHYS_UNIT "Bit Mask" /end CHARACTERISTIC
/begin CHARACTERISTIC FPnd_PWM11_on_hiVf "FPrm_pending(333)" VALUE 0x00164C06 /* @ECU_Address@FPrm_pending@0x021BE29A@ */ ECIPP_ALIGNMENT_UWORD 65535 Compu_IDENTITY 0 65535 PHYS_UNIT "Bit Mask" /end CHARACTERISTIC
/begin CHARACTERISTIC FPnd_PWM12_off_loVf "FPrm_pending(334)" VALUE 0x00164C08 /* @ECU_Address@FPrm_pending@0x021BE29C@ */ ECIPP_ALIGNMENT_UWORD 65535 Compu_IDENTITY 0 65535 PHYS_UNIT "Bit Mask" /end CHARACTERISTIC
/begin CHARACTERISTIC FPnd_PWM12_on_hiVf "FPrm_pending(335)" VALUE 0x00164C0A /* @ECU_Address@FPrm_pending@0x021BE29E@ */ ECIPP_ALIGNMENT_UWORD 65535 Compu_IDENTITY 0 65535 PHYS_UNIT "Bit Mask" /end CHARACTERISTIC
/begin CHARACTERISTIC FPnd_PWM13_off_loVf "FPrm_pending(336)" VALUE 0x00164C0C /* @ECU_Address@FPrm_pending@0x021BE2A0@ */ ECIPP_ALIGNMENT_UWORD 65535 Compu_IDENTITY 0 65535 PHYS_UNIT "Bit Mask" /end CHARACTERISTIC
/begin CHARACTERISTIC FPnd_PWM13_on_hiVf "FPrm_pending(337)" VALUE 0x00164C0E /* @ECU_Address@FPrm_pending@0x021BE2A2@ */ ECIPP_ALIGNMENT_UWORD 65535 Compu_IDENTITY 0 65535 PHYS_UNIT "Bit Mask" /end CHARACTERISTIC
/begin CHARACTERISTIC FPnd_PWM14_off_loVf "FPrm_pending(338)" VALUE 0x00164C10 /* @ECU_Address@FPrm_pending@0x021BE2A4@ */ ECIPP_ALIGNMENT_UWORD 65535 Compu_IDENTITY 0 65535 PHYS_UNIT "Bit Mask" /end CHARACTERISTIC
/begin CHARACTERISTIC FPnd_PWM14_on_hiVf "FPrm_pending(339)" VALUE 0x00164C12 /* @ECU_Address@FPrm_pending@0x021BE2A6@ */ ECIPP_ALIGNMENT_UWORD 65535 Compu_IDENTITY 0 65535 PHYS_UNIT "Bit Mask" /end CHARACTERISTIC
/begin CHARACTERISTIC FPnd_PWM15_off_loVf "FPrm_pending(340)" VALUE 0x00164C14 /* @ECU_Address@FPrm_pending@0x021BE2A8@ */ ECIPP_ALIGNMENT_UWORD 65535 Compu_IDENTITY 0 65535 PHYS_UNIT "Bit Mask" /end CHARACTERISTIC
/begin CHARACTERISTIC FPnd_PWM15_on_hiVf "FPrm_pending(341)" VALUE 0x00164C16 /* @ECU_Address@FPrm_pending@0x021BE2AA@ */ ECIPP_ALIGNMENT_UWORD 65535 Compu_IDENTITY 0 65535 PHYS_UNIT "Bit Mask" /end CHARACTERISTIC
/begin CHARACTERISTIC FPnd_PWM16_off_loVf "FPrm_pending(342)" VALUE 0x00164C18 /* @ECU_Address@FPrm_pending@0x021BE2AC@ */ ECIPP_ALIGNMENT_UWORD 65535 Compu_IDENTITY 0 65535 PHYS_UNIT "Bit Mask" /end CHARACTERISTIC
/begin CHARACTERISTIC FPnd_PWM16_on_hiVf "FPrm_pending(343)" VALUE 0x00164C1A /* @ECU_Address@FPrm_pending@0x021BE2AE@ */ ECIPP_ALIGNMENT_UWORD 65535 Compu_IDENTITY 0 65535 PHYS_UNIT "Bit Mask" /end CHARACTERISTIC
/begin CHARACTERISTIC FPnd_PWM17_off_loVf "FPrm_pending(344)" VALUE 0x00164C1C /* @ECU_Address@FPrm_pending@0x021BE2B0@ */ ECIPP_ALIGNMENT_UWORD 65535 Compu_IDENTITY 0 65535 PHYS_UNIT "Bit Mask" /end CHARACTERISTIC
/begin CHARACTERISTIC FPnd_PWM17_on_hiVf "FPrm_pending(345)" VALUE 0x00164C1E /* @ECU_Address@FPrm_pending@0x021BE2B2@ */ ECIPP_ALIGNMENT_UWORD 65535 Compu_IDENTITY 0 65535 PHYS_UNIT "Bit Mask" /end CHARACTERISTIC
/begin CHARACTERISTIC FPnd_PWM18_off_loVf "FPrm_pending(346)" VALUE 0x00164C20 /* @ECU_Address@FPrm_pending@0x021BE2B4@ */ ECIPP_ALIGNMENT_UWORD 65535 Compu_IDENTITY 0 65535 PHYS_UNIT "Bit Mask" /end CHARACTERISTIC
/begin CHARACTERISTIC FPnd_PWM18_on_hiVf "FPrm_pending(347)" VALUE 0x00164C22 /* @ECU_Address@FPrm_pending@0x021BE2B6@ */ ECIPP_ALIGNMENT_UWORD 65535 Compu_IDENTITY 0 65535 PHYS_UNIT "Bit Mask" /end CHARACTERISTIC
/begin CHARACTERISTIC FPnd_PWM19_off_loVf "FPrm_pending(348)" VALUE 0x00164C24 /* @ECU_Address@FPrm_pending@0x021BE2B8@ */ ECIPP_ALIGNMENT_UWORD 65535 Compu_IDENTITY 0 65535 PHYS_UNIT "Bit Mask" /end CHARACTERISTIC
/begin CHARACTERISTIC FPnd_PWM19_on_hiVf "FPrm_pending(349)" VALUE 0x00164C26 /* @ECU_Address@FPrm_pending@0x021BE2BA@ */ ECIPP_ALIGNMENT_UWORD 65535 Compu_IDENTITY 0 65535 PHYS_UNIT "Bit Mask" /end CHARACTERISTIC
/begin CHARACTERISTIC FPnd_PWM2_off_loVf "FPrm_pending(149)" VALUE 0x00164A96 /* @ECU_Address@FPrm_pending@0x021BE12A@ */ ECIPP_ALIGNMENT_UWORD 65535 Compu_IDENTITY 0 65535 PHYS_UNIT "Bit Mask" /end CHARACTERISTIC
/begin CHARACTERISTIC FPnd_PWM2_on_hiVf "FPrm_pending(150)" VALUE 0x00164A98 /* @ECU_Address@FPrm_pending@0x021BE12C@ */ ECIPP_ALIGNMENT_UWORD 65535 Compu_IDENTITY 0 65535 PHYS_UNIT "Bit Mask" /end CHARACTERISTIC
/begin CHARACTERISTIC FPnd_PWM20_off_loVf "FPrm_pending(350)" VALUE 0x00164C28 /* @ECU_Address@FPrm_pending@0x021BE2BC@ */ ECIPP_ALIGNMENT_UWORD 65535 Compu_IDENTITY 0 65535 PHYS_UNIT "Bit Mask" /end CHARACTERISTIC
/begin CHARACTERISTIC FPnd_PWM20_on_hiVf "FPrm_pending(351)" VALUE 0x00164C2A /* @ECU_Address@FPrm_pending@0x021BE2BE@ */ ECIPP_ALIGNMENT_UWORD 65535 Compu_IDENTITY 0 65535 PHYS_UNIT "Bit Mask" /end CHARACTERISTIC
/begin CHARACTERISTIC FPnd_PWM21_off_loVf "FPrm_pending(352)" VALUE 0x00164C2C /* @ECU_Address@FPrm_pending@0x021BE2C0@ */ ECIPP_ALIGNMENT_UWORD 65535 Compu_IDENTITY 0 65535 PHYS_UNIT "Bit Mask" /end CHARACTERISTIC
/begin CHARACTERISTIC FPsvr_MJ_Pe_HiExp "FPrm_severity(92)" VALUE 0x00165E3A /* @ECU_Address@FPrm_severity@0x024B305C@ */ ECIPP_ALIGNMENT_UBYTE 255 Compu_IDENTITY 0 255 PHYS_UNIT "Severity+Class" /end CHARACTERISTIC
/begin CHARACTERISTIC FPsvr_MJ_Pe_LoExp "FPrm_severity(93)" VALUE 0x00165E3B /* @ECU_Address@FPrm_severity@0x024B305D@ */ ECIPP_ALIGNMENT_UBYTE 255 Compu_IDENTITY 0 255 PHYS_UNIT "Severity+Class" /end CHARACTERISTIC
/begin CHARACTERISTIC FPsvr_MJ2_comm_tout "FPrm_severity(556)" VALUE 0x0016600A /* @ECU_Address@FPrm_severity@0x024B322C@ */ ECIPP_ALIGNMENT_UBYTE 255 Compu_IDENTITY 0 255 PHYS_UNIT "Severity+Class" /end CHARACTERISTIC
/begin CHARACTERISTIC FPsvr_MJ2_intF_act "FPrm_severity(559)" VALUE 0x0016600D /* @ECU_Address@FPrm_severity@0x024B322F@ */ ECIPP_ALIGNMENT_UBYTE 255 Compu_IDENTITY 0 255 PHYS_UNIT "Severity+Class" /end CHARACTERISTIC
/begin CHARACTERISTIC FPsvr_MJ2_intF_circ "FPrm_severity(560)" VALUE 0x0016600E /* @ECU_Address@FPrm_severity@0x024B3230@ */ ECIPP_ALIGNMENT_UBYTE 255 Compu_IDENTITY 0 255 PHYS_UNIT "Severity+Class" /end CHARACTERISTIC
/begin CHARACTERISTIC FPsvr_MJ2_intF_comm "FPrm_severity(561)" VALUE 0x0016600F /* @ECU_Address@FPrm_severity@0x024B3231@ */ ECIPP_ALIGNMENT_UBYTE 255 Compu_IDENTITY 0 255 PHYS_UNIT "Severity+Class" /end CHARACTERISTIC
/begin CHARACTERISTIC FPsvr_MJ2_intF_Vhi "FPrm_severity(557)" VALUE 0x0016600B /* @ECU_Address@FPrm_severity@0x024B322D@ */ ECIPP_ALIGNMENT_UBYTE 255 Compu_IDENTITY 0 255 PHYS_UNIT "Severity+Class" /end CHARACTERISTIC
/begin CHARACTERISTIC FPsvr_MJ2_intF_Vlo "FPrm_severity(558)" VALUE 0x0016600C /* @ECU_Address@FPrm_severity@0x024B322E@ */ ECIPP_ALIGNMENT_UBYTE 255 Compu_IDENTITY 0 255 PHYS_UNIT "Severity+Class" /end CHARACTERISTIC
/begin CHARACTERISTIC FPsvr_MJ2_Pe_HiExp "FPrm_severity(554)" VALUE 0x00166008 /* @ECU_Address@FPrm_severity@0x024B322A@ */ ECIPP_ALIGNMENT_UBYTE 255 Compu_IDENTITY 0 255 PHYS_UNIT "Severity+Class" /end CHARACTERISTIC
/begin CHARACTERISTIC FPsvr_MJ2_Pe_LoExp "FPrm_severity(555)" VALUE 0x00166009 /* @ECU_Address@FPrm_severity@0x024B322B@ */ ECIPP_ALIGNMENT_UBYTE 255 Compu_IDENTITY 0 255 PHYS_UNIT "Severity+Class" /end CHARACTERISTIC
/begin CHARACTERISTIC FPsvr_NOx_hi "FPrm_severity(623)" VALUE 0x0016604D /* @ECU_Address@FPrm_severity@0x024B326F@ */ ECIPP_ALIGNMENT_UBYTE 255 Compu_IDENTITY 0 255 PHYS_UNIT "Severity+Class" /end CHARACTERISTIC
/begin CHARACTERISTIC FPsvr_OilP_hiP "FPrm_severity(109)" VALUE 0x00165E4B /* @ECU_Address@FPrm_severity@0x024B306D@ */ ECIPP_ALIGNMENT_UBYTE 255 Compu_IDENTITY 0 255 PHYS_UNIT "Severity+Class" /end CHARACTERISTIC
/begin CHARACTERISTIC FPsvr_OilP_loP "FPrm_severity(108)" VALUE 0x00165E4A /* @ECU_Address@FPrm_severity@0x024B306C@ */ ECIPP_ALIGNMENT_UBYTE 255 Compu_IDENTITY 0 255 PHYS_UNIT "Severity+Class" /end CHARACTERISTIC
/begin CHARACTERISTIC FPsvr_OilP_maxV "FPrm_severity(110)" VALUE 0x00165E4C /* @ECU_Address@FPrm_severity@0x024B306E@ */ ECIPP_ALIGNMENT_UBYTE 255 Compu_IDENTITY 0 255 PHYS_UNIT "Severity+Class" /end CHARACTERISTIC
/begin CHARACTERISTIC FPsvr_OilP_minV "FPrm_severity(111)" VALUE 0x00165E4D /* @ECU_Address@FPrm_severity@0x024B306F@ */ ECIPP_ALIGNMENT_UBYTE 255 Compu_IDENTITY 0 255 PHYS_UNIT "Severity+Class" /end CHARACTERISTIC
/begin CHARACTERISTIC FPsvr_OILP_test "FPrm_severity(40)" VALUE 0x00165E06 /* @ECU_Address@FPrm_severity@0x024B3028@ */ ECIPP_ALIGNMENT_UBYTE 255 Compu_IDENTITY 0 255 PHYS_UNIT "Severity+Class" /end CHARACTERISTIC
/begin CHARACTERISTIC FPsvr_OilP2_loP "FPrm_severity(215)" VALUE 0x00165EB5 /* @ECU_Address@FPrm_severity@0x024B30D7@ */ ECIPP_ALIGNMENT_UBYTE 255 Compu_IDENTITY 0 255 PHYS_UNIT "Severity+Class" /end CHARACTERISTIC
/begin CHARACTERISTIC FPsvr_OILTL_loss "FPrm_severity(567)" VALUE 0x00166015 /* @ECU_Address@FPrm_severity@0x024B3237@ */ ECIPP_ALIGNMENT_UBYTE 255 Compu_IDENTITY 0 255 PHYS_UNIT "Severity+Class" /end CHARACTERISTIC
/begin CHARACTERISTIC FPsvr_OILTL_Lvl_lo "FPrm_severity(571)" VALUE 0x00166019 /* @ECU_Address@FPrm_severity@0x024B323B@ */ ECIPP_ALIGNMENT_UBYTE 255 Compu_IDENTITY 0 255 PHYS_UNIT "Severity+Class" /end CHARACTERISTIC
/begin CHARACTERISTIC FPsvr_OILTL_Lvl_OOR "FPrm_severity(569)" VALUE 0x00166017 /* @ECU_Address@FPrm_severity@0x024B3239@ */ ECIPP_ALIGNMENT_UBYTE 255 Compu_IDENTITY 0 255 PHYS_UNIT "Severity+Class" /end CHARACTERISTIC
/begin CHARACTERISTIC FPsvr_OILTL_T_hi "FPrm_severity(572)" VALUE 0x0016601A /* @ECU_Address@FPrm_severity@0x024B323C@ */ ECIPP_ALIGNMENT_UBYTE 255 Compu_IDENTITY 0 255 PHYS_UNIT "Severity+Class" /end CHARACTERISTIC
/begin CHARACTERISTIC FPsvr_OILTL_T_OOR "FPrm_severity(570)" VALUE 0x00166018 /* @ECU_Address@FPrm_severity@0x024B323A@ */ ECIPP_ALIGNMENT_UBYTE 255 Compu_IDENTITY 0 255 PHYS_UNIT "Severity+Class" /end CHARACTERISTIC
/begin CHARACTERISTIC FPsvr_OILTL_V_OOR "FPrm_severity(568)" VALUE 0x00166016 /* @ECU_Address@FPrm_severity@0x024B3238@ */ ECIPP_ALIGNMENT_UBYTE 255 Compu_IDENTITY 0 255 PHYS_UNIT "Severity+Class" /end CHARACTERISTIC
/begin CHARACTERISTIC FPsvr_PAUX_dP1_max "FPrm_severity(416)" VALUE 0x00165F7E /* @ECU_Address@FPrm_severity@0x024B31A0@ */ ECIPP_ALIGNMENT_UBYTE 255 Compu_IDENTITY 0 255 PHYS_UNIT "Severity+Class" /end CHARACTERISTIC
/begin CHARACTERISTIC FPsvr_PAUX_dP1_min "FPrm_severity(417)" VALUE 0x00165F7F /* @ECU_Address@FPrm_severity@0x024B31A1@ */ ECIPP_ALIGNMENT_UBYTE 255 Compu_IDENTITY 0 255 PHYS_UNIT "Severity+Class" /end CHARACTERISTIC
/begin CHARACTERISTIC FPsvr_PAUX_dP2_max "FPrm_severity(418)" VALUE 0x00165F80 /* @ECU_Address@FPrm_severity@0x024B31A2@ */ ECIPP_ALIGNMENT_UBYTE 255 Compu_IDENTITY 0 255 PHYS_UNIT "Severity+Class" /end CHARACTERISTIC
/begin CHARACTERISTIC FPsvr_PAUX_dP2_min "FPrm_severity(419)" VALUE 0x00165F81 /* @ECU_Address@FPrm_severity@0x024B31A3@ */ ECIPP_ALIGNMENT_UBYTE 255 Compu_IDENTITY 0 255 PHYS_UNIT "Severity+Class" /end CHARACTERISTIC
/begin CHARACTERISTIC FPsvr_PAUX1_max "FPrm_severity(408)" VALUE 0x00165F76 /* @ECU_Address@FPrm_severity@0x024B3198@ */ ECIPP_ALIGNMENT_UBYTE 255 Compu_IDENTITY 0 255 PHYS_UNIT "Severity+Class" /end CHARACTERISTIC
/begin CHARACTERISTIC FPsvr_PAUX1_min "FPrm_severity(409)" VALUE 0x00165F77 /* @ECU_Address@FPrm_severity@0x024B3199@ */ ECIPP_ALIGNMENT_UBYTE 255 Compu_IDENTITY 0 255 PHYS_UNIT "Severity+Class" /end CHARACTERISTIC
/begin CHARACTERISTIC FPsvr_PAUX2_max "FPrm_severity(410)" VALUE 0x00165F78 /* @ECU_Address@FPrm_severity@0x024B319A@ */ ECIPP_ALIGNMENT_UBYTE 255 Compu_IDENTITY 0 255 PHYS_UNIT "Severity+Class" /end CHARACTERISTIC
/begin CHARACTERISTIC FPsvr_PAUX2_min "FPrm_severity(411)" VALUE 0x00165F79 /* @ECU_Address@FPrm_severity@0x024B319B@ */ ECIPP_ALIGNMENT_UBYTE 255 Compu_IDENTITY 0 255 PHYS_UNIT "Severity+Class" /end CHARACTERISTIC
/begin CHARACTERISTIC FPsvr_PAUX3_max "FPrm_severity(412)" VALUE 0x00165F7A /* @ECU_Address@FPrm_severity@0x024B319C@ */ ECIPP_ALIGNMENT_UBYTE 255 Compu_IDENTITY 0 255 PHYS_UNIT "Severity+Class" /end CHARACTERISTIC
/begin CHARACTERISTIC FPsvr_PAUX3_min "FPrm_severity(413)" VALUE 0x00165F7B /* @ECU_Address@FPrm_severity@0x024B319D@ */ ECIPP_ALIGNMENT_UBYTE 255 Compu_IDENTITY 0 255 PHYS_UNIT "Severity+Class" /end CHARACTERISTIC
/begin CHARACTERISTIC FPsvr_PAUX4_max "FPrm_severity(414)" VALUE 0x00165F7C /* @ECU_Address@FPrm_severity@0x024B319E@ */ ECIPP_ALIGNMENT_UBYTE 255 Compu_IDENTITY 0 255 PHYS_UNIT "Severity+Class" /end CHARACTERISTIC
/begin CHARACTERISTIC FPsvr_PAUX4_min "FPrm_severity(415)" VALUE 0x00165F7D /* @ECU_Address@FPrm_severity@0x024B319F@ */ ECIPP_ALIGNMENT_UBYTE 255 Compu_IDENTITY 0 255 PHYS_UNIT "Severity+Class" /end CHARACTERISTIC
/begin CHARACTERISTIC FPsvr_PPEG_BP "FPrm_severity(500)" VALUE 0x00165FD2 /* @ECU_Address@FPrm_severity@0x024B31F4@ */ ECIPP_ALIGNMENT_UBYTE 255 Compu_IDENTITY 0 255 PHYS_UNIT "Severity+Class" /end CHARACTERISTIC
/begin CHARACTERISTIC FPsvr_PPEG_CVP1 "FPrm_severity(575)" VALUE 0x0016601D /* @ECU_Address@FPrm_severity@0x024B323F@ */ ECIPP_ALIGNMENT_UBYTE 255 Compu_IDENTITY 0 255 PHYS_UNIT "Severity+Class" /end CHARACTERISTIC
/begin CHARACTERISTIC FPsvr_PPEG_CVP2 "FPrm_severity(576)" VALUE 0x0016601E /* @ECU_Address@FPrm_severity@0x024B3240@ */ ECIPP_ALIGNMENT_UBYTE 255 Compu_IDENTITY 0 255 PHYS_UNIT "Severity+Class" /end CHARACTERISTIC
/begin CHARACTERISTIC FPsvr_PPEG_EBP "FPrm_severity(501)" VALUE 0x00165FD3 /* @ECU_Address@FPrm_severity@0x024B31F5@ */ ECIPP_ALIGNMENT_UBYTE 255 Compu_IDENTITY 0 255 PHYS_UNIT "Severity+Class" /end CHARACTERISTIC
/begin CHARACTERISTIC FPsvr_PPEG_EGRdP "FPrm_severity(586)" VALUE 0x00166028 /* @ECU_Address@FPrm_severity@0x024B324A@ */ ECIPP_ALIGNMENT_UBYTE 255 Compu_IDENTITY 0 255 PHYS_UNIT "Severity+Class" /end CHARACTERISTIC
/begin CHARACTERISTIC FPsvr_PPEG_EGRHP "FPrm_severity(503)" VALUE 0x00165FD5 /* @ECU_Address@FPrm_severity@0x024B31F7@ */ ECIPP_ALIGNMENT_UBYTE 255 Compu_IDENTITY 0 255 PHYS_UNIT "Severity+Class" /end CHARACTERISTIC
/begin CHARACTERISTIC FPsvr_PPEG_EGRLP "FPrm_severity(502)" VALUE 0x00165FD4 /* @ECU_Address@FPrm_severity@0x024B31F6@ */ ECIPP_ALIGNMENT_UBYTE 255 Compu_IDENTITY 0 255 PHYS_UNIT "Severity+Class" /end CHARACTERISTIC
/begin CHARACTERISTIC FPsvr_PPEG_EGRwrP "FPrm_severity(505)" VALUE 0x00165FD7 /* @ECU_Address@FPrm_severity@0x024B31F9@ */ ECIPP_ALIGNMENT_UBYTE 255 Compu_IDENTITY 0 255 PHYS_UNIT "Severity+Class" /end CHARACTERISTIC
/begin CHARACTERISTIC FPsvr_PPEG_MAP "FPrm_severity(506)" VALUE 0x00165FD8 /* @ECU_Address@FPrm_severity@0x024B31FA@ */ ECIPP_ALIGNMENT_UBYTE 255 Compu_IDENTITY 0 255 PHYS_UNIT "Severity+Class" /end CHARACTERISTIC
/begin CHARACTERISTIC FPsvr_PPEG_TIP "FPrm_severity(504)" VALUE 0x00165FD6 /* @ECU_Address@FPrm_severity@0x024B31F8@ */ ECIPP_ALIGNMENT_UBYTE 255 Compu_IDENTITY 0 255 PHYS_UNIT "Severity+Class" /end CHARACTERISTIC
/begin CHARACTERISTIC FPsvr_PWM1_off_loVf "FPrm_severity(147)" VALUE 0x00165E71 /* @ECU_Address@FPrm_severity@0x024B3093@ */ ECIPP_ALIGNMENT_UBYTE 255 Compu_IDENTITY 0 255 PHYS_UNIT "Severity+Class" /end CHARACTERISTIC
/begin CHARACTERISTIC FPsvr_PWM1_on_hiVf "FPrm_severity(148)" VALUE 0x00165E72 /* @ECU_Address@FPrm_severity@0x024B3094@ */ ECIPP_ALIGNMENT_UBYTE 255 Compu_IDENTITY 0 255 PHYS_UNIT "Severity+Class" /end CHARACTERISTIC
/begin CHARACTERISTIC FPsvr_PWM10_off_loVf "FPrm_severity(330)" VALUE 0x00165F28 /* @ECU_Address@FPrm_severity@0x024B314A@ */ ECIPP_ALIGNMENT_UBYTE 255 Compu_IDENTITY 0 255 PHYS_UNIT "Severity+Class" /end CHARACTERISTIC
/begin CHARACTERISTIC FPsvr_PWM10_on_hiVf "FPrm_severity(331)" VALUE 0x00165F29 /* @ECU_Address@FPrm_severity@0x024B314B@ */ ECIPP_ALIGNMENT_UBYTE 255 Compu_IDENTITY 0 255 PHYS_UNIT "Severity+Class" /end CHARACTERISTIC
/begin CHARACTERISTIC FPsvr_PWM11_off_loVf "FPrm_severity(332)" VALUE 0x00165F2A /* @ECU_Address@FPrm_severity@0x024B314C@ */ ECIPP_ALIGNMENT_UBYTE 255 Compu_IDENTITY 0 255 PHYS_UNIT "Severity+Class" /end CHARACTERISTIC
/begin CHARACTERISTIC FPsvr_PWM11_on_hiVf "FPrm_severity(333)" VALUE 0x00165F2B /* @ECU_Address@FPrm_severity@0x024B314D@ */ ECIPP_ALIGNMENT_UBYTE 255 Compu_IDENTITY 0 255 PHYS_UNIT "Severity+Class" /end CHARACTERISTIC
/begin CHARACTERISTIC FPsvr_PWM12_off_loVf "FPrm_severity(334)" VALUE 0x00165F2C /* @ECU_Address@FPrm_severity@0x024B314E@ */ ECIPP_ALIGNMENT_UBYTE 255 Compu_IDENTITY 0 255 PHYS_UNIT "Severity+Class" /end CHARACTERISTIC
/begin CHARACTERISTIC FPsvr_PWM12_on_hiVf "FPrm_severity(335)" VALUE 0x00165F2D /* @ECU_Address@FPrm_severity@0x024B314F@ */ ECIPP_ALIGNMENT_UBYTE 255 Compu_IDENTITY 0 255 PHYS_UNIT "Severity+Class" /end CHARACTERISTIC
/begin CHARACTERISTIC FPsvr_PWM13_off_loVf "FPrm_severity(336)" VALUE 0x00165F2E /* @ECU_Address@FPrm_severity@0x024B3150@ */ ECIPP_ALIGNMENT_UBYTE 255 Compu_IDENTITY 0 255 PHYS_UNIT "Severity+Class" /end CHARACTERISTIC
/begin CHARACTERISTIC FPsvr_PWM13_on_hiVf "FPrm_severity(337)" VALUE 0x00165F2F /* @ECU_Address@FPrm_severity@0x024B3151@ */ ECIPP_ALIGNMENT_UBYTE 255 Compu_IDENTITY 0 255 PHYS_UNIT "Severity+Class" /end CHARACTERISTIC
/begin CHARACTERISTIC FPsvr_PWM14_off_loVf "FPrm_severity(338)" VALUE 0x00165F30 /* @ECU_Address@FPrm_severity@0x024B3152@ */ ECIPP_ALIGNMENT_UBYTE 255 Compu_IDENTITY 0 255 PHYS_UNIT "Severity+Class" /end CHARACTERISTIC
/begin CHARACTERISTIC FPsvr_PWM14_on_hiVf "FPrm_severity(339)" VALUE 0x00165F31 /* @ECU_Address@FPrm_severity@0x024B3153@ */ ECIPP_ALIGNMENT_UBYTE 255 Compu_IDENTITY 0 255 PHYS_UNIT "Severity+Class" /end CHARACTERISTIC
/begin CHARACTERISTIC FPsvr_PWM15_off_loVf "FPrm_severity(340)" VALUE 0x00165F32 /* @ECU_Address@FPrm_severity@0x024B3154@ */ ECIPP_ALIGNMENT_UBYTE 255 Compu_IDENTITY 0 255 PHYS_UNIT "Severity+Class" /end CHARACTERISTIC
/begin CHARACTERISTIC FPsvr_PWM15_on_hiVf "FPrm_severity(341)" VALUE 0x00165F33 /* @ECU_Address@FPrm_severity@0x024B3155@ */ ECIPP_ALIGNMENT_UBYTE 255 Compu_IDENTITY 0 255 PHYS_UNIT "Severity+Class" /end CHARACTERISTIC
/begin CHARACTERISTIC FPsvr_PWM16_off_loVf "FPrm_severity(342)" VALUE 0x00165F34 /* @ECU_Address@FPrm_severity@0x024B3156@ */ ECIPP_ALIGNMENT_UBYTE 255 Compu_IDENTITY 0 255 PHYS_UNIT "Severity+Class" /end CHARACTERISTIC
/begin CHARACTERISTIC FPsvr_PWM16_on_hiVf "FPrm_severity(343)" VALUE 0x00165F35 /* @ECU_Address@FPrm_severity@0x024B3157@ */ ECIPP_ALIGNMENT_UBYTE 255 Compu_IDENTITY 0 255 PHYS_UNIT "Severity+Class" /end CHARACTERISTIC
/begin CHARACTERISTIC FPsvr_PWM17_off_loVf "FPrm_severity(344)" VALUE 0x00165F36 /* @ECU_Address@FPrm_severity@0x024B3158@ */ ECIPP_ALIGNMENT_UBYTE 255 Compu_IDENTITY 0 255 PHYS_UNIT "Severity+Class" /end CHARACTERISTIC
/begin CHARACTERISTIC FPsvr_PWM17_on_hiVf "FPrm_severity(345)" VALUE 0x00165F37 /* @ECU_Address@FPrm_severity@0x024B3159@ */ ECIPP_ALIGNMENT_UBYTE 255 Compu_IDENTITY 0 255 PHYS_UNIT "Severity+Class" /end CHARACTERISTIC
/begin CHARACTERISTIC FPsvr_PWM18_off_loVf "FPrm_severity(346)" VALUE 0x00165F38 /* @ECU_Address@FPrm_severity@0x024B315A@ */ ECIPP_ALIGNMENT_UBYTE 255 Compu_IDENTITY 0 255 PHYS_UNIT "Severity+Class" /end CHARACTERISTIC
/begin CHARACTERISTIC FPsvr_PWM18_on_hiVf "FPrm_severity(347)" VALUE 0x00165F39 /* @ECU_Address@FPrm_severity@0x024B315B@ */ ECIPP_ALIGNMENT_UBYTE 255 Compu_IDENTITY 0 255 PHYS_UNIT "Severity+Class" /end CHARACTERISTIC
/begin CHARACTERISTIC FPsvr_PWM19_off_loVf "FPrm_severity(348)" VALUE 0x00165F3A /* @ECU_Address@FPrm_severity@0x024B315C@ */ ECIPP_ALIGNMENT_UBYTE 255 Compu_IDENTITY 0 255 PHYS_UNIT "Severity+Class" /end CHARACTERISTIC
/begin CHARACTERISTIC FPsvr_PWM19_on_hiVf "FPrm_severity(349)" VALUE 0x00165F3B /* @ECU_Address@FPrm_severity@0x024B315D@ */ ECIPP_ALIGNMENT_UBYTE 255 Compu_IDENTITY 0 255 PHYS_UNIT "Severity+Class" /end CHARACTERISTIC
/begin CHARACTERISTIC FPsvr_PWM2_off_loVf "FPrm_severity(149)" VALUE 0x00165E73 /* @ECU_Address@FPrm_severity@0x024B3095@ */ ECIPP_ALIGNMENT_UBYTE 255 Compu_IDENTITY 0 255 PHYS_UNIT "Severity+Class" /end CHARACTERISTIC
/begin CHARACTERISTIC FPsvr_PWM2_on_hiVf "FPrm_severity(150)" VALUE 0x00165E74 /* @ECU_Address@FPrm_severity@0x024B3096@ */ ECIPP_ALIGNMENT_UBYTE 255 Compu_IDENTITY 0 255 PHYS_UNIT "Severity+Class" /end CHARACTERISTIC
/begin CHARACTERISTIC FPsvr_PWM20_off_loVf "FPrm_severity(350)" VALUE 0x00165F3C /* @ECU_Address@FPrm_severity@0x024B315E@ */ ECIPP_ALIGNMENT_UBYTE 255 Compu_IDENTITY 0 255 PHYS_UNIT "Severity+Class" /end CHARACTERISTIC
/begin CHARACTERISTIC FPsvr_PWM20_on_hiVf "FPrm_severity(351)" VALUE 0x00165F3D /* @ECU_Address@FPrm_severity@0x024B315F@ */ ECIPP_ALIGNMENT_UBYTE 255 Compu_IDENTITY 0 255 PHYS_UNIT "Severity+Class" /end CHARACTERISTIC
/begin CHARACTERISTIC FPsvr_PWM21_off_loVf "FPrm_severity(352)" VALUE 0x00165F3E /* @ECU_Address@FPrm_severity@0x024B3160@ */ ECIPP_ALIGNMENT_UBYTE 255 Compu_IDENTITY 0 255 PHYS_UNIT "Severity+Class" /end CHARACTERISTIC
/begin CHARACTERISTIC FPsw_ext1_MJ_Pe_HiExp "FPrm_switches_ext1(92)" VALUE 0x00146EF6 /* @ECU_Address@FPrm_switches_ext1@0x023A50B8@ */ ECIPP_ALIGNMENT_UWORD 65535 Compu_IDENTITY 0 65535 PHYS_UNIT "Enable bits" /end CHARACTERISTIC
/begin CHARACTERISTIC FPsw_ext1_MJ_Pe_LoExp "FPrm_switches_ext1(93)" VALUE 0x00146EF8 /* @ECU_Address@FPrm_switches_ext1@0x023A50BA@ */ ECIPP_ALIGNMENT_UWORD 65535 Compu_IDENTITY 0 65535 PHYS_UNIT "Enable bits" /end CHARACTERISTIC
/begin CHARACTERISTIC FPsw_ext1_MJ2_comm_tout "FPrm_switches_ext1(556)" VALUE 0x00147296 /* @ECU_Address@FPrm_switches_ext1@0x023A5458@ */ ECIPP_ALIGNMENT_UWORD 65535 Compu_IDENTITY 0 65535 PHYS_UNIT "Enable bits" /end CHARACTERISTIC
/begin CHARACTERISTIC FPsw_ext1_MJ2_intF_act "FPrm_switches_ext1(559)" VALUE 0x0014729C /* @ECU_Address@FPrm_switches_ext1@0x023A545E@ */ ECIPP_ALIGNMENT_UWORD 65535 Compu_IDENTITY 0 65535 PHYS_UNIT "Enable bits" /end CHARACTERISTIC
/begin CHARACTERISTIC FPsw_ext1_MJ2_intF_circ "FPrm_switches_ext1(560)" VALUE 0x0014729E /* @ECU_Address@FPrm_switches_ext1@0x023A5460@ */ ECIPP_ALIGNMENT_UWORD 65535 Compu_IDENTITY 0 65535 PHYS_UNIT "Enable bits" /end CHARACTERISTIC
/begin CHARACTERISTIC FPsw_ext1_MJ2_intF_comm "FPrm_switches_ext1(561)" VALUE 0x001472A0 /* @ECU_Address@FPrm_switches_ext1@0x023A5462@ */ ECIPP_ALIGNMENT_UWORD 65535 Compu_IDENTITY 0 65535 PHYS_UNIT "Enable bits" /end CHARACTERISTIC
/begin CHARACTERISTIC FPsw_ext1_MJ2_intF_Vhi "FPrm_switches_ext1(557)" VALUE 0x00147298 /* @ECU_Address@FPrm_switches_ext1@0x023A545A@ */ ECIPP_ALIGNMENT_UWORD 65535 Compu_IDENTITY 0 65535 PHYS_UNIT "Enable bits" /end CHARACTERISTIC
/begin CHARACTERISTIC FPsw_ext1_MJ2_intF_Vlo "FPrm_switches_ext1(558)" VALUE 0x0014729A /* @ECU_Address@FPrm_switches_ext1@0x023A545C@ */ ECIPP_ALIGNMENT_UWORD 65535 Compu_IDENTITY 0 65535 PHYS_UNIT "Enable bits" /end CHARACTERISTIC
/begin CHARACTERISTIC FPsw_ext1_MJ2_Pe_HiExp "FPrm_switches_ext1(554)" VALUE 0x00147292 /* @ECU_Address@FPrm_switches_ext1@0x023A5454@ */ ECIPP_ALIGNMENT_UWORD 65535 Compu_IDENTITY 0 65535 PHYS_UNIT "Enable bits" /end CHARACTERISTIC
/begin CHARACTERISTIC FPsw_ext1_MJ2_Pe_LoExp "FPrm_switches_ext1(555)" VALUE 0x00147294 /* @ECU_Address@FPrm_switches_ext1@0x023A5456@ */ ECIPP_ALIGNMENT_UWORD 65535 Compu_IDENTITY 0 65535 PHYS_UNIT "Enable bits" /end CHARACTERISTIC
/begin CHARACTERISTIC FPsw_ext1_NOx_hi "FPrm_switches_ext1(623)" VALUE 0x0014731C /* @ECU_Address@FPrm_switches_ext1@0x023A54DE@ */ ECIPP_ALIGNMENT_UWORD 65535 Compu_IDENTITY 0 65535 PHYS_UNIT "Enable bits" /end CHARACTERISTIC
/begin CHARACTERISTIC FPsw_ext1_OilP_hiP "FPrm_switches_ext1(109)" VALUE 0x00146F18 /* @ECU_Address@FPrm_switches_ext1@0x023A50DA@ */ ECIPP_ALIGNMENT_UWORD 65535 Compu_IDENTITY 0 65535 PHYS_UNIT "Enable bits" /end CHARACTERISTIC
/begin CHARACTERISTIC FPsw_ext1_OilP_loP "FPrm_switches_ext1(108)" VALUE 0x00146F16 /* @ECU_Address@FPrm_switches_ext1@0x023A50D8@ */ ECIPP_ALIGNMENT_UWORD 65535 Compu_IDENTITY 0 65535 PHYS_UNIT "Enable bits" /end CHARACTERISTIC
/begin CHARACTERISTIC FPsw_ext1_OilP_maxV "FPrm_switches_ext1(110)" VALUE 0x00146F1A /* @ECU_Address@FPrm_switches_ext1@0x023A50DC@ */ ECIPP_ALIGNMENT_UWORD 65535 Compu_IDENTITY 0 65535 PHYS_UNIT "Enable bits" /end CHARACTERISTIC
/begin CHARACTERISTIC FPsw_ext1_OilP_minV "FPrm_switches_ext1(111)" VALUE 0x00146F1C /* @ECU_Address@FPrm_switches_ext1@0x023A50DE@ */ ECIPP_ALIGNMENT_UWORD 65535 Compu_IDENTITY 0 65535 PHYS_UNIT "Enable bits" /end CHARACTERISTIC
/begin CHARACTERISTIC FPsw_ext1_OILP_test "FPrm_switches_ext1(40)" VALUE 0x00146E8E /* @ECU_Address@FPrm_switches_ext1@0x023A5050@ */ ECIPP_ALIGNMENT_UWORD 65535 Compu_IDENTITY 0 65535 PHYS_UNIT "Enable bits" /end CHARACTERISTIC
/begin CHARACTERISTIC FPsw_ext1_OilP2_loP "FPrm_switches_ext1(215)" VALUE 0x00146FEC /* @ECU_Address@FPrm_switches_ext1@0x023A51AE@ */ ECIPP_ALIGNMENT_UWORD 65535 Compu_IDENTITY 0 65535 PHYS_UNIT "Enable bits" /end CHARACTERISTIC
/begin CHARACTERISTIC FPsw_ext1_OILTL_loss "FPrm_switches_ext1(567)" VALUE 0x001472AC /* @ECU_Address@FPrm_switches_ext1@0x023A546E@ */ ECIPP_ALIGNMENT_UWORD 65535 Compu_IDENTITY 0 65535 PHYS_UNIT "Enable bits" /end CHARACTERISTIC
/begin CHARACTERISTIC FPsw_ext1_OILTL_Lvl_lo "FPrm_switches_ext1(571)" VALUE 0x001472B4 /* @ECU_Address@FPrm_switches_ext1@0x023A5476@ */ ECIPP_ALIGNMENT_UWORD 65535 Compu_IDENTITY 0 65535 PHYS_UNIT "Enable bits" /end CHARACTERISTIC
/begin CHARACTERISTIC FPsw_ext1_OILTL_Lvl_OOR "FPrm_switches_ext1(569)" VALUE 0x001472B0 /* @ECU_Address@FPrm_switches_ext1@0x023A5472@ */ ECIPP_ALIGNMENT_UWORD 65535 Compu_IDENTITY 0 65535 PHYS_UNIT "Enable bits" /end CHARACTERISTIC
/begin CHARACTERISTIC FPsw_ext1_OILTL_T_hi "FPrm_switches_ext1(572)" VALUE 0x001472B6 /* @ECU_Address@FPrm_switches_ext1@0x023A5478@ */ ECIPP_ALIGNMENT_UWORD 65535 Compu_IDENTITY 0 65535 PHYS_UNIT "Enable bits" /end CHARACTERISTIC
/begin CHARACTERISTIC FPsw_ext1_OILTL_T_OOR "FPrm_switches_ext1(570)" VALUE 0x001472B2 /* @ECU_Address@FPrm_switches_ext1@0x023A5474@ */ ECIPP_ALIGNMENT_UWORD 65535 Compu_IDENTITY 0 65535 PHYS_UNIT "Enable bits" /end CHARACTERISTIC
/begin CHARACTERISTIC FPsw_ext1_OILTL_V_OOR "FPrm_switches_ext1(568)" VALUE 0x001472AE /* @ECU_Address@FPrm_switches_ext1@0x023A5470@ */ ECIPP_ALIGNMENT_UWORD 65535 Compu_IDENTITY 0 65535 PHYS_UNIT "Enable bits" /end CHARACTERISTIC
/begin CHARACTERISTIC FPsw_ext1_PAUX_dP1_max "FPrm_switches_ext1(416)" VALUE 0x0014717E /* @ECU_Address@FPrm_switches_ext1@0x023A5340@ */ ECIPP_ALIGNMENT_UWORD 65535 Compu_IDENTITY 0 65535 PHYS_UNIT "Enable bits" /end CHARACTERISTIC
/begin CHARACTERISTIC FPsw_ext1_PAUX_dP1_min "FPrm_switches_ext1(417)" VALUE 0x00147180 /* @ECU_Address@FPrm_switches_ext1@0x023A5342@ */ ECIPP_ALIGNMENT_UWORD 65535 Compu_IDENTITY 0 65535 PHYS_UNIT "Enable bits" /end CHARACTERISTIC
/begin CHARACTERISTIC FPsw_ext1_PAUX_dP2_max "FPrm_switches_ext1(418)" VALUE 0x00147182 /* @ECU_Address@FPrm_switches_ext1@0x023A5344@ */ ECIPP_ALIGNMENT_UWORD 65535 Compu_IDENTITY 0 65535 PHYS_UNIT "Enable bits" /end CHARACTERISTIC
/begin CHARACTERISTIC FPsw_ext1_PAUX_dP2_min "FPrm_switches_ext1(419)" VALUE 0x00147184 /* @ECU_Address@FPrm_switches_ext1@0x023A5346@ */ ECIPP_ALIGNMENT_UWORD 65535 Compu_IDENTITY 0 65535 PHYS_UNIT "Enable bits" /end CHARACTERISTIC
/begin CHARACTERISTIC FPsw_ext1_PAUX1_max "FPrm_switches_ext1(408)" VALUE 0x0014716E /* @ECU_Address@FPrm_switches_ext1@0x023A5330@ */ ECIPP_ALIGNMENT_UWORD 65535 Compu_IDENTITY 0 65535 PHYS_UNIT "Enable bits" /end CHARACTERISTIC
/begin CHARACTERISTIC FPsw_ext1_PAUX1_min "FPrm_switches_ext1(409)" VALUE 0x00147170 /* @ECU_Address@FPrm_switches_ext1@0x023A5332@ */ ECIPP_ALIGNMENT_UWORD 65535 Compu_IDENTITY 0 65535 PHYS_UNIT "Enable bits" /end CHARACTERISTIC
/begin CHARACTERISTIC FPsw_ext1_PAUX2_max "FPrm_switches_ext1(410)" VALUE 0x00147172 /* @ECU_Address@FPrm_switches_ext1@0x023A5334@ */ ECIPP_ALIGNMENT_UWORD 65535 Compu_IDENTITY 0 65535 PHYS_UNIT "Enable bits" /end CHARACTERISTIC
/begin CHARACTERISTIC FPsw_ext1_PAUX2_min "FPrm_switches_ext1(411)" VALUE 0x00147174 /* @ECU_Address@FPrm_switches_ext1@0x023A5336@ */ ECIPP_ALIGNMENT_UWORD 65535 Compu_IDENTITY 0 65535 PHYS_UNIT "Enable bits" /end CHARACTERISTIC
/begin CHARACTERISTIC FPsw_ext1_PAUX3_max "FPrm_switches_ext1(412)" VALUE 0x00147176 /* @ECU_Address@FPrm_switches_ext1@0x023A5338@ */ ECIPP_ALIGNMENT_UWORD 65535 Compu_IDENTITY 0 65535 PHYS_UNIT "Enable bits" /end CHARACTERISTIC
/begin CHARACTERISTIC FPsw_ext1_PAUX3_min "FPrm_switches_ext1(413)" VALUE 0x00147178 /* @ECU_Address@FPrm_switches_ext1@0x023A533A@ */ ECIPP_ALIGNMENT_UWORD 65535 Compu_IDENTITY 0 65535 PHYS_UNIT "Enable bits" /end CHARACTERISTIC
/begin CHARACTERISTIC FPsw_ext1_PAUX4_max "FPrm_switches_ext1(414)" VALUE 0x0014717A /* @ECU_Address@FPrm_switches_ext1@0x023A533C@ */ ECIPP_ALIGNMENT_UWORD 65535 Compu_IDENTITY 0 65535 PHYS_UNIT "Enable bits" /end CHARACTERISTIC
/begin CHARACTERISTIC FPsw_ext1_PAUX4_min "FPrm_switches_ext1(415)" VALUE 0x0014717C /* @ECU_Address@FPrm_switches_ext1@0x023A533E@ */ ECIPP_ALIGNMENT_UWORD 65535 Compu_IDENTITY 0 65535 PHYS_UNIT "Enable bits" /end CHARACTERISTIC
/begin CHARACTERISTIC FPsw_ext1_PPEG_BP "FPrm_switches_ext1(500)" VALUE 0x00147226 /* @ECU_Address@FPrm_switches_ext1@0x023A53E8@ */ ECIPP_ALIGNMENT_UWORD 65535 Compu_IDENTITY 0 65535 PHYS_UNIT "Enable bits" /end CHARACTERISTIC
/begin CHARACTERISTIC FPsw_ext1_PPEG_CVP1 "FPrm_switches_ext1(575)" VALUE 0x001472BC /* @ECU_Address@FPrm_switches_ext1@0x023A547E@ */ ECIPP_ALIGNMENT_UWORD 65535 Compu_IDENTITY 0 65535 PHYS_UNIT "Enable bits" /end CHARACTERISTIC
/begin CHARACTERISTIC FPsw_ext1_PPEG_CVP2 "FPrm_switches_ext1(576)" VALUE 0x001472BE /* @ECU_Address@FPrm_switches_ext1@0x023A5480@ */ ECIPP_ALIGNMENT_UWORD 65535 Compu_IDENTITY 0 65535 PHYS_UNIT "Enable bits" /end CHARACTERISTIC
/begin CHARACTERISTIC FPsw_ext1_PPEG_EBP "FPrm_switches_ext1(501)" VALUE 0x00147228 /* @ECU_Address@FPrm_switches_ext1@0x023A53EA@ */ ECIPP_ALIGNMENT_UWORD 65535 Compu_IDENTITY 0 65535 PHYS_UNIT "Enable bits" /end CHARACTERISTIC
/begin CHARACTERISTIC FPsw_ext1_PPEG_EGRdP "FPrm_switches_ext1(586)" VALUE 0x001472D2 /* @ECU_Address@FPrm_switches_ext1@0x023A5494@ */ ECIPP_ALIGNMENT_UWORD 65535 Compu_IDENTITY 0 65535 PHYS_UNIT "Enable bits" /end CHARACTERISTIC
/begin CHARACTERISTIC FPsw_ext1_PPEG_EGRHP "FPrm_switches_ext1(503)" VALUE 0x0014722C /* @ECU_Address@FPrm_switches_ext1@0x023A53EE@ */ ECIPP_ALIGNMENT_UWORD 65535 Compu_IDENTITY 0 65535 PHYS_UNIT "Enable bits" /end CHARACTERISTIC
/begin CHARACTERISTIC FPsw_ext1_PPEG_EGRLP "FPrm_switches_ext1(502)" VALUE 0x0014722A /* @ECU_Address@FPrm_switches_ext1@0x023A53EC@ */ ECIPP_ALIGNMENT_UWORD 65535 Compu_IDENTITY 0 65535 PHYS_UNIT "Enable bits" /end CHARACTERISTIC
/begin CHARACTERISTIC FPsw_ext1_PPEG_EGRwrP "FPrm_switches_ext1(505)" VALUE 0x00147230 /* @ECU_Address@FPrm_switches_ext1@0x023A53F2@ */ ECIPP_ALIGNMENT_UWORD 65535 Compu_IDENTITY 0 65535 PHYS_UNIT "Enable bits" /end CHARACTERISTIC
/begin CHARACTERISTIC FPsw_ext1_PPEG_MAP "FPrm_switches_ext1(506)" VALUE 0x00147232 /* @ECU_Address@FPrm_switches_ext1@0x023A53F4@ */ ECIPP_ALIGNMENT_UWORD 65535 Compu_IDENTITY 0 65535 PHYS_UNIT "Enable bits" /end CHARACTERISTIC
/begin CHARACTERISTIC FPsw_ext1_PPEG_TIP "FPrm_switches_ext1(504)" VALUE 0x0014722E /* @ECU_Address@FPrm_switches_ext1@0x023A53F0@ */ ECIPP_ALIGNMENT_UWORD 65535 Compu_IDENTITY 0 65535 PHYS_UNIT "Enable bits" /end CHARACTERISTIC
/begin CHARACTERISTIC FPsw_ext1_PWM1_off_loVf "FPrm_switches_ext1(147)" VALUE 0x00146F64 /* @ECU_Address@FPrm_switches_ext1@0x023A5126@ */ ECIPP_ALIGNMENT_UWORD 65535 Compu_IDENTITY 0 65535 PHYS_UNIT "Enable bits" /end CHARACTERISTIC
/begin CHARACTERISTIC FPsw_ext1_PWM1_on_hiVf "FPrm_switches_ext1(148)" VALUE 0x00146F66 /* @ECU_Address@FPrm_switches_ext1@0x023A5128@ */ ECIPP_ALIGNMENT_UWORD 65535 Compu_IDENTITY 0 65535 PHYS_UNIT "Enable bits" /end CHARACTERISTIC
/begin CHARACTERISTIC FPsw_ext1_PWM10_off_loVf "FPrm_switches_ext1(330)" VALUE 0x001470D2 /* @ECU_Address@FPrm_switches_ext1@0x023A5294@ */ ECIPP_ALIGNMENT_UWORD 65535 Compu_IDENTITY 0 65535 PHYS_UNIT "Enable bits" /end CHARACTERISTIC
/begin CHARACTERISTIC FPsw_ext1_PWM10_on_hiVf "FPrm_switches_ext1(331)" VALUE 0x001470D4 /* @ECU_Address@FPrm_switches_ext1@0x023A5296@ */ ECIPP_ALIGNMENT_UWORD 65535 Compu_IDENTITY 0 65535 PHYS_UNIT "Enable bits" /end CHARACTERISTIC
/begin CHARACTERISTIC FPsw_ext1_PWM11_off_loVf "FPrm_switches_ext1(332)" VALUE 0x001470D6 /* @ECU_Address@FPrm_switches_ext1@0x023A5298@ */ ECIPP_ALIGNMENT_UWORD 65535 Compu_IDENTITY 0 65535 PHYS_UNIT "Enable bits" /end CHARACTERISTIC
/begin CHARACTERISTIC FPsw_ext1_PWM11_on_hiVf "FPrm_switches_ext1(333)" VALUE 0x001470D8 /* @ECU_Address@FPrm_switches_ext1@0x023A529A@ */ ECIPP_ALIGNMENT_UWORD 65535 Compu_IDENTITY 0 65535 PHYS_UNIT "Enable bits" /end CHARACTERISTIC
/begin CHARACTERISTIC FPsw_ext1_PWM12_off_loVf "FPrm_switches_ext1(334)" VALUE 0x001470DA /* @ECU_Address@FPrm_switches_ext1@0x023A529C@ */ ECIPP_ALIGNMENT_UWORD 65535 Compu_IDENTITY 0 65535 PHYS_UNIT "Enable bits" /end CHARACTERISTIC
/begin CHARACTERISTIC FPsw_ext1_PWM12_on_hiVf "FPrm_switches_ext1(335)" VALUE 0x001470DC /* @ECU_Address@FPrm_switches_ext1@0x023A529E@ */ ECIPP_ALIGNMENT_UWORD 65535 Compu_IDENTITY 0 65535 PHYS_UNIT "Enable bits" /end CHARACTERISTIC
/begin CHARACTERISTIC FPsw_ext1_PWM13_off_loVf "FPrm_switches_ext1(336)" VALUE 0x001470DE /* @ECU_Address@FPrm_switches_ext1@0x023A52A0@ */ ECIPP_ALIGNMENT_UWORD 65535 Compu_IDENTITY 0 65535 PHYS_UNIT "Enable bits" /end CHARACTERISTIC
/begin CHARACTERISTIC FPsw_ext1_PWM13_on_hiVf "FPrm_switches_ext1(337)" VALUE 0x001470E0 /* @ECU_Address@FPrm_switches_ext1@0x023A52A2@ */ ECIPP_ALIGNMENT_UWORD 65535 Compu_IDENTITY 0 65535 PHYS_UNIT "Enable bits" /end CHARACTERISTIC
/begin CHARACTERISTIC FPsw_ext1_PWM14_off_loVf "FPrm_switches_ext1(338)" VALUE 0x001470E2 /* @ECU_Address@FPrm_switches_ext1@0x023A52A4@ */ ECIPP_ALIGNMENT_UWORD 65535 Compu_IDENTITY 0 65535 PHYS_UNIT "Enable bits" /end CHARACTERISTIC
/begin CHARACTERISTIC FPsw_ext1_PWM14_on_hiVf "FPrm_switches_ext1(339)" VALUE 0x001470E4 /* @ECU_Address@FPrm_switches_ext1@0x023A52A6@ */ ECIPP_ALIGNMENT_UWORD 65535 Compu_IDENTITY 0 65535 PHYS_UNIT "Enable bits" /end CHARACTERISTIC
/begin CHARACTERISTIC FPsw_ext1_PWM15_off_loVf "FPrm_switches_ext1(340)" VALUE 0x001470E6 /* @ECU_Address@FPrm_switches_ext1@0x023A52A8@ */ ECIPP_ALIGNMENT_UWORD 65535 Compu_IDENTITY 0 65535 PHYS_UNIT "Enable bits" /end CHARACTERISTIC
/begin CHARACTERISTIC FPsw_ext1_PWM15_on_hiVf "FPrm_switches_ext1(341)" VALUE 0x001470E8 /* @ECU_Address@FPrm_switches_ext1@0x023A52AA@ */ ECIPP_ALIGNMENT_UWORD 65535 Compu_IDENTITY 0 65535 PHYS_UNIT "Enable bits" /end CHARACTERISTIC
/begin CHARACTERISTIC FPsw_ext1_PWM16_off_loVf "FPrm_switches_ext1(342)" VALUE 0x001470EA /* @ECU_Address@FPrm_switches_ext1@0x023A52AC@ */ ECIPP_ALIGNMENT_UWORD 65535 Compu_IDENTITY 0 65535 PHYS_UNIT "Enable bits" /end CHARACTERISTIC
/begin CHARACTERISTIC FPsw_ext1_PWM16_on_hiVf "FPrm_switches_ext1(343)" VALUE 0x001470EC /* @ECU_Address@FPrm_switches_ext1@0x023A52AE@ */ ECIPP_ALIGNMENT_UWORD 65535 Compu_IDENTITY 0 65535 PHYS_UNIT "Enable bits" /end CHARACTERISTIC
/begin CHARACTERISTIC FPsw_ext1_PWM17_off_loVf "FPrm_switches_ext1(344)" VALUE 0x001470EE /* @ECU_Address@FPrm_switches_ext1@0x023A52B0@ */ ECIPP_ALIGNMENT_UWORD 65535 Compu_IDENTITY 0 65535 PHYS_UNIT "Enable bits" /end CHARACTERISTIC
/begin CHARACTERISTIC FPsw_ext1_PWM17_on_hiVf "FPrm_switches_ext1(345)" VALUE 0x001470F0 /* @ECU_Address@FPrm_switches_ext1@0x023A52B2@ */ ECIPP_ALIGNMENT_UWORD 65535 Compu_IDENTITY 0 65535 PHYS_UNIT "Enable bits" /end CHARACTERISTIC
/begin CHARACTERISTIC FPsw_ext1_PWM18_off_loVf "FPrm_switches_ext1(346)" VALUE 0x001470F2 /* @ECU_Address@FPrm_switches_ext1@0x023A52B4@ */ ECIPP_ALIGNMENT_UWORD 65535 Compu_IDENTITY 0 65535 PHYS_UNIT "Enable bits" /end CHARACTERISTIC
/begin CHARACTERISTIC FPsw_ext1_PWM18_on_hiVf "FPrm_switches_ext1(347)" VALUE 0x001470F4 /* @ECU_Address@FPrm_switches_ext1@0x023A52B6@ */ ECIPP_ALIGNMENT_UWORD 65535 Compu_IDENTITY 0 65535 PHYS_UNIT "Enable bits" /end CHARACTERISTIC
/begin CHARACTERISTIC FPsw_ext1_PWM19_off_loVf "FPrm_switches_ext1(348)" VALUE 0x001470F6 /* @ECU_Address@FPrm_switches_ext1@0x023A52B8@ */ ECIPP_ALIGNMENT_UWORD 65535 Compu_IDENTITY 0 65535 PHYS_UNIT "Enable bits" /end CHARACTERISTIC
/begin CHARACTERISTIC FPsw_ext1_PWM19_on_hiVf "FPrm_switches_ext1(349)" VALUE 0x001470F8 /* @ECU_Address@FPrm_switches_ext1@0x023A52BA@ */ ECIPP_ALIGNMENT_UWORD 65535 Compu_IDENTITY 0 65535 PHYS_UNIT "Enable bits" /end CHARACTERISTIC
/begin CHARACTERISTIC FPsw_ext1_PWM2_off_loVf "FPrm_switches_ext1(149)" VALUE 0x00146F68 /* @ECU_Address@FPrm_switches_ext1@0x023A512A@ */ ECIPP_ALIGNMENT_UWORD 65535 Compu_IDENTITY 0 65535 PHYS_UNIT "Enable bits" /end CHARACTERISTIC
/begin CHARACTERISTIC FPsw_ext1_PWM2_on_hiVf "FPrm_switches_ext1(150)" VALUE 0x00146F6A /* @ECU_Address@FPrm_switches_ext1@0x023A512C@ */ ECIPP_ALIGNMENT_UWORD 65535 Compu_IDENTITY 0 65535 PHYS_UNIT "Enable bits" /end CHARACTERISTIC
/begin CHARACTERISTIC FPsw_ext1_PWM20_off_loVf "FPrm_switches_ext1(350)" VALUE 0x001470FA /* @ECU_Address@FPrm_switches_ext1@0x023A52BC@ */ ECIPP_ALIGNMENT_UWORD 65535 Compu_IDENTITY 0 65535 PHYS_UNIT "Enable bits" /end CHARACTERISTIC
/begin CHARACTERISTIC FPsw_ext1_PWM20_on_hiVf "FPrm_switches_ext1(351)" VALUE 0x001470FC /* @ECU_Address@FPrm_switches_ext1@0x023A52BE@ */ ECIPP_ALIGNMENT_UWORD 65535 Compu_IDENTITY 0 65535 PHYS_UNIT "Enable bits" /end CHARACTERISTIC
/begin CHARACTERISTIC FPsw_ext1_PWM21_off_loVf "FPrm_switches_ext1(352)" VALUE 0x001470FE /* @ECU_Address@FPrm_switches_ext1@0x023A52C0@ */ ECIPP_ALIGNMENT_UWORD 65535 Compu_IDENTITY 0 65535 PHYS_UNIT "Enable bits" /end CHARACTERISTIC
/begin CHARACTERISTIC FPsw_MJ_Pe_HiExp "FPrm_switches(92)" VALUE 0x00146994 /* @ECU_Address@FPrm_switches@0x021B90B8@ */ ECIPP_ALIGNMENT_UWORD 65535 Compu_IDENTITY 0 65535 PHYS_UNIT "Enable bits" /end CHARACTERISTIC
/begin CHARACTERISTIC FPsw_MJ_Pe_LoExp "FPrm_switches(93)" VALUE 0x00146996 /* @ECU_Address@FPrm_switches@0x021B90BA@ */ ECIPP_ALIGNMENT_UWORD 65535 Compu_IDENTITY 0 65535 PHYS_UNIT "Enable bits" /end CHARACTERISTIC
/begin CHARACTERISTIC FPsw_MJ2_comm_tout "FPrm_switches(556)" VALUE 0x00146D34 /* @ECU_Address@FPrm_switches@0x021B9458@ */ ECIPP_ALIGNMENT_UWORD 65535 Compu_IDENTITY 0 65535 PHYS_UNIT "Enable bits" /end CHARACTERISTIC
/begin CHARACTERISTIC FPsw_MJ2_intF_act "FPrm_switches(559)" VALUE 0x00146D3A /* @ECU_Address@FPrm_switches@0x021B945E@ */ ECIPP_ALIGNMENT_UWORD 65535 Compu_IDENTITY 0 65535 PHYS_UNIT "Enable bits" /end CHARACTERISTIC
/begin CHARACTERISTIC FPsw_MJ2_intF_circ "FPrm_switches(560)" VALUE 0x00146D3C /* @ECU_Address@FPrm_switches@0x021B9460@ */ ECIPP_ALIGNMENT_UWORD 65535 Compu_IDENTITY 0 65535 PHYS_UNIT "Enable bits" /end CHARACTERISTIC
/begin CHARACTERISTIC FPsw_MJ2_intF_comm "FPrm_switches(561)" VALUE 0x00146D3E /* @ECU_Address@FPrm_switches@0x021B9462@ */ ECIPP_ALIGNMENT_UWORD 65535 Compu_IDENTITY 0 65535 PHYS_UNIT "Enable bits" /end CHARACTERISTIC
/begin CHARACTERISTIC FPsw_MJ2_intF_Vhi "FPrm_switches(557)" VALUE 0x00146D36 /* @ECU_Address@FPrm_switches@0x021B945A@ */ ECIPP_ALIGNMENT_UWORD 65535 Compu_IDENTITY 0 65535 PHYS_UNIT "Enable bits" /end CHARACTERISTIC
/begin CHARACTERISTIC FPsw_MJ2_intF_Vlo "FPrm_switches(558)" VALUE 0x00146D38 /* @ECU_Address@FPrm_switches@0x021B945C@ */ ECIPP_ALIGNMENT_UWORD 65535 Compu_IDENTITY 0 65535 PHYS_UNIT "Enable bits" /end CHARACTERISTIC
/begin CHARACTERISTIC FPsw_MJ2_Pe_HiExp "FPrm_switches(554)" VALUE 0x00146D30 /* @ECU_Address@FPrm_switches@0x021B9454@ */ ECIPP_ALIGNMENT_UWORD 65535 Compu_IDENTITY 0 65535 PHYS_UNIT "Enable bits" /end CHARACTERISTIC
/begin CHARACTERISTIC FPsw_MJ2_Pe_LoExp "FPrm_switches(555)" VALUE 0x00146D32 /* @ECU_Address@FPrm_switches@0x021B9456@ */ ECIPP_ALIGNMENT_UWORD 65535 Compu_IDENTITY 0 65535 PHYS_UNIT "Enable bits" /end CHARACTERISTIC
/begin CHARACTERISTIC FPsw_NOx_hi "FPrm_switches(623)" VALUE 0x00146DBA /* @ECU_Address@FPrm_switches@0x021B94DE@ */ ECIPP_ALIGNMENT_UWORD 65535 Compu_IDENTITY 0 65535 PHYS_UNIT "Enable bits" /end CHARACTERISTIC
/begin CHARACTERISTIC FPsw_OilP_hiP "FPrm_switches(109)" VALUE 0x001469B6 /* @ECU_Address@FPrm_switches@0x021B90DA@ */ ECIPP_ALIGNMENT_UWORD 65535 Compu_IDENTITY 0 65535 PHYS_UNIT "Enable bits" /end CHARACTERISTIC
/begin CHARACTERISTIC FPsw_OilP_loP "FPrm_switches(108)" VALUE 0x001469B4 /* @ECU_Address@FPrm_switches@0x021B90D8@ */ ECIPP_ALIGNMENT_UWORD 65535 Compu_IDENTITY 0 65535 PHYS_UNIT "Enable bits" /end CHARACTERISTIC
/begin CHARACTERISTIC FPsw_OilP_maxV "FPrm_switches(110)" VALUE 0x001469B8 /* @ECU_Address@FPrm_switches@0x021B90DC@ */ ECIPP_ALIGNMENT_UWORD 65535 Compu_IDENTITY 0 65535 PHYS_UNIT "Enable bits" /end CHARACTERISTIC
/begin CHARACTERISTIC FPsw_OilP_minV "FPrm_switches(111)" VALUE 0x001469BA /* @ECU_Address@FPrm_switches@0x021B90DE@ */ ECIPP_ALIGNMENT_UWORD 65535 Compu_IDENTITY 0 65535 PHYS_UNIT "Enable bits" /end CHARACTERISTIC
/begin CHARACTERISTIC FPsw_OILP_test "FPrm_switches(40)" VALUE 0x0014692C /* @ECU_Address@FPrm_switches@0x021B9050@ */ ECIPP_ALIGNMENT_UWORD 65535 Compu_IDENTITY 0 65535 PHYS_UNIT "Enable bits" /end CHARACTERISTIC
/begin CHARACTERISTIC FPsw_OilP2_loP "FPrm_switches(215)" VALUE 0x00146A8A /* @ECU_Address@FPrm_switches@0x021B91AE@ */ ECIPP_ALIGNMENT_UWORD 65535 Compu_IDENTITY 0 65535 PHYS_UNIT "Enable bits" /end CHARACTERISTIC
/begin CHARACTERISTIC FPsw_OILTL_loss "FPrm_switches(567)" VALUE 0x00146D4A /* @ECU_Address@FPrm_switches@0x021B946E@ */ ECIPP_ALIGNMENT_UWORD 65535 Compu_IDENTITY 0 65535 PHYS_UNIT "Enable bits" /end CHARACTERISTIC
/begin CHARACTERISTIC FPsw_OILTL_Lvl_lo "FPrm_switches(571)" VALUE 0x00146D52 /* @ECU_Address@FPrm_switches@0x021B9476@ */ ECIPP_ALIGNMENT_UWORD 65535 Compu_IDENTITY 0 65535 PHYS_UNIT "Enable bits" /end CHARACTERISTIC
/begin CHARACTERISTIC FPsw_OILTL_Lvl_OOR "FPrm_switches(569)" VALUE 0x00146D4E /* @ECU_Address@FPrm_switches@0x021B9472@ */ ECIPP_ALIGNMENT_UWORD 65535 Compu_IDENTITY 0 65535 PHYS_UNIT "Enable bits" /end CHARACTERISTIC
/begin CHARACTERISTIC FPsw_OILTL_T_hi "FPrm_switches(572)" VALUE 0x00146D54 /* @ECU_Address@FPrm_switches@0x021B9478@ */ ECIPP_ALIGNMENT_UWORD 65535 Compu_IDENTITY 0 65535 PHYS_UNIT "Enable bits" /end CHARACTERISTIC
/begin CHARACTERISTIC FPsw_OILTL_T_OOR "FPrm_switches(570)" VALUE 0x00146D50 /* @ECU_Address@FPrm_switches@0x021B9474@ */ ECIPP_ALIGNMENT_UWORD 65535 Compu_IDENTITY 0 65535 PHYS_UNIT "Enable bits" /end CHARACTERISTIC
/begin CHARACTERISTIC FPsw_OILTL_V_OOR "FPrm_switches(568)" VALUE 0x00146D4C /* @ECU_Address@FPrm_switches@0x021B9470@ */ ECIPP_ALIGNMENT_UWORD 65535 Compu_IDENTITY 0 65535 PHYS_UNIT "Enable bits" /end CHARACTERISTIC
/begin CHARACTERISTIC FPsw_PAUX_dP1_max "FPrm_switches(416)" VALUE 0x00146C1C /* @ECU_Address@FPrm_switches@0x021B9340@ */ ECIPP_ALIGNMENT_UWORD 65535 Compu_IDENTITY 0 65535 PHYS_UNIT "Enable bits" /end CHARACTERISTIC
/begin CHARACTERISTIC FPsw_PAUX_dP1_min "FPrm_switches(417)" VALUE 0x00146C1E /* @ECU_Address@FPrm_switches@0x021B9342@ */ ECIPP_ALIGNMENT_UWORD 65535 Compu_IDENTITY 0 65535 PHYS_UNIT "Enable bits" /end CHARACTERISTIC
/begin CHARACTERISTIC FPsw_PAUX_dP2_max "FPrm_switches(418)" VALUE 0x00146C20 /* @ECU_Address@FPrm_switches@0x021B9344@ */ ECIPP_ALIGNMENT_UWORD 65535 Compu_IDENTITY 0 65535 PHYS_UNIT "Enable bits" /end CHARACTERISTIC
/begin CHARACTERISTIC FPsw_PAUX_dP2_min "FPrm_switches(419)" VALUE 0x00146C22 /* @ECU_Address@FPrm_switches@0x021B9346@ */ ECIPP_ALIGNMENT_UWORD 65535 Compu_IDENTITY 0 65535 PHYS_UNIT "Enable bits" /end CHARACTERISTIC
/begin CHARACTERISTIC FPsw_PAUX1_max "FPrm_switches(408)" VALUE 0x00146C0C /* @ECU_Address@FPrm_switches@0x021B9330@ */ ECIPP_ALIGNMENT_UWORD 65535 Compu_IDENTITY 0 65535 PHYS_UNIT "Enable bits" /end CHARACTERISTIC
/begin CHARACTERISTIC FPsw_PAUX1_min "FPrm_switches(409)" VALUE 0x00146C0E /* @ECU_Address@FPrm_switches@0x021B9332@ */ ECIPP_ALIGNMENT_UWORD 65535 Compu_IDENTITY 0 65535 PHYS_UNIT "Enable bits" /end CHARACTERISTIC
/begin CHARACTERISTIC FPsw_PAUX2_max "FPrm_switches(410)" VALUE 0x00146C10 /* @ECU_Address@FPrm_switches@0x021B9334@ */ ECIPP_ALIGNMENT_UWORD 65535 Compu_IDENTITY 0 65535 PHYS_UNIT "Enable bits" /end CHARACTERISTIC
/begin CHARACTERISTIC FPsw_PAUX2_min "FPrm_switches(411)" VALUE 0x00146C12 /* @ECU_Address@FPrm_switches@0x021B9336@ */ ECIPP_ALIGNMENT_UWORD 65535 Compu_IDENTITY 0 65535 PHYS_UNIT "Enable bits" /end CHARACTERISTIC
/begin CHARACTERISTIC FPsw_PAUX3_max "FPrm_switches(412)" VALUE 0x00146C14 /* @ECU_Address@FPrm_switches@0x021B9338@ */ ECIPP_ALIGNMENT_UWORD 65535 Compu_IDENTITY 0 65535 PHYS_UNIT "Enable bits" /end CHARACTERISTIC
/begin CHARACTERISTIC FPsw_PAUX3_min "FPrm_switches(413)" VALUE 0x00146C16 /* @ECU_Address@FPrm_switches@0x021B933A@ */ ECIPP_ALIGNMENT_UWORD 65535 Compu_IDENTITY 0 65535 PHYS_UNIT "Enable bits" /end CHARACTERISTIC
/begin CHARACTERISTIC FPsw_PAUX4_max "FPrm_switches(414)" VALUE 0x00146C18 /* @ECU_Address@FPrm_switches@0x021B933C@ */ ECIPP_ALIGNMENT_UWORD 65535 Compu_IDENTITY 0 65535 PHYS_UNIT "Enable bits" /end CHARACTERISTIC
/begin CHARACTERISTIC FPsw_PAUX4_min "FPrm_switches(415)" VALUE 0x00146C1A /* @ECU_Address@FPrm_switches@0x021B933E@ */ ECIPP_ALIGNMENT_UWORD 65535 Compu_IDENTITY 0 65535 PHYS_UNIT "Enable bits" /end CHARACTERISTIC
/begin CHARACTERISTIC FPsw_PPEG_BP "FPrm_switches(500)" VALUE 0x00146CC4 /* @ECU_Address@FPrm_switches@0x021B93E8@ */ ECIPP_ALIGNMENT_UWORD 65535 Compu_IDENTITY 0 65535 PHYS_UNIT "Enable bits" /end CHARACTERISTIC
/begin CHARACTERISTIC FPsw_PPEG_CVP1 "FPrm_switches(575)" VALUE 0x00146D5A /* @ECU_Address@FPrm_switches@0x021B947E@ */ ECIPP_ALIGNMENT_UWORD 65535 Compu_IDENTITY 0 65535 PHYS_UNIT "Enable bits" /end CHARACTERISTIC
/begin CHARACTERISTIC FPsw_PPEG_CVP2 "FPrm_switches(576)" VALUE 0x00146D5C /* @ECU_Address@FPrm_switches@0x021B9480@ */ ECIPP_ALIGNMENT_UWORD 65535 Compu_IDENTITY 0 65535 PHYS_UNIT "Enable bits" /end CHARACTERISTIC
/begin CHARACTERISTIC FPsw_PPEG_EBP "FPrm_switches(501)" VALUE 0x00146CC6 /* @ECU_Address@FPrm_switches@0x021B93EA@ */ ECIPP_ALIGNMENT_UWORD 65535 Compu_IDENTITY 0 65535 PHYS_UNIT "Enable bits" /end CHARACTERISTIC
/begin CHARACTERISTIC FPsw_PPEG_EGRdP "FPrm_switches(586)" VALUE 0x00146D70 /* @ECU_Address@FPrm_switches@0x021B9494@ */ ECIPP_ALIGNMENT_UWORD 65535 Compu_IDENTITY 0 65535 PHYS_UNIT "Enable bits" /end CHARACTERISTIC
/begin CHARACTERISTIC FPsw_PPEG_EGRHP "FPrm_switches(503)" VALUE 0x00146CCA /* @ECU_Address@FPrm_switches@0x021B93EE@ */ ECIPP_ALIGNMENT_UWORD 65535 Compu_IDENTITY 0 65535 PHYS_UNIT "Enable bits" /end CHARACTERISTIC
/begin CHARACTERISTIC FPsw_PPEG_EGRLP "FPrm_switches(502)" VALUE 0x00146CC8 /* @ECU_Address@FPrm_switches@0x021B93EC@ */ ECIPP_ALIGNMENT_UWORD 65535 Compu_IDENTITY 0 65535 PHYS_UNIT "Enable bits" /end CHARACTERISTIC
/begin CHARACTERISTIC FPsw_PPEG_EGRwrP "FPrm_switches(505)" VALUE 0x00146CCE /* @ECU_Address@FPrm_switches@0x021B93F2@ */ ECIPP_ALIGNMENT_UWORD 65535 Compu_IDENTITY 0 65535 PHYS_UNIT "Enable bits" /end CHARACTERISTIC
/begin CHARACTERISTIC FPsw_PPEG_MAP "FPrm_switches(506)" VALUE 0x00146CD0 /* @ECU_Address@FPrm_switches@0x021B93F4@ */ ECIPP_ALIGNMENT_UWORD 65535 Compu_IDENTITY 0 65535 PHYS_UNIT "Enable bits" /end CHARACTERISTIC
/begin CHARACTERISTIC FPsw_PPEG_TIP "FPrm_switches(504)" VALUE 0x00146CCC /* @ECU_Address@FPrm_switches@0x021B93F0@ */ ECIPP_ALIGNMENT_UWORD 65535 Compu_IDENTITY 0 65535 PHYS_UNIT "Enable bits" /end CHARACTERISTIC
/begin CHARACTERISTIC FPsw_PWM1_off_loVf "FPrm_switches(147)" VALUE 0x00146A02 /* @ECU_Address@FPrm_switches@0x021B9126@ */ ECIPP_ALIGNMENT_UWORD 65535 Compu_IDENTITY 0 65535 PHYS_UNIT "Enable bits" /end CHARACTERISTIC
/begin CHARACTERISTIC FPsw_PWM1_on_hiVf "FPrm_switches(148)" VALUE 0x00146A04 /* @ECU_Address@FPrm_switches@0x021B9128@ */ ECIPP_ALIGNMENT_UWORD 65535 Compu_IDENTITY 0 65535 PHYS_UNIT "Enable bits" /end CHARACTERISTIC
/begin CHARACTERISTIC FPsw_PWM10_off_loVf "FPrm_switches(330)" VALUE 0x00146B70 /* @ECU_Address@FPrm_switches@0x021B9294@ */ ECIPP_ALIGNMENT_UWORD 65535 Compu_IDENTITY 0 65535 PHYS_UNIT "Enable bits" /end CHARACTERISTIC
/begin CHARACTERISTIC FPsw_PWM10_on_hiVf "FPrm_switches(331)" VALUE 0x00146B72 /* @ECU_Address@FPrm_switches@0x021B9296@ */ ECIPP_ALIGNMENT_UWORD 65535 Compu_IDENTITY 0 65535 PHYS_UNIT "Enable bits" /end CHARACTERISTIC
/begin CHARACTERISTIC FPsw_PWM11_off_loVf "FPrm_switches(332)" VALUE 0x00146B74 /* @ECU_Address@FPrm_switches@0x021B9298@ */ ECIPP_ALIGNMENT_UWORD 65535 Compu_IDENTITY 0 65535 PHYS_UNIT "Enable bits" /end CHARACTERISTIC
/begin CHARACTERISTIC FPsw_PWM11_on_hiVf "FPrm_switches(333)" VALUE 0x00146B76 /* @ECU_Address@FPrm_switches@0x021B929A@ */ ECIPP_ALIGNMENT_UWORD 65535 Compu_IDENTITY 0 65535 PHYS_UNIT "Enable bits" /end CHARACTERISTIC
/begin CHARACTERISTIC FPsw_PWM12_off_loVf "FPrm_switches(334)" VALUE 0x00146B78 /* @ECU_Address@FPrm_switches@0x021B929C@ */ ECIPP_ALIGNMENT_UWORD 65535 Compu_IDENTITY 0 65535 PHYS_UNIT "Enable bits" /end CHARACTERISTIC
/begin CHARACTERISTIC FPsw_PWM12_on_hiVf "FPrm_switches(335)" VALUE 0x00146B7A /* @ECU_Address@FPrm_switches@0x021B929E@ */ ECIPP_ALIGNMENT_UWORD 65535 Compu_IDENTITY 0 65535 PHYS_UNIT "Enable bits" /end CHARACTERISTIC
/begin CHARACTERISTIC FPsw_PWM13_off_loVf "FPrm_switches(336)" VALUE 0x00146B7C /* @ECU_Address@FPrm_switches@0x021B92A0@ */ ECIPP_ALIGNMENT_UWORD 65535 Compu_IDENTITY 0 65535 PHYS_UNIT "Enable bits" /end CHARACTERISTIC
/begin CHARACTERISTIC FPsw_PWM13_on_hiVf "FPrm_switches(337)" VALUE 0x00146B7E /* @ECU_Address@FPrm_switches@0x021B92A2@ */ ECIPP_ALIGNMENT_UWORD 65535 Compu_IDENTITY 0 65535 PHYS_UNIT "Enable bits" /end CHARACTERISTIC
/begin CHARACTERISTIC FPsw_PWM14_off_loVf "FPrm_switches(338)" VALUE 0x00146B80 /* @ECU_Address@FPrm_switches@0x021B92A4@ */ ECIPP_ALIGNMENT_UWORD 65535 Compu_IDENTITY 0 65535 PHYS_UNIT "Enable bits" /end CHARACTERISTIC
/begin CHARACTERISTIC FPsw_PWM14_on_hiVf "FPrm_switches(339)" VALUE 0x00146B82 /* @ECU_Address@FPrm_switches@0x021B92A6@ */ ECIPP_ALIGNMENT_UWORD 65535 Compu_IDENTITY 0 65535 PHYS_UNIT "Enable bits" /end CHARACTERISTIC
/begin CHARACTERISTIC FPsw_PWM15_off_loVf "FPrm_switches(340)" VALUE 0x00146B84 /* @ECU_Address@FPrm_switches@0x021B92A8@ */ ECIPP_ALIGNMENT_UWORD 65535 Compu_IDENTITY 0 65535 PHYS_UNIT "Enable bits" /end CHARACTERISTIC
/begin CHARACTERISTIC FPsw_PWM15_on_hiVf "FPrm_switches(341)" VALUE 0x00146B86 /* @ECU_Address@FPrm_switches@0x021B92AA@ */ ECIPP_ALIGNMENT_UWORD 65535 Compu_IDENTITY 0 65535 PHYS_UNIT "Enable bits" /end CHARACTERISTIC
/begin CHARACTERISTIC FPsw_PWM16_off_loVf "FPrm_switches(342)" VALUE 0x00146B88 /* @ECU_Address@FPrm_switches@0x021B92AC@ */ ECIPP_ALIGNMENT_UWORD 65535 Compu_IDENTITY 0 65535 PHYS_UNIT "Enable bits" /end CHARACTERISTIC
/begin CHARACTERISTIC FPsw_PWM16_on_hiVf "FPrm_switches(343)" VALUE 0x00146B8A /* @ECU_Address@FPrm_switches@0x021B92AE@ */ ECIPP_ALIGNMENT_UWORD 65535 Compu_IDENTITY 0 65535 PHYS_UNIT "Enable bits" /end CHARACTERISTIC
/begin CHARACTERISTIC FPsw_PWM17_off_loVf "FPrm_switches(344)" VALUE 0x00146B8C /* @ECU_Address@FPrm_switches@0x021B92B0@ */ ECIPP_ALIGNMENT_UWORD 65535 Compu_IDENTITY 0 65535 PHYS_UNIT "Enable bits" /end CHARACTERISTIC
/begin CHARACTERISTIC FPsw_PWM17_on_hiVf "FPrm_switches(345)" VALUE 0x00146B8E /* @ECU_Address@FPrm_switches@0x021B92B2@ */ ECIPP_ALIGNMENT_UWORD 65535 Compu_IDENTITY 0 65535 PHYS_UNIT "Enable bits" /end CHARACTERISTIC
/begin CHARACTERISTIC FPsw_PWM18_off_loVf "FPrm_switches(346)" VALUE 0x00146B90 /* @ECU_Address@FPrm_switches@0x021B92B4@ */ ECIPP_ALIGNMENT_UWORD 65535 Compu_IDENTITY 0 65535 PHYS_UNIT "Enable bits" /end CHARACTERISTIC
/begin CHARACTERISTIC FPsw_PWM18_on_hiVf "FPrm_switches(347)" VALUE 0x00146B92 /* @ECU_Address@FPrm_switches@0x021B92B6@ */ ECIPP_ALIGNMENT_UWORD 65535 Compu_IDENTITY 0 65535 PHYS_UNIT "Enable bits" /end CHARACTERISTIC
/begin CHARACTERISTIC FPsw_PWM19_off_loVf "FPrm_switches(348)" VALUE 0x00146B94 /* @ECU_Address@FPrm_switches@0x021B92B8@ */ ECIPP_ALIGNMENT_UWORD 65535 Compu_IDENTITY 0 65535 PHYS_UNIT "Enable bits" /end CHARACTERISTIC
/begin CHARACTERISTIC FPsw_PWM19_on_hiVf "FPrm_switches(349)" VALUE 0x00146B96 /* @ECU_Address@FPrm_switches@0x021B92BA@ */ ECIPP_ALIGNMENT_UWORD 65535 Compu_IDENTITY 0 65535 PHYS_UNIT "Enable bits" /end CHARACTERISTIC
/begin CHARACTERISTIC FPsw_PWM2_off_loVf "FPrm_switches(149)" VALUE 0x00146A06 /* @ECU_Address@FPrm_switches@0x021B912A@ */ ECIPP_ALIGNMENT_UWORD 65535 Compu_IDENTITY 0 65535 PHYS_UNIT "Enable bits" /end CHARACTERISTIC
/begin CHARACTERISTIC FPsw_PWM2_on_hiVf "FPrm_switches(150)" VALUE 0x00146A08 /* @ECU_Address@FPrm_switches@0x021B912C@ */ ECIPP_ALIGNMENT_UWORD 65535 Compu_IDENTITY 0 65535 PHYS_UNIT "Enable bits" /end CHARACTERISTIC
/begin CHARACTERISTIC FPsw_PWM20_off_loVf "FPrm_switches(350)" VALUE 0x00146B98 /* @ECU_Address@FPrm_switches@0x021B92BC@ */ ECIPP_ALIGNMENT_UWORD 65535 Compu_IDENTITY 0 65535 PHYS_UNIT "Enable bits" /end CHARACTERISTIC
/begin CHARACTERISTIC FPsw_PWM20_on_hiVf "FPrm_switches(351)" VALUE 0x00146B9A /* @ECU_Address@FPrm_switches@0x021B92BE@ */ ECIPP_ALIGNMENT_UWORD 65535 Compu_IDENTITY 0 65535 PHYS_UNIT "Enable bits" /end CHARACTERISTIC
/begin CHARACTERISTIC FPsw_PWM21_off_loVf "FPrm_switches(352)" VALUE 0x00146B9C /* @ECU_Address@FPrm_switches@0x021B92C0@ */ ECIPP_ALIGNMENT_UWORD 65535 Compu_IDENTITY 0 65535 PHYS_UNIT "Enable bits" /end CHARACTERISTIC
/begin CHARACTERISTIC FCdtc_MJ_Pe_HiExp "FCtl_DTC(133)" VALUE 0x0016361E /* @ECU_Address@FCtl_DTC@0x021B510A@ */ ECIPP_ALIGNMENT_UWORD 65535 Compu_IDENTITY 0 65535 PHYS_UNIT "DTC" /end CHARACTERISTIC
/begin CHARACTERISTIC FCdtc_MJ_Pe_LoExp "FCtl_DTC(134)" VALUE 0x00163620 /* @ECU_Address@FCtl_DTC@0x021B510C@ */ ECIPP_ALIGNMENT_UWORD 65535 Compu_IDENTITY 0 65535 PHYS_UNIT "DTC" /end CHARACTERISTIC
/begin CHARACTERISTIC FCdtc_MJ2_comm_tout "FCtl_DTC(726)" VALUE 0x00163AC0 /* @ECU_Address@FCtl_DTC@0x021B55AC@ */ ECIPP_ALIGNMENT_UWORD 65535 Compu_IDENTITY 0 65535 PHYS_UNIT "DTC" /end CHARACTERISTIC
/begin CHARACTERISTIC FCdtc_MJ2_intF_act "FCtl_DTC(729)" VALUE 0x00163AC6 /* @ECU_Address@FCtl_DTC@0x021B55B2@ */ ECIPP_ALIGNMENT_UWORD 65535 Compu_IDENTITY 0 65535 PHYS_UNIT "DTC" /end CHARACTERISTIC
/begin CHARACTERISTIC FCdtc_MJ2_intF_circ "FCtl_DTC(730)" VALUE 0x00163AC8 /* @ECU_Address@FCtl_DTC@0x021B55B4@ */ ECIPP_ALIGNMENT_UWORD 65535 Compu_IDENTITY 0 65535 PHYS_UNIT "DTC" /end CHARACTERISTIC
/begin CHARACTERISTIC FCdtc_MJ2_intF_comm "FCtl_DTC(731)" VALUE 0x00163ACA /* @ECU_Address@FCtl_DTC@0x021B55B6@ */ ECIPP_ALIGNMENT_UWORD 65535 Compu_IDENTITY 0 65535 PHYS_UNIT "DTC" /end CHARACTERISTIC
/begin CHARACTERISTIC FCdtc_MJ2_intF_Vhi "FCtl_DTC(727)" VALUE 0x00163AC2 /* @ECU_Address@FCtl_DTC@0x021B55AE@ */ ECIPP_ALIGNMENT_UWORD 65535 Compu_IDENTITY 0 65535 PHYS_UNIT "DTC" /end CHARACTERISTIC
/begin CHARACTERISTIC FCdtc_MJ2_intF_Vlo "FCtl_DTC(728)" VALUE 0x00163AC4 /* @ECU_Address@FCtl_DTC@0x021B55B0@ */ ECIPP_ALIGNMENT_UWORD 65535 Compu_IDENTITY 0 65535 PHYS_UNIT "DTC" /end CHARACTERISTIC
/begin CHARACTERISTIC FCdtc_MJ2_Pe_HiExp "FCtl_DTC(724)" VALUE 0x00163ABC /* @ECU_Address@FCtl_DTC@0x021B55A8@ */ ECIPP_ALIGNMENT_UWORD 65535 Compu_IDENTITY 0 65535 PHYS_UNIT "DTC" /end CHARACTERISTIC
/begin CHARACTERISTIC FCdtc_MJ2_Pe_LoExp "FCtl_DTC(725)" VALUE 0x00163ABE /* @ECU_Address@FCtl_DTC@0x021B55AA@ */ ECIPP_ALIGNMENT_UWORD 65535 Compu_IDENTITY 0 65535 PHYS_UNIT "DTC" /end CHARACTERISTIC
/begin CHARACTERISTIC FCdtc_NOx_hi "FCtl_DTC(793)" VALUE 0x00163B46 /* @ECU_Address@FCtl_DTC@0x021B5632@ */ ECIPP_ALIGNMENT_UWORD 65535 Compu_IDENTITY 0 65535 PHYS_UNIT "DTC" /end CHARACTERISTIC
/begin CHARACTERISTIC FCdtc_OilP_hiP "FCtl_DTC(149)" VALUE 0x0016363E /* @ECU_Address@FCtl_DTC@0x021B512A@ */ ECIPP_ALIGNMENT_UWORD 65535 Compu_IDENTITY 0 65535 PHYS_UNIT "DTC" /end CHARACTERISTIC
/begin CHARACTERISTIC FCdtc_OilP_loP "FCtl_DTC(148)" VALUE 0x0016363C /* @ECU_Address@FCtl_DTC@0x021B5128@ */ ECIPP_ALIGNMENT_UWORD 65535 Compu_IDENTITY 0 65535 PHYS_UNIT "DTC" /end CHARACTERISTIC
/begin CHARACTERISTIC FCdtc_OilP_maxV "FCtl_DTC(150)" VALUE 0x00163640 /* @ECU_Address@FCtl_DTC@0x021B512C@ */ ECIPP_ALIGNMENT_UWORD 65535 Compu_IDENTITY 0 65535 PHYS_UNIT "DTC" /end CHARACTERISTIC
/begin CHARACTERISTIC FCdtc_OilP_minV "FCtl_DTC(151)" VALUE 0x00163642 /* @ECU_Address@FCtl_DTC@0x021B512E@ */ ECIPP_ALIGNMENT_UWORD 65535 Compu_IDENTITY 0 65535 PHYS_UNIT "DTC" /end CHARACTERISTIC
/begin CHARACTERISTIC FCdtc_OILP_test "FCtl_DTC(29)" VALUE 0x0016354E /* @ECU_Address@FCtl_DTC@0x021B503A@ */ ECIPP_ALIGNMENT_UWORD 65535 Compu_IDENTITY 0 65535 PHYS_UNIT "DTC" /end CHARACTERISTIC
/begin CHARACTERISTIC FCdtc_OilP2_loP "FCtl_DTC(293)" VALUE 0x0016375E /* @ECU_Address@FCtl_DTC@0x021B524A@ */ ECIPP_ALIGNMENT_UWORD 65535 Compu_IDENTITY 0 65535 PHYS_UNIT "DTC" /end CHARACTERISTIC
/begin CHARACTERISTIC FCdtc_OILTL_loss "FCtl_DTC(737)" VALUE 0x00163AD6 /* @ECU_Address@FCtl_DTC@0x021B55C2@ */ ECIPP_ALIGNMENT_UWORD 65535 Compu_IDENTITY 0 65535 PHYS_UNIT "DTC" /end CHARACTERISTIC
/begin CHARACTERISTIC FCdtc_OILTL_Lvl_lo "FCtl_DTC(741)" VALUE 0x00163ADE /* @ECU_Address@FCtl_DTC@0x021B55CA@ */ ECIPP_ALIGNMENT_UWORD 65535 Compu_IDENTITY 0 65535 PHYS_UNIT "DTC" /end CHARACTERISTIC
/begin CHARACTERISTIC FCdtc_OILTL_Lvl_OOR "FCtl_DTC(739)" VALUE 0x00163ADA /* @ECU_Address@FCtl_DTC@0x021B55C6@ */ ECIPP_ALIGNMENT_UWORD 65535 Compu_IDENTITY 0 65535 PHYS_UNIT "DTC" /end CHARACTERISTIC
/begin CHARACTERISTIC FCdtc_OILTL_T_hi "FCtl_DTC(742)" VALUE 0x00163AE0 /* @ECU_Address@FCtl_DTC@0x021B55CC@ */ ECIPP_ALIGNMENT_UWORD 65535 Compu_IDENTITY 0 65535 PHYS_UNIT "DTC" /end CHARACTERISTIC
/begin CHARACTERISTIC FCdtc_OILTL_T_OOR "FCtl_DTC(740)" VALUE 0x00163ADC /* @ECU_Address@FCtl_DTC@0x021B55C8@ */ ECIPP_ALIGNMENT_UWORD 65535 Compu_IDENTITY 0 65535 PHYS_UNIT "DTC" /end CHARACTERISTIC
/begin CHARACTERISTIC FCdtc_OILTL_V_OOR "FCtl_DTC(738)" VALUE 0x00163AD8 /* @ECU_Address@FCtl_DTC@0x021B55C4@ */ ECIPP_ALIGNMENT_UWORD 65535 Compu_IDENTITY 0 65535 PHYS_UNIT "DTC" /end CHARACTERISTIC
/begin CHARACTERISTIC FCdtc_PAUX_dP1_max "FCtl_DTC(546)" VALUE 0x00163958 /* @ECU_Address@FCtl_DTC@0x021B5444@ */ ECIPP_ALIGNMENT_UWORD 65535 Compu_IDENTITY 0 65535 PHYS_UNIT "DTC" /end CHARACTERISTIC
/begin CHARACTERISTIC FCdtc_PAUX_dP1_min "FCtl_DTC(547)" VALUE 0x0016395A /* @ECU_Address@FCtl_DTC@0x021B5446@ */ ECIPP_ALIGNMENT_UWORD 65535 Compu_IDENTITY 0 65535 PHYS_UNIT "DTC" /end CHARACTERISTIC
/begin CHARACTERISTIC FCdtc_PAUX_dP2_max "FCtl_DTC(548)" VALUE 0x0016395C /* @ECU_Address@FCtl_DTC@0x021B5448@ */ ECIPP_ALIGNMENT_UWORD 65535 Compu_IDENTITY 0 65535 PHYS_UNIT "DTC" /end CHARACTERISTIC
/begin CHARACTERISTIC FCdtc_PAUX_dP2_min "FCtl_DTC(549)" VALUE 0x0016395E /* @ECU_Address@FCtl_DTC@0x021B544A@ */ ECIPP_ALIGNMENT_UWORD 65535 Compu_IDENTITY 0 65535 PHYS_UNIT "DTC" /end CHARACTERISTIC
/begin CHARACTERISTIC FCdtc_PAUX1_max "FCtl_DTC(538)" VALUE 0x00163948 /* @ECU_Address@FCtl_DTC@0x021B5434@ */ ECIPP_ALIGNMENT_UWORD 65535 Compu_IDENTITY 0 65535 PHYS_UNIT "DTC" /end CHARACTERISTIC
/begin CHARACTERISTIC FCdtc_PAUX1_min "FCtl_DTC(539)" VALUE 0x0016394A /* @ECU_Address@FCtl_DTC@0x021B5436@ */ ECIPP_ALIGNMENT_UWORD 65535 Compu_IDENTITY 0 65535 PHYS_UNIT "DTC" /end CHARACTERISTIC
/begin CHARACTERISTIC FCdtc_PAUX2_max "FCtl_DTC(540)" VALUE 0x0016394C /* @ECU_Address@FCtl_DTC@0x021B5438@ */ ECIPP_ALIGNMENT_UWORD 65535 Compu_IDENTITY 0 65535 PHYS_UNIT "DTC" /end CHARACTERISTIC
/begin CHARACTERISTIC FCdtc_PAUX2_min "FCtl_DTC(541)" VALUE 0x0016394E /* @ECU_Address@FCtl_DTC@0x021B543A@ */ ECIPP_ALIGNMENT_UWORD 65535 Compu_IDENTITY 0 65535 PHYS_UNIT "DTC" /end CHARACTERISTIC
/begin CHARACTERISTIC FCdtc_PAUX3_max "FCtl_DTC(542)" VALUE 0x00163950 /* @ECU_Address@FCtl_DTC@0x021B543C@ */ ECIPP_ALIGNMENT_UWORD 65535 Compu_IDENTITY 0 65535 PHYS_UNIT "DTC" /end CHARACTERISTIC
/begin CHARACTERISTIC FCdtc_PAUX3_min "FCtl_DTC(543)" VALUE 0x00163952 /* @ECU_Address@FCtl_DTC@0x021B543E@ */ ECIPP_ALIGNMENT_UWORD 65535 Compu_IDENTITY 0 65535 PHYS_UNIT "DTC" /end CHARACTERISTIC
/begin CHARACTERISTIC FCdtc_PAUX4_max "FCtl_DTC(544)" VALUE 0x00163954 /* @ECU_Address@FCtl_DTC@0x021B5440@ */ ECIPP_ALIGNMENT_UWORD 65535 Compu_IDENTITY 0 65535 PHYS_UNIT "DTC" /end CHARACTERISTIC
/begin CHARACTERISTIC FCdtc_PAUX4_min "FCtl_DTC(545)" VALUE 0x00163956 /* @ECU_Address@FCtl_DTC@0x021B5442@ */ ECIPP_ALIGNMENT_UWORD 65535 Compu_IDENTITY 0 65535 PHYS_UNIT "DTC" /end CHARACTERISTIC
/begin CHARACTERISTIC FCdtc_PPEG_BP "FCtl_DTC(670)" VALUE 0x00163A50 /* @ECU_Address@FCtl_DTC@0x021B553C@ */ ECIPP_ALIGNMENT_UWORD 65535 Compu_IDENTITY 0 65535 PHYS_UNIT "DTC" /end CHARACTERISTIC
/begin CHARACTERISTIC FCdtc_PPEG_CVP1 "FCtl_DTC(745)" VALUE 0x00163AE6 /* @ECU_Address@FCtl_DTC@0x021B55D2@ */ ECIPP_ALIGNMENT_UWORD 65535 Compu_IDENTITY 0 65535 PHYS_UNIT "DTC" /end CHARACTERISTIC
/begin CHARACTERISTIC FCdtc_PPEG_CVP2 "FCtl_DTC(746)" VALUE 0x00163AE8 /* @ECU_Address@FCtl_DTC@0x021B55D4@ */ ECIPP_ALIGNMENT_UWORD 65535 Compu_IDENTITY 0 65535 PHYS_UNIT "DTC" /end CHARACTERISTIC
/begin CHARACTERISTIC FCdtc_PPEG_EBP "FCtl_DTC(671)" VALUE 0x00163A52 /* @ECU_Address@FCtl_DTC@0x021B553E@ */ ECIPP_ALIGNMENT_UWORD 65535 Compu_IDENTITY 0 65535 PHYS_UNIT "DTC" /end CHARACTERISTIC
/begin CHARACTERISTIC FCdtc_PPEG_EGRdP "FCtl_DTC(756)" VALUE 0x00163AFC /* @ECU_Address@FCtl_DTC@0x021B55E8@ */ ECIPP_ALIGNMENT_UWORD 65535 Compu_IDENTITY 0 65535 PHYS_UNIT "DTC" /end CHARACTERISTIC
/begin CHARACTERISTIC FCdtc_PPEG_EGRHP "FCtl_DTC(673)" VALUE 0x00163A56 /* @ECU_Address@FCtl_DTC@0x021B5542@ */ ECIPP_ALIGNMENT_UWORD 65535 Compu_IDENTITY 0 65535 PHYS_UNIT "DTC" /end CHARACTERISTIC
/begin CHARACTERISTIC FCdtc_PPEG_EGRLP "FCtl_DTC(672)" VALUE 0x00163A54 /* @ECU_Address@FCtl_DTC@0x021B5540@ */ ECIPP_ALIGNMENT_UWORD 65535 Compu_IDENTITY 0 65535 PHYS_UNIT "DTC" /end CHARACTERISTIC
/begin CHARACTERISTIC FCdtc_PPEG_EGRwrP "FCtl_DTC(675)" VALUE 0x00163A5A /* @ECU_Address@FCtl_DTC@0x021B5546@ */ ECIPP_ALIGNMENT_UWORD 65535 Compu_IDENTITY 0 65535 PHYS_UNIT "DTC" /end CHARACTERISTIC
/begin CHARACTERISTIC FCdtc_PPEG_MAP "FCtl_DTC(676)" VALUE 0x00163A5C /* @ECU_Address@FCtl_DTC@0x021B5548@ */ ECIPP_ALIGNMENT_UWORD 65535 Compu_IDENTITY 0 65535 PHYS_UNIT "DTC" /end CHARACTERISTIC
/begin CHARACTERISTIC FCdtc_PPEG_TIP "FCtl_DTC(674)" VALUE 0x00163A58 /* @ECU_Address@FCtl_DTC@0x021B5544@ */ ECIPP_ALIGNMENT_UWORD 65535 Compu_IDENTITY 0 65535 PHYS_UNIT "DTC" /end CHARACTERISTIC
/begin CHARACTERISTIC FCdtc_PWM1_off_loVf "FCtl_DTC(189)" VALUE 0x0016368E /* @ECU_Address@FCtl_DTC@0x021B517A@ */ ECIPP_ALIGNMENT_UWORD 65535 Compu_IDENTITY 0 65535 PHYS_UNIT "DTC" /end CHARACTERISTIC
/begin CHARACTERISTIC FCdtc_PWM1_on_hiVf "FCtl_DTC(190)" VALUE 0x00163690 /* @ECU_Address@FCtl_DTC@0x021B517C@ */ ECIPP_ALIGNMENT_UWORD 65535 Compu_IDENTITY 0 65535 PHYS_UNIT "DTC" /end CHARACTERISTIC
/begin CHARACTERISTIC FCdtc_PWM10_off_loVf "FCtl_DTC(433)" VALUE 0x00163876 /* @ECU_Address@FCtl_DTC@0x021B5362@ */ ECIPP_ALIGNMENT_UWORD 65535 Compu_IDENTITY 0 65535 PHYS_UNIT "DTC" /end CHARACTERISTIC
/begin CHARACTERISTIC FCdtc_PWM10_on_hiVf "FCtl_DTC(434)" VALUE 0x00163878 /* @ECU_Address@FCtl_DTC@0x021B5364@ */ ECIPP_ALIGNMENT_UWORD 65535 Compu_IDENTITY 0 65535 PHYS_UNIT "DTC" /end CHARACTERISTIC
/begin CHARACTERISTIC FCdtc_PWM11_off_loVf "FCtl_DTC(435)" VALUE 0x0016387A /* @ECU_Address@FCtl_DTC@0x021B5366@ */ ECIPP_ALIGNMENT_UWORD 65535 Compu_IDENTITY 0 65535 PHYS_UNIT "DTC" /end CHARACTERISTIC
/begin CHARACTERISTIC FCdtc_PWM11_on_hiVf "FCtl_DTC(436)" VALUE 0x0016387C /* @ECU_Address@FCtl_DTC@0x021B5368@ */ ECIPP_ALIGNMENT_UWORD 65535 Compu_IDENTITY 0 65535 PHYS_UNIT "DTC" /end CHARACTERISTIC
/begin CHARACTERISTIC FCdtc_PWM12_off_loVf "FCtl_DTC(437)" VALUE 0x0016387E /* @ECU_Address@FCtl_DTC@0x021B536A@ */ ECIPP_ALIGNMENT_UWORD 65535 Compu_IDENTITY 0 65535 PHYS_UNIT "DTC" /end CHARACTERISTIC
/begin CHARACTERISTIC FCdtc_PWM12_on_hiVf "FCtl_DTC(438)" VALUE 0x00163880 /* @ECU_Address@FCtl_DTC@0x021B536C@ */ ECIPP_ALIGNMENT_UWORD 65535 Compu_IDENTITY 0 65535 PHYS_UNIT "DTC" /end CHARACTERISTIC
/begin CHARACTERISTIC FCdtc_PWM13_off_loVf "FCtl_DTC(439)" VALUE 0x00163882 /* @ECU_Address@FCtl_DTC@0x021B536E@ */ ECIPP_ALIGNMENT_UWORD 65535 Compu_IDENTITY 0 65535 PHYS_UNIT "DTC" /end CHARACTERISTIC
/begin CHARACTERISTIC FCdtc_PWM13_on_hiVf "FCtl_DTC(440)" VALUE 0x00163884 /* @ECU_Address@FCtl_DTC@0x021B5370@ */ ECIPP_ALIGNMENT_UWORD 65535 Compu_IDENTITY 0 65535 PHYS_UNIT "DTC" /end CHARACTERISTIC
/begin CHARACTERISTIC FCdtc_PWM14_off_loVf "FCtl_DTC(441)" VALUE 0x00163886 /* @ECU_Address@FCtl_DTC@0x021B5372@ */ ECIPP_ALIGNMENT_UWORD 65535 Compu_IDENTITY 0 65535 PHYS_UNIT "DTC" /end CHARACTERISTIC
/begin CHARACTERISTIC FCdtc_PWM14_on_hiVf "FCtl_DTC(442)" VALUE 0x00163888 /* @ECU_Address@FCtl_DTC@0x021B5374@ */ ECIPP_ALIGNMENT_UWORD 65535 Compu_IDENTITY 0 65535 PHYS_UNIT "DTC" /end CHARACTERISTIC
/begin CHARACTERISTIC FCdtc_PWM15_off_loVf "FCtl_DTC(443)" VALUE 0x0016388A /* @ECU_Address@FCtl_DTC@0x021B5376@ */ ECIPP_ALIGNMENT_UWORD 65535 Compu_IDENTITY 0 65535 PHYS_UNIT "DTC" /end CHARACTERISTIC
/begin CHARACTERISTIC FCdtc_PWM15_on_hiVf "FCtl_DTC(444)" VALUE 0x0016388C /* @ECU_Address@FCtl_DTC@0x021B5378@ */ ECIPP_ALIGNMENT_UWORD 65535 Compu_IDENTITY 0 65535 PHYS_UNIT "DTC" /end CHARACTERISTIC
/begin CHARACTERISTIC FCdtc_PWM16_off_loVf "FCtl_DTC(445)" VALUE 0x0016388E /* @ECU_Address@FCtl_DTC@0x021B537A@ */ ECIPP_ALIGNMENT_UWORD 65535 Compu_IDENTITY 0 65535 PHYS_UNIT "DTC" /end CHARACTERISTIC
/begin CHARACTERISTIC FCdtc_PWM16_on_hiVf "FCtl_DTC(446)" VALUE 0x00163890 /* @ECU_Address@FCtl_DTC@0x021B537C@ */ ECIPP_ALIGNMENT_UWORD 65535 Compu_IDENTITY 0 65535 PHYS_UNIT "DTC" /end CHARACTERISTIC
/begin CHARACTERISTIC FCdtc_PWM17_off_loVf "FCtl_DTC(447)" VALUE 0x00163892 /* @ECU_Address@FCtl_DTC@0x021B537E@ */ ECIPP_ALIGNMENT_UWORD 65535 Compu_IDENTITY 0 65535 PHYS_UNIT "DTC" /end CHARACTERISTIC
/begin CHARACTERISTIC FCdtc_PWM17_on_hiVf "FCtl_DTC(448)" VALUE 0x00163894 /* @ECU_Address@FCtl_DTC@0x021B5380@ */ ECIPP_ALIGNMENT_UWORD 65535 Compu_IDENTITY 0 65535 PHYS_UNIT "DTC" /end CHARACTERISTIC
/begin CHARACTERISTIC FCdtc_PWM18_off_loVf "FCtl_DTC(449)" VALUE 0x00163896 /* @ECU_Address@FCtl_DTC@0x021B5382@ */ ECIPP_ALIGNMENT_UWORD 65535 Compu_IDENTITY 0 65535 PHYS_UNIT "DTC" /end CHARACTERISTIC
/begin CHARACTERISTIC FCdtc_PWM18_on_hiVf "FCtl_DTC(450)" VALUE 0x00163898 /* @ECU_Address@FCtl_DTC@0x021B5384@ */ ECIPP_ALIGNMENT_UWORD 65535 Compu_IDENTITY 0 65535 PHYS_UNIT "DTC" /end CHARACTERISTIC
/begin CHARACTERISTIC FCdtc_PWM19_off_loVf "FCtl_DTC(451)" VALUE 0x0016389A /* @ECU_Address@FCtl_DTC@0x021B5386@ */ ECIPP_ALIGNMENT_UWORD 65535 Compu_IDENTITY 0 65535 PHYS_UNIT "DTC" /end CHARACTERISTIC
/begin CHARACTERISTIC FCdtc_PWM19_on_hiVf "FCtl_DTC(452)" VALUE 0x0016389C /* @ECU_Address@FCtl_DTC@0x021B5388@ */ ECIPP_ALIGNMENT_UWORD 65535 Compu_IDENTITY 0 65535 PHYS_UNIT "DTC" /end CHARACTERISTIC
/begin CHARACTERISTIC FCdtc_PWM2_off_loVf "FCtl_DTC(191)" VALUE 0x00163692 /* @ECU_Address@FCtl_DTC@0x021B517E@ */ ECIPP_ALIGNMENT_UWORD 65535 Compu_IDENTITY 0 65535 PHYS_UNIT "DTC" /end CHARACTERISTIC
/begin CHARACTERISTIC FCdtc_PWM2_on_hiVf "FCtl_DTC(192)" VALUE 0x00163694 /* @ECU_Address@FCtl_DTC@0x021B5180@ */ ECIPP_ALIGNMENT_UWORD 65535 Compu_IDENTITY 0 65535 PHYS_UNIT "DTC" /end CHARACTERISTIC
/begin CHARACTERISTIC FCdtc_PWM20_off_loVf "FCtl_DTC(453)" VALUE 0x0016389E /* @ECU_Address@FCtl_DTC@0x021B538A@ */ ECIPP_ALIGNMENT_UWORD 65535 Compu_IDENTITY 0 65535 PHYS_UNIT "DTC" /end CHARACTERISTIC
/begin CHARACTERISTIC FCdtc_PWM20_on_hiVf "FCtl_DTC(454)" VALUE 0x001638A0 /* @ECU_Address@FCtl_DTC@0x021B538C@ */ ECIPP_ALIGNMENT_UWORD 65535 Compu_IDENTITY 0 65535 PHYS_UNIT "DTC" /end CHARACTERISTIC
/begin CHARACTERISTIC FCdtc_PWM21_off_loVf "FCtl_DTC(455)" VALUE 0x001638A2 /* @ECU_Address@FCtl_DTC@0x021B538E@ */ ECIPP_ALIGNMENT_UWORD 65535 Compu_IDENTITY 0 65535 PHYS_UNIT "DTC" /end CHARACTERISTIC
/begin CHARACTERISTIC FCfmi_MJ_Pe_HiExp "FCtl_FMI(133)" VALUE 0x00165198 /* @ECU_Address@FCtl_FMI@0x021B7085@ */ ECIPP_ALIGNMENT_UBYTE 255 Compu_IDENTITY 0 255 PHYS_UNIT "FMI" /end CHARACTERISTIC
/begin CHARACTERISTIC FCfmi_MJ_Pe_LoExp "FCtl_FMI(134)" VALUE 0x00165199 /* @ECU_Address@FCtl_FMI@0x021B7086@ */ ECIPP_ALIGNMENT_UBYTE 255 Compu_IDENTITY 0 255 PHYS_UNIT "FMI" /end CHARACTERISTIC
/begin CHARACTERISTIC FCfmi_MJ2_comm_tout "FCtl_FMI(726)" VALUE 0x001653E9 /* @ECU_Address@FCtl_FMI@0x021B72D6@ */ ECIPP_ALIGNMENT_UBYTE 255 Compu_IDENTITY 0 255 PHYS_UNIT "FMI" /end CHARACTERISTIC
/begin CHARACTERISTIC FCfmi_MJ2_intF_act "FCtl_FMI(729)" VALUE 0x001653EC /* @ECU_Address@FCtl_FMI@0x021B72D9@ */ ECIPP_ALIGNMENT_UBYTE 255 Compu_IDENTITY 0 255 PHYS_UNIT "FMI" /end CHARACTERISTIC
/begin CHARACTERISTIC FCfmi_MJ2_intF_circ "FCtl_FMI(730)" VALUE 0x001653ED /* @ECU_Address@FCtl_FMI@0x021B72DA@ */ ECIPP_ALIGNMENT_UBYTE 255 Compu_IDENTITY 0 255 PHYS_UNIT "FMI" /end CHARACTERISTIC
/begin CHARACTERISTIC FCfmi_MJ2_intF_comm "FCtl_FMI(731)" VALUE 0x001653EE /* @ECU_Address@FCtl_FMI@0x021B72DB@ */ ECIPP_ALIGNMENT_UBYTE 255 Compu_IDENTITY 0 255 PHYS_UNIT "FMI" /end CHARACTERISTIC
/begin CHARACTERISTIC FCfmi_MJ2_intF_Vhi "FCtl_FMI(727)" VALUE 0x001653EA /* @ECU_Address@FCtl_FMI@0x021B72D7@ */ ECIPP_ALIGNMENT_UBYTE 255 Compu_IDENTITY 0 255 PHYS_UNIT "FMI" /end CHARACTERISTIC
/begin CHARACTERISTIC FCfmi_MJ2_intF_Vlo "FCtl_FMI(728)" VALUE 0x001653EB /* @ECU_Address@FCtl_FMI@0x021B72D8@ */ ECIPP_ALIGNMENT_UBYTE 255 Compu_IDENTITY 0 255 PHYS_UNIT "FMI" /end CHARACTERISTIC
/begin CHARACTERISTIC FCfmi_MJ2_Pe_HiExp "FCtl_FMI(724)" VALUE 0x001653E7 /* @ECU_Address@FCtl_FMI@0x021B72D4@ */ ECIPP_ALIGNMENT_UBYTE 255 Compu_IDENTITY 0 255 PHYS_UNIT "FMI" /end CHARACTERISTIC
/begin CHARACTERISTIC FCfmi_MJ2_Pe_LoExp "FCtl_FMI(725)" VALUE 0x001653E8 /* @ECU_Address@FCtl_FMI@0x021B72D5@ */ ECIPP_ALIGNMENT_UBYTE 255 Compu_IDENTITY 0 255 PHYS_UNIT "FMI" /end CHARACTERISTIC
/begin CHARACTERISTIC FCfmi_NOx_hi "FCtl_FMI(793)" VALUE 0x0016542C /* @ECU_Address@FCtl_FMI@0x021B7319@ */ ECIPP_ALIGNMENT_UBYTE 255 Compu_IDENTITY 0 255 PHYS_UNIT "FMI" /end CHARACTERISTIC
/begin CHARACTERISTIC FCfmi_OilP_hiP "FCtl_FMI(149)" VALUE 0x001651A8 /* @ECU_Address@FCtl_FMI@0x021B7095@ */ ECIPP_ALIGNMENT_UBYTE 255 Compu_IDENTITY 0 255 PHYS_UNIT "FMI" /end CHARACTERISTIC
/begin CHARACTERISTIC FCfmi_OilP_loP "FCtl_FMI(148)" VALUE 0x001651A7 /* @ECU_Address@FCtl_FMI@0x021B7094@ */ ECIPP_ALIGNMENT_UBYTE 255 Compu_IDENTITY 0 255 PHYS_UNIT "FMI" /end CHARACTERISTIC
/begin CHARACTERISTIC FCfmi_OilP_maxV "FCtl_FMI(150)" VALUE 0x001651A9 /* @ECU_Address@FCtl_FMI@0x021B7096@ */ ECIPP_ALIGNMENT_UBYTE 255 Compu_IDENTITY 0 255 PHYS_UNIT "FMI" /end CHARACTERISTIC
/begin CHARACTERISTIC FCfmi_OilP_minV "FCtl_FMI(151)" VALUE 0x001651AA /* @ECU_Address@FCtl_FMI@0x021B7097@ */ ECIPP_ALIGNMENT_UBYTE 255 Compu_IDENTITY 0 255 PHYS_UNIT "FMI" /end CHARACTERISTIC
/begin CHARACTERISTIC FCfmi_OILP_test "FCtl_FMI(29)" VALUE 0x00165130 /* @ECU_Address@FCtl_FMI@0x021B701D@ */ ECIPP_ALIGNMENT_UBYTE 255 Compu_IDENTITY 0 255 PHYS_UNIT "FMI" /end CHARACTERISTIC
/begin CHARACTERISTIC FCfmi_OilP2_loP "FCtl_FMI(293)" VALUE 0x00165238 /* @ECU_Address@FCtl_FMI@0x021B7125@ */ ECIPP_ALIGNMENT_UBYTE 255 Compu_IDENTITY 0 255 PHYS_UNIT "FMI" /end CHARACTERISTIC
/begin CHARACTERISTIC FCfmi_OILTL_loss "FCtl_FMI(737)" VALUE 0x001653F4 /* @ECU_Address@FCtl_FMI@0x021B72E1@ */ ECIPP_ALIGNMENT_UBYTE 255 Compu_IDENTITY 0 255 PHYS_UNIT "FMI" /end CHARACTERISTIC
/begin CHARACTERISTIC FCfmi_OILTL_Lvl_lo "FCtl_FMI(741)" VALUE 0x001653F8 /* @ECU_Address@FCtl_FMI@0x021B72E5@ */ ECIPP_ALIGNMENT_UBYTE 255 Compu_IDENTITY 0 255 PHYS_UNIT "FMI" /end CHARACTERISTIC
/begin CHARACTERISTIC FCfmi_OILTL_Lvl_OOR "FCtl_FMI(739)" VALUE 0x001653F6 /* @ECU_Address@FCtl_FMI@0x021B72E3@ */ ECIPP_ALIGNMENT_UBYTE 255 Compu_IDENTITY 0 255 PHYS_UNIT "FMI" /end CHARACTERISTIC
/begin CHARACTERISTIC FCfmi_OILTL_T_hi "FCtl_FMI(742)" VALUE 0x001653F9 /* @ECU_Address@FCtl_FMI@0x021B72E6@ */ ECIPP_ALIGNMENT_UBYTE 255 Compu_IDENTITY 0 255 PHYS_UNIT "FMI" /end CHARACTERISTIC
/begin CHARACTERISTIC FCfmi_OILTL_T_OOR "FCtl_FMI(740)" VALUE 0x001653F7 /* @ECU_Address@FCtl_FMI@0x021B72E4@ */ ECIPP_ALIGNMENT_UBYTE 255 Compu_IDENTITY 0 255 PHYS_UNIT "FMI" /end CHARACTERISTIC
/begin CHARACTERISTIC FCfmi_OILTL_V_OOR "FCtl_FMI(738)" VALUE 0x001653F5 /* @ECU_Address@FCtl_FMI@0x021B72E2@ */ ECIPP_ALIGNMENT_UBYTE 255 Compu_IDENTITY 0 255 PHYS_UNIT "FMI" /end CHARACTERISTIC
/begin CHARACTERISTIC FCfmi_PAUX_dP1_max "FCtl_FMI(546)" VALUE 0x00165335 /* @ECU_Address@FCtl_FMI@0x021B7222@ */ ECIPP_ALIGNMENT_UBYTE 255 Compu_IDENTITY 0 255 PHYS_UNIT "FMI" /end CHARACTERISTIC
/begin CHARACTERISTIC FCfmi_PAUX_dP1_min "FCtl_FMI(547)" VALUE 0x00165336 /* @ECU_Address@FCtl_FMI@0x021B7223@ */ ECIPP_ALIGNMENT_UBYTE 255 Compu_IDENTITY 0 255 PHYS_UNIT "FMI" /end CHARACTERISTIC
/begin CHARACTERISTIC FCfmi_PAUX_dP2_max "FCtl_FMI(548)" VALUE 0x00165337 /* @ECU_Address@FCtl_FMI@0x021B7224@ */ ECIPP_ALIGNMENT_UBYTE 255 Compu_IDENTITY 0 255 PHYS_UNIT "FMI" /end CHARACTERISTIC
/begin CHARACTERISTIC FCfmi_PAUX_dP2_min "FCtl_FMI(549)" VALUE 0x00165338 /* @ECU_Address@FCtl_FMI@0x021B7225@ */ ECIPP_ALIGNMENT_UBYTE 255 Compu_IDENTITY 0 255 PHYS_UNIT "FMI" /end CHARACTERISTIC
/begin CHARACTERISTIC FCfmi_PAUX1_max "FCtl_FMI(538)" VALUE 0x0016532D /* @ECU_Address@FCtl_FMI@0x021B721A@ */ ECIPP_ALIGNMENT_UBYTE 255 Compu_IDENTITY 0 255 PHYS_UNIT "FMI" /end CHARACTERISTIC
/begin CHARACTERISTIC FCfmi_PAUX1_min "FCtl_FMI(539)" VALUE 0x0016532E /* @ECU_Address@FCtl_FMI@0x021B721B@ */ ECIPP_ALIGNMENT_UBYTE 255 Compu_IDENTITY 0 255 PHYS_UNIT "FMI" /end CHARACTERISTIC
/begin CHARACTERISTIC FCfmi_PAUX2_max "FCtl_FMI(540)" VALUE 0x0016532F /* @ECU_Address@FCtl_FMI@0x021B721C@ */ ECIPP_ALIGNMENT_UBYTE 255 Compu_IDENTITY 0 255 PHYS_UNIT "FMI" /end CHARACTERISTIC
/begin CHARACTERISTIC FCfmi_PAUX2_min "FCtl_FMI(541)" VALUE 0x00165330 /* @ECU_Address@FCtl_FMI@0x021B721D@ */ ECIPP_ALIGNMENT_UBYTE 255 Compu_IDENTITY 0 255 PHYS_UNIT "FMI" /end CHARACTERISTIC
/begin CHARACTERISTIC FCfmi_PAUX3_max "FCtl_FMI(542)" VALUE 0x00165331 /* @ECU_Address@FCtl_FMI@0x021B721E@ */ ECIPP_ALIGNMENT_UBYTE 255 Compu_IDENTITY 0 255 PHYS_UNIT "FMI" /end CHARACTERISTIC
/begin CHARACTERISTIC FCfmi_PAUX3_min "FCtl_FMI(543)" VALUE 0x00165332 /* @ECU_Address@FCtl_FMI@0x021B721F@ */ ECIPP_ALIGNMENT_UBYTE 255 Compu_IDENTITY 0 255 PHYS_UNIT "FMI" /end CHARACTERISTIC
/begin CHARACTERISTIC FCfmi_PAUX4_max "FCtl_FMI(544)" VALUE 0x00165333 /* @ECU_Address@FCtl_FMI@0x021B7220@ */ ECIPP_ALIGNMENT_UBYTE 255 Compu_IDENTITY 0 255 PHYS_UNIT "FMI" /end CHARACTERISTIC
/begin CHARACTERISTIC FCfmi_PAUX4_min "FCtl_FMI(545)" VALUE 0x00165334 /* @ECU_Address@FCtl_FMI@0x021B7221@ */ ECIPP_ALIGNMENT_UBYTE 255 Compu_IDENTITY 0 255 PHYS_UNIT "FMI" /end CHARACTERISTIC
/begin CHARACTERISTIC FCfmi_PPEG_BP "FCtl_FMI(670)" VALUE 0x001653B1 /* @ECU_Address@FCtl_FMI@0x021B729E@ */ ECIPP_ALIGNMENT_UBYTE 255 Compu_IDENTITY 0 255 PHYS_UNIT "FMI" /end CHARACTERISTIC
/begin CHARACTERISTIC FCfmi_PPEG_CVP1 "FCtl_FMI(745)" VALUE 0x001653FC /* @ECU_Address@FCtl_FMI@0x021B72E9@ */ ECIPP_ALIGNMENT_UBYTE 255 Compu_IDENTITY 0 255 PHYS_UNIT "FMI" /end CHARACTERISTIC
/begin CHARACTERISTIC FCfmi_PPEG_CVP2 "FCtl_FMI(746)" VALUE 0x001653FD /* @ECU_Address@FCtl_FMI@0x021B72EA@ */ ECIPP_ALIGNMENT_UBYTE 255 Compu_IDENTITY 0 255 PHYS_UNIT "FMI" /end CHARACTERISTIC
/begin CHARACTERISTIC FCfmi_PPEG_EBP "FCtl_FMI(671)" VALUE 0x001653B2 /* @ECU_Address@FCtl_FMI@0x021B729F@ */ ECIPP_ALIGNMENT_UBYTE 255 Compu_IDENTITY 0 255 PHYS_UNIT "FMI" /end CHARACTERISTIC
/begin CHARACTERISTIC FCfmi_PPEG_EGRdP "FCtl_FMI(756)" VALUE 0x00165407 /* @ECU_Address@FCtl_FMI@0x021B72F4@ */ ECIPP_ALIGNMENT_UBYTE 255 Compu_IDENTITY 0 255 PHYS_UNIT "FMI" /end CHARACTERISTIC
/begin CHARACTERISTIC FCfmi_PPEG_EGRHP "FCtl_FMI(673)" VALUE 0x001653B4 /* @ECU_Address@FCtl_FMI@0x021B72A1@ */ ECIPP_ALIGNMENT_UBYTE 255 Compu_IDENTITY 0 255 PHYS_UNIT "FMI" /end CHARACTERISTIC
/begin CHARACTERISTIC FCfmi_PPEG_EGRLP "FCtl_FMI(672)" VALUE 0x001653B3 /* @ECU_Address@FCtl_FMI@0x021B72A0@ */ ECIPP_ALIGNMENT_UBYTE 255 Compu_IDENTITY 0 255 PHYS_UNIT "FMI" /end CHARACTERISTIC
/begin CHARACTERISTIC FCfmi_PPEG_EGRwrP "FCtl_FMI(675)" VALUE 0x001653B6 /* @ECU_Address@FCtl_FMI@0x021B72A3@ */ ECIPP_ALIGNMENT_UBYTE 255 Compu_IDENTITY 0 255 PHYS_UNIT "FMI" /end CHARACTERISTIC
/begin CHARACTERISTIC FCfmi_PPEG_MAP "FCtl_FMI(676)" VALUE 0x001653B7 /* @ECU_Address@FCtl_FMI@0x021B72A4@ */ ECIPP_ALIGNMENT_UBYTE 255 Compu_IDENTITY 0 255 PHYS_UNIT "FMI" /end CHARACTERISTIC
/begin CHARACTERISTIC FCfmi_PPEG_TIP "FCtl_FMI(674)" VALUE 0x001653B5 /* @ECU_Address@FCtl_FMI@0x021B72A2@ */ ECIPP_ALIGNMENT_UBYTE 255 Compu_IDENTITY 0 255 PHYS_UNIT "FMI" /end CHARACTERISTIC
/begin CHARACTERISTIC FCfmi_PWM1_off_loVf "FCtl_FMI(189)" VALUE 0x001651D0 /* @ECU_Address@FCtl_FMI@0x021B70BD@ */ ECIPP_ALIGNMENT_UBYTE 255 Compu_IDENTITY 0 255 PHYS_UNIT "FMI" /end CHARACTERISTIC
/begin CHARACTERISTIC FCfmi_PWM1_on_hiVf "FCtl_FMI(190)" VALUE 0x001651D1 /* @ECU_Address@FCtl_FMI@0x021B70BE@ */ ECIPP_ALIGNMENT_UBYTE 255 Compu_IDENTITY 0 255 PHYS_UNIT "FMI" /end CHARACTERISTIC
/begin CHARACTERISTIC FCfmi_PWM10_off_loVf "FCtl_FMI(433)" VALUE 0x001652C4 /* @ECU_Address@FCtl_FMI@0x021B71B1@ */ ECIPP_ALIGNMENT_UBYTE 255 Compu_IDENTITY 0 255 PHYS_UNIT "FMI" /end CHARACTERISTIC
/begin CHARACTERISTIC FCfmi_PWM10_on_hiVf "FCtl_FMI(434)" VALUE 0x001652C5 /* @ECU_Address@FCtl_FMI@0x021B71B2@ */ ECIPP_ALIGNMENT_UBYTE 255 Compu_IDENTITY 0 255 PHYS_UNIT "FMI" /end CHARACTERISTIC
/begin CHARACTERISTIC FCfmi_PWM11_off_loVf "FCtl_FMI(435)" VALUE 0x001652C6 /* @ECU_Address@FCtl_FMI@0x021B71B3@ */ ECIPP_ALIGNMENT_UBYTE 255 Compu_IDENTITY 0 255 PHYS_UNIT "FMI" /end CHARACTERISTIC
/begin CHARACTERISTIC FCfmi_PWM11_on_hiVf "FCtl_FMI(436)" VALUE 0x001652C7 /* @ECU_Address@FCtl_FMI@0x021B71B4@ */ ECIPP_ALIGNMENT_UBYTE 255 Compu_IDENTITY 0 255 PHYS_UNIT "FMI" /end CHARACTERISTIC
/begin CHARACTERISTIC FCfmi_PWM12_off_loVf "FCtl_FMI(437)" VALUE 0x001652C8 /* @ECU_Address@FCtl_FMI@0x021B71B5@ */ ECIPP_ALIGNMENT_UBYTE 255 Compu_IDENTITY 0 255 PHYS_UNIT "FMI" /end CHARACTERISTIC
/begin CHARACTERISTIC FCfmi_PWM12_on_hiVf "FCtl_FMI(438)" VALUE 0x001652C9 /* @ECU_Address@FCtl_FMI@0x021B71B6@ */ ECIPP_ALIGNMENT_UBYTE 255 Compu_IDENTITY 0 255 PHYS_UNIT "FMI" /end CHARACTERISTIC
/begin CHARACTERISTIC FCfmi_PWM13_off_loVf "FCtl_FMI(439)" VALUE 0x001652CA /* @ECU_Address@FCtl_FMI@0x021B71B7@ */ ECIPP_ALIGNMENT_UBYTE 255 Compu_IDENTITY 0 255 PHYS_UNIT "FMI" /end CHARACTERISTIC
/begin CHARACTERISTIC FCfmi_PWM13_on_hiVf "FCtl_FMI(440)" VALUE 0x001652CB /* @ECU_Address@FCtl_FMI@0x021B71B8@ */ ECIPP_ALIGNMENT_UBYTE 255 Compu_IDENTITY 0 255 PHYS_UNIT "FMI" /end CHARACTERISTIC
/begin CHARACTERISTIC FCfmi_PWM14_off_loVf "FCtl_FMI(441)" VALUE 0x001652CC /* @ECU_Address@FCtl_FMI@0x021B71B9@ */ ECIPP_ALIGNMENT_UBYTE 255 Compu_IDENTITY 0 255 PHYS_UNIT "FMI" /end CHARACTERISTIC
/begin CHARACTERISTIC FCfmi_PWM14_on_hiVf "FCtl_FMI(442)" VALUE 0x001652CD /* @ECU_Address@FCtl_FMI@0x021B71BA@ */ ECIPP_ALIGNMENT_UBYTE 255 Compu_IDENTITY 0 255 PHYS_UNIT "FMI" /end CHARACTERISTIC
/begin CHARACTERISTIC FCfmi_PWM15_off_loVf "FCtl_FMI(443)" VALUE 0x001652CE /* @ECU_Address@FCtl_FMI@0x021B71BB@ */ ECIPP_ALIGNMENT_UBYTE 255 Compu_IDENTITY 0 255 PHYS_UNIT "FMI" /end CHARACTERISTIC
/begin CHARACTERISTIC FCfmi_PWM15_on_hiVf "FCtl_FMI(444)" VALUE 0x001652CF /* @ECU_Address@FCtl_FMI@0x021B71BC@ */ ECIPP_ALIGNMENT_UBYTE 255 Compu_IDENTITY 0 255 PHYS_UNIT "FMI" /end CHARACTERISTIC
/begin CHARACTERISTIC FCfmi_PWM16_off_loVf "FCtl_FMI(445)" VALUE 0x001652D0 /* @ECU_Address@FCtl_FMI@0x021B71BD@ */ ECIPP_ALIGNMENT_UBYTE 255 Compu_IDENTITY 0 255 PHYS_UNIT "FMI" /end CHARACTERISTIC
/begin CHARACTERISTIC FCfmi_PWM16_on_hiVf "FCtl_FMI(446)" VALUE 0x001652D1 /* @ECU_Address@FCtl_FMI@0x021B71BE@ */ ECIPP_ALIGNMENT_UBYTE 255 Compu_IDENTITY 0 255 PHYS_UNIT "FMI" /end CHARACTERISTIC
/begin CHARACTERISTIC FCfmi_PWM17_off_loVf "FCtl_FMI(447)" VALUE 0x001652D2 /* @ECU_Address@FCtl_FMI@0x021B71BF@ */ ECIPP_ALIGNMENT_UBYTE 255 Compu_IDENTITY 0 255 PHYS_UNIT "FMI" /end CHARACTERISTIC
/begin CHARACTERISTIC FCfmi_PWM17_on_hiVf "FCtl_FMI(448)" VALUE 0x001652D3 /* @ECU_Address@FCtl_FMI@0x021B71C0@ */ ECIPP_ALIGNMENT_UBYTE 255 Compu_IDENTITY 0 255 PHYS_UNIT "FMI" /end CHARACTERISTIC
/begin CHARACTERISTIC FCfmi_PWM18_off_loVf "FCtl_FMI(449)" VALUE 0x001652D4 /* @ECU_Address@FCtl_FMI@0x021B71C1@ */ ECIPP_ALIGNMENT_UBYTE 255 Compu_IDENTITY 0 255 PHYS_UNIT "FMI" /end CHARACTERISTIC
/begin CHARACTERISTIC FCfmi_PWM18_on_hiVf "FCtl_FMI(450)" VALUE 0x001652D5 /* @ECU_Address@FCtl_FMI@0x021B71C2@ */ ECIPP_ALIGNMENT_UBYTE 255 Compu_IDENTITY 0 255 PHYS_UNIT "FMI" /end CHARACTERISTIC
/begin CHARACTERISTIC FCfmi_PWM19_off_loVf "FCtl_FMI(451)" VALUE 0x001652D6 /* @ECU_Address@FCtl_FMI@0x021B71C3@ */ ECIPP_ALIGNMENT_UBYTE 255 Compu_IDENTITY 0 255 PHYS_UNIT "FMI" /end CHARACTERISTIC
/begin CHARACTERISTIC FCfmi_PWM19_on_hiVf "FCtl_FMI(452)" VALUE 0x001652D7 /* @ECU_Address@FCtl_FMI@0x021B71C4@ */ ECIPP_ALIGNMENT_UBYTE 255 Compu_IDENTITY 0 255 PHYS_UNIT "FMI" /end CHARACTERISTIC
/begin CHARACTERISTIC FCfmi_PWM2_off_loVf "FCtl_FMI(191)" VALUE 0x001651D2 /* @ECU_Address@FCtl_FMI@0x021B70BF@ */ ECIPP_ALIGNMENT_UBYTE 255 Compu_IDENTITY 0 255 PHYS_UNIT "FMI" /end CHARACTERISTIC
/begin CHARACTERISTIC FCfmi_PWM2_on_hiVf "FCtl_FMI(192)" VALUE 0x001651D3 /* @ECU_Address@FCtl_FMI@0x021B70C0@ */ ECIPP_ALIGNMENT_UBYTE 255 Compu_IDENTITY 0 255 PHYS_UNIT "FMI" /end CHARACTERISTIC
/begin CHARACTERISTIC FCfmi_PWM20_off_loVf "FCtl_FMI(453)" VALUE 0x001652D8 /* @ECU_Address@FCtl_FMI@0x021B71C5@ */ ECIPP_ALIGNMENT_UBYTE 255 Compu_IDENTITY 0 255 PHYS_UNIT "FMI" /end CHARACTERISTIC
/begin CHARACTERISTIC FCfmi_PWM20_on_hiVf "FCtl_FMI(454)" VALUE 0x001652D9 /* @ECU_Address@FCtl_FMI@0x021B71C6@ */ ECIPP_ALIGNMENT_UBYTE 255 Compu_IDENTITY 0 255 PHYS_UNIT "FMI" /end CHARACTERISTIC
/begin CHARACTERISTIC FCfmi_PWM21_off_loVf "FCtl_FMI(455)" VALUE 0x001652DA /* @ECU_Address@FCtl_FMI@0x021B71C7@ */ ECIPP_ALIGNMENT_UBYTE 255 Compu_IDENTITY 0 255 PHYS_UNIT "FMI" /end CHARACTERISTIC
/begin CHARACTERISTIC FCftb_MJ_Pe_HiExp "FCtl_FTB_0x04(133)" VALUE 0x001654F6 /* @ECU_Address@FCtl_FTB_0x04@0x024C5085@ */ ECIPP_ALIGNMENT_UBYTE 255 Compu_IDENTITY 0 255 PHYS_UNIT "FTB" /end CHARACTERISTIC
/begin CHARACTERISTIC FCftb_MJ_Pe_LoExp "FCtl_FTB_0x04(134)" VALUE 0x001654F7 /* @ECU_Address@FCtl_FTB_0x04@0x024C5086@ */ ECIPP_ALIGNMENT_UBYTE 255 Compu_IDENTITY 0 255 PHYS_UNIT "FTB" /end CHARACTERISTIC
/begin CHARACTERISTIC FCftb_MJ2_comm_tout "FCtl_FTB_0x04(726)" VALUE 0x00165747 /* @ECU_Address@FCtl_FTB_0x04@0x024C52D6@ */ ECIPP_ALIGNMENT_UBYTE 255 Compu_IDENTITY 0 255 PHYS_UNIT "FTB" /end CHARACTERISTIC
/begin CHARACTERISTIC FCftb_MJ2_intF_act "FCtl_FTB_0x04(729)" VALUE 0x0016574A /* @ECU_Address@FCtl_FTB_0x04@0x024C52D9@ */ ECIPP_ALIGNMENT_UBYTE 255 Compu_IDENTITY 0 255 PHYS_UNIT "FTB" /end CHARACTERISTIC
/begin CHARACTERISTIC FCftb_MJ2_intF_circ "FCtl_FTB_0x04(730)" VALUE 0x0016574B /* @ECU_Address@FCtl_FTB_0x04@0x024C52DA@ */ ECIPP_ALIGNMENT_UBYTE 255 Compu_IDENTITY 0 255 PHYS_UNIT "FTB" /end CHARACTERISTIC
/begin CHARACTERISTIC FCftb_MJ2_intF_comm "FCtl_FTB_0x04(731)" VALUE 0x0016574C /* @ECU_Address@FCtl_FTB_0x04@0x024C52DB@ */ ECIPP_ALIGNMENT_UBYTE 255 Compu_IDENTITY 0 255 PHYS_UNIT "FTB" /end CHARACTERISTIC
/begin CHARACTERISTIC FCftb_MJ2_intF_Vhi "FCtl_FTB_0x04(727)" VALUE 0x00165748 /* @ECU_Address@FCtl_FTB_0x04@0x024C52D7@ */ ECIPP_ALIGNMENT_UBYTE 255 Compu_IDENTITY 0 255 PHYS_UNIT "FTB" /end CHARACTERISTIC
/begin CHARACTERISTIC FCftb_MJ2_intF_Vlo "FCtl_FTB_0x04(728)" VALUE 0x00165749 /* @ECU_Address@FCtl_FTB_0x04@0x024C52D8@ */ ECIPP_ALIGNMENT_UBYTE 255 Compu_IDENTITY 0 255 PHYS_UNIT "FTB" /end CHARACTERISTIC
/begin CHARACTERISTIC FCftb_MJ2_Pe_HiExp "FCtl_FTB_0x04(724)" VALUE 0x00165745 /* @ECU_Address@FCtl_FTB_0x04@0x024C52D4@ */ ECIPP_ALIGNMENT_UBYTE 255 Compu_IDENTITY 0 255 PHYS_UNIT "FTB" /end CHARACTERISTIC
/begin CHARACTERISTIC FCftb_MJ2_Pe_LoExp "FCtl_FTB_0x04(725)" VALUE 0x00165746 /* @ECU_Address@FCtl_FTB_0x04@0x024C52D5@ */ ECIPP_ALIGNMENT_UBYTE 255 Compu_IDENTITY 0 255 PHYS_UNIT "FTB" /end CHARACTERISTIC
/begin CHARACTERISTIC FCftb_NOx_hi "FCtl_FTB_0x04(793)" VALUE 0x0016578A /* @ECU_Address@FCtl_FTB_0x04@0x024C5319@ */ ECIPP_ALIGNMENT_UBYTE 255 Compu_IDENTITY 0 255 PHYS_UNIT "FTB" /end CHARACTERISTIC
/begin CHARACTERISTIC FCftb_OilP_hiP "FCtl_FTB_0x04(149)" VALUE 0x00165506 /* @ECU_Address@FCtl_FTB_0x04@0x024C5095@ */ ECIPP_ALIGNMENT_UBYTE 255 Compu_IDENTITY 0 255 PHYS_UNIT "FTB" /end CHARACTERISTIC
/begin CHARACTERISTIC FCftb_OilP_loP "FCtl_FTB_0x04(148)" VALUE 0x00165505 /* @ECU_Address@FCtl_FTB_0x04@0x024C5094@ */ ECIPP_ALIGNMENT_UBYTE 255 Compu_IDENTITY 0 255 PHYS_UNIT "FTB" /end CHARACTERISTIC
/begin CHARACTERISTIC FCftb_OilP_maxV "FCtl_FTB_0x04(150)" VALUE 0x00165507 /* @ECU_Address@FCtl_FTB_0x04@0x024C5096@ */ ECIPP_ALIGNMENT_UBYTE 255 Compu_IDENTITY 0 255 PHYS_UNIT "FTB" /end CHARACTERISTIC
/begin CHARACTERISTIC FCftb_OilP_minV "FCtl_FTB_0x04(151)" VALUE 0x00165508 /* @ECU_Address@FCtl_FTB_0x04@0x024C5097@ */ ECIPP_ALIGNMENT_UBYTE 255 Compu_IDENTITY 0 255 PHYS_UNIT "FTB" /end CHARACTERISTIC
/begin CHARACTERISTIC FCftb_OILP_test "FCtl_FTB_0x04(29)" VALUE 0x0016548E /* @ECU_Address@FCtl_FTB_0x04@0x024C501D@ */ ECIPP_ALIGNMENT_UBYTE 255 Compu_IDENTITY 0 255 PHYS_UNIT "FTB" /end CHARACTERISTIC
/begin CHARACTERISTIC FCftb_OilP2_loP "FCtl_FTB_0x04(293)" VALUE 0x00165596 /* @ECU_Address@FCtl_FTB_0x04@0x024C5125@ */ ECIPP_ALIGNMENT_UBYTE 255 Compu_IDENTITY 0 255 PHYS_UNIT "FTB" /end CHARACTERISTIC
/begin CHARACTERISTIC FCftb_OILTL_loss "FCtl_FTB_0x04(737)" VALUE 0x00165752 /* @ECU_Address@FCtl_FTB_0x04@0x024C52E1@ */ ECIPP_ALIGNMENT_UBYTE 255 Compu_IDENTITY 0 255 PHYS_UNIT "FTB" /end CHARACTERISTIC
/begin CHARACTERISTIC FCftb_OILTL_Lvl_lo "FCtl_FTB_0x04(741)" VALUE 0x00165756 /* @ECU_Address@FCtl_FTB_0x04@0x024C52E5@ */ ECIPP_ALIGNMENT_UBYTE 255 Compu_IDENTITY 0 255 PHYS_UNIT "FTB" /end CHARACTERISTIC
/begin CHARACTERISTIC FCftb_OILTL_Lvl_OOR "FCtl_FTB_0x04(739)" VALUE 0x00165754 /* @ECU_Address@FCtl_FTB_0x04@0x024C52E3@ */ ECIPP_ALIGNMENT_UBYTE 255 Compu_IDENTITY 0 255 PHYS_UNIT "FTB" /end CHARACTERISTIC
/begin CHARACTERISTIC FCftb_OILTL_T_hi "FCtl_FTB_0x04(742)" VALUE 0x00165757 /* @ECU_Address@FCtl_FTB_0x04@0x024C52E6@ */ ECIPP_ALIGNMENT_UBYTE 255 Compu_IDENTITY 0 255 PHYS_UNIT "FTB" /end CHARACTERISTIC
/begin CHARACTERISTIC FCftb_OILTL_T_OOR "FCtl_FTB_0x04(740)" VALUE 0x00165755 /* @ECU_Address@FCtl_FTB_0x04@0x024C52E4@ */ ECIPP_ALIGNMENT_UBYTE 255 Compu_IDENTITY 0 255 PHYS_UNIT "FTB" /end CHARACTERISTIC
/begin CHARACTERISTIC FCftb_OILTL_V_OOR "FCtl_FTB_0x04(738)" VALUE 0x00165753 /* @ECU_Address@FCtl_FTB_0x04@0x024C52E2@ */ ECIPP_ALIGNMENT_UBYTE 255 Compu_IDENTITY 0 255 PHYS_UNIT "FTB" /end CHARACTERISTIC
/begin CHARACTERISTIC FCftb_PAUX_dP1_max "FCtl_FTB_0x04(546)" VALUE 0x00165693 /* @ECU_Address@FCtl_FTB_0x04@0x024C5222@ */ ECIPP_ALIGNMENT_UBYTE 255 Compu_IDENTITY 0 255 PHYS_UNIT "FTB" /end CHARACTERISTIC
/begin CHARACTERISTIC FCftb_PAUX_dP1_min "FCtl_FTB_0x04(547)" VALUE 0x00165694 /* @ECU_Address@FCtl_FTB_0x04@0x024C5223@ */ ECIPP_ALIGNMENT_UBYTE 255 Compu_IDENTITY 0 255 PHYS_UNIT "FTB" /end CHARACTERISTIC
/begin CHARACTERISTIC FCftb_PAUX_dP2_max "FCtl_FTB_0x04(548)" VALUE 0x00165695 /* @ECU_Address@FCtl_FTB_0x04@0x024C5224@ */ ECIPP_ALIGNMENT_UBYTE 255 Compu_IDENTITY 0 255 PHYS_UNIT "FTB" /end CHARACTERISTIC
/begin CHARACTERISTIC FCftb_PAUX_dP2_min "FCtl_FTB_0x04(549)" VALUE 0x00165696 /* @ECU_Address@FCtl_FTB_0x04@0x024C5225@ */ ECIPP_ALIGNMENT_UBYTE 255 Compu_IDENTITY 0 255 PHYS_UNIT "FTB" /end CHARACTERISTIC
/begin CHARACTERISTIC FCftb_PAUX1_max "FCtl_FTB_0x04(538)" VALUE 0x0016568B /* @ECU_Address@FCtl_FTB_0x04@0x024C521A@ */ ECIPP_ALIGNMENT_UBYTE 255 Compu_IDENTITY 0 255 PHYS_UNIT "FTB" /end CHARACTERISTIC
/begin CHARACTERISTIC FCftb_PAUX1_min "FCtl_FTB_0x04(539)" VALUE 0x0016568C /* @ECU_Address@FCtl_FTB_0x04@0x024C521B@ */ ECIPP_ALIGNMENT_UBYTE 255 Compu_IDENTITY 0 255 PHYS_UNIT "FTB" /end CHARACTERISTIC
/begin CHARACTERISTIC FCftb_PAUX2_max "FCtl_FTB_0x04(540)" VALUE 0x0016568D /* @ECU_Address@FCtl_FTB_0x04@0x024C521C@ */ ECIPP_ALIGNMENT_UBYTE 255 Compu_IDENTITY 0 255 PHYS_UNIT "FTB" /end CHARACTERISTIC
/begin CHARACTERISTIC FCftb_PAUX2_min "FCtl_FTB_0x04(541)" VALUE 0x0016568E /* @ECU_Address@FCtl_FTB_0x04@0x024C521D@ */ ECIPP_ALIGNMENT_UBYTE 255 Compu_IDENTITY 0 255 PHYS_UNIT "FTB" /end CHARACTERISTIC
/begin CHARACTERISTIC FCftb_PAUX3_max "FCtl_FTB_0x04(542)" VALUE 0x0016568F /* @ECU_Address@FCtl_FTB_0x04@0x024C521E@ */ ECIPP_ALIGNMENT_UBYTE 255 Compu_IDENTITY 0 255 PHYS_UNIT "FTB" /end CHARACTERISTIC
/begin CHARACTERISTIC FCftb_PAUX3_min "FCtl_FTB_0x04(543)" VALUE 0x00165690 /* @ECU_Address@FCtl_FTB_0x04@0x024C521F@ */ ECIPP_ALIGNMENT_UBYTE 255 Compu_IDENTITY 0 255 PHYS_UNIT "FTB" /end CHARACTERISTIC
/begin CHARACTERISTIC FCftb_PAUX4_max "FCtl_FTB_0x04(544)" VALUE 0x00165691 /* @ECU_Address@FCtl_FTB_0x04@0x024C5220@ */ ECIPP_ALIGNMENT_UBYTE 255 Compu_IDENTITY 0 255 PHYS_UNIT "FTB" /end CHARACTERISTIC
/begin CHARACTERISTIC FCftb_PAUX4_min "FCtl_FTB_0x04(545)" VALUE 0x00165692 /* @ECU_Address@FCtl_FTB_0x04@0x024C5221@ */ ECIPP_ALIGNMENT_UBYTE 255 Compu_IDENTITY 0 255 PHYS_UNIT "FTB" /end CHARACTERISTIC
/begin CHARACTERISTIC FCftb_PPEG_BP "FCtl_FTB_0x04(670)" VALUE 0x0016570F /* @ECU_Address@FCtl_FTB_0x04@0x024C529E@ */ ECIPP_ALIGNMENT_UBYTE 255 Compu_IDENTITY 0 255 PHYS_UNIT "FTB" /end CHARACTERISTIC
/begin CHARACTERISTIC FCftb_PPEG_CVP1 "FCtl_FTB_0x04(745)" VALUE 0x0016575A /* @ECU_Address@FCtl_FTB_0x04@0x024C52E9@ */ ECIPP_ALIGNMENT_UBYTE 255 Compu_IDENTITY 0 255 PHYS_UNIT "FTB" /end CHARACTERISTIC
/begin CHARACTERISTIC FCftb_PPEG_CVP2 "FCtl_FTB_0x04(746)" VALUE 0x0016575B /* @ECU_Address@FCtl_FTB_0x04@0x024C52EA@ */ ECIPP_ALIGNMENT_UBYTE 255 Compu_IDENTITY 0 255 PHYS_UNIT "FTB" /end CHARACTERISTIC
/begin CHARACTERISTIC FCftb_PPEG_EBP "FCtl_FTB_0x04(671)" VALUE 0x00165710 /* @ECU_Address@FCtl_FTB_0x04@0x024C529F@ */ ECIPP_ALIGNMENT_UBYTE 255 Compu_IDENTITY 0 255 PHYS_UNIT "FTB" /end CHARACTERISTIC
/begin CHARACTERISTIC FCftb_PPEG_EGRdP "FCtl_FTB_0x04(756)" VALUE 0x00165765 /* @ECU_Address@FCtl_FTB_0x04@0x024C52F4@ */ ECIPP_ALIGNMENT_UBYTE 255 Compu_IDENTITY 0 255 PHYS_UNIT "FTB" /end CHARACTERISTIC
/begin CHARACTERISTIC FCftb_PPEG_EGRHP "FCtl_FTB_0x04(673)" VALUE 0x00165712 /* @ECU_Address@FCtl_FTB_0x04@0x024C52A1@ */ ECIPP_ALIGNMENT_UBYTE 255 Compu_IDENTITY 0 255 PHYS_UNIT "FTB" /end CHARACTERISTIC
/begin CHARACTERISTIC FCftb_PPEG_EGRLP "FCtl_FTB_0x04(672)" VALUE 0x00165711 /* @ECU_Address@FCtl_FTB_0x04@0x024C52A0@ */ ECIPP_ALIGNMENT_UBYTE 255 Compu_IDENTITY 0 255 PHYS_UNIT "FTB" /end CHARACTERISTIC
/begin CHARACTERISTIC FCftb_PPEG_EGRwrP "FCtl_FTB_0x04(675)" VALUE 0x00165714 /* @ECU_Address@FCtl_FTB_0x04@0x024C52A3@ */ ECIPP_ALIGNMENT_UBYTE 255 Compu_IDENTITY 0 255 PHYS_UNIT "FTB" /end CHARACTERISTIC
/begin CHARACTERISTIC FCftb_PPEG_MAP "FCtl_FTB_0x04(676)" VALUE 0x00165715 /* @ECU_Address@FCtl_FTB_0x04@0x024C52A4@ */ ECIPP_ALIGNMENT_UBYTE 255 Compu_IDENTITY 0 255 PHYS_UNIT "FTB" /end CHARACTERISTIC
/begin CHARACTERISTIC FCftb_PPEG_TIP "FCtl_FTB_0x04(674)" VALUE 0x00165713 /* @ECU_Address@FCtl_FTB_0x04@0x024C52A2@ */ ECIPP_ALIGNMENT_UBYTE 255 Compu_IDENTITY 0 255 PHYS_UNIT "FTB" /end CHARACTERISTIC
/begin CHARACTERISTIC FCftb_PWM1_off_loVf "FCtl_FTB_0x04(189)" VALUE 0x0016552E /* @ECU_Address@FCtl_FTB_0x04@0x024C50BD@ */ ECIPP_ALIGNMENT_UBYTE 255 Compu_IDENTITY 0 255 PHYS_UNIT "FTB" /end CHARACTERISTIC
/begin CHARACTERISTIC FCftb_PWM1_on_hiVf "FCtl_FTB_0x04(190)" VALUE 0x0016552F /* @ECU_Address@FCtl_FTB_0x04@0x024C50BE@ */ ECIPP_ALIGNMENT_UBYTE 255 Compu_IDENTITY 0 255 PHYS_UNIT "FTB" /end CHARACTERISTIC
/begin CHARACTERISTIC FCftb_PWM10_off_loVf "FCtl_FTB_0x04(433)" VALUE 0x00165622 /* @ECU_Address@FCtl_FTB_0x04@0x024C51B1@ */ ECIPP_ALIGNMENT_UBYTE 255 Compu_IDENTITY 0 255 PHYS_UNIT "FTB" /end CHARACTERISTIC
/begin CHARACTERISTIC FCftb_PWM10_on_hiVf "FCtl_FTB_0x04(434)" VALUE 0x00165623 /* @ECU_Address@FCtl_FTB_0x04@0x024C51B2@ */ ECIPP_ALIGNMENT_UBYTE 255 Compu_IDENTITY 0 255 PHYS_UNIT "FTB" /end CHARACTERISTIC
/begin CHARACTERISTIC FCftb_PWM11_off_loVf "FCtl_FTB_0x04(435)" VALUE 0x00165624 /* @ECU_Address@FCtl_FTB_0x04@0x024C51B3@ */ ECIPP_ALIGNMENT_UBYTE 255 Compu_IDENTITY 0 255 PHYS_UNIT "FTB" /end CHARACTERISTIC
/begin CHARACTERISTIC FCftb_PWM11_on_hiVf "FCtl_FTB_0x04(436)" VALUE 0x00165625 /* @ECU_Address@FCtl_FTB_0x04@0x024C51B4@ */ ECIPP_ALIGNMENT_UBYTE 255 Compu_IDENTITY 0 255 PHYS_UNIT "FTB" /end CHARACTERISTIC
/begin CHARACTERISTIC FCftb_PWM12_off_loVf "FCtl_FTB_0x04(437)" VALUE 0x00165626 /* @ECU_Address@FCtl_FTB_0x04@0x024C51B5@ */ ECIPP_ALIGNMENT_UBYTE 255 Compu_IDENTITY 0 255 PHYS_UNIT "FTB" /end CHARACTERISTIC
/begin CHARACTERISTIC FCftb_PWM12_on_hiVf "FCtl_FTB_0x04(438)" VALUE 0x00165627 /* @ECU_Address@FCtl_FTB_0x04@0x024C51B6@ */ ECIPP_ALIGNMENT_UBYTE 255 Compu_IDENTITY 0 255 PHYS_UNIT "FTB" /end CHARACTERISTIC
/begin CHARACTERISTIC FCftb_PWM13_off_loVf "FCtl_FTB_0x04(439)" VALUE 0x00165628 /* @ECU_Address@FCtl_FTB_0x04@0x024C51B7@ */ ECIPP_ALIGNMENT_UBYTE 255 Compu_IDENTITY 0 255 PHYS_UNIT "FTB" /end CHARACTERISTIC
/begin CHARACTERISTIC FCftb_PWM13_on_hiVf "FCtl_FTB_0x04(440)" VALUE 0x00165629 /* @ECU_Address@FCtl_FTB_0x04@0x024C51B8@ */ ECIPP_ALIGNMENT_UBYTE 255 Compu_IDENTITY 0 255 PHYS_UNIT "FTB" /end CHARACTERISTIC
/begin CHARACTERISTIC FCftb_PWM14_off_loVf "FCtl_FTB_0x04(441)" VALUE 0x0016562A /* @ECU_Address@FCtl_FTB_0x04@0x024C51B9@ */ ECIPP_ALIGNMENT_UBYTE 255 Compu_IDENTITY 0 255 PHYS_UNIT "FTB" /end CHARACTERISTIC
/begin CHARACTERISTIC FCftb_PWM14_on_hiVf "FCtl_FTB_0x04(442)" VALUE 0x0016562B /* @ECU_Address@FCtl_FTB_0x04@0x024C51BA@ */ ECIPP_ALIGNMENT_UBYTE 255 Compu_IDENTITY 0 255 PHYS_UNIT "FTB" /end CHARACTERISTIC
/begin CHARACTERISTIC FCftb_PWM15_off_loVf "FCtl_FTB_0x04(443)" VALUE 0x0016562C /* @ECU_Address@FCtl_FTB_0x04@0x024C51BB@ */ ECIPP_ALIGNMENT_UBYTE 255 Compu_IDENTITY 0 255 PHYS_UNIT "FTB" /end CHARACTERISTIC
/begin CHARACTERISTIC FCftb_PWM15_on_hiVf "FCtl_FTB_0x04(444)" VALUE 0x0016562D /* @ECU_Address@FCtl_FTB_0x04@0x024C51BC@ */ ECIPP_ALIGNMENT_UBYTE 255 Compu_IDENTITY 0 255 PHYS_UNIT "FTB" /end CHARACTERISTIC
/begin CHARACTERISTIC FCftb_PWM16_off_loVf "FCtl_FTB_0x04(445)" VALUE 0x0016562E /* @ECU_Address@FCtl_FTB_0x04@0x024C51BD@ */ ECIPP_ALIGNMENT_UBYTE 255 Compu_IDENTITY 0 255 PHYS_UNIT "FTB" /end CHARACTERISTIC
/begin CHARACTERISTIC FCftb_PWM16_on_hiVf "FCtl_FTB_0x04(446)" VALUE 0x0016562F /* @ECU_Address@FCtl_FTB_0x04@0x024C51BE@ */ ECIPP_ALIGNMENT_UBYTE 255 Compu_IDENTITY 0 255 PHYS_UNIT "FTB" /end CHARACTERISTIC
/begin CHARACTERISTIC FCftb_PWM17_off_loVf "FCtl_FTB_0x04(447)" VALUE 0x00165630 /* @ECU_Address@FCtl_FTB_0x04@0x024C51BF@ */ ECIPP_ALIGNMENT_UBYTE 255 Compu_IDENTITY 0 255 PHYS_UNIT "FTB" /end CHARACTERISTIC
/begin CHARACTERISTIC FCftb_PWM17_on_hiVf "FCtl_FTB_0x04(448)" VALUE 0x00165631 /* @ECU_Address@FCtl_FTB_0x04@0x024C51C0@ */ ECIPP_ALIGNMENT_UBYTE 255 Compu_IDENTITY 0 255 PHYS_UNIT "FTB" /end CHARACTERISTIC
/begin CHARACTERISTIC FCftb_PWM18_off_loVf "FCtl_FTB_0x04(449)" VALUE 0x00165632 /* @ECU_Address@FCtl_FTB_0x04@0x024C51C1@ */ ECIPP_ALIGNMENT_UBYTE 255 Compu_IDENTITY 0 255 PHYS_UNIT "FTB" /end CHARACTERISTIC
/begin CHARACTERISTIC FCftb_PWM18_on_hiVf "FCtl_FTB_0x04(450)" VALUE 0x00165633 /* @ECU_Address@FCtl_FTB_0x04@0x024C51C2@ */ ECIPP_ALIGNMENT_UBYTE 255 Compu_IDENTITY 0 255 PHYS_UNIT "FTB" /end CHARACTERISTIC
/begin CHARACTERISTIC FCftb_PWM19_off_loVf "FCtl_FTB_0x04(451)" VALUE 0x00165634 /* @ECU_Address@FCtl_FTB_0x04@0x024C51C3@ */ ECIPP_ALIGNMENT_UBYTE 255 Compu_IDENTITY 0 255 PHYS_UNIT "FTB" /end CHARACTERISTIC
/begin CHARACTERISTIC FCftb_PWM19_on_hiVf "FCtl_FTB_0x04(452)" VALUE 0x00165635 /* @ECU_Address@FCtl_FTB_0x04@0x024C51C4@ */ ECIPP_ALIGNMENT_UBYTE 255 Compu_IDENTITY 0 255 PHYS_UNIT "FTB" /end CHARACTERISTIC
/begin CHARACTERISTIC FCftb_PWM2_off_loVf "FCtl_FTB_0x04(191)" VALUE 0x00165530 /* @ECU_Address@FCtl_FTB_0x04@0x024C50BF@ */ ECIPP_ALIGNMENT_UBYTE 255 Compu_IDENTITY 0 255 PHYS_UNIT "FTB" /end CHARACTERISTIC
/begin CHARACTERISTIC FCftb_PWM2_on_hiVf "FCtl_FTB_0x04(192)" VALUE 0x00165531 /* @ECU_Address@FCtl_FTB_0x04@0x024C50C0@ */ ECIPP_ALIGNMENT_UBYTE 255 Compu_IDENTITY 0 255 PHYS_UNIT "FTB" /end CHARACTERISTIC
/begin CHARACTERISTIC FCftb_PWM20_off_loVf "FCtl_FTB_0x04(453)" VALUE 0x00165636 /* @ECU_Address@FCtl_FTB_0x04@0x024C51C5@ */ ECIPP_ALIGNMENT_UBYTE 255 Compu_IDENTITY 0 255 PHYS_UNIT "FTB" /end CHARACTERISTIC
/begin CHARACTERISTIC FCftb_PWM20_on_hiVf "FCtl_FTB_0x04(454)" VALUE 0x00165637 /* @ECU_Address@FCtl_FTB_0x04@0x024C51C6@ */ ECIPP_ALIGNMENT_UBYTE 255 Compu_IDENTITY 0 255 PHYS_UNIT "FTB" /end CHARACTERISTIC
/begin CHARACTERISTIC FCftb_PWM21_off_loVf "FCtl_FTB_0x04(455)" VALUE 0x00165638 /* @ECU_Address@FCtl_FTB_0x04@0x024C51C7@ */ ECIPP_ALIGNMENT_UBYTE 255 Compu_IDENTITY 0 255 PHYS_UNIT "FTB" /end CHARACTERISTIC
/begin CHARACTERISTIC FCspn_MJ_Pe_HiExp "FCtl_SPN(133)" VALUE 0x00161EF0 /* @ECU_Address@FCtl_SPN@0x021B6214@ */ ECIPP_ALIGNMENT_ULONG 4294967295 Compu_IDENTITY 0 4294967295 PHYS_UNIT "SPN" /end CHARACTERISTIC
/begin CHARACTERISTIC FCspn_MJ_Pe_LoExp "FCtl_SPN(134)" VALUE 0x00161EF4 /* @ECU_Address@FCtl_SPN@0x021B6218@ */ ECIPP_ALIGNMENT_ULONG 4294967295 Compu_IDENTITY 0 4294967295 PHYS_UNIT "SPN" /end CHARACTERISTIC
/begin CHARACTERISTIC FCspn_MJ2_comm_tout "FCtl_SPN(726)" VALUE 0x00162834 /* @ECU_Address@FCtl_SPN@0x021B6B58@ */ ECIPP_ALIGNMENT_ULONG 4294967295 Compu_IDENTITY 0 4294967295 PHYS_UNIT "SPN" /end CHARACTERISTIC
/begin CHARACTERISTIC FCspn_MJ2_intF_act "FCtl_SPN(729)" VALUE 0x00162840 /* @ECU_Address@FCtl_SPN@0x021B6B64@ */ ECIPP_ALIGNMENT_ULONG 4294967295 Compu_IDENTITY 0 4294967295 PHYS_UNIT "SPN" /end CHARACTERISTIC
/begin CHARACTERISTIC FCspn_MJ2_intF_circ "FCtl_SPN(730)" VALUE 0x00162844 /* @ECU_Address@FCtl_SPN@0x021B6B68@ */ ECIPP_ALIGNMENT_ULONG 4294967295 Compu_IDENTITY 0 4294967295 PHYS_UNIT "SPN" /end CHARACTERISTIC
/begin CHARACTERISTIC FCspn_MJ2_intF_comm "FCtl_SPN(731)" VALUE 0x00162848 /* @ECU_Address@FCtl_SPN@0x021B6B6C@ */ ECIPP_ALIGNMENT_ULONG 4294967295 Compu_IDENTITY 0 4294967295 PHYS_UNIT "SPN" /end CHARACTERISTIC
/begin CHARACTERISTIC FCspn_MJ2_intF_Vhi "FCtl_SPN(727)" VALUE 0x00162838 /* @ECU_Address@FCtl_SPN@0x021B6B5C@ */ ECIPP_ALIGNMENT_ULONG 4294967295 Compu_IDENTITY 0 4294967295 PHYS_UNIT "SPN" /end CHARACTERISTIC
/begin CHARACTERISTIC FCspn_MJ2_intF_Vlo "FCtl_SPN(728)" VALUE 0x0016283C /* @ECU_Address@FCtl_SPN@0x021B6B60@ */ ECIPP_ALIGNMENT_ULONG 4294967295 Compu_IDENTITY 0 4294967295 PHYS_UNIT "SPN" /end CHARACTERISTIC
/begin CHARACTERISTIC FCspn_MJ2_Pe_HiExp "FCtl_SPN(724)" VALUE 0x0016282C /* @ECU_Address@FCtl_SPN@0x021B6B50@ */ ECIPP_ALIGNMENT_ULONG 4294967295 Compu_IDENTITY 0 4294967295 PHYS_UNIT "SPN" /end CHARACTERISTIC
/begin CHARACTERISTIC FCspn_MJ2_Pe_LoExp "FCtl_SPN(725)" VALUE 0x00162830 /* @ECU_Address@FCtl_SPN@0x021B6B54@ */ ECIPP_ALIGNMENT_ULONG 4294967295 Compu_IDENTITY 0 4294967295 PHYS_UNIT "SPN" /end CHARACTERISTIC
/begin CHARACTERISTIC FCspn_NOx_hi "FCtl_SPN(793)" VALUE 0x00162940 /* @ECU_Address@FCtl_SPN@0x021B6C64@ */ ECIPP_ALIGNMENT_ULONG 4294967295 Compu_IDENTITY 0 4294967295 PHYS_UNIT "SPN" /end CHARACTERISTIC
/begin CHARACTERISTIC FCspn_OilP_hiP "FCtl_SPN(149)" VALUE 0x00161F30 /* @ECU_Address@FCtl_SPN@0x021B6254@ */ ECIPP_ALIGNMENT_ULONG 4294967295 Compu_IDENTITY 0 4294967295 PHYS_UNIT "SPN" /end CHARACTERISTIC
/begin CHARACTERISTIC FCspn_OilP_loP "FCtl_SPN(148)" VALUE 0x00161F2C /* @ECU_Address@FCtl_SPN@0x021B6250@ */ ECIPP_ALIGNMENT_ULONG 4294967295 Compu_IDENTITY 0 4294967295 PHYS_UNIT "SPN" /end CHARACTERISTIC
/begin CHARACTERISTIC FCspn_OilP_maxV "FCtl_SPN(150)" VALUE 0x00161F34 /* @ECU_Address@FCtl_SPN@0x021B6258@ */ ECIPP_ALIGNMENT_ULONG 4294967295 Compu_IDENTITY 0 4294967295 PHYS_UNIT "SPN" /end CHARACTERISTIC
/begin CHARACTERISTIC FCspn_OilP_minV "FCtl_SPN(151)" VALUE 0x00161F38 /* @ECU_Address@FCtl_SPN@0x021B625C@ */ ECIPP_ALIGNMENT_ULONG 4294967295 Compu_IDENTITY 0 4294967295 PHYS_UNIT "SPN" /end CHARACTERISTIC
/begin CHARACTERISTIC FCspn_OILP_test "FCtl_SPN(29)" VALUE 0x00161D50 /* @ECU_Address@FCtl_SPN@0x021B6074@ */ ECIPP_ALIGNMENT_ULONG 4294967295 Compu_IDENTITY 0 4294967295 PHYS_UNIT "SPN" /end CHARACTERISTIC
/begin CHARACTERISTIC FCspn_OilP2_loP "FCtl_SPN(293)" VALUE 0x00162170 /* @ECU_Address@FCtl_SPN@0x021B6494@ */ ECIPP_ALIGNMENT_ULONG 4294967295 Compu_IDENTITY 0 4294967295 PHYS_UNIT "SPN" /end CHARACTERISTIC
/begin CHARACTERISTIC FCspn_OILTL_loss "FCtl_SPN(737)" VALUE 0x00162860 /* @ECU_Address@FCtl_SPN@0x021B6B84@ */ ECIPP_ALIGNMENT_ULONG 4294967295 Compu_IDENTITY 0 4294967295 PHYS_UNIT "SPN" /end CHARACTERISTIC
/begin CHARACTERISTIC FCspn_OILTL_Lvl_lo "FCtl_SPN(741)" VALUE 0x00162870 /* @ECU_Address@FCtl_SPN@0x021B6B94@ */ ECIPP_ALIGNMENT_ULONG 4294967295 Compu_IDENTITY 0 4294967295 PHYS_UNIT "SPN" /end CHARACTERISTIC
/begin CHARACTERISTIC FCspn_OILTL_Lvl_OOR "FCtl_SPN(739)" VALUE 0x00162868 /* @ECU_Address@FCtl_SPN@0x021B6B8C@ */ ECIPP_ALIGNMENT_ULONG 4294967295 Compu_IDENTITY 0 4294967295 PHYS_UNIT "SPN" /end CHARACTERISTIC
/begin CHARACTERISTIC FCspn_OILTL_T_hi "FCtl_SPN(742)" VALUE 0x00162874 /* @ECU_Address@FCtl_SPN@0x021B6B98@ */ ECIPP_ALIGNMENT_ULONG 4294967295 Compu_IDENTITY 0 4294967295 PHYS_UNIT "SPN" /end CHARACTERISTIC
/begin CHARACTERISTIC FCspn_OILTL_T_OOR "FCtl_SPN(740)" VALUE 0x0016286C /* @ECU_Address@FCtl_SPN@0x021B6B90@ */ ECIPP_ALIGNMENT_ULONG 4294967295 Compu_IDENTITY 0 4294967295 PHYS_UNIT "SPN" /end CHARACTERISTIC
/begin CHARACTERISTIC FCspn_OILTL_V_OOR "FCtl_SPN(738)" VALUE 0x00162864 /* @ECU_Address@FCtl_SPN@0x021B6B88@ */ ECIPP_ALIGNMENT_ULONG 4294967295 Compu_IDENTITY 0 4294967295 PHYS_UNIT "SPN" /end CHARACTERISTIC
/begin CHARACTERISTIC FCspn_PAUX_dP1_max "FCtl_SPN(546)" VALUE 0x00162564 /* @ECU_Address@FCtl_SPN@0x021B6888@ */ ECIPP_ALIGNMENT_ULONG 4294967295 Compu_IDENTITY 0 4294967295 PHYS_UNIT "SPN" /end CHARACTERISTIC
/begin CHARACTERISTIC FCspn_PAUX_dP1_min "FCtl_SPN(547)" VALUE 0x00162568 /* @ECU_Address@FCtl_SPN@0x021B688C@ */ ECIPP_ALIGNMENT_ULONG 4294967295 Compu_IDENTITY 0 4294967295 PHYS_UNIT "SPN" /end CHARACTERISTIC
/begin CHARACTERISTIC FCspn_PAUX_dP2_max "FCtl_SPN(548)" VALUE 0x0016256C /* @ECU_Address@FCtl_SPN@0x021B6890@ */ ECIPP_ALIGNMENT_ULONG 4294967295 Compu_IDENTITY 0 4294967295 PHYS_UNIT "SPN" /end CHARACTERISTIC
/begin CHARACTERISTIC FCspn_PAUX_dP2_min "FCtl_SPN(549)" VALUE 0x00162570 /* @ECU_Address@FCtl_SPN@0x021B6894@ */ ECIPP_ALIGNMENT_ULONG 4294967295 Compu_IDENTITY 0 4294967295 PHYS_UNIT "SPN" /end CHARACTERISTIC
/begin CHARACTERISTIC FCspn_PAUX1_max "FCtl_SPN(538)" VALUE 0x00162544 /* @ECU_Address@FCtl_SPN@0x021B6868@ */ ECIPP_ALIGNMENT_ULONG 4294967295 Compu_IDENTITY 0 4294967295 PHYS_UNIT "SPN" /end CHARACTERISTIC
/begin CHARACTERISTIC FCspn_PAUX1_min "FCtl_SPN(539)" VALUE 0x00162548 /* @ECU_Address@FCtl_SPN@0x021B686C@ */ ECIPP_ALIGNMENT_ULONG 4294967295 Compu_IDENTITY 0 4294967295 PHYS_UNIT "SPN" /end CHARACTERISTIC
/begin CHARACTERISTIC FCspn_PAUX2_max "FCtl_SPN(540)" VALUE 0x0016254C /* @ECU_Address@FCtl_SPN@0x021B6870@ */ ECIPP_ALIGNMENT_ULONG 4294967295 Compu_IDENTITY 0 4294967295 PHYS_UNIT "SPN" /end CHARACTERISTIC
/begin CHARACTERISTIC FCspn_PAUX2_min "FCtl_SPN(541)" VALUE 0x00162550 /* @ECU_Address@FCtl_SPN@0x021B6874@ */ ECIPP_ALIGNMENT_ULONG 4294967295 Compu_IDENTITY 0 4294967295 PHYS_UNIT "SPN" /end CHARACTERISTIC
/begin CHARACTERISTIC FCspn_PAUX3_max "FCtl_SPN(542)" VALUE 0x00162554 /* @ECU_Address@FCtl_SPN@0x021B6878@ */ ECIPP_ALIGNMENT_ULONG 4294967295 Compu_IDENTITY 0 4294967295 PHYS_UNIT "SPN" /end CHARACTERISTIC
/begin CHARACTERISTIC FCspn_PAUX3_min "FCtl_SPN(543)" VALUE 0x00162558 /* @ECU_Address@FCtl_SPN@0x021B687C@ */ ECIPP_ALIGNMENT_ULONG 4294967295 Compu_IDENTITY 0 4294967295 PHYS_UNIT "SPN" /end CHARACTERISTIC
/begin CHARACTERISTIC FCspn_PAUX4_max "FCtl_SPN(544)" VALUE 0x0016255C /* @ECU_Address@FCtl_SPN@0x021B6880@ */ ECIPP_ALIGNMENT_ULONG 4294967295 Compu_IDENTITY 0 4294967295 PHYS_UNIT "SPN" /end CHARACTERISTIC
/begin CHARACTERISTIC FCspn_PAUX4_min "FCtl_SPN(545)" VALUE 0x00162560 /* @ECU_Address@FCtl_SPN@0x021B6884@ */ ECIPP_ALIGNMENT_ULONG 4294967295 Compu_IDENTITY 0 4294967295 PHYS_UNIT "SPN" /end CHARACTERISTIC
/begin CHARACTERISTIC FCspn_PPEG_BP "FCtl_SPN(670)" VALUE 0x00162754 /* @ECU_Address@FCtl_SPN@0x021B6A78@ */ ECIPP_ALIGNMENT_ULONG 4294967295 Compu_IDENTITY 0 4294967295 PHYS_UNIT "SPN" /end CHARACTERISTIC
/begin CHARACTERISTIC FCspn_PPEG_CVP1 "FCtl_SPN(745)" VALUE 0x00162880 /* @ECU_Address@FCtl_SPN@0x021B6BA4@ */ ECIPP_ALIGNMENT_ULONG 4294967295 Compu_IDENTITY 0 4294967295 PHYS_UNIT "SPN" /end CHARACTERISTIC
/begin CHARACTERISTIC FCspn_PPEG_CVP2 "FCtl_SPN(746)" VALUE 0x00162884 /* @ECU_Address@FCtl_SPN@0x021B6BA8@ */ ECIPP_ALIGNMENT_ULONG 4294967295 Compu_IDENTITY 0 4294967295 PHYS_UNIT "SPN" /end CHARACTERISTIC
/begin CHARACTERISTIC FCspn_PPEG_EBP "FCtl_SPN(671)" VALUE 0x00162758 /* @ECU_Address@FCtl_SPN@0x021B6A7C@ */ ECIPP_ALIGNMENT_ULONG 4294967295 Compu_IDENTITY 0 4294967295 PHYS_UNIT "SPN" /end CHARACTERISTIC
/begin CHARACTERISTIC FCspn_PPEG_EGRdP "FCtl_SPN(756)" VALUE 0x001628AC /* @ECU_Address@FCtl_SPN@0x021B6BD0@ */ ECIPP_ALIGNMENT_ULONG 4294967295 Compu_IDENTITY 0 4294967295 PHYS_UNIT "SPN" /end CHARACTERISTIC
/begin CHARACTERISTIC FCspn_PPEG_EGRHP "FCtl_SPN(673)" VALUE 0x00162760 /* @ECU_Address@FCtl_SPN@0x021B6A84@ */ ECIPP_ALIGNMENT_ULONG 4294967295 Compu_IDENTITY 0 4294967295 PHYS_UNIT "SPN" /end CHARACTERISTIC
/begin CHARACTERISTIC FCspn_PPEG_EGRLP "FCtl_SPN(672)" VALUE 0x0016275C /* @ECU_Address@FCtl_SPN@0x021B6A80@ */ ECIPP_ALIGNMENT_ULONG 4294967295 Compu_IDENTITY 0 4294967295 PHYS_UNIT "SPN" /end CHARACTERISTIC
/begin CHARACTERISTIC FCspn_PPEG_EGRwrP "FCtl_SPN(675)" VALUE 0x00162768 /* @ECU_Address@FCtl_SPN@0x021B6A8C@ */ ECIPP_ALIGNMENT_ULONG 4294967295 Compu_IDENTITY 0 4294967295 PHYS_UNIT "SPN" /end CHARACTERISTIC
/begin CHARACTERISTIC FCspn_PPEG_MAP "FCtl_SPN(676)" VALUE 0x0016276C /* @ECU_Address@FCtl_SPN@0x021B6A90@ */ ECIPP_ALIGNMENT_ULONG 4294967295 Compu_IDENTITY 0 4294967295 PHYS_UNIT "SPN" /end CHARACTERISTIC
/begin CHARACTERISTIC FCspn_PPEG_TIP "FCtl_SPN(674)" VALUE 0x00162764 /* @ECU_Address@FCtl_SPN@0x021B6A88@ */ ECIPP_ALIGNMENT_ULONG 4294967295 Compu_IDENTITY 0 4294967295 PHYS_UNIT "SPN" /end CHARACTERISTIC
/begin CHARACTERISTIC FCspn_PWM1_off_loVf "FCtl_SPN(189)" VALUE 0x00161FD0 /* @ECU_Address@FCtl_SPN@0x021B62F4@ */ ECIPP_ALIGNMENT_ULONG 4294967295 Compu_IDENTITY 0 4294967295 PHYS_UNIT "SPN" /end CHARACTERISTIC
/begin CHARACTERISTIC FCspn_PWM1_on_hiVf "FCtl_SPN(190)" VALUE 0x00161FD4 /* @ECU_Address@FCtl_SPN@0x021B62F8@ */ ECIPP_ALIGNMENT_ULONG 4294967295 Compu_IDENTITY 0 4294967295 PHYS_UNIT "SPN" /end CHARACTERISTIC
/begin CHARACTERISTIC FCspn_PWM10_off_loVf "FCtl_SPN(433)" VALUE 0x001623A0 /* @ECU_Address@FCtl_SPN@0x021B66C4@ */ ECIPP_ALIGNMENT_ULONG 4294967295 Compu_IDENTITY 0 4294967295 PHYS_UNIT "SPN" /end CHARACTERISTIC
/begin CHARACTERISTIC FCspn_PWM10_on_hiVf "FCtl_SPN(434)" VALUE 0x001623A4 /* @ECU_Address@FCtl_SPN@0x021B66C8@ */ ECIPP_ALIGNMENT_ULONG 4294967295 Compu_IDENTITY 0 4294967295 PHYS_UNIT "SPN" /end CHARACTERISTIC
/begin CHARACTERISTIC FCspn_PWM11_off_loVf "FCtl_SPN(435)" VALUE 0x001623A8 /* @ECU_Address@FCtl_SPN@0x021B66CC@ */ ECIPP_ALIGNMENT_ULONG 4294967295 Compu_IDENTITY 0 4294967295 PHYS_UNIT "SPN" /end CHARACTERISTIC
/begin CHARACTERISTIC FCspn_PWM11_on_hiVf "FCtl_SPN(436)" VALUE 0x001623AC /* @ECU_Address@FCtl_SPN@0x021B66D0@ */ ECIPP_ALIGNMENT_ULONG 4294967295 Compu_IDENTITY 0 4294967295 PHYS_UNIT "SPN" /end CHARACTERISTIC
/begin CHARACTERISTIC FCspn_PWM12_off_loVf "FCtl_SPN(437)" VALUE 0x001623B0 /* @ECU_Address@FCtl_SPN@0x021B66D4@ */ ECIPP_ALIGNMENT_ULONG 4294967295 Compu_IDENTITY 0 4294967295 PHYS_UNIT "SPN" /end CHARACTERISTIC
/begin CHARACTERISTIC FCspn_PWM12_on_hiVf "FCtl_SPN(438)" VALUE 0x001623B4 /* @ECU_Address@FCtl_SPN@0x021B66D8@ */ ECIPP_ALIGNMENT_ULONG 4294967295 Compu_IDENTITY 0 4294967295 PHYS_UNIT "SPN" /end CHARACTERISTIC
/begin CHARACTERISTIC FCspn_PWM13_off_loVf "FCtl_SPN(439)" VALUE 0x001623B8 /* @ECU_Address@FCtl_SPN@0x021B66DC@ */ ECIPP_ALIGNMENT_ULONG 4294967295 Compu_IDENTITY 0 4294967295 PHYS_UNIT "SPN" /end CHARACTERISTIC
/begin CHARACTERISTIC FCspn_PWM13_on_hiVf "FCtl_SPN(440)" VALUE 0x001623BC /* @ECU_Address@FCtl_SPN@0x021B66E0@ */ ECIPP_ALIGNMENT_ULONG 4294967295 Compu_IDENTITY 0 4294967295 PHYS_UNIT "SPN" /end CHARACTERISTIC
/begin CHARACTERISTIC FCspn_PWM14_off_loVf "FCtl_SPN(441)" VALUE 0x001623C0 /* @ECU_Address@FCtl_SPN@0x021B66E4@ */ ECIPP_ALIGNMENT_ULONG 4294967295 Compu_IDENTITY 0 4294967295 PHYS_UNIT "SPN" /end CHARACTERISTIC
/begin CHARACTERISTIC FCspn_PWM14_on_hiVf "FCtl_SPN(442)" VALUE 0x001623C4 /* @ECU_Address@FCtl_SPN@0x021B66E8@ */ ECIPP_ALIGNMENT_ULONG 4294967295 Compu_IDENTITY 0 4294967295 PHYS_UNIT "SPN" /end CHARACTERISTIC
/begin CHARACTERISTIC FCspn_PWM15_off_loVf "FCtl_SPN(443)" VALUE 0x001623C8 /* @ECU_Address@FCtl_SPN@0x021B66EC@ */ ECIPP_ALIGNMENT_ULONG 4294967295 Compu_IDENTITY 0 4294967295 PHYS_UNIT "SPN" /end CHARACTERISTIC
/begin CHARACTERISTIC FCspn_PWM15_on_hiVf "FCtl_SPN(444)" VALUE 0x001623CC /* @ECU_Address@FCtl_SPN@0x021B66F0@ */ ECIPP_ALIGNMENT_ULONG 4294967295 Compu_IDENTITY 0 4294967295 PHYS_UNIT "SPN" /end CHARACTERISTIC
/begin CHARACTERISTIC FCspn_PWM16_off_loVf "FCtl_SPN(445)" VALUE 0x001623D0 /* @ECU_Address@FCtl_SPN@0x021B66F4@ */ ECIPP_ALIGNMENT_ULONG 4294967295 Compu_IDENTITY 0 4294967295 PHYS_UNIT "SPN" /end CHARACTERISTIC
/begin CHARACTERISTIC FCspn_PWM16_on_hiVf "FCtl_SPN(446)" VALUE 0x001623D4 /* @ECU_Address@FCtl_SPN@0x021B66F8@ */ ECIPP_ALIGNMENT_ULONG 4294967295 Compu_IDENTITY 0 4294967295 PHYS_UNIT "SPN" /end CHARACTERISTIC
/begin CHARACTERISTIC FCspn_PWM17_off_loVf "FCtl_SPN(447)" VALUE 0x001623D8 /* @ECU_Address@FCtl_SPN@0x021B66FC@ */ ECIPP_ALIGNMENT_ULONG 4294967295 Compu_IDENTITY 0 4294967295 PHYS_UNIT "SPN" /end CHARACTERISTIC
/begin CHARACTERISTIC FCspn_PWM17_on_hiVf "FCtl_SPN(448)" VALUE 0x001623DC /* @ECU_Address@FCtl_SPN@0x021B6700@ */ ECIPP_ALIGNMENT_ULONG 4294967295 Compu_IDENTITY 0 4294967295 PHYS_UNIT "SPN" /end CHARACTERISTIC
/begin CHARACTERISTIC FCspn_PWM18_off_loVf "FCtl_SPN(449)" VALUE 0x001623E0 /* @ECU_Address@FCtl_SPN@0x021B6704@ */ ECIPP_ALIGNMENT_ULONG 4294967295 Compu_IDENTITY 0 4294967295 PHYS_UNIT "SPN" /end CHARACTERISTIC
/begin CHARACTERISTIC FCspn_PWM18_on_hiVf "FCtl_SPN(450)" VALUE 0x001623E4 /* @ECU_Address@FCtl_SPN@0x021B6708@ */ ECIPP_ALIGNMENT_ULONG 4294967295 Compu_IDENTITY 0 4294967295 PHYS_UNIT "SPN" /end CHARACTERISTIC
/begin CHARACTERISTIC FCspn_PWM19_off_loVf "FCtl_SPN(451)" VALUE 0x001623E8 /* @ECU_Address@FCtl_SPN@0x021B670C@ */ ECIPP_ALIGNMENT_ULONG 4294967295 Compu_IDENTITY 0 4294967295 PHYS_UNIT "SPN" /end CHARACTERISTIC
/begin CHARACTERISTIC FCspn_PWM19_on_hiVf "FCtl_SPN(452)" VALUE 0x001623EC /* @ECU_Address@FCtl_SPN@0x021B6710@ */ ECIPP_ALIGNMENT_ULONG 4294967295 Compu_IDENTITY 0 4294967295 PHYS_UNIT "SPN" /end CHARACTERISTIC
/begin CHARACTERISTIC FCspn_PWM2_off_loVf "FCtl_SPN(191)" VALUE 0x00161FD8 /* @ECU_Address@FCtl_SPN@0x021B62FC@ */ ECIPP_ALIGNMENT_ULONG 4294967295 Compu_IDENTITY 0 4294967295 PHYS_UNIT "SPN" /end CHARACTERISTIC
/begin CHARACTERISTIC FCspn_PWM2_on_hiVf "FCtl_SPN(192)" VALUE 0x00161FDC /* @ECU_Address@FCtl_SPN@0x021B6300@ */ ECIPP_ALIGNMENT_ULONG 4294967295 Compu_IDENTITY 0 4294967295 PHYS_UNIT "SPN" /end CHARACTERISTIC
/begin CHARACTERISTIC FCspn_PWM20_off_loVf "FCtl_SPN(453)" VALUE 0x001623F0 /* @ECU_Address@FCtl_SPN@0x021B6714@ */ ECIPP_ALIGNMENT_ULONG 4294967295 Compu_IDENTITY 0 4294967295 PHYS_UNIT "SPN" /end CHARACTERISTIC
/begin CHARACTERISTIC FCspn_PWM20_on_hiVf "FCtl_SPN(454)" VALUE 0x001623F4 /* @ECU_Address@FCtl_SPN@0x021B6718@ */ ECIPP_ALIGNMENT_ULONG 4294967295 Compu_IDENTITY 0 4294967295 PHYS_UNIT "SPN" /end CHARACTERISTIC
/begin CHARACTERISTIC FCspn_PWM21_off_loVf "FCtl_SPN(455)" VALUE 0x001623F8 /* @ECU_Address@FCtl_SPN@0x021B671C@ */ ECIPP_ALIGNMENT_ULONG 4294967295 Compu_IDENTITY 0 4294967295 PHYS_UNIT "SPN" /end CHARACTERISTIC
/begin CHARACTERISTIC FPfl_MJ_Pe_HiExp "FPrm_latch(92)" VALUE 0x00160188 /* @ECU_Address@FPrm_latch@0x021BB170@ */ ECIPP_ALIGNMENT_FLOAT32_IEEE 10000000000 Compu_IDENTITY -10000000000 10000000000 PHYS_UNIT "ms" /end CHARACTERISTIC
/begin CHARACTERISTIC FPfl_MJ_Pe_LoExp "FPrm_latch(93)" VALUE 0x0016018C /* @ECU_Address@FPrm_latch@0x021BB174@ */ ECIPP_ALIGNMENT_FLOAT32_IEEE 10000000000 Compu_IDENTITY -10000000000 10000000000 PHYS_UNIT "ms" /end CHARACTERISTIC
/begin CHARACTERISTIC FPfl_MJ2_comm_tout "FPrm_latch(556)" VALUE 0x001608C8 /* @ECU_Address@FPrm_latch@0x021BB8B0@ */ ECIPP_ALIGNMENT_FLOAT32_IEEE 10000000000 Compu_IDENTITY -10000000000 10000000000 PHYS_UNIT "ms" /end CHARACTERISTIC
/begin CHARACTERISTIC FPfl_MJ2_intF_act "FPrm_latch(559)" VALUE 0x001608D4 /* @ECU_Address@FPrm_latch@0x021BB8BC@ */ ECIPP_ALIGNMENT_FLOAT32_IEEE 10000000000 Compu_IDENTITY -10000000000 10000000000 PHYS_UNIT "ms" /end CHARACTERISTIC
/begin CHARACTERISTIC FPfl_MJ2_intF_circ "FPrm_latch(560)" VALUE 0x001608D8 /* @ECU_Address@FPrm_latch@0x021BB8C0@ */ ECIPP_ALIGNMENT_FLOAT32_IEEE 10000000000 Compu_IDENTITY -10000000000 10000000000 PHYS_UNIT "ms" /end CHARACTERISTIC
/begin CHARACTERISTIC FPfl_MJ2_intF_comm "FPrm_latch(561)" VALUE 0x001608DC /* @ECU_Address@FPrm_latch@0x021BB8C4@ */ ECIPP_ALIGNMENT_FLOAT32_IEEE 10000000000 Compu_IDENTITY -10000000000 10000000000 PHYS_UNIT "ms" /end CHARACTERISTIC
/begin CHARACTERISTIC FPfl_MJ2_intF_Vhi "FPrm_latch(557)" VALUE 0x001608CC /* @ECU_Address@FPrm_latch@0x021BB8B4@ */ ECIPP_ALIGNMENT_FLOAT32_IEEE 10000000000 Compu_IDENTITY -10000000000 10000000000 PHYS_UNIT "ms" /end CHARACTERISTIC
/begin CHARACTERISTIC FPfl_MJ2_intF_Vlo "FPrm_latch(558)" VALUE 0x001608D0 /* @ECU_Address@FPrm_latch@0x021BB8B8@ */ ECIPP_ALIGNMENT_FLOAT32_IEEE 10000000000 Compu_IDENTITY -10000000000 10000000000 PHYS_UNIT "ms" /end CHARACTERISTIC
/begin CHARACTERISTIC FPfl_MJ2_Pe_HiExp "FPrm_latch(554)" VALUE 0x001608C0 /* @ECU_Address@FPrm_latch@0x021BB8A8@ */ ECIPP_ALIGNMENT_FLOAT32_IEEE 10000000000 Compu_IDENTITY -10000000000 10000000000 PHYS_UNIT "ms" /end CHARACTERISTIC
/begin CHARACTERISTIC FPfl_MJ2_Pe_LoExp "FPrm_latch(555)" VALUE 0x001608C4 /* @ECU_Address@FPrm_latch@0x021BB8AC@ */ ECIPP_ALIGNMENT_FLOAT32_IEEE 10000000000 Compu_IDENTITY -10000000000 10000000000 PHYS_UNIT "ms" /end CHARACTERISTIC
/begin CHARACTERISTIC FPfl_NOx_hi "FPrm_latch(623)" VALUE 0x001609D4 /* @ECU_Address@FPrm_latch@0x021BB9BC@ */ ECIPP_ALIGNMENT_FLOAT32_IEEE 10000000000 Compu_IDENTITY -10000000000 10000000000 PHYS_UNIT "ms" /end CHARACTERISTIC
/begin CHARACTERISTIC FPfl_OilP_hiP "FPrm_latch(109)" VALUE 0x001601CC /* @ECU_Address@FPrm_latch@0x021BB1B4@ */ ECIPP_ALIGNMENT_FLOAT32_IEEE 10000000000 Compu_IDENTITY -10000000000 10000000000 PHYS_UNIT "ms" /end CHARACTERISTIC
/begin CHARACTERISTIC FPfl_OilP_loP "FPrm_latch(108)" VALUE 0x001601C8 /* @ECU_Address@FPrm_latch@0x021BB1B0@ */ ECIPP_ALIGNMENT_FLOAT32_IEEE 10000000000 Compu_IDENTITY -10000000000 10000000000 PHYS_UNIT "ms" /end CHARACTERISTIC
/begin CHARACTERISTIC FPfl_OilP_maxV "FPrm_latch(110)" VALUE 0x001601D0 /* @ECU_Address@FPrm_latch@0x021BB1B8@ */ ECIPP_ALIGNMENT_FLOAT32_IEEE 10000000000 Compu_IDENTITY -10000000000 10000000000 PHYS_UNIT "ms" /end CHARACTERISTIC
/begin CHARACTERISTIC FPfl_OilP_minV "FPrm_latch(111)" VALUE 0x001601D4 /* @ECU_Address@FPrm_latch@0x021BB1BC@ */ ECIPP_ALIGNMENT_FLOAT32_IEEE 10000000000 Compu_IDENTITY -10000000000 10000000000 PHYS_UNIT "ms" /end CHARACTERISTIC
/begin CHARACTERISTIC FPfl_OILP_test "FPrm_latch(40)" VALUE 0x001600B8 /* @ECU_Address@FPrm_latch@0x021BB0A0@ */ ECIPP_ALIGNMENT_FLOAT32_IEEE 10000000000 Compu_IDENTITY -10000000000 10000000000 PHYS_UNIT "ms" /end CHARACTERISTIC
/begin CHARACTERISTIC FPfl_OilP2_loP "FPrm_latch(215)" VALUE 0x00160374 /* @ECU_Address@FPrm_latch@0x021BB35C@ */ ECIPP_ALIGNMENT_FLOAT32_IEEE 10000000000 Compu_IDENTITY -10000000000 10000000000 PHYS_UNIT "ms" /end CHARACTERISTIC
/begin CHARACTERISTIC FPfl_OILTL_loss "FPrm_latch(567)" VALUE 0x001608F4 /* @ECU_Address@FPrm_latch@0x021BB8DC@ */ ECIPP_ALIGNMENT_FLOAT32_IEEE 10000000000 Compu_IDENTITY -10000000000 10000000000 PHYS_UNIT "ms" /end CHARACTERISTIC
/begin CHARACTERISTIC FPfl_OILTL_Lvl_lo "FPrm_latch(571)" VALUE 0x00160904 /* @ECU_Address@FPrm_latch@0x021BB8EC@ */ ECIPP_ALIGNMENT_FLOAT32_IEEE 10000000000 Compu_IDENTITY -10000000000 10000000000 PHYS_UNIT "ms" /end CHARACTERISTIC
/begin CHARACTERISTIC FPfl_OILTL_Lvl_OOR "FPrm_latch(569)" VALUE 0x001608FC /* @ECU_Address@FPrm_latch@0x021BB8E4@ */ ECIPP_ALIGNMENT_FLOAT32_IEEE 10000000000 Compu_IDENTITY -10000000000 10000000000 PHYS_UNIT "ms" /end CHARACTERISTIC
/begin CHARACTERISTIC FPfl_OILTL_T_hi "FPrm_latch(572)" VALUE 0x00160908 /* @ECU_Address@FPrm_latch@0x021BB8F0@ */ ECIPP_ALIGNMENT_FLOAT32_IEEE 10000000000 Compu_IDENTITY -10000000000 10000000000 PHYS_UNIT "ms" /end CHARACTERISTIC
/begin CHARACTERISTIC FPfl_OILTL_T_OOR "FPrm_latch(570)" VALUE 0x00160900 /* @ECU_Address@FPrm_latch@0x021BB8E8@ */ ECIPP_ALIGNMENT_FLOAT32_IEEE 10000000000 Compu_IDENTITY -10000000000 10000000000 PHYS_UNIT "ms" /end CHARACTERISTIC
/begin CHARACTERISTIC FPfl_OILTL_V_OOR "FPrm_latch(568)" VALUE 0x001608F8 /* @ECU_Address@FPrm_latch@0x021BB8E0@ */ ECIPP_ALIGNMENT_FLOAT32_IEEE 10000000000 Compu_IDENTITY -10000000000 10000000000 PHYS_UNIT "ms" /end CHARACTERISTIC
/begin CHARACTERISTIC FPfl_PAUX_dP1_max "FPrm_latch(416)" VALUE 0x00160698 /* @ECU_Address@FPrm_latch@0x021BB680@ */ ECIPP_ALIGNMENT_FLOAT32_IEEE 10000000000 Compu_IDENTITY -10000000000 10000000000 PHYS_UNIT "ms" /end CHARACTERISTIC
/begin CHARACTERISTIC FPfl_PAUX_dP1_min "FPrm_latch(417)" VALUE 0x0016069C /* @ECU_Address@FPrm_latch@0x021BB684@ */ ECIPP_ALIGNMENT_FLOAT32_IEEE 10000000000 Compu_IDENTITY -10000000000 10000000000 PHYS_UNIT "ms" /end CHARACTERISTIC
/begin CHARACTERISTIC FPfl_PAUX_dP2_max "FPrm_latch(418)" VALUE 0x001606A0 /* @ECU_Address@FPrm_latch@0x021BB688@ */ ECIPP_ALIGNMENT_FLOAT32_IEEE 10000000000 Compu_IDENTITY -10000000000 10000000000 PHYS_UNIT "ms" /end CHARACTERISTIC
/begin CHARACTERISTIC FPfl_PAUX_dP2_min "FPrm_latch(419)" VALUE 0x001606A4 /* @ECU_Address@FPrm_latch@0x021BB68C@ */ ECIPP_ALIGNMENT_FLOAT32_IEEE 10000000000 Compu_IDENTITY -10000000000 10000000000 PHYS_UNIT "ms" /end CHARACTERISTIC
/begin CHARACTERISTIC FPfl_PAUX1_max "FPrm_latch(408)" VALUE 0x00160678 /* @ECU_Address@FPrm_latch@0x021BB660@ */ ECIPP_ALIGNMENT_FLOAT32_IEEE 10000000000 Compu_IDENTITY -10000000000 10000000000 PHYS_UNIT "ms" /end CHARACTERISTIC
/begin CHARACTERISTIC FPfl_PAUX1_min "FPrm_latch(409)" VALUE 0x0016067C /* @ECU_Address@FPrm_latch@0x021BB664@ */ ECIPP_ALIGNMENT_FLOAT32_IEEE 10000000000 Compu_IDENTITY -10000000000 10000000000 PHYS_UNIT "ms" /end CHARACTERISTIC
/begin CHARACTERISTIC FPfl_PAUX2_max "FPrm_latch(410)" VALUE 0x00160680 /* @ECU_Address@FPrm_latch@0x021BB668@ */ ECIPP_ALIGNMENT_FLOAT32_IEEE 10000000000 Compu_IDENTITY -10000000000 10000000000 PHYS_UNIT "ms" /end CHARACTERISTIC
/begin CHARACTERISTIC FPfl_PAUX2_min "FPrm_latch(411)" VALUE 0x00160684 /* @ECU_Address@FPrm_latch@0x021BB66C@ */ ECIPP_ALIGNMENT_FLOAT32_IEEE 10000000000 Compu_IDENTITY -10000000000 10000000000 PHYS_UNIT "ms" /end CHARACTERISTIC
/begin CHARACTERISTIC FPfl_PAUX3_max "FPrm_latch(412)" VALUE 0x00160688 /* @ECU_Address@FPrm_latch@0x021BB670@ */ ECIPP_ALIGNMENT_FLOAT32_IEEE 10000000000 Compu_IDENTITY -10000000000 10000000000 PHYS_UNIT "ms" /end CHARACTERISTIC
/begin CHARACTERISTIC FPfl_PAUX3_min "FPrm_latch(413)" VALUE 0x0016068C /* @ECU_Address@FPrm_latch@0x021BB674@ */ ECIPP_ALIGNMENT_FLOAT32_IEEE 10000000000 Compu_IDENTITY -10000000000 10000000000 PHYS_UNIT "ms" /end CHARACTERISTIC
/begin CHARACTERISTIC FPfl_PAUX4_max "FPrm_latch(414)" VALUE 0x00160690 /* @ECU_Address@FPrm_latch@0x021BB678@ */ ECIPP_ALIGNMENT_FLOAT32_IEEE 10000000000 Compu_IDENTITY -10000000000 10000000000 PHYS_UNIT "ms" /end CHARACTERISTIC
/begin CHARACTERISTIC FPfl_PAUX4_min "FPrm_latch(415)" VALUE 0x00160694 /* @ECU_Address@FPrm_latch@0x021BB67C@ */ ECIPP_ALIGNMENT_FLOAT32_IEEE 10000000000 Compu_IDENTITY -10000000000 10000000000 PHYS_UNIT "ms" /end CHARACTERISTIC
/begin CHARACTERISTIC FPfl_PPEG_BP "FPrm_latch(500)" VALUE 0x001607E8 /* @ECU_Address@FPrm_latch@0x021BB7D0@ */ ECIPP_ALIGNMENT_FLOAT32_IEEE 10000000000 Compu_IDENTITY -10000000000 10000000000 PHYS_UNIT "ms" /end CHARACTERISTIC
/begin CHARACTERISTIC FPfl_PPEG_CVP1 "FPrm_latch(575)" VALUE 0x00160914 /* @ECU_Address@FPrm_latch@0x021BB8FC@ */ ECIPP_ALIGNMENT_FLOAT32_IEEE 10000000000 Compu_IDENTITY -10000000000 10000000000 PHYS_UNIT "ms" /end CHARACTERISTIC
/begin CHARACTERISTIC FPfl_PPEG_CVP2 "FPrm_latch(576)" VALUE 0x00160918 /* @ECU_Address@FPrm_latch@0x021BB900@ */ ECIPP_ALIGNMENT_FLOAT32_IEEE 10000000000 Compu_IDENTITY -10000000000 10000000000 PHYS_UNIT "ms" /end CHARACTERISTIC
/begin CHARACTERISTIC FPfl_PPEG_EBP "FPrm_latch(501)" VALUE 0x001607EC /* @ECU_Address@FPrm_latch@0x021BB7D4@ */ ECIPP_ALIGNMENT_FLOAT32_IEEE 10000000000 Compu_IDENTITY -10000000000 10000000000 PHYS_UNIT "ms" /end CHARACTERISTIC
/begin CHARACTERISTIC FPfl_PPEG_EGRdP "FPrm_latch(586)" VALUE 0x00160940 /* @ECU_Address@FPrm_latch@0x021BB928@ */ ECIPP_ALIGNMENT_FLOAT32_IEEE 10000000000 Compu_IDENTITY -10000000000 10000000000 PHYS_UNIT "ms" /end CHARACTERISTIC
/begin CHARACTERISTIC FPfl_PPEG_EGRHP "FPrm_latch(503)" VALUE 0x001607F4 /* @ECU_Address@FPrm_latch@0x021BB7DC@ */ ECIPP_ALIGNMENT_FLOAT32_IEEE 10000000000 Compu_IDENTITY -10000000000 10000000000 PHYS_UNIT "ms" /end CHARACTERISTIC
/begin CHARACTERISTIC FPfl_PPEG_EGRLP "FPrm_latch(502)" VALUE 0x001607F0 /* @ECU_Address@FPrm_latch@0x021BB7D8@ */ ECIPP_ALIGNMENT_FLOAT32_IEEE 10000000000 Compu_IDENTITY -10000000000 10000000000 PHYS_UNIT "ms" /end CHARACTERISTIC
/begin CHARACTERISTIC FPfl_PPEG_EGRwrP "FPrm_latch(505)" VALUE 0x001607FC /* @ECU_Address@FPrm_latch@0x021BB7E4@ */ ECIPP_ALIGNMENT_FLOAT32_IEEE 10000000000 Compu_IDENTITY -10000000000 10000000000 PHYS_UNIT "ms" /end CHARACTERISTIC
/begin CHARACTERISTIC FPfl_PPEG_MAP "FPrm_latch(506)" VALUE 0x00160800 /* @ECU_Address@FPrm_latch@0x021BB7E8@ */ ECIPP_ALIGNMENT_FLOAT32_IEEE 10000000000 Compu_IDENTITY -10000000000 10000000000 PHYS_UNIT "ms" /end CHARACTERISTIC
/begin CHARACTERISTIC FPfl_PPEG_TIP "FPrm_latch(504)" VALUE 0x001607F8 /* @ECU_Address@FPrm_latch@0x021BB7E0@ */ ECIPP_ALIGNMENT_FLOAT32_IEEE 10000000000 Compu_IDENTITY -10000000000 10000000000 PHYS_UNIT "ms" /end CHARACTERISTIC
/begin CHARACTERISTIC FPfl_PWM1_off_loVf "FPrm_latch(147)" VALUE 0x00160264 /* @ECU_Address@FPrm_latch@0x021BB24C@ */ ECIPP_ALIGNMENT_FLOAT32_IEEE 10000000000 Compu_IDENTITY -10000000000 10000000000 PHYS_UNIT "ms" /end CHARACTERISTIC
/begin CHARACTERISTIC FPfl_PWM1_on_hiVf "FPrm_latch(148)" VALUE 0x00160268 /* @ECU_Address@FPrm_latch@0x021BB250@ */ ECIPP_ALIGNMENT_FLOAT32_IEEE 10000000000 Compu_IDENTITY -10000000000 10000000000 PHYS_UNIT "ms" /end CHARACTERISTIC
/begin CHARACTERISTIC FPfl_PWM10_off_loVf "FPrm_latch(330)" VALUE 0x00160540 /* @ECU_Address@FPrm_latch@0x021BB528@ */ ECIPP_ALIGNMENT_FLOAT32_IEEE 10000000000 Compu_IDENTITY -10000000000 10000000000 PHYS_UNIT "ms" /end CHARACTERISTIC
/begin CHARACTERISTIC FPfl_PWM10_on_hiVf "FPrm_latch(331)" VALUE 0x00160544 /* @ECU_Address@FPrm_latch@0x021BB52C@ */ ECIPP_ALIGNMENT_FLOAT32_IEEE 10000000000 Compu_IDENTITY -10000000000 10000000000 PHYS_UNIT "ms" /end CHARACTERISTIC
/begin CHARACTERISTIC FPfl_PWM11_off_loVf "FPrm_latch(332)" VALUE 0x00160548 /* @ECU_Address@FPrm_latch@0x021BB530@ */ ECIPP_ALIGNMENT_FLOAT32_IEEE 10000000000 Compu_IDENTITY -10000000000 10000000000 PHYS_UNIT "ms" /end CHARACTERISTIC
/begin CHARACTERISTIC FPfl_PWM11_on_hiVf "FPrm_latch(333)" VALUE 0x0016054C /* @ECU_Address@FPrm_latch@0x021BB534@ */ ECIPP_ALIGNMENT_FLOAT32_IEEE 10000000000 Compu_IDENTITY -10000000000 10000000000 PHYS_UNIT "ms" /end CHARACTERISTIC
/begin CHARACTERISTIC FPfl_PWM12_off_loVf "FPrm_latch(334)" VALUE 0x00160550 /* @ECU_Address@FPrm_latch@0x021BB538@ */ ECIPP_ALIGNMENT_FLOAT32_IEEE 10000000000 Compu_IDENTITY -10000000000 10000000000 PHYS_UNIT "ms" /end CHARACTERISTIC
/begin CHARACTERISTIC FPfl_PWM12_on_hiVf "FPrm_latch(335)" VALUE 0x00160554 /* @ECU_Address@FPrm_latch@0x021BB53C@ */ ECIPP_ALIGNMENT_FLOAT32_IEEE 10000000000 Compu_IDENTITY -10000000000 10000000000 PHYS_UNIT "ms" /end CHARACTERISTIC
/begin CHARACTERISTIC FPfl_PWM13_off_loVf "FPrm_latch(336)" VALUE 0x00160558 /* @ECU_Address@FPrm_latch@0x021BB540@ */ ECIPP_ALIGNMENT_FLOAT32_IEEE 10000000000 Compu_IDENTITY -10000000000 10000000000 PHYS_UNIT "ms" /end CHARACTERISTIC
/begin CHARACTERISTIC FPfl_PWM13_on_hiVf "FPrm_latch(337)" VALUE 0x0016055C /* @ECU_Address@FPrm_latch@0x021BB544@ */ ECIPP_ALIGNMENT_FLOAT32_IEEE 10000000000 Compu_IDENTITY -10000000000 10000000000 PHYS_UNIT "ms" /end CHARACTERISTIC
/begin CHARACTERISTIC FPfl_PWM14_off_loVf "FPrm_latch(338)" VALUE 0x00160560 /* @ECU_Address@FPrm_latch@0x021BB548@ */ ECIPP_ALIGNMENT_FLOAT32_IEEE 10000000000 Compu_IDENTITY -10000000000 10000000000 PHYS_UNIT "ms" /end CHARACTERISTIC
/begin CHARACTERISTIC FPfl_PWM14_on_hiVf "FPrm_latch(339)" VALUE 0x00160564 /* @ECU_Address@FPrm_latch@0x021BB54C@ */ ECIPP_ALIGNMENT_FLOAT32_IEEE 10000000000 Compu_IDENTITY -10000000000 10000000000 PHYS_UNIT "ms" /end CHARACTERISTIC
/begin CHARACTERISTIC FPfl_PWM15_off_loVf "FPrm_latch(340)" VALUE 0x00160568 /* @ECU_Address@FPrm_latch@0x021BB550@ */ ECIPP_ALIGNMENT_FLOAT32_IEEE 10000000000 Compu_IDENTITY -10000000000 10000000000 PHYS_UNIT "ms" /end CHARACTERISTIC
/begin CHARACTERISTIC FPfl_PWM15_on_hiVf "FPrm_latch(341)" VALUE 0x0016056C /* @ECU_Address@FPrm_latch@0x021BB554@ */ ECIPP_ALIGNMENT_FLOAT32_IEEE 10000000000 Compu_IDENTITY -10000000000 10000000000 PHYS_UNIT "ms" /end CHARACTERISTIC
/begin CHARACTERISTIC FPfl_PWM16_off_loVf "FPrm_latch(342)" VALUE 0x00160570 /* @ECU_Address@FPrm_latch@0x021BB558@ */ ECIPP_ALIGNMENT_FLOAT32_IEEE 10000000000 Compu_IDENTITY -10000000000 10000000000 PHYS_UNIT "ms" /end CHARACTERISTIC
/begin CHARACTERISTIC FPfl_PWM16_on_hiVf "FPrm_latch(343)" VALUE 0x00160574 /* @ECU_Address@FPrm_latch@0x021BB55C@ */ ECIPP_ALIGNMENT_FLOAT32_IEEE 10000000000 Compu_IDENTITY -10000000000 10000000000 PHYS_UNIT "ms" /end CHARACTERISTIC
/begin CHARACTERISTIC FPfl_PWM17_off_loVf "FPrm_latch(344)" VALUE 0x00160578 /* @ECU_Address@FPrm_latch@0x021BB560@ */ ECIPP_ALIGNMENT_FLOAT32_IEEE 10000000000 Compu_IDENTITY -10000000000 10000000000 PHYS_UNIT "ms" /end CHARACTERISTIC
/begin CHARACTERISTIC FPfl_PWM17_on_hiVf "FPrm_latch(345)" VALUE 0x0016057C /* @ECU_Address@FPrm_latch@0x021BB564@ */ ECIPP_ALIGNMENT_FLOAT32_IEEE 10000000000 Compu_IDENTITY -10000000000 10000000000 PHYS_UNIT "ms" /end CHARACTERISTIC
/begin CHARACTERISTIC FPfl_PWM18_off_loVf "FPrm_latch(346)" VALUE 0x00160580 /* @ECU_Address@FPrm_latch@0x021BB568@ */ ECIPP_ALIGNMENT_FLOAT32_IEEE 10000000000 Compu_IDENTITY -10000000000 10000000000 PHYS_UNIT "ms" /end CHARACTERISTIC
/begin CHARACTERISTIC FPfl_PWM18_on_hiVf "FPrm_latch(347)" VALUE 0x00160584 /* @ECU_Address@FPrm_latch@0x021BB56C@ */ ECIPP_ALIGNMENT_FLOAT32_IEEE 10000000000 Compu_IDENTITY -10000000000 10000000000 PHYS_UNIT "ms" /end CHARACTERISTIC
/begin CHARACTERISTIC FPfl_PWM19_off_loVf "FPrm_latch(348)" VALUE 0x00160588 /* @ECU_Address@FPrm_latch@0x021BB570@ */ ECIPP_ALIGNMENT_FLOAT32_IEEE 10000000000 Compu_IDENTITY -10000000000 10000000000 PHYS_UNIT "ms" /end CHARACTERISTIC
/begin CHARACTERISTIC FPfl_PWM19_on_hiVf "FPrm_latch(349)" VALUE 0x0016058C /* @ECU_Address@FPrm_latch@0x021BB574@ */ ECIPP_ALIGNMENT_FLOAT32_IEEE 10000000000 Compu_IDENTITY -10000000000 10000000000 PHYS_UNIT "ms" /end CHARACTERISTIC
/begin CHARACTERISTIC FPfl_PWM2_off_loVf "FPrm_latch(149)" VALUE 0x0016026C /* @ECU_Address@FPrm_latch@0x021BB254@ */ ECIPP_ALIGNMENT_FLOAT32_IEEE 10000000000 Compu_IDENTITY -10000000000 10000000000 PHYS_UNIT "ms" /end CHARACTERISTIC
/begin CHARACTERISTIC FPfl_PWM2_on_hiVf "FPrm_latch(150)" VALUE 0x00160270 /* @ECU_Address@FPrm_latch@0x021BB258@ */ ECIPP_ALIGNMENT_FLOAT32_IEEE 10000000000 Compu_IDENTITY -10000000000 10000000000 PHYS_UNIT "ms" /end CHARACTERISTIC
/begin CHARACTERISTIC FPfl_PWM20_off_loVf "FPrm_latch(350)" VALUE 0x00160590 /* @ECU_Address@FPrm_latch@0x021BB578@ */ ECIPP_ALIGNMENT_FLOAT32_IEEE 10000000000 Compu_IDENTITY -10000000000 10000000000 PHYS_UNIT "ms" /end CHARACTERISTIC
/begin CHARACTERISTIC FPfl_PWM20_on_hiVf "FPrm_latch(351)" VALUE 0x00160594 /* @ECU_Address@FPrm_latch@0x021BB57C@ */ ECIPP_ALIGNMENT_FLOAT32_IEEE 10000000000 Compu_IDENTITY -10000000000 10000000000 PHYS_UNIT "ms" /end CHARACTERISTIC
/begin CHARACTERISTIC FPfl_PWM21_off_loVf "FPrm_latch(352)" VALUE 0x00160598 /* @ECU_Address@FPrm_latch@0x021BB580@ */ ECIPP_ALIGNMENT_FLOAT32_IEEE 10000000000 Compu_IDENTITY -10000000000 10000000000 PHYS_UNIT "ms" /end CHARACTERISTIC
/begin CHARACTERISTIC FPfu_MJ_Pe_HiExp "FPrm_unlatch(92)" VALUE 0x00160C4C /* @ECU_Address@FPrm_unlatch@0x021BD170@ */ ECIPP_ALIGNMENT_FLOAT32_IEEE 10000000000 Compu_IDENTITY -10000000000 10000000000 PHYS_UNIT "ms" /end CHARACTERISTIC
/begin CHARACTERISTIC FPfu_MJ_Pe_LoExp "FPrm_unlatch(93)" VALUE 0x00160C50 /* @ECU_Address@FPrm_unlatch@0x021BD174@ */ ECIPP_ALIGNMENT_FLOAT32_IEEE 10000000000 Compu_IDENTITY -10000000000 10000000000 PHYS_UNIT "ms" /end CHARACTERISTIC
/begin CHARACTERISTIC FPfu_MJ2_comm_tout "FPrm_unlatch(556)" VALUE 0x0016138C /* @ECU_Address@FPrm_unlatch@0x021BD8B0@ */ ECIPP_ALIGNMENT_FLOAT32_IEEE 10000000000 Compu_IDENTITY -10000000000 10000000000 PHYS_UNIT "ms" /end CHARACTERISTIC
/begin CHARACTERISTIC FPfu_MJ2_intF_act "FPrm_unlatch(559)" VALUE 0x00161398 /* @ECU_Address@FPrm_unlatch@0x021BD8BC@ */ ECIPP_ALIGNMENT_FLOAT32_IEEE 10000000000 Compu_IDENTITY -10000000000 10000000000 PHYS_UNIT "ms" /end CHARACTERISTIC
/begin CHARACTERISTIC FPfu_MJ2_intF_circ "FPrm_unlatch(560)" VALUE 0x0016139C /* @ECU_Address@FPrm_unlatch@0x021BD8C0@ */ ECIPP_ALIGNMENT_FLOAT32_IEEE 10000000000 Compu_IDENTITY -10000000000 10000000000 PHYS_UNIT "ms" /end CHARACTERISTIC
/begin CHARACTERISTIC FPfu_MJ2_intF_comm "FPrm_unlatch(561)" VALUE 0x001613A0 /* @ECU_Address@FPrm_unlatch@0x021BD8C4@ */ ECIPP_ALIGNMENT_FLOAT32_IEEE 10000000000 Compu_IDENTITY -10000000000 10000000000 PHYS_UNIT "ms" /end CHARACTERISTIC
/begin CHARACTERISTIC FPfu_MJ2_intF_Vhi "FPrm_unlatch(557)" VALUE 0x00161390 /* @ECU_Address@FPrm_unlatch@0x021BD8B4@ */ ECIPP_ALIGNMENT_FLOAT32_IEEE 10000000000 Compu_IDENTITY -10000000000 10000000000 PHYS_UNIT "ms" /end CHARACTERISTIC
/begin CHARACTERISTIC FPfu_MJ2_intF_Vlo "FPrm_unlatch(558)" VALUE 0x00161394 /* @ECU_Address@FPrm_unlatch@0x021BD8B8@ */ ECIPP_ALIGNMENT_FLOAT32_IEEE 10000000000 Compu_IDENTITY -10000000000 10000000000 PHYS_UNIT "ms" /end CHARACTERISTIC
/begin CHARACTERISTIC FPfu_MJ2_Pe_HiExp "FPrm_unlatch(554)" VALUE 0x00161384 /* @ECU_Address@FPrm_unlatch@0x021BD8A8@ */ ECIPP_ALIGNMENT_FLOAT32_IEEE 10000000000 Compu_IDENTITY -10000000000 10000000000 PHYS_UNIT "ms" /end CHARACTERISTIC
/begin CHARACTERISTIC FPfu_MJ2_Pe_LoExp "FPrm_unlatch(555)" VALUE 0x00161388 /* @ECU_Address@FPrm_unlatch@0x021BD8AC@ */ ECIPP_ALIGNMENT_FLOAT32_IEEE 10000000000 Compu_IDENTITY -10000000000 10000000000 PHYS_UNIT "ms" /end CHARACTERISTIC
/begin CHARACTERISTIC FPfu_NOx_hi "FPrm_unlatch(623)" VALUE 0x00161498 /* @ECU_Address@FPrm_unlatch@0x021BD9BC@ */ ECIPP_ALIGNMENT_FLOAT32_IEEE 10000000000 Compu_IDENTITY -10000000000 10000000000 PHYS_UNIT "ms" /end CHARACTERISTIC
/begin CHARACTERISTIC FPfu_OilP_hiP "FPrm_unlatch(109)" VALUE 0x00160C90 /* @ECU_Address@FPrm_unlatch@0x021BD1B4@ */ ECIPP_ALIGNMENT_FLOAT32_IEEE 10000000000 Compu_IDENTITY -10000000000 10000000000 PHYS_UNIT "ms" /end CHARACTERISTIC
/begin CHARACTERISTIC FPfu_OilP_loP "FPrm_unlatch(108)" VALUE 0x00160C8C /* @ECU_Address@FPrm_unlatch@0x021BD1B0@ */ ECIPP_ALIGNMENT_FLOAT32_IEEE 10000000000 Compu_IDENTITY -10000000000 10000000000 PHYS_UNIT "ms" /end CHARACTERISTIC
/begin CHARACTERISTIC FPfu_OilP_maxV "FPrm_unlatch(110)" VALUE 0x00160C94 /* @ECU_Address@FPrm_unlatch@0x021BD1B8@ */ ECIPP_ALIGNMENT_FLOAT32_IEEE 10000000000 Compu_IDENTITY -10000000000 10000000000 PHYS_UNIT "ms" /end CHARACTERISTIC
/begin CHARACTERISTIC FPfu_OilP_minV "FPrm_unlatch(111)" VALUE 0x00160C98 /* @ECU_Address@FPrm_unlatch@0x021BD1BC@ */ ECIPP_ALIGNMENT_FLOAT32_IEEE 10000000000 Compu_IDENTITY -10000000000 10000000000 PHYS_UNIT "ms" /end CHARACTERISTIC
/begin CHARACTERISTIC FPfu_OILP_test "FPrm_unlatch(40)" VALUE 0x00160B7C /* @ECU_Address@FPrm_unlatch@0x021BD0A0@ */ ECIPP_ALIGNMENT_FLOAT32_IEEE 10000000000 Compu_IDENTITY -10000000000 10000000000 PHYS_UNIT "ms" /end CHARACTERISTIC
/begin CHARACTERISTIC FPfu_OilP2_loP "FPrm_unlatch(215)" VALUE 0x00160E38 /* @ECU_Address@FPrm_unlatch@0x021BD35C@ */ ECIPP_ALIGNMENT_FLOAT32_IEEE 10000000000 Compu_IDENTITY -10000000000 10000000000 PHYS_UNIT "ms" /end CHARACTERISTIC
/begin CHARACTERISTIC FPfu_OILTL_loss "FPrm_unlatch(567)" VALUE 0x001613B8 /* @ECU_Address@FPrm_unlatch@0x021BD8DC@ */ ECIPP_ALIGNMENT_FLOAT32_IEEE 10000000000 Compu_IDENTITY -10000000000 10000000000 PHYS_UNIT "ms" /end CHARACTERISTIC
/begin CHARACTERISTIC FPfu_OILTL_Lvl_lo "FPrm_unlatch(571)" VALUE 0x001613C8 /* @ECU_Address@FPrm_unlatch@0x021BD8EC@ */ ECIPP_ALIGNMENT_FLOAT32_IEEE 10000000000 Compu_IDENTITY -10000000000 10000000000 PHYS_UNIT "ms" /end CHARACTERISTIC
/begin CHARACTERISTIC FPfu_OILTL_Lvl_OOR "FPrm_unlatch(569)" VALUE 0x001613C0 /* @ECU_Address@FPrm_unlatch@0x021BD8E4@ */ ECIPP_ALIGNMENT_FLOAT32_IEEE 10000000000 Compu_IDENTITY -10000000000 10000000000 PHYS_UNIT "ms" /end CHARACTERISTIC
/begin CHARACTERISTIC FPfu_OILTL_T_hi "FPrm_unlatch(572)" VALUE 0x001613CC /* @ECU_Address@FPrm_unlatch@0x021BD8F0@ */ ECIPP_ALIGNMENT_FLOAT32_IEEE 10000000000 Compu_IDENTITY -10000000000 10000000000 PHYS_UNIT "ms" /end CHARACTERISTIC
/begin CHARACTERISTIC FPfu_OILTL_T_OOR "FPrm_unlatch(570)" VALUE 0x001613C4 /* @ECU_Address@FPrm_unlatch@0x021BD8E8@ */ ECIPP_ALIGNMENT_FLOAT32_IEEE 10000000000 Compu_IDENTITY -10000000000 10000000000 PHYS_UNIT "ms" /end CHARACTERISTIC
/begin CHARACTERISTIC FPfu_OILTL_V_OOR "FPrm_unlatch(568)" VALUE 0x001613BC /* @ECU_Address@FPrm_unlatch@0x021BD8E0@ */ ECIPP_ALIGNMENT_FLOAT32_IEEE 10000000000 Compu_IDENTITY -10000000000 10000000000 PHYS_UNIT "ms" /end CHARACTERISTIC
/begin CHARACTERISTIC FPfu_PAUX_dP1_max "FPrm_unlatch(416)" VALUE 0x0016115C /* @ECU_Address@FPrm_unlatch@0x021BD680@ */ ECIPP_ALIGNMENT_FLOAT32_IEEE 10000000000 Compu_IDENTITY -10000000000 10000000000 PHYS_UNIT "ms" /end CHARACTERISTIC
/begin CHARACTERISTIC FPfu_PAUX_dP1_min "FPrm_unlatch(417)" VALUE 0x00161160 /* @ECU_Address@FPrm_unlatch@0x021BD684@ */ ECIPP_ALIGNMENT_FLOAT32_IEEE 10000000000 Compu_IDENTITY -10000000000 10000000000 PHYS_UNIT "ms" /end CHARACTERISTIC
/begin CHARACTERISTIC FPfu_PAUX_dP2_max "FPrm_unlatch(418)" VALUE 0x00161164 /* @ECU_Address@FPrm_unlatch@0x021BD688@ */ ECIPP_ALIGNMENT_FLOAT32_IEEE 10000000000 Compu_IDENTITY -10000000000 10000000000 PHYS_UNIT "ms" /end CHARACTERISTIC
/begin CHARACTERISTIC FPfu_PAUX_dP2_min "FPrm_unlatch(419)" VALUE 0x00161168 /* @ECU_Address@FPrm_unlatch@0x021BD68C@ */ ECIPP_ALIGNMENT_FLOAT32_IEEE 10000000000 Compu_IDENTITY -10000000000 10000000000 PHYS_UNIT "ms" /end CHARACTERISTIC
/begin CHARACTERISTIC FPfu_PAUX1_max "FPrm_unlatch(408)" VALUE 0x0016113C /* @ECU_Address@FPrm_unlatch@0x021BD660@ */ ECIPP_ALIGNMENT_FLOAT32_IEEE 10000000000 Compu_IDENTITY -10000000000 10000000000 PHYS_UNIT "ms" /end CHARACTERISTIC
/begin CHARACTERISTIC FPfu_PAUX1_min "FPrm_unlatch(409)" VALUE 0x00161140 /* @ECU_Address@FPrm_unlatch@0x021BD664@ */ ECIPP_ALIGNMENT_FLOAT32_IEEE 10000000000 Compu_IDENTITY -10000000000 10000000000 PHYS_UNIT "ms" /end CHARACTERISTIC
/begin CHARACTERISTIC FPfu_PAUX2_max "FPrm_unlatch(410)" VALUE 0x00161144 /* @ECU_Address@FPrm_unlatch@0x021BD668@ */ ECIPP_ALIGNMENT_FLOAT32_IEEE 10000000000 Compu_IDENTITY -10000000000 10000000000 PHYS_UNIT "ms" /end CHARACTERISTIC
/begin CHARACTERISTIC FPfu_PAUX2_min "FPrm_unlatch(411)" VALUE 0x00161148 /* @ECU_Address@FPrm_unlatch@0x021BD66C@ */ ECIPP_ALIGNMENT_FLOAT32_IEEE 10000000000 Compu_IDENTITY -10000000000 10000000000 PHYS_UNIT "ms" /end CHARACTERISTIC
/begin CHARACTERISTIC FPfu_PAUX3_max "FPrm_unlatch(412)" VALUE 0x0016114C /* @ECU_Address@FPrm_unlatch@0x021BD670@ */ ECIPP_ALIGNMENT_FLOAT32_IEEE 10000000000 Compu_IDENTITY -10000000000 10000000000 PHYS_UNIT "ms" /end CHARACTERISTIC
/begin CHARACTERISTIC FPfu_PAUX3_min "FPrm_unlatch(413)" VALUE 0x00161150 /* @ECU_Address@FPrm_unlatch@0x021BD674@ */ ECIPP_ALIGNMENT_FLOAT32_IEEE 10000000000 Compu_IDENTITY -10000000000 10000000000 PHYS_UNIT "ms" /end CHARACTERISTIC
/begin CHARACTERISTIC FPfu_PAUX4_max "FPrm_unlatch(414)" VALUE 0x00161154 /* @ECU_Address@FPrm_unlatch@0x021BD678@ */ ECIPP_ALIGNMENT_FLOAT32_IEEE 10000000000 Compu_IDENTITY -10000000000 10000000000 PHYS_UNIT "ms" /end CHARACTERISTIC
/begin CHARACTERISTIC FPfu_PAUX4_min "FPrm_unlatch(415)" VALUE 0x00161158 /* @ECU_Address@FPrm_unlatch@0x021BD67C@ */ ECIPP_ALIGNMENT_FLOAT32_IEEE 10000000000 Compu_IDENTITY -10000000000 10000000000 PHYS_UNIT "ms" /end CHARACTERISTIC
/begin CHARACTERISTIC FPfu_PPEG_BP "FPrm_unlatch(500)" VALUE 0x001612AC /* @ECU_Address@FPrm_unlatch@0x021BD7D0@ */ ECIPP_ALIGNMENT_FLOAT32_IEEE 10000000000 Compu_IDENTITY -10000000000 10000000000 PHYS_UNIT "ms" /end CHARACTERISTIC
/begin CHARACTERISTIC FPfu_PPEG_CVP1 "FPrm_unlatch(575)" VALUE 0x001613D8 /* @ECU_Address@FPrm_unlatch@0x021BD8FC@ */ ECIPP_ALIGNMENT_FLOAT32_IEEE 10000000000 Compu_IDENTITY -10000000000 10000000000 PHYS_UNIT "ms" /end CHARACTERISTIC
/begin CHARACTERISTIC FPfu_PPEG_CVP2 "FPrm_unlatch(576)" VALUE 0x001613DC /* @ECU_Address@FPrm_unlatch@0x021BD900@ */ ECIPP_ALIGNMENT_FLOAT32_IEEE 10000000000 Compu_IDENTITY -10000000000 10000000000 PHYS_UNIT "ms" /end CHARACTERISTIC
/begin CHARACTERISTIC FPfu_PPEG_EBP "FPrm_unlatch(501)" VALUE 0x001612B0 /* @ECU_Address@FPrm_unlatch@0x021BD7D4@ */ ECIPP_ALIGNMENT_FLOAT32_IEEE 10000000000 Compu_IDENTITY -10000000000 10000000000 PHYS_UNIT "ms" /end CHARACTERISTIC
/begin CHARACTERISTIC FPfu_PPEG_EGRdP "FPrm_unlatch(586)" VALUE 0x00161404 /* @ECU_Address@FPrm_unlatch@0x021BD928@ */ ECIPP_ALIGNMENT_FLOAT32_IEEE 10000000000 Compu_IDENTITY -10000000000 10000000000 PHYS_UNIT "ms" /end CHARACTERISTIC
/begin CHARACTERISTIC FPfu_PPEG_EGRHP "FPrm_unlatch(503)" VALUE 0x001612B8 /* @ECU_Address@FPrm_unlatch@0x021BD7DC@ */ ECIPP_ALIGNMENT_FLOAT32_IEEE 10000000000 Compu_IDENTITY -10000000000 10000000000 PHYS_UNIT "ms" /end CHARACTERISTIC
/begin CHARACTERISTIC FPfu_PPEG_EGRLP "FPrm_unlatch(502)" VALUE 0x001612B4 /* @ECU_Address@FPrm_unlatch@0x021BD7D8@ */ ECIPP_ALIGNMENT_FLOAT32_IEEE 10000000000 Compu_IDENTITY -10000000000 10000000000 PHYS_UNIT "ms" /end CHARACTERISTIC
/begin CHARACTERISTIC FPfu_PPEG_EGRwrP "FPrm_unlatch(505)" VALUE 0x001612C0 /* @ECU_Address@FPrm_unlatch@0x021BD7E4@ */ ECIPP_ALIGNMENT_FLOAT32_IEEE 10000000000 Compu_IDENTITY -10000000000 10000000000 PHYS_UNIT "ms" /end CHARACTERISTIC
/begin CHARACTERISTIC FPfu_PPEG_MAP "FPrm_unlatch(506)" VALUE 0x001612C4 /* @ECU_Address@FPrm_unlatch@0x021BD7E8@ */ ECIPP_ALIGNMENT_FLOAT32_IEEE 10000000000 Compu_IDENTITY -10000000000 10000000000 PHYS_UNIT "ms" /end CHARACTERISTIC
/begin CHARACTERISTIC FPfu_PPEG_TIP "FPrm_unlatch(504)" VALUE 0x001612BC /* @ECU_Address@FPrm_unlatch@0x021BD7E0@ */ ECIPP_ALIGNMENT_FLOAT32_IEEE 10000000000 Compu_IDENTITY -10000000000 10000000000 PHYS_UNIT "ms" /end CHARACTERISTIC
/begin CHARACTERISTIC FPfu_PWM1_off_loVf "FPrm_unlatch(147)" VALUE 0x00160D28 /* @ECU_Address@FPrm_unlatch@0x021BD24C@ */ ECIPP_ALIGNMENT_FLOAT32_IEEE 10000000000 Compu_IDENTITY -10000000000 10000000000 PHYS_UNIT "ms" /end CHARACTERISTIC
/begin CHARACTERISTIC FPfu_PWM1_on_hiVf "FPrm_unlatch(148)" VALUE 0x00160D2C /* @ECU_Address@FPrm_unlatch@0x021BD250@ */ ECIPP_ALIGNMENT_FLOAT32_IEEE 10000000000 Compu_IDENTITY -10000000000 10000000000 PHYS_UNIT "ms" /end CHARACTERISTIC
/begin CHARACTERISTIC FPfu_PWM10_off_loVf "FPrm_unlatch(330)" VALUE 0x00161004 /* @ECU_Address@FPrm_unlatch@0x021BD528@ */ ECIPP_ALIGNMENT_FLOAT32_IEEE 10000000000 Compu_IDENTITY -10000000000 10000000000 PHYS_UNIT "ms" /end CHARACTERISTIC
/begin CHARACTERISTIC FPfu_PWM10_on_hiVf "FPrm_unlatch(331)" VALUE 0x00161008 /* @ECU_Address@FPrm_unlatch@0x021BD52C@ */ ECIPP_ALIGNMENT_FLOAT32_IEEE 10000000000 Compu_IDENTITY -10000000000 10000000000 PHYS_UNIT "ms" /end CHARACTERISTIC
/begin CHARACTERISTIC FPfu_PWM11_off_loVf "FPrm_unlatch(332)" VALUE 0x0016100C /* @ECU_Address@FPrm_unlatch@0x021BD530@ */ ECIPP_ALIGNMENT_FLOAT32_IEEE 10000000000 Compu_IDENTITY -10000000000 10000000000 PHYS_UNIT "ms" /end CHARACTERISTIC
/begin CHARACTERISTIC FPfu_PWM11_on_hiVf "FPrm_unlatch(333)" VALUE 0x00161010 /* @ECU_Address@FPrm_unlatch@0x021BD534@ */ ECIPP_ALIGNMENT_FLOAT32_IEEE 10000000000 Compu_IDENTITY -10000000000 10000000000 PHYS_UNIT "ms" /end CHARACTERISTIC
/begin CHARACTERISTIC FPfu_PWM12_off_loVf "FPrm_unlatch(334)" VALUE 0x00161014 /* @ECU_Address@FPrm_unlatch@0x021BD538@ */ ECIPP_ALIGNMENT_FLOAT32_IEEE 10000000000 Compu_IDENTITY -10000000000 10000000000 PHYS_UNIT "ms" /end CHARACTERISTIC
/begin CHARACTERISTIC FPfu_PWM12_on_hiVf "FPrm_unlatch(335)" VALUE 0x00161018 /* @ECU_Address@FPrm_unlatch@0x021BD53C@ */ ECIPP_ALIGNMENT_FLOAT32_IEEE 10000000000 Compu_IDENTITY -10000000000 10000000000 PHYS_UNIT "ms" /end CHARACTERISTIC
/begin CHARACTERISTIC FPfu_PWM13_off_loVf "FPrm_unlatch(336)" VALUE 0x0016101C /* @ECU_Address@FPrm_unlatch@0x021BD540@ */ ECIPP_ALIGNMENT_FLOAT32_IEEE 10000000000 Compu_IDENTITY -10000000000 10000000000 PHYS_UNIT "ms" /end CHARACTERISTIC
/begin CHARACTERISTIC FPfu_PWM13_on_hiVf "FPrm_unlatch(337)" VALUE 0x00161020 /* @ECU_Address@FPrm_unlatch@0x021BD544@ */ ECIPP_ALIGNMENT_FLOAT32_IEEE 10000000000 Compu_IDENTITY -10000000000 10000000000 PHYS_UNIT "ms" /end CHARACTERISTIC
/begin CHARACTERISTIC FPfu_PWM14_off_loVf "FPrm_unlatch(338)" VALUE 0x00161024 /* @ECU_Address@FPrm_unlatch@0x021BD548@ */ ECIPP_ALIGNMENT_FLOAT32_IEEE 10000000000 Compu_IDENTITY -10000000000 10000000000 PHYS_UNIT "ms" /end CHARACTERISTIC
/begin CHARACTERISTIC FPfu_PWM14_on_hiVf "FPrm_unlatch(339)" VALUE 0x00161028 /* @ECU_Address@FPrm_unlatch@0x021BD54C@ */ ECIPP_ALIGNMENT_FLOAT32_IEEE 10000000000 Compu_IDENTITY -10000000000 10000000000 PHYS_UNIT "ms" /end CHARACTERISTIC
/begin CHARACTERISTIC FPfu_PWM15_off_loVf "FPrm_unlatch(340)" VALUE 0x0016102C /* @ECU_Address@FPrm_unlatch@0x021BD550@ */ ECIPP_ALIGNMENT_FLOAT32_IEEE 10000000000 Compu_IDENTITY -10000000000 10000000000 PHYS_UNIT "ms" /end CHARACTERISTIC
/begin CHARACTERISTIC FPfu_PWM15_on_hiVf "FPrm_unlatch(341)" VALUE 0x00161030 /* @ECU_Address@FPrm_unlatch@0x021BD554@ */ ECIPP_ALIGNMENT_FLOAT32_IEEE 10000000000 Compu_IDENTITY -10000000000 10000000000 PHYS_UNIT "ms" /end CHARACTERISTIC
/begin CHARACTERISTIC FPfu_PWM16_off_loVf "FPrm_unlatch(342)" VALUE 0x00161034 /* @ECU_Address@FPrm_unlatch@0x021BD558@ */ ECIPP_ALIGNMENT_FLOAT32_IEEE 10000000000 Compu_IDENTITY -10000000000 10000000000 PHYS_UNIT "ms" /end CHARACTERISTIC
/begin CHARACTERISTIC FPfu_PWM16_on_hiVf "FPrm_unlatch(343)" VALUE 0x00161038 /* @ECU_Address@FPrm_unlatch@0x021BD55C@ */ ECIPP_ALIGNMENT_FLOAT32_IEEE 10000000000 Compu_IDENTITY -10000000000 10000000000 PHYS_UNIT "ms" /end CHARACTERISTIC
/begin CHARACTERISTIC FPfu_PWM17_off_loVf "FPrm_unlatch(344)" VALUE 0x0016103C /* @ECU_Address@FPrm_unlatch@0x021BD560@ */ ECIPP_ALIGNMENT_FLOAT32_IEEE 10000000000 Compu_IDENTITY -10000000000 10000000000 PHYS_UNIT "ms" /end CHARACTERISTIC
/begin CHARACTERISTIC FPfu_PWM17_on_hiVf "FPrm_unlatch(345)" VALUE 0x00161040 /* @ECU_Address@FPrm_unlatch@0x021BD564@ */ ECIPP_ALIGNMENT_FLOAT32_IEEE 10000000000 Compu_IDENTITY -10000000000 10000000000 PHYS_UNIT "ms" /end CHARACTERISTIC
/begin CHARACTERISTIC FPfu_PWM18_off_loVf "FPrm_unlatch(346)" VALUE 0x00161044 /* @ECU_Address@FPrm_unlatch@0x021BD568@ */ ECIPP_ALIGNMENT_FLOAT32_IEEE 10000000000 Compu_IDENTITY -10000000000 10000000000 PHYS_UNIT "ms" /end CHARACTERISTIC
/begin CHARACTERISTIC FPfu_PWM18_on_hiVf "FPrm_unlatch(347)" VALUE 0x00161048 /* @ECU_Address@FPrm_unlatch@0x021BD56C@ */ ECIPP_ALIGNMENT_FLOAT32_IEEE 10000000000 Compu_IDENTITY -10000000000 10000000000 PHYS_UNIT "ms" /end CHARACTERISTIC
/begin CHARACTERISTIC FPfu_PWM19_off_loVf "FPrm_unlatch(348)" VALUE 0x0016104C /* @ECU_Address@FPrm_unlatch@0x021BD570@ */ ECIPP_ALIGNMENT_FLOAT32_IEEE 10000000000 Compu_IDENTITY -10000000000 10000000000 PHYS_UNIT "ms" /end CHARACTERISTIC
/begin CHARACTERISTIC FPfu_PWM19_on_hiVf "FPrm_unlatch(349)" VALUE 0x00161050 /* @ECU_Address@FPrm_unlatch@0x021BD574@ */ ECIPP_ALIGNMENT_FLOAT32_IEEE 10000000000 Compu_IDENTITY -10000000000 10000000000 PHYS_UNIT "ms" /end CHARACTERISTIC
/begin CHARACTERISTIC FPfu_PWM2_off_loVf "FPrm_unlatch(149)" VALUE 0x00160D30 /* @ECU_Address@FPrm_unlatch@0x021BD254@ */ ECIPP_ALIGNMENT_FLOAT32_IEEE 10000000000 Compu_IDENTITY -10000000000 10000000000 PHYS_UNIT "ms" /end CHARACTERISTIC
/begin CHARACTERISTIC FPfu_PWM2_on_hiVf "FPrm_unlatch(150)" VALUE 0x00160D34 /* @ECU_Address@FPrm_unlatch@0x021BD258@ */ ECIPP_ALIGNMENT_FLOAT32_IEEE 10000000000 Compu_IDENTITY -10000000000 10000000000 PHYS_UNIT "ms" /end CHARACTERISTIC
/begin CHARACTERISTIC FPfu_PWM20_off_loVf "FPrm_unlatch(350)" VALUE 0x00161054 /* @ECU_Address@FPrm_unlatch@0x021BD578@ */ ECIPP_ALIGNMENT_FLOAT32_IEEE 10000000000 Compu_IDENTITY -10000000000 10000000000 PHYS_UNIT "ms" /end CHARACTERISTIC
/begin CHARACTERISTIC FPfu_PWM20_on_hiVf "FPrm_unlatch(351)" VALUE 0x00161058 /* @ECU_Address@FPrm_unlatch@0x021BD57C@ */ ECIPP_ALIGNMENT_FLOAT32_IEEE 10000000000 Compu_IDENTITY -10000000000 10000000000 PHYS_UNIT "ms" /end CHARACTERISTIC
/begin CHARACTERISTIC FPfu_PWM21_off_loVf "FPrm_unlatch(352)" VALUE 0x0016105C /* @ECU_Address@FPrm_unlatch@0x021BD580@ */ ECIPP_ALIGNMENT_FLOAT32_IEEE 10000000000 Compu_IDENTITY -10000000000 10000000000 PHYS_UNIT "ms" /end CHARACTERISTIC
/begin GROUP MJ_Pe_HiExp_EC_Fault "EPR / CFV regulation pressure higher than expected"
 /begin REF_CHARACTERISTIC FCdc4_MJ_Pe_HiExp FCdtc_MJ_Pe_HiExp FCfmi_MJ_Pe_HiExp FCftb_MJ_Pe_HiExp FCspn_MJ_Pe_HiExp FPfl_MJ_Pe_HiExp FPfu_MJ_Pe_HiExp FPnd_MJ_Pe_HiExp FPsvr_MJ_Pe_HiExp FPsw_ext1_MJ_Pe_HiExp FPsw_MJ_Pe_HiExp /end REF_CHARACTERISTIC
/end GROUP
/begin GROUP MJ_Pe_LoExp_EC_Fault "EPR / CFV regulation pressure lower than expected"
 /begin REF_CHARACTERISTIC FCdc4_MJ_Pe_LoExp FCdtc_MJ_Pe_LoExp FCfmi_MJ_Pe_LoExp FCftb_MJ_Pe_LoExp FCspn_MJ_Pe_LoExp FPfl_MJ_Pe_LoExp FPfu_MJ_Pe_LoExp FPnd_MJ_Pe_LoExp FPsvr_MJ_Pe_LoExp FPsw_ext1_MJ_Pe_LoExp FPsw_MJ_Pe_LoExp /end REF_CHARACTERISTIC
/end GROUP
/begin GROUP MJ2_comm_tout_EC_Fault "EPR secondary comm lost"
 /begin REF_CHARACTERISTIC FCdc4_MJ2_comm_tout FCdtc_MJ2_comm_tout FCfmi_MJ2_comm_tout FCftb_MJ2_comm_tout FCspn_MJ2_comm_tout FPfl_MJ2_comm_tout FPfu_MJ2_comm_tout FPnd_MJ2_comm_tout FPsvr_MJ2_comm_tout FPsw_ext1_MJ2_comm_tout FPsw_MJ2_comm_tout /end REF_CHARACTERISTIC
/end GROUP
/begin GROUP MJ2_intF_act_EC_Fault "EPR secondary internal actuator fault detection"
 /begin REF_CHARACTERISTIC FCdc4_MJ2_intF_act FCdtc_MJ2_intF_act FCfmi_MJ2_intF_act FCftb_MJ2_intF_act FCspn_MJ2_intF_act FPfl_MJ2_intF_act FPfu_MJ2_intF_act FPnd_MJ2_intF_act FPsvr_MJ2_intF_act FPsw_ext1_MJ2_intF_act FPsw_MJ2_intF_act /end REF_CHARACTERISTIC
/end GROUP
/begin GROUP MJ2_intF_circ_EC_Fault "EPR secondary internal circuitry fault detection"
 /begin REF_CHARACTERISTIC FCdc4_MJ2_intF_circ FCdtc_MJ2_intF_circ FCfmi_MJ2_intF_circ FCftb_MJ2_intF_circ FCspn_MJ2_intF_circ FPfl_MJ2_intF_circ FPfu_MJ2_intF_circ FPnd_MJ2_intF_circ FPsvr_MJ2_intF_circ FPsw_ext1_MJ2_intF_circ FPsw_MJ2_intF_circ /end REF_CHARACTERISTIC
/end GROUP
/begin GROUP MJ2_intF_comm_EC_Fault "EPR secondary internal comm fault detection"
 /begin REF_CHARACTERISTIC FCdc4_MJ2_intF_comm FCdtc_MJ2_intF_comm FCfmi_MJ2_intF_comm FCftb_MJ2_intF_comm FCspn_MJ2_intF_comm FPfl_MJ2_intF_comm FPfu_MJ2_intF_comm FPnd_MJ2_intF_comm FPsvr_MJ2_intF_comm FPsw_ext1_MJ2_intF_comm FPsw_MJ2_intF_comm /end REF_CHARACTERISTIC
/end GROUP
/begin GROUP MJ2_intF_Vhi_EC_Fault "EPR secondary voltage supply high"
 /begin REF_CHARACTERISTIC FCdc4_MJ2_intF_Vhi FCdtc_MJ2_intF_Vhi FCfmi_MJ2_intF_Vhi FCftb_MJ2_intF_Vhi FCspn_MJ2_intF_Vhi FPfl_MJ2_intF_Vhi FPfu_MJ2_intF_Vhi FPnd_MJ2_intF_Vhi FPsvr_MJ2_intF_Vhi FPsw_ext1_MJ2_intF_Vhi FPsw_MJ2_intF_Vhi /end REF_CHARACTERISTIC
/end GROUP
/begin GROUP MJ2_intF_Vlo_EC_Fault "EPR secondary voltage supply low"
 /begin REF_CHARACTERISTIC FCdc4_MJ2_intF_Vlo FCdtc_MJ2_intF_Vlo FCfmi_MJ2_intF_Vlo FCftb_MJ2_intF_Vlo FCspn_MJ2_intF_Vlo FPfl_MJ2_intF_Vlo FPfu_MJ2_intF_Vlo FPnd_MJ2_intF_Vlo FPsvr_MJ2_intF_Vlo FPsw_ext1_MJ2_intF_Vlo FPsw_MJ2_intF_Vlo /end REF_CHARACTERISTIC
/end GROUP
/begin GROUP MJ2_Pe_HiExp_EC_Fault "EPR secondary regulation pressure higher than expected"
 /begin REF_CHARACTERISTIC FCdc4_MJ2_Pe_HiExp FCdtc_MJ2_Pe_HiExp FCfmi_MJ2_Pe_HiExp FCftb_MJ2_Pe_HiExp FCspn_MJ2_Pe_HiExp FPfl_MJ2_Pe_HiExp FPfu_MJ2_Pe_HiExp FPnd_MJ2_Pe_HiExp FPsvr_MJ2_Pe_HiExp FPsw_ext1_MJ2_Pe_HiExp FPsw_MJ2_Pe_HiExp /end REF_CHARACTERISTIC
/end GROUP
/begin GROUP MJ2_Pe_LoExp_EC_Fault "EPR secondary regulation pressure lower than expected"
 /begin REF_CHARACTERISTIC FCdc4_MJ2_Pe_LoExp FCdtc_MJ2_Pe_LoExp FCfmi_MJ2_Pe_LoExp FCftb_MJ2_Pe_LoExp FCspn_MJ2_Pe_LoExp FPfl_MJ2_Pe_LoExp FPfu_MJ2_Pe_LoExp FPnd_MJ2_Pe_LoExp FPsvr_MJ2_Pe_LoExp FPsw_ext1_MJ2_Pe_LoExp FPsw_MJ2_Pe_LoExp /end REF_CHARACTERISTIC
/end GROUP
/begin GROUP NOx_hi_EC_Fault "NOx Exceedance - NOx control monitoring system"
 /begin REF_CHARACTERISTIC FCdc4_NOx_hi FCdtc_NOx_hi FCfmi_NOx_hi FCftb_NOx_hi FCspn_NOx_hi FPfl_NOx_hi FPfu_NOx_hi FPnd_NOx_hi FPsvr_NOx_hi FPsw_ext1_NOx_hi FPsw_NOx_hi /end REF_CHARACTERISTIC
/end GROUP
/begin GROUP OilP_hiP_EC_Fault "Oil pressure high (sender)"
 /begin REF_CHARACTERISTIC FCdc4_OilP_hiP FCdtc_OilP_hiP FCfmi_OilP_hiP FCftb_OilP_hiP FCspn_OilP_hiP FPfl_OilP_hiP FPfu_OilP_hiP FPnd_OilP_hiP FPsvr_OilP_hiP FPsw_ext1_OilP_hiP FPsw_OilP_hiP /end REF_CHARACTERISTIC
/end GROUP
/begin GROUP OilP_loP_EC_Fault "Oil pressure low stage 2 (sender)"
 /begin REF_CHARACTERISTIC FCdc4_OilP_loP FCdtc_OilP_loP FCfmi_OilP_loP FCftb_OilP_loP FCspn_OilP_loP FPfl_OilP_loP FPfu_OilP_loP FPnd_OilP_loP FPsvr_OilP_loP FPsw_ext1_OilP_loP FPsw_OilP_loP /end REF_CHARACTERISTIC
/end GROUP
/begin GROUP OilP_maxV_EC_Fault "Oil pressure high voltage (switch or sender)"
 /begin REF_CHARACTERISTIC FCdc4_OilP_maxV FCdtc_OilP_maxV FCfmi_OilP_maxV FCftb_OilP_maxV FCspn_OilP_maxV FPfl_OilP_maxV FPfu_OilP_maxV FPnd_OilP_maxV FPsvr_OilP_maxV FPsw_ext1_OilP_maxV FPsw_OilP_maxV /end REF_CHARACTERISTIC
/end GROUP
/begin GROUP OilP_minV_EC_Fault "Oil pressure low voltage (switch or sender)"
 /begin REF_CHARACTERISTIC FCdc4_OilP_minV FCdtc_OilP_minV FCfmi_OilP_minV FCftb_OilP_minV FCspn_OilP_minV FPfl_OilP_minV FPfu_OilP_minV FPnd_OilP_minV FPsvr_OilP_minV FPsw_ext1_OilP_minV FPsw_OilP_minV /end REF_CHARACTERISTIC
/end GROUP
/begin GROUP OILP_test_EC_Fault "Oil pressure low (switch)"
 /begin REF_CHARACTERISTIC FCdc4_OILP_test FCdtc_OILP_test FCfmi_OILP_test FCftb_OILP_test FCspn_OILP_test FPfl_OILP_test FPfu_OILP_test FPnd_OILP_test FPsvr_OILP_test FPsw_ext1_OILP_test FPsw_OILP_test /end REF_CHARACTERISTIC
/end GROUP
/begin GROUP OilP2_loP_EC_Fault "Oil pressure low stage 1 (sender)"
 /begin REF_CHARACTERISTIC FCdc4_OilP2_loP FCdtc_OilP2_loP FCfmi_OilP2_loP FCftb_OilP2_loP FCspn_OilP2_loP FPfl_OilP2_loP FPfu_OilP2_loP FPnd_OilP2_loP FPsvr_OilP2_loP FPsw_ext1_OilP2_loP FPsw_OilP2_loP /end REF_CHARACTERISTIC
/end GROUP
/begin GROUP OILTL_loss_EC_Fault "Oil level and temperature sensor loss"
 /begin REF_CHARACTERISTIC FCdc4_OILTL_loss FCdtc_OILTL_loss FCfmi_OILTL_loss FCftb_OILTL_loss FCspn_OILTL_loss FPfl_OILTL_loss FPfu_OILTL_loss FPnd_OILTL_loss FPsvr_OILTL_loss FPsw_ext1_OILTL_loss FPsw_OILTL_loss /end REF_CHARACTERISTIC
/end GROUP
/begin GROUP OILTL_Lvl_lo_EC_Fault "Oil level too low"
 /begin REF_CHARACTERISTIC FCdc4_OILTL_Lvl_lo FCdtc_OILTL_Lvl_lo FCfmi_OILTL_Lvl_lo FCftb_OILTL_Lvl_lo FCspn_OILTL_Lvl_lo FPfl_OILTL_Lvl_lo FPfu_OILTL_Lvl_lo FPnd_OILTL_Lvl_lo FPsvr_OILTL_Lvl_lo FPsw_ext1_OILTL_Lvl_lo FPsw_OILTL_Lvl_lo /end REF_CHARACTERISTIC
/end GROUP
/begin GROUP OILTL_Lvl_OOR_EC_Fault "Oil level out of range"
 /begin REF_CHARACTERISTIC FCdc4_OILTL_Lvl_OOR FCdtc_OILTL_Lvl_OOR FCfmi_OILTL_Lvl_OOR FCftb_OILTL_Lvl_OOR FCspn_OILTL_Lvl_OOR FPfl_OILTL_Lvl_OOR FPfu_OILTL_Lvl_OOR FPnd_OILTL_Lvl_OOR FPsvr_OILTL_Lvl_OOR FPsw_ext1_OILTL_Lvl_OOR FPsw_OILTL_Lvl_OOR /end REF_CHARACTERISTIC
/end GROUP
/begin GROUP OILTL_T_hi_EC_Fault "Oil temperature too high"
 /begin REF_CHARACTERISTIC FCdc4_OILTL_T_hi FCdtc_OILTL_T_hi FCfmi_OILTL_T_hi FCftb_OILTL_T_hi FCspn_OILTL_T_hi FPfl_OILTL_T_hi FPfu_OILTL_T_hi FPnd_OILTL_T_hi FPsvr_OILTL_T_hi FPsw_ext1_OILTL_T_hi FPsw_OILTL_T_hi /end REF_CHARACTERISTIC
/end GROUP
/begin GROUP OILTL_T_OOR_EC_Fault "Oil temperature out of range"
 /begin REF_CHARACTERISTIC FCdc4_OILTL_T_OOR FCdtc_OILTL_T_OOR FCfmi_OILTL_T_OOR FCftb_OILTL_T_OOR FCspn_OILTL_T_OOR FPfl_OILTL_T_OOR FPfu_OILTL_T_OOR FPnd_OILTL_T_OOR FPsvr_OILTL_T_OOR FPsw_ext1_OILTL_T_OOR FPsw_OILTL_T_OOR /end REF_CHARACTERISTIC
/end GROUP
/begin GROUP OILTL_V_OOR_EC_Fault "Oil level and temperature sensor voltage out of range"
 /begin REF_CHARACTERISTIC FCdc4_OILTL_V_OOR FCdtc_OILTL_V_OOR FCfmi_OILTL_V_OOR FCftb_OILTL_V_OOR FCspn_OILTL_V_OOR FPfl_OILTL_V_OOR FPfu_OILTL_V_OOR FPnd_OILTL_V_OOR FPsvr_OILTL_V_OOR FPsw_ext1_OILTL_V_OOR FPsw_OILTL_V_OOR /end REF_CHARACTERISTIC
/end GROUP
/begin GROUP PAUX_dP1_max_EC_Fault "AUX Pressure delta P 1 high"
 /begin REF_CHARACTERISTIC FCdc4_PAUX_dP1_max FCdtc_PAUX_dP1_max FCfmi_PAUX_dP1_max FCftb_PAUX_dP1_max FCspn_PAUX_dP1_max FPfl_PAUX_dP1_max FPfu_PAUX_dP1_max FPnd_PAUX_dP1_max FPsvr_PAUX_dP1_max FPsw_ext1_PAUX_dP1_max FPsw_PAUX_dP1_max /end REF_CHARACTERISTIC
/end GROUP
/begin GROUP PAUX_dP1_min_EC_Fault "AUX Pressure delta P 1 low"
 /begin REF_CHARACTERISTIC FCdc4_PAUX_dP1_min FCdtc_PAUX_dP1_min FCfmi_PAUX_dP1_min FCftb_PAUX_dP1_min FCspn_PAUX_dP1_min FPfl_PAUX_dP1_min FPfu_PAUX_dP1_min FPnd_PAUX_dP1_min FPsvr_PAUX_dP1_min FPsw_ext1_PAUX_dP1_min FPsw_PAUX_dP1_min /end REF_CHARACTERISTIC
/end GROUP
/begin GROUP PAUX_dP2_max_EC_Fault "AUX Pressure delta P 2 high"
 /begin REF_CHARACTERISTIC FCdc4_PAUX_dP2_max FCdtc_PAUX_dP2_max FCfmi_PAUX_dP2_max FCftb_PAUX_dP2_max FCspn_PAUX_dP2_max FPfl_PAUX_dP2_max FPfu_PAUX_dP2_max FPnd_PAUX_dP2_max FPsvr_PAUX_dP2_max FPsw_ext1_PAUX_dP2_max FPsw_PAUX_dP2_max /end REF_CHARACTERISTIC
/end GROUP
/begin GROUP PAUX_dP2_min_EC_Fault "AUX Pressure delta P 2 low"
 /begin REF_CHARACTERISTIC FCdc4_PAUX_dP2_min FCdtc_PAUX_dP2_min FCfmi_PAUX_dP2_min FCftb_PAUX_dP2_min FCspn_PAUX_dP2_min FPfl_PAUX_dP2_min FPfu_PAUX_dP2_min FPnd_PAUX_dP2_min FPsvr_PAUX_dP2_min FPsw_ext1_PAUX_dP2_min FPsw_PAUX_dP2_min /end REF_CHARACTERISTIC
/end GROUP
/begin GROUP PAUX1_max_EC_Fault "Auxiliary pressure 1 high"
 /begin REF_CHARACTERISTIC FCdc4_PAUX1_max FCdtc_PAUX1_max FCfmi_PAUX1_max FCftb_PAUX1_max FCspn_PAUX1_max FPfl_PAUX1_max FPfu_PAUX1_max FPnd_PAUX1_max FPsvr_PAUX1_max FPsw_ext1_PAUX1_max FPsw_PAUX1_max /end REF_CHARACTERISTIC
/end GROUP
/begin GROUP PAUX1_min_EC_Fault "Auxiliary pressure 1 low"
 /begin REF_CHARACTERISTIC FCdc4_PAUX1_min FCdtc_PAUX1_min FCfmi_PAUX1_min FCftb_PAUX1_min FCspn_PAUX1_min FPfl_PAUX1_min FPfu_PAUX1_min FPnd_PAUX1_min FPsvr_PAUX1_min FPsw_ext1_PAUX1_min FPsw_PAUX1_min /end REF_CHARACTERISTIC
/end GROUP
/begin GROUP PAUX2_max_EC_Fault "Auxiliary pressure 2 high"
 /begin REF_CHARACTERISTIC FCdc4_PAUX2_max FCdtc_PAUX2_max FCfmi_PAUX2_max FCftb_PAUX2_max FCspn_PAUX2_max FPfl_PAUX2_max FPfu_PAUX2_max FPnd_PAUX2_max FPsvr_PAUX2_max FPsw_ext1_PAUX2_max FPsw_PAUX2_max /end REF_CHARACTERISTIC
/end GROUP
/begin GROUP PAUX2_min_EC_Fault "Auxiliary pressure 2 low"
 /begin REF_CHARACTERISTIC FCdc4_PAUX2_min FCdtc_PAUX2_min FCfmi_PAUX2_min FCftb_PAUX2_min FCspn_PAUX2_min FPfl_PAUX2_min FPfu_PAUX2_min FPnd_PAUX2_min FPsvr_PAUX2_min FPsw_ext1_PAUX2_min FPsw_PAUX2_min /end REF_CHARACTERISTIC
/end GROUP
/begin GROUP PAUX3_max_EC_Fault "Auxiliary pressure 3 high"
 /begin REF_CHARACTERISTIC FCdc4_PAUX3_max FCdtc_PAUX3_max FCfmi_PAUX3_max FCftb_PAUX3_max FCspn_PAUX3_max FPfl_PAUX3_max FPfu_PAUX3_max FPnd_PAUX3_max FPsvr_PAUX3_max FPsw_ext1_PAUX3_max FPsw_PAUX3_max /end REF_CHARACTERISTIC
/end GROUP
/begin GROUP PAUX3_min_EC_Fault "Auxiliary pressure 3 low"
 /begin REF_CHARACTERISTIC FCdc4_PAUX3_min FCdtc_PAUX3_min FCfmi_PAUX3_min FCftb_PAUX3_min FCspn_PAUX3_min FPfl_PAUX3_min FPfu_PAUX3_min FPnd_PAUX3_min FPsvr_PAUX3_min FPsw_ext1_PAUX3_min FPsw_PAUX3_min /end REF_CHARACTERISTIC
/end GROUP
/begin GROUP PAUX4_max_EC_Fault "Auxiliary pressure 4 high"
 /begin REF_CHARACTERISTIC FCdc4_PAUX4_max FCdtc_PAUX4_max FCfmi_PAUX4_max FCftb_PAUX4_max FCspn_PAUX4_max FPfl_PAUX4_max FPfu_PAUX4_max FPnd_PAUX4_max FPsvr_PAUX4_max FPsw_ext1_PAUX4_max FPsw_PAUX4_max /end REF_CHARACTERISTIC
/end GROUP
/begin GROUP PAUX4_min_EC_Fault "Auxiliary pressure 4 low"
 /begin REF_CHARACTERISTIC FCdc4_PAUX4_min FCdtc_PAUX4_min FCfmi_PAUX4_min FCftb_PAUX4_min FCspn_PAUX4_min FPfl_PAUX4_min FPfu_PAUX4_min FPnd_PAUX4_min FPsvr_PAUX4_min FPsw_ext1_PAUX4_min FPsw_PAUX4_min /end REF_CHARACTERISTIC
/end GROUP
/begin GROUP PPEG_BP_EC_Fault "BP pegging offset out-of-range"
 /begin REF_CHARACTERISTIC FCdc4_PPEG_BP FCdtc_PPEG_BP FCfmi_PPEG_BP FCftb_PPEG_BP FCspn_PPEG_BP FPfl_PPEG_BP FPfu_PPEG_BP FPnd_PPEG_BP FPsvr_PPEG_BP FPsw_ext1_PPEG_BP FPsw_PPEG_BP /end REF_CHARACTERISTIC
/end GROUP
/begin GROUP PPEG_CVP1_EC_Fault "CVP1 pegging offset out-of-range"
 /begin REF_CHARACTERISTIC FCdc4_PPEG_CVP1 FCdtc_PPEG_CVP1 FCfmi_PPEG_CVP1 FCftb_PPEG_CVP1 FCspn_PPEG_CVP1 FPfl_PPEG_CVP1 FPfu_PPEG_CVP1 FPnd_PPEG_CVP1 FPsvr_PPEG_CVP1 FPsw_ext1_PPEG_CVP1 FPsw_PPEG_CVP1 /end REF_CHARACTERISTIC
/end GROUP
/begin GROUP PPEG_CVP2_EC_Fault "CVP2 pegging offset out-of-range"
 /begin REF_CHARACTERISTIC FCdc4_PPEG_CVP2 FCdtc_PPEG_CVP2 FCfmi_PPEG_CVP2 FCftb_PPEG_CVP2 FCspn_PPEG_CVP2 FPfl_PPEG_CVP2 FPfu_PPEG_CVP2 FPnd_PPEG_CVP2 FPsvr_PPEG_CVP2 FPsw_ext1_PPEG_CVP2 FPsw_PPEG_CVP2 /end REF_CHARACTERISTIC
/end GROUP
/begin GROUP PPEG_EBP_EC_Fault "EBP pegging offset out-of-range"
 /begin REF_CHARACTERISTIC FCdc4_PPEG_EBP FCdtc_PPEG_EBP FCfmi_PPEG_EBP FCftb_PPEG_EBP FCspn_PPEG_EBP FPfl_PPEG_EBP FPfu_PPEG_EBP FPnd_PPEG_EBP FPsvr_PPEG_EBP FPsw_ext1_PPEG_EBP FPsw_PPEG_EBP /end REF_CHARACTERISTIC
/end GROUP
/begin GROUP PPEG_EGRdP_EC_Fault "EGRdP pegging offset out-of-range"
 /begin REF_CHARACTERISTIC FCdc4_PPEG_EGRdP FCdtc_PPEG_EGRdP FCfmi_PPEG_EGRdP FCftb_PPEG_EGRdP FCspn_PPEG_EGRdP FPfl_PPEG_EGRdP FPfu_PPEG_EGRdP FPnd_PPEG_EGRdP FPsvr_PPEG_EGRdP FPsw_ext1_PPEG_EGRdP FPsw_PPEG_EGRdP /end REF_CHARACTERISTIC
/end GROUP
/begin GROUP PPEG_EGRHP_EC_Fault "EGRHP pegging offset out-of-range"
 /begin REF_CHARACTERISTIC FCdc4_PPEG_EGRHP FCdtc_PPEG_EGRHP FCfmi_PPEG_EGRHP FCftb_PPEG_EGRHP FCspn_PPEG_EGRHP FPfl_PPEG_EGRHP FPfu_PPEG_EGRHP FPnd_PPEG_EGRHP FPsvr_PPEG_EGRHP FPsw_ext1_PPEG_EGRHP FPsw_PPEG_EGRHP /end REF_CHARACTERISTIC
/end GROUP
/begin GROUP PPEG_EGRLP_EC_Fault "EGRLP pegging offset out-of-range"
 /begin REF_CHARACTERISTIC FCdc4_PPEG_EGRLP FCdtc_PPEG_EGRLP FCfmi_PPEG_EGRLP FCftb_PPEG_EGRLP FCspn_PPEG_EGRLP FPfl_PPEG_EGRLP FPfu_PPEG_EGRLP FPnd_PPEG_EGRLP FPsvr_PPEG_EGRLP FPsw_ext1_PPEG_EGRLP FPsw_PPEG_EGRLP /end REF_CHARACTERISTIC
/end GROUP
/begin GROUP PPEG_EGRwrP_EC_Fault "EGRwrP pegging offset out-of-range"
 /begin REF_CHARACTERISTIC FCdc4_PPEG_EGRwrP FCdtc_PPEG_EGRwrP FCfmi_PPEG_EGRwrP FCftb_PPEG_EGRwrP FCspn_PPEG_EGRwrP FPfl_PPEG_EGRwrP FPfu_PPEG_EGRwrP FPnd_PPEG_EGRwrP FPsvr_PPEG_EGRwrP FPsw_ext1_PPEG_EGRwrP FPsw_PPEG_EGRwrP /end REF_CHARACTERISTIC
/end GROUP
/begin GROUP PPEG_MAP_EC_Fault "MAP pegging reference out-of-range"
 /begin REF_CHARACTERISTIC FCdc4_PPEG_MAP FCdtc_PPEG_MAP FCfmi_PPEG_MAP FCftb_PPEG_MAP FCspn_PPEG_MAP FPfl_PPEG_MAP FPfu_PPEG_MAP FPnd_PPEG_MAP FPsvr_PPEG_MAP FPsw_ext1_PPEG_MAP FPsw_PPEG_MAP /end REF_CHARACTERISTIC
/end GROUP
/begin GROUP PPEG_TIP_EC_Fault "TIP pegging offset out-of-range"
 /begin REF_CHARACTERISTIC FCdc4_PPEG_TIP FCdtc_PPEG_TIP FCfmi_PPEG_TIP FCftb_PPEG_TIP FCspn_PPEG_TIP FPfl_PPEG_TIP FPfu_PPEG_TIP FPnd_PPEG_TIP FPsvr_PPEG_TIP FPsw_ext1_PPEG_TIP FPsw_PPEG_TIP /end REF_CHARACTERISTIC
/end GROUP
/begin GROUP PWM1_off_loVf_EC_Fault "PWM1-Gauge1 open / ground short"
 /begin REF_CHARACTERISTIC FCdc4_PWM1_off_loVf FCdtc_PWM1_off_loVf FCfmi_PWM1_off_loVf FCftb_PWM1_off_loVf FCspn_PWM1_off_loVf FPfl_PWM1_off_loVf FPfu_PWM1_off_loVf FPnd_PWM1_off_loVf FPsvr_PWM1_off_loVf FPsw_ext1_PWM1_off_loVf FPsw_PWM1_off_loVf /end REF_CHARACTERISTIC
/end GROUP
/begin GROUP PWM1_on_hiVf_EC_Fault "PWM1-Gauge1 short to power"
 /begin REF_CHARACTERISTIC FCdc4_PWM1_on_hiVf FCdtc_PWM1_on_hiVf FCfmi_PWM1_on_hiVf FCftb_PWM1_on_hiVf FCspn_PWM1_on_hiVf FPfl_PWM1_on_hiVf FPfu_PWM1_on_hiVf FPnd_PWM1_on_hiVf FPsvr_PWM1_on_hiVf FPsw_ext1_PWM1_on_hiVf FPsw_PWM1_on_hiVf /end REF_CHARACTERISTIC
/end GROUP
/begin GROUP PWM10_off_loVf_EC_Fault "PWM10 open / ground short"
 /begin REF_CHARACTERISTIC FCdc4_PWM10_off_loVf FCdtc_PWM10_off_loVf FCfmi_PWM10_off_loVf FCftb_PWM10_off_loVf FCspn_PWM10_off_loVf FPfl_PWM10_off_loVf FPfu_PWM10_off_loVf FPnd_PWM10_off_loVf FPsvr_PWM10_off_loVf FPsw_ext1_PWM10_off_loVf FPsw_PWM10_off_loVf /end REF_CHARACTERISTIC
/end GROUP
/begin GROUP PWM10_on_hiVf_EC_Fault "PWM10 short to power"
 /begin REF_CHARACTERISTIC FCdc4_PWM10_on_hiVf FCdtc_PWM10_on_hiVf FCfmi_PWM10_on_hiVf FCftb_PWM10_on_hiVf FCspn_PWM10_on_hiVf FPfl_PWM10_on_hiVf FPfu_PWM10_on_hiVf FPnd_PWM10_on_hiVf FPsvr_PWM10_on_hiVf FPsw_ext1_PWM10_on_hiVf FPsw_PWM10_on_hiVf /end REF_CHARACTERISTIC
/end GROUP
/begin GROUP PWM11_off_loVf_EC_Fault "PWM11 open / ground short"
 /begin REF_CHARACTERISTIC FCdc4_PWM11_off_loVf FCdtc_PWM11_off_loVf FCfmi_PWM11_off_loVf FCftb_PWM11_off_loVf FCspn_PWM11_off_loVf FPfl_PWM11_off_loVf FPfu_PWM11_off_loVf FPnd_PWM11_off_loVf FPsvr_PWM11_off_loVf FPsw_ext1_PWM11_off_loVf FPsw_PWM11_off_loVf /end REF_CHARACTERISTIC
/end GROUP
/begin GROUP PWM11_on_hiVf_EC_Fault "PWM11 short to power"
 /begin REF_CHARACTERISTIC FCdc4_PWM11_on_hiVf FCdtc_PWM11_on_hiVf FCfmi_PWM11_on_hiVf FCftb_PWM11_on_hiVf FCspn_PWM11_on_hiVf FPfl_PWM11_on_hiVf FPfu_PWM11_on_hiVf FPnd_PWM11_on_hiVf FPsvr_PWM11_on_hiVf FPsw_ext1_PWM11_on_hiVf FPsw_PWM11_on_hiVf /end REF_CHARACTERISTIC
/end GROUP
/begin GROUP PWM12_off_loVf_EC_Fault "PWM12 open / ground short"
 /begin REF_CHARACTERISTIC FCdc4_PWM12_off_loVf FCdtc_PWM12_off_loVf FCfmi_PWM12_off_loVf FCftb_PWM12_off_loVf FCspn_PWM12_off_loVf FPfl_PWM12_off_loVf FPfu_PWM12_off_loVf FPnd_PWM12_off_loVf FPsvr_PWM12_off_loVf FPsw_ext1_PWM12_off_loVf FPsw_PWM12_off_loVf /end REF_CHARACTERISTIC
/end GROUP
/begin GROUP PWM12_on_hiVf_EC_Fault "PWM12 short to power"
 /begin REF_CHARACTERISTIC FCdc4_PWM12_on_hiVf FCdtc_PWM12_on_hiVf FCfmi_PWM12_on_hiVf FCftb_PWM12_on_hiVf FCspn_PWM12_on_hiVf FPfl_PWM12_on_hiVf FPfu_PWM12_on_hiVf FPnd_PWM12_on_hiVf FPsvr_PWM12_on_hiVf FPsw_ext1_PWM12_on_hiVf FPsw_PWM12_on_hiVf /end REF_CHARACTERISTIC
/end GROUP
/begin GROUP PWM13_off_loVf_EC_Fault "PWM13 open / ground short"
 /begin REF_CHARACTERISTIC FCdc4_PWM13_off_loVf FCdtc_PWM13_off_loVf FCfmi_PWM13_off_loVf FCftb_PWM13_off_loVf FCspn_PWM13_off_loVf FPfl_PWM13_off_loVf FPfu_PWM13_off_loVf FPnd_PWM13_off_loVf FPsvr_PWM13_off_loVf FPsw_ext1_PWM13_off_loVf FPsw_PWM13_off_loVf /end REF_CHARACTERISTIC
/end GROUP
/begin GROUP PWM13_on_hiVf_EC_Fault "PWM13 short to power"
 /begin REF_CHARACTERISTIC FCdc4_PWM13_on_hiVf FCdtc_PWM13_on_hiVf FCfmi_PWM13_on_hiVf FCftb_PWM13_on_hiVf FCspn_PWM13_on_hiVf FPfl_PWM13_on_hiVf FPfu_PWM13_on_hiVf FPnd_PWM13_on_hiVf FPsvr_PWM13_on_hiVf FPsw_ext1_PWM13_on_hiVf FPsw_PWM13_on_hiVf /end REF_CHARACTERISTIC
/end GROUP
/begin GROUP PWM14_off_loVf_EC_Fault "PWM14 open / ground short"
 /begin REF_CHARACTERISTIC FCdc4_PWM14_off_loVf FCdtc_PWM14_off_loVf FCfmi_PWM14_off_loVf FCftb_PWM14_off_loVf FCspn_PWM14_off_loVf FPfl_PWM14_off_loVf FPfu_PWM14_off_loVf FPnd_PWM14_off_loVf FPsvr_PWM14_off_loVf FPsw_ext1_PWM14_off_loVf FPsw_PWM14_off_loVf /end REF_CHARACTERISTIC
/end GROUP
/begin GROUP PWM14_on_hiVf_EC_Fault "PWM14 short to power"
 /begin REF_CHARACTERISTIC FCdc4_PWM14_on_hiVf FCdtc_PWM14_on_hiVf FCfmi_PWM14_on_hiVf FCftb_PWM14_on_hiVf FCspn_PWM14_on_hiVf FPfl_PWM14_on_hiVf FPfu_PWM14_on_hiVf FPnd_PWM14_on_hiVf FPsvr_PWM14_on_hiVf FPsw_ext1_PWM14_on_hiVf FPsw_PWM14_on_hiVf /end REF_CHARACTERISTIC
/end GROUP
/begin GROUP PWM15_off_loVf_EC_Fault "PWM15 open / ground short"
 /begin REF_CHARACTERISTIC FCdc4_PWM15_off_loVf FCdtc_PWM15_off_loVf FCfmi_PWM15_off_loVf FCftb_PWM15_off_loVf FCspn_PWM15_off_loVf FPfl_PWM15_off_loVf FPfu_PWM15_off_loVf FPnd_PWM15_off_loVf FPsvr_PWM15_off_loVf FPsw_ext1_PWM15_off_loVf FPsw_PWM15_off_loVf /end REF_CHARACTERISTIC
/end GROUP
/begin GROUP PWM15_on_hiVf_EC_Fault "PWM15 short to power"
 /begin REF_CHARACTERISTIC FCdc4_PWM15_on_hiVf FCdtc_PWM15_on_hiVf FCfmi_PWM15_on_hiVf FCftb_PWM15_on_hiVf FCspn_PWM15_on_hiVf FPfl_PWM15_on_hiVf FPfu_PWM15_on_hiVf FPnd_PWM15_on_hiVf FPsvr_PWM15_on_hiVf FPsw_ext1_PWM15_on_hiVf FPsw_PWM15_on_hiVf /end REF_CHARACTERISTIC
/end GROUP
/begin GROUP PWM16_off_loVf_EC_Fault "PWM16 open / ground short"
 /begin REF_CHARACTERISTIC FCdc4_PWM16_off_loVf FCdtc_PWM16_off_loVf FCfmi_PWM16_off_loVf FCftb_PWM16_off_loVf FCspn_PWM16_off_loVf FPfl_PWM16_off_loVf FPfu_PWM16_off_loVf FPnd_PWM16_off_loVf FPsvr_PWM16_off_loVf FPsw_ext1_PWM16_off_loVf FPsw_PWM16_off_loVf /end REF_CHARACTERISTIC
/end GROUP
/begin GROUP PWM16_on_hiVf_EC_Fault "PWM16 short to power"
 /begin REF_CHARACTERISTIC FCdc4_PWM16_on_hiVf FCdtc_PWM16_on_hiVf FCfmi_PWM16_on_hiVf FCftb_PWM16_on_hiVf FCspn_PWM16_on_hiVf FPfl_PWM16_on_hiVf FPfu_PWM16_on_hiVf FPnd_PWM16_on_hiVf FPsvr_PWM16_on_hiVf FPsw_ext1_PWM16_on_hiVf FPsw_PWM16_on_hiVf /end REF_CHARACTERISTIC
/end GROUP
/begin GROUP PWM17_off_loVf_EC_Fault "PWM17 open / ground short"
 /begin REF_CHARACTERISTIC FCdc4_PWM17_off_loVf FCdtc_PWM17_off_loVf FCfmi_PWM17_off_loVf FCftb_PWM17_off_loVf FCspn_PWM17_off_loVf FPfl_PWM17_off_loVf FPfu_PWM17_off_loVf FPnd_PWM17_off_loVf FPsvr_PWM17_off_loVf FPsw_ext1_PWM17_off_loVf FPsw_PWM17_off_loVf /end REF_CHARACTERISTIC
/end GROUP
/begin GROUP PWM17_on_hiVf_EC_Fault "PWM17 short to power"
 /begin REF_CHARACTERISTIC FCdc4_PWM17_on_hiVf FCdtc_PWM17_on_hiVf FCfmi_PWM17_on_hiVf FCftb_PWM17_on_hiVf FCspn_PWM17_on_hiVf FPfl_PWM17_on_hiVf FPfu_PWM17_on_hiVf FPnd_PWM17_on_hiVf FPsvr_PWM17_on_hiVf FPsw_ext1_PWM17_on_hiVf FPsw_PWM17_on_hiVf /end REF_CHARACTERISTIC
/end GROUP
/begin GROUP PWM18_off_loVf_EC_Fault "PWM18 open / ground short"
 /begin REF_CHARACTERISTIC FCdc4_PWM18_off_loVf FCdtc_PWM18_off_loVf FCfmi_PWM18_off_loVf FCftb_PWM18_off_loVf FCspn_PWM18_off_loVf FPfl_PWM18_off_loVf FPfu_PWM18_off_loVf FPnd_PWM18_off_loVf FPsvr_PWM18_off_loVf FPsw_ext1_PWM18_off_loVf FPsw_PWM18_off_loVf /end REF_CHARACTERISTIC
/end GROUP
/begin GROUP PWM18_on_hiVf_EC_Fault "PWM18 short to power"
 /begin REF_CHARACTERISTIC FCdc4_PWM18_on_hiVf FCdtc_PWM18_on_hiVf FCfmi_PWM18_on_hiVf FCftb_PWM18_on_hiVf FCspn_PWM18_on_hiVf FPfl_PWM18_on_hiVf FPfu_PWM18_on_hiVf FPnd_PWM18_on_hiVf FPsvr_PWM18_on_hiVf FPsw_ext1_PWM18_on_hiVf FPsw_PWM18_on_hiVf /end REF_CHARACTERISTIC
/end GROUP
/begin GROUP PWM19_off_loVf_EC_Fault "PWM19 open / ground short"
 /begin REF_CHARACTERISTIC FCdc4_PWM19_off_loVf FCdtc_PWM19_off_loVf FCfmi_PWM19_off_loVf FCftb_PWM19_off_loVf FCspn_PWM19_off_loVf FPfl_PWM19_off_loVf FPfu_PWM19_off_loVf FPnd_PWM19_off_loVf FPsvr_PWM19_off_loVf FPsw_ext1_PWM19_off_loVf FPsw_PWM19_off_loVf /end REF_CHARACTERISTIC
/end GROUP
/begin GROUP PWM19_on_hiVf_EC_Fault "PWM19 short to power"
 /begin REF_CHARACTERISTIC FCdc4_PWM19_on_hiVf FCdtc_PWM19_on_hiVf FCfmi_PWM19_on_hiVf FCftb_PWM19_on_hiVf FCspn_PWM19_on_hiVf FPfl_PWM19_on_hiVf FPfu_PWM19_on_hiVf FPnd_PWM19_on_hiVf FPsvr_PWM19_on_hiVf FPsw_ext1_PWM19_on_hiVf FPsw_PWM19_on_hiVf /end REF_CHARACTERISTIC
/end GROUP
/begin GROUP PWM2_off_loVf_EC_Fault "PWM2-Gauge2 open / ground short"
 /begin REF_CHARACTERISTIC FCdc4_PWM2_off_loVf FCdtc_PWM2_off_loVf FCfmi_PWM2_off_loVf FCftb_PWM2_off_loVf FCspn_PWM2_off_loVf FPfl_PWM2_off_loVf FPfu_PWM2_off_loVf FPnd_PWM2_off_loVf FPsvr_PWM2_off_loVf FPsw_ext1_PWM2_off_loVf FPsw_PWM2_off_loVf /end REF_CHARACTERISTIC
/end GROUP
/begin GROUP PWM2_on_hiVf_EC_Fault "PWM2-Gauge2 short to power"
 /begin REF_CHARACTERISTIC FCdc4_PWM2_on_hiVf FCdtc_PWM2_on_hiVf FCfmi_PWM2_on_hiVf FCftb_PWM2_on_hiVf FCspn_PWM2_on_hiVf FPfl_PWM2_on_hiVf FPfu_PWM2_on_hiVf FPnd_PWM2_on_hiVf FPsvr_PWM2_on_hiVf FPsw_ext1_PWM2_on_hiVf FPsw_PWM2_on_hiVf /end REF_CHARACTERISTIC
/end GROUP
/begin GROUP PWM20_off_loVf_EC_Fault "PWM20 open / ground short"
 /begin REF_CHARACTERISTIC FCdc4_PWM20_off_loVf FCdtc_PWM20_off_loVf FCfmi_PWM20_off_loVf FCftb_PWM20_off_loVf FCspn_PWM20_off_loVf FPfl_PWM20_off_loVf FPfu_PWM20_off_loVf FPnd_PWM20_off_loVf FPsvr_PWM20_off_loVf FPsw_ext1_PWM20_off_loVf FPsw_PWM20_off_loVf /end REF_CHARACTERISTIC
/end GROUP
/begin GROUP PWM20_on_hiVf_EC_Fault "PWM20 short to power"
 /begin REF_CHARACTERISTIC FCdc4_PWM20_on_hiVf FCdtc_PWM20_on_hiVf FCfmi_PWM20_on_hiVf FCftb_PWM20_on_hiVf FCspn_PWM20_on_hiVf FPfl_PWM20_on_hiVf FPfu_PWM20_on_hiVf FPnd_PWM20_on_hiVf FPsvr_PWM20_on_hiVf FPsw_ext1_PWM20_on_hiVf FPsw_PWM20_on_hiVf /end REF_CHARACTERISTIC
/end GROUP
/begin GROUP PWM21_off_loVf_EC_Fault "PWM21 open / ground short"
 /begin REF_CHARACTERISTIC FCdc4_PWM21_off_loVf FCdtc_PWM21_off_loVf FCfmi_PWM21_off_loVf FCftb_PWM21_off_loVf FCspn_PWM21_off_loVf FPfl_PWM21_off_loVf FPfu_PWM21_off_loVf FPnd_PWM21_off_loVf FPsvr_PWM21_off_loVf FPsw_ext1_PWM21_off_loVf FPsw_PWM21_off_loVf /end REF_CHARACTERISTIC
/end GROUP
/end MODULE
/end PROJECT
