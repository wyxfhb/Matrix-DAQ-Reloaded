ASAP2_VERSION 1 61
/begin PROJECT Econtrols_4G "4G Test"
/begin HEADER "4G A2L Configuration" PROJECT_NO EControls4G /* config for version control */ VERSION "$Revision: 82130 $:" /* config for version control */ /end HEADER
/begin MODULE EControls_4G_SH2A "EControls 4G"
/begin MOD_COMMON "" DEPOSIT ABSOLUTE BYTE_ORDER MSB_FIRST /end MOD_COMMON
/* Define the Record Layouts */
/begin RECORD_LAYOUT ECIPP_ALIGNMENT_UBYTE FNC_VALUES 1 UBYTE COLUMN_DIR DIRECT /end RECORD_LAYOUT
/begin RECORD_LAYOUT ECIPP_ALIGNMENT_UWORD FNC_VALUES 1 UWORD COLUMN_DIR DIRECT /end RECORD_LAYOUT
/begin RECORD_LAYOUT ECIPP_ALIGNMENT_SWORD FNC_VALUES 1 SWORD COLUMN_DIR DIRECT /end RECORD_LAYOUT
/begin RECORD_LAYOUT ECIPP_Lookup_SWORD AXIS_PTS_X 1 SWORD INDEX_INCR DIRECT /end RECORD_LAYOUT
/begin RECORD_LAYOUT ECIPP_ALIGNMENT_SLONG FNC_VALUES 1 SLONG COLUMN_DIR DIRECT /end RECORD_LAYOUT
/begin MEASUREMENT VE "VE final" UWORD Compu_VE 0 0 0 199.996948242188 ECU_ADDRESS 0x010000A0 /end MEASUREMENT
/begin COMPU_METHOD Compu_VE " " RAT_FUNC "%.1" "%" COEFFS 0 327.68 0 0 0 1 /end COMPU_METHOD
/begin MEASUREMENT gov_MAP_d "Governor MAP_d" UWORD Compu_gov_MAP_d 0 0 0 255.99609375 ECU_ADDRESS 0x010002C0 /end MEASUREMENT
/begin COMPU_METHOD Compu_gov_MAP_d " " RAT_FUNC "%.2" "psia" COEFFS 0 256 0 0 0 1 /end COMPU_METHOD
/begin MEASUREMENT gov_MAPdt_d "Governor MAPdt_d" SWORD Compu_gov_MAPdt_d 0 0 -4000 3999.8779296875 ECU_ADDRESS 0x010002C8 /end MEASUREMENT
/begin COMPU_METHOD Compu_gov_MAPdt_d " " RAT_FUNC "%.1" "psi/sec" COEFFS 0 8.192 0 0 0 1 /end COMPU_METHOD
/begin MEASUREMENT TPS_min_gov_pct "TPS_min_gov_pct" UWORD Compu_TPS_min_gov_pct 0 0 0 99.9984741210938 ECU_ADDRESS 0x010002D0 /end MEASUREMENT
/begin COMPU_METHOD Compu_TPS_min_gov_pct " " RAT_FUNC "%.1" "%" COEFFS 0 655.36 0 0 0 1 /end COMPU_METHOD
/begin MEASUREMENT TPS_max_gov_pct "TPS_max_gov_pct" UWORD Compu_TPS_max_gov_pct 0 0 0 99.9984741210938 ECU_ADDRESS 0x010002D8 /end MEASUREMENT
/begin COMPU_METHOD Compu_TPS_max_gov_pct " " RAT_FUNC "%.1" "%" COEFFS 0 655.36 0 0 0 1 /end COMPU_METHOD
/begin MEASUREMENT TPS_GovN_pct "TPS_GovN_pct" UWORD Compu_TPS_GovN_pct 0 0 0 99.9984741210938 ECU_ADDRESS 0x01000310 /end MEASUREMENT
/begin COMPU_METHOD Compu_TPS_GovN_pct " " RAT_FUNC "%.1" "%" COEFFS 0 655.36 0 0 0 1 /end COMPU_METHOD
/begin MEASUREMENT spkgv_mod "Spark governor adv offset" SWORD Compu_spkgv_mod 0 0 -2048 2047.9375 ECU_ADDRESS 0x010003D0 /end MEASUREMENT
/begin COMPU_METHOD Compu_spkgv_mod " " RAT_FUNC "%.1" "CAD BTDC" COEFFS 0 16 0 0 0 1 /end COMPU_METHOD
/begin MEASUREMENT gov_gain_man "RPM gain selection{gov_gain_man&0xff=0x00:Lookup}{gov_gain_man&0xff=0x01:Fixed}" UBYTE gov_gain_man_COMPU_VTAB 0 0 0 255 ECU_ADDRESS 0x01000850 BIT_MASK 0xff /end MEASUREMENT
/begin COMPU_METHOD gov_gain_man_COMPU_VTAB "Verbal Table" TAB_VERB "%.0" "list" COMPU_TAB_REF gov_gain_man_COMPU_VTAB_REF /end COMPU_METHOD
/begin COMPU_VTAB gov_gain_man_COMPU_VTAB_REF "Verbal Table" TAB_VERB 2 0x00 "Lookup" 0x01 "Fixed" DEFAULT_VALUE "UNKNOWN" /end COMPU_VTAB
/begin MEASUREMENT MAP_noload "MAP_noload" UWORD Compu_MAP_noload 0 0 0 255.99609375 ECU_ADDRESS 0x010009A0 /end MEASUREMENT
/begin COMPU_METHOD Compu_MAP_noload " " RAT_FUNC "%.2" "psia" COEFFS 0 256 0 0 0 1 /end COMPU_METHOD
/begin MEASUREMENT MAP_fullload "MAP_fullload" UWORD Compu_MAP_fullload 0 0 0 255.99609375 ECU_ADDRESS 0x010009A8 /end MEASUREMENT
/begin COMPU_METHOD Compu_MAP_fullload " " RAT_FUNC "%.2" "psia" COEFFS 0 256 0 0 0 1 /end COMPU_METHOD
/begin CHARACTERISTIC LG_gov_ena "Min governor control{LG_gov_ena&0xff=0x00:Disabled}{LG_gov_ena&0xff=0x01:Isochronous}{LG_gov_ena&0xff=0x02:Droop}" VALUE 0x001C9DD4 /* @ECU_Address@LG_gov_ena@0x010009E8@ */ ECIPP_ALIGNMENT_UBYTE 255 LG_gov_ena_COMPU_VTAB 0 255 BIT_MASK 0xff /end CHARACTERISTIC
/begin COMPU_METHOD LG_gov_ena_COMPU_VTAB "Verbal Table" TAB_VERB "%.0" "list" COMPU_TAB_REF LG_gov_ena_COMPU_VTAB_REF /end COMPU_METHOD
/begin COMPU_VTAB LG_gov_ena_COMPU_VTAB_REF "Verbal Table" TAB_VERB 3 0x00 "Disabled" 0x01 "Isochronous" 0x02 "Droop" DEFAULT_VALUE "UNKNOWN" /end COMPU_VTAB
/begin CHARACTERISTIC HG_gov_ena "Max governor control{HG_gov_ena&0xff=0x00:Disabled}{HG_gov_ena&0xff=0x01:Isochronous}{HG_gov_ena&0xff=0x02:Droop}" VALUE 0x001C9DB4 /* @ECU_Address@HG_gov_ena@0x010009F0@ */ ECIPP_ALIGNMENT_UBYTE 255 HG_gov_ena_COMPU_VTAB 0 255 BIT_MASK 0xff /end CHARACTERISTIC
/begin COMPU_METHOD HG_gov_ena_COMPU_VTAB "Verbal Table" TAB_VERB "%.0" "list" COMPU_TAB_REF HG_gov_ena_COMPU_VTAB_REF /end COMPU_METHOD
/begin COMPU_VTAB HG_gov_ena_COMPU_VTAB_REF "Verbal Table" TAB_VERB 3 0x00 "Disabled" 0x01 "Isochronous" 0x02 "Droop" DEFAULT_VALUE "UNKNOWN" /end COMPU_VTAB
/begin MEASUREMENT Kp_gov "Kp_rpm gain" SWORD Compu_Kp_gov 0 0 -3125 3124.90463256836 ECU_ADDRESS 0x010009F8 /end MEASUREMENT
/begin COMPU_METHOD Compu_Kp_gov " " RAT_FUNC "%.1" "% / krpm" COEFFS 0 10.48576 0 0 0 1 /end COMPU_METHOD
/begin MEASUREMENT Kd_gov "Kd_rpm gain" SWORD Compu_Kd_gov 0 0 -1600 1599.951171875 ECU_ADDRESS 0x01000A00 /end MEASUREMENT
/begin COMPU_METHOD Compu_Kd_gov " " RAT_FUNC "%.2" "% / (krpm/sec)" COEFFS 0 20.48 0 0 0 1 /end COMPU_METHOD
/begin CHARACTERISTIC mingv_auth_min "Min governor authority low" VALUE 0x001C9DE4 /* @ECU_Address@mingv_auth_min@0x01000A08@ */ ECIPP_ALIGNMENT_UWORD 100 Compu_mingv_auth_min 0 99.9984741210938 /end CHARACTERISTIC
/begin COMPU_METHOD Compu_mingv_auth_min " " RAT_FUNC "%.1" "%" COEFFS 0 655.36 0 0 0 1 /end COMPU_METHOD
/begin CHARACTERISTIC mingv_auth_max "Min governor authority high" VALUE 0x001C9DE6 /* @ECU_Address@mingv_auth_max@0x01000A10@ */ ECIPP_ALIGNMENT_UWORD 100 Compu_mingv_auth_max 0 99.9984741210938 /end CHARACTERISTIC
/begin COMPU_METHOD Compu_mingv_auth_max " " RAT_FUNC "%.1" "%" COEFFS 0 655.36 0 0 0 1 /end COMPU_METHOD
/begin MEASUREMENT KMAPdt_gov "dMAP/dt gain" SWORD Compu_KMAPdt_gov 0 0 -1000 999.969482421875 ECU_ADDRESS 0x01000A18 /end MEASUREMENT
/begin COMPU_METHOD Compu_KMAPdt_gov " " RAT_FUNC "%.1" "1 / sec" COEFFS 0 32.768 0 0 0 1 /end COMPU_METHOD
/begin MEASUREMENT Ki_gov "Ki_rpm gain" SWORD Compu_Ki_gov 0 0 -12207.03125 12206.6587209702 ECU_ADDRESS 0x01000A20 /end MEASUREMENT
/begin COMPU_METHOD Compu_Ki_gov " " RAT_FUNC "%.1" "% / krpm / sec" COEFFS 0 2.68435456 0 0 0 1 /end COMPU_METHOD
/begin MEASUREMENT gov_I_frz "Integrator freeze" SWORD Compu_gov_I_frz 0 0 -64000 63998.046875 ECU_ADDRESS 0x01000A28 /end MEASUREMENT
/begin COMPU_METHOD Compu_gov_I_frz " " RAT_FUNC "%.0" "rpm / sec" COEFFS 0 0.512 0 0 0 1 /end COMPU_METHOD
/begin CHARACTERISTIC strt_min_idle "Single-point start init speed" VALUE 0x001c84fa /* @ECU_Address@strt_min_idle@0x01000A90@ */ ECIPP_ALIGNMENT_UWORD 65535 Compu_strt_min_idle 0 65535 /end CHARACTERISTIC
/begin COMPU_METHOD Compu_strt_min_idle " " RAT_FUNC "%.0" "rpm" COEFFS 0 1 0 0 0 1 /end COMPU_METHOD
/begin CHARACTERISTIC strt_min_idle_dcy "Single-point start init speed ramp" VALUE 0x001c84fc /* @ECU_Address@strt_min_idle_dcy@0x01000A98@ */ ECIPP_ALIGNMENT_UWORD 1000 Compu_strt_min_idle_dcy 0 999.984741210938 /end CHARACTERISTIC
/begin COMPU_METHOD Compu_strt_min_idle_dcy " " RAT_FUNC "%.0" "rpm / sec" COEFFS 0 65.536 0 0 0 1 /end COMPU_METHOD
/begin CHARACTERISTIC strt_min_FPP "Start min FPP" VALUE 0x001c84f8 /* @ECU_Address@strt_min_FPP@0x01000AA0@ */ ECIPP_ALIGNMENT_UWORD 100 Compu_strt_min_FPP 0 99.9984741210938 /end CHARACTERISTIC
/begin COMPU_METHOD Compu_strt_min_FPP " " RAT_FUNC "%.1" "%" COEFFS 0 655.36 0 0 0 1 /end COMPU_METHOD
/begin MEASUREMENT rpmdtdz_Kd "Kd_rpm dead-zone" SWORD Compu_rpmdtdz_Kd 0 0 -64000 63998.046875 ECU_ADDRESS 0x01000BE8 /end MEASUREMENT
/begin COMPU_METHOD Compu_rpmdtdz_Kd " " RAT_FUNC "%.0" "rpm/sec" COEFFS 0 0.512 0 0 0 1 /end COMPU_METHOD
/begin MEASUREMENT rpmdz_Kp "Kp_rpm dead-zone" SWORD Compu_rpmdz_Kp 0 0 -32768 32767 ECU_ADDRESS 0x01000BF8 /end MEASUREMENT
/begin COMPU_METHOD Compu_rpmdz_Kp " " RAT_FUNC "%.0" "rpm" COEFFS 0 1 0 0 0 1 /end COMPU_METHOD
/begin CHARACTERISTIC minigv_appdlt "Min isoc approach delta" VALUE 0x001C9DEC /* @ECU_Address@minigv_appdlt@0x01000C00@ */ ECIPP_ALIGNMENT_UWORD 65535 Compu_minigv_appdlt 0 65535 /end CHARACTERISTIC
/begin COMPU_METHOD Compu_minigv_appdlt " " RAT_FUNC "%.0" "rpm" COEFFS 0 1 0 0 0 1 /end COMPU_METHOD
/begin CHARACTERISTIC maxigv_appdlt "Max igov approach delta" VALUE 0x001C9DCC /* @ECU_Address@maxigv_appdlt@0x01000C08@ */ ECIPP_ALIGNMENT_UWORD 65535 Compu_maxigv_appdlt 0 65535 /end CHARACTERISTIC
/begin COMPU_METHOD Compu_maxigv_appdlt " " RAT_FUNC "%.0" "rpm" COEFFS 0 1 0 0 0 1 /end COMPU_METHOD
/begin CHARACTERISTIC minigv_apprdt "Min isoc approach rpmdt" VALUE 0x001C9DEE /* @ECU_Address@minigv_apprdt@0x01000C10@ */ ECIPP_ALIGNMENT_SWORD 63998 Compu_minigv_apprdt -64000 63998.046875 /end CHARACTERISTIC
/begin COMPU_METHOD Compu_minigv_apprdt " " RAT_FUNC "%.0" "rpm / sec" COEFFS 0 0.512 0 0 0 1 /end COMPU_METHOD
/begin CHARACTERISTIC maxigv_apprdt "Max igov approach rpmdt" VALUE 0x001C9DCE /* @ECU_Address@maxigv_apprdt@0x01000C18@ */ ECIPP_ALIGNMENT_SWORD 63998 Compu_maxigv_apprdt -64000 63998.046875 /end CHARACTERISTIC
/begin COMPU_METHOD Compu_maxigv_apprdt " " RAT_FUNC "%.0" "rpm / sec" COEFFS 0 0.512 0 0 0 1 /end COMPU_METHOD
/begin CHARACTERISTIC minigv_Iinit "Min isoc approach I init" VALUE 0x001C9DEA /* @ECU_Address@minigv_Iinit@0x01000C20@ */ ECIPP_ALIGNMENT_UWORD 3200 Compu_minigv_Iinit 0 3199.951171875 /end CHARACTERISTIC
/begin COMPU_METHOD Compu_minigv_Iinit " " RAT_FUNC "%.1" "% / (krpm/sec)" COEFFS 0 20.48 0 0 0 1 /end COMPU_METHOD
/begin CHARACTERISTIC maxigv_Iinit "Max isoc approach I init" VALUE 0x001C9DCA /* @ECU_Address@maxigv_Iinit@0x01000C28@ */ ECIPP_ALIGNMENT_UWORD 3200 Compu_maxigv_Iinit 0 3199.951171875 /end CHARACTERISTIC
/begin COMPU_METHOD Compu_maxigv_Iinit " " RAT_FUNC "%.1" "% / (krpm/sec)" COEFFS 0 20.48 0 0 0 1 /end COMPU_METHOD
/begin MEASUREMENT rpmdz_Ki "Ki_rpm dead-zone" SWORD Compu_rpmdz_Ki 0 0 -32768 32767 ECU_ADDRESS 0x01000CB0 /end MEASUREMENT
/begin COMPU_METHOD Compu_rpmdz_Ki " " RAT_FUNC "%.0" "rpm" COEFFS 0 1 0 0 0 1 /end COMPU_METHOD
/begin CHARACTERISTIC Gov1_ena "Gov1 control{Gov1_ena&0xff=0x00:Disabled}{Gov1_ena&0xff=0x01:Isochronous}{Gov1_ena&0xff=0x02:Droop}" VALUE 0x001C9D30 /* @ECU_Address@Gov1_ena@0x01000CB8@ */ ECIPP_ALIGNMENT_UBYTE 255 Gov1_ena_COMPU_VTAB 0 255 BIT_MASK 0xff /end CHARACTERISTIC
/begin COMPU_METHOD Gov1_ena_COMPU_VTAB "Verbal Table" TAB_VERB "%.0" "list" COMPU_TAB_REF Gov1_ena_COMPU_VTAB_REF /end COMPU_METHOD
/begin COMPU_VTAB Gov1_ena_COMPU_VTAB_REF "Verbal Table" TAB_VERB 3 0x00 "Disabled" 0x01 "Isochronous" 0x02 "Droop" DEFAULT_VALUE "UNKNOWN" /end COMPU_VTAB
/begin CHARACTERISTIC Gov2_ena "Gov2 control{Gov2_ena&0xff=0x00:Disabled}{Gov2_ena&0xff=0x01:Isochronous}{Gov2_ena&0xff=0x02:Droop}" VALUE 0x001C9D5C /* @ECU_Address@Gov2_ena@0x01000CC0@ */ ECIPP_ALIGNMENT_UBYTE 255 Gov2_ena_COMPU_VTAB 0 255 BIT_MASK 0xff /end CHARACTERISTIC
/begin COMPU_METHOD Gov2_ena_COMPU_VTAB "Verbal Table" TAB_VERB "%.0" "list" COMPU_TAB_REF Gov2_ena_COMPU_VTAB_REF /end COMPU_METHOD
/begin COMPU_VTAB Gov2_ena_COMPU_VTAB_REF "Verbal Table" TAB_VERB 3 0x00 "Disabled" 0x01 "Isochronous" 0x02 "Droop" DEFAULT_VALUE "UNKNOWN" /end COMPU_VTAB
/begin CHARACTERISTIC Gov3_ena "Gov3 control{Gov3_ena&0xff=0x00:Disabled}{Gov3_ena&0xff=0x01:Isochronous}{Gov3_ena&0xff=0x02:Droop}" VALUE 0x001C9D88 /* @ECU_Address@Gov3_ena@0x01000CC8@ */ ECIPP_ALIGNMENT_UBYTE 255 Gov3_ena_COMPU_VTAB 0 255 BIT_MASK 0xff /end CHARACTERISTIC
/begin COMPU_METHOD Gov3_ena_COMPU_VTAB "Verbal Table" TAB_VERB "%.0" "list" COMPU_TAB_REF Gov3_ena_COMPU_VTAB_REF /end COMPU_METHOD
/begin COMPU_VTAB Gov3_ena_COMPU_VTAB_REF "Verbal Table" TAB_VERB 3 0x00 "Disabled" 0x01 "Isochronous" 0x02 "Droop" DEFAULT_VALUE "UNKNOWN" /end COMPU_VTAB
/begin CHARACTERISTIC mindgv_I_min "Min droop integrator low" VALUE 0x001C9DDC /* @ECU_Address@mindgv_I_min@0x01000CD0@ */ ECIPP_ALIGNMENT_SWORD 800 Compu_mindgv_I_min -800 799.9755859375 /end CHARACTERISTIC
/begin COMPU_METHOD Compu_mindgv_I_min " " RAT_FUNC "%.1" "%" COEFFS 0 40.96 0 0 0 1 /end COMPU_METHOD
/begin CHARACTERISTIC mindgv_I_max "Min droop integrator high" VALUE 0x001C9DDE /* @ECU_Address@mindgv_I_max@0x01000CD8@ */ ECIPP_ALIGNMENT_SWORD 800 Compu_mindgv_I_max -800 799.9755859375 /end CHARACTERISTIC
/begin COMPU_METHOD Compu_mindgv_I_max " " RAT_FUNC "%.1" "%" COEFFS 0 40.96 0 0 0 1 /end COMPU_METHOD
/begin CHARACTERISTIC minigv_I_min "Min isoc integrator low" VALUE 0x001C9DE0 /* @ECU_Address@minigv_I_min@0x01000CE0@ */ ECIPP_ALIGNMENT_SWORD 800 Compu_minigv_I_min -800 799.9755859375 /end CHARACTERISTIC
/begin COMPU_METHOD Compu_minigv_I_min " " RAT_FUNC "%.1" "%" COEFFS 0 40.96 0 0 0 1 /end COMPU_METHOD
/begin CHARACTERISTIC minigv_I_max "Min isoc integrator high" VALUE 0x001C9DE2 /* @ECU_Address@minigv_I_max@0x01000CE8@ */ ECIPP_ALIGNMENT_SWORD 800 Compu_minigv_I_max -800 799.9755859375 /end CHARACTERISTIC
/begin COMPU_METHOD Compu_minigv_I_max " " RAT_FUNC "%.1" "%" COEFFS 0 40.96 0 0 0 1 /end COMPU_METHOD
/begin CHARACTERISTIC mingv_nomload "Min droop nominal load" VALUE 0x001C9DE8 /* @ECU_Address@mingv_nomload@0x01000CF0@ */ ECIPP_ALIGNMENT_UWORD 1600 Compu_mingv_nomload 0 1599.9755859375 /end CHARACTERISTIC
/begin COMPU_METHOD Compu_mingv_nomload " " RAT_FUNC "%.1" "%" COEFFS 0 40.96 0 0 0 1 /end COMPU_METHOD
/begin CHARACTERISTIC maxdgv_I_min "Max droop integrator low" VALUE 0x001C9DBC /* @ECU_Address@maxdgv_I_min@0x01000CF8@ */ ECIPP_ALIGNMENT_SWORD 800 Compu_maxdgv_I_min -800 799.9755859375 /end CHARACTERISTIC
/begin COMPU_METHOD Compu_maxdgv_I_min " " RAT_FUNC "%.1" "%" COEFFS 0 40.96 0 0 0 1 /end COMPU_METHOD
/begin CHARACTERISTIC maxdgv_I_max "Max droop integrator high" VALUE 0x001C9DBE /* @ECU_Address@maxdgv_I_max@0x01000D00@ */ ECIPP_ALIGNMENT_SWORD 800 Compu_maxdgv_I_max -800 799.9755859375 /end CHARACTERISTIC
/begin COMPU_METHOD Compu_maxdgv_I_max " " RAT_FUNC "%.1" "%" COEFFS 0 40.96 0 0 0 1 /end COMPU_METHOD
/begin CHARACTERISTIC maxigv_I_min "Max isoc integrator low" VALUE 0x001C9DC0 /* @ECU_Address@maxigv_I_min@0x01000D08@ */ ECIPP_ALIGNMENT_SWORD 800 Compu_maxigv_I_min -800 799.9755859375 /end CHARACTERISTIC
/begin COMPU_METHOD Compu_maxigv_I_min " " RAT_FUNC "%.1" "%" COEFFS 0 40.96 0 0 0 1 /end COMPU_METHOD
/begin CHARACTERISTIC maxigv_I_max "Max isoc integrator high" VALUE 0x001C9DC2 /* @ECU_Address@maxigv_I_max@0x01000D10@ */ ECIPP_ALIGNMENT_SWORD 800 Compu_maxigv_I_max -800 799.9755859375 /end CHARACTERISTIC
/begin COMPU_METHOD Compu_maxigv_I_max " " RAT_FUNC "%.1" "%" COEFFS 0 40.96 0 0 0 1 /end COMPU_METHOD
/begin CHARACTERISTIC maxgv_nomload "Max droop nominal load" VALUE 0x001C9DC8 /* @ECU_Address@maxgv_nomload@0x01000D18@ */ ECIPP_ALIGNMENT_UWORD 1600 Compu_maxgv_nomload 0 1599.9755859375 /end CHARACTERISTIC
/begin COMPU_METHOD Compu_maxgv_nomload " " RAT_FUNC "%.1" "%" COEFFS 0 40.96 0 0 0 1 /end COMPU_METHOD
/begin CHARACTERISTIC maxgv_auth_min "Max governor authority low" VALUE 0x001C9DC4 /* @ECU_Address@maxgv_auth_min@0x01000D20@ */ ECIPP_ALIGNMENT_UWORD 100 Compu_maxgv_auth_min 0 99.9984741210938 /end CHARACTERISTIC
/begin COMPU_METHOD Compu_maxgv_auth_min " " RAT_FUNC "%.1" "%" COEFFS 0 655.36 0 0 0 1 /end COMPU_METHOD
/begin CHARACTERISTIC maxgv_auth_max "Max governor authority high" VALUE 0x001C9DC6 /* @ECU_Address@maxgv_auth_max@0x01000D28@ */ ECIPP_ALIGNMENT_UWORD 100 Compu_maxgv_auth_max 0 99.9984741210938 /end CHARACTERISTIC
/begin COMPU_METHOD Compu_maxgv_auth_max " " RAT_FUNC "%.1" "%" COEFFS 0 655.36 0 0 0 1 /end COMPU_METHOD
/begin CHARACTERISTIC Gov1_rpm "Gov1 target speed" VALUE 0x001C9D36 /* @ECU_Address@Gov1_rpm@0x01000D30@ */ ECIPP_ALIGNMENT_UWORD 65535 Compu_Gov1_rpm 0 65535 /end CHARACTERISTIC
/begin COMPU_METHOD Compu_Gov1_rpm " " RAT_FUNC "%.0" "rpm" COEFFS 0 1 0 0 0 1 /end COMPU_METHOD
/begin CHARACTERISTIC Gov1d_I_min "Gov1 droop integrator low" VALUE 0x001C9D38 /* @ECU_Address@Gov1d_I_min@0x01000D38@ */ ECIPP_ALIGNMENT_SWORD 800 Compu_Gov1d_I_min -800 799.9755859375 /end CHARACTERISTIC
/begin COMPU_METHOD Compu_Gov1d_I_min " " RAT_FUNC "%.1" "%" COEFFS 0 40.96 0 0 0 1 /end COMPU_METHOD
/begin CHARACTERISTIC Gov1d_I_max "Gov1 droop integrator high" VALUE 0x001C9D3A /* @ECU_Address@Gov1d_I_max@0x01000D40@ */ ECIPP_ALIGNMENT_SWORD 800 Compu_Gov1d_I_max -800 799.9755859375 /end CHARACTERISTIC
/begin COMPU_METHOD Compu_Gov1d_I_max " " RAT_FUNC "%.1" "%" COEFFS 0 40.96 0 0 0 1 /end COMPU_METHOD
/begin CHARACTERISTIC Gov1i_I_min "Gov1 isoc integrator low" VALUE 0x001C9D3C /* @ECU_Address@Gov1i_I_min@0x01000D48@ */ ECIPP_ALIGNMENT_SWORD 800 Compu_Gov1i_I_min -800 799.9755859375 /end CHARACTERISTIC
/begin COMPU_METHOD Compu_Gov1i_I_min " " RAT_FUNC "%.1" "%" COEFFS 0 40.96 0 0 0 1 /end COMPU_METHOD
/begin CHARACTERISTIC Gov1i_I_max "Gov1 isoc integrator high" VALUE 0x001C9D3E /* @ECU_Address@Gov1i_I_max@0x01000D50@ */ ECIPP_ALIGNMENT_SWORD 800 Compu_Gov1i_I_max -800 799.9755859375 /end CHARACTERISTIC
/begin COMPU_METHOD Compu_Gov1i_I_max " " RAT_FUNC "%.1" "%" COEFFS 0 40.96 0 0 0 1 /end COMPU_METHOD
/begin CHARACTERISTIC Gov1_nomload "Gov1 droop nominal load" VALUE 0x001C9D44 /* @ECU_Address@Gov1_nomload@0x01000D58@ */ ECIPP_ALIGNMENT_UWORD 1600 Compu_Gov1_nomload 0 1599.9755859375 /end CHARACTERISTIC
/begin COMPU_METHOD Compu_Gov1_nomload " " RAT_FUNC "%.1" "%" COEFFS 0 40.96 0 0 0 1 /end COMPU_METHOD
/begin CHARACTERISTIC Gov1_auth_min "Gov1 authority low" VALUE 0x001C9D40 /* @ECU_Address@Gov1_auth_min@0x01000D60@ */ ECIPP_ALIGNMENT_UWORD 100 Compu_Gov1_auth_min 0 99.9984741210938 /end CHARACTERISTIC
/begin COMPU_METHOD Compu_Gov1_auth_min " " RAT_FUNC "%.1" "%" COEFFS 0 655.36 0 0 0 1 /end COMPU_METHOD
/begin CHARACTERISTIC Gov1_auth_max "Gov1 authority high" VALUE 0x001C9D42 /* @ECU_Address@Gov1_auth_max@0x01000D68@ */ ECIPP_ALIGNMENT_UWORD 100 Compu_Gov1_auth_max 0 99.9984741210938 /end CHARACTERISTIC
/begin COMPU_METHOD Compu_Gov1_auth_max " " RAT_FUNC "%.1" "%" COEFFS 0 655.36 0 0 0 1 /end COMPU_METHOD
/begin CHARACTERISTIC Gov1i_Iinit "Gov1 isoc approach I init" VALUE 0x001C9D46 /* @ECU_Address@Gov1i_Iinit@0x01000D70@ */ ECIPP_ALIGNMENT_UWORD 3200 Compu_Gov1i_Iinit 0 3199.951171875 /end CHARACTERISTIC
/begin COMPU_METHOD Compu_Gov1i_Iinit " " RAT_FUNC "%.1" "% / (krpm/sec)" COEFFS 0 20.48 0 0 0 1 /end COMPU_METHOD
/begin CHARACTERISTIC Gov1i_appdlt "Gov1 igov approach delta" VALUE 0x001C9D48 /* @ECU_Address@Gov1i_appdlt@0x01000D78@ */ ECIPP_ALIGNMENT_UWORD 65535 Compu_Gov1i_appdlt 0 65535 /end CHARACTERISTIC
/begin COMPU_METHOD Compu_Gov1i_appdlt " " RAT_FUNC "%.0" "rpm" COEFFS 0 1 0 0 0 1 /end COMPU_METHOD
/begin CHARACTERISTIC Gov1i_apprdt "Gov1 igov approach rpmdt" VALUE 0x001C9D4A /* @ECU_Address@Gov1i_apprdt@0x01000D80@ */ ECIPP_ALIGNMENT_SWORD 63998 Compu_Gov1i_apprdt -64000 63998.046875 /end CHARACTERISTIC
/begin COMPU_METHOD Compu_Gov1i_apprdt " " RAT_FUNC "%.0" "rpm / sec" COEFFS 0 0.512 0 0 0 1 /end COMPU_METHOD
/begin CHARACTERISTIC Gov2_rpm "Gov2 target speed" VALUE 0x001C9D62 /* @ECU_Address@Gov2_rpm@0x01000D88@ */ ECIPP_ALIGNMENT_UWORD 65535 Compu_Gov2_rpm 0 65535 /end CHARACTERISTIC
/begin COMPU_METHOD Compu_Gov2_rpm " " RAT_FUNC "%.0" "rpm" COEFFS 0 1 0 0 0 1 /end COMPU_METHOD
/begin CHARACTERISTIC Gov2d_I_min "Gov2 droop integrator low" VALUE 0x001C9D64 /* @ECU_Address@Gov2d_I_min@0x01000D90@ */ ECIPP_ALIGNMENT_SWORD 800 Compu_Gov2d_I_min -800 799.9755859375 /end CHARACTERISTIC
/begin COMPU_METHOD Compu_Gov2d_I_min " " RAT_FUNC "%.1" "%" COEFFS 0 40.96 0 0 0 1 /end COMPU_METHOD
/begin CHARACTERISTIC Gov2d_I_max "Gov2 droop integrator high" VALUE 0x001C9D66 /* @ECU_Address@Gov2d_I_max@0x01000D98@ */ ECIPP_ALIGNMENT_SWORD 800 Compu_Gov2d_I_max -800 799.9755859375 /end CHARACTERISTIC
/begin COMPU_METHOD Compu_Gov2d_I_max " " RAT_FUNC "%.1" "%" COEFFS 0 40.96 0 0 0 1 /end COMPU_METHOD
/begin CHARACTERISTIC Gov2i_I_min "Gov2 isoc integrator low" VALUE 0x001C9D68 /* @ECU_Address@Gov2i_I_min@0x01000DA0@ */ ECIPP_ALIGNMENT_SWORD 800 Compu_Gov2i_I_min -800 799.9755859375 /end CHARACTERISTIC
/begin COMPU_METHOD Compu_Gov2i_I_min " " RAT_FUNC "%.1" "%" COEFFS 0 40.96 0 0 0 1 /end COMPU_METHOD
/begin CHARACTERISTIC Gov2i_I_max "Gov2 isoc integrator high" VALUE 0x001C9D6A /* @ECU_Address@Gov2i_I_max@0x01000DA8@ */ ECIPP_ALIGNMENT_SWORD 800 Compu_Gov2i_I_max -800 799.9755859375 /end CHARACTERISTIC
/begin COMPU_METHOD Compu_Gov2i_I_max " " RAT_FUNC "%.1" "%" COEFFS 0 40.96 0 0 0 1 /end COMPU_METHOD
/begin CHARACTERISTIC Gov2_nomload "Gov2 droop nominal load" VALUE 0x001C9D70 /* @ECU_Address@Gov2_nomload@0x01000DB0@ */ ECIPP_ALIGNMENT_UWORD 1600 Compu_Gov2_nomload 0 1599.9755859375 /end CHARACTERISTIC
/begin COMPU_METHOD Compu_Gov2_nomload " " RAT_FUNC "%.1" "%" COEFFS 0 40.96 0 0 0 1 /end COMPU_METHOD
/begin CHARACTERISTIC Gov2_auth_min "Gov2 authority low" VALUE 0x001C9D6C /* @ECU_Address@Gov2_auth_min@0x01000DB8@ */ ECIPP_ALIGNMENT_UWORD 100 Compu_Gov2_auth_min 0 99.9984741210938 /end CHARACTERISTIC
/begin COMPU_METHOD Compu_Gov2_auth_min " " RAT_FUNC "%.1" "%" COEFFS 0 655.36 0 0 0 1 /end COMPU_METHOD
/begin CHARACTERISTIC Gov2_auth_max "Gov2 authority high" VALUE 0x001C9D6E /* @ECU_Address@Gov2_auth_max@0x01000DC0@ */ ECIPP_ALIGNMENT_UWORD 100 Compu_Gov2_auth_max 0 99.9984741210938 /end CHARACTERISTIC
/begin COMPU_METHOD Compu_Gov2_auth_max " " RAT_FUNC "%.1" "%" COEFFS 0 655.36 0 0 0 1 /end COMPU_METHOD
/begin CHARACTERISTIC Gov2i_Iinit "Gov2 isoc approach I init" VALUE 0x001C9D72 /* @ECU_Address@Gov2i_Iinit@0x01000DC8@ */ ECIPP_ALIGNMENT_UWORD 3200 Compu_Gov2i_Iinit 0 3199.951171875 /end CHARACTERISTIC
/begin COMPU_METHOD Compu_Gov2i_Iinit " " RAT_FUNC "%.1" "% / (krpm/sec)" COEFFS 0 20.48 0 0 0 1 /end COMPU_METHOD
/begin CHARACTERISTIC Gov2i_appdlt "Gov2 igov approach delta" VALUE 0x001C9D74 /* @ECU_Address@Gov2i_appdlt@0x01000DD0@ */ ECIPP_ALIGNMENT_UWORD 65535 Compu_Gov2i_appdlt 0 65535 /end CHARACTERISTIC
/begin COMPU_METHOD Compu_Gov2i_appdlt " " RAT_FUNC "%.0" "rpm" COEFFS 0 1 0 0 0 1 /end COMPU_METHOD
/begin CHARACTERISTIC Gov2i_apprdt "Gov2 igov approach rpmdt" VALUE 0x001C9D76 /* @ECU_Address@Gov2i_apprdt@0x01000DD8@ */ ECIPP_ALIGNMENT_SWORD 63998 Compu_Gov2i_apprdt -64000 63998.046875 /end CHARACTERISTIC
/begin COMPU_METHOD Compu_Gov2i_apprdt " " RAT_FUNC "%.0" "rpm / sec" COEFFS 0 0.512 0 0 0 1 /end COMPU_METHOD
/begin CHARACTERISTIC Gov3_rpm "Gov3 target speed" VALUE 0x001C9D8E /* @ECU_Address@Gov3_rpm@0x01000DE0@ */ ECIPP_ALIGNMENT_UWORD 65535 Compu_Gov3_rpm 0 65535 /end CHARACTERISTIC
/begin COMPU_METHOD Compu_Gov3_rpm " " RAT_FUNC "%.0" "rpm" COEFFS 0 1 0 0 0 1 /end COMPU_METHOD
/begin CHARACTERISTIC Gov3d_I_min "Gov3 droop integrator low" VALUE 0x001C9D90 /* @ECU_Address@Gov3d_I_min@0x01000DE8@ */ ECIPP_ALIGNMENT_SWORD 800 Compu_Gov3d_I_min -800 799.9755859375 /end CHARACTERISTIC
/begin COMPU_METHOD Compu_Gov3d_I_min " " RAT_FUNC "%.1" "%" COEFFS 0 40.96 0 0 0 1 /end COMPU_METHOD
/begin CHARACTERISTIC Gov3d_I_max "Gov3 droop integrator high" VALUE 0x001C9D92 /* @ECU_Address@Gov3d_I_max@0x01000DF0@ */ ECIPP_ALIGNMENT_SWORD 800 Compu_Gov3d_I_max -800 799.9755859375 /end CHARACTERISTIC
/begin COMPU_METHOD Compu_Gov3d_I_max " " RAT_FUNC "%.1" "%" COEFFS 0 40.96 0 0 0 1 /end COMPU_METHOD
/begin CHARACTERISTIC Gov3i_I_min "Gov3 isoc integrator low" VALUE 0x001C9D94 /* @ECU_Address@Gov3i_I_min@0x01000DF8@ */ ECIPP_ALIGNMENT_SWORD 800 Compu_Gov3i_I_min -800 799.9755859375 /end CHARACTERISTIC
/begin COMPU_METHOD Compu_Gov3i_I_min " " RAT_FUNC "%.1" "%" COEFFS 0 40.96 0 0 0 1 /end COMPU_METHOD
/begin CHARACTERISTIC Gov3i_I_max "Gov3 isoc integrator high" VALUE 0x001C9D96 /* @ECU_Address@Gov3i_I_max@0x01000E00@ */ ECIPP_ALIGNMENT_SWORD 800 Compu_Gov3i_I_max -800 799.9755859375 /end CHARACTERISTIC
/begin COMPU_METHOD Compu_Gov3i_I_max " " RAT_FUNC "%.1" "%" COEFFS 0 40.96 0 0 0 1 /end COMPU_METHOD
/begin CHARACTERISTIC Gov3_nomload "Gov3 droop nominal load" VALUE 0x001C9D9C /* @ECU_Address@Gov3_nomload@0x01000E08@ */ ECIPP_ALIGNMENT_UWORD 1600 Compu_Gov3_nomload 0 1599.9755859375 /end CHARACTERISTIC
/begin COMPU_METHOD Compu_Gov3_nomload " " RAT_FUNC "%.1" "%" COEFFS 0 40.96 0 0 0 1 /end COMPU_METHOD
/begin CHARACTERISTIC Gov3_auth_min "Gov3 authority low" VALUE 0x001C9D98 /* @ECU_Address@Gov3_auth_min@0x01000E10@ */ ECIPP_ALIGNMENT_UWORD 100 Compu_Gov3_auth_min 0 99.9984741210938 /end CHARACTERISTIC
/begin COMPU_METHOD Compu_Gov3_auth_min " " RAT_FUNC "%.1" "%" COEFFS 0 655.36 0 0 0 1 /end COMPU_METHOD
/begin CHARACTERISTIC Gov3_auth_max "Gov3 authority high" VALUE 0x001C9D9A /* @ECU_Address@Gov3_auth_max@0x01000E18@ */ ECIPP_ALIGNMENT_UWORD 100 Compu_Gov3_auth_max 0 99.9984741210938 /end CHARACTERISTIC
/begin COMPU_METHOD Compu_Gov3_auth_max " " RAT_FUNC "%.1" "%" COEFFS 0 655.36 0 0 0 1 /end COMPU_METHOD
/begin CHARACTERISTIC Gov3i_Iinit "Gov3 isoc approach I init" VALUE 0x001C9D9E /* @ECU_Address@Gov3i_Iinit@0x01000E20@ */ ECIPP_ALIGNMENT_UWORD 3200 Compu_Gov3i_Iinit 0 3199.951171875 /end CHARACTERISTIC
/begin COMPU_METHOD Compu_Gov3i_Iinit " " RAT_FUNC "%.1" "% / (krpm/sec)" COEFFS 0 20.48 0 0 0 1 /end COMPU_METHOD
/begin CHARACTERISTIC Gov3i_appdlt "Gov3 igov approach delta" VALUE 0x001C9DA0 /* @ECU_Address@Gov3i_appdlt@0x01000E28@ */ ECIPP_ALIGNMENT_UWORD 65535 Compu_Gov3i_appdlt 0 65535 /end CHARACTERISTIC
/begin COMPU_METHOD Compu_Gov3i_appdlt " " RAT_FUNC "%.0" "rpm" COEFFS 0 1 0 0 0 1 /end COMPU_METHOD
/begin CHARACTERISTIC Gov3i_apprdt "Gov3 igov approach rpmdt" VALUE 0x001C9DA2 /* @ECU_Address@Gov3i_apprdt@0x01000E30@ */ ECIPP_ALIGNMENT_SWORD 63998 Compu_Gov3i_apprdt -64000 63998.046875 /end CHARACTERISTIC
/begin COMPU_METHOD Compu_Gov3i_apprdt " " RAT_FUNC "%.0" "rpm / sec" COEFFS 0 0.512 0 0 0 1 /end COMPU_METHOD
/begin MEASUREMENT Kp_gov_mult "Kp ECT attenuator" UWORD Compu_Kp_gov_mult 0 0 0 15.999755859375 ECU_ADDRESS 0x01000E38 /end MEASUREMENT
/begin COMPU_METHOD Compu_Kp_gov_mult " " RAT_FUNC "%.3" "fraction" COEFFS 0 4096 0 0 0 1 /end COMPU_METHOD
/begin MEASUREMENT Ki_gov_mult "Ki ECT attenuator" UWORD Compu_Ki_gov_mult 0 0 0 15.999755859375 ECU_ADDRESS 0x01000E40 /end MEASUREMENT
/begin COMPU_METHOD Compu_Ki_gov_mult " " RAT_FUNC "%.3" "fraction" COEFFS 0 4096 0 0 0 1 /end COMPU_METHOD
/begin MEASUREMENT Kd_gov_mult "Kd ECT attenuator" UWORD Compu_Kd_gov_mult 0 0 0 15.999755859375 ECU_ADDRESS 0x01000E48 /end MEASUREMENT
/begin COMPU_METHOD Compu_Kd_gov_mult " " RAT_FUNC "%.3" "fraction" COEFFS 0 4096 0 0 0 1 /end COMPU_METHOD
/begin MEASUREMENT KMAPdt_gov_mult "KMAPdt ECT attenuator" UWORD Compu_KMAPdt_gov_mult 0 0 0 15.999755859375 ECU_ADDRESS 0x01000E50 /end MEASUREMENT
/begin COMPU_METHOD Compu_KMAPdt_gov_mult " " RAT_FUNC "%.3" "fraction" COEFFS 0 4096 0 0 0 1 /end COMPU_METHOD
/begin MEASUREMENT KMAPdtfb_gov_mult "KMAPdt FB ECT attenuator" UWORD Compu_KMAPdtfb_gov_mult 0 0 0 15.999755859375 ECU_ADDRESS 0x01000E58 /end MEASUREMENT
/begin COMPU_METHOD Compu_KMAPdtfb_gov_mult " " RAT_FUNC "%.3" "fraction" COEFFS 0 4096 0 0 0 1 /end COMPU_METHOD
/begin MEASUREMENT KMAPdtfb_gov "dMAP/dt feedback gain" SWORD Compu_KMAPdtfb_gov 0 0 -32 31.9990234375 ECU_ADDRESS 0x01000E60 /end MEASUREMENT
/begin COMPU_METHOD Compu_KMAPdtfb_gov " " RAT_FUNC "%.3" "fraction" COEFFS 0 1024 0 0 0 1 /end COMPU_METHOD
/begin CHARACTERISTIC gov_app_mode "Governor application mode{gov_app_mode&0xff=0x00:Vehicle, neutral required}{gov_app_mode&0xff=0x01:Stationary}{gov_app_mode&0xff=0x02:Vehicle, neut. req. if stationary}" VALUE 0x001c9040 /* @ECU_Address@gov_app_mode@0x01000E80@ */ ECIPP_ALIGNMENT_UBYTE 255 gov_app_mode_COMPU_VTAB 0 255 BIT_MASK 0xff /end CHARACTERISTIC
/begin COMPU_METHOD gov_app_mode_COMPU_VTAB "Verbal Table" TAB_VERB "%.0" "list" COMPU_TAB_REF gov_app_mode_COMPU_VTAB_REF /end COMPU_METHOD
/begin COMPU_VTAB gov_app_mode_COMPU_VTAB_REF "Verbal Table" TAB_VERB 3 0x00 "Vehicle, neutral required" 0x01 "Stationary" 0x02 "Vehicle, neut. req. if stationary" DEFAULT_VALUE "UNKNOWN" /end COMPU_VTAB
/begin MEASUREMENT gov_nomld_ECTadd "Nominal load ECT adder" SWORD Compu_gov_nomld_ECTadd 0 0 -800 799.9755859375 ECU_ADDRESS 0x01000EE0 /end MEASUREMENT
/begin COMPU_METHOD Compu_gov_nomld_ECTadd " " RAT_FUNC "%.1" "%" COEFFS 0 40.96 0 0 0 1 /end COMPU_METHOD
/begin CHARACTERISTIC mingv_odz "Min gov output dead-zone (+/-)" VALUE 0x001c6d28 /* @ECU_Address@mingv_odz@0x01000F30@ */ ECIPP_ALIGNMENT_SWORD 100 Compu_mingv_odz -100 99.9969482421875 /end CHARACTERISTIC
/begin COMPU_METHOD Compu_mingv_odz " " RAT_FUNC "%.1" "%" COEFFS 0 327.68 0 0 0 1 /end COMPU_METHOD
/begin CHARACTERISTIC maxgv_odz "Max gov output dead-zone (+/-)" VALUE 0x001c6d24 /* @ECU_Address@maxgv_odz@0x01000F38@ */ ECIPP_ALIGNMENT_SWORD 100 Compu_maxgv_odz -100 99.9969482421875 /end CHARACTERISTIC
/begin COMPU_METHOD Compu_maxgv_odz " " RAT_FUNC "%.1" "%" COEFFS 0 327.68 0 0 0 1 /end COMPU_METHOD
/begin CHARACTERISTIC mingv_odz_wall "Min gov output dead-zone floor" VALUE 0x001c6d2a /* @ECU_Address@mingv_odz_wall@0x01000F40@ */ ECIPP_ALIGNMENT_SWORD 100 Compu_mingv_odz_wall -100 99.9969482421875 /end CHARACTERISTIC
/begin COMPU_METHOD Compu_mingv_odz_wall " " RAT_FUNC "%.1" "%" COEFFS 0 327.68 0 0 0 1 /end COMPU_METHOD
/begin CHARACTERISTIC maxgv_odz_wall "Max gov output dead-zone ceiling" VALUE 0x001c6d26 /* @ECU_Address@maxgv_odz_wall@0x01000F48@ */ ECIPP_ALIGNMENT_SWORD 100 Compu_maxgv_odz_wall -100 99.9969482421875 /end CHARACTERISTIC
/begin COMPU_METHOD Compu_maxgv_odz_wall " " RAT_FUNC "%.1" "%" COEFFS 0 327.68 0 0 0 1 /end COMPU_METHOD
/begin CHARACTERISTIC mingv_odz_tau "Min gov output dead-zone tau" VALUE 0x001c8660 /* @ECU_Address@mingv_odz_tau@0x01000F50@ */ ECIPP_ALIGNMENT_UWORD 327680 Compu_mingv_odz_tau 0.45084 327680 /end CHARACTERISTIC
/begin COMPU_METHOD Compu_mingv_odz_tau " " FORM "%.0" "ms"
 /begin FORMULA "-5 / log(1 - (X1 / 65536))" FORMULA_INV "(1 - exp(-5/X1)) * 65536" /end FORMULA
/end COMPU_METHOD
/begin CHARACTERISTIC maxgv_odz_tau "Max gov output dead-zone tau" VALUE 0x001c865c /* @ECU_Address@maxgv_odz_tau@0x01000F58@ */ ECIPP_ALIGNMENT_UWORD 327680 Compu_maxgv_odz_tau 0.45084 327680 /end CHARACTERISTIC
/begin COMPU_METHOD Compu_maxgv_odz_tau " " FORM "%.0" "ms"
 /begin FORMULA "-5 / log(1 - (X1 / 65536))" FORMULA_INV "(1 - exp(-5/X1)) * 65536" /end FORMULA
/end COMPU_METHOD
/begin CHARACTERISTIC gov_ntrlock_chan "Vehicle mode Gov1/2/3 interlock{gov_ntrlock_chan&0xff=0x00:IVS input}{gov_ntrlock_chan&0xff=0x01:Brake input}{gov_ntrlock_chan&0xff=0x02:Neutral/Park/Secondary}" VALUE 0x001c904f /* @ECU_Address@gov_ntrlock_chan@0x010012E8@ */ ECIPP_ALIGNMENT_UBYTE 255 gov_ntrlock_chan_COMPU_VTAB 0 255 BIT_MASK 0xff /end CHARACTERISTIC
/begin COMPU_METHOD gov_ntrlock_chan_COMPU_VTAB "Verbal Table" TAB_VERB "%.0" "list" COMPU_TAB_REF gov_ntrlock_chan_COMPU_VTAB_REF /end COMPU_METHOD
/begin COMPU_VTAB gov_ntrlock_chan_COMPU_VTAB_REF "Verbal Table" TAB_VERB 3 0x00 "IVS input" 0x01 "Brake input" 0x02 "Neutral/Park/Secondary" DEFAULT_VALUE "UNKNOWN" /end COMPU_VTAB
/begin CHARACTERISTIC mingv_TPSLP "Min Gov TPS low-pass" VALUE 0x001C9DD8 /* @ECU_Address@mingv_TPSLP@0x01001758@ */ ECIPP_ALIGNMENT_UWORD 327680 Compu_mingv_TPSLP 0.45084 327680 /end CHARACTERISTIC
/begin COMPU_METHOD Compu_mingv_TPSLP " " FORM "%.1" "ms"
 /begin FORMULA "-5 / log(1 - (X1 / 65536))" FORMULA_INV "(1 - exp(-5/X1)) * 65536" /end FORMULA
/end COMPU_METHOD
/begin CHARACTERISTIC maxgv_TPSLP "Max Gov TPS low-pass" VALUE 0x001C9DB8 /* @ECU_Address@maxgv_TPSLP@0x01001760@ */ ECIPP_ALIGNMENT_UWORD 327680 Compu_maxgv_TPSLP 0.45084 327680 /end CHARACTERISTIC
/begin COMPU_METHOD Compu_maxgv_TPSLP " " FORM "%.1" "ms"
 /begin FORMULA "-5 / log(1 - (X1 / 65536))" FORMULA_INV "(1 - exp(-5/X1)) * 65536" /end FORMULA
/end COMPU_METHOD
/begin CHARACTERISTIC Gov1_TPSLP "Gov1 TPS low-pass" VALUE 0x001C9D34 /* @ECU_Address@Gov1_TPSLP@0x01001768@ */ ECIPP_ALIGNMENT_UWORD 327680 Compu_Gov1_TPSLP 0.45084 327680 /end CHARACTERISTIC
/begin COMPU_METHOD Compu_Gov1_TPSLP " " FORM "%.1" "ms"
 /begin FORMULA "-5 / log(1 - (X1 / 65536))" FORMULA_INV "(1 - exp(-5/X1)) * 65536" /end FORMULA
/end COMPU_METHOD
/begin CHARACTERISTIC Gov2_TPSLP "Gov2 TPS low-pass" VALUE 0x001C9D60 /* @ECU_Address@Gov2_TPSLP@0x01001770@ */ ECIPP_ALIGNMENT_UWORD 327680 Compu_Gov2_TPSLP 0.45084 327680 /end CHARACTERISTIC
/begin COMPU_METHOD Compu_Gov2_TPSLP " " FORM "%.1" "ms"
 /begin FORMULA "-5 / log(1 - (X1 / 65536))" FORMULA_INV "(1 - exp(-5/X1)) * 65536" /end FORMULA
/end COMPU_METHOD
/begin CHARACTERISTIC Gov3_TPSLP "Gov3 TPS low-pass" VALUE 0x001C9D8C /* @ECU_Address@Gov3_TPSLP@0x01001778@ */ ECIPP_ALIGNMENT_UWORD 327680 Compu_Gov3_TPSLP 0.45084 327680 /end CHARACTERISTIC
/begin COMPU_METHOD Compu_Gov3_TPSLP " " FORM "%.1" "ms"
 /begin FORMULA "-5 / log(1 - (X1 / 65536))" FORMULA_INV "(1 - exp(-5/X1)) * 65536" /end FORMULA
/end COMPU_METHOD
/begin MEASUREMENT Imin_gov_acc "Min gov integrator" SLONG Compu_Imin_gov_acc 0 0 -800 799.999999627471 ECU_ADDRESS 0x01001828 /end MEASUREMENT
/begin COMPU_METHOD Compu_Imin_gov_acc " " RAT_FUNC "%.1" "%" COEFFS 0 2684354.56 0 0 0 1 /end COMPU_METHOD
/begin MEASUREMENT Imax_gov_acc "Max gov integrator" SLONG Compu_Imax_gov_acc 0 0 -800 799.999999627471 ECU_ADDRESS 0x01001830 /end MEASUREMENT
/begin COMPU_METHOD Compu_Imax_gov_acc " " RAT_FUNC "%.1" "%" COEFFS 0 2684354.56 0 0 0 1 /end COMPU_METHOD
/begin MEASUREMENT Imin_gov_save "Min gov saved integrator" SLONG Compu_Imin_gov_save 0 0 -800 799.999999627471 ECU_ADDRESS 0x01001838 /end MEASUREMENT
/begin COMPU_METHOD Compu_Imin_gov_save " " RAT_FUNC "%.1" "%" COEFFS 0 2684354.56 0 0 0 1 /end COMPU_METHOD
/begin MEASUREMENT Imax_gov_save "Max gov saved integrator" SLONG Compu_Imax_gov_save 0 0 -800 799.999999627471 ECU_ADDRESS 0x01001840 /end MEASUREMENT
/begin COMPU_METHOD Compu_Imax_gov_save " " RAT_FUNC "%.1" "%" COEFFS 0 2684354.56 0 0 0 1 /end COMPU_METHOD
/begin MEASUREMENT I_Gov1_acc "Gov1 integrator" SLONG Compu_I_Gov1_acc 0 0 -800 799.999999627471 ECU_ADDRESS 0x01001848 /end MEASUREMENT
/begin COMPU_METHOD Compu_I_Gov1_acc " " RAT_FUNC "%.1" "%" COEFFS 0 2684354.56 0 0 0 1 /end COMPU_METHOD
/begin MEASUREMENT I_Gov2_acc "Gov2 integrator" SLONG Compu_I_Gov2_acc 0 0 -800 799.999999627471 ECU_ADDRESS 0x01001850 /end MEASUREMENT
/begin COMPU_METHOD Compu_I_Gov2_acc " " RAT_FUNC "%.1" "%" COEFFS 0 2684354.56 0 0 0 1 /end COMPU_METHOD
/begin MEASUREMENT I_Gov3_acc "Gov3 integrator" SLONG Compu_I_Gov3_acc 0 0 -800 799.999999627471 ECU_ADDRESS 0x01001858 /end MEASUREMENT
/begin COMPU_METHOD Compu_I_Gov3_acc " " RAT_FUNC "%.1" "%" COEFFS 0 2684354.56 0 0 0 1 /end COMPU_METHOD
/begin MEASUREMENT rpmd_gov "RPM trajectory target" UWORD Compu_rpmd_gov 0 0 0 65535 ECU_ADDRESS 0x01001860 /end MEASUREMENT
/begin COMPU_METHOD Compu_rpmd_gov " " RAT_FUNC "%.0" "rpm" COEFFS 0 1 0 0 0 1 /end COMPU_METHOD
/begin MEASUREMENT rpmdtd_gov "RPMdt trajectory target" SWORD Compu_rpmdtd_gov 0 0 -64000 63998.046875 ECU_ADDRESS 0x01001868 /end MEASUREMENT
/begin COMPU_METHOD Compu_rpmdtd_gov " " RAT_FUNC "%.1" "rpm / sec" COEFFS 0 0.512 0 0 0 1 /end COMPU_METHOD
/begin CHARACTERISTIC Imin_gov_start "Min governor initial integrator" VALUE 0x001C9DF0 /* @ECU_Address@Imin_gov_start@0x01001870@ */ ECIPP_ALIGNMENT_SLONG 800 Compu_Imin_gov_start -800 799.999999627471 /end CHARACTERISTIC
/begin COMPU_METHOD Compu_Imin_gov_start " " RAT_FUNC "%.1" "%" COEFFS 0 2684354.56 0 0 0 1 /end COMPU_METHOD
/begin CHARACTERISTIC Imax_gov_start "Max governor initial integrator" VALUE 0x001C9DD0 /* @ECU_Address@Imax_gov_start@0x01001878@ */ ECIPP_ALIGNMENT_SLONG 800 Compu_Imax_gov_start -800 799.999999627471 /end CHARACTERISTIC
/begin COMPU_METHOD Compu_Imax_gov_start " " RAT_FUNC "%.1" "%" COEFFS 0 2684354.56 0 0 0 1 /end COMPU_METHOD
/begin CHARACTERISTIC I_Gov1_start "Gov1 initial integrator" VALUE 0x001C9D4C /* @ECU_Address@I_Gov1_start@0x01001880@ */ ECIPP_ALIGNMENT_SLONG 800 Compu_I_Gov1_start -800 799.999999627471 /end CHARACTERISTIC
/begin COMPU_METHOD Compu_I_Gov1_start " " RAT_FUNC "%.1" "%" COEFFS 0 2684354.56 0 0 0 1 /end COMPU_METHOD
/begin CHARACTERISTIC I_Gov2_start "Gov2 initial integrator" VALUE 0x001C9D78 /* @ECU_Address@I_Gov2_start@0x01001888@ */ ECIPP_ALIGNMENT_SLONG 800 Compu_I_Gov2_start -800 799.999999627471 /end CHARACTERISTIC
/begin COMPU_METHOD Compu_I_Gov2_start " " RAT_FUNC "%.1" "%" COEFFS 0 2684354.56 0 0 0 1 /end COMPU_METHOD
/begin CHARACTERISTIC I_Gov3_start "Gov3 initial integrator" VALUE 0x001C9DA4 /* @ECU_Address@I_Gov3_start@0x01001890@ */ ECIPP_ALIGNMENT_SLONG 800 Compu_I_Gov3_start -800 799.999999627471 /end CHARACTERISTIC
/begin COMPU_METHOD Compu_I_Gov3_start " " RAT_FUNC "%.1" "%" COEFFS 0 2684354.56 0 0 0 1 /end COMPU_METHOD
/begin CHARACTERISTIC Gov_start_wait "Gov1/2/3 delay from start" VALUE 0x001c7bd0 /* @ECU_Address@Gov_start_wait@0x01001898@ */ ECIPP_ALIGNMENT_UWORD 66 Compu_Gov_start_wait 0 65.535 /end CHARACTERISTIC
/begin COMPU_METHOD Compu_Gov_start_wait " " RAT_FUNC "%.1" "sec" COEFFS 0 1000 0 0 0 1 /end COMPU_METHOD
/begin CHARACTERISTIC mingv_spk_Kpo "Min gov overshoot spark gain" VALUE 0x001CA55C /* @ECU_Address@mingv_spk_Kpo@0x01001978@ */ ECIPP_ALIGNMENT_UWORD 128 Compu_mingv_spk_Kpo 0 127.998046875 /end CHARACTERISTIC
/begin COMPU_METHOD Compu_mingv_spk_Kpo " " RAT_FUNC "%.2" "CAD ret/rpm" COEFFS 0 512 0 0 0 1 /end COMPU_METHOD
/begin CHARACTERISTIC maxgv_spk_Kpo "Max gov overshoot spark gain" VALUE 0x001CA550 /* @ECU_Address@maxgv_spk_Kpo@0x01001980@ */ ECIPP_ALIGNMENT_UWORD 128 Compu_maxgv_spk_Kpo 0 127.998046875 /end CHARACTERISTIC
/begin COMPU_METHOD Compu_maxgv_spk_Kpo " " RAT_FUNC "%.2" "CAD ret/rpm" COEFFS 0 512 0 0 0 1 /end COMPU_METHOD
/begin CHARACTERISTIC Gov1_spk_Kpo "Gov1 overshoot spark gain" VALUE 0x001C9D50 /* @ECU_Address@Gov1_spk_Kpo@0x01001988@ */ ECIPP_ALIGNMENT_UWORD 128 Compu_Gov1_spk_Kpo 0 127.998046875 /end CHARACTERISTIC
/begin COMPU_METHOD Compu_Gov1_spk_Kpo " " RAT_FUNC "%.2" "CAD ret/rpm" COEFFS 0 512 0 0 0 1 /end COMPU_METHOD
/begin CHARACTERISTIC Gov2_spk_Kpo "Gov2 overshoot spark gain" VALUE 0x001C9D7C /* @ECU_Address@Gov2_spk_Kpo@0x01001990@ */ ECIPP_ALIGNMENT_UWORD 128 Compu_Gov2_spk_Kpo 0 127.998046875 /end CHARACTERISTIC
/begin COMPU_METHOD Compu_Gov2_spk_Kpo " " RAT_FUNC "%.2" "CAD ret/rpm" COEFFS 0 512 0 0 0 1 /end COMPU_METHOD
/begin CHARACTERISTIC Gov3_spk_Kpo "Gov3 overshoot spark gain" VALUE 0x001C9DA8 /* @ECU_Address@Gov3_spk_Kpo@0x01001998@ */ ECIPP_ALIGNMENT_UWORD 128 Compu_Gov3_spk_Kpo 0 127.998046875 /end CHARACTERISTIC
/begin COMPU_METHOD Compu_Gov3_spk_Kpo " " RAT_FUNC "%.2" "CAD ret/rpm" COEFFS 0 512 0 0 0 1 /end COMPU_METHOD
/begin CHARACTERISTIC Gov3_spk_Kpu "Gov3 undershoot spark gain" VALUE 0x001C9DAA /* @ECU_Address@Gov3_spk_Kpu@0x010019A0@ */ ECIPP_ALIGNMENT_UWORD 128 Compu_Gov3_spk_Kpu 0 127.998046875 /end CHARACTERISTIC
/begin COMPU_METHOD Compu_Gov3_spk_Kpu " " RAT_FUNC "%.2" "CAD adv/rpm" COEFFS 0 512 0 0 0 1 /end COMPU_METHOD
/begin CHARACTERISTIC Gov2_spk_Kpu "Gov2 undershoot spark gain" VALUE 0x001C9D7E /* @ECU_Address@Gov2_spk_Kpu@0x010019A8@ */ ECIPP_ALIGNMENT_UWORD 128 Compu_Gov2_spk_Kpu 0 127.998046875 /end CHARACTERISTIC
/begin COMPU_METHOD Compu_Gov2_spk_Kpu " " RAT_FUNC "%.2" "CAD adv/rpm" COEFFS 0 512 0 0 0 1 /end COMPU_METHOD
/begin CHARACTERISTIC Gov1_spk_Kpu "Gov1 undershoot spark gain" VALUE 0x001C9D52 /* @ECU_Address@Gov1_spk_Kpu@0x010019B0@ */ ECIPP_ALIGNMENT_UWORD 128 Compu_Gov1_spk_Kpu 0 127.998046875 /end CHARACTERISTIC
/begin COMPU_METHOD Compu_Gov1_spk_Kpu " " RAT_FUNC "%.2" "CAD adv/rpm" COEFFS 0 512 0 0 0 1 /end COMPU_METHOD
/begin CHARACTERISTIC maxgv_spk_Kpu "Max gov undershoot spark gain" VALUE 0x001CA552 /* @ECU_Address@maxgv_spk_Kpu@0x010019B8@ */ ECIPP_ALIGNMENT_UWORD 128 Compu_maxgv_spk_Kpu 0 127.998046875 /end CHARACTERISTIC
/begin COMPU_METHOD Compu_maxgv_spk_Kpu " " RAT_FUNC "%.2" "CAD adv/rpm" COEFFS 0 512 0 0 0 1 /end COMPU_METHOD
/begin CHARACTERISTIC mingv_spk_Kpu "Min gov undershoot spark gain" VALUE 0x001CA55E /* @ECU_Address@mingv_spk_Kpu@0x010019C0@ */ ECIPP_ALIGNMENT_UWORD 128 Compu_mingv_spk_Kpu 0 127.998046875 /end CHARACTERISTIC
/begin COMPU_METHOD Compu_mingv_spk_Kpu " " RAT_FUNC "%.2" "CAD adv/rpm" COEFFS 0 512 0 0 0 1 /end COMPU_METHOD
/begin CHARACTERISTIC mingv_spk_dzo "Min gov overshoot spark deadzone" VALUE 0x001CA560 /* @ECU_Address@mingv_spk_dzo@0x010019C8@ */ ECIPP_ALIGNMENT_UWORD 65535 Compu_mingv_spk_dzo 0 65535 /end CHARACTERISTIC
/begin COMPU_METHOD Compu_mingv_spk_dzo " " RAT_FUNC "%.0" "rpm" COEFFS 0 1 0 0 0 1 /end COMPU_METHOD
/begin CHARACTERISTIC maxgv_spk_dzo "Max gov overshoot spark deadzone" VALUE 0x001CA554 /* @ECU_Address@maxgv_spk_dzo@0x010019D0@ */ ECIPP_ALIGNMENT_UWORD 65535 Compu_maxgv_spk_dzo 0 65535 /end CHARACTERISTIC
/begin COMPU_METHOD Compu_maxgv_spk_dzo " " RAT_FUNC "%.0" "rpm" COEFFS 0 1 0 0 0 1 /end COMPU_METHOD
/begin CHARACTERISTIC Gov1_spk_dzo "Gov1 overshoot spark deadzone" VALUE 0x001C9D54 /* @ECU_Address@Gov1_spk_dzo@0x010019D8@ */ ECIPP_ALIGNMENT_UWORD 65535 Compu_Gov1_spk_dzo 0 65535 /end CHARACTERISTIC
/begin COMPU_METHOD Compu_Gov1_spk_dzo " " RAT_FUNC "%.0" "rpm" COEFFS 0 1 0 0 0 1 /end COMPU_METHOD
/begin CHARACTERISTIC Gov2_spk_dzo "Gov2 overshoot spark deadzone" VALUE 0x001C9D80 /* @ECU_Address@Gov2_spk_dzo@0x010019E0@ */ ECIPP_ALIGNMENT_UWORD 65535 Compu_Gov2_spk_dzo 0 65535 /end CHARACTERISTIC
/begin COMPU_METHOD Compu_Gov2_spk_dzo " " RAT_FUNC "%.0" "rpm" COEFFS 0 1 0 0 0 1 /end COMPU_METHOD
/begin CHARACTERISTIC Gov3_spk_dzo "Gov3 overshoot spark deadzone" VALUE 0x001C9DAC /* @ECU_Address@Gov3_spk_dzo@0x010019E8@ */ ECIPP_ALIGNMENT_UWORD 65535 Compu_Gov3_spk_dzo 0 65535 /end CHARACTERISTIC
/begin COMPU_METHOD Compu_Gov3_spk_dzo " " RAT_FUNC "%.0" "rpm" COEFFS 0 1 0 0 0 1 /end COMPU_METHOD
/begin CHARACTERISTIC mingv_spk_dzu "Min gov undershoot spark deadzone" VALUE 0x001CA562 /* @ECU_Address@mingv_spk_dzu@0x010019F0@ */ ECIPP_ALIGNMENT_UWORD 65535 Compu_mingv_spk_dzu 0 65535 /end CHARACTERISTIC
/begin COMPU_METHOD Compu_mingv_spk_dzu " " RAT_FUNC "%.0" "rpm" COEFFS 0 1 0 0 0 1 /end COMPU_METHOD
/begin CHARACTERISTIC maxgv_spk_dzu "Max gov undershoot spark deadzone" VALUE 0x001CA556 /* @ECU_Address@maxgv_spk_dzu@0x010019F8@ */ ECIPP_ALIGNMENT_UWORD 65535 Compu_maxgv_spk_dzu 0 65535 /end CHARACTERISTIC
/begin COMPU_METHOD Compu_maxgv_spk_dzu " " RAT_FUNC "%.0" "rpm" COEFFS 0 1 0 0 0 1 /end COMPU_METHOD
/begin CHARACTERISTIC Gov1_spk_dzu "Gov1 undershoot spark deadzone" VALUE 0x001C9D56 /* @ECU_Address@Gov1_spk_dzu@0x01001A00@ */ ECIPP_ALIGNMENT_UWORD 65535 Compu_Gov1_spk_dzu 0 65535 /end CHARACTERISTIC
/begin COMPU_METHOD Compu_Gov1_spk_dzu " " RAT_FUNC "%.0" "rpm" COEFFS 0 1 0 0 0 1 /end COMPU_METHOD
/begin CHARACTERISTIC Gov2_spk_dzu "Gov2 undershoot spark deadzone" VALUE 0x001C9D82 /* @ECU_Address@Gov2_spk_dzu@0x01001A08@ */ ECIPP_ALIGNMENT_UWORD 65535 Compu_Gov2_spk_dzu 0 65535 /end CHARACTERISTIC
/begin COMPU_METHOD Compu_Gov2_spk_dzu " " RAT_FUNC "%.0" "rpm" COEFFS 0 1 0 0 0 1 /end COMPU_METHOD
/begin CHARACTERISTIC Gov3_spk_dzu "Gov3 undershoot spark deadzone" VALUE 0x001C9DAE /* @ECU_Address@Gov3_spk_dzu@0x01001A10@ */ ECIPP_ALIGNMENT_UWORD 65535 Compu_Gov3_spk_dzu 0 65535 /end CHARACTERISTIC
/begin COMPU_METHOD Compu_Gov3_spk_dzu " " RAT_FUNC "%.0" "rpm" COEFFS 0 1 0 0 0 1 /end COMPU_METHOD
/begin CHARACTERISTIC mingv_spk_mxret "Min gov spark max retard" VALUE 0x001CA564 /* @ECU_Address@mingv_spk_mxret@0x01001A18@ */ ECIPP_ALIGNMENT_SWORD 2048 Compu_mingv_spk_mxret -2048 2047.9375 /end CHARACTERISTIC
/begin COMPU_METHOD Compu_mingv_spk_mxret " " RAT_FUNC "%.1" "CAD ret" COEFFS 0 16 0 0 0 1 /end COMPU_METHOD
/begin CHARACTERISTIC maxgv_spk_mxret "Max gov spark max retard" VALUE 0x001CA558 /* @ECU_Address@maxgv_spk_mxret@0x01001A20@ */ ECIPP_ALIGNMENT_SWORD 2048 Compu_maxgv_spk_mxret -2048 2047.9375 /end CHARACTERISTIC
/begin COMPU_METHOD Compu_maxgv_spk_mxret " " RAT_FUNC "%.1" "CAD ret" COEFFS 0 16 0 0 0 1 /end COMPU_METHOD
/begin CHARACTERISTIC Gov1_spk_mxret "Gov1 spark max retard" VALUE 0x001C9D58 /* @ECU_Address@Gov1_spk_mxret@0x01001A28@ */ ECIPP_ALIGNMENT_SWORD 2048 Compu_Gov1_spk_mxret -2048 2047.9375 /end CHARACTERISTIC
/begin COMPU_METHOD Compu_Gov1_spk_mxret " " RAT_FUNC "%.1" "CAD ret" COEFFS 0 16 0 0 0 1 /end COMPU_METHOD
/begin CHARACTERISTIC Gov2_spk_mxret "Gov2 spark max retard" VALUE 0x001C9D84 /* @ECU_Address@Gov2_spk_mxret@0x01001A30@ */ ECIPP_ALIGNMENT_SWORD 2048 Compu_Gov2_spk_mxret -2048 2047.9375 /end CHARACTERISTIC
/begin COMPU_METHOD Compu_Gov2_spk_mxret " " RAT_FUNC "%.1" "CAD ret" COEFFS 0 16 0 0 0 1 /end COMPU_METHOD
/begin CHARACTERISTIC Gov3_spk_mxret "Gov3 spark max retard" VALUE 0x001C9DB0 /* @ECU_Address@Gov3_spk_mxret@0x01001A38@ */ ECIPP_ALIGNMENT_SWORD 2048 Compu_Gov3_spk_mxret -2048 2047.9375 /end CHARACTERISTIC
/begin COMPU_METHOD Compu_Gov3_spk_mxret " " RAT_FUNC "%.1" "CAD ret" COEFFS 0 16 0 0 0 1 /end COMPU_METHOD
/begin CHARACTERISTIC mingv_spk_mxadv "Min gov spark max advance" VALUE 0x001CA566 /* @ECU_Address@mingv_spk_mxadv@0x01001A40@ */ ECIPP_ALIGNMENT_SWORD 2048 Compu_mingv_spk_mxadv -2048 2047.9375 /end CHARACTERISTIC
/begin COMPU_METHOD Compu_mingv_spk_mxadv " " RAT_FUNC "%.1" "CAD adv" COEFFS 0 16 0 0 0 1 /end COMPU_METHOD
/begin CHARACTERISTIC maxgv_spk_mxadv "Max gov spark max advance" VALUE 0x001CA55A /* @ECU_Address@maxgv_spk_mxadv@0x01001A48@ */ ECIPP_ALIGNMENT_SWORD 2048 Compu_maxgv_spk_mxadv -2048 2047.9375 /end CHARACTERISTIC
/begin COMPU_METHOD Compu_maxgv_spk_mxadv " " RAT_FUNC "%.1" "CAD adv" COEFFS 0 16 0 0 0 1 /end COMPU_METHOD
/begin CHARACTERISTIC Gov1_spk_mxadv "Gov1 spark max advance" VALUE 0x001C9D5A /* @ECU_Address@Gov1_spk_mxadv@0x01001A50@ */ ECIPP_ALIGNMENT_SWORD 2048 Compu_Gov1_spk_mxadv -2048 2047.9375 /end CHARACTERISTIC
/begin COMPU_METHOD Compu_Gov1_spk_mxadv " " RAT_FUNC "%.1" "CAD adv" COEFFS 0 16 0 0 0 1 /end COMPU_METHOD
/begin CHARACTERISTIC Gov2_spk_mxadv "Gov2 spark max advance" VALUE 0x001C9D86 /* @ECU_Address@Gov2_spk_mxadv@0x01001A58@ */ ECIPP_ALIGNMENT_SWORD 2048 Compu_Gov2_spk_mxadv -2048 2047.9375 /end CHARACTERISTIC
/begin COMPU_METHOD Compu_Gov2_spk_mxadv " " RAT_FUNC "%.1" "CAD adv" COEFFS 0 16 0 0 0 1 /end COMPU_METHOD
/begin CHARACTERISTIC Gov3_spk_mxadv "Gov3 spark max advance" VALUE 0x001C9DB2 /* @ECU_Address@Gov3_spk_mxadv@0x01001A60@ */ ECIPP_ALIGNMENT_SWORD 2048 Compu_Gov3_spk_mxadv -2048 2047.9375 /end CHARACTERISTIC
/begin COMPU_METHOD Compu_Gov3_spk_mxadv " " RAT_FUNC "%.1" "CAD adv" COEFFS 0 16 0 0 0 1 /end COMPU_METHOD
/begin CHARACTERISTIC gov_gain_gsln "Gasoline mode governor gains{gov_gain_gsln&0xff=0:Std - Set 1}{gov_gain_gsln&0xff=1:Alt - Set 1}{gov_gain_gsln&0xff=2:Std - Set 2}{gov_gain_gsln&0xff=3:Alt - Set 2}" VALUE 0x001c904b /* @ECU_Address@gov_gain_gsln@0x01001AD8@ */ ECIPP_ALIGNMENT_UBYTE 255 gov_gain_gsln_COMPU_VTAB 0 255 BIT_MASK 0xff /end CHARACTERISTIC
/begin COMPU_METHOD gov_gain_gsln_COMPU_VTAB "Verbal Table" TAB_VERB "%.0" "list" COMPU_TAB_REF gov_gain_gsln_COMPU_VTAB_REF /end COMPU_METHOD
/begin COMPU_VTAB gov_gain_gsln_COMPU_VTAB_REF "Verbal Table" TAB_VERB 4 0 "Std - Set 1" 1 "Alt - Set 1" 2 "Std - Set 2" 3 "Alt - Set 2" DEFAULT_VALUE "UNKNOWN" /end COMPU_VTAB
/begin CHARACTERISTIC gov_gain_LPG "LPG mode governor gains{gov_gain_LPG&0xff=0:Std - Set 1}{gov_gain_LPG&0xff=1:Alt - Set 1}{gov_gain_LPG&0xff=2:Std - Set 2}{gov_gain_LPG&0xff=3:Alt - Set 2}" VALUE 0x001c9041 /* @ECU_Address@gov_gain_LPG@0x01001AE0@ */ ECIPP_ALIGNMENT_UBYTE 255 gov_gain_LPG_COMPU_VTAB 0 255 BIT_MASK 0xff /end CHARACTERISTIC
/begin COMPU_METHOD gov_gain_LPG_COMPU_VTAB "Verbal Table" TAB_VERB "%.0" "list" COMPU_TAB_REF gov_gain_LPG_COMPU_VTAB_REF /end COMPU_METHOD
/begin COMPU_VTAB gov_gain_LPG_COMPU_VTAB_REF "Verbal Table" TAB_VERB 4 0 "Std - Set 1" 1 "Alt - Set 1" 2 "Std - Set 2" 3 "Alt - Set 2" DEFAULT_VALUE "UNKNOWN" /end COMPU_VTAB
/begin CHARACTERISTIC gov_gain_NG "NG  mode governor gains{gov_gain_NG&0xff=0:Std - Set 1}{gov_gain_NG&0xff=1:Alt - Set 1}{gov_gain_NG&0xff=2:Std - Set 2}{gov_gain_NG&0xff=3:Alt - Set 2}" VALUE 0x001c9045 /* @ECU_Address@gov_gain_NG@0x01001AE8@ */ ECIPP_ALIGNMENT_UBYTE 255 gov_gain_NG_COMPU_VTAB 0 255 BIT_MASK 0xff /end CHARACTERISTIC
/begin COMPU_METHOD gov_gain_NG_COMPU_VTAB "Verbal Table" TAB_VERB "%.0" "list" COMPU_TAB_REF gov_gain_NG_COMPU_VTAB_REF /end COMPU_METHOD
/begin COMPU_VTAB gov_gain_NG_COMPU_VTAB_REF "Verbal Table" TAB_VERB 4 0 "Std - Set 1" 1 "Alt - Set 1" 2 "Std - Set 2" 3 "Alt - Set 2" DEFAULT_VALUE "UNKNOWN" /end COMPU_VTAB
/begin MEASUREMENT gov_gain_slct "Active governor gain selection{gov_gain_slct&0xff=0:Std - Set 1}{gov_gain_slct&0xff=1:Alt - Set 1}{gov_gain_slct&0xff=2:Std - Set 2}{gov_gain_slct&0xff=3:Alt - Set 2}" UBYTE gov_gain_slct_COMPU_VTAB 0 0 0 255 ECU_ADDRESS 0x01001AF0 BIT_MASK 0xff /end MEASUREMENT
/begin COMPU_METHOD gov_gain_slct_COMPU_VTAB "Verbal Table" TAB_VERB "%.0" "list" COMPU_TAB_REF gov_gain_slct_COMPU_VTAB_REF /end COMPU_METHOD
/begin COMPU_VTAB gov_gain_slct_COMPU_VTAB_REF "Verbal Table" TAB_VERB 4 0 "Std - Set 1" 1 "Alt - Set 1" 2 "Std - Set 2" 3 "Alt - Set 2" DEFAULT_VALUE "UNKNOWN" /end COMPU_VTAB
/begin CHARACTERISTIC FPPSC_mode "FPP speed control rpm source{FPPSC_mode&0xff=0:Min-Max Gov range}{FPPSC_mode&0xff=1:Independent 2-point range}{FPPSC_mode&0xff=2:Independent 4-point range}" VALUE 0x001c871c /* @ECU_Address@FPPSC_mode@0x01001AF8@ */ ECIPP_ALIGNMENT_UBYTE 255 FPPSC_mode_COMPU_VTAB 0 255 BIT_MASK 0xff /end CHARACTERISTIC
/begin COMPU_METHOD FPPSC_mode_COMPU_VTAB "Verbal Table" TAB_VERB "%.0" "list" COMPU_TAB_REF FPPSC_mode_COMPU_VTAB_REF /end COMPU_METHOD
/begin COMPU_VTAB FPPSC_mode_COMPU_VTAB_REF "Verbal Table" TAB_VERB 3 0 "Min-Max Gov range" 1 "Independent 2-point range" 2 "Independent 4-point range" DEFAULT_VALUE "UNKNOWN" /end COMPU_VTAB
/begin CHARACTERISTIC FPPSC_rpmL "FPP independent 2-pt rpm lower" VALUE 0x001c6f8e /* @ECU_Address@FPPSC_rpmL@0x01001B00@ */ ECIPP_ALIGNMENT_UWORD 65535 Compu_FPPSC_rpmL 0 65535 /end CHARACTERISTIC
/begin COMPU_METHOD Compu_FPPSC_rpmL " " RAT_FUNC "%.0" "rpm" COEFFS 0 1 0 0 0 1 /end COMPU_METHOD
/begin CHARACTERISTIC FPPSC_rpmH "FPP independent 2-pt rpm upper" VALUE 0x001c6f8c /* @ECU_Address@FPPSC_rpmH@0x01001B08@ */ ECIPP_ALIGNMENT_UWORD 65535 Compu_FPPSC_rpmH 0 65535 /end CHARACTERISTIC
/begin COMPU_METHOD Compu_FPPSC_rpmH " " RAT_FUNC "%.0" "rpm" COEFFS 0 1 0 0 0 1 /end COMPU_METHOD
/begin CHARACTERISTIC gov_max_abslimit "Governor speed range absolute max" VALUE 0x001c8462 /* @ECU_Address@gov_max_abslimit@0x010021F0@ */ ECIPP_ALIGNMENT_UWORD 65535 Compu_gov_max_abslimit 0 65535 /end CHARACTERISTIC
/begin COMPU_METHOD Compu_gov_max_abslimit " " RAT_FUNC "%.0" "rpm" COEFFS 0 1 0 0 0 1 /end COMPU_METHOD
/begin CHARACTERISTIC gov_min_abslimit "Governor speed range absolute min" VALUE 0x001c8464 /* @ECU_Address@gov_min_abslimit@0x010021F8@ */ ECIPP_ALIGNMENT_UWORD 65535 Compu_gov_min_abslimit 0 65535 /end CHARACTERISTIC
/begin COMPU_METHOD Compu_gov_min_abslimit " " RAT_FUNC "%.0" "rpm" COEFFS 0 1 0 0 0 1 /end COMPU_METHOD
/begin MEASUREMENT Gtap_rpm "Tap up/down speed control setpoint" UWORD Compu_Gtap_rpm 0 0 0 65535 ECU_ADDRESS 0x01002268 /end MEASUREMENT
/begin COMPU_METHOD Compu_Gtap_rpm " " RAT_FUNC "%.0" "rpm" COEFFS 0 1 0 0 0 1 /end COMPU_METHOD
/begin MEASUREMENT Gtap_engaged "Tap up/down speed control status{Gtap_engaged&0xff=0:Not Active}{Gtap_engaged&0xff=1:Active}" UBYTE Gtap_engaged_COMPU_VTAB 0 0 0 255 ECU_ADDRESS 0x01002270 BIT_MASK 0xff /end MEASUREMENT
/begin COMPU_METHOD Gtap_engaged_COMPU_VTAB "Verbal Table" TAB_VERB "%.0" "list" COMPU_TAB_REF Gtap_engaged_COMPU_VTAB_REF /end COMPU_METHOD
/begin COMPU_VTAB Gtap_engaged_COMPU_VTAB_REF "Verbal Table" TAB_VERB 2 0 "Not Active" 1 "Active" DEFAULT_VALUE "UNKNOWN" /end COMPU_VTAB
/begin CHARACTERISTIC Gtap_ena "Tap up/down speed control{Gtap_ena&0xff=0:Disabled}{Gtap_ena&0xff=1:Enabled}" VALUE 0x001c875f /* @ECU_Address@Gtap_ena@0x01002278@ */ ECIPP_ALIGNMENT_UBYTE 255 Gtap_ena_COMPU_VTAB 0 255 BIT_MASK 0xff /end CHARACTERISTIC
/begin COMPU_METHOD Gtap_ena_COMPU_VTAB "Verbal Table" TAB_VERB "%.0" "list" COMPU_TAB_REF Gtap_ena_COMPU_VTAB_REF /end COMPU_METHOD
/begin COMPU_VTAB Gtap_ena_COMPU_VTAB_REF "Verbal Table" TAB_VERB 2 0 "Disabled" 1 "Enabled" DEFAULT_VALUE "UNKNOWN" /end COMPU_VTAB
/begin CHARACTERISTIC Gtap_min_rpm "Tap up/down minimum speed" VALUE 0x001c7bd8 /* @ECU_Address@Gtap_min_rpm@0x01002280@ */ ECIPP_ALIGNMENT_UWORD 65535 Compu_Gtap_min_rpm 0 65535 /end CHARACTERISTIC
/begin COMPU_METHOD Compu_Gtap_min_rpm " " RAT_FUNC "%.0" "rpm" COEFFS 0 1 0 0 0 1 /end COMPU_METHOD
/begin CHARACTERISTIC Gtap_max_rpm "Tap up/down maximum speed" VALUE 0x001c7bd6 /* @ECU_Address@Gtap_max_rpm@0x01002288@ */ ECIPP_ALIGNMENT_UWORD 65535 Compu_Gtap_max_rpm 0 65535 /end CHARACTERISTIC
/begin COMPU_METHOD Compu_Gtap_max_rpm " " RAT_FUNC "%.0" "rpm" COEFFS 0 1 0 0 0 1 /end COMPU_METHOD
/begin CHARACTERISTIC Gtap_1tap_rpm "Single-tap speed step change" VALUE 0x001c7bd4 /* @ECU_Address@Gtap_1tap_rpm@0x01002290@ */ ECIPP_ALIGNMENT_UWORD 65535 Compu_Gtap_1tap_rpm 0 65535 /end CHARACTERISTIC
/begin COMPU_METHOD Compu_Gtap_1tap_rpm " " RAT_FUNC "%.0" "rpm" COEFFS 0 1 0 0 0 1 /end COMPU_METHOD
/begin CHARACTERISTIC Gtap_ramp_delay "Button-hold delay before ramping speed" VALUE 0x001c7bda /* @ECU_Address@Gtap_ramp_delay@0x01002298@ */ ECIPP_ALIGNMENT_UWORD 66 Compu_Gtap_ramp_delay 0 65.535 /end CHARACTERISTIC
/begin COMPU_METHOD Compu_Gtap_ramp_delay " " RAT_FUNC "%.3" "sec" COEFFS 0 1000 0 0 0 1 /end COMPU_METHOD
/begin CHARACTERISTIC Gtap_ramp_phase "Button-hold speed ramping phase-in" VALUE 0x001c7bde /* @ECU_Address@Gtap_ramp_phase@0x010022A0@ */ ECIPP_ALIGNMENT_UWORD 66 Compu_Gtap_ramp_phase 0 65.535 /end CHARACTERISTIC
/begin COMPU_METHOD Compu_Gtap_ramp_phase " " RAT_FUNC "%.3" "sec" COEFFS 0 1000 0 0 0 1 /end COMPU_METHOD
/begin CHARACTERISTIC Gtap_ramp_final "Button-hold speed ramping max rate" VALUE 0x001c7bdc /* @ECU_Address@Gtap_ramp_final@0x010022A8@ */ ECIPP_ALIGNMENT_UWORD 65535 Compu_Gtap_ramp_final 0 65535 /end CHARACTERISTIC
/begin COMPU_METHOD Compu_Gtap_ramp_final " " RAT_FUNC "%.0" "rpm/sec" COEFFS 0 1 0 0 0 1 /end COMPU_METHOD
/begin CHARACTERISTIC IdleFPP_ena "FPP based idle speed control{IdleFPP_ena&0xff=0:Disabled}{IdleFPP_ena&0xff=1:Enabled}" VALUE 0x001c879e /* @ECU_Address@IdleFPP_ena@0x01002870@ */ ECIPP_ALIGNMENT_UBYTE 255 IdleFPP_ena_COMPU_VTAB 0 255 BIT_MASK 0xff /end CHARACTERISTIC
/begin COMPU_METHOD IdleFPP_ena_COMPU_VTAB "Verbal Table" TAB_VERB "%.0" "list" COMPU_TAB_REF IdleFPP_ena_COMPU_VTAB_REF /end COMPU_METHOD
/begin COMPU_VTAB IdleFPP_ena_COMPU_VTAB_REF "Verbal Table" TAB_VERB 2 0 "Disabled" 1 "Enabled" DEFAULT_VALUE "UNKNOWN" /end COMPU_VTAB
/begin CHARACTERISTIC IdleFPP_min "FPP idle lower FPP" VALUE 0x001c7c6a /* @ECU_Address@IdleFPP_min@0x01002878@ */ ECIPP_ALIGNMENT_UWORD 100 Compu_IdleFPP_min 0 99.9984741210938 /end CHARACTERISTIC
/begin COMPU_METHOD Compu_IdleFPP_min " " RAT_FUNC "%.1" "%" COEFFS 0 655.36 0 0 0 1 /end COMPU_METHOD
/begin CHARACTERISTIC IdleFPP_max "FPP idle upper FPP" VALUE 0x001c7c68 /* @ECU_Address@IdleFPP_max@0x01002880@ */ ECIPP_ALIGNMENT_UWORD 100 Compu_IdleFPP_max 0 99.9984741210938 /end CHARACTERISTIC
/begin COMPU_METHOD Compu_IdleFPP_max " " RAT_FUNC "%.1" "%" COEFFS 0 655.36 0 0 0 1 /end COMPU_METHOD
/begin CHARACTERISTIC IdleFPP_rpmdelta "FPP idle speed range delta" VALUE 0x001c7c6c /* @ECU_Address@IdleFPP_rpmdelta@0x01002888@ */ ECIPP_ALIGNMENT_UWORD 65535 Compu_IdleFPP_rpmdelta 0 65535 /end CHARACTERISTIC
/begin COMPU_METHOD Compu_IdleFPP_rpmdelta " " RAT_FUNC "%.0" "rpm" COEFFS 0 1 0 0 0 1 /end COMPU_METHOD
/begin CHARACTERISTIC IdleFPP_rpmmax "FPP idle maximum speed target" VALUE 0x001c7c6e /* @ECU_Address@IdleFPP_rpmmax@0x01002890@ */ ECIPP_ALIGNMENT_UWORD 65535 Compu_IdleFPP_rpmmax 0 65535 /end CHARACTERISTIC
/begin COMPU_METHOD Compu_IdleFPP_rpmmax " " RAT_FUNC "%.0" "rpm" COEFFS 0 1 0 0 0 1 /end COMPU_METHOD
/begin CHARACTERISTIC IdleFPP_loadadd "FPP idle droop load delta" VALUE 0x001c4526 /* @ECU_Address@IdleFPP_loadadd@0x01002898@ */ ECIPP_ALIGNMENT_SWORD 800 Compu_IdleFPP_loadadd -800 799.9755859375 /end CHARACTERISTIC
/begin COMPU_METHOD Compu_IdleFPP_loadadd " " RAT_FUNC "%.1" "%" COEFFS 0 40.96 0 0 0 1 /end COMPU_METHOD
/begin CHARACTERISTIC Gov3_gain_slct "Gov3 gain selection{Gov3_gain_slct&0xff=0:Std - Set 1}{Gov3_gain_slct&0xff=1:Alt - Set 1}{Gov3_gain_slct&0xff=2:Fuel Based}{Gov3_gain_slct&0xff=3:Std - Set 2}{Gov3_gain_slct&0xff=4:Alt - Set 2}" VALUE 0x001C9D89 /* @ECU_Address@Gov3_gain_slct@0x01002C28@ */ ECIPP_ALIGNMENT_UBYTE 255 Gov3_gain_slct_COMPU_VTAB 0 255 BIT_MASK 0xff /end CHARACTERISTIC
/begin COMPU_METHOD Gov3_gain_slct_COMPU_VTAB "Verbal Table" TAB_VERB "%.0" "list" COMPU_TAB_REF Gov3_gain_slct_COMPU_VTAB_REF /end COMPU_METHOD
/begin COMPU_VTAB Gov3_gain_slct_COMPU_VTAB_REF "Verbal Table" TAB_VERB 5 0 "Std - Set 1" 1 "Alt - Set 1" 2 "Fuel Based" 3 "Std - Set 2" 4 "Alt - Set 2" DEFAULT_VALUE "UNKNOWN" /end COMPU_VTAB
/begin CHARACTERISTIC Gov2_gain_slct "Gov2 gain selection{Gov2_gain_slct&0xff=0:Std - Set 1}{Gov2_gain_slct&0xff=1:Alt - Set 1}{Gov2_gain_slct&0xff=2:Fuel Based}{Gov2_gain_slct&0xff=3:Std - Set 2}{Gov2_gain_slct&0xff=4:Alt - Set 2}" VALUE 0x001C9D5D /* @ECU_Address@Gov2_gain_slct@0x01002C30@ */ ECIPP_ALIGNMENT_UBYTE 255 Gov2_gain_slct_COMPU_VTAB 0 255 BIT_MASK 0xff /end CHARACTERISTIC
/begin COMPU_METHOD Gov2_gain_slct_COMPU_VTAB "Verbal Table" TAB_VERB "%.0" "list" COMPU_TAB_REF Gov2_gain_slct_COMPU_VTAB_REF /end COMPU_METHOD
/begin COMPU_VTAB Gov2_gain_slct_COMPU_VTAB_REF "Verbal Table" TAB_VERB 5 0 "Std - Set 1" 1 "Alt - Set 1" 2 "Fuel Based" 3 "Std - Set 2" 4 "Alt - Set 2" DEFAULT_VALUE "UNKNOWN" /end COMPU_VTAB
/begin CHARACTERISTIC Gov1_gain_slct "Gov1 gain selection{Gov1_gain_slct&0xff=0:Std - Set 1}{Gov1_gain_slct&0xff=1:Alt - Set 1}{Gov1_gain_slct&0xff=2:Fuel Based}{Gov1_gain_slct&0xff=3:Std - Set 2}{Gov1_gain_slct&0xff=4:Alt - Set 2}" VALUE 0x001C9D31 /* @ECU_Address@Gov1_gain_slct@0x01002C38@ */ ECIPP_ALIGNMENT_UBYTE 255 Gov1_gain_slct_COMPU_VTAB 0 255 BIT_MASK 0xff /end CHARACTERISTIC
/begin COMPU_METHOD Gov1_gain_slct_COMPU_VTAB "Verbal Table" TAB_VERB "%.0" "list" COMPU_TAB_REF Gov1_gain_slct_COMPU_VTAB_REF /end COMPU_METHOD
/begin COMPU_VTAB Gov1_gain_slct_COMPU_VTAB_REF "Verbal Table" TAB_VERB 5 0 "Std - Set 1" 1 "Alt - Set 1" 2 "Fuel Based" 3 "Std - Set 2" 4 "Alt - Set 2" DEFAULT_VALUE "UNKNOWN" /end COMPU_VTAB
/begin CHARACTERISTIC maxgv_gain_slct "MaxGv gain selection{maxgv_gain_slct&0xff=0:Std - Set 1}{maxgv_gain_slct&0xff=1:Alt - Set 1}{maxgv_gain_slct&0xff=2:Fuel Based}{maxgv_gain_slct&0xff=3:Std - Set 2}{maxgv_gain_slct&0xff=4:Alt - Set 2}" VALUE 0x001C9DB5 /* @ECU_Address@maxgv_gain_slct@0x01002C40@ */ ECIPP_ALIGNMENT_UBYTE 255 maxgv_gain_slct_COMPU_VTAB 0 255 BIT_MASK 0xff /end CHARACTERISTIC
/begin COMPU_METHOD maxgv_gain_slct_COMPU_VTAB "Verbal Table" TAB_VERB "%.0" "list" COMPU_TAB_REF maxgv_gain_slct_COMPU_VTAB_REF /end COMPU_METHOD
/begin COMPU_VTAB maxgv_gain_slct_COMPU_VTAB_REF "Verbal Table" TAB_VERB 5 0 "Std - Set 1" 1 "Alt - Set 1" 2 "Fuel Based" 3 "Std - Set 2" 4 "Alt - Set 2" DEFAULT_VALUE "UNKNOWN" /end COMPU_VTAB
/begin CHARACTERISTIC mingv_gain_slct "MinGv gain selection{mingv_gain_slct&0xff=0:Std - Set 1}{mingv_gain_slct&0xff=1:Alt - Set 1}{mingv_gain_slct&0xff=2:Fuel Based}{mingv_gain_slct&0xff=3:Std - Set 2}{mingv_gain_slct&0xff=4:Alt - Set 2}" VALUE 0x001C9DD5 /* @ECU_Address@mingv_gain_slct@0x01002C48@ */ ECIPP_ALIGNMENT_UBYTE 255 mingv_gain_slct_COMPU_VTAB 0 255 BIT_MASK 0xff /end CHARACTERISTIC
/begin COMPU_METHOD mingv_gain_slct_COMPU_VTAB "Verbal Table" TAB_VERB "%.0" "list" COMPU_TAB_REF mingv_gain_slct_COMPU_VTAB_REF /end COMPU_METHOD
/begin COMPU_VTAB mingv_gain_slct_COMPU_VTAB_REF "Verbal Table" TAB_VERB 5 0 "Std - Set 1" 1 "Alt - Set 1" 2 "Fuel Based" 3 "Std - Set 2" 4 "Alt - Set 2" DEFAULT_VALUE "UNKNOWN" /end COMPU_VTAB
/begin CHARACTERISTIC MaxSetPt_Gov3 "User setpoint max speed parameters{MaxSetPt_Gov3&0xff=0:Default - Max Gov Params}{MaxSetPt_Gov3&0xff=1:Use Gov3 Params}" VALUE 0x001c8846 /* @ECU_Address@MaxSetPt_Gov3@0x01002C50@ */ ECIPP_ALIGNMENT_UBYTE 255 MaxSetPt_Gov3_COMPU_VTAB 0 255 BIT_MASK 0xff /end CHARACTERISTIC
/begin COMPU_METHOD MaxSetPt_Gov3_COMPU_VTAB "Verbal Table" TAB_VERB "%.0" "list" COMPU_TAB_REF MaxSetPt_Gov3_COMPU_VTAB_REF /end COMPU_METHOD
/begin COMPU_VTAB MaxSetPt_Gov3_COMPU_VTAB_REF "Verbal Table" TAB_VERB 2 0 "Default - Max Gov Params" 1 "Use Gov3 Params" DEFAULT_VALUE "UNKNOWN" /end COMPU_VTAB
/begin CHARACTERISTIC minigv_Iinit_ena "minigv_Iinit_ena{minigv_Iinit_ena&0xff=0x00:Disabled}{minigv_Iinit_ena&0xff=0x01:Enabled}" VALUE 0x001C9DD6 /* @ECU_Address@minigv_Iinit_ena@0x01002C58@ */ ECIPP_ALIGNMENT_UBYTE 255 minigv_Iinit_ena_COMPU_VTAB 0 255 BIT_MASK 0xff /end CHARACTERISTIC
/begin COMPU_METHOD minigv_Iinit_ena_COMPU_VTAB "Verbal Table" TAB_VERB "%.0" "list" COMPU_TAB_REF minigv_Iinit_ena_COMPU_VTAB_REF /end COMPU_METHOD
/begin COMPU_VTAB minigv_Iinit_ena_COMPU_VTAB_REF "Verbal Table" TAB_VERB 2 0x00 "Disabled" 0x01 "Enabled" DEFAULT_VALUE "UNKNOWN" /end COMPU_VTAB
/begin CHARACTERISTIC maxigv_Iinit_ena "maxigv_Iinit_ena{maxigv_Iinit_ena&0xff=0x00:Disabled}{maxigv_Iinit_ena&0xff=0x01:Enabled}" VALUE 0x001C9DB6 /* @ECU_Address@maxigv_Iinit_ena@0x01002C60@ */ ECIPP_ALIGNMENT_UBYTE 255 maxigv_Iinit_ena_COMPU_VTAB 0 255 BIT_MASK 0xff /end CHARACTERISTIC
/begin COMPU_METHOD maxigv_Iinit_ena_COMPU_VTAB "Verbal Table" TAB_VERB "%.0" "list" COMPU_TAB_REF maxigv_Iinit_ena_COMPU_VTAB_REF /end COMPU_METHOD
/begin COMPU_VTAB maxigv_Iinit_ena_COMPU_VTAB_REF "Verbal Table" TAB_VERB 2 0x00 "Disabled" 0x01 "Enabled" DEFAULT_VALUE "UNKNOWN" /end COMPU_VTAB
/begin CHARACTERISTIC Gov1i_Iinit_ena "Gov1i_Iinit_ena{Gov1i_Iinit_ena&0xff=0x00:Disabled}{Gov1i_Iinit_ena&0xff=0x01:Enabled}" VALUE 0x001C9D32 /* @ECU_Address@Gov1i_Iinit_ena@0x01002C68@ */ ECIPP_ALIGNMENT_UBYTE 255 Gov1i_Iinit_ena_COMPU_VTAB 0 255 BIT_MASK 0xff /end CHARACTERISTIC
/begin COMPU_METHOD Gov1i_Iinit_ena_COMPU_VTAB "Verbal Table" TAB_VERB "%.0" "list" COMPU_TAB_REF Gov1i_Iinit_ena_COMPU_VTAB_REF /end COMPU_METHOD
/begin COMPU_VTAB Gov1i_Iinit_ena_COMPU_VTAB_REF "Verbal Table" TAB_VERB 2 0x00 "Disabled" 0x01 "Enabled" DEFAULT_VALUE "UNKNOWN" /end COMPU_VTAB
/begin CHARACTERISTIC Gov2i_Iinit_ena "Gov2i_Iinit_ena{Gov2i_Iinit_ena&0xff=0x00:Disabled}{Gov2i_Iinit_ena&0xff=0x01:Enabled}" VALUE 0x001C9D5E /* @ECU_Address@Gov2i_Iinit_ena@0x01002C70@ */ ECIPP_ALIGNMENT_UBYTE 255 Gov2i_Iinit_ena_COMPU_VTAB 0 255 BIT_MASK 0xff /end CHARACTERISTIC
/begin COMPU_METHOD Gov2i_Iinit_ena_COMPU_VTAB "Verbal Table" TAB_VERB "%.0" "list" COMPU_TAB_REF Gov2i_Iinit_ena_COMPU_VTAB_REF /end COMPU_METHOD
/begin COMPU_VTAB Gov2i_Iinit_ena_COMPU_VTAB_REF "Verbal Table" TAB_VERB 2 0x00 "Disabled" 0x01 "Enabled" DEFAULT_VALUE "UNKNOWN" /end COMPU_VTAB
/begin CHARACTERISTIC Gov3i_Iinit_ena "Gov3i_Iinit_ena{Gov3i_Iinit_ena&0xff=0x00:Disabled}{Gov3i_Iinit_ena&0xff=0x01:Enabled}" VALUE 0x001C9D8A /* @ECU_Address@Gov3i_Iinit_ena@0x01002C78@ */ ECIPP_ALIGNMENT_UBYTE 255 Gov3i_Iinit_ena_COMPU_VTAB 0 255 BIT_MASK 0xff /end CHARACTERISTIC
/begin COMPU_METHOD Gov3i_Iinit_ena_COMPU_VTAB "Verbal Table" TAB_VERB "%.0" "list" COMPU_TAB_REF Gov3i_Iinit_ena_COMPU_VTAB_REF /end COMPU_METHOD
/begin COMPU_VTAB Gov3i_Iinit_ena_COMPU_VTAB_REF "Verbal Table" TAB_VERB 2 0x00 "Disabled" 0x01 "Enabled" DEFAULT_VALUE "UNKNOWN" /end COMPU_VTAB
/begin MEASUREMENT MaxSetPt_rpm "Max engine speed control setpoint" UWORD Compu_MaxSetPt_rpm 0 0 0 65535 ECU_ADDRESS 0x01002C80 /end MEASUREMENT
/begin COMPU_METHOD Compu_MaxSetPt_rpm " " RAT_FUNC "%.0" "rpm" COEFFS 0 1 0 0 0 1 /end COMPU_METHOD
/begin MEASUREMENT MaxSetPt_engaged "Max speed user setpoint status{MaxSetPt_engaged&0xff=0:Idle}{MaxSetPt_engaged&0xff=1:Active}" UBYTE MaxSetPt_engaged_COMPU_VTAB 0 0 0 255 ECU_ADDRESS 0x01002C88 BIT_MASK 0xff /end MEASUREMENT
/begin COMPU_METHOD MaxSetPt_engaged_COMPU_VTAB "Verbal Table" TAB_VERB "%.0" "list" COMPU_TAB_REF MaxSetPt_engaged_COMPU_VTAB_REF /end COMPU_METHOD
/begin COMPU_VTAB MaxSetPt_engaged_COMPU_VTAB_REF "Verbal Table" TAB_VERB 2 0 "Idle" 1 "Active" DEFAULT_VALUE "UNKNOWN" /end COMPU_VTAB
/begin MEASUREMENT MaxSetPt_switch "Off/RPM/RS state{MaxSetPt_switch&0xff=0:Off}{MaxSetPt_switch&0xff=1:RPM Control}{MaxSetPt_switch&0xff=2:Vehicle Speed Control}" UBYTE MaxSetPt_switch_COMPU_VTAB 0 0 0 255 ECU_ADDRESS 0x01002C90 BIT_MASK 0xff /end MEASUREMENT
/begin COMPU_METHOD MaxSetPt_switch_COMPU_VTAB "Verbal Table" TAB_VERB "%.0" "list" COMPU_TAB_REF MaxSetPt_switch_COMPU_VTAB_REF /end COMPU_METHOD
/begin COMPU_VTAB MaxSetPt_switch_COMPU_VTAB_REF "Verbal Table" TAB_VERB 3 0 "Off" 1 "RPM Control" 2 "Vehicle Speed Control" DEFAULT_VALUE "UNKNOWN" /end COMPU_VTAB
/begin CHARACTERISTIC MaxSetPt_ena "Max speed user setpoint - Primary{MaxSetPt_ena&0xff=0:Disabled}{MaxSetPt_ena&0xff=1:Enabled by Aux PU1 active=RPM}{MaxSetPt_ena&0xff=2:Enabled by Aux PU2 active=RPM}{MaxSetPt_ena&0xff=3:Enabled by Aux PU3 active=RPM}{MaxSetPt_ena&0xff=4:Enabled by Aux DIG" VALUE 0x001c8848 /* @ECU_Address@MaxSetPt_ena@0x01002C98@ */ ECIPP_ALIGNMENT_UBYTE 255 MaxSetPt_ena_COMPU_VTAB 0 255 BIT_MASK 0xff /end CHARACTERISTIC
/begin COMPU_METHOD MaxSetPt_ena_COMPU_VTAB "Verbal Table" TAB_VERB "%.0" "list" COMPU_TAB_REF MaxSetPt_ena_COMPU_VTAB_REF /end COMPU_METHOD
/begin COMPU_VTAB MaxSetPt_ena_COMPU_VTAB_REF "Verbal Table" TAB_VERB 14 0 "Disabled" 1 "Enabled by Aux PU1 active=RPM" 2 "Enabled by Aux PU2 active=RPM" 3 "Enabled by Aux PU3 active=RPM" 4 "Enabled by Aux DIG1" 5 "Enabled by Aux DIG2" 6 "Enabled by Aux DIG3" 7 "Network Switch" 8 "Software Switch" 9 "Enabled by Aux PU2 w/ DIG2=Open" 10 "Enabled by Aux PU2 w/ DIG2=Gnd" 11 "Enabled by Aux PU1 active=RS" 12 "Enabled by Aux PU2 active=RS" 13 "Enabled by Aux PU3 active=RS" DEFAULT_VALUE "UNKNOWN" /end COMPU_VTAB
/begin CHARACTERISTIC MSP_min_rpm "Minimum settable RPM" VALUE 0x001c7dd6 /* @ECU_Address@MSP_min_rpm@0x01002CA0@ */ ECIPP_ALIGNMENT_UWORD 65535 Compu_MSP_min_rpm 0 65535 /end CHARACTERISTIC
/begin COMPU_METHOD Compu_MSP_min_rpm " " RAT_FUNC "%.0" "rpm" COEFFS 0 1 0 0 0 1 /end COMPU_METHOD
/begin CHARACTERISTIC MSP_max_rpm "Maximum settable RPM" VALUE 0x001c7dd2 /* @ECU_Address@MSP_max_rpm@0x01002CA8@ */ ECIPP_ALIGNMENT_UWORD 65535 Compu_MSP_max_rpm 0 65535 /end CHARACTERISTIC
/begin COMPU_METHOD Compu_MSP_max_rpm " " RAT_FUNC "%.0" "rpm" COEFFS 0 1 0 0 0 1 /end COMPU_METHOD
/begin CHARACTERISTIC MSP_1tap_rpm "Single-tap RPM step change" VALUE 0x001c7dce /* @ECU_Address@MSP_1tap_rpm@0x01002CB0@ */ ECIPP_ALIGNMENT_UWORD 65535 Compu_MSP_1tap_rpm 0 65535 /end CHARACTERISTIC
/begin COMPU_METHOD Compu_MSP_1tap_rpm " " RAT_FUNC "%.0" "rpm" COEFFS 0 1 0 0 0 1 /end COMPU_METHOD
/begin CHARACTERISTIC MSP_ramp_delay "Button-hold delay before ramping speed" VALUE 0x001c7de2 /* @ECU_Address@MSP_ramp_delay@0x01002CB8@ */ ECIPP_ALIGNMENT_UWORD 66 Compu_MSP_ramp_delay 0 65.535 /end CHARACTERISTIC
/begin COMPU_METHOD Compu_MSP_ramp_delay " " RAT_FUNC "%.3" "sec" COEFFS 0 1000 0 0 0 1 /end COMPU_METHOD
/begin CHARACTERISTIC MSP_ramp_phase "Button-hold speed ramping phase-in" VALUE 0x001c7de6 /* @ECU_Address@MSP_ramp_phase@0x01002CC0@ */ ECIPP_ALIGNMENT_UWORD 66 Compu_MSP_ramp_phase 0 65.535 /end CHARACTERISTIC
/begin COMPU_METHOD Compu_MSP_ramp_phase " " RAT_FUNC "%.3" "sec" COEFFS 0 1000 0 0 0 1 /end COMPU_METHOD
/begin CHARACTERISTIC MSP_ramp_final "Button-hold RPM ramping max rate" VALUE 0x001c7de4 /* @ECU_Address@MSP_ramp_final@0x01002CC8@ */ ECIPP_ALIGNMENT_UWORD 65535 Compu_MSP_ramp_final 0 65535 /end CHARACTERISTIC
/begin COMPU_METHOD Compu_MSP_ramp_final " " RAT_FUNC "%.0" "rpm/sec" COEFFS 0 1 0 0 0 1 /end COMPU_METHOD
/begin MEASUREMENT MSP_incdec_sw "Increase/decrease switch{MSP_incdec_sw&0xff=255:Decrease}{MSP_incdec_sw&0xff=0:-}{MSP_incdec_sw&0xff=1:Increase}" UBYTE MSP_incdec_sw_COMPU_VTAB 0 0 0 255 ECU_ADDRESS 0x01002CD0 BIT_MASK 0xff /end MEASUREMENT
/begin COMPU_METHOD MSP_incdec_sw_COMPU_VTAB "Verbal Table" TAB_VERB "%.0" "list" COMPU_TAB_REF MSP_incdec_sw_COMPU_VTAB_REF /end COMPU_METHOD
/begin COMPU_VTAB MSP_incdec_sw_COMPU_VTAB_REF "Verbal Table" TAB_VERB 3 255 "Decrease" 0 "-" 1 "Increase" DEFAULT_VALUE "UNKNOWN" /end COMPU_VTAB
/begin MEASUREMENT MSP_setclr_sw "Set/Clear switch{MSP_setclr_sw&0xff=255:Clear}{MSP_setclr_sw&0xff=0:-}{MSP_setclr_sw&0xff=1:Set}" UBYTE MSP_setclr_sw_COMPU_VTAB 0 0 0 255 ECU_ADDRESS 0x01002CD8 BIT_MASK 0xff /end MEASUREMENT
/begin COMPU_METHOD MSP_setclr_sw_COMPU_VTAB "Verbal Table" TAB_VERB "%.0" "list" COMPU_TAB_REF MSP_setclr_sw_COMPU_VTAB_REF /end COMPU_METHOD
/begin COMPU_VTAB MSP_setclr_sw_COMPU_VTAB_REF "Verbal Table" TAB_VERB 3 255 "Clear" 0 "-" 1 "Set" DEFAULT_VALUE "UNKNOWN" /end COMPU_VTAB
/begin MEASUREMENT Kiv_gov "Kiv_rpm gain" SWORD Compu_Kiv_gov 0 0 -6250 6249.80926513672 ECU_ADDRESS 0x01002D18 /end MEASUREMENT
/begin COMPU_METHOD Compu_Kiv_gov " " RAT_FUNC "%.1" "% / krpm" COEFFS 0 5.24288 0 0 0 1 /end COMPU_METHOD
/begin MEASUREMENT Kiv_gov_mult "Kiv ECT attenuator" UWORD Compu_Kiv_gov_mult 0 0 0 15.999755859375 ECU_ADDRESS 0x01002D20 /end MEASUREMENT
/begin COMPU_METHOD Compu_Kiv_gov_mult " " RAT_FUNC "%.3" "fraction" COEFFS 0 4096 0 0 0 1 /end COMPU_METHOD
/begin CHARACTERISTIC MSP_set_source "Speed setpoint mode/source - Primary{MSP_set_source&0xff=0:Momentary - Gov switches}{MSP_set_source&0xff=1:Proportional - Aux PD1}{MSP_set_source&0xff=2:Proportional - Aux PD2}{MSP_set_source&0xff=3:Proportional - Aux PD3}{MSP_set_source&0xff=4:Proportion" VALUE 0x001C8842 /* @ECU_Address@MSP_set_source@0x010030B0@ */ ECIPP_ALIGNMENT_UBYTE 255 MSP_set_source_COMPU_VTAB 0 255 BIT_MASK 0xff /end CHARACTERISTIC
/begin COMPU_METHOD MSP_set_source_COMPU_VTAB "Verbal Table" TAB_VERB "%.0" "list" COMPU_TAB_REF MSP_set_source_COMPU_VTAB_REF /end COMPU_METHOD
/begin COMPU_VTAB MSP_set_source_COMPU_VTAB_REF "Verbal Table" TAB_VERB 7 0 "Momentary - Gov switches" 1 "Proportional - Aux PD1" 2 "Proportional - Aux PD2" 3 "Proportional - Aux PD3" 4 "Proportional - Aux PUD1" 5 "Proportional - Aux PUD2" 6 "Proportional - Aux PUD3" DEFAULT_VALUE "UNKNOWN" /end COMPU_VTAB
/begin CHARACTERISTIC MSP_prop_V0 "Proportional setpoint V min" VALUE 0x001c7dd8 /* @ECU_Address@MSP_prop_V0@0x010030B8@ */ ECIPP_ALIGNMENT_UWORD 5 Compu_MSP_prop_V0 0 5.00114468864469 /end CHARACTERISTIC
/begin COMPU_METHOD Compu_MSP_prop_V0 " " RAT_FUNC "%.3" "volts" COEFFS 0 13104 0 0 0 1 /end COMPU_METHOD
/begin CHARACTERISTIC MSP_prop_V1 "Proportional setpoint V max" VALUE 0x001c7dda /* @ECU_Address@MSP_prop_V1@0x010030C0@ */ ECIPP_ALIGNMENT_UWORD 5 Compu_MSP_prop_V1 0 5.00114468864469 /end CHARACTERISTIC
/begin COMPU_METHOD Compu_MSP_prop_V1 " " RAT_FUNC "%.3" "volts" COEFFS 0 13104 0 0 0 1 /end COMPU_METHOD
/begin CHARACTERISTIC MSP_prop_rpm0 "Proportional setpoint speed min" VALUE 0x001c7ddc /* @ECU_Address@MSP_prop_rpm0@0x010030C8@ */ ECIPP_ALIGNMENT_UWORD 65535 Compu_MSP_prop_rpm0 0 65535 /end CHARACTERISTIC
/begin COMPU_METHOD Compu_MSP_prop_rpm0 " " RAT_FUNC "%.0" "rpm" COEFFS 0 1 0 0 0 1 /end COMPU_METHOD
/begin CHARACTERISTIC MSP_prop_rpm1 "Proportional setpoint speed max" VALUE 0x001c7dde /* @ECU_Address@MSP_prop_rpm1@0x010030D0@ */ ECIPP_ALIGNMENT_UWORD 65535 Compu_MSP_prop_rpm1 0 65535 /end CHARACTERISTIC
/begin COMPU_METHOD Compu_MSP_prop_rpm1 " " RAT_FUNC "%.0" "rpm" COEFFS 0 1 0 0 0 1 /end COMPU_METHOD
/begin CHARACTERISTIC MSP_prop_tau "Proportional setpoint input low-pass" VALUE 0x001c857a /* @ECU_Address@MSP_prop_tau@0x010030D8@ */ ECIPP_ALIGNMENT_UWORD 327680 Compu_MSP_prop_tau 0.45084 327680 /end CHARACTERISTIC
/begin COMPU_METHOD Compu_MSP_prop_tau " " FORM "%.1" "ms"
 /begin FORMULA "-5 / log(1 - (X1 / 65536))" FORMULA_INV "(1 - exp(-5/X1)) * 65536" /end FORMULA
/end COMPU_METHOD
/begin CHARACTERISTIC MaxSetPt_apprdt "Initial engagement decel limit" VALUE 0x001c4576 /* @ECU_Address@MaxSetPt_apprdt@0x01003110@ */ ECIPP_ALIGNMENT_SWORD 63998 Compu_MaxSetPt_apprdt -64000 63998.046875 /end CHARACTERISTIC
/begin COMPU_METHOD Compu_MaxSetPt_apprdt " " RAT_FUNC "%.0" "rpm/sec" COEFFS 0 0.512 0 0 0 1 /end COMPU_METHOD
/begin MEASUREMENT MSP_prop_V "Proportional setpoint input voltage" UWORD Compu_MSP_prop_V 0 0 0 5.00114468864469 ECU_ADDRESS 0x01003120 /end MEASUREMENT
/begin COMPU_METHOD Compu_MSP_prop_V " " RAT_FUNC "%.3" "volts" COEFFS 0 13104 0 0 0 1 /end COMPU_METHOD
/begin CHARACTERISTIC MSP_1tap_RS "Single-tap roadspeed step change" VALUE 0x001c7dcc /* @ECU_Address@MSP_1tap_RS@0x01003AF8@ */ ECIPP_ALIGNMENT_UWORD 256 Compu_MSP_1tap_RS 0 255.99609375 /end CHARACTERISTIC
/begin COMPU_METHOD Compu_MSP_1tap_RS " " RAT_FUNC "%.2" "kph" COEFFS 0 256 0 0 0 1 /end COMPU_METHOD
/begin CHARACTERISTIC MSP_rampRS_final "Button-hold roadspeed ramping max rate" VALUE 0x001c7de0 /* @ECU_Address@MSP_rampRS_final@0x01003B00@ */ ECIPP_ALIGNMENT_UWORD 256 Compu_MSP_rampRS_final 0 255.99609375 /end CHARACTERISTIC
/begin COMPU_METHOD Compu_MSP_rampRS_final " " RAT_FUNC "%.2" "kph/sec" COEFFS 0 256 0 0 0 1 /end COMPU_METHOD
/begin CHARACTERISTIC MSP_min_RS "Minimum settable roadspeed" VALUE 0x001c7dd4 /* @ECU_Address@MSP_min_RS@0x01003B08@ */ ECIPP_ALIGNMENT_UWORD 256 Compu_MSP_min_RS 0 255.99609375 /end CHARACTERISTIC
/begin COMPU_METHOD Compu_MSP_min_RS " " RAT_FUNC "%.1" "kph" COEFFS 0 256 0 0 0 1 /end COMPU_METHOD
/begin CHARACTERISTIC MSP_max_RS "Maximum settable roadspeed" VALUE 0x001c7dd0 /* @ECU_Address@MSP_max_RS@0x01003B10@ */ ECIPP_ALIGNMENT_UWORD 256 Compu_MSP_max_RS 0 255.99609375 /end CHARACTERISTIC
/begin COMPU_METHOD Compu_MSP_max_RS " " RAT_FUNC "%.1" "kph" COEFFS 0 256 0 0 0 1 /end COMPU_METHOD
/begin MEASUREMENT MSP_mode_sw "Off/RPM/RS switch{MSP_mode_sw&0xff=0:Off}{MSP_mode_sw&0xff=1:RPM Control}{MSP_mode_sw&0xff=2:Vehicle Speed Control}" UBYTE MSP_mode_sw_COMPU_VTAB 0 0 0 255 ECU_ADDRESS 0x01003B38 BIT_MASK 0xff /end MEASUREMENT
/begin COMPU_METHOD MSP_mode_sw_COMPU_VTAB "Verbal Table" TAB_VERB "%.0" "list" COMPU_TAB_REF MSP_mode_sw_COMPU_VTAB_REF /end COMPU_METHOD
/begin COMPU_VTAB MSP_mode_sw_COMPU_VTAB_REF "Verbal Table" TAB_VERB 3 0 "Off" 1 "RPM Control" 2 "Vehicle Speed Control" DEFAULT_VALUE "UNKNOWN" /end COMPU_VTAB
/begin CHARACTERISTIC MSP_setclr_HW_input "Set/Clear switch input{MSP_setclr_HW_input&0xff=0:Network / software switch}{MSP_setclr_HW_input&0xff=1:Gov1 hardware switch}{MSP_setclr_HW_input&0xff=2:Disabled}" VALUE 0x001c8844 /* @ECU_Address@MSP_setclr_HW_input@0x01003B40@ */ ECIPP_ALIGNMENT_UBYTE 255 MSP_setclr_HW_input_COMPU_VTAB 0 255 BIT_MASK 0xff /end CHARACTERISTIC
/begin COMPU_METHOD MSP_setclr_HW_input_COMPU_VTAB "Verbal Table" TAB_VERB "%.0" "list" COMPU_TAB_REF MSP_setclr_HW_input_COMPU_VTAB_REF /end COMPU_METHOD
/begin COMPU_VTAB MSP_setclr_HW_input_COMPU_VTAB_REF "Verbal Table" TAB_VERB 3 0 "Network / software switch" 1 "Gov1 hardware switch" 2 "Disabled" DEFAULT_VALUE "UNKNOWN" /end COMPU_VTAB
/begin CHARACTERISTIC MSP_incdec_HW_input "Inc/Decrement switch input{MSP_incdec_HW_input&0xff=0:Network / software switch}{MSP_incdec_HW_input&0xff=1:Gov2 hardware switch}{MSP_incdec_HW_input&0xff=2:Gov1/2 = +V hardware switches}" VALUE 0x001c8840 /* @ECU_Address@MSP_incdec_HW_input@0x01003B48@ */ ECIPP_ALIGNMENT_UBYTE 255 MSP_incdec_HW_input_COMPU_VTAB 0 255 BIT_MASK 0xff /end CHARACTERISTIC
/begin COMPU_METHOD MSP_incdec_HW_input_COMPU_VTAB "Verbal Table" TAB_VERB "%.0" "list" COMPU_TAB_REF MSP_incdec_HW_input_COMPU_VTAB_REF /end COMPU_METHOD
/begin COMPU_VTAB MSP_incdec_HW_input_COMPU_VTAB_REF "Verbal Table" TAB_VERB 3 0 "Network / software switch" 1 "Gov2 hardware switch" 2 "Gov1/2 = +V hardware switches" DEFAULT_VALUE "UNKNOWN" /end COMPU_VTAB
/begin CHARACTERISTIC MaxSetPt_keyon "Control behavior at key-on{MaxSetPt_keyon&0xff=0:Disengaged initially}{MaxSetPt_keyon&0xff=1:Engaged initially}{MaxSetPt_keyon&0xff=2:Previous state}" VALUE 0x001c8849 /* @ECU_Address@MaxSetPt_keyon@0x01003D30@ */ ECIPP_ALIGNMENT_UBYTE 255 MaxSetPt_keyon_COMPU_VTAB 0 255 BIT_MASK 0xff /end CHARACTERISTIC
/begin COMPU_METHOD MaxSetPt_keyon_COMPU_VTAB "Verbal Table" TAB_VERB "%.0" "list" COMPU_TAB_REF MaxSetPt_keyon_COMPU_VTAB_REF /end COMPU_METHOD
/begin COMPU_VTAB MaxSetPt_keyon_COMPU_VTAB_REF "Verbal Table" TAB_VERB 3 0 "Disengaged initially" 1 "Engaged initially" 2 "Previous state" DEFAULT_VALUE "UNKNOWN" /end COMPU_VTAB
/begin CHARACTERISTIC MSP2_set_source "Speed setpoint mode/source - Secondary{MSP2_set_source&0xff=0:Momentary - Gov switches}{MSP2_set_source&0xff=1:Proportional - Aux PD1}{MSP2_set_source&0xff=2:Proportional - Aux PD2}{MSP2_set_source&0xff=3:Proportional - Aux PD3}{MSP2_set_source&0xff=4:Pro" VALUE 0x001C8843 /* @ECU_Address@MSP2_set_source@0x010041A0@ */ ECIPP_ALIGNMENT_UBYTE 255 MSP2_set_source_COMPU_VTAB 0 255 BIT_MASK 0xff /end CHARACTERISTIC
/begin COMPU_METHOD MSP2_set_source_COMPU_VTAB "Verbal Table" TAB_VERB "%.0" "list" COMPU_TAB_REF MSP2_set_source_COMPU_VTAB_REF /end COMPU_METHOD
/begin COMPU_VTAB MSP2_set_source_COMPU_VTAB_REF "Verbal Table" TAB_VERB 7 0 "Momentary - Gov switches" 1 "Proportional - Aux PD1" 2 "Proportional - Aux PD2" 3 "Proportional - Aux PD3" 4 "Proportional - Aux PUD1" 5 "Proportional - Aux PUD2" 6 "Proportional - Aux PUD3" DEFAULT_VALUE "UNKNOWN" /end COMPU_VTAB
/begin CHARACTERISTIC MaxSetPt2_ena "Max speed user setpoint - Secondary{MaxSetPt2_ena&0xff=0:Disabled}{MaxSetPt2_ena&0xff=1:Enabled by Aux PU1 active=RPM}{MaxSetPt2_ena&0xff=2:Enabled by Aux PU2 active=RPM}{MaxSetPt2_ena&0xff=3:Enabled by Aux PU3 active=RPM}{MaxSetPt2_ena&0xff=4:Enabled by " VALUE 0x001c8845 /* @ECU_Address@MaxSetPt2_ena@0x010041A8@ */ ECIPP_ALIGNMENT_UBYTE 255 MaxSetPt2_ena_COMPU_VTAB 0 255 BIT_MASK 0xff /end CHARACTERISTIC
/begin COMPU_METHOD MaxSetPt2_ena_COMPU_VTAB "Verbal Table" TAB_VERB "%.0" "list" COMPU_TAB_REF MaxSetPt2_ena_COMPU_VTAB_REF /end COMPU_METHOD
/begin COMPU_VTAB MaxSetPt2_ena_COMPU_VTAB_REF "Verbal Table" TAB_VERB 14 0 "Disabled" 1 "Enabled by Aux PU1 active=RPM" 2 "Enabled by Aux PU2 active=RPM" 3 "Enabled by Aux PU3 active=RPM" 4 "Enabled by Aux DIG1" 5 "Enabled by Aux DIG2" 6 "Enabled by Aux DIG3" 7 "Network Switch" 8 "Software Switch" 9 "Enabled by Aux PU2 w/ DIG2=Open" 10 "Enabled by Aux PU2 w/ DIG2=Gnd" 11 "Enabled by Aux PU1 active=RS" 12 "Enabled by Aux PU2 active=RS" 13 "Enabled by Aux PU3 active=RS" DEFAULT_VALUE "UNKNOWN" /end COMPU_VTAB
/begin MEASUREMENT MSP_prisec "Primary/Secondary system selected{MSP_prisec&0xff=0:Primary}{MSP_prisec&0xff=1:Secondary}{MSP_prisec&0xff=2:Network Override}" UBYTE MSP_prisec_COMPU_VTAB 0 0 0 255 ECU_ADDRESS 0x010041B0 BIT_MASK 0xff /end MEASUREMENT
/begin COMPU_METHOD MSP_prisec_COMPU_VTAB "Verbal Table" TAB_VERB "%.0" "list" COMPU_TAB_REF MSP_prisec_COMPU_VTAB_REF /end COMPU_METHOD
/begin COMPU_VTAB MSP_prisec_COMPU_VTAB_REF "Verbal Table" TAB_VERB 3 0 "Primary" 1 "Secondary" 2 "Network Override" DEFAULT_VALUE "UNKNOWN" /end COMPU_VTAB
/begin MEASUREMENT TSC_ff_loadval "Current TSC1 feedforward gov load" SWORD Compu_TSC_ff_loadval 0 0 -800 799.9755859375 ECU_ADDRESS 0x01004520 /end MEASUREMENT
/begin COMPU_METHOD Compu_TSC_ff_loadval " " RAT_FUNC "%.1" "%" COEFFS 0 40.96 0 0 0 1 /end COMPU_METHOD
/begin CHARACTERISTIC fastidle_ena "Fast idle digital input{fastidle_ena&0xff=0:Disabled}{fastidle_ena&0xff=1:Aux DIG1}{fastidle_ena&0xff=2:Aux DIG2}{fastidle_ena&0xff=3:Aux DIG3}{fastidle_ena&0xff=4:Aux DIG4}{fastidle_ena&0xff=5:Gov1 Switch Input}{fastidle_ena&0xff=6:Gov2 Switch Input}" VALUE 0x001c9014 /* @ECU_Address@fastidle_ena@0x01004848@ */ ECIPP_ALIGNMENT_UBYTE 255 fastidle_ena_COMPU_VTAB 0 255 BIT_MASK 0xff /end CHARACTERISTIC
/begin COMPU_METHOD fastidle_ena_COMPU_VTAB "Verbal Table" TAB_VERB "%.0" "list" COMPU_TAB_REF fastidle_ena_COMPU_VTAB_REF /end COMPU_METHOD
/begin COMPU_VTAB fastidle_ena_COMPU_VTAB_REF "Verbal Table" TAB_VERB 7 0 "Disabled" 1 "Aux DIG1" 2 "Aux DIG2" 3 "Aux DIG3" 4 "Aux DIG4" 5 "Gov1 Switch Input" 6 "Gov2 Switch Input" DEFAULT_VALUE "UNKNOWN" /end COMPU_VTAB
/begin CHARACTERISTIC fastidle_rpm "Fast idle speed target" VALUE 0x001c8430 /* @ECU_Address@fastidle_rpm@0x01004850@ */ ECIPP_ALIGNMENT_UWORD 65535 Compu_fastidle_rpm 0 65535 /end CHARACTERISTIC
/begin COMPU_METHOD Compu_fastidle_rpm " " RAT_FUNC "%.0" "rpm" COEFFS 0 1 0 0 0 1 /end COMPU_METHOD
/begin CHARACTERISTIC fastidle_act_st "Fast idle input active state{fastidle_act_st&0xff=0:+V = Active}{fastidle_act_st&0xff=1:Gnd = Active}{fastidle_act_st&0xff=2:Open = Active}" VALUE 0x001c9013 /* @ECU_Address@fastidle_act_st@0x01004858@ */ ECIPP_ALIGNMENT_UBYTE 255 fastidle_act_st_COMPU_VTAB 0 255 BIT_MASK 0xff /end CHARACTERISTIC
/begin COMPU_METHOD fastidle_act_st_COMPU_VTAB "Verbal Table" TAB_VERB "%.0" "list" COMPU_TAB_REF fastidle_act_st_COMPU_VTAB_REF /end COMPU_METHOD
/begin COMPU_VTAB fastidle_act_st_COMPU_VTAB_REF "Verbal Table" TAB_VERB 3 0 "+V = Active" 1 "Gnd = Active" 2 "Open = Active" DEFAULT_VALUE "UNKNOWN" /end COMPU_VTAB
/begin CHARACTERISTIC strt_idle_mode "Starting initial speed mode{strt_idle_mode&0xff=0:Single-Point / Zero-Hold}{strt_idle_mode&0xff=1:ECT Table-Based}{strt_idle_mode&0xff=2:ECT Table Based + Warm Up}" VALUE 0x001c9081 /* @ECU_Address@strt_idle_mode@0x01004B60@ */ ECIPP_ALIGNMENT_UBYTE 255 strt_idle_mode_COMPU_VTAB 0 255 BIT_MASK 0xff /end CHARACTERISTIC
/begin COMPU_METHOD strt_idle_mode_COMPU_VTAB "Verbal Table" TAB_VERB "%.0" "list" COMPU_TAB_REF strt_idle_mode_COMPU_VTAB_REF /end COMPU_METHOD
/begin COMPU_VTAB strt_idle_mode_COMPU_VTAB_REF "Verbal Table" TAB_VERB 3 0 "Single-Point / Zero-Hold" 1 "ECT Table-Based" 2 "ECT Table Based + Warm Up" DEFAULT_VALUE "UNKNOWN" /end COMPU_VTAB
/begin MEASUREMENT strt_idle_ini "Start initial speed" UWORD Compu_strt_idle_ini 0 0 0 65535 ECU_ADDRESS 0x01004B68 /end MEASUREMENT
/begin COMPU_METHOD Compu_strt_idle_ini " " RAT_FUNC "%.0" "rpm" COEFFS 0 1 0 0 0 1 /end COMPU_METHOD
/begin MEASUREMENT strt_idle_hld "Start initial speed hold" UWORD Compu_strt_idle_hld 0 0 0 65.535 ECU_ADDRESS 0x01004B70 /end MEASUREMENT
/begin COMPU_METHOD Compu_strt_idle_hld " " RAT_FUNC "%.3" "sec" COEFFS 0 1000 0 0 0 1 /end COMPU_METHOD
/begin MEASUREMENT strt_idle_dcy "Start initial speed ramp" UWORD Compu_strt_idle_dcy 0 0 0 999.984741210938 ECU_ADDRESS 0x01004B78 /end MEASUREMENT
/begin COMPU_METHOD Compu_strt_idle_dcy " " RAT_FUNC "%.0" "rpm / sec" COEFFS 0 65.536 0 0 0 1 /end COMPU_METHOD
/begin MEASUREMENT MSP_status "Max speed setpoint engagement{MSP_status&0xff=0:Off}{MSP_status&0xff=1:On - Inactive}{MSP_status&0xff=2:On - Active}{MSP_status&0xff=3:N/A}" UBYTE MSP_status_COMPU_VTAB 0 0 0 255 ECU_ADDRESS 0x01005318 BIT_MASK 0xff /end MEASUREMENT
/begin COMPU_METHOD MSP_status_COMPU_VTAB "Verbal Table" TAB_VERB "%.0" "list" COMPU_TAB_REF MSP_status_COMPU_VTAB_REF /end COMPU_METHOD
/begin COMPU_VTAB MSP_status_COMPU_VTAB_REF "Verbal Table" TAB_VERB 4 0 "Off" 1 "On - Inactive" 2 "On - Active" 3 "N/A" DEFAULT_VALUE "UNKNOWN" /end COMPU_VTAB
/begin CHARACTERISTIC MaxSetPt_rtn_ena "Max set point gov interlock{MaxSetPt_rtn_ena&0xff=0:Disabled}{MaxSetPt_rtn_ena&0xff=1:Enabled}" VALUE 0x001c884a /* @ECU_Address@MaxSetPt_rtn_ena@0x01005720@ */ ECIPP_ALIGNMENT_UBYTE 255 MaxSetPt_rtn_ena_COMPU_VTAB 0 255 BIT_MASK 0xff /end CHARACTERISTIC
/begin COMPU_METHOD MaxSetPt_rtn_ena_COMPU_VTAB "Verbal Table" TAB_VERB "%.0" "list" COMPU_TAB_REF MaxSetPt_rtn_ena_COMPU_VTAB_REF /end COMPU_METHOD
/begin COMPU_VTAB MaxSetPt_rtn_ena_COMPU_VTAB_REF "Verbal Table" TAB_VERB 2 0 "Disabled" 1 "Enabled" DEFAULT_VALUE "UNKNOWN" /end COMPU_VTAB
/begin CHARACTERISTIC secspd_sw "Secondary speed ctl engagement{secspd_sw&0xff=0:Default}{secspd_sw&0xff=1:Aux PU1=Gnd}{secspd_sw&0xff=2:Aux PU2=Gnd}{secspd_sw&0xff=3:Aux PU3=Gnd}{secspd_sw&0xff=4:Aux PUD1=+5V}{secspd_sw&0xff=5:Aux PUD2=+5V}{secspd_sw&0xff=6:Aux PUD3=+5V}{secspd_sw&0xff=" VALUE 0x001c9079 /* @ECU_Address@secspd_sw@0x01005878@ */ ECIPP_ALIGNMENT_UBYTE 255 secspd_sw_COMPU_VTAB 0 255 BIT_MASK 0xff /end CHARACTERISTIC
/begin COMPU_METHOD secspd_sw_COMPU_VTAB "Verbal Table" TAB_VERB "%.0" "list" COMPU_TAB_REF secspd_sw_COMPU_VTAB_REF /end COMPU_METHOD
/begin COMPU_VTAB secspd_sw_COMPU_VTAB_REF "Verbal Table" TAB_VERB 10 0 "Default" 1 "Aux PU1=Gnd" 2 "Aux PU2=Gnd" 3 "Aux PU3=Gnd" 4 "Aux PUD1=+5V" 5 "Aux PUD2=+5V" 6 "Aux PUD3=+5V" 7 "Aux DIG1=+V" 8 "Aux DIG2=+V" 9 "Aux DIG3=+V" DEFAULT_VALUE "UNKNOWN" /end COMPU_VTAB
/begin MEASUREMENT secspd_ena "Secondary speed control request{secspd_ena&0xff=0:Off}{secspd_ena&0xff=1:On}" UBYTE secspd_ena_COMPU_VTAB 0 0 0 255 ECU_ADDRESS 0x010058A8 BIT_MASK 0xff /end MEASUREMENT
/begin COMPU_METHOD secspd_ena_COMPU_VTAB "Verbal Table" TAB_VERB "%.0" "list" COMPU_TAB_REF secspd_ena_COMPU_VTAB_REF /end COMPU_METHOD
/begin COMPU_VTAB secspd_ena_COMPU_VTAB_REF "Verbal Table" TAB_VERB 2 0 "Off" 1 "On" DEFAULT_VALUE "UNKNOWN" /end COMPU_VTAB
/begin CHARACTERISTIC TransNeut_sw "Trans in-neutral indication{TransNeut_sw&0xff=0:Disabled}{TransNeut_sw&0xff=1:Aux PU1=Gnd}{TransNeut_sw&0xff=2:Aux PU2=Gnd}{TransNeut_sw&0xff=3:Aux PU3=Gnd}{TransNeut_sw&0xff=4:Aux PUD1=+5V}{TransNeut_sw&0xff=5:Aux PUD2=+5V}{TransNeut_sw&0xff=6:Aux PUD3=+" VALUE 0x001c8f70 /* @ECU_Address@TransNeut_sw@0x01005B08@ */ ECIPP_ALIGNMENT_UBYTE 255 TransNeut_sw_COMPU_VTAB 0 255 BIT_MASK 0xff /end CHARACTERISTIC
/begin COMPU_METHOD TransNeut_sw_COMPU_VTAB "Verbal Table" TAB_VERB "%.0" "list" COMPU_TAB_REF TransNeut_sw_COMPU_VTAB_REF /end COMPU_METHOD
/begin COMPU_VTAB TransNeut_sw_COMPU_VTAB_REF "Verbal Table" TAB_VERB 48 0 "Disabled" 1 "Aux PU1=Gnd" 2 "Aux PU2=Gnd" 3 "Aux PU3=Gnd" 4 "Aux PUD1=+5V" 5 "Aux PUD2=+5V" 6 "Aux PUD3=+5V" 7 "Aux DIG1" 8 "Aux DIG2" 9 "Aux DIG3" 10 "Aux PUD1=Gnd" 11 "Aux PUD2=Gnd" 12 "Aux PUD3=Gnd" 13 "Aux PD1=+5V" 14 "Aux PD2=+5V" 15 "Aux PD3=+5V" 16 "J1939 ETC2" 17 "Aux DIG4" 18 "Aux DIG5" 19 "Aux DIG6" 20 "Aux DIG7" 21 "Aux DIG8" 22 "Aux DIG9" 23 "Aux DIG10" 24 "Aux DIG11" 25 "Aux DIG12" 26 "Aux DIG13" 27 "Aux DIG14" 28 "Aux DIG15" 29 "Aux DIG16" 30 "Aux DIG17" 31 "Aux DIG18" 32 "Aux DIG19" 33 "J1939 BC2" 34 "Aux PUD4" 35 "Aux PUD5" 36 "Aux PUD6" 37 "Aux PUD7" 38 "Aux PUD8" 39 "Aux PUD9" 40 "Aux PUD10" 41 "Aux PUD11" 42 "Aux PUD12" 43 "Aux PUD13" 44 "Aux PUD14" 45 "Aux PUD15" 46 "J1939 DEC1" 47 "J1939 PGN 65473" DEFAULT_VALUE "UNKNOWN" /end COMPU_VTAB
/begin MEASUREMENT TransNeut_ena "Trans in-neutral status{TransNeut_ena&0xff=0:Invalid}{TransNeut_ena&0xff=1:Valid}" UBYTE TransNeut_ena_COMPU_VTAB 0 0 0 255 ECU_ADDRESS 0x01005B10 BIT_MASK 0xff /end MEASUREMENT
/begin COMPU_METHOD TransNeut_ena_COMPU_VTAB "Verbal Table" TAB_VERB "%.0" "list" COMPU_TAB_REF TransNeut_ena_COMPU_VTAB_REF /end COMPU_METHOD
/begin COMPU_VTAB TransNeut_ena_COMPU_VTAB_REF "Verbal Table" TAB_VERB 2 0 "Invalid" 1 "Valid" DEFAULT_VALUE "UNKNOWN" /end COMPU_VTAB
/begin CHARACTERISTIC Gtap_rpmmin_adjust "Minimum speed for setpoint adjustment" VALUE 0x001c7be0 /* @ECU_Address@Gtap_rpmmin_adjust@0x01005CB8@ */ ECIPP_ALIGNMENT_UWORD 65535 Compu_Gtap_rpmmin_adjust 0 65535 /end CHARACTERISTIC
/begin COMPU_METHOD Compu_Gtap_rpmmin_adjust " " RAT_FUNC "%.0" "rpm" COEFFS 0 1 0 0 0 1 /end COMPU_METHOD
/begin CHARACTERISTIC veh_type "Governor application vehicle type{veh_type&0xff=0:Direct drive}{veh_type&0xff=1:Indirect drive}" VALUE 0x001c9090 /* @ECU_Address@veh_type@0x01006730@ */ ECIPP_ALIGNMENT_UBYTE 255 veh_type_COMPU_VTAB 0 255 BIT_MASK 0xff /end CHARACTERISTIC
/begin COMPU_METHOD veh_type_COMPU_VTAB "Verbal Table" TAB_VERB "%.0" "list" COMPU_TAB_REF veh_type_COMPU_VTAB_REF /end COMPU_METHOD
/begin COMPU_VTAB veh_type_COMPU_VTAB_REF "Verbal Table" TAB_VERB 2 0 "Direct drive" 1 "Indirect drive" DEFAULT_VALUE "UNKNOWN" /end COMPU_VTAB
/begin CHARACTERISTIC clutch_sw "Clutch pedal switch{clutch_sw&0xff=0:Disabled}{clutch_sw&0xff=1:Aux PU1=Gnd}{clutch_sw&0xff=2:Aux PU2=Gnd}{clutch_sw&0xff=3:Aux PU3=Gnd}{clutch_sw&0xff=4:Aux PUD1=+5V}{clutch_sw&0xff=5:Aux PUD2=+5V}{clutch_sw&0xff=6:Aux PUD3=+5V}{clutch_sw&0xff=7:Aux DIG1" VALUE 0x001c8fd1 /* @ECU_Address@clutch_sw@0x01007280@ */ ECIPP_ALIGNMENT_UBYTE 255 clutch_sw_COMPU_VTAB 0 255 BIT_MASK 0xff /end CHARACTERISTIC
/begin COMPU_METHOD clutch_sw_COMPU_VTAB "Verbal Table" TAB_VERB "%.0" "list" COMPU_TAB_REF clutch_sw_COMPU_VTAB_REF /end COMPU_METHOD
/begin COMPU_VTAB clutch_sw_COMPU_VTAB_REF "Verbal Table" TAB_VERB 34 0 "Disabled" 1 "Aux PU1=Gnd" 2 "Aux PU2=Gnd" 3 "Aux PU3=Gnd" 4 "Aux PUD1=+5V" 5 "Aux PUD2=+5V" 6 "Aux PUD3=+5V" 7 "Aux DIG1" 8 "Aux DIG2" 9 "Aux DIG3" 10 "Aux PUD1=Gnd" 11 "Aux PUD2=Gnd" 12 "Aux PUD3=Gnd" 13 "Aux PD1=+5V" 14 "Aux PD2=+5V" 15 "Aux PD3=+5V" 16 "J1939 ETC1" 17 "J1939 CCVS" 18 "Aux DIG4" 19 "Aux DIG5" 20 "Aux DIG6" 21 "Aux DIG7" 22 "Aux DIG8" 23 "Aux DIG9" 24 "Aux DIG10" 25 "Aux DIG11" 26 "Aux DIG12" 27 "Aux DIG13" 28 "Aux DIG14" 29 "Aux DIG15" 30 "Aux DIG16" 31 "Aux DIG17" 32 "Aux DIG18" 33 "Aux DIG19" DEFAULT_VALUE "UNKNOWN" /end COMPU_VTAB
/begin MEASUREMENT clutch_depressed "Clutch pedal depressed{clutch_depressed&0xff=0:Released}{clutch_depressed&0xff=1:Depressed}" UBYTE clutch_depressed_COMPU_VTAB 0 0 0 255 ECU_ADDRESS 0x01007288 BIT_MASK 0xff /end MEASUREMENT
/begin COMPU_METHOD clutch_depressed_COMPU_VTAB "Verbal Table" TAB_VERB "%.0" "list" COMPU_TAB_REF clutch_depressed_COMPU_VTAB_REF /end COMPU_METHOD
/begin COMPU_VTAB clutch_depressed_COMPU_VTAB_REF "Verbal Table" TAB_VERB 2 0 "Released" 1 "Depressed" DEFAULT_VALUE "UNKNOWN" /end COMPU_VTAB
/begin CHARACTERISTIC strt_max_FPP "Start max FPP" VALUE 0x001c84f6 /* @ECU_Address@strt_max_FPP@0x010077F8@ */ ECIPP_ALIGNMENT_UWORD 100 Compu_strt_max_FPP 0 99.9984741210938 /end CHARACTERISTIC
/begin COMPU_METHOD Compu_strt_max_FPP " " RAT_FUNC "%.1" "%" COEFFS 0 655.36 0 0 0 1 /end COMPU_METHOD
/begin MEASUREMENT clutch_fault "Clutch fault{clutch_fault&0xff=0:NO}{clutch_fault&0xff=1:YES}" UBYTE clutch_fault_COMPU_VTAB 0 0 0 255 ECU_ADDRESS 0x01007930 BIT_MASK 0xff /end MEASUREMENT
/begin COMPU_METHOD clutch_fault_COMPU_VTAB "Verbal Table" TAB_VERB "%.0" "list" COMPU_TAB_REF clutch_fault_COMPU_VTAB_REF /end COMPU_METHOD
/begin COMPU_VTAB clutch_fault_COMPU_VTAB_REF "Verbal Table" TAB_VERB 2 0 "NO" 1 "YES" DEFAULT_VALUE "UNKNOWN" /end COMPU_VTAB
/begin CHARACTERISTIC clutch_sw_config "Clutch pedal configuration{clutch_sw_config&0xff=0:Bi-state/Tri-state open=released}{clutch_sw_config&0xff=1:Tri-state open=depressed}{clutch_sw_config&0xff=2:Aux DIG +V=released}{clutch_sw_config&0xff=3:Aux DIG +V=depressed}" VALUE 0x001c8fd2 /* @ECU_Address@clutch_sw_config@0x01007948@ */ ECIPP_ALIGNMENT_UBYTE 255 clutch_sw_config_COMPU_VTAB 0 255 BIT_MASK 0xff /end CHARACTERISTIC
/begin COMPU_METHOD clutch_sw_config_COMPU_VTAB "Verbal Table" TAB_VERB "%.0" "list" COMPU_TAB_REF clutch_sw_config_COMPU_VTAB_REF /end COMPU_METHOD
/begin COMPU_VTAB clutch_sw_config_COMPU_VTAB_REF "Verbal Table" TAB_VERB 4 0 "Bi-state/Tri-state open=released" 1 "Tri-state open=depressed" 2 "Aux DIG +V=released" 3 "Aux DIG +V=depressed" DEFAULT_VALUE "UNKNOWN" /end COMPU_VTAB
/begin CHARACTERISTIC gov_rs_ena "Roadspeed based gains{gov_rs_ena&0xff=0:Disabled}{gov_rs_ena&0xff=1:Enabled}" VALUE 0x001c9050 /* @ECU_Address@gov_rs_ena@0x0100C7B0@ */ ECIPP_ALIGNMENT_UBYTE 255 gov_rs_ena_COMPU_VTAB 0 255 BIT_MASK 0xff /end CHARACTERISTIC
/begin COMPU_METHOD gov_rs_ena_COMPU_VTAB "Verbal Table" TAB_VERB "%.0" "list" COMPU_TAB_REF gov_rs_ena_COMPU_VTAB_REF /end COMPU_METHOD
/begin COMPU_VTAB gov_rs_ena_COMPU_VTAB_REF "Verbal Table" TAB_VERB 2 0 "Disabled" 1 "Enabled" DEFAULT_VALUE "UNKNOWN" /end COMPU_VTAB
/begin CHARACTERISTIC TransNeut_sw_cfg "Trans in-neutral Aux DIG config{TransNeut_sw_cfg&0xff=0:Default}{TransNeut_sw_cfg&0xff=1:GND}{TransNeut_sw_cfg&0xff=2:GND/+V}{TransNeut_sw_cfg&0xff=3:+V}{TransNeut_sw_cfg&0xff=4:Open}" VALUE 0x001c8f71 /* @ECU_Address@TransNeut_sw_cfg@0x0100C7D8@ */ ECIPP_ALIGNMENT_UBYTE 255 TransNeut_sw_cfg_COMPU_VTAB 0 255 BIT_MASK 0xff /end CHARACTERISTIC
/begin COMPU_METHOD TransNeut_sw_cfg_COMPU_VTAB "Verbal Table" TAB_VERB "%.0" "list" COMPU_TAB_REF TransNeut_sw_cfg_COMPU_VTAB_REF /end COMPU_METHOD
/begin COMPU_VTAB TransNeut_sw_cfg_COMPU_VTAB_REF "Verbal Table" TAB_VERB 5 0 "Default" 1 "GND" 2 "GND/+V" 3 "+V" 4 "Open" DEFAULT_VALUE "UNKNOWN" /end COMPU_VTAB
/begin MEASUREMENT Linde_ff_loadval "Current feedforward gov load" SWORD Compu_Linde_ff_loadval 0 0 -800 799.9755859375 ECU_ADDRESS 0x0100CD60 /end MEASUREMENT
/begin COMPU_METHOD Compu_Linde_ff_loadval " " RAT_FUNC "%.1" "%" COEFFS 0 40.96 0 0 0 1 /end COMPU_METHOD
/begin CHARACTERISTIC gov_gain_gsln_dis "Gasoline mode governor gains discrete{gov_gain_gsln_dis&0xff=0:Std - Set 1}{gov_gain_gsln_dis&0xff=1:Alt - Set 1}{gov_gain_gsln_dis&0xff=2:Std - Set 2}{gov_gain_gsln_dis&0xff=3:Alt - Set 2}" VALUE 0x001c904e /* @ECU_Address@gov_gain_gsln_dis@0x0100E7C0@ */ ECIPP_ALIGNMENT_UBYTE 255 gov_gain_gsln_dis_COMPU_VTAB 0 255 BIT_MASK 0xff /end CHARACTERISTIC
/begin COMPU_METHOD gov_gain_gsln_dis_COMPU_VTAB "Verbal Table" TAB_VERB "%.0" "list" COMPU_TAB_REF gov_gain_gsln_dis_COMPU_VTAB_REF /end COMPU_METHOD
/begin COMPU_VTAB gov_gain_gsln_dis_COMPU_VTAB_REF "Verbal Table" TAB_VERB 4 0 "Std - Set 1" 1 "Alt - Set 1" 2 "Std - Set 2" 3 "Alt - Set 2" DEFAULT_VALUE "UNKNOWN" /end COMPU_VTAB
/begin CHARACTERISTIC gov_gain_LPG_dis "LPG mode governor gains discrete{gov_gain_LPG_dis&0xff=0:Std - Set 1}{gov_gain_LPG_dis&0xff=1:Alt - Set 1}{gov_gain_LPG_dis&0xff=2:Std - Set 2}{gov_gain_LPG_dis&0xff=3:Alt - Set 2}" VALUE 0x001c9044 /* @ECU_Address@gov_gain_LPG_dis@0x0100E7C8@ */ ECIPP_ALIGNMENT_UBYTE 255 gov_gain_LPG_dis_COMPU_VTAB 0 255 BIT_MASK 0xff /end CHARACTERISTIC
/begin COMPU_METHOD gov_gain_LPG_dis_COMPU_VTAB "Verbal Table" TAB_VERB "%.0" "list" COMPU_TAB_REF gov_gain_LPG_dis_COMPU_VTAB_REF /end COMPU_METHOD
/begin COMPU_VTAB gov_gain_LPG_dis_COMPU_VTAB_REF "Verbal Table" TAB_VERB 4 0 "Std - Set 1" 1 "Alt - Set 1" 2 "Std - Set 2" 3 "Alt - Set 2" DEFAULT_VALUE "UNKNOWN" /end COMPU_VTAB
/begin CHARACTERISTIC gov_gain_NG_dis "NG  mode governor gains discrete{gov_gain_NG_dis&0xff=0:Std - Set 1}{gov_gain_NG_dis&0xff=1:Alt - Set 1}{gov_gain_NG_dis&0xff=2:Std - Set 2}{gov_gain_NG_dis&0xff=3:Alt - Set 2}" VALUE 0x001c9048 /* @ECU_Address@gov_gain_NG_dis@0x0100E7D0@ */ ECIPP_ALIGNMENT_UBYTE 255 gov_gain_NG_dis_COMPU_VTAB 0 255 BIT_MASK 0xff /end CHARACTERISTIC
/begin COMPU_METHOD gov_gain_NG_dis_COMPU_VTAB "Verbal Table" TAB_VERB "%.0" "list" COMPU_TAB_REF gov_gain_NG_dis_COMPU_VTAB_REF /end COMPU_METHOD
/begin COMPU_VTAB gov_gain_NG_dis_COMPU_VTAB_REF "Verbal Table" TAB_VERB 4 0 "Std - Set 1" 1 "Alt - Set 1" 2 "Std - Set 2" 3 "Alt - Set 2" DEFAULT_VALUE "UNKNOWN" /end COMPU_VTAB
/begin CHARACTERISTIC Gov1_spk_att_ena "Gov1 spark attenuation{Gov1_spk_att_ena&0xff=0x00:Disabled}{Gov1_spk_att_ena&0xff=0x01:Enabled}" VALUE 0x001c875b /* @ECU_Address@Gov1_spk_att_ena@0x01012C50@ */ ECIPP_ALIGNMENT_UBYTE 255 Gov1_spk_att_ena_COMPU_VTAB 0 255 BIT_MASK 0xff /end CHARACTERISTIC
/begin COMPU_METHOD Gov1_spk_att_ena_COMPU_VTAB "Verbal Table" TAB_VERB "%.0" "list" COMPU_TAB_REF Gov1_spk_att_ena_COMPU_VTAB_REF /end COMPU_METHOD
/begin COMPU_VTAB Gov1_spk_att_ena_COMPU_VTAB_REF "Verbal Table" TAB_VERB 2 0x00 "Disabled" 0x01 "Enabled" DEFAULT_VALUE "UNKNOWN" /end COMPU_VTAB
/begin CHARACTERISTIC Gov2_spk_att_ena "Gov2 spark attenuation{Gov2_spk_att_ena&0xff=0x00:Disabled}{Gov2_spk_att_ena&0xff=0x01:Enabled}" VALUE 0x001c875d /* @ECU_Address@Gov2_spk_att_ena@0x01012C58@ */ ECIPP_ALIGNMENT_UBYTE 255 Gov2_spk_att_ena_COMPU_VTAB 0 255 BIT_MASK 0xff /end CHARACTERISTIC
/begin COMPU_METHOD Gov2_spk_att_ena_COMPU_VTAB "Verbal Table" TAB_VERB "%.0" "list" COMPU_TAB_REF Gov2_spk_att_ena_COMPU_VTAB_REF /end COMPU_METHOD
/begin COMPU_VTAB Gov2_spk_att_ena_COMPU_VTAB_REF "Verbal Table" TAB_VERB 2 0x00 "Disabled" 0x01 "Enabled" DEFAULT_VALUE "UNKNOWN" /end COMPU_VTAB
/begin MEASUREMENT gov_auth_max "Governor max authority" UWORD Compu_gov_auth_max 0 0 0 99.9984741210938 ECU_ADDRESS 0x01012CE0 /end MEASUREMENT
/begin COMPU_METHOD Compu_gov_auth_max " " RAT_FUNC "%.1" "%" COEFFS 0 655.36 0 0 0 1 /end COMPU_METHOD
/begin CHARACTERISTIC Gtap_setmin_wait "Tap up/down set minimum debounce" VALUE 0x001c7be2 /* @ECU_Address@Gtap_setmin_wait@0x01012D58@ */ ECIPP_ALIGNMENT_UWORD 65535 Compu_Gtap_setmin_wait 0 65535 /end CHARACTERISTIC
/begin COMPU_METHOD Compu_Gtap_setmin_wait " " RAT_FUNC "%.0" "ms" COEFFS 0 1 0 0 0 1 /end COMPU_METHOD
/begin CHARACTERISTIC AMT_Gov3_acc_init "AMT TSC1 Gov3 initial integrator" VALUE 0x001c3e3c /* @ECU_Address@AMT_Gov3_acc_init@0x01013460@ */ ECIPP_ALIGNMENT_SLONG 800 Compu_AMT_Gov3_acc_init -800 799.999999627471 /end CHARACTERISTIC
/begin COMPU_METHOD Compu_AMT_Gov3_acc_init " " RAT_FUNC "%.1" "%" COEFFS 0 2684354.56 0 0 0 1 /end COMPU_METHOD
/begin CHARACTERISTIC AMT_select "AMT selection{AMT_select&0xff=0:Disabled}{AMT_select&0xff=1:Enabled - SA 3}{AMT_select&0xff=2:Enabled - SA 39}" VALUE 0x001c867a /* @ECU_Address@AMT_select@0x01013468@ */ ECIPP_ALIGNMENT_UBYTE 255 AMT_select_COMPU_VTAB 0 255 BIT_MASK 0xff /end CHARACTERISTIC
/begin COMPU_METHOD AMT_select_COMPU_VTAB "Verbal Table" TAB_VERB "%.0" "list" COMPU_TAB_REF AMT_select_COMPU_VTAB_REF /end COMPU_METHOD
/begin COMPU_VTAB AMT_select_COMPU_VTAB_REF "Verbal Table" TAB_VERB 3 0 "Disabled" 1 "Enabled - SA 3" 2 "Enabled - SA 39" DEFAULT_VALUE "UNKNOWN" /end COMPU_VTAB
/begin CHARACTERISTIC AMT_Gov3_acc_maxload "AMT Gov3 integrator reset max load" VALUE 0x001c6d64 /* @ECU_Address@AMT_Gov3_acc_maxload@0x01013470@ */ ECIPP_ALIGNMENT_UWORD 100 Compu_AMT_Gov3_acc_maxload 0 99.9984741210938 /end CHARACTERISTIC
/begin COMPU_METHOD Compu_AMT_Gov3_acc_maxload " " RAT_FUNC "%.1" "%" COEFFS 0 655.36 0 0 0 1 /end COMPU_METHOD
/begin CHARACTERISTIC IPAS_mode "Idle pull away speed mode{IPAS_mode&0xff=0:Disabled}{IPAS_mode&0xff=1:Vehicle speed only}{IPAS_mode&0xff=2:Vehicle speed + parking brake}{IPAS_mode&0xff=3:Vehicle speed + parking brake + foot brake}" VALUE 0x001c8797 /* @ECU_Address@IPAS_mode@0x01013680@ */ ECIPP_ALIGNMENT_UBYTE 255 IPAS_mode_COMPU_VTAB 0 255 BIT_MASK 0xff /end CHARACTERISTIC
/begin COMPU_METHOD IPAS_mode_COMPU_VTAB "Verbal Table" TAB_VERB "%.0" "list" COMPU_TAB_REF IPAS_mode_COMPU_VTAB_REF /end COMPU_METHOD
/begin COMPU_VTAB IPAS_mode_COMPU_VTAB_REF "Verbal Table" TAB_VERB 4 0 "Disabled" 1 "Vehicle speed only" 2 "Vehicle speed + parking brake" 3 "Vehicle speed + parking brake + foot brake" DEFAULT_VALUE "UNKNOWN" /end COMPU_VTAB
/begin CHARACTERISTIC IPAS_rpm "Idle pull away speed" VALUE 0x001c7c5e /* @ECU_Address@IPAS_rpm@0x01013688@ */ ECIPP_ALIGNMENT_UWORD 65535 Compu_IPAS_rpm 0 65535 /end CHARACTERISTIC
/begin COMPU_METHOD Compu_IPAS_rpm " " RAT_FUNC "%.0" "rpm" COEFFS 0 1 0 0 0 1 /end COMPU_METHOD
/begin CHARACTERISTIC IPAS_speed_on "Idle pull away engage min roadspeed" VALUE 0x001c7c62 /* @ECU_Address@IPAS_speed_on@0x01013690@ */ ECIPP_ALIGNMENT_UWORD 256 Compu_IPAS_speed_on 0 255.99609375 /end CHARACTERISTIC
/begin COMPU_METHOD Compu_IPAS_speed_on " " RAT_FUNC "%.1" "kph" COEFFS 0 256 0 0 0 1 /end COMPU_METHOD
/begin CHARACTERISTIC IPAS_speed_off "Idle pull away disengage max roadspeed" VALUE 0x001c7c60 /* @ECU_Address@IPAS_speed_off@0x01013698@ */ ECIPP_ALIGNMENT_UWORD 256 Compu_IPAS_speed_off 0 255.99609375 /end CHARACTERISTIC
/begin COMPU_METHOD Compu_IPAS_speed_off " " RAT_FUNC "%.1" "kph" COEFFS 0 256 0 0 0 1 /end COMPU_METHOD
/begin MEASUREMENT IPAS_engaged "Idle pull away speed engaged{IPAS_engaged&0xff=0:NO}{IPAS_engaged&0xff=1:YES}" UBYTE IPAS_engaged_COMPU_VTAB 0 0 0 255 ECU_ADDRESS 0x010136A0 BIT_MASK 0xff /end MEASUREMENT
/begin COMPU_METHOD IPAS_engaged_COMPU_VTAB "Verbal Table" TAB_VERB "%.0" "list" COMPU_TAB_REF IPAS_engaged_COMPU_VTAB_REF /end COMPU_METHOD
/begin COMPU_VTAB IPAS_engaged_COMPU_VTAB_REF "Verbal Table" TAB_VERB 2 0 "NO" 1 "YES" DEFAULT_VALUE "UNKNOWN" /end COMPU_VTAB
/begin MEASUREMENT min_allspeed_rpm "FPP speed control min gov rpm" UWORD Compu_min_allspeed_rpm 0 0 0 65535 ECU_ADDRESS 0x010136A8 /end MEASUREMENT
/begin COMPU_METHOD Compu_min_allspeed_rpm " " RAT_FUNC "%.0" "rpm" COEFFS 0 1 0 0 0 1 /end COMPU_METHOD
/begin CHARACTERISTIC AMT_neut_coast_mode "AMT neutral coasting{AMT_neut_coast_mode&0xff=0:Disabled}{AMT_neut_coast_mode&0xff=1:WABCO}" VALUE 0x001c8679 /* @ECU_Address@AMT_neut_coast_mode@0x01013900@ */ ECIPP_ALIGNMENT_UBYTE 255 AMT_neut_coast_mode_COMPU_VTAB 0 255 BIT_MASK 0xff /end CHARACTERISTIC
/begin COMPU_METHOD AMT_neut_coast_mode_COMPU_VTAB "Verbal Table" TAB_VERB "%.0" "list" COMPU_TAB_REF AMT_neut_coast_mode_COMPU_VTAB_REF /end COMPU_METHOD
/begin COMPU_VTAB AMT_neut_coast_mode_COMPU_VTAB_REF "Verbal Table" TAB_VERB 2 0 "Disabled" 1 "WABCO" DEFAULT_VALUE "UNKNOWN" /end COMPU_VTAB
/begin MEASUREMENT AMT_RSC_suspend "AMT suspend cruise status{AMT_RSC_suspend&0xff=0x00:Disabled}{AMT_RSC_suspend&0xff=0x01:Inactive}{AMT_RSC_suspend&0xff=0x22:Suspended}{AMT_RSC_suspend&0xff=0x23:Resuming}{AMT_RSC_suspend&0xff=0x14:Resumed}{AMT_RSC_suspend&0xff=0x45:Cancelled}" UBYTE AMT_RSC_suspend_COMPU_VTAB 0 0 0 255 ECU_ADDRESS 0x01013908 BIT_MASK 0xff /end MEASUREMENT
/begin COMPU_METHOD AMT_RSC_suspend_COMPU_VTAB "Verbal Table" TAB_VERB "%.0" "list" COMPU_TAB_REF AMT_RSC_suspend_COMPU_VTAB_REF /end COMPU_METHOD
/begin COMPU_VTAB AMT_RSC_suspend_COMPU_VTAB_REF "Verbal Table" TAB_VERB 6 0x00 "Disabled" 0x01 "Inactive" 0x22 "Suspended" 0x23 "Resuming" 0x14 "Resumed" 0x45 "Cancelled" DEFAULT_VALUE "UNKNOWN" /end COMPU_VTAB
/begin MEASUREMENT max_gov_highidle_rpm "High idle speed" UWORD Compu_max_gov_highidle_rpm 0 0 0 65535 ECU_ADDRESS 0x01013960 /end MEASUREMENT
/begin COMPU_METHOD Compu_max_gov_highidle_rpm " " RAT_FUNC "%.0" "rpm" COEFFS 0 1 0 0 0 1 /end COMPU_METHOD
/begin CHARACTERISTIC gov_strt_wait_mode "Gov1/2/3 delay from start mode{gov_strt_wait_mode&0xff=0:Time-based}{gov_strt_wait_mode&0xff=1:Warm-up complete}" VALUE 0x001c9051 /* @ECU_Address@gov_strt_wait_mode@0x01014270@ */ ECIPP_ALIGNMENT_UBYTE 255 gov_strt_wait_mode_COMPU_VTAB 0 255 BIT_MASK 0xff /end CHARACTERISTIC
/begin COMPU_METHOD gov_strt_wait_mode_COMPU_VTAB "Verbal Table" TAB_VERB "%.0" "list" COMPU_TAB_REF gov_strt_wait_mode_COMPU_VTAB_REF /end COMPU_METHOD
/begin COMPU_VTAB gov_strt_wait_mode_COMPU_VTAB_REF "Verbal Table" TAB_VERB 2 0 "Time-based" 1 "Warm-up complete" DEFAULT_VALUE "UNKNOWN" /end COMPU_VTAB
/begin CHARACTERISTIC strt_OILT_lmt "Warm-up phase min oil temp" VALUE 0x001c84ee /* @ECU_Address@strt_OILT_lmt@0x01014278@ */ ECIPP_ALIGNMENT_UWORD 7732 Compu_strt_OILT_lmt -460 7731.875 /end CHARACTERISTIC
/begin COMPU_METHOD Compu_strt_OILT_lmt " " RAT_FUNC "%.0" "deg F" COEFFS 0 8 3680 0 0 1 /end COMPU_METHOD
/begin CHARACTERISTIC strt_ECT_lmt "Warm-up phase min ECT" VALUE 0x001c84ec /* @ECU_Address@strt_ECT_lmt@0x01014280@ */ ECIPP_ALIGNMENT_UWORD 564 Compu_strt_ECT_lmt -460 563.984375 /end CHARACTERISTIC
/begin COMPU_METHOD Compu_strt_ECT_lmt " " RAT_FUNC "%.0" "deg F" COEFFS 0 64 29440 0 0 1 /end COMPU_METHOD
/begin CHARACTERISTIC strt_no_warmup_mult "Warm-up override ramp-rate multiplier" VALUE 0x001c84fe /* @ECU_Address@strt_no_warmup_mult@0x01014288@ */ ECIPP_ALIGNMENT_UWORD 256 Compu_strt_no_warmup_mult 0 255.99609375 /end CHARACTERISTIC
/begin COMPU_METHOD Compu_strt_no_warmup_mult " " RAT_FUNC "%.2" "-" COEFFS 0 256 0 0 0 1 /end COMPU_METHOD
/begin MEASUREMENT strt_no_warmup "Start warm-up override{strt_no_warmup&0xff=0:Inactive}{strt_no_warmup&0xff=1:Active}" UBYTE strt_no_warmup_COMPU_VTAB 0 0 0 255 ECU_ADDRESS 0x01014290 BIT_MASK 0xff /end MEASUREMENT
/begin COMPU_METHOD strt_no_warmup_COMPU_VTAB "Verbal Table" TAB_VERB "%.0" "list" COMPU_TAB_REF strt_no_warmup_COMPU_VTAB_REF /end COMPU_METHOD
/begin COMPU_VTAB strt_no_warmup_COMPU_VTAB_REF "Verbal Table" TAB_VERB 2 0 "Inactive" 1 "Active" DEFAULT_VALUE "UNKNOWN" /end COMPU_VTAB
/begin MEASUREMENT strt_idle_state "Start initial speed state{strt_idle_state&0xff=0:Inactive}{strt_idle_state&0xff=1:Holding Speed}{strt_idle_state&0xff=2:Ramping Speed}{strt_idle_state&0xff=3:Complete}" UBYTE strt_idle_state_COMPU_VTAB 0 0 0 255 ECU_ADDRESS 0x01014298 BIT_MASK 0xff /end MEASUREMENT
/begin COMPU_METHOD strt_idle_state_COMPU_VTAB "Verbal Table" TAB_VERB "%.0" "list" COMPU_TAB_REF strt_idle_state_COMPU_VTAB_REF /end COMPU_METHOD
/begin COMPU_VTAB strt_idle_state_COMPU_VTAB_REF "Verbal Table" TAB_VERB 4 0 "Inactive" 1 "Holding Speed" 2 "Ramping Speed" 3 "Complete" DEFAULT_VALUE "UNKNOWN" /end COMPU_VTAB
/begin CHARACTERISTIC cooldown_ena "Cool down mode{cooldown_ena&0xff=0x00:Disabled}{cooldown_ena&0xff=0x01:Enabled}" VALUE 0x001c8fd4 /* @ECU_Address@cooldown_ena@0x010142A0@ */ ECIPP_ALIGNMENT_UBYTE 255 cooldown_ena_COMPU_VTAB 0 255 BIT_MASK 0xff /end CHARACTERISTIC
/begin COMPU_METHOD cooldown_ena_COMPU_VTAB "Verbal Table" TAB_VERB "%.0" "list" COMPU_TAB_REF cooldown_ena_COMPU_VTAB_REF /end COMPU_METHOD
/begin COMPU_VTAB cooldown_ena_COMPU_VTAB_REF "Verbal Table" TAB_VERB 2 0x00 "Disabled" 0x01 "Enabled" DEFAULT_VALUE "UNKNOWN" /end COMPU_VTAB
/begin CHARACTERISTIC cooldown_rpm "Cool down speed" VALUE 0x001c83ce /* @ECU_Address@cooldown_rpm@0x010142A8@ */ ECIPP_ALIGNMENT_UWORD 65535 Compu_cooldown_rpm 0 65535 /end CHARACTERISTIC
/begin COMPU_METHOD Compu_cooldown_rpm " " RAT_FUNC "%.0" "rpm" COEFFS 0 1 0 0 0 1 /end COMPU_METHOD
/begin CHARACTERISTIC cooldown_rpmdt "Cool down speed ramp rate" VALUE 0x001c83d0 /* @ECU_Address@cooldown_rpmdt@0x010142B0@ */ ECIPP_ALIGNMENT_UWORD 1000 Compu_cooldown_rpmdt 0 999.984741210938 /end CHARACTERISTIC
/begin COMPU_METHOD Compu_cooldown_rpmdt " " RAT_FUNC "%.0" "rpm/sec" COEFFS 0 65.536 0 0 0 1 /end COMPU_METHOD
/begin CHARACTERISTIC cooldown_time_max "Cool down max time" VALUE 0x001c83d6 /* @ECU_Address@cooldown_time_max@0x010142B8@ */ ECIPP_ALIGNMENT_UWORD 1092 Compu_cooldown_time_max 0 1092.25 /end CHARACTERISTIC
/begin COMPU_METHOD Compu_cooldown_time_max " " RAT_FUNC "%.2" "min" COEFFS 0 60 0 0 0 1 /end COMPU_METHOD
/begin CHARACTERISTIC cooldown_time_min "Cool down min time" VALUE 0x001c83d8 /* @ECU_Address@cooldown_time_min@0x010142C0@ */ ECIPP_ALIGNMENT_UWORD 1092 Compu_cooldown_time_min 0 1092.25 /end CHARACTERISTIC
/begin COMPU_METHOD Compu_cooldown_time_min " " RAT_FUNC "%.2" "min" COEFFS 0 60 0 0 0 1 /end COMPU_METHOD
/begin CHARACTERISTIC cooldown_temp1_ena "Cool down temperature #1{cooldown_temp1_ena&0xff=0:Disabled}{cooldown_temp1_ena&0xff=1:EGT}{cooldown_temp1_ena&0xff=2:CAT1}{cooldown_temp1_ena&0xff=3:CAT2}" VALUE 0x001c8fd7 /* @ECU_Address@cooldown_temp1_ena@0x010142C8@ */ ECIPP_ALIGNMENT_UBYTE 255 cooldown_temp1_ena_COMPU_VTAB 0 255 BIT_MASK 0xff /end CHARACTERISTIC
/begin COMPU_METHOD cooldown_temp1_ena_COMPU_VTAB "Verbal Table" TAB_VERB "%.0" "list" COMPU_TAB_REF cooldown_temp1_ena_COMPU_VTAB_REF /end COMPU_METHOD
/begin COMPU_VTAB cooldown_temp1_ena_COMPU_VTAB_REF "Verbal Table" TAB_VERB 4 0 "Disabled" 1 "EGT" 2 "CAT1" 3 "CAT2" DEFAULT_VALUE "UNKNOWN" /end COMPU_VTAB
/begin CHARACTERISTIC cooldown_temp2_ena "Cool down temperature #2{cooldown_temp2_ena&0xff=0:Disabled}{cooldown_temp2_ena&0xff=1:EGT}{cooldown_temp2_ena&0xff=2:CAT1}{cooldown_temp2_ena&0xff=3:CAT2}" VALUE 0x001c8fd8 /* @ECU_Address@cooldown_temp2_ena@0x010142D0@ */ ECIPP_ALIGNMENT_UBYTE 255 cooldown_temp2_ena_COMPU_VTAB 0 255 BIT_MASK 0xff /end CHARACTERISTIC
/begin COMPU_METHOD cooldown_temp2_ena_COMPU_VTAB "Verbal Table" TAB_VERB "%.0" "list" COMPU_TAB_REF cooldown_temp2_ena_COMPU_VTAB_REF /end COMPU_METHOD
/begin COMPU_VTAB cooldown_temp2_ena_COMPU_VTAB_REF "Verbal Table" TAB_VERB 4 0 "Disabled" 1 "EGT" 2 "CAT1" 3 "CAT2" DEFAULT_VALUE "UNKNOWN" /end COMPU_VTAB
/begin CHARACTERISTIC cooldown_temp1 "Cool down min temperature #1" VALUE 0x001c83d2 /* @ECU_Address@cooldown_temp1@0x010142D8@ */ ECIPP_ALIGNMENT_UWORD 7732 Compu_cooldown_temp1 -460 7731.875 /end CHARACTERISTIC
/begin COMPU_METHOD Compu_cooldown_temp1 " " RAT_FUNC "%.0" "deg F" COEFFS 0 8 3680 0 0 1 /end COMPU_METHOD
/begin CHARACTERISTIC cooldown_temp2 "Cool down min temperature #2" VALUE 0x001c83d4 /* @ECU_Address@cooldown_temp2@0x010142E0@ */ ECIPP_ALIGNMENT_UWORD 7732 Compu_cooldown_temp2 -460 7731.875 /end CHARACTERISTIC
/begin COMPU_METHOD Compu_cooldown_temp2 " " RAT_FUNC "%.0" "deg F" COEFFS 0 8 3680 0 0 1 /end COMPU_METHOD
/begin CHARACTERISTIC cooldown_logic "Cool down temperature logic{cooldown_logic&0xff=0:AND}{cooldown_logic&0xff=1:OR}" VALUE 0x001c8fd6 /* @ECU_Address@cooldown_logic@0x010142E8@ */ ECIPP_ALIGNMENT_UBYTE 255 cooldown_logic_COMPU_VTAB 0 255 BIT_MASK 0xff /end CHARACTERISTIC
/begin COMPU_METHOD cooldown_logic_COMPU_VTAB "Verbal Table" TAB_VERB "%.0" "list" COMPU_TAB_REF cooldown_logic_COMPU_VTAB_REF /end COMPU_METHOD
/begin COMPU_VTAB cooldown_logic_COMPU_VTAB_REF "Verbal Table" TAB_VERB 2 0 "AND" 1 "OR" DEFAULT_VALUE "UNKNOWN" /end COMPU_VTAB
/begin MEASUREMENT cooldown_state "Cool down state{cooldown_state&0xff=0:Disabled}{cooldown_state&0xff=1:Inactive}{cooldown_state&0xff=2:Ramping Speed}{cooldown_state&0xff=3:Holding Speed}{cooldown_state&0xff=4:Shutting Down}" UBYTE cooldown_state_COMPU_VTAB 0 0 0 255 ECU_ADDRESS 0x010142F0 BIT_MASK 0xff /end MEASUREMENT
/begin COMPU_METHOD cooldown_state_COMPU_VTAB "Verbal Table" TAB_VERB "%.0" "list" COMPU_TAB_REF cooldown_state_COMPU_VTAB_REF /end COMPU_METHOD
/begin COMPU_VTAB cooldown_state_COMPU_VTAB_REF "Verbal Table" TAB_VERB 5 0 "Disabled" 1 "Inactive" 2 "Ramping Speed" 3 "Holding Speed" 4 "Shutting Down" DEFAULT_VALUE "UNKNOWN" /end COMPU_VTAB
/begin CHARACTERISTIC cooldown_gov_mode "Cool down governor mode{cooldown_gov_mode&0xff=0:Active Gov}{cooldown_gov_mode&0xff=1:Min Gov}{cooldown_gov_mode&0xff=2:Gov3}" VALUE 0x001c8fd5 /* @ECU_Address@cooldown_gov_mode@0x01014308@ */ ECIPP_ALIGNMENT_UBYTE 255 cooldown_gov_mode_COMPU_VTAB 0 255 BIT_MASK 0xff /end CHARACTERISTIC
/begin COMPU_METHOD cooldown_gov_mode_COMPU_VTAB "Verbal Table" TAB_VERB "%.0" "list" COMPU_TAB_REF cooldown_gov_mode_COMPU_VTAB_REF /end COMPU_METHOD
/begin COMPU_VTAB cooldown_gov_mode_COMPU_VTAB_REF "Verbal Table" TAB_VERB 3 0 "Active Gov" 1 "Min Gov" 2 "Gov3" DEFAULT_VALUE "UNKNOWN" /end COMPU_VTAB
/begin CHARACTERISTIC gov_gain_aux_chan "Governor gain selection aux input{gov_gain_aux_chan&0xff=0:Disabled}{gov_gain_aux_chan&0xff=1:Aux DIG1}{gov_gain_aux_chan&0xff=2:Aux DIG2}{gov_gain_aux_chan&0xff=3:Aux DIG3}{gov_gain_aux_chan&0xff=4:Aux DIG4}{gov_gain_aux_chan&0xff=5:Aux DIG5}{gov_gain_au" VALUE 0x001c904a /* @ECU_Address@gov_gain_aux_chan@0x01014310@ */ ECIPP_ALIGNMENT_UBYTE 255 gov_gain_aux_chan_COMPU_VTAB 0 255 BIT_MASK 0xff /end CHARACTERISTIC
/begin COMPU_METHOD gov_gain_aux_chan_COMPU_VTAB "Verbal Table" TAB_VERB "%.0" "list" COMPU_TAB_REF gov_gain_aux_chan_COMPU_VTAB_REF /end COMPU_METHOD
/begin COMPU_VTAB gov_gain_aux_chan_COMPU_VTAB_REF "Verbal Table" TAB_VERB 26 0 "Disabled" 1 "Aux DIG1" 2 "Aux DIG2" 3 "Aux DIG3" 4 "Aux DIG4" 5 "Aux DIG5" 6 "Aux DIG6" 7 "Aux DIG7" 8 "Aux DIG8" 9 "Aux DIG9" 10 "Aux DIG10" 11 "Aux DIG11" 12 "Aux DIG12" 13 "Aux DIG13" 14 "Aux DIG14" 15 "Aux DIG15" 16 "Aux DIG16" 17 "Aux DIG17" 18 "Aux DIG18" 19 "Aux DIG19" 20 "Aux DIG20" 21 "Aux DIG21" 22 "Aux DIG22" 23 "Aux DIG23" 24 "Aux DIG24" 25 "Aux DIG25" DEFAULT_VALUE "UNKNOWN" /end COMPU_VTAB
/begin CHARACTERISTIC gov_gain_aux_cfg "Governor gain selection aux input config{gov_gain_aux_cfg&0xff=0:+V = Aux Gains}{gov_gain_aux_cfg&0xff=1:GND = Aux Gains}" VALUE 0x001c9049 /* @ECU_Address@gov_gain_aux_cfg@0x01014318@ */ ECIPP_ALIGNMENT_UBYTE 255 gov_gain_aux_cfg_COMPU_VTAB 0 255 BIT_MASK 0xff /end CHARACTERISTIC
/begin COMPU_METHOD gov_gain_aux_cfg_COMPU_VTAB "Verbal Table" TAB_VERB "%.0" "list" COMPU_TAB_REF gov_gain_aux_cfg_COMPU_VTAB_REF /end COMPU_METHOD
/begin COMPU_VTAB gov_gain_aux_cfg_COMPU_VTAB_REF "Verbal Table" TAB_VERB 2 0 "+V = Aux Gains" 1 "GND = Aux Gains" DEFAULT_VALUE "UNKNOWN" /end COMPU_VTAB
/begin CHARACTERISTIC gov_gain_gsln_aux "Gasoline aux input gov gains{gov_gain_gsln_aux&0xff=0:Std - Set 1}{gov_gain_gsln_aux&0xff=1:Alt - Set 1}{gov_gain_gsln_aux&0xff=2:Std - Set 2}{gov_gain_gsln_aux&0xff=3:Alt - Set 2}" VALUE 0x001c904c /* @ECU_Address@gov_gain_gsln_aux@0x01014320@ */ ECIPP_ALIGNMENT_UBYTE 255 gov_gain_gsln_aux_COMPU_VTAB 0 255 BIT_MASK 0xff /end CHARACTERISTIC
/begin COMPU_METHOD gov_gain_gsln_aux_COMPU_VTAB "Verbal Table" TAB_VERB "%.0" "list" COMPU_TAB_REF gov_gain_gsln_aux_COMPU_VTAB_REF /end COMPU_METHOD
/begin COMPU_VTAB gov_gain_gsln_aux_COMPU_VTAB_REF "Verbal Table" TAB_VERB 4 0 "Std - Set 1" 1 "Alt - Set 1" 2 "Std - Set 2" 3 "Alt - Set 2" DEFAULT_VALUE "UNKNOWN" /end COMPU_VTAB
/begin CHARACTERISTIC gov_gain_LPG_aux "LPG aux input gov gains{gov_gain_LPG_aux&0xff=0:Std - Set 1}{gov_gain_LPG_aux&0xff=1:Alt - Set 1}{gov_gain_LPG_aux&0xff=2:Std - Set 2}{gov_gain_LPG_aux&0xff=3:Alt - Set 2}" VALUE 0x001c9042 /* @ECU_Address@gov_gain_LPG_aux@0x01014328@ */ ECIPP_ALIGNMENT_UBYTE 255 gov_gain_LPG_aux_COMPU_VTAB 0 255 BIT_MASK 0xff /end CHARACTERISTIC
/begin COMPU_METHOD gov_gain_LPG_aux_COMPU_VTAB "Verbal Table" TAB_VERB "%.0" "list" COMPU_TAB_REF gov_gain_LPG_aux_COMPU_VTAB_REF /end COMPU_METHOD
/begin COMPU_VTAB gov_gain_LPG_aux_COMPU_VTAB_REF "Verbal Table" TAB_VERB 4 0 "Std - Set 1" 1 "Alt - Set 1" 2 "Std - Set 2" 3 "Alt - Set 2" DEFAULT_VALUE "UNKNOWN" /end COMPU_VTAB
/begin CHARACTERISTIC gov_gain_NG_aux "NG aux input gov gains{gov_gain_NG_aux&0xff=0:Std - Set 1}{gov_gain_NG_aux&0xff=1:Alt - Set 1}{gov_gain_NG_aux&0xff=2:Std - Set 2}{gov_gain_NG_aux&0xff=3:Alt - Set 2}" VALUE 0x001c9046 /* @ECU_Address@gov_gain_NG_aux@0x01014330@ */ ECIPP_ALIGNMENT_UBYTE 255 gov_gain_NG_aux_COMPU_VTAB 0 255 BIT_MASK 0xff /end CHARACTERISTIC
/begin COMPU_METHOD gov_gain_NG_aux_COMPU_VTAB "Verbal Table" TAB_VERB "%.0" "list" COMPU_TAB_REF gov_gain_NG_aux_COMPU_VTAB_REF /end COMPU_METHOD
/begin COMPU_VTAB gov_gain_NG_aux_COMPU_VTAB_REF "Verbal Table" TAB_VERB 4 0 "Std - Set 1" 1 "Alt - Set 1" 2 "Std - Set 2" 3 "Alt - Set 2" DEFAULT_VALUE "UNKNOWN" /end COMPU_VTAB
/begin CHARACTERISTIC gov_gain_gsln_auxdis "Gasoline aux input gov gains discrete{gov_gain_gsln_auxdis&0xff=0:Std - Set 1}{gov_gain_gsln_auxdis&0xff=1:Alt - Set 1}{gov_gain_gsln_auxdis&0xff=2:Std - Set 2}{gov_gain_gsln_auxdis&0xff=3:Alt - Set 2}" VALUE 0x001c904d /* @ECU_Address@gov_gain_gsln_auxdis@0x01014338@ */ ECIPP_ALIGNMENT_UBYTE 255 gov_gain_gsln_auxdis_COMPU_VTAB 0 255 BIT_MASK 0xff /end CHARACTERISTIC
/begin COMPU_METHOD gov_gain_gsln_auxdis_COMPU_VTAB "Verbal Table" TAB_VERB "%.0" "list" COMPU_TAB_REF gov_gain_gsln_auxdis_COMPU_VTAB_REF /end COMPU_METHOD
/begin COMPU_VTAB gov_gain_gsln_auxdis_COMPU_VTAB_REF "Verbal Table" TAB_VERB 4 0 "Std - Set 1" 1 "Alt - Set 1" 2 "Std - Set 2" 3 "Alt - Set 2" DEFAULT_VALUE "UNKNOWN" /end COMPU_VTAB
/begin CHARACTERISTIC gov_gain_LPG_auxdis "LPG aux input gov gains discrete{gov_gain_LPG_auxdis&0xff=0:Std - Set 1}{gov_gain_LPG_auxdis&0xff=1:Alt - Set 1}{gov_gain_LPG_auxdis&0xff=2:Std - Set 2}{gov_gain_LPG_auxdis&0xff=3:Alt - Set 2}" VALUE 0x001c9043 /* @ECU_Address@gov_gain_LPG_auxdis@0x01014340@ */ ECIPP_ALIGNMENT_UBYTE 255 gov_gain_LPG_auxdis_COMPU_VTAB 0 255 BIT_MASK 0xff /end CHARACTERISTIC
/begin COMPU_METHOD gov_gain_LPG_auxdis_COMPU_VTAB "Verbal Table" TAB_VERB "%.0" "list" COMPU_TAB_REF gov_gain_LPG_auxdis_COMPU_VTAB_REF /end COMPU_METHOD
/begin COMPU_VTAB gov_gain_LPG_auxdis_COMPU_VTAB_REF "Verbal Table" TAB_VERB 4 0 "Std - Set 1" 1 "Alt - Set 1" 2 "Std - Set 2" 3 "Alt - Set 2" DEFAULT_VALUE "UNKNOWN" /end COMPU_VTAB
/begin CHARACTERISTIC gov_gain_NG_auxdis "NG aux input gov gains discrete{gov_gain_NG_auxdis&0xff=0:Std - Set 1}{gov_gain_NG_auxdis&0xff=1:Alt - Set 1}{gov_gain_NG_auxdis&0xff=2:Std - Set 2}{gov_gain_NG_auxdis&0xff=3:Alt - Set 2}" VALUE 0x001c9047 /* @ECU_Address@gov_gain_NG_auxdis@0x01014348@ */ ECIPP_ALIGNMENT_UBYTE 255 gov_gain_NG_auxdis_COMPU_VTAB 0 255 BIT_MASK 0xff /end CHARACTERISTIC
/begin COMPU_METHOD gov_gain_NG_auxdis_COMPU_VTAB "Verbal Table" TAB_VERB "%.0" "list" COMPU_TAB_REF gov_gain_NG_auxdis_COMPU_VTAB_REF /end COMPU_METHOD
/begin COMPU_VTAB gov_gain_NG_auxdis_COMPU_VTAB_REF "Verbal Table" TAB_VERB 4 0 "Std - Set 1" 1 "Alt - Set 1" 2 "Std - Set 2" 3 "Alt - Set 2" DEFAULT_VALUE "UNKNOWN" /end COMPU_VTAB
/begin CHARACTERISTIC Gov3_rmt_ff_ena "Gov3 remote feedforward mode{Gov3_rmt_ff_ena&0xff=0:Disabled}{Gov3_rmt_ff_ena&0xff=1:Enabled - SPN 64867}" VALUE 0x001c875e /* @ECU_Address@Gov3_rmt_ff_ena@0x010143E8@ */ ECIPP_ALIGNMENT_UBYTE 255 Gov3_rmt_ff_ena_COMPU_VTAB 0 255 BIT_MASK 0xff /end CHARACTERISTIC
/begin COMPU_METHOD Gov3_rmt_ff_ena_COMPU_VTAB "Verbal Table" TAB_VERB "%.0" "list" COMPU_TAB_REF Gov3_rmt_ff_ena_COMPU_VTAB_REF /end COMPU_METHOD
/begin COMPU_VTAB Gov3_rmt_ff_ena_COMPU_VTAB_REF "Verbal Table" TAB_VERB 2 0 "Disabled" 1 "Enabled - SPN 64867" DEFAULT_VALUE "UNKNOWN" /end COMPU_VTAB
/begin CHARACTERISTIC Gov3_rmt_ff_rpm_min "Gov3 remote feedforward speed min" VALUE 0x001c7bce /* @ECU_Address@Gov3_rmt_ff_rpm_min@0x01014668@ */ ECIPP_ALIGNMENT_UWORD 65535 Compu_Gov3_rmt_ff_rpm_min 0 65535 /end CHARACTERISTIC
/begin COMPU_METHOD Compu_Gov3_rmt_ff_rpm_min " " RAT_FUNC "%.0" "rpm" COEFFS 0 1 0 0 0 1 /end COMPU_METHOD
/begin CHARACTERISTIC Gov3_odz "Gov3 output dead-zone (+/-)" VALUE 0x001c4506 /* @ECU_Address@Gov3_odz@0x010148E8@ */ ECIPP_ALIGNMENT_SWORD 100 Compu_Gov3_odz -100 99.9969482421875 /end CHARACTERISTIC
/begin COMPU_METHOD Compu_Gov3_odz " " RAT_FUNC "%.1" "%" COEFFS 0 327.68 0 0 0 1 /end COMPU_METHOD
/begin CHARACTERISTIC Gov3_odz_wall "Gov3 output dead-zone wall" VALUE 0x001c4508 /* @ECU_Address@Gov3_odz_wall@0x010148F0@ */ ECIPP_ALIGNMENT_SWORD 100 Compu_Gov3_odz_wall -100 99.9969482421875 /end CHARACTERISTIC
/begin COMPU_METHOD Compu_Gov3_odz_wall " " RAT_FUNC "%.1" "%" COEFFS 0 327.68 0 0 0 1 /end COMPU_METHOD
/begin CHARACTERISTIC Gov3_odz_tau "Gov3 output dead-zone tau" VALUE 0x001c854e /* @ECU_Address@Gov3_odz_tau@0x010148F8@ */ ECIPP_ALIGNMENT_UWORD 327680 Compu_Gov3_odz_tau 0.45084 327680 /end CHARACTERISTIC
/begin COMPU_METHOD Compu_Gov3_odz_tau " " FORM "%.0" "ms"
 /begin FORMULA "-5 / log(1 - (X1 / 65536))" FORMULA_INV "(1 - exp(-5/X1)) * 65536" /end FORMULA
/end COMPU_METHOD
/begin CHARACTERISTIC AMTSA_ena "AMT shift assist{AMTSA_ena&0xff=0x00:Disabled}{AMTSA_ena&0xff=0x01:Enabled}" VALUE 0x001c8677 /* @ECU_Address@AMTSA_ena@0x01015020@ */ ECIPP_ALIGNMENT_UBYTE 255 AMTSA_ena_COMPU_VTAB 0 255 BIT_MASK 0xff /end CHARACTERISTIC
/begin COMPU_METHOD AMTSA_ena_COMPU_VTAB "Verbal Table" TAB_VERB "%.0" "list" COMPU_TAB_REF AMTSA_ena_COMPU_VTAB_REF /end COMPU_METHOD
/begin COMPU_VTAB AMTSA_ena_COMPU_VTAB_REF "Verbal Table" TAB_VERB 2 0x00 "Disabled" 0x01 "Enabled" DEFAULT_VALUE "UNKNOWN" /end COMPU_VTAB
/begin CHARACTERISTIC AMTSA_TPSd_filt_ena "AMT shift assist TPSd filtering{AMTSA_TPSd_filt_ena&0xff=0:Disabled}{AMTSA_TPSd_filt_ena&0xff=1:Decrease Only}{AMTSA_TPSd_filt_ena&0xff=2:Increase Only}{AMTSA_TPSd_filt_ena&0xff=3:Both}" VALUE 0x001c8675 /* @ECU_Address@AMTSA_TPSd_filt_ena@0x01015028@ */ ECIPP_ALIGNMENT_UBYTE 255 AMTSA_TPSd_filt_ena_COMPU_VTAB 0 255 BIT_MASK 0xff /end CHARACTERISTIC
/begin COMPU_METHOD AMTSA_TPSd_filt_ena_COMPU_VTAB "Verbal Table" TAB_VERB "%.0" "list" COMPU_TAB_REF AMTSA_TPSd_filt_ena_COMPU_VTAB_REF /end COMPU_METHOD
/begin COMPU_VTAB AMTSA_TPSd_filt_ena_COMPU_VTAB_REF "Verbal Table" TAB_VERB 4 0 "Disabled" 1 "Decrease Only" 2 "Increase Only" 3 "Both" DEFAULT_VALUE "UNKNOWN" /end COMPU_VTAB
/begin MEASUREMENT AMTSA_state "AMT shift assist state{AMTSA_state&0xff=0:Disabled}{AMTSA_state&0xff=1:Gear Not Available}{AMTSA_state&0xff=2:Gear Data Error}{AMTSA_state&0xff=3:Engine Stopped}{AMTSA_state&0xff=4:Park or Neutral}{AMTSA_state&0xff=5:Inactive}{AMTSA_state&0xff=6:Verifying" UBYTE AMTSA_state_COMPU_VTAB 0 0 0 255 ECU_ADDRESS 0x01015030 BIT_MASK 0xff /end MEASUREMENT
/begin COMPU_METHOD AMTSA_state_COMPU_VTAB "Verbal Table" TAB_VERB "%.0" "list" COMPU_TAB_REF AMTSA_state_COMPU_VTAB_REF /end COMPU_METHOD
/begin COMPU_VTAB AMTSA_state_COMPU_VTAB_REF "Verbal Table" TAB_VERB 13 0 "Disabled" 1 "Gear Not Available" 2 "Gear Data Error" 3 "Engine Stopped" 4 "Park or Neutral" 5 "Inactive" 6 "Verifying Shift" 7 "Verifying Shift Wait" 8 "Decreasing Torque" 9 "Speed Sync Wait" 10 "Syncing Speed" 11 "Torque Increase Wait" 12 "Increasing Torque" DEFAULT_VALUE "UNKNOWN" /end COMPU_VTAB
/begin CHARACTERISTIC AMTSA_minnom_ena "AMT shift assist EGR min/nom{AMTSA_minnom_ena&0xff=0x00:Disabled}{AMTSA_minnom_ena&0xff=0x01:Enabled}" VALUE 0x001c8678 /* @ECU_Address@AMTSA_minnom_ena@0x01015038@ */ ECIPP_ALIGNMENT_UBYTE 255 AMTSA_minnom_ena_COMPU_VTAB 0 255 BIT_MASK 0xff /end CHARACTERISTIC
/begin COMPU_METHOD AMTSA_minnom_ena_COMPU_VTAB "Verbal Table" TAB_VERB "%.0" "list" COMPU_TAB_REF AMTSA_minnom_ena_COMPU_VTAB_REF /end COMPU_METHOD
/begin COMPU_VTAB AMTSA_minnom_ena_COMPU_VTAB_REF "Verbal Table" TAB_VERB 2 0x00 "Disabled" 0x01 "Enabled" DEFAULT_VALUE "UNKNOWN" /end COMPU_VTAB
/begin CHARACTERISTIC AMTSA_minnom_time "AMT shift assist EGR min/nom slew time" VALUE 0x001c6d62 /* @ECU_Address@AMTSA_minnom_time@0x01015040@ */ ECIPP_ALIGNMENT_UWORD 65535 Compu_AMTSA_minnom_time 0 65535 /end CHARACTERISTIC
/begin COMPU_METHOD Compu_AMTSA_minnom_time " " RAT_FUNC "%.0" "ms" COEFFS 0 1 0 0 0 1 /end COMPU_METHOD
/begin MEASUREMENT AMT_torq_lmt "AMT torque limit" SWORD Compu_AMT_torq_lmt 0 0 -200 199.993896484375 ECU_ADDRESS 0x01015050 /end MEASUREMENT
/begin COMPU_METHOD Compu_AMT_torq_lmt " " RAT_FUNC "%.1" "% of ref" COEFFS 0 163.84 0 0 0 1 /end COMPU_METHOD
/begin MEASUREMENT AMT_output_speed "AMT output shaft speed" UWORD Compu_AMT_output_speed 0 0 0 8191.875 ECU_ADDRESS 0x01015058 /end MEASUREMENT
/begin COMPU_METHOD Compu_AMT_output_speed " " RAT_FUNC "%.0" "rpm" COEFFS 0 8 0 0 0 1 /end COMPU_METHOD
/begin MEASUREMENT AMT_input_speed "AMT input shaft speed" UWORD Compu_AMT_input_speed 0 0 0 8191.875 ECU_ADDRESS 0x01015060 /end MEASUREMENT
/begin COMPU_METHOD Compu_AMT_input_speed " " RAT_FUNC "%.0" "rpm" COEFFS 0 8 0 0 0 1 /end COMPU_METHOD
/begin MEASUREMENT AMT_shift_in_process "AMT shift in process{AMT_shift_in_process&0x30=0x00:No}{AMT_shift_in_process&0x30=0x10:Yes}{AMT_shift_in_process&0x30=0x20:Error}{AMT_shift_in_process&0x30=0x30:Not Available}" UBYTE AMT_shift_in_process_COMPU_VTAB 0 0 0 255 ECU_ADDRESS 0x01015078 BIT_MASK 0x30 /end MEASUREMENT
/begin COMPU_METHOD AMT_shift_in_process_COMPU_VTAB "Verbal Table" TAB_VERB "%.0" "list" COMPU_TAB_REF AMT_shift_in_process_COMPU_VTAB_REF /end COMPU_METHOD
/begin COMPU_VTAB AMT_shift_in_process_COMPU_VTAB_REF "Verbal Table" TAB_VERB 4 0x00 "No" 0x10 "Yes" 0x20 "Error" 0x30 "Not Available" DEFAULT_VALUE "UNKNOWN" /end COMPU_VTAB
/begin CHARACTERISTIC AMTSA_dec_torq_est "Decreasing torque estimate correction" VALUE 0x001c6d60 /* @ECU_Address@AMTSA_dec_torq_est@0x01015080@ */ ECIPP_ALIGNMENT_UWORD 200 Compu_AMTSA_dec_torq_est 0 199.996948242188 /end CHARACTERISTIC
/begin COMPU_METHOD Compu_AMTSA_dec_torq_est " " RAT_FUNC "%.1" "%" COEFFS 0 327.68 0 0 0 1 /end COMPU_METHOD
/begin CHARACTERISTIC AMTSA_WGPd_ena "AMT shift assist WGPd limiting{AMTSA_WGPd_ena&0xff=0x00:Disabled}{AMTSA_WGPd_ena&0xff=0x01:Enabled}" VALUE 0x001c8676 /* @ECU_Address@AMTSA_WGPd_ena@0x01015088@ */ ECIPP_ALIGNMENT_UBYTE 255 AMTSA_WGPd_ena_COMPU_VTAB 0 255 BIT_MASK 0xff /end CHARACTERISTIC
/begin COMPU_METHOD AMTSA_WGPd_ena_COMPU_VTAB "Verbal Table" TAB_VERB "%.0" "list" COMPU_TAB_REF AMTSA_WGPd_ena_COMPU_VTAB_REF /end COMPU_METHOD
/begin COMPU_VTAB AMTSA_WGPd_ena_COMPU_VTAB_REF "Verbal Table" TAB_VERB 2 0x00 "Disabled" 0x01 "Enabled" DEFAULT_VALUE "UNKNOWN" /end COMPU_VTAB
/begin CHARACTERISTIC TransNeut_ETC2_mode "Trans in-neutral from ETC2{TransNeut_ETC2_mode&0xff=0:Use neutral safety switch config}{TransNeut_ETC2_mode&0xff=1:Sometimes (Legacy)}" VALUE 0x001c8f6f /* @ECU_Address@TransNeut_ETC2_mode@0x010154E8@ */ ECIPP_ALIGNMENT_UBYTE 255 TransNeut_ETC2_mode_COMPU_VTAB 0 255 BIT_MASK 0xff /end CHARACTERISTIC
/begin COMPU_METHOD TransNeut_ETC2_mode_COMPU_VTAB "Verbal Table" TAB_VERB "%.0" "list" COMPU_TAB_REF TransNeut_ETC2_mode_COMPU_VTAB_REF /end COMPU_METHOD
/begin COMPU_VTAB TransNeut_ETC2_mode_COMPU_VTAB_REF "Verbal Table" TAB_VERB 2 0 "Use neutral safety switch config" 1 "Sometimes (Legacy)" DEFAULT_VALUE "UNKNOWN" /end COMPU_VTAB
/begin CHARACTERISTIC gov_switchover_time "Governor switchover response time{gov_switchover_time&0xff=0:50 ms (Legacy)}{gov_switchover_time&0xff=1:5 ms}" VALUE 0x001c9052 /* @ECU_Address@gov_switchover_time@0x01015510@ */ ECIPP_ALIGNMENT_UBYTE 255 gov_switchover_time_COMPU_VTAB 0 255 BIT_MASK 0xff /end CHARACTERISTIC
/begin COMPU_METHOD gov_switchover_time_COMPU_VTAB "Verbal Table" TAB_VERB "%.0" "list" COMPU_TAB_REF gov_switchover_time_COMPU_VTAB_REF /end COMPU_METHOD
/begin COMPU_VTAB gov_switchover_time_COMPU_VTAB_REF "Verbal Table" TAB_VERB 2 0 "50 ms (Legacy)" 1 "5 ms" DEFAULT_VALUE "UNKNOWN" /end COMPU_VTAB
/begin COMPU_METHOD Compu_TIdle_ECT_ECT " " RAT_FUNC "%.0" "ECT (deg F)" COEFFS 0 32 14720 0 0 1 /end COMPU_METHOD
/begin CHARACTERISTIC TIdle_ECT_rpm "Idle Speed Schedule" CURVE 0x001C520C /* @ECU_Address@TIdle_ECT_rpm@0x02042000@ */ ECIPP_ALIGNMENT_SWORD 32767 Compu_TIdle_ECT_rpm -32768 32767
 /begin AXIS_DESCR COM_AXIS NO_INPUT_QUANTITY Compu_TIdle_ECT_ECT 4 -1484 563.96875 AXIS_PTS_REF TIdle_ECT_ECT /end AXIS_DESCR
/end CHARACTERISTIC
/begin AXIS_PTS TIdle_ECT_ECT " " 0x001C5204 /* @ECU_Address@TIdle_ECT_ECT@0x02041000@ */ NO_INPUT_QUANTITY ECIPP_Lookup_SWORD 0 Compu_TIdle_ECT_ECT 4 -1484 563.96875 /end AXIS_PTS
/begin COMPU_METHOD Compu_TIdle_ECT_rpm " " RAT_FUNC "%.0" "Idle (rpm)" COEFFS 0 1 0 0 0 1 /end COMPU_METHOD
/begin COMPU_METHOD Compu_TspdK_rpm_rpm " " RAT_FUNC "%.0" "Speed (rpm)" COEFFS 0 1 0 0 0 1 /end COMPU_METHOD
/begin CHARACTERISTIC TspdK_rpm_Kp "Isochronous Speed Gains" CURVE 0x001C688C /* @ECU_Address@TspdK_rpm_Kp@0x02044000@ */ ECIPP_ALIGNMENT_SWORD 3125 Compu_TspdK_rpm_Kp -3125 3124.90463256836
 /begin AXIS_DESCR COM_AXIS NO_INPUT_QUANTITY Compu_TspdK_rpm_rpm 4 -32768 32767 AXIS_PTS_REF TspdK_rpm_rpm /end AXIS_DESCR
/end CHARACTERISTIC
/begin AXIS_PTS TspdK_rpm_rpm " " 0x001C68AC /* @ECU_Address@TspdK_rpm_rpm@0x02043000@ */ NO_INPUT_QUANTITY ECIPP_Lookup_SWORD 0 Compu_TspdK_rpm_rpm 4 -32768 32767 /end AXIS_PTS
/begin COMPU_METHOD Compu_TspdK_rpm_Kp " " RAT_FUNC "%.1" "Kp rpm (%/krpm)" COEFFS 0 10.48576 0 0 0 1 /end COMPU_METHOD
/begin CHARACTERISTIC TspdK_rpm_Kd "Isochronous Speed Gains" CURVE 0x001C6874 /* @ECU_Address@TspdK_rpm_Kd@0x02045000@ */ ECIPP_ALIGNMENT_SWORD 1600 Compu_TspdK_rpm_Kd -1600 1599.951171875
 /begin AXIS_DESCR COM_AXIS NO_INPUT_QUANTITY Compu_TspdK_rpm_rpm 4 -32768 32767 AXIS_PTS_REF TspdK_rpm_rpm /end AXIS_DESCR
/end CHARACTERISTIC
/begin COMPU_METHOD Compu_TspdK_rpm_Kd " " RAT_FUNC "%.2" "Kd rpm (%/(krpm/s))" COEFFS 0 20.48 0 0 0 1 /end COMPU_METHOD
/begin CHARACTERISTIC TspdK_rpm_KMAPdt "Isochronous Speed Gains" CURVE 0x001C6864 /* @ECU_Address@TspdK_rpm_KMAPdt@0x02046000@ */ ECIPP_ALIGNMENT_SWORD 1000 Compu_TspdK_rpm_KMAPdt -1000 999.969482421875
 /begin AXIS_DESCR COM_AXIS NO_INPUT_QUANTITY Compu_TspdK_rpm_rpm 4 -32768 32767 AXIS_PTS_REF TspdK_rpm_rpm /end AXIS_DESCR
/end CHARACTERISTIC
/begin COMPU_METHOD Compu_TspdK_rpm_KMAPdt " " RAT_FUNC "%.1" "K dMAPdt (1/sec)" COEFFS 0 32.768 0 0 0 1 /end COMPU_METHOD
/begin COMPU_METHOD Compu_TspdK_ECT_ECT " " RAT_FUNC "%.0" "ECT (deg F)" COEFFS 0 32 14720 0 0 1 /end COMPU_METHOD
/begin CHARACTERISTIC TspdK_ECT_Kpm "Governor Gain Corrections" CURVE 0x001C684C /* @ECU_Address@TspdK_ECT_Kpm@0x02048000@ */ ECIPP_ALIGNMENT_SWORD 8 Compu_TspdK_ECT_Kpm -8 7.999755859375
 /begin AXIS_DESCR COM_AXIS NO_INPUT_QUANTITY Compu_TspdK_ECT_ECT 4 -1484 563.96875 AXIS_PTS_REF TspdK_ECT_ECT /end AXIS_DESCR
/end CHARACTERISTIC
/begin AXIS_PTS TspdK_ECT_ECT " " 0x001C681C /* @ECU_Address@TspdK_ECT_ECT@0x02047000@ */ NO_INPUT_QUANTITY ECIPP_Lookup_SWORD 0 Compu_TspdK_ECT_ECT 4 -1484 563.96875 /end AXIS_PTS
/begin COMPU_METHOD Compu_TspdK_ECT_Kpm " " RAT_FUNC "%.3" "Kp Multiplier" COEFFS 0 4096 0 0 0 1 /end COMPU_METHOD
/begin CHARACTERISTIC TspdK_rpm_Ki "Isochronous Speed Gains" CURVE 0x001C687C /* @ECU_Address@TspdK_rpm_Ki@0x02073000@ */ ECIPP_ALIGNMENT_SWORD 12207 Compu_TspdK_rpm_Ki -12207.03125 12206.6587209702
 /begin AXIS_DESCR COM_AXIS NO_INPUT_QUANTITY Compu_TspdK_rpm_rpm 4 -32768 32767 AXIS_PTS_REF TspdK_rpm_rpm /end AXIS_DESCR
/end CHARACTERISTIC
/begin COMPU_METHOD Compu_TspdK_rpm_Ki " " RAT_FUNC "%.1" "Ki rpm (%/krpm/s)" COEFFS 0 2.68435456 0 0 0 1 /end COMPU_METHOD
/begin CHARACTERISTIC TspdK_rpm_KMdtfb "Isochronous Speed Gains" CURVE 0x001C686C /* @ECU_Address@TspdK_rpm_KMdtfb@0x0207E000@ */ ECIPP_ALIGNMENT_SWORD 32 Compu_TspdK_rpm_KMdtfb -32 31.9990234375
 /begin AXIS_DESCR COM_AXIS NO_INPUT_QUANTITY Compu_TspdK_rpm_rpm 4 -32768 32767 AXIS_PTS_REF TspdK_rpm_rpm /end AXIS_DESCR
/end CHARACTERISTIC
/begin COMPU_METHOD Compu_TspdK_rpm_KMdtfb " " RAT_FUNC "%.3" "K dMAPdt FB (fraction)" COEFFS 0 1024 0 0 0 1 /end COMPU_METHOD
/begin CHARACTERISTIC TspdK_rpm_dzKp "Isochronous Speed Gains" CURVE 0x001C68A4 /* @ECU_Address@TspdK_rpm_dzKp@0x0207F000@ */ ECIPP_ALIGNMENT_SWORD 32767 Compu_TspdK_rpm_dzKp -32768 32767
 /begin AXIS_DESCR COM_AXIS NO_INPUT_QUANTITY Compu_TspdK_rpm_rpm 4 -32768 32767 AXIS_PTS_REF TspdK_rpm_rpm /end AXIS_DESCR
/end CHARACTERISTIC
/begin COMPU_METHOD Compu_TspdK_rpm_dzKp " " RAT_FUNC "%.0" "dead-zone (rpm)" COEFFS 0 1 0 0 0 1 /end COMPU_METHOD
/begin CHARACTERISTIC TspdK_rpm_dzKi "Isochronous Speed Gains" CURVE 0x001C689C /* @ECU_Address@TspdK_rpm_dzKi@0x02080000@ */ ECIPP_ALIGNMENT_SWORD 32767 Compu_TspdK_rpm_dzKi -32768 32767
 /begin AXIS_DESCR COM_AXIS NO_INPUT_QUANTITY Compu_TspdK_rpm_rpm 4 -32768 32767 AXIS_PTS_REF TspdK_rpm_rpm /end AXIS_DESCR
/end CHARACTERISTIC
/begin COMPU_METHOD Compu_TspdK_rpm_dzKi " " RAT_FUNC "%.0" "dead-zone (rpm)" COEFFS 0 1 0 0 0 1 /end COMPU_METHOD
/begin CHARACTERISTIC TspdK_rpm_dzKd "Isochronous Speed Gains" CURVE 0x001C6894 /* @ECU_Address@TspdK_rpm_dzKd@0x02081000@ */ ECIPP_ALIGNMENT_SWORD 63998 Compu_TspdK_rpm_dzKd -64000 63998.046875
 /begin AXIS_DESCR COM_AXIS NO_INPUT_QUANTITY Compu_TspdK_rpm_rpm 4 -32768 32767 AXIS_PTS_REF TspdK_rpm_rpm /end AXIS_DESCR
/end CHARACTERISTIC
/begin COMPU_METHOD Compu_TspdK_rpm_dzKd " " RAT_FUNC "%.0" "dead-zone (rpm/sec)" COEFFS 0 0.512 0 0 0 1 /end COMPU_METHOD
/begin CHARACTERISTIC TspdK_rpm_Ifrz "Isochronous Speed Gains" CURVE 0x001C685C /* @ECU_Address@TspdK_rpm_Ifrz@0x02082000@ */ ECIPP_ALIGNMENT_SWORD 63998 Compu_TspdK_rpm_Ifrz -64000 63998.046875
 /begin AXIS_DESCR COM_AXIS NO_INPUT_QUANTITY Compu_TspdK_rpm_rpm 4 -32768 32767 AXIS_PTS_REF TspdK_rpm_rpm /end AXIS_DESCR
/end CHARACTERISTIC
/begin COMPU_METHOD Compu_TspdK_rpm_Ifrz " " RAT_FUNC "%.0" "freeze (rpm/sec)" COEFFS 0 0.512 0 0 0 1 /end COMPU_METHOD
/begin COMPU_METHOD Compu_TdrpK_rpm_rpm " " RAT_FUNC "%.0" "Speed (rpm)" COEFFS 0 1 0 0 0 1 /end COMPU_METHOD
/begin CHARACTERISTIC TdrpK_rpm_Kp "Droop Speed Gains" CURVE 0x001C6458 /* @ECU_Address@TdrpK_rpm_Kp@0x02084000@ */ ECIPP_ALIGNMENT_SWORD 3125 Compu_TdrpK_rpm_Kp -3125 3124.90463256836
 /begin AXIS_DESCR COM_AXIS NO_INPUT_QUANTITY Compu_TdrpK_rpm_rpm 4 -32768 32767 AXIS_PTS_REF TdrpK_rpm_rpm /end AXIS_DESCR
/end CHARACTERISTIC
/begin AXIS_PTS TdrpK_rpm_rpm " " 0x001C6478 /* @ECU_Address@TdrpK_rpm_rpm@0x02083000@ */ NO_INPUT_QUANTITY ECIPP_Lookup_SWORD 0 Compu_TdrpK_rpm_rpm 4 -32768 32767 /end AXIS_PTS
/begin COMPU_METHOD Compu_TdrpK_rpm_Kp " " RAT_FUNC "%.1" "Kp rpm (%/krpm)" COEFFS 0 10.48576 0 0 0 1 /end COMPU_METHOD
/begin CHARACTERISTIC TdrpK_rpm_Kd "Droop Speed Gains" CURVE 0x001C6440 /* @ECU_Address@TdrpK_rpm_Kd@0x02085000@ */ ECIPP_ALIGNMENT_SWORD 1600 Compu_TdrpK_rpm_Kd -1600 1599.951171875
 /begin AXIS_DESCR COM_AXIS NO_INPUT_QUANTITY Compu_TdrpK_rpm_rpm 4 -32768 32767 AXIS_PTS_REF TdrpK_rpm_rpm /end AXIS_DESCR
/end CHARACTERISTIC
/begin COMPU_METHOD Compu_TdrpK_rpm_Kd " " RAT_FUNC "%.2" "Kd rpm (%/(krpm/s))" COEFFS 0 20.48 0 0 0 1 /end COMPU_METHOD
/begin CHARACTERISTIC TdrpK_rpm_Ki "Droop Speed Gains" CURVE 0x001C6448 /* @ECU_Address@TdrpK_rpm_Ki@0x02086000@ */ ECIPP_ALIGNMENT_SWORD 12207 Compu_TdrpK_rpm_Ki -12207.03125 12206.6587209702
 /begin AXIS_DESCR COM_AXIS NO_INPUT_QUANTITY Compu_TdrpK_rpm_rpm 4 -32768 32767 AXIS_PTS_REF TdrpK_rpm_rpm /end AXIS_DESCR
/end CHARACTERISTIC
/begin COMPU_METHOD Compu_TdrpK_rpm_Ki " " RAT_FUNC "%.1" "Ki rpm (%/krpm/s)" COEFFS 0 2.68435456 0 0 0 1 /end COMPU_METHOD
/begin CHARACTERISTIC TdrpK_rpm_KMAPdt "Droop Speed Gains" CURVE 0x001C6430 /* @ECU_Address@TdrpK_rpm_KMAPdt@0x02087000@ */ ECIPP_ALIGNMENT_SWORD 1000 Compu_TdrpK_rpm_KMAPdt -1000 999.969482421875
 /begin AXIS_DESCR COM_AXIS NO_INPUT_QUANTITY Compu_TdrpK_rpm_rpm 4 -32768 32767 AXIS_PTS_REF TdrpK_rpm_rpm /end AXIS_DESCR
/end CHARACTERISTIC
/begin COMPU_METHOD Compu_TdrpK_rpm_KMAPdt " " RAT_FUNC "%.1" "K dMAPdt (1/sec)" COEFFS 0 32.768 0 0 0 1 /end COMPU_METHOD
/begin CHARACTERISTIC TdrpK_rpm_KMdtfb "Droop Speed Gains" CURVE 0x001C6438 /* @ECU_Address@TdrpK_rpm_KMdtfb@0x02088000@ */ ECIPP_ALIGNMENT_SWORD 32 Compu_TdrpK_rpm_KMdtfb -32 31.9990234375
 /begin AXIS_DESCR COM_AXIS NO_INPUT_QUANTITY Compu_TdrpK_rpm_rpm 4 -32768 32767 AXIS_PTS_REF TdrpK_rpm_rpm /end AXIS_DESCR
/end CHARACTERISTIC
/begin COMPU_METHOD Compu_TdrpK_rpm_KMdtfb " " RAT_FUNC "%.3" "K dMAPdt FB (fraction)" COEFFS 0 1024 0 0 0 1 /end COMPU_METHOD
/begin CHARACTERISTIC TdrpK_rpm_dzKp "Droop Speed Gains" CURVE 0x001C6470 /* @ECU_Address@TdrpK_rpm_dzKp@0x02089000@ */ ECIPP_ALIGNMENT_SWORD 32767 Compu_TdrpK_rpm_dzKp -32768 32767
 /begin AXIS_DESCR COM_AXIS NO_INPUT_QUANTITY Compu_TdrpK_rpm_rpm 4 -32768 32767 AXIS_PTS_REF TdrpK_rpm_rpm /end AXIS_DESCR
/end CHARACTERISTIC
/begin COMPU_METHOD Compu_TdrpK_rpm_dzKp " " RAT_FUNC "%.0" "dead-zone (rpm)" COEFFS 0 1 0 0 0 1 /end COMPU_METHOD
/begin CHARACTERISTIC TdrpK_rpm_dzKi "Droop Speed Gains" CURVE 0x001C6468 /* @ECU_Address@TdrpK_rpm_dzKi@0x0208A000@ */ ECIPP_ALIGNMENT_SWORD 32767 Compu_TdrpK_rpm_dzKi -32768 32767
 /begin AXIS_DESCR COM_AXIS NO_INPUT_QUANTITY Compu_TdrpK_rpm_rpm 4 -32768 32767 AXIS_PTS_REF TdrpK_rpm_rpm /end AXIS_DESCR
/end CHARACTERISTIC
/begin COMPU_METHOD Compu_TdrpK_rpm_dzKi " " RAT_FUNC "%.0" "dead-zone (rpm)" COEFFS 0 1 0 0 0 1 /end COMPU_METHOD
/begin CHARACTERISTIC TdrpK_rpm_dzKd "Droop Speed Gains" CURVE 0x001C6460 /* @ECU_Address@TdrpK_rpm_dzKd@0x0208B000@ */ ECIPP_ALIGNMENT_SWORD 63998 Compu_TdrpK_rpm_dzKd -64000 63998.046875
 /begin AXIS_DESCR COM_AXIS NO_INPUT_QUANTITY Compu_TdrpK_rpm_rpm 4 -32768 32767 AXIS_PTS_REF TdrpK_rpm_rpm /end AXIS_DESCR
/end CHARACTERISTIC
/begin COMPU_METHOD Compu_TdrpK_rpm_dzKd " " RAT_FUNC "%.0" "dead-zone (rpm/sec)" COEFFS 0 0.512 0 0 0 1 /end COMPU_METHOD
/begin CHARACTERISTIC TdrpK_rpm_Ifrz "Droop Speed Gains" CURVE 0x001C6428 /* @ECU_Address@TdrpK_rpm_Ifrz@0x0208C000@ */ ECIPP_ALIGNMENT_SWORD 63998 Compu_TdrpK_rpm_Ifrz -64000 63998.046875
 /begin AXIS_DESCR COM_AXIS NO_INPUT_QUANTITY Compu_TdrpK_rpm_rpm 4 -32768 32767 AXIS_PTS_REF TdrpK_rpm_rpm /end AXIS_DESCR
/end CHARACTERISTIC
/begin COMPU_METHOD Compu_TdrpK_rpm_Ifrz " " RAT_FUNC "%.0" "freeze (rpm/sec)" COEFFS 0 0.512 0 0 0 1 /end COMPU_METHOD
/begin CHARACTERISTIC TspdK_ECT_Kim "Governor Gain Corrections" CURVE 0x001C683C /* @ECU_Address@TspdK_ECT_Kim@0x0208D000@ */ ECIPP_ALIGNMENT_SWORD 8 Compu_TspdK_ECT_Kim -8 7.999755859375
 /begin AXIS_DESCR COM_AXIS NO_INPUT_QUANTITY Compu_TspdK_ECT_ECT 4 -1484 563.96875 AXIS_PTS_REF TspdK_ECT_ECT /end AXIS_DESCR
/end CHARACTERISTIC
/begin COMPU_METHOD Compu_TspdK_ECT_Kim " " RAT_FUNC "%.3" "Ki Multiplier" COEFFS 0 4096 0 0 0 1 /end COMPU_METHOD
/begin CHARACTERISTIC TspdK_ECT_Kdm "Governor Gain Corrections" CURVE 0x001C6834 /* @ECU_Address@TspdK_ECT_Kdm@0x0208E000@ */ ECIPP_ALIGNMENT_SWORD 8 Compu_TspdK_ECT_Kdm -8 7.999755859375
 /begin AXIS_DESCR COM_AXIS NO_INPUT_QUANTITY Compu_TspdK_ECT_ECT 4 -1484 563.96875 AXIS_PTS_REF TspdK_ECT_ECT /end AXIS_DESCR
/end CHARACTERISTIC
/begin COMPU_METHOD Compu_TspdK_ECT_Kdm " " RAT_FUNC "%.3" "Kd Multiplier" COEFFS 0 4096 0 0 0 1 /end COMPU_METHOD
/begin CHARACTERISTIC TspdK_ECT_KMdm "Governor Gain Corrections" CURVE 0x001C6824 /* @ECU_Address@TspdK_ECT_KMdm@0x0208F000@ */ ECIPP_ALIGNMENT_SWORD 8 Compu_TspdK_ECT_KMdm -8 7.999755859375
 /begin AXIS_DESCR COM_AXIS NO_INPUT_QUANTITY Compu_TspdK_ECT_ECT 4 -1484 563.96875 AXIS_PTS_REF TspdK_ECT_ECT /end AXIS_DESCR
/end CHARACTERISTIC
/begin COMPU_METHOD Compu_TspdK_ECT_KMdm " " RAT_FUNC "%.3" "KMAPdt Multiplier" COEFFS 0 4096 0 0 0 1 /end COMPU_METHOD
/begin CHARACTERISTIC TspdK_ECT_KMfm "Governor Gain Corrections" CURVE 0x001C682C /* @ECU_Address@TspdK_ECT_KMfm@0x02090000@ */ ECIPP_ALIGNMENT_SWORD 8 Compu_TspdK_ECT_KMfm -8 7.999755859375
 /begin AXIS_DESCR COM_AXIS NO_INPUT_QUANTITY Compu_TspdK_ECT_ECT 4 -1484 563.96875 AXIS_PTS_REF TspdK_ECT_ECT /end AXIS_DESCR
/end CHARACTERISTIC
/begin COMPU_METHOD Compu_TspdK_ECT_KMfm " " RAT_FUNC "%.3" "KMAPdt FB Multiplier" COEFFS 0 4096 0 0 0 1 /end COMPU_METHOD
/begin CHARACTERISTIC TspdK_ECT_nomld "Governor Gain Corrections" CURVE 0x001C6854 /* @ECU_Address@TspdK_ECT_nomld@0x02091000@ */ ECIPP_ALIGNMENT_SWORD 800 Compu_TspdK_ECT_nomld -800 799.9755859375
 /begin AXIS_DESCR COM_AXIS NO_INPUT_QUANTITY Compu_TspdK_ECT_ECT 4 -1484 563.96875 AXIS_PTS_REF TspdK_ECT_ECT /end AXIS_DESCR
/end CHARACTERISTIC
/begin COMPU_METHOD Compu_TspdK_ECT_nomld " " RAT_FUNC "%.1" "Nominal Load (% adder)" COEFFS 0 40.96 0 0 0 1 /end COMPU_METHOD
/begin CHARACTERISTIC TspdK_rpm_Kiv "Isochronous Speed Gains" CURVE 0x001C6884 /* @ECU_Address@TspdK_rpm_Kiv@0x020ED000@ */ ECIPP_ALIGNMENT_SWORD 6250 Compu_TspdK_rpm_Kiv -6250 6249.80926513672
 /begin AXIS_DESCR COM_AXIS NO_INPUT_QUANTITY Compu_TspdK_rpm_rpm 4 -32768 32767 AXIS_PTS_REF TspdK_rpm_rpm /end AXIS_DESCR
/end CHARACTERISTIC
/begin COMPU_METHOD Compu_TspdK_rpm_Kiv " " RAT_FUNC "%.1" "Kiv rpm (%/krpm)" COEFFS 0 5.24288 0 0 0 1 /end COMPU_METHOD
/begin CHARACTERISTIC TdrpK_rpm_Kiv "Droop Speed Gains" CURVE 0x001C6450 /* @ECU_Address@TdrpK_rpm_Kiv@0x020EE000@ */ ECIPP_ALIGNMENT_SWORD 6250 Compu_TdrpK_rpm_Kiv -6250 6249.80926513672
 /begin AXIS_DESCR COM_AXIS NO_INPUT_QUANTITY Compu_TdrpK_rpm_rpm 4 -32768 32767 AXIS_PTS_REF TdrpK_rpm_rpm /end AXIS_DESCR
/end CHARACTERISTIC
/begin COMPU_METHOD Compu_TdrpK_rpm_Kiv " " RAT_FUNC "%.1" "Kiv rpm (%/krpm)" COEFFS 0 5.24288 0 0 0 1 /end COMPU_METHOD
/begin CHARACTERISTIC TspdK_ECT_Kivm "Governor Gain Corrections" CURVE 0x001C6844 /* @ECU_Address@TspdK_ECT_Kivm@0x020F1000@ */ ECIPP_ALIGNMENT_SWORD 8 Compu_TspdK_ECT_Kivm -8 7.999755859375
 /begin AXIS_DESCR COM_AXIS NO_INPUT_QUANTITY Compu_TspdK_ECT_ECT 4 -1484 563.96875 AXIS_PTS_REF TspdK_ECT_ECT /end AXIS_DESCR
/end CHARACTERISTIC
/begin COMPU_METHOD Compu_TspdK_ECT_Kivm " " RAT_FUNC "%.3" "Kiv Multiplier" COEFFS 0 4096 0 0 0 1 /end COMPU_METHOD
/begin COMPU_METHOD Compu_TStrtIdle_ECT_ECT " " RAT_FUNC "%.0" "ECT (deg F)" COEFFS 0 32 14720 0 0 1 /end COMPU_METHOD
/begin CHARACTERISTIC TStrtIdle_ECT_ini "Starting Initial Speed" CURVE 0x001C59BA /* @ECU_Address@TStrtIdle_ECT_ini@0x02133000@ */ ECIPP_ALIGNMENT_SWORD 32767 Compu_TStrtIdle_ECT_ini -32768 32767
 /begin AXIS_DESCR COM_AXIS NO_INPUT_QUANTITY Compu_TStrtIdle_ECT_ECT 4 -1484 563.96875 AXIS_PTS_REF TStrtIdle_ECT_ECT /end AXIS_DESCR
/end CHARACTERISTIC
/begin AXIS_PTS TStrtIdle_ECT_ECT " " 0x001C59A2 /* @ECU_Address@TStrtIdle_ECT_ECT@0x02132000@ */ NO_INPUT_QUANTITY ECIPP_Lookup_SWORD 0 Compu_TStrtIdle_ECT_ECT 4 -1484 563.96875 /end AXIS_PTS
/begin COMPU_METHOD Compu_TStrtIdle_ECT_ini " " RAT_FUNC "%.0" "Initial Speed (rpm)" COEFFS 0 1 0 0 0 1 /end COMPU_METHOD
/begin CHARACTERISTIC TStrtIdle_ECT_hld "Starting Initial Speed Hold" CURVE 0x001C59B2 /* @ECU_Address@TStrtIdle_ECT_hld@0x02134000@ */ ECIPP_ALIGNMENT_SWORD 33 Compu_TStrtIdle_ECT_hld -32.768 32.767
 /begin AXIS_DESCR COM_AXIS NO_INPUT_QUANTITY Compu_TStrtIdle_ECT_ECT 4 -1484 563.96875 AXIS_PTS_REF TStrtIdle_ECT_ECT /end AXIS_DESCR
/end CHARACTERISTIC
/begin COMPU_METHOD Compu_TStrtIdle_ECT_hld " " RAT_FUNC "%.3" "Hold Time (sec)" COEFFS 0 1000 0 0 0 1 /end COMPU_METHOD
/begin CHARACTERISTIC TStrtIdle_ECT_dcy "Starting Initial Speed Ramp" CURVE 0x001C59AA /* @ECU_Address@TStrtIdle_ECT_dcy@0x02135000@ */ ECIPP_ALIGNMENT_SWORD 1000 Compu_TStrtIdle_ECT_dcy -1000 999.969482421875
 /begin AXIS_DESCR COM_AXIS NO_INPUT_QUANTITY Compu_TStrtIdle_ECT_ECT 4 -1484 563.96875 AXIS_PTS_REF TStrtIdle_ECT_ECT /end AXIS_DESCR
/end CHARACTERISTIC
/begin COMPU_METHOD Compu_TStrtIdle_ECT_dcy " " RAT_FUNC "%.0" "Ramp Rate (rpm/sec)" COEFFS 0 32.768 0 0 0 1 /end COMPU_METHOD
/begin COMPU_METHOD Compu_TspdK_rs_rs " " RAT_FUNC "%.0" "Speed (kph)" COEFFS 0 128 0 0 0 1 /end COMPU_METHOD
/begin CHARACTERISTIC TspdK_rs_Kpm "Governor Roadspeed Multipliers" CURVE 0x001C6914 /* @ECU_Address@TspdK_rs_Kpm@0x02372000@ */ ECIPP_ALIGNMENT_SWORD 8 Compu_TspdK_rs_Kpm -8 7.999755859375
 /begin AXIS_DESCR COM_AXIS NO_INPUT_QUANTITY Compu_TspdK_rs_rs 8 -256 255.9921875 AXIS_PTS_REF TspdK_rs_rs /end AXIS_DESCR
/end CHARACTERISTIC
/begin AXIS_PTS TspdK_rs_rs " " 0x001C6954 /* @ECU_Address@TspdK_rs_rs@0x02371000@ */ NO_INPUT_QUANTITY ECIPP_Lookup_SWORD 0 Compu_TspdK_rs_rs 8 -256 255.9921875 /end AXIS_PTS
/begin COMPU_METHOD Compu_TspdK_rs_Kpm " " RAT_FUNC "%.3" "Kp Multiplier" COEFFS 0 4096 0 0 0 1 /end COMPU_METHOD
/begin CHARACTERISTIC TspdK_rs_Kim "Governor Roadspeed Multipliers" CURVE 0x001C68F4 /* @ECU_Address@TspdK_rs_Kim@0x02373000@ */ ECIPP_ALIGNMENT_SWORD 8 Compu_TspdK_rs_Kim -8 7.999755859375
 /begin AXIS_DESCR COM_AXIS NO_INPUT_QUANTITY Compu_TspdK_rs_rs 8 -256 255.9921875 AXIS_PTS_REF TspdK_rs_rs /end AXIS_DESCR
/end CHARACTERISTIC
/begin COMPU_METHOD Compu_TspdK_rs_Kim " " RAT_FUNC "%.3" "Ki Multiplier" COEFFS 0 4096 0 0 0 1 /end COMPU_METHOD
/begin CHARACTERISTIC TspdK_rs_Kivm "Governor Roadspeed Multipliers" CURVE 0x001C6904 /* @ECU_Address@TspdK_rs_Kivm@0x02374000@ */ ECIPP_ALIGNMENT_SWORD 8 Compu_TspdK_rs_Kivm -8 7.999755859375
 /begin AXIS_DESCR COM_AXIS NO_INPUT_QUANTITY Compu_TspdK_rs_rs 8 -256 255.9921875 AXIS_PTS_REF TspdK_rs_rs /end AXIS_DESCR
/end CHARACTERISTIC
/begin COMPU_METHOD Compu_TspdK_rs_Kivm " " RAT_FUNC "%.3" "Kiv Multiplier" COEFFS 0 4096 0 0 0 1 /end COMPU_METHOD
/begin CHARACTERISTIC TspdK_rs_Kdm "Governor Roadspeed Multipliers" CURVE 0x001C68E4 /* @ECU_Address@TspdK_rs_Kdm@0x02375000@ */ ECIPP_ALIGNMENT_SWORD 8 Compu_TspdK_rs_Kdm -8 7.999755859375
 /begin AXIS_DESCR COM_AXIS NO_INPUT_QUANTITY Compu_TspdK_rs_rs 8 -256 255.9921875 AXIS_PTS_REF TspdK_rs_rs /end AXIS_DESCR
/end CHARACTERISTIC
/begin COMPU_METHOD Compu_TspdK_rs_Kdm " " RAT_FUNC "%.3" "Kd Multiplier" COEFFS 0 4096 0 0 0 1 /end COMPU_METHOD
/begin CHARACTERISTIC TspdK_rs_KMAPdtm "Governor Roadspeed Multipliers" CURVE 0x001C68C4 /* @ECU_Address@TspdK_rs_KMAPdtm@0x02376000@ */ ECIPP_ALIGNMENT_SWORD 8 Compu_TspdK_rs_KMAPdtm -8 7.999755859375
 /begin AXIS_DESCR COM_AXIS NO_INPUT_QUANTITY Compu_TspdK_rs_rs 8 -256 255.9921875 AXIS_PTS_REF TspdK_rs_rs /end AXIS_DESCR
/end CHARACTERISTIC
/begin COMPU_METHOD Compu_TspdK_rs_KMAPdtm " " RAT_FUNC "%.3" "dMAP/dt Multiplier" COEFFS 0 4096 0 0 0 1 /end COMPU_METHOD
/begin CHARACTERISTIC TspdK_rs_KMdtfbm "Governor Roadspeed Multipliers" CURVE 0x001C68D4 /* @ECU_Address@TspdK_rs_KMdtfbm@0x02377000@ */ ECIPP_ALIGNMENT_SWORD 8 Compu_TspdK_rs_KMdtfbm -8 7.999755859375
 /begin AXIS_DESCR COM_AXIS NO_INPUT_QUANTITY Compu_TspdK_rs_rs 8 -256 255.9921875 AXIS_PTS_REF TspdK_rs_rs /end AXIS_DESCR
/end CHARACTERISTIC
/begin COMPU_METHOD Compu_TspdK_rs_KMdtfbm " " RAT_FUNC "%.3" "dMAP/dt FB Multiplier" COEFFS 0 4096 0 0 0 1 /end COMPU_METHOD
/begin CHARACTERISTIC TspdK_rs_dzKpm "Governor Roadspeed Multipliers" CURVE 0x001C6944 /* @ECU_Address@TspdK_rs_dzKpm@0x02378000@ */ ECIPP_ALIGNMENT_SWORD 8 Compu_TspdK_rs_dzKpm -8 7.999755859375
 /begin AXIS_DESCR COM_AXIS NO_INPUT_QUANTITY Compu_TspdK_rs_rs 8 -256 255.9921875 AXIS_PTS_REF TspdK_rs_rs /end AXIS_DESCR
/end CHARACTERISTIC
/begin COMPU_METHOD Compu_TspdK_rs_dzKpm " " RAT_FUNC "%.3" "Kp dz Multiplier" COEFFS 0 4096 0 0 0 1 /end COMPU_METHOD
/begin CHARACTERISTIC TspdK_rs_dzKim "Governor Roadspeed Multipliers" CURVE 0x001C6934 /* @ECU_Address@TspdK_rs_dzKim@0x02379000@ */ ECIPP_ALIGNMENT_SWORD 8 Compu_TspdK_rs_dzKim -8 7.999755859375
 /begin AXIS_DESCR COM_AXIS NO_INPUT_QUANTITY Compu_TspdK_rs_rs 8 -256 255.9921875 AXIS_PTS_REF TspdK_rs_rs /end AXIS_DESCR
/end CHARACTERISTIC
/begin COMPU_METHOD Compu_TspdK_rs_dzKim " " RAT_FUNC "%.3" "Ki dz Multiplier" COEFFS 0 4096 0 0 0 1 /end COMPU_METHOD
/begin CHARACTERISTIC TspdK_rs_dzKdm "Governor Roadspeed Multipliers" CURVE 0x001C6924 /* @ECU_Address@TspdK_rs_dzKdm@0x0237A000@ */ ECIPP_ALIGNMENT_SWORD 8 Compu_TspdK_rs_dzKdm -8 7.999755859375
 /begin AXIS_DESCR COM_AXIS NO_INPUT_QUANTITY Compu_TspdK_rs_rs 8 -256 255.9921875 AXIS_PTS_REF TspdK_rs_rs /end AXIS_DESCR
/end CHARACTERISTIC
/begin COMPU_METHOD Compu_TspdK_rs_dzKdm " " RAT_FUNC "%.3" "Kd dz Multiplier" COEFFS 0 4096 0 0 0 1 /end COMPU_METHOD
/begin CHARACTERISTIC TspdK_rs_Ifrzm "Governor Roadspeed Multipliers" CURVE 0x001C68B4 /* @ECU_Address@TspdK_rs_Ifrzm@0x0237B000@ */ ECIPP_ALIGNMENT_SWORD 8 Compu_TspdK_rs_Ifrzm -8 7.999755859375
 /begin AXIS_DESCR COM_AXIS NO_INPUT_QUANTITY Compu_TspdK_rs_rs 8 -256 255.9921875 AXIS_PTS_REF TspdK_rs_rs /end AXIS_DESCR
/end CHARACTERISTIC
/begin COMPU_METHOD Compu_TspdK_rs_Ifrzm " " RAT_FUNC "%.3" "I Freeze Multiplier" COEFFS 0 4096 0 0 0 1 /end COMPU_METHOD
/begin CHARACTERISTIC TspdK_rs_TPSLP "Governor Roadspeed Multipliers" CURVE 0x001C862A /* @ECU_Address@TspdK_rs_TPSLP@0x0237C000@ */ ECIPP_ALIGNMENT_UWORD 327680 Compu_TspdK_rs_TPSLP 0.45084 327680
 /begin AXIS_DESCR COM_AXIS NO_INPUT_QUANTITY Compu_TspdK_rs_rs 8 -256 255.9921875 AXIS_PTS_REF TspdK_rs_rs /end AXIS_DESCR
/end CHARACTERISTIC
/begin COMPU_METHOD Compu_TspdK_rs_TPSLP " " FORM "%.1" "TPS Output low-pass"
 /begin FORMULA "-5 / log(1 - (X1 / 65536))" FORMULA_INV "(1 - exp(-5/X1)) * 65536" /end FORMULA
/end COMPU_METHOD
/begin COMPU_METHOD Compu_TspdK2_rpm_rpm " " RAT_FUNC "%.0" "Speed (rpm)" COEFFS 0 1 0 0 0 1 /end COMPU_METHOD
/begin CHARACTERISTIC TspdK2_rpm_Kp "Isochronous Speed Gains" CURVE 0x001C67F4 /* @ECU_Address@TspdK2_rpm_Kp@0x02486000@ */ ECIPP_ALIGNMENT_SWORD 3125 Compu_TspdK2_rpm_Kp -3125 3124.90463256836
 /begin AXIS_DESCR COM_AXIS NO_INPUT_QUANTITY Compu_TspdK2_rpm_rpm 4 -32768 32767 AXIS_PTS_REF TspdK2_rpm_rpm /end AXIS_DESCR
/end CHARACTERISTIC
/begin AXIS_PTS TspdK2_rpm_rpm " " 0x001C6814 /* @ECU_Address@TspdK2_rpm_rpm@0x02485000@ */ NO_INPUT_QUANTITY ECIPP_Lookup_SWORD 0 Compu_TspdK2_rpm_rpm 4 -32768 32767 /end AXIS_PTS
/begin COMPU_METHOD Compu_TspdK2_rpm_Kp " " RAT_FUNC "%.1" "Kp rpm (%/krpm)" COEFFS 0 10.48576 0 0 0 1 /end COMPU_METHOD
/begin CHARACTERISTIC TspdK2_rpm_Kd "Isochronous Speed Gains" CURVE 0x001C67DC /* @ECU_Address@TspdK2_rpm_Kd@0x02487000@ */ ECIPP_ALIGNMENT_SWORD 1600 Compu_TspdK2_rpm_Kd -1600 1599.951171875
 /begin AXIS_DESCR COM_AXIS NO_INPUT_QUANTITY Compu_TspdK2_rpm_rpm 4 -32768 32767 AXIS_PTS_REF TspdK2_rpm_rpm /end AXIS_DESCR
/end CHARACTERISTIC
/begin COMPU_METHOD Compu_TspdK2_rpm_Kd " " RAT_FUNC "%.2" "Kd rpm (%/(krpm/s))" COEFFS 0 20.48 0 0 0 1 /end COMPU_METHOD
/begin CHARACTERISTIC TspdK2_rpm_KMAPdt "Isochronous Speed Gains" CURVE 0x001C67CC /* @ECU_Address@TspdK2_rpm_KMAPdt@0x02488000@ */ ECIPP_ALIGNMENT_SWORD 1000 Compu_TspdK2_rpm_KMAPdt -1000 999.969482421875
 /begin AXIS_DESCR COM_AXIS NO_INPUT_QUANTITY Compu_TspdK2_rpm_rpm 4 -32768 32767 AXIS_PTS_REF TspdK2_rpm_rpm /end AXIS_DESCR
/end CHARACTERISTIC
/begin COMPU_METHOD Compu_TspdK2_rpm_KMAPdt " " RAT_FUNC "%.1" "K dMAPdt (1/sec)" COEFFS 0 32.768 0 0 0 1 /end COMPU_METHOD
/begin CHARACTERISTIC TspdK2_rpm_Ki "Isochronous Speed Gains" CURVE 0x001C67E4 /* @ECU_Address@TspdK2_rpm_Ki@0x02489000@ */ ECIPP_ALIGNMENT_SWORD 12207 Compu_TspdK2_rpm_Ki -12207.03125 12206.6587209702
 /begin AXIS_DESCR COM_AXIS NO_INPUT_QUANTITY Compu_TspdK2_rpm_rpm 4 -32768 32767 AXIS_PTS_REF TspdK2_rpm_rpm /end AXIS_DESCR
/end CHARACTERISTIC
/begin COMPU_METHOD Compu_TspdK2_rpm_Ki " " RAT_FUNC "%.1" "Ki rpm (%/krpm/s)" COEFFS 0 2.68435456 0 0 0 1 /end COMPU_METHOD
/begin CHARACTERISTIC TspdK2_rpm_KMdtfb "Isochronous Speed Gains" CURVE 0x001C67D4 /* @ECU_Address@TspdK2_rpm_KMdtfb@0x0248A000@ */ ECIPP_ALIGNMENT_SWORD 32 Compu_TspdK2_rpm_KMdtfb -32 31.9990234375
 /begin AXIS_DESCR COM_AXIS NO_INPUT_QUANTITY Compu_TspdK2_rpm_rpm 4 -32768 32767 AXIS_PTS_REF TspdK2_rpm_rpm /end AXIS_DESCR
/end CHARACTERISTIC
/begin COMPU_METHOD Compu_TspdK2_rpm_KMdtfb " " RAT_FUNC "%.3" "K dMAPdt FB (fraction)" COEFFS 0 1024 0 0 0 1 /end COMPU_METHOD
/begin CHARACTERISTIC TspdK2_rpm_dzKp "Isochronous Speed Gains" CURVE 0x001C680C /* @ECU_Address@TspdK2_rpm_dzKp@0x0248B000@ */ ECIPP_ALIGNMENT_SWORD 32767 Compu_TspdK2_rpm_dzKp -32768 32767
 /begin AXIS_DESCR COM_AXIS NO_INPUT_QUANTITY Compu_TspdK2_rpm_rpm 4 -32768 32767 AXIS_PTS_REF TspdK2_rpm_rpm /end AXIS_DESCR
/end CHARACTERISTIC
/begin COMPU_METHOD Compu_TspdK2_rpm_dzKp " " RAT_FUNC "%.0" "dead-zone (rpm)" COEFFS 0 1 0 0 0 1 /end COMPU_METHOD
/begin CHARACTERISTIC TspdK2_rpm_dzKi "Isochronous Speed Gains" CURVE 0x001C6804 /* @ECU_Address@TspdK2_rpm_dzKi@0x0248C000@ */ ECIPP_ALIGNMENT_SWORD 32767 Compu_TspdK2_rpm_dzKi -32768 32767
 /begin AXIS_DESCR COM_AXIS NO_INPUT_QUANTITY Compu_TspdK2_rpm_rpm 4 -32768 32767 AXIS_PTS_REF TspdK2_rpm_rpm /end AXIS_DESCR
/end CHARACTERISTIC
/begin COMPU_METHOD Compu_TspdK2_rpm_dzKi " " RAT_FUNC "%.0" "dead-zone (rpm)" COEFFS 0 1 0 0 0 1 /end COMPU_METHOD
/begin CHARACTERISTIC TspdK2_rpm_dzKd "Isochronous Speed Gains" CURVE 0x001C67FC /* @ECU_Address@TspdK2_rpm_dzKd@0x0248D000@ */ ECIPP_ALIGNMENT_SWORD 63998 Compu_TspdK2_rpm_dzKd -64000 63998.046875
 /begin AXIS_DESCR COM_AXIS NO_INPUT_QUANTITY Compu_TspdK2_rpm_rpm 4 -32768 32767 AXIS_PTS_REF TspdK2_rpm_rpm /end AXIS_DESCR
/end CHARACTERISTIC
/begin COMPU_METHOD Compu_TspdK2_rpm_dzKd " " RAT_FUNC "%.0" "dead-zone (rpm/sec)" COEFFS 0 0.512 0 0 0 1 /end COMPU_METHOD
/begin CHARACTERISTIC TspdK2_rpm_Ifrz "Isochronous Speed Gains" CURVE 0x001C67C4 /* @ECU_Address@TspdK2_rpm_Ifrz@0x0248E000@ */ ECIPP_ALIGNMENT_SWORD 63998 Compu_TspdK2_rpm_Ifrz -64000 63998.046875
 /begin AXIS_DESCR COM_AXIS NO_INPUT_QUANTITY Compu_TspdK2_rpm_rpm 4 -32768 32767 AXIS_PTS_REF TspdK2_rpm_rpm /end AXIS_DESCR
/end CHARACTERISTIC
/begin COMPU_METHOD Compu_TspdK2_rpm_Ifrz " " RAT_FUNC "%.0" "freeze (rpm/sec)" COEFFS 0 0.512 0 0 0 1 /end COMPU_METHOD
/begin CHARACTERISTIC TspdK2_rpm_Kiv "Isochronous Speed Gains" CURVE 0x001C67EC /* @ECU_Address@TspdK2_rpm_Kiv@0x0248F000@ */ ECIPP_ALIGNMENT_SWORD 6250 Compu_TspdK2_rpm_Kiv -6250 6249.80926513672
 /begin AXIS_DESCR COM_AXIS NO_INPUT_QUANTITY Compu_TspdK2_rpm_rpm 4 -32768 32767 AXIS_PTS_REF TspdK2_rpm_rpm /end AXIS_DESCR
/end CHARACTERISTIC
/begin COMPU_METHOD Compu_TspdK2_rpm_Kiv " " RAT_FUNC "%.1" "Kiv rpm (%/krpm)" COEFFS 0 5.24288 0 0 0 1 /end COMPU_METHOD
/begin COMPU_METHOD Compu_TdrpK2_rpm_rpm " " RAT_FUNC "%.0" "Speed (rpm)" COEFFS 0 1 0 0 0 1 /end COMPU_METHOD
/begin CHARACTERISTIC TdrpK2_rpm_Kp "Droop Speed Gains" CURVE 0x001C6400 /* @ECU_Address@TdrpK2_rpm_Kp@0x02491000@ */ ECIPP_ALIGNMENT_SWORD 3125 Compu_TdrpK2_rpm_Kp -3125 3124.90463256836
 /begin AXIS_DESCR COM_AXIS NO_INPUT_QUANTITY Compu_TdrpK2_rpm_rpm 4 -32768 32767 AXIS_PTS_REF TdrpK2_rpm_rpm /end AXIS_DESCR
/end CHARACTERISTIC
/begin AXIS_PTS TdrpK2_rpm_rpm " " 0x001C6420 /* @ECU_Address@TdrpK2_rpm_rpm@0x02490000@ */ NO_INPUT_QUANTITY ECIPP_Lookup_SWORD 0 Compu_TdrpK2_rpm_rpm 4 -32768 32767 /end AXIS_PTS
/begin COMPU_METHOD Compu_TdrpK2_rpm_Kp " " RAT_FUNC "%.1" "Kp rpm (%/krpm)" COEFFS 0 10.48576 0 0 0 1 /end COMPU_METHOD
/begin CHARACTERISTIC TdrpK2_rpm_Kd "Droop Speed Gains" CURVE 0x001C63E8 /* @ECU_Address@TdrpK2_rpm_Kd@0x02492000@ */ ECIPP_ALIGNMENT_SWORD 1600 Compu_TdrpK2_rpm_Kd -1600 1599.951171875
 /begin AXIS_DESCR COM_AXIS NO_INPUT_QUANTITY Compu_TdrpK2_rpm_rpm 4 -32768 32767 AXIS_PTS_REF TdrpK2_rpm_rpm /end AXIS_DESCR
/end CHARACTERISTIC
/begin COMPU_METHOD Compu_TdrpK2_rpm_Kd " " RAT_FUNC "%.2" "Kd rpm (%/(krpm/s))" COEFFS 0 20.48 0 0 0 1 /end COMPU_METHOD
/begin CHARACTERISTIC TdrpK2_rpm_Ki "Droop Speed Gains" CURVE 0x001C63F0 /* @ECU_Address@TdrpK2_rpm_Ki@0x02493000@ */ ECIPP_ALIGNMENT_SWORD 12207 Compu_TdrpK2_rpm_Ki -12207.03125 12206.6587209702
 /begin AXIS_DESCR COM_AXIS NO_INPUT_QUANTITY Compu_TdrpK2_rpm_rpm 4 -32768 32767 AXIS_PTS_REF TdrpK2_rpm_rpm /end AXIS_DESCR
/end CHARACTERISTIC
/begin COMPU_METHOD Compu_TdrpK2_rpm_Ki " " RAT_FUNC "%.1" "Ki rpm (%/krpm/s)" COEFFS 0 2.68435456 0 0 0 1 /end COMPU_METHOD
/begin CHARACTERISTIC TdrpK2_rpm_KMAPdt "Droop Speed Gains" CURVE 0x001C63D8 /* @ECU_Address@TdrpK2_rpm_KMAPdt@0x02494000@ */ ECIPP_ALIGNMENT_SWORD 1000 Compu_TdrpK2_rpm_KMAPdt -1000 999.969482421875
 /begin AXIS_DESCR COM_AXIS NO_INPUT_QUANTITY Compu_TdrpK2_rpm_rpm 4 -32768 32767 AXIS_PTS_REF TdrpK2_rpm_rpm /end AXIS_DESCR
/end CHARACTERISTIC
/begin COMPU_METHOD Compu_TdrpK2_rpm_KMAPdt " " RAT_FUNC "%.1" "K dMAPdt (1/sec)" COEFFS 0 32.768 0 0 0 1 /end COMPU_METHOD
/begin CHARACTERISTIC TdrpK2_rpm_KMdtfb "Droop Speed Gains" CURVE 0x001C63E0 /* @ECU_Address@TdrpK2_rpm_KMdtfb@0x02495000@ */ ECIPP_ALIGNMENT_SWORD 32 Compu_TdrpK2_rpm_KMdtfb -32 31.9990234375
 /begin AXIS_DESCR COM_AXIS NO_INPUT_QUANTITY Compu_TdrpK2_rpm_rpm 4 -32768 32767 AXIS_PTS_REF TdrpK2_rpm_rpm /end AXIS_DESCR
/end CHARACTERISTIC
/begin COMPU_METHOD Compu_TdrpK2_rpm_KMdtfb " " RAT_FUNC "%.3" "K dMAPdt FB (fraction)" COEFFS 0 1024 0 0 0 1 /end COMPU_METHOD
/begin CHARACTERISTIC TdrpK2_rpm_dzKp "Droop Speed Gains" CURVE 0x001C6418 /* @ECU_Address@TdrpK2_rpm_dzKp@0x02496000@ */ ECIPP_ALIGNMENT_SWORD 32767 Compu_TdrpK2_rpm_dzKp -32768 32767
 /begin AXIS_DESCR COM_AXIS NO_INPUT_QUANTITY Compu_TdrpK2_rpm_rpm 4 -32768 32767 AXIS_PTS_REF TdrpK2_rpm_rpm /end AXIS_DESCR
/end CHARACTERISTIC
/begin COMPU_METHOD Compu_TdrpK2_rpm_dzKp " " RAT_FUNC "%.0" "dead-zone (rpm)" COEFFS 0 1 0 0 0 1 /end COMPU_METHOD
/begin CHARACTERISTIC TdrpK2_rpm_dzKi "Droop Speed Gains" CURVE 0x001C6410 /* @ECU_Address@TdrpK2_rpm_dzKi@0x02497000@ */ ECIPP_ALIGNMENT_SWORD 32767 Compu_TdrpK2_rpm_dzKi -32768 32767
 /begin AXIS_DESCR COM_AXIS NO_INPUT_QUANTITY Compu_TdrpK2_rpm_rpm 4 -32768 32767 AXIS_PTS_REF TdrpK2_rpm_rpm /end AXIS_DESCR
/end CHARACTERISTIC
/begin COMPU_METHOD Compu_TdrpK2_rpm_dzKi " " RAT_FUNC "%.0" "dead-zone (rpm)" COEFFS 0 1 0 0 0 1 /end COMPU_METHOD
/begin CHARACTERISTIC TdrpK2_rpm_dzKd "Droop Speed Gains" CURVE 0x001C6408 /* @ECU_Address@TdrpK2_rpm_dzKd@0x02498000@ */ ECIPP_ALIGNMENT_SWORD 63998 Compu_TdrpK2_rpm_dzKd -64000 63998.046875
 /begin AXIS_DESCR COM_AXIS NO_INPUT_QUANTITY Compu_TdrpK2_rpm_rpm 4 -32768 32767 AXIS_PTS_REF TdrpK2_rpm_rpm /end AXIS_DESCR
/end CHARACTERISTIC
/begin COMPU_METHOD Compu_TdrpK2_rpm_dzKd " " RAT_FUNC "%.0" "dead-zone (rpm/sec)" COEFFS 0 0.512 0 0 0 1 /end COMPU_METHOD
/begin CHARACTERISTIC TdrpK2_rpm_Ifrz "Droop Speed Gains" CURVE 0x001C63D0 /* @ECU_Address@TdrpK2_rpm_Ifrz@0x02499000@ */ ECIPP_ALIGNMENT_SWORD 63998 Compu_TdrpK2_rpm_Ifrz -64000 63998.046875
 /begin AXIS_DESCR COM_AXIS NO_INPUT_QUANTITY Compu_TdrpK2_rpm_rpm 4 -32768 32767 AXIS_PTS_REF TdrpK2_rpm_rpm /end AXIS_DESCR
/end CHARACTERISTIC
/begin COMPU_METHOD Compu_TdrpK2_rpm_Ifrz " " RAT_FUNC "%.0" "freeze (rpm/sec)" COEFFS 0 0.512 0 0 0 1 /end COMPU_METHOD
/begin CHARACTERISTIC TdrpK2_rpm_Kiv "Droop Speed Gains" CURVE 0x001C63F8 /* @ECU_Address@TdrpK2_rpm_Kiv@0x0249A000@ */ ECIPP_ALIGNMENT_SWORD 6250 Compu_TdrpK2_rpm_Kiv -6250 6249.80926513672
 /begin AXIS_DESCR COM_AXIS NO_INPUT_QUANTITY Compu_TdrpK2_rpm_rpm 4 -32768 32767 AXIS_PTS_REF TdrpK2_rpm_rpm /end AXIS_DESCR
/end CHARACTERISTIC
/begin COMPU_METHOD Compu_TdrpK2_rpm_Kiv " " RAT_FUNC "%.1" "Kiv rpm (%/krpm)" COEFFS 0 5.24288 0 0 0 1 /end COMPU_METHOD
/begin COMPU_METHOD Compu_TGov3_rmt_ff_rpm " " RAT_FUNC "%.0" "Target Speed (rpm)" COEFFS 0 1 0 0 0 1 /end COMPU_METHOD
/begin CHARACTERISTIC TGov3_rmt_ff_load "Gov3 Remote Feedforward" CURVE 0x001C4E7C /* @ECU_Address@TGov3_rmt_ff_load@0x02692000@ */ ECIPP_ALIGNMENT_SWORD 800 Compu_TGov3_rmt_ff_load -800 799.9755859375
 /begin AXIS_DESCR COM_AXIS NO_INPUT_QUANTITY Compu_TGov3_rmt_ff_rpm 4 -32768 32767 AXIS_PTS_REF TGov3_rmt_ff_rpm /end AXIS_DESCR
/end CHARACTERISTIC
/begin AXIS_PTS TGov3_rmt_ff_rpm " " 0x001C4E84 /* @ECU_Address@TGov3_rmt_ff_rpm@0x02691000@ */ NO_INPUT_QUANTITY ECIPP_Lookup_SWORD 0 Compu_TGov3_rmt_ff_rpm 4 -32768 32767 /end AXIS_PTS
/begin COMPU_METHOD Compu_TGov3_rmt_ff_load " " RAT_FUNC "%.1" "Load (%)" COEFFS 0 40.96 0 0 0 1 /end COMPU_METHOD
/begin CHARACTERISTIC TAMTSA_dec_minnom "AMT shift assist decreasing min/nom target 1" VAL_BLK 0x001C4620 /* @ECU_Address@TAMTSA_dec_minnom@0x026CA000@ */ ECIPP_ALIGNMENT_SWORD 2 Compu_TAMTSA_dec_minnom -2 1.99993896484375 MATRIX_DIM 16 1 1 /end CHARACTERISTIC
/begin COMPU_METHOD Compu_TAMTSA_dec_minnom " " RAT_FUNC "%.2" "-" COEFFS 0 16384 0 0 0 1 /end COMPU_METHOD
/begin CHARACTERISTIC TAMTSA_dec_TPSd_tau "AMT shift assist decreasing TPSd tau 1" VAL_BLK 0x001C858C /* @ECU_Address@TAMTSA_dec_TPSd_tau@0x026CB000@ */ ECIPP_ALIGNMENT_UWORD 327680 Compu_TAMTSA_dec_TPSd_tau 0.45084 327680 MATRIX_DIM 16 1 1 /end CHARACTERISTIC
/begin COMPU_METHOD Compu_TAMTSA_dec_TPSd_tau " " FORM "%.0" "ms"
 /begin FORMULA "-5 / log(1 - (X1 / 65536))" FORMULA_INV "(1 - exp(-5/X1)) * 65536" /end FORMULA
/end COMPU_METHOD
/begin CHARACTERISTIC TAMTSA_dec_TPSd_tm "AMT shift assist decreasing TPSd time 1" VAL_BLK 0x001C7FD6 /* @ECU_Address@TAMTSA_dec_TPSd_tm@0x026CC000@ */ ECIPP_ALIGNMENT_UWORD 65535 Compu_TAMTSA_dec_TPSd_tm 0 65535 MATRIX_DIM 16 1 1 /end CHARACTERISTIC
/begin COMPU_METHOD Compu_TAMTSA_dec_TPSd_tm " " RAT_FUNC "%.0" "ms" COEFFS 0 1 0 0 0 1 /end COMPU_METHOD
/begin CHARACTERISTIC TAMTSA_inc_TPSd_tau "AMT shift assist increasing TPSd tau 1" VAL_BLK 0x001C85AC /* @ECU_Address@TAMTSA_inc_TPSd_tau@0x026CD000@ */ ECIPP_ALIGNMENT_UWORD 327680 Compu_TAMTSA_inc_TPSd_tau 0.45084 327680 MATRIX_DIM 16 1 1 /end CHARACTERISTIC
/begin COMPU_METHOD Compu_TAMTSA_inc_TPSd_tau " " FORM "%.0" "ms"
 /begin FORMULA "-5 / log(1 - (X1 / 65536))" FORMULA_INV "(1 - exp(-5/X1)) * 65536" /end FORMULA
/end COMPU_METHOD
/begin CHARACTERISTIC TAMTSA_inc_TPSd_tm "AMT shift assist increasing TPSd time 1" VAL_BLK 0x001C7FF6 /* @ECU_Address@TAMTSA_inc_TPSd_tm@0x026CE000@ */ ECIPP_ALIGNMENT_UWORD 65535 Compu_TAMTSA_inc_TPSd_tm 0 65535 MATRIX_DIM 16 1 1 /end CHARACTERISTIC
/begin COMPU_METHOD Compu_TAMTSA_inc_TPSd_tm " " RAT_FUNC "%.0" "ms" COEFFS 0 1 0 0 0 1 /end COMPU_METHOD
/begin CHARACTERISTIC TAMTSA_inc_WGPd "AMT shift assist increasing WGPd max 1" VAL_BLK 0x001C8016 /* @ECU_Address@TAMTSA_inc_WGPd@0x026CF000@ */ ECIPP_ALIGNMENT_UWORD 256 Compu_TAMTSA_inc_WGPd 0 255.99609375 MATRIX_DIM 16 1 1 /end CHARACTERISTIC
/begin COMPU_METHOD Compu_TAMTSA_inc_WGPd " " RAT_FUNC "%.1" "psig" COEFFS 0 256 0 0 0 1 /end COMPU_METHOD
/begin GROUP EC_GovCal "ECONTROLS" ROOT
 /begin REF_CHARACTERISTIC LG_gov_ena HG_gov_ena mingv_auth_min mingv_auth_max strt_min_idle strt_min_idle_dcy strt_min_FPP minigv_appdlt maxigv_appdlt minigv_apprdt maxigv_apprdt minigv_Iinit maxigv_Iinit Gov1_ena Gov2_ena Gov3_ena mindgv_I_min mindgv_I_max minigv_I_min minigv_I_max mingv_nomload maxdgv_I_min maxdgv_I_max maxigv_I_min maxigv_I_max maxgv_nomload maxgv_auth_min maxgv_auth_max Gov1_rpm Gov1d_I_min Gov1d_I_max Gov1i_I_min Gov1i_I_max Gov1_nomload Gov1_auth_min Gov1_auth_max Gov1i_Iinit Gov1i_appdlt Gov1i_apprdt Gov2_rpm Gov2d_I_min Gov2d_I_max Gov2i_I_min Gov2i_I_max Gov2_nomload Gov2_auth_min Gov2_auth_max Gov2i_Iinit Gov2i_appdlt Gov2i_apprdt Gov3_rpm Gov3d_I_min Gov3d_I_max Gov3i_I_min Gov3i_I_max Gov3_nomload Gov3_auth_min Gov3_auth_max Gov3i_Iinit Gov3i_appdlt Gov3i_apprdt gov_app_mode mingv_odz maxgv_odz mingv_odz_wall maxgv_odz_wall mingv_odz_tau maxgv_odz_tau gov_ntrlock_chan mingv_TPSLP maxgv_TPSLP Gov1_TPSLP Gov2_TPSLP Gov3_TPSLP Imin_gov_start Imax_gov_start I_Gov1_start I_Gov2_start I_Gov3_start Gov_start_wait mingv_spk_Kpo maxgv_spk_Kpo Gov1_spk_Kpo Gov2_spk_Kpo Gov3_spk_Kpo Gov3_spk_Kpu Gov2_spk_Kpu Gov1_spk_Kpu maxgv_spk_Kpu mingv_spk_Kpu mingv_spk_dzo maxgv_spk_dzo Gov1_spk_dzo Gov2_spk_dzo Gov3_spk_dzo mingv_spk_dzu maxgv_spk_dzu Gov1_spk_dzu Gov2_spk_dzu Gov3_spk_dzu mingv_spk_mxret maxgv_spk_mxret Gov1_spk_mxret Gov2_spk_mxret Gov3_spk_mxret mingv_spk_mxadv maxgv_spk_mxadv Gov1_spk_mxadv Gov2_spk_mxadv Gov3_spk_mxadv gov_gain_gsln gov_gain_LPG gov_gain_NG FPPSC_mode FPPSC_rpmL FPPSC_rpmH gov_max_abslimit gov_min_abslimit Gtap_ena Gtap_min_rpm Gtap_max_rpm Gtap_1tap_rpm Gtap_ramp_delay Gtap_ramp_phase Gtap_ramp_final IdleFPP_ena IdleFPP_min IdleFPP_max IdleFPP_rpmdelta IdleFPP_rpmmax IdleFPP_loadadd Gov3_gain_slct Gov2_gain_slct Gov1_gain_slct maxgv_gain_slct mingv_gain_slct MaxSetPt_Gov3 minigv_Iinit_ena maxigv_Iinit_ena Gov1i_Iinit_ena Gov2i_Iinit_ena Gov3i_Iinit_ena MaxSetPt_ena MSP_min_rpm MSP_max_rpm MSP_1tap_rpm MSP_ramp_delay MSP_ramp_phase MSP_ramp_final MSP_set_source MSP_prop_V0 MSP_prop_V1 MSP_prop_rpm0 MSP_prop_rpm1 MSP_prop_tau MaxSetPt_apprdt MSP_1tap_RS MSP_rampRS_final MSP_min_RS MSP_max_RS MSP_setclr_HW_input MSP_incdec_HW_input MaxSetPt_keyon MSP2_set_source MaxSetPt2_ena fastidle_ena fastidle_rpm fastidle_act_st strt_idle_mode MaxSetPt_rtn_ena secspd_sw TransNeut_sw Gtap_rpmmin_adjust veh_type clutch_sw strt_max_FPP clutch_sw_config gov_rs_ena TransNeut_sw_cfg gov_gain_gsln_dis gov_gain_LPG_dis gov_gain_NG_dis Gov1_spk_att_ena Gov2_spk_att_ena Gtap_setmin_wait AMT_Gov3_acc_init AMT_select AMT_Gov3_acc_maxload IPAS_mode IPAS_rpm IPAS_speed_on IPAS_speed_off AMT_neut_coast_mode gov_strt_wait_mode strt_OILT_lmt strt_ECT_lmt strt_no_warmup_mult cooldown_ena cooldown_rpm cooldown_rpmdt cooldown_time_max cooldown_time_min cooldown_temp1_ena cooldown_temp2_ena cooldown_temp1 cooldown_temp2 cooldown_logic cooldown_gov_mode gov_gain_aux_chan gov_gain_aux_cfg gov_gain_gsln_aux gov_gain_LPG_aux gov_gain_NG_aux gov_gain_gsln_auxdis gov_gain_LPG_auxdis gov_gain_NG_auxdis Gov3_rmt_ff_ena Gov3_rmt_ff_rpm_min Gov3_odz Gov3_odz_wall Gov3_odz_tau AMTSA_ena AMTSA_TPSd_filt_ena AMTSA_minnom_ena AMTSA_minnom_time AMTSA_dec_torq_est AMTSA_WGPd_ena TransNeut_ETC2_mode gov_switchover_time TIdle_ECT_rpm TspdK_rpm_Kp TspdK_rpm_Kd TspdK_rpm_KMAPdt TspdK_ECT_Kpm TspdK_rpm_Ki TspdK_rpm_KMdtfb TspdK_rpm_dzKp TspdK_rpm_dzKi TspdK_rpm_dzKd TspdK_rpm_Ifrz TdrpK_rpm_Kp TdrpK_rpm_Kd TdrpK_rpm_Ki TdrpK_rpm_KMAPdt TdrpK_rpm_KMdtfb TdrpK_rpm_dzKp TdrpK_rpm_dzKi TdrpK_rpm_dzKd TdrpK_rpm_Ifrz TspdK_ECT_Kim TspdK_ECT_Kdm TspdK_ECT_KMdm TspdK_ECT_KMfm TspdK_ECT_nomld TspdK_rpm_Kiv TdrpK_rpm_Kiv TspdK_ECT_Kivm TStrtIdle_ECT_ini TStrtIdle_ECT_hld TStrtIdle_ECT_dcy TspdK_rs_Kpm TspdK_rs_Kim TspdK_rs_Kivm TspdK_rs_Kdm TspdK_rs_KMAPdtm TspdK_rs_KMdtfbm TspdK_rs_dzKpm TspdK_rs_dzKim TspdK_rs_dzKdm TspdK_rs_Ifrzm TspdK_rs_TPSLP TspdK2_rpm_Kp TspdK2_rpm_Kd TspdK2_rpm_KMAPdt TspdK2_rpm_Ki TspdK2_rpm_KMdtfb TspdK2_rpm_dzKp TspdK2_rpm_dzKi TspdK2_rpm_dzKd TspdK2_rpm_Ifrz TspdK2_rpm_Kiv TdrpK2_rpm_Kp TdrpK2_rpm_Kd TdrpK2_rpm_Ki TdrpK2_rpm_KMAPdt TdrpK2_rpm_KMdtfb TdrpK2_rpm_dzKp TdrpK2_rpm_dzKi TdrpK2_rpm_dzKd TdrpK2_rpm_Ifrz TdrpK2_rpm_Kiv TGov3_rmt_ff_load TAMTSA_dec_minnom TAMTSA_dec_TPSd_tau TAMTSA_dec_TPSd_tm TAMTSA_inc_TPSd_tau TAMTSA_inc_TPSd_tm TAMTSA_inc_WGPd /end REF_CHARACTERISTIC
 /begin REF_MEASUREMENT VE gov_MAP_d gov_MAPdt_d TPS_min_gov_pct TPS_max_gov_pct TPS_GovN_pct spkgv_mod gov_gain_man MAP_noload MAP_fullload Kp_gov Kd_gov KMAPdt_gov Ki_gov gov_I_frz rpmdtdz_Kd rpmdz_Kp rpmdz_Ki Kp_gov_mult Ki_gov_mult Kd_gov_mult KMAPdt_gov_mult KMAPdtfb_gov_mult KMAPdtfb_gov gov_nomld_ECTadd Imin_gov_acc Imax_gov_acc Imin_gov_save Imax_gov_save I_Gov1_acc I_Gov2_acc I_Gov3_acc rpmd_gov rpmdtd_gov gov_gain_slct Gtap_rpm Gtap_engaged MaxSetPt_rpm MaxSetPt_engaged MaxSetPt_switch MSP_incdec_sw MSP_setclr_sw Kiv_gov Kiv_gov_mult MSP_prop_V MSP_mode_sw MSP_prisec TSC_ff_loadval strt_idle_ini strt_idle_hld strt_idle_dcy MSP_status secspd_ena TransNeut_ena clutch_depressed clutch_fault Linde_ff_loadval gov_auth_max IPAS_engaged min_allspeed_rpm AMT_RSC_suspend max_gov_highidle_rpm strt_no_warmup strt_idle_state cooldown_state AMTSA_state AMT_torq_lmt AMT_output_speed AMT_input_speed AMT_shift_in_process /end REF_MEASUREMENT
/end GROUP
/begin GROUP EC_GovCalAlt "ECONTROLS" ROOT
 /begin REF_CHARACTERISTIC LG_gov_ena HG_gov_ena mingv_auth_min mingv_auth_max strt_min_idle strt_min_idle_dcy strt_min_FPP minigv_appdlt maxigv_appdlt minigv_apprdt maxigv_apprdt minigv_Iinit maxigv_Iinit Gov1_ena Gov2_ena Gov3_ena mindgv_I_min mindgv_I_max minigv_I_min minigv_I_max mingv_nomload maxdgv_I_min maxdgv_I_max maxigv_I_min maxigv_I_max maxgv_nomload maxgv_auth_min maxgv_auth_max Gov1_rpm Gov1d_I_min Gov1d_I_max Gov1i_I_min Gov1i_I_max Gov1_nomload Gov1_auth_min Gov1_auth_max Gov1i_Iinit Gov1i_appdlt Gov1i_apprdt Gov2_rpm Gov2d_I_min Gov2d_I_max Gov2i_I_min Gov2i_I_max Gov2_nomload Gov2_auth_min Gov2_auth_max Gov2i_Iinit Gov2i_appdlt Gov2i_apprdt Gov3_rpm Gov3d_I_min Gov3d_I_max Gov3i_I_min Gov3i_I_max Gov3_nomload Gov3_auth_min Gov3_auth_max Gov3i_Iinit Gov3i_appdlt Gov3i_apprdt gov_app_mode mingv_odz maxgv_odz mingv_odz_wall maxgv_odz_wall mingv_odz_tau maxgv_odz_tau gov_ntrlock_chan mingv_TPSLP maxgv_TPSLP Gov1_TPSLP Gov2_TPSLP Gov3_TPSLP Imin_gov_start Imax_gov_start I_Gov1_start I_Gov2_start I_Gov3_start mingv_spk_Kpo maxgv_spk_Kpo Gov1_spk_Kpo Gov2_spk_Kpo Gov3_spk_Kpo Gov3_spk_Kpu Gov2_spk_Kpu Gov1_spk_Kpu maxgv_spk_Kpu mingv_spk_Kpu mingv_spk_dzo maxgv_spk_dzo Gov1_spk_dzo Gov2_spk_dzo Gov3_spk_dzo mingv_spk_dzu maxgv_spk_dzu Gov1_spk_dzu Gov2_spk_dzu Gov3_spk_dzu mingv_spk_mxret maxgv_spk_mxret Gov1_spk_mxret Gov2_spk_mxret Gov3_spk_mxret mingv_spk_mxadv maxgv_spk_mxadv Gov1_spk_mxadv Gov2_spk_mxadv Gov3_spk_mxadv gov_gain_gsln gov_gain_LPG gov_gain_NG FPPSC_mode FPPSC_rpmL FPPSC_rpmH gov_max_abslimit gov_min_abslimit Gov3_gain_slct Gov2_gain_slct Gov1_gain_slct maxgv_gain_slct mingv_gain_slct minigv_Iinit_ena maxigv_Iinit_ena Gov1i_Iinit_ena Gov2i_Iinit_ena Gov3i_Iinit_ena secspd_sw TransNeut_sw veh_type clutch_sw strt_max_FPP clutch_sw_config gov_rs_ena TransNeut_sw_cfg gov_gain_gsln_dis gov_gain_LPG_dis gov_gain_NG_dis Gov1_spk_att_ena Gov2_spk_att_ena gov_gain_aux_chan gov_gain_aux_cfg gov_gain_gsln_aux gov_gain_LPG_aux gov_gain_NG_aux gov_gain_gsln_auxdis gov_gain_LPG_auxdis gov_gain_NG_auxdis Gov3_odz Gov3_odz_wall Gov3_odz_tau TransNeut_ETC2_mode gov_switchover_time TIdle_ECT_rpm TspdK_ECT_Kpm TspdK_ECT_Kim TspdK_ECT_Kdm TspdK_ECT_KMdm TspdK_ECT_KMfm TspdK_ECT_nomld TspdK_ECT_Kivm /end REF_CHARACTERISTIC
 /begin REF_MEASUREMENT VE gov_MAP_d gov_MAPdt_d TPS_min_gov_pct TPS_max_gov_pct TPS_GovN_pct spkgv_mod gov_gain_man MAP_noload MAP_fullload Kp_gov Kd_gov KMAPdt_gov Ki_gov gov_I_frz rpmdtdz_Kd rpmdz_Kp rpmdz_Ki Kp_gov_mult Ki_gov_mult Kd_gov_mult KMAPdt_gov_mult KMAPdtfb_gov_mult KMAPdtfb_gov gov_nomld_ECTadd Imin_gov_acc Imax_gov_acc Imin_gov_save Imax_gov_save I_Gov1_acc I_Gov2_acc I_Gov3_acc rpmd_gov rpmdtd_gov gov_gain_slct Kiv_gov Kiv_gov_mult TSC_ff_loadval secspd_ena TransNeut_ena clutch_depressed clutch_fault Linde_ff_loadval gov_auth_max min_allspeed_rpm /end REF_MEASUREMENT
/end GROUP
/begin GROUP EC_LDService "ECONTROLS" ROOT /begin REF_MEASUREMENT rpmd_gov /end REF_MEASUREMENT /end GROUP
/begin GROUP EC_LEService "ECONTROLS" ROOT
 /begin REF_MEASUREMENT spkgv_mod rpmd_gov strt_no_warmup strt_idle_state cooldown_state /end REF_MEASUREMENT
/end GROUP
/begin GROUP EC_OEMEOLConf "ECONTROLS" ROOT
 /begin REF_CHARACTERISTIC Gtap_min_rpm Gtap_max_rpm MSP_prop_V0 MSP_prop_V1 MSP_prop_rpm0 MSP_prop_rpm1 /end REF_CHARACTERISTIC
 /begin REF_MEASUREMENT Gtap_rpm Gtap_engaged MaxSetPt_rpm MaxSetPt_switch MSP_prop_V MSP_status /end REF_MEASUREMENT
/end GROUP
/begin GROUP EC_Outputs "ECONTROLS" ROOT /begin REF_MEASUREMENT MSP_status /end REF_MEASUREMENT /end GROUP
/begin GROUP EC_PowerMon "ECONTROLS" ROOT /begin REF_MEASUREMENT VE /end REF_MEASUREMENT /end GROUP
/begin GROUP EC_SparkCal "ECONTROLS" ROOT /begin REF_MEASUREMENT spkgv_mod /end REF_MEASUREMENT /end GROUP
/begin GROUP EC_SparkCalLP "ECONTROLS" ROOT /begin REF_MEASUREMENT spkgv_mod /end REF_MEASUREMENT /end GROUP
/begin GROUP EC_SparkCalNG "ECONTROLS" ROOT /begin REF_MEASUREMENT spkgv_mod /end REF_MEASUREMENT /end GROUP
/begin GROUP EC_SparkOfst "ECONTROLS" ROOT /begin REF_MEASUREMENT spkgv_mod /end REF_MEASUREMENT /end GROUP
/begin GROUP EC_VECal "ECONTROLS" ROOT /begin REF_MEASUREMENT VE /end REF_MEASUREMENT /end GROUP
/end MODULE
/end PROJECT
