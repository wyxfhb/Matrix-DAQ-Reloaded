ASAP2_VERSION 1 61
/begin PROJECT Econtrols_4G "4G Test"
/begin HEADER "4G A2L Configuration" PROJECT_NO EControls4G /* config for version control */ VERSION "$Revision: 82130 $:" /* config for version control */ /end HEADER
/begin MODULE EControls_4G_SH2A "EControls 4G"
/begin MOD_COMMON "" DEPOSIT ABSOLUTE BYTE_ORDER MSB_FIRST /end MOD_COMMON
/* Define the Record Layouts */
/begin RECORD_LAYOUT ECIPP_ALIGNMENT_UBYTE FNC_VALUES 1 UBYTE COLUMN_DIR DIRECT /end RECORD_LAYOUT
/begin RECORD_LAYOUT ECIPP_ALIGNMENT_UWORD FNC_VALUES 1 UWORD COLUMN_DIR DIRECT /end RECORD_LAYOUT
/begin RECORD_LAYOUT ECIPP_ALIGNMENT_SWORD FNC_VALUES 1 SWORD COLUMN_DIR DIRECT /end RECORD_LAYOUT
/begin RECORD_LAYOUT ECIPP_Lookup_SWORD AXIS_PTS_X 1 SWORD INDEX_INCR DIRECT /end RECORD_LAYOUT
/begin RECORD_LAYOUT ECIPP_ALIGNMENT_ULONG FNC_VALUES 1 ULONG COLUMN_DIR DIRECT /end RECORD_LAYOUT
/begin RECORD_LAYOUT ECIPP_ALIGNMENT_FLOAT32_IEEE FNC_VALUES 1 FLOAT32_IEEE COLUMN_DIR DIRECT /end RECORD_LAYOUT
/begin RECORD_LAYOUT ECIPP_Lookup_FLOAT32_IEEE AXIS_PTS_X 1 FLOAT32_IEEE INDEX_INCR DIRECT /end RECORD_LAYOUT
/begin MEASUREMENT OCT_adapt "Current octane rating" UWORD Compu_OCT_adapt 0 0 0 99.9984741210938 ECU_ADDRESS 0x01002B48 /end MEASUREMENT
/begin COMPU_METHOD Compu_OCT_adapt " " RAT_FUNC "%.1" "%" COEFFS 0 655.36 0 0 0 1 /end COMPU_METHOD
/begin CHARACTERISTIC AFILT_dP_C "Air filter flow rate constant" VALUE 0x001c3a5c /* @ECU_Address@AFILT_dP_C@0x01009268@ */ ECIPP_ALIGNMENT_FLOAT32_IEEE 10000000000 Compu_AFILT_dP_C -10000000000 10000000000 /end CHARACTERISTIC
/begin COMPU_METHOD Compu_AFILT_dP_C " " RAT_FUNC "%.1" "upsig * s^2 / g / L" COEFFS 0 0.000001 0 0 0 1 /end COMPU_METHOD
/begin CHARACTERISTIC EGR_clr_dP_C "EGR cooler flow rate delta-P scaling" VALUE 0x001c0078 /* @ECU_Address@EGR_clr_dP_C@0x01009278@ */ ECIPP_ALIGNMENT_FLOAT32_IEEE 10000000000 Compu_EGR_clr_dP_C -10000000000 10000000000 /end CHARACTERISTIC
/begin COMPU_METHOD Compu_EGR_clr_dP_C " " RAT_FUNC "%.1" "upsig * s^2 / g / L" COEFFS 0 0.000001 0 0 0 1 /end COMPU_METHOD
/begin MEASUREMENT EGRdP "EGR delta-P" SWORD Compu_EGRdP 0 0 -32 31.9990234375 ECU_ADDRESS 0x010092E8 /end MEASUREMENT
/begin COMPU_METHOD Compu_EGRdP " " RAT_FUNC "%.3" "psig" COEFFS 0 1024 0 0 0 1 /end COMPU_METHOD
/begin MEASUREMENT EGRT "EGRT" UWORD Compu_EGRT 0 0 -460 7731.875 ECU_ADDRESS 0x01009328 /end MEASUREMENT
/begin COMPU_METHOD Compu_EGRT " " RAT_FUNC "%.1" "deg F" COEFFS 0 8 3680 0 0 1 /end COMPU_METHOD
/begin CHARACTERISTIC EGRT_ena "EGRT source{EGRT_ena&0xff=0:Disabled}{EGRT_ena&0xff=1:Aux PU1}{EGRT_ena&0xff=2:Aux PU2}{EGRT_ena&0xff=3:Aux PU3}{EGRT_ena&0xff=4:Aux PUD1}{EGRT_ena&0xff=5:Aux PUD2}{EGRT_ena&0xff=6:Aux PUD3}{EGRT_ena&0xff=7:EGT Input}{EGRT_ena&0xff=8:Aux PUD4}{EGRT_ena&0x" VALUE 0x001c0aa5 /* @ECU_Address@EGRT_ena@0x010093B0@ */ ECIPP_ALIGNMENT_UBYTE 255 EGRT_ena_COMPU_VTAB 0 255 BIT_MASK 0xff /end CHARACTERISTIC
/begin COMPU_METHOD EGRT_ena_COMPU_VTAB "Verbal Table" TAB_VERB "%.0" "list" COMPU_TAB_REF EGRT_ena_COMPU_VTAB_REF /end COMPU_METHOD
/begin COMPU_VTAB EGRT_ena_COMPU_VTAB_REF "Verbal Table" TAB_VERB 31 0 "Disabled" 1 "Aux PU1" 2 "Aux PU2" 3 "Aux PU3" 4 "Aux PUD1" 5 "Aux PUD2" 6 "Aux PUD3" 7 "EGT Input" 8 "Aux PUD4" 9 "Aux PUD5" 10 "Aux PUD6" 11 "Aux PUD7" 12 "Aux PUD8" 13 "Aux PUD9" 14 "Aux PUD10" 15 "Aux PUD11" 16 "Aux PUD12" 17 "Aux PUD13" 18 "Aux PUD14" 19 "Aux PUD15" 20 "Aux PUD16" 21 "Aux PUD17" 22 "Aux PUD18" 23 "Aux PUD19" 24 "Aux PUD20" 25 "Aux PUD21" 26 "Aux PUD22" 27 "Aux PUD23" 28 "Aux PUD24" 29 "Aux PUD25" 30 "CAN sourced" DEFAULT_VALUE "UNKNOWN" /end COMPU_VTAB
/begin CHARACTERISTIC EGRdP_ena "EGR delta-P sensor{EGRdP_ena&0xff=0:Disabled}{EGRdP_ena&0xff=1:Aux PD1}{EGRdP_ena&0xff=2:Aux PD2}{EGRdP_ena&0xff=3:Aux PD3}{EGRdP_ena&0xff=4:Aux PUD1}{EGRdP_ena&0xff=5:Aux PUD2}{EGRdP_ena&0xff=6:Aux PUD3}{EGRdP_ena&0xff=7:Aux PUD4}{EGRdP_ena&0xff=8:Aux PU" VALUE 0x001c0ab6 /* @ECU_Address@EGRdP_ena@0x01009410@ */ ECIPP_ALIGNMENT_UBYTE 255 EGRdP_ena_COMPU_VTAB 0 255 BIT_MASK 0xff /end CHARACTERISTIC
/begin COMPU_METHOD EGRdP_ena_COMPU_VTAB "Verbal Table" TAB_VERB "%.0" "list" COMPU_TAB_REF EGRdP_ena_COMPU_VTAB_REF /end COMPU_METHOD
/begin COMPU_VTAB EGRdP_ena_COMPU_VTAB_REF "Verbal Table" TAB_VERB 31 0 "Disabled" 1 "Aux PD1" 2 "Aux PD2" 3 "Aux PD3" 4 "Aux PUD1" 5 "Aux PUD2" 6 "Aux PUD3" 7 "Aux PUD4" 8 "Aux PUD5" 9 "Aux PUD6" 10 "Aux PUD7" 11 "Aux PUD8" 12 "Aux PUD9" 13 "Aux PUD10" 14 "Aux PUD11" 15 "Aux PUD12" 16 "Aux PUD13" 17 "Aux PUD14" 18 "Aux PUD15" 19 "CAN sourced" 20 "FPP2 Input" 21 "Aux PUD16" 22 "Aux PUD17" 23 "Aux PUD18" 24 "Aux PUD19" 25 "Aux PUD20" 26 "Aux PUD21" 27 "Aux PUD22" 28 "Aux PUD23" 29 "Aux PUD24" 30 "Aux PUD25" DEFAULT_VALUE "UNKNOWN" /end COMPU_VTAB
/begin CHARACTERISTIC EGR_channel "EGR output channel{EGR_channel&0xff=0:Disabled}{EGR_channel&0xff=1:H-bridge A}{EGR_channel&0xff=2:H-bridge B}{EGR_channel&0xff=3:Aux PWM1}{EGR_channel&0xff=4:Aux PWM2}{EGR_channel&0xff=5:Aux PWM3}{EGR_channel&0xff=6:Aux PWM4}{EGR_channel&0xff=7:Aux PWM5}{" VALUE 0x001c0aa7 /* @ECU_Address@EGR_channel@0x01009420@ */ ECIPP_ALIGNMENT_UBYTE 255 EGR_channel_COMPU_VTAB 0 255 BIT_MASK 0xff /end CHARACTERISTIC
/begin COMPU_METHOD EGR_channel_COMPU_VTAB "Verbal Table" TAB_VERB "%.0" "list" COMPU_TAB_REF EGR_channel_COMPU_VTAB_REF /end COMPU_METHOD
/begin COMPU_VTAB EGR_channel_COMPU_VTAB_REF "Verbal Table" TAB_VERB 27 0 "Disabled" 1 "H-bridge A" 2 "H-bridge B" 3 "Aux PWM1" 4 "Aux PWM2" 5 "Aux PWM3" 6 "Aux PWM4" 7 "Aux PWM5" 8 "Aux PWM6" 9 "Aux PWM7" 10 "Aux PWM8" 11 "Aux PWM9" 12 "Aux PWM10" 13 "Aux PWM11" 14 "Aux PWM12" 15 "Aux PWM13" 16 "Aux PWM14" 17 "Aux PWM15" 18 "Aux PWM16" 19 "Aux PWM17" 20 "Aux PWM18" 21 "Aux PWM19" 22 "Aux PWM20" 23 "Aux PWM21" 24 "Aux PWM22" 25 "Aux PWM23" 26 "CAN based" DEFAULT_VALUE "UNKNOWN" /end COMPU_VTAB
/begin CHARACTERISTIC EGR_min_DC "EGR min position / DC" VALUE 0x001c09ae /* @ECU_Address@EGR_min_DC@0x01009430@ */ ECIPP_ALIGNMENT_UWORD 100 Compu_EGR_min_DC 0 99.9984741210938 /end CHARACTERISTIC
/begin COMPU_METHOD Compu_EGR_min_DC " " RAT_FUNC "%.1" "%" COEFFS 0 655.36 0 0 0 1 /end COMPU_METHOD
/begin CHARACTERISTIC EGR_max_DC "EGR max position / DC" VALUE 0x001c09ac /* @ECU_Address@EGR_max_DC@0x01009438@ */ ECIPP_ALIGNMENT_UWORD 100 Compu_EGR_max_DC 0 99.9984741210938 /end CHARACTERISTIC
/begin COMPU_METHOD Compu_EGR_max_DC " " RAT_FUNC "%.1" "%" COEFFS 0 655.36 0 0 0 1 /end COMPU_METHOD
/begin MEASUREMENT m_d_pct_cmd "Diluent mass fraction cmd" UWORD Compu_m_d_pct_cmd 0 0 0 399.993896484375 ECU_ADDRESS 0x010098A0 /end MEASUREMENT
/begin COMPU_METHOD Compu_m_d_pct_cmd " " RAT_FUNC "%.1" "%" COEFFS 0 163.84 0 0 0 1 /end COMPU_METHOD
/begin MEASUREMENT EGR_vlv_cmd "EGR valve command" UWORD Compu_EGR_vlv_cmd 0 0 0 99.9984741210938 ECU_ADDRESS 0x01009FA8 /end MEASUREMENT
/begin COMPU_METHOD Compu_EGR_vlv_cmd " " RAT_FUNC "%.1" "%" COEFFS 0 655.36 0 0 0 1 /end COMPU_METHOD
/begin MEASUREMENT EGR_ctl_status "EGR control status{EGR_ctl_status&0xff=0:Disabled}{EGR_ctl_status&0xff=1:Inactive: run time}{EGR_ctl_status&0xff=2:Inactive: ECT low}{EGR_ctl_status&0xff=3:Inactive: ECT high}{EGR_ctl_status&0xff=4:Inactive: IAT low}{EGR_ctl_status&0xff=5:Inactive: IAT hi" UBYTE EGR_ctl_status_COMPU_VTAB 0 0 0 255 ECU_ADDRESS 0x0100A140 BIT_MASK 0xff /end MEASUREMENT
/begin COMPU_METHOD EGR_ctl_status_COMPU_VTAB "Verbal Table" TAB_VERB "%.0" "list" COMPU_TAB_REF EGR_ctl_status_COMPU_VTAB_REF /end COMPU_METHOD
/begin COMPU_VTAB EGR_ctl_status_COMPU_VTAB_REF "Verbal Table" TAB_VERB 7 0 "Disabled" 1 "Inactive: run time" 2 "Inactive: ECT low" 3 "Inactive: ECT high" 4 "Inactive: IAT low" 5 "Inactive: IAT high" 6 "Active" DEFAULT_VALUE "UNKNOWN" /end COMPU_VTAB
/begin MEASUREMENT EGR_vlv_act "EGR valve measured position" UWORD Compu_EGR_vlv_act 0 0 0 99.9984741210938 ECU_ADDRESS 0x0100A160 /end MEASUREMENT
/begin COMPU_METHOD Compu_EGR_vlv_act " " RAT_FUNC "%.1" "%" COEFFS 0 655.36 0 0 0 1 /end COMPU_METHOD
/begin CHARACTERISTIC EGRad_mdot_min "EGR CL adaptive min EGR flow" VALUE 0x001c09e0 /* @ECU_Address@EGRad_mdot_min@0x0100A180@ */ ECIPP_ALIGNMENT_UWORD 1024 Compu_EGRad_mdot_min 0 1023.984375 /end CHARACTERISTIC
/begin COMPU_METHOD Compu_EGRad_mdot_min " " RAT_FUNC "%.2" "g/sec" COEFFS 0 64 0 0 0 1 /end COMPU_METHOD
/begin CHARACTERISTIC EGRad_MAF_min "EGR CL adaptive min MAF flow" VALUE 0x001c09cc /* @ECU_Address@EGRad_MAF_min@0x0100A188@ */ ECIPP_ALIGNMENT_UWORD 1024 Compu_EGRad_MAF_min 0 1023.984375 /end CHARACTERISTIC
/begin COMPU_METHOD Compu_EGRad_MAF_min " " RAT_FUNC "%.2" "g/sec" COEFFS 0 64 0 0 0 1 /end COMPU_METHOD
/begin MEASUREMENT EGRLP_float "EGR valve outlet pressure" FLOAT32_IEEE Compu_EGRLP_float 0 0 -10000000000 10000000000 ECU_ADDRESS 0x0100A190 /end MEASUREMENT
/begin COMPU_METHOD Compu_EGRLP_float " " RAT_FUNC "%.2" "psia" COEFFS 0 1 0 0 0 1 /end COMPU_METHOD
/begin MEASUREMENT EGR_vlv_min_dP "EGR valve minimum delta-P" SWORD Compu_EGR_vlv_min_dP 0 0 -128 127.99609375 ECU_ADDRESS 0x0100A228 /end MEASUREMENT
/begin COMPU_METHOD Compu_EGR_vlv_min_dP " " RAT_FUNC "%.2" "psi" COEFFS 0 256 0 0 0 1 /end COMPU_METHOD
/begin MEASUREMENT EGR_vlv_act_dP "EGR valve actual delta-P" SWORD Compu_EGR_vlv_act_dP 0 0 -128 127.99609375 ECU_ADDRESS 0x0100A230 /end MEASUREMENT
/begin COMPU_METHOD Compu_EGR_vlv_act_dP " " RAT_FUNC "%.2" "psi" COEFFS 0 256 0 0 0 1 /end COMPU_METHOD
/begin MEASUREMENT manual_EGR_mode "Manual EGR mode{manual_EGR_mode&0xff=0:Inactive}{manual_EGR_mode&0xff=1:m_d_pct_cmd}{manual_EGR_mode&0xff=2:mdot_EGR_cmd (SS)}{manual_EGR_mode&0xff=3:MAF command (SS)}{manual_EGR_mode&0xff=4:EGR_vlv_pct (SS)}{manual_EGR_mode&0xff=5:Min/Nom Split}{manual_E" UBYTE manual_EGR_mode_COMPU_VTAB 0 0 0 255 ECU_ADDRESS 0x0100A2A8 BIT_MASK 0xff /end MEASUREMENT
/begin COMPU_METHOD manual_EGR_mode_COMPU_VTAB "Verbal Table" TAB_VERB "%.0" "list" COMPU_TAB_REF manual_EGR_mode_COMPU_VTAB_REF /end COMPU_METHOD
/begin COMPU_VTAB manual_EGR_mode_COMPU_VTAB_REF "Verbal Table" TAB_VERB 7 0 "Inactive" 1 "m_d_pct_cmd" 2 "mdot_EGR_cmd (SS)" 3 "MAF command (SS)" 4 "EGR_vlv_pct (SS)" 5 "Min/Nom Split" 6 "EGR_vlv_pct" DEFAULT_VALUE "UNKNOWN" /end COMPU_VTAB
/begin MEASUREMENT manual_EGR_cmd1 "Manual EGR command 1" FLOAT32_IEEE Compu_manual_EGR_cmd1 0 0 -10000000000 10000000000 ECU_ADDRESS 0x0100A2C0 /end MEASUREMENT
/begin COMPU_METHOD Compu_manual_EGR_cmd1 " " RAT_FUNC "%.2" "-" COEFFS 0 1 0 0 0 1 /end COMPU_METHOD
/begin MEASUREMENT DIL_pct_xval "DIL_pct_xval" FLOAT32_IEEE Compu_DIL_pct_xval 0 0 -10000000000 10000000000 ECU_ADDRESS 0x0100A2D8 /end MEASUREMENT
/begin COMPU_METHOD Compu_DIL_pct_xval " " RAT_FUNC "%.1" "-" COEFFS 0 1 0 0 0 1 /end COMPU_METHOD
/begin CHARACTERISTIC EGRHP_ena "EGR valve inlet pressure sensor{EGRHP_ena&0xff=0:Disabled}{EGRHP_ena&0xff=1:Aux PD1}{EGRHP_ena&0xff=2:Aux PD2}{EGRHP_ena&0xff=3:Aux PD3}{EGRHP_ena&0xff=4:Aux PUD1}{EGRHP_ena&0xff=5:Aux PUD2}{EGRHP_ena&0xff=6:Aux PUD3}{EGRHP_ena&0xff=7:Aux PUD4}{EGRHP_ena&" VALUE 0x001c0aa1 /* @ECU_Address@EGRHP_ena@0x0100BBA0@ */ ECIPP_ALIGNMENT_UBYTE 255 EGRHP_ena_COMPU_VTAB 0 255 BIT_MASK 0xff /end CHARACTERISTIC
/begin COMPU_METHOD EGRHP_ena_COMPU_VTAB "Verbal Table" TAB_VERB "%.0" "list" COMPU_TAB_REF EGRHP_ena_COMPU_VTAB_REF /end COMPU_METHOD
/begin COMPU_VTAB EGRHP_ena_COMPU_VTAB_REF "Verbal Table" TAB_VERB 31 0 "Disabled" 1 "Aux PD1" 2 "Aux PD2" 3 "Aux PD3" 4 "Aux PUD1" 5 "Aux PUD2" 6 "Aux PUD3" 7 "Aux PUD4" 8 "Aux PUD5" 9 "Aux PUD6" 10 "Aux PUD7" 11 "Aux PUD8" 12 "Aux PUD9" 13 "Aux PUD10" 14 "Aux PUD11" 15 "Aux PUD12" 16 "Aux PUD13" 17 "Aux PUD14" 18 "Aux PUD15" 19 "CAN sourced" 20 "FPP2 Input" 21 "Aux PUD16" 22 "Aux PUD17" 23 "Aux PUD18" 24 "Aux PUD19" 25 "Aux PUD20" 26 "Aux PUD21" 27 "Aux PUD22" 28 "Aux PUD23" 29 "Aux PUD24" 30 "Aux PUD25" DEFAULT_VALUE "UNKNOWN" /end COMPU_VTAB
/begin CHARACTERISTIC EGR_vent_location "EGR venturi location{EGR_vent_location&0xff=0:None}{EGR_vent_location&0xff=1:Pre-valve}" VALUE 0x001c0ab0 /* @ECU_Address@EGR_vent_location@0x0100BBD0@ */ ECIPP_ALIGNMENT_UBYTE 255 EGR_vent_location_COMPU_VTAB 0 255 BIT_MASK 0xff /end CHARACTERISTIC
/begin COMPU_METHOD EGR_vent_location_COMPU_VTAB "Verbal Table" TAB_VERB "%.0" "list" COMPU_TAB_REF EGR_vent_location_COMPU_VTAB_REF /end COMPU_METHOD
/begin COMPU_VTAB EGR_vent_location_COMPU_VTAB_REF "Verbal Table" TAB_VERB 2 0 "None" 1 "Pre-valve" DEFAULT_VALUE "UNKNOWN" /end COMPU_VTAB
/begin CHARACTERISTIC EGR_vent_CdA "EGR venturi effective area" VALUE 0x001c09c2 /* @ECU_Address@EGR_vent_CdA@0x0100BBD8@ */ ECIPP_ALIGNMENT_UWORD 4 Compu_EGR_vent_CdA 0 3.99993896484375 /end CHARACTERISTIC
/begin COMPU_METHOD Compu_EGR_vent_CdA " " RAT_FUNC "%.3" "in^2" COEFFS 0 16384 0 0 0 1 /end COMPU_METHOD
/begin CHARACTERISTIC EGRLP_ena "EGR valve outlet pressure sensor{EGRLP_ena&0xff=0:Disabled}{EGRLP_ena&0xff=1:Aux PD1}{EGRLP_ena&0xff=2:Aux PD2}{EGRLP_ena&0xff=3:Aux PD3}{EGRLP_ena&0xff=4:Aux PUD1}{EGRLP_ena&0xff=5:Aux PUD2}{EGRLP_ena&0xff=6:Aux PUD3}{EGRLP_ena&0xff=7:Aux PUD4}{EGRLP_ena" VALUE 0x001c0aa3 /* @ECU_Address@EGRLP_ena@0x0100BC48@ */ ECIPP_ALIGNMENT_UBYTE 255 EGRLP_ena_COMPU_VTAB 0 255 BIT_MASK 0xff /end CHARACTERISTIC
/begin COMPU_METHOD EGRLP_ena_COMPU_VTAB "Verbal Table" TAB_VERB "%.0" "list" COMPU_TAB_REF EGRLP_ena_COMPU_VTAB_REF /end COMPU_METHOD
/begin COMPU_VTAB EGRLP_ena_COMPU_VTAB_REF "Verbal Table" TAB_VERB 31 0 "Disabled" 1 "Aux PD1" 2 "Aux PD2" 3 "Aux PD3" 4 "Aux PUD1" 5 "Aux PUD2" 6 "Aux PUD3" 7 "Aux PUD4" 8 "Aux PUD5" 9 "Aux PUD6" 10 "Aux PUD7" 11 "Aux PUD8" 12 "Aux PUD9" 13 "Aux PUD10" 14 "Aux PUD11" 15 "Aux PUD12" 16 "Aux PUD13" 17 "Aux PUD14" 18 "Aux PUD15" 19 "CAN sourced" 20 "FPP2 Input" 21 "Aux PUD16" 22 "Aux PUD17" 23 "Aux PUD18" 24 "Aux PUD19" 25 "Aux PUD20" 26 "Aux PUD21" 27 "Aux PUD22" 28 "Aux PUD23" 29 "Aux PUD24" 30 "Aux PUD25" DEFAULT_VALUE "UNKNOWN" /end COMPU_VTAB
/begin MEASUREMENT EGRdP_inst "EGRdP sensor instantaneous" SWORD Compu_EGRdP_inst 0 0 -32 31.9990234375 ECU_ADDRESS 0x0100BCC0 /end MEASUREMENT
/begin COMPU_METHOD Compu_EGRdP_inst " " RAT_FUNC "%.3" "psi" COEFFS 0 1024 0 0 0 1 /end COMPU_METHOD
/begin MEASUREMENT EGRdP_offset "EGRdP sensor offset" SWORD Compu_EGRdP_offset 0 0 -32 31.9990234375 ECU_ADDRESS 0x0100BCC8 /end MEASUREMENT
/begin COMPU_METHOD Compu_EGRdP_offset " " RAT_FUNC "%.3" "psi" COEFFS 0 1024 0 0 0 1 /end COMPU_METHOD
/begin MEASUREMENT EGRdP_offset_state "EGRdP offset sampling{EGRdP_offset_state&0xff=0:Disabled}{EGRdP_offset_state&0xff=1:Inactive: key-on wait}{EGRdP_offset_state&0xff=2:Inactive: ECT low}{EGRdP_offset_state&0xff=3:Inactive: dP error}{EGRdP_offset_state&0xff=4:Inactive: EGR on}{EGRdP_offset_" UBYTE EGRdP_offset_state_COMPU_VTAB 0 0 0 255 ECU_ADDRESS 0x0100BCD0 BIT_MASK 0xff /end MEASUREMENT
/begin COMPU_METHOD EGRdP_offset_state_COMPU_VTAB "Verbal Table" TAB_VERB "%.0" "list" COMPU_TAB_REF EGRdP_offset_state_COMPU_VTAB_REF /end COMPU_METHOD
/begin COMPU_VTAB EGRdP_offset_state_COMPU_VTAB_REF "Verbal Table" TAB_VERB 22 0 "Disabled" 1 "Inactive: key-on wait" 2 "Inactive: ECT low" 3 "Inactive: dP error" 4 "Inactive: EGR on" 5 "Inactive: valve open" 6 "Inactive: stabilizing" 7 "Active: sampling" 8 "Inactive: sample high" 9 "Inactive: sample low" 10 "Inactive: pulsations" 11 "Inactive: key-off" 12 "Inactive: start allowed" 13 "Inactive: key-off allowed" 14 "Inactive: key-off wait" 15 "Inactive: key-off done" 16 "Inactive: de-icing" 17 "Inactive: reset learn wait" 18 "Inactive: reset learn abort" 19 "Inactive: reset learn done" 20 "Inactive: untrusted" 21 "Inactive: valve stuck" DEFAULT_VALUE "UNKNOWN" /end COMPU_VTAB
/begin CHARACTERISTIC EGRdP_offset_learn "EGRdP offset learn{EGRdP_offset_learn&0xff=0:Disabled}{EGRdP_offset_learn&0xff=1:Enabled}{EGRdP_offset_learn&0xff=2:Start Inhibit Only}{EGRdP_offset_learn&0xff=3:Key-Off Clear Only}" VALUE 0x001c0ab7 /* @ECU_Address@EGRdP_offset_learn@0x0100BCD8@ */ ECIPP_ALIGNMENT_UBYTE 255 EGRdP_offset_learn_COMPU_VTAB 0 255 BIT_MASK 0xff /end CHARACTERISTIC
/begin COMPU_METHOD EGRdP_offset_learn_COMPU_VTAB "Verbal Table" TAB_VERB "%.0" "list" COMPU_TAB_REF EGRdP_offset_learn_COMPU_VTAB_REF /end COMPU_METHOD
/begin COMPU_VTAB EGRdP_offset_learn_COMPU_VTAB_REF "Verbal Table" TAB_VERB 4 0 "Disabled" 1 "Enabled" 2 "Start Inhibit Only" 3 "Key-Off Clear Only" DEFAULT_VALUE "UNKNOWN" /end COMPU_VTAB
/begin CHARACTERISTIC EGRdP_offset_ECT "EGRdP offset ECT min" VALUE 0x001c09ec /* @ECU_Address@EGRdP_offset_ECT@0x0100BCE0@ */ ECIPP_ALIGNMENT_UWORD 564 Compu_EGRdP_offset_ECT -460 563.984375 /end CHARACTERISTIC
/begin COMPU_METHOD Compu_EGRdP_offset_ECT " " RAT_FUNC "%.1" "deg F" COEFFS 0 64 29440 0 0 1 /end COMPU_METHOD
/begin CHARACTERISTIC EGRdP_offset_vlvmax "EGRdP offset valve max" VALUE 0x001c09f6 /* @ECU_Address@EGRdP_offset_vlvmax@0x0100BCE8@ */ ECIPP_ALIGNMENT_UWORD 100 Compu_EGRdP_offset_vlvmax 0 99.9984741210938 /end CHARACTERISTIC
/begin COMPU_METHOD Compu_EGRdP_offset_vlvmax " " RAT_FUNC "%.1" "%" COEFFS 0 655.36 0 0 0 1 /end COMPU_METHOD
/begin CHARACTERISTIC EGRdP_offset_flowwt "EGRdP offset stabilization wait" VALUE 0x001c09f0 /* @ECU_Address@EGRdP_offset_flowwt@0x0100BCF0@ */ ECIPP_ALIGNMENT_UWORD 66 Compu_EGRdP_offset_flowwt 0 65.535 /end CHARACTERISTIC
/begin COMPU_METHOD Compu_EGRdP_offset_flowwt " " RAT_FUNC "%.1" "sec" COEFFS 0 1000 0 0 0 1 /end COMPU_METHOD
/begin CHARACTERISTIC m_d_pct_cmd_tau "Diluent command low-pass" VALUE 0x001c0a9c /* @ECU_Address@m_d_pct_cmd_tau@0x0100BD10@ */ ECIPP_ALIGNMENT_UWORD 163840 Compu_m_d_pct_cmd_tau 0.16703 163840 /end CHARACTERISTIC
/begin COMPU_METHOD Compu_m_d_pct_cmd_tau " " FORM "%.0" "ms"
 /begin FORMULA "-5 / log(1.0000000000001 - (X1 / 32768))" FORMULA_INV "(1.0000000000001 - exp(-5/X1)) * 32768" /end FORMULA
/end COMPU_METHOD
/begin CHARACTERISTIC m_d_pct_cmd_dz "Diluent command deadzone" VALUE 0x001c0a76 /* @ECU_Address@m_d_pct_cmd_dz@0x0100BD18@ */ ECIPP_ALIGNMENT_UWORD 400 Compu_m_d_pct_cmd_dz 0 399.993896484375 /end CHARACTERISTIC
/begin COMPU_METHOD Compu_m_d_pct_cmd_dz " " RAT_FUNC "%.1" "%" COEFFS 0 163.84 0 0 0 1 /end COMPU_METHOD
/begin MEASUREMENT EGR_clr_dP "EGR cooler pressure loss" UWORD Compu_EGR_clr_dP 0 0 0 255.99609375 ECU_ADDRESS 0x0100BD20 /end MEASUREMENT
/begin COMPU_METHOD Compu_EGR_clr_dP " " RAT_FUNC "%.3" "psi" COEFFS 0 256 0 0 0 1 /end COMPU_METHOD
/begin CHARACTERISTIC EGRdP_offset_dPmin "EGRdP offset sample min" VALUE 0x001c02b6 /* @ECU_Address@EGRdP_offset_dPmin@0x0100BD30@ */ ECIPP_ALIGNMENT_SWORD 32 Compu_EGRdP_offset_dPmin -32 31.9990234375 /end CHARACTERISTIC
/begin COMPU_METHOD Compu_EGRdP_offset_dPmin " " RAT_FUNC "%.3" "psi" COEFFS 0 1024 0 0 0 1 /end COMPU_METHOD
/begin CHARACTERISTIC EGRdP_offset_dPmax "EGRdP offset sample max" VALUE 0x001c02b4 /* @ECU_Address@EGRdP_offset_dPmax@0x0100BD38@ */ ECIPP_ALIGNMENT_SWORD 32 Compu_EGRdP_offset_dPmax -32 31.9990234375 /end CHARACTERISTIC
/begin COMPU_METHOD Compu_EGRdP_offset_dPmax " " RAT_FUNC "%.3" "psi" COEFFS 0 1024 0 0 0 1 /end COMPU_METHOD
/begin CHARACTERISTIC EGRdP_offset_tau "EGRdP offset sampling tau" VALUE 0x001c0a90 /* @ECU_Address@EGRdP_offset_tau@0x0100BD50@ */ ECIPP_ALIGNMENT_UWORD 1638 Compu_EGRdP_offset_tau 0.0016703 1638.4 /end CHARACTERISTIC
/begin COMPU_METHOD Compu_EGRdP_offset_tau " " FORM "%.1" "sec"
 /begin FORMULA "-0.05 / log(1.0000000000001 - (X1 / 32768))" FORMULA_INV "(1.0000000000001 - exp(-0.05/X1)) * 32768" /end FORMULA
/end COMPU_METHOD
/begin MEASUREMENT EGR_FB_source "EGR measured flow source{EGR_FB_source&0xff=0:None}{EGR_FB_source&0xff=1:Venturi + dP}{EGR_FB_source&0xff=2:Valve + dP}{EGR_FB_source&0xff=3:MAF sensor}{EGR_FB_source&0xff=4:UEGO sensor}{EGR_FB_source&0xff=5:UEGO + Venturi dP}" UBYTE EGR_FB_source_COMPU_VTAB 0 0 0 255 ECU_ADDRESS 0x0100BD58 BIT_MASK 0xff /end MEASUREMENT
/begin COMPU_METHOD EGR_FB_source_COMPU_VTAB "Verbal Table" TAB_VERB "%.0" "list" COMPU_TAB_REF EGR_FB_source_COMPU_VTAB_REF /end COMPU_METHOD
/begin COMPU_VTAB EGR_FB_source_COMPU_VTAB_REF "Verbal Table" TAB_VERB 6 0 "None" 1 "Venturi + dP" 2 "Valve + dP" 3 "MAF sensor" 4 "UEGO sensor" 5 "UEGO + Venturi dP" DEFAULT_VALUE "UNKNOWN" /end COMPU_VTAB
/begin CHARACTERISTIC EGRad_ena "EGR CL adaptive area updates{EGRad_ena&0xff=0:Disabled}{EGRad_ena&0xff=1:CL Enabled}{EGRad_ena&0xff=2:CL+Adapt Enabled}" VALUE 0x001c0ab2 /* @ECU_Address@EGRad_ena@0x0100BD60@ */ ECIPP_ALIGNMENT_UBYTE 255 EGRad_ena_COMPU_VTAB 0 255 BIT_MASK 0xff /end CHARACTERISTIC
/begin COMPU_METHOD EGRad_ena_COMPU_VTAB "Verbal Table" TAB_VERB "%.0" "list" COMPU_TAB_REF EGRad_ena_COMPU_VTAB_REF /end COMPU_METHOD
/begin COMPU_VTAB EGRad_ena_COMPU_VTAB_REF "Verbal Table" TAB_VERB 3 0 "Disabled" 1 "CL Enabled" 2 "CL+Adapt Enabled" DEFAULT_VALUE "UNKNOWN" /end COMPU_VTAB
/begin MEASUREMENT EGRad_CL_status "EGR CL status{EGRad_CL_status&0xff=0:Inactive: Disabled}{EGRad_CL_status&0xff=1:Active}{EGRad_CL_status&0xff=2:Inactive: EGR off}{EGRad_CL_status&0xff=3:Inactive: Low EGR Flow}{EGRad_CL_status&0xff=4:Inactive: Low MAF Flow}{EGRad_CL_status&0xff=5:Inactive" UBYTE EGRad_CL_status_COMPU_VTAB 0 0 0 255 ECU_ADDRESS 0x0100BD68 BIT_MASK 0xff /end MEASUREMENT
/begin COMPU_METHOD EGRad_CL_status_COMPU_VTAB "Verbal Table" TAB_VERB "%.0" "list" COMPU_TAB_REF EGRad_CL_status_COMPU_VTAB_REF /end COMPU_METHOD
/begin COMPU_VTAB EGRad_CL_status_COMPU_VTAB_REF "Verbal Table" TAB_VERB 29 0 "Inactive: Disabled" 1 "Active" 2 "Inactive: EGR off" 3 "Inactive: Low EGR Flow" 4 "Inactive: Low MAF Flow" 5 "Inactive: Run Time Wait" 6 "Inactive: Min Position" 7 "Inactive: Stabilizing" 8 "Active" 9 "Active" 10 "Active" 11 "Active" 12 "Active" 13 "Active" 14 "Active" 15 "Active" 16 "Inactive: Transient" 17 "Inactive: Min Valve Lmt" 18 "Inactive: Max Valve Lmt" 19 "Inactive: PR high" 20 "Active" 21 "Inactive: Valve Slew" 22 "Inactive: FSO" 23 "Inactive: FB Source" 24 "Inactive: MAP Transient" 25 "Active" 26 "Inactive: EGR De-icing" 27 "Inactive: Valve Stuck" 28 "Inactive: EGRwrP Invalid" DEFAULT_VALUE "UNKNOWN" /end COMPU_VTAB
/begin MEASUREMENT EGRHP_float "EGRHP" FLOAT32_IEEE Compu_EGRHP_float 0 0 -10000000000 10000000000 ECU_ADDRESS 0x0100BD88 /end MEASUREMENT
/begin COMPU_METHOD Compu_EGRHP_float " " RAT_FUNC "%.2" "psia" COEFFS 0 1 0 0 0 1 /end COMPU_METHOD
/begin CHARACTERISTIC EGRad_strt_wait "EGR CL adaptive start wait" VALUE 0x001c0268 /* @ECU_Address@EGRad_strt_wait@0x0100BDB8@ */ ECIPP_ALIGNMENT_ULONG 4294967 Compu_EGRad_strt_wait 0 4294967.295 /end CHARACTERISTIC
/begin COMPU_METHOD Compu_EGRad_strt_wait " " RAT_FUNC "%.1" "sec" COEFFS 0 1000 0 0 0 1 /end COMPU_METHOD
/begin CHARACTERISTIC EGRad_adapt_dz "EGR adaptive error deadzone" VALUE 0x001c09da /* @ECU_Address@EGRad_adapt_dz@0x0100BDC0@ */ ECIPP_ALIGNMENT_UWORD 200 Compu_EGRad_adapt_dz 0 199.996948242188 /end CHARACTERISTIC
/begin COMPU_METHOD Compu_EGRad_adapt_dz " " RAT_FUNC "%.2" "% error" COEFFS 0 327.68 0 0 0 1 /end COMPU_METHOD
/begin CHARACTERISTIC EGRad_Kadapt "EGR adaptive learn gain" VALUE 0x001c09ca /* @ECU_Address@EGRad_Kadapt@0x0100BDC8@ */ ECIPP_ALIGNMENT_UWORD 1600 Compu_EGRad_Kadapt 0 1599.9755859375 /end CHARACTERISTIC
/begin COMPU_METHOD Compu_EGRad_Kadapt " " RAT_FUNC "%.1" "%/%/sec" COEFFS 0 40.96 0 0 0 1 /end COMPU_METHOD
/begin CHARACTERISTIC EGRad_adapt_lim "EGR adaptive learn +/- limit" VALUE 0x001c02a0 /* @ECU_Address@EGRad_adapt_lim@0x0100BDD0@ */ ECIPP_ALIGNMENT_SWORD 100 Compu_EGRad_adapt_lim -100 99.9969482421875 /end CHARACTERISTIC
/begin COMPU_METHOD Compu_EGRad_adapt_lim " " RAT_FUNC "%.1" "% area" COEFFS 0 327.68 0 0 0 1 /end COMPU_METHOD
/begin CHARACTERISTIC EGRad_stable_wait "EGR CL adaptive stabilization wait" VALUE 0x001c09e2 /* @ECU_Address@EGRad_stable_wait@0x0100BDE8@ */ ECIPP_ALIGNMENT_UWORD 65535 Compu_EGRad_stable_wait 0 65535 /end CHARACTERISTIC
/begin COMPU_METHOD Compu_EGRad_stable_wait " " RAT_FUNC "%.0" "ms" COEFFS 0 1 0 0 0 1 /end COMPU_METHOD
/begin MEASUREMENT EGR_PRf_pseudo "EGR valve pseudo PR" FLOAT32_IEEE Compu_EGR_PRf_pseudo 0 0 -10000000000 10000000000 ECU_ADDRESS 0x0100BE08 /end MEASUREMENT
/begin COMPU_METHOD Compu_EGR_PRf_pseudo " " RAT_FUNC "%.3" "EGRLP/EGRHP" COEFFS 0 1 0 0 0 1 /end COMPU_METHOD
/begin MEASUREMENT EGR_vent_Pin "EGR vent inlet pressure" FLOAT32_IEEE Compu_EGR_vent_Pin 0 0 -10000000000 10000000000 ECU_ADDRESS 0x0100CBE0 /end MEASUREMENT
/begin COMPU_METHOD Compu_EGR_vent_Pin " " RAT_FUNC "%.0" "psia" COEFFS 0 1 0 0 0 1 /end COMPU_METHOD
/begin MEASUREMENT mdot_mix_fill_float "Intake flow - total" FLOAT32_IEEE Compu_mdot_mix_fill_float 0 0 -10000000000 10000000000 ECU_ADDRESS 0x0100CC30 /end MEASUREMENT
/begin COMPU_METHOD Compu_mdot_mix_fill_float " " RAT_FUNC "%.1" "g/sec" COEFFS 0 1 0 0 0 1 /end COMPU_METHOD
/begin CHARACTERISTIC EGRad_TPS_min "EGR adaptive min position" VALUE 0x001c09d4 /* @ECU_Address@EGRad_TPS_min@0x0100CCD0@ */ ECIPP_ALIGNMENT_UWORD 100 Compu_EGRad_TPS_min 0 99.9984741210938 /end CHARACTERISTIC
/begin COMPU_METHOD Compu_EGRad_TPS_min " " RAT_FUNC "%.2" "%" COEFFS 0 655.36 0 0 0 1 /end COMPU_METHOD
/begin CHARACTERISTIC EGRad_adapt_valid "EGR adaptive error valid" VALUE 0x001c09dc /* @ECU_Address@EGRad_adapt_valid@0x0100CCF0@ */ ECIPP_ALIGNMENT_UWORD 200 Compu_EGRad_adapt_valid 0 199.996948242188 /end CHARACTERISTIC
/begin COMPU_METHOD Compu_EGRad_adapt_valid " " RAT_FUNC "%.2" "%" COEFFS 0 327.68 0 0 0 1 /end COMPU_METHOD
/begin MEASUREMENT EGRad_CL_pct "EGR CL correction" FLOAT32_IEEE Compu_EGRad_CL_pct 0 0 -10000000000 10000000000 ECU_ADDRESS 0x0100CCF8 /end MEASUREMENT
/begin COMPU_METHOD Compu_EGRad_CL_pct " " RAT_FUNC "%.1" "%" COEFFS 0 0.01 0 0 0 1 /end COMPU_METHOD
/begin CHARACTERISTIC EGRad_adapt_wait "EGR adaptive stabilization wait" VALUE 0x001c09de /* @ECU_Address@EGRad_adapt_wait@0x0100CD00@ */ ECIPP_ALIGNMENT_UWORD 65535 Compu_EGRad_adapt_wait 0 65535 /end CHARACTERISTIC
/begin COMPU_METHOD Compu_EGRad_adapt_wait " " RAT_FUNC "%.0" "ms" COEFFS 0 1 0 0 0 1 /end COMPU_METHOD
/begin MEASUREMENT EGRad_adapt_status "EGR adaptive area status{EGRad_adapt_status&0xff=0:Inactive: Disabled}{EGRad_adapt_status&0xff=1:Active}{EGRad_adapt_status&0xff=2:Inactive: EGR off}{EGRad_adapt_status&0xff=3:Inactive: Low EGR Flow}{EGRad_adapt_status&0xff=4:Inactive: Low MAF Flow}{EGRad" UBYTE EGRad_adapt_status_COMPU_VTAB 0 0 0 255 ECU_ADDRESS 0x0100CD08 BIT_MASK 0xff /end MEASUREMENT
/begin COMPU_METHOD EGRad_adapt_status_COMPU_VTAB "Verbal Table" TAB_VERB "%.0" "list" COMPU_TAB_REF EGRad_adapt_status_COMPU_VTAB_REF /end COMPU_METHOD
/begin COMPU_VTAB EGRad_adapt_status_COMPU_VTAB_REF "Verbal Table" TAB_VERB 29 0 "Inactive: Disabled" 1 "Active" 2 "Inactive: EGR off" 3 "Inactive: Low EGR Flow" 4 "Inactive: Low MAF Flow" 5 "Inactive: Run Time Wait" 6 "Inactive: Low Position" 7 "Inactive: Stabilizing" 8 "Inactive: PR High" 9 "Inactive: EGRLP Low" 10 "Inactive: Converging" 11 "Inactive: Stabilizing" 12 "Inactive: Deadzone" 13 "Inactive: Low EGR Flow" 14 "Inactive: Low MAF Flow" 15 "Inactive: Low Position" 16 "Inactive: EGR Transient" 17 "Inactive: Min Valve Lmt" 18 "Inactive: Max Valve Lmt" 19 "Inactive: PR high" 20 "Inactive: Disabled" 21 "Inactive: Valve Slew" 22 "Inactive: FSO" 23 "Inactive: FB Source" 24 "Inactive: MAP Transient" 25 "Inactive: Fault Active" 26 "Inactive: EGR de-icing" 27 "Inactive: Valve Stuck" 28 "Inactive: EGRwrP Invalid" DEFAULT_VALUE "UNKNOWN" /end COMPU_VTAB
/begin MEASUREMENT manual_EGR_tau "EGR manual command tau" FLOAT32_IEEE Compu_manual_EGR_tau 0 0 -10000000000 10000000000 ECU_ADDRESS 0x0100CD10 /end MEASUREMENT
/begin COMPU_METHOD Compu_manual_EGR_tau " " RAT_FUNC "%.0" "ms" COEFFS 0 1 0 0 0 1 /end COMPU_METHOD
/begin CHARACTERISTIC EGR_mindil_cmdtbl "Min diluent mass frac command{EGR_mindil_cmdtbl&0xff=0:None}{EGR_mindil_cmdtbl&0xff=1:Alternate Table}" VALUE 0x001c0aab /* @ECU_Address@EGR_mindil_cmdtbl@0x0100D2F8@ */ ECIPP_ALIGNMENT_UBYTE 255 EGR_mindil_cmdtbl_COMPU_VTAB 0 255 BIT_MASK 0xff /end CHARACTERISTIC
/begin COMPU_METHOD EGR_mindil_cmdtbl_COMPU_VTAB "Verbal Table" TAB_VERB "%.0" "list" COMPU_TAB_REF EGR_mindil_cmdtbl_COMPU_VTAB_REF /end COMPU_METHOD
/begin COMPU_VTAB EGR_mindil_cmdtbl_COMPU_VTAB_REF "Verbal Table" TAB_VERB 2 0 "None" 1 "Alternate Table" DEFAULT_VALUE "UNKNOWN" /end COMPU_VTAB
/begin CHARACTERISTIC EGR_mindil_spktbl "Min diluent spark command{EGR_mindil_spktbl&0xff=0:None}{EGR_mindil_spktbl&0xff=1:Gasoline Base}{EGR_mindil_spktbl&0xff=2:LPG Base}{EGR_mindil_spktbl&0xff=3:NG Base}" VALUE 0x001c0aac /* @ECU_Address@EGR_mindil_spktbl@0x0100D300@ */ ECIPP_ALIGNMENT_UBYTE 255 EGR_mindil_spktbl_COMPU_VTAB 0 255 BIT_MASK 0xff /end CHARACTERISTIC
/begin COMPU_METHOD EGR_mindil_spktbl_COMPU_VTAB "Verbal Table" TAB_VERB "%.0" "list" COMPU_TAB_REF EGR_mindil_spktbl_COMPU_VTAB_REF /end COMPU_METHOD
/begin COMPU_VTAB EGR_mindil_spktbl_COMPU_VTAB_REF "Verbal Table" TAB_VERB 4 0 "None" 1 "Gasoline Base" 2 "LPG Base" 3 "NG Base" DEFAULT_VALUE "UNKNOWN" /end COMPU_VTAB
/begin MEASUREMENT m_d_pct_reqmin "Min diluent command request" UWORD Compu_m_d_pct_reqmin 0 0 0 399.993896484375 ECU_ADDRESS 0x0100D308 /end MEASUREMENT
/begin COMPU_METHOD Compu_m_d_pct_reqmin " " RAT_FUNC "%.1" "%" COEFFS 0 163.84 0 0 0 1 /end COMPU_METHOD
/begin MEASUREMENT m_d_pct_min "Min diluent command" UWORD Compu_m_d_pct_min 0 0 0 399.993896484375 ECU_ADDRESS 0x0100D310 /end MEASUREMENT
/begin COMPU_METHOD Compu_m_d_pct_min " " RAT_FUNC "%.1" "%" COEFFS 0 163.84 0 0 0 1 /end COMPU_METHOD
/begin MEASUREMENT m_d_pct_nom "Nom diluent command" UWORD Compu_m_d_pct_nom 0 0 0 399.993896484375 ECU_ADDRESS 0x0100D318 /end MEASUREMENT
/begin COMPU_METHOD Compu_m_d_pct_nom " " RAT_FUNC "%.1" "%" COEFFS 0 163.84 0 0 0 1 /end COMPU_METHOD
/begin MEASUREMENT EGR_minnom_frac "Minimum/nominal command split" FLOAT32_IEEE Compu_EGR_minnom_frac 0 0 -10000000000 10000000000 ECU_ADDRESS 0x0100D320 /end MEASUREMENT
/begin COMPU_METHOD Compu_EGR_minnom_frac " " RAT_FUNC "%.2" "-" COEFFS 0 1 0 0 0 1 /end COMPU_METHOD
/begin MEASUREMENT EGR_spkadv_min "Minimum diluent spark timing" SWORD Compu_EGR_spkadv_min 0 0 -2048 2047.9375 ECU_ADDRESS 0x0100D328 /end MEASUREMENT
/begin COMPU_METHOD Compu_EGR_spkadv_min " " RAT_FUNC "%.1" "CAD" COEFFS 0 16 0 0 0 1 /end COMPU_METHOD
/begin MEASUREMENT EGR_spkadv_nom "Nominal diluent spark timing" SWORD Compu_EGR_spkadv_nom 0 0 -2048 2047.9375 ECU_ADDRESS 0x0100D330 /end MEASUREMENT
/begin COMPU_METHOD Compu_EGR_spkadv_nom " " RAT_FUNC "%.1" "CAD" COEFFS 0 16 0 0 0 1 /end COMPU_METHOD
/begin MEASUREMENT EGR_retard "EGR spark timing offset" SWORD Compu_EGR_retard 0 0 -2048 2047.9375 ECU_ADDRESS 0x0100D348 /end MEASUREMENT
/begin COMPU_METHOD Compu_EGR_retard " " RAT_FUNC "%.1" "CAD" COEFFS 0 16 0 0 0 1 /end COMPU_METHOD
/begin CHARACTERISTIC EGRad_adapt_Amin "EGR adaptive learn +/- min A limit" VALUE 0x001c09d8 /* @ECU_Address@EGRad_adapt_Amin@0x0100D3C0@ */ ECIPP_ALIGNMENT_UWORD 64 Compu_EGRad_adapt_Amin 0 63.9990234375 /end CHARACTERISTIC
/begin COMPU_METHOD Compu_EGRad_adapt_Amin " " RAT_FUNC "%.3" "in^2" COEFFS 0 1024 0 0 0 1 /end COMPU_METHOD
/begin MEASUREMENT EGRad_CdA_in2 "EGR adaptive correction" FLOAT32_IEEE Compu_EGRad_CdA_in2 0 0 -10000000000 10000000000 ECU_ADDRESS 0x0100D3C8 /end MEASUREMENT
/begin COMPU_METHOD Compu_EGRad_CdA_in2 " " RAT_FUNC "%.3" "in^2" COEFFS 0 1 0 0 0 1 /end COMPU_METHOD
/begin MEASUREMENT m_d_pct_act "EGR measured diluent" UWORD Compu_m_d_pct_act 0 0 0 399.993896484375 ECU_ADDRESS 0x0100D3D8 /end MEASUREMENT
/begin COMPU_METHOD Compu_m_d_pct_act " " RAT_FUNC "%.1" "%" COEFFS 0 163.84 0 0 0 1 /end COMPU_METHOD
/begin CHARACTERISTIC EGRdP_offset_dPpls "EGRdP offset pulsation limit" VALUE 0x001c02b8 /* @ECU_Address@EGRdP_offset_dPpls@0x0100D3E0@ */ ECIPP_ALIGNMENT_SWORD 32 Compu_EGRdP_offset_dPpls -32 31.9990234375 /end CHARACTERISTIC
/begin COMPU_METHOD Compu_EGRdP_offset_dPpls " " RAT_FUNC "%.3" "psi" COEFFS 0 1024 0 0 0 1 /end COMPU_METHOD
/begin CHARACTERISTIC EGRdP_offset_keywt "EGRdP offset key-on wait" VALUE 0x001c09f2 /* @ECU_Address@EGRdP_offset_keywt@0x0100D3F0@ */ ECIPP_ALIGNMENT_UWORD 65535 Compu_EGRdP_offset_keywt 0 65535 /end CHARACTERISTIC
/begin COMPU_METHOD Compu_EGRdP_offset_keywt " " RAT_FUNC "%.0" "ms" COEFFS 0 1 0 0 0 1 /end COMPU_METHOD
/begin MEASUREMENT mdot_EGR_act "EGR delta-P calculated flow" SWORD Compu_mdot_EGR_act 0 0 -512 511.984375 ECU_ADDRESS 0x0100D3F8 /end MEASUREMENT
/begin COMPU_METHOD Compu_mdot_EGR_act " " RAT_FUNC "%.1" "g/sec" COEFFS 0 64 0 0 0 1 /end COMPU_METHOD
/begin CHARACTERISTIC EGRwrP_ena "EGR UEGO P sensor{EGRwrP_ena&0xff=0:Disabled}{EGRwrP_ena&0xff=1:Aux PD1}{EGRwrP_ena&0xff=2:Aux PD2}{EGRwrP_ena&0xff=3:Aux PD3}{EGRwrP_ena&0xff=4:Aux PUD1}{EGRwrP_ena&0xff=5:Aux PUD2}{EGRwrP_ena&0xff=6:Aux PUD3}{EGRwrP_ena&0xff=7:Aux PUD4}{EGRwrP_ena&0xff=" VALUE 0x001c0ab9 /* @ECU_Address@EGRwrP_ena@0x0100DDC8@ */ ECIPP_ALIGNMENT_UBYTE 255 EGRwrP_ena_COMPU_VTAB 0 255 BIT_MASK 0xff /end CHARACTERISTIC
/begin COMPU_METHOD EGRwrP_ena_COMPU_VTAB "Verbal Table" TAB_VERB "%.0" "list" COMPU_TAB_REF EGRwrP_ena_COMPU_VTAB_REF /end COMPU_METHOD
/begin COMPU_VTAB EGRwrP_ena_COMPU_VTAB_REF "Verbal Table" TAB_VERB 31 0 "Disabled" 1 "Aux PD1" 2 "Aux PD2" 3 "Aux PD3" 4 "Aux PUD1" 5 "Aux PUD2" 6 "Aux PUD3" 7 "Aux PUD4" 8 "Aux PUD5" 9 "Aux PUD6" 10 "Aux PUD7" 11 "Aux PUD8" 12 "Aux PUD9" 13 "Aux PUD10" 14 "Aux PUD11" 15 "Aux PUD12" 16 "Aux PUD13" 17 "Aux PUD14" 18 "Aux PUD15" 19 "CAN sourced" 20 "FPP2 Input" 21 "Aux PUD16" 22 "Aux PUD17" 23 "Aux PUD18" 24 "Aux PUD19" 25 "Aux PUD20" 26 "Aux PUD21" 27 "Aux PUD22" 28 "Aux PUD23" 29 "Aux PUD24" 30 "Aux PUD25" DEFAULT_VALUE "UNKNOWN" /end COMPU_VTAB
/begin MEASUREMENT EGRwrP_float "EGR UEGO P" FLOAT32_IEEE Compu_EGRwrP_float 0 0 -10000000000 10000000000 ECU_ADDRESS 0x0100DDE8 /end MEASUREMENT
/begin COMPU_METHOD Compu_EGRwrP_float " " RAT_FUNC "%.2" "psia" COEFFS 0 1 0 0 0 1 /end COMPU_METHOD
/begin CHARACTERISTIC EGRwr_flowctl_dPint "EGR UEGO flow to intake:       MAP >= BP +" VALUE 0x001c02c2 /* @ECU_Address@EGRwr_flowctl_dPint@0x0100DDF0@ */ ECIPP_ALIGNMENT_SWORD 128 Compu_EGRwr_flowctl_dPint -128 127.99609375 /end CHARACTERISTIC
/begin COMPU_METHOD Compu_EGRwr_flowctl_dPint " " RAT_FUNC "%.2" "psi" COEFFS 0 256 0 0 0 1 /end COMPU_METHOD
/begin CHARACTERISTIC EGRwr_flowctl_dPmix "EGR UEGO flow to fuel mixer: MAP <= BP +" VALUE 0x001c02c4 /* @ECU_Address@EGRwr_flowctl_dPmix@0x0100DDF8@ */ ECIPP_ALIGNMENT_SWORD 128 Compu_EGRwr_flowctl_dPmix -128 127.99609375 /end CHARACTERISTIC
/begin COMPU_METHOD Compu_EGRwr_flowctl_dPmix " " RAT_FUNC "%.2" "psi" COEFFS 0 256 0 0 0 1 /end COMPU_METHOD
/begin CHARACTERISTIC EGRwr_flowctl_dPdft "EGR UEGO drift cal allowed:  MAP <= BP -" VALUE 0x001c02c0 /* @ECU_Address@EGRwr_flowctl_dPdft@0x0100DE08@ */ ECIPP_ALIGNMENT_SWORD 128 Compu_EGRwr_flowctl_dPdft -128 127.99609375 /end CHARACTERISTIC
/begin COMPU_METHOD Compu_EGRwr_flowctl_dPdft " " RAT_FUNC "%.2" "psi" COEFFS 0 256 0 0 0 1 /end COMPU_METHOD
/begin MEASUREMENT mdot_EGR_MAF "EGR measured flow - MAF" SWORD Compu_mdot_EGR_MAF 0 0 -512 511.984375 ECU_ADDRESS 0x0100DE10 /end MEASUREMENT
/begin COMPU_METHOD Compu_mdot_EGR_MAF " " RAT_FUNC "%.2" "g/sec" COEFFS 0 64 0 0 0 1 /end COMPU_METHOD
/begin MEASUREMENT mdot_EGR_dP "EGR measured flow - dP" SWORD Compu_mdot_EGR_dP 0 0 -512 511.984375 ECU_ADDRESS 0x0100DE18 /end MEASUREMENT
/begin COMPU_METHOD Compu_mdot_EGR_dP " " RAT_FUNC "%.2" "g/sec" COEFFS 0 64 0 0 0 1 /end COMPU_METHOD
/begin MEASUREMENT mdot_EGR_UEGO "EGR measured flow - UEGO" SWORD Compu_mdot_EGR_UEGO 0 0 -512 511.984375 ECU_ADDRESS 0x0100DE20 /end MEASUREMENT
/begin COMPU_METHOD Compu_mdot_EGR_UEGO " " RAT_FUNC "%.2" "g/sec" COEFFS 0 64 0 0 0 1 /end COMPU_METHOD
/begin MEASUREMENT m_d_pct_MAF "EGR measured diluent - MAF" UWORD Compu_m_d_pct_MAF 0 0 0 399.993896484375 ECU_ADDRESS 0x0100DE28 /end MEASUREMENT
/begin COMPU_METHOD Compu_m_d_pct_MAF " " RAT_FUNC "%.1" "%" COEFFS 0 163.84 0 0 0 1 /end COMPU_METHOD
/begin MEASUREMENT m_d_pct_dP "EGR measured diluent - dP" UWORD Compu_m_d_pct_dP 0 0 0 399.993896484375 ECU_ADDRESS 0x0100DE30 /end MEASUREMENT
/begin COMPU_METHOD Compu_m_d_pct_dP " " RAT_FUNC "%.1" "%" COEFFS 0 163.84 0 0 0 1 /end COMPU_METHOD
/begin MEASUREMENT m_d_pct_UEGO "EGR measured diluent - UEGO" UWORD Compu_m_d_pct_UEGO 0 0 0 399.993896484375 ECU_ADDRESS 0x0100DE38 /end MEASUREMENT
/begin COMPU_METHOD Compu_m_d_pct_UEGO " " RAT_FUNC "%.1" "%" COEFFS 0 163.84 0 0 0 1 /end COMPU_METHOD
/begin MEASUREMENT EGR_FB_status_MAF "EGR FB status - MAF{EGR_FB_status_MAF&0xff=0:Disabled}{EGR_FB_status_MAF&0xff=1:Inactive - Fault}{EGR_FB_status_MAF&0xff=2:Inactive - Oper Cond}{EGR_FB_status_MAF&0xff=3:Inactive - 3}{EGR_FB_status_MAF&0xff=4:Inactive - 4}{EGR_FB_status_MAF&0xff=5:Inactiv" UBYTE EGR_FB_status_MAF_COMPU_VTAB 0 0 0 255 ECU_ADDRESS 0x0100DEA8 BIT_MASK 0xff /end MEASUREMENT
/begin COMPU_METHOD EGR_FB_status_MAF_COMPU_VTAB "Verbal Table" TAB_VERB "%.0" "list" COMPU_TAB_REF EGR_FB_status_MAF_COMPU_VTAB_REF /end COMPU_METHOD
/begin COMPU_VTAB EGR_FB_status_MAF_COMPU_VTAB_REF "Verbal Table" TAB_VERB 8 0 "Disabled" 1 "Inactive - Fault" 2 "Inactive - Oper Cond" 3 "Inactive - 3" 4 "Inactive - 4" 5 "Inactive - 5" 6 "Inactive - 6" 7 "Active" DEFAULT_VALUE "UNKNOWN" /end COMPU_VTAB
/begin MEASUREMENT EGR_FB_status_dP "EGR FB status - dP{EGR_FB_status_dP&0xff=0:Disabled}{EGR_FB_status_dP&0xff=1:Inactive - Fault}{EGR_FB_status_dP&0xff=2:Inactive - Oper Cond}{EGR_FB_status_dP&0xff=3:Inactive - 3}{EGR_FB_status_dP&0xff=4:Inactive - 4}{EGR_FB_status_dP&0xff=5:Inactive - 5}{" UBYTE EGR_FB_status_dP_COMPU_VTAB 0 0 0 255 ECU_ADDRESS 0x0100DEB0 BIT_MASK 0xff /end MEASUREMENT
/begin COMPU_METHOD EGR_FB_status_dP_COMPU_VTAB "Verbal Table" TAB_VERB "%.0" "list" COMPU_TAB_REF EGR_FB_status_dP_COMPU_VTAB_REF /end COMPU_METHOD
/begin COMPU_VTAB EGR_FB_status_dP_COMPU_VTAB_REF "Verbal Table" TAB_VERB 8 0 "Disabled" 1 "Inactive - Fault" 2 "Inactive - Oper Cond" 3 "Inactive - 3" 4 "Inactive - 4" 5 "Inactive - 5" 6 "Inactive - 6" 7 "Active" DEFAULT_VALUE "UNKNOWN" /end COMPU_VTAB
/begin MEASUREMENT EGR_FB_status_UEGO "EGR FB status - UEGO{EGR_FB_status_UEGO&0xff=0:Disabled}{EGR_FB_status_UEGO&0xff=1:Inactive - Fault}{EGR_FB_status_UEGO&0xff=2:Inactive - Oper Cond}{EGR_FB_status_UEGO&0xff=3:Inactive - 3}{EGR_FB_status_UEGO&0xff=4:Inactive - 4}{EGR_FB_status_UEGO&0xff=5:" UBYTE EGR_FB_status_UEGO_COMPU_VTAB 0 0 0 255 ECU_ADDRESS 0x0100DEB8 BIT_MASK 0xff /end MEASUREMENT
/begin COMPU_METHOD EGR_FB_status_UEGO_COMPU_VTAB "Verbal Table" TAB_VERB "%.0" "list" COMPU_TAB_REF EGR_FB_status_UEGO_COMPU_VTAB_REF /end COMPU_METHOD
/begin COMPU_VTAB EGR_FB_status_UEGO_COMPU_VTAB_REF "Verbal Table" TAB_VERB 8 0 "Disabled" 1 "Inactive - Fault" 2 "Inactive - Oper Cond" 3 "Inactive - 3" 4 "Inactive - 4" 5 "Inactive - 5" 6 "Inactive - 6" 7 "Active" DEFAULT_VALUE "UNKNOWN" /end COMPU_VTAB
/begin MEASUREMENT EGRwr_drift_status "EGR drift compensation status{EGRwr_drift_status&0xff=0:Off: UEGO Inactive}{EGRwr_drift_status&0xff=1:Off: Key-Cycle Timeout}{EGRwr_drift_status&0xff=2:Off: MAP High}{EGRwr_drift_status&0xff=3:Not Allowed+Active}{EGRwr_drift_status&0xff=4:Off: FSO TPS Ope" UBYTE EGRwr_drift_status_COMPU_VTAB 0 0 0 255 ECU_ADDRESS 0x0100DEC0 BIT_MASK 0xff /end MEASUREMENT
/begin COMPU_METHOD EGRwr_drift_status_COMPU_VTAB "Verbal Table" TAB_VERB "%.0" "list" COMPU_TAB_REF EGRwr_drift_status_COMPU_VTAB_REF /end COMPU_METHOD
/begin COMPU_VTAB EGRwr_drift_status_COMPU_VTAB_REF "Verbal Table" TAB_VERB 12 0 "Off: UEGO Inactive" 1 "Off: Key-Cycle Timeout" 2 "Off: MAP High" 3 "Not Allowed+Active" 4 "Off: FSO TPS Open Req" 5 "Reserved - 5" 6 "Reserved - 6" 7 "Reserved - 7" 8 "Reserved - 8" 9 "Reserved - 9" 10 "Allowed+Inactive" 11 "Allowed+Active" DEFAULT_VALUE "UNKNOWN" /end COMPU_VTAB
/begin CHARACTERISTIC EGR_nomdil_SHref "Nom cmd reference humidity" VALUE 0x001c09b2 /* @ECU_Address@EGR_nomdil_SHref@0x0100DED8@ */ ECIPP_ALIGNMENT_UWORD 250 Compu_EGR_nomdil_SHref 0 249.996185302734 /end CHARACTERISTIC
/begin COMPU_METHOD Compu_EGR_nomdil_SHref " " RAT_FUNC "%.1" "g/kg" COEFFS 0 262.144 0 0 0 1 /end COMPU_METHOD
/begin CHARACTERISTIC EGR_mindil_SHref "Min cmd reference humidity" VALUE 0x001c09b0 /* @ECU_Address@EGR_mindil_SHref@0x0100DEE0@ */ ECIPP_ALIGNMENT_UWORD 250 Compu_EGR_mindil_SHref 0 249.996185302734 /end CHARACTERISTIC
/begin COMPU_METHOD Compu_EGR_mindil_SHref " " RAT_FUNC "%.1" "g/kg" COEFFS 0 262.144 0 0 0 1 /end COMPU_METHOD
/begin MEASUREMENT EGRad_CLadapt_assist "EGR CL/adaptive assist{EGRad_CLadapt_assist&0xff=0:Inactive}{EGRad_CLadapt_assist&0xff=1:Adapt Freeze Updates}{EGRad_CLadapt_assist&0xff=2:Adapt Freeze + Zero Crct}{EGRad_CLadapt_assist&0xff=3:Adapt Clear Tables}" UBYTE EGRad_CLadapt_assist_COMPU_VTAB 0 0 0 255 ECU_ADDRESS 0x0100DF20 BIT_MASK 0xff /end MEASUREMENT
/begin COMPU_METHOD EGRad_CLadapt_assist_COMPU_VTAB "Verbal Table" TAB_VERB "%.0" "list" COMPU_TAB_REF EGRad_CLadapt_assist_COMPU_VTAB_REF /end COMPU_METHOD
/begin COMPU_VTAB EGRad_CLadapt_assist_COMPU_VTAB_REF "Verbal Table" TAB_VERB 4 0 "Inactive" 1 "Adapt Freeze Updates" 2 "Adapt Freeze + Zero Crct" 3 "Adapt Clear Tables" DEFAULT_VALUE "UNKNOWN" /end COMPU_VTAB
/begin CHARACTERISTIC EGRwr_mdpct_mult "EGR UEGO determined EGR% mult" VALUE 0x001c00a0 /* @ECU_Address@EGRwr_mdpct_mult@0x0100DF28@ */ ECIPP_ALIGNMENT_FLOAT32_IEEE 10000000000 Compu_EGRwr_mdpct_mult -10000000000 10000000000 /end CHARACTERISTIC
/begin COMPU_METHOD Compu_EGRwr_mdpct_mult " " RAT_FUNC "%.4" "-" COEFFS 0 1 0 0 0 1 /end COMPU_METHOD
/begin CHARACTERISTIC EGR_PR_vlv_max "EGR valve PR maximum" VALUE 0x001c097c /* @ECU_Address@EGR_PR_vlv_max@0x0100DF48@ */ ECIPP_ALIGNMENT_UWORD 1 Compu_EGR_PR_vlv_max 0 0.999984741210938 /end CHARACTERISTIC
/begin COMPU_METHOD Compu_EGR_PR_vlv_max " " RAT_FUNC "%.3" "-" COEFFS 0 65536 0 0 0 1 /end COMPU_METHOD
/begin MEASUREMENT EGR_PRf_actual "EGR valve actual PR" FLOAT32_IEEE Compu_EGR_PRf_actual 0 0 -10000000000 10000000000 ECU_ADDRESS 0x0100DF58 /end MEASUREMENT
/begin COMPU_METHOD Compu_EGR_PRf_actual " " RAT_FUNC "%.3" "-" COEFFS 0 1 0 0 0 1 /end COMPU_METHOD
/begin MEASUREMENT EGR_minnom_ECT "Minimum/nominal ECT request" SWORD Compu_EGR_minnom_ECT 0 0 -2 1.99993896484375 ECU_ADDRESS 0x0100DF60 /end MEASUREMENT
/begin COMPU_METHOD Compu_EGR_minnom_ECT " " RAT_FUNC "%.2" "-" COEFFS 0 16384 0 0 0 1 /end COMPU_METHOD
/begin MEASUREMENT manual_EGR_cmd2 "EGR manual mode command 2" FLOAT32_IEEE Compu_manual_EGR_cmd2 0 0 -10000000000 10000000000 ECU_ADDRESS 0x0100DF70 /end MEASUREMENT
/begin COMPU_METHOD Compu_manual_EGR_cmd2 " " RAT_FUNC "%.2" "-" COEFFS 0 1 0 0 0 1 /end COMPU_METHOD
/begin MEASUREMENT manual_EGR_toggle "EGR manual mode toggle" UWORD Compu_manual_EGR_toggle 0 0 0 65535 ECU_ADDRESS 0x0100DF78 /end MEASUREMENT
/begin COMPU_METHOD Compu_manual_EGR_toggle " " RAT_FUNC "%.0" "ms" COEFFS 0 1 0 0 0 1 /end COMPU_METHOD
/begin MEASUREMENT manual_EGR_slct "EGR manual mode select{manual_EGR_slct&0xff=0:Command 1}{manual_EGR_slct&0xff=1:Command 2}{manual_EGR_slct&0xff=2:Toggle Command}" UBYTE manual_EGR_slct_COMPU_VTAB 0 0 0 255 ECU_ADDRESS 0x0100DF80 BIT_MASK 0xff /end MEASUREMENT
/begin COMPU_METHOD manual_EGR_slct_COMPU_VTAB "Verbal Table" TAB_VERB "%.0" "list" COMPU_TAB_REF manual_EGR_slct_COMPU_VTAB_REF /end COMPU_METHOD
/begin COMPU_VTAB manual_EGR_slct_COMPU_VTAB_REF "Verbal Table" TAB_VERB 3 0 "Command 1" 1 "Command 2" 2 "Toggle Command" DEFAULT_VALUE "UNKNOWN" /end COMPU_VTAB
/begin MEASUREMENT EGRwr_UEGO_fbpct "EGR UEGO feedback pct" UWORD Compu_EGRwr_UEGO_fbpct 0 0 0 99.9984741210938 ECU_ADDRESS 0x0100DF88 /end MEASUREMENT
/begin COMPU_METHOD Compu_EGRwr_UEGO_fbpct " " RAT_FUNC "%.1" "%" COEFFS 0 655.36 0 0 0 1 /end COMPU_METHOD
/begin CHARACTERISTIC EGR_pstvlv_V "EGR valve downstream volume" VALUE 0x001c09ba /* @ECU_Address@EGR_pstvlv_V@0x0100DFA8@ */ ECIPP_ALIGNMENT_UWORD 32 Compu_EGR_pstvlv_V 0 31.99951171875 /end CHARACTERISTIC
/begin COMPU_METHOD Compu_EGR_pstvlv_V " " RAT_FUNC "%.3" "L" COEFFS 0 2048 0 0 0 1 /end COMPU_METHOD
/begin MEASUREMENT mdot_mix_fill_TPS "Manifold filling - throttle model" FLOAT32_IEEE Compu_mdot_mix_fill_TPS 0 0 -10000000000 10000000000 ECU_ADDRESS 0x0100DFB8 /end MEASUREMENT
/begin COMPU_METHOD Compu_mdot_mix_fill_TPS " " RAT_FUNC "%.1" "g/sec" COEFFS 0 1 0 0 0 1 /end COMPU_METHOD
/begin MEASUREMENT mdot_mix_fill_EGR "Manifold filling - final" FLOAT32_IEEE Compu_mdot_mix_fill_EGR 0 0 -10000000000 10000000000 ECU_ADDRESS 0x0100DFC0 /end MEASUREMENT
/begin COMPU_METHOD Compu_mdot_mix_fill_EGR " " RAT_FUNC "%.1" "g/sec" COEFFS 0 1 0 0 0 1 /end COMPU_METHOD
/begin MEASUREMENT mdot_mix_EGR "Total mixture flow for EGR calcs" FLOAT32_IEEE Compu_mdot_mix_EGR 0 0 -10000000000 10000000000 ECU_ADDRESS 0x0100DFC8 /end MEASUREMENT
/begin COMPU_METHOD Compu_mdot_mix_EGR " " RAT_FUNC "%.1" "g/sec" COEFFS 0 1 0 0 0 1 /end COMPU_METHOD
/begin MEASUREMENT mdot_EGR_VdP "EGR post-volume dm/dt" FLOAT32_IEEE Compu_mdot_EGR_VdP 0 0 -10000000000 10000000000 ECU_ADDRESS 0x0100DFD0 /end MEASUREMENT
/begin COMPU_METHOD Compu_mdot_EGR_VdP " " RAT_FUNC "%.2" "g/sec" COEFFS 0 1 0 0 0 1 /end COMPU_METHOD
/begin CHARACTERISTIC EFMA_map_dP_C "EFMA to MAP delta-P scaling" VALUE 0x001c002c /* @ECU_Address@EFMA_map_dP_C@0x0100DFE0@ */ ECIPP_ALIGNMENT_FLOAT32_IEEE 10000000000 Compu_EFMA_map_dP_C -10000000000 10000000000 /end CHARACTERISTIC
/begin COMPU_METHOD Compu_EFMA_map_dP_C " " RAT_FUNC "%.1" "upsig * s^2 / g / L" COEFFS 0 0.000001 0 0 0 1 /end COMPU_METHOD
/begin MEASUREMENT EGRad_cmdact_err "EGR command - actual difference" FLOAT32_IEEE Compu_EGRad_cmdact_err 0 0 -10000000000 10000000000 ECU_ADDRESS 0x0100DFF8 /end MEASUREMENT
/begin COMPU_METHOD Compu_EGRad_cmdact_err " " RAT_FUNC "%.2" "%" COEFFS 0 0.01 0 0 0 1 /end COMPU_METHOD
/begin CHARACTERISTIC EGRwrP_tau "EGR UEGO P low-pass tau" VALUE 0x001c0a94 /* @ECU_Address@EGRwrP_tau@0x0100E058@ */ ECIPP_ALIGNMENT_UWORD 327680 Compu_EGRwrP_tau 0.45084 327680 /end CHARACTERISTIC
/begin COMPU_METHOD Compu_EGRwrP_tau " " FORM "%.1" "ms"
 /begin FORMULA "-5 / log(1 - (X1 / 65536))" FORMULA_INV "(1 - exp(-5/X1)) * 65536" /end FORMULA
/end COMPU_METHOD
/begin MEASUREMENT EGR_minnom_runwt "Min/Nom run-time wait request" SWORD Compu_EGR_minnom_runwt 0 0 -2 1.99993896484375 ECU_ADDRESS 0x0100E060 /end MEASUREMENT
/begin COMPU_METHOD Compu_EGR_minnom_runwt " " RAT_FUNC "%.2" "-" COEFFS 0 16384 0 0 0 1 /end COMPU_METHOD
/begin MEASUREMENT EGRad_CL_actlmt "EGR CL active integral/final limit" FLOAT32_IEEE Compu_EGRad_CL_actlmt 0 0 -10000000000 10000000000 ECU_ADDRESS 0x0100E088 /end MEASUREMENT
/begin COMPU_METHOD Compu_EGRad_CL_actlmt " " RAT_FUNC "%.2" "%" COEFFS 0 0.01 0 0 0 1 /end COMPU_METHOD
/begin CHARACTERISTIC EGRad_PRadapt_sw "EGR adaptive CdA to PR transition start" VALUE 0x001c09d0 /* @ECU_Address@EGRad_PRadapt_sw@0x0100E098@ */ ECIPP_ALIGNMENT_UWORD 2 Compu_EGRad_PRadapt_sw 0 1.99996948242188 /end CHARACTERISTIC
/begin COMPU_METHOD Compu_EGRad_PRadapt_sw " " RAT_FUNC "%.3" "PR" COEFFS 0 32768 0 0 0 1 /end COMPU_METHOD
/begin CHARACTERISTIC EGRad_PR_Kadapt "EGR adaptive PR learn gain" VALUE 0x001c09ce /* @ECU_Address@EGRad_PR_Kadapt@0x0100E0A0@ */ ECIPP_ALIGNMENT_UWORD 1600 Compu_EGRad_PR_Kadapt 0 1599.9755859375 /end CHARACTERISTIC
/begin COMPU_METHOD Compu_EGRad_PR_Kadapt " " RAT_FUNC "%.1" "% PR/%/sec" COEFFS 0 40.96 0 0 0 1 /end COMPU_METHOD
/begin CHARACTERISTIC EGRad_PR_adapt_lim "EGR adaptive PR learn +/- limit" VALUE 0x001c029e /* @ECU_Address@EGRad_PR_adapt_lim@0x0100E0A8@ */ ECIPP_ALIGNMENT_SWORD 200 Compu_EGRad_PR_adapt_lim -200 199.993896484375 /end CHARACTERISTIC
/begin COMPU_METHOD Compu_EGRad_PR_adapt_lim " " RAT_FUNC "%.1" "% PR" COEFFS 0 163.84 0 0 0 1 /end COMPU_METHOD
/begin MEASUREMENT EGRad_PR_adapt_crct "EGR adaptive PR correction" FLOAT32_IEEE Compu_EGRad_PR_adapt_crct 0 0 -10000000000 10000000000 ECU_ADDRESS 0x0100E0B0 /end MEASUREMENT
/begin COMPU_METHOD Compu_EGRad_PR_adapt_crct " " RAT_FUNC "%.2" "% PR" COEFFS 0 0.01 0 0 0 1 /end COMPU_METHOD
/begin CHARACTERISTIC EGR_tau_MAF_ms "EGR measured flow low-pass - MAF" VALUE 0x001c0088 /* @ECU_Address@EGR_tau_MAF_ms@0x0100E0B8@ */ ECIPP_ALIGNMENT_FLOAT32_IEEE 10000000000 Compu_EGR_tau_MAF_ms -10000000000 10000000000 /end CHARACTERISTIC
/begin COMPU_METHOD Compu_EGR_tau_MAF_ms " " RAT_FUNC "%.1" "ms" COEFFS 0 1 0 0 0 1 /end COMPU_METHOD
/begin CHARACTERISTIC EGR_tau_dP_ms "EGR measured flow low-pass - dP" VALUE 0x001c0090 /* @ECU_Address@EGR_tau_dP_ms@0x0100E0C0@ */ ECIPP_ALIGNMENT_FLOAT32_IEEE 10000000000 Compu_EGR_tau_dP_ms -10000000000 10000000000 /end CHARACTERISTIC
/begin COMPU_METHOD Compu_EGR_tau_dP_ms " " RAT_FUNC "%.1" "ms" COEFFS 0 1 0 0 0 1 /end COMPU_METHOD
/begin CHARACTERISTIC EGR_tau_UEGO_ms "EGR measured flow low-pass - UEGO" VALUE 0x001c008c /* @ECU_Address@EGR_tau_UEGO_ms@0x0100E0C8@ */ ECIPP_ALIGNMENT_FLOAT32_IEEE 10000000000 Compu_EGR_tau_UEGO_ms -10000000000 10000000000 /end CHARACTERISTIC
/begin COMPU_METHOD Compu_EGR_tau_UEGO_ms " " RAT_FUNC "%.1" "ms" COEFFS 0 1 0 0 0 1 /end COMPU_METHOD
/begin CHARACTERISTIC EGRad_PRadapt_swend "EGR adaptive CdA to PR transition end" VALUE 0x001c09d2 /* @ECU_Address@EGRad_PRadapt_swend@0x0100E2A0@ */ ECIPP_ALIGNMENT_UWORD 2 Compu_EGRad_PRadapt_swend 0 1.99996948242188 /end CHARACTERISTIC
/begin COMPU_METHOD Compu_EGRad_PRadapt_swend " " RAT_FUNC "%.3" "PR" COEFFS 0 32768 0 0 0 1 /end COMPU_METHOD
/begin CHARACTERISTIC EGR_vlv_dP_tau "EGR valve actual dP tau" VALUE 0x001c0a88 /* @ECU_Address@EGR_vlv_dP_tau@0x0100E2B8@ */ ECIPP_ALIGNMENT_UWORD 163840 Compu_EGR_vlv_dP_tau 0.16703 163840 /end CHARACTERISTIC
/begin COMPU_METHOD Compu_EGR_vlv_dP_tau " " FORM "%.0" "ms"
 /begin FORMULA "-5 / log(1.0000000000001 - (X1 / 32768))" FORMULA_INV "(1.0000000000001 - exp(-5/X1)) * 32768" /end FORMULA
/end COMPU_METHOD
/begin MEASUREMENT EGRad_PRadapt_ratio "EGR adapt CdA vs. PR adaption" FLOAT32_IEEE Compu_EGRad_PRadapt_ratio 0 0 -10000000000 10000000000 ECU_ADDRESS 0x0100E2C8 /end MEASUREMENT
/begin COMPU_METHOD Compu_EGRad_PRadapt_ratio " " RAT_FUNC "%.2" "0=CdA, 1=PR" COEFFS 0 1 0 0 0 1 /end COMPU_METHOD
/begin MEASUREMENT EGRad_cmdact_ss_err "EGR command - actual steady-state difference" FLOAT32_IEEE Compu_EGRad_cmdact_ss_err 0 0 -10000000000 10000000000 ECU_ADDRESS 0x0100E2D8 /end MEASUREMENT
/begin COMPU_METHOD Compu_EGRad_cmdact_ss_err " " RAT_FUNC "%.2" "%" COEFFS 0 0.01 0 0 0 1 /end COMPU_METHOD
/begin CHARACTERISTIC EGRad_cmdact_ss_itau "EGR CL steady-state error increasing tau" VALUE 0x001c0a8e /* @ECU_Address@EGRad_cmdact_ss_itau@0x0100E2E0@ */ ECIPP_ALIGNMENT_UWORD 327680 Compu_EGRad_cmdact_ss_itau 0.45084 327680 /end CHARACTERISTIC
/begin COMPU_METHOD Compu_EGRad_cmdact_ss_itau " " FORM "%.0" "ms"
 /begin FORMULA "-5 / log(1 - (X1 / 65536))" FORMULA_INV "(1 - exp(-5/X1)) * 65536" /end FORMULA
/end COMPU_METHOD
/begin CHARACTERISTIC EGRad_cmdact_ss_dtau "EGR CL steady-state error decreasing tau" VALUE 0x001c0a8c /* @ECU_Address@EGRad_cmdact_ss_dtau@0x0100E2E8@ */ ECIPP_ALIGNMENT_UWORD 327680 Compu_EGRad_cmdact_ss_dtau 0.45084 327680 /end CHARACTERISTIC
/begin COMPU_METHOD Compu_EGRad_cmdact_ss_dtau " " FORM "%.0" "ms"
 /begin FORMULA "-5 / log(1 - (X1 / 65536))" FORMULA_INV "(1 - exp(-5/X1)) * 65536" /end FORMULA
/end COMPU_METHOD
/begin CHARACTERISTIC EGR_spkextrap_amin "Extrapolated spark adv min sensitivity" VALUE 0x001c0296 /* @ECU_Address@EGR_spkextrap_amin@0x0100E2F0@ */ ECIPP_ALIGNMENT_SWORD 41 Compu_EGR_spkextrap_amin -40.96 40.95875 /end CHARACTERISTIC
/begin COMPU_METHOD Compu_EGR_spkextrap_amin " " RAT_FUNC "%.1" "CAD/% dil" COEFFS 0 800 0 0 0 1 /end COMPU_METHOD
/begin CHARACTERISTIC EGR_spkextrap_amax "Extrapolated spark adv max slope" VALUE 0x001c0294 /* @ECU_Address@EGR_spkextrap_amax@0x0100E2F8@ */ ECIPP_ALIGNMENT_SWORD 41 Compu_EGR_spkextrap_amax -40.96 40.95875 /end CHARACTERISTIC
/begin COMPU_METHOD Compu_EGR_spkextrap_amax " " RAT_FUNC "%.1" "CAD/% dil" COEFFS 0 800 0 0 0 1 /end COMPU_METHOD
/begin CHARACTERISTIC EGR_spkextrap_rmin "Extrapolated spark ret min sensitivity" VALUE 0x001c029c /* @ECU_Address@EGR_spkextrap_rmin@0x0100E300@ */ ECIPP_ALIGNMENT_SWORD 41 Compu_EGR_spkextrap_rmin -40.96 40.95875 /end CHARACTERISTIC
/begin COMPU_METHOD Compu_EGR_spkextrap_rmin " " RAT_FUNC "%.1" "CAD/% dil" COEFFS 0 800 0 0 0 1 /end COMPU_METHOD
/begin CHARACTERISTIC EGR_spkextrap_rmax "Extrapolated spark ret max sensitivity" VALUE 0x001c029a /* @ECU_Address@EGR_spkextrap_rmax@0x0100E308@ */ ECIPP_ALIGNMENT_SWORD 41 Compu_EGR_spkextrap_rmax -40.96 40.95875 /end CHARACTERISTIC
/begin COMPU_METHOD Compu_EGR_spkextrap_rmax " " RAT_FUNC "%.1" "CAD/% dil" COEFFS 0 800 0 0 0 1 /end COMPU_METHOD
/begin MEASUREMENT EGR_spkextrap_sens "Extrapolated spark actual sensitivity" SWORD Compu_EGR_spkextrap_sens 0 0 -40.96 40.95875 ECU_ADDRESS 0x0100E310 /end MEASUREMENT
/begin COMPU_METHOD Compu_EGR_spkextrap_sens " " RAT_FUNC "%.2" "CAD/% dil" COEFFS 0 800 0 0 0 1 /end COMPU_METHOD
/begin CHARACTERISTIC EGR_spkextrap_advlmt "Extrapolated spark advance limit" VALUE 0x001c0292 /* @ECU_Address@EGR_spkextrap_advlmt@0x0100E318@ */ ECIPP_ALIGNMENT_SWORD 2048 Compu_EGR_spkextrap_advlmt -2048 2047.9375 /end CHARACTERISTIC
/begin COMPU_METHOD Compu_EGR_spkextrap_advlmt " " RAT_FUNC "%.1" "CAD" COEFFS 0 16 0 0 0 1 /end COMPU_METHOD
/begin CHARACTERISTIC EGR_spkextrap_retlmt "Extrapolated spark retard limit" VALUE 0x001c0298 /* @ECU_Address@EGR_spkextrap_retlmt@0x0100E320@ */ ECIPP_ALIGNMENT_SWORD 2048 Compu_EGR_spkextrap_retlmt -2048 2047.9375 /end CHARACTERISTIC
/begin COMPU_METHOD Compu_EGR_spkextrap_retlmt " " RAT_FUNC "%.1" "CAD" COEFFS 0 16 0 0 0 1 /end COMPU_METHOD
/begin MEASUREMENT EGR_spkextrap_ret "Extrapolated spark retard" SWORD Compu_EGR_spkextrap_ret 0 0 -2048 2047.9375 ECU_ADDRESS 0x0100E328 /end MEASUREMENT
/begin COMPU_METHOD Compu_EGR_spkextrap_ret " " RAT_FUNC "%.1" "CAD" COEFFS 0 16 0 0 0 1 /end COMPU_METHOD
/begin MEASUREMENT m_d_pct_spk "EGR diluent @ TDC for retard" UWORD Compu_m_d_pct_spk 0 0 0 399.993896484375 ECU_ADDRESS 0x0100E358 /end MEASUREMENT
/begin COMPU_METHOD Compu_m_d_pct_spk " " RAT_FUNC "%.1" "%" COEFFS 0 163.84 0 0 0 1 /end COMPU_METHOD
/begin CHARACTERISTIC m_d_pct_cmd_OFF "Diluent command 'off' limit" VALUE 0x001c0a72 /* @ECU_Address@m_d_pct_cmd_OFF@0x0100E530@ */ ECIPP_ALIGNMENT_UWORD 400 Compu_m_d_pct_cmd_OFF 0 399.993896484375 /end CHARACTERISTIC
/begin COMPU_METHOD Compu_m_d_pct_cmd_OFF " " RAT_FUNC "%.1" "%" COEFFS 0 163.84 0 0 0 1 /end COMPU_METHOD
/begin CHARACTERISTIC m_d_pct_cmd_ON "Diluent command 'on' limit" VALUE 0x001c0a74 /* @ECU_Address@m_d_pct_cmd_ON@0x0100E538@ */ ECIPP_ALIGNMENT_UWORD 400 Compu_m_d_pct_cmd_ON 0 399.993896484375 /end CHARACTERISTIC
/begin COMPU_METHOD Compu_m_d_pct_cmd_ON " " RAT_FUNC "%.1" "%" COEFFS 0 163.84 0 0 0 1 /end COMPU_METHOD
/begin CHARACTERISTIC EGRdP_offset_strtwt "EGRdP offset start inhibit" VALUE 0x001c09f4 /* @ECU_Address@EGRdP_offset_strtwt@0x0100E548@ */ ECIPP_ALIGNMENT_UWORD 65535 Compu_EGRdP_offset_strtwt 0 65535 /end CHARACTERISTIC
/begin COMPU_METHOD Compu_EGRdP_offset_strtwt " " RAT_FUNC "%.0" "ms" COEFFS 0 1 0 0 0 1 /end COMPU_METHOD
/begin MEASUREMENT EGR_minnom_raw "Min/Nom fraction prior to slewing" FLOAT32_IEEE Compu_EGR_minnom_raw 0 0 -10000000000 10000000000 ECU_ADDRESS 0x0100E550 /end MEASUREMENT
/begin COMPU_METHOD Compu_EGR_minnom_raw " " RAT_FUNC "%.2" "-" COEFFS 0 1 0 0 0 1 /end COMPU_METHOD
/begin CHARACTERISTIC EGR_minnom_pslew "Off->Min->Nom slew rate limit" VALUE 0x001c0260 /* @ECU_Address@EGR_minnom_pslew@0x0100E558@ */ ECIPP_ALIGNMENT_FLOAT32_IEEE 10000000000 Compu_EGR_minnom_pslew -10000000000 10000000000 /end CHARACTERISTIC
/begin COMPU_METHOD Compu_EGR_minnom_pslew " " RAT_FUNC "%.3" "sec/frac" COEFFS 0 0 1 0 1000 0 /end COMPU_METHOD
/begin CHARACTERISTIC EGR_minnom_nslew "Nom->Min->Off slew rate limit" VALUE 0x001c025c /* @ECU_Address@EGR_minnom_nslew@0x0100E560@ */ ECIPP_ALIGNMENT_FLOAT32_IEEE 10000000000 Compu_EGR_minnom_nslew -10000000000 10000000000 /end CHARACTERISTIC
/begin COMPU_METHOD Compu_EGR_minnom_nslew " " RAT_FUNC "%.3" "sec/frac" COEFFS 0 0 1 0 1000 0 /end COMPU_METHOD
/begin MEASUREMENT m_d_pct_FL "Full load diluent command" UWORD Compu_m_d_pct_FL 0 0 0 399.993896484375 ECU_ADDRESS 0x0100E568 /end MEASUREMENT
/begin COMPU_METHOD Compu_m_d_pct_FL " " RAT_FUNC "%.1" "%" COEFFS 0 163.84 0 0 0 1 /end COMPU_METHOD
/begin MEASUREMENT m_d_pct_LL "Off/Min limited diluent command" UWORD Compu_m_d_pct_LL 0 0 0 399.993896484375 ECU_ADDRESS 0x0100E570 /end MEASUREMENT
/begin COMPU_METHOD Compu_m_d_pct_LL " " RAT_FUNC "%.1" "%" COEFFS 0 163.84 0 0 0 1 /end COMPU_METHOD
/begin MEASUREMENT EGR_MAPload_LL "Off/Min limited MAP load" UWORD Compu_EGR_MAPload_LL 0 0 0 255.99609375 ECU_ADDRESS 0x0100E578 /end MEASUREMENT
/begin COMPU_METHOD Compu_EGR_MAPload_LL " " RAT_FUNC "%.1" "psi" COEFFS 0 256 0 0 0 1 /end COMPU_METHOD
/begin MEASUREMENT LoadLim_EGR_pct "EGR off/min load limit" UWORD Compu_LoadLim_EGR_pct 0 0 0 99.9984741210938 ECU_ADDRESS 0x0100E580 /end MEASUREMENT
/begin COMPU_METHOD Compu_LoadLim_EGR_pct " " RAT_FUNC "%.1" "%" COEFFS 0 655.36 0 0 0 1 /end COMPU_METHOD
/begin CHARACTERISTIC EFMA_fmix_dP_C "EFMA fuel mixer dP scaling" VALUE 0x001c0024 /* @ECU_Address@EFMA_fmix_dP_C@0x0100E600@ */ ECIPP_ALIGNMENT_FLOAT32_IEEE 10000000000 Compu_EFMA_fmix_dP_C -10000000000 10000000000 /end CHARACTERISTIC
/begin COMPU_METHOD Compu_EFMA_fmix_dP_C " " RAT_FUNC "%.1" "upsig * s^2 / g / L" COEFFS 0 0.000001 0 0 0 1 /end COMPU_METHOD
/begin CHARACTERISTIC EFMA_emix_dP_C "EFMA EGR mixer dP scaling" VALUE 0x001c001c /* @ECU_Address@EFMA_emix_dP_C@0x0100E608@ */ ECIPP_ALIGNMENT_FLOAT32_IEEE 10000000000 Compu_EFMA_emix_dP_C -10000000000 10000000000 /end CHARACTERISTIC
/begin COMPU_METHOD Compu_EFMA_emix_dP_C " " RAT_FUNC "%.1" "upsig * s^2 / g / L" COEFFS 0 0.000001 0 0 0 1 /end COMPU_METHOD
/begin CHARACTERISTIC EGRO_vlv_dP_C "EGRO to valve delta-P scaling" VALUE 0x001c0054 /* @ECU_Address@EGRO_vlv_dP_C@0x0100E610@ */ ECIPP_ALIGNMENT_FLOAT32_IEEE 10000000000 Compu_EGRO_vlv_dP_C -10000000000 10000000000 /end CHARACTERISTIC
/begin COMPU_METHOD Compu_EGRO_vlv_dP_C " " RAT_FUNC "%.1" "upsig * s^2 / g / L" COEFFS 0 0.000001 0 0 0 1 /end COMPU_METHOD
/begin CHARACTERISTIC EFMA_map_dP_nom "EFMA to MAP nominal dP" VALUE 0x001c0030 /* @ECU_Address@EFMA_map_dP_nom@0x0100E618@ */ ECIPP_ALIGNMENT_FLOAT32_IEEE 10000000000 Compu_EFMA_map_dP_nom -10000000000 10000000000 /end CHARACTERISTIC
/begin COMPU_METHOD Compu_EFMA_map_dP_nom " " RAT_FUNC "%.2" "psi" COEFFS 0 1 0 0 0 1 /end COMPU_METHOD
/begin CHARACTERISTIC EFMA_fmix_dP_nom "EFMA fuel mixer nominal dP" VALUE 0x001c0028 /* @ECU_Address@EFMA_fmix_dP_nom@0x0100E620@ */ ECIPP_ALIGNMENT_FLOAT32_IEEE 10000000000 Compu_EFMA_fmix_dP_nom -10000000000 10000000000 /end CHARACTERISTIC
/begin COMPU_METHOD Compu_EFMA_fmix_dP_nom " " RAT_FUNC "%.2" "psi" COEFFS 0 1 0 0 0 1 /end COMPU_METHOD
/begin CHARACTERISTIC EFMA_emix_dP_nom "EFMA EGR mixer nominal dP" VALUE 0x001c0020 /* @ECU_Address@EFMA_emix_dP_nom@0x0100E628@ */ ECIPP_ALIGNMENT_FLOAT32_IEEE 10000000000 Compu_EFMA_emix_dP_nom -10000000000 10000000000 /end CHARACTERISTIC
/begin COMPU_METHOD Compu_EFMA_emix_dP_nom " " RAT_FUNC "%.2" "psi" COEFFS 0 1 0 0 0 1 /end COMPU_METHOD
/begin CHARACTERISTIC EGRO_vlv_dP_nom "EGRO to valve nominal dP" VALUE 0x001c0058 /* @ECU_Address@EGRO_vlv_dP_nom@0x0100E630@ */ ECIPP_ALIGNMENT_FLOAT32_IEEE 10000000000 Compu_EGRO_vlv_dP_nom -10000000000 10000000000 /end CHARACTERISTIC
/begin COMPU_METHOD Compu_EGRO_vlv_dP_nom " " RAT_FUNC "%.2" "psi" COEFFS 0 1 0 0 0 1 /end COMPU_METHOD
/begin CHARACTERISTIC EGR_clr_dP_nom "EGR cooler nominal dP" VALUE 0x001c007c /* @ECU_Address@EGR_clr_dP_nom@0x0100E638@ */ ECIPP_ALIGNMENT_FLOAT32_IEEE 10000000000 Compu_EGR_clr_dP_nom -10000000000 10000000000 /end CHARACTERISTIC
/begin COMPU_METHOD Compu_EGR_clr_dP_nom " " RAT_FUNC "%.2" "psi" COEFFS 0 1 0 0 0 1 /end COMPU_METHOD
/begin MEASUREMENT EFMA_map_dP "EFMA to MAP pressure drop" FLOAT32_IEEE Compu_EFMA_map_dP 0 0 -10000000000 10000000000 ECU_ADDRESS 0x0100E640 /end MEASUREMENT
/begin COMPU_METHOD Compu_EFMA_map_dP " " RAT_FUNC "%.2" "psi" COEFFS 0 1 0 0 0 1 /end COMPU_METHOD
/begin MEASUREMENT EFMA_fmix_dP "EFMA fuel mixer P drop" FLOAT32_IEEE Compu_EFMA_fmix_dP 0 0 -10000000000 10000000000 ECU_ADDRESS 0x0100E648 /end MEASUREMENT
/begin COMPU_METHOD Compu_EFMA_fmix_dP " " RAT_FUNC "%.2" "psi" COEFFS 0 1 0 0 0 1 /end COMPU_METHOD
/begin MEASUREMENT EFMA_emix_dP "EFMA EGR mixer P drop" FLOAT32_IEEE Compu_EFMA_emix_dP 0 0 -10000000000 10000000000 ECU_ADDRESS 0x0100E650 /end MEASUREMENT
/begin COMPU_METHOD Compu_EFMA_emix_dP " " RAT_FUNC "%.2" "psi" COEFFS 0 1 0 0 0 1 /end COMPU_METHOD
/begin MEASUREMENT EGRO_vlv_dP "EGRO to valve dP" FLOAT32_IEEE Compu_EGRO_vlv_dP 0 0 -10000000000 10000000000 ECU_ADDRESS 0x0100E658 /end MEASUREMENT
/begin COMPU_METHOD Compu_EGRO_vlv_dP " " RAT_FUNC "%.2" "psi" COEFFS 0 1 0 0 0 1 /end COMPU_METHOD
/begin MEASUREMENT EFMA_emix_P "EFMA EGR mixer Pout" FLOAT32_IEEE Compu_EFMA_emix_P 0 0 -10000000000 10000000000 ECU_ADDRESS 0x0100E660 /end MEASUREMENT
/begin COMPU_METHOD Compu_EFMA_emix_P " " RAT_FUNC "%.2" "psia" COEFFS 0 1 0 0 0 1 /end COMPU_METHOD
/begin MEASUREMENT EFMA_fmix_P "EFMA fuel mixer Pout" FLOAT32_IEEE Compu_EFMA_fmix_P 0 0 -10000000000 10000000000 ECU_ADDRESS 0x0100E668 /end MEASUREMENT
/begin COMPU_METHOD Compu_EFMA_fmix_P " " RAT_FUNC "%.2" "psia" COEFFS 0 1 0 0 0 1 /end COMPU_METHOD
/begin MEASUREMENT EGR_vent_Pout "EGR orifice assembly Pout" FLOAT32_IEEE Compu_EGR_vent_Pout 0 0 -10000000000 10000000000 ECU_ADDRESS 0x0100E670 /end MEASUREMENT
/begin COMPU_METHOD Compu_EGR_vent_Pout " " RAT_FUNC "%.2" "psia" COEFFS 0 1 0 0 0 1 /end COMPU_METHOD
/begin MEASUREMENT TOP "Throttle outlet pressure" UWORD Compu_TOP 0 0 0 255.99609375 ECU_ADDRESS 0x0100E678 /end MEASUREMENT
/begin COMPU_METHOD Compu_TOP " " RAT_FUNC "%.2" "psia" COEFFS 0 256 0 0 0 1 /end COMPU_METHOD
/begin CHARACTERISTIC EGR_TPSdP_Dz "EGR valve dP limiting TPSdP deadzone" VALUE 0x001c0060 /* @ECU_Address@EGR_TPSdP_Dz@0x0100E688@ */ ECIPP_ALIGNMENT_FLOAT32_IEEE 10000000000 Compu_EGR_TPSdP_Dz -10000000000 10000000000 /end CHARACTERISTIC
/begin COMPU_METHOD Compu_EGR_TPSdP_Dz " " RAT_FUNC "%.2" "psi" COEFFS 0 1 0 0 0 1 /end COMPU_METHOD
/begin CHARACTERISTIC EGR_TPSdP_limiting "EGR valve dP limiting{EGR_TPSdP_limiting&0xff=0:Disabled}{EGR_TPSdP_limiting&0xff=1:Adjust TPSdP}{EGR_TPSdP_limiting&0xff=2:Use IRV - HBA}{EGR_TPSdP_limiting&0xff=3:Use IRV - HBB}" VALUE 0x001c0aa6 /* @ECU_Address@EGR_TPSdP_limiting@0x0100E698@ */ ECIPP_ALIGNMENT_UBYTE 255 EGR_TPSdP_limiting_COMPU_VTAB 0 255 BIT_MASK 0xff /end CHARACTERISTIC
/begin COMPU_METHOD EGR_TPSdP_limiting_COMPU_VTAB "Verbal Table" TAB_VERB "%.0" "list" COMPU_TAB_REF EGR_TPSdP_limiting_COMPU_VTAB_REF /end COMPU_METHOD
/begin COMPU_VTAB EGR_TPSdP_limiting_COMPU_VTAB_REF "Verbal Table" TAB_VERB 4 0 "Disabled" 1 "Adjust TPSdP" 2 "Use IRV - HBA" 3 "Use IRV - HBB" DEFAULT_VALUE "UNKNOWN" /end COMPU_VTAB
/begin CHARACTERISTIC EGRwr_mount_type "EGR UEGO mount type{EGRwr_mount_type&0xff=0:Remote Post-Throttle}{EGRwr_mount_type&0xff=1:Direct Mount}{EGRwr_mount_type&0xff=2:Remote Pre-Intercooler}{EGRwr_mount_type&0xff=3:Remote Post-Intercooler}" VALUE 0x001c0aba /* @ECU_Address@EGRwr_mount_type@0x0100E6A0@ */ ECIPP_ALIGNMENT_UBYTE 255 EGRwr_mount_type_COMPU_VTAB 0 255 BIT_MASK 0xff /end CHARACTERISTIC
/begin COMPU_METHOD EGRwr_mount_type_COMPU_VTAB "Verbal Table" TAB_VERB "%.0" "list" COMPU_TAB_REF EGRwr_mount_type_COMPU_VTAB_REF /end COMPU_METHOD
/begin COMPU_VTAB EGRwr_mount_type_COMPU_VTAB_REF "Verbal Table" TAB_VERB 4 0 "Remote Post-Throttle" 1 "Direct Mount" 2 "Remote Pre-Intercooler" 3 "Remote Post-Intercooler" DEFAULT_VALUE "UNKNOWN" /end COMPU_VTAB
/begin MEASUREMENT m_d_pct_cmd_dly "EGR transport-delayed command" UWORD Compu_m_d_pct_cmd_dly 0 0 0 399.993896484375 ECU_ADDRESS 0x0100E848 /end MEASUREMENT
/begin COMPU_METHOD Compu_m_d_pct_cmd_dly " " RAT_FUNC "%.1" "% dil" COEFFS 0 163.84 0 0 0 1 /end COMPU_METHOD
/begin MEASUREMENT TIAT "Throttle inlet temperature" UWORD Compu_TIAT 0 0 -460 7731.875 ECU_ADDRESS 0x0100EF08 /end MEASUREMENT
/begin COMPU_METHOD Compu_TIAT " " RAT_FUNC "%.1" "deg F" COEFFS 0 8 3680 0 0 1 /end COMPU_METHOD
/begin MEASUREMENT mdot_EGR_min "EGR min table requested flow" UWORD Compu_mdot_EGR_min 0 0 0 1023.984375 ECU_ADDRESS 0x0100EFD0 /end MEASUREMENT
/begin COMPU_METHOD Compu_mdot_EGR_min " " RAT_FUNC "%.2" "g/sec" COEFFS 0 64 0 0 0 1 /end COMPU_METHOD
/begin MEASUREMENT mdot_EGR_nom "EGR nom table requested flow" UWORD Compu_mdot_EGR_nom 0 0 0 1023.984375 ECU_ADDRESS 0x0100EFD8 /end MEASUREMENT
/begin COMPU_METHOD Compu_mdot_EGR_nom " " RAT_FUNC "%.2" "g/sec" COEFFS 0 64 0 0 0 1 /end COMPU_METHOD
/begin CHARACTERISTIC EGRfb_minnom_MAF "EGR feedback based min/nom operation" VALUE 0x001c02ba /* @ECU_Address@EGRfb_minnom_MAF@0x0100F348@ */ ECIPP_ALIGNMENT_SWORD 2 Compu_EGRfb_minnom_MAF -2 1.99993896484375 /end CHARACTERISTIC
/begin COMPU_METHOD Compu_EGRfb_minnom_MAF " " RAT_FUNC "%.2" "frac" COEFFS 0 16384 0 0 0 1 /end COMPU_METHOD
/begin CHARACTERISTIC EGRfb_minnom_dP "EGR feedback based min/nom operation" VALUE 0x001c02be /* @ECU_Address@EGRfb_minnom_dP@0x0100F350@ */ ECIPP_ALIGNMENT_SWORD 2 Compu_EGRfb_minnom_dP -2 1.99993896484375 /end CHARACTERISTIC
/begin COMPU_METHOD Compu_EGRfb_minnom_dP " " RAT_FUNC "%.2" "frac" COEFFS 0 16384 0 0 0 1 /end COMPU_METHOD
/begin CHARACTERISTIC EGRfb_minnom_UEGO "EGR feedback based min/nom operation" VALUE 0x001c02bc /* @ECU_Address@EGRfb_minnom_UEGO@0x0100F358@ */ ECIPP_ALIGNMENT_SWORD 2 Compu_EGRfb_minnom_UEGO -2 1.99993896484375 /end CHARACTERISTIC
/begin COMPU_METHOD Compu_EGRfb_minnom_UEGO " " RAT_FUNC "%.2" "frac" COEFFS 0 16384 0 0 0 1 /end COMPU_METHOD
/begin CHARACTERISTIC EGRfb_LL_openloop "EGR feedback based load-limit - open-loop" VALUE 0x001c0a02 /* @ECU_Address@EGRfb_LL_openloop@0x0100F360@ */ ECIPP_ALIGNMENT_UWORD 100 Compu_EGRfb_LL_openloop 0 99.9984741210938 /end CHARACTERISTIC
/begin COMPU_METHOD Compu_EGRfb_LL_openloop " " RAT_FUNC "%.1" "%" COEFFS 0 655.36 0 0 0 1 /end COMPU_METHOD
/begin CHARACTERISTIC EGRfb_LL_MAF "EGR feedback based load-limit - MAF" VALUE 0x001c09fc /* @ECU_Address@EGRfb_LL_MAF@0x0100F368@ */ ECIPP_ALIGNMENT_UWORD 100 Compu_EGRfb_LL_MAF 0 99.9984741210938 /end CHARACTERISTIC
/begin COMPU_METHOD Compu_EGRfb_LL_MAF " " RAT_FUNC "%.1" "%" COEFFS 0 655.36 0 0 0 1 /end COMPU_METHOD
/begin CHARACTERISTIC EGRfb_LL_dP "EGR feedback based load-limit - dP" VALUE 0x001c0a00 /* @ECU_Address@EGRfb_LL_dP@0x0100F370@ */ ECIPP_ALIGNMENT_UWORD 100 Compu_EGRfb_LL_dP 0 99.9984741210938 /end CHARACTERISTIC
/begin COMPU_METHOD Compu_EGRfb_LL_dP " " RAT_FUNC "%.1" "%" COEFFS 0 655.36 0 0 0 1 /end COMPU_METHOD
/begin CHARACTERISTIC EGRfb_LL_UEGO "EGR feedback based load-limit - UEGO" VALUE 0x001c09fe /* @ECU_Address@EGRfb_LL_UEGO@0x0100F378@ */ ECIPP_ALIGNMENT_UWORD 100 Compu_EGRfb_LL_UEGO 0 99.9984741210938 /end CHARACTERISTIC
/begin COMPU_METHOD Compu_EGRfb_LL_UEGO " " RAT_FUNC "%.1" "%" COEFFS 0 655.36 0 0 0 1 /end COMPU_METHOD
/begin MEASUREMENT m_d_pct_cmdmdl "EGR diluent modeled - command" SWORD Compu_m_d_pct_cmdmdl 0 0 -200 199.993896484375 ECU_ADDRESS 0x0100F380 /end MEASUREMENT
/begin COMPU_METHOD Compu_m_d_pct_cmdmdl " " RAT_FUNC "%.1" "%" COEFFS 0 163.84 0 0 0 1 /end COMPU_METHOD
/begin MEASUREMENT EGR_minnom_derate "Min/Nom derate request" SWORD Compu_EGR_minnom_derate 0 0 -2 1.99993896484375 ECU_ADDRESS 0x0100F388 /end MEASUREMENT
/begin COMPU_METHOD Compu_EGR_minnom_derate " " RAT_FUNC "%.2" "-" COEFFS 0 16384 0 0 0 1 /end COMPU_METHOD
/begin MEASUREMENT EGR_minnom_FB "Min/Nom FB type request" SWORD Compu_EGR_minnom_FB 0 0 -2 1.99993896484375 ECU_ADDRESS 0x0100F390 /end MEASUREMENT
/begin COMPU_METHOD Compu_EGR_minnom_FB " " RAT_FUNC "%.2" "-" COEFFS 0 16384 0 0 0 1 /end COMPU_METHOD
/begin CHARACTERISTIC EGRwrT_ena "EGR Wide Range Temperature{EGRwrT_ena&0xff=0:Disabled}{EGRwrT_ena&0xff=1:Aux PU1}{EGRwrT_ena&0xff=2:Aux PU2}{EGRwrT_ena&0xff=3:Aux PU3}{EGRwrT_ena&0xff=4:Aux PUD1}{EGRwrT_ena&0xff=5:Aux PUD2}{EGRwrT_ena&0xff=6:Aux PUD3}{EGRwrT_ena&0xff=7:EGT Input}{EGRwrT" VALUE 0x001c86dc /* @ECU_Address@EGRwrT_ena@0x0100F918@ */ ECIPP_ALIGNMENT_UBYTE 255 EGRwrT_ena_COMPU_VTAB 0 255 BIT_MASK 0xff /end CHARACTERISTIC
/begin COMPU_METHOD EGRwrT_ena_COMPU_VTAB "Verbal Table" TAB_VERB "%.0" "list" COMPU_TAB_REF EGRwrT_ena_COMPU_VTAB_REF /end COMPU_METHOD
/begin COMPU_VTAB EGRwrT_ena_COMPU_VTAB_REF "Verbal Table" TAB_VERB 31 0 "Disabled" 1 "Aux PU1" 2 "Aux PU2" 3 "Aux PU3" 4 "Aux PUD1" 5 "Aux PUD2" 6 "Aux PUD3" 7 "EGT Input" 8 "Aux PUD4" 9 "Aux PUD5" 10 "Aux PUD6" 11 "Aux PUD7" 12 "Aux PUD8" 13 "Aux PUD9" 14 "Aux PUD10" 15 "Aux PUD11" 16 "Aux PUD12" 17 "Aux PUD13" 18 "Aux PUD14" 19 "Aux PUD15" 20 "Aux PUD16" 21 "Aux PUD17" 22 "Aux PUD18" 23 "Aux PUD19" 24 "Aux PUD20" 25 "Aux PUD21" 26 "Aux PUD22" 27 "Aux PUD23" 28 "Aux PUD24" 29 "Aux PUD25" 30 "CAN sourced" DEFAULT_VALUE "UNKNOWN" /end COMPU_VTAB
/begin MEASUREMENT EGRwrT_float "EGR UEGO T" FLOAT32_IEEE Compu_EGRwrT_float 0 0 -10000000000 10000000000 ECU_ADDRESS 0x0100F930 /end MEASUREMENT
/begin COMPU_METHOD Compu_EGRwrT_float " " RAT_FUNC "%.2" "deg F" COEFFS 0 1 460 0 0 1 /end COMPU_METHOD
/begin CHARACTERISTIC EGRwr_UEGO_slew "EGR UEGO engage slew rate" VALUE 0x001c6f04 /* @ECU_Address@EGRwr_UEGO_slew@0x010102A0@ */ ECIPP_ALIGNMENT_UWORD 20000 Compu_EGRwr_UEGO_slew 0 19999.6948242188 /end CHARACTERISTIC
/begin COMPU_METHOD Compu_EGRwr_UEGO_slew " " RAT_FUNC "%.0" "%/sec" COEFFS 0 3.2768 0 0 0 1 /end COMPU_METHOD
/begin MEASUREMENT EGR_vent_Mx_mult "EGR orifice flow correction" SWORD Compu_EGR_vent_Mx_mult 0 0 -4 3.9998779296875 ECU_ADDRESS 0x01010710 /end MEASUREMENT
/begin COMPU_METHOD Compu_EGR_vent_Mx_mult " " RAT_FUNC "%.2" "mult" COEFFS 0 8192 0 0 0 1 /end COMPU_METHOD
/begin MEASUREMENT m_d_pct_act_dry "EGR diluent actual (dry)" FLOAT32_IEEE Compu_m_d_pct_act_dry 0 0 -10000000000 10000000000 ECU_ADDRESS 0x01010718 /end MEASUREMENT
/begin COMPU_METHOD Compu_m_d_pct_act_dry " " RAT_FUNC "%.2" "%" COEFFS 0 0.01 0 0 0 1 /end COMPU_METHOD
/begin CHARACTERISTIC EGRad_CL_K "EGR CL update gain" VALUE 0x001c0098 /* @ECU_Address@EGRad_CL_K@0x01010770@ */ ECIPP_ALIGNMENT_FLOAT32_IEEE 10000000000 Compu_EGRad_CL_K -10000000000 10000000000 /end CHARACTERISTIC
/begin COMPU_METHOD Compu_EGRad_CL_K " " RAT_FUNC "%.2" "% / TD" COEFFS 0 0.01 0 0 0 1 /end COMPU_METHOD
/begin CHARACTERISTIC EGRad_CL_valid_cnt "EGR CL valid updates reqd" VALUE 0x001c0ab1 /* @ECU_Address@EGRad_CL_valid_cnt@0x01010778@ */ ECIPP_ALIGNMENT_UBYTE 255 Compu_EGRad_CL_valid_cnt 0 255 /end CHARACTERISTIC
/begin COMPU_METHOD Compu_EGRad_CL_valid_cnt " " RAT_FUNC "%.0" "updates" COEFFS 0 1 0 0 0 1 /end COMPU_METHOD
/begin CHARACTERISTIC EGRad_tran_dMAP "EGR CL disabling: MAP" VALUE 0x001c02a2 /* @ECU_Address@EGRad_tran_dMAP@0x01010780@ */ ECIPP_ALIGNMENT_SWORD 256 Compu_EGRad_tran_dMAP -256 255.9921875 /end CHARACTERISTIC
/begin COMPU_METHOD Compu_EGRad_tran_dMAP " " RAT_FUNC "%.1" "psia" COEFFS 0 128 0 0 0 1 /end COMPU_METHOD
/begin CHARACTERISTIC EGRad_tran_dmdpct "EGR CL disabling: diluent cmd" VALUE 0x001c02a4 /* @ECU_Address@EGRad_tran_dmdpct@0x01010788@ */ ECIPP_ALIGNMENT_SWORD 400 Compu_EGRad_tran_dmdpct -400 399.98779296875 /end CHARACTERISTIC
/begin COMPU_METHOD Compu_EGRad_tran_dmdpct " " RAT_FUNC "%.2" "% diluent" COEFFS 0 81.92 0 0 0 1 /end COMPU_METHOD
/begin MEASUREMENT EGRad_CL_updates "EGR CL valid updates actual" UBYTE Compu_EGRad_CL_updates 0 0 0 255 ECU_ADDRESS 0x01010790 /end MEASUREMENT
/begin COMPU_METHOD Compu_EGRad_CL_updates " " RAT_FUNC "%.0" "updates" COEFFS 0 1 0 0 0 1 /end COMPU_METHOD
/begin CHARACTERISTIC EGR_TPSdP_tau_inc "EGR TPSdP inc low-pass" VALUE 0x001c006c /* @ECU_Address@EGR_TPSdP_tau_inc@0x01010798@ */ ECIPP_ALIGNMENT_FLOAT32_IEEE 10000000000 Compu_EGR_TPSdP_tau_inc -10000000000 10000000000 /end CHARACTERISTIC
/begin COMPU_METHOD Compu_EGR_TPSdP_tau_inc " " RAT_FUNC "%.0" "ms" COEFFS 0 1 0 0 0 1 /end COMPU_METHOD
/begin CHARACTERISTIC EGR_TPSdP_tau_dec "EGR TPSdP dec low-pass" VALUE 0x001c0068 /* @ECU_Address@EGR_TPSdP_tau_dec@0x010107A0@ */ ECIPP_ALIGNMENT_FLOAT32_IEEE 10000000000 Compu_EGR_TPSdP_tau_dec -10000000000 10000000000 /end CHARACTERISTIC
/begin COMPU_METHOD Compu_EGR_TPSdP_tau_dec " " RAT_FUNC "%.1" "sec" COEFFS 0 1000 0 0 0 1 /end COMPU_METHOD
/begin CHARACTERISTIC EGR_TPSdP_Ktrans "EGR TPSdP flow cmd gain" VALUE 0x001c0064 /* @ECU_Address@EGR_TPSdP_Ktrans@0x010107A8@ */ ECIPP_ALIGNMENT_FLOAT32_IEEE 10000000000 Compu_EGR_TPSdP_Ktrans -10000000000 10000000000 /end CHARACTERISTIC
/begin COMPU_METHOD Compu_EGR_TPSdP_Ktrans " " RAT_FUNC "%.2" "psi/(g/s^2)" COEFFS 0 1 0 0 0 1 /end COMPU_METHOD
/begin CHARACTERISTIC EGR_TPSdP_max "EGR TPSdP maximum" VALUE 0x001c097e /* @ECU_Address@EGR_TPSdP_max@0x010107B0@ */ ECIPP_ALIGNMENT_UWORD 256 Compu_EGR_TPSdP_max 0 255.99609375 /end CHARACTERISTIC
/begin COMPU_METHOD Compu_EGR_TPSdP_max " " RAT_FUNC "%.2" "psi" COEFFS 0 256 0 0 0 1 /end COMPU_METHOD
/begin CHARACTERISTIC EGR_dmdot_cmd_n "EGR flow command dt window" VALUE 0x001c0aaa /* @ECU_Address@EGR_dmdot_cmd_n@0x010107B8@ */ ECIPP_ALIGNMENT_UBYTE 1275 Compu_EGR_dmdot_cmd_n 0 1275 /end CHARACTERISTIC
/begin COMPU_METHOD Compu_EGR_dmdot_cmd_n " " RAT_FUNC "%.0" "ms" COEFFS 0 0.2 0 0 0 1 /end COMPU_METHOD
/begin CHARACTERISTIC EGR_dmdot_cmd_tau "EGR flow command dt low-pass" VALUE 0x001c0a82 /* @ECU_Address@EGR_dmdot_cmd_tau@0x010107C0@ */ ECIPP_ALIGNMENT_UWORD 327680 Compu_EGR_dmdot_cmd_tau 0.45084 327680 /end CHARACTERISTIC
/begin COMPU_METHOD Compu_EGR_dmdot_cmd_tau " " FORM "%.0" "ms"
 /begin FORMULA "-5 / log(1 - (X1 / 65536))" FORMULA_INV "(1 - exp(-5/X1)) * 65536" /end FORMULA
/end COMPU_METHOD
/begin CHARACTERISTIC EGR_dmdot_cmd_dz "EGR flow command dt deadzone" VALUE 0x001c0084 /* @ECU_Address@EGR_dmdot_cmd_dz@0x010107C8@ */ ECIPP_ALIGNMENT_FLOAT32_IEEE 10000000000 Compu_EGR_dmdot_cmd_dz -10000000000 10000000000 /end CHARACTERISTIC
/begin COMPU_METHOD Compu_EGR_dmdot_cmd_dz " " RAT_FUNC "%.1" "g/sec^2" COEFFS 0 1 0 0 0 1 /end COMPU_METHOD
/begin MEASUREMENT mdot_EGR_cmd "EGR commanded flow" FLOAT32_IEEE Compu_mdot_EGR_cmd 0 0 -10000000000 10000000000 ECU_ADDRESS 0x010107D0 /end MEASUREMENT
/begin COMPU_METHOD Compu_mdot_EGR_cmd " " RAT_FUNC "%.2" "g/sec" COEFFS 0 1 0 0 0 1 /end COMPU_METHOD
/begin MEASUREMENT EGR_dmdot_cmd "EGR flow derivative" FLOAT32_IEEE Compu_EGR_dmdot_cmd 0 0 -10000000000 10000000000 ECU_ADDRESS 0x010107D8 /end MEASUREMENT
/begin COMPU_METHOD Compu_EGR_dmdot_cmd " " RAT_FUNC "%.1" "g/sec^2" COEFFS 0 1 0 0 0 1 /end COMPU_METHOD
/begin CHARACTERISTIC EGRad_CL_Dz "EGR CL deadzone" VALUE 0x001c0094 /* @ECU_Address@EGRad_CL_Dz@0x010107E0@ */ ECIPP_ALIGNMENT_FLOAT32_IEEE 10000000000 Compu_EGRad_CL_Dz -10000000000 10000000000 /end CHARACTERISTIC
/begin COMPU_METHOD Compu_EGRad_CL_Dz " " RAT_FUNC "%.2" "%" COEFFS 0 0.01 0 0 0 1 /end COMPU_METHOD
/begin MEASUREMENT EGRdP_min "EGRdP minimum" SWORD Compu_EGRdP_min 0 0 -32 31.9990234375 ECU_ADDRESS 0x010107F0 /end MEASUREMENT
/begin COMPU_METHOD Compu_EGRdP_min " " RAT_FUNC "%.3" "psi" COEFFS 0 1024 0 0 0 1 /end COMPU_METHOD
/begin MEASUREMENT EGRdP_max "EGRdP maximum" SWORD Compu_EGRdP_max 0 0 -32 31.9990234375 ECU_ADDRESS 0x010107F8 /end MEASUREMENT
/begin COMPU_METHOD Compu_EGRdP_max " " RAT_FUNC "%.3" "psi" COEFFS 0 1024 0 0 0 1 /end COMPU_METHOD
/begin MEASUREMENT EGR_vlv_temp_est "Estimated EGR valve temperature" FLOAT32_IEEE Compu_EGR_vlv_temp_est 0 0 -10000000000 10000000000 ECU_ADDRESS 0x01010988 /end MEASUREMENT
/begin COMPU_METHOD Compu_EGR_vlv_temp_est " " RAT_FUNC "%.1" "deg C" COEFFS 0 1 0 0 0 1 /end COMPU_METHOD
/begin CHARACTERISTIC EGR_vlv_zero_dz "EGR valve zero deadzone" VALUE 0x001c6f00 /* @ECU_Address@EGR_vlv_zero_dz@0x01010998@ */ ECIPP_ALIGNMENT_UWORD 5 Compu_EGR_vlv_zero_dz 0 5.00114468864469 /end CHARACTERISTIC
/begin COMPU_METHOD Compu_EGR_vlv_zero_dz " " RAT_FUNC "%.3" "volts" COEFFS 0 13104 0 0 0 1 /end COMPU_METHOD
/begin CHARACTERISTIC EGR_vlv_dPos_max "EGR valve position delta max" VALUE 0x001c6efe /* @ECU_Address@EGR_vlv_dPos_max@0x010109A0@ */ ECIPP_ALIGNMENT_UWORD 5 Compu_EGR_vlv_dPos_max 0 5.00114468864469 /end CHARACTERISTIC
/begin COMPU_METHOD Compu_EGR_vlv_dPos_max " " RAT_FUNC "%.3" "volts" COEFFS 0 13104 0 0 0 1 /end COMPU_METHOD
/begin MEASUREMENT mdot_EGRv_mdl "Modeled EGR flow" FLOAT32_IEEE Compu_mdot_EGRv_mdl 0 0 -10000000000 10000000000 ECU_ADDRESS 0x01010E40 /end MEASUREMENT
/begin COMPU_METHOD Compu_mdot_EGRv_mdl " " RAT_FUNC "%.2" "g/sec" COEFFS 0 1 0 0 0 1 /end COMPU_METHOD
/begin CHARACTERISTIC EGRdP_offset_clrdly "EGRdP offset key-off clear wait" VALUE 0x001c6f02 /* @ECU_Address@EGRdP_offset_clrdly@0x01010E48@ */ ECIPP_ALIGNMENT_UWORD 65535 Compu_EGRdP_offset_clrdly 0 65535 /end CHARACTERISTIC
/begin COMPU_METHOD Compu_EGRdP_offset_clrdly " " RAT_FUNC "%.0" "ms" COEFFS 0 1 0 0 0 1 /end COMPU_METHOD
/begin CHARACTERISTIC FDC_ena "FDC mode{FDC_ena&0xff=0:Disabled}{FDC_ena&0xff=1:Enabled}" VALUE 0x001c86fe /* @ECU_Address@FDC_ena@0x01011F30@ */ ECIPP_ALIGNMENT_UBYTE 255 FDC_ena_COMPU_VTAB 0 255 BIT_MASK 0xff /end CHARACTERISTIC
/begin COMPU_METHOD FDC_ena_COMPU_VTAB "Verbal Table" TAB_VERB "%.0" "list" COMPU_TAB_REF FDC_ena_COMPU_VTAB_REF /end COMPU_METHOD
/begin COMPU_VTAB FDC_ena_COMPU_VTAB_REF "Verbal Table" TAB_VERB 2 0 "Disabled" 1 "Enabled" DEFAULT_VALUE "UNKNOWN" /end COMPU_VTAB
/begin CHARACTERISTIC FDC_rpm_min "FDC RPM minimum" VALUE 0x001c6f3c /* @ECU_Address@FDC_rpm_min@0x01011F38@ */ ECIPP_ALIGNMENT_UWORD 65535 Compu_FDC_rpm_min 0 65535 /end CHARACTERISTIC
/begin COMPU_METHOD Compu_FDC_rpm_min " " RAT_FUNC "%.0" "rpm" COEFFS 0 1 0 0 0 1 /end COMPU_METHOD
/begin CHARACTERISTIC FDC_load_off "FDC load cmd = 0% comp" VALUE 0x001c6f38 /* @ECU_Address@FDC_load_off@0x01011F40@ */ ECIPP_ALIGNMENT_UWORD 100 Compu_FDC_load_off 0 99.9984741210938 /end CHARACTERISTIC
/begin COMPU_METHOD Compu_FDC_load_off " " RAT_FUNC "%.1" "% load" COEFFS 0 655.36 0 0 0 1 /end COMPU_METHOD
/begin CHARACTERISTIC FDC_load_on "FDC load cmd = 100% comp" VALUE 0x001c6f3a /* @ECU_Address@FDC_load_on@0x01011F48@ */ ECIPP_ALIGNMENT_UWORD 100 Compu_FDC_load_on 0 99.9984741210938 /end CHARACTERISTIC
/begin COMPU_METHOD Compu_FDC_load_on " " RAT_FUNC "%.1" "% load" COEFFS 0 655.36 0 0 0 1 /end COMPU_METHOD
/begin CHARACTERISTIC FDC_CLAL_ref "FDC fuel CL+AL = 100% comp" VALUE 0x001c6f34 /* @ECU_Address@FDC_CLAL_ref@0x01011F50@ */ ECIPP_ALIGNMENT_UWORD 200 Compu_FDC_CLAL_ref 0 199.996948242188 /end CHARACTERISTIC
/begin COMPU_METHOD Compu_FDC_CLAL_ref " " RAT_FUNC "%.1" "%" COEFFS 0 327.68 0 0 0 1 /end COMPU_METHOD
/begin CHARACTERISTIC FDC_EGR_max "FDC EGR cmd offset max" VALUE 0x001c6f36 /* @ECU_Address@FDC_EGR_max@0x01011F58@ */ ECIPP_ALIGNMENT_UWORD 400 Compu_FDC_EGR_max 0 399.993896484375 /end CHARACTERISTIC
/begin COMPU_METHOD Compu_FDC_EGR_max " " RAT_FUNC "%.2" "% dil" COEFFS 0 163.84 0 0 0 1 /end COMPU_METHOD
/begin CHARACTERISTIC FDC_comp_inc_LP "FDC compensation inc LP" VALUE 0x001c8534 /* @ECU_Address@FDC_comp_inc_LP@0x01011F60@ */ ECIPP_ALIGNMENT_UWORD 3277 Compu_FDC_comp_inc_LP 0.0045084 3276.8 /end CHARACTERISTIC
/begin COMPU_METHOD Compu_FDC_comp_inc_LP " " FORM "%.1" "sec"
 /begin FORMULA "-0.05 / log(1 - (X1 / 65536))" FORMULA_INV "(1 - exp(-0.05/X1)) * 65536" /end FORMULA
/end COMPU_METHOD
/begin CHARACTERISTIC FDC_comp_dec_LP "FDC compensation dec LP" VALUE 0x001c8532 /* @ECU_Address@FDC_comp_dec_LP@0x01011F68@ */ ECIPP_ALIGNMENT_UWORD 3277 Compu_FDC_comp_dec_LP 0.0045084 3276.8 /end CHARACTERISTIC
/begin COMPU_METHOD Compu_FDC_comp_dec_LP " " FORM "%.1" "sec"
 /begin FORMULA "-0.05 / log(1 - (X1 / 65536))" FORMULA_INV "(1 - exp(-0.05/X1)) * 65536" /end FORMULA
/end COMPU_METHOD
/begin MEASUREMENT FDC_comp_pct "FDC compensation" FLOAT32_IEEE Compu_FDC_comp_pct 0 0 -10000000000 10000000000 ECU_ADDRESS 0x01011F70 /end MEASUREMENT
/begin COMPU_METHOD Compu_FDC_comp_pct " " RAT_FUNC "%.1" "%" COEFFS 0 0.01 0 0 0 1 /end COMPU_METHOD
/begin MEASUREMENT FDC_EGR_ofst "FDC EGR offset" FLOAT32_IEEE Compu_FDC_EGR_ofst 0 0 -10000000000 10000000000 ECU_ADDRESS 0x01011F78 /end MEASUREMENT
/begin COMPU_METHOD Compu_FDC_EGR_ofst " " RAT_FUNC "%.2" "% dil" COEFFS 0 0.01 0 0 0 1 /end COMPU_METHOD
/begin CHARACTERISTIC EGRad_store_EE "EGR adaptive retention memory{EGRad_store_EE&0xff=0:Battery}{EGRad_store_EE&0xff=1:Permanent}" VALUE 0x001c0ab3 /* @ECU_Address@EGRad_store_EE@0x01012038@ */ ECIPP_ALIGNMENT_UBYTE 255 EGRad_store_EE_COMPU_VTAB 0 255 BIT_MASK 0xff /end CHARACTERISTIC
/begin COMPU_METHOD EGRad_store_EE_COMPU_VTAB "Verbal Table" TAB_VERB "%.0" "list" COMPU_TAB_REF EGRad_store_EE_COMPU_VTAB_REF /end COMPU_METHOD
/begin COMPU_VTAB EGRad_store_EE_COMPU_VTAB_REF "Verbal Table" TAB_VERB 2 0 "Battery" 1 "Permanent" DEFAULT_VALUE "UNKNOWN" /end COMPU_VTAB
/begin MEASUREMENT m_d_pct_octmin "Octane-compensated min diluent command request" UWORD Compu_m_d_pct_octmin 0 0 0 399.993896484375 ECU_ADDRESS 0x010125C0 /end MEASUREMENT
/begin COMPU_METHOD Compu_m_d_pct_octmin " " RAT_FUNC "%.1" "%" COEFFS 0 163.84 0 0 0 1 /end COMPU_METHOD
/begin MEASUREMENT m_d_pct_octnom "Octane-compensated nom diluent command request" UWORD Compu_m_d_pct_octnom 0 0 0 399.993896484375 ECU_ADDRESS 0x010125C8 /end MEASUREMENT
/begin COMPU_METHOD Compu_m_d_pct_octnom " " RAT_FUNC "%.1" "%" COEFFS 0 163.84 0 0 0 1 /end COMPU_METHOD
/begin MEASUREMENT EGR_oct_retard "Additional spark retard for octane adaptation" SWORD Compu_EGR_oct_retard 0 0 -2048 2047.9375 ECU_ADDRESS 0x010125D0 /end MEASUREMENT
/begin COMPU_METHOD Compu_EGR_oct_retard " " RAT_FUNC "%.1" "CAD ret" COEFFS 0 16 0 0 0 1 /end COMPU_METHOD
/begin MEASUREMENT EGR_oct_LL_pct "Octane rating load limit" UWORD Compu_EGR_oct_LL_pct 0 0 0 99.9984741210938 ECU_ADDRESS 0x010125E0 /end MEASUREMENT
/begin COMPU_METHOD Compu_EGR_oct_LL_pct " " RAT_FUNC "%.1" "%" COEFFS 0 655.36 0 0 0 1 /end COMPU_METHOD
/begin MEASUREMENT m_d_pct_oct_ofst "Additional EGR diluent for octane adaptation" SWORD Compu_m_d_pct_oct_ofst 0 0 -200 199.993896484375 ECU_ADDRESS 0x010125F8 /end MEASUREMENT
/begin COMPU_METHOD Compu_m_d_pct_oct_ofst " " RAT_FUNC "%.1" "%" COEFFS 0 163.84 0 0 0 1 /end COMPU_METHOD
/begin CHARACTERISTIC EGRdP_offset_clrtime "EGRdP offset key-off clear time" VALUE 0x001c09ee /* @ECU_Address@EGRdP_offset_clrtime@0x01012708@ */ ECIPP_ALIGNMENT_UWORD 66 Compu_EGRdP_offset_clrtime 0 65.535 /end CHARACTERISTIC
/begin COMPU_METHOD Compu_EGRdP_offset_clrtime " " RAT_FUNC "%.1" "sec" COEFFS 0 1000 0 0 0 1 /end COMPU_METHOD
/begin MEASUREMENT EGR_deice_state "EGR de-icing state{EGR_deice_state&0xff=0xce:Inactive: foot pedal in use}{EGR_deice_state&0xff=0xcf:Inactive: fuel shutoff active}{EGR_deice_state&0xff=0xd0:Inactive: PTO active}{EGR_deice_state&0xff=0xd1:Inactive: clutch depressed}{EGR_deice_state&0xff=0" SBYTE EGR_deice_state_COMPU_VTAB 0 0 -127 128 ECU_ADDRESS 0x01012888 BIT_MASK 0xff /end MEASUREMENT
/begin COMPU_METHOD EGR_deice_state_COMPU_VTAB "Verbal Table" TAB_VERB "%.0" "list" COMPU_TAB_REF EGR_deice_state_COMPU_VTAB_REF /end COMPU_METHOD
/begin COMPU_VTAB EGR_deice_state_COMPU_VTAB_REF "Verbal Table" TAB_VERB 23 0xce "Inactive: foot pedal in use" 0xcf "Inactive: fuel shutoff active" 0xd0 "Inactive: PTO active" 0xd1 "Inactive: clutch depressed" 0xd2 "Inactive: clutch state unknown" 0xd3 "Inactive: brake pedal depressed" 0xd4 "Inactive: brake pedal state unknown" 0xd5 "Inactive: vehicle in motion" 0xd6 "Inactive: vehicle speed unknown" 0xd7 "Inactive: transmission in gear" 0xd8 "Inactive: secondary speed control active" 0xeb "Inactive: engine not running" 0xec "Inactive: run time wait not satisfied" 0xfe "Inactive: primary wait not satisfied" 0xff "Inactive: secondary wait not satisfied" 0x00 "Disabled" 0x01 "Active: increasing speed" 0x02 "Active: pre-purge delay" 0x03 "Active: post-purge delay" 0x04 "Active: returning to idle" 0x05 "Active" 0x06 "Active: IAT low" 0xe2 "Inactive: other diagnostic running" DEFAULT_VALUE "UNKNOWN" /end COMPU_VTAB
/begin CHARACTERISTIC EGR_deice_idle_tm "EGR de-icing primary idle time" VALUE 0x001c0996 /* @ECU_Address@EGR_deice_idle_tm@0x01012890@ */ ECIPP_ALIGNMENT_UWORD 65535 Compu_EGR_deice_idle_tm 0 65535 /end CHARACTERISTIC
/begin COMPU_METHOD Compu_EGR_deice_idle_tm " " RAT_FUNC "%.0" "sec" COEFFS 0 1 0 0 0 1 /end COMPU_METHOD
/begin CHARACTERISTIC EGR_deice_retidle_tm "EGR de-icing secondary idle time" VALUE 0x001c099e /* @ECU_Address@EGR_deice_retidle_tm@0x01012898@ */ ECIPP_ALIGNMENT_UWORD 65535 Compu_EGR_deice_retidle_tm 0 65535 /end CHARACTERISTIC
/begin COMPU_METHOD Compu_EGR_deice_retidle_tm " " RAT_FUNC "%.0" "sec" COEFFS 0 1 0 0 0 1 /end COMPU_METHOD
/begin CHARACTERISTIC EGR_deice_purge_tm "EGR de-icing purge time at target IAT" VALUE 0x001c099c /* @ECU_Address@EGR_deice_purge_tm@0x010128A0@ */ ECIPP_ALIGNMENT_UWORD 65535 Compu_EGR_deice_purge_tm 0 65535 /end CHARACTERISTIC
/begin COMPU_METHOD Compu_EGR_deice_purge_tm " " RAT_FUNC "%.0" "sec" COEFFS 0 1 0 0 0 1 /end COMPU_METHOD
/begin MEASUREMENT EGR_deice_wait_tm "EGR de-icing current wait time" ULONG Compu_EGR_deice_wait_tm 0 0 0 16777215.9960938 ECU_ADDRESS 0x010128A8 /end MEASUREMENT
/begin COMPU_METHOD Compu_EGR_deice_wait_tm " " RAT_FUNC "%.1" "sec" COEFFS 0 256 0 0 0 1 /end COMPU_METHOD
/begin MEASUREMENT EGR_deice_tmr "EGR de-icing current wait timer" ULONG Compu_EGR_deice_tmr 0 0 0 4294967.295 ECU_ADDRESS 0x010128B0 /end MEASUREMENT
/begin COMPU_METHOD Compu_EGR_deice_tmr " " RAT_FUNC "%.1" "sec" COEFFS 0 1000 0 0 0 1 /end COMPU_METHOD
/begin CHARACTERISTIC EGR_deice_rpm "EGR de-icing purge speed" VALUE 0x001c09a0 /* @ECU_Address@EGR_deice_rpm@0x010128B8@ */ ECIPP_ALIGNMENT_UWORD 65535 Compu_EGR_deice_rpm 0 65535 /end CHARACTERISTIC
/begin COMPU_METHOD Compu_EGR_deice_rpm " " RAT_FUNC "%.0" "rpm" COEFFS 0 1 0 0 0 1 /end COMPU_METHOD
/begin CHARACTERISTIC EGR_deice_AAT_max "EGR de-icing maximum ambient air temperature" VALUE 0x001c0994 /* @ECU_Address@EGR_deice_AAT_max@0x010128C0@ */ ECIPP_ALIGNMENT_UWORD 564 Compu_EGR_deice_AAT_max -460 563.984375 /end CHARACTERISTIC
/begin COMPU_METHOD Compu_EGR_deice_AAT_max " " RAT_FUNC "%.1" "deg F" COEFFS 0 64 29440 0 0 1 /end COMPU_METHOD
/begin CHARACTERISTIC EGR_deice_pct_cmd "EGR de-icing purge % diluent" VALUE 0x001c0998 /* @ECU_Address@EGR_deice_pct_cmd@0x010128C8@ */ ECIPP_ALIGNMENT_UWORD 400 Compu_EGR_deice_pct_cmd 0 399.993896484375 /end CHARACTERISTIC
/begin COMPU_METHOD Compu_EGR_deice_pct_cmd " " RAT_FUNC "%.1" "%" COEFFS 0 163.84 0 0 0 1 /end COMPU_METHOD
/begin CHARACTERISTIC EGR_deice_rpm_rate "EGR de-icing purge speed ramp rate" VALUE 0x001c09a2 /* @ECU_Address@EGR_deice_rpm_rate@0x010128F0@ */ ECIPP_ALIGNMENT_UWORD 65535 Compu_EGR_deice_rpm_rate 0 65535 /end CHARACTERISTIC
/begin COMPU_METHOD Compu_EGR_deice_rpm_rate " " RAT_FUNC "%.0" "rpm/s" COEFFS 0 1 0 0 0 1 /end COMPU_METHOD
/begin CHARACTERISTIC EGR_deice_pre_tm "EGR de-icing pre-purge delay" VALUE 0x001c0aa9 /* @ECU_Address@EGR_deice_pre_tm@0x010128F8@ */ ECIPP_ALIGNMENT_UBYTE 255 Compu_EGR_deice_pre_tm 0 255 /end CHARACTERISTIC
/begin COMPU_METHOD Compu_EGR_deice_pre_tm " " RAT_FUNC "%.0" "sec" COEFFS 0 1 0 0 0 1 /end COMPU_METHOD
/begin CHARACTERISTIC EGR_deice_post_tm "EGR de-icing post-purge delay" VALUE 0x001c0aa8 /* @ECU_Address@EGR_deice_post_tm@0x01012900@ */ ECIPP_ALIGNMENT_UBYTE 255 Compu_EGR_deice_post_tm 0 255 /end CHARACTERISTIC
/begin COMPU_METHOD Compu_EGR_deice_post_tm " " RAT_FUNC "%.0" "sec" COEFFS 0 1 0 0 0 1 /end COMPU_METHOD
/begin CHARACTERISTIC EGR_deice_purge_IAT "EGR de-icing purge target IAT" VALUE 0x001c099a /* @ECU_Address@EGR_deice_purge_IAT@0x01012908@ */ ECIPP_ALIGNMENT_UWORD 564 Compu_EGR_deice_purge_IAT -460 563.984375 /end CHARACTERISTIC
/begin COMPU_METHOD Compu_EGR_deice_purge_IAT " " RAT_FUNC "%.1" "deg F" COEFFS 0 64 29440 0 0 1 /end COMPU_METHOD
/begin MEASUREMENT EGR_sensor_trust "EGR sensor trust{EGR_sensor_trust&0xff=0xb0:Untrusted: de-icing}{EGR_sensor_trust&0xff=0xc0:Untrusted: ECT low}{EGR_sensor_trust&0xff=0xd0:EGRdP untrusted}{EGR_sensor_trust&0xff=0xe0:EGRHP untrusted}{EGR_sensor_trust&0xff=0xf0:Untrusted}{EGR_sensor_trust&" SBYTE EGR_sensor_trust_COMPU_VTAB 0 0 -127 128 ECU_ADDRESS 0x01012920 BIT_MASK 0xff /end MEASUREMENT
/begin COMPU_METHOD EGR_sensor_trust_COMPU_VTAB "Verbal Table" TAB_VERB "%.0" "list" COMPU_TAB_REF EGR_sensor_trust_COMPU_VTAB_REF /end COMPU_METHOD
/begin COMPU_VTAB EGR_sensor_trust_COMPU_VTAB_REF "Verbal Table" TAB_VERB 8 0xb0 "Untrusted: de-icing" 0xc0 "Untrusted: ECT low" 0xd0 "EGRdP untrusted" 0xe0 "EGRHP untrusted" 0xf0 "Untrusted" 0x00 "Trust pending" 0x10 "Trusted" 0x20 "Trusted until next key cycle" DEFAULT_VALUE "UNKNOWN" /end COMPU_VTAB
/begin CHARACTERISTIC EGRdP_trust_zero_dz "EGRdP trust deadzone" VALUE 0x001c09fa /* @ECU_Address@EGRdP_trust_zero_dz@0x010129B0@ */ ECIPP_ALIGNMENT_UWORD 64 Compu_EGRdP_trust_zero_dz 0 63.9990234375 /end CHARACTERISTIC
/begin COMPU_METHOD Compu_EGRdP_trust_zero_dz " " RAT_FUNC "%.3" "psi" COEFFS 0 1024 0 0 0 1 /end COMPU_METHOD
/begin CHARACTERISTIC EGRdP_trust_latch_tm "EGRdP trust latch time" VALUE 0x001c09f8 /* @ECU_Address@EGRdP_trust_latch_tm@0x010129B8@ */ ECIPP_ALIGNMENT_UWORD 65535 Compu_EGRdP_trust_latch_tm 0 65535 /end CHARACTERISTIC
/begin COMPU_METHOD Compu_EGRdP_trust_latch_tm " " RAT_FUNC "%.0" "sec" COEFFS 0 1 0 0 0 1 /end COMPU_METHOD
/begin MEASUREMENT EGRdP_trust_pct "EGRdP trust level" UWORD Compu_EGRdP_trust_pct 0 0 0 99.9984741210938 ECU_ADDRESS 0x010129C0 /end MEASUREMENT
/begin COMPU_METHOD Compu_EGRdP_trust_pct " " RAT_FUNC "%.1" "%" COEFFS 0 655.36 0 0 0 1 /end COMPU_METHOD
/begin MEASUREMENT EGRHP_trust_mdl_err "EGRHP trust model error" UWORD Compu_EGRHP_trust_mdl_err 0 0 0 255.99609375 ECU_ADDRESS 0x010129C8 /end MEASUREMENT
/begin COMPU_METHOD Compu_EGRHP_trust_mdl_err " " RAT_FUNC "%.2" "psi" COEFFS 0 256 0 0 0 1 /end COMPU_METHOD
/begin CHARACTERISTIC EGRHP_trust_mdl_dz "EGRHP trust model error deadzone" VALUE 0x001c0950 /* @ECU_Address@EGRHP_trust_mdl_dz@0x010129D0@ */ ECIPP_ALIGNMENT_UWORD 256 Compu_EGRHP_trust_mdl_dz 0 255.99609375 /end CHARACTERISTIC
/begin COMPU_METHOD Compu_EGRHP_trust_mdl_dz " " RAT_FUNC "%.2" "psi" COEFFS 0 256 0 0 0 1 /end COMPU_METHOD
/begin CHARACTERISTIC EGRHP_trust_latch_tm "EGRHP trust latch time" VALUE 0x001c094e /* @ECU_Address@EGRHP_trust_latch_tm@0x010129D8@ */ ECIPP_ALIGNMENT_UWORD 65535 Compu_EGRHP_trust_latch_tm 0 65535 /end CHARACTERISTIC
/begin COMPU_METHOD Compu_EGRHP_trust_latch_tm " " RAT_FUNC "%.0" "sec" COEFFS 0 1 0 0 0 1 /end COMPU_METHOD
/begin CHARACTERISTIC EGRHP_trust_unlatcht "EGRHP trust unlatch time" VALUE 0x001c0952 /* @ECU_Address@EGRHP_trust_unlatcht@0x010129E0@ */ ECIPP_ALIGNMENT_UWORD 65535 Compu_EGRHP_trust_unlatcht 0 65535 /end CHARACTERISTIC
/begin COMPU_METHOD Compu_EGRHP_trust_unlatcht " " RAT_FUNC "%.0" "sec" COEFFS 0 1 0 0 0 1 /end COMPU_METHOD
/begin MEASUREMENT EGRHP_trust_pct "EGRHP trust level" UWORD Compu_EGRHP_trust_pct 0 0 0 99.9984741210938 ECU_ADDRESS 0x010129E8 /end MEASUREMENT
/begin COMPU_METHOD Compu_EGRHP_trust_pct " " RAT_FUNC "%.1" "%" COEFFS 0 655.36 0 0 0 1 /end COMPU_METHOD
/begin CHARACTERISTIC EGR_senstrst_flt_tm "EGR sensor trustworthiness fault delay" VALUE 0x001c0264 /* @ECU_Address@EGR_senstrst_flt_tm@0x010129F0@ */ ECIPP_ALIGNMENT_ULONG 4294967 Compu_EGR_senstrst_flt_tm 0 4294967.295 /end CHARACTERISTIC
/begin COMPU_METHOD Compu_EGR_senstrst_flt_tm " " RAT_FUNC "%.1" "sec" COEFFS 0 1000 0 0 0 1 /end COMPU_METHOD
/begin MEASUREMENT EGR_senstrst_flt_tmr "EGR sensor trustworthiness fault timer" ULONG Compu_EGR_senstrst_flt_tmr 0 0 0 4294967.295 ECU_ADDRESS 0x010129F8 /end MEASUREMENT
/begin COMPU_METHOD Compu_EGR_senstrst_flt_tmr " " RAT_FUNC "%.1" "sec" COEFFS 0 1000 0 0 0 1 /end COMPU_METHOD
/begin CHARACTERISTIC EGR_senstrst_ECTfrac "EGR sensor trustworthiness ECT min/nom threshold" VALUE 0x001c0288 /* @ECU_Address@EGR_senstrst_ECTfrac@0x01012A00@ */ ECIPP_ALIGNMENT_SWORD 2 Compu_EGR_senstrst_ECTfrac -2 1.99993896484375 /end CHARACTERISTIC
/begin COMPU_METHOD Compu_EGR_senstrst_ECTfrac " " RAT_FUNC "%.2" "-" COEFFS 0 16384 0 0 0 1 /end COMPU_METHOD
/begin MEASUREMENT EGR_minnom_senstrst "EGR sensor trustworthiness min/nom request" SWORD Compu_EGR_minnom_senstrst 0 0 -2 1.99993896484375 ECU_ADDRESS 0x01012A08 /end MEASUREMENT
/begin COMPU_METHOD Compu_EGR_minnom_senstrst " " RAT_FUNC "%.2" "-" COEFFS 0 16384 0 0 0 1 /end COMPU_METHOD
/begin CHARACTERISTIC mdot_EGR_ON "Diluent flow command 'on' limit" VALUE 0x001c0a7a /* @ECU_Address@mdot_EGR_ON@0x01012A10@ */ ECIPP_ALIGNMENT_UWORD 1024 Compu_mdot_EGR_ON 0 1023.984375 /end CHARACTERISTIC
/begin COMPU_METHOD Compu_mdot_EGR_ON " " RAT_FUNC "%.2" "g/sec" COEFFS 0 64 0 0 0 1 /end COMPU_METHOD
/begin CHARACTERISTIC mdot_EGR_OFF "Diluent flow command 'off' limit" VALUE 0x001c0a78 /* @ECU_Address@mdot_EGR_OFF@0x01012A18@ */ ECIPP_ALIGNMENT_UWORD 1024 Compu_mdot_EGR_OFF 0 1023.984375 /end CHARACTERISTIC
/begin COMPU_METHOD Compu_mdot_EGR_OFF " " RAT_FUNC "%.2" "g/sec" COEFFS 0 64 0 0 0 1 /end COMPU_METHOD
/begin CHARACTERISTIC mdot_EGR_ON_cold "Cold diluent flow command 'on' limit" VALUE 0x001c0a7c /* @ECU_Address@mdot_EGR_ON_cold@0x01012B18@ */ ECIPP_ALIGNMENT_UWORD 1024 Compu_mdot_EGR_ON_cold 0 1023.984375 /end CHARACTERISTIC
/begin COMPU_METHOD Compu_mdot_EGR_ON_cold " " RAT_FUNC "%.2" "g/sec" COEFFS 0 64 0 0 0 1 /end COMPU_METHOD
/begin CHARACTERISTIC EGR_ON_cold_IAT "Max. IAT for cold diluent flow command 'on' limit" VALUE 0x001c0978 /* @ECU_Address@EGR_ON_cold_IAT@0x01012B20@ */ ECIPP_ALIGNMENT_UWORD 564 Compu_EGR_ON_cold_IAT -460 563.984375 /end CHARACTERISTIC
/begin COMPU_METHOD Compu_EGR_ON_cold_IAT " " RAT_FUNC "%.1" "deg F" COEFFS 0 64 29440 0 0 1 /end COMPU_METHOD
/begin CHARACTERISTIC EGR_initpct_reduct "EGR initial % command reduction" VALUE 0x001c09aa /* @ECU_Address@EGR_initpct_reduct@0x01012D00@ */ ECIPP_ALIGNMENT_UWORD 100 Compu_EGR_initpct_reduct 0 99.9984741210938 /end CHARACTERISTIC
/begin COMPU_METHOD Compu_EGR_initpct_reduct " " RAT_FUNC "%.1" "%" COEFFS 0 655.36 0 0 0 1 /end COMPU_METHOD
/begin MEASUREMENT EGR_initpct_accmd "Acc flow for % cmd reduct" ULONG Compu_EGR_initpct_accmd 0 0 0 67.108863984375 ECU_ADDRESS 0x01012D08 /end MEASUREMENT
/begin COMPU_METHOD Compu_EGR_initpct_accmd " " RAT_FUNC "%.2" "kg" COEFFS 0 64000000 0 0 0 1 /end COMPU_METHOD
/begin CHARACTERISTIC EGR_initpct_accmdmax "Max acc flow for % cmd reduct" VALUE 0x001c09a8 /* @ECU_Address@EGR_initpct_accmdmax@0x01012D10@ */ ECIPP_ALIGNMENT_UWORD 64 Compu_EGR_initpct_accmdmax 0 63.9990234375 /end CHARACTERISTIC
/begin COMPU_METHOD Compu_EGR_initpct_accmdmax " " RAT_FUNC "%.2" "kg" COEFFS 0 1024 0 0 0 1 /end COMPU_METHOD
/begin MEASUREMENT m_d_pct_req_lp "EGR diluent request" UWORD Compu_m_d_pct_req_lp 0 0 0 399.993896484375 ECU_ADDRESS 0x01012D18 /end MEASUREMENT
/begin COMPU_METHOD Compu_m_d_pct_req_lp " " RAT_FUNC "%.1" "% dil" COEFFS 0 163.84 0 0 0 1 /end COMPU_METHOD
/begin MEASUREMENT mdot_EGR_req "EGR requested flow" FLOAT32_IEEE Compu_mdot_EGR_req 0 0 -10000000000 10000000000 ECU_ADDRESS 0x01012D20 /end MEASUREMENT
/begin COMPU_METHOD Compu_mdot_EGR_req " " RAT_FUNC "%.2" "g/sec" COEFFS 0 1 0 0 0 1 /end COMPU_METHOD
/begin CHARACTERISTIC mdot_EGR_inc_max "EGR flow max inc cmd slew rate" VALUE 0x001c0258 /* @ECU_Address@mdot_EGR_inc_max@0x01012D28@ */ ECIPP_ALIGNMENT_FLOAT32_IEEE 10000000000 Compu_mdot_EGR_inc_max -10000000000 10000000000 /end CHARACTERISTIC
/begin COMPU_METHOD Compu_mdot_EGR_inc_max " " RAT_FUNC "%.1" "g/sec/sec" COEFFS 0 1 0 0 0 1 /end COMPU_METHOD
/begin CHARACTERISTIC EGR_spkex_pdspanmin "Nom-min for average spk sens" VALUE 0x001c09be /* @ECU_Address@EGR_spkex_pdspanmin@0x01012D30@ */ ECIPP_ALIGNMENT_UWORD 400 Compu_EGR_spkex_pdspanmin 0 399.993896484375 /end CHARACTERISTIC
/begin COMPU_METHOD Compu_EGR_spkex_pdspanmin " " RAT_FUNC "%.1" "% dil" COEFFS 0 163.84 0 0 0 1 /end COMPU_METHOD
/begin CHARACTERISTIC EGR_spkex_pdspanmax "Nom-min for calculated spk sens" VALUE 0x001c09bc /* @ECU_Address@EGR_spkex_pdspanmax@0x01012D38@ */ ECIPP_ALIGNMENT_UWORD 400 Compu_EGR_spkex_pdspanmax 0 399.993896484375 /end CHARACTERISTIC
/begin COMPU_METHOD Compu_EGR_spkex_pdspanmax " " RAT_FUNC "%.1" "% dil" COEFFS 0 163.84 0 0 0 1 /end COMPU_METHOD
/begin MEASUREMENT mdot_EGR_zero_tmr "Zero flow timer for % cmd reduct" ULONG Compu_mdot_EGR_zero_tmr 0 0 0 4294967.295 ECU_ADDRESS 0x01012D40 /end MEASUREMENT
/begin COMPU_METHOD Compu_mdot_EGR_zero_tmr " " RAT_FUNC "%.1" "sec" COEFFS 0 1000 0 0 0 1 /end COMPU_METHOD
/begin CHARACTERISTIC EGR_initpct_0md_tm "0 flow time for inc % cmd reduct" VALUE 0x001c09a6 /* @ECU_Address@EGR_initpct_0md_tm@0x01012D48@ */ ECIPP_ALIGNMENT_UWORD 65535 Compu_EGR_initpct_0md_tm 0 65535 /end CHARACTERISTIC
/begin COMPU_METHOD Compu_EGR_initpct_0md_tm " " RAT_FUNC "%.0" "sec" COEFFS 0 1 0 0 0 1 /end COMPU_METHOD
/begin CHARACTERISTIC EGR_initpct_0md_slew "% cmd reduct inc rate at 0 flow" VALUE 0x001c09a4 /* @ECU_Address@EGR_initpct_0md_slew@0x01012D50@ */ ECIPP_ALIGNMENT_UWORD 100 Compu_EGR_initpct_0md_slew 0 99.9984741210938 /end CHARACTERISTIC
/begin COMPU_METHOD Compu_EGR_initpct_0md_slew " " RAT_FUNC "%.1" "%/sec" COEFFS 0 655.36 0 0 0 1 /end COMPU_METHOD
/begin MEASUREMENT EGR_stuckvlv_state "Stuck EGR valve diagnostic state{EGR_stuckvlv_state&0xff=0:Inactive}{EGR_stuckvlv_state&0xff=1:Inactive: de-icing}{EGR_stuckvlv_state&0xff=2:Monitoring}{EGR_stuckvlv_state&0xff=10:Monitoring: DC high}{EGR_stuckvlv_state&0xff=20:Active: resting}{EGR_stuckv" UBYTE EGR_stuckvlv_state_COMPU_VTAB 0 0 0 255 ECU_ADDRESS 0x01012F18 BIT_MASK 0xff /end MEASUREMENT
/begin COMPU_METHOD EGR_stuckvlv_state_COMPU_VTAB "Verbal Table" TAB_VERB "%.0" "list" COMPU_TAB_REF EGR_stuckvlv_state_COMPU_VTAB_REF /end COMPU_METHOD
/begin COMPU_VTAB EGR_stuckvlv_state_COMPU_VTAB_REF "Verbal Table" TAB_VERB 9 0 "Inactive" 1 "Inactive: de-icing" 2 "Monitoring" 10 "Monitoring: DC high" 20 "Active: resting" 21 "Active: closing valve" 22 "Active: opening valve" 30 "Stuck" 31 "Stuck: key-off" DEFAULT_VALUE "UNKNOWN" /end COMPU_VTAB
/begin MEASUREMENT EGR_stuckvlv_dc_lp "Stuck EGR valve low-passed duty cycle" SWORD Compu_EGR_stuckvlv_dc_lp 0 0 -100 99.9969482421875 ECU_ADDRESS 0x01012F20 /end MEASUREMENT
/begin COMPU_METHOD Compu_EGR_stuckvlv_dc_lp " " RAT_FUNC "%.1" "%" COEFFS 0 327.68 0 0 0 1 /end COMPU_METHOD
/begin MEASUREMENT EGR_stuckvlv_tmr_max "Stuck EGR valve peak time outside thresholds" UWORD Compu_EGR_stuckvlv_tmr_max 0 0 0 65535 ECU_ADDRESS 0x01012F28 /end MEASUREMENT
/begin COMPU_METHOD Compu_EGR_stuckvlv_tmr_max " " RAT_FUNC "%.0" "ms" COEFFS 0 1 0 0 0 1 /end COMPU_METHOD
/begin CHARACTERISTIC EFMA_venturi_dP_ena "Venturi EGR mixer enable{EFMA_venturi_dP_ena&0xff=0:Disabled}{EFMA_venturi_dP_ena&0xff=1:Enabled}" VALUE 0x001c0a9f /* @ECU_Address@EFMA_venturi_dP_ena@0x010139D8@ */ ECIPP_ALIGNMENT_UBYTE 255 EFMA_venturi_dP_ena_COMPU_VTAB 0 255 BIT_MASK 0xff /end CHARACTERISTIC
/begin COMPU_METHOD EFMA_venturi_dP_ena_COMPU_VTAB "Verbal Table" TAB_VERB "%.0" "list" COMPU_TAB_REF EFMA_venturi_dP_ena_COMPU_VTAB_REF /end COMPU_METHOD
/begin COMPU_VTAB EFMA_venturi_dP_ena_COMPU_VTAB_REF "Verbal Table" TAB_VERB 2 0 "Disabled" 1 "Enabled" DEFAULT_VALUE "UNKNOWN" /end COMPU_VTAB
/begin CHARACTERISTIC EFMA_venturi_dP_C1 "Venturi EGR mixer MAP dP scaling" VALUE 0x001c0034 /* @ECU_Address@EFMA_venturi_dP_C1@0x010139E0@ */ ECIPP_ALIGNMENT_FLOAT32_IEEE 10000000000 Compu_EFMA_venturi_dP_C1 -10000000000 10000000000 /end CHARACTERISTIC
/begin COMPU_METHOD Compu_EFMA_venturi_dP_C1 " " RAT_FUNC "%.4" "-" COEFFS 0 1 0 0 0 1 /end COMPU_METHOD
/begin CHARACTERISTIC EFMA_venturi_dP_C2 "Venturi EGR mixer throttle flow dP scaling" VALUE 0x001c0038 /* @ECU_Address@EFMA_venturi_dP_C2@0x010139E8@ */ ECIPP_ALIGNMENT_FLOAT32_IEEE 10000000000 Compu_EFMA_venturi_dP_C2 -10000000000 10000000000 /end CHARACTERISTIC
/begin COMPU_METHOD Compu_EFMA_venturi_dP_C2 " " RAT_FUNC "%.4" "mpsi-s/g" COEFFS 0 0.001 0 0 0 1 /end COMPU_METHOD
/begin CHARACTERISTIC EFMA_venturi_dP_C3 "Venturi EGR mixer throttle flow^2 dP scaling" VALUE 0x001c003c /* @ECU_Address@EFMA_venturi_dP_C3@0x010139F0@ */ ECIPP_ALIGNMENT_FLOAT32_IEEE 10000000000 Compu_EFMA_venturi_dP_C3 -10000000000 10000000000 /end CHARACTERISTIC
/begin COMPU_METHOD Compu_EFMA_venturi_dP_C3 " " RAT_FUNC "%.4" "upsi-s^2/g^2" COEFFS 0 0.000001 0 0 0 1 /end COMPU_METHOD
/begin CHARACTERISTIC EFMA_venturi_dP_C4 "Venturi EGR mixer EGR flow dP scaling" VALUE 0x001c0040 /* @ECU_Address@EFMA_venturi_dP_C4@0x010139F8@ */ ECIPP_ALIGNMENT_FLOAT32_IEEE 10000000000 Compu_EFMA_venturi_dP_C4 -10000000000 10000000000 /end CHARACTERISTIC
/begin COMPU_METHOD Compu_EFMA_venturi_dP_C4 " " RAT_FUNC "%.4" "mpsi-s/g" COEFFS 0 0.001 0 0 0 1 /end COMPU_METHOD
/begin CHARACTERISTIC EFMA_venturi_dP_C5 "Venturi EGR mixer EGR flow^2 dP scaling" VALUE 0x001c0044 /* @ECU_Address@EFMA_venturi_dP_C5@0x01013A00@ */ ECIPP_ALIGNMENT_FLOAT32_IEEE 10000000000 Compu_EFMA_venturi_dP_C5 -10000000000 10000000000 /end CHARACTERISTIC
/begin COMPU_METHOD Compu_EFMA_venturi_dP_C5 " " RAT_FUNC "%.4" "upsi-s^2/g^2" COEFFS 0 0.000001 0 0 0 1 /end COMPU_METHOD
/begin CHARACTERISTIC EGR_sys_config "EGR system configuration{EGR_sys_config&0xff=0:High-Pressure EGR}{EGR_sys_config&0xff=1:Low-Pressure EGR}" VALUE 0x001c0aaf /* @ECU_Address@EGR_sys_config@0x01013BF0@ */ ECIPP_ALIGNMENT_UBYTE 255 EGR_sys_config_COMPU_VTAB 0 255 BIT_MASK 0xff /end CHARACTERISTIC
/begin COMPU_METHOD EGR_sys_config_COMPU_VTAB "Verbal Table" TAB_VERB "%.0" "list" COMPU_TAB_REF EGR_sys_config_COMPU_VTAB_REF /end COMPU_METHOD
/begin COMPU_VTAB EGR_sys_config_COMPU_VTAB_REF "Verbal Table" TAB_VERB 2 0 "High-Pressure EGR" 1 "Low-Pressure EGR" DEFAULT_VALUE "UNKNOWN" /end COMPU_VTAB
/begin MEASUREMENT mdot_IRV_cmd "IRV mass flow" FLOAT32_IEEE Compu_mdot_IRV_cmd 0 0 -10000000000 10000000000 ECU_ADDRESS 0x01013C80 /end MEASUREMENT
/begin COMPU_METHOD Compu_mdot_IRV_cmd " " RAT_FUNC "%.1" "g/sec" COEFFS 0 1 0 0 0 1 /end COMPU_METHOD
/begin MEASUREMENT IRV_EGRLPd "EGRLP target" FLOAT32_IEEE Compu_IRV_EGRLPd 0 0 -10000000000 10000000000 ECU_ADDRESS 0x01013C88 /end MEASUREMENT
/begin COMPU_METHOD Compu_IRV_EGRLPd " " RAT_FUNC "%.2" "psia" COEFFS 0 1 0 0 0 1 /end COMPU_METHOD
/begin MEASUREMENT IRV_EGRLP_error "EGRLP error" FLOAT32_IEEE Compu_IRV_EGRLP_error 0 0 -10000000000 10000000000 ECU_ADDRESS 0x01013C90 /end MEASUREMENT
/begin COMPU_METHOD Compu_IRV_EGRLP_error " " RAT_FUNC "%.2" "psia" COEFFS 0 1 0 0 0 1 /end COMPU_METHOD
/begin MEASUREMENT IRV_AFILT_dP "Air filter dP at IRV command" FLOAT32_IEEE Compu_IRV_AFILT_dP 0 0 -10000000000 10000000000 ECU_ADDRESS 0x01013C98 /end MEASUREMENT
/begin COMPU_METHOD Compu_IRV_AFILT_dP " " RAT_FUNC "%.3" "psi" COEFFS 0 1 0 0 0 1 /end COMPU_METHOD
/begin MEASUREMENT IRV_Pin "IRV inlet pressure" FLOAT32_IEEE Compu_IRV_Pin 0 0 -10000000000 10000000000 ECU_ADDRESS 0x01013CA0 /end MEASUREMENT
/begin COMPU_METHOD Compu_IRV_Pin " " RAT_FUNC "%.2" "psia" COEFFS 0 1 0 0 0 1 /end COMPU_METHOD
/begin MEASUREMENT IRV_dP_cmd "IRV delta-P command" FLOAT32_IEEE Compu_IRV_dP_cmd 0 0 -10000000000 10000000000 ECU_ADDRESS 0x01013CA8 /end MEASUREMENT
/begin COMPU_METHOD Compu_IRV_dP_cmd " " RAT_FUNC "%.2" "psi" COEFFS 0 1 0 0 0 1 /end COMPU_METHOD
/begin MEASUREMENT IRV_CL_crct "IRV CL correction" FLOAT32_IEEE Compu_IRV_CL_crct 0 0 -10000000000 10000000000 ECU_ADDRESS 0x01013CB0 /end MEASUREMENT
/begin COMPU_METHOD Compu_IRV_CL_crct " " RAT_FUNC "%.1" "% area" COEFFS 0 0.01 0 0 0 1 /end COMPU_METHOD
/begin MEASUREMENT IRV_vlv_cmd "IRV position - command" UWORD Compu_IRV_vlv_cmd 0 0 0 99.9984741210938 ECU_ADDRESS 0x01013CB8 /end MEASUREMENT
/begin COMPU_METHOD Compu_IRV_vlv_cmd " " RAT_FUNC "%.1" "%" COEFFS 0 655.36 0 0 0 1 /end COMPU_METHOD
/begin MEASUREMENT IRV_vlv_act "IRV position - actual" UWORD Compu_IRV_vlv_act 0 0 0 99.9984741210938 ECU_ADDRESS 0x01013CC0 /end MEASUREMENT
/begin COMPU_METHOD Compu_IRV_vlv_act " " RAT_FUNC "%.1" "%" COEFFS 0 655.36 0 0 0 1 /end COMPU_METHOD
/begin CHARACTERISTIC IRV_CL_Amin "IRV CL min authority" VALUE 0x001c00a8 /* @ECU_Address@IRV_CL_Amin@0x01013CC8@ */ ECIPP_ALIGNMENT_FLOAT32_IEEE 10000000000 Compu_IRV_CL_Amin -10000000000 10000000000 /end CHARACTERISTIC
/begin COMPU_METHOD Compu_IRV_CL_Amin " " RAT_FUNC "%.1" "% area" COEFFS 0 0.01 0 0 0 1 /end COMPU_METHOD
/begin CHARACTERISTIC IRV_CL_Amax "IRV CL max authority" VALUE 0x001c00a4 /* @ECU_Address@IRV_CL_Amax@0x01013CD0@ */ ECIPP_ALIGNMENT_FLOAT32_IEEE 10000000000 Compu_IRV_CL_Amax -10000000000 10000000000 /end CHARACTERISTIC
/begin COMPU_METHOD Compu_IRV_CL_Amax " " RAT_FUNC "%.1" "% area" COEFFS 0 0.01 0 0 0 1 /end COMPU_METHOD
/begin CHARACTERISTIC IRV_CL_Kp "IRV CL gain Kp" VALUE 0x001c00b4 /* @ECU_Address@IRV_CL_Kp@0x01013CD8@ */ ECIPP_ALIGNMENT_FLOAT32_IEEE 10000000000 Compu_IRV_CL_Kp -10000000000 10000000000 /end CHARACTERISTIC
/begin COMPU_METHOD Compu_IRV_CL_Kp " " RAT_FUNC "%.0" "% area/psi" COEFFS 0 0.01 0 0 0 1 /end COMPU_METHOD
/begin CHARACTERISTIC IRV_CL_Ki "IRV CL gain Ki" VALUE 0x001c00b0 /* @ECU_Address@IRV_CL_Ki@0x01013CE0@ */ ECIPP_ALIGNMENT_FLOAT32_IEEE 10000000000 Compu_IRV_CL_Ki -10000000000 10000000000 /end CHARACTERISTIC
/begin COMPU_METHOD Compu_IRV_CL_Ki " " RAT_FUNC "%.0" "% area/psi/s" COEFFS 0 0.01 0 0 0 1 /end COMPU_METHOD
/begin CHARACTERISTIC IRV_CL_Kd "IRV CL gain Kd" VALUE 0x001c00ac /* @ECU_Address@IRV_CL_Kd@0x01013CE8@ */ ECIPP_ALIGNMENT_FLOAT32_IEEE 10000000000 Compu_IRV_CL_Kd -10000000000 10000000000 /end CHARACTERISTIC
/begin COMPU_METHOD Compu_IRV_CL_Kd " " RAT_FUNC "%.0" "% area /(psi/s)" COEFFS 0 0.01 0 0 0 1 /end COMPU_METHOD
/begin MEASUREMENT IRV_CL_Iaccum "IRV CL integral accum" FLOAT32_IEEE Compu_IRV_CL_Iaccum 0 0 -10000000000 10000000000 ECU_ADDRESS 0x01013CF0 /end MEASUREMENT
/begin COMPU_METHOD Compu_IRV_CL_Iaccum " " RAT_FUNC "%.1" "% area" COEFFS 0 0.01 0 0 0 1 /end COMPU_METHOD
/begin CHARACTERISTIC EGRLP_dedt_dz "EGRLP de/dt low-pass" VALUE 0x001c004c /* @ECU_Address@EGRLP_dedt_dz@0x01013CF8@ */ ECIPP_ALIGNMENT_FLOAT32_IEEE 10000000000 Compu_EGRLP_dedt_dz -10000000000 10000000000 /end CHARACTERISTIC
/begin COMPU_METHOD Compu_EGRLP_dedt_dz " " RAT_FUNC "%.0" "ms" COEFFS 0 1 0 0 0 1 /end COMPU_METHOD
/begin MEASUREMENT EGRLP_dedt "EGRLP error derivative de/dt" FLOAT32_IEEE Compu_EGRLP_dedt 0 0 -10000000000 10000000000 ECU_ADDRESS 0x01013D00 /end MEASUREMENT
/begin COMPU_METHOD Compu_EGRLP_dedt " " RAT_FUNC "%.1" "psi/s" COEFFS 0 1 0 0 0 1 /end COMPU_METHOD
/begin MEASUREMENT EGRdP_config "EGRdP configuration{EGRdP_config&0xff=0:None}{EGRdP_config&0xff=1:Invalid}{EGRdP_config&0xff=2:Orifice Flow}{EGRdP_config&0xff=3:Valve dP & EGRHP}{EGRdP_config&0xff=4:Valve dP & EGRLP}" UBYTE EGRdP_config_COMPU_VTAB 0 0 0 255 ECU_ADDRESS 0x01013D58 BIT_MASK 0xff /end MEASUREMENT
/begin COMPU_METHOD EGRdP_config_COMPU_VTAB "Verbal Table" TAB_VERB "%.0" "list" COMPU_TAB_REF EGRdP_config_COMPU_VTAB_REF /end COMPU_METHOD
/begin COMPU_VTAB EGRdP_config_COMPU_VTAB_REF "Verbal Table" TAB_VERB 5 0 "None" 1 "Invalid" 2 "Orifice Flow" 3 "Valve dP & EGRHP" 4 "Valve dP & EGRLP" DEFAULT_VALUE "UNKNOWN" /end COMPU_VTAB
/begin MEASUREMENT ACT "ACT = radiator bypass feedback" UWORD Compu_ACT 0 0 -460 563.984375 ECU_ADDRESS 0x01013D78 /end MEASUREMENT
/begin COMPU_METHOD Compu_ACT " " RAT_FUNC "%.1" "deg F" COEFFS 0 64 29440 0 0 1 /end COMPU_METHOD
/begin CHARACTERISTIC ACLT_radby_ena "Radiator bypass{ACLT_radby_ena&0xff=0:Disabled}{ACLT_radby_ena&0xff=1:H-bridge A}{ACLT_radby_ena&0xff=2:H-bridge B}{ACLT_radby_ena&0xff=3:Aux PWM1}{ACLT_radby_ena&0xff=4:Aux PWM2}{ACLT_radby_ena&0xff=5:Aux PWM3}{ACLT_radby_ena&0xff=6:Aux PWM4}{ACLT_radby_" VALUE 0x001C90D4 /* @ECU_Address@ACLT_radby_ena@0x01013D80@ */ ECIPP_ALIGNMENT_UBYTE 255 ACLT_radby_ena_COMPU_VTAB 0 255 BIT_MASK 0xff /end CHARACTERISTIC
/begin COMPU_METHOD ACLT_radby_ena_COMPU_VTAB "Verbal Table" TAB_VERB "%.0" "list" COMPU_TAB_REF ACLT_radby_ena_COMPU_VTAB_REF /end COMPU_METHOD
/begin COMPU_VTAB ACLT_radby_ena_COMPU_VTAB_REF "Verbal Table" TAB_VERB 29 0 "Disabled" 1 "H-bridge A" 2 "H-bridge B" 3 "Aux PWM1" 4 "Aux PWM2" 5 "Aux PWM3" 6 "Aux PWM4" 7 "Aux PWM5" 8 "Aux PWM6" 9 "Aux PWM7" 10 "Aux PWM8" 11 "Aux PWM9" 12 "Aux PWM10" 13 "Aux PWM11" 14 "Aux PWM12" 15 "Aux PWM13" 16 "Aux PWM14" 17 "Aux PWM15" 18 "Aux PWM16" 19 "Aux PWM17" 20 "Aux PWM18" 21 "Aux PWM19" 22 "Aux PWM20" 23 "Aux PWM21" 24 "Aux PWM22" 25 "Aux PWM23" 26 "CAN based" 27 "H-bridge A (remote)" 28 "H-bridge B (remote)" DEFAULT_VALUE "UNKNOWN" /end COMPU_VTAB
/begin CHARACTERISTIC ACLT_intby_ena "Intercooler/EGR split{ACLT_intby_ena&0xff=0:Disabled}{ACLT_intby_ena&0xff=1:H-bridge A}{ACLT_intby_ena&0xff=2:H-bridge B}{ACLT_intby_ena&0xff=3:Aux PWM1}{ACLT_intby_ena&0xff=4:Aux PWM2}{ACLT_intby_ena&0xff=5:Aux PWM3}{ACLT_intby_ena&0xff=6:Aux PWM4}{ACLT_" VALUE 0x001C90A8 /* @ECU_Address@ACLT_intby_ena@0x01013D88@ */ ECIPP_ALIGNMENT_UBYTE 255 ACLT_intby_ena_COMPU_VTAB 0 255 BIT_MASK 0xff /end CHARACTERISTIC
/begin COMPU_METHOD ACLT_intby_ena_COMPU_VTAB "Verbal Table" TAB_VERB "%.0" "list" COMPU_TAB_REF ACLT_intby_ena_COMPU_VTAB_REF /end COMPU_METHOD
/begin COMPU_VTAB ACLT_intby_ena_COMPU_VTAB_REF "Verbal Table" TAB_VERB 29 0 "Disabled" 1 "H-bridge A" 2 "H-bridge B" 3 "Aux PWM1" 4 "Aux PWM2" 5 "Aux PWM3" 6 "Aux PWM4" 7 "Aux PWM5" 8 "Aux PWM6" 9 "Aux PWM7" 10 "Aux PWM8" 11 "Aux PWM9" 12 "Aux PWM10" 13 "Aux PWM11" 14 "Aux PWM12" 15 "Aux PWM13" 16 "Aux PWM14" 17 "Aux PWM15" 18 "Aux PWM16" 19 "Aux PWM17" 20 "Aux PWM18" 21 "Aux PWM19" 22 "Aux PWM20" 23 "Aux PWM21" 24 "Aux PWM22" 25 "Aux PWM23" 26 "CAN based" 27 "H-bridge A (remote)" 28 "H-bridge B (remote)" DEFAULT_VALUE "UNKNOWN" /end COMPU_VTAB
/begin CHARACTERISTIC ACLT_radby_T_cmd "Temperature target - Radiator" VALUE 0x001c6d4e /* @ECU_Address@ACLT_radby_T_cmd@0x01013D90@ */ ECIPP_ALIGNMENT_UWORD 564 Compu_ACLT_radby_T_cmd -460 563.984375 /end CHARACTERISTIC
/begin COMPU_METHOD Compu_ACLT_radby_T_cmd " " RAT_FUNC "%.1" "deg F" COEFFS 0 64 29440 0 0 1 /end COMPU_METHOD
/begin MEASUREMENT ACLT_intby_T_cmd "Temperature target - Int/EGR Cooler" UWORD Compu_ACLT_intby_T_cmd 0 0 -460 563.984375 ECU_ADDRESS 0x01013D98 /end MEASUREMENT
/begin COMPU_METHOD Compu_ACLT_intby_T_cmd " " RAT_FUNC "%.1" "deg F" COEFFS 0 64 29440 0 0 1 /end COMPU_METHOD
/begin MEASUREMENT ACLT_radby_vlv_cmd "Valve position - command - Radiator" UWORD Compu_ACLT_radby_vlv_cmd 0 0 0 99.9984741210938 ECU_ADDRESS 0x01013DA0 /end MEASUREMENT
/begin COMPU_METHOD Compu_ACLT_radby_vlv_cmd " " RAT_FUNC "%.1" "%" COEFFS 0 655.36 0 0 0 1 /end COMPU_METHOD
/begin MEASUREMENT ACLT_intby_vlv_cmd "Valve position - command - Int/EGR Cooler" UWORD Compu_ACLT_intby_vlv_cmd 0 0 0 99.9984741210938 ECU_ADDRESS 0x01013DA8 /end MEASUREMENT
/begin COMPU_METHOD Compu_ACLT_intby_vlv_cmd " " RAT_FUNC "%.1" "%" COEFFS 0 655.36 0 0 0 1 /end COMPU_METHOD
/begin MEASUREMENT ACLT_radby_vlv_act "Valve position - actual - Radiator" UWORD Compu_ACLT_radby_vlv_act 0 0 0 99.9984741210938 ECU_ADDRESS 0x01013DB0 /end MEASUREMENT
/begin COMPU_METHOD Compu_ACLT_radby_vlv_act " " RAT_FUNC "%.1" "%" COEFFS 0 655.36 0 0 0 1 /end COMPU_METHOD
/begin MEASUREMENT ACLT_intby_vlv_act "Valve position - actual - Int/EGR Cooler" UWORD Compu_ACLT_intby_vlv_act 0 0 0 99.9984741210938 ECU_ADDRESS 0x01013DB8 /end MEASUREMENT
/begin COMPU_METHOD Compu_ACLT_intby_vlv_act " " RAT_FUNC "%.1" "%" COEFFS 0 655.36 0 0 0 1 /end COMPU_METHOD
/begin CHARACTERISTIC ACLT_radby_vlv_def "Valve default position - Radiator" VALUE 0x001C90E4 /* @ECU_Address@ACLT_radby_vlv_def@0x01013DE8@ */ ECIPP_ALIGNMENT_UWORD 100 Compu_ACLT_radby_vlv_def 0 99.9984741210938 /end CHARACTERISTIC
/begin COMPU_METHOD Compu_ACLT_radby_vlv_def " " RAT_FUNC "%.1" "%" COEFFS 0 655.36 0 0 0 1 /end COMPU_METHOD
/begin CHARACTERISTIC ACLT_intby_vlv_def "Valve default position - Int/EGR Cooler" VALUE 0x001C90B8 /* @ECU_Address@ACLT_intby_vlv_def@0x01013DF0@ */ ECIPP_ALIGNMENT_UWORD 100 Compu_ACLT_intby_vlv_def 0 99.9984741210938 /end CHARACTERISTIC
/begin COMPU_METHOD Compu_ACLT_intby_vlv_def " " RAT_FUNC "%.1" "%" COEFFS 0 655.36 0 0 0 1 /end COMPU_METHOD
/begin MEASUREMENT ACLT_radby_vlv_halt "Valve control halted - Radiator{ACLT_radby_vlv_halt&0xff=0:Active}{ACLT_radby_vlv_halt&0xff=1:Halted}" UBYTE ACLT_radby_vlv_halt_COMPU_VTAB 0 0 0 255 ECU_ADDRESS 0x01013DF8 BIT_MASK 0xff /end MEASUREMENT
/begin COMPU_METHOD ACLT_radby_vlv_halt_COMPU_VTAB "Verbal Table" TAB_VERB "%.0" "list" COMPU_TAB_REF ACLT_radby_vlv_halt_COMPU_VTAB_REF /end COMPU_METHOD
/begin COMPU_VTAB ACLT_radby_vlv_halt_COMPU_VTAB_REF "Verbal Table" TAB_VERB 2 0 "Active" 1 "Halted" DEFAULT_VALUE "UNKNOWN" /end COMPU_VTAB
/begin MEASUREMENT ACLT_intby_vlv_halt "Valve control halted - Int/EGR Cooler{ACLT_intby_vlv_halt&0xff=0:Active}{ACLT_intby_vlv_halt&0xff=1:Halted}" UBYTE ACLT_intby_vlv_halt_COMPU_VTAB 0 0 0 255 ECU_ADDRESS 0x01013E00 BIT_MASK 0xff /end MEASUREMENT
/begin COMPU_METHOD ACLT_intby_vlv_halt_COMPU_VTAB "Verbal Table" TAB_VERB "%.0" "list" COMPU_TAB_REF ACLT_intby_vlv_halt_COMPU_VTAB_REF /end COMPU_METHOD
/begin COMPU_VTAB ACLT_intby_vlv_halt_COMPU_VTAB_REF "Verbal Table" TAB_VERB 2 0 "Active" 1 "Halted" DEFAULT_VALUE "UNKNOWN" /end COMPU_VTAB
/begin MEASUREMENT SH_airEGR_mix "SH air + EGR" UWORD Compu_SH_airEGR_mix 0 0 0 15999.755859375 ECU_ADDRESS 0x01013E20 /end MEASUREMENT
/begin COMPU_METHOD Compu_SH_airEGR_mix " " RAT_FUNC "%.1" "g/kg" COEFFS 0 4.096 0 0 0 1 /end COMPU_METHOD
/begin MEASUREMENT Tdewpt_pre_intclr "Pre-intercooler dewpoint" UWORD Compu_Tdewpt_pre_intclr 0 0 -460 7731.875 ECU_ADDRESS 0x01013E28 /end MEASUREMENT
/begin COMPU_METHOD Compu_Tdewpt_pre_intclr " " RAT_FUNC "%.1" "deg F" COEFFS 0 8 3680 0 0 1 /end COMPU_METHOD
/begin MEASUREMENT Tdewpt_pst_intclr "Post-intercooler dewpoint" UWORD Compu_Tdewpt_pst_intclr 0 0 -460 7731.875 ECU_ADDRESS 0x01013E30 /end MEASUREMENT
/begin COMPU_METHOD Compu_Tdewpt_pst_intclr " " RAT_FUNC "%.1" "deg F" COEFFS 0 8 3680 0 0 1 /end COMPU_METHOD
/begin MEASUREMENT EGR_off_tmr_ms "EGR off timer" ULONG Compu_EGR_off_tmr_ms 0 0 0 4294967.295 ECU_ADDRESS 0x01013E38 /end MEASUREMENT
/begin COMPU_METHOD Compu_EGR_off_tmr_ms " " RAT_FUNC "%.1" "sec" COEFFS 0 1000 0 0 0 1 /end COMPU_METHOD
/begin MEASUREMENT ACLT_pump_Lmin "Auxiliary coolant current flow rate" UWORD Compu_ACLT_pump_Lmin 0 0 0 4095.9375 ECU_ADDRESS 0x01013E40 /end MEASUREMENT
/begin COMPU_METHOD Compu_ACLT_pump_Lmin " " RAT_FUNC "%.1" "L/min" COEFFS 0 16 0 0 0 1 /end COMPU_METHOD
/begin MEASUREMENT ACLT_intclr_dTi "Intake mix-coolant inlet temp diff" SWORD Compu_ACLT_intclr_dTi 0 0 -512 511.984375 ECU_ADDRESS 0x01013E48 /end MEASUREMENT
/begin COMPU_METHOD Compu_ACLT_intclr_dTi " " RAT_FUNC "%.1" "deg F" COEFFS 0 64 0 0 0 1 /end COMPU_METHOD
/begin MEASUREMENT ACLT_intclr_dTh_ff "Feedforward intake temp drop" SWORD Compu_ACLT_intclr_dTh_ff 0 0 -512 511.984375 ECU_ADDRESS 0x01013E50 /end MEASUREMENT
/begin COMPU_METHOD Compu_ACLT_intclr_dTh_ff " " RAT_FUNC "%.1" "deg F" COEFFS 0 64 0 0 0 1 /end COMPU_METHOD
/begin MEASUREMENT ACLT_intclr_dTh "Intake mix temperature drop" SWORD Compu_ACLT_intclr_dTh 0 0 -512 511.984375 ECU_ADDRESS 0x01013E58 /end MEASUREMENT
/begin COMPU_METHOD Compu_ACLT_intclr_dTh " " RAT_FUNC "%.1" "deg F" COEFFS 0 64 0 0 0 1 /end COMPU_METHOD
/begin MEASUREMENT ACLT_intclr_Qmax "Max heat rejection" UWORD Compu_ACLT_intclr_Qmax 0 0 0 262.14 ECU_ADDRESS 0x01013E60 /end MEASUREMENT
/begin COMPU_METHOD Compu_ACLT_intclr_Qmax " " RAT_FUNC "%.1" "kW" COEFFS 0 250 0 0 0 1 /end COMPU_METHOD
/begin MEASUREMENT ACLT_intclr_Qff "Feedforward heat rejection" UWORD Compu_ACLT_intclr_Qff 0 0 0 262.14 ECU_ADDRESS 0x01013E68 /end MEASUREMENT
/begin COMPU_METHOD Compu_ACLT_intclr_Qff " " RAT_FUNC "%.1" "kW" COEFFS 0 250 0 0 0 1 /end COMPU_METHOD
/begin MEASUREMENT ACLT_intclr_Q "Actual heat rejection" UWORD Compu_ACLT_intclr_Q 0 0 0 262.14 ECU_ADDRESS 0x01013E70 /end MEASUREMENT
/begin COMPU_METHOD Compu_ACLT_intclr_Q " " RAT_FUNC "%.1" "kW" COEFFS 0 250 0 0 0 1 /end COMPU_METHOD
/begin MEASUREMENT ACLT_intclr_eff_ff "Feedforward intercooler effectiveness" UWORD Compu_ACLT_intclr_eff_ff 0 0 0 3.99993896484375 ECU_ADDRESS 0x01013E78 /end MEASUREMENT
/begin COMPU_METHOD Compu_ACLT_intclr_eff_ff " " RAT_FUNC "%.2" "-" COEFFS 0 16384 0 0 0 1 /end COMPU_METHOD
/begin MEASUREMENT ACLT_intclr_eff "Intercooler effectiveness" UWORD Compu_ACLT_intclr_eff 0 0 0 3.99993896484375 ECU_ADDRESS 0x01013E80 /end MEASUREMENT
/begin COMPU_METHOD Compu_ACLT_intclr_eff " " RAT_FUNC "%.2" "-" COEFFS 0 16384 0 0 0 1 /end COMPU_METHOD
/begin MEASUREMENT ACLT_intclr_mdotx "Actual intake mix / coolant mass flow" UWORD Compu_ACLT_intclr_mdotx 0 0 0 63.9990234375 ECU_ADDRESS 0x01013E88 /end MEASUREMENT
/begin COMPU_METHOD Compu_ACLT_intclr_mdotx " " RAT_FUNC "%.2" "-" COEFFS 0 1024 0 0 0 1 /end COMPU_METHOD
/begin MEASUREMENT ACLT_intclr_Lmin_ff "Feedforward intercooler flow" UWORD Compu_ACLT_intclr_Lmin_ff 0 0 0 4095.9375 ECU_ADDRESS 0x01013E90 /end MEASUREMENT
/begin COMPU_METHOD Compu_ACLT_intclr_Lmin_ff " " RAT_FUNC "%.1" "L/min" COEFFS 0 16 0 0 0 1 /end COMPU_METHOD
/begin MEASUREMENT ACLT_intclr_Lmin "Actual intercooler flow" UWORD Compu_ACLT_intclr_Lmin 0 0 0 4095.9375 ECU_ADDRESS 0x01013E98 /end MEASUREMENT
/begin COMPU_METHOD Compu_ACLT_intclr_Lmin " " RAT_FUNC "%.1" "L/min" COEFFS 0 16 0 0 0 1 /end COMPU_METHOD
/begin MEASUREMENT ACLT_rad_Lmin_ff "Feedforward radiator flow" UWORD Compu_ACLT_rad_Lmin_ff 0 0 0 4095.9375 ECU_ADDRESS 0x01013EA0 /end MEASUREMENT
/begin COMPU_METHOD Compu_ACLT_rad_Lmin_ff " " RAT_FUNC "%.1" "L/min" COEFFS 0 16 0 0 0 1 /end COMPU_METHOD
/begin MEASUREMENT ACLT_rad_Lmin "Actual radiator flow" UWORD Compu_ACLT_rad_Lmin 0 0 0 4095.9375 ECU_ADDRESS 0x01013EA8 /end MEASUREMENT
/begin COMPU_METHOD Compu_ACLT_rad_Lmin " " RAT_FUNC "%.1" "L/min" COEFFS 0 16 0 0 0 1 /end COMPU_METHOD
/begin CHARACTERISTIC ACLT_radby_Kp "Valve CL Kp - Radiator" VALUE 0x001C90D8 /* @ECU_Address@ACLT_radby_Kp@0x01013EB0@ */ ECIPP_ALIGNMENT_FLOAT32_IEEE 10000000000 Compu_ACLT_radby_Kp -10000000000 10000000000 /end CHARACTERISTIC
/begin COMPU_METHOD Compu_ACLT_radby_Kp " " RAT_FUNC "%.1" "(L/min)/deg F" COEFFS 0 1 0 0 0 1 /end COMPU_METHOD
/begin CHARACTERISTIC ACLT_intby_Kp "Valve CL Kp - Int/EGR Cooler" VALUE 0x001C90AC /* @ECU_Address@ACLT_intby_Kp@0x01013EB8@ */ ECIPP_ALIGNMENT_FLOAT32_IEEE 10000000000 Compu_ACLT_intby_Kp -10000000000 10000000000 /end CHARACTERISTIC
/begin COMPU_METHOD Compu_ACLT_intby_Kp " " RAT_FUNC "%.1" "(L/min)/deg F" COEFFS 0 1 0 0 0 1 /end COMPU_METHOD
/begin CHARACTERISTIC ACLT_radby_Ki "Valve CL Ki - Radiator" VALUE 0x001C90DC /* @ECU_Address@ACLT_radby_Ki@0x01013EC0@ */ ECIPP_ALIGNMENT_FLOAT32_IEEE 10000000000 Compu_ACLT_radby_Ki -10000000000 10000000000 /end CHARACTERISTIC
/begin COMPU_METHOD Compu_ACLT_radby_Ki " " RAT_FUNC "%.2" "(L/min)/deg F/s" COEFFS 0 0.001 0 0 0 1 /end COMPU_METHOD
/begin CHARACTERISTIC ACLT_intby_Ki "Valve CL Ki - Int/EGR Cooler" VALUE 0x001C90B0 /* @ECU_Address@ACLT_intby_Ki@0x01013EC8@ */ ECIPP_ALIGNMENT_FLOAT32_IEEE 10000000000 Compu_ACLT_intby_Ki -10000000000 10000000000 /end CHARACTERISTIC
/begin COMPU_METHOD Compu_ACLT_intby_Ki " " RAT_FUNC "%.2" "(L/min)/deg F/s" COEFFS 0 0.001 0 0 0 1 /end COMPU_METHOD
/begin CHARACTERISTIC ACLT_radby_vlv_min "Valve min position - Radiator" VALUE 0x001C90E6 /* @ECU_Address@ACLT_radby_vlv_min@0x01013ED0@ */ ECIPP_ALIGNMENT_UWORD 100 Compu_ACLT_radby_vlv_min 0 99.9984741210938 /end CHARACTERISTIC
/begin COMPU_METHOD Compu_ACLT_radby_vlv_min " " RAT_FUNC "%.1" "%" COEFFS 0 655.36 0 0 0 1 /end COMPU_METHOD
/begin CHARACTERISTIC ACLT_intby_vlv_min "Valve min position - Int/EGR Cooler" VALUE 0x001C90BA /* @ECU_Address@ACLT_intby_vlv_min@0x01013ED8@ */ ECIPP_ALIGNMENT_UWORD 100 Compu_ACLT_intby_vlv_min 0 99.9984741210938 /end CHARACTERISTIC
/begin COMPU_METHOD Compu_ACLT_intby_vlv_min " " RAT_FUNC "%.1" "%" COEFFS 0 655.36 0 0 0 1 /end COMPU_METHOD
/begin CHARACTERISTIC ACLT_radby_vlv_max "Valve max position - Radiator" VALUE 0x001C90E8 /* @ECU_Address@ACLT_radby_vlv_max@0x01013EE0@ */ ECIPP_ALIGNMENT_UWORD 100 Compu_ACLT_radby_vlv_max 0 99.9984741210938 /end CHARACTERISTIC
/begin COMPU_METHOD Compu_ACLT_radby_vlv_max " " RAT_FUNC "%.1" "%" COEFFS 0 655.36 0 0 0 1 /end COMPU_METHOD
/begin CHARACTERISTIC ACLT_intby_vlv_max "Valve max position - Int/EGR Cooler" VALUE 0x001C90BC /* @ECU_Address@ACLT_intby_vlv_max@0x01013EE8@ */ ECIPP_ALIGNMENT_UWORD 100 Compu_ACLT_intby_vlv_max 0 99.9984741210938 /end CHARACTERISTIC
/begin COMPU_METHOD Compu_ACLT_intby_vlv_max " " RAT_FUNC "%.1" "%" COEFFS 0 655.36 0 0 0 1 /end COMPU_METHOD
/begin MEASUREMENT ACLT_radby_I_accum "Valve CL I accum - Radiator" FLOAT32_IEEE Compu_ACLT_radby_I_accum 0 0 -10000000000 10000000000 ECU_ADDRESS 0x01013EF0 /end MEASUREMENT
/begin COMPU_METHOD Compu_ACLT_radby_I_accum " " RAT_FUNC "%.1" "L/min" COEFFS 0 1 0 0 0 1 /end COMPU_METHOD
/begin MEASUREMENT ACLT_intby_I_accum "Valve CL I accum - Int/EGR Cooler" FLOAT32_IEEE Compu_ACLT_intby_I_accum 0 0 -10000000000 10000000000 ECU_ADDRESS 0x01013EF8 /end MEASUREMENT
/begin COMPU_METHOD Compu_ACLT_intby_I_accum " " RAT_FUNC "%.1" "L/min" COEFFS 0 1 0 0 0 1 /end COMPU_METHOD
/begin MEASUREMENT ACLT_radby_Lmin_CL "Valve CL correction - Radiator" FLOAT32_IEEE Compu_ACLT_radby_Lmin_CL 0 0 -10000000000 10000000000 ECU_ADDRESS 0x01013F00 /end MEASUREMENT
/begin COMPU_METHOD Compu_ACLT_radby_Lmin_CL " " RAT_FUNC "%.1" "L/min" COEFFS 0 1 0 0 0 1 /end COMPU_METHOD
/begin MEASUREMENT ACLT_intby_Lmin_CL "Valve CL correction - Int/EGR Cooler" FLOAT32_IEEE Compu_ACLT_intby_Lmin_CL 0 0 -10000000000 10000000000 ECU_ADDRESS 0x01013F08 /end MEASUREMENT
/begin COMPU_METHOD Compu_ACLT_intby_Lmin_CL " " RAT_FUNC "%.1" "L/min" COEFFS 0 1 0 0 0 1 /end COMPU_METHOD
/begin MEASUREMENT ACLT_radby_T_error "Temperature error - Radiator" SWORD Compu_ACLT_radby_T_error 0 0 -512 511.984375 ECU_ADDRESS 0x01013F10 /end MEASUREMENT
/begin COMPU_METHOD Compu_ACLT_radby_T_error " " RAT_FUNC "%.1" "deg F" COEFFS 0 64 0 0 0 1 /end COMPU_METHOD
/begin MEASUREMENT ACLT_intby_T_error "Temperature error - Int/EGR Cooler" SWORD Compu_ACLT_intby_T_error 0 0 -512 511.984375 ECU_ADDRESS 0x01013F18 /end MEASUREMENT
/begin COMPU_METHOD Compu_ACLT_intby_T_error " " RAT_FUNC "%.1" "deg F" COEFFS 0 64 0 0 0 1 /end COMPU_METHOD
/begin CHARACTERISTIC ACLT_radby_dT_halt "Temperature error control halt - Radiator" VALUE 0x001C90E0 /* @ECU_Address@ACLT_radby_dT_halt@0x01013F20@ */ ECIPP_ALIGNMENT_UWORD 1024 Compu_ACLT_radby_dT_halt 0 1023.984375 /end CHARACTERISTIC
/begin COMPU_METHOD Compu_ACLT_radby_dT_halt " " RAT_FUNC "%.1" "deg F" COEFFS 0 64 0 0 0 1 /end COMPU_METHOD
/begin CHARACTERISTIC ACLT_intby_dT_halt "Temperature error control halt - Int/EGR Cooler" VALUE 0x001C90B4 /* @ECU_Address@ACLT_intby_dT_halt@0x01013F28@ */ ECIPP_ALIGNMENT_UWORD 1024 Compu_ACLT_intby_dT_halt 0 1023.984375 /end CHARACTERISTIC
/begin COMPU_METHOD Compu_ACLT_intby_dT_halt " " RAT_FUNC "%.1" "deg F" COEFFS 0 64 0 0 0 1 /end COMPU_METHOD
/begin CHARACTERISTIC ACLT_radby_dT_res "Temperature error control resume - Radiator" VALUE 0x001C90E2 /* @ECU_Address@ACLT_radby_dT_res@0x01013F30@ */ ECIPP_ALIGNMENT_UWORD 1024 Compu_ACLT_radby_dT_res 0 1023.984375 /end CHARACTERISTIC
/begin COMPU_METHOD Compu_ACLT_radby_dT_res " " RAT_FUNC "%.1" "deg F" COEFFS 0 64 0 0 0 1 /end COMPU_METHOD
/begin CHARACTERISTIC ACLT_intby_dT_res "Temperature error control resume - Int/EGR Cooler" VALUE 0x001C90B6 /* @ECU_Address@ACLT_intby_dT_res@0x01013F38@ */ ECIPP_ALIGNMENT_UWORD 1024 Compu_ACLT_intby_dT_res 0 1023.984375 /end CHARACTERISTIC
/begin COMPU_METHOD Compu_ACLT_intby_dT_res " " RAT_FUNC "%.1" "deg F" COEFFS 0 64 0 0 0 1 /end COMPU_METHOD
/begin CHARACTERISTIC ACLT_EGRclr_min_Lmin "EGR cooler minimum coolant flow" VALUE 0x001c6d38 /* @ECU_Address@ACLT_EGRclr_min_Lmin@0x01013F40@ */ ECIPP_ALIGNMENT_UWORD 4096 Compu_ACLT_EGRclr_min_Lmin 0 4095.9375 /end CHARACTERISTIC
/begin COMPU_METHOD Compu_ACLT_EGRclr_min_Lmin " " RAT_FUNC "%.1" "L/min" COEFFS 0 16 0 0 0 1 /end COMPU_METHOD
/begin MEASUREMENT ACLT_EGRclr_Lmin "EGR cooler coolant flow rate" UWORD Compu_ACLT_EGRclr_Lmin 0 0 0 4095.9375 ECU_ADDRESS 0x01013F48 /end MEASUREMENT
/begin COMPU_METHOD Compu_ACLT_EGRclr_Lmin " " RAT_FUNC "%.1" "L/min" COEFFS 0 16 0 0 0 1 /end COMPU_METHOD
/begin CHARACTERISTIC ACLT_intby_T_ofs "Temperature target offset" VALUE 0x001c6d4c /* @ECU_Address@ACLT_intby_T_ofs@0x01013F80@ */ ECIPP_ALIGNMENT_UWORD 1024 Compu_ACLT_intby_T_ofs 0 1023.984375 /end CHARACTERISTIC
/begin COMPU_METHOD Compu_ACLT_intby_T_ofs " " RAT_FUNC "%.1" "deg F" COEFFS 0 64 0 0 0 1 /end COMPU_METHOD
/begin CHARACTERISTIC Tdewpt_pst_intclrtau "Post-intercooler dewpoint tau" VALUE 0x001c8610 /* @ECU_Address@Tdewpt_pst_intclrtau@0x01013F88@ */ ECIPP_ALIGNMENT_UWORD 3277 Compu_Tdewpt_pst_intclrtau 0.0045084 3276.8 /end CHARACTERISTIC
/begin COMPU_METHOD Compu_Tdewpt_pst_intclrtau " " FORM "%.1" "sec"
 /begin FORMULA "-0.05 / log(1 - (X1 / 65536))" FORMULA_INV "(1 - exp(-0.05/X1)) * 65536" /end FORMULA
/end COMPU_METHOD
/begin MEASUREMENT ACLT_pump_max_Lmin "Auxiliary coolant maximum flow rate" UWORD Compu_ACLT_pump_max_Lmin 0 0 0 4095.9375 ECU_ADDRESS 0x01013F90 /end MEASUREMENT
/begin COMPU_METHOD Compu_ACLT_pump_max_Lmin " " RAT_FUNC "%.1" "L/min" COEFFS 0 16 0 0 0 1 /end COMPU_METHOD
/begin MEASUREMENT ICCOT "Intercooler coolant outlet temperature" FLOAT32_IEEE Compu_ICCOT 0 0 -10000000000 10000000000 ECU_ADDRESS 0x01013FB0 /end MEASUREMENT
/begin COMPU_METHOD Compu_ICCOT " " RAT_FUNC "%.1" "deg F" COEFFS 0 1 460 0 0 1 /end COMPU_METHOD
/begin CHARACTERISTIC ICCOT_resp_tau "Sensor response time" VALUE 0x001c7c50 /* @ECU_Address@ICCOT_resp_tau@0x01013FB8@ */ ECIPP_ALIGNMENT_UWORD 256 Compu_ICCOT_resp_tau 0 255.99609375 /end CHARACTERISTIC
/begin COMPU_METHOD Compu_ICCOT_resp_tau " " RAT_FUNC "%.1" "T63 sec" COEFFS 0 256 0 0 0 1 /end COMPU_METHOD
/begin CHARACTERISTIC ICCOT_proj_tau "Projected outlet temperature tau" VALUE 0x001c8556 /* @ECU_Address@ICCOT_proj_tau@0x01013FC0@ */ ECIPP_ALIGNMENT_UWORD 3276795 Compu_ICCOT_proj_tau 4.5084 3276800 /end CHARACTERISTIC
/begin COMPU_METHOD Compu_ICCOT_proj_tau " " FORM "%.0" "ms"
 /begin FORMULA "-50 / log(1 - (X1 / 65536))" FORMULA_INV "(1 - exp(-50/X1)) * 65536" /end FORMULA
/end COMPU_METHOD
/begin MEASUREMENT ICCOT_proj_lp "Projected outlet temperature" FLOAT32_IEEE Compu_ICCOT_proj_lp 0 0 -10000000000 10000000000 ECU_ADDRESS 0x01013FC8 /end MEASUREMENT
/begin COMPU_METHOD Compu_ICCOT_proj_lp " " RAT_FUNC "%.1" "deg F" COEFFS 0 1 460 0 0 1 /end COMPU_METHOD
/begin CHARACTERISTIC ACLT_intTlim_T_max "Projected outlet temperature limit" VALUE 0x001c6d3c /* @ECU_Address@ACLT_intTlim_T_max@0x01013FD0@ */ ECIPP_ALIGNMENT_UWORD 564 Compu_ACLT_intTlim_T_max -460 563.984375 /end CHARACTERISTIC
/begin COMPU_METHOD Compu_ACLT_intTlim_T_max " " RAT_FUNC "%.1" "deg F" COEFFS 0 64 29440 0 0 1 /end COMPU_METHOD
/begin CHARACTERISTIC ACLT_intTlim_Kp "Projection over-limit Kp" VALUE 0x001c3a54 /* @ECU_Address@ACLT_intTlim_Kp@0x01013FD8@ */ ECIPP_ALIGNMENT_FLOAT32_IEEE 10000000000 Compu_ACLT_intTlim_Kp -10000000000 10000000000 /end CHARACTERISTIC
/begin COMPU_METHOD Compu_ACLT_intTlim_Kp " " RAT_FUNC "%.1" "(L/min)/deg F" COEFFS 0 1 0 0 0 1 /end COMPU_METHOD
/begin CHARACTERISTIC ACLT_intTlim_Ki "Projection over-limit Ki" VALUE 0x001c3a50 /* @ECU_Address@ACLT_intTlim_Ki@0x01013FE0@ */ ECIPP_ALIGNMENT_FLOAT32_IEEE 10000000000 Compu_ACLT_intTlim_Ki -10000000000 10000000000 /end CHARACTERISTIC
/begin COMPU_METHOD Compu_ACLT_intTlim_Ki " " RAT_FUNC "%.2" "(L/min)/deg F/s" COEFFS 0 0.001 0 0 0 1 /end COMPU_METHOD
/begin CHARACTERISTIC ACLT_intTlim_Amin "Intercooler absolute minimum coolant flow" VALUE 0x001c6d3a /* @ECU_Address@ACLT_intTlim_Amin@0x01013FE8@ */ ECIPP_ALIGNMENT_UWORD 4096 Compu_ACLT_intTlim_Amin 0 4095.9375 /end CHARACTERISTIC
/begin COMPU_METHOD Compu_ACLT_intTlim_Amin " " RAT_FUNC "%.1" "L/min" COEFFS 0 16 0 0 0 1 /end COMPU_METHOD
/begin CHARACTERISTIC ACLT_intTlim_I_decay "Over-limit integral decay" VALUE 0x001c3a4c /* @ECU_Address@ACLT_intTlim_I_decay@0x01013FF0@ */ ECIPP_ALIGNMENT_FLOAT32_IEEE 10000000000 Compu_ACLT_intTlim_I_decay -10000000000 10000000000 /end CHARACTERISTIC
/begin COMPU_METHOD Compu_ACLT_intTlim_I_decay " " RAT_FUNC "%.1" "L/min/s" COEFFS 0 0.001 0 0 0 1 /end COMPU_METHOD
/begin MEASUREMENT ACLT_intTlim_I_accum "Over-limit integral accumulator" FLOAT32_IEEE Compu_ACLT_intTlim_I_accum 0 0 -10000000000 10000000000 ECU_ADDRESS 0x01013FF8 /end MEASUREMENT
/begin COMPU_METHOD Compu_ACLT_intTlim_I_accum " " RAT_FUNC "%.1" "L/min" COEFFS 0 1 0 0 0 1 /end COMPU_METHOD
/begin MEASUREMENT ACLT_intTlim_minLmin "Intercooler minimum coolant flow" UWORD Compu_ACLT_intTlim_minLmin 0 0 0 4095.9375 ECU_ADDRESS 0x01014000 /end MEASUREMENT
/begin COMPU_METHOD Compu_ACLT_intTlim_minLmin " " RAT_FUNC "%.1" "L/min" COEFFS 0 16 0 0 0 1 /end COMPU_METHOD
/begin CHARACTERISTIC ACLT_intTlim_crct_Kp "Flow correction Kp per excursion" VALUE 0x001c6d3e /* @ECU_Address@ACLT_intTlim_crct_Kp@0x01014008@ */ ECIPP_ALIGNMENT_UWORD 100 Compu_ACLT_intTlim_crct_Kp 0 99.9984741210938 /end CHARACTERISTIC
/begin COMPU_METHOD Compu_ACLT_intTlim_crct_Kp " " RAT_FUNC "%.2" "%/(L/min)" COEFFS 0 655.36 0 0 0 1 /end COMPU_METHOD
/begin CHARACTERISTIC ACLT_intTlim_crctmin "Minimum flow correction" VALUE 0x001c6d42 /* @ECU_Address@ACLT_intTlim_crctmin@0x01014010@ */ ECIPP_ALIGNMENT_UWORD 6400 Compu_ACLT_intTlim_crctmin 0 6399.90234375 /end CHARACTERISTIC
/begin COMPU_METHOD Compu_ACLT_intTlim_crctmin " " RAT_FUNC "%.2" "%" COEFFS 0 10.24 0 0 0 1 /end COMPU_METHOD
/begin MEASUREMENT ACLT_intclr_Q_dT_max "Heat transfer per thermal margin" UWORD Compu_ACLT_intclr_Q_dT_max 0 0 0 262140 ECU_ADDRESS 0x01014028 /end MEASUREMENT
/begin COMPU_METHOD Compu_ACLT_intclr_Q_dT_max " " RAT_FUNC "%.1" "W/deg F" COEFFS 0 0.25 0 0 0 1 /end COMPU_METHOD
/begin CHARACTERISTIC ACLT_intTlim_trst_th "Correction confidence increase threshold" VALUE 0x001c6d46 /* @ECU_Address@ACLT_intTlim_trst_th@0x01014030@ */ ECIPP_ALIGNMENT_UWORD 262140 Compu_ACLT_intTlim_trst_th 0 262140 /end CHARACTERISTIC
/begin COMPU_METHOD Compu_ACLT_intTlim_trst_th " " RAT_FUNC "%.1" "W/deg F" COEFFS 0 0.25 0 0 0 1 /end COMPU_METHOD
/begin CHARACTERISTIC ACLT_intTlim_trust_i "Correction confidence increase time" VALUE 0x001c6d4a /* @ECU_Address@ACLT_intTlim_trust_i@0x01014038@ */ ECIPP_ALIGNMENT_UWORD 65535 Compu_ACLT_intTlim_trust_i 0 65535 /end CHARACTERISTIC
/begin COMPU_METHOD Compu_ACLT_intTlim_trust_i " " RAT_FUNC "%.0" "sec" COEFFS 0 1 0 0 0 1 /end COMPU_METHOD
/begin CHARACTERISTIC ACLT_intTlim_trust_d "Correction confidence decrease time" VALUE 0x001c6d48 /* @ECU_Address@ACLT_intTlim_trust_d@0x01014040@ */ ECIPP_ALIGNMENT_UWORD 65535 Compu_ACLT_intTlim_trust_d 0 65535 /end CHARACTERISTIC
/begin COMPU_METHOD Compu_ACLT_intTlim_trust_d " " RAT_FUNC "%.0" "sec" COEFFS 0 1 0 0 0 1 /end COMPU_METHOD
/begin MEASUREMENT ACLT_intTlim_trust "Correction confidence" FLOAT32_IEEE Compu_ACLT_intTlim_trust 0 0 -10000000000 10000000000 ECU_ADDRESS 0x01014048 /end MEASUREMENT
/begin COMPU_METHOD Compu_ACLT_intTlim_trust " " RAT_FUNC "%.1" "%" COEFFS 0 0.01 0 0 0 1 /end COMPU_METHOD
/begin CHARACTERISTIC ACLT_intTlim_crctdcy "Correction decay rate" VALUE 0x001c6d40 /* @ECU_Address@ACLT_intTlim_crctdcy@0x01014050@ */ ECIPP_ALIGNMENT_UWORD 100 Compu_ACLT_intTlim_crctdcy 0 99.9984741210938 /end CHARACTERISTIC
/begin COMPU_METHOD Compu_ACLT_intTlim_crctdcy " " RAT_FUNC "%.2" "%/period" COEFFS 0 655.36 0 0 0 1 /end COMPU_METHOD
/begin CHARACTERISTIC ACLT_intTlim_pctmax "Temp limiting max flow authority" VALUE 0x001c6d44 /* @ECU_Address@ACLT_intTlim_pctmax@0x01014088@ */ ECIPP_ALIGNMENT_UWORD 100 Compu_ACLT_intTlim_pctmax 0 99.9984741210938 /end CHARACTERISTIC
/begin COMPU_METHOD Compu_ACLT_intTlim_pctmax " " RAT_FUNC "%.1" "% max flow" COEFFS 0 655.36 0 0 0 1 /end COMPU_METHOD
/begin CHARACTERISTIC EGRad_UEGO_stable_wt "EGR CL remote UEGO stable wait" VALUE 0x001c09d6 /* @ECU_Address@EGRad_UEGO_stable_wt@0x01014090@ */ ECIPP_ALIGNMENT_UWORD 65535 Compu_EGRad_UEGO_stable_wt 0 65535 /end CHARACTERISTIC
/begin COMPU_METHOD Compu_EGRad_UEGO_stable_wt " " RAT_FUNC "%.0" "ms" COEFFS 0 1 0 0 0 1 /end COMPU_METHOD
/begin MEASUREMENT ACLT_intTlim_maxLmin "Temp limiting maximum flow" UWORD Compu_ACLT_intTlim_maxLmin 0 0 0 4095.9375 ECU_ADDRESS 0x01014138 /end MEASUREMENT
/begin COMPU_METHOD Compu_ACLT_intTlim_maxLmin " " RAT_FUNC "%.1" "L/min" COEFFS 0 16 0 0 0 1 /end COMPU_METHOD
/begin CHARACTERISTIC IRV_vlv_min "IRV min position" VALUE 0x001c0a0a /* @ECU_Address@IRV_vlv_min@0x01014170@ */ ECIPP_ALIGNMENT_UWORD 100 Compu_IRV_vlv_min 0 99.9984741210938 /end CHARACTERISTIC
/begin COMPU_METHOD Compu_IRV_vlv_min " " RAT_FUNC "%.1" "%" COEFFS 0 655.36 0 0 0 1 /end COMPU_METHOD
/begin CHARACTERISTIC IRV_vlv_max "IRV max position" VALUE 0x001c0a08 /* @ECU_Address@IRV_vlv_max@0x01014178@ */ ECIPP_ALIGNMENT_UWORD 100 Compu_IRV_vlv_max 0 99.9984741210938 /end CHARACTERISTIC
/begin COMPU_METHOD Compu_IRV_vlv_max " " RAT_FUNC "%.1" "%" COEFFS 0 655.36 0 0 0 1 /end COMPU_METHOD
/begin CHARACTERISTIC IRV_PR_max "IRV PR maximum" VALUE 0x001c0a06 /* @ECU_Address@IRV_PR_max@0x01014180@ */ ECIPP_ALIGNMENT_UWORD 1 Compu_IRV_PR_max 0 0.999984741210938 /end CHARACTERISTIC
/begin COMPU_METHOD Compu_IRV_PR_max " " RAT_FUNC "%.3" "-" COEFFS 0 65536 0 0 0 1 /end COMPU_METHOD
/begin MEASUREMENT IRV_PR_cmd "IRV PR command" UWORD Compu_IRV_PR_cmd 0 0 0 0.999984741210938 ECU_ADDRESS 0x01014188 /end MEASUREMENT
/begin COMPU_METHOD Compu_IRV_PR_cmd " " RAT_FUNC "%.3" "-" COEFFS 0 65536 0 0 0 1 /end COMPU_METHOD
/begin CHARACTERISTIC BRV_comp_ena "BRV compensation{BRV_comp_ena&0xff=0:Disabled}{BRV_comp_ena&0xff=1:Enabled}" VALUE 0x001c0a9e /* @ECU_Address@BRV_comp_ena@0x01014190@ */ ECIPP_ALIGNMENT_UBYTE 255 BRV_comp_ena_COMPU_VTAB 0 255 BIT_MASK 0xff /end CHARACTERISTIC
/begin COMPU_METHOD BRV_comp_ena_COMPU_VTAB "Verbal Table" TAB_VERB "%.0" "list" COMPU_TAB_REF BRV_comp_ena_COMPU_VTAB_REF /end COMPU_METHOD
/begin COMPU_VTAB BRV_comp_ena_COMPU_VTAB_REF "Verbal Table" TAB_VERB 2 0 "Disabled" 1 "Enabled" DEFAULT_VALUE "UNKNOWN" /end COMPU_VTAB
/begin CHARACTERISTIC BRV_comp_ms "BRV comp active time" VALUE 0x001c0944 /* @ECU_Address@BRV_comp_ms@0x01014198@ */ ECIPP_ALIGNMENT_UWORD 65535 Compu_BRV_comp_ms 0 65535 /end CHARACTERISTIC
/begin COMPU_METHOD Compu_BRV_comp_ms " " RAT_FUNC "%.0" "ms" COEFFS 0 1 0 0 0 1 /end COMPU_METHOD
/begin MEASUREMENT BRV_comp_tmr "BRV comp timer" UWORD Compu_BRV_comp_tmr 0 0 0 65535 ECU_ADDRESS 0x010141A0 /end MEASUREMENT
/begin COMPU_METHOD Compu_BRV_comp_tmr " " RAT_FUNC "%.0" "ms" COEFFS 0 1 0 0 0 1 /end COMPU_METHOD
/begin CHARACTERISTIC BRV_wait_ms "BRV comp re-engage wait" VALUE 0x001c0948 /* @ECU_Address@BRV_wait_ms@0x010141A8@ */ ECIPP_ALIGNMENT_UWORD 65535 Compu_BRV_wait_ms 0 65535 /end CHARACTERISTIC
/begin COMPU_METHOD Compu_BRV_wait_ms " " RAT_FUNC "%.0" "ms" COEFFS 0 1 0 0 0 1 /end COMPU_METHOD
/begin CHARACTERISTIC BRV_MAPd_dtmin "BRV MAPd decreasing limit" VALUE 0x001c0014 /* @ECU_Address@BRV_MAPd_dtmin@0x010141B0@ */ ECIPP_ALIGNMENT_FLOAT32_IEEE 10000000000 Compu_BRV_MAPd_dtmin -10000000000 10000000000 /end CHARACTERISTIC
/begin COMPU_METHOD Compu_BRV_MAPd_dtmin " " RAT_FUNC "%.1" "psi/sec" COEFFS 0 1 0 0 0 1 /end COMPU_METHOD
/begin CHARACTERISTIC BRV_TIPMAPd_dtmax "BRV TIP-MAPd increasing limit" VALUE 0x001c0018 /* @ECU_Address@BRV_TIPMAPd_dtmax@0x010141B8@ */ ECIPP_ALIGNMENT_FLOAT32_IEEE 10000000000 Compu_BRV_TIPMAPd_dtmax -10000000000 10000000000 /end CHARACTERISTIC
/begin COMPU_METHOD Compu_BRV_TIPMAPd_dtmax " " RAT_FUNC "%.1" "psi/sec" COEFFS 0 1 0 0 0 1 /end COMPU_METHOD
/begin CHARACTERISTIC BRV_dilpct_reduct "BRV diluent % cmd reduction" VALUE 0x001c0946 /* @ECU_Address@BRV_dilpct_reduct@0x010141C0@ */ ECIPP_ALIGNMENT_UWORD 100 Compu_BRV_dilpct_reduct 0 99.9984741210938 /end CHARACTERISTIC
/begin COMPU_METHOD Compu_BRV_dilpct_reduct " " RAT_FUNC "%.1" "%" COEFFS 0 655.36 0 0 0 1 /end COMPU_METHOD
/begin CHARACTERISTIC BRV_EGRvlv_dP "BRV EGR valve delta-P max" VALUE 0x001c0270 /* @ECU_Address@BRV_EGRvlv_dP@0x010141C8@ */ ECIPP_ALIGNMENT_SWORD 128 Compu_BRV_EGRvlv_dP -128 127.99609375 /end CHARACTERISTIC
/begin COMPU_METHOD Compu_BRV_EGRvlv_dP " " RAT_FUNC "%.2" "psi" COEFFS 0 256 0 0 0 1 /end COMPU_METHOD
/begin MEASUREMENT EGR_vlv_cmd_dP "EGR valve command delta-P" SWORD Compu_EGR_vlv_cmd_dP 0 0 -128 127.99609375 ECU_ADDRESS 0x010141F0 /end MEASUREMENT
/begin COMPU_METHOD Compu_EGR_vlv_cmd_dP " " RAT_FUNC "%.2" "psi" COEFFS 0 256 0 0 0 1 /end COMPU_METHOD
/begin CHARACTERISTIC m_d_cmd_TD_tau "EGR flow cmd TD tau" VALUE 0x001c0a9a /* @ECU_Address@m_d_cmd_TD_tau@0x010141F8@ */ ECIPP_ALIGNMENT_UWORD 327680 Compu_m_d_cmd_TD_tau 0.45084 327680 /end CHARACTERISTIC
/begin COMPU_METHOD Compu_m_d_cmd_TD_tau " " FORM "%.0" "ms"
 /begin FORMULA "-5 / log(1 - (X1 / 65536))" FORMULA_INV "(1 - exp(-5/X1)) * 65536" /end FORMULA
/end COMPU_METHOD
/begin CHARACTERISTIC EGRclr_EFM_mult "EGR clr eductor flow multiplier" VALUE 0x001c09e4 /* @ECU_Address@EGRclr_EFM_mult@0x01014208@ */ ECIPP_ALIGNMENT_UWORD 16 Compu_EGRclr_EFM_mult 0 15.999755859375 /end CHARACTERISTIC
/begin COMPU_METHOD Compu_EGRclr_EFM_mult " " RAT_FUNC "%.2" "-" COEFFS 0 4096 0 0 0 1 /end COMPU_METHOD
/begin MEASUREMENT EGRclr_EFM_mdot "EGR cooler eductor flow" SWORD Compu_EGRclr_EFM_mdot 0 0 -512 511.984375 ECU_ADDRESS 0x01014210 /end MEASUREMENT
/begin COMPU_METHOD Compu_EGRclr_EFM_mdot " " RAT_FUNC "%.2" "g/sec" COEFFS 0 64 0 0 0 1 /end COMPU_METHOD
/begin CHARACTERISTIC EGRad_EGRwrP_slew "EGR CL remote UEGO FB slew" VALUE 0x001c09c8 /* @ECU_Address@EGRad_EGRwrP_slew@0x01014218@ */ ECIPP_ALIGNMENT_UWORD 65535 Compu_EGRad_EGRwrP_slew 0 65535 /end CHARACTERISTIC
/begin COMPU_METHOD Compu_EGRad_EGRwrP_slew " " RAT_FUNC "%.0" "ms" COEFFS 0 1 0 0 0 1 /end COMPU_METHOD
/begin MEASUREMENT AMTSA_minnom "AMT shift assist EGR min/nom request" SWORD Compu_AMTSA_minnom 0 0 -2 1.99993896484375 ECU_ADDRESS 0x01015048 /end MEASUREMENT
/begin COMPU_METHOD Compu_AMTSA_minnom " " RAT_FUNC "%.2" "-" COEFFS 0 16384 0 0 0 1 /end COMPU_METHOD
/begin COMPU_METHOD Compu_TTM_EGRA_TPS " " RAT_FUNC "%.1" "Position (%)" COEFFS 0 0.01 0 0 0 1 /end COMPU_METHOD
/begin CHARACTERISTIC TTM_EGRA_A "EGR Valve Nominal Area" CURVE 0x001C0190 /* @ECU_Address@TTM_EGRA_A@0x022B9000@ */ ECIPP_ALIGNMENT_FLOAT32_IEEE 10000000000 Compu_TTM_EGRA_A -10000000000 10000000000
 /begin AXIS_DESCR COM_AXIS NO_INPUT_QUANTITY Compu_TTM_EGRA_TPS 16 -10000000000 10000000000 AXIS_PTS_REF TTM_EGRA_TPS /end AXIS_DESCR
/end CHARACTERISTIC
/begin AXIS_PTS TTM_EGRA_TPS " " 0x001E1D08 /* @ECU_Address@TTM_EGRA_TPS@0x022B8000@ */ NO_INPUT_QUANTITY ECIPP_Lookup_FLOAT32_IEEE 0 Compu_TTM_EGRA_TPS 16 -10000000000 10000000000 /end AXIS_PTS
/begin COMPU_METHOD Compu_TTM_EGRA_A " " RAT_FUNC "%.3" "Area (in2)" COEFFS 0 1 0 0 0 1 /end COMPU_METHOD
/begin CHARACTERISTIC TDIL_pct_std "Diluent Mass Fraction - Standard (%)" MAP 0x001C0576 /* @ECU_Address@TDIL_pct_std@0x022DA000@ */ ECIPP_ALIGNMENT_SWORD 200 Compu_TDIL_pct_std -200 199.993896484375
 /begin AXIS_DESCR COM_AXIS NO_INPUT_QUANTITY Compu_TDIL_pct_xaxis 16 -10000000000 10000000000 AXIS_PTS_REF TDIL_pct_xaxis /end AXIS_DESCR
 /begin AXIS_DESCR COM_AXIS NO_INPUT_QUANTITY Compu_TDIL_pct_rpm 16 -32768 32767 AXIS_PTS_REF TDIL_pct_rpm /end AXIS_DESCR
/end CHARACTERISTIC
/begin AXIS_PTS TDIL_pct_xaxis " " 0x001C00D8 /* @ECU_Address@TDIL_pct_xaxis@0x022DC000@ */ NO_INPUT_QUANTITY ECIPP_Lookup_FLOAT32_IEEE 0 Compu_TDIL_pct_xaxis 16 -10000000000 10000000000 /end AXIS_PTS
/begin AXIS_PTS TDIL_pct_rpm " " 0x001C0556 /* @ECU_Address@TDIL_pct_rpm@0x022DD000@ */ NO_INPUT_QUANTITY ECIPP_Lookup_SWORD 0 Compu_TDIL_pct_rpm 16 -32768 32767 /end AXIS_PTS
/begin COMPU_METHOD Compu_TDIL_pct_std "" RAT_FUNC "%.1" "-" COEFFS 0 163.84 0 0 0 1 /end COMPU_METHOD
/begin CHARACTERISTIC TDIL_pct_alt "Diluent Mass Fraction - Alternate (%)" MAP 0x001C02C6 /* @ECU_Address@TDIL_pct_alt@0x022DB000@ */ ECIPP_ALIGNMENT_SWORD 200 Compu_TDIL_pct_alt -200 199.993896484375
 /begin AXIS_DESCR COM_AXIS NO_INPUT_QUANTITY Compu_TDIL_pct_xaxis 16 -10000000000 10000000000 AXIS_PTS_REF TDIL_pct_xaxis /end AXIS_DESCR
 /begin AXIS_DESCR COM_AXIS NO_INPUT_QUANTITY Compu_TDIL_pct_rpm 16 -32768 32767 AXIS_PTS_REF TDIL_pct_rpm /end AXIS_DESCR
/end CHARACTERISTIC
/begin COMPU_METHOD Compu_TDIL_pct_alt "" RAT_FUNC "%.1" "-" COEFFS 0 163.84 0 0 0 1 /end COMPU_METHOD
/begin COMPU_METHOD Compu_TDIL_pct_xaxis " " RAT_FUNC "%.1" "-" COEFFS 0 1 0 0 0 1 /end COMPU_METHOD
/begin COMPU_METHOD Compu_TDIL_pct_rpm " " RAT_FUNC "%.0" "Speed (rpm)" COEFFS 0 1 0 0 0 1 /end COMPU_METHOD
/begin MEASUREMENT TEGRad_CdA_crct "EGR Valve Adaptive Area" FLOAT32_IEEE Compu_TEGRad_CdA_crct 0 0 -10000000000 10000000000 ECU_ADDRESS 0x0238B000 MATRIX_DIM 16 1 1 /end MEASUREMENT
/begin COMPU_METHOD Compu_TEGRad_CdA_crct " " RAT_FUNC "%.3" "Corrected Area (in2)" COEFFS 0 1 0 0 0 1 /end COMPU_METHOD
/begin COMPU_METHOD Compu_TEGR_ECT_ECT " " RAT_FUNC "%.1" "ECT (deg F)" COEFFS 0 32 14720 0 0 1 /end COMPU_METHOD
/begin CHARACTERISTIC TEGR_ECT_minnom "EGR ECT Enabling" CURVE 0x001C0782 /* @ECU_Address@TEGR_ECT_minnom@0x023C3000@ */ ECIPP_ALIGNMENT_SWORD 2 Compu_TEGR_ECT_minnom -2 1.99993896484375
 /begin AXIS_DESCR COM_AXIS NO_INPUT_QUANTITY Compu_TEGR_ECT_ECT 6 -1484 563.96875 AXIS_PTS_REF TEGR_ECT_ECT /end AXIS_DESCR
/end CHARACTERISTIC
/begin AXIS_PTS TEGR_ECT_ECT " " 0x001C0776 /* @ECU_Address@TEGR_ECT_ECT@0x023C2000@ */ NO_INPUT_QUANTITY ECIPP_Lookup_SWORD 0 Compu_TEGR_ECT_ECT 6 -1484 563.96875 /end AXIS_PTS
/begin COMPU_METHOD Compu_TEGR_ECT_minnom " " RAT_FUNC "%.2" "Off/Min/Nom" COEFFS 0 16384 0 0 0 1 /end COMPU_METHOD
/begin COMPU_METHOD Compu_TEGR_runwt_sec " " RAT_FUNC "%.1" "Run Time (sec)" COEFFS 0 16 0 0 0 1 /end COMPU_METHOD
/begin CHARACTERISTIC TEGR_runwt_minnom "EGR Run Time Wait" CURVE 0x001C07A6 /* @ECU_Address@TEGR_runwt_minnom@0x023C7000@ */ ECIPP_ALIGNMENT_SWORD 2 Compu_TEGR_runwt_minnom -2 1.99993896484375
 /begin AXIS_DESCR COM_AXIS NO_INPUT_QUANTITY Compu_TEGR_runwt_sec 6 -2048 2047.9375 AXIS_PTS_REF TEGR_runwt_sec /end AXIS_DESCR
/end CHARACTERISTIC
/begin AXIS_PTS TEGR_runwt_sec " " 0x001C07B2 /* @ECU_Address@TEGR_runwt_sec@0x023C6000@ */ NO_INPUT_QUANTITY ECIPP_Lookup_SWORD 0 Compu_TEGR_runwt_sec 6 -2048 2047.9375 /end AXIS_PTS
/begin COMPU_METHOD Compu_TEGR_runwt_minnom " " RAT_FUNC "%.2" "Off/Min/Nom" COEFFS 0 16384 0 0 0 1 /end COMPU_METHOD
/begin COMPU_METHOD Compu_TEGRad_CL_vlvpct " " RAT_FUNC "%.1" "EGR Valve Cmd (%)" COEFFS 0 327.68 0 0 0 1 /end COMPU_METHOD
/begin CHARACTERISTIC TEGRad_CL_lim "EGR Closed-Loop Limit" CURVE 0x001C08E6 /* @ECU_Address@TEGRad_CL_lim@0x023D0000@ */ ECIPP_ALIGNMENT_SWORD 100 Compu_TEGRad_CL_lim -100 99.9969482421875
 /begin AXIS_DESCR COM_AXIS NO_INPUT_QUANTITY Compu_TEGRad_CL_vlvpct 4 -100 99.9969482421875 AXIS_PTS_REF TEGRad_CL_vlvpct /end AXIS_DESCR
/end CHARACTERISTIC
/begin AXIS_PTS TEGRad_CL_vlvpct " " 0x001C08EE /* @ECU_Address@TEGRad_CL_vlvpct@0x023CF000@ */ NO_INPUT_QUANTITY ECIPP_Lookup_SWORD 0 Compu_TEGRad_CL_vlvpct 4 -100 99.9969482421875 /end AXIS_PTS
/begin COMPU_METHOD Compu_TEGRad_CL_lim " " RAT_FUNC "%.1" "EGR CL Limit (% dil)" COEFFS 0 327.68 0 0 0 1 /end COMPU_METHOD
/begin COMPU_METHOD Compu_TEGR_vlvdP_mdot " " RAT_FUNC "%.1" "EGR Flow (g/s)" COEFFS 0 64 0 0 0 1 /end COMPU_METHOD
/begin CHARACTERISTIC TEGR_vlvdP_dP "EGR Valve Min dP" CURVE 0x001C08CE /* @ECU_Address@TEGR_vlvdP_dP@0x0247E000@ */ ECIPP_ALIGNMENT_SWORD 128 Compu_TEGR_vlvdP_dP -128 127.99609375
 /begin AXIS_DESCR COM_AXIS NO_INPUT_QUANTITY Compu_TEGR_vlvdP_mdot 6 -512 511.984375 AXIS_PTS_REF TEGR_vlvdP_mdot /end AXIS_DESCR
/end CHARACTERISTIC
/begin AXIS_PTS TEGR_vlvdP_mdot " " 0x001C08DA /* @ECU_Address@TEGR_vlvdP_mdot@0x0247D000@ */ NO_INPUT_QUANTITY ECIPP_Lookup_SWORD 0 Compu_TEGR_vlvdP_mdot 6 -512 511.984375 /end AXIS_PTS
/begin COMPU_METHOD Compu_TEGR_vlvdP_dP " " RAT_FUNC "%.2" "Min Valve dP (psi)" COEFFS 0 256 0 0 0 1 /end COMPU_METHOD
/begin CHARACTERISTIC TEGR_vent_Mx_mult "EGR Orifice Flow Rate Correction" MAP 0x001C083E /* @ECU_Address@TEGR_vent_Mx_mult@0x025C0000@ */ ECIPP_ALIGNMENT_SWORD 4 Compu_TEGR_vent_Mx_mult -4 3.9998779296875
 /begin AXIS_DESCR COM_AXIS NO_INPUT_QUANTITY Compu_TEGR_vent_Mx_load 8 -10000000000 10000000000 AXIS_PTS_REF TEGR_vent_Mx_load /end AXIS_DESCR
 /begin AXIS_DESCR COM_AXIS NO_INPUT_QUANTITY Compu_TEGR_vent_Mx_rpm 8 -32768 32767 AXIS_PTS_REF TEGR_vent_Mx_rpm /end AXIS_DESCR
/end CHARACTERISTIC
/begin AXIS_PTS TEGR_vent_Mx_load " " 0x001C0148 /* @ECU_Address@TEGR_vent_Mx_load@0x025C1000@ */ NO_INPUT_QUANTITY ECIPP_Lookup_FLOAT32_IEEE 0 Compu_TEGR_vent_Mx_load 8 -10000000000 10000000000 /end AXIS_PTS
/begin AXIS_PTS TEGR_vent_Mx_rpm " " 0x001C08BE /* @ECU_Address@TEGR_vent_Mx_rpm@0x025C2000@ */ NO_INPUT_QUANTITY ECIPP_Lookup_SWORD 0 Compu_TEGR_vent_Mx_rpm 8 -32768 32767 /end AXIS_PTS
/begin COMPU_METHOD Compu_TEGR_vent_Mx_mult "" RAT_FUNC "%.2" "Flow Correction (multiplier)" COEFFS 0 8192 0 0 0 1 /end COMPU_METHOD
/begin COMPU_METHOD Compu_TEGR_vent_Mx_load " " RAT_FUNC "%.2" "Load Cmd (%)" COEFFS 0 1 0 0 0 1 /end COMPU_METHOD
/begin COMPU_METHOD Compu_TEGR_vent_Mx_rpm " " RAT_FUNC "%.0" "Speed (rpm)" COEFFS 0 1 0 0 0 1 /end COMPU_METHOD
/begin COMPU_METHOD Compu_TEGR_vlv_PR " " RAT_FUNC "%.3" "Actual PR" COEFFS 0 1 0 0 0 1 /end COMPU_METHOD
/begin CHARACTERISTIC TEGR_vlv_PR_Dz "EGR valve PR Dz" CURVE 0x001C0170 /* @ECU_Address@TEGR_vlv_PR_Dz@0x025C4000@ */ ECIPP_ALIGNMENT_FLOAT32_IEEE 10000000000 Compu_TEGR_vlv_PR_Dz -10000000000 10000000000
 /begin AXIS_DESCR COM_AXIS NO_INPUT_QUANTITY Compu_TEGR_vlv_PR 2 -10000000000 10000000000 AXIS_PTS_REF TEGR_vlv_PR /end AXIS_DESCR
/end CHARACTERISTIC
/begin AXIS_PTS TEGR_vlv_PR " " 0x001C0168 /* @ECU_Address@TEGR_vlv_PR@0x025C3000@ */ NO_INPUT_QUANTITY ECIPP_Lookup_FLOAT32_IEEE 0 Compu_TEGR_vlv_PR 2 -10000000000 10000000000 /end AXIS_PTS
/begin COMPU_METHOD Compu_TEGR_vlv_PR_Dz " " RAT_FUNC "%.3" "PR Dz" COEFFS 0 1 0 0 0 1 /end COMPU_METHOD
/begin CHARACTERISTIC TEGR_vlv_PR_tau "EGR valve PR Tau" CURVE 0x001C0A96 /* @ECU_Address@TEGR_vlv_PR_tau@0x025C5000@ */ ECIPP_ALIGNMENT_UWORD 327680 Compu_TEGR_vlv_PR_tau 0.45084 327680
 /begin AXIS_DESCR COM_AXIS NO_INPUT_QUANTITY Compu_TEGR_vlv_PR 2 -10000000000 10000000000 AXIS_PTS_REF TEGR_vlv_PR /end AXIS_DESCR
/end CHARACTERISTIC
/begin COMPU_METHOD Compu_TEGR_vlv_PR_tau " " FORM "%.0" "PR tau [ms]"
 /begin FORMULA "-5 / log(1 - (X1 / 65536))" FORMULA_INV "(1 - exp(-5/X1)) * 65536" /end FORMULA
/end COMPU_METHOD
/begin COMPU_METHOD Compu_TEGR_deice_AAT " " RAT_FUNC "%.1" "Ambient Temp (deg F)" COEFFS 0 32 14720 0 0 1 /end COMPU_METHOD
/begin CHARACTERISTIC TEGR_deice_tm_mult "EGR De-icing Primary Idle Time Multiplier" CURVE 0x001C0A1E /* @ECU_Address@TEGR_deice_tm_mult@0x02640000@ */ ECIPP_ALIGNMENT_UWORD 256 Compu_TEGR_deice_tm_mult 0 255.99609375
 /begin AXIS_DESCR COM_AXIS NO_INPUT_QUANTITY Compu_TEGR_deice_AAT 6 -1484 563.96875 AXIS_PTS_REF TEGR_deice_AAT /end AXIS_DESCR
/end CHARACTERISTIC
/begin AXIS_PTS TEGR_deice_AAT " " 0x001C078E /* @ECU_Address@TEGR_deice_AAT@0x0263F000@ */ NO_INPUT_QUANTITY ECIPP_Lookup_SWORD 0 Compu_TEGR_deice_AAT 6 -1484 563.96875 /end AXIS_PTS
/begin COMPU_METHOD Compu_TEGR_deice_tm_mult " " RAT_FUNC "%.1" "Time Multiplier" COEFFS 0 256 0 0 0 1 /end COMPU_METHOD
/begin COMPU_METHOD Compu_TEGR_deice_IAT " " RAT_FUNC "%.1" "Intake Temp (deg F)" COEFFS 0 32 14720 0 0 1 /end COMPU_METHOD
/begin CHARACTERISTIC TEGR_deice_rettmmult "EGR De-icing Secondary Idle Time Multiplier" CURVE 0x001C0A12 /* @ECU_Address@TEGR_deice_rettmmult@0x02642000@ */ ECIPP_ALIGNMENT_UWORD 256 Compu_TEGR_deice_rettmmult 0 255.99609375
 /begin AXIS_DESCR COM_AXIS NO_INPUT_QUANTITY Compu_TEGR_deice_IAT 6 -1484 563.96875 AXIS_PTS_REF TEGR_deice_IAT /end AXIS_DESCR
/end CHARACTERISTIC
/begin AXIS_PTS TEGR_deice_IAT " " 0x001C079A /* @ECU_Address@TEGR_deice_IAT@0x02641000@ */ NO_INPUT_QUANTITY ECIPP_Lookup_SWORD 0 Compu_TEGR_deice_IAT 6 -1484 563.96875 /end AXIS_PTS
/begin COMPU_METHOD Compu_TEGR_deice_rettmmult " " RAT_FUNC "%.1" "Time Multiplier" COEFFS 0 256 0 0 0 1 /end COMPU_METHOD
/begin COMPU_METHOD Compu_TACLT_max_rpm " " RAT_FUNC "%.0" "Speed (rpm)" COEFFS 0 1 0 0 0 1 /end COMPU_METHOD
/begin CHARACTERISTIC TACLT_max_Lmin "Aux Coolant Pump" CURVE 0x001C45D8 /* @ECU_Address@TACLT_max_Lmin@0x02684000@ */ ECIPP_ALIGNMENT_SWORD 2048 Compu_TACLT_max_Lmin -2048 2047.9375
 /begin AXIS_DESCR COM_AXIS NO_INPUT_QUANTITY Compu_TACLT_max_rpm 8 -32768 32767 AXIS_PTS_REF TACLT_max_rpm /end AXIS_DESCR
/end CHARACTERISTIC
/begin AXIS_PTS TACLT_max_rpm " " 0x001C45E8 /* @ECU_Address@TACLT_max_rpm@0x02683000@ */ NO_INPUT_QUANTITY ECIPP_Lookup_SWORD 0 Compu_TACLT_max_rpm 8 -32768 32767 /end AXIS_PTS
/begin COMPU_METHOD Compu_TACLT_max_Lmin " " RAT_FUNC "%.1" "Coolant Flow (L/min)" COEFFS 0 16 0 0 0 1 /end COMPU_METHOD
/begin COMPU_METHOD Compu_TACLT_vlv_pos " " RAT_FUNC "%.1" "Normalized Valve Position (%)" COEFFS 0 327.68 0 0 0 1 /end COMPU_METHOD
/begin CHARACTERISTIC TACLT_vlv_flow "Aux Coolant Valves" CURVE 0x001C90EA /* @ECU_Address@TACLT_vlv_flow@0x02686000@ */ ECIPP_ALIGNMENT_SWORD 100 Compu_TACLT_vlv_flow -100 99.9969482421875
 /begin AXIS_DESCR COM_AXIS NO_INPUT_QUANTITY Compu_TACLT_vlv_pos 10 -100 99.9969482421875 AXIS_PTS_REF TACLT_vlv_pos /end AXIS_DESCR
/end CHARACTERISTIC
/begin AXIS_PTS TACLT_vlv_pos " " 0x001C460C /* @ECU_Address@TACLT_vlv_pos@0x02685000@ */ NO_INPUT_QUANTITY ECIPP_Lookup_SWORD 0 Compu_TACLT_vlv_pos 10 -100 99.9969482421875 /end AXIS_PTS
/begin COMPU_METHOD Compu_TACLT_vlv_flow " " RAT_FUNC "%.1" "Coolant Flow (% max)" COEFFS 0 327.68 0 0 0 1 /end COMPU_METHOD
/begin CHARACTERISTIC TACLT_vlv_int_flow "Intercooler Coolant Flow" CURVE 0x001C90BE /* @ECU_Address@TACLT_vlv_int_flow@0x02687000@ */ ECIPP_ALIGNMENT_SWORD 100 Compu_TACLT_vlv_int_flow -100 99.9969482421875
 /begin AXIS_DESCR COM_AXIS NO_INPUT_QUANTITY Compu_TACLT_vlv_pos 10 -100 99.9969482421875 AXIS_PTS_REF TACLT_vlv_pos /end AXIS_DESCR
/end CHARACTERISTIC
/begin COMPU_METHOD Compu_TACLT_vlv_int_flow " " RAT_FUNC "%.1" "Coolant Flow (% max)" COEFFS 0 327.68 0 0 0 1 /end COMPU_METHOD
/begin CHARACTERISTIC TACLT_vlv_EGR_flow "EGR Cooler Coolant Flow" CURVE 0x001C45F8 /* @ECU_Address@TACLT_vlv_EGR_flow@0x02688000@ */ ECIPP_ALIGNMENT_SWORD 100 Compu_TACLT_vlv_EGR_flow -100 99.9969482421875
 /begin AXIS_DESCR COM_AXIS NO_INPUT_QUANTITY Compu_TACLT_vlv_pos 10 -100 99.9969482421875 AXIS_PTS_REF TACLT_vlv_pos /end AXIS_DESCR
/end CHARACTERISTIC
/begin COMPU_METHOD Compu_TACLT_vlv_EGR_flow " " RAT_FUNC "%.1" "Coolant Flow (% max)" COEFFS 0 327.68 0 0 0 1 /end COMPU_METHOD
/begin GROUP EC_EGRAux "ECONTROLS" ROOT
 /begin REF_CHARACTERISTIC AFILT_dP_C EGR_clr_dP_C EGR_pstvlv_V EFMA_map_dP_C EFMA_fmix_dP_C EFMA_emix_dP_C EGRO_vlv_dP_C EFMA_map_dP_nom EFMA_fmix_dP_nom EFMA_emix_dP_nom EGRO_vlv_dP_nom EGR_clr_dP_nom EGR_TPSdP_Dz EGR_TPSdP_limiting EGR_TPSdP_tau_inc EGR_TPSdP_tau_dec EGR_TPSdP_Ktrans EGR_TPSdP_max EGR_dmdot_cmd_n EGR_dmdot_cmd_tau EGR_dmdot_cmd_dz FDC_ena FDC_rpm_min FDC_load_off FDC_load_on FDC_CLAL_ref FDC_EGR_max FDC_comp_inc_LP FDC_comp_dec_LP EGR_deice_idle_tm EGR_deice_retidle_tm EGR_deice_purge_tm EGR_deice_rpm EGR_deice_AAT_max EGR_deice_pct_cmd EGR_deice_rpm_rate EGR_deice_pre_tm EGR_deice_post_tm EGR_deice_purge_IAT EGRdP_trust_zero_dz EGRdP_trust_latch_tm EGRHP_trust_mdl_dz EGRHP_trust_latch_tm EGRHP_trust_unlatcht EGR_senstrst_flt_tm EGR_senstrst_ECTfrac IRV_CL_Amin IRV_CL_Amax IRV_CL_Kp IRV_CL_Ki IRV_CL_Kd EGRLP_dedt_dz ACLT_radby_ena ACLT_intby_ena ACLT_radby_T_cmd ACLT_radby_vlv_def ACLT_intby_vlv_def ACLT_radby_Kp ACLT_intby_Kp ACLT_radby_Ki ACLT_intby_Ki ACLT_radby_vlv_min ACLT_intby_vlv_min ACLT_radby_vlv_max ACLT_intby_vlv_max ACLT_radby_dT_halt ACLT_intby_dT_halt ACLT_radby_dT_res ACLT_intby_dT_res ACLT_EGRclr_min_Lmin ACLT_intby_T_ofs ICCOT_resp_tau ICCOT_proj_tau ACLT_intTlim_T_max ACLT_intTlim_Kp ACLT_intTlim_Ki ACLT_intTlim_Amin ACLT_intTlim_I_decay ACLT_intTlim_crct_Kp ACLT_intTlim_crctmin ACLT_intTlim_trst_th ACLT_intTlim_trust_i ACLT_intTlim_trust_d ACLT_intTlim_crctdcy ACLT_intTlim_pctmax IRV_vlv_min IRV_vlv_max IRV_PR_max EGRclr_EFM_mult TEGR_vlvdP_dP TEGR_deice_tm_mult TEGR_deice_rettmmult TACLT_max_Lmin TACLT_vlv_flow TACLT_vlv_int_flow TACLT_vlv_EGR_flow /end REF_CHARACTERISTIC
 /begin REF_MEASUREMENT m_d_pct_cmd EGR_vlv_cmd EGR_vlv_act EGRLP_float EGR_vlv_min_dP EGR_vlv_act_dP EGR_clr_dP mdot_mix_fill_float m_d_pct_act mdot_EGR_act mdot_mix_fill_TPS mdot_mix_fill_EGR mdot_mix_EGR mdot_EGR_VdP EFMA_map_dP EFMA_fmix_dP EFMA_emix_dP EGRO_vlv_dP EFMA_emix_P EFMA_fmix_P TOP TIAT m_d_pct_act_dry mdot_EGR_cmd EGR_dmdot_cmd FDC_comp_pct FDC_EGR_ofst EGR_deice_state EGR_deice_wait_tm EGR_deice_tmr EGR_sensor_trust EGRdP_trust_pct EGRHP_trust_mdl_err EGRHP_trust_pct EGR_senstrst_flt_tmr EGR_stuckvlv_state EGR_stuckvlv_dc_lp EGR_stuckvlv_tmr_max mdot_IRV_cmd IRV_EGRLPd IRV_EGRLP_error IRV_AFILT_dP IRV_Pin IRV_dP_cmd IRV_CL_crct IRV_vlv_cmd IRV_vlv_act IRV_CL_Iaccum EGRLP_dedt ACT ACLT_intby_T_cmd ACLT_radby_vlv_cmd ACLT_intby_vlv_cmd ACLT_radby_vlv_act ACLT_intby_vlv_act ACLT_radby_vlv_halt ACLT_intby_vlv_halt ACLT_pump_Lmin ACLT_intclr_dTi ACLT_intclr_dTh_ff ACLT_intclr_dTh ACLT_intclr_Qmax ACLT_intclr_Qff ACLT_intclr_Q ACLT_intclr_eff_ff ACLT_intclr_eff ACLT_intclr_mdotx ACLT_intclr_Lmin_ff ACLT_intclr_Lmin ACLT_rad_Lmin_ff ACLT_rad_Lmin ACLT_radby_I_accum ACLT_intby_I_accum ACLT_radby_Lmin_CL ACLT_intby_Lmin_CL ACLT_radby_T_error ACLT_intby_T_error ACLT_EGRclr_Lmin ACLT_pump_max_Lmin ICCOT ICCOT_proj_lp ACLT_intTlim_I_accum ACLT_intTlim_minLmin ACLT_intclr_Q_dT_max ACLT_intTlim_trust ACLT_intTlim_maxLmin IRV_PR_cmd EGR_vlv_cmd_dP EGRclr_EFM_mdot /end REF_MEASUREMENT
/end GROUP
/begin GROUP EC_EGRCommand "ECONTROLS" ROOT
 /begin REF_CHARACTERISTIC EGRT_ena EGR_channel EGR_min_DC EGR_max_DC EGRHP_ena EGRLP_ena m_d_pct_cmd_tau m_d_pct_cmd_dz EGR_mindil_cmdtbl EGR_mindil_spktbl EGR_nomdil_SHref EGR_mindil_SHref EGR_PR_vlv_max EGR_vlv_dP_tau EGRad_cmdact_ss_itau EGRad_cmdact_ss_dtau EGR_spkextrap_amin EGR_spkextrap_amax EGR_spkextrap_rmin EGR_spkextrap_rmax EGR_spkextrap_advlmt EGR_spkextrap_retlmt m_d_pct_cmd_OFF m_d_pct_cmd_ON EGR_minnom_pslew EGR_minnom_nslew EGR_vlv_zero_dz EGR_vlv_dPos_max mdot_EGR_ON mdot_EGR_OFF mdot_EGR_ON_cold EGR_ON_cold_IAT EGR_initpct_reduct EGR_initpct_accmdmax mdot_EGR_inc_max EGR_spkex_pdspanmin EGR_spkex_pdspanmax EGR_initpct_0md_tm EGR_initpct_0md_slew EFMA_venturi_dP_ena EFMA_venturi_dP_C1 EFMA_venturi_dP_C2 EFMA_venturi_dP_C3 EFMA_venturi_dP_C4 EFMA_venturi_dP_C5 EGR_sys_config Tdewpt_pst_intclrtau BRV_comp_ena BRV_comp_ms BRV_wait_ms BRV_MAPd_dtmin BRV_TIPMAPd_dtmax BRV_dilpct_reduct BRV_EGRvlv_dP m_d_cmd_TD_tau TDIL_pct_std TDIL_pct_alt TEGR_ECT_minnom TEGR_runwt_minnom TEGR_vlv_PR_Dz TEGR_vlv_PR_tau /end REF_CHARACTERISTIC
 /begin REF_MEASUREMENT OCT_adapt EGRT m_d_pct_cmd EGR_vlv_cmd EGR_ctl_status EGR_vlv_act EGRLP_float EGR_vlv_act_dP manual_EGR_mode manual_EGR_cmd1 DIL_pct_xval EGRHP_float EGR_PRf_pseudo manual_EGR_tau m_d_pct_reqmin m_d_pct_min m_d_pct_nom EGR_minnom_frac EGR_spkadv_min EGR_spkadv_nom EGR_retard m_d_pct_act mdot_EGR_act EGR_PRf_actual EGR_minnom_ECT manual_EGR_cmd2 manual_EGR_toggle manual_EGR_slct EGR_minnom_runwt EGRad_cmdact_ss_err EGR_spkextrap_sens EGR_spkextrap_ret m_d_pct_spk EGR_minnom_raw m_d_pct_FL m_d_pct_LL EGR_MAPload_LL LoadLim_EGR_pct mdot_EGR_min mdot_EGR_nom EGR_minnom_derate EGR_minnom_FB m_d_pct_act_dry mdot_EGR_cmd EGR_dmdot_cmd EGR_vlv_temp_est m_d_pct_octmin m_d_pct_octnom EGR_oct_retard EGR_oct_LL_pct m_d_pct_oct_ofst EGR_minnom_senstrst EGR_initpct_accmd m_d_pct_req_lp mdot_EGR_req mdot_EGR_zero_tmr SH_airEGR_mix Tdewpt_pre_intclr Tdewpt_pst_intclr EGR_off_tmr_ms BRV_comp_tmr AMTSA_minnom /end REF_MEASUREMENT
/end GROUP
/begin GROUP EC_EGRControl "ECONTROLS" ROOT
 /begin REF_CHARACTERISTIC EGRdP_ena EGRad_mdot_min EGRad_MAF_min EGR_vent_location EGR_vent_CdA EGRdP_offset_learn EGRdP_offset_ECT EGRdP_offset_vlvmax EGRdP_offset_flowwt EGRdP_offset_dPmin EGRdP_offset_dPmax EGRdP_offset_tau EGRad_ena EGRad_strt_wait EGRad_adapt_dz EGRad_Kadapt EGRad_adapt_lim EGRad_stable_wait EGRad_TPS_min EGRad_adapt_valid EGRad_adapt_wait EGRad_adapt_Amin EGRdP_offset_dPpls EGRdP_offset_keywt EGRwrP_ena EGRwr_flowctl_dPint EGRwr_flowctl_dPmix EGRwr_flowctl_dPdft EGRwr_mdpct_mult EGRwrP_tau EGRad_PRadapt_sw EGRad_PR_Kadapt EGRad_PR_adapt_lim EGR_tau_MAF_ms EGR_tau_dP_ms EGR_tau_UEGO_ms EGRad_PRadapt_swend EGRdP_offset_strtwt EGRwr_mount_type EGRfb_minnom_MAF EGRfb_minnom_dP EGRfb_minnom_UEGO EGRfb_LL_openloop EGRfb_LL_MAF EGRfb_LL_dP EGRfb_LL_UEGO EGRwrT_ena EGRwr_UEGO_slew EGRad_CL_K EGRad_CL_valid_cnt EGRad_tran_dMAP EGRad_tran_dmdpct EGRad_CL_Dz EGRdP_offset_clrdly EGRad_store_EE EGRdP_offset_clrtime EGRad_UEGO_stable_wt EGRad_EGRwrP_slew TTM_EGRA_A TEGRad_CL_lim TEGR_vent_Mx_mult /end REF_CHARACTERISTIC
 /begin REF_MEASUREMENT EGRdP m_d_pct_cmd EGR_vlv_cmd EGR_vlv_act EGRdP_inst EGRdP_offset EGRdP_offset_state EGR_FB_source EGRad_CL_status EGR_vent_Pin EGRad_CL_pct EGRad_adapt_status EGRad_CdA_in2 m_d_pct_act mdot_EGR_act EGRwrP_float mdot_EGR_MAF mdot_EGR_dP mdot_EGR_UEGO m_d_pct_MAF m_d_pct_dP m_d_pct_UEGO EGR_FB_status_MAF EGR_FB_status_dP EGR_FB_status_UEGO EGRwr_drift_status EGRad_CLadapt_assist EGRwr_UEGO_fbpct EGRad_cmdact_err EGRad_CL_actlmt EGRad_PR_adapt_crct EGRad_PRadapt_ratio EGR_vent_Pout m_d_pct_cmd_dly m_d_pct_cmdmdl EGRwrT_float EGR_vent_Mx_mult m_d_pct_act_dry EGRad_CL_updates EGRdP_min EGRdP_max mdot_EGRv_mdl EGR_sensor_trust EGRdP_config TEGRad_CdA_crct /end REF_MEASUREMENT
/end GROUP
/begin GROUP EC_FaultCfg "ECONTROLS" ROOT /begin REF_MEASUREMENT TIAT /end REF_MEASUREMENT /end GROUP
/begin GROUP EC_FilterCal "ECONTROLS" ROOT /begin REF_MEASUREMENT EGRdP EGRLP_float EGRHP_float /end REF_MEASUREMENT /end GROUP
/begin GROUP EC_GovCal "ECONTROLS" ROOT /begin REF_MEASUREMENT AMTSA_minnom /end REF_MEASUREMENT /end GROUP
/begin GROUP EC_HDService2 "ECONTROLS" ROOT
 /begin REF_MEASUREMENT OCT_adapt EGRdP m_d_pct_cmd EGR_vlv_cmd EGR_ctl_status EGR_vlv_act EGRdP_offset EGRdP_offset_state m_d_pct_act mdot_EGR_act m_d_pct_act_dry mdot_EGR_cmd EGR_vlv_temp_est EGR_stuckvlv_state /end REF_MEASUREMENT
/end GROUP
/begin GROUP EC_Knock "ECONTROLS" ROOT /begin REF_MEASUREMENT OCT_adapt EGR_oct_retard EGR_oct_LL_pct m_d_pct_oct_ofst /end REF_MEASUREMENT /end GROUP
/begin GROUP EC_PhiGsln "ECONTROLS" ROOT /begin REF_MEASUREMENT OCT_adapt /end REF_MEASUREMENT /end GROUP
/begin GROUP EC_SparkCal "ECONTROLS" ROOT /begin REF_MEASUREMENT OCT_adapt EGR_retard /end REF_MEASUREMENT /end GROUP
/begin GROUP EC_SparkCalLP "ECONTROLS" ROOT /begin REF_MEASUREMENT EGR_retard /end REF_MEASUREMENT /end GROUP
/begin GROUP EC_SparkCalNG "ECONTROLS" ROOT /begin REF_MEASUREMENT EGR_retard /end REF_MEASUREMENT /end GROUP
/begin GROUP EC_SparkOfst "ECONTROLS" ROOT /begin REF_MEASUREMENT EGR_retard /end REF_MEASUREMENT /end GROUP
/begin GROUP EC_Tests "ECONTROLS" ROOT
 /begin REF_MEASUREMENT EGR_vlv_cmd EGR_vlv_act manual_EGR_cmd1 manual_EGR_cmd2 manual_EGR_toggle manual_EGR_slct /end REF_MEASUREMENT
/end GROUP
/begin GROUP EC_VECal "ECONTROLS" ROOT /begin REF_MEASUREMENT mdot_mix_fill_float /end REF_MEASUREMENT /end GROUP
/end MODULE
/end PROJECT
