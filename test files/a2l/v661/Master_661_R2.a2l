ASAP2_VERSION 1 61
/begin PROJECT Econtrols_4G "4G Test"
/begin HEADER "4G A2L Configuration" PROJECT_NO EControls4G /* config for version control */ VERSION "$Revision: 82130 $:" /* config for version control */ /end HEADER
/begin MODULE EControls_4G_SH2A "EControls 4G"
/begin MOD_COMMON "" DEPOSIT ABSOLUTE BYTE_ORDER MSB_FIRST /end MOD_COMMON
/* Define the Record Layouts */
/begin RECORD_LAYOUT ECIPP_ALIGNMENT_UBYTE FNC_VALUES 1 UBYTE COLUMN_DIR DIRECT /end RECORD_LAYOUT
/begin RECORD_LAYOUT ECIPP_ALIGNMENT_UWORD FNC_VALUES 1 UWORD COLUMN_DIR DIRECT /end RECORD_LAYOUT
/begin RECORD_LAYOUT ECIPP_ALIGNMENT_SWORD FNC_VALUES 1 SWORD COLUMN_DIR DIRECT /end RECORD_LAYOUT
/begin RECORD_LAYOUT ECIPP_Lookup_SWORD AXIS_PTS_X 1 SWORD INDEX_INCR DIRECT /end RECORD_LAYOUT
/begin RECORD_LAYOUT ECIPP_ALIGNMENT_ULONG FNC_VALUES 1 ULONG COLUMN_DIR DIRECT /end RECORD_LAYOUT
/begin RECORD_LAYOUT ECIPP_ALIGNMENT_SLONG FNC_VALUES 1 SLONG COLUMN_DIR DIRECT /end RECORD_LAYOUT
/begin RECORD_LAYOUT ECIPP_ALIGNMENT_FLOAT32_IEEE FNC_VALUES 1 FLOAT32_IEEE COLUMN_DIR DIRECT /end RECORD_LAYOUT
/begin CHARACTERISTIC UEGO_config "UEGO configuration{UEGO_config&0xff=0:Not Present}{UEGO_config&0xff=1:Internal Hardware}{UEGO_config&0xff=2:Aux PD1}{UEGO_config&0xff=3:Aux PD2}{UEGO_config&0xff=4:Aux PD3}{UEGO_config&0xff=5:Aux PU1}{UEGO_config&0xff=6:Aux PU2}{UEGO_config&0xff=7:Aux PU3" VALUE 0x001C8F7B /* @ECU_Address@UEGO_config@0x01001248@ */ ECIPP_ALIGNMENT_UBYTE 255 UEGO_config_COMPU_VTAB 0 255 BIT_MASK 0xff /end CHARACTERISTIC
/begin COMPU_METHOD UEGO_config_COMPU_VTAB "Verbal Table" TAB_VERB "%.0" "list" COMPU_TAB_REF UEGO_config_COMPU_VTAB_REF /end COMPU_METHOD
/begin COMPU_VTAB UEGO_config_COMPU_VTAB_REF "Verbal Table" TAB_VERB 37 0 "Not Present" 1 "Internal Hardware" 2 "Aux PD1" 3 "Aux PD2" 4 "Aux PD3" 5 "Aux PU1" 6 "Aux PU2" 7 "Aux PU3" 8 "Aux PUD1" 9 "Aux PUD2" 10 "Aux PUD3" 11 "Aux PUD4" 12 "Aux PUD5" 13 "Aux PUD6" 14 "Aux PUD7" 15 "Aux PUD8" 16 "Aux PUD9" 17 "Aux PUD10" 18 "Aux PUD11" 19 "Aux PUD12" 20 "Aux PUD13" 21 "Aux PUD14" 22 "Aux PUD15" 23 "Aux PUD16" 24 "Aux PUD17" 25 "Aux PUD18" 26 "Aux PUD19" 27 "Aux PUD20" 28 "Aux PUD21" 29 "Aux PUD22" 30 "Aux PUD23" 31 "Aux PUD24" 32 "Aux PUD25" 33 "CAN - NTK1" 34 "CAN - NTK2" 35 "CAN - NTK3" 36 "CAN - NTK intake" DEFAULT_VALUE "UNKNOWN" /end COMPU_VTAB
/begin CHARACTERISTIC LP_UEGO "UEGO low-pass" VALUE 0x001e58e8 /* @ECU_Address@LP_UEGO@0x01001250@ */ ECIPP_ALIGNMENT_UWORD 327680 Compu_LP_UEGO 0.45084 327680 /end CHARACTERISTIC
/begin COMPU_METHOD Compu_LP_UEGO " " FORM "%.1" "ms"
 /begin FORMULA "-5 / log(1 - (X1 / 65536))" FORMULA_INV "(1 - exp(-5/X1)) * 65536" /end FORMULA
/end COMPU_METHOD
/begin MEASUREMENT AAT "Ambient air temperature" UWORD Compu_AAT 0 0 -460 563.984375 ECU_ADDRESS 0x01001A98 /end MEASUREMENT
/begin COMPU_METHOD Compu_AAT " " RAT_FUNC "%.1" "deg F" COEFFS 0 64 29440 0 0 1 /end COMPU_METHOD
/begin CHARACTERISTIC UEGO_EBP_ena "UEGO EBP correction{UEGO_EBP_ena&0xff=0:Disabled}{UEGO_EBP_ena&0xff=1:Delta-P Mode (Legacy)}{UEGO_EBP_ena&0xff=2:Pressure Ratio Mode}{UEGO_EBP_ena&0xff=3:MFG Provided}" VALUE 0x001CA362 /* @ECU_Address@UEGO_EBP_ena@0x01001CA0@ */ ECIPP_ALIGNMENT_UBYTE 255 UEGO_EBP_ena_COMPU_VTAB 0 255 BIT_MASK 0xff /end CHARACTERISTIC
/begin COMPU_METHOD UEGO_EBP_ena_COMPU_VTAB "Verbal Table" TAB_VERB "%.0" "list" COMPU_TAB_REF UEGO_EBP_ena_COMPU_VTAB_REF /end COMPU_METHOD
/begin COMPU_VTAB UEGO_EBP_ena_COMPU_VTAB_REF "Verbal Table" TAB_VERB 4 0 "Disabled" 1 "Delta-P Mode (Legacy)" 2 "Pressure Ratio Mode" 3 "MFG Provided" DEFAULT_VALUE "UNKNOWN" /end COMPU_VTAB
/begin MEASUREMENT Phi_UEGO_raw "UEGO Phi uncorrected" UWORD Compu_Phi_UEGO_raw 0 0 0 3.99993896484375 ECU_ADDRESS 0x01001CB0 /end MEASUREMENT
/begin COMPU_METHOD Compu_Phi_UEGO_raw " " RAT_FUNC "%.3" "phi" COEFFS 0 16384 0 0 0 1 /end COMPU_METHOD
/begin CHARACTERISTIC EGO1_config "EGO1 configuration{EGO1_config&0xff=0:Not Present}{EGO1_config&0xff=1:Pre-Catalyst}{EGO1_config&0xff=2:Post-Catalyst}{EGO1_config&0xff=3:Intake Air+EGR}" VALUE 0x001c86d1 /* @ECU_Address@EGO1_config@0x01002248@ */ ECIPP_ALIGNMENT_UBYTE 255 EGO1_config_COMPU_VTAB 0 255 BIT_MASK 0xff /end CHARACTERISTIC
/begin COMPU_METHOD EGO1_config_COMPU_VTAB "Verbal Table" TAB_VERB "%.0" "list" COMPU_TAB_REF EGO1_config_COMPU_VTAB_REF /end COMPU_METHOD
/begin COMPU_VTAB EGO1_config_COMPU_VTAB_REF "Verbal Table" TAB_VERB 4 0 "Not Present" 1 "Pre-Catalyst" 2 "Post-Catalyst" 3 "Intake Air+EGR" DEFAULT_VALUE "UNKNOWN" /end COMPU_VTAB
/begin CHARACTERISTIC EGO2_config "EGO2 configuration{EGO2_config&0xff=0:Not Present}{EGO2_config&0xff=1:Pre-Catalyst}{EGO2_config&0xff=2:Post-Catalyst}{EGO2_config&0xff=3:Intake Air+EGR}" VALUE 0x001c86d2 /* @ECU_Address@EGO2_config@0x01002250@ */ ECIPP_ALIGNMENT_UBYTE 255 EGO2_config_COMPU_VTAB 0 255 BIT_MASK 0xff /end CHARACTERISTIC
/begin COMPU_METHOD EGO2_config_COMPU_VTAB "Verbal Table" TAB_VERB "%.0" "list" COMPU_TAB_REF EGO2_config_COMPU_VTAB_REF /end COMPU_METHOD
/begin COMPU_VTAB EGO2_config_COMPU_VTAB_REF "Verbal Table" TAB_VERB 4 0 "Not Present" 1 "Pre-Catalyst" 2 "Post-Catalyst" 3 "Intake Air+EGR" DEFAULT_VALUE "UNKNOWN" /end COMPU_VTAB
/begin CHARACTERISTIC EGO3_config "EGO3 configuration{EGO3_config&0xff=0:Not Present}{EGO3_config&0xff=1:Post-Catalyst}{EGO3_config&0xff=2:Pre-Catalyst}{EGO3_config&0xff=3:Intake Air+EGR}" VALUE 0x001c86d3 /* @ECU_Address@EGO3_config@0x01002258@ */ ECIPP_ALIGNMENT_UBYTE 255 EGO3_config_COMPU_VTAB 0 255 BIT_MASK 0xff /end CHARACTERISTIC
/begin COMPU_METHOD EGO3_config_COMPU_VTAB "Verbal Table" TAB_VERB "%.0" "list" COMPU_TAB_REF EGO3_config_COMPU_VTAB_REF /end COMPU_METHOD
/begin COMPU_VTAB EGO3_config_COMPU_VTAB_REF "Verbal Table" TAB_VERB 4 0 "Not Present" 1 "Post-Catalyst" 2 "Pre-Catalyst" 3 "Intake Air+EGR" DEFAULT_VALUE "UNKNOWN" /end COMPU_VTAB
/begin CHARACTERISTIC SH_UEGO_ena "UEGO humidity correction{SH_UEGO_ena&0xff=0:Disabled}{SH_UEGO_ena&0xff=1:Enabled}" VALUE 0x001c8908 /* @ECU_Address@SH_UEGO_ena@0x01002638@ */ ECIPP_ALIGNMENT_UBYTE 255 SH_UEGO_ena_COMPU_VTAB 0 255 BIT_MASK 0xff /end CHARACTERISTIC
/begin COMPU_METHOD SH_UEGO_ena_COMPU_VTAB "Verbal Table" TAB_VERB "%.0" "list" COMPU_TAB_REF SH_UEGO_ena_COMPU_VTAB_REF /end COMPU_METHOD
/begin COMPU_VTAB SH_UEGO_ena_COMPU_VTAB_REF "Verbal Table" TAB_VERB 2 0 "Disabled" 1 "Enabled" DEFAULT_VALUE "UNKNOWN" /end COMPU_VTAB
/begin CHARACTERISTIC SH_UEGO_nom "Nominal UEGO humidity" VALUE 0x001c7f5c /* @ECU_Address@SH_UEGO_nom@0x01002648@ */ ECIPP_ALIGNMENT_UWORD 16000 Compu_SH_UEGO_nom 0 15999.755859375 /end CHARACTERISTIC
/begin COMPU_METHOD Compu_SH_UEGO_nom " " RAT_FUNC "%.1" "g/kg" COEFFS 0 4.096 0 0 0 1 /end COMPU_METHOD
/begin CHARACTERISTIC EGO4_config "EGO4 configuration{EGO4_config&0xff=0:Not Present}{EGO4_config&0xff=1:Post-Catalyst}{EGO4_config&0xff=2:Pre-Catalyst}{EGO4_config&0xff=3:Intake Air+EGR}" VALUE 0x001c86d4 /* @ECU_Address@EGO4_config@0x010038C8@ */ ECIPP_ALIGNMENT_UBYTE 255 EGO4_config_COMPU_VTAB 0 255 BIT_MASK 0xff /end CHARACTERISTIC
/begin COMPU_METHOD EGO4_config_COMPU_VTAB "Verbal Table" TAB_VERB "%.0" "list" COMPU_TAB_REF EGO4_config_COMPU_VTAB_REF /end COMPU_METHOD
/begin COMPU_VTAB EGO4_config_COMPU_VTAB_REF "Verbal Table" TAB_VERB 4 0 "Not Present" 1 "Post-Catalyst" 2 "Pre-Catalyst" 3 "Intake Air+EGR" DEFAULT_VALUE "UNKNOWN" /end COMPU_VTAB
/begin CHARACTERISTIC EGOZ_enable "EGOZ monitor/control{EGOZ_enable&0xff=0:Disabled}{EGOZ_enable&0xff=1:Monitor Only}{EGOZ_enable&0xff=2:Heater Control}" VALUE 0x001c86d6 /* @ECU_Address@EGOZ_enable@0x01003960@ */ ECIPP_ALIGNMENT_UBYTE 255 EGOZ_enable_COMPU_VTAB 0 255 BIT_MASK 0xff /end CHARACTERISTIC
/begin COMPU_METHOD EGOZ_enable_COMPU_VTAB "Verbal Table" TAB_VERB "%.0" "list" COMPU_TAB_REF EGOZ_enable_COMPU_VTAB_REF /end COMPU_METHOD
/begin COMPU_VTAB EGOZ_enable_COMPU_VTAB_REF "Verbal Table" TAB_VERB 3 0 "Disabled" 1 "Monitor Only" 2 "Heater Control" DEFAULT_VALUE "UNKNOWN" /end COMPU_VTAB
/begin MEASUREMENT EGOZ_state "EGOZ sampling state" SBYTE Compu_EGOZ_state 0 0 -128 127 ECU_ADDRESS 0x01003968 /end MEASUREMENT
/begin COMPU_METHOD Compu_EGOZ_state " " RAT_FUNC "%.0" "-" COEFFS 0 1 0 0 0 1 /end COMPU_METHOD
/begin MEASUREMENT EGOZ_sensor "EGOZ sampled sensor" UBYTE Compu_EGOZ_sensor 0 0 0 255 ECU_ADDRESS 0x01003970 /end MEASUREMENT
/begin COMPU_METHOD Compu_EGOZ_sensor " " RAT_FUNC "%.0" "-" COEFFS 0 1 0 0 0 1 /end COMPU_METHOD
/begin CHARACTERISTIC EGOZ_poll_tout "EGOZ sampling interval" VALUE 0x001c6ee4 /* @ECU_Address@EGOZ_poll_tout@0x01003978@ */ ECIPP_ALIGNMENT_UWORD 65535 Compu_EGOZ_poll_tout 0 65535 /end CHARACTERISTIC
/begin COMPU_METHOD Compu_EGOZ_poll_tout " " RAT_FUNC "%.0" "ms" COEFFS 0 1 0 0 0 1 /end COMPU_METHOD
/begin CHARACTERISTIC EGOZ_presamp "EGOZ sampling pre-sample" VALUE 0x001c6ee6 /* @ECU_Address@EGOZ_presamp@0x01003980@ */ ECIPP_ALIGNMENT_UWORD 210 Compu_EGOZ_presamp 0 209.712 /end CHARACTERISTIC
/begin COMPU_METHOD Compu_EGOZ_presamp " " RAT_FUNC "%.3" "ms" COEFFS 0 312.5 0 0 0 1 /end COMPU_METHOD
/begin CHARACTERISTIC EGOZ_settle_ini "EGOZ pulse drive settling time" VALUE 0x001c6ef2 /* @ECU_Address@EGOZ_settle_ini@0x01003988@ */ ECIPP_ALIGNMENT_UWORD 210 Compu_EGOZ_settle_ini 0 209.712 /end CHARACTERISTIC
/begin COMPU_METHOD Compu_EGOZ_settle_ini " " RAT_FUNC "%.3" "ms" COEFFS 0 312.5 0 0 0 1 /end COMPU_METHOD
/begin CHARACTERISTIC EGOZ_pulse_t "EGOZ pulse time" VALUE 0x001c6eea /* @ECU_Address@EGOZ_pulse_t@0x01003990@ */ ECIPP_ALIGNMENT_UWORD 210 Compu_EGOZ_pulse_t 0 209.712 /end CHARACTERISTIC
/begin COMPU_METHOD Compu_EGOZ_pulse_t " " RAT_FUNC "%.3" "ms" COEFFS 0 312.5 0 0 0 1 /end COMPU_METHOD
/begin CHARACTERISTIC EGOZ_H_Vmin "EGOZ heater control Vmin" VALUE 0x001c44a8 /* @ECU_Address@EGOZ_H_Vmin@0x01003998@ */ ECIPP_ALIGNMENT_SWORD 128 Compu_EGOZ_H_Vmin -128 127.99609375 /end CHARACTERISTIC
/begin COMPU_METHOD Compu_EGOZ_H_Vmin " " RAT_FUNC "%.1" "volts" COEFFS 0 256 0 0 0 1 /end COMPU_METHOD
/begin CHARACTERISTIC EGOZ_H_Vmax "EGOZ heater control Vmax" VALUE 0x001c44a6 /* @ECU_Address@EGOZ_H_Vmax@0x010039A0@ */ ECIPP_ALIGNMENT_SWORD 128 Compu_EGOZ_H_Vmax -128 127.99609375 /end CHARACTERISTIC
/begin COMPU_METHOD Compu_EGOZ_H_Vmax " " RAT_FUNC "%.1" "volts" COEFFS 0 256 0 0 0 1 /end COMPU_METHOD
/begin CHARACTERISTIC EGOZ_H_Kp "EGOZ heater control Kp" VALUE 0x001c44a4 /* @ECU_Address@EGOZ_H_Kp@0x010039A8@ */ ECIPP_ALIGNMENT_SWORD 10 Compu_EGOZ_H_Kp -10.24 10.2396875 /end CHARACTERISTIC
/begin COMPU_METHOD Compu_EGOZ_H_Kp " " RAT_FUNC "%.3" "volts/%" COEFFS 0 3200 0 0 0 1 /end COMPU_METHOD
/begin CHARACTERISTIC EGOZ_H_Ki "EGOZ heater control Ki" VALUE 0x001c44a2 /* @ECU_Address@EGOZ_H_Ki@0x010039B0@ */ ECIPP_ALIGNMENT_SWORD 1 Compu_EGOZ_H_Ki -1.28 1.2799609375 /end CHARACTERISTIC
/begin COMPU_METHOD Compu_EGOZ_H_Ki " " RAT_FUNC "%.3" "volts/%/sec" COEFFS 0 25600 0 0 0 1 /end COMPU_METHOD
/begin MEASUREMENT EGO1Z_Rd "EGO1 heater control target Z" UWORD Compu_EGO1Z_Rd 0 0 0 65535 ECU_ADDRESS 0x010039B8 /end MEASUREMENT
/begin COMPU_METHOD Compu_EGO1Z_Rd " " RAT_FUNC "%.0" "ohms" COEFFS 0 1 0 0 0 1 /end COMPU_METHOD
/begin MEASUREMENT EGO2Z_Rd "EGO2 heater control target Z" UWORD Compu_EGO2Z_Rd 0 0 0 65535 ECU_ADDRESS 0x010039C0 /end MEASUREMENT
/begin COMPU_METHOD Compu_EGO2Z_Rd " " RAT_FUNC "%.0" "ohms" COEFFS 0 1 0 0 0 1 /end COMPU_METHOD
/begin MEASUREMENT EGO3Z_Rd "EGO3 heater control target Z" UWORD Compu_EGO3Z_Rd 0 0 0 65535 ECU_ADDRESS 0x010039C8 /end MEASUREMENT
/begin COMPU_METHOD Compu_EGO3Z_Rd " " RAT_FUNC "%.0" "ohms" COEFFS 0 1 0 0 0 1 /end COMPU_METHOD
/begin MEASUREMENT EGO4Z_Rd "EGO4 heater control target Z" UWORD Compu_EGO4Z_Rd 0 0 0 65535 ECU_ADDRESS 0x010039D0 /end MEASUREMENT
/begin COMPU_METHOD Compu_EGO4Z_Rd " " RAT_FUNC "%.0" "ohms" COEFFS 0 1 0 0 0 1 /end COMPU_METHOD
/begin MEASUREMENT EGO1Z_ohms "EGO1 impedance" UWORD Compu_EGO1Z_ohms 0 0 0 65535 ECU_ADDRESS 0x010039D8 /end MEASUREMENT
/begin COMPU_METHOD Compu_EGO1Z_ohms " " RAT_FUNC "%.0" "ohms" COEFFS 0 1 0 0 0 1 /end COMPU_METHOD
/begin MEASUREMENT EGO2Z_ohms "EGO2 impedance" UWORD Compu_EGO2Z_ohms 0 0 0 65535 ECU_ADDRESS 0x010039E0 /end MEASUREMENT
/begin COMPU_METHOD Compu_EGO2Z_ohms " " RAT_FUNC "%.0" "ohms" COEFFS 0 1 0 0 0 1 /end COMPU_METHOD
/begin MEASUREMENT EGO3Z_ohms "EGO3 impedance" UWORD Compu_EGO3Z_ohms 0 0 0 65535 ECU_ADDRESS 0x010039E8 /end MEASUREMENT
/begin COMPU_METHOD Compu_EGO3Z_ohms " " RAT_FUNC "%.0" "ohms" COEFFS 0 1 0 0 0 1 /end COMPU_METHOD
/begin MEASUREMENT EGO4Z_ohms "EGO4 impedance" UWORD Compu_EGO4Z_ohms 0 0 0 65535 ECU_ADDRESS 0x010039F0 /end MEASUREMENT
/begin COMPU_METHOD Compu_EGO4Z_ohms " " RAT_FUNC "%.0" "ohms" COEFFS 0 1 0 0 0 1 /end COMPU_METHOD
/begin MEASUREMENT EGO1Z_samp_fail "EGO1 failed impedance samples" UWORD Compu_EGO1Z_samp_fail 0 0 0 65535 ECU_ADDRESS 0x010039F8 /end MEASUREMENT
/begin COMPU_METHOD Compu_EGO1Z_samp_fail " " RAT_FUNC "%.0" "count" COEFFS 0 1 0 0 0 1 /end COMPU_METHOD
/begin MEASUREMENT EGO2Z_samp_fail "EGO2 failed impedance samples" UWORD Compu_EGO2Z_samp_fail 0 0 0 65535 ECU_ADDRESS 0x01003A00 /end MEASUREMENT
/begin COMPU_METHOD Compu_EGO2Z_samp_fail " " RAT_FUNC "%.0" "count" COEFFS 0 1 0 0 0 1 /end COMPU_METHOD
/begin MEASUREMENT EGO3Z_samp_fail "EGO3 failed impedance samples" UWORD Compu_EGO3Z_samp_fail 0 0 0 65535 ECU_ADDRESS 0x01003A08 /end MEASUREMENT
/begin COMPU_METHOD Compu_EGO3Z_samp_fail " " RAT_FUNC "%.0" "count" COEFFS 0 1 0 0 0 1 /end COMPU_METHOD
/begin MEASUREMENT EGO4Z_samp_fail "EGO4 failed impedance samples" UWORD Compu_EGO4Z_samp_fail 0 0 0 65535 ECU_ADDRESS 0x01003A10 /end MEASUREMENT
/begin COMPU_METHOD Compu_EGO4Z_samp_fail " " RAT_FUNC "%.0" "count" COEFFS 0 1 0 0 0 1 /end COMPU_METHOD
/begin CHARACTERISTIC EGOZ_samp_fail_lim "EGO failed impedance sample limit" VALUE 0x001c6eee /* @ECU_Address@EGOZ_samp_fail_lim@0x01003A18@ */ ECIPP_ALIGNMENT_UWORD 65535 Compu_EGOZ_samp_fail_lim 0 65535 /end CHARACTERISTIC
/begin COMPU_METHOD Compu_EGOZ_samp_fail_lim " " RAT_FUNC "%.0" "count" COEFFS 0 1 0 0 0 1 /end COMPU_METHOD
/begin CHARACTERISTIC EGOZ_settle_final "EGOZ post-sample recovery time" VALUE 0x001c6ef0 /* @ECU_Address@EGOZ_settle_final@0x01003A20@ */ ECIPP_ALIGNMENT_UWORD 210 Compu_EGOZ_settle_final 0 209.712 /end CHARACTERISTIC
/begin COMPU_METHOD Compu_EGOZ_settle_final " " RAT_FUNC "%.3" "ms" COEFFS 0 312.5 0 0 0 1 /end COMPU_METHOD
/begin MEASUREMENT EGO1Z_H_Iacc "EGO1Z heater integrator accum" SWORD Compu_EGO1Z_H_Iacc 0 0 -128 127.99609375 ECU_ADDRESS 0x01003A28 /end MEASUREMENT
/begin COMPU_METHOD Compu_EGO1Z_H_Iacc " " RAT_FUNC "%.1" "volts" COEFFS 0 256 0 0 0 1 /end COMPU_METHOD
/begin MEASUREMENT EGO2Z_H_Iacc "EGO2Z heater integrator accum" SWORD Compu_EGO2Z_H_Iacc 0 0 -128 127.99609375 ECU_ADDRESS 0x01003A30 /end MEASUREMENT
/begin COMPU_METHOD Compu_EGO2Z_H_Iacc " " RAT_FUNC "%.1" "volts" COEFFS 0 256 0 0 0 1 /end COMPU_METHOD
/begin MEASUREMENT EGO3Z_H_Iacc "EGO3Z heater integrator accum" SWORD Compu_EGO3Z_H_Iacc 0 0 -128 127.99609375 ECU_ADDRESS 0x01003A38 /end MEASUREMENT
/begin COMPU_METHOD Compu_EGO3Z_H_Iacc " " RAT_FUNC "%.1" "volts" COEFFS 0 256 0 0 0 1 /end COMPU_METHOD
/begin MEASUREMENT EGO4Z_H_Iacc "EGO4Z heater integrator accum" SWORD Compu_EGO4Z_H_Iacc 0 0 -128 127.99609375 ECU_ADDRESS 0x01003A40 /end MEASUREMENT
/begin COMPU_METHOD Compu_EGO4Z_H_Iacc " " RAT_FUNC "%.1" "volts" COEFFS 0 256 0 0 0 1 /end COMPU_METHOD
/begin CHARACTERISTIC EGOZ_presamp_SStol "EGOZ pre-sample SS tolerance" VALUE 0x001c6ee8 /* @ECU_Address@EGOZ_presamp_SStol@0x01003A48@ */ ECIPP_ALIGNMENT_UWORD 5 Compu_EGOZ_presamp_SStol 0 4.98867383424908 /end CHARACTERISTIC
/begin COMPU_METHOD Compu_EGOZ_presamp_SStol " " RAT_FUNC "%.3" "volts" COEFFS 0 13136.7578192982 0 0 0 1 /end COMPU_METHOD
/begin CHARACTERISTIC EGOZ_Rcold_def "EGOZ default cold R value" VALUE 0x001c6ede /* @ECU_Address@EGOZ_Rcold_def@0x01003A50@ */ ECIPP_ALIGNMENT_UWORD 65535 Compu_EGOZ_Rcold_def 0 65535 /end CHARACTERISTIC
/begin COMPU_METHOD Compu_EGOZ_Rcold_def " " RAT_FUNC "%.0" "ohms" COEFFS 0 1 0 0 0 1 /end COMPU_METHOD
/begin CHARACTERISTIC EGOZ_pulse_thresh "EGOZ pre-sample pulse hi/lo threshold" VALUE 0x001c6eec /* @ECU_Address@EGOZ_pulse_thresh@0x01003A58@ */ ECIPP_ALIGNMENT_UWORD 5 Compu_EGOZ_pulse_thresh 0 4.98867383424908 /end CHARACTERISTIC
/begin COMPU_METHOD Compu_EGOZ_pulse_thresh " " RAT_FUNC "%.3" "volts" COEFFS 0 13136.7578192982 0 0 0 1 /end COMPU_METHOD
/begin CHARACTERISTIC EGOZ_Rhot_precat "Pre-cat EGO active sensor threshold Z" VALUE 0x001c6ee2 /* @ECU_Address@EGOZ_Rhot_precat@0x01003A60@ */ ECIPP_ALIGNMENT_UWORD 65535 Compu_EGOZ_Rhot_precat 0 65535 /end CHARACTERISTIC
/begin COMPU_METHOD Compu_EGOZ_Rhot_precat " " RAT_FUNC "%.0" "ohms" COEFFS 0 1 0 0 0 1 /end COMPU_METHOD
/begin CHARACTERISTIC EGOZ_Rhot_postcat "Post-cat EGO active sensor threshold Z" VALUE 0x001c6ee0 /* @ECU_Address@EGOZ_Rhot_postcat@0x01003A68@ */ ECIPP_ALIGNMENT_UWORD 65535 Compu_EGOZ_Rhot_postcat 0 65535 /end CHARACTERISTIC
/begin COMPU_METHOD Compu_EGOZ_Rhot_postcat " " RAT_FUNC "%.0" "ohms" COEFFS 0 1 0 0 0 1 /end COMPU_METHOD
/begin CHARACTERISTIC EGOH_Vdef_precat "Pre-cat EGO heater default voltage" VALUE 0x001c6eda /* @ECU_Address@EGOH_Vdef_precat@0x01003A70@ */ ECIPP_ALIGNMENT_UWORD 256 Compu_EGOH_Vdef_precat 0 255.99609375 /end CHARACTERISTIC
/begin COMPU_METHOD Compu_EGOH_Vdef_precat " " RAT_FUNC "%.1" "volts" COEFFS 0 256 0 0 0 1 /end COMPU_METHOD
/begin CHARACTERISTIC EGOH_Vdef_postcat "Post-cat EGO heater default voltage" VALUE 0x001c6ed8 /* @ECU_Address@EGOH_Vdef_postcat@0x01003A78@ */ ECIPP_ALIGNMENT_UWORD 256 Compu_EGOH_Vdef_postcat 0 255.99609375 /end CHARACTERISTIC
/begin COMPU_METHOD Compu_EGOH_Vdef_postcat " " RAT_FUNC "%.1" "volts" COEFFS 0 256 0 0 0 1 /end COMPU_METHOD
/begin CHARACTERISTIC EGOZ_H_Iinit "EGOZ heater control initial integrator" VALUE 0x001c3e48 /* @ECU_Address@EGOZ_H_Iinit@0x01003A80@ */ ECIPP_ALIGNMENT_SLONG 128 Compu_EGOZ_H_Iinit -128 127.999999940395 /end CHARACTERISTIC
/begin COMPU_METHOD Compu_EGOZ_H_Iinit " " RAT_FUNC "%.1" "volts" COEFFS 0 16777216 0 0 0 1 /end COMPU_METHOD
/begin MEASUREMENT EGO1H_V_d "EGO1 heater V target" UWORD Compu_EGO1H_V_d 0 0 0 255.99609375 ECU_ADDRESS 0x01003A88 /end MEASUREMENT
/begin COMPU_METHOD Compu_EGO1H_V_d " " RAT_FUNC "%.1" "volts" COEFFS 0 256 0 0 0 1 /end COMPU_METHOD
/begin MEASUREMENT EGO2H_V_d "EGO2 heater V target" UWORD Compu_EGO2H_V_d 0 0 0 255.99609375 ECU_ADDRESS 0x01003A90 /end MEASUREMENT
/begin COMPU_METHOD Compu_EGO2H_V_d " " RAT_FUNC "%.1" "volts" COEFFS 0 256 0 0 0 1 /end COMPU_METHOD
/begin MEASUREMENT EGO3H_V_d "EGO3 heater V target" UWORD Compu_EGO3H_V_d 0 0 0 255.99609375 ECU_ADDRESS 0x01003A98 /end MEASUREMENT
/begin COMPU_METHOD Compu_EGO3H_V_d " " RAT_FUNC "%.1" "volts" COEFFS 0 256 0 0 0 1 /end COMPU_METHOD
/begin MEASUREMENT EGO4H_V_d "EGO4 heater V target" UWORD Compu_EGO4H_V_d 0 0 0 255.99609375 ECU_ADDRESS 0x01003AA0 /end MEASUREMENT
/begin COMPU_METHOD Compu_EGO4H_V_d " " RAT_FUNC "%.1" "volts" COEFFS 0 256 0 0 0 1 /end COMPU_METHOD
/begin MEASUREMENT EGO1H_DC "EGO1 heater duty-cycle" UWORD Compu_EGO1H_DC 0 0 0 99.9984741210938 ECU_ADDRESS 0x01003AA8 /end MEASUREMENT
/begin COMPU_METHOD Compu_EGO1H_DC " " RAT_FUNC "%.1" "%" COEFFS 0 655.36 0 0 0 1 /end COMPU_METHOD
/begin MEASUREMENT EGO2H_DC "EGO2 heater duty-cycle" UWORD Compu_EGO2H_DC 0 0 0 99.9984741210938 ECU_ADDRESS 0x01003AB0 /end MEASUREMENT
/begin COMPU_METHOD Compu_EGO2H_DC " " RAT_FUNC "%.1" "%" COEFFS 0 655.36 0 0 0 1 /end COMPU_METHOD
/begin MEASUREMENT EGO3H_DC "EGO3 heater duty-cycle" UWORD Compu_EGO3H_DC 0 0 0 99.9984741210938 ECU_ADDRESS 0x01003AB8 /end MEASUREMENT
/begin COMPU_METHOD Compu_EGO3H_DC " " RAT_FUNC "%.1" "%" COEFFS 0 655.36 0 0 0 1 /end COMPU_METHOD
/begin MEASUREMENT EGO4H_DC "EGO4 heater duty-cycle" UWORD Compu_EGO4H_DC 0 0 0 99.9984741210938 ECU_ADDRESS 0x01003AC0 /end MEASUREMENT
/begin COMPU_METHOD Compu_EGO4H_DC " " RAT_FUNC "%.1" "%" COEFFS 0 655.36 0 0 0 1 /end COMPU_METHOD
/begin MEASUREMENT ECT_start "ECT latched at start" UWORD Compu_ECT_start 0 0 -460 563.984375 ECU_ADDRESS 0x01004948 /end MEASUREMENT
/begin COMPU_METHOD Compu_ECT_start " " RAT_FUNC "%.1" "deg F" COEFFS 0 64 29440 0 0 1 /end COMPU_METHOD
/begin MEASUREMENT ECT_restart "ECT for relatch at restart" UWORD Compu_ECT_restart 0 0 -460 563.984375 ECU_ADDRESS 0x01004950 /end MEASUREMENT
/begin COMPU_METHOD Compu_ECT_restart " " RAT_FUNC "%.1" "deg F" COEFFS 0 64 29440 0 0 1 /end COMPU_METHOD
/begin MEASUREMENT UEGOH_start_wait "UEGO heater delay from start" UWORD Compu_UEGOH_start_wait 0 0 0 65535 ECU_ADDRESS 0x01004958 /end MEASUREMENT
/begin COMPU_METHOD Compu_UEGOH_start_wait " " RAT_FUNC "%.0" "sec" COEFFS 0 1 0 0 0 1 /end COMPU_METHOD
/begin CHARACTERISTIC EGOHpost_run_mode "Post-cat EGO heater control mode{EGOHpost_run_mode&0xff=0:On when engine is running}{EGOHpost_run_mode&0xff=1:On only during active control}{EGOHpost_run_mode&0xff=2:On when engine is running OR UEGOH on}" VALUE 0x001c86d5 /* @ECU_Address@EGOHpost_run_mode@0x01004960@ */ ECIPP_ALIGNMENT_UBYTE 255 EGOHpost_run_mode_COMPU_VTAB 0 255 BIT_MASK 0xff /end CHARACTERISTIC
/begin COMPU_METHOD EGOHpost_run_mode_COMPU_VTAB "Verbal Table" TAB_VERB "%.0" "list" COMPU_TAB_REF EGOHpost_run_mode_COMPU_VTAB_REF /end COMPU_METHOD
/begin COMPU_VTAB EGOHpost_run_mode_COMPU_VTAB_REF "Verbal Table" TAB_VERB 3 0 "On when engine is running" 1 "On only during active control" 2 "On when engine is running OR UEGOH on" DEFAULT_VALUE "UNKNOWN" /end COMPU_VTAB
/begin CHARACTERISTIC ECT_restart_ramp "ECT at engine re-start ramp rate" VALUE 0x001c6eb4 /* @ECU_Address@ECT_restart_ramp@0x01004968@ */ ECIPP_ALIGNMENT_UWORD 512 Compu_ECT_restart_ramp 0 511.9921875 /end CHARACTERISTIC
/begin COMPU_METHOD Compu_ECT_restart_ramp " " RAT_FUNC "%.2" "deg F/sec" COEFFS 0 128 0 0 0 1 /end COMPU_METHOD
/begin MEASUREMENT AF_UEGO "UEGO A/F ratio" UWORD Compu_AF_UEGO 0 0 0 63.9990234375 ECU_ADDRESS 0x010052C8 /end MEASUREMENT
/begin COMPU_METHOD Compu_AF_UEGO " " RAT_FUNC "%.2" "A/F ratio" COEFFS 0 1024 0 0 0 1 /end COMPU_METHOD
/begin CHARACTERISTIC UEGO_EBP_C "UEGO EBP dP mode C" VALUE 0x001CA364 /* @ECU_Address@UEGO_EBP_C@0x01006288@ */ ECIPP_ALIGNMENT_FLOAT32_IEEE 10000000000 Compu_UEGO_EBP_C -10000000000 10000000000 /end CHARACTERISTIC
/begin COMPU_METHOD Compu_UEGO_EBP_C " " RAT_FUNC "%.3" "dphi / psi" COEFFS 0 1 0 0 0 1 /end COMPU_METHOD
/begin MEASUREMENT UEGO_state "UEGO state{UEGO_state&0xff=0:Off}{UEGO_state&0xff=1:Calibrating}{UEGO_state&0xff=2:Cold}{UEGO_state&0xff=3:Warmup}{UEGO_state&0xff=4:Running}{UEGO_state&0xff=5:Fault}" UBYTE UEGO_state_COMPU_VTAB 0 0 0 255 ECU_ADDRESS 0x01007508 BIT_MASK 0xff /end MEASUREMENT
/begin COMPU_METHOD UEGO_state_COMPU_VTAB "Verbal Table" TAB_VERB "%.0" "list" COMPU_TAB_REF UEGO_state_COMPU_VTAB_REF /end COMPU_METHOD
/begin COMPU_VTAB UEGO_state_COMPU_VTAB_REF "Verbal Table" TAB_VERB 6 0 "Off" 1 "Calibrating" 2 "Cold" 3 "Warmup" 4 "Running" 5 "Fault" DEFAULT_VALUE "UNKNOWN" /end COMPU_VTAB
/begin MEASUREMENT UEGO_SPI_state "UEGO SPI state{UEGO_SPI_state&0xff=0:Idle}{UEGO_SPI_state&0xff=1:Reset}{UEGO_SPI_state&0xff=2:Cold}{UEGO_SPI_state&0xff=3:Warmup}{UEGO_SPI_state&0xff=4:Running}{UEGO_SPI_state&0xff=5:Diagnosing}{UEGO_SPI_state&0xff=6:SPI busy}" UBYTE UEGO_SPI_state_COMPU_VTAB 0 0 0 255 ECU_ADDRESS 0x01007510 BIT_MASK 0xff /end MEASUREMENT
/begin COMPU_METHOD UEGO_SPI_state_COMPU_VTAB "Verbal Table" TAB_VERB "%.0" "list" COMPU_TAB_REF UEGO_SPI_state_COMPU_VTAB_REF /end COMPU_METHOD
/begin COMPU_VTAB UEGO_SPI_state_COMPU_VTAB_REF "Verbal Table" TAB_VERB 7 0 "Idle" 1 "Reset" 2 "Cold" 3 "Warmup" 4 "Running" 5 "Diagnosing" 6 "SPI busy" DEFAULT_VALUE "UNKNOWN" /end COMPU_VTAB
/begin MEASUREMENT UEGO_cal_flag "UEGO calibration status{UEGO_cal_flag&0xff=0:Not calibrated}{UEGO_cal_flag&0xff=1:Calibration complete}" UBYTE UEGO_cal_flag_COMPU_VTAB 0 0 0 255 ECU_ADDRESS 0x01007520 BIT_MASK 0xff /end MEASUREMENT
/begin COMPU_METHOD UEGO_cal_flag_COMPU_VTAB "Verbal Table" TAB_VERB "%.0" "list" COMPU_TAB_REF UEGO_cal_flag_COMPU_VTAB_REF /end COMPU_METHOD
/begin COMPU_VTAB UEGO_cal_flag_COMPU_VTAB_REF "Verbal Table" TAB_VERB 2 0 "Not calibrated" 1 "Calibration complete" DEFAULT_VALUE "UNKNOWN" /end COMPU_VTAB
/begin MEASUREMENT UEGO_Rsensor "UEGO sensor resistance" UWORD Compu_UEGO_Rsensor 0 0 0 1023.984375 ECU_ADDRESS 0x01007528 /end MEASUREMENT
/begin COMPU_METHOD Compu_UEGO_Rsensor " " RAT_FUNC "%.0" "ohms" COEFFS 0 64 0 0 0 1 /end COMPU_METHOD
/begin MEASUREMENT UEGO_Tsensor "UEGO sensor temperature" SWORD Compu_UEGO_Tsensor 0 0 -8192 8191.75 ECU_ADDRESS 0x01007530 /end MEASUREMENT
/begin COMPU_METHOD Compu_UEGO_Tsensor " " RAT_FUNC "%.1" "deg C" COEFFS 0 4 0 0 0 1 /end COMPU_METHOD
/begin MEASUREMENT UEGO_Vheater_DC "UEGO heater duty-cycle" UWORD Compu_UEGO_Vheater_DC 0 0 0 99.9984741210938 ECU_ADDRESS 0x01007538 /end MEASUREMENT
/begin COMPU_METHOD Compu_UEGO_Vheater_DC " " RAT_FUNC "%.1" "%" COEFFS 0 655.36 0 0 0 1 /end COMPU_METHOD
/begin CHARACTERISTIC UEGOB_Twarmup "UEGO warmup transition" VALUE 0x001CA2D4 /* @ECU_Address@UEGOB_Twarmup@0x01007688@ */ ECIPP_ALIGNMENT_SWORD 8192 Compu_UEGOB_Twarmup -8192 8191.75 /end CHARACTERISTIC
/begin COMPU_METHOD Compu_UEGOB_Twarmup " " RAT_FUNC "%.1" "deg C" COEFFS 0 4 0 0 0 1 /end COMPU_METHOD
/begin CHARACTERISTIC UEGOB_TCLp_enable "UEGO closed-loop transition" VALUE 0x001CA2D6 /* @ECU_Address@UEGOB_TCLp_enable@0x01007690@ */ ECIPP_ALIGNMENT_SWORD 8192 Compu_UEGOB_TCLp_enable -8192 8191.75 /end CHARACTERISTIC
/begin COMPU_METHOD Compu_UEGOB_TCLp_enable " " RAT_FUNC "%.1" "deg C" COEFFS 0 4 0 0 0 1 /end COMPU_METHOD
/begin CHARACTERISTIC UEGOB_Ttarget "UEGO closed-loop target" VALUE 0x001CA2D8 /* @ECU_Address@UEGOB_Ttarget@0x01007698@ */ ECIPP_ALIGNMENT_SWORD 8192 Compu_UEGOB_Ttarget -8192 8191.75 /end CHARACTERISTIC
/begin COMPU_METHOD Compu_UEGOB_Ttarget " " RAT_FUNC "%.1" "deg C" COEFFS 0 4 0 0 0 1 /end COMPU_METHOD
/begin CHARACTERISTIC UEGOB_Thysteresis "UEGO temperature hysteresis" VALUE 0x001CA2DA /* @ECU_Address@UEGOB_Thysteresis@0x010076A0@ */ ECIPP_ALIGNMENT_SWORD 8192 Compu_UEGOB_Thysteresis -8192 8191.75 /end CHARACTERISTIC
/begin COMPU_METHOD Compu_UEGOB_Thysteresis " " RAT_FUNC "%.1" "deg C" COEFFS 0 4 0 0 0 1 /end COMPU_METHOD
/begin CHARACTERISTIC UEGOB_Kp_Vheater "UEGO heater Kp gain" VALUE 0x001CA2DC /* @ECU_Address@UEGOB_Kp_Vheater@0x010076A8@ */ ECIPP_ALIGNMENT_SWORD 0 Compu_UEGOB_Kp_Vheater -0.5 0.499984741210938 /end CHARACTERISTIC
/begin COMPU_METHOD Compu_UEGOB_Kp_Vheater " " RAT_FUNC "%.3" "volts/degC" COEFFS 0 65536 0 0 0 1 /end COMPU_METHOD
/begin CHARACTERISTIC UEGOB_Ki_Vheater "UEGO heater Ki gain" VALUE 0x001CA2DE /* @ECU_Address@UEGOB_Ki_Vheater@0x010076B0@ */ ECIPP_ALIGNMENT_SWORD 25 Compu_UEGOB_Ki_Vheater -25 24.9992370605469 /end CHARACTERISTIC
/begin COMPU_METHOD Compu_UEGOB_Ki_Vheater " " RAT_FUNC "%.3" "volts/degC/sec" COEFFS 0 1310.72 0 0 0 1 /end COMPU_METHOD
/begin CHARACTERISTIC UEGOB_Kd_Vheater "UEGO heater Kd gain" VALUE 0x001CA2E0 /* @ECU_Address@UEGOB_Kd_Vheater@0x010076B8@ */ ECIPP_ALIGNMENT_SWORD 200 Compu_UEGOB_Kd_Vheater -200 199.993896484375 /end CHARACTERISTIC
/begin COMPU_METHOD Compu_UEGOB_Kd_Vheater " " RAT_FUNC "%.3" "volts/degC*sec" COEFFS 0 163.84 0 0 0 1 /end COMPU_METHOD
/begin CHARACTERISTIC UEGOB_Vheater_max "UEGO heater max voltage" VALUE 0x001CA2E8 /* @ECU_Address@UEGOB_Vheater_max@0x010076C0@ */ ECIPP_ALIGNMENT_SLONG 2097152 Compu_UEGOB_Vheater_max -2097152 2097151.99902344 /end CHARACTERISTIC
/begin COMPU_METHOD Compu_UEGOB_Vheater_max " " RAT_FUNC "%.1" "volts" COEFFS 0 1024 0 0 0 1 /end COMPU_METHOD
/begin CHARACTERISTIC UEGOB_integral_max "UEGO heater max integral" VALUE 0x001CA2F0 /* @ECU_Address@UEGOB_integral_max@0x010076C8@ */ ECIPP_ALIGNMENT_SLONG 2048 Compu_UEGOB_integral_max -2048 2047.99999904633 /end CHARACTERISTIC
/begin COMPU_METHOD Compu_UEGOB_integral_max " " RAT_FUNC "%.1" "volts" COEFFS 0 1048576 0 0 0 1 /end COMPU_METHOD
/begin MEASUREMENT UEGO_Vheater_int "UEGO heater integral" SLONG Compu_UEGO_Vheater_int 0 0 -2048 2047.99999904633 ECU_ADDRESS 0x010076D0 /end MEASUREMENT
/begin COMPU_METHOD Compu_UEGO_Vheater_int " " RAT_FUNC "%.1" "volts" COEFFS 0 1048576 0 0 0 1 /end COMPU_METHOD
/begin MEASUREMENT UEGO_SR_Vofst "UEGO ASIC SR Vout offset" UWORD Compu_UEGO_SR_Vofst 0 0 0 63.9990234375 ECU_ADDRESS 0x010076D8 /end MEASUREMENT
/begin COMPU_METHOD Compu_UEGO_SR_Vofst " " RAT_FUNC "%.3" "volts" COEFFS 0 1024 0 0 0 1 /end COMPU_METHOD
/begin MEASUREMENT UEGO_PI_Vofst "UEGO ASIC PI Vout offset" UWORD Compu_UEGO_PI_Vofst 0 0 0 63.9990234375 ECU_ADDRESS 0x010076E0 /end MEASUREMENT
/begin COMPU_METHOD Compu_UEGO_PI_Vofst " " RAT_FUNC "%.3" "volts" COEFFS 0 1024 0 0 0 1 /end COMPU_METHOD
/begin MEASUREMENT UEGO_Vheater "UEGO heater voltage" SWORD Compu_UEGO_Vheater 0 0 -32 31.9990234375 ECU_ADDRESS 0x010076E8 /end MEASUREMENT
/begin COMPU_METHOD Compu_UEGO_Vheater " " RAT_FUNC "%.1" "volts" COEFFS 0 1024 0 0 0 1 /end COMPU_METHOD
/begin CHARACTERISTIC UEGO2_config "UEGO2 configuration{UEGO2_config&0xff=0:Not Present}{UEGO2_config&0xff=1:Internal Hardware}{UEGO2_config&0xff=2:Aux PD1}{UEGO2_config&0xff=3:Aux PD2}{UEGO2_config&0xff=4:Aux PD3}{UEGO2_config&0xff=5:Aux PU1}{UEGO2_config&0xff=6:Aux PU2}{UEGO2_config&0xff=" VALUE 0x001C8F7C /* @ECU_Address@UEGO2_config@0x01007D40@ */ ECIPP_ALIGNMENT_UBYTE 255 UEGO2_config_COMPU_VTAB 0 255 BIT_MASK 0xff /end CHARACTERISTIC
/begin COMPU_METHOD UEGO2_config_COMPU_VTAB "Verbal Table" TAB_VERB "%.0" "list" COMPU_TAB_REF UEGO2_config_COMPU_VTAB_REF /end COMPU_METHOD
/begin COMPU_VTAB UEGO2_config_COMPU_VTAB_REF "Verbal Table" TAB_VERB 37 0 "Not Present" 1 "Internal Hardware" 2 "Aux PD1" 3 "Aux PD2" 4 "Aux PD3" 5 "Aux PU1" 6 "Aux PU2" 7 "Aux PU3" 8 "Aux PUD1" 9 "Aux PUD2" 10 "Aux PUD3" 11 "Aux PUD4" 12 "Aux PUD5" 13 "Aux PUD6" 14 "Aux PUD7" 15 "Aux PUD8" 16 "Aux PUD9" 17 "Aux PUD10" 18 "Aux PUD11" 19 "Aux PUD12" 20 "Aux PUD13" 21 "Aux PUD14" 22 "Aux PUD15" 23 "Aux PUD16" 24 "Aux PUD17" 25 "Aux PUD18" 26 "Aux PUD19" 27 "Aux PUD20" 28 "Aux PUD21" 29 "Aux PUD22" 30 "Aux PUD23" 31 "Aux PUD24" 32 "Aux PUD25" 33 "CAN - NTK1" 34 "CAN - NTK2" 35 "CAN - NTK3" 36 "CAN - NTK intake" DEFAULT_VALUE "UNKNOWN" /end COMPU_VTAB
/begin MEASUREMENT Phi_UEGO2_raw "UEGO Phi uncorrected" UWORD Compu_Phi_UEGO2_raw 0 0 0 3.99993896484375 ECU_ADDRESS 0x01007D48 /end MEASUREMENT
/begin COMPU_METHOD Compu_Phi_UEGO2_raw " " RAT_FUNC "%.3" "phi" COEFFS 0 16384 0 0 0 1 /end COMPU_METHOD
/begin MEASUREMENT AF_UEGO2 "UEGO A/F ratio" UWORD Compu_AF_UEGO2 0 0 0 63.9990234375 ECU_ADDRESS 0x01007D58 /end MEASUREMENT
/begin COMPU_METHOD Compu_AF_UEGO2 " " RAT_FUNC "%.2" "A/F ratio" COEFFS 0 1024 0 0 0 1 /end COMPU_METHOD
/begin MEASUREMENT UEGO2_state "UEGO2 state{UEGO2_state&0xff=0:Off}{UEGO2_state&0xff=1:Calibrating}{UEGO2_state&0xff=2:Cold}{UEGO2_state&0xff=3:Warmup}{UEGO2_state&0xff=4:Running}{UEGO2_state&0xff=5:Fault}" UBYTE UEGO2_state_COMPU_VTAB 0 0 0 255 ECU_ADDRESS 0x010081A0 BIT_MASK 0xff /end MEASUREMENT
/begin COMPU_METHOD UEGO2_state_COMPU_VTAB "Verbal Table" TAB_VERB "%.0" "list" COMPU_TAB_REF UEGO2_state_COMPU_VTAB_REF /end COMPU_METHOD
/begin COMPU_VTAB UEGO2_state_COMPU_VTAB_REF "Verbal Table" TAB_VERB 6 0 "Off" 1 "Calibrating" 2 "Cold" 3 "Warmup" 4 "Running" 5 "Fault" DEFAULT_VALUE "UNKNOWN" /end COMPU_VTAB
/begin MEASUREMENT UEGO2_SPI_state "UEGO2 SPI state{UEGO2_SPI_state&0xff=0:Idle}{UEGO2_SPI_state&0xff=1:Reset}{UEGO2_SPI_state&0xff=2:Cold}{UEGO2_SPI_state&0xff=3:Warmup}{UEGO2_SPI_state&0xff=4:Running}{UEGO2_SPI_state&0xff=5:Diagnosing}{UEGO2_SPI_state&0xff=6:SPI busy}" UBYTE UEGO2_SPI_state_COMPU_VTAB 0 0 0 255 ECU_ADDRESS 0x010081A8 BIT_MASK 0xff /end MEASUREMENT
/begin COMPU_METHOD UEGO2_SPI_state_COMPU_VTAB "Verbal Table" TAB_VERB "%.0" "list" COMPU_TAB_REF UEGO2_SPI_state_COMPU_VTAB_REF /end COMPU_METHOD
/begin COMPU_VTAB UEGO2_SPI_state_COMPU_VTAB_REF "Verbal Table" TAB_VERB 7 0 "Idle" 1 "Reset" 2 "Cold" 3 "Warmup" 4 "Running" 5 "Diagnosing" 6 "SPI busy" DEFAULT_VALUE "UNKNOWN" /end COMPU_VTAB
/begin MEASUREMENT UEGO2_cal_flag "UEGO2 calibration status{UEGO2_cal_flag&0xff=0:Not calibrated}{UEGO2_cal_flag&0xff=1:Calibration complete}" UBYTE UEGO2_cal_flag_COMPU_VTAB 0 0 0 255 ECU_ADDRESS 0x010081B8 BIT_MASK 0xff /end MEASUREMENT
/begin COMPU_METHOD UEGO2_cal_flag_COMPU_VTAB "Verbal Table" TAB_VERB "%.0" "list" COMPU_TAB_REF UEGO2_cal_flag_COMPU_VTAB_REF /end COMPU_METHOD
/begin COMPU_VTAB UEGO2_cal_flag_COMPU_VTAB_REF "Verbal Table" TAB_VERB 2 0 "Not calibrated" 1 "Calibration complete" DEFAULT_VALUE "UNKNOWN" /end COMPU_VTAB
/begin MEASUREMENT UEGO2_Rsensor "UEGO2 sensor resistance" UWORD Compu_UEGO2_Rsensor 0 0 0 1023.984375 ECU_ADDRESS 0x010081C0 /end MEASUREMENT
/begin COMPU_METHOD Compu_UEGO2_Rsensor " " RAT_FUNC "%.0" "ohms" COEFFS 0 64 0 0 0 1 /end COMPU_METHOD
/begin MEASUREMENT UEGO2_Tsensor "UEGO2 sensor temperature" SWORD Compu_UEGO2_Tsensor 0 0 -8192 8191.75 ECU_ADDRESS 0x010081C8 /end MEASUREMENT
/begin COMPU_METHOD Compu_UEGO2_Tsensor " " RAT_FUNC "%.1" "deg C" COEFFS 0 4 0 0 0 1 /end COMPU_METHOD
/begin MEASUREMENT UEGO2_Vheater_DC "UEGO2 heater duty-cycle" UWORD Compu_UEGO2_Vheater_DC 0 0 0 99.9984741210938 ECU_ADDRESS 0x010081D0 /end MEASUREMENT
/begin COMPU_METHOD Compu_UEGO2_Vheater_DC " " RAT_FUNC "%.1" "%" COEFFS 0 655.36 0 0 0 1 /end COMPU_METHOD
/begin MEASUREMENT UEGO2_Vheater_int "UEGO2 heater integral" SLONG Compu_UEGO2_Vheater_int 0 0 -2048 2047.99999904633 ECU_ADDRESS 0x010081F8 /end MEASUREMENT
/begin COMPU_METHOD Compu_UEGO2_Vheater_int " " RAT_FUNC "%.1" "volts" COEFFS 0 1048576 0 0 0 1 /end COMPU_METHOD
/begin MEASUREMENT UEGO2_SR_Vofst "UEGO2 ASIC SR Vout offset" UWORD Compu_UEGO2_SR_Vofst 0 0 0 63.9990234375 ECU_ADDRESS 0x01008200 /end MEASUREMENT
/begin COMPU_METHOD Compu_UEGO2_SR_Vofst " " RAT_FUNC "%.3" "volts" COEFFS 0 1024 0 0 0 1 /end COMPU_METHOD
/begin MEASUREMENT UEGO2_PI_Vofst "UEGO2 ASIC PI Vout offset" UWORD Compu_UEGO2_PI_Vofst 0 0 0 63.9990234375 ECU_ADDRESS 0x01008208 /end MEASUREMENT
/begin COMPU_METHOD Compu_UEGO2_PI_Vofst " " RAT_FUNC "%.3" "volts" COEFFS 0 1024 0 0 0 1 /end COMPU_METHOD
/begin MEASUREMENT UEGO2_Vheater "UEGO2 heater voltage" SWORD Compu_UEGO2_Vheater 0 0 -32 31.9990234375 ECU_ADDRESS 0x01008210 /end MEASUREMENT
/begin COMPU_METHOD Compu_UEGO2_Vheater " " RAT_FUNC "%.1" "volts" COEFFS 0 1024 0 0 0 1 /end COMPU_METHOD
/begin MEASUREMENT EGO1H_FB_volts "EGO1 heater low-side feedback" UWORD Compu_EGO1H_FB_volts 0 0 0 255.99609375 ECU_ADDRESS 0x01008218 /end MEASUREMENT
/begin COMPU_METHOD Compu_EGO1H_FB_volts " " RAT_FUNC "%.1" "volts" COEFFS 0 256 0 0 0 1 /end COMPU_METHOD
/begin MEASUREMENT EGO2H_FB_volts "EGO2 heater low-side feedback" UWORD Compu_EGO2H_FB_volts 0 0 0 255.99609375 ECU_ADDRESS 0x01008220 /end MEASUREMENT
/begin COMPU_METHOD Compu_EGO2H_FB_volts " " RAT_FUNC "%.1" "volts" COEFFS 0 256 0 0 0 1 /end COMPU_METHOD
/begin MEASUREMENT EGO3H_FB_volts "EGO3 heater low-side feedback" UWORD Compu_EGO3H_FB_volts 0 0 0 255.99609375 ECU_ADDRESS 0x01008228 /end MEASUREMENT
/begin COMPU_METHOD Compu_EGO3H_FB_volts " " RAT_FUNC "%.1" "volts" COEFFS 0 256 0 0 0 1 /end COMPU_METHOD
/begin MEASUREMENT EGO4H_FB_volts "EGO4 heater low-side feedback" UWORD Compu_EGO4H_FB_volts 0 0 0 255.99609375 ECU_ADDRESS 0x01008230 /end MEASUREMENT
/begin COMPU_METHOD Compu_EGO4H_FB_volts " " RAT_FUNC "%.1" "volts" COEFFS 0 256 0 0 0 1 /end COMPU_METHOD
/begin CHARACTERISTIC UEGO_EBP_Klean "UEGO EBP PR mode Klean" VALUE 0x001CA36A /* @ECU_Address@UEGO_EBP_Klean@0x010086C8@ */ ECIPP_ALIGNMENT_UWORD 256 Compu_UEGO_EBP_Klean 0 255.99609375 /end CHARACTERISTIC
/begin COMPU_METHOD Compu_UEGO_EBP_Klean " " RAT_FUNC "%.2" "psi" COEFFS 0 256 0 0 0 1 /end COMPU_METHOD
/begin CHARACTERISTIC UEGO_EBP_Krich "UEGO EBP PR mode Krich" VALUE 0x001CA36C /* @ECU_Address@UEGO_EBP_Krich@0x010086D0@ */ ECIPP_ALIGNMENT_UWORD 256 Compu_UEGO_EBP_Krich 0 255.99609375 /end CHARACTERISTIC
/begin COMPU_METHOD Compu_UEGO_EBP_Krich " " RAT_FUNC "%.2" "psi" COEFFS 0 256 0 0 0 1 /end COMPU_METHOD
/begin CHARACTERISTIC UEGO_EBP_EBPo "UEGO EBP PR mode EBPs" VALUE 0x001CA368 /* @ECU_Address@UEGO_EBP_EBPo@0x010086D8@ */ ECIPP_ALIGNMENT_UWORD 256 Compu_UEGO_EBP_EBPo 0 255.99609375 /end CHARACTERISTIC
/begin COMPU_METHOD Compu_UEGO_EBP_EBPo " " RAT_FUNC "%.2" "psia" COEFFS 0 256 0 0 0 1 /end COMPU_METHOD
/begin MEASUREMENT UEGO_PI_Vout_inst "UEGO ASIC PI Vout raw" UWORD Compu_UEGO_PI_Vout_inst 0 0 0 63.9990234375 ECU_ADDRESS 0x010087D8 /end MEASUREMENT
/begin COMPU_METHOD Compu_UEGO_PI_Vout_inst " " RAT_FUNC "%.3" "volts" COEFFS 0 1024 0 0 0 1 /end COMPU_METHOD
/begin MEASUREMENT UEGO2_PI_Vout_inst "UEGO2 ASIC PI Vout raw" UWORD Compu_UEGO2_PI_Vout_inst 0 0 0 63.9990234375 ECU_ADDRESS 0x010087E8 /end MEASUREMENT
/begin COMPU_METHOD Compu_UEGO2_PI_Vout_inst " " RAT_FUNC "%.3" "volts" COEFFS 0 1024 0 0 0 1 /end COMPU_METHOD
/begin MEASUREMENT NOx1pre_NOx_conc "NOx concentration" UWORD Compu_NOx1pre_NOx_conc 0 0 0 4095.9375 ECU_ADDRESS 0x01008B40 /end MEASUREMENT
/begin COMPU_METHOD Compu_NOx1pre_NOx_conc " " RAT_FUNC "%.0" "ppm" COEFFS 0 16 0 0 0 1 /end COMPU_METHOD
/begin MEASUREMENT NOx1pst_NOx_conc "NOx concentration" UWORD Compu_NOx1pst_NOx_conc 0 0 0 4095.9375 ECU_ADDRESS 0x01008B48 /end MEASUREMENT
/begin COMPU_METHOD Compu_NOx1pst_NOx_conc " " RAT_FUNC "%.0" "ppm" COEFFS 0 16 0 0 0 1 /end COMPU_METHOD
/begin MEASUREMENT NOx1pre_O2_conc "O2 concentration" SWORD Compu_NOx1pre_O2_conc 0 0 -100 99.9969482421875 ECU_ADDRESS 0x01008B50 /end MEASUREMENT
/begin COMPU_METHOD Compu_NOx1pre_O2_conc " " RAT_FUNC "%.1" "%O2" COEFFS 0 327.68 0 0 0 1 /end COMPU_METHOD
/begin MEASUREMENT NOx1pst_O2_conc "O2 concentration" SWORD Compu_NOx1pst_O2_conc 0 0 -100 99.9969482421875 ECU_ADDRESS 0x01008B58 /end MEASUREMENT
/begin COMPU_METHOD Compu_NOx1pst_O2_conc " " RAT_FUNC "%.1" "%O2" COEFFS 0 327.68 0 0 0 1 /end COMPU_METHOD
/begin MEASUREMENT NOx1pre_O2_stable "O2 reading status{NOx1pre_O2_stable&0xc0=0x00:Not Stable}{NOx1pre_O2_stable&0xc0=0x40:Stable}{NOx1pre_O2_stable&0xc0=0x80:Error}{NOx1pre_O2_stable&0xc0=0xc0:Not Available}" UBYTE NOx1pre_O2_stable_COMPU_VTAB 0 0 0 255 ECU_ADDRESS 0x01008B60 BIT_MASK 0xc0 /end MEASUREMENT
/begin COMPU_METHOD NOx1pre_O2_stable_COMPU_VTAB "Verbal Table" TAB_VERB "%.0" "list" COMPU_TAB_REF NOx1pre_O2_stable_COMPU_VTAB_REF /end COMPU_METHOD
/begin COMPU_VTAB NOx1pre_O2_stable_COMPU_VTAB_REF "Verbal Table" TAB_VERB 4 0x00 "Not Stable" 0x40 "Stable" 0x80 "Error" 0xc0 "Not Available" DEFAULT_VALUE "UNKNOWN" /end COMPU_VTAB
/begin MEASUREMENT NOx1pst_O2_stable "O2 reading status{NOx1pst_O2_stable&0xc0=0x00:Not Stable}{NOx1pst_O2_stable&0xc0=0x40:Stable}{NOx1pst_O2_stable&0xc0=0x80:Error}{NOx1pst_O2_stable&0xc0=0xc0:Not Available}" UBYTE NOx1pst_O2_stable_COMPU_VTAB 0 0 0 255 ECU_ADDRESS 0x01008B68 BIT_MASK 0xc0 /end MEASUREMENT
/begin COMPU_METHOD NOx1pst_O2_stable_COMPU_VTAB "Verbal Table" TAB_VERB "%.0" "list" COMPU_TAB_REF NOx1pst_O2_stable_COMPU_VTAB_REF /end COMPU_METHOD
/begin COMPU_VTAB NOx1pst_O2_stable_COMPU_VTAB_REF "Verbal Table" TAB_VERB 4 0x00 "Not Stable" 0x40 "Stable" 0x80 "Error" 0xc0 "Not Available" DEFAULT_VALUE "UNKNOWN" /end COMPU_VTAB
/begin MEASUREMENT NOx1pre_NOx_stable "NOx reading status{NOx1pre_NOx_stable&0x30=0x00:Not Stable}{NOx1pre_NOx_stable&0x30=0x10:Stable}{NOx1pre_NOx_stable&0x30=0x20:Error}{NOx1pre_NOx_stable&0x30=0x30:Not Available}" UBYTE NOx1pre_NOx_stable_COMPU_VTAB 0 0 0 255 ECU_ADDRESS 0x01008B70 BIT_MASK 0x30 /end MEASUREMENT
/begin COMPU_METHOD NOx1pre_NOx_stable_COMPU_VTAB "Verbal Table" TAB_VERB "%.0" "list" COMPU_TAB_REF NOx1pre_NOx_stable_COMPU_VTAB_REF /end COMPU_METHOD
/begin COMPU_VTAB NOx1pre_NOx_stable_COMPU_VTAB_REF "Verbal Table" TAB_VERB 4 0x00 "Not Stable" 0x10 "Stable" 0x20 "Error" 0x30 "Not Available" DEFAULT_VALUE "UNKNOWN" /end COMPU_VTAB
/begin MEASUREMENT NOx1pst_NOx_stable "NOx reading status{NOx1pst_NOx_stable&0x30=0x00:Not Stable}{NOx1pst_NOx_stable&0x30=0x10:Stable}{NOx1pst_NOx_stable&0x30=0x20:Error}{NOx1pst_NOx_stable&0x30=0x30:Not Available}" UBYTE NOx1pst_NOx_stable_COMPU_VTAB 0 0 0 255 ECU_ADDRESS 0x01008B78 BIT_MASK 0x30 /end MEASUREMENT
/begin COMPU_METHOD NOx1pst_NOx_stable_COMPU_VTAB "Verbal Table" TAB_VERB "%.0" "list" COMPU_TAB_REF NOx1pst_NOx_stable_COMPU_VTAB_REF /end COMPU_METHOD
/begin COMPU_VTAB NOx1pst_NOx_stable_COMPU_VTAB_REF "Verbal Table" TAB_VERB 4 0x00 "Not Stable" 0x10 "Stable" 0x20 "Error" 0x30 "Not Available" DEFAULT_VALUE "UNKNOWN" /end COMPU_VTAB
/begin MEASUREMENT NOx1pre_Tsensor_stat "Sensor temperature{NOx1pre_Tsensor_stat&0x0c=0x00:Warming}{NOx1pre_Tsensor_stat&0x0c=0x04:Active}{NOx1pre_Tsensor_stat&0x0c=0x08:Error}{NOx1pre_Tsensor_stat&0x0c=0x0c:Not Available}" UBYTE NOx1pre_Tsensor_stat_COMPU_VTAB 0 0 0 255 ECU_ADDRESS 0x01008B80 BIT_MASK 0x0c /end MEASUREMENT
/begin COMPU_METHOD NOx1pre_Tsensor_stat_COMPU_VTAB "Verbal Table" TAB_VERB "%.0" "list" COMPU_TAB_REF NOx1pre_Tsensor_stat_COMPU_VTAB_REF /end COMPU_METHOD
/begin COMPU_VTAB NOx1pre_Tsensor_stat_COMPU_VTAB_REF "Verbal Table" TAB_VERB 4 0x00 "Warming" 0x04 "Active" 0x08 "Error" 0x0c "Not Available" DEFAULT_VALUE "UNKNOWN" /end COMPU_VTAB
/begin MEASUREMENT NOx1pst_Tsensor_stat "Sensor temperature{NOx1pst_Tsensor_stat&0x0c=0x00:Warming}{NOx1pst_Tsensor_stat&0x0c=0x04:Active}{NOx1pst_Tsensor_stat&0x0c=0x08:Error}{NOx1pst_Tsensor_stat&0x0c=0x0c:Not Available}" UBYTE NOx1pst_Tsensor_stat_COMPU_VTAB 0 0 0 255 ECU_ADDRESS 0x01008B88 BIT_MASK 0x0c /end MEASUREMENT
/begin COMPU_METHOD NOx1pst_Tsensor_stat_COMPU_VTAB "Verbal Table" TAB_VERB "%.0" "list" COMPU_TAB_REF NOx1pst_Tsensor_stat_COMPU_VTAB_REF /end COMPU_METHOD
/begin COMPU_VTAB NOx1pst_Tsensor_stat_COMPU_VTAB_REF "Verbal Table" TAB_VERB 4 0x00 "Warming" 0x04 "Active" 0x08 "Error" 0x0c "Not Available" DEFAULT_VALUE "UNKNOWN" /end COMPU_VTAB
/begin MEASUREMENT NOx1pre_Vsupply_stat "Supply voltage status{NOx1pre_Vsupply_stat&0x03=0x00:Out-of-range}{NOx1pre_Vsupply_stat&0x03=0x01:OK}{NOx1pre_Vsupply_stat&0x03=0x02:Error}{NOx1pre_Vsupply_stat&0x03=0x03:Not Available}" UBYTE NOx1pre_Vsupply_stat_COMPU_VTAB 0 0 0 255 ECU_ADDRESS 0x01008B90 BIT_MASK 0x03 /end MEASUREMENT
/begin COMPU_METHOD NOx1pre_Vsupply_stat_COMPU_VTAB "Verbal Table" TAB_VERB "%.0" "list" COMPU_TAB_REF NOx1pre_Vsupply_stat_COMPU_VTAB_REF /end COMPU_METHOD
/begin COMPU_VTAB NOx1pre_Vsupply_stat_COMPU_VTAB_REF "Verbal Table" TAB_VERB 4 0x00 "Out-of-range" 0x01 "OK" 0x02 "Error" 0x03 "Not Available" DEFAULT_VALUE "UNKNOWN" /end COMPU_VTAB
/begin MEASUREMENT NOx1pst_Vsupply_stat "Supply voltage status{NOx1pst_Vsupply_stat&0x03=0x00:Out-of-range}{NOx1pst_Vsupply_stat&0x03=0x01:OK}{NOx1pst_Vsupply_stat&0x03=0x02:Error}{NOx1pst_Vsupply_stat&0x03=0x03:Not Available}" UBYTE NOx1pst_Vsupply_stat_COMPU_VTAB 0 0 0 255 ECU_ADDRESS 0x01008B98 BIT_MASK 0x03 /end MEASUREMENT
/begin COMPU_METHOD NOx1pst_Vsupply_stat_COMPU_VTAB "Verbal Table" TAB_VERB "%.0" "list" COMPU_TAB_REF NOx1pst_Vsupply_stat_COMPU_VTAB_REF /end COMPU_METHOD
/begin COMPU_VTAB NOx1pst_Vsupply_stat_COMPU_VTAB_REF "Verbal Table" TAB_VERB 4 0x00 "Out-of-range" 0x01 "OK" 0x02 "Error" 0x03 "Not Available" DEFAULT_VALUE "UNKNOWN" /end COMPU_VTAB
/begin MEASUREMENT NOx1pre_heater_diag "Heater fault{NOx1pre_heater_diag&0x1f=0x03:Short Circuit}{NOx1pre_heater_diag&0x1f=0x05:Open Circuit}{NOx1pre_heater_diag&0x1f=0x1f:OK}" UBYTE NOx1pre_heater_diag_COMPU_VTAB 0 0 0 255 ECU_ADDRESS 0x01008BA0 BIT_MASK 0x1f /end MEASUREMENT
/begin COMPU_METHOD NOx1pre_heater_diag_COMPU_VTAB "Verbal Table" TAB_VERB "%.0" "list" COMPU_TAB_REF NOx1pre_heater_diag_COMPU_VTAB_REF /end COMPU_METHOD
/begin COMPU_VTAB NOx1pre_heater_diag_COMPU_VTAB_REF "Verbal Table" TAB_VERB 3 0x03 "Short Circuit" 0x05 "Open Circuit" 0x1f "OK" DEFAULT_VALUE "UNKNOWN" /end COMPU_VTAB
/begin MEASUREMENT NOx1pst_heater_diag "Heater fault{NOx1pst_heater_diag&0x1f=0x03:Short Circuit}{NOx1pst_heater_diag&0x1f=0x05:Open Circuit}{NOx1pst_heater_diag&0x1f=0x1f:OK}" UBYTE NOx1pst_heater_diag_COMPU_VTAB 0 0 0 255 ECU_ADDRESS 0x01008BA8 BIT_MASK 0x1f /end MEASUREMENT
/begin COMPU_METHOD NOx1pst_heater_diag_COMPU_VTAB "Verbal Table" TAB_VERB "%.0" "list" COMPU_TAB_REF NOx1pst_heater_diag_COMPU_VTAB_REF /end COMPU_METHOD
/begin COMPU_VTAB NOx1pst_heater_diag_COMPU_VTAB_REF "Verbal Table" TAB_VERB 3 0x03 "Short Circuit" 0x05 "Open Circuit" 0x1f "OK" DEFAULT_VALUE "UNKNOWN" /end COMPU_VTAB
/begin MEASUREMENT NOx1pre_heater_mode "Heater mode{NOx1pre_heater_mode&0x60=0x00:Automatic}{NOx1pre_heater_mode&0x60=0x20:Preheat 2}{NOx1pre_heater_mode&0x60=0x40:Preheat 1}{NOx1pre_heater_mode&0x60=0x60:Heater Off}" UBYTE NOx1pre_heater_mode_COMPU_VTAB 0 0 0 255 ECU_ADDRESS 0x01008BB0 BIT_MASK 0x60 /end MEASUREMENT
/begin COMPU_METHOD NOx1pre_heater_mode_COMPU_VTAB "Verbal Table" TAB_VERB "%.0" "list" COMPU_TAB_REF NOx1pre_heater_mode_COMPU_VTAB_REF /end COMPU_METHOD
/begin COMPU_VTAB NOx1pre_heater_mode_COMPU_VTAB_REF "Verbal Table" TAB_VERB 4 0x00 "Automatic" 0x20 "Preheat 2" 0x40 "Preheat 1" 0x60 "Heater Off" DEFAULT_VALUE "UNKNOWN" /end COMPU_VTAB
/begin MEASUREMENT NOx1pst_heater_mode "Heater mode{NOx1pst_heater_mode&0x60=0x00:Automatic}{NOx1pst_heater_mode&0x60=0x20:Preheat 2}{NOx1pst_heater_mode&0x60=0x40:Preheat 1}{NOx1pst_heater_mode&0x60=0x60:Heater Off}" UBYTE NOx1pst_heater_mode_COMPU_VTAB 0 0 0 255 ECU_ADDRESS 0x01008BB8 BIT_MASK 0x60 /end MEASUREMENT
/begin COMPU_METHOD NOx1pst_heater_mode_COMPU_VTAB "Verbal Table" TAB_VERB "%.0" "list" COMPU_TAB_REF NOx1pst_heater_mode_COMPU_VTAB_REF /end COMPU_METHOD
/begin COMPU_VTAB NOx1pst_heater_mode_COMPU_VTAB_REF "Verbal Table" TAB_VERB 4 0x00 "Automatic" 0x20 "Preheat 2" 0x40 "Preheat 1" 0x60 "Heater Off" DEFAULT_VALUE "UNKNOWN" /end COMPU_VTAB
/begin MEASUREMENT NOx1pre_NOx_diag "NOx signal fault{NOx1pre_NOx_diag&0x1f=0x03:Short Circuit}{NOx1pre_NOx_diag&0x1f=0x05:Open Circuit}{NOx1pre_NOx_diag&0x1f=0x1f:OK}" UBYTE NOx1pre_NOx_diag_COMPU_VTAB 0 0 0 255 ECU_ADDRESS 0x01008BC0 BIT_MASK 0x1f /end MEASUREMENT
/begin COMPU_METHOD NOx1pre_NOx_diag_COMPU_VTAB "Verbal Table" TAB_VERB "%.0" "list" COMPU_TAB_REF NOx1pre_NOx_diag_COMPU_VTAB_REF /end COMPU_METHOD
/begin COMPU_VTAB NOx1pre_NOx_diag_COMPU_VTAB_REF "Verbal Table" TAB_VERB 3 0x03 "Short Circuit" 0x05 "Open Circuit" 0x1f "OK" DEFAULT_VALUE "UNKNOWN" /end COMPU_VTAB
/begin MEASUREMENT NOx1pst_NOx_diag "NOx signal fault{NOx1pst_NOx_diag&0x1f=0x03:Short Circuit}{NOx1pst_NOx_diag&0x1f=0x05:Open Circuit}{NOx1pst_NOx_diag&0x1f=0x1f:OK}" UBYTE NOx1pst_NOx_diag_COMPU_VTAB 0 0 0 255 ECU_ADDRESS 0x01008BC8 BIT_MASK 0x1f /end MEASUREMENT
/begin COMPU_METHOD NOx1pst_NOx_diag_COMPU_VTAB "Verbal Table" TAB_VERB "%.0" "list" COMPU_TAB_REF NOx1pst_NOx_diag_COMPU_VTAB_REF /end COMPU_METHOD
/begin COMPU_VTAB NOx1pst_NOx_diag_COMPU_VTAB_REF "Verbal Table" TAB_VERB 3 0x03 "Short Circuit" 0x05 "Open Circuit" 0x1f "OK" DEFAULT_VALUE "UNKNOWN" /end COMPU_VTAB
/begin MEASUREMENT NOx1pst_O2_diag "O2 signal fault{NOx1pst_O2_diag&0x1f=0x03:Short Circuit}{NOx1pst_O2_diag&0x1f=0x05:Open Circuit}{NOx1pst_O2_diag&0x1f=0x1f:OK}" UBYTE NOx1pst_O2_diag_COMPU_VTAB 0 0 0 255 ECU_ADDRESS 0x01008BD0 BIT_MASK 0x1f /end MEASUREMENT
/begin COMPU_METHOD NOx1pst_O2_diag_COMPU_VTAB "Verbal Table" TAB_VERB "%.0" "list" COMPU_TAB_REF NOx1pst_O2_diag_COMPU_VTAB_REF /end COMPU_METHOD
/begin COMPU_VTAB NOx1pst_O2_diag_COMPU_VTAB_REF "Verbal Table" TAB_VERB 3 0x03 "Short Circuit" 0x05 "Open Circuit" 0x1f "OK" DEFAULT_VALUE "UNKNOWN" /end COMPU_VTAB
/begin MEASUREMENT NOx1pre_O2_diag "O2 signal fault{NOx1pre_O2_diag&0x1f=0x03:Short Circuit}{NOx1pre_O2_diag&0x1f=0x05:Open Circuit}{NOx1pre_O2_diag&0x1f=0x1f:OK}" UBYTE NOx1pre_O2_diag_COMPU_VTAB 0 0 0 255 ECU_ADDRESS 0x01008BD8 BIT_MASK 0x1f /end MEASUREMENT
/begin COMPU_METHOD NOx1pre_O2_diag_COMPU_VTAB "Verbal Table" TAB_VERB "%.0" "list" COMPU_TAB_REF NOx1pre_O2_diag_COMPU_VTAB_REF /end COMPU_METHOD
/begin COMPU_VTAB NOx1pre_O2_diag_COMPU_VTAB_REF "Verbal Table" TAB_VERB 3 0x03 "Short Circuit" 0x05 "Open Circuit" 0x1f "OK" DEFAULT_VALUE "UNKNOWN" /end COMPU_VTAB
/begin CHARACTERISTIC UEGO_drift_learn "UEGO drift compensation{UEGO_drift_learn&0xff=0:EGR UEGOs Only}{UEGO_drift_learn&0xff=1:Pre/Post/EGR UEGOs}" VALUE 0x001c8f78 /* @ECU_Address@UEGO_drift_learn@0x0100B168@ */ ECIPP_ALIGNMENT_UBYTE 255 UEGO_drift_learn_COMPU_VTAB 0 255 BIT_MASK 0xff /end CHARACTERISTIC
/begin COMPU_METHOD UEGO_drift_learn_COMPU_VTAB "Verbal Table" TAB_VERB "%.0" "list" COMPU_TAB_REF UEGO_drift_learn_COMPU_VTAB_REF /end COMPU_METHOD
/begin COMPU_VTAB UEGO_drift_learn_COMPU_VTAB_REF "Verbal Table" TAB_VERB 2 0 "EGR UEGOs Only" 1 "Pre/Post/EGR UEGOs" DEFAULT_VALUE "UNKNOWN" /end COMPU_VTAB
/begin CHARACTERISTIC UEGO_drift_stable_wt "UEGO pre-sampling FSO TPS open wait" VALUE 0x001CA2C2 /* @ECU_Address@UEGO_drift_stable_wt@0x0100B170@ */ ECIPP_ALIGNMENT_UWORD 65535 Compu_UEGO_drift_stable_wt 0 65535 /end CHARACTERISTIC
/begin COMPU_METHOD Compu_UEGO_drift_stable_wt " " RAT_FUNC "%.0" "ms" COEFFS 0 1 0 0 0 1 /end COMPU_METHOD
/begin CHARACTERISTIC UEGO_drift_Tdelays "UEGO pre-sampling transport delay wait" VALUE 0x001c82e2 /* @ECU_Address@UEGO_drift_Tdelays@0x0100B178@ */ ECIPP_ALIGNMENT_UWORD 256 Compu_UEGO_drift_Tdelays 0 255.99609375 /end CHARACTERISTIC
/begin COMPU_METHOD Compu_UEGO_drift_Tdelays " " RAT_FUNC "%.1" "Tdelays" COEFFS 0 256 0 0 0 1 /end COMPU_METHOD
/begin CHARACTERISTIC UEGO_drift_sample_ms "UEGO sampling interval" VALUE 0x001CA2C4 /* @ECU_Address@UEGO_drift_sample_ms@0x0100B180@ */ ECIPP_ALIGNMENT_UWORD 65535 Compu_UEGO_drift_sample_ms 0 65535 /end CHARACTERISTIC
/begin COMPU_METHOD Compu_UEGO_drift_sample_ms " " RAT_FUNC "%.0" "ms" COEFFS 0 1 0 0 0 1 /end COMPU_METHOD
/begin CHARACTERISTIC UEGO_drift_Terr_max "UEGO sampling max CL heater error" VALUE 0x001CA2C8 /* @ECU_Address@UEGO_drift_Terr_max@0x0100B188@ */ ECIPP_ALIGNMENT_SWORD 8192 Compu_UEGO_drift_Terr_max -8192 8191.75 /end CHARACTERISTIC
/begin COMPU_METHOD Compu_UEGO_drift_Terr_max " " RAT_FUNC "%.1" "deg C" COEFFS 0 4 0 0 0 1 /end COMPU_METHOD
/begin CHARACTERISTIC UEGO_drift_Ip_tol "UEGO sampling max Ip deviation" VALUE 0x001CA2C6 /* @ECU_Address@UEGO_drift_Ip_tol@0x0100B190@ */ ECIPP_ALIGNMENT_UWORD 100 Compu_UEGO_drift_Ip_tol 0 99.9984741210938 /end CHARACTERISTIC
/begin COMPU_METHOD Compu_UEGO_drift_Ip_tol " " RAT_FUNC "%.2" "% from mean" COEFFS 0 655.36 0 0 0 1 /end COMPU_METHOD
/begin CHARACTERISTIC UEGO_drift_min_flow "UEGO sampling min air flow" VALUE 0x001c3de8 /* @ECU_Address@UEGO_drift_min_flow@0x0100B198@ */ ECIPP_ALIGNMENT_FLOAT32_IEEE 10000000000 Compu_UEGO_drift_min_flow -10000000000 10000000000 /end CHARACTERISTIC
/begin COMPU_METHOD Compu_UEGO_drift_min_flow " " RAT_FUNC "%.0" "cfm" COEFFS 0 1 0 0 0 1 /end COMPU_METHOD
/begin MEASUREMENT UEGO1_drift_state "UEGO drift state{UEGO1_drift_state&0xff=0:Disabled}{UEGO1_drift_state&0xff=1:UEGO run wait}{UEGO1_drift_state&0xff=2:ECT low}{UEGO1_drift_state&0xff=3:FT low}{UEGO1_drift_state&0xff=4:Exhaust braking}{UEGO1_drift_state&0xff=5:Recovery wait}{UEGO1_drift_st" UBYTE UEGO1_drift_state_COMPU_VTAB 0 0 0 255 ECU_ADDRESS 0x0100B1B0 BIT_MASK 0xff /end MEASUREMENT
/begin COMPU_METHOD UEGO1_drift_state_COMPU_VTAB "Verbal Table" TAB_VERB "%.0" "list" COMPU_TAB_REF UEGO1_drift_state_COMPU_VTAB_REF /end COMPU_METHOD
/begin COMPU_VTAB UEGO1_drift_state_COMPU_VTAB_REF "Verbal Table" TAB_VERB 17 0 "Disabled" 1 "UEGO run wait" 2 "ECT low" 3 "FT low" 4 "Exhaust braking" 5 "Recovery wait" 6 "Env. sensor fault" 7 "7 - Reserved" 8 "8 - Reserved" 9 "9 - Reserved" 10 "Idle" 11 "Stabilizing" 12 "Trans delay wait" 13 "Initializing samples" 14 "Sampling" 15 "Validating" 16 "Success" DEFAULT_VALUE "UNKNOWN" /end COMPU_VTAB
/begin MEASUREMENT UEGO2_drift_state "UEGO drift state{UEGO2_drift_state&0xff=0:Disabled}{UEGO2_drift_state&0xff=1:UEGO run wait}{UEGO2_drift_state&0xff=2:ECT low}{UEGO2_drift_state&0xff=3:FT low}{UEGO2_drift_state&0xff=4:Exhaust braking}{UEGO2_drift_state&0xff=5:Recovery wait}{UEGO2_drift_st" UBYTE UEGO2_drift_state_COMPU_VTAB 0 0 0 255 ECU_ADDRESS 0x0100B1B8 BIT_MASK 0xff /end MEASUREMENT
/begin COMPU_METHOD UEGO2_drift_state_COMPU_VTAB "Verbal Table" TAB_VERB "%.0" "list" COMPU_TAB_REF UEGO2_drift_state_COMPU_VTAB_REF /end COMPU_METHOD
/begin COMPU_VTAB UEGO2_drift_state_COMPU_VTAB_REF "Verbal Table" TAB_VERB 17 0 "Disabled" 1 "UEGO run wait" 2 "ECT low" 3 "FT low" 4 "Exhaust braking" 5 "Recovery wait" 6 "Env. sensor fault" 7 "7 - Reserved" 8 "8 - Reserved" 9 "9 - Reserved" 10 "Idle" 11 "Stabilizing" 12 "Trans delay wait" 13 "Initializing samples" 14 "Sampling" 15 "Validating" 16 "Success" DEFAULT_VALUE "UNKNOWN" /end COMPU_VTAB
/begin MEASUREMENT UEGO1_drift_PI_dmean "UEGO drift Ip deviation" UWORD Compu_UEGO1_drift_PI_dmean 0 0 0 99.9984741210938 ECU_ADDRESS 0x0100B1C0 /end MEASUREMENT
/begin COMPU_METHOD Compu_UEGO1_drift_PI_dmean " " RAT_FUNC "%.2" "%" COEFFS 0 655.36 0 0 0 1 /end COMPU_METHOD
/begin MEASUREMENT UEGO2_drift_PI_dmean "UEGO drift Ip deviation" UWORD Compu_UEGO2_drift_PI_dmean 0 0 0 99.9984741210938 ECU_ADDRESS 0x0100B1C8 /end MEASUREMENT
/begin COMPU_METHOD Compu_UEGO2_drift_PI_dmean " " RAT_FUNC "%.2" "%" COEFFS 0 655.36 0 0 0 1 /end COMPU_METHOD
/begin MEASUREMENT UEGO1_drift_Terror "UEGO drift CL heater error" SWORD Compu_UEGO1_drift_Terror 0 0 -8192 8191.75 ECU_ADDRESS 0x0100B1D0 /end MEASUREMENT
/begin COMPU_METHOD Compu_UEGO1_drift_Terror " " RAT_FUNC "%.1" "deg C" COEFFS 0 4 0 0 0 1 /end COMPU_METHOD
/begin MEASUREMENT UEGO2_drift_Terror "UEGO drift CL heater error" SWORD Compu_UEGO2_drift_Terror 0 0 -8192 8191.75 ECU_ADDRESS 0x0100B1D8 /end MEASUREMENT
/begin COMPU_METHOD Compu_UEGO2_drift_Terror " " RAT_FUNC "%.1" "deg C" COEFFS 0 4 0 0 0 1 /end COMPU_METHOD
/begin MEASUREMENT UEGO1_drift_air_err "UEGO drift air sample error" SWORD Compu_UEGO1_drift_air_err 0 0 -100 99.9969482421875 ECU_ADDRESS 0x0100B1E0 /end MEASUREMENT
/begin COMPU_METHOD Compu_UEGO1_drift_air_err " " RAT_FUNC "%.2" "%" COEFFS 0 327.68 0 0 0 1 /end COMPU_METHOD
/begin MEASUREMENT UEGO2_drift_air_err "UEGO drift air sample error" SWORD Compu_UEGO2_drift_air_err 0 0 -100 99.9969482421875 ECU_ADDRESS 0x0100B1E8 /end MEASUREMENT
/begin COMPU_METHOD Compu_UEGO2_drift_air_err " " RAT_FUNC "%.2" "%" COEFFS 0 327.68 0 0 0 1 /end COMPU_METHOD
/begin CHARACTERISTIC UEGO_drift_gain_hr "UEGO new sample time-based gain" VALUE 0x001CA2CA /* @ECU_Address@UEGO_drift_gain_hr@0x0100B1F8@ */ ECIPP_ALIGNMENT_UWORD 6400 Compu_UEGO_drift_gain_hr 0 6399.90234375 /end CHARACTERISTIC
/begin COMPU_METHOD Compu_UEGO_drift_gain_hr " " RAT_FUNC "%.1" "%/hr" COEFFS 0 10.24 0 0 0 1 /end COMPU_METHOD
/begin CHARACTERISTIC UEGO_drift_gain_max "UEGO new sample maximum gain" VALUE 0x001CA2CE /* @ECU_Address@UEGO_drift_gain_max@0x0100B200@ */ ECIPP_ALIGNMENT_SWORD 100 Compu_UEGO_drift_gain_max -100 99.9969482421875 /end CHARACTERISTIC
/begin COMPU_METHOD Compu_UEGO_drift_gain_max " " RAT_FUNC "%.1" "%" COEFFS 0 327.68 0 0 0 1 /end COMPU_METHOD
/begin CHARACTERISTIC UEGO_drift_crct_min "UEGO min Ip error to correct" VALUE 0x001CA2D0 /* @ECU_Address@UEGO_drift_crct_min@0x0100B208@ */ ECIPP_ALIGNMENT_SWORD 100 Compu_UEGO_drift_crct_min -100 99.9969482421875 /end CHARACTERISTIC
/begin COMPU_METHOD Compu_UEGO_drift_crct_min " " RAT_FUNC "%.1" "% Ip" COEFFS 0 327.68 0 0 0 1 /end COMPU_METHOD
/begin CHARACTERISTIC UEGO_drift_crct_max "UEGO max Ip error to correct" VALUE 0x001CA2D2 /* @ECU_Address@UEGO_drift_crct_max@0x0100B210@ */ ECIPP_ALIGNMENT_SWORD 100 Compu_UEGO_drift_crct_max -100 99.9969482421875 /end CHARACTERISTIC
/begin COMPU_METHOD Compu_UEGO_drift_crct_max " " RAT_FUNC "%.1" "% Ip" COEFFS 0 327.68 0 0 0 1 /end COMPU_METHOD
/begin CHARACTERISTIC UEGO_drift_ECT_min "UEGO drift compensation minimum ECT" VALUE 0x001c82de /* @ECU_Address@UEGO_drift_ECT_min@0x0100B218@ */ ECIPP_ALIGNMENT_UWORD 564 Compu_UEGO_drift_ECT_min -460 563.984375 /end CHARACTERISTIC
/begin COMPU_METHOD Compu_UEGO_drift_ECT_min " " RAT_FUNC "%.1" "deg F" COEFFS 0 64 29440 0 0 1 /end COMPU_METHOD
/begin CHARACTERISTIC UEGO_drift_FT_min "UEGO drift compensation minimum FT" VALUE 0x001c82e0 /* @ECU_Address@UEGO_drift_FT_min@0x0100B220@ */ ECIPP_ALIGNMENT_UWORD 564 Compu_UEGO_drift_FT_min -460 563.984375 /end CHARACTERISTIC
/begin COMPU_METHOD Compu_UEGO_drift_FT_min " " RAT_FUNC "%.1" "deg F" COEFFS 0 64 29440 0 0 1 /end COMPU_METHOD
/begin CHARACTERISTIC UEGO_drift_inject_t "UEGO drift compensation FSO injection" VALUE 0x001CA2C0 /* @ECU_Address@UEGO_drift_inject_t@0x0100B228@ */ ECIPP_ALIGNMENT_UWORD 1092 Compu_UEGO_drift_inject_t 0 1092.25 /end CHARACTERISTIC
/begin COMPU_METHOD Compu_UEGO_drift_inject_t " " RAT_FUNC "%.1" "hours" COEFFS 0 60 0 0 0 1 /end COMPU_METHOD
/begin MEASUREMENT UEGO_manual_action "UEGO manual action{UEGO_manual_action&0xff=0:Inactive}{UEGO_manual_action&0xff=1:UEGO1 new reset}{UEGO_manual_action&0xff=2:UEGO2 new reset}{UEGO_manual_action&0xff=3:Trigger drift comp}{UEGO_manual_action&0xff=4:Schedule recovery}{UEGO_manual_action&0xff" UBYTE UEGO_manual_action_COMPU_VTAB 0 0 0 255 ECU_ADDRESS 0x0100B260 BIT_MASK 0xff /end MEASUREMENT
/begin COMPU_METHOD UEGO_manual_action_COMPU_VTAB "Verbal Table" TAB_VERB "%.0" "list" COMPU_TAB_REF UEGO_manual_action_COMPU_VTAB_REF /end COMPU_METHOD
/begin COMPU_VTAB UEGO_manual_action_COMPU_VTAB_REF "Verbal Table" TAB_VERB 8 0 "Inactive" 1 "UEGO1 new reset" 2 "UEGO2 new reset" 3 "Trigger drift comp" 4 "Schedule recovery" 5 "Trigger drift test" 6 "UEGO3 new reset" 7 "UEGO4 new reset" DEFAULT_VALUE "UNKNOWN" /end COMPU_VTAB
/begin MEASUREMENT UEGO_manual_key "UEGO manual action key" UWORD Compu_UEGO_manual_key 0 0 0 65535 ECU_ADDRESS 0x0100B268 /end MEASUREMENT
/begin COMPU_METHOD Compu_UEGO_manual_key " " RAT_FUNC "%.0" "27030" COEFFS 0 1 0 0 0 1 /end COMPU_METHOD
/begin CHARACTERISTIC UEGO_recvr_mode "UEGO recovery mode{UEGO_recvr_mode&0xff=0:Disabled}{UEGO_recvr_mode&0xff=1:Time Triggered - fixed T}{UEGO_recvr_mode&0xff=2:Time + Drift Triggered - fixed T}{UEGO_recvr_mode&0xff=3:Time + Drift Triggered - table T}{UEGO_recvr_mode&0xff=4:Time Triggered - " VALUE 0x001c8f7a /* @ECU_Address@UEGO_recvr_mode@0x0100B270@ */ ECIPP_ALIGNMENT_UBYTE 255 UEGO_recvr_mode_COMPU_VTAB 0 255 BIT_MASK 0xff /end CHARACTERISTIC
/begin COMPU_METHOD UEGO_recvr_mode_COMPU_VTAB "Verbal Table" TAB_VERB "%.0" "list" COMPU_TAB_REF UEGO_recvr_mode_COMPU_VTAB_REF /end COMPU_METHOD
/begin COMPU_VTAB UEGO_recvr_mode_COMPU_VTAB_REF "Verbal Table" TAB_VERB 5 0 "Disabled" 1 "Time Triggered - fixed T" 2 "Time + Drift Triggered - fixed T" 3 "Time + Drift Triggered - table T" 4 "Time Triggered - table T" DEFAULT_VALUE "UNKNOWN" /end COMPU_VTAB
/begin CHARACTERISTIC UEGO_recvr_T "UEGO recovery T target" VALUE 0x001c6bea /* @ECU_Address@UEGO_recvr_T@0x0100B278@ */ ECIPP_ALIGNMENT_SWORD 8192 Compu_UEGO_recvr_T -8192 8191.75 /end CHARACTERISTIC
/begin COMPU_METHOD Compu_UEGO_recvr_T " " RAT_FUNC "%.1" "deg C" COEFFS 0 4 0 0 0 1 /end COMPU_METHOD
/begin CHARACTERISTIC UEGO_recvr_Tramp "UEGO recovery T ramp rate" VALUE 0x001c82f0 /* @ECU_Address@UEGO_recvr_Tramp@0x0100B280@ */ ECIPP_ALIGNMENT_UWORD 250 Compu_UEGO_recvr_Tramp 0 249.996185302734 /end CHARACTERISTIC
/begin COMPU_METHOD Compu_UEGO_recvr_Tramp " " RAT_FUNC "%.1" "deg C / sec" COEFFS 0 262.144 0 0 0 1 /end COMPU_METHOD
/begin CHARACTERISTIC UEGO_recvr_interval "UEGO recovery interval" VALUE 0x001c82f4 /* @ECU_Address@UEGO_recvr_interval@0x0100B288@ */ ECIPP_ALIGNMENT_UWORD 1092 Compu_UEGO_recvr_interval 0 1092.25 /end CHARACTERISTIC
/begin COMPU_METHOD Compu_UEGO_recvr_interval " " RAT_FUNC "%.1" "hours" COEFFS 0 60 0 0 0 1 /end COMPU_METHOD
/begin CHARACTERISTIC UEGO_recvr_duration "UEGO recovery duration" VALUE 0x001c82f2 /* @ECU_Address@UEGO_recvr_duration@0x0100B290@ */ ECIPP_ALIGNMENT_UWORD 1092 Compu_UEGO_recvr_duration 0 1092.25 /end CHARACTERISTIC
/begin COMPU_METHOD Compu_UEGO_recvr_duration " " RAT_FUNC "%.1" "min" COEFFS 0 60 0 0 0 1 /end COMPU_METHOD
/begin MEASUREMENT UEGO1_Ttarget "UEGO CL target T" SWORD Compu_UEGO1_Ttarget 0 0 -8192 8191.75 ECU_ADDRESS 0x0100B298 /end MEASUREMENT
/begin COMPU_METHOD Compu_UEGO1_Ttarget " " RAT_FUNC "%.1" "deg C" COEFFS 0 4 0 0 0 1 /end COMPU_METHOD
/begin MEASUREMENT UEGO2_Ttarget "UEGO CL target T" SWORD Compu_UEGO2_Ttarget 0 0 -8192 8191.75 ECU_ADDRESS 0x0100B2A0 /end MEASUREMENT
/begin COMPU_METHOD Compu_UEGO2_Ttarget " " RAT_FUNC "%.1" "deg C" COEFFS 0 4 0 0 0 1 /end COMPU_METHOD
/begin MEASUREMENT UEGO1_recvr_secleft "UEGO recovery time remaining" UWORD Compu_UEGO1_recvr_secleft 0 0 0 1092.25 ECU_ADDRESS 0x0100B2B8 /end MEASUREMENT
/begin COMPU_METHOD Compu_UEGO1_recvr_secleft " " RAT_FUNC "%.1" "min" COEFFS 0 60 0 0 0 1 /end COMPU_METHOD
/begin MEASUREMENT UEGO2_recvr_secleft "UEGO recovery time remaining" UWORD Compu_UEGO2_recvr_secleft 0 0 0 1092.25 ECU_ADDRESS 0x0100B2C0 /end MEASUREMENT
/begin COMPU_METHOD Compu_UEGO2_recvr_secleft " " RAT_FUNC "%.1" "min" COEFFS 0 60 0 0 0 1 /end COMPU_METHOD
/begin CHARACTERISTIC UEGO_drift_leakage "UEGO sampling assumed fuel leakage" VALUE 0x001c3de4 /* @ECU_Address@UEGO_drift_leakage@0x0100B2C8@ */ ECIPP_ALIGNMENT_FLOAT32_IEEE 10000000000 Compu_UEGO_drift_leakage -10000000000 10000000000 /end CHARACTERISTIC
/begin COMPU_METHOD Compu_UEGO_drift_leakage " " RAT_FUNC "%.2" "cfm" COEFFS 0 1 0 0 0 1 /end COMPU_METHOD
/begin MEASUREMENT UEGO1_drift_error "UEGO drift final error" SWORD Compu_UEGO1_drift_error 0 0 -100 99.9969482421875 ECU_ADDRESS 0x0100B2D0 /end MEASUREMENT
/begin COMPU_METHOD Compu_UEGO1_drift_error " " RAT_FUNC "%.2" "% Ip" COEFFS 0 327.68 0 0 0 1 /end COMPU_METHOD
/begin MEASUREMENT UEGO2_drift_error "UEGO drift final error" SWORD Compu_UEGO2_drift_error 0 0 -100 99.9969482421875 ECU_ADDRESS 0x0100B2D8 /end MEASUREMENT
/begin COMPU_METHOD Compu_UEGO2_drift_error " " RAT_FUNC "%.2" "% Ip" COEFFS 0 327.68 0 0 0 1 /end COMPU_METHOD
/begin MEASUREMENT UEGO1_drift_leak_err "UEGO drift sample leak" SWORD Compu_UEGO1_drift_leak_err 0 0 -100 99.9969482421875 ECU_ADDRESS 0x0100B418 /end MEASUREMENT
/begin COMPU_METHOD Compu_UEGO1_drift_leak_err " " RAT_FUNC "%.2" "% Ip" COEFFS 0 327.68 0 0 0 1 /end COMPU_METHOD
/begin MEASUREMENT UEGO2_drift_leak_err "UEGO drift sample leak" SWORD Compu_UEGO2_drift_leak_err 0 0 -100 99.9969482421875 ECU_ADDRESS 0x0100B420 /end MEASUREMENT
/begin COMPU_METHOD Compu_UEGO2_drift_leak_err " " RAT_FUNC "%.2" "% Ip" COEFFS 0 327.68 0 0 0 1 /end COMPU_METHOD
/begin MEASUREMENT UEGO1_recvr_error "UEGO recovery induced error" SWORD Compu_UEGO1_recvr_error 0 0 -100 99.9969482421875 ECU_ADDRESS 0x0100B428 /end MEASUREMENT
/begin COMPU_METHOD Compu_UEGO1_recvr_error " " RAT_FUNC "%.2" "% Ip" COEFFS 0 327.68 0 0 0 1 /end COMPU_METHOD
/begin MEASUREMENT UEGO2_recvr_error "UEGO recovery induced error" SWORD Compu_UEGO2_recvr_error 0 0 -100 99.9969482421875 ECU_ADDRESS 0x0100B430 /end MEASUREMENT
/begin COMPU_METHOD Compu_UEGO2_recvr_error " " RAT_FUNC "%.2" "% Ip" COEFFS 0 327.68 0 0 0 1 /end COMPU_METHOD
/begin CHARACTERISTIC UEGO_drift_holdoff "UEGO drift comp hold off" VALUE 0x001c82e4 /* @ECU_Address@UEGO_drift_holdoff@0x0100B438@ */ ECIPP_ALIGNMENT_UWORD 65535 Compu_UEGO_drift_holdoff 0 65535 /end CHARACTERISTIC
/begin COMPU_METHOD Compu_UEGO_drift_holdoff " " RAT_FUNC "%.0" "ms" COEFFS 0 1 0 0 0 1 /end COMPU_METHOD
/begin CHARACTERISTIC UEGO_recvr_FPPFSO_wt "UEGO recovery active FPP FSO delay" VALUE 0x001c82ea /* @ECU_Address@UEGO_recvr_FPPFSO_wt@0x0100B920@ */ ECIPP_ALIGNMENT_UWORD 65535 Compu_UEGO_recvr_FPPFSO_wt 0 65535 /end CHARACTERISTIC
/begin COMPU_METHOD Compu_UEGO_recvr_FPPFSO_wt " " RAT_FUNC "%.0" "ms" COEFFS 0 1 0 0 0 1 /end COMPU_METHOD
/begin CHARACTERISTIC UEGO_recvr_MAPFSO_wt "UEGO recovery active MAP FSO delay" VALUE 0x001c82ee /* @ECU_Address@UEGO_recvr_MAPFSO_wt@0x0100B928@ */ ECIPP_ALIGNMENT_UWORD 65535 Compu_UEGO_recvr_MAPFSO_wt 0 65535 /end CHARACTERISTIC
/begin COMPU_METHOD Compu_UEGO_recvr_MAPFSO_wt " " RAT_FUNC "%.0" "ms" COEFFS 0 1 0 0 0 1 /end COMPU_METHOD
/begin CHARACTERISTIC UEGO_sensor_slct "UEGO1 sensor type{UEGO_sensor_slct&0xff=0:Default}{UEGO_sensor_slct&0xff=1:Bosch LSU 4.9}{UEGO_sensor_slct&0xff=2:NTK 6312}{UEGO_sensor_slct&0xff=3:NTK ZFAS-U2 Exh}{UEGO_sensor_slct&0xff=4:NTK ZFAS-U2 Int}" VALUE 0x001C8F7F /* @ECU_Address@UEGO_sensor_slct@0x0100BEA8@ */ ECIPP_ALIGNMENT_UBYTE 255 UEGO_sensor_slct_COMPU_VTAB 0 255 BIT_MASK 0xff /end CHARACTERISTIC
/begin COMPU_METHOD UEGO_sensor_slct_COMPU_VTAB "Verbal Table" TAB_VERB "%.0" "list" COMPU_TAB_REF UEGO_sensor_slct_COMPU_VTAB_REF /end COMPU_METHOD
/begin COMPU_VTAB UEGO_sensor_slct_COMPU_VTAB_REF "Verbal Table" TAB_VERB 5 0 "Default" 1 "Bosch LSU 4.9" 2 "NTK 6312" 3 "NTK ZFAS-U2 Exh" 4 "NTK ZFAS-U2 Int" DEFAULT_VALUE "UNKNOWN" /end COMPU_VTAB
/begin CHARACTERISTIC UEGO2_sensor_slct "UEGO2 sensor type{UEGO2_sensor_slct&0xff=0:Default}{UEGO2_sensor_slct&0xff=1:Bosch LSU 4.9}{UEGO2_sensor_slct&0xff=2:NTK 6312}{UEGO2_sensor_slct&0xff=3:NTK ZFAS-U2 Exh}{UEGO2_sensor_slct&0xff=4:NTK ZFAS-U2 Int}" VALUE 0x001C8F80 /* @ECU_Address@UEGO2_sensor_slct@0x0100BEB0@ */ ECIPP_ALIGNMENT_UBYTE 255 UEGO2_sensor_slct_COMPU_VTAB 0 255 BIT_MASK 0xff /end CHARACTERISTIC
/begin COMPU_METHOD UEGO2_sensor_slct_COMPU_VTAB "Verbal Table" TAB_VERB "%.0" "list" COMPU_TAB_REF UEGO2_sensor_slct_COMPU_VTAB_REF /end COMPU_METHOD
/begin COMPU_VTAB UEGO2_sensor_slct_COMPU_VTAB_REF "Verbal Table" TAB_VERB 5 0 "Default" 1 "Bosch LSU 4.9" 2 "NTK 6312" 3 "NTK ZFAS-U2 Exh" 4 "NTK ZFAS-U2 Int" DEFAULT_VALUE "UNKNOWN" /end COMPU_VTAB
/begin CHARACTERISTIC UEGON_Twarmup "UEGO warmup transition" VALUE 0x001CA370 /* @ECU_Address@UEGON_Twarmup@0x0100BEB8@ */ ECIPP_ALIGNMENT_SWORD 8192 Compu_UEGON_Twarmup -8192 8191.75 /end CHARACTERISTIC
/begin COMPU_METHOD Compu_UEGON_Twarmup " " RAT_FUNC "%.1" "deg C" COEFFS 0 4 0 0 0 1 /end COMPU_METHOD
/begin CHARACTERISTIC UEGON_TCLp_enable "UEGO closed-loop transition" VALUE 0x001CA372 /* @ECU_Address@UEGON_TCLp_enable@0x0100BEC0@ */ ECIPP_ALIGNMENT_SWORD 8192 Compu_UEGON_TCLp_enable -8192 8191.75 /end CHARACTERISTIC
/begin COMPU_METHOD Compu_UEGON_TCLp_enable " " RAT_FUNC "%.1" "deg C" COEFFS 0 4 0 0 0 1 /end COMPU_METHOD
/begin CHARACTERISTIC UEGON_Ttarget "UEGO closed-loop target" VALUE 0x001CA374 /* @ECU_Address@UEGON_Ttarget@0x0100BEC8@ */ ECIPP_ALIGNMENT_SWORD 8192 Compu_UEGON_Ttarget -8192 8191.75 /end CHARACTERISTIC
/begin COMPU_METHOD Compu_UEGON_Ttarget " " RAT_FUNC "%.1" "deg C" COEFFS 0 4 0 0 0 1 /end COMPU_METHOD
/begin CHARACTERISTIC UEGON_Thysteresis "UEGO temperature hysteresis" VALUE 0x001CA376 /* @ECU_Address@UEGON_Thysteresis@0x0100BED0@ */ ECIPP_ALIGNMENT_SWORD 8192 Compu_UEGON_Thysteresis -8192 8191.75 /end CHARACTERISTIC
/begin COMPU_METHOD Compu_UEGON_Thysteresis " " RAT_FUNC "%.1" "deg C" COEFFS 0 4 0 0 0 1 /end COMPU_METHOD
/begin CHARACTERISTIC UEGON_Kp_Vheater "UEGO heater Kp gain" VALUE 0x001CA378 /* @ECU_Address@UEGON_Kp_Vheater@0x0100BED8@ */ ECIPP_ALIGNMENT_SWORD 0 Compu_UEGON_Kp_Vheater -0.5 0.499984741210938 /end CHARACTERISTIC
/begin COMPU_METHOD Compu_UEGON_Kp_Vheater " " RAT_FUNC "%.3" "volts/degC" COEFFS 0 65536 0 0 0 1 /end COMPU_METHOD
/begin CHARACTERISTIC UEGON_Ki_Vheater "UEGO heater Ki gain" VALUE 0x001CA37A /* @ECU_Address@UEGON_Ki_Vheater@0x0100BEE0@ */ ECIPP_ALIGNMENT_SWORD 25 Compu_UEGON_Ki_Vheater -25 24.9992370605469 /end CHARACTERISTIC
/begin COMPU_METHOD Compu_UEGON_Ki_Vheater " " RAT_FUNC "%.3" "volts/degC/sec" COEFFS 0 1310.72 0 0 0 1 /end COMPU_METHOD
/begin CHARACTERISTIC UEGON_Kd_Vheater "UEGO heater Kd gain" VALUE 0x001CA37C /* @ECU_Address@UEGON_Kd_Vheater@0x0100BEE8@ */ ECIPP_ALIGNMENT_SWORD 200 Compu_UEGON_Kd_Vheater -200 199.993896484375 /end CHARACTERISTIC
/begin COMPU_METHOD Compu_UEGON_Kd_Vheater " " RAT_FUNC "%.3" "volts/degC*sec" COEFFS 0 163.84 0 0 0 1 /end COMPU_METHOD
/begin CHARACTERISTIC UEGON_Vheater_max "UEGO heater max voltage" VALUE 0x001CA384 /* @ECU_Address@UEGON_Vheater_max@0x0100BEF0@ */ ECIPP_ALIGNMENT_SLONG 2097152 Compu_UEGON_Vheater_max -2097152 2097151.99902344 /end CHARACTERISTIC
/begin COMPU_METHOD Compu_UEGON_Vheater_max " " RAT_FUNC "%.1" "volts" COEFFS 0 1024 0 0 0 1 /end COMPU_METHOD
/begin CHARACTERISTIC UEGON_integral_max "UEGO heater max integral" VALUE 0x001CA38C /* @ECU_Address@UEGON_integral_max@0x0100BEF8@ */ ECIPP_ALIGNMENT_SLONG 2048 Compu_UEGON_integral_max -2048 2047.99999904633 /end CHARACTERISTIC
/begin COMPU_METHOD Compu_UEGON_integral_max " " RAT_FUNC "%.1" "volts" COEFFS 0 1048576 0 0 0 1 /end COMPU_METHOD
/begin MEASUREMENT UEGO_sensor_type "UEGO1 sensor type{UEGO_sensor_type&0xff=0:None}{UEGO_sensor_type&0xff=1:Bosch LSU 4.9}{UEGO_sensor_type&0xff=2:NTK 6312}{UEGO_sensor_type&0xff=3:NTK ZFAS-U2 Exh}{UEGO_sensor_type&0xff=4:NTK ZFAS-U2 Int}" UBYTE UEGO_sensor_type_COMPU_VTAB 0 0 0 255 ECU_ADDRESS 0x0100BF08 BIT_MASK 0xff /end MEASUREMENT
/begin COMPU_METHOD UEGO_sensor_type_COMPU_VTAB "Verbal Table" TAB_VERB "%.0" "list" COMPU_TAB_REF UEGO_sensor_type_COMPU_VTAB_REF /end COMPU_METHOD
/begin COMPU_VTAB UEGO_sensor_type_COMPU_VTAB_REF "Verbal Table" TAB_VERB 5 0 "None" 1 "Bosch LSU 4.9" 2 "NTK 6312" 3 "NTK ZFAS-U2 Exh" 4 "NTK ZFAS-U2 Int" DEFAULT_VALUE "UNKNOWN" /end COMPU_VTAB
/begin MEASUREMENT UEGO2_sensor_type "UEGO2 sensor type{UEGO2_sensor_type&0xff=0:None}{UEGO2_sensor_type&0xff=1:Bosch LSU 4.9}{UEGO2_sensor_type&0xff=2:NTK 6312}{UEGO2_sensor_type&0xff=3:NTK ZFAS-U2 Exh}{UEGO2_sensor_type&0xff=4:NTK ZFAS-U2 Int}" UBYTE UEGO2_sensor_type_COMPU_VTAB 0 0 0 255 ECU_ADDRESS 0x0100BF10 BIT_MASK 0xff /end MEASUREMENT
/begin COMPU_METHOD UEGO2_sensor_type_COMPU_VTAB "Verbal Table" TAB_VERB "%.0" "list" COMPU_TAB_REF UEGO2_sensor_type_COMPU_VTAB_REF /end COMPU_METHOD
/begin COMPU_VTAB UEGO2_sensor_type_COMPU_VTAB_REF "Verbal Table" TAB_VERB 5 0 "None" 1 "Bosch LSU 4.9" 2 "NTK 6312" 3 "NTK ZFAS-U2 Exh" 4 "NTK ZFAS-U2 Int" DEFAULT_VALUE "UNKNOWN" /end COMPU_VTAB
/begin CHARACTERISTIC UEGOB_integral_min "UEGOB integral min" VALUE 0x001CA2EC /* @ECU_Address@UEGOB_integral_min@0x0100BFA8@ */ ECIPP_ALIGNMENT_SLONG 2048 Compu_UEGOB_integral_min -2048 2047.99999904633 /end CHARACTERISTIC
/begin COMPU_METHOD Compu_UEGOB_integral_min " " RAT_FUNC "%.1" "volts" COEFFS 0 1048576 0 0 0 1 /end COMPU_METHOD
/begin CHARACTERISTIC UEGON_integral_min "UEGON integral min" VALUE 0x001CA388 /* @ECU_Address@UEGON_integral_min@0x0100BFE0@ */ ECIPP_ALIGNMENT_SLONG 2048 Compu_UEGON_integral_min -2048 2047.99999904633 /end CHARACTERISTIC
/begin COMPU_METHOD Compu_UEGON_integral_min " " RAT_FUNC "%.1" "volts" COEFFS 0 1048576 0 0 0 1 /end COMPU_METHOD
/begin CHARACTERISTIC UEGOH_SD_tout "UEGO heater on at engine stop" VALUE 0x001c43e0 /* @ECU_Address@UEGOH_SD_tout@0x0100C298@ */ ECIPP_ALIGNMENT_ULONG 4294967 Compu_UEGOH_SD_tout 0 4294967.295 /end CHARACTERISTIC
/begin COMPU_METHOD Compu_UEGOH_SD_tout " " RAT_FUNC "%.1" "sec" COEFFS 0 1000 0 0 0 1 /end COMPU_METHOD
/begin MEASUREMENT UEGOH_SD_tmr "UEGO heater on at engine stop" ULONG Compu_UEGOH_SD_tmr 0 0 0 4294967.295 ECU_ADDRESS 0x0100C2A0 /end MEASUREMENT
/begin COMPU_METHOD Compu_UEGOH_SD_tmr " " RAT_FUNC "%.1" "sec" COEFFS 0 1000 0 0 0 1 /end COMPU_METHOD
/begin CHARACTERISTIC UEGOB_heater_Hz "UEGO heater PWM freq" VALUE 0x001CA35C /* @ECU_Address@UEGOB_heater_Hz@0x0100C3E8@ */ ECIPP_ALIGNMENT_ULONG 10000000000 Compu_UEGOB_heater_Hz 0 10000000000 /end CHARACTERISTIC
/begin COMPU_METHOD Compu_UEGOB_heater_Hz " " RAT_FUNC "%.0" "Hz" COEFFS 0 0 1 0 0.00000005 0 /end COMPU_METHOD
/begin CHARACTERISTIC UEGON_heater_Hz "UEGO heater PWM freq" VALUE 0x001CA3F8 /* @ECU_Address@UEGON_heater_Hz@0x0100C3F0@ */ ECIPP_ALIGNMENT_ULONG 10000000000 Compu_UEGON_heater_Hz 0 10000000000 /end CHARACTERISTIC
/begin COMPU_METHOD Compu_UEGON_heater_Hz " " RAT_FUNC "%.0" "Hz" COEFFS 0 0 1 0 0.00000005 0 /end COMPU_METHOD
/begin CHARACTERISTIC UEGOB_Vheater_min "UEGO heater min voltage" VALUE 0x001CA2E4 /* @ECU_Address@UEGOB_Vheater_min@0x0100C3F8@ */ ECIPP_ALIGNMENT_SLONG 2097152 Compu_UEGOB_Vheater_min -2097152 2097151.99902344 /end CHARACTERISTIC
/begin COMPU_METHOD Compu_UEGOB_Vheater_min " " RAT_FUNC "%.1" "volts" COEFFS 0 1024 0 0 0 1 /end COMPU_METHOD
/begin CHARACTERISTIC UEGON_Vheater_min "UEGO heater min voltage" VALUE 0x001CA380 /* @ECU_Address@UEGON_Vheater_min@0x0100C400@ */ ECIPP_ALIGNMENT_SLONG 2097152 Compu_UEGON_Vheater_min -2097152 2097151.99902344 /end CHARACTERISTIC
/begin COMPU_METHOD Compu_UEGON_Vheater_min " " RAT_FUNC "%.1" "volts" COEFFS 0 1024 0 0 0 1 /end COMPU_METHOD
/begin CHARACTERISTIC UEGOB_integral_lmts "UEGO heater integral lmts{UEGOB_integral_lmts&0xff=0:Fixed Scalars}{UEGOB_integral_lmts&0xff=1:Use CL limits}" VALUE 0x001CA360 /* @ECU_Address@UEGOB_integral_lmts@0x0100C408@ */ ECIPP_ALIGNMENT_UBYTE 255 UEGOB_integral_lmts_COMPU_VTAB 0 255 BIT_MASK 0xff /end CHARACTERISTIC
/begin COMPU_METHOD UEGOB_integral_lmts_COMPU_VTAB "Verbal Table" TAB_VERB "%.0" "list" COMPU_TAB_REF UEGOB_integral_lmts_COMPU_VTAB_REF /end COMPU_METHOD
/begin COMPU_VTAB UEGOB_integral_lmts_COMPU_VTAB_REF "Verbal Table" TAB_VERB 2 0 "Fixed Scalars" 1 "Use CL limits" DEFAULT_VALUE "UNKNOWN" /end COMPU_VTAB
/begin CHARACTERISTIC UEGON_integral_lmts "UEGO heater integral lmts{UEGON_integral_lmts&0xff=0:Fixed Scalars}{UEGON_integral_lmts&0xff=1:Use CL limits}" VALUE 0x001CA3FC /* @ECU_Address@UEGON_integral_lmts@0x0100C410@ */ ECIPP_ALIGNMENT_UBYTE 255 UEGON_integral_lmts_COMPU_VTAB 0 255 BIT_MASK 0xff /end CHARACTERISTIC
/begin COMPU_METHOD UEGON_integral_lmts_COMPU_VTAB "Verbal Table" TAB_VERB "%.0" "list" COMPU_TAB_REF UEGON_integral_lmts_COMPU_VTAB_REF /end COMPU_METHOD
/begin COMPU_VTAB UEGON_integral_lmts_COMPU_VTAB_REF "Verbal Table" TAB_VERB 2 0 "Fixed Scalars" 1 "Use CL limits" DEFAULT_VALUE "UNKNOWN" /end COMPU_VTAB
/begin CHARACTERISTIC UEGOB_Vheater_lmts "UEGO heater CL limits{UEGOB_Vheater_lmts&0xff=0:Fixed Scalars}{UEGOB_Vheater_lmts&0xff=1:1D Table}" VALUE 0x001CA361 /* @ECU_Address@UEGOB_Vheater_lmts@0x0100C418@ */ ECIPP_ALIGNMENT_UBYTE 255 UEGOB_Vheater_lmts_COMPU_VTAB 0 255 BIT_MASK 0xff /end CHARACTERISTIC
/begin COMPU_METHOD UEGOB_Vheater_lmts_COMPU_VTAB "Verbal Table" TAB_VERB "%.0" "list" COMPU_TAB_REF UEGOB_Vheater_lmts_COMPU_VTAB_REF /end COMPU_METHOD
/begin COMPU_VTAB UEGOB_Vheater_lmts_COMPU_VTAB_REF "Verbal Table" TAB_VERB 2 0 "Fixed Scalars" 1 "1D Table" DEFAULT_VALUE "UNKNOWN" /end COMPU_VTAB
/begin CHARACTERISTIC UEGON_Vheater_lmts "UEGO heater CL limits{UEGON_Vheater_lmts&0xff=0:Fixed Scalars}{UEGON_Vheater_lmts&0xff=1:1D Table}" VALUE 0x001CA3FD /* @ECU_Address@UEGON_Vheater_lmts@0x0100C420@ */ ECIPP_ALIGNMENT_UBYTE 255 UEGON_Vheater_lmts_COMPU_VTAB 0 255 BIT_MASK 0xff /end CHARACTERISTIC
/begin COMPU_METHOD UEGON_Vheater_lmts_COMPU_VTAB "Verbal Table" TAB_VERB "%.0" "list" COMPU_TAB_REF UEGON_Vheater_lmts_COMPU_VTAB_REF /end COMPU_METHOD
/begin COMPU_VTAB UEGON_Vheater_lmts_COMPU_VTAB_REF "Verbal Table" TAB_VERB 2 0 "Fixed Scalars" 1 "1D Table" DEFAULT_VALUE "UNKNOWN" /end COMPU_VTAB
/begin CHARACTERISTIC UEGOB_ext_warmadd "UEGO ext mode warmup add" VALUE 0x001CA346 /* @ECU_Address@UEGOB_ext_warmadd@0x0100C428@ */ ECIPP_ALIGNMENT_UWORD 64 Compu_UEGOB_ext_warmadd 0 63.9990234375 /end CHARACTERISTIC
/begin COMPU_METHOD Compu_UEGOB_ext_warmadd " " RAT_FUNC "%.1" "volts" COEFFS 0 1024 0 0 0 1 /end COMPU_METHOD
/begin CHARACTERISTIC UEGON_ext_warmadd "UEGO ext mode warmup add" VALUE 0x001CA3E2 /* @ECU_Address@UEGON_ext_warmadd@0x0100C430@ */ ECIPP_ALIGNMENT_UWORD 64 Compu_UEGON_ext_warmadd 0 63.9990234375 /end CHARACTERISTIC
/begin COMPU_METHOD Compu_UEGON_ext_warmadd " " RAT_FUNC "%.1" "volts" COEFFS 0 1024 0 0 0 1 /end COMPU_METHOD
/begin CHARACTERISTIC UEGOB_ext_CLadd "UEGO ext mode CL add" VALUE 0x001CA348 /* @ECU_Address@UEGOB_ext_CLadd@0x0100C438@ */ ECIPP_ALIGNMENT_UWORD 64 Compu_UEGOB_ext_CLadd 0 63.9990234375 /end CHARACTERISTIC
/begin COMPU_METHOD Compu_UEGOB_ext_CLadd " " RAT_FUNC "%.1" "volts" COEFFS 0 1024 0 0 0 1 /end COMPU_METHOD
/begin CHARACTERISTIC UEGON_ext_CLadd "UEGO ext mode CL add" VALUE 0x001CA3E4 /* @ECU_Address@UEGON_ext_CLadd@0x0100C440@ */ ECIPP_ALIGNMENT_UWORD 64 Compu_UEGON_ext_CLadd 0 63.9990234375 /end CHARACTERISTIC
/begin COMPU_METHOD Compu_UEGON_ext_CLadd " " RAT_FUNC "%.1" "volts" COEFFS 0 1024 0 0 0 1 /end COMPU_METHOD
/begin CHARACTERISTIC UEGOB_ext_warmwt "UEGO ext mode warmup wait" VALUE 0x001CA34A /* @ECU_Address@UEGOB_ext_warmwt@0x0100C448@ */ ECIPP_ALIGNMENT_UWORD 1049 Compu_UEGOB_ext_warmwt 0 1048.56 /end CHARACTERISTIC
/begin COMPU_METHOD Compu_UEGOB_ext_warmwt " " RAT_FUNC "%.1" "sec" COEFFS 0 62.5 0 0 0 1 /end COMPU_METHOD
/begin CHARACTERISTIC UEGON_ext_warmwt "UEGO ext mode warmup wait" VALUE 0x001CA3E6 /* @ECU_Address@UEGON_ext_warmwt@0x0100C450@ */ ECIPP_ALIGNMENT_UWORD 1049 Compu_UEGON_ext_warmwt 0 1048.56 /end CHARACTERISTIC
/begin COMPU_METHOD Compu_UEGON_ext_warmwt " " RAT_FUNC "%.1" "sec" COEFFS 0 62.5 0 0 0 1 /end COMPU_METHOD
/begin CHARACTERISTIC UEGOB_ext_mrgwt "UEGO ext mode margin wait" VALUE 0x001CA34C /* @ECU_Address@UEGOB_ext_mrgwt@0x0100C458@ */ ECIPP_ALIGNMENT_UWORD 1049 Compu_UEGOB_ext_mrgwt 0 1048.56 /end CHARACTERISTIC
/begin COMPU_METHOD Compu_UEGOB_ext_mrgwt " " RAT_FUNC "%.1" "sec" COEFFS 0 62.5 0 0 0 1 /end COMPU_METHOD
/begin CHARACTERISTIC UEGON_ext_mrgwt "UEGO ext mode margin wait" VALUE 0x001CA3E8 /* @ECU_Address@UEGON_ext_mrgwt@0x0100C460@ */ ECIPP_ALIGNMENT_UWORD 1049 Compu_UEGON_ext_mrgwt 0 1048.56 /end CHARACTERISTIC
/begin COMPU_METHOD Compu_UEGON_ext_mrgwt " " RAT_FUNC "%.1" "sec" COEFFS 0 62.5 0 0 0 1 /end COMPU_METHOD
/begin CHARACTERISTIC UEGOB_ext_ramp "UEGO ext mode ramp" VALUE 0x001CA34E /* @ECU_Address@UEGOB_ext_ramp@0x0100C468@ */ ECIPP_ALIGNMENT_UWORD 1049 Compu_UEGOB_ext_ramp 0 1048.56 /end CHARACTERISTIC
/begin COMPU_METHOD Compu_UEGOB_ext_ramp " " RAT_FUNC "%.1" "sec" COEFFS 0 62.5 0 0 0 1 /end COMPU_METHOD
/begin CHARACTERISTIC UEGON_ext_ramp "UEGO ext mode ramp" VALUE 0x001CA3EA /* @ECU_Address@UEGON_ext_ramp@0x0100C470@ */ ECIPP_ALIGNMENT_UWORD 1049 Compu_UEGON_ext_ramp 0 1048.56 /end CHARACTERISTIC
/begin COMPU_METHOD Compu_UEGON_ext_ramp " " RAT_FUNC "%.1" "sec" COEFFS 0 62.5 0 0 0 1 /end COMPU_METHOD
/begin MEASUREMENT UEGO1_timer_heater "UEGO heater on-time" ULONG Compu_UEGO1_timer_heater 0 0 0 4294967.295 ECU_ADDRESS 0x0100C478 /end MEASUREMENT
/begin COMPU_METHOD Compu_UEGO1_timer_heater " " RAT_FUNC "%.0" "sec" COEFFS 0 1000 0 0 0 1 /end COMPU_METHOD
/begin MEASUREMENT UEGO2_timer_heater "UEGO heater on-time" ULONG Compu_UEGO2_timer_heater 0 0 0 4294967.295 ECU_ADDRESS 0x0100C480 /end MEASUREMENT
/begin COMPU_METHOD Compu_UEGO2_timer_heater " " RAT_FUNC "%.0" "sec" COEFFS 0 1000 0 0 0 1 /end COMPU_METHOD
/begin MEASUREMENT UEGO1_timer_warm "UEGO sensor warm time" ULONG Compu_UEGO1_timer_warm 0 0 0 4294967.295 ECU_ADDRESS 0x0100C488 /end MEASUREMENT
/begin COMPU_METHOD Compu_UEGO1_timer_warm " " RAT_FUNC "%.0" "sec" COEFFS 0 1000 0 0 0 1 /end COMPU_METHOD
/begin MEASUREMENT UEGO2_timer_warm "UEGO sensor warm time" ULONG Compu_UEGO2_timer_warm 0 0 0 4294967.295 ECU_ADDRESS 0x0100C490 /end MEASUREMENT
/begin COMPU_METHOD Compu_UEGO2_timer_warm " " RAT_FUNC "%.0" "sec" COEFFS 0 1000 0 0 0 1 /end COMPU_METHOD
/begin MEASUREMENT UEGO1_Vheater_CLmin "UEGO heater min voltage" UWORD Compu_UEGO1_Vheater_CLmin 0 0 0 63.9990234375 ECU_ADDRESS 0x0100C498 /end MEASUREMENT
/begin COMPU_METHOD Compu_UEGO1_Vheater_CLmin " " RAT_FUNC "%.1" "volts" COEFFS 0 1024 0 0 0 1 /end COMPU_METHOD
/begin MEASUREMENT UEGO2_Vheater_CLmin "UEGO heater min voltage" UWORD Compu_UEGO2_Vheater_CLmin 0 0 0 63.9990234375 ECU_ADDRESS 0x0100C4A0 /end MEASUREMENT
/begin COMPU_METHOD Compu_UEGO2_Vheater_CLmin " " RAT_FUNC "%.1" "volts" COEFFS 0 1024 0 0 0 1 /end COMPU_METHOD
/begin MEASUREMENT UEGO1_Vheater_CLmax "UEGO heater max voltage" UWORD Compu_UEGO1_Vheater_CLmax 0 0 0 63.9990234375 ECU_ADDRESS 0x0100C4A8 /end MEASUREMENT
/begin COMPU_METHOD Compu_UEGO1_Vheater_CLmax " " RAT_FUNC "%.1" "volts" COEFFS 0 1024 0 0 0 1 /end COMPU_METHOD
/begin MEASUREMENT UEGO2_Vheater_CLmax "UEGO heater max voltage" UWORD Compu_UEGO2_Vheater_CLmax 0 0 0 63.9990234375 ECU_ADDRESS 0x0100C4B0 /end MEASUREMENT
/begin COMPU_METHOD Compu_UEGO2_Vheater_CLmax " " RAT_FUNC "%.1" "volts" COEFFS 0 1024 0 0 0 1 /end COMPU_METHOD
/begin MEASUREMENT UEGO1_Vheater_OL "UEGO heater warmup voltage" UWORD Compu_UEGO1_Vheater_OL 0 0 0 63.9990234375 ECU_ADDRESS 0x0100C4B8 /end MEASUREMENT
/begin COMPU_METHOD Compu_UEGO1_Vheater_OL " " RAT_FUNC "%.1" "volts" COEFFS 0 1024 0 0 0 1 /end COMPU_METHOD
/begin MEASUREMENT UEGO2_Vheater_OL "UEGO heater warmup voltage" UWORD Compu_UEGO2_Vheater_OL 0 0 0 63.9990234375 ECU_ADDRESS 0x0100C4C0 /end MEASUREMENT
/begin COMPU_METHOD Compu_UEGO2_Vheater_OL " " RAT_FUNC "%.1" "volts" COEFFS 0 1024 0 0 0 1 /end COMPU_METHOD
/begin CHARACTERISTIC UEGO_driftE_inject_t "EGRwr sample injection" VALUE 0x001C0ABC /* @ECU_Address@UEGO_driftE_inject_t@0x0100D920@ */ ECIPP_ALIGNMENT_UWORD 1092 Compu_UEGO_driftE_inject_t 0 1092.25 /end CHARACTERISTIC
/begin COMPU_METHOD Compu_UEGO_driftE_inject_t " " RAT_FUNC "%.1" "min" COEFFS 0 60 0 0 0 1 /end COMPU_METHOD
/begin CHARACTERISTIC UEGO_driftE_samp_ms "EGRwr sampling interval" VALUE 0x001C0AC0 /* @ECU_Address@UEGO_driftE_samp_ms@0x0100D928@ */ ECIPP_ALIGNMENT_UWORD 65535 Compu_UEGO_driftE_samp_ms 0 65535 /end CHARACTERISTIC
/begin COMPU_METHOD Compu_UEGO_driftE_samp_ms " " RAT_FUNC "%.0" "ms" COEFFS 0 1 0 0 0 1 /end COMPU_METHOD
/begin CHARACTERISTIC UEGO_driftE_Ip_tol "EGRwr sampling max Ip deviation" VALUE 0x001C0AC2 /* @ECU_Address@UEGO_driftE_Ip_tol@0x0100D930@ */ ECIPP_ALIGNMENT_UWORD 100 Compu_UEGO_driftE_Ip_tol 0 99.9984741210938 /end CHARACTERISTIC
/begin COMPU_METHOD Compu_UEGO_driftE_Ip_tol " " RAT_FUNC "%.2" "% from mean" COEFFS 0 655.36 0 0 0 1 /end COMPU_METHOD
/begin CHARACTERISTIC UEGO_driftE_Terr_max "EGRwr sampling max CL heater error" VALUE 0x001C0AC4 /* @ECU_Address@UEGO_driftE_Terr_max@0x0100D938@ */ ECIPP_ALIGNMENT_SWORD 8192 Compu_UEGO_driftE_Terr_max -8192 8191.75 /end CHARACTERISTIC
/begin COMPU_METHOD Compu_UEGO_driftE_Terr_max " " RAT_FUNC "%.1" "deg C" COEFFS 0 4 0 0 0 1 /end COMPU_METHOD
/begin CHARACTERISTIC UEGO_driftE_gain "EGRwr new sample time-based gain" VALUE 0x001C0AC6 /* @ECU_Address@UEGO_driftE_gain@0x0100D940@ */ ECIPP_ALIGNMENT_UWORD 6400 Compu_UEGO_driftE_gain 0 6399.90234375 /end CHARACTERISTIC
/begin COMPU_METHOD Compu_UEGO_driftE_gain " " RAT_FUNC "%.1" "%/hr" COEFFS 0 10.24 0 0 0 1 /end COMPU_METHOD
/begin CHARACTERISTIC UEGO_driftE_crct_min "EGRwr min Ip error to correct" VALUE 0x001C0ACC /* @ECU_Address@UEGO_driftE_crct_min@0x0100D948@ */ ECIPP_ALIGNMENT_SWORD 100 Compu_UEGO_driftE_crct_min -100 99.9969482421875 /end CHARACTERISTIC
/begin COMPU_METHOD Compu_UEGO_driftE_crct_min " " RAT_FUNC "%.1" "% Ip" COEFFS 0 327.68 0 0 0 1 /end COMPU_METHOD
/begin CHARACTERISTIC UEGO_driftE_crct_max "EGRwr max Ip error to correct" VALUE 0x001C0ACE /* @ECU_Address@UEGO_driftE_crct_max@0x0100D950@ */ ECIPP_ALIGNMENT_SWORD 100 Compu_UEGO_driftE_crct_max -100 99.9969482421875 /end CHARACTERISTIC
/begin COMPU_METHOD Compu_UEGO_driftE_crct_max " " RAT_FUNC "%.1" "% Ip" COEFFS 0 327.68 0 0 0 1 /end COMPU_METHOD
/begin MEASUREMENT UEGOH_start_wtEGR "EGR UEGO heater delay from start" UWORD Compu_UEGOH_start_wtEGR 0 0 0 65535 ECU_ADDRESS 0x0100D958 /end MEASUREMENT
/begin COMPU_METHOD Compu_UEGOH_start_wtEGR " " RAT_FUNC "%.0" "sec" COEFFS 0 1 0 0 0 1 /end COMPU_METHOD
/begin CHARACTERISTIC UEGO_driftE_stable_t "UEGO pre-sampling wait period" VALUE 0x001C0ABE /* @ECU_Address@UEGO_driftE_stable_t@0x0100D960@ */ ECIPP_ALIGNMENT_UWORD 65535 Compu_UEGO_driftE_stable_t 0 65535 /end CHARACTERISTIC
/begin COMPU_METHOD Compu_UEGO_driftE_stable_t " " RAT_FUNC "%.0" "ms" COEFFS 0 1 0 0 0 1 /end COMPU_METHOD
/begin CHARACTERISTIC UEGO_driftE_gain_max "UEGO new sample maximum gain" VALUE 0x001C0ACA /* @ECU_Address@UEGO_driftE_gain_max@0x0100D968@ */ ECIPP_ALIGNMENT_SWORD 100 Compu_UEGO_driftE_gain_max -100 99.9969482421875 /end CHARACTERISTIC
/begin COMPU_METHOD Compu_UEGO_driftE_gain_max " " RAT_FUNC "%.1" "%" COEFFS 0 327.68 0 0 0 1 /end COMPU_METHOD
/begin MEASUREMENT UEGO1_CAN_PI_mA "UEGO CAN pump current" SWORD Compu_UEGO1_CAN_PI_mA 0 0 -32 31.9990234375 ECU_ADDRESS 0x0100D970 /end MEASUREMENT
/begin COMPU_METHOD Compu_UEGO1_CAN_PI_mA " " RAT_FUNC "%.3" "mA" COEFFS 0 1024 0 0 0 1 /end COMPU_METHOD
/begin MEASUREMENT UEGO1_CAN_O2_pct "UEGO CAN O2 percent" SWORD Compu_UEGO1_CAN_O2_pct 0 0 -100 99.9969482421875 ECU_ADDRESS 0x0100D978 /end MEASUREMENT
/begin COMPU_METHOD Compu_UEGO1_CAN_O2_pct " " RAT_FUNC "%.2" "%" COEFFS 0 327.68 0 0 0 1 /end COMPU_METHOD
/begin MEASUREMENT UEGO1_CAN_stable "UEGO CAN status{UEGO1_CAN_stable&0xc0=0x00:Not Stable}{UEGO1_CAN_stable&0xc0=0x40:Stable}{UEGO1_CAN_stable&0xc0=0x80:Error}{UEGO1_CAN_stable&0xc0=0xc0:Not Available}" UBYTE UEGO1_CAN_stable_COMPU_VTAB 0 0 0 255 ECU_ADDRESS 0x0100D980 BIT_MASK 0xc0 /end MEASUREMENT
/begin COMPU_METHOD UEGO1_CAN_stable_COMPU_VTAB "Verbal Table" TAB_VERB "%.0" "list" COMPU_TAB_REF UEGO1_CAN_stable_COMPU_VTAB_REF /end COMPU_METHOD
/begin COMPU_VTAB UEGO1_CAN_stable_COMPU_VTAB_REF "Verbal Table" TAB_VERB 4 0x00 "Not Stable" 0x40 "Stable" 0x80 "Error" 0xc0 "Not Available" DEFAULT_VALUE "UNKNOWN" /end COMPU_VTAB
/begin MEASUREMENT UEGO1_CAN_compfail "UEGO CAN component fault{UEGO1_CAN_compfail&0x20=0x00:OK}{UEGO1_CAN_compfail&0x20=0x20:Fault}" UBYTE UEGO1_CAN_compfail_COMPU_VTAB 0 0 0 255 ECU_ADDRESS 0x0100D988 BIT_MASK 0x20 /end MEASUREMENT
/begin COMPU_METHOD UEGO1_CAN_compfail_COMPU_VTAB "Verbal Table" TAB_VERB "%.0" "list" COMPU_TAB_REF UEGO1_CAN_compfail_COMPU_VTAB_REF /end COMPU_METHOD
/begin COMPU_VTAB UEGO1_CAN_compfail_COMPU_VTAB_REF "Verbal Table" TAB_VERB 2 0x00 "OK" 0x20 "Fault" DEFAULT_VALUE "UNKNOWN" /end COMPU_VTAB
/begin MEASUREMENT UEGO1_CAN_circThi "UEGO CAN circ T fault{UEGO1_CAN_circThi&0x10=0x00:OK}{UEGO1_CAN_circThi&0x10=0x10:Fault}" UBYTE UEGO1_CAN_circThi_COMPU_VTAB 0 0 0 255 ECU_ADDRESS 0x0100D990 BIT_MASK 0xFF /end MEASUREMENT
/begin COMPU_METHOD UEGO1_CAN_circThi_COMPU_VTAB "Verbal Table" TAB_VERB "%.0" "list" COMPU_TAB_REF UEGO1_CAN_circThi_COMPU_VTAB_REF /end COMPU_METHOD
/begin COMPU_VTAB UEGO1_CAN_circThi_COMPU_VTAB_REF "Verbal Table" TAB_VERB 2 0x00 "OK" 0x10 "Fault" DEFAULT_VALUE "Unsupported Bit_Shift" /end COMPU_VTAB
/begin MEASUREMENT UEGO1_CAN_heatfail "UEGO CAN heater fault{UEGO1_CAN_heatfail&0x08=0x00:OK}{UEGO1_CAN_heatfail&0x08=0x08:Fault}" UBYTE UEGO1_CAN_heatfail_COMPU_VTAB 0 0 0 255 ECU_ADDRESS 0x0100D998 BIT_MASK 0x08 /end MEASUREMENT
/begin COMPU_METHOD UEGO1_CAN_heatfail_COMPU_VTAB "Verbal Table" TAB_VERB "%.0" "list" COMPU_TAB_REF UEGO1_CAN_heatfail_COMPU_VTAB_REF /end COMPU_METHOD
/begin COMPU_VTAB UEGO1_CAN_heatfail_COMPU_VTAB_REF "Verbal Table" TAB_VERB 2 0x00 "OK" 0x08 "Fault" DEFAULT_VALUE "UNKNOWN" /end COMPU_VTAB
/begin MEASUREMENT UEGO1_CAN_TxRxfail "UEGO CAN Tx/Rx fault{UEGO1_CAN_TxRxfail&0x04=0x00:OK}{UEGO1_CAN_TxRxfail&0x04=0x04:Fault}" UBYTE UEGO1_CAN_TxRxfail_COMPU_VTAB 0 0 0 255 ECU_ADDRESS 0x0100D9A0 BIT_MASK 0x04 /end MEASUREMENT
/begin COMPU_METHOD UEGO1_CAN_TxRxfail_COMPU_VTAB "Verbal Table" TAB_VERB "%.0" "list" COMPU_TAB_REF UEGO1_CAN_TxRxfail_COMPU_VTAB_REF /end COMPU_METHOD
/begin COMPU_VTAB UEGO1_CAN_TxRxfail_COMPU_VTAB_REF "Verbal Table" TAB_VERB 2 0x00 "OK" 0x04 "Fault" DEFAULT_VALUE "UNKNOWN" /end COMPU_VTAB
/begin MEASUREMENT UEGO1_CAN_Vbatlo "UEGO CAN battery low{UEGO1_CAN_Vbatlo&0x02=0x00:OK}{UEGO1_CAN_Vbatlo&0x02=0x02:Fault}" UBYTE UEGO1_CAN_Vbatlo_COMPU_VTAB 0 0 0 255 ECU_ADDRESS 0x0100D9A8 BIT_MASK 0x02 /end MEASUREMENT
/begin COMPU_METHOD UEGO1_CAN_Vbatlo_COMPU_VTAB "Verbal Table" TAB_VERB "%.0" "list" COMPU_TAB_REF UEGO1_CAN_Vbatlo_COMPU_VTAB_REF /end COMPU_METHOD
/begin COMPU_VTAB UEGO1_CAN_Vbatlo_COMPU_VTAB_REF "Verbal Table" TAB_VERB 2 0x00 "OK" 0x02 "Fault" DEFAULT_VALUE "UNKNOWN" /end COMPU_VTAB
/begin MEASUREMENT UEGO1_CAN_Vbathi "UEGO CAN battery high{UEGO1_CAN_Vbathi&0x01=0x00:OK}{UEGO1_CAN_Vbathi&0x01=0x01:Fault}" UBYTE UEGO1_CAN_Vbathi_COMPU_VTAB 0 0 0 255 ECU_ADDRESS 0x0100D9B0 BIT_MASK 0x01 /end MEASUREMENT
/begin COMPU_METHOD UEGO1_CAN_Vbathi_COMPU_VTAB "Verbal Table" TAB_VERB "%.0" "list" COMPU_TAB_REF UEGO1_CAN_Vbathi_COMPU_VTAB_REF /end COMPU_METHOD
/begin COMPU_VTAB UEGO1_CAN_Vbathi_COMPU_VTAB_REF "Verbal Table" TAB_VERB 2 0x00 "OK" 0x01 "Fault" DEFAULT_VALUE "UNKNOWN" /end COMPU_VTAB
/begin CHARACTERISTIC UEGO_drift_gain_min "UEGO new sample maximum gain" VALUE 0x001CA2CC /* @ECU_Address@UEGO_drift_gain_min@0x0100D9B8@ */ ECIPP_ALIGNMENT_SWORD 100 Compu_UEGO_drift_gain_min -100 99.9969482421875 /end CHARACTERISTIC
/begin COMPU_METHOD Compu_UEGO_drift_gain_min " " RAT_FUNC "%.1" "%" COEFFS 0 327.68 0 0 0 1 /end COMPU_METHOD
/begin CHARACTERISTIC UEGO_driftE_gain_min "UEGO new sample maximum gain" VALUE 0x001C0AC8 /* @ECU_Address@UEGO_driftE_gain_min@0x0100D9C0@ */ ECIPP_ALIGNMENT_SWORD 100 Compu_UEGO_driftE_gain_min -100 99.9969482421875 /end CHARACTERISTIC
/begin COMPU_METHOD Compu_UEGO_driftE_gain_min " " RAT_FUNC "%.1" "%" COEFFS 0 327.68 0 0 0 1 /end COMPU_METHOD
/begin MEASUREMENT AFT_dewpt_CL1pre "Tx Bank 1 pre dew point indication{AFT_dewpt_CL1pre&0x03=0x00:Not Exceeded}{AFT_dewpt_CL1pre&0x03=0x01:Dewpoint Met}{AFT_dewpt_CL1pre&0x03=0x02:Error}{AFT_dewpt_CL1pre&0x03=0x03:Not Available}" UBYTE AFT_dewpt_CL1pre_COMPU_VTAB 0 0 0 255 ECU_ADDRESS 0x0100D9C8 BIT_MASK 0x03 /end MEASUREMENT
/begin COMPU_METHOD AFT_dewpt_CL1pre_COMPU_VTAB "Verbal Table" TAB_VERB "%.0" "list" COMPU_TAB_REF AFT_dewpt_CL1pre_COMPU_VTAB_REF /end COMPU_METHOD
/begin COMPU_VTAB AFT_dewpt_CL1pre_COMPU_VTAB_REF "Verbal Table" TAB_VERB 4 0x00 "Not Exceeded" 0x01 "Dewpoint Met" 0x02 "Error" 0x03 "Not Available" DEFAULT_VALUE "UNKNOWN" /end COMPU_VTAB
/begin MEASUREMENT AFT_dewpt_CL1pst "Tx Bank 1 post dew point{AFT_dewpt_CL1pst&0x0c=0x00:Not Exceeded}{AFT_dewpt_CL1pst&0x0c=0x04:Dewpoint Met}{AFT_dewpt_CL1pst&0x0c=0x08:Error}{AFT_dewpt_CL1pst&0x0c=0x0c:Not Available}" UBYTE AFT_dewpt_CL1pst_COMPU_VTAB 0 0 0 255 ECU_ADDRESS 0x0100D9D0 BIT_MASK 0x0c /end MEASUREMENT
/begin COMPU_METHOD AFT_dewpt_CL1pst_COMPU_VTAB "Verbal Table" TAB_VERB "%.0" "list" COMPU_TAB_REF AFT_dewpt_CL1pst_COMPU_VTAB_REF /end COMPU_METHOD
/begin COMPU_VTAB AFT_dewpt_CL1pst_COMPU_VTAB_REF "Verbal Table" TAB_VERB 4 0x00 "Not Exceeded" 0x04 "Dewpoint Met" 0x08 "Error" 0x0c "Not Available" DEFAULT_VALUE "UNKNOWN" /end COMPU_VTAB
/begin MEASUREMENT NTK_dewpoint "Dewpoint Tx to UEGO{NTK_dewpoint&0x03=0x00:Not Exceeded}{NTK_dewpoint&0x03=0x01:Dewpoint Met}{NTK_dewpoint&0x03=0x02:Error}{NTK_dewpoint&0x03=0x03:Not Available}" UBYTE NTK_dewpoint_COMPU_VTAB 0 0 0 255 ECU_ADDRESS 0x0100D9E8 BIT_MASK 0x03 /end MEASUREMENT
/begin COMPU_METHOD NTK_dewpoint_COMPU_VTAB "Verbal Table" TAB_VERB "%.0" "list" COMPU_TAB_REF NTK_dewpoint_COMPU_VTAB_REF /end COMPU_METHOD
/begin COMPU_VTAB NTK_dewpoint_COMPU_VTAB_REF "Verbal Table" TAB_VERB 4 0x00 "Not Exceeded" 0x01 "Dewpoint Met" 0x02 "Error" 0x03 "Not Available" DEFAULT_VALUE "UNKNOWN" /end COMPU_VTAB
/begin MEASUREMENT NTK_preheat "Preheat Tx to UEGO{NTK_preheat&0x0c=0x00:Preheat OFF}{NTK_preheat&0x0c=0x04:Preheat ON}{NTK_preheat&0x0c=0x08:Error}{NTK_preheat&0x0c=0x0c:Not Available}" UBYTE NTK_preheat_COMPU_VTAB 0 0 0 255 ECU_ADDRESS 0x0100D9F0 BIT_MASK 0x0c /end MEASUREMENT
/begin COMPU_METHOD NTK_preheat_COMPU_VTAB "Verbal Table" TAB_VERB "%.0" "list" COMPU_TAB_REF NTK_preheat_COMPU_VTAB_REF /end COMPU_METHOD
/begin COMPU_VTAB NTK_preheat_COMPU_VTAB_REF "Verbal Table" TAB_VERB 4 0x00 "Preheat OFF" 0x04 "Preheat ON" 0x08 "Error" 0x0c "Not Available" DEFAULT_VALUE "UNKNOWN" /end COMPU_VTAB
/begin CHARACTERISTIC UEGO3_config "UEGO3 configuration{UEGO3_config&0xff=0:Not Present}{UEGO3_config&0xff=1:Internal Hardware}{UEGO3_config&0xff=2:Aux PD1}{UEGO3_config&0xff=3:Aux PD2}{UEGO3_config&0xff=4:Aux PD3}{UEGO3_config&0xff=5:Aux PU1}{UEGO3_config&0xff=6:Aux PU2}{UEGO3_config&0xff=" VALUE 0x001C8F7D /* @ECU_Address@UEGO3_config@0x0100E0D0@ */ ECIPP_ALIGNMENT_UBYTE 255 UEGO3_config_COMPU_VTAB 0 255 BIT_MASK 0xff /end CHARACTERISTIC
/begin COMPU_METHOD UEGO3_config_COMPU_VTAB "Verbal Table" TAB_VERB "%.0" "list" COMPU_TAB_REF UEGO3_config_COMPU_VTAB_REF /end COMPU_METHOD
/begin COMPU_VTAB UEGO3_config_COMPU_VTAB_REF "Verbal Table" TAB_VERB 37 0 "Not Present" 1 "Internal Hardware" 2 "Aux PD1" 3 "Aux PD2" 4 "Aux PD3" 5 "Aux PU1" 6 "Aux PU2" 7 "Aux PU3" 8 "Aux PUD1" 9 "Aux PUD2" 10 "Aux PUD3" 11 "Aux PUD4" 12 "Aux PUD5" 13 "Aux PUD6" 14 "Aux PUD7" 15 "Aux PUD8" 16 "Aux PUD9" 17 "Aux PUD10" 18 "Aux PUD11" 19 "Aux PUD12" 20 "Aux PUD13" 21 "Aux PUD14" 22 "Aux PUD15" 23 "Aux PUD16" 24 "Aux PUD17" 25 "Aux PUD18" 26 "Aux PUD19" 27 "Aux PUD20" 28 "Aux PUD21" 29 "Aux PUD22" 30 "Aux PUD23" 31 "Aux PUD24" 32 "Aux PUD25" 33 "CAN - NTK1" 34 "CAN - NTK2" 35 "CAN - NTK3" 36 "CAN - NTK intake" DEFAULT_VALUE "UNKNOWN" /end COMPU_VTAB
/begin CHARACTERISTIC UEGO3_sensor_slct "UEGO3 sensor type{UEGO3_sensor_slct&0xff=0:Default}{UEGO3_sensor_slct&0xff=1:Bosch LSU 4.9}{UEGO3_sensor_slct&0xff=2:NTK 6312}{UEGO3_sensor_slct&0xff=3:NTK ZFAS-U2 Exh}{UEGO3_sensor_slct&0xff=4:NTK ZFAS-U2 Int}" VALUE 0x001C8F81 /* @ECU_Address@UEGO3_sensor_slct@0x0100E0D8@ */ ECIPP_ALIGNMENT_UBYTE 255 UEGO3_sensor_slct_COMPU_VTAB 0 255 BIT_MASK 0xff /end CHARACTERISTIC
/begin COMPU_METHOD UEGO3_sensor_slct_COMPU_VTAB "Verbal Table" TAB_VERB "%.0" "list" COMPU_TAB_REF UEGO3_sensor_slct_COMPU_VTAB_REF /end COMPU_METHOD
/begin COMPU_VTAB UEGO3_sensor_slct_COMPU_VTAB_REF "Verbal Table" TAB_VERB 5 0 "Default" 1 "Bosch LSU 4.9" 2 "NTK 6312" 3 "NTK ZFAS-U2 Exh" 4 "NTK ZFAS-U2 Int" DEFAULT_VALUE "UNKNOWN" /end COMPU_VTAB
/begin MEASUREMENT UEGO3_sensor_type "UEGO3 sensor type{UEGO3_sensor_type&0xff=0:None}{UEGO3_sensor_type&0xff=1:Bosch LSU 4.9}{UEGO3_sensor_type&0xff=2:NTK 6312}{UEGO3_sensor_type&0xff=3:NTK ZFAS-U2 Exh}{UEGO3_sensor_type&0xff=4:NTK ZFAS-U2 Int}" UBYTE UEGO3_sensor_type_COMPU_VTAB 0 0 0 255 ECU_ADDRESS 0x0100E0E0 BIT_MASK 0xff /end MEASUREMENT
/begin COMPU_METHOD UEGO3_sensor_type_COMPU_VTAB "Verbal Table" TAB_VERB "%.0" "list" COMPU_TAB_REF UEGO3_sensor_type_COMPU_VTAB_REF /end COMPU_METHOD
/begin COMPU_VTAB UEGO3_sensor_type_COMPU_VTAB_REF "Verbal Table" TAB_VERB 5 0 "None" 1 "Bosch LSU 4.9" 2 "NTK 6312" 3 "NTK ZFAS-U2 Exh" 4 "NTK ZFAS-U2 Int" DEFAULT_VALUE "UNKNOWN" /end COMPU_VTAB
/begin MEASUREMENT Phi_UEGO3_raw "UEGO Phi uncorrected" UWORD Compu_Phi_UEGO3_raw 0 0 0 3.99993896484375 ECU_ADDRESS 0x0100E0F8 /end MEASUREMENT
/begin COMPU_METHOD Compu_Phi_UEGO3_raw " " RAT_FUNC "%.3" "phi" COEFFS 0 16384 0 0 0 1 /end COMPU_METHOD
/begin MEASUREMENT AF_UEGO3 "UEGO A/F ratio" UWORD Compu_AF_UEGO3 0 0 0 63.9990234375 ECU_ADDRESS 0x0100E108 /end MEASUREMENT
/begin COMPU_METHOD Compu_AF_UEGO3 " " RAT_FUNC "%.2" "A/F ratio" COEFFS 0 1024 0 0 0 1 /end COMPU_METHOD
/begin MEASUREMENT UEGO3_drift_state "UEGO drift state{UEGO3_drift_state&0xff=0:Disabled}{UEGO3_drift_state&0xff=1:UEGO run wait}{UEGO3_drift_state&0xff=2:ECT low}{UEGO3_drift_state&0xff=3:FT low}{UEGO3_drift_state&0xff=4:Exhaust braking}{UEGO3_drift_state&0xff=5:Recovery wait}{UEGO3_drift_st" UBYTE UEGO3_drift_state_COMPU_VTAB 0 0 0 255 ECU_ADDRESS 0x0100E110 BIT_MASK 0xff /end MEASUREMENT
/begin COMPU_METHOD UEGO3_drift_state_COMPU_VTAB "Verbal Table" TAB_VERB "%.0" "list" COMPU_TAB_REF UEGO3_drift_state_COMPU_VTAB_REF /end COMPU_METHOD
/begin COMPU_VTAB UEGO3_drift_state_COMPU_VTAB_REF "Verbal Table" TAB_VERB 17 0 "Disabled" 1 "UEGO run wait" 2 "ECT low" 3 "FT low" 4 "Exhaust braking" 5 "Recovery wait" 6 "Env. sensor fault" 7 "7 - Reserved" 8 "8 - Reserved" 9 "9 - Reserved" 10 "Idle" 11 "Stabilizing" 12 "Trans delay wait" 13 "Initializing samples" 14 "Sampling" 15 "Validating" 16 "Success" DEFAULT_VALUE "UNKNOWN" /end COMPU_VTAB
/begin MEASUREMENT UEGO3_drift_PI_dmean "UEGO drift Ip deviation" UWORD Compu_UEGO3_drift_PI_dmean 0 0 0 99.9984741210938 ECU_ADDRESS 0x0100E130 /end MEASUREMENT
/begin COMPU_METHOD Compu_UEGO3_drift_PI_dmean " " RAT_FUNC "%.2" "%" COEFFS 0 655.36 0 0 0 1 /end COMPU_METHOD
/begin MEASUREMENT UEGO3_drift_Terror "UEGO drift CL heater error" SWORD Compu_UEGO3_drift_Terror 0 0 -8192 8191.75 ECU_ADDRESS 0x0100E138 /end MEASUREMENT
/begin COMPU_METHOD Compu_UEGO3_drift_Terror " " RAT_FUNC "%.1" "deg C" COEFFS 0 4 0 0 0 1 /end COMPU_METHOD
/begin MEASUREMENT UEGO3_drift_air_err "UEGO drift air sample error" SWORD Compu_UEGO3_drift_air_err 0 0 -100 99.9969482421875 ECU_ADDRESS 0x0100E140 /end MEASUREMENT
/begin COMPU_METHOD Compu_UEGO3_drift_air_err " " RAT_FUNC "%.2" "%" COEFFS 0 327.68 0 0 0 1 /end COMPU_METHOD
/begin MEASUREMENT UEGO3_drift_leak_err "UEGO drift sample leak" SWORD Compu_UEGO3_drift_leak_err 0 0 -100 99.9969482421875 ECU_ADDRESS 0x0100E148 /end MEASUREMENT
/begin COMPU_METHOD Compu_UEGO3_drift_leak_err " " RAT_FUNC "%.2" "% Ip" COEFFS 0 327.68 0 0 0 1 /end COMPU_METHOD
/begin MEASUREMENT UEGO3_drift_error "UEGO drift final error" SWORD Compu_UEGO3_drift_error 0 0 -100 99.9969482421875 ECU_ADDRESS 0x0100E158 /end MEASUREMENT
/begin COMPU_METHOD Compu_UEGO3_drift_error " " RAT_FUNC "%.2" "% Ip" COEFFS 0 327.68 0 0 0 1 /end COMPU_METHOD
/begin CHARACTERISTIC UEGO4_config "UEGO4 configuration{UEGO4_config&0xff=0:Not Present}{UEGO4_config&0xff=1:Internal Hardware}{UEGO4_config&0xff=2:Aux PD1}{UEGO4_config&0xff=3:Aux PD2}{UEGO4_config&0xff=4:Aux PD3}{UEGO4_config&0xff=5:Aux PU1}{UEGO4_config&0xff=6:Aux PU2}{UEGO4_config&0xff=" VALUE 0x001C8F7E /* @ECU_Address@UEGO4_config@0x0100E1A8@ */ ECIPP_ALIGNMENT_UBYTE 255 UEGO4_config_COMPU_VTAB 0 255 BIT_MASK 0xff /end CHARACTERISTIC
/begin COMPU_METHOD UEGO4_config_COMPU_VTAB "Verbal Table" TAB_VERB "%.0" "list" COMPU_TAB_REF UEGO4_config_COMPU_VTAB_REF /end COMPU_METHOD
/begin COMPU_VTAB UEGO4_config_COMPU_VTAB_REF "Verbal Table" TAB_VERB 37 0 "Not Present" 1 "Internal Hardware" 2 "Aux PD1" 3 "Aux PD2" 4 "Aux PD3" 5 "Aux PU1" 6 "Aux PU2" 7 "Aux PU3" 8 "Aux PUD1" 9 "Aux PUD2" 10 "Aux PUD3" 11 "Aux PUD4" 12 "Aux PUD5" 13 "Aux PUD6" 14 "Aux PUD7" 15 "Aux PUD8" 16 "Aux PUD9" 17 "Aux PUD10" 18 "Aux PUD11" 19 "Aux PUD12" 20 "Aux PUD13" 21 "Aux PUD14" 22 "Aux PUD15" 23 "Aux PUD16" 24 "Aux PUD17" 25 "Aux PUD18" 26 "Aux PUD19" 27 "Aux PUD20" 28 "Aux PUD21" 29 "Aux PUD22" 30 "Aux PUD23" 31 "Aux PUD24" 32 "Aux PUD25" 33 "CAN - NTK1" 34 "CAN - NTK2" 35 "CAN - NTK3" 36 "CAN - NTK intake" DEFAULT_VALUE "UNKNOWN" /end COMPU_VTAB
/begin CHARACTERISTIC UEGO4_sensor_slct "UEGO4 sensor type{UEGO4_sensor_slct&0xff=0:Default}{UEGO4_sensor_slct&0xff=1:Bosch LSU 4.9}{UEGO4_sensor_slct&0xff=2:NTK 6312}{UEGO4_sensor_slct&0xff=3:NTK ZFAS-U2 Exh}{UEGO4_sensor_slct&0xff=4:NTK ZFAS-U2 Int}" VALUE 0x001C8F82 /* @ECU_Address@UEGO4_sensor_slct@0x0100E1B0@ */ ECIPP_ALIGNMENT_UBYTE 255 UEGO4_sensor_slct_COMPU_VTAB 0 255 BIT_MASK 0xff /end CHARACTERISTIC
/begin COMPU_METHOD UEGO4_sensor_slct_COMPU_VTAB "Verbal Table" TAB_VERB "%.0" "list" COMPU_TAB_REF UEGO4_sensor_slct_COMPU_VTAB_REF /end COMPU_METHOD
/begin COMPU_VTAB UEGO4_sensor_slct_COMPU_VTAB_REF "Verbal Table" TAB_VERB 5 0 "Default" 1 "Bosch LSU 4.9" 2 "NTK 6312" 3 "NTK ZFAS-U2 Exh" 4 "NTK ZFAS-U2 Int" DEFAULT_VALUE "UNKNOWN" /end COMPU_VTAB
/begin MEASUREMENT UEGO4_sensor_type "UEGO4 sensor type{UEGO4_sensor_type&0xff=0:None}{UEGO4_sensor_type&0xff=1:Bosch LSU 4.9}{UEGO4_sensor_type&0xff=2:NTK 6312}{UEGO4_sensor_type&0xff=3:NTK ZFAS-U2 Exh}{UEGO4_sensor_type&0xff=4:NTK ZFAS-U2 Int}" UBYTE UEGO4_sensor_type_COMPU_VTAB 0 0 0 255 ECU_ADDRESS 0x0100E1B8 BIT_MASK 0xff /end MEASUREMENT
/begin COMPU_METHOD UEGO4_sensor_type_COMPU_VTAB "Verbal Table" TAB_VERB "%.0" "list" COMPU_TAB_REF UEGO4_sensor_type_COMPU_VTAB_REF /end COMPU_METHOD
/begin COMPU_VTAB UEGO4_sensor_type_COMPU_VTAB_REF "Verbal Table" TAB_VERB 5 0 "None" 1 "Bosch LSU 4.9" 2 "NTK 6312" 3 "NTK ZFAS-U2 Exh" 4 "NTK ZFAS-U2 Int" DEFAULT_VALUE "UNKNOWN" /end COMPU_VTAB
/begin MEASUREMENT Phi_UEGO4_raw "UEGO Phi uncorrected" UWORD Compu_Phi_UEGO4_raw 0 0 0 3.99993896484375 ECU_ADDRESS 0x0100E1D0 /end MEASUREMENT
/begin COMPU_METHOD Compu_Phi_UEGO4_raw " " RAT_FUNC "%.3" "phi" COEFFS 0 16384 0 0 0 1 /end COMPU_METHOD
/begin MEASUREMENT AF_UEGO4 "UEGO A/F ratio" UWORD Compu_AF_UEGO4 0 0 0 63.9990234375 ECU_ADDRESS 0x0100E1E0 /end MEASUREMENT
/begin COMPU_METHOD Compu_AF_UEGO4 " " RAT_FUNC "%.2" "A/F ratio" COEFFS 0 1024 0 0 0 1 /end COMPU_METHOD
/begin MEASUREMENT UEGO4_drift_state "UEGO drift state{UEGO4_drift_state&0xff=0:Disabled}{UEGO4_drift_state&0xff=1:UEGO run wait}{UEGO4_drift_state&0xff=2:ECT low}{UEGO4_drift_state&0xff=3:FT low}{UEGO4_drift_state&0xff=4:Exhaust braking}{UEGO4_drift_state&0xff=5:Recovery wait}{UEGO4_drift_st" UBYTE UEGO4_drift_state_COMPU_VTAB 0 0 0 255 ECU_ADDRESS 0x0100E1E8 BIT_MASK 0xff /end MEASUREMENT
/begin COMPU_METHOD UEGO4_drift_state_COMPU_VTAB "Verbal Table" TAB_VERB "%.0" "list" COMPU_TAB_REF UEGO4_drift_state_COMPU_VTAB_REF /end COMPU_METHOD
/begin COMPU_VTAB UEGO4_drift_state_COMPU_VTAB_REF "Verbal Table" TAB_VERB 17 0 "Disabled" 1 "UEGO run wait" 2 "ECT low" 3 "FT low" 4 "Exhaust braking" 5 "Recovery wait" 6 "Env. sensor fault" 7 "7 - Reserved" 8 "8 - Reserved" 9 "9 - Reserved" 10 "Idle" 11 "Stabilizing" 12 "Trans delay wait" 13 "Initializing samples" 14 "Sampling" 15 "Validating" 16 "Success" DEFAULT_VALUE "UNKNOWN" /end COMPU_VTAB
/begin MEASUREMENT UEGO4_drift_PI_dmean "UEGO drift Ip deviation" UWORD Compu_UEGO4_drift_PI_dmean 0 0 0 99.9984741210938 ECU_ADDRESS 0x0100E208 /end MEASUREMENT
/begin COMPU_METHOD Compu_UEGO4_drift_PI_dmean " " RAT_FUNC "%.2" "%" COEFFS 0 655.36 0 0 0 1 /end COMPU_METHOD
/begin MEASUREMENT UEGO4_drift_Terror "UEGO drift CL heater error" SWORD Compu_UEGO4_drift_Terror 0 0 -8192 8191.75 ECU_ADDRESS 0x0100E210 /end MEASUREMENT
/begin COMPU_METHOD Compu_UEGO4_drift_Terror " " RAT_FUNC "%.1" "deg C" COEFFS 0 4 0 0 0 1 /end COMPU_METHOD
/begin MEASUREMENT UEGO4_drift_air_err "UEGO drift air sample error" SWORD Compu_UEGO4_drift_air_err 0 0 -100 99.9969482421875 ECU_ADDRESS 0x0100E218 /end MEASUREMENT
/begin COMPU_METHOD Compu_UEGO4_drift_air_err " " RAT_FUNC "%.2" "%" COEFFS 0 327.68 0 0 0 1 /end COMPU_METHOD
/begin MEASUREMENT UEGO4_drift_leak_err "UEGO drift sample leak" SWORD Compu_UEGO4_drift_leak_err 0 0 -100 99.9969482421875 ECU_ADDRESS 0x0100E220 /end MEASUREMENT
/begin COMPU_METHOD Compu_UEGO4_drift_leak_err " " RAT_FUNC "%.2" "% Ip" COEFFS 0 327.68 0 0 0 1 /end COMPU_METHOD
/begin MEASUREMENT UEGO4_drift_error "UEGO drift final error" SWORD Compu_UEGO4_drift_error 0 0 -100 99.9969482421875 ECU_ADDRESS 0x0100E230 /end MEASUREMENT
/begin COMPU_METHOD Compu_UEGO4_drift_error " " RAT_FUNC "%.2" "% Ip" COEFFS 0 327.68 0 0 0 1 /end COMPU_METHOD
/begin CHARACTERISTIC UEGON_EBP_ena "UEGO EBP correction{UEGON_EBP_ena&0xff=0:Disabled}{UEGON_EBP_ena&0xff=1:Delta-P Mode (Legacy)}{UEGON_EBP_ena&0xff=2:Pressure Ratio Mode}{UEGON_EBP_ena&0xff=3:MFG Provided}" VALUE 0x001CA3FE /* @ECU_Address@UEGON_EBP_ena@0x0100E330@ */ ECIPP_ALIGNMENT_UBYTE 255 UEGON_EBP_ena_COMPU_VTAB 0 255 BIT_MASK 0xff /end CHARACTERISTIC
/begin COMPU_METHOD UEGON_EBP_ena_COMPU_VTAB "Verbal Table" TAB_VERB "%.0" "list" COMPU_TAB_REF UEGON_EBP_ena_COMPU_VTAB_REF /end COMPU_METHOD
/begin COMPU_VTAB UEGON_EBP_ena_COMPU_VTAB_REF "Verbal Table" TAB_VERB 4 0 "Disabled" 1 "Delta-P Mode (Legacy)" 2 "Pressure Ratio Mode" 3 "MFG Provided" DEFAULT_VALUE "UNKNOWN" /end COMPU_VTAB
/begin CHARACTERISTIC UEGON_EBP_C "UEGO EBP dP mode C" VALUE 0x001CA400 /* @ECU_Address@UEGON_EBP_C@0x0100E338@ */ ECIPP_ALIGNMENT_FLOAT32_IEEE 10000000000 Compu_UEGON_EBP_C -10000000000 10000000000 /end CHARACTERISTIC
/begin COMPU_METHOD Compu_UEGON_EBP_C " " RAT_FUNC "%.3" "dphi / psi" COEFFS 0 1 0 0 0 1 /end COMPU_METHOD
/begin CHARACTERISTIC UEGON_EBP_Klean "UEGO EBP PR mode Klean" VALUE 0x001CA406 /* @ECU_Address@UEGON_EBP_Klean@0x0100E340@ */ ECIPP_ALIGNMENT_UWORD 256 Compu_UEGON_EBP_Klean 0 255.99609375 /end CHARACTERISTIC
/begin COMPU_METHOD Compu_UEGON_EBP_Klean " " RAT_FUNC "%.2" "psi" COEFFS 0 256 0 0 0 1 /end COMPU_METHOD
/begin CHARACTERISTIC UEGON_EBP_Krich "UEGO EBP PR mode Krich" VALUE 0x001CA408 /* @ECU_Address@UEGON_EBP_Krich@0x0100E348@ */ ECIPP_ALIGNMENT_UWORD 256 Compu_UEGON_EBP_Krich 0 255.99609375 /end CHARACTERISTIC
/begin COMPU_METHOD Compu_UEGON_EBP_Krich " " RAT_FUNC "%.2" "psi" COEFFS 0 256 0 0 0 1 /end COMPU_METHOD
/begin CHARACTERISTIC UEGON_EBP_EBPo "UEGO EBP PR mode EBPs" VALUE 0x001CA404 /* @ECU_Address@UEGON_EBP_EBPo@0x0100E350@ */ ECIPP_ALIGNMENT_UWORD 256 Compu_UEGON_EBP_EBPo 0 255.99609375 /end CHARACTERISTIC
/begin COMPU_METHOD Compu_UEGON_EBP_EBPo " " RAT_FUNC "%.2" "psia" COEFFS 0 256 0 0 0 1 /end COMPU_METHOD
/begin MEASUREMENT UEGO4_CAN_PI_mA "UEGO4 CAN pump current" SWORD Compu_UEGO4_CAN_PI_mA 0 0 -32 31.9990234375 ECU_ADDRESS 0x0100EF30 /end MEASUREMENT
/begin COMPU_METHOD Compu_UEGO4_CAN_PI_mA " " RAT_FUNC "%.3" "mA" COEFFS 0 1024 0 0 0 1 /end COMPU_METHOD
/begin MEASUREMENT UEGO4_CAN_O2_pct "UEGO4 CAN O2 percent" SWORD Compu_UEGO4_CAN_O2_pct 0 0 -100 99.9969482421875 ECU_ADDRESS 0x0100EF38 /end MEASUREMENT
/begin COMPU_METHOD Compu_UEGO4_CAN_O2_pct " " RAT_FUNC "%.2" "%" COEFFS 0 327.68 0 0 0 1 /end COMPU_METHOD
/begin MEASUREMENT UEGO4_CAN_stable "UEGO4 CAN status{UEGO4_CAN_stable&0xc0=0x00:Not Stable}{UEGO4_CAN_stable&0xc0=0x40:Stable}{UEGO4_CAN_stable&0xc0=0x80:Error}{UEGO4_CAN_stable&0xc0=0xc0:Not Available}" UBYTE UEGO4_CAN_stable_COMPU_VTAB 0 0 0 255 ECU_ADDRESS 0x0100EF40 BIT_MASK 0xc0 /end MEASUREMENT
/begin COMPU_METHOD UEGO4_CAN_stable_COMPU_VTAB "Verbal Table" TAB_VERB "%.0" "list" COMPU_TAB_REF UEGO4_CAN_stable_COMPU_VTAB_REF /end COMPU_METHOD
/begin COMPU_VTAB UEGO4_CAN_stable_COMPU_VTAB_REF "Verbal Table" TAB_VERB 4 0x00 "Not Stable" 0x40 "Stable" 0x80 "Error" 0xc0 "Not Available" DEFAULT_VALUE "UNKNOWN" /end COMPU_VTAB
/begin MEASUREMENT UEGO4_CAN_compfail "UEGO4 CAN component fault{UEGO4_CAN_compfail&0x20=0x00:OK}{UEGO4_CAN_compfail&0x20=0x20:Fault}" UBYTE UEGO4_CAN_compfail_COMPU_VTAB 0 0 0 255 ECU_ADDRESS 0x0100EF48 BIT_MASK 0x20 /end MEASUREMENT
/begin COMPU_METHOD UEGO4_CAN_compfail_COMPU_VTAB "Verbal Table" TAB_VERB "%.0" "list" COMPU_TAB_REF UEGO4_CAN_compfail_COMPU_VTAB_REF /end COMPU_METHOD
/begin COMPU_VTAB UEGO4_CAN_compfail_COMPU_VTAB_REF "Verbal Table" TAB_VERB 2 0x00 "OK" 0x20 "Fault" DEFAULT_VALUE "UNKNOWN" /end COMPU_VTAB
/begin MEASUREMENT UEGO4_CAN_circThi "UEGO4 CAN circ T fault{UEGO4_CAN_circThi&0x10=0x00:OK}{UEGO4_CAN_circThi&0x10=0x10:Fault}" UBYTE UEGO4_CAN_circThi_COMPU_VTAB 0 0 0 255 ECU_ADDRESS 0x0100EF50 BIT_MASK 0xFF /end MEASUREMENT
/begin COMPU_METHOD UEGO4_CAN_circThi_COMPU_VTAB "Verbal Table" TAB_VERB "%.0" "list" COMPU_TAB_REF UEGO4_CAN_circThi_COMPU_VTAB_REF /end COMPU_METHOD
/begin COMPU_VTAB UEGO4_CAN_circThi_COMPU_VTAB_REF "Verbal Table" TAB_VERB 2 0x00 "OK" 0x10 "Fault" DEFAULT_VALUE "Unsupported Bit_Shift" /end COMPU_VTAB
/begin MEASUREMENT UEGO4_CAN_heatfail "UEGO4 CAN heater fault{UEGO4_CAN_heatfail&0x08=0x00:OK}{UEGO4_CAN_heatfail&0x08=0x08:Fault}" UBYTE UEGO4_CAN_heatfail_COMPU_VTAB 0 0 0 255 ECU_ADDRESS 0x0100EF58 BIT_MASK 0x08 /end MEASUREMENT
/begin COMPU_METHOD UEGO4_CAN_heatfail_COMPU_VTAB "Verbal Table" TAB_VERB "%.0" "list" COMPU_TAB_REF UEGO4_CAN_heatfail_COMPU_VTAB_REF /end COMPU_METHOD
/begin COMPU_VTAB UEGO4_CAN_heatfail_COMPU_VTAB_REF "Verbal Table" TAB_VERB 2 0x00 "OK" 0x08 "Fault" DEFAULT_VALUE "UNKNOWN" /end COMPU_VTAB
/begin MEASUREMENT UEGO4_CAN_TxRxfail "UEGO4 CAN Tx/Rx fault{UEGO4_CAN_TxRxfail&0x04=0x00:OK}{UEGO4_CAN_TxRxfail&0x04=0x04:Fault}" UBYTE UEGO4_CAN_TxRxfail_COMPU_VTAB 0 0 0 255 ECU_ADDRESS 0x0100EF60 BIT_MASK 0x04 /end MEASUREMENT
/begin COMPU_METHOD UEGO4_CAN_TxRxfail_COMPU_VTAB "Verbal Table" TAB_VERB "%.0" "list" COMPU_TAB_REF UEGO4_CAN_TxRxfail_COMPU_VTAB_REF /end COMPU_METHOD
/begin COMPU_VTAB UEGO4_CAN_TxRxfail_COMPU_VTAB_REF "Verbal Table" TAB_VERB 2 0x00 "OK" 0x04 "Fault" DEFAULT_VALUE "UNKNOWN" /end COMPU_VTAB
/begin MEASUREMENT UEGO4_CAN_Vbatlo "UEGO4 CAN battery low{UEGO4_CAN_Vbatlo&0x02=0x00:OK}{UEGO4_CAN_Vbatlo&0x02=0x02:Fault}" UBYTE UEGO4_CAN_Vbatlo_COMPU_VTAB 0 0 0 255 ECU_ADDRESS 0x0100EF68 BIT_MASK 0x02 /end MEASUREMENT
/begin COMPU_METHOD UEGO4_CAN_Vbatlo_COMPU_VTAB "Verbal Table" TAB_VERB "%.0" "list" COMPU_TAB_REF UEGO4_CAN_Vbatlo_COMPU_VTAB_REF /end COMPU_METHOD
/begin COMPU_VTAB UEGO4_CAN_Vbatlo_COMPU_VTAB_REF "Verbal Table" TAB_VERB 2 0x00 "OK" 0x02 "Fault" DEFAULT_VALUE "UNKNOWN" /end COMPU_VTAB
/begin MEASUREMENT UEGO4_CAN_Vbathi "UEGO4 CAN battery high{UEGO4_CAN_Vbathi&0x01=0x00:OK}{UEGO4_CAN_Vbathi&0x01=0x01:Fault}" UBYTE UEGO4_CAN_Vbathi_COMPU_VTAB 0 0 0 255 ECU_ADDRESS 0x0100EF70 BIT_MASK 0x01 /end MEASUREMENT
/begin COMPU_METHOD UEGO4_CAN_Vbathi_COMPU_VTAB "Verbal Table" TAB_VERB "%.0" "list" COMPU_TAB_REF UEGO4_CAN_Vbathi_COMPU_VTAB_REF /end COMPU_METHOD
/begin COMPU_VTAB UEGO4_CAN_Vbathi_COMPU_VTAB_REF "Verbal Table" TAB_VERB 2 0x00 "OK" 0x01 "Fault" DEFAULT_VALUE "UNKNOWN" /end COMPU_VTAB
/begin CHARACTERISTIC UEGO_alt_config "UEGO alt configuration{UEGO_alt_config&0xff=0x00:Disabled}{UEGO_alt_config&0xff=0x01:Enabled}" VALUE 0x001C8F75 /* @ECU_Address@UEGO_alt_config@0x0100EF78@ */ ECIPP_ALIGNMENT_UBYTE 255 UEGO_alt_config_COMPU_VTAB 0 255 BIT_MASK 0xff /end CHARACTERISTIC
/begin COMPU_METHOD UEGO_alt_config_COMPU_VTAB "Verbal Table" TAB_VERB "%.0" "list" COMPU_TAB_REF UEGO_alt_config_COMPU_VTAB_REF /end COMPU_METHOD
/begin COMPU_VTAB UEGO_alt_config_COMPU_VTAB_REF "Verbal Table" TAB_VERB 2 0x00 "Disabled" 0x01 "Enabled" DEFAULT_VALUE "UNKNOWN" /end COMPU_VTAB
/begin CHARACTERISTIC UEGO2_alt_config "UEGO2 alt configuration{UEGO2_alt_config&0xff=0x00:Disabled}{UEGO2_alt_config&0xff=0x01:Enabled}" VALUE 0x001C8F76 /* @ECU_Address@UEGO2_alt_config@0x0100EF80@ */ ECIPP_ALIGNMENT_UBYTE 255 UEGO2_alt_config_COMPU_VTAB 0 255 BIT_MASK 0xff /end CHARACTERISTIC
/begin COMPU_METHOD UEGO2_alt_config_COMPU_VTAB "Verbal Table" TAB_VERB "%.0" "list" COMPU_TAB_REF UEGO2_alt_config_COMPU_VTAB_REF /end COMPU_METHOD
/begin COMPU_VTAB UEGO2_alt_config_COMPU_VTAB_REF "Verbal Table" TAB_VERB 2 0x00 "Disabled" 0x01 "Enabled" DEFAULT_VALUE "UNKNOWN" /end COMPU_VTAB
/begin MEASUREMENT UEGO_alt_slct "UEGO alt sensor type{UEGO_alt_slct&0xff=0:Default}{UEGO_alt_slct&0xff=1:Bosch LSU 4.9}{UEGO_alt_slct&0xff=2:NTK 6312}{UEGO_alt_slct&0xff=3:NTK ZFAS-U2 Exh}{UEGO_alt_slct&0xff=4:NTK ZFAS-U2 Int}" UBYTE UEGO_alt_slct_COMPU_VTAB 0 0 0 255 ECU_ADDRESS 0x0100EF88 BIT_MASK 0xff /end MEASUREMENT
/begin COMPU_METHOD UEGO_alt_slct_COMPU_VTAB "Verbal Table" TAB_VERB "%.0" "list" COMPU_TAB_REF UEGO_alt_slct_COMPU_VTAB_REF /end COMPU_METHOD
/begin COMPU_VTAB UEGO_alt_slct_COMPU_VTAB_REF "Verbal Table" TAB_VERB 5 0 "Default" 1 "Bosch LSU 4.9" 2 "NTK 6312" 3 "NTK ZFAS-U2 Exh" 4 "NTK ZFAS-U2 Int" DEFAULT_VALUE "UNKNOWN" /end COMPU_VTAB
/begin MEASUREMENT UEGO2_alt_slct "UEGO2 alt sensor type{UEGO2_alt_slct&0xff=0:Default}{UEGO2_alt_slct&0xff=1:Bosch LSU 4.9}{UEGO2_alt_slct&0xff=2:NTK 6312}{UEGO2_alt_slct&0xff=3:NTK ZFAS-U2 Exh}{UEGO2_alt_slct&0xff=4:NTK ZFAS-U2 Int}" UBYTE UEGO2_alt_slct_COMPU_VTAB 0 0 0 255 ECU_ADDRESS 0x0100EF90 BIT_MASK 0xff /end MEASUREMENT
/begin COMPU_METHOD UEGO2_alt_slct_COMPU_VTAB "Verbal Table" TAB_VERB "%.0" "list" COMPU_TAB_REF UEGO2_alt_slct_COMPU_VTAB_REF /end COMPU_METHOD
/begin COMPU_VTAB UEGO2_alt_slct_COMPU_VTAB_REF "Verbal Table" TAB_VERB 5 0 "Default" 1 "Bosch LSU 4.9" 2 "NTK 6312" 3 "NTK ZFAS-U2 Exh" 4 "NTK ZFAS-U2 Int" DEFAULT_VALUE "UNKNOWN" /end COMPU_VTAB
/begin CHARACTERISTIC UEGOH_strt_dly_cmd "UEGO heater volt during start delay" VALUE 0x001c82d8 /* @ECU_Address@UEGOH_strt_dly_cmd@0x0100F620@ */ ECIPP_ALIGNMENT_UWORD 66 Compu_UEGOH_strt_dly_cmd 0 65.535 /end CHARACTERISTIC
/begin COMPU_METHOD Compu_UEGOH_strt_dly_cmd " " RAT_FUNC "%.1" "volts" COEFFS 0 1000 0 0 0 1 /end COMPU_METHOD
/begin MEASUREMENT UEGO1_CAN_PI_mA_crct "UEGO1 CAN-based Exhaust Ip crct" SWORD Compu_UEGO1_CAN_PI_mA_crct 0 0 -32 31.9990234375 ECU_ADDRESS 0x0100F630 /end MEASUREMENT
/begin COMPU_METHOD Compu_UEGO1_CAN_PI_mA_crct " " RAT_FUNC "%.2" "mA" COEFFS 0 1024 0 0 0 1 /end COMPU_METHOD
/begin MEASUREMENT UEGO4_CAN_PI_mA_crct "UEGO4 CAN-based Intake Ip crct" SWORD Compu_UEGO4_CAN_PI_mA_crct 0 0 -32 31.9990234375 ECU_ADDRESS 0x0100F638 /end MEASUREMENT
/begin COMPU_METHOD Compu_UEGO4_CAN_PI_mA_crct " " RAT_FUNC "%.2" "mA" COEFFS 0 1024 0 0 0 1 /end COMPU_METHOD
/begin CHARACTERISTIC UEGOH_SD_KOFF_tout "UEGO heater on at key off engine stop" VALUE 0x001c43dc /* @ECU_Address@UEGOH_SD_KOFF_tout@0x0100F8B8@ */ ECIPP_ALIGNMENT_ULONG 4294967 Compu_UEGOH_SD_KOFF_tout 0 4294967.295 /end CHARACTERISTIC
/begin COMPU_METHOD Compu_UEGOH_SD_KOFF_tout " " RAT_FUNC "%.1" "sec" COEFFS 0 1000 0 0 0 1 /end COMPU_METHOD
/begin MEASUREMENT UEGOH_SD_KOFF_tmr "UEGO heater on at key off engine stop" ULONG Compu_UEGOH_SD_KOFF_tmr 0 0 0 4294967.295 ECU_ADDRESS 0x0100F8C0 /end MEASUREMENT
/begin COMPU_METHOD Compu_UEGOH_SD_KOFF_tmr " " RAT_FUNC "%.1" "sec" COEFFS 0 1000 0 0 0 1 /end COMPU_METHOD
/begin CHARACTERISTIC UEGOH_strt_PP_prH "Pre/Post UEGO Preheat delay start{UEGOH_strt_PP_prH&0xff=0x00:Time from start}{UEGOH_strt_PP_prH&0xff=0x01:Time after DP}" VALUE 0x001c8f74 /* @ECU_Address@UEGOH_strt_PP_prH@0x0100F8C8@ */ ECIPP_ALIGNMENT_UBYTE 255 UEGOH_strt_PP_prH_COMPU_VTAB 0 255 BIT_MASK 0xff /end CHARACTERISTIC
/begin COMPU_METHOD UEGOH_strt_PP_prH_COMPU_VTAB "Verbal Table" TAB_VERB "%.0" "list" COMPU_TAB_REF UEGOH_strt_PP_prH_COMPU_VTAB_REF /end COMPU_METHOD
/begin COMPU_VTAB UEGOH_strt_PP_prH_COMPU_VTAB_REF "Verbal Table" TAB_VERB 2 0x00 "Time from start" 0x01 "Time after DP" DEFAULT_VALUE "UNKNOWN" /end COMPU_VTAB
/begin CHARACTERISTIC UEGOH_strt_EGR_prH "EGR UEGO Preheat delay start{UEGOH_strt_EGR_prH&0xff=0x00:Time from start}{UEGOH_strt_EGR_prH&0xff=0x01:Time after DP}" VALUE 0x001c8f73 /* @ECU_Address@UEGOH_strt_EGR_prH@0x0100F8D0@ */ ECIPP_ALIGNMENT_UBYTE 255 UEGOH_strt_EGR_prH_COMPU_VTAB 0 255 BIT_MASK 0xff /end CHARACTERISTIC
/begin COMPU_METHOD UEGOH_strt_EGR_prH_COMPU_VTAB "Verbal Table" TAB_VERB "%.0" "list" COMPU_TAB_REF UEGOH_strt_EGR_prH_COMPU_VTAB_REF /end COMPU_METHOD
/begin COMPU_VTAB UEGOH_strt_EGR_prH_COMPU_VTAB_REF "Verbal Table" TAB_VERB 2 0x00 "Time from start" 0x01 "Time after DP" DEFAULT_VALUE "UNKNOWN" /end COMPU_VTAB
/begin MEASUREMENT UEGO1_dewpt "UEGO1 dew point" FLOAT32_IEEE Compu_UEGO1_dewpt 0 0 -10000000000 10000000000 ECU_ADDRESS 0x0100F938 /end MEASUREMENT
/begin COMPU_METHOD Compu_UEGO1_dewpt " " RAT_FUNC "%.2" "deg F" COEFFS 0 1 460 0 0 1 /end COMPU_METHOD
/begin MEASUREMENT UEGO2_dewpt "UEGO2 dew point" FLOAT32_IEEE Compu_UEGO2_dewpt 0 0 -10000000000 10000000000 ECU_ADDRESS 0x0100F940 /end MEASUREMENT
/begin COMPU_METHOD Compu_UEGO2_dewpt " " RAT_FUNC "%.2" "deg F" COEFFS 0 1 460 0 0 1 /end COMPU_METHOD
/begin MEASUREMENT UEGO3_dewpt "UEGO3 dew point" FLOAT32_IEEE Compu_UEGO3_dewpt 0 0 -10000000000 10000000000 ECU_ADDRESS 0x0100F948 /end MEASUREMENT
/begin COMPU_METHOD Compu_UEGO3_dewpt " " RAT_FUNC "%.2" "deg F" COEFFS 0 1 460 0 0 1 /end COMPU_METHOD
/begin MEASUREMENT UEGO4_dewpt "UEGO4 dew point" FLOAT32_IEEE Compu_UEGO4_dewpt 0 0 -10000000000 10000000000 ECU_ADDRESS 0x0100F950 /end MEASUREMENT
/begin COMPU_METHOD Compu_UEGO4_dewpt " " RAT_FUNC "%.2" "deg F" COEFFS 0 1 460 0 0 1 /end COMPU_METHOD
/begin MEASUREMENT AAT_UEGO_PHstart "Ambient air temperature at start" UWORD Compu_AAT_UEGO_PHstart 0 0 -460 563.984375 ECU_ADDRESS 0x0100F958 /end MEASUREMENT
/begin COMPU_METHOD Compu_AAT_UEGO_PHstart " " RAT_FUNC "%.1" "deg F" COEFFS 0 64 29440 0 0 1 /end COMPU_METHOD
/begin MEASUREMENT UEGOH_preheat_PP "UEGO heater preheat period" UWORD Compu_UEGOH_preheat_PP 0 0 0 65535 ECU_ADDRESS 0x0100F960 /end MEASUREMENT
/begin COMPU_METHOD Compu_UEGOH_preheat_PP " " RAT_FUNC "%.0" "sec" COEFFS 0 1 0 0 0 1 /end COMPU_METHOD
/begin MEASUREMENT UEGOH_preheat_EGR "UEGO heater EGR preheat period" UWORD Compu_UEGOH_preheat_EGR 0 0 0 65535 ECU_ADDRESS 0x0100F968 /end MEASUREMENT
/begin COMPU_METHOD Compu_UEGOH_preheat_EGR " " RAT_FUNC "%.0" "sec" COEFFS 0 1 0 0 0 1 /end COMPU_METHOD
/begin CHARACTERISTIC UEGO_lo_pwr_set "UEGO ASIC low pwr set" VALUE 0x001c82e8 /* @ECU_Address@UEGO_lo_pwr_set@0x010104C0@ */ ECIPP_ALIGNMENT_UWORD 256 Compu_UEGO_lo_pwr_set 0 255.99609375 /end CHARACTERISTIC
/begin COMPU_METHOD Compu_UEGO_lo_pwr_set " " RAT_FUNC "%.1" "volts" COEFFS 0 256 0 0 0 1 /end COMPU_METHOD
/begin CHARACTERISTIC UEGO_lo_pwr_reset "UEGO ASIC low pwr reset" VALUE 0x001c82e6 /* @ECU_Address@UEGO_lo_pwr_reset@0x010104C8@ */ ECIPP_ALIGNMENT_UWORD 256 Compu_UEGO_lo_pwr_reset 0 255.99609375 /end CHARACTERISTIC
/begin COMPU_METHOD Compu_UEGO_lo_pwr_reset " " RAT_FUNC "%.1" "volts" COEFFS 0 256 0 0 0 1 /end COMPU_METHOD
/begin CHARACTERISTIC UEGOH_dewpt_offset "UEGO preheat dew point offset" VALUE 0x001c82d6 /* @ECU_Address@UEGOH_dewpt_offset@0x01010B28@ */ ECIPP_ALIGNMENT_UWORD 1024 Compu_UEGOH_dewpt_offset 0 1023.984375 /end CHARACTERISTIC
/begin COMPU_METHOD Compu_UEGOH_dewpt_offset " " RAT_FUNC "%.1" "deg F" COEFFS 0 64 0 0 0 1 /end COMPU_METHOD
/begin CHARACTERISTIC NOx_hi_tau "NOx fault tau (Fault Condition:sample window tau)" VALUE 0x001c857c /* @ECU_Address@NOx_hi_tau@0x010118B0@ */ ECIPP_ALIGNMENT_UWORD 328 Compu_NOx_hi_tau 0.00045084 327.68 /end CHARACTERISTIC
/begin COMPU_METHOD Compu_NOx_hi_tau " " FORM "%.1" "sec"
 /begin FORMULA "-0.005 / log(1 - (X1 / 65536))" FORMULA_INV "(1 - exp(-0.005/X1)) * 65536" /end FORMULA
/end COMPU_METHOD
/begin MEASUREMENT NOx_ppm_filt "NOx fault window" ULONG Compu_NOx_ppm_filt 0 0 0 4095.99999904633 ECU_ADDRESS 0x010118C0 /end MEASUREMENT
/begin COMPU_METHOD Compu_NOx_ppm_filt " " RAT_FUNC "%.0" "ppm" COEFFS 0 1048576 0 0 0 1 /end COMPU_METHOD
/begin CHARACTERISTIC UEGO_bias_est_ena "Pre-cat UEGO rich bias est.{UEGO_bias_est_ena&0xff=0x00:Disabled}{UEGO_bias_est_ena&0xff=0x01:Enabled}" VALUE 0x001c8f77 /* @ECU_Address@UEGO_bias_est_ena@0x01012050@ */ ECIPP_ALIGNMENT_UBYTE 255 UEGO_bias_est_ena_COMPU_VTAB 0 255 BIT_MASK 0xff /end CHARACTERISTIC
/begin COMPU_METHOD UEGO_bias_est_ena_COMPU_VTAB "Verbal Table" TAB_VERB "%.0" "list" COMPU_TAB_REF UEGO_bias_est_ena_COMPU_VTAB_REF /end COMPU_METHOD
/begin COMPU_VTAB UEGO_bias_est_ena_COMPU_VTAB_REF "Verbal Table" TAB_VERB 2 0x00 "Disabled" 0x01 "Enabled" DEFAULT_VALUE "UNKNOWN" /end COMPU_VTAB
/begin CHARACTERISTIC UEGO_bias_est_tau "Sensor filter time constant" VALUE 0x001c863a /* @ECU_Address@UEGO_bias_est_tau@0x01012058@ */ ECIPP_ALIGNMENT_UWORD 328 Compu_UEGO_bias_est_tau 0.00045084 327.68 /end CHARACTERISTIC
/begin COMPU_METHOD Compu_UEGO_bias_est_tau " " FORM "%.1" "seconds"
 /begin FORMULA "-0.005 / log(1 - (X1 / 65536))" FORMULA_INV "(1 - exp(-0.005/X1)) * 65536" /end FORMULA
/end COMPU_METHOD
/begin CHARACTERISTIC UEGO_bias_est_max "Maximum applied rich bias" VALUE 0x001c82da /* @ECU_Address@UEGO_bias_est_max@0x01012060@ */ ECIPP_ALIGNMENT_UWORD 0 Compu_UEGO_bias_est_max 0 6.24990463256836E-02 /end CHARACTERISTIC
/begin COMPU_METHOD Compu_UEGO_bias_est_max " " RAT_FUNC "%.3" "phi" COEFFS 0 1048576 0 0 0 1 /end COMPU_METHOD
/begin MEASUREMENT UEGO_bias_est "Calculated rich bias" UWORD Compu_UEGO_bias_est 0 0 0 6.24990463256836E-02 ECU_ADDRESS 0x01012068 /end MEASUREMENT
/begin COMPU_METHOD Compu_UEGO_bias_est " " RAT_FUNC "%.3" "phi" COEFFS 0 1048576 0 0 0 1 /end COMPU_METHOD
/begin CHARACTERISTIC EGOHpost_pre_wt_mult "Post-cat EGO heater wait multiplier" VALUE 0x001c6edc /* @ECU_Address@EGOHpost_pre_wt_mult@0x01013618@ */ ECIPP_ALIGNMENT_UWORD 64 Compu_EGOHpost_pre_wt_mult 0 63.9990234375 /end CHARACTERISTIC
/begin COMPU_METHOD Compu_EGOHpost_pre_wt_mult " " RAT_FUNC "%.2" "multiplier" COEFFS 0 1024 0 0 0 1 /end COMPU_METHOD
/begin MEASUREMENT EGOHpost_wait_tm "Post-cat EGO heater wait time" ULONG Compu_EGOHpost_wait_tm 0 0 0 4294967.295 ECU_ADDRESS 0x01013620 /end MEASUREMENT
/begin COMPU_METHOD Compu_EGOHpost_wait_tm " " RAT_FUNC "%.1" "sec" COEFFS 0 1000 0 0 0 1 /end COMPU_METHOD
/begin MEASUREMENT EGOHpost_wait_tmr "Post-cat EGO heater wait timer" ULONG Compu_EGOHpost_wait_tmr 0 0 0 4294967.295 ECU_ADDRESS 0x01013628 /end MEASUREMENT
/begin COMPU_METHOD Compu_EGOHpost_wait_tmr " " RAT_FUNC "%.1" "sec" COEFFS 0 1000 0 0 0 1 /end COMPU_METHOD
/begin MEASUREMENT EGOHpost_run_tmr "Post-cat EGO heater timer" ULONG Compu_EGOHpost_run_tmr 0 0 0 4294967.295 ECU_ADDRESS 0x01013630 /end MEASUREMENT
/begin COMPU_METHOD Compu_EGOHpost_run_tmr " " RAT_FUNC "%.1" "sec" COEFFS 0 1000 0 0 0 1 /end COMPU_METHOD
/begin MEASUREMENT UEGO3_CAN_PI_mA "UEGO3 CAN pump current" SWORD Compu_UEGO3_CAN_PI_mA 0 0 -32 31.9990234375 ECU_ADDRESS 0x01013D08 /end MEASUREMENT
/begin COMPU_METHOD Compu_UEGO3_CAN_PI_mA " " RAT_FUNC "%.3" "mA" COEFFS 0 1024 0 0 0 1 /end COMPU_METHOD
/begin MEASUREMENT UEGO3_CAN_PI_mA_crct "UEGO3 CAN pump current (crct)" SWORD Compu_UEGO3_CAN_PI_mA_crct 0 0 -32 31.9990234375 ECU_ADDRESS 0x01013D10 /end MEASUREMENT
/begin COMPU_METHOD Compu_UEGO3_CAN_PI_mA_crct " " RAT_FUNC "%.3" "mA" COEFFS 0 1024 0 0 0 1 /end COMPU_METHOD
/begin MEASUREMENT UEGO3_CAN_O2_pct "UEGO3 CAN O2 percent" SWORD Compu_UEGO3_CAN_O2_pct 0 0 -100 99.9969482421875 ECU_ADDRESS 0x01013D18 /end MEASUREMENT
/begin COMPU_METHOD Compu_UEGO3_CAN_O2_pct " " RAT_FUNC "%.2" "%" COEFFS 0 327.68 0 0 0 1 /end COMPU_METHOD
/begin MEASUREMENT UEGO3_CAN_stable "UEGO3 CAN status{UEGO3_CAN_stable&0xc0=0x00:Not Stable}{UEGO3_CAN_stable&0xc0=0x40:Stable}{UEGO3_CAN_stable&0xc0=0x80:Error}{UEGO3_CAN_stable&0xc0=0xc0:Not Available}" UBYTE UEGO3_CAN_stable_COMPU_VTAB 0 0 0 255 ECU_ADDRESS 0x01013D20 BIT_MASK 0xc0 /end MEASUREMENT
/begin COMPU_METHOD UEGO3_CAN_stable_COMPU_VTAB "Verbal Table" TAB_VERB "%.0" "list" COMPU_TAB_REF UEGO3_CAN_stable_COMPU_VTAB_REF /end COMPU_METHOD
/begin COMPU_VTAB UEGO3_CAN_stable_COMPU_VTAB_REF "Verbal Table" TAB_VERB 4 0x00 "Not Stable" 0x40 "Stable" 0x80 "Error" 0xc0 "Not Available" DEFAULT_VALUE "UNKNOWN" /end COMPU_VTAB
/begin MEASUREMENT UEGO3_CAN_compfail "UEGO3 CAN component fault{UEGO3_CAN_compfail&0x20=0x00:OK}{UEGO3_CAN_compfail&0x20=0x20:Fault}" UBYTE UEGO3_CAN_compfail_COMPU_VTAB 0 0 0 255 ECU_ADDRESS 0x01013D28 BIT_MASK 0x20 /end MEASUREMENT
/begin COMPU_METHOD UEGO3_CAN_compfail_COMPU_VTAB "Verbal Table" TAB_VERB "%.0" "list" COMPU_TAB_REF UEGO3_CAN_compfail_COMPU_VTAB_REF /end COMPU_METHOD
/begin COMPU_VTAB UEGO3_CAN_compfail_COMPU_VTAB_REF "Verbal Table" TAB_VERB 2 0x00 "OK" 0x20 "Fault" DEFAULT_VALUE "UNKNOWN" /end COMPU_VTAB
/begin MEASUREMENT UEGO3_CAN_circThi "UEGO3 CAN circ T fault{UEGO3_CAN_circThi&0x10=0x00:OK}{UEGO3_CAN_circThi&0x10=0x10:Fault}" UBYTE UEGO3_CAN_circThi_COMPU_VTAB 0 0 0 255 ECU_ADDRESS 0x01013D30 BIT_MASK 0xFF /end MEASUREMENT
/begin COMPU_METHOD UEGO3_CAN_circThi_COMPU_VTAB "Verbal Table" TAB_VERB "%.0" "list" COMPU_TAB_REF UEGO3_CAN_circThi_COMPU_VTAB_REF /end COMPU_METHOD
/begin COMPU_VTAB UEGO3_CAN_circThi_COMPU_VTAB_REF "Verbal Table" TAB_VERB 2 0x00 "OK" 0x10 "Fault" DEFAULT_VALUE "Unsupported Bit_Shift" /end COMPU_VTAB
/begin MEASUREMENT UEGO3_CAN_heatfail "UEGO3 CAN heater fault{UEGO3_CAN_heatfail&0x08=0x00:OK}{UEGO3_CAN_heatfail&0x08=0x08:Fault}" UBYTE UEGO3_CAN_heatfail_COMPU_VTAB 0 0 0 255 ECU_ADDRESS 0x01013D38 BIT_MASK 0x08 /end MEASUREMENT
/begin COMPU_METHOD UEGO3_CAN_heatfail_COMPU_VTAB "Verbal Table" TAB_VERB "%.0" "list" COMPU_TAB_REF UEGO3_CAN_heatfail_COMPU_VTAB_REF /end COMPU_METHOD
/begin COMPU_VTAB UEGO3_CAN_heatfail_COMPU_VTAB_REF "Verbal Table" TAB_VERB 2 0x00 "OK" 0x08 "Fault" DEFAULT_VALUE "UNKNOWN" /end COMPU_VTAB
/begin MEASUREMENT UEGO3_CAN_TxRxfail "UEGO3 CAN Tx/Rx fault{UEGO3_CAN_TxRxfail&0x04=0x00:OK}{UEGO3_CAN_TxRxfail&0x04=0x04:Fault}" UBYTE UEGO3_CAN_TxRxfail_COMPU_VTAB 0 0 0 255 ECU_ADDRESS 0x01013D40 BIT_MASK 0x04 /end MEASUREMENT
/begin COMPU_METHOD UEGO3_CAN_TxRxfail_COMPU_VTAB "Verbal Table" TAB_VERB "%.0" "list" COMPU_TAB_REF UEGO3_CAN_TxRxfail_COMPU_VTAB_REF /end COMPU_METHOD
/begin COMPU_VTAB UEGO3_CAN_TxRxfail_COMPU_VTAB_REF "Verbal Table" TAB_VERB 2 0x00 "OK" 0x04 "Fault" DEFAULT_VALUE "UNKNOWN" /end COMPU_VTAB
/begin MEASUREMENT UEGO3_CAN_Vbatlo "UEGO3 CAN battery low{UEGO3_CAN_Vbatlo&0x02=0x00:OK}{UEGO3_CAN_Vbatlo&0x02=0x02:Fault}" UBYTE UEGO3_CAN_Vbatlo_COMPU_VTAB 0 0 0 255 ECU_ADDRESS 0x01013D48 BIT_MASK 0x02 /end MEASUREMENT
/begin COMPU_METHOD UEGO3_CAN_Vbatlo_COMPU_VTAB "Verbal Table" TAB_VERB "%.0" "list" COMPU_TAB_REF UEGO3_CAN_Vbatlo_COMPU_VTAB_REF /end COMPU_METHOD
/begin COMPU_VTAB UEGO3_CAN_Vbatlo_COMPU_VTAB_REF "Verbal Table" TAB_VERB 2 0x00 "OK" 0x02 "Fault" DEFAULT_VALUE "UNKNOWN" /end COMPU_VTAB
/begin MEASUREMENT UEGO3_CAN_Vbathi "UEGO3 CAN battery high{UEGO3_CAN_Vbathi&0x01=0x00:OK}{UEGO3_CAN_Vbathi&0x01=0x01:Fault}" UBYTE UEGO3_CAN_Vbathi_COMPU_VTAB 0 0 0 255 ECU_ADDRESS 0x01013D50 BIT_MASK 0x01 /end MEASUREMENT
/begin COMPU_METHOD UEGO3_CAN_Vbathi_COMPU_VTAB "Verbal Table" TAB_VERB "%.0" "list" COMPU_TAB_REF UEGO3_CAN_Vbathi_COMPU_VTAB_REF /end COMPU_METHOD
/begin COMPU_VTAB UEGO3_CAN_Vbathi_COMPU_VTAB_REF "Verbal Table" TAB_VERB 2 0x00 "OK" 0x01 "Fault" DEFAULT_VALUE "UNKNOWN" /end COMPU_VTAB
/begin MEASUREMENT UEGO2_CAN_PI_mA "UEGO2 CAN pump current" SWORD Compu_UEGO2_CAN_PI_mA 0 0 -32 31.9990234375 ECU_ADDRESS 0x01014220 /end MEASUREMENT
/begin COMPU_METHOD Compu_UEGO2_CAN_PI_mA " " RAT_FUNC "%.3" "mA" COEFFS 0 1024 0 0 0 1 /end COMPU_METHOD
/begin MEASUREMENT UEGO2_CAN_PI_mA_crct "UEGO2 CAN pump current (crct)" SWORD Compu_UEGO2_CAN_PI_mA_crct 0 0 -32 31.9990234375 ECU_ADDRESS 0x01014228 /end MEASUREMENT
/begin COMPU_METHOD Compu_UEGO2_CAN_PI_mA_crct " " RAT_FUNC "%.3" "mA" COEFFS 0 1024 0 0 0 1 /end COMPU_METHOD
/begin MEASUREMENT UEGO2_CAN_O2_pct "UEGO2 CAN O2 percent" SWORD Compu_UEGO2_CAN_O2_pct 0 0 -100 99.9969482421875 ECU_ADDRESS 0x01014230 /end MEASUREMENT
/begin COMPU_METHOD Compu_UEGO2_CAN_O2_pct " " RAT_FUNC "%.2" "%" COEFFS 0 327.68 0 0 0 1 /end COMPU_METHOD
/begin MEASUREMENT UEGO2_CAN_stable "UEGO2 CAN status{UEGO2_CAN_stable&0xc0=0x00:Not Stable}{UEGO2_CAN_stable&0xc0=0x40:Stable}{UEGO2_CAN_stable&0xc0=0x80:Error}{UEGO2_CAN_stable&0xc0=0xc0:Not Available}" UBYTE UEGO2_CAN_stable_COMPU_VTAB 0 0 0 255 ECU_ADDRESS 0x01014238 BIT_MASK 0xc0 /end MEASUREMENT
/begin COMPU_METHOD UEGO2_CAN_stable_COMPU_VTAB "Verbal Table" TAB_VERB "%.0" "list" COMPU_TAB_REF UEGO2_CAN_stable_COMPU_VTAB_REF /end COMPU_METHOD
/begin COMPU_VTAB UEGO2_CAN_stable_COMPU_VTAB_REF "Verbal Table" TAB_VERB 4 0x00 "Not Stable" 0x40 "Stable" 0x80 "Error" 0xc0 "Not Available" DEFAULT_VALUE "UNKNOWN" /end COMPU_VTAB
/begin MEASUREMENT UEGO2_CAN_compfail "UEGO2 CAN component fault{UEGO2_CAN_compfail&0x20=0x00:OK}{UEGO2_CAN_compfail&0x20=0x20:Fault}" UBYTE UEGO2_CAN_compfail_COMPU_VTAB 0 0 0 255 ECU_ADDRESS 0x01014240 BIT_MASK 0x20 /end MEASUREMENT
/begin COMPU_METHOD UEGO2_CAN_compfail_COMPU_VTAB "Verbal Table" TAB_VERB "%.0" "list" COMPU_TAB_REF UEGO2_CAN_compfail_COMPU_VTAB_REF /end COMPU_METHOD
/begin COMPU_VTAB UEGO2_CAN_compfail_COMPU_VTAB_REF "Verbal Table" TAB_VERB 2 0x00 "OK" 0x20 "Fault" DEFAULT_VALUE "UNKNOWN" /end COMPU_VTAB
/begin MEASUREMENT UEGO2_CAN_circThi "UEGO2 CAN circ T fault{UEGO2_CAN_circThi&0x10=0x00:OK}{UEGO2_CAN_circThi&0x10=0x10:Fault}" UBYTE UEGO2_CAN_circThi_COMPU_VTAB 0 0 0 255 ECU_ADDRESS 0x01014248 BIT_MASK 0xFF /end MEASUREMENT
/begin COMPU_METHOD UEGO2_CAN_circThi_COMPU_VTAB "Verbal Table" TAB_VERB "%.0" "list" COMPU_TAB_REF UEGO2_CAN_circThi_COMPU_VTAB_REF /end COMPU_METHOD
/begin COMPU_VTAB UEGO2_CAN_circThi_COMPU_VTAB_REF "Verbal Table" TAB_VERB 2 0x00 "OK" 0x10 "Fault" DEFAULT_VALUE "Unsupported Bit_Shift" /end COMPU_VTAB
/begin MEASUREMENT UEGO2_CAN_heatfail "UEGO2 CAN heater fault{UEGO2_CAN_heatfail&0x08=0x00:OK}{UEGO2_CAN_heatfail&0x08=0x08:Fault}" UBYTE UEGO2_CAN_heatfail_COMPU_VTAB 0 0 0 255 ECU_ADDRESS 0x01014250 BIT_MASK 0x08 /end MEASUREMENT
/begin COMPU_METHOD UEGO2_CAN_heatfail_COMPU_VTAB "Verbal Table" TAB_VERB "%.0" "list" COMPU_TAB_REF UEGO2_CAN_heatfail_COMPU_VTAB_REF /end COMPU_METHOD
/begin COMPU_VTAB UEGO2_CAN_heatfail_COMPU_VTAB_REF "Verbal Table" TAB_VERB 2 0x00 "OK" 0x08 "Fault" DEFAULT_VALUE "UNKNOWN" /end COMPU_VTAB
/begin MEASUREMENT UEGO2_CAN_TxRxfail "UEGO2 CAN Tx/Rx fault{UEGO2_CAN_TxRxfail&0x04=0x00:OK}{UEGO2_CAN_TxRxfail&0x04=0x04:Fault}" UBYTE UEGO2_CAN_TxRxfail_COMPU_VTAB 0 0 0 255 ECU_ADDRESS 0x01014258 BIT_MASK 0x04 /end MEASUREMENT
/begin COMPU_METHOD UEGO2_CAN_TxRxfail_COMPU_VTAB "Verbal Table" TAB_VERB "%.0" "list" COMPU_TAB_REF UEGO2_CAN_TxRxfail_COMPU_VTAB_REF /end COMPU_METHOD
/begin COMPU_VTAB UEGO2_CAN_TxRxfail_COMPU_VTAB_REF "Verbal Table" TAB_VERB 2 0x00 "OK" 0x04 "Fault" DEFAULT_VALUE "UNKNOWN" /end COMPU_VTAB
/begin MEASUREMENT UEGO2_CAN_Vbatlo "UEGO2 CAN battery low{UEGO2_CAN_Vbatlo&0x02=0x00:OK}{UEGO2_CAN_Vbatlo&0x02=0x02:Fault}" UBYTE UEGO2_CAN_Vbatlo_COMPU_VTAB 0 0 0 255 ECU_ADDRESS 0x01014260 BIT_MASK 0x02 /end MEASUREMENT
/begin COMPU_METHOD UEGO2_CAN_Vbatlo_COMPU_VTAB "Verbal Table" TAB_VERB "%.0" "list" COMPU_TAB_REF UEGO2_CAN_Vbatlo_COMPU_VTAB_REF /end COMPU_METHOD
/begin COMPU_VTAB UEGO2_CAN_Vbatlo_COMPU_VTAB_REF "Verbal Table" TAB_VERB 2 0x00 "OK" 0x02 "Fault" DEFAULT_VALUE "UNKNOWN" /end COMPU_VTAB
/begin MEASUREMENT UEGO2_CAN_Vbathi "UEGO2 CAN battery high{UEGO2_CAN_Vbathi&0x01=0x00:OK}{UEGO2_CAN_Vbathi&0x01=0x01:Fault}" UBYTE UEGO2_CAN_Vbathi_COMPU_VTAB 0 0 0 255 ECU_ADDRESS 0x01014268 BIT_MASK 0x01 /end MEASUREMENT
/begin COMPU_METHOD UEGO2_CAN_Vbathi_COMPU_VTAB "Verbal Table" TAB_VERB "%.0" "list" COMPU_TAB_REF UEGO2_CAN_Vbathi_COMPU_VTAB_REF /end COMPU_METHOD
/begin COMPU_VTAB UEGO2_CAN_Vbathi_COMPU_VTAB_REF "Verbal Table" TAB_VERB 2 0x00 "OK" 0x01 "Fault" DEFAULT_VALUE "UNKNOWN" /end COMPU_VTAB
/begin CHARACTERISTIC EGOZ_heatoff_ena "EGOZ heater off sampling{EGOZ_heatoff_ena&0xff=0:Disabled}{EGOZ_heatoff_ena&0xff=1:Enabled}" VALUE 0x001c86d7 /* @ECU_Address@EGOZ_heatoff_ena@0x01014648@ */ ECIPP_ALIGNMENT_UBYTE 255 EGOZ_heatoff_ena_COMPU_VTAB 0 255 BIT_MASK 0xff /end CHARACTERISTIC
/begin COMPU_METHOD EGOZ_heatoff_ena_COMPU_VTAB "Verbal Table" TAB_VERB "%.0" "list" COMPU_TAB_REF EGOZ_heatoff_ena_COMPU_VTAB_REF /end COMPU_METHOD
/begin COMPU_VTAB EGOZ_heatoff_ena_COMPU_VTAB_REF "Verbal Table" TAB_VERB 2 0 "Disabled" 1 "Enabled" DEFAULT_VALUE "UNKNOWN" /end COMPU_VTAB
/begin CHARACTERISTIC UEGO_recvr_GovFSO_wt "UEGO recovery Gov3 FSO delay" VALUE 0x001c82ec /* @ECU_Address@UEGO_recvr_GovFSO_wt@0x01014C10@ */ ECIPP_ALIGNMENT_UWORD 65535 Compu_UEGO_recvr_GovFSO_wt 0 65535 /end CHARACTERISTIC
/begin COMPU_METHOD Compu_UEGO_recvr_GovFSO_wt " " RAT_FUNC "%.0" "ms" COEFFS 0 1 0 0 0 1 /end COMPU_METHOD
/begin COMPU_METHOD Compu_TEGOZRd_time " " RAT_FUNC "%.1" "Run Time (sec)" COEFFS 0 15.625 0 0 0 1 /end COMPU_METHOD
/begin CHARACTERISTIC TEGOZRd_preRd "EGOZ Heater Control Target Impedance" CURVE 0x001C4B14 /* @ECU_Address@TEGOZRd_preRd@0x020FE000@ */ ECIPP_ALIGNMENT_SWORD 32767 Compu_TEGOZRd_preRd -32768 32767
 /begin AXIS_DESCR COM_AXIS NO_INPUT_QUANTITY Compu_TEGOZRd_time 4 -2097.152 2097.088 AXIS_PTS_REF TEGOZRd_time /end AXIS_DESCR
/end CHARACTERISTIC
/begin AXIS_PTS TEGOZRd_time " " 0x001C4B1C /* @ECU_Address@TEGOZRd_time@0x020FD000@ */ NO_INPUT_QUANTITY ECIPP_Lookup_SWORD 0 Compu_TEGOZRd_time 4 -2097.152 2097.088 /end AXIS_PTS
/begin COMPU_METHOD Compu_TEGOZRd_preRd " " RAT_FUNC "%.0" "Pre-Cat EGOZ (ohms)" COEFFS 0 1 0 0 0 1 /end COMPU_METHOD
/begin CHARACTERISTIC TEGOZRd_postRd "EGOZ Heater Control Target Impedance" CURVE 0x001C4B04 /* @ECU_Address@TEGOZRd_postRd@0x020FF000@ */ ECIPP_ALIGNMENT_SWORD 32767 Compu_TEGOZRd_postRd -32768 32767
 /begin AXIS_DESCR COM_AXIS NO_INPUT_QUANTITY Compu_TEGOZRd_time 4 -2097.152 2097.088 AXIS_PTS_REF TEGOZRd_time /end AXIS_DESCR
/end CHARACTERISTIC
/begin COMPU_METHOD Compu_TEGOZRd_postRd " " RAT_FUNC "%.0" "Post-Cat EGOZ (ohms)" COEFFS 0 1 0 0 0 1 /end COMPU_METHOD
/begin COMPU_METHOD Compu_TUEGOHsdly_ECT " " RAT_FUNC "%.1" "ECT at start (deg F)" COEFFS 0 32 14720 0 0 1 /end COMPU_METHOD
/begin CHARACTERISTIC TUEGOHsdly_time "UEGO Heater Start Delay Schedule" CURVE 0x001C5C42 /* @ECU_Address@TUEGOHsdly_time@0x0212D000@ */ ECIPP_ALIGNMENT_SWORD 32767 Compu_TUEGOHsdly_time -32768 32767
 /begin AXIS_DESCR COM_AXIS NO_INPUT_QUANTITY Compu_TUEGOHsdly_ECT 6 -1484 563.96875 AXIS_PTS_REF TUEGOHsdly_ECT /end AXIS_DESCR
/end CHARACTERISTIC
/begin AXIS_PTS TUEGOHsdly_ECT " " 0x001C5C16 /* @ECU_Address@TUEGOHsdly_ECT@0x0212C000@ */ NO_INPUT_QUANTITY ECIPP_Lookup_SWORD 0 Compu_TUEGOHsdly_ECT 6 -1484 563.96875 /end AXIS_PTS
/begin COMPU_METHOD Compu_TUEGOHsdly_time " " RAT_FUNC "%.0" "Heater start delay (sec)" COEFFS 0 1 0 0 0 1 /end COMPU_METHOD
/begin CHARACTERISTIC TEGOZRd_preHVlim "EGOZ Heater Control Voltage Limit" CURVE 0x001C4B0C /* @ECU_Address@TEGOZRd_preHVlim@0x0215C000@ */ ECIPP_ALIGNMENT_SWORD 128 Compu_TEGOZRd_preHVlim -128 127.99609375
 /begin AXIS_DESCR COM_AXIS NO_INPUT_QUANTITY Compu_TEGOZRd_time 4 -2097.152 2097.088 AXIS_PTS_REF TEGOZRd_time /end AXIS_DESCR
/end CHARACTERISTIC
/begin COMPU_METHOD Compu_TEGOZRd_preHVlim " " RAT_FUNC "%.1" "Pre-Cat EGOH V Lim (volts)" COEFFS 0 256 0 0 0 1 /end COMPU_METHOD
/begin CHARACTERISTIC TEGOZRd_postHVlim "EGOZ Heater Control Voltage Limit" CURVE 0x001C4AFC /* @ECU_Address@TEGOZRd_postHVlim@0x0215D000@ */ ECIPP_ALIGNMENT_SWORD 128 Compu_TEGOZRd_postHVlim -128 127.99609375
 /begin AXIS_DESCR COM_AXIS NO_INPUT_QUANTITY Compu_TEGOZRd_time 4 -2097.152 2097.088 AXIS_PTS_REF TEGOZRd_time /end AXIS_DESCR
/end CHARACTERISTIC
/begin COMPU_METHOD Compu_TEGOZRd_postHVlim " " RAT_FUNC "%.1" "Post-Cat EGOH V Lim (volts)" COEFFS 0 256 0 0 0 1 /end COMPU_METHOD
/begin CHARACTERISTIC TUEGO_drift_recvrT "UEGO recovery T target" CURVE 0x001C5C5E /* @ECU_Address@TUEGO_drift_recvrT@0x02355000@ */ ECIPP_ALIGNMENT_SWORD 8192 Compu_TUEGO_drift_recvrT -8192 8191.75
 /begin AXIS_DESCR COM_AXIS NO_INPUT_QUANTITY Compu_TUEGO_drift_crct 4 -100 99.9969482421875 AXIS_PTS_REF TUEGO_drift_crct /end AXIS_DESCR
/end CHARACTERISTIC
/begin AXIS_PTS TUEGO_drift_crct " " 0x001C5C56 /* @ECU_Address@TUEGO_drift_crct@0x02356000@ */ NO_INPUT_QUANTITY ECIPP_Lookup_SWORD 0 Compu_TUEGO_drift_crct 4 -100 99.9969482421875 /end AXIS_PTS
/begin COMPU_METHOD Compu_TUEGO_drift_recvrT " " RAT_FUNC "%.1" "target T (deg C)" COEFFS 0 4 0 0 0 1 /end COMPU_METHOD
/begin COMPU_METHOD Compu_TUEGO_drift_crct " " RAT_FUNC "%.1" "Drift (% Ip)" COEFFS 0 327.68 0 0 0 1 /end COMPU_METHOD
/begin CHARACTERISTIC TUEGOHsdly_tEGR "EGR UEGO Heater Start Delay Schedule" CURVE 0x001C5C36 /* @ECU_Address@TUEGOHsdly_tEGR@0x023A2000@ */ ECIPP_ALIGNMENT_SWORD 32767 Compu_TUEGOHsdly_tEGR -32768 32767
 /begin AXIS_DESCR COM_AXIS NO_INPUT_QUANTITY Compu_TUEGOHsdly_ECT 6 -1484 563.96875 AXIS_PTS_REF TUEGOHsdly_ECT /end AXIS_DESCR
/end CHARACTERISTIC
/begin COMPU_METHOD Compu_TUEGOHsdly_tEGR " " RAT_FUNC "%.0" "Heater start delay (sec)" COEFFS 0 1 0 0 0 1 /end COMPU_METHOD
/begin CHARACTERISTIC TUEGOHsdly_PHdly "UEGO PreHeat Delay Schedule" CURVE 0x001C5C22 /* @ECU_Address@TUEGOHsdly_PHdly@0x02524000@ */ ECIPP_ALIGNMENT_SWORD 32767 Compu_TUEGOHsdly_PHdly -32768 32767
 /begin AXIS_DESCR COM_AXIS NO_INPUT_QUANTITY Compu_TUEGOHsdly_ECT 6 -1484 563.96875 AXIS_PTS_REF TUEGOHsdly_ECT /end AXIS_DESCR
/end CHARACTERISTIC
/begin COMPU_METHOD Compu_TUEGOHsdly_PHdly " " RAT_FUNC "%.0" "Heater preheat (sec)" COEFFS 0 1 0 0 0 1 /end COMPU_METHOD
/begin COMPU_METHOD Compu_TUEGOHsdly_AAT " " RAT_FUNC "%.1" "Preheat multiplier" COEFFS 0 32 14720 0 0 1 /end COMPU_METHOD
/begin CHARACTERISTIC TUEGOHsdly_PHmult "UEGO PreHeat multiplier" CURVE 0x001C5C2E /* @ECU_Address@TUEGOHsdly_PHmult@0x02526000@ */ ECIPP_ALIGNMENT_SWORD 512 Compu_TUEGOHsdly_PHmult -512 511.984375
 /begin AXIS_DESCR COM_AXIS NO_INPUT_QUANTITY Compu_TUEGOHsdly_AAT 4 -1484 563.96875 AXIS_PTS_REF TUEGOHsdly_AAT /end AXIS_DESCR
/end CHARACTERISTIC
/begin AXIS_PTS TUEGOHsdly_AAT " " 0x001C5C0E /* @ECU_Address@TUEGOHsdly_AAT@0x02525000@ */ NO_INPUT_QUANTITY ECIPP_Lookup_SWORD 0 Compu_TUEGOHsdly_AAT 4 -1484 563.96875 /end AXIS_PTS
/begin COMPU_METHOD Compu_TUEGOHsdly_PHmult " " RAT_FUNC "%.2" "Preheat multiplier" COEFFS 0 64 0 0 0 1 /end COMPU_METHOD
/begin GROUP EC_EGOConfig "ECONTROLS" ROOT
 /begin REF_CHARACTERISTIC UEGO_config LP_UEGO UEGO_EBP_ena EGO1_config EGO2_config EGO3_config SH_UEGO_ena SH_UEGO_nom EGO4_config EGOZ_enable EGOZ_poll_tout EGOZ_presamp EGOZ_settle_ini EGOZ_pulse_t EGOZ_H_Vmin EGOZ_H_Vmax EGOZ_H_Kp EGOZ_H_Ki EGOZ_samp_fail_lim EGOZ_settle_final EGOZ_presamp_SStol EGOZ_Rcold_def EGOZ_pulse_thresh EGOZ_Rhot_precat EGOZ_Rhot_postcat EGOH_Vdef_precat EGOH_Vdef_postcat EGOZ_H_Iinit EGOHpost_run_mode ECT_restart_ramp UEGO_EBP_C UEGOB_Twarmup UEGOB_TCLp_enable UEGOB_Ttarget UEGOB_Thysteresis UEGOB_Kp_Vheater UEGOB_Ki_Vheater UEGOB_Kd_Vheater UEGOB_Vheater_max UEGOB_integral_max UEGO2_config UEGO_EBP_Klean UEGO_EBP_Krich UEGO_EBP_EBPo UEGO_drift_learn UEGO_drift_stable_wt UEGO_drift_Tdelays UEGO_drift_sample_ms UEGO_drift_Terr_max UEGO_drift_Ip_tol UEGO_drift_min_flow UEGO_drift_gain_hr UEGO_drift_gain_max UEGO_drift_crct_min UEGO_drift_crct_max UEGO_drift_ECT_min UEGO_drift_FT_min UEGO_drift_inject_t UEGO_recvr_mode UEGO_recvr_T UEGO_recvr_Tramp UEGO_recvr_interval UEGO_recvr_duration UEGO_drift_leakage UEGO_drift_holdoff UEGO_recvr_FPPFSO_wt UEGO_recvr_MAPFSO_wt UEGO_sensor_slct UEGO2_sensor_slct UEGON_Twarmup UEGON_TCLp_enable UEGON_Ttarget UEGON_Thysteresis UEGON_Kp_Vheater UEGON_Ki_Vheater UEGON_Kd_Vheater UEGON_Vheater_max UEGON_integral_max UEGOB_integral_min UEGON_integral_min UEGOH_SD_tout UEGOB_heater_Hz UEGON_heater_Hz UEGOB_Vheater_min UEGON_Vheater_min UEGOB_integral_lmts UEGON_integral_lmts UEGOB_Vheater_lmts UEGON_Vheater_lmts UEGOB_ext_warmadd UEGON_ext_warmadd UEGOB_ext_CLadd UEGON_ext_CLadd UEGOB_ext_warmwt UEGON_ext_warmwt UEGOB_ext_mrgwt UEGON_ext_mrgwt UEGOB_ext_ramp UEGON_ext_ramp UEGO_driftE_inject_t UEGO_driftE_samp_ms UEGO_driftE_Ip_tol UEGO_driftE_Terr_max UEGO_driftE_gain UEGO_driftE_crct_min UEGO_driftE_crct_max UEGO_driftE_stable_t UEGO_driftE_gain_max UEGO_drift_gain_min UEGO_driftE_gain_min UEGO3_config UEGO3_sensor_slct UEGO4_config UEGO4_sensor_slct UEGON_EBP_ena UEGON_EBP_C UEGON_EBP_Klean UEGON_EBP_Krich UEGON_EBP_EBPo UEGO_alt_config UEGO2_alt_config UEGOH_strt_dly_cmd UEGOH_SD_KOFF_tout UEGOH_strt_PP_prH UEGOH_strt_EGR_prH UEGO_lo_pwr_set UEGO_lo_pwr_reset UEGOH_dewpt_offset NOx_hi_tau UEGO_bias_est_ena UEGO_bias_est_tau UEGO_bias_est_max EGOHpost_pre_wt_mult EGOZ_heatoff_ena UEGO_recvr_GovFSO_wt TEGOZRd_preRd TEGOZRd_postRd TUEGOHsdly_time TEGOZRd_preHVlim TEGOZRd_postHVlim TUEGO_drift_recvrT TUEGOHsdly_tEGR TUEGOHsdly_PHdly TUEGOHsdly_PHmult /end REF_CHARACTERISTIC
 /begin REF_MEASUREMENT AAT Phi_UEGO_raw EGOZ_state EGOZ_sensor EGO1Z_Rd EGO2Z_Rd EGO3Z_Rd EGO4Z_Rd EGO1Z_ohms EGO2Z_ohms EGO3Z_ohms EGO4Z_ohms EGO1Z_samp_fail EGO2Z_samp_fail EGO3Z_samp_fail EGO4Z_samp_fail EGO1Z_H_Iacc EGO2Z_H_Iacc EGO3Z_H_Iacc EGO4Z_H_Iacc EGO1H_V_d EGO2H_V_d EGO3H_V_d EGO4H_V_d EGO1H_DC EGO2H_DC EGO3H_DC EGO4H_DC ECT_start ECT_restart UEGOH_start_wait AF_UEGO UEGO_state UEGO_SPI_state UEGO_cal_flag UEGO_Rsensor UEGO_Tsensor UEGO_Vheater_DC UEGO_Vheater_int UEGO_SR_Vofst UEGO_PI_Vofst UEGO_Vheater Phi_UEGO2_raw AF_UEGO2 UEGO2_state UEGO2_SPI_state UEGO2_cal_flag UEGO2_Rsensor UEGO2_Tsensor UEGO2_Vheater_DC UEGO2_Vheater_int UEGO2_SR_Vofst UEGO2_PI_Vofst UEGO2_Vheater EGO1H_FB_volts EGO2H_FB_volts EGO3H_FB_volts EGO4H_FB_volts UEGO_PI_Vout_inst UEGO2_PI_Vout_inst NOx1pre_NOx_conc NOx1pst_NOx_conc NOx1pre_O2_conc NOx1pst_O2_conc NOx1pre_O2_stable NOx1pst_O2_stable NOx1pre_NOx_stable NOx1pst_NOx_stable NOx1pre_Tsensor_stat NOx1pst_Tsensor_stat NOx1pre_Vsupply_stat NOx1pst_Vsupply_stat NOx1pre_heater_diag NOx1pst_heater_diag NOx1pre_heater_mode NOx1pst_heater_mode NOx1pre_NOx_diag NOx1pst_NOx_diag NOx1pst_O2_diag NOx1pre_O2_diag UEGO1_drift_state UEGO2_drift_state UEGO1_drift_PI_dmean UEGO2_drift_PI_dmean UEGO1_drift_Terror UEGO2_drift_Terror UEGO1_drift_air_err UEGO2_drift_air_err UEGO_manual_action UEGO_manual_key UEGO1_Ttarget UEGO2_Ttarget UEGO1_recvr_secleft UEGO2_recvr_secleft UEGO1_drift_error UEGO2_drift_error UEGO1_drift_leak_err UEGO2_drift_leak_err UEGO1_recvr_error UEGO2_recvr_error UEGO_sensor_type UEGO2_sensor_type UEGOH_SD_tmr UEGO1_timer_heater UEGO2_timer_heater UEGO1_timer_warm UEGO2_timer_warm UEGO1_Vheater_CLmin UEGO2_Vheater_CLmin UEGO1_Vheater_CLmax UEGO2_Vheater_CLmax UEGO1_Vheater_OL UEGO2_Vheater_OL UEGOH_start_wtEGR UEGO1_CAN_PI_mA UEGO1_CAN_O2_pct UEGO1_CAN_stable UEGO1_CAN_compfail UEGO1_CAN_circThi UEGO1_CAN_heatfail UEGO1_CAN_TxRxfail UEGO1_CAN_Vbatlo UEGO1_CAN_Vbathi AFT_dewpt_CL1pre AFT_dewpt_CL1pst NTK_dewpoint NTK_preheat UEGO3_sensor_type Phi_UEGO3_raw AF_UEGO3 UEGO3_drift_state UEGO3_drift_PI_dmean UEGO3_drift_Terror UEGO3_drift_air_err UEGO3_drift_leak_err UEGO3_drift_error UEGO4_sensor_type Phi_UEGO4_raw AF_UEGO4 UEGO4_drift_state UEGO4_drift_PI_dmean UEGO4_drift_Terror UEGO4_drift_air_err UEGO4_drift_leak_err UEGO4_drift_error UEGO4_CAN_PI_mA UEGO4_CAN_O2_pct UEGO4_CAN_stable UEGO4_CAN_compfail UEGO4_CAN_circThi UEGO4_CAN_heatfail UEGO4_CAN_TxRxfail UEGO4_CAN_Vbatlo UEGO4_CAN_Vbathi UEGO_alt_slct UEGO2_alt_slct UEGO1_CAN_PI_mA_crct UEGO4_CAN_PI_mA_crct UEGOH_SD_KOFF_tmr UEGO1_dewpt UEGO2_dewpt UEGO3_dewpt UEGO4_dewpt AAT_UEGO_PHstart UEGOH_preheat_PP UEGOH_preheat_EGR NOx_ppm_filt UEGO_bias_est EGOHpost_wait_tm EGOHpost_wait_tmr EGOHpost_run_tmr UEGO3_CAN_PI_mA UEGO3_CAN_PI_mA_crct UEGO3_CAN_O2_pct UEGO3_CAN_stable UEGO3_CAN_compfail UEGO3_CAN_circThi UEGO3_CAN_heatfail UEGO3_CAN_TxRxfail UEGO3_CAN_Vbatlo UEGO3_CAN_Vbathi UEGO2_CAN_PI_mA UEGO2_CAN_PI_mA_crct UEGO2_CAN_O2_pct UEGO2_CAN_stable UEGO2_CAN_compfail UEGO2_CAN_circThi UEGO2_CAN_heatfail UEGO2_CAN_TxRxfail UEGO2_CAN_Vbatlo UEGO2_CAN_Vbathi /end REF_MEASUREMENT
/end GROUP
/begin GROUP EC_HDService "ECONTROLS" ROOT /begin REF_MEASUREMENT AAT Phi_UEGO_raw UEGOH_start_wait /end REF_MEASUREMENT /end GROUP
/begin GROUP EC_HDService2 "ECONTROLS" ROOT /begin REF_MEASUREMENT AAT /end REF_MEASUREMENT /end GROUP
/begin GROUP EC_PowerMon "ECONTROLS" ROOT /begin REF_MEASUREMENT AAT /end REF_MEASUREMENT /end GROUP
/begin GROUP EC_Tests "ECONTROLS" ROOT
 /begin REF_MEASUREMENT UEGO_state UEGO_Tsensor UEGO2_state UEGO2_Tsensor UEGO1_drift_state UEGO2_drift_state UEGO1_drift_air_err UEGO2_drift_air_err UEGO1_Ttarget UEGO2_Ttarget UEGO3_drift_state UEGO3_drift_air_err UEGO4_drift_state UEGO4_drift_air_err /end REF_MEASUREMENT
/end GROUP
/end MODULE
/end PROJECT
