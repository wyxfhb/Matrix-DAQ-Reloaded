ASAP2_VERSION 1 61
/begin PROJECT Econtrols_4G "4G Test"
/begin HEADER "4G A2L Configuration" PROJECT_NO EControls4G /* config for version control */ VERSION "$Revision: 82130 $:" /* config for version control */ /end HEADER
/begin MODULE EControls_4G_SH2A "EControls 4G"
/begin MOD_COMMON "" DEPOSIT ABSOLUTE BYTE_ORDER MSB_FIRST /end MOD_COMMON
/* Define the Record Layouts */
/begin RECORD_LAYOUT ECIPP_ALIGNMENT_UBYTE FNC_VALUES 1 UBYTE COLUMN_DIR DIRECT /end RECORD_LAYOUT
/begin RECORD_LAYOUT ECIPP_ALIGNMENT_UWORD FNC_VALUES 1 UWORD COLUMN_DIR DIRECT /end RECORD_LAYOUT
/begin RECORD_LAYOUT ECIPP_Lookup_SWORD AXIS_PTS_X 1 SWORD INDEX_INCR DIRECT /end RECORD_LAYOUT
/begin RECORD_LAYOUT ECIPP_ALIGNMENT_ULONG FNC_VALUES 1 ULONG COLUMN_DIR DIRECT /end RECORD_LAYOUT
/begin CHARACTERISTIC Gov12_state_cfg "Gov1 / Gov2 state configuration{Gov12_state_cfg&0xff=0:Normal}{Gov12_state_cfg&0xff=1:Reversed}" VALUE 0x001c8759 /* @ECU_Address@Gov12_state_cfg@0x01001B40@ */ ECIPP_ALIGNMENT_UBYTE 255 Gov12_state_cfg_COMPU_VTAB 0 255 BIT_MASK 0xff /end CHARACTERISTIC
/begin COMPU_METHOD Gov12_state_cfg_COMPU_VTAB "Verbal Table" TAB_VERB "%.0" "list" COMPU_TAB_REF Gov12_state_cfg_COMPU_VTAB_REF /end COMPU_METHOD
/begin COMPU_VTAB Gov12_state_cfg_COMPU_VTAB_REF "Verbal Table" TAB_VERB 2 0 "Normal" 1 "Reversed" DEFAULT_VALUE "UNKNOWN" /end COMPU_VTAB
/begin MEASUREMENT AUX_PU1_state "Aux PU1 digital state{AUX_PU1_state&0xff=0:Open (off)}{AUX_PU1_state&0xff=1:Ground (on)}" UBYTE AUX_PU1_state_COMPU_VTAB 0 0 0 255 ECU_ADDRESS 0x010037C0 BIT_MASK 0xff /end MEASUREMENT
/begin COMPU_METHOD AUX_PU1_state_COMPU_VTAB "Verbal Table" TAB_VERB "%.0" "list" COMPU_TAB_REF AUX_PU1_state_COMPU_VTAB_REF /end COMPU_METHOD
/begin COMPU_VTAB AUX_PU1_state_COMPU_VTAB_REF "Verbal Table" TAB_VERB 2 0 "Open (off)" 1 "Ground (on)" DEFAULT_VALUE "UNKNOWN" /end COMPU_VTAB
/begin MEASUREMENT AUX_PU2_state "Aux PU2 digital state{AUX_PU2_state&0xff=0:Open (off)}{AUX_PU2_state&0xff=1:Ground (on)}" UBYTE AUX_PU2_state_COMPU_VTAB 0 0 0 255 ECU_ADDRESS 0x010037C8 BIT_MASK 0xff /end MEASUREMENT
/begin COMPU_METHOD AUX_PU2_state_COMPU_VTAB "Verbal Table" TAB_VERB "%.0" "list" COMPU_TAB_REF AUX_PU2_state_COMPU_VTAB_REF /end COMPU_METHOD
/begin COMPU_VTAB AUX_PU2_state_COMPU_VTAB_REF "Verbal Table" TAB_VERB 2 0 "Open (off)" 1 "Ground (on)" DEFAULT_VALUE "UNKNOWN" /end COMPU_VTAB
/begin MEASUREMENT AUX_PU3_state "Aux PU3 digital state{AUX_PU3_state&0xff=0:Open (off)}{AUX_PU3_state&0xff=1:Ground (on)}" UBYTE AUX_PU3_state_COMPU_VTAB 0 0 0 255 ECU_ADDRESS 0x010037D0 BIT_MASK 0xff /end MEASUREMENT
/begin COMPU_METHOD AUX_PU3_state_COMPU_VTAB "Verbal Table" TAB_VERB "%.0" "list" COMPU_TAB_REF AUX_PU3_state_COMPU_VTAB_REF /end COMPU_METHOD
/begin COMPU_VTAB AUX_PU3_state_COMPU_VTAB_REF "Verbal Table" TAB_VERB 2 0 "Open (off)" 1 "Ground (on)" DEFAULT_VALUE "UNKNOWN" /end COMPU_VTAB
/begin MEASUREMENT AUX_PUD1_state "Aux PUD1 digital state{AUX_PUD1_state&0xff=0:Open (off)}{AUX_PUD1_state&0xff=1:Ground (on)}" UBYTE AUX_PUD1_state_COMPU_VTAB 0 0 0 255 ECU_ADDRESS 0x010037D8 BIT_MASK 0xff /end MEASUREMENT
/begin COMPU_METHOD AUX_PUD1_state_COMPU_VTAB "Verbal Table" TAB_VERB "%.0" "list" COMPU_TAB_REF AUX_PUD1_state_COMPU_VTAB_REF /end COMPU_METHOD
/begin COMPU_VTAB AUX_PUD1_state_COMPU_VTAB_REF "Verbal Table" TAB_VERB 2 0 "Open (off)" 1 "Ground (on)" DEFAULT_VALUE "UNKNOWN" /end COMPU_VTAB
/begin MEASUREMENT AUX_PUD2_state "Aux PUD2 digital state{AUX_PUD2_state&0xff=0:Open (off)}{AUX_PUD2_state&0xff=1:Ground (on)}" UBYTE AUX_PUD2_state_COMPU_VTAB 0 0 0 255 ECU_ADDRESS 0x010037E0 BIT_MASK 0xff /end MEASUREMENT
/begin COMPU_METHOD AUX_PUD2_state_COMPU_VTAB "Verbal Table" TAB_VERB "%.0" "list" COMPU_TAB_REF AUX_PUD2_state_COMPU_VTAB_REF /end COMPU_METHOD
/begin COMPU_VTAB AUX_PUD2_state_COMPU_VTAB_REF "Verbal Table" TAB_VERB 2 0 "Open (off)" 1 "Ground (on)" DEFAULT_VALUE "UNKNOWN" /end COMPU_VTAB
/begin MEASUREMENT AUX_PUD3_state "Aux PUD3 digital state{AUX_PUD3_state&0xff=0:Open (off)}{AUX_PUD3_state&0xff=1:Ground (on)}" UBYTE AUX_PUD3_state_COMPU_VTAB 0 0 0 255 ECU_ADDRESS 0x010037E8 BIT_MASK 0xff /end MEASUREMENT
/begin COMPU_METHOD AUX_PUD3_state_COMPU_VTAB "Verbal Table" TAB_VERB "%.0" "list" COMPU_TAB_REF AUX_PUD3_state_COMPU_VTAB_REF /end COMPU_METHOD
/begin COMPU_VTAB AUX_PUD3_state_COMPU_VTAB_REF "Verbal Table" TAB_VERB 2 0 "Open (off)" 1 "Ground (on)" DEFAULT_VALUE "UNKNOWN" /end COMPU_VTAB
/begin MEASUREMENT AUX_DIG1_state "Aux DIG1 digital state{AUX_DIG1_state&0xff=0:Open (off)}{AUX_DIG1_state&0xff=255:Ground (on:1)}{AUX_DIG1_state&0xff=1:+Voltage (on:2)}" UBYTE AUX_DIG1_state_COMPU_VTAB 0 0 0 255 ECU_ADDRESS 0x010037F0 BIT_MASK 0xff /end MEASUREMENT
/begin COMPU_METHOD AUX_DIG1_state_COMPU_VTAB "Verbal Table" TAB_VERB "%.0" "list" COMPU_TAB_REF AUX_DIG1_state_COMPU_VTAB_REF /end COMPU_METHOD
/begin COMPU_VTAB AUX_DIG1_state_COMPU_VTAB_REF "Verbal Table" TAB_VERB 3 0 "Open (off)" 255 "Ground (on:1)" 1 "+Voltage (on:2)" DEFAULT_VALUE "UNKNOWN" /end COMPU_VTAB
/begin MEASUREMENT AUX_DIG2_state "Aux DIG2 digital state{AUX_DIG2_state&0xff=0:Open (off)}{AUX_DIG2_state&0xff=255:Ground (on:1)}{AUX_DIG2_state&0xff=1:+Voltage (on:2)}" UBYTE AUX_DIG2_state_COMPU_VTAB 0 0 0 255 ECU_ADDRESS 0x010037F8 BIT_MASK 0xff /end MEASUREMENT
/begin COMPU_METHOD AUX_DIG2_state_COMPU_VTAB "Verbal Table" TAB_VERB "%.0" "list" COMPU_TAB_REF AUX_DIG2_state_COMPU_VTAB_REF /end COMPU_METHOD
/begin COMPU_VTAB AUX_DIG2_state_COMPU_VTAB_REF "Verbal Table" TAB_VERB 3 0 "Open (off)" 255 "Ground (on:1)" 1 "+Voltage (on:2)" DEFAULT_VALUE "UNKNOWN" /end COMPU_VTAB
/begin MEASUREMENT AUX_DIG3_state "Aux DIG3 digital state{AUX_DIG3_state&0xff=0:Open (off)}{AUX_DIG3_state&0xff=255:Ground (on:1)}{AUX_DIG3_state&0xff=1:+Voltage (on:2)}" UBYTE AUX_DIG3_state_COMPU_VTAB 0 0 0 255 ECU_ADDRESS 0x01003800 BIT_MASK 0xff /end MEASUREMENT
/begin COMPU_METHOD AUX_DIG3_state_COMPU_VTAB "Verbal Table" TAB_VERB "%.0" "list" COMPU_TAB_REF AUX_DIG3_state_COMPU_VTAB_REF /end COMPU_METHOD
/begin COMPU_VTAB AUX_DIG3_state_COMPU_VTAB_REF "Verbal Table" TAB_VERB 3 0 "Open (off)" 255 "Ground (on:1)" 1 "+Voltage (on:2)" DEFAULT_VALUE "UNKNOWN" /end COMPU_VTAB
/begin CHARACTERISTIC Gov12_input_cfg "Gov1 / Gov2 input configuration{Gov12_input_cfg&0xff=0:Bi-state Gnd=Active}{Gov12_input_cfg&0xff=1:Bi-state +V=Active}{Gov12_input_cfg&0xff=2:Tri-state Open=Inactive}" VALUE 0x001c8758 /* @ECU_Address@Gov12_input_cfg@0x01003B50@ */ ECIPP_ALIGNMENT_UBYTE 255 Gov12_input_cfg_COMPU_VTAB 0 255 BIT_MASK 0xff /end CHARACTERISTIC
/begin COMPU_METHOD Gov12_input_cfg_COMPU_VTAB "Verbal Table" TAB_VERB "%.0" "list" COMPU_TAB_REF Gov12_input_cfg_COMPU_VTAB_REF /end COMPU_METHOD
/begin COMPU_VTAB Gov12_input_cfg_COMPU_VTAB_REF "Verbal Table" TAB_VERB 3 0 "Bi-state Gnd=Active" 1 "Bi-state +V=Active" 2 "Tri-state Open=Inactive" DEFAULT_VALUE "UNKNOWN" /end COMPU_VTAB
/begin CHARACTERISTIC FST_ena "FST source{FST_ena&0xff=0:Disabled}{FST_ena&0xff=1:Aux PU1}{FST_ena&0xff=2:Aux PU2}{FST_ena&0xff=3:Aux PU3}{FST_ena&0xff=4:Aux PUD1}{FST_ena&0xff=5:Aux PUD2}{FST_ena&0xff=6:Aux PUD3}{FST_ena&0xff=7:EGT Input}{FST_ena&0xff=8:Aux PUD4}{FST_ena&0xff=9:Aux PU" VALUE 0x001c873e /* @ECU_Address@FST_ena@0x01003F58@ */ ECIPP_ALIGNMENT_UBYTE 255 FST_ena_COMPU_VTAB 0 255 BIT_MASK 0xff /end CHARACTERISTIC
/begin COMPU_METHOD FST_ena_COMPU_VTAB "Verbal Table" TAB_VERB "%.0" "list" COMPU_TAB_REF FST_ena_COMPU_VTAB_REF /end COMPU_METHOD
/begin COMPU_VTAB FST_ena_COMPU_VTAB_REF "Verbal Table" TAB_VERB 31 0 "Disabled" 1 "Aux PU1" 2 "Aux PU2" 3 "Aux PU3" 4 "Aux PUD1" 5 "Aux PUD2" 6 "Aux PUD3" 7 "EGT Input" 8 "Aux PUD4" 9 "Aux PUD5" 10 "Aux PUD6" 11 "Aux PUD7" 12 "Aux PUD8" 13 "Aux PUD9" 14 "Aux PUD10" 15 "Aux PUD11" 16 "Aux PUD12" 17 "Aux PUD13" 18 "Aux PUD14" 19 "Aux PUD15" 20 "Aux PUD16" 21 "Aux PUD17" 22 "Aux PUD18" 23 "Aux PUD19" 24 "Aux PUD20" 25 "Aux PUD21" 26 "Aux PUD22" 27 "Aux PUD23" 28 "Aux PUD24" 29 "Aux PUD25" 30 "CAN sourced" DEFAULT_VALUE "UNKNOWN" /end COMPU_VTAB
/begin MEASUREMENT FST "FST" UWORD Compu_FST 0 0 -460 563.984375 ECU_ADDRESS 0x01003F60 /end MEASUREMENT
/begin COMPU_METHOD Compu_FST " " RAT_FUNC "%.1" "deg F" COEFFS 0 64 29440 0 0 1 /end COMPU_METHOD
/begin CHARACTERISTIC FST_def "FST default" VALUE 0x001c7b74 /* @ECU_Address@FST_def@0x01003F68@ */ ECIPP_ALIGNMENT_UWORD 564 Compu_FST_def -460 563.984375 /end CHARACTERISTIC
/begin COMPU_METHOD Compu_FST_def " " RAT_FUNC "%.1" "deg F" COEFFS 0 64 29440 0 0 1 /end COMPU_METHOD
/begin CHARACTERISTIC CL_fuellev_mon "Low fuel monitoring input{CL_fuellev_mon&0xff=0:Disabled}{CL_fuellev_mon&0xff=1:NMHG J1939 (LPG)}{CL_fuellev_mon&0xff=2:Fuel pressure switch (All fuels)}{CL_fuellev_mon&0xff=3:FP switch (LPG/NG) + Fuel level (Gasoline)}{CL_fuellev_mon&0xff=4:NMHG J1939 (A" VALUE 0x001c86a8 /* @ECU_Address@CL_fuellev_mon@0x01004340@ */ ECIPP_ALIGNMENT_UBYTE 255 CL_fuellev_mon_COMPU_VTAB 0 255 BIT_MASK 0xff /end CHARACTERISTIC
/begin COMPU_METHOD CL_fuellev_mon_COMPU_VTAB "Verbal Table" TAB_VERB "%.0" "list" COMPU_TAB_REF CL_fuellev_mon_COMPU_VTAB_REF /end COMPU_METHOD
/begin COMPU_VTAB CL_fuellev_mon_COMPU_VTAB_REF "Verbal Table" TAB_VERB 10 0 "Disabled" 1 "NMHG J1939 (LPG)" 2 "Fuel pressure switch (All fuels)" 3 "FP switch (LPG/NG) + Fuel level (Gasoline)" 4 "NMHG J1939 (All fuels)" 5 "Fuel level input (NG)" 6 "FTPM (LPG) + Fuel level input (Gasoline)" 7 "FTPM (LPG) + J1939 gasoline fuel low" 8 "Gaseous Fuel Level FLEV Monitoring (NG)" 9 "Low Fuel Pressure Derate (gaseous)" DEFAULT_VALUE "UNKNOWN" /end COMPU_VTAB
/begin CHARACTERISTIC fuellev_in_ena "Fuel level input configuration{fuellev_in_ena&0xff=0:Disabled}{fuellev_in_ena&0xff=1:Network Source}{fuellev_in_ena&0xff=2:Aux PU1}{fuellev_in_ena&0xff=3:Aux PU2}{fuellev_in_ena&0xff=4:Aux PU3}{fuellev_in_ena&0xff=5:Aux PD1}{fuellev_in_ena&0xff=6:Aux PD2}" VALUE 0x001c903b /* @ECU_Address@fuellev_in_ena@0x01004C18@ */ ECIPP_ALIGNMENT_UBYTE 255 fuellev_in_ena_COMPU_VTAB 0 255 BIT_MASK 0xff /end CHARACTERISTIC
/begin COMPU_METHOD fuellev_in_ena_COMPU_VTAB "Verbal Table" TAB_VERB "%.0" "list" COMPU_TAB_REF fuellev_in_ena_COMPU_VTAB_REF /end COMPU_METHOD
/begin COMPU_VTAB fuellev_in_ena_COMPU_VTAB_REF "Verbal Table" TAB_VERB 37 0 "Disabled" 1 "Network Source" 2 "Aux PU1" 3 "Aux PU2" 4 "Aux PU3" 5 "Aux PD1" 6 "Aux PD2" 7 "Aux PD3" 8 "Aux PUD1" 9 "Aux PUD2" 10 "Aux PUD3" 11 "Aux DIG1" 12 "Aux DIG2" 13 "Aux DIG3" 14 "Aux DIG4" 15 "Aux PUD4" 16 "Aux PUD5" 17 "Aux PUD6" 18 "Aux PUD7" 19 "Aux PUD8" 20 "Aux PUD9" 21 "Aux PUD10" 22 "Aux PUD11" 23 "Aux PUD12" 24 "Aux PUD13" 25 "Aux PUD14" 26 "Aux PUD15" 27 "Aux PUD16" 28 "Aux PUD17" 29 "Aux PUD18" 30 "Aux PUD19" 31 "Aux PUD20" 32 "Aux PUD21" 33 "Aux PUD22" 34 "Aux PUD23" 35 "Aux PUD24" 36 "Aux PUD25" DEFAULT_VALUE "UNKNOWN" /end COMPU_VTAB
/begin MEASUREMENT FTT "FTT" UWORD Compu_FTT 0 0 -460 563.984375 ECU_ADDRESS 0x01004E60 /end MEASUREMENT
/begin COMPU_METHOD Compu_FTT " " RAT_FUNC "%.1" "deg F" COEFFS 0 64 29440 0 0 1 /end COMPU_METHOD
/begin MEASUREMENT FTP "FTP" UWORD Compu_FTP 0 0 0 8191.875 ECU_ADDRESS 0x01004E78 /end MEASUREMENT
/begin COMPU_METHOD Compu_FTP " " RAT_FUNC "%.1" "psia" COEFFS 0 8 0 0 0 1 /end COMPU_METHOD
/begin MEASUREMENT fuellev_pct "Current fuel level" UWORD Compu_fuellev_pct 0 0 0 99.9984741210938 ECU_ADDRESS 0x010053B0 /end MEASUREMENT
/begin COMPU_METHOD Compu_fuellev_pct " " RAT_FUNC "%.1" "%" COEFFS 0 655.36 0 0 0 1 /end COMPU_METHOD
/begin MEASUREMENT fuellev_volt "Current fuel level voltage" UWORD Compu_fuellev_volt 0 0 0 255.99609375 ECU_ADDRESS 0x010053B8 /end MEASUREMENT
/begin COMPU_METHOD Compu_fuellev_volt " " RAT_FUNC "%.2" "volts" COEFFS 0 256 0 0 0 1 /end COMPU_METHOD
/begin CHARACTERISTIC fuellev_ratio_md "Fuel level sender type{fuellev_ratio_md&0xff=0:Absolute voltage output}{fuellev_ratio_md&0xff=1:5V ratiometric output}{fuellev_ratio_md&0xff=2:Vbat ratiometric output}" VALUE 0x001c903c /* @ECU_Address@fuellev_ratio_md@0x010053C0@ */ ECIPP_ALIGNMENT_UBYTE 255 fuellev_ratio_md_COMPU_VTAB 0 255 BIT_MASK 0xff /end CHARACTERISTIC
/begin COMPU_METHOD fuellev_ratio_md_COMPU_VTAB "Verbal Table" TAB_VERB "%.0" "list" COMPU_TAB_REF fuellev_ratio_md_COMPU_VTAB_REF /end COMPU_METHOD
/begin COMPU_VTAB fuellev_ratio_md_COMPU_VTAB_REF "Verbal Table" TAB_VERB 3 0 "Absolute voltage output" 1 "5V ratiometric output" 2 "Vbat ratiometric output" DEFAULT_VALUE "UNKNOWN" /end COMPU_VTAB
/begin CHARACTERISTIC fuellev_Vstd "Fuel level standard excitation" VALUE 0x001c844e /* @ECU_Address@fuellev_Vstd@0x010053C8@ */ ECIPP_ALIGNMENT_UWORD 256 Compu_fuellev_Vstd 0 255.99609375 /end CHARACTERISTIC
/begin COMPU_METHOD Compu_fuellev_Vstd " " RAT_FUNC "%.2" "volts" COEFFS 0 256 0 0 0 1 /end COMPU_METHOD
/begin CHARACTERISTIC fuellev_V_0 "Fuel level 0% voltage" VALUE 0x001c8444 /* @ECU_Address@fuellev_V_0@0x010053D0@ */ ECIPP_ALIGNMENT_UWORD 256 Compu_fuellev_V_0 0 255.99609375 /end CHARACTERISTIC
/begin COMPU_METHOD Compu_fuellev_V_0 " " RAT_FUNC "%.2" "volts" COEFFS 0 256 0 0 0 1 /end COMPU_METHOD
/begin CHARACTERISTIC fuellev_V_1 "Fuel level 100% voltage" VALUE 0x001c8446 /* @ECU_Address@fuellev_V_1@0x010053D8@ */ ECIPP_ALIGNMENT_UWORD 256 Compu_fuellev_V_1 0 255.99609375 /end CHARACTERISTIC
/begin COMPU_METHOD Compu_fuellev_V_1 " " RAT_FUNC "%.2" "volts" COEFFS 0 256 0 0 0 1 /end COMPU_METHOD
/begin CHARACTERISTIC brake_chan "Brake input{brake_chan&0xff=0:Disabled}{brake_chan&0xff=1:Aux PU1}{brake_chan&0xff=2:Aux PU2}{brake_chan&0xff=3:Aux PU3}{brake_chan&0xff=4:Aux PUD1}{brake_chan&0xff=5:Aux PUD2}{brake_chan&0xff=6:Aux PUD3}{brake_chan&0xff=7:Aux DIG1}{brake_chan&0xff=8:Aux " VALUE 0x001c8fa2 /* @ECU_Address@brake_chan@0x01005880@ */ ECIPP_ALIGNMENT_UBYTE 255 brake_chan_COMPU_VTAB 0 255 BIT_MASK 0xff /end CHARACTERISTIC
/begin COMPU_METHOD brake_chan_COMPU_VTAB "Verbal Table" TAB_VERB "%.0" "list" COMPU_TAB_REF brake_chan_COMPU_VTAB_REF /end COMPU_METHOD
/begin COMPU_VTAB brake_chan_COMPU_VTAB_REF "Verbal Table" TAB_VERB 17 0 "Disabled" 1 "Aux PU1" 2 "Aux PU2" 3 "Aux PU3" 4 "Aux PUD1" 5 "Aux PUD2" 6 "Aux PUD3" 7 "Aux DIG1" 8 "Aux DIG2" 9 "Aux DIG3" 10 "Aux DIG4" 11 "J1939 CCVS" 12 "Aux DIG5" 13 "Aux DIG6" 14 "Aux DIG7" 15 "Aux DIG8" 16 "Aux DIG9" DEFAULT_VALUE "UNKNOWN" /end COMPU_VTAB
/begin CHARACTERISTIC brake_cfg "Brake input config{brake_cfg&0xff=0:Bi/Tri-state Gnd=valid}{brake_cfg&0xff=1:Tri-state +V=valid}{brake_cfg&0xff=2:Aux DIG Open=valid}" VALUE 0x001c8fa1 /* @ECU_Address@brake_cfg@0x01005888@ */ ECIPP_ALIGNMENT_UBYTE 255 brake_cfg_COMPU_VTAB 0 255 BIT_MASK 0xff /end CHARACTERISTIC
/begin COMPU_METHOD brake_cfg_COMPU_VTAB "Verbal Table" TAB_VERB "%.0" "list" COMPU_TAB_REF brake_cfg_COMPU_VTAB_REF /end COMPU_METHOD
/begin COMPU_VTAB brake_cfg_COMPU_VTAB_REF "Verbal Table" TAB_VERB 3 0 "Bi/Tri-state Gnd=valid" 1 "Tri-state +V=valid" 2 "Aux DIG Open=valid" DEFAULT_VALUE "UNKNOWN" /end COMPU_VTAB
/begin MEASUREMENT AUX_DIG4_state "Aux DIG4 digital state{AUX_DIG4_state&0xff=0:Open (off)}{AUX_DIG4_state&0xff=255:Ground (on:1)}{AUX_DIG4_state&0xff=1:+Voltage (on:2)}" UBYTE AUX_DIG4_state_COMPU_VTAB 0 0 0 255 ECU_ADDRESS 0x010074E0 BIT_MASK 0xff /end MEASUREMENT
/begin COMPU_METHOD AUX_DIG4_state_COMPU_VTAB "Verbal Table" TAB_VERB "%.0" "list" COMPU_TAB_REF AUX_DIG4_state_COMPU_VTAB_REF /end COMPU_METHOD
/begin COMPU_VTAB AUX_DIG4_state_COMPU_VTAB_REF "Verbal Table" TAB_VERB 3 0 "Open (off)" 255 "Ground (on:1)" 1 "+Voltage (on:2)" DEFAULT_VALUE "UNKNOWN" /end COMPU_VTAB
/begin MEASUREMENT AUX_DIG5_state "Aux DIG5 digital state{AUX_DIG5_state&0xff=0:Open (off)}{AUX_DIG5_state&0xff=255:Ground (on:1)}{AUX_DIG5_state&0xff=1:+Voltage (on:2)}" UBYTE AUX_DIG5_state_COMPU_VTAB 0 0 0 255 ECU_ADDRESS 0x010074E8 BIT_MASK 0xff /end MEASUREMENT
/begin COMPU_METHOD AUX_DIG5_state_COMPU_VTAB "Verbal Table" TAB_VERB "%.0" "list" COMPU_TAB_REF AUX_DIG5_state_COMPU_VTAB_REF /end COMPU_METHOD
/begin COMPU_VTAB AUX_DIG5_state_COMPU_VTAB_REF "Verbal Table" TAB_VERB 3 0 "Open (off)" 255 "Ground (on:1)" 1 "+Voltage (on:2)" DEFAULT_VALUE "UNKNOWN" /end COMPU_VTAB
/begin MEASUREMENT AUX_DIG6_state "Aux DIG6 digital state{AUX_DIG6_state&0xff=0:Open (off)}{AUX_DIG6_state&0xff=255:Ground (on:1)}{AUX_DIG6_state&0xff=1:+Voltage (on:2)}" UBYTE AUX_DIG6_state_COMPU_VTAB 0 0 0 255 ECU_ADDRESS 0x010074F0 BIT_MASK 0xff /end MEASUREMENT
/begin COMPU_METHOD AUX_DIG6_state_COMPU_VTAB "Verbal Table" TAB_VERB "%.0" "list" COMPU_TAB_REF AUX_DIG6_state_COMPU_VTAB_REF /end COMPU_METHOD
/begin COMPU_VTAB AUX_DIG6_state_COMPU_VTAB_REF "Verbal Table" TAB_VERB 3 0 "Open (off)" 255 "Ground (on:1)" 1 "+Voltage (on:2)" DEFAULT_VALUE "UNKNOWN" /end COMPU_VTAB
/begin MEASUREMENT AUX_DIG7_state "Aux DIG7 digital state{AUX_DIG7_state&0xff=0:Open (off)}{AUX_DIG7_state&0xff=255:Ground (on:1)}{AUX_DIG7_state&0xff=1:+Voltage (on:2)}" UBYTE AUX_DIG7_state_COMPU_VTAB 0 0 0 255 ECU_ADDRESS 0x010074F8 BIT_MASK 0xff /end MEASUREMENT
/begin COMPU_METHOD AUX_DIG7_state_COMPU_VTAB "Verbal Table" TAB_VERB "%.0" "list" COMPU_TAB_REF AUX_DIG7_state_COMPU_VTAB_REF /end COMPU_METHOD
/begin COMPU_VTAB AUX_DIG7_state_COMPU_VTAB_REF "Verbal Table" TAB_VERB 3 0 "Open (off)" 255 "Ground (on:1)" 1 "+Voltage (on:2)" DEFAULT_VALUE "UNKNOWN" /end COMPU_VTAB
/begin MEASUREMENT AUX_DIG8_state "Aux DIG8 digital state{AUX_DIG8_state&0xff=0:Open (off)}{AUX_DIG8_state&0xff=255:Ground (on:1)}{AUX_DIG8_state&0xff=1:+Voltage (on:2)}" UBYTE AUX_DIG8_state_COMPU_VTAB 0 0 0 255 ECU_ADDRESS 0x01007500 BIT_MASK 0xff /end MEASUREMENT
/begin COMPU_METHOD AUX_DIG8_state_COMPU_VTAB "Verbal Table" TAB_VERB "%.0" "list" COMPU_TAB_REF AUX_DIG8_state_COMPU_VTAB_REF /end COMPU_METHOD
/begin COMPU_VTAB AUX_DIG8_state_COMPU_VTAB_REF "Verbal Table" TAB_VERB 3 0 "Open (off)" 255 "Ground (on:1)" 1 "+Voltage (on:2)" DEFAULT_VALUE "UNKNOWN" /end COMPU_VTAB
/begin CHARACTERISTIC brake_sec_chan "Secondary brake input{brake_sec_chan&0xff=0:Disabled}{brake_sec_chan&0xff=1:Aux PU1}{brake_sec_chan&0xff=2:Aux PU2}{brake_sec_chan&0xff=3:Aux PU3}{brake_sec_chan&0xff=4:Aux PUD1}{brake_sec_chan&0xff=5:Aux PUD2}{brake_sec_chan&0xff=6:Aux PUD3}{brake_sec_ch" VALUE 0x001c8fa5 /* @ECU_Address@brake_sec_chan@0x01007910@ */ ECIPP_ALIGNMENT_UBYTE 255 brake_sec_chan_COMPU_VTAB 0 255 BIT_MASK 0xff /end CHARACTERISTIC
/begin COMPU_METHOD brake_sec_chan_COMPU_VTAB "Verbal Table" TAB_VERB "%.0" "list" COMPU_TAB_REF brake_sec_chan_COMPU_VTAB_REF /end COMPU_METHOD
/begin COMPU_VTAB brake_sec_chan_COMPU_VTAB_REF "Verbal Table" TAB_VERB 16 0 "Disabled" 1 "Aux PU1" 2 "Aux PU2" 3 "Aux PU3" 4 "Aux PUD1" 5 "Aux PUD2" 6 "Aux PUD3" 7 "Aux DIG1" 8 "Aux DIG2" 9 "Aux DIG3" 10 "Aux DIG4" 11 "Aux DIG5" 12 "Aux DIG6" 13 "Aux DIG7" 14 "Aux DIG8" 15 "Aux DIG9" DEFAULT_VALUE "UNKNOWN" /end COMPU_VTAB
/begin CHARACTERISTIC brake_sec_cfg "Secondary brake input config{brake_sec_cfg&0xff=0:Bi/Tri-state Gnd=valid}{brake_sec_cfg&0xff=1:Tri-state +V=valid}{brake_sec_cfg&0xff=2:Aux DIG Open=valid}" VALUE 0x001c8fa4 /* @ECU_Address@brake_sec_cfg@0x01007918@ */ ECIPP_ALIGNMENT_UBYTE 255 brake_sec_cfg_COMPU_VTAB 0 255 BIT_MASK 0xff /end CHARACTERISTIC
/begin COMPU_METHOD brake_sec_cfg_COMPU_VTAB "Verbal Table" TAB_VERB "%.0" "list" COMPU_TAB_REF brake_sec_cfg_COMPU_VTAB_REF /end COMPU_METHOD
/begin COMPU_VTAB brake_sec_cfg_COMPU_VTAB_REF "Verbal Table" TAB_VERB 3 0 "Bi/Tri-state Gnd=valid" 1 "Tri-state +V=valid" 2 "Aux DIG Open=valid" DEFAULT_VALUE "UNKNOWN" /end COMPU_VTAB
/begin MEASUREMENT AUX_DIG2_keyon "Aux DIG2 key-on latch{AUX_DIG2_keyon&0xff=0:Uninitialized}{AUX_DIG2_keyon&0xff=2:Open (off)}{AUX_DIG2_keyon&0xff=1:Ground (on:1)}{AUX_DIG2_keyon&0xff=3:+Voltage (on:2)}" UBYTE AUX_DIG2_keyon_COMPU_VTAB 0 0 0 255 ECU_ADDRESS 0x01007980 BIT_MASK 0xff /end MEASUREMENT
/begin COMPU_METHOD AUX_DIG2_keyon_COMPU_VTAB "Verbal Table" TAB_VERB "%.0" "list" COMPU_TAB_REF AUX_DIG2_keyon_COMPU_VTAB_REF /end COMPU_METHOD
/begin COMPU_VTAB AUX_DIG2_keyon_COMPU_VTAB_REF "Verbal Table" TAB_VERB 4 0 "Uninitialized" 2 "Open (off)" 1 "Ground (on:1)" 3 "+Voltage (on:2)" DEFAULT_VALUE "UNKNOWN" /end COMPU_VTAB
/begin CHARACTERISTIC Gov1_aux_input "Gov1 input function{Gov1_aux_input&0xff=0:Gov 1 select}{Gov1_aux_input&0xff=1:Auxiliary input}" VALUE 0x001c875a /* @ECU_Address@Gov1_aux_input@0x01007A68@ */ ECIPP_ALIGNMENT_UBYTE 255 Gov1_aux_input_COMPU_VTAB 0 255 BIT_MASK 0xff /end CHARACTERISTIC
/begin COMPU_METHOD Gov1_aux_input_COMPU_VTAB "Verbal Table" TAB_VERB "%.0" "list" COMPU_TAB_REF Gov1_aux_input_COMPU_VTAB_REF /end COMPU_METHOD
/begin COMPU_VTAB Gov1_aux_input_COMPU_VTAB_REF "Verbal Table" TAB_VERB 2 0 "Gov 1 select" 1 "Auxiliary input" DEFAULT_VALUE "UNKNOWN" /end COMPU_VTAB
/begin CHARACTERISTIC Gov2_aux_input "Gov2 input function{Gov2_aux_input&0xff=0:Gov 2 select}{Gov2_aux_input&0xff=1:Auxiliary input}" VALUE 0x001c875c /* @ECU_Address@Gov2_aux_input@0x01007A70@ */ ECIPP_ALIGNMENT_UBYTE 255 Gov2_aux_input_COMPU_VTAB 0 255 BIT_MASK 0xff /end CHARACTERISTIC
/begin COMPU_METHOD Gov2_aux_input_COMPU_VTAB "Verbal Table" TAB_VERB "%.0" "list" COMPU_TAB_REF Gov2_aux_input_COMPU_VTAB_REF /end COMPU_METHOD
/begin COMPU_VTAB Gov2_aux_input_COMPU_VTAB_REF "Verbal Table" TAB_VERB 2 0 "Gov 2 select" 1 "Auxiliary input" DEFAULT_VALUE "UNKNOWN" /end COMPU_VTAB
/begin MEASUREMENT AUX_DIG11_state "Aux DIG11 digital state{AUX_DIG11_state&0xff=0:Open (off)}{AUX_DIG11_state&0xff=255:Ground (on:1)}{AUX_DIG11_state&0xff=1:+Voltage (on:2)}" UBYTE AUX_DIG11_state_COMPU_VTAB 0 0 0 255 ECU_ADDRESS 0x01007B40 BIT_MASK 0xff /end MEASUREMENT
/begin COMPU_METHOD AUX_DIG11_state_COMPU_VTAB "Verbal Table" TAB_VERB "%.0" "list" COMPU_TAB_REF AUX_DIG11_state_COMPU_VTAB_REF /end COMPU_METHOD
/begin COMPU_VTAB AUX_DIG11_state_COMPU_VTAB_REF "Verbal Table" TAB_VERB 3 0 "Open (off)" 255 "Ground (on:1)" 1 "+Voltage (on:2)" DEFAULT_VALUE "UNKNOWN" /end COMPU_VTAB
/begin MEASUREMENT AUX_DIG9_state "Aux DIG9 digital state{AUX_DIG9_state&0xff=0:Open (off)}{AUX_DIG9_state&0xff=255:Ground (on:1)}{AUX_DIG9_state&0xff=1:+Voltage (on:2)}" UBYTE AUX_DIG9_state_COMPU_VTAB 0 0 0 255 ECU_ADDRESS 0x01007B78 BIT_MASK 0xff /end MEASUREMENT
/begin COMPU_METHOD AUX_DIG9_state_COMPU_VTAB "Verbal Table" TAB_VERB "%.0" "list" COMPU_TAB_REF AUX_DIG9_state_COMPU_VTAB_REF /end COMPU_METHOD
/begin COMPU_VTAB AUX_DIG9_state_COMPU_VTAB_REF "Verbal Table" TAB_VERB 3 0 "Open (off)" 255 "Ground (on:1)" 1 "+Voltage (on:2)" DEFAULT_VALUE "UNKNOWN" /end COMPU_VTAB
/begin MEASUREMENT AUX_DIG10_state "Aux DIG10 digital state{AUX_DIG10_state&0xff=0:Open (off)}{AUX_DIG10_state&0xff=255:Ground (on:1)}{AUX_DIG10_state&0xff=1:+Voltage (on:2)}" UBYTE AUX_DIG10_state_COMPU_VTAB 0 0 0 255 ECU_ADDRESS 0x01007B90 BIT_MASK 0xff /end MEASUREMENT
/begin COMPU_METHOD AUX_DIG10_state_COMPU_VTAB "Verbal Table" TAB_VERB "%.0" "list" COMPU_TAB_REF AUX_DIG10_state_COMPU_VTAB_REF /end COMPU_METHOD
/begin COMPU_VTAB AUX_DIG10_state_COMPU_VTAB_REF "Verbal Table" TAB_VERB 3 0 "Open (off)" 255 "Ground (on:1)" 1 "+Voltage (on:2)" DEFAULT_VALUE "UNKNOWN" /end COMPU_VTAB
/begin MEASUREMENT AUX_DIG12_state "Aux DIG12 digital state{AUX_DIG12_state&0xff=0:Open (off)}{AUX_DIG12_state&0xff=255:Ground (on:1)}{AUX_DIG12_state&0xff=1:+Voltage (on:2)}" UBYTE AUX_DIG12_state_COMPU_VTAB 0 0 0 255 ECU_ADDRESS 0x01007BA0 BIT_MASK 0xff /end MEASUREMENT
/begin COMPU_METHOD AUX_DIG12_state_COMPU_VTAB "Verbal Table" TAB_VERB "%.0" "list" COMPU_TAB_REF AUX_DIG12_state_COMPU_VTAB_REF /end COMPU_METHOD
/begin COMPU_VTAB AUX_DIG12_state_COMPU_VTAB_REF "Verbal Table" TAB_VERB 3 0 "Open (off)" 255 "Ground (on:1)" 1 "+Voltage (on:2)" DEFAULT_VALUE "UNKNOWN" /end COMPU_VTAB
/begin MEASUREMENT AUX_DIG13_state "Aux DIG13 digital state{AUX_DIG13_state&0xff=0:Open (off)}{AUX_DIG13_state&0xff=255:Ground (on:1)}{AUX_DIG13_state&0xff=1:+Voltage (on:2)}" UBYTE AUX_DIG13_state_COMPU_VTAB 0 0 0 255 ECU_ADDRESS 0x01007D78 BIT_MASK 0xff /end MEASUREMENT
/begin COMPU_METHOD AUX_DIG13_state_COMPU_VTAB "Verbal Table" TAB_VERB "%.0" "list" COMPU_TAB_REF AUX_DIG13_state_COMPU_VTAB_REF /end COMPU_METHOD
/begin COMPU_VTAB AUX_DIG13_state_COMPU_VTAB_REF "Verbal Table" TAB_VERB 3 0 "Open (off)" 255 "Ground (on:1)" 1 "+Voltage (on:2)" DEFAULT_VALUE "UNKNOWN" /end COMPU_VTAB
/begin MEASUREMENT AUX_DIG14_state "Aux DIG14 digital state{AUX_DIG14_state&0xff=0:Open (off)}{AUX_DIG14_state&0xff=255:Ground (on:1)}{AUX_DIG14_state&0xff=1:+Voltage (on:2)}" UBYTE AUX_DIG14_state_COMPU_VTAB 0 0 0 255 ECU_ADDRESS 0x01007D90 BIT_MASK 0xff /end MEASUREMENT
/begin COMPU_METHOD AUX_DIG14_state_COMPU_VTAB "Verbal Table" TAB_VERB "%.0" "list" COMPU_TAB_REF AUX_DIG14_state_COMPU_VTAB_REF /end COMPU_METHOD
/begin COMPU_VTAB AUX_DIG14_state_COMPU_VTAB_REF "Verbal Table" TAB_VERB 3 0 "Open (off)" 255 "Ground (on:1)" 1 "+Voltage (on:2)" DEFAULT_VALUE "UNKNOWN" /end COMPU_VTAB
/begin MEASUREMENT AUX_DIG15_state "Aux DIG15 digital state{AUX_DIG15_state&0xff=0:Open (off)}{AUX_DIG15_state&0xff=255:Ground (on:1)}{AUX_DIG15_state&0xff=1:+Voltage (on:2)}" UBYTE AUX_DIG15_state_COMPU_VTAB 0 0 0 255 ECU_ADDRESS 0x01007DA8 BIT_MASK 0xff /end MEASUREMENT
/begin COMPU_METHOD AUX_DIG15_state_COMPU_VTAB "Verbal Table" TAB_VERB "%.0" "list" COMPU_TAB_REF AUX_DIG15_state_COMPU_VTAB_REF /end COMPU_METHOD
/begin COMPU_VTAB AUX_DIG15_state_COMPU_VTAB_REF "Verbal Table" TAB_VERB 3 0 "Open (off)" 255 "Ground (on:1)" 1 "+Voltage (on:2)" DEFAULT_VALUE "UNKNOWN" /end COMPU_VTAB
/begin MEASUREMENT AUX_DIG16_state "Aux DIG16 digital state{AUX_DIG16_state&0xff=0:Open (off)}{AUX_DIG16_state&0xff=255:Ground (on:1)}{AUX_DIG16_state&0xff=1:+Voltage (on:2)}" UBYTE AUX_DIG16_state_COMPU_VTAB 0 0 0 255 ECU_ADDRESS 0x01007DC0 BIT_MASK 0xff /end MEASUREMENT
/begin COMPU_METHOD AUX_DIG16_state_COMPU_VTAB "Verbal Table" TAB_VERB "%.0" "list" COMPU_TAB_REF AUX_DIG16_state_COMPU_VTAB_REF /end COMPU_METHOD
/begin COMPU_VTAB AUX_DIG16_state_COMPU_VTAB_REF "Verbal Table" TAB_VERB 3 0 "Open (off)" 255 "Ground (on:1)" 1 "+Voltage (on:2)" DEFAULT_VALUE "UNKNOWN" /end COMPU_VTAB
/begin MEASUREMENT AUX_DIG17_state "Aux DIG17 digital state{AUX_DIG17_state&0xff=0:Open (off)}{AUX_DIG17_state&0xff=255:Ground (on:1)}{AUX_DIG17_state&0xff=1:+Voltage (on:2)}" UBYTE AUX_DIG17_state_COMPU_VTAB 0 0 0 255 ECU_ADDRESS 0x01007DD8 BIT_MASK 0xff /end MEASUREMENT
/begin COMPU_METHOD AUX_DIG17_state_COMPU_VTAB "Verbal Table" TAB_VERB "%.0" "list" COMPU_TAB_REF AUX_DIG17_state_COMPU_VTAB_REF /end COMPU_METHOD
/begin COMPU_VTAB AUX_DIG17_state_COMPU_VTAB_REF "Verbal Table" TAB_VERB 3 0 "Open (off)" 255 "Ground (on:1)" 1 "+Voltage (on:2)" DEFAULT_VALUE "UNKNOWN" /end COMPU_VTAB
/begin MEASUREMENT AUX_DIG18_state "Aux DIG18 digital state{AUX_DIG18_state&0xff=0:Open (off)}{AUX_DIG18_state&0xff=255:Ground (on:1)}{AUX_DIG18_state&0xff=1:+Voltage (on:2)}" UBYTE AUX_DIG18_state_COMPU_VTAB 0 0 0 255 ECU_ADDRESS 0x01007DF0 BIT_MASK 0xff /end MEASUREMENT
/begin COMPU_METHOD AUX_DIG18_state_COMPU_VTAB "Verbal Table" TAB_VERB "%.0" "list" COMPU_TAB_REF AUX_DIG18_state_COMPU_VTAB_REF /end COMPU_METHOD
/begin COMPU_VTAB AUX_DIG18_state_COMPU_VTAB_REF "Verbal Table" TAB_VERB 3 0 "Open (off)" 255 "Ground (on:1)" 1 "+Voltage (on:2)" DEFAULT_VALUE "UNKNOWN" /end COMPU_VTAB
/begin MEASUREMENT AUX_DIG19_state "Aux DIG19 digital state{AUX_DIG19_state&0xff=0:Open (off)}{AUX_DIG19_state&0xff=255:Ground (on:1)}{AUX_DIG19_state&0xff=1:+Voltage (on:2)}" UBYTE AUX_DIG19_state_COMPU_VTAB 0 0 0 255 ECU_ADDRESS 0x01007E08 BIT_MASK 0xff /end MEASUREMENT
/begin COMPU_METHOD AUX_DIG19_state_COMPU_VTAB "Verbal Table" TAB_VERB "%.0" "list" COMPU_TAB_REF AUX_DIG19_state_COMPU_VTAB_REF /end COMPU_METHOD
/begin COMPU_VTAB AUX_DIG19_state_COMPU_VTAB_REF "Verbal Table" TAB_VERB 3 0 "Open (off)" 255 "Ground (on:1)" 1 "+Voltage (on:2)" DEFAULT_VALUE "UNKNOWN" /end COMPU_VTAB
/begin MEASUREMENT AUX_PUD4_state "Aux PUD4 digital state{AUX_PUD4_state&0xff=0:Open (off)}{AUX_PUD4_state&0xff=1:Ground (on)}" UBYTE AUX_PUD4_state_COMPU_VTAB 0 0 0 255 ECU_ADDRESS 0x01007E98 BIT_MASK 0xff /end MEASUREMENT
/begin COMPU_METHOD AUX_PUD4_state_COMPU_VTAB "Verbal Table" TAB_VERB "%.0" "list" COMPU_TAB_REF AUX_PUD4_state_COMPU_VTAB_REF /end COMPU_METHOD
/begin COMPU_VTAB AUX_PUD4_state_COMPU_VTAB_REF "Verbal Table" TAB_VERB 2 0 "Open (off)" 1 "Ground (on)" DEFAULT_VALUE "UNKNOWN" /end COMPU_VTAB
/begin MEASUREMENT AUX_PUD5_state "Aux PUD5 digital state{AUX_PUD5_state&0xff=0:Open (off)}{AUX_PUD5_state&0xff=1:Ground (on)}" UBYTE AUX_PUD5_state_COMPU_VTAB 0 0 0 255 ECU_ADDRESS 0x01007EA0 BIT_MASK 0xff /end MEASUREMENT
/begin COMPU_METHOD AUX_PUD5_state_COMPU_VTAB "Verbal Table" TAB_VERB "%.0" "list" COMPU_TAB_REF AUX_PUD5_state_COMPU_VTAB_REF /end COMPU_METHOD
/begin COMPU_VTAB AUX_PUD5_state_COMPU_VTAB_REF "Verbal Table" TAB_VERB 2 0 "Open (off)" 1 "Ground (on)" DEFAULT_VALUE "UNKNOWN" /end COMPU_VTAB
/begin MEASUREMENT AUX_PUD6_state "Aux PUD6 digital state{AUX_PUD6_state&0xff=0:Open (off)}{AUX_PUD6_state&0xff=1:Ground (on)}" UBYTE AUX_PUD6_state_COMPU_VTAB 0 0 0 255 ECU_ADDRESS 0x01007EA8 BIT_MASK 0xff /end MEASUREMENT
/begin COMPU_METHOD AUX_PUD6_state_COMPU_VTAB "Verbal Table" TAB_VERB "%.0" "list" COMPU_TAB_REF AUX_PUD6_state_COMPU_VTAB_REF /end COMPU_METHOD
/begin COMPU_VTAB AUX_PUD6_state_COMPU_VTAB_REF "Verbal Table" TAB_VERB 2 0 "Open (off)" 1 "Ground (on)" DEFAULT_VALUE "UNKNOWN" /end COMPU_VTAB
/begin MEASUREMENT AUX_PUD7_state "Aux PUD7 digital state{AUX_PUD7_state&0xff=0:Open (off)}{AUX_PUD7_state&0xff=1:Ground (on)}" UBYTE AUX_PUD7_state_COMPU_VTAB 0 0 0 255 ECU_ADDRESS 0x01007EB0 BIT_MASK 0xff /end MEASUREMENT
/begin COMPU_METHOD AUX_PUD7_state_COMPU_VTAB "Verbal Table" TAB_VERB "%.0" "list" COMPU_TAB_REF AUX_PUD7_state_COMPU_VTAB_REF /end COMPU_METHOD
/begin COMPU_VTAB AUX_PUD7_state_COMPU_VTAB_REF "Verbal Table" TAB_VERB 2 0 "Open (off)" 1 "Ground (on)" DEFAULT_VALUE "UNKNOWN" /end COMPU_VTAB
/begin MEASUREMENT AUX_PUD8_state "Aux PUD8 digital state{AUX_PUD8_state&0xff=0:Open (off)}{AUX_PUD8_state&0xff=1:Ground (on)}" UBYTE AUX_PUD8_state_COMPU_VTAB 0 0 0 255 ECU_ADDRESS 0x01007EB8 BIT_MASK 0xff /end MEASUREMENT
/begin COMPU_METHOD AUX_PUD8_state_COMPU_VTAB "Verbal Table" TAB_VERB "%.0" "list" COMPU_TAB_REF AUX_PUD8_state_COMPU_VTAB_REF /end COMPU_METHOD
/begin COMPU_VTAB AUX_PUD8_state_COMPU_VTAB_REF "Verbal Table" TAB_VERB 2 0 "Open (off)" 1 "Ground (on)" DEFAULT_VALUE "UNKNOWN" /end COMPU_VTAB
/begin MEASUREMENT AUX_PUD9_state "Aux PUD9 digital state{AUX_PUD9_state&0xff=0:Open (off)}{AUX_PUD9_state&0xff=1:Ground (on)}" UBYTE AUX_PUD9_state_COMPU_VTAB 0 0 0 255 ECU_ADDRESS 0x01007EC0 BIT_MASK 0xff /end MEASUREMENT
/begin COMPU_METHOD AUX_PUD9_state_COMPU_VTAB "Verbal Table" TAB_VERB "%.0" "list" COMPU_TAB_REF AUX_PUD9_state_COMPU_VTAB_REF /end COMPU_METHOD
/begin COMPU_VTAB AUX_PUD9_state_COMPU_VTAB_REF "Verbal Table" TAB_VERB 2 0 "Open (off)" 1 "Ground (on)" DEFAULT_VALUE "UNKNOWN" /end COMPU_VTAB
/begin MEASUREMENT AUX_PUD10_state "Aux PUD10 digital state{AUX_PUD10_state&0xff=0:Open (off)}{AUX_PUD10_state&0xff=1:Ground (on)}" UBYTE AUX_PUD10_state_COMPU_VTAB 0 0 0 255 ECU_ADDRESS 0x01007EC8 BIT_MASK 0xff /end MEASUREMENT
/begin COMPU_METHOD AUX_PUD10_state_COMPU_VTAB "Verbal Table" TAB_VERB "%.0" "list" COMPU_TAB_REF AUX_PUD10_state_COMPU_VTAB_REF /end COMPU_METHOD
/begin COMPU_VTAB AUX_PUD10_state_COMPU_VTAB_REF "Verbal Table" TAB_VERB 2 0 "Open (off)" 1 "Ground (on)" DEFAULT_VALUE "UNKNOWN" /end COMPU_VTAB
/begin MEASUREMENT AUX_PUD11_state "Aux PUD11 digital state{AUX_PUD11_state&0xff=0:Open (off)}{AUX_PUD11_state&0xff=1:Ground (on)}" UBYTE AUX_PUD11_state_COMPU_VTAB 0 0 0 255 ECU_ADDRESS 0x01007ED0 BIT_MASK 0xff /end MEASUREMENT
/begin COMPU_METHOD AUX_PUD11_state_COMPU_VTAB "Verbal Table" TAB_VERB "%.0" "list" COMPU_TAB_REF AUX_PUD11_state_COMPU_VTAB_REF /end COMPU_METHOD
/begin COMPU_VTAB AUX_PUD11_state_COMPU_VTAB_REF "Verbal Table" TAB_VERB 2 0 "Open (off)" 1 "Ground (on)" DEFAULT_VALUE "UNKNOWN" /end COMPU_VTAB
/begin MEASUREMENT AUX_PUD12_state "Aux PUD12 digital state{AUX_PUD12_state&0xff=0:Open (off)}{AUX_PUD12_state&0xff=1:Ground (on)}" UBYTE AUX_PUD12_state_COMPU_VTAB 0 0 0 255 ECU_ADDRESS 0x01007ED8 BIT_MASK 0xff /end MEASUREMENT
/begin COMPU_METHOD AUX_PUD12_state_COMPU_VTAB "Verbal Table" TAB_VERB "%.0" "list" COMPU_TAB_REF AUX_PUD12_state_COMPU_VTAB_REF /end COMPU_METHOD
/begin COMPU_VTAB AUX_PUD12_state_COMPU_VTAB_REF "Verbal Table" TAB_VERB 2 0 "Open (off)" 1 "Ground (on)" DEFAULT_VALUE "UNKNOWN" /end COMPU_VTAB
/begin MEASUREMENT AUX_PUD13_state "Aux PUD13 digital state{AUX_PUD13_state&0xff=0:Open (off)}{AUX_PUD13_state&0xff=1:Ground (on)}" UBYTE AUX_PUD13_state_COMPU_VTAB 0 0 0 255 ECU_ADDRESS 0x01007EE0 BIT_MASK 0xff /end MEASUREMENT
/begin COMPU_METHOD AUX_PUD13_state_COMPU_VTAB "Verbal Table" TAB_VERB "%.0" "list" COMPU_TAB_REF AUX_PUD13_state_COMPU_VTAB_REF /end COMPU_METHOD
/begin COMPU_VTAB AUX_PUD13_state_COMPU_VTAB_REF "Verbal Table" TAB_VERB 2 0 "Open (off)" 1 "Ground (on)" DEFAULT_VALUE "UNKNOWN" /end COMPU_VTAB
/begin MEASUREMENT AUX_PUD14_state "Aux PUD14 digital state{AUX_PUD14_state&0xff=0:Open (off)}{AUX_PUD14_state&0xff=1:Ground (on)}" UBYTE AUX_PUD14_state_COMPU_VTAB 0 0 0 255 ECU_ADDRESS 0x01007EE8 BIT_MASK 0xff /end MEASUREMENT
/begin COMPU_METHOD AUX_PUD14_state_COMPU_VTAB "Verbal Table" TAB_VERB "%.0" "list" COMPU_TAB_REF AUX_PUD14_state_COMPU_VTAB_REF /end COMPU_METHOD
/begin COMPU_VTAB AUX_PUD14_state_COMPU_VTAB_REF "Verbal Table" TAB_VERB 2 0 "Open (off)" 1 "Ground (on)" DEFAULT_VALUE "UNKNOWN" /end COMPU_VTAB
/begin MEASUREMENT AUX_PUD15_state "Aux PUD15 digital state{AUX_PUD15_state&0xff=0:Open (off)}{AUX_PUD15_state&0xff=1:Ground (on)}" UBYTE AUX_PUD15_state_COMPU_VTAB 0 0 0 255 ECU_ADDRESS 0x01007EF0 BIT_MASK 0xff /end MEASUREMENT
/begin COMPU_METHOD AUX_PUD15_state_COMPU_VTAB "Verbal Table" TAB_VERB "%.0" "list" COMPU_TAB_REF AUX_PUD15_state_COMPU_VTAB_REF /end COMPU_METHOD
/begin COMPU_VTAB AUX_PUD15_state_COMPU_VTAB_REF "Verbal Table" TAB_VERB 2 0 "Open (off)" 1 "Ground (on)" DEFAULT_VALUE "UNKNOWN" /end COMPU_VTAB
/begin MEASUREMENT AUX_PUD16_state "Aux PUD16 digital state{AUX_PUD16_state&0xff=0:Open (off)}{AUX_PUD16_state&0xff=1:Ground (on)}" UBYTE AUX_PUD16_state_COMPU_VTAB 0 0 0 255 ECU_ADDRESS 0x01007EF8 BIT_MASK 0xff /end MEASUREMENT
/begin COMPU_METHOD AUX_PUD16_state_COMPU_VTAB "Verbal Table" TAB_VERB "%.0" "list" COMPU_TAB_REF AUX_PUD16_state_COMPU_VTAB_REF /end COMPU_METHOD
/begin COMPU_VTAB AUX_PUD16_state_COMPU_VTAB_REF "Verbal Table" TAB_VERB 2 0 "Open (off)" 1 "Ground (on)" DEFAULT_VALUE "UNKNOWN" /end COMPU_VTAB
/begin MEASUREMENT AUX_PUD17_state "Aux PUD17 digital state{AUX_PUD17_state&0xff=0:Open (off)}{AUX_PUD17_state&0xff=1:Ground (on)}" UBYTE AUX_PUD17_state_COMPU_VTAB 0 0 0 255 ECU_ADDRESS 0x01007F00 BIT_MASK 0xff /end MEASUREMENT
/begin COMPU_METHOD AUX_PUD17_state_COMPU_VTAB "Verbal Table" TAB_VERB "%.0" "list" COMPU_TAB_REF AUX_PUD17_state_COMPU_VTAB_REF /end COMPU_METHOD
/begin COMPU_VTAB AUX_PUD17_state_COMPU_VTAB_REF "Verbal Table" TAB_VERB 2 0 "Open (off)" 1 "Ground (on)" DEFAULT_VALUE "UNKNOWN" /end COMPU_VTAB
/begin MEASUREMENT AUX_PUD18_state "Aux PUD18 digital state{AUX_PUD18_state&0xff=0:Open (off)}{AUX_PUD18_state&0xff=1:Ground (on)}" UBYTE AUX_PUD18_state_COMPU_VTAB 0 0 0 255 ECU_ADDRESS 0x01007F08 BIT_MASK 0xff /end MEASUREMENT
/begin COMPU_METHOD AUX_PUD18_state_COMPU_VTAB "Verbal Table" TAB_VERB "%.0" "list" COMPU_TAB_REF AUX_PUD18_state_COMPU_VTAB_REF /end COMPU_METHOD
/begin COMPU_VTAB AUX_PUD18_state_COMPU_VTAB_REF "Verbal Table" TAB_VERB 2 0 "Open (off)" 1 "Ground (on)" DEFAULT_VALUE "UNKNOWN" /end COMPU_VTAB
/begin MEASUREMENT AUX_PUD19_state "Aux PUD19 digital state{AUX_PUD19_state&0xff=0:Open (off)}{AUX_PUD19_state&0xff=1:Ground (on)}" UBYTE AUX_PUD19_state_COMPU_VTAB 0 0 0 255 ECU_ADDRESS 0x01007F10 BIT_MASK 0xff /end MEASUREMENT
/begin COMPU_METHOD AUX_PUD19_state_COMPU_VTAB "Verbal Table" TAB_VERB "%.0" "list" COMPU_TAB_REF AUX_PUD19_state_COMPU_VTAB_REF /end COMPU_METHOD
/begin COMPU_VTAB AUX_PUD19_state_COMPU_VTAB_REF "Verbal Table" TAB_VERB 2 0 "Open (off)" 1 "Ground (on)" DEFAULT_VALUE "UNKNOWN" /end COMPU_VTAB
/begin MEASUREMENT AUX_PUD20_state "Aux PUD20 digital state{AUX_PUD20_state&0xff=0:Open (off)}{AUX_PUD20_state&0xff=1:Ground (on)}" UBYTE AUX_PUD20_state_COMPU_VTAB 0 0 0 255 ECU_ADDRESS 0x01007F18 BIT_MASK 0xff /end MEASUREMENT
/begin COMPU_METHOD AUX_PUD20_state_COMPU_VTAB "Verbal Table" TAB_VERB "%.0" "list" COMPU_TAB_REF AUX_PUD20_state_COMPU_VTAB_REF /end COMPU_METHOD
/begin COMPU_VTAB AUX_PUD20_state_COMPU_VTAB_REF "Verbal Table" TAB_VERB 2 0 "Open (off)" 1 "Ground (on)" DEFAULT_VALUE "UNKNOWN" /end COMPU_VTAB
/begin MEASUREMENT AUX_PUD21_state "Aux PUD21 digital state{AUX_PUD21_state&0xff=0:Open (off)}{AUX_PUD21_state&0xff=1:Ground (on)}" UBYTE AUX_PUD21_state_COMPU_VTAB 0 0 0 255 ECU_ADDRESS 0x01007F20 BIT_MASK 0xff /end MEASUREMENT
/begin COMPU_METHOD AUX_PUD21_state_COMPU_VTAB "Verbal Table" TAB_VERB "%.0" "list" COMPU_TAB_REF AUX_PUD21_state_COMPU_VTAB_REF /end COMPU_METHOD
/begin COMPU_VTAB AUX_PUD21_state_COMPU_VTAB_REF "Verbal Table" TAB_VERB 2 0 "Open (off)" 1 "Ground (on)" DEFAULT_VALUE "UNKNOWN" /end COMPU_VTAB
/begin MEASUREMENT AUX_PUD22_state "Aux PUD22 digital state{AUX_PUD22_state&0xff=0:Open (off)}{AUX_PUD22_state&0xff=1:Ground (on)}" UBYTE AUX_PUD22_state_COMPU_VTAB 0 0 0 255 ECU_ADDRESS 0x01007F28 BIT_MASK 0xff /end MEASUREMENT
/begin COMPU_METHOD AUX_PUD22_state_COMPU_VTAB "Verbal Table" TAB_VERB "%.0" "list" COMPU_TAB_REF AUX_PUD22_state_COMPU_VTAB_REF /end COMPU_METHOD
/begin COMPU_VTAB AUX_PUD22_state_COMPU_VTAB_REF "Verbal Table" TAB_VERB 2 0 "Open (off)" 1 "Ground (on)" DEFAULT_VALUE "UNKNOWN" /end COMPU_VTAB
/begin MEASUREMENT AUX_PUD23_state "Aux PUD23 digital state{AUX_PUD23_state&0xff=0:Open (off)}{AUX_PUD23_state&0xff=1:Ground (on)}" UBYTE AUX_PUD23_state_COMPU_VTAB 0 0 0 255 ECU_ADDRESS 0x01007F30 BIT_MASK 0xff /end MEASUREMENT
/begin COMPU_METHOD AUX_PUD23_state_COMPU_VTAB "Verbal Table" TAB_VERB "%.0" "list" COMPU_TAB_REF AUX_PUD23_state_COMPU_VTAB_REF /end COMPU_METHOD
/begin COMPU_VTAB AUX_PUD23_state_COMPU_VTAB_REF "Verbal Table" TAB_VERB 2 0 "Open (off)" 1 "Ground (on)" DEFAULT_VALUE "UNKNOWN" /end COMPU_VTAB
/begin MEASUREMENT AUX_PUD24_state "Aux PUD24 digital state{AUX_PUD24_state&0xff=0:Open (off)}{AUX_PUD24_state&0xff=1:Ground (on)}" UBYTE AUX_PUD24_state_COMPU_VTAB 0 0 0 255 ECU_ADDRESS 0x01007F38 BIT_MASK 0xff /end MEASUREMENT
/begin COMPU_METHOD AUX_PUD24_state_COMPU_VTAB "Verbal Table" TAB_VERB "%.0" "list" COMPU_TAB_REF AUX_PUD24_state_COMPU_VTAB_REF /end COMPU_METHOD
/begin COMPU_VTAB AUX_PUD24_state_COMPU_VTAB_REF "Verbal Table" TAB_VERB 2 0 "Open (off)" 1 "Ground (on)" DEFAULT_VALUE "UNKNOWN" /end COMPU_VTAB
/begin MEASUREMENT AUX_PUD25_state "Aux PUD25 digital state{AUX_PUD25_state&0xff=0:Open (off)}{AUX_PUD25_state&0xff=1:Ground (on)}" UBYTE AUX_PUD25_state_COMPU_VTAB 0 0 0 255 ECU_ADDRESS 0x01007F40 BIT_MASK 0xff /end MEASUREMENT
/begin COMPU_METHOD AUX_PUD25_state_COMPU_VTAB "Verbal Table" TAB_VERB "%.0" "list" COMPU_TAB_REF AUX_PUD25_state_COMPU_VTAB_REF /end COMPU_METHOD
/begin COMPU_VTAB AUX_PUD25_state_COMPU_VTAB_REF "Verbal Table" TAB_VERB 2 0 "Open (off)" 1 "Ground (on)" DEFAULT_VALUE "UNKNOWN" /end COMPU_VTAB
/begin MEASUREMENT AUX_DIG20_state "Aux DIG20 digital state{AUX_DIG20_state&0xff=0:Open (off)}{AUX_DIG20_state&0xff=255:Ground (on:1)}{AUX_DIG20_state&0xff=1:+Voltage (on:2)}" UBYTE AUX_DIG20_state_COMPU_VTAB 0 0 0 255 ECU_ADDRESS 0x01008708 BIT_MASK 0xff /end MEASUREMENT
/begin COMPU_METHOD AUX_DIG20_state_COMPU_VTAB "Verbal Table" TAB_VERB "%.0" "list" COMPU_TAB_REF AUX_DIG20_state_COMPU_VTAB_REF /end COMPU_METHOD
/begin COMPU_VTAB AUX_DIG20_state_COMPU_VTAB_REF "Verbal Table" TAB_VERB 3 0 "Open (off)" 255 "Ground (on:1)" 1 "+Voltage (on:2)" DEFAULT_VALUE "UNKNOWN" /end COMPU_VTAB
/begin MEASUREMENT AUX_DIG21_state "Aux DIG21 digital state{AUX_DIG21_state&0xff=0:Open (off)}{AUX_DIG21_state&0xff=255:Ground (on:1)}{AUX_DIG21_state&0xff=1:+Voltage (on:2)}" UBYTE AUX_DIG21_state_COMPU_VTAB 0 0 0 255 ECU_ADDRESS 0x01008720 BIT_MASK 0xff /end MEASUREMENT
/begin COMPU_METHOD AUX_DIG21_state_COMPU_VTAB "Verbal Table" TAB_VERB "%.0" "list" COMPU_TAB_REF AUX_DIG21_state_COMPU_VTAB_REF /end COMPU_METHOD
/begin COMPU_VTAB AUX_DIG21_state_COMPU_VTAB_REF "Verbal Table" TAB_VERB 3 0 "Open (off)" 255 "Ground (on:1)" 1 "+Voltage (on:2)" DEFAULT_VALUE "UNKNOWN" /end COMPU_VTAB
/begin MEASUREMENT AUX_DIG22_state "Aux DIG22 digital state{AUX_DIG22_state&0xff=0:Open (off)}{AUX_DIG22_state&0xff=255:Ground (on:1)}{AUX_DIG22_state&0xff=1:+Voltage (on:2)}" UBYTE AUX_DIG22_state_COMPU_VTAB 0 0 0 255 ECU_ADDRESS 0x01008738 BIT_MASK 0xff /end MEASUREMENT
/begin COMPU_METHOD AUX_DIG22_state_COMPU_VTAB "Verbal Table" TAB_VERB "%.0" "list" COMPU_TAB_REF AUX_DIG22_state_COMPU_VTAB_REF /end COMPU_METHOD
/begin COMPU_VTAB AUX_DIG22_state_COMPU_VTAB_REF "Verbal Table" TAB_VERB 3 0 "Open (off)" 255 "Ground (on:1)" 1 "+Voltage (on:2)" DEFAULT_VALUE "UNKNOWN" /end COMPU_VTAB
/begin CHARACTERISTIC fuellev_low_pct "Fuel level low threshold" VALUE 0x001c8452 /* @ECU_Address@fuellev_low_pct@0x0100C008@ */ ECIPP_ALIGNMENT_UWORD 100 Compu_fuellev_low_pct 0 99.9984741210938 /end CHARACTERISTIC
/begin COMPU_METHOD Compu_fuellev_low_pct " " RAT_FUNC "%.1" "%" COEFFS 0 655.36 0 0 0 1 /end COMPU_METHOD
/begin CHARACTERISTIC fuellev_low_latch "Fuel level low latch" VALUE 0x001c8450 /* @ECU_Address@fuellev_low_latch@0x0100C010@ */ ECIPP_ALIGNMENT_UWORD 66 Compu_fuellev_low_latch 0 65.535 /end CHARACTERISTIC
/begin COMPU_METHOD Compu_fuellev_low_latch " " RAT_FUNC "%.1" "sec" COEFFS 0 1000 0 0 0 1 /end COMPU_METHOD
/begin CHARACTERISTIC fuellev_low_unlatch "Fuel level low unlatch" VALUE 0x001c8454 /* @ECU_Address@fuellev_low_unlatch@0x0100C018@ */ ECIPP_ALIGNMENT_UWORD 66 Compu_fuellev_low_unlatch 0 65.535 /end CHARACTERISTIC
/begin COMPU_METHOD Compu_fuellev_low_unlatch " " RAT_FUNC "%.1" "sec" COEFFS 0 1000 0 0 0 1 /end COMPU_METHOD
/begin MEASUREMENT fuellev_low_tmr "Fuel level low latch" UWORD Compu_fuellev_low_tmr 0 0 0 99.9984741210938 ECU_ADDRESS 0x0100C020 /end MEASUREMENT
/begin COMPU_METHOD Compu_fuellev_low_tmr " " RAT_FUNC "%.0" "%" COEFFS 0 655.36 0 0 0 1 /end COMPU_METHOD
/begin MEASUREMENT AUX_DIG23_state "Aux DIG23 digital state{AUX_DIG23_state&0xff=0:Open (off)}{AUX_DIG23_state&0xff=255:Ground (on:1)}{AUX_DIG23_state&0xff=1:+Voltage (on:2)}" UBYTE AUX_DIG23_state_COMPU_VTAB 0 0 0 255 ECU_ADDRESS 0x0100D208 BIT_MASK 0xff /end MEASUREMENT
/begin COMPU_METHOD AUX_DIG23_state_COMPU_VTAB "Verbal Table" TAB_VERB "%.0" "list" COMPU_TAB_REF AUX_DIG23_state_COMPU_VTAB_REF /end COMPU_METHOD
/begin COMPU_VTAB AUX_DIG23_state_COMPU_VTAB_REF "Verbal Table" TAB_VERB 3 0 "Open (off)" 255 "Ground (on:1)" 1 "+Voltage (on:2)" DEFAULT_VALUE "UNKNOWN" /end COMPU_VTAB
/begin MEASUREMENT AUX_DIG24_state "Aux DIG24 digital state{AUX_DIG24_state&0xff=0:Open (off)}{AUX_DIG24_state&0xff=255:Ground (on:1)}{AUX_DIG24_state&0xff=1:+Voltage (on:2)}" UBYTE AUX_DIG24_state_COMPU_VTAB 0 0 0 255 ECU_ADDRESS 0x0100D220 BIT_MASK 0xff /end MEASUREMENT
/begin COMPU_METHOD AUX_DIG24_state_COMPU_VTAB "Verbal Table" TAB_VERB "%.0" "list" COMPU_TAB_REF AUX_DIG24_state_COMPU_VTAB_REF /end COMPU_METHOD
/begin COMPU_VTAB AUX_DIG24_state_COMPU_VTAB_REF "Verbal Table" TAB_VERB 3 0 "Open (off)" 255 "Ground (on:1)" 1 "+Voltage (on:2)" DEFAULT_VALUE "UNKNOWN" /end COMPU_VTAB
/begin MEASUREMENT AUX_DIG25_state "Aux DIG25 digital state{AUX_DIG25_state&0xff=0:Open (off)}{AUX_DIG25_state&0xff=255:Ground (on:1)}{AUX_DIG25_state&0xff=1:+Voltage (on:2)}" UBYTE AUX_DIG25_state_COMPU_VTAB 0 0 0 255 ECU_ADDRESS 0x0100D238 BIT_MASK 0xff /end MEASUREMENT
/begin COMPU_METHOD AUX_DIG25_state_COMPU_VTAB "Verbal Table" TAB_VERB "%.0" "list" COMPU_TAB_REF AUX_DIG25_state_COMPU_VTAB_REF /end COMPU_METHOD
/begin COMPU_VTAB AUX_DIG25_state_COMPU_VTAB_REF "Verbal Table" TAB_VERB 3 0 "Open (off)" 255 "Ground (on:1)" 1 "+Voltage (on:2)" DEFAULT_VALUE "UNKNOWN" /end COMPU_VTAB
/begin CHARACTERISTIC mfi_rsc_ena "Roadspeed cruise{mfi_rsc_ena&0xff=0:Disabled}{mfi_rsc_ena&0xff=1:Enabled}" VALUE 0x001c9072 /* @ECU_Address@mfi_rsc_ena@0x0100D7A0@ */ ECIPP_ALIGNMENT_UBYTE 255 mfi_rsc_ena_COMPU_VTAB 0 255 BIT_MASK 0xff /end CHARACTERISTIC
/begin COMPU_METHOD mfi_rsc_ena_COMPU_VTAB "Verbal Table" TAB_VERB "%.0" "list" COMPU_TAB_REF mfi_rsc_ena_COMPU_VTAB_REF /end COMPU_METHOD
/begin COMPU_VTAB mfi_rsc_ena_COMPU_VTAB_REF "Verbal Table" TAB_VERB 2 0 "Disabled" 1 "Enabled" DEFAULT_VALUE "UNKNOWN" /end COMPU_VTAB
/begin CHARACTERISTIC mfi_pto_ena "Power take-off{mfi_pto_ena&0xff=0:Disabled}{mfi_pto_ena&0xff=1:Enabled}" VALUE 0x001c9071 /* @ECU_Address@mfi_pto_ena@0x0100D7A8@ */ ECIPP_ALIGNMENT_UBYTE 255 mfi_pto_ena_COMPU_VTAB 0 255 BIT_MASK 0xff /end CHARACTERISTIC
/begin COMPU_METHOD mfi_pto_ena_COMPU_VTAB "Verbal Table" TAB_VERB "%.0" "list" COMPU_TAB_REF mfi_pto_ena_COMPU_VTAB_REF /end COMPU_METHOD
/begin COMPU_VTAB mfi_pto_ena_COMPU_VTAB_REF "Verbal Table" TAB_VERB 2 0 "Disabled" 1 "Enabled" DEFAULT_VALUE "UNKNOWN" /end COMPU_VTAB
/begin CHARACTERISTIC mfi_idle_ena "Idle trim{mfi_idle_ena&0xff=0:Disabled}{mfi_idle_ena&0xff=1:Enabled}" VALUE 0x001c9070 /* @ECU_Address@mfi_idle_ena@0x0100D7B0@ */ ECIPP_ALIGNMENT_UBYTE 255 mfi_idle_ena_COMPU_VTAB 0 255 BIT_MASK 0xff /end CHARACTERISTIC
/begin COMPU_METHOD mfi_idle_ena_COMPU_VTAB "Verbal Table" TAB_VERB "%.0" "list" COMPU_TAB_REF mfi_idle_ena_COMPU_VTAB_REF /end COMPU_METHOD
/begin COMPU_VTAB mfi_idle_ena_COMPU_VTAB_REF "Verbal Table" TAB_VERB 2 0 "Disabled" 1 "Enabled" DEFAULT_VALUE "UNKNOWN" /end COMPU_VTAB
/begin MEASUREMENT mfi_ena "Multi-function input{mfi_ena&0xff=0:Disabled}{mfi_ena&0xff=1:Enabled}" UBYTE mfi_ena_COMPU_VTAB 0 0 0 255 ECU_ADDRESS 0x0100D7B8 BIT_MASK 0xff /end MEASUREMENT
/begin COMPU_METHOD mfi_ena_COMPU_VTAB "Verbal Table" TAB_VERB "%.0" "list" COMPU_TAB_REF mfi_ena_COMPU_VTAB_REF /end COMPU_METHOD
/begin COMPU_VTAB mfi_ena_COMPU_VTAB_REF "Verbal Table" TAB_VERB 2 0 "Disabled" 1 "Enabled" DEFAULT_VALUE "UNKNOWN" /end COMPU_VTAB
/begin MEASUREMENT mfi_func_allowed "Current function{mfi_func_allowed&0xff=0:None}{mfi_func_allowed&0xff=1:Roadspeed cruise}{mfi_func_allowed&0xff=2:Idle trim}{mfi_func_allowed&0xff=3:Power take-off}" UBYTE mfi_func_allowed_COMPU_VTAB 0 0 0 255 ECU_ADDRESS 0x0100D7C0 BIT_MASK 0xff /end MEASUREMENT
/begin COMPU_METHOD mfi_func_allowed_COMPU_VTAB "Verbal Table" TAB_VERB "%.0" "list" COMPU_TAB_REF mfi_func_allowed_COMPU_VTAB_REF /end COMPU_METHOD
/begin COMPU_VTAB mfi_func_allowed_COMPU_VTAB_REF "Verbal Table" TAB_VERB 4 0 "None" 1 "Roadspeed cruise" 2 "Idle trim" 3 "Power take-off" DEFAULT_VALUE "UNKNOWN" /end COMPU_VTAB
/begin CHARACTERISTIC AUX_start_chan "Aux start input{AUX_start_chan&0xff=0:Disabled}{AUX_start_chan&0xff=1:Aux PU1 = Gnd}{AUX_start_chan&0xff=2:Aux PU2 = Gnd}{AUX_start_chan&0xff=3:Aux PU3 = Gnd}{AUX_start_chan&0xff=4:Aux PUD1 = Gnd}{AUX_start_chan&0xff=5:Aux PUD2 = Gnd}{AUX_start_chan&0xff=" VALUE 0x001c867b /* @ECU_Address@AUX_start_chan@0x0100D878@ */ ECIPP_ALIGNMENT_UBYTE 255 AUX_start_chan_COMPU_VTAB 0 255 BIT_MASK 0xff /end CHARACTERISTIC
/begin COMPU_METHOD AUX_start_chan_COMPU_VTAB "Verbal Table" TAB_VERB "%.0" "list" COMPU_TAB_REF AUX_start_chan_COMPU_VTAB_REF /end COMPU_METHOD
/begin COMPU_VTAB AUX_start_chan_COMPU_VTAB_REF "Verbal Table" TAB_VERB 30 0 "Disabled" 1 "Aux PU1 = Gnd" 2 "Aux PU2 = Gnd" 3 "Aux PU3 = Gnd" 4 "Aux PUD1 = Gnd" 5 "Aux PUD2 = Gnd" 6 "Aux PUD3 = Gnd" 7 "Aux PUD4 = +V" 8 "Aux PUD5 = Gnd" 9 "Aux DIG1" 10 "Aux DIG2" 11 "Aux DIG3" 12 "Aux DIG4" 13 "Aux DIG5" 14 "Aux DIG6" 15 "Aux DIG7" 16 "Aux DIG8" 17 "Aux DIG9" 18 "Aux DIG10" 19 "Aux DIG11" 20 "Aux DIG12" 21 "Aux DIG13" 22 "Aux DIG14" 23 "Aux DIG15" 24 "Aux DIG16" 25 "Aux DIG17" 26 "Aux DIG18" 27 "Aux DIG19" 28 "Gov1" 29 "Gov2" DEFAULT_VALUE "UNKNOWN" /end COMPU_VTAB
/begin CHARACTERISTIC AUX_start_chan_cfg "Aux start input Aux DIG{AUX_start_chan_cfg&0xff=0:Default}{AUX_start_chan_cfg&0xff=1:GND}{AUX_start_chan_cfg&0xff=2:GND/+V}{AUX_start_chan_cfg&0xff=3:+V}{AUX_start_chan_cfg&0xff=4:Open}" VALUE 0x001c867c /* @ECU_Address@AUX_start_chan_cfg@0x0100D880@ */ ECIPP_ALIGNMENT_UBYTE 255 AUX_start_chan_cfg_COMPU_VTAB 0 255 BIT_MASK 0xff /end CHARACTERISTIC
/begin COMPU_METHOD AUX_start_chan_cfg_COMPU_VTAB "Verbal Table" TAB_VERB "%.0" "list" COMPU_TAB_REF AUX_start_chan_cfg_COMPU_VTAB_REF /end COMPU_METHOD
/begin COMPU_VTAB AUX_start_chan_cfg_COMPU_VTAB_REF "Verbal Table" TAB_VERB 5 0 "Default" 1 "GND" 2 "GND/+V" 3 "+V" 4 "Open" DEFAULT_VALUE "UNKNOWN" /end COMPU_VTAB
/begin CHARACTERISTIC AUX_stop_chan "Aux stop input{AUX_stop_chan&0xff=0:Disabled}{AUX_stop_chan&0xff=1:Aux PU1 = Gnd}{AUX_stop_chan&0xff=2:Aux PU2 = Gnd}{AUX_stop_chan&0xff=3:Aux PU3 = Gnd}{AUX_stop_chan&0xff=4:Aux PUD1 = Gnd}{AUX_stop_chan&0xff=5:Aux PUD2 = Gnd}{AUX_stop_chan&0xff=6:Aux PU" VALUE 0x001c867d /* @ECU_Address@AUX_stop_chan@0x0100D888@ */ ECIPP_ALIGNMENT_UBYTE 255 AUX_stop_chan_COMPU_VTAB 0 255 BIT_MASK 0xff /end CHARACTERISTIC
/begin COMPU_METHOD AUX_stop_chan_COMPU_VTAB "Verbal Table" TAB_VERB "%.0" "list" COMPU_TAB_REF AUX_stop_chan_COMPU_VTAB_REF /end COMPU_METHOD
/begin COMPU_VTAB AUX_stop_chan_COMPU_VTAB_REF "Verbal Table" TAB_VERB 30 0 "Disabled" 1 "Aux PU1 = Gnd" 2 "Aux PU2 = Gnd" 3 "Aux PU3 = Gnd" 4 "Aux PUD1 = Gnd" 5 "Aux PUD2 = Gnd" 6 "Aux PUD3 = Gnd" 7 "Aux PUD4 = +V" 8 "Aux PUD5 = Gnd" 9 "Aux DIG1" 10 "Aux DIG2" 11 "Aux DIG3" 12 "Aux DIG4" 13 "Aux DIG5" 14 "Aux DIG6" 15 "Aux DIG7" 16 "Aux DIG8" 17 "Aux DIG9" 18 "Aux DIG10" 19 "Aux DIG11" 20 "Aux DIG12" 21 "Aux DIG13" 22 "Aux DIG14" 23 "Aux DIG15" 24 "Aux DIG16" 25 "Aux DIG17" 26 "Aux DIG18" 27 "Aux DIG19" 28 "Gov1" 29 "Gov2" DEFAULT_VALUE "UNKNOWN" /end COMPU_VTAB
/begin CHARACTERISTIC AUX_stop_chan_cfg "Aux stop input Aux DIG{AUX_stop_chan_cfg&0xff=0:Default}{AUX_stop_chan_cfg&0xff=1:GND}{AUX_stop_chan_cfg&0xff=2:GND/+V}{AUX_stop_chan_cfg&0xff=3:+V}{AUX_stop_chan_cfg&0xff=4:Open}" VALUE 0x001c867e /* @ECU_Address@AUX_stop_chan_cfg@0x0100D890@ */ ECIPP_ALIGNMENT_UBYTE 255 AUX_stop_chan_cfg_COMPU_VTAB 0 255 BIT_MASK 0xff /end CHARACTERISTIC
/begin COMPU_METHOD AUX_stop_chan_cfg_COMPU_VTAB "Verbal Table" TAB_VERB "%.0" "list" COMPU_TAB_REF AUX_stop_chan_cfg_COMPU_VTAB_REF /end COMPU_METHOD
/begin COMPU_VTAB AUX_stop_chan_cfg_COMPU_VTAB_REF "Verbal Table" TAB_VERB 5 0 "Default" 1 "GND" 2 "GND/+V" 3 "+V" 4 "Open" DEFAULT_VALUE "UNKNOWN" /end COMPU_VTAB
/begin MEASUREMENT AUX_stop_occurred "Aux stop occurred{AUX_stop_occurred&0xff=0:Inactive}{AUX_stop_occurred&0xff=1:Caused Engine Stop}" UBYTE AUX_stop_occurred_COMPU_VTAB 0 0 0 255 ECU_ADDRESS 0x0100D898 BIT_MASK 0xff /end MEASUREMENT
/begin COMPU_METHOD AUX_stop_occurred_COMPU_VTAB "Verbal Table" TAB_VERB "%.0" "list" COMPU_TAB_REF AUX_stop_occurred_COMPU_VTAB_REF /end COMPU_METHOD
/begin COMPU_VTAB AUX_stop_occurred_COMPU_VTAB_REF "Verbal Table" TAB_VERB 2 0 "Inactive" 1 "Caused Engine Stop" DEFAULT_VALUE "UNKNOWN" /end COMPU_VTAB
/begin CHARACTERISTIC idle_SD_tout "Idle shutdown time" VALUE 0x001c43fc /* @ECU_Address@idle_SD_tout@0x0100E780@ */ ECIPP_ALIGNMENT_ULONG 4294967 Compu_idle_SD_tout 0 4294967.295 /end CHARACTERISTIC
/begin COMPU_METHOD Compu_idle_SD_tout " " RAT_FUNC "%.0" "sec" COEFFS 0 1000 0 0 0 1 /end COMPU_METHOD
/begin CHARACTERISTIC idle_SD_wait_tout "Idle shutdown back-on time" VALUE 0x001c8468 /* @ECU_Address@idle_SD_wait_tout@0x0100E788@ */ ECIPP_ALIGNMENT_UWORD 66 Compu_idle_SD_wait_tout 0 65.535 /end CHARACTERISTIC
/begin COMPU_METHOD Compu_idle_SD_wait_tout " " RAT_FUNC "%.1" "sec" COEFFS 0 1000 0 0 0 1 /end COMPU_METHOD
/begin CHARACTERISTIC idle_SD_ena "Idle shutdown{idle_SD_ena&0xff=0x00:Disabled}{idle_SD_ena&0xff=0x01:Enabled}" VALUE 0x001c9053 /* @ECU_Address@idle_SD_ena@0x0100E790@ */ ECIPP_ALIGNMENT_UBYTE 255 idle_SD_ena_COMPU_VTAB 0 255 BIT_MASK 0xff /end CHARACTERISTIC
/begin COMPU_METHOD idle_SD_ena_COMPU_VTAB "Verbal Table" TAB_VERB "%.0" "list" COMPU_TAB_REF idle_SD_ena_COMPU_VTAB_REF /end COMPU_METHOD
/begin COMPU_VTAB idle_SD_ena_COMPU_VTAB_REF "Verbal Table" TAB_VERB 2 0x00 "Disabled" 0x01 "Enabled" DEFAULT_VALUE "UNKNOWN" /end COMPU_VTAB
/begin CHARACTERISTIC idle_SD_sw_chan "Idle shutdown override switch{idle_SD_sw_chan&0xff=0:Disabled}{idle_SD_sw_chan&0xff=1:Aux PU1 = Gnd}{idle_SD_sw_chan&0xff=2:Aux PU2 = Gnd}{idle_SD_sw_chan&0xff=3:Aux PU3 = Gnd}{idle_SD_sw_chan&0xff=4:Aux PUD1 = Gnd}{idle_SD_sw_chan&0xff=5:Aux PUD2 = Gnd}{" VALUE 0x001c9055 /* @ECU_Address@idle_SD_sw_chan@0x0100E798@ */ ECIPP_ALIGNMENT_UBYTE 255 idle_SD_sw_chan_COMPU_VTAB 0 255 BIT_MASK 0xff /end CHARACTERISTIC
/begin COMPU_METHOD idle_SD_sw_chan_COMPU_VTAB "Verbal Table" TAB_VERB "%.0" "list" COMPU_TAB_REF idle_SD_sw_chan_COMPU_VTAB_REF /end COMPU_METHOD
/begin COMPU_VTAB idle_SD_sw_chan_COMPU_VTAB_REF "Verbal Table" TAB_VERB 30 0 "Disabled" 1 "Aux PU1 = Gnd" 2 "Aux PU2 = Gnd" 3 "Aux PU3 = Gnd" 4 "Aux PUD1 = Gnd" 5 "Aux PUD2 = Gnd" 6 "Aux PUD3 = Gnd" 7 "Aux PUD4 = +V" 8 "Aux PUD5 = Gnd" 9 "Aux DIG1" 10 "Aux DIG2" 11 "Aux DIG3" 12 "Aux DIG4" 13 "Aux DIG5" 14 "Aux DIG6" 15 "Aux DIG7" 16 "Aux DIG8" 17 "Aux DIG9" 18 "Aux DIG10" 19 "Aux DIG11" 20 "Aux DIG12" 21 "Aux DIG13" 22 "Aux DIG14" 23 "Aux DIG15" 24 "Aux DIG16" 25 "Aux DIG17" 26 "Aux DIG18" 27 "Aux DIG19" 28 "Gov1" 29 "Gov2" DEFAULT_VALUE "UNKNOWN" /end COMPU_VTAB
/begin CHARACTERISTIC idle_SD_sw_cfg "Idle shutdown override Aux DIG{idle_SD_sw_cfg&0xff=0:Default}{idle_SD_sw_cfg&0xff=1:GND}{idle_SD_sw_cfg&0xff=2:GND/+V}{idle_SD_sw_cfg&0xff=3:+V}{idle_SD_sw_cfg&0xff=4:Open}" VALUE 0x001c9054 /* @ECU_Address@idle_SD_sw_cfg@0x0100E7A0@ */ ECIPP_ALIGNMENT_UBYTE 255 idle_SD_sw_cfg_COMPU_VTAB 0 255 BIT_MASK 0xff /end CHARACTERISTIC
/begin COMPU_METHOD idle_SD_sw_cfg_COMPU_VTAB "Verbal Table" TAB_VERB "%.0" "list" COMPU_TAB_REF idle_SD_sw_cfg_COMPU_VTAB_REF /end COMPU_METHOD
/begin COMPU_VTAB idle_SD_sw_cfg_COMPU_VTAB_REF "Verbal Table" TAB_VERB 5 0 "Default" 1 "GND" 2 "GND/+V" 3 "+V" 4 "Open" DEFAULT_VALUE "UNKNOWN" /end COMPU_VTAB
/begin MEASUREMENT idle_SD_sw "Idle shutdown override switch{idle_SD_sw&0xff=0x00:OFF}{idle_SD_sw&0xff=0x01:ON}" UBYTE idle_SD_sw_COMPU_VTAB 0 0 0 255 ECU_ADDRESS 0x0100E7A8 BIT_MASK 0xff /end MEASUREMENT
/begin COMPU_METHOD idle_SD_sw_COMPU_VTAB "Verbal Table" TAB_VERB "%.0" "list" COMPU_TAB_REF idle_SD_sw_COMPU_VTAB_REF /end COMPU_METHOD
/begin COMPU_VTAB idle_SD_sw_COMPU_VTAB_REF "Verbal Table" TAB_VERB 2 0x00 "OFF" 0x01 "ON" DEFAULT_VALUE "UNKNOWN" /end COMPU_VTAB
/begin MEASUREMENT idle_SD_state "Idle shutdown state{idle_SD_state&0xff=0:Inactive}{idle_SD_state&0xff=1:Timer active}{idle_SD_state&0xff=2:Engine shutdown}" UBYTE idle_SD_state_COMPU_VTAB 0 0 0 255 ECU_ADDRESS 0x0100E7B0 BIT_MASK 0xff /end MEASUREMENT
/begin COMPU_METHOD idle_SD_state_COMPU_VTAB "Verbal Table" TAB_VERB "%.0" "list" COMPU_TAB_REF idle_SD_state_COMPU_VTAB_REF /end COMPU_METHOD
/begin COMPU_VTAB idle_SD_state_COMPU_VTAB_REF "Verbal Table" TAB_VERB 3 0 "Inactive" 1 "Timer active" 2 "Engine shutdown" DEFAULT_VALUE "UNKNOWN" /end COMPU_VTAB
/begin CHARACTERISTIC KOR_action_1 "Table to reset{KOR_action_1&0xff=0:Disabled}{KOR_action_1&0xff=1:CL Adaptive Learn}{KOR_action_1&0xff=2:Adaptive Octane}" VALUE 0x001C9FD8 /* @ECU_Address@KOR_action_1@0x0100E870@ */ ECIPP_ALIGNMENT_UBYTE 255 KOR_action_1_COMPU_VTAB 0 255 BIT_MASK 0xff /end CHARACTERISTIC
/begin COMPU_METHOD KOR_action_1_COMPU_VTAB "Verbal Table" TAB_VERB "%.0" "list" COMPU_TAB_REF KOR_action_1_COMPU_VTAB_REF /end COMPU_METHOD
/begin COMPU_VTAB KOR_action_1_COMPU_VTAB_REF "Verbal Table" TAB_VERB 3 0 "Disabled" 1 "CL Adaptive Learn" 2 "Adaptive Octane" DEFAULT_VALUE "UNKNOWN" /end COMPU_VTAB
/begin CHARACTERISTIC KOR_action_2 "Table to reset{KOR_action_2&0xff=0:Disabled}{KOR_action_2&0xff=1:CL Adaptive Learn}{KOR_action_2&0xff=2:Adaptive Octane}" VALUE 0x001C9FDD /* @ECU_Address@KOR_action_2@0x0100E878@ */ ECIPP_ALIGNMENT_UBYTE 255 KOR_action_2_COMPU_VTAB 0 255 BIT_MASK 0xff /end CHARACTERISTIC
/begin COMPU_METHOD KOR_action_2_COMPU_VTAB "Verbal Table" TAB_VERB "%.0" "list" COMPU_TAB_REF KOR_action_2_COMPU_VTAB_REF /end COMPU_METHOD
/begin COMPU_VTAB KOR_action_2_COMPU_VTAB_REF "Verbal Table" TAB_VERB 3 0 "Disabled" 1 "CL Adaptive Learn" 2 "Adaptive Octane" DEFAULT_VALUE "UNKNOWN" /end COMPU_VTAB
/begin CHARACTERISTIC KOR_key_cycles_1 "Key cycles" VALUE 0x001C9FD9 /* @ECU_Address@KOR_key_cycles_1@0x0100E880@ */ ECIPP_ALIGNMENT_UBYTE 255 Compu_KOR_key_cycles_1 0 255 /end CHARACTERISTIC
/begin COMPU_METHOD Compu_KOR_key_cycles_1 " " RAT_FUNC "%.0" "cycles" COEFFS 0 1 0 0 0 1 /end COMPU_METHOD
/begin CHARACTERISTIC KOR_key_cycles_2 "Key cycles" VALUE 0x001C9FDE /* @ECU_Address@KOR_key_cycles_2@0x0100E888@ */ ECIPP_ALIGNMENT_UBYTE 255 Compu_KOR_key_cycles_2 0 255 /end CHARACTERISTIC
/begin COMPU_METHOD Compu_KOR_key_cycles_2 " " RAT_FUNC "%.0" "cycles" COEFFS 0 1 0 0 0 1 /end COMPU_METHOD
/begin CHARACTERISTIC KOR_FPP_cycles_1 "FPP cycles" VALUE 0x001C9FDA /* @ECU_Address@KOR_FPP_cycles_1@0x0100E890@ */ ECIPP_ALIGNMENT_UBYTE 255 Compu_KOR_FPP_cycles_1 0 255 /end CHARACTERISTIC
/begin COMPU_METHOD Compu_KOR_FPP_cycles_1 " " RAT_FUNC "%.0" "cycles" COEFFS 0 1 0 0 0 1 /end COMPU_METHOD
/begin CHARACTERISTIC KOR_FPP_cycles_2 "FPP cycles" VALUE 0x001C9FDF /* @ECU_Address@KOR_FPP_cycles_2@0x0100E898@ */ ECIPP_ALIGNMENT_UBYTE 255 Compu_KOR_FPP_cycles_2 0 255 /end CHARACTERISTIC
/begin COMPU_METHOD Compu_KOR_FPP_cycles_2 " " RAT_FUNC "%.0" "cycles" COEFFS 0 1 0 0 0 1 /end COMPU_METHOD
/begin CHARACTERISTIC KOR_conf_chan_1 "Confirmation output{KOR_conf_chan_1&0xff=0:Disabled}{KOR_conf_chan_1&0xff=1:MIL output}{KOR_conf_chan_1&0xff=2:BUZZ output}" VALUE 0x001C9FDB /* @ECU_Address@KOR_conf_chan_1@0x0100E8A0@ */ ECIPP_ALIGNMENT_UBYTE 255 KOR_conf_chan_1_COMPU_VTAB 0 255 BIT_MASK 0xff /end CHARACTERISTIC
/begin COMPU_METHOD KOR_conf_chan_1_COMPU_VTAB "Verbal Table" TAB_VERB "%.0" "list" COMPU_TAB_REF KOR_conf_chan_1_COMPU_VTAB_REF /end COMPU_METHOD
/begin COMPU_VTAB KOR_conf_chan_1_COMPU_VTAB_REF "Verbal Table" TAB_VERB 3 0 "Disabled" 1 "MIL output" 2 "BUZZ output" DEFAULT_VALUE "UNKNOWN" /end COMPU_VTAB
/begin CHARACTERISTIC KOR_conf_chan_2 "Confirmation output{KOR_conf_chan_2&0xff=0:Disabled}{KOR_conf_chan_2&0xff=1:MIL output}{KOR_conf_chan_2&0xff=2:BUZZ output}" VALUE 0x001C9FE0 /* @ECU_Address@KOR_conf_chan_2@0x0100E8A8@ */ ECIPP_ALIGNMENT_UBYTE 255 KOR_conf_chan_2_COMPU_VTAB 0 255 BIT_MASK 0xff /end CHARACTERISTIC
/begin COMPU_METHOD KOR_conf_chan_2_COMPU_VTAB "Verbal Table" TAB_VERB "%.0" "list" COMPU_TAB_REF KOR_conf_chan_2_COMPU_VTAB_REF /end COMPU_METHOD
/begin COMPU_VTAB KOR_conf_chan_2_COMPU_VTAB_REF "Verbal Table" TAB_VERB 3 0 "Disabled" 1 "MIL output" 2 "BUZZ output" DEFAULT_VALUE "UNKNOWN" /end COMPU_VTAB
/begin CHARACTERISTIC KOR_conf_cycles_1 "Confirmation cycles" VALUE 0x001C9FDC /* @ECU_Address@KOR_conf_cycles_1@0x0100E8B0@ */ ECIPP_ALIGNMENT_UBYTE 255 Compu_KOR_conf_cycles_1 0 255 /end CHARACTERISTIC
/begin COMPU_METHOD Compu_KOR_conf_cycles_1 " " RAT_FUNC "%.0" "cycles" COEFFS 0 1 0 0 0 1 /end COMPU_METHOD
/begin CHARACTERISTIC KOR_conf_cycles_2 "Confirmation cycles" VALUE 0x001C9FE1 /* @ECU_Address@KOR_conf_cycles_2@0x0100E8B8@ */ ECIPP_ALIGNMENT_UBYTE 255 Compu_KOR_conf_cycles_2 0 255 /end CHARACTERISTIC
/begin COMPU_METHOD Compu_KOR_conf_cycles_2 " " RAT_FUNC "%.0" "cycles" COEFFS 0 1 0 0 0 1 /end COMPU_METHOD
/begin CHARACTERISTIC KOR_conf_on_time "Confirmation on time" VALUE 0x001c7cda /* @ECU_Address@KOR_conf_on_time@0x0100E8C0@ */ ECIPP_ALIGNMENT_UWORD 65535 Compu_KOR_conf_on_time 0 65535 /end CHARACTERISTIC
/begin COMPU_METHOD Compu_KOR_conf_on_time " " RAT_FUNC "%.0" "ms" COEFFS 0 1 0 0 0 1 /end COMPU_METHOD
/begin CHARACTERISTIC KOR_conf_off_time "Confirmation off time" VALUE 0x001c7cd8 /* @ECU_Address@KOR_conf_off_time@0x0100E8C8@ */ ECIPP_ALIGNMENT_UWORD 65535 Compu_KOR_conf_off_time 0 65535 /end CHARACTERISTIC
/begin COMPU_METHOD Compu_KOR_conf_off_time " " RAT_FUNC "%.0" "ms" COEFFS 0 1 0 0 0 1 /end COMPU_METHOD
/begin CHARACTERISTIC KOR_seq_end_time "Key-on end of sequence" VALUE 0x001c7cdc /* @ECU_Address@KOR_seq_end_time@0x0100E8D0@ */ ECIPP_ALIGNMENT_UWORD 65535 Compu_KOR_seq_end_time 0 65535 /end CHARACTERISTIC
/begin COMPU_METHOD Compu_KOR_seq_end_time " " RAT_FUNC "%.0" "ms" COEFFS 0 1 0 0 0 1 /end COMPU_METHOD
/begin CHARACTERISTIC KOR_state_min_time "FPP depressed / Key-off min" VALUE 0x001c7ce0 /* @ECU_Address@KOR_state_min_time@0x0100E8D8@ */ ECIPP_ALIGNMENT_UWORD 65535 Compu_KOR_state_min_time 0 65535 /end CHARACTERISTIC
/begin COMPU_METHOD Compu_KOR_state_min_time " " RAT_FUNC "%.0" "ms" COEFFS 0 1 0 0 0 1 /end COMPU_METHOD
/begin CHARACTERISTIC KOR_state_max_time "FPP depressed / Key-off max" VALUE 0x001c7cde /* @ECU_Address@KOR_state_max_time@0x0100E8E0@ */ ECIPP_ALIGNMENT_UWORD 65535 Compu_KOR_state_max_time 0 65535 /end CHARACTERISTIC
/begin COMPU_METHOD Compu_KOR_state_max_time " " RAT_FUNC "%.0" "ms" COEFFS 0 1 0 0 0 1 /end COMPU_METHOD
/begin CHARACTERISTIC KOR_FPP_dpsd_pct "FPP depressed" VALUE 0x001c7cd4 /* @ECU_Address@KOR_FPP_dpsd_pct@0x0100E8E8@ */ ECIPP_ALIGNMENT_UWORD 100 Compu_KOR_FPP_dpsd_pct 0 99.9984741210938 /end CHARACTERISTIC
/begin COMPU_METHOD Compu_KOR_FPP_dpsd_pct " " RAT_FUNC "%.1" "%" COEFFS 0 655.36 0 0 0 1 /end COMPU_METHOD
/begin CHARACTERISTIC KOR_FPP_rlsd_pct "FPP released" VALUE 0x001c7cd6 /* @ECU_Address@KOR_FPP_rlsd_pct@0x0100E8F0@ */ ECIPP_ALIGNMENT_UWORD 100 Compu_KOR_FPP_rlsd_pct 0 99.9984741210938 /end CHARACTERISTIC
/begin COMPU_METHOD Compu_KOR_FPP_rlsd_pct " " RAT_FUNC "%.1" "%" COEFFS 0 655.36 0 0 0 1 /end COMPU_METHOD
/begin MEASUREMENT KOR_state "Key-On Reset state{KOR_state&0xff=0:Initialization}{KOR_state&0xff=1:Key-on}{KOR_state&0xff=2:Key-off}{KOR_state&0xff=3:Key-on KC+1}{KOR_state&0xff=4:FPP depressed}{KOR_state&0xff=5:CL Adaptive reset}{KOR_state&0xff=6:Octane reset}{KOR_state&0xff=7:Confir" UBYTE KOR_state_COMPU_VTAB 0 0 0 255 ECU_ADDRESS 0x0100E8F8 BIT_MASK 0xff /end MEASUREMENT
/begin COMPU_METHOD KOR_state_COMPU_VTAB "Verbal Table" TAB_VERB "%.0" "list" COMPU_TAB_REF KOR_state_COMPU_VTAB_REF /end COMPU_METHOD
/begin COMPU_VTAB KOR_state_COMPU_VTAB_REF "Verbal Table" TAB_VERB 12 0 "Initialization" 1 "Key-on" 2 "Key-off" 3 "Key-on KC+1" 4 "FPP depressed" 5 "CL Adaptive reset" 6 "Octane reset" 7 "Confirmation init" 8 "Confirmation ON" 9 "Confirmation OFF" 10 "SD wait init" 11 "SD wait" DEFAULT_VALUE "UNKNOWN" /end COMPU_VTAB
/begin MEASUREMENT imu_accel_x_raw "Accel X raw" SWORD Compu_imu_accel_x_raw 0 0 -32768 32767 ECU_ADDRESS 0x0100FF40 /end MEASUREMENT
/begin COMPU_METHOD Compu_imu_accel_x_raw " " RAT_FUNC "%.0" "-" COEFFS 0 1 0 0 0 1 /end COMPU_METHOD
/begin MEASUREMENT imu_accel_y_raw "Accel Y raw" SWORD Compu_imu_accel_y_raw 0 0 -32768 32767 ECU_ADDRESS 0x0100FF48 /end MEASUREMENT
/begin COMPU_METHOD Compu_imu_accel_y_raw " " RAT_FUNC "%.0" "-" COEFFS 0 1 0 0 0 1 /end COMPU_METHOD
/begin MEASUREMENT imu_accel_z_raw "Accel Z raw" SWORD Compu_imu_accel_z_raw 0 0 -32768 32767 ECU_ADDRESS 0x0100FF50 /end MEASUREMENT
/begin COMPU_METHOD Compu_imu_accel_z_raw " " RAT_FUNC "%.0" "-" COEFFS 0 1 0 0 0 1 /end COMPU_METHOD
/begin MEASUREMENT imu_accel_x "Accel X" FLOAT32_IEEE Compu_imu_accel_x 0 0 -10000000000 10000000000 ECU_ADDRESS 0x0100FF58 /end MEASUREMENT
/begin COMPU_METHOD Compu_imu_accel_x " " RAT_FUNC "%.3" "g" COEFFS 0 1 0 0 0 1 /end COMPU_METHOD
/begin MEASUREMENT imu_accel_y "Accel Y" FLOAT32_IEEE Compu_imu_accel_y 0 0 -10000000000 10000000000 ECU_ADDRESS 0x0100FF60 /end MEASUREMENT
/begin COMPU_METHOD Compu_imu_accel_y " " RAT_FUNC "%.3" "g" COEFFS 0 1 0 0 0 1 /end COMPU_METHOD
/begin MEASUREMENT imu_accel_z "Accel Z" FLOAT32_IEEE Compu_imu_accel_z 0 0 -10000000000 10000000000 ECU_ADDRESS 0x0100FF68 /end MEASUREMENT
/begin COMPU_METHOD Compu_imu_accel_z " " RAT_FUNC "%.3" "g" COEFFS 0 1 0 0 0 1 /end COMPU_METHOD
/begin MEASUREMENT imu_gyro_x_raw "Gyro X raw" SWORD Compu_imu_gyro_x_raw 0 0 -32768 32767 ECU_ADDRESS 0x0100FF70 /end MEASUREMENT
/begin COMPU_METHOD Compu_imu_gyro_x_raw " " RAT_FUNC "%.0" "-" COEFFS 0 1 0 0 0 1 /end COMPU_METHOD
/begin MEASUREMENT imu_gyro_y_raw "Gyro Y raw" SWORD Compu_imu_gyro_y_raw 0 0 -32768 32767 ECU_ADDRESS 0x0100FF78 /end MEASUREMENT
/begin COMPU_METHOD Compu_imu_gyro_y_raw " " RAT_FUNC "%.0" "-" COEFFS 0 1 0 0 0 1 /end COMPU_METHOD
/begin MEASUREMENT imu_gyro_z_raw "Gyro Z raw" SWORD Compu_imu_gyro_z_raw 0 0 -32768 32767 ECU_ADDRESS 0x0100FF80 /end MEASUREMENT
/begin COMPU_METHOD Compu_imu_gyro_z_raw " " RAT_FUNC "%.0" "-" COEFFS 0 1 0 0 0 1 /end COMPU_METHOD
/begin MEASUREMENT imu_gyro_x "Gyro X" FLOAT32_IEEE Compu_imu_gyro_x 0 0 -10000000000 10000000000 ECU_ADDRESS 0x0100FF88 /end MEASUREMENT
/begin COMPU_METHOD Compu_imu_gyro_x " " RAT_FUNC "%.3" "dps" COEFFS 0 1 0 0 0 1 /end COMPU_METHOD
/begin MEASUREMENT imu_gyro_y "Gyro Y" FLOAT32_IEEE Compu_imu_gyro_y 0 0 -10000000000 10000000000 ECU_ADDRESS 0x0100FF90 /end MEASUREMENT
/begin COMPU_METHOD Compu_imu_gyro_y " " RAT_FUNC "%.3" "dps" COEFFS 0 1 0 0 0 1 /end COMPU_METHOD
/begin MEASUREMENT imu_gyro_z "Gyro Z" FLOAT32_IEEE Compu_imu_gyro_z 0 0 -10000000000 10000000000 ECU_ADDRESS 0x0100FF98 /end MEASUREMENT
/begin COMPU_METHOD Compu_imu_gyro_z " " RAT_FUNC "%.3" "dps" COEFFS 0 1 0 0 0 1 /end COMPU_METHOD
/begin MEASUREMENT imu_temp "Temperature" SWORD Compu_imu_temp 0 0 -2023 2072.9375 ECU_ADDRESS 0x0100FFA0 /end MEASUREMENT
/begin COMPU_METHOD Compu_imu_temp " " RAT_FUNC "%.1" "deg C" COEFFS 0 16 -400 0 0 1 /end COMPU_METHOD
/begin CHARACTERISTIC LSM6DS3_accel_fs "Accel fullscale range{LSM6DS3_accel_fs&0xff=0:+-2 g}{LSM6DS3_accel_fs&0xff=1:+-4 g}{LSM6DS3_accel_fs&0xff=2:+-8 g}{LSM6DS3_accel_fs&0xff=3:+-16 g}" VALUE 0x001c87df /* @ECU_Address@LSM6DS3_accel_fs@0x01010068@ */ ECIPP_ALIGNMENT_UBYTE 255 LSM6DS3_accel_fs_COMPU_VTAB 0 255 BIT_MASK 0xff /end CHARACTERISTIC
/begin COMPU_METHOD LSM6DS3_accel_fs_COMPU_VTAB "Verbal Table" TAB_VERB "%.0" "list" COMPU_TAB_REF LSM6DS3_accel_fs_COMPU_VTAB_REF /end COMPU_METHOD
/begin COMPU_VTAB LSM6DS3_accel_fs_COMPU_VTAB_REF "Verbal Table" TAB_VERB 4 0 "+-2 g" 1 "+-4 g" 2 "+-8 g" 3 "+-16 g" DEFAULT_VALUE "UNKNOWN" /end COMPU_VTAB
/begin CHARACTERISTIC LSM6DS3_gyro_fs "Gyro fullscale range{LSM6DS3_gyro_fs&0xff=0:+-125 dps}{LSM6DS3_gyro_fs&0xff=1:+-245 dps}{LSM6DS3_gyro_fs&0xff=2:+-500 dps}{LSM6DS3_gyro_fs&0xff=3:+-1000 dps}{LSM6DS3_gyro_fs&0xff=4:+-2000 dps}" VALUE 0x001c87e1 /* @ECU_Address@LSM6DS3_gyro_fs@0x01010070@ */ ECIPP_ALIGNMENT_UBYTE 255 LSM6DS3_gyro_fs_COMPU_VTAB 0 255 BIT_MASK 0xff /end CHARACTERISTIC
/begin COMPU_METHOD LSM6DS3_gyro_fs_COMPU_VTAB "Verbal Table" TAB_VERB "%.0" "list" COMPU_TAB_REF LSM6DS3_gyro_fs_COMPU_VTAB_REF /end COMPU_METHOD
/begin COMPU_VTAB LSM6DS3_gyro_fs_COMPU_VTAB_REF "Verbal Table" TAB_VERB 5 0 "+-125 dps" 1 "+-245 dps" 2 "+-500 dps" 3 "+-1000 dps" 4 "+-2000 dps" DEFAULT_VALUE "UNKNOWN" /end COMPU_VTAB
/begin CHARACTERISTIC LSM6DS3_gyro_sign_x "Gyro pitch axis (X) sign{LSM6DS3_gyro_sign_x&0xff=0:Positive sign}{LSM6DS3_gyro_sign_x&0xff=1:Negative sign}" VALUE 0x001c87e5 /* @ECU_Address@LSM6DS3_gyro_sign_x@0x01010090@ */ ECIPP_ALIGNMENT_UBYTE 255 LSM6DS3_gyro_sign_x_COMPU_VTAB 0 255 BIT_MASK 0xff /end CHARACTERISTIC
/begin COMPU_METHOD LSM6DS3_gyro_sign_x_COMPU_VTAB "Verbal Table" TAB_VERB "%.0" "list" COMPU_TAB_REF LSM6DS3_gyro_sign_x_COMPU_VTAB_REF /end COMPU_METHOD
/begin COMPU_VTAB LSM6DS3_gyro_sign_x_COMPU_VTAB_REF "Verbal Table" TAB_VERB 2 0 "Positive sign" 1 "Negative sign" DEFAULT_VALUE "UNKNOWN" /end COMPU_VTAB
/begin CHARACTERISTIC LSM6DS3_gyro_sign_y "Gyro roll axis (Y) sign{LSM6DS3_gyro_sign_y&0xff=0:Positive sign}{LSM6DS3_gyro_sign_y&0xff=1:Negative sign}" VALUE 0x001c87e6 /* @ECU_Address@LSM6DS3_gyro_sign_y@0x01010098@ */ ECIPP_ALIGNMENT_UBYTE 255 LSM6DS3_gyro_sign_y_COMPU_VTAB 0 255 BIT_MASK 0xff /end CHARACTERISTIC
/begin COMPU_METHOD LSM6DS3_gyro_sign_y_COMPU_VTAB "Verbal Table" TAB_VERB "%.0" "list" COMPU_TAB_REF LSM6DS3_gyro_sign_y_COMPU_VTAB_REF /end COMPU_METHOD
/begin COMPU_VTAB LSM6DS3_gyro_sign_y_COMPU_VTAB_REF "Verbal Table" TAB_VERB 2 0 "Positive sign" 1 "Negative sign" DEFAULT_VALUE "UNKNOWN" /end COMPU_VTAB
/begin CHARACTERISTIC LSM6DS3_gyro_sign_z "Gyro yaw axis (Z) sign{LSM6DS3_gyro_sign_z&0xff=0:Positive sign}{LSM6DS3_gyro_sign_z&0xff=1:Negative sign}" VALUE 0x001c87e7 /* @ECU_Address@LSM6DS3_gyro_sign_z@0x010100A0@ */ ECIPP_ALIGNMENT_UBYTE 255 LSM6DS3_gyro_sign_z_COMPU_VTAB 0 255 BIT_MASK 0xff /end CHARACTERISTIC
/begin COMPU_METHOD LSM6DS3_gyro_sign_z_COMPU_VTAB "Verbal Table" TAB_VERB "%.0" "list" COMPU_TAB_REF LSM6DS3_gyro_sign_z_COMPU_VTAB_REF /end COMPU_METHOD
/begin COMPU_VTAB LSM6DS3_gyro_sign_z_COMPU_VTAB_REF "Verbal Table" TAB_VERB 2 0 "Positive sign" 1 "Negative sign" DEFAULT_VALUE "UNKNOWN" /end COMPU_VTAB
/begin CHARACTERISTIC LSM6DS3_gyro_orient "Gyro orientation of axis{LSM6DS3_gyro_orient&0xff=0:Pitch=X, Roll=Y, Yaw=Z}{LSM6DS3_gyro_orient&0xff=1:Pitch=X, Roll=Z, Yaw=Y}{LSM6DS3_gyro_orient&0xff=2:Pitch=Y, Roll=X, Yaw=Z}{LSM6DS3_gyro_orient&0xff=3:Pitch=Y, Roll=Z, Yaw=X}{LSM6DS3_gyro_orient&0xff=4" VALUE 0x001c87e4 /* @ECU_Address@LSM6DS3_gyro_orient@0x010100A8@ */ ECIPP_ALIGNMENT_UBYTE 255 LSM6DS3_gyro_orient_COMPU_VTAB 0 255 BIT_MASK 0xff /end CHARACTERISTIC
/begin COMPU_METHOD LSM6DS3_gyro_orient_COMPU_VTAB "Verbal Table" TAB_VERB "%.0" "list" COMPU_TAB_REF LSM6DS3_gyro_orient_COMPU_VTAB_REF /end COMPU_METHOD
/begin COMPU_VTAB LSM6DS3_gyro_orient_COMPU_VTAB_REF "Verbal Table" TAB_VERB 6 0 "Pitch=X, Roll=Y, Yaw=Z" 1 "Pitch=X, Roll=Z, Yaw=Y" 2 "Pitch=Y, Roll=X, Yaw=Z" 3 "Pitch=Y, Roll=Z, Yaw=X" 4 "Pitch=Z, Roll=X, Yaw=Y" 5 "Pitch=Z, Roll=Y, Yaw=X" DEFAULT_VALUE "UNKNOWN" /end COMPU_VTAB
/begin CHARACTERISTIC LSM6DS3_gyro_hpf "Gyro digital HPF{LSM6DS3_gyro_hpf&0xff=0:Disabled}{LSM6DS3_gyro_hpf&0xff=1:0.0081 Hz}{LSM6DS3_gyro_hpf&0xff=2:0.0324 Hz}{LSM6DS3_gyro_hpf&0xff=3:2.07 Hz}{LSM6DS3_gyro_hpf&0xff=4:16.32 Hz}" VALUE 0x001c87e2 /* @ECU_Address@LSM6DS3_gyro_hpf@0x010100B0@ */ ECIPP_ALIGNMENT_UBYTE 255 LSM6DS3_gyro_hpf_COMPU_VTAB 0 255 BIT_MASK 0xff /end CHARACTERISTIC
/begin COMPU_METHOD LSM6DS3_gyro_hpf_COMPU_VTAB "Verbal Table" TAB_VERB "%.0" "list" COMPU_TAB_REF LSM6DS3_gyro_hpf_COMPU_VTAB_REF /end COMPU_METHOD
/begin COMPU_VTAB LSM6DS3_gyro_hpf_COMPU_VTAB_REF "Verbal Table" TAB_VERB 5 0 "Disabled" 1 "0.0081 Hz" 2 "0.0324 Hz" 3 "2.07 Hz" 4 "16.32 Hz" DEFAULT_VALUE "UNKNOWN" /end COMPU_VTAB
/begin CHARACTERISTIC LSM6DS3_accel_aabw "Accel anti-aliasing filter{LSM6DS3_accel_aabw&0xff=0:Automatic}{LSM6DS3_accel_aabw&0xff=1:400 Hz}{LSM6DS3_accel_aabw&0xff=2:200 Hz}{LSM6DS3_accel_aabw&0xff=3:100 Hz}{LSM6DS3_accel_aabw&0xff=4:50 Hz}" VALUE 0x001c87dd /* @ECU_Address@LSM6DS3_accel_aabw@0x010100B8@ */ ECIPP_ALIGNMENT_UBYTE 255 LSM6DS3_accel_aabw_COMPU_VTAB 0 255 BIT_MASK 0xff /end CHARACTERISTIC
/begin COMPU_METHOD LSM6DS3_accel_aabw_COMPU_VTAB "Verbal Table" TAB_VERB "%.0" "list" COMPU_TAB_REF LSM6DS3_accel_aabw_COMPU_VTAB_REF /end COMPU_METHOD
/begin COMPU_VTAB LSM6DS3_accel_aabw_COMPU_VTAB_REF "Verbal Table" TAB_VERB 5 0 "Automatic" 1 "400 Hz" 2 "200 Hz" 3 "100 Hz" 4 "50 Hz" DEFAULT_VALUE "UNKNOWN" /end COMPU_VTAB
/begin CHARACTERISTIC LSM6DS3_accel_cdf "Accel digital composite filter{LSM6DS3_accel_cdf&0xff=0:Disabled}{LSM6DS3_accel_cdf&0xff=1:Low-pass - 184.44 Hz}{LSM6DS3_accel_cdf&0xff=2:Low-pass - 33.2 Hz}{LSM6DS3_accel_cdf&0xff=3:Low-pass - 16.6 Hz}{LSM6DS3_accel_cdf&0xff=4:Low-pass - 4.15 Hz}{LSM6DS3" VALUE 0x001c87de /* @ECU_Address@LSM6DS3_accel_cdf@0x010100C0@ */ ECIPP_ALIGNMENT_UBYTE 255 LSM6DS3_accel_cdf_COMPU_VTAB 0 255 BIT_MASK 0xff /end CHARACTERISTIC
/begin COMPU_METHOD LSM6DS3_accel_cdf_COMPU_VTAB "Verbal Table" TAB_VERB "%.0" "list" COMPU_TAB_REF LSM6DS3_accel_cdf_COMPU_VTAB_REF /end COMPU_METHOD
/begin COMPU_VTAB LSM6DS3_accel_cdf_COMPU_VTAB_REF "Verbal Table" TAB_VERB 9 0 "Disabled" 1 "Low-pass - 184.44 Hz" 2 "Low-pass - 33.2 Hz" 3 "Low-pass - 16.6 Hz" 4 "Low-pass - 4.15 Hz" 5 "Slope - 415 Hz" 6 "High-pass - 184.44 Hz" 7 "High-pass - 16.6 Hz" 8 "High-pass - 4.15 Hz" DEFAULT_VALUE "UNKNOWN" /end COMPU_VTAB
/begin CHARACTERISTIC LSM6DS3_accel_odr "Accel output data rate{LSM6DS3_accel_odr&0xff=0:Power-down}{LSM6DS3_accel_odr&0xff=1:12.5 Hz}{LSM6DS3_accel_odr&0xff=2:26 Hz}{LSM6DS3_accel_odr&0xff=3:52 Hz}{LSM6DS3_accel_odr&0xff=4:104 Hz}{LSM6DS3_accel_odr&0xff=5:208 Hz}{LSM6DS3_accel_odr&0xff=6:416 Hz" VALUE 0x001c87e0 /* @ECU_Address@LSM6DS3_accel_odr@0x01010330@ */ ECIPP_ALIGNMENT_UBYTE 255 LSM6DS3_accel_odr_COMPU_VTAB 0 255 BIT_MASK 0xff /end CHARACTERISTIC
/begin COMPU_METHOD LSM6DS3_accel_odr_COMPU_VTAB "Verbal Table" TAB_VERB "%.0" "list" COMPU_TAB_REF LSM6DS3_accel_odr_COMPU_VTAB_REF /end COMPU_METHOD
/begin COMPU_VTAB LSM6DS3_accel_odr_COMPU_VTAB_REF "Verbal Table" TAB_VERB 11 0 "Power-down" 1 "12.5 Hz" 2 "26 Hz" 3 "52 Hz" 4 "104 Hz" 5 "208 Hz" 6 "416 Hz" 7 "833 Hz" 8 "1.66 kHz" 9 "3.33 kHz" 10 "6.66 kHz" DEFAULT_VALUE "UNKNOWN" /end COMPU_VTAB
/begin CHARACTERISTIC LSM6DS3_gyro_odr "Gyro output data rate{LSM6DS3_gyro_odr&0xff=0:Power-down}{LSM6DS3_gyro_odr&0xff=1:12.5 Hz}{LSM6DS3_gyro_odr&0xff=2:26 Hz}{LSM6DS3_gyro_odr&0xff=3:52 Hz}{LSM6DS3_gyro_odr&0xff=4:104 Hz}{LSM6DS3_gyro_odr&0xff=5:208 Hz}{LSM6DS3_gyro_odr&0xff=6:416 Hz}{LSM6DS" VALUE 0x001c87e3 /* @ECU_Address@LSM6DS3_gyro_odr@0x01010338@ */ ECIPP_ALIGNMENT_UBYTE 255 LSM6DS3_gyro_odr_COMPU_VTAB 0 255 BIT_MASK 0xff /end CHARACTERISTIC
/begin COMPU_METHOD LSM6DS3_gyro_odr_COMPU_VTAB "Verbal Table" TAB_VERB "%.0" "list" COMPU_TAB_REF LSM6DS3_gyro_odr_COMPU_VTAB_REF /end COMPU_METHOD
/begin COMPU_VTAB LSM6DS3_gyro_odr_COMPU_VTAB_REF "Verbal Table" TAB_VERB 9 0 "Power-down" 1 "12.5 Hz" 2 "26 Hz" 3 "52 Hz" 4 "104 Hz" 5 "208 Hz" 6 "416 Hz" 7 "833 Hz" 8 "1.66 kHz" DEFAULT_VALUE "UNKNOWN" /end COMPU_VTAB
/begin CHARACTERISTIC ECL_chan "Coolant level sensor input{ECL_chan&0xff=0:Disabled}{ECL_chan&0xff=1:Aux PU1 = Gnd}{ECL_chan&0xff=2:Aux PU2 = Gnd}{ECL_chan&0xff=3:Aux PU3 = Gnd}{ECL_chan&0xff=4:Aux PUD1 = Gnd}{ECL_chan&0xff=5:Aux PUD2 = Gnd}{ECL_chan&0xff=6:Aux PUD3 = Gnd}{ECL_chan&0xff" VALUE 0x001c86c5 /* @ECU_Address@ECL_chan@0x01010480@ */ ECIPP_ALIGNMENT_UBYTE 255 ECL_chan_COMPU_VTAB 0 255 BIT_MASK 0xff /end CHARACTERISTIC
/begin COMPU_METHOD ECL_chan_COMPU_VTAB "Verbal Table" TAB_VERB "%.0" "list" COMPU_TAB_REF ECL_chan_COMPU_VTAB_REF /end COMPU_METHOD
/begin COMPU_VTAB ECL_chan_COMPU_VTAB_REF "Verbal Table" TAB_VERB 30 0 "Disabled" 1 "Aux PU1 = Gnd" 2 "Aux PU2 = Gnd" 3 "Aux PU3 = Gnd" 4 "Aux PUD1 = Gnd" 5 "Aux PUD2 = Gnd" 6 "Aux PUD3 = Gnd" 7 "Aux PUD4 = +V" 8 "Aux PUD5 = Gnd" 9 "Aux DIG1" 10 "Aux DIG2" 11 "Aux DIG3" 12 "Aux DIG4" 13 "Aux DIG5" 14 "Aux DIG6" 15 "Aux DIG7" 16 "Aux DIG8" 17 "Aux DIG9" 18 "Aux DIG10" 19 "Aux DIG11" 20 "Aux DIG12" 21 "Aux DIG13" 22 "Aux DIG14" 23 "Aux DIG15" 24 "Aux DIG16" 25 "Aux DIG17" 26 "Aux DIG18" 27 "Aux DIG19" 28 "Gov1" 29 "Gov2" DEFAULT_VALUE "UNKNOWN" /end COMPU_VTAB
/begin CHARACTERISTIC ECL_chan_cfg "Coolant level sensor input Aux DIG config{ECL_chan_cfg&0xff=0:Default}{ECL_chan_cfg&0xff=1:GND}{ECL_chan_cfg&0xff=2:GND/+V}{ECL_chan_cfg&0xff=3:+V}{ECL_chan_cfg&0xff=4:Open}" VALUE 0x001c86c6 /* @ECU_Address@ECL_chan_cfg@0x01010488@ */ ECIPP_ALIGNMENT_UBYTE 255 ECL_chan_cfg_COMPU_VTAB 0 255 BIT_MASK 0xff /end CHARACTERISTIC
/begin COMPU_METHOD ECL_chan_cfg_COMPU_VTAB "Verbal Table" TAB_VERB "%.0" "list" COMPU_TAB_REF ECL_chan_cfg_COMPU_VTAB_REF /end COMPU_METHOD
/begin COMPU_VTAB ECL_chan_cfg_COMPU_VTAB_REF "Verbal Table" TAB_VERB 5 0 "Default" 1 "GND" 2 "GND/+V" 3 "+V" 4 "Open" DEFAULT_VALUE "UNKNOWN" /end COMPU_VTAB
/begin CHARACTERISTIC AFILT_dP_chan "Air filter pressure sensor input{AFILT_dP_chan&0xff=0:Disabled}{AFILT_dP_chan&0xff=1:Aux PU1 = Gnd}{AFILT_dP_chan&0xff=2:Aux PU2 = Gnd}{AFILT_dP_chan&0xff=3:Aux PU3 = Gnd}{AFILT_dP_chan&0xff=4:Aux PUD1 = Gnd}{AFILT_dP_chan&0xff=5:Aux PUD2 = Gnd}{AFILT_dP_" VALUE 0x001c8671 /* @ECU_Address@AFILT_dP_chan@0x01010490@ */ ECIPP_ALIGNMENT_UBYTE 255 AFILT_dP_chan_COMPU_VTAB 0 255 BIT_MASK 0xff /end CHARACTERISTIC
/begin COMPU_METHOD AFILT_dP_chan_COMPU_VTAB "Verbal Table" TAB_VERB "%.0" "list" COMPU_TAB_REF AFILT_dP_chan_COMPU_VTAB_REF /end COMPU_METHOD
/begin COMPU_VTAB AFILT_dP_chan_COMPU_VTAB_REF "Verbal Table" TAB_VERB 30 0 "Disabled" 1 "Aux PU1 = Gnd" 2 "Aux PU2 = Gnd" 3 "Aux PU3 = Gnd" 4 "Aux PUD1 = Gnd" 5 "Aux PUD2 = Gnd" 6 "Aux PUD3 = Gnd" 7 "Aux PUD4 = +V" 8 "Aux PUD5 = Gnd" 9 "Aux DIG1" 10 "Aux DIG2" 11 "Aux DIG3" 12 "Aux DIG4" 13 "Aux DIG5" 14 "Aux DIG6" 15 "Aux DIG7" 16 "Aux DIG8" 17 "Aux DIG9" 18 "Aux DIG10" 19 "Aux DIG11" 20 "Aux DIG12" 21 "Aux DIG13" 22 "Aux DIG14" 23 "Aux DIG15" 24 "Aux DIG16" 25 "Aux DIG17" 26 "Aux DIG18" 27 "Aux DIG19" 28 "Gov1" 29 "Gov2" DEFAULT_VALUE "UNKNOWN" /end COMPU_VTAB
/begin CHARACTERISTIC AFILT_dP_chan_cfg "Air filter pressure sensor Aux DIG config{AFILT_dP_chan_cfg&0xff=0:Default}{AFILT_dP_chan_cfg&0xff=1:GND}{AFILT_dP_chan_cfg&0xff=2:GND/+V}{AFILT_dP_chan_cfg&0xff=3:+V}{AFILT_dP_chan_cfg&0xff=4:Open}" VALUE 0x001c8672 /* @ECU_Address@AFILT_dP_chan_cfg@0x01010498@ */ ECIPP_ALIGNMENT_UBYTE 255 AFILT_dP_chan_cfg_COMPU_VTAB 0 255 BIT_MASK 0xff /end CHARACTERISTIC
/begin COMPU_METHOD AFILT_dP_chan_cfg_COMPU_VTAB "Verbal Table" TAB_VERB "%.0" "list" COMPU_TAB_REF AFILT_dP_chan_cfg_COMPU_VTAB_REF /end COMPU_METHOD
/begin COMPU_VTAB AFILT_dP_chan_cfg_COMPU_VTAB_REF "Verbal Table" TAB_VERB 5 0 "Default" 1 "GND" 2 "GND/+V" 3 "+V" 4 "Open" DEFAULT_VALUE "UNKNOWN" /end COMPU_VTAB
/begin CHARACTERISTIC ECL_start_lock_ena "Coolant level start lockout{ECL_start_lock_ena&0xff=0x00:Disabled}{ECL_start_lock_ena&0xff=0x01:Enabled}" VALUE 0x001c86c7 /* @ECU_Address@ECL_start_lock_ena@0x010104A0@ */ ECIPP_ALIGNMENT_UBYTE 255 ECL_start_lock_ena_COMPU_VTAB 0 255 BIT_MASK 0xff /end CHARACTERISTIC
/begin COMPU_METHOD ECL_start_lock_ena_COMPU_VTAB "Verbal Table" TAB_VERB "%.0" "list" COMPU_TAB_REF ECL_start_lock_ena_COMPU_VTAB_REF /end COMPU_METHOD
/begin COMPU_VTAB ECL_start_lock_ena_COMPU_VTAB_REF "Verbal Table" TAB_VERB 2 0x00 "Disabled" 0x01 "Enabled" DEFAULT_VALUE "UNKNOWN" /end COMPU_VTAB
/begin MEASUREMENT ECL_inhibit_start "Coolant level start lockout active" UBYTE Compu_ECL_inhibit_start 0 0 0 255 ECU_ADDRESS 0x010104A8 /end MEASUREMENT
/begin COMPU_METHOD Compu_ECL_inhibit_start " " RAT_FUNC "%.0" "-" COEFFS 0 1 0 0 0 1 /end COMPU_METHOD
/begin CHARACTERISTIC alternator_chg_V "Alternator charging threshold" VALUE 0x001c839a /* @ECU_Address@alternator_chg_V@0x010105C8@ */ ECIPP_ALIGNMENT_UWORD 256 Compu_alternator_chg_V 0 255.99609375 /end CHARACTERISTIC
/begin COMPU_METHOD Compu_alternator_chg_V " " RAT_FUNC "%.2" "volts" COEFFS 0 256 0 0 0 1 /end COMPU_METHOD
/begin MEASUREMENT Valternator "Alternator voltage" UWORD Compu_Valternator 0 0 0 255.99609375 ECU_ADDRESS 0x010105D0 /end MEASUREMENT
/begin COMPU_METHOD Compu_Valternator " " RAT_FUNC "%.2" "volts" COEFFS 0 256 0 0 0 1 /end COMPU_METHOD
/begin CHARACTERISTIC FTPM_mode "FTPM mode{FTPM_mode&0xff=0:Disabled}{FTPM_mode&0xff=1:Enabled}" VALUE 0x001c873f /* @ECU_Address@FTPM_mode@0x01012DA8@ */ ECIPP_ALIGNMENT_UBYTE 255 FTPM_mode_COMPU_VTAB 0 255 BIT_MASK 0xff /end CHARACTERISTIC
/begin COMPU_METHOD FTPM_mode_COMPU_VTAB "Verbal Table" TAB_VERB "%.0" "list" COMPU_TAB_REF FTPM_mode_COMPU_VTAB_REF /end COMPU_METHOD
/begin COMPU_VTAB FTPM_mode_COMPU_VTAB_REF "Verbal Table" TAB_VERB 2 0 "Disabled" 1 "Enabled" DEFAULT_VALUE "UNKNOWN" /end COMPU_VTAB
/begin MEASUREMENT FTT_state "FTT rationalization state{FTT_state&0xff=0:Off}{FTT_state&0xff=1:Monitoring}{FTT_state&0xff=2:Above normal}{FTT_state&0xff=3:Vaporizing}{FTT_state&0xff=4:Fault}" SBYTE FTT_state_COMPU_VTAB 0 0 -128 127 ECU_ADDRESS 0x01012DB0 BIT_MASK 0xff /end MEASUREMENT
/begin COMPU_METHOD FTT_state_COMPU_VTAB "Verbal Table" TAB_VERB "%.0" "list" COMPU_TAB_REF FTT_state_COMPU_VTAB_REF /end COMPU_METHOD
/begin COMPU_VTAB FTT_state_COMPU_VTAB_REF "Verbal Table" TAB_VERB 5 0 "Off" 1 "Monitoring" 2 "Above normal" 3 "Vaporizing" 4 "Fault" DEFAULT_VALUE "UNKNOWN" /end COMPU_VTAB
/begin CHARACTERISTIC FTT_inc_slew_tank "FTT max inc tank heat slew rate" VALUE 0x001c7b8c /* @ECU_Address@FTT_inc_slew_tank@0x01012DB8@ */ ECIPP_ALIGNMENT_UWORD 1024 Compu_FTT_inc_slew_tank 0 1023.984375 /end CHARACTERISTIC
/begin COMPU_METHOD Compu_FTT_inc_slew_tank " " RAT_FUNC "%.1" "deg F/min" COEFFS 0 64 0 0 0 1 /end COMPU_METHOD
/begin CHARACTERISTIC FTT_inc_slew_idle "FTT max inc heat soak slew rate" VALUE 0x001c7b8a /* @ECU_Address@FTT_inc_slew_idle@0x01012DC0@ */ ECIPP_ALIGNMENT_UWORD 1024 Compu_FTT_inc_slew_idle 0 1023.984375 /end CHARACTERISTIC
/begin COMPU_METHOD Compu_FTT_inc_slew_idle " " RAT_FUNC "%.1" "deg F/min" COEFFS 0 64 0 0 0 1 /end COMPU_METHOD
/begin MEASUREMENT FTT_expected_max "FTT maximum expected" UWORD Compu_FTT_expected_max 0 0 -460 563.984375 ECU_ADDRESS 0x01012DC8 /end MEASUREMENT
/begin COMPU_METHOD Compu_FTT_expected_max " " RAT_FUNC "%.1" "deg F" COEFFS 0 64 29440 0 0 1 /end COMPU_METHOD
/begin MEASUREMENT FTT_expected_tank "FTT maximum due to tank heat" UWORD Compu_FTT_expected_tank 0 0 -460 563.984375 ECU_ADDRESS 0x01012DD0 /end MEASUREMENT
/begin COMPU_METHOD Compu_FTT_expected_tank " " RAT_FUNC "%.1" "deg F" COEFFS 0 64 29440 0 0 1 /end COMPU_METHOD
/begin MEASUREMENT FTT_tolerance "FTT tolerance" UWORD Compu_FTT_tolerance 0 0 0 1023.984375 ECU_ADDRESS 0x01012DD8 /end MEASUREMENT
/begin COMPU_METHOD Compu_FTT_tolerance " " RAT_FUNC "%.1" "deg F" COEFFS 0 64 0 0 0 1 /end COMPU_METHOD
/begin MEASUREMENT FTT_min_vapor "FTT minimum for vaporization" UWORD Compu_FTT_min_vapor 0 0 -460 563.984375 ECU_ADDRESS 0x01012DE0 /end MEASUREMENT
/begin COMPU_METHOD Compu_FTT_min_vapor " " RAT_FUNC "%.1" "deg F" COEFFS 0 64 29440 0 0 1 /end COMPU_METHOD
/begin MEASUREMENT FTT_vapor_Ierr "FTT accumulated vapor error" ULONG Compu_FTT_vapor_Ierr 0 0 0 67108.863984375 ECU_ADDRESS 0x01012DE8 /end MEASUREMENT
/begin COMPU_METHOD Compu_FTT_vapor_Ierr " " RAT_FUNC "%.2" "deg F*sec" COEFFS 0 64000 0 0 0 1 /end COMPU_METHOD
/begin MEASUREMENT FTT_vapor_Ierr_lim "FTT accumulated vapor error limit" UWORD Compu_FTT_vapor_Ierr_lim 0 0 0 1023.984375 ECU_ADDRESS 0x01012DF0 /end MEASUREMENT
/begin COMPU_METHOD Compu_FTT_vapor_Ierr_lim " " RAT_FUNC "%.2" "deg F*sec" COEFFS 0 64 0 0 0 1 /end COMPU_METHOD
/begin MEASUREMENT FTT_max_tank "FTT limit for FTPM" UWORD Compu_FTT_max_tank 0 0 -460 563.984375 ECU_ADDRESS 0x01012DF8 /end MEASUREMENT
/begin COMPU_METHOD Compu_FTT_max_tank " " RAT_FUNC "%.1" "deg F" COEFFS 0 64 29440 0 0 1 /end COMPU_METHOD
/begin CHARACTERISTIC FTPM_imp_md_f_min "FTT/FIMP rationalization min fuel flow" VALUE 0x001c7b7e /* @ECU_Address@FTPM_imp_md_f_min@0x01012E00@ */ ECIPP_ALIGNMENT_UWORD 128 Compu_FTPM_imp_md_f_min 0 127.998046875 /end CHARACTERISTIC
/begin COMPU_METHOD Compu_FTPM_imp_md_f_min " " RAT_FUNC "%.2" "g/sec" COEFFS 0 512 0 0 0 1 /end COMPU_METHOD
/begin CHARACTERISTIC FTPM_imp_md_f_max "Rationalized FIMP max fuel flow" VALUE 0x001c7b7c /* @ECU_Address@FTPM_imp_md_f_max@0x01012E08@ */ ECIPP_ALIGNMENT_UWORD 128 Compu_FTPM_imp_md_f_max 0 127.998046875 /end CHARACTERISTIC
/begin COMPU_METHOD Compu_FTPM_imp_md_f_max " " RAT_FUNC "%.2" "g/sec" COEFFS 0 512 0 0 0 1 /end COMPU_METHOD
/begin CHARACTERISTIC FTPM_imp_max_idle_tm "Rationalized FIMP max idle time" VALUE 0x001c7b7a /* @ECU_Address@FTPM_imp_max_idle_tm@0x01012E10@ */ ECIPP_ALIGNMENT_UWORD 65535 Compu_FTPM_imp_max_idle_tm 0 65535 /end CHARACTERISTIC
/begin COMPU_METHOD Compu_FTPM_imp_max_idle_tm " " RAT_FUNC "%.0" "sec" COEFFS 0 1 0 0 0 1 /end COMPU_METHOD
/begin MEASUREMENT FTPM_imp_actv "Rationalized FIMP updating{FTPM_imp_actv&0xff=0:NO}{FTPM_imp_actv&0xff=1:YES}" UBYTE FTPM_imp_actv_COMPU_VTAB 0 0 0 255 ECU_ADDRESS 0x01012E18 BIT_MASK 0xff /end MEASUREMENT
/begin COMPU_METHOD FTPM_imp_actv_COMPU_VTAB "Verbal Table" TAB_VERB "%.0" "list" COMPU_TAB_REF FTPM_imp_actv_COMPU_VTAB_REF /end COMPU_METHOD
/begin COMPU_VTAB FTPM_imp_actv_COMPU_VTAB_REF "Verbal Table" TAB_VERB 2 0 "NO" 1 "YES" DEFAULT_VALUE "UNKNOWN" /end COMPU_VTAB
/begin MEASUREMENT FTPM_imp_inst "Rationalized FIMP" UWORD Compu_FTPM_imp_inst 0 0 0 99.9984741210938 ECU_ADDRESS 0x01012E20 /end MEASUREMENT
/begin COMPU_METHOD Compu_FTPM_imp_inst " " RAT_FUNC "%.1" "%" COEFFS 0 655.36 0 0 0 1 /end COMPU_METHOD
/begin MEASUREMENT FTPM_imp_tmr "Rationalized FIMP update timer" ULONG Compu_FTPM_imp_tmr 0 0 0 4294967.295 ECU_ADDRESS 0x01012E28 /end MEASUREMENT
/begin COMPU_METHOD Compu_FTPM_imp_tmr " " RAT_FUNC "%.1" "sec" COEFFS 0 1000 0 0 0 1 /end COMPU_METHOD
/begin CHARACTERISTIC FTPM_imp_learn_tm "Rationalized FIMP initial learn time" VALUE 0x001c7b78 /* @ECU_Address@FTPM_imp_learn_tm@0x01012E30@ */ ECIPP_ALIGNMENT_UWORD 66 Compu_FTPM_imp_learn_tm 0 65.535 /end CHARACTERISTIC
/begin COMPU_METHOD Compu_FTPM_imp_learn_tm " " RAT_FUNC "%.1" "sec" COEFFS 0 1000 0 0 0 1 /end COMPU_METHOD
/begin CHARACTERISTIC FTPM_imp_learn_tau "Rationalized FIMP initial learn tau" VALUE 0x001c854c /* @ECU_Address@FTPM_imp_learn_tau@0x01012E38@ */ ECIPP_ALIGNMENT_UWORD 3277 Compu_FTPM_imp_learn_tau 0.0045084 3276.8 /end CHARACTERISTIC
/begin COMPU_METHOD Compu_FTPM_imp_learn_tau " " FORM "%.1" "sec"
 /begin FORMULA "-0.05 / log(1 - (X1 / 65536))" FORMULA_INV "(1 - exp(-0.05/X1)) * 65536" /end FORMULA
/end COMPU_METHOD
/begin CHARACTERISTIC FTPM_imp_dec_tau "Rationalized FIMP ss decreasing tau" VALUE 0x001c854a /* @ECU_Address@FTPM_imp_dec_tau@0x01012E40@ */ ECIPP_ALIGNMENT_UWORD 3277 Compu_FTPM_imp_dec_tau 0.0045084 3276.8 /end CHARACTERISTIC
/begin COMPU_METHOD Compu_FTPM_imp_dec_tau " " FORM "%.1" "sec"
 /begin FORMULA "-0.05 / log(1 - (X1 / 65536))" FORMULA_INV "(1 - exp(-0.05/X1)) * 65536" /end FORMULA
/end COMPU_METHOD
/begin CHARACTERISTIC FTPM_imp_inc_tau "Rationalized FIMP ss increasing tau" VALUE 0x001c7b76 /* @ECU_Address@FTPM_imp_inc_tau@0x01012E48@ */ ECIPP_ALIGNMENT_UWORD 65535 Compu_FTPM_imp_inc_tau 0 65535 /end CHARACTERISTIC
/begin COMPU_METHOD Compu_FTPM_imp_inc_tau " " RAT_FUNC "%.0" "sec" COEFFS 0 1 0 0 0 1 /end COMPU_METHOD
/begin MEASUREMENT FTPM_imp_lp "Rationalized FIMP low-passed" UWORD Compu_FTPM_imp_lp 0 0 0 99.9984741210938 ECU_ADDRESS 0x01012E50 /end MEASUREMENT
/begin COMPU_METHOD Compu_FTPM_imp_lp " " RAT_FUNC "%.1" "%" COEFFS 0 655.36 0 0 0 1 /end COMPU_METHOD
/begin MEASUREMENT FTPM_expected_FTP "FTPM expected FTP" UWORD Compu_FTPM_expected_FTP 0 0 0 8191.875 ECU_ADDRESS 0x01012E58 /end MEASUREMENT
/begin COMPU_METHOD Compu_FTPM_expected_FTP " " RAT_FUNC "%.1" "psia" COEFFS 0 8 0 0 0 1 /end COMPU_METHOD
/begin CHARACTERISTIC FTPM_min_FTP_mult "FTPM minimum FTP multiplier" VALUE 0x001c7b86 /* @ECU_Address@FTPM_min_FTP_mult@0x01012E60@ */ ECIPP_ALIGNMENT_UWORD 100 Compu_FTPM_min_FTP_mult 0 99.9984741210938 /end CHARACTERISTIC
/begin COMPU_METHOD Compu_FTPM_min_FTP_mult " " RAT_FUNC "%.1" "%" COEFFS 0 655.36 0 0 0 1 /end COMPU_METHOD
/begin MEASUREMENT FTPM_min_FTP "FTPM minimum FTP" UWORD Compu_FTPM_min_FTP 0 0 0 8191.875 ECU_ADDRESS 0x01012E68 /end MEASUREMENT
/begin COMPU_METHOD Compu_FTPM_min_FTP " " RAT_FUNC "%.1" "psia" COEFFS 0 8 0 0 0 1 /end COMPU_METHOD
/begin CHARACTERISTIC FTPM_min_FTP_lim "FTPM minimum FTP lower limit" VALUE 0x001c7b84 /* @ECU_Address@FTPM_min_FTP_lim@0x01012E70@ */ ECIPP_ALIGNMENT_UWORD 8192 Compu_FTPM_min_FTP_lim 0 8191.875 /end CHARACTERISTIC
/begin COMPU_METHOD Compu_FTPM_min_FTP_lim " " RAT_FUNC "%.1" "psia" COEFFS 0 8 0 0 0 1 /end COMPU_METHOD
/begin CHARACTERISTIC FTPM_min_FTP_inc_tau "FTPM minimum FTP tau" VALUE 0x001c7b82 /* @ECU_Address@FTPM_min_FTP_inc_tau@0x01012E78@ */ ECIPP_ALIGNMENT_UWORD 65535 Compu_FTPM_min_FTP_inc_tau 0 65535 /end CHARACTERISTIC
/begin COMPU_METHOD Compu_FTPM_min_FTP_inc_tau " " RAT_FUNC "%.0" "sec" COEFFS 0 1 0 0 0 1 /end COMPU_METHOD
/begin MEASUREMENT FTPM_min_FTP_lp "FTPM minimum FTP low-passed" UWORD Compu_FTPM_min_FTP_lp 0 0 0 8191.875 ECU_ADDRESS 0x01012E80 /end MEASUREMENT
/begin COMPU_METHOD Compu_FTPM_min_FTP_lp " " RAT_FUNC "%.1" "psia" COEFFS 0 8 0 0 0 1 /end COMPU_METHOD
/begin MEASUREMENT FTPM_latch_tmr "FTPM latch timer" UWORD Compu_FTPM_latch_tmr 0 0 0 65.535 ECU_ADDRESS 0x01012E88 /end MEASUREMENT
/begin COMPU_METHOD Compu_FTPM_latch_tmr " " RAT_FUNC "%.1" "sec" COEFFS 0 1000 0 0 0 1 /end COMPU_METHOD
/begin CHARACTERISTIC FTPM_latch_tm "FTPM low pressure latch time" VALUE 0x001c7b80 /* @ECU_Address@FTPM_latch_tm@0x01012E90@ */ ECIPP_ALIGNMENT_UWORD 66 Compu_FTPM_latch_tm 0 65.535 /end CHARACTERISTIC
/begin COMPU_METHOD Compu_FTPM_latch_tm " " RAT_FUNC "%.1" "sec" COEFFS 0 1000 0 0 0 1 /end COMPU_METHOD
/begin MEASUREMENT FTPM_low "FTPM low pressure state{FTPM_low&0xff=0:NO}{FTPM_low&0xff=1:YES}" UBYTE FTPM_low_COMPU_VTAB 0 0 0 255 ECU_ADDRESS 0x01012E98 BIT_MASK 0xff /end MEASUREMENT
/begin COMPU_METHOD FTPM_low_COMPU_VTAB "Verbal Table" TAB_VERB "%.0" "list" COMPU_TAB_REF FTPM_low_COMPU_VTAB_REF /end COMPU_METHOD
/begin COMPU_VTAB FTPM_low_COMPU_VTAB_REF "Verbal Table" TAB_VERB 2 0 "NO" 1 "YES" DEFAULT_VALUE "UNKNOWN" /end COMPU_VTAB
/begin CHARACTERISTIC CCT_ena "Crankcase temperature input{CCT_ena&0xff=0:Disabled}{CCT_ena&0xff=1:Aux PU1}{CCT_ena&0xff=2:Aux PU2}{CCT_ena&0xff=3:Aux PU3}{CCT_ena&0xff=4:Aux PUD1}{CCT_ena&0xff=5:Aux PUD2}{CCT_ena&0xff=6:Aux PUD3}{CCT_ena&0xff=7:EGT Input}{CCT_ena&0xff=8:Aux PUD4}{CCT_" VALUE 0x001c869d /* @ECU_Address@CCT_ena@0x010136F0@ */ ECIPP_ALIGNMENT_UBYTE 255 CCT_ena_COMPU_VTAB 0 255 BIT_MASK 0xff /end CHARACTERISTIC
/begin COMPU_METHOD CCT_ena_COMPU_VTAB "Verbal Table" TAB_VERB "%.0" "list" COMPU_TAB_REF CCT_ena_COMPU_VTAB_REF /end COMPU_METHOD
/begin COMPU_VTAB CCT_ena_COMPU_VTAB_REF "Verbal Table" TAB_VERB 31 0 "Disabled" 1 "Aux PU1" 2 "Aux PU2" 3 "Aux PU3" 4 "Aux PUD1" 5 "Aux PUD2" 6 "Aux PUD3" 7 "EGT Input" 8 "Aux PUD4" 9 "Aux PUD5" 10 "Aux PUD6" 11 "Aux PUD7" 12 "Aux PUD8" 13 "Aux PUD9" 14 "Aux PUD10" 15 "Aux PUD11" 16 "Aux PUD12" 17 "Aux PUD13" 18 "Aux PUD14" 19 "Aux PUD15" 20 "Aux PUD16" 21 "Aux PUD17" 22 "Aux PUD18" 23 "Aux PUD19" 24 "Aux PUD20" 25 "Aux PUD21" 26 "Aux PUD22" 27 "Aux PUD23" 28 "Aux PUD24" 29 "Aux PUD25" 30 "CAN sourced" DEFAULT_VALUE "UNKNOWN" /end COMPU_VTAB
/begin CHARACTERISTIC fuel_mon_CL_lmt "Low fuel reaction - CL low and CL high faults{fuel_mon_CL_lmt&0xff=0:None}{fuel_mon_CL_lmt&0xff=1:Inhibit updates}" VALUE 0x001c9032 /* @ECU_Address@fuel_mon_CL_lmt@0x01013BC0@ */ ECIPP_ALIGNMENT_UBYTE 255 fuel_mon_CL_lmt_COMPU_VTAB 0 255 BIT_MASK 0xff /end CHARACTERISTIC
/begin COMPU_METHOD fuel_mon_CL_lmt_COMPU_VTAB "Verbal Table" TAB_VERB "%.0" "list" COMPU_TAB_REF fuel_mon_CL_lmt_COMPU_VTAB_REF /end COMPU_METHOD
/begin COMPU_VTAB fuel_mon_CL_lmt_COMPU_VTAB_REF "Verbal Table" TAB_VERB 2 0 "None" 1 "Inhibit updates" DEFAULT_VALUE "UNKNOWN" /end COMPU_VTAB
/begin CHARACTERISTIC fuel_mon_CL_ctl_lmt "Low fuel reaction - CL control at limit faults{fuel_mon_CL_ctl_lmt&0xff=0:None}{fuel_mon_CL_ctl_lmt&0xff=1:Inhibit updates}" VALUE 0x001c9031 /* @ECU_Address@fuel_mon_CL_ctl_lmt@0x01013BC8@ */ ECIPP_ALIGNMENT_UBYTE 255 fuel_mon_CL_ctl_lmt_COMPU_VTAB 0 255 BIT_MASK 0xff /end CHARACTERISTIC
/begin COMPU_METHOD fuel_mon_CL_ctl_lmt_COMPU_VTAB "Verbal Table" TAB_VERB "%.0" "list" COMPU_TAB_REF fuel_mon_CL_ctl_lmt_COMPU_VTAB_REF /end COMPU_METHOD
/begin COMPU_VTAB fuel_mon_CL_ctl_lmt_COMPU_VTAB_REF "Verbal Table" TAB_VERB 2 0 "None" 1 "Inhibit updates" DEFAULT_VALUE "UNKNOWN" /end COMPU_VTAB
/begin CHARACTERISTIC fuel_mon_EPR_low "Low fuel reaction - EPR / CFV low pressure faults{fuel_mon_EPR_low&0xff=0:None}{fuel_mon_EPR_low&0xff=1:Inhibit updates}" VALUE 0x001c9033 /* @ECU_Address@fuel_mon_EPR_low@0x01013BD0@ */ ECIPP_ALIGNMENT_UBYTE 255 fuel_mon_EPR_low_COMPU_VTAB 0 255 BIT_MASK 0xff /end CHARACTERISTIC
/begin COMPU_METHOD fuel_mon_EPR_low_COMPU_VTAB "Verbal Table" TAB_VERB "%.0" "list" COMPU_TAB_REF fuel_mon_EPR_low_COMPU_VTAB_REF /end COMPU_METHOD
/begin COMPU_VTAB fuel_mon_EPR_low_COMPU_VTAB_REF "Verbal Table" TAB_VERB 2 0 "None" 1 "Inhibit updates" DEFAULT_VALUE "UNKNOWN" /end COMPU_VTAB
/begin CHARACTERISTIC fuel_mon_pres_low "Low fuel reaction - Low fuel pressure faults{fuel_mon_pres_low&0xff=0:None}{fuel_mon_pres_low&0xff=1:Inhibit updates}" VALUE 0x001c9036 /* @ECU_Address@fuel_mon_pres_low@0x01013BD8@ */ ECIPP_ALIGNMENT_UBYTE 255 fuel_mon_pres_low_COMPU_VTAB 0 255 BIT_MASK 0xff /end CHARACTERISTIC
/begin COMPU_METHOD fuel_mon_pres_low_COMPU_VTAB "Verbal Table" TAB_VERB "%.0" "list" COMPU_TAB_REF fuel_mon_pres_low_COMPU_VTAB_REF /end COMPU_METHOD
/begin COMPU_VTAB fuel_mon_pres_low_COMPU_VTAB_REF "Verbal Table" TAB_VERB 2 0 "None" 1 "Inhibit updates" DEFAULT_VALUE "UNKNOWN" /end COMPU_VTAB
/begin CHARACTERISTIC fuel_mon_boost "Low fuel reaction - Boost control faults{fuel_mon_boost&0xff=0:None}{fuel_mon_boost&0xff=1:Inhibit updates}" VALUE 0x001c9034 /* @ECU_Address@fuel_mon_boost@0x01013BE0@ */ ECIPP_ALIGNMENT_UBYTE 255 fuel_mon_boost_COMPU_VTAB 0 255 BIT_MASK 0xff /end CHARACTERISTIC
/begin COMPU_METHOD fuel_mon_boost_COMPU_VTAB "Verbal Table" TAB_VERB "%.0" "list" COMPU_TAB_REF fuel_mon_boost_COMPU_VTAB_REF /end COMPU_METHOD
/begin COMPU_VTAB fuel_mon_boost_COMPU_VTAB_REF "Verbal Table" TAB_VERB 2 0 "None" 1 "Inhibit updates" DEFAULT_VALUE "UNKNOWN" /end COMPU_VTAB
/begin CHARACTERISTIC fuel_mon_precat_OOR "Low fuel reaction - Pre-cat O2 sensor out of range fault{fuel_mon_precat_OOR&0xff=0:None}{fuel_mon_precat_OOR&0xff=1:Inhibit updates}" VALUE 0x001c9035 /* @ECU_Address@fuel_mon_precat_OOR@0x01013BE8@ */ ECIPP_ALIGNMENT_UBYTE 255 fuel_mon_precat_OOR_COMPU_VTAB 0 255 BIT_MASK 0xff /end CHARACTERISTIC
/begin COMPU_METHOD fuel_mon_precat_OOR_COMPU_VTAB "Verbal Table" TAB_VERB "%.0" "list" COMPU_TAB_REF fuel_mon_precat_OOR_COMPU_VTAB_REF /end COMPU_METHOD
/begin COMPU_VTAB fuel_mon_precat_OOR_COMPU_VTAB_REF "Verbal Table" TAB_VERB 2 0 "None" 1 "Inhibit updates" DEFAULT_VALUE "UNKNOWN" /end COMPU_VTAB
/begin MEASUREMENT AUX_start_sw_stat "Auxiliary start switch input status{AUX_start_sw_stat&0xff=0:Not Active}{AUX_start_sw_stat&0xff=1:Active}{AUX_start_sw_stat&0xff=2:Error/Fault}{AUX_start_sw_stat&0xff=3:Not Configured}" UBYTE AUX_start_sw_stat_COMPU_VTAB 0 0 0 255 ECU_ADDRESS 0x01014998 BIT_MASK 0xff /end MEASUREMENT
/begin COMPU_METHOD AUX_start_sw_stat_COMPU_VTAB "Verbal Table" TAB_VERB "%.0" "list" COMPU_TAB_REF AUX_start_sw_stat_COMPU_VTAB_REF /end COMPU_METHOD
/begin COMPU_VTAB AUX_start_sw_stat_COMPU_VTAB_REF "Verbal Table" TAB_VERB 4 0 "Not Active" 1 "Active" 2 "Error/Fault" 3 "Not Configured" DEFAULT_VALUE "UNKNOWN" /end COMPU_VTAB
/begin MEASUREMENT AUX_stop_sw_stat "Auxiliary stop switch input status{AUX_stop_sw_stat&0xff=0:Not Active}{AUX_stop_sw_stat&0xff=1:Active}{AUX_stop_sw_stat&0xff=2:Error/Fault}{AUX_stop_sw_stat&0xff=3:Not Configured}" UBYTE AUX_stop_sw_stat_COMPU_VTAB 0 0 0 255 ECU_ADDRESS 0x010149A0 BIT_MASK 0xff /end MEASUREMENT
/begin COMPU_METHOD AUX_stop_sw_stat_COMPU_VTAB "Verbal Table" TAB_VERB "%.0" "list" COMPU_TAB_REF AUX_stop_sw_stat_COMPU_VTAB_REF /end COMPU_METHOD
/begin COMPU_VTAB AUX_stop_sw_stat_COMPU_VTAB_REF "Verbal Table" TAB_VERB 4 0 "Not Active" 1 "Active" 2 "Error/Fault" 3 "Not Configured" DEFAULT_VALUE "UNKNOWN" /end COMPU_VTAB
/begin MEASUREMENT ESD_LED "ESD switch{ESD_LED&0xff=0:Engine run}{ESD_LED&0xff=1:Engine STOP}" UBYTE ESD_LED_COMPU_VTAB 0 0 0 255 ECU_ADDRESS 0x01014D38 BIT_MASK 0xff /end MEASUREMENT
/begin COMPU_METHOD ESD_LED_COMPU_VTAB "Verbal Table" TAB_VERB "%.0" "list" COMPU_TAB_REF ESD_LED_COMPU_VTAB_REF /end COMPU_METHOD
/begin COMPU_VTAB ESD_LED_COMPU_VTAB_REF "Verbal Table" TAB_VERB 2 0 "Engine run" 1 "Engine STOP" DEFAULT_VALUE "UNKNOWN" /end COMPU_VTAB
/begin MEASUREMENT IGN_LED "IGN_DIS switch{IGN_LED&0xff=0:Engine run}{IGN_LED&0xff=1:Engine STOP}" UBYTE IGN_LED_COMPU_VTAB 0 0 0 255 ECU_ADDRESS 0x01014D40 BIT_MASK 0xff /end MEASUREMENT
/begin COMPU_METHOD IGN_LED_COMPU_VTAB "Verbal Table" TAB_VERB "%.0" "list" COMPU_TAB_REF IGN_LED_COMPU_VTAB_REF /end COMPU_METHOD
/begin COMPU_VTAB IGN_LED_COMPU_VTAB_REF "Verbal Table" TAB_VERB 2 0 "Engine run" 1 "Engine STOP" DEFAULT_VALUE "UNKNOWN" /end COMPU_VTAB
/begin CHARACTERISTIC ESD_chan "ESD input{ESD_chan&0xff=0:Disabled}{ESD_chan&0xff=1:Aux PU1 = Gnd}{ESD_chan&0xff=2:Aux PU2 = Gnd}{ESD_chan&0xff=3:Aux PU3 = Gnd}{ESD_chan&0xff=4:Aux PUD1 = Gnd}{ESD_chan&0xff=5:Aux PUD2 = Gnd}{ESD_chan&0xff=6:Aux PUD3 = Gnd}{ESD_chan&0xff=7:Aux PUD4 = +V}" VALUE 0x001c86ee /* @ECU_Address@ESD_chan@0x01014EC8@ */ ECIPP_ALIGNMENT_UBYTE 255 ESD_chan_COMPU_VTAB 0 255 BIT_MASK 0xff /end CHARACTERISTIC
/begin COMPU_METHOD ESD_chan_COMPU_VTAB "Verbal Table" TAB_VERB "%.0" "list" COMPU_TAB_REF ESD_chan_COMPU_VTAB_REF /end COMPU_METHOD
/begin COMPU_VTAB ESD_chan_COMPU_VTAB_REF "Verbal Table" TAB_VERB 30 0 "Disabled" 1 "Aux PU1 = Gnd" 2 "Aux PU2 = Gnd" 3 "Aux PU3 = Gnd" 4 "Aux PUD1 = Gnd" 5 "Aux PUD2 = Gnd" 6 "Aux PUD3 = Gnd" 7 "Aux PUD4 = +V" 8 "Aux PUD5 = Gnd" 9 "Aux DIG1" 10 "Aux DIG2" 11 "Aux DIG3" 12 "Aux DIG4" 13 "Aux DIG5" 14 "Aux DIG6" 15 "Aux DIG7" 16 "Aux DIG8" 17 "Aux DIG9" 18 "Aux DIG10" 19 "Aux DIG11" 20 "Aux DIG12" 21 "Aux DIG13" 22 "Aux DIG14" 23 "Aux DIG15" 24 "Aux DIG16" 25 "Aux DIG17" 26 "Aux DIG18" 27 "Aux DIG19" 28 "Gov1" 29 "Gov2" DEFAULT_VALUE "UNKNOWN" /end COMPU_VTAB
/begin CHARACTERISTIC ESD_chan_cfg "ESD input Aux DIG config{ESD_chan_cfg&0xff=0:Default}{ESD_chan_cfg&0xff=1:GND}{ESD_chan_cfg&0xff=2:GND/+V}{ESD_chan_cfg&0xff=3:+V}{ESD_chan_cfg&0xff=4:Open}" VALUE 0x001c86ef /* @ECU_Address@ESD_chan_cfg@0x01014ED0@ */ ECIPP_ALIGNMENT_UBYTE 255 ESD_chan_cfg_COMPU_VTAB 0 255 BIT_MASK 0xff /end CHARACTERISTIC
/begin COMPU_METHOD ESD_chan_cfg_COMPU_VTAB "Verbal Table" TAB_VERB "%.0" "list" COMPU_TAB_REF ESD_chan_cfg_COMPU_VTAB_REF /end COMPU_METHOD
/begin COMPU_VTAB ESD_chan_cfg_COMPU_VTAB_REF "Verbal Table" TAB_VERB 5 0 "Default" 1 "GND" 2 "GND/+V" 3 "+V" 4 "Open" DEFAULT_VALUE "UNKNOWN" /end COMPU_VTAB
/begin CHARACTERISTIC IGN_DIS_chan "IGN_DIS input{IGN_DIS_chan&0xff=0:Disabled}{IGN_DIS_chan&0xff=1:Aux PU1 = Gnd}{IGN_DIS_chan&0xff=2:Aux PU2 = Gnd}{IGN_DIS_chan&0xff=3:Aux PU3 = Gnd}{IGN_DIS_chan&0xff=4:Aux PUD1 = Gnd}{IGN_DIS_chan&0xff=5:Aux PUD2 = Gnd}{IGN_DIS_chan&0xff=6:Aux PUD3 = Gnd" VALUE 0x001c8781 /* @ECU_Address@IGN_DIS_chan@0x01014ED8@ */ ECIPP_ALIGNMENT_UBYTE 255 IGN_DIS_chan_COMPU_VTAB 0 255 BIT_MASK 0xff /end CHARACTERISTIC
/begin COMPU_METHOD IGN_DIS_chan_COMPU_VTAB "Verbal Table" TAB_VERB "%.0" "list" COMPU_TAB_REF IGN_DIS_chan_COMPU_VTAB_REF /end COMPU_METHOD
/begin COMPU_VTAB IGN_DIS_chan_COMPU_VTAB_REF "Verbal Table" TAB_VERB 30 0 "Disabled" 1 "Aux PU1 = Gnd" 2 "Aux PU2 = Gnd" 3 "Aux PU3 = Gnd" 4 "Aux PUD1 = Gnd" 5 "Aux PUD2 = Gnd" 6 "Aux PUD3 = Gnd" 7 "Aux PUD4 = +V" 8 "Aux PUD5 = Gnd" 9 "Aux DIG1" 10 "Aux DIG2" 11 "Aux DIG3" 12 "Aux DIG4" 13 "Aux DIG5" 14 "Aux DIG6" 15 "Aux DIG7" 16 "Aux DIG8" 17 "Aux DIG9" 18 "Aux DIG10" 19 "Aux DIG11" 20 "Aux DIG12" 21 "Aux DIG13" 22 "Aux DIG14" 23 "Aux DIG15" 24 "Aux DIG16" 25 "Aux DIG17" 26 "Aux DIG18" 27 "Aux DIG19" 28 "Gov1" 29 "Gov2" DEFAULT_VALUE "UNKNOWN" /end COMPU_VTAB
/begin CHARACTERISTIC IGN_DIS_chan_cfg "IGN_DIS input Aux DIG config{IGN_DIS_chan_cfg&0xff=0:Default}{IGN_DIS_chan_cfg&0xff=1:GND}{IGN_DIS_chan_cfg&0xff=2:GND/+V}{IGN_DIS_chan_cfg&0xff=3:+V}{IGN_DIS_chan_cfg&0xff=4:Open}" VALUE 0x001c8782 /* @ECU_Address@IGN_DIS_chan_cfg@0x01014EE0@ */ ECIPP_ALIGNMENT_UBYTE 255 IGN_DIS_chan_cfg_COMPU_VTAB 0 255 BIT_MASK 0xff /end CHARACTERISTIC
/begin COMPU_METHOD IGN_DIS_chan_cfg_COMPU_VTAB "Verbal Table" TAB_VERB "%.0" "list" COMPU_TAB_REF IGN_DIS_chan_cfg_COMPU_VTAB_REF /end COMPU_METHOD
/begin COMPU_VTAB IGN_DIS_chan_cfg_COMPU_VTAB_REF "Verbal Table" TAB_VERB 5 0 "Default" 1 "GND" 2 "GND/+V" 3 "+V" 4 "Open" DEFAULT_VALUE "UNKNOWN" /end COMPU_VTAB
/begin CHARACTERISTIC fuellev_V_inter "Fuel level 25%" VAL_BLK 0x001C8448 /* @ECU_Address@fuellev_V_inter@0x02202000@ */ ECIPP_ALIGNMENT_UWORD 256 Compu_fuellev_V_inter 0 255.99609375 MATRIX_DIM 3 1 1 /end CHARACTERISTIC
/begin COMPU_METHOD Compu_fuellev_V_inter " " RAT_FUNC "%.2" "%" COEFFS 0 256 0 0 0 1 /end COMPU_METHOD
/begin COMPU_METHOD Compu_TFTT_imp_pct " " RAT_FUNC "%.1" "Fuel Impurity (%)" COEFFS 0 163.84 0 0 0 1 /end COMPU_METHOD
/begin CHARACTERISTIC TFTT_tolerance "FTT Tolerance" CURVE 0x001C80E2 /* @ECU_Address@TFTT_tolerance@0x02649000@ */ ECIPP_ALIGNMENT_UWORD 1024 Compu_TFTT_tolerance 0 1023.984375
 /begin AXIS_DESCR COM_AXIS NO_INPUT_QUANTITY Compu_TFTT_imp_pct 4 -200 199.993896484375 AXIS_PTS_REF TFTT_imp_pct /end AXIS_DESCR
/end CHARACTERISTIC
/begin AXIS_PTS TFTT_imp_pct " " 0x001C4E44 /* @ECU_Address@TFTT_imp_pct@0x02648000@ */ NO_INPUT_QUANTITY ECIPP_Lookup_SWORD 0 Compu_TFTT_imp_pct 4 -200 199.993896484375 /end AXIS_PTS
/begin COMPU_METHOD Compu_TFTT_tolerance " " RAT_FUNC "%.1" "deg F" COEFFS 0 64 0 0 0 1 /end COMPU_METHOD
/begin CHARACTERISTIC TFTT_vapor_Ierr_lim "FTT Vaporization Error Integral Limit" CURVE 0x001C80EA /* @ECU_Address@TFTT_vapor_Ierr_lim@0x0264A000@ */ ECIPP_ALIGNMENT_UWORD 1024 Compu_TFTT_vapor_Ierr_lim 0 1023.984375
 /begin AXIS_DESCR COM_AXIS NO_INPUT_QUANTITY Compu_TFTT_imp_pct 4 -200 199.993896484375 AXIS_PTS_REF TFTT_imp_pct /end AXIS_DESCR
/end CHARACTERISTIC
/begin COMPU_METHOD Compu_TFTT_vapor_Ierr_lim " " RAT_FUNC "%.2" "deg F*sec" COEFFS 0 64 0 0 0 1 /end COMPU_METHOD
/begin GROUP EC_ConfigApp "ECONTROLS" ROOT
 /begin REF_CHARACTERISTIC Gov12_state_cfg Gov12_input_cfg FST_ena FST_def CL_fuellev_mon fuellev_in_ena fuellev_ratio_md fuellev_Vstd fuellev_V_0 fuellev_V_1 brake_chan brake_cfg brake_sec_chan brake_sec_cfg Gov1_aux_input Gov2_aux_input fuellev_low_pct fuellev_low_latch fuellev_low_unlatch mfi_rsc_ena mfi_pto_ena mfi_idle_ena AUX_start_chan AUX_start_chan_cfg AUX_stop_chan AUX_stop_chan_cfg idle_SD_tout idle_SD_wait_tout idle_SD_ena idle_SD_sw_chan idle_SD_sw_cfg KOR_action_1 KOR_action_2 KOR_key_cycles_1 KOR_key_cycles_2 KOR_FPP_cycles_1 KOR_FPP_cycles_2 KOR_conf_chan_1 KOR_conf_chan_2 KOR_conf_cycles_1 KOR_conf_cycles_2 KOR_conf_on_time KOR_conf_off_time KOR_seq_end_time KOR_state_min_time KOR_state_max_time KOR_FPP_dpsd_pct KOR_FPP_rlsd_pct LSM6DS3_accel_fs LSM6DS3_gyro_fs LSM6DS3_gyro_sign_x LSM6DS3_gyro_sign_y LSM6DS3_gyro_sign_z LSM6DS3_gyro_orient LSM6DS3_gyro_hpf LSM6DS3_accel_aabw LSM6DS3_accel_cdf LSM6DS3_accel_odr LSM6DS3_gyro_odr ECL_chan ECL_chan_cfg AFILT_dP_chan AFILT_dP_chan_cfg ECL_start_lock_ena alternator_chg_V FTPM_mode FTT_inc_slew_tank FTT_inc_slew_idle FTPM_imp_md_f_min FTPM_imp_md_f_max FTPM_imp_max_idle_tm FTPM_imp_learn_tm FTPM_imp_learn_tau FTPM_imp_dec_tau FTPM_imp_inc_tau FTPM_min_FTP_mult FTPM_min_FTP_lim FTPM_min_FTP_inc_tau FTPM_latch_tm CCT_ena fuel_mon_CL_lmt fuel_mon_CL_ctl_lmt fuel_mon_EPR_low fuel_mon_pres_low fuel_mon_boost fuel_mon_precat_OOR ESD_chan ESD_chan_cfg IGN_DIS_chan IGN_DIS_chan_cfg fuellev_V_inter TFTT_tolerance TFTT_vapor_Ierr_lim /end REF_CHARACTERISTIC
 /begin REF_MEASUREMENT AUX_PU1_state AUX_PU2_state AUX_PU3_state AUX_PUD1_state AUX_PUD2_state AUX_PUD3_state AUX_DIG1_state AUX_DIG2_state AUX_DIG3_state FST FTT FTP fuellev_pct fuellev_volt AUX_DIG4_state AUX_DIG5_state AUX_DIG6_state AUX_DIG7_state AUX_DIG8_state AUX_DIG2_keyon AUX_DIG11_state AUX_DIG9_state AUX_DIG10_state AUX_DIG12_state AUX_DIG13_state AUX_DIG14_state AUX_DIG15_state AUX_DIG16_state AUX_DIG17_state AUX_DIG18_state AUX_DIG19_state AUX_PUD4_state AUX_PUD5_state AUX_PUD6_state AUX_PUD7_state AUX_PUD8_state AUX_PUD9_state AUX_PUD10_state AUX_PUD11_state AUX_PUD12_state AUX_PUD13_state AUX_PUD14_state AUX_PUD15_state AUX_PUD16_state AUX_PUD17_state AUX_PUD18_state AUX_PUD19_state AUX_PUD20_state AUX_PUD21_state AUX_PUD22_state AUX_PUD23_state AUX_PUD24_state AUX_PUD25_state AUX_DIG20_state AUX_DIG21_state AUX_DIG22_state fuellev_low_tmr AUX_DIG23_state AUX_DIG24_state AUX_DIG25_state mfi_ena mfi_func_allowed AUX_stop_occurred idle_SD_sw idle_SD_state KOR_state imu_accel_x_raw imu_accel_y_raw imu_accel_z_raw imu_accel_x imu_accel_y imu_accel_z imu_gyro_x_raw imu_gyro_y_raw imu_gyro_z_raw imu_gyro_x imu_gyro_y imu_gyro_z imu_temp ECL_inhibit_start Valternator FTT_state FTT_expected_max FTT_expected_tank FTT_tolerance FTT_min_vapor FTT_vapor_Ierr FTT_vapor_Ierr_lim FTT_max_tank FTPM_imp_actv FTPM_imp_inst FTPM_imp_tmr FTPM_imp_lp FTPM_expected_FTP FTPM_min_FTP FTPM_min_FTP_lp FTPM_latch_tmr FTPM_low AUX_start_sw_stat AUX_stop_sw_stat ESD_LED IGN_LED /end REF_MEASUREMENT
/end GROUP
/begin GROUP EC_ConfigEng "ECONTROLS" ROOT /begin REF_CHARACTERISTIC FST_ena FST_def /end REF_CHARACTERISTIC /begin REF_MEASUREMENT FST /end REF_MEASUREMENT /end GROUP
/begin GROUP EC_Fuel "ECONTROLS" ROOT /begin REF_MEASUREMENT FTT FTP /end REF_MEASUREMENT /end GROUP
/begin GROUP EC_LEService "ECONTROLS" ROOT /begin REF_MEASUREMENT ESD_LED IGN_LED /end REF_MEASUREMENT /end GROUP
/begin GROUP EC_SparkCD "ECONTROLS" ROOT /begin REF_MEASUREMENT ESD_LED IGN_LED /end REF_MEASUREMENT /end GROUP
/end MODULE
/end PROJECT
