/******************************************************************************
* ASAP2 file: 4G_A2L_ECIPP.cfg
* This configuration file is used by embed_utils/proc_a2l_files to create
* an A2L file for a MOT/EMOT during remote_compile or generate_code.
* EControls, Inc.
* Copyright (c) 2000-2022.
* All rights reserved. This is an unpublished work.
* $Revision: 82130 $:
* $Date: 2022-11-21 15:54:07 -0600 (Mon, 21 Nov 2022) $:
* ACKNOWLEDGEMENTS: This A2L is based on examples provide by ETAS and is based
* on examples with credits to the following:
* Vector Informatik, Zaiser
* Hewlett Packard, Krueger
* ETAS, Maier
* SIEMENS Automotive, Stuhler
* ASAP2 Meta Language for CCP CAN Calibration Protocol V2.1
* Assumes ASAP2 V1.2 or later
* AML Version V2.4, 27.4.1999
******************************************************************************/
ASAP2_VERSION 1 61
/begin PROJECT Econtrols_4G "4G Test"
/begin HEADER "4G A2L Configuration" PROJECT_NO EControls4G /* config for version control */ VERSION "$Revision: 82130 $:" /* config for version control */ /end HEADER
/begin MODULE EControls_4G_SH2A "EControls 4G"
/* The following A2ML describes the interface between our ECM and a calibration tool */
/* This A2ML block provides the framework for the actual configuration in the next block */
/begin MOD_COMMON "" DEPOSIT ABSOLUTE BYTE_ORDER MSB_FIRST /end MOD_COMMON
/* IF_DATA is short for InterFace data. The following blocks CONFIGURE the interface */ /* between our ECM and a calibration tool. The A2ML block above provides the */ /* framework for the configuration below. */
/begin IF_DATA ASAP1B_CCP /* Describe the DAQs */ /* 1st DAQ */
 /begin SOURCE "100 ms DAQ" 3 100 /begin QP_BLOB 3 LENGTH 10 CAN_ID_FIXED 0x8cff5200 FIRST_PID 30 RASTER 0 /end QP_BLOB /end SOURCE
 /* 2nd DAQ */
 /begin SOURCE "50 ms DAQ" 3 50 /begin QP_BLOB 2 LENGTH 10 CAN_ID_FIXED 0x8cff5200 FIRST_PID 20 RASTER 1 /end QP_BLOB /end SOURCE
 /* 3rd DAQ */
 /begin SOURCE "10 ms DAQ" /* @config@ DAQ LIST NAME */ 3 10 /* @config@ Period definition : Rate in Scaling Units */
  /begin QP_BLOB 1 LENGTH 10 /* @config@ Length of the DAQ-List; Max ODTs */ CAN_ID_FIXED 0x8cff5200 FIRST_PID 10 RASTER 2 /end QP_BLOB
 /end SOURCE
 /* 4th DAQ */
 /begin SOURCE "1 ms DAQ" 3 /* Period definition : Basic scaling unit = 1ms */ 1 /begin QP_BLOB 0 LENGTH 2 CAN_ID_FIXED 0x8cff5200 FIRST_PID 0 RASTER 3 /end QP_BLOB /end SOURCE
 /* Describe the RASTERS (timing) for the DAQs */
 /begin RASTER "100ms time synchronous event channel" "100_ms" 0 4 /* Time Scale: 4 --> 10 ms */ 10 /* 10 x 10ms = 100ms */ /end RASTER
 /begin RASTER "50ms time synchronous event channel" "50_ms" 1 4 /* Time Scale: 4 --> 10 ms */ 5 /* 5 x 10ms = 50ms */ /end RASTER
 /begin RASTER "10 ms time synchronous event channel" /* @config@ Channel Name */ "10 ms" /* @config@ Display Name */ 2 3 /* Time Scale: 3 --> 1 ms */ 10 /* @config@ 10 x 1ms = 10ms */ /end RASTER
 /begin RASTER "1ms time synchronous event channel" "1_ms" 3 3 /* Time Scale: 3 --> 1 ms */ 1 /* 1 x 1ms = 1ms */ /end RASTER
 /begin TP_BLOB 0x201 /* CCP Version */ 0x202 /* BLOB Version */ 0x8cff50f9 /* CAN-Message ID for Transmitting to ECU */ 0x8CFF5100 /* @config@CAN-Message-ID for Receiving from ECU (ID=0) */ 0x0 /* Logical CCP Address of the station */ 0x1 /* Byte Order = High Byte First */
  /begin CAN_PARAM 0x0FA /* @config@Baud-Rate: 0x0FA=250k 0x1F4=500k 0x3E8=1M */ 0x41 /* BTR0 */ 0x25 /* BTR1 */ /end CAN_PARAM
  BAUDRATE 250000 DAQ_MODE BURST /* ECU is sending a complete DAQ */ /* STORE_SUPPORTED          /* Not Supported by INCA * / */ CONSISTENCY DAQ /* consistency of a complete DAQ list guaranteed */ ADDRESS_EXTENSION DAQ /* ECU supports only one Address extension within a DAQ */ /* Description of the checksum calculation process */
  /begin CHECKSUM_PARAM 0x8003 /* ENUM for checksum calculation procedure M_32_BIT_BY_ADD8 */ 0x4000 /* Maximum block length */ CHECKSUM_CALCULATION ACTIVE_PAGE /end CHECKSUM_PARAM
  /* Configure Working Page (WP) and Reference Page (RP) */
  /begin DEFINED_PAGES 1 /* Logical No. of the memory page (1,2,..) */ "working page" /* Name of the memory page */ 0 /* Address-Extension of the memory page */ 0 /* Address of the working page */ 0 /* Size of the working page */ RAM /* memory page in RAM */ RAM_INIT_BY_ECU /* memory page is initialised by ECU start-up */ /end DEFINED_PAGES
  /* config WP/RP: INSERT Reference Page Block Below to enable WP/RP */
  /begin DEFINED_PAGES 2 /* Logical No. of the memory page (1,2,..) */ "reference page" /* Name of the memory page */ 1 /* Address-Extension of the memory page */ 1 /* Address of the reference page */ 0 /* Size of the reference page */ FLASH /* memory page in RAM */ /end DEFINED_PAGES
  /* It is recommended to declare all non-standard CCP commands supported by the ECU */ OPTIONAL_CMD 0x0C /* ECU supports SET_S_STATUS */ OPTIONAL_CMD 0x0D /* ECU supports GET_S_STATUS */ OPTIONAL_CMD 0x0E /* ECU supports BUILD_CHKSUM */ OPTIONAL_CMD 0x12 /* ECU supports GET_SEED */ OPTIONAL_CMD 0x13 /* ECU supports UNLOCK */ OPTIONAL_CMD 0x08 /* ECU supports START_STOP_ALL */ OPTIONAL_CMD 0x09 /* ECU supports GET_ACTIVE_CAL_PAGE */ OPTIONAL_CMD 0x11 /* ECU supports SELECT_CAL_PAGE */ OPTIONAL_CMD 0x19 /* MOVE */ /end TP_BLOB
 /* Describe the authentication (seed and key) process */
 /begin SEED_KEY "PSIR2_CCP_CAL_OEM.dll" /* Name of the Seed&Key DLL for CAL Priviledge */ "PSIR2_CCP_DAQ_OEM.dll" /* Name of the Seed&Key DLL for DAQ Priviledge */ "" /* Default to no PGM DLL: Name of the Seed&Key DLL for PGM Priviledge */ /end SEED_KEY
/end IF_DATA
/begin MOD_PAR "SH2A-4G" CUSTOMER "Reserved" CUSTOMER_NO "C001" /* config custerom ID? */ ECU "4G" PHONE_NO "210-495-9772" SUPPLIER "EControls" USER "EControls Customer" VERSION "V00001" /* config */ /* ADDR_EPK 0xfff88869         /* config * / */ /* EPK "xxxx-"                 /* config * / */ /* configure memory segments */
 /begin MEMORY_SEGMENT ApplicationCode "EControls Application Code" CODE FLASH INTERN 0x00010000 0x001b0000 /* config @ECU_Address@SECTION=CAppHeader@ */ -1 -1 -1 -1 -1 /end MEMORY_SEGMENT
 /begin MEMORY_SEGMENT DCalibration "ECIPP Calibration Data" DATA FLASH INTERN 0x001c0000 0x0000ab8e /* config @ECU_Address@SECTION=DCalibration@ */ -1 -1 -1 -1 -1 /end MEMORY_SEGMENT
 /begin MEMORY_SEGMENT CStaticCalibration "ECIPP Static Calibration" OFFLINE_DATA FLASH INTERN /* OFF_LINE allows Calibration of CStatic, but breaks download */ /* RESERVED FLASH INTERN    /* RESREVED prohibits Calibration of CStatic, but keeps INCA from trying to download to CStatic * / */ 0x001e0000 0x000120f0 /* config @ECU_Address@SECTION=CStaticCalibration@ */ -1 -1 -1 -1 -1 /end MEMORY_SEGMENT
/end MOD_PAR
/* Define the Record Layouts */
/begin RECORD_LAYOUT ECIPP_ALIGNMENT_UBYTE FNC_VALUES 1 UBYTE COLUMN_DIR DIRECT /end RECORD_LAYOUT
/begin RECORD_LAYOUT ECIPP_ALIGNMENT_UWORD FNC_VALUES 1 UWORD COLUMN_DIR DIRECT /end RECORD_LAYOUT
/begin RECORD_LAYOUT ECIPP_ALIGNMENT_SWORD FNC_VALUES 1 SWORD COLUMN_DIR DIRECT /end RECORD_LAYOUT
/begin RECORD_LAYOUT ECIPP_Lookup_SWORD AXIS_PTS_X 1 SWORD INDEX_INCR DIRECT /end RECORD_LAYOUT
/begin RECORD_LAYOUT ECIPP_ALIGNMENT_ULONG FNC_VALUES 1 ULONG COLUMN_DIR DIRECT /end RECORD_LAYOUT
/begin RECORD_LAYOUT ECIPP_ALIGNMENT_FLOAT32_IEEE FNC_VALUES 1 FLOAT32_IEEE COLUMN_DIR DIRECT /end RECORD_LAYOUT
/* Define generic COMPU_METHODS used in the A2L */ /* NOTE: most of the parameters from ECIPP use unique/specific COMPU_METHODS */
/begin COMPU_METHOD Compu_ECIPP_STRINGS "ECIPP Strings " /* Identifier */ RAT_FUNC "%.0" /* Format */ "ASCII" /* Units */ COEFFS 0 1 0 0 0 1 /end COMPU_METHOD
/* The remainder of this file is created programmatically */ /* By merging A2L files from the Simulink model and ECIPP */ /* and updating ECU Addresses using the MAP File */ /**** Merging: 4G_CCP_ECIPP.a2l ****/ /*******************************************************************
* DO NOT CHANGE THIS FILE - It is auto-generated by ECIPP.xlsm
* This file contains the A2L for ECIPP Parameters
* PROJECT_NO XLS: 661B
* VERSION - Software Revision: 23
*******************************************************************/
/begin MEASUREMENT rpm "Engine Speed" UWORD Compu_rpm 0 0 0 65535 ECU_ADDRESS 0x01000000 /end MEASUREMENT
/begin COMPU_METHOD Compu_rpm " " RAT_FUNC "%.0" "rpm" COEFFS 0 1 0 0 0 1 /end COMPU_METHOD
/begin MEASUREMENT MAPressure "Manifold Pressure" UWORD Compu_MAPressure 0 0 0 255.99609375 ECU_ADDRESS 0x01000008 /end MEASUREMENT
/begin COMPU_METHOD Compu_MAPressure " " RAT_FUNC "%.2" "psia" COEFFS 0 256 0 0 0 1 /end COMPU_METHOD
/begin MEASUREMENT ECT "Coolant Temperature" UWORD Compu_ECT 0 0 -460 563.984375 ECU_ADDRESS 0x01000010 /end MEASUREMENT
/begin COMPU_METHOD Compu_ECT " " RAT_FUNC "%.1" "deg F" COEFFS 0 64 29440 0 0 1 /end COMPU_METHOD
/begin MEASUREMENT MAT "Manifold Temperature" UWORD Compu_MAT 0 0 -460 563.984375 ECU_ADDRESS 0x01000018 /end MEASUREMENT
/begin COMPU_METHOD Compu_MAT " " RAT_FUNC "%.1" "deg F" COEFFS 0 64 29440 0 0 1 /end COMPU_METHOD
/begin MEASUREMENT IAT "Intake Air Temperature" UWORD Compu_IAT 0 0 -460 563.984375 ECU_ADDRESS 0x01000050 /end MEASUREMENT
/begin COMPU_METHOD Compu_IAT " " RAT_FUNC "%.1" "deg F" COEFFS 0 64 29440 0 0 1 /end COMPU_METHOD
/begin MEASUREMENT run_mode "Run Mode{run_mode&0xff=0x00:Stopped}{run_mode&0xff=0x01:Cranking}{run_mode&0xff=0x02:Underspd}{run_mode&0xff=0x03:Running}" UBYTE run_mode_COMPU_VTAB 0 0 0 255 ECU_ADDRESS 0x01000080 BIT_MASK 0xff /end MEASUREMENT
/begin COMPU_METHOD run_mode_COMPU_VTAB "Verbal Table" TAB_VERB "%.0" "list" COMPU_TAB_REF run_mode_COMPU_VTAB_REF /end COMPU_METHOD
/begin COMPU_VTAB run_mode_COMPU_VTAB_REF "Verbal Table" TAB_VERB 4 0x00 "Stopped" 0x01 "Cranking" 0x02 "Underspd" 0x03 "Running" DEFAULT_VALUE "UNKNOWN" /end COMPU_VTAB
/begin MEASUREMENT power_mode "Power Mode{power_mode&0xff=0xfe:Sleep}{power_mode&0xff=0xff:Key-off}{power_mode&0xff=0x00:Standby}{power_mode&0xff=0x01:Active}" UBYTE power_mode_COMPU_VTAB 0 0 0 255 ECU_ADDRESS 0x01000088 BIT_MASK 0xff /end MEASUREMENT
/begin COMPU_METHOD power_mode_COMPU_VTAB "Verbal Table" TAB_VERB "%.0" "list" COMPU_TAB_REF power_mode_COMPU_VTAB_REF /end COMPU_METHOD
/begin COMPU_VTAB power_mode_COMPU_VTAB_REF "Verbal Table" TAB_VERB 4 0xfe "Sleep" 0xff "Key-off" 0x00 "Standby" 0x01 "Active" DEFAULT_VALUE "UNKNOWN" /end COMPU_VTAB
/begin MEASUREMENT fuel_type "Fuel Type{fuel_type&0xff=0x00:Gasoline}{fuel_type&0xff=0x01:Propane}{fuel_type&0xff=0x02:Natural Gas}" UBYTE fuel_type_COMPU_VTAB 0 0 0 255 ECU_ADDRESS 0x01000090 BIT_MASK 0xff /end MEASUREMENT
/begin COMPU_METHOD fuel_type_COMPU_VTAB "Verbal Table" TAB_VERB "%.0" "list" COMPU_TAB_REF fuel_type_COMPU_VTAB_REF /end COMPU_METHOD
/begin COMPU_VTAB fuel_type_COMPU_VTAB_REF "Verbal Table" TAB_VERB 3 0x00 "Gasoline" 0x01 "Propane" 0x02 "Natural Gas" DEFAULT_VALUE "UNKNOWN" /end COMPU_VTAB
/begin MEASUREMENT PW_avg "Pulse width" UWORD Compu_PW_avg 0 0 0 209.712 ECU_ADDRESS 0x010000A8 /end MEASUREMENT
/begin COMPU_METHOD Compu_PW_avg " " RAT_FUNC "%.2" "ms" COEFFS 0 312.5 0 0 0 1 /end COMPU_METHOD
/begin MEASUREMENT FaultSysFlag "MIL{FaultSysFlag&0x01=0x00:OK}{FaultSysFlag&0x01=0x01:FAULT}" UBYTE FaultSysFlag_COMPU_VTAB 0 0 0 255 ECU_ADDRESS 0x01000148 BIT_MASK 0x01 /end MEASUREMENT
/begin COMPU_METHOD FaultSysFlag_COMPU_VTAB "Verbal Table" TAB_VERB "%.0" "list" COMPU_TAB_REF FaultSysFlag_COMPU_VTAB_REF /end COMPU_METHOD
/begin COMPU_VTAB FaultSysFlag_COMPU_VTAB_REF "Verbal Table" TAB_VERB 2 0x00 "OK" 0x01 "FAULT" DEFAULT_VALUE "UNKNOWN" /end COMPU_VTAB
/begin MEASUREMENT BP "BP" UWORD Compu_BP 0 0 0 255.99609375 ECU_ADDRESS 0x01000158 /end MEASUREMENT
/begin COMPU_METHOD Compu_BP " " RAT_FUNC "%.2" "psia" COEFFS 0 256 0 0 0 1 /end COMPU_METHOD
/begin MEASUREMENT Vbat "Vbat" UWORD Compu_Vbat 0 0 0 255.99609375 ECU_ADDRESS 0x01000160 /end MEASUREMENT
/begin COMPU_METHOD Compu_Vbat " " RAT_FUNC "%.1" "volts" COEFFS 0 256 0 0 0 1 /end COMPU_METHOD
/begin MEASUREMENT Vsw "Vsw" UWORD Compu_Vsw 0 0 0 255.99609375 ECU_ADDRESS 0x01000168 /end MEASUREMENT
/begin COMPU_METHOD Compu_Vsw " " RAT_FUNC "%.1" "volts" COEFFS 0 256 0 0 0 1 /end COMPU_METHOD
/begin MEASUREMENT FPP_pct "FPP_pct" UWORD Compu_FPP_pct 0 0 0 99.9984741210938 ECU_ADDRESS 0x010001A8 /end MEASUREMENT
/begin COMPU_METHOD Compu_FPP_pct " " RAT_FUNC "%.1" "%" COEFFS 0 655.36 0 0 0 1 /end COMPU_METHOD
/begin MEASUREMENT TPS_pct "TPS_pct" UWORD Compu_TPS_pct 0 0 0 99.9984741210938 ECU_ADDRESS 0x010001B8 /end MEASUREMENT
/begin COMPU_METHOD Compu_TPS_pct " " RAT_FUNC "%.1" "%" COEFFS 0 655.36 0 0 0 1 /end COMPU_METHOD
/begin MEASUREMENT EBP "Exhaust back pressure" UWORD Compu_EBP 0 0 0 255.99609375 ECU_ADDRESS 0x010001D8 /end MEASUREMENT
/begin COMPU_METHOD Compu_EBP " " RAT_FUNC "%.2" "psi" COEFFS 0 256 0 0 0 1 /end COMPU_METHOD
/begin MEASUREMENT EGT "EGT" UWORD Compu_EGT 0 0 -460 7731.875 ECU_ADDRESS 0x010001E0 /end MEASUREMENT
/begin COMPU_METHOD Compu_EGT " " RAT_FUNC "%.1" "deg F" COEFFS 0 8 3680 0 0 1 /end COMPU_METHOD
/begin MEASUREMENT fuel_ctl_mode "Fuel Control Mode{fuel_ctl_mode&0xff=0x00:Open Loop}{fuel_ctl_mode&0xff=0x01:CL Inactive}{fuel_ctl_mode&0xff=0x03:CL Active}{fuel_ctl_mode&0xff=0x07:CL + Adapt}" UBYTE fuel_ctl_mode_COMPU_VTAB 0 0 0 255 ECU_ADDRESS 0x010001F0 BIT_MASK 0xff /end MEASUREMENT
/begin COMPU_METHOD fuel_ctl_mode_COMPU_VTAB "Verbal Table" TAB_VERB "%.0" "list" COMPU_TAB_REF fuel_ctl_mode_COMPU_VTAB_REF /end COMPU_METHOD
/begin COMPU_VTAB fuel_ctl_mode_COMPU_VTAB_REF "Verbal Table" TAB_VERB 4 0x00 "Open Loop" 0x01 "CL Inactive" 0x03 "CL Active" 0x07 "CL + Adapt" DEFAULT_VALUE "UNKNOWN" /end COMPU_VTAB
/begin MEASUREMENT min_gov_rpm "Min governor target speed" UWORD Compu_min_gov_rpm 0 0 0 65535 ECU_ADDRESS 0x01000288 /end MEASUREMENT
/begin COMPU_METHOD Compu_min_gov_rpm " " RAT_FUNC "%.0" "rpm" COEFFS 0 1 0 0 0 1 /end COMPU_METHOD
/begin MEASUREMENT gov_eng_load_d "Governor desired load" UWORD Compu_gov_eng_load_d 0 0 0 99.9984741210938 ECU_ADDRESS 0x010002B8 /end MEASUREMENT
/begin COMPU_METHOD Compu_gov_eng_load_d " " RAT_FUNC "%.1" "%" COEFFS 0 655.36 0 0 0 1 /end COMPU_METHOD
/begin MEASUREMENT CHT "Cylinder Head Temp" UWORD Compu_CHT 0 0 -460 563.984375 ECU_ADDRESS 0x01000318 /end MEASUREMENT
/begin COMPU_METHOD Compu_CHT " " RAT_FUNC "%.1" "deg F" COEFFS 0 64 29440 0 0 1 /end COMPU_METHOD
/begin MEASUREMENT rMAP "Real MAP" UWORD Compu_rMAP 0 0 0 255.99609375 ECU_ADDRESS 0x010003A0 /end MEASUREMENT
/begin COMPU_METHOD Compu_rMAP " " RAT_FUNC "%.2" "-" COEFFS 0 256 0 0 0 1 /end COMPU_METHOD
/begin MEASUREMENT rECT "Real ECT" UWORD Compu_rECT 0 0 -460 563.984375 ECU_ADDRESS 0x010003B0 /end MEASUREMENT
/begin COMPU_METHOD Compu_rECT " " RAT_FUNC "%.1" "-" COEFFS 0 64 29440 0 0 1 /end COMPU_METHOD
/begin MEASUREMENT rIAT "Real IAT" UWORD Compu_rIAT 0 0 -460 563.984375 ECU_ADDRESS 0x010003B8 /end MEASUREMENT
/begin COMPU_METHOD Compu_rIAT " " RAT_FUNC "%.1" "-" COEFFS 0 64 29440 0 0 1 /end COMPU_METHOD
/begin MEASUREMENT OILP_press "Oil pressure" UWORD Compu_OILP_press 0 0 0 255.99609375 ECU_ADDRESS 0x01000418 /end MEASUREMENT
/begin COMPU_METHOD Compu_OILP_press " " RAT_FUNC "%.1" "psig" COEFFS 0 256 0 0 0 1 /end COMPU_METHOD
/begin MEASUREMENT TIP "Throttle Inlet Pressure" UWORD Compu_TIP 0 0 0 255.99609375 ECU_ADDRESS 0x01000428 /end MEASUREMENT
/begin COMPU_METHOD Compu_TIP " " RAT_FUNC "%.2" "psia" COEFFS 0 256 0 0 0 1 /end COMPU_METHOD
/begin MEASUREMENT WGP_dot "WGP derivative (dWGP/dt)" SWORD Compu_WGP_dot 0 0 -512 511.984375 ECU_ADDRESS 0x01000468 /end MEASUREMENT
/begin COMPU_METHOD Compu_WGP_dot " " RAT_FUNC "%.1" "psi/sec" COEFFS 0 64 0 0 0 1 /end COMPU_METHOD
/begin MEASUREMENT TIP_dot "TIP derivative (dTIP/dt)" SWORD Compu_TIP_dot 0 0 -256 255.9921875 ECU_ADDRESS 0x01000470 /end MEASUREMENT
/begin COMPU_METHOD Compu_TIP_dot " " RAT_FUNC "%.2" "psi/sec" COEFFS 0 128 0 0 0 1 /end COMPU_METHOD
/begin MEASUREMENT TIP_dot_dz "TIP derivative dz limited" SWORD Compu_TIP_dot_dz 0 0 -256 255.9921875 ECU_ADDRESS 0x01000478 /end MEASUREMENT
/begin COMPU_METHOD Compu_TIP_dot_dz " " RAT_FUNC "%.2" "psi/sec" COEFFS 0 128 0 0 0 1 /end COMPU_METHOD
/begin MEASUREMENT bst_WGPd_dot "WGP derivative target" SWORD Compu_bst_WGPd_dot 0 0 -512 511.984375 ECU_ADDRESS 0x01000480 /end MEASUREMENT
/begin COMPU_METHOD Compu_bst_WGPd_dot " " RAT_FUNC "%.1" "psi/sec" COEFFS 0 64 0 0 0 1 /end COMPU_METHOD
/begin CHARACTERISTIC max_gov_rpm "Max governor target speed" VALUE 0x001C9DBA /* @ECU_Address@max_gov_rpm@0x01000A88@ */ ECIPP_ALIGNMENT_UWORD 65535 Compu_max_gov_rpm 0 65535 /end CHARACTERISTIC
/begin COMPU_METHOD Compu_max_gov_rpm " " RAT_FUNC "%.0" "rpm" COEFFS 0 1 0 0 0 1 /end COMPU_METHOD
/begin MEASUREMENT gov_sw_state "Governor switch state{gov_sw_state&0xff=0x00:None}{gov_sw_state&0xff=0x01:Gov1}{gov_sw_state&0xff=0x02:Gov2}{gov_sw_state&0xff=0x03:Gov3}" UBYTE gov_sw_state_COMPU_VTAB 0 0 0 255 ECU_ADDRESS 0x01000E68 BIT_MASK 0xff /end MEASUREMENT
/begin COMPU_METHOD gov_sw_state_COMPU_VTAB "Verbal Table" TAB_VERB "%.0" "list" COMPU_TAB_REF gov_sw_state_COMPU_VTAB_REF /end COMPU_METHOD
/begin COMPU_VTAB gov_sw_state_COMPU_VTAB_REF "Verbal Table" TAB_VERB 4 0x00 "None" 0x01 "Gov1" 0x02 "Gov2" 0x03 "Gov3" DEFAULT_VALUE "UNKNOWN" /end COMPU_VTAB
/begin MEASUREMENT gov_type "Active governor type{gov_type&0xff=0x00:None}{gov_type&0xff=0x01:Gov1}{gov_type&0xff=0x02:Gov2}{gov_type&0xff=0x03:Gov3}{gov_type&0xff=0x04:Min}{gov_type&0xff=0x05:Max}" UBYTE gov_type_COMPU_VTAB 0 0 0 255 ECU_ADDRESS 0x01000E70 BIT_MASK 0xff /end MEASUREMENT
/begin COMPU_METHOD gov_type_COMPU_VTAB "Verbal Table" TAB_VERB "%.0" "list" COMPU_TAB_REF gov_type_COMPU_VTAB_REF /end COMPU_METHOD
/begin COMPU_VTAB gov_type_COMPU_VTAB_REF "Verbal Table" TAB_VERB 6 0x00 "None" 0x01 "Gov1" 0x02 "Gov2" 0x03 "Gov3" 0x04 "Min" 0x05 "Max" DEFAULT_VALUE "UNKNOWN" /end COMPU_VTAB
/begin MEASUREMENT gov_mode "Active governor mode{gov_mode&0xff=0x00:Disabled}{gov_mode&0xff=0x01:Isochronous}{gov_mode&0xff=0x02:Droop}" UBYTE gov_mode_COMPU_VTAB 0 0 0 255 ECU_ADDRESS 0x01000E78 BIT_MASK 0xff /end MEASUREMENT
/begin COMPU_METHOD gov_mode_COMPU_VTAB "Verbal Table" TAB_VERB "%.0" "list" COMPU_TAB_REF gov_mode_COMPU_VTAB_REF /end COMPU_METHOD
/begin COMPU_VTAB gov_mode_COMPU_VTAB_REF "Verbal Table" TAB_VERB 3 0x00 "Disabled" 0x01 "Isochronous" 0x02 "Droop" DEFAULT_VALUE "UNKNOWN" /end COMPU_VTAB
/begin MEASUREMENT rpmd_gain "rpm gain selector" UWORD Compu_rpmd_gain 0 0 0 65535 ECU_ADDRESS 0x01000EE8 /end MEASUREMENT
/begin COMPU_METHOD Compu_rpmd_gain " " RAT_FUNC "%.0" "rpm" COEFFS 0 1 0 0 0 1 /end COMPU_METHOD
/begin MEASUREMENT OILP_state "Oil pressure state{OILP_state&0xff=0x00:OK}{OILP_state&0xff=0x01:Low - Ignored}{OILP_state&0xff=0x02:Low}" UBYTE OILP_state_COMPU_VTAB 0 0 0 255 ECU_ADDRESS 0x01000F80 BIT_MASK 0xff /end MEASUREMENT
/begin COMPU_METHOD OILP_state_COMPU_VTAB "Verbal Table" TAB_VERB "%.0" "list" COMPU_TAB_REF OILP_state_COMPU_VTAB_REF /end COMPU_METHOD
/begin COMPU_VTAB OILP_state_COMPU_VTAB_REF "Verbal Table" TAB_VERB 3 0x00 "OK" 0x01 "Low - Ignored" 0x02 "Low" DEFAULT_VALUE "UNKNOWN" /end COMPU_VTAB
/begin MEASUREMENT HM_RAM_seconds "Hour meter" ULONG Compu_HM_RAM_seconds 0 0 0 1193046.47083333 ECU_ADDRESS 0x01001308 /end MEASUREMENT
/begin COMPU_METHOD Compu_HM_RAM_seconds " " RAT_FUNC "%.3" "hours" COEFFS 0 3600 0 0 0 1 /end COMPU_METHOD
/begin MEASUREMENT HM_RAM_starts "Cumulative starts" ULONG Compu_HM_RAM_starts 0 0 0 4294967295 ECU_ADDRESS 0x01001318 /end MEASUREMENT
/begin COMPU_METHOD Compu_HM_RAM_starts " " RAT_FUNC "%.0" "starts" COEFFS 0 1 0 0 0 1 /end COMPU_METHOD
/begin CHARACTERISTIC MAP_fl_scaling "TIP based full-load rescaling{MAP_fl_scaling&0xff=0x00:Disabled}{MAP_fl_scaling&0xff=0x01:Enabled}" VALUE 0x001c8816 /* @ECU_Address@MAP_fl_scaling@0x01002178@ */ ECIPP_ALIGNMENT_UBYTE 255 MAP_fl_scaling_COMPU_VTAB 0 255 BIT_MASK 0xff /end CHARACTERISTIC
/begin COMPU_METHOD MAP_fl_scaling_COMPU_VTAB "Verbal Table" TAB_VERB "%.0" "list" COMPU_TAB_REF MAP_fl_scaling_COMPU_VTAB_REF /end COMPU_METHOD
/begin COMPU_VTAB MAP_fl_scaling_COMPU_VTAB_REF "Verbal Table" TAB_VERB 2 0x00 "Disabled" 0x01 "Enabled" DEFAULT_VALUE "UNKNOWN" /end COMPU_VTAB
/begin CHARACTERISTIC DATE_gov_desc "Governor cal date" VALUE 0x001e1d58 /* @ECU_Address@DATE_gov_desc@0x01002208@ */ ECIPP_ALIGNMENT_ULONG 4294967295 Compu_DATE_gov_desc 0 4294967295 /end CHARACTERISTIC
/begin COMPU_METHOD Compu_DATE_gov_desc " " RAT_FUNC "%.0" "date" COEFFS 0 1 0 0 0 1 /end COMPU_METHOD
/begin CHARACTERISTIC bst_mode "Boost control mode{bst_mode&0xff=0:Disabled}{bst_mode&0xff=1:TIP absolute}{bst_mode&0xff=2:delta-P}" VALUE 0x001c8fb6 /* @ECU_Address@bst_mode@0x010024A0@ */ ECIPP_ALIGNMENT_UBYTE 255 bst_mode_COMPU_VTAB 0 255 BIT_MASK 0xff /end CHARACTERISTIC
/begin COMPU_METHOD bst_mode_COMPU_VTAB "Verbal Table" TAB_VERB "%.0" "list" COMPU_TAB_REF bst_mode_COMPU_VTAB_REF /end COMPU_METHOD
/begin COMPU_VTAB bst_mode_COMPU_VTAB_REF "Verbal Table" TAB_VERB 3 0 "Disabled" 1 "TIP absolute" 2 "delta-P" DEFAULT_VALUE "UNKNOWN" /end COMPU_VTAB
/begin CHARACTERISTIC bst_WGPneut "WGP neutral actuator pressure" VALUE 0x001c83b0 /* @ECU_Address@bst_WGPneut@0x010024A8@ */ ECIPP_ALIGNMENT_UWORD 256 Compu_bst_WGPneut 0 255.99609375 /end CHARACTERISTIC
/begin COMPU_METHOD Compu_bst_WGPneut " " RAT_FUNC "%.2" "psig" COEFFS 0 256 0 0 0 1 /end COMPU_METHOD
/begin CHARACTERISTIC bst_Kp_TIP "TIP feedback Kp" VALUE 0x001c6c42 /* @ECU_Address@bst_Kp_TIP@0x010024B0@ */ ECIPP_ALIGNMENT_SWORD 128 Compu_bst_Kp_TIP -128 127.99609375 /end CHARACTERISTIC
/begin COMPU_METHOD Compu_bst_Kp_TIP " " RAT_FUNC "%.1" "WGP/TIP" COEFFS 0 256 0 0 0 1 /end COMPU_METHOD
/begin CHARACTERISTIC bst_Ki_TIP "TIP feedback Ki" VALUE 0x001c6c34 /* @ECU_Address@bst_Ki_TIP@0x010024B8@ */ ECIPP_ALIGNMENT_SWORD 128 Compu_bst_Ki_TIP -128 127.99609375 /end CHARACTERISTIC
/begin COMPU_METHOD Compu_bst_Ki_TIP " " RAT_FUNC "%.1" "WGP/TIP/s" COEFFS 0 256 0 0 0 1 /end COMPU_METHOD
/begin CHARACTERISTIC bst_Kp_WGP "WGP feedback Kp" VALUE 0x001c6c46 /* @ECU_Address@bst_Kp_WGP@0x010024C0@ */ ECIPP_ALIGNMENT_SWORD 800 Compu_bst_Kp_WGP -800 799.9755859375 /end CHARACTERISTIC
/begin COMPU_METHOD Compu_bst_Kp_WGP " " RAT_FUNC "%.1" "%/WGP" COEFFS 0 40.96 0 0 0 1 /end COMPU_METHOD
/begin CHARACTERISTIC bst_Ki_WGP "WGP feedback Ki" VALUE 0x001c6c38 /* @ECU_Address@bst_Ki_WGP@0x010024C8@ */ ECIPP_ALIGNMENT_SWORD 400 Compu_bst_Ki_WGP -400 399.98779296875 /end CHARACTERISTIC
/begin COMPU_METHOD Compu_bst_Ki_WGP " " RAT_FUNC "%.1" "%/WGP/s" COEFFS 0 81.92 0 0 0 1 /end COMPU_METHOD
/begin CHARACTERISTIC bst_WGAVmin "WG actuator min voltage" VALUE 0x001c83aa /* @ECU_Address@bst_WGAVmin@0x010024D0@ */ ECIPP_ALIGNMENT_UWORD 256 Compu_bst_WGAVmin 0 255.99609375 /end CHARACTERISTIC
/begin COMPU_METHOD Compu_bst_WGAVmin " " RAT_FUNC "%.2" "volts" COEFFS 0 256 0 0 0 1 /end COMPU_METHOD
/begin CHARACTERISTIC bst_WGAVmax "WG actuator max voltage" VALUE 0x001c83a8 /* @ECU_Address@bst_WGAVmax@0x010024D8@ */ ECIPP_ALIGNMENT_UWORD 256 Compu_bst_WGAVmax 0 255.99609375 /end CHARACTERISTIC
/begin COMPU_METHOD Compu_bst_WGAVmax " " RAT_FUNC "%.2" "volts" COEFFS 0 256 0 0 0 1 /end COMPU_METHOD
/begin MEASUREMENT bst_loadcmd "Boost target load command" UWORD Compu_bst_loadcmd 0 0 0 99.9984741210938 ECU_ADDRESS 0x010024E0 /end MEASUREMENT
/begin COMPU_METHOD Compu_bst_loadcmd " " RAT_FUNC "%.1" "%" COEFFS 0 655.36 0 0 0 1 /end COMPU_METHOD
/begin MEASUREMENT bst_IAT_crct "Boost target IAT correction" UWORD Compu_bst_IAT_crct 0 0 0 3.99993896484375 ECU_ADDRESS 0x010024E8 /end MEASUREMENT
/begin COMPU_METHOD Compu_bst_IAT_crct " " RAT_FUNC "%.3" "multiplier" COEFFS 0 16384 0 0 0 1 /end COMPU_METHOD
/begin MEASUREMENT bst_MAT_derate "Boost target MAT derate" UWORD Compu_bst_MAT_derate 0 0 0 3.99993896484375 ECU_ADDRESS 0x010024F0 /end MEASUREMENT
/begin COMPU_METHOD Compu_bst_MAT_derate " " RAT_FUNC "%.3" "multiplier" COEFFS 0 16384 0 0 0 1 /end COMPU_METHOD
/begin MEASUREMENT bst_Temp_mult "Total boost target correction/derate" UWORD Compu_bst_Temp_mult 0 0 0 3.99993896484375 ECU_ADDRESS 0x010024F8 /end MEASUREMENT
/begin COMPU_METHOD Compu_bst_Temp_mult " " RAT_FUNC "%.3" "multiplier" COEFFS 0 16384 0 0 0 1 /end COMPU_METHOD
/begin MEASUREMENT bst_BP_lim "Boost target BP limit" UWORD Compu_bst_BP_lim 0 0 0 255.99609375 ECU_ADDRESS 0x01002500 /end MEASUREMENT
/begin COMPU_METHOD Compu_bst_BP_lim " " RAT_FUNC "%.2" "psia" COEFFS 0 256 0 0 0 1 /end COMPU_METHOD
/begin MEASUREMENT bst_TPSd "Delta-P boost control TPS command" UWORD Compu_bst_TPSd 0 0 0 99.9984741210938 ECU_ADDRESS 0x01002508 /end MEASUREMENT
/begin COMPU_METHOD Compu_bst_TPSd " " RAT_FUNC "%.1" "%" COEFFS 0 655.36 0 0 0 1 /end COMPU_METHOD
/begin MEASUREMENT bst_dPd "Delta-P boost control TIP-MAP target" UWORD Compu_bst_dPd 0 0 0 255.99609375 ECU_ADDRESS 0x01002510 /end MEASUREMENT
/begin COMPU_METHOD Compu_bst_dPd " " RAT_FUNC "%.2" "psi" COEFFS 0 256 0 0 0 1 /end COMPU_METHOD
/begin MEASUREMENT bst_MAPd "Delta-P boost control MAP target" UWORD Compu_bst_MAPd 0 0 0 255.99609375 ECU_ADDRESS 0x01002518 /end MEASUREMENT
/begin COMPU_METHOD Compu_bst_MAPd " " RAT_FUNC "%.2" "psia" COEFFS 0 256 0 0 0 1 /end COMPU_METHOD
/begin MEASUREMENT bst_TIPd "Boost control TIP target" UWORD Compu_bst_TIPd 0 0 0 255.99609375 ECU_ADDRESS 0x01002520 /end MEASUREMENT
/begin COMPU_METHOD Compu_bst_TIPd " " RAT_FUNC "%.2" "psia" COEFFS 0 256 0 0 0 1 /end COMPU_METHOD
/begin MEASUREMENT bst_Iacc_TIP "TIP control loop integrator" SWORD Compu_bst_Iacc_TIP 0 0 -256 255.9921875 ECU_ADDRESS 0x01002528 /end MEASUREMENT
/begin COMPU_METHOD Compu_bst_Iacc_TIP " " RAT_FUNC "%.2" "WGP_psi" COEFFS 0 128 0 0 0 1 /end COMPU_METHOD
/begin MEASUREMENT bst_WGPd "WGP feedback target (final)" UWORD Compu_bst_WGPd 0 0 0 255.99609375 ECU_ADDRESS 0x01002530 /end MEASUREMENT
/begin COMPU_METHOD Compu_bst_WGPd " " RAT_FUNC "%.2" "psig" COEFFS 0 256 0 0 0 1 /end COMPU_METHOD
/begin MEASUREMENT bst_Iacc_WGP "WGP feedback integrator" SWORD Compu_bst_Iacc_WGP 0 0 -800 799.9755859375 ECU_ADDRESS 0x01002538 /end MEASUREMENT
/begin COMPU_METHOD Compu_bst_Iacc_WGP " " RAT_FUNC "%.1" "WGA_%" COEFFS 0 40.96 0 0 0 1 /end COMPU_METHOD
/begin MEASUREMENT bst_WGAcmd "WGP control loop percent command" UWORD Compu_bst_WGAcmd 0 0 0 99.9984741210938 ECU_ADDRESS 0x01002540 /end MEASUREMENT
/begin COMPU_METHOD Compu_bst_WGAcmd " " RAT_FUNC "%.1" "%" COEFFS 0 655.36 0 0 0 1 /end COMPU_METHOD
/begin MEASUREMENT bst_WGAcmd_V "WGP control loop voltage command" UWORD Compu_bst_WGAcmd_V 0 0 0 255.99609375 ECU_ADDRESS 0x01002548 /end MEASUREMENT
/begin COMPU_METHOD Compu_bst_WGAcmd_V " " RAT_FUNC "%.2" "volts" COEFFS 0 256 0 0 0 1 /end COMPU_METHOD
/begin MEASUREMENT bst_WGAcmd_DC "WGP control loop PWM duty-cycle command" UWORD Compu_bst_WGAcmd_DC 0 0 0 99.9984741210938 ECU_ADDRESS 0x01002550 /end MEASUREMENT
/begin COMPU_METHOD Compu_bst_WGAcmd_DC " " RAT_FUNC "%.1" "%" COEFFS 0 655.36 0 0 0 1 /end COMPU_METHOD
/begin CHARACTERISTIC bst_Kd_WGP "WGP feedback Kd" VALUE 0x001c6c32 /* @ECU_Address@bst_Kd_WGP@0x01002560@ */ ECIPP_ALIGNMENT_SWORD 200 Compu_bst_Kd_WGP -200 199.993896484375 /end CHARACTERISTIC
/begin COMPU_METHOD Compu_bst_Kd_WGP " " RAT_FUNC "%.2" "%/(psi/sec)" COEFFS 0 163.84 0 0 0 1 /end COMPU_METHOD
/begin CHARACTERISTIC bst_Kiv_WGP "WGP feedback Kiv" VALUE 0x001c6c3c /* @ECU_Address@bst_Kiv_WGP@0x01002568@ */ ECIPP_ALIGNMENT_SWORD 50 Compu_bst_Kiv_WGP -50 49.9984741210938 /end CHARACTERISTIC
/begin COMPU_METHOD Compu_bst_Kiv_WGP " " RAT_FUNC "%.2" "%/psi/sec" COEFFS 0 655.36 0 0 0 1 /end COMPU_METHOD
/begin CHARACTERISTIC WGP_dot_window "WGP derivative window" VALUE 0x001c8388 /* @ECU_Address@WGP_dot_window@0x01002570@ */ ECIPP_ALIGNMENT_UWORD 65535 Compu_WGP_dot_window 0 65535 /end CHARACTERISTIC
/begin COMPU_METHOD Compu_WGP_dot_window " " RAT_FUNC "%.0" "ms" COEFFS 0 1 0 0 0 1 /end COMPU_METHOD
/begin CHARACTERISTIC WGP_dot_tau "WGP derivative low-pass tau" VALUE 0x001c8648 /* @ECU_Address@WGP_dot_tau@0x01002578@ */ ECIPP_ALIGNMENT_UWORD 163840 Compu_WGP_dot_tau 0.16703 163840 /end CHARACTERISTIC
/begin COMPU_METHOD Compu_WGP_dot_tau " " FORM "%.1" "ms"
 /begin FORMULA "-5 / log(1.0000000000001 - (X1 / 32768))" FORMULA_INV "(1.0000000000001 - exp(-5/X1)) * 32768" /end FORMULA
/end COMPU_METHOD
/begin MEASUREMENT bst_WGP_test "WGP control test mode{bst_WGP_test&0xff=0:Disabled}{bst_WGP_test&0xff=1:Enabled}" UBYTE bst_WGP_test_COMPU_VTAB 0 0 0 255 ECU_ADDRESS 0x01002580 BIT_MASK 0xff /end MEASUREMENT
/begin COMPU_METHOD bst_WGP_test_COMPU_VTAB "Verbal Table" TAB_VERB "%.0" "list" COMPU_TAB_REF bst_WGP_test_COMPU_VTAB_REF /end COMPU_METHOD
/begin COMPU_VTAB bst_WGP_test_COMPU_VTAB_REF "Verbal Table" TAB_VERB 2 0 "Disabled" 1 "Enabled" DEFAULT_VALUE "UNKNOWN" /end COMPU_VTAB
/begin CHARACTERISTIC bst_IATnom "Boost temperature compensation nominal IAT" VALUE 0x001c83a4 /* @ECU_Address@bst_IATnom@0x01002588@ */ ECIPP_ALIGNMENT_UWORD 564 Compu_bst_IATnom -460 563.984375 /end CHARACTERISTIC
/begin COMPU_METHOD Compu_bst_IATnom " " RAT_FUNC "%.1" "deg F" COEFFS 0 64 29440 0 0 1 /end COMPU_METHOD
/begin CHARACTERISTIC bst_Kd_TIP "TIP feedback Kd" VALUE 0x001c6c2e /* @ECU_Address@bst_Kd_TIP@0x01002590@ */ ECIPP_ALIGNMENT_SWORD 64 Compu_bst_Kd_TIP -64 63.998046875 /end CHARACTERISTIC
/begin COMPU_METHOD Compu_bst_Kd_TIP " " RAT_FUNC "%.2" "WGP_psi/(TIP_psi/sec)" COEFFS 0 512 0 0 0 1 /end COMPU_METHOD
/begin CHARACTERISTIC bst_Kiv_TIP "TIP feedback Kiv" VALUE 0x001c6c3a /* @ECU_Address@bst_Kiv_TIP@0x01002598@ */ ECIPP_ALIGNMENT_SWORD 32 Compu_bst_Kiv_TIP -32 31.9990234375 /end CHARACTERISTIC
/begin COMPU_METHOD Compu_bst_Kiv_TIP " " RAT_FUNC "%.2" "WGP_psi/TIP_psi/sec" COEFFS 0 1024 0 0 0 1 /end COMPU_METHOD
/begin CHARACTERISTIC TIP_dot_window "TIP derivative window" VALUE 0x001c80f8 /* @ECU_Address@TIP_dot_window@0x010025A0@ */ ECIPP_ALIGNMENT_UWORD 65535 Compu_TIP_dot_window 0 65535 /end CHARACTERISTIC
/begin COMPU_METHOD Compu_TIP_dot_window " " RAT_FUNC "%.0" "ms" COEFFS 0 1 0 0 0 1 /end COMPU_METHOD
/begin CHARACTERISTIC TIP_dot_tau "TIP derivative low-pass tau" VALUE 0x001c8604 /* @ECU_Address@TIP_dot_tau@0x010025A8@ */ ECIPP_ALIGNMENT_UWORD 163840 Compu_TIP_dot_tau 0.16703 163840 /end CHARACTERISTIC
/begin COMPU_METHOD Compu_TIP_dot_tau " " FORM "%.1" "ms"
 /begin FORMULA "-5 / log(1.0000000000001 - (X1 / 32768))" FORMULA_INV "(1.0000000000001 - exp(-5/X1)) * 32768" /end FORMULA
/end COMPU_METHOD
/begin CHARACTERISTIC TIP_dot_dzlim "TIP derivative cubic dz limit" VALUE 0x001c51fa /* @ECU_Address@TIP_dot_dzlim@0x010025B0@ */ ECIPP_ALIGNMENT_SWORD 256 Compu_TIP_dot_dzlim -256 255.9921875 /end CHARACTERISTIC
/begin COMPU_METHOD Compu_TIP_dot_dzlim " " RAT_FUNC "%.2" "psi/sec" COEFFS 0 128 0 0 0 1 /end COMPU_METHOD
/begin CHARACTERISTIC bst_WGPsource "Boost WG pressure source{bst_WGPsource&0xff=0:TIP}{bst_WGPsource&0xff=1:Constant Supply}" VALUE 0x001c8fb0 /* @ECU_Address@bst_WGPsource@0x010025F8@ */ ECIPP_ALIGNMENT_UBYTE 255 bst_WGPsource_COMPU_VTAB 0 255 BIT_MASK 0xff /end CHARACTERISTIC
/begin COMPU_METHOD bst_WGPsource_COMPU_VTAB "Verbal Table" TAB_VERB "%.0" "list" COMPU_TAB_REF bst_WGPsource_COMPU_VTAB_REF /end COMPU_METHOD
/begin COMPU_VTAB bst_WGPsource_COMPU_VTAB_REF "Verbal Table" TAB_VERB 2 0 "TIP" 1 "Constant Supply" DEFAULT_VALUE "UNKNOWN" /end COMPU_VTAB
/begin CHARACTERISTIC bst_WGPsource_Pc "Boost WGP constant supply" VALUE 0x001c83b2 /* @ECU_Address@bst_WGPsource_Pc@0x01002600@ */ ECIPP_ALIGNMENT_UWORD 256 Compu_bst_WGPsource_Pc 0 255.99609375 /end CHARACTERISTIC
/begin COMPU_METHOD Compu_bst_WGPsource_Pc " " RAT_FUNC "%.2" "psig" COEFFS 0 256 0 0 0 1 /end COMPU_METHOD
/begin CHARACTERISTIC bst_WGPd_tau "WGP target output low-pass" VALUE 0x001c8656 /* @ECU_Address@bst_WGPd_tau@0x01002608@ */ ECIPP_ALIGNMENT_UWORD 327680 Compu_bst_WGPd_tau 0.45084 327680 /end CHARACTERISTIC
/begin COMPU_METHOD Compu_bst_WGPd_tau " " FORM "%.1" "ms"
 /begin FORMULA "-5 / log(1 - (X1 / 65536))" FORMULA_INV "(1 - exp(-5/X1)) * 65536" /end FORMULA
/end COMPU_METHOD
/begin CHARACTERISTIC bst_WGAcmd_tau "WG actuator command low-pass" VALUE 0x001c8654 /* @ECU_Address@bst_WGAcmd_tau@0x01002610@ */ ECIPP_ALIGNMENT_UWORD 327680 Compu_bst_WGAcmd_tau 0.45084 327680 /end CHARACTERISTIC
/begin COMPU_METHOD Compu_bst_WGAcmd_tau " " FORM "%.1" "ms"
 /begin FORMULA "-5 / log(1 - (X1 / 65536))" FORMULA_INV "(1 - exp(-5/X1)) * 65536" /end FORMULA
/end COMPU_METHOD
/begin CHARACTERISTIC bst_WGPnl_ena "Non-linear WGP target mapping{bst_WGPnl_ena&0xff=0:Disabled}{bst_WGPnl_ena&0xff=1:Enabled}" VALUE 0x001c8faf /* @ECU_Address@bst_WGPnl_ena@0x01002620@ */ ECIPP_ALIGNMENT_UBYTE 255 bst_WGPnl_ena_COMPU_VTAB 0 255 BIT_MASK 0xff /end CHARACTERISTIC
/begin COMPU_METHOD bst_WGPnl_ena_COMPU_VTAB "Verbal Table" TAB_VERB "%.0" "list" COMPU_TAB_REF bst_WGPnl_ena_COMPU_VTAB_REF /end COMPU_METHOD
/begin COMPU_VTAB bst_WGPnl_ena_COMPU_VTAB_REF "Verbal Table" TAB_VERB 2 0 "Disabled" 1 "Enabled" DEFAULT_VALUE "UNKNOWN" /end COMPU_VTAB
/begin MEASUREMENT bst_WGPdi "WGP feedback target (initial)" UWORD Compu_bst_WGPdi 0 0 0 255.99609375 ECU_ADDRESS 0x01002628 /end MEASUREMENT
/begin COMPU_METHOD Compu_bst_WGPdi " " RAT_FUNC "%.2" "psig" COEFFS 0 256 0 0 0 1 /end COMPU_METHOD
/begin CHARACTERISTIC bst_WGPd_dotena "WGP derivative desired estimate{bst_WGPd_dotena&0xff=0:Disabled}{bst_WGPd_dotena&0xff=1:Enabled}" VALUE 0x001c8fae /* @ECU_Address@bst_WGPd_dotena@0x01002630@ */ ECIPP_ALIGNMENT_UBYTE 255 bst_WGPd_dotena_COMPU_VTAB 0 255 BIT_MASK 0xff /end CHARACTERISTIC
/begin COMPU_METHOD bst_WGPd_dotena_COMPU_VTAB "Verbal Table" TAB_VERB "%.0" "list" COMPU_TAB_REF bst_WGPd_dotena_COMPU_VTAB_REF /end COMPU_METHOD
/begin COMPU_VTAB bst_WGPd_dotena_COMPU_VTAB_REF "Verbal Table" TAB_VERB 2 0 "Disabled" 1 "Enabled" DEFAULT_VALUE "UNKNOWN" /end COMPU_VTAB
/begin CHARACTERISTIC TEI_mode "TEI control{TEI_mode&0xff=0:Disabled}{TEI_mode&0xff=1:Enabled: Spark/Fuel}{TEI_mode&0xff=2:Enabled: EGR Min/Nom}" VALUE 0x001c8f1e /* @ECU_Address@TEI_mode@0x010028A0@ */ ECIPP_ALIGNMENT_UBYTE 255 TEI_mode_COMPU_VTAB 0 255 BIT_MASK 0xff /end CHARACTERISTIC
/begin COMPU_METHOD TEI_mode_COMPU_VTAB "Verbal Table" TAB_VERB "%.0" "list" COMPU_TAB_REF TEI_mode_COMPU_VTAB_REF /end COMPU_METHOD
/begin COMPU_VTAB TEI_mode_COMPU_VTAB_REF "Verbal Table" TAB_VERB 3 0 "Disabled" 1 "Enabled: Spark/Fuel" 2 "Enabled: EGR Min/Nom" DEFAULT_VALUE "UNKNOWN" /end COMPU_VTAB
/begin CHARACTERISTIC TEI_max_enrich "TEI max enrichment @0.65 nominal phi" VALUE 0x001c80be /* @ECU_Address@TEI_max_enrich@0x010028A8@ */ ECIPP_ALIGNMENT_UWORD 100 Compu_TEI_max_enrich 0 99.9984741210938 /end CHARACTERISTIC
/begin COMPU_METHOD Compu_TEI_max_enrich " " RAT_FUNC "%.1" "%" COEFFS 0 655.36 0 0 0 1 /end COMPU_METHOD
/begin CHARACTERISTIC TEI_max_retard "TEI max spark retard" VALUE 0x001c4b56 /* @ECU_Address@TEI_max_retard@0x010028B0@ */ ECIPP_ALIGNMENT_SWORD 2048 Compu_TEI_max_retard -2048 2047.9375 /end CHARACTERISTIC
/begin COMPU_METHOD Compu_TEI_max_retard " " RAT_FUNC "%.1" "CAD" COEFFS 0 16 0 0 0 1 /end COMPU_METHOD
/begin CHARACTERISTIC TEI_TIP_span "TEI fully-enabled TIP span" VALUE 0x001c80ba /* @ECU_Address@TEI_TIP_span@0x010028B8@ */ ECIPP_ALIGNMENT_UWORD 256 Compu_TEI_TIP_span 0 255.99609375 /end CHARACTERISTIC
/begin COMPU_METHOD Compu_TEI_TIP_span " " RAT_FUNC "%.2" "psi" COEFFS 0 256 0 0 0 1 /end COMPU_METHOD
/begin CHARACTERISTIC TEI_TIP_dz "TEI TIP target dead-zone" VALUE 0x001c4b54 /* @ECU_Address@TEI_TIP_dz@0x010028C0@ */ ECIPP_ALIGNMENT_SWORD 128 Compu_TEI_TIP_dz -128 127.99609375 /end CHARACTERISTIC
/begin COMPU_METHOD Compu_TEI_TIP_dz " " RAT_FUNC "%.2" "psi" COEFFS 0 256 0 0 0 1 /end COMPU_METHOD
/begin CHARACTERISTIC TEI_full_t "TEI initial fully-enabled time" VALUE 0x001c80bc /* @ECU_Address@TEI_full_t@0x010028C8@ */ ECIPP_ALIGNMENT_UWORD 65535 Compu_TEI_full_t 0 65535 /end CHARACTERISTIC
/begin COMPU_METHOD Compu_TEI_full_t " " RAT_FUNC "%.0" "ms" COEFFS 0 1 0 0 0 1 /end COMPU_METHOD
/begin CHARACTERISTIC TEI_trans_t "TEI transition ramp-down/up time" VALUE 0x001c80c6 /* @ECU_Address@TEI_trans_t@0x010028D0@ */ ECIPP_ALIGNMENT_UWORD 65535 Compu_TEI_trans_t 0 65535 /end CHARACTERISTIC
/begin COMPU_METHOD Compu_TEI_trans_t " " RAT_FUNC "%.0" "ms" COEFFS 0 1 0 0 0 1 /end COMPU_METHOD
/begin CHARACTERISTIC TEI_reset_t "TEI reset time" VALUE 0x001c80c0 /* @ECU_Address@TEI_reset_t@0x010028D8@ */ ECIPP_ALIGNMENT_UWORD 65535 Compu_TEI_reset_t 0 65535 /end CHARACTERISTIC
/begin COMPU_METHOD Compu_TEI_reset_t " " RAT_FUNC "%.0" "ms" COEFFS 0 1 0 0 0 1 /end COMPU_METHOD
/begin CHARACTERISTIC TEI_rpm_lower "TEI fully-enabled speed" VALUE 0x001c80c2 /* @ECU_Address@TEI_rpm_lower@0x010028E0@ */ ECIPP_ALIGNMENT_UWORD 65535 Compu_TEI_rpm_lower 0 65535 /end CHARACTERISTIC
/begin COMPU_METHOD Compu_TEI_rpm_lower " " RAT_FUNC "%.0" "rpm" COEFFS 0 1 0 0 0 1 /end COMPU_METHOD
/begin CHARACTERISTIC TEI_rpm_upper "TEI fully-disabled speed" VALUE 0x001c80c4 /* @ECU_Address@TEI_rpm_upper@0x010028E8@ */ ECIPP_ALIGNMENT_UWORD 65535 Compu_TEI_rpm_upper 0 65535 /end CHARACTERISTIC
/begin COMPU_METHOD Compu_TEI_rpm_upper " " RAT_FUNC "%.0" "rpm" COEFFS 0 1 0 0 0 1 /end COMPU_METHOD
/begin CHARACTERISTIC TEI_FPP_dz "TEI foot-pedal steady-state tolerance" VALUE 0x001c80b8 /* @ECU_Address@TEI_FPP_dz@0x010028F0@ */ ECIPP_ALIGNMENT_UWORD 100 Compu_TEI_FPP_dz 0 99.9984741210938 /end CHARACTERISTIC
/begin COMPU_METHOD Compu_TEI_FPP_dz " " RAT_FUNC "%.1" "+/- %" COEFFS 0 655.36 0 0 0 1 /end COMPU_METHOD
/begin MEASUREMENT TEI_enrich "Current TEI enrichment @0.65 nom phi" UWORD Compu_TEI_enrich 0 0 0 99.9984741210938 ECU_ADDRESS 0x010028F8 /end MEASUREMENT
/begin COMPU_METHOD Compu_TEI_enrich " " RAT_FUNC "%.1" "%" COEFFS 0 655.36 0 0 0 1 /end COMPU_METHOD
/begin MEASUREMENT TEI_retard "Current TEI spark retard" SWORD Compu_TEI_retard 0 0 -2048 2047.9375 ECU_ADDRESS 0x01002900 /end MEASUREMENT
/begin COMPU_METHOD Compu_TEI_retard " " RAT_FUNC "%.1" "CAD" COEFFS 0 16 0 0 0 1 /end COMPU_METHOD
/begin MEASUREMENT TEI_enable "Current TEI timer-based enable" UWORD Compu_TEI_enable 0 0 0 99.9984741210938 ECU_ADDRESS 0x01002908 /end MEASUREMENT
/begin COMPU_METHOD Compu_TEI_enable " " RAT_FUNC "%.1" "%" COEFFS 0 655.36 0 0 0 1 /end COMPU_METHOD
/begin CHARACTERISTIC Ncyl "Cylinders" VALUE 0x001c884f /* @ECU_Address@Ncyl@0x010029F0@ */ ECIPP_ALIGNMENT_UBYTE 255 Compu_Ncyl 0 255 /end CHARACTERISTIC
/begin COMPU_METHOD Compu_Ncyl " " RAT_FUNC "%.0" "-" COEFFS 0 1 0 0 0 1 /end COMPU_METHOD
/begin CHARACTERISTIC OilP_type "Oil pressure sensor type{OilP_type&0xff=0x00:Switch - default input}{OilP_type&0xff=0x01:Sender - default input}{OilP_type&0xff=0x02:Aux DIG4}{OilP_type&0xff=0x03:Aux DIG5}{OilP_type&0xff=0x04:Aux DIG6}{OilP_type&0xff=0x05:Aux DIG7}{OilP_type&0xff=0x06:Au" VALUE 0x001c886f /* @ECU_Address@OilP_type@0x01002BB8@ */ ECIPP_ALIGNMENT_UBYTE 255 OilP_type_COMPU_VTAB 0 255 BIT_MASK 0xff /end CHARACTERISTIC
/begin COMPU_METHOD OilP_type_COMPU_VTAB "Verbal Table" TAB_VERB "%.0" "list" COMPU_TAB_REF OilP_type_COMPU_VTAB_REF /end COMPU_METHOD
/begin COMPU_VTAB OilP_type_COMPU_VTAB_REF "Verbal Table" TAB_VERB 14 0x00 "Switch - default input" 0x01 "Sender - default input" 0x02 "Aux DIG4" 0x03 "Aux DIG5" 0x04 "Aux DIG6" 0x05 "Aux DIG7" 0x06 "Aux DIG8" 0x07 "Aux DIG9" 0x08 "Aux DIG10" 0x09 "Aux DIG11" 0x0A "SENT1 Data1" 0x0B "SENT1 Data2" 0x0C "SENT2 Data1" 0x0D "SENT2 Data2" DEFAULT_VALUE "UNKNOWN" /end COMPU_VTAB
/begin CHARACTERISTIC CylFireOrder1 "CFO1{CylFireOrder1&0xff=0:X}{CylFireOrder1&0xff=1:1}{CylFireOrder1&0xff=2:2}{CylFireOrder1&0xff=3:3}{CylFireOrder1&0xff=4:4}{CylFireOrder1&0xff=5:5}{CylFireOrder1&0xff=6:6}{CylFireOrder1&0xff=7:7}{CylFireOrder1&0xff=8:8}{CylFireOrder1&0xff=9:9}{CylFireOrd" VALUE 0x001C8FE1 /* @ECU_Address@CylFireOrder1@0x01003298@ */ ECIPP_ALIGNMENT_UBYTE 255 CylFireOrder1_COMPU_VTAB 0 255 BIT_MASK 0xff /end CHARACTERISTIC
/begin COMPU_METHOD CylFireOrder1_COMPU_VTAB "Verbal Table" TAB_VERB "%.0" "list" COMPU_TAB_REF CylFireOrder1_COMPU_VTAB_REF /end COMPU_METHOD
/begin COMPU_VTAB CylFireOrder1_COMPU_VTAB_REF "Verbal Table" TAB_VERB 13 0 "X" 1 "1" 2 "2" 3 "3" 4 "4" 5 "5" 6 "6" 7 "7" 8 "8" 9 "9" 10 "10" 11 "11" 12 "12" DEFAULT_VALUE "UNKNOWN" /end COMPU_VTAB
/begin CHARACTERISTIC CylFireOrder2 "CFO2{CylFireOrder2&0xff=0:X}{CylFireOrder2&0xff=1:1}{CylFireOrder2&0xff=2:2}{CylFireOrder2&0xff=3:3}{CylFireOrder2&0xff=4:4}{CylFireOrder2&0xff=5:5}{CylFireOrder2&0xff=6:6}{CylFireOrder2&0xff=7:7}{CylFireOrder2&0xff=8:8}{CylFireOrder2&0xff=9:9}{CylFireOrd" VALUE 0x001C8FE2 /* @ECU_Address@CylFireOrder2@0x010032A0@ */ ECIPP_ALIGNMENT_UBYTE 255 CylFireOrder2_COMPU_VTAB 0 255 BIT_MASK 0xff /end CHARACTERISTIC
/begin COMPU_METHOD CylFireOrder2_COMPU_VTAB "Verbal Table" TAB_VERB "%.0" "list" COMPU_TAB_REF CylFireOrder2_COMPU_VTAB_REF /end COMPU_METHOD
/begin COMPU_VTAB CylFireOrder2_COMPU_VTAB_REF "Verbal Table" TAB_VERB 13 0 "X" 1 "1" 2 "2" 3 "3" 4 "4" 5 "5" 6 "6" 7 "7" 8 "8" 9 "9" 10 "10" 11 "11" 12 "12" DEFAULT_VALUE "UNKNOWN" /end COMPU_VTAB
/begin CHARACTERISTIC CylFireOrder3 "CFO3{CylFireOrder3&0xff=0:X}{CylFireOrder3&0xff=1:1}{CylFireOrder3&0xff=2:2}{CylFireOrder3&0xff=3:3}{CylFireOrder3&0xff=4:4}{CylFireOrder3&0xff=5:5}{CylFireOrder3&0xff=6:6}{CylFireOrder3&0xff=7:7}{CylFireOrder3&0xff=8:8}{CylFireOrder3&0xff=9:9}{CylFireOrd" VALUE 0x001C8FE3 /* @ECU_Address@CylFireOrder3@0x010032A8@ */ ECIPP_ALIGNMENT_UBYTE 255 CylFireOrder3_COMPU_VTAB 0 255 BIT_MASK 0xff /end CHARACTERISTIC
/begin COMPU_METHOD CylFireOrder3_COMPU_VTAB "Verbal Table" TAB_VERB "%.0" "list" COMPU_TAB_REF CylFireOrder3_COMPU_VTAB_REF /end COMPU_METHOD
/begin COMPU_VTAB CylFireOrder3_COMPU_VTAB_REF "Verbal Table" TAB_VERB 13 0 "X" 1 "1" 2 "2" 3 "3" 4 "4" 5 "5" 6 "6" 7 "7" 8 "8" 9 "9" 10 "10" 11 "11" 12 "12" DEFAULT_VALUE "UNKNOWN" /end COMPU_VTAB
/begin CHARACTERISTIC CylFireOrder4 "CFO4{CylFireOrder4&0xff=0:X}{CylFireOrder4&0xff=1:1}{CylFireOrder4&0xff=2:2}{CylFireOrder4&0xff=3:3}{CylFireOrder4&0xff=4:4}{CylFireOrder4&0xff=5:5}{CylFireOrder4&0xff=6:6}{CylFireOrder4&0xff=7:7}{CylFireOrder4&0xff=8:8}{CylFireOrder4&0xff=9:9}{CylFireOrd" VALUE 0x001C8FE4 /* @ECU_Address@CylFireOrder4@0x010032B0@ */ ECIPP_ALIGNMENT_UBYTE 255 CylFireOrder4_COMPU_VTAB 0 255 BIT_MASK 0xff /end CHARACTERISTIC
/begin COMPU_METHOD CylFireOrder4_COMPU_VTAB "Verbal Table" TAB_VERB "%.0" "list" COMPU_TAB_REF CylFireOrder4_COMPU_VTAB_REF /end COMPU_METHOD
/begin COMPU_VTAB CylFireOrder4_COMPU_VTAB_REF "Verbal Table" TAB_VERB 13 0 "X" 1 "1" 2 "2" 3 "3" 4 "4" 5 "5" 6 "6" 7 "7" 8 "8" 9 "9" 10 "10" 11 "11" 12 "12" DEFAULT_VALUE "UNKNOWN" /end COMPU_VTAB
/begin CHARACTERISTIC CylFireOrder5 "CFO5{CylFireOrder5&0xff=0:X}{CylFireOrder5&0xff=1:1}{CylFireOrder5&0xff=2:2}{CylFireOrder5&0xff=3:3}{CylFireOrder5&0xff=4:4}{CylFireOrder5&0xff=5:5}{CylFireOrder5&0xff=6:6}{CylFireOrder5&0xff=7:7}{CylFireOrder5&0xff=8:8}{CylFireOrder5&0xff=9:9}{CylFireOrd" VALUE 0x001C8FE5 /* @ECU_Address@CylFireOrder5@0x010032B8@ */ ECIPP_ALIGNMENT_UBYTE 255 CylFireOrder5_COMPU_VTAB 0 255 BIT_MASK 0xff /end CHARACTERISTIC
/begin COMPU_METHOD CylFireOrder5_COMPU_VTAB "Verbal Table" TAB_VERB "%.0" "list" COMPU_TAB_REF CylFireOrder5_COMPU_VTAB_REF /end COMPU_METHOD
/begin COMPU_VTAB CylFireOrder5_COMPU_VTAB_REF "Verbal Table" TAB_VERB 13 0 "X" 1 "1" 2 "2" 3 "3" 4 "4" 5 "5" 6 "6" 7 "7" 8 "8" 9 "9" 10 "10" 11 "11" 12 "12" DEFAULT_VALUE "UNKNOWN" /end COMPU_VTAB
/begin CHARACTERISTIC CylFireOrder6 "CFO6{CylFireOrder6&0xff=0:X}{CylFireOrder6&0xff=1:1}{CylFireOrder6&0xff=2:2}{CylFireOrder6&0xff=3:3}{CylFireOrder6&0xff=4:4}{CylFireOrder6&0xff=5:5}{CylFireOrder6&0xff=6:6}{CylFireOrder6&0xff=7:7}{CylFireOrder6&0xff=8:8}{CylFireOrder6&0xff=9:9}{CylFireOrd" VALUE 0x001C8FE6 /* @ECU_Address@CylFireOrder6@0x010032C0@ */ ECIPP_ALIGNMENT_UBYTE 255 CylFireOrder6_COMPU_VTAB 0 255 BIT_MASK 0xff /end CHARACTERISTIC
/begin COMPU_METHOD CylFireOrder6_COMPU_VTAB "Verbal Table" TAB_VERB "%.0" "list" COMPU_TAB_REF CylFireOrder6_COMPU_VTAB_REF /end COMPU_METHOD
/begin COMPU_VTAB CylFireOrder6_COMPU_VTAB_REF "Verbal Table" TAB_VERB 13 0 "X" 1 "1" 2 "2" 3 "3" 4 "4" 5 "5" 6 "6" 7 "7" 8 "8" 9 "9" 10 "10" 11 "11" 12 "12" DEFAULT_VALUE "UNKNOWN" /end COMPU_VTAB
/begin CHARACTERISTIC CylFireOrder7 "CFO7{CylFireOrder7&0xff=0:X}{CylFireOrder7&0xff=1:1}{CylFireOrder7&0xff=2:2}{CylFireOrder7&0xff=3:3}{CylFireOrder7&0xff=4:4}{CylFireOrder7&0xff=5:5}{CylFireOrder7&0xff=6:6}{CylFireOrder7&0xff=7:7}{CylFireOrder7&0xff=8:8}{CylFireOrder7&0xff=9:9}{CylFireOrd" VALUE 0x001C8FE7 /* @ECU_Address@CylFireOrder7@0x010032C8@ */ ECIPP_ALIGNMENT_UBYTE 255 CylFireOrder7_COMPU_VTAB 0 255 BIT_MASK 0xff /end CHARACTERISTIC
/begin COMPU_METHOD CylFireOrder7_COMPU_VTAB "Verbal Table" TAB_VERB "%.0" "list" COMPU_TAB_REF CylFireOrder7_COMPU_VTAB_REF /end COMPU_METHOD
/begin COMPU_VTAB CylFireOrder7_COMPU_VTAB_REF "Verbal Table" TAB_VERB 13 0 "X" 1 "1" 2 "2" 3 "3" 4 "4" 5 "5" 6 "6" 7 "7" 8 "8" 9 "9" 10 "10" 11 "11" 12 "12" DEFAULT_VALUE "UNKNOWN" /end COMPU_VTAB
/begin CHARACTERISTIC CylFireOrder8 "CFO8{CylFireOrder8&0xff=0:X}{CylFireOrder8&0xff=1:1}{CylFireOrder8&0xff=2:2}{CylFireOrder8&0xff=3:3}{CylFireOrder8&0xff=4:4}{CylFireOrder8&0xff=5:5}{CylFireOrder8&0xff=6:6}{CylFireOrder8&0xff=7:7}{CylFireOrder8&0xff=8:8}{CylFireOrder8&0xff=9:9}{CylFireOrd" VALUE 0x001C8FE8 /* @ECU_Address@CylFireOrder8@0x010032D0@ */ ECIPP_ALIGNMENT_UBYTE 255 CylFireOrder8_COMPU_VTAB 0 255 BIT_MASK 0xff /end CHARACTERISTIC
/begin COMPU_METHOD CylFireOrder8_COMPU_VTAB "Verbal Table" TAB_VERB "%.0" "list" COMPU_TAB_REF CylFireOrder8_COMPU_VTAB_REF /end COMPU_METHOD
/begin COMPU_VTAB CylFireOrder8_COMPU_VTAB_REF "Verbal Table" TAB_VERB 13 0 "X" 1 "1" 2 "2" 3 "3" 4 "4" 5 "5" 6 "6" 7 "7" 8 "8" 9 "9" 10 "10" 11 "11" 12 "12" DEFAULT_VALUE "UNKNOWN" /end COMPU_VTAB
/begin CHARACTERISTIC Vd "Displacement" VALUE 0x001c8380 /* @ECU_Address@Vd@0x010032D8@ */ ECIPP_ALIGNMENT_UWORD 32 Compu_Vd 0 31.99951171875 /end CHARACTERISTIC
/begin COMPU_METHOD Compu_Vd " " RAT_FUNC "%.1" "L" COEFFS 0 2048 0 0 0 1 /end COMPU_METHOD
/begin CHARACTERISTIC spark_type "Spark system type{spark_type&0xff=0:Distributor}{spark_type&0xff=1:Waste Spark}{spark_type&0xff=2:Coil Per Cylinder}{spark_type&0xff=3:Capacitive Discharge}" VALUE 0x001c907c /* @ECU_Address@spark_type@0x010033D0@ */ ECIPP_ALIGNMENT_UBYTE 255 spark_type_COMPU_VTAB 0 255 BIT_MASK 0xff /end CHARACTERISTIC
/begin COMPU_METHOD spark_type_COMPU_VTAB "Verbal Table" TAB_VERB "%.0" "list" COMPU_TAB_REF spark_type_COMPU_VTAB_REF /end COMPU_METHOD
/begin COMPU_VTAB spark_type_COMPU_VTAB_REF "Verbal Table" TAB_VERB 4 0 "Distributor" 1 "Waste Spark" 2 "Coil Per Cylinder" 3 "Capacitive Discharge" DEFAULT_VALUE "UNKNOWN" /end COMPU_VTAB
/begin MEASUREMENT emcal_CS_32 "Emissions cal checksum32" ULONG Compu_emcal_CS_32 0 0 0 4294967295 ECU_ADDRESS 0x01003468 /end MEASUREMENT
/begin COMPU_METHOD Compu_emcal_CS_32 " " RAT_FUNC "%.0" "-" COEFFS 0 1 0 0 0 1 /end COMPU_METHOD
/begin MEASUREMENT totalcal_CS_32 "Total checksum32" ULONG Compu_totalcal_CS_32 0 0 0 4294967295 ECU_ADDRESS 0x010034B0 /end MEASUREMENT
/begin COMPU_METHOD Compu_totalcal_CS_32 " " RAT_FUNC "%.0" "-" COEFFS 0 1 0 0 0 1 /end COMPU_METHOD
/begin MEASUREMENT FuelSpk_SD_active "Fuel/Spark inhibit state{FuelSpk_SD_active&0xff=0:Inactive / Normal}{FuelSpk_SD_active&0xff=1:Active / Shutdown}" UBYTE FuelSpk_SD_active_COMPU_VTAB 0 0 0 255 ECU_ADDRESS 0x01004AE0 BIT_MASK 0xff /end MEASUREMENT
/begin COMPU_METHOD FuelSpk_SD_active_COMPU_VTAB "Verbal Table" TAB_VERB "%.0" "list" COMPU_TAB_REF FuelSpk_SD_active_COMPU_VTAB_REF /end COMPU_METHOD
/begin COMPU_VTAB FuelSpk_SD_active_COMPU_VTAB_REF "Verbal Table" TAB_VERB 2 0 "Inactive / Normal" 1 "Active / Shutdown" DEFAULT_VALUE "UNKNOWN" /end COMPU_VTAB
/begin MEASUREMENT fuel_supply "Fuel supply{fuel_supply&0xff=0:Off}{fuel_supply&0xff=1:On}" UBYTE fuel_supply_COMPU_VTAB 0 0 0 255 ECU_ADDRESS 0x01004D30 BIT_MASK 0xff /end MEASUREMENT
/begin COMPU_METHOD fuel_supply_COMPU_VTAB "Verbal Table" TAB_VERB "%.0" "list" COMPU_TAB_REF fuel_supply_COMPU_VTAB_REF /end COMPU_METHOD
/begin COMPU_VTAB fuel_supply_COMPU_VTAB_REF "Verbal Table" TAB_VERB 2 0 "Off" 1 "On" DEFAULT_VALUE "UNKNOWN" /end COMPU_VTAB
/begin CHARACTERISTIC CylFireOrder9 "CFO9{CylFireOrder9&0xff=0:X}{CylFireOrder9&0xff=1:1}{CylFireOrder9&0xff=2:2}{CylFireOrder9&0xff=3:3}{CylFireOrder9&0xff=4:4}{CylFireOrder9&0xff=5:5}{CylFireOrder9&0xff=6:6}{CylFireOrder9&0xff=7:7}{CylFireOrder9&0xff=8:8}{CylFireOrder9&0xff=9:9}{CylFireOrd" VALUE 0x001C8FE9 /* @ECU_Address@CylFireOrder9@0x01004F60@ */ ECIPP_ALIGNMENT_UBYTE 255 CylFireOrder9_COMPU_VTAB 0 255 BIT_MASK 0xff /end CHARACTERISTIC
/begin COMPU_METHOD CylFireOrder9_COMPU_VTAB "Verbal Table" TAB_VERB "%.0" "list" COMPU_TAB_REF CylFireOrder9_COMPU_VTAB_REF /end COMPU_METHOD
/begin COMPU_VTAB CylFireOrder9_COMPU_VTAB_REF "Verbal Table" TAB_VERB 13 0 "X" 1 "1" 2 "2" 3 "3" 4 "4" 5 "5" 6 "6" 7 "7" 8 "8" 9 "9" 10 "10" 11 "11" 12 "12" DEFAULT_VALUE "UNKNOWN" /end COMPU_VTAB
/begin CHARACTERISTIC CylFireOrder10 "CFO10{CylFireOrder10&0xff=0:X}{CylFireOrder10&0xff=1:1}{CylFireOrder10&0xff=2:2}{CylFireOrder10&0xff=3:3}{CylFireOrder10&0xff=4:4}{CylFireOrder10&0xff=5:5}{CylFireOrder10&0xff=6:6}{CylFireOrder10&0xff=7:7}{CylFireOrder10&0xff=8:8}{CylFireOrder10&0xff=9:9}" VALUE 0x001C8FEA /* @ECU_Address@CylFireOrder10@0x01004F68@ */ ECIPP_ALIGNMENT_UBYTE 255 CylFireOrder10_COMPU_VTAB 0 255 BIT_MASK 0xff /end CHARACTERISTIC
/begin COMPU_METHOD CylFireOrder10_COMPU_VTAB "Verbal Table" TAB_VERB "%.0" "list" COMPU_TAB_REF CylFireOrder10_COMPU_VTAB_REF /end COMPU_METHOD
/begin COMPU_VTAB CylFireOrder10_COMPU_VTAB_REF "Verbal Table" TAB_VERB 13 0 "X" 1 "1" 2 "2" 3 "3" 4 "4" 5 "5" 6 "6" 7 "7" 8 "8" 9 "9" 10 "10" 11 "11" 12 "12" DEFAULT_VALUE "UNKNOWN" /end COMPU_VTAB
/begin CHARACTERISTIC bst_TPS_filt "Delta-P boost TPS command filters{bst_TPS_filt&0xff=0:Disabled}{bst_TPS_filt&0xff=1:Both rpm and TIP}{bst_TPS_filt&0xff=2:rpm only, TIP unfiltered}" VALUE 0x001c8faa /* @ECU_Address@bst_TPS_filt@0x010058B8@ */ ECIPP_ALIGNMENT_UBYTE 255 bst_TPS_filt_COMPU_VTAB 0 255 BIT_MASK 0xff /end CHARACTERISTIC
/begin COMPU_METHOD bst_TPS_filt_COMPU_VTAB "Verbal Table" TAB_VERB "%.0" "list" COMPU_TAB_REF bst_TPS_filt_COMPU_VTAB_REF /end COMPU_METHOD
/begin COMPU_VTAB bst_TPS_filt_COMPU_VTAB_REF "Verbal Table" TAB_VERB 3 0 "Disabled" 1 "Both rpm and TIP" 2 "rpm only, TIP unfiltered" DEFAULT_VALUE "UNKNOWN" /end COMPU_VTAB
/begin CHARACTERISTIC bst_rpm_tau "Delta-P boost TPS command rpm tau" VALUE 0x001c8658 /* @ECU_Address@bst_rpm_tau@0x010058C0@ */ ECIPP_ALIGNMENT_UWORD 327680 Compu_bst_rpm_tau 0.45084 327680 /end CHARACTERISTIC
/begin COMPU_METHOD Compu_bst_rpm_tau " " FORM "%.1" "ms"
 /begin FORMULA "-5 / log(1 - (X1 / 65536))" FORMULA_INV "(1 - exp(-5/X1)) * 65536" /end FORMULA
/end COMPU_METHOD
/begin CHARACTERISTIC bst_TIP_tau "Delta-P boost TPS command TIP tau" VALUE 0x001c8650 /* @ECU_Address@bst_TIP_tau@0x010058C8@ */ ECIPP_ALIGNMENT_UWORD 327680 Compu_bst_TIP_tau 0.45084 327680 /end CHARACTERISTIC
/begin COMPU_METHOD Compu_bst_TIP_tau " " FORM "%.1" "ms"
 /begin FORMULA "-5 / log(1 - (X1 / 65536))" FORMULA_INV "(1 - exp(-5/X1)) * 65536" /end FORMULA
/end COMPU_METHOD
/begin MEASUREMENT XLS_Revision "XLS_Revision" UWORD Compu_XLS_Revision 0 0 0 65535 ECU_ADDRESS 0x01005ED0 /end MEASUREMENT
/begin COMPU_METHOD Compu_XLS_Revision " " RAT_FUNC "%.0" "-" COEFFS 0 1 0 0 0 1 /end COMPU_METHOD
/begin CHARACTERISTIC WGP_ena "WGP source{WGP_ena&0xff=0:Disabled}{WGP_ena&0xff=1:WGP Input}{WGP_ena&0xff=2:FP Input}{WGP_ena&0xff=3:Aux PUD1}{WGP_ena&0xff=4:Aux PUD2}{WGP_ena&0xff=5:Aux PUD3}{WGP_ena&0xff=6:Aux PUD4}{WGP_ena&0xff=7:Aux PUD5}{WGP_ena&0xff=8:Aux PUD6}{WGP_ena&0xff=9:Aux" VALUE 0x001c8f93 /* @ECU_Address@WGP_ena@0x01006310@ */ ECIPP_ALIGNMENT_UBYTE 255 WGP_ena_COMPU_VTAB 0 255 BIT_MASK 0xff /end CHARACTERISTIC
/begin COMPU_METHOD WGP_ena_COMPU_VTAB "Verbal Table" TAB_VERB "%.0" "list" COMPU_TAB_REF WGP_ena_COMPU_VTAB_REF /end COMPU_METHOD
/begin COMPU_VTAB WGP_ena_COMPU_VTAB_REF "Verbal Table" TAB_VERB 32 0 "Disabled" 1 "WGP Input" 2 "FP Input" 3 "Aux PUD1" 4 "Aux PUD2" 5 "Aux PUD3" 6 "Aux PUD4" 7 "Aux PUD5" 8 "Aux PUD6" 9 "Aux PUD7" 10 "Aux PUD8" 11 "Aux PUD9" 12 "Aux PUD10" 13 "Aux PUD11" 14 "Aux PUD12" 15 "Aux PUD13" 16 "Aux PUD14" 17 "Aux PUD15" 18 "Aux PUD16" 19 "Aux PUD17" 20 "Aux PUD18" 21 "Aux PUD19" 22 "Aux PUD20" 23 "Aux PUD21" 24 "Aux PUD22" 25 "Aux PUD23" 26 "Aux PUD24" 27 "Aux PUD25" 28 "Aux PD1" 29 "Aux PD2" 30 "Aux PD3" 31 "CAN-based WGCV" DEFAULT_VALUE "UNKNOWN" /end COMPU_VTAB
/begin MEASUREMENT svn_revision "SVN revision" ULONG Compu_svn_revision 0 0 0 4294967295 ECU_ADDRESS 0x01006668 /end MEASUREMENT
/begin COMPU_METHOD Compu_svn_revision " " RAT_FUNC "%.0" "-" COEFFS 0 1 0 0 0 1 /end COMPU_METHOD
/begin MEASUREMENT svn_compile_date "SVN compile date" ULONG Compu_svn_compile_date 0 0 0 4294967295 ECU_ADDRESS 0x01006670 /end MEASUREMENT
/begin COMPU_METHOD Compu_svn_compile_date " " RAT_FUNC "%.0" "-" COEFFS 0 1 0 0 0 1 /end COMPU_METHOD
/begin MEASUREMENT svn_compile_status "SVN compile status" UBYTE Compu_svn_compile_status 0 0 0 255 ECU_ADDRESS 0x01006678 /end MEASUREMENT
/begin COMPU_METHOD Compu_svn_compile_status " " RAT_FUNC "%.0" "-" COEFFS 0 1 0 0 0 1 /end COMPU_METHOD
/begin CHARACTERISTIC bst_supercharge "Boost control type{bst_supercharge&0xff=0:Turbocharged}{bst_supercharge&0xff=1:Supercharged}" VALUE 0x001c8fb7 /* @ECU_Address@bst_supercharge@0x01006798@ */ ECIPP_ALIGNMENT_UBYTE 255 bst_supercharge_COMPU_VTAB 0 255 BIT_MASK 0xff /end CHARACTERISTIC
/begin COMPU_METHOD bst_supercharge_COMPU_VTAB "Verbal Table" TAB_VERB "%.0" "list" COMPU_TAB_REF bst_supercharge_COMPU_VTAB_REF /end COMPU_METHOD
/begin COMPU_VTAB bst_supercharge_COMPU_VTAB_REF "Verbal Table" TAB_VERB 2 0 "Turbocharged" 1 "Supercharged" DEFAULT_VALUE "UNKNOWN" /end COMPU_VTAB
/begin CHARACTERISTIC bst_Ksc_MAP "TOP target MAP error Kp" VALUE 0x001c6c4a /* @ECU_Address@bst_Ksc_MAP@0x010067A0@ */ ECIPP_ALIGNMENT_SWORD 16 Compu_bst_Ksc_MAP -16 15.99951171875 /end CHARACTERISTIC
/begin COMPU_METHOD Compu_bst_Ksc_MAP " " RAT_FUNC "%.2" "-" COEFFS 0 2048 0 0 0 1 /end COMPU_METHOD
/begin CHARACTERISTIC bst_Ksc_DP "TOP target delta-P error Kp" VALUE 0x001c6c48 /* @ECU_Address@bst_Ksc_DP@0x010067A8@ */ ECIPP_ALIGNMENT_SWORD 16 Compu_bst_Ksc_DP -16 15.99951171875 /end CHARACTERISTIC
/begin COMPU_METHOD Compu_bst_Ksc_DP " " RAT_FUNC "%.2" "-" COEFFS 0 2048 0 0 0 1 /end COMPU_METHOD
/begin CHARACTERISTIC bst_WGAchan "Boost WG output channel{bst_WGAchan&0xff=0:Aux PWM1}{bst_WGAchan&0xff=1:Aux PWM2}{bst_WGAchan&0xff=2:Aux PWM3}{bst_WGAchan&0xff=3:Aux PWM4}{bst_WGAchan&0xff=4:Aux PWM5}{bst_WGAchan&0xff=5:Aux PWM6}{bst_WGAchan&0xff=6:Aux PWM8}{bst_WGAchan&0xff=7:Aux PWM9}" VALUE 0x001c8fab /* @ECU_Address@bst_WGAchan@0x010067B0@ */ ECIPP_ALIGNMENT_UBYTE 255 bst_WGAchan_COMPU_VTAB 0 255 BIT_MASK 0xff /end CHARACTERISTIC
/begin COMPU_METHOD bst_WGAchan_COMPU_VTAB "Verbal Table" TAB_VERB "%.0" "list" COMPU_TAB_REF bst_WGAchan_COMPU_VTAB_REF /end COMPU_METHOD
/begin COMPU_VTAB bst_WGAchan_COMPU_VTAB_REF "Verbal Table" TAB_VERB 13 0 "Aux PWM1" 1 "Aux PWM2" 2 "Aux PWM3" 3 "Aux PWM4" 4 "Aux PWM5" 5 "Aux PWM6" 6 "Aux PWM8" 7 "Aux PWM9" 8 "TACH" 9 "H-bridge A" 10 "H-bridge B" 11 "CAN-based VGT" 12 "CAN-based WGCV" DEFAULT_VALUE "UNKNOWN" /end COMPU_VTAB
/begin MEASUREMENT rTOP "Throttle outlet pressure" UWORD Compu_rTOP 0 0 0 255.99609375 ECU_ADDRESS 0x010067B8 /end MEASUREMENT
/begin COMPU_METHOD Compu_rTOP " " RAT_FUNC "%.2" "psia" COEFFS 0 256 0 0 0 1 /end COMPU_METHOD
/begin MEASUREMENT bst_TOPd "Boost control TOP target" UWORD Compu_bst_TOPd 0 0 0 255.99609375 ECU_ADDRESS 0x010067C0 /end MEASUREMENT
/begin COMPU_METHOD Compu_bst_TOPd " " RAT_FUNC "%.2" "psia" COEFFS 0 256 0 0 0 1 /end COMPU_METHOD
/begin CHARACTERISTIC bst_WGPWM_type "WG PWM output type{bst_WGPWM_type&0xff=0:Electrical PWM}{bst_WGPWM_type&0xff=1:Mechanical PWM}" VALUE 0x001c8fad /* @ECU_Address@bst_WGPWM_type@0x010067D0@ */ ECIPP_ALIGNMENT_UBYTE 255 bst_WGPWM_type_COMPU_VTAB 0 255 BIT_MASK 0xff /end CHARACTERISTIC
/begin COMPU_METHOD bst_WGPWM_type_COMPU_VTAB "Verbal Table" TAB_VERB "%.0" "list" COMPU_TAB_REF bst_WGPWM_type_COMPU_VTAB_REF /end COMPU_METHOD
/begin COMPU_VTAB bst_WGPWM_type_COMPU_VTAB_REF "Verbal Table" TAB_VERB 2 0 "Electrical PWM" 1 "Mechanical PWM" DEFAULT_VALUE "UNKNOWN" /end COMPU_VTAB
/begin CHARACTERISTIC bst_WGPWM_per "Boost WG PWM3/4 output pulse period" VALUE 0x001c83ae /* @ECU_Address@bst_WGPWM_per@0x010067D8@ */ ECIPP_ALIGNMENT_UWORD 210 Compu_bst_WGPWM_per 0 209.712 /end CHARACTERISTIC
/begin COMPU_METHOD Compu_bst_WGPWM_per " " RAT_FUNC "%.1" "ms" COEFFS 0 312.5 0 0 0 1 /end COMPU_METHOD
/begin MEASUREMENT FPP_cmd_predz "FPP percent pre-dead zone" UWORD Compu_FPP_cmd_predz 0 0 0 99.9984741210938 ECU_ADDRESS 0x010067F8 /end MEASUREMENT
/begin COMPU_METHOD Compu_FPP_cmd_predz " " RAT_FUNC "%.1" "%" COEFFS 0 655.36 0 0 0 1 /end COMPU_METHOD
/begin CHARACTERISTIC bst_BP_enabled "Boost altitude compensation{bst_BP_enabled&0xff=0:Disabled}{bst_BP_enabled&0xff=1:TIP only: 1D Table}{bst_BP_enabled&0xff=2:TIP only: 2D Table}{bst_BP_enabled&0xff=3:TIP & MAP: 1D Table}{bst_BP_enabled&0xff=4:TIP & MAP: 2D Table}{bst_BP_enabled&0xff=5:Loa" VALUE 0x001c8fa6 /* @ECU_Address@bst_BP_enabled@0x010072A8@ */ ECIPP_ALIGNMENT_UBYTE 255 bst_BP_enabled_COMPU_VTAB 0 255 BIT_MASK 0xff /end CHARACTERISTIC
/begin COMPU_METHOD bst_BP_enabled_COMPU_VTAB "Verbal Table" TAB_VERB "%.0" "list" COMPU_TAB_REF bst_BP_enabled_COMPU_VTAB_REF /end COMPU_METHOD
/begin COMPU_VTAB bst_BP_enabled_COMPU_VTAB_REF "Verbal Table" TAB_VERB 7 0 "Disabled" 1 "TIP only: 1D Table" 2 "TIP only: 2D Table" 3 "TIP & MAP: 1D Table" 4 "TIP & MAP: 2D Table" 5 "Load-Limit & EGR MinNom: 2D Table" 6 "Load-Limit & EGR MinNom: 2D Table with Load Threshold" DEFAULT_VALUE "UNKNOWN" /end COMPU_VTAB
/begin MEASUREMENT bst_BP_phifrac "Boost altitude phi multiplier" UWORD Compu_bst_BP_phifrac 0 0 1 1.99998474121094 ECU_ADDRESS 0x010072B0 /end MEASUREMENT
/begin COMPU_METHOD Compu_bst_BP_phifrac " " RAT_FUNC "%.2" "-" COEFFS 0 65536 -65536 0 0 1 /end COMPU_METHOD
/begin CHARACTERISTIC bst_discrete_gov "Boost discrete speed governing{bst_discrete_gov&0xff=0:FPP = load %}{bst_discrete_gov&0xff=1:Full-authority}" VALUE 0x001c8fb5 /* @ECU_Address@bst_discrete_gov@0x01007850@ */ ECIPP_ALIGNMENT_UBYTE 255 bst_discrete_gov_COMPU_VTAB 0 255 BIT_MASK 0xff /end CHARACTERISTIC
/begin COMPU_METHOD bst_discrete_gov_COMPU_VTAB "Verbal Table" TAB_VERB "%.0" "list" COMPU_TAB_REF bst_discrete_gov_COMPU_VTAB_REF /end COMPU_METHOD
/begin COMPU_VTAB bst_discrete_gov_COMPU_VTAB_REF "Verbal Table" TAB_VERB 2 0 "FPP = load %" 1 "Full-authority" DEFAULT_VALUE "UNKNOWN" /end COMPU_VTAB
/begin CHARACTERISTIC bst_IAT_crct_ena "Boost IAT correction{bst_IAT_crct_ena&0xff=0:Disabled}{bst_IAT_crct_ena&0xff=1:Enabled}" VALUE 0x001c8fa7 /* @ECU_Address@bst_IAT_crct_ena@0x01007A28@ */ ECIPP_ALIGNMENT_UBYTE 255 bst_IAT_crct_ena_COMPU_VTAB 0 255 BIT_MASK 0xff /end CHARACTERISTIC
/begin COMPU_METHOD bst_IAT_crct_ena_COMPU_VTAB "Verbal Table" TAB_VERB "%.0" "list" COMPU_TAB_REF bst_IAT_crct_ena_COMPU_VTAB_REF /end COMPU_METHOD
/begin COMPU_VTAB bst_IAT_crct_ena_COMPU_VTAB_REF "Verbal Table" TAB_VERB 2 0 "Disabled" 1 "Enabled" DEFAULT_VALUE "UNKNOWN" /end COMPU_VTAB
/begin CHARACTERISTIC bst_carb_dP_ena "Boost carb delta-P compensation{bst_carb_dP_ena&0xff=0:Disabled}{bst_carb_dP_ena&0xff=1:Enabled}" VALUE 0x001c8fb3 /* @ECU_Address@bst_carb_dP_ena@0x01007CE8@ */ ECIPP_ALIGNMENT_UBYTE 255 bst_carb_dP_ena_COMPU_VTAB 0 255 BIT_MASK 0xff /end CHARACTERISTIC
/begin COMPU_METHOD bst_carb_dP_ena_COMPU_VTAB "Verbal Table" TAB_VERB "%.0" "list" COMPU_TAB_REF bst_carb_dP_ena_COMPU_VTAB_REF /end COMPU_METHOD
/begin COMPU_VTAB bst_carb_dP_ena_COMPU_VTAB_REF "Verbal Table" TAB_VERB 2 0 "Disabled" 1 "Enabled" DEFAULT_VALUE "UNKNOWN" /end COMPU_VTAB
/begin CHARACTERISTIC bst_dP_limit_ena "Boost TPS delta-P limiting{bst_dP_limit_ena&0xff=0:Disabled}{bst_dP_limit_ena&0xff=1:Enabled}" VALUE 0x001c8fb4 /* @ECU_Address@bst_dP_limit_ena@0x01007CF8@ */ ECIPP_ALIGNMENT_UBYTE 255 bst_dP_limit_ena_COMPU_VTAB 0 255 BIT_MASK 0xff /end CHARACTERISTIC
/begin COMPU_METHOD bst_dP_limit_ena_COMPU_VTAB "Verbal Table" TAB_VERB "%.0" "list" COMPU_TAB_REF bst_dP_limit_ena_COMPU_VTAB_REF /end COMPU_METHOD
/begin COMPU_VTAB bst_dP_limit_ena_COMPU_VTAB_REF "Verbal Table" TAB_VERB 2 0 "Disabled" 1 "Enabled" DEFAULT_VALUE "UNKNOWN" /end COMPU_VTAB
/begin MEASUREMENT bst_dP_limit_active "Boost TPS delta-P limiting active{bst_dP_limit_active&0xff=0:NO}{bst_dP_limit_active&0xff=1:YES}" UBYTE bst_dP_limit_active_COMPU_VTAB 0 0 0 255 ECU_ADDRESS 0x01007D00 BIT_MASK 0xff /end MEASUREMENT
/begin COMPU_METHOD bst_dP_limit_active_COMPU_VTAB "Verbal Table" TAB_VERB "%.0" "list" COMPU_TAB_REF bst_dP_limit_active_COMPU_VTAB_REF /end COMPU_METHOD
/begin COMPU_VTAB bst_dP_limit_active_COMPU_VTAB_REF "Verbal Table" TAB_VERB 2 0 "NO" 1 "YES" DEFAULT_VALUE "UNKNOWN" /end COMPU_VTAB
/begin CHARACTERISTIC bst_dP_limit_min "Boost TPS delta-P minimum" VALUE 0x001c6c4e /* @ECU_Address@bst_dP_limit_min@0x01007D08@ */ ECIPP_ALIGNMENT_SWORD 128 Compu_bst_dP_limit_min -128 127.99609375 /end CHARACTERISTIC
/begin COMPU_METHOD Compu_bst_dP_limit_min " " RAT_FUNC "%.2" "psia" COEFFS 0 256 0 0 0 1 /end COMPU_METHOD
/begin MEASUREMENT CRI_Prail_actual "Rail pressure actual" UWORD Compu_CRI_Prail_actual 0 0 0 8191.875 ECU_ADDRESS 0x01008890 /end MEASUREMENT
/begin COMPU_METHOD Compu_CRI_Prail_actual " " RAT_FUNC "%.0" "bar" COEFFS 0 8 0 0 0 1 /end COMPU_METHOD
/begin MEASUREMENT CRI_mg_main "Main injection quantity" SWORD Compu_CRI_mg_main 0 0 -1024 1023.96875 ECU_ADDRESS 0x01008898 /end MEASUREMENT
/begin COMPU_METHOD Compu_CRI_mg_main " " RAT_FUNC "%.1" "mg/stroke" COEFFS 0 32 0 0 0 1 /end COMPU_METHOD
/begin MEASUREMENT CRI_mg_pilot2 "Pilot 2 injection quantity" SWORD Compu_CRI_mg_pilot2 0 0 -1024 1023.96875 ECU_ADDRESS 0x010088A0 /end MEASUREMENT
/begin COMPU_METHOD Compu_CRI_mg_pilot2 " " RAT_FUNC "%.1" "mg/stroke" COEFFS 0 32 0 0 0 1 /end COMPU_METHOD
/begin MEASUREMENT CRI_mg_pilot1 "Pilot 1 injection quantity" SWORD Compu_CRI_mg_pilot1 0 0 -1024 1023.96875 ECU_ADDRESS 0x010088A8 /end MEASUREMENT
/begin COMPU_METHOD Compu_CRI_mg_pilot1 " " RAT_FUNC "%.1" "mg/stroke" COEFFS 0 32 0 0 0 1 /end COMPU_METHOD
/begin MEASUREMENT CRI_mg_post1 "Post 1 injection quantity" SWORD Compu_CRI_mg_post1 0 0 -1024 1023.96875 ECU_ADDRESS 0x010088B0 /end MEASUREMENT
/begin COMPU_METHOD Compu_CRI_mg_post1 " " RAT_FUNC "%.1" "mg/stroke" COEFFS 0 32 0 0 0 1 /end COMPU_METHOD
/begin MEASUREMENT CRI_mg_post2 "Post 2 injection quantity" SWORD Compu_CRI_mg_post2 0 0 -1024 1023.96875 ECU_ADDRESS 0x010088B8 /end MEASUREMENT
/begin COMPU_METHOD Compu_CRI_mg_post2 " " RAT_FUNC "%.1" "mg/stroke" COEFFS 0 32 0 0 0 1 /end COMPU_METHOD
/begin MEASUREMENT CRI_cad_main "Main injection timing" SWORD Compu_CRI_cad_main 0 0 -2048 2047.9375 ECU_ADDRESS 0x010088C0 /end MEASUREMENT
/begin COMPU_METHOD Compu_CRI_cad_main " " RAT_FUNC "%.1" "CAD  BTDCC" COEFFS 0 16 0 0 0 1 /end COMPU_METHOD
/begin MEASUREMENT CRI_cad_pilot2 "Pilot 2 injection timing" SWORD Compu_CRI_cad_pilot2 0 0 -2048 2047.9375 ECU_ADDRESS 0x010088C8 /end MEASUREMENT
/begin COMPU_METHOD Compu_CRI_cad_pilot2 " " RAT_FUNC "%.1" "CAD  BTDCC" COEFFS 0 16 0 0 0 1 /end COMPU_METHOD
/begin MEASUREMENT CRI_cad_pilot1 "Pilot 1 injection timing" SWORD Compu_CRI_cad_pilot1 0 0 -2048 2047.9375 ECU_ADDRESS 0x010088D0 /end MEASUREMENT
/begin COMPU_METHOD Compu_CRI_cad_pilot1 " " RAT_FUNC "%.1" "CAD  BTDCC" COEFFS 0 16 0 0 0 1 /end COMPU_METHOD
/begin MEASUREMENT CRI_cad_post1 "Post 1 injection timing" SWORD Compu_CRI_cad_post1 0 0 -2048 2047.9375 ECU_ADDRESS 0x010088D8 /end MEASUREMENT
/begin COMPU_METHOD Compu_CRI_cad_post1 " " RAT_FUNC "%.1" "CAD  BTDCC" COEFFS 0 16 0 0 0 1 /end COMPU_METHOD
/begin MEASUREMENT CRI_cad_post2 "Post 2 injection timing" SWORD Compu_CRI_cad_post2 0 0 -2048 2047.9375 ECU_ADDRESS 0x010088E0 /end MEASUREMENT
/begin COMPU_METHOD Compu_CRI_cad_post2 " " RAT_FUNC "%.1" "CAD  BTDCC" COEFFS 0 16 0 0 0 1 /end COMPU_METHOD
/begin MEASUREMENT CRI_width_main "Main injection pulse-width" ULONG Compu_CRI_width_main 0 0 0 214748364.75 ECU_ADDRESS 0x010088F0 /end MEASUREMENT
/begin COMPU_METHOD Compu_CRI_width_main " " RAT_FUNC "%.0" "us" COEFFS 0 20 0 0 0 1 /end COMPU_METHOD
/begin MEASUREMENT CRI_width_pilot2 "Pilot 2 injection pulse-width" ULONG Compu_CRI_width_pilot2 0 0 0 214748364.75 ECU_ADDRESS 0x010088F8 /end MEASUREMENT
/begin COMPU_METHOD Compu_CRI_width_pilot2 " " RAT_FUNC "%.0" "us" COEFFS 0 20 0 0 0 1 /end COMPU_METHOD
/begin MEASUREMENT CRI_width_pilot1 "Pilot 1 injection pulse-width" ULONG Compu_CRI_width_pilot1 0 0 0 214748364.75 ECU_ADDRESS 0x01008900 /end MEASUREMENT
/begin COMPU_METHOD Compu_CRI_width_pilot1 " " RAT_FUNC "%.0" "us" COEFFS 0 20 0 0 0 1 /end COMPU_METHOD
/begin MEASUREMENT CRI_width_post1 "Post 1 injection pulse-width" ULONG Compu_CRI_width_post1 0 0 0 214748364.75 ECU_ADDRESS 0x01008908 /end MEASUREMENT
/begin COMPU_METHOD Compu_CRI_width_post1 " " RAT_FUNC "%.0" "us" COEFFS 0 20 0 0 0 1 /end COMPU_METHOD
/begin MEASUREMENT CRI_width_post2 "Post 2 injection pulse-width" ULONG Compu_CRI_width_post2 0 0 0 214748364.75 ECU_ADDRESS 0x01008910 /end MEASUREMENT
/begin COMPU_METHOD Compu_CRI_width_post2 " " RAT_FUNC "%.0" "us" COEFFS 0 20 0 0 0 1 /end COMPU_METHOD
/begin MEASUREMENT CRI_mg_load "Final fuel load" SWORD Compu_CRI_mg_load 0 0 -1024 1023.96875 ECU_ADDRESS 0x01008920 /end MEASUREMENT
/begin COMPU_METHOD Compu_CRI_mg_load " " RAT_FUNC "%.1" "mg/cyl" COEFFS 0 32 0 0 0 1 /end COMPU_METHOD
/begin MEASUREMENT CRI_mg_total "Total fuel" SWORD Compu_CRI_mg_total 0 0 -1024 1023.96875 ECU_ADDRESS 0x010089D8 /end MEASUREMENT
/begin COMPU_METHOD Compu_CRI_mg_total " " RAT_FUNC "%.1" "mg/cyl" COEFFS 0 32 0 0 0 1 /end COMPU_METHOD
/begin MEASUREMENT load_cmd_pct "Final load command" UWORD Compu_load_cmd_pct 0 0 0 99.9984741210938 ECU_ADDRESS 0x01008C18 /end MEASUREMENT
/begin COMPU_METHOD Compu_load_cmd_pct " " RAT_FUNC "%.1" "%" COEFFS 0 655.36 0 0 0 1 /end COMPU_METHOD
/begin MEASUREMENT spk_off_BP "BP Adv Offset" SWORD Compu_spk_off_BP 0 0 -2048 2047.9375 ECU_ADDRESS 0x01008CA0 /end MEASUREMENT
/begin COMPU_METHOD Compu_spk_off_BP " " RAT_FUNC "%.1" "CAD BTDC" COEFFS 0 16 0 0 0 1 /end COMPU_METHOD
/begin CHARACTERISTIC CAC_dP_C "CAC flow rate delta-P scaling" VALUE 0x001c3a68 /* @ECU_Address@CAC_dP_C@0x01009270@ */ ECIPP_ALIGNMENT_FLOAT32_IEEE 10000000000 Compu_CAC_dP_C -10000000000 10000000000 /end CHARACTERISTIC
/begin COMPU_METHOD Compu_CAC_dP_C " " RAT_FUNC "%.1" "upsig * s^2 / g / L" COEFFS 0 0.000001 0 0 0 1 /end COMPU_METHOD
/begin CHARACTERISTIC CAC_dP_nom "CAC nominal delta-P" VALUE 0x001c3a6c /* @ECU_Address@CAC_dP_nom@0x01009280@ */ ECIPP_ALIGNMENT_FLOAT32_IEEE 10000000000 Compu_CAC_dP_nom -10000000000 10000000000 /end CHARACTERISTIC
/begin COMPU_METHOD Compu_CAC_dP_nom " " RAT_FUNC "%.2" "psig" COEFFS 0 1 0 0 0 1 /end COMPU_METHOD
/begin CHARACTERISTIC CAC_eta_nom "CAC nominal efficiency" VALUE 0x001c3a70 /* @ECU_Address@CAC_eta_nom@0x01009298@ */ ECIPP_ALIGNMENT_FLOAT32_IEEE 10000000000 Compu_CAC_eta_nom -10000000000 10000000000 /end CHARACTERISTIC
/begin COMPU_METHOD Compu_CAC_eta_nom " " RAT_FUNC "%.1" "%" COEFFS 0 0.01 0 0 0 1 /end COMPU_METHOD
/begin MEASUREMENT TC_comp_eta "Compressor efficiency" UWORD Compu_TC_comp_eta 0 0 0 399.993896484375 ECU_ADDRESS 0x010092A8 /end MEASUREMENT
/begin COMPU_METHOD Compu_TC_comp_eta " " RAT_FUNC "%.1" "%" COEFFS 0 163.84 0 0 0 1 /end COMPU_METHOD
/begin MEASUREMENT CAC_eta "CAC actual efficiency" FLOAT32_IEEE Compu_CAC_eta 0 0 -10000000000 10000000000 ECU_ADDRESS 0x010092B8 /end MEASUREMENT
/begin COMPU_METHOD Compu_CAC_eta " " RAT_FUNC "%.1" "%" COEFFS 0 0.01 0 0 0 1 /end COMPU_METHOD
/begin MEASUREMENT CIP "Compressor inlet press" UWORD Compu_CIP 0 0 0 255.99609375 ECU_ADDRESS 0x010092C8 /end MEASUREMENT
/begin COMPU_METHOD Compu_CIP " " RAT_FUNC "%.2" "psia" COEFFS 0 256 0 0 0 1 /end COMPU_METHOD
/begin MEASUREMENT COP "Compressor outlet press" UWORD Compu_COP 0 0 0 255.99609375 ECU_ADDRESS 0x010092D0 /end MEASUREMENT
/begin COMPU_METHOD Compu_COP " " RAT_FUNC "%.2" "psia" COEFFS 0 256 0 0 0 1 /end COMPU_METHOD
/begin MEASUREMENT COT "Compressor outlet temp" UWORD Compu_COT 0 0 -460 7731.875 ECU_ADDRESS 0x01009308 /end MEASUREMENT
/begin COMPU_METHOD Compu_COT " " RAT_FUNC "%.1" "deg F" COEFFS 0 8 3680 0 0 1 /end COMPU_METHOD
/begin MEASUREMENT TOT_mdl "Turbine Tout estimate" UWORD Compu_TOT_mdl 0 0 -460 7731.875 ECU_ADDRESS 0x01009318 /end MEASUREMENT
/begin COMPU_METHOD Compu_TOT_mdl " " RAT_FUNC "%.1" "deg F" COEFFS 0 8 3680 0 0 1 /end COMPU_METHOD
/begin CHARACTERISTIC SMK_mode "Smoke control mode{SMK_mode&0xff=0:Disabled}{SMK_mode&0xff=1:Enabled}" VALUE 0x001f1a80 /* @ECU_Address@SMK_mode@0x010094B0@ */ ECIPP_ALIGNMENT_UBYTE 255 SMK_mode_COMPU_VTAB 0 255 BIT_MASK 0xff /end CHARACTERISTIC
/begin COMPU_METHOD SMK_mode_COMPU_VTAB "Verbal Table" TAB_VERB "%.0" "list" COMPU_TAB_REF SMK_mode_COMPU_VTAB_REF /end COMPU_METHOD
/begin COMPU_VTAB SMK_mode_COMPU_VTAB_REF "Verbal Table" TAB_VERB 2 0 "Disabled" 1 "Enabled" DEFAULT_VALUE "UNKNOWN" /end COMPU_VTAB
/begin MEASUREMENT TC_comp_mdotc "Compressor (corrected) flow" UWORD Compu_TC_comp_mdotc 0 0 0 1023.984375 ECU_ADDRESS 0x010097D8 /end MEASUREMENT
/begin COMPU_METHOD Compu_TC_comp_mdotc " " RAT_FUNC "%.1" "g/sec" COEFFS 0 64 0 0 0 1 /end COMPU_METHOD
/begin MEASUREMENT TC_comp_Pratio "Compressor press ratio" UWORD Compu_TC_comp_Pratio 0 0 0 31.99951171875 ECU_ADDRESS 0x010097E8 /end MEASUREMENT
/begin COMPU_METHOD Compu_TC_comp_Pratio " " RAT_FUNC "%.2" "-" COEFFS 0 2048 0 0 0 1 /end COMPU_METHOD
/begin MEASUREMENT TC_turb_Pratio "Turbine press ratio" UWORD Compu_TC_turb_Pratio 0 0 0 31.99951171875 ECU_ADDRESS 0x010097F0 /end MEASUREMENT
/begin COMPU_METHOD Compu_TC_turb_Pratio " " RAT_FUNC "%.2" "-" COEFFS 0 2048 0 0 0 1 /end COMPU_METHOD
/begin CHARACTERISTIC TC_comp_Tint_tau_nom "Turbo nominal tau - compressor T" VALUE 0x001c3b90 /* @ECU_Address@TC_comp_Tint_tau_nom@0x01009830@ */ ECIPP_ALIGNMENT_FLOAT32_IEEE 10000000000 Compu_TC_comp_Tint_tau_nom -10000000000 10000000000 /end CHARACTERISTIC
/begin COMPU_METHOD Compu_TC_comp_Tint_tau_nom " " RAT_FUNC "%.1" "sec" COEFFS 0 1000 0 0 0 1 /end COMPU_METHOD
/begin CHARACTERISTIC TC_turb_Tint_tau_nom "Turbo nominal tau - turbine T" VALUE 0x001c3ba0 /* @ECU_Address@TC_turb_Tint_tau_nom@0x01009838@ */ ECIPP_ALIGNMENT_FLOAT32_IEEE 10000000000 Compu_TC_turb_Tint_tau_nom -10000000000 10000000000 /end CHARACTERISTIC
/begin COMPU_METHOD Compu_TC_turb_Tint_tau_nom " " RAT_FUNC "%.1" "sec" COEFFS 0 1000 0 0 0 1 /end COMPU_METHOD
/begin CHARACTERISTIC TC_mdot_avg_tau "Turbo heat transfer flow low-pass" VALUE 0x001c3b94 /* @ECU_Address@TC_mdot_avg_tau@0x01009840@ */ ECIPP_ALIGNMENT_FLOAT32_IEEE 10000000000 Compu_TC_mdot_avg_tau -10000000000 10000000000 /end CHARACTERISTIC
/begin COMPU_METHOD Compu_TC_mdot_avg_tau " " RAT_FUNC "%.1" "sec" COEFFS 0 1000 0 0 0 1 /end COMPU_METHOD
/begin CHARACTERISTIC TC_mdot_nom "Turbo heat transfer reference flow" VALUE 0x001c8086 /* @ECU_Address@TC_mdot_nom@0x01009848@ */ ECIPP_ALIGNMENT_UWORD 1024 Compu_TC_mdot_nom 0 1023.984375 /end CHARACTERISTIC
/begin COMPU_METHOD Compu_TC_mdot_nom " " RAT_FUNC "%.1" "g/sec" COEFFS 0 64 0 0 0 1 /end COMPU_METHOD
/begin CHARACTERISTIC TC_mech_eta "Turbo mechanical efficiency" VALUE 0x001c8088 /* @ECU_Address@TC_mech_eta@0x01009850@ */ ECIPP_ALIGNMENT_UWORD 200 Compu_TC_mech_eta 0 199.996948242188 /end CHARACTERISTIC
/begin COMPU_METHOD Compu_TC_mech_eta " " RAT_FUNC "%.1" "%" COEFFS 0 327.68 0 0 0 1 /end COMPU_METHOD
/begin CHARACTERISTIC TC_comp_A_emiss "Turbo area*emissivity - compressor" VALUE 0x001c3b88 /* @ECU_Address@TC_comp_A_emiss@0x01009858@ */ ECIPP_ALIGNMENT_FLOAT32_IEEE 10000000000 Compu_TC_comp_A_emiss -10000000000 10000000000 /end CHARACTERISTIC
/begin COMPU_METHOD Compu_TC_comp_A_emiss " " RAT_FUNC "%.1" "in^2" COEFFS 0 1 0 0 0 1 /end COMPU_METHOD
/begin CHARACTERISTIC TC_turb_A_emiss "Turbo area*emissivity - turbine" VALUE 0x001c3b98 /* @ECU_Address@TC_turb_A_emiss@0x01009860@ */ ECIPP_ALIGNMENT_FLOAT32_IEEE 10000000000 Compu_TC_turb_A_emiss -10000000000 10000000000 /end CHARACTERISTIC
/begin COMPU_METHOD Compu_TC_turb_A_emiss " " RAT_FUNC "%.1" "in^2" COEFFS 0 1 0 0 0 1 /end COMPU_METHOD
/begin CHARACTERISTIC TC_comp_C_thermal "Turbo thermal capacitance - compressor" VALUE 0x001c3b8c /* @ECU_Address@TC_comp_C_thermal@0x01009868@ */ ECIPP_ALIGNMENT_FLOAT32_IEEE 10000000000 Compu_TC_comp_C_thermal -10000000000 10000000000 /end CHARACTERISTIC
/begin COMPU_METHOD Compu_TC_comp_C_thermal " " RAT_FUNC "%.0" "J/deg F" COEFFS 0 1 0 0 0 1 /end COMPU_METHOD
/begin CHARACTERISTIC TC_turb_C_thermal "Turbo thermal capacitance - turbine" VALUE 0x001c3b9c /* @ECU_Address@TC_turb_C_thermal@0x01009870@ */ ECIPP_ALIGNMENT_FLOAT32_IEEE 10000000000 Compu_TC_turb_C_thermal -10000000000 10000000000 /end CHARACTERISTIC
/begin COMPU_METHOD Compu_TC_turb_C_thermal " " RAT_FUNC "%.0" "J/deg F" COEFFS 0 1 0 0 0 1 /end COMPU_METHOD
/begin MEASUREMENT TC_surge_Pratio "Turbo surge pressure ratio" UWORD Compu_TC_surge_Pratio 0 0 0 31.99951171875 ECU_ADDRESS 0x010098B8 /end MEASUREMENT
/begin COMPU_METHOD Compu_TC_surge_Pratio " " RAT_FUNC "%.2" "-" COEFFS 0 2048 0 0 0 1 /end COMPU_METHOD
/begin MEASUREMENT bst_Ptarg_P "Delta-P or TIP target" UWORD Compu_bst_Ptarg_P 0 0 0 255.99609375 ECU_ADDRESS 0x01009F58 /end MEASUREMENT
/begin COMPU_METHOD Compu_bst_Ptarg_P " " RAT_FUNC "%.2" "psi" COEFFS 0 256 0 0 0 1 /end COMPU_METHOD
/begin MEASUREMENT bst_TIP_Iacc_low "TIP integrator low{bst_TIP_Iacc_low&0x0080=0:NO}{bst_TIP_Iacc_low&0x0080=0x0080:YES}" UWORD bst_TIP_Iacc_low_COMPU_VTAB 0 0 0 65535 ECU_ADDRESS 0x01009F60 BIT_MASK 0x0080 /end MEASUREMENT
/begin COMPU_METHOD bst_TIP_Iacc_low_COMPU_VTAB "Verbal Table" TAB_VERB "%.0" "list" COMPU_TAB_REF bst_TIP_Iacc_low_COMPU_VTAB_REF /end COMPU_METHOD
/begin COMPU_VTAB bst_TIP_Iacc_low_COMPU_VTAB_REF "Verbal Table" TAB_VERB 2 0 "NO" 0x0080 "YES" DEFAULT_VALUE "UNKNOWN" /end COMPU_VTAB
/begin MEASUREMENT bst_TIP_Iacc_high "TIP integrator high{bst_TIP_Iacc_high&0x0040=0:NO}{bst_TIP_Iacc_high&0x0040=0x0040:YES}" UWORD bst_TIP_Iacc_high_COMPU_VTAB 0 0 0 65535 ECU_ADDRESS 0x01009F68 BIT_MASK 0x0040 /end MEASUREMENT
/begin COMPU_METHOD bst_TIP_Iacc_high_COMPU_VTAB "Verbal Table" TAB_VERB "%.0" "list" COMPU_TAB_REF bst_TIP_Iacc_high_COMPU_VTAB_REF /end COMPU_METHOD
/begin COMPU_VTAB bst_TIP_Iacc_high_COMPU_VTAB_REF "Verbal Table" TAB_VERB 2 0 "NO" 0x0040 "YES" DEFAULT_VALUE "UNKNOWN" /end COMPU_VTAB
/begin MEASUREMENT bst_WGPa "WGP | EMP actual" UWORD Compu_bst_WGPa 0 0 0 255.99609375 ECU_ADDRESS 0x01009F90 /end MEASUREMENT
/begin COMPU_METHOD Compu_bst_WGPa " " RAT_FUNC "%.2" "psig | psia" COEFFS 0 256 0 0 0 1 /end COMPU_METHOD
/begin MEASUREMENT m_a_port_cmd "Air mass command" UWORD Compu_m_a_port_cmd 0 0 0 16383.75 ECU_ADDRESS 0x01009FB0 /end MEASUREMENT
/begin COMPU_METHOD Compu_m_a_port_cmd " " RAT_FUNC "%.0" "mg/intake" COEFFS 0 4 0 0 0 1 /end COMPU_METHOD
/begin CHARACTERISTIC TC_N_mode "Turbo speed measurement input{TC_N_mode&0xff=0:Estimate}{TC_N_mode&0xff=1:Pulse in}{TC_N_mode&0xff=2:Roadspeed}" VALUE 0x001c8f1a /* @ECU_Address@TC_N_mode@0x0100A040@ */ ECIPP_ALIGNMENT_UBYTE 255 TC_N_mode_COMPU_VTAB 0 255 BIT_MASK 0xff /end CHARACTERISTIC
/begin COMPU_METHOD TC_N_mode_COMPU_VTAB "Verbal Table" TAB_VERB "%.0" "list" COMPU_TAB_REF TC_N_mode_COMPU_VTAB_REF /end COMPU_METHOD
/begin COMPU_VTAB TC_N_mode_COMPU_VTAB_REF "Verbal Table" TAB_VERB 3 0 "Estimate" 1 "Pulse in" 2 "Roadspeed" DEFAULT_VALUE "UNKNOWN" /end COMPU_VTAB
/begin CHARACTERISTIC TC_N_PWM_edge "Turbo speed edge capture{TC_N_PWM_edge&0xff=0:Rising edge}{TC_N_PWM_edge&0xff=1:Falling edge}" VALUE 0x001c8f19 /* @ECU_Address@TC_N_PWM_edge@0x0100A048@ */ ECIPP_ALIGNMENT_UBYTE 255 TC_N_PWM_edge_COMPU_VTAB 0 255 BIT_MASK 0xff /end CHARACTERISTIC
/begin COMPU_METHOD TC_N_PWM_edge_COMPU_VTAB "Verbal Table" TAB_VERB "%.0" "list" COMPU_TAB_REF TC_N_PWM_edge_COMPU_VTAB_REF /end COMPU_METHOD
/begin COMPU_VTAB TC_N_PWM_edge_COMPU_VTAB_REF "Verbal Table" TAB_VERB 2 0 "Rising edge" 1 "Falling edge" DEFAULT_VALUE "UNKNOWN" /end COMPU_VTAB
/begin CHARACTERISTIC TC_N_PWM_periods "Turbo speed window" VALUE 0x001c8070 /* @ECU_Address@TC_N_PWM_periods@0x0100A050@ */ ECIPP_ALIGNMENT_UWORD 65535 Compu_TC_N_PWM_periods 0 65535 /end CHARACTERISTIC
/begin COMPU_METHOD Compu_TC_N_PWM_periods " " RAT_FUNC "%.0" "PWM periods" COEFFS 0 1 0 0 0 1 /end COMPU_METHOD
/begin CHARACTERISTIC TC_N_tau "Turbo speed low-pass tau" VALUE 0x001c85d0 /* @ECU_Address@TC_N_tau@0x0100A058@ */ ECIPP_ALIGNMENT_UWORD 327680 Compu_TC_N_tau 0.45084 327680 /end CHARACTERISTIC
/begin COMPU_METHOD Compu_TC_N_tau " " FORM "%.1" "ms"
 /begin FORMULA "-5 / log(1 - (X1 / 65536))" FORMULA_INV "(1 - exp(-5/X1)) * 65536" /end FORMULA
/end COMPU_METHOD
/begin CHARACTERISTIC TC_N_pulses_rev "Turbo speed scaling divisor" VALUE 0x001c3b84 /* @ECU_Address@TC_N_pulses_rev@0x0100A060@ */ ECIPP_ALIGNMENT_FLOAT32_IEEE 10000000000 Compu_TC_N_pulses_rev -10000000000 10000000000 /end CHARACTERISTIC
/begin COMPU_METHOD Compu_TC_N_pulses_rev " " RAT_FUNC "%.3" "pulses/rev" COEFFS 0 1 0 0 0 1 /end COMPU_METHOD
/begin MEASUREMENT pulse_Hz_capture "Pulse-in Hz capture available{pulse_Hz_capture&0xff=0:NO}{pulse_Hz_capture&0xff=1:YES}" UBYTE pulse_Hz_capture_COMPU_VTAB 0 0 0 255 ECU_ADDRESS 0x0100A068 BIT_MASK 0xff /end MEASUREMENT
/begin COMPU_METHOD pulse_Hz_capture_COMPU_VTAB "Verbal Table" TAB_VERB "%.0" "list" COMPU_TAB_REF pulse_Hz_capture_COMPU_VTAB_REF /end COMPU_METHOD
/begin COMPU_VTAB pulse_Hz_capture_COMPU_VTAB_REF "Verbal Table" TAB_VERB 2 0 "NO" 1 "YES" DEFAULT_VALUE "UNKNOWN" /end COMPU_VTAB
/begin MEASUREMENT rs_Hz_capture "Roadpseed Hz capture available{rs_Hz_capture&0xff=0:NO}{rs_Hz_capture&0xff=1:YES}" UBYTE rs_Hz_capture_COMPU_VTAB 0 0 0 255 ECU_ADDRESS 0x0100A070 BIT_MASK 0xff /end MEASUREMENT
/begin COMPU_METHOD rs_Hz_capture_COMPU_VTAB "Verbal Table" TAB_VERB "%.0" "list" COMPU_TAB_REF rs_Hz_capture_COMPU_VTAB_REF /end COMPU_METHOD
/begin COMPU_VTAB rs_Hz_capture_COMPU_VTAB_REF "Verbal Table" TAB_VERB 2 0 "NO" 1 "YES" DEFAULT_VALUE "UNKNOWN" /end COMPU_VTAB
/begin MEASUREMENT CRI_smk_lmt_mg "Smoke fuel limit" SWORD Compu_CRI_smk_lmt_mg 0 0 -1024 1023.96875 ECU_ADDRESS 0x0100A0D0 /end MEASUREMENT
/begin COMPU_METHOD Compu_CRI_smk_lmt_mg " " RAT_FUNC "%.1" "mg/cyl" COEFFS 0 32 0 0 0 1 /end COMPU_METHOD
/begin MEASUREMENT CRI_smk_adjust_mg "Smoke fuel adjustment" SWORD Compu_CRI_smk_adjust_mg 0 0 -1024 1023.96875 ECU_ADDRESS 0x0100A0D8 /end MEASUREMENT
/begin COMPU_METHOD Compu_CRI_smk_adjust_mg " " RAT_FUNC "%.1" "mg/cyl" COEFFS 0 32 0 0 0 1 /end COMPU_METHOD
/begin MEASUREMENT CRI_smk_lmt_active "Smoke limiting active{CRI_smk_lmt_active&0xff=0:NO}{CRI_smk_lmt_active&0xff=1:YES}" UBYTE CRI_smk_lmt_active_COMPU_VTAB 0 0 0 255 ECU_ADDRESS 0x0100A0E0 BIT_MASK 0xff /end MEASUREMENT
/begin COMPU_METHOD CRI_smk_lmt_active_COMPU_VTAB "Verbal Table" TAB_VERB "%.0" "list" COMPU_TAB_REF CRI_smk_lmt_active_COMPU_VTAB_REF /end COMPU_METHOD
/begin COMPU_VTAB CRI_smk_lmt_active_COMPU_VTAB_REF "Verbal Table" TAB_VERB 2 0 "NO" 1 "YES" DEFAULT_VALUE "UNKNOWN" /end COMPU_VTAB
/begin CHARACTERISTIC SMK_lmt_persist_min "Smoke limiting persistence" VALUE 0x001f1958 /* @ECU_Address@SMK_lmt_persist_min@0x0100A148@ */ ECIPP_ALIGNMENT_UWORD 66 Compu_SMK_lmt_persist_min 0 65.535 /end CHARACTERISTIC
/begin COMPU_METHOD Compu_SMK_lmt_persist_min " " RAT_FUNC "%.1" "sec" COEFFS 0 1000 0 0 0 1 /end COMPU_METHOD
/begin MEASUREMENT TC_comp_Tint "Compressor internal temp" FLOAT32_IEEE Compu_TC_comp_Tint 0 0 -10000000000 10000000000 ECU_ADDRESS 0x0100A240 /end MEASUREMENT
/begin COMPU_METHOD Compu_TC_comp_Tint " " RAT_FUNC "%.1" "deg F" COEFFS 0 1 460 0 0 1 /end COMPU_METHOD
/begin MEASUREMENT TC_turb_Tint "Turbine internal temp" FLOAT32_IEEE Compu_TC_turb_Tint 0 0 -10000000000 10000000000 ECU_ADDRESS 0x0100A248 /end MEASUREMENT
/begin COMPU_METHOD Compu_TC_turb_Tint " " RAT_FUNC "%.1" "deg F" COEFFS 0 1 460 0 0 1 /end COMPU_METHOD
/begin CHARACTERISTIC bst_WGAcmd_FF "WGP feedforward command pt" VALUE 0x001c83ac /* @ECU_Address@bst_WGAcmd_FF@0x0100A268@ */ ECIPP_ALIGNMENT_UWORD 100 Compu_bst_WGAcmd_FF 0 99.9984741210938 /end CHARACTERISTIC
/begin COMPU_METHOD Compu_bst_WGAcmd_FF " " RAT_FUNC "%.1" "%" COEFFS 0 655.36 0 0 0 1 /end COMPU_METHOD
/begin MEASUREMENT EMP "EMP" UWORD Compu_EMP 0 0 0 255.99609375 ECU_ADDRESS 0x0100A298 /end MEASUREMENT
/begin COMPU_METHOD Compu_EMP " " RAT_FUNC "%.2" "psia" COEFFS 0 256 0 0 0 1 /end COMPU_METHOD
/begin MEASUREMENT manual_air_mode "Manual air mode{manual_air_mode&0xff=0:Inactive}{manual_air_mode&0xff=1:m_a_port_cmd}{manual_air_mode&0xff=2:mdot_ports_cmd}{manual_air_mode&0xff=3:TC_comp_mdotc}{manual_air_mode&0xff=4:TC_turb_mdotc}{manual_air_mode&0xff=5:MAP command}" UBYTE manual_air_mode_COMPU_VTAB 0 0 0 255 ECU_ADDRESS 0x0100A2A0 BIT_MASK 0xff /end MEASUREMENT
/begin COMPU_METHOD manual_air_mode_COMPU_VTAB "Verbal Table" TAB_VERB "%.0" "list" COMPU_TAB_REF manual_air_mode_COMPU_VTAB_REF /end COMPU_METHOD
/begin COMPU_VTAB manual_air_mode_COMPU_VTAB_REF "Verbal Table" TAB_VERB 6 0 "Inactive" 1 "m_a_port_cmd" 2 "mdot_ports_cmd" 3 "TC_comp_mdotc" 4 "TC_turb_mdotc" 5 "MAP command" DEFAULT_VALUE "UNKNOWN" /end COMPU_VTAB
/begin MEASUREMENT manual_air_cmd "Manual air target" FLOAT32_IEEE Compu_manual_air_cmd 0 0 -10000000000 10000000000 ECU_ADDRESS 0x0100A2B8 /end MEASUREMENT
/begin COMPU_METHOD Compu_manual_air_cmd " " RAT_FUNC "%.2" "-" COEFFS 0 1 0 0 0 1 /end COMPU_METHOD
/begin MEASUREMENT CRI_mg_load_nosmk "Nominal fuel load" SWORD Compu_CRI_mg_load_nosmk 0 0 -1024 1023.96875 ECU_ADDRESS 0x0100A650 /end MEASUREMENT
/begin COMPU_METHOD Compu_CRI_mg_load_nosmk " " RAT_FUNC "%.1" "mg/cyl" COEFFS 0 32 0 0 0 1 /end COMPU_METHOD
/begin CHARACTERISTIC TC_comp_eta_surge "Compressor efficiency - surge" VALUE 0x001c807e /* @ECU_Address@TC_comp_eta_surge@0x0100B4E0@ */ ECIPP_ALIGNMENT_UWORD 400 Compu_TC_comp_eta_surge 0 399.993896484375 /end CHARACTERISTIC
/begin COMPU_METHOD Compu_TC_comp_eta_surge " " RAT_FUNC "%.1" "%" COEFFS 0 163.84 0 0 0 1 /end COMPU_METHOD
/begin CHARACTERISTIC TC_comp_eta_choke "Compressor efficiency - choked" VALUE 0x001c807c /* @ECU_Address@TC_comp_eta_choke@0x0100B4E8@ */ ECIPP_ALIGNMENT_UWORD 400 Compu_TC_comp_eta_choke 0 399.993896484375 /end CHARACTERISTIC
/begin COMPU_METHOD Compu_TC_comp_eta_choke " " RAT_FUNC "%.1" "%" COEFFS 0 163.84 0 0 0 1 /end COMPU_METHOD
/begin CHARACTERISTIC TC_comp_Pratio_min "Compressor min surge press ratio" VALUE 0x001c8074 /* @ECU_Address@TC_comp_Pratio_min@0x0100B4F0@ */ ECIPP_ALIGNMENT_UWORD 32 Compu_TC_comp_Pratio_min 0 31.99951171875 /end CHARACTERISTIC
/begin COMPU_METHOD Compu_TC_comp_Pratio_min " " RAT_FUNC "%.2" "-" COEFFS 0 2048 0 0 0 1 /end COMPU_METHOD
/begin MEASUREMENT TC_comp_etamax "Compressor max efficiency" UWORD Compu_TC_comp_etamax 0 0 0 399.993896484375 ECU_ADDRESS 0x0100B508 /end MEASUREMENT
/begin COMPU_METHOD Compu_TC_comp_etamax " " RAT_FUNC "%.1" "%" COEFFS 0 163.84 0 0 0 1 /end COMPU_METHOD
/begin MEASUREMENT TC_comp_mdot_margin "Compressor surge-choke margin" SWORD Compu_TC_comp_mdot_margin 0 0 -200 199.993896484375 ECU_ADDRESS 0x0100B510 /end MEASUREMENT
/begin COMPU_METHOD Compu_TC_comp_mdot_margin " " RAT_FUNC "%.1" "%" COEFFS 0 163.84 0 0 0 1 /end COMPU_METHOD
/begin MEASUREMENT TC_N_actual "Turbo actual speed" ULONG Compu_TC_N_actual 0 0 0 1023.99999976158 ECU_ADDRESS 0x0100B528 /end MEASUREMENT
/begin COMPU_METHOD Compu_TC_N_actual " " RAT_FUNC "%.1" "Krpm" COEFFS 0 4194304 0 0 0 1 /end COMPU_METHOD
/begin CHARACTERISTIC TC_comp_mdotr_Ld "Compressor reference flow per liter" VALUE 0x001c8084 /* @ECU_Address@TC_comp_mdotr_Ld@0x0100B930@ */ ECIPP_ALIGNMENT_UWORD 1024 Compu_TC_comp_mdotr_Ld 0 1023.984375 /end CHARACTERISTIC
/begin COMPU_METHOD Compu_TC_comp_mdotr_Ld " " RAT_FUNC "%.1" "g/sec/Ld" COEFFS 0 64 0 0 0 1 /end COMPU_METHOD
/begin CHARACTERISTIC TC_comp_Nr "Compressor reference speed" VALUE 0x001c8072 /* @ECU_Address@TC_comp_Nr@0x0100B938@ */ ECIPP_ALIGNMENT_UWORD 1024 Compu_TC_comp_Nr 0 1023.984375 /end CHARACTERISTIC
/begin COMPU_METHOD Compu_TC_comp_Nr " " RAT_FUNC "%.1" "Krpm" COEFFS 0 64 0 0 0 1 /end COMPU_METHOD
/begin MEASUREMENT bst_WGAact "WGP control loop feedback" UWORD Compu_bst_WGAact 0 0 0 99.9984741210938 ECU_ADDRESS 0x0100B9B0 /end MEASUREMENT
/begin COMPU_METHOD Compu_bst_WGAact " " RAT_FUNC "%.1" "%" COEFFS 0 655.36 0 0 0 1 /end COMPU_METHOD
/begin CHARACTERISTIC bst_WGAact_tau "Boost WGA command->actual" VALUE 0x001c8652 /* @ECU_Address@bst_WGAact_tau@0x0100B9B8@ */ ECIPP_ALIGNMENT_UWORD 65536 Compu_bst_WGAact_tau 0.090168 65536 /end CHARACTERISTIC
/begin COMPU_METHOD Compu_bst_WGAact_tau " " FORM "%.1" "ms"
 /begin FORMULA "-1 / log(1 - (X1 / 65536))" FORMULA_INV "(1 - exp(-1/X1)) * 65536" /end FORMULA
/end COMPU_METHOD
/begin MEASUREMENT TC_comp_Nc "Compressor corrected speed" UWORD Compu_TC_comp_Nc 0 0 0 1023.984375 ECU_ADDRESS 0x0100B9C0 /end MEASUREMENT
/begin COMPU_METHOD Compu_TC_comp_Nc " " RAT_FUNC "%.1" "Krpm" COEFFS 0 64 0 0 0 1 /end COMPU_METHOD
/begin MEASUREMENT TC_comp_Npct "Compressor corrected speed" UWORD Compu_TC_comp_Npct 0 0 0 399.993896484375 ECU_ADDRESS 0x0100B9D8 /end MEASUREMENT
/begin COMPU_METHOD Compu_TC_comp_Npct " " RAT_FUNC "%.1" "% ref" COEFFS 0 163.84 0 0 0 1 /end COMPU_METHOD
/begin MEASUREMENT TC_comp_mdotr "Compressor reference flow" UWORD Compu_TC_comp_mdotr 0 0 0 1023.984375 ECU_ADDRESS 0x0100BA18 /end MEASUREMENT
/begin COMPU_METHOD Compu_TC_comp_mdotr " " RAT_FUNC "%.1" "g/sec" COEFFS 0 64 0 0 0 1 /end COMPU_METHOD
/begin MEASUREMENT CB1pre_volts "Bank 1 pre-cat sensor voltage" UWORD Compu_CB1pre_volts 0 0 0 15.999755859375 ECU_ADDRESS 0x0100CFD8 /end MEASUREMENT
/begin COMPU_METHOD Compu_CB1pre_volts " " RAT_FUNC "%.3" "volts" COEFFS 0 4096 0 0 0 1 /end COMPU_METHOD
/begin MEASUREMENT CB1pst_volts "Bank 1 post-cat sensor voltage" UWORD Compu_CB1pst_volts 0 0 0 15.999755859375 ECU_ADDRESS 0x0100CFE0 /end MEASUREMENT
/begin COMPU_METHOD Compu_CB1pst_volts " " RAT_FUNC "%.3" "volts" COEFFS 0 4096 0 0 0 1 /end COMPU_METHOD
/begin MEASUREMENT CB2pre_volts "Bank 2 pre-cat sensor voltage" UWORD Compu_CB2pre_volts 0 0 0 15.999755859375 ECU_ADDRESS 0x0100CFE8 /end MEASUREMENT
/begin COMPU_METHOD Compu_CB2pre_volts " " RAT_FUNC "%.3" "volts" COEFFS 0 4096 0 0 0 1 /end COMPU_METHOD
/begin MEASUREMENT CB2pst_volts "Bank 2 post-cat sensor voltage" UWORD Compu_CB2pst_volts 0 0 0 15.999755859375 ECU_ADDRESS 0x0100CFF0 /end MEASUREMENT
/begin COMPU_METHOD Compu_CB2pst_volts " " RAT_FUNC "%.3" "volts" COEFFS 0 4096 0 0 0 1 /end COMPU_METHOD
/begin MEASUREMENT MAP_load "MAP load" UWORD Compu_MAP_load 0 0 0 255.99609375 ECU_ADDRESS 0x0100D2B8 /end MEASUREMENT
/begin COMPU_METHOD Compu_MAP_load " " RAT_FUNC "%.2" "psia" COEFFS 0 256 0 0 0 1 /end COMPU_METHOD
/begin MEASUREMENT DATE_engine_mfg "Engine manufacture date" ULONG Compu_DATE_engine_mfg 0 0 0 4294967295 ECU_ADDRESS 0x0100D910 /end MEASUREMENT
/begin COMPU_METHOD Compu_DATE_engine_mfg " " RAT_FUNC "%.0" "-" COEFFS 0 1 0 0 0 1 /end COMPU_METHOD
/begin MEASUREMENT TEI_total_pct "TEI total engagement" UWORD Compu_TEI_total_pct 0 0 0 99.9984741210938 ECU_ADDRESS 0x0100DEC8 /end MEASUREMENT
/begin COMPU_METHOD Compu_TEI_total_pct " " RAT_FUNC "%.1" "%" COEFFS 0 655.36 0 0 0 1 /end COMPU_METHOD
/begin MEASUREMENT TEI_EGR_minnom "Current TEI EGR min/nom select" SWORD Compu_TEI_EGR_minnom 0 0 -2 1.99993896484375 ECU_ADDRESS 0x0100DED0 /end MEASUREMENT
/begin COMPU_METHOD Compu_TEI_EGR_minnom " " RAT_FUNC "%.2" "-" COEFFS 0 16384 0 0 0 1 /end COMPU_METHOD
/begin MEASUREMENT bst_MAPd_load "Boost MAP load desired" UWORD Compu_bst_MAPd_load 0 0 0 255.99609375 ECU_ADDRESS 0x0100DFB0 /end MEASUREMENT
/begin COMPU_METHOD Compu_bst_MAPd_load " " RAT_FUNC "%.2" "psi" COEFFS 0 256 0 0 0 1 /end COMPU_METHOD
/begin MEASUREMENT EGR_TPSdP_min "EGR valve dP limiting TPSdP request" FLOAT32_IEEE Compu_EGR_TPSdP_min 0 0 -10000000000 10000000000 ECU_ADDRESS 0x0100E690 /end MEASUREMENT
/begin COMPU_METHOD Compu_EGR_TPSdP_min " " RAT_FUNC "%.2" "psi" COEFFS 0 1 0 0 0 1 /end COMPU_METHOD
/begin MEASUREMENT COT_mdl "Compressor outlet temp (model)" UWORD Compu_COT_mdl 0 0 -460 7731.875 ECU_ADDRESS 0x0100EF10 /end MEASUREMENT
/begin COMPU_METHOD Compu_COT_mdl " " RAT_FUNC "%.1" "deg F" COEFFS 0 8 3680 0 0 1 /end COMPU_METHOD
/begin CHARACTERISTIC bst_TPS_dmdot_ena "Boost TPS flow rate limiting{bst_TPS_dmdot_ena&0xff=0:Disabled}{bst_TPS_dmdot_ena&0xff=1:Enabled}" VALUE 0x001c8fa9 /* @ECU_Address@bst_TPS_dmdot_ena@0x0100F1F8@ */ ECIPP_ALIGNMENT_UBYTE 255 bst_TPS_dmdot_ena_COMPU_VTAB 0 255 BIT_MASK 0xff /end CHARACTERISTIC
/begin COMPU_METHOD bst_TPS_dmdot_ena_COMPU_VTAB "Verbal Table" TAB_VERB "%.0" "list" COMPU_TAB_REF bst_TPS_dmdot_ena_COMPU_VTAB_REF /end COMPU_METHOD
/begin COMPU_VTAB bst_TPS_dmdot_ena_COMPU_VTAB_REF "Verbal Table" TAB_VERB 2 0 "Disabled" 1 "Enabled" DEFAULT_VALUE "UNKNOWN" /end COMPU_VTAB
/begin CHARACTERISTIC bst_dmdot_inc "Boost TPS flow increasing limit" VALUE 0x001c3e00 /* @ECU_Address@bst_dmdot_inc@0x0100F200@ */ ECIPP_ALIGNMENT_FLOAT32_IEEE 10000000000 Compu_bst_dmdot_inc -10000000000 10000000000 /end CHARACTERISTIC
/begin COMPU_METHOD Compu_bst_dmdot_inc " " RAT_FUNC "%.1" "g/sec/sec" COEFFS 0 1 0 0 0 1 /end COMPU_METHOD
/begin CHARACTERISTIC bst_dCdA_margin "Boost TPS flow CdA lower limit" VALUE 0x001c3dfc /* @ECU_Address@bst_dCdA_margin@0x0100F208@ */ ECIPP_ALIGNMENT_FLOAT32_IEEE 10000000000 Compu_bst_dCdA_margin -10000000000 10000000000 /end CHARACTERISTIC
/begin COMPU_METHOD Compu_bst_dCdA_margin " " RAT_FUNC "%.1" "% max CdA" COEFFS 0 0.01 0 0 0 1 /end COMPU_METHOD
/begin MEASUREMENT bst_TPSd_raw "Boost TPS command pre-limiting" UWORD Compu_bst_TPSd_raw 0 0 0 99.9984741210938 ECU_ADDRESS 0x0100F210 /end MEASUREMENT
/begin COMPU_METHOD Compu_bst_TPSd_raw " " RAT_FUNC "%.1" "%" COEFFS 0 655.36 0 0 0 1 /end COMPU_METHOD
/begin CHARACTERISTIC TEI_BP_lo_off "TEI fully-disabled pressure = BP -" VALUE 0x001c80b6 /* @ECU_Address@TEI_BP_lo_off@0x0100F600@ */ ECIPP_ALIGNMENT_UWORD 256 Compu_TEI_BP_lo_off 0 255.99609375 /end CHARACTERISTIC
/begin COMPU_METHOD Compu_TEI_BP_lo_off " " RAT_FUNC "%.2" "psi" COEFFS 0 256 0 0 0 1 /end COMPU_METHOD
/begin CHARACTERISTIC TEI_BP_hi_on "TEI fully-enabled pressure = BP +" VALUE 0x001c80b4 /* @ECU_Address@TEI_BP_hi_on@0x0100F608@ */ ECIPP_ALIGNMENT_UWORD 256 Compu_TEI_BP_hi_on 0 255.99609375 /end CHARACTERISTIC
/begin COMPU_METHOD Compu_TEI_BP_hi_on " " RAT_FUNC "%.2" "psi" COEFFS 0 256 0 0 0 1 /end COMPU_METHOD
/begin CHARACTERISTIC reprog_security "Reprogramming Security{reprog_security&0xff=0:Disabled}{reprog_security&0xff=1:Match SW Model #}{reprog_security&0xff=2:Match SW Model # & Rev}" VALUE 0x001c9075 /* @ECU_Address@reprog_security@0x0100FC08@ */ ECIPP_ALIGNMENT_UBYTE 255 reprog_security_COMPU_VTAB 0 255 BIT_MASK 0xff /end CHARACTERISTIC
/begin COMPU_METHOD reprog_security_COMPU_VTAB "Verbal Table" TAB_VERB "%.0" "list" COMPU_TAB_REF reprog_security_COMPU_VTAB_REF /end COMPU_METHOD
/begin COMPU_VTAB reprog_security_COMPU_VTAB_REF "Verbal Table" TAB_VERB 3 0 "Disabled" 1 "Match SW Model #" 2 "Match SW Model # & Rev" DEFAULT_VALUE "UNKNOWN" /end COMPU_VTAB
/begin CHARACTERISTIC bst_appd_enabled "Approach delta control{bst_appd_enabled&0xff=0:Disabled}{bst_appd_enabled&0xff=1:Enabled - Upper and Lower}{bst_appd_enabled&0xff=2:Enabled - Upper only}{bst_appd_enabled&0xff=3:Enabled - Lower only}" VALUE 0x001c8fb1 /* @ECU_Address@bst_appd_enabled@0x0100FC98@ */ ECIPP_ALIGNMENT_UBYTE 255 bst_appd_enabled_COMPU_VTAB 0 255 BIT_MASK 0xff /end CHARACTERISTIC
/begin COMPU_METHOD bst_appd_enabled_COMPU_VTAB "Verbal Table" TAB_VERB "%.0" "list" COMPU_TAB_REF bst_appd_enabled_COMPU_VTAB_REF /end COMPU_METHOD
/begin COMPU_VTAB bst_appd_enabled_COMPU_VTAB_REF "Verbal Table" TAB_VERB 4 0 "Disabled" 1 "Enabled - Upper and Lower" 2 "Enabled - Upper only" 3 "Enabled - Lower only" DEFAULT_VALUE "UNKNOWN" /end COMPU_VTAB
/begin CHARACTERISTIC bst_appd_upr_delta "Upper approach delta" VALUE 0x001c83ba /* @ECU_Address@bst_appd_upr_delta@0x0100FCA0@ */ ECIPP_ALIGNMENT_UWORD 256 Compu_bst_appd_upr_delta 0 255.99609375 /end CHARACTERISTIC
/begin COMPU_METHOD Compu_bst_appd_upr_delta " " RAT_FUNC "%.2" "psi" COEFFS 0 256 0 0 0 1 /end COMPU_METHOD
/begin CHARACTERISTIC bst_appd_upr_slew "Upper approach slew down rate" VALUE 0x001c83bc /* @ECU_Address@bst_appd_upr_slew@0x0100FCB0@ */ ECIPP_ALIGNMENT_UWORD 1000 Compu_bst_appd_upr_slew 0 999.984741210938 /end CHARACTERISTIC
/begin COMPU_METHOD Compu_bst_appd_upr_slew " " RAT_FUNC "%.2" "psi/sec" COEFFS 0 65.536 0 0 0 1 /end COMPU_METHOD
/begin CHARACTERISTIC bst_appd_upr_slew_m "Upper approach slew margin" VALUE 0x001c83be /* @ECU_Address@bst_appd_upr_slew_m@0x0100FCC0@ */ ECIPP_ALIGNMENT_UWORD 256 Compu_bst_appd_upr_slew_m 0 255.99609375 /end CHARACTERISTIC
/begin COMPU_METHOD Compu_bst_appd_upr_slew_m " " RAT_FUNC "%.2" "psi" COEFFS 0 256 0 0 0 1 /end COMPU_METHOD
/begin CHARACTERISTIC bst_appd_lwr_slew_m "Lower approach slew margin" VALUE 0x001c83b6 /* @ECU_Address@bst_appd_lwr_slew_m@0x0100FCC8@ */ ECIPP_ALIGNMENT_UWORD 256 Compu_bst_appd_lwr_slew_m 0 255.99609375 /end CHARACTERISTIC
/begin COMPU_METHOD Compu_bst_appd_lwr_slew_m " " RAT_FUNC "%.2" "psi" COEFFS 0 256 0 0 0 1 /end COMPU_METHOD
/begin MEASUREMENT bst_TIPdapp "Boost TIP approach target" ULONG Compu_bst_TIPdapp 0 0 0 255.999999940395 ECU_ADDRESS 0x0100FCD0 /end MEASUREMENT
/begin COMPU_METHOD Compu_bst_TIPdapp " " RAT_FUNC "%.2" "psi" COEFFS 0 16777216 0 0 0 1 /end COMPU_METHOD
/begin MEASUREMENT bst_appd_lwr_d_pt "Lower delta point" UWORD Compu_bst_appd_lwr_d_pt 0 0 0 255.99609375 ECU_ADDRESS 0x0100FCD8 /end MEASUREMENT
/begin COMPU_METHOD Compu_bst_appd_lwr_d_pt " " RAT_FUNC "%.2" "psi" COEFFS 0 256 0 0 0 1 /end COMPU_METHOD
/begin MEASUREMENT bst_appd_upr_d_pt "Upper delta point" UWORD Compu_bst_appd_upr_d_pt 0 0 0 255.99609375 ECU_ADDRESS 0x0100FCE0 /end MEASUREMENT
/begin COMPU_METHOD Compu_bst_appd_upr_d_pt " " RAT_FUNC "%.2" "psi" COEFFS 0 256 0 0 0 1 /end COMPU_METHOD
/begin MEASUREMENT bst_appd_lwr_m_pt "Lower slew margin point" UWORD Compu_bst_appd_lwr_m_pt 0 0 0 255.99609375 ECU_ADDRESS 0x0100FCE8 /end MEASUREMENT
/begin COMPU_METHOD Compu_bst_appd_lwr_m_pt " " RAT_FUNC "%.2" "psi" COEFFS 0 256 0 0 0 1 /end COMPU_METHOD
/begin MEASUREMENT bst_appd_upr_m_pt "Upper slew margin point" UWORD Compu_bst_appd_upr_m_pt 0 0 0 255.99609375 ECU_ADDRESS 0x0100FCF0 /end MEASUREMENT
/begin COMPU_METHOD Compu_bst_appd_upr_m_pt " " RAT_FUNC "%.2" "psi" COEFFS 0 256 0 0 0 1 /end COMPU_METHOD
/begin CHARACTERISTIC bst_WGAcmd_FF_source "WGP feedforward command src{bst_WGAcmd_FF_source&0xff=0:Single Point}{bst_WGAcmd_FF_source&0xff=1:Table Based}" VALUE 0x001c8fac /* @ECU_Address@bst_WGAcmd_FF_source@0x01010130@ */ ECIPP_ALIGNMENT_UBYTE 255 bst_WGAcmd_FF_source_COMPU_VTAB 0 255 BIT_MASK 0xff /end CHARACTERISTIC
/begin COMPU_METHOD bst_WGAcmd_FF_source_COMPU_VTAB "Verbal Table" TAB_VERB "%.0" "list" COMPU_TAB_REF bst_WGAcmd_FF_source_COMPU_VTAB_REF /end COMPU_METHOD
/begin COMPU_VTAB bst_WGAcmd_FF_source_COMPU_VTAB_REF "Verbal Table" TAB_VERB 2 0 "Single Point" 1 "Table Based" DEFAULT_VALUE "UNKNOWN" /end COMPU_VTAB
/begin MEASUREMENT bst_WGAcmd_FF_tbl "WGP feedforward command tbl" UWORD Compu_bst_WGAcmd_FF_tbl 0 0 0 99.9984741210938 ECU_ADDRESS 0x01010138 /end MEASUREMENT
/begin COMPU_METHOD Compu_bst_WGAcmd_FF_tbl " " RAT_FUNC "%.1" "%" COEFFS 0 655.36 0 0 0 1 /end COMPU_METHOD
/begin MEASUREMENT boot_revision "Boot revision" ULONG Compu_boot_revision 0 0 0 4294967295 ECU_ADDRESS 0x010103A0 /end MEASUREMENT
/begin COMPU_METHOD Compu_boot_revision " " RAT_FUNC "%.0" "-" COEFFS 0 1 0 0 0 1 /end COMPU_METHOD
/begin MEASUREMENT EGR_minnom_bst_BP "EGR minnom frac" SWORD Compu_EGR_minnom_bst_BP 0 0 -1 0.999969482421875 ECU_ADDRESS 0x01010AF0 /end MEASUREMENT
/begin COMPU_METHOD Compu_EGR_minnom_bst_BP " " RAT_FUNC "%.2" "frac" COEFFS 0 32768 0 0 0 1 /end COMPU_METHOD
/begin MEASUREMENT bst_BP_loadlim "Load-limit" UWORD Compu_bst_BP_loadlim 0 0 0 199.996948242188 ECU_ADDRESS 0x01010AF8 /end MEASUREMENT
/begin COMPU_METHOD Compu_bst_BP_loadlim " " RAT_FUNC "%.1" "%" COEFFS 0 327.68 0 0 0 1 /end COMPU_METHOD
/begin CHARACTERISTIC AFILTdP_ena "Air filter delta-P sensor{AFILTdP_ena&0xff=0:Disabled}{AFILTdP_ena&0xff=1:Aux PD1}{AFILTdP_ena&0xff=2:Aux PD2}{AFILTdP_ena&0xff=3:Aux PD3}{AFILTdP_ena&0xff=4:Aux PUD1}{AFILTdP_ena&0xff=5:Aux PUD2}{AFILTdP_ena&0xff=6:Aux PUD3}{AFILTdP_ena&0xff=7:Aux PUD4}{" VALUE 0x001c8674 /* @ECU_Address@AFILTdP_ena@0x01011440@ */ ECIPP_ALIGNMENT_UBYTE 255 AFILTdP_ena_COMPU_VTAB 0 255 BIT_MASK 0xff /end CHARACTERISTIC
/begin COMPU_METHOD AFILTdP_ena_COMPU_VTAB "Verbal Table" TAB_VERB "%.0" "list" COMPU_TAB_REF AFILTdP_ena_COMPU_VTAB_REF /end COMPU_METHOD
/begin COMPU_VTAB AFILTdP_ena_COMPU_VTAB_REF "Verbal Table" TAB_VERB 31 0 "Disabled" 1 "Aux PD1" 2 "Aux PD2" 3 "Aux PD3" 4 "Aux PUD1" 5 "Aux PUD2" 6 "Aux PUD3" 7 "Aux PUD4" 8 "Aux PUD5" 9 "Aux PUD6" 10 "Aux PUD7" 11 "Aux PUD8" 12 "Aux PUD9" 13 "Aux PUD10" 14 "Aux PUD11" 15 "Aux PUD12" 16 "Aux PUD13" 17 "Aux PUD14" 18 "Aux PUD15" 19 "CAN sourced" 20 "FPP2 Input" 21 "Aux PUD16" 22 "Aux PUD17" 23 "Aux PUD18" 24 "Aux PUD19" 25 "Aux PUD20" 26 "Aux PUD21" 27 "Aux PUD22" 28 "Aux PUD23" 29 "Aux PUD24" 30 "Aux PUD25" DEFAULT_VALUE "UNKNOWN" /end COMPU_VTAB
/begin MEASUREMENT AFILTdP_inst "AFILTdP sensor instantaneous" SWORD Compu_AFILTdP_inst 0 0 -32 31.9990234375 ECU_ADDRESS 0x01011450 /end MEASUREMENT
/begin COMPU_METHOD Compu_AFILTdP_inst " " RAT_FUNC "%.3" "psi" COEFFS 0 1024 0 0 0 1 /end COMPU_METHOD
/begin MEASUREMENT AFILTdP "Air filter delta-P" SWORD Compu_AFILTdP 0 0 -32 31.9990234375 ECU_ADDRESS 0x01011458 /end MEASUREMENT
/begin COMPU_METHOD Compu_AFILTdP " " RAT_FUNC "%.3" "psig" COEFFS 0 1024 0 0 0 1 /end COMPU_METHOD
/begin CHARACTERISTIC diesel_altd_ena "Diesel altitude compensation{diesel_altd_ena&0xff=0:Disabled}{diesel_altd_ena&0xff=1:Load compensation}{diesel_altd_ena&0xff=2:Linear mode selection}" VALUE 0x001c8ff2 /* @ECU_Address@diesel_altd_ena@0x01011460@ */ ECIPP_ALIGNMENT_UBYTE 255 diesel_altd_ena_COMPU_VTAB 0 255 BIT_MASK 0xff /end CHARACTERISTIC
/begin COMPU_METHOD diesel_altd_ena_COMPU_VTAB "Verbal Table" TAB_VERB "%.0" "list" COMPU_TAB_REF diesel_altd_ena_COMPU_VTAB_REF /end COMPU_METHOD
/begin COMPU_VTAB diesel_altd_ena_COMPU_VTAB_REF "Verbal Table" TAB_VERB 3 0 "Disabled" 1 "Load compensation" 2 "Linear mode selection" DEFAULT_VALUE "UNKNOWN" /end COMPU_VTAB
/begin MEASUREMENT diesel_altd_mult "Diesel altitude load multiplier" UWORD Compu_diesel_altd_mult 0 0 0 25599.609375 ECU_ADDRESS 0x01011468 /end MEASUREMENT
/begin COMPU_METHOD Compu_diesel_altd_mult " " RAT_FUNC "%.1" "%" COEFFS 0 2.56 0 0 0 1 /end COMPU_METHOD
/begin MEASUREMENT bst_WGPe "WGP feedback error" SWORD Compu_bst_WGPe 0 0 -128 127.99609375 ECU_ADDRESS 0x01012730 /end MEASUREMENT
/begin COMPU_METHOD Compu_bst_WGPe " " RAT_FUNC "%.2" "psi" COEFFS 0 256 0 0 0 1 /end COMPU_METHOD
/begin CHARACTERISTIC enhanced_security "Enhanced Security{enhanced_security&0xff=0:Disabled}{enhanced_security&0xff=1:Enabled}" VALUE 0x001c9010 /* @ECU_Address@enhanced_security@0x01012C28@ */ ECIPP_ALIGNMENT_UBYTE 255 enhanced_security_COMPU_VTAB 0 255 BIT_MASK 0xff /end CHARACTERISTIC
/begin COMPU_METHOD enhanced_security_COMPU_VTAB "Verbal Table" TAB_VERB "%.0" "list" COMPU_TAB_REF enhanced_security_COMPU_VTAB_REF /end COMPU_METHOD
/begin COMPU_VTAB enhanced_security_COMPU_VTAB_REF "Verbal Table" TAB_VERB 2 0 "Disabled" 1 "Enabled" DEFAULT_VALUE "UNKNOWN" /end COMPU_VTAB
/begin CHARACTERISTIC diesel_altd_LMS_std "Linear mode selection - standard{diesel_altd_LMS_std&0xff=0:Mode 0}{diesel_altd_LMS_std&0xff=1:Mode 1}{diesel_altd_LMS_std&0xff=2:Mode 2}{diesel_altd_LMS_std&0xff=3:Mode 3}{diesel_altd_LMS_std&0xff=4:Mode 4}{diesel_altd_LMS_std&0xff=5:Mode 5}{diesel_altd_" VALUE 0x001f1c82 /* @ECU_Address@diesel_altd_LMS_std@0x01013078@ */ ECIPP_ALIGNMENT_UBYTE 255 diesel_altd_LMS_std_COMPU_VTAB 0 255 BIT_MASK 0xff /end CHARACTERISTIC
/begin COMPU_METHOD diesel_altd_LMS_std_COMPU_VTAB "Verbal Table" TAB_VERB "%.0" "list" COMPU_TAB_REF diesel_altd_LMS_std_COMPU_VTAB_REF /end COMPU_METHOD
/begin COMPU_VTAB diesel_altd_LMS_std_COMPU_VTAB_REF "Verbal Table" TAB_VERB 10 0 "Mode 0" 1 "Mode 1" 2 "Mode 2" 3 "Mode 3" 4 "Mode 4" 5 "Mode 5" 6 "Mode 6" 7 "Mode 7" 8 "Mode 8" 9 "Mode 9" DEFAULT_VALUE "UNKNOWN" /end COMPU_VTAB
/begin CHARACTERISTIC diesel_altd_LMS_hi "Linear mode selection - high altitude{diesel_altd_LMS_hi&0xff=0:Mode 0}{diesel_altd_LMS_hi&0xff=1:Mode 1}{diesel_altd_LMS_hi&0xff=2:Mode 2}{diesel_altd_LMS_hi&0xff=3:Mode 3}{diesel_altd_LMS_hi&0xff=4:Mode 4}{diesel_altd_LMS_hi&0xff=5:Mode 5}{diesel_altd_L" VALUE 0x001f1c81 /* @ECU_Address@diesel_altd_LMS_hi@0x01013080@ */ ECIPP_ALIGNMENT_UBYTE 255 diesel_altd_LMS_hi_COMPU_VTAB 0 255 BIT_MASK 0xff /end CHARACTERISTIC
/begin COMPU_METHOD diesel_altd_LMS_hi_COMPU_VTAB "Verbal Table" TAB_VERB "%.0" "list" COMPU_TAB_REF diesel_altd_LMS_hi_COMPU_VTAB_REF /end COMPU_METHOD
/begin COMPU_VTAB diesel_altd_LMS_hi_COMPU_VTAB_REF "Verbal Table" TAB_VERB 10 0 "Mode 0" 1 "Mode 1" 2 "Mode 2" 3 "Mode 3" 4 "Mode 4" 5 "Mode 5" 6 "Mode 6" 7 "Mode 7" 8 "Mode 8" 9 "Mode 9" DEFAULT_VALUE "UNKNOWN" /end COMPU_VTAB
/begin CHARACTERISTIC diesel_altd_BP_std "BP standard" VALUE 0x001f195c /* @ECU_Address@diesel_altd_BP_std@0x01013088@ */ ECIPP_ALIGNMENT_UWORD 256 Compu_diesel_altd_BP_std 0 255.99609375 /end CHARACTERISTIC
/begin COMPU_METHOD Compu_diesel_altd_BP_std " " RAT_FUNC "%.2" "psia" COEFFS 0 256 0 0 0 1 /end COMPU_METHOD
/begin CHARACTERISTIC diesel_altd_BP_hi "BP high altitude" VALUE 0x001f195a /* @ECU_Address@diesel_altd_BP_hi@0x01013090@ */ ECIPP_ALIGNMENT_UWORD 256 Compu_diesel_altd_BP_hi 0 255.99609375 /end CHARACTERISTIC
/begin COMPU_METHOD Compu_diesel_altd_BP_hi " " RAT_FUNC "%.2" "psia" COEFFS 0 256 0 0 0 1 /end COMPU_METHOD
/begin MEASUREMENT diesel_altd_LMS_pct "Altitude ratio" UWORD Compu_diesel_altd_LMS_pct 0 0 0 0.999984741210938 ECU_ADDRESS 0x01013098 /end MEASUREMENT
/begin COMPU_METHOD Compu_diesel_altd_LMS_pct " " RAT_FUNC "%.3" "-" COEFFS 0 65536 0 0 0 1 /end COMPU_METHOD
/begin CHARACTERISTIC TC_comp_mdotc_pcttau "Compressor corrected flow tau" VALUE 0x001c85d2 /* @ECU_Address@TC_comp_mdotc_pcttau@0x01013250@ */ ECIPP_ALIGNMENT_UWORD 327680 Compu_TC_comp_mdotc_pcttau 0.45084 327680 /end CHARACTERISTIC
/begin COMPU_METHOD Compu_TC_comp_mdotc_pcttau " " FORM "%.0" "ms"
 /begin FORMULA "-5 / log(1 - (X1 / 65536))" FORMULA_INV "(1 - exp(-5/X1)) * 65536" /end FORMULA
/end COMPU_METHOD
/begin MEASUREMENT TC_comp_mdotc_pct_lp "Compressor corrected flow filt" UWORD Compu_TC_comp_mdotc_pct_lp 0 0 0 399.993896484375 ECU_ADDRESS 0x01013258 /end MEASUREMENT
/begin COMPU_METHOD Compu_TC_comp_mdotc_pct_lp " " RAT_FUNC "%.1" "% of ref" COEFFS 0 163.84 0 0 0 1 /end COMPU_METHOD
/begin CHARACTERISTIC bst_BP_LL_tau "Alt. compensation load limit tau" VALUE 0x001c864e /* @ECU_Address@bst_BP_LL_tau@0x010132A8@ */ ECIPP_ALIGNMENT_UWORD 328 Compu_bst_BP_LL_tau 0.00045084 327.68 /end CHARACTERISTIC
/begin COMPU_METHOD Compu_bst_BP_LL_tau " " FORM "%.1" "sec"
 /begin FORMULA "-0.005 / log(1 - (X1 / 65536))" FORMULA_INV "(1 - exp(-0.005/X1)) * 65536" /end FORMULA
/end COMPU_METHOD
/begin CHARACTERISTIC cal_pwd_ena "Calibration Password{cal_pwd_ena&0xff=0:Disabled}{cal_pwd_ena&0xff=1:Tech}{cal_pwd_ena&0xff=2:SuperTech}{cal_pwd_ena&0xff=3:Engineer}{cal_pwd_ena&0xff=4:OEM}{cal_pwd_ena&0xff=5:Enabled}" VALUE 0x001c8fc8 /* @ECU_Address@cal_pwd_ena@0x010132B0@ */ ECIPP_ALIGNMENT_UBYTE 255 cal_pwd_ena_COMPU_VTAB 0 255 BIT_MASK 0xff /end CHARACTERISTIC
/begin COMPU_METHOD cal_pwd_ena_COMPU_VTAB "Verbal Table" TAB_VERB "%.0" "list" COMPU_TAB_REF cal_pwd_ena_COMPU_VTAB_REF /end COMPU_METHOD
/begin COMPU_VTAB cal_pwd_ena_COMPU_VTAB_REF "Verbal Table" TAB_VERB 6 0 "Disabled" 1 "Tech" 2 "SuperTech" 3 "Engineer" 4 "OEM" 5 "Enabled" DEFAULT_VALUE "UNKNOWN" /end COMPU_VTAB
/begin MEASUREMENT bst_rpm "Boost filtered rpm" UWORD Compu_bst_rpm 0 0 0 65535 ECU_ADDRESS 0x010132E0 /end MEASUREMENT
/begin COMPU_METHOD Compu_bst_rpm " " RAT_FUNC "%.0" "rpm" COEFFS 0 1 0 0 0 1 /end COMPU_METHOD
/begin MEASUREMENT bst_TIP "Boost filtered TIP" UWORD Compu_bst_TIP 0 0 0 255.99609375 ECU_ADDRESS 0x010132E8 /end MEASUREMENT
/begin COMPU_METHOD Compu_bst_TIP " " RAT_FUNC "%.1" "psia" COEFFS 0 256 0 0 0 1 /end COMPU_METHOD
/begin MEASUREMENT bst_BP_MAP_load "MAP load threshold" UWORD Compu_bst_BP_MAP_load 0 0 0 255.99609375 ECU_ADDRESS 0x01013480 /end MEASUREMENT
/begin COMPU_METHOD Compu_bst_BP_MAP_load " " RAT_FUNC "%.1" "psia" COEFFS 0 256 0 0 0 1 /end COMPU_METHOD
/begin CHARACTERISTIC bst_BP_MAP_load_dlt "MAP load approach delta" VALUE 0x001c83a2 /* @ECU_Address@bst_BP_MAP_load_dlt@0x01013488@ */ ECIPP_ALIGNMENT_UWORD 256 Compu_bst_BP_MAP_load_dlt 0 255.99609375 /end CHARACTERISTIC
/begin COMPU_METHOD Compu_bst_BP_MAP_load_dlt " " RAT_FUNC "%.2" "psia" COEFFS 0 256 0 0 0 1 /end COMPU_METHOD
/begin MEASUREMENT bst_BP_MAP_load_app "MAP load approach threshold" UWORD Compu_bst_BP_MAP_load_app 0 0 0 255.99609375 ECU_ADDRESS 0x01013490 /end MEASUREMENT
/begin COMPU_METHOD Compu_bst_BP_MAP_load_app " " RAT_FUNC "%.2" "psia" COEFFS 0 256 0 0 0 1 /end COMPU_METHOD
/begin MEASUREMENT bst_BP_oct_derate "Derate for EGR octane adaptation" SWORD Compu_bst_BP_oct_derate 0 0 -100 99.9969482421875 ECU_ADDRESS 0x01013498 /end MEASUREMENT
/begin COMPU_METHOD Compu_bst_BP_oct_derate " " RAT_FUNC "%.1" "%" COEFFS 0 327.68 0 0 0 1 /end COMPU_METHOD
/begin MEASUREMENT CIT "Compressor inlet temp" UWORD Compu_CIT 0 0 -460 563.984375 ECU_ADDRESS 0x01013C68 /end MEASUREMENT
/begin COMPU_METHOD Compu_CIT " " RAT_FUNC "%.1" "deg F" COEFFS 0 64 29440 0 0 1 /end COMPU_METHOD
/begin CHARACTERISTIC TC_model_type "Turbocharger model selection{TC_model_type&0xff=0:Auto}{TC_model_type&0xff=1:Legacy}{TC_model_type&0xff=2:Revised}" VALUE 0x001c8f1c /* @ECU_Address@TC_model_type@0x01013F50@ */ ECIPP_ALIGNMENT_UBYTE 255 TC_model_type_COMPU_VTAB 0 255 BIT_MASK 0xff /end CHARACTERISTIC
/begin COMPU_METHOD TC_model_type_COMPU_VTAB "Verbal Table" TAB_VERB "%.0" "list" COMPU_TAB_REF TC_model_type_COMPU_VTAB_REF /end COMPU_METHOD
/begin COMPU_VTAB TC_model_type_COMPU_VTAB_REF "Verbal Table" TAB_VERB 3 0 "Auto" 1 "Legacy" 2 "Revised" DEFAULT_VALUE "UNKNOWN" /end COMPU_VTAB
/begin CHARACTERISTIC TC_comp_fac_hAint "Compressor internal heat transfer factor" VALUE 0x001c8080 /* @ECU_Address@TC_comp_fac_hAint@0x01013F58@ */ ECIPP_ALIGNMENT_UWORD 16 Compu_TC_comp_fac_hAint 0 15.999755859375 /end CHARACTERISTIC
/begin COMPU_METHOD Compu_TC_comp_fac_hAint " " RAT_FUNC "%.1" "-" COEFFS 0 4096 0 0 0 1 /end COMPU_METHOD
/begin CHARACTERISTIC TC_comp_hAext "Compressor external heat conductance" VALUE 0x001c8082 /* @ECU_Address@TC_comp_hAext@0x01013F60@ */ ECIPP_ALIGNMENT_UWORD 256 Compu_TC_comp_hAext 0 255.99609375 /end CHARACTERISTIC
/begin COMPU_METHOD Compu_TC_comp_hAext " " RAT_FUNC "%.0" "W/deg F" COEFFS 0 256 0 0 0 1 /end COMPU_METHOD
/begin CHARACTERISTIC TC_comp_Text "Compressor heat rejection temperature" VALUE 0x001c8078 /* @ECU_Address@TC_comp_Text@0x01013F68@ */ ECIPP_ALIGNMENT_UWORD 7732 Compu_TC_comp_Text -460 7731.875 /end CHARACTERISTIC
/begin COMPU_METHOD Compu_TC_comp_Text " " RAT_FUNC "%.0" "deg F" COEFFS 0 8 3680 0 0 1 /end COMPU_METHOD
/begin CHARACTERISTIC TC_comp_Td_COT "Compressor outlet temperature delay" VALUE 0x001c8f1b /* @ECU_Address@TC_comp_Td_COT@0x01013F70@ */ ECIPP_ALIGNMENT_UBYTE 16 Compu_TC_comp_Td_COT 0 15.9375 /end CHARACTERISTIC
/begin COMPU_METHOD Compu_TC_comp_Td_COT " " RAT_FUNC "%.1" "sec" COEFFS 0 16 0 0 0 1 /end COMPU_METHOD
/begin CHARACTERISTIC bst_MAPd_dttau "Boost MAPd derivative tau" VALUE 0x001c3df4 /* @ECU_Address@bst_MAPd_dttau@0x010141D0@ */ ECIPP_ALIGNMENT_FLOAT32_IEEE 10000000000 Compu_bst_MAPd_dttau -10000000000 10000000000 /end CHARACTERISTIC
/begin COMPU_METHOD Compu_bst_MAPd_dttau " " RAT_FUNC "%.0" "ms" COEFFS 0 1 0 0 0 1 /end COMPU_METHOD
/begin CHARACTERISTIC bst_TIPMAPd_dttau "Boost TIP-MAPd derivative tau" VALUE 0x001c3df8 /* @ECU_Address@bst_TIPMAPd_dttau@0x010141D8@ */ ECIPP_ALIGNMENT_FLOAT32_IEEE 10000000000 Compu_bst_TIPMAPd_dttau -10000000000 10000000000 /end CHARACTERISTIC
/begin COMPU_METHOD Compu_bst_TIPMAPd_dttau " " RAT_FUNC "%.0" "ms" COEFFS 0 1 0 0 0 1 /end COMPU_METHOD
/begin MEASUREMENT bst_MAPd_dt "Boost MAPd derivative" FLOAT32_IEEE Compu_bst_MAPd_dt 0 0 -10000000000 10000000000 ECU_ADDRESS 0x010141E0 /end MEASUREMENT
/begin COMPU_METHOD Compu_bst_MAPd_dt " " RAT_FUNC "%.1" "psi/sec" COEFFS 0 1 0 0 0 1 /end COMPU_METHOD
/begin MEASUREMENT bst_TIPMAPd_dt "Boost TIP-MAPd derivative" FLOAT32_IEEE Compu_bst_TIPMAPd_dt 0 0 -10000000000 10000000000 ECU_ADDRESS 0x010141E8 /end MEASUREMENT
/begin COMPU_METHOD Compu_bst_TIPMAPd_dt " " RAT_FUNC "%.1" "psi/sec" COEFFS 0 1 0 0 0 1 /end COMPU_METHOD
/begin CHARACTERISTIC TC_turb_fac_hAint "Turbine internal heat transfer factor" VALUE 0x001c8094 /* @ECU_Address@TC_turb_fac_hAint@0x010143F0@ */ ECIPP_ALIGNMENT_UWORD 16 Compu_TC_turb_fac_hAint 0 15.999755859375 /end CHARACTERISTIC
/begin COMPU_METHOD Compu_TC_turb_fac_hAint " " RAT_FUNC "%.1" "-" COEFFS 0 4096 0 0 0 1 /end COMPU_METHOD
/begin CHARACTERISTIC TC_turb_hAext "Turbine external heat conductance" VALUE 0x001c8098 /* @ECU_Address@TC_turb_hAext@0x010143F8@ */ ECIPP_ALIGNMENT_UWORD 256 Compu_TC_turb_hAext 0 255.99609375 /end CHARACTERISTIC
/begin COMPU_METHOD Compu_TC_turb_hAext " " RAT_FUNC "%.0" "W/deg F" COEFFS 0 256 0 0 0 1 /end COMPU_METHOD
/begin CHARACTERISTIC TC_turb_Text "Turbine heat rejection temperature" VALUE 0x001c808e /* @ECU_Address@TC_turb_Text@0x01014400@ */ ECIPP_ALIGNMENT_UWORD 7732 Compu_TC_turb_Text -460 7731.875 /end CHARACTERISTIC
/begin COMPU_METHOD Compu_TC_turb_Text " " RAT_FUNC "%.0" "deg F" COEFFS 0 8 3680 0 0 1 /end COMPU_METHOD
/begin CHARACTERISTIC TC_turb_Td_COT "Turbine outlet temperature delay" VALUE 0x001c8f1d /* @ECU_Address@TC_turb_Td_COT@0x01014408@ */ ECIPP_ALIGNMENT_UBYTE 16 Compu_TC_turb_Td_COT 0 15.9375 /end CHARACTERISTIC
/begin COMPU_METHOD Compu_TC_turb_Td_COT " " RAT_FUNC "%.1" "sec" COEFFS 0 16 0 0 0 1 /end COMPU_METHOD
/begin CHARACTERISTIC TC_turb_fac_hx_temp "Turbine heat transfer temperature factor" VALUE 0x001c8096 /* @ECU_Address@TC_turb_fac_hx_temp@0x01014410@ */ ECIPP_ALIGNMENT_UWORD 1 Compu_TC_turb_fac_hx_temp 0 0.999984741210938 /end CHARACTERISTIC
/begin COMPU_METHOD Compu_TC_turb_fac_hx_temp " " RAT_FUNC "%.2" "-" COEFFS 0 65536 0 0 0 1 /end COMPU_METHOD
/begin MEASUREMENT diesel_altd_LMS_torq "Altitude max brake torque multiplier" UWORD Compu_diesel_altd_LMS_torq 0 0 0 99.9984741210938 ECU_ADDRESS 0x01014420 /end MEASUREMENT
/begin COMPU_METHOD Compu_diesel_altd_LMS_torq " " RAT_FUNC "%.1" "%" COEFFS 0 655.36 0 0 0 1 /end COMPU_METHOD
/begin CHARACTERISTIC bst_TIP_atten_psi "TIP gain attenuation threshold" VALUE 0x001c6c4c /* @ECU_Address@bst_TIP_atten_psi@0x010147C0@ */ ECIPP_ALIGNMENT_SWORD 128 Compu_bst_TIP_atten_psi -128 127.99609375 /end CHARACTERISTIC
/begin COMPU_METHOD Compu_bst_TIP_atten_psi " " RAT_FUNC "%.1" "psi" COEFFS 0 256 0 0 0 1 /end COMPU_METHOD
/begin CHARACTERISTIC bst_Kp_TIP_atten "TIP Kp percentage when error zero" VALUE 0x001c6c44 /* @ECU_Address@bst_Kp_TIP_atten@0x010147C8@ */ ECIPP_ALIGNMENT_SWORD 100 Compu_bst_Kp_TIP_atten -100 99.9969482421875 /end CHARACTERISTIC
/begin COMPU_METHOD Compu_bst_Kp_TIP_atten " " RAT_FUNC "%.1" "%" COEFFS 0 327.68 0 0 0 1 /end COMPU_METHOD
/begin CHARACTERISTIC bst_Ki_TIP_atten "TIP Ki percentage when error zero" VALUE 0x001c6c36 /* @ECU_Address@bst_Ki_TIP_atten@0x010147D0@ */ ECIPP_ALIGNMENT_SWORD 100 Compu_bst_Ki_TIP_atten -100 99.9969482421875 /end CHARACTERISTIC
/begin COMPU_METHOD Compu_bst_Ki_TIP_atten " " RAT_FUNC "%.1" "%" COEFFS 0 327.68 0 0 0 1 /end COMPU_METHOD
/begin CHARACTERISTIC bst_Kd_TIP_atten "TIP Kd percentage when error zero" VALUE 0x001c6c30 /* @ECU_Address@bst_Kd_TIP_atten@0x010147D8@ */ ECIPP_ALIGNMENT_SWORD 100 Compu_bst_Kd_TIP_atten -100 99.9969482421875 /end CHARACTERISTIC
/begin COMPU_METHOD Compu_bst_Kd_TIP_atten " " RAT_FUNC "%.1" "%" COEFFS 0 327.68 0 0 0 1 /end COMPU_METHOD
/begin CHARACTERISTIC bst_TIP_Iacc_mode "TIP integrator limiting mode{bst_TIP_Iacc_mode&0xff=0:Legacy}{bst_TIP_Iacc_mode&0xff=1:Enhanced}" VALUE 0x001c8fa8 /* @ECU_Address@bst_TIP_Iacc_mode@0x010147E0@ */ ECIPP_ALIGNMENT_UBYTE 255 bst_TIP_Iacc_mode_COMPU_VTAB 0 255 BIT_MASK 0xff /end CHARACTERISTIC
/begin COMPU_METHOD bst_TIP_Iacc_mode_COMPU_VTAB "Verbal Table" TAB_VERB "%.0" "list" COMPU_TAB_REF bst_TIP_Iacc_mode_COMPU_VTAB_REF /end COMPU_METHOD
/begin COMPU_VTAB bst_TIP_Iacc_mode_COMPU_VTAB_REF "Verbal Table" TAB_VERB 2 0 "Legacy" 1 "Enhanced" DEFAULT_VALUE "UNKNOWN" /end COMPU_VTAB
/begin CHARACTERISTIC bst_appd_lwr_offset "Lower approach offset" VALUE 0x001c83b4 /* @ECU_Address@bst_appd_lwr_offset@0x010147E8@ */ ECIPP_ALIGNMENT_UWORD 256 Compu_bst_appd_lwr_offset 0 255.99609375 /end CHARACTERISTIC
/begin COMPU_METHOD Compu_bst_appd_lwr_offset " " RAT_FUNC "%.1" "psi" COEFFS 0 256 0 0 0 1 /end COMPU_METHOD
/begin CHARACTERISTIC bst_appd_lwr_time "Lower approach offset time" VALUE 0x001c83b8 /* @ECU_Address@bst_appd_lwr_time@0x010147F0@ */ ECIPP_ALIGNMENT_UWORD 65535 Compu_bst_appd_lwr_time 0 65535 /end CHARACTERISTIC
/begin COMPU_METHOD Compu_bst_appd_lwr_time " " RAT_FUNC "%.0" "ms" COEFFS 0 1 0 0 0 1 /end COMPU_METHOD
/begin CHARACTERISTIC TIPrsc2D_tbl_mode "Boost altitude 2D table selection{TIPrsc2D_tbl_mode&0xff=0:Standard Tables (legacy)}{TIPrsc2D_tbl_mode&0xff=1:Expanded Tables}" VALUE 0x001c8f39 /* @ECU_Address@TIPrsc2D_tbl_mode@0x010147F8@ */ ECIPP_ALIGNMENT_UBYTE 255 TIPrsc2D_tbl_mode_COMPU_VTAB 0 255 BIT_MASK 0xff /end CHARACTERISTIC
/begin COMPU_METHOD TIPrsc2D_tbl_mode_COMPU_VTAB "Verbal Table" TAB_VERB "%.0" "list" COMPU_TAB_REF TIPrsc2D_tbl_mode_COMPU_VTAB_REF /end COMPU_METHOD
/begin COMPU_VTAB TIPrsc2D_tbl_mode_COMPU_VTAB_REF "Verbal Table" TAB_VERB 2 0 "Standard Tables (legacy)" 1 "Expanded Tables" DEFAULT_VALUE "UNKNOWN" /end COMPU_VTAB
/begin CHARACTERISTIC bst_Kiv_ena_TIPe "TIP feedback Kiv engage error" VALUE 0x001c6c40 /* @ECU_Address@bst_Kiv_ena_TIPe@0x01014800@ */ ECIPP_ALIGNMENT_SWORD 128 Compu_bst_Kiv_ena_TIPe -128 127.99609375 /end CHARACTERISTIC
/begin COMPU_METHOD Compu_bst_Kiv_ena_TIPe " " RAT_FUNC "%.1" "psi" COEFFS 0 256 0 0 0 1 /end COMPU_METHOD
/begin CHARACTERISTIC bst_Kiv_dis_TIPe "TIP feedback Kiv disengage error" VALUE 0x001c6c3e /* @ECU_Address@bst_Kiv_dis_TIPe@0x01014808@ */ ECIPP_ALIGNMENT_SWORD 128 Compu_bst_Kiv_dis_TIPe -128 127.99609375 /end CHARACTERISTIC
/begin COMPU_METHOD Compu_bst_Kiv_dis_TIPe " " RAT_FUNC "%.1" "psi" COEFFS 0 256 0 0 0 1 /end COMPU_METHOD
/begin CHARACTERISTIC bst_Kiv_dis_time "TIP feedback Kiv disengage time" VALUE 0x001c83a6 /* @ECU_Address@bst_Kiv_dis_time@0x01014810@ */ ECIPP_ALIGNMENT_UWORD 65535 Compu_bst_Kiv_dis_time 0 65535 /end CHARACTERISTIC
/begin COMPU_METHOD Compu_bst_Kiv_dis_time " " RAT_FUNC "%.0" "ms" COEFFS 0 1 0 0 0 1 /end COMPU_METHOD
/begin CHARACTERISTIC bst_appd_lwr_mode "Lower approach slew mode{bst_appd_lwr_mode&0xff=0:Slew up at constant rate}{bst_appd_lwr_mode&0xff=1:Slew to TIP target}" VALUE 0x001c8fb2 /* @ECU_Address@bst_appd_lwr_mode@0x01014818@ */ ECIPP_ALIGNMENT_UBYTE 255 bst_appd_lwr_mode_COMPU_VTAB 0 255 BIT_MASK 0xff /end CHARACTERISTIC
/begin COMPU_METHOD bst_appd_lwr_mode_COMPU_VTAB "Verbal Table" TAB_VERB "%.0" "list" COMPU_TAB_REF bst_appd_lwr_mode_COMPU_VTAB_REF /end COMPU_METHOD
/begin COMPU_VTAB bst_appd_lwr_mode_COMPU_VTAB_REF "Verbal Table" TAB_VERB 2 0 "Slew up at constant rate" 1 "Slew to TIP target" DEFAULT_VALUE "UNKNOWN" /end COMPU_VTAB
/begin MEASUREMENT bst_MAPd_load_max "Boost MAP load immediately available" UWORD Compu_bst_MAPd_load_max 0 0 0 255.99609375 ECU_ADDRESS 0x01014940 /end MEASUREMENT
/begin COMPU_METHOD Compu_bst_MAPd_load_max " " RAT_FUNC "%.2" "psia" COEFFS 0 256 0 0 0 1 /end COMPU_METHOD
/begin CHARACTERISTIC CylFireOrder11 "CFO11{CylFireOrder11&0xff=0:X}{CylFireOrder11&0xff=1:1}{CylFireOrder11&0xff=2:2}{CylFireOrder11&0xff=3:3}{CylFireOrder11&0xff=4:4}{CylFireOrder11&0xff=5:5}{CylFireOrder11&0xff=6:6}{CylFireOrder11&0xff=7:7}{CylFireOrder11&0xff=8:8}{CylFireOrder11&0xff=9:9}" VALUE 0x001C8FEB /* @ECU_Address@CylFireOrder11@0x01014AA0@ */ ECIPP_ALIGNMENT_UBYTE 255 CylFireOrder11_COMPU_VTAB 0 255 BIT_MASK 0xff /end CHARACTERISTIC
/begin COMPU_METHOD CylFireOrder11_COMPU_VTAB "Verbal Table" TAB_VERB "%.0" "list" COMPU_TAB_REF CylFireOrder11_COMPU_VTAB_REF /end COMPU_METHOD
/begin COMPU_VTAB CylFireOrder11_COMPU_VTAB_REF "Verbal Table" TAB_VERB 13 0 "X" 1 "1" 2 "2" 3 "3" 4 "4" 5 "5" 6 "6" 7 "7" 8 "8" 9 "9" 10 "10" 11 "11" 12 "12" DEFAULT_VALUE "UNKNOWN" /end COMPU_VTAB
/begin CHARACTERISTIC CylFireOrder12 "CFO12{CylFireOrder12&0xff=0:X}{CylFireOrder12&0xff=1:1}{CylFireOrder12&0xff=2:2}{CylFireOrder12&0xff=3:3}{CylFireOrder12&0xff=4:4}{CylFireOrder12&0xff=5:5}{CylFireOrder12&0xff=6:6}{CylFireOrder12&0xff=7:7}{CylFireOrder12&0xff=8:8}{CylFireOrder12&0xff=9:9}" VALUE 0x001C8FEC /* @ECU_Address@CylFireOrder12@0x01014AA8@ */ ECIPP_ALIGNMENT_UBYTE 255 CylFireOrder12_COMPU_VTAB 0 255 BIT_MASK 0xff /end CHARACTERISTIC
/begin COMPU_METHOD CylFireOrder12_COMPU_VTAB "Verbal Table" TAB_VERB "%.0" "list" COMPU_TAB_REF CylFireOrder12_COMPU_VTAB_REF /end COMPU_METHOD
/begin COMPU_VTAB CylFireOrder12_COMPU_VTAB_REF "Verbal Table" TAB_VERB 13 0 "X" 1 "1" 2 "2" 3 "3" 4 "4" 5 "5" 6 "6" 7 "7" 8 "8" 9 "9" 10 "10" 11 "11" 12 "12" DEFAULT_VALUE "UNKNOWN" /end COMPU_VTAB
/begin MEASUREMENT WGCV_state "WGCV state{WGCV_state&0xff=0:Unknown}{WGCV_state&0xff=1:Pressure Control}{WGCV_state&0xff=2:Fail-Safe}{WGCV_state&0xff=3:Unknown}{WGCV_state&0xff=255:Not Available}" UBYTE WGCV_state_COMPU_VTAB 0 0 0 255 ECU_ADDRESS 0x01014CF0 BIT_MASK 0xff /end MEASUREMENT
/begin COMPU_METHOD WGCV_state_COMPU_VTAB "Verbal Table" TAB_VERB "%.0" "list" COMPU_TAB_REF WGCV_state_COMPU_VTAB_REF /end COMPU_METHOD
/begin COMPU_VTAB WGCV_state_COMPU_VTAB_REF "Verbal Table" TAB_VERB 5 0 "Unknown" 1 "Pressure Control" 2 "Fail-Safe" 3 "Unknown" 255 "Not Available" DEFAULT_VALUE "UNKNOWN" /end COMPU_VTAB
/begin MEASUREMENT WGCV_fault_code "WGCV fault code{WGCV_fault_code&0xff=0:None}{WGCV_fault_code&0xff=1:Internal Fault}{WGCV_fault_code&0xff=2:Low Voltage}{WGCV_fault_code&0xff=3:High Voltage}{WGCV_fault_code&0xff=4:Large Pressure Delta}{WGCV_fault_code&0xff=5:Pressure Message Timeout}{WGCV" UBYTE WGCV_fault_code_COMPU_VTAB 0 0 0 255 ECU_ADDRESS 0x01014CF8 BIT_MASK 0xff /end MEASUREMENT
/begin COMPU_METHOD WGCV_fault_code_COMPU_VTAB "Verbal Table" TAB_VERB "%.0" "list" COMPU_TAB_REF WGCV_fault_code_COMPU_VTAB_REF /end COMPU_METHOD
/begin COMPU_VTAB WGCV_fault_code_COMPU_VTAB_REF "Verbal Table" TAB_VERB 13 0 "None" 1 "Internal Fault" 2 "Low Voltage" 3 "High Voltage" 4 "Large Pressure Delta" 5 "Pressure Message Timeout" 6 "Pressure Message Timeout" 7 "CAN Bus Off" 8 "Open-Circuit Pressure Sensor" 9 "Short-Circuit Pressure Sensor" 10 "Open-Circuit Valve" 11 "Short-Circuit Valve" 255 "Not Available" DEFAULT_VALUE "UNKNOWN" /end COMPU_VTAB
/begin MEASUREMENT TID_table "Serial number" ULONG Compu_TID_table 0 0 0 4294967295 ECU_ADDRESS 0x02004000 MATRIX_DIM 9 1 1 /end MEASUREMENT
/begin COMPU_METHOD Compu_TID_table " " RAT_FUNC "%.0" "-" COEFFS 0 1 0 0 0 1 /end COMPU_METHOD
/begin MEASUREMENT TSoftID_table "Software model" ULONG Compu_TSoftID_table 0 0 0 4294967295 ECU_ADDRESS 0x02006000 MATRIX_DIM 4 1 1 /end MEASUREMENT
/begin COMPU_METHOD Compu_TSoftID_table " " RAT_FUNC "%.0" "-" COEFFS 0 1 0 0 0 1 /end COMPU_METHOD
/begin CHARACTERISTIC STR_cust_HWpart "Cust hardware part number" ASCII 0x001C8E9F /* @ECU_Address@STR_cust_HWpart@0x02009000@ */ ECIPP_ALIGNMENT_UBYTE 255 Compu_ECIPP_STRINGS 0 255 MATRIX_DIM 39 1 1 /end CHARACTERISTIC
/begin CHARACTERISTIC STR_cust_SWpart "Cust software part number" ASCII 0x001C8EC7 /* @ECU_Address@STR_cust_SWpart@0x0200A000@ */ ECIPP_ALIGNMENT_UBYTE 255 Compu_ECIPP_STRINGS 0 255 MATRIX_DIM 39 1 1 /end CHARACTERISTIC
/begin CHARACTERISTIC STR_gov_desc "Governor cal description" ASCII 0x001E9ADC /* @ECU_Address@STR_gov_desc@0x0200B000@ */ ECIPP_ALIGNMENT_UBYTE 255 Compu_ECIPP_STRINGS 0 255 MATRIX_DIM 159 1 1 /end CHARACTERISTIC
/begin MEASUREMENT STR_engine_PN "Engine part number" UBYTE Compu_ECIPP_STRINGS 0 0 0 255 ECU_ADDRESS 0x0200D000 MATRIX_DIM 19 1 1 /end MEASUREMENT
/begin MEASUREMENT STR_engine_SN "Engine serial number" UBYTE Compu_ECIPP_STRINGS 0 0 0 255 ECU_ADDRESS 0x0200E000 MATRIX_DIM 19 1 1 /end MEASUREMENT
/begin COMPU_METHOD Compu_TMAP_rpm " " RAT_FUNC "%.0" "Speed (rpm)" COEFFS 0 1 0 0 0 1 /end COMPU_METHOD
/begin CHARACTERISTIC TMAP_noload "MAP No-Load" CURVE 0x001C53E8 /* @ECU_Address@TMAP_noload@0x0202E000@ */ ECIPP_ALIGNMENT_SWORD 128 Compu_TMAP_noload -128 127.99609375
 /begin AXIS_DESCR COM_AXIS NO_INPUT_QUANTITY Compu_TMAP_rpm 16 -32768 32767 AXIS_PTS_REF TMAP_rpm /end AXIS_DESCR
/end CHARACTERISTIC
/begin AXIS_PTS TMAP_rpm " " 0x001C5408 /* @ECU_Address@TMAP_rpm@0x0202D000@ */ NO_INPUT_QUANTITY ECIPP_Lookup_SWORD 0 Compu_TMAP_rpm 16 -32768 32767 /end AXIS_PTS
/begin COMPU_METHOD Compu_TMAP_noload " " RAT_FUNC "%.2" "MAP (psia)" COEFFS 0 256 0 0 0 1 /end COMPU_METHOD
/begin CHARACTERISTIC TMAP_fullload "MAP Full-Load" CURVE 0x001C53C8 /* @ECU_Address@TMAP_fullload@0x0202F000@ */ ECIPP_ALIGNMENT_SWORD 128 Compu_TMAP_fullload -128 127.99609375
 /begin AXIS_DESCR COM_AXIS NO_INPUT_QUANTITY Compu_TMAP_rpm 16 -32768 32767 AXIS_PTS_REF TMAP_rpm /end AXIS_DESCR
/end CHARACTERISTIC
/begin COMPU_METHOD Compu_TMAP_fullload " " RAT_FUNC "%.2" "MAP (psia)" COEFFS 0 256 0 0 0 1 /end COMPU_METHOD
/begin COMPU_METHOD Compu_Tbst_Ptarg_ldcmd " " RAT_FUNC "%.1" "Load Cmd (%)" COEFFS 0 163.84 0 0 0 1 /end COMPU_METHOD
/begin COMPU_METHOD Compu_Tbst_Ptarg_rpm " " RAT_FUNC "%.0" "Speed (rpm)" COEFFS 0 1 0 0 0 1 /end COMPU_METHOD
/begin CHARACTERISTIC Tbst_Ptarg_P "Boost Pressure Command" MAP 0x001C6120 /* @ECU_Address@Tbst_Ptarg_P@0x02098000@ */ ECIPP_ALIGNMENT_SWORD 128 Compu_Tbst_Ptarg_P -128 127.99609375
 /begin AXIS_DESCR COM_AXIS NO_INPUT_QUANTITY Compu_Tbst_Ptarg_ldcmd 8 -200 199.993896484375 AXIS_PTS_REF Tbst_Ptarg_ldcmd /end AXIS_DESCR
 /begin AXIS_DESCR COM_AXIS NO_INPUT_QUANTITY Compu_Tbst_Ptarg_rpm 8 -32768 32767 AXIS_PTS_REF Tbst_Ptarg_rpm /end AXIS_DESCR
/end CHARACTERISTIC
/begin AXIS_PTS Tbst_Ptarg_ldcmd " " 0x001C61A0 /* @ECU_Address@Tbst_Ptarg_ldcmd@0x02096000@ */ NO_INPUT_QUANTITY ECIPP_Lookup_SWORD 0 Compu_Tbst_Ptarg_ldcmd 8 -200 199.993896484375 /end AXIS_PTS
/begin AXIS_PTS Tbst_Ptarg_rpm " " 0x001C61B0 /* @ECU_Address@Tbst_Ptarg_rpm@0x02097000@ */ NO_INPUT_QUANTITY ECIPP_Lookup_SWORD 0 Compu_Tbst_Ptarg_rpm 8 -32768 32767 /end AXIS_PTS
/begin COMPU_METHOD Compu_Tbst_Ptarg_P "" RAT_FUNC "%.2" "Target TIP (psia) or delta-P (psi)" COEFFS 0 256 0 0 0 1 /end COMPU_METHOD
/begin COMPU_METHOD Compu_Tbst_WGPnl_in " " RAT_FUNC "%.2" "WGP in (psig)" COEFFS 0 256 0 0 0 1 /end COMPU_METHOD
/begin CHARACTERISTIC Tbst_WGPnl_out "Non-linear WGP Target Mapping" CURVE 0x001C6260 /* @ECU_Address@Tbst_WGPnl_out@0x020DB000@ */ ECIPP_ALIGNMENT_SWORD 128 Compu_Tbst_WGPnl_out -128 127.99609375
 /begin AXIS_DESCR COM_AXIS NO_INPUT_QUANTITY Compu_Tbst_WGPnl_in 16 -128 127.99609375 AXIS_PTS_REF Tbst_WGPnl_in /end AXIS_DESCR
/end CHARACTERISTIC
/begin AXIS_PTS Tbst_WGPnl_in " " 0x001C6240 /* @ECU_Address@Tbst_WGPnl_in@0x020DA000@ */ NO_INPUT_QUANTITY ECIPP_Lookup_SWORD 0 Compu_Tbst_WGPnl_in 16 -128 127.99609375 /end AXIS_PTS
/begin COMPU_METHOD Compu_Tbst_WGPnl_out " " RAT_FUNC "%.2" "WGP out (psig)" COEFFS 0 256 0 0 0 1 /end COMPU_METHOD
/begin COMPU_METHOD Compu_Tbst_MATdr_MAT " " RAT_FUNC "%.0" "MAT (deg F)" COEFFS 0 32 14720 0 0 1 /end COMPU_METHOD
/begin CHARACTERISTIC Tbst_MATdr_mult "Boost MAT Temp Correction Limit/Derate" CURVE 0x001C6110 /* @ECU_Address@Tbst_MATdr_mult@0x0214E000@ */ ECIPP_ALIGNMENT_SWORD 2 Compu_Tbst_MATdr_mult -2 1.99993896484375
 /begin AXIS_DESCR COM_AXIS NO_INPUT_QUANTITY Compu_Tbst_MATdr_MAT 8 -1484 563.96875 AXIS_PTS_REF Tbst_MATdr_MAT /end AXIS_DESCR
/end CHARACTERISTIC
/begin AXIS_PTS Tbst_MATdr_MAT " " 0x001C6100 /* @ECU_Address@Tbst_MATdr_MAT@0x0214D000@ */ NO_INPUT_QUANTITY ECIPP_Lookup_SWORD 0 Compu_Tbst_MATdr_MAT 8 -1484 563.96875 /end AXIS_PTS
/begin COMPU_METHOD Compu_Tbst_MATdr_mult " " RAT_FUNC "%.3" "Limit (mult)" COEFFS 0 16384 0 0 0 1 /end COMPU_METHOD
/begin COMPU_METHOD Compu_TTIPrsc_BP " " RAT_FUNC "%.2" "BP (psia)" COEFFS 0 256 0 0 0 1 /end COMPU_METHOD
/begin CHARACTERISTIC TTIPrsc_TIP_derate "Boost Altitude TIP derate" CURVE 0x001C5BAE /* @ECU_Address@TTIPrsc_TIP_derate@0x02214000@ */ ECIPP_ALIGNMENT_SWORD 100 Compu_TTIPrsc_TIP_derate -100 99.9969482421875
 /begin AXIS_DESCR COM_AXIS NO_INPUT_QUANTITY Compu_TTIPrsc_BP 4 -128 127.99609375 AXIS_PTS_REF TTIPrsc_BP /end AXIS_DESCR
/end CHARACTERISTIC
/begin AXIS_PTS TTIPrsc_BP " " 0x001C5B9E /* @ECU_Address@TTIPrsc_BP@0x02213000@ */ NO_INPUT_QUANTITY ECIPP_Lookup_SWORD 0 Compu_TTIPrsc_BP 4 -128 127.99609375 /end AXIS_PTS
/begin COMPU_METHOD Compu_TTIPrsc_TIP_derate " " RAT_FUNC "%.1" "TIP target derate (%)" COEFFS 0 327.68 0 0 0 1 /end COMPU_METHOD
/begin CHARACTERISTIC TTIPrsc_Phi_frac "Boost Altitude dPhi/dTIP fraction" CURVE 0x001C5BA6 /* @ECU_Address@TTIPrsc_Phi_frac@0x02215000@ */ ECIPP_ALIGNMENT_SWORD 1 Compu_TTIPrsc_Phi_frac -1 0.999969482421875
 /begin AXIS_DESCR COM_AXIS NO_INPUT_QUANTITY Compu_TTIPrsc_BP 4 -128 127.99609375 AXIS_PTS_REF TTIPrsc_BP /end AXIS_DESCR
/end CHARACTERISTIC
/begin COMPU_METHOD Compu_TTIPrsc_Phi_frac " " RAT_FUNC "%.2" "dPhi/dTIP Mult" COEFFS 0 32768 0 0 0 1 /end COMPU_METHOD
/begin COMPU_METHOD Compu_TTIPrsc2D_BP " " RAT_FUNC "%.2" "BP (psia)" COEFFS 0 256 0 0 0 1 /end COMPU_METHOD
/begin COMPU_METHOD Compu_TTIPrsc2D_rpm " " RAT_FUNC "%.0" "Speed (rpm)" COEFFS 0 1 0 0 0 1 /end COMPU_METHOD
/begin CHARACTERISTIC TTIPrsc2D_TIP_derate "TIP Target Derate (%)" MAP 0x001C5ABE /* @ECU_Address@TTIPrsc2D_TIP_derate@0x02296000@ */ ECIPP_ALIGNMENT_SWORD 100 Compu_TTIPrsc2D_TIP_derate -100 99.9969482421875
 /begin AXIS_DESCR COM_AXIS NO_INPUT_QUANTITY Compu_TTIPrsc2D_BP 4 -128 127.99609375 AXIS_PTS_REF TTIPrsc2D_BP /end AXIS_DESCR
 /begin AXIS_DESCR COM_AXIS NO_INPUT_QUANTITY Compu_TTIPrsc2D_rpm 8 -32768 32767 AXIS_PTS_REF TTIPrsc2D_rpm /end AXIS_DESCR
/end CHARACTERISTIC
/begin AXIS_PTS TTIPrsc2D_BP " " 0x001C59CC /* @ECU_Address@TTIPrsc2D_BP@0x02294000@ */ NO_INPUT_QUANTITY ECIPP_Lookup_SWORD 0 Compu_TTIPrsc2D_BP 4 -128 127.99609375 /end AXIS_PTS
/begin AXIS_PTS TTIPrsc2D_rpm " " 0x001C5AFE /* @ECU_Address@TTIPrsc2D_rpm@0x02295000@ */ NO_INPUT_QUANTITY ECIPP_Lookup_SWORD 0 Compu_TTIPrsc2D_rpm 8 -32768 32767 /end AXIS_PTS
/begin COMPU_METHOD Compu_TTIPrsc2D_TIP_derate "" RAT_FUNC "%.1" "Derate (%)" COEFFS 0 327.68 0 0 0 1 /end COMPU_METHOD
/begin CHARACTERISTIC TTIPrsc2D_Phi_frac "dPhi/dTIP Multiplier (fraction)" MAP 0x001C5A2E /* @ECU_Address@TTIPrsc2D_Phi_frac@0x02297000@ */ ECIPP_ALIGNMENT_SWORD 1 Compu_TTIPrsc2D_Phi_frac -1 0.999969482421875
 /begin AXIS_DESCR COM_AXIS NO_INPUT_QUANTITY Compu_TTIPrsc2D_BP 4 -128 127.99609375 AXIS_PTS_REF TTIPrsc2D_BP /end AXIS_DESCR
 /begin AXIS_DESCR COM_AXIS NO_INPUT_QUANTITY Compu_TTIPrsc2D_rpm 8 -32768 32767 AXIS_PTS_REF TTIPrsc2D_rpm /end AXIS_DESCR
/end CHARACTERISTIC
/begin COMPU_METHOD Compu_TTIPrsc2D_Phi_frac "" RAT_FUNC "%.2" "Multiplier" COEFFS 0 32768 0 0 0 1 /end COMPU_METHOD
/begin CHARACTERISTIC TTIPrsc_spk_off "Boost Altitude Spark Timing" CURVE 0x001C5BB6 /* @ECU_Address@TTIPrsc_spk_off@0x0229E000@ */ ECIPP_ALIGNMENT_SWORD 2048 Compu_TTIPrsc_spk_off -2048 2047.9375
 /begin AXIS_DESCR COM_AXIS NO_INPUT_QUANTITY Compu_TTIPrsc_BP 4 -128 127.99609375 AXIS_PTS_REF TTIPrsc_BP /end AXIS_DESCR
/end CHARACTERISTIC
/begin COMPU_METHOD Compu_TTIPrsc_spk_off " " RAT_FUNC "%.1" "Spark Offset (CAD)" COEFFS 0 16 0 0 0 1 /end COMPU_METHOD
/begin CHARACTERISTIC TTIPrsc2D_spk_off "Spark Timing Offset (CAD) / MAP Load Threshold (psia)" MAP 0x001C5B5E /* @ECU_Address@TTIPrsc2D_spk_off@0x0229F000@ */ ECIPP_ALIGNMENT_SWORD 2048 Compu_TTIPrsc2D_spk_off -2048 2047.9375
 /begin AXIS_DESCR COM_AXIS NO_INPUT_QUANTITY Compu_TTIPrsc2D_BP 4 -128 127.99609375 AXIS_PTS_REF TTIPrsc2D_BP /end AXIS_DESCR
 /begin AXIS_DESCR COM_AXIS NO_INPUT_QUANTITY Compu_TTIPrsc2D_rpm 8 -32768 32767 AXIS_PTS_REF TTIPrsc2D_rpm /end AXIS_DESCR
/end CHARACTERISTIC
/begin COMPU_METHOD Compu_TTIPrsc2D_spk_off "" RAT_FUNC "%.1" "CAD BTDCC or psia" COEFFS 0 16 0 0 0 1 /end COMPU_METHOD
/begin MEASUREMENT STR_engine_VIN "Vehicle identification number (VIN)" UBYTE Compu_ECIPP_STRINGS 0 0 0 255 ECU_ADDRESS 0x022A9000 MATRIX_DIM 19 1 1 /end MEASUREMENT
/begin CHARACTERISTIC TTC_comp_etamax "Compressor Efficiency, Flow, and Speed" CURVE 0x001E336E /* @ECU_Address@TTC_comp_etamax@0x02336000@ */ ECIPP_ALIGNMENT_SWORD 200 Compu_TTC_comp_etamax -200 199.993896484375
 /begin AXIS_DESCR COM_AXIS NO_INPUT_QUANTITY Compu_TTC_comp_Pratio 8 -16 15.99951171875 AXIS_PTS_REF TTC_comp_Pratio /end AXIS_DESCR
/end CHARACTERISTIC
/begin AXIS_PTS TTC_comp_Pratio " " 0x001E334E /* @ECU_Address@TTC_comp_Pratio@0x0233E000@ */ NO_INPUT_QUANTITY ECIPP_Lookup_SWORD 0 Compu_TTC_comp_Pratio 8 -16 15.99951171875 /end AXIS_PTS
/begin COMPU_METHOD Compu_TTC_comp_etamax " " RAT_FUNC "%.1" "Eta Max (%)" COEFFS 0 163.84 0 0 0 1 /end COMPU_METHOD
/begin COMPU_METHOD Compu_TTC_comp_Pratio " " RAT_FUNC "%.2" "Pratio (mult)" COEFFS 0 2048 0 0 0 1 /end COMPU_METHOD
/begin CHARACTERISTIC TTC_comp_surge_pct "Compressor Efficiency, Flow, and Speed" CURVE 0x001E3386 /* @ECU_Address@TTC_comp_surge_pct@0x02340000@ */ ECIPP_ALIGNMENT_SWORD 200 Compu_TTC_comp_surge_pct -200 199.993896484375
 /begin AXIS_DESCR COM_AXIS NO_INPUT_QUANTITY Compu_TTC_comp_Pratio 8 -16 15.99951171875 AXIS_PTS_REF TTC_comp_Pratio /end AXIS_DESCR
/end CHARACTERISTIC
/begin COMPU_METHOD Compu_TTC_comp_surge_pct " " RAT_FUNC "%.1" "Surge Flow (% ref)" COEFFS 0 163.84 0 0 0 1 /end COMPU_METHOD
/begin CHARACTERISTIC TTC_comp_choke_pct "Compressor Efficiency, Flow, and Speed" CURVE 0x001E335E /* @ECU_Address@TTC_comp_choke_pct@0x02341000@ */ ECIPP_ALIGNMENT_SWORD 200 Compu_TTC_comp_choke_pct -200 199.993896484375
 /begin AXIS_DESCR COM_AXIS NO_INPUT_QUANTITY Compu_TTC_comp_Pratio 8 -16 15.99951171875 AXIS_PTS_REF TTC_comp_Pratio /end AXIS_DESCR
/end CHARACTERISTIC
/begin COMPU_METHOD Compu_TTC_comp_choke_pct " " RAT_FUNC "%.1" "Choke Flow (% ref)" COEFFS 0 163.84 0 0 0 1 /end COMPU_METHOD
/begin COMPU_METHOD Compu_TTEI_EGR_TEIpct " " RAT_FUNC "%.1" "TEI Engage (%)" COEFFS 0 163.84 0 0 0 1 /end COMPU_METHOD
/begin CHARACTERISTIC TTEI_EGR_minnom "TEI EGR Min/Nom Select" CURVE 0x001C0932 /* @ECU_Address@TTEI_EGR_minnom@0x023C1000@ */ ECIPP_ALIGNMENT_SWORD 2 Compu_TTEI_EGR_minnom -2 1.99993896484375
 /begin AXIS_DESCR COM_AXIS NO_INPUT_QUANTITY Compu_TTEI_EGR_TEIpct 6 -200 199.993896484375 AXIS_PTS_REF TTEI_EGR_TEIpct /end AXIS_DESCR
/end CHARACTERISTIC
/begin AXIS_PTS TTEI_EGR_TEIpct " " 0x001C0926 /* @ECU_Address@TTEI_EGR_TEIpct@0x023C0000@ */ NO_INPUT_QUANTITY ECIPP_Lookup_SWORD 0 Compu_TTEI_EGR_TEIpct 6 -200 199.993896484375 /end AXIS_PTS
/begin COMPU_METHOD Compu_TTEI_EGR_minnom " " RAT_FUNC "%.2" "EGR Min/Nom (mult)" COEFFS 0 16384 0 0 0 1 /end COMPU_METHOD
/begin COMPU_METHOD Compu_Tappd_lwrA_rpm " " RAT_FUNC "%.0" "Engine Speed (rpm)" COEFFS 0 1 0 0 0 1 /end COMPU_METHOD
/begin CHARACTERISTIC Tbst_WGAcmd_FF "WGP Feedforward Command" MAP 0x001C61C0 /* @ECU_Address@Tbst_WGAcmd_FF@0x02583000@ */ ECIPP_ALIGNMENT_SWORD 100 Compu_Tbst_WGAcmd_FF -100 99.9969482421875
 /begin AXIS_DESCR COM_AXIS NO_INPUT_QUANTITY Compu_Tbst_Ptarg_ldcmd 8 -200 199.993896484375 AXIS_PTS_REF Tbst_Ptarg_ldcmd /end AXIS_DESCR
 /begin AXIS_DESCR COM_AXIS NO_INPUT_QUANTITY Compu_Tbst_Ptarg_rpm 8 -32768 32767 AXIS_PTS_REF Tbst_Ptarg_rpm /end AXIS_DESCR
/end CHARACTERISTIC
/begin COMPU_METHOD Compu_Tbst_WGAcmd_FF "" RAT_FUNC "%.1" "Feedforward Cmd (%)" COEFFS 0 327.68 0 0 0 1 /end COMPU_METHOD
/begin CHARACTERISTIC Tappd_lwr_delta "Lower Approach Attenuation" CURVE 0x001C60D4 /* @ECU_Address@Tappd_lwr_delta@0x02584000@ */ ECIPP_ALIGNMENT_SWORD 128 Compu_Tappd_lwr_delta -128 127.99609375
 /begin AXIS_DESCR COM_AXIS NO_INPUT_QUANTITY Compu_Tappd_lwrA_rpm 4 -32768 32767 AXIS_PTS_REF Tappd_lwrA_rpm /end AXIS_DESCR
/end CHARACTERISTIC
/begin AXIS_PTS Tappd_lwrA_rpm " " 0x001C60CC /* @ECU_Address@Tappd_lwrA_rpm@0x02531000@ */ NO_INPUT_QUANTITY ECIPP_Lookup_SWORD 0 Compu_Tappd_lwrA_rpm 4 -32768 32767 /end AXIS_PTS
/begin COMPU_METHOD Compu_Tappd_lwr_delta " " RAT_FUNC "%.2" "Delta (psi)" COEFFS 0 256 0 0 0 1 /end COMPU_METHOD
/begin CHARACTERISTIC Tappd_lwr_slew "Lower Approach Configuration" CURVE 0x001C60DC /* @ECU_Address@Tappd_lwr_slew@0x02585000@ */ ECIPP_ALIGNMENT_SWORD 1000 Compu_Tappd_lwr_slew -1000 999.969482421875
 /begin AXIS_DESCR COM_AXIS NO_INPUT_QUANTITY Compu_Tappd_lwrA_rpm 4 -32768 32767 AXIS_PTS_REF Tappd_lwrA_rpm /end AXIS_DESCR
/end CHARACTERISTIC
/begin COMPU_METHOD Compu_Tappd_lwr_slew " " RAT_FUNC "%.2" "Slew Up Rate (psi/sec)" COEFFS 0 32.768 0 0 0 1 /end COMPU_METHOD
/begin MEASUREMENT XLS_revision_hst "XLS revision 1" UWORD Compu_XLS_revision_hst 0 0 0 65535 ECU_ADDRESS 0x025BB000 MATRIX_DIM 3 1 1 /end MEASUREMENT
/begin COMPU_METHOD Compu_XLS_revision_hst " " RAT_FUNC "%.0" "-" COEFFS 0 1 0 0 0 1 /end COMPU_METHOD
/begin MEASUREMENT SVN_revision_hst "SVN revision 1" ULONG Compu_SVN_revision_hst 0 0 0 4294967295 ECU_ADDRESS 0x025BC000 MATRIX_DIM 3 1 1 /end MEASUREMENT
/begin COMPU_METHOD Compu_SVN_revision_hst " " RAT_FUNC "%.0" "-" COEFFS 0 1 0 0 0 1 /end COMPU_METHOD
/begin MEASUREMENT totalcal_CS_hst "Total calibration checksum 1" ULONG Compu_totalcal_CS_hst 0 0 0 4294967295 ECU_ADDRESS 0x025BD000 MATRIX_DIM 3 1 1 /end MEASUREMENT
/begin COMPU_METHOD Compu_totalcal_CS_hst " " RAT_FUNC "%.0" "-" COEFFS 0 1 0 0 0 1 /end COMPU_METHOD
/begin MEASUREMENT HM_seconds_hst "Hour meter 1" ULONG Compu_HM_seconds_hst 0 0 0 1193046.47083333 ECU_ADDRESS 0x025BE000 MATRIX_DIM 3 1 1 /end MEASUREMENT
/begin COMPU_METHOD Compu_HM_seconds_hst " " RAT_FUNC "%.3" "-" COEFFS 0 3600 0 0 0 1 /end COMPU_METHOD
/begin CHARACTERISTIC STR_cust_DM1part "Cust data 1 name/number" ASCII 0x001C8E77 /* @ECU_Address@STR_cust_DM1part@0x0261D000@ */ ECIPP_ALIGNMENT_UBYTE 255 Compu_ECIPP_STRINGS 0 255 MATRIX_DIM 19 1 1 /end CHARACTERISTIC
/begin CHARACTERISTIC STR_cust_DM2part "Cust data 2 name/number" ASCII 0x001C8E8B /* @ECU_Address@STR_cust_DM2part@0x0261E000@ */ ECIPP_ALIGNMENT_UBYTE 255 Compu_ECIPP_STRINGS 0 255 MATRIX_DIM 19 1 1 /end CHARACTERISTIC
/begin COMPU_METHOD Compu_Tbst_FSO_rpm " " RAT_FUNC "%.0" "Speed (rpm)" COEFFS 0 1 0 0 0 1 /end COMPU_METHOD
/begin CHARACTERISTIC Tbst_FSO_Ptarg "TIP Target During FSO Throttle-Open" CURVE 0x001C8278 /* @ECU_Address@Tbst_FSO_Ptarg@0x02657000@ */ ECIPP_ALIGNMENT_UWORD 256 Compu_Tbst_FSO_Ptarg 0 255.99609375
 /begin AXIS_DESCR COM_AXIS NO_INPUT_QUANTITY Compu_Tbst_FSO_rpm 4 -32768 32767 AXIS_PTS_REF Tbst_FSO_rpm /end AXIS_DESCR
/end CHARACTERISTIC
/begin AXIS_PTS Tbst_FSO_rpm " " 0x001C60F8 /* @ECU_Address@Tbst_FSO_rpm@0x02656000@ */ NO_INPUT_QUANTITY ECIPP_Lookup_SWORD 0 Compu_Tbst_FSO_rpm 4 -32768 32767 /end AXIS_PTS
/begin COMPU_METHOD Compu_Tbst_FSO_Ptarg " " RAT_FUNC "%.2" "TIP Target (psia)" COEFFS 0 256 0 0 0 1 /end COMPU_METHOD
/begin CHARACTERISTIC STR_cal_pwd_hint "Cal hint" ASCII 0x001E9A28 /* @ECU_Address@STR_cal_pwd_hint@0x0265B000@ */ ECIPP_ALIGNMENT_UBYTE 255 Compu_ECIPP_STRINGS 0 255 MATRIX_DIM 19 1 1 /end CHARACTERISTIC
/begin COMPU_METHOD Compu_Tappd_mult_BP " " RAT_FUNC "%.2" "BP (psia)" COEFFS 0 256 0 0 0 1 /end COMPU_METHOD
/begin CHARACTERISTIC Tappd_mult_pct "Lower Approach Delta Altitude Compensation" CURVE 0x001C60EE /* @ECU_Address@Tappd_mult_pct@0x026A9000@ */ ECIPP_ALIGNMENT_SWORD 100 Compu_Tappd_mult_pct -100 99.9969482421875
 /begin AXIS_DESCR COM_AXIS NO_INPUT_QUANTITY Compu_Tappd_mult_BP 5 -128 127.99609375 AXIS_PTS_REF Tappd_mult_BP /end AXIS_DESCR
/end CHARACTERISTIC
/begin AXIS_PTS Tappd_mult_BP " " 0x001C60E4 /* @ECU_Address@Tappd_mult_BP@0x026A8000@ */ NO_INPUT_QUANTITY ECIPP_Lookup_SWORD 0 Compu_Tappd_mult_BP 5 -128 127.99609375 /end AXIS_PTS
/begin COMPU_METHOD Compu_Tappd_mult_pct " " RAT_FUNC "%.1" "Multiplier (%)" COEFFS 0 327.68 0 0 0 1 /end COMPU_METHOD
/begin COMPU_METHOD Compu_TTIPrsc2D_BP_Exp " " RAT_FUNC "%.2" "BP (psia)" COEFFS 0 256 0 0 0 1 /end COMPU_METHOD
/begin CHARACTERISTIC TTIPrsc2D_TIP_Exp "TIP Target Derate (%) / Load-Limit (%)" MAP 0x001C5A6E /* @ECU_Address@TTIPrsc2D_TIP_Exp@0x026AB000@ */ ECIPP_ALIGNMENT_SWORD 100 Compu_TTIPrsc2D_TIP_Exp -100 99.9969482421875
 /begin AXIS_DESCR COM_AXIS NO_INPUT_QUANTITY Compu_TTIPrsc2D_BP_Exp 5 -128 127.99609375 AXIS_PTS_REF TTIPrsc2D_BP_Exp /end AXIS_DESCR
 /begin AXIS_DESCR COM_AXIS NO_INPUT_QUANTITY Compu_TTIPrsc2D_rpm 8 -32768 32767 AXIS_PTS_REF TTIPrsc2D_rpm /end AXIS_DESCR
/end CHARACTERISTIC
/begin AXIS_PTS TTIPrsc2D_BP_Exp " " 0x001C59D4 /* @ECU_Address@TTIPrsc2D_BP_Exp@0x026AA000@ */ NO_INPUT_QUANTITY ECIPP_Lookup_SWORD 0 Compu_TTIPrsc2D_BP_Exp 5 -128 127.99609375 /end AXIS_PTS
/begin COMPU_METHOD Compu_TTIPrsc2D_TIP_Exp "" RAT_FUNC "%.1" "Derate (%)" COEFFS 0 327.68 0 0 0 1 /end COMPU_METHOD
/begin CHARACTERISTIC TTIPrsc2D_Phi_Exp "dPhi/dTIP Multiplier (fraction) / EGR MinNom (fraction)" MAP 0x001C59DE /* @ECU_Address@TTIPrsc2D_Phi_Exp@0x026AC000@ */ ECIPP_ALIGNMENT_SWORD 1 Compu_TTIPrsc2D_Phi_Exp -1 0.999969482421875
 /begin AXIS_DESCR COM_AXIS NO_INPUT_QUANTITY Compu_TTIPrsc2D_BP_Exp 5 -128 127.99609375 AXIS_PTS_REF TTIPrsc2D_BP_Exp /end AXIS_DESCR
 /begin AXIS_DESCR COM_AXIS NO_INPUT_QUANTITY Compu_TTIPrsc2D_rpm 8 -32768 32767 AXIS_PTS_REF TTIPrsc2D_rpm /end AXIS_DESCR
/end CHARACTERISTIC
/begin COMPU_METHOD Compu_TTIPrsc2D_Phi_Exp "" RAT_FUNC "%.2" "Multiplier" COEFFS 0 32768 0 0 0 1 /end COMPU_METHOD
/begin CHARACTERISTIC TTIPrsc2D_spk_Exp "Spark Timing Offset (CAD) / MAP Load Threshold (psia)" MAP 0x001C5B0E /* @ECU_Address@TTIPrsc2D_spk_Exp@0x026AD000@ */ ECIPP_ALIGNMENT_SWORD 2048 Compu_TTIPrsc2D_spk_Exp -2048 2047.9375
 /begin AXIS_DESCR COM_AXIS NO_INPUT_QUANTITY Compu_TTIPrsc2D_BP_Exp 5 -128 127.99609375 AXIS_PTS_REF TTIPrsc2D_BP_Exp /end AXIS_DESCR
 /begin AXIS_DESCR COM_AXIS NO_INPUT_QUANTITY Compu_TTIPrsc2D_rpm 8 -32768 32767 AXIS_PTS_REF TTIPrsc2D_rpm /end AXIS_DESCR
/end CHARACTERISTIC
/begin COMPU_METHOD Compu_TTIPrsc2D_spk_Exp "" RAT_FUNC "%.1" "CAD BTDCC or psia" COEFFS 0 16 0 0 0 1 /end COMPU_METHOD
/begin COMPU_METHOD Compu_TTEI_altd_BP " " RAT_FUNC "%.2" "BP (psia)" COEFFS 0 256 0 0 0 1 /end COMPU_METHOD
/begin CHARACTERISTIC TTEI_altd_pct "TEI Altitude Compensation" CURVE 0x001C8226 /* @ECU_Address@TTEI_altd_pct@0x026B1000@ */ ECIPP_ALIGNMENT_UWORD 200 Compu_TTEI_altd_pct 0 199.996948242188
 /begin AXIS_DESCR COM_AXIS NO_INPUT_QUANTITY Compu_TTEI_altd_BP 5 -128 127.99609375 AXIS_PTS_REF TTEI_altd_BP /end AXIS_DESCR
/end CHARACTERISTIC
/begin AXIS_PTS TTEI_altd_BP " " 0x001C59C2 /* @ECU_Address@TTEI_altd_BP@0x026B0000@ */ NO_INPUT_QUANTITY ECIPP_Lookup_SWORD 0 Compu_TTEI_altd_BP 5 -128 127.99609375 /end AXIS_PTS
/begin COMPU_METHOD Compu_TTEI_altd_pct " " RAT_FUNC "%.1" "TEI (%)" COEFFS 0 327.68 0 0 0 1 /end COMPU_METHOD
/begin GROUP EC_Main "ECONTROLS" ROOT
 /begin REF_CHARACTERISTIC max_gov_rpm DATE_gov_desc Ncyl OilP_type CylFireOrder1 CylFireOrder2 CylFireOrder3 CylFireOrder4 CylFireOrder5 CylFireOrder6 CylFireOrder7 CylFireOrder8 Vd spark_type CylFireOrder9 CylFireOrder10 reprog_security enhanced_security cal_pwd_ena CylFireOrder11 CylFireOrder12 STR_cust_HWpart STR_cust_SWpart STR_gov_desc STR_cust_DM1part STR_cust_DM2part STR_cal_pwd_hint /end REF_CHARACTERISTIC
 /begin REF_MEASUREMENT rpm run_mode power_mode fuel_type PW_avg FaultSysFlag Vbat FPP_pct TPS_pct fuel_ctl_mode min_gov_rpm rMAP rECT rIAT OILP_press gov_sw_state gov_type gov_mode rpmd_gain OILP_state HM_RAM_seconds HM_RAM_starts emcal_CS_32 totalcal_CS_32 FuelSpk_SD_active fuel_supply XLS_Revision svn_revision svn_compile_date svn_compile_status CB1pre_volts CB1pst_volts CB2pre_volts CB2pst_volts DATE_engine_mfg boot_revision TID_table TSoftID_table STR_engine_PN STR_engine_SN STR_engine_VIN XLS_revision_hst SVN_revision_hst totalcal_CS_hst HM_seconds_hst /end REF_MEASUREMENT
/end GROUP
/begin GROUP EC_AirSmoke "ECONTROLS" ROOT /begin REF_CHARACTERISTIC SMK_mode SMK_lmt_persist_min /end REF_CHARACTERISTIC
 /begin REF_MEASUREMENT MAPressure ECT MAT IAT FaultSysFlag Vbat Vsw gov_eng_load_d CHT gov_type FPP_cmd_predz CRI_Prail_actual CRI_mg_main CRI_mg_pilot2 CRI_mg_pilot1 CRI_mg_post1 CRI_mg_post2 CRI_cad_main CRI_cad_pilot2 CRI_cad_pilot1 CRI_cad_post1 CRI_cad_post2 CRI_width_main CRI_width_pilot2 CRI_width_pilot1 CRI_width_post1 CRI_width_post2 CRI_mg_load CRI_mg_total load_cmd_pct m_a_port_cmd CRI_smk_lmt_mg CRI_smk_adjust_mg CRI_smk_lmt_active manual_air_mode manual_air_cmd CRI_mg_load_nosmk /end REF_MEASUREMENT
/end GROUP
/begin GROUP EC_Boost "ECONTROLS" ROOT
 /begin REF_CHARACTERISTIC MAP_fl_scaling bst_mode bst_WGPneut bst_Kp_TIP bst_Ki_TIP bst_Kp_WGP bst_Ki_WGP bst_WGAVmin bst_WGAVmax bst_Kd_WGP bst_Kiv_WGP WGP_dot_window WGP_dot_tau bst_IATnom bst_Kd_TIP bst_Kiv_TIP TIP_dot_window TIP_dot_tau TIP_dot_dzlim bst_WGPsource bst_WGPsource_Pc bst_WGPd_tau bst_WGAcmd_tau bst_WGPd_dotena bst_TPS_filt bst_rpm_tau bst_TIP_tau WGP_ena bst_supercharge bst_Ksc_MAP bst_Ksc_DP bst_WGAchan bst_WGPWM_type bst_WGPWM_per bst_discrete_gov bst_IAT_crct_ena bst_carb_dP_ena bst_dP_limit_ena bst_dP_limit_min bst_WGAcmd_FF bst_WGAact_tau bst_TPS_dmdot_ena bst_dmdot_inc bst_dCdA_margin bst_appd_enabled bst_appd_upr_delta bst_appd_upr_slew bst_appd_upr_slew_m bst_appd_lwr_slew_m bst_WGAcmd_FF_source bst_MAPd_dttau bst_TIPMAPd_dttau bst_TIP_atten_psi bst_Kp_TIP_atten bst_Ki_TIP_atten bst_Kd_TIP_atten bst_TIP_Iacc_mode bst_appd_lwr_offset bst_appd_lwr_time bst_Kiv_ena_TIPe bst_Kiv_dis_TIPe bst_Kiv_dis_time bst_appd_lwr_mode TMAP_noload TMAP_fullload Tbst_Ptarg_P Tbst_WGAcmd_FF Tappd_lwr_delta Tappd_lwr_slew Tbst_FSO_Ptarg Tappd_mult_pct /end REF_CHARACTERISTIC
 /begin REF_MEASUREMENT MAPressure ECT MAT IAT FaultSysFlag BP CHT TIP WGP_dot TIP_dot TIP_dot_dz bst_WGPd_dot bst_loadcmd bst_IAT_crct bst_MAT_derate bst_Temp_mult bst_TPSd bst_dPd bst_MAPd bst_TIPd bst_Iacc_TIP bst_WGPd bst_Iacc_WGP bst_WGAcmd bst_WGAcmd_V bst_WGAcmd_DC bst_WGP_test bst_WGPdi rTOP bst_TOPd bst_dP_limit_active bst_Ptarg_P bst_TIP_Iacc_low bst_TIP_Iacc_high bst_WGPa bst_WGAact MAP_load bst_MAPd_load EGR_TPSdP_min bst_TPSd_raw bst_TIPdapp bst_appd_lwr_d_pt bst_appd_upr_d_pt bst_appd_lwr_m_pt bst_appd_upr_m_pt bst_WGAcmd_FF_tbl bst_WGPe bst_rpm bst_TIP bst_MAPd_dt bst_TIPMAPd_dt bst_MAPd_load_max WGCV_state WGCV_fault_code /end REF_MEASUREMENT
/end GROUP
/begin GROUP EC_BoostAlt "ECONTROLS" ROOT
 /begin REF_CHARACTERISTIC bst_WGPnl_ena TEI_mode TEI_max_enrich TEI_max_retard TEI_TIP_span TEI_TIP_dz TEI_full_t TEI_trans_t TEI_reset_t TEI_rpm_lower TEI_rpm_upper TEI_FPP_dz bst_BP_enabled CAC_dP_C CAC_dP_nom CAC_eta_nom TC_comp_Tint_tau_nom TC_turb_Tint_tau_nom TC_mdot_avg_tau TC_mdot_nom TC_mech_eta TC_comp_A_emiss TC_turb_A_emiss TC_comp_C_thermal TC_turb_C_thermal TC_N_mode TC_N_PWM_edge TC_N_PWM_periods TC_N_tau TC_N_pulses_rev TC_comp_eta_surge TC_comp_eta_choke TC_comp_Pratio_min TC_comp_mdotr_Ld TC_comp_Nr TEI_BP_lo_off TEI_BP_hi_on AFILTdP_ena diesel_altd_ena diesel_altd_LMS_std diesel_altd_LMS_hi diesel_altd_BP_std diesel_altd_BP_hi TC_comp_mdotc_pcttau bst_BP_LL_tau bst_BP_MAP_load_dlt TC_model_type TC_comp_fac_hAint TC_comp_hAext TC_comp_Text TC_comp_Td_COT TC_turb_fac_hAint TC_turb_hAext TC_turb_Text TC_turb_Td_COT TC_turb_fac_hx_temp TIPrsc2D_tbl_mode Tbst_WGPnl_out Tbst_MATdr_mult TTIPrsc_TIP_derate TTIPrsc_Phi_frac TTIPrsc2D_TIP_derate TTIPrsc2D_Phi_frac TTIPrsc_spk_off TTIPrsc2D_spk_off TTC_comp_etamax TTC_comp_surge_pct TTC_comp_choke_pct TTEI_EGR_minnom TTIPrsc2D_TIP_Exp TTIPrsc2D_Phi_Exp TTIPrsc2D_spk_Exp TTEI_altd_pct /end REF_CHARACTERISTIC
 /begin REF_MEASUREMENT MAPressure ECT MAT IAT FaultSysFlag BP EBP EGT CHT TIP bst_BP_lim TEI_enrich TEI_retard TEI_enable bst_BP_phifrac spk_off_BP TC_comp_eta CAC_eta CIP COP COT TOT_mdl TC_comp_mdotc TC_comp_Pratio TC_turb_Pratio TC_surge_Pratio pulse_Hz_capture rs_Hz_capture TC_comp_Tint TC_turb_Tint EMP TC_comp_etamax TC_comp_mdot_margin TC_N_actual TC_comp_Nc TC_comp_Npct TC_comp_mdotr TEI_total_pct TEI_EGR_minnom COT_mdl EGR_minnom_bst_BP bst_BP_loadlim AFILTdP_inst AFILTdP diesel_altd_mult diesel_altd_LMS_pct TC_comp_mdotc_pct_lp bst_BP_MAP_load bst_BP_MAP_load_app bst_BP_oct_derate CIT diesel_altd_LMS_torq /end REF_MEASUREMENT
/end GROUP
/begin GROUP EC_CalTools "ECONTROLS" ROOT
 /begin REF_MEASUREMENT MAPressure ECT MAT IAT run_mode power_mode fuel_type FaultSysFlag BP fuel_ctl_mode CHT gov_sw_state gov_type gov_mode /end REF_MEASUREMENT
/end GROUP
/begin GROUP EC_Cam "ECONTROLS" ROOT /begin REF_MEASUREMENT MAPressure ECT MAT IAT FaultSysFlag BP CHT TIP /end REF_MEASUREMENT /end GROUP
/begin GROUP EC_Catalyst "ECONTROLS" ROOT
 /begin REF_MEASUREMENT MAPressure ECT MAT IAT fuel_type FaultSysFlag CHT HM_RAM_seconds CB1pre_volts CB1pst_volts CB2pre_volts CB2pst_volts /end REF_MEASUREMENT
/end GROUP
/begin GROUP EC_CLCalGsln "ECONTROLS" ROOT
 /begin REF_MEASUREMENT MAPressure ECT MAT IAT fuel_type PW_avg FaultSysFlag fuel_ctl_mode CB1pre_volts CB1pst_volts CB2pre_volts CB2pst_volts MAP_load /end REF_MEASUREMENT
/end GROUP
/begin GROUP EC_CLCalLP "ECONTROLS" ROOT
 /begin REF_MEASUREMENT MAPressure ECT MAT IAT fuel_type PW_avg FaultSysFlag fuel_ctl_mode CB1pre_volts CB1pst_volts CB2pre_volts MAP_load /end REF_MEASUREMENT
/end GROUP
/begin GROUP EC_CLCalNG "ECONTROLS" ROOT
 /begin REF_MEASUREMENT MAPressure ECT MAT IAT fuel_type PW_avg FaultSysFlag fuel_ctl_mode CB1pre_volts CB1pst_volts CB2pre_volts MAP_load /end REF_MEASUREMENT
/end GROUP
/begin GROUP EC_ColdStart "ECONTROLS" ROOT
 /begin REF_MEASUREMENT MAPressure ECT MAT IAT FaultSysFlag Vbat Vsw gov_eng_load_d CHT gov_type FPP_cmd_predz CRI_Prail_actual CRI_mg_main CRI_mg_pilot2 CRI_mg_pilot1 CRI_mg_post1 CRI_mg_post2 CRI_cad_main CRI_cad_pilot2 CRI_cad_pilot1 CRI_cad_post1 CRI_cad_post2 CRI_width_main CRI_width_pilot2 CRI_width_pilot1 CRI_width_post1 CRI_width_post2 CRI_mg_load CRI_mg_total load_cmd_pct CRI_smk_adjust_mg CRI_smk_lmt_active CRI_mg_load_nosmk /end REF_MEASUREMENT
/end GROUP
/begin GROUP EC_Comms "ECONTROLS" ROOT
 /begin REF_MEASUREMENT rpm MAPressure ECT IAT run_mode fuel_type FaultSysFlag Vbat Vsw fuel_ctl_mode gov_sw_state gov_type gov_mode OILP_state /end REF_MEASUREMENT
/end GROUP
/begin GROUP EC_ConfigApp "ECONTROLS" ROOT
 /begin REF_MEASUREMENT MAPressure ECT MAT IAT run_mode power_mode fuel_type FaultSysFlag BP fuel_ctl_mode CHT gov_sw_state gov_type gov_mode /end REF_MEASUREMENT
/end GROUP
/begin GROUP EC_ConfigEng "ECONTROLS" ROOT /begin REF_CHARACTERISTIC OilP_type /end REF_CHARACTERISTIC
 /begin REF_MEASUREMENT MAPressure ECT MAT IAT run_mode power_mode fuel_type FaultSysFlag BP fuel_ctl_mode CHT OILP_press gov_sw_state gov_type gov_mode OILP_state HM_RAM_seconds HM_RAM_starts DATE_engine_mfg /end REF_MEASUREMENT
/end GROUP
/begin GROUP EC_DBWCal "ECONTROLS" ROOT
 /begin REF_MEASUREMENT MAPressure ECT MAT FaultSysFlag BP FPP_pct TPS_pct FPP_cmd_predz /end REF_MEASUREMENT
/end GROUP
/begin GROUP EC_Derate "ECONTROLS" ROOT /begin REF_MEASUREMENT MAPressure ECT MAT IAT FaultSysFlag BP CHT /end REF_MEASUREMENT /end GROUP
/begin GROUP EC_DieselMode "ECONTROLS" ROOT
 /begin REF_MEASUREMENT MAPressure ECT MAT IAT FaultSysFlag Vbat Vsw gov_eng_load_d CHT gov_type FPP_cmd_predz CRI_mg_main CRI_mg_pilot2 CRI_mg_pilot1 CRI_mg_post1 CRI_mg_post2 CRI_cad_main CRI_cad_pilot2 CRI_cad_pilot1 CRI_cad_post1 CRI_cad_post2 CRI_width_main CRI_width_pilot2 CRI_width_pilot1 CRI_width_post1 CRI_width_post2 CRI_mg_load CRI_mg_total load_cmd_pct m_a_port_cmd CRI_smk_adjust_mg CRI_smk_lmt_active CRI_mg_load_nosmk /end REF_MEASUREMENT
/end GROUP
/begin GROUP EC_DPF "ECONTROLS" ROOT
 /begin REF_MEASUREMENT MAPressure ECT MAT IAT FaultSysFlag Vbat Vsw EGT gov_eng_load_d CHT gov_type FPP_cmd_predz CRI_Prail_actual CRI_mg_main CRI_mg_pilot2 CRI_mg_pilot1 CRI_mg_post1 CRI_mg_post2 CRI_cad_main CRI_cad_pilot2 CRI_cad_pilot1 CRI_cad_post1 CRI_cad_post2 CRI_width_main CRI_width_pilot2 CRI_width_pilot1 CRI_width_post1 CRI_width_post2 CRI_mg_load CRI_mg_total load_cmd_pct CRI_smk_adjust_mg CRI_smk_lmt_active CRI_mg_load_nosmk /end REF_MEASUREMENT
/end GROUP
/begin GROUP EC_EGOConfig "ECONTROLS" ROOT
 /begin REF_MEASUREMENT MAPressure ECT IAT FaultSysFlag CB1pre_volts CB1pst_volts CB2pre_volts CB2pst_volts /end REF_MEASUREMENT
/end GROUP
/begin GROUP EC_EGRAux "ECONTROLS" ROOT
 /begin REF_MEASUREMENT MAPressure ECT IAT FaultSysFlag TIP COT MAP_load EGR_TPSdP_min /end REF_MEASUREMENT
/end GROUP
/begin GROUP EC_EGRCommand "ECONTROLS" ROOT
 /begin REF_MEASUREMENT MAPressure ECT IAT FaultSysFlag TIP MAP_load TEI_EGR_minnom EGR_minnom_bst_BP /end REF_MEASUREMENT
/end GROUP
/begin GROUP EC_EGRControl "ECONTROLS" ROOT /begin REF_MEASUREMENT MAPressure ECT IAT FaultSysFlag TIP MAP_load /end REF_MEASUREMENT /end GROUP
/begin GROUP EC_FaultCfg "ECONTROLS" ROOT
 /begin REF_MEASUREMENT rpm MAPressure ECT MAT IAT run_mode power_mode FaultSysFlag CHT OILP_press /end REF_MEASUREMENT
/end GROUP
/begin GROUP EC_FaultMon "ECONTROLS" ROOT /begin REF_MEASUREMENT rpm MAPressure ECT FaultSysFlag /end REF_MEASUREMENT /end GROUP
/begin GROUP EC_Faults "ECONTROLS" ROOT
 /begin REF_CHARACTERISTIC CylFireOrder1 CylFireOrder2 CylFireOrder3 CylFireOrder4 CylFireOrder5 CylFireOrder6 CylFireOrder7 CylFireOrder8 CylFireOrder9 CylFireOrder10 CylFireOrder11 CylFireOrder12 /end REF_CHARACTERISTIC
 /begin REF_MEASUREMENT rpm MAT run_mode power_mode fuel_type FaultSysFlag BP Vbat Vsw FPP_pct TPS_pct fuel_ctl_mode CHT rMAP rECT rIAT gov_sw_state gov_type gov_mode rpmd_gain OILP_state HM_RAM_seconds HM_RAM_starts FuelSpk_SD_active fuel_supply /end REF_MEASUREMENT
/end GROUP
/begin GROUP EC_FilterCal "ECONTROLS" ROOT /begin REF_MEASUREMENT MAPressure ECT MAT IAT FaultSysFlag CHT EMP /end REF_MEASUREMENT /end GROUP
/begin GROUP EC_Fuel "ECONTROLS" ROOT
 /begin REF_CHARACTERISTIC CylFireOrder1 CylFireOrder2 CylFireOrder3 CylFireOrder4 CylFireOrder5 CylFireOrder6 CylFireOrder7 CylFireOrder8 CylFireOrder9 CylFireOrder10 CylFireOrder11 CylFireOrder12 /end REF_CHARACTERISTIC
 /begin REF_MEASUREMENT MAPressure ECT MAT IAT fuel_type PW_avg FaultSysFlag Vbat Vsw CHT /end REF_MEASUREMENT
/end GROUP
/begin GROUP EC_FuelRail "ECONTROLS" ROOT
 /begin REF_MEASUREMENT MAPressure ECT MAT IAT FaultSysFlag Vbat Vsw gov_eng_load_d CHT gov_type FPP_cmd_predz CRI_Prail_actual CRI_mg_main CRI_mg_pilot2 CRI_mg_pilot1 CRI_mg_post1 CRI_mg_post2 CRI_cad_main CRI_cad_pilot2 CRI_cad_pilot1 CRI_cad_post1 CRI_cad_post2 CRI_width_main CRI_width_pilot2 CRI_width_pilot1 CRI_width_post1 CRI_width_post2 CRI_mg_load CRI_mg_total load_cmd_pct m_a_port_cmd CRI_smk_adjust_mg CRI_smk_lmt_active CRI_mg_load_nosmk /end REF_MEASUREMENT
/end GROUP
/begin GROUP EC_FuelSecond "ECONTROLS" ROOT
 /begin REF_CHARACTERISTIC CylFireOrder1 CylFireOrder2 CylFireOrder3 CylFireOrder4 CylFireOrder5 CylFireOrder6 CylFireOrder7 CylFireOrder8 CylFireOrder9 CylFireOrder10 CylFireOrder11 CylFireOrder12 /end REF_CHARACTERISTIC
 /begin REF_MEASUREMENT MAPressure ECT MAT IAT fuel_type PW_avg FaultSysFlag Vbat Vsw CHT /end REF_MEASUREMENT
/end GROUP
/begin GROUP EC_GaugeDrive "ECONTROLS" ROOT /begin REF_CHARACTERISTIC OilP_type /end REF_CHARACTERISTIC /begin REF_MEASUREMENT MAT FaultSysFlag CHT rMAP rECT rIAT OILP_press /end REF_MEASUREMENT /end GROUP
/begin GROUP EC_GovCal "ECONTROLS" ROOT
 /begin REF_MEASUREMENT MAPressure ECT MAT fuel_type FaultSysFlag TPS_pct min_gov_rpm gov_eng_load_d TIP gov_sw_state gov_type gov_mode rpmd_gain MAP_load /end REF_MEASUREMENT
/end GROUP
/begin GROUP EC_GovCalAlt "ECONTROLS" ROOT
 /begin REF_MEASUREMENT MAPressure ECT MAT fuel_type FaultSysFlag TPS_pct min_gov_rpm gov_eng_load_d TIP gov_sw_state gov_type gov_mode rpmd_gain /end REF_MEASUREMENT
/end GROUP
/begin GROUP EC_HDOBD "ECONTROLS" ROOT
 /begin REF_MEASUREMENT rpm MAPressure ECT MAT IAT run_mode power_mode FaultSysFlag Vbat Vsw CHT /end REF_MEASUREMENT
/end GROUP
/begin GROUP EC_HDService "ECONTROLS" ROOT
 /begin REF_MEASUREMENT MAPressure ECT MAT IAT FaultSysFlag BP CHT TIP HM_RAM_seconds HM_RAM_starts bst_MAPd bst_TIPd bst_WGPd bst_WGAcmd_V bst_WGAcmd_DC bst_WGP_test DATE_engine_mfg TID_table /end REF_MEASUREMENT
/end GROUP
/begin GROUP EC_HDService2 "ECONTROLS" ROOT /begin REF_MEASUREMENT MAPressure ECT MAT IAT FaultSysFlag CHT TIP /end REF_MEASUREMENT /end GROUP
/begin GROUP EC_HWConfig "ECONTROLS" ROOT
 /begin REF_MEASUREMENT rpm MAPressure ECT FaultSysFlag XLS_Revision svn_revision svn_compile_date svn_compile_status boot_revision /end REF_MEASUREMENT
/end GROUP
/begin GROUP EC_IOMap "ECONTROLS" ROOT /begin REF_MEASUREMENT FaultSysFlag /end REF_MEASUREMENT /end GROUP
/begin GROUP EC_Knock "ECONTROLS" ROOT
 /begin REF_CHARACTERISTIC CylFireOrder1 CylFireOrder2 CylFireOrder3 CylFireOrder4 CylFireOrder5 CylFireOrder6 CylFireOrder7 CylFireOrder8 CylFireOrder9 CylFireOrder10 CylFireOrder11 CylFireOrder12 /end REF_CHARACTERISTIC
 /begin REF_MEASUREMENT MAPressure ECT MAT IAT FaultSysFlag CHT spk_off_BP MAP_load /end REF_MEASUREMENT
/end GROUP
/begin GROUP EC_LDService "ECONTROLS" ROOT
 /begin REF_MEASUREMENT rpm fuel_type FaultSysFlag Vbat Vsw FPP_pct TPS_pct fuel_ctl_mode rECT rIAT OILP_state MAP_load /end REF_MEASUREMENT
/end GROUP
/begin GROUP EC_LEService "ECONTROLS" ROOT
 /begin REF_CHARACTERISTIC CylFireOrder1 CylFireOrder2 CylFireOrder3 CylFireOrder4 CylFireOrder5 CylFireOrder6 CylFireOrder7 CylFireOrder8 CylFireOrder9 CylFireOrder10 CylFireOrder11 CylFireOrder12 /end REF_CHARACTERISTIC
 /begin REF_MEASUREMENT rpm run_mode power_mode fuel_type FaultSysFlag BP Vbat Vsw TPS_pct EGT fuel_ctl_mode rMAP rECT rIAT OILP_press TIP gov_sw_state gov_type gov_mode HM_RAM_seconds FuelSpk_SD_active fuel_supply /end REF_MEASUREMENT
/end GROUP
/begin GROUP EC_LoadCal "ECONTROLS" ROOT /begin REF_CHARACTERISTIC MAP_fl_scaling TMAP_noload TMAP_fullload /end REF_CHARACTERISTIC
 /begin REF_MEASUREMENT MAPressure ECT MAT IAT FaultSysFlag BP TPS_pct CHT TIP FPP_cmd_predz MAP_load /end REF_MEASUREMENT
/end GROUP
/begin GROUP EC_Marine "ECONTROLS" ROOT /begin REF_MEASUREMENT rpm MAPressure ECT IAT FaultSysFlag BP Vbat Vsw /end REF_MEASUREMENT /end GROUP
/begin GROUP EC_Megajector "ECONTROLS" ROOT /begin REF_MEASUREMENT MAPressure ECT MAT IAT FaultSysFlag /end REF_MEASUREMENT /end GROUP
/begin GROUP EC_Misfire "ECONTROLS" ROOT
 /begin REF_CHARACTERISTIC CylFireOrder1 CylFireOrder2 CylFireOrder3 CylFireOrder4 CylFireOrder5 CylFireOrder6 CylFireOrder7 CylFireOrder8 CylFireOrder9 CylFireOrder10 CylFireOrder11 CylFireOrder12 /end REF_CHARACTERISTIC
 /begin REF_MEASUREMENT MAPressure ECT IAT FaultSysFlag /end REF_MEASUREMENT
/end GROUP
/begin GROUP EC_OEMEOLConf "ECONTROLS" ROOT /begin REF_MEASUREMENT FaultSysFlag /end REF_MEASUREMENT /end GROUP
/begin GROUP EC_Outputs "ECONTROLS" ROOT /begin REF_CHARACTERISTIC OilP_type /end REF_CHARACTERISTIC /begin REF_MEASUREMENT MAPressure ECT MAT IAT FaultSysFlag CHT OILP_press /end REF_MEASUREMENT /end GROUP
/begin GROUP EC_PhiGsln "ECONTROLS" ROOT
 /begin REF_MEASUREMENT MAPressure ECT MAT IAT PW_avg FaultSysFlag CHT bst_BP_phifrac MAP_load /end REF_MEASUREMENT
/end GROUP
/begin GROUP EC_PhiLP "ECONTROLS" ROOT
 /begin REF_MEASUREMENT MAPressure ECT MAT IAT fuel_type FaultSysFlag fuel_ctl_mode MAP_load /end REF_MEASUREMENT
/end GROUP
/begin GROUP EC_PhiNG "ECONTROLS" ROOT
 /begin REF_MEASUREMENT MAPressure ECT MAT IAT fuel_type FaultSysFlag fuel_ctl_mode MAP_load /end REF_MEASUREMENT
/end GROUP
/begin GROUP EC_PowerMon "ECONTROLS" ROOT
 /begin REF_CHARACTERISTIC CylFireOrder1 CylFireOrder2 CylFireOrder3 CylFireOrder4 CylFireOrder5 CylFireOrder6 CylFireOrder7 CylFireOrder8 CylFireOrder9 CylFireOrder10 CylFireOrder11 CylFireOrder12 /end REF_CHARACTERISTIC
 /begin REF_MEASUREMENT MAPressure ECT MAT IAT FaultSysFlag BP CHT /end REF_MEASUREMENT
/end GROUP
/begin GROUP EC_QTgeneric "ECONTROLS" ROOT
 /begin REF_MEASUREMENT MAPressure ECT MAT IAT FaultSysFlag Vbat Vsw gov_eng_load_d CHT gov_type FPP_cmd_predz CRI_Prail_actual CRI_mg_main CRI_mg_pilot2 CRI_mg_pilot1 CRI_mg_post1 CRI_mg_post2 CRI_cad_main CRI_cad_pilot2 CRI_cad_pilot1 CRI_cad_post1 CRI_cad_post2 CRI_width_main CRI_width_pilot2 CRI_width_pilot1 CRI_width_post1 CRI_width_post2 CRI_mg_load CRI_mg_total load_cmd_pct CRI_smk_adjust_mg CRI_smk_lmt_active CRI_mg_load_nosmk /end REF_MEASUREMENT
/end GROUP
/begin GROUP EC_QTpilot2 "ECONTROLS" ROOT
 /begin REF_MEASUREMENT MAPressure ECT MAT IAT FaultSysFlag Vbat Vsw gov_eng_load_d CHT gov_type FPP_cmd_predz CRI_Prail_actual CRI_mg_main CRI_mg_pilot2 CRI_mg_pilot1 CRI_mg_post1 CRI_mg_post2 CRI_cad_main CRI_cad_pilot2 CRI_cad_pilot1 CRI_cad_post1 CRI_cad_post2 CRI_width_main CRI_width_pilot2 CRI_width_pilot1 CRI_width_post1 CRI_width_post2 CRI_mg_load CRI_mg_total load_cmd_pct CRI_smk_adjust_mg CRI_smk_lmt_active CRI_mg_load_nosmk /end REF_MEASUREMENT
/end GROUP
/begin GROUP EC_QTpilot1 "ECONTROLS" ROOT
 /begin REF_MEASUREMENT MAPressure ECT MAT IAT FaultSysFlag Vbat Vsw gov_eng_load_d CHT gov_type FPP_cmd_predz CRI_Prail_actual CRI_mg_main CRI_mg_pilot2 CRI_mg_pilot1 CRI_mg_post1 CRI_mg_post2 CRI_cad_main CRI_cad_pilot2 CRI_cad_pilot1 CRI_cad_post1 CRI_cad_post2 CRI_width_main CRI_width_pilot2 CRI_width_pilot1 CRI_width_post1 CRI_width_post2 CRI_mg_load CRI_mg_total load_cmd_pct CRI_smk_adjust_mg CRI_smk_lmt_active CRI_mg_load_nosmk /end REF_MEASUREMENT
/end GROUP
/begin GROUP EC_QTmain "ECONTROLS" ROOT
 /begin REF_MEASUREMENT MAPressure ECT MAT IAT FaultSysFlag Vbat Vsw gov_eng_load_d CHT gov_type FPP_cmd_predz CRI_Prail_actual CRI_mg_main CRI_mg_pilot2 CRI_mg_pilot1 CRI_mg_post1 CRI_mg_post2 CRI_cad_main CRI_cad_pilot2 CRI_cad_pilot1 CRI_cad_post1 CRI_cad_post2 CRI_width_main CRI_width_pilot2 CRI_width_pilot1 CRI_width_post1 CRI_width_post2 CRI_mg_load CRI_mg_total load_cmd_pct CRI_smk_adjust_mg CRI_smk_lmt_active CRI_mg_load_nosmk /end REF_MEASUREMENT
/end GROUP
/begin GROUP EC_QTpost1 "ECONTROLS" ROOT
 /begin REF_MEASUREMENT MAPressure ECT MAT IAT FaultSysFlag Vbat Vsw gov_eng_load_d CHT gov_type FPP_cmd_predz CRI_Prail_actual CRI_mg_main CRI_mg_pilot2 CRI_mg_pilot1 CRI_mg_post1 CRI_mg_post2 CRI_cad_main CRI_cad_pilot2 CRI_cad_pilot1 CRI_cad_post1 CRI_cad_post2 CRI_width_main CRI_width_pilot2 CRI_width_pilot1 CRI_width_post1 CRI_width_post2 CRI_mg_load CRI_mg_total load_cmd_pct CRI_smk_adjust_mg CRI_smk_lmt_active CRI_mg_load_nosmk /end REF_MEASUREMENT
/end GROUP
/begin GROUP EC_QTpost2 "ECONTROLS" ROOT
 /begin REF_MEASUREMENT MAPressure ECT MAT IAT FaultSysFlag Vbat Vsw gov_eng_load_d CHT gov_type FPP_cmd_predz CRI_Prail_actual CRI_mg_main CRI_mg_pilot2 CRI_mg_pilot1 CRI_mg_post1 CRI_mg_post2 CRI_cad_main CRI_cad_pilot2 CRI_cad_pilot1 CRI_cad_post1 CRI_cad_post2 CRI_width_main CRI_width_pilot2 CRI_width_pilot1 CRI_width_post1 CRI_width_post2 CRI_mg_load CRI_mg_total load_cmd_pct CRI_smk_adjust_mg CRI_smk_lmt_active CRI_mg_load_nosmk /end REF_MEASUREMENT
/end GROUP
/begin GROUP EC_RawVolts "ECONTROLS" ROOT
 /begin REF_CHARACTERISTIC CylFireOrder1 CylFireOrder2 CylFireOrder3 CylFireOrder4 CylFireOrder5 CylFireOrder6 CylFireOrder7 CylFireOrder8 CylFireOrder9 CylFireOrder10 CylFireOrder11 CylFireOrder12 /end REF_CHARACTERISTIC
 /begin REF_MEASUREMENT MAPressure ECT MAT IAT FaultSysFlag Vbat Vsw CHT /end REF_MEASUREMENT
/end GROUP
/begin GROUP EC_Roadspeed "ECONTROLS" ROOT /begin REF_MEASUREMENT MAPressure ECT FaultSysFlag TPS_pct /end REF_MEASUREMENT /end GROUP
/begin GROUP EC_Service "ECONTROLS" ROOT /begin REF_MEASUREMENT FaultSysFlag load_cmd_pct /end REF_MEASUREMENT /end GROUP
/begin GROUP EC_Service1 "ECONTROLS" ROOT /begin REF_MEASUREMENT rpm ECT FaultSysFlag fuel_ctl_mode /end REF_MEASUREMENT /end GROUP
/begin GROUP EC_Service2 "ECONTROLS" ROOT /begin REF_MEASUREMENT rpm ECT FaultSysFlag /end REF_MEASUREMENT /end GROUP
/begin GROUP EC_Simulink "ECONTROLS" ROOT
 /begin REF_MEASUREMENT MAPressure ECT IAT FaultSysFlag Vbat Vsw TIP XLS_Revision svn_revision MAP_load /end REF_MEASUREMENT
/end GROUP
/begin GROUP EC_SparkCal "ECONTROLS" ROOT
 /begin REF_CHARACTERISTIC CylFireOrder1 CylFireOrder2 CylFireOrder3 CylFireOrder4 CylFireOrder5 CylFireOrder6 CylFireOrder7 CylFireOrder8 CylFireOrder9 CylFireOrder10 CylFireOrder11 CylFireOrder12 /end REF_CHARACTERISTIC
 /begin REF_MEASUREMENT MAPressure ECT MAT IAT PW_avg FaultSysFlag Vbat CHT spk_off_BP MAP_load /end REF_MEASUREMENT
/end GROUP
/begin GROUP EC_SparkCalLP "ECONTROLS" ROOT
 /begin REF_MEASUREMENT MAPressure ECT MAT IAT fuel_type FaultSysFlag CHT spk_off_BP MAP_load /end REF_MEASUREMENT
/end GROUP
/begin GROUP EC_SparkCalNG "ECONTROLS" ROOT
 /begin REF_MEASUREMENT MAPressure ECT MAT IAT fuel_type FaultSysFlag CHT spk_off_BP MAP_load /end REF_MEASUREMENT
/end GROUP
/begin GROUP EC_SparkCD "ECONTROLS" ROOT /begin REF_MEASUREMENT rpm MAPressure ECT FaultSysFlag Vbat /end REF_MEASUREMENT /end GROUP
/begin GROUP EC_SparkOfst "ECONTROLS" ROOT
 /begin REF_CHARACTERISTIC CylFireOrder1 CylFireOrder2 CylFireOrder3 CylFireOrder4 CylFireOrder5 CylFireOrder6 CylFireOrder7 CylFireOrder8 CylFireOrder9 CylFireOrder10 CylFireOrder11 CylFireOrder12 /end REF_CHARACTERISTIC
 /begin REF_MEASUREMENT MAPressure ECT MAT IAT fuel_type FaultSysFlag CHT spk_off_BP MAP_load /end REF_MEASUREMENT
/end GROUP
/begin GROUP EC_Starting "ECONTROLS" ROOT /begin REF_MEASUREMENT MAPressure ECT MAT IAT PW_avg FaultSysFlag Vbat Vsw CHT /end REF_MEASUREMENT /end GROUP
/begin GROUP EC_Tests "ECONTROLS" ROOT
 /begin REF_MEASUREMENT rpm MAT run_mode power_mode fuel_type FaultSysFlag BP Vbat Vsw FPP_pct TPS_pct fuel_ctl_mode CHT rMAP rECT rIAT gov_type gov_mode OILP_state FuelSpk_SD_active MAP_load /end REF_MEASUREMENT
/end GROUP
/begin GROUP EC_TranCal "ECONTROLS" ROOT
 /begin REF_MEASUREMENT MAPressure ECT MAT IAT PW_avg FaultSysFlag CHT CB1pre_volts CB1pst_volts CB2pre_volts CB2pst_volts /end REF_MEASUREMENT
/end GROUP
/begin GROUP EC_VECal "ECONTROLS" ROOT
 /begin REF_MEASUREMENT MAPressure ECT MAT IAT fuel_type PW_avg FaultSysFlag BP TPS_pct CHT TIP pulse_Hz_capture rs_Hz_capture CB1pre_volts CB1pst_volts CB2pre_volts CB2pst_volts MAP_load /end REF_MEASUREMENT
/end GROUP
/begin GROUP EC_WirelesDAQ "ECONTROLS" ROOT /begin REF_MEASUREMENT FaultSysFlag /end REF_MEASUREMENT /end GROUP
/end MODULE
/end PROJECT
