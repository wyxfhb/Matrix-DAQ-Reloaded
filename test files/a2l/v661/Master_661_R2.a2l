ASAP2_VERSION 1 61
/begin PROJECT Econtrols_4G "4G Test"
/begin HEADER "4G A2L Configuration" PROJECT_NO EControls4G /* config for version control */ VERSION "$Revision: 82130 $:" /* config for version control */ /end HEADER
/begin MODULE EControls_4G_SH2A "EControls 4G"
/begin MOD_COMMON "" DEPOSIT ABSOLUTE BYTE_ORDER MSB_FIRST /end MOD_COMMON
/* Define the Record Layouts */
/begin RECORD_LAYOUT ECIPP_ALIGNMENT_UBYTE FNC_VALUES 1 UBYTE COLUMN_DIR DIRECT /end RECORD_LAYOUT
/begin RECORD_LAYOUT ECIPP_ALIGNMENT_UWORD FNC_VALUES 1 UWORD COLUMN_DIR DIRECT /end RECORD_LAYOUT
/begin RECORD_LAYOUT ECIPP_ALIGNMENT_SWORD FNC_VALUES 1 SWORD COLUMN_DIR DIRECT /end RECORD_LAYOUT
/begin RECORD_LAYOUT ECIPP_Lookup_SWORD AXIS_PTS_X 1 SWORD INDEX_INCR DIRECT /end RECORD_LAYOUT
/begin RECORD_LAYOUT ECIPP_ALIGNMENT_ULONG FNC_VALUES 1 ULONG COLUMN_DIR DIRECT /end RECORD_LAYOUT
/begin RECORD_LAYOUT ECIPP_ALIGNMENT_SLONG FNC_VALUES 1 SLONG COLUMN_DIR DIRECT /end RECORD_LAYOUT
/begin RECORD_LAYOUT ECIPP_ALIGNMENT_FLOAT32_IEEE FNC_VALUES 1 FLOAT32_IEEE COLUMN_DIR DIRECT /end RECORD_LAYOUT
/begin RECORD_LAYOUT ECIPP_Lookup_FLOAT32_IEEE AXIS_PTS_X 1 FLOAT32_IEEE INDEX_INCR DIRECT /end RECORD_LAYOUT
/* Define generic COMPU_METHODS used in the A2L */ /* NOTE: most of the parameters from ECIPP use unique/specific COMPU_METHODS */
/begin COMPU_METHOD Compu_ECIPP_STRINGS "ECIPP Strings " /* Identifier */ RAT_FUNC "%.0" /* Format */ "ASCII" /* Units */ COEFFS 0 1 0 0 0 1 /end COMPU_METHOD
/begin MEASUREMENT spk_max_ECT "CHT Max Advance" SWORD Compu_spk_max_ECT 0 0 -2048 2047.9375 ECU_ADDRESS 0x01000030 /end MEASUREMENT
/begin COMPU_METHOD Compu_spk_max_ECT " " RAT_FUNC "%.1" "CAD BTDC" COEFFS 0 16 0 0 0 1 /end COMPU_METHOD
/begin MEASUREMENT dwell_OL "Base dwell" UWORD Compu_dwell_OL 0 0 0 209.712 ECU_ADDRESS 0x01000058 /end MEASUREMENT
/begin COMPU_METHOD Compu_dwell_OL " " RAT_FUNC "%.2" "ms" COEFFS 0 312.5 0 0 0 1 /end COMPU_METHOD
/begin MEASUREMENT VE_CWT_crct_pct "VE_CWT_crct_pct" SWORD Compu_VE_CWT_crct_pct 0 0 -100 99.9969482421875 ECU_ADDRESS 0x01000240 /end MEASUREMENT
/begin COMPU_METHOD Compu_VE_CWT_crct_pct " " RAT_FUNC "%.1" "%" COEFFS 0 327.68 0 0 0 1 /end COMPU_METHOD
/begin CHARACTERISTIC FSO_ret_init "FSO spark retard max" VALUE 0x001c44f8 /* @ECU_Address@FSO_ret_init@0x01000AF8@ */ ECIPP_ALIGNMENT_SWORD 2048 Compu_FSO_ret_init -2048 2047.9375 /end CHARACTERISTIC
/begin COMPU_METHOD Compu_FSO_ret_init " " RAT_FUNC "%.1" "CAD" COEFFS 0 16 0 0 0 1 /end COMPU_METHOD
/begin CHARACTERISTIC FSO_ret_decay "FSO retard decay" VALUE 0x001c7b5a /* @ECU_Address@FSO_ret_decay@0x01000B00@ */ ECIPP_ALIGNMENT_UWORD 500 Compu_FSO_ret_decay 0 499.992370605469 /end CHARACTERISTIC
/begin COMPU_METHOD Compu_FSO_ret_decay " " RAT_FUNC "%.1" "CAD / sec" COEFFS 0 131.072 0 0 0 1 /end COMPU_METHOD
/begin CHARACTERISTIC CWTret_posC "CWT+ retard - gasoline" VALUE 0x001C4474 /* @ECU_Address@CWTret_posC@0x01000EA0@ */ ECIPP_ALIGNMENT_SWORD 82 Compu_CWTret_posC -81.92 81.9175 /end CHARACTERISTIC
/begin COMPU_METHOD Compu_CWTret_posC " " RAT_FUNC "%.1" "CAD / %" COEFFS 0 400 0 0 0 1 /end COMPU_METHOD
/begin CHARACTERISTIC CWTretLP_posC "CWT+ retard - LPG" VALUE 0x001C4476 /* @ECU_Address@CWTretLP_posC@0x01000EA8@ */ ECIPP_ALIGNMENT_SWORD 82 Compu_CWTretLP_posC -81.92 81.9175 /end CHARACTERISTIC
/begin COMPU_METHOD Compu_CWTretLP_posC " " RAT_FUNC "%.1" "CAD / %" COEFFS 0 400 0 0 0 1 /end COMPU_METHOD
/begin CHARACTERISTIC CWTretNG_posC "CWT+ retard - NG" VALUE 0x001C4478 /* @ECU_Address@CWTretNG_posC@0x01000EB0@ */ ECIPP_ALIGNMENT_SWORD 82 Compu_CWTretNG_posC -81.92 81.9175 /end CHARACTERISTIC
/begin COMPU_METHOD Compu_CWTretNG_posC " " RAT_FUNC "%.1" "CAD / %" COEFFS 0 400 0 0 0 1 /end COMPU_METHOD
/begin CHARACTERISTIC CWTret_negC "CWT- retard - gasoline" VALUE 0x001C446C /* @ECU_Address@CWTret_negC@0x01000EB8@ */ ECIPP_ALIGNMENT_SWORD 82 Compu_CWTret_negC -81.92 81.9175 /end CHARACTERISTIC
/begin COMPU_METHOD Compu_CWTret_negC " " RAT_FUNC "%.1" "CAD / %" COEFFS 0 400 0 0 0 1 /end COMPU_METHOD
/begin CHARACTERISTIC CWTretLP_negC "CWT- retard - LPG" VALUE 0x001C446E /* @ECU_Address@CWTretLP_negC@0x01000EC0@ */ ECIPP_ALIGNMENT_SWORD 82 Compu_CWTretLP_negC -81.92 81.9175 /end CHARACTERISTIC
/begin COMPU_METHOD Compu_CWTretLP_negC " " RAT_FUNC "%.1" "CAD / %" COEFFS 0 400 0 0 0 1 /end COMPU_METHOD
/begin CHARACTERISTIC CWTretNG_negC "CWT- retard - NG" VALUE 0x001C4470 /* @ECU_Address@CWTretNG_negC@0x01000EC8@ */ ECIPP_ALIGNMENT_SWORD 82 Compu_CWTretNG_negC -81.92 81.9175 /end CHARACTERISTIC
/begin COMPU_METHOD Compu_CWTretNG_negC " " RAT_FUNC "%.1" "CAD / %" COEFFS 0 400 0 0 0 1 /end COMPU_METHOD
/begin CHARACTERISTIC CWTret_poslim "CWT+ retard limit" VALUE 0x001c447a /* @ECU_Address@CWTret_poslim@0x01000ED0@ */ ECIPP_ALIGNMENT_SWORD 2048 Compu_CWTret_poslim -2048 2047.9375 /end CHARACTERISTIC
/begin COMPU_METHOD Compu_CWTret_poslim " " RAT_FUNC "%.1" "CAD" COEFFS 0 16 0 0 0 1 /end COMPU_METHOD
/begin CHARACTERISTIC CWTret_neglim "CWT- retard limit" VALUE 0x001c4472 /* @ECU_Address@CWTret_neglim@0x01000ED8@ */ ECIPP_ALIGNMENT_SWORD 2048 Compu_CWTret_neglim -2048 2047.9375 /end CHARACTERISTIC
/begin COMPU_METHOD Compu_CWTret_neglim " " RAT_FUNC "%.1" "CAD" COEFFS 0 16 0 0 0 1 /end COMPU_METHOD
/begin CHARACTERISTIC spk_adv_dz "Spk Adv dead-zone" VALUE 0x001c6d2e /* @ECU_Address@spk_adv_dz@0x01000F60@ */ ECIPP_ALIGNMENT_SWORD 2048 Compu_spk_adv_dz -2048 2047.9375 /end CHARACTERISTIC
/begin COMPU_METHOD Compu_spk_adv_dz " " RAT_FUNC "%.1" "CAD" COEFFS 0 16 0 0 0 1 /end COMPU_METHOD
/begin CHARACTERISTIC spk_adv_dz_tau "Spk Adv dead-zone tau" VALUE 0x001c8666 /* @ECU_Address@spk_adv_dz_tau@0x01000F68@ */ ECIPP_ALIGNMENT_UWORD 163840 Compu_spk_adv_dz_tau 0.16703 163840 /end CHARACTERISTIC
/begin COMPU_METHOD Compu_spk_adv_dz_tau " " FORM "%.0" "ms"
 /begin FORMULA "-5 / log(1.0000000000001 - (X1 / 32768))" FORMULA_INV "(1.0000000000001 - exp(-5/X1)) * 32768" /end FORMULA
/end COMPU_METHOD
/begin CHARACTERISTIC dwell_adpt_ena "Dwell current control{dwell_adpt_ena&0xff=0x00:Disabled}{dwell_adpt_ena&0xff=0x01:Adaptive Dwell}{dwell_adpt_ena&0xff=0x02:Monitor Only}" VALUE 0x001c8ff8 /* @ECU_Address@dwell_adpt_ena@0x01001268@ */ ECIPP_ALIGNMENT_UBYTE 255 dwell_adpt_ena_COMPU_VTAB 0 255 BIT_MASK 0xff /end CHARACTERISTIC
/begin COMPU_METHOD dwell_adpt_ena_COMPU_VTAB "Verbal Table" TAB_VERB "%.0" "list" COMPU_TAB_REF dwell_adpt_ena_COMPU_VTAB_REF /end COMPU_METHOD
/begin COMPU_VTAB dwell_adpt_ena_COMPU_VTAB_REF "Verbal Table" TAB_VERB 3 0x00 "Disabled" 0x01 "Adaptive Dwell" 0x02 "Monitor Only" DEFAULT_VALUE "UNKNOWN" /end COMPU_VTAB
/begin CHARACTERISTIC dwell_a_min "Min adaptive dwell delta" VALUE 0x001c6c8e /* @ECU_Address@dwell_a_min@0x01001270@ */ ECIPP_ALIGNMENT_SWORD 105 Compu_dwell_a_min -104.8576 104.8544 /end CHARACTERISTIC
/begin COMPU_METHOD Compu_dwell_a_min " " RAT_FUNC "%.3" "ms" COEFFS 0 312.5 0 0 0 1 /end COMPU_METHOD
/begin CHARACTERISTIC dwell_a_max "Max adaptive dwell delta" VALUE 0x001c6c8c /* @ECU_Address@dwell_a_max@0x01001278@ */ ECIPP_ALIGNMENT_SWORD 105 Compu_dwell_a_max -104.8576 104.8544 /end CHARACTERISTIC
/begin COMPU_METHOD Compu_dwell_a_max " " RAT_FUNC "%.3" "ms" COEFFS 0 312.5 0 0 0 1 /end COMPU_METHOD
/begin CHARACTERISTIC dwell_inc_K "Adaptive dwell gain" VALUE 0x001c6c92 /* @ECU_Address@dwell_inc_K@0x01001280@ */ ECIPP_ALIGNMENT_SWORD 10 Compu_dwell_inc_K -10.48576 10.48544 /end CHARACTERISTIC
/begin COMPU_METHOD Compu_dwell_inc_K " " RAT_FUNC "%.3" "ms/volt" COEFFS 0 3125 0 0 0 1 /end COMPU_METHOD
/begin CHARACTERISTIC dwell_inc_max "Adaptive dwell step max" VALUE 0x001c6c94 /* @ECU_Address@dwell_inc_max@0x01001288@ */ ECIPP_ALIGNMENT_SWORD 105 Compu_dwell_inc_max -104.8576 104.8544 /end CHARACTERISTIC
/begin COMPU_METHOD Compu_dwell_inc_max " " RAT_FUNC "%.3" "ms" COEFFS 0 312.5 0 0 0 1 /end COMPU_METHOD
/begin MEASUREMENT dwell1_adapt "Coil1 dwell adapt" SWORD Compu_dwell1_adapt 0 0 -104.8576 104.8544 ECU_ADDRESS 0x01002188 /end MEASUREMENT
/begin COMPU_METHOD Compu_dwell1_adapt " " RAT_FUNC "%.2" "ms" COEFFS 0 312.5 0 0 0 1 /end COMPU_METHOD
/begin MEASUREMENT dwell2_adapt "Coil2 dwell adapt" SWORD Compu_dwell2_adapt 0 0 -104.8576 104.8544 ECU_ADDRESS 0x01002190 /end MEASUREMENT
/begin COMPU_METHOD Compu_dwell2_adapt " " RAT_FUNC "%.2" "ms" COEFFS 0 312.5 0 0 0 1 /end COMPU_METHOD
/begin MEASUREMENT dwell3_adapt "Coil3 dwell adapt" SWORD Compu_dwell3_adapt 0 0 -104.8576 104.8544 ECU_ADDRESS 0x01002198 /end MEASUREMENT
/begin COMPU_METHOD Compu_dwell3_adapt " " RAT_FUNC "%.2" "ms" COEFFS 0 312.5 0 0 0 1 /end COMPU_METHOD
/begin MEASUREMENT AL_nonzero "Adaptive Learn State{AL_nonzero&0x01=0x00:Cleared}{AL_nonzero&0x01=0x01:Non-Zero}" UBYTE AL_nonzero_COMPU_VTAB 0 0 0 255 ECU_ADDRESS 0x01004670 BIT_MASK 0x01 /end MEASUREMENT
/begin COMPU_METHOD AL_nonzero_COMPU_VTAB "Verbal Table" TAB_VERB "%.0" "list" COMPU_TAB_REF AL_nonzero_COMPU_VTAB_REF /end COMPU_METHOD
/begin COMPU_VTAB AL_nonzero_COMPU_VTAB_REF "Verbal Table" TAB_VERB 2 0x00 "Cleared" 0x01 "Non-Zero" DEFAULT_VALUE "UNKNOWN" /end COMPU_VTAB
/begin MEASUREMENT TRIM_EGO_ajlean "Lean{TRIM_EGO_ajlean&0x01=0x00:OFF}{TRIM_EGO_ajlean&0x01=0x01:ON}" UBYTE TRIM_EGO_ajlean_COMPU_VTAB 0 0 0 255 ECU_ADDRESS 0x01004680 BIT_MASK 0x01 /end MEASUREMENT
/begin COMPU_METHOD TRIM_EGO_ajlean_COMPU_VTAB "Verbal Table" TAB_VERB "%.0" "list" COMPU_TAB_REF TRIM_EGO_ajlean_COMPU_VTAB_REF /end COMPU_METHOD
/begin COMPU_VTAB TRIM_EGO_ajlean_COMPU_VTAB_REF "Verbal Table" TAB_VERB 2 0x00 "OFF" 0x01 "ON" DEFAULT_VALUE "UNKNOWN" /end COMPU_VTAB
/begin MEASUREMENT TRIM_EGO_ajstoc "Stoich{TRIM_EGO_ajstoc&0x02=0x00:OFF}{TRIM_EGO_ajstoc&0x02=0x02:ON}" UBYTE TRIM_EGO_ajstoc_COMPU_VTAB 0 0 0 255 ECU_ADDRESS 0x01004688 BIT_MASK 0x02 /end MEASUREMENT
/begin COMPU_METHOD TRIM_EGO_ajstoc_COMPU_VTAB "Verbal Table" TAB_VERB "%.0" "list" COMPU_TAB_REF TRIM_EGO_ajstoc_COMPU_VTAB_REF /end COMPU_METHOD
/begin COMPU_VTAB TRIM_EGO_ajstoc_COMPU_VTAB_REF "Verbal Table" TAB_VERB 2 0x00 "OFF" 0x02 "ON" DEFAULT_VALUE "UNKNOWN" /end COMPU_VTAB
/begin MEASUREMENT TRIM_EGO_ajrich "Rich{TRIM_EGO_ajrich&0x04=0x00:OFF}{TRIM_EGO_ajrich&0x04=0x04:ON}" UBYTE TRIM_EGO_ajrich_COMPU_VTAB 0 0 0 255 ECU_ADDRESS 0x01004690 BIT_MASK 0x04 /end MEASUREMENT
/begin COMPU_METHOD TRIM_EGO_ajrich_COMPU_VTAB "Verbal Table" TAB_VERB "%.0" "list" COMPU_TAB_REF TRIM_EGO_ajrich_COMPU_VTAB_REF /end COMPU_METHOD
/begin COMPU_VTAB TRIM_EGO_ajrich_COMPU_VTAB_REF "Verbal Table" TAB_VERB 2 0x00 "OFF" 0x04 "ON" DEFAULT_VALUE "UNKNOWN" /end COMPU_VTAB
/begin MEASUREMENT TRIM_EGO_avg "TRIM_EGO_avg" UWORD Compu_TRIM_EGO_avg 0 0 0 15.999755859375 ECU_ADDRESS 0x01004698 /end MEASUREMENT
/begin COMPU_METHOD Compu_TRIM_EGO_avg " " RAT_FUNC "%.3" "volts" COEFFS 0 4096 0 0 0 1 /end COMPU_METHOD
/begin MEASUREMENT spk_adv_crk "Crank spark timing value" SWORD Compu_spk_adv_crk 0 0 -2048 2047.9375 ECU_ADDRESS 0x01004BB8 /end MEASUREMENT
/begin COMPU_METHOD Compu_spk_adv_crk " " RAT_FUNC "%.1" "CAD BTDC" COEFFS 0 16 0 0 0 1 /end COMPU_METHOD
/begin MEASUREMENT CrkTT_dcy_t "Crank spark timing transition decay" UWORD Compu_CrkTT_dcy_t 0 0 0 1048.56 ECU_ADDRESS 0x01004BD0 /end MEASUREMENT
/begin COMPU_METHOD Compu_CrkTT_dcy_t " " RAT_FUNC "%.1" "sec" COEFFS 0 62.5 0 0 0 1 /end COMPU_METHOD
/begin CHARACTERISTIC spko_cyl_mode "Cylinder spark adv mode{spko_cyl_mode&0xff=0:Disabled}{spko_cyl_mode&0xff=1:Gasoline Only}{spko_cyl_mode&0xff=2:LP Only}{spko_cyl_mode&0xff=3:NG Only}{spko_cyl_mode&0xff=4:Gaseous Only}{spko_cyl_mode&0xff=5:Always Enabled}" VALUE 0x001c907f /* @ECU_Address@spko_cyl_mode@0x01005640@ */ ECIPP_ALIGNMENT_UBYTE 255 spko_cyl_mode_COMPU_VTAB 0 255 BIT_MASK 0xff /end CHARACTERISTIC
/begin COMPU_METHOD spko_cyl_mode_COMPU_VTAB "Verbal Table" TAB_VERB "%.0" "list" COMPU_TAB_REF spko_cyl_mode_COMPU_VTAB_REF /end COMPU_METHOD
/begin COMPU_VTAB spko_cyl_mode_COMPU_VTAB_REF "Verbal Table" TAB_VERB 6 0 "Disabled" 1 "Gasoline Only" 2 "LP Only" 3 "NG Only" 4 "Gaseous Only" 5 "Always Enabled" DEFAULT_VALUE "UNKNOWN" /end COMPU_VTAB
/begin CHARACTERISTIC coil1_spk_mult "Cylinder 1 (F.O.) spark multiplier" VALUE 0x001C6C54 /* @ECU_Address@coil1_spk_mult@0x01005648@ */ ECIPP_ALIGNMENT_SWORD 2 Compu_coil1_spk_mult -2 1.99993896484375 /end CHARACTERISTIC
/begin COMPU_METHOD Compu_coil1_spk_mult " " RAT_FUNC "%.2" "-" COEFFS 0 16384 0 0 0 1 /end COMPU_METHOD
/begin CHARACTERISTIC coil2_spk_mult "2" VALUE 0x001C6C56 /* @ECU_Address@coil2_spk_mult@0x01005650@ */ ECIPP_ALIGNMENT_SWORD 2 Compu_coil2_spk_mult -2 1.99993896484375 /end CHARACTERISTIC
/begin COMPU_METHOD Compu_coil2_spk_mult " " RAT_FUNC "%.2" "-" COEFFS 0 16384 0 0 0 1 /end COMPU_METHOD
/begin CHARACTERISTIC coil3_spk_mult "3" VALUE 0x001C6C58 /* @ECU_Address@coil3_spk_mult@0x01005658@ */ ECIPP_ALIGNMENT_SWORD 2 Compu_coil3_spk_mult -2 1.99993896484375 /end CHARACTERISTIC
/begin COMPU_METHOD Compu_coil3_spk_mult " " RAT_FUNC "%.2" "-" COEFFS 0 16384 0 0 0 1 /end COMPU_METHOD
/begin CHARACTERISTIC coil4_spk_mult "4" VALUE 0x001C6C5A /* @ECU_Address@coil4_spk_mult@0x01005660@ */ ECIPP_ALIGNMENT_SWORD 2 Compu_coil4_spk_mult -2 1.99993896484375 /end CHARACTERISTIC
/begin COMPU_METHOD Compu_coil4_spk_mult " " RAT_FUNC "%.2" "-" COEFFS 0 16384 0 0 0 1 /end COMPU_METHOD
/begin CHARACTERISTIC coil5_spk_mult "5" VALUE 0x001C6C5C /* @ECU_Address@coil5_spk_mult@0x01005668@ */ ECIPP_ALIGNMENT_SWORD 2 Compu_coil5_spk_mult -2 1.99993896484375 /end CHARACTERISTIC
/begin COMPU_METHOD Compu_coil5_spk_mult " " RAT_FUNC "%.2" "-" COEFFS 0 16384 0 0 0 1 /end COMPU_METHOD
/begin CHARACTERISTIC coil6_spk_mult "6" VALUE 0x001C6C5E /* @ECU_Address@coil6_spk_mult@0x01005670@ */ ECIPP_ALIGNMENT_SWORD 2 Compu_coil6_spk_mult -2 1.99993896484375 /end CHARACTERISTIC
/begin COMPU_METHOD Compu_coil6_spk_mult " " RAT_FUNC "%.2" "-" COEFFS 0 16384 0 0 0 1 /end COMPU_METHOD
/begin CHARACTERISTIC coil7_spk_mult "7" VALUE 0x001C6C60 /* @ECU_Address@coil7_spk_mult@0x01005678@ */ ECIPP_ALIGNMENT_SWORD 2 Compu_coil7_spk_mult -2 1.99993896484375 /end CHARACTERISTIC
/begin COMPU_METHOD Compu_coil7_spk_mult " " RAT_FUNC "%.2" "-" COEFFS 0 16384 0 0 0 1 /end COMPU_METHOD
/begin CHARACTERISTIC coil8_spk_mult "8" VALUE 0x001C6C62 /* @ECU_Address@coil8_spk_mult@0x01005680@ */ ECIPP_ALIGNMENT_SWORD 2 Compu_coil8_spk_mult -2 1.99993896484375 /end CHARACTERISTIC
/begin COMPU_METHOD Compu_coil8_spk_mult " " RAT_FUNC "%.2" "-" COEFFS 0 16384 0 0 0 1 /end COMPU_METHOD
/begin CHARACTERISTIC coil9_spk_mult "9" VALUE 0x001C6C64 /* @ECU_Address@coil9_spk_mult@0x01005688@ */ ECIPP_ALIGNMENT_SWORD 2 Compu_coil9_spk_mult -2 1.99993896484375 /end CHARACTERISTIC
/begin COMPU_METHOD Compu_coil9_spk_mult " " RAT_FUNC "%.2" "-" COEFFS 0 16384 0 0 0 1 /end COMPU_METHOD
/begin CHARACTERISTIC coil10_spk_mult "10" VALUE 0x001C6C66 /* @ECU_Address@coil10_spk_mult@0x01005690@ */ ECIPP_ALIGNMENT_SWORD 2 Compu_coil10_spk_mult -2 1.99993896484375 /end CHARACTERISTIC
/begin COMPU_METHOD Compu_coil10_spk_mult " " RAT_FUNC "%.2" "-" COEFFS 0 16384 0 0 0 1 /end COMPU_METHOD
/begin CHARACTERISTIC spko_cyl_dzfilt "Cylinder spark adv dead-zone{spko_cyl_dzfilt&0xff=0:Disabled}{spko_cyl_dzfilt&0xff=1:Enabled}" VALUE 0x001c907e /* @ECU_Address@spko_cyl_dzfilt@0x01005698@ */ ECIPP_ALIGNMENT_UBYTE 255 spko_cyl_dzfilt_COMPU_VTAB 0 255 BIT_MASK 0xff /end CHARACTERISTIC
/begin COMPU_METHOD spko_cyl_dzfilt_COMPU_VTAB "Verbal Table" TAB_VERB "%.0" "list" COMPU_TAB_REF spko_cyl_dzfilt_COMPU_VTAB_REF /end COMPU_METHOD
/begin COMPU_VTAB spko_cyl_dzfilt_COMPU_VTAB_REF "Verbal Table" TAB_VERB 2 0 "Disabled" 1 "Enabled" DEFAULT_VALUE "UNKNOWN" /end COMPU_VTAB
/begin MEASUREMENT svn_remote_compiled "Remote compiled{svn_remote_compiled&0x01=0x00:NO}{svn_remote_compiled&0x01=0x01:YES}" UBYTE svn_remote_compiled_COMPU_VTAB 0 0 0 255 ECU_ADDRESS 0x01006680 BIT_MASK 0x01 /end MEASUREMENT
/begin COMPU_METHOD svn_remote_compiled_COMPU_VTAB "Verbal Table" TAB_VERB "%.0" "list" COMPU_TAB_REF svn_remote_compiled_COMPU_VTAB_REF /end COMPU_METHOD
/begin COMPU_VTAB svn_remote_compiled_COMPU_VTAB_REF "Verbal Table" TAB_VERB 2 0x00 "NO" 0x01 "YES" DEFAULT_VALUE "UNKNOWN" /end COMPU_VTAB
/begin MEASUREMENT svn_mixed "SVN mixed revisions{svn_mixed&0x02=0x00:NO}{svn_mixed&0x02=0x02:YES}" UBYTE svn_mixed_COMPU_VTAB 0 0 0 255 ECU_ADDRESS 0x01006688 BIT_MASK 0x02 /end MEASUREMENT
/begin COMPU_METHOD svn_mixed_COMPU_VTAB "Verbal Table" TAB_VERB "%.0" "list" COMPU_TAB_REF svn_mixed_COMPU_VTAB_REF /end COMPU_METHOD
/begin COMPU_VTAB svn_mixed_COMPU_VTAB_REF "Verbal Table" TAB_VERB 2 0x00 "NO" 0x02 "YES" DEFAULT_VALUE "UNKNOWN" /end COMPU_VTAB
/begin MEASUREMENT svn_modified "SVN modified{svn_modified&0x04=0x00:NO}{svn_modified&0x04=0x04:YES}" UBYTE svn_modified_COMPU_VTAB 0 0 0 255 ECU_ADDRESS 0x01006690 BIT_MASK 0x04 /end MEASUREMENT
/begin COMPU_METHOD svn_modified_COMPU_VTAB "Verbal Table" TAB_VERB "%.0" "list" COMPU_TAB_REF svn_modified_COMPU_VTAB_REF /end COMPU_METHOD
/begin COMPU_VTAB svn_modified_COMPU_VTAB_REF "Verbal Table" TAB_VERB 2 0x00 "NO" 0x04 "YES" DEFAULT_VALUE "UNKNOWN" /end COMPU_VTAB
/begin MEASUREMENT svn_compile_date_str "SVN compile date str" ULONG Compu_svn_compile_date_str 0 0 0 4294967295 ECU_ADDRESS 0x01006698 /end MEASUREMENT
/begin COMPU_METHOD Compu_svn_compile_date_str " " RAT_FUNC "%.0" "-" COEFFS 0 1 0 0 0 1 /end COMPU_METHOD
/begin CHARACTERISTIC dwell_d_amp "Dwell target" VALUE 0x001c6c90 /* @ECU_Address@dwell_d_amp@0x010069E0@ */ ECIPP_ALIGNMENT_SWORD 32 Compu_dwell_d_amp -32 31.9990234375 /end CHARACTERISTIC
/begin COMPU_METHOD Compu_dwell_d_amp " " RAT_FUNC "%.3" "amps" COEFFS 0 1024 0 0 0 1 /end COMPU_METHOD
/begin CHARACTERISTIC dwell_def "Dwell default" VALUE 0x001c841e /* @ECU_Address@dwell_def@0x010069E8@ */ ECIPP_ALIGNMENT_UWORD 210 Compu_dwell_def 0 209.712 /end CHARACTERISTIC
/begin COMPU_METHOD Compu_dwell_def " " RAT_FUNC "%.2" "ms" COEFFS 0 312.5 0 0 0 1 /end COMPU_METHOD
/begin CHARACTERISTIC dwell_min "Dwell min" VALUE 0x001c8422 /* @ECU_Address@dwell_min@0x010069F0@ */ ECIPP_ALIGNMENT_UWORD 210 Compu_dwell_min 0 209.712 /end CHARACTERISTIC
/begin COMPU_METHOD Compu_dwell_min " " RAT_FUNC "%.2" "ms" COEFFS 0 312.5 0 0 0 1 /end COMPU_METHOD
/begin CHARACTERISTIC dwell_max "Dwell max" VALUE 0x001c8420 /* @ECU_Address@dwell_max@0x010069F8@ */ ECIPP_ALIGNMENT_UWORD 210 Compu_dwell_max 0 209.712 /end CHARACTERISTIC
/begin COMPU_METHOD Compu_dwell_max " " RAT_FUNC "%.2" "ms" COEFFS 0 312.5 0 0 0 1 /end COMPU_METHOD
/begin CHARACTERISTIC dwell_shorted "Shorted primary coil dwell" VALUE 0x001c8428 /* @ECU_Address@dwell_shorted@0x01006A00@ */ ECIPP_ALIGNMENT_UWORD 210 Compu_dwell_shorted 0 209.712 /end CHARACTERISTIC
/begin COMPU_METHOD Compu_dwell_shorted " " RAT_FUNC "%.2" "ms" COEFFS 0 312.5 0 0 0 1 /end COMPU_METHOD
/begin CHARACTERISTIC spk_min_dissipate "Minimum coil dissipation time" VALUE 0x001c84dc /* @ECU_Address@spk_min_dissipate@0x01006A08@ */ ECIPP_ALIGNMENT_UWORD 210 Compu_spk_min_dissipate 0 209.712 /end CHARACTERISTIC
/begin COMPU_METHOD Compu_spk_min_dissipate " " RAT_FUNC "%.2" "ms" COEFFS 0 312.5 0 0 0 1 /end COMPU_METHOD
/begin CHARACTERISTIC dwell_crk_add "Dwell crank extra" VALUE 0x001c841a /* @ECU_Address@dwell_crk_add@0x01006A10@ */ ECIPP_ALIGNMENT_UWORD 210 Compu_dwell_crk_add 0 209.712 /end CHARACTERISTIC
/begin COMPU_METHOD Compu_dwell_crk_add " " RAT_FUNC "%.2" "ms" COEFFS 0 312.5 0 0 0 1 /end COMPU_METHOD
/begin CHARACTERISTIC dwell_crk_rpm "Dwell crank rpm" VALUE 0x001c841c /* @ECU_Address@dwell_crk_rpm@0x01006A18@ */ ECIPP_ALIGNMENT_UWORD 65535 Compu_dwell_crk_rpm 0 65535 /end CHARACTERISTIC
/begin COMPU_METHOD Compu_dwell_crk_rpm " " RAT_FUNC "%.0" "rpm" COEFFS 0 1 0 0 0 1 /end COMPU_METHOD
/begin CHARACTERISTIC dwell_min_Vbat "Dwell adapt min battery voltage" VALUE 0x001c8424 /* @ECU_Address@dwell_min_Vbat@0x01006A20@ */ ECIPP_ALIGNMENT_UWORD 256 Compu_dwell_min_Vbat 0 255.99609375 /end CHARACTERISTIC
/begin COMPU_METHOD Compu_dwell_min_Vbat " " RAT_FUNC "%.1" "volts" COEFFS 0 256 0 0 0 1 /end COMPU_METHOD
/begin MEASUREMENT coil1_adv_cyl "Cylinder 1 (F.O.) advance offset" SWORD Compu_coil1_adv_cyl 0 0 -2048 2047.9375 ECU_ADDRESS 0x01006B88 /end MEASUREMENT
/begin COMPU_METHOD Compu_coil1_adv_cyl " " RAT_FUNC "%.1" "-" COEFFS 0 16 0 0 0 1 /end COMPU_METHOD
/begin MEASUREMENT coil2_adv_cyl "2" SWORD Compu_coil2_adv_cyl 0 0 -2048 2047.9375 ECU_ADDRESS 0x01006B90 /end MEASUREMENT
/begin COMPU_METHOD Compu_coil2_adv_cyl " " RAT_FUNC "%.1" "-" COEFFS 0 16 0 0 0 1 /end COMPU_METHOD
/begin MEASUREMENT coil3_adv_cyl "3" SWORD Compu_coil3_adv_cyl 0 0 -2048 2047.9375 ECU_ADDRESS 0x01006B98 /end MEASUREMENT
/begin COMPU_METHOD Compu_coil3_adv_cyl " " RAT_FUNC "%.1" "-" COEFFS 0 16 0 0 0 1 /end COMPU_METHOD
/begin MEASUREMENT coil4_adv_cyl "4" SWORD Compu_coil4_adv_cyl 0 0 -2048 2047.9375 ECU_ADDRESS 0x01006BA0 /end MEASUREMENT
/begin COMPU_METHOD Compu_coil4_adv_cyl " " RAT_FUNC "%.1" "-" COEFFS 0 16 0 0 0 1 /end COMPU_METHOD
/begin MEASUREMENT coil5_adv_cyl "5" SWORD Compu_coil5_adv_cyl 0 0 -2048 2047.9375 ECU_ADDRESS 0x01006BA8 /end MEASUREMENT
/begin COMPU_METHOD Compu_coil5_adv_cyl " " RAT_FUNC "%.1" "-" COEFFS 0 16 0 0 0 1 /end COMPU_METHOD
/begin MEASUREMENT coil6_adv_cyl "6" SWORD Compu_coil6_adv_cyl 0 0 -2048 2047.9375 ECU_ADDRESS 0x01006BB0 /end MEASUREMENT
/begin COMPU_METHOD Compu_coil6_adv_cyl " " RAT_FUNC "%.1" "-" COEFFS 0 16 0 0 0 1 /end COMPU_METHOD
/begin MEASUREMENT coil7_adv_cyl "7" SWORD Compu_coil7_adv_cyl 0 0 -2048 2047.9375 ECU_ADDRESS 0x01006BB8 /end MEASUREMENT
/begin COMPU_METHOD Compu_coil7_adv_cyl " " RAT_FUNC "%.1" "-" COEFFS 0 16 0 0 0 1 /end COMPU_METHOD
/begin MEASUREMENT coil8_adv_cyl "8" SWORD Compu_coil8_adv_cyl 0 0 -2048 2047.9375 ECU_ADDRESS 0x01006BC0 /end MEASUREMENT
/begin COMPU_METHOD Compu_coil8_adv_cyl " " RAT_FUNC "%.1" "-" COEFFS 0 16 0 0 0 1 /end COMPU_METHOD
/begin MEASUREMENT coil9_adv_cyl "9" SWORD Compu_coil9_adv_cyl 0 0 -2048 2047.9375 ECU_ADDRESS 0x01006BC8 /end MEASUREMENT
/begin COMPU_METHOD Compu_coil9_adv_cyl " " RAT_FUNC "%.1" "-" COEFFS 0 16 0 0 0 1 /end COMPU_METHOD
/begin MEASUREMENT coil10_adv_cyl "10" SWORD Compu_coil10_adv_cyl 0 0 -2048 2047.9375 ECU_ADDRESS 0x01006BD0 /end MEASUREMENT
/begin COMPU_METHOD Compu_coil10_adv_cyl " " RAT_FUNC "%.1" "-" COEFFS 0 16 0 0 0 1 /end COMPU_METHOD
/begin CHARACTERISTIC dwell_a_prefire_samp "Dwell adapt pre-fire samp" VALUE 0x001c8418 /* @ECU_Address@dwell_a_prefire_samp@0x01007078@ */ ECIPP_ALIGNMENT_UWORD 13107 Compu_dwell_a_prefire_samp 0 13107 /end CHARACTERISTIC
/begin COMPU_METHOD Compu_dwell_a_prefire_samp " " RAT_FUNC "%.1" "us" COEFFS 0 5 0 0 0 1 /end COMPU_METHOD
/begin CHARACTERISTIC dwell_crk_max_accel "Dwell override max accel" VALUE 0x001c3e04 /* @ECU_Address@dwell_crk_max_accel@0x01007098@ */ ECIPP_ALIGNMENT_FLOAT32_IEEE 10000000000 Compu_dwell_crk_max_accel -10000000000 10000000000 /end CHARACTERISTIC
/begin COMPU_METHOD Compu_dwell_crk_max_accel " " RAT_FUNC "%.3" "rpm/ms" COEFFS 0 0.00000006144 0 0 0 1 /end COMPU_METHOD
/begin MEASUREMENT dwell_crk_min "Dwell crank min" UWORD Compu_dwell_crk_min 0 0 0 1677.696 ECU_ADDRESS 0x010070A0 /end MEASUREMENT
/begin COMPU_METHOD Compu_dwell_crk_min " " RAT_FUNC "%.2" "ms" COEFFS 0 39.0625 0 0 0 1 /end COMPU_METHOD
/begin MEASUREMENT dwell4_adapt "Coil4 dwell adapt" SWORD Compu_dwell4_adapt 0 0 -104.8576 104.8544 ECU_ADDRESS 0x010070B0 /end MEASUREMENT
/begin COMPU_METHOD Compu_dwell4_adapt " " RAT_FUNC "%.2" "ms" COEFFS 0 312.5 0 0 0 1 /end COMPU_METHOD
/begin MEASUREMENT dwell5_adapt "Coil5 dwell adapt" SWORD Compu_dwell5_adapt 0 0 -104.8576 104.8544 ECU_ADDRESS 0x010070B8 /end MEASUREMENT
/begin COMPU_METHOD Compu_dwell5_adapt " " RAT_FUNC "%.2" "ms" COEFFS 0 312.5 0 0 0 1 /end COMPU_METHOD
/begin MEASUREMENT dwell6_adapt "Coil6 dwell adapt" SWORD Compu_dwell6_adapt 0 0 -104.8576 104.8544 ECU_ADDRESS 0x010070C0 /end MEASUREMENT
/begin COMPU_METHOD Compu_dwell6_adapt " " RAT_FUNC "%.2" "ms" COEFFS 0 312.5 0 0 0 1 /end COMPU_METHOD
/begin MEASUREMENT dwell7_adapt "Coil7 dwell adapt" SWORD Compu_dwell7_adapt 0 0 -104.8576 104.8544 ECU_ADDRESS 0x010070C8 /end MEASUREMENT
/begin COMPU_METHOD Compu_dwell7_adapt " " RAT_FUNC "%.2" "ms" COEFFS 0 312.5 0 0 0 1 /end COMPU_METHOD
/begin MEASUREMENT dwell8_adapt "Coil8 dwell adapt" SWORD Compu_dwell8_adapt 0 0 -104.8576 104.8544 ECU_ADDRESS 0x010070D0 /end MEASUREMENT
/begin COMPU_METHOD Compu_dwell8_adapt " " RAT_FUNC "%.2" "ms" COEFFS 0 312.5 0 0 0 1 /end COMPU_METHOD
/begin MEASUREMENT dwell_samp_cnt "Dwell adapt samples" UWORD Compu_dwell_samp_cnt 0 0 0 65535 ECU_ADDRESS 0x010070E0 /end MEASUREMENT
/begin COMPU_METHOD Compu_dwell_samp_cnt " " RAT_FUNC "%.0" "-" COEFFS 0 1 0 0 0 1 /end COMPU_METHOD
/begin MEASUREMENT dwell_extmod_cnt "Dwell ext module samples" UWORD Compu_dwell_extmod_cnt 0 0 0 65535 ECU_ADDRESS 0x010070E8 /end MEASUREMENT
/begin COMPU_METHOD Compu_dwell_extmod_cnt " " RAT_FUNC "%.0" "-" COEFFS 0 1 0 0 0 1 /end COMPU_METHOD
/begin MEASUREMENT dwell_open_i "Dwell open current samp" UWORD Compu_dwell_open_i 0 0 0 63.9990234375 ECU_ADDRESS 0x01007108 /end MEASUREMENT
/begin COMPU_METHOD Compu_dwell_open_i " " RAT_FUNC "%.3" "amps" COEFFS 0 1024 0 0 0 1 /end COMPU_METHOD
/begin CHARACTERISTIC SPKD_short_trig "Dwell diagnose post-rise samp (Fault Condition:sample delay from rising edge)" VALUE 0x001c7f6a /* @ECU_Address@SPKD_short_trig@0x01007128@ */ ECIPP_ALIGNMENT_UWORD 13107 Compu_SPKD_short_trig 0 13107 /end CHARACTERISTIC
/begin COMPU_METHOD Compu_SPKD_short_trig " " RAT_FUNC "%.1" "us" COEFFS 0 5 0 0 0 1 /end COMPU_METHOD
/begin MEASUREMENT dwell_short_i "Dwell short current samp" UWORD Compu_dwell_short_i 0 0 0 63.9990234375 ECU_ADDRESS 0x01007130 /end MEASUREMENT
/begin COMPU_METHOD Compu_dwell_short_i " " RAT_FUNC "%.3" "amps" COEFFS 0 1024 0 0 0 1 /end COMPU_METHOD
/begin MEASUREMENT dwell9_adapt "Coil9 dwell adapt" SWORD Compu_dwell9_adapt 0 0 -104.8576 104.8544 ECU_ADDRESS 0x010071E0 /end MEASUREMENT
/begin COMPU_METHOD Compu_dwell9_adapt " " RAT_FUNC "%.2" "ms" COEFFS 0 312.5 0 0 0 1 /end COMPU_METHOD
/begin MEASUREMENT dwell10_adapt "Coil10 dwell adapt" SWORD Compu_dwell10_adapt 0 0 -104.8576 104.8544 ECU_ADDRESS 0x010071E8 /end MEASUREMENT
/begin COMPU_METHOD Compu_dwell10_adapt " " RAT_FUNC "%.2" "ms" COEFFS 0 312.5 0 0 0 1 /end COMPU_METHOD
/begin CHARACTERISTIC spk_rpmlo_crank_lmt "Spark low-rpm crank limit" VALUE 0x001c84de /* @ECU_Address@spk_rpmlo_crank_lmt@0x01007BD0@ */ ECIPP_ALIGNMENT_UWORD 65535 Compu_spk_rpmlo_crank_lmt 0 65535 /end CHARACTERISTIC
/begin COMPU_METHOD Compu_spk_rpmlo_crank_lmt " " RAT_FUNC "%.0" "rpm" COEFFS 0 1 0 0 0 1 /end COMPU_METHOD
/begin CHARACTERISTIC spk_rpmlo_stall_lmt "Spark low-rpm stall limit" VALUE 0x001c84e0 /* @ECU_Address@spk_rpmlo_stall_lmt@0x01007BD8@ */ ECIPP_ALIGNMENT_UWORD 65535 Compu_spk_rpmlo_stall_lmt 0 65535 /end CHARACTERISTIC
/begin COMPU_METHOD Compu_spk_rpmlo_stall_lmt " " RAT_FUNC "%.0" "rpm" COEFFS 0 1 0 0 0 1 /end COMPU_METHOD
/begin CHARACTERISTIC KNKHst_percent_trig "Knock histogram percent trigger" VALUE 0x001c7cb0 /* @ECU_Address@KNKHst_percent_trig@0x01008320@ */ ECIPP_ALIGNMENT_UWORD 100 Compu_KNKHst_percent_trig 0 99.9984741210938 /end CHARACTERISTIC
/begin COMPU_METHOD Compu_KNKHst_percent_trig " " RAT_FUNC "%.1" "%" COEFFS 0 655.36 0 0 0 1 /end COMPU_METHOD
/begin CHARACTERISTIC KNKHst_retard_trig "Knock histogram retard trigger" VALUE 0x001c7cb2 /* @ECU_Address@KNKHst_retard_trig@0x01008328@ */ ECIPP_ALIGNMENT_UWORD 128 Compu_KNKHst_retard_trig 0 127.998046875 /end CHARACTERISTIC
/begin COMPU_METHOD Compu_KNKHst_retard_trig " " RAT_FUNC "%.1" "CAD" COEFFS 0 512 0 0 0 1 /end COMPU_METHOD
/begin CHARACTERISTIC KNKHst_trig_mode "Knock histogram trigger mode{KNKHst_trig_mode&0xff=0:Disabled}{KNKHst_trig_mode&0xff=1:Knock Retard}{KNKHst_trig_mode&0xff=2:Knock Percent}" VALUE 0x001c87b9 /* @ECU_Address@KNKHst_trig_mode@0x01008330@ */ ECIPP_ALIGNMENT_UBYTE 255 KNKHst_trig_mode_COMPU_VTAB 0 255 BIT_MASK 0xff /end CHARACTERISTIC
/begin COMPU_METHOD KNKHst_trig_mode_COMPU_VTAB "Verbal Table" TAB_VERB "%.0" "list" COMPU_TAB_REF KNKHst_trig_mode_COMPU_VTAB_REF /end COMPU_METHOD
/begin COMPU_VTAB KNKHst_trig_mode_COMPU_VTAB_REF "Verbal Table" TAB_VERB 3 0 "Disabled" 1 "Knock Retard" 2 "Knock Percent" DEFAULT_VALUE "UNKNOWN" /end COMPU_VTAB
/begin MEASUREMENT KNKHst_reset_request "Knock histogram reset{KNKHst_reset_request&0xff=0:Inactive}{KNKHst_reset_request&0xff=1:Reset Histogram}" UBYTE KNKHst_reset_request_COMPU_VTAB 0 0 0 255 ECU_ADDRESS 0x01008338 BIT_MASK 0xff /end MEASUREMENT
/begin COMPU_METHOD KNKHst_reset_request_COMPU_VTAB "Verbal Table" TAB_VERB "%.0" "list" COMPU_TAB_REF KNKHst_reset_request_COMPU_VTAB_REF /end COMPU_METHOD
/begin COMPU_VTAB KNKHst_reset_request_COMPU_VTAB_REF "Verbal Table" TAB_VERB 2 0 "Inactive" 1 "Reset Histogram" DEFAULT_VALUE "UNKNOWN" /end COMPU_VTAB
/begin CHARACTERISTIC dwell_sense1_source "Dwell source firing index 1{dwell_sense1_source&0xff=0:Default}{dwell_sense1_source&0xff=1:SPK_MON1}{dwell_sense1_source&0xff=2:SPK_MON2}" VALUE 0x001C8FF9 /* @ECU_Address@dwell_sense1_source@0x01008340@ */ ECIPP_ALIGNMENT_UBYTE 255 dwell_sense1_source_COMPU_VTAB 0 255 BIT_MASK 0xff /end CHARACTERISTIC
/begin COMPU_METHOD dwell_sense1_source_COMPU_VTAB "Verbal Table" TAB_VERB "%.0" "list" COMPU_TAB_REF dwell_sense1_source_COMPU_VTAB_REF /end COMPU_METHOD
/begin COMPU_VTAB dwell_sense1_source_COMPU_VTAB_REF "Verbal Table" TAB_VERB 3 0 "Default" 1 "SPK_MON1" 2 "SPK_MON2" DEFAULT_VALUE "UNKNOWN" /end COMPU_VTAB
/begin CHARACTERISTIC dwell_sense2_source "Dwell source firing index 2{dwell_sense2_source&0xff=0:Default}{dwell_sense2_source&0xff=1:SPK_MON1}{dwell_sense2_source&0xff=2:SPK_MON2}" VALUE 0x001C8FFA /* @ECU_Address@dwell_sense2_source@0x01008348@ */ ECIPP_ALIGNMENT_UBYTE 255 dwell_sense2_source_COMPU_VTAB 0 255 BIT_MASK 0xff /end CHARACTERISTIC
/begin COMPU_METHOD dwell_sense2_source_COMPU_VTAB "Verbal Table" TAB_VERB "%.0" "list" COMPU_TAB_REF dwell_sense2_source_COMPU_VTAB_REF /end COMPU_METHOD
/begin COMPU_VTAB dwell_sense2_source_COMPU_VTAB_REF "Verbal Table" TAB_VERB 3 0 "Default" 1 "SPK_MON1" 2 "SPK_MON2" DEFAULT_VALUE "UNKNOWN" /end COMPU_VTAB
/begin CHARACTERISTIC dwell_sense3_source "Dwell source firing index 3{dwell_sense3_source&0xff=0:Default}{dwell_sense3_source&0xff=1:SPK_MON1}{dwell_sense3_source&0xff=2:SPK_MON2}" VALUE 0x001C8FFB /* @ECU_Address@dwell_sense3_source@0x01008350@ */ ECIPP_ALIGNMENT_UBYTE 255 dwell_sense3_source_COMPU_VTAB 0 255 BIT_MASK 0xff /end CHARACTERISTIC
/begin COMPU_METHOD dwell_sense3_source_COMPU_VTAB "Verbal Table" TAB_VERB "%.0" "list" COMPU_TAB_REF dwell_sense3_source_COMPU_VTAB_REF /end COMPU_METHOD
/begin COMPU_VTAB dwell_sense3_source_COMPU_VTAB_REF "Verbal Table" TAB_VERB 3 0 "Default" 1 "SPK_MON1" 2 "SPK_MON2" DEFAULT_VALUE "UNKNOWN" /end COMPU_VTAB
/begin CHARACTERISTIC dwell_sense4_source "Dwell source firing index 4{dwell_sense4_source&0xff=0:Default}{dwell_sense4_source&0xff=1:SPK_MON1}{dwell_sense4_source&0xff=2:SPK_MON2}" VALUE 0x001C8FFC /* @ECU_Address@dwell_sense4_source@0x01008358@ */ ECIPP_ALIGNMENT_UBYTE 255 dwell_sense4_source_COMPU_VTAB 0 255 BIT_MASK 0xff /end CHARACTERISTIC
/begin COMPU_METHOD dwell_sense4_source_COMPU_VTAB "Verbal Table" TAB_VERB "%.0" "list" COMPU_TAB_REF dwell_sense4_source_COMPU_VTAB_REF /end COMPU_METHOD
/begin COMPU_VTAB dwell_sense4_source_COMPU_VTAB_REF "Verbal Table" TAB_VERB 3 0 "Default" 1 "SPK_MON1" 2 "SPK_MON2" DEFAULT_VALUE "UNKNOWN" /end COMPU_VTAB
/begin CHARACTERISTIC dwell_sense5_source "Dwell source firing index 5{dwell_sense5_source&0xff=0:Default}{dwell_sense5_source&0xff=1:SPK_MON1}{dwell_sense5_source&0xff=2:SPK_MON2}" VALUE 0x001C8FFD /* @ECU_Address@dwell_sense5_source@0x01008360@ */ ECIPP_ALIGNMENT_UBYTE 255 dwell_sense5_source_COMPU_VTAB 0 255 BIT_MASK 0xff /end CHARACTERISTIC
/begin COMPU_METHOD dwell_sense5_source_COMPU_VTAB "Verbal Table" TAB_VERB "%.0" "list" COMPU_TAB_REF dwell_sense5_source_COMPU_VTAB_REF /end COMPU_METHOD
/begin COMPU_VTAB dwell_sense5_source_COMPU_VTAB_REF "Verbal Table" TAB_VERB 3 0 "Default" 1 "SPK_MON1" 2 "SPK_MON2" DEFAULT_VALUE "UNKNOWN" /end COMPU_VTAB
/begin CHARACTERISTIC dwell_sense6_source "Dwell source firing index 6{dwell_sense6_source&0xff=0:Default}{dwell_sense6_source&0xff=1:SPK_MON1}{dwell_sense6_source&0xff=2:SPK_MON2}" VALUE 0x001C8FFE /* @ECU_Address@dwell_sense6_source@0x01008368@ */ ECIPP_ALIGNMENT_UBYTE 255 dwell_sense6_source_COMPU_VTAB 0 255 BIT_MASK 0xff /end CHARACTERISTIC
/begin COMPU_METHOD dwell_sense6_source_COMPU_VTAB "Verbal Table" TAB_VERB "%.0" "list" COMPU_TAB_REF dwell_sense6_source_COMPU_VTAB_REF /end COMPU_METHOD
/begin COMPU_VTAB dwell_sense6_source_COMPU_VTAB_REF "Verbal Table" TAB_VERB 3 0 "Default" 1 "SPK_MON1" 2 "SPK_MON2" DEFAULT_VALUE "UNKNOWN" /end COMPU_VTAB
/begin CHARACTERISTIC dwell_sense7_source "Dwell source firing index 7{dwell_sense7_source&0xff=0:Default}{dwell_sense7_source&0xff=1:SPK_MON1}{dwell_sense7_source&0xff=2:SPK_MON2}" VALUE 0x001C8FFF /* @ECU_Address@dwell_sense7_source@0x01008370@ */ ECIPP_ALIGNMENT_UBYTE 255 dwell_sense7_source_COMPU_VTAB 0 255 BIT_MASK 0xff /end CHARACTERISTIC
/begin COMPU_METHOD dwell_sense7_source_COMPU_VTAB "Verbal Table" TAB_VERB "%.0" "list" COMPU_TAB_REF dwell_sense7_source_COMPU_VTAB_REF /end COMPU_METHOD
/begin COMPU_VTAB dwell_sense7_source_COMPU_VTAB_REF "Verbal Table" TAB_VERB 3 0 "Default" 1 "SPK_MON1" 2 "SPK_MON2" DEFAULT_VALUE "UNKNOWN" /end COMPU_VTAB
/begin CHARACTERISTIC dwell_sense8_source "Dwell source firing index 8{dwell_sense8_source&0xff=0:Default}{dwell_sense8_source&0xff=1:SPK_MON1}{dwell_sense8_source&0xff=2:SPK_MON2}" VALUE 0x001C9000 /* @ECU_Address@dwell_sense8_source@0x01008378@ */ ECIPP_ALIGNMENT_UBYTE 255 dwell_sense8_source_COMPU_VTAB 0 255 BIT_MASK 0xff /end CHARACTERISTIC
/begin COMPU_METHOD dwell_sense8_source_COMPU_VTAB "Verbal Table" TAB_VERB "%.0" "list" COMPU_TAB_REF dwell_sense8_source_COMPU_VTAB_REF /end COMPU_METHOD
/begin COMPU_VTAB dwell_sense8_source_COMPU_VTAB_REF "Verbal Table" TAB_VERB 3 0 "Default" 1 "SPK_MON1" 2 "SPK_MON2" DEFAULT_VALUE "UNKNOWN" /end COMPU_VTAB
/begin CHARACTERISTIC dwell_sense9_source "Dwell source firing index 9{dwell_sense9_source&0xff=0:Default}{dwell_sense9_source&0xff=1:SPK_MON1}{dwell_sense9_source&0xff=2:SPK_MON2}" VALUE 0x001C9001 /* @ECU_Address@dwell_sense9_source@0x01008380@ */ ECIPP_ALIGNMENT_UBYTE 255 dwell_sense9_source_COMPU_VTAB 0 255 BIT_MASK 0xff /end CHARACTERISTIC
/begin COMPU_METHOD dwell_sense9_source_COMPU_VTAB "Verbal Table" TAB_VERB "%.0" "list" COMPU_TAB_REF dwell_sense9_source_COMPU_VTAB_REF /end COMPU_METHOD
/begin COMPU_VTAB dwell_sense9_source_COMPU_VTAB_REF "Verbal Table" TAB_VERB 3 0 "Default" 1 "SPK_MON1" 2 "SPK_MON2" DEFAULT_VALUE "UNKNOWN" /end COMPU_VTAB
/begin CHARACTERISTIC dwell_sense10_source "Dwell source firing index 10{dwell_sense10_source&0xff=0:Default}{dwell_sense10_source&0xff=1:SPK_MON1}{dwell_sense10_source&0xff=2:SPK_MON2}" VALUE 0x001C9002 /* @ECU_Address@dwell_sense10_source@0x01008388@ */ ECIPP_ALIGNMENT_UBYTE 255 dwell_sense10_source_COMPU_VTAB 0 255 BIT_MASK 0xff /end CHARACTERISTIC
/begin COMPU_METHOD dwell_sense10_source_COMPU_VTAB "Verbal Table" TAB_VERB "%.0" "list" COMPU_TAB_REF dwell_sense10_source_COMPU_VTAB_REF /end COMPU_METHOD
/begin COMPU_VTAB dwell_sense10_source_COMPU_VTAB_REF "Verbal Table" TAB_VERB 3 0 "Default" 1 "SPK_MON1" 2 "SPK_MON2" DEFAULT_VALUE "UNKNOWN" /end COMPU_VTAB
/begin CHARACTERISTIC SRVC_mode "Service notification mode{SRVC_mode&0xff=0:Disabled}{SRVC_mode&0xff=1:Fixed interval (hours)}{SRVC_mode&0xff=2:Speed/load based}{SRVC_mode&0xff=3:Fixed interval (kms)}" VALUE 0x001c8910 /* @ECU_Address@SRVC_mode@0x01008408@ */ ECIPP_ALIGNMENT_UBYTE 255 SRVC_mode_COMPU_VTAB 0 255 BIT_MASK 0xff /end CHARACTERISTIC
/begin COMPU_METHOD SRVC_mode_COMPU_VTAB "Verbal Table" TAB_VERB "%.0" "list" COMPU_TAB_REF SRVC_mode_COMPU_VTAB_REF /end COMPU_METHOD
/begin COMPU_VTAB SRVC_mode_COMPU_VTAB_REF "Verbal Table" TAB_VERB 4 0 "Disabled" 1 "Fixed interval (hours)" 2 "Speed/load based" 3 "Fixed interval (kms)" DEFAULT_VALUE "UNKNOWN" /end COMPU_VTAB
/begin CHARACTERISTIC SRVC_fixed_interval "Service fixed interval (hours)" VALUE 0x001c7f88 /* @ECU_Address@SRVC_fixed_interval@0x01008410@ */ ECIPP_ALIGNMENT_UWORD 32768 Compu_SRVC_fixed_interval 0 32767.5 /end CHARACTERISTIC
/begin COMPU_METHOD Compu_SRVC_fixed_interval " " RAT_FUNC "%.1" "hours" COEFFS 0 2 0 0 0 1 /end COMPU_METHOD
/begin MEASUREMENT SRVC_update_key "Service update key" UWORD Compu_SRVC_update_key 0 0 0 65535 ECU_ADDRESS 0x01008418 /end MEASUREMENT
/begin COMPU_METHOD Compu_SRVC_update_key " " RAT_FUNC "%.0" "[23130]" COEFFS 0 1 0 0 0 1 /end COMPU_METHOD
/begin MEASUREMENT SRVC_update_status "Service update status{SRVC_update_status&0xff=0:Inactive}{SRVC_update_status&0xff=1:In progress...}{SRVC_update_status&0xff=2:Completed}{SRVC_update_status&0xff=3:Reset Request}" UBYTE SRVC_update_status_COMPU_VTAB 0 0 0 255 ECU_ADDRESS 0x01008420 BIT_MASK 0xff /end MEASUREMENT
/begin COMPU_METHOD SRVC_update_status_COMPU_VTAB "Verbal Table" TAB_VERB "%.0" "list" COMPU_TAB_REF SRVC_update_status_COMPU_VTAB_REF /end COMPU_METHOD
/begin COMPU_VTAB SRVC_update_status_COMPU_VTAB_REF "Verbal Table" TAB_VERB 4 0 "Inactive" 1 "In progress..." 2 "Completed" 3 "Reset Request" DEFAULT_VALUE "UNKNOWN" /end COMPU_VTAB
/begin MEASUREMENT SRVC_pct_accum "Service interval used" ULONG Compu_SRVC_pct_accum 0 0 0 99.9999999767169 ECU_ADDRESS 0x01008428 /end MEASUREMENT
/begin COMPU_METHOD Compu_SRVC_pct_accum " " RAT_FUNC "%.1" "%" COEFFS 0 42949672.96 0 0 0 1 /end COMPU_METHOD
/begin CHARACTERISTIC spkmon_min_dissipate "Dwell current sampling dissipation" VALUE 0x001c84e2 /* @ECU_Address@spkmon_min_dissipate@0x01008CC8@ */ ECIPP_ALIGNMENT_UWORD 13107 Compu_spkmon_min_dissipate 0 13107 /end CHARACTERISTIC
/begin COMPU_METHOD Compu_spkmon_min_dissipate " " RAT_FUNC "%.0" "ms" COEFFS 0 5 0 0 0 1 /end COMPU_METHOD
/begin CHARACTERISTIC engine_type "Engine type{engine_type&0xff=0:Spark-ignited non-DI}{engine_type&0xff=1:Common-rail diesel}{engine_type&0xff=2:Spark-ignited CRDI}" VALUE 0x001c900f /* @ECU_Address@engine_type@0x0100A2D0@ */ ECIPP_ALIGNMENT_UBYTE 255 engine_type_COMPU_VTAB 0 255 BIT_MASK 0xff /end CHARACTERISTIC
/begin COMPU_METHOD engine_type_COMPU_VTAB "Verbal Table" TAB_VERB "%.0" "list" COMPU_TAB_REF engine_type_COMPU_VTAB_REF /end COMPU_METHOD
/begin COMPU_VTAB engine_type_COMPU_VTAB_REF "Verbal Table" TAB_VERB 3 0 "Spark-ignited non-DI" 1 "Common-rail diesel" 2 "Spark-ignited CRDI" DEFAULT_VALUE "UNKNOWN" /end COMPU_VTAB
/begin CHARACTERISTIC SPK_IGBT_T_Timer "Spark kill overtemp (Fault Condition:Spark plug or coil fault countdown timer)" VALUE 0x001c890c /* @ECU_Address@SPK_IGBT_T_Timer@0x0100B918@ */ ECIPP_ALIGNMENT_UBYTE 255 Compu_SPK_IGBT_T_Timer 0 255 /end CHARACTERISTIC
/begin COMPU_METHOD Compu_SPK_IGBT_T_Timer " " RAT_FUNC "%.1" "secs" COEFFS 0 1 0 0 0 1 /end COMPU_METHOD
/begin MEASUREMENT dwell_d_amp_ls "Dwell adapt target adjusted" SWORD Compu_dwell_d_amp_ls 0 0 -32 31.9990234375 ECU_ADDRESS 0x0100C050 /end MEASUREMENT
/begin COMPU_METHOD Compu_dwell_d_amp_ls " " RAT_FUNC "%.3" "amps" COEFFS 0 1024 0 0 0 1 /end COMPU_METHOD
/begin CHARACTERISTIC ECTHst_ena "ECT histogram{ECTHst_ena&0xff=0:Disabled}{ECTHst_ena&0xff=1:Enabled}" VALUE 0x001c86ca /* @ECU_Address@ECTHst_ena@0x0100DD48@ */ ECIPP_ALIGNMENT_UBYTE 255 ECTHst_ena_COMPU_VTAB 0 255 BIT_MASK 0xff /end CHARACTERISTIC
/begin COMPU_METHOD ECTHst_ena_COMPU_VTAB "Verbal Table" TAB_VERB "%.0" "list" COMPU_TAB_REF ECTHst_ena_COMPU_VTAB_REF /end COMPU_METHOD
/begin COMPU_VTAB ECTHst_ena_COMPU_VTAB_REF "Verbal Table" TAB_VERB 2 0 "Disabled" 1 "Enabled" DEFAULT_VALUE "UNKNOWN" /end COMPU_VTAB
/begin MEASUREMENT ECTHst_reset_usr "ECT histogram reset" UWORD Compu_ECTHst_reset_usr 0 0 0 65535 ECU_ADDRESS 0x0100DD58 /end MEASUREMENT
/begin COMPU_METHOD Compu_ECTHst_reset_usr " " RAT_FUNC "%.0" "-" COEFFS 0 1 0 0 0 1 /end COMPU_METHOD
/begin CHARACTERISTIC ECTHst_hi_trig "ECT hour meter trigger" VALUE 0x001c6e8a /* @ECU_Address@ECTHst_hi_trig@0x0100DD68@ */ ECIPP_ALIGNMENT_UWORD 564 Compu_ECTHst_hi_trig -460 563.984375 /end CHARACTERISTIC
/begin COMPU_METHOD Compu_ECTHst_hi_trig " " RAT_FUNC "%.1" "deg F" COEFFS 0 64 29440 0 0 1 /end COMPU_METHOD
/begin CHARACTERISTIC spk_rpmlo_crank_ena "Spark low-rpm crank limit enable{spk_rpmlo_crank_ena&0xff=0:Disabled}{spk_rpmlo_crank_ena&0xff=1:Gasoline Only}{spk_rpmlo_crank_ena&0xff=2:LP Only}{spk_rpmlo_crank_ena&0xff=3:NG Only}{spk_rpmlo_crank_ena&0xff=4:Gaseous Only}{spk_rpmlo_crank_ena&0xff=5:Alw" VALUE 0x001c907d /* @ECU_Address@spk_rpmlo_crank_ena@0x0100F438@ */ ECIPP_ALIGNMENT_UBYTE 255 spk_rpmlo_crank_ena_COMPU_VTAB 0 255 BIT_MASK 0xff /end CHARACTERISTIC
/begin COMPU_METHOD spk_rpmlo_crank_ena_COMPU_VTAB "Verbal Table" TAB_VERB "%.0" "list" COMPU_TAB_REF spk_rpmlo_crank_ena_COMPU_VTAB_REF /end COMPU_METHOD
/begin COMPU_VTAB spk_rpmlo_crank_ena_COMPU_VTAB_REF "Verbal Table" TAB_VERB 6 0 "Disabled" 1 "Gasoline Only" 2 "LP Only" 3 "NG Only" 4 "Gaseous Only" 5 "Always Enabled" DEFAULT_VALUE "UNKNOWN" /end COMPU_VTAB
/begin MEASUREMENT enov_slnk_u8_1 "enov_slnk_u8_1" UBYTE Compu_enov_slnk_u8_1 0 0 0 255 ECU_ADDRESS 0x0100FD30 /end MEASUREMENT
/begin COMPU_METHOD Compu_enov_slnk_u8_1 " " RAT_FUNC "%.0" "-" COEFFS 0 1 0 0 0 1 /end COMPU_METHOD
/begin MEASUREMENT enov_slnk_u8_2 "enov_slnk_u8_2" UBYTE Compu_enov_slnk_u8_2 0 0 0 255 ECU_ADDRESS 0x0100FD38 /end MEASUREMENT
/begin COMPU_METHOD Compu_enov_slnk_u8_2 " " RAT_FUNC "%.0" "-" COEFFS 0 1 0 0 0 1 /end COMPU_METHOD
/begin MEASUREMENT enov_slnk_u8_3 "enov_slnk_u8_3" UBYTE Compu_enov_slnk_u8_3 0 0 0 255 ECU_ADDRESS 0x0100FD40 /end MEASUREMENT
/begin COMPU_METHOD Compu_enov_slnk_u8_3 " " RAT_FUNC "%.0" "-" COEFFS 0 1 0 0 0 1 /end COMPU_METHOD
/begin MEASUREMENT enov_slnk_u8_4 "enov_slnk_u8_4" UBYTE Compu_enov_slnk_u8_4 0 0 0 255 ECU_ADDRESS 0x0100FD48 /end MEASUREMENT
/begin COMPU_METHOD Compu_enov_slnk_u8_4 " " RAT_FUNC "%.0" "-" COEFFS 0 1 0 0 0 1 /end COMPU_METHOD
/begin MEASUREMENT enov_slnk_u8_5 "enov_slnk_u8_5" UBYTE Compu_enov_slnk_u8_5 0 0 0 255 ECU_ADDRESS 0x0100FD50 /end MEASUREMENT
/begin COMPU_METHOD Compu_enov_slnk_u8_5 " " RAT_FUNC "%.0" "-" COEFFS 0 1 0 0 0 1 /end COMPU_METHOD
/begin MEASUREMENT enov_slnk_u8_6 "enov_slnk_u8_6" UBYTE Compu_enov_slnk_u8_6 0 0 0 255 ECU_ADDRESS 0x0100FD58 /end MEASUREMENT
/begin COMPU_METHOD Compu_enov_slnk_u8_6 " " RAT_FUNC "%.0" "-" COEFFS 0 1 0 0 0 1 /end COMPU_METHOD
/begin MEASUREMENT enov_slnk_u8_7 "enov_slnk_u8_7" UBYTE Compu_enov_slnk_u8_7 0 0 0 255 ECU_ADDRESS 0x0100FD60 /end MEASUREMENT
/begin COMPU_METHOD Compu_enov_slnk_u8_7 " " RAT_FUNC "%.0" "-" COEFFS 0 1 0 0 0 1 /end COMPU_METHOD
/begin MEASUREMENT enov_slnk_u8_8 "enov_slnk_u8_8" UBYTE Compu_enov_slnk_u8_8 0 0 0 255 ECU_ADDRESS 0x0100FD68 /end MEASUREMENT
/begin COMPU_METHOD Compu_enov_slnk_u8_8 " " RAT_FUNC "%.0" "-" COEFFS 0 1 0 0 0 1 /end COMPU_METHOD
/begin MEASUREMENT enov_slnk_u8_9 "enov_slnk_u8_9" UBYTE Compu_enov_slnk_u8_9 0 0 0 255 ECU_ADDRESS 0x0100FD70 /end MEASUREMENT
/begin COMPU_METHOD Compu_enov_slnk_u8_9 " " RAT_FUNC "%.0" "-" COEFFS 0 1 0 0 0 1 /end COMPU_METHOD
/begin MEASUREMENT enov_slnk_u8_10 "enov_slnk_u8_10" UBYTE Compu_enov_slnk_u8_10 0 0 0 255 ECU_ADDRESS 0x0100FD78 /end MEASUREMENT
/begin COMPU_METHOD Compu_enov_slnk_u8_10 " " RAT_FUNC "%.0" "-" COEFFS 0 1 0 0 0 1 /end COMPU_METHOD
/begin MEASUREMENT enov_slnk_u8_11 "enov_slnk_u8_11" UBYTE Compu_enov_slnk_u8_11 0 0 0 255 ECU_ADDRESS 0x0100FD80 /end MEASUREMENT
/begin COMPU_METHOD Compu_enov_slnk_u8_11 " " RAT_FUNC "%.0" "-" COEFFS 0 1 0 0 0 1 /end COMPU_METHOD
/begin MEASUREMENT enov_slnk_u8_12 "enov_slnk_u8_12" UBYTE Compu_enov_slnk_u8_12 0 0 0 255 ECU_ADDRESS 0x0100FD88 /end MEASUREMENT
/begin COMPU_METHOD Compu_enov_slnk_u8_12 " " RAT_FUNC "%.0" "-" COEFFS 0 1 0 0 0 1 /end COMPU_METHOD
/begin MEASUREMENT enov_slnk_u8_13 "enov_slnk_u8_13" UBYTE Compu_enov_slnk_u8_13 0 0 0 255 ECU_ADDRESS 0x0100FD90 /end MEASUREMENT
/begin COMPU_METHOD Compu_enov_slnk_u8_13 " " RAT_FUNC "%.0" "-" COEFFS 0 1 0 0 0 1 /end COMPU_METHOD
/begin MEASUREMENT enov_slnk_u8_14 "enov_slnk_u8_14" UBYTE Compu_enov_slnk_u8_14 0 0 0 255 ECU_ADDRESS 0x0100FD98 /end MEASUREMENT
/begin COMPU_METHOD Compu_enov_slnk_u8_14 " " RAT_FUNC "%.0" "-" COEFFS 0 1 0 0 0 1 /end COMPU_METHOD
/begin MEASUREMENT enov_slnk_u8_15 "enov_slnk_u8_15" UBYTE Compu_enov_slnk_u8_15 0 0 0 255 ECU_ADDRESS 0x0100FDA0 /end MEASUREMENT
/begin COMPU_METHOD Compu_enov_slnk_u8_15 " " RAT_FUNC "%.0" "-" COEFFS 0 1 0 0 0 1 /end COMPU_METHOD
/begin MEASUREMENT enov_slnk_u8_16 "enov_slnk_u8_16" UBYTE Compu_enov_slnk_u8_16 0 0 0 255 ECU_ADDRESS 0x0100FDA8 /end MEASUREMENT
/begin COMPU_METHOD Compu_enov_slnk_u8_16 " " RAT_FUNC "%.0" "-" COEFFS 0 1 0 0 0 1 /end COMPU_METHOD
/begin MEASUREMENT enov_slnk_u8_17 "enov_slnk_u8_17" UBYTE Compu_enov_slnk_u8_17 0 0 0 255 ECU_ADDRESS 0x0100FDB0 /end MEASUREMENT
/begin COMPU_METHOD Compu_enov_slnk_u8_17 " " RAT_FUNC "%.0" "-" COEFFS 0 1 0 0 0 1 /end COMPU_METHOD
/begin MEASUREMENT enov_slnk_u8_18 "enov_slnk_u8_18" UBYTE Compu_enov_slnk_u8_18 0 0 0 255 ECU_ADDRESS 0x0100FDB8 /end MEASUREMENT
/begin COMPU_METHOD Compu_enov_slnk_u8_18 " " RAT_FUNC "%.0" "-" COEFFS 0 1 0 0 0 1 /end COMPU_METHOD
/begin MEASUREMENT enov_slnk_u8_19 "enov_slnk_u8_19" UBYTE Compu_enov_slnk_u8_19 0 0 0 255 ECU_ADDRESS 0x0100FDC0 /end MEASUREMENT
/begin COMPU_METHOD Compu_enov_slnk_u8_19 " " RAT_FUNC "%.0" "-" COEFFS 0 1 0 0 0 1 /end COMPU_METHOD
/begin MEASUREMENT enov_slnk_u8_20 "enov_slnk_u8_20" UBYTE Compu_enov_slnk_u8_20 0 0 0 255 ECU_ADDRESS 0x0100FDC8 /end MEASUREMENT
/begin COMPU_METHOD Compu_enov_slnk_u8_20 " " RAT_FUNC "%.0" "-" COEFFS 0 1 0 0 0 1 /end COMPU_METHOD
/begin MEASUREMENT enov_slnk_f_1 "enov_slnk_f_1" FLOAT32_IEEE Compu_enov_slnk_f_1 0 0 -10000000000 10000000000 ECU_ADDRESS 0x0100FDD0 /end MEASUREMENT
/begin COMPU_METHOD Compu_enov_slnk_f_1 " " RAT_FUNC "%.3" "-" COEFFS 0 1 0 0 0 1 /end COMPU_METHOD
/begin MEASUREMENT enov_slnk_f_2 "enov_slnk_f_2" FLOAT32_IEEE Compu_enov_slnk_f_2 0 0 -10000000000 10000000000 ECU_ADDRESS 0x0100FDD8 /end MEASUREMENT
/begin COMPU_METHOD Compu_enov_slnk_f_2 " " RAT_FUNC "%.3" "-" COEFFS 0 1 0 0 0 1 /end COMPU_METHOD
/begin MEASUREMENT enov_slnk_f_3 "enov_slnk_f_3" FLOAT32_IEEE Compu_enov_slnk_f_3 0 0 -10000000000 10000000000 ECU_ADDRESS 0x0100FDE0 /end MEASUREMENT
/begin COMPU_METHOD Compu_enov_slnk_f_3 " " RAT_FUNC "%.3" "-" COEFFS 0 1 0 0 0 1 /end COMPU_METHOD
/begin MEASUREMENT enov_slnk_f_4 "enov_slnk_f_4" FLOAT32_IEEE Compu_enov_slnk_f_4 0 0 -10000000000 10000000000 ECU_ADDRESS 0x0100FDE8 /end MEASUREMENT
/begin COMPU_METHOD Compu_enov_slnk_f_4 " " RAT_FUNC "%.3" "-" COEFFS 0 1 0 0 0 1 /end COMPU_METHOD
/begin MEASUREMENT enov_slnk_f_5 "enov_slnk_f_5" FLOAT32_IEEE Compu_enov_slnk_f_5 0 0 -10000000000 10000000000 ECU_ADDRESS 0x0100FDF0 /end MEASUREMENT
/begin COMPU_METHOD Compu_enov_slnk_f_5 " " RAT_FUNC "%.3" "-" COEFFS 0 1 0 0 0 1 /end COMPU_METHOD
/begin MEASUREMENT enov_slnk_f_6 "enov_slnk_f_6" FLOAT32_IEEE Compu_enov_slnk_f_6 0 0 -10000000000 10000000000 ECU_ADDRESS 0x0100FDF8 /end MEASUREMENT
/begin COMPU_METHOD Compu_enov_slnk_f_6 " " RAT_FUNC "%.3" "-" COEFFS 0 1 0 0 0 1 /end COMPU_METHOD
/begin MEASUREMENT enov_slnk_f_7 "enov_slnk_f_7" FLOAT32_IEEE Compu_enov_slnk_f_7 0 0 -10000000000 10000000000 ECU_ADDRESS 0x0100FE00 /end MEASUREMENT
/begin COMPU_METHOD Compu_enov_slnk_f_7 " " RAT_FUNC "%.3" "-" COEFFS 0 1 0 0 0 1 /end COMPU_METHOD
/begin MEASUREMENT enov_slnk_f_8 "enov_slnk_f_8" FLOAT32_IEEE Compu_enov_slnk_f_8 0 0 -10000000000 10000000000 ECU_ADDRESS 0x0100FE08 /end MEASUREMENT
/begin COMPU_METHOD Compu_enov_slnk_f_8 " " RAT_FUNC "%.3" "-" COEFFS 0 1 0 0 0 1 /end COMPU_METHOD
/begin MEASUREMENT enov_slnk_f_9 "enov_slnk_f_9" FLOAT32_IEEE Compu_enov_slnk_f_9 0 0 -10000000000 10000000000 ECU_ADDRESS 0x0100FE10 /end MEASUREMENT
/begin COMPU_METHOD Compu_enov_slnk_f_9 " " RAT_FUNC "%.3" "-" COEFFS 0 1 0 0 0 1 /end COMPU_METHOD
/begin MEASUREMENT enov_slnk_f_10 "enov_slnk_f_10" FLOAT32_IEEE Compu_enov_slnk_f_10 0 0 -10000000000 10000000000 ECU_ADDRESS 0x0100FE18 /end MEASUREMENT
/begin COMPU_METHOD Compu_enov_slnk_f_10 " " RAT_FUNC "%.3" "-" COEFFS 0 1 0 0 0 1 /end COMPU_METHOD
/begin MEASUREMENT enov_slnk_f_11 "enov_slnk_f_11" FLOAT32_IEEE Compu_enov_slnk_f_11 0 0 -10000000000 10000000000 ECU_ADDRESS 0x0100FE20 /end MEASUREMENT
/begin COMPU_METHOD Compu_enov_slnk_f_11 " " RAT_FUNC "%.3" "-" COEFFS 0 1 0 0 0 1 /end COMPU_METHOD
/begin MEASUREMENT enov_slnk_f_12 "enov_slnk_f_12" FLOAT32_IEEE Compu_enov_slnk_f_12 0 0 -10000000000 10000000000 ECU_ADDRESS 0x0100FE28 /end MEASUREMENT
/begin COMPU_METHOD Compu_enov_slnk_f_12 " " RAT_FUNC "%.3" "-" COEFFS 0 1 0 0 0 1 /end COMPU_METHOD
/begin MEASUREMENT enov_slnk_f_13 "enov_slnk_f_13" FLOAT32_IEEE Compu_enov_slnk_f_13 0 0 -10000000000 10000000000 ECU_ADDRESS 0x0100FE30 /end MEASUREMENT
/begin COMPU_METHOD Compu_enov_slnk_f_13 " " RAT_FUNC "%.3" "-" COEFFS 0 1 0 0 0 1 /end COMPU_METHOD
/begin MEASUREMENT enov_slnk_f_14 "enov_slnk_f_14" FLOAT32_IEEE Compu_enov_slnk_f_14 0 0 -10000000000 10000000000 ECU_ADDRESS 0x0100FE38 /end MEASUREMENT
/begin COMPU_METHOD Compu_enov_slnk_f_14 " " RAT_FUNC "%.3" "-" COEFFS 0 1 0 0 0 1 /end COMPU_METHOD
/begin MEASUREMENT enov_slnk_f_15 "enov_slnk_f_15" FLOAT32_IEEE Compu_enov_slnk_f_15 0 0 -10000000000 10000000000 ECU_ADDRESS 0x0100FE40 /end MEASUREMENT
/begin COMPU_METHOD Compu_enov_slnk_f_15 " " RAT_FUNC "%.3" "-" COEFFS 0 1 0 0 0 1 /end COMPU_METHOD
/begin MEASUREMENT enov_slnk_f_16 "enov_slnk_f_16" FLOAT32_IEEE Compu_enov_slnk_f_16 0 0 -10000000000 10000000000 ECU_ADDRESS 0x0100FE48 /end MEASUREMENT
/begin COMPU_METHOD Compu_enov_slnk_f_16 " " RAT_FUNC "%.3" "-" COEFFS 0 1 0 0 0 1 /end COMPU_METHOD
/begin MEASUREMENT enov_slnk_f_17 "enov_slnk_f_17" FLOAT32_IEEE Compu_enov_slnk_f_17 0 0 -10000000000 10000000000 ECU_ADDRESS 0x0100FE50 /end MEASUREMENT
/begin COMPU_METHOD Compu_enov_slnk_f_17 " " RAT_FUNC "%.3" "-" COEFFS 0 1 0 0 0 1 /end COMPU_METHOD
/begin MEASUREMENT enov_slnk_f_18 "enov_slnk_f_18" FLOAT32_IEEE Compu_enov_slnk_f_18 0 0 -10000000000 10000000000 ECU_ADDRESS 0x0100FE58 /end MEASUREMENT
/begin COMPU_METHOD Compu_enov_slnk_f_18 " " RAT_FUNC "%.3" "-" COEFFS 0 1 0 0 0 1 /end COMPU_METHOD
/begin MEASUREMENT enov_slnk_f_19 "enov_slnk_f_19" FLOAT32_IEEE Compu_enov_slnk_f_19 0 0 -10000000000 10000000000 ECU_ADDRESS 0x0100FE60 /end MEASUREMENT
/begin COMPU_METHOD Compu_enov_slnk_f_19 " " RAT_FUNC "%.3" "-" COEFFS 0 1 0 0 0 1 /end COMPU_METHOD
/begin MEASUREMENT enov_slnk_f_20 "enov_slnk_f_20" FLOAT32_IEEE Compu_enov_slnk_f_20 0 0 -10000000000 10000000000 ECU_ADDRESS 0x0100FE68 /end MEASUREMENT
/begin COMPU_METHOD Compu_enov_slnk_f_20 " " RAT_FUNC "%.3" "-" COEFFS 0 1 0 0 0 1 /end COMPU_METHOD
/begin MEASUREMENT slnk_invalid_fsh_adr "Invalid flash access" ULONG Compu_slnk_invalid_fsh_adr 0 0 0 4294967295 ECU_ADDRESS 0x0100FE70 /end MEASUREMENT
/begin COMPU_METHOD Compu_slnk_invalid_fsh_adr " " RAT_FUNC "%.0" "address" COEFFS 0 1 0 0 0 1 /end COMPU_METHOD
/begin MEASUREMENT slnk_invalid_fsh_cnt "Invalid flash access" UBYTE Compu_slnk_invalid_fsh_cnt 0 0 0 255 ECU_ADDRESS 0x0100FE78 /end MEASUREMENT
/begin COMPU_METHOD Compu_slnk_invalid_fsh_cnt " " RAT_FUNC "%.0" "count" COEFFS 0 1 0 0 0 1 /end COMPU_METHOD
/begin MEASUREMENT slnk_invalid_reg_adr "Invalid register access" ULONG Compu_slnk_invalid_reg_adr 0 0 0 4294967295 ECU_ADDRESS 0x0100FE80 /end MEASUREMENT
/begin COMPU_METHOD Compu_slnk_invalid_reg_adr " " RAT_FUNC "%.0" "address" COEFFS 0 1 0 0 0 1 /end COMPU_METHOD
/begin MEASUREMENT slnk_invalid_reg_cnt "Invalid register access" UBYTE Compu_slnk_invalid_reg_cnt 0 0 0 255 ECU_ADDRESS 0x0100FE88 /end MEASUREMENT
/begin COMPU_METHOD Compu_slnk_invalid_reg_cnt " " RAT_FUNC "%.0" "count" COEFFS 0 1 0 0 0 1 /end COMPU_METHOD
/begin MEASUREMENT slnk_invalid_RAM_adr "Invalid RAM access" ULONG Compu_slnk_invalid_RAM_adr 0 0 0 4294967295 ECU_ADDRESS 0x0100FE90 /end MEASUREMENT
/begin COMPU_METHOD Compu_slnk_invalid_RAM_adr " " RAT_FUNC "%.0" "address" COEFFS 0 1 0 0 0 1 /end COMPU_METHOD
/begin MEASUREMENT slnk_invalid_RAM_cnt "Invalid RAM access" UBYTE Compu_slnk_invalid_RAM_cnt 0 0 0 255 ECU_ADDRESS 0x0100FE98 /end MEASUREMENT
/begin COMPU_METHOD Compu_slnk_invalid_RAM_cnt " " RAT_FUNC "%.0" "count" COEFFS 0 1 0 0 0 1 /end COMPU_METHOD
/begin MEASUREMENT enov_slnk_1ms_live "Task 1ms - Live{enov_slnk_1ms_live&0xff=0:NO}{enov_slnk_1ms_live&0xff=1:YES}" UBYTE enov_slnk_1ms_live_COMPU_VTAB 0 0 0 255 ECU_ADDRESS 0x0100FEA8 BIT_MASK 0xff /end MEASUREMENT
/begin COMPU_METHOD enov_slnk_1ms_live_COMPU_VTAB "Verbal Table" TAB_VERB "%.0" "list" COMPU_TAB_REF enov_slnk_1ms_live_COMPU_VTAB_REF /end COMPU_METHOD
/begin COMPU_VTAB enov_slnk_1ms_live_COMPU_VTAB_REF "Verbal Table" TAB_VERB 2 0 "NO" 1 "YES" DEFAULT_VALUE "UNKNOWN" /end COMPU_VTAB
/begin MEASUREMENT enov_slnk_1ms_oruns "Task 1ms - Overruns" UBYTE Compu_enov_slnk_1ms_oruns 0 0 0 255 ECU_ADDRESS 0x0100FEB0 /end MEASUREMENT
/begin COMPU_METHOD Compu_enov_slnk_1ms_oruns " " RAT_FUNC "%.0" "-" COEFFS 0 1 0 0 0 1 /end COMPU_METHOD
/begin MEASUREMENT enov_slnk_1ms_inst "Task 1ms - Inst (ms)" UWORD Compu_enov_slnk_1ms_inst 0 0 0 209.712 ECU_ADDRESS 0x0100FEB8 /end MEASUREMENT
/begin COMPU_METHOD Compu_enov_slnk_1ms_inst " " RAT_FUNC "%.3" "ms" COEFFS 0 312.5 0 0 0 1 /end COMPU_METHOD
/begin MEASUREMENT enov_slnk_1ms_max "Task 1ms - Max (ms)" UWORD Compu_enov_slnk_1ms_max 0 0 0 209.712 ECU_ADDRESS 0x0100FEC0 /end MEASUREMENT
/begin COMPU_METHOD Compu_enov_slnk_1ms_max " " RAT_FUNC "%.3" "ms" COEFFS 0 312.5 0 0 0 1 /end COMPU_METHOD
/begin MEASUREMENT enov_slnk_5ms_live "Task 5ms - Live{enov_slnk_5ms_live&0xff=0:NO}{enov_slnk_5ms_live&0xff=1:YES}" UBYTE enov_slnk_5ms_live_COMPU_VTAB 0 0 0 255 ECU_ADDRESS 0x0100FED0 BIT_MASK 0xff /end MEASUREMENT
/begin COMPU_METHOD enov_slnk_5ms_live_COMPU_VTAB "Verbal Table" TAB_VERB "%.0" "list" COMPU_TAB_REF enov_slnk_5ms_live_COMPU_VTAB_REF /end COMPU_METHOD
/begin COMPU_VTAB enov_slnk_5ms_live_COMPU_VTAB_REF "Verbal Table" TAB_VERB 2 0 "NO" 1 "YES" DEFAULT_VALUE "UNKNOWN" /end COMPU_VTAB
/begin MEASUREMENT enov_slnk_5ms_oruns "Task 5ms - Overruns" UBYTE Compu_enov_slnk_5ms_oruns 0 0 0 255 ECU_ADDRESS 0x0100FED8 /end MEASUREMENT
/begin COMPU_METHOD Compu_enov_slnk_5ms_oruns " " RAT_FUNC "%.0" "-" COEFFS 0 1 0 0 0 1 /end COMPU_METHOD
/begin MEASUREMENT enov_slnk_5ms_inst "Task 5ms - Inst (ms)" UWORD Compu_enov_slnk_5ms_inst 0 0 0 209.712 ECU_ADDRESS 0x0100FEE0 /end MEASUREMENT
/begin COMPU_METHOD Compu_enov_slnk_5ms_inst " " RAT_FUNC "%.3" "ms" COEFFS 0 312.5 0 0 0 1 /end COMPU_METHOD
/begin MEASUREMENT enov_slnk_5ms_max "Task 5ms - Max (ms)" UWORD Compu_enov_slnk_5ms_max 0 0 0 209.712 ECU_ADDRESS 0x0100FEE8 /end MEASUREMENT
/begin COMPU_METHOD Compu_enov_slnk_5ms_max " " RAT_FUNC "%.3" "ms" COEFFS 0 312.5 0 0 0 1 /end COMPU_METHOD
/begin MEASUREMENT enov_slnk_50ms_live "Task 50ms - Live{enov_slnk_50ms_live&0xff=0:NO}{enov_slnk_50ms_live&0xff=1:YES}" UBYTE enov_slnk_50ms_live_COMPU_VTAB 0 0 0 255 ECU_ADDRESS 0x0100FEF8 BIT_MASK 0xff /end MEASUREMENT
/begin COMPU_METHOD enov_slnk_50ms_live_COMPU_VTAB "Verbal Table" TAB_VERB "%.0" "list" COMPU_TAB_REF enov_slnk_50ms_live_COMPU_VTAB_REF /end COMPU_METHOD
/begin COMPU_VTAB enov_slnk_50ms_live_COMPU_VTAB_REF "Verbal Table" TAB_VERB 2 0 "NO" 1 "YES" DEFAULT_VALUE "UNKNOWN" /end COMPU_VTAB
/begin MEASUREMENT enov_slnk_50ms_oruns "Task 50ms - Overruns" UBYTE Compu_enov_slnk_50ms_oruns 0 0 0 255 ECU_ADDRESS 0x0100FF00 /end MEASUREMENT
/begin COMPU_METHOD Compu_enov_slnk_50ms_oruns " " RAT_FUNC "%.0" "-" COEFFS 0 1 0 0 0 1 /end COMPU_METHOD
/begin MEASUREMENT enov_slnk_50ms_inst "Task 50ms - Inst (ms)" UWORD Compu_enov_slnk_50ms_inst 0 0 0 209.712 ECU_ADDRESS 0x0100FF08 /end MEASUREMENT
/begin COMPU_METHOD Compu_enov_slnk_50ms_inst " " RAT_FUNC "%.3" "ms" COEFFS 0 312.5 0 0 0 1 /end COMPU_METHOD
/begin MEASUREMENT enov_slnk_50ms_max "Task 50ms - Max (ms)" UWORD Compu_enov_slnk_50ms_max 0 0 0 209.712 ECU_ADDRESS 0x0100FF10 /end MEASUREMENT
/begin COMPU_METHOD Compu_enov_slnk_50ms_max " " RAT_FUNC "%.3" "ms" COEFFS 0 312.5 0 0 0 1 /end COMPU_METHOD
/begin MEASUREMENT enov_slnk_fsh_bytes "Flash consumption - Bytes" ULONG Compu_enov_slnk_fsh_bytes 0 0 0 4294967295 ECU_ADDRESS 0x0100FF18 /end MEASUREMENT
/begin COMPU_METHOD Compu_enov_slnk_fsh_bytes " " RAT_FUNC "%.0" "bytes" COEFFS 0 1 0 0 0 1 /end COMPU_METHOD
/begin MEASUREMENT enov_slnk_fsh_pct "Flash consumption - % Alloc" UWORD Compu_enov_slnk_fsh_pct 0 0 0 399.993896484375 ECU_ADDRESS 0x0100FF20 /end MEASUREMENT
/begin COMPU_METHOD Compu_enov_slnk_fsh_pct " " RAT_FUNC "%.1" "%" COEFFS 0 163.84 0 0 0 1 /end COMPU_METHOD
/begin MEASUREMENT enov_slnk_RAM_bytes "RAM consumption - Bytes" ULONG Compu_enov_slnk_RAM_bytes 0 0 0 4294967295 ECU_ADDRESS 0x0100FF28 /end MEASUREMENT
/begin COMPU_METHOD Compu_enov_slnk_RAM_bytes " " RAT_FUNC "%.0" "bytes" COEFFS 0 1 0 0 0 1 /end COMPU_METHOD
/begin MEASUREMENT enov_slnk_RAM_pct "RAM consumption - % Alloc" UWORD Compu_enov_slnk_RAM_pct 0 0 0 399.993896484375 ECU_ADDRESS 0x0100FF30 /end MEASUREMENT
/begin COMPU_METHOD Compu_enov_slnk_RAM_pct " " RAT_FUNC "%.1" "%" COEFFS 0 163.84 0 0 0 1 /end COMPU_METHOD
/begin MEASUREMENT enov_slnk_1ms_allwd "Task 1ms - Allowed (ms)" UWORD Compu_enov_slnk_1ms_allwd 0 0 0 209.712 ECU_ADDRESS 0x01010270 /end MEASUREMENT
/begin COMPU_METHOD Compu_enov_slnk_1ms_allwd " " RAT_FUNC "%.3" "-" COEFFS 0 312.5 0 0 0 1 /end COMPU_METHOD
/begin MEASUREMENT enov_slnk_5ms_allwd "Task 5ms - Allowed (ms)" UWORD Compu_enov_slnk_5ms_allwd 0 0 0 209.712 ECU_ADDRESS 0x01010278 /end MEASUREMENT
/begin COMPU_METHOD Compu_enov_slnk_5ms_allwd " " RAT_FUNC "%.3" "-" COEFFS 0 312.5 0 0 0 1 /end COMPU_METHOD
/begin MEASUREMENT enov_slnk_50ms_allwd "Task 50ms - Allowed (ms)" UWORD Compu_enov_slnk_50ms_allwd 0 0 0 209.712 ECU_ADDRESS 0x01010280 /end MEASUREMENT
/begin COMPU_METHOD Compu_enov_slnk_50ms_allwd " " RAT_FUNC "%.3" "-" COEFFS 0 312.5 0 0 0 1 /end COMPU_METHOD
/begin MEASUREMENT enov_slnk_1ms_pct "Task 1ms - Max (%)" UWORD Compu_enov_slnk_1ms_pct 0 0 0 399.993896484375 ECU_ADDRESS 0x01010288 /end MEASUREMENT
/begin COMPU_METHOD Compu_enov_slnk_1ms_pct " " RAT_FUNC "%.1" "-" COEFFS 0 163.84 0 0 0 1 /end COMPU_METHOD
/begin MEASUREMENT enov_slnk_5ms_pct "Task 5ms - Max (%)" UWORD Compu_enov_slnk_5ms_pct 0 0 0 399.993896484375 ECU_ADDRESS 0x01010290 /end MEASUREMENT
/begin COMPU_METHOD Compu_enov_slnk_5ms_pct " " RAT_FUNC "%.1" "-" COEFFS 0 163.84 0 0 0 1 /end COMPU_METHOD
/begin MEASUREMENT enov_slnk_50ms_pct "Task 50ms - Max (%)" UWORD Compu_enov_slnk_50ms_pct 0 0 0 399.993896484375 ECU_ADDRESS 0x01010298 /end MEASUREMENT
/begin COMPU_METHOD Compu_enov_slnk_50ms_pct " " RAT_FUNC "%.1" "-" COEFFS 0 163.84 0 0 0 1 /end COMPU_METHOD
/begin MEASUREMENT enov_slnk_revision "Simulink interface revision" UWORD Compu_enov_slnk_revision 0 0 0 65535 ECU_ADDRESS 0x01010310 /end MEASUREMENT
/begin COMPU_METHOD Compu_enov_slnk_revision " " RAT_FUNC "%.0" "-" COEFFS 0 1 0 0 0 1 /end COMPU_METHOD
/begin CHARACTERISTIC slnk_nvm_reprog_clr "Clear NVM after reprogramming{slnk_nvm_reprog_clr&0xff=0:Disabled}{slnk_nvm_reprog_clr&0xff=1:Enabled}" VALUE 0x001eccab /* @ECU_Address@slnk_nvm_reprog_clr@0x01010370@ */ ECIPP_ALIGNMENT_UBYTE 255 slnk_nvm_reprog_clr_COMPU_VTAB 0 255 BIT_MASK 0xff /end CHARACTERISTIC
/begin COMPU_METHOD slnk_nvm_reprog_clr_COMPU_VTAB "Verbal Table" TAB_VERB "%.0" "list" COMPU_TAB_REF slnk_nvm_reprog_clr_COMPU_VTAB_REF /end COMPU_METHOD
/begin COMPU_VTAB slnk_nvm_reprog_clr_COMPU_VTAB_REF "Verbal Table" TAB_VERB 2 0 "Disabled" 1 "Enabled" DEFAULT_VALUE "UNKNOWN" /end COMPU_VTAB
/begin CHARACTERISTIC slnk_nvm_wr_period "Persist NVM changes every" VALUE 0x001e2f08 /* @ECU_Address@slnk_nvm_wr_period@0x01010378@ */ ECIPP_ALIGNMENT_ULONG 4294967295 Compu_slnk_nvm_wr_period 0 4294967295 /end CHARACTERISTIC
/begin COMPU_METHOD Compu_slnk_nvm_wr_period " " RAT_FUNC "%.0" "ms" COEFFS 0 1 0 0 0 1 /end COMPU_METHOD
/begin CHARACTERISTIC RangeHst_mode1 "Range history mode 1{RangeHst_mode1&0xff=0:Disabled}{RangeHst_mode1&0xff=1:Event Counter}{RangeHst_mode1&0xff=2:Event Timer}" VALUE 0x001C88E9 /* @ECU_Address@RangeHst_mode1@0x01010A08@ */ ECIPP_ALIGNMENT_UBYTE 255 RangeHst_mode1_COMPU_VTAB 0 255 BIT_MASK 0xff /end CHARACTERISTIC
/begin COMPU_METHOD RangeHst_mode1_COMPU_VTAB "Verbal Table" TAB_VERB "%.0" "list" COMPU_TAB_REF RangeHst_mode1_COMPU_VTAB_REF /end COMPU_METHOD
/begin COMPU_VTAB RangeHst_mode1_COMPU_VTAB_REF "Verbal Table" TAB_VERB 3 0 "Disabled" 1 "Event Counter" 2 "Event Timer" DEFAULT_VALUE "UNKNOWN" /end COMPU_VTAB
/begin CHARACTERISTIC RangeHst_mode2 "Range history mode 2{RangeHst_mode2&0xff=0:Disabled}{RangeHst_mode2&0xff=1:Event Counter}{RangeHst_mode2&0xff=2:Event Timer}" VALUE 0x001C88EA /* @ECU_Address@RangeHst_mode2@0x01010A10@ */ ECIPP_ALIGNMENT_UBYTE 255 RangeHst_mode2_COMPU_VTAB 0 255 BIT_MASK 0xff /end CHARACTERISTIC
/begin COMPU_METHOD RangeHst_mode2_COMPU_VTAB "Verbal Table" TAB_VERB "%.0" "list" COMPU_TAB_REF RangeHst_mode2_COMPU_VTAB_REF /end COMPU_METHOD
/begin COMPU_VTAB RangeHst_mode2_COMPU_VTAB_REF "Verbal Table" TAB_VERB 3 0 "Disabled" 1 "Event Counter" 2 "Event Timer" DEFAULT_VALUE "UNKNOWN" /end COMPU_VTAB
/begin CHARACTERISTIC RangeHst_mode3 "Range history mode 3{RangeHst_mode3&0xff=0:Disabled}{RangeHst_mode3&0xff=1:Event Counter}{RangeHst_mode3&0xff=2:Event Timer}" VALUE 0x001C88EB /* @ECU_Address@RangeHst_mode3@0x01010A18@ */ ECIPP_ALIGNMENT_UBYTE 255 RangeHst_mode3_COMPU_VTAB 0 255 BIT_MASK 0xff /end CHARACTERISTIC
/begin COMPU_METHOD RangeHst_mode3_COMPU_VTAB "Verbal Table" TAB_VERB "%.0" "list" COMPU_TAB_REF RangeHst_mode3_COMPU_VTAB_REF /end COMPU_METHOD
/begin COMPU_VTAB RangeHst_mode3_COMPU_VTAB_REF "Verbal Table" TAB_VERB 3 0 "Disabled" 1 "Event Counter" 2 "Event Timer" DEFAULT_VALUE "UNKNOWN" /end COMPU_VTAB
/begin CHARACTERISTIC RangeHst_mode4 "Range history mode 4{RangeHst_mode4&0xff=0:Disabled}{RangeHst_mode4&0xff=1:Event Counter}{RangeHst_mode4&0xff=2:Event Timer}" VALUE 0x001C88EC /* @ECU_Address@RangeHst_mode4@0x01010A20@ */ ECIPP_ALIGNMENT_UBYTE 255 RangeHst_mode4_COMPU_VTAB 0 255 BIT_MASK 0xff /end CHARACTERISTIC
/begin COMPU_METHOD RangeHst_mode4_COMPU_VTAB "Verbal Table" TAB_VERB "%.0" "list" COMPU_TAB_REF RangeHst_mode4_COMPU_VTAB_REF /end COMPU_METHOD
/begin COMPU_VTAB RangeHst_mode4_COMPU_VTAB_REF "Verbal Table" TAB_VERB 3 0 "Disabled" 1 "Event Counter" 2 "Event Timer" DEFAULT_VALUE "UNKNOWN" /end COMPU_VTAB
/begin CHARACTERISTIC RangeHst_mode5 "Range history mode 5{RangeHst_mode5&0xff=0:Disabled}{RangeHst_mode5&0xff=1:Event Counter}{RangeHst_mode5&0xff=2:Event Timer}" VALUE 0x001C88ED /* @ECU_Address@RangeHst_mode5@0x01010A28@ */ ECIPP_ALIGNMENT_UBYTE 255 RangeHst_mode5_COMPU_VTAB 0 255 BIT_MASK 0xff /end CHARACTERISTIC
/begin COMPU_METHOD RangeHst_mode5_COMPU_VTAB "Verbal Table" TAB_VERB "%.0" "list" COMPU_TAB_REF RangeHst_mode5_COMPU_VTAB_REF /end COMPU_METHOD
/begin COMPU_VTAB RangeHst_mode5_COMPU_VTAB_REF "Verbal Table" TAB_VERB 3 0 "Disabled" 1 "Event Counter" 2 "Event Timer" DEFAULT_VALUE "UNKNOWN" /end COMPU_VTAB
/begin CHARACTERISTIC RangeHst_mode6 "Range history mode 6{RangeHst_mode6&0xff=0:Disabled}{RangeHst_mode6&0xff=1:Event Counter}{RangeHst_mode6&0xff=2:Event Timer}" VALUE 0x001C88EE /* @ECU_Address@RangeHst_mode6@0x01010A30@ */ ECIPP_ALIGNMENT_UBYTE 255 RangeHst_mode6_COMPU_VTAB 0 255 BIT_MASK 0xff /end CHARACTERISTIC
/begin COMPU_METHOD RangeHst_mode6_COMPU_VTAB "Verbal Table" TAB_VERB "%.0" "list" COMPU_TAB_REF RangeHst_mode6_COMPU_VTAB_REF /end COMPU_METHOD
/begin COMPU_VTAB RangeHst_mode6_COMPU_VTAB_REF "Verbal Table" TAB_VERB 3 0 "Disabled" 1 "Event Counter" 2 "Event Timer" DEFAULT_VALUE "UNKNOWN" /end COMPU_VTAB
/begin CHARACTERISTIC RangeHst_mode7 "Range history mode 7{RangeHst_mode7&0xff=0:Disabled}{RangeHst_mode7&0xff=1:Event Counter}{RangeHst_mode7&0xff=2:Event Timer}" VALUE 0x001C88EF /* @ECU_Address@RangeHst_mode7@0x01010A38@ */ ECIPP_ALIGNMENT_UBYTE 255 RangeHst_mode7_COMPU_VTAB 0 255 BIT_MASK 0xff /end CHARACTERISTIC
/begin COMPU_METHOD RangeHst_mode7_COMPU_VTAB "Verbal Table" TAB_VERB "%.0" "list" COMPU_TAB_REF RangeHst_mode7_COMPU_VTAB_REF /end COMPU_METHOD
/begin COMPU_VTAB RangeHst_mode7_COMPU_VTAB_REF "Verbal Table" TAB_VERB 3 0 "Disabled" 1 "Event Counter" 2 "Event Timer" DEFAULT_VALUE "UNKNOWN" /end COMPU_VTAB
/begin CHARACTERISTIC RangeHst_mode8 "Range history mode 8{RangeHst_mode8&0xff=0:Disabled}{RangeHst_mode8&0xff=1:Event Counter}{RangeHst_mode8&0xff=2:Event Timer}" VALUE 0x001C88F0 /* @ECU_Address@RangeHst_mode8@0x01010A40@ */ ECIPP_ALIGNMENT_UBYTE 255 RangeHst_mode8_COMPU_VTAB 0 255 BIT_MASK 0xff /end CHARACTERISTIC
/begin COMPU_METHOD RangeHst_mode8_COMPU_VTAB "Verbal Table" TAB_VERB "%.0" "list" COMPU_TAB_REF RangeHst_mode8_COMPU_VTAB_REF /end COMPU_METHOD
/begin COMPU_VTAB RangeHst_mode8_COMPU_VTAB_REF "Verbal Table" TAB_VERB 3 0 "Disabled" 1 "Event Counter" 2 "Event Timer" DEFAULT_VALUE "UNKNOWN" /end COMPU_VTAB
/begin CHARACTERISTIC RangeHst_mode9 "Range history mode 9{RangeHst_mode9&0xff=0:Disabled}{RangeHst_mode9&0xff=1:Event Counter}{RangeHst_mode9&0xff=2:Event Timer}" VALUE 0x001C88F1 /* @ECU_Address@RangeHst_mode9@0x01010A48@ */ ECIPP_ALIGNMENT_UBYTE 255 RangeHst_mode9_COMPU_VTAB 0 255 BIT_MASK 0xff /end CHARACTERISTIC
/begin COMPU_METHOD RangeHst_mode9_COMPU_VTAB "Verbal Table" TAB_VERB "%.0" "list" COMPU_TAB_REF RangeHst_mode9_COMPU_VTAB_REF /end COMPU_METHOD
/begin COMPU_VTAB RangeHst_mode9_COMPU_VTAB_REF "Verbal Table" TAB_VERB 3 0 "Disabled" 1 "Event Counter" 2 "Event Timer" DEFAULT_VALUE "UNKNOWN" /end COMPU_VTAB
/begin CHARACTERISTIC RangeHst_mode10 "Range history mode 10{RangeHst_mode10&0xff=0:Disabled}{RangeHst_mode10&0xff=1:Event Counter}{RangeHst_mode10&0xff=2:Event Timer}" VALUE 0x001C88F2 /* @ECU_Address@RangeHst_mode10@0x01010A50@ */ ECIPP_ALIGNMENT_UBYTE 255 RangeHst_mode10_COMPU_VTAB 0 255 BIT_MASK 0xff /end CHARACTERISTIC
/begin COMPU_METHOD RangeHst_mode10_COMPU_VTAB "Verbal Table" TAB_VERB "%.0" "list" COMPU_TAB_REF RangeHst_mode10_COMPU_VTAB_REF /end COMPU_METHOD
/begin COMPU_VTAB RangeHst_mode10_COMPU_VTAB_REF "Verbal Table" TAB_VERB 3 0 "Disabled" 1 "Event Counter" 2 "Event Timer" DEFAULT_VALUE "UNKNOWN" /end COMPU_VTAB
/begin CHARACTERISTIC RangeHst_mode11 "Range history mode 11{RangeHst_mode11&0xff=0:Disabled}{RangeHst_mode11&0xff=1:Event Counter}{RangeHst_mode11&0xff=2:Event Timer}" VALUE 0x001C88F3 /* @ECU_Address@RangeHst_mode11@0x01010A58@ */ ECIPP_ALIGNMENT_UBYTE 255 RangeHst_mode11_COMPU_VTAB 0 255 BIT_MASK 0xff /end CHARACTERISTIC
/begin COMPU_METHOD RangeHst_mode11_COMPU_VTAB "Verbal Table" TAB_VERB "%.0" "list" COMPU_TAB_REF RangeHst_mode11_COMPU_VTAB_REF /end COMPU_METHOD
/begin COMPU_VTAB RangeHst_mode11_COMPU_VTAB_REF "Verbal Table" TAB_VERB 3 0 "Disabled" 1 "Event Counter" 2 "Event Timer" DEFAULT_VALUE "UNKNOWN" /end COMPU_VTAB
/begin CHARACTERISTIC RangeHst_mode12 "Range history mode 12{RangeHst_mode12&0xff=0:Disabled}{RangeHst_mode12&0xff=1:Event Counter}{RangeHst_mode12&0xff=2:Event Timer}" VALUE 0x001C88F4 /* @ECU_Address@RangeHst_mode12@0x01010A60@ */ ECIPP_ALIGNMENT_UBYTE 255 RangeHst_mode12_COMPU_VTAB 0 255 BIT_MASK 0xff /end CHARACTERISTIC
/begin COMPU_METHOD RangeHst_mode12_COMPU_VTAB "Verbal Table" TAB_VERB "%.0" "list" COMPU_TAB_REF RangeHst_mode12_COMPU_VTAB_REF /end COMPU_METHOD
/begin COMPU_VTAB RangeHst_mode12_COMPU_VTAB_REF "Verbal Table" TAB_VERB 3 0 "Disabled" 1 "Event Counter" 2 "Event Timer" DEFAULT_VALUE "UNKNOWN" /end COMPU_VTAB
/begin CHARACTERISTIC RangeHst_mode13 "Range history mode 13{RangeHst_mode13&0xff=0:Disabled}{RangeHst_mode13&0xff=1:Event Counter}{RangeHst_mode13&0xff=2:Event Timer}" VALUE 0x001C88F5 /* @ECU_Address@RangeHst_mode13@0x01010A68@ */ ECIPP_ALIGNMENT_UBYTE 255 RangeHst_mode13_COMPU_VTAB 0 255 BIT_MASK 0xff /end CHARACTERISTIC
/begin COMPU_METHOD RangeHst_mode13_COMPU_VTAB "Verbal Table" TAB_VERB "%.0" "list" COMPU_TAB_REF RangeHst_mode13_COMPU_VTAB_REF /end COMPU_METHOD
/begin COMPU_VTAB RangeHst_mode13_COMPU_VTAB_REF "Verbal Table" TAB_VERB 3 0 "Disabled" 1 "Event Counter" 2 "Event Timer" DEFAULT_VALUE "UNKNOWN" /end COMPU_VTAB
/begin CHARACTERISTIC RangeHst_mode14 "Range history mode 14{RangeHst_mode14&0xff=0:Disabled}{RangeHst_mode14&0xff=1:Event Counter}{RangeHst_mode14&0xff=2:Event Timer}" VALUE 0x001C88F6 /* @ECU_Address@RangeHst_mode14@0x01010A70@ */ ECIPP_ALIGNMENT_UBYTE 255 RangeHst_mode14_COMPU_VTAB 0 255 BIT_MASK 0xff /end CHARACTERISTIC
/begin COMPU_METHOD RangeHst_mode14_COMPU_VTAB "Verbal Table" TAB_VERB "%.0" "list" COMPU_TAB_REF RangeHst_mode14_COMPU_VTAB_REF /end COMPU_METHOD
/begin COMPU_VTAB RangeHst_mode14_COMPU_VTAB_REF "Verbal Table" TAB_VERB 3 0 "Disabled" 1 "Event Counter" 2 "Event Timer" DEFAULT_VALUE "UNKNOWN" /end COMPU_VTAB
/begin CHARACTERISTIC RangeHst_mode15 "Range history mode 15{RangeHst_mode15&0xff=0:Disabled}{RangeHst_mode15&0xff=1:Event Counter}{RangeHst_mode15&0xff=2:Event Timer}" VALUE 0x001C88F7 /* @ECU_Address@RangeHst_mode15@0x01010A78@ */ ECIPP_ALIGNMENT_UBYTE 255 RangeHst_mode15_COMPU_VTAB 0 255 BIT_MASK 0xff /end CHARACTERISTIC
/begin COMPU_METHOD RangeHst_mode15_COMPU_VTAB "Verbal Table" TAB_VERB "%.0" "list" COMPU_TAB_REF RangeHst_mode15_COMPU_VTAB_REF /end COMPU_METHOD
/begin COMPU_VTAB RangeHst_mode15_COMPU_VTAB_REF "Verbal Table" TAB_VERB 3 0 "Disabled" 1 "Event Counter" 2 "Event Timer" DEFAULT_VALUE "UNKNOWN" /end COMPU_VTAB
/begin CHARACTERISTIC RangeHst_mode16 "Range history mode 16{RangeHst_mode16&0xff=0:Disabled}{RangeHst_mode16&0xff=1:Event Counter}{RangeHst_mode16&0xff=2:Event Timer}" VALUE 0x001C88F8 /* @ECU_Address@RangeHst_mode16@0x01010A80@ */ ECIPP_ALIGNMENT_UBYTE 255 RangeHst_mode16_COMPU_VTAB 0 255 BIT_MASK 0xff /end CHARACTERISTIC
/begin COMPU_METHOD RangeHst_mode16_COMPU_VTAB "Verbal Table" TAB_VERB "%.0" "list" COMPU_TAB_REF RangeHst_mode16_COMPU_VTAB_REF /end COMPU_METHOD
/begin COMPU_VTAB RangeHst_mode16_COMPU_VTAB_REF "Verbal Table" TAB_VERB 3 0 "Disabled" 1 "Event Counter" 2 "Event Timer" DEFAULT_VALUE "UNKNOWN" /end COMPU_VTAB
/begin CHARACTERISTIC RangeHst_mode17 "Range history mode 17{RangeHst_mode17&0xff=0:Disabled}{RangeHst_mode17&0xff=1:Event Counter}{RangeHst_mode17&0xff=2:Event Timer}" VALUE 0x001C88F9 /* @ECU_Address@RangeHst_mode17@0x01010A88@ */ ECIPP_ALIGNMENT_UBYTE 255 RangeHst_mode17_COMPU_VTAB 0 255 BIT_MASK 0xff /end CHARACTERISTIC
/begin COMPU_METHOD RangeHst_mode17_COMPU_VTAB "Verbal Table" TAB_VERB "%.0" "list" COMPU_TAB_REF RangeHst_mode17_COMPU_VTAB_REF /end COMPU_METHOD
/begin COMPU_VTAB RangeHst_mode17_COMPU_VTAB_REF "Verbal Table" TAB_VERB 3 0 "Disabled" 1 "Event Counter" 2 "Event Timer" DEFAULT_VALUE "UNKNOWN" /end COMPU_VTAB
/begin CHARACTERISTIC RangeHst_mode18 "Range history mode 18{RangeHst_mode18&0xff=0:Disabled}{RangeHst_mode18&0xff=1:Event Counter}{RangeHst_mode18&0xff=2:Event Timer}" VALUE 0x001C88FA /* @ECU_Address@RangeHst_mode18@0x01010A90@ */ ECIPP_ALIGNMENT_UBYTE 255 RangeHst_mode18_COMPU_VTAB 0 255 BIT_MASK 0xff /end CHARACTERISTIC
/begin COMPU_METHOD RangeHst_mode18_COMPU_VTAB "Verbal Table" TAB_VERB "%.0" "list" COMPU_TAB_REF RangeHst_mode18_COMPU_VTAB_REF /end COMPU_METHOD
/begin COMPU_VTAB RangeHst_mode18_COMPU_VTAB_REF "Verbal Table" TAB_VERB 3 0 "Disabled" 1 "Event Counter" 2 "Event Timer" DEFAULT_VALUE "UNKNOWN" /end COMPU_VTAB
/begin CHARACTERISTIC RangeHst_mode19 "Range history mode 19{RangeHst_mode19&0xff=0:Disabled}{RangeHst_mode19&0xff=1:Event Counter}{RangeHst_mode19&0xff=2:Event Timer}" VALUE 0x001C88FB /* @ECU_Address@RangeHst_mode19@0x01010A98@ */ ECIPP_ALIGNMENT_UBYTE 255 RangeHst_mode19_COMPU_VTAB 0 255 BIT_MASK 0xff /end CHARACTERISTIC
/begin COMPU_METHOD RangeHst_mode19_COMPU_VTAB "Verbal Table" TAB_VERB "%.0" "list" COMPU_TAB_REF RangeHst_mode19_COMPU_VTAB_REF /end COMPU_METHOD
/begin COMPU_VTAB RangeHst_mode19_COMPU_VTAB_REF "Verbal Table" TAB_VERB 3 0 "Disabled" 1 "Event Counter" 2 "Event Timer" DEFAULT_VALUE "UNKNOWN" /end COMPU_VTAB
/begin CHARACTERISTIC RangeHst_mode20 "Range history mode 20{RangeHst_mode20&0xff=0:Disabled}{RangeHst_mode20&0xff=1:Event Counter}{RangeHst_mode20&0xff=2:Event Timer}" VALUE 0x001C88FC /* @ECU_Address@RangeHst_mode20@0x01010AA0@ */ ECIPP_ALIGNMENT_UBYTE 255 RangeHst_mode20_COMPU_VTAB 0 255 BIT_MASK 0xff /end CHARACTERISTIC
/begin COMPU_METHOD RangeHst_mode20_COMPU_VTAB "Verbal Table" TAB_VERB "%.0" "list" COMPU_TAB_REF RangeHst_mode20_COMPU_VTAB_REF /end COMPU_METHOD
/begin COMPU_VTAB RangeHst_mode20_COMPU_VTAB_REF "Verbal Table" TAB_VERB 3 0 "Disabled" 1 "Event Counter" 2 "Event Timer" DEFAULT_VALUE "UNKNOWN" /end COMPU_VTAB
/begin CHARACTERISTIC FSO_ret_mode "FSO spark retard mode{FSO_ret_mode&0xff=0:Single Point}{FSO_ret_mode&0xff=1:Table Based}" VALUE 0x001c873b /* @ECU_Address@FSO_ret_mode@0x01010AD0@ */ ECIPP_ALIGNMENT_UBYTE 255 FSO_ret_mode_COMPU_VTAB 0 255 BIT_MASK 0xff /end CHARACTERISTIC
/begin COMPU_METHOD FSO_ret_mode_COMPU_VTAB "Verbal Table" TAB_VERB "%.0" "list" COMPU_TAB_REF FSO_ret_mode_COMPU_VTAB_REF /end COMPU_METHOD
/begin COMPU_VTAB FSO_ret_mode_COMPU_VTAB_REF "Verbal Table" TAB_VERB 2 0 "Single Point" 1 "Table Based" DEFAULT_VALUE "UNKNOWN" /end COMPU_VTAB
/begin CHARACTERISTIC spkret_decay_time "Spark retard decay time" VALUE 0x001c84e6 /* @ECU_Address@spkret_decay_time@0x01010AD8@ */ ECIPP_ALIGNMENT_UWORD 66 Compu_spkret_decay_time 0 65.535 /end CHARACTERISTIC
/begin COMPU_METHOD Compu_spkret_decay_time " " RAT_FUNC "%.1" "seconds" COEFFS 0 1000 0 0 0 1 /end COMPU_METHOD
/begin CHARACTERISTIC strt_spkret_ena "Engine start spark retard{strt_spkret_ena&0xff=0:Disabled}{strt_spkret_ena&0xff=1:Enabled - ECT only}{strt_spkret_ena&0xff=2:Enabled - ECT and EGT}" VALUE 0x001c9082 /* @ECU_Address@strt_spkret_ena@0x01010AE0@ */ ECIPP_ALIGNMENT_UBYTE 255 strt_spkret_ena_COMPU_VTAB 0 255 BIT_MASK 0xff /end CHARACTERISTIC
/begin COMPU_METHOD strt_spkret_ena_COMPU_VTAB "Verbal Table" TAB_VERB "%.0" "list" COMPU_TAB_REF strt_spkret_ena_COMPU_VTAB_REF /end COMPU_METHOD
/begin COMPU_VTAB strt_spkret_ena_COMPU_VTAB_REF "Verbal Table" TAB_VERB 3 0 "Disabled" 1 "Enabled - ECT only" 2 "Enabled - ECT and EGT" DEFAULT_VALUE "UNKNOWN" /end COMPU_VTAB
/begin MEASUREMENT spkret_hold_tmr "Eng start/FSO retard hold time" FLOAT32_IEEE Compu_spkret_hold_tmr 0 0 -10000000000 10000000000 ECU_ADDRESS 0x01010AE8 /end MEASUREMENT
/begin COMPU_METHOD Compu_spkret_hold_tmr " " RAT_FUNC "%.1" "seconds" COEFFS 0 1000 0 0 0 1 /end COMPU_METHOD
/begin CHARACTERISTIC spkret_EGT "EGT retard decay threshold" VALUE 0x001c84e4 /* @ECU_Address@spkret_EGT@0x01011B58@ */ ECIPP_ALIGNMENT_UWORD 7732 Compu_spkret_EGT -460 7731.875 /end CHARACTERISTIC
/begin COMPU_METHOD Compu_spkret_EGT " " RAT_FUNC "%.0" "deg F" COEFFS 0 8 3680 0 0 1 /end COMPU_METHOD
/begin CHARACTERISTIC spkret_hold_mult "Invalid EGT hold multiplier" VALUE 0x001c84e8 /* @ECU_Address@spkret_hold_mult@0x01011B60@ */ ECIPP_ALIGNMENT_UWORD 1 Compu_spkret_hold_mult 0 0.999984741210938 /end CHARACTERISTIC
/begin COMPU_METHOD Compu_spkret_hold_mult " " RAT_FUNC "%.2" "-" COEFFS 0 65536 0 0 0 1 /end COMPU_METHOD
/begin CHARACTERISTIC RangeHst_cntr_upd "Event counter sample time{RangeHst_cntr_upd&0xff=0:50 ms}{RangeHst_cntr_upd&0xff=1:100 ms}{RangeHst_cntr_upd&0xff=2:250 ms}{RangeHst_cntr_upd&0xff=3:500 ms}{RangeHst_cntr_upd&0xff=4:1000 ms}{RangeHst_cntr_upd&0xff=5:5000 ms}" VALUE 0x001c88e8 /* @ECU_Address@RangeHst_cntr_upd@0x01012028@ */ ECIPP_ALIGNMENT_UBYTE 255 RangeHst_cntr_upd_COMPU_VTAB 0 255 BIT_MASK 0xff /end CHARACTERISTIC
/begin COMPU_METHOD RangeHst_cntr_upd_COMPU_VTAB "Verbal Table" TAB_VERB "%.0" "list" COMPU_TAB_REF RangeHst_cntr_upd_COMPU_VTAB_REF /end COMPU_METHOD
/begin COMPU_VTAB RangeHst_cntr_upd_COMPU_VTAB_REF "Verbal Table" TAB_VERB 6 0 "50 ms" 1 "100 ms" 2 "250 ms" 3 "500 ms" 4 "1000 ms" 5 "5000 ms" DEFAULT_VALUE "UNKNOWN" /end COMPU_VTAB
/begin CHARACTERISTIC reset_learn_reprog "Auto-learn after reprogramming{reset_learn_reprog&0xff=0:Disabled}{reset_learn_reprog&0xff=1:Enabled}" VALUE 0x001c9076 /* @ECU_Address@reset_learn_reprog@0x01012928@ */ ECIPP_ALIGNMENT_UBYTE 255 reset_learn_reprog_COMPU_VTAB 0 255 BIT_MASK 0xff /end CHARACTERISTIC
/begin COMPU_METHOD reset_learn_reprog_COMPU_VTAB "Verbal Table" TAB_VERB "%.0" "list" COMPU_TAB_REF reset_learn_reprog_COMPU_VTAB_REF /end COMPU_METHOD
/begin COMPU_VTAB reset_learn_reprog_COMPU_VTAB_REF "Verbal Table" TAB_VERB 2 0 "Disabled" 1 "Enabled" DEFAULT_VALUE "UNKNOWN" /end COMPU_VTAB
/begin MEASUREMENT reset_learn_active "Learn active timer" UWORD Compu_reset_learn_active 0 0 0 65.535 ECU_ADDRESS 0x01012938 /end MEASUREMENT
/begin COMPU_METHOD Compu_reset_learn_active " " RAT_FUNC "%.1" "sec" COEFFS 0 1000 0 0 0 1 /end COMPU_METHOD
/begin MEASUREMENT reset_learn_action "Manual learn action{reset_learn_action&0xff=0x00:None}{reset_learn_action&0xff=0x01:Learn TPS idle/full}{reset_learn_action&0xff=0x02:Learn EGR zero}{reset_learn_action&0xff=0x04:Learn pressure offsets}{reset_learn_action&0xff=0x07:Learn all}" UBYTE reset_learn_action_COMPU_VTAB 0 0 0 255 ECU_ADDRESS 0x01012940 BIT_MASK 0xff /end MEASUREMENT
/begin COMPU_METHOD reset_learn_action_COMPU_VTAB "Verbal Table" TAB_VERB "%.0" "list" COMPU_TAB_REF reset_learn_action_COMPU_VTAB_REF /end COMPU_METHOD
/begin COMPU_VTAB reset_learn_action_COMPU_VTAB_REF "Verbal Table" TAB_VERB 5 0x00 "None" 0x01 "Learn TPS idle/full" 0x02 "Learn EGR zero" 0x04 "Learn pressure offsets" 0x07 "Learn all" DEFAULT_VALUE "UNKNOWN" /end COMPU_VTAB
/begin MEASUREMENT reset_learn_state "Learn state{reset_learn_state&0xff=0:Idle}{reset_learn_state&0xff=1:Inactive: key-off clr disabled}{reset_learn_state&0xff=2:Inactive: conditions invalid}{reset_learn_state&0xff=3:Active: reprogramming learn}{reset_learn_state&0xff=4:Active: manual learn}" UBYTE reset_learn_state_COMPU_VTAB 0 0 0 255 ECU_ADDRESS 0x01012948 BIT_MASK 0xff /end MEASUREMENT
/begin COMPU_METHOD reset_learn_state_COMPU_VTAB "Verbal Table" TAB_VERB "%.0" "list" COMPU_TAB_REF reset_learn_state_COMPU_VTAB_REF /end COMPU_METHOD
/begin COMPU_VTAB reset_learn_state_COMPU_VTAB_REF "Verbal Table" TAB_VERB 7 0 "Idle" 1 "Inactive: key-off clr disabled" 2 "Inactive: conditions invalid" 3 "Active: reprogramming learn" 4 "Active: manual learn" 5 "Active: EGRdP offset learn" 6 "Learn complete" DEFAULT_VALUE "UNKNOWN" /end COMPU_VTAB
/begin CHARACTERISTIC SRVC_fixed_int_km_L1 "Service fixed interval (kms) - level 1" VALUE 0x001c7f84 /* @ECU_Address@SRVC_fixed_int_km_L1@0x010131E8@ */ ECIPP_ALIGNMENT_UWORD 327675 Compu_SRVC_fixed_int_km_L1 0 327675 /end CHARACTERISTIC
/begin COMPU_METHOD Compu_SRVC_fixed_int_km_L1 " " RAT_FUNC "%.0" "km" COEFFS 0 0.2 0 0 0 1 /end COMPU_METHOD
/begin CHARACTERISTIC SRVC_fixed_int_km_L2 "Service fixed interval (kms) - level 2" VALUE 0x001c7f86 /* @ECU_Address@SRVC_fixed_int_km_L2@0x010131F0@ */ ECIPP_ALIGNMENT_UWORD 327675 Compu_SRVC_fixed_int_km_L2 0 327675 /end CHARACTERISTIC
/begin COMPU_METHOD Compu_SRVC_fixed_int_km_L2 " " RAT_FUNC "%.0" "km" COEFFS 0 0.2 0 0 0 1 /end COMPU_METHOD
/begin MEASUREMENT SRVC_km_rem "Service distance remaining" SLONG Compu_SRVC_km_rem 0 0 -268435456 268435455.875 ECU_ADDRESS 0x010131F8 /end MEASUREMENT
/begin COMPU_METHOD Compu_SRVC_km_rem " " RAT_FUNC "%.1" "km" COEFFS 0 8 0 0 0 1 /end COMPU_METHOD
/begin CHARACTERISTIC IBF_mode "Intake backfire detection mode{IBF_mode&0xff=0:Disabled}{IBF_mode&0xff=1:IATdt}{IBF_mode&0xff=2:MAP}" VALUE 0x001c876a /* @ECU_Address@IBF_mode@0x01013A78@ */ ECIPP_ALIGNMENT_UBYTE 255 IBF_mode_COMPU_VTAB 0 255 BIT_MASK 0xff /end CHARACTERISTIC
/begin COMPU_METHOD IBF_mode_COMPU_VTAB "Verbal Table" TAB_VERB "%.0" "list" COMPU_TAB_REF IBF_mode_COMPU_VTAB_REF /end COMPU_METHOD
/begin COMPU_VTAB IBF_mode_COMPU_VTAB_REF "Verbal Table" TAB_VERB 3 0 "Disabled" 1 "IATdt" 2 "MAP" DEFAULT_VALUE "UNKNOWN" /end COMPU_VTAB
/begin MEASUREMENT IATdt "IATdt" SWORD Compu_IATdt 0 0 -256 255.9921875 ECU_ADDRESS 0x01013A80 /end MEASUREMENT
/begin COMPU_METHOD Compu_IATdt " " RAT_FUNC "%.1" "deg F/sec" COEFFS 0 128 0 0 0 1 /end COMPU_METHOD
/begin MEASUREMENT IATdt_key_cyc_max "IATdt max (key cycle)" SWORD Compu_IATdt_key_cyc_max 0 0 -256 255.9921875 ECU_ADDRESS 0x01013A88 /end MEASUREMENT
/begin COMPU_METHOD Compu_IATdt_key_cyc_max " " RAT_FUNC "%.1" "deg F/sec" COEFFS 0 128 0 0 0 1 /end COMPU_METHOD
/begin CHARACTERISTIC IBF_IATdt_lim "Intake backfire IATdt limit" VALUE 0x001c450e /* @ECU_Address@IBF_IATdt_lim@0x01013A90@ */ ECIPP_ALIGNMENT_SWORD 256 Compu_IBF_IATdt_lim -256 255.9921875 /end CHARACTERISTIC
/begin COMPU_METHOD Compu_IBF_IATdt_lim " " RAT_FUNC "%.1" "deg F/sec" COEFFS 0 128 0 0 0 1 /end COMPU_METHOD
/begin CHARACTERISTIC IBF_MAP_lim "Intake backfire MAP limit" VALUE 0x001c7c0e /* @ECU_Address@IBF_MAP_lim@0x01013A98@ */ ECIPP_ALIGNMENT_UWORD 256 Compu_IBF_MAP_lim 0 255.99609375 /end CHARACTERISTIC
/begin COMPU_METHOD Compu_IBF_MAP_lim " " RAT_FUNC "%.1" "psia" COEFFS 0 256 0 0 0 1 /end COMPU_METHOD
/begin CHARACTERISTIC IBF_latch_tm "Intake backfire latch time" VALUE 0x001c7c10 /* @ECU_Address@IBF_latch_tm@0x01013AA0@ */ ECIPP_ALIGNMENT_UWORD 65535 Compu_IBF_latch_tm 0 65535 /end CHARACTERISTIC
/begin COMPU_METHOD Compu_IBF_latch_tm " " RAT_FUNC "%.0" "ms" COEFFS 0 1 0 0 0 1 /end COMPU_METHOD
/begin CHARACTERISTIC IBF_unlatch_tm "Intake backfire unlatch time" VALUE 0x001c7c12 /* @ECU_Address@IBF_unlatch_tm@0x01013AA8@ */ ECIPP_ALIGNMENT_UWORD 65535 Compu_IBF_unlatch_tm 0 65535 /end CHARACTERISTIC
/begin COMPU_METHOD Compu_IBF_unlatch_tm " " RAT_FUNC "%.0" "ms" COEFFS 0 1 0 0 0 1 /end COMPU_METHOD
/begin MEASUREMENT IBF_action_request "Intake backfire action request{IBF_action_request&0xff=0:Press to select action...}{IBF_action_request&0xff=1:Reset Recent Histograms}" UBYTE IBF_action_request_COMPU_VTAB 0 0 0 255 ECU_ADDRESS 0x01013AB0 BIT_MASK 0xff /end MEASUREMENT
/begin COMPU_METHOD IBF_action_request_COMPU_VTAB "Verbal Table" TAB_VERB "%.0" "list" COMPU_TAB_REF IBF_action_request_COMPU_VTAB_REF /end COMPU_METHOD
/begin COMPU_VTAB IBF_action_request_COMPU_VTAB_REF "Verbal Table" TAB_VERB 2 0 "Press to select action..." 1 "Reset Recent Histograms" DEFAULT_VALUE "UNKNOWN" /end COMPU_VTAB
/begin MEASUREMENT HstIBF_total "Total intake backfires (recent)" UWORD Compu_HstIBF_total 0 0 0 65535 ECU_ADDRESS 0x01013AB8 /end MEASUREMENT
/begin COMPU_METHOD Compu_HstIBF_total " " RAT_FUNC "%.0" "occurrences" COEFFS 0 1 0 0 0 1 /end COMPU_METHOD
/begin MEASUREMENT HstIBF_LT_total "Total intake backfires (lifetime)" UWORD Compu_HstIBF_LT_total 0 0 0 65535 ECU_ADDRESS 0x01013AC0 /end MEASUREMENT
/begin COMPU_METHOD Compu_HstIBF_LT_total " " RAT_FUNC "%.0" "occurrences" COEFFS 0 1 0 0 0 1 /end COMPU_METHOD
/begin MEASUREMENT HstIBF_time "Cumulative time since reset" ULONG Compu_HstIBF_time 0 0 0 1193046.47083333 ECU_ADDRESS 0x01013AC8 /end MEASUREMENT
/begin COMPU_METHOD Compu_HstIBF_time " " RAT_FUNC "%.3" "hours" COEFFS 0 3600 0 0 0 1 /end COMPU_METHOD
/begin CHARACTERISTIC postphi_ret_CAD "Spark retard @30% EGR" VALUE 0x001c6d2c /* @ECU_Address@postphi_ret_CAD@0x01014060@ */ ECIPP_ALIGNMENT_SWORD 2048 Compu_postphi_ret_CAD -2048 2047.9375 /end CHARACTERISTIC
/begin COMPU_METHOD Compu_postphi_ret_CAD " " RAT_FUNC "%.1" "CAD" COEFFS 0 16 0 0 0 1 /end COMPU_METHOD
/begin CHARACTERISTIC postphi_ret_engage "Spark retard engage" VALUE 0x001c84ae /* @ECU_Address@postphi_ret_engage@0x01014068@ */ ECIPP_ALIGNMENT_UWORD 4 Compu_postphi_ret_engage 0 3.99993896484375 /end CHARACTERISTIC
/begin COMPU_METHOD Compu_postphi_ret_engage " " RAT_FUNC "%.3" "phi" COEFFS 0 16384 0 0 0 1 /end COMPU_METHOD
/begin CHARACTERISTIC postphi_ret_diseng "Spark retard disengage" VALUE 0x001c84ac /* @ECU_Address@postphi_ret_diseng@0x01014070@ */ ECIPP_ALIGNMENT_UWORD 4 Compu_postphi_ret_diseng 0 3.99993896484375 /end CHARACTERISTIC
/begin COMPU_METHOD Compu_postphi_ret_diseng " " RAT_FUNC "%.3" "phi" COEFFS 0 16384 0 0 0 1 /end COMPU_METHOD
/begin MEASUREMENT postcat_phi_retard "Postcat phi retard" SWORD Compu_postcat_phi_retard 0 0 -2048 2047.9375 ECU_ADDRESS 0x01014078 /end MEASUREMENT
/begin COMPU_METHOD Compu_postcat_phi_retard " " RAT_FUNC "%.1" "CAD ret" COEFFS 0 16 0 0 0 1 /end COMPU_METHOD
/begin CHARACTERISTIC postphi_ret_FSO_wt "Post FSO phi enrichment wait" VALUE 0x001c9073 /* @ECU_Address@postphi_ret_FSO_wt@0x01014080@ */ ECIPP_ALIGNMENT_UBYTE 255 Compu_postphi_ret_FSO_wt 0 255 /end CHARACTERISTIC
/begin COMPU_METHOD Compu_postphi_ret_FSO_wt " " RAT_FUNC "%.0" "Tdelays" COEFFS 0 1 0 0 0 1 /end COMPU_METHOD
/begin MEASUREMENT V12_FB_raw "V12_FB_raw" UWORD Compu_V12_FB_raw 0 0 0 5.00114468864469 ECU_ADDRESS 0x01014428 /end MEASUREMENT
/begin COMPU_METHOD Compu_V12_FB_raw " " RAT_FUNC "%.3" "volts" COEFFS 0 13104 0 0 0 1 /end COMPU_METHOD
/begin MEASUREMENT V3P3_FB_raw "V3P3_FB_raw" UWORD Compu_V3P3_FB_raw 0 0 0 5.00114468864469 ECU_ADDRESS 0x01014430 /end MEASUREMENT
/begin COMPU_METHOD Compu_V3P3_FB_raw " " RAT_FUNC "%.3" "volts" COEFFS 0 13104 0 0 0 1 /end COMPU_METHOD
/begin MEASUREMENT TANK1_DIS_raw "TANK1_DIS_raw" UWORD Compu_TANK1_DIS_raw 0 0 0 5.00114468864469 ECU_ADDRESS 0x01014448 /end MEASUREMENT
/begin COMPU_METHOD Compu_TANK1_DIS_raw " " RAT_FUNC "%.3" "volts" COEFFS 0 13104 0 0 0 1 /end COMPU_METHOD
/begin MEASUREMENT TANK2_DIS_raw "TANK2_DIS_raw" UWORD Compu_TANK2_DIS_raw 0 0 0 5.00114468864469 ECU_ADDRESS 0x01014450 /end MEASUREMENT
/begin COMPU_METHOD Compu_TANK2_DIS_raw " " RAT_FUNC "%.3" "volts" COEFFS 0 13104 0 0 0 1 /end COMPU_METHOD
/begin MEASUREMENT TANK_1_V_raw "TANK_1_V_raw" UWORD Compu_TANK_1_V_raw 0 0 0 5.00114468864469 ECU_ADDRESS 0x01014458 /end MEASUREMENT
/begin COMPU_METHOD Compu_TANK_1_V_raw " " RAT_FUNC "%.3" "volts" COEFFS 0 13104 0 0 0 1 /end COMPU_METHOD
/begin MEASUREMENT TANK_2_V_raw "TANK_2_V_raw" UWORD Compu_TANK_2_V_raw 0 0 0 5.00114468864469 ECU_ADDRESS 0x01014460 /end MEASUREMENT
/begin COMPU_METHOD Compu_TANK_2_V_raw " " RAT_FUNC "%.3" "volts" COEFFS 0 13104 0 0 0 1 /end COMPU_METHOD
/begin CHARACTERISTIC TANK_1_V_minv "Tank min V (Fault Condition:Tank voltage <)" VALUE 0x001ecef4 /* @ECU_Address@TANK_1_V_minv@0x01014468@ */ ECIPP_ALIGNMENT_UWORD 1024 Compu_TANK_1_V_minv 0 1023.984375 /end CHARACTERISTIC
/begin COMPU_METHOD Compu_TANK_1_V_minv " " RAT_FUNC "%.1" "volts" COEFFS 0 64 0 0 0 1 /end COMPU_METHOD
/begin CHARACTERISTIC TANK_1_V_maxv "Tank max V (Fault Condition:Tank voltage >)" VALUE 0x001ecef2 /* @ECU_Address@TANK_1_V_maxv@0x01014470@ */ ECIPP_ALIGNMENT_UWORD 1024 Compu_TANK_1_V_maxv 0 1023.984375 /end CHARACTERISTIC
/begin COMPU_METHOD Compu_TANK_1_V_maxv " " RAT_FUNC "%.1" "volts" COEFFS 0 64 0 0 0 1 /end COMPU_METHOD
/begin MEASUREMENT TANK_1_VMF "TANK 1 Misfire Spark" UWORD Compu_TANK_1_VMF 0 0 0 1023.984375 ECU_ADDRESS 0x01014488 /end MEASUREMENT
/begin COMPU_METHOD Compu_TANK_1_VMF " " RAT_FUNC "%.3" "volts" COEFFS 0 64 0 0 0 1 /end COMPU_METHOD
/begin MEASUREMENT TANK_2_VMF "TANK 2 Misfire Spark" UWORD Compu_TANK_2_VMF 0 0 0 1023.984375 ECU_ADDRESS 0x01014490 /end MEASUREMENT
/begin COMPU_METHOD Compu_TANK_2_VMF " " RAT_FUNC "%.3" "volts" COEFFS 0 64 0 0 0 1 /end COMPU_METHOD
/begin MEASUREMENT TANK_1_VRF "TANK 1 Refire Spark" UWORD Compu_TANK_1_VRF 0 0 0 1023.984375 ECU_ADDRESS 0x01014498 /end MEASUREMENT
/begin COMPU_METHOD Compu_TANK_1_VRF " " RAT_FUNC "%.3" "volts" COEFFS 0 64 0 0 0 1 /end COMPU_METHOD
/begin MEASUREMENT TANK_2_VRF "TANK 2 Refire Spark" UWORD Compu_TANK_2_VRF 0 0 0 1023.984375 ECU_ADDRESS 0x010144A0 /end MEASUREMENT
/begin COMPU_METHOD Compu_TANK_2_VRF " " RAT_FUNC "%.3" "volts" COEFFS 0 64 0 0 0 1 /end COMPU_METHOD
/begin MEASUREMENT TANK_ADCnts_Des "Active Tank Setpoint" ULONG Compu_TANK_ADCnts_Des 0 0 0 21029082.8485348 ECU_ADDRESS 0x010144A8 /end MEASUREMENT
/begin COMPU_METHOD Compu_TANK_ADCnts_Des " " RAT_FUNC "%.1" "volts" COEFFS 0 204.239401496259 0 0 0 1 /end COMPU_METHOD
/begin MEASUREMENT TANK_ADCnts_DesMF "Active Tank Setpoint MF" ULONG Compu_TANK_ADCnts_DesMF 0 0 0 21029082.8485348 ECU_ADDRESS 0x010144B0 /end MEASUREMENT
/begin COMPU_METHOD Compu_TANK_ADCnts_DesMF " " RAT_FUNC "%.1" "volts" COEFFS 0 204.239401496259 0 0 0 1 /end COMPU_METHOD
/begin CHARACTERISTIC RF_spk_ena "Refire Spark{RF_spk_ena&0xff=0:Disabled}{RF_spk_ena&0xff=1:Enabled}" VALUE 0x001ecf13 /* @ECU_Address@RF_spk_ena@0x010144C0@ */ ECIPP_ALIGNMENT_UBYTE 255 RF_spk_ena_COMPU_VTAB 0 255 BIT_MASK 0xff /end CHARACTERISTIC
/begin COMPU_METHOD RF_spk_ena_COMPU_VTAB "Verbal Table" TAB_VERB "%.0" "list" COMPU_TAB_REF RF_spk_ena_COMPU_VTAB_REF /end COMPU_METHOD
/begin COMPU_VTAB RF_spk_ena_COMPU_VTAB_REF "Verbal Table" TAB_VERB 2 0 "Disabled" 1 "Enabled" DEFAULT_VALUE "UNKNOWN" /end COMPU_VTAB
/begin CHARACTERISTIC RF_spk_MAP "Refire MAP Threshold" VALUE 0x001ecee8 /* @ECU_Address@RF_spk_MAP@0x010144C8@ */ ECIPP_ALIGNMENT_UWORD 256 Compu_RF_spk_MAP 0 255.99609375 /end CHARACTERISTIC
/begin COMPU_METHOD Compu_RF_spk_MAP " " RAT_FUNC "%.1" "psia" COEFFS 0 256 0 0 0 1 /end COMPU_METHOD
/begin CHARACTERISTIC CD_dwell "CD_dwell" VALUE 0x001eced4 /* @ECU_Address@CD_dwell@0x010144D0@ */ ECIPP_ALIGNMENT_UWORD 210 Compu_CD_dwell 0 209.712 /end CHARACTERISTIC
/begin COMPU_METHOD Compu_CD_dwell " " RAT_FUNC "%.2" "ms" COEFFS 0 312.5 0 0 0 1 /end COMPU_METHOD
/begin CHARACTERISTIC SpkDelayCal "SpkDelayCal" VALUE 0x001ecdac /* @ECU_Address@SpkDelayCal@0x010144D8@ */ ECIPP_ALIGNMENT_SLONG 1677722 Compu_SpkDelayCal -1677721.6 1677721.59921875 /end CHARACTERISTIC
/begin COMPU_METHOD Compu_SpkDelayCal " " RAT_FUNC "%.1" "us" COEFFS 0 1280 0 0 0 1 /end COMPU_METHOD
/begin CHARACTERISTIC SoftStartPchan "SoftStartPchan" VALUE 0x001ecf15 /* @ECU_Address@SoftStartPchan@0x010144E0@ */ ECIPP_ALIGNMENT_UBYTE 255 Compu_SoftStartPchan 0 255 /end CHARACTERISTIC
/begin COMPU_METHOD Compu_SoftStartPchan " " RAT_FUNC "%.0" "cnts" COEFFS 0 1 0 0 0 1 /end COMPU_METHOD
/begin CHARACTERISTIC SoftStartPWM "SoftStartPWM" VALUE 0x001ecf14 /* @ECU_Address@SoftStartPWM@0x010144E8@ */ ECIPP_ALIGNMENT_UBYTE 255 Compu_SoftStartPWM 0 255 /end CHARACTERISTIC
/begin COMPU_METHOD Compu_SoftStartPWM " " RAT_FUNC "%.0" "cnts" COEFFS 0 1 0 0 0 1 /end COMPU_METHOD
/begin CHARACTERISTIC SoftStartPWMmaxDC "SoftStartPWM max DC" VALUE 0x001eceec /* @ECU_Address@SoftStartPWMmaxDC@0x010144F0@ */ ECIPP_ALIGNMENT_UWORD 100 Compu_SoftStartPWMmaxDC 0 99.9984741210938 /end CHARACTERISTIC
/begin COMPU_METHOD Compu_SoftStartPWMmaxDC " " RAT_FUNC "%.2" "%" COEFFS 0 655.36 0 0 0 1 /end COMPU_METHOD
/begin CHARACTERISTIC TankMaxDC_28V "TankMaxDC_28V" VALUE 0x001ecefc /* @ECU_Address@TankMaxDC_28V@0x010144F8@ */ ECIPP_ALIGNMENT_UWORD 100 Compu_TankMaxDC_28V 0 99.9984741210938 /end CHARACTERISTIC
/begin COMPU_METHOD Compu_TankMaxDC_28V " " RAT_FUNC "%.2" "%" COEFFS 0 655.36 0 0 0 1 /end COMPU_METHOD
/begin CHARACTERISTIC TankMaxDC_12V "TankMaxDC_12V" VALUE 0x001ecefa /* @ECU_Address@TankMaxDC_12V@0x01014500@ */ ECIPP_ALIGNMENT_UWORD 100 Compu_TankMaxDC_12V 0 99.9984741210938 /end CHARACTERISTIC
/begin COMPU_METHOD Compu_TankMaxDC_12V " " RAT_FUNC "%.2" "%" COEFFS 0 655.36 0 0 0 1 /end COMPU_METHOD
/begin CHARACTERISTIC TankMinDC_28V "TankMinDC_28V" VALUE 0x001ecf00 /* @ECU_Address@TankMinDC_28V@0x01014508@ */ ECIPP_ALIGNMENT_UWORD 100 Compu_TankMinDC_28V 0 99.9984741210938 /end CHARACTERISTIC
/begin COMPU_METHOD Compu_TankMinDC_28V " " RAT_FUNC "%.2" "%" COEFFS 0 655.36 0 0 0 1 /end COMPU_METHOD
/begin CHARACTERISTIC TankMinDC_12V "TankMinDC_12V" VALUE 0x001ecefe /* @ECU_Address@TankMinDC_12V@0x01014510@ */ ECIPP_ALIGNMENT_UWORD 100 Compu_TankMinDC_12V 0 99.9984741210938 /end CHARACTERISTIC
/begin COMPU_METHOD Compu_TankMinDC_12V " " RAT_FUNC "%.2" "%" COEFFS 0 655.36 0 0 0 1 /end COMPU_METHOD
/begin CHARACTERISTIC TANK_Pump_Kp "TANK_Pump_Kp" VALUE 0x001ecef6 /* @ECU_Address@TANK_Pump_Kp@0x01014518@ */ ECIPP_ALIGNMENT_UWORD 100 Compu_TANK_Pump_Kp 0 99.9984741210938 /end CHARACTERISTIC
/begin COMPU_METHOD Compu_TANK_Pump_Kp " " RAT_FUNC "%.1" "%/V" COEFFS 0 655.36 0 0 0 1 /end COMPU_METHOD
/begin CHARACTERISTIC TANK_Pump_Kp12V "TANK_Pump_Kp12V" VALUE 0x001ecef8 /* @ECU_Address@TANK_Pump_Kp12V@0x01014520@ */ ECIPP_ALIGNMENT_UWORD 100 Compu_TANK_Pump_Kp12V 0 99.9984741210938 /end CHARACTERISTIC
/begin COMPU_METHOD Compu_TANK_Pump_Kp12V " " RAT_FUNC "%.1" "%/V" COEFFS 0 655.36 0 0 0 1 /end COMPU_METHOD
/begin CHARACTERISTIC TankSetpoint "TankSetpoint" VALUE 0x001ecf02 /* @ECU_Address@TankSetpoint@0x01014528@ */ ECIPP_ALIGNMENT_UWORD 1024 Compu_TankSetpoint 0 1023.984375 /end CHARACTERISTIC
/begin COMPU_METHOD Compu_TankSetpoint " " RAT_FUNC "%.1" "volts" COEFFS 0 64 0 0 0 1 /end COMPU_METHOD
/begin CHARACTERISTIC TankSetpointMF "TankSetpointMF" VALUE 0x001ecf04 /* @ECU_Address@TankSetpointMF@0x01014530@ */ ECIPP_ALIGNMENT_UWORD 1024 Compu_TankSetpointMF 0 1023.984375 /end CHARACTERISTIC
/begin COMPU_METHOD Compu_TankSetpointMF " " RAT_FUNC "%.1" "volts" COEFFS 0 64 0 0 0 1 /end COMPU_METHOD
/begin CHARACTERISTIC TankSetptMF_limit "TankSetpointMF limit" VALUE 0x001ecf06 /* @ECU_Address@TankSetptMF_limit@0x01014538@ */ ECIPP_ALIGNMENT_UWORD 1024 Compu_TankSetptMF_limit 0 1023.984375 /end CHARACTERISTIC
/begin COMPU_METHOD Compu_TankSetptMF_limit " " RAT_FUNC "%.1" "volts" COEFFS 0 64 0 0 0 1 /end COMPU_METHOD
/begin CHARACTERISTIC SecThreshold "Secondary Feedback Threshold" VALUE 0x001eceea /* @ECU_Address@SecThreshold@0x01014540@ */ ECIPP_ALIGNMENT_UWORD 65535 Compu_SecThreshold 0 65535 /end CHARACTERISTIC
/begin COMPU_METHOD Compu_SecThreshold " " RAT_FUNC "%.1" "mV" COEFFS 0 1 0 0 0 1 /end COMPU_METHOD
/begin CHARACTERISTIC KV_term "Secondary Termination Inductor{KV_term&0xff=0:In}{KV_term&0xff=1:Out}" VALUE 0x001ecf12 /* @ECU_Address@KV_term@0x01014548@ */ ECIPP_ALIGNMENT_UBYTE 255 KV_term_COMPU_VTAB 0 255 BIT_MASK 0xff /end CHARACTERISTIC
/begin COMPU_METHOD KV_term_COMPU_VTAB "Verbal Table" TAB_VERB "%.0" "list" COMPU_TAB_REF KV_term_COMPU_VTAB_REF /end COMPU_METHOD
/begin COMPU_VTAB KV_term_COMPU_VTAB_REF "Verbal Table" TAB_VERB 2 0 "In" 1 "Out" DEFAULT_VALUE "UNKNOWN" /end COMPU_VTAB
/begin CHARACTERISTIC AutoKV_ena "AutoKV enable{AutoKV_ena&0xff=0:Disabled}{AutoKV_ena&0xff=1:Enabled}" VALUE 0x001ecf0e /* @ECU_Address@AutoKV_ena@0x01014558@ */ ECIPP_ALIGNMENT_UBYTE 255 AutoKV_ena_COMPU_VTAB 0 255 BIT_MASK 0xff /end CHARACTERISTIC
/begin COMPU_METHOD AutoKV_ena_COMPU_VTAB "Verbal Table" TAB_VERB "%.0" "list" COMPU_TAB_REF AutoKV_ena_COMPU_VTAB_REF /end COMPU_METHOD
/begin COMPU_VTAB AutoKV_ena_COMPU_VTAB_REF "Verbal Table" TAB_VERB 2 0 "Disabled" 1 "Enabled" DEFAULT_VALUE "UNKNOWN" /end COMPU_VTAB
/begin CHARACTERISTIC AutoKV_period "AutoKV execution period" VALUE 0x001eced2 /* @ECU_Address@AutoKV_period@0x01014560@ */ ECIPP_ALIGNMENT_UWORD 3277 Compu_AutoKV_period 0 3276.75 /end CHARACTERISTIC
/begin COMPU_METHOD Compu_AutoKV_period " " RAT_FUNC "%.2" "sec" COEFFS 0 20 0 0 0 1 /end COMPU_METHOD
/begin MEASUREMENT AutoKV_tmr "AutoKV timer" UWORD Compu_AutoKV_tmr 0 0 0 3276.75 ECU_ADDRESS 0x01014568 /end MEASUREMENT
/begin COMPU_METHOD Compu_AutoKV_tmr " " RAT_FUNC "%.2" "sec" COEFFS 0 20 0 0 0 1 /end COMPU_METHOD
/begin MEASUREMENT AutoKV_TankSetpt "AutoKV Tank setpoint" UWORD Compu_AutoKV_TankSetpt 0 0 0 1023.984375 ECU_ADDRESS 0x01014570 /end MEASUREMENT
/begin COMPU_METHOD Compu_AutoKV_TankSetpt " " RAT_FUNC "%.2" "volts" COEFFS 0 64 0 0 0 1 /end COMPU_METHOD
/begin CHARACTERISTIC AutoKVMargin "AutoKV margin" VALUE 0x001ecec8 /* @ECU_Address@AutoKVMargin@0x01014578@ */ ECIPP_ALIGNMENT_UWORD 66 Compu_AutoKVMargin 0 65.535 /end CHARACTERISTIC
/begin COMPU_METHOD Compu_AutoKVMargin " " RAT_FUNC "%.2" "KV" COEFFS 0 1000 0 0 0 1 /end COMPU_METHOD
/begin CHARACTERISTIC AutoKVReq_inc "AutoKV increment" VALUE 0x001ececc /* @ECU_Address@AutoKVReq_inc@0x01014580@ */ ECIPP_ALIGNMENT_UWORD 66 Compu_AutoKVReq_inc 0 65.535 /end CHARACTERISTIC
/begin COMPU_METHOD Compu_AutoKVReq_inc " " RAT_FUNC "%.2" "KV" COEFFS 0 1000 0 0 0 1 /end COMPU_METHOD
/begin CHARACTERISTIC AutoKVReq_dec "AutoKV decrement" VALUE 0x001ececa /* @ECU_Address@AutoKVReq_dec@0x01014588@ */ ECIPP_ALIGNMENT_UWORD 66 Compu_AutoKVReq_dec 0 65.535 /end CHARACTERISTIC
/begin COMPU_METHOD Compu_AutoKVReq_dec " " RAT_FUNC "%.2" "KV" COEFFS 0 1000 0 0 0 1 /end COMPU_METHOD
/begin CHARACTERISTIC AutoKVReq_min "AutoKV minimum" VALUE 0x001ecece /* @ECU_Address@AutoKVReq_min@0x01014590@ */ ECIPP_ALIGNMENT_UWORD 66 Compu_AutoKVReq_min 0 65.535 /end CHARACTERISTIC
/begin COMPU_METHOD Compu_AutoKVReq_min " " RAT_FUNC "%.2" "KV" COEFFS 0 1000 0 0 0 1 /end COMPU_METHOD
/begin MEASUREMENT AutoKVReq "AutoKV desired" UWORD Compu_AutoKVReq 0 0 0 65.535 ECU_ADDRESS 0x01014598 /end MEASUREMENT
/begin COMPU_METHOD Compu_AutoKVReq " " RAT_FUNC "%.2" "KV" COEFFS 0 1000 0 0 0 1 /end COMPU_METHOD
/begin MEASUREMENT KVHighest "KV Highest" UWORD Compu_KVHighest 0 0 0 65.535 ECU_ADDRESS 0x010145A0 /end MEASUREMENT
/begin COMPU_METHOD Compu_KVHighest " " RAT_FUNC "%.2" "KV" COEFFS 0 1000 0 0 0 1 /end COMPU_METHOD
/begin CHARACTERISTIC KVHighest_max "KV Highest maximum" VALUE 0x001eceda /* @ECU_Address@KVHighest_max@0x010145A8@ */ ECIPP_ALIGNMENT_UWORD 66 Compu_KVHighest_max 0 65.535 /end CHARACTERISTIC
/begin COMPU_METHOD Compu_KVHighest_max " " RAT_FUNC "%.2" "KV" COEFFS 0 1000 0 0 0 1 /end COMPU_METHOD
/begin CHARACTERISTIC KVHighest_tau "KV Highest low pass tau" VALUE 0x001ecf08 /* @ECU_Address@KVHighest_tau@0x010145B0@ */ ECIPP_ALIGNMENT_UWORD 3276795 Compu_KVHighest_tau 4.5084 3276800 /end CHARACTERISTIC
/begin COMPU_METHOD Compu_KVHighest_tau " " FORM "%.1" "ms"
 /begin FORMULA "-50 / log(1 - (X1 / 65536))" FORMULA_INV "(1 - exp(-50/X1)) * 65536" /end FORMULA
/end COMPU_METHOD
/begin MEASUREMENT MAPKV_MAPss "MAPKV steady state" UWORD Compu_MAPKV_MAPss 0 0 0 255.99609375 ECU_ADDRESS 0x010145B8 /end MEASUREMENT
/begin COMPU_METHOD Compu_MAPKV_MAPss " " RAT_FUNC "%.2" "psia" COEFFS 0 256 0 0 0 1 /end COMPU_METHOD
/begin CHARACTERISTIC MAPKV_MAPss_tau "MAPKVss low pass tau" VALUE 0x001ecf0c /* @ECU_Address@MAPKV_MAPss_tau@0x010145C0@ */ ECIPP_ALIGNMENT_UWORD 3276795 Compu_MAPKV_MAPss_tau 4.5084 3276800 /end CHARACTERISTIC
/begin COMPU_METHOD Compu_MAPKV_MAPss_tau " " FORM "%.1" "ms"
 /begin FORMULA "-50 / log(1 - (X1 / 65536))" FORMULA_INV "(1 - exp(-50/X1)) * 65536" /end FORMULA
/end COMPU_METHOD
/begin CHARACTERISTIC MAPKV_ofst "MAPKVss offset" VALUE 0x001ecee0 /* @ECU_Address@MAPKV_ofst@0x010145C8@ */ ECIPP_ALIGNMENT_UWORD 256 Compu_MAPKV_ofst 0 255.99609375 /end CHARACTERISTIC
/begin COMPU_METHOD Compu_MAPKV_ofst " " RAT_FUNC "%.2" "psi" COEFFS 0 256 0 0 0 1 /end COMPU_METHOD
/begin CHARACTERISTIC AutoKV_MAP_Kp "MAPKVss Kp" VALUE 0x001eced0 /* @ECU_Address@AutoKV_MAP_Kp@0x010145D0@ */ ECIPP_ALIGNMENT_UWORD 66 Compu_AutoKV_MAP_Kp 0 65.535 /end CHARACTERISTIC
/begin COMPU_METHOD Compu_AutoKV_MAP_Kp " " RAT_FUNC "%.2" "KV/psi" COEFFS 0 1000 0 0 0 1 /end COMPU_METHOD
/begin CHARACTERISTIC Coil_turns "Coil turns" VALUE 0x001eced6 /* @ECU_Address@Coil_turns@0x010145D8@ */ ECIPP_ALIGNMENT_UWORD 512 Compu_Coil_turns 0 511.9921875 /end CHARACTERISTIC
/begin COMPU_METHOD Compu_Coil_turns " " RAT_FUNC "%.0" "-" COEFFS 0 128 0 0 0 1 /end COMPU_METHOD
/begin CHARACTERISTIC CD_CoilType "Coil type{CD_CoilType&0xff=0:Unshielded IT230}{CD_CoilType&0xff=1:Shielded 230RM}{CD_CoilType&0xff=2:Unshielded IT250}" VALUE 0x001ecf0f /* @ECU_Address@CD_CoilType@0x010145E0@ */ ECIPP_ALIGNMENT_UBYTE 255 CD_CoilType_COMPU_VTAB 0 255 BIT_MASK 0xff /end CHARACTERISTIC
/begin COMPU_METHOD CD_CoilType_COMPU_VTAB "Verbal Table" TAB_VERB "%.0" "list" COMPU_TAB_REF CD_CoilType_COMPU_VTAB_REF /end COMPU_METHOD
/begin COMPU_VTAB CD_CoilType_COMPU_VTAB_REF "Verbal Table" TAB_VERB 3 0 "Unshielded IT230" 1 "Shielded 230RM" 2 "Unshielded IT250" DEFAULT_VALUE "UNKNOWN" /end COMPU_VTAB
/begin MEASUREMENT CDdur_CAD "Misfire spk CAD required" SWORD Compu_CDdur_CAD 0 0 -2048 2047.9375 ECU_ADDRESS 0x010145E8 /end MEASUREMENT
/begin COMPU_METHOD Compu_CDdur_CAD " " RAT_FUNC "%.1" "CAD" COEFFS 0 16 0 0 0 1 /end COMPU_METHOD
/begin CHARACTERISTIC CDmisfire_spkCnt "Misfire Detection Spark Count" VALUE 0x001ecdb0 /* @ECU_Address@CDmisfire_spkCnt@0x01014620@ */ ECIPP_ALIGNMENT_SWORD 32767 Compu_CDmisfire_spkCnt -32768 32767 /end CHARACTERISTIC
/begin COMPU_METHOD Compu_CDmisfire_spkCnt " " RAT_FUNC "%.0" "counts" COEFFS 0 1 0 0 0 1 /end COMPU_METHOD
/begin CHARACTERISTIC MAP_misfire_OK "Misfire Detection MAP Threshold" VALUE 0x001ecee4 /* @ECU_Address@MAP_misfire_OK@0x01014628@ */ ECIPP_ALIGNMENT_UWORD 256 Compu_MAP_misfire_OK 0 255.99609375 /end CHARACTERISTIC
/begin COMPU_METHOD Compu_MAP_misfire_OK " " RAT_FUNC "%.1" "psia" COEFFS 0 256 0 0 0 1 /end COMPU_METHOD
/begin CHARACTERISTIC ECT_spk_ena "Diagnostics ECT enable temp" VALUE 0x001eced8 /* @ECU_Address@ECT_spk_ena@0x01014630@ */ ECIPP_ALIGNMENT_UWORD 564 Compu_ECT_spk_ena -460 563.984375 /end CHARACTERISTIC
/begin COMPU_METHOD Compu_ECT_spk_ena " " RAT_FUNC "%.1" "degF" COEFFS 0 64 29440 0 0 1 /end COMPU_METHOD
/begin MEASUREMENT spk_kill_mfmode "Misfire Detect During Kill{spk_kill_mfmode&0xff=0:MF_OFF}{spk_kill_mfmode&0xff=1:MF_ON}" UBYTE spk_kill_mfmode_COMPU_VTAB 0 0 0 255 ECU_ADDRESS 0x01014638 BIT_MASK 0xff /end MEASUREMENT
/begin COMPU_METHOD spk_kill_mfmode_COMPU_VTAB "Verbal Table" TAB_VERB "%.0" "list" COMPU_TAB_REF spk_kill_mfmode_COMPU_VTAB_REF /end COMPU_METHOD
/begin COMPU_VTAB spk_kill_mfmode_COMPU_VTAB_REF "Verbal Table" TAB_VERB 2 0 "MF_OFF" 1 "MF_ON" DEFAULT_VALUE "UNKNOWN" /end COMPU_VTAB
/begin CHARACTERISTIC KV_high "Diagnostics KV high inc (Fault Condition:SparkKV_filt > Kvnom_filt +)" VALUE 0x001ecedc /* @ECU_Address@KV_high@0x01014650@ */ ECIPP_ALIGNMENT_UWORD 66 Compu_KV_high 0 65.535 /end CHARACTERISTIC
/begin COMPU_METHOD Compu_KV_high " " RAT_FUNC "%.2" "KV" COEFFS 0 1000 0 0 0 1 /end COMPU_METHOD
/begin CHARACTERISTIC KV_low "Diagnostics KV low dec (Fault Condition:SparkKV_filt < Kvnom_filt -)" VALUE 0x001ecede /* @ECU_Address@KV_low@0x01014658@ */ ECIPP_ALIGNMENT_UWORD 66 Compu_KV_low 0 65.535 /end CHARACTERISTIC
/begin COMPU_METHOD Compu_KV_low " " RAT_FUNC "%.2" "KV" COEFFS 0 1000 0 0 0 1 /end COMPU_METHOD
/begin CHARACTERISTIC MAP_MinKVflt "Diagnostics <5KV min MAP (Fault Condition:AND MAP >)" VALUE 0x001ecee2 /* @ECU_Address@MAP_MinKVflt@0x01014660@ */ ECIPP_ALIGNMENT_UWORD 256 Compu_MAP_MinKVflt 0 255.99609375 /end CHARACTERISTIC
/begin COMPU_METHOD Compu_MAP_MinKVflt " " RAT_FUNC "%.1" "psia" COEFFS 0 256 0 0 0 1 /end COMPU_METHOD
/begin MEASUREMENT spock_sync_ena "4G - SPOCK Sync{spock_sync_ena&0xff=0:Disabled}{spock_sync_ena&0xff=1:Enabled}" UBYTE spock_sync_ena_COMPU_VTAB 0 0 0 255 ECU_ADDRESS 0x01014828 BIT_MASK 0xff /end MEASUREMENT
/begin COMPU_METHOD spock_sync_ena_COMPU_VTAB "Verbal Table" TAB_VERB "%.0" "list" COMPU_TAB_REF spock_sync_ena_COMPU_VTAB_REF /end COMPU_METHOD
/begin COMPU_VTAB spock_sync_ena_COMPU_VTAB_REF "Verbal Table" TAB_VERB 2 0 "Disabled" 1 "Enabled" DEFAULT_VALUE "UNKNOWN" /end COMPU_VTAB
/begin MEASUREMENT local_cal_sync_CS_32 "Local Cal Sync Checksum" ULONG Compu_local_cal_sync_CS_32 0 0 0 4294967295 ECU_ADDRESS 0x01014830 /end MEASUREMENT
/begin COMPU_METHOD Compu_local_cal_sync_CS_32 " " RAT_FUNC "%.0" "-" COEFFS 0 1 0 0 0 1 /end COMPU_METHOD
/begin MEASUREMENT ext_cal_sync_CS_32 "External Cal Sync Checksum" ULONG Compu_ext_cal_sync_CS_32 0 0 0 4294967295 ECU_ADDRESS 0x01014838 /end MEASUREMENT
/begin COMPU_METHOD Compu_ext_cal_sync_CS_32 " " RAT_FUNC "%.0" "-" COEFFS 0 1 0 0 0 1 /end COMPU_METHOD
/begin MEASUREMENT Bootblock_Enable_raw "Bootblock Enable" UWORD Compu_Bootblock_Enable_raw 0 0 0 5.00114468864469 ECU_ADDRESS 0x01014840 /end MEASUREMENT
/begin COMPU_METHOD Compu_Bootblock_Enable_raw " " RAT_FUNC "%.3" "volts" COEFFS 0 13104 0 0 0 1 /end COMPU_METHOD
/begin MEASUREMENT cal_sync_status "Cal Sync Status{cal_sync_status&0xff=0:Idle}{cal_sync_status&0xff=1:Syncing Scalars}{cal_sync_status&0xff=2:Syncing Scalars}{cal_sync_status&0xff=3:Syncing Scalars}{cal_sync_status&0xff=4:Syncing Tables}{cal_sync_status&0xff=5:Syncing Tables}{cal_sync_sta" UBYTE cal_sync_status_COMPU_VTAB 0 0 0 255 ECU_ADDRESS 0x01014848 BIT_MASK 0xff /end MEASUREMENT
/begin COMPU_METHOD cal_sync_status_COMPU_VTAB "Verbal Table" TAB_VERB "%.0" "list" COMPU_TAB_REF cal_sync_status_COMPU_VTAB_REF /end COMPU_METHOD
/begin COMPU_VTAB cal_sync_status_COMPU_VTAB_REF "Verbal Table" TAB_VERB 7 0 "Idle" 1 "Syncing Scalars" 2 "Syncing Scalars" 3 "Syncing Scalars" 4 "Syncing Tables" 5 "Syncing Tables" 6 "Flash Commit" DEFAULT_VALUE "UNKNOWN" /end COMPU_VTAB
/begin MEASUREMENT cal_sync_timer "Cal Sync Timer" UWORD Compu_cal_sync_timer 0 0 0 65.535 ECU_ADDRESS 0x01014850 /end MEASUREMENT
/begin COMPU_METHOD Compu_cal_sync_timer " " RAT_FUNC "%.1" "secs" COEFFS 0 1000 0 0 0 1 /end COMPU_METHOD
/begin MEASUREMENT cal_sync_attempts "Cal Sync Attempts" UBYTE Compu_cal_sync_attempts 0 0 0 255 ECU_ADDRESS 0x01014858 /end MEASUREMENT
/begin COMPU_METHOD Compu_cal_sync_attempts " " RAT_FUNC "%.0" "-" COEFFS 0 1 0 0 0 1 /end COMPU_METHOD
/begin MEASUREMENT spock_XLS_revision "SPOCK XLS Revision" UWORD Compu_spock_XLS_revision 0 0 0 65535 ECU_ADDRESS 0x010148A0 /end MEASUREMENT
/begin COMPU_METHOD Compu_spock_XLS_revision " " RAT_FUNC "%.0" "-" COEFFS 0 1 0 0 0 1 /end COMPU_METHOD
/begin MEASUREMENT spock_SVN_revision "SPOCK SVN Revision" ULONG Compu_spock_SVN_revision 0 0 0 4294967295 ECU_ADDRESS 0x010148A8 /end MEASUREMENT
/begin COMPU_METHOD Compu_spock_SVN_revision " " RAT_FUNC "%.0" "-" COEFFS 0 1 0 0 0 1 /end COMPU_METHOD
/begin MEASUREMENT spock_spk_halt "Spark Halt{spock_spk_halt&0x20=0x00:Disabled}{spock_spk_halt&0x20=0x20:Enabled}" UBYTE spock_spk_halt_COMPU_VTAB 0 0 0 255 ECU_ADDRESS 0x010148B0 BIT_MASK 0x20 /end MEASUREMENT
/begin COMPU_METHOD spock_spk_halt_COMPU_VTAB "Verbal Table" TAB_VERB "%.0" "list" COMPU_TAB_REF spock_spk_halt_COMPU_VTAB_REF /end COMPU_METHOD
/begin COMPU_VTAB spock_spk_halt_COMPU_VTAB_REF "Verbal Table" TAB_VERB 2 0x00 "Disabled" 0x20 "Enabled" DEFAULT_VALUE "UNKNOWN" /end COMPU_VTAB
/begin CHARACTERISTIC coil11_spk_mult "11" VALUE 0x001C6C68 /* @ECU_Address@coil11_spk_mult@0x01014AB0@ */ ECIPP_ALIGNMENT_SWORD 2 Compu_coil11_spk_mult -2 1.99993896484375 /end CHARACTERISTIC
/begin COMPU_METHOD Compu_coil11_spk_mult " " RAT_FUNC "%.2" "-" COEFFS 0 16384 0 0 0 1 /end COMPU_METHOD
/begin CHARACTERISTIC coil12_spk_mult "12" VALUE 0x001C6C6A /* @ECU_Address@coil12_spk_mult@0x01014AB8@ */ ECIPP_ALIGNMENT_SWORD 2 Compu_coil12_spk_mult -2 1.99993896484375 /end CHARACTERISTIC
/begin COMPU_METHOD Compu_coil12_spk_mult " " RAT_FUNC "%.2" "-" COEFFS 0 16384 0 0 0 1 /end COMPU_METHOD
/begin CHARACTERISTIC dwell_sense11_source "Dwell source firing index 11{dwell_sense11_source&0xff=0:Default}{dwell_sense11_source&0xff=1:SPK_MON1}{dwell_sense11_source&0xff=2:SPK_MON2}" VALUE 0x001C9003 /* @ECU_Address@dwell_sense11_source@0x01014AC0@ */ ECIPP_ALIGNMENT_UBYTE 255 dwell_sense11_source_COMPU_VTAB 0 255 BIT_MASK 0xff /end CHARACTERISTIC
/begin COMPU_METHOD dwell_sense11_source_COMPU_VTAB "Verbal Table" TAB_VERB "%.0" "list" COMPU_TAB_REF dwell_sense11_source_COMPU_VTAB_REF /end COMPU_METHOD
/begin COMPU_VTAB dwell_sense11_source_COMPU_VTAB_REF "Verbal Table" TAB_VERB 3 0 "Default" 1 "SPK_MON1" 2 "SPK_MON2" DEFAULT_VALUE "UNKNOWN" /end COMPU_VTAB
/begin CHARACTERISTIC dwell_sense12_source "Dwell source firing index 12{dwell_sense12_source&0xff=0:Default}{dwell_sense12_source&0xff=1:SPK_MON1}{dwell_sense12_source&0xff=2:SPK_MON2}" VALUE 0x001C9004 /* @ECU_Address@dwell_sense12_source@0x01014AC8@ */ ECIPP_ALIGNMENT_UBYTE 255 dwell_sense12_source_COMPU_VTAB 0 255 BIT_MASK 0xff /end CHARACTERISTIC
/begin COMPU_METHOD dwell_sense12_source_COMPU_VTAB "Verbal Table" TAB_VERB "%.0" "list" COMPU_TAB_REF dwell_sense12_source_COMPU_VTAB_REF /end COMPU_METHOD
/begin COMPU_VTAB dwell_sense12_source_COMPU_VTAB_REF "Verbal Table" TAB_VERB 3 0 "Default" 1 "SPK_MON1" 2 "SPK_MON2" DEFAULT_VALUE "UNKNOWN" /end COMPU_VTAB
/begin MEASUREMENT coil11_adv_cyl "11" SWORD Compu_coil11_adv_cyl 0 0 -2048 2047.9375 ECU_ADDRESS 0x01014AD0 /end MEASUREMENT
/begin COMPU_METHOD Compu_coil11_adv_cyl " " RAT_FUNC "%.1" "-" COEFFS 0 16 0 0 0 1 /end COMPU_METHOD
/begin MEASUREMENT coil12_adv_cyl "12" SWORD Compu_coil12_adv_cyl 0 0 -2048 2047.9375 ECU_ADDRESS 0x01014AD8 /end MEASUREMENT
/begin COMPU_METHOD Compu_coil12_adv_cyl " " RAT_FUNC "%.1" "-" COEFFS 0 16 0 0 0 1 /end COMPU_METHOD
/begin MEASUREMENT dwell11_adapt "Coil11 dwell adapt" SWORD Compu_dwell11_adapt 0 0 -104.8576 104.8544 ECU_ADDRESS 0x01014B00 /end MEASUREMENT
/begin COMPU_METHOD Compu_dwell11_adapt " " RAT_FUNC "%.2" "ms" COEFFS 0 312.5 0 0 0 1 /end COMPU_METHOD
/begin MEASUREMENT dwell12_adapt "Coil12 dwell adapt" SWORD Compu_dwell12_adapt 0 0 -104.8576 104.8544 ECU_ADDRESS 0x01014B08 /end MEASUREMENT
/begin COMPU_METHOD Compu_dwell12_adapt " " RAT_FUNC "%.2" "ms" COEFFS 0 312.5 0 0 0 1 /end COMPU_METHOD
/begin MEASUREMENT TankSetptMF_actual "TankSetpointMF actual" UWORD Compu_TankSetptMF_actual 0 0 0 1023.984375 ECU_ADDRESS 0x01014BD8 /end MEASUREMENT
/begin COMPU_METHOD Compu_TankSetptMF_actual " " RAT_FUNC "%.1" "volts" COEFFS 0 64 0 0 0 1 /end COMPU_METHOD
/begin MEASUREMENT cd_spk_adv "Spark Advance" SWORD Compu_cd_spk_adv 0 0 -2048 2047.9375 ECU_ADDRESS 0x01014BE0 /end MEASUREMENT
/begin COMPU_METHOD Compu_cd_spk_adv " " RAT_FUNC "%.1" "CAD BTDC" COEFFS 0 16 0 0 0 1 /end COMPU_METHOD
/begin MEASUREMENT CD_MF_cntr1 "CD misfire spark cntr 1" UWORD Compu_CD_MF_cntr1 0 0 0 65535 ECU_ADDRESS 0x01014D70 /end MEASUREMENT
/begin COMPU_METHOD Compu_CD_MF_cntr1 " " RAT_FUNC "%.0" "-" COEFFS 0 1 0 0 0 1 /end COMPU_METHOD
/begin MEASUREMENT CD_MF_cntr2 "CD misfire spark cntr 2" UWORD Compu_CD_MF_cntr2 0 0 0 65535 ECU_ADDRESS 0x01014D78 /end MEASUREMENT
/begin COMPU_METHOD Compu_CD_MF_cntr2 " " RAT_FUNC "%.0" "-" COEFFS 0 1 0 0 0 1 /end COMPU_METHOD
/begin MEASUREMENT CD_MF_cntr3 "CD misfire spark cntr 3" UWORD Compu_CD_MF_cntr3 0 0 0 65535 ECU_ADDRESS 0x01014D80 /end MEASUREMENT
/begin COMPU_METHOD Compu_CD_MF_cntr3 " " RAT_FUNC "%.0" "-" COEFFS 0 1 0 0 0 1 /end COMPU_METHOD
/begin MEASUREMENT CD_MF_cntr4 "CD misfire spark cntr 4" UWORD Compu_CD_MF_cntr4 0 0 0 65535 ECU_ADDRESS 0x01014D88 /end MEASUREMENT
/begin COMPU_METHOD Compu_CD_MF_cntr4 " " RAT_FUNC "%.0" "-" COEFFS 0 1 0 0 0 1 /end COMPU_METHOD
/begin MEASUREMENT CD_MF_cntr5 "CD misfire spark cntr 5" UWORD Compu_CD_MF_cntr5 0 0 0 65535 ECU_ADDRESS 0x01014D90 /end MEASUREMENT
/begin COMPU_METHOD Compu_CD_MF_cntr5 " " RAT_FUNC "%.0" "-" COEFFS 0 1 0 0 0 1 /end COMPU_METHOD
/begin MEASUREMENT CD_MF_cntr6 "CD misfire spark cntr 6" UWORD Compu_CD_MF_cntr6 0 0 0 65535 ECU_ADDRESS 0x01014D98 /end MEASUREMENT
/begin COMPU_METHOD Compu_CD_MF_cntr6 " " RAT_FUNC "%.0" "-" COEFFS 0 1 0 0 0 1 /end COMPU_METHOD
/begin MEASUREMENT CD_MF_cntr7 "CD misfire spark cntr 7" UWORD Compu_CD_MF_cntr7 0 0 0 65535 ECU_ADDRESS 0x01014DA0 /end MEASUREMENT
/begin COMPU_METHOD Compu_CD_MF_cntr7 " " RAT_FUNC "%.0" "-" COEFFS 0 1 0 0 0 1 /end COMPU_METHOD
/begin MEASUREMENT CD_MF_cntr8 "CD misfire spark cntr 8" UWORD Compu_CD_MF_cntr8 0 0 0 65535 ECU_ADDRESS 0x01014DA8 /end MEASUREMENT
/begin COMPU_METHOD Compu_CD_MF_cntr8 " " RAT_FUNC "%.0" "-" COEFFS 0 1 0 0 0 1 /end COMPU_METHOD
/begin MEASUREMENT CD_MF_cntr9 "CD misfire spark cntr 9" UWORD Compu_CD_MF_cntr9 0 0 0 65535 ECU_ADDRESS 0x01014DB0 /end MEASUREMENT
/begin COMPU_METHOD Compu_CD_MF_cntr9 " " RAT_FUNC "%.0" "-" COEFFS 0 1 0 0 0 1 /end COMPU_METHOD
/begin MEASUREMENT CD_MF_cntr10 "CD misfire spark cntr 10" UWORD Compu_CD_MF_cntr10 0 0 0 65535 ECU_ADDRESS 0x01014DB8 /end MEASUREMENT
/begin COMPU_METHOD Compu_CD_MF_cntr10 " " RAT_FUNC "%.0" "-" COEFFS 0 1 0 0 0 1 /end COMPU_METHOD
/begin MEASUREMENT CD_MF_cntr11 "CD misfire spark cntr 11" UWORD Compu_CD_MF_cntr11 0 0 0 65535 ECU_ADDRESS 0x01014DC0 /end MEASUREMENT
/begin COMPU_METHOD Compu_CD_MF_cntr11 " " RAT_FUNC "%.0" "-" COEFFS 0 1 0 0 0 1 /end COMPU_METHOD
/begin MEASUREMENT CD_MF_cntr12 "CD misfire spark cntr 12" UWORD Compu_CD_MF_cntr12 0 0 0 65535 ECU_ADDRESS 0x01014DC8 /end MEASUREMENT
/begin COMPU_METHOD Compu_CD_MF_cntr12 " " RAT_FUNC "%.0" "-" COEFFS 0 1 0 0 0 1 /end COMPU_METHOD
/begin MEASUREMENT CD_MF_MAP_LED "Misfire MAP{CD_MF_MAP_LED&0x01=0:Misfire OK}{CD_MF_MAP_LED&0x01=1:Misfire Stopped}" UBYTE CD_MF_MAP_LED_COMPU_VTAB 0 0 0 255 ECU_ADDRESS 0x01014DD0 BIT_MASK 0x01 /end MEASUREMENT
/begin COMPU_METHOD CD_MF_MAP_LED_COMPU_VTAB "Verbal Table" TAB_VERB "%.0" "list" COMPU_TAB_REF CD_MF_MAP_LED_COMPU_VTAB_REF /end COMPU_METHOD
/begin COMPU_VTAB CD_MF_MAP_LED_COMPU_VTAB_REF "Verbal Table" TAB_VERB 2 0 "Misfire OK" 1 "Misfire Stopped" DEFAULT_VALUE "UNKNOWN" /end COMPU_VTAB
/begin MEASUREMENT CD_MF_ECT_LED "Misfire ECT{CD_MF_ECT_LED&0x02=0:Misfire OK}{CD_MF_ECT_LED&0x02=1:Misfire Stopped}" UBYTE CD_MF_ECT_LED_COMPU_VTAB 0 0 0 255 ECU_ADDRESS 0x01014DD8 BIT_MASK 0x02 /end MEASUREMENT
/begin COMPU_METHOD CD_MF_ECT_LED_COMPU_VTAB "Verbal Table" TAB_VERB "%.0" "list" COMPU_TAB_REF CD_MF_ECT_LED_COMPU_VTAB_REF /end COMPU_METHOD
/begin COMPU_VTAB CD_MF_ECT_LED_COMPU_VTAB_REF "Verbal Table" TAB_VERB 2 0 "Misfire OK" 1 "Misfire Stopped" DEFAULT_VALUE "UNKNOWN" /end COMPU_VTAB
/begin MEASUREMENT CD_MF_rpm_LED "Misfire rpm{CD_MF_rpm_LED&0x04=0:Misfire OK}{CD_MF_rpm_LED&0x04=1:Misfire Stopped}" UBYTE CD_MF_rpm_LED_COMPU_VTAB 0 0 0 255 ECU_ADDRESS 0x01014DE0 BIT_MASK 0x04 /end MEASUREMENT
/begin COMPU_METHOD CD_MF_rpm_LED_COMPU_VTAB "Verbal Table" TAB_VERB "%.0" "list" COMPU_TAB_REF CD_MF_rpm_LED_COMPU_VTAB_REF /end COMPU_METHOD
/begin COMPU_VTAB CD_MF_rpm_LED_COMPU_VTAB_REF "Verbal Table" TAB_VERB 2 0 "Misfire OK" 1 "Misfire Stopped" DEFAULT_VALUE "UNKNOWN" /end COMPU_VTAB
/begin MEASUREMENT CD_MF_run_tmr_LED "Misfire run_tmr{CD_MF_run_tmr_LED&0x08=0:Misfire OK}{CD_MF_run_tmr_LED&0x08=1:Misfire Stopped}" UBYTE CD_MF_run_tmr_LED_COMPU_VTAB 0 0 0 255 ECU_ADDRESS 0x01014DE8 BIT_MASK 0x08 /end MEASUREMENT
/begin COMPU_METHOD CD_MF_run_tmr_LED_COMPU_VTAB "Verbal Table" TAB_VERB "%.0" "list" COMPU_TAB_REF CD_MF_run_tmr_LED_COMPU_VTAB_REF /end COMPU_METHOD
/begin COMPU_VTAB CD_MF_run_tmr_LED_COMPU_VTAB_REF "Verbal Table" TAB_VERB 2 0 "Misfire OK" 1 "Misfire Stopped" DEFAULT_VALUE "UNKNOWN" /end COMPU_VTAB
/begin MEASUREMENT CD_MF_AutoKV_LED "Misfire AutoKV Tank setpt{CD_MF_AutoKV_LED&0x10=0:Misfire OK}{CD_MF_AutoKV_LED&0x10=1:Misfire Stopped}" UBYTE CD_MF_AutoKV_LED_COMPU_VTAB 0 0 0 255 ECU_ADDRESS 0x01014DF0 BIT_MASK 0xFF /end MEASUREMENT
/begin COMPU_METHOD CD_MF_AutoKV_LED_COMPU_VTAB "Verbal Table" TAB_VERB "%.0" "list" COMPU_TAB_REF CD_MF_AutoKV_LED_COMPU_VTAB_REF /end COMPU_METHOD
/begin COMPU_VTAB CD_MF_AutoKV_LED_COMPU_VTAB_REF "Verbal Table" TAB_VERB 2 0 "Misfire OK" 1 "Misfire Stopped" DEFAULT_VALUE "Unsupported Bit_Shift" /end COMPU_VTAB
/begin MEASUREMENT CD_MF_CDdur_LED "Misfire Spark adv required{CD_MF_CDdur_LED&0x20=0:Misfire OK}{CD_MF_CDdur_LED&0x20=1:Misfire Stopped}" UBYTE CD_MF_CDdur_LED_COMPU_VTAB 0 0 0 255 ECU_ADDRESS 0x01014DF8 BIT_MASK 0x20 /end MEASUREMENT
/begin COMPU_METHOD CD_MF_CDdur_LED_COMPU_VTAB "Verbal Table" TAB_VERB "%.0" "list" COMPU_TAB_REF CD_MF_CDdur_LED_COMPU_VTAB_REF /end COMPU_METHOD
/begin COMPU_VTAB CD_MF_CDdur_LED_COMPU_VTAB_REF "Verbal Table" TAB_VERB 2 0 "Misfire OK" 1 "Misfire Stopped" DEFAULT_VALUE "UNKNOWN" /end COMPU_VTAB
/begin MEASUREMENT CD_MF_CDcal_LED "Misfire Spark Count{CD_MF_CDcal_LED&0x40=0:Misfire OK}{CD_MF_CDcal_LED&0x40=1:Misfire Stopped}" UBYTE CD_MF_CDcal_LED_COMPU_VTAB 0 0 0 255 ECU_ADDRESS 0x01014E00 BIT_MASK 0x40 /end MEASUREMENT
/begin COMPU_METHOD CD_MF_CDcal_LED_COMPU_VTAB "Verbal Table" TAB_VERB "%.0" "list" COMPU_TAB_REF CD_MF_CDcal_LED_COMPU_VTAB_REF /end COMPU_METHOD
/begin COMPU_VTAB CD_MF_CDcal_LED_COMPU_VTAB_REF "Verbal Table" TAB_VERB 2 0 "Misfire OK" 1 "Misfire Stopped" DEFAULT_VALUE "UNKNOWN" /end COMPU_VTAB
/begin MEASUREMENT CD_RF_LED "Refire LED{CD_RF_LED&0x80=0:Refire inactive}{CD_RF_LED&0x80=1:Refire active}" UBYTE CD_RF_LED_COMPU_VTAB 0 0 0 255 ECU_ADDRESS 0x01014E08 BIT_MASK 0xFF /end MEASUREMENT
/begin COMPU_METHOD CD_RF_LED_COMPU_VTAB "Verbal Table" TAB_VERB "%.0" "list" COMPU_TAB_REF CD_RF_LED_COMPU_VTAB_REF /end COMPU_METHOD
/begin COMPU_VTAB CD_RF_LED_COMPU_VTAB_REF "Verbal Table" TAB_VERB 2 0 "Refire inactive" 1 "Refire active" DEFAULT_VALUE "Unsupported Bit_Shift" /end COMPU_VTAB
/begin CHARACTERISTIC TANK_PumpMult_180V "TankSetpointKp" VALUE 0x001ecdb4 /* @ECU_Address@TANK_PumpMult_180V@0x01014E10@ */ ECIPP_ALIGNMENT_SWORD 32 Compu_TANK_PumpMult_180V -32 31.9990234375 /end CHARACTERISTIC
/begin COMPU_METHOD Compu_TANK_PumpMult_180V " " RAT_FUNC "%.2" "mult" COEFFS 0 1024 0 0 0 1 /end COMPU_METHOD
/begin CHARACTERISTIC TANK_PumpMult_280V "TankSetpointKp" VALUE 0x001ecdb6 /* @ECU_Address@TANK_PumpMult_280V@0x01014E18@ */ ECIPP_ALIGNMENT_SWORD 32 Compu_TANK_PumpMult_280V -32 31.9990234375 /end CHARACTERISTIC
/begin COMPU_METHOD Compu_TANK_PumpMult_280V " " RAT_FUNC "%.2" "mult" COEFFS 0 1024 0 0 0 1 /end COMPU_METHOD
/begin MEASUREMENT TANK_Kp "TankPumpKp" UWORD Compu_TANK_Kp 0 0 0 99.9984741210938 ECU_ADDRESS 0x01014E20 /end MEASUREMENT
/begin COMPU_METHOD Compu_TANK_Kp " " RAT_FUNC "%.1" "%/V" COEFFS 0 655.36 0 0 0 1 /end COMPU_METHOD
/begin MEASUREMENT CDdur_nom_ticks "Spk charge estimate" ULONG Compu_CDdur_nom_ticks 0 0 0 3355.44319921875 ECU_ADDRESS 0x01014F48 /end MEASUREMENT
/begin COMPU_METHOD Compu_CDdur_nom_ticks " " RAT_FUNC "%.3" "ms" COEFFS 0 1280000 0 0 0 1 /end COMPU_METHOD
/begin MEASUREMENT CDdur_nomMF_ticks "Spk charge estimate MF" ULONG Compu_CDdur_nomMF_ticks 0 0 0 3355.44319921875 ECU_ADDRESS 0x01014F50 /end MEASUREMENT
/begin COMPU_METHOD Compu_CDdur_nomMF_ticks " " RAT_FUNC "%.3" "ms" COEFFS 0 1280000 0 0 0 1 /end COMPU_METHOD
/begin MEASUREMENT CDdur_act_Tk1_ps "Spk rise actual Tank 1" ULONG Compu_CDdur_act_Tk1_ps 0 0 0 3355.44319921875 ECU_ADDRESS 0x01014F58 /end MEASUREMENT
/begin COMPU_METHOD Compu_CDdur_act_Tk1_ps " " RAT_FUNC "%.3" "ms" COEFFS 0 1280000 0 0 0 1 /end COMPU_METHOD
/begin MEASUREMENT CDdur_act_Tk2_ps "Spk rise actual Tank 2" ULONG Compu_CDdur_act_Tk2_ps 0 0 0 3355.44319921875 ECU_ADDRESS 0x01014F60 /end MEASUREMENT
/begin COMPU_METHOD Compu_CDdur_act_Tk2_ps " " RAT_FUNC "%.3" "ms" COEFFS 0 1280000 0 0 0 1 /end COMPU_METHOD
/begin MEASUREMENT CDdur_act_Tk1_mf_rf "Spk rise actual Tank 1 MF/RF" ULONG Compu_CDdur_act_Tk1_mf_rf 0 0 0 3355.44319921875 ECU_ADDRESS 0x01014F68 /end MEASUREMENT
/begin COMPU_METHOD Compu_CDdur_act_Tk1_mf_rf " " RAT_FUNC "%.3" "ms" COEFFS 0 1280000 0 0 0 1 /end COMPU_METHOD
/begin MEASUREMENT CDdur_act_Tk2_mf_rf "Spk rise actual Tank 2 MF/RF" ULONG Compu_CDdur_act_Tk2_mf_rf 0 0 0 3355.44319921875 ECU_ADDRESS 0x01014F70 /end MEASUREMENT
/begin COMPU_METHOD Compu_CDdur_act_Tk2_mf_rf " " RAT_FUNC "%.3" "ms" COEFFS 0 1280000 0 0 0 1 /end COMPU_METHOD
/begin MEASUREMENT RFdur_CAD "Refire Spark adv required" SWORD Compu_RFdur_CAD 0 0 -2048 2047.9375 ECU_ADDRESS 0x01014F78 /end MEASUREMENT
/begin COMPU_METHOD Compu_RFdur_CAD " " RAT_FUNC "%.1" "CAD" COEFFS 0 16 0 0 0 1 /end COMPU_METHOD
/begin MEASUREMENT asw_can_rx_cnt_cur "Current Rx Definitions" UBYTE Compu_asw_can_rx_cnt_cur 0 0 0 255 ECU_ADDRESS 0x01014FA0 /end MEASUREMENT
/begin COMPU_METHOD Compu_asw_can_rx_cnt_cur " " RAT_FUNC "%.0" "-" COEFFS 0 1 0 0 0 1 /end COMPU_METHOD
/begin MEASUREMENT asw_can_rx_cnt_max "Maximum Rx Definitions" UBYTE Compu_asw_can_rx_cnt_max 0 0 0 255 ECU_ADDRESS 0x01014FA8 /end MEASUREMENT
/begin COMPU_METHOD Compu_asw_can_rx_cnt_max " " RAT_FUNC "%.0" "-" COEFFS 0 1 0 0 0 1 /end COMPU_METHOD
/begin MEASUREMENT asw_can_tx_cnt_cur "Current Tx Definitions" UBYTE Compu_asw_can_tx_cnt_cur 0 0 0 255 ECU_ADDRESS 0x01014FB0 /end MEASUREMENT
/begin COMPU_METHOD Compu_asw_can_tx_cnt_cur " " RAT_FUNC "%.0" "-" COEFFS 0 1 0 0 0 1 /end COMPU_METHOD
/begin MEASUREMENT asw_can_tx_cnt_max "Maximum Tx Definitions" UBYTE Compu_asw_can_tx_cnt_max 0 0 0 255 ECU_ADDRESS 0x01014FB8 /end MEASUREMENT
/begin COMPU_METHOD Compu_asw_can_tx_cnt_max " " RAT_FUNC "%.0" "-" COEFFS 0 1 0 0 0 1 /end COMPU_METHOD
/begin MEASUREMENT asw_can_err_cnt "Rx/Tx error count" ULONG Compu_asw_can_err_cnt 0 0 0 4294967295 ECU_ADDRESS 0x01014FC0 /end MEASUREMENT
/begin COMPU_METHOD Compu_asw_can_err_cnt " " RAT_FUNC "%.0" "-" COEFFS 0 1 0 0 0 1 /end COMPU_METHOD
/begin MEASUREMENT asw_can_err_code "Rx/Tx error code" ULONG Compu_asw_can_err_code 0 0 0 4294967295 ECU_ADDRESS 0x01014FC8 /end MEASUREMENT
/begin COMPU_METHOD Compu_asw_can_err_code " " RAT_FUNC "%.0" "-" COEFFS 0 1 0 0 0 1 /end COMPU_METHOD
/begin MEASUREMENT CAN1_asw_rx_packs "CAN1 Rx packets" ULONG Compu_CAN1_asw_rx_packs 0 0 0 4294967295 ECU_ADDRESS 0x01014FD0 /end MEASUREMENT
/begin COMPU_METHOD Compu_CAN1_asw_rx_packs " " RAT_FUNC "%.0" "-" COEFFS 0 1 0 0 0 1 /end COMPU_METHOD
/begin MEASUREMENT CAN1_asw_tx_packs "CAN1 Tx packets" ULONG Compu_CAN1_asw_tx_packs 0 0 0 4294967295 ECU_ADDRESS 0x01014FD8 /end MEASUREMENT
/begin COMPU_METHOD Compu_CAN1_asw_tx_packs " " RAT_FUNC "%.0" "-" COEFFS 0 1 0 0 0 1 /end COMPU_METHOD
/begin MEASUREMENT CAN2_asw_rx_packs "CAN2 Rx packets" ULONG Compu_CAN2_asw_rx_packs 0 0 0 4294967295 ECU_ADDRESS 0x01014FE0 /end MEASUREMENT
/begin COMPU_METHOD Compu_CAN2_asw_rx_packs " " RAT_FUNC "%.0" "-" COEFFS 0 1 0 0 0 1 /end COMPU_METHOD
/begin MEASUREMENT CAN2_asw_tx_packs "CAN2 Tx packets" ULONG Compu_CAN2_asw_tx_packs 0 0 0 4294967295 ECU_ADDRESS 0x01014FE8 /end MEASUREMENT
/begin COMPU_METHOD Compu_CAN2_asw_tx_packs " " RAT_FUNC "%.0" "-" COEFFS 0 1 0 0 0 1 /end COMPU_METHOD
/begin MEASUREMENT CAN3_asw_rx_packs "CAN3 Rx packets" ULONG Compu_CAN3_asw_rx_packs 0 0 0 4294967295 ECU_ADDRESS 0x01014FF0 /end MEASUREMENT
/begin COMPU_METHOD Compu_CAN3_asw_rx_packs " " RAT_FUNC "%.0" "-" COEFFS 0 1 0 0 0 1 /end COMPU_METHOD
/begin MEASUREMENT CAN3_asw_tx_packs "CAN3 Tx packets" ULONG Compu_CAN3_asw_tx_packs 0 0 0 4294967295 ECU_ADDRESS 0x01014FF8 /end MEASUREMENT
/begin COMPU_METHOD Compu_CAN3_asw_tx_packs " " RAT_FUNC "%.0" "-" COEFFS 0 1 0 0 0 1 /end COMPU_METHOD
/begin CHARACTERISTIC RPM_stat_ena "RPM statistics{RPM_stat_ena&0xff=0:Disabled}{RPM_stat_ena&0xff=1:Enabled}" VALUE 0x001c88c6 /* @ECU_Address@RPM_stat_ena@0x01015130@ */ ECIPP_ALIGNMENT_UBYTE 255 RPM_stat_ena_COMPU_VTAB 0 255 BIT_MASK 0xff /end CHARACTERISTIC
/begin COMPU_METHOD RPM_stat_ena_COMPU_VTAB "Verbal Table" TAB_VERB "%.0" "list" COMPU_TAB_REF RPM_stat_ena_COMPU_VTAB_REF /end COMPU_METHOD
/begin COMPU_VTAB RPM_stat_ena_COMPU_VTAB_REF "Verbal Table" TAB_VERB 2 0 "Disabled" 1 "Enabled" DEFAULT_VALUE "UNKNOWN" /end COMPU_VTAB
/begin CHARACTERISTIC RPM_stat_hi_trig "RPM high hour meter trigger" VALUE 0x001c7eae /* @ECU_Address@RPM_stat_hi_trig@0x01015138@ */ ECIPP_ALIGNMENT_UWORD 65535 Compu_RPM_stat_hi_trig 0 65535 /end CHARACTERISTIC
/begin COMPU_METHOD Compu_RPM_stat_hi_trig " " RAT_FUNC "%.0" "rpm" COEFFS 0 1 0 0 0 1 /end COMPU_METHOD
/begin MEASUREMENT RPM_stat_reset_usr "RPM statistics reset" UWORD Compu_RPM_stat_reset_usr 0 0 0 65535 ECU_ADDRESS 0x01015148 /end MEASUREMENT
/begin COMPU_METHOD Compu_RPM_stat_reset_usr " " RAT_FUNC "%.0" "-" COEFFS 0 1 0 0 0 1 /end COMPU_METHOD
/begin MEASUREMENT RPM_stat_max "RPM max" UWORD Compu_RPM_stat_max 0 0 0 65535 ECU_ADDRESS 0x01015150 /end MEASUREMENT
/begin COMPU_METHOD Compu_RPM_stat_max " " RAT_FUNC "%.0" "rpm" COEFFS 0 1 0 0 0 1 /end COMPU_METHOD
/begin MEASUREMENT RPM_stat_hi_HM "RPM high hour meter" ULONG Compu_RPM_stat_hi_HM 0 0 0 1193046.47083333 ECU_ADDRESS 0x01015158 /end MEASUREMENT
/begin COMPU_METHOD Compu_RPM_stat_hi_HM " " RAT_FUNC "%.3" "hours" COEFFS 0 3600 0 0 0 1 /end COMPU_METHOD
/begin CHARACTERISTIC OILT_stat_ena "OILT statistics{OILT_stat_ena&0xff=0:Disabled}{OILT_stat_ena&0xff=1:Enabled}" VALUE 0x001c886b /* @ECU_Address@OILT_stat_ena@0x01015160@ */ ECIPP_ALIGNMENT_UBYTE 255 OILT_stat_ena_COMPU_VTAB 0 255 BIT_MASK 0xff /end CHARACTERISTIC
/begin COMPU_METHOD OILT_stat_ena_COMPU_VTAB "Verbal Table" TAB_VERB "%.0" "list" COMPU_TAB_REF OILT_stat_ena_COMPU_VTAB_REF /end COMPU_METHOD
/begin COMPU_VTAB OILT_stat_ena_COMPU_VTAB_REF "Verbal Table" TAB_VERB 2 0 "Disabled" 1 "Enabled" DEFAULT_VALUE "UNKNOWN" /end COMPU_VTAB
/begin CHARACTERISTIC OILT_stat_hi_trig "OILT high hour meter trigger" VALUE 0x001c7e14 /* @ECU_Address@OILT_stat_hi_trig@0x01015168@ */ ECIPP_ALIGNMENT_UWORD 7732 Compu_OILT_stat_hi_trig -460 7731.875 /end CHARACTERISTIC
/begin COMPU_METHOD Compu_OILT_stat_hi_trig " " RAT_FUNC "%.1" "deg F" COEFFS 0 8 3680 0 0 1 /end COMPU_METHOD
/begin MEASUREMENT OILT_stat_reset_usr "OILT statistics reset" UWORD Compu_OILT_stat_reset_usr 0 0 0 65535 ECU_ADDRESS 0x01015178 /end MEASUREMENT
/begin COMPU_METHOD Compu_OILT_stat_reset_usr " " RAT_FUNC "%.0" "-" COEFFS 0 1 0 0 0 1 /end COMPU_METHOD
/begin MEASUREMENT OILT_stat_max "OILT max" UWORD Compu_OILT_stat_max 0 0 -460 7731.875 ECU_ADDRESS 0x01015180 /end MEASUREMENT
/begin COMPU_METHOD Compu_OILT_stat_max " " RAT_FUNC "%.1" "deg F" COEFFS 0 8 3680 0 0 1 /end COMPU_METHOD
/begin MEASUREMENT OILT_stat_hi_HM "OILT high hour meter" ULONG Compu_OILT_stat_hi_HM 0 0 0 1193046.47083333 ECU_ADDRESS 0x01015188 /end MEASUREMENT
/begin COMPU_METHOD Compu_OILT_stat_hi_HM " " RAT_FUNC "%.3" "hours" COEFFS 0 3600 0 0 0 1 /end COMPU_METHOD
/begin CHARACTERISTIC OILP_stat_ena "OILP statistics{OILP_stat_ena&0xff=0:Disabled}{OILP_stat_ena&0xff=1:Enabled}" VALUE 0x001c8863 /* @ECU_Address@OILP_stat_ena@0x01015190@ */ ECIPP_ALIGNMENT_UBYTE 255 OILP_stat_ena_COMPU_VTAB 0 255 BIT_MASK 0xff /end CHARACTERISTIC
/begin COMPU_METHOD OILP_stat_ena_COMPU_VTAB "Verbal Table" TAB_VERB "%.0" "list" COMPU_TAB_REF OILP_stat_ena_COMPU_VTAB_REF /end COMPU_METHOD
/begin COMPU_VTAB OILP_stat_ena_COMPU_VTAB_REF "Verbal Table" TAB_VERB 2 0 "Disabled" 1 "Enabled" DEFAULT_VALUE "UNKNOWN" /end COMPU_VTAB
/begin CHARACTERISTIC OILP_stat_lo_trig "OILP low hour meter trigger" VALUE 0x001c7e04 /* @ECU_Address@OILP_stat_lo_trig@0x01015198@ */ ECIPP_ALIGNMENT_UWORD 256 Compu_OILP_stat_lo_trig 0 255.99609375 /end CHARACTERISTIC
/begin COMPU_METHOD Compu_OILP_stat_lo_trig " " RAT_FUNC "%.1" "psig" COEFFS 0 256 0 0 0 1 /end COMPU_METHOD
/begin MEASUREMENT OILP_stat_reset_usr "OILP statistics reset" UWORD Compu_OILP_stat_reset_usr 0 0 0 65535 ECU_ADDRESS 0x010151A8 /end MEASUREMENT
/begin COMPU_METHOD Compu_OILP_stat_reset_usr " " RAT_FUNC "%.0" "-" COEFFS 0 1 0 0 0 1 /end COMPU_METHOD
/begin MEASUREMENT OILP_stat_min "OILP min" UWORD Compu_OILP_stat_min 0 0 0 255.99609375 ECU_ADDRESS 0x010151B0 /end MEASUREMENT
/begin COMPU_METHOD Compu_OILP_stat_min " " RAT_FUNC "%.1" "psig" COEFFS 0 256 0 0 0 1 /end COMPU_METHOD
/begin MEASUREMENT OILP_stat_lo_HM "OILP low hour meter" ULONG Compu_OILP_stat_lo_HM 0 0 0 1193046.47083333 ECU_ADDRESS 0x010151B8 /end MEASUREMENT
/begin COMPU_METHOD Compu_OILP_stat_lo_HM " " RAT_FUNC "%.3" "hours" COEFFS 0 3600 0 0 0 1 /end COMPU_METHOD
/begin CHARACTERISTIC OILP_stat_lo_wait "OILP low runtime wait" VALUE 0x001c42c8 /* @ECU_Address@OILP_stat_lo_wait@0x010151C0@ */ ECIPP_ALIGNMENT_ULONG 4294967 Compu_OILP_stat_lo_wait 0 4294967.295 /end CHARACTERISTIC
/begin COMPU_METHOD Compu_OILP_stat_lo_wait " " RAT_FUNC "%.1" "sec" COEFFS 0 1000 0 0 0 1 /end COMPU_METHOD
/begin CHARACTERISTIC OILP_stat_low_rpm "OILP low RPM limit" VALUE 0x001c7e06 /* @ECU_Address@OILP_stat_low_rpm@0x010151C8@ */ ECIPP_ALIGNMENT_UWORD 65535 Compu_OILP_stat_low_rpm 0 65535 /end CHARACTERISTIC
/begin COMPU_METHOD Compu_OILP_stat_low_rpm " " RAT_FUNC "%.0" "rpm" COEFFS 0 1 0 0 0 1 /end COMPU_METHOD
/begin MEASUREMENT RPM_stat_hi_acc "RPM high accumulated" ULONG Compu_RPM_stat_hi_acc 0 0 0 1193.04647083333 ECU_ADDRESS 0x01015350 /end MEASUREMENT
/begin COMPU_METHOD Compu_RPM_stat_hi_acc " " RAT_FUNC "%.3" "hours" COEFFS 0 3600000 0 0 0 1 /end COMPU_METHOD
/begin CHARACTERISTIC Tspka_base_CAD "Gasoline Base Spark Advance" MAP 0x001C2FDE /* @ECU_Address@Tspka_base_CAD@0x02011000@ */ ECIPP_ALIGNMENT_SWORD 2048 Compu_Tspka_base_CAD -2048 2047.9375
 /begin AXIS_DESCR COM_AXIS NO_INPUT_QUANTITY Compu_Tspka_base_MAP 16 -128 127.99609375 AXIS_PTS_REF Tspka_base_MAP /end AXIS_DESCR
 /begin AXIS_DESCR COM_AXIS NO_INPUT_QUANTITY Compu_Tspka_base_rpm 16 -32768 32767 AXIS_PTS_REF Tspka_base_rpm /end AXIS_DESCR
/end CHARACTERISTIC
/begin AXIS_PTS Tspka_base_MAP " " 0x001C31DE /* @ECU_Address@Tspka_base_MAP@0x02012000@ */ NO_INPUT_QUANTITY ECIPP_Lookup_SWORD 0 Compu_Tspka_base_MAP 16 -128 127.99609375 /end AXIS_PTS
/begin AXIS_PTS Tspka_base_rpm " " 0x001C31FE /* @ECU_Address@Tspka_base_rpm@0x02013000@ */ NO_INPUT_QUANTITY ECIPP_Lookup_SWORD 0 Compu_Tspka_base_rpm 16 -32768 32767 /end AXIS_PTS
/begin COMPU_METHOD Compu_Tspka_base_CAD "" RAT_FUNC "%.1" "CAD BTDC" COEFFS 0 16 0 0 0 1 /end COMPU_METHOD
/begin COMPU_METHOD Compu_Tspka_base_MAP " " RAT_FUNC "%.1" "MAP load (psia)" COEFFS 0 256 0 0 0 1 /end COMPU_METHOD
/begin COMPU_METHOD Compu_Tspka_base_rpm " " RAT_FUNC "%.0" "Speed (rpm)" COEFFS 0 1 0 0 0 1 /end COMPU_METHOD
/begin COMPU_METHOD Compu_Tspko_ECTvL_ECT " " RAT_FUNC "%.0" "CHT (deg F)" COEFFS 0 32 14720 0 0 1 /end COMPU_METHOD
/begin COMPU_METHOD Compu_Tspko_ECTvL_MAP " " RAT_FUNC "%.1" "MAP load (psia)" COEFFS 0 256 0 0 0 1 /end COMPU_METHOD
/begin CHARACTERISTIC Tspko_ECTvL_CAD "Gasoline CHT Spark Offset" MAP 0x001C321E /* @ECU_Address@Tspko_ECTvL_CAD@0x02032000@ */ ECIPP_ALIGNMENT_SWORD 2048 Compu_Tspko_ECTvL_CAD -2048 2047.9375
 /begin AXIS_DESCR COM_AXIS NO_INPUT_QUANTITY Compu_Tspko_ECTvL_MAP 8 -128 127.99609375 AXIS_PTS_REF Tspko_ECTvL_MAP /end AXIS_DESCR
 /begin AXIS_DESCR COM_AXIS NO_INPUT_QUANTITY Compu_Tspko_ECTvL_ECT 16 -1484 563.96875 AXIS_PTS_REF Tspko_ECTvL_ECT /end AXIS_DESCR
/end CHARACTERISTIC
/begin AXIS_PTS Tspko_ECTvL_MAP " " 0x001C333E /* @ECU_Address@Tspko_ECTvL_MAP@0x02031000@ */ NO_INPUT_QUANTITY ECIPP_Lookup_SWORD 0 Compu_Tspko_ECTvL_MAP 8 -128 127.99609375 /end AXIS_PTS
/begin AXIS_PTS Tspko_ECTvL_ECT " " 0x001C331E /* @ECU_Address@Tspko_ECTvL_ECT@0x02030000@ */ NO_INPUT_QUANTITY ECIPP_Lookup_SWORD 0 Compu_Tspko_ECTvL_ECT 16 -1484 563.96875 /end AXIS_PTS
/begin COMPU_METHOD Compu_Tspko_ECTvL_CAD "" RAT_FUNC "%.1" "CAD" COEFFS 0 16 0 0 0 1 /end COMPU_METHOD
/begin COMPU_METHOD Compu_Tspko_MATvL_MAT " " RAT_FUNC "%.0" "MAT (deg F)" COEFFS 0 32 14720 0 0 1 /end COMPU_METHOD
/begin COMPU_METHOD Compu_Tspko_MATvL_MAP " " RAT_FUNC "%.1" "MAP load (psia)" COEFFS 0 256 0 0 0 1 /end COMPU_METHOD
/begin CHARACTERISTIC Tspko_MATvL_CAD "Gasoline MAT Spark Offset" MAP 0x001C334E /* @ECU_Address@Tspko_MATvL_CAD@0x02035000@ */ ECIPP_ALIGNMENT_SWORD 2048 Compu_Tspko_MATvL_CAD -2048 2047.9375
 /begin AXIS_DESCR COM_AXIS NO_INPUT_QUANTITY Compu_Tspko_MATvL_MAP 8 -128 127.99609375 AXIS_PTS_REF Tspko_MATvL_MAP /end AXIS_DESCR
 /begin AXIS_DESCR COM_AXIS NO_INPUT_QUANTITY Compu_Tspko_MATvL_MAT 16 -1484 563.96875 AXIS_PTS_REF Tspko_MATvL_MAT /end AXIS_DESCR
/end CHARACTERISTIC
/begin AXIS_PTS Tspko_MATvL_MAP " " 0x001C344E /* @ECU_Address@Tspko_MATvL_MAP@0x02034000@ */ NO_INPUT_QUANTITY ECIPP_Lookup_SWORD 0 Compu_Tspko_MATvL_MAP 8 -128 127.99609375 /end AXIS_PTS
/begin AXIS_PTS Tspko_MATvL_MAT " " 0x001C345E /* @ECU_Address@Tspko_MATvL_MAT@0x02033000@ */ NO_INPUT_QUANTITY ECIPP_Lookup_SWORD 0 Compu_Tspko_MATvL_MAT 16 -1484 563.96875 /end AXIS_PTS
/begin COMPU_METHOD Compu_Tspko_MATvL_CAD "" RAT_FUNC "%.1" "CAD" COEFFS 0 16 0 0 0 1 /end COMPU_METHOD
/begin COMPU_METHOD Compu_Tmod_ECT_ECT " " RAT_FUNC "%.0" "CHT (deg F)" COEFFS 0 32 14720 0 0 1 /end COMPU_METHOD
/begin CHARACTERISTIC Tspko_ECT_CAD "Spark CHT Offset" CURVE 0x001C69D8 /* @ECU_Address@Tspko_ECT_CAD@0x02037000@ */ ECIPP_ALIGNMENT_SWORD 2048 Compu_Tspko_ECT_CAD -2048 2047.9375
 /begin AXIS_DESCR COM_AXIS NO_INPUT_QUANTITY Compu_Tmod_ECT_ECT 16 -1484 563.96875 AXIS_PTS_REF Tmod_ECT_ECT /end AXIS_DESCR
/end CHARACTERISTIC
/begin AXIS_PTS Tmod_ECT_ECT " " 0x001C661C /* @ECU_Address@Tmod_ECT_ECT@0x02036000@ */ NO_INPUT_QUANTITY ECIPP_Lookup_SWORD 0 Compu_Tmod_ECT_ECT 16 -1484 563.96875 /end AXIS_PTS
/begin COMPU_METHOD Compu_Tspko_ECT_CAD " " RAT_FUNC "%.1" "CAD" COEFFS 0 16 0 0 0 1 /end COMPU_METHOD
/begin CHARACTERISTIC Tspka_baseNG_CAD "NG Base Spark Advance" MAP 0x001C2452 /* @ECU_Address@Tspka_baseNG_CAD@0x02049000@ */ ECIPP_ALIGNMENT_SWORD 2048 Compu_Tspka_baseNG_CAD -2048 2047.9375
 /begin AXIS_DESCR COM_AXIS NO_INPUT_QUANTITY Compu_Tspka_baseNG_MAP 16 -128 127.99609375 AXIS_PTS_REF Tspka_baseNG_MAP /end AXIS_DESCR
 /begin AXIS_DESCR COM_AXIS NO_INPUT_QUANTITY Compu_Tspka_baseNG_rpm 16 -32768 32767 AXIS_PTS_REF Tspka_baseNG_rpm /end AXIS_DESCR
/end CHARACTERISTIC
/begin AXIS_PTS Tspka_baseNG_MAP " " 0x001C2652 /* @ECU_Address@Tspka_baseNG_MAP@0x0204A000@ */ NO_INPUT_QUANTITY ECIPP_Lookup_SWORD 0 Compu_Tspka_baseNG_MAP 16 -128 127.99609375 /end AXIS_PTS
/begin AXIS_PTS Tspka_baseNG_rpm " " 0x001C2672 /* @ECU_Address@Tspka_baseNG_rpm@0x0204B000@ */ NO_INPUT_QUANTITY ECIPP_Lookup_SWORD 0 Compu_Tspka_baseNG_rpm 16 -32768 32767 /end AXIS_PTS
/begin COMPU_METHOD Compu_Tspka_baseNG_CAD "" RAT_FUNC "%.1" "CAD BTDC" COEFFS 0 16 0 0 0 1 /end COMPU_METHOD
/begin COMPU_METHOD Compu_Tspka_baseNG_MAP " " RAT_FUNC "%.1" "MAP load (psia)" COEFFS 0 256 0 0 0 1 /end COMPU_METHOD
/begin COMPU_METHOD Compu_Tspka_baseNG_rpm " " RAT_FUNC "%.0" "Speed (rpm)" COEFFS 0 1 0 0 0 1 /end COMPU_METHOD
/begin COMPU_METHOD Compu_Tspko_ECTvLNG_ECT " " RAT_FUNC "%.0" "CHT (deg F)" COEFFS 0 32 14720 0 0 1 /end COMPU_METHOD
/begin COMPU_METHOD Compu_Tspko_ECTvLNG_MAP " " RAT_FUNC "%.1" "MAP load (psia)" COEFFS 0 256 0 0 0 1 /end COMPU_METHOD
/begin CHARACTERISTIC Tspko_ECTvLNG_CAD "NG CHT Spark Offset" MAP 0x001C2692 /* @ECU_Address@Tspko_ECTvLNG_CAD@0x0204E000@ */ ECIPP_ALIGNMENT_SWORD 2048 Compu_Tspko_ECTvLNG_CAD -2048 2047.9375
 /begin AXIS_DESCR COM_AXIS NO_INPUT_QUANTITY Compu_Tspko_ECTvLNG_MAP 8 -128 127.99609375 AXIS_PTS_REF Tspko_ECTvLNG_MAP /end AXIS_DESCR
 /begin AXIS_DESCR COM_AXIS NO_INPUT_QUANTITY Compu_Tspko_ECTvLNG_ECT 16 -1484 563.96875 AXIS_PTS_REF Tspko_ECTvLNG_ECT /end AXIS_DESCR
/end CHARACTERISTIC
/begin AXIS_PTS Tspko_ECTvLNG_MAP " " 0x001C27B2 /* @ECU_Address@Tspko_ECTvLNG_MAP@0x0204D000@ */ NO_INPUT_QUANTITY ECIPP_Lookup_SWORD 0 Compu_Tspko_ECTvLNG_MAP 8 -128 127.99609375 /end AXIS_PTS
/begin AXIS_PTS Tspko_ECTvLNG_ECT " " 0x001C2792 /* @ECU_Address@Tspko_ECTvLNG_ECT@0x0204C000@ */ NO_INPUT_QUANTITY ECIPP_Lookup_SWORD 0 Compu_Tspko_ECTvLNG_ECT 16 -1484 563.96875 /end AXIS_PTS
/begin COMPU_METHOD Compu_Tspko_ECTvLNG_CAD "" RAT_FUNC "%.1" "CAD" COEFFS 0 16 0 0 0 1 /end COMPU_METHOD
/begin COMPU_METHOD Compu_Tspko_MATvLNG_MAT " " RAT_FUNC "%.0" "MAT (deg F)" COEFFS 0 32 14720 0 0 1 /end COMPU_METHOD
/begin COMPU_METHOD Compu_Tspko_MATvLNG_MAP " " RAT_FUNC "%.1" "MAP load (psia)" COEFFS 0 256 0 0 0 1 /end COMPU_METHOD
/begin CHARACTERISTIC Tspko_MATvLNG_CAD "NG MAT Spark Offset" MAP 0x001C27C2 /* @ECU_Address@Tspko_MATvLNG_CAD@0x02051000@ */ ECIPP_ALIGNMENT_SWORD 2048 Compu_Tspko_MATvLNG_CAD -2048 2047.9375
 /begin AXIS_DESCR COM_AXIS NO_INPUT_QUANTITY Compu_Tspko_MATvLNG_MAP 8 -128 127.99609375 AXIS_PTS_REF Tspko_MATvLNG_MAP /end AXIS_DESCR
 /begin AXIS_DESCR COM_AXIS NO_INPUT_QUANTITY Compu_Tspko_MATvLNG_MAT 16 -1484 563.96875 AXIS_PTS_REF Tspko_MATvLNG_MAT /end AXIS_DESCR
/end CHARACTERISTIC
/begin AXIS_PTS Tspko_MATvLNG_MAP " " 0x001C28C2 /* @ECU_Address@Tspko_MATvLNG_MAP@0x02050000@ */ NO_INPUT_QUANTITY ECIPP_Lookup_SWORD 0 Compu_Tspko_MATvLNG_MAP 8 -128 127.99609375 /end AXIS_PTS
/begin AXIS_PTS Tspko_MATvLNG_MAT " " 0x001C28D2 /* @ECU_Address@Tspko_MATvLNG_MAT@0x0204F000@ */ NO_INPUT_QUANTITY ECIPP_Lookup_SWORD 0 Compu_Tspko_MATvLNG_MAT 16 -1484 563.96875 /end AXIS_PTS
/begin COMPU_METHOD Compu_Tspko_MATvLNG_CAD "" RAT_FUNC "%.1" "CAD" COEFFS 0 16 0 0 0 1 /end COMPU_METHOD
/begin CHARACTERISTIC Tspka_baseP_CAD "LPG Base Spark Advance" MAP 0x001C14E8 /* @ECU_Address@Tspka_baseP_CAD@0x02052000@ */ ECIPP_ALIGNMENT_SWORD 2048 Compu_Tspka_baseP_CAD -2048 2047.9375
 /begin AXIS_DESCR COM_AXIS NO_INPUT_QUANTITY Compu_Tspka_baseP_MAP 16 -128 127.99609375 AXIS_PTS_REF Tspka_baseP_MAP /end AXIS_DESCR
 /begin AXIS_DESCR COM_AXIS NO_INPUT_QUANTITY Compu_Tspka_baseP_rpm 16 -32768 32767 AXIS_PTS_REF Tspka_baseP_rpm /end AXIS_DESCR
/end CHARACTERISTIC
/begin AXIS_PTS Tspka_baseP_MAP " " 0x001C16E8 /* @ECU_Address@Tspka_baseP_MAP@0x02053000@ */ NO_INPUT_QUANTITY ECIPP_Lookup_SWORD 0 Compu_Tspka_baseP_MAP 16 -128 127.99609375 /end AXIS_PTS
/begin AXIS_PTS Tspka_baseP_rpm " " 0x001C1708 /* @ECU_Address@Tspka_baseP_rpm@0x02054000@ */ NO_INPUT_QUANTITY ECIPP_Lookup_SWORD 0 Compu_Tspka_baseP_rpm 16 -32768 32767 /end AXIS_PTS
/begin COMPU_METHOD Compu_Tspka_baseP_CAD "" RAT_FUNC "%.1" "CAD BTDC" COEFFS 0 16 0 0 0 1 /end COMPU_METHOD
/begin COMPU_METHOD Compu_Tspka_baseP_MAP " " RAT_FUNC "%.1" "MAP load (psia)" COEFFS 0 256 0 0 0 1 /end COMPU_METHOD
/begin COMPU_METHOD Compu_Tspka_baseP_rpm " " RAT_FUNC "%.0" "Speed (rpm)" COEFFS 0 1 0 0 0 1 /end COMPU_METHOD
/begin COMPU_METHOD Compu_Tspko_ECTvLP_ECT " " RAT_FUNC "%.0" "CHT (deg F)" COEFFS 0 32 14720 0 0 1 /end COMPU_METHOD
/begin COMPU_METHOD Compu_Tspko_ECTvLP_MAP " " RAT_FUNC "%.1" "MAP load (psia)" COEFFS 0 256 0 0 0 1 /end COMPU_METHOD
/begin CHARACTERISTIC Tspko_ECTvLP_CAD "LPG CHT Spark Offset" MAP 0x001C1728 /* @ECU_Address@Tspko_ECTvLP_CAD@0x02057000@ */ ECIPP_ALIGNMENT_SWORD 2048 Compu_Tspko_ECTvLP_CAD -2048 2047.9375
 /begin AXIS_DESCR COM_AXIS NO_INPUT_QUANTITY Compu_Tspko_ECTvLP_MAP 8 -128 127.99609375 AXIS_PTS_REF Tspko_ECTvLP_MAP /end AXIS_DESCR
 /begin AXIS_DESCR COM_AXIS NO_INPUT_QUANTITY Compu_Tspko_ECTvLP_ECT 16 -1484 563.96875 AXIS_PTS_REF Tspko_ECTvLP_ECT /end AXIS_DESCR
/end CHARACTERISTIC
/begin AXIS_PTS Tspko_ECTvLP_MAP " " 0x001C1848 /* @ECU_Address@Tspko_ECTvLP_MAP@0x02056000@ */ NO_INPUT_QUANTITY ECIPP_Lookup_SWORD 0 Compu_Tspko_ECTvLP_MAP 8 -128 127.99609375 /end AXIS_PTS
/begin AXIS_PTS Tspko_ECTvLP_ECT " " 0x001C1828 /* @ECU_Address@Tspko_ECTvLP_ECT@0x02055000@ */ NO_INPUT_QUANTITY ECIPP_Lookup_SWORD 0 Compu_Tspko_ECTvLP_ECT 16 -1484 563.96875 /end AXIS_PTS
/begin COMPU_METHOD Compu_Tspko_ECTvLP_CAD "" RAT_FUNC "%.1" "CAD" COEFFS 0 16 0 0 0 1 /end COMPU_METHOD
/begin COMPU_METHOD Compu_Tspko_MATvLP_MAT " " RAT_FUNC "%.0" "MAT (deg F)" COEFFS 0 32 14720 0 0 1 /end COMPU_METHOD
/begin COMPU_METHOD Compu_Tspko_MATvLP_MAP " " RAT_FUNC "%.1" "MAP load (psia)" COEFFS 0 256 0 0 0 1 /end COMPU_METHOD
/begin CHARACTERISTIC Tspko_MATvLP_CAD "LPG MAT Spark Offset" MAP 0x001C1858 /* @ECU_Address@Tspko_MATvLP_CAD@0x0205A000@ */ ECIPP_ALIGNMENT_SWORD 2048 Compu_Tspko_MATvLP_CAD -2048 2047.9375
 /begin AXIS_DESCR COM_AXIS NO_INPUT_QUANTITY Compu_Tspko_MATvLP_MAP 8 -128 127.99609375 AXIS_PTS_REF Tspko_MATvLP_MAP /end AXIS_DESCR
 /begin AXIS_DESCR COM_AXIS NO_INPUT_QUANTITY Compu_Tspko_MATvLP_MAT 16 -1484 563.96875 AXIS_PTS_REF Tspko_MATvLP_MAT /end AXIS_DESCR
/end CHARACTERISTIC
/begin AXIS_PTS Tspko_MATvLP_MAP " " 0x001C1958 /* @ECU_Address@Tspko_MATvLP_MAP@0x02059000@ */ NO_INPUT_QUANTITY ECIPP_Lookup_SWORD 0 Compu_Tspko_MATvLP_MAP 8 -128 127.99609375 /end AXIS_PTS
/begin AXIS_PTS Tspko_MATvLP_MAT " " 0x001C1968 /* @ECU_Address@Tspko_MATvLP_MAT@0x02058000@ */ NO_INPUT_QUANTITY ECIPP_Lookup_SWORD 0 Compu_Tspko_MATvLP_MAT 16 -1484 563.96875 /end AXIS_PTS
/begin COMPU_METHOD Compu_Tspko_MATvLP_CAD "" RAT_FUNC "%.1" "CAD" COEFFS 0 16 0 0 0 1 /end COMPU_METHOD
/begin COMPU_METHOD Compu_Tspko_cyl_rpm " " RAT_FUNC "%.0" "Speed (rpm)" COEFFS 0 1 0 0 0 1 /end COMPU_METHOD
/begin COMPU_METHOD Compu_Tspko_cyl_MAP " " RAT_FUNC "%.1" "MAP (psia)" COEFFS 0 256 0 0 0 1 /end COMPU_METHOD
/begin CHARACTERISTIC Tspko_cyl_CAD "Cylinder Base Spark Advance Offset" MAP 0x001C69F8 /* @ECU_Address@Tspko_cyl_CAD@0x02189000@ */ ECIPP_ALIGNMENT_SWORD 2048 Compu_Tspko_cyl_CAD -2048 2047.9375
 /begin AXIS_DESCR COM_AXIS NO_INPUT_QUANTITY Compu_Tspko_cyl_MAP 8 -128 127.99609375 AXIS_PTS_REF Tspko_cyl_MAP /end AXIS_DESCR
 /begin AXIS_DESCR COM_AXIS NO_INPUT_QUANTITY Compu_Tspko_cyl_rpm 8 -32768 32767 AXIS_PTS_REF Tspko_cyl_rpm /end AXIS_DESCR
/end CHARACTERISTIC
/begin AXIS_PTS Tspko_cyl_MAP " " 0x001C6A78 /* @ECU_Address@Tspko_cyl_MAP@0x02188000@ */ NO_INPUT_QUANTITY ECIPP_Lookup_SWORD 0 Compu_Tspko_cyl_MAP 8 -128 127.99609375 /end AXIS_PTS
/begin AXIS_PTS Tspko_cyl_rpm " " 0x001C6A88 /* @ECU_Address@Tspko_cyl_rpm@0x02187000@ */ NO_INPUT_QUANTITY ECIPP_Lookup_SWORD 0 Compu_Tspko_cyl_rpm 8 -32768 32767 /end AXIS_PTS
/begin COMPU_METHOD Compu_Tspko_cyl_CAD "" RAT_FUNC "%.1" "CAD advance" COEFFS 0 16 0 0 0 1 /end COMPU_METHOD
/begin COMPU_METHOD Compu_dwell_Vbat_tbl " " RAT_FUNC "%.2" "Vbat (volts)" COEFFS 0 256 0 0 0 1 /end COMPU_METHOD
/begin CHARACTERISTIC dwell_nom_tbl "Nominal dwell schedule" CURVE 0x001C6CF6 /* @ECU_Address@dwell_nom_tbl@0x02201000@ */ ECIPP_ALIGNMENT_SWORD 105 Compu_dwell_nom_tbl -104.8576 104.8544
 /begin AXIS_DESCR COM_AXIS NO_INPUT_QUANTITY Compu_dwell_Vbat_tbl 16 -128 127.99609375 AXIS_PTS_REF dwell_Vbat_tbl /end AXIS_DESCR
/end CHARACTERISTIC
/begin AXIS_PTS dwell_Vbat_tbl " " 0x001C6C6C /* @ECU_Address@dwell_Vbat_tbl@0x02200000@ */ NO_INPUT_QUANTITY ECIPP_Lookup_SWORD 0 Compu_dwell_Vbat_tbl 16 -128 127.99609375 /end AXIS_PTS
/begin COMPU_METHOD Compu_dwell_nom_tbl " " RAT_FUNC "%.2" "Dwell (ms)" COEFFS 0 312.5 0 0 0 1 /end COMPU_METHOD
/begin MEASUREMENT dwell_extmod_coils "Coil1 ext diag sample" UWORD Compu_dwell_extmod_coils 0 0 0 5.00114468864469 ECU_ADDRESS 0x0220B000 MATRIX_DIM 10 1 1 /end MEASUREMENT
/begin COMPU_METHOD Compu_dwell_extmod_coils " " RAT_FUNC "%.3" "V" COEFFS 0 13104 0 0 0 1 /end COMPU_METHOD
/begin COMPU_METHOD Compu_TSRVC_rpm " " RAT_FUNC "%.0" "Speed (rpm)" COEFFS 0 1 0 0 0 1 /end COMPU_METHOD
/begin COMPU_METHOD Compu_TSRVC_MAP " " RAT_FUNC "%.1" "MAP (psia)" COEFFS 0 256 0 0 0 1 /end COMPU_METHOD
/begin CHARACTERISTIC TSRVC_intervals "Service Notification Calibration" MAP 0x001C5944 /* @ECU_Address@TSRVC_intervals@0x0225A000@ */ ECIPP_ALIGNMENT_SWORD 16384 Compu_TSRVC_intervals -16384 16383.5
 /begin AXIS_DESCR COM_AXIS NO_INPUT_QUANTITY Compu_TSRVC_MAP 6 -128 127.99609375 AXIS_PTS_REF TSRVC_MAP /end AXIS_DESCR
 /begin AXIS_DESCR COM_AXIS NO_INPUT_QUANTITY Compu_TSRVC_rpm 6 -32768 32767 AXIS_PTS_REF TSRVC_rpm /end AXIS_DESCR
/end CHARACTERISTIC
/begin AXIS_PTS TSRVC_MAP " " 0x001C5938 /* @ECU_Address@TSRVC_MAP@0x02259000@ */ NO_INPUT_QUANTITY ECIPP_Lookup_SWORD 0 Compu_TSRVC_MAP 6 -128 127.99609375 /end AXIS_PTS
/begin AXIS_PTS TSRVC_rpm " " 0x001C598C /* @ECU_Address@TSRVC_rpm@0x02258000@ */ NO_INPUT_QUANTITY ECIPP_Lookup_SWORD 0 Compu_TSRVC_rpm 6 -32768 32767 /end AXIS_PTS
/begin COMPU_METHOD Compu_TSRVC_intervals "" RAT_FUNC "%.1" "Speed/Load Service Intervals (hours)" COEFFS 0 2 0 0 0 1 /end COMPU_METHOD
/begin COMPU_METHOD Compu_dwell_ls_mult_MAP " " RAT_FUNC "%.1" "MAP load (psia)" COEFFS 0 256 0 0 0 1 /end COMPU_METHOD
/begin COMPU_METHOD Compu_dwell_ls_mult_rpm " " RAT_FUNC "%.0" "Speed (rpm)" COEFFS 0 1 0 0 0 1 /end COMPU_METHOD
/begin CHARACTERISTIC dwell_ls_mult "Dwell Adapt Target Multiplier" MAP 0x001C6C96 /* @ECU_Address@dwell_ls_mult@0x02354000@ */ ECIPP_ALIGNMENT_SWORD 32 Compu_dwell_ls_mult -32 31.9990234375
 /begin AXIS_DESCR COM_AXIS NO_INPUT_QUANTITY Compu_dwell_ls_mult_MAP 6 -128 127.99609375 AXIS_PTS_REF dwell_ls_mult_MAP /end AXIS_DESCR
 /begin AXIS_DESCR COM_AXIS NO_INPUT_QUANTITY Compu_dwell_ls_mult_rpm 6 -32768 32767 AXIS_PTS_REF dwell_ls_mult_rpm /end AXIS_DESCR
/end CHARACTERISTIC
/begin AXIS_PTS dwell_ls_mult_MAP " " 0x001C6CDE /* @ECU_Address@dwell_ls_mult_MAP@0x02352000@ */ NO_INPUT_QUANTITY ECIPP_Lookup_SWORD 0 Compu_dwell_ls_mult_MAP 6 -128 127.99609375 /end AXIS_PTS
/begin AXIS_PTS dwell_ls_mult_rpm " " 0x001C6CEA /* @ECU_Address@dwell_ls_mult_rpm@0x02353000@ */ NO_INPUT_QUANTITY ECIPP_Lookup_SWORD 0 Compu_dwell_ls_mult_rpm 6 -32768 32767 /end AXIS_PTS
/begin COMPU_METHOD Compu_dwell_ls_mult "" RAT_FUNC "%.3" "Dwell Multiplier" COEFFS 0 1024 0 0 0 1 /end COMPU_METHOD
/begin MEASUREMENT STR_enov_slnk_u8_1 "simulink_u8_1" UBYTE Compu_ECIPP_STRINGS 0 0 0 255 ECU_ADDRESS 0x0255B000 MATRIX_DIM 24 1 1 /end MEASUREMENT
/begin MEASUREMENT STR_enov_slnk_u8_2 "simulink_u8_2" UBYTE Compu_ECIPP_STRINGS 0 0 0 255 ECU_ADDRESS 0x0255C000 MATRIX_DIM 24 1 1 /end MEASUREMENT
/begin MEASUREMENT STR_enov_slnk_u8_3 "simulink_u8_3" UBYTE Compu_ECIPP_STRINGS 0 0 0 255 ECU_ADDRESS 0x0255D000 MATRIX_DIM 24 1 1 /end MEASUREMENT
/begin MEASUREMENT STR_enov_slnk_u8_4 "simulink_u8_4" UBYTE Compu_ECIPP_STRINGS 0 0 0 255 ECU_ADDRESS 0x0255E000 MATRIX_DIM 24 1 1 /end MEASUREMENT
/begin MEASUREMENT STR_enov_slnk_u8_5 "simulink_u8_5" UBYTE Compu_ECIPP_STRINGS 0 0 0 255 ECU_ADDRESS 0x0255F000 MATRIX_DIM 24 1 1 /end MEASUREMENT
/begin MEASUREMENT STR_enov_slnk_u8_6 "simulink_u8_6" UBYTE Compu_ECIPP_STRINGS 0 0 0 255 ECU_ADDRESS 0x02560000 MATRIX_DIM 24 1 1 /end MEASUREMENT
/begin MEASUREMENT STR_enov_slnk_u8_7 "simulink_u8_7" UBYTE Compu_ECIPP_STRINGS 0 0 0 255 ECU_ADDRESS 0x02561000 MATRIX_DIM 24 1 1 /end MEASUREMENT
/begin MEASUREMENT STR_enov_slnk_u8_8 "simulink_u8_8" UBYTE Compu_ECIPP_STRINGS 0 0 0 255 ECU_ADDRESS 0x02562000 MATRIX_DIM 24 1 1 /end MEASUREMENT
/begin MEASUREMENT STR_enov_slnk_u8_9 "simulink_u8_9" UBYTE Compu_ECIPP_STRINGS 0 0 0 255 ECU_ADDRESS 0x02563000 MATRIX_DIM 24 1 1 /end MEASUREMENT
/begin MEASUREMENT STR_enov_slnk_u8_10 "simulink_u8_10" UBYTE Compu_ECIPP_STRINGS 0 0 0 255 ECU_ADDRESS 0x02564000 MATRIX_DIM 24 1 1 /end MEASUREMENT
/begin MEASUREMENT STR_enov_slnk_u8_11 "simulink_u8_11" UBYTE Compu_ECIPP_STRINGS 0 0 0 255 ECU_ADDRESS 0x02565000 MATRIX_DIM 24 1 1 /end MEASUREMENT
/begin MEASUREMENT STR_enov_slnk_u8_12 "simulink_u8_12" UBYTE Compu_ECIPP_STRINGS 0 0 0 255 ECU_ADDRESS 0x02566000 MATRIX_DIM 24 1 1 /end MEASUREMENT
/begin MEASUREMENT STR_enov_slnk_u8_13 "simulink_u8_13" UBYTE Compu_ECIPP_STRINGS 0 0 0 255 ECU_ADDRESS 0x02567000 MATRIX_DIM 24 1 1 /end MEASUREMENT
/begin MEASUREMENT STR_enov_slnk_u8_14 "simulink_u8_14" UBYTE Compu_ECIPP_STRINGS 0 0 0 255 ECU_ADDRESS 0x02568000 MATRIX_DIM 24 1 1 /end MEASUREMENT
/begin MEASUREMENT STR_enov_slnk_u8_15 "simulink_u8_15" UBYTE Compu_ECIPP_STRINGS 0 0 0 255 ECU_ADDRESS 0x02569000 MATRIX_DIM 24 1 1 /end MEASUREMENT
/begin MEASUREMENT STR_enov_slnk_u8_16 "simulink_u8_16" UBYTE Compu_ECIPP_STRINGS 0 0 0 255 ECU_ADDRESS 0x0256A000 MATRIX_DIM 24 1 1 /end MEASUREMENT
/begin MEASUREMENT STR_enov_slnk_u8_17 "simulink_u8_17" UBYTE Compu_ECIPP_STRINGS 0 0 0 255 ECU_ADDRESS 0x0256B000 MATRIX_DIM 24 1 1 /end MEASUREMENT
/begin MEASUREMENT STR_enov_slnk_u8_18 "simulink_u8_18" UBYTE Compu_ECIPP_STRINGS 0 0 0 255 ECU_ADDRESS 0x0256C000 MATRIX_DIM 24 1 1 /end MEASUREMENT
/begin MEASUREMENT STR_enov_slnk_u8_19 "simulink_u8_19" UBYTE Compu_ECIPP_STRINGS 0 0 0 255 ECU_ADDRESS 0x0256D000 MATRIX_DIM 24 1 1 /end MEASUREMENT
/begin MEASUREMENT STR_enov_slnk_u8_20 "simulink_u8_20" UBYTE Compu_ECIPP_STRINGS 0 0 0 255 ECU_ADDRESS 0x0256E000 MATRIX_DIM 24 1 1 /end MEASUREMENT
/begin MEASUREMENT STR_enov_slnk_f_1 "simulink_float_1" UBYTE Compu_ECIPP_STRINGS 0 0 0 255 ECU_ADDRESS 0x0256F000 MATRIX_DIM 24 1 1 /end MEASUREMENT
/begin MEASUREMENT STR_enov_slnk_f_2 "simulink_float_2" UBYTE Compu_ECIPP_STRINGS 0 0 0 255 ECU_ADDRESS 0x02570000 MATRIX_DIM 24 1 1 /end MEASUREMENT
/begin MEASUREMENT STR_enov_slnk_f_3 "simulink_float_3" UBYTE Compu_ECIPP_STRINGS 0 0 0 255 ECU_ADDRESS 0x02571000 MATRIX_DIM 24 1 1 /end MEASUREMENT
/begin MEASUREMENT STR_enov_slnk_f_4 "simulink_float_4" UBYTE Compu_ECIPP_STRINGS 0 0 0 255 ECU_ADDRESS 0x02572000 MATRIX_DIM 24 1 1 /end MEASUREMENT
/begin MEASUREMENT STR_enov_slnk_f_5 "simulink_float_5" UBYTE Compu_ECIPP_STRINGS 0 0 0 255 ECU_ADDRESS 0x02573000 MATRIX_DIM 24 1 1 /end MEASUREMENT
/begin MEASUREMENT STR_enov_slnk_f_6 "simulink_float_6" UBYTE Compu_ECIPP_STRINGS 0 0 0 255 ECU_ADDRESS 0x02574000 MATRIX_DIM 24 1 1 /end MEASUREMENT
/begin MEASUREMENT STR_enov_slnk_f_7 "simulink_float_7" UBYTE Compu_ECIPP_STRINGS 0 0 0 255 ECU_ADDRESS 0x02575000 MATRIX_DIM 24 1 1 /end MEASUREMENT
/begin MEASUREMENT STR_enov_slnk_f_8 "simulink_float_8" UBYTE Compu_ECIPP_STRINGS 0 0 0 255 ECU_ADDRESS 0x02576000 MATRIX_DIM 24 1 1 /end MEASUREMENT
/begin MEASUREMENT STR_enov_slnk_f_9 "simulink_float_9" UBYTE Compu_ECIPP_STRINGS 0 0 0 255 ECU_ADDRESS 0x02577000 MATRIX_DIM 24 1 1 /end MEASUREMENT
/begin MEASUREMENT STR_enov_slnk_f_10 "simulink_float_10" UBYTE Compu_ECIPP_STRINGS 0 0 0 255 ECU_ADDRESS 0x02578000 MATRIX_DIM 24 1 1 /end MEASUREMENT
/begin MEASUREMENT STR_enov_slnk_f_11 "simulink_float_11" UBYTE Compu_ECIPP_STRINGS 0 0 0 255 ECU_ADDRESS 0x02579000 MATRIX_DIM 24 1 1 /end MEASUREMENT
/begin MEASUREMENT STR_enov_slnk_f_12 "simulink_float_12" UBYTE Compu_ECIPP_STRINGS 0 0 0 255 ECU_ADDRESS 0x0257A000 MATRIX_DIM 24 1 1 /end MEASUREMENT
/begin MEASUREMENT STR_enov_slnk_f_13 "simulink_float_13" UBYTE Compu_ECIPP_STRINGS 0 0 0 255 ECU_ADDRESS 0x0257B000 MATRIX_DIM 24 1 1 /end MEASUREMENT
/begin MEASUREMENT STR_enov_slnk_f_14 "simulink_float_14" UBYTE Compu_ECIPP_STRINGS 0 0 0 255 ECU_ADDRESS 0x0257C000 MATRIX_DIM 24 1 1 /end MEASUREMENT
/begin MEASUREMENT STR_enov_slnk_f_15 "simulink_float_15" UBYTE Compu_ECIPP_STRINGS 0 0 0 255 ECU_ADDRESS 0x0257D000 MATRIX_DIM 24 1 1 /end MEASUREMENT
/begin MEASUREMENT STR_enov_slnk_f_16 "simulink_float_16" UBYTE Compu_ECIPP_STRINGS 0 0 0 255 ECU_ADDRESS 0x0257E000 MATRIX_DIM 24 1 1 /end MEASUREMENT
/begin MEASUREMENT STR_enov_slnk_f_17 "simulink_float_17" UBYTE Compu_ECIPP_STRINGS 0 0 0 255 ECU_ADDRESS 0x0257F000 MATRIX_DIM 24 1 1 /end MEASUREMENT
/begin MEASUREMENT STR_enov_slnk_f_18 "simulink_float_18" UBYTE Compu_ECIPP_STRINGS 0 0 0 255 ECU_ADDRESS 0x02580000 MATRIX_DIM 24 1 1 /end MEASUREMENT
/begin MEASUREMENT STR_enov_slnk_f_19 "simulink_float_19" UBYTE Compu_ECIPP_STRINGS 0 0 0 255 ECU_ADDRESS 0x02581000 MATRIX_DIM 24 1 1 /end MEASUREMENT
/begin MEASUREMENT STR_enov_slnk_f_20 "simulink_float_20" UBYTE Compu_ECIPP_STRINGS 0 0 0 255 ECU_ADDRESS 0x02582000 MATRIX_DIM 24 1 1 /end MEASUREMENT
/begin CHARACTERISTIC RangeHst_ECIPP_ndx "Range history ECIPP index 1" VAL_BLK 0x001C7F0E /* @ECU_Address@RangeHst_ECIPP_ndx@0x025D5000@ */ ECIPP_ALIGNMENT_UWORD 65535 Compu_RangeHst_ECIPP_ndx 0 65535 MATRIX_DIM 20 1 1 /end CHARACTERISTIC
/begin COMPU_METHOD Compu_RangeHst_ECIPP_ndx " " RAT_FUNC "%.0" "-" COEFFS 0 1 0 0 0 1 /end COMPU_METHOD
/begin CHARACTERISTIC RangeHst_min "Range history minimum 1" VAL_BLK 0x001C4338 /* @ECU_Address@RangeHst_min@0x025D6000@ */ ECIPP_ALIGNMENT_ULONG 4294967295 Compu_RangeHst_min 0 4294967295 MATRIX_DIM 20 1 1 /end CHARACTERISTIC
/begin COMPU_METHOD Compu_RangeHst_min " " RAT_FUNC "%.0" "-" COEFFS 0 1 0 0 0 1 /end COMPU_METHOD
/begin CHARACTERISTIC RangeHst_max "Range history maximum 1" VAL_BLK 0x001C42E8 /* @ECU_Address@RangeHst_max@0x025D7000@ */ ECIPP_ALIGNMENT_ULONG 4294967295 Compu_RangeHst_max 0 4294967295 MATRIX_DIM 20 1 1 /end CHARACTERISTIC
/begin COMPU_METHOD Compu_RangeHst_max " " RAT_FUNC "%.0" "-" COEFFS 0 1 0 0 0 1 /end COMPU_METHOD
/begin MEASUREMENT RangeHst_cnt "Range history counter/timer 1" ULONG Compu_RangeHst_cnt 0 0 0 4294967295 ECU_ADDRESS 0x025D8000 MATRIX_DIM 20 1 1 /end MEASUREMENT
/begin COMPU_METHOD Compu_RangeHst_cnt " " RAT_FUNC "%.0" "-" COEFFS 0 1 0 0 0 1 /end COMPU_METHOD
/begin COMPU_METHOD Compu_Tspkret_FSOt_FSOt " " RAT_FUNC "%.1" "FSO Time (sec)" COEFFS 0 1000 0 0 0 1 /end COMPU_METHOD
/begin CHARACTERISTIC Tspkret_FSOt_hold "FSO Spark Retard Hold" CURVE 0x001C3DD4 /* @ECU_Address@Tspkret_FSOt_hold@0x025DA000@ */ ECIPP_ALIGNMENT_FLOAT32_IEEE 10000000000 Compu_Tspkret_FSOt_hold -10000000000 10000000000
 /begin AXIS_DESCR COM_AXIS NO_INPUT_QUANTITY Compu_Tspkret_FSOt_FSOt 4 -10000000000 10000000000 AXIS_PTS_REF Tspkret_FSOt_FSOt /end AXIS_DESCR
/end CHARACTERISTIC
/begin AXIS_PTS Tspkret_FSOt_FSOt " " 0x001C3DC4 /* @ECU_Address@Tspkret_FSOt_FSOt@0x025D9000@ */ NO_INPUT_QUANTITY ECIPP_Lookup_FLOAT32_IEEE 0 Compu_Tspkret_FSOt_FSOt 4 -10000000000 10000000000 /end AXIS_PTS
/begin COMPU_METHOD Compu_Tspkret_FSOt_hold " " RAT_FUNC "%.1" "Hold Time (0.5 sec)" COEFFS 0 1000 0 0 0 1 /end COMPU_METHOD
/begin COMPU_METHOD Compu_Tspkret_ECT_ECT " " RAT_FUNC "%.1" "ECT (deg F)" COEFFS 0 1 460 0 0 1 /end COMPU_METHOD
/begin CHARACTERISTIC Tspkret_ECT_hold "Engine Start Spark Retard Hold" CURVE 0x001C3DB4 /* @ECU_Address@Tspkret_ECT_hold@0x025DC000@ */ ECIPP_ALIGNMENT_FLOAT32_IEEE 10000000000 Compu_Tspkret_ECT_hold -10000000000 10000000000
 /begin AXIS_DESCR COM_AXIS NO_INPUT_QUANTITY Compu_Tspkret_ECT_ECT 4 -10000000000 10000000000 AXIS_PTS_REF Tspkret_ECT_ECT /end AXIS_DESCR
/end CHARACTERISTIC
/begin AXIS_PTS Tspkret_ECT_ECT " " 0x001C3DA4 /* @ECU_Address@Tspkret_ECT_ECT@0x025DB000@ */ NO_INPUT_QUANTITY ECIPP_Lookup_FLOAT32_IEEE 0 Compu_Tspkret_ECT_ECT 4 -10000000000 10000000000 /end AXIS_PTS
/begin COMPU_METHOD Compu_Tspkret_ECT_hold " " RAT_FUNC "%.1" "Hold Time (0.5 sec)" COEFFS 0 1000 0 0 0 1 /end COMPU_METHOD
/begin COMPU_METHOD Compu_Tspkret_MAP_MAP " " RAT_FUNC "%.2" "MAP load (psia)" COEFFS 0 256 0 0 0 1 /end COMPU_METHOD
/begin CHARACTERISTIC Tspkret_MAP_retard "MAP-based Spark Retard" CURVE 0x001C6A9C /* @ECU_Address@Tspkret_MAP_retard@0x025DE000@ */ ECIPP_ALIGNMENT_SWORD 2048 Compu_Tspkret_MAP_retard -2048 2047.9375
 /begin AXIS_DESCR COM_AXIS NO_INPUT_QUANTITY Compu_Tspkret_MAP_MAP 2 -128 127.99609375 AXIS_PTS_REF Tspkret_MAP_MAP /end AXIS_DESCR
/end CHARACTERISTIC
/begin AXIS_PTS Tspkret_MAP_MAP " " 0x001C6A98 /* @ECU_Address@Tspkret_MAP_MAP@0x025DD000@ */ NO_INPUT_QUANTITY ECIPP_Lookup_SWORD 0 Compu_Tspkret_MAP_MAP 2 -128 127.99609375 /end AXIS_PTS
/begin COMPU_METHOD Compu_Tspkret_MAP_retard " " RAT_FUNC "%.1" "Spark Retard (CAD)" COEFFS 0 16 0 0 0 1 /end COMPU_METHOD
/begin MEASUREMENT cal_grp_cksums "Group Checksum" ULONG Compu_cal_grp_cksums 0 0 0 4294967295 ECU_ADDRESS 0x025FD000 MATRIX_DIM 8 1 1 /end MEASUREMENT
/begin COMPU_METHOD Compu_cal_grp_cksums " " RAT_FUNC "%.0" "-" COEFFS 0 1 0 0 0 1 /end COMPU_METHOD
/begin CHARACTERISTIC cal_grp_revisions "Group Revisoin" VAL_BLK 0x001C8FC0 /* @ECU_Address@cal_grp_revisions@0x025FE000@ */ ECIPP_ALIGNMENT_UBYTE 255 Compu_cal_grp_revisions 0 255 MATRIX_DIM 8 1 1 /end CHARACTERISTIC
/begin COMPU_METHOD Compu_cal_grp_revisions " " RAT_FUNC "%.0" "Rev" COEFFS 0 1 0 0 0 1 /end COMPU_METHOD
/begin CHARACTERISTIC STR_cal_grp_name1 "Group 1" ASCII 0x001E99B4 /* @ECU_Address@STR_cal_grp_name1@0x02602000@ */ ECIPP_ALIGNMENT_UBYTE 255 Compu_ECIPP_STRINGS 0 255 MATRIX_DIM 11 1 1 /end CHARACTERISTIC
/begin CHARACTERISTIC STR_cal_grp_name2 "Group 2" ASCII 0x001E99C0 /* @ECU_Address@STR_cal_grp_name2@0x02603000@ */ ECIPP_ALIGNMENT_UBYTE 255 Compu_ECIPP_STRINGS 0 255 MATRIX_DIM 11 1 1 /end CHARACTERISTIC
/begin CHARACTERISTIC STR_cal_grp_name3 "Group 3" ASCII 0x001E99CC /* @ECU_Address@STR_cal_grp_name3@0x02604000@ */ ECIPP_ALIGNMENT_UBYTE 255 Compu_ECIPP_STRINGS 0 255 MATRIX_DIM 11 1 1 /end CHARACTERISTIC
/begin CHARACTERISTIC STR_cal_grp_name4 "Group 4" ASCII 0x001E99D8 /* @ECU_Address@STR_cal_grp_name4@0x02605000@ */ ECIPP_ALIGNMENT_UBYTE 255 Compu_ECIPP_STRINGS 0 255 MATRIX_DIM 11 1 1 /end CHARACTERISTIC
/begin CHARACTERISTIC STR_cal_grp_name5 "Group 5" ASCII 0x001E99E4 /* @ECU_Address@STR_cal_grp_name5@0x02606000@ */ ECIPP_ALIGNMENT_UBYTE 255 Compu_ECIPP_STRINGS 0 255 MATRIX_DIM 11 1 1 /end CHARACTERISTIC
/begin CHARACTERISTIC STR_cal_grp_name6 "Group 6" ASCII 0x001E99F0 /* @ECU_Address@STR_cal_grp_name6@0x02607000@ */ ECIPP_ALIGNMENT_UBYTE 255 Compu_ECIPP_STRINGS 0 255 MATRIX_DIM 11 1 1 /end CHARACTERISTIC
/begin CHARACTERISTIC STR_cal_grp_name7 "Group 7" ASCII 0x001E99FC /* @ECU_Address@STR_cal_grp_name7@0x02608000@ */ ECIPP_ALIGNMENT_UBYTE 255 Compu_ECIPP_STRINGS 0 255 MATRIX_DIM 11 1 1 /end CHARACTERISTIC
/begin CHARACTERISTIC STR_cal_grp_name8 "Group 8" ASCII 0x001E9A08 /* @ECU_Address@STR_cal_grp_name8@0x02609000@ */ ECIPP_ALIGNMENT_UBYTE 255 Compu_ECIPP_STRINGS 0 255 MATRIX_DIM 11 1 1 /end CHARACTERISTIC
/begin CHARACTERISTIC cal_grp_locked "Group Locked{cal_grp_locked&0xff=0:No}{cal_grp_locked&0xff=1:Yes}" VAL_BLK 0x001C8FB8 /* @ECU_Address@cal_grp_locked@0x0260A000@ */ ECIPP_ALIGNMENT_UBYTE 255 cal_grp_locked_COMPU_VTAB 0 255 MATRIX_DIM 8 1 1 BIT_MASK 0xff /end CHARACTERISTIC
/begin COMPU_METHOD cal_grp_locked_COMPU_VTAB "Verbal Table" TAB_VERB "%.0" "list" COMPU_TAB_REF cal_grp_locked_COMPU_VTAB_REF /end COMPU_METHOD
/begin COMPU_VTAB cal_grp_locked_COMPU_VTAB_REF "Verbal Table" TAB_VERB 2 0 "No" 1 "Yes" DEFAULT_VALUE "UNKNOWN" /end COMPU_VTAB
/begin MEASUREMENT cal_grp_cksum_ee "Group Checksum" ULONG Compu_cal_grp_cksum_ee 0 0 0 4294967295 ECU_ADDRESS 0x0260C000 MATRIX_DIM 8 1 1 /end MEASUREMENT
/begin COMPU_METHOD Compu_cal_grp_cksum_ee " " RAT_FUNC "%.0" "-" COEFFS 0 1 0 0 0 1 /end COMPU_METHOD
/begin MEASUREMENT cal_grp_rev_ee "Group Revisoin" UBYTE Compu_cal_grp_rev_ee 0 0 0 255 ECU_ADDRESS 0x0260D000 MATRIX_DIM 8 1 1 /end MEASUREMENT
/begin COMPU_METHOD Compu_cal_grp_rev_ee " " RAT_FUNC "%.0" "-" COEFFS 0 1 0 0 0 1 /end COMPU_METHOD
/begin MEASUREMENT cal_grp_lock_ee "Group Locked{cal_grp_lock_ee&0xff=0:No}{cal_grp_lock_ee&0xff=1:Yes}" UBYTE cal_grp_lock_ee_COMPU_VTAB 0 0 0 255 ECU_ADDRESS 0x0260E000 MATRIX_DIM 8 1 1 BIT_MASK 0xff /end MEASUREMENT
/begin COMPU_METHOD cal_grp_lock_ee_COMPU_VTAB "Verbal Table" TAB_VERB "%.0" "list" COMPU_TAB_REF cal_grp_lock_ee_COMPU_VTAB_REF /end COMPU_METHOD
/begin COMPU_VTAB cal_grp_lock_ee_COMPU_VTAB_REF "Verbal Table" TAB_VERB 2 0 "No" 1 "Yes" DEFAULT_VALUE "UNKNOWN" /end COMPU_VTAB
/begin MEASUREMENT cal_grp_cksum_hst1 "Group Checksum" ULONG Compu_cal_grp_cksum_hst1 0 0 0 4294967295 ECU_ADDRESS 0x0260F000 MATRIX_DIM 8 1 1 /end MEASUREMENT
/begin COMPU_METHOD Compu_cal_grp_cksum_hst1 " " RAT_FUNC "%.0" "-" COEFFS 0 1 0 0 0 1 /end COMPU_METHOD
/begin MEASUREMENT cal_grp_rev_hst1 "Group Revisoin" UBYTE Compu_cal_grp_rev_hst1 0 0 0 255 ECU_ADDRESS 0x02610000 MATRIX_DIM 8 1 1 /end MEASUREMENT
/begin COMPU_METHOD Compu_cal_grp_rev_hst1 " " RAT_FUNC "%.0" "-" COEFFS 0 1 0 0 0 1 /end COMPU_METHOD
/begin MEASUREMENT cal_grp_lock_hst1 "Group Locked{cal_grp_lock_hst1&0xff=0:No}{cal_grp_lock_hst1&0xff=1:Yes}" UBYTE cal_grp_lock_hst1_COMPU_VTAB 0 0 0 255 ECU_ADDRESS 0x02611000 MATRIX_DIM 8 1 1 BIT_MASK 0xff /end MEASUREMENT
/begin COMPU_METHOD cal_grp_lock_hst1_COMPU_VTAB "Verbal Table" TAB_VERB "%.0" "list" COMPU_TAB_REF cal_grp_lock_hst1_COMPU_VTAB_REF /end COMPU_METHOD
/begin COMPU_VTAB cal_grp_lock_hst1_COMPU_VTAB_REF "Verbal Table" TAB_VERB 2 0 "No" 1 "Yes" DEFAULT_VALUE "UNKNOWN" /end COMPU_VTAB
/begin MEASUREMENT cal_grp_cksum_hst2 "Group Checksum" ULONG Compu_cal_grp_cksum_hst2 0 0 0 4294967295 ECU_ADDRESS 0x02612000 MATRIX_DIM 8 1 1 /end MEASUREMENT
/begin COMPU_METHOD Compu_cal_grp_cksum_hst2 " " RAT_FUNC "%.0" "-" COEFFS 0 1 0 0 0 1 /end COMPU_METHOD
/begin MEASUREMENT cal_grp_rev_hst2 "Group Revisoin" UBYTE Compu_cal_grp_rev_hst2 0 0 0 255 ECU_ADDRESS 0x02613000 MATRIX_DIM 8 1 1 /end MEASUREMENT
/begin COMPU_METHOD Compu_cal_grp_rev_hst2 " " RAT_FUNC "%.0" "-" COEFFS 0 1 0 0 0 1 /end COMPU_METHOD
/begin MEASUREMENT cal_grp_lock_hst2 "Group Locked{cal_grp_lock_hst2&0xff=0:No}{cal_grp_lock_hst2&0xff=1:Yes}" UBYTE cal_grp_lock_hst2_COMPU_VTAB 0 0 0 255 ECU_ADDRESS 0x02614000 MATRIX_DIM 8 1 1 BIT_MASK 0xff /end MEASUREMENT
/begin COMPU_METHOD cal_grp_lock_hst2_COMPU_VTAB "Verbal Table" TAB_VERB "%.0" "list" COMPU_TAB_REF cal_grp_lock_hst2_COMPU_VTAB_REF /end COMPU_METHOD
/begin COMPU_VTAB cal_grp_lock_hst2_COMPU_VTAB_REF "Verbal Table" TAB_VERB 2 0 "No" 1 "Yes" DEFAULT_VALUE "UNKNOWN" /end COMPU_VTAB
/begin MEASUREMENT cal_grp_valid "Valid Calibration Group{cal_grp_valid&0xff=0:No}{cal_grp_valid&0xff=1:Yes}" UBYTE cal_grp_valid_COMPU_VTAB 0 0 0 255 ECU_ADDRESS 0x02615000 MATRIX_DIM 8 1 1 BIT_MASK 0xff /end MEASUREMENT
/begin COMPU_METHOD cal_grp_valid_COMPU_VTAB "Verbal Table" TAB_VERB "%.0" "list" COMPU_TAB_REF cal_grp_valid_COMPU_VTAB_REF /end COMPU_METHOD
/begin COMPU_VTAB cal_grp_valid_COMPU_VTAB_REF "Verbal Table" TAB_VERB 2 0 "No" 1 "Yes" DEFAULT_VALUE "UNKNOWN" /end COMPU_VTAB
/begin MEASUREMENT cal_grp_hrs_ee "Hour Last Commit" ULONG Compu_cal_grp_hrs_ee 0 0 0 1193046.47083333 ECU_ADDRESS 0x02639000 MATRIX_DIM 3 1 1 /end MEASUREMENT
/begin COMPU_METHOD Compu_cal_grp_hrs_ee " " RAT_FUNC "%.3" "-" COEFFS 0 3600 0 0 0 1 /end COMPU_METHOD
/begin COMPU_METHOD Compu_TspkMATMAPrmultrpm " " RAT_FUNC "%.0" "Speed (rpm)" COEFFS 0 1 0 0 0 1 /end COMPU_METHOD
/begin CHARACTERISTIC TspkMATMAPrmult "MAT Spark Retard Attenuation" CURVE 0x001C82B0 /* @ECU_Address@TspkMATMAPrmult@0x0266C000@ */ ECIPP_ALIGNMENT_UWORD 100 Compu_TspkMATMAPrmult 0 99.9984741210938
 /begin AXIS_DESCR COM_AXIS NO_INPUT_QUANTITY Compu_TspkMATMAPrmultrpm 6 -32768 32767 AXIS_PTS_REF TspkMATMAPrmultrpm /end AXIS_DESCR
/end CHARACTERISTIC
/begin AXIS_PTS TspkMATMAPrmultrpm " " 0x001C697C /* @ECU_Address@TspkMATMAPrmultrpm@0x0266B000@ */ NO_INPUT_QUANTITY ECIPP_Lookup_SWORD 0 Compu_TspkMATMAPrmultrpm 6 -32768 32767 /end AXIS_PTS
/begin COMPU_METHOD Compu_TspkMATMAPrmult " " RAT_FUNC "%.1" "% CAD" COEFFS 0 655.36 0 0 0 1 /end COMPU_METHOD
/begin COMPU_METHOD Compu_TspkMATMAPrmultLPrpm " " RAT_FUNC "%.0" "Speed (rpm)" COEFFS 0 1 0 0 0 1 /end COMPU_METHOD
/begin CHARACTERISTIC TspkMATMAPrmultLP "LPG MAT Spark Retard Attenuation" CURVE 0x001C82BC /* @ECU_Address@TspkMATMAPrmultLP@0x0266E000@ */ ECIPP_ALIGNMENT_UWORD 100 Compu_TspkMATMAPrmultLP 0 99.9984741210938
 /begin AXIS_DESCR COM_AXIS NO_INPUT_QUANTITY Compu_TspkMATMAPrmultLPrpm 6 -32768 32767 AXIS_PTS_REF TspkMATMAPrmultLPrpm /end AXIS_DESCR
/end CHARACTERISTIC
/begin AXIS_PTS TspkMATMAPrmultLPrpm " " 0x001C6964 /* @ECU_Address@TspkMATMAPrmultLPrpm@0x0266D000@ */ NO_INPUT_QUANTITY ECIPP_Lookup_SWORD 0 Compu_TspkMATMAPrmultLPrpm 6 -32768 32767 /end AXIS_PTS
/begin COMPU_METHOD Compu_TspkMATMAPrmultLP " " RAT_FUNC "%.1" "% CAD" COEFFS 0 655.36 0 0 0 1 /end COMPU_METHOD
/begin COMPU_METHOD Compu_TspkMATMAPrmultNGrpm " " RAT_FUNC "%.0" "Speed (rpm)" COEFFS 0 1 0 0 0 1 /end COMPU_METHOD
/begin CHARACTERISTIC TspkMATMAPrmultNG "NG MAT Spark Retard Attenuation" CURVE 0x001C82C8 /* @ECU_Address@TspkMATMAPrmultNG@0x02670000@ */ ECIPP_ALIGNMENT_UWORD 100 Compu_TspkMATMAPrmultNG 0 99.9984741210938
 /begin AXIS_DESCR COM_AXIS NO_INPUT_QUANTITY Compu_TspkMATMAPrmultNGrpm 6 -32768 32767 AXIS_PTS_REF TspkMATMAPrmultNGrpm /end AXIS_DESCR
/end CHARACTERISTIC
/begin AXIS_PTS TspkMATMAPrmultNGrpm " " 0x001C6970 /* @ECU_Address@TspkMATMAPrmultNGrpm@0x0266F000@ */ NO_INPUT_QUANTITY ECIPP_Lookup_SWORD 0 Compu_TspkMATMAPrmultNGrpm 6 -32768 32767 /end AXIS_PTS
/begin COMPU_METHOD Compu_TspkMATMAPrmultNG " " RAT_FUNC "%.1" "% CAD" COEFFS 0 655.36 0 0 0 1 /end COMPU_METHOD
/begin MEASUREMENT THstIBF_occ "Intake Backfire Histogram (Recent)" UBYTE Compu_THstIBF_occ 0 0 0 255 ECU_ADDRESS 0x02677000 MATRIX_DIM 30 1 1 /end MEASUREMENT
/begin COMPU_METHOD Compu_THstIBF_occ " " RAT_FUNC "%.0" "Intake Backfire Occurrences" COEFFS 0 1 0 0 0 1 /end COMPU_METHOD
/begin MEASUREMENT THstIBF_LT_occ "Intake Backfire Histogram (Lifetime)" UBYTE Compu_THstIBF_LT_occ 0 0 0 255 ECU_ADDRESS 0x02678000 MATRIX_DIM 30 1 1 /end MEASUREMENT
/begin COMPU_METHOD Compu_THstIBF_LT_occ " " RAT_FUNC "%.0" "Intake Backfire Occurrences" COEFFS 0 1 0 0 0 1 /end COMPU_METHOD
/begin MEASUREMENT THrsIBF_occ "Historical Intake Backfire Events" UBYTE Compu_THrsIBF_occ 0 0 0 255 ECU_ADDRESS 0x0267B000 MATRIX_DIM 4 1 1 /end MEASUREMENT
/begin COMPU_METHOD Compu_THrsIBF_occ " " RAT_FUNC "%.0" "Occurrences" COEFFS 0 1 0 0 0 1 /end COMPU_METHOD
/begin COMPU_METHOD Compu_Tpostphi_ret_ld_rpm " " RAT_FUNC "%.0" "Engine Speed (rpm)" COEFFS 0 1 0 0 0 1 /end COMPU_METHOD
/begin CHARACTERISTIC Tpostphi_ret_ld_MAP "Spark Retard Minimum Load" CURVE 0x001C663C /* @ECU_Address@Tpostphi_ret_ld_MAP@0x0268B000@ */ ECIPP_ALIGNMENT_SWORD 128 Compu_Tpostphi_ret_ld_MAP -128 127.99609375
 /begin AXIS_DESCR COM_AXIS NO_INPUT_QUANTITY Compu_Tpostphi_ret_ld_rpm 6 -32768 32767 AXIS_PTS_REF Tpostphi_ret_ld_rpm /end AXIS_DESCR
/end CHARACTERISTIC
/begin AXIS_PTS Tpostphi_ret_ld_rpm " " 0x001C6648 /* @ECU_Address@Tpostphi_ret_ld_rpm@0x0268A000@ */ NO_INPUT_QUANTITY ECIPP_Lookup_SWORD 0 Compu_Tpostphi_ret_ld_rpm 6 -32768 32767 /end AXIS_PTS
/begin COMPU_METHOD Compu_Tpostphi_ret_ld_MAP " " RAT_FUNC "%.2" "MAP Load (psia)" COEFFS 0 256 0 0 0 1 /end COMPU_METHOD
/begin MEASUREMENT HstSL_Tbl_load_cmd "Speed-Load Histogram" UWORD Compu_HstSL_Tbl_load_cmd 0 0 0 99.9984741210938 ECU_ADDRESS 0x02690000 MATRIX_DIM 6 1 1 /end MEASUREMENT
/begin COMPU_METHOD Compu_HstSL_Tbl_load_cmd " " RAT_FUNC "%.1" "%" COEFFS 0 655.36 0 0 0 1 /end COMPU_METHOD
/begin MEASUREMENT SparkKV "Spark KV Cyl1" UWORD Compu_SparkKV 0 0 0 65.535 ECU_ADDRESS 0x02697000 MATRIX_DIM 12 1 1 /end MEASUREMENT
/begin COMPU_METHOD Compu_SparkKV " " RAT_FUNC "%.1" "KV" COEFFS 0 1000 0 0 0 1 /end COMPU_METHOD
/begin MEASUREMENT SparkKV_filt "Spark KV filt Cyl1" ULONG Compu_SparkKV_filt 0 0 0 65.5359999847412 ECU_ADDRESS 0x02698000 MATRIX_DIM 12 1 1 /end MEASUREMENT
/begin COMPU_METHOD Compu_SparkKV_filt " " RAT_FUNC "%.1" "KV" COEFFS 0 65536000 0 0 0 1 /end COMPU_METHOD
/begin MEASUREMENT OutputDelay "Spark Delay Cyl1" SLONG Compu_OutputDelay 0 0 -1677721.6 1677721.59921875 ECU_ADDRESS 0x026A0000 MATRIX_DIM 12 1 1 /end MEASUREMENT
/begin COMPU_METHOD Compu_OutputDelay " " RAT_FUNC "%.1" "us" COEFFS 0 1280 0 0 0 1 /end COMPU_METHOD
/begin MEASUREMENT OutputDelayMF "Spark Misfire Delay Cyl1" SLONG Compu_OutputDelayMF 0 0 -1677721.6 1677721.59921875 ECU_ADDRESS 0x026A1000 MATRIX_DIM 12 1 1 /end MEASUREMENT
/begin COMPU_METHOD Compu_OutputDelayMF " " RAT_FUNC "%.1" "us" COEFFS 0 1280 0 0 0 1 /end COMPU_METHOD
/begin MEASUREMENT OutputDelayRF "Spark Refire Delay Cyl1" SLONG Compu_OutputDelayRF 0 0 -1677721.6 1677721.59921875 ECU_ADDRESS 0x026A2000 MATRIX_DIM 12 1 1 /end MEASUREMENT
/begin COMPU_METHOD Compu_OutputDelayRF " " RAT_FUNC "%.1" "us" COEFFS 0 1280 0 0 0 1 /end COMPU_METHOD
/begin MEASUREMENT SparkKVRF "Spark Refire KV Cyl1" UWORD Compu_SparkKVRF 0 0 0 65.535 ECU_ADDRESS 0x026A3000 MATRIX_DIM 12 1 1 /end MEASUREMENT
/begin COMPU_METHOD Compu_SparkKVRF " " RAT_FUNC "%.1" "KV" COEFFS 0 1000 0 0 0 1 /end COMPU_METHOD
/begin MEASUREMENT SparkKVMF "Spark Misfire KV Cyl1" UWORD Compu_SparkKVMF 0 0 0 65.535 ECU_ADDRESS 0x026A4000 MATRIX_DIM 12 1 1 /end MEASUREMENT
/begin COMPU_METHOD Compu_SparkKVMF " " RAT_FUNC "%.1" "KV" COEFFS 0 1000 0 0 0 1 /end COMPU_METHOD
/begin MEASUREMENT SparkKVMFD1 "Spark Misfire Delta1 KV Cyl1" SWORD Compu_SparkKVMFD1 0 0 -32.768 32.767 ECU_ADDRESS 0x026A5000 MATRIX_DIM 12 1 1 /end MEASUREMENT
/begin COMPU_METHOD Compu_SparkKVMFD1 " " RAT_FUNC "%.1" "KV" COEFFS 0 1000 0 0 0 1 /end COMPU_METHOD
/begin MEASUREMENT SparkKVMFD2 "Spark Misfire Delta2 KV Cyl1" SWORD Compu_SparkKVMFD2 0 0 -32.768 32.767 ECU_ADDRESS 0x026A6000 MATRIX_DIM 12 1 1 /end MEASUREMENT
/begin COMPU_METHOD Compu_SparkKVMFD2 " " RAT_FUNC "%.1" "KV" COEFFS 0 1000 0 0 0 1 /end COMPU_METHOD
/begin MEASUREMENT SparkKVMFD3 "Spark Misfire Delta3 KV Cyl1" SWORD Compu_SparkKVMFD3 0 0 -32.768 32.767 ECU_ADDRESS 0x026A7000 MATRIX_DIM 12 1 1 /end MEASUREMENT
/begin COMPU_METHOD Compu_SparkKVMFD3 " " RAT_FUNC "%.1" "KV" COEFFS 0 1000 0 0 0 1 /end COMPU_METHOD
/begin GROUP EC_Service "ECONTROLS" ROOT
 /begin REF_CHARACTERISTIC KNKHst_percent_trig KNKHst_retard_trig KNKHst_trig_mode SRVC_mode SRVC_fixed_interval engine_type ECTHst_ena ECTHst_hi_trig RangeHst_mode1 RangeHst_mode2 RangeHst_mode3 RangeHst_mode4 RangeHst_mode5 RangeHst_mode6 RangeHst_mode7 RangeHst_mode8 RangeHst_mode9 RangeHst_mode10 RangeHst_mode11 RangeHst_mode12 RangeHst_mode13 RangeHst_mode14 RangeHst_mode15 RangeHst_mode16 RangeHst_mode17 RangeHst_mode18 RangeHst_mode19 RangeHst_mode20 RangeHst_cntr_upd reset_learn_reprog SRVC_fixed_int_km_L1 SRVC_fixed_int_km_L2 IBF_mode IBF_IATdt_lim IBF_MAP_lim IBF_latch_tm IBF_unlatch_tm RPM_stat_ena RPM_stat_hi_trig OILT_stat_ena OILT_stat_hi_trig OILP_stat_ena OILP_stat_lo_trig OILP_stat_lo_wait OILP_stat_low_rpm TSRVC_intervals RangeHst_ECIPP_ndx RangeHst_min RangeHst_max cal_grp_revisions STR_cal_grp_name1 STR_cal_grp_name2 STR_cal_grp_name3 STR_cal_grp_name4 STR_cal_grp_name5 STR_cal_grp_name6 STR_cal_grp_name7 STR_cal_grp_name8 cal_grp_locked /end REF_CHARACTERISTIC
 /begin REF_MEASUREMENT KNKHst_reset_request SRVC_update_key SRVC_update_status SRVC_pct_accum ECTHst_reset_usr reset_learn_active reset_learn_action reset_learn_state SRVC_km_rem IATdt IATdt_key_cyc_max IBF_action_request HstIBF_total HstIBF_LT_total HstIBF_time RPM_stat_reset_usr RPM_stat_max RPM_stat_hi_HM OILT_stat_reset_usr OILT_stat_max OILT_stat_hi_HM OILP_stat_reset_usr OILP_stat_min OILP_stat_lo_HM RPM_stat_hi_acc RangeHst_cnt cal_grp_cksums cal_grp_cksum_ee cal_grp_rev_ee cal_grp_lock_ee cal_grp_cksum_hst1 cal_grp_rev_hst1 cal_grp_lock_hst1 cal_grp_cksum_hst2 cal_grp_rev_hst2 cal_grp_lock_hst2 cal_grp_valid cal_grp_hrs_ee THstIBF_occ THstIBF_LT_occ THrsIBF_occ HstSL_Tbl_load_cmd /end REF_MEASUREMENT
/end GROUP
/begin GROUP EC_Service1 "ECONTROLS" ROOT
 /begin REF_MEASUREMENT AL_nonzero TRIM_EGO_ajlean TRIM_EGO_ajstoc TRIM_EGO_ajrich TRIM_EGO_avg /end REF_MEASUREMENT
/end GROUP
/begin GROUP EC_Simulink "ECONTROLS" ROOT /begin REF_CHARACTERISTIC slnk_nvm_reprog_clr slnk_nvm_wr_period /end REF_CHARACTERISTIC
 /begin REF_MEASUREMENT svn_remote_compiled svn_mixed svn_modified svn_compile_date_str enov_slnk_u8_1 enov_slnk_u8_2 enov_slnk_u8_3 enov_slnk_u8_4 enov_slnk_u8_5 enov_slnk_u8_6 enov_slnk_u8_7 enov_slnk_u8_8 enov_slnk_u8_9 enov_slnk_u8_10 enov_slnk_u8_11 enov_slnk_u8_12 enov_slnk_u8_13 enov_slnk_u8_14 enov_slnk_u8_15 enov_slnk_u8_16 enov_slnk_u8_17 enov_slnk_u8_18 enov_slnk_u8_19 enov_slnk_u8_20 enov_slnk_f_1 enov_slnk_f_2 enov_slnk_f_3 enov_slnk_f_4 enov_slnk_f_5 enov_slnk_f_6 enov_slnk_f_7 enov_slnk_f_8 enov_slnk_f_9 enov_slnk_f_10 enov_slnk_f_11 enov_slnk_f_12 enov_slnk_f_13 enov_slnk_f_14 enov_slnk_f_15 enov_slnk_f_16 enov_slnk_f_17 enov_slnk_f_18 enov_slnk_f_19 enov_slnk_f_20 slnk_invalid_fsh_adr slnk_invalid_fsh_cnt slnk_invalid_reg_adr slnk_invalid_reg_cnt slnk_invalid_RAM_adr slnk_invalid_RAM_cnt enov_slnk_1ms_live enov_slnk_1ms_oruns enov_slnk_1ms_inst enov_slnk_1ms_max enov_slnk_5ms_live enov_slnk_5ms_oruns enov_slnk_5ms_inst enov_slnk_5ms_max enov_slnk_50ms_live enov_slnk_50ms_oruns enov_slnk_50ms_inst enov_slnk_50ms_max enov_slnk_fsh_bytes enov_slnk_fsh_pct enov_slnk_RAM_bytes enov_slnk_RAM_pct enov_slnk_1ms_allwd enov_slnk_5ms_allwd enov_slnk_50ms_allwd enov_slnk_1ms_pct enov_slnk_5ms_pct enov_slnk_50ms_pct enov_slnk_revision asw_can_rx_cnt_cur asw_can_rx_cnt_max asw_can_tx_cnt_cur asw_can_tx_cnt_max asw_can_err_cnt asw_can_err_code CAN1_asw_rx_packs CAN1_asw_tx_packs CAN2_asw_rx_packs CAN2_asw_tx_packs CAN3_asw_rx_packs CAN3_asw_tx_packs STR_enov_slnk_u8_1 STR_enov_slnk_u8_2 STR_enov_slnk_u8_3 STR_enov_slnk_u8_4 STR_enov_slnk_u8_5 STR_enov_slnk_u8_6 STR_enov_slnk_u8_7 STR_enov_slnk_u8_8 STR_enov_slnk_u8_9 STR_enov_slnk_u8_10 STR_enov_slnk_u8_11 STR_enov_slnk_u8_12 STR_enov_slnk_u8_13 STR_enov_slnk_u8_14 STR_enov_slnk_u8_15 STR_enov_slnk_u8_16 STR_enov_slnk_u8_17 STR_enov_slnk_u8_18 STR_enov_slnk_u8_19 STR_enov_slnk_u8_20 STR_enov_slnk_f_1 STR_enov_slnk_f_2 STR_enov_slnk_f_3 STR_enov_slnk_f_4 STR_enov_slnk_f_5 STR_enov_slnk_f_6 STR_enov_slnk_f_7 STR_enov_slnk_f_8 STR_enov_slnk_f_9 STR_enov_slnk_f_10 STR_enov_slnk_f_11 STR_enov_slnk_f_12 STR_enov_slnk_f_13 STR_enov_slnk_f_14 STR_enov_slnk_f_15 STR_enov_slnk_f_16 STR_enov_slnk_f_17 STR_enov_slnk_f_18 STR_enov_slnk_f_19 STR_enov_slnk_f_20 /end REF_MEASUREMENT
/end GROUP
/begin GROUP EC_SparkCal "ECONTROLS" ROOT
 /begin REF_CHARACTERISTIC spk_adv_dz spk_adv_dz_tau dwell_adpt_ena dwell_a_min dwell_a_max dwell_inc_K dwell_inc_max dwell_d_amp dwell_def dwell_min dwell_max dwell_shorted spk_min_dissipate dwell_crk_add dwell_crk_rpm dwell_min_Vbat dwell_a_prefire_samp dwell_crk_max_accel SPKD_short_trig dwell_sense1_source dwell_sense2_source dwell_sense3_source dwell_sense4_source dwell_sense5_source dwell_sense6_source dwell_sense7_source dwell_sense8_source dwell_sense9_source dwell_sense10_source spkmon_min_dissipate SPK_IGBT_T_Timer dwell_sense11_source dwell_sense12_source Tspka_base_CAD dwell_nom_tbl dwell_ls_mult /end REF_CHARACTERISTIC
 /begin REF_MEASUREMENT spk_max_ECT dwell_OL dwell1_adapt dwell2_adapt dwell3_adapt spk_adv_crk CrkTT_dcy_t dwell_crk_min dwell4_adapt dwell5_adapt dwell6_adapt dwell7_adapt dwell8_adapt dwell_samp_cnt dwell_extmod_cnt dwell_open_i dwell_short_i dwell9_adapt dwell10_adapt dwell_d_amp_ls postcat_phi_retard dwell11_adapt dwell12_adapt dwell_extmod_coils /end REF_MEASUREMENT
/end GROUP
/begin GROUP EC_SparkCalLP "ECONTROLS" ROOT
 /begin REF_CHARACTERISTIC CWTretLP_posC CWTretLP_negC CWTret_poslim CWTret_neglim Tspka_baseP_CAD Tspko_ECTvLP_CAD Tspko_MATvLP_CAD TspkMATMAPrmultLP /end REF_CHARACTERISTIC
 /begin REF_MEASUREMENT spk_max_ECT VE_CWT_crct_pct postcat_phi_retard /end REF_MEASUREMENT
/end GROUP
/begin GROUP EC_SparkCalNG "ECONTROLS" ROOT
 /begin REF_CHARACTERISTIC CWTretNG_posC CWTretNG_negC CWTret_poslim CWTret_neglim Tspka_baseNG_CAD Tspko_ECTvLNG_CAD Tspko_MATvLNG_CAD TspkMATMAPrmultNG /end REF_CHARACTERISTIC
 /begin REF_MEASUREMENT spk_max_ECT VE_CWT_crct_pct postcat_phi_retard /end REF_MEASUREMENT
/end GROUP
/begin GROUP EC_SparkCD "ECONTROLS" ROOT
 /begin REF_CHARACTERISTIC TANK_1_V_minv TANK_1_V_maxv RF_spk_ena RF_spk_MAP CD_dwell SpkDelayCal SoftStartPchan SoftStartPWM SoftStartPWMmaxDC TankMaxDC_28V TankMaxDC_12V TankMinDC_28V TankMinDC_12V TANK_Pump_Kp TANK_Pump_Kp12V TankSetpoint TankSetpointMF TankSetptMF_limit SecThreshold KV_term AutoKV_ena AutoKV_period AutoKVMargin AutoKVReq_inc AutoKVReq_dec AutoKVReq_min KVHighest_max KVHighest_tau MAPKV_MAPss_tau MAPKV_ofst AutoKV_MAP_Kp Coil_turns CD_CoilType CDmisfire_spkCnt MAP_misfire_OK ECT_spk_ena KV_high KV_low MAP_MinKVflt TANK_PumpMult_180V TANK_PumpMult_280V /end REF_CHARACTERISTIC
 /begin REF_MEASUREMENT V12_FB_raw V3P3_FB_raw TANK1_DIS_raw TANK2_DIS_raw TANK_1_V_raw TANK_2_V_raw TANK_1_VMF TANK_2_VMF TANK_1_VRF TANK_2_VRF TANK_ADCnts_Des TANK_ADCnts_DesMF AutoKV_tmr AutoKV_TankSetpt AutoKVReq KVHighest MAPKV_MAPss CDdur_CAD spk_kill_mfmode spock_sync_ena local_cal_sync_CS_32 ext_cal_sync_CS_32 Bootblock_Enable_raw cal_sync_status cal_sync_timer cal_sync_attempts spock_XLS_revision spock_SVN_revision spock_spk_halt TankSetptMF_actual cd_spk_adv CD_MF_cntr1 CD_MF_cntr2 CD_MF_cntr3 CD_MF_cntr4 CD_MF_cntr5 CD_MF_cntr6 CD_MF_cntr7 CD_MF_cntr8 CD_MF_cntr9 CD_MF_cntr10 CD_MF_cntr11 CD_MF_cntr12 CD_MF_MAP_LED CD_MF_ECT_LED CD_MF_rpm_LED CD_MF_run_tmr_LED CD_MF_AutoKV_LED CD_MF_CDdur_LED CD_MF_CDcal_LED CD_RF_LED TANK_Kp CDdur_nom_ticks CDdur_nomMF_ticks CDdur_act_Tk1_ps CDdur_act_Tk2_ps CDdur_act_Tk1_mf_rf CDdur_act_Tk2_mf_rf RFdur_CAD SparkKV SparkKV_filt OutputDelay OutputDelayMF OutputDelayRF SparkKVRF SparkKVMF SparkKVMFD1 SparkKVMFD2 SparkKVMFD3 /end REF_MEASUREMENT
/end GROUP
/begin GROUP EC_SparkOfst "ECONTROLS" ROOT
 /begin REF_CHARACTERISTIC FSO_ret_init FSO_ret_decay CWTret_posC CWTretLP_posC CWTretNG_posC CWTret_negC CWTretLP_negC CWTretNG_negC CWTret_poslim CWTret_neglim spko_cyl_mode coil1_spk_mult coil2_spk_mult coil3_spk_mult coil4_spk_mult coil5_spk_mult coil6_spk_mult coil7_spk_mult coil8_spk_mult coil9_spk_mult coil10_spk_mult spko_cyl_dzfilt spk_rpmlo_crank_lmt spk_rpmlo_stall_lmt spk_rpmlo_crank_ena FSO_ret_mode spkret_decay_time strt_spkret_ena spkret_EGT spkret_hold_mult postphi_ret_CAD postphi_ret_engage postphi_ret_diseng postphi_ret_FSO_wt coil11_spk_mult coil12_spk_mult Tspko_ECTvL_CAD Tspko_MATvL_CAD Tspko_ECT_CAD Tspko_cyl_CAD Tspkret_FSOt_hold Tspkret_ECT_hold Tspkret_MAP_retard TspkMATMAPrmult Tpostphi_ret_ld_MAP /end REF_CHARACTERISTIC
 /begin REF_MEASUREMENT spk_max_ECT VE_CWT_crct_pct coil1_adv_cyl coil2_adv_cyl coil3_adv_cyl coil4_adv_cyl coil5_adv_cyl coil6_adv_cyl coil7_adv_cyl coil8_adv_cyl coil9_adv_cyl coil10_adv_cyl spkret_hold_tmr postcat_phi_retard coil11_adv_cyl coil12_adv_cyl /end REF_MEASUREMENT
/end GROUP
/begin GROUP EC_Starting "ECONTROLS" ROOT /begin REF_MEASUREMENT spk_adv_crk CrkTT_dcy_t /end REF_MEASUREMENT /end GROUP
/begin GROUP EC_VECal "ECONTROLS" ROOT /begin REF_MEASUREMENT VE_CWT_crct_pct /end REF_MEASUREMENT /end GROUP
/end MODULE
/end PROJECT
