ASAP2_VERSION 1 61
/begin PROJECT Econtrols_4G "4G Test"
/begin HEADER "4G A2L Configuration" PROJECT_NO EControls4G /* config for version control */ VERSION "$Revision: 82130 $:" /* config for version control */ /end HEADER
/begin MODULE EControls_4G_SH2A "EControls 4G"
/begin MOD_COMMON "" DEPOSIT ABSOLUTE BYTE_ORDER MSB_FIRST /end MOD_COMMON
/* Define the Record Layouts */
/begin RECORD_LAYOUT ECIPP_ALIGNMENT_UBYTE FNC_VALUES 1 UBYTE COLUMN_DIR DIRECT /end RECORD_LAYOUT
/begin RECORD_LAYOUT ECIPP_ALIGNMENT_UWORD FNC_VALUES 1 UWORD COLUMN_DIR DIRECT /end RECORD_LAYOUT
/begin RECORD_LAYOUT ECIPP_ALIGNMENT_ULONG FNC_VALUES 1 ULONG COLUMN_DIR DIRECT /end RECORD_LAYOUT
/begin RECORD_LAYOUT ECIPP_ALIGNMENT_FLOAT32_IEEE FNC_VALUES 1 FLOAT32_IEEE COLUMN_DIR DIRECT /end RECORD_LAYOUT
/begin COMPU_METHOD Compu_IDENTITY "Discrete Values " /* Identifier */ IDENTICAL "%.0" /* Format */ "-" /* Units */ /end COMPU_METHOD
/begin CHARACTERISTIC FCdc4_PWM17_off_loVf "FCtl_DTC_0x04(447)" VALUE 0x001E4414 /* @ECU_Address@FCtl_DTC_0x04@0x024C437E@ */ ECIPP_ALIGNMENT_UWORD 65535 Compu_IDENTITY 0 65535 PHYS_UNIT "System ID + DTC" /end CHARACTERISTIC
/begin CHARACTERISTIC FCdc4_PWM17_on_hiVf "FCtl_DTC_0x04(448)" VALUE 0x001E4416 /* @ECU_Address@FCtl_DTC_0x04@0x024C4380@ */ ECIPP_ALIGNMENT_UWORD 65535 Compu_IDENTITY 0 65535 PHYS_UNIT "System ID + DTC" /end CHARACTERISTIC
/begin CHARACTERISTIC FCdc4_PWM18_off_loVf "FCtl_DTC_0x04(449)" VALUE 0x001E4418 /* @ECU_Address@FCtl_DTC_0x04@0x024C4382@ */ ECIPP_ALIGNMENT_UWORD 65535 Compu_IDENTITY 0 65535 PHYS_UNIT "System ID + DTC" /end CHARACTERISTIC
/begin CHARACTERISTIC FCdc4_PWM18_on_hiVf "FCtl_DTC_0x04(450)" VALUE 0x001E441A /* @ECU_Address@FCtl_DTC_0x04@0x024C4384@ */ ECIPP_ALIGNMENT_UWORD 65535 Compu_IDENTITY 0 65535 PHYS_UNIT "System ID + DTC" /end CHARACTERISTIC
/begin CHARACTERISTIC FCdc4_PWM19_off_loVf "FCtl_DTC_0x04(451)" VALUE 0x001E441C /* @ECU_Address@FCtl_DTC_0x04@0x024C4386@ */ ECIPP_ALIGNMENT_UWORD 65535 Compu_IDENTITY 0 65535 PHYS_UNIT "System ID + DTC" /end CHARACTERISTIC
/begin CHARACTERISTIC FCdc4_PWM19_on_hiVf "FCtl_DTC_0x04(452)" VALUE 0x001E441E /* @ECU_Address@FCtl_DTC_0x04@0x024C4388@ */ ECIPP_ALIGNMENT_UWORD 65535 Compu_IDENTITY 0 65535 PHYS_UNIT "System ID + DTC" /end CHARACTERISTIC
/begin CHARACTERISTIC FCdc4_PWM2_off_loVf "FCtl_DTC_0x04(191)" VALUE 0x001E4214 /* @ECU_Address@FCtl_DTC_0x04@0x024C417E@ */ ECIPP_ALIGNMENT_UWORD 65535 Compu_IDENTITY 0 65535 PHYS_UNIT "System ID + DTC" /end CHARACTERISTIC
/begin CHARACTERISTIC FCdc4_PWM2_on_hiVf "FCtl_DTC_0x04(192)" VALUE 0x001E4216 /* @ECU_Address@FCtl_DTC_0x04@0x024C4180@ */ ECIPP_ALIGNMENT_UWORD 65535 Compu_IDENTITY 0 65535 PHYS_UNIT "System ID + DTC" /end CHARACTERISTIC
/begin CHARACTERISTIC FCdc4_PWM20_off_loVf "FCtl_DTC_0x04(453)" VALUE 0x001E4420 /* @ECU_Address@FCtl_DTC_0x04@0x024C438A@ */ ECIPP_ALIGNMENT_UWORD 65535 Compu_IDENTITY 0 65535 PHYS_UNIT "System ID + DTC" /end CHARACTERISTIC
/begin CHARACTERISTIC FCdc4_PWM20_on_hiVf "FCtl_DTC_0x04(454)" VALUE 0x001E4422 /* @ECU_Address@FCtl_DTC_0x04@0x024C438C@ */ ECIPP_ALIGNMENT_UWORD 65535 Compu_IDENTITY 0 65535 PHYS_UNIT "System ID + DTC" /end CHARACTERISTIC
/begin CHARACTERISTIC FCdc4_PWM21_off_loVf "FCtl_DTC_0x04(455)" VALUE 0x001E4424 /* @ECU_Address@FCtl_DTC_0x04@0x024C438E@ */ ECIPP_ALIGNMENT_UWORD 65535 Compu_IDENTITY 0 65535 PHYS_UNIT "System ID + DTC" /end CHARACTERISTIC
/begin CHARACTERISTIC FCdc4_PWM21_on_hiVf "FCtl_DTC_0x04(456)" VALUE 0x001E4426 /* @ECU_Address@FCtl_DTC_0x04@0x024C4390@ */ ECIPP_ALIGNMENT_UWORD 65535 Compu_IDENTITY 0 65535 PHYS_UNIT "System ID + DTC" /end CHARACTERISTIC
/begin CHARACTERISTIC FCdc4_PWM22_off_loVf "FCtl_DTC_0x04(457)" VALUE 0x001E4428 /* @ECU_Address@FCtl_DTC_0x04@0x024C4392@ */ ECIPP_ALIGNMENT_UWORD 65535 Compu_IDENTITY 0 65535 PHYS_UNIT "System ID + DTC" /end CHARACTERISTIC
/begin CHARACTERISTIC FCdc4_PWM22_on_hiVf "FCtl_DTC_0x04(458)" VALUE 0x001E442A /* @ECU_Address@FCtl_DTC_0x04@0x024C4394@ */ ECIPP_ALIGNMENT_UWORD 65535 Compu_IDENTITY 0 65535 PHYS_UNIT "System ID + DTC" /end CHARACTERISTIC
/begin CHARACTERISTIC FCdc4_PWM23_off_loVf "FCtl_DTC_0x04(459)" VALUE 0x001E442C /* @ECU_Address@FCtl_DTC_0x04@0x024C4396@ */ ECIPP_ALIGNMENT_UWORD 65535 Compu_IDENTITY 0 65535 PHYS_UNIT "System ID + DTC" /end CHARACTERISTIC
/begin CHARACTERISTIC FCdc4_PWM23_on_hiVf "FCtl_DTC_0x04(460)" VALUE 0x001E442E /* @ECU_Address@FCtl_DTC_0x04@0x024C4398@ */ ECIPP_ALIGNMENT_UWORD 65535 Compu_IDENTITY 0 65535 PHYS_UNIT "System ID + DTC" /end CHARACTERISTIC
/begin CHARACTERISTIC FCdc4_PWM3_off_loVf "FCtl_DTC_0x04(193)" VALUE 0x001E4218 /* @ECU_Address@FCtl_DTC_0x04@0x024C4182@ */ ECIPP_ALIGNMENT_UWORD 65535 Compu_IDENTITY 0 65535 PHYS_UNIT "System ID + DTC" /end CHARACTERISTIC
/begin CHARACTERISTIC FCdc4_PWM3_on_hiVf "FCtl_DTC_0x04(194)" VALUE 0x001E421A /* @ECU_Address@FCtl_DTC_0x04@0x024C4184@ */ ECIPP_ALIGNMENT_UWORD 65535 Compu_IDENTITY 0 65535 PHYS_UNIT "System ID + DTC" /end CHARACTERISTIC
/begin CHARACTERISTIC FCdc4_PWM4_off_loVf "FCtl_DTC_0x04(195)" VALUE 0x001E421C /* @ECU_Address@FCtl_DTC_0x04@0x024C4186@ */ ECIPP_ALIGNMENT_UWORD 65535 Compu_IDENTITY 0 65535 PHYS_UNIT "System ID + DTC" /end CHARACTERISTIC
/begin CHARACTERISTIC FCdc4_PWM4_on_hiVf "FCtl_DTC_0x04(196)" VALUE 0x001E421E /* @ECU_Address@FCtl_DTC_0x04@0x024C4188@ */ ECIPP_ALIGNMENT_UWORD 65535 Compu_IDENTITY 0 65535 PHYS_UNIT "System ID + DTC" /end CHARACTERISTIC
/begin CHARACTERISTIC FCdc4_PWM5_off_loVf "FCtl_DTC_0x04(197)" VALUE 0x001E4220 /* @ECU_Address@FCtl_DTC_0x04@0x024C418A@ */ ECIPP_ALIGNMENT_UWORD 65535 Compu_IDENTITY 0 65535 PHYS_UNIT "System ID + DTC" /end CHARACTERISTIC
/begin CHARACTERISTIC FCdc4_PWM5_on_hiVf "FCtl_DTC_0x04(198)" VALUE 0x001E4222 /* @ECU_Address@FCtl_DTC_0x04@0x024C418C@ */ ECIPP_ALIGNMENT_UWORD 65535 Compu_IDENTITY 0 65535 PHYS_UNIT "System ID + DTC" /end CHARACTERISTIC
/begin CHARACTERISTIC FCdc4_PWM6_off_loVf "FCtl_DTC_0x04(276)" VALUE 0x001E42BE /* @ECU_Address@FCtl_DTC_0x04@0x024C4228@ */ ECIPP_ALIGNMENT_UWORD 65535 Compu_IDENTITY 0 65535 PHYS_UNIT "System ID + DTC" /end CHARACTERISTIC
/begin CHARACTERISTIC FCdc4_PWM6_on_hiVf "FCtl_DTC_0x04(277)" VALUE 0x001E42C0 /* @ECU_Address@FCtl_DTC_0x04@0x024C422A@ */ ECIPP_ALIGNMENT_UWORD 65535 Compu_IDENTITY 0 65535 PHYS_UNIT "System ID + DTC" /end CHARACTERISTIC
/begin CHARACTERISTIC FCdc4_PWM7_off_loVf "FCtl_DTC_0x04(278)" VALUE 0x001E42C2 /* @ECU_Address@FCtl_DTC_0x04@0x024C422C@ */ ECIPP_ALIGNMENT_UWORD 65535 Compu_IDENTITY 0 65535 PHYS_UNIT "System ID + DTC" /end CHARACTERISTIC
/begin CHARACTERISTIC FCdc4_PWM7_on_hiVf "FCtl_DTC_0x04(279)" VALUE 0x001E42C4 /* @ECU_Address@FCtl_DTC_0x04@0x024C422E@ */ ECIPP_ALIGNMENT_UWORD 65535 Compu_IDENTITY 0 65535 PHYS_UNIT "System ID + DTC" /end CHARACTERISTIC
/begin CHARACTERISTIC FCdc4_PWM8_off_loVf "FCtl_DTC_0x04(283)" VALUE 0x001E42CC /* @ECU_Address@FCtl_DTC_0x04@0x024C4236@ */ ECIPP_ALIGNMENT_UWORD 65535 Compu_IDENTITY 0 65535 PHYS_UNIT "System ID + DTC" /end CHARACTERISTIC
/begin CHARACTERISTIC FCdc4_PWM8_on_hiVf "FCtl_DTC_0x04(284)" VALUE 0x001E42CE /* @ECU_Address@FCtl_DTC_0x04@0x024C4238@ */ ECIPP_ALIGNMENT_UWORD 65535 Compu_IDENTITY 0 65535 PHYS_UNIT "System ID + DTC" /end CHARACTERISTIC
/begin CHARACTERISTIC FCdc4_PWM9_off_loVf "FCtl_DTC_0x04(285)" VALUE 0x001E42D0 /* @ECU_Address@FCtl_DTC_0x04@0x024C423A@ */ ECIPP_ALIGNMENT_UWORD 65535 Compu_IDENTITY 0 65535 PHYS_UNIT "System ID + DTC" /end CHARACTERISTIC
/begin CHARACTERISTIC FCdc4_PWM9_on_hiVf "FCtl_DTC_0x04(286)" VALUE 0x001E42D2 /* @ECU_Address@FCtl_DTC_0x04@0x024C423C@ */ ECIPP_ALIGNMENT_UWORD 65535 Compu_IDENTITY 0 65535 PHYS_UNIT "System ID + DTC" /end CHARACTERISTIC
/begin CHARACTERISTIC FCdc4_PWMLO_off_loVf "FCtl_DTC_0x04(521)" VALUE 0x001E44A8 /* @ECU_Address@FCtl_DTC_0x04@0x024C4412@ */ ECIPP_ALIGNMENT_UWORD 65535 Compu_IDENTITY 0 65535 PHYS_UNIT "System ID + DTC" /end CHARACTERISTIC
/begin CHARACTERISTIC FCdc4_PWMLO_on_hiVf "FCtl_DTC_0x04(522)" VALUE 0x001E44AA /* @ECU_Address@FCtl_DTC_0x04@0x024C4414@ */ ECIPP_ALIGNMENT_UWORD 65535 Compu_IDENTITY 0 65535 PHYS_UNIT "System ID + DTC" /end CHARACTERISTIC
/begin CHARACTERISTIC FCdc4_radby_poserr "FCtl_DTC_0x04(870)" VALUE 0x001E4762 /* @ECU_Address@FCtl_DTC_0x04@0x024C46CC@ */ ECIPP_ALIGNMENT_UWORD 65535 Compu_IDENTITY 0 65535 PHYS_UNIT "System ID + DTC" /end CHARACTERISTIC
/begin CHARACTERISTIC FCdc4_RAM_fail "FCtl_DTC_0x04(106)" VALUE 0x001E416A /* @ECU_Address@FCtl_DTC_0x04@0x024C40D4@ */ ECIPP_ALIGNMENT_UWORD 65535 Compu_IDENTITY 0 65535 PHYS_UNIT "System ID + DTC" /end CHARACTERISTIC
/begin CHARACTERISTIC FCdc4_relay_coilopen "FCtl_DTC_0x04(159)" VALUE 0x001E41D4 /* @ECU_Address@FCtl_DTC_0x04@0x024C413E@ */ ECIPP_ALIGNMENT_UWORD 65535 Compu_IDENTITY 0 65535 PHYS_UNIT "System ID + DTC" /end CHARACTERISTIC
/begin CHARACTERISTIC FCdc4_relay_coilshort "FCtl_DTC_0x04(160)" VALUE 0x001E41D6 /* @ECU_Address@FCtl_DTC_0x04@0x024C4140@ */ ECIPP_ALIGNMENT_UWORD 65535 Compu_IDENTITY 0 65535 PHYS_UNIT "System ID + DTC" /end CHARACTERISTIC
/begin CHARACTERISTIC FCdc4_relay_gndshort "FCtl_DTC_0x04(158)" VALUE 0x001E41D2 /* @ECU_Address@FCtl_DTC_0x04@0x024C413C@ */ ECIPP_ALIGNMENT_UWORD 65535 Compu_IDENTITY 0 65535 PHYS_UNIT "System ID + DTC" /end CHARACTERISTIC
/begin CHARACTERISTIC FCdc4_relayoff_hiV "FCtl_DTC_0x04(431)" VALUE 0x001E43F4 /* @ECU_Address@FCtl_DTC_0x04@0x024C435E@ */ ECIPP_ALIGNMENT_UWORD 65535 Compu_IDENTITY 0 65535 PHYS_UNIT "System ID + DTC" /end CHARACTERISTIC
/begin CHARACTERISTIC FCdc4_relayon_loV "FCtl_DTC_0x04(432)" VALUE 0x001E43F6 /* @ECU_Address@FCtl_DTC_0x04@0x024C4360@ */ ECIPP_ALIGNMENT_UWORD 65535 Compu_IDENTITY 0 65535 PHYS_UNIT "System ID + DTC" /end CHARACTERISTIC
/begin CHARACTERISTIC FCdc4_rpm_hi_expected "FCtl_DTC_0x04(351)" VALUE 0x001E4354 /* @ECU_Address@FCtl_DTC_0x04@0x024C42BE@ */ ECIPP_ALIGNMENT_UWORD 65535 Compu_IDENTITY 0 65535 PHYS_UNIT "System ID + DTC" /end CHARACTERISTIC
/begin CHARACTERISTIC FCdc4_rpmd_gov_lo "FCtl_DTC_0x04(520)" VALUE 0x001E44A6 /* @ECU_Address@FCtl_DTC_0x04@0x024C4410@ */ ECIPP_ALIGNMENT_UWORD 65535 Compu_IDENTITY 0 65535 PHYS_UNIT "System ID + DTC" /end CHARACTERISTIC
/begin CHARACTERISTIC FCdc4_RS_discon "FCtl_DTC_0x04(691)" VALUE 0x001E45FC /* @ECU_Address@FCtl_DTC_0x04@0x024C4566@ */ ECIPP_ALIGNMENT_UWORD 65535 Compu_IDENTITY 0 65535 PHYS_UNIT "System ID + DTC" /end CHARACTERISTIC
/begin CHARACTERISTIC FCdc4_RS_hiV "FCtl_DTC_0x04(599)" VALUE 0x001E4544 /* @ECU_Address@FCtl_DTC_0x04@0x024C44AE@ */ ECIPP_ALIGNMENT_UWORD 65535 Compu_IDENTITY 0 65535 PHYS_UNIT "System ID + DTC" /end CHARACTERISTIC
/begin CHARACTERISTIC FCdc4_RS_loss "FCtl_DTC_0x04(220)" VALUE 0x001E424E /* @ECU_Address@FCtl_DTC_0x04@0x024C41B8@ */ ECIPP_ALIGNMENT_UWORD 65535 Compu_IDENTITY 0 65535 PHYS_UNIT "System ID + DTC" /end CHARACTERISTIC
/begin CHARACTERISTIC FCdc4_RS_loV "FCtl_DTC_0x04(598)" VALUE 0x001E4542 /* @ECU_Address@FCtl_DTC_0x04@0x024C44AC@ */ ECIPP_ALIGNMENT_UWORD 65535 Compu_IDENTITY 0 65535 PHYS_UNIT "System ID + DTC" /end CHARACTERISTIC
/begin CHARACTERISTIC FCdc4_RS485_bad_fmt "FCtl_DTC_0x04(124)" VALUE 0x001E418E /* @ECU_Address@FCtl_DTC_0x04@0x024C40F8@ */ ECIPP_ALIGNMENT_UWORD 65535 Compu_IDENTITY 0 65535 PHYS_UNIT "System ID + DTC" /end CHARACTERISTIC
/begin CHARACTERISTIC FCdc4_RS485_Rx_inact "FCtl_DTC_0x04(122)" VALUE 0x001E418A /* @ECU_Address@FCtl_DTC_0x04@0x024C40F4@ */ ECIPP_ALIGNMENT_UWORD 65535 Compu_IDENTITY 0 65535 PHYS_UNIT "System ID + DTC" /end CHARACTERISTIC
/begin CHARACTERISTIC FCdc4_RS485_Rx_noise "FCtl_DTC_0x04(123)" VALUE 0x001E418C /* @ECU_Address@FCtl_DTC_0x04@0x024C40F6@ */ ECIPP_ALIGNMENT_UWORD 65535 Compu_IDENTITY 0 65535 PHYS_UNIT "System ID + DTC" /end CHARACTERISTIC
/begin CHARACTERISTIC FCdc4_RS485_SD_rq "FCtl_DTC_0x04(125)" VALUE 0x001E4190 /* @ECU_Address@FCtl_DTC_0x04@0x024C40FA@ */ ECIPP_ALIGNMENT_UWORD 65535 Compu_IDENTITY 0 65535 PHYS_UNIT "System ID + DTC" /end CHARACTERISTIC
/begin CHARACTERISTIC FCdc4_RTI1 "FCtl_DTC_0x04(100)" VALUE 0x001E415E /* @ECU_Address@FCtl_DTC_0x04@0x024C40C8@ */ ECIPP_ALIGNMENT_UWORD 65535 Compu_IDENTITY 0 65535 PHYS_UNIT "System ID + DTC" /end CHARACTERISTIC
/begin CHARACTERISTIC FCdc4_RTI2 "FCtl_DTC_0x04(101)" VALUE 0x001E4160 /* @ECU_Address@FCtl_DTC_0x04@0x024C40CA@ */ ECIPP_ALIGNMENT_UWORD 65535 Compu_IDENTITY 0 65535 PHYS_UNIT "System ID + DTC" /end CHARACTERISTIC
/begin CHARACTERISTIC FCdc4_RTI3 "FCtl_DTC_0x04(102)" VALUE 0x001E4162 /* @ECU_Address@FCtl_DTC_0x04@0x024C40CC@ */ ECIPP_ALIGNMENT_UWORD 65535 Compu_IDENTITY 0 65535 PHYS_UNIT "System ID + DTC" /end CHARACTERISTIC
/begin CHARACTERISTIC FCdc4_Sec1_31KV_open "FCtl_DTC_0x04(949)" VALUE 0x001E4800 /* @ECU_Address@FCtl_DTC_0x04@0x024C476A@ */ ECIPP_ALIGNMENT_UWORD 65535 Compu_IDENTITY 0 65535 PHYS_UNIT "System ID + DTC" /end CHARACTERISTIC
/begin CHARACTERISTIC FCdc4_Sec1_low "FCtl_DTC_0x04(937)" VALUE 0x001E47E8 /* @ECU_Address@FCtl_DTC_0x04@0x024C4752@ */ ECIPP_ALIGNMENT_UWORD 65535 Compu_IDENTITY 0 65535 PHYS_UNIT "System ID + DTC" /end CHARACTERISTIC
/begin CHARACTERISTIC FCdc4_Sec1_open "FCtl_DTC_0x04(925)" VALUE 0x001E47D0 /* @ECU_Address@FCtl_DTC_0x04@0x024C473A@ */ ECIPP_ALIGNMENT_UWORD 65535 Compu_IDENTITY 0 65535 PHYS_UNIT "System ID + DTC" /end CHARACTERISTIC
/begin CHARACTERISTIC FCdc4_SHIFT_FB_OOR "FCtl_DTC_0x04(294)" VALUE 0x001E42E2 /* @ECU_Address@FCtl_DTC_0x04@0x024C424C@ */ ECIPP_ALIGNMENT_UWORD 65535 Compu_IDENTITY 0 65535 PHYS_UNIT "System ID + DTC" /end CHARACTERISTIC
/begin CHARACTERISTIC FCdc4_SHIFT_intcirc_fail "FCtl_DTC_0x04(296)" VALUE 0x001E42E6 /* @ECU_Address@FCtl_DTC_0x04@0x024C4250@ */ ECIPP_ALIGNMENT_UWORD 65535 Compu_IDENTITY 0 65535 PHYS_UNIT "System ID + DTC" /end CHARACTERISTIC
/begin CHARACTERISTIC FCdc4_SHIFT_shift_fail "FCtl_DTC_0x04(295)" VALUE 0x001E42E4 /* @ECU_Address@FCtl_DTC_0x04@0x024C424E@ */ ECIPP_ALIGNMENT_UWORD 65535 Compu_IDENTITY 0 65535 PHYS_UNIT "System ID + DTC" /end CHARACTERISTIC
/begin CHARACTERISTIC FCdc4_SL_fuel "FCtl_DTC_0x04(109)" VALUE 0x001E4170 /* @ECU_Address@FCtl_DTC_0x04@0x024C40DA@ */ ECIPP_ALIGNMENT_UWORD 65535 Compu_IDENTITY 0 65535 PHYS_UNIT "System ID + DTC" /end CHARACTERISTIC
/begin CHARACTERISTIC FCdc4_SL_gov "FCtl_DTC_0x04(108)" VALUE 0x001E416E /* @ECU_Address@FCtl_DTC_0x04@0x024C40D8@ */ ECIPP_ALIGNMENT_UWORD 65535 Compu_IDENTITY 0 65535 PHYS_UNIT "System ID + DTC" /end CHARACTERISTIC
/begin CHARACTERISTIC FCdc4_SL_spk "FCtl_DTC_0x04(110)" VALUE 0x001E4172 /* @ECU_Address@FCtl_DTC_0x04@0x024C40DC@ */ ECIPP_ALIGNMENT_UWORD 65535 Compu_IDENTITY 0 65535 PHYS_UNIT "System ID + DTC" /end CHARACTERISTIC
/begin CHARACTERISTIC FCdc4_slv_MAP_hi_OOA "FCtl_DTC_0x04(837)" VALUE 0x001E4720 /* @ECU_Address@FCtl_DTC_0x04@0x024C468A@ */ ECIPP_ALIGNMENT_UWORD 65535 Compu_IDENTITY 0 65535 PHYS_UNIT "System ID + DTC" /end CHARACTERISTIC
/begin CHARACTERISTIC FCdc4_slv_MAP_lo_OOA "FCtl_DTC_0x04(838)" VALUE 0x001E4722 /* @ECU_Address@FCtl_DTC_0x04@0x024C468C@ */ ECIPP_ALIGNMENT_UWORD 65535 Compu_IDENTITY 0 65535 PHYS_UNIT "System ID + DTC" /end CHARACTERISTIC
/begin CHARACTERISTIC FCdc4_SPK_int_fail "FCtl_DTC_0x04(303)" VALUE 0x001E42F4 /* @ECU_Address@FCtl_DTC_0x04@0x024C425E@ */ ECIPP_ALIGNMENT_UWORD 65535 Compu_IDENTITY 0 65535 PHYS_UNIT "System ID + DTC" /end CHARACTERISTIC
/begin CHARACTERISTIC FCdc4_SPK1_IGBT_T "FCtl_DTC_0x04(509)" VALUE 0x001E4490 /* @ECU_Address@FCtl_DTC_0x04@0x024C43FA@ */ ECIPP_ALIGNMENT_UWORD 65535 Compu_IDENTITY 0 65535 PHYS_UNIT "System ID + DTC" /end CHARACTERISTIC
/begin CHARACTERISTIC FCdc4_SPKD_coil_fail "FCtl_DTC_0x04(304)" VALUE 0x001E42F6 /* @ECU_Address@FCtl_DTC_0x04@0x024C4260@ */ ECIPP_ALIGNMENT_UWORD 65535 Compu_IDENTITY 0 65535 PHYS_UNIT "System ID + DTC" /end CHARACTERISTIC
/begin CHARACTERISTIC FCdc4_SPKD_dw_hi "FCtl_DTC_0x04(76)" VALUE 0x001E412E /* @ECU_Address@FCtl_DTC_0x04@0x024C4098@ */ ECIPP_ALIGNMENT_UWORD 65535 Compu_IDENTITY 0 65535 PHYS_UNIT "System ID + DTC" /end CHARACTERISTIC
/begin CHARACTERISTIC FCdc4_SPKD_dw_lo "FCtl_DTC_0x04(66)" VALUE 0x001E411A /* @ECU_Address@FCtl_DTC_0x04@0x024C4084@ */ ECIPP_ALIGNMENT_UWORD 65535 Compu_IDENTITY 0 65535 PHYS_UNIT "System ID + DTC" /end CHARACTERISTIC
/begin CHARACTERISTIC FCdc4_SRVC_expired "FCtl_DTC_0x04(426)" VALUE 0x001E43EA /* @ECU_Address@FCtl_DTC_0x04@0x024C4354@ */ ECIPP_ALIGNMENT_UWORD 65535 Compu_IDENTITY 0 65535 PHYS_UNIT "System ID + DTC" /end CHARACTERISTIC
/begin CHARACTERISTIC FCdc4_SRVC_expired2 "FCtl_DTC_0x04(836)" VALUE 0x001E471E /* @ECU_Address@FCtl_DTC_0x04@0x024C4688@ */ ECIPP_ALIGNMENT_UWORD 65535 Compu_IDENTITY 0 65535 PHYS_UNIT "System ID + DTC" /end CHARACTERISTIC
/begin CHARACTERISTIC FCdc4_start_coilopen "FCtl_DTC_0x04(162)" VALUE 0x001E41DA /* @ECU_Address@FCtl_DTC_0x04@0x024C4144@ */ ECIPP_ALIGNMENT_UWORD 65535 Compu_IDENTITY 0 65535 PHYS_UNIT "System ID + DTC" /end CHARACTERISTIC
/begin CHARACTERISTIC FPnd_PWM17_off_loVf "FPrm_pending(344)" VALUE 0x001E53C2 /* @ECU_Address@FPrm_pending@0x021BE2B0@ */ ECIPP_ALIGNMENT_UWORD 65535 Compu_IDENTITY 0 65535 PHYS_UNIT "Bit Mask" /end CHARACTERISTIC
/begin CHARACTERISTIC FPnd_PWM17_on_hiVf "FPrm_pending(345)" VALUE 0x001E53C4 /* @ECU_Address@FPrm_pending@0x021BE2B2@ */ ECIPP_ALIGNMENT_UWORD 65535 Compu_IDENTITY 0 65535 PHYS_UNIT "Bit Mask" /end CHARACTERISTIC
/begin CHARACTERISTIC FPnd_PWM18_off_loVf "FPrm_pending(346)" VALUE 0x001E53C6 /* @ECU_Address@FPrm_pending@0x021BE2B4@ */ ECIPP_ALIGNMENT_UWORD 65535 Compu_IDENTITY 0 65535 PHYS_UNIT "Bit Mask" /end CHARACTERISTIC
/begin CHARACTERISTIC FPnd_PWM18_on_hiVf "FPrm_pending(347)" VALUE 0x001E53C8 /* @ECU_Address@FPrm_pending@0x021BE2B6@ */ ECIPP_ALIGNMENT_UWORD 65535 Compu_IDENTITY 0 65535 PHYS_UNIT "Bit Mask" /end CHARACTERISTIC
/begin CHARACTERISTIC FPnd_PWM19_off_loVf "FPrm_pending(348)" VALUE 0x001E53CA /* @ECU_Address@FPrm_pending@0x021BE2B8@ */ ECIPP_ALIGNMENT_UWORD 65535 Compu_IDENTITY 0 65535 PHYS_UNIT "Bit Mask" /end CHARACTERISTIC
/begin CHARACTERISTIC FPnd_PWM19_on_hiVf "FPrm_pending(349)" VALUE 0x001E53CC /* @ECU_Address@FPrm_pending@0x021BE2BA@ */ ECIPP_ALIGNMENT_UWORD 65535 Compu_IDENTITY 0 65535 PHYS_UNIT "Bit Mask" /end CHARACTERISTIC
/begin CHARACTERISTIC FPnd_PWM2_off_loVf "FPrm_pending(149)" VALUE 0x001E523C /* @ECU_Address@FPrm_pending@0x021BE12A@ */ ECIPP_ALIGNMENT_UWORD 65535 Compu_IDENTITY 0 65535 PHYS_UNIT "Bit Mask" /end CHARACTERISTIC
/begin CHARACTERISTIC FPnd_PWM2_on_hiVf "FPrm_pending(150)" VALUE 0x001E523E /* @ECU_Address@FPrm_pending@0x021BE12C@ */ ECIPP_ALIGNMENT_UWORD 65535 Compu_IDENTITY 0 65535 PHYS_UNIT "Bit Mask" /end CHARACTERISTIC
/begin CHARACTERISTIC FPnd_PWM20_off_loVf "FPrm_pending(350)" VALUE 0x001E53CE /* @ECU_Address@FPrm_pending@0x021BE2BC@ */ ECIPP_ALIGNMENT_UWORD 65535 Compu_IDENTITY 0 65535 PHYS_UNIT "Bit Mask" /end CHARACTERISTIC
/begin CHARACTERISTIC FPnd_PWM20_on_hiVf "FPrm_pending(351)" VALUE 0x001E53D0 /* @ECU_Address@FPrm_pending@0x021BE2BE@ */ ECIPP_ALIGNMENT_UWORD 65535 Compu_IDENTITY 0 65535 PHYS_UNIT "Bit Mask" /end CHARACTERISTIC
/begin CHARACTERISTIC FPnd_PWM21_off_loVf "FPrm_pending(352)" VALUE 0x001E53D2 /* @ECU_Address@FPrm_pending@0x021BE2C0@ */ ECIPP_ALIGNMENT_UWORD 65535 Compu_IDENTITY 0 65535 PHYS_UNIT "Bit Mask" /end CHARACTERISTIC
/begin CHARACTERISTIC FPnd_PWM21_on_hiVf "FPrm_pending(353)" VALUE 0x001E53D4 /* @ECU_Address@FPrm_pending@0x021BE2C2@ */ ECIPP_ALIGNMENT_UWORD 65535 Compu_IDENTITY 0 65535 PHYS_UNIT "Bit Mask" /end CHARACTERISTIC
/begin CHARACTERISTIC FPnd_PWM22_off_loVf "FPrm_pending(354)" VALUE 0x001E53D6 /* @ECU_Address@FPrm_pending@0x021BE2C4@ */ ECIPP_ALIGNMENT_UWORD 65535 Compu_IDENTITY 0 65535 PHYS_UNIT "Bit Mask" /end CHARACTERISTIC
/begin CHARACTERISTIC FPnd_PWM22_on_hiVf "FPrm_pending(355)" VALUE 0x001E53D8 /* @ECU_Address@FPrm_pending@0x021BE2C6@ */ ECIPP_ALIGNMENT_UWORD 65535 Compu_IDENTITY 0 65535 PHYS_UNIT "Bit Mask" /end CHARACTERISTIC
/begin CHARACTERISTIC FPnd_PWM23_off_loVf "FPrm_pending(356)" VALUE 0x001E53DA /* @ECU_Address@FPrm_pending@0x021BE2C8@ */ ECIPP_ALIGNMENT_UWORD 65535 Compu_IDENTITY 0 65535 PHYS_UNIT "Bit Mask" /end CHARACTERISTIC
/begin CHARACTERISTIC FPnd_PWM23_on_hiVf "FPrm_pending(357)" VALUE 0x001E53DC /* @ECU_Address@FPrm_pending@0x021BE2CA@ */ ECIPP_ALIGNMENT_UWORD 65535 Compu_IDENTITY 0 65535 PHYS_UNIT "Bit Mask" /end CHARACTERISTIC
/begin CHARACTERISTIC FPnd_PWM3_off_loVf "FPrm_pending(151)" VALUE 0x001E5240 /* @ECU_Address@FPrm_pending@0x021BE12E@ */ ECIPP_ALIGNMENT_UWORD 65535 Compu_IDENTITY 0 65535 PHYS_UNIT "Bit Mask" /end CHARACTERISTIC
/begin CHARACTERISTIC FPnd_PWM3_on_hiVf "FPrm_pending(152)" VALUE 0x001E5242 /* @ECU_Address@FPrm_pending@0x021BE130@ */ ECIPP_ALIGNMENT_UWORD 65535 Compu_IDENTITY 0 65535 PHYS_UNIT "Bit Mask" /end CHARACTERISTIC
/begin CHARACTERISTIC FPnd_PWM4_off_loVf "FPrm_pending(153)" VALUE 0x001E5244 /* @ECU_Address@FPrm_pending@0x021BE132@ */ ECIPP_ALIGNMENT_UWORD 65535 Compu_IDENTITY 0 65535 PHYS_UNIT "Bit Mask" /end CHARACTERISTIC
/begin CHARACTERISTIC FPnd_PWM4_on_hiVf "FPrm_pending(154)" VALUE 0x001E5246 /* @ECU_Address@FPrm_pending@0x021BE134@ */ ECIPP_ALIGNMENT_UWORD 65535 Compu_IDENTITY 0 65535 PHYS_UNIT "Bit Mask" /end CHARACTERISTIC
/begin CHARACTERISTIC FPnd_PWM5_off_loVf "FPrm_pending(155)" VALUE 0x001E5248 /* @ECU_Address@FPrm_pending@0x021BE136@ */ ECIPP_ALIGNMENT_UWORD 65535 Compu_IDENTITY 0 65535 PHYS_UNIT "Bit Mask" /end CHARACTERISTIC
/begin CHARACTERISTIC FPnd_PWM5_on_hiVf "FPrm_pending(156)" VALUE 0x001E524A /* @ECU_Address@FPrm_pending@0x021BE138@ */ ECIPP_ALIGNMENT_UWORD 65535 Compu_IDENTITY 0 65535 PHYS_UNIT "Bit Mask" /end CHARACTERISTIC
/begin CHARACTERISTIC FPnd_PWM6_off_loVf "FPrm_pending(198)" VALUE 0x001E529E /* @ECU_Address@FPrm_pending@0x021BE18C@ */ ECIPP_ALIGNMENT_UWORD 65535 Compu_IDENTITY 0 65535 PHYS_UNIT "Bit Mask" /end CHARACTERISTIC
/begin CHARACTERISTIC FPnd_PWM6_on_hiVf "FPrm_pending(199)" VALUE 0x001E52A0 /* @ECU_Address@FPrm_pending@0x021BE18E@ */ ECIPP_ALIGNMENT_UWORD 65535 Compu_IDENTITY 0 65535 PHYS_UNIT "Bit Mask" /end CHARACTERISTIC
/begin CHARACTERISTIC FPnd_PWM7_off_loVf "FPrm_pending(200)" VALUE 0x001E52A2 /* @ECU_Address@FPrm_pending@0x021BE190@ */ ECIPP_ALIGNMENT_UWORD 65535 Compu_IDENTITY 0 65535 PHYS_UNIT "Bit Mask" /end CHARACTERISTIC
/begin CHARACTERISTIC FPnd_PWM7_on_hiVf "FPrm_pending(201)" VALUE 0x001E52A4 /* @ECU_Address@FPrm_pending@0x021BE192@ */ ECIPP_ALIGNMENT_UWORD 65535 Compu_IDENTITY 0 65535 PHYS_UNIT "Bit Mask" /end CHARACTERISTIC
/begin CHARACTERISTIC FPnd_PWM8_off_loVf "FPrm_pending(205)" VALUE 0x001E52AC /* @ECU_Address@FPrm_pending@0x021BE19A@ */ ECIPP_ALIGNMENT_UWORD 65535 Compu_IDENTITY 0 65535 PHYS_UNIT "Bit Mask" /end CHARACTERISTIC
/begin CHARACTERISTIC FPnd_PWM8_on_hiVf "FPrm_pending(206)" VALUE 0x001E52AE /* @ECU_Address@FPrm_pending@0x021BE19C@ */ ECIPP_ALIGNMENT_UWORD 65535 Compu_IDENTITY 0 65535 PHYS_UNIT "Bit Mask" /end CHARACTERISTIC
/begin CHARACTERISTIC FPnd_PWM9_off_loVf "FPrm_pending(207)" VALUE 0x001E52B0 /* @ECU_Address@FPrm_pending@0x021BE19E@ */ ECIPP_ALIGNMENT_UWORD 65535 Compu_IDENTITY 0 65535 PHYS_UNIT "Bit Mask" /end CHARACTERISTIC
/begin CHARACTERISTIC FPnd_PWM9_on_hiVf "FPrm_pending(208)" VALUE 0x001E52B2 /* @ECU_Address@FPrm_pending@0x021BE1A0@ */ ECIPP_ALIGNMENT_UWORD 65535 Compu_IDENTITY 0 65535 PHYS_UNIT "Bit Mask" /end CHARACTERISTIC
/begin CHARACTERISTIC FPnd_PWMLO_off_loVf "FPrm_pending(391)" VALUE 0x001E5420 /* @ECU_Address@FPrm_pending@0x021BE30E@ */ ECIPP_ALIGNMENT_UWORD 65535 Compu_IDENTITY 0 65535 PHYS_UNIT "Bit Mask" /end CHARACTERISTIC
/begin CHARACTERISTIC FPnd_PWMLO_on_hiVf "FPrm_pending(392)" VALUE 0x001E5422 /* @ECU_Address@FPrm_pending@0x021BE310@ */ ECIPP_ALIGNMENT_UWORD 65535 Compu_IDENTITY 0 65535 PHYS_UNIT "Bit Mask" /end CHARACTERISTIC
/begin CHARACTERISTIC FPnd_radby_poserr "FPrm_pending(697)" VALUE 0x001E5684 /* @ECU_Address@FPrm_pending@0x021BE572@ */ ECIPP_ALIGNMENT_UWORD 65535 Compu_IDENTITY 0 65535 PHYS_UNIT "Bit Mask" /end CHARACTERISTIC
/begin CHARACTERISTIC FPnd_RAM_fail "FPrm_pending(70)" VALUE 0x001E519E /* @ECU_Address@FPrm_pending@0x021BE08C@ */ ECIPP_ALIGNMENT_UWORD 65535 Compu_IDENTITY 0 65535 PHYS_UNIT "Bit Mask" /end CHARACTERISTIC
/begin CHARACTERISTIC FPnd_relay_coilopen "FPrm_pending(119)" VALUE 0x001E5200 /* @ECU_Address@FPrm_pending@0x021BE0EE@ */ ECIPP_ALIGNMENT_UWORD 65535 Compu_IDENTITY 0 65535 PHYS_UNIT "Bit Mask" /end CHARACTERISTIC
/begin CHARACTERISTIC FPnd_relay_coilshort "FPrm_pending(120)" VALUE 0x001E5202 /* @ECU_Address@FPrm_pending@0x021BE0F0@ */ ECIPP_ALIGNMENT_UWORD 65535 Compu_IDENTITY 0 65535 PHYS_UNIT "Bit Mask" /end CHARACTERISTIC
/begin CHARACTERISTIC FPnd_relay_gndshort "FPrm_pending(118)" VALUE 0x001E51FE /* @ECU_Address@FPrm_pending@0x021BE0EC@ */ ECIPP_ALIGNMENT_UWORD 65535 Compu_IDENTITY 0 65535 PHYS_UNIT "Bit Mask" /end CHARACTERISTIC
/begin CHARACTERISTIC FPnd_relayoff_hiV "FPrm_pending(328)" VALUE 0x001E53A2 /* @ECU_Address@FPrm_pending@0x021BE290@ */ ECIPP_ALIGNMENT_UWORD 65535 Compu_IDENTITY 0 65535 PHYS_UNIT "Bit Mask" /end CHARACTERISTIC
/begin CHARACTERISTIC FPnd_relayon_loV "FPrm_pending(329)" VALUE 0x001E53A4 /* @ECU_Address@FPrm_pending@0x021BE292@ */ ECIPP_ALIGNMENT_UWORD 65535 Compu_IDENTITY 0 65535 PHYS_UNIT "Bit Mask" /end CHARACTERISTIC
/begin CHARACTERISTIC FPnd_rpm_hi_expected "FPrm_pending(260)" VALUE 0x001E531A /* @ECU_Address@FPrm_pending@0x021BE208@ */ ECIPP_ALIGNMENT_UWORD 65535 Compu_IDENTITY 0 65535 PHYS_UNIT "Bit Mask" /end CHARACTERISTIC
/begin CHARACTERISTIC FPnd_rpmd_gov_lo "FPrm_pending(390)" VALUE 0x001E541E /* @ECU_Address@FPrm_pending@0x021BE30C@ */ ECIPP_ALIGNMENT_UWORD 65535 Compu_IDENTITY 0 65535 PHYS_UNIT "Bit Mask" /end CHARACTERISTIC
/begin CHARACTERISTIC FPnd_RS_discon "FPrm_pending(521)" VALUE 0x001E5524 /* @ECU_Address@FPrm_pending@0x021BE412@ */ ECIPP_ALIGNMENT_UWORD 65535 Compu_IDENTITY 0 65535 PHYS_UNIT "Bit Mask" /end CHARACTERISTIC
/begin CHARACTERISTIC FPnd_RS_hiV "FPrm_pending(453)" VALUE 0x001E549C /* @ECU_Address@FPrm_pending@0x021BE38A@ */ ECIPP_ALIGNMENT_UWORD 65535 Compu_IDENTITY 0 65535 PHYS_UNIT "Bit Mask" /end CHARACTERISTIC
/begin CHARACTERISTIC FPnd_RS_loss "FPrm_pending(176)" VALUE 0x001E5272 /* @ECU_Address@FPrm_pending@0x021BE160@ */ ECIPP_ALIGNMENT_UWORD 65535 Compu_IDENTITY 0 65535 PHYS_UNIT "Bit Mask" /end CHARACTERISTIC
/begin CHARACTERISTIC FPnd_RS_loV "FPrm_pending(452)" VALUE 0x001E549A /* @ECU_Address@FPrm_pending@0x021BE388@ */ ECIPP_ALIGNMENT_UWORD 65535 Compu_IDENTITY 0 65535 PHYS_UNIT "Bit Mask" /end CHARACTERISTIC
/begin CHARACTERISTIC FPnd_RS485_bad_fmt "FPrm_pending(83)" VALUE 0x001E51B8 /* @ECU_Address@FPrm_pending@0x021BE0A6@ */ ECIPP_ALIGNMENT_UWORD 65535 Compu_IDENTITY 0 65535 PHYS_UNIT "Bit Mask" /end CHARACTERISTIC
/begin CHARACTERISTIC FPnd_RS485_Rx_inact "FPrm_pending(81)" VALUE 0x001E51B4 /* @ECU_Address@FPrm_pending@0x021BE0A2@ */ ECIPP_ALIGNMENT_UWORD 65535 Compu_IDENTITY 0 65535 PHYS_UNIT "Bit Mask" /end CHARACTERISTIC
/begin CHARACTERISTIC FPnd_RS485_Rx_noise "FPrm_pending(82)" VALUE 0x001E51B6 /* @ECU_Address@FPrm_pending@0x021BE0A4@ */ ECIPP_ALIGNMENT_UWORD 65535 Compu_IDENTITY 0 65535 PHYS_UNIT "Bit Mask" /end CHARACTERISTIC
/begin CHARACTERISTIC FPnd_RS485_SD_rq "FPrm_pending(84)" VALUE 0x001E51BA /* @ECU_Address@FPrm_pending@0x021BE0A8@ */ ECIPP_ALIGNMENT_UWORD 65535 Compu_IDENTITY 0 65535 PHYS_UNIT "Bit Mask" /end CHARACTERISTIC
/begin CHARACTERISTIC FPnd_RTI1 "FPrm_pending(64)" VALUE 0x001E5192 /* @ECU_Address@FPrm_pending@0x021BE080@ */ ECIPP_ALIGNMENT_UWORD 65535 Compu_IDENTITY 0 65535 PHYS_UNIT "Bit Mask" /end CHARACTERISTIC
/begin CHARACTERISTIC FPnd_RTI2 "FPrm_pending(65)" VALUE 0x001E5194 /* @ECU_Address@FPrm_pending@0x021BE082@ */ ECIPP_ALIGNMENT_UWORD 65535 Compu_IDENTITY 0 65535 PHYS_UNIT "Bit Mask" /end CHARACTERISTIC
/begin CHARACTERISTIC FPnd_RTI3 "FPrm_pending(66)" VALUE 0x001E5196 /* @ECU_Address@FPrm_pending@0x021BE084@ */ ECIPP_ALIGNMENT_UWORD 65535 Compu_IDENTITY 0 65535 PHYS_UNIT "Bit Mask" /end CHARACTERISTIC
/begin CHARACTERISTIC FPnd_Sec1_31KV_open "FPrm_pending(707)" VALUE 0x001E5698 /* @ECU_Address@FPrm_pending@0x021BE586@ */ ECIPP_ALIGNMENT_UWORD 65535 Compu_IDENTITY 0 65535 PHYS_UNIT "Bit Mask" /end CHARACTERISTIC
/begin CHARACTERISTIC FPnd_Sec1_low "FPrm_pending(706)" VALUE 0x001E5696 /* @ECU_Address@FPrm_pending@0x021BE584@ */ ECIPP_ALIGNMENT_UWORD 65535 Compu_IDENTITY 0 65535 PHYS_UNIT "Bit Mask" /end CHARACTERISTIC
/begin CHARACTERISTIC FPnd_Sec1_open "FPrm_pending(705)" VALUE 0x001E5694 /* @ECU_Address@FPrm_pending@0x021BE582@ */ ECIPP_ALIGNMENT_UWORD 65535 Compu_IDENTITY 0 65535 PHYS_UNIT "Bit Mask" /end CHARACTERISTIC
/begin CHARACTERISTIC FPnd_SHIFT_FB_OOR "FPrm_pending(216)" VALUE 0x001E52C2 /* @ECU_Address@FPrm_pending@0x021BE1B0@ */ ECIPP_ALIGNMENT_UWORD 65535 Compu_IDENTITY 0 65535 PHYS_UNIT "Bit Mask" /end CHARACTERISTIC
/begin CHARACTERISTIC FPnd_SHIFT_intcirc_fail "FPrm_pending(218)" VALUE 0x001E52C6 /* @ECU_Address@FPrm_pending@0x021BE1B4@ */ ECIPP_ALIGNMENT_UWORD 65535 Compu_IDENTITY 0 65535 PHYS_UNIT "Bit Mask" /end CHARACTERISTIC
/begin CHARACTERISTIC FPnd_SHIFT_shift_fail "FPrm_pending(217)" VALUE 0x001E52C4 /* @ECU_Address@FPrm_pending@0x021BE1B2@ */ ECIPP_ALIGNMENT_UWORD 65535 Compu_IDENTITY 0 65535 PHYS_UNIT "Bit Mask" /end CHARACTERISTIC
/begin CHARACTERISTIC FPnd_SL_fuel "FPrm_pending(38)" VALUE 0x001E515E /* @ECU_Address@FPrm_pending@0x021BE04C@ */ ECIPP_ALIGNMENT_UWORD 65535 Compu_IDENTITY 0 65535 PHYS_UNIT "Bit Mask" /end CHARACTERISTIC
/begin CHARACTERISTIC FPnd_SL_gov "FPrm_pending(37)" VALUE 0x001E515C /* @ECU_Address@FPrm_pending@0x021BE04A@ */ ECIPP_ALIGNMENT_UWORD 65535 Compu_IDENTITY 0 65535 PHYS_UNIT "Bit Mask" /end CHARACTERISTIC
/begin CHARACTERISTIC FPnd_SL_spk "FPrm_pending(39)" VALUE 0x001E5160 /* @ECU_Address@FPrm_pending@0x021BE04E@ */ ECIPP_ALIGNMENT_UWORD 65535 Compu_IDENTITY 0 65535 PHYS_UNIT "Bit Mask" /end CHARACTERISTIC
/begin CHARACTERISTIC FPnd_slv_MAP_hi_OOA "FPrm_pending(664)" VALUE 0x001E5642 /* @ECU_Address@FPrm_pending@0x021BE530@ */ ECIPP_ALIGNMENT_UWORD 65535 Compu_IDENTITY 0 65535 PHYS_UNIT "Bit Mask" /end CHARACTERISTIC
/begin CHARACTERISTIC FPnd_slv_MAP_lo_OOA "FPrm_pending(665)" VALUE 0x001E5644 /* @ECU_Address@FPrm_pending@0x021BE532@ */ ECIPP_ALIGNMENT_UWORD 65535 Compu_IDENTITY 0 65535 PHYS_UNIT "Bit Mask" /end CHARACTERISTIC
/begin CHARACTERISTIC FPnd_SPK_int_fail "FPrm_pending(225)" VALUE 0x001E52D4 /* @ECU_Address@FPrm_pending@0x021BE1C2@ */ ECIPP_ALIGNMENT_UWORD 65535 Compu_IDENTITY 0 65535 PHYS_UNIT "Bit Mask" /end CHARACTERISTIC
/begin CHARACTERISTIC FPnd_SPK1_IGBT_T "FPrm_pending(388)" VALUE 0x001E541A /* @ECU_Address@FPrm_pending@0x021BE308@ */ ECIPP_ALIGNMENT_UWORD 65535 Compu_IDENTITY 0 65535 PHYS_UNIT "Bit Mask" /end CHARACTERISTIC
/begin CHARACTERISTIC FPnd_SPKD_coil_fail "FPrm_pending(226)" VALUE 0x001E52D6 /* @ECU_Address@FPrm_pending@0x021BE1C4@ */ ECIPP_ALIGNMENT_UWORD 65535 Compu_IDENTITY 0 65535 PHYS_UNIT "Bit Mask" /end CHARACTERISTIC
/begin CHARACTERISTIC FPnd_SPKD_dw_hi "FPrm_pending(56)" VALUE 0x001E5182 /* @ECU_Address@FPrm_pending@0x021BE070@ */ ECIPP_ALIGNMENT_UWORD 65535 Compu_IDENTITY 0 65535 PHYS_UNIT "Bit Mask" /end CHARACTERISTIC
/begin CHARACTERISTIC FPnd_SPKD_dw_lo "FPrm_pending(55)" VALUE 0x001E5180 /* @ECU_Address@FPrm_pending@0x021BE06E@ */ ECIPP_ALIGNMENT_UWORD 65535 Compu_IDENTITY 0 65535 PHYS_UNIT "Bit Mask" /end CHARACTERISTIC
/begin CHARACTERISTIC FPnd_SRVC_expired "FPrm_pending(323)" VALUE 0x001E5398 /* @ECU_Address@FPrm_pending@0x021BE286@ */ ECIPP_ALIGNMENT_UWORD 65535 Compu_IDENTITY 0 65535 PHYS_UNIT "Bit Mask" /end CHARACTERISTIC
/begin CHARACTERISTIC FPnd_SRVC_expired2 "FPrm_pending(663)" VALUE 0x001E5640 /* @ECU_Address@FPrm_pending@0x021BE52E@ */ ECIPP_ALIGNMENT_UWORD 65535 Compu_IDENTITY 0 65535 PHYS_UNIT "Bit Mask" /end CHARACTERISTIC
/begin CHARACTERISTIC FPnd_start_coilopen "FPrm_pending(122)" VALUE 0x001E5206 /* @ECU_Address@FPrm_pending@0x021BE0F4@ */ ECIPP_ALIGNMENT_UWORD 65535 Compu_IDENTITY 0 65535 PHYS_UNIT "Bit Mask" /end CHARACTERISTIC
/begin CHARACTERISTIC FPsvr_PWM17_off_loVf "FPrm_severity(344)" VALUE 0x001E696D /* @ECU_Address@FPrm_severity@0x024B3158@ */ ECIPP_ALIGNMENT_UBYTE 255 Compu_IDENTITY 0 255 PHYS_UNIT "Severity+Class" /end CHARACTERISTIC
/begin CHARACTERISTIC FPsvr_PWM17_on_hiVf "FPrm_severity(345)" VALUE 0x001E696E /* @ECU_Address@FPrm_severity@0x024B3159@ */ ECIPP_ALIGNMENT_UBYTE 255 Compu_IDENTITY 0 255 PHYS_UNIT "Severity+Class" /end CHARACTERISTIC
/begin CHARACTERISTIC FPsvr_PWM18_off_loVf "FPrm_severity(346)" VALUE 0x001E696F /* @ECU_Address@FPrm_severity@0x024B315A@ */ ECIPP_ALIGNMENT_UBYTE 255 Compu_IDENTITY 0 255 PHYS_UNIT "Severity+Class" /end CHARACTERISTIC
/begin CHARACTERISTIC FPsvr_PWM18_on_hiVf "FPrm_severity(347)" VALUE 0x001E6970 /* @ECU_Address@FPrm_severity@0x024B315B@ */ ECIPP_ALIGNMENT_UBYTE 255 Compu_IDENTITY 0 255 PHYS_UNIT "Severity+Class" /end CHARACTERISTIC
/begin CHARACTERISTIC FPsvr_PWM19_off_loVf "FPrm_severity(348)" VALUE 0x001E6971 /* @ECU_Address@FPrm_severity@0x024B315C@ */ ECIPP_ALIGNMENT_UBYTE 255 Compu_IDENTITY 0 255 PHYS_UNIT "Severity+Class" /end CHARACTERISTIC
/begin CHARACTERISTIC FPsvr_PWM19_on_hiVf "FPrm_severity(349)" VALUE 0x001E6972 /* @ECU_Address@FPrm_severity@0x024B315D@ */ ECIPP_ALIGNMENT_UBYTE 255 Compu_IDENTITY 0 255 PHYS_UNIT "Severity+Class" /end CHARACTERISTIC
/begin CHARACTERISTIC FPsvr_PWM2_off_loVf "FPrm_severity(149)" VALUE 0x001E68AA /* @ECU_Address@FPrm_severity@0x024B3095@ */ ECIPP_ALIGNMENT_UBYTE 255 Compu_IDENTITY 0 255 PHYS_UNIT "Severity+Class" /end CHARACTERISTIC
/begin CHARACTERISTIC FPsvr_PWM2_on_hiVf "FPrm_severity(150)" VALUE 0x001E68AB /* @ECU_Address@FPrm_severity@0x024B3096@ */ ECIPP_ALIGNMENT_UBYTE 255 Compu_IDENTITY 0 255 PHYS_UNIT "Severity+Class" /end CHARACTERISTIC
/begin CHARACTERISTIC FPsvr_PWM20_off_loVf "FPrm_severity(350)" VALUE 0x001E6973 /* @ECU_Address@FPrm_severity@0x024B315E@ */ ECIPP_ALIGNMENT_UBYTE 255 Compu_IDENTITY 0 255 PHYS_UNIT "Severity+Class" /end CHARACTERISTIC
/begin CHARACTERISTIC FPsvr_PWM20_on_hiVf "FPrm_severity(351)" VALUE 0x001E6974 /* @ECU_Address@FPrm_severity@0x024B315F@ */ ECIPP_ALIGNMENT_UBYTE 255 Compu_IDENTITY 0 255 PHYS_UNIT "Severity+Class" /end CHARACTERISTIC
/begin CHARACTERISTIC FPsvr_PWM21_off_loVf "FPrm_severity(352)" VALUE 0x001E6975 /* @ECU_Address@FPrm_severity@0x024B3160@ */ ECIPP_ALIGNMENT_UBYTE 255 Compu_IDENTITY 0 255 PHYS_UNIT "Severity+Class" /end CHARACTERISTIC
/begin CHARACTERISTIC FPsvr_PWM21_on_hiVf "FPrm_severity(353)" VALUE 0x001E6976 /* @ECU_Address@FPrm_severity@0x024B3161@ */ ECIPP_ALIGNMENT_UBYTE 255 Compu_IDENTITY 0 255 PHYS_UNIT "Severity+Class" /end CHARACTERISTIC
/begin CHARACTERISTIC FPsvr_PWM22_off_loVf "FPrm_severity(354)" VALUE 0x001E6977 /* @ECU_Address@FPrm_severity@0x024B3162@ */ ECIPP_ALIGNMENT_UBYTE 255 Compu_IDENTITY 0 255 PHYS_UNIT "Severity+Class" /end CHARACTERISTIC
/begin CHARACTERISTIC FPsvr_PWM22_on_hiVf "FPrm_severity(355)" VALUE 0x001E6978 /* @ECU_Address@FPrm_severity@0x024B3163@ */ ECIPP_ALIGNMENT_UBYTE 255 Compu_IDENTITY 0 255 PHYS_UNIT "Severity+Class" /end CHARACTERISTIC
/begin CHARACTERISTIC FPsvr_PWM23_off_loVf "FPrm_severity(356)" VALUE 0x001E6979 /* @ECU_Address@FPrm_severity@0x024B3164@ */ ECIPP_ALIGNMENT_UBYTE 255 Compu_IDENTITY 0 255 PHYS_UNIT "Severity+Class" /end CHARACTERISTIC
/begin CHARACTERISTIC FPsvr_PWM23_on_hiVf "FPrm_severity(357)" VALUE 0x001E697A /* @ECU_Address@FPrm_severity@0x024B3165@ */ ECIPP_ALIGNMENT_UBYTE 255 Compu_IDENTITY 0 255 PHYS_UNIT "Severity+Class" /end CHARACTERISTIC
/begin CHARACTERISTIC FPsvr_PWM3_off_loVf "FPrm_severity(151)" VALUE 0x001E68AC /* @ECU_Address@FPrm_severity@0x024B3097@ */ ECIPP_ALIGNMENT_UBYTE 255 Compu_IDENTITY 0 255 PHYS_UNIT "Severity+Class" /end CHARACTERISTIC
/begin CHARACTERISTIC FPsvr_PWM3_on_hiVf "FPrm_severity(152)" VALUE 0x001E68AD /* @ECU_Address@FPrm_severity@0x024B3098@ */ ECIPP_ALIGNMENT_UBYTE 255 Compu_IDENTITY 0 255 PHYS_UNIT "Severity+Class" /end CHARACTERISTIC
/begin CHARACTERISTIC FPsvr_PWM4_off_loVf "FPrm_severity(153)" VALUE 0x001E68AE /* @ECU_Address@FPrm_severity@0x024B3099@ */ ECIPP_ALIGNMENT_UBYTE 255 Compu_IDENTITY 0 255 PHYS_UNIT "Severity+Class" /end CHARACTERISTIC
/begin CHARACTERISTIC FPsvr_PWM4_on_hiVf "FPrm_severity(154)" VALUE 0x001E68AF /* @ECU_Address@FPrm_severity@0x024B309A@ */ ECIPP_ALIGNMENT_UBYTE 255 Compu_IDENTITY 0 255 PHYS_UNIT "Severity+Class" /end CHARACTERISTIC
/begin CHARACTERISTIC FPsvr_PWM5_off_loVf "FPrm_severity(155)" VALUE 0x001E68B0 /* @ECU_Address@FPrm_severity@0x024B309B@ */ ECIPP_ALIGNMENT_UBYTE 255 Compu_IDENTITY 0 255 PHYS_UNIT "Severity+Class" /end CHARACTERISTIC
/begin CHARACTERISTIC FPsvr_PWM5_on_hiVf "FPrm_severity(156)" VALUE 0x001E68B1 /* @ECU_Address@FPrm_severity@0x024B309C@ */ ECIPP_ALIGNMENT_UBYTE 255 Compu_IDENTITY 0 255 PHYS_UNIT "Severity+Class" /end CHARACTERISTIC
/begin CHARACTERISTIC FPsvr_PWM6_off_loVf "FPrm_severity(198)" VALUE 0x001E68DB /* @ECU_Address@FPrm_severity@0x024B30C6@ */ ECIPP_ALIGNMENT_UBYTE 255 Compu_IDENTITY 0 255 PHYS_UNIT "Severity+Class" /end CHARACTERISTIC
/begin CHARACTERISTIC FPsvr_PWM6_on_hiVf "FPrm_severity(199)" VALUE 0x001E68DC /* @ECU_Address@FPrm_severity@0x024B30C7@ */ ECIPP_ALIGNMENT_UBYTE 255 Compu_IDENTITY 0 255 PHYS_UNIT "Severity+Class" /end CHARACTERISTIC
/begin CHARACTERISTIC FPsvr_PWM7_off_loVf "FPrm_severity(200)" VALUE 0x001E68DD /* @ECU_Address@FPrm_severity@0x024B30C8@ */ ECIPP_ALIGNMENT_UBYTE 255 Compu_IDENTITY 0 255 PHYS_UNIT "Severity+Class" /end CHARACTERISTIC
/begin CHARACTERISTIC FPsvr_PWM7_on_hiVf "FPrm_severity(201)" VALUE 0x001E68DE /* @ECU_Address@FPrm_severity@0x024B30C9@ */ ECIPP_ALIGNMENT_UBYTE 255 Compu_IDENTITY 0 255 PHYS_UNIT "Severity+Class" /end CHARACTERISTIC
/begin CHARACTERISTIC FPsvr_PWM8_off_loVf "FPrm_severity(205)" VALUE 0x001E68E2 /* @ECU_Address@FPrm_severity@0x024B30CD@ */ ECIPP_ALIGNMENT_UBYTE 255 Compu_IDENTITY 0 255 PHYS_UNIT "Severity+Class" /end CHARACTERISTIC
/begin CHARACTERISTIC FPsvr_PWM8_on_hiVf "FPrm_severity(206)" VALUE 0x001E68E3 /* @ECU_Address@FPrm_severity@0x024B30CE@ */ ECIPP_ALIGNMENT_UBYTE 255 Compu_IDENTITY 0 255 PHYS_UNIT "Severity+Class" /end CHARACTERISTIC
/begin CHARACTERISTIC FPsvr_PWM9_off_loVf "FPrm_severity(207)" VALUE 0x001E68E4 /* @ECU_Address@FPrm_severity@0x024B30CF@ */ ECIPP_ALIGNMENT_UBYTE 255 Compu_IDENTITY 0 255 PHYS_UNIT "Severity+Class" /end CHARACTERISTIC
/begin CHARACTERISTIC FPsvr_PWM9_on_hiVf "FPrm_severity(208)" VALUE 0x001E68E5 /* @ECU_Address@FPrm_severity@0x024B30D0@ */ ECIPP_ALIGNMENT_UBYTE 255 Compu_IDENTITY 0 255 PHYS_UNIT "Severity+Class" /end CHARACTERISTIC
/begin CHARACTERISTIC FPsvr_PWMLO_off_loVf "FPrm_severity(391)" VALUE 0x001E699C /* @ECU_Address@FPrm_severity@0x024B3187@ */ ECIPP_ALIGNMENT_UBYTE 255 Compu_IDENTITY 0 255 PHYS_UNIT "Severity+Class" /end CHARACTERISTIC
/begin CHARACTERISTIC FPsvr_PWMLO_on_hiVf "FPrm_severity(392)" VALUE 0x001E699D /* @ECU_Address@FPrm_severity@0x024B3188@ */ ECIPP_ALIGNMENT_UBYTE 255 Compu_IDENTITY 0 255 PHYS_UNIT "Severity+Class" /end CHARACTERISTIC
/begin CHARACTERISTIC FPsvr_radby_poserr "FPrm_severity(697)" VALUE 0x001E6ACE /* @ECU_Address@FPrm_severity@0x024B32B9@ */ ECIPP_ALIGNMENT_UBYTE 255 Compu_IDENTITY 0 255 PHYS_UNIT "Severity+Class" /end CHARACTERISTIC
/begin CHARACTERISTIC FPsvr_RAM_fail "FPrm_severity(70)" VALUE 0x001E685B /* @ECU_Address@FPrm_severity@0x024B3046@ */ ECIPP_ALIGNMENT_UBYTE 255 Compu_IDENTITY 0 255 PHYS_UNIT "Severity+Class" /end CHARACTERISTIC
/begin CHARACTERISTIC FPsvr_relay_coilopen "FPrm_severity(119)" VALUE 0x001E688C /* @ECU_Address@FPrm_severity@0x024B3077@ */ ECIPP_ALIGNMENT_UBYTE 255 Compu_IDENTITY 0 255 PHYS_UNIT "Severity+Class" /end CHARACTERISTIC
/begin CHARACTERISTIC FPsvr_relay_coilshort "FPrm_severity(120)" VALUE 0x001E688D /* @ECU_Address@FPrm_severity@0x024B3078@ */ ECIPP_ALIGNMENT_UBYTE 255 Compu_IDENTITY 0 255 PHYS_UNIT "Severity+Class" /end CHARACTERISTIC
/begin CHARACTERISTIC FPsvr_relay_gndshort "FPrm_severity(118)" VALUE 0x001E688B /* @ECU_Address@FPrm_severity@0x024B3076@ */ ECIPP_ALIGNMENT_UBYTE 255 Compu_IDENTITY 0 255 PHYS_UNIT "Severity+Class" /end CHARACTERISTIC
/begin CHARACTERISTIC FPsvr_relayoff_hiV "FPrm_severity(328)" VALUE 0x001E695D /* @ECU_Address@FPrm_severity@0x024B3148@ */ ECIPP_ALIGNMENT_UBYTE 255 Compu_IDENTITY 0 255 PHYS_UNIT "Severity+Class" /end CHARACTERISTIC
/begin CHARACTERISTIC FPsvr_relayon_loV "FPrm_severity(329)" VALUE 0x001E695E /* @ECU_Address@FPrm_severity@0x024B3149@ */ ECIPP_ALIGNMENT_UBYTE 255 Compu_IDENTITY 0 255 PHYS_UNIT "Severity+Class" /end CHARACTERISTIC
/begin CHARACTERISTIC FPsvr_rpm_hi_expected "FPrm_severity(260)" VALUE 0x001E6919 /* @ECU_Address@FPrm_severity@0x024B3104@ */ ECIPP_ALIGNMENT_UBYTE 255 Compu_IDENTITY 0 255 PHYS_UNIT "Severity+Class" /end CHARACTERISTIC
/begin CHARACTERISTIC FPsvr_rpmd_gov_lo "FPrm_severity(390)" VALUE 0x001E699B /* @ECU_Address@FPrm_severity@0x024B3186@ */ ECIPP_ALIGNMENT_UBYTE 255 Compu_IDENTITY 0 255 PHYS_UNIT "Severity+Class" /end CHARACTERISTIC
/begin CHARACTERISTIC FPsvr_RS_discon "FPrm_severity(521)" VALUE 0x001E6A1E /* @ECU_Address@FPrm_severity@0x024B3209@ */ ECIPP_ALIGNMENT_UBYTE 255 Compu_IDENTITY 0 255 PHYS_UNIT "Severity+Class" /end CHARACTERISTIC
/begin CHARACTERISTIC FPsvr_RS_hiV "FPrm_severity(453)" VALUE 0x001E69DA /* @ECU_Address@FPrm_severity@0x024B31C5@ */ ECIPP_ALIGNMENT_UBYTE 255 Compu_IDENTITY 0 255 PHYS_UNIT "Severity+Class" /end CHARACTERISTIC
/begin CHARACTERISTIC FPsvr_RS_loss "FPrm_severity(176)" VALUE 0x001E68C5 /* @ECU_Address@FPrm_severity@0x024B30B0@ */ ECIPP_ALIGNMENT_UBYTE 255 Compu_IDENTITY 0 255 PHYS_UNIT "Severity+Class" /end CHARACTERISTIC
/begin CHARACTERISTIC FPsvr_RS_loV "FPrm_severity(452)" VALUE 0x001E69D9 /* @ECU_Address@FPrm_severity@0x024B31C4@ */ ECIPP_ALIGNMENT_UBYTE 255 Compu_IDENTITY 0 255 PHYS_UNIT "Severity+Class" /end CHARACTERISTIC
/begin CHARACTERISTIC FPsvr_RS485_bad_fmt "FPrm_severity(83)" VALUE 0x001E6868 /* @ECU_Address@FPrm_severity@0x024B3053@ */ ECIPP_ALIGNMENT_UBYTE 255 Compu_IDENTITY 0 255 PHYS_UNIT "Severity+Class" /end CHARACTERISTIC
/begin CHARACTERISTIC FPsvr_RS485_Rx_inact "FPrm_severity(81)" VALUE 0x001E6866 /* @ECU_Address@FPrm_severity@0x024B3051@ */ ECIPP_ALIGNMENT_UBYTE 255 Compu_IDENTITY 0 255 PHYS_UNIT "Severity+Class" /end CHARACTERISTIC
/begin CHARACTERISTIC FPsvr_RS485_Rx_noise "FPrm_severity(82)" VALUE 0x001E6867 /* @ECU_Address@FPrm_severity@0x024B3052@ */ ECIPP_ALIGNMENT_UBYTE 255 Compu_IDENTITY 0 255 PHYS_UNIT "Severity+Class" /end CHARACTERISTIC
/begin CHARACTERISTIC FPsvr_RS485_SD_rq "FPrm_severity(84)" VALUE 0x001E6869 /* @ECU_Address@FPrm_severity@0x024B3054@ */ ECIPP_ALIGNMENT_UBYTE 255 Compu_IDENTITY 0 255 PHYS_UNIT "Severity+Class" /end CHARACTERISTIC
/begin CHARACTERISTIC FPsvr_RTI1 "FPrm_severity(64)" VALUE 0x001E6855 /* @ECU_Address@FPrm_severity@0x024B3040@ */ ECIPP_ALIGNMENT_UBYTE 255 Compu_IDENTITY 0 255 PHYS_UNIT "Severity+Class" /end CHARACTERISTIC
/begin CHARACTERISTIC FPsvr_RTI2 "FPrm_severity(65)" VALUE 0x001E6856 /* @ECU_Address@FPrm_severity@0x024B3041@ */ ECIPP_ALIGNMENT_UBYTE 255 Compu_IDENTITY 0 255 PHYS_UNIT "Severity+Class" /end CHARACTERISTIC
/begin CHARACTERISTIC FPsvr_RTI3 "FPrm_severity(66)" VALUE 0x001E6857 /* @ECU_Address@FPrm_severity@0x024B3042@ */ ECIPP_ALIGNMENT_UBYTE 255 Compu_IDENTITY 0 255 PHYS_UNIT "Severity+Class" /end CHARACTERISTIC
/begin CHARACTERISTIC FPsvr_Sec1_31KV_open "FPrm_severity(707)" VALUE 0x001E6AD8 /* @ECU_Address@FPrm_severity@0x024B32C3@ */ ECIPP_ALIGNMENT_UBYTE 255 Compu_IDENTITY 0 255 PHYS_UNIT "Severity+Class" /end CHARACTERISTIC
/begin CHARACTERISTIC FPsvr_Sec1_low "FPrm_severity(706)" VALUE 0x001E6AD7 /* @ECU_Address@FPrm_severity@0x024B32C2@ */ ECIPP_ALIGNMENT_UBYTE 255 Compu_IDENTITY 0 255 PHYS_UNIT "Severity+Class" /end CHARACTERISTIC
/begin CHARACTERISTIC FPsvr_Sec1_open "FPrm_severity(705)" VALUE 0x001E6AD6 /* @ECU_Address@FPrm_severity@0x024B32C1@ */ ECIPP_ALIGNMENT_UBYTE 255 Compu_IDENTITY 0 255 PHYS_UNIT "Severity+Class" /end CHARACTERISTIC
/begin CHARACTERISTIC FPsvr_SHIFT_FB_OOR "FPrm_severity(216)" VALUE 0x001E68ED /* @ECU_Address@FPrm_severity@0x024B30D8@ */ ECIPP_ALIGNMENT_UBYTE 255 Compu_IDENTITY 0 255 PHYS_UNIT "Severity+Class" /end CHARACTERISTIC
/begin CHARACTERISTIC FPsvr_SHIFT_intcirc_fail "FPrm_severity(218)" VALUE 0x001E68EF /* @ECU_Address@FPrm_severity@0x024B30DA@ */ ECIPP_ALIGNMENT_UBYTE 255 Compu_IDENTITY 0 255 PHYS_UNIT "Severity+Class" /end CHARACTERISTIC
/begin CHARACTERISTIC FPsvr_SHIFT_shift_fail "FPrm_severity(217)" VALUE 0x001E68EE /* @ECU_Address@FPrm_severity@0x024B30D9@ */ ECIPP_ALIGNMENT_UBYTE 255 Compu_IDENTITY 0 255 PHYS_UNIT "Severity+Class" /end CHARACTERISTIC
/begin CHARACTERISTIC FPsvr_SL_fuel "FPrm_severity(38)" VALUE 0x001E683B /* @ECU_Address@FPrm_severity@0x024B3026@ */ ECIPP_ALIGNMENT_UBYTE 255 Compu_IDENTITY 0 255 PHYS_UNIT "Severity+Class" /end CHARACTERISTIC
/begin CHARACTERISTIC FPsvr_SL_gov "FPrm_severity(37)" VALUE 0x001E683A /* @ECU_Address@FPrm_severity@0x024B3025@ */ ECIPP_ALIGNMENT_UBYTE 255 Compu_IDENTITY 0 255 PHYS_UNIT "Severity+Class" /end CHARACTERISTIC
/begin CHARACTERISTIC FPsvr_SL_spk "FPrm_severity(39)" VALUE 0x001E683C /* @ECU_Address@FPrm_severity@0x024B3027@ */ ECIPP_ALIGNMENT_UBYTE 255 Compu_IDENTITY 0 255 PHYS_UNIT "Severity+Class" /end CHARACTERISTIC
/begin CHARACTERISTIC FPsvr_slv_MAP_hi_OOA "FPrm_severity(664)" VALUE 0x001E6AAD /* @ECU_Address@FPrm_severity@0x024B3298@ */ ECIPP_ALIGNMENT_UBYTE 255 Compu_IDENTITY 0 255 PHYS_UNIT "Severity+Class" /end CHARACTERISTIC
/begin CHARACTERISTIC FPsvr_slv_MAP_lo_OOA "FPrm_severity(665)" VALUE 0x001E6AAE /* @ECU_Address@FPrm_severity@0x024B3299@ */ ECIPP_ALIGNMENT_UBYTE 255 Compu_IDENTITY 0 255 PHYS_UNIT "Severity+Class" /end CHARACTERISTIC
/begin CHARACTERISTIC FPsvr_SPK_int_fail "FPrm_severity(225)" VALUE 0x001E68F6 /* @ECU_Address@FPrm_severity@0x024B30E1@ */ ECIPP_ALIGNMENT_UBYTE 255 Compu_IDENTITY 0 255 PHYS_UNIT "Severity+Class" /end CHARACTERISTIC
/begin CHARACTERISTIC FPsvr_SPK1_IGBT_T "FPrm_severity(388)" VALUE 0x001E6999 /* @ECU_Address@FPrm_severity@0x024B3184@ */ ECIPP_ALIGNMENT_UBYTE 255 Compu_IDENTITY 0 255 PHYS_UNIT "Severity+Class" /end CHARACTERISTIC
/begin CHARACTERISTIC FPsvr_SPKD_coil_fail "FPrm_severity(226)" VALUE 0x001E68F7 /* @ECU_Address@FPrm_severity@0x024B30E2@ */ ECIPP_ALIGNMENT_UBYTE 255 Compu_IDENTITY 0 255 PHYS_UNIT "Severity+Class" /end CHARACTERISTIC
/begin CHARACTERISTIC FPsvr_SPKD_dw_hi "FPrm_severity(56)" VALUE 0x001E684D /* @ECU_Address@FPrm_severity@0x024B3038@ */ ECIPP_ALIGNMENT_UBYTE 255 Compu_IDENTITY 0 255 PHYS_UNIT "Severity+Class" /end CHARACTERISTIC
/begin CHARACTERISTIC FPsvr_SPKD_dw_lo "FPrm_severity(55)" VALUE 0x001E684C /* @ECU_Address@FPrm_severity@0x024B3037@ */ ECIPP_ALIGNMENT_UBYTE 255 Compu_IDENTITY 0 255 PHYS_UNIT "Severity+Class" /end CHARACTERISTIC
/begin CHARACTERISTIC FPsvr_SRVC_expired "FPrm_severity(323)" VALUE 0x001E6958 /* @ECU_Address@FPrm_severity@0x024B3143@ */ ECIPP_ALIGNMENT_UBYTE 255 Compu_IDENTITY 0 255 PHYS_UNIT "Severity+Class" /end CHARACTERISTIC
/begin CHARACTERISTIC FPsvr_SRVC_expired2 "FPrm_severity(663)" VALUE 0x001E6AAC /* @ECU_Address@FPrm_severity@0x024B3297@ */ ECIPP_ALIGNMENT_UBYTE 255 Compu_IDENTITY 0 255 PHYS_UNIT "Severity+Class" /end CHARACTERISTIC
/begin CHARACTERISTIC FPsvr_start_coilopen "FPrm_severity(122)" VALUE 0x001E688F /* @ECU_Address@FPrm_severity@0x024B307A@ */ ECIPP_ALIGNMENT_UBYTE 255 Compu_IDENTITY 0 255 PHYS_UNIT "Severity+Class" /end CHARACTERISTIC
/begin CHARACTERISTIC FPsw_ext1_PWM17_off_loVf "FPrm_switches_ext1(344)" VALUE 0x001C782E /* @ECU_Address@FPrm_switches_ext1@0x023A52B0@ */ ECIPP_ALIGNMENT_UWORD 65535 Compu_IDENTITY 0 65535 PHYS_UNIT "Enable bits" /end CHARACTERISTIC
/begin CHARACTERISTIC FPsw_ext1_PWM17_on_hiVf "FPrm_switches_ext1(345)" VALUE 0x001C7830 /* @ECU_Address@FPrm_switches_ext1@0x023A52B2@ */ ECIPP_ALIGNMENT_UWORD 65535 Compu_IDENTITY 0 65535 PHYS_UNIT "Enable bits" /end CHARACTERISTIC
/begin CHARACTERISTIC FPsw_ext1_PWM18_off_loVf "FPrm_switches_ext1(346)" VALUE 0x001C7832 /* @ECU_Address@FPrm_switches_ext1@0x023A52B4@ */ ECIPP_ALIGNMENT_UWORD 65535 Compu_IDENTITY 0 65535 PHYS_UNIT "Enable bits" /end CHARACTERISTIC
/begin CHARACTERISTIC FPsw_ext1_PWM18_on_hiVf "FPrm_switches_ext1(347)" VALUE 0x001C7834 /* @ECU_Address@FPrm_switches_ext1@0x023A52B6@ */ ECIPP_ALIGNMENT_UWORD 65535 Compu_IDENTITY 0 65535 PHYS_UNIT "Enable bits" /end CHARACTERISTIC
/begin CHARACTERISTIC FPsw_ext1_PWM19_off_loVf "FPrm_switches_ext1(348)" VALUE 0x001C7836 /* @ECU_Address@FPrm_switches_ext1@0x023A52B8@ */ ECIPP_ALIGNMENT_UWORD 65535 Compu_IDENTITY 0 65535 PHYS_UNIT "Enable bits" /end CHARACTERISTIC
/begin CHARACTERISTIC FPsw_ext1_PWM19_on_hiVf "FPrm_switches_ext1(349)" VALUE 0x001C7838 /* @ECU_Address@FPrm_switches_ext1@0x023A52BA@ */ ECIPP_ALIGNMENT_UWORD 65535 Compu_IDENTITY 0 65535 PHYS_UNIT "Enable bits" /end CHARACTERISTIC
/begin CHARACTERISTIC FPsw_ext1_PWM2_off_loVf "FPrm_switches_ext1(149)" VALUE 0x001C76A8 /* @ECU_Address@FPrm_switches_ext1@0x023A512A@ */ ECIPP_ALIGNMENT_UWORD 65535 Compu_IDENTITY 0 65535 PHYS_UNIT "Enable bits" /end CHARACTERISTIC
/begin CHARACTERISTIC FPsw_ext1_PWM2_on_hiVf "FPrm_switches_ext1(150)" VALUE 0x001C76AA /* @ECU_Address@FPrm_switches_ext1@0x023A512C@ */ ECIPP_ALIGNMENT_UWORD 65535 Compu_IDENTITY 0 65535 PHYS_UNIT "Enable bits" /end CHARACTERISTIC
/begin CHARACTERISTIC FPsw_ext1_PWM20_off_loVf "FPrm_switches_ext1(350)" VALUE 0x001C783A /* @ECU_Address@FPrm_switches_ext1@0x023A52BC@ */ ECIPP_ALIGNMENT_UWORD 65535 Compu_IDENTITY 0 65535 PHYS_UNIT "Enable bits" /end CHARACTERISTIC
/begin CHARACTERISTIC FPsw_ext1_PWM20_on_hiVf "FPrm_switches_ext1(351)" VALUE 0x001C783C /* @ECU_Address@FPrm_switches_ext1@0x023A52BE@ */ ECIPP_ALIGNMENT_UWORD 65535 Compu_IDENTITY 0 65535 PHYS_UNIT "Enable bits" /end CHARACTERISTIC
/begin CHARACTERISTIC FPsw_ext1_PWM21_off_loVf "FPrm_switches_ext1(352)" VALUE 0x001C783E /* @ECU_Address@FPrm_switches_ext1@0x023A52C0@ */ ECIPP_ALIGNMENT_UWORD 65535 Compu_IDENTITY 0 65535 PHYS_UNIT "Enable bits" /end CHARACTERISTIC
/begin CHARACTERISTIC FPsw_ext1_PWM21_on_hiVf "FPrm_switches_ext1(353)" VALUE 0x001C7840 /* @ECU_Address@FPrm_switches_ext1@0x023A52C2@ */ ECIPP_ALIGNMENT_UWORD 65535 Compu_IDENTITY 0 65535 PHYS_UNIT "Enable bits" /end CHARACTERISTIC
/begin CHARACTERISTIC FPsw_ext1_PWM22_off_loVf "FPrm_switches_ext1(354)" VALUE 0x001C7842 /* @ECU_Address@FPrm_switches_ext1@0x023A52C4@ */ ECIPP_ALIGNMENT_UWORD 65535 Compu_IDENTITY 0 65535 PHYS_UNIT "Enable bits" /end CHARACTERISTIC
/begin CHARACTERISTIC FPsw_ext1_PWM22_on_hiVf "FPrm_switches_ext1(355)" VALUE 0x001C7844 /* @ECU_Address@FPrm_switches_ext1@0x023A52C6@ */ ECIPP_ALIGNMENT_UWORD 65535 Compu_IDENTITY 0 65535 PHYS_UNIT "Enable bits" /end CHARACTERISTIC
/begin CHARACTERISTIC FPsw_ext1_PWM23_off_loVf "FPrm_switches_ext1(356)" VALUE 0x001C7846 /* @ECU_Address@FPrm_switches_ext1@0x023A52C8@ */ ECIPP_ALIGNMENT_UWORD 65535 Compu_IDENTITY 0 65535 PHYS_UNIT "Enable bits" /end CHARACTERISTIC
/begin CHARACTERISTIC FPsw_ext1_PWM23_on_hiVf "FPrm_switches_ext1(357)" VALUE 0x001C7848 /* @ECU_Address@FPrm_switches_ext1@0x023A52CA@ */ ECIPP_ALIGNMENT_UWORD 65535 Compu_IDENTITY 0 65535 PHYS_UNIT "Enable bits" /end CHARACTERISTIC
/begin CHARACTERISTIC FPsw_ext1_PWM3_off_loVf "FPrm_switches_ext1(151)" VALUE 0x001C76AC /* @ECU_Address@FPrm_switches_ext1@0x023A512E@ */ ECIPP_ALIGNMENT_UWORD 65535 Compu_IDENTITY 0 65535 PHYS_UNIT "Enable bits" /end CHARACTERISTIC
/begin CHARACTERISTIC FPsw_ext1_PWM3_on_hiVf "FPrm_switches_ext1(152)" VALUE 0x001C76AE /* @ECU_Address@FPrm_switches_ext1@0x023A5130@ */ ECIPP_ALIGNMENT_UWORD 65535 Compu_IDENTITY 0 65535 PHYS_UNIT "Enable bits" /end CHARACTERISTIC
/begin CHARACTERISTIC FPsw_ext1_PWM4_off_loVf "FPrm_switches_ext1(153)" VALUE 0x001C76B0 /* @ECU_Address@FPrm_switches_ext1@0x023A5132@ */ ECIPP_ALIGNMENT_UWORD 65535 Compu_IDENTITY 0 65535 PHYS_UNIT "Enable bits" /end CHARACTERISTIC
/begin CHARACTERISTIC FPsw_ext1_PWM4_on_hiVf "FPrm_switches_ext1(154)" VALUE 0x001C76B2 /* @ECU_Address@FPrm_switches_ext1@0x023A5134@ */ ECIPP_ALIGNMENT_UWORD 65535 Compu_IDENTITY 0 65535 PHYS_UNIT "Enable bits" /end CHARACTERISTIC
/begin CHARACTERISTIC FPsw_ext1_PWM5_off_loVf "FPrm_switches_ext1(155)" VALUE 0x001C76B4 /* @ECU_Address@FPrm_switches_ext1@0x023A5136@ */ ECIPP_ALIGNMENT_UWORD 65535 Compu_IDENTITY 0 65535 PHYS_UNIT "Enable bits" /end CHARACTERISTIC
/begin CHARACTERISTIC FPsw_ext1_PWM5_on_hiVf "FPrm_switches_ext1(156)" VALUE 0x001C76B6 /* @ECU_Address@FPrm_switches_ext1@0x023A5138@ */ ECIPP_ALIGNMENT_UWORD 65535 Compu_IDENTITY 0 65535 PHYS_UNIT "Enable bits" /end CHARACTERISTIC
/begin CHARACTERISTIC FPsw_ext1_PWM6_off_loVf "FPrm_switches_ext1(198)" VALUE 0x001C770A /* @ECU_Address@FPrm_switches_ext1@0x023A518C@ */ ECIPP_ALIGNMENT_UWORD 65535 Compu_IDENTITY 0 65535 PHYS_UNIT "Enable bits" /end CHARACTERISTIC
/begin CHARACTERISTIC FPsw_ext1_PWM6_on_hiVf "FPrm_switches_ext1(199)" VALUE 0x001C770C /* @ECU_Address@FPrm_switches_ext1@0x023A518E@ */ ECIPP_ALIGNMENT_UWORD 65535 Compu_IDENTITY 0 65535 PHYS_UNIT "Enable bits" /end CHARACTERISTIC
/begin CHARACTERISTIC FPsw_ext1_PWM7_off_loVf "FPrm_switches_ext1(200)" VALUE 0x001C770E /* @ECU_Address@FPrm_switches_ext1@0x023A5190@ */ ECIPP_ALIGNMENT_UWORD 65535 Compu_IDENTITY 0 65535 PHYS_UNIT "Enable bits" /end CHARACTERISTIC
/begin CHARACTERISTIC FPsw_ext1_PWM7_on_hiVf "FPrm_switches_ext1(201)" VALUE 0x001C7710 /* @ECU_Address@FPrm_switches_ext1@0x023A5192@ */ ECIPP_ALIGNMENT_UWORD 65535 Compu_IDENTITY 0 65535 PHYS_UNIT "Enable bits" /end CHARACTERISTIC
/begin CHARACTERISTIC FPsw_ext1_PWM8_off_loVf "FPrm_switches_ext1(205)" VALUE 0x001C7718 /* @ECU_Address@FPrm_switches_ext1@0x023A519A@ */ ECIPP_ALIGNMENT_UWORD 65535 Compu_IDENTITY 0 65535 PHYS_UNIT "Enable bits" /end CHARACTERISTIC
/begin CHARACTERISTIC FPsw_ext1_PWM8_on_hiVf "FPrm_switches_ext1(206)" VALUE 0x001C771A /* @ECU_Address@FPrm_switches_ext1@0x023A519C@ */ ECIPP_ALIGNMENT_UWORD 65535 Compu_IDENTITY 0 65535 PHYS_UNIT "Enable bits" /end CHARACTERISTIC
/begin CHARACTERISTIC FPsw_ext1_PWM9_off_loVf "FPrm_switches_ext1(207)" VALUE 0x001C771C /* @ECU_Address@FPrm_switches_ext1@0x023A519E@ */ ECIPP_ALIGNMENT_UWORD 65535 Compu_IDENTITY 0 65535 PHYS_UNIT "Enable bits" /end CHARACTERISTIC
/begin CHARACTERISTIC FPsw_ext1_PWM9_on_hiVf "FPrm_switches_ext1(208)" VALUE 0x001C771E /* @ECU_Address@FPrm_switches_ext1@0x023A51A0@ */ ECIPP_ALIGNMENT_UWORD 65535 Compu_IDENTITY 0 65535 PHYS_UNIT "Enable bits" /end CHARACTERISTIC
/begin CHARACTERISTIC FPsw_ext1_PWMLO_off_loVf "FPrm_switches_ext1(391)" VALUE 0x001C788C /* @ECU_Address@FPrm_switches_ext1@0x023A530E@ */ ECIPP_ALIGNMENT_UWORD 65535 Compu_IDENTITY 0 65535 PHYS_UNIT "Enable bits" /end CHARACTERISTIC
/begin CHARACTERISTIC FPsw_ext1_PWMLO_on_hiVf "FPrm_switches_ext1(392)" VALUE 0x001C788E /* @ECU_Address@FPrm_switches_ext1@0x023A5310@ */ ECIPP_ALIGNMENT_UWORD 65535 Compu_IDENTITY 0 65535 PHYS_UNIT "Enable bits" /end CHARACTERISTIC
/begin CHARACTERISTIC FPsw_ext1_radby_poserr "FPrm_switches_ext1(697)" VALUE 0x001C7AF0 /* @ECU_Address@FPrm_switches_ext1@0x023A5572@ */ ECIPP_ALIGNMENT_UWORD 65535 Compu_IDENTITY 0 65535 PHYS_UNIT "Enable bits" /end CHARACTERISTIC
/begin CHARACTERISTIC FPsw_ext1_RAM_fail "FPrm_switches_ext1(70)" VALUE 0x001C760A /* @ECU_Address@FPrm_switches_ext1@0x023A508C@ */ ECIPP_ALIGNMENT_UWORD 65535 Compu_IDENTITY 0 65535 PHYS_UNIT "Enable bits" /end CHARACTERISTIC
/begin CHARACTERISTIC FPsw_ext1_relay_coilopen "FPrm_switches_ext1(119)" VALUE 0x001C766C /* @ECU_Address@FPrm_switches_ext1@0x023A50EE@ */ ECIPP_ALIGNMENT_UWORD 65535 Compu_IDENTITY 0 65535 PHYS_UNIT "Enable bits" /end CHARACTERISTIC
/begin CHARACTERISTIC FPsw_ext1_relay_coilshort "FPrm_switches_ext1(120)" VALUE 0x001C766E /* @ECU_Address@FPrm_switches_ext1@0x023A50F0@ */ ECIPP_ALIGNMENT_UWORD 65535 Compu_IDENTITY 0 65535 PHYS_UNIT "Enable bits" /end CHARACTERISTIC
/begin CHARACTERISTIC FPsw_ext1_relay_gndshort "FPrm_switches_ext1(118)" VALUE 0x001C766A /* @ECU_Address@FPrm_switches_ext1@0x023A50EC@ */ ECIPP_ALIGNMENT_UWORD 65535 Compu_IDENTITY 0 65535 PHYS_UNIT "Enable bits" /end CHARACTERISTIC
/begin CHARACTERISTIC FPsw_ext1_relayoff_hiV "FPrm_switches_ext1(328)" VALUE 0x001C780E /* @ECU_Address@FPrm_switches_ext1@0x023A5290@ */ ECIPP_ALIGNMENT_UWORD 65535 Compu_IDENTITY 0 65535 PHYS_UNIT "Enable bits" /end CHARACTERISTIC
/begin CHARACTERISTIC FPsw_ext1_relayon_loV "FPrm_switches_ext1(329)" VALUE 0x001C7810 /* @ECU_Address@FPrm_switches_ext1@0x023A5292@ */ ECIPP_ALIGNMENT_UWORD 65535 Compu_IDENTITY 0 65535 PHYS_UNIT "Enable bits" /end CHARACTERISTIC
/begin CHARACTERISTIC FPsw_ext1_rpm_hi_expected "FPrm_switches_ext1(260)" VALUE 0x001C7786 /* @ECU_Address@FPrm_switches_ext1@0x023A5208@ */ ECIPP_ALIGNMENT_UWORD 65535 Compu_IDENTITY 0 65535 PHYS_UNIT "Enable bits" /end CHARACTERISTIC
/begin CHARACTERISTIC FPsw_ext1_rpmd_gov_lo "FPrm_switches_ext1(390)" VALUE 0x001C788A /* @ECU_Address@FPrm_switches_ext1@0x023A530C@ */ ECIPP_ALIGNMENT_UWORD 65535 Compu_IDENTITY 0 65535 PHYS_UNIT "Enable bits" /end CHARACTERISTIC
/begin CHARACTERISTIC FPsw_ext1_RS_discon "FPrm_switches_ext1(521)" VALUE 0x001C7990 /* @ECU_Address@FPrm_switches_ext1@0x023A5412@ */ ECIPP_ALIGNMENT_UWORD 65535 Compu_IDENTITY 0 65535 PHYS_UNIT "Enable bits" /end CHARACTERISTIC
/begin CHARACTERISTIC FPsw_ext1_RS_hiV "FPrm_switches_ext1(453)" VALUE 0x001C7908 /* @ECU_Address@FPrm_switches_ext1@0x023A538A@ */ ECIPP_ALIGNMENT_UWORD 65535 Compu_IDENTITY 0 65535 PHYS_UNIT "Enable bits" /end CHARACTERISTIC
/begin CHARACTERISTIC FPsw_ext1_RS_loss "FPrm_switches_ext1(176)" VALUE 0x001C76DE /* @ECU_Address@FPrm_switches_ext1@0x023A5160@ */ ECIPP_ALIGNMENT_UWORD 65535 Compu_IDENTITY 0 65535 PHYS_UNIT "Enable bits" /end CHARACTERISTIC
/begin CHARACTERISTIC FPsw_ext1_RS_loV "FPrm_switches_ext1(452)" VALUE 0x001C7906 /* @ECU_Address@FPrm_switches_ext1@0x023A5388@ */ ECIPP_ALIGNMENT_UWORD 65535 Compu_IDENTITY 0 65535 PHYS_UNIT "Enable bits" /end CHARACTERISTIC
/begin CHARACTERISTIC FPsw_ext1_RS485_bad_fmt "FPrm_switches_ext1(83)" VALUE 0x001C7624 /* @ECU_Address@FPrm_switches_ext1@0x023A50A6@ */ ECIPP_ALIGNMENT_UWORD 65535 Compu_IDENTITY 0 65535 PHYS_UNIT "Enable bits" /end CHARACTERISTIC
/begin CHARACTERISTIC FPsw_ext1_RS485_Rx_inact "FPrm_switches_ext1(81)" VALUE 0x001C7620 /* @ECU_Address@FPrm_switches_ext1@0x023A50A2@ */ ECIPP_ALIGNMENT_UWORD 65535 Compu_IDENTITY 0 65535 PHYS_UNIT "Enable bits" /end CHARACTERISTIC
/begin CHARACTERISTIC FPsw_ext1_RS485_Rx_noise "FPrm_switches_ext1(82)" VALUE 0x001C7622 /* @ECU_Address@FPrm_switches_ext1@0x023A50A4@ */ ECIPP_ALIGNMENT_UWORD 65535 Compu_IDENTITY 0 65535 PHYS_UNIT "Enable bits" /end CHARACTERISTIC
/begin CHARACTERISTIC FPsw_ext1_RS485_SD_rq "FPrm_switches_ext1(84)" VALUE 0x001C7626 /* @ECU_Address@FPrm_switches_ext1@0x023A50A8@ */ ECIPP_ALIGNMENT_UWORD 65535 Compu_IDENTITY 0 65535 PHYS_UNIT "Enable bits" /end CHARACTERISTIC
/begin CHARACTERISTIC FPsw_ext1_RTI1 "FPrm_switches_ext1(64)" VALUE 0x001C75FE /* @ECU_Address@FPrm_switches_ext1@0x023A5080@ */ ECIPP_ALIGNMENT_UWORD 65535 Compu_IDENTITY 0 65535 PHYS_UNIT "Enable bits" /end CHARACTERISTIC
/begin CHARACTERISTIC FPsw_ext1_RTI2 "FPrm_switches_ext1(65)" VALUE 0x001C7600 /* @ECU_Address@FPrm_switches_ext1@0x023A5082@ */ ECIPP_ALIGNMENT_UWORD 65535 Compu_IDENTITY 0 65535 PHYS_UNIT "Enable bits" /end CHARACTERISTIC
/begin CHARACTERISTIC FPsw_ext1_RTI3 "FPrm_switches_ext1(66)" VALUE 0x001C7602 /* @ECU_Address@FPrm_switches_ext1@0x023A5084@ */ ECIPP_ALIGNMENT_UWORD 65535 Compu_IDENTITY 0 65535 PHYS_UNIT "Enable bits" /end CHARACTERISTIC
/begin CHARACTERISTIC FPsw_ext1_Sec1_31KV_open "FPrm_switches_ext1(707)" VALUE 0x001C7B04 /* @ECU_Address@FPrm_switches_ext1@0x023A5586@ */ ECIPP_ALIGNMENT_UWORD 65535 Compu_IDENTITY 0 65535 PHYS_UNIT "Enable bits" /end CHARACTERISTIC
/begin CHARACTERISTIC FPsw_ext1_Sec1_low "FPrm_switches_ext1(706)" VALUE 0x001C7B02 /* @ECU_Address@FPrm_switches_ext1@0x023A5584@ */ ECIPP_ALIGNMENT_UWORD 65535 Compu_IDENTITY 0 65535 PHYS_UNIT "Enable bits" /end CHARACTERISTIC
/begin CHARACTERISTIC FPsw_ext1_Sec1_open "FPrm_switches_ext1(705)" VALUE 0x001C7B00 /* @ECU_Address@FPrm_switches_ext1@0x023A5582@ */ ECIPP_ALIGNMENT_UWORD 65535 Compu_IDENTITY 0 65535 PHYS_UNIT "Enable bits" /end CHARACTERISTIC
/begin CHARACTERISTIC FPsw_ext1_SHIFT_FB_OOR "FPrm_switches_ext1(216)" VALUE 0x001C772E /* @ECU_Address@FPrm_switches_ext1@0x023A51B0@ */ ECIPP_ALIGNMENT_UWORD 65535 Compu_IDENTITY 0 65535 PHYS_UNIT "Enable bits" /end CHARACTERISTIC
/begin CHARACTERISTIC FPsw_ext1_SHIFT_intcirc_fail "FPrm_switches_ext1(218)" VALUE 0x001C7732 /* @ECU_Address@FPrm_switches_ext1@0x023A51B4@ */ ECIPP_ALIGNMENT_UWORD 65535 Compu_IDENTITY 0 65535 PHYS_UNIT "Enable bits" /end CHARACTERISTIC
/begin CHARACTERISTIC FPsw_ext1_SHIFT_shift_fail "FPrm_switches_ext1(217)" VALUE 0x001C7730 /* @ECU_Address@FPrm_switches_ext1@0x023A51B2@ */ ECIPP_ALIGNMENT_UWORD 65535 Compu_IDENTITY 0 65535 PHYS_UNIT "Enable bits" /end CHARACTERISTIC
/begin CHARACTERISTIC FPsw_ext1_SL_fuel "FPrm_switches_ext1(38)" VALUE 0x001C75CA /* @ECU_Address@FPrm_switches_ext1@0x023A504C@ */ ECIPP_ALIGNMENT_UWORD 65535 Compu_IDENTITY 0 65535 PHYS_UNIT "Enable bits" /end CHARACTERISTIC
/begin CHARACTERISTIC FPsw_ext1_SL_gov "FPrm_switches_ext1(37)" VALUE 0x001C75C8 /* @ECU_Address@FPrm_switches_ext1@0x023A504A@ */ ECIPP_ALIGNMENT_UWORD 65535 Compu_IDENTITY 0 65535 PHYS_UNIT "Enable bits" /end CHARACTERISTIC
/begin CHARACTERISTIC FPsw_ext1_SL_spk "FPrm_switches_ext1(39)" VALUE 0x001C75CC /* @ECU_Address@FPrm_switches_ext1@0x023A504E@ */ ECIPP_ALIGNMENT_UWORD 65535 Compu_IDENTITY 0 65535 PHYS_UNIT "Enable bits" /end CHARACTERISTIC
/begin CHARACTERISTIC FPsw_ext1_slv_MAP_hi_OOA "FPrm_switches_ext1(664)" VALUE 0x001C7AAE /* @ECU_Address@FPrm_switches_ext1@0x023A5530@ */ ECIPP_ALIGNMENT_UWORD 65535 Compu_IDENTITY 0 65535 PHYS_UNIT "Enable bits" /end CHARACTERISTIC
/begin CHARACTERISTIC FPsw_ext1_slv_MAP_lo_OOA "FPrm_switches_ext1(665)" VALUE 0x001C7AB0 /* @ECU_Address@FPrm_switches_ext1@0x023A5532@ */ ECIPP_ALIGNMENT_UWORD 65535 Compu_IDENTITY 0 65535 PHYS_UNIT "Enable bits" /end CHARACTERISTIC
/begin CHARACTERISTIC FPsw_ext1_SPK_int_fail "FPrm_switches_ext1(225)" VALUE 0x001C7740 /* @ECU_Address@FPrm_switches_ext1@0x023A51C2@ */ ECIPP_ALIGNMENT_UWORD 65535 Compu_IDENTITY 0 65535 PHYS_UNIT "Enable bits" /end CHARACTERISTIC
/begin CHARACTERISTIC FPsw_ext1_SPK1_IGBT_T "FPrm_switches_ext1(388)" VALUE 0x001C7886 /* @ECU_Address@FPrm_switches_ext1@0x023A5308@ */ ECIPP_ALIGNMENT_UWORD 65535 Compu_IDENTITY 0 65535 PHYS_UNIT "Enable bits" /end CHARACTERISTIC
/begin CHARACTERISTIC FPsw_ext1_SPKD_coil_fail "FPrm_switches_ext1(226)" VALUE 0x001C7742 /* @ECU_Address@FPrm_switches_ext1@0x023A51C4@ */ ECIPP_ALIGNMENT_UWORD 65535 Compu_IDENTITY 0 65535 PHYS_UNIT "Enable bits" /end CHARACTERISTIC
/begin CHARACTERISTIC FPsw_ext1_SPKD_dw_hi "FPrm_switches_ext1(56)" VALUE 0x001C75EE /* @ECU_Address@FPrm_switches_ext1@0x023A5070@ */ ECIPP_ALIGNMENT_UWORD 65535 Compu_IDENTITY 0 65535 PHYS_UNIT "Enable bits" /end CHARACTERISTIC
/begin CHARACTERISTIC FPsw_ext1_SPKD_dw_lo "FPrm_switches_ext1(55)" VALUE 0x001C75EC /* @ECU_Address@FPrm_switches_ext1@0x023A506E@ */ ECIPP_ALIGNMENT_UWORD 65535 Compu_IDENTITY 0 65535 PHYS_UNIT "Enable bits" /end CHARACTERISTIC
/begin CHARACTERISTIC FPsw_ext1_SRVC_expired "FPrm_switches_ext1(323)" VALUE 0x001C7804 /* @ECU_Address@FPrm_switches_ext1@0x023A5286@ */ ECIPP_ALIGNMENT_UWORD 65535 Compu_IDENTITY 0 65535 PHYS_UNIT "Enable bits" /end CHARACTERISTIC
/begin CHARACTERISTIC FPsw_ext1_SRVC_expired2 "FPrm_switches_ext1(663)" VALUE 0x001C7AAC /* @ECU_Address@FPrm_switches_ext1@0x023A552E@ */ ECIPP_ALIGNMENT_UWORD 65535 Compu_IDENTITY 0 65535 PHYS_UNIT "Enable bits" /end CHARACTERISTIC
/begin CHARACTERISTIC FPsw_ext1_start_coilopen "FPrm_switches_ext1(122)" VALUE 0x001C7672 /* @ECU_Address@FPrm_switches_ext1@0x023A50F4@ */ ECIPP_ALIGNMENT_UWORD 65535 Compu_IDENTITY 0 65535 PHYS_UNIT "Enable bits" /end CHARACTERISTIC
/begin CHARACTERISTIC FPsw_PWM17_off_loVf "FPrm_switches(344)" VALUE 0x001C728A /* @ECU_Address@FPrm_switches@0x021B92B0@ */ ECIPP_ALIGNMENT_UWORD 65535 Compu_IDENTITY 0 65535 PHYS_UNIT "Enable bits" /end CHARACTERISTIC
/begin CHARACTERISTIC FPsw_PWM17_on_hiVf "FPrm_switches(345)" VALUE 0x001C728C /* @ECU_Address@FPrm_switches@0x021B92B2@ */ ECIPP_ALIGNMENT_UWORD 65535 Compu_IDENTITY 0 65535 PHYS_UNIT "Enable bits" /end CHARACTERISTIC
/begin CHARACTERISTIC FPsw_PWM18_off_loVf "FPrm_switches(346)" VALUE 0x001C728E /* @ECU_Address@FPrm_switches@0x021B92B4@ */ ECIPP_ALIGNMENT_UWORD 65535 Compu_IDENTITY 0 65535 PHYS_UNIT "Enable bits" /end CHARACTERISTIC
/begin CHARACTERISTIC FPsw_PWM18_on_hiVf "FPrm_switches(347)" VALUE 0x001C7290 /* @ECU_Address@FPrm_switches@0x021B92B6@ */ ECIPP_ALIGNMENT_UWORD 65535 Compu_IDENTITY 0 65535 PHYS_UNIT "Enable bits" /end CHARACTERISTIC
/begin CHARACTERISTIC FPsw_PWM19_off_loVf "FPrm_switches(348)" VALUE 0x001C7292 /* @ECU_Address@FPrm_switches@0x021B92B8@ */ ECIPP_ALIGNMENT_UWORD 65535 Compu_IDENTITY 0 65535 PHYS_UNIT "Enable bits" /end CHARACTERISTIC
/begin CHARACTERISTIC FPsw_PWM19_on_hiVf "FPrm_switches(349)" VALUE 0x001C7294 /* @ECU_Address@FPrm_switches@0x021B92BA@ */ ECIPP_ALIGNMENT_UWORD 65535 Compu_IDENTITY 0 65535 PHYS_UNIT "Enable bits" /end CHARACTERISTIC
/begin CHARACTERISTIC FPsw_PWM2_off_loVf "FPrm_switches(149)" VALUE 0x001C7104 /* @ECU_Address@FPrm_switches@0x021B912A@ */ ECIPP_ALIGNMENT_UWORD 65535 Compu_IDENTITY 0 65535 PHYS_UNIT "Enable bits" /end CHARACTERISTIC
/begin CHARACTERISTIC FPsw_PWM2_on_hiVf "FPrm_switches(150)" VALUE 0x001C7106 /* @ECU_Address@FPrm_switches@0x021B912C@ */ ECIPP_ALIGNMENT_UWORD 65535 Compu_IDENTITY 0 65535 PHYS_UNIT "Enable bits" /end CHARACTERISTIC
/begin CHARACTERISTIC FPsw_PWM20_off_loVf "FPrm_switches(350)" VALUE 0x001C7296 /* @ECU_Address@FPrm_switches@0x021B92BC@ */ ECIPP_ALIGNMENT_UWORD 65535 Compu_IDENTITY 0 65535 PHYS_UNIT "Enable bits" /end CHARACTERISTIC
/begin CHARACTERISTIC FPsw_PWM20_on_hiVf "FPrm_switches(351)" VALUE 0x001C7298 /* @ECU_Address@FPrm_switches@0x021B92BE@ */ ECIPP_ALIGNMENT_UWORD 65535 Compu_IDENTITY 0 65535 PHYS_UNIT "Enable bits" /end CHARACTERISTIC
/begin CHARACTERISTIC FPsw_PWM21_off_loVf "FPrm_switches(352)" VALUE 0x001C729A /* @ECU_Address@FPrm_switches@0x021B92C0@ */ ECIPP_ALIGNMENT_UWORD 65535 Compu_IDENTITY 0 65535 PHYS_UNIT "Enable bits" /end CHARACTERISTIC
/begin CHARACTERISTIC FPsw_PWM21_on_hiVf "FPrm_switches(353)" VALUE 0x001C729C /* @ECU_Address@FPrm_switches@0x021B92C2@ */ ECIPP_ALIGNMENT_UWORD 65535 Compu_IDENTITY 0 65535 PHYS_UNIT "Enable bits" /end CHARACTERISTIC
/begin CHARACTERISTIC FPsw_PWM22_off_loVf "FPrm_switches(354)" VALUE 0x001C729E /* @ECU_Address@FPrm_switches@0x021B92C4@ */ ECIPP_ALIGNMENT_UWORD 65535 Compu_IDENTITY 0 65535 PHYS_UNIT "Enable bits" /end CHARACTERISTIC
/begin CHARACTERISTIC FPsw_PWM22_on_hiVf "FPrm_switches(355)" VALUE 0x001C72A0 /* @ECU_Address@FPrm_switches@0x021B92C6@ */ ECIPP_ALIGNMENT_UWORD 65535 Compu_IDENTITY 0 65535 PHYS_UNIT "Enable bits" /end CHARACTERISTIC
/begin CHARACTERISTIC FPsw_PWM23_off_loVf "FPrm_switches(356)" VALUE 0x001C72A2 /* @ECU_Address@FPrm_switches@0x021B92C8@ */ ECIPP_ALIGNMENT_UWORD 65535 Compu_IDENTITY 0 65535 PHYS_UNIT "Enable bits" /end CHARACTERISTIC
/begin CHARACTERISTIC FPsw_PWM23_on_hiVf "FPrm_switches(357)" VALUE 0x001C72A4 /* @ECU_Address@FPrm_switches@0x021B92CA@ */ ECIPP_ALIGNMENT_UWORD 65535 Compu_IDENTITY 0 65535 PHYS_UNIT "Enable bits" /end CHARACTERISTIC
/begin CHARACTERISTIC FPsw_PWM3_off_loVf "FPrm_switches(151)" VALUE 0x001C7108 /* @ECU_Address@FPrm_switches@0x021B912E@ */ ECIPP_ALIGNMENT_UWORD 65535 Compu_IDENTITY 0 65535 PHYS_UNIT "Enable bits" /end CHARACTERISTIC
/begin CHARACTERISTIC FPsw_PWM3_on_hiVf "FPrm_switches(152)" VALUE 0x001C710A /* @ECU_Address@FPrm_switches@0x021B9130@ */ ECIPP_ALIGNMENT_UWORD 65535 Compu_IDENTITY 0 65535 PHYS_UNIT "Enable bits" /end CHARACTERISTIC
/begin CHARACTERISTIC FPsw_PWM4_off_loVf "FPrm_switches(153)" VALUE 0x001C710C /* @ECU_Address@FPrm_switches@0x021B9132@ */ ECIPP_ALIGNMENT_UWORD 65535 Compu_IDENTITY 0 65535 PHYS_UNIT "Enable bits" /end CHARACTERISTIC
/begin CHARACTERISTIC FPsw_PWM4_on_hiVf "FPrm_switches(154)" VALUE 0x001C710E /* @ECU_Address@FPrm_switches@0x021B9134@ */ ECIPP_ALIGNMENT_UWORD 65535 Compu_IDENTITY 0 65535 PHYS_UNIT "Enable bits" /end CHARACTERISTIC
/begin CHARACTERISTIC FPsw_PWM5_off_loVf "FPrm_switches(155)" VALUE 0x001C7110 /* @ECU_Address@FPrm_switches@0x021B9136@ */ ECIPP_ALIGNMENT_UWORD 65535 Compu_IDENTITY 0 65535 PHYS_UNIT "Enable bits" /end CHARACTERISTIC
/begin CHARACTERISTIC FPsw_PWM5_on_hiVf "FPrm_switches(156)" VALUE 0x001C7112 /* @ECU_Address@FPrm_switches@0x021B9138@ */ ECIPP_ALIGNMENT_UWORD 65535 Compu_IDENTITY 0 65535 PHYS_UNIT "Enable bits" /end CHARACTERISTIC
/begin CHARACTERISTIC FPsw_PWM6_off_loVf "FPrm_switches(198)" VALUE 0x001C7166 /* @ECU_Address@FPrm_switches@0x021B918C@ */ ECIPP_ALIGNMENT_UWORD 65535 Compu_IDENTITY 0 65535 PHYS_UNIT "Enable bits" /end CHARACTERISTIC
/begin CHARACTERISTIC FPsw_PWM6_on_hiVf "FPrm_switches(199)" VALUE 0x001C7168 /* @ECU_Address@FPrm_switches@0x021B918E@ */ ECIPP_ALIGNMENT_UWORD 65535 Compu_IDENTITY 0 65535 PHYS_UNIT "Enable bits" /end CHARACTERISTIC
/begin CHARACTERISTIC FPsw_PWM7_off_loVf "FPrm_switches(200)" VALUE 0x001C716A /* @ECU_Address@FPrm_switches@0x021B9190@ */ ECIPP_ALIGNMENT_UWORD 65535 Compu_IDENTITY 0 65535 PHYS_UNIT "Enable bits" /end CHARACTERISTIC
/begin CHARACTERISTIC FPsw_PWM7_on_hiVf "FPrm_switches(201)" VALUE 0x001C716C /* @ECU_Address@FPrm_switches@0x021B9192@ */ ECIPP_ALIGNMENT_UWORD 65535 Compu_IDENTITY 0 65535 PHYS_UNIT "Enable bits" /end CHARACTERISTIC
/begin CHARACTERISTIC FPsw_PWM8_off_loVf "FPrm_switches(205)" VALUE 0x001C7174 /* @ECU_Address@FPrm_switches@0x021B919A@ */ ECIPP_ALIGNMENT_UWORD 65535 Compu_IDENTITY 0 65535 PHYS_UNIT "Enable bits" /end CHARACTERISTIC
/begin CHARACTERISTIC FPsw_PWM8_on_hiVf "FPrm_switches(206)" VALUE 0x001C7176 /* @ECU_Address@FPrm_switches@0x021B919C@ */ ECIPP_ALIGNMENT_UWORD 65535 Compu_IDENTITY 0 65535 PHYS_UNIT "Enable bits" /end CHARACTERISTIC
/begin CHARACTERISTIC FPsw_PWM9_off_loVf "FPrm_switches(207)" VALUE 0x001C7178 /* @ECU_Address@FPrm_switches@0x021B919E@ */ ECIPP_ALIGNMENT_UWORD 65535 Compu_IDENTITY 0 65535 PHYS_UNIT "Enable bits" /end CHARACTERISTIC
/begin CHARACTERISTIC FPsw_PWM9_on_hiVf "FPrm_switches(208)" VALUE 0x001C717A /* @ECU_Address@FPrm_switches@0x021B91A0@ */ ECIPP_ALIGNMENT_UWORD 65535 Compu_IDENTITY 0 65535 PHYS_UNIT "Enable bits" /end CHARACTERISTIC
/begin CHARACTERISTIC FPsw_PWMLO_off_loVf "FPrm_switches(391)" VALUE 0x001C72E8 /* @ECU_Address@FPrm_switches@0x021B930E@ */ ECIPP_ALIGNMENT_UWORD 65535 Compu_IDENTITY 0 65535 PHYS_UNIT "Enable bits" /end CHARACTERISTIC
/begin CHARACTERISTIC FPsw_PWMLO_on_hiVf "FPrm_switches(392)" VALUE 0x001C72EA /* @ECU_Address@FPrm_switches@0x021B9310@ */ ECIPP_ALIGNMENT_UWORD 65535 Compu_IDENTITY 0 65535 PHYS_UNIT "Enable bits" /end CHARACTERISTIC
/begin CHARACTERISTIC FPsw_radby_poserr "FPrm_switches(697)" VALUE 0x001C754C /* @ECU_Address@FPrm_switches@0x021B9572@ */ ECIPP_ALIGNMENT_UWORD 65535 Compu_IDENTITY 0 65535 PHYS_UNIT "Enable bits" /end CHARACTERISTIC
/begin CHARACTERISTIC FPsw_RAM_fail "FPrm_switches(70)" VALUE 0x001C7066 /* @ECU_Address@FPrm_switches@0x021B908C@ */ ECIPP_ALIGNMENT_UWORD 65535 Compu_IDENTITY 0 65535 PHYS_UNIT "Enable bits" /end CHARACTERISTIC
/begin CHARACTERISTIC FPsw_relay_coilopen "FPrm_switches(119)" VALUE 0x001C70C8 /* @ECU_Address@FPrm_switches@0x021B90EE@ */ ECIPP_ALIGNMENT_UWORD 65535 Compu_IDENTITY 0 65535 PHYS_UNIT "Enable bits" /end CHARACTERISTIC
/begin CHARACTERISTIC FPsw_relay_coilshort "FPrm_switches(120)" VALUE 0x001C70CA /* @ECU_Address@FPrm_switches@0x021B90F0@ */ ECIPP_ALIGNMENT_UWORD 65535 Compu_IDENTITY 0 65535 PHYS_UNIT "Enable bits" /end CHARACTERISTIC
/begin CHARACTERISTIC FPsw_relay_gndshort "FPrm_switches(118)" VALUE 0x001C70C6 /* @ECU_Address@FPrm_switches@0x021B90EC@ */ ECIPP_ALIGNMENT_UWORD 65535 Compu_IDENTITY 0 65535 PHYS_UNIT "Enable bits" /end CHARACTERISTIC
/begin CHARACTERISTIC FPsw_relayoff_hiV "FPrm_switches(328)" VALUE 0x001C726A /* @ECU_Address@FPrm_switches@0x021B9290@ */ ECIPP_ALIGNMENT_UWORD 65535 Compu_IDENTITY 0 65535 PHYS_UNIT "Enable bits" /end CHARACTERISTIC
/begin CHARACTERISTIC FPsw_relayon_loV "FPrm_switches(329)" VALUE 0x001C726C /* @ECU_Address@FPrm_switches@0x021B9292@ */ ECIPP_ALIGNMENT_UWORD 65535 Compu_IDENTITY 0 65535 PHYS_UNIT "Enable bits" /end CHARACTERISTIC
/begin CHARACTERISTIC FPsw_rpm_hi_expected "FPrm_switches(260)" VALUE 0x001C71E2 /* @ECU_Address@FPrm_switches@0x021B9208@ */ ECIPP_ALIGNMENT_UWORD 65535 Compu_IDENTITY 0 65535 PHYS_UNIT "Enable bits" /end CHARACTERISTIC
/begin CHARACTERISTIC FPsw_rpmd_gov_lo "FPrm_switches(390)" VALUE 0x001C72E6 /* @ECU_Address@FPrm_switches@0x021B930C@ */ ECIPP_ALIGNMENT_UWORD 65535 Compu_IDENTITY 0 65535 PHYS_UNIT "Enable bits" /end CHARACTERISTIC
/begin CHARACTERISTIC FPsw_RS_discon "FPrm_switches(521)" VALUE 0x001C73EC /* @ECU_Address@FPrm_switches@0x021B9412@ */ ECIPP_ALIGNMENT_UWORD 65535 Compu_IDENTITY 0 65535 PHYS_UNIT "Enable bits" /end CHARACTERISTIC
/begin CHARACTERISTIC FPsw_RS_hiV "FPrm_switches(453)" VALUE 0x001C7364 /* @ECU_Address@FPrm_switches@0x021B938A@ */ ECIPP_ALIGNMENT_UWORD 65535 Compu_IDENTITY 0 65535 PHYS_UNIT "Enable bits" /end CHARACTERISTIC
/begin CHARACTERISTIC FPsw_RS_loss "FPrm_switches(176)" VALUE 0x001C713A /* @ECU_Address@FPrm_switches@0x021B9160@ */ ECIPP_ALIGNMENT_UWORD 65535 Compu_IDENTITY 0 65535 PHYS_UNIT "Enable bits" /end CHARACTERISTIC
/begin CHARACTERISTIC FPsw_RS_loV "FPrm_switches(452)" VALUE 0x001C7362 /* @ECU_Address@FPrm_switches@0x021B9388@ */ ECIPP_ALIGNMENT_UWORD 65535 Compu_IDENTITY 0 65535 PHYS_UNIT "Enable bits" /end CHARACTERISTIC
/begin CHARACTERISTIC FPsw_RS485_bad_fmt "FPrm_switches(83)" VALUE 0x001C7080 /* @ECU_Address@FPrm_switches@0x021B90A6@ */ ECIPP_ALIGNMENT_UWORD 65535 Compu_IDENTITY 0 65535 PHYS_UNIT "Enable bits" /end CHARACTERISTIC
/begin CHARACTERISTIC FPsw_RS485_Rx_inact "FPrm_switches(81)" VALUE 0x001C707C /* @ECU_Address@FPrm_switches@0x021B90A2@ */ ECIPP_ALIGNMENT_UWORD 65535 Compu_IDENTITY 0 65535 PHYS_UNIT "Enable bits" /end CHARACTERISTIC
/begin CHARACTERISTIC FPsw_RS485_Rx_noise "FPrm_switches(82)" VALUE 0x001C707E /* @ECU_Address@FPrm_switches@0x021B90A4@ */ ECIPP_ALIGNMENT_UWORD 65535 Compu_IDENTITY 0 65535 PHYS_UNIT "Enable bits" /end CHARACTERISTIC
/begin CHARACTERISTIC FPsw_RS485_SD_rq "FPrm_switches(84)" VALUE 0x001C7082 /* @ECU_Address@FPrm_switches@0x021B90A8@ */ ECIPP_ALIGNMENT_UWORD 65535 Compu_IDENTITY 0 65535 PHYS_UNIT "Enable bits" /end CHARACTERISTIC
/begin CHARACTERISTIC FPsw_RTI1 "FPrm_switches(64)" VALUE 0x001C705A /* @ECU_Address@FPrm_switches@0x021B9080@ */ ECIPP_ALIGNMENT_UWORD 65535 Compu_IDENTITY 0 65535 PHYS_UNIT "Enable bits" /end CHARACTERISTIC
/begin CHARACTERISTIC FPsw_RTI2 "FPrm_switches(65)" VALUE 0x001C705C /* @ECU_Address@FPrm_switches@0x021B9082@ */ ECIPP_ALIGNMENT_UWORD 65535 Compu_IDENTITY 0 65535 PHYS_UNIT "Enable bits" /end CHARACTERISTIC
/begin CHARACTERISTIC FPsw_RTI3 "FPrm_switches(66)" VALUE 0x001C705E /* @ECU_Address@FPrm_switches@0x021B9084@ */ ECIPP_ALIGNMENT_UWORD 65535 Compu_IDENTITY 0 65535 PHYS_UNIT "Enable bits" /end CHARACTERISTIC
/begin CHARACTERISTIC FPsw_Sec1_31KV_open "FPrm_switches(707)" VALUE 0x001C7560 /* @ECU_Address@FPrm_switches@0x021B9586@ */ ECIPP_ALIGNMENT_UWORD 65535 Compu_IDENTITY 0 65535 PHYS_UNIT "Enable bits" /end CHARACTERISTIC
/begin CHARACTERISTIC FPsw_Sec1_low "FPrm_switches(706)" VALUE 0x001C755E /* @ECU_Address@FPrm_switches@0x021B9584@ */ ECIPP_ALIGNMENT_UWORD 65535 Compu_IDENTITY 0 65535 PHYS_UNIT "Enable bits" /end CHARACTERISTIC
/begin CHARACTERISTIC FPsw_Sec1_open "FPrm_switches(705)" VALUE 0x001C755C /* @ECU_Address@FPrm_switches@0x021B9582@ */ ECIPP_ALIGNMENT_UWORD 65535 Compu_IDENTITY 0 65535 PHYS_UNIT "Enable bits" /end CHARACTERISTIC
/begin CHARACTERISTIC FPsw_SHIFT_FB_OOR "FPrm_switches(216)" VALUE 0x001C718A /* @ECU_Address@FPrm_switches@0x021B91B0@ */ ECIPP_ALIGNMENT_UWORD 65535 Compu_IDENTITY 0 65535 PHYS_UNIT "Enable bits" /end CHARACTERISTIC
/begin CHARACTERISTIC FPsw_SHIFT_intcirc_fail "FPrm_switches(218)" VALUE 0x001C718E /* @ECU_Address@FPrm_switches@0x021B91B4@ */ ECIPP_ALIGNMENT_UWORD 65535 Compu_IDENTITY 0 65535 PHYS_UNIT "Enable bits" /end CHARACTERISTIC
/begin CHARACTERISTIC FPsw_SHIFT_shift_fail "FPrm_switches(217)" VALUE 0x001C718C /* @ECU_Address@FPrm_switches@0x021B91B2@ */ ECIPP_ALIGNMENT_UWORD 65535 Compu_IDENTITY 0 65535 PHYS_UNIT "Enable bits" /end CHARACTERISTIC
/begin CHARACTERISTIC FPsw_SL_fuel "FPrm_switches(38)" VALUE 0x001C7026 /* @ECU_Address@FPrm_switches@0x021B904C@ */ ECIPP_ALIGNMENT_UWORD 65535 Compu_IDENTITY 0 65535 PHYS_UNIT "Enable bits" /end CHARACTERISTIC
/begin CHARACTERISTIC FPsw_SL_gov "FPrm_switches(37)" VALUE 0x001C7024 /* @ECU_Address@FPrm_switches@0x021B904A@ */ ECIPP_ALIGNMENT_UWORD 65535 Compu_IDENTITY 0 65535 PHYS_UNIT "Enable bits" /end CHARACTERISTIC
/begin CHARACTERISTIC FPsw_SL_spk "FPrm_switches(39)" VALUE 0x001C7028 /* @ECU_Address@FPrm_switches@0x021B904E@ */ ECIPP_ALIGNMENT_UWORD 65535 Compu_IDENTITY 0 65535 PHYS_UNIT "Enable bits" /end CHARACTERISTIC
/begin CHARACTERISTIC FPsw_slv_MAP_hi_OOA "FPrm_switches(664)" VALUE 0x001C750A /* @ECU_Address@FPrm_switches@0x021B9530@ */ ECIPP_ALIGNMENT_UWORD 65535 Compu_IDENTITY 0 65535 PHYS_UNIT "Enable bits" /end CHARACTERISTIC
/begin CHARACTERISTIC FPsw_slv_MAP_lo_OOA "FPrm_switches(665)" VALUE 0x001C750C /* @ECU_Address@FPrm_switches@0x021B9532@ */ ECIPP_ALIGNMENT_UWORD 65535 Compu_IDENTITY 0 65535 PHYS_UNIT "Enable bits" /end CHARACTERISTIC
/begin CHARACTERISTIC FPsw_SPK_int_fail "FPrm_switches(225)" VALUE 0x001C719C /* @ECU_Address@FPrm_switches@0x021B91C2@ */ ECIPP_ALIGNMENT_UWORD 65535 Compu_IDENTITY 0 65535 PHYS_UNIT "Enable bits" /end CHARACTERISTIC
/begin CHARACTERISTIC FPsw_SPK1_IGBT_T "FPrm_switches(388)" VALUE 0x001C72E2 /* @ECU_Address@FPrm_switches@0x021B9308@ */ ECIPP_ALIGNMENT_UWORD 65535 Compu_IDENTITY 0 65535 PHYS_UNIT "Enable bits" /end CHARACTERISTIC
/begin CHARACTERISTIC FPsw_SPKD_coil_fail "FPrm_switches(226)" VALUE 0x001C719E /* @ECU_Address@FPrm_switches@0x021B91C4@ */ ECIPP_ALIGNMENT_UWORD 65535 Compu_IDENTITY 0 65535 PHYS_UNIT "Enable bits" /end CHARACTERISTIC
/begin CHARACTERISTIC FPsw_SPKD_dw_hi "FPrm_switches(56)" VALUE 0x001C704A /* @ECU_Address@FPrm_switches@0x021B9070@ */ ECIPP_ALIGNMENT_UWORD 65535 Compu_IDENTITY 0 65535 PHYS_UNIT "Enable bits" /end CHARACTERISTIC
/begin CHARACTERISTIC FPsw_SPKD_dw_lo "FPrm_switches(55)" VALUE 0x001C7048 /* @ECU_Address@FPrm_switches@0x021B906E@ */ ECIPP_ALIGNMENT_UWORD 65535 Compu_IDENTITY 0 65535 PHYS_UNIT "Enable bits" /end CHARACTERISTIC
/begin CHARACTERISTIC FPsw_SRVC_expired "FPrm_switches(323)" VALUE 0x001C7260 /* @ECU_Address@FPrm_switches@0x021B9286@ */ ECIPP_ALIGNMENT_UWORD 65535 Compu_IDENTITY 0 65535 PHYS_UNIT "Enable bits" /end CHARACTERISTIC
/begin CHARACTERISTIC FPsw_SRVC_expired2 "FPrm_switches(663)" VALUE 0x001C7508 /* @ECU_Address@FPrm_switches@0x021B952E@ */ ECIPP_ALIGNMENT_UWORD 65535 Compu_IDENTITY 0 65535 PHYS_UNIT "Enable bits" /end CHARACTERISTIC
/begin CHARACTERISTIC FPsw_start_coilopen "FPrm_switches(122)" VALUE 0x001C70CE /* @ECU_Address@FPrm_switches@0x021B90F4@ */ ECIPP_ALIGNMENT_UWORD 65535 Compu_IDENTITY 0 65535 PHYS_UNIT "Enable bits" /end CHARACTERISTIC
/begin CHARACTERISTIC FCdtc_PWM17_off_loVf "FCtl_DTC(447)" VALUE 0x001E3BE8 /* @ECU_Address@FCtl_DTC@0x021B537E@ */ ECIPP_ALIGNMENT_UWORD 65535 Compu_IDENTITY 0 65535 PHYS_UNIT "DTC" /end CHARACTERISTIC
/begin CHARACTERISTIC FCdtc_PWM17_on_hiVf "FCtl_DTC(448)" VALUE 0x001E3BEA /* @ECU_Address@FCtl_DTC@0x021B5380@ */ ECIPP_ALIGNMENT_UWORD 65535 Compu_IDENTITY 0 65535 PHYS_UNIT "DTC" /end CHARACTERISTIC
/begin CHARACTERISTIC FCdtc_PWM18_off_loVf "FCtl_DTC(449)" VALUE 0x001E3BEC /* @ECU_Address@FCtl_DTC@0x021B5382@ */ ECIPP_ALIGNMENT_UWORD 65535 Compu_IDENTITY 0 65535 PHYS_UNIT "DTC" /end CHARACTERISTIC
/begin CHARACTERISTIC FCdtc_PWM18_on_hiVf "FCtl_DTC(450)" VALUE 0x001E3BEE /* @ECU_Address@FCtl_DTC@0x021B5384@ */ ECIPP_ALIGNMENT_UWORD 65535 Compu_IDENTITY 0 65535 PHYS_UNIT "DTC" /end CHARACTERISTIC
/begin CHARACTERISTIC FCdtc_PWM19_off_loVf "FCtl_DTC(451)" VALUE 0x001E3BF0 /* @ECU_Address@FCtl_DTC@0x021B5386@ */ ECIPP_ALIGNMENT_UWORD 65535 Compu_IDENTITY 0 65535 PHYS_UNIT "DTC" /end CHARACTERISTIC
/begin CHARACTERISTIC FCdtc_PWM19_on_hiVf "FCtl_DTC(452)" VALUE 0x001E3BF2 /* @ECU_Address@FCtl_DTC@0x021B5388@ */ ECIPP_ALIGNMENT_UWORD 65535 Compu_IDENTITY 0 65535 PHYS_UNIT "DTC" /end CHARACTERISTIC
/begin CHARACTERISTIC FCdtc_PWM2_off_loVf "FCtl_DTC(191)" VALUE 0x001E39E8 /* @ECU_Address@FCtl_DTC@0x021B517E@ */ ECIPP_ALIGNMENT_UWORD 65535 Compu_IDENTITY 0 65535 PHYS_UNIT "DTC" /end CHARACTERISTIC
/begin CHARACTERISTIC FCdtc_PWM2_on_hiVf "FCtl_DTC(192)" VALUE 0x001E39EA /* @ECU_Address@FCtl_DTC@0x021B5180@ */ ECIPP_ALIGNMENT_UWORD 65535 Compu_IDENTITY 0 65535 PHYS_UNIT "DTC" /end CHARACTERISTIC
/begin CHARACTERISTIC FCdtc_PWM20_off_loVf "FCtl_DTC(453)" VALUE 0x001E3BF4 /* @ECU_Address@FCtl_DTC@0x021B538A@ */ ECIPP_ALIGNMENT_UWORD 65535 Compu_IDENTITY 0 65535 PHYS_UNIT "DTC" /end CHARACTERISTIC
/begin CHARACTERISTIC FCdtc_PWM20_on_hiVf "FCtl_DTC(454)" VALUE 0x001E3BF6 /* @ECU_Address@FCtl_DTC@0x021B538C@ */ ECIPP_ALIGNMENT_UWORD 65535 Compu_IDENTITY 0 65535 PHYS_UNIT "DTC" /end CHARACTERISTIC
/begin CHARACTERISTIC FCdtc_PWM21_off_loVf "FCtl_DTC(455)" VALUE 0x001E3BF8 /* @ECU_Address@FCtl_DTC@0x021B538E@ */ ECIPP_ALIGNMENT_UWORD 65535 Compu_IDENTITY 0 65535 PHYS_UNIT "DTC" /end CHARACTERISTIC
/begin CHARACTERISTIC FCdtc_PWM21_on_hiVf "FCtl_DTC(456)" VALUE 0x001E3BFA /* @ECU_Address@FCtl_DTC@0x021B5390@ */ ECIPP_ALIGNMENT_UWORD 65535 Compu_IDENTITY 0 65535 PHYS_UNIT "DTC" /end CHARACTERISTIC
/begin CHARACTERISTIC FCdtc_PWM22_off_loVf "FCtl_DTC(457)" VALUE 0x001E3BFC /* @ECU_Address@FCtl_DTC@0x021B5392@ */ ECIPP_ALIGNMENT_UWORD 65535 Compu_IDENTITY 0 65535 PHYS_UNIT "DTC" /end CHARACTERISTIC
/begin CHARACTERISTIC FCdtc_PWM22_on_hiVf "FCtl_DTC(458)" VALUE 0x001E3BFE /* @ECU_Address@FCtl_DTC@0x021B5394@ */ ECIPP_ALIGNMENT_UWORD 65535 Compu_IDENTITY 0 65535 PHYS_UNIT "DTC" /end CHARACTERISTIC
/begin CHARACTERISTIC FCdtc_PWM23_off_loVf "FCtl_DTC(459)" VALUE 0x001E3C00 /* @ECU_Address@FCtl_DTC@0x021B5396@ */ ECIPP_ALIGNMENT_UWORD 65535 Compu_IDENTITY 0 65535 PHYS_UNIT "DTC" /end CHARACTERISTIC
/begin CHARACTERISTIC FCdtc_PWM23_on_hiVf "FCtl_DTC(460)" VALUE 0x001E3C02 /* @ECU_Address@FCtl_DTC@0x021B5398@ */ ECIPP_ALIGNMENT_UWORD 65535 Compu_IDENTITY 0 65535 PHYS_UNIT "DTC" /end CHARACTERISTIC
/begin CHARACTERISTIC FCdtc_PWM3_off_loVf "FCtl_DTC(193)" VALUE 0x001E39EC /* @ECU_Address@FCtl_DTC@0x021B5182@ */ ECIPP_ALIGNMENT_UWORD 65535 Compu_IDENTITY 0 65535 PHYS_UNIT "DTC" /end CHARACTERISTIC
/begin CHARACTERISTIC FCdtc_PWM3_on_hiVf "FCtl_DTC(194)" VALUE 0x001E39EE /* @ECU_Address@FCtl_DTC@0x021B5184@ */ ECIPP_ALIGNMENT_UWORD 65535 Compu_IDENTITY 0 65535 PHYS_UNIT "DTC" /end CHARACTERISTIC
/begin CHARACTERISTIC FCdtc_PWM4_off_loVf "FCtl_DTC(195)" VALUE 0x001E39F0 /* @ECU_Address@FCtl_DTC@0x021B5186@ */ ECIPP_ALIGNMENT_UWORD 65535 Compu_IDENTITY 0 65535 PHYS_UNIT "DTC" /end CHARACTERISTIC
/begin CHARACTERISTIC FCdtc_PWM4_on_hiVf "FCtl_DTC(196)" VALUE 0x001E39F2 /* @ECU_Address@FCtl_DTC@0x021B5188@ */ ECIPP_ALIGNMENT_UWORD 65535 Compu_IDENTITY 0 65535 PHYS_UNIT "DTC" /end CHARACTERISTIC
/begin CHARACTERISTIC FCdtc_PWM5_off_loVf "FCtl_DTC(197)" VALUE 0x001E39F4 /* @ECU_Address@FCtl_DTC@0x021B518A@ */ ECIPP_ALIGNMENT_UWORD 65535 Compu_IDENTITY 0 65535 PHYS_UNIT "DTC" /end CHARACTERISTIC
/begin CHARACTERISTIC FCdtc_PWM5_on_hiVf "FCtl_DTC(198)" VALUE 0x001E39F6 /* @ECU_Address@FCtl_DTC@0x021B518C@ */ ECIPP_ALIGNMENT_UWORD 65535 Compu_IDENTITY 0 65535 PHYS_UNIT "DTC" /end CHARACTERISTIC
/begin CHARACTERISTIC FCdtc_PWM6_off_loVf "FCtl_DTC(276)" VALUE 0x001E3A92 /* @ECU_Address@FCtl_DTC@0x021B5228@ */ ECIPP_ALIGNMENT_UWORD 65535 Compu_IDENTITY 0 65535 PHYS_UNIT "DTC" /end CHARACTERISTIC
/begin CHARACTERISTIC FCdtc_PWM6_on_hiVf "FCtl_DTC(277)" VALUE 0x001E3A94 /* @ECU_Address@FCtl_DTC@0x021B522A@ */ ECIPP_ALIGNMENT_UWORD 65535 Compu_IDENTITY 0 65535 PHYS_UNIT "DTC" /end CHARACTERISTIC
/begin CHARACTERISTIC FCdtc_PWM7_off_loVf "FCtl_DTC(278)" VALUE 0x001E3A96 /* @ECU_Address@FCtl_DTC@0x021B522C@ */ ECIPP_ALIGNMENT_UWORD 65535 Compu_IDENTITY 0 65535 PHYS_UNIT "DTC" /end CHARACTERISTIC
/begin CHARACTERISTIC FCdtc_PWM7_on_hiVf "FCtl_DTC(279)" VALUE 0x001E3A98 /* @ECU_Address@FCtl_DTC@0x021B522E@ */ ECIPP_ALIGNMENT_UWORD 65535 Compu_IDENTITY 0 65535 PHYS_UNIT "DTC" /end CHARACTERISTIC
/begin CHARACTERISTIC FCdtc_PWM8_off_loVf "FCtl_DTC(283)" VALUE 0x001E3AA0 /* @ECU_Address@FCtl_DTC@0x021B5236@ */ ECIPP_ALIGNMENT_UWORD 65535 Compu_IDENTITY 0 65535 PHYS_UNIT "DTC" /end CHARACTERISTIC
/begin CHARACTERISTIC FCdtc_PWM8_on_hiVf "FCtl_DTC(284)" VALUE 0x001E3AA2 /* @ECU_Address@FCtl_DTC@0x021B5238@ */ ECIPP_ALIGNMENT_UWORD 65535 Compu_IDENTITY 0 65535 PHYS_UNIT "DTC" /end CHARACTERISTIC
/begin CHARACTERISTIC FCdtc_PWM9_off_loVf "FCtl_DTC(285)" VALUE 0x001E3AA4 /* @ECU_Address@FCtl_DTC@0x021B523A@ */ ECIPP_ALIGNMENT_UWORD 65535 Compu_IDENTITY 0 65535 PHYS_UNIT "DTC" /end CHARACTERISTIC
/begin CHARACTERISTIC FCdtc_PWM9_on_hiVf "FCtl_DTC(286)" VALUE 0x001E3AA6 /* @ECU_Address@FCtl_DTC@0x021B523C@ */ ECIPP_ALIGNMENT_UWORD 65535 Compu_IDENTITY 0 65535 PHYS_UNIT "DTC" /end CHARACTERISTIC
/begin CHARACTERISTIC FCdtc_PWMLO_off_loVf "FCtl_DTC(521)" VALUE 0x001E3C7C /* @ECU_Address@FCtl_DTC@0x021B5412@ */ ECIPP_ALIGNMENT_UWORD 65535 Compu_IDENTITY 0 65535 PHYS_UNIT "DTC" /end CHARACTERISTIC
/begin CHARACTERISTIC FCdtc_PWMLO_on_hiVf "FCtl_DTC(522)" VALUE 0x001E3C7E /* @ECU_Address@FCtl_DTC@0x021B5414@ */ ECIPP_ALIGNMENT_UWORD 65535 Compu_IDENTITY 0 65535 PHYS_UNIT "DTC" /end CHARACTERISTIC
/begin CHARACTERISTIC FCdtc_radby_poserr "FCtl_DTC(870)" VALUE 0x001E3F36 /* @ECU_Address@FCtl_DTC@0x021B56CC@ */ ECIPP_ALIGNMENT_UWORD 65535 Compu_IDENTITY 0 65535 PHYS_UNIT "DTC" /end CHARACTERISTIC
/begin CHARACTERISTIC FCdtc_RAM_fail "FCtl_DTC(106)" VALUE 0x001E393E /* @ECU_Address@FCtl_DTC@0x021B50D4@ */ ECIPP_ALIGNMENT_UWORD 65535 Compu_IDENTITY 0 65535 PHYS_UNIT "DTC" /end CHARACTERISTIC
/begin CHARACTERISTIC FCdtc_relay_coilopen "FCtl_DTC(159)" VALUE 0x001E39A8 /* @ECU_Address@FCtl_DTC@0x021B513E@ */ ECIPP_ALIGNMENT_UWORD 65535 Compu_IDENTITY 0 65535 PHYS_UNIT "DTC" /end CHARACTERISTIC
/begin CHARACTERISTIC FCdtc_relay_coilshort "FCtl_DTC(160)" VALUE 0x001E39AA /* @ECU_Address@FCtl_DTC@0x021B5140@ */ ECIPP_ALIGNMENT_UWORD 65535 Compu_IDENTITY 0 65535 PHYS_UNIT "DTC" /end CHARACTERISTIC
/begin CHARACTERISTIC FCdtc_relay_gndshort "FCtl_DTC(158)" VALUE 0x001E39A6 /* @ECU_Address@FCtl_DTC@0x021B513C@ */ ECIPP_ALIGNMENT_UWORD 65535 Compu_IDENTITY 0 65535 PHYS_UNIT "DTC" /end CHARACTERISTIC
/begin CHARACTERISTIC FCdtc_relayoff_hiV "FCtl_DTC(431)" VALUE 0x001E3BC8 /* @ECU_Address@FCtl_DTC@0x021B535E@ */ ECIPP_ALIGNMENT_UWORD 65535 Compu_IDENTITY 0 65535 PHYS_UNIT "DTC" /end CHARACTERISTIC
/begin CHARACTERISTIC FCdtc_relayon_loV "FCtl_DTC(432)" VALUE 0x001E3BCA /* @ECU_Address@FCtl_DTC@0x021B5360@ */ ECIPP_ALIGNMENT_UWORD 65535 Compu_IDENTITY 0 65535 PHYS_UNIT "DTC" /end CHARACTERISTIC
/begin CHARACTERISTIC FCdtc_rpm_hi_expected "FCtl_DTC(351)" VALUE 0x001E3B28 /* @ECU_Address@FCtl_DTC@0x021B52BE@ */ ECIPP_ALIGNMENT_UWORD 65535 Compu_IDENTITY 0 65535 PHYS_UNIT "DTC" /end CHARACTERISTIC
/begin CHARACTERISTIC FCdtc_rpmd_gov_lo "FCtl_DTC(520)" VALUE 0x001E3C7A /* @ECU_Address@FCtl_DTC@0x021B5410@ */ ECIPP_ALIGNMENT_UWORD 65535 Compu_IDENTITY 0 65535 PHYS_UNIT "DTC" /end CHARACTERISTIC
/begin CHARACTERISTIC FCdtc_RS_discon "FCtl_DTC(691)" VALUE 0x001E3DD0 /* @ECU_Address@FCtl_DTC@0x021B5566@ */ ECIPP_ALIGNMENT_UWORD 65535 Compu_IDENTITY 0 65535 PHYS_UNIT "DTC" /end CHARACTERISTIC
/begin CHARACTERISTIC FCdtc_RS_hiV "FCtl_DTC(599)" VALUE 0x001E3D18 /* @ECU_Address@FCtl_DTC@0x021B54AE@ */ ECIPP_ALIGNMENT_UWORD 65535 Compu_IDENTITY 0 65535 PHYS_UNIT "DTC" /end CHARACTERISTIC
/begin CHARACTERISTIC FCdtc_RS_loss "FCtl_DTC(220)" VALUE 0x001E3A22 /* @ECU_Address@FCtl_DTC@0x021B51B8@ */ ECIPP_ALIGNMENT_UWORD 65535 Compu_IDENTITY 0 65535 PHYS_UNIT "DTC" /end CHARACTERISTIC
/begin CHARACTERISTIC FCdtc_RS_loV "FCtl_DTC(598)" VALUE 0x001E3D16 /* @ECU_Address@FCtl_DTC@0x021B54AC@ */ ECIPP_ALIGNMENT_UWORD 65535 Compu_IDENTITY 0 65535 PHYS_UNIT "DTC" /end CHARACTERISTIC
/begin CHARACTERISTIC FCdtc_RS485_bad_fmt "FCtl_DTC(124)" VALUE 0x001E3962 /* @ECU_Address@FCtl_DTC@0x021B50F8@ */ ECIPP_ALIGNMENT_UWORD 65535 Compu_IDENTITY 0 65535 PHYS_UNIT "DTC" /end CHARACTERISTIC
/begin CHARACTERISTIC FCdtc_RS485_Rx_inact "FCtl_DTC(122)" VALUE 0x001E395E /* @ECU_Address@FCtl_DTC@0x021B50F4@ */ ECIPP_ALIGNMENT_UWORD 65535 Compu_IDENTITY 0 65535 PHYS_UNIT "DTC" /end CHARACTERISTIC
/begin CHARACTERISTIC FCdtc_RS485_Rx_noise "FCtl_DTC(123)" VALUE 0x001E3960 /* @ECU_Address@FCtl_DTC@0x021B50F6@ */ ECIPP_ALIGNMENT_UWORD 65535 Compu_IDENTITY 0 65535 PHYS_UNIT "DTC" /end CHARACTERISTIC
/begin CHARACTERISTIC FCdtc_RS485_SD_rq "FCtl_DTC(125)" VALUE 0x001E3964 /* @ECU_Address@FCtl_DTC@0x021B50FA@ */ ECIPP_ALIGNMENT_UWORD 65535 Compu_IDENTITY 0 65535 PHYS_UNIT "DTC" /end CHARACTERISTIC
/begin CHARACTERISTIC FCdtc_RTI1 "FCtl_DTC(100)" VALUE 0x001E3932 /* @ECU_Address@FCtl_DTC@0x021B50C8@ */ ECIPP_ALIGNMENT_UWORD 65535 Compu_IDENTITY 0 65535 PHYS_UNIT "DTC" /end CHARACTERISTIC
/begin CHARACTERISTIC FCdtc_RTI2 "FCtl_DTC(101)" VALUE 0x001E3934 /* @ECU_Address@FCtl_DTC@0x021B50CA@ */ ECIPP_ALIGNMENT_UWORD 65535 Compu_IDENTITY 0 65535 PHYS_UNIT "DTC" /end CHARACTERISTIC
/begin CHARACTERISTIC FCdtc_RTI3 "FCtl_DTC(102)" VALUE 0x001E3936 /* @ECU_Address@FCtl_DTC@0x021B50CC@ */ ECIPP_ALIGNMENT_UWORD 65535 Compu_IDENTITY 0 65535 PHYS_UNIT "DTC" /end CHARACTERISTIC
/begin CHARACTERISTIC FCdtc_Sec1_31KV_open "FCtl_DTC(949)" VALUE 0x001E3FD4 /* @ECU_Address@FCtl_DTC@0x021B576A@ */ ECIPP_ALIGNMENT_UWORD 65535 Compu_IDENTITY 0 65535 PHYS_UNIT "DTC" /end CHARACTERISTIC
/begin CHARACTERISTIC FCdtc_Sec1_low "FCtl_DTC(937)" VALUE 0x001E3FBC /* @ECU_Address@FCtl_DTC@0x021B5752@ */ ECIPP_ALIGNMENT_UWORD 65535 Compu_IDENTITY 0 65535 PHYS_UNIT "DTC" /end CHARACTERISTIC
/begin CHARACTERISTIC FCdtc_Sec1_open "FCtl_DTC(925)" VALUE 0x001E3FA4 /* @ECU_Address@FCtl_DTC@0x021B573A@ */ ECIPP_ALIGNMENT_UWORD 65535 Compu_IDENTITY 0 65535 PHYS_UNIT "DTC" /end CHARACTERISTIC
/begin CHARACTERISTIC FCdtc_SHIFT_FB_OOR "FCtl_DTC(294)" VALUE 0x001E3AB6 /* @ECU_Address@FCtl_DTC@0x021B524C@ */ ECIPP_ALIGNMENT_UWORD 65535 Compu_IDENTITY 0 65535 PHYS_UNIT "DTC" /end CHARACTERISTIC
/begin CHARACTERISTIC FCdtc_SHIFT_intcirc_fail "FCtl_DTC(296)" VALUE 0x001E3ABA /* @ECU_Address@FCtl_DTC@0x021B5250@ */ ECIPP_ALIGNMENT_UWORD 65535 Compu_IDENTITY 0 65535 PHYS_UNIT "DTC" /end CHARACTERISTIC
/begin CHARACTERISTIC FCdtc_SHIFT_shift_fail "FCtl_DTC(295)" VALUE 0x001E3AB8 /* @ECU_Address@FCtl_DTC@0x021B524E@ */ ECIPP_ALIGNMENT_UWORD 65535 Compu_IDENTITY 0 65535 PHYS_UNIT "DTC" /end CHARACTERISTIC
/begin CHARACTERISTIC FCdtc_SL_fuel "FCtl_DTC(109)" VALUE 0x001E3944 /* @ECU_Address@FCtl_DTC@0x021B50DA@ */ ECIPP_ALIGNMENT_UWORD 65535 Compu_IDENTITY 0 65535 PHYS_UNIT "DTC" /end CHARACTERISTIC
/begin CHARACTERISTIC FCdtc_SL_gov "FCtl_DTC(108)" VALUE 0x001E3942 /* @ECU_Address@FCtl_DTC@0x021B50D8@ */ ECIPP_ALIGNMENT_UWORD 65535 Compu_IDENTITY 0 65535 PHYS_UNIT "DTC" /end CHARACTERISTIC
/begin CHARACTERISTIC FCdtc_SL_spk "FCtl_DTC(110)" VALUE 0x001E3946 /* @ECU_Address@FCtl_DTC@0x021B50DC@ */ ECIPP_ALIGNMENT_UWORD 65535 Compu_IDENTITY 0 65535 PHYS_UNIT "DTC" /end CHARACTERISTIC
/begin CHARACTERISTIC FCdtc_slv_MAP_hi_OOA "FCtl_DTC(837)" VALUE 0x001E3EF4 /* @ECU_Address@FCtl_DTC@0x021B568A@ */ ECIPP_ALIGNMENT_UWORD 65535 Compu_IDENTITY 0 65535 PHYS_UNIT "DTC" /end CHARACTERISTIC
/begin CHARACTERISTIC FCdtc_slv_MAP_lo_OOA "FCtl_DTC(838)" VALUE 0x001E3EF6 /* @ECU_Address@FCtl_DTC@0x021B568C@ */ ECIPP_ALIGNMENT_UWORD 65535 Compu_IDENTITY 0 65535 PHYS_UNIT "DTC" /end CHARACTERISTIC
/begin CHARACTERISTIC FCdtc_SPK_int_fail "FCtl_DTC(303)" VALUE 0x001E3AC8 /* @ECU_Address@FCtl_DTC@0x021B525E@ */ ECIPP_ALIGNMENT_UWORD 65535 Compu_IDENTITY 0 65535 PHYS_UNIT "DTC" /end CHARACTERISTIC
/begin CHARACTERISTIC FCdtc_SPK1_IGBT_T "FCtl_DTC(509)" VALUE 0x001E3C64 /* @ECU_Address@FCtl_DTC@0x021B53FA@ */ ECIPP_ALIGNMENT_UWORD 65535 Compu_IDENTITY 0 65535 PHYS_UNIT "DTC" /end CHARACTERISTIC
/begin CHARACTERISTIC FCdtc_SPKD_coil_fail "FCtl_DTC(304)" VALUE 0x001E3ACA /* @ECU_Address@FCtl_DTC@0x021B5260@ */ ECIPP_ALIGNMENT_UWORD 65535 Compu_IDENTITY 0 65535 PHYS_UNIT "DTC" /end CHARACTERISTIC
/begin CHARACTERISTIC FCdtc_SPKD_dw_hi "FCtl_DTC(76)" VALUE 0x001E3902 /* @ECU_Address@FCtl_DTC@0x021B5098@ */ ECIPP_ALIGNMENT_UWORD 65535 Compu_IDENTITY 0 65535 PHYS_UNIT "DTC" /end CHARACTERISTIC
/begin CHARACTERISTIC FCdtc_SPKD_dw_lo "FCtl_DTC(66)" VALUE 0x001E38EE /* @ECU_Address@FCtl_DTC@0x021B5084@ */ ECIPP_ALIGNMENT_UWORD 65535 Compu_IDENTITY 0 65535 PHYS_UNIT "DTC" /end CHARACTERISTIC
/begin CHARACTERISTIC FCdtc_SRVC_expired "FCtl_DTC(426)" VALUE 0x001E3BBE /* @ECU_Address@FCtl_DTC@0x021B5354@ */ ECIPP_ALIGNMENT_UWORD 65535 Compu_IDENTITY 0 65535 PHYS_UNIT "DTC" /end CHARACTERISTIC
/begin CHARACTERISTIC FCdtc_SRVC_expired2 "FCtl_DTC(836)" VALUE 0x001E3EF2 /* @ECU_Address@FCtl_DTC@0x021B5688@ */ ECIPP_ALIGNMENT_UWORD 65535 Compu_IDENTITY 0 65535 PHYS_UNIT "DTC" /end CHARACTERISTIC
/begin CHARACTERISTIC FCdtc_start_coilopen "FCtl_DTC(162)" VALUE 0x001E39AE /* @ECU_Address@FCtl_DTC@0x021B5144@ */ ECIPP_ALIGNMENT_UWORD 65535 Compu_IDENTITY 0 65535 PHYS_UNIT "DTC" /end CHARACTERISTIC
/begin CHARACTERISTIC FCfmi_PWM17_off_loVf "FCtl_FMI(447)" VALUE 0x001E5AC0 /* @ECU_Address@FCtl_FMI@0x021B71BF@ */ ECIPP_ALIGNMENT_UBYTE 255 Compu_IDENTITY 0 255 PHYS_UNIT "FMI" /end CHARACTERISTIC
/begin CHARACTERISTIC FCfmi_PWM17_on_hiVf "FCtl_FMI(448)" VALUE 0x001E5AC1 /* @ECU_Address@FCtl_FMI@0x021B71C0@ */ ECIPP_ALIGNMENT_UBYTE 255 Compu_IDENTITY 0 255 PHYS_UNIT "FMI" /end CHARACTERISTIC
/begin CHARACTERISTIC FCfmi_PWM18_off_loVf "FCtl_FMI(449)" VALUE 0x001E5AC2 /* @ECU_Address@FCtl_FMI@0x021B71C1@ */ ECIPP_ALIGNMENT_UBYTE 255 Compu_IDENTITY 0 255 PHYS_UNIT "FMI" /end CHARACTERISTIC
/begin CHARACTERISTIC FCfmi_PWM18_on_hiVf "FCtl_FMI(450)" VALUE 0x001E5AC3 /* @ECU_Address@FCtl_FMI@0x021B71C2@ */ ECIPP_ALIGNMENT_UBYTE 255 Compu_IDENTITY 0 255 PHYS_UNIT "FMI" /end CHARACTERISTIC
/begin CHARACTERISTIC FCfmi_PWM19_off_loVf "FCtl_FMI(451)" VALUE 0x001E5AC4 /* @ECU_Address@FCtl_FMI@0x021B71C3@ */ ECIPP_ALIGNMENT_UBYTE 255 Compu_IDENTITY 0 255 PHYS_UNIT "FMI" /end CHARACTERISTIC
/begin CHARACTERISTIC FCfmi_PWM19_on_hiVf "FCtl_FMI(452)" VALUE 0x001E5AC5 /* @ECU_Address@FCtl_FMI@0x021B71C4@ */ ECIPP_ALIGNMENT_UBYTE 255 Compu_IDENTITY 0 255 PHYS_UNIT "FMI" /end CHARACTERISTIC
/begin CHARACTERISTIC FCfmi_PWM2_off_loVf "FCtl_FMI(191)" VALUE 0x001E59C0 /* @ECU_Address@FCtl_FMI@0x021B70BF@ */ ECIPP_ALIGNMENT_UBYTE 255 Compu_IDENTITY 0 255 PHYS_UNIT "FMI" /end CHARACTERISTIC
/begin CHARACTERISTIC FCfmi_PWM2_on_hiVf "FCtl_FMI(192)" VALUE 0x001E59C1 /* @ECU_Address@FCtl_FMI@0x021B70C0@ */ ECIPP_ALIGNMENT_UBYTE 255 Compu_IDENTITY 0 255 PHYS_UNIT "FMI" /end CHARACTERISTIC
/begin CHARACTERISTIC FCfmi_PWM20_off_loVf "FCtl_FMI(453)" VALUE 0x001E5AC6 /* @ECU_Address@FCtl_FMI@0x021B71C5@ */ ECIPP_ALIGNMENT_UBYTE 255 Compu_IDENTITY 0 255 PHYS_UNIT "FMI" /end CHARACTERISTIC
/begin CHARACTERISTIC FCfmi_PWM20_on_hiVf "FCtl_FMI(454)" VALUE 0x001E5AC7 /* @ECU_Address@FCtl_FMI@0x021B71C6@ */ ECIPP_ALIGNMENT_UBYTE 255 Compu_IDENTITY 0 255 PHYS_UNIT "FMI" /end CHARACTERISTIC
/begin CHARACTERISTIC FCfmi_PWM21_off_loVf "FCtl_FMI(455)" VALUE 0x001E5AC8 /* @ECU_Address@FCtl_FMI@0x021B71C7@ */ ECIPP_ALIGNMENT_UBYTE 255 Compu_IDENTITY 0 255 PHYS_UNIT "FMI" /end CHARACTERISTIC
/begin CHARACTERISTIC FCfmi_PWM21_on_hiVf "FCtl_FMI(456)" VALUE 0x001E5AC9 /* @ECU_Address@FCtl_FMI@0x021B71C8@ */ ECIPP_ALIGNMENT_UBYTE 255 Compu_IDENTITY 0 255 PHYS_UNIT "FMI" /end CHARACTERISTIC
/begin CHARACTERISTIC FCfmi_PWM22_off_loVf "FCtl_FMI(457)" VALUE 0x001E5ACA /* @ECU_Address@FCtl_FMI@0x021B71C9@ */ ECIPP_ALIGNMENT_UBYTE 255 Compu_IDENTITY 0 255 PHYS_UNIT "FMI" /end CHARACTERISTIC
/begin CHARACTERISTIC FCfmi_PWM22_on_hiVf "FCtl_FMI(458)" VALUE 0x001E5ACB /* @ECU_Address@FCtl_FMI@0x021B71CA@ */ ECIPP_ALIGNMENT_UBYTE 255 Compu_IDENTITY 0 255 PHYS_UNIT "FMI" /end CHARACTERISTIC
/begin CHARACTERISTIC FCfmi_PWM23_off_loVf "FCtl_FMI(459)" VALUE 0x001E5ACC /* @ECU_Address@FCtl_FMI@0x021B71CB@ */ ECIPP_ALIGNMENT_UBYTE 255 Compu_IDENTITY 0 255 PHYS_UNIT "FMI" /end CHARACTERISTIC
/begin CHARACTERISTIC FCfmi_PWM23_on_hiVf "FCtl_FMI(460)" VALUE 0x001E5ACD /* @ECU_Address@FCtl_FMI@0x021B71CC@ */ ECIPP_ALIGNMENT_UBYTE 255 Compu_IDENTITY 0 255 PHYS_UNIT "FMI" /end CHARACTERISTIC
/begin CHARACTERISTIC FCfmi_PWM3_off_loVf "FCtl_FMI(193)" VALUE 0x001E59C2 /* @ECU_Address@FCtl_FMI@0x021B70C1@ */ ECIPP_ALIGNMENT_UBYTE 255 Compu_IDENTITY 0 255 PHYS_UNIT "FMI" /end CHARACTERISTIC
/begin CHARACTERISTIC FCfmi_PWM3_on_hiVf "FCtl_FMI(194)" VALUE 0x001E59C3 /* @ECU_Address@FCtl_FMI@0x021B70C2@ */ ECIPP_ALIGNMENT_UBYTE 255 Compu_IDENTITY 0 255 PHYS_UNIT "FMI" /end CHARACTERISTIC
/begin CHARACTERISTIC FCfmi_PWM4_off_loVf "FCtl_FMI(195)" VALUE 0x001E59C4 /* @ECU_Address@FCtl_FMI@0x021B70C3@ */ ECIPP_ALIGNMENT_UBYTE 255 Compu_IDENTITY 0 255 PHYS_UNIT "FMI" /end CHARACTERISTIC
/begin CHARACTERISTIC FCfmi_PWM4_on_hiVf "FCtl_FMI(196)" VALUE 0x001E59C5 /* @ECU_Address@FCtl_FMI@0x021B70C4@ */ ECIPP_ALIGNMENT_UBYTE 255 Compu_IDENTITY 0 255 PHYS_UNIT "FMI" /end CHARACTERISTIC
/begin CHARACTERISTIC FCfmi_PWM5_off_loVf "FCtl_FMI(197)" VALUE 0x001E59C6 /* @ECU_Address@FCtl_FMI@0x021B70C5@ */ ECIPP_ALIGNMENT_UBYTE 255 Compu_IDENTITY 0 255 PHYS_UNIT "FMI" /end CHARACTERISTIC
/begin CHARACTERISTIC FCfmi_PWM5_on_hiVf "FCtl_FMI(198)" VALUE 0x001E59C7 /* @ECU_Address@FCtl_FMI@0x021B70C6@ */ ECIPP_ALIGNMENT_UBYTE 255 Compu_IDENTITY 0 255 PHYS_UNIT "FMI" /end CHARACTERISTIC
/begin CHARACTERISTIC FCfmi_PWM6_off_loVf "FCtl_FMI(276)" VALUE 0x001E5A15 /* @ECU_Address@FCtl_FMI@0x021B7114@ */ ECIPP_ALIGNMENT_UBYTE 255 Compu_IDENTITY 0 255 PHYS_UNIT "FMI" /end CHARACTERISTIC
/begin CHARACTERISTIC FCfmi_PWM6_on_hiVf "FCtl_FMI(277)" VALUE 0x001E5A16 /* @ECU_Address@FCtl_FMI@0x021B7115@ */ ECIPP_ALIGNMENT_UBYTE 255 Compu_IDENTITY 0 255 PHYS_UNIT "FMI" /end CHARACTERISTIC
/begin CHARACTERISTIC FCfmi_PWM7_off_loVf "FCtl_FMI(278)" VALUE 0x001E5A17 /* @ECU_Address@FCtl_FMI@0x021B7116@ */ ECIPP_ALIGNMENT_UBYTE 255 Compu_IDENTITY 0 255 PHYS_UNIT "FMI" /end CHARACTERISTIC
/begin CHARACTERISTIC FCfmi_PWM7_on_hiVf "FCtl_FMI(279)" VALUE 0x001E5A18 /* @ECU_Address@FCtl_FMI@0x021B7117@ */ ECIPP_ALIGNMENT_UBYTE 255 Compu_IDENTITY 0 255 PHYS_UNIT "FMI" /end CHARACTERISTIC
/begin CHARACTERISTIC FCfmi_PWM8_off_loVf "FCtl_FMI(283)" VALUE 0x001E5A1C /* @ECU_Address@FCtl_FMI@0x021B711B@ */ ECIPP_ALIGNMENT_UBYTE 255 Compu_IDENTITY 0 255 PHYS_UNIT "FMI" /end CHARACTERISTIC
/begin CHARACTERISTIC FCfmi_PWM8_on_hiVf "FCtl_FMI(284)" VALUE 0x001E5A1D /* @ECU_Address@FCtl_FMI@0x021B711C@ */ ECIPP_ALIGNMENT_UBYTE 255 Compu_IDENTITY 0 255 PHYS_UNIT "FMI" /end CHARACTERISTIC
/begin CHARACTERISTIC FCfmi_PWM9_off_loVf "FCtl_FMI(285)" VALUE 0x001E5A1E /* @ECU_Address@FCtl_FMI@0x021B711D@ */ ECIPP_ALIGNMENT_UBYTE 255 Compu_IDENTITY 0 255 PHYS_UNIT "FMI" /end CHARACTERISTIC
/begin CHARACTERISTIC FCfmi_PWM9_on_hiVf "FCtl_FMI(286)" VALUE 0x001E5A1F /* @ECU_Address@FCtl_FMI@0x021B711E@ */ ECIPP_ALIGNMENT_UBYTE 255 Compu_IDENTITY 0 255 PHYS_UNIT "FMI" /end CHARACTERISTIC
/begin CHARACTERISTIC FCfmi_PWMLO_off_loVf "FCtl_FMI(521)" VALUE 0x001E5B0A /* @ECU_Address@FCtl_FMI@0x021B7209@ */ ECIPP_ALIGNMENT_UBYTE 255 Compu_IDENTITY 0 255 PHYS_UNIT "FMI" /end CHARACTERISTIC
/begin CHARACTERISTIC FCfmi_PWMLO_on_hiVf "FCtl_FMI(522)" VALUE 0x001E5B0B /* @ECU_Address@FCtl_FMI@0x021B720A@ */ ECIPP_ALIGNMENT_UBYTE 255 Compu_IDENTITY 0 255 PHYS_UNIT "FMI" /end CHARACTERISTIC
/begin CHARACTERISTIC FCfmi_radby_poserr "FCtl_FMI(870)" VALUE 0x001E5C67 /* @ECU_Address@FCtl_FMI@0x021B7366@ */ ECIPP_ALIGNMENT_UBYTE 255 Compu_IDENTITY 0 255 PHYS_UNIT "FMI" /end CHARACTERISTIC
/begin CHARACTERISTIC FCfmi_RAM_fail "FCtl_FMI(106)" VALUE 0x001E596B /* @ECU_Address@FCtl_FMI@0x021B706A@ */ ECIPP_ALIGNMENT_UBYTE 255 Compu_IDENTITY 0 255 PHYS_UNIT "FMI" /end CHARACTERISTIC
/begin CHARACTERISTIC FCfmi_relay_coilopen "FCtl_FMI(159)" VALUE 0x001E59A0 /* @ECU_Address@FCtl_FMI@0x021B709F@ */ ECIPP_ALIGNMENT_UBYTE 255 Compu_IDENTITY 0 255 PHYS_UNIT "FMI" /end CHARACTERISTIC
/begin CHARACTERISTIC FCfmi_relay_coilshort "FCtl_FMI(160)" VALUE 0x001E59A1 /* @ECU_Address@FCtl_FMI@0x021B70A0@ */ ECIPP_ALIGNMENT_UBYTE 255 Compu_IDENTITY 0 255 PHYS_UNIT "FMI" /end CHARACTERISTIC
/begin CHARACTERISTIC FCfmi_relay_gndshort "FCtl_FMI(158)" VALUE 0x001E599F /* @ECU_Address@FCtl_FMI@0x021B709E@ */ ECIPP_ALIGNMENT_UBYTE 255 Compu_IDENTITY 0 255 PHYS_UNIT "FMI" /end CHARACTERISTIC
/begin CHARACTERISTIC FCfmi_relayoff_hiV "FCtl_FMI(431)" VALUE 0x001E5AB0 /* @ECU_Address@FCtl_FMI@0x021B71AF@ */ ECIPP_ALIGNMENT_UBYTE 255 Compu_IDENTITY 0 255 PHYS_UNIT "FMI" /end CHARACTERISTIC
/begin CHARACTERISTIC FCfmi_relayon_loV "FCtl_FMI(432)" VALUE 0x001E5AB1 /* @ECU_Address@FCtl_FMI@0x021B71B0@ */ ECIPP_ALIGNMENT_UBYTE 255 Compu_IDENTITY 0 255 PHYS_UNIT "FMI" /end CHARACTERISTIC
/begin CHARACTERISTIC FCfmi_rpm_hi_expected "FCtl_FMI(351)" VALUE 0x001E5A60 /* @ECU_Address@FCtl_FMI@0x021B715F@ */ ECIPP_ALIGNMENT_UBYTE 255 Compu_IDENTITY 0 255 PHYS_UNIT "FMI" /end CHARACTERISTIC
/begin CHARACTERISTIC FCfmi_rpmd_gov_lo "FCtl_FMI(520)" VALUE 0x001E5B09 /* @ECU_Address@FCtl_FMI@0x021B7208@ */ ECIPP_ALIGNMENT_UBYTE 255 Compu_IDENTITY 0 255 PHYS_UNIT "FMI" /end CHARACTERISTIC
/begin CHARACTERISTIC FCfmi_RS_discon "FCtl_FMI(691)" VALUE 0x001E5BB4 /* @ECU_Address@FCtl_FMI@0x021B72B3@ */ ECIPP_ALIGNMENT_UBYTE 255 Compu_IDENTITY 0 255 PHYS_UNIT "FMI" /end CHARACTERISTIC
/begin CHARACTERISTIC FCfmi_RS_hiV "FCtl_FMI(599)" VALUE 0x001E5B58 /* @ECU_Address@FCtl_FMI@0x021B7257@ */ ECIPP_ALIGNMENT_UBYTE 255 Compu_IDENTITY 0 255 PHYS_UNIT "FMI" /end CHARACTERISTIC
/begin CHARACTERISTIC FCfmi_RS_loss "FCtl_FMI(220)" VALUE 0x001E59DD /* @ECU_Address@FCtl_FMI@0x021B70DC@ */ ECIPP_ALIGNMENT_UBYTE 255 Compu_IDENTITY 0 255 PHYS_UNIT "FMI" /end CHARACTERISTIC
/begin CHARACTERISTIC FCfmi_RS_loV "FCtl_FMI(598)" VALUE 0x001E5B57 /* @ECU_Address@FCtl_FMI@0x021B7256@ */ ECIPP_ALIGNMENT_UBYTE 255 Compu_IDENTITY 0 255 PHYS_UNIT "FMI" /end CHARACTERISTIC
/begin CHARACTERISTIC FCfmi_RS485_bad_fmt "FCtl_FMI(124)" VALUE 0x001E597D /* @ECU_Address@FCtl_FMI@0x021B707C@ */ ECIPP_ALIGNMENT_UBYTE 255 Compu_IDENTITY 0 255 PHYS_UNIT "FMI" /end CHARACTERISTIC
/begin CHARACTERISTIC FCfmi_RS485_Rx_inact "FCtl_FMI(122)" VALUE 0x001E597B /* @ECU_Address@FCtl_FMI@0x021B707A@ */ ECIPP_ALIGNMENT_UBYTE 255 Compu_IDENTITY 0 255 PHYS_UNIT "FMI" /end CHARACTERISTIC
/begin CHARACTERISTIC FCfmi_RS485_Rx_noise "FCtl_FMI(123)" VALUE 0x001E597C /* @ECU_Address@FCtl_FMI@0x021B707B@ */ ECIPP_ALIGNMENT_UBYTE 255 Compu_IDENTITY 0 255 PHYS_UNIT "FMI" /end CHARACTERISTIC
/begin CHARACTERISTIC FCfmi_RS485_SD_rq "FCtl_FMI(125)" VALUE 0x001E597E /* @ECU_Address@FCtl_FMI@0x021B707D@ */ ECIPP_ALIGNMENT_UBYTE 255 Compu_IDENTITY 0 255 PHYS_UNIT "FMI" /end CHARACTERISTIC
/begin CHARACTERISTIC FCfmi_RTI1 "FCtl_FMI(100)" VALUE 0x001E5965 /* @ECU_Address@FCtl_FMI@0x021B7064@ */ ECIPP_ALIGNMENT_UBYTE 255 Compu_IDENTITY 0 255 PHYS_UNIT "FMI" /end CHARACTERISTIC
/begin CHARACTERISTIC FCfmi_RTI2 "FCtl_FMI(101)" VALUE 0x001E5966 /* @ECU_Address@FCtl_FMI@0x021B7065@ */ ECIPP_ALIGNMENT_UBYTE 255 Compu_IDENTITY 0 255 PHYS_UNIT "FMI" /end CHARACTERISTIC
/begin CHARACTERISTIC FCfmi_RTI3 "FCtl_FMI(102)" VALUE 0x001E5967 /* @ECU_Address@FCtl_FMI@0x021B7066@ */ ECIPP_ALIGNMENT_UBYTE 255 Compu_IDENTITY 0 255 PHYS_UNIT "FMI" /end CHARACTERISTIC
/begin CHARACTERISTIC FCfmi_Sec1_31KV_open "FCtl_FMI(949)" VALUE 0x001E5CB6 /* @ECU_Address@FCtl_FMI@0x021B73B5@ */ ECIPP_ALIGNMENT_UBYTE 255 Compu_IDENTITY 0 255 PHYS_UNIT "FMI" /end CHARACTERISTIC
/begin CHARACTERISTIC FCfmi_Sec1_low "FCtl_FMI(937)" VALUE 0x001E5CAA /* @ECU_Address@FCtl_FMI@0x021B73A9@ */ ECIPP_ALIGNMENT_UBYTE 255 Compu_IDENTITY 0 255 PHYS_UNIT "FMI" /end CHARACTERISTIC
/begin CHARACTERISTIC FCfmi_Sec1_open "FCtl_FMI(925)" VALUE 0x001E5C9E /* @ECU_Address@FCtl_FMI@0x021B739D@ */ ECIPP_ALIGNMENT_UBYTE 255 Compu_IDENTITY 0 255 PHYS_UNIT "FMI" /end CHARACTERISTIC
/begin CHARACTERISTIC FCfmi_SHIFT_FB_OOR "FCtl_FMI(294)" VALUE 0x001E5A27 /* @ECU_Address@FCtl_FMI@0x021B7126@ */ ECIPP_ALIGNMENT_UBYTE 255 Compu_IDENTITY 0 255 PHYS_UNIT "FMI" /end CHARACTERISTIC
/begin CHARACTERISTIC FCfmi_SHIFT_intcirc_fail "FCtl_FMI(296)" VALUE 0x001E5A29 /* @ECU_Address@FCtl_FMI@0x021B7128@ */ ECIPP_ALIGNMENT_UBYTE 255 Compu_IDENTITY 0 255 PHYS_UNIT "FMI" /end CHARACTERISTIC
/begin CHARACTERISTIC FCfmi_SHIFT_shift_fail "FCtl_FMI(295)" VALUE 0x001E5A28 /* @ECU_Address@FCtl_FMI@0x021B7127@ */ ECIPP_ALIGNMENT_UBYTE 255 Compu_IDENTITY 0 255 PHYS_UNIT "FMI" /end CHARACTERISTIC
/begin CHARACTERISTIC FCfmi_SL_fuel "FCtl_FMI(109)" VALUE 0x001E596E /* @ECU_Address@FCtl_FMI@0x021B706D@ */ ECIPP_ALIGNMENT_UBYTE 255 Compu_IDENTITY 0 255 PHYS_UNIT "FMI" /end CHARACTERISTIC
/begin CHARACTERISTIC FCfmi_SL_gov "FCtl_FMI(108)" VALUE 0x001E596D /* @ECU_Address@FCtl_FMI@0x021B706C@ */ ECIPP_ALIGNMENT_UBYTE 255 Compu_IDENTITY 0 255 PHYS_UNIT "FMI" /end CHARACTERISTIC
/begin CHARACTERISTIC FCfmi_SL_spk "FCtl_FMI(110)" VALUE 0x001E596F /* @ECU_Address@FCtl_FMI@0x021B706E@ */ ECIPP_ALIGNMENT_UBYTE 255 Compu_IDENTITY 0 255 PHYS_UNIT "FMI" /end CHARACTERISTIC
/begin CHARACTERISTIC FCfmi_slv_MAP_hi_OOA "FCtl_FMI(837)" VALUE 0x001E5C46 /* @ECU_Address@FCtl_FMI@0x021B7345@ */ ECIPP_ALIGNMENT_UBYTE 255 Compu_IDENTITY 0 255 PHYS_UNIT "FMI" /end CHARACTERISTIC
/begin CHARACTERISTIC FCfmi_slv_MAP_lo_OOA "FCtl_FMI(838)" VALUE 0x001E5C47 /* @ECU_Address@FCtl_FMI@0x021B7346@ */ ECIPP_ALIGNMENT_UBYTE 255 Compu_IDENTITY 0 255 PHYS_UNIT "FMI" /end CHARACTERISTIC
/begin CHARACTERISTIC FCfmi_SPK_int_fail "FCtl_FMI(303)" VALUE 0x001E5A30 /* @ECU_Address@FCtl_FMI@0x021B712F@ */ ECIPP_ALIGNMENT_UBYTE 255 Compu_IDENTITY 0 255 PHYS_UNIT "FMI" /end CHARACTERISTIC
/begin CHARACTERISTIC FCfmi_SPK1_IGBT_T "FCtl_FMI(509)" VALUE 0x001E5AFE /* @ECU_Address@FCtl_FMI@0x021B71FD@ */ ECIPP_ALIGNMENT_UBYTE 255 Compu_IDENTITY 0 255 PHYS_UNIT "FMI" /end CHARACTERISTIC
/begin CHARACTERISTIC FCfmi_SPKD_coil_fail "FCtl_FMI(304)" VALUE 0x001E5A31 /* @ECU_Address@FCtl_FMI@0x021B7130@ */ ECIPP_ALIGNMENT_UBYTE 255 Compu_IDENTITY 0 255 PHYS_UNIT "FMI" /end CHARACTERISTIC
/begin CHARACTERISTIC FCfmi_SPKD_dw_hi "FCtl_FMI(76)" VALUE 0x001E594D /* @ECU_Address@FCtl_FMI@0x021B704C@ */ ECIPP_ALIGNMENT_UBYTE 255 Compu_IDENTITY 0 255 PHYS_UNIT "FMI" /end CHARACTERISTIC
/begin CHARACTERISTIC FCfmi_SPKD_dw_lo "FCtl_FMI(66)" VALUE 0x001E5943 /* @ECU_Address@FCtl_FMI@0x021B7042@ */ ECIPP_ALIGNMENT_UBYTE 255 Compu_IDENTITY 0 255 PHYS_UNIT "FMI" /end CHARACTERISTIC
/begin CHARACTERISTIC FCfmi_SRVC_expired "FCtl_FMI(426)" VALUE 0x001E5AAB /* @ECU_Address@FCtl_FMI@0x021B71AA@ */ ECIPP_ALIGNMENT_UBYTE 255 Compu_IDENTITY 0 255 PHYS_UNIT "FMI" /end CHARACTERISTIC
/begin CHARACTERISTIC FCfmi_SRVC_expired2 "FCtl_FMI(836)" VALUE 0x001E5C45 /* @ECU_Address@FCtl_FMI@0x021B7344@ */ ECIPP_ALIGNMENT_UBYTE 255 Compu_IDENTITY 0 255 PHYS_UNIT "FMI" /end CHARACTERISTIC
/begin CHARACTERISTIC FCfmi_start_coilopen "FCtl_FMI(162)" VALUE 0x001E59A3 /* @ECU_Address@FCtl_FMI@0x021B70A2@ */ ECIPP_ALIGNMENT_UBYTE 255 Compu_IDENTITY 0 255 PHYS_UNIT "FMI" /end CHARACTERISTIC
/begin CHARACTERISTIC FCftb_PWM17_off_loVf "FCtl_FTB_0x04(447)" VALUE 0x001E5ED6 /* @ECU_Address@FCtl_FTB_0x04@0x024C51BF@ */ ECIPP_ALIGNMENT_UBYTE 255 Compu_IDENTITY 0 255 PHYS_UNIT "FTB" /end CHARACTERISTIC
/begin CHARACTERISTIC FCftb_PWM17_on_hiVf "FCtl_FTB_0x04(448)" VALUE 0x001E5ED7 /* @ECU_Address@FCtl_FTB_0x04@0x024C51C0@ */ ECIPP_ALIGNMENT_UBYTE 255 Compu_IDENTITY 0 255 PHYS_UNIT "FTB" /end CHARACTERISTIC
/begin CHARACTERISTIC FCftb_PWM18_off_loVf "FCtl_FTB_0x04(449)" VALUE 0x001E5ED8 /* @ECU_Address@FCtl_FTB_0x04@0x024C51C1@ */ ECIPP_ALIGNMENT_UBYTE 255 Compu_IDENTITY 0 255 PHYS_UNIT "FTB" /end CHARACTERISTIC
/begin CHARACTERISTIC FCftb_PWM18_on_hiVf "FCtl_FTB_0x04(450)" VALUE 0x001E5ED9 /* @ECU_Address@FCtl_FTB_0x04@0x024C51C2@ */ ECIPP_ALIGNMENT_UBYTE 255 Compu_IDENTITY 0 255 PHYS_UNIT "FTB" /end CHARACTERISTIC
/begin CHARACTERISTIC FCftb_PWM19_off_loVf "FCtl_FTB_0x04(451)" VALUE 0x001E5EDA /* @ECU_Address@FCtl_FTB_0x04@0x024C51C3@ */ ECIPP_ALIGNMENT_UBYTE 255 Compu_IDENTITY 0 255 PHYS_UNIT "FTB" /end CHARACTERISTIC
/begin CHARACTERISTIC FCftb_PWM19_on_hiVf "FCtl_FTB_0x04(452)" VALUE 0x001E5EDB /* @ECU_Address@FCtl_FTB_0x04@0x024C51C4@ */ ECIPP_ALIGNMENT_UBYTE 255 Compu_IDENTITY 0 255 PHYS_UNIT "FTB" /end CHARACTERISTIC
/begin CHARACTERISTIC FCftb_PWM2_off_loVf "FCtl_FTB_0x04(191)" VALUE 0x001E5DD6 /* @ECU_Address@FCtl_FTB_0x04@0x024C50BF@ */ ECIPP_ALIGNMENT_UBYTE 255 Compu_IDENTITY 0 255 PHYS_UNIT "FTB" /end CHARACTERISTIC
/begin CHARACTERISTIC FCftb_PWM2_on_hiVf "FCtl_FTB_0x04(192)" VALUE 0x001E5DD7 /* @ECU_Address@FCtl_FTB_0x04@0x024C50C0@ */ ECIPP_ALIGNMENT_UBYTE 255 Compu_IDENTITY 0 255 PHYS_UNIT "FTB" /end CHARACTERISTIC
/begin CHARACTERISTIC FCftb_PWM20_off_loVf "FCtl_FTB_0x04(453)" VALUE 0x001E5EDC /* @ECU_Address@FCtl_FTB_0x04@0x024C51C5@ */ ECIPP_ALIGNMENT_UBYTE 255 Compu_IDENTITY 0 255 PHYS_UNIT "FTB" /end CHARACTERISTIC
/begin CHARACTERISTIC FCftb_PWM20_on_hiVf "FCtl_FTB_0x04(454)" VALUE 0x001E5EDD /* @ECU_Address@FCtl_FTB_0x04@0x024C51C6@ */ ECIPP_ALIGNMENT_UBYTE 255 Compu_IDENTITY 0 255 PHYS_UNIT "FTB" /end CHARACTERISTIC
/begin CHARACTERISTIC FCftb_PWM21_off_loVf "FCtl_FTB_0x04(455)" VALUE 0x001E5EDE /* @ECU_Address@FCtl_FTB_0x04@0x024C51C7@ */ ECIPP_ALIGNMENT_UBYTE 255 Compu_IDENTITY 0 255 PHYS_UNIT "FTB" /end CHARACTERISTIC
/begin CHARACTERISTIC FCftb_PWM21_on_hiVf "FCtl_FTB_0x04(456)" VALUE 0x001E5EDF /* @ECU_Address@FCtl_FTB_0x04@0x024C51C8@ */ ECIPP_ALIGNMENT_UBYTE 255 Compu_IDENTITY 0 255 PHYS_UNIT "FTB" /end CHARACTERISTIC
/begin CHARACTERISTIC FCftb_PWM22_off_loVf "FCtl_FTB_0x04(457)" VALUE 0x001E5EE0 /* @ECU_Address@FCtl_FTB_0x04@0x024C51C9@ */ ECIPP_ALIGNMENT_UBYTE 255 Compu_IDENTITY 0 255 PHYS_UNIT "FTB" /end CHARACTERISTIC
/begin CHARACTERISTIC FCftb_PWM22_on_hiVf "FCtl_FTB_0x04(458)" VALUE 0x001E5EE1 /* @ECU_Address@FCtl_FTB_0x04@0x024C51CA@ */ ECIPP_ALIGNMENT_UBYTE 255 Compu_IDENTITY 0 255 PHYS_UNIT "FTB" /end CHARACTERISTIC
/begin CHARACTERISTIC FCftb_PWM23_off_loVf "FCtl_FTB_0x04(459)" VALUE 0x001E5EE2 /* @ECU_Address@FCtl_FTB_0x04@0x024C51CB@ */ ECIPP_ALIGNMENT_UBYTE 255 Compu_IDENTITY 0 255 PHYS_UNIT "FTB" /end CHARACTERISTIC
/begin CHARACTERISTIC FCftb_PWM23_on_hiVf "FCtl_FTB_0x04(460)" VALUE 0x001E5EE3 /* @ECU_Address@FCtl_FTB_0x04@0x024C51CC@ */ ECIPP_ALIGNMENT_UBYTE 255 Compu_IDENTITY 0 255 PHYS_UNIT "FTB" /end CHARACTERISTIC
/begin CHARACTERISTIC FCftb_PWM3_off_loVf "FCtl_FTB_0x04(193)" VALUE 0x001E5DD8 /* @ECU_Address@FCtl_FTB_0x04@0x024C50C1@ */ ECIPP_ALIGNMENT_UBYTE 255 Compu_IDENTITY 0 255 PHYS_UNIT "FTB" /end CHARACTERISTIC
/begin CHARACTERISTIC FCftb_PWM3_on_hiVf "FCtl_FTB_0x04(194)" VALUE 0x001E5DD9 /* @ECU_Address@FCtl_FTB_0x04@0x024C50C2@ */ ECIPP_ALIGNMENT_UBYTE 255 Compu_IDENTITY 0 255 PHYS_UNIT "FTB" /end CHARACTERISTIC
/begin CHARACTERISTIC FCftb_PWM4_off_loVf "FCtl_FTB_0x04(195)" VALUE 0x001E5DDA /* @ECU_Address@FCtl_FTB_0x04@0x024C50C3@ */ ECIPP_ALIGNMENT_UBYTE 255 Compu_IDENTITY 0 255 PHYS_UNIT "FTB" /end CHARACTERISTIC
/begin CHARACTERISTIC FCftb_PWM4_on_hiVf "FCtl_FTB_0x04(196)" VALUE 0x001E5DDB /* @ECU_Address@FCtl_FTB_0x04@0x024C50C4@ */ ECIPP_ALIGNMENT_UBYTE 255 Compu_IDENTITY 0 255 PHYS_UNIT "FTB" /end CHARACTERISTIC
/begin CHARACTERISTIC FCftb_PWM5_off_loVf "FCtl_FTB_0x04(197)" VALUE 0x001E5DDC /* @ECU_Address@FCtl_FTB_0x04@0x024C50C5@ */ ECIPP_ALIGNMENT_UBYTE 255 Compu_IDENTITY 0 255 PHYS_UNIT "FTB" /end CHARACTERISTIC
/begin CHARACTERISTIC FCftb_PWM5_on_hiVf "FCtl_FTB_0x04(198)" VALUE 0x001E5DDD /* @ECU_Address@FCtl_FTB_0x04@0x024C50C6@ */ ECIPP_ALIGNMENT_UBYTE 255 Compu_IDENTITY 0 255 PHYS_UNIT "FTB" /end CHARACTERISTIC
/begin CHARACTERISTIC FCftb_PWM6_off_loVf "FCtl_FTB_0x04(276)" VALUE 0x001E5E2B /* @ECU_Address@FCtl_FTB_0x04@0x024C5114@ */ ECIPP_ALIGNMENT_UBYTE 255 Compu_IDENTITY 0 255 PHYS_UNIT "FTB" /end CHARACTERISTIC
/begin CHARACTERISTIC FCftb_PWM6_on_hiVf "FCtl_FTB_0x04(277)" VALUE 0x001E5E2C /* @ECU_Address@FCtl_FTB_0x04@0x024C5115@ */ ECIPP_ALIGNMENT_UBYTE 255 Compu_IDENTITY 0 255 PHYS_UNIT "FTB" /end CHARACTERISTIC
/begin CHARACTERISTIC FCftb_PWM7_off_loVf "FCtl_FTB_0x04(278)" VALUE 0x001E5E2D /* @ECU_Address@FCtl_FTB_0x04@0x024C5116@ */ ECIPP_ALIGNMENT_UBYTE 255 Compu_IDENTITY 0 255 PHYS_UNIT "FTB" /end CHARACTERISTIC
/begin CHARACTERISTIC FCftb_PWM7_on_hiVf "FCtl_FTB_0x04(279)" VALUE 0x001E5E2E /* @ECU_Address@FCtl_FTB_0x04@0x024C5117@ */ ECIPP_ALIGNMENT_UBYTE 255 Compu_IDENTITY 0 255 PHYS_UNIT "FTB" /end CHARACTERISTIC
/begin CHARACTERISTIC FCftb_PWM8_off_loVf "FCtl_FTB_0x04(283)" VALUE 0x001E5E32 /* @ECU_Address@FCtl_FTB_0x04@0x024C511B@ */ ECIPP_ALIGNMENT_UBYTE 255 Compu_IDENTITY 0 255 PHYS_UNIT "FTB" /end CHARACTERISTIC
/begin CHARACTERISTIC FCftb_PWM8_on_hiVf "FCtl_FTB_0x04(284)" VALUE 0x001E5E33 /* @ECU_Address@FCtl_FTB_0x04@0x024C511C@ */ ECIPP_ALIGNMENT_UBYTE 255 Compu_IDENTITY 0 255 PHYS_UNIT "FTB" /end CHARACTERISTIC
/begin CHARACTERISTIC FCftb_PWM9_off_loVf "FCtl_FTB_0x04(285)" VALUE 0x001E5E34 /* @ECU_Address@FCtl_FTB_0x04@0x024C511D@ */ ECIPP_ALIGNMENT_UBYTE 255 Compu_IDENTITY 0 255 PHYS_UNIT "FTB" /end CHARACTERISTIC
/begin CHARACTERISTIC FCftb_PWM9_on_hiVf "FCtl_FTB_0x04(286)" VALUE 0x001E5E35 /* @ECU_Address@FCtl_FTB_0x04@0x024C511E@ */ ECIPP_ALIGNMENT_UBYTE 255 Compu_IDENTITY 0 255 PHYS_UNIT "FTB" /end CHARACTERISTIC
/begin CHARACTERISTIC FCftb_PWMLO_off_loVf "FCtl_FTB_0x04(521)" VALUE 0x001E5F20 /* @ECU_Address@FCtl_FTB_0x04@0x024C5209@ */ ECIPP_ALIGNMENT_UBYTE 255 Compu_IDENTITY 0 255 PHYS_UNIT "FTB" /end CHARACTERISTIC
/begin CHARACTERISTIC FCftb_PWMLO_on_hiVf "FCtl_FTB_0x04(522)" VALUE 0x001E5F21 /* @ECU_Address@FCtl_FTB_0x04@0x024C520A@ */ ECIPP_ALIGNMENT_UBYTE 255 Compu_IDENTITY 0 255 PHYS_UNIT "FTB" /end CHARACTERISTIC
/begin CHARACTERISTIC FCftb_radby_poserr "FCtl_FTB_0x04(870)" VALUE 0x001E607D /* @ECU_Address@FCtl_FTB_0x04@0x024C5366@ */ ECIPP_ALIGNMENT_UBYTE 255 Compu_IDENTITY 0 255 PHYS_UNIT "FTB" /end CHARACTERISTIC
/begin CHARACTERISTIC FCftb_RAM_fail "FCtl_FTB_0x04(106)" VALUE 0x001E5D81 /* @ECU_Address@FCtl_FTB_0x04@0x024C506A@ */ ECIPP_ALIGNMENT_UBYTE 255 Compu_IDENTITY 0 255 PHYS_UNIT "FTB" /end CHARACTERISTIC
/begin CHARACTERISTIC FCftb_relay_coilopen "FCtl_FTB_0x04(159)" VALUE 0x001E5DB6 /* @ECU_Address@FCtl_FTB_0x04@0x024C509F@ */ ECIPP_ALIGNMENT_UBYTE 255 Compu_IDENTITY 0 255 PHYS_UNIT "FTB" /end CHARACTERISTIC
/begin CHARACTERISTIC FCftb_relay_coilshort "FCtl_FTB_0x04(160)" VALUE 0x001E5DB7 /* @ECU_Address@FCtl_FTB_0x04@0x024C50A0@ */ ECIPP_ALIGNMENT_UBYTE 255 Compu_IDENTITY 0 255 PHYS_UNIT "FTB" /end CHARACTERISTIC
/begin CHARACTERISTIC FCftb_relay_gndshort "FCtl_FTB_0x04(158)" VALUE 0x001E5DB5 /* @ECU_Address@FCtl_FTB_0x04@0x024C509E@ */ ECIPP_ALIGNMENT_UBYTE 255 Compu_IDENTITY 0 255 PHYS_UNIT "FTB" /end CHARACTERISTIC
/begin CHARACTERISTIC FCftb_relayoff_hiV "FCtl_FTB_0x04(431)" VALUE 0x001E5EC6 /* @ECU_Address@FCtl_FTB_0x04@0x024C51AF@ */ ECIPP_ALIGNMENT_UBYTE 255 Compu_IDENTITY 0 255 PHYS_UNIT "FTB" /end CHARACTERISTIC
/begin CHARACTERISTIC FCftb_relayon_loV "FCtl_FTB_0x04(432)" VALUE 0x001E5EC7 /* @ECU_Address@FCtl_FTB_0x04@0x024C51B0@ */ ECIPP_ALIGNMENT_UBYTE 255 Compu_IDENTITY 0 255 PHYS_UNIT "FTB" /end CHARACTERISTIC
/begin CHARACTERISTIC FCftb_rpm_hi_expected "FCtl_FTB_0x04(351)" VALUE 0x001E5E76 /* @ECU_Address@FCtl_FTB_0x04@0x024C515F@ */ ECIPP_ALIGNMENT_UBYTE 255 Compu_IDENTITY 0 255 PHYS_UNIT "FTB" /end CHARACTERISTIC
/begin CHARACTERISTIC FCftb_rpmd_gov_lo "FCtl_FTB_0x04(520)" VALUE 0x001E5F1F /* @ECU_Address@FCtl_FTB_0x04@0x024C5208@ */ ECIPP_ALIGNMENT_UBYTE 255 Compu_IDENTITY 0 255 PHYS_UNIT "FTB" /end CHARACTERISTIC
/begin CHARACTERISTIC FCftb_RS_discon "FCtl_FTB_0x04(691)" VALUE 0x001E5FCA /* @ECU_Address@FCtl_FTB_0x04@0x024C52B3@ */ ECIPP_ALIGNMENT_UBYTE 255 Compu_IDENTITY 0 255 PHYS_UNIT "FTB" /end CHARACTERISTIC
/begin CHARACTERISTIC FCftb_RS_hiV "FCtl_FTB_0x04(599)" VALUE 0x001E5F6E /* @ECU_Address@FCtl_FTB_0x04@0x024C5257@ */ ECIPP_ALIGNMENT_UBYTE 255 Compu_IDENTITY 0 255 PHYS_UNIT "FTB" /end CHARACTERISTIC
/begin CHARACTERISTIC FCftb_RS_loss "FCtl_FTB_0x04(220)" VALUE 0x001E5DF3 /* @ECU_Address@FCtl_FTB_0x04@0x024C50DC@ */ ECIPP_ALIGNMENT_UBYTE 255 Compu_IDENTITY 0 255 PHYS_UNIT "FTB" /end CHARACTERISTIC
/begin CHARACTERISTIC FCftb_RS_loV "FCtl_FTB_0x04(598)" VALUE 0x001E5F6D /* @ECU_Address@FCtl_FTB_0x04@0x024C5256@ */ ECIPP_ALIGNMENT_UBYTE 255 Compu_IDENTITY 0 255 PHYS_UNIT "FTB" /end CHARACTERISTIC
/begin CHARACTERISTIC FCftb_RS485_bad_fmt "FCtl_FTB_0x04(124)" VALUE 0x001E5D93 /* @ECU_Address@FCtl_FTB_0x04@0x024C507C@ */ ECIPP_ALIGNMENT_UBYTE 255 Compu_IDENTITY 0 255 PHYS_UNIT "FTB" /end CHARACTERISTIC
/begin CHARACTERISTIC FCftb_RS485_Rx_inact "FCtl_FTB_0x04(122)" VALUE 0x001E5D91 /* @ECU_Address@FCtl_FTB_0x04@0x024C507A@ */ ECIPP_ALIGNMENT_UBYTE 255 Compu_IDENTITY 0 255 PHYS_UNIT "FTB" /end CHARACTERISTIC
/begin CHARACTERISTIC FCftb_RS485_Rx_noise "FCtl_FTB_0x04(123)" VALUE 0x001E5D92 /* @ECU_Address@FCtl_FTB_0x04@0x024C507B@ */ ECIPP_ALIGNMENT_UBYTE 255 Compu_IDENTITY 0 255 PHYS_UNIT "FTB" /end CHARACTERISTIC
/begin CHARACTERISTIC FCftb_RS485_SD_rq "FCtl_FTB_0x04(125)" VALUE 0x001E5D94 /* @ECU_Address@FCtl_FTB_0x04@0x024C507D@ */ ECIPP_ALIGNMENT_UBYTE 255 Compu_IDENTITY 0 255 PHYS_UNIT "FTB" /end CHARACTERISTIC
/begin CHARACTERISTIC FCftb_RTI1 "FCtl_FTB_0x04(100)" VALUE 0x001E5D7B /* @ECU_Address@FCtl_FTB_0x04@0x024C5064@ */ ECIPP_ALIGNMENT_UBYTE 255 Compu_IDENTITY 0 255 PHYS_UNIT "FTB" /end CHARACTERISTIC
/begin CHARACTERISTIC FCftb_RTI2 "FCtl_FTB_0x04(101)" VALUE 0x001E5D7C /* @ECU_Address@FCtl_FTB_0x04@0x024C5065@ */ ECIPP_ALIGNMENT_UBYTE 255 Compu_IDENTITY 0 255 PHYS_UNIT "FTB" /end CHARACTERISTIC
/begin CHARACTERISTIC FCftb_RTI3 "FCtl_FTB_0x04(102)" VALUE 0x001E5D7D /* @ECU_Address@FCtl_FTB_0x04@0x024C5066@ */ ECIPP_ALIGNMENT_UBYTE 255 Compu_IDENTITY 0 255 PHYS_UNIT "FTB" /end CHARACTERISTIC
/begin CHARACTERISTIC FCftb_Sec1_31KV_open "FCtl_FTB_0x04(949)" VALUE 0x001E60CC /* @ECU_Address@FCtl_FTB_0x04@0x024C53B5@ */ ECIPP_ALIGNMENT_UBYTE 255 Compu_IDENTITY 0 255 PHYS_UNIT "FTB" /end CHARACTERISTIC
/begin CHARACTERISTIC FCftb_Sec1_low "FCtl_FTB_0x04(937)" VALUE 0x001E60C0 /* @ECU_Address@FCtl_FTB_0x04@0x024C53A9@ */ ECIPP_ALIGNMENT_UBYTE 255 Compu_IDENTITY 0 255 PHYS_UNIT "FTB" /end CHARACTERISTIC
/begin CHARACTERISTIC FCftb_Sec1_open "FCtl_FTB_0x04(925)" VALUE 0x001E60B4 /* @ECU_Address@FCtl_FTB_0x04@0x024C539D@ */ ECIPP_ALIGNMENT_UBYTE 255 Compu_IDENTITY 0 255 PHYS_UNIT "FTB" /end CHARACTERISTIC
/begin CHARACTERISTIC FCftb_SHIFT_FB_OOR "FCtl_FTB_0x04(294)" VALUE 0x001E5E3D /* @ECU_Address@FCtl_FTB_0x04@0x024C5126@ */ ECIPP_ALIGNMENT_UBYTE 255 Compu_IDENTITY 0 255 PHYS_UNIT "FTB" /end CHARACTERISTIC
/begin CHARACTERISTIC FCftb_SHIFT_intcirc_fail "FCtl_FTB_0x04(296)" VALUE 0x001E5E3F /* @ECU_Address@FCtl_FTB_0x04@0x024C5128@ */ ECIPP_ALIGNMENT_UBYTE 255 Compu_IDENTITY 0 255 PHYS_UNIT "FTB" /end CHARACTERISTIC
/begin CHARACTERISTIC FCftb_SHIFT_shift_fail "FCtl_FTB_0x04(295)" VALUE 0x001E5E3E /* @ECU_Address@FCtl_FTB_0x04@0x024C5127@ */ ECIPP_ALIGNMENT_UBYTE 255 Compu_IDENTITY 0 255 PHYS_UNIT "FTB" /end CHARACTERISTIC
/begin CHARACTERISTIC FCftb_SL_fuel "FCtl_FTB_0x04(109)" VALUE 0x001E5D84 /* @ECU_Address@FCtl_FTB_0x04@0x024C506D@ */ ECIPP_ALIGNMENT_UBYTE 255 Compu_IDENTITY 0 255 PHYS_UNIT "FTB" /end CHARACTERISTIC
/begin CHARACTERISTIC FCftb_SL_gov "FCtl_FTB_0x04(108)" VALUE 0x001E5D83 /* @ECU_Address@FCtl_FTB_0x04@0x024C506C@ */ ECIPP_ALIGNMENT_UBYTE 255 Compu_IDENTITY 0 255 PHYS_UNIT "FTB" /end CHARACTERISTIC
/begin CHARACTERISTIC FCftb_SL_spk "FCtl_FTB_0x04(110)" VALUE 0x001E5D85 /* @ECU_Address@FCtl_FTB_0x04@0x024C506E@ */ ECIPP_ALIGNMENT_UBYTE 255 Compu_IDENTITY 0 255 PHYS_UNIT "FTB" /end CHARACTERISTIC
/begin CHARACTERISTIC FCftb_slv_MAP_hi_OOA "FCtl_FTB_0x04(837)" VALUE 0x001E605C /* @ECU_Address@FCtl_FTB_0x04@0x024C5345@ */ ECIPP_ALIGNMENT_UBYTE 255 Compu_IDENTITY 0 255 PHYS_UNIT "FTB" /end CHARACTERISTIC
/begin CHARACTERISTIC FCftb_slv_MAP_lo_OOA "FCtl_FTB_0x04(838)" VALUE 0x001E605D /* @ECU_Address@FCtl_FTB_0x04@0x024C5346@ */ ECIPP_ALIGNMENT_UBYTE 255 Compu_IDENTITY 0 255 PHYS_UNIT "FTB" /end CHARACTERISTIC
/begin CHARACTERISTIC FCftb_SPK_int_fail "FCtl_FTB_0x04(303)" VALUE 0x001E5E46 /* @ECU_Address@FCtl_FTB_0x04@0x024C512F@ */ ECIPP_ALIGNMENT_UBYTE 255 Compu_IDENTITY 0 255 PHYS_UNIT "FTB" /end CHARACTERISTIC
/begin CHARACTERISTIC FCftb_SPK1_IGBT_T "FCtl_FTB_0x04(509)" VALUE 0x001E5F14 /* @ECU_Address@FCtl_FTB_0x04@0x024C51FD@ */ ECIPP_ALIGNMENT_UBYTE 255 Compu_IDENTITY 0 255 PHYS_UNIT "FTB" /end CHARACTERISTIC
/begin CHARACTERISTIC FCftb_SPKD_coil_fail "FCtl_FTB_0x04(304)" VALUE 0x001E5E47 /* @ECU_Address@FCtl_FTB_0x04@0x024C5130@ */ ECIPP_ALIGNMENT_UBYTE 255 Compu_IDENTITY 0 255 PHYS_UNIT "FTB" /end CHARACTERISTIC
/begin CHARACTERISTIC FCftb_SPKD_dw_hi "FCtl_FTB_0x04(76)" VALUE 0x001E5D63 /* @ECU_Address@FCtl_FTB_0x04@0x024C504C@ */ ECIPP_ALIGNMENT_UBYTE 255 Compu_IDENTITY 0 255 PHYS_UNIT "FTB" /end CHARACTERISTIC
/begin CHARACTERISTIC FCftb_SPKD_dw_lo "FCtl_FTB_0x04(66)" VALUE 0x001E5D59 /* @ECU_Address@FCtl_FTB_0x04@0x024C5042@ */ ECIPP_ALIGNMENT_UBYTE 255 Compu_IDENTITY 0 255 PHYS_UNIT "FTB" /end CHARACTERISTIC
/begin CHARACTERISTIC FCftb_SRVC_expired "FCtl_FTB_0x04(426)" VALUE 0x001E5EC1 /* @ECU_Address@FCtl_FTB_0x04@0x024C51AA@ */ ECIPP_ALIGNMENT_UBYTE 255 Compu_IDENTITY 0 255 PHYS_UNIT "FTB" /end CHARACTERISTIC
/begin CHARACTERISTIC FCftb_SRVC_expired2 "FCtl_FTB_0x04(836)" VALUE 0x001E605B /* @ECU_Address@FCtl_FTB_0x04@0x024C5344@ */ ECIPP_ALIGNMENT_UBYTE 255 Compu_IDENTITY 0 255 PHYS_UNIT "FTB" /end CHARACTERISTIC
/begin CHARACTERISTIC FCftb_start_coilopen "FCtl_FTB_0x04(162)" VALUE 0x001E5DB9 /* @ECU_Address@FCtl_FTB_0x04@0x024C50A2@ */ ECIPP_ALIGNMENT_UBYTE 255 Compu_IDENTITY 0 255 PHYS_UNIT "FTB" /end CHARACTERISTIC
/begin CHARACTERISTIC FCspn_PWM17_off_loVf "FCtl_SPN(447)" VALUE 0x001E2460 /* @ECU_Address@FCtl_SPN@0x21B606FC@ */ ECIPP_ALIGNMENT_ULONG 4294967295 Compu_IDENTITY 0 4294967295 PHYS_UNIT "SPN" /end CHARACTERISTIC
/begin CHARACTERISTIC FCspn_PWM17_on_hiVf "FCtl_SPN(448)" VALUE 0x001E2464 /* @ECU_Address@FCtl_SPN@0x21B60700@ */ ECIPP_ALIGNMENT_ULONG 4294967295 Compu_IDENTITY 0 4294967295 PHYS_UNIT "SPN" /end CHARACTERISTIC
/begin CHARACTERISTIC FCspn_PWM18_off_loVf "FCtl_SPN(449)" VALUE 0x001E2468 /* @ECU_Address@FCtl_SPN@0x21B60704@ */ ECIPP_ALIGNMENT_ULONG 4294967295 Compu_IDENTITY 0 4294967295 PHYS_UNIT "SPN" /end CHARACTERISTIC
/begin CHARACTERISTIC FCspn_PWM18_on_hiVf "FCtl_SPN(450)" VALUE 0x001E246C /* @ECU_Address@FCtl_SPN@0x21B60708@ */ ECIPP_ALIGNMENT_ULONG 4294967295 Compu_IDENTITY 0 4294967295 PHYS_UNIT "SPN" /end CHARACTERISTIC
/begin CHARACTERISTIC FCspn_PWM19_off_loVf "FCtl_SPN(451)" VALUE 0x001E2470 /* @ECU_Address@FCtl_SPN@0x21B6070C@ */ ECIPP_ALIGNMENT_ULONG 4294967295 Compu_IDENTITY 0 4294967295 PHYS_UNIT "SPN" /end CHARACTERISTIC
/begin CHARACTERISTIC FCspn_PWM19_on_hiVf "FCtl_SPN(452)" VALUE 0x001E2474 /* @ECU_Address@FCtl_SPN@0x21B60710@ */ ECIPP_ALIGNMENT_ULONG 4294967295 Compu_IDENTITY 0 4294967295 PHYS_UNIT "SPN" /end CHARACTERISTIC
/begin CHARACTERISTIC FCspn_PWM2_off_loVf "FCtl_SPN(191)" VALUE 0x001E2060 /* @ECU_Address@FCtl_SPN@0x21B602FC@ */ ECIPP_ALIGNMENT_ULONG 4294967295 Compu_IDENTITY 0 4294967295 PHYS_UNIT "SPN" /end CHARACTERISTIC
/begin CHARACTERISTIC FCspn_PWM2_on_hiVf "FCtl_SPN(192)" VALUE 0x001E2064 /* @ECU_Address@FCtl_SPN@0x21B60300@ */ ECIPP_ALIGNMENT_ULONG 4294967295 Compu_IDENTITY 0 4294967295 PHYS_UNIT "SPN" /end CHARACTERISTIC
/begin CHARACTERISTIC FCspn_PWM20_off_loVf "FCtl_SPN(453)" VALUE 0x001E2478 /* @ECU_Address@FCtl_SPN@0x21B60714@ */ ECIPP_ALIGNMENT_ULONG 4294967295 Compu_IDENTITY 0 4294967295 PHYS_UNIT "SPN" /end CHARACTERISTIC
/begin CHARACTERISTIC FCspn_PWM20_on_hiVf "FCtl_SPN(454)" VALUE 0x001E247C /* @ECU_Address@FCtl_SPN@0x21B60718@ */ ECIPP_ALIGNMENT_ULONG 4294967295 Compu_IDENTITY 0 4294967295 PHYS_UNIT "SPN" /end CHARACTERISTIC
/begin CHARACTERISTIC FCspn_PWM21_off_loVf "FCtl_SPN(455)" VALUE 0x001E2480 /* @ECU_Address@FCtl_SPN@0x21B6071C@ */ ECIPP_ALIGNMENT_ULONG 4294967295 Compu_IDENTITY 0 4294967295 PHYS_UNIT "SPN" /end CHARACTERISTIC
/begin CHARACTERISTIC FCspn_PWM21_on_hiVf "FCtl_SPN(456)" VALUE 0x001E2484 /* @ECU_Address@FCtl_SPN@0x21B60720@ */ ECIPP_ALIGNMENT_ULONG 4294967295 Compu_IDENTITY 0 4294967295 PHYS_UNIT "SPN" /end CHARACTERISTIC
/begin CHARACTERISTIC FCspn_PWM22_off_loVf "FCtl_SPN(457)" VALUE 0x001E2488 /* @ECU_Address@FCtl_SPN@0x21B60724@ */ ECIPP_ALIGNMENT_ULONG 4294967295 Compu_IDENTITY 0 4294967295 PHYS_UNIT "SPN" /end CHARACTERISTIC
/begin CHARACTERISTIC FCspn_PWM22_on_hiVf "FCtl_SPN(458)" VALUE 0x001E248C /* @ECU_Address@FCtl_SPN@0x21B60728@ */ ECIPP_ALIGNMENT_ULONG 4294967295 Compu_IDENTITY 0 4294967295 PHYS_UNIT "SPN" /end CHARACTERISTIC
/begin CHARACTERISTIC FCspn_PWM23_off_loVf "FCtl_SPN(459)" VALUE 0x001E2490 /* @ECU_Address@FCtl_SPN@0x21B6072C@ */ ECIPP_ALIGNMENT_ULONG 4294967295 Compu_IDENTITY 0 4294967295 PHYS_UNIT "SPN" /end CHARACTERISTIC
/begin CHARACTERISTIC FCspn_PWM23_on_hiVf "FCtl_SPN(460)" VALUE 0x001E2494 /* @ECU_Address@FCtl_SPN@0x21B60730@ */ ECIPP_ALIGNMENT_ULONG 4294967295 Compu_IDENTITY 0 4294967295 PHYS_UNIT "SPN" /end CHARACTERISTIC
/begin CHARACTERISTIC FCspn_PWM3_off_loVf "FCtl_SPN(193)" VALUE 0x001E2068 /* @ECU_Address@FCtl_SPN@0x21B60304@ */ ECIPP_ALIGNMENT_ULONG 4294967295 Compu_IDENTITY 0 4294967295 PHYS_UNIT "SPN" /end CHARACTERISTIC
/begin CHARACTERISTIC FCspn_PWM3_on_hiVf "FCtl_SPN(194)" VALUE 0x001E206C /* @ECU_Address@FCtl_SPN@0x21B60308@ */ ECIPP_ALIGNMENT_ULONG 4294967295 Compu_IDENTITY 0 4294967295 PHYS_UNIT "SPN" /end CHARACTERISTIC
/begin CHARACTERISTIC FCspn_PWM4_off_loVf "FCtl_SPN(195)" VALUE 0x001E2070 /* @ECU_Address@FCtl_SPN@0x21B6030C@ */ ECIPP_ALIGNMENT_ULONG 4294967295 Compu_IDENTITY 0 4294967295 PHYS_UNIT "SPN" /end CHARACTERISTIC
/begin CHARACTERISTIC FCspn_PWM4_on_hiVf "FCtl_SPN(196)" VALUE 0x001E2074 /* @ECU_Address@FCtl_SPN@0x21B60310@ */ ECIPP_ALIGNMENT_ULONG 4294967295 Compu_IDENTITY 0 4294967295 PHYS_UNIT "SPN" /end CHARACTERISTIC
/begin CHARACTERISTIC FCspn_PWM5_off_loVf "FCtl_SPN(197)" VALUE 0x001E2078 /* @ECU_Address@FCtl_SPN@0x21B60314@ */ ECIPP_ALIGNMENT_ULONG 4294967295 Compu_IDENTITY 0 4294967295 PHYS_UNIT "SPN" /end CHARACTERISTIC
/begin CHARACTERISTIC FCspn_PWM5_on_hiVf "FCtl_SPN(198)" VALUE 0x001E207C /* @ECU_Address@FCtl_SPN@0x21B60318@ */ ECIPP_ALIGNMENT_ULONG 4294967295 Compu_IDENTITY 0 4294967295 PHYS_UNIT "SPN" /end CHARACTERISTIC
/begin CHARACTERISTIC FCspn_PWM6_off_loVf "FCtl_SPN(276)" VALUE 0x001E21B4 /* @ECU_Address@FCtl_SPN@0x21B60450@ */ ECIPP_ALIGNMENT_ULONG 4294967295 Compu_IDENTITY 0 4294967295 PHYS_UNIT "SPN" /end CHARACTERISTIC
/begin CHARACTERISTIC FCspn_PWM6_on_hiVf "FCtl_SPN(277)" VALUE 0x001E21B8 /* @ECU_Address@FCtl_SPN@0x21B60454@ */ ECIPP_ALIGNMENT_ULONG 4294967295 Compu_IDENTITY 0 4294967295 PHYS_UNIT "SPN" /end CHARACTERISTIC
/begin CHARACTERISTIC FCspn_PWM7_off_loVf "FCtl_SPN(278)" VALUE 0x001E21BC /* @ECU_Address@FCtl_SPN@0x21B60458@ */ ECIPP_ALIGNMENT_ULONG 4294967295 Compu_IDENTITY 0 4294967295 PHYS_UNIT "SPN" /end CHARACTERISTIC
/begin CHARACTERISTIC FCspn_PWM7_on_hiVf "FCtl_SPN(279)" VALUE 0x001E21C0 /* @ECU_Address@FCtl_SPN@0x21B6045C@ */ ECIPP_ALIGNMENT_ULONG 4294967295 Compu_IDENTITY 0 4294967295 PHYS_UNIT "SPN" /end CHARACTERISTIC
/begin CHARACTERISTIC FCspn_PWM8_off_loVf "FCtl_SPN(283)" VALUE 0x001E21D0 /* @ECU_Address@FCtl_SPN@0x21B6046C@ */ ECIPP_ALIGNMENT_ULONG 4294967295 Compu_IDENTITY 0 4294967295 PHYS_UNIT "SPN" /end CHARACTERISTIC
/begin CHARACTERISTIC FCspn_PWM8_on_hiVf "FCtl_SPN(284)" VALUE 0x001E21D4 /* @ECU_Address@FCtl_SPN@0x21B60470@ */ ECIPP_ALIGNMENT_ULONG 4294967295 Compu_IDENTITY 0 4294967295 PHYS_UNIT "SPN" /end CHARACTERISTIC
/begin CHARACTERISTIC FCspn_PWM9_off_loVf "FCtl_SPN(285)" VALUE 0x001E21D8 /* @ECU_Address@FCtl_SPN@0x21B60474@ */ ECIPP_ALIGNMENT_ULONG 4294967295 Compu_IDENTITY 0 4294967295 PHYS_UNIT "SPN" /end CHARACTERISTIC
/begin CHARACTERISTIC FCspn_PWM9_on_hiVf "FCtl_SPN(286)" VALUE 0x001E21DC /* @ECU_Address@FCtl_SPN@0x21B60478@ */ ECIPP_ALIGNMENT_ULONG 4294967295 Compu_IDENTITY 0 4294967295 PHYS_UNIT "SPN" /end CHARACTERISTIC
/begin CHARACTERISTIC FCspn_PWMLO_off_loVf "FCtl_SPN(521)" VALUE 0x001E2588 /* @ECU_Address@FCtl_SPN@0x21B60824@ */ ECIPP_ALIGNMENT_ULONG 4294967295 Compu_IDENTITY 0 4294967295 PHYS_UNIT "SPN" /end CHARACTERISTIC
/begin CHARACTERISTIC FCspn_PWMLO_on_hiVf "FCtl_SPN(522)" VALUE 0x001E258C /* @ECU_Address@FCtl_SPN@0x21B60828@ */ ECIPP_ALIGNMENT_ULONG 4294967295 Compu_IDENTITY 0 4294967295 PHYS_UNIT "SPN" /end CHARACTERISTIC
/begin CHARACTERISTIC FCspn_radby_poserr "FCtl_SPN(870)" VALUE 0x001E2AFC /* @ECU_Address@FCtl_SPN@0x21B60D98@ */ ECIPP_ALIGNMENT_ULONG 4294967295 Compu_IDENTITY 0 4294967295 PHYS_UNIT "SPN" /end CHARACTERISTIC
/begin CHARACTERISTIC FCspn_RAM_fail "FCtl_SPN(106)" VALUE 0x001E1F0C /* @ECU_Address@FCtl_SPN@0x21B601A8@ */ ECIPP_ALIGNMENT_ULONG 4294967295 Compu_IDENTITY 0 4294967295 PHYS_UNIT "SPN" /end CHARACTERISTIC
/begin CHARACTERISTIC FCspn_relay_coilopen "FCtl_SPN(159)" VALUE 0x001E1FE0 /* @ECU_Address@FCtl_SPN@0x21B6027C@ */ ECIPP_ALIGNMENT_ULONG 4294967295 Compu_IDENTITY 0 4294967295 PHYS_UNIT "SPN" /end CHARACTERISTIC
/begin CHARACTERISTIC FCspn_relay_coilshort "FCtl_SPN(160)" VALUE 0x001E1FE4 /* @ECU_Address@FCtl_SPN@0x21B60280@ */ ECIPP_ALIGNMENT_ULONG 4294967295 Compu_IDENTITY 0 4294967295 PHYS_UNIT "SPN" /end CHARACTERISTIC
/begin CHARACTERISTIC FCspn_relay_gndshort "FCtl_SPN(158)" VALUE 0x001E1FDC /* @ECU_Address@FCtl_SPN@0x21B60278@ */ ECIPP_ALIGNMENT_ULONG 4294967295 Compu_IDENTITY 0 4294967295 PHYS_UNIT "SPN" /end CHARACTERISTIC
/begin CHARACTERISTIC FCspn_relayoff_hiV "FCtl_SPN(431)" VALUE 0x001E2420 /* @ECU_Address@FCtl_SPN@0x21B606BC@ */ ECIPP_ALIGNMENT_ULONG 4294967295 Compu_IDENTITY 0 4294967295 PHYS_UNIT "SPN" /end CHARACTERISTIC
/begin CHARACTERISTIC FCspn_relayon_loV "FCtl_SPN(432)" VALUE 0x001E2424 /* @ECU_Address@FCtl_SPN@0x21B606C0@ */ ECIPP_ALIGNMENT_ULONG 4294967295 Compu_IDENTITY 0 4294967295 PHYS_UNIT "SPN" /end CHARACTERISTIC
/begin CHARACTERISTIC FCspn_rpm_hi_expected "FCtl_SPN(351)" VALUE 0x001E22E0 /* @ECU_Address@FCtl_SPN@0x21B6057C@ */ ECIPP_ALIGNMENT_ULONG 4294967295 Compu_IDENTITY 0 4294967295 PHYS_UNIT "SPN" /end CHARACTERISTIC
/begin CHARACTERISTIC FCspn_rpmd_gov_lo "FCtl_SPN(520)" VALUE 0x001E2584 /* @ECU_Address@FCtl_SPN@0x21B60820@ */ ECIPP_ALIGNMENT_ULONG 4294967295 Compu_IDENTITY 0 4294967295 PHYS_UNIT "SPN" /end CHARACTERISTIC
/begin CHARACTERISTIC FCspn_RS_discon "FCtl_SPN(691)" VALUE 0x001E2830 /* @ECU_Address@FCtl_SPN@0x21B60ACC@ */ ECIPP_ALIGNMENT_ULONG 4294967295 Compu_IDENTITY 0 4294967295 PHYS_UNIT "SPN" /end CHARACTERISTIC
/begin CHARACTERISTIC FCspn_RS_hiV "FCtl_SPN(599)" VALUE 0x001E26C0 /* @ECU_Address@FCtl_SPN@0x21B6095C@ */ ECIPP_ALIGNMENT_ULONG 4294967295 Compu_IDENTITY 0 4294967295 PHYS_UNIT "SPN" /end CHARACTERISTIC
/begin CHARACTERISTIC FCspn_RS_loss "FCtl_SPN(220)" VALUE 0x001E20D4 /* @ECU_Address@FCtl_SPN@0x21B60370@ */ ECIPP_ALIGNMENT_ULONG 4294967295 Compu_IDENTITY 0 4294967295 PHYS_UNIT "SPN" /end CHARACTERISTIC
/begin CHARACTERISTIC FCspn_RS_loV "FCtl_SPN(598)" VALUE 0x001E26BC /* @ECU_Address@FCtl_SPN@0x21B60958@ */ ECIPP_ALIGNMENT_ULONG 4294967295 Compu_IDENTITY 0 4294967295 PHYS_UNIT "SPN" /end CHARACTERISTIC
/begin CHARACTERISTIC FCspn_RS485_bad_fmt "FCtl_SPN(124)" VALUE 0x001E1F54 /* @ECU_Address@FCtl_SPN@0x21B601F0@ */ ECIPP_ALIGNMENT_ULONG 4294967295 Compu_IDENTITY 0 4294967295 PHYS_UNIT "SPN" /end CHARACTERISTIC
/begin CHARACTERISTIC FCspn_RS485_Rx_inact "FCtl_SPN(122)" VALUE 0x001E1F4C /* @ECU_Address@FCtl_SPN@0x21B601E8@ */ ECIPP_ALIGNMENT_ULONG 4294967295 Compu_IDENTITY 0 4294967295 PHYS_UNIT "SPN" /end CHARACTERISTIC
/begin CHARACTERISTIC FCspn_RS485_Rx_noise "FCtl_SPN(123)" VALUE 0x001E1F50 /* @ECU_Address@FCtl_SPN@0x21B601EC@ */ ECIPP_ALIGNMENT_ULONG 4294967295 Compu_IDENTITY 0 4294967295 PHYS_UNIT "SPN" /end CHARACTERISTIC
/begin CHARACTERISTIC FCspn_RS485_SD_rq "FCtl_SPN(125)" VALUE 0x001E1F58 /* @ECU_Address@FCtl_SPN@0x21B601F4@ */ ECIPP_ALIGNMENT_ULONG 4294967295 Compu_IDENTITY 0 4294967295 PHYS_UNIT "SPN" /end CHARACTERISTIC
/begin CHARACTERISTIC FCspn_RTI1 "FCtl_SPN(100)" VALUE 0x001E1EF4 /* @ECU_Address@FCtl_SPN@0x21B60190@ */ ECIPP_ALIGNMENT_ULONG 4294967295 Compu_IDENTITY 0 4294967295 PHYS_UNIT "SPN" /end CHARACTERISTIC
/begin CHARACTERISTIC FCspn_RTI2 "FCtl_SPN(101)" VALUE 0x001E1EF8 /* @ECU_Address@FCtl_SPN@0x21B60194@ */ ECIPP_ALIGNMENT_ULONG 4294967295 Compu_IDENTITY 0 4294967295 PHYS_UNIT "SPN" /end CHARACTERISTIC
/begin CHARACTERISTIC FCspn_RTI3 "FCtl_SPN(102)" VALUE 0x001E1EFC /* @ECU_Address@FCtl_SPN@0x21B60198@ */ ECIPP_ALIGNMENT_ULONG 4294967295 Compu_IDENTITY 0 4294967295 PHYS_UNIT "SPN" /end CHARACTERISTIC
/begin CHARACTERISTIC FCspn_Sec1_31KV_open "FCtl_SPN(949)" VALUE 0x001E2C38 /* @ECU_Address@FCtl_SPN@0x21B60ED4@ */ ECIPP_ALIGNMENT_ULONG 4294967295 Compu_IDENTITY 0 4294967295 PHYS_UNIT "SPN" /end CHARACTERISTIC
/begin CHARACTERISTIC FCspn_Sec1_low "FCtl_SPN(937)" VALUE 0x001E2C08 /* @ECU_Address@FCtl_SPN@0x21B60EA4@ */ ECIPP_ALIGNMENT_ULONG 4294967295 Compu_IDENTITY 0 4294967295 PHYS_UNIT "SPN" /end CHARACTERISTIC
/begin CHARACTERISTIC FCspn_Sec1_open "FCtl_SPN(925)" VALUE 0x001E2BD8 /* @ECU_Address@FCtl_SPN@0x21B60E74@ */ ECIPP_ALIGNMENT_ULONG 4294967295 Compu_IDENTITY 0 4294967295 PHYS_UNIT "SPN" /end CHARACTERISTIC
/begin CHARACTERISTIC FCspn_SHIFT_FB_OOR "FCtl_SPN(294)" VALUE 0x001E21FC /* @ECU_Address@FCtl_SPN@0x21B60498@ */ ECIPP_ALIGNMENT_ULONG 4294967295 Compu_IDENTITY 0 4294967295 PHYS_UNIT "SPN" /end CHARACTERISTIC
/begin CHARACTERISTIC FCspn_SHIFT_intcirc_fail "FCtl_SPN(296)" VALUE 0x001E2204 /* @ECU_Address@FCtl_SPN@0x21B604A0@ */ ECIPP_ALIGNMENT_ULONG 4294967295 Compu_IDENTITY 0 4294967295 PHYS_UNIT "SPN" /end CHARACTERISTIC
/begin CHARACTERISTIC FCspn_SHIFT_shift_fail "FCtl_SPN(295)" VALUE 0x001E2200 /* @ECU_Address@FCtl_SPN@0x21B6049C@ */ ECIPP_ALIGNMENT_ULONG 4294967295 Compu_IDENTITY 0 4294967295 PHYS_UNIT "SPN" /end CHARACTERISTIC
/begin CHARACTERISTIC FCspn_SL_fuel "FCtl_SPN(109)" VALUE 0x001E1F18 /* @ECU_Address@FCtl_SPN@0x21B601B4@ */ ECIPP_ALIGNMENT_ULONG 4294967295 Compu_IDENTITY 0 4294967295 PHYS_UNIT "SPN" /end CHARACTERISTIC
/begin CHARACTERISTIC FCspn_SL_gov "FCtl_SPN(108)" VALUE 0x001E1F14 /* @ECU_Address@FCtl_SPN@0x21B601B0@ */ ECIPP_ALIGNMENT_ULONG 4294967295 Compu_IDENTITY 0 4294967295 PHYS_UNIT "SPN" /end CHARACTERISTIC
/begin CHARACTERISTIC FCspn_SL_spk "FCtl_SPN(110)" VALUE 0x001E1F1C /* @ECU_Address@FCtl_SPN@0x21B601B8@ */ ECIPP_ALIGNMENT_ULONG 4294967295 Compu_IDENTITY 0 4294967295 PHYS_UNIT "SPN" /end CHARACTERISTIC
/begin CHARACTERISTIC FCspn_slv_MAP_hi_OOA "FCtl_SPN(837)" VALUE 0x001E2A78 /* @ECU_Address@FCtl_SPN@0x21B60D14@ */ ECIPP_ALIGNMENT_ULONG 4294967295 Compu_IDENTITY 0 4294967295 PHYS_UNIT "SPN" /end CHARACTERISTIC
/begin CHARACTERISTIC FCspn_slv_MAP_lo_OOA "FCtl_SPN(838)" VALUE 0x001E2A7C /* @ECU_Address@FCtl_SPN@0x21B60D18@ */ ECIPP_ALIGNMENT_ULONG 4294967295 Compu_IDENTITY 0 4294967295 PHYS_UNIT "SPN" /end CHARACTERISTIC
/begin CHARACTERISTIC FCspn_SPK_int_fail "FCtl_SPN(303)" VALUE 0x001E2220 /* @ECU_Address@FCtl_SPN@0x21B604BC@ */ ECIPP_ALIGNMENT_ULONG 4294967295 Compu_IDENTITY 0 4294967295 PHYS_UNIT "SPN" /end CHARACTERISTIC
/begin CHARACTERISTIC FCspn_SPK1_IGBT_T "FCtl_SPN(509)" VALUE 0x001E2558 /* @ECU_Address@FCtl_SPN@0x21B607F4@ */ ECIPP_ALIGNMENT_ULONG 4294967295 Compu_IDENTITY 0 4294967295 PHYS_UNIT "SPN" /end CHARACTERISTIC
/begin CHARACTERISTIC FCspn_SPKD_coil_fail "FCtl_SPN(304)" VALUE 0x001E2224 /* @ECU_Address@FCtl_SPN@0x21B604C0@ */ ECIPP_ALIGNMENT_ULONG 4294967295 Compu_IDENTITY 0 4294967295 PHYS_UNIT "SPN" /end CHARACTERISTIC
/begin CHARACTERISTIC FCspn_SPKD_dw_hi "FCtl_SPN(76)" VALUE 0x001E1E94 /* @ECU_Address@FCtl_SPN@0x21B60130@ */ ECIPP_ALIGNMENT_ULONG 4294967295 Compu_IDENTITY 0 4294967295 PHYS_UNIT "SPN" /end CHARACTERISTIC
/begin CHARACTERISTIC FCspn_SPKD_dw_lo "FCtl_SPN(66)" VALUE 0x001E1E6C /* @ECU_Address@FCtl_SPN@0x21B60108@ */ ECIPP_ALIGNMENT_ULONG 4294967295 Compu_IDENTITY 0 4294967295 PHYS_UNIT "SPN" /end CHARACTERISTIC
/begin CHARACTERISTIC FCspn_SRVC_expired "FCtl_SPN(426)" VALUE 0x001E240C /* @ECU_Address@FCtl_SPN@0x21B606A8@ */ ECIPP_ALIGNMENT_ULONG 4294967295 Compu_IDENTITY 0 4294967295 PHYS_UNIT "SPN" /end CHARACTERISTIC
/begin CHARACTERISTIC FCspn_SRVC_expired2 "FCtl_SPN(836)" VALUE 0x001E2A74 /* @ECU_Address@FCtl_SPN@0x21B60D10@ */ ECIPP_ALIGNMENT_ULONG 4294967295 Compu_IDENTITY 0 4294967295 PHYS_UNIT "SPN" /end CHARACTERISTIC
/begin CHARACTERISTIC FCspn_start_coilopen "FCtl_SPN(162)" VALUE 0x001E1FEC /* @ECU_Address@FCtl_SPN@0x21B60288@ */ ECIPP_ALIGNMENT_ULONG 4294967295 Compu_IDENTITY 0 4294967295 PHYS_UNIT "SPN" /end CHARACTERISTIC
/begin CHARACTERISTIC FPfl_PWM17_off_loVf "FPrm_latch(344)" VALUE 0x001E0578 /* @ECU_Address@FPrm_latch@0x021BB560@ */ ECIPP_ALIGNMENT_FLOAT32_IEEE 10000000000 Compu_IDENTITY -10000000000 10000000000 PHYS_UNIT "ms" /end CHARACTERISTIC
/begin CHARACTERISTIC FPfl_PWM17_on_hiVf "FPrm_latch(345)" VALUE 0x001E057C /* @ECU_Address@FPrm_latch@0x021BB564@ */ ECIPP_ALIGNMENT_FLOAT32_IEEE 10000000000 Compu_IDENTITY -10000000000 10000000000 PHYS_UNIT "ms" /end CHARACTERISTIC
/begin CHARACTERISTIC FPfl_PWM18_off_loVf "FPrm_latch(346)" VALUE 0x001E0580 /* @ECU_Address@FPrm_latch@0x021BB568@ */ ECIPP_ALIGNMENT_FLOAT32_IEEE 10000000000 Compu_IDENTITY -10000000000 10000000000 PHYS_UNIT "ms" /end CHARACTERISTIC
/begin CHARACTERISTIC FPfl_PWM18_on_hiVf "FPrm_latch(347)" VALUE 0x001E0584 /* @ECU_Address@FPrm_latch@0x021BB56C@ */ ECIPP_ALIGNMENT_FLOAT32_IEEE 10000000000 Compu_IDENTITY -10000000000 10000000000 PHYS_UNIT "ms" /end CHARACTERISTIC
/begin CHARACTERISTIC FPfl_PWM19_off_loVf "FPrm_latch(348)" VALUE 0x001E0588 /* @ECU_Address@FPrm_latch@0x021BB570@ */ ECIPP_ALIGNMENT_FLOAT32_IEEE 10000000000 Compu_IDENTITY -10000000000 10000000000 PHYS_UNIT "ms" /end CHARACTERISTIC
/begin CHARACTERISTIC FPfl_PWM19_on_hiVf "FPrm_latch(349)" VALUE 0x001E058C /* @ECU_Address@FPrm_latch@0x021BB574@ */ ECIPP_ALIGNMENT_FLOAT32_IEEE 10000000000 Compu_IDENTITY -10000000000 10000000000 PHYS_UNIT "ms" /end CHARACTERISTIC
/begin CHARACTERISTIC FPfl_PWM2_off_loVf "FPrm_latch(149)" VALUE 0x001E026C /* @ECU_Address@FPrm_latch@0x021BB254@ */ ECIPP_ALIGNMENT_FLOAT32_IEEE 10000000000 Compu_IDENTITY -10000000000 10000000000 PHYS_UNIT "ms" /end CHARACTERISTIC
/begin CHARACTERISTIC FPfl_PWM2_on_hiVf "FPrm_latch(150)" VALUE 0x001E0270 /* @ECU_Address@FPrm_latch@0x021BB258@ */ ECIPP_ALIGNMENT_FLOAT32_IEEE 10000000000 Compu_IDENTITY -10000000000 10000000000 PHYS_UNIT "ms" /end CHARACTERISTIC
/begin CHARACTERISTIC FPfl_PWM20_off_loVf "FPrm_latch(350)" VALUE 0x001E0590 /* @ECU_Address@FPrm_latch@0x021BB578@ */ ECIPP_ALIGNMENT_FLOAT32_IEEE 10000000000 Compu_IDENTITY -10000000000 10000000000 PHYS_UNIT "ms" /end CHARACTERISTIC
/begin CHARACTERISTIC FPfl_PWM20_on_hiVf "FPrm_latch(351)" VALUE 0x001E0594 /* @ECU_Address@FPrm_latch@0x021BB57C@ */ ECIPP_ALIGNMENT_FLOAT32_IEEE 10000000000 Compu_IDENTITY -10000000000 10000000000 PHYS_UNIT "ms" /end CHARACTERISTIC
/begin CHARACTERISTIC FPfl_PWM21_off_loVf "FPrm_latch(352)" VALUE 0x001E0598 /* @ECU_Address@FPrm_latch@0x021BB580@ */ ECIPP_ALIGNMENT_FLOAT32_IEEE 10000000000 Compu_IDENTITY -10000000000 10000000000 PHYS_UNIT "ms" /end CHARACTERISTIC
/begin CHARACTERISTIC FPfl_PWM21_on_hiVf "FPrm_latch(353)" VALUE 0x001E059C /* @ECU_Address@FPrm_latch@0x021BB584@ */ ECIPP_ALIGNMENT_FLOAT32_IEEE 10000000000 Compu_IDENTITY -10000000000 10000000000 PHYS_UNIT "ms" /end CHARACTERISTIC
/begin CHARACTERISTIC FPfl_PWM22_off_loVf "FPrm_latch(354)" VALUE 0x001E05A0 /* @ECU_Address@FPrm_latch@0x021BB588@ */ ECIPP_ALIGNMENT_FLOAT32_IEEE 10000000000 Compu_IDENTITY -10000000000 10000000000 PHYS_UNIT "ms" /end CHARACTERISTIC
/begin CHARACTERISTIC FPfl_PWM22_on_hiVf "FPrm_latch(355)" VALUE 0x001E05A4 /* @ECU_Address@FPrm_latch@0x021BB58C@ */ ECIPP_ALIGNMENT_FLOAT32_IEEE 10000000000 Compu_IDENTITY -10000000000 10000000000 PHYS_UNIT "ms" /end CHARACTERISTIC
/begin CHARACTERISTIC FPfl_PWM23_off_loVf "FPrm_latch(356)" VALUE 0x001E05A8 /* @ECU_Address@FPrm_latch@0x021BB590@ */ ECIPP_ALIGNMENT_FLOAT32_IEEE 10000000000 Compu_IDENTITY -10000000000 10000000000 PHYS_UNIT "ms" /end CHARACTERISTIC
/begin CHARACTERISTIC FPfl_PWM23_on_hiVf "FPrm_latch(357)" VALUE 0x001E05AC /* @ECU_Address@FPrm_latch@0x021BB594@ */ ECIPP_ALIGNMENT_FLOAT32_IEEE 10000000000 Compu_IDENTITY -10000000000 10000000000 PHYS_UNIT "ms" /end CHARACTERISTIC
/begin CHARACTERISTIC FPfl_PWM3_off_loVf "FPrm_latch(151)" VALUE 0x001E0274 /* @ECU_Address@FPrm_latch@0x021BB25C@ */ ECIPP_ALIGNMENT_FLOAT32_IEEE 10000000000 Compu_IDENTITY -10000000000 10000000000 PHYS_UNIT "ms" /end CHARACTERISTIC
/begin CHARACTERISTIC FPfl_PWM3_on_hiVf "FPrm_latch(152)" VALUE 0x001E0278 /* @ECU_Address@FPrm_latch@0x021BB260@ */ ECIPP_ALIGNMENT_FLOAT32_IEEE 10000000000 Compu_IDENTITY -10000000000 10000000000 PHYS_UNIT "ms" /end CHARACTERISTIC
/begin CHARACTERISTIC FPfl_PWM4_off_loVf "FPrm_latch(153)" VALUE 0x001E027C /* @ECU_Address@FPrm_latch@0x021BB264@ */ ECIPP_ALIGNMENT_FLOAT32_IEEE 10000000000 Compu_IDENTITY -10000000000 10000000000 PHYS_UNIT "ms" /end CHARACTERISTIC
/begin CHARACTERISTIC FPfl_PWM4_on_hiVf "FPrm_latch(154)" VALUE 0x001E0280 /* @ECU_Address@FPrm_latch@0x021BB268@ */ ECIPP_ALIGNMENT_FLOAT32_IEEE 10000000000 Compu_IDENTITY -10000000000 10000000000 PHYS_UNIT "ms" /end CHARACTERISTIC
/begin CHARACTERISTIC FPfl_PWM5_off_loVf "FPrm_latch(155)" VALUE 0x001E0284 /* @ECU_Address@FPrm_latch@0x021BB26C@ */ ECIPP_ALIGNMENT_FLOAT32_IEEE 10000000000 Compu_IDENTITY -10000000000 10000000000 PHYS_UNIT "ms" /end CHARACTERISTIC
/begin CHARACTERISTIC FPfl_PWM5_on_hiVf "FPrm_latch(156)" VALUE 0x001E0288 /* @ECU_Address@FPrm_latch@0x021BB270@ */ ECIPP_ALIGNMENT_FLOAT32_IEEE 10000000000 Compu_IDENTITY -10000000000 10000000000 PHYS_UNIT "ms" /end CHARACTERISTIC
/begin CHARACTERISTIC FPfl_PWM6_off_loVf "FPrm_latch(198)" VALUE 0x001E0330 /* @ECU_Address@FPrm_latch@0x021BB318@ */ ECIPP_ALIGNMENT_FLOAT32_IEEE 10000000000 Compu_IDENTITY -10000000000 10000000000 PHYS_UNIT "ms" /end CHARACTERISTIC
/begin CHARACTERISTIC FPfl_PWM6_on_hiVf "FPrm_latch(199)" VALUE 0x001E0334 /* @ECU_Address@FPrm_latch@0x021BB31C@ */ ECIPP_ALIGNMENT_FLOAT32_IEEE 10000000000 Compu_IDENTITY -10000000000 10000000000 PHYS_UNIT "ms" /end CHARACTERISTIC
/begin CHARACTERISTIC FPfl_PWM7_off_loVf "FPrm_latch(200)" VALUE 0x001E0338 /* @ECU_Address@FPrm_latch@0x021BB320@ */ ECIPP_ALIGNMENT_FLOAT32_IEEE 10000000000 Compu_IDENTITY -10000000000 10000000000 PHYS_UNIT "ms" /end CHARACTERISTIC
/begin CHARACTERISTIC FPfl_PWM7_on_hiVf "FPrm_latch(201)" VALUE 0x001E033C /* @ECU_Address@FPrm_latch@0x021BB324@ */ ECIPP_ALIGNMENT_FLOAT32_IEEE 10000000000 Compu_IDENTITY -10000000000 10000000000 PHYS_UNIT "ms" /end CHARACTERISTIC
/begin CHARACTERISTIC FPfl_PWM8_off_loVf "FPrm_latch(205)" VALUE 0x001E034C /* @ECU_Address@FPrm_latch@0x021BB334@ */ ECIPP_ALIGNMENT_FLOAT32_IEEE 10000000000 Compu_IDENTITY -10000000000 10000000000 PHYS_UNIT "ms" /end CHARACTERISTIC
/begin CHARACTERISTIC FPfl_PWM8_on_hiVf "FPrm_latch(206)" VALUE 0x001E0350 /* @ECU_Address@FPrm_latch@0x021BB338@ */ ECIPP_ALIGNMENT_FLOAT32_IEEE 10000000000 Compu_IDENTITY -10000000000 10000000000 PHYS_UNIT "ms" /end CHARACTERISTIC
/begin CHARACTERISTIC FPfl_PWM9_off_loVf "FPrm_latch(207)" VALUE 0x001E0354 /* @ECU_Address@FPrm_latch@0x021BB33C@ */ ECIPP_ALIGNMENT_FLOAT32_IEEE 10000000000 Compu_IDENTITY -10000000000 10000000000 PHYS_UNIT "ms" /end CHARACTERISTIC
/begin CHARACTERISTIC FPfl_PWM9_on_hiVf "FPrm_latch(208)" VALUE 0x001E0358 /* @ECU_Address@FPrm_latch@0x021BB340@ */ ECIPP_ALIGNMENT_FLOAT32_IEEE 10000000000 Compu_IDENTITY -10000000000 10000000000 PHYS_UNIT "ms" /end CHARACTERISTIC
/begin CHARACTERISTIC FPfl_PWMLO_off_loVf "FPrm_latch(391)" VALUE 0x001E0634 /* @ECU_Address@FPrm_latch@0x021BB61C@ */ ECIPP_ALIGNMENT_FLOAT32_IEEE 10000000000 Compu_IDENTITY -10000000000 10000000000 PHYS_UNIT "ms" /end CHARACTERISTIC
/begin CHARACTERISTIC FPfl_PWMLO_on_hiVf "FPrm_latch(392)" VALUE 0x001E0638 /* @ECU_Address@FPrm_latch@0x021BB620@ */ ECIPP_ALIGNMENT_FLOAT32_IEEE 10000000000 Compu_IDENTITY -10000000000 10000000000 PHYS_UNIT "ms" /end CHARACTERISTIC
/begin CHARACTERISTIC FPfl_radby_poserr "FPrm_latch(697)" VALUE 0x001E0AFC /* @ECU_Address@FPrm_latch@0x021BBAE4@ */ ECIPP_ALIGNMENT_FLOAT32_IEEE 10000000000 Compu_IDENTITY -10000000000 10000000000 PHYS_UNIT "ms" /end CHARACTERISTIC
/begin CHARACTERISTIC FPfl_RAM_fail "FPrm_latch(70)" VALUE 0x001E0130 /* @ECU_Address@FPrm_latch@0x021BB118@ */ ECIPP_ALIGNMENT_FLOAT32_IEEE 10000000000 Compu_IDENTITY -10000000000 10000000000 PHYS_UNIT "ms" /end CHARACTERISTIC
/begin CHARACTERISTIC FPfl_relay_coilopen "FPrm_latch(119)" VALUE 0x001E01F4 /* @ECU_Address@FPrm_latch@0x021BB1DC@ */ ECIPP_ALIGNMENT_FLOAT32_IEEE 10000000000 Compu_IDENTITY -10000000000 10000000000 PHYS_UNIT "samples" /end CHARACTERISTIC
/begin CHARACTERISTIC FPfl_relay_coilshort "FPrm_latch(120)" VALUE 0x001E01F8 /* @ECU_Address@FPrm_latch@0x021BB1E0@ */ ECIPP_ALIGNMENT_FLOAT32_IEEE 10000000000 Compu_IDENTITY -10000000000 10000000000 PHYS_UNIT "samples" /end CHARACTERISTIC
/begin CHARACTERISTIC FPfl_relay_gndshort "FPrm_latch(118)" VALUE 0x001E01F0 /* @ECU_Address@FPrm_latch@0x021BB1D8@ */ ECIPP_ALIGNMENT_FLOAT32_IEEE 10000000000 Compu_IDENTITY -10000000000 10000000000 PHYS_UNIT "samples" /end CHARACTERISTIC
/begin CHARACTERISTIC FPfl_relayoff_hiV "FPrm_latch(328)" VALUE 0x001E0538 /* @ECU_Address@FPrm_latch@0x021BB520@ */ ECIPP_ALIGNMENT_FLOAT32_IEEE 10000000000 Compu_IDENTITY -10000000000 10000000000 PHYS_UNIT "ms" /end CHARACTERISTIC
/begin CHARACTERISTIC FPfl_relayon_loV "FPrm_latch(329)" VALUE 0x001E053C /* @ECU_Address@FPrm_latch@0x021BB524@ */ ECIPP_ALIGNMENT_FLOAT32_IEEE 10000000000 Compu_IDENTITY -10000000000 10000000000 PHYS_UNIT "ms" /end CHARACTERISTIC
/begin CHARACTERISTIC FPfl_rpm_hi_expected "FPrm_latch(260)" VALUE 0x001E0428 /* @ECU_Address@FPrm_latch@0x021BB410@ */ ECIPP_ALIGNMENT_FLOAT32_IEEE 10000000000 Compu_IDENTITY -10000000000 10000000000 PHYS_UNIT "ms" /end CHARACTERISTIC
/begin CHARACTERISTIC FPfl_rpmd_gov_lo "FPrm_latch(390)" VALUE 0x001E0630 /* @ECU_Address@FPrm_latch@0x021BB618@ */ ECIPP_ALIGNMENT_FLOAT32_IEEE 10000000000 Compu_IDENTITY -10000000000 10000000000 PHYS_UNIT "ms" /end CHARACTERISTIC
/begin CHARACTERISTIC FPfl_RS_discon "FPrm_latch(521)" VALUE 0x001E083C /* @ECU_Address@FPrm_latch@0x021BB824@ */ ECIPP_ALIGNMENT_FLOAT32_IEEE 10000000000 Compu_IDENTITY -10000000000 10000000000 PHYS_UNIT "samples" /end CHARACTERISTIC
/begin CHARACTERISTIC FPfl_RS_hiV "FPrm_latch(453)" VALUE 0x001E072C /* @ECU_Address@FPrm_latch@0x021BB714@ */ ECIPP_ALIGNMENT_FLOAT32_IEEE 10000000000 Compu_IDENTITY -10000000000 10000000000 PHYS_UNIT "ms" /end CHARACTERISTIC
/begin CHARACTERISTIC FPfl_RS_loss "FPrm_latch(176)" VALUE 0x001E02D8 /* @ECU_Address@FPrm_latch@0x021BB2C0@ */ ECIPP_ALIGNMENT_FLOAT32_IEEE 10000000000 Compu_IDENTITY -10000000000 10000000000 PHYS_UNIT "ms" /end CHARACTERISTIC
/begin CHARACTERISTIC FPfl_RS_loV "FPrm_latch(452)" VALUE 0x001E0728 /* @ECU_Address@FPrm_latch@0x021BB710@ */ ECIPP_ALIGNMENT_FLOAT32_IEEE 10000000000 Compu_IDENTITY -10000000000 10000000000 PHYS_UNIT "ms" /end CHARACTERISTIC
/begin CHARACTERISTIC FPfl_RS485_bad_fmt "FPrm_latch(83)" VALUE 0x001E0164 /* @ECU_Address@FPrm_latch@0x021BB14C@ */ ECIPP_ALIGNMENT_FLOAT32_IEEE 10000000000 Compu_IDENTITY -10000000000 10000000000 PHYS_UNIT "packets" /end CHARACTERISTIC
/begin CHARACTERISTIC FPfl_RS485_Rx_inact "FPrm_latch(81)" VALUE 0x001E015C /* @ECU_Address@FPrm_latch@0x021BB144@ */ ECIPP_ALIGNMENT_FLOAT32_IEEE 10000000000 Compu_IDENTITY -10000000000 10000000000 PHYS_UNIT "ms" /end CHARACTERISTIC
/begin CHARACTERISTIC FPfl_RS485_Rx_noise "FPrm_latch(82)" VALUE 0x001E0160 /* @ECU_Address@FPrm_latch@0x021BB148@ */ ECIPP_ALIGNMENT_FLOAT32_IEEE 10000000000 Compu_IDENTITY -10000000000 10000000000 PHYS_UNIT "packets" /end CHARACTERISTIC
/begin CHARACTERISTIC FPfl_RS485_SD_rq "FPrm_latch(84)" VALUE 0x001E0168 /* @ECU_Address@FPrm_latch@0x021BB150@ */ ECIPP_ALIGNMENT_FLOAT32_IEEE 10000000000 Compu_IDENTITY -10000000000 10000000000 PHYS_UNIT "ms" /end CHARACTERISTIC
/begin CHARACTERISTIC FPfl_RTI1 "FPrm_latch(64)" VALUE 0x001E0118 /* @ECU_Address@FPrm_latch@0x021BB100@ */ ECIPP_ALIGNMENT_FLOAT32_IEEE 10000000000 Compu_IDENTITY -10000000000 10000000000 PHYS_UNIT "ms" /end CHARACTERISTIC
/begin CHARACTERISTIC FPfl_RTI2 "FPrm_latch(65)" VALUE 0x001E011C /* @ECU_Address@FPrm_latch@0x021BB104@ */ ECIPP_ALIGNMENT_FLOAT32_IEEE 10000000000 Compu_IDENTITY -10000000000 10000000000 PHYS_UNIT "ms" /end CHARACTERISTIC
/begin CHARACTERISTIC FPfl_RTI3 "FPrm_latch(66)" VALUE 0x001E0120 /* @ECU_Address@FPrm_latch@0x021BB108@ */ ECIPP_ALIGNMENT_FLOAT32_IEEE 10000000000 Compu_IDENTITY -10000000000 10000000000 PHYS_UNIT "ms" /end CHARACTERISTIC
/begin CHARACTERISTIC FPfl_Sec1_31KV_open "FPrm_latch(707)" VALUE 0x001E0B24 /* @ECU_Address@FPrm_latch@0x021BBB0C@ */ ECIPP_ALIGNMENT_FLOAT32_IEEE 10000000000 Compu_IDENTITY -10000000000 10000000000 PHYS_UNIT "ms" /end CHARACTERISTIC
/begin CHARACTERISTIC FPfl_Sec1_low "FPrm_latch(706)" VALUE 0x001E0B20 /* @ECU_Address@FPrm_latch@0x021BBB08@ */ ECIPP_ALIGNMENT_FLOAT32_IEEE 10000000000 Compu_IDENTITY -10000000000 10000000000 PHYS_UNIT "ms" /end CHARACTERISTIC
/begin CHARACTERISTIC FPfl_Sec1_open "FPrm_latch(705)" VALUE 0x001E0B1C /* @ECU_Address@FPrm_latch@0x021BBB04@ */ ECIPP_ALIGNMENT_FLOAT32_IEEE 10000000000 Compu_IDENTITY -10000000000 10000000000 PHYS_UNIT "ms" /end CHARACTERISTIC
/begin CHARACTERISTIC FPfl_SHIFT_FB_OOR "FPrm_latch(216)" VALUE 0x001E0378 /* @ECU_Address@FPrm_latch@0x021BB360@ */ ECIPP_ALIGNMENT_FLOAT32_IEEE 10000000000 Compu_IDENTITY -10000000000 10000000000 PHYS_UNIT "ms" /end CHARACTERISTIC
/begin CHARACTERISTIC FPfl_SHIFT_intcirc_fail "FPrm_latch(218)" VALUE 0x001E0380 /* @ECU_Address@FPrm_latch@0x021BB368@ */ ECIPP_ALIGNMENT_FLOAT32_IEEE 10000000000 Compu_IDENTITY -10000000000 10000000000 PHYS_UNIT "ms" /end CHARACTERISTIC
/begin CHARACTERISTIC FPfl_SHIFT_shift_fail "FPrm_latch(217)" VALUE 0x001E037C /* @ECU_Address@FPrm_latch@0x021BB364@ */ ECIPP_ALIGNMENT_FLOAT32_IEEE 10000000000 Compu_IDENTITY -10000000000 10000000000 PHYS_UNIT "ms" /end CHARACTERISTIC
/begin CHARACTERISTIC FPfl_SL_fuel "FPrm_latch(38)" VALUE 0x001E00B0 /* @ECU_Address@FPrm_latch@0x021BB098@ */ ECIPP_ALIGNMENT_FLOAT32_IEEE 10000000000 Compu_IDENTITY -10000000000 10000000000 PHYS_UNIT "ms" /end CHARACTERISTIC
/begin CHARACTERISTIC FPfl_SL_gov "FPrm_latch(37)" VALUE 0x001E00AC /* @ECU_Address@FPrm_latch@0x021BB094@ */ ECIPP_ALIGNMENT_FLOAT32_IEEE 10000000000 Compu_IDENTITY -10000000000 10000000000 PHYS_UNIT "ms" /end CHARACTERISTIC
/begin CHARACTERISTIC FPfl_SL_spk "FPrm_latch(39)" VALUE 0x001E00B4 /* @ECU_Address@FPrm_latch@0x021BB09C@ */ ECIPP_ALIGNMENT_FLOAT32_IEEE 10000000000 Compu_IDENTITY -10000000000 10000000000 PHYS_UNIT "ms" /end CHARACTERISTIC
/begin CHARACTERISTIC FPfl_slv_MAP_hi_OOA "FPrm_latch(664)" VALUE 0x001E0A78 /* @ECU_Address@FPrm_latch@0x021BBA60@ */ ECIPP_ALIGNMENT_FLOAT32_IEEE 10000000000 Compu_IDENTITY -10000000000 10000000000 PHYS_UNIT "ms" /end CHARACTERISTIC
/begin CHARACTERISTIC FPfl_slv_MAP_lo_OOA "FPrm_latch(665)" VALUE 0x001E0A7C /* @ECU_Address@FPrm_latch@0x021BBA64@ */ ECIPP_ALIGNMENT_FLOAT32_IEEE 10000000000 Compu_IDENTITY -10000000000 10000000000 PHYS_UNIT "ms" /end CHARACTERISTIC
/begin CHARACTERISTIC FPfl_SPK_int_fail "FPrm_latch(225)" VALUE 0x001E039C /* @ECU_Address@FPrm_latch@0x021BB384@ */ ECIPP_ALIGNMENT_FLOAT32_IEEE 10000000000 Compu_IDENTITY -10000000000 10000000000 PHYS_UNIT "sparks" /end CHARACTERISTIC
/begin CHARACTERISTIC FPfl_SPK1_IGBT_T "FPrm_latch(388)" VALUE 0x001E0628 /* @ECU_Address@FPrm_latch@0x021BB610@ */ ECIPP_ALIGNMENT_FLOAT32_IEEE 10000000000 Compu_IDENTITY -10000000000 10000000000 PHYS_UNIT "ms" /end CHARACTERISTIC
/begin CHARACTERISTIC FPfl_SPKD_coil_fail "FPrm_latch(226)" VALUE 0x001E03A0 /* @ECU_Address@FPrm_latch@0x021BB388@ */ ECIPP_ALIGNMENT_FLOAT32_IEEE 10000000000 Compu_IDENTITY -10000000000 10000000000 PHYS_UNIT "sparks" /end CHARACTERISTIC
/begin CHARACTERISTIC FPfl_SPKD_dw_hi "FPrm_latch(56)" VALUE 0x001E00F8 /* @ECU_Address@FPrm_latch@0x021BB0E0@ */ ECIPP_ALIGNMENT_FLOAT32_IEEE 10000000000 Compu_IDENTITY -10000000000 10000000000 PHYS_UNIT "sparks" /end CHARACTERISTIC
/begin CHARACTERISTIC FPfl_SPKD_dw_lo "FPrm_latch(55)" VALUE 0x001E00F4 /* @ECU_Address@FPrm_latch@0x021BB0DC@ */ ECIPP_ALIGNMENT_FLOAT32_IEEE 10000000000 Compu_IDENTITY -10000000000 10000000000 PHYS_UNIT "sparks" /end CHARACTERISTIC
/begin CHARACTERISTIC FPfl_SRVC_expired "FPrm_latch(323)" VALUE 0x001E0524 /* @ECU_Address@FPrm_latch@0x021BB50C@ */ ECIPP_ALIGNMENT_FLOAT32_IEEE 10000000000 Compu_IDENTITY -10000000000 10000000000 PHYS_UNIT "ms" /end CHARACTERISTIC
/begin CHARACTERISTIC FPfl_SRVC_expired2 "FPrm_latch(663)" VALUE 0x001E0A74 /* @ECU_Address@FPrm_latch@0x021BBA5C@ */ ECIPP_ALIGNMENT_FLOAT32_IEEE 10000000000 Compu_IDENTITY -10000000000 10000000000 PHYS_UNIT "ms" /end CHARACTERISTIC
/begin CHARACTERISTIC FPfl_start_coilopen "FPrm_latch(122)" VALUE 0x001E0200 /* @ECU_Address@FPrm_latch@0x021BB1E8@ */ ECIPP_ALIGNMENT_FLOAT32_IEEE 10000000000 Compu_IDENTITY -10000000000 10000000000 PHYS_UNIT "samples" /end CHARACTERISTIC
/begin CHARACTERISTIC FPfu_PWM17_off_loVf "FPrm_unlatch(344)" VALUE 0x001E10C0 /* @ECU_Address@FPrm_unlatch@0x021BD560@ */ ECIPP_ALIGNMENT_FLOAT32_IEEE 10000000000 Compu_IDENTITY -10000000000 10000000000 PHYS_UNIT "ms" /end CHARACTERISTIC
/begin CHARACTERISTIC FPfu_PWM17_on_hiVf "FPrm_unlatch(345)" VALUE 0x001E10C4 /* @ECU_Address@FPrm_unlatch@0x021BD564@ */ ECIPP_ALIGNMENT_FLOAT32_IEEE 10000000000 Compu_IDENTITY -10000000000 10000000000 PHYS_UNIT "ms" /end CHARACTERISTIC
/begin CHARACTERISTIC FPfu_PWM18_off_loVf "FPrm_unlatch(346)" VALUE 0x001E10C8 /* @ECU_Address@FPrm_unlatch@0x021BD568@ */ ECIPP_ALIGNMENT_FLOAT32_IEEE 10000000000 Compu_IDENTITY -10000000000 10000000000 PHYS_UNIT "ms" /end CHARACTERISTIC
/begin CHARACTERISTIC FPfu_PWM18_on_hiVf "FPrm_unlatch(347)" VALUE 0x001E10CC /* @ECU_Address@FPrm_unlatch@0x021BD56C@ */ ECIPP_ALIGNMENT_FLOAT32_IEEE 10000000000 Compu_IDENTITY -10000000000 10000000000 PHYS_UNIT "ms" /end CHARACTERISTIC
/begin CHARACTERISTIC FPfu_PWM19_off_loVf "FPrm_unlatch(348)" VALUE 0x001E10D0 /* @ECU_Address@FPrm_unlatch@0x021BD570@ */ ECIPP_ALIGNMENT_FLOAT32_IEEE 10000000000 Compu_IDENTITY -10000000000 10000000000 PHYS_UNIT "ms" /end CHARACTERISTIC
/begin CHARACTERISTIC FPfu_PWM19_on_hiVf "FPrm_unlatch(349)" VALUE 0x001E10D4 /* @ECU_Address@FPrm_unlatch@0x021BD574@ */ ECIPP_ALIGNMENT_FLOAT32_IEEE 10000000000 Compu_IDENTITY -10000000000 10000000000 PHYS_UNIT "ms" /end CHARACTERISTIC
/begin CHARACTERISTIC FPfu_PWM2_off_loVf "FPrm_unlatch(149)" VALUE 0x001E0DB4 /* @ECU_Address@FPrm_unlatch@0x021BD254@ */ ECIPP_ALIGNMENT_FLOAT32_IEEE 10000000000 Compu_IDENTITY -10000000000 10000000000 PHYS_UNIT "ms" /end CHARACTERISTIC
/begin CHARACTERISTIC FPfu_PWM2_on_hiVf "FPrm_unlatch(150)" VALUE 0x001E0DB8 /* @ECU_Address@FPrm_unlatch@0x021BD258@ */ ECIPP_ALIGNMENT_FLOAT32_IEEE 10000000000 Compu_IDENTITY -10000000000 10000000000 PHYS_UNIT "ms" /end CHARACTERISTIC
/begin CHARACTERISTIC FPfu_PWM20_off_loVf "FPrm_unlatch(350)" VALUE 0x001E10D8 /* @ECU_Address@FPrm_unlatch@0x021BD578@ */ ECIPP_ALIGNMENT_FLOAT32_IEEE 10000000000 Compu_IDENTITY -10000000000 10000000000 PHYS_UNIT "ms" /end CHARACTERISTIC
/begin CHARACTERISTIC FPfu_PWM20_on_hiVf "FPrm_unlatch(351)" VALUE 0x001E10DC /* @ECU_Address@FPrm_unlatch@0x021BD57C@ */ ECIPP_ALIGNMENT_FLOAT32_IEEE 10000000000 Compu_IDENTITY -10000000000 10000000000 PHYS_UNIT "ms" /end CHARACTERISTIC
/begin CHARACTERISTIC FPfu_PWM21_off_loVf "FPrm_unlatch(352)" VALUE 0x001E10E0 /* @ECU_Address@FPrm_unlatch@0x021BD580@ */ ECIPP_ALIGNMENT_FLOAT32_IEEE 10000000000 Compu_IDENTITY -10000000000 10000000000 PHYS_UNIT "ms" /end CHARACTERISTIC
/begin CHARACTERISTIC FPfu_PWM21_on_hiVf "FPrm_unlatch(353)" VALUE 0x001E10E4 /* @ECU_Address@FPrm_unlatch@0x021BD584@ */ ECIPP_ALIGNMENT_FLOAT32_IEEE 10000000000 Compu_IDENTITY -10000000000 10000000000 PHYS_UNIT "ms" /end CHARACTERISTIC
/begin CHARACTERISTIC FPfu_PWM22_off_loVf "FPrm_unlatch(354)" VALUE 0x001E10E8 /* @ECU_Address@FPrm_unlatch@0x021BD588@ */ ECIPP_ALIGNMENT_FLOAT32_IEEE 10000000000 Compu_IDENTITY -10000000000 10000000000 PHYS_UNIT "ms" /end CHARACTERISTIC
/begin CHARACTERISTIC FPfu_PWM22_on_hiVf "FPrm_unlatch(355)" VALUE 0x001E10EC /* @ECU_Address@FPrm_unlatch@0x021BD58C@ */ ECIPP_ALIGNMENT_FLOAT32_IEEE 10000000000 Compu_IDENTITY -10000000000 10000000000 PHYS_UNIT "ms" /end CHARACTERISTIC
/begin CHARACTERISTIC FPfu_PWM23_off_loVf "FPrm_unlatch(356)" VALUE 0x001E10F0 /* @ECU_Address@FPrm_unlatch@0x021BD590@ */ ECIPP_ALIGNMENT_FLOAT32_IEEE 10000000000 Compu_IDENTITY -10000000000 10000000000 PHYS_UNIT "ms" /end CHARACTERISTIC
/begin CHARACTERISTIC FPfu_PWM23_on_hiVf "FPrm_unlatch(357)" VALUE 0x001E10F4 /* @ECU_Address@FPrm_unlatch@0x021BD594@ */ ECIPP_ALIGNMENT_FLOAT32_IEEE 10000000000 Compu_IDENTITY -10000000000 10000000000 PHYS_UNIT "ms" /end CHARACTERISTIC
/begin CHARACTERISTIC FPfu_PWM3_off_loVf "FPrm_unlatch(151)" VALUE 0x001E0DBC /* @ECU_Address@FPrm_unlatch@0x021BD25C@ */ ECIPP_ALIGNMENT_FLOAT32_IEEE 10000000000 Compu_IDENTITY -10000000000 10000000000 PHYS_UNIT "ms" /end CHARACTERISTIC
/begin CHARACTERISTIC FPfu_PWM3_on_hiVf "FPrm_unlatch(152)" VALUE 0x001E0DC0 /* @ECU_Address@FPrm_unlatch@0x021BD260@ */ ECIPP_ALIGNMENT_FLOAT32_IEEE 10000000000 Compu_IDENTITY -10000000000 10000000000 PHYS_UNIT "ms" /end CHARACTERISTIC
/begin CHARACTERISTIC FPfu_PWM4_off_loVf "FPrm_unlatch(153)" VALUE 0x001E0DC4 /* @ECU_Address@FPrm_unlatch@0x021BD264@ */ ECIPP_ALIGNMENT_FLOAT32_IEEE 10000000000 Compu_IDENTITY -10000000000 10000000000 PHYS_UNIT "ms" /end CHARACTERISTIC
/begin CHARACTERISTIC FPfu_PWM4_on_hiVf "FPrm_unlatch(154)" VALUE 0x001E0DC8 /* @ECU_Address@FPrm_unlatch@0x021BD268@ */ ECIPP_ALIGNMENT_FLOAT32_IEEE 10000000000 Compu_IDENTITY -10000000000 10000000000 PHYS_UNIT "ms" /end CHARACTERISTIC
/begin CHARACTERISTIC FPfu_PWM5_off_loVf "FPrm_unlatch(155)" VALUE 0x001E0DCC /* @ECU_Address@FPrm_unlatch@0x021BD26C@ */ ECIPP_ALIGNMENT_FLOAT32_IEEE 10000000000 Compu_IDENTITY -10000000000 10000000000 PHYS_UNIT "ms" /end CHARACTERISTIC
/begin CHARACTERISTIC FPfu_PWM5_on_hiVf "FPrm_unlatch(156)" VALUE 0x001E0DD0 /* @ECU_Address@FPrm_unlatch@0x021BD270@ */ ECIPP_ALIGNMENT_FLOAT32_IEEE 10000000000 Compu_IDENTITY -10000000000 10000000000 PHYS_UNIT "ms" /end CHARACTERISTIC
/begin CHARACTERISTIC FPfu_PWM6_off_loVf "FPrm_unlatch(198)" VALUE 0x001E0E78 /* @ECU_Address@FPrm_unlatch@0x021BD318@ */ ECIPP_ALIGNMENT_FLOAT32_IEEE 10000000000 Compu_IDENTITY -10000000000 10000000000 PHYS_UNIT "ms" /end CHARACTERISTIC
/begin CHARACTERISTIC FPfu_PWM6_on_hiVf "FPrm_unlatch(199)" VALUE 0x001E0E7C /* @ECU_Address@FPrm_unlatch@0x021BD31C@ */ ECIPP_ALIGNMENT_FLOAT32_IEEE 10000000000 Compu_IDENTITY -10000000000 10000000000 PHYS_UNIT "ms" /end CHARACTERISTIC
/begin CHARACTERISTIC FPfu_PWM7_off_loVf "FPrm_unlatch(200)" VALUE 0x001E0E80 /* @ECU_Address@FPrm_unlatch@0x021BD320@ */ ECIPP_ALIGNMENT_FLOAT32_IEEE 10000000000 Compu_IDENTITY -10000000000 10000000000 PHYS_UNIT "ms" /end CHARACTERISTIC
/begin CHARACTERISTIC FPfu_PWM7_on_hiVf "FPrm_unlatch(201)" VALUE 0x001E0E84 /* @ECU_Address@FPrm_unlatch@0x021BD324@ */ ECIPP_ALIGNMENT_FLOAT32_IEEE 10000000000 Compu_IDENTITY -10000000000 10000000000 PHYS_UNIT "ms" /end CHARACTERISTIC
/begin CHARACTERISTIC FPfu_PWM8_off_loVf "FPrm_unlatch(205)" VALUE 0x001E0E94 /* @ECU_Address@FPrm_unlatch@0x021BD334@ */ ECIPP_ALIGNMENT_FLOAT32_IEEE 10000000000 Compu_IDENTITY -10000000000 10000000000 PHYS_UNIT "ms" /end CHARACTERISTIC
/begin CHARACTERISTIC FPfu_PWM8_on_hiVf "FPrm_unlatch(206)" VALUE 0x001E0E98 /* @ECU_Address@FPrm_unlatch@0x021BD338@ */ ECIPP_ALIGNMENT_FLOAT32_IEEE 10000000000 Compu_IDENTITY -10000000000 10000000000 PHYS_UNIT "ms" /end CHARACTERISTIC
/begin CHARACTERISTIC FPfu_PWM9_off_loVf "FPrm_unlatch(207)" VALUE 0x001E0E9C /* @ECU_Address@FPrm_unlatch@0x021BD33C@ */ ECIPP_ALIGNMENT_FLOAT32_IEEE 10000000000 Compu_IDENTITY -10000000000 10000000000 PHYS_UNIT "ms" /end CHARACTERISTIC
/begin CHARACTERISTIC FPfu_PWM9_on_hiVf "FPrm_unlatch(208)" VALUE 0x001E0EA0 /* @ECU_Address@FPrm_unlatch@0x021BD340@ */ ECIPP_ALIGNMENT_FLOAT32_IEEE 10000000000 Compu_IDENTITY -10000000000 10000000000 PHYS_UNIT "ms" /end CHARACTERISTIC
/begin CHARACTERISTIC FPfu_PWMLO_off_loVf "FPrm_unlatch(391)" VALUE 0x001E117C /* @ECU_Address@FPrm_unlatch@0x021BD61C@ */ ECIPP_ALIGNMENT_FLOAT32_IEEE 10000000000 Compu_IDENTITY -10000000000 10000000000 PHYS_UNIT "ms" /end CHARACTERISTIC
/begin CHARACTERISTIC FPfu_PWMLO_on_hiVf "FPrm_unlatch(392)" VALUE 0x001E1180 /* @ECU_Address@FPrm_unlatch@0x021BD620@ */ ECIPP_ALIGNMENT_FLOAT32_IEEE 10000000000 Compu_IDENTITY -10000000000 10000000000 PHYS_UNIT "ms" /end CHARACTERISTIC
/begin CHARACTERISTIC FPfu_radby_poserr "FPrm_unlatch(697)" VALUE 0x001E1644 /* @ECU_Address@FPrm_unlatch@0x021BDAE4@ */ ECIPP_ALIGNMENT_FLOAT32_IEEE 10000000000 Compu_IDENTITY -10000000000 10000000000 PHYS_UNIT "ms" /end CHARACTERISTIC
/begin CHARACTERISTIC FPfu_RAM_fail "FPrm_unlatch(70)" VALUE 0x001E0C78 /* @ECU_Address@FPrm_unlatch@0x021BD118@ */ ECIPP_ALIGNMENT_FLOAT32_IEEE 10000000000 Compu_IDENTITY -10000000000 10000000000 PHYS_UNIT "ms" /end CHARACTERISTIC
/begin CHARACTERISTIC FPfu_relay_coilopen "FPrm_unlatch(119)" VALUE 0x001E0D3C /* @ECU_Address@FPrm_unlatch@0x021BD1DC@ */ ECIPP_ALIGNMENT_FLOAT32_IEEE 10000000000 Compu_IDENTITY -10000000000 10000000000 PHYS_UNIT "samples" /end CHARACTERISTIC
/begin CHARACTERISTIC FPfu_relay_coilshort "FPrm_unlatch(120)" VALUE 0x001E0D40 /* @ECU_Address@FPrm_unlatch@0x021BD1E0@ */ ECIPP_ALIGNMENT_FLOAT32_IEEE 10000000000 Compu_IDENTITY -10000000000 10000000000 PHYS_UNIT "samples" /end CHARACTERISTIC
/begin CHARACTERISTIC FPfu_relay_gndshort "FPrm_unlatch(118)" VALUE 0x001E0D38 /* @ECU_Address@FPrm_unlatch@0x021BD1D8@ */ ECIPP_ALIGNMENT_FLOAT32_IEEE 10000000000 Compu_IDENTITY -10000000000 10000000000 PHYS_UNIT "samples" /end CHARACTERISTIC
/begin CHARACTERISTIC FPfu_relayoff_hiV "FPrm_unlatch(328)" VALUE 0x001E1080 /* @ECU_Address@FPrm_unlatch@0x021BD520@ */ ECIPP_ALIGNMENT_FLOAT32_IEEE 10000000000 Compu_IDENTITY -10000000000 10000000000 PHYS_UNIT "ms" /end CHARACTERISTIC
/begin CHARACTERISTIC FPfu_relayon_loV "FPrm_unlatch(329)" VALUE 0x001E1084 /* @ECU_Address@FPrm_unlatch@0x021BD524@ */ ECIPP_ALIGNMENT_FLOAT32_IEEE 10000000000 Compu_IDENTITY -10000000000 10000000000 PHYS_UNIT "ms" /end CHARACTERISTIC
/begin CHARACTERISTIC FPfu_rpm_hi_expected "FPrm_unlatch(260)" VALUE 0x001E0F70 /* @ECU_Address@FPrm_unlatch@0x021BD410@ */ ECIPP_ALIGNMENT_FLOAT32_IEEE 10000000000 Compu_IDENTITY -10000000000 10000000000 PHYS_UNIT "ms" /end CHARACTERISTIC
/begin CHARACTERISTIC FPfu_rpmd_gov_lo "FPrm_unlatch(390)" VALUE 0x001E1178 /* @ECU_Address@FPrm_unlatch@0x021BD618@ */ ECIPP_ALIGNMENT_FLOAT32_IEEE 10000000000 Compu_IDENTITY -10000000000 10000000000 PHYS_UNIT "ms" /end CHARACTERISTIC
/begin CHARACTERISTIC FPfu_RS_discon "FPrm_unlatch(521)" VALUE 0x001E1384 /* @ECU_Address@FPrm_unlatch@0x021BD824@ */ ECIPP_ALIGNMENT_FLOAT32_IEEE 10000000000 Compu_IDENTITY -10000000000 10000000000 PHYS_UNIT "samples" /end CHARACTERISTIC
/begin CHARACTERISTIC FPfu_RS_hiV "FPrm_unlatch(453)" VALUE 0x001E1274 /* @ECU_Address@FPrm_unlatch@0x021BD714@ */ ECIPP_ALIGNMENT_FLOAT32_IEEE 10000000000 Compu_IDENTITY -10000000000 10000000000 PHYS_UNIT "ms" /end CHARACTERISTIC
/begin CHARACTERISTIC FPfu_RS_loss "FPrm_unlatch(176)" VALUE 0x001E0E20 /* @ECU_Address@FPrm_unlatch@0x021BD2C0@ */ ECIPP_ALIGNMENT_FLOAT32_IEEE 10000000000 Compu_IDENTITY -10000000000 10000000000 PHYS_UNIT "ms" /end CHARACTERISTIC
/begin CHARACTERISTIC FPfu_RS_loV "FPrm_unlatch(452)" VALUE 0x001E1270 /* @ECU_Address@FPrm_unlatch@0x021BD710@ */ ECIPP_ALIGNMENT_FLOAT32_IEEE 10000000000 Compu_IDENTITY -10000000000 10000000000 PHYS_UNIT "ms" /end CHARACTERISTIC
/begin CHARACTERISTIC FPfu_RS485_bad_fmt "FPrm_unlatch(83)" VALUE 0x001E0CAC /* @ECU_Address@FPrm_unlatch@0x021BD14C@ */ ECIPP_ALIGNMENT_FLOAT32_IEEE 10000000000 Compu_IDENTITY -10000000000 10000000000 PHYS_UNIT "packets" /end CHARACTERISTIC
/begin CHARACTERISTIC FPfu_RS485_Rx_inact "FPrm_unlatch(81)" VALUE 0x001E0CA4 /* @ECU_Address@FPrm_unlatch@0x021BD144@ */ ECIPP_ALIGNMENT_FLOAT32_IEEE 10000000000 Compu_IDENTITY -10000000000 10000000000 PHYS_UNIT "ms" /end CHARACTERISTIC
/begin CHARACTERISTIC FPfu_RS485_Rx_noise "FPrm_unlatch(82)" VALUE 0x001E0CA8 /* @ECU_Address@FPrm_unlatch@0x021BD148@ */ ECIPP_ALIGNMENT_FLOAT32_IEEE 10000000000 Compu_IDENTITY -10000000000 10000000000 PHYS_UNIT "packets" /end CHARACTERISTIC
/begin CHARACTERISTIC FPfu_RS485_SD_rq "FPrm_unlatch(84)" VALUE 0x001E0CB0 /* @ECU_Address@FPrm_unlatch@0x021BD150@ */ ECIPP_ALIGNMENT_FLOAT32_IEEE 10000000000 Compu_IDENTITY -10000000000 10000000000 PHYS_UNIT "ms" /end CHARACTERISTIC
/begin CHARACTERISTIC FPfu_RTI1 "FPrm_unlatch(64)" VALUE 0x001E0C60 /* @ECU_Address@FPrm_unlatch@0x021BD100@ */ ECIPP_ALIGNMENT_FLOAT32_IEEE 10000000000 Compu_IDENTITY -10000000000 10000000000 PHYS_UNIT "ms" /end CHARACTERISTIC
/begin CHARACTERISTIC FPfu_RTI2 "FPrm_unlatch(65)" VALUE 0x001E0C64 /* @ECU_Address@FPrm_unlatch@0x021BD104@ */ ECIPP_ALIGNMENT_FLOAT32_IEEE 10000000000 Compu_IDENTITY -10000000000 10000000000 PHYS_UNIT "ms" /end CHARACTERISTIC
/begin CHARACTERISTIC FPfu_RTI3 "FPrm_unlatch(66)" VALUE 0x001E0C68 /* @ECU_Address@FPrm_unlatch@0x021BD108@ */ ECIPP_ALIGNMENT_FLOAT32_IEEE 10000000000 Compu_IDENTITY -10000000000 10000000000 PHYS_UNIT "ms" /end CHARACTERISTIC
/begin CHARACTERISTIC FPfu_Sec1_31KV_open "FPrm_unlatch(707)" VALUE 0x001E166C /* @ECU_Address@FPrm_unlatch@0x021BDB0C@ */ ECIPP_ALIGNMENT_FLOAT32_IEEE 10000000000 Compu_IDENTITY -10000000000 10000000000 PHYS_UNIT "ms" /end CHARACTERISTIC
/begin CHARACTERISTIC FPfu_Sec1_low "FPrm_unlatch(706)" VALUE 0x001E1668 /* @ECU_Address@FPrm_unlatch@0x021BDB08@ */ ECIPP_ALIGNMENT_FLOAT32_IEEE 10000000000 Compu_IDENTITY -10000000000 10000000000 PHYS_UNIT "ms" /end CHARACTERISTIC
/begin CHARACTERISTIC FPfu_Sec1_open "FPrm_unlatch(705)" VALUE 0x001E1664 /* @ECU_Address@FPrm_unlatch@0x021BDB04@ */ ECIPP_ALIGNMENT_FLOAT32_IEEE 10000000000 Compu_IDENTITY -10000000000 10000000000 PHYS_UNIT "ms" /end CHARACTERISTIC
/begin CHARACTERISTIC FPfu_SHIFT_FB_OOR "FPrm_unlatch(216)" VALUE 0x001E0EC0 /* @ECU_Address@FPrm_unlatch@0x021BD360@ */ ECIPP_ALIGNMENT_FLOAT32_IEEE 10000000000 Compu_IDENTITY -10000000000 10000000000 PHYS_UNIT "ms" /end CHARACTERISTIC
/begin CHARACTERISTIC FPfu_SHIFT_intcirc_fail "FPrm_unlatch(218)" VALUE 0x001E0EC8 /* @ECU_Address@FPrm_unlatch@0x021BD368@ */ ECIPP_ALIGNMENT_FLOAT32_IEEE 10000000000 Compu_IDENTITY -10000000000 10000000000 PHYS_UNIT "ms" /end CHARACTERISTIC
/begin CHARACTERISTIC FPfu_SHIFT_shift_fail "FPrm_unlatch(217)" VALUE 0x001E0EC4 /* @ECU_Address@FPrm_unlatch@0x021BD364@ */ ECIPP_ALIGNMENT_FLOAT32_IEEE 10000000000 Compu_IDENTITY -10000000000 10000000000 PHYS_UNIT "ms" /end CHARACTERISTIC
/begin CHARACTERISTIC FPfu_SL_fuel "FPrm_unlatch(38)" VALUE 0x001E0BF8 /* @ECU_Address@FPrm_unlatch@0x021BD098@ */ ECIPP_ALIGNMENT_FLOAT32_IEEE 10000000000 Compu_IDENTITY -10000000000 10000000000 PHYS_UNIT "ms" /end CHARACTERISTIC
/begin CHARACTERISTIC FPfu_SL_gov "FPrm_unlatch(37)" VALUE 0x001E0BF4 /* @ECU_Address@FPrm_unlatch@0x021BD094@ */ ECIPP_ALIGNMENT_FLOAT32_IEEE 10000000000 Compu_IDENTITY -10000000000 10000000000 PHYS_UNIT "ms" /end CHARACTERISTIC
/begin CHARACTERISTIC FPfu_SL_spk "FPrm_unlatch(39)" VALUE 0x001E0BFC /* @ECU_Address@FPrm_unlatch@0x021BD09C@ */ ECIPP_ALIGNMENT_FLOAT32_IEEE 10000000000 Compu_IDENTITY -10000000000 10000000000 PHYS_UNIT "ms" /end CHARACTERISTIC
/begin CHARACTERISTIC FPfu_slv_MAP_hi_OOA "FPrm_unlatch(664)" VALUE 0x001E15C0 /* @ECU_Address@FPrm_unlatch@0x021BDA60@ */ ECIPP_ALIGNMENT_FLOAT32_IEEE 10000000000 Compu_IDENTITY -10000000000 10000000000 PHYS_UNIT "ms" /end CHARACTERISTIC
/begin CHARACTERISTIC FPfu_slv_MAP_lo_OOA "FPrm_unlatch(665)" VALUE 0x001E15C4 /* @ECU_Address@FPrm_unlatch@0x021BDA64@ */ ECIPP_ALIGNMENT_FLOAT32_IEEE 10000000000 Compu_IDENTITY -10000000000 10000000000 PHYS_UNIT "ms" /end CHARACTERISTIC
/begin CHARACTERISTIC FPfu_SPK_int_fail "FPrm_unlatch(225)" VALUE 0x001E0EE4 /* @ECU_Address@FPrm_unlatch@0x021BD384@ */ ECIPP_ALIGNMENT_FLOAT32_IEEE 10000000000 Compu_IDENTITY -10000000000 10000000000 PHYS_UNIT "sparks" /end CHARACTERISTIC
/begin CHARACTERISTIC FPfu_SPK1_IGBT_T "FPrm_unlatch(388)" VALUE 0x001E1170 /* @ECU_Address@FPrm_unlatch@0x021BD610@ */ ECIPP_ALIGNMENT_FLOAT32_IEEE 10000000000 Compu_IDENTITY -10000000000 10000000000 PHYS_UNIT "ms" /end CHARACTERISTIC
/begin CHARACTERISTIC FPfu_SPKD_coil_fail "FPrm_unlatch(226)" VALUE 0x001E0EE8 /* @ECU_Address@FPrm_unlatch@0x021BD388@ */ ECIPP_ALIGNMENT_FLOAT32_IEEE 10000000000 Compu_IDENTITY -10000000000 10000000000 PHYS_UNIT "sparks" /end CHARACTERISTIC
/begin CHARACTERISTIC FPfu_SPKD_dw_hi "FPrm_unlatch(56)" VALUE 0x001E0C40 /* @ECU_Address@FPrm_unlatch@0x021BD0E0@ */ ECIPP_ALIGNMENT_FLOAT32_IEEE 10000000000 Compu_IDENTITY -10000000000 10000000000 PHYS_UNIT "sparks" /end CHARACTERISTIC
/begin CHARACTERISTIC FPfu_SPKD_dw_lo "FPrm_unlatch(55)" VALUE 0x001E0C3C /* @ECU_Address@FPrm_unlatch@0x021BD0DC@ */ ECIPP_ALIGNMENT_FLOAT32_IEEE 10000000000 Compu_IDENTITY -10000000000 10000000000 PHYS_UNIT "sparks" /end CHARACTERISTIC
/begin CHARACTERISTIC FPfu_SRVC_expired "FPrm_unlatch(323)" VALUE 0x001E106C /* @ECU_Address@FPrm_unlatch@0x021BD50C@ */ ECIPP_ALIGNMENT_FLOAT32_IEEE 10000000000 Compu_IDENTITY -10000000000 10000000000 PHYS_UNIT "ms" /end CHARACTERISTIC
/begin CHARACTERISTIC FPfu_SRVC_expired2 "FPrm_unlatch(663)" VALUE 0x001E15BC /* @ECU_Address@FPrm_unlatch@0x021BDA5C@ */ ECIPP_ALIGNMENT_FLOAT32_IEEE 10000000000 Compu_IDENTITY -10000000000 10000000000 PHYS_UNIT "ms" /end CHARACTERISTIC
/begin CHARACTERISTIC FPfu_start_coilopen "FPrm_unlatch(122)" VALUE 0x001E0D48 /* @ECU_Address@FPrm_unlatch@0x021BD1E8@ */ ECIPP_ALIGNMENT_FLOAT32_IEEE 10000000000 Compu_IDENTITY -10000000000 10000000000 PHYS_UNIT "samples" /end CHARACTERISTIC
/begin GROUP PWM17_off_loVf_EC_Fault "PWM17 open / ground short"
 /begin REF_CHARACTERISTIC FCdc4_PWM17_off_loVf FCdtc_PWM17_off_loVf FCfmi_PWM17_off_loVf FCftb_PWM17_off_loVf FCspn_PWM17_off_loVf FPfl_PWM17_off_loVf FPfu_PWM17_off_loVf FPnd_PWM17_off_loVf FPsvr_PWM17_off_loVf FPsw_ext1_PWM17_off_loVf FPsw_PWM17_off_loVf /end REF_CHARACTERISTIC
/end GROUP
/begin GROUP PWM17_on_hiVf_EC_Fault "PWM17 short to power"
 /begin REF_CHARACTERISTIC FCdc4_PWM17_on_hiVf FCdtc_PWM17_on_hiVf FCfmi_PWM17_on_hiVf FCftb_PWM17_on_hiVf FCspn_PWM17_on_hiVf FPfl_PWM17_on_hiVf FPfu_PWM17_on_hiVf FPnd_PWM17_on_hiVf FPsvr_PWM17_on_hiVf FPsw_ext1_PWM17_on_hiVf FPsw_PWM17_on_hiVf /end REF_CHARACTERISTIC
/end GROUP
/begin GROUP PWM18_off_loVf_EC_Fault "PWM18 open / ground short"
 /begin REF_CHARACTERISTIC FCdc4_PWM18_off_loVf FCdtc_PWM18_off_loVf FCfmi_PWM18_off_loVf FCftb_PWM18_off_loVf FCspn_PWM18_off_loVf FPfl_PWM18_off_loVf FPfu_PWM18_off_loVf FPnd_PWM18_off_loVf FPsvr_PWM18_off_loVf FPsw_ext1_PWM18_off_loVf FPsw_PWM18_off_loVf /end REF_CHARACTERISTIC
/end GROUP
/begin GROUP PWM18_on_hiVf_EC_Fault "PWM18 short to power"
 /begin REF_CHARACTERISTIC FCdc4_PWM18_on_hiVf FCdtc_PWM18_on_hiVf FCfmi_PWM18_on_hiVf FCftb_PWM18_on_hiVf FCspn_PWM18_on_hiVf FPfl_PWM18_on_hiVf FPfu_PWM18_on_hiVf FPnd_PWM18_on_hiVf FPsvr_PWM18_on_hiVf FPsw_ext1_PWM18_on_hiVf FPsw_PWM18_on_hiVf /end REF_CHARACTERISTIC
/end GROUP
/begin GROUP PWM19_off_loVf_EC_Fault "PWM19 open / ground short"
 /begin REF_CHARACTERISTIC FCdc4_PWM19_off_loVf FCdtc_PWM19_off_loVf FCfmi_PWM19_off_loVf FCftb_PWM19_off_loVf FCspn_PWM19_off_loVf FPfl_PWM19_off_loVf FPfu_PWM19_off_loVf FPnd_PWM19_off_loVf FPsvr_PWM19_off_loVf FPsw_ext1_PWM19_off_loVf FPsw_PWM19_off_loVf /end REF_CHARACTERISTIC
/end GROUP
/begin GROUP PWM19_on_hiVf_EC_Fault "PWM19 short to power"
 /begin REF_CHARACTERISTIC FCdc4_PWM19_on_hiVf FCdtc_PWM19_on_hiVf FCfmi_PWM19_on_hiVf FCftb_PWM19_on_hiVf FCspn_PWM19_on_hiVf FPfl_PWM19_on_hiVf FPfu_PWM19_on_hiVf FPnd_PWM19_on_hiVf FPsvr_PWM19_on_hiVf FPsw_ext1_PWM19_on_hiVf FPsw_PWM19_on_hiVf /end REF_CHARACTERISTIC
/end GROUP
/begin GROUP PWM2_off_loVf_EC_Fault "PWM2-Gauge2 open / ground short"
 /begin REF_CHARACTERISTIC FCdc4_PWM2_off_loVf FCdtc_PWM2_off_loVf FCfmi_PWM2_off_loVf FCftb_PWM2_off_loVf FCspn_PWM2_off_loVf FPfl_PWM2_off_loVf FPfu_PWM2_off_loVf FPnd_PWM2_off_loVf FPsvr_PWM2_off_loVf FPsw_ext1_PWM2_off_loVf FPsw_PWM2_off_loVf /end REF_CHARACTERISTIC
/end GROUP
/begin GROUP PWM2_on_hiVf_EC_Fault "PWM2-Gauge2 short to power"
 /begin REF_CHARACTERISTIC FCdc4_PWM2_on_hiVf FCdtc_PWM2_on_hiVf FCfmi_PWM2_on_hiVf FCftb_PWM2_on_hiVf FCspn_PWM2_on_hiVf FPfl_PWM2_on_hiVf FPfu_PWM2_on_hiVf FPnd_PWM2_on_hiVf FPsvr_PWM2_on_hiVf FPsw_ext1_PWM2_on_hiVf FPsw_PWM2_on_hiVf /end REF_CHARACTERISTIC
/end GROUP
/begin GROUP PWM20_off_loVf_EC_Fault "PWM20 open / ground short"
 /begin REF_CHARACTERISTIC FCdc4_PWM20_off_loVf FCdtc_PWM20_off_loVf FCfmi_PWM20_off_loVf FCftb_PWM20_off_loVf FCspn_PWM20_off_loVf FPfl_PWM20_off_loVf FPfu_PWM20_off_loVf FPnd_PWM20_off_loVf FPsvr_PWM20_off_loVf FPsw_ext1_PWM20_off_loVf FPsw_PWM20_off_loVf /end REF_CHARACTERISTIC
/end GROUP
/begin GROUP PWM20_on_hiVf_EC_Fault "PWM20 short to power"
 /begin REF_CHARACTERISTIC FCdc4_PWM20_on_hiVf FCdtc_PWM20_on_hiVf FCfmi_PWM20_on_hiVf FCftb_PWM20_on_hiVf FCspn_PWM20_on_hiVf FPfl_PWM20_on_hiVf FPfu_PWM20_on_hiVf FPnd_PWM20_on_hiVf FPsvr_PWM20_on_hiVf FPsw_ext1_PWM20_on_hiVf FPsw_PWM20_on_hiVf /end REF_CHARACTERISTIC
/end GROUP
/begin GROUP PWM21_off_loVf_EC_Fault "PWM21 open / ground short"
 /begin REF_CHARACTERISTIC FCdc4_PWM21_off_loVf FCdtc_PWM21_off_loVf FCfmi_PWM21_off_loVf FCftb_PWM21_off_loVf FCspn_PWM21_off_loVf FPfl_PWM21_off_loVf FPfu_PWM21_off_loVf FPnd_PWM21_off_loVf FPsvr_PWM21_off_loVf FPsw_ext1_PWM21_off_loVf FPsw_PWM21_off_loVf /end REF_CHARACTERISTIC
/end GROUP
/begin GROUP PWM21_on_hiVf_EC_Fault "PWM21 short to power"
 /begin REF_CHARACTERISTIC FCdc4_PWM21_on_hiVf FCdtc_PWM21_on_hiVf FCfmi_PWM21_on_hiVf FCftb_PWM21_on_hiVf FCspn_PWM21_on_hiVf FPfl_PWM21_on_hiVf FPfu_PWM21_on_hiVf FPnd_PWM21_on_hiVf FPsvr_PWM21_on_hiVf FPsw_ext1_PWM21_on_hiVf FPsw_PWM21_on_hiVf /end REF_CHARACTERISTIC
/end GROUP
/begin GROUP PWM22_off_loVf_EC_Fault "PWM22 open / ground short"
 /begin REF_CHARACTERISTIC FCdc4_PWM22_off_loVf FCdtc_PWM22_off_loVf FCfmi_PWM22_off_loVf FCftb_PWM22_off_loVf FCspn_PWM22_off_loVf FPfl_PWM22_off_loVf FPfu_PWM22_off_loVf FPnd_PWM22_off_loVf FPsvr_PWM22_off_loVf FPsw_ext1_PWM22_off_loVf FPsw_PWM22_off_loVf /end REF_CHARACTERISTIC
/end GROUP
/begin GROUP PWM22_on_hiVf_EC_Fault "PWM22 short to power"
 /begin REF_CHARACTERISTIC FCdc4_PWM22_on_hiVf FCdtc_PWM22_on_hiVf FCfmi_PWM22_on_hiVf FCftb_PWM22_on_hiVf FCspn_PWM22_on_hiVf FPfl_PWM22_on_hiVf FPfu_PWM22_on_hiVf FPnd_PWM22_on_hiVf FPsvr_PWM22_on_hiVf FPsw_ext1_PWM22_on_hiVf FPsw_PWM22_on_hiVf /end REF_CHARACTERISTIC
/end GROUP
/begin GROUP PWM23_off_loVf_EC_Fault "PWM23 open / ground short"
 /begin REF_CHARACTERISTIC FCdc4_PWM23_off_loVf FCdtc_PWM23_off_loVf FCfmi_PWM23_off_loVf FCftb_PWM23_off_loVf FCspn_PWM23_off_loVf FPfl_PWM23_off_loVf FPfu_PWM23_off_loVf FPnd_PWM23_off_loVf FPsvr_PWM23_off_loVf FPsw_ext1_PWM23_off_loVf FPsw_PWM23_off_loVf /end REF_CHARACTERISTIC
/end GROUP
/begin GROUP PWM23_on_hiVf_EC_Fault "PWM23 short to power"
 /begin REF_CHARACTERISTIC FCdc4_PWM23_on_hiVf FCdtc_PWM23_on_hiVf FCfmi_PWM23_on_hiVf FCftb_PWM23_on_hiVf FCspn_PWM23_on_hiVf FPfl_PWM23_on_hiVf FPfu_PWM23_on_hiVf FPnd_PWM23_on_hiVf FPsvr_PWM23_on_hiVf FPsw_ext1_PWM23_on_hiVf FPsw_PWM23_on_hiVf /end REF_CHARACTERISTIC
/end GROUP
/begin GROUP PWM3_off_loVf_EC_Fault "PWM3-Gauge3 open / ground short"
 /begin REF_CHARACTERISTIC FCdc4_PWM3_off_loVf FCdtc_PWM3_off_loVf FCfmi_PWM3_off_loVf FCftb_PWM3_off_loVf FCspn_PWM3_off_loVf FPfl_PWM3_off_loVf FPfu_PWM3_off_loVf FPnd_PWM3_off_loVf FPsvr_PWM3_off_loVf FPsw_ext1_PWM3_off_loVf FPsw_PWM3_off_loVf /end REF_CHARACTERISTIC
/end GROUP
/begin GROUP PWM3_on_hiVf_EC_Fault "PWM3-Gauge3 short to power"
 /begin REF_CHARACTERISTIC FCdc4_PWM3_on_hiVf FCdtc_PWM3_on_hiVf FCfmi_PWM3_on_hiVf FCftb_PWM3_on_hiVf FCspn_PWM3_on_hiVf FPfl_PWM3_on_hiVf FPfu_PWM3_on_hiVf FPnd_PWM3_on_hiVf FPsvr_PWM3_on_hiVf FPsw_ext1_PWM3_on_hiVf FPsw_PWM3_on_hiVf /end REF_CHARACTERISTIC
/end GROUP
/begin GROUP PWM4_off_loVf_EC_Fault "PWM4-Gauge4 open / ground short"
 /begin REF_CHARACTERISTIC FCdc4_PWM4_off_loVf FCdtc_PWM4_off_loVf FCfmi_PWM4_off_loVf FCftb_PWM4_off_loVf FCspn_PWM4_off_loVf FPfl_PWM4_off_loVf FPfu_PWM4_off_loVf FPnd_PWM4_off_loVf FPsvr_PWM4_off_loVf FPsw_ext1_PWM4_off_loVf FPsw_PWM4_off_loVf /end REF_CHARACTERISTIC
/end GROUP
/begin GROUP PWM4_on_hiVf_EC_Fault "PWM4-Gauge4 short to power"
 /begin REF_CHARACTERISTIC FCdc4_PWM4_on_hiVf FCdtc_PWM4_on_hiVf FCfmi_PWM4_on_hiVf FCftb_PWM4_on_hiVf FCspn_PWM4_on_hiVf FPfl_PWM4_on_hiVf FPfu_PWM4_on_hiVf FPnd_PWM4_on_hiVf FPsvr_PWM4_on_hiVf FPsw_ext1_PWM4_on_hiVf FPsw_PWM4_on_hiVf /end REF_CHARACTERISTIC
/end GROUP
/begin GROUP PWM5_off_loVf_EC_Fault "PWM5 open / ground short"
 /begin REF_CHARACTERISTIC FCdc4_PWM5_off_loVf FCdtc_PWM5_off_loVf FCfmi_PWM5_off_loVf FCftb_PWM5_off_loVf FCspn_PWM5_off_loVf FPfl_PWM5_off_loVf FPfu_PWM5_off_loVf FPnd_PWM5_off_loVf FPsvr_PWM5_off_loVf FPsw_ext1_PWM5_off_loVf FPsw_PWM5_off_loVf /end REF_CHARACTERISTIC
/end GROUP
/begin GROUP PWM5_on_hiVf_EC_Fault "PWM5 short to power"
 /begin REF_CHARACTERISTIC FCdc4_PWM5_on_hiVf FCdtc_PWM5_on_hiVf FCfmi_PWM5_on_hiVf FCftb_PWM5_on_hiVf FCspn_PWM5_on_hiVf FPfl_PWM5_on_hiVf FPfu_PWM5_on_hiVf FPnd_PWM5_on_hiVf FPsvr_PWM5_on_hiVf FPsw_ext1_PWM5_on_hiVf FPsw_PWM5_on_hiVf /end REF_CHARACTERISTIC
/end GROUP
/begin GROUP PWM6_off_loVf_EC_Fault "PWM6 open / ground short"
 /begin REF_CHARACTERISTIC FCdc4_PWM6_off_loVf FCdtc_PWM6_off_loVf FCfmi_PWM6_off_loVf FCftb_PWM6_off_loVf FCspn_PWM6_off_loVf FPfl_PWM6_off_loVf FPfu_PWM6_off_loVf FPnd_PWM6_off_loVf FPsvr_PWM6_off_loVf FPsw_ext1_PWM6_off_loVf FPsw_PWM6_off_loVf /end REF_CHARACTERISTIC
/end GROUP
/begin GROUP PWM6_on_hiVf_EC_Fault "PWM6 short to power"
 /begin REF_CHARACTERISTIC FCdc4_PWM6_on_hiVf FCdtc_PWM6_on_hiVf FCfmi_PWM6_on_hiVf FCftb_PWM6_on_hiVf FCspn_PWM6_on_hiVf FPfl_PWM6_on_hiVf FPfu_PWM6_on_hiVf FPnd_PWM6_on_hiVf FPsvr_PWM6_on_hiVf FPsw_ext1_PWM6_on_hiVf FPsw_PWM6_on_hiVf /end REF_CHARACTERISTIC
/end GROUP
/begin GROUP PWM7_off_loVf_EC_Fault "PWM7 open / ground short"
 /begin REF_CHARACTERISTIC FCdc4_PWM7_off_loVf FCdtc_PWM7_off_loVf FCfmi_PWM7_off_loVf FCftb_PWM7_off_loVf FCspn_PWM7_off_loVf FPfl_PWM7_off_loVf FPfu_PWM7_off_loVf FPnd_PWM7_off_loVf FPsvr_PWM7_off_loVf FPsw_ext1_PWM7_off_loVf FPsw_PWM7_off_loVf /end REF_CHARACTERISTIC
/end GROUP
/begin GROUP PWM7_on_hiVf_EC_Fault "PWM7 short to power"
 /begin REF_CHARACTERISTIC FCdc4_PWM7_on_hiVf FCdtc_PWM7_on_hiVf FCfmi_PWM7_on_hiVf FCftb_PWM7_on_hiVf FCspn_PWM7_on_hiVf FPfl_PWM7_on_hiVf FPfu_PWM7_on_hiVf FPnd_PWM7_on_hiVf FPsvr_PWM7_on_hiVf FPsw_ext1_PWM7_on_hiVf FPsw_PWM7_on_hiVf /end REF_CHARACTERISTIC
/end GROUP
/begin GROUP PWM8_off_loVf_EC_Fault "PWM8 open / ground short"
 /begin REF_CHARACTERISTIC FCdc4_PWM8_off_loVf FCdtc_PWM8_off_loVf FCfmi_PWM8_off_loVf FCftb_PWM8_off_loVf FCspn_PWM8_off_loVf FPfl_PWM8_off_loVf FPfu_PWM8_off_loVf FPnd_PWM8_off_loVf FPsvr_PWM8_off_loVf FPsw_ext1_PWM8_off_loVf FPsw_PWM8_off_loVf /end REF_CHARACTERISTIC
/end GROUP
/begin GROUP PWM8_on_hiVf_EC_Fault "PWM8 short to power"
 /begin REF_CHARACTERISTIC FCdc4_PWM8_on_hiVf FCdtc_PWM8_on_hiVf FCfmi_PWM8_on_hiVf FCftb_PWM8_on_hiVf FCspn_PWM8_on_hiVf FPfl_PWM8_on_hiVf FPfu_PWM8_on_hiVf FPnd_PWM8_on_hiVf FPsvr_PWM8_on_hiVf FPsw_ext1_PWM8_on_hiVf FPsw_PWM8_on_hiVf /end REF_CHARACTERISTIC
/end GROUP
/begin GROUP PWM9_off_loVf_EC_Fault "PWM9 open / ground short"
 /begin REF_CHARACTERISTIC FCdc4_PWM9_off_loVf FCdtc_PWM9_off_loVf FCfmi_PWM9_off_loVf FCftb_PWM9_off_loVf FCspn_PWM9_off_loVf FPfl_PWM9_off_loVf FPfu_PWM9_off_loVf FPnd_PWM9_off_loVf FPsvr_PWM9_off_loVf FPsw_ext1_PWM9_off_loVf FPsw_PWM9_off_loVf /end REF_CHARACTERISTIC
/end GROUP
/begin GROUP PWM9_on_hiVf_EC_Fault "PWM9 short to power"
 /begin REF_CHARACTERISTIC FCdc4_PWM9_on_hiVf FCdtc_PWM9_on_hiVf FCfmi_PWM9_on_hiVf FCftb_PWM9_on_hiVf FCspn_PWM9_on_hiVf FPfl_PWM9_on_hiVf FPfu_PWM9_on_hiVf FPnd_PWM9_on_hiVf FPsvr_PWM9_on_hiVf FPsw_ext1_PWM9_on_hiVf FPsw_PWM9_on_hiVf /end REF_CHARACTERISTIC
/end GROUP
/begin GROUP PWMLO_off_loVf_EC_Fault "Lockoff open / ground short"
 /begin REF_CHARACTERISTIC FCdc4_PWMLO_off_loVf FCdtc_PWMLO_off_loVf FCfmi_PWMLO_off_loVf FCftb_PWMLO_off_loVf FCspn_PWMLO_off_loVf FPfl_PWMLO_off_loVf FPfu_PWMLO_off_loVf FPnd_PWMLO_off_loVf FPsvr_PWMLO_off_loVf FPsw_ext1_PWMLO_off_loVf FPsw_PWMLO_off_loVf /end REF_CHARACTERISTIC
/end GROUP
/begin GROUP PWMLO_on_hiVf_EC_Fault "Lockoff short to power"
 /begin REF_CHARACTERISTIC FCdc4_PWMLO_on_hiVf FCdtc_PWMLO_on_hiVf FCfmi_PWMLO_on_hiVf FCftb_PWMLO_on_hiVf FCspn_PWMLO_on_hiVf FPfl_PWMLO_on_hiVf FPfu_PWMLO_on_hiVf FPnd_PWMLO_on_hiVf FPsvr_PWMLO_on_hiVf FPsw_ext1_PWMLO_on_hiVf FPsw_PWMLO_on_hiVf /end REF_CHARACTERISTIC
/end GROUP
/begin GROUP radby_poserr_EC_Fault "Unable to reach radiator bypass valve target position"
 /begin REF_CHARACTERISTIC FCdc4_radby_poserr FCdtc_radby_poserr FCfmi_radby_poserr FCftb_radby_poserr FCspn_radby_poserr FPfl_radby_poserr FPfu_radby_poserr FPnd_radby_poserr FPsvr_radby_poserr FPsw_ext1_radby_poserr FPsw_radby_poserr /end REF_CHARACTERISTIC
/end GROUP
/begin GROUP RAM_fail_EC_Fault "RAM failure"
 /begin REF_CHARACTERISTIC FCdc4_RAM_fail FCdtc_RAM_fail FCfmi_RAM_fail FCftb_RAM_fail FCspn_RAM_fail FPfl_RAM_fail FPfu_RAM_fail FPnd_RAM_fail FPsvr_RAM_fail FPsw_ext1_RAM_fail FPsw_RAM_fail /end REF_CHARACTERISTIC
/end GROUP
/begin GROUP relay_coilopen_EC_Fault "Relay coil open"
 /begin REF_CHARACTERISTIC FCdc4_relay_coilopen FCdtc_relay_coilopen FCfmi_relay_coilopen FCftb_relay_coilopen FCspn_relay_coilopen FPfl_relay_coilopen FPfu_relay_coilopen FPnd_relay_coilopen FPsvr_relay_coilopen FPsw_ext1_relay_coilopen FPsw_relay_coilopen /end REF_CHARACTERISTIC
/end GROUP
/begin GROUP relay_coilshort_EC_Fault "Relay coil short to power"
 /begin REF_CHARACTERISTIC FCdc4_relay_coilshort FCdtc_relay_coilshort FCfmi_relay_coilshort FCftb_relay_coilshort FCspn_relay_coilshort FPfl_relay_coilshort FPfu_relay_coilshort FPnd_relay_coilshort FPsvr_relay_coilshort FPsw_ext1_relay_coilshort FPsw_relay_coilshort /end REF_CHARACTERISTIC
/end GROUP
/begin GROUP relay_gndshort_EC_Fault "Relay control ground short"
 /begin REF_CHARACTERISTIC FCdc4_relay_gndshort FCdtc_relay_gndshort FCfmi_relay_gndshort FCftb_relay_gndshort FCspn_relay_gndshort FPfl_relay_gndshort FPfu_relay_gndshort FPnd_relay_gndshort FPsvr_relay_gndshort FPsw_ext1_relay_gndshort FPsw_relay_gndshort /end REF_CHARACTERISTIC
/end GROUP
/begin GROUP relayoff_hiV_EC_Fault "Relay off high voltage"
 /begin REF_CHARACTERISTIC FCdc4_relayoff_hiV FCdtc_relayoff_hiV FCfmi_relayoff_hiV FCftb_relayoff_hiV FCspn_relayoff_hiV FPfl_relayoff_hiV FPfu_relayoff_hiV FPnd_relayoff_hiV FPsvr_relayoff_hiV FPsw_ext1_relayoff_hiV FPsw_relayoff_hiV /end REF_CHARACTERISTIC
/end GROUP
/begin GROUP relayon_loV_EC_Fault "Relay on low voltage"
 /begin REF_CHARACTERISTIC FCdc4_relayon_loV FCdtc_relayon_loV FCfmi_relayon_loV FCftb_relayon_loV FCspn_relayon_loV FPfl_relayon_loV FPfu_relayon_loV FPnd_relayon_loV FPsvr_relayon_loV FPsw_ext1_relayon_loV FPsw_relayon_loV /end REF_CHARACTERISTIC
/end GROUP
/begin GROUP rpm_hi_expected_EC_Fault "RPM higher than expected"
 /begin REF_CHARACTERISTIC FCdc4_rpm_hi_expected FCdtc_rpm_hi_expected FCfmi_rpm_hi_expected FCftb_rpm_hi_expected FCspn_rpm_hi_expected FPfl_rpm_hi_expected FPfu_rpm_hi_expected FPnd_rpm_hi_expected FPsvr_rpm_hi_expected FPsw_ext1_rpm_hi_expected FPsw_rpm_hi_expected /end REF_CHARACTERISTIC
/end GROUP
/begin GROUP rpmd_gov_lo_EC_Fault "Unable to achieve low target speed"
 /begin REF_CHARACTERISTIC FCdc4_rpmd_gov_lo FCdtc_rpmd_gov_lo FCfmi_rpmd_gov_lo FCftb_rpmd_gov_lo FCspn_rpmd_gov_lo FPfl_rpmd_gov_lo FPfu_rpmd_gov_lo FPnd_rpmd_gov_lo FPsvr_rpmd_gov_lo FPsw_ext1_rpmd_gov_lo FPsw_rpmd_gov_lo /end REF_CHARACTERISTIC
/end GROUP
/begin GROUP RS_discon_EC_Fault "Roadspeed sensor disconnected"
 /begin REF_CHARACTERISTIC FCdc4_RS_discon FCdtc_RS_discon FCfmi_RS_discon FCftb_RS_discon FCspn_RS_discon FPfl_RS_discon FPfu_RS_discon FPnd_RS_discon FPsvr_RS_discon FPsw_ext1_RS_discon FPsw_RS_discon /end REF_CHARACTERISTIC
/end GROUP
/begin GROUP RS_hiV_EC_Fault "Roadspeed open/short to power"
 /begin REF_CHARACTERISTIC FCdc4_RS_hiV FCdtc_RS_hiV FCfmi_RS_hiV FCftb_RS_hiV FCspn_RS_hiV FPfl_RS_hiV FPfu_RS_hiV FPnd_RS_hiV FPsvr_RS_hiV FPsw_ext1_RS_hiV FPsw_RS_hiV /end REF_CHARACTERISTIC
/end GROUP
/begin GROUP RS_loss_EC_Fault "Roadspeed loss"
 /begin REF_CHARACTERISTIC FCdc4_RS_loss FCdtc_RS_loss FCfmi_RS_loss FCftb_RS_loss FCspn_RS_loss FPfl_RS_loss FPfu_RS_loss FPnd_RS_loss FPsvr_RS_loss FPsw_ext1_RS_loss FPsw_RS_loss /end REF_CHARACTERISTIC
/end GROUP
/begin GROUP RS_loV_EC_Fault "Roadspeed short to ground"
 /begin REF_CHARACTERISTIC FCdc4_RS_loV FCdtc_RS_loV FCfmi_RS_loV FCftb_RS_loV FCspn_RS_loV FPfl_RS_loV FPfu_RS_loV FPnd_RS_loV FPsvr_RS_loV FPsw_ext1_RS_loV FPsw_RS_loV /end REF_CHARACTERISTIC
/end GROUP
/begin GROUP RS485_bad_fmt_EC_Fault "Invalid Packet Format"
 /begin REF_CHARACTERISTIC FCdc4_RS485_bad_fmt FCdtc_RS485_bad_fmt FCfmi_RS485_bad_fmt FCftb_RS485_bad_fmt FCspn_RS485_bad_fmt FPfl_RS485_bad_fmt FPfu_RS485_bad_fmt FPnd_RS485_bad_fmt FPsvr_RS485_bad_fmt FPsw_ext1_RS485_bad_fmt FPsw_RS485_bad_fmt /end REF_CHARACTERISTIC
/end GROUP
/begin GROUP RS485_Rx_inact_EC_Fault "Rx Inactive"
 /begin REF_CHARACTERISTIC FCdc4_RS485_Rx_inact FCdtc_RS485_Rx_inact FCfmi_RS485_Rx_inact FCftb_RS485_Rx_inact FCspn_RS485_Rx_inact FPfl_RS485_Rx_inact FPfu_RS485_Rx_inact FPnd_RS485_Rx_inact FPsvr_RS485_Rx_inact FPsw_ext1_RS485_Rx_inact FPsw_RS485_Rx_inact /end REF_CHARACTERISTIC
/end GROUP
/begin GROUP RS485_Rx_noise_EC_Fault "Rx Noise"
 /begin REF_CHARACTERISTIC FCdc4_RS485_Rx_noise FCdtc_RS485_Rx_noise FCfmi_RS485_Rx_noise FCftb_RS485_Rx_noise FCspn_RS485_Rx_noise FPfl_RS485_Rx_noise FPfu_RS485_Rx_noise FPnd_RS485_Rx_noise FPsvr_RS485_Rx_noise FPsw_ext1_RS485_Rx_noise FPsw_RS485_Rx_noise /end REF_CHARACTERISTIC
/end GROUP
/begin GROUP RS485_SD_rq_EC_Fault "Shutdown Request"
 /begin REF_CHARACTERISTIC FCdc4_RS485_SD_rq FCdtc_RS485_SD_rq FCfmi_RS485_SD_rq FCftb_RS485_SD_rq FCspn_RS485_SD_rq FPfl_RS485_SD_rq FPfu_RS485_SD_rq FPnd_RS485_SD_rq FPsvr_RS485_SD_rq FPsw_ext1_RS485_SD_rq FPsw_RS485_SD_rq /end REF_CHARACTERISTIC
/end GROUP
/begin GROUP RTI1_EC_Fault "RTI 1 loss"
 /begin REF_CHARACTERISTIC FCdc4_RTI1 FCdtc_RTI1 FCfmi_RTI1 FCftb_RTI1 FCspn_RTI1 FPfl_RTI1 FPfu_RTI1 FPnd_RTI1 FPsvr_RTI1 FPsw_ext1_RTI1 FPsw_RTI1 /end REF_CHARACTERISTIC
/end GROUP
/begin GROUP RTI2_EC_Fault "RTI 2 loss"
 /begin REF_CHARACTERISTIC FCdc4_RTI2 FCdtc_RTI2 FCfmi_RTI2 FCftb_RTI2 FCspn_RTI2 FPfl_RTI2 FPfu_RTI2 FPnd_RTI2 FPsvr_RTI2 FPsw_ext1_RTI2 FPsw_RTI2 /end REF_CHARACTERISTIC
/end GROUP
/begin GROUP RTI3_EC_Fault "RTI 3 loss"
 /begin REF_CHARACTERISTIC FCdc4_RTI3 FCdtc_RTI3 FCfmi_RTI3 FCftb_RTI3 FCspn_RTI3 FPfl_RTI3 FPfu_RTI3 FPnd_RTI3 FPsvr_RTI3 FPsw_ext1_RTI3 FPsw_RTI3 /end REF_CHARACTERISTIC
/end GROUP
/begin GROUP Sec1_31KV_open_EC_Fault "Spark 1 31KV-Open"
 /begin REF_CHARACTERISTIC FCdc4_Sec1_31KV_open FCdtc_Sec1_31KV_open FCfmi_Sec1_31KV_open FCftb_Sec1_31KV_open FCspn_Sec1_31KV_open FPfl_Sec1_31KV_open FPfu_Sec1_31KV_open FPnd_Sec1_31KV_open FPsvr_Sec1_31KV_open FPsw_ext1_Sec1_31KV_open FPsw_Sec1_31KV_open /end REF_CHARACTERISTIC
/end GROUP
/begin GROUP Sec1_low_EC_Fault "Spark 1 <5KV"
 /begin REF_CHARACTERISTIC FCdc4_Sec1_low FCdtc_Sec1_low FCfmi_Sec1_low FCftb_Sec1_low FCspn_Sec1_low FPfl_Sec1_low FPfu_Sec1_low FPnd_Sec1_low FPsvr_Sec1_low FPsw_ext1_Sec1_low FPsw_Sec1_low /end REF_CHARACTERISTIC
/end GROUP
/begin GROUP Sec1_open_EC_Fault "Spark 1 Open Secondary"
 /begin REF_CHARACTERISTIC FCdc4_Sec1_open FCdtc_Sec1_open FCfmi_Sec1_open FCftb_Sec1_open FCspn_Sec1_open FPfl_Sec1_open FPfu_Sec1_open FPnd_Sec1_open FPsvr_Sec1_open FPsw_ext1_Sec1_open FPsw_Sec1_open /end REF_CHARACTERISTIC
/end GROUP
/begin GROUP SHIFT_FB_OOR_EC_Fault "Shift feedback absent or out-of-range"
 /begin REF_CHARACTERISTIC FCdc4_SHIFT_FB_OOR FCdtc_SHIFT_FB_OOR FCfmi_SHIFT_FB_OOR FCftb_SHIFT_FB_OOR FCspn_SHIFT_FB_OOR FPfl_SHIFT_FB_OOR FPfu_SHIFT_FB_OOR FPnd_SHIFT_FB_OOR FPsvr_SHIFT_FB_OOR FPsw_ext1_SHIFT_FB_OOR FPsw_SHIFT_FB_OOR /end REF_CHARACTERISTIC
/end GROUP
/begin GROUP SHIFT_intcirc_fail_EC_Fault "Shift actuator or drive circuit failure"
 /begin REF_CHARACTERISTIC FCdc4_SHIFT_intcirc_fail FCdtc_SHIFT_intcirc_fail FCfmi_SHIFT_intcirc_fail FCftb_SHIFT_intcirc_fail FCspn_SHIFT_intcirc_fail FPfl_SHIFT_intcirc_fail FPfu_SHIFT_intcirc_fail FPnd_SHIFT_intcirc_fail FPsvr_SHIFT_intcirc_fail FPsw_ext1_SHIFT_intcirc_fail FPsw_SHIFT_intcirc_fail /end REF_CHARACTERISTIC
/end GROUP
/begin GROUP SHIFT_shift_fail_EC_Fault "Shift unable to reach desired gear"
 /begin REF_CHARACTERISTIC FCdc4_SHIFT_shift_fail FCdtc_SHIFT_shift_fail FCfmi_SHIFT_shift_fail FCftb_SHIFT_shift_fail FCspn_SHIFT_shift_fail FPfl_SHIFT_shift_fail FPfu_SHIFT_shift_fail FPnd_SHIFT_shift_fail FPsvr_SHIFT_shift_fail FPsw_ext1_SHIFT_shift_fail FPsw_SHIFT_shift_fail /end REF_CHARACTERISTIC
/end GROUP
/begin GROUP SL_fuel_EC_Fault "Fuel rev limit"
 /begin REF_CHARACTERISTIC FCdc4_SL_fuel FCdtc_SL_fuel FCfmi_SL_fuel FCftb_SL_fuel FCspn_SL_fuel FPfl_SL_fuel FPfu_SL_fuel FPnd_SL_fuel FPsvr_SL_fuel FPsw_ext1_SL_fuel FPsw_SL_fuel /end REF_CHARACTERISTIC
/end GROUP
/begin GROUP SL_gov_EC_Fault "Max govern speed override"
 /begin REF_CHARACTERISTIC FCdc4_SL_gov FCdtc_SL_gov FCfmi_SL_gov FCftb_SL_gov FCspn_SL_gov FPfl_SL_gov FPfu_SL_gov FPnd_SL_gov FPsvr_SL_gov FPsw_ext1_SL_gov FPsw_SL_gov /end REF_CHARACTERISTIC
/end GROUP
/begin GROUP SL_spk_EC_Fault "Spark rev limit"
 /begin REF_CHARACTERISTIC FCdc4_SL_spk FCdtc_SL_spk FCfmi_SL_spk FCftb_SL_spk FCspn_SL_spk FPfl_SL_spk FPfu_SL_spk FPnd_SL_spk FPsvr_SL_spk FPsw_ext1_SL_spk FPsw_SL_spk /end REF_CHARACTERISTIC
/end GROUP
/begin GROUP slv_MAP_hi_OOA_EC_Fault "Multi-ECM slave MAP high - out of authority"
 /begin REF_CHARACTERISTIC FCdc4_slv_MAP_hi_OOA FCdtc_slv_MAP_hi_OOA FCfmi_slv_MAP_hi_OOA FCftb_slv_MAP_hi_OOA FCspn_slv_MAP_hi_OOA FPfl_slv_MAP_hi_OOA FPfu_slv_MAP_hi_OOA FPnd_slv_MAP_hi_OOA FPsvr_slv_MAP_hi_OOA FPsw_ext1_slv_MAP_hi_OOA FPsw_slv_MAP_hi_OOA /end REF_CHARACTERISTIC
/end GROUP
/begin GROUP slv_MAP_lo_OOA_EC_Fault "Multi-ECM slave MAP low - out of authority"
 /begin REF_CHARACTERISTIC FCdc4_slv_MAP_lo_OOA FCdtc_slv_MAP_lo_OOA FCfmi_slv_MAP_lo_OOA FCftb_slv_MAP_lo_OOA FCspn_slv_MAP_lo_OOA FPfl_slv_MAP_lo_OOA FPfu_slv_MAP_lo_OOA FPnd_slv_MAP_lo_OOA FPsvr_slv_MAP_lo_OOA FPsw_ext1_slv_MAP_lo_OOA FPsw_slv_MAP_lo_OOA /end REF_CHARACTERISTIC
/end GROUP
/begin GROUP SPK_int_fail_EC_Fault "External Spark Module Failure"
 /begin REF_CHARACTERISTIC FCdc4_SPK_int_fail FCdtc_SPK_int_fail FCfmi_SPK_int_fail FCftb_SPK_int_fail FCspn_SPK_int_fail FPfl_SPK_int_fail FPfu_SPK_int_fail FPnd_SPK_int_fail FPsvr_SPK_int_fail FPsw_ext1_SPK_int_fail FPsw_SPK_int_fail /end REF_CHARACTERISTIC
/end GROUP
/begin GROUP SPK1_IGBT_T_EC_Fault "Spark Plug or Coil Failure"
 /begin REF_CHARACTERISTIC FCdc4_SPK1_IGBT_T FCdtc_SPK1_IGBT_T FCfmi_SPK1_IGBT_T FCftb_SPK1_IGBT_T FCspn_SPK1_IGBT_T FPfl_SPK1_IGBT_T FPfu_SPK1_IGBT_T FPnd_SPK1_IGBT_T FPsvr_SPK1_IGBT_T FPsw_ext1_SPK1_IGBT_T FPsw_SPK1_IGBT_T /end REF_CHARACTERISTIC
/end GROUP
/begin GROUP SPKD_coil_fail_EC_Fault "External Spark Module Coil Failure"
 /begin REF_CHARACTERISTIC FCdc4_SPKD_coil_fail FCdtc_SPKD_coil_fail FCfmi_SPKD_coil_fail FCftb_SPKD_coil_fail FCspn_SPKD_coil_fail FPfl_SPKD_coil_fail FPfu_SPKD_coil_fail FPnd_SPKD_coil_fail FPsvr_SPKD_coil_fail FPsw_ext1_SPKD_coil_fail FPsw_SPKD_coil_fail /end REF_CHARACTERISTIC
/end GROUP
/begin GROUP SPKD_dw_hi_EC_Fault "Primary Coil Shorted"
 /begin REF_CHARACTERISTIC FCdc4_SPKD_dw_hi FCdtc_SPKD_dw_hi FCfmi_SPKD_dw_hi FCftb_SPKD_dw_hi FCspn_SPKD_dw_hi FPfl_SPKD_dw_hi FPfu_SPKD_dw_hi FPnd_SPKD_dw_hi FPsvr_SPKD_dw_hi FPsw_ext1_SPKD_dw_hi FPsw_SPKD_dw_hi /end REF_CHARACTERISTIC
/end GROUP
/begin GROUP SPKD_dw_lo_EC_Fault "Primary Loop Open or"
 /begin REF_CHARACTERISTIC FCdc4_SPKD_dw_lo FCdtc_SPKD_dw_lo FCfmi_SPKD_dw_lo FCftb_SPKD_dw_lo FCspn_SPKD_dw_lo FPfl_SPKD_dw_lo FPfu_SPKD_dw_lo FPnd_SPKD_dw_lo FPsvr_SPKD_dw_lo FPsw_ext1_SPKD_dw_lo FPsw_SPKD_dw_lo /end REF_CHARACTERISTIC
/end GROUP
/begin GROUP SRVC_expired_EC_Fault "Service Interval Expired - Level 1"
 /begin REF_CHARACTERISTIC FCdc4_SRVC_expired FCdtc_SRVC_expired FCfmi_SRVC_expired FCftb_SRVC_expired FCspn_SRVC_expired FPfl_SRVC_expired FPfu_SRVC_expired FPnd_SRVC_expired FPsvr_SRVC_expired FPsw_ext1_SRVC_expired FPsw_SRVC_expired /end REF_CHARACTERISTIC
/end GROUP
/begin GROUP SRVC_expired2_EC_Fault "Service Interval Expired - Level 2"
 /begin REF_CHARACTERISTIC FCdc4_SRVC_expired2 FCdtc_SRVC_expired2 FCfmi_SRVC_expired2 FCftb_SRVC_expired2 FCspn_SRVC_expired2 FPfl_SRVC_expired2 FPfu_SRVC_expired2 FPnd_SRVC_expired2 FPsvr_SRVC_expired2 FPsw_ext1_SRVC_expired2 FPsw_SRVC_expired2 /end REF_CHARACTERISTIC
/end GROUP
/begin GROUP start_coilopen_EC_Fault "Start relay coil open"
 /begin REF_CHARACTERISTIC FCdc4_start_coilopen FCdtc_start_coilopen FCfmi_start_coilopen FCftb_start_coilopen FCspn_start_coilopen FPfl_start_coilopen FPfu_start_coilopen FPnd_start_coilopen FPsvr_start_coilopen FPsw_ext1_start_coilopen FPsw_start_coilopen /end REF_CHARACTERISTIC
/end GROUP
/end MODULE
/end PROJECT
