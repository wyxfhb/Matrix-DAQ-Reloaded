ASAP2_VERSION 1 61
/begin PROJECT Econtrols_4G "4G Test"
/begin HEADER "4G A2L Configuration" PROJECT_NO EControls4G /* config for version control */ VERSION "$Revision: 82130 $:" /* config for version control */ /end HEADER
/begin MODULE EControls_4G_SH2A "EControls 4G"
/begin MOD_COMMON "" DEPOSIT ABSOLUTE BYTE_ORDER MSB_FIRST /end MOD_COMMON
/* Define the Record Layouts */
/begin RECORD_LAYOUT ECIPP_ALIGNMENT_UBYTE FNC_VALUES 1 UBYTE COLUMN_DIR DIRECT /end RECORD_LAYOUT
/begin RECORD_LAYOUT ECIPP_ALIGNMENT_UWORD FNC_VALUES 1 UWORD COLUMN_DIR DIRECT /end RECORD_LAYOUT
/begin RECORD_LAYOUT ECIPP_ALIGNMENT_SWORD FNC_VALUES 1 SWORD COLUMN_DIR DIRECT /end RECORD_LAYOUT
/begin RECORD_LAYOUT ECIPP_Lookup_SWORD AXIS_PTS_X 1 SWORD INDEX_INCR DIRECT /end RECORD_LAYOUT
/begin RECORD_LAYOUT ECIPP_ALIGNMENT_FLOAT32_IEEE FNC_VALUES 1 FLOAT32_IEEE COLUMN_DIR DIRECT /end RECORD_LAYOUT
/begin RECORD_LAYOUT ECIPP_Lookup_FLOAT32_IEEE AXIS_PTS_X 1 FLOAT32_IEEE INDEX_INCR DIRECT /end RECORD_LAYOUT
/* Define generic COMPU_METHODS used in the A2L */ /* NOTE: most of the parameters from ECIPP use unique/specific COMPU_METHODS */
/begin COMPU_METHOD Compu_ECIPP_STRINGS "ECIPP Strings " /* Identifier */ RAT_FUNC "%.0" /* Format */ "ASCII" /* Units */ COEFFS 0 1 0 0 0 1 /end COMPU_METHOD
/begin MEASUREMENT spk_adv_base "Base Spark Advance" SWORD Compu_spk_adv_base 0 0 -2048 2047.9375 ECU_ADDRESS 0x01000028 /end MEASUREMENT
/begin COMPU_METHOD Compu_spk_adv_base " " RAT_FUNC "%.1" "CAD BTDC" COEFFS 0 16 0 0 0 1 /end COMPU_METHOD
/begin MEASUREMENT spk_off_ECTvL "CHT-MAP Adv Offset" SWORD Compu_spk_off_ECTvL 0 0 -2048 2047.9375 ECU_ADDRESS 0x01000038 /end MEASUREMENT
/begin COMPU_METHOD Compu_spk_off_ECTvL " " RAT_FUNC "%.1" "CAD BTDC" COEFFS 0 16 0 0 0 1 /end COMPU_METHOD
/begin MEASUREMENT spk_off_MATvL "MAT-MAP Adv Offset" SWORD Compu_spk_off_MATvL 0 0 -2048 2047.9375 ECU_ADDRESS 0x01000040 /end MEASUREMENT
/begin COMPU_METHOD Compu_spk_off_MATvL " " RAT_FUNC "%.1" "CAD BTDC" COEFFS 0 16 0 0 0 1 /end COMPU_METHOD
/begin MEASUREMENT spk_off_ECT "CHT Adv Offset" SWORD Compu_spk_off_ECT 0 0 -2048 2047.9375 ECU_ADDRESS 0x01000048 /end MEASUREMENT
/begin COMPU_METHOD Compu_spk_off_ECT " " RAT_FUNC "%.1" "CAD BTDC" COEFFS 0 16 0 0 0 1 /end COMPU_METHOD
/begin MEASUREMENT KNK_sig_pavg "Instant KNK peak-average" UWORD Compu_KNK_sig_pavg 0 0 0 63.9990234375 ECU_ADDRESS 0x01000150 /end MEASUREMENT
/begin COMPU_METHOD Compu_KNK_sig_pavg " " RAT_FUNC "%.3" "volts" COEFFS 0 1024 0 0 0 1 /end COMPU_METHOD
/begin MEASUREMENT spk_ret_CWT "CWT retard" SWORD Compu_spk_ret_CWT 0 0 -2048 2047.9375 ECU_ADDRESS 0x01000280 /end MEASUREMENT
/begin COMPU_METHOD Compu_spk_ret_CWT " " RAT_FUNC "%.1" "CAD" COEFFS 0 16 0 0 0 1 /end COMPU_METHOD
/begin MEASUREMENT KNK_pct_latch "Instant KNK percent" UWORD Compu_KNK_pct_latch 0 0 0 99.9984741210938 ECU_ADDRESS 0x01000368 /end MEASUREMENT
/begin COMPU_METHOD Compu_KNK_pct_latch " " RAT_FUNC "%.1" "%" COEFFS 0 655.36 0 0 0 1 /end COMPU_METHOD
/begin MEASUREMENT KNK_pct_avg "Average KNK" UWORD Compu_KNK_pct_avg 0 0 0 99.9984741210938 ECU_ADDRESS 0x01000370 /end MEASUREMENT
/begin COMPU_METHOD Compu_KNK_pct_avg " " RAT_FUNC "%.1" "%" COEFFS 0 655.36 0 0 0 1 /end COMPU_METHOD
/begin MEASUREMENT KNK_pct_max "Max KNK" UWORD Compu_KNK_pct_max 0 0 0 99.9984741210938 ECU_ADDRESS 0x01000378 /end MEASUREMENT
/begin COMPU_METHOD Compu_KNK_pct_max " " RAT_FUNC "%.1" "%" COEFFS 0 655.36 0 0 0 1 /end COMPU_METHOD
/begin MEASUREMENT KNK_pct_min "Min KNK" UWORD Compu_KNK_pct_min 0 0 0 99.9984741210938 ECU_ADDRESS 0x01000380 /end MEASUREMENT
/begin COMPU_METHOD Compu_KNK_pct_min " " RAT_FUNC "%.1" "%" COEFFS 0 655.36 0 0 0 1 /end COMPU_METHOD
/begin MEASUREMENT KNK_win_dur "KNK window duration" SWORD Compu_KNK_win_dur 0 0 -16384 16383.5 ECU_ADDRESS 0x010010E0 /end MEASUREMENT
/begin COMPU_METHOD Compu_KNK_win_dur " " RAT_FUNC "%.0" "CAD" COEFFS 0 2 0 0 0 1 /end COMPU_METHOD
/begin MEASUREMENT KNK_win_start "KNK window start" SWORD Compu_KNK_win_start 0 0 -16384 16383.5 ECU_ADDRESS 0x010010E8 /end MEASUREMENT
/begin COMPU_METHOD Compu_KNK_win_start " " RAT_FUNC "%.0" "CAD BTDC" COEFFS 0 2 0 0 0 1 /end COMPU_METHOD
/begin CHARACTERISTIC KNK_enable "Knock control system{KNK_enable&0xff=0:Disabled}{KNK_enable&0xff=1:Enabled - ECM only}{KNK_enable&0xff=2:Enabled - ECM+SPOCK}" VALUE 0x001c3a22 /* @ECU_Address@KNK_enable@0x010010F0@ */ ECIPP_ALIGNMENT_UBYTE 255 KNK_enable_COMPU_VTAB 0 255 BIT_MASK 0xff /end CHARACTERISTIC
/begin COMPU_METHOD KNK_enable_COMPU_VTAB "Verbal Table" TAB_VERB "%.0" "list" COMPU_TAB_REF KNK_enable_COMPU_VTAB_REF /end COMPU_METHOD
/begin COMPU_VTAB KNK_enable_COMPU_VTAB_REF "Verbal Table" TAB_VERB 3 0 "Disabled" 1 "Enabled - ECM only" 2 "Enabled - ECM+SPOCK" DEFAULT_VALUE "UNKNOWN" /end COMPU_VTAB
/begin MEASUREMENT KNK_manual "Knock mode{KNK_manual&0xff=0x00:Automatic}{KNK_manual&0xff=0x01:Manual}" UBYTE KNK_manual_COMPU_VTAB 0 0 0 255 ECU_ADDRESS 0x010010F8 BIT_MASK 0xff /end MEASUREMENT
/begin COMPU_METHOD KNK_manual_COMPU_VTAB "Verbal Table" TAB_VERB "%.0" "list" COMPU_TAB_REF KNK_manual_COMPU_VTAB_REF /end COMPU_METHOD
/begin COMPU_VTAB KNK_manual_COMPU_VTAB_REF "Verbal Table" TAB_VERB 2 0x00 "Automatic" 0x01 "Manual" DEFAULT_VALUE "UNKNOWN" /end COMPU_VTAB
/begin MEASUREMENT KNK_100_V "KNK 100% voltage" UWORD Compu_KNK_100_V 0 0 0 63.9990234375 ECU_ADDRESS 0x01001100 /end MEASUREMENT
/begin COMPU_METHOD Compu_KNK_100_V " " RAT_FUNC "%.3" "volts" COEFFS 0 1024 0 0 0 1 /end COMPU_METHOD
/begin MEASUREMENT KNK_0_V "KNK 0% voltage" UWORD Compu_KNK_0_V 0 0 0 63.9990234375 ECU_ADDRESS 0x01001108 /end MEASUREMENT
/begin COMPU_METHOD Compu_KNK_0_V " " RAT_FUNC "%.3" "volts" COEFFS 0 1024 0 0 0 1 /end COMPU_METHOD
/begin MEASUREMENT KNK_ret_max "KNK retard max" SWORD Compu_KNK_ret_max 0 0 -64 63.998046875 ECU_ADDRESS 0x01001110 /end MEASUREMENT
/begin COMPU_METHOD Compu_KNK_ret_max " " RAT_FUNC "%.1" "CAD" COEFFS 0 512 0 0 0 1 /end COMPU_METHOD
/begin CHARACTERISTIC KNK_ret_K "KNK retard gain" VALUE 0x001c39e6 /* @ECU_Address@KNK_ret_K@0x01001118@ */ ECIPP_ALIGNMENT_UWORD 128 Compu_KNK_ret_K 0 127.998046875 /end CHARACTERISTIC
/begin COMPU_METHOD Compu_KNK_ret_K " " RAT_FUNC "%.3" "CAD / cycle" COEFFS 0 512 0 0 0 1 /end COMPU_METHOD
/begin CHARACTERISTIC KNK_adv_K "KNK advance gain" VALUE 0x001c39da /* @ECU_Address@KNK_adv_K@0x01001120@ */ ECIPP_ALIGNMENT_UWORD 128 Compu_KNK_adv_K 0 127.998046875 /end CHARACTERISTIC
/begin COMPU_METHOD Compu_KNK_adv_K " " RAT_FUNC "%.3" "CAD / cycle" COEFFS 0 512 0 0 0 1 /end COMPU_METHOD
/begin CHARACTERISTIC KNK_val_trig "Average KNK validation trigger" VALUE 0x001c39ea /* @ECU_Address@KNK_val_trig@0x01001128@ */ ECIPP_ALIGNMENT_UWORD 100 Compu_KNK_val_trig 0 99.9984741210938 /end CHARACTERISTIC
/begin COMPU_METHOD Compu_KNK_val_trig " " RAT_FUNC "%.1" "%" COEFFS 0 655.36 0 0 0 1 /end COMPU_METHOD
/begin CHARACTERISTIC KNK_val_cycles "Average KNK window" VALUE 0x001c3a47 /* @ECU_Address@KNK_val_cycles@0x01001130@ */ ECIPP_ALIGNMENT_UBYTE 255 Compu_KNK_val_cycles 0 255 /end CHARACTERISTIC
/begin COMPU_METHOD Compu_KNK_val_cycles " " RAT_FUNC "%.0" "cycles" COEFFS 0 1 0 0 0 1 /end COMPU_METHOD
/begin CHARACTERISTIC KNK_ECT_ena "KNK ECT enable" VALUE 0x001c39d4 /* @ECU_Address@KNK_ECT_ena@0x010011A0@ */ ECIPP_ALIGNMENT_UWORD 564 Compu_KNK_ECT_ena -460 563.984375 /end CHARACTERISTIC
/begin COMPU_METHOD Compu_KNK_ECT_ena " " RAT_FUNC "%.1" "deg F" COEFFS 0 64 29440 0 0 1 /end COMPU_METHOD
/begin CHARACTERISTIC KNK_min_MAP "Knock min MAP" VALUE 0x001c39e4 /* @ECU_Address@KNK_min_MAP@0x01001258@ */ ECIPP_ALIGNMENT_UWORD 256 Compu_KNK_min_MAP 0 255.99609375 /end CHARACTERISTIC
/begin COMPU_METHOD Compu_KNK_min_MAP " " RAT_FUNC "%.2" "psia" COEFFS 0 256 0 0 0 1 /end COMPU_METHOD
/begin CHARACTERISTIC KNK_max_RPM "Knock max RPM" VALUE 0x001c39e2 /* @ECU_Address@KNK_max_RPM@0x01001260@ */ ECIPP_ALIGNMENT_UWORD 65535 Compu_KNK_max_RPM 0 65535 /end CHARACTERISTIC
/begin COMPU_METHOD Compu_KNK_max_RPM " " RAT_FUNC "%.0" "rpm" COEFFS 0 1 0 0 0 1 /end COMPU_METHOD
/begin MEASUREMENT KCYC_enable "Knock cycle-sample updates{KCYC_enable&0xff=0:Halted}{KCYC_enable&0xff=1:Active}" UBYTE KCYC_enable_COMPU_VTAB 0 0 0 255 ECU_ADDRESS 0x01002A28 BIT_MASK 0xff /end MEASUREMENT
/begin COMPU_METHOD KCYC_enable_COMPU_VTAB "Verbal Table" TAB_VERB "%.0" "list" COMPU_TAB_REF KCYC_enable_COMPU_VTAB_REF /end COMPU_METHOD
/begin COMPU_VTAB KCYC_enable_COMPU_VTAB_REF "Verbal Table" TAB_VERB 2 0 "Halted" 1 "Active" DEFAULT_VALUE "UNKNOWN" /end COMPU_VTAB
/begin CHARACTERISTIC KNK_BPF "Knock band-pass filter selection{KNK_BPF&0xff=0:Disabled}{KNK_BPF&0xff=1:2.00 KHz}{KNK_BPF&0xff=2:2.25 KHz}{KNK_BPF&0xff=3:2.50 KHz}{KNK_BPF&0xff=4:2.75 KHz}{KNK_BPF&0xff=5:3.00 KHz}{KNK_BPF&0xff=6:3.25 KHz}{KNK_BPF&0xff=7:3.50 KHz}{KNK_BPF&0xff=8:3.75 KH" VALUE 0x001c3a1f /* @ECU_Address@KNK_BPF@0x01002A30@ */ ECIPP_ALIGNMENT_UBYTE 255 KNK_BPF_COMPU_VTAB 0 255 BIT_MASK 0xff /end CHARACTERISTIC
/begin COMPU_METHOD KNK_BPF_COMPU_VTAB "Verbal Table" TAB_VERB "%.0" "list" COMPU_TAB_REF KNK_BPF_COMPU_VTAB_REF /end COMPU_METHOD
/begin COMPU_VTAB KNK_BPF_COMPU_VTAB_REF "Verbal Table" TAB_VERB 50 0 "Disabled" 1 "2.00 KHz" 2 "2.25 KHz" 3 "2.50 KHz" 4 "2.75 KHz" 5 "3.00 KHz" 6 "3.25 KHz" 7 "3.50 KHz" 8 "3.75 KHz" 9 "4.00 KHz" 10 "4.25 KHz" 11 "4.50 KHz" 12 "4.75 KHz" 13 "5.00 KHz" 14 "5.25 KHz" 15 "5.50 KHz" 16 "5.75 KHz" 17 "6.00 KHz" 18 "6.25 KHz" 19 "6.50 KHz" 20 "6.75 KHz" 21 "7.00 KHz" 22 "7.25 KHz" 23 "7.50 KHz" 24 "7.75 KHz" 25 "8.00 KHz" 26 "8.25 KHz" 27 "8.50 KHz" 28 "8.75 KHz" 29 "9.00 KHz" 30 "9.50 KHz" 31 "10.00 KHz" 32 "10.50 KHz" 33 "11.00 KHz" 34 "11.50 KHz" 35 "12.00 KHz" 36 "12.50 KHz" 37 "13.00 KHz" 38 "13.50 KHz" 39 "14.00 KHz" 40 "14.50 KHz" 41 "15.00 KHz" 42 "15.50 KHz" 43 "16.00 KHz" 44 "16.50 KHz" 45 "17.00 KHz" 46 "17.50 KHz" 47 "18.00 KHz" 48 "19.00 KHz" 49 "20.00 KHz" DEFAULT_VALUE "UNKNOWN" /end COMPU_VTAB
/begin MEASUREMENT KNK_SW_gain "Knock software gain" UWORD Compu_KNK_SW_gain 0 0 0 255.99609375 ECU_ADDRESS 0x01002A38 /end MEASUREMENT
/begin COMPU_METHOD Compu_KNK_SW_gain " " RAT_FUNC "%.2" "multiplier" COEFFS 0 256 0 0 0 1 /end COMPU_METHOD
/begin CHARACTERISTIC KNK_sens_cyl1 "Knock sensor assignment 1{KNK_sens_cyl1&0xff=0:Disabled}{KNK_sens_cyl1&0xff=1:Sensor 1}{KNK_sens_cyl1&0xff=2:Sensor 2}{KNK_sens_cyl1&0xff=3:Sensor 3}{KNK_sens_cyl1&0xff=4:Sensor 4}{KNK_sens_cyl1&0xff=5:Sensor 5}{KNK_sens_cyl1&0xff=6:Sensor 6}{KNK_sens_cyl" VALUE 0x001C3A2F /* @ECU_Address@KNK_sens_cyl1@0x01002A58@ */ ECIPP_ALIGNMENT_UBYTE 255 KNK_sens_cyl1_COMPU_VTAB 0 255 BIT_MASK 0xff /end CHARACTERISTIC
/begin COMPU_METHOD KNK_sens_cyl1_COMPU_VTAB "Verbal Table" TAB_VERB "%.0" "list" COMPU_TAB_REF KNK_sens_cyl1_COMPU_VTAB_REF /end COMPU_METHOD
/begin COMPU_VTAB KNK_sens_cyl1_COMPU_VTAB_REF "Verbal Table" TAB_VERB 13 0 "Disabled" 1 "Sensor 1" 2 "Sensor 2" 3 "Sensor 3" 4 "Sensor 4" 5 "Sensor 5" 6 "Sensor 6" 7 "Sensor 7" 8 "Sensor 8" 9 "Sensor 9" 10 "Sensor 10" 11 "Sensor 11" 12 "Sensor 12" DEFAULT_VALUE "UNKNOWN" /end COMPU_VTAB
/begin CHARACTERISTIC KNK_sens_cyl2 "Knock sensor assignment 2{KNK_sens_cyl2&0xff=0:Disabled}{KNK_sens_cyl2&0xff=1:Sensor 1}{KNK_sens_cyl2&0xff=2:Sensor 2}{KNK_sens_cyl2&0xff=3:Sensor 3}{KNK_sens_cyl2&0xff=4:Sensor 4}{KNK_sens_cyl2&0xff=5:Sensor 5}{KNK_sens_cyl2&0xff=6:Sensor 6}{KNK_sens_cyl" VALUE 0x001C3A30 /* @ECU_Address@KNK_sens_cyl2@0x01002A60@ */ ECIPP_ALIGNMENT_UBYTE 255 KNK_sens_cyl2_COMPU_VTAB 0 255 BIT_MASK 0xff /end CHARACTERISTIC
/begin COMPU_METHOD KNK_sens_cyl2_COMPU_VTAB "Verbal Table" TAB_VERB "%.0" "list" COMPU_TAB_REF KNK_sens_cyl2_COMPU_VTAB_REF /end COMPU_METHOD
/begin COMPU_VTAB KNK_sens_cyl2_COMPU_VTAB_REF "Verbal Table" TAB_VERB 13 0 "Disabled" 1 "Sensor 1" 2 "Sensor 2" 3 "Sensor 3" 4 "Sensor 4" 5 "Sensor 5" 6 "Sensor 6" 7 "Sensor 7" 8 "Sensor 8" 9 "Sensor 9" 10 "Sensor 10" 11 "Sensor 11" 12 "Sensor 12" DEFAULT_VALUE "UNKNOWN" /end COMPU_VTAB
/begin CHARACTERISTIC KNK_sens_cyl3 "Knock sensor assignment 3{KNK_sens_cyl3&0xff=0:Disabled}{KNK_sens_cyl3&0xff=1:Sensor 1}{KNK_sens_cyl3&0xff=2:Sensor 2}{KNK_sens_cyl3&0xff=3:Sensor 3}{KNK_sens_cyl3&0xff=4:Sensor 4}{KNK_sens_cyl3&0xff=5:Sensor 5}{KNK_sens_cyl3&0xff=6:Sensor 6}{KNK_sens_cyl" VALUE 0x001C3A31 /* @ECU_Address@KNK_sens_cyl3@0x01002A68@ */ ECIPP_ALIGNMENT_UBYTE 255 KNK_sens_cyl3_COMPU_VTAB 0 255 BIT_MASK 0xff /end CHARACTERISTIC
/begin COMPU_METHOD KNK_sens_cyl3_COMPU_VTAB "Verbal Table" TAB_VERB "%.0" "list" COMPU_TAB_REF KNK_sens_cyl3_COMPU_VTAB_REF /end COMPU_METHOD
/begin COMPU_VTAB KNK_sens_cyl3_COMPU_VTAB_REF "Verbal Table" TAB_VERB 13 0 "Disabled" 1 "Sensor 1" 2 "Sensor 2" 3 "Sensor 3" 4 "Sensor 4" 5 "Sensor 5" 6 "Sensor 6" 7 "Sensor 7" 8 "Sensor 8" 9 "Sensor 9" 10 "Sensor 10" 11 "Sensor 11" 12 "Sensor 12" DEFAULT_VALUE "UNKNOWN" /end COMPU_VTAB
/begin CHARACTERISTIC KNK_sens_cyl4 "Knock sensor assignment 4{KNK_sens_cyl4&0xff=0:Disabled}{KNK_sens_cyl4&0xff=1:Sensor 1}{KNK_sens_cyl4&0xff=2:Sensor 2}{KNK_sens_cyl4&0xff=3:Sensor 3}{KNK_sens_cyl4&0xff=4:Sensor 4}{KNK_sens_cyl4&0xff=5:Sensor 5}{KNK_sens_cyl4&0xff=6:Sensor 6}{KNK_sens_cyl" VALUE 0x001C3A32 /* @ECU_Address@KNK_sens_cyl4@0x01002A70@ */ ECIPP_ALIGNMENT_UBYTE 255 KNK_sens_cyl4_COMPU_VTAB 0 255 BIT_MASK 0xff /end CHARACTERISTIC
/begin COMPU_METHOD KNK_sens_cyl4_COMPU_VTAB "Verbal Table" TAB_VERB "%.0" "list" COMPU_TAB_REF KNK_sens_cyl4_COMPU_VTAB_REF /end COMPU_METHOD
/begin COMPU_VTAB KNK_sens_cyl4_COMPU_VTAB_REF "Verbal Table" TAB_VERB 13 0 "Disabled" 1 "Sensor 1" 2 "Sensor 2" 3 "Sensor 3" 4 "Sensor 4" 5 "Sensor 5" 6 "Sensor 6" 7 "Sensor 7" 8 "Sensor 8" 9 "Sensor 9" 10 "Sensor 10" 11 "Sensor 11" 12 "Sensor 12" DEFAULT_VALUE "UNKNOWN" /end COMPU_VTAB
/begin CHARACTERISTIC KNK_sens_cyl5 "Knock sensor assignment 5{KNK_sens_cyl5&0xff=0:Disabled}{KNK_sens_cyl5&0xff=1:Sensor 1}{KNK_sens_cyl5&0xff=2:Sensor 2}{KNK_sens_cyl5&0xff=3:Sensor 3}{KNK_sens_cyl5&0xff=4:Sensor 4}{KNK_sens_cyl5&0xff=5:Sensor 5}{KNK_sens_cyl5&0xff=6:Sensor 6}{KNK_sens_cyl" VALUE 0x001C3A33 /* @ECU_Address@KNK_sens_cyl5@0x01002A78@ */ ECIPP_ALIGNMENT_UBYTE 255 KNK_sens_cyl5_COMPU_VTAB 0 255 BIT_MASK 0xff /end CHARACTERISTIC
/begin COMPU_METHOD KNK_sens_cyl5_COMPU_VTAB "Verbal Table" TAB_VERB "%.0" "list" COMPU_TAB_REF KNK_sens_cyl5_COMPU_VTAB_REF /end COMPU_METHOD
/begin COMPU_VTAB KNK_sens_cyl5_COMPU_VTAB_REF "Verbal Table" TAB_VERB 13 0 "Disabled" 1 "Sensor 1" 2 "Sensor 2" 3 "Sensor 3" 4 "Sensor 4" 5 "Sensor 5" 6 "Sensor 6" 7 "Sensor 7" 8 "Sensor 8" 9 "Sensor 9" 10 "Sensor 10" 11 "Sensor 11" 12 "Sensor 12" DEFAULT_VALUE "UNKNOWN" /end COMPU_VTAB
/begin CHARACTERISTIC KNK_sens_cyl6 "Knock sensor assignment 6{KNK_sens_cyl6&0xff=0:Disabled}{KNK_sens_cyl6&0xff=1:Sensor 1}{KNK_sens_cyl6&0xff=2:Sensor 2}{KNK_sens_cyl6&0xff=3:Sensor 3}{KNK_sens_cyl6&0xff=4:Sensor 4}{KNK_sens_cyl6&0xff=5:Sensor 5}{KNK_sens_cyl6&0xff=6:Sensor 6}{KNK_sens_cyl" VALUE 0x001C3A34 /* @ECU_Address@KNK_sens_cyl6@0x01002A80@ */ ECIPP_ALIGNMENT_UBYTE 255 KNK_sens_cyl6_COMPU_VTAB 0 255 BIT_MASK 0xff /end CHARACTERISTIC
/begin COMPU_METHOD KNK_sens_cyl6_COMPU_VTAB "Verbal Table" TAB_VERB "%.0" "list" COMPU_TAB_REF KNK_sens_cyl6_COMPU_VTAB_REF /end COMPU_METHOD
/begin COMPU_VTAB KNK_sens_cyl6_COMPU_VTAB_REF "Verbal Table" TAB_VERB 13 0 "Disabled" 1 "Sensor 1" 2 "Sensor 2" 3 "Sensor 3" 4 "Sensor 4" 5 "Sensor 5" 6 "Sensor 6" 7 "Sensor 7" 8 "Sensor 8" 9 "Sensor 9" 10 "Sensor 10" 11 "Sensor 11" 12 "Sensor 12" DEFAULT_VALUE "UNKNOWN" /end COMPU_VTAB
/begin CHARACTERISTIC KNK_sens_cyl7 "Knock sensor assignment 7{KNK_sens_cyl7&0xff=0:Disabled}{KNK_sens_cyl7&0xff=1:Sensor 1}{KNK_sens_cyl7&0xff=2:Sensor 2}{KNK_sens_cyl7&0xff=3:Sensor 3}{KNK_sens_cyl7&0xff=4:Sensor 4}{KNK_sens_cyl7&0xff=5:Sensor 5}{KNK_sens_cyl7&0xff=6:Sensor 6}{KNK_sens_cyl" VALUE 0x001C3A35 /* @ECU_Address@KNK_sens_cyl7@0x01002A88@ */ ECIPP_ALIGNMENT_UBYTE 255 KNK_sens_cyl7_COMPU_VTAB 0 255 BIT_MASK 0xff /end CHARACTERISTIC
/begin COMPU_METHOD KNK_sens_cyl7_COMPU_VTAB "Verbal Table" TAB_VERB "%.0" "list" COMPU_TAB_REF KNK_sens_cyl7_COMPU_VTAB_REF /end COMPU_METHOD
/begin COMPU_VTAB KNK_sens_cyl7_COMPU_VTAB_REF "Verbal Table" TAB_VERB 13 0 "Disabled" 1 "Sensor 1" 2 "Sensor 2" 3 "Sensor 3" 4 "Sensor 4" 5 "Sensor 5" 6 "Sensor 6" 7 "Sensor 7" 8 "Sensor 8" 9 "Sensor 9" 10 "Sensor 10" 11 "Sensor 11" 12 "Sensor 12" DEFAULT_VALUE "UNKNOWN" /end COMPU_VTAB
/begin CHARACTERISTIC KNK_sens_cyl8 "Knock sensor assignment 8{KNK_sens_cyl8&0xff=0:Disabled}{KNK_sens_cyl8&0xff=1:Sensor 1}{KNK_sens_cyl8&0xff=2:Sensor 2}{KNK_sens_cyl8&0xff=3:Sensor 3}{KNK_sens_cyl8&0xff=4:Sensor 4}{KNK_sens_cyl8&0xff=5:Sensor 5}{KNK_sens_cyl8&0xff=6:Sensor 6}{KNK_sens_cyl" VALUE 0x001C3A36 /* @ECU_Address@KNK_sens_cyl8@0x01002A90@ */ ECIPP_ALIGNMENT_UBYTE 255 KNK_sens_cyl8_COMPU_VTAB 0 255 BIT_MASK 0xff /end CHARACTERISTIC
/begin COMPU_METHOD KNK_sens_cyl8_COMPU_VTAB "Verbal Table" TAB_VERB "%.0" "list" COMPU_TAB_REF KNK_sens_cyl8_COMPU_VTAB_REF /end COMPU_METHOD
/begin COMPU_VTAB KNK_sens_cyl8_COMPU_VTAB_REF "Verbal Table" TAB_VERB 13 0 "Disabled" 1 "Sensor 1" 2 "Sensor 2" 3 "Sensor 3" 4 "Sensor 4" 5 "Sensor 5" 6 "Sensor 6" 7 "Sensor 7" 8 "Sensor 8" 9 "Sensor 9" 10 "Sensor 10" 11 "Sensor 11" 12 "Sensor 12" DEFAULT_VALUE "UNKNOWN" /end COMPU_VTAB
/begin MEASUREMENT KNK_bg_dur "KNK backgnd duration" SWORD Compu_KNK_bg_dur 0 0 -16384 16383.5 ECU_ADDRESS 0x01002A98 /end MEASUREMENT
/begin COMPU_METHOD Compu_KNK_bg_dur " " RAT_FUNC "%.0" "CAD" COEFFS 0 2 0 0 0 1 /end COMPU_METHOD
/begin MEASUREMENT KNK_bg_start "KNK background start" SWORD Compu_KNK_bg_start 0 0 -16384 16383.5 ECU_ADDRESS 0x01002AA0 /end MEASUREMENT
/begin COMPU_METHOD Compu_KNK_bg_start " " RAT_FUNC "%.0" "CAD BTDC" COEFFS 0 2 0 0 0 1 /end COMPU_METHOD
/begin MEASUREMENT KNK_win_avg "Knock sensor 1" UWORD Compu_KNK_win_avg 0 0 0 63.9990234375 ECU_ADDRESS 0x01002AA8 /end MEASUREMENT
/begin COMPU_METHOD Compu_KNK_win_avg " " RAT_FUNC "%.3" "RMS volts" COEFFS 0 1024 0 0 0 1 /end COMPU_METHOD
/begin CHARACTERISTIC KNK_BPF_delay "Knock band-pass filter delay" VALUE 0x001c39d0 /* @ECU_Address@KNK_BPF_delay@0x01002AB0@ */ ECIPP_ALIGNMENT_UWORD 16 Compu_KNK_BPF_delay 0 15.999755859375 /end CHARACTERISTIC
/begin COMPU_METHOD Compu_KNK_BPF_delay " " RAT_FUNC "%.3" "ms" COEFFS 0 4096 0 0 0 1 /end COMPU_METHOD
/begin CHARACTERISTIC KNK_sig_pweight "Knock feedback peak weighting" VALUE 0x001c39e8 /* @ECU_Address@KNK_sig_pweight@0x01002AB8@ */ ECIPP_ALIGNMENT_UWORD 100 Compu_KNK_sig_pweight 0 99.9984741210938 /end CHARACTERISTIC
/begin COMPU_METHOD Compu_KNK_sig_pweight " " RAT_FUNC "%.1" "%" COEFFS 0 655.36 0 0 0 1 /end COMPU_METHOD
/begin CHARACTERISTIC spk_ofst_maxadv "Engineering spark advance offset limit" VALUE 0x001c6d34 /* @ECU_Address@spk_ofst_maxadv@0x01002AC0@ */ ECIPP_ALIGNMENT_SWORD 2048 Compu_spk_ofst_maxadv -2048 2047.9375 /end CHARACTERISTIC
/begin COMPU_METHOD Compu_spk_ofst_maxadv " " RAT_FUNC "%.0" "%" COEFFS 0 16 0 0 0 1 /end COMPU_METHOD
/begin CHARACTERISTIC OCT_init "Cold power-up default octane rating" VALUE 0x001c39fa /* @ECU_Address@OCT_init@0x01002AD0@ */ ECIPP_ALIGNMENT_UWORD 100 Compu_OCT_init 0 99.9984741210938 /end CHARACTERISTIC
/begin COMPU_METHOD Compu_OCT_init " " RAT_FUNC "%.1" "%" COEFFS 0 655.36 0 0 0 1 /end COMPU_METHOD
/begin CHARACTERISTIC OCT_ret_increase "Lower knk retard for octane increase" VALUE 0x001c3a06 /* @ECU_Address@OCT_ret_increase@0x01002AD8@ */ ECIPP_ALIGNMENT_UWORD 128 Compu_OCT_ret_increase 0 127.998046875 /end CHARACTERISTIC
/begin COMPU_METHOD Compu_OCT_ret_increase " " RAT_FUNC "%.1" "CAD" COEFFS 0 512 0 0 0 1 /end COMPU_METHOD
/begin CHARACTERISTIC OCT_ret_decrease "Higher knk retard for proportional octane decrease" VALUE 0x001c3a04 /* @ECU_Address@OCT_ret_decrease@0x01002AE0@ */ ECIPP_ALIGNMENT_UWORD 128 Compu_OCT_ret_decrease 0 127.998046875 /end CHARACTERISTIC
/begin COMPU_METHOD Compu_OCT_ret_decrease " " RAT_FUNC "%.1" "CAD" COEFFS 0 512 0 0 0 1 /end COMPU_METHOD
/begin CHARACTERISTIC OCT_slew_inc "Increasing octane slew rate" VALUE 0x001c3a12 /* @ECU_Address@OCT_slew_inc@0x01002AE8@ */ ECIPP_ALIGNMENT_UWORD 100 Compu_OCT_slew_inc 0 99.9984741210938 /end CHARACTERISTIC
/begin COMPU_METHOD Compu_OCT_slew_inc " " RAT_FUNC "%.2" "%/sec" COEFFS 0 655.36 0 0 0 1 /end COMPU_METHOD
/begin CHARACTERISTIC OCT_slew_dec "Decreasing octane minimum Kp" VALUE 0x001c3a0a /* @ECU_Address@OCT_slew_dec@0x01002AF0@ */ ECIPP_ALIGNMENT_UWORD 100 Compu_OCT_slew_dec 0 99.9984741210938 /end CHARACTERISTIC
/begin COMPU_METHOD Compu_OCT_slew_dec " " RAT_FUNC "%.2" "%/sec" COEFFS 0 655.36 0 0 0 1 /end COMPU_METHOD
/begin CHARACTERISTIC OCT_update_wait "Octane adapt validation wait" VALUE 0x001c3a16 /* @ECU_Address@OCT_update_wait@0x01002AF8@ */ ECIPP_ALIGNMENT_UWORD 66 Compu_OCT_update_wait 0 65.535 /end CHARACTERISTIC
/begin COMPU_METHOD Compu_OCT_update_wait " " RAT_FUNC "%.1" "sec" COEFFS 0 1000 0 0 0 1 /end COMPU_METHOD
/begin CHARACTERISTIC OCT_MAPss_win "Octane adapt steady-state +/- MAP" VALUE 0x001c39ee /* @ECU_Address@OCT_MAPss_win@0x01002B00@ */ ECIPP_ALIGNMENT_UWORD 256 Compu_OCT_MAPss_win 0 255.99609375 /end CHARACTERISTIC
/begin COMPU_METHOD Compu_OCT_MAPss_win " " RAT_FUNC "%.2" "psia" COEFFS 0 256 0 0 0 1 /end COMPU_METHOD
/begin CHARACTERISTIC OCT_RPMss_win "Octane adapt steady-state +/- RPM" VALUE 0x001c39f0 /* @ECU_Address@OCT_RPMss_win@0x01002B08@ */ ECIPP_ALIGNMENT_UWORD 65535 Compu_OCT_RPMss_win 0 65535 /end CHARACTERISTIC
/begin COMPU_METHOD Compu_OCT_RPMss_win " " RAT_FUNC "%.0" "rpm" COEFFS 0 1 0 0 0 1 /end COMPU_METHOD
/begin CHARACTERISTIC OCT_ss_tau "Octane steady-state low-pass tau" VALUE 0x001c3a1c /* @ECU_Address@OCT_ss_tau@0x01002B10@ */ ECIPP_ALIGNMENT_UWORD 3277 Compu_OCT_ss_tau 0.0045084 3276.8 /end CHARACTERISTIC
/begin COMPU_METHOD Compu_OCT_ss_tau " " FORM "%.1" "sec"
 /begin FORMULA "-0.05 / log(1 - (X1 / 65536))" FORMULA_INV "(1 - exp(-0.05/X1)) * 65536" /end FORMULA
/end COMPU_METHOD
/begin CHARACTERISTIC OCT_run_wait "Octane estimation engine start wait" VALUE 0x001c3a08 /* @ECU_Address@OCT_run_wait@0x01002B18@ */ ECIPP_ALIGNMENT_UWORD 65535 Compu_OCT_run_wait 0 65535 /end CHARACTERISTIC
/begin COMPU_METHOD Compu_OCT_run_wait " " RAT_FUNC "%.0" "sec" COEFFS 0 1 0 0 0 1 /end COMPU_METHOD
/begin CHARACTERISTIC OCT_ECT_ena "Octane estimation minimum ECT" VALUE 0x001c39ec /* @ECU_Address@OCT_ECT_ena@0x01002B20@ */ ECIPP_ALIGNMENT_UWORD 564 Compu_OCT_ECT_ena -460 563.984375 /end CHARACTERISTIC
/begin COMPU_METHOD Compu_OCT_ECT_ena " " RAT_FUNC "%.1" "deg F" COEFFS 0 64 29440 0 0 1 /end COMPU_METHOD
/begin CHARACTERISTIC OCT_min_MAP "Octane estimation minimum MAP" VALUE 0x001c3a00 /* @ECU_Address@OCT_min_MAP@0x01002B28@ */ ECIPP_ALIGNMENT_UWORD 256 Compu_OCT_min_MAP 0 255.99609375 /end CHARACTERISTIC
/begin COMPU_METHOD Compu_OCT_min_MAP " " RAT_FUNC "%.2" "psia" COEFFS 0 256 0 0 0 1 /end COMPU_METHOD
/begin CHARACTERISTIC OCT_max_MAP "Octane estimation maximum MAP" VALUE 0x001c39fc /* @ECU_Address@OCT_max_MAP@0x01002B30@ */ ECIPP_ALIGNMENT_UWORD 256 Compu_OCT_max_MAP 0 255.99609375 /end CHARACTERISTIC
/begin COMPU_METHOD Compu_OCT_max_MAP " " RAT_FUNC "%.2" "psia" COEFFS 0 256 0 0 0 1 /end COMPU_METHOD
/begin CHARACTERISTIC OCT_min_RPM "Octane estimation minimum RPM" VALUE 0x001c3a02 /* @ECU_Address@OCT_min_RPM@0x01002B38@ */ ECIPP_ALIGNMENT_UWORD 65535 Compu_OCT_min_RPM 0 65535 /end CHARACTERISTIC
/begin COMPU_METHOD Compu_OCT_min_RPM " " RAT_FUNC "%.0" "rpm" COEFFS 0 1 0 0 0 1 /end COMPU_METHOD
/begin CHARACTERISTIC OCT_max_RPM "Octane estimation maximum RPM" VALUE 0x001c39fe /* @ECU_Address@OCT_max_RPM@0x01002B40@ */ ECIPP_ALIGNMENT_UWORD 65535 Compu_OCT_max_RPM 0 65535 /end CHARACTERISTIC
/begin COMPU_METHOD Compu_OCT_max_RPM " " RAT_FUNC "%.0" "rpm" COEFFS 0 1 0 0 0 1 /end COMPU_METHOD
/begin MEASUREMENT OCT_update_tmr "Octane adapt validation timer" UWORD Compu_OCT_update_tmr 0 0 0 65.535 ECU_ADDRESS 0x01002B50 /end MEASUREMENT
/begin COMPU_METHOD Compu_OCT_update_tmr " " RAT_FUNC "%.1" "sec" COEFFS 0 1000 0 0 0 1 /end COMPU_METHOD
/begin MEASUREMENT OCT_MAPss "Octane adapt steady-state MAP" UWORD Compu_OCT_MAPss 0 0 0 255.99609375 ECU_ADDRESS 0x01002B58 /end MEASUREMENT
/begin COMPU_METHOD Compu_OCT_MAPss " " RAT_FUNC "%.2" "psia" COEFFS 0 256 0 0 0 1 /end COMPU_METHOD
/begin MEASUREMENT OCT_RPMss "Octane adapt steady-state RPM" UWORD Compu_OCT_RPMss 0 0 0 65535 ECU_ADDRESS 0x01002B60 /end MEASUREMENT
/begin COMPU_METHOD Compu_OCT_RPMss " " RAT_FUNC "%.0" "rpm" COEFFS 0 1 0 0 0 1 /end COMPU_METHOD
/begin MEASUREMENT spk_adv_altOCT "High octane base advance" SWORD Compu_spk_adv_altOCT 0 0 -2048 2047.9375 ECU_ADDRESS 0x01002B68 /end MEASUREMENT
/begin COMPU_METHOD Compu_spk_adv_altOCT " " RAT_FUNC "%.1" "CAD BTDC" COEFFS 0 16 0 0 0 1 /end COMPU_METHOD
/begin MEASUREMENT spk_adv_OCTcomp "Octane compensated base advance" SWORD Compu_spk_adv_OCTcomp 0 0 -2048 2047.9375 ECU_ADDRESS 0x01002B70 /end MEASUREMENT
/begin COMPU_METHOD Compu_spk_adv_OCTcomp " " RAT_FUNC "%.1" "CAD BTDC" COEFFS 0 16 0 0 0 1 /end COMPU_METHOD
/begin CHARACTERISTIC OCT_init_mode "Key-on octane rating reset mode{OCT_init_mode&0xff=0:Use last value}{OCT_init_mode&0xff=1:Reset to default}" VALUE 0x001c3a48 /* @ECU_Address@OCT_init_mode@0x01002B78@ */ ECIPP_ALIGNMENT_UBYTE 255 OCT_init_mode_COMPU_VTAB 0 255 BIT_MASK 0xff /end CHARACTERISTIC
/begin COMPU_METHOD OCT_init_mode_COMPU_VTAB "Verbal Table" TAB_VERB "%.0" "list" COMPU_TAB_REF OCT_init_mode_COMPU_VTAB_REF /end COMPU_METHOD
/begin COMPU_VTAB OCT_init_mode_COMPU_VTAB_REF "Verbal Table" TAB_VERB 2 0 "Use last value" 1 "Reset to default" DEFAULT_VALUE "UNKNOWN" /end COMPU_VTAB
/begin CHARACTERISTIC FKNK_ena "Fuel-based knock control{FKNK_ena&0xff=0:Disabled}{FKNK_ena&0xff=1:Enabled}" VALUE 0x001c3a1e /* @ECU_Address@FKNK_ena@0x01002B80@ */ ECIPP_ALIGNMENT_UBYTE 255 FKNK_ena_COMPU_VTAB 0 255 BIT_MASK 0xff /end CHARACTERISTIC
/begin COMPU_METHOD FKNK_ena_COMPU_VTAB "Verbal Table" TAB_VERB "%.0" "list" COMPU_TAB_REF FKNK_ena_COMPU_VTAB_REF /end COMPU_METHOD
/begin COMPU_VTAB FKNK_ena_COMPU_VTAB_REF "Verbal Table" TAB_VERB 2 0 "Disabled" 1 "Enabled" DEFAULT_VALUE "UNKNOWN" /end COMPU_VTAB
/begin CHARACTERISTIC FKNK_ret_start "Fuel-based knock control initiation" VALUE 0x001c39cc /* @ECU_Address@FKNK_ret_start@0x01002B88@ */ ECIPP_ALIGNMENT_UWORD 128 Compu_FKNK_ret_start 0 127.998046875 /end CHARACTERISTIC
/begin COMPU_METHOD Compu_FKNK_ret_start " " RAT_FUNC "%.1" "CAD retard" COEFFS 0 512 0 0 0 1 /end COMPU_METHOD
/begin CHARACTERISTIC FKNK_ret_max "Fuel-based knock control completion" VALUE 0x001c39ca /* @ECU_Address@FKNK_ret_max@0x01002B90@ */ ECIPP_ALIGNMENT_UWORD 128 Compu_FKNK_ret_max 0 127.998046875 /end CHARACTERISTIC
/begin COMPU_METHOD Compu_FKNK_ret_max " " RAT_FUNC "%.1" "CAD retard" COEFFS 0 512 0 0 0 1 /end COMPU_METHOD
/begin CHARACTERISTIC FKNK_enrich_max "Maximum fuel modifier at completion" VALUE 0x001c34f6 /* @ECU_Address@FKNK_enrich_max@0x01002B98@ */ ECIPP_ALIGNMENT_SWORD 200 Compu_FKNK_enrich_max -200 199.993896484375 /end CHARACTERISTIC
/begin COMPU_METHOD Compu_FKNK_enrich_max " " RAT_FUNC "%.1" "%" COEFFS 0 163.84 0 0 0 1 /end COMPU_METHOD
/begin CHARACTERISTIC FKNK_enr_inc_tau "Increasing fuel modifier low-pass tau" VALUE 0x001c3a1a /* @ECU_Address@FKNK_enr_inc_tau@0x01002BA0@ */ ECIPP_ALIGNMENT_UWORD 163840 Compu_FKNK_enr_inc_tau 0.16703 163840 /end CHARACTERISTIC
/begin COMPU_METHOD Compu_FKNK_enr_inc_tau " " FORM "%.0" "ms"
 /begin FORMULA "-5 / log(1.0000000000001 - (X1 / 32768))" FORMULA_INV "(1.0000000000001 - exp(-5/X1)) * 32768" /end FORMULA
/end COMPU_METHOD
/begin CHARACTERISTIC FKNK_enr_dec_tau "Decreasing fuel modifier low-pass tau" VALUE 0x001c3a18 /* @ECU_Address@FKNK_enr_dec_tau@0x01002BA8@ */ ECIPP_ALIGNMENT_UWORD 163840 Compu_FKNK_enr_dec_tau 0.16703 163840 /end CHARACTERISTIC
/begin COMPU_METHOD Compu_FKNK_enr_dec_tau " " FORM "%.0" "ms"
 /begin FORMULA "-5 / log(1.0000000000001 - (X1 / 32768))" FORMULA_INV "(1.0000000000001 - exp(-5/X1)) * 32768" /end FORMULA
/end COMPU_METHOD
/begin MEASUREMENT FKNK_enrich_mod "Current knock fuel modifier" SWORD Compu_FKNK_enrich_mod 0 0 -200 199.993896484375 ECU_ADDRESS 0x01002BB0 /end MEASUREMENT
/begin COMPU_METHOD Compu_FKNK_enrich_mod " " RAT_FUNC "%.1" "%" COEFFS 0 163.84 0 0 0 1 /end COMPU_METHOD
/begin CHARACTERISTIC KNK_adv_KRreti "Knock advance gain rolloff initiation" VALUE 0x001c39e0 /* @ECU_Address@KNK_adv_KRreti@0x01002BE8@ */ ECIPP_ALIGNMENT_UWORD 128 Compu_KNK_adv_KRreti 0 127.998046875 /end CHARACTERISTIC
/begin COMPU_METHOD Compu_KNK_adv_KRreti " " RAT_FUNC "%.3" "CAD retard" COEFFS 0 512 0 0 0 1 /end COMPU_METHOD
/begin CHARACTERISTIC KNK_adv_KRretc "Knock advance gain rolloff completion" VALUE 0x001c39de /* @ECU_Address@KNK_adv_KRretc@0x01002BF0@ */ ECIPP_ALIGNMENT_UWORD 128 Compu_KNK_adv_KRretc 0 127.998046875 /end CHARACTERISTIC
/begin COMPU_METHOD Compu_KNK_adv_KRretc " " RAT_FUNC "%.3" "CAD retard" COEFFS 0 512 0 0 0 1 /end COMPU_METHOD
/begin CHARACTERISTIC KNK_adv_KRmin "Knock advance rolloff gain minimum" VALUE 0x001c39dc /* @ECU_Address@KNK_adv_KRmin@0x01002BF8@ */ ECIPP_ALIGNMENT_UWORD 128 Compu_KNK_adv_KRmin 0 127.998046875 /end CHARACTERISTIC
/begin COMPU_METHOD Compu_KNK_adv_KRmin " " RAT_FUNC "%.3" "CAD / cycle" COEFFS 0 512 0 0 0 1 /end COMPU_METHOD
/begin CHARACTERISTIC OCT_mem_type "Adaptive octane memory type{OCT_mem_type&0xff=0:Single Point}{OCT_mem_type&0xff=1:Table Based}" VALUE 0x001c3a4a /* @ECU_Address@OCT_mem_type@0x01002C00@ */ ECIPP_ALIGNMENT_UBYTE 255 OCT_mem_type_COMPU_VTAB 0 255 BIT_MASK 0xff /end CHARACTERISTIC
/begin COMPU_METHOD OCT_mem_type_COMPU_VTAB "Verbal Table" TAB_VERB "%.0" "list" COMPU_TAB_REF OCT_mem_type_COMPU_VTAB_REF /end COMPU_METHOD
/begin COMPU_VTAB OCT_mem_type_COMPU_VTAB_REF "Verbal Table" TAB_VERB 2 0 "Single Point" 1 "Table Based" DEFAULT_VALUE "UNKNOWN" /end COMPU_VTAB
/begin CHARACTERISTIC OCT_inc_wait "Octane increase wait time" VALUE 0x001c39f6 /* @ECU_Address@OCT_inc_wait@0x010031D0@ */ ECIPP_ALIGNMENT_UWORD 66 Compu_OCT_inc_wait 0 65.535 /end CHARACTERISTIC
/begin COMPU_METHOD Compu_OCT_inc_wait " " RAT_FUNC "%.1" "sec" COEFFS 0 1000 0 0 0 1 /end COMPU_METHOD
/begin CHARACTERISTIC OCT_inc_wait_pct "Octane increase wait knock activity" VALUE 0x001c39f8 /* @ECU_Address@OCT_inc_wait_pct@0x010031D8@ */ ECIPP_ALIGNMENT_UWORD 100 Compu_OCT_inc_wait_pct 0 99.9984741210938 /end CHARACTERISTIC
/begin COMPU_METHOD Compu_OCT_inc_wait_pct " " RAT_FUNC "%.1" "%" COEFFS 0 655.36 0 0 0 1 /end COMPU_METHOD
/begin MEASUREMENT OCT_inc_tmr "Octane increase wait timer" UWORD Compu_OCT_inc_tmr 0 0 0 65.535 ECU_ADDRESS 0x010031E0 /end MEASUREMENT
/begin COMPU_METHOD Compu_OCT_inc_tmr " " RAT_FUNC "%.1" "sec" COEFFS 0 1000 0 0 0 1 /end COMPU_METHOD
/begin MEASUREMENT TSTcompression "Compression test command{TSTcompression&0xff=0:Disabled}{TSTcompression&0xff=1:Active}" UBYTE TSTcompression_COMPU_VTAB 0 0 0 255 ECU_ADDRESS 0x010031F0 BIT_MASK 0xff /end MEASUREMENT
/begin COMPU_METHOD TSTcompression_COMPU_VTAB "Verbal Table" TAB_VERB "%.0" "list" COMPU_TAB_REF TSTcompression_COMPU_VTAB_REF /end COMPU_METHOD
/begin COMPU_VTAB TSTcompression_COMPU_VTAB_REF "Verbal Table" TAB_VERB 2 0 "Disabled" 1 "Active" DEFAULT_VALUE "UNKNOWN" /end COMPU_VTAB
/begin MEASUREMENT MSinj_kill "Injector kill test status{MSinj_kill&0xff=0:Test Not Started}{MSinj_kill&0xff=1:Test Running}{MSinj_kill&0xff=2:Test Finished}{MSinj_kill&0xff=3:Condition 1 Not Met}{MSinj_kill&0xff=4:Condition 2 Not Met}{MSinj_kill&0xff=5:Condition 3 Not Met}{MSinj_kill&" UBYTE MSinj_kill_COMPU_VTAB 0 0 0 255 ECU_ADDRESS 0x010032E0 BIT_MASK 0xff /end MEASUREMENT
/begin COMPU_METHOD MSinj_kill_COMPU_VTAB "Verbal Table" TAB_VERB "%.0" "list" COMPU_TAB_REF MSinj_kill_COMPU_VTAB_REF /end COMPU_METHOD
/begin COMPU_VTAB MSinj_kill_COMPU_VTAB_REF "Verbal Table" TAB_VERB 8 0 "Test Not Started" 1 "Test Running" 2 "Test Finished" 3 "Condition 1 Not Met" 4 "Condition 2 Not Met" 5 "Condition 3 Not Met" 6 "Condition 4 Not Met" 7 "Cannot Start Test" DEFAULT_VALUE "UNKNOWN" /end COMPU_VTAB
/begin MEASUREMENT MSspk_kill "Spark kill test status{MSspk_kill&0xff=0:Test Not Started}{MSspk_kill&0xff=1:Test Running}{MSspk_kill&0xff=2:Test Finished}{MSspk_kill&0xff=3:RPM Too High}{MSspk_kill&0xff=4:MAP Too High}{MSspk_kill&0xff=5:CBT Too High}{MSspk_kill&0xff=6:Condition 4 Not M" UBYTE MSspk_kill_COMPU_VTAB 0 0 0 255 ECU_ADDRESS 0x010032E8 BIT_MASK 0xff /end MEASUREMENT
/begin COMPU_METHOD MSspk_kill_COMPU_VTAB "Verbal Table" TAB_VERB "%.0" "list" COMPU_TAB_REF MSspk_kill_COMPU_VTAB_REF /end COMPU_METHOD
/begin COMPU_VTAB MSspk_kill_COMPU_VTAB_REF "Verbal Table" TAB_VERB 8 0 "Test Not Started" 1 "Test Running" 2 "Test Finished" 3 "RPM Too High" 4 "MAP Too High" 5 "CBT Too High" 6 "Condition 4 Not Met" 7 "Cannot Start Test" DEFAULT_VALUE "UNKNOWN" /end COMPU_VTAB
/begin MEASUREMENT MSinj_fire "Injector firing test status{MSinj_fire&0xff=0:Test Not Started}{MSinj_fire&0xff=1:Test Running}{MSinj_fire&0xff=2:Test Finished}{MSinj_fire&0xff=3:Condition 1 Not Met}{MSinj_fire&0xff=4:Condition 2 Not Met}{MSinj_fire&0xff=5:Condition 3 Not Met}{MSinj_fir" UBYTE MSinj_fire_COMPU_VTAB 0 0 0 255 ECU_ADDRESS 0x010032F8 BIT_MASK 0xff /end MEASUREMENT
/begin COMPU_METHOD MSinj_fire_COMPU_VTAB "Verbal Table" TAB_VERB "%.0" "list" COMPU_TAB_REF MSinj_fire_COMPU_VTAB_REF /end COMPU_METHOD
/begin COMPU_VTAB MSinj_fire_COMPU_VTAB_REF "Verbal Table" TAB_VERB 8 0 "Test Not Started" 1 "Test Running" 2 "Test Finished" 3 "Condition 1 Not Met" 4 "Condition 2 Not Met" 5 "Condition 3 Not Met" 6 "Condition 4 Not Met" 7 "Cannot Start Test" DEFAULT_VALUE "UNKNOWN" /end COMPU_VTAB
/begin MEASUREMENT MScompression "Compression test status{MScompression&0xff=0:Test Not Started}{MScompression&0xff=1:Test Running}{MScompression&0xff=2:Test Finished}{MScompression&0xff=3:Condition 1 Not Met}{MScompression&0xff=4:Condition 2 Not Met}{MScompression&0xff=5:Condition 3 Not " UBYTE MScompression_COMPU_VTAB 0 0 0 255 ECU_ADDRESS 0x01003300 BIT_MASK 0xff /end MEASUREMENT
/begin COMPU_METHOD MScompression_COMPU_VTAB "Verbal Table" TAB_VERB "%.0" "list" COMPU_TAB_REF MScompression_COMPU_VTAB_REF /end COMPU_METHOD
/begin COMPU_VTAB MScompression_COMPU_VTAB_REF "Verbal Table" TAB_VERB 8 0 "Test Not Started" 1 "Test Running" 2 "Test Finished" 3 "Condition 1 Not Met" 4 "Condition 2 Not Met" 5 "Condition 3 Not Met" 6 "Condition 4 Not Met" 7 "Cannot Start Test" DEFAULT_VALUE "UNKNOWN" /end COMPU_VTAB
/begin MEASUREMENT MSspk_fire "Spark firing test status{MSspk_fire&0xff=0:Test Not Started}{MSspk_fire&0xff=1:Test Running}{MSspk_fire&0xff=2:Test Finished}{MSspk_fire&0xff=3:Condition 1 Not Met}{MSspk_fire&0xff=4:Condition 2 Not Met}{MSspk_fire&0xff=5:Condition 3 Not Met}{MSspk_fire&0" UBYTE MSspk_fire_COMPU_VTAB 0 0 0 255 ECU_ADDRESS 0x01003308 BIT_MASK 0xff /end MEASUREMENT
/begin COMPU_METHOD MSspk_fire_COMPU_VTAB "Verbal Table" TAB_VERB "%.0" "list" COMPU_TAB_REF MSspk_fire_COMPU_VTAB_REF /end COMPU_METHOD
/begin COMPU_VTAB MSspk_fire_COMPU_VTAB_REF "Verbal Table" TAB_VERB 8 0 "Test Not Started" 1 "Test Running" 2 "Test Finished" 3 "Condition 1 Not Met" 4 "Condition 2 Not Met" 5 "Condition 3 Not Met" 6 "Condition 4 Not Met" 7 "Cannot Start Test" DEFAULT_VALUE "UNKNOWN" /end COMPU_VTAB
/begin MEASUREMENT MSDBW_test "DBW test status{MSDBW_test&0xff=0:Test Not Started}{MSDBW_test&0xff=1:Test Running}{MSDBW_test&0xff=2:Test Finished}{MSDBW_test&0xff=3:Condition 1 Not Met}{MSDBW_test&0xff=4:Condition 2 Not Met}{MSDBW_test&0xff=5:Condition 3 Not Met}{MSDBW_test&0xff=6:Con" UBYTE MSDBW_test_COMPU_VTAB 0 0 0 255 ECU_ADDRESS 0x01003310 BIT_MASK 0xff /end MEASUREMENT
/begin COMPU_METHOD MSDBW_test_COMPU_VTAB "Verbal Table" TAB_VERB "%.0" "list" COMPU_TAB_REF MSDBW_test_COMPU_VTAB_REF /end COMPU_METHOD
/begin COMPU_VTAB MSDBW_test_COMPU_VTAB_REF "Verbal Table" TAB_VERB 8 0 "Test Not Started" 1 "Test Running" 2 "Test Finished" 3 "Condition 1 Not Met" 4 "Condition 2 Not Met" 5 "Condition 3 Not Met" 6 "Condition 4 Not Met" 7 "Cannot Start Test" DEFAULT_VALUE "UNKNOWN" /end COMPU_VTAB
/begin MEASUREMENT MSmanual_ext_pwr "Manual external power test status{MSmanual_ext_pwr&0xff=0:Test Not Started}{MSmanual_ext_pwr&0xff=1:Test Running}{MSmanual_ext_pwr&0xff=2:Test Finished}{MSmanual_ext_pwr&0xff=3:Condition 1 Not Met}{MSmanual_ext_pwr&0xff=4:Condition 2 Not Met}{MSmanual_ext" UBYTE MSmanual_ext_pwr_COMPU_VTAB 0 0 0 255 ECU_ADDRESS 0x01003318 BIT_MASK 0xff /end MEASUREMENT
/begin COMPU_METHOD MSmanual_ext_pwr_COMPU_VTAB "Verbal Table" TAB_VERB "%.0" "list" COMPU_TAB_REF MSmanual_ext_pwr_COMPU_VTAB_REF /end COMPU_METHOD
/begin COMPU_VTAB MSmanual_ext_pwr_COMPU_VTAB_REF "Verbal Table" TAB_VERB 8 0 "Test Not Started" 1 "Test Running" 2 "Test Finished" 3 "Condition 1 Not Met" 4 "Condition 2 Not Met" 5 "Condition 3 Not Met" 6 "Condition 4 Not Met" 7 "Cannot Start Test" DEFAULT_VALUE "UNKNOWN" /end COMPU_VTAB
/begin MEASUREMENT TSTspk_fire "Spark firing test command{TSTspk_fire&0xff=0:Disabled}{TSTspk_fire&0xff=1:Coil 1}{TSTspk_fire&0xff=2:Coil 2}{TSTspk_fire&0xff=3:Coil 3}{TSTspk_fire&0xff=4:Coil 4}{TSTspk_fire&0xff=5:Coil 5}{TSTspk_fire&0xff=6:Coil 6}{TSTspk_fire&0xff=7:Coil 7}{TSTspk_fire" UBYTE TSTspk_fire_COMPU_VTAB 0 0 0 255 ECU_ADDRESS 0x01003370 BIT_MASK 0xff /end MEASUREMENT
/begin COMPU_METHOD TSTspk_fire_COMPU_VTAB "Verbal Table" TAB_VERB "%.0" "list" COMPU_TAB_REF TSTspk_fire_COMPU_VTAB_REF /end COMPU_METHOD
/begin COMPU_VTAB TSTspk_fire_COMPU_VTAB_REF "Verbal Table" TAB_VERB 13 0 "Disabled" 1 "Coil 1" 2 "Coil 2" 3 "Coil 3" 4 "Coil 4" 5 "Coil 5" 6 "Coil 6" 7 "Coil 7" 8 "Coil 8" 9 "Coil 9" 10 "Coil 10" 11 "Coil 11" 12 "Coil 12" DEFAULT_VALUE "UNKNOWN" /end COMPU_VTAB
/begin MEASUREMENT TSTinj_fire "Injector firing test command{TSTinj_fire&0xff=0:Disabled}{TSTinj_fire&0xff=1:Injector 1}{TSTinj_fire&0xff=2:Injector 2}{TSTinj_fire&0xff=3:Injector 3}{TSTinj_fire&0xff=4:Injector 4}{TSTinj_fire&0xff=5:Injector 5}{TSTinj_fire&0xff=6:Injector 6}{TSTinj_fire" UBYTE TSTinj_fire_COMPU_VTAB 0 0 0 255 ECU_ADDRESS 0x01003388 BIT_MASK 0xff /end MEASUREMENT
/begin COMPU_METHOD TSTinj_fire_COMPU_VTAB "Verbal Table" TAB_VERB "%.0" "list" COMPU_TAB_REF TSTinj_fire_COMPU_VTAB_REF /end COMPU_METHOD
/begin COMPU_VTAB TSTinj_fire_COMPU_VTAB_REF "Verbal Table" TAB_VERB 13 0 "Disabled" 1 "Injector 1" 2 "Injector 2" 3 "Injector 3" 4 "Injector 4" 5 "Injector 5" 6 "Injector 6" 7 "Injector 7" 8 "Injector 8" 9 "Injector 9" 10 "Injector 10" 11 "Injector 11" 12 "Injector 12" DEFAULT_VALUE "UNKNOWN" /end COMPU_VTAB
/begin MEASUREMENT KNK2_win_avg "Knock sensor 2" UWORD Compu_KNK2_win_avg 0 0 0 63.9990234375 ECU_ADDRESS 0x010034C8 /end MEASUREMENT
/begin COMPU_METHOD Compu_KNK2_win_avg " " RAT_FUNC "%.3" "RMS volts" COEFFS 0 1024 0 0 0 1 /end COMPU_METHOD
/begin MEASUREMENT AL_erase_req "Clear Adaptive Memory{AL_erase_req&0xff=0x00:Clear Adaptive}{AL_erase_req&0xff=0x01:Clearing...}" UBYTE AL_erase_req_COMPU_VTAB 0 0 0 255 ECU_ADDRESS 0x01004678 BIT_MASK 0xff /end MEASUREMENT
/begin COMPU_METHOD AL_erase_req_COMPU_VTAB "Verbal Table" TAB_VERB "%.0" "list" COMPU_TAB_REF AL_erase_req_COMPU_VTAB_REF /end COMPU_METHOD
/begin COMPU_VTAB AL_erase_req_COMPU_VTAB_REF "Verbal Table" TAB_VERB 2 0x00 "Clear Adaptive" 0x01 "Clearing..." DEFAULT_VALUE "UNKNOWN" /end COMPU_VTAB
/begin CHARACTERISTIC KNK_Ksel "Knock analog input gain selection{KNK_Ksel&0xff=0:Low Gain - Tuned Response}{KNK_Ksel&0xff=1:High Gain - Flat Response}" VALUE 0x001c3a20 /* @ECU_Address@KNK_Ksel@0x01004F70@ */ ECIPP_ALIGNMENT_UBYTE 255 KNK_Ksel_COMPU_VTAB 0 255 BIT_MASK 0xff /end CHARACTERISTIC
/begin COMPU_METHOD KNK_Ksel_COMPU_VTAB "Verbal Table" TAB_VERB "%.0" "list" COMPU_TAB_REF KNK_Ksel_COMPU_VTAB_REF /end COMPU_METHOD
/begin COMPU_VTAB KNK_Ksel_COMPU_VTAB_REF "Verbal Table" TAB_VERB 2 0 "Low Gain - Tuned Response" 1 "High Gain - Flat Response" DEFAULT_VALUE "UNKNOWN" /end COMPU_VTAB
/begin CHARACTERISTIC KNK_sens_cyl9 "Knock sensor assignment 9{KNK_sens_cyl9&0xff=0:Disabled}{KNK_sens_cyl9&0xff=1:Sensor 1}{KNK_sens_cyl9&0xff=2:Sensor 2}{KNK_sens_cyl9&0xff=3:Sensor 3}{KNK_sens_cyl9&0xff=4:Sensor 4}{KNK_sens_cyl9&0xff=5:Sensor 5}{KNK_sens_cyl9&0xff=6:Sensor 6}{KNK_sens_cyl" VALUE 0x001C3A37 /* @ECU_Address@KNK_sens_cyl9@0x01004F88@ */ ECIPP_ALIGNMENT_UBYTE 255 KNK_sens_cyl9_COMPU_VTAB 0 255 BIT_MASK 0xff /end CHARACTERISTIC
/begin COMPU_METHOD KNK_sens_cyl9_COMPU_VTAB "Verbal Table" TAB_VERB "%.0" "list" COMPU_TAB_REF KNK_sens_cyl9_COMPU_VTAB_REF /end COMPU_METHOD
/begin COMPU_VTAB KNK_sens_cyl9_COMPU_VTAB_REF "Verbal Table" TAB_VERB 13 0 "Disabled" 1 "Sensor 1" 2 "Sensor 2" 3 "Sensor 3" 4 "Sensor 4" 5 "Sensor 5" 6 "Sensor 6" 7 "Sensor 7" 8 "Sensor 8" 9 "Sensor 9" 10 "Sensor 10" 11 "Sensor 11" 12 "Sensor 12" DEFAULT_VALUE "UNKNOWN" /end COMPU_VTAB
/begin CHARACTERISTIC KNK_sens_cyl10 "Knock sensor assignment 10{KNK_sens_cyl10&0xff=0:Disabled}{KNK_sens_cyl10&0xff=1:Sensor 1}{KNK_sens_cyl10&0xff=2:Sensor 2}{KNK_sens_cyl10&0xff=3:Sensor 3}{KNK_sens_cyl10&0xff=4:Sensor 4}{KNK_sens_cyl10&0xff=5:Sensor 5}{KNK_sens_cyl10&0xff=6:Sensor 6}{KNK_" VALUE 0x001C3A38 /* @ECU_Address@KNK_sens_cyl10@0x01004F90@ */ ECIPP_ALIGNMENT_UBYTE 255 KNK_sens_cyl10_COMPU_VTAB 0 255 BIT_MASK 0xff /end CHARACTERISTIC
/begin COMPU_METHOD KNK_sens_cyl10_COMPU_VTAB "Verbal Table" TAB_VERB "%.0" "list" COMPU_TAB_REF KNK_sens_cyl10_COMPU_VTAB_REF /end COMPU_METHOD
/begin COMPU_VTAB KNK_sens_cyl10_COMPU_VTAB_REF "Verbal Table" TAB_VERB 13 0 "Disabled" 1 "Sensor 1" 2 "Sensor 2" 3 "Sensor 3" 4 "Sensor 4" 5 "Sensor 5" 6 "Sensor 6" 7 "Sensor 7" 8 "Sensor 8" 9 "Sensor 9" 10 "Sensor 10" 11 "Sensor 11" 12 "Sensor 12" DEFAULT_VALUE "UNKNOWN" /end COMPU_VTAB
/begin MEASUREMENT TransCrk_dis "Trans in-gear override active" UBYTE Compu_TransCrk_dis 0 0 0 255 ECU_ADDRESS 0x01005E68 /end MEASUREMENT
/begin COMPU_METHOD Compu_TransCrk_dis " " RAT_FUNC "%.0" "-" COEFFS 0 1 0 0 0 1 /end COMPU_METHOD
/begin MEASUREMENT coil1_adv_mod "Coil1 advance modifier" SWORD Compu_coil1_adv_mod 0 0 -2048 2047.9375 ECU_ADDRESS 0x01006B38 /end MEASUREMENT
/begin COMPU_METHOD Compu_coil1_adv_mod " " RAT_FUNC "%.1" "CAD BTDC" COEFFS 0 16 0 0 0 1 /end COMPU_METHOD
/begin MEASUREMENT coil2_adv_mod "Coil2 advance modifier" SWORD Compu_coil2_adv_mod 0 0 -2048 2047.9375 ECU_ADDRESS 0x01006B40 /end MEASUREMENT
/begin COMPU_METHOD Compu_coil2_adv_mod " " RAT_FUNC "%.1" "CAD BTDC" COEFFS 0 16 0 0 0 1 /end COMPU_METHOD
/begin MEASUREMENT coil3_adv_mod "Coil3 advance modifier" SWORD Compu_coil3_adv_mod 0 0 -2048 2047.9375 ECU_ADDRESS 0x01006B48 /end MEASUREMENT
/begin COMPU_METHOD Compu_coil3_adv_mod " " RAT_FUNC "%.1" "CAD BTDC" COEFFS 0 16 0 0 0 1 /end COMPU_METHOD
/begin MEASUREMENT coil4_adv_mod "Coil4 advance modifier" SWORD Compu_coil4_adv_mod 0 0 -2048 2047.9375 ECU_ADDRESS 0x01006B50 /end MEASUREMENT
/begin COMPU_METHOD Compu_coil4_adv_mod " " RAT_FUNC "%.1" "CAD BTDC" COEFFS 0 16 0 0 0 1 /end COMPU_METHOD
/begin MEASUREMENT coil5_adv_mod "Coil5 advance modifier" SWORD Compu_coil5_adv_mod 0 0 -2048 2047.9375 ECU_ADDRESS 0x01006B58 /end MEASUREMENT
/begin COMPU_METHOD Compu_coil5_adv_mod " " RAT_FUNC "%.1" "CAD BTDC" COEFFS 0 16 0 0 0 1 /end COMPU_METHOD
/begin MEASUREMENT coil6_adv_mod "Coil6 advance modifier" SWORD Compu_coil6_adv_mod 0 0 -2048 2047.9375 ECU_ADDRESS 0x01006B60 /end MEASUREMENT
/begin COMPU_METHOD Compu_coil6_adv_mod " " RAT_FUNC "%.1" "CAD BTDC" COEFFS 0 16 0 0 0 1 /end COMPU_METHOD
/begin MEASUREMENT coil7_adv_mod "Coil7 advance modifier" SWORD Compu_coil7_adv_mod 0 0 -2048 2047.9375 ECU_ADDRESS 0x01006B68 /end MEASUREMENT
/begin COMPU_METHOD Compu_coil7_adv_mod " " RAT_FUNC "%.1" "CAD BTDC" COEFFS 0 16 0 0 0 1 /end COMPU_METHOD
/begin MEASUREMENT coil8_adv_mod "Coil8 advance modifier" SWORD Compu_coil8_adv_mod 0 0 -2048 2047.9375 ECU_ADDRESS 0x01006B70 /end MEASUREMENT
/begin COMPU_METHOD Compu_coil8_adv_mod " " RAT_FUNC "%.1" "CAD BTDC" COEFFS 0 16 0 0 0 1 /end COMPU_METHOD
/begin MEASUREMENT coil9_adv_mod "Coil9 advance modifier" SWORD Compu_coil9_adv_mod 0 0 -2048 2047.9375 ECU_ADDRESS 0x01006B78 /end MEASUREMENT
/begin COMPU_METHOD Compu_coil9_adv_mod " " RAT_FUNC "%.1" "CAD BTDC" COEFFS 0 16 0 0 0 1 /end COMPU_METHOD
/begin MEASUREMENT coil10_adv_mod "Coil10 advance modifier" SWORD Compu_coil10_adv_mod 0 0 -2048 2047.9375 ECU_ADDRESS 0x01006B80 /end MEASUREMENT
/begin COMPU_METHOD Compu_coil10_adv_mod " " RAT_FUNC "%.1" "CAD BTDC" COEFFS 0 16 0 0 0 1 /end COMPU_METHOD
/begin MEASUREMENT coil1_drv_latch "Coil1 (FO) drive" UWORD Compu_coil1_drv_latch 0 0 0 100.022893772894 ECU_ADDRESS 0x01006BD8 /end MEASUREMENT
/begin COMPU_METHOD Compu_coil1_drv_latch " " RAT_FUNC "%.1" "% FS" COEFFS 0 655.2 0 0 0 1 /end COMPU_METHOD
/begin MEASUREMENT coil2_drv_latch "Coil2 (FO) drive" UWORD Compu_coil2_drv_latch 0 0 0 100.022893772894 ECU_ADDRESS 0x01006BE0 /end MEASUREMENT
/begin COMPU_METHOD Compu_coil2_drv_latch " " RAT_FUNC "%.1" "% FS" COEFFS 0 655.2 0 0 0 1 /end COMPU_METHOD
/begin MEASUREMENT coil3_drv_latch "Coil3 (FO) drive" UWORD Compu_coil3_drv_latch 0 0 0 100.022893772894 ECU_ADDRESS 0x01006BE8 /end MEASUREMENT
/begin COMPU_METHOD Compu_coil3_drv_latch " " RAT_FUNC "%.1" "% FS" COEFFS 0 655.2 0 0 0 1 /end COMPU_METHOD
/begin MEASUREMENT coil4_drv_latch "Coil4 (FO) drive" UWORD Compu_coil4_drv_latch 0 0 0 100.022893772894 ECU_ADDRESS 0x01006BF0 /end MEASUREMENT
/begin COMPU_METHOD Compu_coil4_drv_latch " " RAT_FUNC "%.1" "% FS" COEFFS 0 655.2 0 0 0 1 /end COMPU_METHOD
/begin MEASUREMENT coil5_drv_latch "Coil5 (FO) drive" UWORD Compu_coil5_drv_latch 0 0 0 100.022893772894 ECU_ADDRESS 0x01006BF8 /end MEASUREMENT
/begin COMPU_METHOD Compu_coil5_drv_latch " " RAT_FUNC "%.1" "% FS" COEFFS 0 655.2 0 0 0 1 /end COMPU_METHOD
/begin MEASUREMENT coil6_drv_latch "Coil6 (FO) drive" UWORD Compu_coil6_drv_latch 0 0 0 100.022893772894 ECU_ADDRESS 0x01006C00 /end MEASUREMENT
/begin COMPU_METHOD Compu_coil6_drv_latch " " RAT_FUNC "%.1" "% FS" COEFFS 0 655.2 0 0 0 1 /end COMPU_METHOD
/begin MEASUREMENT coil7_drv_latch "Coil7 (FO) drive" UWORD Compu_coil7_drv_latch 0 0 0 100.022893772894 ECU_ADDRESS 0x01006C08 /end MEASUREMENT
/begin COMPU_METHOD Compu_coil7_drv_latch " " RAT_FUNC "%.1" "% FS" COEFFS 0 655.2 0 0 0 1 /end COMPU_METHOD
/begin MEASUREMENT coil8_drv_latch "Coil8 (FO) drive" UWORD Compu_coil8_drv_latch 0 0 0 100.022893772894 ECU_ADDRESS 0x01006C10 /end MEASUREMENT
/begin COMPU_METHOD Compu_coil8_drv_latch " " RAT_FUNC "%.1" "% FS" COEFFS 0 655.2 0 0 0 1 /end COMPU_METHOD
/begin MEASUREMENT coil9_drv_latch "Coil9 (FO) drive" UWORD Compu_coil9_drv_latch 0 0 0 100.022893772894 ECU_ADDRESS 0x010071D0 /end MEASUREMENT
/begin COMPU_METHOD Compu_coil9_drv_latch " " RAT_FUNC "%.1" "% FS" COEFFS 0 655.2 0 0 0 1 /end COMPU_METHOD
/begin MEASUREMENT coil10_drv_latch "Coil10 (FO) drive" UWORD Compu_coil10_drv_latch 0 0 0 100.022893772894 ECU_ADDRESS 0x010071D8 /end MEASUREMENT
/begin COMPU_METHOD Compu_coil10_drv_latch " " RAT_FUNC "%.1" "% FS" COEFFS 0 655.2 0 0 0 1 /end COMPU_METHOD
/begin CHARACTERISTIC OCT_init_table "Cold power-up default octane mode{OCT_init_table&0xff=0:Single Point}{OCT_init_table&0xff=1:Table Based}" VALUE 0x001c3a49 /* @ECU_Address@OCT_init_table@0x01008558@ */ ECIPP_ALIGNMENT_UBYTE 255 OCT_init_table_COMPU_VTAB 0 255 BIT_MASK 0xff /end CHARACTERISTIC
/begin COMPU_METHOD OCT_init_table_COMPU_VTAB "Verbal Table" TAB_VERB "%.0" "list" COMPU_TAB_REF OCT_init_table_COMPU_VTAB_REF /end COMPU_METHOD
/begin COMPU_VTAB OCT_init_table_COMPU_VTAB_REF "Verbal Table" TAB_VERB 2 0 "Single Point" 1 "Table Based" DEFAULT_VALUE "UNKNOWN" /end COMPU_VTAB
/begin MEASUREMENT OILT "Oil temperature" UWORD Compu_OILT 0 0 -460 7731.875 ECU_ADDRESS 0x0100A1E0 /end MEASUREMENT
/begin COMPU_METHOD Compu_OILT " " RAT_FUNC "%.1" "deg F" COEFFS 0 8 3680 0 0 1 /end COMPU_METHOD
/begin CHARACTERISTIC KNK_mult_cyl1 "Knock signal multiplier 1{KNK_mult_cyl1&0xff=0:Standard}{KNK_mult_cyl1&0xff=1:Alternate A}{KNK_mult_cyl1&0xff=2:Alternate B}" VALUE 0x001C3A23 /* @ECU_Address@KNK_mult_cyl1@0x0100DB40@ */ ECIPP_ALIGNMENT_UBYTE 255 KNK_mult_cyl1_COMPU_VTAB 0 255 BIT_MASK 0xff /end CHARACTERISTIC
/begin COMPU_METHOD KNK_mult_cyl1_COMPU_VTAB "Verbal Table" TAB_VERB "%.0" "list" COMPU_TAB_REF KNK_mult_cyl1_COMPU_VTAB_REF /end COMPU_METHOD
/begin COMPU_VTAB KNK_mult_cyl1_COMPU_VTAB_REF "Verbal Table" TAB_VERB 3 0 "Standard" 1 "Alternate A" 2 "Alternate B" DEFAULT_VALUE "UNKNOWN" /end COMPU_VTAB
/begin CHARACTERISTIC KNK_mult_cyl2 "Knock signal multiplier 2{KNK_mult_cyl2&0xff=0:Standard}{KNK_mult_cyl2&0xff=1:Alternate A}{KNK_mult_cyl2&0xff=2:Alternate B}" VALUE 0x001C3A24 /* @ECU_Address@KNK_mult_cyl2@0x0100DB48@ */ ECIPP_ALIGNMENT_UBYTE 255 KNK_mult_cyl2_COMPU_VTAB 0 255 BIT_MASK 0xff /end CHARACTERISTIC
/begin COMPU_METHOD KNK_mult_cyl2_COMPU_VTAB "Verbal Table" TAB_VERB "%.0" "list" COMPU_TAB_REF KNK_mult_cyl2_COMPU_VTAB_REF /end COMPU_METHOD
/begin COMPU_VTAB KNK_mult_cyl2_COMPU_VTAB_REF "Verbal Table" TAB_VERB 3 0 "Standard" 1 "Alternate A" 2 "Alternate B" DEFAULT_VALUE "UNKNOWN" /end COMPU_VTAB
/begin CHARACTERISTIC KNK_mult_cyl3 "Knock signal multiplier 3{KNK_mult_cyl3&0xff=0:Standard}{KNK_mult_cyl3&0xff=1:Alternate A}{KNK_mult_cyl3&0xff=2:Alternate B}" VALUE 0x001C3A25 /* @ECU_Address@KNK_mult_cyl3@0x0100DB50@ */ ECIPP_ALIGNMENT_UBYTE 255 KNK_mult_cyl3_COMPU_VTAB 0 255 BIT_MASK 0xff /end CHARACTERISTIC
/begin COMPU_METHOD KNK_mult_cyl3_COMPU_VTAB "Verbal Table" TAB_VERB "%.0" "list" COMPU_TAB_REF KNK_mult_cyl3_COMPU_VTAB_REF /end COMPU_METHOD
/begin COMPU_VTAB KNK_mult_cyl3_COMPU_VTAB_REF "Verbal Table" TAB_VERB 3 0 "Standard" 1 "Alternate A" 2 "Alternate B" DEFAULT_VALUE "UNKNOWN" /end COMPU_VTAB
/begin CHARACTERISTIC KNK_mult_cyl4 "Knock signal multiplier 4{KNK_mult_cyl4&0xff=0:Standard}{KNK_mult_cyl4&0xff=1:Alternate A}{KNK_mult_cyl4&0xff=2:Alternate B}" VALUE 0x001C3A26 /* @ECU_Address@KNK_mult_cyl4@0x0100DB58@ */ ECIPP_ALIGNMENT_UBYTE 255 KNK_mult_cyl4_COMPU_VTAB 0 255 BIT_MASK 0xff /end CHARACTERISTIC
/begin COMPU_METHOD KNK_mult_cyl4_COMPU_VTAB "Verbal Table" TAB_VERB "%.0" "list" COMPU_TAB_REF KNK_mult_cyl4_COMPU_VTAB_REF /end COMPU_METHOD
/begin COMPU_VTAB KNK_mult_cyl4_COMPU_VTAB_REF "Verbal Table" TAB_VERB 3 0 "Standard" 1 "Alternate A" 2 "Alternate B" DEFAULT_VALUE "UNKNOWN" /end COMPU_VTAB
/begin CHARACTERISTIC KNK_mult_cyl5 "Knock signal multiplier 5{KNK_mult_cyl5&0xff=0:Standard}{KNK_mult_cyl5&0xff=1:Alternate A}{KNK_mult_cyl5&0xff=2:Alternate B}" VALUE 0x001C3A27 /* @ECU_Address@KNK_mult_cyl5@0x0100DB60@ */ ECIPP_ALIGNMENT_UBYTE 255 KNK_mult_cyl5_COMPU_VTAB 0 255 BIT_MASK 0xff /end CHARACTERISTIC
/begin COMPU_METHOD KNK_mult_cyl5_COMPU_VTAB "Verbal Table" TAB_VERB "%.0" "list" COMPU_TAB_REF KNK_mult_cyl5_COMPU_VTAB_REF /end COMPU_METHOD
/begin COMPU_VTAB KNK_mult_cyl5_COMPU_VTAB_REF "Verbal Table" TAB_VERB 3 0 "Standard" 1 "Alternate A" 2 "Alternate B" DEFAULT_VALUE "UNKNOWN" /end COMPU_VTAB
/begin CHARACTERISTIC KNK_mult_cyl6 "Knock signal multiplier 6{KNK_mult_cyl6&0xff=0:Standard}{KNK_mult_cyl6&0xff=1:Alternate A}{KNK_mult_cyl6&0xff=2:Alternate B}" VALUE 0x001C3A28 /* @ECU_Address@KNK_mult_cyl6@0x0100DB68@ */ ECIPP_ALIGNMENT_UBYTE 255 KNK_mult_cyl6_COMPU_VTAB 0 255 BIT_MASK 0xff /end CHARACTERISTIC
/begin COMPU_METHOD KNK_mult_cyl6_COMPU_VTAB "Verbal Table" TAB_VERB "%.0" "list" COMPU_TAB_REF KNK_mult_cyl6_COMPU_VTAB_REF /end COMPU_METHOD
/begin COMPU_VTAB KNK_mult_cyl6_COMPU_VTAB_REF "Verbal Table" TAB_VERB 3 0 "Standard" 1 "Alternate A" 2 "Alternate B" DEFAULT_VALUE "UNKNOWN" /end COMPU_VTAB
/begin CHARACTERISTIC KNK_mult_cyl7 "Knock signal multiplier 7{KNK_mult_cyl7&0xff=0:Standard}{KNK_mult_cyl7&0xff=1:Alternate A}{KNK_mult_cyl7&0xff=2:Alternate B}" VALUE 0x001C3A29 /* @ECU_Address@KNK_mult_cyl7@0x0100DB70@ */ ECIPP_ALIGNMENT_UBYTE 255 KNK_mult_cyl7_COMPU_VTAB 0 255 BIT_MASK 0xff /end CHARACTERISTIC
/begin COMPU_METHOD KNK_mult_cyl7_COMPU_VTAB "Verbal Table" TAB_VERB "%.0" "list" COMPU_TAB_REF KNK_mult_cyl7_COMPU_VTAB_REF /end COMPU_METHOD
/begin COMPU_VTAB KNK_mult_cyl7_COMPU_VTAB_REF "Verbal Table" TAB_VERB 3 0 "Standard" 1 "Alternate A" 2 "Alternate B" DEFAULT_VALUE "UNKNOWN" /end COMPU_VTAB
/begin CHARACTERISTIC KNK_mult_cyl8 "Knock signal multiplier 8{KNK_mult_cyl8&0xff=0:Standard}{KNK_mult_cyl8&0xff=1:Alternate A}{KNK_mult_cyl8&0xff=2:Alternate B}" VALUE 0x001C3A2A /* @ECU_Address@KNK_mult_cyl8@0x0100DB78@ */ ECIPP_ALIGNMENT_UBYTE 255 KNK_mult_cyl8_COMPU_VTAB 0 255 BIT_MASK 0xff /end CHARACTERISTIC
/begin COMPU_METHOD KNK_mult_cyl8_COMPU_VTAB "Verbal Table" TAB_VERB "%.0" "list" COMPU_TAB_REF KNK_mult_cyl8_COMPU_VTAB_REF /end COMPU_METHOD
/begin COMPU_VTAB KNK_mult_cyl8_COMPU_VTAB_REF "Verbal Table" TAB_VERB 3 0 "Standard" 1 "Alternate A" 2 "Alternate B" DEFAULT_VALUE "UNKNOWN" /end COMPU_VTAB
/begin CHARACTERISTIC KNK_mult_cyl9 "Knock signal multiplier 9{KNK_mult_cyl9&0xff=0:Standard}{KNK_mult_cyl9&0xff=1:Alternate A}{KNK_mult_cyl9&0xff=2:Alternate B}" VALUE 0x001C3A2B /* @ECU_Address@KNK_mult_cyl9@0x0100DB80@ */ ECIPP_ALIGNMENT_UBYTE 255 KNK_mult_cyl9_COMPU_VTAB 0 255 BIT_MASK 0xff /end CHARACTERISTIC
/begin COMPU_METHOD KNK_mult_cyl9_COMPU_VTAB "Verbal Table" TAB_VERB "%.0" "list" COMPU_TAB_REF KNK_mult_cyl9_COMPU_VTAB_REF /end COMPU_METHOD
/begin COMPU_VTAB KNK_mult_cyl9_COMPU_VTAB_REF "Verbal Table" TAB_VERB 3 0 "Standard" 1 "Alternate A" 2 "Alternate B" DEFAULT_VALUE "UNKNOWN" /end COMPU_VTAB
/begin CHARACTERISTIC KNK_mult_cyl10 "Knock signal multiplier 10{KNK_mult_cyl10&0xff=0:Standard}{KNK_mult_cyl10&0xff=1:Alternate A}{KNK_mult_cyl10&0xff=2:Alternate B}" VALUE 0x001C3A2C /* @ECU_Address@KNK_mult_cyl10@0x0100DB88@ */ ECIPP_ALIGNMENT_UBYTE 255 KNK_mult_cyl10_COMPU_VTAB 0 255 BIT_MASK 0xff /end CHARACTERISTIC
/begin COMPU_METHOD KNK_mult_cyl10_COMPU_VTAB "Verbal Table" TAB_VERB "%.0" "list" COMPU_TAB_REF KNK_mult_cyl10_COMPU_VTAB_REF /end COMPU_METHOD
/begin COMPU_VTAB KNK_mult_cyl10_COMPU_VTAB_REF "Verbal Table" TAB_VERB 3 0 "Standard" 1 "Alternate A" 2 "Alternate B" DEFAULT_VALUE "UNKNOWN" /end COMPU_VTAB
/begin CHARACTERISTIC KNK_tbl_cyl1 "Knock table select 1{KNK_tbl_cyl1&0xff=0:Standard}{KNK_tbl_cyl1&0xff=1:Alternate A}{KNK_tbl_cyl1&0xff=2:Alternate B}" VALUE 0x001C3A3B /* @ECU_Address@KNK_tbl_cyl1@0x0100DB90@ */ ECIPP_ALIGNMENT_UBYTE 255 KNK_tbl_cyl1_COMPU_VTAB 0 255 BIT_MASK 0xff /end CHARACTERISTIC
/begin COMPU_METHOD KNK_tbl_cyl1_COMPU_VTAB "Verbal Table" TAB_VERB "%.0" "list" COMPU_TAB_REF KNK_tbl_cyl1_COMPU_VTAB_REF /end COMPU_METHOD
/begin COMPU_VTAB KNK_tbl_cyl1_COMPU_VTAB_REF "Verbal Table" TAB_VERB 3 0 "Standard" 1 "Alternate A" 2 "Alternate B" DEFAULT_VALUE "UNKNOWN" /end COMPU_VTAB
/begin CHARACTERISTIC KNK_tbl_cyl2 "Knock table select 2{KNK_tbl_cyl2&0xff=0:Standard}{KNK_tbl_cyl2&0xff=1:Alternate A}{KNK_tbl_cyl2&0xff=2:Alternate B}" VALUE 0x001C3A3C /* @ECU_Address@KNK_tbl_cyl2@0x0100DB98@ */ ECIPP_ALIGNMENT_UBYTE 255 KNK_tbl_cyl2_COMPU_VTAB 0 255 BIT_MASK 0xff /end CHARACTERISTIC
/begin COMPU_METHOD KNK_tbl_cyl2_COMPU_VTAB "Verbal Table" TAB_VERB "%.0" "list" COMPU_TAB_REF KNK_tbl_cyl2_COMPU_VTAB_REF /end COMPU_METHOD
/begin COMPU_VTAB KNK_tbl_cyl2_COMPU_VTAB_REF "Verbal Table" TAB_VERB 3 0 "Standard" 1 "Alternate A" 2 "Alternate B" DEFAULT_VALUE "UNKNOWN" /end COMPU_VTAB
/begin CHARACTERISTIC KNK_tbl_cyl3 "Knock table select 3{KNK_tbl_cyl3&0xff=0:Standard}{KNK_tbl_cyl3&0xff=1:Alternate A}{KNK_tbl_cyl3&0xff=2:Alternate B}" VALUE 0x001C3A3D /* @ECU_Address@KNK_tbl_cyl3@0x0100DBA0@ */ ECIPP_ALIGNMENT_UBYTE 255 KNK_tbl_cyl3_COMPU_VTAB 0 255 BIT_MASK 0xff /end CHARACTERISTIC
/begin COMPU_METHOD KNK_tbl_cyl3_COMPU_VTAB "Verbal Table" TAB_VERB "%.0" "list" COMPU_TAB_REF KNK_tbl_cyl3_COMPU_VTAB_REF /end COMPU_METHOD
/begin COMPU_VTAB KNK_tbl_cyl3_COMPU_VTAB_REF "Verbal Table" TAB_VERB 3 0 "Standard" 1 "Alternate A" 2 "Alternate B" DEFAULT_VALUE "UNKNOWN" /end COMPU_VTAB
/begin CHARACTERISTIC KNK_tbl_cyl4 "Knock table select 4{KNK_tbl_cyl4&0xff=0:Standard}{KNK_tbl_cyl4&0xff=1:Alternate A}{KNK_tbl_cyl4&0xff=2:Alternate B}" VALUE 0x001C3A3E /* @ECU_Address@KNK_tbl_cyl4@0x0100DBA8@ */ ECIPP_ALIGNMENT_UBYTE 255 KNK_tbl_cyl4_COMPU_VTAB 0 255 BIT_MASK 0xff /end CHARACTERISTIC
/begin COMPU_METHOD KNK_tbl_cyl4_COMPU_VTAB "Verbal Table" TAB_VERB "%.0" "list" COMPU_TAB_REF KNK_tbl_cyl4_COMPU_VTAB_REF /end COMPU_METHOD
/begin COMPU_VTAB KNK_tbl_cyl4_COMPU_VTAB_REF "Verbal Table" TAB_VERB 3 0 "Standard" 1 "Alternate A" 2 "Alternate B" DEFAULT_VALUE "UNKNOWN" /end COMPU_VTAB
/begin CHARACTERISTIC KNK_tbl_cyl5 "Knock table select 5{KNK_tbl_cyl5&0xff=0:Standard}{KNK_tbl_cyl5&0xff=1:Alternate A}{KNK_tbl_cyl5&0xff=2:Alternate B}" VALUE 0x001C3A3F /* @ECU_Address@KNK_tbl_cyl5@0x0100DBB0@ */ ECIPP_ALIGNMENT_UBYTE 255 KNK_tbl_cyl5_COMPU_VTAB 0 255 BIT_MASK 0xff /end CHARACTERISTIC
/begin COMPU_METHOD KNK_tbl_cyl5_COMPU_VTAB "Verbal Table" TAB_VERB "%.0" "list" COMPU_TAB_REF KNK_tbl_cyl5_COMPU_VTAB_REF /end COMPU_METHOD
/begin COMPU_VTAB KNK_tbl_cyl5_COMPU_VTAB_REF "Verbal Table" TAB_VERB 3 0 "Standard" 1 "Alternate A" 2 "Alternate B" DEFAULT_VALUE "UNKNOWN" /end COMPU_VTAB
/begin CHARACTERISTIC KNK_tbl_cyl6 "Knock table select 6{KNK_tbl_cyl6&0xff=0:Standard}{KNK_tbl_cyl6&0xff=1:Alternate A}{KNK_tbl_cyl6&0xff=2:Alternate B}" VALUE 0x001C3A40 /* @ECU_Address@KNK_tbl_cyl6@0x0100DBB8@ */ ECIPP_ALIGNMENT_UBYTE 255 KNK_tbl_cyl6_COMPU_VTAB 0 255 BIT_MASK 0xff /end CHARACTERISTIC
/begin COMPU_METHOD KNK_tbl_cyl6_COMPU_VTAB "Verbal Table" TAB_VERB "%.0" "list" COMPU_TAB_REF KNK_tbl_cyl6_COMPU_VTAB_REF /end COMPU_METHOD
/begin COMPU_VTAB KNK_tbl_cyl6_COMPU_VTAB_REF "Verbal Table" TAB_VERB 3 0 "Standard" 1 "Alternate A" 2 "Alternate B" DEFAULT_VALUE "UNKNOWN" /end COMPU_VTAB
/begin CHARACTERISTIC KNK_tbl_cyl7 "Knock table select 7{KNK_tbl_cyl7&0xff=0:Standard}{KNK_tbl_cyl7&0xff=1:Alternate A}{KNK_tbl_cyl7&0xff=2:Alternate B}" VALUE 0x001C3A41 /* @ECU_Address@KNK_tbl_cyl7@0x0100DBC0@ */ ECIPP_ALIGNMENT_UBYTE 255 KNK_tbl_cyl7_COMPU_VTAB 0 255 BIT_MASK 0xff /end CHARACTERISTIC
/begin COMPU_METHOD KNK_tbl_cyl7_COMPU_VTAB "Verbal Table" TAB_VERB "%.0" "list" COMPU_TAB_REF KNK_tbl_cyl7_COMPU_VTAB_REF /end COMPU_METHOD
/begin COMPU_VTAB KNK_tbl_cyl7_COMPU_VTAB_REF "Verbal Table" TAB_VERB 3 0 "Standard" 1 "Alternate A" 2 "Alternate B" DEFAULT_VALUE "UNKNOWN" /end COMPU_VTAB
/begin CHARACTERISTIC KNK_tbl_cyl8 "Knock table select 8{KNK_tbl_cyl8&0xff=0:Standard}{KNK_tbl_cyl8&0xff=1:Alternate A}{KNK_tbl_cyl8&0xff=2:Alternate B}" VALUE 0x001C3A42 /* @ECU_Address@KNK_tbl_cyl8@0x0100DBC8@ */ ECIPP_ALIGNMENT_UBYTE 255 KNK_tbl_cyl8_COMPU_VTAB 0 255 BIT_MASK 0xff /end CHARACTERISTIC
/begin COMPU_METHOD KNK_tbl_cyl8_COMPU_VTAB "Verbal Table" TAB_VERB "%.0" "list" COMPU_TAB_REF KNK_tbl_cyl8_COMPU_VTAB_REF /end COMPU_METHOD
/begin COMPU_VTAB KNK_tbl_cyl8_COMPU_VTAB_REF "Verbal Table" TAB_VERB 3 0 "Standard" 1 "Alternate A" 2 "Alternate B" DEFAULT_VALUE "UNKNOWN" /end COMPU_VTAB
/begin CHARACTERISTIC KNK_tbl_cyl9 "Knock table select 9{KNK_tbl_cyl9&0xff=0:Standard}{KNK_tbl_cyl9&0xff=1:Alternate A}{KNK_tbl_cyl9&0xff=2:Alternate B}" VALUE 0x001C3A43 /* @ECU_Address@KNK_tbl_cyl9@0x0100DBD0@ */ ECIPP_ALIGNMENT_UBYTE 255 KNK_tbl_cyl9_COMPU_VTAB 0 255 BIT_MASK 0xff /end CHARACTERISTIC
/begin COMPU_METHOD KNK_tbl_cyl9_COMPU_VTAB "Verbal Table" TAB_VERB "%.0" "list" COMPU_TAB_REF KNK_tbl_cyl9_COMPU_VTAB_REF /end COMPU_METHOD
/begin COMPU_VTAB KNK_tbl_cyl9_COMPU_VTAB_REF "Verbal Table" TAB_VERB 3 0 "Standard" 1 "Alternate A" 2 "Alternate B" DEFAULT_VALUE "UNKNOWN" /end COMPU_VTAB
/begin CHARACTERISTIC KNK_tbl_cyl10 "Knock table select 10{KNK_tbl_cyl10&0xff=0:Standard}{KNK_tbl_cyl10&0xff=1:Alternate A}{KNK_tbl_cyl10&0xff=2:Alternate B}" VALUE 0x001C3A44 /* @ECU_Address@KNK_tbl_cyl10@0x0100DBD8@ */ ECIPP_ALIGNMENT_UBYTE 255 KNK_tbl_cyl10_COMPU_VTAB 0 255 BIT_MASK 0xff /end CHARACTERISTIC
/begin COMPU_METHOD KNK_tbl_cyl10_COMPU_VTAB "Verbal Table" TAB_VERB "%.0" "list" COMPU_TAB_REF KNK_tbl_cyl10_COMPU_VTAB_REF /end COMPU_METHOD
/begin COMPU_VTAB KNK_tbl_cyl10_COMPU_VTAB_REF "Verbal Table" TAB_VERB 3 0 "Standard" 1 "Alternate A" 2 "Alternate B" DEFAULT_VALUE "UNKNOWN" /end COMPU_VTAB
/begin MEASUREMENT KNK_bg_cyl1 "Knock background cylinder 1" UWORD Compu_KNK_bg_cyl1 0 0 0 99.9984741210938 ECU_ADDRESS 0x0100DBE0 /end MEASUREMENT
/begin COMPU_METHOD Compu_KNK_bg_cyl1 " " RAT_FUNC "%.2" "% FS" COEFFS 0 655.36 0 0 0 1 /end COMPU_METHOD
/begin MEASUREMENT KNK_bg_cyl2 "Knock background cylinder 2" UWORD Compu_KNK_bg_cyl2 0 0 0 99.9984741210938 ECU_ADDRESS 0x0100DBE8 /end MEASUREMENT
/begin COMPU_METHOD Compu_KNK_bg_cyl2 " " RAT_FUNC "%.2" "% FS" COEFFS 0 655.36 0 0 0 1 /end COMPU_METHOD
/begin MEASUREMENT KNK_bg_cyl3 "Knock background cylinder 3" UWORD Compu_KNK_bg_cyl3 0 0 0 99.9984741210938 ECU_ADDRESS 0x0100DBF0 /end MEASUREMENT
/begin COMPU_METHOD Compu_KNK_bg_cyl3 " " RAT_FUNC "%.2" "% FS" COEFFS 0 655.36 0 0 0 1 /end COMPU_METHOD
/begin MEASUREMENT KNK_bg_cyl4 "Knock background cylinder 4" UWORD Compu_KNK_bg_cyl4 0 0 0 99.9984741210938 ECU_ADDRESS 0x0100DBF8 /end MEASUREMENT
/begin COMPU_METHOD Compu_KNK_bg_cyl4 " " RAT_FUNC "%.2" "% FS" COEFFS 0 655.36 0 0 0 1 /end COMPU_METHOD
/begin MEASUREMENT KNK_bg_cyl5 "Knock background cylinder 5" UWORD Compu_KNK_bg_cyl5 0 0 0 99.9984741210938 ECU_ADDRESS 0x0100DC00 /end MEASUREMENT
/begin COMPU_METHOD Compu_KNK_bg_cyl5 " " RAT_FUNC "%.2" "% FS" COEFFS 0 655.36 0 0 0 1 /end COMPU_METHOD
/begin MEASUREMENT KNK_bg_cyl6 "Knock background cylinder 6" UWORD Compu_KNK_bg_cyl6 0 0 0 99.9984741210938 ECU_ADDRESS 0x0100DC08 /end MEASUREMENT
/begin COMPU_METHOD Compu_KNK_bg_cyl6 " " RAT_FUNC "%.2" "% FS" COEFFS 0 655.36 0 0 0 1 /end COMPU_METHOD
/begin MEASUREMENT KNK_bg_cyl7 "Knock background cylinder 7" UWORD Compu_KNK_bg_cyl7 0 0 0 99.9984741210938 ECU_ADDRESS 0x0100DC10 /end MEASUREMENT
/begin COMPU_METHOD Compu_KNK_bg_cyl7 " " RAT_FUNC "%.2" "% FS" COEFFS 0 655.36 0 0 0 1 /end COMPU_METHOD
/begin MEASUREMENT KNK_bg_cyl8 "Knock background cylinder 8" UWORD Compu_KNK_bg_cyl8 0 0 0 99.9984741210938 ECU_ADDRESS 0x0100DC18 /end MEASUREMENT
/begin COMPU_METHOD Compu_KNK_bg_cyl8 " " RAT_FUNC "%.2" "% FS" COEFFS 0 655.36 0 0 0 1 /end COMPU_METHOD
/begin MEASUREMENT KNK_bg_cyl9 "Knock background cylinder 9" UWORD Compu_KNK_bg_cyl9 0 0 0 99.9984741210938 ECU_ADDRESS 0x0100DC20 /end MEASUREMENT
/begin COMPU_METHOD Compu_KNK_bg_cyl9 " " RAT_FUNC "%.2" "% FS" COEFFS 0 655.36 0 0 0 1 /end COMPU_METHOD
/begin MEASUREMENT KNK_bg_cyl10 "Knock background cylinder 10" UWORD Compu_KNK_bg_cyl10 0 0 0 99.9984741210938 ECU_ADDRESS 0x0100DC28 /end MEASUREMENT
/begin COMPU_METHOD Compu_KNK_bg_cyl10 " " RAT_FUNC "%.2" "% FS" COEFFS 0 655.36 0 0 0 1 /end COMPU_METHOD
/begin MEASUREMENT KNK_win_cyl1 "Knock window cylinder 1" UWORD Compu_KNK_win_cyl1 0 0 0 99.9984741210938 ECU_ADDRESS 0x0100DC30 /end MEASUREMENT
/begin COMPU_METHOD Compu_KNK_win_cyl1 " " RAT_FUNC "%.2" "% FS" COEFFS 0 655.36 0 0 0 1 /end COMPU_METHOD
/begin MEASUREMENT KNK_win_cyl2 "Knock window cylinder 2" UWORD Compu_KNK_win_cyl2 0 0 0 99.9984741210938 ECU_ADDRESS 0x0100DC38 /end MEASUREMENT
/begin COMPU_METHOD Compu_KNK_win_cyl2 " " RAT_FUNC "%.2" "% FS" COEFFS 0 655.36 0 0 0 1 /end COMPU_METHOD
/begin MEASUREMENT KNK_win_cyl3 "Knock window cylinder 3" UWORD Compu_KNK_win_cyl3 0 0 0 99.9984741210938 ECU_ADDRESS 0x0100DC40 /end MEASUREMENT
/begin COMPU_METHOD Compu_KNK_win_cyl3 " " RAT_FUNC "%.2" "% FS" COEFFS 0 655.36 0 0 0 1 /end COMPU_METHOD
/begin MEASUREMENT KNK_win_cyl4 "Knock window cylinder 4" UWORD Compu_KNK_win_cyl4 0 0 0 99.9984741210938 ECU_ADDRESS 0x0100DC48 /end MEASUREMENT
/begin COMPU_METHOD Compu_KNK_win_cyl4 " " RAT_FUNC "%.2" "% FS" COEFFS 0 655.36 0 0 0 1 /end COMPU_METHOD
/begin MEASUREMENT KNK_win_cyl5 "Knock window cylinder 5" UWORD Compu_KNK_win_cyl5 0 0 0 99.9984741210938 ECU_ADDRESS 0x0100DC50 /end MEASUREMENT
/begin COMPU_METHOD Compu_KNK_win_cyl5 " " RAT_FUNC "%.2" "% FS" COEFFS 0 655.36 0 0 0 1 /end COMPU_METHOD
/begin MEASUREMENT KNK_win_cyl6 "Knock window cylinder 6" UWORD Compu_KNK_win_cyl6 0 0 0 99.9984741210938 ECU_ADDRESS 0x0100DC58 /end MEASUREMENT
/begin COMPU_METHOD Compu_KNK_win_cyl6 " " RAT_FUNC "%.2" "% FS" COEFFS 0 655.36 0 0 0 1 /end COMPU_METHOD
/begin MEASUREMENT KNK_win_cyl7 "Knock window cylinder 7" UWORD Compu_KNK_win_cyl7 0 0 0 99.9984741210938 ECU_ADDRESS 0x0100DC60 /end MEASUREMENT
/begin COMPU_METHOD Compu_KNK_win_cyl7 " " RAT_FUNC "%.2" "% FS" COEFFS 0 655.36 0 0 0 1 /end COMPU_METHOD
/begin MEASUREMENT KNK_win_cyl8 "Knock window cylinder 8" UWORD Compu_KNK_win_cyl8 0 0 0 99.9984741210938 ECU_ADDRESS 0x0100DC68 /end MEASUREMENT
/begin COMPU_METHOD Compu_KNK_win_cyl8 " " RAT_FUNC "%.2" "% FS" COEFFS 0 655.36 0 0 0 1 /end COMPU_METHOD
/begin MEASUREMENT KNK_win_cyl9 "Knock window cylinder 9" UWORD Compu_KNK_win_cyl9 0 0 0 99.9984741210938 ECU_ADDRESS 0x0100DC70 /end MEASUREMENT
/begin COMPU_METHOD Compu_KNK_win_cyl9 " " RAT_FUNC "%.2" "% FS" COEFFS 0 655.36 0 0 0 1 /end COMPU_METHOD
/begin MEASUREMENT KNK_win_cyl10 "Knock window cylinder 10" UWORD Compu_KNK_win_cyl10 0 0 0 99.9984741210938 ECU_ADDRESS 0x0100DC78 /end MEASUREMENT
/begin COMPU_METHOD Compu_KNK_win_cyl10 " " RAT_FUNC "%.2" "% FS" COEFFS 0 655.36 0 0 0 1 /end COMPU_METHOD
/begin MEASUREMENT KNK_sig_cyl1 "Knock signal cylinder 1" UWORD Compu_KNK_sig_cyl1 0 0 0 99.9984741210938 ECU_ADDRESS 0x0100DC80 /end MEASUREMENT
/begin COMPU_METHOD Compu_KNK_sig_cyl1 " " RAT_FUNC "%.2" "% FS" COEFFS 0 655.36 0 0 0 1 /end COMPU_METHOD
/begin MEASUREMENT KNK_sig_cyl2 "Knock signal cylinder 2" UWORD Compu_KNK_sig_cyl2 0 0 0 99.9984741210938 ECU_ADDRESS 0x0100DC88 /end MEASUREMENT
/begin COMPU_METHOD Compu_KNK_sig_cyl2 " " RAT_FUNC "%.2" "% FS" COEFFS 0 655.36 0 0 0 1 /end COMPU_METHOD
/begin MEASUREMENT KNK_sig_cyl3 "Knock signal cylinder 3" UWORD Compu_KNK_sig_cyl3 0 0 0 99.9984741210938 ECU_ADDRESS 0x0100DC90 /end MEASUREMENT
/begin COMPU_METHOD Compu_KNK_sig_cyl3 " " RAT_FUNC "%.2" "% FS" COEFFS 0 655.36 0 0 0 1 /end COMPU_METHOD
/begin MEASUREMENT KNK_sig_cyl4 "Knock signal cylinder 4" UWORD Compu_KNK_sig_cyl4 0 0 0 99.9984741210938 ECU_ADDRESS 0x0100DC98 /end MEASUREMENT
/begin COMPU_METHOD Compu_KNK_sig_cyl4 " " RAT_FUNC "%.2" "% FS" COEFFS 0 655.36 0 0 0 1 /end COMPU_METHOD
/begin MEASUREMENT KNK_sig_cyl5 "Knock signal cylinder 5" UWORD Compu_KNK_sig_cyl5 0 0 0 99.9984741210938 ECU_ADDRESS 0x0100DCA0 /end MEASUREMENT
/begin COMPU_METHOD Compu_KNK_sig_cyl5 " " RAT_FUNC "%.2" "% FS" COEFFS 0 655.36 0 0 0 1 /end COMPU_METHOD
/begin MEASUREMENT KNK_sig_cyl6 "Knock signal cylinder 6" UWORD Compu_KNK_sig_cyl6 0 0 0 99.9984741210938 ECU_ADDRESS 0x0100DCA8 /end MEASUREMENT
/begin COMPU_METHOD Compu_KNK_sig_cyl6 " " RAT_FUNC "%.2" "% FS" COEFFS 0 655.36 0 0 0 1 /end COMPU_METHOD
/begin MEASUREMENT KNK_sig_cyl7 "Knock signal cylinder 7" UWORD Compu_KNK_sig_cyl7 0 0 0 99.9984741210938 ECU_ADDRESS 0x0100DCB0 /end MEASUREMENT
/begin COMPU_METHOD Compu_KNK_sig_cyl7 " " RAT_FUNC "%.2" "% FS" COEFFS 0 655.36 0 0 0 1 /end COMPU_METHOD
/begin MEASUREMENT KNK_sig_cyl8 "Knock signal cylinder 8" UWORD Compu_KNK_sig_cyl8 0 0 0 99.9984741210938 ECU_ADDRESS 0x0100DCB8 /end MEASUREMENT
/begin COMPU_METHOD Compu_KNK_sig_cyl8 " " RAT_FUNC "%.2" "% FS" COEFFS 0 655.36 0 0 0 1 /end COMPU_METHOD
/begin MEASUREMENT KNK_sig_cyl9 "Knock signal cylinder 9" UWORD Compu_KNK_sig_cyl9 0 0 0 99.9984741210938 ECU_ADDRESS 0x0100DCC0 /end MEASUREMENT
/begin COMPU_METHOD Compu_KNK_sig_cyl9 " " RAT_FUNC "%.2" "% FS" COEFFS 0 655.36 0 0 0 1 /end COMPU_METHOD
/begin MEASUREMENT KNK_sig_cyl10 "Knock signal cylinder 10" UWORD Compu_KNK_sig_cyl10 0 0 0 99.9984741210938 ECU_ADDRESS 0x0100DCC8 /end MEASUREMENT
/begin COMPU_METHOD Compu_KNK_sig_cyl10 " " RAT_FUNC "%.2" "% FS" COEFFS 0 655.36 0 0 0 1 /end COMPU_METHOD
/begin MEASUREMENT KNK_bg_dur_AltA "Knock background duration AltA" SWORD Compu_KNK_bg_dur_AltA 0 0 -16384 16383.5 ECU_ADDRESS 0x0100DCD0 /end MEASUREMENT
/begin COMPU_METHOD Compu_KNK_bg_dur_AltA " " RAT_FUNC "%.0" "CAD" COEFFS 0 2 0 0 0 1 /end COMPU_METHOD
/begin MEASUREMENT KNK_bg_dur_AltB "Knock background duration AltB" SWORD Compu_KNK_bg_dur_AltB 0 0 -16384 16383.5 ECU_ADDRESS 0x0100DCD8 /end MEASUREMENT
/begin COMPU_METHOD Compu_KNK_bg_dur_AltB " " RAT_FUNC "%.0" "CAD" COEFFS 0 2 0 0 0 1 /end COMPU_METHOD
/begin MEASUREMENT KNK_bg_start_AltA "Knock background start AltA" SWORD Compu_KNK_bg_start_AltA 0 0 -16384 16383.5 ECU_ADDRESS 0x0100DCE0 /end MEASUREMENT
/begin COMPU_METHOD Compu_KNK_bg_start_AltA " " RAT_FUNC "%.0" "CAD BTDC" COEFFS 0 2 0 0 0 1 /end COMPU_METHOD
/begin MEASUREMENT KNK_bg_start_AltB "Knock background start AltB" SWORD Compu_KNK_bg_start_AltB 0 0 -16384 16383.5 ECU_ADDRESS 0x0100DCE8 /end MEASUREMENT
/begin COMPU_METHOD Compu_KNK_bg_start_AltB " " RAT_FUNC "%.0" "CAD BTDC" COEFFS 0 2 0 0 0 1 /end COMPU_METHOD
/begin MEASUREMENT KNK_win_dur_AltA "Knock window duration AltA" SWORD Compu_KNK_win_dur_AltA 0 0 -16384 16383.5 ECU_ADDRESS 0x0100DCF0 /end MEASUREMENT
/begin COMPU_METHOD Compu_KNK_win_dur_AltA " " RAT_FUNC "%.0" "CAD" COEFFS 0 2 0 0 0 1 /end COMPU_METHOD
/begin MEASUREMENT KNK_win_dur_AltB "Knock window duration AltB" SWORD Compu_KNK_win_dur_AltB 0 0 -16384 16383.5 ECU_ADDRESS 0x0100DCF8 /end MEASUREMENT
/begin COMPU_METHOD Compu_KNK_win_dur_AltB " " RAT_FUNC "%.0" "CAD" COEFFS 0 2 0 0 0 1 /end COMPU_METHOD
/begin MEASUREMENT KNK_win_start_AltA "Knock window start AltA" SWORD Compu_KNK_win_start_AltA 0 0 -16384 16383.5 ECU_ADDRESS 0x0100DD00 /end MEASUREMENT
/begin COMPU_METHOD Compu_KNK_win_start_AltA " " RAT_FUNC "%.0" "CAD BTDC" COEFFS 0 2 0 0 0 1 /end COMPU_METHOD
/begin MEASUREMENT KNK_win_start_AltB "Knock window start AltB" SWORD Compu_KNK_win_start_AltB 0 0 -16384 16383.5 ECU_ADDRESS 0x0100DD08 /end MEASUREMENT
/begin COMPU_METHOD Compu_KNK_win_start_AltB " " RAT_FUNC "%.0" "CAD BTDC" COEFFS 0 2 0 0 0 1 /end COMPU_METHOD
/begin MEASUREMENT KNK_mult "Knock signal multiplier" SWORD Compu_KNK_mult 0 0 -16 15.99951171875 ECU_ADDRESS 0x0100DD10 /end MEASUREMENT
/begin COMPU_METHOD Compu_KNK_mult " " RAT_FUNC "%.2" "multiplier" COEFFS 0 2048 0 0 0 1 /end COMPU_METHOD
/begin MEASUREMENT KNK_mult_AltA "Knock signal multiplier AltA" SWORD Compu_KNK_mult_AltA 0 0 -16 15.99951171875 ECU_ADDRESS 0x0100DD18 /end MEASUREMENT
/begin COMPU_METHOD Compu_KNK_mult_AltA " " RAT_FUNC "%.2" "multiplier" COEFFS 0 2048 0 0 0 1 /end COMPU_METHOD
/begin MEASUREMENT KNK_mult_AltB "Knock signal multiplier AltB" SWORD Compu_KNK_mult_AltB 0 0 -16 15.99951171875 ECU_ADDRESS 0x0100DD20 /end MEASUREMENT
/begin COMPU_METHOD Compu_KNK_mult_AltB " " RAT_FUNC "%.2" "multiplier" COEFFS 0 2048 0 0 0 1 /end COMPU_METHOD
/begin MEASUREMENT KNK_CWT_100_V "Knock 100% CWT offset" UWORD Compu_KNK_CWT_100_V 0 0 0 63.9990234375 ECU_ADDRESS 0x0100DD30 /end MEASUREMENT
/begin COMPU_METHOD Compu_KNK_CWT_100_V " " RAT_FUNC "%.3" "volts" COEFFS 0 1024 0 0 0 1 /end COMPU_METHOD
/begin MEASUREMENT KNK_CWT_0_V "Knock 0% CWT offset" UWORD Compu_KNK_CWT_0_V 0 0 0 63.9990234375 ECU_ADDRESS 0x0100DD38 /end MEASUREMENT
/begin COMPU_METHOD Compu_KNK_CWT_0_V " " RAT_FUNC "%.3" "volts" COEFFS 0 1024 0 0 0 1 /end COMPU_METHOD
/begin MEASUREMENT ECTHst_max "ECT max" UWORD Compu_ECTHst_max 0 0 -460 563.984375 ECU_ADDRESS 0x0100DD60 /end MEASUREMENT
/begin COMPU_METHOD Compu_ECTHst_max " " RAT_FUNC "%.1" "deg F" COEFFS 0 64 29440 0 0 1 /end COMPU_METHOD
/begin MEASUREMENT ECTHst_hi_HM "ECT hour meter" ULONG Compu_ECTHst_hi_HM 0 0 0 1193046.47083333 ECU_ADDRESS 0x0100DD70 /end MEASUREMENT
/begin COMPU_METHOD Compu_ECTHst_hi_HM " " RAT_FUNC "%.3" "hours" COEFFS 0 3600 0 0 0 1 /end COMPU_METHOD
/begin CHARACTERISTIC OCT_tbl_store_EE "Adaptive octane table retention{OCT_tbl_store_EE&0xff=0:Battery}{OCT_tbl_store_EE&0xff=1:Permanent}" VALUE 0x001c3a4b /* @ECU_Address@OCT_tbl_store_EE@0x0100E7E0@ */ ECIPP_ALIGNMENT_UBYTE 255 OCT_tbl_store_EE_COMPU_VTAB 0 255 BIT_MASK 0xff /end CHARACTERISTIC
/begin COMPU_METHOD OCT_tbl_store_EE_COMPU_VTAB "Verbal Table" TAB_VERB "%.0" "list" COMPU_TAB_REF OCT_tbl_store_EE_COMPU_VTAB_REF /end COMPU_METHOD
/begin COMPU_VTAB OCT_tbl_store_EE_COMPU_VTAB_REF "Verbal Table" TAB_VERB 2 0 "Battery" 1 "Permanent" DEFAULT_VALUE "UNKNOWN" /end COMPU_VTAB
/begin CHARACTERISTIC KNK_FSO_disabled_tm "KNK FSO disable time" VALUE 0x001c39d8 /* @ECU_Address@KNK_FSO_disabled_tm@0x010102D8@ */ ECIPP_ALIGNMENT_UWORD 66 Compu_KNK_FSO_disabled_tm 0 65.535 /end CHARACTERISTIC
/begin COMPU_METHOD Compu_KNK_FSO_disabled_tm " " RAT_FUNC "%.1" "sec" COEFFS 0 1000 0 0 0 1 /end COMPU_METHOD
/begin CHARACTERISTIC KNK_CWT_mult "Knock signal CWT offset" VALUE 0x001c39d2 /* @ECU_Address@KNK_CWT_mult@0x010102E0@ */ ECIPP_ALIGNMENT_UWORD 128 Compu_KNK_CWT_mult 0 127.998046875 /end CHARACTERISTIC
/begin COMPU_METHOD Compu_KNK_CWT_mult " " RAT_FUNC "%.2" "multiplier" COEFFS 0 512 0 0 0 1 /end COMPU_METHOD
/begin CHARACTERISTIC KNK_FSO_debounce "KNK FSO disable debounce" VALUE 0x001c39d6 /* @ECU_Address@KNK_FSO_debounce@0x010102E8@ */ ECIPP_ALIGNMENT_UWORD 66 Compu_KNK_FSO_debounce 0 65.535 /end CHARACTERISTIC
/begin COMPU_METHOD Compu_KNK_FSO_debounce " " RAT_FUNC "%.2" "sec" COEFFS 0 1000 0 0 0 1 /end COMPU_METHOD
/begin MEASUREMENT KNK_FSO_disabled "KNK FSO disabled{KNK_FSO_disabled&0xff=0:NO}{KNK_FSO_disabled&0xff=1:YES}" UBYTE KNK_FSO_disabled_COMPU_VTAB 0 0 0 255 ECU_ADDRESS 0x010102F0 BIT_MASK 0xff /end MEASUREMENT
/begin COMPU_METHOD KNK_FSO_disabled_COMPU_VTAB "Verbal Table" TAB_VERB "%.0" "list" COMPU_TAB_REF KNK_FSO_disabled_COMPU_VTAB_REF /end COMPU_METHOD
/begin COMPU_VTAB KNK_FSO_disabled_COMPU_VTAB_REF "Verbal Table" TAB_VERB 2 0 "NO" 1 "YES" DEFAULT_VALUE "UNKNOWN" /end COMPU_VTAB
/begin CHARACTERISTIC KNK_FSO_win_tm "Knock FSO peak window" VALUE 0x001c7cb6 /* @ECU_Address@KNK_FSO_win_tm@0x01010348@ */ ECIPP_ALIGNMENT_UWORD 65535 Compu_KNK_FSO_win_tm 0 65535 /end CHARACTERISTIC
/begin COMPU_METHOD Compu_KNK_FSO_win_tm " " RAT_FUNC "%.0" "ms" COEFFS 0 1 0 0 0 1 /end COMPU_METHOD
/begin MEASUREMENT KNK_FSO_0_V "Knock 0% FSO offset" UWORD Compu_KNK_FSO_0_V 0 0 0 63.9990234375 ECU_ADDRESS 0x01010350 /end MEASUREMENT
/begin COMPU_METHOD Compu_KNK_FSO_0_V " " RAT_FUNC "%.3" "volts" COEFFS 0 1024 0 0 0 1 /end COMPU_METHOD
/begin CHARACTERISTIC KNK_FSO_win_peak_tau "Knock FSO window peak tau" VALUE 0x001c855a /* @ECU_Address@KNK_FSO_win_peak_tau@0x01010358@ */ ECIPP_ALIGNMENT_UWORD 327680 Compu_KNK_FSO_win_peak_tau 0.45084 327680 /end CHARACTERISTIC
/begin COMPU_METHOD Compu_KNK_FSO_win_peak_tau " " FORM "%.0" "ms"
 /begin FORMULA "-5 / log(1 - (X1 / 65536))" FORMULA_INV "(1 - exp(-5/X1)) * 65536" /end FORMULA
/end COMPU_METHOD
/begin MEASUREMENT KNK_FSO_100_V "Knock 100% FSO offset" UWORD Compu_KNK_FSO_100_V 0 0 0 63.9990234375 ECU_ADDRESS 0x01010360 /end MEASUREMENT
/begin COMPU_METHOD Compu_KNK_FSO_100_V " " RAT_FUNC "%.3" "volts" COEFFS 0 1024 0 0 0 1 /end COMPU_METHOD
/begin CHARACTERISTIC KNK_FSO_min_mdot "Knock FSO exit min fuel flow" VALUE 0x001c7cb4 /* @ECU_Address@KNK_FSO_min_mdot@0x01010368@ */ ECIPP_ALIGNMENT_UWORD 128 Compu_KNK_FSO_min_mdot 0 127.998046875 /end CHARACTERISTIC
/begin COMPU_METHOD Compu_KNK_FSO_min_mdot " " RAT_FUNC "%.2" "g/sec" COEFFS 0 512 0 0 0 1 /end COMPU_METHOD
/begin CHARACTERISTIC OCT_gsln_alt_tbl "Gasoline alternate table{OCT_gsln_alt_tbl&0xff=0:Gasoline}{OCT_gsln_alt_tbl&0xff=1:Propane}{OCT_gsln_alt_tbl&0xff=2:Natural Gas}" VALUE 0x001C8851 /* @ECU_Address@OCT_gsln_alt_tbl@0x01010420@ */ ECIPP_ALIGNMENT_UBYTE 255 OCT_gsln_alt_tbl_COMPU_VTAB 0 255 BIT_MASK 0xff /end CHARACTERISTIC
/begin COMPU_METHOD OCT_gsln_alt_tbl_COMPU_VTAB "Verbal Table" TAB_VERB "%.0" "list" COMPU_TAB_REF OCT_gsln_alt_tbl_COMPU_VTAB_REF /end COMPU_METHOD
/begin COMPU_VTAB OCT_gsln_alt_tbl_COMPU_VTAB_REF "Verbal Table" TAB_VERB 3 0 "Gasoline" 1 "Propane" 2 "Natural Gas" DEFAULT_VALUE "UNKNOWN" /end COMPU_VTAB
/begin CHARACTERISTIC OCT_gsln_ena "Gasoline octane adapt mode{OCT_gsln_ena&0xff=0:Disabled}{OCT_gsln_ena&0xff=1:High}{OCT_gsln_ena&0xff=2:Low}" VALUE 0x001C8854 /* @ECU_Address@OCT_gsln_ena@0x01010428@ */ ECIPP_ALIGNMENT_UBYTE 255 OCT_gsln_ena_COMPU_VTAB 0 255 BIT_MASK 0xff /end CHARACTERISTIC
/begin COMPU_METHOD OCT_gsln_ena_COMPU_VTAB "Verbal Table" TAB_VERB "%.0" "list" COMPU_TAB_REF OCT_gsln_ena_COMPU_VTAB_REF /end COMPU_METHOD
/begin COMPU_VTAB OCT_gsln_ena_COMPU_VTAB_REF "Verbal Table" TAB_VERB 3 0 "Disabled" 1 "High" 2 "Low" DEFAULT_VALUE "UNKNOWN" /end COMPU_VTAB
/begin CHARACTERISTIC OCT_LP_alt_tbl "LP alternate table{OCT_LP_alt_tbl&0xff=0:Gasoline}{OCT_LP_alt_tbl&0xff=1:Propane}{OCT_LP_alt_tbl&0xff=2:Natural Gas}" VALUE 0x001C8852 /* @ECU_Address@OCT_LP_alt_tbl@0x01010430@ */ ECIPP_ALIGNMENT_UBYTE 255 OCT_LP_alt_tbl_COMPU_VTAB 0 255 BIT_MASK 0xff /end CHARACTERISTIC
/begin COMPU_METHOD OCT_LP_alt_tbl_COMPU_VTAB "Verbal Table" TAB_VERB "%.0" "list" COMPU_TAB_REF OCT_LP_alt_tbl_COMPU_VTAB_REF /end COMPU_METHOD
/begin COMPU_VTAB OCT_LP_alt_tbl_COMPU_VTAB_REF "Verbal Table" TAB_VERB 3 0 "Gasoline" 1 "Propane" 2 "Natural Gas" DEFAULT_VALUE "UNKNOWN" /end COMPU_VTAB
/begin CHARACTERISTIC OCT_LP_ena "LP octane adapt mode{OCT_LP_ena&0xff=0:Disabled}{OCT_LP_ena&0xff=1:High}{OCT_LP_ena&0xff=2:Low}" VALUE 0x001C8855 /* @ECU_Address@OCT_LP_ena@0x01010438@ */ ECIPP_ALIGNMENT_UBYTE 255 OCT_LP_ena_COMPU_VTAB 0 255 BIT_MASK 0xff /end CHARACTERISTIC
/begin COMPU_METHOD OCT_LP_ena_COMPU_VTAB "Verbal Table" TAB_VERB "%.0" "list" COMPU_TAB_REF OCT_LP_ena_COMPU_VTAB_REF /end COMPU_METHOD
/begin COMPU_VTAB OCT_LP_ena_COMPU_VTAB_REF "Verbal Table" TAB_VERB 3 0 "Disabled" 1 "High" 2 "Low" DEFAULT_VALUE "UNKNOWN" /end COMPU_VTAB
/begin CHARACTERISTIC OCT_NG_alt_tbl "NG alternate table{OCT_NG_alt_tbl&0xff=0:Gasoline}{OCT_NG_alt_tbl&0xff=1:Propane}{OCT_NG_alt_tbl&0xff=2:Natural Gas}" VALUE 0x001C8853 /* @ECU_Address@OCT_NG_alt_tbl@0x01010440@ */ ECIPP_ALIGNMENT_UBYTE 255 OCT_NG_alt_tbl_COMPU_VTAB 0 255 BIT_MASK 0xff /end CHARACTERISTIC
/begin COMPU_METHOD OCT_NG_alt_tbl_COMPU_VTAB "Verbal Table" TAB_VERB "%.0" "list" COMPU_TAB_REF OCT_NG_alt_tbl_COMPU_VTAB_REF /end COMPU_METHOD
/begin COMPU_VTAB OCT_NG_alt_tbl_COMPU_VTAB_REF "Verbal Table" TAB_VERB 3 0 "Gasoline" 1 "Propane" 2 "Natural Gas" DEFAULT_VALUE "UNKNOWN" /end COMPU_VTAB
/begin CHARACTERISTIC OCT_NG_ena "NG octane adapt mode{OCT_NG_ena&0xff=0:Disabled}{OCT_NG_ena&0xff=1:High}{OCT_NG_ena&0xff=2:Low}" VALUE 0x001C8856 /* @ECU_Address@OCT_NG_ena@0x01010448@ */ ECIPP_ALIGNMENT_UBYTE 255 OCT_NG_ena_COMPU_VTAB 0 255 BIT_MASK 0xff /end CHARACTERISTIC
/begin COMPU_METHOD OCT_NG_ena_COMPU_VTAB "Verbal Table" TAB_VERB "%.0" "list" COMPU_TAB_REF OCT_NG_ena_COMPU_VTAB_REF /end COMPU_METHOD
/begin COMPU_VTAB OCT_NG_ena_COMPU_VTAB_REF "Verbal Table" TAB_VERB 3 0 "Disabled" 1 "High" 2 "Low" DEFAULT_VALUE "UNKNOWN" /end COMPU_VTAB
/begin CHARACTERISTIC OCT_phi_gsln_alt_tbl "Gasoline phi alternate table{OCT_phi_gsln_alt_tbl&0xff=0:Gasoline}{OCT_phi_gsln_alt_tbl&0xff=1:Propane}{OCT_phi_gsln_alt_tbl&0xff=2:Natural Gas}" VALUE 0x001C8857 /* @ECU_Address@OCT_phi_gsln_alt_tbl@0x01010450@ */ ECIPP_ALIGNMENT_UBYTE 255 OCT_phi_gsln_alt_tbl_COMPU_VTAB 0 255 BIT_MASK 0xff /end CHARACTERISTIC
/begin COMPU_METHOD OCT_phi_gsln_alt_tbl_COMPU_VTAB "Verbal Table" TAB_VERB "%.0" "list" COMPU_TAB_REF OCT_phi_gsln_alt_tbl_COMPU_VTAB_REF /end COMPU_METHOD
/begin COMPU_VTAB OCT_phi_gsln_alt_tbl_COMPU_VTAB_REF "Verbal Table" TAB_VERB 3 0 "Gasoline" 1 "Propane" 2 "Natural Gas" DEFAULT_VALUE "UNKNOWN" /end COMPU_VTAB
/begin CHARACTERISTIC OCT_phi_gsln_ena "Gasoline phi enable{OCT_phi_gsln_ena&0xff=0x00:Disabled}{OCT_phi_gsln_ena&0xff=0x01:Enabled}" VALUE 0x001C885A /* @ECU_Address@OCT_phi_gsln_ena@0x01010458@ */ ECIPP_ALIGNMENT_UBYTE 255 OCT_phi_gsln_ena_COMPU_VTAB 0 255 BIT_MASK 0xff /end CHARACTERISTIC
/begin COMPU_METHOD OCT_phi_gsln_ena_COMPU_VTAB "Verbal Table" TAB_VERB "%.0" "list" COMPU_TAB_REF OCT_phi_gsln_ena_COMPU_VTAB_REF /end COMPU_METHOD
/begin COMPU_VTAB OCT_phi_gsln_ena_COMPU_VTAB_REF "Verbal Table" TAB_VERB 2 0x00 "Disabled" 0x01 "Enabled" DEFAULT_VALUE "UNKNOWN" /end COMPU_VTAB
/begin CHARACTERISTIC OCT_phi_LP_alt_tbl "LP phi alternate table{OCT_phi_LP_alt_tbl&0xff=0:Gasoline}{OCT_phi_LP_alt_tbl&0xff=1:Propane}{OCT_phi_LP_alt_tbl&0xff=2:Natural Gas}" VALUE 0x001C8858 /* @ECU_Address@OCT_phi_LP_alt_tbl@0x01010460@ */ ECIPP_ALIGNMENT_UBYTE 255 OCT_phi_LP_alt_tbl_COMPU_VTAB 0 255 BIT_MASK 0xff /end CHARACTERISTIC
/begin COMPU_METHOD OCT_phi_LP_alt_tbl_COMPU_VTAB "Verbal Table" TAB_VERB "%.0" "list" COMPU_TAB_REF OCT_phi_LP_alt_tbl_COMPU_VTAB_REF /end COMPU_METHOD
/begin COMPU_VTAB OCT_phi_LP_alt_tbl_COMPU_VTAB_REF "Verbal Table" TAB_VERB 3 0 "Gasoline" 1 "Propane" 2 "Natural Gas" DEFAULT_VALUE "UNKNOWN" /end COMPU_VTAB
/begin CHARACTERISTIC OCT_phi_LP_ena "LP phi enable{OCT_phi_LP_ena&0xff=0x00:Disabled}{OCT_phi_LP_ena&0xff=0x01:Enabled}" VALUE 0x001C885B /* @ECU_Address@OCT_phi_LP_ena@0x01010468@ */ ECIPP_ALIGNMENT_UBYTE 255 OCT_phi_LP_ena_COMPU_VTAB 0 255 BIT_MASK 0xff /end CHARACTERISTIC
/begin COMPU_METHOD OCT_phi_LP_ena_COMPU_VTAB "Verbal Table" TAB_VERB "%.0" "list" COMPU_TAB_REF OCT_phi_LP_ena_COMPU_VTAB_REF /end COMPU_METHOD
/begin COMPU_VTAB OCT_phi_LP_ena_COMPU_VTAB_REF "Verbal Table" TAB_VERB 2 0x00 "Disabled" 0x01 "Enabled" DEFAULT_VALUE "UNKNOWN" /end COMPU_VTAB
/begin CHARACTERISTIC OCT_phi_NG_alt_tbl "NG phi alternate table{OCT_phi_NG_alt_tbl&0xff=0:Gasoline}{OCT_phi_NG_alt_tbl&0xff=1:Propane}{OCT_phi_NG_alt_tbl&0xff=2:Natural Gas}" VALUE 0x001C8859 /* @ECU_Address@OCT_phi_NG_alt_tbl@0x01010470@ */ ECIPP_ALIGNMENT_UBYTE 255 OCT_phi_NG_alt_tbl_COMPU_VTAB 0 255 BIT_MASK 0xff /end CHARACTERISTIC
/begin COMPU_METHOD OCT_phi_NG_alt_tbl_COMPU_VTAB "Verbal Table" TAB_VERB "%.0" "list" COMPU_TAB_REF OCT_phi_NG_alt_tbl_COMPU_VTAB_REF /end COMPU_METHOD
/begin COMPU_VTAB OCT_phi_NG_alt_tbl_COMPU_VTAB_REF "Verbal Table" TAB_VERB 3 0 "Gasoline" 1 "Propane" 2 "Natural Gas" DEFAULT_VALUE "UNKNOWN" /end COMPU_VTAB
/begin CHARACTERISTIC OCT_phi_NG_ena "NG phi enable{OCT_phi_NG_ena&0xff=0x00:Disabled}{OCT_phi_NG_ena&0xff=0x01:Enabled}" VALUE 0x001C885C /* @ECU_Address@OCT_phi_NG_ena@0x01010478@ */ ECIPP_ALIGNMENT_UBYTE 255 OCT_phi_NG_ena_COMPU_VTAB 0 255 BIT_MASK 0xff /end CHARACTERISTIC
/begin COMPU_METHOD OCT_phi_NG_ena_COMPU_VTAB "Verbal Table" TAB_VERB "%.0" "list" COMPU_TAB_REF OCT_phi_NG_ena_COMPU_VTAB_REF /end COMPU_METHOD
/begin COMPU_VTAB OCT_phi_NG_ena_COMPU_VTAB_REF "Verbal Table" TAB_VERB 2 0x00 "Disabled" 0x01 "Enabled" DEFAULT_VALUE "UNKNOWN" /end COMPU_VTAB
/begin MEASUREMENT MFG_status "MFG status{MFG_status&0xff=0:Comm Lost}{MFG_status&0xff=1:OK}{MFG_status&0xff=2:Fault}" UBYTE MFG_status_COMPU_VTAB 0 0 0 255 ECU_ADDRESS 0x010115B0 BIT_MASK 0xff /end MEASUREMENT
/begin COMPU_METHOD MFG_status_COMPU_VTAB "Verbal Table" TAB_VERB "%.0" "list" COMPU_TAB_REF MFG_status_COMPU_VTAB_REF /end COMPU_METHOD
/begin COMPU_VTAB MFG_status_COMPU_VTAB_REF "Verbal Table" TAB_VERB 3 0 "Comm Lost" 1 "OK" 2 "Fault" DEFAULT_VALUE "UNKNOWN" /end COMPU_VTAB
/begin MEASUREMENT MFG_mdot_cmd_pct "MFG commanded fuel flow" UWORD Compu_MFG_mdot_cmd_pct 0 0 0 99.9984741210938 ECU_ADDRESS 0x01011618 /end MEASUREMENT
/begin COMPU_METHOD Compu_MFG_mdot_cmd_pct " " RAT_FUNC "%.1" "% of FS" COEFFS 0 655.36 0 0 0 1 /end COMPU_METHOD
/begin MEASUREMENT MFG_mdot_cmd "MFG commanded fuel flow" ULONG Compu_MFG_mdot_cmd 0 0 0 16383.9999961853 ECU_ADDRESS 0x01011620 /end MEASUREMENT
/begin COMPU_METHOD Compu_MFG_mdot_cmd " " RAT_FUNC "%.2" "g/sec" COEFFS 0 262144 0 0 0 1 /end COMPU_METHOD
/begin MEASUREMENT MFG_TPS_act_pct "MFG actual position" UWORD Compu_MFG_TPS_act_pct 0 0 0 99.9984741210938 ECU_ADDRESS 0x01011630 /end MEASUREMENT
/begin COMPU_METHOD Compu_MFG_TPS_act_pct " " RAT_FUNC "%.1" "%" COEFFS 0 655.36 0 0 0 1 /end COMPU_METHOD
/begin MEASUREMENT MFG_TPS_cmd_pct "MFG commanded position" UWORD Compu_MFG_TPS_cmd_pct 0 0 0 99.9984741210938 ECU_ADDRESS 0x01011638 /end MEASUREMENT
/begin COMPU_METHOD Compu_MFG_TPS_cmd_pct " " RAT_FUNC "%.1" "%" COEFFS 0 655.36 0 0 0 1 /end COMPU_METHOD
/begin MEASUREMENT MFG_FTemp "MFG fuel temperature" UWORD Compu_MFG_FTemp 0 0 -460 1383.171875 ECU_ADDRESS 0x01011640 /end MEASUREMENT
/begin COMPU_METHOD Compu_MFG_FTemp " " RAT_FUNC "%.1" "deg F" COEFFS 0 35.5555555555556 16355.5555555556 0 0 1 /end COMPU_METHOD
/begin MEASUREMENT MFG_USPress "MFG upstream pressure" UWORD Compu_MFG_USPress 0 0 0 148.51664578125 ECU_ADDRESS 0x01011650 /end MEASUREMENT
/begin COMPU_METHOD Compu_MFG_USPress " " RAT_FUNC "%.2" "psia" COEFFS 0 441.263668831617 0 0 0 1 /end COMPU_METHOD
/begin MEASUREMENT MFG_DSPress "MFG downstream pressure" UWORD Compu_MFG_DSPress 0 0 0 148.51664578125 ECU_ADDRESS 0x01011658 /end MEASUREMENT
/begin COMPU_METHOD Compu_MFG_DSPress " " RAT_FUNC "%.2" "psia" COEFFS 0 441.263668831617 0 0 0 1 /end COMPU_METHOD
/begin MEASUREMENT MFG_DPPress "MFG delta pressure" SWORD Compu_MFG_DPPress 0 0 -2.320608 2.32053718066406 ECU_ADDRESS 0x01011660 /end MEASUREMENT
/begin COMPU_METHOD Compu_MFG_DPPress " " RAT_FUNC "%.3" "psia" COEFFS 0 14120.4374026117 0 0 0 1 /end COMPU_METHOD
/begin MEASUREMENT KNK3_win_avg "Knock sensor 3" UWORD Compu_KNK3_win_avg 0 0 0 63.9990234375 ECU_ADDRESS 0x01012048 /end MEASUREMENT
/begin COMPU_METHOD Compu_KNK3_win_avg " " RAT_FUNC "%.3" "RMS volts" COEFFS 0 1024 0 0 0 1 /end COMPU_METHOD
/begin CHARACTERISTIC EGR_oct_ena "EGR octane adaptation{EGR_oct_ena&0xff=0:Disabled}{EGR_oct_ena&0xff=1:Enabled}" VALUE 0x001c0aad /* @ECU_Address@EGR_oct_ena@0x01012588@ */ ECIPP_ALIGNMENT_UBYTE 255 EGR_oct_ena_COMPU_VTAB 0 255 BIT_MASK 0xff /end CHARACTERISTIC
/begin COMPU_METHOD EGR_oct_ena_COMPU_VTAB "Verbal Table" TAB_VERB "%.0" "list" COMPU_TAB_REF EGR_oct_ena_COMPU_VTAB_REF /end COMPU_METHOD
/begin COMPU_VTAB EGR_oct_ena_COMPU_VTAB_REF "Verbal Table" TAB_VERB 2 0 "Disabled" 1 "Enabled" DEFAULT_VALUE "UNKNOWN" /end COMPU_VTAB
/begin CHARACTERISTIC EGR_oct_lim "Octane rating derate threshold" VALUE 0x001c09b4 /* @ECU_Address@EGR_oct_lim@0x01012590@ */ ECIPP_ALIGNMENT_UWORD 100 Compu_EGR_oct_lim 0 99.9984741210938 /end CHARACTERISTIC
/begin COMPU_METHOD Compu_EGR_oct_lim " " RAT_FUNC "%.1" "%" COEFFS 0 655.36 0 0 0 1 /end COMPU_METHOD
/begin CHARACTERISTIC EGR_oct_lim_mode "Octane rating load limit source{EGR_oct_lim_mode&0xff=0:Table 1 / Gasoline}{EGR_oct_lim_mode&0xff=1:Table 2 / LPG}{EGR_oct_lim_mode&0xff=2:Table 3 / NG}{EGR_oct_lim_mode&0xff=3:Table 4 / Power}{EGR_oct_lim_mode&0xff=4:Table 5}{EGR_oct_lim_mode&0xff=5:Tabl" VALUE 0x001c0aae /* @ECU_Address@EGR_oct_lim_mode@0x01012598@ */ ECIPP_ALIGNMENT_UBYTE 255 EGR_oct_lim_mode_COMPU_VTAB 0 255 BIT_MASK 0xff /end CHARACTERISTIC
/begin COMPU_METHOD EGR_oct_lim_mode_COMPU_VTAB "Verbal Table" TAB_VERB "%.0" "list" COMPU_TAB_REF EGR_oct_lim_mode_COMPU_VTAB_REF /end COMPU_METHOD
/begin COMPU_VTAB EGR_oct_lim_mode_COMPU_VTAB_REF "Verbal Table" TAB_VERB 8 0 "Table 1 / Gasoline" 1 "Table 2 / LPG" 2 "Table 3 / NG" 3 "Table 4 / Power" 4 "Table 5" 5 "Table 6" 6 "Table 7" 7 "Table 8" DEFAULT_VALUE "UNKNOWN" /end COMPU_VTAB
/begin CHARACTERISTIC EGR_oct_LL_tau_dec "Octane rating load limit decreasing tau" VALUE 0x001c0a84 /* @ECU_Address@EGR_oct_LL_tau_dec@0x010125A0@ */ ECIPP_ALIGNMENT_UWORD 3277 Compu_EGR_oct_LL_tau_dec 0.0045084 3276.8 /end CHARACTERISTIC
/begin COMPU_METHOD Compu_EGR_oct_LL_tau_dec " " FORM "%.1" "sec"
 /begin FORMULA "-0.05 / log(1 - (X1 / 65536))" FORMULA_INV "(1 - exp(-0.05/X1)) * 65536" /end FORMULA
/end COMPU_METHOD
/begin CHARACTERISTIC EGR_oct_LL_tau_inc "Octane rating load limit increasing tau" VALUE 0x001c0a86 /* @ECU_Address@EGR_oct_LL_tau_inc@0x010125A8@ */ ECIPP_ALIGNMENT_UWORD 3277 Compu_EGR_oct_LL_tau_inc 0.0045084 3276.8 /end CHARACTERISTIC
/begin COMPU_METHOD Compu_EGR_oct_LL_tau_inc " " FORM "%.1" "sec"
 /begin FORMULA "-0.05 / log(1 - (X1 / 65536))" FORMULA_INV "(1 - exp(-0.05/X1)) * 65536" /end FORMULA
/end COMPU_METHOD
/begin MEASUREMENT EGR_oct_LL_pct_raw "Octane rating load limit prior to slewing" UWORD Compu_EGR_oct_LL_pct_raw 0 0 0 99.9984741210938 ECU_ADDRESS 0x010125D8 /end MEASUREMENT
/begin COMPU_METHOD Compu_EGR_oct_LL_pct_raw " " RAT_FUNC "%.1" "%" COEFFS 0 655.36 0 0 0 1 /end COMPU_METHOD
/begin CHARACTERISTIC OCT_slew_dec_max "Decreasing octane maximum Kp" VALUE 0x001c3a10 /* @ECU_Address@OCT_slew_dec_max@0x010125E8@ */ ECIPP_ALIGNMENT_UWORD 100 Compu_OCT_slew_dec_max 0 99.9984741210938 /end CHARACTERISTIC
/begin COMPU_METHOD Compu_OCT_slew_dec_max " " RAT_FUNC "%.2" "%/sec" COEFFS 0 655.36 0 0 0 1 /end COMPU_METHOD
/begin MEASUREMENT OCT_slew_dec_cur "Decreasing octane slew rate" UWORD Compu_OCT_slew_dec_cur 0 0 0 99.9984741210938 ECU_ADDRESS 0x010125F0 /end MEASUREMENT
/begin COMPU_METHOD Compu_OCT_slew_dec_cur " " RAT_FUNC "%.2" "%/sec" COEFFS 0 655.36 0 0 0 1 /end COMPU_METHOD
/begin CHARACTERISTIC OCT_slew_inc_ss "Increasing octane steady-state slew rate" VALUE 0x001c3a14 /* @ECU_Address@OCT_slew_inc_ss@0x01012600@ */ ECIPP_ALIGNMENT_UWORD 100 Compu_OCT_slew_inc_ss 0 99.9984741210938 /end CHARACTERISTIC
/begin COMPU_METHOD Compu_OCT_slew_inc_ss " " RAT_FUNC "%.2" "%/sec" COEFFS 0 655.36 0 0 0 1 /end COMPU_METHOD
/begin CHARACTERISTIC OCT_dec_knkpctinc_dz "Decreasing octane knock retard increase deadzone" VALUE 0x001c39f2 /* @ECU_Address@OCT_dec_knkpctinc_dz@0x01012BC0@ */ ECIPP_ALIGNMENT_UWORD 100 Compu_OCT_dec_knkpctinc_dz 0 99.9984741210938 /end CHARACTERISTIC
/begin COMPU_METHOD Compu_OCT_dec_knkpctinc_dz " " RAT_FUNC "%.2" "%/window" COEFFS 0 655.36 0 0 0 1 /end COMPU_METHOD
/begin CHARACTERISTIC OCT_dec_tm "Decreasing octane update period" VALUE 0x001c39f4 /* @ECU_Address@OCT_dec_tm@0x01012BC8@ */ ECIPP_ALIGNMENT_UWORD 65535 Compu_OCT_dec_tm 0 65535 /end CHARACTERISTIC
/begin COMPU_METHOD Compu_OCT_dec_tm " " RAT_FUNC "%.0" "ms" COEFFS 0 1 0 0 0 1 /end COMPU_METHOD
/begin MEASUREMENT KNK_ret_pctinc_max "Max knock retard increase" UWORD Compu_KNK_ret_pctinc_max 0 0 0 99.9984741210938 ECU_ADDRESS 0x01012BD0 /end MEASUREMENT
/begin COMPU_METHOD Compu_KNK_ret_pctinc_max " " RAT_FUNC "%.2" "%/window" COEFFS 0 655.36 0 0 0 1 /end COMPU_METHOD
/begin MEASUREMENT OCT_adapt_reset "Octane rating reset request{OCT_adapt_reset&0xff=0:Reset}{OCT_adapt_reset&0xff=1:Resetting...}" UBYTE OCT_adapt_reset_COMPU_VTAB 0 0 0 255 ECU_ADDRESS 0x01012BD8 BIT_MASK 0xff /end MEASUREMENT
/begin COMPU_METHOD OCT_adapt_reset_COMPU_VTAB "Verbal Table" TAB_VERB "%.0" "list" COMPU_TAB_REF OCT_adapt_reset_COMPU_VTAB_REF /end COMPU_METHOD
/begin COMPU_VTAB OCT_adapt_reset_COMPU_VTAB_REF "Verbal Table" TAB_VERB 2 0 "Reset" 1 "Resetting..." DEFAULT_VALUE "UNKNOWN" /end COMPU_VTAB
/begin CHARACTERISTIC OCT_slew_dec_Kd "Decreasing octane minimum Kd" VALUE 0x001c3a0c /* @ECU_Address@OCT_slew_dec_Kd@0x01012BE0@ */ ECIPP_ALIGNMENT_UWORD 100 Compu_OCT_slew_dec_Kd 0 99.9984741210938 /end CHARACTERISTIC
/begin COMPU_METHOD Compu_OCT_slew_dec_Kd " " RAT_FUNC "%.2" "%/window" COEFFS 0 655.36 0 0 0 1 /end COMPU_METHOD
/begin CHARACTERISTIC KNK_MAP_mode "Knock/octane enable/fault MAP selection{KNK_MAP_mode&0xff=0:MAP}{KNK_MAP_mode&0xff=1:MAP load}" VALUE 0x001c3a21 /* @ECU_Address@KNK_MAP_mode@0x01012BE8@ */ ECIPP_ALIGNMENT_UBYTE 255 KNK_MAP_mode_COMPU_VTAB 0 255 BIT_MASK 0xff /end CHARACTERISTIC
/begin COMPU_METHOD KNK_MAP_mode_COMPU_VTAB "Verbal Table" TAB_VERB "%.0" "list" COMPU_TAB_REF KNK_MAP_mode_COMPU_VTAB_REF /end COMPU_METHOD
/begin COMPU_VTAB KNK_MAP_mode_COMPU_VTAB_REF "Verbal Table" TAB_VERB 2 0 "MAP" 1 "MAP load" DEFAULT_VALUE "UNKNOWN" /end COMPU_VTAB
/begin MEASUREMENT OCT_slew_inc_mode "Increasing octane slew rate mode{OCT_slew_inc_mode&0xff=1:Steady-state}{OCT_slew_inc_mode&0xff=0:Power-up}" UBYTE OCT_slew_inc_mode_COMPU_VTAB 0 0 0 255 ECU_ADDRESS 0x01012BF0 BIT_MASK 0xff /end MEASUREMENT
/begin COMPU_METHOD OCT_slew_inc_mode_COMPU_VTAB "Verbal Table" TAB_VERB "%.0" "list" COMPU_TAB_REF OCT_slew_inc_mode_COMPU_VTAB_REF /end COMPU_METHOD
/begin COMPU_VTAB OCT_slew_inc_mode_COMPU_VTAB_REF "Verbal Table" TAB_VERB 2 1 "Steady-state" 0 "Power-up" DEFAULT_VALUE "UNKNOWN" /end COMPU_VTAB
/begin CHARACTERISTIC OCT_slew_dec_Kd_max "Decreasing octane maximum Kd" VALUE 0x001c3a0e /* @ECU_Address@OCT_slew_dec_Kd_max@0x01012BF8@ */ ECIPP_ALIGNMENT_UWORD 100 Compu_OCT_slew_dec_Kd_max 0 99.9984741210938 /end CHARACTERISTIC
/begin COMPU_METHOD Compu_OCT_slew_dec_Kd_max " " RAT_FUNC "%.2" "%/window" COEFFS 0 655.36 0 0 0 1 /end COMPU_METHOD
/begin CHARACTERISTIC KNK_min_mode "Knock sensor open fault voltage measurement{KNK_min_mode&0xff=0:Filtered/windowed}{KNK_min_mode&0xff=1:Unfiltered/engine cycle} (Fault Condition:Knock sensor input measurement)" VALUE 0x001c87ba /* @ECU_Address@KNK_min_mode@0x01012C60@ */ ECIPP_ALIGNMENT_UBYTE 255 KNK_min_mode_COMPU_VTAB 0 255 BIT_MASK 0xff /end CHARACTERISTIC
/begin COMPU_METHOD KNK_min_mode_COMPU_VTAB "Verbal Table" TAB_VERB "%.0" "list" COMPU_TAB_REF KNK_min_mode_COMPU_VTAB_REF /end COMPU_METHOD
/begin COMPU_VTAB KNK_min_mode_COMPU_VTAB_REF "Verbal Table" TAB_VERB 2 0 "Filtered/windowed" 1 "Unfiltered/engine cycle" DEFAULT_VALUE "UNKNOWN" /end COMPU_VTAB
/begin MEASUREMENT KNK_raw_avg "KNK1 unfiltered average" UWORD Compu_KNK_raw_avg 0 0 0 63.9990234375 ECU_ADDRESS 0x01012C68 /end MEASUREMENT
/begin COMPU_METHOD Compu_KNK_raw_avg " " RAT_FUNC "%.3" "RMS volts" COEFFS 0 1024 0 0 0 1 /end COMPU_METHOD
/begin MEASUREMENT KNK2_raw_avg "KNK2 unfiltered average" UWORD Compu_KNK2_raw_avg 0 0 0 63.9990234375 ECU_ADDRESS 0x01012C70 /end MEASUREMENT
/begin COMPU_METHOD Compu_KNK2_raw_avg " " RAT_FUNC "%.3" "RMS volts" COEFFS 0 1024 0 0 0 1 /end COMPU_METHOD
/begin MEASUREMENT KNK3_raw_avg "KNK3 unfiltered average" UWORD Compu_KNK3_raw_avg 0 0 0 63.9990234375 ECU_ADDRESS 0x01012C78 /end MEASUREMENT
/begin COMPU_METHOD Compu_KNK3_raw_avg " " RAT_FUNC "%.3" "RMS volts" COEFFS 0 1024 0 0 0 1 /end COMPU_METHOD
/begin MEASUREMENT EPR_DC_act "EPR duty-cycle feedback" SWORD Compu_EPR_DC_act 0 0 -100 99.9969482421875 ECU_ADDRESS 0x01013940 /end MEASUREMENT
/begin COMPU_METHOD Compu_EPR_DC_act " " RAT_FUNC "%.1" "%" COEFFS 0 327.68 0 0 0 1 /end COMPU_METHOD
/begin MEASUREMENT TANK_1_V "TANK_1_V" UWORD Compu_TANK_1_V 0 0 0 1023.984375 ECU_ADDRESS 0x01014478 /end MEASUREMENT
/begin COMPU_METHOD Compu_TANK_1_V " " RAT_FUNC "%.3" "volts" COEFFS 0 64 0 0 0 1 /end COMPU_METHOD
/begin MEASUREMENT TANK_2_V "TANK_2_V" UWORD Compu_TANK_2_V 0 0 0 1023.984375 ECU_ADDRESS 0x01014480 /end MEASUREMENT
/begin COMPU_METHOD Compu_TANK_2_V " " RAT_FUNC "%.3" "volts" COEFFS 0 64 0 0 0 1 /end COMPU_METHOD
/begin MEASUREMENT TANK_ADCnts_final "Final Tank Setpoint" ULONG Compu_TANK_ADCnts_final 0 0 0 21029082.8485348 ECU_ADDRESS 0x010144B8 /end MEASUREMENT
/begin COMPU_METHOD Compu_TANK_ADCnts_final " " RAT_FUNC "%.1" "volts" COEFFS 0 204.239401496259 0 0 0 1 /end COMPU_METHOD
/begin MEASUREMENT SPOCK_ECM1_LED "4G-SPOCK CAN{SPOCK_ECM1_LED&0x01=0x00:Inactive}{SPOCK_ECM1_LED&0x01=0x01:Active}" UBYTE SPOCK_ECM1_LED_COMPU_VTAB 0 0 0 255 ECU_ADDRESS 0x01014550 BIT_MASK 0x01 /end MEASUREMENT
/begin COMPU_METHOD SPOCK_ECM1_LED_COMPU_VTAB "Verbal Table" TAB_VERB "%.0" "list" COMPU_TAB_REF SPOCK_ECM1_LED_COMPU_VTAB_REF /end COMPU_METHOD
/begin COMPU_VTAB SPOCK_ECM1_LED_COMPU_VTAB_REF "Verbal Table" TAB_VERB 2 0x00 "Inactive" 0x01 "Active" DEFAULT_VALUE "UNKNOWN" /end COMPU_VTAB
/begin MEASUREMENT SparkKV_filt_avg "Spark KV filt avg" UWORD Compu_SparkKV_filt_avg 0 0 0 65.535 ECU_ADDRESS 0x01014608 /end MEASUREMENT
/begin COMPU_METHOD Compu_SparkKV_filt_avg " " RAT_FUNC "%.1" "KV" COEFFS 0 1000 0 0 0 1 /end COMPU_METHOD
/begin CHARACTERISTIC KNK_sens_cyl11 "Knock sensor assignment 11{KNK_sens_cyl11&0xff=0:Disabled}{KNK_sens_cyl11&0xff=1:Sensor 1}{KNK_sens_cyl11&0xff=2:Sensor 2}{KNK_sens_cyl11&0xff=3:Sensor 3}{KNK_sens_cyl11&0xff=4:Sensor 4}{KNK_sens_cyl11&0xff=5:Sensor 5}{KNK_sens_cyl11&0xff=6:Sensor 6}{KNK_" VALUE 0x001C3A39 /* @ECU_Address@KNK_sens_cyl11@0x010146A0@ */ ECIPP_ALIGNMENT_UBYTE 255 KNK_sens_cyl11_COMPU_VTAB 0 255 BIT_MASK 0xff /end CHARACTERISTIC
/begin COMPU_METHOD KNK_sens_cyl11_COMPU_VTAB "Verbal Table" TAB_VERB "%.0" "list" COMPU_TAB_REF KNK_sens_cyl11_COMPU_VTAB_REF /end COMPU_METHOD
/begin COMPU_VTAB KNK_sens_cyl11_COMPU_VTAB_REF "Verbal Table" TAB_VERB 13 0 "Disabled" 1 "Sensor 1" 2 "Sensor 2" 3 "Sensor 3" 4 "Sensor 4" 5 "Sensor 5" 6 "Sensor 6" 7 "Sensor 7" 8 "Sensor 8" 9 "Sensor 9" 10 "Sensor 10" 11 "Sensor 11" 12 "Sensor 12" DEFAULT_VALUE "UNKNOWN" /end COMPU_VTAB
/begin CHARACTERISTIC KNK_sens_cyl12 "Knock sensor assignment 12{KNK_sens_cyl12&0xff=0:Disabled}{KNK_sens_cyl12&0xff=1:Sensor 1}{KNK_sens_cyl12&0xff=2:Sensor 2}{KNK_sens_cyl12&0xff=3:Sensor 3}{KNK_sens_cyl12&0xff=4:Sensor 4}{KNK_sens_cyl12&0xff=5:Sensor 5}{KNK_sens_cyl12&0xff=6:Sensor 6}{KNK_" VALUE 0x001C3A3A /* @ECU_Address@KNK_sens_cyl12@0x010146A8@ */ ECIPP_ALIGNMENT_UBYTE 255 KNK_sens_cyl12_COMPU_VTAB 0 255 BIT_MASK 0xff /end CHARACTERISTIC
/begin COMPU_METHOD KNK_sens_cyl12_COMPU_VTAB "Verbal Table" TAB_VERB "%.0" "list" COMPU_TAB_REF KNK_sens_cyl12_COMPU_VTAB_REF /end COMPU_METHOD
/begin COMPU_VTAB KNK_sens_cyl12_COMPU_VTAB_REF "Verbal Table" TAB_VERB 13 0 "Disabled" 1 "Sensor 1" 2 "Sensor 2" 3 "Sensor 3" 4 "Sensor 4" 5 "Sensor 5" 6 "Sensor 6" 7 "Sensor 7" 8 "Sensor 8" 9 "Sensor 9" 10 "Sensor 10" 11 "Sensor 11" 12 "Sensor 12" DEFAULT_VALUE "UNKNOWN" /end COMPU_VTAB
/begin CHARACTERISTIC KNK_tbl_cyl11 "Knock table select 11{KNK_tbl_cyl11&0xff=0:Standard}{KNK_tbl_cyl11&0xff=1:Alternate A}{KNK_tbl_cyl11&0xff=2:Alternate B}" VALUE 0x001C3A45 /* @ECU_Address@KNK_tbl_cyl11@0x010146B0@ */ ECIPP_ALIGNMENT_UBYTE 255 KNK_tbl_cyl11_COMPU_VTAB 0 255 BIT_MASK 0xff /end CHARACTERISTIC
/begin COMPU_METHOD KNK_tbl_cyl11_COMPU_VTAB "Verbal Table" TAB_VERB "%.0" "list" COMPU_TAB_REF KNK_tbl_cyl11_COMPU_VTAB_REF /end COMPU_METHOD
/begin COMPU_VTAB KNK_tbl_cyl11_COMPU_VTAB_REF "Verbal Table" TAB_VERB 3 0 "Standard" 1 "Alternate A" 2 "Alternate B" DEFAULT_VALUE "UNKNOWN" /end COMPU_VTAB
/begin CHARACTERISTIC KNK_tbl_cyl12 "Knock table select 12{KNK_tbl_cyl12&0xff=0:Standard}{KNK_tbl_cyl12&0xff=1:Alternate A}{KNK_tbl_cyl12&0xff=2:Alternate B}" VALUE 0x001C3A46 /* @ECU_Address@KNK_tbl_cyl12@0x010146B8@ */ ECIPP_ALIGNMENT_UBYTE 255 KNK_tbl_cyl12_COMPU_VTAB 0 255 BIT_MASK 0xff /end CHARACTERISTIC
/begin COMPU_METHOD KNK_tbl_cyl12_COMPU_VTAB "Verbal Table" TAB_VERB "%.0" "list" COMPU_TAB_REF KNK_tbl_cyl12_COMPU_VTAB_REF /end COMPU_METHOD
/begin COMPU_VTAB KNK_tbl_cyl12_COMPU_VTAB_REF "Verbal Table" TAB_VERB 3 0 "Standard" 1 "Alternate A" 2 "Alternate B" DEFAULT_VALUE "UNKNOWN" /end COMPU_VTAB
/begin CHARACTERISTIC KNK_mult_cyl11 "Knock signal multiplier 11{KNK_mult_cyl11&0xff=0:Standard}{KNK_mult_cyl11&0xff=1:Alternate A}{KNK_mult_cyl11&0xff=2:Alternate B}" VALUE 0x001C3A2D /* @ECU_Address@KNK_mult_cyl11@0x010146C0@ */ ECIPP_ALIGNMENT_UBYTE 255 KNK_mult_cyl11_COMPU_VTAB 0 255 BIT_MASK 0xff /end CHARACTERISTIC
/begin COMPU_METHOD KNK_mult_cyl11_COMPU_VTAB "Verbal Table" TAB_VERB "%.0" "list" COMPU_TAB_REF KNK_mult_cyl11_COMPU_VTAB_REF /end COMPU_METHOD
/begin COMPU_VTAB KNK_mult_cyl11_COMPU_VTAB_REF "Verbal Table" TAB_VERB 3 0 "Standard" 1 "Alternate A" 2 "Alternate B" DEFAULT_VALUE "UNKNOWN" /end COMPU_VTAB
/begin CHARACTERISTIC KNK_mult_cyl12 "Knock signal multiplier 12{KNK_mult_cyl12&0xff=0:Standard}{KNK_mult_cyl12&0xff=1:Alternate A}{KNK_mult_cyl12&0xff=2:Alternate B}" VALUE 0x001C3A2E /* @ECU_Address@KNK_mult_cyl12@0x010146C8@ */ ECIPP_ALIGNMENT_UBYTE 255 KNK_mult_cyl12_COMPU_VTAB 0 255 BIT_MASK 0xff /end CHARACTERISTIC
/begin COMPU_METHOD KNK_mult_cyl12_COMPU_VTAB "Verbal Table" TAB_VERB "%.0" "list" COMPU_TAB_REF KNK_mult_cyl12_COMPU_VTAB_REF /end COMPU_METHOD
/begin COMPU_VTAB KNK_mult_cyl12_COMPU_VTAB_REF "Verbal Table" TAB_VERB 3 0 "Standard" 1 "Alternate A" 2 "Alternate B" DEFAULT_VALUE "UNKNOWN" /end COMPU_VTAB
/begin MEASUREMENT KNK4_win_avg "Knock sensor 4" UWORD Compu_KNK4_win_avg 0 0 0 63.9990234375 ECU_ADDRESS 0x01014728 /end MEASUREMENT
/begin COMPU_METHOD Compu_KNK4_win_avg " " RAT_FUNC "%.3" "RMS volts" COEFFS 0 1024 0 0 0 1 /end COMPU_METHOD
/begin MEASUREMENT KNK5_win_avg "Knock sensor 5" UWORD Compu_KNK5_win_avg 0 0 0 63.9990234375 ECU_ADDRESS 0x01014730 /end MEASUREMENT
/begin COMPU_METHOD Compu_KNK5_win_avg " " RAT_FUNC "%.3" "RMS volts" COEFFS 0 1024 0 0 0 1 /end COMPU_METHOD
/begin MEASUREMENT KNK6_win_avg "Knock sensor 6" UWORD Compu_KNK6_win_avg 0 0 0 63.9990234375 ECU_ADDRESS 0x01014738 /end MEASUREMENT
/begin COMPU_METHOD Compu_KNK6_win_avg " " RAT_FUNC "%.3" "RMS volts" COEFFS 0 1024 0 0 0 1 /end COMPU_METHOD
/begin MEASUREMENT KNK7_win_avg "Knock sensor 7" UWORD Compu_KNK7_win_avg 0 0 0 63.9990234375 ECU_ADDRESS 0x01014740 /end MEASUREMENT
/begin COMPU_METHOD Compu_KNK7_win_avg " " RAT_FUNC "%.3" "RMS volts" COEFFS 0 1024 0 0 0 1 /end COMPU_METHOD
/begin MEASUREMENT KNK8_win_avg "Knock sensor 8" UWORD Compu_KNK8_win_avg 0 0 0 63.9990234375 ECU_ADDRESS 0x01014748 /end MEASUREMENT
/begin COMPU_METHOD Compu_KNK8_win_avg " " RAT_FUNC "%.3" "RMS volts" COEFFS 0 1024 0 0 0 1 /end COMPU_METHOD
/begin MEASUREMENT KNK9_win_avg "Knock sensor 9" UWORD Compu_KNK9_win_avg 0 0 0 63.9990234375 ECU_ADDRESS 0x01014750 /end MEASUREMENT
/begin COMPU_METHOD Compu_KNK9_win_avg " " RAT_FUNC "%.3" "RMS volts" COEFFS 0 1024 0 0 0 1 /end COMPU_METHOD
/begin MEASUREMENT KNK10_win_avg "Knock sensor 10" UWORD Compu_KNK10_win_avg 0 0 0 63.9990234375 ECU_ADDRESS 0x01014758 /end MEASUREMENT
/begin COMPU_METHOD Compu_KNK10_win_avg " " RAT_FUNC "%.3" "RMS volts" COEFFS 0 1024 0 0 0 1 /end COMPU_METHOD
/begin MEASUREMENT KNK11_win_avg "Knock sensor 11" UWORD Compu_KNK11_win_avg 0 0 0 63.9990234375 ECU_ADDRESS 0x01014760 /end MEASUREMENT
/begin COMPU_METHOD Compu_KNK11_win_avg " " RAT_FUNC "%.3" "RMS volts" COEFFS 0 1024 0 0 0 1 /end COMPU_METHOD
/begin MEASUREMENT KNK12_win_avg "Knock sensor 12" UWORD Compu_KNK12_win_avg 0 0 0 63.9990234375 ECU_ADDRESS 0x01014768 /end MEASUREMENT
/begin COMPU_METHOD Compu_KNK12_win_avg " " RAT_FUNC "%.3" "RMS volts" COEFFS 0 1024 0 0 0 1 /end COMPU_METHOD
/begin MEASUREMENT KNK4_raw_avg "KNK4 unfiltered average" UWORD Compu_KNK4_raw_avg 0 0 0 63.9990234375 ECU_ADDRESS 0x01014770 /end MEASUREMENT
/begin COMPU_METHOD Compu_KNK4_raw_avg " " RAT_FUNC "%.3" "RMS volts" COEFFS 0 1024 0 0 0 1 /end COMPU_METHOD
/begin MEASUREMENT KNK5_raw_avg "KNK5 unfiltered average" UWORD Compu_KNK5_raw_avg 0 0 0 63.9990234375 ECU_ADDRESS 0x01014778 /end MEASUREMENT
/begin COMPU_METHOD Compu_KNK5_raw_avg " " RAT_FUNC "%.3" "RMS volts" COEFFS 0 1024 0 0 0 1 /end COMPU_METHOD
/begin MEASUREMENT KNK6_raw_avg "KNK6 unfiltered average" UWORD Compu_KNK6_raw_avg 0 0 0 63.9990234375 ECU_ADDRESS 0x01014780 /end MEASUREMENT
/begin COMPU_METHOD Compu_KNK6_raw_avg " " RAT_FUNC "%.3" "RMS volts" COEFFS 0 1024 0 0 0 1 /end COMPU_METHOD
/begin MEASUREMENT KNK7_raw_avg "KNK7 unfiltered average" UWORD Compu_KNK7_raw_avg 0 0 0 63.9990234375 ECU_ADDRESS 0x01014788 /end MEASUREMENT
/begin COMPU_METHOD Compu_KNK7_raw_avg " " RAT_FUNC "%.3" "RMS volts" COEFFS 0 1024 0 0 0 1 /end COMPU_METHOD
/begin MEASUREMENT KNK8_raw_avg "KNK8 unfiltered average" UWORD Compu_KNK8_raw_avg 0 0 0 63.9990234375 ECU_ADDRESS 0x01014790 /end MEASUREMENT
/begin COMPU_METHOD Compu_KNK8_raw_avg " " RAT_FUNC "%.3" "RMS volts" COEFFS 0 1024 0 0 0 1 /end COMPU_METHOD
/begin MEASUREMENT KNK9_raw_avg "KNK9 unfiltered average" UWORD Compu_KNK9_raw_avg 0 0 0 63.9990234375 ECU_ADDRESS 0x01014798 /end MEASUREMENT
/begin COMPU_METHOD Compu_KNK9_raw_avg " " RAT_FUNC "%.3" "RMS volts" COEFFS 0 1024 0 0 0 1 /end COMPU_METHOD
/begin MEASUREMENT KNK10_raw_avg "KNK10 unfiltered average" UWORD Compu_KNK10_raw_avg 0 0 0 63.9990234375 ECU_ADDRESS 0x010147A0 /end MEASUREMENT
/begin COMPU_METHOD Compu_KNK10_raw_avg " " RAT_FUNC "%.3" "RMS volts" COEFFS 0 1024 0 0 0 1 /end COMPU_METHOD
/begin MEASUREMENT KNK11_raw_avg "KNK11 unfiltered average" UWORD Compu_KNK11_raw_avg 0 0 0 63.9990234375 ECU_ADDRESS 0x010147A8 /end MEASUREMENT
/begin COMPU_METHOD Compu_KNK11_raw_avg " " RAT_FUNC "%.3" "RMS volts" COEFFS 0 1024 0 0 0 1 /end COMPU_METHOD
/begin MEASUREMENT KNK12_raw_avg "KNK12 unfiltered average" UWORD Compu_KNK12_raw_avg 0 0 0 63.9990234375 ECU_ADDRESS 0x010147B0 /end MEASUREMENT
/begin COMPU_METHOD Compu_KNK12_raw_avg " " RAT_FUNC "%.3" "RMS volts" COEFFS 0 1024 0 0 0 1 /end COMPU_METHOD
/begin MEASUREMENT KNK_control_status "Knock control status{KNK_control_status&0xff=0:Disabled}{KNK_control_status&0xff=1:Inactive: sensor invalid}{KNK_control_status&0xff=2:Inactive: assignment invalid}{KNK_control_status&0xff=3:Active}{KNK_control_status&0xff=4:Remote}" UBYTE KNK_control_status_COMPU_VTAB 0 0 0 255 ECU_ADDRESS 0x01014948 BIT_MASK 0xff /end MEASUREMENT
/begin COMPU_METHOD KNK_control_status_COMPU_VTAB "Verbal Table" TAB_VERB "%.0" "list" COMPU_TAB_REF KNK_control_status_COMPU_VTAB_REF /end COMPU_METHOD
/begin COMPU_VTAB KNK_control_status_COMPU_VTAB_REF "Verbal Table" TAB_VERB 5 0 "Disabled" 1 "Inactive: sensor invalid" 2 "Inactive: assignment invalid" 3 "Active" 4 "Remote" DEFAULT_VALUE "UNKNOWN" /end COMPU_VTAB
/begin MEASUREMENT KNK_bg_cyl11 "Knock background cylinder 11" UWORD Compu_KNK_bg_cyl11 0 0 0 99.9984741210938 ECU_ADDRESS 0x01014A60 /end MEASUREMENT
/begin COMPU_METHOD Compu_KNK_bg_cyl11 " " RAT_FUNC "%.2" "% FS" COEFFS 0 655.36 0 0 0 1 /end COMPU_METHOD
/begin MEASUREMENT KNK_bg_cyl12 "Knock background cylinder 12" UWORD Compu_KNK_bg_cyl12 0 0 0 99.9984741210938 ECU_ADDRESS 0x01014A68 /end MEASUREMENT
/begin COMPU_METHOD Compu_KNK_bg_cyl12 " " RAT_FUNC "%.2" "% FS" COEFFS 0 655.36 0 0 0 1 /end COMPU_METHOD
/begin MEASUREMENT KNK_win_cyl11 "Knock window cylinder 11" UWORD Compu_KNK_win_cyl11 0 0 0 99.9984741210938 ECU_ADDRESS 0x01014A70 /end MEASUREMENT
/begin COMPU_METHOD Compu_KNK_win_cyl11 " " RAT_FUNC "%.2" "% FS" COEFFS 0 655.36 0 0 0 1 /end COMPU_METHOD
/begin MEASUREMENT KNK_win_cyl12 "Knock window cylinder 12" UWORD Compu_KNK_win_cyl12 0 0 0 99.9984741210938 ECU_ADDRESS 0x01014A78 /end MEASUREMENT
/begin COMPU_METHOD Compu_KNK_win_cyl12 " " RAT_FUNC "%.2" "% FS" COEFFS 0 655.36 0 0 0 1 /end COMPU_METHOD
/begin MEASUREMENT KNK_sig_cyl11 "Knock signal cylinder 11" UWORD Compu_KNK_sig_cyl11 0 0 0 99.9984741210938 ECU_ADDRESS 0x01014A80 /end MEASUREMENT
/begin COMPU_METHOD Compu_KNK_sig_cyl11 " " RAT_FUNC "%.2" "% FS" COEFFS 0 655.36 0 0 0 1 /end COMPU_METHOD
/begin MEASUREMENT KNK_sig_cyl12 "Knock signal cylinder 12" UWORD Compu_KNK_sig_cyl12 0 0 0 99.9984741210938 ECU_ADDRESS 0x01014A88 /end MEASUREMENT
/begin COMPU_METHOD Compu_KNK_sig_cyl12 " " RAT_FUNC "%.2" "% FS" COEFFS 0 655.36 0 0 0 1 /end COMPU_METHOD
/begin MEASUREMENT coil11_adv_mod "Coil11 advance modifier" SWORD Compu_coil11_adv_mod 0 0 -2048 2047.9375 ECU_ADDRESS 0x01014A90 /end MEASUREMENT
/begin COMPU_METHOD Compu_coil11_adv_mod " " RAT_FUNC "%.1" "CAD BTDC" COEFFS 0 16 0 0 0 1 /end COMPU_METHOD
/begin MEASUREMENT coil12_adv_mod "Coil12 advance modifier" SWORD Compu_coil12_adv_mod 0 0 -2048 2047.9375 ECU_ADDRESS 0x01014A98 /end MEASUREMENT
/begin COMPU_METHOD Compu_coil12_adv_mod " " RAT_FUNC "%.1" "CAD BTDC" COEFFS 0 16 0 0 0 1 /end COMPU_METHOD
/begin MEASUREMENT coil11_drv_latch "Coil11 (FO) drive" UWORD Compu_coil11_drv_latch 0 0 0 100.022893772894 ECU_ADDRESS 0x01014AE0 /end MEASUREMENT
/begin COMPU_METHOD Compu_coil11_drv_latch " " RAT_FUNC "%.1" "% FS" COEFFS 0 655.2 0 0 0 1 /end COMPU_METHOD
/begin MEASUREMENT coil12_drv_latch "Coil12 (FO) drive" UWORD Compu_coil12_drv_latch 0 0 0 100.022893772894 ECU_ADDRESS 0x01014AE8 /end MEASUREMENT
/begin COMPU_METHOD Compu_coil12_drv_latch " " RAT_FUNC "%.1" "% FS" COEFFS 0 655.2 0 0 0 1 /end COMPU_METHOD
/begin MEASUREMENT ESD_Sw_state "ESD switch{ESD_Sw_state&0xff=0:Engine run}{ESD_Sw_state&0xff=1:Engine STOP}" UBYTE ESD_Sw_state_COMPU_VTAB 0 0 0 255 ECU_ADDRESS 0x01014D48 BIT_MASK 0xff /end MEASUREMENT
/begin COMPU_METHOD ESD_Sw_state_COMPU_VTAB "Verbal Table" TAB_VERB "%.0" "list" COMPU_TAB_REF ESD_Sw_state_COMPU_VTAB_REF /end COMPU_METHOD
/begin COMPU_VTAB ESD_Sw_state_COMPU_VTAB_REF "Verbal Table" TAB_VERB 2 0 "Engine run" 1 "Engine STOP" DEFAULT_VALUE "UNKNOWN" /end COMPU_VTAB
/begin MEASUREMENT IGN_DIS_Sw_state "IGN_DIS switch{IGN_DIS_Sw_state&0xff=0:Engine run}{IGN_DIS_Sw_state&0xff=1:Engine STOP}" UBYTE IGN_DIS_Sw_state_COMPU_VTAB 0 0 0 255 ECU_ADDRESS 0x01014D50 BIT_MASK 0xff /end MEASUREMENT
/begin COMPU_METHOD IGN_DIS_Sw_state_COMPU_VTAB "Verbal Table" TAB_VERB "%.0" "list" COMPU_TAB_REF IGN_DIS_Sw_state_COMPU_VTAB_REF /end COMPU_METHOD
/begin COMPU_VTAB IGN_DIS_Sw_state_COMPU_VTAB_REF "Verbal Table" TAB_VERB 2 0 "Engine run" 1 "Engine STOP" DEFAULT_VALUE "UNKNOWN" /end COMPU_VTAB
/begin MEASUREMENT CAN1_speed_latch "CAN1 link speed{CAN1_speed_latch&0xff=0:125 Kbaud}{CAN1_speed_latch&0xff=1:250 Kbaud (J1939)}{CAN1_speed_latch&0xff=2:500 Kbaud}{CAN1_speed_latch&0xff=3:1000 Kbaud}" UBYTE CAN1_speed_latch_COMPU_VTAB 0 0 0 255 ECU_ADDRESS 0x010150C0 BIT_MASK 0xff /end MEASUREMENT
/begin COMPU_METHOD CAN1_speed_latch_COMPU_VTAB "Verbal Table" TAB_VERB "%.0" "list" COMPU_TAB_REF CAN1_speed_latch_COMPU_VTAB_REF /end COMPU_METHOD
/begin COMPU_VTAB CAN1_speed_latch_COMPU_VTAB_REF "Verbal Table" TAB_VERB 4 0 "125 Kbaud" 1 "250 Kbaud (J1939)" 2 "500 Kbaud" 3 "1000 Kbaud" DEFAULT_VALUE "UNKNOWN" /end COMPU_VTAB
/begin MEASUREMENT CAN2_speed_latch "CAN2 link speed{CAN2_speed_latch&0xff=0:125 Kbaud}{CAN2_speed_latch&0xff=1:250 Kbaud (J1939)}{CAN2_speed_latch&0xff=2:500 Kbaud}{CAN2_speed_latch&0xff=3:1000 Kbaud}" UBYTE CAN2_speed_latch_COMPU_VTAB 0 0 0 255 ECU_ADDRESS 0x010150C8 BIT_MASK 0xff /end MEASUREMENT
/begin COMPU_METHOD CAN2_speed_latch_COMPU_VTAB "Verbal Table" TAB_VERB "%.0" "list" COMPU_TAB_REF CAN2_speed_latch_COMPU_VTAB_REF /end COMPU_METHOD
/begin COMPU_VTAB CAN2_speed_latch_COMPU_VTAB_REF "Verbal Table" TAB_VERB 4 0 "125 Kbaud" 1 "250 Kbaud (J1939)" 2 "500 Kbaud" 3 "1000 Kbaud" DEFAULT_VALUE "UNKNOWN" /end COMPU_VTAB
/begin MEASUREMENT CAN3_speed_latch "CAN3 link speed{CAN3_speed_latch&0xff=0:125 Kbaud}{CAN3_speed_latch&0xff=1:250 Kbaud (J1939)}{CAN3_speed_latch&0xff=2:500 Kbaud}{CAN3_speed_latch&0xff=3:1000 Kbaud}" UBYTE CAN3_speed_latch_COMPU_VTAB 0 0 0 255 ECU_ADDRESS 0x010150D0 BIT_MASK 0xff /end MEASUREMENT
/begin COMPU_METHOD CAN3_speed_latch_COMPU_VTAB "Verbal Table" TAB_VERB "%.0" "list" COMPU_TAB_REF CAN3_speed_latch_COMPU_VTAB_REF /end COMPU_METHOD
/begin COMPU_VTAB CAN3_speed_latch_COMPU_VTAB_REF "Verbal Table" TAB_VERB 4 0 "125 Kbaud" 1 "250 Kbaud (J1939)" 2 "500 Kbaud" 3 "1000 Kbaud" DEFAULT_VALUE "UNKNOWN" /end COMPU_VTAB
/begin MEASUREMENT KNK_sampling_enabled "Knock sampling status{KNK_sampling_enabled&0xff=0:Inactive}{KNK_sampling_enabled&0xff=1:Active}" UBYTE KNK_sampling_enabled_COMPU_VTAB 0 0 0 255 ECU_ADDRESS 0x01015348 BIT_MASK 0xff /end MEASUREMENT
/begin COMPU_METHOD KNK_sampling_enabled_COMPU_VTAB "Verbal Table" TAB_VERB "%.0" "list" COMPU_TAB_REF KNK_sampling_enabled_COMPU_VTAB_REF /end COMPU_METHOD
/begin COMPU_VTAB KNK_sampling_enabled_COMPU_VTAB_REF "Verbal Table" TAB_VERB 2 0 "Inactive" 1 "Active" DEFAULT_VALUE "UNKNOWN" /end COMPU_VTAB
/begin MEASUREMENT crank_LFP_Ptgt_LED "Low fuel pressure LED{crank_LFP_Ptgt_LED&0xff=0:Inactive}{crank_LFP_Ptgt_LED&0xff=1:Active}" UBYTE crank_LFP_Ptgt_LED_COMPU_VTAB 0 0 0 255 ECU_ADDRESS 0x01015450 BIT_MASK 0xff /end MEASUREMENT
/begin COMPU_METHOD crank_LFP_Ptgt_LED_COMPU_VTAB "Verbal Table" TAB_VERB "%.0" "list" COMPU_TAB_REF crank_LFP_Ptgt_LED_COMPU_VTAB_REF /end COMPU_METHOD
/begin COMPU_VTAB crank_LFP_Ptgt_LED_COMPU_VTAB_REF "Verbal Table" TAB_VERB 2 0 "Inactive" 1 "Active" DEFAULT_VALUE "UNKNOWN" /end COMPU_VTAB
/begin COMPU_METHOD Compu_TKNK_cal_MAP " " RAT_FUNC "%.1" "MAP load (psia)" COEFFS 0 256 0 0 0 1 /end COMPU_METHOD
/begin COMPU_METHOD Compu_TKNK_cal_rpm " " RAT_FUNC "%.0" "Speed (rpm)" COEFFS 0 1 0 0 0 1 /end COMPU_METHOD
/begin CHARACTERISTIC TKNK_start "Knock Window Start" MAP 0x001C3750 /* @ECU_Address@TKNK_start@0x020A3000@ */ ECIPP_ALIGNMENT_SWORD 16384 Compu_TKNK_start -16384 16383.5
 /begin AXIS_DESCR COM_AXIS NO_INPUT_QUANTITY Compu_TKNK_cal_MAP 4 -128 127.99609375 AXIS_PTS_REF TKNK_cal_MAP /end AXIS_DESCR
 /begin AXIS_DESCR COM_AXIS NO_INPUT_QUANTITY Compu_TKNK_cal_rpm 8 -32768 32767 AXIS_PTS_REF TKNK_cal_rpm /end AXIS_DESCR
/end CHARACTERISTIC
/begin AXIS_PTS TKNK_cal_MAP " " 0x001C3578 /* @ECU_Address@TKNK_cal_MAP@0x020A1000@ */ NO_INPUT_QUANTITY ECIPP_Lookup_SWORD 0 Compu_TKNK_cal_MAP 4 -128 127.99609375 /end AXIS_PTS
/begin AXIS_PTS TKNK_cal_rpm " " 0x001C3580 /* @ECU_Address@TKNK_cal_rpm@0x020A2000@ */ NO_INPUT_QUANTITY ECIPP_Lookup_SWORD 0 Compu_TKNK_cal_rpm 8 -32768 32767 /end AXIS_PTS
/begin COMPU_METHOD Compu_TKNK_start "" RAT_FUNC "%.0" "CAD BTDC start" COEFFS 0 2 0 0 0 1 /end COMPU_METHOD
/begin CHARACTERISTIC TKNK_dur "Knock Window Duration" MAP 0x001C3590 /* @ECU_Address@TKNK_dur@0x020A4000@ */ ECIPP_ALIGNMENT_SWORD 16384 Compu_TKNK_dur -16384 16383.5
 /begin AXIS_DESCR COM_AXIS NO_INPUT_QUANTITY Compu_TKNK_cal_MAP 4 -128 127.99609375 AXIS_PTS_REF TKNK_cal_MAP /end AXIS_DESCR
 /begin AXIS_DESCR COM_AXIS NO_INPUT_QUANTITY Compu_TKNK_cal_rpm 8 -32768 32767 AXIS_PTS_REF TKNK_cal_rpm /end AXIS_DESCR
/end CHARACTERISTIC
/begin COMPU_METHOD Compu_TKNK_dur "" RAT_FUNC "%.0" "CAD duration" COEFFS 0 2 0 0 0 1 /end COMPU_METHOD
/begin CHARACTERISTIC TKNK_100V "Knock 100% Calibration" MAP 0x001C3538 /* @ECU_Address@TKNK_100V@0x020A5000@ */ ECIPP_ALIGNMENT_SWORD 32 Compu_TKNK_100V -32 31.9990234375
 /begin AXIS_DESCR COM_AXIS NO_INPUT_QUANTITY Compu_TKNK_cal_MAP 4 -128 127.99609375 AXIS_PTS_REF TKNK_cal_MAP /end AXIS_DESCR
 /begin AXIS_DESCR COM_AXIS NO_INPUT_QUANTITY Compu_TKNK_cal_rpm 8 -32768 32767 AXIS_PTS_REF TKNK_cal_rpm /end AXIS_DESCR
/end CHARACTERISTIC
/begin COMPU_METHOD Compu_TKNK_100V "" RAT_FUNC "%.3" "RMS volts" COEFFS 0 1024 0 0 0 1 /end COMPU_METHOD
/begin CHARACTERISTIC TKNK_0V "Knock 0% Calibration" MAP 0x001C34F8 /* @ECU_Address@TKNK_0V@0x020A6000@ */ ECIPP_ALIGNMENT_SWORD 32 Compu_TKNK_0V -32 31.9990234375
 /begin AXIS_DESCR COM_AXIS NO_INPUT_QUANTITY Compu_TKNK_cal_MAP 4 -128 127.99609375 AXIS_PTS_REF TKNK_cal_MAP /end AXIS_DESCR
 /begin AXIS_DESCR COM_AXIS NO_INPUT_QUANTITY Compu_TKNK_cal_rpm 8 -32768 32767 AXIS_PTS_REF TKNK_cal_rpm /end AXIS_DESCR
/end CHARACTERISTIC
/begin COMPU_METHOD Compu_TKNK_0V "" RAT_FUNC "%.3" "RMS volts" COEFFS 0 1024 0 0 0 1 /end COMPU_METHOD
/begin CHARACTERISTIC TKNK_ret_max "Knock Max Retard" MAP 0x001C3710 /* @ECU_Address@TKNK_ret_max@0x020A7000@ */ ECIPP_ALIGNMENT_SWORD 64 Compu_TKNK_ret_max -64 63.998046875
 /begin AXIS_DESCR COM_AXIS NO_INPUT_QUANTITY Compu_TKNK_cal_MAP 4 -128 127.99609375 AXIS_PTS_REF TKNK_cal_MAP /end AXIS_DESCR
 /begin AXIS_DESCR COM_AXIS NO_INPUT_QUANTITY Compu_TKNK_cal_rpm 8 -32768 32767 AXIS_PTS_REF TKNK_cal_rpm /end AXIS_DESCR
/end CHARACTERISTIC
/begin COMPU_METHOD Compu_TKNK_ret_max "" RAT_FUNC "%.1" "CAD retard" COEFFS 0 512 0 0 0 1 /end COMPU_METHOD
/begin CHARACTERISTIC TKNKbg_start "Knock Background Start" MAP 0x001C38D0 /* @ECU_Address@TKNKbg_start@0x020E3000@ */ ECIPP_ALIGNMENT_SWORD 16384 Compu_TKNKbg_start -16384 16383.5
 /begin AXIS_DESCR COM_AXIS NO_INPUT_QUANTITY Compu_TKNK_cal_MAP 4 -128 127.99609375 AXIS_PTS_REF TKNK_cal_MAP /end AXIS_DESCR
 /begin AXIS_DESCR COM_AXIS NO_INPUT_QUANTITY Compu_TKNK_cal_rpm 8 -32768 32767 AXIS_PTS_REF TKNK_cal_rpm /end AXIS_DESCR
/end CHARACTERISTIC
/begin COMPU_METHOD Compu_TKNKbg_start "" RAT_FUNC "%.0" "CAD BTDC start" COEFFS 0 2 0 0 0 1 /end COMPU_METHOD
/begin CHARACTERISTIC TKNKbg_dur "Knock Background Duration" MAP 0x001C3810 /* @ECU_Address@TKNKbg_dur@0x020E4000@ */ ECIPP_ALIGNMENT_SWORD 16384 Compu_TKNKbg_dur -16384 16383.5
 /begin AXIS_DESCR COM_AXIS NO_INPUT_QUANTITY Compu_TKNK_cal_MAP 4 -128 127.99609375 AXIS_PTS_REF TKNK_cal_MAP /end AXIS_DESCR
 /begin AXIS_DESCR COM_AXIS NO_INPUT_QUANTITY Compu_TKNK_cal_rpm 8 -32768 32767 AXIS_PTS_REF TKNK_cal_rpm /end AXIS_DESCR
/end CHARACTERISTIC
/begin COMPU_METHOD Compu_TKNKbg_dur "" RAT_FUNC "%.0" "CAD duration" COEFFS 0 2 0 0 0 1 /end COMPU_METHOD
/begin MEASUREMENT KNKHst_Tbl "Knock Intensity Histogram" ULONG Compu_KNKHst_Tbl 0 0 0 4294967.295 ECU_ADDRESS 0x02239000 MATRIX_DIM 36 1 1 /end MEASUREMENT
/begin COMPU_METHOD Compu_KNKHst_Tbl " " RAT_FUNC "%.1" "Time in Knock (sec)" COEFFS 0 1000 0 0 0 1 /end COMPU_METHOD
/begin MEASUREMENT SPK_IGBT_T "Spk_IGBT_T 0" UWORD Compu_SPK_IGBT_T 0 0 -460 65075 ECU_ADDRESS 0x0233D000 MATRIX_DIM 13 1 1 /end MEASUREMENT
/begin COMPU_METHOD Compu_SPK_IGBT_T " " RAT_FUNC "%.0" "deg F" COEFFS 0 1 460 0 0 1 /end COMPU_METHOD
/begin CHARACTERISTIC TKNK_dur_AltA "Knock Window Duration - Alternate A" MAP 0x001C35D0 /* @ECU_Address@TKNK_dur_AltA@0x023B3000@ */ ECIPP_ALIGNMENT_SWORD 16384 Compu_TKNK_dur_AltA -16384 16383.5
 /begin AXIS_DESCR COM_AXIS NO_INPUT_QUANTITY Compu_TKNK_cal_MAP 4 -128 127.99609375 AXIS_PTS_REF TKNK_cal_MAP /end AXIS_DESCR
 /begin AXIS_DESCR COM_AXIS NO_INPUT_QUANTITY Compu_TKNK_cal_rpm 8 -32768 32767 AXIS_PTS_REF TKNK_cal_rpm /end AXIS_DESCR
/end CHARACTERISTIC
/begin COMPU_METHOD Compu_TKNK_dur_AltA "" RAT_FUNC "%.0" "CAD duration" COEFFS 0 2 0 0 0 1 /end COMPU_METHOD
/begin CHARACTERISTIC TKNK_dur_AltB "Knock Window Duration - Alternate B" MAP 0x001C3610 /* @ECU_Address@TKNK_dur_AltB@0x023B4000@ */ ECIPP_ALIGNMENT_SWORD 16384 Compu_TKNK_dur_AltB -16384 16383.5
 /begin AXIS_DESCR COM_AXIS NO_INPUT_QUANTITY Compu_TKNK_cal_MAP 4 -128 127.99609375 AXIS_PTS_REF TKNK_cal_MAP /end AXIS_DESCR
 /begin AXIS_DESCR COM_AXIS NO_INPUT_QUANTITY Compu_TKNK_cal_rpm 8 -32768 32767 AXIS_PTS_REF TKNK_cal_rpm /end AXIS_DESCR
/end CHARACTERISTIC
/begin COMPU_METHOD Compu_TKNK_dur_AltB "" RAT_FUNC "%.0" "CAD duration" COEFFS 0 2 0 0 0 1 /end COMPU_METHOD
/begin CHARACTERISTIC TKNKbg_dur_AltA "Knock Background Duration - Alternate A" MAP 0x001C3850 /* @ECU_Address@TKNKbg_dur_AltA@0x023B5000@ */ ECIPP_ALIGNMENT_SWORD 16384 Compu_TKNKbg_dur_AltA -16384 16383.5
 /begin AXIS_DESCR COM_AXIS NO_INPUT_QUANTITY Compu_TKNK_cal_MAP 4 -128 127.99609375 AXIS_PTS_REF TKNK_cal_MAP /end AXIS_DESCR
 /begin AXIS_DESCR COM_AXIS NO_INPUT_QUANTITY Compu_TKNK_cal_rpm 8 -32768 32767 AXIS_PTS_REF TKNK_cal_rpm /end AXIS_DESCR
/end CHARACTERISTIC
/begin COMPU_METHOD Compu_TKNKbg_dur_AltA "" RAT_FUNC "%.0" "CAD duration" COEFFS 0 2 0 0 0 1 /end COMPU_METHOD
/begin CHARACTERISTIC TKNKbg_dur_AltB "Knock Background Duration - Alternate B" MAP 0x001C3890 /* @ECU_Address@TKNKbg_dur_AltB@0x023B6000@ */ ECIPP_ALIGNMENT_SWORD 16384 Compu_TKNKbg_dur_AltB -16384 16383.5
 /begin AXIS_DESCR COM_AXIS NO_INPUT_QUANTITY Compu_TKNK_cal_MAP 4 -128 127.99609375 AXIS_PTS_REF TKNK_cal_MAP /end AXIS_DESCR
 /begin AXIS_DESCR COM_AXIS NO_INPUT_QUANTITY Compu_TKNK_cal_rpm 8 -32768 32767 AXIS_PTS_REF TKNK_cal_rpm /end AXIS_DESCR
/end CHARACTERISTIC
/begin COMPU_METHOD Compu_TKNKbg_dur_AltB "" RAT_FUNC "%.0" "CAD duration" COEFFS 0 2 0 0 0 1 /end COMPU_METHOD
/begin CHARACTERISTIC TKNK_start_AltA "Knock Window Start - Alternate A" MAP 0x001C3790 /* @ECU_Address@TKNK_start_AltA@0x023B7000@ */ ECIPP_ALIGNMENT_SWORD 16384 Compu_TKNK_start_AltA -16384 16383.5
 /begin AXIS_DESCR COM_AXIS NO_INPUT_QUANTITY Compu_TKNK_cal_MAP 4 -128 127.99609375 AXIS_PTS_REF TKNK_cal_MAP /end AXIS_DESCR
 /begin AXIS_DESCR COM_AXIS NO_INPUT_QUANTITY Compu_TKNK_cal_rpm 8 -32768 32767 AXIS_PTS_REF TKNK_cal_rpm /end AXIS_DESCR
/end CHARACTERISTIC
/begin COMPU_METHOD Compu_TKNK_start_AltA "" RAT_FUNC "%.0" "CAD BTDC start" COEFFS 0 2 0 0 0 1 /end COMPU_METHOD
/begin CHARACTERISTIC TKNK_start_AltB "Knock Window Start - Alternate B" MAP 0x001C37D0 /* @ECU_Address@TKNK_start_AltB@0x023B8000@ */ ECIPP_ALIGNMENT_SWORD 16384 Compu_TKNK_start_AltB -16384 16383.5
 /begin AXIS_DESCR COM_AXIS NO_INPUT_QUANTITY Compu_TKNK_cal_MAP 4 -128 127.99609375 AXIS_PTS_REF TKNK_cal_MAP /end AXIS_DESCR
 /begin AXIS_DESCR COM_AXIS NO_INPUT_QUANTITY Compu_TKNK_cal_rpm 8 -32768 32767 AXIS_PTS_REF TKNK_cal_rpm /end AXIS_DESCR
/end CHARACTERISTIC
/begin COMPU_METHOD Compu_TKNK_start_AltB "" RAT_FUNC "%.0" "CAD BTDC start" COEFFS 0 2 0 0 0 1 /end COMPU_METHOD
/begin CHARACTERISTIC TKNKbg_start_AltA "Knock Background Start - Alternate A" MAP 0x001C3910 /* @ECU_Address@TKNKbg_start_AltA@0x023B9000@ */ ECIPP_ALIGNMENT_SWORD 16384 Compu_TKNKbg_start_AltA -16384 16383.5
 /begin AXIS_DESCR COM_AXIS NO_INPUT_QUANTITY Compu_TKNK_cal_MAP 4 -128 127.99609375 AXIS_PTS_REF TKNK_cal_MAP /end AXIS_DESCR
 /begin AXIS_DESCR COM_AXIS NO_INPUT_QUANTITY Compu_TKNK_cal_rpm 8 -32768 32767 AXIS_PTS_REF TKNK_cal_rpm /end AXIS_DESCR
/end CHARACTERISTIC
/begin COMPU_METHOD Compu_TKNKbg_start_AltA "" RAT_FUNC "%.0" "CAD BTDC start" COEFFS 0 2 0 0 0 1 /end COMPU_METHOD
/begin CHARACTERISTIC TKNKbg_start_AltB "Knock Background Start - Alternate B" MAP 0x001C3950 /* @ECU_Address@TKNKbg_start_AltB@0x023BA000@ */ ECIPP_ALIGNMENT_SWORD 16384 Compu_TKNKbg_start_AltB -16384 16383.5
 /begin AXIS_DESCR COM_AXIS NO_INPUT_QUANTITY Compu_TKNK_cal_MAP 4 -128 127.99609375 AXIS_PTS_REF TKNK_cal_MAP /end AXIS_DESCR
 /begin AXIS_DESCR COM_AXIS NO_INPUT_QUANTITY Compu_TKNK_cal_rpm 8 -32768 32767 AXIS_PTS_REF TKNK_cal_rpm /end AXIS_DESCR
/end CHARACTERISTIC
/begin COMPU_METHOD Compu_TKNKbg_start_AltB "" RAT_FUNC "%.0" "CAD BTDC start" COEFFS 0 2 0 0 0 1 /end COMPU_METHOD
/begin CHARACTERISTIC TKNK_mult_AltA "Knock Signal Multiplier - Alternate A" MAP 0x001C3690 /* @ECU_Address@TKNK_mult_AltA@0x023BB000@ */ ECIPP_ALIGNMENT_SWORD 16 Compu_TKNK_mult_AltA -16 15.99951171875
 /begin AXIS_DESCR COM_AXIS NO_INPUT_QUANTITY Compu_TKNK_cal_MAP 4 -128 127.99609375 AXIS_PTS_REF TKNK_cal_MAP /end AXIS_DESCR
 /begin AXIS_DESCR COM_AXIS NO_INPUT_QUANTITY Compu_TKNK_cal_rpm 8 -32768 32767 AXIS_PTS_REF TKNK_cal_rpm /end AXIS_DESCR
/end CHARACTERISTIC
/begin COMPU_METHOD Compu_TKNK_mult_AltA "" RAT_FUNC "%.2" "Signal Multiplier" COEFFS 0 2048 0 0 0 1 /end COMPU_METHOD
/begin CHARACTERISTIC TKNK_mult_AltB "Knock Signal Multiplier - Alternate B" MAP 0x001C36D0 /* @ECU_Address@TKNK_mult_AltB@0x023BC000@ */ ECIPP_ALIGNMENT_SWORD 16 Compu_TKNK_mult_AltB -16 15.99951171875
 /begin AXIS_DESCR COM_AXIS NO_INPUT_QUANTITY Compu_TKNK_cal_MAP 4 -128 127.99609375 AXIS_PTS_REF TKNK_cal_MAP /end AXIS_DESCR
 /begin AXIS_DESCR COM_AXIS NO_INPUT_QUANTITY Compu_TKNK_cal_rpm 8 -32768 32767 AXIS_PTS_REF TKNK_cal_rpm /end AXIS_DESCR
/end CHARACTERISTIC
/begin COMPU_METHOD Compu_TKNK_mult_AltB "" RAT_FUNC "%.2" "Signal Multiplier" COEFFS 0 2048 0 0 0 1 /end COMPU_METHOD
/begin CHARACTERISTIC TKNK_mult "Knock Signal Multiplier" MAP 0x001C3650 /* @ECU_Address@TKNK_mult@0x023BD000@ */ ECIPP_ALIGNMENT_SWORD 16 Compu_TKNK_mult -16 15.99951171875
 /begin AXIS_DESCR COM_AXIS NO_INPUT_QUANTITY Compu_TKNK_cal_MAP 4 -128 127.99609375 AXIS_PTS_REF TKNK_cal_MAP /end AXIS_DESCR
 /begin AXIS_DESCR COM_AXIS NO_INPUT_QUANTITY Compu_TKNK_cal_rpm 8 -32768 32767 AXIS_PTS_REF TKNK_cal_rpm /end AXIS_DESCR
/end CHARACTERISTIC
/begin COMPU_METHOD Compu_TKNK_mult "" RAT_FUNC "%.2" "Signal Multiplier" COEFFS 0 2048 0 0 0 1 /end COMPU_METHOD
/begin MEASUREMENT ECTHst_Tbl "ECT Histogram" ULONG Compu_ECTHst_Tbl 0 0 0 1193.04647083333 ECU_ADDRESS 0x023BE000 MATRIX_DIM 8 1 1 /end MEASUREMENT
/begin COMPU_METHOD Compu_ECTHst_Tbl " " RAT_FUNC "%.3" "Time (hours)" COEFFS 0 3600000 0 0 0 1 /end COMPU_METHOD
/begin CHARACTERISTIC STR_RM_AUX_PU1 "AUX PU1" ASCII 0x001E7E34 /* @ECU_Address@STR_RM_AUX_PU1@0x023DB000@ */ ECIPP_ALIGNMENT_UBYTE 255 Compu_ECIPP_STRINGS 0 255 MATRIX_DIM 29 1 1 /end CHARACTERISTIC
/begin CHARACTERISTIC STR_RM_AUX_PU2 "AUX PU2" ASCII 0x001E7E52 /* @ECU_Address@STR_RM_AUX_PU2@0x023DC000@ */ ECIPP_ALIGNMENT_UBYTE 255 Compu_ECIPP_STRINGS 0 255 MATRIX_DIM 29 1 1 /end CHARACTERISTIC
/begin CHARACTERISTIC STR_RM_AUX_PU3 "AUX PU3" ASCII 0x001E7E70 /* @ECU_Address@STR_RM_AUX_PU3@0x023DD000@ */ ECIPP_ALIGNMENT_UBYTE 255 Compu_ECIPP_STRINGS 0 255 MATRIX_DIM 29 1 1 /end CHARACTERISTIC
/begin CHARACTERISTIC STR_RM_AUX_PD1 "AUX PD1" ASCII 0x001E7DDA /* @ECU_Address@STR_RM_AUX_PD1@0x023DE000@ */ ECIPP_ALIGNMENT_UBYTE 255 Compu_ECIPP_STRINGS 0 255 MATRIX_DIM 29 1 1 /end CHARACTERISTIC
/begin CHARACTERISTIC STR_RM_AUX_PD2 "AUX PD2" ASCII 0x001E7DF8 /* @ECU_Address@STR_RM_AUX_PD2@0x023DF000@ */ ECIPP_ALIGNMENT_UBYTE 255 Compu_ECIPP_STRINGS 0 255 MATRIX_DIM 29 1 1 /end CHARACTERISTIC
/begin CHARACTERISTIC STR_RM_AUX_PD3 "AUX PD3" ASCII 0x001E7E16 /* @ECU_Address@STR_RM_AUX_PD3@0x023E0000@ */ ECIPP_ALIGNMENT_UBYTE 255 Compu_ECIPP_STRINGS 0 255 MATRIX_DIM 29 1 1 /end CHARACTERISTIC
/begin CHARACTERISTIC STR_RM_AUX_PUD1 "AUX PUD1" ASCII 0x001E7E8E /* @ECU_Address@STR_RM_AUX_PUD1@0x023E1000@ */ ECIPP_ALIGNMENT_UBYTE 255 Compu_ECIPP_STRINGS 0 255 MATRIX_DIM 29 1 1 /end CHARACTERISTIC
/begin CHARACTERISTIC STR_RM_AUX_PUD2 "AUX PUD2" ASCII 0x001E7FD8 /* @ECU_Address@STR_RM_AUX_PUD2@0x023E2000@ */ ECIPP_ALIGNMENT_UBYTE 255 Compu_ECIPP_STRINGS 0 255 MATRIX_DIM 29 1 1 /end CHARACTERISTIC
/begin CHARACTERISTIC STR_RM_AUX_PUD3 "AUX PUD3" ASCII 0x001E80AA /* @ECU_Address@STR_RM_AUX_PUD3@0x023E3000@ */ ECIPP_ALIGNMENT_UBYTE 255 Compu_ECIPP_STRINGS 0 255 MATRIX_DIM 29 1 1 /end CHARACTERISTIC
/begin CHARACTERISTIC STR_RM_AUX_PUD4 "AUX PUD4" ASCII 0x001E80C8 /* @ECU_Address@STR_RM_AUX_PUD4@0x023E4000@ */ ECIPP_ALIGNMENT_UBYTE 255 Compu_ECIPP_STRINGS 0 255 MATRIX_DIM 29 1 1 /end CHARACTERISTIC
/begin CHARACTERISTIC STR_RM_AUX_PUD5 "AUX PUD5" ASCII 0x001E80E6 /* @ECU_Address@STR_RM_AUX_PUD5@0x023E5000@ */ ECIPP_ALIGNMENT_UBYTE 255 Compu_ECIPP_STRINGS 0 255 MATRIX_DIM 29 1 1 /end CHARACTERISTIC
/begin CHARACTERISTIC STR_RM_AUX_PUD6 "AUX PUD6" ASCII 0x001E8104 /* @ECU_Address@STR_RM_AUX_PUD6@0x023E6000@ */ ECIPP_ALIGNMENT_UBYTE 255 Compu_ECIPP_STRINGS 0 255 MATRIX_DIM 29 1 1 /end CHARACTERISTIC
/begin CHARACTERISTIC STR_RM_AUX_PUD7 "AUX PUD7" ASCII 0x001E8122 /* @ECU_Address@STR_RM_AUX_PUD7@0x023E7000@ */ ECIPP_ALIGNMENT_UBYTE 255 Compu_ECIPP_STRINGS 0 255 MATRIX_DIM 29 1 1 /end CHARACTERISTIC
/begin CHARACTERISTIC STR_RM_AUX_PUD8 "AUX PUD8" ASCII 0x001E8140 /* @ECU_Address@STR_RM_AUX_PUD8@0x023E8000@ */ ECIPP_ALIGNMENT_UBYTE 255 Compu_ECIPP_STRINGS 0 255 MATRIX_DIM 29 1 1 /end CHARACTERISTIC
/begin CHARACTERISTIC STR_RM_AUX_PUD9 "AUX PUD9" ASCII 0x001E815E /* @ECU_Address@STR_RM_AUX_PUD9@0x023E9000@ */ ECIPP_ALIGNMENT_UBYTE 255 Compu_ECIPP_STRINGS 0 255 MATRIX_DIM 29 1 1 /end CHARACTERISTIC
/begin CHARACTERISTIC STR_RM_AUX_PUD10 "AUX PUD10" ASCII 0x001E7EAC /* @ECU_Address@STR_RM_AUX_PUD10@0x023EA000@ */ ECIPP_ALIGNMENT_UBYTE 255 Compu_ECIPP_STRINGS 0 255 MATRIX_DIM 29 1 1 /end CHARACTERISTIC
/begin CHARACTERISTIC STR_RM_AUX_PUD11 "AUX PUD11" ASCII 0x001E7ECA /* @ECU_Address@STR_RM_AUX_PUD11@0x023EB000@ */ ECIPP_ALIGNMENT_UBYTE 255 Compu_ECIPP_STRINGS 0 255 MATRIX_DIM 29 1 1 /end CHARACTERISTIC
/begin CHARACTERISTIC STR_RM_AUX_PUD12 "AUX PUD12" ASCII 0x001E7EE8 /* @ECU_Address@STR_RM_AUX_PUD12@0x023EC000@ */ ECIPP_ALIGNMENT_UBYTE 255 Compu_ECIPP_STRINGS 0 255 MATRIX_DIM 29 1 1 /end CHARACTERISTIC
/begin CHARACTERISTIC STR_RM_AUX_PUD13 "AUX PUD13" ASCII 0x001E7F06 /* @ECU_Address@STR_RM_AUX_PUD13@0x023ED000@ */ ECIPP_ALIGNMENT_UBYTE 255 Compu_ECIPP_STRINGS 0 255 MATRIX_DIM 29 1 1 /end CHARACTERISTIC
/begin CHARACTERISTIC STR_RM_AUX_PUD14 "AUX PUD14" ASCII 0x001E7F24 /* @ECU_Address@STR_RM_AUX_PUD14@0x023EE000@ */ ECIPP_ALIGNMENT_UBYTE 255 Compu_ECIPP_STRINGS 0 255 MATRIX_DIM 29 1 1 /end CHARACTERISTIC
/begin CHARACTERISTIC STR_RM_AUX_PUD15 "AUX PUD15" ASCII 0x001E7F42 /* @ECU_Address@STR_RM_AUX_PUD15@0x023EF000@ */ ECIPP_ALIGNMENT_UBYTE 255 Compu_ECIPP_STRINGS 0 255 MATRIX_DIM 29 1 1 /end CHARACTERISTIC
/begin CHARACTERISTIC STR_RM_AUX_PUD16 "AUX PUD16" ASCII 0x001E7F60 /* @ECU_Address@STR_RM_AUX_PUD16@0x023F0000@ */ ECIPP_ALIGNMENT_UBYTE 255 Compu_ECIPP_STRINGS 0 255 MATRIX_DIM 29 1 1 /end CHARACTERISTIC
/begin CHARACTERISTIC STR_RM_AUX_PUD17 "AUX PUD17" ASCII 0x001E7F7E /* @ECU_Address@STR_RM_AUX_PUD17@0x023F1000@ */ ECIPP_ALIGNMENT_UBYTE 255 Compu_ECIPP_STRINGS 0 255 MATRIX_DIM 29 1 1 /end CHARACTERISTIC
/begin CHARACTERISTIC STR_RM_AUX_PUD18 "AUX PUD18" ASCII 0x001E7F9C /* @ECU_Address@STR_RM_AUX_PUD18@0x023F2000@ */ ECIPP_ALIGNMENT_UBYTE 255 Compu_ECIPP_STRINGS 0 255 MATRIX_DIM 29 1 1 /end CHARACTERISTIC
/begin CHARACTERISTIC STR_RM_AUX_PUD19 "AUX PUD19" ASCII 0x001E7FBA /* @ECU_Address@STR_RM_AUX_PUD19@0x023F3000@ */ ECIPP_ALIGNMENT_UBYTE 255 Compu_ECIPP_STRINGS 0 255 MATRIX_DIM 29 1 1 /end CHARACTERISTIC
/begin CHARACTERISTIC STR_RM_AUX_PUD20 "AUX PUD20" ASCII 0x001E7FF6 /* @ECU_Address@STR_RM_AUX_PUD20@0x023F4000@ */ ECIPP_ALIGNMENT_UBYTE 255 Compu_ECIPP_STRINGS 0 255 MATRIX_DIM 29 1 1 /end CHARACTERISTIC
/begin CHARACTERISTIC STR_RM_AUX_PUD21 "AUX PUD21" ASCII 0x001E8014 /* @ECU_Address@STR_RM_AUX_PUD21@0x023F5000@ */ ECIPP_ALIGNMENT_UBYTE 255 Compu_ECIPP_STRINGS 0 255 MATRIX_DIM 29 1 1 /end CHARACTERISTIC
/begin CHARACTERISTIC STR_RM_AUX_PUD22 "AUX PUD22" ASCII 0x001E8032 /* @ECU_Address@STR_RM_AUX_PUD22@0x023F6000@ */ ECIPP_ALIGNMENT_UBYTE 255 Compu_ECIPP_STRINGS 0 255 MATRIX_DIM 29 1 1 /end CHARACTERISTIC
/begin CHARACTERISTIC STR_RM_AUX_PUD23 "AUX PUD23" ASCII 0x001E8050 /* @ECU_Address@STR_RM_AUX_PUD23@0x023F7000@ */ ECIPP_ALIGNMENT_UBYTE 255 Compu_ECIPP_STRINGS 0 255 MATRIX_DIM 29 1 1 /end CHARACTERISTIC
/begin CHARACTERISTIC STR_RM_AUX_PUD24 "AUX PUD24" ASCII 0x001E806E /* @ECU_Address@STR_RM_AUX_PUD24@0x023F8000@ */ ECIPP_ALIGNMENT_UBYTE 255 Compu_ECIPP_STRINGS 0 255 MATRIX_DIM 29 1 1 /end CHARACTERISTIC
/begin CHARACTERISTIC STR_RM_AUX_PUD25 "AUX PUD25" ASCII 0x001E808C /* @ECU_Address@STR_RM_AUX_PUD25@0x023F9000@ */ ECIPP_ALIGNMENT_UBYTE 255 Compu_ECIPP_STRINGS 0 255 MATRIX_DIM 29 1 1 /end CHARACTERISTIC
/begin CHARACTERISTIC STR_RM_AUX_DIG1 "AUX DIG1" ASCII 0x001E7AEC /* @ECU_Address@STR_RM_AUX_DIG1@0x023FA000@ */ ECIPP_ALIGNMENT_UBYTE 255 Compu_ECIPP_STRINGS 0 255 MATRIX_DIM 29 1 1 /end CHARACTERISTIC
/begin CHARACTERISTIC STR_RM_AUX_DIG2 "AUX DIG2" ASCII 0x001E7C36 /* @ECU_Address@STR_RM_AUX_DIG2@0x023FB000@ */ ECIPP_ALIGNMENT_UBYTE 255 Compu_ECIPP_STRINGS 0 255 MATRIX_DIM 29 1 1 /end CHARACTERISTIC
/begin CHARACTERISTIC STR_RM_AUX_DIG3 "AUX DIG3" ASCII 0x001E7D08 /* @ECU_Address@STR_RM_AUX_DIG3@0x023FC000@ */ ECIPP_ALIGNMENT_UBYTE 255 Compu_ECIPP_STRINGS 0 255 MATRIX_DIM 29 1 1 /end CHARACTERISTIC
/begin CHARACTERISTIC STR_RM_AUX_DIG4 "AUX DIG4" ASCII 0x001E7D26 /* @ECU_Address@STR_RM_AUX_DIG4@0x023FD000@ */ ECIPP_ALIGNMENT_UBYTE 255 Compu_ECIPP_STRINGS 0 255 MATRIX_DIM 29 1 1 /end CHARACTERISTIC
/begin CHARACTERISTIC STR_RM_AUX_DIG5 "AUX DIG5" ASCII 0x001E7D44 /* @ECU_Address@STR_RM_AUX_DIG5@0x023FE000@ */ ECIPP_ALIGNMENT_UBYTE 255 Compu_ECIPP_STRINGS 0 255 MATRIX_DIM 29 1 1 /end CHARACTERISTIC
/begin CHARACTERISTIC STR_RM_AUX_DIG6 "AUX DIG6" ASCII 0x001E7D62 /* @ECU_Address@STR_RM_AUX_DIG6@0x023FF000@ */ ECIPP_ALIGNMENT_UBYTE 255 Compu_ECIPP_STRINGS 0 255 MATRIX_DIM 29 1 1 /end CHARACTERISTIC
/begin CHARACTERISTIC STR_RM_AUX_DIG7 "AUX DIG7" ASCII 0x001E7D80 /* @ECU_Address@STR_RM_AUX_DIG7@0x02400000@ */ ECIPP_ALIGNMENT_UBYTE 255 Compu_ECIPP_STRINGS 0 255 MATRIX_DIM 29 1 1 /end CHARACTERISTIC
/begin CHARACTERISTIC STR_RM_AUX_DIG8 "AUX DIG8" ASCII 0x001E7D9E /* @ECU_Address@STR_RM_AUX_DIG8@0x02401000@ */ ECIPP_ALIGNMENT_UBYTE 255 Compu_ECIPP_STRINGS 0 255 MATRIX_DIM 29 1 1 /end CHARACTERISTIC
/begin CHARACTERISTIC STR_RM_AUX_DIG9 "AUX DIG9" ASCII 0x001E7DBC /* @ECU_Address@STR_RM_AUX_DIG9@0x02402000@ */ ECIPP_ALIGNMENT_UBYTE 255 Compu_ECIPP_STRINGS 0 255 MATRIX_DIM 29 1 1 /end CHARACTERISTIC
/begin CHARACTERISTIC STR_RM_AUX_DIG10 "AUX DIG10" ASCII 0x001E7B0A /* @ECU_Address@STR_RM_AUX_DIG10@0x02403000@ */ ECIPP_ALIGNMENT_UBYTE 255 Compu_ECIPP_STRINGS 0 255 MATRIX_DIM 29 1 1 /end CHARACTERISTIC
/begin CHARACTERISTIC STR_RM_AUX_DIG11 "AUX DIG11" ASCII 0x001E7B28 /* @ECU_Address@STR_RM_AUX_DIG11@0x02404000@ */ ECIPP_ALIGNMENT_UBYTE 255 Compu_ECIPP_STRINGS 0 255 MATRIX_DIM 29 1 1 /end CHARACTERISTIC
/begin CHARACTERISTIC STR_RM_AUX_DIG12 "AUX DIG12" ASCII 0x001E7B46 /* @ECU_Address@STR_RM_AUX_DIG12@0x02405000@ */ ECIPP_ALIGNMENT_UBYTE 255 Compu_ECIPP_STRINGS 0 255 MATRIX_DIM 29 1 1 /end CHARACTERISTIC
/begin CHARACTERISTIC STR_RM_AUX_DIG13 "AUX DIG13" ASCII 0x001E7B64 /* @ECU_Address@STR_RM_AUX_DIG13@0x02406000@ */ ECIPP_ALIGNMENT_UBYTE 255 Compu_ECIPP_STRINGS 0 255 MATRIX_DIM 29 1 1 /end CHARACTERISTIC
/begin CHARACTERISTIC STR_RM_AUX_DIG14 "AUX DIG14" ASCII 0x001E7B82 /* @ECU_Address@STR_RM_AUX_DIG14@0x02407000@ */ ECIPP_ALIGNMENT_UBYTE 255 Compu_ECIPP_STRINGS 0 255 MATRIX_DIM 29 1 1 /end CHARACTERISTIC
/begin CHARACTERISTIC STR_RM_AUX_DIG15 "AUX DIG15" ASCII 0x001E7BA0 /* @ECU_Address@STR_RM_AUX_DIG15@0x02408000@ */ ECIPP_ALIGNMENT_UBYTE 255 Compu_ECIPP_STRINGS 0 255 MATRIX_DIM 29 1 1 /end CHARACTERISTIC
/begin CHARACTERISTIC STR_RM_AUX_DIG16 "AUX DIG16" ASCII 0x001E7BBE /* @ECU_Address@STR_RM_AUX_DIG16@0x02409000@ */ ECIPP_ALIGNMENT_UBYTE 255 Compu_ECIPP_STRINGS 0 255 MATRIX_DIM 29 1 1 /end CHARACTERISTIC
/begin CHARACTERISTIC STR_RM_AUX_DIG17 "AUX DIG17" ASCII 0x001E7BDC /* @ECU_Address@STR_RM_AUX_DIG17@0x0240A000@ */ ECIPP_ALIGNMENT_UBYTE 255 Compu_ECIPP_STRINGS 0 255 MATRIX_DIM 29 1 1 /end CHARACTERISTIC
/begin CHARACTERISTIC STR_RM_AUX_DIG18 "AUX DIG18" ASCII 0x001E7BFA /* @ECU_Address@STR_RM_AUX_DIG18@0x0240B000@ */ ECIPP_ALIGNMENT_UBYTE 255 Compu_ECIPP_STRINGS 0 255 MATRIX_DIM 29 1 1 /end CHARACTERISTIC
/begin CHARACTERISTIC STR_RM_AUX_DIG19 "AUX DIG19" ASCII 0x001E7C18 /* @ECU_Address@STR_RM_AUX_DIG19@0x0240C000@ */ ECIPP_ALIGNMENT_UBYTE 255 Compu_ECIPP_STRINGS 0 255 MATRIX_DIM 29 1 1 /end CHARACTERISTIC
/begin CHARACTERISTIC STR_RM_AUX_DIG20 "AUX DIG20" ASCII 0x001E7C54 /* @ECU_Address@STR_RM_AUX_DIG20@0x0240D000@ */ ECIPP_ALIGNMENT_UBYTE 255 Compu_ECIPP_STRINGS 0 255 MATRIX_DIM 29 1 1 /end CHARACTERISTIC
/begin CHARACTERISTIC STR_RM_AUX_DIG21 "AUX DIG21" ASCII 0x001E7C72 /* @ECU_Address@STR_RM_AUX_DIG21@0x0240E000@ */ ECIPP_ALIGNMENT_UBYTE 255 Compu_ECIPP_STRINGS 0 255 MATRIX_DIM 29 1 1 /end CHARACTERISTIC
/begin CHARACTERISTIC STR_RM_AUX_DIG22 "AUX DIG22" ASCII 0x001E7C90 /* @ECU_Address@STR_RM_AUX_DIG22@0x0240F000@ */ ECIPP_ALIGNMENT_UBYTE 255 Compu_ECIPP_STRINGS 0 255 MATRIX_DIM 29 1 1 /end CHARACTERISTIC
/begin CHARACTERISTIC STR_RM_AUX_DIG23 "AUX DIG23" ASCII 0x001E7CAE /* @ECU_Address@STR_RM_AUX_DIG23@0x02410000@ */ ECIPP_ALIGNMENT_UBYTE 255 Compu_ECIPP_STRINGS 0 255 MATRIX_DIM 29 1 1 /end CHARACTERISTIC
/begin CHARACTERISTIC STR_RM_AUX_DIG24 "AUX DIG24" ASCII 0x001E7CCC /* @ECU_Address@STR_RM_AUX_DIG24@0x02411000@ */ ECIPP_ALIGNMENT_UBYTE 255 Compu_ECIPP_STRINGS 0 255 MATRIX_DIM 29 1 1 /end CHARACTERISTIC
/begin CHARACTERISTIC STR_RM_AUX_DIG25 "AUX DIG25" ASCII 0x001E7CEA /* @ECU_Address@STR_RM_AUX_DIG25@0x02412000@ */ ECIPP_ALIGNMENT_UBYTE 255 Compu_ECIPP_STRINGS 0 255 MATRIX_DIM 29 1 1 /end CHARACTERISTIC
/begin CHARACTERISTIC STR_RM_AUX_PWM1 "AUX PWM1" ASCII 0x001E817C /* @ECU_Address@STR_RM_AUX_PWM1@0x02413000@ */ ECIPP_ALIGNMENT_UBYTE 255 Compu_ECIPP_STRINGS 0 255 MATRIX_DIM 29 1 1 /end CHARACTERISTIC
/begin CHARACTERISTIC STR_RM_AUX_PWM2 "AUX PWM2" ASCII 0x001E82C6 /* @ECU_Address@STR_RM_AUX_PWM2@0x02414000@ */ ECIPP_ALIGNMENT_UBYTE 255 Compu_ECIPP_STRINGS 0 255 MATRIX_DIM 29 1 1 /end CHARACTERISTIC
/begin CHARACTERISTIC STR_RM_AUX_PWM3 "AUX PWM3" ASCII 0x001E8398 /* @ECU_Address@STR_RM_AUX_PWM3@0x02415000@ */ ECIPP_ALIGNMENT_UBYTE 255 Compu_ECIPP_STRINGS 0 255 MATRIX_DIM 29 1 1 /end CHARACTERISTIC
/begin CHARACTERISTIC STR_RM_AUX_PWM4 "AUX PWM4" ASCII 0x001E83B6 /* @ECU_Address@STR_RM_AUX_PWM4@0x02416000@ */ ECIPP_ALIGNMENT_UBYTE 255 Compu_ECIPP_STRINGS 0 255 MATRIX_DIM 29 1 1 /end CHARACTERISTIC
/begin CHARACTERISTIC STR_RM_AUX_PWM5 "AUX PWM5" ASCII 0x001E83D4 /* @ECU_Address@STR_RM_AUX_PWM5@0x02417000@ */ ECIPP_ALIGNMENT_UBYTE 255 Compu_ECIPP_STRINGS 0 255 MATRIX_DIM 29 1 1 /end CHARACTERISTIC
/begin CHARACTERISTIC STR_RM_AUX_PWM6 "AUX PWM6" ASCII 0x001E83F2 /* @ECU_Address@STR_RM_AUX_PWM6@0x02418000@ */ ECIPP_ALIGNMENT_UBYTE 255 Compu_ECIPP_STRINGS 0 255 MATRIX_DIM 29 1 1 /end CHARACTERISTIC
/begin CHARACTERISTIC STR_RM_AUX_PWM7 "AUX PWM7" ASCII 0x001E8410 /* @ECU_Address@STR_RM_AUX_PWM7@0x02419000@ */ ECIPP_ALIGNMENT_UBYTE 255 Compu_ECIPP_STRINGS 0 255 MATRIX_DIM 29 1 1 /end CHARACTERISTIC
/begin CHARACTERISTIC STR_RM_AUX_PWM8 "AUX PWM8" ASCII 0x001E842E /* @ECU_Address@STR_RM_AUX_PWM8@0x0241A000@ */ ECIPP_ALIGNMENT_UBYTE 255 Compu_ECIPP_STRINGS 0 255 MATRIX_DIM 29 1 1 /end CHARACTERISTIC
/begin CHARACTERISTIC STR_RM_AUX_PWM9 "AUX PWM9" ASCII 0x001E844C /* @ECU_Address@STR_RM_AUX_PWM9@0x0241B000@ */ ECIPP_ALIGNMENT_UBYTE 255 Compu_ECIPP_STRINGS 0 255 MATRIX_DIM 29 1 1 /end CHARACTERISTIC
/begin CHARACTERISTIC STR_RM_AUX_PWM10 "AUX PWM10" ASCII 0x001E819A /* @ECU_Address@STR_RM_AUX_PWM10@0x0241C000@ */ ECIPP_ALIGNMENT_UBYTE 255 Compu_ECIPP_STRINGS 0 255 MATRIX_DIM 29 1 1 /end CHARACTERISTIC
/begin CHARACTERISTIC STR_RM_AUX_PWM11 "AUX PWM11" ASCII 0x001E81B8 /* @ECU_Address@STR_RM_AUX_PWM11@0x0241D000@ */ ECIPP_ALIGNMENT_UBYTE 255 Compu_ECIPP_STRINGS 0 255 MATRIX_DIM 29 1 1 /end CHARACTERISTIC
/begin CHARACTERISTIC STR_RM_AUX_PWM12 "AUX PWM12" ASCII 0x001E81D6 /* @ECU_Address@STR_RM_AUX_PWM12@0x0241E000@ */ ECIPP_ALIGNMENT_UBYTE 255 Compu_ECIPP_STRINGS 0 255 MATRIX_DIM 29 1 1 /end CHARACTERISTIC
/begin CHARACTERISTIC STR_RM_AUX_PWM13 "AUX PWM13" ASCII 0x001E81F4 /* @ECU_Address@STR_RM_AUX_PWM13@0x0241F000@ */ ECIPP_ALIGNMENT_UBYTE 255 Compu_ECIPP_STRINGS 0 255 MATRIX_DIM 29 1 1 /end CHARACTERISTIC
/begin CHARACTERISTIC STR_RM_AUX_PWM14 "AUX PWM14" ASCII 0x001E8212 /* @ECU_Address@STR_RM_AUX_PWM14@0x02420000@ */ ECIPP_ALIGNMENT_UBYTE 255 Compu_ECIPP_STRINGS 0 255 MATRIX_DIM 29 1 1 /end CHARACTERISTIC
/begin CHARACTERISTIC STR_RM_AUX_PWM15 "AUX PWM15" ASCII 0x001E8230 /* @ECU_Address@STR_RM_AUX_PWM15@0x02421000@ */ ECIPP_ALIGNMENT_UBYTE 255 Compu_ECIPP_STRINGS 0 255 MATRIX_DIM 29 1 1 /end CHARACTERISTIC
/begin CHARACTERISTIC STR_RM_AUX_PWM16 "AUX PWM16" ASCII 0x001E824E /* @ECU_Address@STR_RM_AUX_PWM16@0x02422000@ */ ECIPP_ALIGNMENT_UBYTE 255 Compu_ECIPP_STRINGS 0 255 MATRIX_DIM 29 1 1 /end CHARACTERISTIC
/begin CHARACTERISTIC STR_RM_AUX_PWM17 "AUX PWM17" ASCII 0x001E826C /* @ECU_Address@STR_RM_AUX_PWM17@0x02423000@ */ ECIPP_ALIGNMENT_UBYTE 255 Compu_ECIPP_STRINGS 0 255 MATRIX_DIM 29 1 1 /end CHARACTERISTIC
/begin CHARACTERISTIC STR_RM_AUX_PWM18 "AUX PWM18" ASCII 0x001E828A /* @ECU_Address@STR_RM_AUX_PWM18@0x02424000@ */ ECIPP_ALIGNMENT_UBYTE 255 Compu_ECIPP_STRINGS 0 255 MATRIX_DIM 29 1 1 /end CHARACTERISTIC
/begin CHARACTERISTIC STR_RM_AUX_PWM19 "AUX PWM19" ASCII 0x001E82A8 /* @ECU_Address@STR_RM_AUX_PWM19@0x02425000@ */ ECIPP_ALIGNMENT_UBYTE 255 Compu_ECIPP_STRINGS 0 255 MATRIX_DIM 29 1 1 /end CHARACTERISTIC
/begin CHARACTERISTIC STR_RM_AUX_PWM20 "AUX PWM20" ASCII 0x001E82E4 /* @ECU_Address@STR_RM_AUX_PWM20@0x02426000@ */ ECIPP_ALIGNMENT_UBYTE 255 Compu_ECIPP_STRINGS 0 255 MATRIX_DIM 29 1 1 /end CHARACTERISTIC
/begin CHARACTERISTIC STR_RM_AUX_PWM21 "AUX PWM21" ASCII 0x001E8302 /* @ECU_Address@STR_RM_AUX_PWM21@0x02427000@ */ ECIPP_ALIGNMENT_UBYTE 255 Compu_ECIPP_STRINGS 0 255 MATRIX_DIM 29 1 1 /end CHARACTERISTIC
/begin CHARACTERISTIC STR_RM_AUX_PWM22 "AUX PWM22" ASCII 0x001E8320 /* @ECU_Address@STR_RM_AUX_PWM22@0x02428000@ */ ECIPP_ALIGNMENT_UBYTE 255 Compu_ECIPP_STRINGS 0 255 MATRIX_DIM 29 1 1 /end CHARACTERISTIC
/begin CHARACTERISTIC STR_RM_AUX_PWM23 "AUX PWM23" ASCII 0x001E833E /* @ECU_Address@STR_RM_AUX_PWM23@0x02429000@ */ ECIPP_ALIGNMENT_UBYTE 255 Compu_ECIPP_STRINGS 0 255 MATRIX_DIM 29 1 1 /end CHARACTERISTIC
/begin CHARACTERISTIC STR_RM_AUX_PWM24 "AUX PWM24" ASCII 0x001E835C /* @ECU_Address@STR_RM_AUX_PWM24@0x0242A000@ */ ECIPP_ALIGNMENT_UBYTE 255 Compu_ECIPP_STRINGS 0 255 MATRIX_DIM 29 1 1 /end CHARACTERISTIC
/begin CHARACTERISTIC STR_RM_AUX_PWM25 "AUX PWM25" ASCII 0x001E837A /* @ECU_Address@STR_RM_AUX_PWM25@0x0242B000@ */ ECIPP_ALIGNMENT_UBYTE 255 Compu_ECIPP_STRINGS 0 255 MATRIX_DIM 29 1 1 /end CHARACTERISTIC
/begin CHARACTERISTIC STR_RW_AUX_PU1 "AUX PU1" ASCII 0x001E8E9C /* @ECU_Address@STR_RW_AUX_PU1@0x0242C000@ */ ECIPP_ALIGNMENT_UBYTE 255 Compu_ECIPP_STRINGS 0 255 MATRIX_DIM 29 1 1 /end CHARACTERISTIC
/begin CHARACTERISTIC STR_RW_AUX_PU2 "AUX PU2" ASCII 0x001E8EBA /* @ECU_Address@STR_RW_AUX_PU2@0x0242D000@ */ ECIPP_ALIGNMENT_UBYTE 255 Compu_ECIPP_STRINGS 0 255 MATRIX_DIM 29 1 1 /end CHARACTERISTIC
/begin CHARACTERISTIC STR_RW_AUX_PU3 "AUX PU3" ASCII 0x001E8ED8 /* @ECU_Address@STR_RW_AUX_PU3@0x0242E000@ */ ECIPP_ALIGNMENT_UBYTE 255 Compu_ECIPP_STRINGS 0 255 MATRIX_DIM 29 1 1 /end CHARACTERISTIC
/begin CHARACTERISTIC STR_RW_AUX_PD1 "AUX PD1" ASCII 0x001E8E42 /* @ECU_Address@STR_RW_AUX_PD1@0x0242F000@ */ ECIPP_ALIGNMENT_UBYTE 255 Compu_ECIPP_STRINGS 0 255 MATRIX_DIM 29 1 1 /end CHARACTERISTIC
/begin CHARACTERISTIC STR_RW_AUX_PD2 "AUX PD2" ASCII 0x001E8E60 /* @ECU_Address@STR_RW_AUX_PD2@0x02430000@ */ ECIPP_ALIGNMENT_UBYTE 255 Compu_ECIPP_STRINGS 0 255 MATRIX_DIM 29 1 1 /end CHARACTERISTIC
/begin CHARACTERISTIC STR_RW_AUX_PD3 "AUX PD3" ASCII 0x001E8E7E /* @ECU_Address@STR_RW_AUX_PD3@0x02431000@ */ ECIPP_ALIGNMENT_UBYTE 255 Compu_ECIPP_STRINGS 0 255 MATRIX_DIM 29 1 1 /end CHARACTERISTIC
/begin CHARACTERISTIC STR_RW_AUX_PUD1 "AUX PUD1" ASCII 0x001E8EF6 /* @ECU_Address@STR_RW_AUX_PUD1@0x02432000@ */ ECIPP_ALIGNMENT_UBYTE 255 Compu_ECIPP_STRINGS 0 255 MATRIX_DIM 29 1 1 /end CHARACTERISTIC
/begin CHARACTERISTIC STR_RW_AUX_PUD2 "AUX PUD2" ASCII 0x001E9040 /* @ECU_Address@STR_RW_AUX_PUD2@0x02433000@ */ ECIPP_ALIGNMENT_UBYTE 255 Compu_ECIPP_STRINGS 0 255 MATRIX_DIM 29 1 1 /end CHARACTERISTIC
/begin CHARACTERISTIC STR_RW_AUX_PUD3 "AUX PUD3" ASCII 0x001E9112 /* @ECU_Address@STR_RW_AUX_PUD3@0x02434000@ */ ECIPP_ALIGNMENT_UBYTE 255 Compu_ECIPP_STRINGS 0 255 MATRIX_DIM 29 1 1 /end CHARACTERISTIC
/begin CHARACTERISTIC STR_RW_AUX_PUD4 "AUX PUD4" ASCII 0x001E9130 /* @ECU_Address@STR_RW_AUX_PUD4@0x02435000@ */ ECIPP_ALIGNMENT_UBYTE 255 Compu_ECIPP_STRINGS 0 255 MATRIX_DIM 29 1 1 /end CHARACTERISTIC
/begin CHARACTERISTIC STR_RW_AUX_PUD5 "AUX PUD5" ASCII 0x001E914E /* @ECU_Address@STR_RW_AUX_PUD5@0x02436000@ */ ECIPP_ALIGNMENT_UBYTE 255 Compu_ECIPP_STRINGS 0 255 MATRIX_DIM 29 1 1 /end CHARACTERISTIC
/begin CHARACTERISTIC STR_RW_AUX_PUD6 "AUX PUD6" ASCII 0x001E916C /* @ECU_Address@STR_RW_AUX_PUD6@0x02437000@ */ ECIPP_ALIGNMENT_UBYTE 255 Compu_ECIPP_STRINGS 0 255 MATRIX_DIM 29 1 1 /end CHARACTERISTIC
/begin CHARACTERISTIC STR_RW_AUX_PUD7 "AUX PUD7" ASCII 0x001E918A /* @ECU_Address@STR_RW_AUX_PUD7@0x02438000@ */ ECIPP_ALIGNMENT_UBYTE 255 Compu_ECIPP_STRINGS 0 255 MATRIX_DIM 29 1 1 /end CHARACTERISTIC
/begin CHARACTERISTIC STR_RW_AUX_PUD8 "AUX PUD8" ASCII 0x001E91A8 /* @ECU_Address@STR_RW_AUX_PUD8@0x02439000@ */ ECIPP_ALIGNMENT_UBYTE 255 Compu_ECIPP_STRINGS 0 255 MATRIX_DIM 29 1 1 /end CHARACTERISTIC
/begin CHARACTERISTIC STR_RW_AUX_PUD9 "AUX PUD9" ASCII 0x001E91C6 /* @ECU_Address@STR_RW_AUX_PUD9@0x0243A000@ */ ECIPP_ALIGNMENT_UBYTE 255 Compu_ECIPP_STRINGS 0 255 MATRIX_DIM 29 1 1 /end CHARACTERISTIC
/begin CHARACTERISTIC STR_RW_AUX_PUD10 "AUX PUD10" ASCII 0x001E8F14 /* @ECU_Address@STR_RW_AUX_PUD10@0x0243B000@ */ ECIPP_ALIGNMENT_UBYTE 255 Compu_ECIPP_STRINGS 0 255 MATRIX_DIM 29 1 1 /end CHARACTERISTIC
/begin CHARACTERISTIC STR_RW_AUX_PUD11 "AUX PUD11" ASCII 0x001E8F32 /* @ECU_Address@STR_RW_AUX_PUD11@0x0243C000@ */ ECIPP_ALIGNMENT_UBYTE 255 Compu_ECIPP_STRINGS 0 255 MATRIX_DIM 29 1 1 /end CHARACTERISTIC
/begin CHARACTERISTIC STR_RW_AUX_PUD12 "AUX PUD12" ASCII 0x001E8F50 /* @ECU_Address@STR_RW_AUX_PUD12@0x0243D000@ */ ECIPP_ALIGNMENT_UBYTE 255 Compu_ECIPP_STRINGS 0 255 MATRIX_DIM 29 1 1 /end CHARACTERISTIC
/begin CHARACTERISTIC STR_RW_AUX_PUD13 "AUX PUD13" ASCII 0x001E8F6E /* @ECU_Address@STR_RW_AUX_PUD13@0x0243E000@ */ ECIPP_ALIGNMENT_UBYTE 255 Compu_ECIPP_STRINGS 0 255 MATRIX_DIM 29 1 1 /end CHARACTERISTIC
/begin CHARACTERISTIC STR_RW_AUX_PUD14 "AUX PUD14" ASCII 0x001E8F8C /* @ECU_Address@STR_RW_AUX_PUD14@0x0243F000@ */ ECIPP_ALIGNMENT_UBYTE 255 Compu_ECIPP_STRINGS 0 255 MATRIX_DIM 29 1 1 /end CHARACTERISTIC
/begin CHARACTERISTIC STR_RW_AUX_PUD15 "AUX PUD15" ASCII 0x001E8FAA /* @ECU_Address@STR_RW_AUX_PUD15@0x02440000@ */ ECIPP_ALIGNMENT_UBYTE 255 Compu_ECIPP_STRINGS 0 255 MATRIX_DIM 29 1 1 /end CHARACTERISTIC
/begin CHARACTERISTIC STR_RW_AUX_PUD16 "AUX PUD16" ASCII 0x001E8FC8 /* @ECU_Address@STR_RW_AUX_PUD16@0x02441000@ */ ECIPP_ALIGNMENT_UBYTE 255 Compu_ECIPP_STRINGS 0 255 MATRIX_DIM 29 1 1 /end CHARACTERISTIC
/begin CHARACTERISTIC STR_RW_AUX_PUD17 "AUX PUD17" ASCII 0x001E8FE6 /* @ECU_Address@STR_RW_AUX_PUD17@0x02442000@ */ ECIPP_ALIGNMENT_UBYTE 255 Compu_ECIPP_STRINGS 0 255 MATRIX_DIM 29 1 1 /end CHARACTERISTIC
/begin CHARACTERISTIC STR_RW_AUX_PUD18 "AUX PUD18" ASCII 0x001E9004 /* @ECU_Address@STR_RW_AUX_PUD18@0x02443000@ */ ECIPP_ALIGNMENT_UBYTE 255 Compu_ECIPP_STRINGS 0 255 MATRIX_DIM 29 1 1 /end CHARACTERISTIC
/begin CHARACTERISTIC STR_RW_AUX_PUD19 "AUX PUD19" ASCII 0x001E9022 /* @ECU_Address@STR_RW_AUX_PUD19@0x02444000@ */ ECIPP_ALIGNMENT_UBYTE 255 Compu_ECIPP_STRINGS 0 255 MATRIX_DIM 29 1 1 /end CHARACTERISTIC
/begin CHARACTERISTIC STR_RW_AUX_PUD20 "AUX PUD20" ASCII 0x001E905E /* @ECU_Address@STR_RW_AUX_PUD20@0x02445000@ */ ECIPP_ALIGNMENT_UBYTE 255 Compu_ECIPP_STRINGS 0 255 MATRIX_DIM 29 1 1 /end CHARACTERISTIC
/begin CHARACTERISTIC STR_RW_AUX_PUD21 "AUX PUD21" ASCII 0x001E907C /* @ECU_Address@STR_RW_AUX_PUD21@0x02446000@ */ ECIPP_ALIGNMENT_UBYTE 255 Compu_ECIPP_STRINGS 0 255 MATRIX_DIM 29 1 1 /end CHARACTERISTIC
/begin CHARACTERISTIC STR_RW_AUX_PUD22 "AUX PUD22" ASCII 0x001E909A /* @ECU_Address@STR_RW_AUX_PUD22@0x02447000@ */ ECIPP_ALIGNMENT_UBYTE 255 Compu_ECIPP_STRINGS 0 255 MATRIX_DIM 29 1 1 /end CHARACTERISTIC
/begin CHARACTERISTIC STR_RW_AUX_PUD23 "AUX PUD23" ASCII 0x001E90B8 /* @ECU_Address@STR_RW_AUX_PUD23@0x02448000@ */ ECIPP_ALIGNMENT_UBYTE 255 Compu_ECIPP_STRINGS 0 255 MATRIX_DIM 29 1 1 /end CHARACTERISTIC
/begin CHARACTERISTIC STR_RW_AUX_PUD24 "AUX PUD24" ASCII 0x001E90D6 /* @ECU_Address@STR_RW_AUX_PUD24@0x02449000@ */ ECIPP_ALIGNMENT_UBYTE 255 Compu_ECIPP_STRINGS 0 255 MATRIX_DIM 29 1 1 /end CHARACTERISTIC
/begin CHARACTERISTIC STR_RW_AUX_PUD25 "AUX PUD25" ASCII 0x001E90F4 /* @ECU_Address@STR_RW_AUX_PUD25@0x0244A000@ */ ECIPP_ALIGNMENT_UBYTE 255 Compu_ECIPP_STRINGS 0 255 MATRIX_DIM 29 1 1 /end CHARACTERISTIC
/begin CHARACTERISTIC STR_RW_AUX_DIG1 "AUX DIG1" ASCII 0x001E8B54 /* @ECU_Address@STR_RW_AUX_DIG1@0x0244B000@ */ ECIPP_ALIGNMENT_UBYTE 255 Compu_ECIPP_STRINGS 0 255 MATRIX_DIM 29 1 1 /end CHARACTERISTIC
/begin CHARACTERISTIC STR_RW_AUX_DIG2 "AUX DIG2" ASCII 0x001E8C9E /* @ECU_Address@STR_RW_AUX_DIG2@0x0244C000@ */ ECIPP_ALIGNMENT_UBYTE 255 Compu_ECIPP_STRINGS 0 255 MATRIX_DIM 29 1 1 /end CHARACTERISTIC
/begin CHARACTERISTIC STR_RW_AUX_DIG3 "AUX DIG3" ASCII 0x001E8D70 /* @ECU_Address@STR_RW_AUX_DIG3@0x0244D000@ */ ECIPP_ALIGNMENT_UBYTE 255 Compu_ECIPP_STRINGS 0 255 MATRIX_DIM 29 1 1 /end CHARACTERISTIC
/begin CHARACTERISTIC STR_RW_AUX_DIG4 "AUX DIG4" ASCII 0x001E8D8E /* @ECU_Address@STR_RW_AUX_DIG4@0x0244E000@ */ ECIPP_ALIGNMENT_UBYTE 255 Compu_ECIPP_STRINGS 0 255 MATRIX_DIM 29 1 1 /end CHARACTERISTIC
/begin CHARACTERISTIC STR_RW_AUX_DIG5 "AUX DIG5" ASCII 0x001E8DAC /* @ECU_Address@STR_RW_AUX_DIG5@0x0244F000@ */ ECIPP_ALIGNMENT_UBYTE 255 Compu_ECIPP_STRINGS 0 255 MATRIX_DIM 29 1 1 /end CHARACTERISTIC
/begin CHARACTERISTIC STR_RW_AUX_DIG6 "AUX DIG6" ASCII 0x001E8DCA /* @ECU_Address@STR_RW_AUX_DIG6@0x02450000@ */ ECIPP_ALIGNMENT_UBYTE 255 Compu_ECIPP_STRINGS 0 255 MATRIX_DIM 29 1 1 /end CHARACTERISTIC
/begin CHARACTERISTIC STR_RW_AUX_DIG7 "AUX DIG7" ASCII 0x001E8DE8 /* @ECU_Address@STR_RW_AUX_DIG7@0x02451000@ */ ECIPP_ALIGNMENT_UBYTE 255 Compu_ECIPP_STRINGS 0 255 MATRIX_DIM 29 1 1 /end CHARACTERISTIC
/begin CHARACTERISTIC STR_RW_AUX_DIG8 "AUX DIG8" ASCII 0x001E8E06 /* @ECU_Address@STR_RW_AUX_DIG8@0x02452000@ */ ECIPP_ALIGNMENT_UBYTE 255 Compu_ECIPP_STRINGS 0 255 MATRIX_DIM 29 1 1 /end CHARACTERISTIC
/begin CHARACTERISTIC STR_RW_AUX_DIG9 "AUX DIG9" ASCII 0x001E8E24 /* @ECU_Address@STR_RW_AUX_DIG9@0x02453000@ */ ECIPP_ALIGNMENT_UBYTE 255 Compu_ECIPP_STRINGS 0 255 MATRIX_DIM 29 1 1 /end CHARACTERISTIC
/begin CHARACTERISTIC STR_RW_AUX_DIG10 "AUX DIG10" ASCII 0x001E8B72 /* @ECU_Address@STR_RW_AUX_DIG10@0x02454000@ */ ECIPP_ALIGNMENT_UBYTE 255 Compu_ECIPP_STRINGS 0 255 MATRIX_DIM 29 1 1 /end CHARACTERISTIC
/begin CHARACTERISTIC STR_RW_AUX_DIG11 "AUX DIG11" ASCII 0x001E8B90 /* @ECU_Address@STR_RW_AUX_DIG11@0x02455000@ */ ECIPP_ALIGNMENT_UBYTE 255 Compu_ECIPP_STRINGS 0 255 MATRIX_DIM 29 1 1 /end CHARACTERISTIC
/begin CHARACTERISTIC STR_RW_AUX_DIG12 "AUX DIG12" ASCII 0x001E8BAE /* @ECU_Address@STR_RW_AUX_DIG12@0x02456000@ */ ECIPP_ALIGNMENT_UBYTE 255 Compu_ECIPP_STRINGS 0 255 MATRIX_DIM 29 1 1 /end CHARACTERISTIC
/begin CHARACTERISTIC STR_RW_AUX_DIG13 "AUX DIG13" ASCII 0x001E8BCC /* @ECU_Address@STR_RW_AUX_DIG13@0x02457000@ */ ECIPP_ALIGNMENT_UBYTE 255 Compu_ECIPP_STRINGS 0 255 MATRIX_DIM 29 1 1 /end CHARACTERISTIC
/begin CHARACTERISTIC STR_RW_AUX_DIG14 "AUX DIG14" ASCII 0x001E8BEA /* @ECU_Address@STR_RW_AUX_DIG14@0x02458000@ */ ECIPP_ALIGNMENT_UBYTE 255 Compu_ECIPP_STRINGS 0 255 MATRIX_DIM 29 1 1 /end CHARACTERISTIC
/begin CHARACTERISTIC STR_RW_AUX_DIG15 "AUX DIG15" ASCII 0x001E8C08 /* @ECU_Address@STR_RW_AUX_DIG15@0x02459000@ */ ECIPP_ALIGNMENT_UBYTE 255 Compu_ECIPP_STRINGS 0 255 MATRIX_DIM 29 1 1 /end CHARACTERISTIC
/begin CHARACTERISTIC STR_RW_AUX_DIG16 "AUX DIG16" ASCII 0x001E8C26 /* @ECU_Address@STR_RW_AUX_DIG16@0x0245A000@ */ ECIPP_ALIGNMENT_UBYTE 255 Compu_ECIPP_STRINGS 0 255 MATRIX_DIM 29 1 1 /end CHARACTERISTIC
/begin CHARACTERISTIC STR_RW_AUX_DIG17 "AUX DIG17" ASCII 0x001E8C44 /* @ECU_Address@STR_RW_AUX_DIG17@0x0245B000@ */ ECIPP_ALIGNMENT_UBYTE 255 Compu_ECIPP_STRINGS 0 255 MATRIX_DIM 29 1 1 /end CHARACTERISTIC
/begin CHARACTERISTIC STR_RW_AUX_DIG18 "AUX DIG18" ASCII 0x001E8C62 /* @ECU_Address@STR_RW_AUX_DIG18@0x0245C000@ */ ECIPP_ALIGNMENT_UBYTE 255 Compu_ECIPP_STRINGS 0 255 MATRIX_DIM 29 1 1 /end CHARACTERISTIC
/begin CHARACTERISTIC STR_RW_AUX_DIG19 "AUX DIG19" ASCII 0x001E8C80 /* @ECU_Address@STR_RW_AUX_DIG19@0x0245D000@ */ ECIPP_ALIGNMENT_UBYTE 255 Compu_ECIPP_STRINGS 0 255 MATRIX_DIM 29 1 1 /end CHARACTERISTIC
/begin CHARACTERISTIC STR_RW_AUX_DIG20 "AUX DIG20" ASCII 0x001E8CBC /* @ECU_Address@STR_RW_AUX_DIG20@0x0245E000@ */ ECIPP_ALIGNMENT_UBYTE 255 Compu_ECIPP_STRINGS 0 255 MATRIX_DIM 29 1 1 /end CHARACTERISTIC
/begin CHARACTERISTIC STR_RW_AUX_DIG21 "AUX DIG21" ASCII 0x001E8CDA /* @ECU_Address@STR_RW_AUX_DIG21@0x0245F000@ */ ECIPP_ALIGNMENT_UBYTE 255 Compu_ECIPP_STRINGS 0 255 MATRIX_DIM 29 1 1 /end CHARACTERISTIC
/begin CHARACTERISTIC STR_RW_AUX_DIG22 "AUX DIG22" ASCII 0x001E8CF8 /* @ECU_Address@STR_RW_AUX_DIG22@0x02460000@ */ ECIPP_ALIGNMENT_UBYTE 255 Compu_ECIPP_STRINGS 0 255 MATRIX_DIM 29 1 1 /end CHARACTERISTIC
/begin CHARACTERISTIC STR_RW_AUX_DIG23 "AUX DIG23" ASCII 0x001E8D16 /* @ECU_Address@STR_RW_AUX_DIG23@0x02461000@ */ ECIPP_ALIGNMENT_UBYTE 255 Compu_ECIPP_STRINGS 0 255 MATRIX_DIM 29 1 1 /end CHARACTERISTIC
/begin CHARACTERISTIC STR_RW_AUX_DIG24 "AUX DIG24" ASCII 0x001E8D34 /* @ECU_Address@STR_RW_AUX_DIG24@0x02462000@ */ ECIPP_ALIGNMENT_UBYTE 255 Compu_ECIPP_STRINGS 0 255 MATRIX_DIM 29 1 1 /end CHARACTERISTIC
/begin CHARACTERISTIC STR_RW_AUX_DIG25 "AUX DIG25" ASCII 0x001E8D52 /* @ECU_Address@STR_RW_AUX_DIG25@0x02463000@ */ ECIPP_ALIGNMENT_UBYTE 255 Compu_ECIPP_STRINGS 0 255 MATRIX_DIM 29 1 1 /end CHARACTERISTIC
/begin CHARACTERISTIC STR_RW_AUX_PWM1 "AUX PWM1" ASCII 0x001E91E4 /* @ECU_Address@STR_RW_AUX_PWM1@0x02464000@ */ ECIPP_ALIGNMENT_UBYTE 255 Compu_ECIPP_STRINGS 0 255 MATRIX_DIM 29 1 1 /end CHARACTERISTIC
/begin CHARACTERISTIC STR_RW_AUX_PWM2 "AUX PWM2" ASCII 0x001E932E /* @ECU_Address@STR_RW_AUX_PWM2@0x02465000@ */ ECIPP_ALIGNMENT_UBYTE 255 Compu_ECIPP_STRINGS 0 255 MATRIX_DIM 29 1 1 /end CHARACTERISTIC
/begin CHARACTERISTIC STR_RW_AUX_PWM3 "AUX PWM3" ASCII 0x001E9400 /* @ECU_Address@STR_RW_AUX_PWM3@0x02466000@ */ ECIPP_ALIGNMENT_UBYTE 255 Compu_ECIPP_STRINGS 0 255 MATRIX_DIM 29 1 1 /end CHARACTERISTIC
/begin CHARACTERISTIC STR_RW_AUX_PWM4 "AUX PWM4" ASCII 0x001E941E /* @ECU_Address@STR_RW_AUX_PWM4@0x02467000@ */ ECIPP_ALIGNMENT_UBYTE 255 Compu_ECIPP_STRINGS 0 255 MATRIX_DIM 29 1 1 /end CHARACTERISTIC
/begin CHARACTERISTIC STR_RW_AUX_PWM5 "AUX PWM5" ASCII 0x001E943C /* @ECU_Address@STR_RW_AUX_PWM5@0x02468000@ */ ECIPP_ALIGNMENT_UBYTE 255 Compu_ECIPP_STRINGS 0 255 MATRIX_DIM 29 1 1 /end CHARACTERISTIC
/begin CHARACTERISTIC STR_RW_AUX_PWM6 "AUX PWM6" ASCII 0x001E945A /* @ECU_Address@STR_RW_AUX_PWM6@0x02469000@ */ ECIPP_ALIGNMENT_UBYTE 255 Compu_ECIPP_STRINGS 0 255 MATRIX_DIM 29 1 1 /end CHARACTERISTIC
/begin CHARACTERISTIC STR_RW_AUX_PWM7 "AUX PWM7" ASCII 0x001E9478 /* @ECU_Address@STR_RW_AUX_PWM7@0x0246A000@ */ ECIPP_ALIGNMENT_UBYTE 255 Compu_ECIPP_STRINGS 0 255 MATRIX_DIM 29 1 1 /end CHARACTERISTIC
/begin CHARACTERISTIC STR_RW_AUX_PWM8 "AUX PWM8" ASCII 0x001E9496 /* @ECU_Address@STR_RW_AUX_PWM8@0x0246B000@ */ ECIPP_ALIGNMENT_UBYTE 255 Compu_ECIPP_STRINGS 0 255 MATRIX_DIM 29 1 1 /end CHARACTERISTIC
/begin CHARACTERISTIC STR_RW_AUX_PWM9 "AUX PWM9" ASCII 0x001E94B4 /* @ECU_Address@STR_RW_AUX_PWM9@0x0246C000@ */ ECIPP_ALIGNMENT_UBYTE 255 Compu_ECIPP_STRINGS 0 255 MATRIX_DIM 29 1 1 /end CHARACTERISTIC
/begin CHARACTERISTIC STR_RW_AUX_PWM10 "AUX PWM10" ASCII 0x001E9202 /* @ECU_Address@STR_RW_AUX_PWM10@0x0246D000@ */ ECIPP_ALIGNMENT_UBYTE 255 Compu_ECIPP_STRINGS 0 255 MATRIX_DIM 29 1 1 /end CHARACTERISTIC
/begin CHARACTERISTIC STR_RW_AUX_PWM11 "AUX PWM11" ASCII 0x001E9220 /* @ECU_Address@STR_RW_AUX_PWM11@0x0246E000@ */ ECIPP_ALIGNMENT_UBYTE 255 Compu_ECIPP_STRINGS 0 255 MATRIX_DIM 29 1 1 /end CHARACTERISTIC
/begin CHARACTERISTIC STR_RW_AUX_PWM12 "AUX PWM12" ASCII 0x001E923E /* @ECU_Address@STR_RW_AUX_PWM12@0x0246F000@ */ ECIPP_ALIGNMENT_UBYTE 255 Compu_ECIPP_STRINGS 0 255 MATRIX_DIM 29 1 1 /end CHARACTERISTIC
/begin CHARACTERISTIC STR_RW_AUX_PWM13 "AUX PWM13" ASCII 0x001E925C /* @ECU_Address@STR_RW_AUX_PWM13@0x02470000@ */ ECIPP_ALIGNMENT_UBYTE 255 Compu_ECIPP_STRINGS 0 255 MATRIX_DIM 29 1 1 /end CHARACTERISTIC
/begin CHARACTERISTIC STR_RW_AUX_PWM14 "AUX PWM14" ASCII 0x001E927A /* @ECU_Address@STR_RW_AUX_PWM14@0x02471000@ */ ECIPP_ALIGNMENT_UBYTE 255 Compu_ECIPP_STRINGS 0 255 MATRIX_DIM 29 1 1 /end CHARACTERISTIC
/begin CHARACTERISTIC STR_RW_AUX_PWM15 "AUX PWM15" ASCII 0x001E9298 /* @ECU_Address@STR_RW_AUX_PWM15@0x02472000@ */ ECIPP_ALIGNMENT_UBYTE 255 Compu_ECIPP_STRINGS 0 255 MATRIX_DIM 29 1 1 /end CHARACTERISTIC
/begin CHARACTERISTIC STR_RW_AUX_PWM16 "AUX PWM16" ASCII 0x001E92B6 /* @ECU_Address@STR_RW_AUX_PWM16@0x02473000@ */ ECIPP_ALIGNMENT_UBYTE 255 Compu_ECIPP_STRINGS 0 255 MATRIX_DIM 29 1 1 /end CHARACTERISTIC
/begin CHARACTERISTIC STR_RW_AUX_PWM17 "AUX PWM17" ASCII 0x001E92D4 /* @ECU_Address@STR_RW_AUX_PWM17@0x02474000@ */ ECIPP_ALIGNMENT_UBYTE 255 Compu_ECIPP_STRINGS 0 255 MATRIX_DIM 29 1 1 /end CHARACTERISTIC
/begin CHARACTERISTIC STR_RW_AUX_PWM18 "AUX PWM18" ASCII 0x001E92F2 /* @ECU_Address@STR_RW_AUX_PWM18@0x02475000@ */ ECIPP_ALIGNMENT_UBYTE 255 Compu_ECIPP_STRINGS 0 255 MATRIX_DIM 29 1 1 /end CHARACTERISTIC
/begin CHARACTERISTIC STR_RW_AUX_PWM19 "AUX PWM19" ASCII 0x001E9310 /* @ECU_Address@STR_RW_AUX_PWM19@0x02476000@ */ ECIPP_ALIGNMENT_UBYTE 255 Compu_ECIPP_STRINGS 0 255 MATRIX_DIM 29 1 1 /end CHARACTERISTIC
/begin CHARACTERISTIC STR_RW_AUX_PWM20 "AUX PWM20" ASCII 0x001E934C /* @ECU_Address@STR_RW_AUX_PWM20@0x02477000@ */ ECIPP_ALIGNMENT_UBYTE 255 Compu_ECIPP_STRINGS 0 255 MATRIX_DIM 29 1 1 /end CHARACTERISTIC
/begin CHARACTERISTIC STR_RW_AUX_PWM21 "AUX PWM21" ASCII 0x001E936A /* @ECU_Address@STR_RW_AUX_PWM21@0x02478000@ */ ECIPP_ALIGNMENT_UBYTE 255 Compu_ECIPP_STRINGS 0 255 MATRIX_DIM 29 1 1 /end CHARACTERISTIC
/begin CHARACTERISTIC STR_RW_AUX_PWM22 "AUX PWM22" ASCII 0x001E9388 /* @ECU_Address@STR_RW_AUX_PWM22@0x02479000@ */ ECIPP_ALIGNMENT_UBYTE 255 Compu_ECIPP_STRINGS 0 255 MATRIX_DIM 29 1 1 /end CHARACTERISTIC
/begin CHARACTERISTIC STR_RW_AUX_PWM23 "AUX PWM23" ASCII 0x001E93A6 /* @ECU_Address@STR_RW_AUX_PWM23@0x0247A000@ */ ECIPP_ALIGNMENT_UBYTE 255 Compu_ECIPP_STRINGS 0 255 MATRIX_DIM 29 1 1 /end CHARACTERISTIC
/begin CHARACTERISTIC STR_RW_AUX_PWM24 "AUX PWM24" ASCII 0x001E93C4 /* @ECU_Address@STR_RW_AUX_PWM24@0x0247B000@ */ ECIPP_ALIGNMENT_UBYTE 255 Compu_ECIPP_STRINGS 0 255 MATRIX_DIM 29 1 1 /end CHARACTERISTIC
/begin CHARACTERISTIC STR_RW_AUX_PWM25 "AUX PWM25" ASCII 0x001E93E2 /* @ECU_Address@STR_RW_AUX_PWM25@0x0247C000@ */ ECIPP_ALIGNMENT_UBYTE 255 Compu_ECIPP_STRINGS 0 255 MATRIX_DIM 29 1 1 /end CHARACTERISTIC
/begin CHARACTERISTIC STR_RM_TAUX1 "Aux Temp1" ASCII 0x001E880C /* @ECU_Address@STR_RM_TAUX1@0x024CF000@ */ ECIPP_ALIGNMENT_UBYTE 255 Compu_ECIPP_STRINGS 0 255 MATRIX_DIM 29 1 1 /end CHARACTERISTIC
/begin CHARACTERISTIC STR_RM_TAUX2 "Aux Temp2" ASCII 0x001E8956 /* @ECU_Address@STR_RM_TAUX2@0x024D0000@ */ ECIPP_ALIGNMENT_UBYTE 255 Compu_ECIPP_STRINGS 0 255 MATRIX_DIM 29 1 1 /end CHARACTERISTIC
/begin CHARACTERISTIC STR_RM_TAUX3 "Aux Temp3" ASCII 0x001E8A0A /* @ECU_Address@STR_RM_TAUX3@0x024D1000@ */ ECIPP_ALIGNMENT_UBYTE 255 Compu_ECIPP_STRINGS 0 255 MATRIX_DIM 29 1 1 /end CHARACTERISTIC
/begin CHARACTERISTIC STR_RM_TAUX4 "Aux Temp4" ASCII 0x001E8A28 /* @ECU_Address@STR_RM_TAUX4@0x024D2000@ */ ECIPP_ALIGNMENT_UBYTE 255 Compu_ECIPP_STRINGS 0 255 MATRIX_DIM 29 1 1 /end CHARACTERISTIC
/begin CHARACTERISTIC STR_RM_TAUX5 "Aux Temp5" ASCII 0x001E8A46 /* @ECU_Address@STR_RM_TAUX5@0x024D3000@ */ ECIPP_ALIGNMENT_UBYTE 255 Compu_ECIPP_STRINGS 0 255 MATRIX_DIM 29 1 1 /end CHARACTERISTIC
/begin CHARACTERISTIC STR_RM_TAUX6 "Aux Temp6" ASCII 0x001E8A64 /* @ECU_Address@STR_RM_TAUX6@0x024D4000@ */ ECIPP_ALIGNMENT_UBYTE 255 Compu_ECIPP_STRINGS 0 255 MATRIX_DIM 29 1 1 /end CHARACTERISTIC
/begin CHARACTERISTIC STR_RM_TAUX7 "Aux Temp7" ASCII 0x001E8A82 /* @ECU_Address@STR_RM_TAUX7@0x024D5000@ */ ECIPP_ALIGNMENT_UBYTE 255 Compu_ECIPP_STRINGS 0 255 MATRIX_DIM 29 1 1 /end CHARACTERISTIC
/begin CHARACTERISTIC STR_RM_TAUX8 "Aux Temp8" ASCII 0x001E8AA0 /* @ECU_Address@STR_RM_TAUX8@0x024D6000@ */ ECIPP_ALIGNMENT_UBYTE 255 Compu_ECIPP_STRINGS 0 255 MATRIX_DIM 29 1 1 /end CHARACTERISTIC
/begin CHARACTERISTIC STR_RM_TAUX9 "Aux Temp9" ASCII 0x001E8ABE /* @ECU_Address@STR_RM_TAUX9@0x024D7000@ */ ECIPP_ALIGNMENT_UBYTE 255 Compu_ECIPP_STRINGS 0 255 MATRIX_DIM 29 1 1 /end CHARACTERISTIC
/begin CHARACTERISTIC STR_RM_TAUX10 "Aux Temp10" ASCII 0x001E882A /* @ECU_Address@STR_RM_TAUX10@0x024D8000@ */ ECIPP_ALIGNMENT_UBYTE 255 Compu_ECIPP_STRINGS 0 255 MATRIX_DIM 29 1 1 /end CHARACTERISTIC
/begin CHARACTERISTIC STR_RM_TAUX11 "Aux Temp11" ASCII 0x001E8848 /* @ECU_Address@STR_RM_TAUX11@0x024D9000@ */ ECIPP_ALIGNMENT_UBYTE 255 Compu_ECIPP_STRINGS 0 255 MATRIX_DIM 29 1 1 /end CHARACTERISTIC
/begin CHARACTERISTIC STR_RM_TAUX12 "Aux Temp12" ASCII 0x001E8866 /* @ECU_Address@STR_RM_TAUX12@0x024DA000@ */ ECIPP_ALIGNMENT_UBYTE 255 Compu_ECIPP_STRINGS 0 255 MATRIX_DIM 29 1 1 /end CHARACTERISTIC
/begin CHARACTERISTIC STR_RM_TAUX13 "Aux Temp13" ASCII 0x001E8884 /* @ECU_Address@STR_RM_TAUX13@0x024DB000@ */ ECIPP_ALIGNMENT_UBYTE 255 Compu_ECIPP_STRINGS 0 255 MATRIX_DIM 29 1 1 /end CHARACTERISTIC
/begin CHARACTERISTIC STR_RM_TAUX14 "Aux Temp14" ASCII 0x001E88A2 /* @ECU_Address@STR_RM_TAUX14@0x024DC000@ */ ECIPP_ALIGNMENT_UBYTE 255 Compu_ECIPP_STRINGS 0 255 MATRIX_DIM 29 1 1 /end CHARACTERISTIC
/begin CHARACTERISTIC STR_RM_TAUX15 "Aux Temp15" ASCII 0x001E88C0 /* @ECU_Address@STR_RM_TAUX15@0x024DD000@ */ ECIPP_ALIGNMENT_UBYTE 255 Compu_ECIPP_STRINGS 0 255 MATRIX_DIM 29 1 1 /end CHARACTERISTIC
/begin CHARACTERISTIC STR_RM_TAUX16 "Aux Temp16" ASCII 0x001E88DE /* @ECU_Address@STR_RM_TAUX16@0x024DE000@ */ ECIPP_ALIGNMENT_UBYTE 255 Compu_ECIPP_STRINGS 0 255 MATRIX_DIM 29 1 1 /end CHARACTERISTIC
/begin CHARACTERISTIC STR_RM_TAUX17 "Aux Temp17" ASCII 0x001E88FC /* @ECU_Address@STR_RM_TAUX17@0x024DF000@ */ ECIPP_ALIGNMENT_UBYTE 255 Compu_ECIPP_STRINGS 0 255 MATRIX_DIM 29 1 1 /end CHARACTERISTIC
/begin CHARACTERISTIC STR_RM_TAUX18 "Aux Temp18" ASCII 0x001E891A /* @ECU_Address@STR_RM_TAUX18@0x024E0000@ */ ECIPP_ALIGNMENT_UBYTE 255 Compu_ECIPP_STRINGS 0 255 MATRIX_DIM 29 1 1 /end CHARACTERISTIC
/begin CHARACTERISTIC STR_RM_TAUX19 "Aux Temp19" ASCII 0x001E8938 /* @ECU_Address@STR_RM_TAUX19@0x024E1000@ */ ECIPP_ALIGNMENT_UBYTE 255 Compu_ECIPP_STRINGS 0 255 MATRIX_DIM 29 1 1 /end CHARACTERISTIC
/begin CHARACTERISTIC STR_RM_TAUX20 "Aux Temp20" ASCII 0x001E8974 /* @ECU_Address@STR_RM_TAUX20@0x024E2000@ */ ECIPP_ALIGNMENT_UBYTE 255 Compu_ECIPP_STRINGS 0 255 MATRIX_DIM 29 1 1 /end CHARACTERISTIC
/begin CHARACTERISTIC STR_RM_TAUX21 "Aux Temp21" ASCII 0x001E8992 /* @ECU_Address@STR_RM_TAUX21@0x024E3000@ */ ECIPP_ALIGNMENT_UBYTE 255 Compu_ECIPP_STRINGS 0 255 MATRIX_DIM 29 1 1 /end CHARACTERISTIC
/begin CHARACTERISTIC STR_RM_TAUX22 "Aux Temp22" ASCII 0x001E89B0 /* @ECU_Address@STR_RM_TAUX22@0x024E4000@ */ ECIPP_ALIGNMENT_UBYTE 255 Compu_ECIPP_STRINGS 0 255 MATRIX_DIM 29 1 1 /end CHARACTERISTIC
/begin CHARACTERISTIC STR_RM_TAUX23 "Aux Temp23" ASCII 0x001E89CE /* @ECU_Address@STR_RM_TAUX23@0x024E5000@ */ ECIPP_ALIGNMENT_UBYTE 255 Compu_ECIPP_STRINGS 0 255 MATRIX_DIM 29 1 1 /end CHARACTERISTIC
/begin CHARACTERISTIC STR_RM_TAUX24 "Aux Temp24" ASCII 0x001E89EC /* @ECU_Address@STR_RM_TAUX24@0x024E6000@ */ ECIPP_ALIGNMENT_UBYTE 255 Compu_ECIPP_STRINGS 0 255 MATRIX_DIM 29 1 1 /end CHARACTERISTIC
/begin CHARACTERISTIC STR_RM_PAUX1 "Aux Pressure1" ASCII 0x001E8500 /* @ECU_Address@STR_RM_PAUX1@0x024E7000@ */ ECIPP_ALIGNMENT_UBYTE 255 Compu_ECIPP_STRINGS 0 255 MATRIX_DIM 29 1 1 /end CHARACTERISTIC
/begin CHARACTERISTIC STR_RM_PAUX2 "Aux Pressure2" ASCII 0x001E85F0 /* @ECU_Address@STR_RM_PAUX2@0x024E8000@ */ ECIPP_ALIGNMENT_UBYTE 255 Compu_ECIPP_STRINGS 0 255 MATRIX_DIM 29 1 1 /end CHARACTERISTIC
/begin CHARACTERISTIC STR_RM_PAUX3 "Aux Pressure3" ASCII 0x001E860E /* @ECU_Address@STR_RM_PAUX3@0x024E9000@ */ ECIPP_ALIGNMENT_UBYTE 255 Compu_ECIPP_STRINGS 0 255 MATRIX_DIM 29 1 1 /end CHARACTERISTIC
/begin CHARACTERISTIC STR_RM_PAUX4 "Aux Pressure4" ASCII 0x001E862C /* @ECU_Address@STR_RM_PAUX4@0x024EA000@ */ ECIPP_ALIGNMENT_UBYTE 255 Compu_ECIPP_STRINGS 0 255 MATRIX_DIM 29 1 1 /end CHARACTERISTIC
/begin CHARACTERISTIC STR_RM_PAUX5 "Aux Pressure5" ASCII 0x001E864A /* @ECU_Address@STR_RM_PAUX5@0x024EB000@ */ ECIPP_ALIGNMENT_UBYTE 255 Compu_ECIPP_STRINGS 0 255 MATRIX_DIM 29 1 1 /end CHARACTERISTIC
/begin CHARACTERISTIC STR_RM_PAUX6 "Aux Pressure6" ASCII 0x001E8668 /* @ECU_Address@STR_RM_PAUX6@0x024EC000@ */ ECIPP_ALIGNMENT_UBYTE 255 Compu_ECIPP_STRINGS 0 255 MATRIX_DIM 29 1 1 /end CHARACTERISTIC
/begin CHARACTERISTIC STR_RM_PAUX7 "Aux Pressure7" ASCII 0x001E8686 /* @ECU_Address@STR_RM_PAUX7@0x024ED000@ */ ECIPP_ALIGNMENT_UBYTE 255 Compu_ECIPP_STRINGS 0 255 MATRIX_DIM 29 1 1 /end CHARACTERISTIC
/begin CHARACTERISTIC STR_RM_PAUX8 "Aux Pressure8" ASCII 0x001E86A4 /* @ECU_Address@STR_RM_PAUX8@0x024EE000@ */ ECIPP_ALIGNMENT_UBYTE 255 Compu_ECIPP_STRINGS 0 255 MATRIX_DIM 29 1 1 /end CHARACTERISTIC
/begin CHARACTERISTIC STR_RM_PAUX9 "Aux Pressure9" ASCII 0x001E86C2 /* @ECU_Address@STR_RM_PAUX9@0x024EF000@ */ ECIPP_ALIGNMENT_UBYTE 255 Compu_ECIPP_STRINGS 0 255 MATRIX_DIM 29 1 1 /end CHARACTERISTIC
/begin CHARACTERISTIC STR_RM_PAUX10 "Aux Pressure10" ASCII 0x001E851E /* @ECU_Address@STR_RM_PAUX10@0x024F0000@ */ ECIPP_ALIGNMENT_UBYTE 255 Compu_ECIPP_STRINGS 0 255 MATRIX_DIM 29 1 1 /end CHARACTERISTIC
/begin CHARACTERISTIC STR_RM_PAUX11 "Aux Pressure11" ASCII 0x001E853C /* @ECU_Address@STR_RM_PAUX11@0x024F1000@ */ ECIPP_ALIGNMENT_UBYTE 255 Compu_ECIPP_STRINGS 0 255 MATRIX_DIM 29 1 1 /end CHARACTERISTIC
/begin CHARACTERISTIC STR_RM_PAUX12 "Aux Pressure12" ASCII 0x001E855A /* @ECU_Address@STR_RM_PAUX12@0x024F2000@ */ ECIPP_ALIGNMENT_UBYTE 255 Compu_ECIPP_STRINGS 0 255 MATRIX_DIM 29 1 1 /end CHARACTERISTIC
/begin CHARACTERISTIC STR_RM_PAUX13 "Aux Pressure13" ASCII 0x001E8578 /* @ECU_Address@STR_RM_PAUX13@0x024F3000@ */ ECIPP_ALIGNMENT_UBYTE 255 Compu_ECIPP_STRINGS 0 255 MATRIX_DIM 29 1 1 /end CHARACTERISTIC
/begin CHARACTERISTIC STR_RM_PAUX14 "Aux Pressure14" ASCII 0x001E8596 /* @ECU_Address@STR_RM_PAUX14@0x024F4000@ */ ECIPP_ALIGNMENT_UBYTE 255 Compu_ECIPP_STRINGS 0 255 MATRIX_DIM 29 1 1 /end CHARACTERISTIC
/begin CHARACTERISTIC STR_RM_PAUX15 "Aux Pressure15" ASCII 0x001E85B4 /* @ECU_Address@STR_RM_PAUX15@0x024F5000@ */ ECIPP_ALIGNMENT_UBYTE 255 Compu_ECIPP_STRINGS 0 255 MATRIX_DIM 29 1 1 /end CHARACTERISTIC
/begin CHARACTERISTIC STR_RM_PAUX16 "Aux Pressure16" ASCII 0x001E85D2 /* @ECU_Address@STR_RM_PAUX16@0x024F6000@ */ ECIPP_ALIGNMENT_UBYTE 255 Compu_ECIPP_STRINGS 0 255 MATRIX_DIM 29 1 1 /end CHARACTERISTIC
/begin CHARACTERISTIC STR_RW_TAUX1 "Aux Temp1" ASCII 0x001C8BA7 /* @ECU_Address@STR_RW_TAUX1@0x024F7000@ */ ECIPP_ALIGNMENT_UBYTE 255 Compu_ECIPP_STRINGS 0 255 MATRIX_DIM 29 1 1 /end CHARACTERISTIC
/begin CHARACTERISTIC STR_RW_TAUX2 "Aux Temp2" ASCII 0x001C8CF1 /* @ECU_Address@STR_RW_TAUX2@0x024F8000@ */ ECIPP_ALIGNMENT_UBYTE 255 Compu_ECIPP_STRINGS 0 255 MATRIX_DIM 29 1 1 /end CHARACTERISTIC
/begin CHARACTERISTIC STR_RW_TAUX3 "Aux Temp3" ASCII 0x001C8DA5 /* @ECU_Address@STR_RW_TAUX3@0x024F9000@ */ ECIPP_ALIGNMENT_UBYTE 255 Compu_ECIPP_STRINGS 0 255 MATRIX_DIM 29 1 1 /end CHARACTERISTIC
/begin CHARACTERISTIC STR_RW_TAUX4 "Aux Temp4" ASCII 0x001C8DC3 /* @ECU_Address@STR_RW_TAUX4@0x024FA000@ */ ECIPP_ALIGNMENT_UBYTE 255 Compu_ECIPP_STRINGS 0 255 MATRIX_DIM 29 1 1 /end CHARACTERISTIC
/begin CHARACTERISTIC STR_RW_TAUX5 "Aux Temp5" ASCII 0x001C8DE1 /* @ECU_Address@STR_RW_TAUX5@0x024FB000@ */ ECIPP_ALIGNMENT_UBYTE 255 Compu_ECIPP_STRINGS 0 255 MATRIX_DIM 29 1 1 /end CHARACTERISTIC
/begin CHARACTERISTIC STR_RW_TAUX6 "Aux Temp6" ASCII 0x001C8DFF /* @ECU_Address@STR_RW_TAUX6@0x024FC000@ */ ECIPP_ALIGNMENT_UBYTE 255 Compu_ECIPP_STRINGS 0 255 MATRIX_DIM 29 1 1 /end CHARACTERISTIC
/begin CHARACTERISTIC STR_RW_TAUX7 "Aux Temp7" ASCII 0x001C8E1D /* @ECU_Address@STR_RW_TAUX7@0x024FD000@ */ ECIPP_ALIGNMENT_UBYTE 255 Compu_ECIPP_STRINGS 0 255 MATRIX_DIM 29 1 1 /end CHARACTERISTIC
/begin CHARACTERISTIC STR_RW_TAUX8 "Aux Temp8" ASCII 0x001C8E3B /* @ECU_Address@STR_RW_TAUX8@0x024FE000@ */ ECIPP_ALIGNMENT_UBYTE 255 Compu_ECIPP_STRINGS 0 255 MATRIX_DIM 29 1 1 /end CHARACTERISTIC
/begin CHARACTERISTIC STR_RW_TAUX9 "Aux Temp9" ASCII 0x001C8E59 /* @ECU_Address@STR_RW_TAUX9@0x024FF000@ */ ECIPP_ALIGNMENT_UBYTE 255 Compu_ECIPP_STRINGS 0 255 MATRIX_DIM 29 1 1 /end CHARACTERISTIC
/begin CHARACTERISTIC STR_RW_TAUX10 "Aux Temp10" ASCII 0x001C8BC5 /* @ECU_Address@STR_RW_TAUX10@0x02500000@ */ ECIPP_ALIGNMENT_UBYTE 255 Compu_ECIPP_STRINGS 0 255 MATRIX_DIM 29 1 1 /end CHARACTERISTIC
/begin CHARACTERISTIC STR_RW_TAUX11 "Aux Temp11" ASCII 0x001C8BE3 /* @ECU_Address@STR_RW_TAUX11@0x02501000@ */ ECIPP_ALIGNMENT_UBYTE 255 Compu_ECIPP_STRINGS 0 255 MATRIX_DIM 29 1 1 /end CHARACTERISTIC
/begin CHARACTERISTIC STR_RW_TAUX12 "Aux Temp12" ASCII 0x001C8C01 /* @ECU_Address@STR_RW_TAUX12@0x02502000@ */ ECIPP_ALIGNMENT_UBYTE 255 Compu_ECIPP_STRINGS 0 255 MATRIX_DIM 29 1 1 /end CHARACTERISTIC
/begin CHARACTERISTIC STR_RW_TAUX13 "Aux Temp13" ASCII 0x001C8C1F /* @ECU_Address@STR_RW_TAUX13@0x02503000@ */ ECIPP_ALIGNMENT_UBYTE 255 Compu_ECIPP_STRINGS 0 255 MATRIX_DIM 29 1 1 /end CHARACTERISTIC
/begin CHARACTERISTIC STR_RW_TAUX14 "Aux Temp14" ASCII 0x001C8C3D /* @ECU_Address@STR_RW_TAUX14@0x02504000@ */ ECIPP_ALIGNMENT_UBYTE 255 Compu_ECIPP_STRINGS 0 255 MATRIX_DIM 29 1 1 /end CHARACTERISTIC
/begin CHARACTERISTIC STR_RW_TAUX15 "Aux Temp15" ASCII 0x001C8C5B /* @ECU_Address@STR_RW_TAUX15@0x02505000@ */ ECIPP_ALIGNMENT_UBYTE 255 Compu_ECIPP_STRINGS 0 255 MATRIX_DIM 29 1 1 /end CHARACTERISTIC
/begin CHARACTERISTIC STR_RW_TAUX16 "Aux Temp16" ASCII 0x001C8C79 /* @ECU_Address@STR_RW_TAUX16@0x02506000@ */ ECIPP_ALIGNMENT_UBYTE 255 Compu_ECIPP_STRINGS 0 255 MATRIX_DIM 29 1 1 /end CHARACTERISTIC
/begin CHARACTERISTIC STR_RW_TAUX17 "Aux Temp17" ASCII 0x001C8C97 /* @ECU_Address@STR_RW_TAUX17@0x02507000@ */ ECIPP_ALIGNMENT_UBYTE 255 Compu_ECIPP_STRINGS 0 255 MATRIX_DIM 29 1 1 /end CHARACTERISTIC
/begin CHARACTERISTIC STR_RW_TAUX18 "Aux Temp18" ASCII 0x001C8CB5 /* @ECU_Address@STR_RW_TAUX18@0x02508000@ */ ECIPP_ALIGNMENT_UBYTE 255 Compu_ECIPP_STRINGS 0 255 MATRIX_DIM 29 1 1 /end CHARACTERISTIC
/begin CHARACTERISTIC STR_RW_TAUX19 "Aux Temp19" ASCII 0x001C8CD3 /* @ECU_Address@STR_RW_TAUX19@0x02509000@ */ ECIPP_ALIGNMENT_UBYTE 255 Compu_ECIPP_STRINGS 0 255 MATRIX_DIM 29 1 1 /end CHARACTERISTIC
/begin CHARACTERISTIC STR_RW_TAUX20 "Aux Temp20" ASCII 0x001C8D0F /* @ECU_Address@STR_RW_TAUX20@0x0250A000@ */ ECIPP_ALIGNMENT_UBYTE 255 Compu_ECIPP_STRINGS 0 255 MATRIX_DIM 29 1 1 /end CHARACTERISTIC
/begin CHARACTERISTIC STR_RW_TAUX21 "Aux Temp21" ASCII 0x001C8D2D /* @ECU_Address@STR_RW_TAUX21@0x0250B000@ */ ECIPP_ALIGNMENT_UBYTE 255 Compu_ECIPP_STRINGS 0 255 MATRIX_DIM 29 1 1 /end CHARACTERISTIC
/begin CHARACTERISTIC STR_RW_TAUX22 "Aux Temp22" ASCII 0x001C8D4B /* @ECU_Address@STR_RW_TAUX22@0x0250C000@ */ ECIPP_ALIGNMENT_UBYTE 255 Compu_ECIPP_STRINGS 0 255 MATRIX_DIM 29 1 1 /end CHARACTERISTIC
/begin CHARACTERISTIC STR_RW_TAUX23 "Aux Temp23" ASCII 0x001C8D69 /* @ECU_Address@STR_RW_TAUX23@0x0250D000@ */ ECIPP_ALIGNMENT_UBYTE 255 Compu_ECIPP_STRINGS 0 255 MATRIX_DIM 29 1 1 /end CHARACTERISTIC
/begin CHARACTERISTIC STR_RW_TAUX24 "Aux Temp24" ASCII 0x001C8D87 /* @ECU_Address@STR_RW_TAUX24@0x0250E000@ */ ECIPP_ALIGNMENT_UBYTE 255 Compu_ECIPP_STRINGS 0 255 MATRIX_DIM 29 1 1 /end CHARACTERISTIC
/begin CHARACTERISTIC STR_RW_PAUX1 "Aux Pressure1" ASCII 0x001C89C7 /* @ECU_Address@STR_RW_PAUX1@0x0250F000@ */ ECIPP_ALIGNMENT_UBYTE 255 Compu_ECIPP_STRINGS 0 255 MATRIX_DIM 29 1 1 /end CHARACTERISTIC
/begin CHARACTERISTIC STR_RW_PAUX2 "Aux Pressure2" ASCII 0x001C8AB7 /* @ECU_Address@STR_RW_PAUX2@0x02510000@ */ ECIPP_ALIGNMENT_UBYTE 255 Compu_ECIPP_STRINGS 0 255 MATRIX_DIM 29 1 1 /end CHARACTERISTIC
/begin CHARACTERISTIC STR_RW_PAUX3 "Aux Pressure3" ASCII 0x001C8AD5 /* @ECU_Address@STR_RW_PAUX3@0x02511000@ */ ECIPP_ALIGNMENT_UBYTE 255 Compu_ECIPP_STRINGS 0 255 MATRIX_DIM 29 1 1 /end CHARACTERISTIC
/begin CHARACTERISTIC STR_RW_PAUX4 "Aux Pressure4" ASCII 0x001C8AF3 /* @ECU_Address@STR_RW_PAUX4@0x02512000@ */ ECIPP_ALIGNMENT_UBYTE 255 Compu_ECIPP_STRINGS 0 255 MATRIX_DIM 29 1 1 /end CHARACTERISTIC
/begin CHARACTERISTIC STR_RW_PAUX5 "Aux Pressure5" ASCII 0x001C8B11 /* @ECU_Address@STR_RW_PAUX5@0x02513000@ */ ECIPP_ALIGNMENT_UBYTE 255 Compu_ECIPP_STRINGS 0 255 MATRIX_DIM 29 1 1 /end CHARACTERISTIC
/begin CHARACTERISTIC STR_RW_PAUX6 "Aux Pressure6" ASCII 0x001C8B2F /* @ECU_Address@STR_RW_PAUX6@0x02514000@ */ ECIPP_ALIGNMENT_UBYTE 255 Compu_ECIPP_STRINGS 0 255 MATRIX_DIM 29 1 1 /end CHARACTERISTIC
/begin CHARACTERISTIC STR_RW_PAUX7 "Aux Pressure7" ASCII 0x001C8B4D /* @ECU_Address@STR_RW_PAUX7@0x02515000@ */ ECIPP_ALIGNMENT_UBYTE 255 Compu_ECIPP_STRINGS 0 255 MATRIX_DIM 29 1 1 /end CHARACTERISTIC
/begin CHARACTERISTIC STR_RW_PAUX8 "Aux Pressure8" ASCII 0x001C8B6B /* @ECU_Address@STR_RW_PAUX8@0x02516000@ */ ECIPP_ALIGNMENT_UBYTE 255 Compu_ECIPP_STRINGS 0 255 MATRIX_DIM 29 1 1 /end CHARACTERISTIC
/begin CHARACTERISTIC STR_RW_PAUX9 "Aux Pressure9" ASCII 0x001C8B89 /* @ECU_Address@STR_RW_PAUX9@0x02517000@ */ ECIPP_ALIGNMENT_UBYTE 255 Compu_ECIPP_STRINGS 0 255 MATRIX_DIM 29 1 1 /end CHARACTERISTIC
/begin CHARACTERISTIC STR_RW_PAUX10 "Aux Pressure10" ASCII 0x001C89E5 /* @ECU_Address@STR_RW_PAUX10@0x02518000@ */ ECIPP_ALIGNMENT_UBYTE 255 Compu_ECIPP_STRINGS 0 255 MATRIX_DIM 29 1 1 /end CHARACTERISTIC
/begin CHARACTERISTIC STR_RW_PAUX11 "Aux Pressure11" ASCII 0x001C8A03 /* @ECU_Address@STR_RW_PAUX11@0x02519000@ */ ECIPP_ALIGNMENT_UBYTE 255 Compu_ECIPP_STRINGS 0 255 MATRIX_DIM 29 1 1 /end CHARACTERISTIC
/begin CHARACTERISTIC STR_RW_PAUX12 "Aux Pressure12" ASCII 0x001C8A21 /* @ECU_Address@STR_RW_PAUX12@0x0251A000@ */ ECIPP_ALIGNMENT_UBYTE 255 Compu_ECIPP_STRINGS 0 255 MATRIX_DIM 29 1 1 /end CHARACTERISTIC
/begin CHARACTERISTIC STR_RW_PAUX13 "Aux Pressure13" ASCII 0x001C8A3F /* @ECU_Address@STR_RW_PAUX13@0x0251B000@ */ ECIPP_ALIGNMENT_UBYTE 255 Compu_ECIPP_STRINGS 0 255 MATRIX_DIM 29 1 1 /end CHARACTERISTIC
/begin CHARACTERISTIC STR_RW_PAUX14 "Aux Pressure14" ASCII 0x001C8A5D /* @ECU_Address@STR_RW_PAUX14@0x0251C000@ */ ECIPP_ALIGNMENT_UBYTE 255 Compu_ECIPP_STRINGS 0 255 MATRIX_DIM 29 1 1 /end CHARACTERISTIC
/begin CHARACTERISTIC STR_RW_PAUX15 "Aux Pressure15" ASCII 0x001C8A7B /* @ECU_Address@STR_RW_PAUX15@0x0251D000@ */ ECIPP_ALIGNMENT_UBYTE 255 Compu_ECIPP_STRINGS 0 255 MATRIX_DIM 29 1 1 /end CHARACTERISTIC
/begin CHARACTERISTIC STR_RW_PAUX16 "Aux Pressure16" ASCII 0x001C8A99 /* @ECU_Address@STR_RW_PAUX16@0x0251E000@ */ ECIPP_ALIGNMENT_UBYTE 255 Compu_ECIPP_STRINGS 0 255 MATRIX_DIM 29 1 1 /end CHARACTERISTIC
/begin CHARACTERISTIC STR_RM_UEGO1 "UEGO1" ASCII 0x001E8ADC /* @ECU_Address@STR_RM_UEGO1@0x02527000@ */ ECIPP_ALIGNMENT_UBYTE 255 Compu_ECIPP_STRINGS 0 255 MATRIX_DIM 29 1 1 /end CHARACTERISTIC
/begin CHARACTERISTIC STR_RM_UEGO2 "UEGO2" ASCII 0x001E8AFA /* @ECU_Address@STR_RM_UEGO2@0x02528000@ */ ECIPP_ALIGNMENT_UBYTE 255 Compu_ECIPP_STRINGS 0 255 MATRIX_DIM 29 1 1 /end CHARACTERISTIC
/begin CHARACTERISTIC STR_RM_UEGO3 "UEGO3" ASCII 0x001E8B18 /* @ECU_Address@STR_RM_UEGO3@0x02529000@ */ ECIPP_ALIGNMENT_UBYTE 255 Compu_ECIPP_STRINGS 0 255 MATRIX_DIM 29 1 1 /end CHARACTERISTIC
/begin CHARACTERISTIC STR_RM_UEGO4 "UEGO4" ASCII 0x001E8B36 /* @ECU_Address@STR_RM_UEGO4@0x0252A000@ */ ECIPP_ALIGNMENT_UBYTE 255 Compu_ECIPP_STRINGS 0 255 MATRIX_DIM 29 1 1 /end CHARACTERISTIC
/begin CHARACTERISTIC STR_RW_UEGO1 "UEGO1" ASCII 0x001E9694 /* @ECU_Address@STR_RW_UEGO1@0x0252B000@ */ ECIPP_ALIGNMENT_UBYTE 255 Compu_ECIPP_STRINGS 0 255 MATRIX_DIM 29 1 1 /end CHARACTERISTIC
/begin CHARACTERISTIC STR_RW_UEGO2 "UEGO2" ASCII 0x001E96B2 /* @ECU_Address@STR_RW_UEGO2@0x0252C000@ */ ECIPP_ALIGNMENT_UBYTE 255 Compu_ECIPP_STRINGS 0 255 MATRIX_DIM 29 1 1 /end CHARACTERISTIC
/begin CHARACTERISTIC STR_RW_UEGO3 "UEGO3" ASCII 0x001E96D0 /* @ECU_Address@STR_RW_UEGO3@0x0252D000@ */ ECIPP_ALIGNMENT_UBYTE 255 Compu_ECIPP_STRINGS 0 255 MATRIX_DIM 29 1 1 /end CHARACTERISTIC
/begin CHARACTERISTIC STR_RW_UEGO4 "UEGO4" ASCII 0x001E96EE /* @ECU_Address@STR_RW_UEGO4@0x0252E000@ */ ECIPP_ALIGNMENT_UBYTE 255 Compu_ECIPP_STRINGS 0 255 MATRIX_DIM 29 1 1 /end CHARACTERISTIC
/begin COMPU_METHOD Compu_TKNK_FSO_exit_mdot " " RAT_FUNC "%.2" "Fuel flow(g/s)" COEFFS 0 1 0 0 0 1 /end COMPU_METHOD
/begin CHARACTERISTIC TKNK_FSO_exit_tau "Knock FSO exit tau" CURVE 0x001C3C38 /* @ECU_Address@TKNK_FSO_exit_tau@0x0259C000@ */ ECIPP_ALIGNMENT_FLOAT32_IEEE 10000000000 Compu_TKNK_FSO_exit_tau -10000000000 10000000000
 /begin AXIS_DESCR COM_AXIS NO_INPUT_QUANTITY Compu_TKNK_FSO_exit_mdot 4 -10000000000 10000000000 AXIS_PTS_REF TKNK_FSO_exit_mdot /end AXIS_DESCR
/end CHARACTERISTIC
/begin AXIS_PTS TKNK_FSO_exit_mdot " " 0x001C3C28 /* @ECU_Address@TKNK_FSO_exit_mdot@0x0259B000@ */ NO_INPUT_QUANTITY ECIPP_Lookup_FLOAT32_IEEE 0 Compu_TKNK_FSO_exit_mdot 4 -10000000000 10000000000 /end AXIS_PTS
/begin COMPU_METHOD Compu_TKNK_FSO_exit_tau " " RAT_FUNC "%.1" "Tau (ms)" COEFFS 0 1000 0 0 0 1 /end COMPU_METHOD
/begin MEASUREMENT HstSL_expTbl "Speed-Load Histogram" ULONG Compu_HstSL_expTbl 0 0 0 59652.3235416667 ECU_ADDRESS 0x025AC000 MATRIX_DIM 72 1 1 /end MEASUREMENT
/begin COMPU_METHOD Compu_HstSL_expTbl " " RAT_FUNC "%.3" "Operating Time (hours)" COEFFS 0 72000 0 0 0 1 /end COMPU_METHOD
/begin CHARACTERISTIC STR_RM_EGOH1 "EGOH1" ASCII 0x001E8488 /* @ECU_Address@STR_RM_EGOH1@0x025AF000@ */ ECIPP_ALIGNMENT_UBYTE 255 Compu_ECIPP_STRINGS 0 255 MATRIX_DIM 29 1 1 /end CHARACTERISTIC
/begin CHARACTERISTIC STR_RM_EGOH2 "EGOH2" ASCII 0x001E84A6 /* @ECU_Address@STR_RM_EGOH2@0x025B0000@ */ ECIPP_ALIGNMENT_UBYTE 255 Compu_ECIPP_STRINGS 0 255 MATRIX_DIM 29 1 1 /end CHARACTERISTIC
/begin CHARACTERISTIC STR_RM_EGOH3 "EGOH3" ASCII 0x001E84C4 /* @ECU_Address@STR_RM_EGOH3@0x025B1000@ */ ECIPP_ALIGNMENT_UBYTE 255 Compu_ECIPP_STRINGS 0 255 MATRIX_DIM 29 1 1 /end CHARACTERISTIC
/begin CHARACTERISTIC STR_RM_EGOH4 "EGOH4" ASCII 0x001E84E2 /* @ECU_Address@STR_RM_EGOH4@0x025B2000@ */ ECIPP_ALIGNMENT_UBYTE 255 Compu_ECIPP_STRINGS 0 255 MATRIX_DIM 29 1 1 /end CHARACTERISTIC
/begin CHARACTERISTIC STR_RW_EGOH1 "EGOH1" ASCII 0x001E94F0 /* @ECU_Address@STR_RW_EGOH1@0x025B3000@ */ ECIPP_ALIGNMENT_UBYTE 255 Compu_ECIPP_STRINGS 0 255 MATRIX_DIM 29 1 1 /end CHARACTERISTIC
/begin CHARACTERISTIC STR_RW_EGOH2 "EGOH2" ASCII 0x001E950E /* @ECU_Address@STR_RW_EGOH2@0x025B4000@ */ ECIPP_ALIGNMENT_UBYTE 255 Compu_ECIPP_STRINGS 0 255 MATRIX_DIM 29 1 1 /end CHARACTERISTIC
/begin CHARACTERISTIC STR_RW_EGOH3 "EGOH3" ASCII 0x001E952C /* @ECU_Address@STR_RW_EGOH3@0x025B5000@ */ ECIPP_ALIGNMENT_UBYTE 255 Compu_ECIPP_STRINGS 0 255 MATRIX_DIM 29 1 1 /end CHARACTERISTIC
/begin CHARACTERISTIC STR_RW_EGOH4 "EGOH4" ASCII 0x001E954A /* @ECU_Address@STR_RW_EGOH4@0x025B6000@ */ ECIPP_ALIGNMENT_UBYTE 255 Compu_ECIPP_STRINGS 0 255 MATRIX_DIM 29 1 1 /end CHARACTERISTIC
/begin COMPU_METHOD Compu_TDIL_pct_oct_xaxis " " RAT_FUNC "%.1" "SI: MAP load (psia), Diesel: Fuel load (mg/cyl)" COEFFS 0 1 0 0 0 1 /end COMPU_METHOD
/begin COMPU_METHOD Compu_TDIL_pct_oct_rpm " " RAT_FUNC "%.0" "Speed (rpm)" COEFFS 0 1 0 0 0 1 /end COMPU_METHOD
/begin CHARACTERISTIC TDIL_pct_oct_ofst "EGR Octane Adaptation Diluent Offset (%)" MAP 0x001C04C6 /* @ECU_Address@TDIL_pct_oct_ofst@0x02626000@ */ ECIPP_ALIGNMENT_SWORD 200 Compu_TDIL_pct_oct_ofst -200 199.993896484375
 /begin AXIS_DESCR COM_AXIS NO_INPUT_QUANTITY Compu_TDIL_pct_oct_xaxis 8 -10000000000 10000000000 AXIS_PTS_REF TDIL_pct_oct_xaxis /end AXIS_DESCR
 /begin AXIS_DESCR COM_AXIS NO_INPUT_QUANTITY Compu_TDIL_pct_oct_rpm 8 -32768 32767 AXIS_PTS_REF TDIL_pct_oct_rpm /end AXIS_DESCR
/end CHARACTERISTIC
/begin AXIS_PTS TDIL_pct_oct_xaxis " " 0x001C00B8 /* @ECU_Address@TDIL_pct_oct_xaxis@0x02624000@ */ NO_INPUT_QUANTITY ECIPP_Lookup_FLOAT32_IEEE 0 Compu_TDIL_pct_oct_xaxis 8 -10000000000 10000000000 /end AXIS_PTS
/begin AXIS_PTS TDIL_pct_oct_rpm " " 0x001C0546 /* @ECU_Address@TDIL_pct_oct_rpm@0x02625000@ */ NO_INPUT_QUANTITY ECIPP_Lookup_SWORD 0 Compu_TDIL_pct_oct_rpm 8 -32768 32767 /end AXIS_PTS
/begin COMPU_METHOD Compu_TDIL_pct_oct_ofst "" RAT_FUNC "%.1" "EGR Octane Adaptation Diluent Offset (%)" COEFFS 0 163.84 0 0 0 1 /end COMPU_METHOD
/begin CHARACTERISTIC TEGR_spkret_oct_ofst "EGR Octane Adaptation Spark Retard (CAD)" MAP 0x001C07BE /* @ECU_Address@TEGR_spkret_oct_ofst@0x02627000@ */ ECIPP_ALIGNMENT_SWORD 2048 Compu_TEGR_spkret_oct_ofst -2048 2047.9375
 /begin AXIS_DESCR COM_AXIS NO_INPUT_QUANTITY Compu_TDIL_pct_oct_xaxis 8 -10000000000 10000000000 AXIS_PTS_REF TDIL_pct_oct_xaxis /end AXIS_DESCR
 /begin AXIS_DESCR COM_AXIS NO_INPUT_QUANTITY Compu_TDIL_pct_oct_rpm 8 -32768 32767 AXIS_PTS_REF TDIL_pct_oct_rpm /end AXIS_DESCR
/end CHARACTERISTIC
/begin COMPU_METHOD Compu_TEGR_spkret_oct_ofst "" RAT_FUNC "%.1" "EGR Octane Adaptation Spark Retard (CAD)" COEFFS 0 16 0 0 0 1 /end COMPU_METHOD
/begin CHARACTERISTIC STR_RW_CAM2 "Cam2" ASCII 0x001E94D2 /* @ECU_Address@STR_RW_CAM2@0x02633000@ */ ECIPP_ALIGNMENT_UBYTE 255 Compu_ECIPP_STRINGS 0 255 MATRIX_DIM 29 1 1 /end CHARACTERISTIC
/begin CHARACTERISTIC STR_RM_CAM2 "Cam2" ASCII 0x001E846A /* @ECU_Address@STR_RM_CAM2@0x02634000@ */ ECIPP_ALIGNMENT_UBYTE 255 Compu_ECIPP_STRINGS 0 255 MATRIX_DIM 29 1 1 /end CHARACTERISTIC
/begin MEASUREMENT SparkKV_BO "Spark KV BO Cyl1" UWORD Compu_SparkKV_BO 0 0 0 65.535 ECU_ADDRESS 0x02699000 MATRIX_DIM 12 1 1 /end MEASUREMENT
/begin COMPU_METHOD Compu_SparkKV_BO " " RAT_FUNC "%.1" "KV" COEFFS 0 1000 0 0 0 1 /end COMPU_METHOD
/begin GROUP EC_IOMap "ECONTROLS" ROOT
 /begin REF_CHARACTERISTIC STR_RM_AUX_PU1 STR_RM_AUX_PU2 STR_RM_AUX_PU3 STR_RM_AUX_PD1 STR_RM_AUX_PD2 STR_RM_AUX_PD3 STR_RM_AUX_PUD1 STR_RM_AUX_PUD2 STR_RM_AUX_PUD3 STR_RM_AUX_PUD4 STR_RM_AUX_PUD5 STR_RM_AUX_PUD6 STR_RM_AUX_PUD7 STR_RM_AUX_PUD8 STR_RM_AUX_PUD9 STR_RM_AUX_PUD10 STR_RM_AUX_PUD11 STR_RM_AUX_PUD12 STR_RM_AUX_PUD13 STR_RM_AUX_PUD14 STR_RM_AUX_PUD15 STR_RM_AUX_PUD16 STR_RM_AUX_PUD17 STR_RM_AUX_PUD18 STR_RM_AUX_PUD19 STR_RM_AUX_PUD20 STR_RM_AUX_PUD21 STR_RM_AUX_PUD22 STR_RM_AUX_PUD23 STR_RM_AUX_PUD24 STR_RM_AUX_PUD25 STR_RM_AUX_DIG1 STR_RM_AUX_DIG2 STR_RM_AUX_DIG3 STR_RM_AUX_DIG4 STR_RM_AUX_DIG5 STR_RM_AUX_DIG6 STR_RM_AUX_DIG7 STR_RM_AUX_DIG8 STR_RM_AUX_DIG9 STR_RM_AUX_DIG10 STR_RM_AUX_DIG11 STR_RM_AUX_DIG12 STR_RM_AUX_DIG13 STR_RM_AUX_DIG14 STR_RM_AUX_DIG15 STR_RM_AUX_DIG16 STR_RM_AUX_DIG17 STR_RM_AUX_DIG18 STR_RM_AUX_DIG19 STR_RM_AUX_DIG20 STR_RM_AUX_DIG21 STR_RM_AUX_DIG22 STR_RM_AUX_DIG23 STR_RM_AUX_DIG24 STR_RM_AUX_DIG25 STR_RM_AUX_PWM1 STR_RM_AUX_PWM2 STR_RM_AUX_PWM3 STR_RM_AUX_PWM4 STR_RM_AUX_PWM5 STR_RM_AUX_PWM6 STR_RM_AUX_PWM7 STR_RM_AUX_PWM8 STR_RM_AUX_PWM9 STR_RM_AUX_PWM10 STR_RM_AUX_PWM11 STR_RM_AUX_PWM12 STR_RM_AUX_PWM13 STR_RM_AUX_PWM14 STR_RM_AUX_PWM15 STR_RM_AUX_PWM16 STR_RM_AUX_PWM17 STR_RM_AUX_PWM18 STR_RM_AUX_PWM19 STR_RM_AUX_PWM20 STR_RM_AUX_PWM21 STR_RM_AUX_PWM22 STR_RM_AUX_PWM23 STR_RM_AUX_PWM24 STR_RM_AUX_PWM25 STR_RW_AUX_PU1 STR_RW_AUX_PU2 STR_RW_AUX_PU3 STR_RW_AUX_PD1 STR_RW_AUX_PD2 STR_RW_AUX_PD3 STR_RW_AUX_PUD1 STR_RW_AUX_PUD2 STR_RW_AUX_PUD3 STR_RW_AUX_PUD4 STR_RW_AUX_PUD5 STR_RW_AUX_PUD6 STR_RW_AUX_PUD7 STR_RW_AUX_PUD8 STR_RW_AUX_PUD9 STR_RW_AUX_PUD10 STR_RW_AUX_PUD11 STR_RW_AUX_PUD12 STR_RW_AUX_PUD13 STR_RW_AUX_PUD14 STR_RW_AUX_PUD15 STR_RW_AUX_PUD16 STR_RW_AUX_PUD17 STR_RW_AUX_PUD18 STR_RW_AUX_PUD19 STR_RW_AUX_PUD20 STR_RW_AUX_PUD21 STR_RW_AUX_PUD22 STR_RW_AUX_PUD23 STR_RW_AUX_PUD24 STR_RW_AUX_PUD25 STR_RW_AUX_DIG1 STR_RW_AUX_DIG2 STR_RW_AUX_DIG3 STR_RW_AUX_DIG4 STR_RW_AUX_DIG5 STR_RW_AUX_DIG6 STR_RW_AUX_DIG7 STR_RW_AUX_DIG8 STR_RW_AUX_DIG9 STR_RW_AUX_DIG10 STR_RW_AUX_DIG11 STR_RW_AUX_DIG12 STR_RW_AUX_DIG13 STR_RW_AUX_DIG14 STR_RW_AUX_DIG15 STR_RW_AUX_DIG16 STR_RW_AUX_DIG17 STR_RW_AUX_DIG18 STR_RW_AUX_DIG19 STR_RW_AUX_DIG20 STR_RW_AUX_DIG21 STR_RW_AUX_DIG22 STR_RW_AUX_DIG23 STR_RW_AUX_DIG24 STR_RW_AUX_DIG25 STR_RW_AUX_PWM1 STR_RW_AUX_PWM2 STR_RW_AUX_PWM3 STR_RW_AUX_PWM4 STR_RW_AUX_PWM5 STR_RW_AUX_PWM6 STR_RW_AUX_PWM7 STR_RW_AUX_PWM8 STR_RW_AUX_PWM9 STR_RW_AUX_PWM10 STR_RW_AUX_PWM11 STR_RW_AUX_PWM12 STR_RW_AUX_PWM13 STR_RW_AUX_PWM14 STR_RW_AUX_PWM15 STR_RW_AUX_PWM16 STR_RW_AUX_PWM17 STR_RW_AUX_PWM18 STR_RW_AUX_PWM19 STR_RW_AUX_PWM20 STR_RW_AUX_PWM21 STR_RW_AUX_PWM22 STR_RW_AUX_PWM23 STR_RW_AUX_PWM24 STR_RW_AUX_PWM25 STR_RM_TAUX1 STR_RM_TAUX2 STR_RM_TAUX3 STR_RM_TAUX4 STR_RM_TAUX5 STR_RM_TAUX6 STR_RM_TAUX7 STR_RM_TAUX8 STR_RM_TAUX9 STR_RM_TAUX10 STR_RM_TAUX11 STR_RM_TAUX12 STR_RM_TAUX13 STR_RM_TAUX14 STR_RM_TAUX15 STR_RM_TAUX16 STR_RM_TAUX17 STR_RM_TAUX18 STR_RM_TAUX19 STR_RM_TAUX20 STR_RM_TAUX21 STR_RM_TAUX22 STR_RM_TAUX23 STR_RM_TAUX24 STR_RM_PAUX1 STR_RM_PAUX2 STR_RM_PAUX3 STR_RM_PAUX4 STR_RM_PAUX5 STR_RM_PAUX6 STR_RM_PAUX7 STR_RM_PAUX8 STR_RM_PAUX9 STR_RM_PAUX10 STR_RM_PAUX11 STR_RM_PAUX12 STR_RM_PAUX13 STR_RM_PAUX14 STR_RM_PAUX15 STR_RM_PAUX16 STR_RW_TAUX1 STR_RW_TAUX2 STR_RW_TAUX3 STR_RW_TAUX4 STR_RW_TAUX5 STR_RW_TAUX6 STR_RW_TAUX7 STR_RW_TAUX8 STR_RW_TAUX9 STR_RW_TAUX10 STR_RW_TAUX11 STR_RW_TAUX12 STR_RW_TAUX13 STR_RW_TAUX14 STR_RW_TAUX15 STR_RW_TAUX16 STR_RW_TAUX17 STR_RW_TAUX18 STR_RW_TAUX19 STR_RW_TAUX20 STR_RW_TAUX21 STR_RW_TAUX22 STR_RW_TAUX23 STR_RW_TAUX24 STR_RW_PAUX1 STR_RW_PAUX2 STR_RW_PAUX3 STR_RW_PAUX4 STR_RW_PAUX5 STR_RW_PAUX6 STR_RW_PAUX7 STR_RW_PAUX8 STR_RW_PAUX9 STR_RW_PAUX10 STR_RW_PAUX11 STR_RW_PAUX12 STR_RW_PAUX13 STR_RW_PAUX14 STR_RW_PAUX15 STR_RW_PAUX16 STR_RM_UEGO1 STR_RM_UEGO2 STR_RM_UEGO3 STR_RM_UEGO4 STR_RW_UEGO1 STR_RW_UEGO2 STR_RW_UEGO3 STR_RW_UEGO4 STR_RM_EGOH1 STR_RM_EGOH2 STR_RM_EGOH3 STR_RM_EGOH4 STR_RW_EGOH1 STR_RW_EGOH2 STR_RW_EGOH3 STR_RW_EGOH4 STR_RW_CAM2 STR_RM_CAM2 /end REF_CHARACTERISTIC
/end GROUP
/begin GROUP EC_Knock "ECONTROLS" ROOT
 /begin REF_CHARACTERISTIC KNK_enable KNK_ret_K KNK_adv_K KNK_val_trig KNK_val_cycles KNK_ECT_ena KNK_min_MAP KNK_max_RPM KNK_BPF KNK_sens_cyl1 KNK_sens_cyl2 KNK_sens_cyl3 KNK_sens_cyl4 KNK_sens_cyl5 KNK_sens_cyl6 KNK_sens_cyl7 KNK_sens_cyl8 KNK_BPF_delay KNK_sig_pweight spk_ofst_maxadv OCT_init OCT_ret_increase OCT_ret_decrease OCT_slew_inc OCT_slew_dec OCT_update_wait OCT_MAPss_win OCT_RPMss_win OCT_ss_tau OCT_run_wait OCT_ECT_ena OCT_min_MAP OCT_max_MAP OCT_min_RPM OCT_max_RPM OCT_init_mode FKNK_ena FKNK_ret_start FKNK_ret_max FKNK_enrich_max FKNK_enr_inc_tau FKNK_enr_dec_tau KNK_adv_KRreti KNK_adv_KRretc KNK_adv_KRmin OCT_mem_type OCT_inc_wait OCT_inc_wait_pct KNK_Ksel KNK_sens_cyl9 KNK_sens_cyl10 OCT_init_table KNK_mult_cyl1 KNK_mult_cyl2 KNK_mult_cyl3 KNK_mult_cyl4 KNK_mult_cyl5 KNK_mult_cyl6 KNK_mult_cyl7 KNK_mult_cyl8 KNK_mult_cyl9 KNK_mult_cyl10 KNK_tbl_cyl1 KNK_tbl_cyl2 KNK_tbl_cyl3 KNK_tbl_cyl4 KNK_tbl_cyl5 KNK_tbl_cyl6 KNK_tbl_cyl7 KNK_tbl_cyl8 KNK_tbl_cyl9 KNK_tbl_cyl10 OCT_tbl_store_EE KNK_FSO_disabled_tm KNK_CWT_mult KNK_FSO_debounce KNK_FSO_win_tm KNK_FSO_win_peak_tau KNK_FSO_min_mdot OCT_gsln_alt_tbl OCT_gsln_ena OCT_LP_alt_tbl OCT_LP_ena OCT_NG_alt_tbl OCT_NG_ena OCT_phi_gsln_alt_tbl OCT_phi_gsln_ena OCT_phi_LP_alt_tbl OCT_phi_LP_ena OCT_phi_NG_alt_tbl OCT_phi_NG_ena EGR_oct_ena EGR_oct_lim EGR_oct_lim_mode EGR_oct_LL_tau_dec EGR_oct_LL_tau_inc OCT_slew_dec_max OCT_slew_inc_ss OCT_dec_knkpctinc_dz OCT_dec_tm OCT_slew_dec_Kd KNK_MAP_mode OCT_slew_dec_Kd_max KNK_min_mode KNK_sens_cyl11 KNK_sens_cyl12 KNK_tbl_cyl11 KNK_tbl_cyl12 KNK_mult_cyl11 KNK_mult_cyl12 TKNK_start TKNK_dur TKNK_100V TKNK_0V TKNK_ret_max TKNKbg_start TKNKbg_dur TKNK_dur_AltA TKNK_dur_AltB TKNKbg_dur_AltA TKNKbg_dur_AltB TKNK_start_AltA TKNK_start_AltB TKNKbg_start_AltA TKNKbg_start_AltB TKNK_mult_AltA TKNK_mult_AltB TKNK_mult TKNK_FSO_exit_tau TDIL_pct_oct_ofst TEGR_spkret_oct_ofst /end REF_CHARACTERISTIC
 /begin REF_MEASUREMENT spk_adv_base spk_off_ECTvL spk_off_MATvL spk_off_ECT KNK_sig_pavg spk_ret_CWT KNK_pct_latch KNK_pct_avg KNK_pct_max KNK_pct_min KNK_win_dur KNK_win_start KNK_manual KNK_100_V KNK_0_V KNK_ret_max KCYC_enable KNK_SW_gain KNK_bg_dur KNK_bg_start KNK_win_avg OCT_update_tmr OCT_MAPss OCT_RPMss spk_adv_altOCT spk_adv_OCTcomp FKNK_enrich_mod OCT_inc_tmr KNK2_win_avg coil1_adv_mod coil2_adv_mod coil3_adv_mod coil4_adv_mod coil5_adv_mod coil6_adv_mod coil7_adv_mod coil8_adv_mod coil9_adv_mod coil10_adv_mod KNK_bg_cyl1 KNK_bg_cyl2 KNK_bg_cyl3 KNK_bg_cyl4 KNK_bg_cyl5 KNK_bg_cyl6 KNK_bg_cyl7 KNK_bg_cyl8 KNK_bg_cyl9 KNK_bg_cyl10 KNK_win_cyl1 KNK_win_cyl2 KNK_win_cyl3 KNK_win_cyl4 KNK_win_cyl5 KNK_win_cyl6 KNK_win_cyl7 KNK_win_cyl8 KNK_win_cyl9 KNK_win_cyl10 KNK_sig_cyl1 KNK_sig_cyl2 KNK_sig_cyl3 KNK_sig_cyl4 KNK_sig_cyl5 KNK_sig_cyl6 KNK_sig_cyl7 KNK_sig_cyl8 KNK_sig_cyl9 KNK_sig_cyl10 KNK_bg_dur_AltA KNK_bg_dur_AltB KNK_bg_start_AltA KNK_bg_start_AltB KNK_win_dur_AltA KNK_win_dur_AltB KNK_win_start_AltA KNK_win_start_AltB KNK_mult KNK_mult_AltA KNK_mult_AltB KNK_CWT_100_V KNK_CWT_0_V KNK_FSO_disabled KNK_FSO_0_V KNK_FSO_100_V KNK3_win_avg EGR_oct_LL_pct_raw OCT_slew_dec_cur KNK_ret_pctinc_max OCT_adapt_reset OCT_slew_inc_mode KNK_raw_avg KNK2_raw_avg KNK3_raw_avg KNK4_win_avg KNK5_win_avg KNK6_win_avg KNK7_win_avg KNK8_win_avg KNK9_win_avg KNK10_win_avg KNK11_win_avg KNK12_win_avg KNK4_raw_avg KNK5_raw_avg KNK6_raw_avg KNK7_raw_avg KNK8_raw_avg KNK9_raw_avg KNK10_raw_avg KNK11_raw_avg KNK12_raw_avg KNK_control_status KNK_bg_cyl11 KNK_bg_cyl12 KNK_win_cyl11 KNK_win_cyl12 KNK_sig_cyl11 KNK_sig_cyl12 coil11_adv_mod coil12_adv_mod KNK_sampling_enabled /end REF_MEASUREMENT
/end GROUP
/begin GROUP EC_LDService "ECONTROLS" ROOT
 /begin REF_MEASUREMENT TSTcompression MSinj_kill MSspk_kill MSinj_fire MScompression MSspk_fire MSDBW_test MSmanual_ext_pwr TSTspk_fire TSTinj_fire AL_erase_req TransCrk_dis ECTHst_max ECTHst_hi_HM EPR_DC_act crank_LFP_Ptgt_LED ECTHst_Tbl /end REF_MEASUREMENT
/end GROUP
/begin GROUP EC_LEService "ECONTROLS" ROOT
 /begin REF_CHARACTERISTIC STR_RW_TAUX1 STR_RW_TAUX2 STR_RW_TAUX3 STR_RW_TAUX4 STR_RW_TAUX5 STR_RW_PAUX1 STR_RW_PAUX2 STR_RW_PAUX3 STR_RW_PAUX4 STR_RW_PAUX5 /end REF_CHARACTERISTIC
 /begin REF_MEASUREMENT AL_erase_req TransCrk_dis coil1_drv_latch coil2_drv_latch coil3_drv_latch coil4_drv_latch coil5_drv_latch coil6_drv_latch coil7_drv_latch coil8_drv_latch coil9_drv_latch coil10_drv_latch OILT ECTHst_max ECTHst_hi_HM MFG_status MFG_mdot_cmd_pct MFG_mdot_cmd MFG_TPS_act_pct MFG_TPS_cmd_pct MFG_FTemp MFG_USPress MFG_DSPress MFG_DPPress EPR_DC_act TANK_1_V TANK_2_V TANK_ADCnts_final SPOCK_ECM1_LED SparkKV_filt_avg coil11_drv_latch coil12_drv_latch ESD_Sw_state IGN_DIS_Sw_state CAN1_speed_latch CAN2_speed_latch CAN3_speed_latch KNKHst_Tbl SPK_IGBT_T ECTHst_Tbl HstSL_expTbl SparkKV_BO /end REF_MEASUREMENT
/end GROUP
/begin GROUP EC_Megajector "ECONTROLS" ROOT
 /begin REF_MEASUREMENT MFG_status MFG_mdot_cmd_pct MFG_mdot_cmd MFG_TPS_act_pct MFG_TPS_cmd_pct MFG_FTemp MFG_USPress MFG_DSPress MFG_DPPress EPR_DC_act /end REF_MEASUREMENT
/end GROUP
/begin GROUP EC_Misfire "ECONTROLS" ROOT /begin REF_MEASUREMENT MSinj_kill MSspk_kill /end REF_MEASUREMENT /end GROUP
/begin GROUP EC_Outputs "ECONTROLS" ROOT /begin REF_MEASUREMENT TransCrk_dis crank_LFP_Ptgt_LED /end REF_MEASUREMENT /end GROUP
/begin GROUP EC_PhiGsln "ECONTROLS" ROOT /begin REF_MEASUREMENT FKNK_enrich_mod /end REF_MEASUREMENT /end GROUP
/begin GROUP EC_Service "ECONTROLS" ROOT /begin REF_MEASUREMENT ECTHst_max ECTHst_hi_HM KNKHst_Tbl ECTHst_Tbl HstSL_expTbl /end REF_MEASUREMENT /end GROUP
/begin GROUP EC_Service1 "ECONTROLS" ROOT /begin REF_MEASUREMENT AL_erase_req /end REF_MEASUREMENT /end GROUP
/begin GROUP EC_Service2 "ECONTROLS" ROOT /begin REF_MEASUREMENT AL_erase_req /end REF_MEASUREMENT /end GROUP
/begin GROUP EC_SparkCal "ECONTROLS" ROOT /begin REF_CHARACTERISTIC KNK_enable /end REF_CHARACTERISTIC
 /begin REF_MEASUREMENT spk_adv_base spk_off_ECTvL spk_off_MATvL spk_off_ECT KNK_sig_pavg spk_ret_CWT KNK_pct_latch KNK_pct_avg spk_adv_altOCT spk_adv_OCTcomp coil1_drv_latch coil2_drv_latch coil3_drv_latch coil4_drv_latch coil5_drv_latch coil6_drv_latch coil7_drv_latch coil8_drv_latch coil9_drv_latch coil10_drv_latch KNK_control_status coil11_drv_latch coil12_drv_latch SPK_IGBT_T /end REF_MEASUREMENT
/end GROUP
/begin GROUP EC_SparkCalLP "ECONTROLS" ROOT
 /begin REF_MEASUREMENT spk_adv_base spk_off_ECTvL spk_off_MATvL spk_off_ECT spk_ret_CWT spk_adv_altOCT spk_adv_OCTcomp /end REF_MEASUREMENT
/end GROUP
/begin GROUP EC_SparkCalNG "ECONTROLS" ROOT
 /begin REF_MEASUREMENT spk_adv_base spk_off_ECTvL spk_off_MATvL spk_off_ECT spk_ret_CWT spk_adv_altOCT spk_adv_OCTcomp /end REF_MEASUREMENT
/end GROUP
/begin GROUP EC_SparkCD "ECONTROLS" ROOT
 /begin REF_MEASUREMENT TANK_1_V TANK_2_V TANK_ADCnts_final SPOCK_ECM1_LED SparkKV_filt_avg ESD_Sw_state IGN_DIS_Sw_state SparkKV_BO /end REF_MEASUREMENT
/end GROUP
/begin GROUP EC_SparkOfst "ECONTROLS" ROOT
 /begin REF_MEASUREMENT spk_adv_base spk_off_ECTvL spk_off_MATvL spk_off_ECT spk_ret_CWT spk_adv_altOCT spk_adv_OCTcomp /end REF_MEASUREMENT
/end GROUP
/begin GROUP EC_Tests "ECONTROLS" ROOT
 /begin REF_MEASUREMENT TSTcompression MSinj_kill MSspk_kill MSinj_fire MScompression MSspk_fire MSDBW_test MSmanual_ext_pwr TSTspk_fire TSTinj_fire /end REF_MEASUREMENT
/end GROUP
/begin GROUP EC_TranCal "ECONTROLS" ROOT /begin REF_MEASUREMENT OILT /end REF_MEASUREMENT /end GROUP
/end MODULE
/end PROJECT
