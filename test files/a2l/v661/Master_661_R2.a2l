ASAP2_VERSION 1 61
/begin PROJECT Econtrols_4G "4G Test"
/begin HEADER "4G A2L Configuration" PROJECT_NO EControls4G /* config for version control */ VERSION "$Revision: 82130 $:" /* config for version control */ /end HEADER
/begin MODULE EControls_4G_SH2A "EControls 4G"
/begin MOD_COMMON "" DEPOSIT ABSOLUTE BYTE_ORDER MSB_FIRST /end MOD_COMMON
/* Define the Record Layouts */
/begin RECORD_LAYOUT ECIPP_ALIGNMENT_UBYTE FNC_VALUES 1 UBYTE COLUMN_DIR DIRECT /end RECORD_LAYOUT
/begin RECORD_LAYOUT ECIPP_ALIGNMENT_SBYTE FNC_VALUES 1 SBYTE COLUMN_DIR DIRECT /end RECORD_LAYOUT
/begin RECORD_LAYOUT ECIPP_ALIGNMENT_UWORD FNC_VALUES 1 UWORD COLUMN_DIR DIRECT /end RECORD_LAYOUT
/begin RECORD_LAYOUT ECIPP_ALIGNMENT_SWORD FNC_VALUES 1 SWORD COLUMN_DIR DIRECT /end RECORD_LAYOUT
/begin RECORD_LAYOUT ECIPP_ALIGNMENT_ULONG FNC_VALUES 1 ULONG COLUMN_DIR DIRECT /end RECORD_LAYOUT
/begin RECORD_LAYOUT ECIPP_ALIGNMENT_FLOAT32_IEEE FNC_VALUES 1 FLOAT32_IEEE COLUMN_DIR DIRECT /end RECORD_LAYOUT
/begin CHARACTERISTIC ERWT2_Taux_cal "{ERWT2_Taux_cal&0xff=0:Fuel source}{ERWT2_Taux_cal&0xff=1:Exhaust manifold/riser}{ERWT2_Taux_cal&0xff=2:Aux Temp A}{ERWT2_Taux_cal&0xff=3:Aux Temp B}{ERWT2_Taux_cal&0xff=4:Aux Temp C}{ERWT2_Taux_cal&0xff=5:Aux Temp D}" VALUE 0x001c86ec /* @ECU_Address@ERWT2_Taux_cal@0x01009500@ */ ECIPP_ALIGNMENT_UBYTE 255 ERWT2_Taux_cal_COMPU_VTAB 0 255 BIT_MASK 0xff /end CHARACTERISTIC
/begin COMPU_METHOD ERWT2_Taux_cal_COMPU_VTAB "Verbal Table" TAB_VERB "%.0" "list" COMPU_TAB_REF ERWT2_Taux_cal_COMPU_VTAB_REF /end COMPU_METHOD
/begin COMPU_VTAB ERWT2_Taux_cal_COMPU_VTAB_REF "Verbal Table" TAB_VERB 6 0 "Fuel source" 1 "Exhaust manifold/riser" 2 "Aux Temp A" 3 "Aux Temp B" 4 "Aux Temp C" 5 "Aux Temp D" DEFAULT_VALUE "UNKNOWN" /end COMPU_VTAB
/begin CHARACTERISTIC FST_Taux_cal "{FST_Taux_cal&0xff=0:Fuel source}{FST_Taux_cal&0xff=1:Exhaust manifold/riser}{FST_Taux_cal&0xff=2:Aux Temp A}{FST_Taux_cal&0xff=3:Aux Temp B}{FST_Taux_cal&0xff=4:Aux Temp C}{FST_Taux_cal&0xff=5:Aux Temp D}" VALUE 0x001c873d /* @ECU_Address@FST_Taux_cal@0x01009508@ */ ECIPP_ALIGNMENT_UBYTE 255 FST_Taux_cal_COMPU_VTAB 0 255 BIT_MASK 0xff /end CHARACTERISTIC
/begin COMPU_METHOD FST_Taux_cal_COMPU_VTAB "Verbal Table" TAB_VERB "%.0" "list" COMPU_TAB_REF FST_Taux_cal_COMPU_VTAB_REF /end COMPU_METHOD
/begin COMPU_VTAB FST_Taux_cal_COMPU_VTAB_REF "Verbal Table" TAB_VERB 6 0 "Fuel source" 1 "Exhaust manifold/riser" 2 "Aux Temp A" 3 "Aux Temp B" 4 "Aux Temp C" 5 "Aux Temp D" DEFAULT_VALUE "UNKNOWN" /end COMPU_VTAB
/begin CHARACTERISTIC PauxA_abs_gage "{PauxA_abs_gage&0xff=0:(psia)}{PauxA_abs_gage&0xff=1:(psig)}" VALUE 0x001c88ad /* @ECU_Address@PauxA_abs_gage@0x01009510@ */ ECIPP_ALIGNMENT_UBYTE 255 PauxA_abs_gage_COMPU_VTAB 0 255 BIT_MASK 0xff /end CHARACTERISTIC
/begin COMPU_METHOD PauxA_abs_gage_COMPU_VTAB "Verbal Table" TAB_VERB "%.0" "list" COMPU_TAB_REF PauxA_abs_gage_COMPU_VTAB_REF /end COMPU_METHOD
/begin COMPU_VTAB PauxA_abs_gage_COMPU_VTAB_REF "Verbal Table" TAB_VERB 2 0 "(psia)" 1 "(psig)" DEFAULT_VALUE "UNKNOWN" /end COMPU_VTAB
/begin CHARACTERISTIC PauxB_abs_gage "{PauxB_abs_gage&0xff=0:(psia)}{PauxB_abs_gage&0xff=1:(psig)}" VALUE 0x001c88ae /* @ECU_Address@PauxB_abs_gage@0x01009518@ */ ECIPP_ALIGNMENT_UBYTE 255 PauxB_abs_gage_COMPU_VTAB 0 255 BIT_MASK 0xff /end CHARACTERISTIC
/begin COMPU_METHOD PauxB_abs_gage_COMPU_VTAB "Verbal Table" TAB_VERB "%.0" "list" COMPU_TAB_REF PauxB_abs_gage_COMPU_VTAB_REF /end COMPU_METHOD
/begin COMPU_VTAB PauxB_abs_gage_COMPU_VTAB_REF "Verbal Table" TAB_VERB 2 0 "(psia)" 1 "(psig)" DEFAULT_VALUE "UNKNOWN" /end COMPU_VTAB
/begin CHARACTERISTIC PauxC_abs_gage "{PauxC_abs_gage&0xff=0:(psia)}{PauxC_abs_gage&0xff=1:(psig)}" VALUE 0x001c88af /* @ECU_Address@PauxC_abs_gage@0x01009520@ */ ECIPP_ALIGNMENT_UBYTE 255 PauxC_abs_gage_COMPU_VTAB 0 255 BIT_MASK 0xff /end CHARACTERISTIC
/begin COMPU_METHOD PauxC_abs_gage_COMPU_VTAB "Verbal Table" TAB_VERB "%.0" "list" COMPU_TAB_REF PauxC_abs_gage_COMPU_VTAB_REF /end COMPU_METHOD
/begin COMPU_VTAB PauxC_abs_gage_COMPU_VTAB_REF "Verbal Table" TAB_VERB 2 0 "(psia)" 1 "(psig)" DEFAULT_VALUE "UNKNOWN" /end COMPU_VTAB
/begin CHARACTERISTIC PauxD_abs_gage "{PauxD_abs_gage&0xff=0:(psia)}{PauxD_abs_gage&0xff=1:(psig)}" VALUE 0x001c88b0 /* @ECU_Address@PauxD_abs_gage@0x01009528@ */ ECIPP_ALIGNMENT_UBYTE 255 PauxD_abs_gage_COMPU_VTAB 0 255 BIT_MASK 0xff /end CHARACTERISTIC
/begin COMPU_METHOD PauxD_abs_gage_COMPU_VTAB "Verbal Table" TAB_VERB "%.0" "list" COMPU_TAB_REF PauxD_abs_gage_COMPU_VTAB_REF /end COMPU_METHOD
/begin COMPU_VTAB PauxD_abs_gage_COMPU_VTAB_REF "Verbal Table" TAB_VERB 2 0 "(psia)" 1 "(psig)" DEFAULT_VALUE "UNKNOWN" /end COMPU_VTAB
/begin CHARACTERISTIC EMP_Paux_cal "{EMP_Paux_cal&0xff=0:Aux Press A}{EMP_Paux_cal&0xff=1:Aux Press B}{EMP_Paux_cal&0xff=2:Aux Press C}{EMP_Paux_cal&0xff=3:Aux Press D}" VALUE 0x001c86e0 /* @ECU_Address@EMP_Paux_cal@0x01009530@ */ ECIPP_ALIGNMENT_UBYTE 255 EMP_Paux_cal_COMPU_VTAB 0 255 BIT_MASK 0xff /end CHARACTERISTIC
/begin COMPU_METHOD EMP_Paux_cal_COMPU_VTAB "Verbal Table" TAB_VERB "%.0" "list" COMPU_TAB_REF EMP_Paux_cal_COMPU_VTAB_REF /end COMPU_METHOD
/begin COMPU_VTAB EMP_Paux_cal_COMPU_VTAB_REF "Verbal Table" TAB_VERB 4 0 "Aux Press A" 1 "Aux Press B" 2 "Aux Press C" 3 "Aux Press D" DEFAULT_VALUE "UNKNOWN" /end COMPU_VTAB
/begin CHARACTERISTIC EGRdP_Paux_cal "{EGRdP_Paux_cal&0xff=0:Aux Press A}{EGRdP_Paux_cal&0xff=1:Aux Press B}{EGRdP_Paux_cal&0xff=2:Aux Press C}{EGRdP_Paux_cal&0xff=3:Aux Press D}" VALUE 0x001c0ab5 /* @ECU_Address@EGRdP_Paux_cal@0x01009538@ */ ECIPP_ALIGNMENT_UBYTE 255 EGRdP_Paux_cal_COMPU_VTAB 0 255 BIT_MASK 0xff /end CHARACTERISTIC
/begin COMPU_METHOD EGRdP_Paux_cal_COMPU_VTAB "Verbal Table" TAB_VERB "%.0" "list" COMPU_TAB_REF EGRdP_Paux_cal_COMPU_VTAB_REF /end COMPU_METHOD
/begin COMPU_VTAB EGRdP_Paux_cal_COMPU_VTAB_REF "Verbal Table" TAB_VERB 4 0 "Aux Press A" 1 "Aux Press B" 2 "Aux Press C" 3 "Aux Press D" DEFAULT_VALUE "UNKNOWN" /end COMPU_VTAB
/begin CHARACTERISTIC DPFdP_Paux_cal "{DPFdP_Paux_cal&0xff=0:Aux Press A}{DPFdP_Paux_cal&0xff=1:Aux Press B}{DPFdP_Paux_cal&0xff=2:Aux Press C}{DPFdP_Paux_cal&0xff=3:Aux Press D}" VALUE 0x001f1a7c /* @ECU_Address@DPFdP_Paux_cal@0x01009540@ */ ECIPP_ALIGNMENT_UBYTE 255 DPFdP_Paux_cal_COMPU_VTAB 0 255 BIT_MASK 0xff /end CHARACTERISTIC
/begin COMPU_METHOD DPFdP_Paux_cal_COMPU_VTAB "Verbal Table" TAB_VERB "%.0" "list" COMPU_TAB_REF DPFdP_Paux_cal_COMPU_VTAB_REF /end COMPU_METHOD
/begin COMPU_VTAB DPFdP_Paux_cal_COMPU_VTAB_REF "Verbal Table" TAB_VERB 4 0 "Aux Press A" 1 "Aux Press B" 2 "Aux Press C" 3 "Aux Press D" DEFAULT_VALUE "UNKNOWN" /end COMPU_VTAB
/begin CHARACTERISTIC PAUX1_Paux_cal "{PAUX1_Paux_cal&0xff=0:Aux Press A}{PAUX1_Paux_cal&0xff=1:Aux Press B}{PAUX1_Paux_cal&0xff=2:Aux Press C}{PAUX1_Paux_cal&0xff=3:Aux Press D}" VALUE 0x001C8877 /* @ECU_Address@PAUX1_Paux_cal@0x01009548@ */ ECIPP_ALIGNMENT_UBYTE 255 PAUX1_Paux_cal_COMPU_VTAB 0 255 BIT_MASK 0xff /end CHARACTERISTIC
/begin COMPU_METHOD PAUX1_Paux_cal_COMPU_VTAB "Verbal Table" TAB_VERB "%.0" "list" COMPU_TAB_REF PAUX1_Paux_cal_COMPU_VTAB_REF /end COMPU_METHOD
/begin COMPU_VTAB PAUX1_Paux_cal_COMPU_VTAB_REF "Verbal Table" TAB_VERB 4 0 "Aux Press A" 1 "Aux Press B" 2 "Aux Press C" 3 "Aux Press D" DEFAULT_VALUE "UNKNOWN" /end COMPU_VTAB
/begin CHARACTERISTIC PAUX2_Paux_cal "{PAUX2_Paux_cal&0xff=0:Aux Press A}{PAUX2_Paux_cal&0xff=1:Aux Press B}{PAUX2_Paux_cal&0xff=2:Aux Press C}{PAUX2_Paux_cal&0xff=3:Aux Press D}" VALUE 0x001C8878 /* @ECU_Address@PAUX2_Paux_cal@0x01009550@ */ ECIPP_ALIGNMENT_UBYTE 255 PAUX2_Paux_cal_COMPU_VTAB 0 255 BIT_MASK 0xff /end CHARACTERISTIC
/begin COMPU_METHOD PAUX2_Paux_cal_COMPU_VTAB "Verbal Table" TAB_VERB "%.0" "list" COMPU_TAB_REF PAUX2_Paux_cal_COMPU_VTAB_REF /end COMPU_METHOD
/begin COMPU_VTAB PAUX2_Paux_cal_COMPU_VTAB_REF "Verbal Table" TAB_VERB 4 0 "Aux Press A" 1 "Aux Press B" 2 "Aux Press C" 3 "Aux Press D" DEFAULT_VALUE "UNKNOWN" /end COMPU_VTAB
/begin CHARACTERISTIC PAUX3_Paux_cal "{PAUX3_Paux_cal&0xff=0:Aux Press A}{PAUX3_Paux_cal&0xff=1:Aux Press B}{PAUX3_Paux_cal&0xff=2:Aux Press C}{PAUX3_Paux_cal&0xff=3:Aux Press D}" VALUE 0x001C8879 /* @ECU_Address@PAUX3_Paux_cal@0x01009558@ */ ECIPP_ALIGNMENT_UBYTE 255 PAUX3_Paux_cal_COMPU_VTAB 0 255 BIT_MASK 0xff /end CHARACTERISTIC
/begin COMPU_METHOD PAUX3_Paux_cal_COMPU_VTAB "Verbal Table" TAB_VERB "%.0" "list" COMPU_TAB_REF PAUX3_Paux_cal_COMPU_VTAB_REF /end COMPU_METHOD
/begin COMPU_VTAB PAUX3_Paux_cal_COMPU_VTAB_REF "Verbal Table" TAB_VERB 4 0 "Aux Press A" 1 "Aux Press B" 2 "Aux Press C" 3 "Aux Press D" DEFAULT_VALUE "UNKNOWN" /end COMPU_VTAB
/begin CHARACTERISTIC PAUX4_Paux_cal "{PAUX4_Paux_cal&0xff=0:Aux Press A}{PAUX4_Paux_cal&0xff=1:Aux Press B}{PAUX4_Paux_cal&0xff=2:Aux Press C}{PAUX4_Paux_cal&0xff=3:Aux Press D}" VALUE 0x001C887A /* @ECU_Address@PAUX4_Paux_cal@0x01009560@ */ ECIPP_ALIGNMENT_UBYTE 255 PAUX4_Paux_cal_COMPU_VTAB 0 255 BIT_MASK 0xff /end CHARACTERISTIC
/begin COMPU_METHOD PAUX4_Paux_cal_COMPU_VTAB "Verbal Table" TAB_VERB "%.0" "list" COMPU_TAB_REF PAUX4_Paux_cal_COMPU_VTAB_REF /end COMPU_METHOD
/begin COMPU_VTAB PAUX4_Paux_cal_COMPU_VTAB_REF "Verbal Table" TAB_VERB 4 0 "Aux Press A" 1 "Aux Press B" 2 "Aux Press C" 3 "Aux Press D" DEFAULT_VALUE "UNKNOWN" /end COMPU_VTAB
/begin CHARACTERISTIC PAUX5_Paux_cal "{PAUX5_Paux_cal&0xff=0:Aux Press A}{PAUX5_Paux_cal&0xff=1:Aux Press B}{PAUX5_Paux_cal&0xff=2:Aux Press C}{PAUX5_Paux_cal&0xff=3:Aux Press D}" VALUE 0x001C887B /* @ECU_Address@PAUX5_Paux_cal@0x01009568@ */ ECIPP_ALIGNMENT_UBYTE 255 PAUX5_Paux_cal_COMPU_VTAB 0 255 BIT_MASK 0xff /end CHARACTERISTIC
/begin COMPU_METHOD PAUX5_Paux_cal_COMPU_VTAB "Verbal Table" TAB_VERB "%.0" "list" COMPU_TAB_REF PAUX5_Paux_cal_COMPU_VTAB_REF /end COMPU_METHOD
/begin COMPU_VTAB PAUX5_Paux_cal_COMPU_VTAB_REF "Verbal Table" TAB_VERB 4 0 "Aux Press A" 1 "Aux Press B" 2 "Aux Press C" 3 "Aux Press D" DEFAULT_VALUE "UNKNOWN" /end COMPU_VTAB
/begin CHARACTERISTIC PAUX6_Paux_cal "{PAUX6_Paux_cal&0xff=0:Aux Press A}{PAUX6_Paux_cal&0xff=1:Aux Press B}{PAUX6_Paux_cal&0xff=2:Aux Press C}{PAUX6_Paux_cal&0xff=3:Aux Press D}" VALUE 0x001C887C /* @ECU_Address@PAUX6_Paux_cal@0x01009570@ */ ECIPP_ALIGNMENT_UBYTE 255 PAUX6_Paux_cal_COMPU_VTAB 0 255 BIT_MASK 0xff /end CHARACTERISTIC
/begin COMPU_METHOD PAUX6_Paux_cal_COMPU_VTAB "Verbal Table" TAB_VERB "%.0" "list" COMPU_TAB_REF PAUX6_Paux_cal_COMPU_VTAB_REF /end COMPU_METHOD
/begin COMPU_VTAB PAUX6_Paux_cal_COMPU_VTAB_REF "Verbal Table" TAB_VERB 4 0 "Aux Press A" 1 "Aux Press B" 2 "Aux Press C" 3 "Aux Press D" DEFAULT_VALUE "UNKNOWN" /end COMPU_VTAB
/begin CHARACTERISTIC PAUX7_Paux_cal "{PAUX7_Paux_cal&0xff=0:Aux Press A}{PAUX7_Paux_cal&0xff=1:Aux Press B}{PAUX7_Paux_cal&0xff=2:Aux Press C}{PAUX7_Paux_cal&0xff=3:Aux Press D}" VALUE 0x001C887D /* @ECU_Address@PAUX7_Paux_cal@0x01009578@ */ ECIPP_ALIGNMENT_UBYTE 255 PAUX7_Paux_cal_COMPU_VTAB 0 255 BIT_MASK 0xff /end CHARACTERISTIC
/begin COMPU_METHOD PAUX7_Paux_cal_COMPU_VTAB "Verbal Table" TAB_VERB "%.0" "list" COMPU_TAB_REF PAUX7_Paux_cal_COMPU_VTAB_REF /end COMPU_METHOD
/begin COMPU_VTAB PAUX7_Paux_cal_COMPU_VTAB_REF "Verbal Table" TAB_VERB 4 0 "Aux Press A" 1 "Aux Press B" 2 "Aux Press C" 3 "Aux Press D" DEFAULT_VALUE "UNKNOWN" /end COMPU_VTAB
/begin CHARACTERISTIC PAUX8_Paux_cal "{PAUX8_Paux_cal&0xff=0:Aux Press A}{PAUX8_Paux_cal&0xff=1:Aux Press B}{PAUX8_Paux_cal&0xff=2:Aux Press C}{PAUX8_Paux_cal&0xff=3:Aux Press D}" VALUE 0x001C887E /* @ECU_Address@PAUX8_Paux_cal@0x01009580@ */ ECIPP_ALIGNMENT_UBYTE 255 PAUX8_Paux_cal_COMPU_VTAB 0 255 BIT_MASK 0xff /end CHARACTERISTIC
/begin COMPU_METHOD PAUX8_Paux_cal_COMPU_VTAB "Verbal Table" TAB_VERB "%.0" "list" COMPU_TAB_REF PAUX8_Paux_cal_COMPU_VTAB_REF /end COMPU_METHOD
/begin COMPU_VTAB PAUX8_Paux_cal_COMPU_VTAB_REF "Verbal Table" TAB_VERB 4 0 "Aux Press A" 1 "Aux Press B" 2 "Aux Press C" 3 "Aux Press D" DEFAULT_VALUE "UNKNOWN" /end COMPU_VTAB
/begin CHARACTERISTIC PAUX1_ena "{PAUX1_ena&0xff=0:Disabled}{PAUX1_ena&0xff=1:Aux PD1}{PAUX1_ena&0xff=2:Aux PD2}{PAUX1_ena&0xff=3:Aux PD3}{PAUX1_ena&0xff=4:Aux PUD1}{PAUX1_ena&0xff=5:Aux PUD2}{PAUX1_ena&0xff=6:Aux PUD3}{PAUX1_ena&0xff=7:Aux PUD4}{PAUX1_ena&0xff=8:Aux PUD5}{PAUX1_ena&0xff" VALUE 0x001C8887 /* @ECU_Address@PAUX1_ena@0x01009588@ */ ECIPP_ALIGNMENT_UBYTE 255 PAUX1_ena_COMPU_VTAB 0 255 BIT_MASK 0xff /end CHARACTERISTIC
/begin COMPU_METHOD PAUX1_ena_COMPU_VTAB "Verbal Table" TAB_VERB "%.0" "list" COMPU_TAB_REF PAUX1_ena_COMPU_VTAB_REF /end COMPU_METHOD
/begin COMPU_VTAB PAUX1_ena_COMPU_VTAB_REF "Verbal Table" TAB_VERB 31 0 "Disabled" 1 "Aux PD1" 2 "Aux PD2" 3 "Aux PD3" 4 "Aux PUD1" 5 "Aux PUD2" 6 "Aux PUD3" 7 "Aux PUD4" 8 "Aux PUD5" 9 "Aux PUD6" 10 "Aux PUD7" 11 "Aux PUD8" 12 "Aux PUD9" 13 "Aux PUD10" 14 "Aux PUD11" 15 "Aux PUD12" 16 "Aux PUD13" 17 "Aux PUD14" 18 "Aux PUD15" 19 "CAN sourced" 20 "FPP2 Input" 21 "Aux PUD16" 22 "Aux PUD17" 23 "Aux PUD18" 24 "Aux PUD19" 25 "Aux PUD20" 26 "Aux PUD21" 27 "Aux PUD22" 28 "Aux PUD23" 29 "Aux PUD24" 30 "Aux PUD25" DEFAULT_VALUE "UNKNOWN" /end COMPU_VTAB
/begin CHARACTERISTIC PAUX2_ena "{PAUX2_ena&0xff=0:Disabled}{PAUX2_ena&0xff=1:Aux PD1}{PAUX2_ena&0xff=2:Aux PD2}{PAUX2_ena&0xff=3:Aux PD3}{PAUX2_ena&0xff=4:Aux PUD1}{PAUX2_ena&0xff=5:Aux PUD2}{PAUX2_ena&0xff=6:Aux PUD3}{PAUX2_ena&0xff=7:Aux PUD4}{PAUX2_ena&0xff=8:Aux PUD5}{PAUX2_ena&0xff" VALUE 0x001C8888 /* @ECU_Address@PAUX2_ena@0x01009590@ */ ECIPP_ALIGNMENT_UBYTE 255 PAUX2_ena_COMPU_VTAB 0 255 BIT_MASK 0xff /end CHARACTERISTIC
/begin COMPU_METHOD PAUX2_ena_COMPU_VTAB "Verbal Table" TAB_VERB "%.0" "list" COMPU_TAB_REF PAUX2_ena_COMPU_VTAB_REF /end COMPU_METHOD
/begin COMPU_VTAB PAUX2_ena_COMPU_VTAB_REF "Verbal Table" TAB_VERB 31 0 "Disabled" 1 "Aux PD1" 2 "Aux PD2" 3 "Aux PD3" 4 "Aux PUD1" 5 "Aux PUD2" 6 "Aux PUD3" 7 "Aux PUD4" 8 "Aux PUD5" 9 "Aux PUD6" 10 "Aux PUD7" 11 "Aux PUD8" 12 "Aux PUD9" 13 "Aux PUD10" 14 "Aux PUD11" 15 "Aux PUD12" 16 "Aux PUD13" 17 "Aux PUD14" 18 "Aux PUD15" 19 "CAN sourced" 20 "FPP2 Input" 21 "Aux PUD16" 22 "Aux PUD17" 23 "Aux PUD18" 24 "Aux PUD19" 25 "Aux PUD20" 26 "Aux PUD21" 27 "Aux PUD22" 28 "Aux PUD23" 29 "Aux PUD24" 30 "Aux PUD25" DEFAULT_VALUE "UNKNOWN" /end COMPU_VTAB
/begin CHARACTERISTIC PAUX3_ena "{PAUX3_ena&0xff=0:Disabled}{PAUX3_ena&0xff=1:Aux PD1}{PAUX3_ena&0xff=2:Aux PD2}{PAUX3_ena&0xff=3:Aux PD3}{PAUX3_ena&0xff=4:Aux PUD1}{PAUX3_ena&0xff=5:Aux PUD2}{PAUX3_ena&0xff=6:Aux PUD3}{PAUX3_ena&0xff=7:Aux PUD4}{PAUX3_ena&0xff=8:Aux PUD5}{PAUX3_ena&0xff" VALUE 0x001C8889 /* @ECU_Address@PAUX3_ena@0x01009598@ */ ECIPP_ALIGNMENT_UBYTE 255 PAUX3_ena_COMPU_VTAB 0 255 BIT_MASK 0xff /end CHARACTERISTIC
/begin COMPU_METHOD PAUX3_ena_COMPU_VTAB "Verbal Table" TAB_VERB "%.0" "list" COMPU_TAB_REF PAUX3_ena_COMPU_VTAB_REF /end COMPU_METHOD
/begin COMPU_VTAB PAUX3_ena_COMPU_VTAB_REF "Verbal Table" TAB_VERB 31 0 "Disabled" 1 "Aux PD1" 2 "Aux PD2" 3 "Aux PD3" 4 "Aux PUD1" 5 "Aux PUD2" 6 "Aux PUD3" 7 "Aux PUD4" 8 "Aux PUD5" 9 "Aux PUD6" 10 "Aux PUD7" 11 "Aux PUD8" 12 "Aux PUD9" 13 "Aux PUD10" 14 "Aux PUD11" 15 "Aux PUD12" 16 "Aux PUD13" 17 "Aux PUD14" 18 "Aux PUD15" 19 "CAN sourced" 20 "FPP2 Input" 21 "Aux PUD16" 22 "Aux PUD17" 23 "Aux PUD18" 24 "Aux PUD19" 25 "Aux PUD20" 26 "Aux PUD21" 27 "Aux PUD22" 28 "Aux PUD23" 29 "Aux PUD24" 30 "Aux PUD25" DEFAULT_VALUE "UNKNOWN" /end COMPU_VTAB
/begin CHARACTERISTIC PAUX4_ena "{PAUX4_ena&0xff=0:Disabled}{PAUX4_ena&0xff=1:Aux PD1}{PAUX4_ena&0xff=2:Aux PD2}{PAUX4_ena&0xff=3:Aux PD3}{PAUX4_ena&0xff=4:Aux PUD1}{PAUX4_ena&0xff=5:Aux PUD2}{PAUX4_ena&0xff=6:Aux PUD3}{PAUX4_ena&0xff=7:Aux PUD4}{PAUX4_ena&0xff=8:Aux PUD5}{PAUX4_ena&0xff" VALUE 0x001C888A /* @ECU_Address@PAUX4_ena@0x010095A0@ */ ECIPP_ALIGNMENT_UBYTE 255 PAUX4_ena_COMPU_VTAB 0 255 BIT_MASK 0xff /end CHARACTERISTIC
/begin COMPU_METHOD PAUX4_ena_COMPU_VTAB "Verbal Table" TAB_VERB "%.0" "list" COMPU_TAB_REF PAUX4_ena_COMPU_VTAB_REF /end COMPU_METHOD
/begin COMPU_VTAB PAUX4_ena_COMPU_VTAB_REF "Verbal Table" TAB_VERB 31 0 "Disabled" 1 "Aux PD1" 2 "Aux PD2" 3 "Aux PD3" 4 "Aux PUD1" 5 "Aux PUD2" 6 "Aux PUD3" 7 "Aux PUD4" 8 "Aux PUD5" 9 "Aux PUD6" 10 "Aux PUD7" 11 "Aux PUD8" 12 "Aux PUD9" 13 "Aux PUD10" 14 "Aux PUD11" 15 "Aux PUD12" 16 "Aux PUD13" 17 "Aux PUD14" 18 "Aux PUD15" 19 "CAN sourced" 20 "FPP2 Input" 21 "Aux PUD16" 22 "Aux PUD17" 23 "Aux PUD18" 24 "Aux PUD19" 25 "Aux PUD20" 26 "Aux PUD21" 27 "Aux PUD22" 28 "Aux PUD23" 29 "Aux PUD24" 30 "Aux PUD25" DEFAULT_VALUE "UNKNOWN" /end COMPU_VTAB
/begin CHARACTERISTIC PAUX5_ena "{PAUX5_ena&0xff=0:Disabled}{PAUX5_ena&0xff=1:Aux PD1}{PAUX5_ena&0xff=2:Aux PD2}{PAUX5_ena&0xff=3:Aux PD3}{PAUX5_ena&0xff=4:Aux PUD1}{PAUX5_ena&0xff=5:Aux PUD2}{PAUX5_ena&0xff=6:Aux PUD3}{PAUX5_ena&0xff=7:Aux PUD4}{PAUX5_ena&0xff=8:Aux PUD5}{PAUX5_ena&0xff" VALUE 0x001C888B /* @ECU_Address@PAUX5_ena@0x010095A8@ */ ECIPP_ALIGNMENT_UBYTE 255 PAUX5_ena_COMPU_VTAB 0 255 BIT_MASK 0xff /end CHARACTERISTIC
/begin COMPU_METHOD PAUX5_ena_COMPU_VTAB "Verbal Table" TAB_VERB "%.0" "list" COMPU_TAB_REF PAUX5_ena_COMPU_VTAB_REF /end COMPU_METHOD
/begin COMPU_VTAB PAUX5_ena_COMPU_VTAB_REF "Verbal Table" TAB_VERB 31 0 "Disabled" 1 "Aux PD1" 2 "Aux PD2" 3 "Aux PD3" 4 "Aux PUD1" 5 "Aux PUD2" 6 "Aux PUD3" 7 "Aux PUD4" 8 "Aux PUD5" 9 "Aux PUD6" 10 "Aux PUD7" 11 "Aux PUD8" 12 "Aux PUD9" 13 "Aux PUD10" 14 "Aux PUD11" 15 "Aux PUD12" 16 "Aux PUD13" 17 "Aux PUD14" 18 "Aux PUD15" 19 "CAN sourced" 20 "FPP2 Input" 21 "Aux PUD16" 22 "Aux PUD17" 23 "Aux PUD18" 24 "Aux PUD19" 25 "Aux PUD20" 26 "Aux PUD21" 27 "Aux PUD22" 28 "Aux PUD23" 29 "Aux PUD24" 30 "Aux PUD25" DEFAULT_VALUE "UNKNOWN" /end COMPU_VTAB
/begin CHARACTERISTIC PAUX6_ena "{PAUX6_ena&0xff=0:Disabled}{PAUX6_ena&0xff=1:Aux PD1}{PAUX6_ena&0xff=2:Aux PD2}{PAUX6_ena&0xff=3:Aux PD3}{PAUX6_ena&0xff=4:Aux PUD1}{PAUX6_ena&0xff=5:Aux PUD2}{PAUX6_ena&0xff=6:Aux PUD3}{PAUX6_ena&0xff=7:Aux PUD4}{PAUX6_ena&0xff=8:Aux PUD5}{PAUX6_ena&0xff" VALUE 0x001C888C /* @ECU_Address@PAUX6_ena@0x010095B0@ */ ECIPP_ALIGNMENT_UBYTE 255 PAUX6_ena_COMPU_VTAB 0 255 BIT_MASK 0xff /end CHARACTERISTIC
/begin COMPU_METHOD PAUX6_ena_COMPU_VTAB "Verbal Table" TAB_VERB "%.0" "list" COMPU_TAB_REF PAUX6_ena_COMPU_VTAB_REF /end COMPU_METHOD
/begin COMPU_VTAB PAUX6_ena_COMPU_VTAB_REF "Verbal Table" TAB_VERB 31 0 "Disabled" 1 "Aux PD1" 2 "Aux PD2" 3 "Aux PD3" 4 "Aux PUD1" 5 "Aux PUD2" 6 "Aux PUD3" 7 "Aux PUD4" 8 "Aux PUD5" 9 "Aux PUD6" 10 "Aux PUD7" 11 "Aux PUD8" 12 "Aux PUD9" 13 "Aux PUD10" 14 "Aux PUD11" 15 "Aux PUD12" 16 "Aux PUD13" 17 "Aux PUD14" 18 "Aux PUD15" 19 "CAN sourced" 20 "FPP2 Input" 21 "Aux PUD16" 22 "Aux PUD17" 23 "Aux PUD18" 24 "Aux PUD19" 25 "Aux PUD20" 26 "Aux PUD21" 27 "Aux PUD22" 28 "Aux PUD23" 29 "Aux PUD24" 30 "Aux PUD25" DEFAULT_VALUE "UNKNOWN" /end COMPU_VTAB
/begin CHARACTERISTIC PAUX7_ena "{PAUX7_ena&0xff=0:Disabled}{PAUX7_ena&0xff=1:Aux PD1}{PAUX7_ena&0xff=2:Aux PD2}{PAUX7_ena&0xff=3:Aux PD3}{PAUX7_ena&0xff=4:Aux PUD1}{PAUX7_ena&0xff=5:Aux PUD2}{PAUX7_ena&0xff=6:Aux PUD3}{PAUX7_ena&0xff=7:Aux PUD4}{PAUX7_ena&0xff=8:Aux PUD5}{PAUX7_ena&0xff" VALUE 0x001C888D /* @ECU_Address@PAUX7_ena@0x010095B8@ */ ECIPP_ALIGNMENT_UBYTE 255 PAUX7_ena_COMPU_VTAB 0 255 BIT_MASK 0xff /end CHARACTERISTIC
/begin COMPU_METHOD PAUX7_ena_COMPU_VTAB "Verbal Table" TAB_VERB "%.0" "list" COMPU_TAB_REF PAUX7_ena_COMPU_VTAB_REF /end COMPU_METHOD
/begin COMPU_VTAB PAUX7_ena_COMPU_VTAB_REF "Verbal Table" TAB_VERB 31 0 "Disabled" 1 "Aux PD1" 2 "Aux PD2" 3 "Aux PD3" 4 "Aux PUD1" 5 "Aux PUD2" 6 "Aux PUD3" 7 "Aux PUD4" 8 "Aux PUD5" 9 "Aux PUD6" 10 "Aux PUD7" 11 "Aux PUD8" 12 "Aux PUD9" 13 "Aux PUD10" 14 "Aux PUD11" 15 "Aux PUD12" 16 "Aux PUD13" 17 "Aux PUD14" 18 "Aux PUD15" 19 "CAN sourced" 20 "FPP2 Input" 21 "Aux PUD16" 22 "Aux PUD17" 23 "Aux PUD18" 24 "Aux PUD19" 25 "Aux PUD20" 26 "Aux PUD21" 27 "Aux PUD22" 28 "Aux PUD23" 29 "Aux PUD24" 30 "Aux PUD25" DEFAULT_VALUE "UNKNOWN" /end COMPU_VTAB
/begin CHARACTERISTIC PAUX8_ena "{PAUX8_ena&0xff=0:Disabled}{PAUX8_ena&0xff=1:Aux PD1}{PAUX8_ena&0xff=2:Aux PD2}{PAUX8_ena&0xff=3:Aux PD3}{PAUX8_ena&0xff=4:Aux PUD1}{PAUX8_ena&0xff=5:Aux PUD2}{PAUX8_ena&0xff=6:Aux PUD3}{PAUX8_ena&0xff=7:Aux PUD4}{PAUX8_ena&0xff=8:Aux PUD5}{PAUX8_ena&0xff" VALUE 0x001C888E /* @ECU_Address@PAUX8_ena@0x010095C0@ */ ECIPP_ALIGNMENT_UBYTE 255 PAUX8_ena_COMPU_VTAB 0 255 BIT_MASK 0xff /end CHARACTERISTIC
/begin COMPU_METHOD PAUX8_ena_COMPU_VTAB "Verbal Table" TAB_VERB "%.0" "list" COMPU_TAB_REF PAUX8_ena_COMPU_VTAB_REF /end COMPU_METHOD
/begin COMPU_VTAB PAUX8_ena_COMPU_VTAB_REF "Verbal Table" TAB_VERB 31 0 "Disabled" 1 "Aux PD1" 2 "Aux PD2" 3 "Aux PD3" 4 "Aux PUD1" 5 "Aux PUD2" 6 "Aux PUD3" 7 "Aux PUD4" 8 "Aux PUD5" 9 "Aux PUD6" 10 "Aux PUD7" 11 "Aux PUD8" 12 "Aux PUD9" 13 "Aux PUD10" 14 "Aux PUD11" 15 "Aux PUD12" 16 "Aux PUD13" 17 "Aux PUD14" 18 "Aux PUD15" 19 "CAN sourced" 20 "FPP2 Input" 21 "Aux PUD16" 22 "Aux PUD17" 23 "Aux PUD18" 24 "Aux PUD19" 25 "Aux PUD20" 26 "Aux PUD21" 27 "Aux PUD22" 28 "Aux PUD23" 29 "Aux PUD24" 30 "Aux PUD25" DEFAULT_VALUE "UNKNOWN" /end COMPU_VTAB
/begin CHARACTERISTIC TAUX1_ena "{TAUX1_ena&0xff=0:Disabled}{TAUX1_ena&0xff=1:Aux PU1}{TAUX1_ena&0xff=2:Aux PU2}{TAUX1_ena&0xff=3:Aux PU3}{TAUX1_ena&0xff=4:Aux PUD1}{TAUX1_ena&0xff=5:Aux PUD2}{TAUX1_ena&0xff=6:Aux PUD3}{TAUX1_ena&0xff=7:EGT Input}{TAUX1_ena&0xff=8:Aux PUD4}{TAUX1_ena&0xf" VALUE 0x001C8F07 /* @ECU_Address@TAUX1_ena@0x01009648@ */ ECIPP_ALIGNMENT_UBYTE 255 TAUX1_ena_COMPU_VTAB 0 255 BIT_MASK 0xff /end CHARACTERISTIC
/begin COMPU_METHOD TAUX1_ena_COMPU_VTAB "Verbal Table" TAB_VERB "%.0" "list" COMPU_TAB_REF TAUX1_ena_COMPU_VTAB_REF /end COMPU_METHOD
/begin COMPU_VTAB TAUX1_ena_COMPU_VTAB_REF "Verbal Table" TAB_VERB 31 0 "Disabled" 1 "Aux PU1" 2 "Aux PU2" 3 "Aux PU3" 4 "Aux PUD1" 5 "Aux PUD2" 6 "Aux PUD3" 7 "EGT Input" 8 "Aux PUD4" 9 "Aux PUD5" 10 "Aux PUD6" 11 "Aux PUD7" 12 "Aux PUD8" 13 "Aux PUD9" 14 "Aux PUD10" 15 "Aux PUD11" 16 "Aux PUD12" 17 "Aux PUD13" 18 "Aux PUD14" 19 "Aux PUD15" 20 "Aux PUD16" 21 "Aux PUD17" 22 "Aux PUD18" 23 "Aux PUD19" 24 "Aux PUD20" 25 "Aux PUD21" 26 "Aux PUD22" 27 "Aux PUD23" 28 "Aux PUD24" 29 "Aux PUD25" 30 "CAN sourced" DEFAULT_VALUE "UNKNOWN" /end COMPU_VTAB
/begin CHARACTERISTIC TAUX2_ena "{TAUX2_ena&0xff=0:Disabled}{TAUX2_ena&0xff=1:Aux PU1}{TAUX2_ena&0xff=2:Aux PU2}{TAUX2_ena&0xff=3:Aux PU3}{TAUX2_ena&0xff=4:Aux PUD1}{TAUX2_ena&0xff=5:Aux PUD2}{TAUX2_ena&0xff=6:Aux PUD3}{TAUX2_ena&0xff=7:EGT Input}{TAUX2_ena&0xff=8:Aux PUD4}{TAUX2_ena&0xf" VALUE 0x001C8F08 /* @ECU_Address@TAUX2_ena@0x01009650@ */ ECIPP_ALIGNMENT_UBYTE 255 TAUX2_ena_COMPU_VTAB 0 255 BIT_MASK 0xff /end CHARACTERISTIC
/begin COMPU_METHOD TAUX2_ena_COMPU_VTAB "Verbal Table" TAB_VERB "%.0" "list" COMPU_TAB_REF TAUX2_ena_COMPU_VTAB_REF /end COMPU_METHOD
/begin COMPU_VTAB TAUX2_ena_COMPU_VTAB_REF "Verbal Table" TAB_VERB 31 0 "Disabled" 1 "Aux PU1" 2 "Aux PU2" 3 "Aux PU3" 4 "Aux PUD1" 5 "Aux PUD2" 6 "Aux PUD3" 7 "EGT Input" 8 "Aux PUD4" 9 "Aux PUD5" 10 "Aux PUD6" 11 "Aux PUD7" 12 "Aux PUD8" 13 "Aux PUD9" 14 "Aux PUD10" 15 "Aux PUD11" 16 "Aux PUD12" 17 "Aux PUD13" 18 "Aux PUD14" 19 "Aux PUD15" 20 "Aux PUD16" 21 "Aux PUD17" 22 "Aux PUD18" 23 "Aux PUD19" 24 "Aux PUD20" 25 "Aux PUD21" 26 "Aux PUD22" 27 "Aux PUD23" 28 "Aux PUD24" 29 "Aux PUD25" 30 "CAN sourced" DEFAULT_VALUE "UNKNOWN" /end COMPU_VTAB
/begin CHARACTERISTIC TAUX3_ena "{TAUX3_ena&0xff=0:Disabled}{TAUX3_ena&0xff=1:Aux PU1}{TAUX3_ena&0xff=2:Aux PU2}{TAUX3_ena&0xff=3:Aux PU3}{TAUX3_ena&0xff=4:Aux PUD1}{TAUX3_ena&0xff=5:Aux PUD2}{TAUX3_ena&0xff=6:Aux PUD3}{TAUX3_ena&0xff=7:EGT Input}{TAUX3_ena&0xff=8:Aux PUD4}{TAUX3_ena&0xf" VALUE 0x001C8F09 /* @ECU_Address@TAUX3_ena@0x01009658@ */ ECIPP_ALIGNMENT_UBYTE 255 TAUX3_ena_COMPU_VTAB 0 255 BIT_MASK 0xff /end CHARACTERISTIC
/begin COMPU_METHOD TAUX3_ena_COMPU_VTAB "Verbal Table" TAB_VERB "%.0" "list" COMPU_TAB_REF TAUX3_ena_COMPU_VTAB_REF /end COMPU_METHOD
/begin COMPU_VTAB TAUX3_ena_COMPU_VTAB_REF "Verbal Table" TAB_VERB 31 0 "Disabled" 1 "Aux PU1" 2 "Aux PU2" 3 "Aux PU3" 4 "Aux PUD1" 5 "Aux PUD2" 6 "Aux PUD3" 7 "EGT Input" 8 "Aux PUD4" 9 "Aux PUD5" 10 "Aux PUD6" 11 "Aux PUD7" 12 "Aux PUD8" 13 "Aux PUD9" 14 "Aux PUD10" 15 "Aux PUD11" 16 "Aux PUD12" 17 "Aux PUD13" 18 "Aux PUD14" 19 "Aux PUD15" 20 "Aux PUD16" 21 "Aux PUD17" 22 "Aux PUD18" 23 "Aux PUD19" 24 "Aux PUD20" 25 "Aux PUD21" 26 "Aux PUD22" 27 "Aux PUD23" 28 "Aux PUD24" 29 "Aux PUD25" 30 "CAN sourced" DEFAULT_VALUE "UNKNOWN" /end COMPU_VTAB
/begin CHARACTERISTIC TAUX4_ena "{TAUX4_ena&0xff=0:Disabled}{TAUX4_ena&0xff=1:Aux PU1}{TAUX4_ena&0xff=2:Aux PU2}{TAUX4_ena&0xff=3:Aux PU3}{TAUX4_ena&0xff=4:Aux PUD1}{TAUX4_ena&0xff=5:Aux PUD2}{TAUX4_ena&0xff=6:Aux PUD3}{TAUX4_ena&0xff=7:EGT Input}{TAUX4_ena&0xff=8:Aux PUD4}{TAUX4_ena&0xf" VALUE 0x001C8F0A /* @ECU_Address@TAUX4_ena@0x01009660@ */ ECIPP_ALIGNMENT_UBYTE 255 TAUX4_ena_COMPU_VTAB 0 255 BIT_MASK 0xff /end CHARACTERISTIC
/begin COMPU_METHOD TAUX4_ena_COMPU_VTAB "Verbal Table" TAB_VERB "%.0" "list" COMPU_TAB_REF TAUX4_ena_COMPU_VTAB_REF /end COMPU_METHOD
/begin COMPU_VTAB TAUX4_ena_COMPU_VTAB_REF "Verbal Table" TAB_VERB 31 0 "Disabled" 1 "Aux PU1" 2 "Aux PU2" 3 "Aux PU3" 4 "Aux PUD1" 5 "Aux PUD2" 6 "Aux PUD3" 7 "EGT Input" 8 "Aux PUD4" 9 "Aux PUD5" 10 "Aux PUD6" 11 "Aux PUD7" 12 "Aux PUD8" 13 "Aux PUD9" 14 "Aux PUD10" 15 "Aux PUD11" 16 "Aux PUD12" 17 "Aux PUD13" 18 "Aux PUD14" 19 "Aux PUD15" 20 "Aux PUD16" 21 "Aux PUD17" 22 "Aux PUD18" 23 "Aux PUD19" 24 "Aux PUD20" 25 "Aux PUD21" 26 "Aux PUD22" 27 "Aux PUD23" 28 "Aux PUD24" 29 "Aux PUD25" 30 "CAN sourced" DEFAULT_VALUE "UNKNOWN" /end COMPU_VTAB
/begin CHARACTERISTIC TAUX5_ena "{TAUX5_ena&0xff=0:Disabled}{TAUX5_ena&0xff=1:Aux PU1}{TAUX5_ena&0xff=2:Aux PU2}{TAUX5_ena&0xff=3:Aux PU3}{TAUX5_ena&0xff=4:Aux PUD1}{TAUX5_ena&0xff=5:Aux PUD2}{TAUX5_ena&0xff=6:Aux PUD3}{TAUX5_ena&0xff=7:EGT Input}{TAUX5_ena&0xff=8:Aux PUD4}{TAUX5_ena&0xf" VALUE 0x001C8F0B /* @ECU_Address@TAUX5_ena@0x01009668@ */ ECIPP_ALIGNMENT_UBYTE 255 TAUX5_ena_COMPU_VTAB 0 255 BIT_MASK 0xff /end CHARACTERISTIC
/begin COMPU_METHOD TAUX5_ena_COMPU_VTAB "Verbal Table" TAB_VERB "%.0" "list" COMPU_TAB_REF TAUX5_ena_COMPU_VTAB_REF /end COMPU_METHOD
/begin COMPU_VTAB TAUX5_ena_COMPU_VTAB_REF "Verbal Table" TAB_VERB 31 0 "Disabled" 1 "Aux PU1" 2 "Aux PU2" 3 "Aux PU3" 4 "Aux PUD1" 5 "Aux PUD2" 6 "Aux PUD3" 7 "EGT Input" 8 "Aux PUD4" 9 "Aux PUD5" 10 "Aux PUD6" 11 "Aux PUD7" 12 "Aux PUD8" 13 "Aux PUD9" 14 "Aux PUD10" 15 "Aux PUD11" 16 "Aux PUD12" 17 "Aux PUD13" 18 "Aux PUD14" 19 "Aux PUD15" 20 "Aux PUD16" 21 "Aux PUD17" 22 "Aux PUD18" 23 "Aux PUD19" 24 "Aux PUD20" 25 "Aux PUD21" 26 "Aux PUD22" 27 "Aux PUD23" 28 "Aux PUD24" 29 "Aux PUD25" 30 "CAN sourced" DEFAULT_VALUE "UNKNOWN" /end COMPU_VTAB
/begin CHARACTERISTIC TAUX6_ena "{TAUX6_ena&0xff=0:Disabled}{TAUX6_ena&0xff=1:Aux PU1}{TAUX6_ena&0xff=2:Aux PU2}{TAUX6_ena&0xff=3:Aux PU3}{TAUX6_ena&0xff=4:Aux PUD1}{TAUX6_ena&0xff=5:Aux PUD2}{TAUX6_ena&0xff=6:Aux PUD3}{TAUX6_ena&0xff=7:EGT Input}{TAUX6_ena&0xff=8:Aux PUD4}{TAUX6_ena&0xf" VALUE 0x001C8F0C /* @ECU_Address@TAUX6_ena@0x01009670@ */ ECIPP_ALIGNMENT_UBYTE 255 TAUX6_ena_COMPU_VTAB 0 255 BIT_MASK 0xff /end CHARACTERISTIC
/begin COMPU_METHOD TAUX6_ena_COMPU_VTAB "Verbal Table" TAB_VERB "%.0" "list" COMPU_TAB_REF TAUX6_ena_COMPU_VTAB_REF /end COMPU_METHOD
/begin COMPU_VTAB TAUX6_ena_COMPU_VTAB_REF "Verbal Table" TAB_VERB 31 0 "Disabled" 1 "Aux PU1" 2 "Aux PU2" 3 "Aux PU3" 4 "Aux PUD1" 5 "Aux PUD2" 6 "Aux PUD3" 7 "EGT Input" 8 "Aux PUD4" 9 "Aux PUD5" 10 "Aux PUD6" 11 "Aux PUD7" 12 "Aux PUD8" 13 "Aux PUD9" 14 "Aux PUD10" 15 "Aux PUD11" 16 "Aux PUD12" 17 "Aux PUD13" 18 "Aux PUD14" 19 "Aux PUD15" 20 "Aux PUD16" 21 "Aux PUD17" 22 "Aux PUD18" 23 "Aux PUD19" 24 "Aux PUD20" 25 "Aux PUD21" 26 "Aux PUD22" 27 "Aux PUD23" 28 "Aux PUD24" 29 "Aux PUD25" 30 "CAN sourced" DEFAULT_VALUE "UNKNOWN" /end COMPU_VTAB
/begin CHARACTERISTIC TAUX7_ena "{TAUX7_ena&0xff=0:Disabled}{TAUX7_ena&0xff=1:Aux PU1}{TAUX7_ena&0xff=2:Aux PU2}{TAUX7_ena&0xff=3:Aux PU3}{TAUX7_ena&0xff=4:Aux PUD1}{TAUX7_ena&0xff=5:Aux PUD2}{TAUX7_ena&0xff=6:Aux PUD3}{TAUX7_ena&0xff=7:EGT Input}{TAUX7_ena&0xff=8:Aux PUD4}{TAUX7_ena&0xf" VALUE 0x001C8F0D /* @ECU_Address@TAUX7_ena@0x01009678@ */ ECIPP_ALIGNMENT_UBYTE 255 TAUX7_ena_COMPU_VTAB 0 255 BIT_MASK 0xff /end CHARACTERISTIC
/begin COMPU_METHOD TAUX7_ena_COMPU_VTAB "Verbal Table" TAB_VERB "%.0" "list" COMPU_TAB_REF TAUX7_ena_COMPU_VTAB_REF /end COMPU_METHOD
/begin COMPU_VTAB TAUX7_ena_COMPU_VTAB_REF "Verbal Table" TAB_VERB 31 0 "Disabled" 1 "Aux PU1" 2 "Aux PU2" 3 "Aux PU3" 4 "Aux PUD1" 5 "Aux PUD2" 6 "Aux PUD3" 7 "EGT Input" 8 "Aux PUD4" 9 "Aux PUD5" 10 "Aux PUD6" 11 "Aux PUD7" 12 "Aux PUD8" 13 "Aux PUD9" 14 "Aux PUD10" 15 "Aux PUD11" 16 "Aux PUD12" 17 "Aux PUD13" 18 "Aux PUD14" 19 "Aux PUD15" 20 "Aux PUD16" 21 "Aux PUD17" 22 "Aux PUD18" 23 "Aux PUD19" 24 "Aux PUD20" 25 "Aux PUD21" 26 "Aux PUD22" 27 "Aux PUD23" 28 "Aux PUD24" 29 "Aux PUD25" 30 "CAN sourced" DEFAULT_VALUE "UNKNOWN" /end COMPU_VTAB
/begin CHARACTERISTIC TAUX8_ena "{TAUX8_ena&0xff=0:Disabled}{TAUX8_ena&0xff=1:Aux PU1}{TAUX8_ena&0xff=2:Aux PU2}{TAUX8_ena&0xff=3:Aux PU3}{TAUX8_ena&0xff=4:Aux PUD1}{TAUX8_ena&0xff=5:Aux PUD2}{TAUX8_ena&0xff=6:Aux PUD3}{TAUX8_ena&0xff=7:EGT Input}{TAUX8_ena&0xff=8:Aux PUD4}{TAUX8_ena&0xf" VALUE 0x001C8F0E /* @ECU_Address@TAUX8_ena@0x01009680@ */ ECIPP_ALIGNMENT_UBYTE 255 TAUX8_ena_COMPU_VTAB 0 255 BIT_MASK 0xff /end CHARACTERISTIC
/begin COMPU_METHOD TAUX8_ena_COMPU_VTAB "Verbal Table" TAB_VERB "%.0" "list" COMPU_TAB_REF TAUX8_ena_COMPU_VTAB_REF /end COMPU_METHOD
/begin COMPU_VTAB TAUX8_ena_COMPU_VTAB_REF "Verbal Table" TAB_VERB 31 0 "Disabled" 1 "Aux PU1" 2 "Aux PU2" 3 "Aux PU3" 4 "Aux PUD1" 5 "Aux PUD2" 6 "Aux PUD3" 7 "EGT Input" 8 "Aux PUD4" 9 "Aux PUD5" 10 "Aux PUD6" 11 "Aux PUD7" 12 "Aux PUD8" 13 "Aux PUD9" 14 "Aux PUD10" 15 "Aux PUD11" 16 "Aux PUD12" 17 "Aux PUD13" 18 "Aux PUD14" 19 "Aux PUD15" 20 "Aux PUD16" 21 "Aux PUD17" 22 "Aux PUD18" 23 "Aux PUD19" 24 "Aux PUD20" 25 "Aux PUD21" 26 "Aux PUD22" 27 "Aux PUD23" 28 "Aux PUD24" 29 "Aux PUD25" 30 "CAN sourced" DEFAULT_VALUE "UNKNOWN" /end COMPU_VTAB
/begin CHARACTERISTIC TAUX1_Taux_cal "{TAUX1_Taux_cal&0xff=0:Fuel source}{TAUX1_Taux_cal&0xff=1:Exhaust manifold/riser}{TAUX1_Taux_cal&0xff=2:Aux Temp A}{TAUX1_Taux_cal&0xff=3:Aux Temp B}{TAUX1_Taux_cal&0xff=4:Aux Temp C}{TAUX1_Taux_cal&0xff=5:Aux Temp D}" VALUE 0x001C8EF7 /* @ECU_Address@TAUX1_Taux_cal@0x01009688@ */ ECIPP_ALIGNMENT_UBYTE 255 TAUX1_Taux_cal_COMPU_VTAB 0 255 BIT_MASK 0xff /end CHARACTERISTIC
/begin COMPU_METHOD TAUX1_Taux_cal_COMPU_VTAB "Verbal Table" TAB_VERB "%.0" "list" COMPU_TAB_REF TAUX1_Taux_cal_COMPU_VTAB_REF /end COMPU_METHOD
/begin COMPU_VTAB TAUX1_Taux_cal_COMPU_VTAB_REF "Verbal Table" TAB_VERB 6 0 "Fuel source" 1 "Exhaust manifold/riser" 2 "Aux Temp A" 3 "Aux Temp B" 4 "Aux Temp C" 5 "Aux Temp D" DEFAULT_VALUE "UNKNOWN" /end COMPU_VTAB
/begin CHARACTERISTIC TAUX2_Taux_cal "{TAUX2_Taux_cal&0xff=0:Fuel source}{TAUX2_Taux_cal&0xff=1:Exhaust manifold/riser}{TAUX2_Taux_cal&0xff=2:Aux Temp A}{TAUX2_Taux_cal&0xff=3:Aux Temp B}{TAUX2_Taux_cal&0xff=4:Aux Temp C}{TAUX2_Taux_cal&0xff=5:Aux Temp D}" VALUE 0x001C8EF8 /* @ECU_Address@TAUX2_Taux_cal@0x01009690@ */ ECIPP_ALIGNMENT_UBYTE 255 TAUX2_Taux_cal_COMPU_VTAB 0 255 BIT_MASK 0xff /end CHARACTERISTIC
/begin COMPU_METHOD TAUX2_Taux_cal_COMPU_VTAB "Verbal Table" TAB_VERB "%.0" "list" COMPU_TAB_REF TAUX2_Taux_cal_COMPU_VTAB_REF /end COMPU_METHOD
/begin COMPU_VTAB TAUX2_Taux_cal_COMPU_VTAB_REF "Verbal Table" TAB_VERB 6 0 "Fuel source" 1 "Exhaust manifold/riser" 2 "Aux Temp A" 3 "Aux Temp B" 4 "Aux Temp C" 5 "Aux Temp D" DEFAULT_VALUE "UNKNOWN" /end COMPU_VTAB
/begin CHARACTERISTIC TAUX3_Taux_cal "{TAUX3_Taux_cal&0xff=0:Fuel source}{TAUX3_Taux_cal&0xff=1:Exhaust manifold/riser}{TAUX3_Taux_cal&0xff=2:Aux Temp A}{TAUX3_Taux_cal&0xff=3:Aux Temp B}{TAUX3_Taux_cal&0xff=4:Aux Temp C}{TAUX3_Taux_cal&0xff=5:Aux Temp D}" VALUE 0x001C8EF9 /* @ECU_Address@TAUX3_Taux_cal@0x01009698@ */ ECIPP_ALIGNMENT_UBYTE 255 TAUX3_Taux_cal_COMPU_VTAB 0 255 BIT_MASK 0xff /end CHARACTERISTIC
/begin COMPU_METHOD TAUX3_Taux_cal_COMPU_VTAB "Verbal Table" TAB_VERB "%.0" "list" COMPU_TAB_REF TAUX3_Taux_cal_COMPU_VTAB_REF /end COMPU_METHOD
/begin COMPU_VTAB TAUX3_Taux_cal_COMPU_VTAB_REF "Verbal Table" TAB_VERB 6 0 "Fuel source" 1 "Exhaust manifold/riser" 2 "Aux Temp A" 3 "Aux Temp B" 4 "Aux Temp C" 5 "Aux Temp D" DEFAULT_VALUE "UNKNOWN" /end COMPU_VTAB
/begin CHARACTERISTIC TAUX4_Taux_cal "{TAUX4_Taux_cal&0xff=0:Fuel source}{TAUX4_Taux_cal&0xff=1:Exhaust manifold/riser}{TAUX4_Taux_cal&0xff=2:Aux Temp A}{TAUX4_Taux_cal&0xff=3:Aux Temp B}{TAUX4_Taux_cal&0xff=4:Aux Temp C}{TAUX4_Taux_cal&0xff=5:Aux Temp D}" VALUE 0x001C8EFA /* @ECU_Address@TAUX4_Taux_cal@0x010096A0@ */ ECIPP_ALIGNMENT_UBYTE 255 TAUX4_Taux_cal_COMPU_VTAB 0 255 BIT_MASK 0xff /end CHARACTERISTIC
/begin COMPU_METHOD TAUX4_Taux_cal_COMPU_VTAB "Verbal Table" TAB_VERB "%.0" "list" COMPU_TAB_REF TAUX4_Taux_cal_COMPU_VTAB_REF /end COMPU_METHOD
/begin COMPU_VTAB TAUX4_Taux_cal_COMPU_VTAB_REF "Verbal Table" TAB_VERB 6 0 "Fuel source" 1 "Exhaust manifold/riser" 2 "Aux Temp A" 3 "Aux Temp B" 4 "Aux Temp C" 5 "Aux Temp D" DEFAULT_VALUE "UNKNOWN" /end COMPU_VTAB
/begin CHARACTERISTIC TAUX5_Taux_cal "{TAUX5_Taux_cal&0xff=0:Fuel source}{TAUX5_Taux_cal&0xff=1:Exhaust manifold/riser}{TAUX5_Taux_cal&0xff=2:Aux Temp A}{TAUX5_Taux_cal&0xff=3:Aux Temp B}{TAUX5_Taux_cal&0xff=4:Aux Temp C}{TAUX5_Taux_cal&0xff=5:Aux Temp D}" VALUE 0x001C8EFB /* @ECU_Address@TAUX5_Taux_cal@0x010096A8@ */ ECIPP_ALIGNMENT_UBYTE 255 TAUX5_Taux_cal_COMPU_VTAB 0 255 BIT_MASK 0xff /end CHARACTERISTIC
/begin COMPU_METHOD TAUX5_Taux_cal_COMPU_VTAB "Verbal Table" TAB_VERB "%.0" "list" COMPU_TAB_REF TAUX5_Taux_cal_COMPU_VTAB_REF /end COMPU_METHOD
/begin COMPU_VTAB TAUX5_Taux_cal_COMPU_VTAB_REF "Verbal Table" TAB_VERB 6 0 "Fuel source" 1 "Exhaust manifold/riser" 2 "Aux Temp A" 3 "Aux Temp B" 4 "Aux Temp C" 5 "Aux Temp D" DEFAULT_VALUE "UNKNOWN" /end COMPU_VTAB
/begin CHARACTERISTIC TAUX6_Taux_cal "{TAUX6_Taux_cal&0xff=0:Fuel source}{TAUX6_Taux_cal&0xff=1:Exhaust manifold/riser}{TAUX6_Taux_cal&0xff=2:Aux Temp A}{TAUX6_Taux_cal&0xff=3:Aux Temp B}{TAUX6_Taux_cal&0xff=4:Aux Temp C}{TAUX6_Taux_cal&0xff=5:Aux Temp D}" VALUE 0x001C8EFC /* @ECU_Address@TAUX6_Taux_cal@0x010096B0@ */ ECIPP_ALIGNMENT_UBYTE 255 TAUX6_Taux_cal_COMPU_VTAB 0 255 BIT_MASK 0xff /end CHARACTERISTIC
/begin COMPU_METHOD TAUX6_Taux_cal_COMPU_VTAB "Verbal Table" TAB_VERB "%.0" "list" COMPU_TAB_REF TAUX6_Taux_cal_COMPU_VTAB_REF /end COMPU_METHOD
/begin COMPU_VTAB TAUX6_Taux_cal_COMPU_VTAB_REF "Verbal Table" TAB_VERB 6 0 "Fuel source" 1 "Exhaust manifold/riser" 2 "Aux Temp A" 3 "Aux Temp B" 4 "Aux Temp C" 5 "Aux Temp D" DEFAULT_VALUE "UNKNOWN" /end COMPU_VTAB
/begin CHARACTERISTIC TAUX7_Taux_cal "{TAUX7_Taux_cal&0xff=0:Fuel source}{TAUX7_Taux_cal&0xff=1:Exhaust manifold/riser}{TAUX7_Taux_cal&0xff=2:Aux Temp A}{TAUX7_Taux_cal&0xff=3:Aux Temp B}{TAUX7_Taux_cal&0xff=4:Aux Temp C}{TAUX7_Taux_cal&0xff=5:Aux Temp D}" VALUE 0x001C8EFD /* @ECU_Address@TAUX7_Taux_cal@0x010096B8@ */ ECIPP_ALIGNMENT_UBYTE 255 TAUX7_Taux_cal_COMPU_VTAB 0 255 BIT_MASK 0xff /end CHARACTERISTIC
/begin COMPU_METHOD TAUX7_Taux_cal_COMPU_VTAB "Verbal Table" TAB_VERB "%.0" "list" COMPU_TAB_REF TAUX7_Taux_cal_COMPU_VTAB_REF /end COMPU_METHOD
/begin COMPU_VTAB TAUX7_Taux_cal_COMPU_VTAB_REF "Verbal Table" TAB_VERB 6 0 "Fuel source" 1 "Exhaust manifold/riser" 2 "Aux Temp A" 3 "Aux Temp B" 4 "Aux Temp C" 5 "Aux Temp D" DEFAULT_VALUE "UNKNOWN" /end COMPU_VTAB
/begin CHARACTERISTIC TAUX8_Taux_cal "{TAUX8_Taux_cal&0xff=0:Fuel source}{TAUX8_Taux_cal&0xff=1:Exhaust manifold/riser}{TAUX8_Taux_cal&0xff=2:Aux Temp A}{TAUX8_Taux_cal&0xff=3:Aux Temp B}{TAUX8_Taux_cal&0xff=4:Aux Temp C}{TAUX8_Taux_cal&0xff=5:Aux Temp D}" VALUE 0x001C8EFE /* @ECU_Address@TAUX8_Taux_cal@0x010096C0@ */ ECIPP_ALIGNMENT_UBYTE 255 TAUX8_Taux_cal_COMPU_VTAB 0 255 BIT_MASK 0xff /end CHARACTERISTIC
/begin COMPU_METHOD TAUX8_Taux_cal_COMPU_VTAB "Verbal Table" TAB_VERB "%.0" "list" COMPU_TAB_REF TAUX8_Taux_cal_COMPU_VTAB_REF /end COMPU_METHOD
/begin COMPU_VTAB TAUX8_Taux_cal_COMPU_VTAB_REF "Verbal Table" TAB_VERB 6 0 "Fuel source" 1 "Exhaust manifold/riser" 2 "Aux Temp A" 3 "Aux Temp B" 4 "Aux Temp C" 5 "Aux Temp D" DEFAULT_VALUE "UNKNOWN" /end COMPU_VTAB
/begin CHARACTERISTIC TAUX1_vdr "IOConfig # TAUX1_vdr" VALUE 0x001C3B38 /* @ECU_Address@TAUX1_vdr@0x010096C8@ */ ECIPP_ALIGNMENT_FLOAT32_IEEE 10000000000 Compu_TAUX1_vdr -10000000000 10000000000 /end CHARACTERISTIC
/begin COMPU_METHOD Compu_TAUX1_vdr " " RAT_FUNC "%.3" "ohms" COEFFS 0 1 0 0 0 1 /end COMPU_METHOD
/begin CHARACTERISTIC TAUX2_vdr "IOConfig # TAUX2_vdr" VALUE 0x001C3B3C /* @ECU_Address@TAUX2_vdr@0x010096D0@ */ ECIPP_ALIGNMENT_FLOAT32_IEEE 10000000000 Compu_TAUX2_vdr -10000000000 10000000000 /end CHARACTERISTIC
/begin COMPU_METHOD Compu_TAUX2_vdr " " RAT_FUNC "%.3" "ohms" COEFFS 0 1 0 0 0 1 /end COMPU_METHOD
/begin CHARACTERISTIC TAUX3_vdr "IOConfig # TAUX3_vdr" VALUE 0x001C3B40 /* @ECU_Address@TAUX3_vdr@0x010096D8@ */ ECIPP_ALIGNMENT_FLOAT32_IEEE 10000000000 Compu_TAUX3_vdr -10000000000 10000000000 /end CHARACTERISTIC
/begin COMPU_METHOD Compu_TAUX3_vdr " " RAT_FUNC "%.3" "ohms" COEFFS 0 1 0 0 0 1 /end COMPU_METHOD
/begin CHARACTERISTIC TAUX4_vdr "IOConfig # TAUX4_vdr" VALUE 0x001C3B44 /* @ECU_Address@TAUX4_vdr@0x010096E0@ */ ECIPP_ALIGNMENT_FLOAT32_IEEE 10000000000 Compu_TAUX4_vdr -10000000000 10000000000 /end CHARACTERISTIC
/begin COMPU_METHOD Compu_TAUX4_vdr " " RAT_FUNC "%.3" "ohms" COEFFS 0 1 0 0 0 1 /end COMPU_METHOD
/begin CHARACTERISTIC TAUX5_vdr "IOConfig # TAUX5_vdr" VALUE 0x001C3B48 /* @ECU_Address@TAUX5_vdr@0x010096E8@ */ ECIPP_ALIGNMENT_FLOAT32_IEEE 10000000000 Compu_TAUX5_vdr -10000000000 10000000000 /end CHARACTERISTIC
/begin COMPU_METHOD Compu_TAUX5_vdr " " RAT_FUNC "%.3" "ohms" COEFFS 0 1 0 0 0 1 /end COMPU_METHOD
/begin CHARACTERISTIC TAUX6_vdr "IOConfig # TAUX6_vdr" VALUE 0x001C3B4C /* @ECU_Address@TAUX6_vdr@0x010096F0@ */ ECIPP_ALIGNMENT_FLOAT32_IEEE 10000000000 Compu_TAUX6_vdr -10000000000 10000000000 /end CHARACTERISTIC
/begin COMPU_METHOD Compu_TAUX6_vdr " " RAT_FUNC "%.3" "ohms" COEFFS 0 1 0 0 0 1 /end COMPU_METHOD
/begin CHARACTERISTIC TAUX7_vdr "IOConfig # TAUX7_vdr" VALUE 0x001C3B50 /* @ECU_Address@TAUX7_vdr@0x010096F8@ */ ECIPP_ALIGNMENT_FLOAT32_IEEE 10000000000 Compu_TAUX7_vdr -10000000000 10000000000 /end CHARACTERISTIC
/begin COMPU_METHOD Compu_TAUX7_vdr " " RAT_FUNC "%.3" "ohms" COEFFS 0 1 0 0 0 1 /end COMPU_METHOD
/begin CHARACTERISTIC TAUX8_vdr "IOConfig # TAUX8_vdr" VALUE 0x001C3B54 /* @ECU_Address@TAUX8_vdr@0x01009700@ */ ECIPP_ALIGNMENT_FLOAT32_IEEE 10000000000 Compu_TAUX8_vdr -10000000000 10000000000 /end CHARACTERISTIC
/begin COMPU_METHOD Compu_TAUX8_vdr " " RAT_FUNC "%.3" "ohms" COEFFS 0 1 0 0 0 1 /end COMPU_METHOD
/begin CHARACTERISTIC EGR_clr_Tint_tau_nom "Air # EGR_clr_Tint_tau_nom" VALUE 0x001c0074 /* @ECU_Address@EGR_clr_Tint_tau_nom@0x01009828@ */ ECIPP_ALIGNMENT_FLOAT32_IEEE 10000000000 Compu_EGR_clr_Tint_tau_nom -10000000000 10000000000 /end CHARACTERISTIC
/begin COMPU_METHOD Compu_EGR_clr_Tint_tau_nom " " RAT_FUNC "%.3" "sec" COEFFS 0 1000 0 0 0 1 /end COMPU_METHOD
/begin CHARACTERISTIC APS_learn_idle_lim "General # APS_learn_idle_lim" VALUE 0x001C9E00 /* @ECU_Address@APS_learn_idle_lim@0x010098F0@ */ ECIPP_ALIGNMENT_UWORD 5 Compu_APS_learn_idle_lim 0 5.00114468864469 /end CHARACTERISTIC
/begin COMPU_METHOD Compu_APS_learn_idle_lim " " RAT_FUNC "%.3" "volts" COEFFS 0 13104 0 0 0 1 /end COMPU_METHOD
/begin CHARACTERISTIC BPS_learn_idle_lim "General # BPS_learn_idle_lim" VALUE 0x001C9EA0 /* @ECU_Address@BPS_learn_idle_lim@0x010098F8@ */ ECIPP_ALIGNMENT_UWORD 5 Compu_BPS_learn_idle_lim 0 5.00114468864469 /end CHARACTERISTIC
/begin COMPU_METHOD Compu_BPS_learn_idle_lim " " RAT_FUNC "%.3" "volts" COEFFS 0 13104 0 0 0 1 /end COMPU_METHOD
/begin CHARACTERISTIC APS1_idle_def "IOConfig # APS1_idle_def" VALUE 0x001C9E14 /* @ECU_Address@APS1_idle_def@0x01009900@ */ ECIPP_ALIGNMENT_FLOAT32_IEEE 10000000000 Compu_APS1_idle_def -10000000000 10000000000 /end CHARACTERISTIC
/begin COMPU_METHOD Compu_APS1_idle_def " " RAT_FUNC "%.3" "volts" COEFFS 0 1 0 0 0 1 /end COMPU_METHOD
/begin CHARACTERISTIC BPS1_idle_def "IOConfig # BPS1_idle_def" VALUE 0x001C9EB4 /* @ECU_Address@BPS1_idle_def@0x01009908@ */ ECIPP_ALIGNMENT_FLOAT32_IEEE 10000000000 Compu_BPS1_idle_def -10000000000 10000000000 /end CHARACTERISTIC
/begin COMPU_METHOD Compu_BPS1_idle_def " " RAT_FUNC "%.3" "volts" COEFFS 0 1 0 0 0 1 /end COMPU_METHOD
/begin CHARACTERISTIC APS1_def "IOConfig # APS1_def" VALUE 0x001ECCAE /* @ECU_Address@APS1_def@0x01009910@ */ ECIPP_ALIGNMENT_UWORD 5 Compu_APS1_def 0 5.00114468864469 /end CHARACTERISTIC
/begin COMPU_METHOD Compu_APS1_def " " RAT_FUNC "%.3" "volts" COEFFS 0 13104 0 0 0 1 /end COMPU_METHOD
/begin CHARACTERISTIC BPS1_def "IOConfig # BPS1_def" VALUE 0x001ECCC2 /* @ECU_Address@BPS1_def@0x01009918@ */ ECIPP_ALIGNMENT_UWORD 5 Compu_BPS1_def 0 5.00114468864469 /end CHARACTERISTIC
/begin COMPU_METHOD Compu_BPS1_def " " RAT_FUNC "%.3" "volts" COEFFS 0 13104 0 0 0 1 /end COMPU_METHOD
/begin CHARACTERISTIC APS1_idle_init "IOConfig # APS1_idle_init" VALUE 0x001ECCB4 /* @ECU_Address@APS1_idle_init@0x01009920@ */ ECIPP_ALIGNMENT_UWORD 5 Compu_APS1_idle_init 0 5.00114468864469 /end CHARACTERISTIC
/begin COMPU_METHOD Compu_APS1_idle_init " " RAT_FUNC "%.3" "volts" COEFFS 0 13104 0 0 0 1 /end COMPU_METHOD
/begin CHARACTERISTIC BPS1_idle_init "IOConfig # BPS1_idle_init" VALUE 0x001ECCC8 /* @ECU_Address@BPS1_idle_init@0x01009928@ */ ECIPP_ALIGNMENT_UWORD 5 Compu_BPS1_idle_init 0 5.00114468864469 /end CHARACTERISTIC
/begin COMPU_METHOD Compu_BPS1_idle_init " " RAT_FUNC "%.3" "volts" COEFFS 0 13104 0 0 0 1 /end COMPU_METHOD
/begin CHARACTERISTIC APS1_full_init "IOConfig # APS1_full_init" VALUE 0x001ECCB6 /* @ECU_Address@APS1_full_init@0x01009930@ */ ECIPP_ALIGNMENT_UWORD 5 Compu_APS1_full_init 0 5.00114468864469 /end CHARACTERISTIC
/begin COMPU_METHOD Compu_APS1_full_init " " RAT_FUNC "%.3" "volts" COEFFS 0 13104 0 0 0 1 /end COMPU_METHOD
/begin CHARACTERISTIC BPS1_full_init "IOConfig # BPS1_full_init" VALUE 0x001ECCCA /* @ECU_Address@BPS1_full_init@0x01009938@ */ ECIPP_ALIGNMENT_UWORD 5 Compu_BPS1_full_init 0 5.00114468864469 /end CHARACTERISTIC
/begin COMPU_METHOD Compu_BPS1_full_init " " RAT_FUNC "%.3" "volts" COEFFS 0 13104 0 0 0 1 /end COMPU_METHOD
/begin CHARACTERISTIC APS1_full_def "IOConfig # APS1_full_def" VALUE 0x001C9E18 /* @ECU_Address@APS1_full_def@0x01009940@ */ ECIPP_ALIGNMENT_FLOAT32_IEEE 10000000000 Compu_APS1_full_def -10000000000 10000000000 /end CHARACTERISTIC
/begin COMPU_METHOD Compu_APS1_full_def " " RAT_FUNC "%.3" "volts" COEFFS 0 1 0 0 0 1 /end COMPU_METHOD
/begin CHARACTERISTIC BPS1_full_def "IOConfig # BPS1_full_def" VALUE 0x001C9EB8 /* @ECU_Address@BPS1_full_def@0x01009948@ */ ECIPP_ALIGNMENT_FLOAT32_IEEE 10000000000 Compu_BPS1_full_def -10000000000 10000000000 /end CHARACTERISTIC
/begin COMPU_METHOD Compu_BPS1_full_def " " RAT_FUNC "%.3" "volts" COEFFS 0 1 0 0 0 1 /end COMPU_METHOD
/begin CHARACTERISTIC APS_learn_full_lim "General # APS_learn_full_lim" VALUE 0x001C9E06 /* @ECU_Address@APS_learn_full_lim@0x01009950@ */ ECIPP_ALIGNMENT_UWORD 5 Compu_APS_learn_full_lim 0 5.00114468864469 /end CHARACTERISTIC
/begin COMPU_METHOD Compu_APS_learn_full_lim " " RAT_FUNC "%.3" "volts" COEFFS 0 13104 0 0 0 1 /end COMPU_METHOD
/begin CHARACTERISTIC BPS_learn_full_lim "General # BPS_learn_full_lim" VALUE 0x001C9EA6 /* @ECU_Address@BPS_learn_full_lim@0x01009958@ */ ECIPP_ALIGNMENT_UWORD 5 Compu_BPS_learn_full_lim 0 5.00114468864469 /end CHARACTERISTIC
/begin COMPU_METHOD Compu_BPS_learn_full_lim " " RAT_FUNC "%.3" "volts" COEFFS 0 13104 0 0 0 1 /end COMPU_METHOD
/begin CHARACTERISTIC APS1_learn_wait "IOConfig # APS1_learn_wait" VALUE 0x001ECCB0 /* @ECU_Address@APS1_learn_wait@0x01009960@ */ ECIPP_ALIGNMENT_SWORD 32767 Compu_APS1_learn_wait -32768 32767 /end CHARACTERISTIC
/begin COMPU_METHOD Compu_APS1_learn_wait " " RAT_FUNC "%.0" "ms" COEFFS 0 1 0 0 0 1 /end COMPU_METHOD
/begin CHARACTERISTIC BPS1_learn_wait "IOConfig # BPS1_learn_wait" VALUE 0x001ECCC4 /* @ECU_Address@BPS1_learn_wait@0x01009968@ */ ECIPP_ALIGNMENT_SWORD 32767 Compu_BPS1_learn_wait -32768 32767 /end CHARACTERISTIC
/begin COMPU_METHOD Compu_BPS1_learn_wait " " RAT_FUNC "%.0" "ms" COEFFS 0 1 0 0 0 1 /end COMPU_METHOD
/begin CHARACTERISTIC APS1_learn_tau "IOConfig # APS1_learn_tau" VALUE 0x001ECCB2 /* @ECU_Address@APS1_learn_tau@0x01009970@ */ ECIPP_ALIGNMENT_UWORD 327680 Compu_APS1_learn_tau 0.45084 327680 /end CHARACTERISTIC
/begin COMPU_METHOD Compu_APS1_learn_tau " " FORM "%.3" "ms"
 /begin FORMULA "-5 / log(1 - (X1 / 65536))" FORMULA_INV "(1 - exp(-5/X1)) * 65536" /end FORMULA
/end COMPU_METHOD
/begin CHARACTERISTIC BPS1_learn_tau "IOConfig # BPS1_learn_tau" VALUE 0x001ECCC6 /* @ECU_Address@BPS1_learn_tau@0x01009978@ */ ECIPP_ALIGNMENT_UWORD 327680 Compu_BPS1_learn_tau 0.45084 327680 /end CHARACTERISTIC
/begin COMPU_METHOD Compu_BPS1_learn_tau " " FORM "%.3" "ms"
 /begin FORMULA "-5 / log(1 - (X1 / 65536))" FORMULA_INV "(1 - exp(-5/X1)) * 65536" /end FORMULA
/end COMPU_METHOD
/begin CHARACTERISTIC APS2_def "IOConfig # APS2_def" VALUE 0x001ECCB8 /* @ECU_Address@APS2_def@0x01009980@ */ ECIPP_ALIGNMENT_UWORD 5 Compu_APS2_def 0 5.00114468864469 /end CHARACTERISTIC
/begin COMPU_METHOD Compu_APS2_def " " RAT_FUNC "%.3" "volts" COEFFS 0 13104 0 0 0 1 /end COMPU_METHOD
/begin CHARACTERISTIC BPS2_def "IOConfig # BPS2_def" VALUE 0x001ECCCC /* @ECU_Address@BPS2_def@0x01009988@ */ ECIPP_ALIGNMENT_UWORD 5 Compu_BPS2_def 0 5.00114468864469 /end CHARACTERISTIC
/begin COMPU_METHOD Compu_BPS2_def " " RAT_FUNC "%.3" "volts" COEFFS 0 13104 0 0 0 1 /end COMPU_METHOD
/begin CHARACTERISTIC APS2_idle_init "IOConfig # APS2_idle_init" VALUE 0x001ECCBE /* @ECU_Address@APS2_idle_init@0x01009990@ */ ECIPP_ALIGNMENT_UWORD 5 Compu_APS2_idle_init 0 5.00114468864469 /end CHARACTERISTIC
/begin COMPU_METHOD Compu_APS2_idle_init " " RAT_FUNC "%.3" "volts" COEFFS 0 13104 0 0 0 1 /end COMPU_METHOD
/begin CHARACTERISTIC BPS2_idle_init "IOConfig # BPS2_idle_init" VALUE 0x001ECCD2 /* @ECU_Address@BPS2_idle_init@0x01009998@ */ ECIPP_ALIGNMENT_UWORD 5 Compu_BPS2_idle_init 0 5.00114468864469 /end CHARACTERISTIC
/begin COMPU_METHOD Compu_BPS2_idle_init " " RAT_FUNC "%.3" "volts" COEFFS 0 13104 0 0 0 1 /end COMPU_METHOD
/begin CHARACTERISTIC APS2_full_init "IOConfig # APS2_full_init" VALUE 0x001ECCC0 /* @ECU_Address@APS2_full_init@0x010099A0@ */ ECIPP_ALIGNMENT_UWORD 5 Compu_APS2_full_init 0 5.00114468864469 /end CHARACTERISTIC
/begin COMPU_METHOD Compu_APS2_full_init " " RAT_FUNC "%.3" "volts" COEFFS 0 13104 0 0 0 1 /end COMPU_METHOD
/begin CHARACTERISTIC BPS2_full_init "IOConfig # BPS2_full_init" VALUE 0x001ECCD4 /* @ECU_Address@BPS2_full_init@0x010099A8@ */ ECIPP_ALIGNMENT_UWORD 5 Compu_BPS2_full_init 0 5.00114468864469 /end CHARACTERISTIC
/begin COMPU_METHOD Compu_BPS2_full_init " " RAT_FUNC "%.3" "volts" COEFFS 0 13104 0 0 0 1 /end COMPU_METHOD
/begin CHARACTERISTIC APS2_learn_wait "IOConfig # APS2_learn_wait" VALUE 0x001ECCBA /* @ECU_Address@APS2_learn_wait@0x010099B0@ */ ECIPP_ALIGNMENT_SWORD 32767 Compu_APS2_learn_wait -32768 32767 /end CHARACTERISTIC
/begin COMPU_METHOD Compu_APS2_learn_wait " " RAT_FUNC "%.0" "ms" COEFFS 0 1 0 0 0 1 /end COMPU_METHOD
/begin CHARACTERISTIC BPS2_learn_wait "IOConfig # BPS2_learn_wait" VALUE 0x001ECCCE /* @ECU_Address@BPS2_learn_wait@0x010099B8@ */ ECIPP_ALIGNMENT_SWORD 32767 Compu_BPS2_learn_wait -32768 32767 /end CHARACTERISTIC
/begin COMPU_METHOD Compu_BPS2_learn_wait " " RAT_FUNC "%.0" "ms" COEFFS 0 1 0 0 0 1 /end COMPU_METHOD
/begin CHARACTERISTIC APS2_learn_tau "IOConfig # APS2_learn_tau" VALUE 0x001ECCBC /* @ECU_Address@APS2_learn_tau@0x010099C0@ */ ECIPP_ALIGNMENT_UWORD 327680 Compu_APS2_learn_tau 0.45084 327680 /end CHARACTERISTIC
/begin COMPU_METHOD Compu_APS2_learn_tau " " FORM "%.3" "ms"
 /begin FORMULA "-5 / log(1 - (X1 / 65536))" FORMULA_INV "(1 - exp(-5/X1)) * 65536" /end FORMULA
/end COMPU_METHOD
/begin CHARACTERISTIC BPS2_learn_tau "IOConfig # BPS2_learn_tau" VALUE 0x001ECCD0 /* @ECU_Address@BPS2_learn_tau@0x010099C8@ */ ECIPP_ALIGNMENT_UWORD 327680 Compu_BPS2_learn_tau 0.45084 327680 /end CHARACTERISTIC
/begin COMPU_METHOD Compu_BPS2_learn_tau " " FORM "%.3" "ms"
 /begin FORMULA "-5 / log(1 - (X1 / 65536))" FORMULA_INV "(1 - exp(-5/X1)) * 65536" /end FORMULA
/end COMPU_METHOD
/begin CHARACTERISTIC APS_learn_idle_seek "Gov # APS_learn_idle_seek" VALUE 0x001C9E02 /* @ECU_Address@APS_learn_idle_seek@0x010099D0@ */ ECIPP_ALIGNMENT_UWORD 100 Compu_APS_learn_idle_seek 0 99.9984741210938 /end CHARACTERISTIC
/begin COMPU_METHOD Compu_APS_learn_idle_seek " " RAT_FUNC "%.3" "%" COEFFS 0 655.36 0 0 0 1 /end COMPU_METHOD
/begin CHARACTERISTIC BPS_learn_idle_seek "Gov # BPS_learn_idle_seek" VALUE 0x001C9EA2 /* @ECU_Address@BPS_learn_idle_seek@0x010099D8@ */ ECIPP_ALIGNMENT_UWORD 100 Compu_BPS_learn_idle_seek 0 99.9984741210938 /end CHARACTERISTIC
/begin COMPU_METHOD Compu_BPS_learn_idle_seek " " RAT_FUNC "%.3" "%" COEFFS 0 655.36 0 0 0 1 /end COMPU_METHOD
/begin CHARACTERISTIC APS_learn_full_seek "Gov # APS_learn_full_seek" VALUE 0x001C9E08 /* @ECU_Address@APS_learn_full_seek@0x010099E0@ */ ECIPP_ALIGNMENT_UWORD 100 Compu_APS_learn_full_seek 0 99.9984741210938 /end CHARACTERISTIC
/begin COMPU_METHOD Compu_APS_learn_full_seek " " RAT_FUNC "%.3" "%" COEFFS 0 655.36 0 0 0 1 /end COMPU_METHOD
/begin CHARACTERISTIC BPS_learn_full_seek "Gov # BPS_learn_full_seek" VALUE 0x001C9EA8 /* @ECU_Address@BPS_learn_full_seek@0x010099E8@ */ ECIPP_ALIGNMENT_UWORD 100 Compu_BPS_learn_full_seek 0 99.9984741210938 /end CHARACTERISTIC
/begin COMPU_METHOD Compu_BPS_learn_full_seek " " RAT_FUNC "%.3" "%" COEFFS 0 655.36 0 0 0 1 /end COMPU_METHOD
/begin CHARACTERISTIC APS_learn_idle_ofst "General # APS_learn_idle_ofst" VALUE 0x001C9E04 /* @ECU_Address@APS_learn_idle_ofst@0x010099F0@ */ ECIPP_ALIGNMENT_UWORD 5 Compu_APS_learn_idle_ofst 0 5.00114468864469 /end CHARACTERISTIC
/begin COMPU_METHOD Compu_APS_learn_idle_ofst " " RAT_FUNC "%.3" "volts" COEFFS 0 13104 0 0 0 1 /end COMPU_METHOD
/begin CHARACTERISTIC BPS_learn_idle_ofst "General # BPS_learn_idle_ofst" VALUE 0x001C9EA4 /* @ECU_Address@BPS_learn_idle_ofst@0x010099F8@ */ ECIPP_ALIGNMENT_UWORD 5 Compu_BPS_learn_idle_ofst 0 5.00114468864469 /end CHARACTERISTIC
/begin COMPU_METHOD Compu_BPS_learn_idle_ofst " " RAT_FUNC "%.3" "volts" COEFFS 0 13104 0 0 0 1 /end COMPU_METHOD
/begin CHARACTERISTIC APS_learn_full_ofst "General # APS_learn_full_ofst" VALUE 0x001C9E0A /* @ECU_Address@APS_learn_full_ofst@0x01009A00@ */ ECIPP_ALIGNMENT_UWORD 5 Compu_APS_learn_full_ofst 0 5.00114468864469 /end CHARACTERISTIC
/begin COMPU_METHOD Compu_APS_learn_full_ofst " " RAT_FUNC "%.3" "volts" COEFFS 0 13104 0 0 0 1 /end COMPU_METHOD
/begin CHARACTERISTIC BPS_learn_full_ofst "General # BPS_learn_full_ofst" VALUE 0x001C9EAA /* @ECU_Address@BPS_learn_full_ofst@0x01009A08@ */ ECIPP_ALIGNMENT_UWORD 5 Compu_BPS_learn_full_ofst 0 5.00114468864469 /end CHARACTERISTIC
/begin COMPU_METHOD Compu_BPS_learn_full_ofst " " RAT_FUNC "%.3" "volts" COEFFS 0 13104 0 0 0 1 /end COMPU_METHOD
/begin CHARACTERISTIC AEM_R "IOConfig # AEM_R" VALUE 0x001C9E54 /* @ECU_Address@AEM_R@0x01009AE0@ */ ECIPP_ALIGNMENT_FLOAT32_IEEE 10000000000 Compu_AEM_R -10000000000 10000000000 /end CHARACTERISTIC
/begin COMPU_METHOD Compu_AEM_R " " RAT_FUNC "%.3" "ohms" COEFFS 0 1 0 0 0 1 /end COMPU_METHOD
/begin CHARACTERISTIC BEM_R "IOConfig # BEM_R" VALUE 0x001C9EF4 /* @ECU_Address@BEM_R@0x01009AE8@ */ ECIPP_ALIGNMENT_FLOAT32_IEEE 10000000000 Compu_BEM_R -10000000000 10000000000 /end CHARACTERISTIC
/begin COMPU_METHOD Compu_BEM_R " " RAT_FUNC "%.3" "ohms" COEFFS 0 1 0 0 0 1 /end COMPU_METHOD
/begin CHARACTERISTIC AEM_L "IOConfig # AEM_L" VALUE 0x001C9E58 /* @ECU_Address@AEM_L@0x01009AF0@ */ ECIPP_ALIGNMENT_FLOAT32_IEEE 10000000000 Compu_AEM_L -10000000000 10000000000 /end CHARACTERISTIC
/begin COMPU_METHOD Compu_AEM_L " " RAT_FUNC "%.3" "mH" COEFFS 0 1 0 0 0 1 /end COMPU_METHOD
/begin CHARACTERISTIC BEM_L "IOConfig # BEM_L" VALUE 0x001C9EF8 /* @ECU_Address@BEM_L@0x01009AF8@ */ ECIPP_ALIGNMENT_FLOAT32_IEEE 10000000000 Compu_BEM_L -10000000000 10000000000 /end CHARACTERISTIC
/begin COMPU_METHOD Compu_BEM_L " " RAT_FUNC "%.3" "mH" COEFFS 0 1 0 0 0 1 /end COMPU_METHOD
/begin CHARACTERISTIC AEM_Kv "IOConfig # AEM_Kv" VALUE 0x001C9E5C /* @ECU_Address@AEM_Kv@0x01009B00@ */ ECIPP_ALIGNMENT_FLOAT32_IEEE 10000000000 Compu_AEM_Kv -10000000000 10000000000 /end CHARACTERISTIC
/begin COMPU_METHOD Compu_AEM_Kv " " RAT_FUNC "%.3" "V / (100% / sec)" COEFFS 0 1 0 0 0 1 /end COMPU_METHOD
/begin CHARACTERISTIC BEM_Kv "IOConfig # BEM_Kv" VALUE 0x001C9EFC /* @ECU_Address@BEM_Kv@0x01009B08@ */ ECIPP_ALIGNMENT_FLOAT32_IEEE 10000000000 Compu_BEM_Kv -10000000000 10000000000 /end CHARACTERISTIC
/begin COMPU_METHOD Compu_BEM_Kv " " RAT_FUNC "%.3" "V / (100% / sec)" COEFFS 0 1 0 0 0 1 /end COMPU_METHOD
/begin CHARACTERISTIC AEM_V_diode "General # AEM_V_diode" VALUE 0x001C9E60 /* @ECU_Address@AEM_V_diode@0x01009B10@ */ ECIPP_ALIGNMENT_UWORD 256 Compu_AEM_V_diode 0 255.99609375 /end CHARACTERISTIC
/begin COMPU_METHOD Compu_AEM_V_diode " " RAT_FUNC "%.3" "volts" COEFFS 0 256 0 0 0 1 /end COMPU_METHOD
/begin CHARACTERISTIC BEM_V_diode "General # BEM_V_diode" VALUE 0x001C9F00 /* @ECU_Address@BEM_V_diode@0x01009B18@ */ ECIPP_ALIGNMENT_UWORD 256 Compu_BEM_V_diode 0 255.99609375 /end CHARACTERISTIC
/begin COMPU_METHOD Compu_BEM_V_diode " " RAT_FUNC "%.3" "volts" COEFFS 0 256 0 0 0 1 /end COMPU_METHOD
/begin CHARACTERISTIC AEM_hard_Ilim "General # AEM_hard_Ilim" VALUE 0x001C9E62 /* @ECU_Address@AEM_hard_Ilim@0x01009B20@ */ ECIPP_ALIGNMENT_SWORD 32 Compu_AEM_hard_Ilim -32 31.9990234375 /end CHARACTERISTIC
/begin COMPU_METHOD Compu_AEM_hard_Ilim " " RAT_FUNC "%.3" "amps" COEFFS 0 1024 0 0 0 1 /end COMPU_METHOD
/begin CHARACTERISTIC BEM_hard_Ilim "General # BEM_hard_Ilim" VALUE 0x001C9F02 /* @ECU_Address@BEM_hard_Ilim@0x01009B28@ */ ECIPP_ALIGNMENT_SWORD 32 Compu_BEM_hard_Ilim -32 31.9990234375 /end CHARACTERISTIC
/begin COMPU_METHOD Compu_BEM_hard_Ilim " " RAT_FUNC "%.3" "amps" COEFFS 0 1024 0 0 0 1 /end COMPU_METHOD
/begin CHARACTERISTIC IparkA_Ilim "General # IparkA_Ilim" VALUE 0x001C9E66 /* @ECU_Address@IparkA_Ilim@0x01009B30@ */ ECIPP_ALIGNMENT_UWORD 64 Compu_IparkA_Ilim 0 63.9990234375 /end CHARACTERISTIC
/begin COMPU_METHOD Compu_IparkA_Ilim " " RAT_FUNC "%.3" "amps" COEFFS 0 1024 0 0 0 1 /end COMPU_METHOD
/begin CHARACTERISTIC IparkB_Ilim "General # IparkB_Ilim" VALUE 0x001C9F06 /* @ECU_Address@IparkB_Ilim@0x01009B38@ */ ECIPP_ALIGNMENT_UWORD 64 Compu_IparkB_Ilim 0 63.9990234375 /end CHARACTERISTIC
/begin COMPU_METHOD Compu_IparkB_Ilim " " RAT_FUNC "%.3" "amps" COEFFS 0 1024 0 0 0 1 /end COMPU_METHOD
/begin CHARACTERISTIC IparkA_Ki "General # IparkA_Ki" VALUE 0x001C9E72 /* @ECU_Address@IparkA_Ki@0x01009B40@ */ ECIPP_ALIGNMENT_UWORD 3125 Compu_IparkA_Ki 0 3124.95231628418 /end CHARACTERISTIC
/begin COMPU_METHOD Compu_IparkA_Ki " " RAT_FUNC "%.3" "% / amp / sec" COEFFS 0 20.97152 0 0 0 1 /end COMPU_METHOD
/begin CHARACTERISTIC IparkB_Ki "General # IparkB_Ki" VALUE 0x001C9F12 /* @ECU_Address@IparkB_Ki@0x01009B48@ */ ECIPP_ALIGNMENT_UWORD 3125 Compu_IparkB_Ki 0 3124.95231628418 /end CHARACTERISTIC
/begin COMPU_METHOD Compu_IparkB_Ki " " RAT_FUNC "%.3" "% / amp / sec" COEFFS 0 20.97152 0 0 0 1 /end COMPU_METHOD
/begin CHARACTERISTIC IparkA_dly "General # IparkA_dly" VALUE 0x001C9E70 /* @ECU_Address@IparkA_dly@0x01009B50@ */ ECIPP_ALIGNMENT_UWORD 66 Compu_IparkA_dly 0 65.535 /end CHARACTERISTIC
/begin COMPU_METHOD Compu_IparkA_dly " " RAT_FUNC "%.3" "seconds" COEFFS 0 1000 0 0 0 1 /end COMPU_METHOD
/begin CHARACTERISTIC IparkB_dly "General # IparkB_dly" VALUE 0x001C9F10 /* @ECU_Address@IparkB_dly@0x01009B58@ */ ECIPP_ALIGNMENT_UWORD 66 Compu_IparkB_dly 0 65.535 /end CHARACTERISTIC
/begin COMPU_METHOD Compu_IparkB_dly " " RAT_FUNC "%.3" "seconds" COEFFS 0 1000 0 0 0 1 /end COMPU_METHOD
/begin CHARACTERISTIC IparkA_ena "{IparkA_ena&0xff=0:Disabled}{IparkA_ena&0xff=1:Single-Point}{IparkA_ena&0xff=2:1-D Table-Based}" VALUE 0x001C9E64 /* @ECU_Address@IparkA_ena@0x01009B60@ */ ECIPP_ALIGNMENT_UBYTE 255 IparkA_ena_COMPU_VTAB 0 255 BIT_MASK 0xff /end CHARACTERISTIC
/begin COMPU_METHOD IparkA_ena_COMPU_VTAB "Verbal Table" TAB_VERB "%.0" "list" COMPU_TAB_REF IparkA_ena_COMPU_VTAB_REF /end COMPU_METHOD
/begin COMPU_VTAB IparkA_ena_COMPU_VTAB_REF "Verbal Table" TAB_VERB 3 0 "Disabled" 1 "Single-Point" 2 "1-D Table-Based" DEFAULT_VALUE "UNKNOWN" /end COMPU_VTAB
/begin CHARACTERISTIC IparkB_ena "{IparkB_ena&0xff=0:Disabled}{IparkB_ena&0xff=1:Single-Point}{IparkB_ena&0xff=2:1-D Table-Based}" VALUE 0x001C9F04 /* @ECU_Address@IparkB_ena@0x01009B68@ */ ECIPP_ALIGNMENT_UBYTE 255 IparkB_ena_COMPU_VTAB 0 255 BIT_MASK 0xff /end CHARACTERISTIC
/begin COMPU_METHOD IparkB_ena_COMPU_VTAB "Verbal Table" TAB_VERB "%.0" "list" COMPU_TAB_REF IparkB_ena_COMPU_VTAB_REF /end COMPU_METHOD
/begin COMPU_VTAB IparkB_ena_COMPU_VTAB_REF "Verbal Table" TAB_VERB 3 0 "Disabled" 1 "Single-Point" 2 "1-D Table-Based" DEFAULT_VALUE "UNKNOWN" /end COMPU_VTAB
/begin CHARACTERISTIC IparkA_max_att "General # IparkA_max_att" VALUE 0x001C9E74 /* @ECU_Address@IparkA_max_att@0x01009B70@ */ ECIPP_ALIGNMENT_SWORD 100 Compu_IparkA_max_att -100 99.9969482421875 /end CHARACTERISTIC
/begin COMPU_METHOD Compu_IparkA_max_att " " RAT_FUNC "%.3" "% decrease" COEFFS 0 327.68 0 0 0 1 /end COMPU_METHOD
/begin CHARACTERISTIC IparkB_max_att "General # IparkB_max_att" VALUE 0x001C9F14 /* @ECU_Address@IparkB_max_att@0x01009B78@ */ ECIPP_ALIGNMENT_SWORD 100 Compu_IparkB_max_att -100 99.9969482421875 /end CHARACTERISTIC
/begin COMPU_METHOD Compu_IparkB_max_att " " RAT_FUNC "%.3" "% decrease" COEFFS 0 327.68 0 0 0 1 /end COMPU_METHOD
/begin CHARACTERISTIC HBA_spring_0 "Gov # HBA_spring_0" VALUE 0x001C9E76 /* @ECU_Address@HBA_spring_0@0x01009B80@ */ ECIPP_ALIGNMENT_SWORD 200 Compu_HBA_spring_0 -200 199.993896484375 /end CHARACTERISTIC
/begin COMPU_METHOD Compu_HBA_spring_0 " " RAT_FUNC "%.3" "%" COEFFS 0 163.84 0 0 0 1 /end COMPU_METHOD
/begin CHARACTERISTIC HBB_spring_0 "Gov # HBB_spring_0" VALUE 0x001C9F16 /* @ECU_Address@HBB_spring_0@0x01009B88@ */ ECIPP_ALIGNMENT_SWORD 200 Compu_HBB_spring_0 -200 199.993896484375 /end CHARACTERISTIC
/begin COMPU_METHOD Compu_HBB_spring_0 " " RAT_FUNC "%.3" "%" COEFFS 0 163.84 0 0 0 1 /end COMPU_METHOD
/begin CHARACTERISTIC HBA_spring_100 "Gov # HBA_spring_100" VALUE 0x001C9E78 /* @ECU_Address@HBA_spring_100@0x01009B90@ */ ECIPP_ALIGNMENT_SWORD 200 Compu_HBA_spring_100 -200 199.993896484375 /end CHARACTERISTIC
/begin COMPU_METHOD Compu_HBA_spring_100 " " RAT_FUNC "%.3" "%" COEFFS 0 163.84 0 0 0 1 /end COMPU_METHOD
/begin CHARACTERISTIC HBB_spring_100 "Gov # HBB_spring_100" VALUE 0x001C9F18 /* @ECU_Address@HBB_spring_100@0x01009B98@ */ ECIPP_ALIGNMENT_SWORD 200 Compu_HBB_spring_100 -200 199.993896484375 /end CHARACTERISTIC
/begin COMPU_METHOD Compu_HBB_spring_100 " " RAT_FUNC "%.3" "%" COEFFS 0 163.84 0 0 0 1 /end COMPU_METHOD
/begin CHARACTERISTIC HBA_Vcomp_min "Gov # HBA_Vcomp_min" VALUE 0x001C9E8E /* @ECU_Address@HBA_Vcomp_min@0x01009C40@ */ ECIPP_ALIGNMENT_UWORD 256 Compu_HBA_Vcomp_min 0 255.99609375 /end CHARACTERISTIC
/begin COMPU_METHOD Compu_HBA_Vcomp_min " " RAT_FUNC "%.3" "volts" COEFFS 0 256 0 0 0 1 /end COMPU_METHOD
/begin CHARACTERISTIC HBB_Vcomp_min "Gov # HBB_Vcomp_min" VALUE 0x001C9F2E /* @ECU_Address@HBB_Vcomp_min@0x01009C48@ */ ECIPP_ALIGNMENT_UWORD 256 Compu_HBB_Vcomp_min 0 255.99609375 /end CHARACTERISTIC
/begin COMPU_METHOD Compu_HBB_Vcomp_min " " RAT_FUNC "%.3" "volts" COEFFS 0 256 0 0 0 1 /end COMPU_METHOD
/begin CHARACTERISTIC HBA_Vcomp_max "Gov # HBA_Vcomp_max" VALUE 0x001C9E90 /* @ECU_Address@HBA_Vcomp_max@0x01009C50@ */ ECIPP_ALIGNMENT_UWORD 256 Compu_HBA_Vcomp_max 0 255.99609375 /end CHARACTERISTIC
/begin COMPU_METHOD Compu_HBA_Vcomp_max " " RAT_FUNC "%.3" "volts" COEFFS 0 256 0 0 0 1 /end COMPU_METHOD
/begin CHARACTERISTIC HBB_Vcomp_max "Gov # HBB_Vcomp_max" VALUE 0x001C9F30 /* @ECU_Address@HBB_Vcomp_max@0x01009C58@ */ ECIPP_ALIGNMENT_UWORD 256 Compu_HBB_Vcomp_max 0 255.99609375 /end CHARACTERISTIC
/begin COMPU_METHOD Compu_HBB_Vcomp_max " " RAT_FUNC "%.3" "volts" COEFFS 0 256 0 0 0 1 /end COMPU_METHOD
/begin CHARACTERISTIC APS1_min "FaultConfig # APS1_min (Fault Condition:APS1 voltage <)" VALUE 0x001C9E3A /* @ECU_Address@APS1_min@0x01009D80@ */ ECIPP_ALIGNMENT_UWORD 5 Compu_APS1_min 0 5.00114468864469 /end CHARACTERISTIC
/begin COMPU_METHOD Compu_APS1_min " " RAT_FUNC "%.3" "volts" COEFFS 0 13104 0 0 0 1 /end COMPU_METHOD
/begin CHARACTERISTIC APS1_max "FaultConfig # APS1_max (Fault Condition:APS1 voltage >)" VALUE 0x001C9E3C /* @ECU_Address@APS1_max@0x01009D88@ */ ECIPP_ALIGNMENT_UWORD 5 Compu_APS1_max 0 5.00114468864469 /end CHARACTERISTIC
/begin COMPU_METHOD Compu_APS1_max " " RAT_FUNC "%.3" "volts" COEFFS 0 13104 0 0 0 1 /end COMPU_METHOD
/begin CHARACTERISTIC APS2_min "FaultConfig # APS2_min (Fault Condition:APS2 voltage <)" VALUE 0x001C9E3E /* @ECU_Address@APS2_min@0x01009D90@ */ ECIPP_ALIGNMENT_UWORD 5 Compu_APS2_min 0 5.00114468864469 /end CHARACTERISTIC
/begin COMPU_METHOD Compu_APS2_min " " RAT_FUNC "%.3" "volts" COEFFS 0 13104 0 0 0 1 /end COMPU_METHOD
/begin CHARACTERISTIC APS2_max "FaultConfig # APS2_max (Fault Condition:APS2 voltage >)" VALUE 0x001C9E40 /* @ECU_Address@APS2_max@0x01009D98@ */ ECIPP_ALIGNMENT_UWORD 5 Compu_APS2_max 0 5.00114468864469 /end CHARACTERISTIC
/begin COMPU_METHOD Compu_APS2_max " " RAT_FUNC "%.3" "volts" COEFFS 0 13104 0 0 0 1 /end COMPU_METHOD
/begin CHARACTERISTIC APS12pct_hi "FaultConfig # APS12pct_hi (Fault Condition:(APS1% - APS2%) >)" VALUE 0x001C9E42 /* @ECU_Address@APS12pct_hi@0x01009DA0@ */ ECIPP_ALIGNMENT_SWORD 100 Compu_APS12pct_hi -100 99.9969482421875 /end CHARACTERISTIC
/begin COMPU_METHOD Compu_APS12pct_hi " " RAT_FUNC "%.3" "%" COEFFS 0 327.68 0 0 0 1 /end COMPU_METHOD
/begin CHARACTERISTIC APS12pct_lo "FaultConfig # APS12pct_lo (Fault Condition:(APS1% - APS2%) <)" VALUE 0x001C9E44 /* @ECU_Address@APS12pct_lo@0x01009DA8@ */ ECIPP_ALIGNMENT_SWORD 100 Compu_APS12pct_lo -100 99.9969482421875 /end CHARACTERISTIC
/begin COMPU_METHOD Compu_APS12pct_lo " " RAT_FUNC "%.3" "%" COEFFS 0 327.68 0 0 0 1 /end COMPU_METHOD
/begin CHARACTERISTIC APSerr_pos "FaultConfig # APSerr_pos (Fault Condition:(target APS - actual APS) >)" VALUE 0x001C9E46 /* @ECU_Address@APSerr_pos@0x01009DB0@ */ ECIPP_ALIGNMENT_SWORD 100 Compu_APSerr_pos -100 99.9969482421875 /end CHARACTERISTIC
/begin COMPU_METHOD Compu_APSerr_pos " " RAT_FUNC "%.3" "%" COEFFS 0 327.68 0 0 0 1 /end COMPU_METHOD
/begin CHARACTERISTIC APSerr_neg "FaultConfig # APSerr_neg (Fault Condition:(target APS - actual APS) <)" VALUE 0x001C9E48 /* @ECU_Address@APSerr_neg@0x01009DB8@ */ ECIPP_ALIGNMENT_SWORD 100 Compu_APSerr_neg -100 99.9969482421875 /end CHARACTERISTIC
/begin COMPU_METHOD Compu_APSerr_neg " " RAT_FUNC "%.3" "%" COEFFS 0 327.68 0 0 0 1 /end COMPU_METHOD
/begin CHARACTERISTIC APSerr_wait "FaultConfig # APSerr_wait (Fault Condition:persistently longer than)" VALUE 0x001C9E4A /* @ECU_Address@APSerr_wait@0x01009DC0@ */ ECIPP_ALIGNMENT_UWORD 65535 Compu_APSerr_wait 0 65535 /end CHARACTERISTIC
/begin COMPU_METHOD Compu_APSerr_wait " " RAT_FUNC "%.0" "ms" COEFFS 0 1 0 0 0 1 /end COMPU_METHOD
/begin CHARACTERISTIC APSerr_minVbat "FaultConfig # APSerr_minVbat (Fault Condition:while battery voltage >)" VALUE 0x001C9E4C /* @ECU_Address@APSerr_minVbat@0x01009DC8@ */ ECIPP_ALIGNMENT_UWORD 256 Compu_APSerr_minVbat 0 255.99609375 /end CHARACTERISTIC
/begin COMPU_METHOD Compu_APSerr_minVbat " " RAT_FUNC "%.3" "volts" COEFFS 0 256 0 0 0 1 /end COMPU_METHOD
/begin CHARACTERISTIC BPS1_min "FaultConfig # BPS1_min (Fault Condition:BPS1 voltage <)" VALUE 0x001C9EDA /* @ECU_Address@BPS1_min@0x01009DD8@ */ ECIPP_ALIGNMENT_UWORD 5 Compu_BPS1_min 0 5.00114468864469 /end CHARACTERISTIC
/begin COMPU_METHOD Compu_BPS1_min " " RAT_FUNC "%.3" "volts" COEFFS 0 13104 0 0 0 1 /end COMPU_METHOD
/begin CHARACTERISTIC BPS1_max "FaultConfig # BPS1_max (Fault Condition:BPS1 voltage >)" VALUE 0x001C9EDC /* @ECU_Address@BPS1_max@0x01009DE0@ */ ECIPP_ALIGNMENT_UWORD 5 Compu_BPS1_max 0 5.00114468864469 /end CHARACTERISTIC
/begin COMPU_METHOD Compu_BPS1_max " " RAT_FUNC "%.3" "volts" COEFFS 0 13104 0 0 0 1 /end COMPU_METHOD
/begin CHARACTERISTIC BPS2_min "FaultConfig # BPS2_min (Fault Condition:BPS2 voltage <)" VALUE 0x001C9EDE /* @ECU_Address@BPS2_min@0x01009DE8@ */ ECIPP_ALIGNMENT_UWORD 5 Compu_BPS2_min 0 5.00114468864469 /end CHARACTERISTIC
/begin COMPU_METHOD Compu_BPS2_min " " RAT_FUNC "%.3" "volts" COEFFS 0 13104 0 0 0 1 /end COMPU_METHOD
/begin CHARACTERISTIC BPS2_max "FaultConfig # BPS2_max (Fault Condition:BPS2 voltage >)" VALUE 0x001C9EE0 /* @ECU_Address@BPS2_max@0x01009DF0@ */ ECIPP_ALIGNMENT_UWORD 5 Compu_BPS2_max 0 5.00114468864469 /end CHARACTERISTIC
/begin COMPU_METHOD Compu_BPS2_max " " RAT_FUNC "%.3" "volts" COEFFS 0 13104 0 0 0 1 /end COMPU_METHOD
/begin CHARACTERISTIC BPS12pct_hi "FaultConfig # BPS12pct_hi (Fault Condition:(BPS1% - BPS2%) >)" VALUE 0x001C9EE2 /* @ECU_Address@BPS12pct_hi@0x01009DF8@ */ ECIPP_ALIGNMENT_SWORD 100 Compu_BPS12pct_hi -100 99.9969482421875 /end CHARACTERISTIC
/begin COMPU_METHOD Compu_BPS12pct_hi " " RAT_FUNC "%.3" "%" COEFFS 0 327.68 0 0 0 1 /end COMPU_METHOD
/begin CHARACTERISTIC BPS12pct_lo "FaultConfig # BPS12pct_lo (Fault Condition:(BPS1% - BPS2%) <)" VALUE 0x001C9EE4 /* @ECU_Address@BPS12pct_lo@0x01009E00@ */ ECIPP_ALIGNMENT_SWORD 100 Compu_BPS12pct_lo -100 99.9969482421875 /end CHARACTERISTIC
/begin COMPU_METHOD Compu_BPS12pct_lo " " RAT_FUNC "%.3" "%" COEFFS 0 327.68 0 0 0 1 /end COMPU_METHOD
/begin CHARACTERISTIC BPSerr_pos "FaultConfig # BPSerr_pos (Fault Condition:(target BPS - actual BPS) >)" VALUE 0x001C9EE6 /* @ECU_Address@BPSerr_pos@0x01009E08@ */ ECIPP_ALIGNMENT_SWORD 100 Compu_BPSerr_pos -100 99.9969482421875 /end CHARACTERISTIC
/begin COMPU_METHOD Compu_BPSerr_pos " " RAT_FUNC "%.3" "%" COEFFS 0 327.68 0 0 0 1 /end COMPU_METHOD
/begin CHARACTERISTIC BPSerr_neg "FaultConfig # BPSerr_neg (Fault Condition:(target BPS - actual BPS) <)" VALUE 0x001C9EE8 /* @ECU_Address@BPSerr_neg@0x01009E10@ */ ECIPP_ALIGNMENT_SWORD 100 Compu_BPSerr_neg -100 99.9969482421875 /end CHARACTERISTIC
/begin COMPU_METHOD Compu_BPSerr_neg " " RAT_FUNC "%.3" "%" COEFFS 0 327.68 0 0 0 1 /end COMPU_METHOD
/begin CHARACTERISTIC BPSerr_wait "FaultConfig # BPSerr_wait (Fault Condition:persistently longer than)" VALUE 0x001C9EEA /* @ECU_Address@BPSerr_wait@0x01009E18@ */ ECIPP_ALIGNMENT_UWORD 65535 Compu_BPSerr_wait 0 65535 /end CHARACTERISTIC
/begin COMPU_METHOD Compu_BPSerr_wait " " RAT_FUNC "%.0" "ms" COEFFS 0 1 0 0 0 1 /end COMPU_METHOD
/begin CHARACTERISTIC BPSerr_minVbat "FaultConfig # BPSerr_minVbat (Fault Condition:while battery voltage >)" VALUE 0x001C9EEC /* @ECU_Address@BPSerr_minVbat@0x01009E20@ */ ECIPP_ALIGNMENT_UWORD 256 Compu_BPSerr_minVbat 0 255.99609375 /end CHARACTERISTIC
/begin COMPU_METHOD Compu_BPSerr_minVbat " " RAT_FUNC "%.3" "volts" COEFFS 0 256 0 0 0 1 /end COMPU_METHOD
/begin CHARACTERISTIC DBW2_output "{DBW2_output&0xff=0:Disabled}{DBW2_output&0xff=1:H-bridge A}{DBW2_output&0xff=2:H-bridge B}" VALUE 0x001c86b8 /* @ECU_Address@DBW2_output@0x0100A038@ */ ECIPP_ALIGNMENT_UBYTE 255 DBW2_output_COMPU_VTAB 0 255 BIT_MASK 0xff /end CHARACTERISTIC
/begin COMPU_METHOD DBW2_output_COMPU_VTAB "Verbal Table" TAB_VERB "%.0" "list" COMPU_TAB_REF DBW2_output_COMPU_VTAB_REF /end COMPU_METHOD
/begin COMPU_VTAB DBW2_output_COMPU_VTAB_REF "Verbal Table" TAB_VERB 3 0 "Disabled" 1 "H-bridge A" 2 "H-bridge B" DEFAULT_VALUE "UNKNOWN" /end COMPU_VTAB
/begin CHARACTERISTIC OILT_Taux_cal "{OILT_Taux_cal&0xff=0:Fuel source}{OILT_Taux_cal&0xff=1:Exhaust manifold/riser}{OILT_Taux_cal&0xff=2:Aux Temp A}{OILT_Taux_cal&0xff=3:Aux Temp B}{OILT_Taux_cal&0xff=4:Aux Temp C}{OILT_Taux_cal&0xff=5:Aux Temp D}" VALUE 0x001c8868 /* @ECU_Address@OILT_Taux_cal@0x0100A1D0@ */ ECIPP_ALIGNMENT_UBYTE 255 OILT_Taux_cal_COMPU_VTAB 0 255 BIT_MASK 0xff /end CHARACTERISTIC
/begin COMPU_METHOD OILT_Taux_cal_COMPU_VTAB "Verbal Table" TAB_VERB "%.0" "list" COMPU_TAB_REF OILT_Taux_cal_COMPU_VTAB_REF /end COMPU_METHOD
/begin COMPU_VTAB OILT_Taux_cal_COMPU_VTAB_REF "Verbal Table" TAB_VERB 6 0 "Fuel source" 1 "Exhaust manifold/riser" 2 "Aux Temp A" 3 "Aux Temp B" 4 "Aux Temp C" 5 "Aux Temp D" DEFAULT_VALUE "UNKNOWN" /end COMPU_VTAB
/begin CHARACTERISTIC OILT_vdr "IOConfig # OILT_vdr" VALUE 0x001c3aec /* @ECU_Address@OILT_vdr@0x0100A1D8@ */ ECIPP_ALIGNMENT_FLOAT32_IEEE 10000000000 Compu_OILT_vdr -10000000000 10000000000 /end CHARACTERISTIC
/begin COMPU_METHOD Compu_OILT_vdr " " RAT_FUNC "%.3" "ohms" COEFFS 0 1 0 0 0 1 /end COMPU_METHOD
/begin CHARACTERISTIC module_load_diesel "General # module_load_diesel" VALUE 0x001ecca7 /* @ECU_Address@module_load_diesel@0x0100B120@ */ ECIPP_ALIGNMENT_UBYTE 255 Compu_module_load_diesel 0 255 /end CHARACTERISTIC
/begin COMPU_METHOD Compu_module_load_diesel " " RAT_FUNC "%.0" "-" COEFFS 0 1 0 0 0 1 /end COMPU_METHOD
/begin CHARACTERISTIC module_load_EGR "General # module_load_EGR" VALUE 0x001ecca4 /* @ECU_Address@module_load_EGR@0x0100B128@ */ ECIPP_ALIGNMENT_UBYTE 255 Compu_module_load_EGR 0 255 /end CHARACTERISTIC
/begin COMPU_METHOD Compu_module_load_EGR " " RAT_FUNC "%.0" "-" COEFFS 0 1 0 0 0 1 /end COMPU_METHOD
/begin CHARACTERISTIC module_load_gasoline "General # module_load_gasoline" VALUE 0x001ecca8 /* @ECU_Address@module_load_gasoline@0x0100B130@ */ ECIPP_ALIGNMENT_UBYTE 255 Compu_module_load_gasoline 0 255 /end CHARACTERISTIC
/begin COMPU_METHOD Compu_module_load_gasoline " " RAT_FUNC "%.0" "-" COEFFS 0 1 0 0 0 1 /end COMPU_METHOD
/begin CHARACTERISTIC module_load_LPG "General # module_load_LPG" VALUE 0x001ecca5 /* @ECU_Address@module_load_LPG@0x0100B138@ */ ECIPP_ALIGNMENT_UBYTE 255 Compu_module_load_LPG 0 255 /end CHARACTERISTIC
/begin COMPU_METHOD Compu_module_load_LPG " " RAT_FUNC "%.0" "-" COEFFS 0 1 0 0 0 1 /end COMPU_METHOD
/begin CHARACTERISTIC module_load_NG "General # module_load_NG" VALUE 0x001ecca6 /* @ECU_Address@module_load_NG@0x0100B140@ */ ECIPP_ALIGNMENT_UBYTE 255 Compu_module_load_NG 0 255 /end CHARACTERISTIC
/begin COMPU_METHOD Compu_module_load_NG " " RAT_FUNC "%.0" "-" COEFFS 0 1 0 0 0 1 /end COMPU_METHOD
/begin CHARACTERISTIC module_load_knock "General # module_load_knock" VALUE 0x001ecca9 /* @ECU_Address@module_load_knock@0x0100B148@ */ ECIPP_ALIGNMENT_UBYTE 255 Compu_module_load_knock 0 255 /end CHARACTERISTIC
/begin COMPU_METHOD Compu_module_load_knock " " RAT_FUNC "%.0" "-" COEFFS 0 1 0 0 0 1 /end COMPU_METHOD
/begin MEASUREMENT UEGO1_hours "UEGO hours" ULONG Compu_UEGO1_hours 0 0 0 1193046.47083333 ECU_ADDRESS 0x0100B230 /end MEASUREMENT
/begin COMPU_METHOD Compu_UEGO1_hours " " RAT_FUNC "%.3" "hours" COEFFS 0 3600 0 0 0 1 /end COMPU_METHOD
/begin MEASUREMENT UEGO2_hours "UEGO hours" ULONG Compu_UEGO2_hours 0 0 0 1193046.47083333 ECU_ADDRESS 0x0100B238 /end MEASUREMENT
/begin COMPU_METHOD Compu_UEGO2_hours " " RAT_FUNC "%.3" "hours" COEFFS 0 3600 0 0 0 1 /end COMPU_METHOD
/begin MEASUREMENT UEGO1_drift_accum "UEGO drift compensation accum" SLONG Compu_UEGO1_drift_accum 0 0 -100 99.9999999534339 ECU_ADDRESS 0x0100B240 /end MEASUREMENT
/begin COMPU_METHOD Compu_UEGO1_drift_accum " " RAT_FUNC "%.2" "% Ip" COEFFS 0 21474836.48 0 0 0 1 /end COMPU_METHOD
/begin MEASUREMENT UEGO2_drift_accum "UEGO drift compensation accum" SLONG Compu_UEGO2_drift_accum 0 0 -100 99.9999999534339 ECU_ADDRESS 0x0100B248 /end MEASUREMENT
/begin COMPU_METHOD Compu_UEGO2_drift_accum " " RAT_FUNC "%.2" "% Ip" COEFFS 0 21474836.48 0 0 0 1 /end COMPU_METHOD
/begin MEASUREMENT UEGO1_drift_hours "UEGO drift time since sample" ULONG Compu_UEGO1_drift_hours 0 0 0 1193046.47083333 ECU_ADDRESS 0x0100B250 /end MEASUREMENT
/begin COMPU_METHOD Compu_UEGO1_drift_hours " " RAT_FUNC "%.3" "hours" COEFFS 0 3600 0 0 0 1 /end COMPU_METHOD
/begin MEASUREMENT UEGO2_drift_hours "UEGO drift time since sample" ULONG Compu_UEGO2_drift_hours 0 0 0 1193046.47083333 ECU_ADDRESS 0x0100B258 /end MEASUREMENT
/begin COMPU_METHOD Compu_UEGO2_drift_hours " " RAT_FUNC "%.3" "hours" COEFFS 0 3600 0 0 0 1 /end COMPU_METHOD
/begin MEASUREMENT UEGO1_recvr_seconds "UEGO time since last recovery" ULONG Compu_UEGO1_recvr_seconds 0 0 0 1193046.47083333 ECU_ADDRESS 0x0100B2A8 /end MEASUREMENT
/begin COMPU_METHOD Compu_UEGO1_recvr_seconds " " RAT_FUNC "%.3" "hours" COEFFS 0 3600 0 0 0 1 /end COMPU_METHOD
/begin MEASUREMENT UEGO2_recvr_seconds "UEGO time since last recovery" ULONG Compu_UEGO2_recvr_seconds 0 0 0 1193046.47083333 ECU_ADDRESS 0x0100B2B0 /end MEASUREMENT
/begin COMPU_METHOD Compu_UEGO2_recvr_seconds " " RAT_FUNC "%.3" "hours" COEFFS 0 3600 0 0 0 1 /end COMPU_METHOD
/begin MEASUREMENT UEGO1_drift_success "UEGO1 drift successful samples" ULONG Compu_UEGO1_drift_success 0 0 0 4294967295 ECU_ADDRESS 0x0100B440 /end MEASUREMENT
/begin COMPU_METHOD Compu_UEGO1_drift_success " " RAT_FUNC "%.0" "-" COEFFS 0 1 0 0 0 1 /end COMPU_METHOD
/begin MEASUREMENT UEGO1_drift_aborted "UEGO1 drift aborted samples" ULONG Compu_UEGO1_drift_aborted 0 0 0 4294967295 ECU_ADDRESS 0x0100B448 /end MEASUREMENT
/begin COMPU_METHOD Compu_UEGO1_drift_aborted " " RAT_FUNC "%.0" "-" COEFFS 0 1 0 0 0 1 /end COMPU_METHOD
/begin MEASUREMENT UEGO2_drift_success "UEGO2 drift successful samples" ULONG Compu_UEGO2_drift_success 0 0 0 4294967295 ECU_ADDRESS 0x0100B450 /end MEASUREMENT
/begin COMPU_METHOD Compu_UEGO2_drift_success " " RAT_FUNC "%.0" "-" COEFFS 0 1 0 0 0 1 /end COMPU_METHOD
/begin MEASUREMENT UEGO2_drift_aborted "UEGO2 drift aborted samples" ULONG Compu_UEGO2_drift_aborted 0 0 0 4294967295 ECU_ADDRESS 0x0100B458 /end MEASUREMENT
/begin COMPU_METHOD Compu_UEGO2_drift_aborted " " RAT_FUNC "%.0" "-" COEFFS 0 1 0 0 0 1 /end COMPU_METHOD
/begin CHARACTERISTIC KNK_retardlmt_RPM "FaultConfig # KNK_retardlmt_RPM (Fault Condition:RPM >)" VALUE 0x001c7ccc /* @ECU_Address@KNK_retardlmt_RPM@0x0100B460@ */ ECIPP_ALIGNMENT_UWORD 65535 Compu_KNK_retardlmt_RPM 0 65535 /end CHARACTERISTIC
/begin COMPU_METHOD Compu_KNK_retardlmt_RPM " " RAT_FUNC "%.0" "rpm" COEFFS 0 1 0 0 0 1 /end COMPU_METHOD
/begin CHARACTERISTIC KNK_retardlmt_MAP "FaultConfig # KNK_retardlmt_MAP (Fault Condition:and MAP >)" VALUE 0x001c7cc4 /* @ECU_Address@KNK_retardlmt_MAP@0x0100B468@ */ ECIPP_ALIGNMENT_UWORD 256 Compu_KNK_retardlmt_MAP 0 255.99609375 /end CHARACTERISTIC
/begin COMPU_METHOD Compu_KNK_retardlmt_MAP " " RAT_FUNC "%.3" "psia" COEFFS 0 256 0 0 0 1 /end COMPU_METHOD
/begin CHARACTERISTIC UGF1_drift_min "FaultConfig # UGF1_drift_min (Fault Condition:UEGO1 drift compensation accumulator <)" VALUE 0x001c6bf0 /* @ECU_Address@UGF1_drift_min@0x0100B470@ */ ECIPP_ALIGNMENT_SWORD 100 Compu_UGF1_drift_min -100 99.9969482421875 /end CHARACTERISTIC
/begin COMPU_METHOD Compu_UGF1_drift_min " " RAT_FUNC "%.3" "% Ip" COEFFS 0 327.68 0 0 0 1 /end COMPU_METHOD
/begin CHARACTERISTIC UGF1_drift_max "FaultConfig # UGF1_drift_max (Fault Condition:or >)" VALUE 0x001c6bec /* @ECU_Address@UGF1_drift_max@0x0100B478@ */ ECIPP_ALIGNMENT_SWORD 100 Compu_UGF1_drift_max -100 99.9969482421875 /end CHARACTERISTIC
/begin COMPU_METHOD Compu_UGF1_drift_max " " RAT_FUNC "%.3" "% Ip" COEFFS 0 327.68 0 0 0 1 /end COMPU_METHOD
/begin CHARACTERISTIC UGF2_drift_min "FaultConfig # UGF2_drift_min (Fault Condition:UEGO2 drift compensation accumulator <)" VALUE 0x001c6bf8 /* @ECU_Address@UGF2_drift_min@0x0100B480@ */ ECIPP_ALIGNMENT_SWORD 100 Compu_UGF2_drift_min -100 99.9969482421875 /end CHARACTERISTIC
/begin COMPU_METHOD Compu_UGF2_drift_min " " RAT_FUNC "%.3" "% Ip" COEFFS 0 327.68 0 0 0 1 /end COMPU_METHOD
/begin CHARACTERISTIC UGF2_drift_max "FaultConfig # UGF2_drift_max (Fault Condition:or >)" VALUE 0x001c6bf4 /* @ECU_Address@UGF2_drift_max@0x0100B488@ */ ECIPP_ALIGNMENT_SWORD 100 Compu_UGF2_drift_max -100 99.9969482421875 /end CHARACTERISTIC
/begin COMPU_METHOD Compu_UGF2_drift_max " " RAT_FUNC "%.3" "% Ip" COEFFS 0 327.68 0 0 0 1 /end COMPU_METHOD
/begin CHARACTERISTIC VE5c_max "FaultConfig # VE5c_max (Fault Condition:5VE3 >)" VALUE 0x001e58be /* @ECU_Address@VE5c_max@0x0100B4C0@ */ ECIPP_ALIGNMENT_UWORD 6 Compu_VE5c_max 0 5.50125915750916 /end CHARACTERISTIC
/begin COMPU_METHOD Compu_VE5c_max " " RAT_FUNC "%.3" "volts" COEFFS 0 11912.7272727273 0 0 0 1 /end COMPU_METHOD
/begin CHARACTERISTIC VE5c_min "FaultConfig # VE5c_min (Fault Condition:5VE3 <)" VALUE 0x001e58c0 /* @ECU_Address@VE5c_min@0x0100B4C8@ */ ECIPP_ALIGNMENT_UWORD 6 Compu_VE5c_min 0 5.50125915750916 /end CHARACTERISTIC
/begin COMPU_METHOD Compu_VE5c_min " " RAT_FUNC "%.3" "volts" COEFFS 0 11912.7272727273 0 0 0 1 /end COMPU_METHOD
/begin CHARACTERISTIC module_load_CRI "General # module_load_CRI" VALUE 0x001ecca2 /* @ECU_Address@module_load_CRI@0x0100B530@ */ ECIPP_ALIGNMENT_UBYTE 255 Compu_module_load_CRI 0 255 /end CHARACTERISTIC
/begin COMPU_METHOD Compu_module_load_CRI " " RAT_FUNC "%.0" "-" COEFFS 0 1 0 0 0 1 /end COMPU_METHOD
/begin CHARACTERISTIC PAUX9_Paux_cal "{PAUX9_Paux_cal&0xff=0:Aux Press A}{PAUX9_Paux_cal&0xff=1:Aux Press B}{PAUX9_Paux_cal&0xff=2:Aux Press C}{PAUX9_Paux_cal&0xff=3:Aux Press D}" VALUE 0x001C887F /* @ECU_Address@PAUX9_Paux_cal@0x0100BA40@ */ ECIPP_ALIGNMENT_UBYTE 255 PAUX9_Paux_cal_COMPU_VTAB 0 255 BIT_MASK 0xff /end CHARACTERISTIC
/begin COMPU_METHOD PAUX9_Paux_cal_COMPU_VTAB "Verbal Table" TAB_VERB "%.0" "list" COMPU_TAB_REF PAUX9_Paux_cal_COMPU_VTAB_REF /end COMPU_METHOD
/begin COMPU_VTAB PAUX9_Paux_cal_COMPU_VTAB_REF "Verbal Table" TAB_VERB 4 0 "Aux Press A" 1 "Aux Press B" 2 "Aux Press C" 3 "Aux Press D" DEFAULT_VALUE "UNKNOWN" /end COMPU_VTAB
/begin CHARACTERISTIC PAUX10_Paux_cal "{PAUX10_Paux_cal&0xff=0:Aux Press A}{PAUX10_Paux_cal&0xff=1:Aux Press B}{PAUX10_Paux_cal&0xff=2:Aux Press C}{PAUX10_Paux_cal&0xff=3:Aux Press D}" VALUE 0x001C8880 /* @ECU_Address@PAUX10_Paux_cal@0x0100BA48@ */ ECIPP_ALIGNMENT_UBYTE 255 PAUX10_Paux_cal_COMPU_VTAB 0 255 BIT_MASK 0xff /end CHARACTERISTIC
/begin COMPU_METHOD PAUX10_Paux_cal_COMPU_VTAB "Verbal Table" TAB_VERB "%.0" "list" COMPU_TAB_REF PAUX10_Paux_cal_COMPU_VTAB_REF /end COMPU_METHOD
/begin COMPU_VTAB PAUX10_Paux_cal_COMPU_VTAB_REF "Verbal Table" TAB_VERB 4 0 "Aux Press A" 1 "Aux Press B" 2 "Aux Press C" 3 "Aux Press D" DEFAULT_VALUE "UNKNOWN" /end COMPU_VTAB
/begin CHARACTERISTIC PAUX11_Paux_cal "{PAUX11_Paux_cal&0xff=0:Aux Press A}{PAUX11_Paux_cal&0xff=1:Aux Press B}{PAUX11_Paux_cal&0xff=2:Aux Press C}{PAUX11_Paux_cal&0xff=3:Aux Press D}" VALUE 0x001C8881 /* @ECU_Address@PAUX11_Paux_cal@0x0100BA50@ */ ECIPP_ALIGNMENT_UBYTE 255 PAUX11_Paux_cal_COMPU_VTAB 0 255 BIT_MASK 0xff /end CHARACTERISTIC
/begin COMPU_METHOD PAUX11_Paux_cal_COMPU_VTAB "Verbal Table" TAB_VERB "%.0" "list" COMPU_TAB_REF PAUX11_Paux_cal_COMPU_VTAB_REF /end COMPU_METHOD
/begin COMPU_VTAB PAUX11_Paux_cal_COMPU_VTAB_REF "Verbal Table" TAB_VERB 4 0 "Aux Press A" 1 "Aux Press B" 2 "Aux Press C" 3 "Aux Press D" DEFAULT_VALUE "UNKNOWN" /end COMPU_VTAB
/begin CHARACTERISTIC PAUX12_Paux_cal "{PAUX12_Paux_cal&0xff=0:Aux Press A}{PAUX12_Paux_cal&0xff=1:Aux Press B}{PAUX12_Paux_cal&0xff=2:Aux Press C}{PAUX12_Paux_cal&0xff=3:Aux Press D}" VALUE 0x001C8882 /* @ECU_Address@PAUX12_Paux_cal@0x0100BA58@ */ ECIPP_ALIGNMENT_UBYTE 255 PAUX12_Paux_cal_COMPU_VTAB 0 255 BIT_MASK 0xff /end CHARACTERISTIC
/begin COMPU_METHOD PAUX12_Paux_cal_COMPU_VTAB "Verbal Table" TAB_VERB "%.0" "list" COMPU_TAB_REF PAUX12_Paux_cal_COMPU_VTAB_REF /end COMPU_METHOD
/begin COMPU_VTAB PAUX12_Paux_cal_COMPU_VTAB_REF "Verbal Table" TAB_VERB 4 0 "Aux Press A" 1 "Aux Press B" 2 "Aux Press C" 3 "Aux Press D" DEFAULT_VALUE "UNKNOWN" /end COMPU_VTAB
/begin CHARACTERISTIC PAUX13_Paux_cal "{PAUX13_Paux_cal&0xff=0:Aux Press A}{PAUX13_Paux_cal&0xff=1:Aux Press B}{PAUX13_Paux_cal&0xff=2:Aux Press C}{PAUX13_Paux_cal&0xff=3:Aux Press D}" VALUE 0x001C8883 /* @ECU_Address@PAUX13_Paux_cal@0x0100BA60@ */ ECIPP_ALIGNMENT_UBYTE 255 PAUX13_Paux_cal_COMPU_VTAB 0 255 BIT_MASK 0xff /end CHARACTERISTIC
/begin COMPU_METHOD PAUX13_Paux_cal_COMPU_VTAB "Verbal Table" TAB_VERB "%.0" "list" COMPU_TAB_REF PAUX13_Paux_cal_COMPU_VTAB_REF /end COMPU_METHOD
/begin COMPU_VTAB PAUX13_Paux_cal_COMPU_VTAB_REF "Verbal Table" TAB_VERB 4 0 "Aux Press A" 1 "Aux Press B" 2 "Aux Press C" 3 "Aux Press D" DEFAULT_VALUE "UNKNOWN" /end COMPU_VTAB
/begin CHARACTERISTIC PAUX14_Paux_cal "{PAUX14_Paux_cal&0xff=0:Aux Press A}{PAUX14_Paux_cal&0xff=1:Aux Press B}{PAUX14_Paux_cal&0xff=2:Aux Press C}{PAUX14_Paux_cal&0xff=3:Aux Press D}" VALUE 0x001C8884 /* @ECU_Address@PAUX14_Paux_cal@0x0100BA68@ */ ECIPP_ALIGNMENT_UBYTE 255 PAUX14_Paux_cal_COMPU_VTAB 0 255 BIT_MASK 0xff /end CHARACTERISTIC
/begin COMPU_METHOD PAUX14_Paux_cal_COMPU_VTAB "Verbal Table" TAB_VERB "%.0" "list" COMPU_TAB_REF PAUX14_Paux_cal_COMPU_VTAB_REF /end COMPU_METHOD
/begin COMPU_VTAB PAUX14_Paux_cal_COMPU_VTAB_REF "Verbal Table" TAB_VERB 4 0 "Aux Press A" 1 "Aux Press B" 2 "Aux Press C" 3 "Aux Press D" DEFAULT_VALUE "UNKNOWN" /end COMPU_VTAB
/begin CHARACTERISTIC PAUX15_Paux_cal "{PAUX15_Paux_cal&0xff=0:Aux Press A}{PAUX15_Paux_cal&0xff=1:Aux Press B}{PAUX15_Paux_cal&0xff=2:Aux Press C}{PAUX15_Paux_cal&0xff=3:Aux Press D}" VALUE 0x001C8885 /* @ECU_Address@PAUX15_Paux_cal@0x0100BA70@ */ ECIPP_ALIGNMENT_UBYTE 255 PAUX15_Paux_cal_COMPU_VTAB 0 255 BIT_MASK 0xff /end CHARACTERISTIC
/begin COMPU_METHOD PAUX15_Paux_cal_COMPU_VTAB "Verbal Table" TAB_VERB "%.0" "list" COMPU_TAB_REF PAUX15_Paux_cal_COMPU_VTAB_REF /end COMPU_METHOD
/begin COMPU_VTAB PAUX15_Paux_cal_COMPU_VTAB_REF "Verbal Table" TAB_VERB 4 0 "Aux Press A" 1 "Aux Press B" 2 "Aux Press C" 3 "Aux Press D" DEFAULT_VALUE "UNKNOWN" /end COMPU_VTAB
/begin CHARACTERISTIC PAUX16_Paux_cal "{PAUX16_Paux_cal&0xff=0:Aux Press A}{PAUX16_Paux_cal&0xff=1:Aux Press B}{PAUX16_Paux_cal&0xff=2:Aux Press C}{PAUX16_Paux_cal&0xff=3:Aux Press D}" VALUE 0x001C8886 /* @ECU_Address@PAUX16_Paux_cal@0x0100BA78@ */ ECIPP_ALIGNMENT_UBYTE 255 PAUX16_Paux_cal_COMPU_VTAB 0 255 BIT_MASK 0xff /end CHARACTERISTIC
/begin COMPU_METHOD PAUX16_Paux_cal_COMPU_VTAB "Verbal Table" TAB_VERB "%.0" "list" COMPU_TAB_REF PAUX16_Paux_cal_COMPU_VTAB_REF /end COMPU_METHOD
/begin COMPU_VTAB PAUX16_Paux_cal_COMPU_VTAB_REF "Verbal Table" TAB_VERB 4 0 "Aux Press A" 1 "Aux Press B" 2 "Aux Press C" 3 "Aux Press D" DEFAULT_VALUE "UNKNOWN" /end COMPU_VTAB
/begin CHARACTERISTIC PAUX9_ena "{PAUX9_ena&0xff=0:Disabled}{PAUX9_ena&0xff=1:Aux PD1}{PAUX9_ena&0xff=2:Aux PD2}{PAUX9_ena&0xff=3:Aux PD3}{PAUX9_ena&0xff=4:Aux PUD1}{PAUX9_ena&0xff=5:Aux PUD2}{PAUX9_ena&0xff=6:Aux PUD3}{PAUX9_ena&0xff=7:Aux PUD4}{PAUX9_ena&0xff=8:Aux PUD5}{PAUX9_ena&0xff" VALUE 0x001C888F /* @ECU_Address@PAUX9_ena@0x0100BA80@ */ ECIPP_ALIGNMENT_UBYTE 255 PAUX9_ena_COMPU_VTAB 0 255 BIT_MASK 0xff /end CHARACTERISTIC
/begin COMPU_METHOD PAUX9_ena_COMPU_VTAB "Verbal Table" TAB_VERB "%.0" "list" COMPU_TAB_REF PAUX9_ena_COMPU_VTAB_REF /end COMPU_METHOD
/begin COMPU_VTAB PAUX9_ena_COMPU_VTAB_REF "Verbal Table" TAB_VERB 31 0 "Disabled" 1 "Aux PD1" 2 "Aux PD2" 3 "Aux PD3" 4 "Aux PUD1" 5 "Aux PUD2" 6 "Aux PUD3" 7 "Aux PUD4" 8 "Aux PUD5" 9 "Aux PUD6" 10 "Aux PUD7" 11 "Aux PUD8" 12 "Aux PUD9" 13 "Aux PUD10" 14 "Aux PUD11" 15 "Aux PUD12" 16 "Aux PUD13" 17 "Aux PUD14" 18 "Aux PUD15" 19 "CAN sourced" 20 "FPP2 Input" 21 "Aux PUD16" 22 "Aux PUD17" 23 "Aux PUD18" 24 "Aux PUD19" 25 "Aux PUD20" 26 "Aux PUD21" 27 "Aux PUD22" 28 "Aux PUD23" 29 "Aux PUD24" 30 "Aux PUD25" DEFAULT_VALUE "UNKNOWN" /end COMPU_VTAB
/begin CHARACTERISTIC PAUX10_ena "{PAUX10_ena&0xff=0:Disabled}{PAUX10_ena&0xff=1:Aux PD1}{PAUX10_ena&0xff=2:Aux PD2}{PAUX10_ena&0xff=3:Aux PD3}{PAUX10_ena&0xff=4:Aux PUD1}{PAUX10_ena&0xff=5:Aux PUD2}{PAUX10_ena&0xff=6:Aux PUD3}{PAUX10_ena&0xff=7:Aux PUD4}{PAUX10_ena&0xff=8:Aux PUD5}{PAUX1" VALUE 0x001C8890 /* @ECU_Address@PAUX10_ena@0x0100BA88@ */ ECIPP_ALIGNMENT_UBYTE 255 PAUX10_ena_COMPU_VTAB 0 255 BIT_MASK 0xff /end CHARACTERISTIC
/begin COMPU_METHOD PAUX10_ena_COMPU_VTAB "Verbal Table" TAB_VERB "%.0" "list" COMPU_TAB_REF PAUX10_ena_COMPU_VTAB_REF /end COMPU_METHOD
/begin COMPU_VTAB PAUX10_ena_COMPU_VTAB_REF "Verbal Table" TAB_VERB 31 0 "Disabled" 1 "Aux PD1" 2 "Aux PD2" 3 "Aux PD3" 4 "Aux PUD1" 5 "Aux PUD2" 6 "Aux PUD3" 7 "Aux PUD4" 8 "Aux PUD5" 9 "Aux PUD6" 10 "Aux PUD7" 11 "Aux PUD8" 12 "Aux PUD9" 13 "Aux PUD10" 14 "Aux PUD11" 15 "Aux PUD12" 16 "Aux PUD13" 17 "Aux PUD14" 18 "Aux PUD15" 19 "CAN sourced" 20 "FPP2 Input" 21 "Aux PUD16" 22 "Aux PUD17" 23 "Aux PUD18" 24 "Aux PUD19" 25 "Aux PUD20" 26 "Aux PUD21" 27 "Aux PUD22" 28 "Aux PUD23" 29 "Aux PUD24" 30 "Aux PUD25" DEFAULT_VALUE "UNKNOWN" /end COMPU_VTAB
/begin CHARACTERISTIC PAUX11_ena "{PAUX11_ena&0xff=0:Disabled}{PAUX11_ena&0xff=1:Aux PD1}{PAUX11_ena&0xff=2:Aux PD2}{PAUX11_ena&0xff=3:Aux PD3}{PAUX11_ena&0xff=4:Aux PUD1}{PAUX11_ena&0xff=5:Aux PUD2}{PAUX11_ena&0xff=6:Aux PUD3}{PAUX11_ena&0xff=7:Aux PUD4}{PAUX11_ena&0xff=8:Aux PUD5}{PAUX1" VALUE 0x001C8891 /* @ECU_Address@PAUX11_ena@0x0100BA90@ */ ECIPP_ALIGNMENT_UBYTE 255 PAUX11_ena_COMPU_VTAB 0 255 BIT_MASK 0xff /end CHARACTERISTIC
/begin COMPU_METHOD PAUX11_ena_COMPU_VTAB "Verbal Table" TAB_VERB "%.0" "list" COMPU_TAB_REF PAUX11_ena_COMPU_VTAB_REF /end COMPU_METHOD
/begin COMPU_VTAB PAUX11_ena_COMPU_VTAB_REF "Verbal Table" TAB_VERB 31 0 "Disabled" 1 "Aux PD1" 2 "Aux PD2" 3 "Aux PD3" 4 "Aux PUD1" 5 "Aux PUD2" 6 "Aux PUD3" 7 "Aux PUD4" 8 "Aux PUD5" 9 "Aux PUD6" 10 "Aux PUD7" 11 "Aux PUD8" 12 "Aux PUD9" 13 "Aux PUD10" 14 "Aux PUD11" 15 "Aux PUD12" 16 "Aux PUD13" 17 "Aux PUD14" 18 "Aux PUD15" 19 "CAN sourced" 20 "FPP2 Input" 21 "Aux PUD16" 22 "Aux PUD17" 23 "Aux PUD18" 24 "Aux PUD19" 25 "Aux PUD20" 26 "Aux PUD21" 27 "Aux PUD22" 28 "Aux PUD23" 29 "Aux PUD24" 30 "Aux PUD25" DEFAULT_VALUE "UNKNOWN" /end COMPU_VTAB
/begin CHARACTERISTIC PAUX12_ena "{PAUX12_ena&0xff=0:Disabled}{PAUX12_ena&0xff=1:Aux PD1}{PAUX12_ena&0xff=2:Aux PD2}{PAUX12_ena&0xff=3:Aux PD3}{PAUX12_ena&0xff=4:Aux PUD1}{PAUX12_ena&0xff=5:Aux PUD2}{PAUX12_ena&0xff=6:Aux PUD3}{PAUX12_ena&0xff=7:Aux PUD4}{PAUX12_ena&0xff=8:Aux PUD5}{PAUX1" VALUE 0x001C8892 /* @ECU_Address@PAUX12_ena@0x0100BA98@ */ ECIPP_ALIGNMENT_UBYTE 255 PAUX12_ena_COMPU_VTAB 0 255 BIT_MASK 0xff /end CHARACTERISTIC
/begin COMPU_METHOD PAUX12_ena_COMPU_VTAB "Verbal Table" TAB_VERB "%.0" "list" COMPU_TAB_REF PAUX12_ena_COMPU_VTAB_REF /end COMPU_METHOD
/begin COMPU_VTAB PAUX12_ena_COMPU_VTAB_REF "Verbal Table" TAB_VERB 31 0 "Disabled" 1 "Aux PD1" 2 "Aux PD2" 3 "Aux PD3" 4 "Aux PUD1" 5 "Aux PUD2" 6 "Aux PUD3" 7 "Aux PUD4" 8 "Aux PUD5" 9 "Aux PUD6" 10 "Aux PUD7" 11 "Aux PUD8" 12 "Aux PUD9" 13 "Aux PUD10" 14 "Aux PUD11" 15 "Aux PUD12" 16 "Aux PUD13" 17 "Aux PUD14" 18 "Aux PUD15" 19 "CAN sourced" 20 "FPP2 Input" 21 "Aux PUD16" 22 "Aux PUD17" 23 "Aux PUD18" 24 "Aux PUD19" 25 "Aux PUD20" 26 "Aux PUD21" 27 "Aux PUD22" 28 "Aux PUD23" 29 "Aux PUD24" 30 "Aux PUD25" DEFAULT_VALUE "UNKNOWN" /end COMPU_VTAB
/begin CHARACTERISTIC PAUX13_ena "{PAUX13_ena&0xff=0:Disabled}{PAUX13_ena&0xff=1:Aux PD1}{PAUX13_ena&0xff=2:Aux PD2}{PAUX13_ena&0xff=3:Aux PD3}{PAUX13_ena&0xff=4:Aux PUD1}{PAUX13_ena&0xff=5:Aux PUD2}{PAUX13_ena&0xff=6:Aux PUD3}{PAUX13_ena&0xff=7:Aux PUD4}{PAUX13_ena&0xff=8:Aux PUD5}{PAUX1" VALUE 0x001C8893 /* @ECU_Address@PAUX13_ena@0x0100BAA0@ */ ECIPP_ALIGNMENT_UBYTE 255 PAUX13_ena_COMPU_VTAB 0 255 BIT_MASK 0xff /end CHARACTERISTIC
/begin COMPU_METHOD PAUX13_ena_COMPU_VTAB "Verbal Table" TAB_VERB "%.0" "list" COMPU_TAB_REF PAUX13_ena_COMPU_VTAB_REF /end COMPU_METHOD
/begin COMPU_VTAB PAUX13_ena_COMPU_VTAB_REF "Verbal Table" TAB_VERB 31 0 "Disabled" 1 "Aux PD1" 2 "Aux PD2" 3 "Aux PD3" 4 "Aux PUD1" 5 "Aux PUD2" 6 "Aux PUD3" 7 "Aux PUD4" 8 "Aux PUD5" 9 "Aux PUD6" 10 "Aux PUD7" 11 "Aux PUD8" 12 "Aux PUD9" 13 "Aux PUD10" 14 "Aux PUD11" 15 "Aux PUD12" 16 "Aux PUD13" 17 "Aux PUD14" 18 "Aux PUD15" 19 "CAN sourced" 20 "FPP2 Input" 21 "Aux PUD16" 22 "Aux PUD17" 23 "Aux PUD18" 24 "Aux PUD19" 25 "Aux PUD20" 26 "Aux PUD21" 27 "Aux PUD22" 28 "Aux PUD23" 29 "Aux PUD24" 30 "Aux PUD25" DEFAULT_VALUE "UNKNOWN" /end COMPU_VTAB
/begin CHARACTERISTIC PAUX14_ena "{PAUX14_ena&0xff=0:Disabled}{PAUX14_ena&0xff=1:Aux PD1}{PAUX14_ena&0xff=2:Aux PD2}{PAUX14_ena&0xff=3:Aux PD3}{PAUX14_ena&0xff=4:Aux PUD1}{PAUX14_ena&0xff=5:Aux PUD2}{PAUX14_ena&0xff=6:Aux PUD3}{PAUX14_ena&0xff=7:Aux PUD4}{PAUX14_ena&0xff=8:Aux PUD5}{PAUX1" VALUE 0x001C8894 /* @ECU_Address@PAUX14_ena@0x0100BAA8@ */ ECIPP_ALIGNMENT_UBYTE 255 PAUX14_ena_COMPU_VTAB 0 255 BIT_MASK 0xff /end CHARACTERISTIC
/begin COMPU_METHOD PAUX14_ena_COMPU_VTAB "Verbal Table" TAB_VERB "%.0" "list" COMPU_TAB_REF PAUX14_ena_COMPU_VTAB_REF /end COMPU_METHOD
/begin COMPU_VTAB PAUX14_ena_COMPU_VTAB_REF "Verbal Table" TAB_VERB 31 0 "Disabled" 1 "Aux PD1" 2 "Aux PD2" 3 "Aux PD3" 4 "Aux PUD1" 5 "Aux PUD2" 6 "Aux PUD3" 7 "Aux PUD4" 8 "Aux PUD5" 9 "Aux PUD6" 10 "Aux PUD7" 11 "Aux PUD8" 12 "Aux PUD9" 13 "Aux PUD10" 14 "Aux PUD11" 15 "Aux PUD12" 16 "Aux PUD13" 17 "Aux PUD14" 18 "Aux PUD15" 19 "CAN sourced" 20 "FPP2 Input" 21 "Aux PUD16" 22 "Aux PUD17" 23 "Aux PUD18" 24 "Aux PUD19" 25 "Aux PUD20" 26 "Aux PUD21" 27 "Aux PUD22" 28 "Aux PUD23" 29 "Aux PUD24" 30 "Aux PUD25" DEFAULT_VALUE "UNKNOWN" /end COMPU_VTAB
/begin CHARACTERISTIC PAUX15_ena "{PAUX15_ena&0xff=0:Disabled}{PAUX15_ena&0xff=1:Aux PD1}{PAUX15_ena&0xff=2:Aux PD2}{PAUX15_ena&0xff=3:Aux PD3}{PAUX15_ena&0xff=4:Aux PUD1}{PAUX15_ena&0xff=5:Aux PUD2}{PAUX15_ena&0xff=6:Aux PUD3}{PAUX15_ena&0xff=7:Aux PUD4}{PAUX15_ena&0xff=8:Aux PUD5}{PAUX1" VALUE 0x001C8895 /* @ECU_Address@PAUX15_ena@0x0100BAB0@ */ ECIPP_ALIGNMENT_UBYTE 255 PAUX15_ena_COMPU_VTAB 0 255 BIT_MASK 0xff /end CHARACTERISTIC
/begin COMPU_METHOD PAUX15_ena_COMPU_VTAB "Verbal Table" TAB_VERB "%.0" "list" COMPU_TAB_REF PAUX15_ena_COMPU_VTAB_REF /end COMPU_METHOD
/begin COMPU_VTAB PAUX15_ena_COMPU_VTAB_REF "Verbal Table" TAB_VERB 31 0 "Disabled" 1 "Aux PD1" 2 "Aux PD2" 3 "Aux PD3" 4 "Aux PUD1" 5 "Aux PUD2" 6 "Aux PUD3" 7 "Aux PUD4" 8 "Aux PUD5" 9 "Aux PUD6" 10 "Aux PUD7" 11 "Aux PUD8" 12 "Aux PUD9" 13 "Aux PUD10" 14 "Aux PUD11" 15 "Aux PUD12" 16 "Aux PUD13" 17 "Aux PUD14" 18 "Aux PUD15" 19 "CAN sourced" 20 "FPP2 Input" 21 "Aux PUD16" 22 "Aux PUD17" 23 "Aux PUD18" 24 "Aux PUD19" 25 "Aux PUD20" 26 "Aux PUD21" 27 "Aux PUD22" 28 "Aux PUD23" 29 "Aux PUD24" 30 "Aux PUD25" DEFAULT_VALUE "UNKNOWN" /end COMPU_VTAB
/begin CHARACTERISTIC PAUX16_ena "{PAUX16_ena&0xff=0:Disabled}{PAUX16_ena&0xff=1:Aux PD1}{PAUX16_ena&0xff=2:Aux PD2}{PAUX16_ena&0xff=3:Aux PD3}{PAUX16_ena&0xff=4:Aux PUD1}{PAUX16_ena&0xff=5:Aux PUD2}{PAUX16_ena&0xff=6:Aux PUD3}{PAUX16_ena&0xff=7:Aux PUD4}{PAUX16_ena&0xff=8:Aux PUD5}{PAUX1" VALUE 0x001C8896 /* @ECU_Address@PAUX16_ena@0x0100BAB8@ */ ECIPP_ALIGNMENT_UBYTE 255 PAUX16_ena_COMPU_VTAB 0 255 BIT_MASK 0xff /end CHARACTERISTIC
/begin COMPU_METHOD PAUX16_ena_COMPU_VTAB "Verbal Table" TAB_VERB "%.0" "list" COMPU_TAB_REF PAUX16_ena_COMPU_VTAB_REF /end COMPU_METHOD
/begin COMPU_VTAB PAUX16_ena_COMPU_VTAB_REF "Verbal Table" TAB_VERB 31 0 "Disabled" 1 "Aux PD1" 2 "Aux PD2" 3 "Aux PD3" 4 "Aux PUD1" 5 "Aux PUD2" 6 "Aux PUD3" 7 "Aux PUD4" 8 "Aux PUD5" 9 "Aux PUD6" 10 "Aux PUD7" 11 "Aux PUD8" 12 "Aux PUD9" 13 "Aux PUD10" 14 "Aux PUD11" 15 "Aux PUD12" 16 "Aux PUD13" 17 "Aux PUD14" 18 "Aux PUD15" 19 "CAN sourced" 20 "FPP2 Input" 21 "Aux PUD16" 22 "Aux PUD17" 23 "Aux PUD18" 24 "Aux PUD19" 25 "Aux PUD20" 26 "Aux PUD21" 27 "Aux PUD22" 28 "Aux PUD23" 29 "Aux PUD24" 30 "Aux PUD25" DEFAULT_VALUE "UNKNOWN" /end COMPU_VTAB
/begin CHARACTERISTIC TAUX9_ena "{TAUX9_ena&0xff=0:Disabled}{TAUX9_ena&0xff=1:Aux PU1}{TAUX9_ena&0xff=2:Aux PU2}{TAUX9_ena&0xff=3:Aux PU3}{TAUX9_ena&0xff=4:Aux PUD1}{TAUX9_ena&0xff=5:Aux PUD2}{TAUX9_ena&0xff=6:Aux PUD3}{TAUX9_ena&0xff=7:EGT Input}{TAUX9_ena&0xff=8:Aux PUD4}{TAUX9_ena&0xf" VALUE 0x001C8F0F /* @ECU_Address@TAUX9_ena@0x0100BAC0@ */ ECIPP_ALIGNMENT_UBYTE 255 TAUX9_ena_COMPU_VTAB 0 255 BIT_MASK 0xff /end CHARACTERISTIC
/begin COMPU_METHOD TAUX9_ena_COMPU_VTAB "Verbal Table" TAB_VERB "%.0" "list" COMPU_TAB_REF TAUX9_ena_COMPU_VTAB_REF /end COMPU_METHOD
/begin COMPU_VTAB TAUX9_ena_COMPU_VTAB_REF "Verbal Table" TAB_VERB 31 0 "Disabled" 1 "Aux PU1" 2 "Aux PU2" 3 "Aux PU3" 4 "Aux PUD1" 5 "Aux PUD2" 6 "Aux PUD3" 7 "EGT Input" 8 "Aux PUD4" 9 "Aux PUD5" 10 "Aux PUD6" 11 "Aux PUD7" 12 "Aux PUD8" 13 "Aux PUD9" 14 "Aux PUD10" 15 "Aux PUD11" 16 "Aux PUD12" 17 "Aux PUD13" 18 "Aux PUD14" 19 "Aux PUD15" 20 "Aux PUD16" 21 "Aux PUD17" 22 "Aux PUD18" 23 "Aux PUD19" 24 "Aux PUD20" 25 "Aux PUD21" 26 "Aux PUD22" 27 "Aux PUD23" 28 "Aux PUD24" 29 "Aux PUD25" 30 "CAN sourced" DEFAULT_VALUE "UNKNOWN" /end COMPU_VTAB
/begin CHARACTERISTIC TAUX10_ena "{TAUX10_ena&0xff=0:Disabled}{TAUX10_ena&0xff=1:Aux PU1}{TAUX10_ena&0xff=2:Aux PU2}{TAUX10_ena&0xff=3:Aux PU3}{TAUX10_ena&0xff=4:Aux PUD1}{TAUX10_ena&0xff=5:Aux PUD2}{TAUX10_ena&0xff=6:Aux PUD3}{TAUX10_ena&0xff=7:EGT Input}{TAUX10_ena&0xff=8:Aux PUD4}{TAUX" VALUE 0x001C8F10 /* @ECU_Address@TAUX10_ena@0x0100BAC8@ */ ECIPP_ALIGNMENT_UBYTE 255 TAUX10_ena_COMPU_VTAB 0 255 BIT_MASK 0xff /end CHARACTERISTIC
/begin COMPU_METHOD TAUX10_ena_COMPU_VTAB "Verbal Table" TAB_VERB "%.0" "list" COMPU_TAB_REF TAUX10_ena_COMPU_VTAB_REF /end COMPU_METHOD
/begin COMPU_VTAB TAUX10_ena_COMPU_VTAB_REF "Verbal Table" TAB_VERB 31 0 "Disabled" 1 "Aux PU1" 2 "Aux PU2" 3 "Aux PU3" 4 "Aux PUD1" 5 "Aux PUD2" 6 "Aux PUD3" 7 "EGT Input" 8 "Aux PUD4" 9 "Aux PUD5" 10 "Aux PUD6" 11 "Aux PUD7" 12 "Aux PUD8" 13 "Aux PUD9" 14 "Aux PUD10" 15 "Aux PUD11" 16 "Aux PUD12" 17 "Aux PUD13" 18 "Aux PUD14" 19 "Aux PUD15" 20 "Aux PUD16" 21 "Aux PUD17" 22 "Aux PUD18" 23 "Aux PUD19" 24 "Aux PUD20" 25 "Aux PUD21" 26 "Aux PUD22" 27 "Aux PUD23" 28 "Aux PUD24" 29 "Aux PUD25" 30 "CAN sourced" DEFAULT_VALUE "UNKNOWN" /end COMPU_VTAB
/begin CHARACTERISTIC TAUX11_ena "{TAUX11_ena&0xff=0:Disabled}{TAUX11_ena&0xff=1:Aux PU1}{TAUX11_ena&0xff=2:Aux PU2}{TAUX11_ena&0xff=3:Aux PU3}{TAUX11_ena&0xff=4:Aux PUD1}{TAUX11_ena&0xff=5:Aux PUD2}{TAUX11_ena&0xff=6:Aux PUD3}{TAUX11_ena&0xff=7:EGT Input}{TAUX11_ena&0xff=8:Aux PUD4}{TAUX" VALUE 0x001C8F11 /* @ECU_Address@TAUX11_ena@0x0100BAD0@ */ ECIPP_ALIGNMENT_UBYTE 255 TAUX11_ena_COMPU_VTAB 0 255 BIT_MASK 0xff /end CHARACTERISTIC
/begin COMPU_METHOD TAUX11_ena_COMPU_VTAB "Verbal Table" TAB_VERB "%.0" "list" COMPU_TAB_REF TAUX11_ena_COMPU_VTAB_REF /end COMPU_METHOD
/begin COMPU_VTAB TAUX11_ena_COMPU_VTAB_REF "Verbal Table" TAB_VERB 31 0 "Disabled" 1 "Aux PU1" 2 "Aux PU2" 3 "Aux PU3" 4 "Aux PUD1" 5 "Aux PUD2" 6 "Aux PUD3" 7 "EGT Input" 8 "Aux PUD4" 9 "Aux PUD5" 10 "Aux PUD6" 11 "Aux PUD7" 12 "Aux PUD8" 13 "Aux PUD9" 14 "Aux PUD10" 15 "Aux PUD11" 16 "Aux PUD12" 17 "Aux PUD13" 18 "Aux PUD14" 19 "Aux PUD15" 20 "Aux PUD16" 21 "Aux PUD17" 22 "Aux PUD18" 23 "Aux PUD19" 24 "Aux PUD20" 25 "Aux PUD21" 26 "Aux PUD22" 27 "Aux PUD23" 28 "Aux PUD24" 29 "Aux PUD25" 30 "CAN sourced" DEFAULT_VALUE "UNKNOWN" /end COMPU_VTAB
/begin CHARACTERISTIC TAUX12_ena "{TAUX12_ena&0xff=0:Disabled}{TAUX12_ena&0xff=1:Aux PU1}{TAUX12_ena&0xff=2:Aux PU2}{TAUX12_ena&0xff=3:Aux PU3}{TAUX12_ena&0xff=4:Aux PUD1}{TAUX12_ena&0xff=5:Aux PUD2}{TAUX12_ena&0xff=6:Aux PUD3}{TAUX12_ena&0xff=7:EGT Input}{TAUX12_ena&0xff=8:Aux PUD4}{TAUX" VALUE 0x001C8F12 /* @ECU_Address@TAUX12_ena@0x0100BAD8@ */ ECIPP_ALIGNMENT_UBYTE 255 TAUX12_ena_COMPU_VTAB 0 255 BIT_MASK 0xff /end CHARACTERISTIC
/begin COMPU_METHOD TAUX12_ena_COMPU_VTAB "Verbal Table" TAB_VERB "%.0" "list" COMPU_TAB_REF TAUX12_ena_COMPU_VTAB_REF /end COMPU_METHOD
/begin COMPU_VTAB TAUX12_ena_COMPU_VTAB_REF "Verbal Table" TAB_VERB 31 0 "Disabled" 1 "Aux PU1" 2 "Aux PU2" 3 "Aux PU3" 4 "Aux PUD1" 5 "Aux PUD2" 6 "Aux PUD3" 7 "EGT Input" 8 "Aux PUD4" 9 "Aux PUD5" 10 "Aux PUD6" 11 "Aux PUD7" 12 "Aux PUD8" 13 "Aux PUD9" 14 "Aux PUD10" 15 "Aux PUD11" 16 "Aux PUD12" 17 "Aux PUD13" 18 "Aux PUD14" 19 "Aux PUD15" 20 "Aux PUD16" 21 "Aux PUD17" 22 "Aux PUD18" 23 "Aux PUD19" 24 "Aux PUD20" 25 "Aux PUD21" 26 "Aux PUD22" 27 "Aux PUD23" 28 "Aux PUD24" 29 "Aux PUD25" 30 "CAN sourced" DEFAULT_VALUE "UNKNOWN" /end COMPU_VTAB
/begin CHARACTERISTIC TAUX13_ena "{TAUX13_ena&0xff=0:Disabled}{TAUX13_ena&0xff=1:Aux PU1}{TAUX13_ena&0xff=2:Aux PU2}{TAUX13_ena&0xff=3:Aux PU3}{TAUX13_ena&0xff=4:Aux PUD1}{TAUX13_ena&0xff=5:Aux PUD2}{TAUX13_ena&0xff=6:Aux PUD3}{TAUX13_ena&0xff=7:EGT Input}{TAUX13_ena&0xff=8:Aux PUD4}{TAUX" VALUE 0x001C8F13 /* @ECU_Address@TAUX13_ena@0x0100BAE0@ */ ECIPP_ALIGNMENT_UBYTE 255 TAUX13_ena_COMPU_VTAB 0 255 BIT_MASK 0xff /end CHARACTERISTIC
/begin COMPU_METHOD TAUX13_ena_COMPU_VTAB "Verbal Table" TAB_VERB "%.0" "list" COMPU_TAB_REF TAUX13_ena_COMPU_VTAB_REF /end COMPU_METHOD
/begin COMPU_VTAB TAUX13_ena_COMPU_VTAB_REF "Verbal Table" TAB_VERB 31 0 "Disabled" 1 "Aux PU1" 2 "Aux PU2" 3 "Aux PU3" 4 "Aux PUD1" 5 "Aux PUD2" 6 "Aux PUD3" 7 "EGT Input" 8 "Aux PUD4" 9 "Aux PUD5" 10 "Aux PUD6" 11 "Aux PUD7" 12 "Aux PUD8" 13 "Aux PUD9" 14 "Aux PUD10" 15 "Aux PUD11" 16 "Aux PUD12" 17 "Aux PUD13" 18 "Aux PUD14" 19 "Aux PUD15" 20 "Aux PUD16" 21 "Aux PUD17" 22 "Aux PUD18" 23 "Aux PUD19" 24 "Aux PUD20" 25 "Aux PUD21" 26 "Aux PUD22" 27 "Aux PUD23" 28 "Aux PUD24" 29 "Aux PUD25" 30 "CAN sourced" DEFAULT_VALUE "UNKNOWN" /end COMPU_VTAB
/begin CHARACTERISTIC TAUX14_ena "{TAUX14_ena&0xff=0:Disabled}{TAUX14_ena&0xff=1:Aux PU1}{TAUX14_ena&0xff=2:Aux PU2}{TAUX14_ena&0xff=3:Aux PU3}{TAUX14_ena&0xff=4:Aux PUD1}{TAUX14_ena&0xff=5:Aux PUD2}{TAUX14_ena&0xff=6:Aux PUD3}{TAUX14_ena&0xff=7:EGT Input}{TAUX14_ena&0xff=8:Aux PUD4}{TAUX" VALUE 0x001C8F14 /* @ECU_Address@TAUX14_ena@0x0100BAE8@ */ ECIPP_ALIGNMENT_UBYTE 255 TAUX14_ena_COMPU_VTAB 0 255 BIT_MASK 0xff /end CHARACTERISTIC
/begin COMPU_METHOD TAUX14_ena_COMPU_VTAB "Verbal Table" TAB_VERB "%.0" "list" COMPU_TAB_REF TAUX14_ena_COMPU_VTAB_REF /end COMPU_METHOD
/begin COMPU_VTAB TAUX14_ena_COMPU_VTAB_REF "Verbal Table" TAB_VERB 31 0 "Disabled" 1 "Aux PU1" 2 "Aux PU2" 3 "Aux PU3" 4 "Aux PUD1" 5 "Aux PUD2" 6 "Aux PUD3" 7 "EGT Input" 8 "Aux PUD4" 9 "Aux PUD5" 10 "Aux PUD6" 11 "Aux PUD7" 12 "Aux PUD8" 13 "Aux PUD9" 14 "Aux PUD10" 15 "Aux PUD11" 16 "Aux PUD12" 17 "Aux PUD13" 18 "Aux PUD14" 19 "Aux PUD15" 20 "Aux PUD16" 21 "Aux PUD17" 22 "Aux PUD18" 23 "Aux PUD19" 24 "Aux PUD20" 25 "Aux PUD21" 26 "Aux PUD22" 27 "Aux PUD23" 28 "Aux PUD24" 29 "Aux PUD25" 30 "CAN sourced" DEFAULT_VALUE "UNKNOWN" /end COMPU_VTAB
/begin CHARACTERISTIC TAUX15_ena "{TAUX15_ena&0xff=0:Disabled}{TAUX15_ena&0xff=1:Aux PU1}{TAUX15_ena&0xff=2:Aux PU2}{TAUX15_ena&0xff=3:Aux PU3}{TAUX15_ena&0xff=4:Aux PUD1}{TAUX15_ena&0xff=5:Aux PUD2}{TAUX15_ena&0xff=6:Aux PUD3}{TAUX15_ena&0xff=7:EGT Input}{TAUX15_ena&0xff=8:Aux PUD4}{TAUX" VALUE 0x001C8F15 /* @ECU_Address@TAUX15_ena@0x0100BAF0@ */ ECIPP_ALIGNMENT_UBYTE 255 TAUX15_ena_COMPU_VTAB 0 255 BIT_MASK 0xff /end CHARACTERISTIC
/begin COMPU_METHOD TAUX15_ena_COMPU_VTAB "Verbal Table" TAB_VERB "%.0" "list" COMPU_TAB_REF TAUX15_ena_COMPU_VTAB_REF /end COMPU_METHOD
/begin COMPU_VTAB TAUX15_ena_COMPU_VTAB_REF "Verbal Table" TAB_VERB 31 0 "Disabled" 1 "Aux PU1" 2 "Aux PU2" 3 "Aux PU3" 4 "Aux PUD1" 5 "Aux PUD2" 6 "Aux PUD3" 7 "EGT Input" 8 "Aux PUD4" 9 "Aux PUD5" 10 "Aux PUD6" 11 "Aux PUD7" 12 "Aux PUD8" 13 "Aux PUD9" 14 "Aux PUD10" 15 "Aux PUD11" 16 "Aux PUD12" 17 "Aux PUD13" 18 "Aux PUD14" 19 "Aux PUD15" 20 "Aux PUD16" 21 "Aux PUD17" 22 "Aux PUD18" 23 "Aux PUD19" 24 "Aux PUD20" 25 "Aux PUD21" 26 "Aux PUD22" 27 "Aux PUD23" 28 "Aux PUD24" 29 "Aux PUD25" 30 "CAN sourced" DEFAULT_VALUE "UNKNOWN" /end COMPU_VTAB
/begin CHARACTERISTIC TAUX16_ena "{TAUX16_ena&0xff=0:Disabled}{TAUX16_ena&0xff=1:Aux PU1}{TAUX16_ena&0xff=2:Aux PU2}{TAUX16_ena&0xff=3:Aux PU3}{TAUX16_ena&0xff=4:Aux PUD1}{TAUX16_ena&0xff=5:Aux PUD2}{TAUX16_ena&0xff=6:Aux PUD3}{TAUX16_ena&0xff=7:EGT Input}{TAUX16_ena&0xff=8:Aux PUD4}{TAUX" VALUE 0x001C8F16 /* @ECU_Address@TAUX16_ena@0x0100BAF8@ */ ECIPP_ALIGNMENT_UBYTE 255 TAUX16_ena_COMPU_VTAB 0 255 BIT_MASK 0xff /end CHARACTERISTIC
/begin COMPU_METHOD TAUX16_ena_COMPU_VTAB "Verbal Table" TAB_VERB "%.0" "list" COMPU_TAB_REF TAUX16_ena_COMPU_VTAB_REF /end COMPU_METHOD
/begin COMPU_VTAB TAUX16_ena_COMPU_VTAB_REF "Verbal Table" TAB_VERB 31 0 "Disabled" 1 "Aux PU1" 2 "Aux PU2" 3 "Aux PU3" 4 "Aux PUD1" 5 "Aux PUD2" 6 "Aux PUD3" 7 "EGT Input" 8 "Aux PUD4" 9 "Aux PUD5" 10 "Aux PUD6" 11 "Aux PUD7" 12 "Aux PUD8" 13 "Aux PUD9" 14 "Aux PUD10" 15 "Aux PUD11" 16 "Aux PUD12" 17 "Aux PUD13" 18 "Aux PUD14" 19 "Aux PUD15" 20 "Aux PUD16" 21 "Aux PUD17" 22 "Aux PUD18" 23 "Aux PUD19" 24 "Aux PUD20" 25 "Aux PUD21" 26 "Aux PUD22" 27 "Aux PUD23" 28 "Aux PUD24" 29 "Aux PUD25" 30 "CAN sourced" DEFAULT_VALUE "UNKNOWN" /end COMPU_VTAB
/begin CHARACTERISTIC TAUX9_Taux_cal "{TAUX9_Taux_cal&0xff=0:Fuel source}{TAUX9_Taux_cal&0xff=1:Exhaust manifold/riser}{TAUX9_Taux_cal&0xff=2:Aux Temp A}{TAUX9_Taux_cal&0xff=3:Aux Temp B}{TAUX9_Taux_cal&0xff=4:Aux Temp C}{TAUX9_Taux_cal&0xff=5:Aux Temp D}" VALUE 0x001C8EFF /* @ECU_Address@TAUX9_Taux_cal@0x0100BB00@ */ ECIPP_ALIGNMENT_UBYTE 255 TAUX9_Taux_cal_COMPU_VTAB 0 255 BIT_MASK 0xff /end CHARACTERISTIC
/begin COMPU_METHOD TAUX9_Taux_cal_COMPU_VTAB "Verbal Table" TAB_VERB "%.0" "list" COMPU_TAB_REF TAUX9_Taux_cal_COMPU_VTAB_REF /end COMPU_METHOD
/begin COMPU_VTAB TAUX9_Taux_cal_COMPU_VTAB_REF "Verbal Table" TAB_VERB 6 0 "Fuel source" 1 "Exhaust manifold/riser" 2 "Aux Temp A" 3 "Aux Temp B" 4 "Aux Temp C" 5 "Aux Temp D" DEFAULT_VALUE "UNKNOWN" /end COMPU_VTAB
/begin CHARACTERISTIC TAUX10_Taux_cal "{TAUX10_Taux_cal&0xff=0:Fuel source}{TAUX10_Taux_cal&0xff=1:Exhaust manifold/riser}{TAUX10_Taux_cal&0xff=2:Aux Temp A}{TAUX10_Taux_cal&0xff=3:Aux Temp B}{TAUX10_Taux_cal&0xff=4:Aux Temp C}{TAUX10_Taux_cal&0xff=5:Aux Temp D}" VALUE 0x001C8F00 /* @ECU_Address@TAUX10_Taux_cal@0x0100BB08@ */ ECIPP_ALIGNMENT_UBYTE 255 TAUX10_Taux_cal_COMPU_VTAB 0 255 BIT_MASK 0xff /end CHARACTERISTIC
/begin COMPU_METHOD TAUX10_Taux_cal_COMPU_VTAB "Verbal Table" TAB_VERB "%.0" "list" COMPU_TAB_REF TAUX10_Taux_cal_COMPU_VTAB_REF /end COMPU_METHOD
/begin COMPU_VTAB TAUX10_Taux_cal_COMPU_VTAB_REF "Verbal Table" TAB_VERB 6 0 "Fuel source" 1 "Exhaust manifold/riser" 2 "Aux Temp A" 3 "Aux Temp B" 4 "Aux Temp C" 5 "Aux Temp D" DEFAULT_VALUE "UNKNOWN" /end COMPU_VTAB
/begin CHARACTERISTIC TAUX11_Taux_cal "{TAUX11_Taux_cal&0xff=0:Fuel source}{TAUX11_Taux_cal&0xff=1:Exhaust manifold/riser}{TAUX11_Taux_cal&0xff=2:Aux Temp A}{TAUX11_Taux_cal&0xff=3:Aux Temp B}{TAUX11_Taux_cal&0xff=4:Aux Temp C}{TAUX11_Taux_cal&0xff=5:Aux Temp D}" VALUE 0x001C8F01 /* @ECU_Address@TAUX11_Taux_cal@0x0100BB10@ */ ECIPP_ALIGNMENT_UBYTE 255 TAUX11_Taux_cal_COMPU_VTAB 0 255 BIT_MASK 0xff /end CHARACTERISTIC
/begin COMPU_METHOD TAUX11_Taux_cal_COMPU_VTAB "Verbal Table" TAB_VERB "%.0" "list" COMPU_TAB_REF TAUX11_Taux_cal_COMPU_VTAB_REF /end COMPU_METHOD
/begin COMPU_VTAB TAUX11_Taux_cal_COMPU_VTAB_REF "Verbal Table" TAB_VERB 6 0 "Fuel source" 1 "Exhaust manifold/riser" 2 "Aux Temp A" 3 "Aux Temp B" 4 "Aux Temp C" 5 "Aux Temp D" DEFAULT_VALUE "UNKNOWN" /end COMPU_VTAB
/begin CHARACTERISTIC TAUX12_Taux_cal "{TAUX12_Taux_cal&0xff=0:Fuel source}{TAUX12_Taux_cal&0xff=1:Exhaust manifold/riser}{TAUX12_Taux_cal&0xff=2:Aux Temp A}{TAUX12_Taux_cal&0xff=3:Aux Temp B}{TAUX12_Taux_cal&0xff=4:Aux Temp C}{TAUX12_Taux_cal&0xff=5:Aux Temp D}" VALUE 0x001C8F02 /* @ECU_Address@TAUX12_Taux_cal@0x0100BB18@ */ ECIPP_ALIGNMENT_UBYTE 255 TAUX12_Taux_cal_COMPU_VTAB 0 255 BIT_MASK 0xff /end CHARACTERISTIC
/begin COMPU_METHOD TAUX12_Taux_cal_COMPU_VTAB "Verbal Table" TAB_VERB "%.0" "list" COMPU_TAB_REF TAUX12_Taux_cal_COMPU_VTAB_REF /end COMPU_METHOD
/begin COMPU_VTAB TAUX12_Taux_cal_COMPU_VTAB_REF "Verbal Table" TAB_VERB 6 0 "Fuel source" 1 "Exhaust manifold/riser" 2 "Aux Temp A" 3 "Aux Temp B" 4 "Aux Temp C" 5 "Aux Temp D" DEFAULT_VALUE "UNKNOWN" /end COMPU_VTAB
/begin CHARACTERISTIC TAUX13_Taux_cal "{TAUX13_Taux_cal&0xff=0:Fuel source}{TAUX13_Taux_cal&0xff=1:Exhaust manifold/riser}{TAUX13_Taux_cal&0xff=2:Aux Temp A}{TAUX13_Taux_cal&0xff=3:Aux Temp B}{TAUX13_Taux_cal&0xff=4:Aux Temp C}{TAUX13_Taux_cal&0xff=5:Aux Temp D}" VALUE 0x001C8F03 /* @ECU_Address@TAUX13_Taux_cal@0x0100BB20@ */ ECIPP_ALIGNMENT_UBYTE 255 TAUX13_Taux_cal_COMPU_VTAB 0 255 BIT_MASK 0xff /end CHARACTERISTIC
/begin COMPU_METHOD TAUX13_Taux_cal_COMPU_VTAB "Verbal Table" TAB_VERB "%.0" "list" COMPU_TAB_REF TAUX13_Taux_cal_COMPU_VTAB_REF /end COMPU_METHOD
/begin COMPU_VTAB TAUX13_Taux_cal_COMPU_VTAB_REF "Verbal Table" TAB_VERB 6 0 "Fuel source" 1 "Exhaust manifold/riser" 2 "Aux Temp A" 3 "Aux Temp B" 4 "Aux Temp C" 5 "Aux Temp D" DEFAULT_VALUE "UNKNOWN" /end COMPU_VTAB
/begin CHARACTERISTIC TAUX14_Taux_cal "{TAUX14_Taux_cal&0xff=0:Fuel source}{TAUX14_Taux_cal&0xff=1:Exhaust manifold/riser}{TAUX14_Taux_cal&0xff=2:Aux Temp A}{TAUX14_Taux_cal&0xff=3:Aux Temp B}{TAUX14_Taux_cal&0xff=4:Aux Temp C}{TAUX14_Taux_cal&0xff=5:Aux Temp D}" VALUE 0x001C8F04 /* @ECU_Address@TAUX14_Taux_cal@0x0100BB28@ */ ECIPP_ALIGNMENT_UBYTE 255 TAUX14_Taux_cal_COMPU_VTAB 0 255 BIT_MASK 0xff /end CHARACTERISTIC
/begin COMPU_METHOD TAUX14_Taux_cal_COMPU_VTAB "Verbal Table" TAB_VERB "%.0" "list" COMPU_TAB_REF TAUX14_Taux_cal_COMPU_VTAB_REF /end COMPU_METHOD
/begin COMPU_VTAB TAUX14_Taux_cal_COMPU_VTAB_REF "Verbal Table" TAB_VERB 6 0 "Fuel source" 1 "Exhaust manifold/riser" 2 "Aux Temp A" 3 "Aux Temp B" 4 "Aux Temp C" 5 "Aux Temp D" DEFAULT_VALUE "UNKNOWN" /end COMPU_VTAB
/begin CHARACTERISTIC TAUX15_Taux_cal "{TAUX15_Taux_cal&0xff=0:Fuel source}{TAUX15_Taux_cal&0xff=1:Exhaust manifold/riser}{TAUX15_Taux_cal&0xff=2:Aux Temp A}{TAUX15_Taux_cal&0xff=3:Aux Temp B}{TAUX15_Taux_cal&0xff=4:Aux Temp C}{TAUX15_Taux_cal&0xff=5:Aux Temp D}" VALUE 0x001C8F05 /* @ECU_Address@TAUX15_Taux_cal@0x0100BB30@ */ ECIPP_ALIGNMENT_UBYTE 255 TAUX15_Taux_cal_COMPU_VTAB 0 255 BIT_MASK 0xff /end CHARACTERISTIC
/begin COMPU_METHOD TAUX15_Taux_cal_COMPU_VTAB "Verbal Table" TAB_VERB "%.0" "list" COMPU_TAB_REF TAUX15_Taux_cal_COMPU_VTAB_REF /end COMPU_METHOD
/begin COMPU_VTAB TAUX15_Taux_cal_COMPU_VTAB_REF "Verbal Table" TAB_VERB 6 0 "Fuel source" 1 "Exhaust manifold/riser" 2 "Aux Temp A" 3 "Aux Temp B" 4 "Aux Temp C" 5 "Aux Temp D" DEFAULT_VALUE "UNKNOWN" /end COMPU_VTAB
/begin CHARACTERISTIC TAUX16_Taux_cal "{TAUX16_Taux_cal&0xff=0:Fuel source}{TAUX16_Taux_cal&0xff=1:Exhaust manifold/riser}{TAUX16_Taux_cal&0xff=2:Aux Temp A}{TAUX16_Taux_cal&0xff=3:Aux Temp B}{TAUX16_Taux_cal&0xff=4:Aux Temp C}{TAUX16_Taux_cal&0xff=5:Aux Temp D}" VALUE 0x001C8F06 /* @ECU_Address@TAUX16_Taux_cal@0x0100BB38@ */ ECIPP_ALIGNMENT_UBYTE 255 TAUX16_Taux_cal_COMPU_VTAB 0 255 BIT_MASK 0xff /end CHARACTERISTIC
/begin COMPU_METHOD TAUX16_Taux_cal_COMPU_VTAB "Verbal Table" TAB_VERB "%.0" "list" COMPU_TAB_REF TAUX16_Taux_cal_COMPU_VTAB_REF /end COMPU_METHOD
/begin COMPU_VTAB TAUX16_Taux_cal_COMPU_VTAB_REF "Verbal Table" TAB_VERB 6 0 "Fuel source" 1 "Exhaust manifold/riser" 2 "Aux Temp A" 3 "Aux Temp B" 4 "Aux Temp C" 5 "Aux Temp D" DEFAULT_VALUE "UNKNOWN" /end COMPU_VTAB
/begin CHARACTERISTIC TAUX9_vdr "IOConfig # TAUX9_vdr" VALUE 0x001C3B58 /* @ECU_Address@TAUX9_vdr@0x0100BB40@ */ ECIPP_ALIGNMENT_FLOAT32_IEEE 10000000000 Compu_TAUX9_vdr -10000000000 10000000000 /end CHARACTERISTIC
/begin COMPU_METHOD Compu_TAUX9_vdr " " RAT_FUNC "%.3" "ohms" COEFFS 0 1 0 0 0 1 /end COMPU_METHOD
/begin CHARACTERISTIC TAUX10_vdr "IOConfig # TAUX10_vdr" VALUE 0x001C3B5C /* @ECU_Address@TAUX10_vdr@0x0100BB48@ */ ECIPP_ALIGNMENT_FLOAT32_IEEE 10000000000 Compu_TAUX10_vdr -10000000000 10000000000 /end CHARACTERISTIC
/begin COMPU_METHOD Compu_TAUX10_vdr " " RAT_FUNC "%.3" "ohms" COEFFS 0 1 0 0 0 1 /end COMPU_METHOD
/begin CHARACTERISTIC TAUX11_vdr "IOConfig # TAUX11_vdr" VALUE 0x001C3B60 /* @ECU_Address@TAUX11_vdr@0x0100BB50@ */ ECIPP_ALIGNMENT_FLOAT32_IEEE 10000000000 Compu_TAUX11_vdr -10000000000 10000000000 /end CHARACTERISTIC
/begin COMPU_METHOD Compu_TAUX11_vdr " " RAT_FUNC "%.3" "ohms" COEFFS 0 1 0 0 0 1 /end COMPU_METHOD
/begin CHARACTERISTIC TAUX12_vdr "IOConfig # TAUX12_vdr" VALUE 0x001C3B64 /* @ECU_Address@TAUX12_vdr@0x0100BB58@ */ ECIPP_ALIGNMENT_FLOAT32_IEEE 10000000000 Compu_TAUX12_vdr -10000000000 10000000000 /end CHARACTERISTIC
/begin COMPU_METHOD Compu_TAUX12_vdr " " RAT_FUNC "%.3" "ohms" COEFFS 0 1 0 0 0 1 /end COMPU_METHOD
/begin CHARACTERISTIC TAUX13_vdr "IOConfig # TAUX13_vdr" VALUE 0x001C3B68 /* @ECU_Address@TAUX13_vdr@0x0100BB60@ */ ECIPP_ALIGNMENT_FLOAT32_IEEE 10000000000 Compu_TAUX13_vdr -10000000000 10000000000 /end CHARACTERISTIC
/begin COMPU_METHOD Compu_TAUX13_vdr " " RAT_FUNC "%.3" "ohms" COEFFS 0 1 0 0 0 1 /end COMPU_METHOD
/begin CHARACTERISTIC TAUX14_vdr "IOConfig # TAUX14_vdr" VALUE 0x001C3B6C /* @ECU_Address@TAUX14_vdr@0x0100BB68@ */ ECIPP_ALIGNMENT_FLOAT32_IEEE 10000000000 Compu_TAUX14_vdr -10000000000 10000000000 /end CHARACTERISTIC
/begin COMPU_METHOD Compu_TAUX14_vdr " " RAT_FUNC "%.3" "ohms" COEFFS 0 1 0 0 0 1 /end COMPU_METHOD
/begin CHARACTERISTIC TAUX15_vdr "IOConfig # TAUX15_vdr" VALUE 0x001C3B70 /* @ECU_Address@TAUX15_vdr@0x0100BB70@ */ ECIPP_ALIGNMENT_FLOAT32_IEEE 10000000000 Compu_TAUX15_vdr -10000000000 10000000000 /end CHARACTERISTIC
/begin COMPU_METHOD Compu_TAUX15_vdr " " RAT_FUNC "%.3" "ohms" COEFFS 0 1 0 0 0 1 /end COMPU_METHOD
/begin CHARACTERISTIC TAUX16_vdr "IOConfig # TAUX16_vdr" VALUE 0x001C3B74 /* @ECU_Address@TAUX16_vdr@0x0100BB78@ */ ECIPP_ALIGNMENT_FLOAT32_IEEE 10000000000 Compu_TAUX16_vdr -10000000000 10000000000 /end CHARACTERISTIC
/begin COMPU_METHOD Compu_TAUX16_vdr " " RAT_FUNC "%.3" "ohms" COEFFS 0 1 0 0 0 1 /end COMPU_METHOD
/begin CHARACTERISTIC EGRHP_Paux_cal "{EGRHP_Paux_cal&0xff=0:Aux Press A}{EGRHP_Paux_cal&0xff=1:Aux Press B}{EGRHP_Paux_cal&0xff=2:Aux Press C}{EGRHP_Paux_cal&0xff=3:Aux Press D}" VALUE 0x001c0aa0 /* @ECU_Address@EGRHP_Paux_cal@0x0100BBA8@ */ ECIPP_ALIGNMENT_UBYTE 255 EGRHP_Paux_cal_COMPU_VTAB 0 255 BIT_MASK 0xff /end CHARACTERISTIC
/begin COMPU_METHOD EGRHP_Paux_cal_COMPU_VTAB "Verbal Table" TAB_VERB "%.0" "list" COMPU_TAB_REF EGRHP_Paux_cal_COMPU_VTAB_REF /end COMPU_METHOD
/begin COMPU_VTAB EGRHP_Paux_cal_COMPU_VTAB_REF "Verbal Table" TAB_VERB 4 0 "Aux Press A" 1 "Aux Press B" 2 "Aux Press C" 3 "Aux Press D" DEFAULT_VALUE "UNKNOWN" /end COMPU_VTAB
/begin CHARACTERISTIC Aux_DIG2_rpm_lo "FaultConfig # Aux_DIG2_rpm_lo (Fault Condition:and RPM >=)" VALUE 0x001e37d4 /* @ECU_Address@Aux_DIG2_rpm_lo@0x0100BC00@ */ ECIPP_ALIGNMENT_UWORD 65535 Compu_Aux_DIG2_rpm_lo 0 65535 /end CHARACTERISTIC
/begin COMPU_METHOD Compu_Aux_DIG2_rpm_lo " " RAT_FUNC "%.0" "rpm" COEFFS 0 1 0 0 0 1 /end COMPU_METHOD
/begin CHARACTERISTIC Aux_DIG2_rpm_hi "FaultConfig # Aux_DIG2_rpm_hi (Fault Condition:and RPM <=)" VALUE 0x001e37d2 /* @ECU_Address@Aux_DIG2_rpm_hi@0x0100BC08@ */ ECIPP_ALIGNMENT_UWORD 65535 Compu_Aux_DIG2_rpm_hi 0 65535 /end CHARACTERISTIC
/begin COMPU_METHOD Compu_Aux_DIG2_rpm_hi " " RAT_FUNC "%.0" "rpm" COEFFS 0 1 0 0 0 1 /end COMPU_METHOD
/begin CHARACTERISTIC Aux_DIG2_ECT_lo "FaultConfig # Aux_DIG2_ECT_lo (Fault Condition:and ECT >=)" VALUE 0x001e37d0 /* @ECU_Address@Aux_DIG2_ECT_lo@0x0100BC10@ */ ECIPP_ALIGNMENT_UWORD 564 Compu_Aux_DIG2_ECT_lo -460 563.984375 /end CHARACTERISTIC
/begin COMPU_METHOD Compu_Aux_DIG2_ECT_lo " " RAT_FUNC "%.3" "deg F" COEFFS 0 64 29440 0 0 1 /end COMPU_METHOD
/begin CHARACTERISTIC EGRLP_Paux_cal "{EGRLP_Paux_cal&0xff=0:Aux Press A}{EGRLP_Paux_cal&0xff=1:Aux Press B}{EGRLP_Paux_cal&0xff=2:Aux Press C}{EGRLP_Paux_cal&0xff=3:Aux Press D}" VALUE 0x001c0aa2 /* @ECU_Address@EGRLP_Paux_cal@0x0100BC50@ */ ECIPP_ALIGNMENT_UBYTE 255 EGRLP_Paux_cal_COMPU_VTAB 0 255 BIT_MASK 0xff /end CHARACTERISTIC
/begin COMPU_METHOD EGRLP_Paux_cal_COMPU_VTAB "Verbal Table" TAB_VERB "%.0" "list" COMPU_TAB_REF EGRLP_Paux_cal_COMPU_VTAB_REF /end COMPU_METHOD
/begin COMPU_VTAB EGRLP_Paux_cal_COMPU_VTAB_REF "Verbal Table" TAB_VERB 4 0 "Aux Press A" 1 "Aux Press B" 2 "Aux Press C" 3 "Aux Press D" DEFAULT_VALUE "UNKNOWN" /end COMPU_VTAB
/begin CHARACTERISTIC PWM_flt_DCtrans_wt "FaultConfig # PWM_flt_DCtrans_wt (Fault Condition:PWM duty-cycle transition fault ignore wait)" VALUE 0x001e58ea /* @ECU_Address@PWM_flt_DCtrans_wt@0x0100BD90@ */ ECIPP_ALIGNMENT_SBYTE 127 Compu_PWM_flt_DCtrans_wt -128 127 /end CHARACTERISTIC
/begin COMPU_METHOD Compu_PWM_flt_DCtrans_wt " " RAT_FUNC "%.0" "ms" COEFFS 0 1 0 0 0 1 /end COMPU_METHOD
/begin CHARACTERISTIC rpmd_gov_lo_lmt "FaultConfig # rpmd_gov_lo_lmt (Fault Condition:rpm - governor desired speed >)" VALUE 0x001c84c2 /* @ECU_Address@rpmd_gov_lo_lmt@0x0100BD98@ */ ECIPP_ALIGNMENT_UWORD 65535 Compu_rpmd_gov_lo_lmt 0 65535 /end CHARACTERISTIC
/begin COMPU_METHOD Compu_rpmd_gov_lo_lmt " " RAT_FUNC "%.0" "rpm" COEFFS 0 1 0 0 0 1 /end COMPU_METHOD
/begin CHARACTERISTIC rpmd_gov_lo_min "FaultConfig # rpmd_gov_lo_min (Fault Condition:and governor desired speed >)" VALUE 0x001c84c6 /* @ECU_Address@rpmd_gov_lo_min@0x0100BDA0@ */ ECIPP_ALIGNMENT_UWORD 65535 Compu_rpmd_gov_lo_min 0 65535 /end CHARACTERISTIC
/begin COMPU_METHOD Compu_rpmd_gov_lo_min " " RAT_FUNC "%.0" "rpm" COEFFS 0 1 0 0 0 1 /end COMPU_METHOD
/begin CHARACTERISTIC rpmd_gov_lo_max "FaultConfig # rpmd_gov_lo_max (Fault Condition:and governor desired speed <)" VALUE 0x001c84c4 /* @ECU_Address@rpmd_gov_lo_max@0x0100BDA8@ */ ECIPP_ALIGNMENT_UWORD 65535 Compu_rpmd_gov_lo_max 0 65535 /end CHARACTERISTIC
/begin COMPU_METHOD Compu_rpmd_gov_lo_max " " RAT_FUNC "%.0" "rpm" COEFFS 0 1 0 0 0 1 /end COMPU_METHOD
/begin CHARACTERISTIC MAP_HiExp "FaultConfig # MAP_HiExp (Fault Condition:MAP - MAP estimate >)" VALUE 0x001c7d40 /* @ECU_Address@MAP_HiExp@0x0100BDB0@ */ ECIPP_ALIGNMENT_UWORD 256 Compu_MAP_HiExp 0 255.99609375 /end CHARACTERISTIC
/begin COMPU_METHOD Compu_MAP_HiExp " " RAT_FUNC "%.3" "psi" COEFFS 0 256 0 0 0 1 /end COMPU_METHOD
/begin CHARACTERISTIC PWMLO_off_loVf "FaultConfig # PWMLO_off_loVf (Fault Condition:PWM low-side feedback <)" VALUE 0x001e57e4 /* @ECU_Address@PWMLO_off_loVf@0x0100C028@ */ ECIPP_ALIGNMENT_UWORD 100 Compu_PWMLO_off_loVf 0 99.9984741210938 /end CHARACTERISTIC
/begin COMPU_METHOD Compu_PWMLO_off_loVf " " RAT_FUNC "%.3" "% Vbat" COEFFS 0 655.36 0 0 0 1 /end COMPU_METHOD
/begin CHARACTERISTIC PWMLO_off_loDC "FaultConfig # PWMLO_off_loDC (Fault Condition:and PWM duty-cycle <)" VALUE 0x001e57e2 /* @ECU_Address@PWMLO_off_loDC@0x0100C030@ */ ECIPP_ALIGNMENT_UWORD 100 Compu_PWMLO_off_loDC 0 99.9984741210938 /end CHARACTERISTIC
/begin COMPU_METHOD Compu_PWMLO_off_loDC " " RAT_FUNC "%.3" "%" COEFFS 0 655.36 0 0 0 1 /end COMPU_METHOD
/begin CHARACTERISTIC PWMLO_on_hiVf "FaultConfig # PWMLO_on_hiVf (Fault Condition:PWM low-side feedback >)" VALUE 0x001e57e8 /* @ECU_Address@PWMLO_on_hiVf@0x0100C038@ */ ECIPP_ALIGNMENT_UWORD 100 Compu_PWMLO_on_hiVf 0 99.9984741210938 /end CHARACTERISTIC
/begin COMPU_METHOD Compu_PWMLO_on_hiVf " " RAT_FUNC "%.3" "% Vbat" COEFFS 0 655.36 0 0 0 1 /end COMPU_METHOD
/begin CHARACTERISTIC PWMLO_on_hiDC "FaultConfig # PWMLO_on_hiDC (Fault Condition:and PWM duty-cycle >)" VALUE 0x001e57e6 /* @ECU_Address@PWMLO_on_hiDC@0x0100C040@ */ ECIPP_ALIGNMENT_UWORD 100 Compu_PWMLO_on_hiDC 0 99.9984741210938 /end CHARACTERISTIC
/begin COMPU_METHOD Compu_PWMLO_on_hiDC " " RAT_FUNC "%.3" "%" COEFFS 0 655.36 0 0 0 1 /end COMPU_METHOD
/begin CHARACTERISTIC IOAI_alternator "{IOAI_alternator&0xff=0:Default / standard pin}{IOAI_alternator&0xff=1:Aux PUD1}{IOAI_alternator&0xff=2:Aux PUD2}{IOAI_alternator&0xff=3:Aux PUD3}{IOAI_alternator&0xff=4:Aux PUD4}{IOAI_alternator&0xff=5:Aux PUD5}{IOAI_alternator&0xff=6:Aux PUD6}{IOAI_alte" VALUE 0x001c8787 /* @ECU_Address@IOAI_alternator@0x0100C048@ */ ECIPP_ALIGNMENT_UBYTE 255 IOAI_alternator_COMPU_VTAB 0 255 BIT_MASK 0xff /end CHARACTERISTIC
/begin COMPU_METHOD IOAI_alternator_COMPU_VTAB "Verbal Table" TAB_VERB "%.0" "list" COMPU_TAB_REF IOAI_alternator_COMPU_VTAB_REF /end COMPU_METHOD
/begin COMPU_VTAB IOAI_alternator_COMPU_VTAB_REF "Verbal Table" TAB_VERB 51 0 "Default / standard pin" 1 "Aux PUD1" 2 "Aux PUD2" 3 "Aux PUD3" 4 "Aux PUD4" 5 "Aux PUD5" 6 "Aux PUD6" 7 "Aux PUD7" 8 "Aux PUD8" 9 "Aux PUD9" 10 "Aux PUD10" 11 "Aux PUD11" 12 "Aux PUD12" 13 "Aux PUD13" 14 "Aux PUD14" 15 "Aux PUD15" 16 "Aux PUD16" 17 "Aux PUD17" 18 "Aux PUD18" 19 "Aux PUD19" 20 "Aux PUD20" 21 "Aux PUD21" 22 "Aux PUD22" 23 "Aux PUD23" 24 "Aux PUD24" 25 "Aux PUD25" 26 "Aux DIG1" 27 "Aux DIG2" 28 "Aux DIG3" 29 "Aux DIG4" 30 "Aux DIG5" 31 "Aux DIG6" 32 "Aux DIG7" 33 "Aux DIG8" 34 "Aux DIG9" 35 "Aux DIG10" 36 "Aux DIG11" 37 "Aux DIG12" 38 "Aux DIG13" 39 "Aux DIG14" 40 "Aux DIG15" 41 "Aux DIG16" 42 "Aux DIG17" 43 "Aux DIG18" 44 "Aux DIG19" 45 "Aux DIG20" 46 "Aux DIG21" 47 "Aux DIG22" 48 "Aux DIG23" 49 "Aux DIG24" 50 "Aux DIG25" DEFAULT_VALUE "UNKNOWN" /end COMPU_VTAB
/begin CHARACTERISTIC UGF1_Hv_lo_limit "FaultConfig # UGF1_Hv_lo_limit (Fault Condition:or <)" VALUE 0x001c82fa /* @ECU_Address@UGF1_Hv_lo_limit@0x0100C0A8@ */ ECIPP_ALIGNMENT_UWORD 256 Compu_UGF1_Hv_lo_limit 0 255.99609375 /end CHARACTERISTIC
/begin COMPU_METHOD Compu_UGF1_Hv_lo_limit " " RAT_FUNC "%.3" "volts" COEFFS 0 256 0 0 0 1 /end COMPU_METHOD
/begin CHARACTERISTIC UGF1_Hv_hi_limit "FaultConfig # UGF1_Hv_hi_limit (Fault Condition:UEGO1 heater supply voltage >)" VALUE 0x001c82f8 /* @ECU_Address@UGF1_Hv_hi_limit@0x0100C0B0@ */ ECIPP_ALIGNMENT_UWORD 256 Compu_UGF1_Hv_hi_limit 0 255.99609375 /end CHARACTERISTIC
/begin COMPU_METHOD Compu_UGF1_Hv_hi_limit " " RAT_FUNC "%.3" "volts" COEFFS 0 256 0 0 0 1 /end COMPU_METHOD
/begin CHARACTERISTIC UGF2_Hv_lo_limit "FaultConfig # UGF2_Hv_lo_limit (Fault Condition:or <)" VALUE 0x001c82fe /* @ECU_Address@UGF2_Hv_lo_limit@0x0100C0B8@ */ ECIPP_ALIGNMENT_UWORD 256 Compu_UGF2_Hv_lo_limit 0 255.99609375 /end CHARACTERISTIC
/begin COMPU_METHOD Compu_UGF2_Hv_lo_limit " " RAT_FUNC "%.3" "volts" COEFFS 0 256 0 0 0 1 /end COMPU_METHOD
/begin CHARACTERISTIC UGF2_Hv_hi_limit "FaultConfig # UGF2_Hv_hi_limit (Fault Condition:UEGO2 heater supply voltage >)" VALUE 0x001c82fc /* @ECU_Address@UGF2_Hv_hi_limit@0x0100C0C0@ */ ECIPP_ALIGNMENT_UWORD 256 Compu_UGF2_Hv_hi_limit 0 255.99609375 /end CHARACTERISTIC
/begin COMPU_METHOD Compu_UGF2_Hv_hi_limit " " RAT_FUNC "%.3" "volts" COEFFS 0 256 0 0 0 1 /end COMPU_METHOD
/begin CHARACTERISTIC CFV_mdot_pct_hi "Fuel # CFV_mdot_pct_hi (Fault Condition:(actual flow - commanded flow) >)" VALUE 0x001c4456 /* @ECU_Address@CFV_mdot_pct_hi@0x0100C2A8@ */ ECIPP_ALIGNMENT_SWORD 6400 Compu_CFV_mdot_pct_hi -6400 6399.8046875 /end CHARACTERISTIC
/begin COMPU_METHOD Compu_CFV_mdot_pct_hi " " RAT_FUNC "%.3" "%" COEFFS 0 5.12 0 0 0 1 /end COMPU_METHOD
/begin CHARACTERISTIC CFV_mdot_pct_lo "Fuel # CFV_mdot_pct_lo (Fault Condition:(actual flow - commanded flow) <)" VALUE 0x001c4458 /* @ECU_Address@CFV_mdot_pct_lo@0x0100C2B0@ */ ECIPP_ALIGNMENT_SWORD 6400 Compu_CFV_mdot_pct_lo -6400 6399.8046875 /end CHARACTERISTIC
/begin COMPU_METHOD Compu_CFV_mdot_pct_lo " " RAT_FUNC "%.3" "%" COEFFS 0 5.12 0 0 0 1 /end COMPU_METHOD
/begin CHARACTERISTIC CATdP_Paux_cal "{CATdP_Paux_cal&0xff=0:Aux Press A}{CATdP_Paux_cal&0xff=1:Aux Press B}{CATdP_Paux_cal&0xff=2:Aux Press C}{CATdP_Paux_cal&0xff=3:Aux Press D}" VALUE 0x001c8695 /* @ECU_Address@CATdP_Paux_cal@0x0100C2F8@ */ ECIPP_ALIGNMENT_UBYTE 255 CATdP_Paux_cal_COMPU_VTAB 0 255 BIT_MASK 0xff /end CHARACTERISTIC
/begin COMPU_METHOD CATdP_Paux_cal_COMPU_VTAB "Verbal Table" TAB_VERB "%.0" "list" COMPU_TAB_REF CATdP_Paux_cal_COMPU_VTAB_REF /end COMPU_METHOD
/begin COMPU_VTAB CATdP_Paux_cal_COMPU_VTAB_REF "Verbal Table" TAB_VERB 4 0 "Aux Press A" 1 "Aux Press B" 2 "Aux Press C" 3 "Aux Press D" DEFAULT_VALUE "UNKNOWN" /end COMPU_VTAB
/begin CHARACTERISTIC CATdP_Vdot_min "General # CATdP_Vdot_min" VALUE 0x001c6db4 /* @ECU_Address@CATdP_Vdot_min@0x0100C300@ */ ECIPP_ALIGNMENT_UWORD 8192 Compu_CATdP_Vdot_min 0 8191.875 /end CHARACTERISTIC
/begin COMPU_METHOD Compu_CATdP_Vdot_min " " RAT_FUNC "%.3" "liters/sec" COEFFS 0 8 0 0 0 1 /end COMPU_METHOD
/begin CHARACTERISTIC TPS2_angle_at_full "IOConfig # TPS2_angle_at_full" VALUE 0x001C9C3A /* @ECU_Address@TPS2_angle_at_full@0x0100C310@ */ ECIPP_ALIGNMENT_UWORD 100 Compu_TPS2_angle_at_full 0 99.9984741210938 /end CHARACTERISTIC
/begin COMPU_METHOD Compu_TPS2_angle_at_full " " RAT_FUNC "%.3" "%" COEFFS 0 655.36 0 0 0 1 /end COMPU_METHOD
/begin CHARACTERISTIC APS2_angle_at_full "IOConfig # APS2_angle_at_full" VALUE 0x001C9E0E /* @ECU_Address@APS2_angle_at_full@0x0100C318@ */ ECIPP_ALIGNMENT_UWORD 100 Compu_APS2_angle_at_full 0 99.9984741210938 /end CHARACTERISTIC
/begin COMPU_METHOD Compu_APS2_angle_at_full " " RAT_FUNC "%.3" "%" COEFFS 0 655.36 0 0 0 1 /end COMPU_METHOD
/begin CHARACTERISTIC BPS2_angle_at_full "IOConfig # BPS2_angle_at_full" VALUE 0x001C9EAE /* @ECU_Address@BPS2_angle_at_full@0x0100C320@ */ ECIPP_ALIGNMENT_UWORD 100 Compu_BPS2_angle_at_full 0 99.9984741210938 /end CHARACTERISTIC
/begin COMPU_METHOD Compu_BPS2_angle_at_full " " RAT_FUNC "%.3" "%" COEFFS 0 655.36 0 0 0 1 /end COMPU_METHOD
/begin CHARACTERISTIC DBW_fault_Ilim "FaultConfig # DBW_fault_Ilim (Fault Condition:DBW electrical model current >)" VALUE 0x001C9C7C /* @ECU_Address@DBW_fault_Ilim@0x0100C328@ */ ECIPP_ALIGNMENT_UWORD 64 Compu_DBW_fault_Ilim 0 63.9990234375 /end CHARACTERISTIC
/begin COMPU_METHOD Compu_DBW_fault_Ilim " " RAT_FUNC "%.3" "amps" COEFFS 0 1024 0 0 0 1 /end COMPU_METHOD
/begin CHARACTERISTIC HBA_fault_Ilim "FaultConfig # HBA_fault_Ilim (Fault Condition:HBA electrical model current >)" VALUE 0x001C9E50 /* @ECU_Address@HBA_fault_Ilim@0x0100C330@ */ ECIPP_ALIGNMENT_UWORD 64 Compu_HBA_fault_Ilim 0 63.9990234375 /end CHARACTERISTIC
/begin COMPU_METHOD Compu_HBA_fault_Ilim " " RAT_FUNC "%.3" "amps" COEFFS 0 1024 0 0 0 1 /end COMPU_METHOD
/begin CHARACTERISTIC HBB_fault_Ilim "FaultConfig # HBB_fault_Ilim (Fault Condition:HBB electrical model current >)" VALUE 0x001C9EF0 /* @ECU_Address@HBB_fault_Ilim@0x0100C338@ */ ECIPP_ALIGNMENT_UWORD 64 Compu_HBB_fault_Ilim 0 63.9990234375 /end CHARACTERISTIC
/begin COMPU_METHOD Compu_HBB_fault_Ilim " " RAT_FUNC "%.3" "amps" COEFFS 0 1024 0 0 0 1 /end COMPU_METHOD
/begin CHARACTERISTIC FauxA_Funits "{FauxA_Funits&0xff=0:gpm}{FauxA_Funits&0xff=1:Lpm}" VALUE 0x001c874b /* @ECU_Address@FauxA_Funits@0x0100C6E8@ */ ECIPP_ALIGNMENT_UBYTE 255 FauxA_Funits_COMPU_VTAB 0 255 BIT_MASK 0xff /end CHARACTERISTIC
/begin COMPU_METHOD FauxA_Funits_COMPU_VTAB "Verbal Table" TAB_VERB "%.0" "list" COMPU_TAB_REF FauxA_Funits_COMPU_VTAB_REF /end COMPU_METHOD
/begin COMPU_VTAB FauxA_Funits_COMPU_VTAB_REF "Verbal Table" TAB_VERB 2 0 "gpm" 1 "Lpm" DEFAULT_VALUE "UNKNOWN" /end COMPU_VTAB
/begin CHARACTERISTIC FauxB_Funits "{FauxB_Funits&0xff=0:gpm}{FauxB_Funits&0xff=1:Lpm}" VALUE 0x001c874c /* @ECU_Address@FauxB_Funits@0x0100C6F0@ */ ECIPP_ALIGNMENT_UBYTE 255 FauxB_Funits_COMPU_VTAB 0 255 BIT_MASK 0xff /end CHARACTERISTIC
/begin COMPU_METHOD FauxB_Funits_COMPU_VTAB "Verbal Table" TAB_VERB "%.0" "list" COMPU_TAB_REF FauxB_Funits_COMPU_VTAB_REF /end COMPU_METHOD
/begin COMPU_VTAB FauxB_Funits_COMPU_VTAB_REF "Verbal Table" TAB_VERB 2 0 "gpm" 1 "Lpm" DEFAULT_VALUE "UNKNOWN" /end COMPU_VTAB
/begin CHARACTERISTIC FAUX1_Faux_cal "{FAUX1_Faux_cal&0xff=0:Aux Flow A}{FAUX1_Faux_cal&0xff=1:Aux Flow B}" VALUE 0x001C86FA /* @ECU_Address@FAUX1_Faux_cal@0x0100C708@ */ ECIPP_ALIGNMENT_UBYTE 255 FAUX1_Faux_cal_COMPU_VTAB 0 255 BIT_MASK 0xff /end CHARACTERISTIC
/begin COMPU_METHOD FAUX1_Faux_cal_COMPU_VTAB "Verbal Table" TAB_VERB "%.0" "list" COMPU_TAB_REF FAUX1_Faux_cal_COMPU_VTAB_REF /end COMPU_METHOD
/begin COMPU_VTAB FAUX1_Faux_cal_COMPU_VTAB_REF "Verbal Table" TAB_VERB 2 0 "Aux Flow A" 1 "Aux Flow B" DEFAULT_VALUE "UNKNOWN" /end COMPU_VTAB
/begin CHARACTERISTIC FAUX2_Faux_cal "{FAUX2_Faux_cal&0xff=0:Aux Flow A}{FAUX2_Faux_cal&0xff=1:Aux Flow B}" VALUE 0x001C86FB /* @ECU_Address@FAUX2_Faux_cal@0x0100C710@ */ ECIPP_ALIGNMENT_UBYTE 255 FAUX2_Faux_cal_COMPU_VTAB 0 255 BIT_MASK 0xff /end CHARACTERISTIC
/begin COMPU_METHOD FAUX2_Faux_cal_COMPU_VTAB "Verbal Table" TAB_VERB "%.0" "list" COMPU_TAB_REF FAUX2_Faux_cal_COMPU_VTAB_REF /end COMPU_METHOD
/begin COMPU_VTAB FAUX2_Faux_cal_COMPU_VTAB_REF "Verbal Table" TAB_VERB 2 0 "Aux Flow A" 1 "Aux Flow B" DEFAULT_VALUE "UNKNOWN" /end COMPU_VTAB
/begin CHARACTERISTIC FAUX1_ena "{FAUX1_ena&0xff=0:Disabled}{FAUX1_ena&0xff=1:Aux PUD1}{FAUX1_ena&0xff=2:Aux PUD2}{FAUX1_ena&0xff=3:Aux PUD3}{FAUX1_ena&0xff=4:Aux PUD4}{FAUX1_ena&0xff=5:Aux PUD5}{FAUX1_ena&0xff=6:Aux PUD6}{FAUX1_ena&0xff=7:Aux PUD7}{FAUX1_ena&0xff=8:Aux PUD8}{FAUX1_ena&0" VALUE 0x001C86FC /* @ECU_Address@FAUX1_ena@0x0100C718@ */ ECIPP_ALIGNMENT_UBYTE 255 FAUX1_ena_COMPU_VTAB 0 255 BIT_MASK 0xff /end CHARACTERISTIC
/begin COMPU_METHOD FAUX1_ena_COMPU_VTAB "Verbal Table" TAB_VERB "%.0" "list" COMPU_TAB_REF FAUX1_ena_COMPU_VTAB_REF /end COMPU_METHOD
/begin COMPU_VTAB FAUX1_ena_COMPU_VTAB_REF "Verbal Table" TAB_VERB 10 0 "Disabled" 1 "Aux PUD1" 2 "Aux PUD2" 3 "Aux PUD3" 4 "Aux PUD4" 5 "Aux PUD5" 6 "Aux PUD6" 7 "Aux PUD7" 8 "Aux PUD8" 9 "Aux PUD9" DEFAULT_VALUE "UNKNOWN" /end COMPU_VTAB
/begin CHARACTERISTIC FAUX2_ena "{FAUX2_ena&0xff=0:Disabled}{FAUX2_ena&0xff=1:Aux PUD1}{FAUX2_ena&0xff=2:Aux PUD2}{FAUX2_ena&0xff=3:Aux PUD3}{FAUX2_ena&0xff=4:Aux PUD4}{FAUX2_ena&0xff=5:Aux PUD5}{FAUX2_ena&0xff=6:Aux PUD6}{FAUX2_ena&0xff=7:Aux PUD7}{FAUX2_ena&0xff=8:Aux PUD8}{FAUX2_ena&0" VALUE 0x001C86FD /* @ECU_Address@FAUX2_ena@0x0100C720@ */ ECIPP_ALIGNMENT_UBYTE 255 FAUX2_ena_COMPU_VTAB 0 255 BIT_MASK 0xff /end CHARACTERISTIC
/begin COMPU_METHOD FAUX2_ena_COMPU_VTAB "Verbal Table" TAB_VERB "%.0" "list" COMPU_TAB_REF FAUX2_ena_COMPU_VTAB_REF /end COMPU_METHOD
/begin COMPU_VTAB FAUX2_ena_COMPU_VTAB_REF "Verbal Table" TAB_VERB 10 0 "Disabled" 1 "Aux PUD1" 2 "Aux PUD2" 3 "Aux PUD3" 4 "Aux PUD4" 5 "Aux PUD5" 6 "Aux PUD6" 7 "Aux PUD7" 8 "Aux PUD8" 9 "Aux PUD9" DEFAULT_VALUE "UNKNOWN" /end COMPU_VTAB
/begin CHARACTERISTIC CoolingH2OLow_pct "FaultConfig # CoolingH2OLow_pct (Fault Condition:cooling water flow low by more than)" VALUE 0x001c6e68 /* @ECU_Address@CoolingH2OLow_pct@0x0100C750@ */ ECIPP_ALIGNMENT_UWORD 65535 Compu_CoolingH2OLow_pct 0 65535 /end CHARACTERISTIC
/begin COMPU_METHOD Compu_CoolingH2OLow_pct " " RAT_FUNC "%.0" "%" COEFFS 0 1 0 0 0 1 /end COMPU_METHOD
/begin CHARACTERISTIC EBP_Paux_cal "{EBP_Paux_cal&0xff=0:Aux Press A}{EBP_Paux_cal&0xff=1:Aux Press B}{EBP_Paux_cal&0xff=2:Aux Press C}{EBP_Paux_cal&0xff=3:Aux Press D}" VALUE 0x001c86c0 /* @ECU_Address@EBP_Paux_cal@0x0100C7F8@ */ ECIPP_ALIGNMENT_UBYTE 255 EBP_Paux_cal_COMPU_VTAB 0 255 BIT_MASK 0xff /end CHARACTERISTIC
/begin COMPU_METHOD EBP_Paux_cal_COMPU_VTAB "Verbal Table" TAB_VERB "%.0" "list" COMPU_TAB_REF EBP_Paux_cal_COMPU_VTAB_REF /end COMPU_METHOD
/begin COMPU_VTAB EBP_Paux_cal_COMPU_VTAB_REF "Verbal Table" TAB_VERB 4 0 "Aux Press A" 1 "Aux Press B" 2 "Aux Press C" 3 "Aux Press D" DEFAULT_VALUE "UNKNOWN" /end COMPU_VTAB
/begin CHARACTERISTIC fuel_throt_mode "{fuel_throt_mode&0xff=0:Legacy}{fuel_throt_mode&0xff=1:Corrected}" VALUE 0x001c9037 /* @ECU_Address@fuel_throt_mode@0x0100CBE8@ */ ECIPP_ALIGNMENT_UBYTE 255 fuel_throt_mode_COMPU_VTAB 0 255 BIT_MASK 0xff /end CHARACTERISTIC
/begin COMPU_METHOD fuel_throt_mode_COMPU_VTAB "Verbal Table" TAB_VERB "%.0" "list" COMPU_TAB_REF fuel_throt_mode_COMPU_VTAB_REF /end COMPU_METHOD
/begin COMPU_VTAB fuel_throt_mode_COMPU_VTAB_REF "Verbal Table" TAB_VERB 2 0 "Legacy" 1 "Corrected" DEFAULT_VALUE "UNKNOWN" /end COMPU_VTAB
/begin CHARACTERISTIC UGF1_drift_min_lvl2 "FaultConfig # UGF1_drift_min_lvl2 (Fault Condition:UEGO1 drift compensation accumulator <)" VALUE 0x001c6bf2 /* @ECU_Address@UGF1_drift_min_lvl2@0x0100CD20@ */ ECIPP_ALIGNMENT_SWORD 100 Compu_UGF1_drift_min_lvl2 -100 99.9969482421875 /end CHARACTERISTIC
/begin COMPU_METHOD Compu_UGF1_drift_min_lvl2 " " RAT_FUNC "%.3" "% Ip" COEFFS 0 327.68 0 0 0 1 /end COMPU_METHOD
/begin CHARACTERISTIC UGF1_drift_max_lvl2 "FaultConfig # UGF1_drift_max_lvl2 (Fault Condition:or >)" VALUE 0x001c6bee /* @ECU_Address@UGF1_drift_max_lvl2@0x0100CD28@ */ ECIPP_ALIGNMENT_SWORD 100 Compu_UGF1_drift_max_lvl2 -100 99.9969482421875 /end CHARACTERISTIC
/begin COMPU_METHOD Compu_UGF1_drift_max_lvl2 " " RAT_FUNC "%.3" "% Ip" COEFFS 0 327.68 0 0 0 1 /end COMPU_METHOD
/begin CHARACTERISTIC UGF2_drift_min_lvl2 "FaultConfig # UGF2_drift_min_lvl2 (Fault Condition:UEGO2 drift compensation accumulator <)" VALUE 0x001c6bfa /* @ECU_Address@UGF2_drift_min_lvl2@0x0100CD30@ */ ECIPP_ALIGNMENT_SWORD 100 Compu_UGF2_drift_min_lvl2 -100 99.9969482421875 /end CHARACTERISTIC
/begin COMPU_METHOD Compu_UGF2_drift_min_lvl2 " " RAT_FUNC "%.3" "% Ip" COEFFS 0 327.68 0 0 0 1 /end COMPU_METHOD
/begin CHARACTERISTIC UGF2_drift_max_lvl2 "FaultConfig # UGF2_drift_max_lvl2 (Fault Condition:or >)" VALUE 0x001c6bf6 /* @ECU_Address@UGF2_drift_max_lvl2@0x0100CD38@ */ ECIPP_ALIGNMENT_SWORD 100 Compu_UGF2_drift_max_lvl2 -100 99.9969482421875 /end CHARACTERISTIC
/begin COMPU_METHOD Compu_UGF2_drift_max_lvl2 " " RAT_FUNC "%.3" "% Ip" COEFFS 0 327.68 0 0 0 1 /end COMPU_METHOD
/begin CHARACTERISTIC TAUX1_max "FaultConfig # TAUX1_max (Fault Condition:AUX Temperature 1 >)" VALUE 0x001ECD5E /* @ECU_Address@TAUX1_max@0x0100CD70@ */ ECIPP_ALIGNMENT_UWORD 7732 Compu_TAUX1_max -460 7731.875 /end CHARACTERISTIC
/begin COMPU_METHOD Compu_TAUX1_max " " RAT_FUNC "%.3" "deg F" COEFFS 0 8 3680 0 0 1 /end COMPU_METHOD
/begin CHARACTERISTIC TAUX1_min "FaultConfig # TAUX1_min (Fault Condition:AUX Temperature 1 <)" VALUE 0x001ECD5C /* @ECU_Address@TAUX1_min@0x0100CD78@ */ ECIPP_ALIGNMENT_UWORD 7732 Compu_TAUX1_min -460 7731.875 /end CHARACTERISTIC
/begin COMPU_METHOD Compu_TAUX1_min " " RAT_FUNC "%.3" "deg F" COEFFS 0 8 3680 0 0 1 /end COMPU_METHOD
/begin CHARACTERISTIC TAUX2_max "FaultConfig # TAUX2_max (Fault Condition:AUX Temperature 2 >)" VALUE 0x001ECD62 /* @ECU_Address@TAUX2_max@0x0100CD80@ */ ECIPP_ALIGNMENT_UWORD 7732 Compu_TAUX2_max -460 7731.875 /end CHARACTERISTIC
/begin COMPU_METHOD Compu_TAUX2_max " " RAT_FUNC "%.3" "deg F" COEFFS 0 8 3680 0 0 1 /end COMPU_METHOD
/begin CHARACTERISTIC TAUX2_min "FaultConfig # TAUX2_min (Fault Condition:AUX Temperature 2 <)" VALUE 0x001ECD60 /* @ECU_Address@TAUX2_min@0x0100CD88@ */ ECIPP_ALIGNMENT_UWORD 7732 Compu_TAUX2_min -460 7731.875 /end CHARACTERISTIC
/begin COMPU_METHOD Compu_TAUX2_min " " RAT_FUNC "%.3" "deg F" COEFFS 0 8 3680 0 0 1 /end COMPU_METHOD
/begin CHARACTERISTIC TAUX3_max "FaultConfig # TAUX3_max (Fault Condition:AUX Temperature 3 >)" VALUE 0x001ECD66 /* @ECU_Address@TAUX3_max@0x0100CD90@ */ ECIPP_ALIGNMENT_UWORD 7732 Compu_TAUX3_max -460 7731.875 /end CHARACTERISTIC
/begin COMPU_METHOD Compu_TAUX3_max " " RAT_FUNC "%.3" "deg F" COEFFS 0 8 3680 0 0 1 /end COMPU_METHOD
/begin CHARACTERISTIC TAUX3_min "FaultConfig # TAUX3_min (Fault Condition:AUX Temperature 3 <)" VALUE 0x001ECD64 /* @ECU_Address@TAUX3_min@0x0100CD98@ */ ECIPP_ALIGNMENT_UWORD 7732 Compu_TAUX3_min -460 7731.875 /end CHARACTERISTIC
/begin COMPU_METHOD Compu_TAUX3_min " " RAT_FUNC "%.3" "deg F" COEFFS 0 8 3680 0 0 1 /end COMPU_METHOD
/begin CHARACTERISTIC TAUX4_max "FaultConfig # TAUX4_max (Fault Condition:AUX Temperature 4 >)" VALUE 0x001ECD6A /* @ECU_Address@TAUX4_max@0x0100CDA0@ */ ECIPP_ALIGNMENT_UWORD 7732 Compu_TAUX4_max -460 7731.875 /end CHARACTERISTIC
/begin COMPU_METHOD Compu_TAUX4_max " " RAT_FUNC "%.3" "deg F" COEFFS 0 8 3680 0 0 1 /end COMPU_METHOD
/begin CHARACTERISTIC TAUX4_min "FaultConfig # TAUX4_min (Fault Condition:AUX Temperature 4 <)" VALUE 0x001ECD68 /* @ECU_Address@TAUX4_min@0x0100CDA8@ */ ECIPP_ALIGNMENT_UWORD 7732 Compu_TAUX4_min -460 7731.875 /end CHARACTERISTIC
/begin COMPU_METHOD Compu_TAUX4_min " " RAT_FUNC "%.3" "deg F" COEFFS 0 8 3680 0 0 1 /end COMPU_METHOD
/begin CHARACTERISTIC TAUX_dT1_max "FaultConfig # TAUX_dT1_max (Fault Condition:AUX Temperature X-Y >)" VALUE 0x001ECD54 /* @ECU_Address@TAUX_dT1_max@0x0100CDC8@ */ ECIPP_ALIGNMENT_SWORD 4096 Compu_TAUX_dT1_max -4096 4095.875 /end CHARACTERISTIC
/begin COMPU_METHOD Compu_TAUX_dT1_max " " RAT_FUNC "%.3" "deg F" COEFFS 0 8 0 0 0 1 /end COMPU_METHOD
/begin CHARACTERISTIC TAUX_dT1_min "FaultConfig # TAUX_dT1_min (Fault Condition:AUX Temperature X-Y <)" VALUE 0x001ECD52 /* @ECU_Address@TAUX_dT1_min@0x0100CDD0@ */ ECIPP_ALIGNMENT_SWORD 4096 Compu_TAUX_dT1_min -4096 4095.875 /end CHARACTERISTIC
/begin COMPU_METHOD Compu_TAUX_dT1_min " " RAT_FUNC "%.3" "deg F" COEFFS 0 8 0 0 0 1 /end COMPU_METHOD
/begin CHARACTERISTIC TAUX_dT2_max "FaultConfig # TAUX_dT2_max (Fault Condition:AUX Temperature X-Y >)" VALUE 0x001ECD5A /* @ECU_Address@TAUX_dT2_max@0x0100CDF0@ */ ECIPP_ALIGNMENT_SWORD 4096 Compu_TAUX_dT2_max -4096 4095.875 /end CHARACTERISTIC
/begin COMPU_METHOD Compu_TAUX_dT2_max " " RAT_FUNC "%.3" "deg F" COEFFS 0 8 0 0 0 1 /end COMPU_METHOD
/begin CHARACTERISTIC TAUX_dT2_min "FaultConfig # TAUX_dT2_min (Fault Condition:AUX Temperature X-Y <)" VALUE 0x001ECD58 /* @ECU_Address@TAUX_dT2_min@0x0100CDF8@ */ ECIPP_ALIGNMENT_SWORD 4096 Compu_TAUX_dT2_min -4096 4095.875 /end CHARACTERISTIC
/begin COMPU_METHOD Compu_TAUX_dT2_min " " RAT_FUNC "%.3" "deg F" COEFFS 0 8 0 0 0 1 /end COMPU_METHOD
/begin CHARACTERISTIC PAUX1_max "FaultConfig # PAUX1_max (Fault Condition:AUX Pressure 1 >)" VALUE 0x001ECD42 /* @ECU_Address@PAUX1_max@0x0100CE00@ */ ECIPP_ALIGNMENT_UWORD 256 Compu_PAUX1_max 0 255.99609375 /end CHARACTERISTIC
/begin COMPU_METHOD Compu_PAUX1_max " " RAT_FUNC "%.3" "psia" COEFFS 0 256 0 0 0 1 /end COMPU_METHOD
/begin CHARACTERISTIC PAUX1_min "FaultConfig # PAUX1_min (Fault Condition:AUX Pressure 1 <)" VALUE 0x001ECD40 /* @ECU_Address@PAUX1_min@0x0100CE08@ */ ECIPP_ALIGNMENT_UWORD 256 Compu_PAUX1_min 0 255.99609375 /end CHARACTERISTIC
/begin COMPU_METHOD Compu_PAUX1_min " " RAT_FUNC "%.3" "psia" COEFFS 0 256 0 0 0 1 /end COMPU_METHOD
/begin CHARACTERISTIC PAUX2_max "FaultConfig # PAUX2_max (Fault Condition:AUX Pressure 2 >)" VALUE 0x001ECD46 /* @ECU_Address@PAUX2_max@0x0100CE10@ */ ECIPP_ALIGNMENT_UWORD 256 Compu_PAUX2_max 0 255.99609375 /end CHARACTERISTIC
/begin COMPU_METHOD Compu_PAUX2_max " " RAT_FUNC "%.3" "psia" COEFFS 0 256 0 0 0 1 /end COMPU_METHOD
/begin CHARACTERISTIC PAUX2_min "FaultConfig # PAUX2_min (Fault Condition:AUX Pressure 2 <)" VALUE 0x001ECD44 /* @ECU_Address@PAUX2_min@0x0100CE18@ */ ECIPP_ALIGNMENT_UWORD 256 Compu_PAUX2_min 0 255.99609375 /end CHARACTERISTIC
/begin COMPU_METHOD Compu_PAUX2_min " " RAT_FUNC "%.3" "psia" COEFFS 0 256 0 0 0 1 /end COMPU_METHOD
/begin CHARACTERISTIC PAUX3_max "FaultConfig # PAUX3_max (Fault Condition:AUX Pressure 3 >)" VALUE 0x001ECD4A /* @ECU_Address@PAUX3_max@0x0100CE20@ */ ECIPP_ALIGNMENT_UWORD 256 Compu_PAUX3_max 0 255.99609375 /end CHARACTERISTIC
/begin COMPU_METHOD Compu_PAUX3_max " " RAT_FUNC "%.3" "psia" COEFFS 0 256 0 0 0 1 /end COMPU_METHOD
/begin CHARACTERISTIC PAUX3_min "FaultConfig # PAUX3_min (Fault Condition:AUX Pressure 3 <)" VALUE 0x001ECD48 /* @ECU_Address@PAUX3_min@0x0100CE28@ */ ECIPP_ALIGNMENT_UWORD 256 Compu_PAUX3_min 0 255.99609375 /end CHARACTERISTIC
/begin COMPU_METHOD Compu_PAUX3_min " " RAT_FUNC "%.3" "psia" COEFFS 0 256 0 0 0 1 /end COMPU_METHOD
/begin CHARACTERISTIC PAUX4_max "FaultConfig # PAUX4_max (Fault Condition:AUX Pressure 4 >)" VALUE 0x001ECD4E /* @ECU_Address@PAUX4_max@0x0100CE30@ */ ECIPP_ALIGNMENT_UWORD 256 Compu_PAUX4_max 0 255.99609375 /end CHARACTERISTIC
/begin COMPU_METHOD Compu_PAUX4_max " " RAT_FUNC "%.3" "psia" COEFFS 0 256 0 0 0 1 /end COMPU_METHOD
/begin CHARACTERISTIC PAUX4_min "FaultConfig # PAUX4_min (Fault Condition:AUX Pressure 4 <)" VALUE 0x001ECD4C /* @ECU_Address@PAUX4_min@0x0100CE38@ */ ECIPP_ALIGNMENT_UWORD 256 Compu_PAUX4_min 0 255.99609375 /end CHARACTERISTIC
/begin COMPU_METHOD Compu_PAUX4_min " " RAT_FUNC "%.3" "psia" COEFFS 0 256 0 0 0 1 /end COMPU_METHOD
/begin CHARACTERISTIC PAUX_dP1_max "FaultConfig # PAUX_dP1_max (Fault Condition:AUX Pressure X-Y >)" VALUE 0x001ECD38 /* @ECU_Address@PAUX_dP1_max@0x0100CE58@ */ ECIPP_ALIGNMENT_SWORD 128 Compu_PAUX_dP1_max -128 127.99609375 /end CHARACTERISTIC
/begin COMPU_METHOD Compu_PAUX_dP1_max " " RAT_FUNC "%.3" "psi" COEFFS 0 256 0 0 0 1 /end COMPU_METHOD
/begin CHARACTERISTIC PAUX_dP1_min "FaultConfig # PAUX_dP1_min (Fault Condition:AUX Pressure X-Y <)" VALUE 0x001ECD36 /* @ECU_Address@PAUX_dP1_min@0x0100CE60@ */ ECIPP_ALIGNMENT_SWORD 128 Compu_PAUX_dP1_min -128 127.99609375 /end CHARACTERISTIC
/begin COMPU_METHOD Compu_PAUX_dP1_min " " RAT_FUNC "%.3" "psi" COEFFS 0 256 0 0 0 1 /end COMPU_METHOD
/begin CHARACTERISTIC PAUX_dP2_max "FaultConfig # PAUX_dP2_max (Fault Condition:AUX Pressure X-Y >)" VALUE 0x001ECD3E /* @ECU_Address@PAUX_dP2_max@0x0100CE80@ */ ECIPP_ALIGNMENT_SWORD 128 Compu_PAUX_dP2_max -128 127.99609375 /end CHARACTERISTIC
/begin COMPU_METHOD Compu_PAUX_dP2_max " " RAT_FUNC "%.3" "psi" COEFFS 0 256 0 0 0 1 /end COMPU_METHOD
/begin CHARACTERISTIC PAUX_dP2_min "FaultConfig # PAUX_dP2_min (Fault Condition:AUX Pressure X-Y <)" VALUE 0x001ECD3C /* @ECU_Address@PAUX_dP2_min@0x0100CE88@ */ ECIPP_ALIGNMENT_SWORD 128 Compu_PAUX_dP2_min -128 127.99609375 /end CHARACTERISTIC
/begin COMPU_METHOD Compu_PAUX_dP2_min " " RAT_FUNC "%.3" "psi" COEFFS 0 256 0 0 0 1 /end COMPU_METHOD
/begin CHARACTERISTIC ADIG20_max "FaultConfig # ADIG20_max (Fault Condition:AUX DIG20 >)" VALUE 0x001e3710 /* @ECU_Address@ADIG20_max@0x0100D248@ */ ECIPP_ALIGNMENT_UWORD 256 Compu_ADIG20_max 0 255.99609375 /end CHARACTERISTIC
/begin COMPU_METHOD Compu_ADIG20_max " " RAT_FUNC "%.3" "volts" COEFFS 0 256 0 0 0 1 /end COMPU_METHOD
/begin CHARACTERISTIC ADIG20_min "FaultConfig # ADIG20_min (Fault Condition:AUX DIG20 <)" VALUE 0x001e3712 /* @ECU_Address@ADIG20_min@0x0100D250@ */ ECIPP_ALIGNMENT_UWORD 256 Compu_ADIG20_min 0 255.99609375 /end CHARACTERISTIC
/begin COMPU_METHOD Compu_ADIG20_min " " RAT_FUNC "%.3" "volts" COEFFS 0 256 0 0 0 1 /end COMPU_METHOD
/begin CHARACTERISTIC ADIG21_max "FaultConfig # ADIG21_max (Fault Condition:AUX DIG21 >)" VALUE 0x001e3714 /* @ECU_Address@ADIG21_max@0x0100D258@ */ ECIPP_ALIGNMENT_UWORD 256 Compu_ADIG21_max 0 255.99609375 /end CHARACTERISTIC
/begin COMPU_METHOD Compu_ADIG21_max " " RAT_FUNC "%.3" "volts" COEFFS 0 256 0 0 0 1 /end COMPU_METHOD
/begin CHARACTERISTIC ADIG21_min "FaultConfig # ADIG21_min (Fault Condition:AUX DIG21 <)" VALUE 0x001e3716 /* @ECU_Address@ADIG21_min@0x0100D260@ */ ECIPP_ALIGNMENT_UWORD 256 Compu_ADIG21_min 0 255.99609375 /end CHARACTERISTIC
/begin COMPU_METHOD Compu_ADIG21_min " " RAT_FUNC "%.3" "volts" COEFFS 0 256 0 0 0 1 /end COMPU_METHOD
/begin CHARACTERISTIC ADIG22_max "FaultConfig # ADIG22_max (Fault Condition:AUX DIG22 >)" VALUE 0x001e3718 /* @ECU_Address@ADIG22_max@0x0100D268@ */ ECIPP_ALIGNMENT_UWORD 256 Compu_ADIG22_max 0 255.99609375 /end CHARACTERISTIC
/begin COMPU_METHOD Compu_ADIG22_max " " RAT_FUNC "%.3" "volts" COEFFS 0 256 0 0 0 1 /end COMPU_METHOD
/begin CHARACTERISTIC ADIG22_min "FaultConfig # ADIG22_min (Fault Condition:AUX DIG22 <)" VALUE 0x001e371a /* @ECU_Address@ADIG22_min@0x0100D270@ */ ECIPP_ALIGNMENT_UWORD 256 Compu_ADIG22_min 0 255.99609375 /end CHARACTERISTIC
/begin COMPU_METHOD Compu_ADIG22_min " " RAT_FUNC "%.3" "volts" COEFFS 0 256 0 0 0 1 /end COMPU_METHOD
/begin CHARACTERISTIC ADIG23_max "FaultConfig # ADIG23_max (Fault Condition:AUX DIG23 >)" VALUE 0x001e371c /* @ECU_Address@ADIG23_max@0x0100D278@ */ ECIPP_ALIGNMENT_UWORD 256 Compu_ADIG23_max 0 255.99609375 /end CHARACTERISTIC
/begin COMPU_METHOD Compu_ADIG23_max " " RAT_FUNC "%.3" "volts" COEFFS 0 256 0 0 0 1 /end COMPU_METHOD
/begin CHARACTERISTIC ADIG23_min "FaultConfig # ADIG23_min (Fault Condition:AUX DIG23 <)" VALUE 0x001e371e /* @ECU_Address@ADIG23_min@0x0100D280@ */ ECIPP_ALIGNMENT_UWORD 256 Compu_ADIG23_min 0 255.99609375 /end CHARACTERISTIC
/begin COMPU_METHOD Compu_ADIG23_min " " RAT_FUNC "%.3" "volts" COEFFS 0 256 0 0 0 1 /end COMPU_METHOD
/begin CHARACTERISTIC ADIG24_max "FaultConfig # ADIG24_max (Fault Condition:AUX DIG24 >)" VALUE 0x001e3720 /* @ECU_Address@ADIG24_max@0x0100D288@ */ ECIPP_ALIGNMENT_UWORD 256 Compu_ADIG24_max 0 255.99609375 /end CHARACTERISTIC
/begin COMPU_METHOD Compu_ADIG24_max " " RAT_FUNC "%.3" "volts" COEFFS 0 256 0 0 0 1 /end COMPU_METHOD
/begin CHARACTERISTIC ADIG24_min "FaultConfig # ADIG24_min (Fault Condition:AUX DIG24 <)" VALUE 0x001e3722 /* @ECU_Address@ADIG24_min@0x0100D290@ */ ECIPP_ALIGNMENT_UWORD 256 Compu_ADIG24_min 0 255.99609375 /end CHARACTERISTIC
/begin COMPU_METHOD Compu_ADIG24_min " " RAT_FUNC "%.3" "volts" COEFFS 0 256 0 0 0 1 /end COMPU_METHOD
/begin CHARACTERISTIC ADIG25_max "FaultConfig # ADIG25_max (Fault Condition:AUX DIG25 >)" VALUE 0x001e3724 /* @ECU_Address@ADIG25_max@0x0100D298@ */ ECIPP_ALIGNMENT_UWORD 256 Compu_ADIG25_max 0 255.99609375 /end CHARACTERISTIC
/begin COMPU_METHOD Compu_ADIG25_max " " RAT_FUNC "%.3" "volts" COEFFS 0 256 0 0 0 1 /end COMPU_METHOD
/begin CHARACTERISTIC ADIG25_min "FaultConfig # ADIG25_min (Fault Condition:AUX DIG25 <)" VALUE 0x001e3726 /* @ECU_Address@ADIG25_min@0x0100D2A0@ */ ECIPP_ALIGNMENT_UWORD 256 Compu_ADIG25_min 0 255.99609375 /end CHARACTERISTIC
/begin COMPU_METHOD Compu_ADIG25_min " " RAT_FUNC "%.3" "volts" COEFFS 0 256 0 0 0 1 /end COMPU_METHOD
/begin CHARACTERISTIC EGR_LoExp_mdot "Air # EGR_LoExp_mdot (Fault Condition:EGR flow command >)" VALUE 0x001c0972 /* @ECU_Address@EGR_LoExp_mdot@0x0100D390@ */ ECIPP_ALIGNMENT_UWORD 1024 Compu_EGR_LoExp_mdot 0 1023.984375 /end CHARACTERISTIC
/begin COMPU_METHOD Compu_EGR_LoExp_mdot " " RAT_FUNC "%.3" "g/sec" COEFFS 0 64 0 0 0 1 /end COMPU_METHOD
/begin CHARACTERISTIC EGR_HiExp_mdot "Air # EGR_HiExp_mdot (Fault Condition:EGR flow command >)" VALUE 0x001c0966 /* @ECU_Address@EGR_HiExp_mdot@0x0100D398@ */ ECIPP_ALIGNMENT_UWORD 1024 Compu_EGR_HiExp_mdot 0 1023.984375 /end CHARACTERISTIC
/begin COMPU_METHOD Compu_EGR_HiExp_mdot " " RAT_FUNC "%.3" "g/sec" COEFFS 0 64 0 0 0 1 /end COMPU_METHOD
/begin CHARACTERISTIC EGR_LoExp_pctmin "Air # EGR_LoExp_pctmin (Fault Condition:and command >)" VALUE 0x001c0976 /* @ECU_Address@EGR_LoExp_pctmin@0x0100D3A0@ */ ECIPP_ALIGNMENT_UWORD 400 Compu_EGR_LoExp_pctmin 0 399.993896484375 /end CHARACTERISTIC
/begin COMPU_METHOD Compu_EGR_LoExp_pctmin " " RAT_FUNC "%.3" "% dil" COEFFS 0 163.84 0 0 0 1 /end COMPU_METHOD
/begin CHARACTERISTIC EGR_LoExp_pcterr "Air # EGR_LoExp_pcterr (Fault Condition:and command - actual >)" VALUE 0x001c0974 /* @ECU_Address@EGR_LoExp_pcterr@0x0100D3A8@ */ ECIPP_ALIGNMENT_UWORD 400 Compu_EGR_LoExp_pcterr 0 399.993896484375 /end CHARACTERISTIC
/begin COMPU_METHOD Compu_EGR_LoExp_pcterr " " RAT_FUNC "%.3" "% dil" COEFFS 0 163.84 0 0 0 1 /end COMPU_METHOD
/begin CHARACTERISTIC EGR_HiExp_pctmin "Air # EGR_HiExp_pctmin (Fault Condition:and command >)" VALUE 0x001c096a /* @ECU_Address@EGR_HiExp_pctmin@0x0100D3B0@ */ ECIPP_ALIGNMENT_UWORD 400 Compu_EGR_HiExp_pctmin 0 399.993896484375 /end CHARACTERISTIC
/begin COMPU_METHOD Compu_EGR_HiExp_pctmin " " RAT_FUNC "%.3" "% dil" COEFFS 0 163.84 0 0 0 1 /end COMPU_METHOD
/begin CHARACTERISTIC EGR_HiExp_pcterr "Air # EGR_HiExp_pcterr (Fault Condition:and actual - command >)" VALUE 0x001c0968 /* @ECU_Address@EGR_HiExp_pcterr@0x0100D3B8@ */ ECIPP_ALIGNMENT_UWORD 400 Compu_EGR_HiExp_pcterr 0 399.993896484375 /end CHARACTERISTIC
/begin COMPU_METHOD Compu_EGR_HiExp_pcterr " " RAT_FUNC "%.3" "% dil" COEFFS 0 163.84 0 0 0 1 /end COMPU_METHOD
/begin CHARACTERISTIC UEGO_extreme_rich "{UEGO_extreme_rich&0xff=0:Normal}{UEGO_extreme_rich&0xff=1:Extreme Rich}" VALUE 0x001c8f79 /* @ECU_Address@UEGO_extreme_rich@0x0100D3D0@ */ ECIPP_ALIGNMENT_UBYTE 255 UEGO_extreme_rich_COMPU_VTAB 0 255 BIT_MASK 0xff /end CHARACTERISTIC
/begin COMPU_METHOD UEGO_extreme_rich_COMPU_VTAB "Verbal Table" TAB_VERB "%.0" "list" COMPU_TAB_REF UEGO_extreme_rich_COMPU_VTAB_REF /end COMPU_METHOD
/begin COMPU_VTAB UEGO_extreme_rich_COMPU_VTAB_REF "Verbal Table" TAB_VERB 2 0 "Normal" 1 "Extreme Rich" DEFAULT_VALUE "UNKNOWN" /end COMPU_VTAB
/begin CHARACTERISTIC inj_peak_I "Peak current target" VALUE 0x001c847e /* @ECU_Address@inj_peak_I@0x0100D430@ */ ECIPP_ALIGNMENT_UWORD 64 Compu_inj_peak_I 0 63.9990234375 /end CHARACTERISTIC
/begin COMPU_METHOD Compu_inj_peak_I " " RAT_FUNC "%.2" "amps" COEFFS 0 1024 0 0 0 1 /end COMPU_METHOD
/begin CHARACTERISTIC inj_high_peak_I "Cold start peak current target" VALUE 0x001c8470 /* @ECU_Address@inj_high_peak_I@0x0100D438@ */ ECIPP_ALIGNMENT_UWORD 64 Compu_inj_high_peak_I 0 63.9990234375 /end CHARACTERISTIC
/begin COMPU_METHOD Compu_inj_high_peak_I " " RAT_FUNC "%.2" "amps" COEFFS 0 1024 0 0 0 1 /end COMPU_METHOD
/begin CHARACTERISTIC inj_hold_I "Hold current target" VALUE 0x001c8474 /* @ECU_Address@inj_hold_I@0x0100D440@ */ ECIPP_ALIGNMENT_UWORD 64 Compu_inj_hold_I 0 63.9990234375 /end CHARACTERISTIC
/begin COMPU_METHOD Compu_inj_hold_I " " RAT_FUNC "%.2" "amps" COEFFS 0 1024 0 0 0 1 /end COMPU_METHOD
/begin CHARACTERISTIC inj_pk_hld_I "Peak to Hold current trig" VALUE 0x001c8482 /* @ECU_Address@inj_pk_hld_I@0x0100D448@ */ ECIPP_ALIGNMENT_UWORD 64 Compu_inj_pk_hld_I 0 63.9990234375 /end CHARACTERISTIC
/begin COMPU_METHOD Compu_inj_pk_hld_I " " RAT_FUNC "%.2" "amps" COEFFS 0 1024 0 0 0 1 /end COMPU_METHOD
/begin CHARACTERISTIC inj_rapid_pk_I "Rapid peak decay current trig" VALUE 0x001c8484 /* @ECU_Address@inj_rapid_pk_I@0x0100D450@ */ ECIPP_ALIGNMENT_UWORD 64 Compu_inj_rapid_pk_I 0 63.9990234375 /end CHARACTERISTIC
/begin COMPU_METHOD Compu_inj_rapid_pk_I " " RAT_FUNC "%.2" "amps" COEFFS 0 1024 0 0 0 1 /end COMPU_METHOD
/begin CHARACTERISTIC inj_peak_offT "Peak off-time" VALUE 0x001c8480 /* @ECU_Address@inj_peak_offT@0x0100D458@ */ ECIPP_ALIGNMENT_UWORD 4096 Compu_inj_peak_offT 0 4095.9375 /end CHARACTERISTIC
/begin COMPU_METHOD Compu_inj_peak_offT " " RAT_FUNC "%.1" "us" COEFFS 0 16 0 0 0 1 /end COMPU_METHOD
/begin CHARACTERISTIC inj_high_peak_offT "Cold start peak off-time" VALUE 0x001c8472 /* @ECU_Address@inj_high_peak_offT@0x0100D460@ */ ECIPP_ALIGNMENT_UWORD 4096 Compu_inj_high_peak_offT 0 4095.9375 /end CHARACTERISTIC
/begin COMPU_METHOD Compu_inj_high_peak_offT " " RAT_FUNC "%.1" "us" COEFFS 0 16 0 0 0 1 /end COMPU_METHOD
/begin CHARACTERISTIC inj_hold_offT "Hold off-time" VALUE 0x001c8476 /* @ECU_Address@inj_hold_offT@0x0100D468@ */ ECIPP_ALIGNMENT_UWORD 4096 Compu_inj_hold_offT 0 4095.9375 /end CHARACTERISTIC
/begin COMPU_METHOD Compu_inj_hold_offT " " RAT_FUNC "%.1" "us" COEFFS 0 16 0 0 0 1 /end COMPU_METHOD
/begin CHARACTERISTIC PWPCF_mode "{PWPCF_mode&0xff=0:Fixed scalar}{PWPCF_mode&0xff=1:Voltage-based}" VALUE 0x001C9F7C /* @ECU_Address@PWPCF_mode@0x0100D470@ */ ECIPP_ALIGNMENT_UBYTE 255 PWPCF_mode_COMPU_VTAB 0 255 BIT_MASK 0xff /end CHARACTERISTIC
/begin COMPU_METHOD PWPCF_mode_COMPU_VTAB "Verbal Table" TAB_VERB "%.0" "list" COMPU_TAB_REF PWPCF_mode_COMPU_VTAB_REF /end COMPU_METHOD
/begin COMPU_VTAB PWPCF_mode_COMPU_VTAB_REF "Verbal Table" TAB_VERB 2 0 "Fixed scalar" 1 "Voltage-based" DEFAULT_VALUE "UNKNOWN" /end COMPU_VTAB
/begin CHARACTERISTIC PWPCF_mode_I2 "{PWPCF_mode_I2&0xff=0:Fixed scalar}{PWPCF_mode_I2&0xff=1:Voltage-based}" VALUE 0x001C9FB8 /* @ECU_Address@PWPCF_mode_I2@0x0100D478@ */ ECIPP_ALIGNMENT_UBYTE 255 PWPCF_mode_I2_COMPU_VTAB 0 255 BIT_MASK 0xff /end CHARACTERISTIC
/begin COMPU_METHOD PWPCF_mode_I2_COMPU_VTAB "Verbal Table" TAB_VERB "%.0" "list" COMPU_TAB_REF PWPCF_mode_I2_COMPU_VTAB_REF /end COMPU_METHOD
/begin COMPU_VTAB PWPCF_mode_I2_COMPU_VTAB_REF "Verbal Table" TAB_VERB 2 0 "Fixed scalar" 1 "Voltage-based" DEFAULT_VALUE "UNKNOWN" /end COMPU_VTAB
/begin CHARACTERISTIC inj_min_riseT "Min rise time to peak current" VALUE 0x001c847c /* @ECU_Address@inj_min_riseT@0x0100D620@ */ ECIPP_ALIGNMENT_UWORD 65535 Compu_inj_min_riseT 0 65535 /end CHARACTERISTIC
/begin COMPU_METHOD Compu_inj_min_riseT " " RAT_FUNC "%.0" "us" COEFFS 0 1 0 0 0 1 /end COMPU_METHOD
/begin CHARACTERISTIC inj_max_riseT "Max rise time to peak current" VALUE 0x001c847a /* @ECU_Address@inj_max_riseT@0x0100D628@ */ ECIPP_ALIGNMENT_UWORD 65535 Compu_inj_max_riseT 0 65535 /end CHARACTERISTIC
/begin COMPU_METHOD Compu_inj_max_riseT " " RAT_FUNC "%.0" "us" COEFFS 0 1 0 0 0 1 /end COMPU_METHOD
/begin CHARACTERISTIC INJD_ph_maxR_minV "FaultConfig # INJD_ph_maxR_minV (Fault Condition:and battery voltage >)" VALUE 0x001c7c5c /* @ECU_Address@INJD_ph_maxR_minV@0x0100D630@ */ ECIPP_ALIGNMENT_UWORD 256 Compu_INJD_ph_maxR_minV 0 255.99609375 /end CHARACTERISTIC
/begin COMPU_METHOD Compu_INJD_ph_maxR_minV " " RAT_FUNC "%.3" "volts" COEFFS 0 256 0 0 0 1 /end COMPU_METHOD
/begin MEASUREMENT fm_ign_cyc_counter "Ignition cycle counter" UWORD Compu_fm_ign_cyc_counter 0 0 0 65535 ECU_ADDRESS 0x0100DA28 /end MEASUREMENT
/begin COMPU_METHOD Compu_fm_ign_cyc_counter " " RAT_FUNC "%.0" "cycles" COEFFS 0 1 0 0 0 1 /end COMPU_METHOD
/begin MEASUREMENT fm_wuc_wo_MIL "Warm-ups without MIL" UBYTE Compu_fm_wuc_wo_MIL 0 0 0 255 ECU_ADDRESS 0x0100DA38 /end MEASUREMENT
/begin COMPU_METHOD Compu_fm_wuc_wo_MIL " " RAT_FUNC "%.0" "cycles" COEFFS 0 1 0 0 0 1 /end COMPU_METHOD
/begin MEASUREMENT fm_wu_since_clr "Warm-ups since clear" UBYTE Compu_fm_wu_since_clr 0 0 0 255 ECU_ADDRESS 0x0100DA40 /end MEASUREMENT
/begin COMPU_METHOD Compu_fm_wu_since_clr " " RAT_FUNC "%.0" "cycles" COEFFS 0 1 0 0 0 1 /end COMPU_METHOD
/begin MEASUREMENT fm_rt_while_MIL "Engine run time with MIL" ULONG Compu_fm_rt_while_MIL 0 0 0 71582788.25 ECU_ADDRESS 0x0100DA48 /end MEASUREMENT
/begin COMPU_METHOD Compu_fm_rt_while_MIL " " RAT_FUNC "%.0" "minutes" COEFFS 0 60 0 0 0 1 /end COMPU_METHOD
/begin MEASUREMENT fm_rt_since_clr "Engine run time since clear" ULONG Compu_fm_rt_since_clr 0 0 0 71582788.25 ECU_ADDRESS 0x0100DA50 /end MEASUREMENT
/begin COMPU_METHOD Compu_fm_rt_since_clr " " RAT_FUNC "%.0" "minutes" COEFFS 0 60 0 0 0 1 /end COMPU_METHOD
/begin MEASUREMENT fm_dist_while_MIL "Distance with MIL" ULONG Compu_fm_dist_while_MIL 0 0 0 536870911.875 ECU_ADDRESS 0x0100DA58 /end MEASUREMENT
/begin COMPU_METHOD Compu_fm_dist_while_MIL " " RAT_FUNC "%.0" "km" COEFFS 0 8 0 0 0 1 /end COMPU_METHOD
/begin MEASUREMENT fm_dist_since_clr "Distance since clear" ULONG Compu_fm_dist_since_clr 0 0 0 536870911.875 ECU_ADDRESS 0x0100DA60 /end MEASUREMENT
/begin COMPU_METHOD Compu_fm_dist_since_clr " " RAT_FUNC "%.0" "km" COEFFS 0 8 0 0 0 1 /end COMPU_METHOD
/begin CHARACTERISTIC ECTHst_reset_key "General # ECTHst_reset_key" VALUE 0x001c6e8c /* @ECU_Address@ECTHst_reset_key@0x0100DD50@ */ ECIPP_ALIGNMENT_UWORD 65535 Compu_ECTHst_reset_key 0 65535 /end CHARACTERISTIC
/begin COMPU_METHOD Compu_ECTHst_reset_key " " RAT_FUNC "%.0" "-" COEFFS 0 1 0 0 0 1 /end COMPU_METHOD
/begin CHARACTERISTIC J1939_RSsetpt_loss "FaultConfig # J1939_RSsetpt_loss (Fault Condition:Loss of RS setpoint after engine running >=)" VALUE 0x001c7ca4 /* @ECU_Address@J1939_RSsetpt_loss@0x0100DDA0@ */ ECIPP_ALIGNMENT_UWORD 66 Compu_J1939_RSsetpt_loss 0 65.535 /end CHARACTERISTIC
/begin COMPU_METHOD Compu_J1939_RSsetpt_loss " " RAT_FUNC "%.3" "sec" COEFFS 0 1000 0 0 0 1 /end COMPU_METHOD
/begin CHARACTERISTIC EGRwrP_Paux_cal "{EGRwrP_Paux_cal&0xff=0:Aux Press A}{EGRwrP_Paux_cal&0xff=1:Aux Press B}{EGRwrP_Paux_cal&0xff=2:Aux Press C}{EGRwrP_Paux_cal&0xff=3:Aux Press D}" VALUE 0x001c0ab8 /* @ECU_Address@EGRwrP_Paux_cal@0x0100DDD0@ */ ECIPP_ALIGNMENT_UBYTE 255 EGRwrP_Paux_cal_COMPU_VTAB 0 255 BIT_MASK 0xff /end CHARACTERISTIC
/begin COMPU_METHOD EGRwrP_Paux_cal_COMPU_VTAB "Verbal Table" TAB_VERB "%.0" "list" COMPU_TAB_REF EGRwrP_Paux_cal_COMPU_VTAB_REF /end COMPU_METHOD
/begin COMPU_VTAB EGRwrP_Paux_cal_COMPU_VTAB_REF "Verbal Table" TAB_VERB 4 0 "Aux Press A" 1 "Aux Press B" 2 "Aux Press C" 3 "Aux Press D" DEFAULT_VALUE "UNKNOWN" /end COMPU_VTAB
/begin CHARACTERISTIC EGRHP_def "General # EGRHP_def" VALUE 0x001c094c /* @ECU_Address@EGRHP_def@0x0100DF30@ */ ECIPP_ALIGNMENT_UWORD 256 Compu_EGRHP_def 0 255.99609375 /end CHARACTERISTIC
/begin COMPU_METHOD Compu_EGRHP_def " " RAT_FUNC "%.3" "psia" COEFFS 0 256 0 0 0 1 /end COMPU_METHOD
/begin CHARACTERISTIC EGRLP_def "General # EGRLP_def" VALUE 0x001c0954 /* @ECU_Address@EGRLP_def@0x0100DF38@ */ ECIPP_ALIGNMENT_UWORD 256 Compu_EGRLP_def 0 255.99609375 /end CHARACTERISTIC
/begin COMPU_METHOD Compu_EGRLP_def " " RAT_FUNC "%.3" "psia" COEFFS 0 256 0 0 0 1 /end COMPU_METHOD
/begin CHARACTERISTIC EGRT_def "General # EGRT_def" VALUE 0x001c0956 /* @ECU_Address@EGRT_def@0x0100DF40@ */ ECIPP_ALIGNMENT_UWORD 7732 Compu_EGRT_def -460 7731.875 /end CHARACTERISTIC
/begin COMPU_METHOD Compu_EGRT_def " " RAT_FUNC "%.3" "deg F" COEFFS 0 8 3680 0 0 1 /end COMPU_METHOD
/begin MEASUREMENT UEGO3_hours "UEGO hours" ULONG Compu_UEGO3_hours 0 0 0 1193046.47083333 ECU_ADDRESS 0x0100E0F0 /end MEASUREMENT
/begin COMPU_METHOD Compu_UEGO3_hours " " RAT_FUNC "%.3" "hours" COEFFS 0 3600 0 0 0 1 /end COMPU_METHOD
/begin MEASUREMENT UEGO3_drift_hours "UEGO drift time since sample" ULONG Compu_UEGO3_drift_hours 0 0 0 1193046.47083333 ECU_ADDRESS 0x0100E118 /end MEASUREMENT
/begin COMPU_METHOD Compu_UEGO3_drift_hours " " RAT_FUNC "%.3" "hours" COEFFS 0 3600 0 0 0 1 /end COMPU_METHOD
/begin MEASUREMENT UEGO3_drift_success "UEGO3 drift successful samples" ULONG Compu_UEGO3_drift_success 0 0 0 4294967295 ECU_ADDRESS 0x0100E120 /end MEASUREMENT
/begin COMPU_METHOD Compu_UEGO3_drift_success " " RAT_FUNC "%.0" "-" COEFFS 0 1 0 0 0 1 /end COMPU_METHOD
/begin MEASUREMENT UEGO3_drift_aborted "UEGO3 drift aborted samples" ULONG Compu_UEGO3_drift_aborted 0 0 0 4294967295 ECU_ADDRESS 0x0100E128 /end MEASUREMENT
/begin COMPU_METHOD Compu_UEGO3_drift_aborted " " RAT_FUNC "%.0" "-" COEFFS 0 1 0 0 0 1 /end COMPU_METHOD
/begin MEASUREMENT UEGO3_drift_accum "UEGO drift compensation accum" SLONG Compu_UEGO3_drift_accum 0 0 -100 99.9999999534339 ECU_ADDRESS 0x0100E150 /end MEASUREMENT
/begin COMPU_METHOD Compu_UEGO3_drift_accum " " RAT_FUNC "%.2" "% Ip" COEFFS 0 21474836.48 0 0 0 1 /end COMPU_METHOD
/begin MEASUREMENT UEGO4_hours "UEGO hours" ULONG Compu_UEGO4_hours 0 0 0 1193046.47083333 ECU_ADDRESS 0x0100E1C8 /end MEASUREMENT
/begin COMPU_METHOD Compu_UEGO4_hours " " RAT_FUNC "%.3" "hours" COEFFS 0 3600 0 0 0 1 /end COMPU_METHOD
/begin MEASUREMENT UEGO4_drift_hours "UEGO drift time since sample" ULONG Compu_UEGO4_drift_hours 0 0 0 1193046.47083333 ECU_ADDRESS 0x0100E1F0 /end MEASUREMENT
/begin COMPU_METHOD Compu_UEGO4_drift_hours " " RAT_FUNC "%.3" "hours" COEFFS 0 3600 0 0 0 1 /end COMPU_METHOD
/begin MEASUREMENT UEGO4_drift_success "UEGO4 drift successful samples" ULONG Compu_UEGO4_drift_success 0 0 0 4294967295 ECU_ADDRESS 0x0100E1F8 /end MEASUREMENT
/begin COMPU_METHOD Compu_UEGO4_drift_success " " RAT_FUNC "%.0" "-" COEFFS 0 1 0 0 0 1 /end COMPU_METHOD
/begin MEASUREMENT UEGO4_drift_aborted "UEGO4 drift aborted samples" ULONG Compu_UEGO4_drift_aborted 0 0 0 4294967295 ECU_ADDRESS 0x0100E200 /end MEASUREMENT
/begin COMPU_METHOD Compu_UEGO4_drift_aborted " " RAT_FUNC "%.0" "-" COEFFS 0 1 0 0 0 1 /end COMPU_METHOD
/begin MEASUREMENT UEGO4_drift_accum "UEGO drift compensation accum" SLONG Compu_UEGO4_drift_accum 0 0 -100 99.9999999534339 ECU_ADDRESS 0x0100E228 /end MEASUREMENT
/begin COMPU_METHOD Compu_UEGO4_drift_accum " " RAT_FUNC "%.2" "% Ip" COEFFS 0 21474836.48 0 0 0 1 /end COMPU_METHOD
/begin CHARACTERISTIC UGF3_run_wait "FaultConfig # UGF3_run_wait (Fault Condition:or warmup period and an additional)" VALUE 0x001c43e8 /* @ECU_Address@UGF3_run_wait@0x0100E460@ */ ECIPP_ALIGNMENT_ULONG 4294967 Compu_UGF3_run_wait 0 4294967.295 /end CHARACTERISTIC
/begin COMPU_METHOD Compu_UGF3_run_wait " " RAT_FUNC "%.3" "seconds" COEFFS 0 1000 0 0 0 1 /end COMPU_METHOD
/begin CHARACTERISTIC UGF3_drift_min "FaultConfig # UGF3_drift_min (Fault Condition:UEGO3 drift compensation accumulator <)" VALUE 0x001c6c00 /* @ECU_Address@UGF3_drift_min@0x0100E468@ */ ECIPP_ALIGNMENT_SWORD 100 Compu_UGF3_drift_min -100 99.9969482421875 /end CHARACTERISTIC
/begin COMPU_METHOD Compu_UGF3_drift_min " " RAT_FUNC "%.3" "% Ip" COEFFS 0 327.68 0 0 0 1 /end COMPU_METHOD
/begin CHARACTERISTIC UGF3_drift_max "FaultConfig # UGF3_drift_max (Fault Condition:or >)" VALUE 0x001c6bfc /* @ECU_Address@UGF3_drift_max@0x0100E470@ */ ECIPP_ALIGNMENT_SWORD 100 Compu_UGF3_drift_max -100 99.9969482421875 /end CHARACTERISTIC
/begin COMPU_METHOD Compu_UGF3_drift_max " " RAT_FUNC "%.3" "% Ip" COEFFS 0 327.68 0 0 0 1 /end COMPU_METHOD
/begin CHARACTERISTIC UGF3_Hv_lo_limit "FaultConfig # UGF3_Hv_lo_limit (Fault Condition:or <)" VALUE 0x001c8302 /* @ECU_Address@UGF3_Hv_lo_limit@0x0100E478@ */ ECIPP_ALIGNMENT_UWORD 256 Compu_UGF3_Hv_lo_limit 0 255.99609375 /end CHARACTERISTIC
/begin COMPU_METHOD Compu_UGF3_Hv_lo_limit " " RAT_FUNC "%.3" "volts" COEFFS 0 256 0 0 0 1 /end COMPU_METHOD
/begin CHARACTERISTIC UGF3_Hv_hi_limit "FaultConfig # UGF3_Hv_hi_limit (Fault Condition:UEGO3 heater supply voltage >)" VALUE 0x001c8300 /* @ECU_Address@UGF3_Hv_hi_limit@0x0100E480@ */ ECIPP_ALIGNMENT_UWORD 256 Compu_UGF3_Hv_hi_limit 0 255.99609375 /end CHARACTERISTIC
/begin COMPU_METHOD Compu_UGF3_Hv_hi_limit " " RAT_FUNC "%.3" "volts" COEFFS 0 256 0 0 0 1 /end COMPU_METHOD
/begin CHARACTERISTIC UGF3_drift_min_lvl2 "FaultConfig # UGF3_drift_min_lvl2 (Fault Condition:UEGO3 drift compensation accumulator <)" VALUE 0x001c6c02 /* @ECU_Address@UGF3_drift_min_lvl2@0x0100E488@ */ ECIPP_ALIGNMENT_SWORD 100 Compu_UGF3_drift_min_lvl2 -100 99.9969482421875 /end CHARACTERISTIC
/begin COMPU_METHOD Compu_UGF3_drift_min_lvl2 " " RAT_FUNC "%.3" "% Ip" COEFFS 0 327.68 0 0 0 1 /end COMPU_METHOD
/begin CHARACTERISTIC UGF3_drift_max_lvl2 "FaultConfig # UGF3_drift_max_lvl2 (Fault Condition:or >)" VALUE 0x001c6bfe /* @ECU_Address@UGF3_drift_max_lvl2@0x0100E490@ */ ECIPP_ALIGNMENT_SWORD 100 Compu_UGF3_drift_max_lvl2 -100 99.9969482421875 /end CHARACTERISTIC
/begin COMPU_METHOD Compu_UGF3_drift_max_lvl2 " " RAT_FUNC "%.3" "% Ip" COEFFS 0 327.68 0 0 0 1 /end COMPU_METHOD
/begin CHARACTERISTIC UGF4_run_wait "FaultConfig # UGF4_run_wait (Fault Condition:or warmup period and an additional)" VALUE 0x001c43ec /* @ECU_Address@UGF4_run_wait@0x0100E498@ */ ECIPP_ALIGNMENT_ULONG 4294967 Compu_UGF4_run_wait 0 4294967.295 /end CHARACTERISTIC
/begin COMPU_METHOD Compu_UGF4_run_wait " " RAT_FUNC "%.3" "seconds" COEFFS 0 1000 0 0 0 1 /end COMPU_METHOD
/begin CHARACTERISTIC UGF4_drift_min "FaultConfig # UGF4_drift_min (Fault Condition:UEGO4 drift compensation accumulator <)" VALUE 0x001c6c08 /* @ECU_Address@UGF4_drift_min@0x0100E4A0@ */ ECIPP_ALIGNMENT_SWORD 100 Compu_UGF4_drift_min -100 99.9969482421875 /end CHARACTERISTIC
/begin COMPU_METHOD Compu_UGF4_drift_min " " RAT_FUNC "%.3" "% Ip" COEFFS 0 327.68 0 0 0 1 /end COMPU_METHOD
/begin CHARACTERISTIC UGF4_drift_max "FaultConfig # UGF4_drift_max (Fault Condition:or >)" VALUE 0x001c6c04 /* @ECU_Address@UGF4_drift_max@0x0100E4A8@ */ ECIPP_ALIGNMENT_SWORD 100 Compu_UGF4_drift_max -100 99.9969482421875 /end CHARACTERISTIC
/begin COMPU_METHOD Compu_UGF4_drift_max " " RAT_FUNC "%.3" "% Ip" COEFFS 0 327.68 0 0 0 1 /end COMPU_METHOD
/begin CHARACTERISTIC UGF4_Hv_lo_limit "FaultConfig # UGF4_Hv_lo_limit (Fault Condition:or <)" VALUE 0x001c8306 /* @ECU_Address@UGF4_Hv_lo_limit@0x0100E4B0@ */ ECIPP_ALIGNMENT_UWORD 256 Compu_UGF4_Hv_lo_limit 0 255.99609375 /end CHARACTERISTIC
/begin COMPU_METHOD Compu_UGF4_Hv_lo_limit " " RAT_FUNC "%.3" "volts" COEFFS 0 256 0 0 0 1 /end COMPU_METHOD
/begin CHARACTERISTIC UGF4_Hv_hi_limit "FaultConfig # UGF4_Hv_hi_limit (Fault Condition:UEGO4 heater supply voltage >)" VALUE 0x001c8304 /* @ECU_Address@UGF4_Hv_hi_limit@0x0100E4B8@ */ ECIPP_ALIGNMENT_UWORD 256 Compu_UGF4_Hv_hi_limit 0 255.99609375 /end CHARACTERISTIC
/begin COMPU_METHOD Compu_UGF4_Hv_hi_limit " " RAT_FUNC "%.3" "volts" COEFFS 0 256 0 0 0 1 /end COMPU_METHOD
/begin CHARACTERISTIC UGF4_drift_min_lvl2 "FaultConfig # UGF4_drift_min_lvl2 (Fault Condition:UEGO4 drift compensation accumulator <)" VALUE 0x001c6c0a /* @ECU_Address@UGF4_drift_min_lvl2@0x0100E4C0@ */ ECIPP_ALIGNMENT_SWORD 100 Compu_UGF4_drift_min_lvl2 -100 99.9969482421875 /end CHARACTERISTIC
/begin COMPU_METHOD Compu_UGF4_drift_min_lvl2 " " RAT_FUNC "%.3" "% Ip" COEFFS 0 327.68 0 0 0 1 /end COMPU_METHOD
/begin CHARACTERISTIC UGF4_drift_max_lvl2 "FaultConfig # UGF4_drift_max_lvl2 (Fault Condition:or >)" VALUE 0x001c6c06 /* @ECU_Address@UGF4_drift_max_lvl2@0x0100E4C8@ */ ECIPP_ALIGNMENT_SWORD 100 Compu_UGF4_drift_max_lvl2 -100 99.9969482421875 /end CHARACTERISTIC
/begin COMPU_METHOD Compu_UGF4_drift_max_lvl2 " " RAT_FUNC "%.3" "% Ip" COEFFS 0 327.68 0 0 0 1 /end COMPU_METHOD
/begin CHARACTERISTIC UEGOH3_off_loVf "FaultConfig # UEGOH3_off_loVf (Fault Condition:UEGO3 heater low-side feedback <)" VALUE 0x001e589a /* @ECU_Address@UEGOH3_off_loVf@0x0100E4D0@ */ ECIPP_ALIGNMENT_UWORD 100 Compu_UEGOH3_off_loVf 0 99.9984741210938 /end CHARACTERISTIC
/begin COMPU_METHOD Compu_UEGOH3_off_loVf " " RAT_FUNC "%.3" "% Vbat" COEFFS 0 655.36 0 0 0 1 /end COMPU_METHOD
/begin CHARACTERISTIC UEGOH4_off_loVf "FaultConfig # UEGOH4_off_loVf (Fault Condition:UEGO4 heater low-side feedback <)" VALUE 0x001e58a2 /* @ECU_Address@UEGOH4_off_loVf@0x0100E4D8@ */ ECIPP_ALIGNMENT_UWORD 100 Compu_UEGOH4_off_loVf 0 99.9984741210938 /end CHARACTERISTIC
/begin COMPU_METHOD Compu_UEGOH4_off_loVf " " RAT_FUNC "%.3" "% Vbat" COEFFS 0 655.36 0 0 0 1 /end COMPU_METHOD
/begin CHARACTERISTIC UEGOH3_on_hiVf "FaultConfig # UEGOH3_on_hiVf (Fault Condition:UEGO3 heater low-side feedback >)" VALUE 0x001e589e /* @ECU_Address@UEGOH3_on_hiVf@0x0100E4E0@ */ ECIPP_ALIGNMENT_UWORD 100 Compu_UEGOH3_on_hiVf 0 99.9984741210938 /end CHARACTERISTIC
/begin COMPU_METHOD Compu_UEGOH3_on_hiVf " " RAT_FUNC "%.3" "% Vbat" COEFFS 0 655.36 0 0 0 1 /end COMPU_METHOD
/begin CHARACTERISTIC UEGOH4_on_hiVf "FaultConfig # UEGOH4_on_hiVf (Fault Condition:UEGO4 heater low-side feedback >)" VALUE 0x001e58a6 /* @ECU_Address@UEGOH4_on_hiVf@0x0100E4E8@ */ ECIPP_ALIGNMENT_UWORD 100 Compu_UEGOH4_on_hiVf 0 99.9984741210938 /end CHARACTERISTIC
/begin COMPU_METHOD Compu_UEGOH4_on_hiVf " " RAT_FUNC "%.3" "% Vbat" COEFFS 0 655.36 0 0 0 1 /end COMPU_METHOD
/begin CHARACTERISTIC UEGOH3_off_loDC "FaultConfig # UEGOH3_off_loDC (Fault Condition:and PWM duty-cycle <)" VALUE 0x001e5898 /* @ECU_Address@UEGOH3_off_loDC@0x0100E4F0@ */ ECIPP_ALIGNMENT_UWORD 100 Compu_UEGOH3_off_loDC 0 99.9984741210938 /end CHARACTERISTIC
/begin COMPU_METHOD Compu_UEGOH3_off_loDC " " RAT_FUNC "%.3" "%" COEFFS 0 655.36 0 0 0 1 /end COMPU_METHOD
/begin CHARACTERISTIC UEGOH4_off_loDC "FaultConfig # UEGOH4_off_loDC (Fault Condition:and PWM duty-cycle <)" VALUE 0x001e58a0 /* @ECU_Address@UEGOH4_off_loDC@0x0100E4F8@ */ ECIPP_ALIGNMENT_UWORD 100 Compu_UEGOH4_off_loDC 0 99.9984741210938 /end CHARACTERISTIC
/begin COMPU_METHOD Compu_UEGOH4_off_loDC " " RAT_FUNC "%.3" "%" COEFFS 0 655.36 0 0 0 1 /end COMPU_METHOD
/begin CHARACTERISTIC UEGOH3_on_hiDC "FaultConfig # UEGOH3_on_hiDC (Fault Condition:and PWM duty-cycle >)" VALUE 0x001e589c /* @ECU_Address@UEGOH3_on_hiDC@0x0100E500@ */ ECIPP_ALIGNMENT_UWORD 100 Compu_UEGOH3_on_hiDC 0 99.9984741210938 /end CHARACTERISTIC
/begin COMPU_METHOD Compu_UEGOH3_on_hiDC " " RAT_FUNC "%.3" "%" COEFFS 0 655.36 0 0 0 1 /end COMPU_METHOD
/begin CHARACTERISTIC UEGOH4_on_hiDC "FaultConfig # UEGOH4_on_hiDC (Fault Condition:and PWM duty-cycle >)" VALUE 0x001e58a4 /* @ECU_Address@UEGOH4_on_hiDC@0x0100E508@ */ ECIPP_ALIGNMENT_UWORD 100 Compu_UEGOH4_on_hiDC 0 99.9984741210938 /end CHARACTERISTIC
/begin COMPU_METHOD Compu_UEGOH4_on_hiDC " " RAT_FUNC "%.3" "%" COEFFS 0 655.36 0 0 0 1 /end COMPU_METHOD
/begin CHARACTERISTIC ECT_HiExp_MAP "FaultConfig # ECT_HiExp_MAP (Fault Condition:and MAP >)" VALUE 0x001c6e98 /* @ECU_Address@ECT_HiExp_MAP@0x0100E6D8@ */ ECIPP_ALIGNMENT_UWORD 256 Compu_ECT_HiExp_MAP 0 255.99609375 /end CHARACTERISTIC
/begin COMPU_METHOD Compu_ECT_HiExp_MAP " " RAT_FUNC "%.3" "psia" COEFFS 0 256 0 0 0 1 /end COMPU_METHOD
/begin CHARACTERISTIC ECT_HiExp2_MAP "FaultConfig # ECT_HiExp2_MAP (Fault Condition:and MAP >)" VALUE 0x001c6e94 /* @ECU_Address@ECT_HiExp2_MAP@0x0100E6E0@ */ ECIPP_ALIGNMENT_UWORD 256 Compu_ECT_HiExp2_MAP 0 255.99609375 /end CHARACTERISTIC
/begin COMPU_METHOD Compu_ECT_HiExp2_MAP " " RAT_FUNC "%.3" "psia" COEFFS 0 256 0 0 0 1 /end COMPU_METHOD
/begin CHARACTERISTIC ECT_LoExp "FaultConfig # ECT_LoExp (Fault Condition:ECT <)" VALUE 0x001c6e9c /* @ECU_Address@ECT_LoExp@0x0100E6E8@ */ ECIPP_ALIGNMENT_UWORD 564 Compu_ECT_LoExp -460 563.984375 /end CHARACTERISTIC
/begin COMPU_METHOD Compu_ECT_LoExp " " RAT_FUNC "%.3" "deg F" COEFFS 0 64 29440 0 0 1 /end COMPU_METHOD
/begin CHARACTERISTIC ECT_LoExp_rpm "FaultConfig # ECT_LoExp_rpm (Fault Condition:and RPM >)" VALUE 0x001c6ea6 /* @ECU_Address@ECT_LoExp_rpm@0x0100E6F0@ */ ECIPP_ALIGNMENT_UWORD 65535 Compu_ECT_LoExp_rpm 0 65535 /end CHARACTERISTIC
/begin COMPU_METHOD Compu_ECT_LoExp_rpm " " RAT_FUNC "%.0" "rpm" COEFFS 0 1 0 0 0 1 /end COMPU_METHOD
/begin CHARACTERISTIC ECT_LoExp_MAP "FaultConfig # ECT_LoExp_MAP (Fault Condition:and MAP >)" VALUE 0x001c6ea4 /* @ECU_Address@ECT_LoExp_MAP@0x0100E6F8@ */ ECIPP_ALIGNMENT_UWORD 256 Compu_ECT_LoExp_MAP 0 255.99609375 /end CHARACTERISTIC
/begin COMPU_METHOD Compu_ECT_LoExp_MAP " " RAT_FUNC "%.3" "psia" COEFFS 0 256 0 0 0 1 /end COMPU_METHOD
/begin CHARACTERISTIC ECT_LoExp_wait "FaultConfig # ECT_LoExp_wait (Fault Condition:and run-time >)" VALUE 0x001c4288 /* @ECU_Address@ECT_LoExp_wait@0x0100E700@ */ ECIPP_ALIGNMENT_ULONG 4294967 Compu_ECT_LoExp_wait 0 4294967.295 /end CHARACTERISTIC
/begin COMPU_METHOD Compu_ECT_LoExp_wait " " RAT_FUNC "%.3" "seconds" COEFFS 0 1000 0 0 0 1 /end COMPU_METHOD
/begin CHARACTERISTIC ECT_LoExp2 "FaultConfig # ECT_LoExp2 (Fault Condition:ECT <)" VALUE 0x001c6e9e /* @ECU_Address@ECT_LoExp2@0x0100E708@ */ ECIPP_ALIGNMENT_UWORD 564 Compu_ECT_LoExp2 -460 563.984375 /end CHARACTERISTIC
/begin COMPU_METHOD Compu_ECT_LoExp2 " " RAT_FUNC "%.3" "deg F" COEFFS 0 64 29440 0 0 1 /end COMPU_METHOD
/begin CHARACTERISTIC ECT_LoExp2_rpm "FaultConfig # ECT_LoExp2_rpm (Fault Condition:and RPM >)" VALUE 0x001c6ea2 /* @ECU_Address@ECT_LoExp2_rpm@0x0100E710@ */ ECIPP_ALIGNMENT_UWORD 65535 Compu_ECT_LoExp2_rpm 0 65535 /end CHARACTERISTIC
/begin COMPU_METHOD Compu_ECT_LoExp2_rpm " " RAT_FUNC "%.0" "rpm" COEFFS 0 1 0 0 0 1 /end COMPU_METHOD
/begin CHARACTERISTIC ECT_LoExp2_MAP "FaultConfig # ECT_LoExp2_MAP (Fault Condition:and MAP >)" VALUE 0x001c6ea0 /* @ECU_Address@ECT_LoExp2_MAP@0x0100E718@ */ ECIPP_ALIGNMENT_UWORD 256 Compu_ECT_LoExp2_MAP 0 255.99609375 /end CHARACTERISTIC
/begin COMPU_METHOD Compu_ECT_LoExp2_MAP " " RAT_FUNC "%.3" "psia" COEFFS 0 256 0 0 0 1 /end COMPU_METHOD
/begin CHARACTERISTIC ECT_LoExp2_wait "FaultConfig # ECT_LoExp2_wait (Fault Condition:and run-time >)" VALUE 0x001c4284 /* @ECU_Address@ECT_LoExp2_wait@0x0100E720@ */ ECIPP_ALIGNMENT_ULONG 4294967 Compu_ECT_LoExp2_wait 0 4294967.295 /end CHARACTERISTIC
/begin COMPU_METHOD Compu_ECT_LoExp2_wait " " RAT_FUNC "%.3" "seconds" COEFFS 0 1000 0 0 0 1 /end COMPU_METHOD
/begin CHARACTERISTIC LowCLTemp_rpm "FaultConfig # LowCLTemp_rpm (Fault Condition:and RPM >)" VALUE 0x001c7d18 /* @ECU_Address@LowCLTemp_rpm@0x0100E728@ */ ECIPP_ALIGNMENT_UWORD 65535 Compu_LowCLTemp_rpm 0 65535 /end CHARACTERISTIC
/begin COMPU_METHOD Compu_LowCLTemp_rpm " " RAT_FUNC "%.0" "rpm" COEFFS 0 1 0 0 0 1 /end COMPU_METHOD
/begin CHARACTERISTIC LowCLTemp_MAP "FaultConfig # LowCLTemp_MAP (Fault Condition:and MAP >)" VALUE 0x001c7d16 /* @ECU_Address@LowCLTemp_MAP@0x0100E730@ */ ECIPP_ALIGNMENT_UWORD 256 Compu_LowCLTemp_MAP 0 255.99609375 /end CHARACTERISTIC
/begin COMPU_METHOD Compu_LowCLTemp_MAP " " RAT_FUNC "%.3" "psia" COEFFS 0 256 0 0 0 1 /end COMPU_METHOD
/begin CHARACTERISTIC LowDiagTemp_rpm "FaultConfig # LowDiagTemp_rpm (Fault Condition:and RPM >)" VALUE 0x001c7d1c /* @ECU_Address@LowDiagTemp_rpm@0x0100E738@ */ ECIPP_ALIGNMENT_UWORD 65535 Compu_LowDiagTemp_rpm 0 65535 /end CHARACTERISTIC
/begin COMPU_METHOD Compu_LowDiagTemp_rpm " " RAT_FUNC "%.0" "rpm" COEFFS 0 1 0 0 0 1 /end COMPU_METHOD
/begin CHARACTERISTIC LowDiagTemp_MAP "FaultConfig # LowDiagTemp_MAP (Fault Condition:and MAP >)" VALUE 0x001c7d1a /* @ECU_Address@LowDiagTemp_MAP@0x0100E740@ */ ECIPP_ALIGNMENT_UWORD 256 Compu_LowDiagTemp_MAP 0 255.99609375 /end CHARACTERISTIC
/begin COMPU_METHOD Compu_LowDiagTemp_MAP " " RAT_FUNC "%.3" "psia" COEFFS 0 256 0 0 0 1 /end COMPU_METHOD
/begin CHARACTERISTIC HiDiagTemp_wait "FaultConfig # HiDiagTemp_wait (Fault Condition:and run-time >)" VALUE 0x001c42b0 /* @ECU_Address@HiDiagTemp_wait@0x0100E748@ */ ECIPP_ALIGNMENT_ULONG 4294967 Compu_HiDiagTemp_wait 0 4294967.295 /end CHARACTERISTIC
/begin COMPU_METHOD Compu_HiDiagTemp_wait " " RAT_FUNC "%.3" "seconds" COEFFS 0 1000 0 0 0 1 /end COMPU_METHOD
/begin MEASUREMENT fm_rt_while_b1 "B1 counter" ULONG Compu_fm_rt_while_b1 0 0 0 1193046.47083333 ECU_ADDRESS 0x0100E9C8 /end MEASUREMENT
/begin COMPU_METHOD Compu_fm_rt_while_b1 " " RAT_FUNC "%.2" "hours" COEFFS 0 3600 0 0 0 1 /end COMPU_METHOD
/begin MEASUREMENT fm_cycles_wo_b1 "Cycles since B1 active" UBYTE Compu_fm_cycles_wo_b1 0 0 0 255 ECU_ADDRESS 0x0100E9D0 /end MEASUREMENT
/begin COMPU_METHOD Compu_fm_cycles_wo_b1 " " RAT_FUNC "%.0" "cycles" COEFFS 0 1 0 0 0 1 /end COMPU_METHOD
/begin MEASUREMENT fm_rt_cumcont_mil "Cumulative cont-MI counter" ULONG Compu_fm_rt_cumcont_mil 0 0 0 1193046.47083333 ECU_ADDRESS 0x0100E9D8 /end MEASUREMENT
/begin COMPU_METHOD Compu_fm_rt_cumcont_mil " " RAT_FUNC "%.2" "hours" COEFFS 0 3600 0 0 0 1 /end COMPU_METHOD
/begin MEASUREMENT fm_rt_cont_mil "Continuous-MI counter" ULONG Compu_fm_rt_cont_mil 0 0 0 1193046.47083333 ECU_ADDRESS 0x0100E9E0 /end MEASUREMENT
/begin COMPU_METHOD Compu_fm_rt_cont_mil " " RAT_FUNC "%.2" "hours" COEFFS 0 3600 0 0 0 1 /end COMPU_METHOD
/begin MEASUREMENT fm_cont_mil_na_cyc "Cycles since cont-MI" UBYTE Compu_fm_cont_mil_na_cyc 0 0 0 255 ECU_ADDRESS 0x0100E9E8 /end MEASUREMENT
/begin COMPU_METHOD Compu_fm_cont_mil_na_cyc " " RAT_FUNC "%.0" "cycles" COEFFS 0 1 0 0 0 1 /end COMPU_METHOD
/begin MEASUREMENT fm_wu_cont_mil_hld "Warm-ups cont-MI held" UBYTE Compu_fm_wu_cont_mil_hld 0 0 0 255 ECU_ADDRESS 0x0100E9F0 /end MEASUREMENT
/begin COMPU_METHOD Compu_fm_wu_cont_mil_hld " " RAT_FUNC "%.0" "cycles" COEFFS 0 1 0 0 0 1 /end COMPU_METHOD
/begin MEASUREMENT fm_rt_cont_mil_hld "Engine hours cont-MI held" ULONG Compu_fm_rt_cont_mil_hld 0 0 0 1193046.47083333 ECU_ADDRESS 0x0100E9F8 /end MEASUREMENT
/begin COMPU_METHOD Compu_fm_rt_cont_mil_hld " " RAT_FUNC "%.2" "hours" COEFFS 0 3600 0 0 0 1 /end COMPU_METHOD
/begin MEASUREMENT fm_general_denom "General denominator" UWORD Compu_fm_general_denom 0 0 0 65535 ECU_ADDRESS 0x0100EA90 /end MEASUREMENT
/begin COMPU_METHOD Compu_fm_general_denom " " RAT_FUNC "%.0" "cycles" COEFFS 0 1 0 0 0 1 /end COMPU_METHOD
/begin MEASUREMENT rdy_rdy_misfire "OBD Readiness Status Ready 1" UBYTE Compu_rdy_rdy_misfire 0 0 0 255 ECU_ADDRESS 0x0100EAD0 /end MEASUREMENT
/begin COMPU_METHOD Compu_rdy_rdy_misfire " " RAT_FUNC "%.0" "-" COEFFS 0 1 0 0 0 1 /end COMPU_METHOD
/begin MEASUREMENT rdy_rdy_fuel "OBD Readiness Status Ready 2" UBYTE Compu_rdy_rdy_fuel 0 0 0 255 ECU_ADDRESS 0x0100EAD8 /end MEASUREMENT
/begin COMPU_METHOD Compu_rdy_rdy_fuel " " RAT_FUNC "%.0" "-" COEFFS 0 1 0 0 0 1 /end COMPU_METHOD
/begin MEASUREMENT rdy_rdy_compcomp "OBD Readiness Status Ready 3" UBYTE Compu_rdy_rdy_compcomp 0 0 0 255 ECU_ADDRESS 0x0100EAE0 /end MEASUREMENT
/begin COMPU_METHOD Compu_rdy_rdy_compcomp " " RAT_FUNC "%.0" "-" COEFFS 0 1 0 0 0 1 /end COMPU_METHOD
/begin MEASUREMENT rdy_rdy_cat "OBD Readiness Status Ready 4" UBYTE Compu_rdy_rdy_cat 0 0 0 255 ECU_ADDRESS 0x0100EAE8 /end MEASUREMENT
/begin COMPU_METHOD Compu_rdy_rdy_cat " " RAT_FUNC "%.0" "-" COEFFS 0 1 0 0 0 1 /end COMPU_METHOD
/begin MEASUREMENT rdy_rdy_boost "OBD Readiness Status Ready 10" UBYTE Compu_rdy_rdy_boost 0 0 0 255 ECU_ADDRESS 0x0100EB18 /end MEASUREMENT
/begin COMPU_METHOD Compu_rdy_rdy_boost " " RAT_FUNC "%.0" "-" COEFFS 0 1 0 0 0 1 /end COMPU_METHOD
/begin MEASUREMENT rdy_rdy_o2 "OBD Readiness Status Ready 11" UBYTE Compu_rdy_rdy_o2 0 0 0 255 ECU_ADDRESS 0x0100EB20 /end MEASUREMENT
/begin COMPU_METHOD Compu_rdy_rdy_o2 " " RAT_FUNC "%.0" "-" COEFFS 0 1 0 0 0 1 /end COMPU_METHOD
/begin MEASUREMENT rdy_rdy_o2_heater "OBD Readiness Status Ready 13" UBYTE Compu_rdy_rdy_o2_heater 0 0 0 255 ECU_ADDRESS 0x0100EB30 /end MEASUREMENT
/begin COMPU_METHOD Compu_rdy_rdy_o2_heater " " RAT_FUNC "%.0" "-" COEFFS 0 1 0 0 0 1 /end COMPU_METHOD
/begin MEASUREMENT rdy_rdy_egr_vvt "OBD Readiness Status Ready 15" UBYTE Compu_rdy_rdy_egr_vvt 0 0 0 255 ECU_ADDRESS 0x0100EB40 /end MEASUREMENT
/begin COMPU_METHOD Compu_rdy_rdy_egr_vvt " " RAT_FUNC "%.0" "-" COEFFS 0 1 0 0 0 1 /end COMPU_METHOD
/begin MEASUREMENT rdy_sup_misfire "OBD Readiness Status Supported 1" UBYTE Compu_rdy_sup_misfire 0 0 0 255 ECU_ADDRESS 0x0100EB50 /end MEASUREMENT
/begin COMPU_METHOD Compu_rdy_sup_misfire " " RAT_FUNC "%.0" "-" COEFFS 0 1 0 0 0 1 /end COMPU_METHOD
/begin MEASUREMENT rdy_sup_fuel "OBD Readiness Status Supported 2" UBYTE Compu_rdy_sup_fuel 0 0 0 255 ECU_ADDRESS 0x0100EB58 /end MEASUREMENT
/begin COMPU_METHOD Compu_rdy_sup_fuel " " RAT_FUNC "%.0" "-" COEFFS 0 1 0 0 0 1 /end COMPU_METHOD
/begin MEASUREMENT rdy_sup_compcomp "OBD Readiness Status Supported 3" UBYTE Compu_rdy_sup_compcomp 0 0 0 255 ECU_ADDRESS 0x0100EB60 /end MEASUREMENT
/begin COMPU_METHOD Compu_rdy_sup_compcomp " " RAT_FUNC "%.0" "-" COEFFS 0 1 0 0 0 1 /end COMPU_METHOD
/begin MEASUREMENT rdy_sup_cat "OBD Readiness Status Supported 4" UBYTE Compu_rdy_sup_cat 0 0 0 255 ECU_ADDRESS 0x0100EB68 /end MEASUREMENT
/begin COMPU_METHOD Compu_rdy_sup_cat " " RAT_FUNC "%.0" "-" COEFFS 0 1 0 0 0 1 /end COMPU_METHOD
/begin MEASUREMENT rdy_sup_boost "OBD Readiness Status Supported 10" UBYTE Compu_rdy_sup_boost 0 0 0 255 ECU_ADDRESS 0x0100EB98 /end MEASUREMENT
/begin COMPU_METHOD Compu_rdy_sup_boost " " RAT_FUNC "%.0" "-" COEFFS 0 1 0 0 0 1 /end COMPU_METHOD
/begin MEASUREMENT rdy_sup_o2 "OBD Readiness Status Supported 11" UBYTE Compu_rdy_sup_o2 0 0 0 255 ECU_ADDRESS 0x0100EBA0 /end MEASUREMENT
/begin COMPU_METHOD Compu_rdy_sup_o2 " " RAT_FUNC "%.0" "-" COEFFS 0 1 0 0 0 1 /end COMPU_METHOD
/begin MEASUREMENT rdy_sup_o2_heater "OBD Readiness Status Supported 13" UBYTE Compu_rdy_sup_o2_heater 0 0 0 255 ECU_ADDRESS 0x0100EBB0 /end MEASUREMENT
/begin COMPU_METHOD Compu_rdy_sup_o2_heater " " RAT_FUNC "%.0" "-" COEFFS 0 1 0 0 0 1 /end COMPU_METHOD
/begin MEASUREMENT rdy_sup_egr_vvt "OBD Readiness Status Supported 15" UBYTE Compu_rdy_sup_egr_vvt 0 0 0 255 ECU_ADDRESS 0x0100EBC0 /end MEASUREMENT
/begin COMPU_METHOD Compu_rdy_sup_egr_vvt " " RAT_FUNC "%.0" "-" COEFFS 0 1 0 0 0 1 /end COMPU_METHOD
/begin MEASUREMENT iupr_sup_cat_b1 "IUPR Supported 1" UBYTE Compu_iupr_sup_cat_b1 0 0 0 255 ECU_ADDRESS 0x0100ECD0 /end MEASUREMENT
/begin COMPU_METHOD Compu_iupr_sup_cat_b1 " " RAT_FUNC "%.0" "-" COEFFS 0 1 0 0 0 1 /end COMPU_METHOD
/begin MEASUREMENT iupr_sup_cat_b2 "IUPR Supported 2" UBYTE Compu_iupr_sup_cat_b2 0 0 0 255 ECU_ADDRESS 0x0100ECD8 /end MEASUREMENT
/begin COMPU_METHOD Compu_iupr_sup_cat_b2 " " RAT_FUNC "%.0" "-" COEFFS 0 1 0 0 0 1 /end COMPU_METHOD
/begin MEASUREMENT iupr_sup_o2_b1 "IUPR Supported 3" UBYTE Compu_iupr_sup_o2_b1 0 0 0 255 ECU_ADDRESS 0x0100ECE0 /end MEASUREMENT
/begin COMPU_METHOD Compu_iupr_sup_o2_b1 " " RAT_FUNC "%.0" "-" COEFFS 0 1 0 0 0 1 /end COMPU_METHOD
/begin MEASUREMENT iupr_sup_o2_b2 "IUPR Supported 4" UBYTE Compu_iupr_sup_o2_b2 0 0 0 255 ECU_ADDRESS 0x0100ECE8 /end MEASUREMENT
/begin COMPU_METHOD Compu_iupr_sup_o2_b2 " " RAT_FUNC "%.0" "-" COEFFS 0 1 0 0 0 1 /end COMPU_METHOD
/begin MEASUREMENT iupr_sup_egr_vvt "IUPR Supported 5" UBYTE Compu_iupr_sup_egr_vvt 0 0 0 255 ECU_ADDRESS 0x0100ECF0 /end MEASUREMENT
/begin COMPU_METHOD Compu_iupr_sup_egr_vvt " " RAT_FUNC "%.0" "-" COEFFS 0 1 0 0 0 1 /end COMPU_METHOD
/begin MEASUREMENT iupr_sup_sec_o2_b1 "IUPR Supported 8" UBYTE Compu_iupr_sup_sec_o2_b1 0 0 0 255 ECU_ADDRESS 0x0100ED08 /end MEASUREMENT
/begin COMPU_METHOD Compu_iupr_sup_sec_o2_b1 " " RAT_FUNC "%.0" "-" COEFFS 0 1 0 0 0 1 /end COMPU_METHOD
/begin MEASUREMENT iupr_sup_sec_o2_b2 "IUPR Supported 9" UBYTE Compu_iupr_sup_sec_o2_b2 0 0 0 255 ECU_ADDRESS 0x0100ED10 /end MEASUREMENT
/begin COMPU_METHOD Compu_iupr_sup_sec_o2_b2 " " RAT_FUNC "%.0" "-" COEFFS 0 1 0 0 0 1 /end COMPU_METHOD
/begin MEASUREMENT iupr_sup_boost "IUPR Supported 15" UBYTE Compu_iupr_sup_boost 0 0 0 255 ECU_ADDRESS 0x0100ED40 /end MEASUREMENT
/begin COMPU_METHOD Compu_iupr_sup_boost " " RAT_FUNC "%.0" "-" COEFFS 0 1 0 0 0 1 /end COMPU_METHOD
/begin MEASUREMENT iupr_num_cat_b1 "IUPR Numerator 1" UWORD Compu_iupr_num_cat_b1 0 0 0 65535 ECU_ADDRESS 0x0100ED50 /end MEASUREMENT
/begin COMPU_METHOD Compu_iupr_num_cat_b1 " " RAT_FUNC "%.0" "-" COEFFS 0 1 0 0 0 1 /end COMPU_METHOD
/begin MEASUREMENT iupr_num_cat_b2 "IUPR Numerator 2" UWORD Compu_iupr_num_cat_b2 0 0 0 65535 ECU_ADDRESS 0x0100ED58 /end MEASUREMENT
/begin COMPU_METHOD Compu_iupr_num_cat_b2 " " RAT_FUNC "%.0" "-" COEFFS 0 1 0 0 0 1 /end COMPU_METHOD
/begin MEASUREMENT iupr_num_o2_b1 "IUPR Numerator 3" UWORD Compu_iupr_num_o2_b1 0 0 0 65535 ECU_ADDRESS 0x0100ED60 /end MEASUREMENT
/begin COMPU_METHOD Compu_iupr_num_o2_b1 " " RAT_FUNC "%.0" "-" COEFFS 0 1 0 0 0 1 /end COMPU_METHOD
/begin MEASUREMENT iupr_num_o2_b2 "IUPR Numerator 4" UWORD Compu_iupr_num_o2_b2 0 0 0 65535 ECU_ADDRESS 0x0100ED68 /end MEASUREMENT
/begin COMPU_METHOD Compu_iupr_num_o2_b2 " " RAT_FUNC "%.0" "-" COEFFS 0 1 0 0 0 1 /end COMPU_METHOD
/begin MEASUREMENT iupr_num_egr_vvt "IUPR Numerator 5" UWORD Compu_iupr_num_egr_vvt 0 0 0 65535 ECU_ADDRESS 0x0100ED70 /end MEASUREMENT
/begin COMPU_METHOD Compu_iupr_num_egr_vvt " " RAT_FUNC "%.0" "-" COEFFS 0 1 0 0 0 1 /end COMPU_METHOD
/begin MEASUREMENT iupr_num_sec_o2_b1 "IUPR Numerator 8" UWORD Compu_iupr_num_sec_o2_b1 0 0 0 65535 ECU_ADDRESS 0x0100ED88 /end MEASUREMENT
/begin COMPU_METHOD Compu_iupr_num_sec_o2_b1 " " RAT_FUNC "%.0" "-" COEFFS 0 1 0 0 0 1 /end COMPU_METHOD
/begin MEASUREMENT iupr_num_sec_o2_b2 "IUPR Numerator 9" UWORD Compu_iupr_num_sec_o2_b2 0 0 0 65535 ECU_ADDRESS 0x0100ED90 /end MEASUREMENT
/begin COMPU_METHOD Compu_iupr_num_sec_o2_b2 " " RAT_FUNC "%.0" "-" COEFFS 0 1 0 0 0 1 /end COMPU_METHOD
/begin MEASUREMENT iupr_num_boost "IUPR Numerator 15" UWORD Compu_iupr_num_boost 0 0 0 65535 ECU_ADDRESS 0x0100EDC0 /end MEASUREMENT
/begin COMPU_METHOD Compu_iupr_num_boost " " RAT_FUNC "%.0" "-" COEFFS 0 1 0 0 0 1 /end COMPU_METHOD
/begin MEASUREMENT iupr_den_cat_b1 "IUPR Denominator 1" UWORD Compu_iupr_den_cat_b1 0 0 0 65535 ECU_ADDRESS 0x0100EDD0 /end MEASUREMENT
/begin COMPU_METHOD Compu_iupr_den_cat_b1 " " RAT_FUNC "%.0" "-" COEFFS 0 1 0 0 0 1 /end COMPU_METHOD
/begin MEASUREMENT iupr_den_cat_b2 "IUPR Denominator 2" UWORD Compu_iupr_den_cat_b2 0 0 0 65535 ECU_ADDRESS 0x0100EDD8 /end MEASUREMENT
/begin COMPU_METHOD Compu_iupr_den_cat_b2 " " RAT_FUNC "%.0" "-" COEFFS 0 1 0 0 0 1 /end COMPU_METHOD
/begin MEASUREMENT iupr_den_o2_b1 "IUPR Denominator 3" UWORD Compu_iupr_den_o2_b1 0 0 0 65535 ECU_ADDRESS 0x0100EDE0 /end MEASUREMENT
/begin COMPU_METHOD Compu_iupr_den_o2_b1 " " RAT_FUNC "%.0" "-" COEFFS 0 1 0 0 0 1 /end COMPU_METHOD
/begin MEASUREMENT iupr_den_o2_b2 "IUPR Denominator 4" UWORD Compu_iupr_den_o2_b2 0 0 0 65535 ECU_ADDRESS 0x0100EDE8 /end MEASUREMENT
/begin COMPU_METHOD Compu_iupr_den_o2_b2 " " RAT_FUNC "%.0" "-" COEFFS 0 1 0 0 0 1 /end COMPU_METHOD
/begin MEASUREMENT iupr_den_egr_vvt "IUPR Denominator 5" UWORD Compu_iupr_den_egr_vvt 0 0 0 65535 ECU_ADDRESS 0x0100EDF0 /end MEASUREMENT
/begin COMPU_METHOD Compu_iupr_den_egr_vvt " " RAT_FUNC "%.0" "-" COEFFS 0 1 0 0 0 1 /end COMPU_METHOD
/begin MEASUREMENT iupr_den_sec_o2_b1 "IUPR Denominator 8" UWORD Compu_iupr_den_sec_o2_b1 0 0 0 65535 ECU_ADDRESS 0x0100EE08 /end MEASUREMENT
/begin COMPU_METHOD Compu_iupr_den_sec_o2_b1 " " RAT_FUNC "%.0" "-" COEFFS 0 1 0 0 0 1 /end COMPU_METHOD
/begin MEASUREMENT iupr_den_sec_o2_b2 "IUPR Denominator 9" UWORD Compu_iupr_den_sec_o2_b2 0 0 0 65535 ECU_ADDRESS 0x0100EE10 /end MEASUREMENT
/begin COMPU_METHOD Compu_iupr_den_sec_o2_b2 " " RAT_FUNC "%.0" "-" COEFFS 0 1 0 0 0 1 /end COMPU_METHOD
/begin MEASUREMENT iupr_den_boost "IUPR Denominator 15" UWORD Compu_iupr_den_boost 0 0 0 65535 ECU_ADDRESS 0x0100EE40 /end MEASUREMENT
/begin COMPU_METHOD Compu_iupr_den_boost " " RAT_FUNC "%.0" "-" COEFFS 0 1 0 0 0 1 /end COMPU_METHOD
/begin CHARACTERISTIC BstTIP_slow_delta "FaultConfig # BstTIP_slow_delta (Fault Condition:P < P target -)" VALUE 0x001c6da4 /* @ECU_Address@BstTIP_slow_delta@0x0100EE98@ */ ECIPP_ALIGNMENT_UWORD 256 Compu_BstTIP_slow_delta 0 255.99609375 /end CHARACTERISTIC
/begin COMPU_METHOD Compu_BstTIP_slow_delta " " RAT_FUNC "%.3" "psi" COEFFS 0 256 0 0 0 1 /end COMPU_METHOD
/begin CHARACTERISTIC BstTIP_slow_MAP "FaultConfig # BstTIP_slow_MAP (Fault Condition:and P >)" VALUE 0x001c6da2 /* @ECU_Address@BstTIP_slow_MAP@0x0100EEA0@ */ ECIPP_ALIGNMENT_UWORD 256 Compu_BstTIP_slow_MAP 0 255.99609375 /end CHARACTERISTIC
/begin COMPU_METHOD Compu_BstTIP_slow_MAP " " RAT_FUNC "%.3" "psia" COEFFS 0 256 0 0 0 1 /end COMPU_METHOD
/begin CHARACTERISTIC BstTIP_slow_rpm "FaultConfig # BstTIP_slow_rpm (Fault Condition:and RPM >)" VALUE 0x001c6da6 /* @ECU_Address@BstTIP_slow_rpm@0x0100EEA8@ */ ECIPP_ALIGNMENT_UWORD 65535 Compu_BstTIP_slow_rpm 0 65535 /end CHARACTERISTIC
/begin COMPU_METHOD Compu_BstTIP_slow_rpm " " RAT_FUNC "%.0" "rpm" COEFFS 0 1 0 0 0 1 /end COMPU_METHOD
/begin CHARACTERISTIC BstTIP_slow_dtdz "FaultConfig # BstTIP_slow_dtdz (Fault Condition:and dP/dt <)" VALUE 0x001c4428 /* @ECU_Address@BstTIP_slow_dtdz@0x0100EEB0@ */ ECIPP_ALIGNMENT_SWORD 512 Compu_BstTIP_slow_dtdz -512 511.984375 /end CHARACTERISTIC
/begin COMPU_METHOD Compu_BstTIP_slow_dtdz " " RAT_FUNC "%.3" "psi/sec" COEFFS 0 64 0 0 0 1 /end COMPU_METHOD
/begin CHARACTERISTIC CAC_eta_lo_mdota "FaultConfig # CAC_eta_lo_mdota (Fault Condition:Air mass flow >)" VALUE 0x001c6db2 /* @ECU_Address@CAC_eta_lo_mdota@0x0100EEB8@ */ ECIPP_ALIGNMENT_UWORD 1024 Compu_CAC_eta_lo_mdota 0 1023.984375 /end CHARACTERISTIC
/begin COMPU_METHOD Compu_CAC_eta_lo_mdota " " RAT_FUNC "%.3" "g/sec" COEFFS 0 64 0 0 0 1 /end COMPU_METHOD
/begin CHARACTERISTIC CAC_eta_lo_COT "FaultConfig # CAC_eta_lo_COT (Fault Condition:and COT >)" VALUE 0x001c6dae /* @ECU_Address@CAC_eta_lo_COT@0x0100EEC0@ */ ECIPP_ALIGNMENT_UWORD 7732 Compu_CAC_eta_lo_COT -460 7731.875 /end CHARACTERISTIC
/begin COMPU_METHOD Compu_CAC_eta_lo_COT " " RAT_FUNC "%.3" "deg F" COEFFS 0 8 3680 0 0 1 /end COMPU_METHOD
/begin CHARACTERISTIC CAC_eta_lo_kph "FaultConfig # CAC_eta_lo_kph (Fault Condition:and roadspeed >=)" VALUE 0x001c6db0 /* @ECU_Address@CAC_eta_lo_kph@0x0100EEC8@ */ ECIPP_ALIGNMENT_UWORD 256 Compu_CAC_eta_lo_kph 0 255.99609375 /end CHARACTERISTIC
/begin COMPU_METHOD Compu_CAC_eta_lo_kph " " RAT_FUNC "%.3" "km/hr" COEFFS 0 256 0 0 0 1 /end COMPU_METHOD
/begin CHARACTERISTIC CAC_eta_lo "FaultConfig # CAC_eta_lo (Fault Condition:and CAC efficiency <)" VALUE 0x001c6dac /* @ECU_Address@CAC_eta_lo@0x0100EED0@ */ ECIPP_ALIGNMENT_UWORD 100 Compu_CAC_eta_lo 0 99.9984741210938 /end CHARACTERISTIC
/begin COMPU_METHOD Compu_CAC_eta_lo " " RAT_FUNC "%.3" "%" COEFFS 0 655.36 0 0 0 1 /end COMPU_METHOD
/begin CHARACTERISTIC COT_Taux_cal "{COT_Taux_cal&0xff=0:Fuel source}{COT_Taux_cal&0xff=1:Exhaust manifold/riser}{COT_Taux_cal&0xff=2:Aux Temp A}{COT_Taux_cal&0xff=3:Aux Temp B}{COT_Taux_cal&0xff=4:Aux Temp C}{COT_Taux_cal&0xff=5:Aux Temp D}" VALUE 0x001c86ac /* @ECU_Address@COT_Taux_cal@0x0100EEE0@ */ ECIPP_ALIGNMENT_UBYTE 255 COT_Taux_cal_COMPU_VTAB 0 255 BIT_MASK 0xff /end CHARACTERISTIC
/begin COMPU_METHOD COT_Taux_cal_COMPU_VTAB "Verbal Table" TAB_VERB "%.0" "list" COMPU_TAB_REF COT_Taux_cal_COMPU_VTAB_REF /end COMPU_METHOD
/begin COMPU_VTAB COT_Taux_cal_COMPU_VTAB_REF "Verbal Table" TAB_VERB 6 0 "Fuel source" 1 "Exhaust manifold/riser" 2 "Aux Temp A" 3 "Aux Temp B" 4 "Aux Temp C" 5 "Aux Temp D" DEFAULT_VALUE "UNKNOWN" /end COMPU_VTAB
/begin CHARACTERISTIC COT_vdr "IOConfig # COT_vdr" VALUE 0x001c3a88 /* @ECU_Address@COT_vdr@0x0100EEE8@ */ ECIPP_ALIGNMENT_FLOAT32_IEEE 10000000000 Compu_COT_vdr -10000000000 10000000000 /end CHARACTERISTIC
/begin COMPU_METHOD Compu_COT_vdr " " RAT_FUNC "%.3" "ohms" COEFFS 0 1 0 0 0 1 /end COMPU_METHOD
/begin CHARACTERISTIC TIAT_Taux_cal "{TIAT_Taux_cal&0xff=0:Fuel source}{TIAT_Taux_cal&0xff=1:Exhaust manifold/riser}{TIAT_Taux_cal&0xff=2:Aux Temp A}{TIAT_Taux_cal&0xff=3:Aux Temp B}{TIAT_Taux_cal&0xff=4:Aux Temp C}{TIAT_Taux_cal&0xff=5:Aux Temp D}" VALUE 0x001c8f30 /* @ECU_Address@TIAT_Taux_cal@0x0100EEF8@ */ ECIPP_ALIGNMENT_UBYTE 255 TIAT_Taux_cal_COMPU_VTAB 0 255 BIT_MASK 0xff /end CHARACTERISTIC
/begin COMPU_METHOD TIAT_Taux_cal_COMPU_VTAB "Verbal Table" TAB_VERB "%.0" "list" COMPU_TAB_REF TIAT_Taux_cal_COMPU_VTAB_REF /end COMPU_METHOD
/begin COMPU_VTAB TIAT_Taux_cal_COMPU_VTAB_REF "Verbal Table" TAB_VERB 6 0 "Fuel source" 1 "Exhaust manifold/riser" 2 "Aux Temp A" 3 "Aux Temp B" 4 "Aux Temp C" 5 "Aux Temp D" DEFAULT_VALUE "UNKNOWN" /end COMPU_VTAB
/begin CHARACTERISTIC TIAT_vdr "IOConfig # TIAT_vdr" VALUE 0x001c3c24 /* @ECU_Address@TIAT_vdr@0x0100EF00@ */ ECIPP_ALIGNMENT_FLOAT32_IEEE 10000000000 Compu_TIAT_vdr -10000000000 10000000000 /end CHARACTERISTIC
/begin COMPU_METHOD Compu_TIAT_vdr " " RAT_FUNC "%.3" "ohms" COEFFS 0 1 0 0 0 1 /end COMPU_METHOD
/begin CHARACTERISTIC TPSdP_Paux_cal "{TPSdP_Paux_cal&0xff=0:Aux Press A}{TPSdP_Paux_cal&0xff=1:Aux Press B}{TPSdP_Paux_cal&0xff=2:Aux Press C}{TPSdP_Paux_cal&0xff=3:Aux Press D}" VALUE 0x001c8f4a /* @ECU_Address@TPSdP_Paux_cal@0x0100F0B0@ */ ECIPP_ALIGNMENT_UBYTE 255 TPSdP_Paux_cal_COMPU_VTAB 0 255 BIT_MASK 0xff /end CHARACTERISTIC
/begin COMPU_METHOD TPSdP_Paux_cal_COMPU_VTAB "Verbal Table" TAB_VERB "%.0" "list" COMPU_TAB_REF TPSdP_Paux_cal_COMPU_VTAB_REF /end COMPU_METHOD
/begin COMPU_VTAB TPSdP_Paux_cal_COMPU_VTAB_REF "Verbal Table" TAB_VERB 4 0 "Aux Press A" 1 "Aux Press B" 2 "Aux Press C" 3 "Aux Press D" DEFAULT_VALUE "UNKNOWN" /end COMPU_VTAB
/begin MEASUREMENT TPSdP_offset_float "TPSdP offset" FLOAT32_IEEE Compu_TPSdP_offset_float 0 0 -10000000000 10000000000 ECU_ADDRESS 0x0100F0F8 /end MEASUREMENT
/begin COMPU_METHOD Compu_TPSdP_offset_float " " RAT_FUNC "%.3" "psi" COEFFS 0 1 0 0 0 1 /end COMPU_METHOD
/begin CHARACTERISTIC TPS_learn_EE_ofst "General # TPS_learn_EE_ofst" VALUE 0x001C9C38 /* @ECU_Address@TPS_learn_EE_ofst@0x0100F130@ */ ECIPP_ALIGNMENT_UWORD 5 Compu_TPS_learn_EE_ofst 0 5.00114468864469 /end CHARACTERISTIC
/begin COMPU_METHOD Compu_TPS_learn_EE_ofst " " RAT_FUNC "%.3" "volts" COEFFS 0 13104 0 0 0 1 /end COMPU_METHOD
/begin CHARACTERISTIC APS_learn_EE_ofst "General # APS_learn_EE_ofst" VALUE 0x001C9E0C /* @ECU_Address@APS_learn_EE_ofst@0x0100F138@ */ ECIPP_ALIGNMENT_UWORD 5 Compu_APS_learn_EE_ofst 0 5.00114468864469 /end CHARACTERISTIC
/begin COMPU_METHOD Compu_APS_learn_EE_ofst " " RAT_FUNC "%.3" "volts" COEFFS 0 13104 0 0 0 1 /end COMPU_METHOD
/begin CHARACTERISTIC BPS_learn_EE_ofst "General # BPS_learn_EE_ofst" VALUE 0x001C9EAC /* @ECU_Address@BPS_learn_EE_ofst@0x0100F140@ */ ECIPP_ALIGNMENT_UWORD 5 Compu_BPS_learn_EE_ofst 0 5.00114468864469 /end CHARACTERISTIC
/begin COMPU_METHOD Compu_BPS_learn_EE_ofst " " RAT_FUNC "%.3" "volts" COEFFS 0 13104 0 0 0 1 /end COMPU_METHOD
/begin CHARACTERISTIC EGR_slowinc_err "Air # EGR_slowinc_err (Fault Condition:EGR commanded - model estimated >)" VALUE 0x001c0290 /* @ECU_Address@EGR_slowinc_err@0x0100F298@ */ ECIPP_ALIGNMENT_SWORD 200 Compu_EGR_slowinc_err -200 199.993896484375 /end CHARACTERISTIC
/begin COMPU_METHOD Compu_EGR_slowinc_err " " RAT_FUNC "%.3" "%" COEFFS 0 163.84 0 0 0 1 /end COMPU_METHOD
/begin CHARACTERISTIC EGR_slowdec_err "Air # EGR_slowdec_err (Fault Condition:EGR model estimated - commanded >)" VALUE 0x001c028a /* @ECU_Address@EGR_slowdec_err@0x0100F2A0@ */ ECIPP_ALIGNMENT_SWORD 200 Compu_EGR_slowdec_err -200 199.993896484375 /end CHARACTERISTIC
/begin COMPU_METHOD Compu_EGR_slowdec_err " " RAT_FUNC "%.3" "%" COEFFS 0 163.84 0 0 0 1 /end COMPU_METHOD
/begin CHARACTERISTIC EGR_OOA_hi_err "Air # EGR_OOA_hi_err (Fault Condition:EGR commanded - model estimated >)" VALUE 0x001c0278 /* @ECU_Address@EGR_OOA_hi_err@0x0100F2A8@ */ ECIPP_ALIGNMENT_SWORD 200 Compu_EGR_OOA_hi_err -200 199.993896484375 /end CHARACTERISTIC
/begin COMPU_METHOD Compu_EGR_OOA_hi_err " " RAT_FUNC "%.3" "%" COEFFS 0 163.84 0 0 0 1 /end COMPU_METHOD
/begin CHARACTERISTIC EGR_OOA_lo_err "Air # EGR_OOA_lo_err (Fault Condition:EGR model estimated - commanded >)" VALUE 0x001c027a /* @ECU_Address@EGR_OOA_lo_err@0x0100F2B0@ */ ECIPP_ALIGNMENT_SWORD 200 Compu_EGR_OOA_lo_err -200 199.993896484375 /end CHARACTERISTIC
/begin COMPU_METHOD Compu_EGR_OOA_lo_err " " RAT_FUNC "%.3" "%" COEFFS 0 163.84 0 0 0 1 /end COMPU_METHOD
/begin CHARACTERISTIC EGR_UEGOdP_hi_min "Air # EGR_UEGOdP_hi_min (Fault Condition:EGR UEGO feedback >)" VALUE 0x001c0980 /* @ECU_Address@EGR_UEGOdP_hi_min@0x0100F2B8@ */ ECIPP_ALIGNMENT_UWORD 400 Compu_EGR_UEGOdP_hi_min 0 399.993896484375 /end CHARACTERISTIC
/begin COMPU_METHOD Compu_EGR_UEGOdP_hi_min " " RAT_FUNC "%.3" "%" COEFFS 0 163.84 0 0 0 1 /end COMPU_METHOD
/begin CHARACTERISTIC EGR_UEGOdP_hi_err "Air # EGR_UEGOdP_hi_err (Fault Condition:and EGR (UEGO-dP) feedback >)" VALUE 0x001c027e /* @ECU_Address@EGR_UEGOdP_hi_err@0x0100F2C0@ */ ECIPP_ALIGNMENT_SWORD 200 Compu_EGR_UEGOdP_hi_err -200 199.993896484375 /end CHARACTERISTIC
/begin COMPU_METHOD Compu_EGR_UEGOdP_hi_err " " RAT_FUNC "%.3" "%" COEFFS 0 163.84 0 0 0 1 /end COMPU_METHOD
/begin CHARACTERISTIC EGR_UEGOdP_lo_min "Air # EGR_UEGOdP_lo_min (Fault Condition:EGR dP feedback >)" VALUE 0x001c0982 /* @ECU_Address@EGR_UEGOdP_lo_min@0x0100F2C8@ */ ECIPP_ALIGNMENT_UWORD 400 Compu_EGR_UEGOdP_lo_min 0 399.993896484375 /end CHARACTERISTIC
/begin COMPU_METHOD Compu_EGR_UEGOdP_lo_min " " RAT_FUNC "%.3" "%" COEFFS 0 163.84 0 0 0 1 /end COMPU_METHOD
/begin CHARACTERISTIC EGR_UEGOdP_lo_err "Air # EGR_UEGOdP_lo_err (Fault Condition:and EGR (dP-UEGO) feedback >)" VALUE 0x001c0280 /* @ECU_Address@EGR_UEGOdP_lo_err@0x0100F2D0@ */ ECIPP_ALIGNMENT_SWORD 200 Compu_EGR_UEGOdP_lo_err -200 199.993896484375 /end CHARACTERISTIC
/begin COMPU_METHOD Compu_EGR_UEGOdP_lo_err " " RAT_FUNC "%.3" "%" COEFFS 0 163.84 0 0 0 1 /end COMPU_METHOD
/begin CHARACTERISTIC EGR_offmin_lmt "Air # EGR_offmin_lmt (Fault Condition:and EGR min/nom fraction <)" VALUE 0x001c0286 /* @ECU_Address@EGR_offmin_lmt@0x0100F2D8@ */ ECIPP_ALIGNMENT_SWORD 2 Compu_EGR_offmin_lmt -2 1.99993896484375 /end CHARACTERISTIC
/begin COMPU_METHOD Compu_EGR_offmin_lmt " " RAT_FUNC "%.3" "-" COEFFS 0 16384 0 0 0 1 /end COMPU_METHOD
/begin CHARACTERISTIC EGR_clr_eta_ECTmin "Air # EGR_clr_eta_ECTmin (Fault Condition:Coolant temperature >)" VALUE 0x001c098e /* @ECU_Address@EGR_clr_eta_ECTmin@0x0100F2E8@ */ ECIPP_ALIGNMENT_UWORD 564 Compu_EGR_clr_eta_ECTmin -460 563.984375 /end CHARACTERISTIC
/begin COMPU_METHOD Compu_EGR_clr_eta_ECTmin " " RAT_FUNC "%.3" "deg F" COEFFS 0 64 29440 0 0 1 /end COMPU_METHOD
/begin CHARACTERISTIC EGR_clr_eta_ECTmax "Air # EGR_clr_eta_ECTmax (Fault Condition:and coolant temperature <)" VALUE 0x001c098c /* @ECU_Address@EGR_clr_eta_ECTmax@0x0100F2F0@ */ ECIPP_ALIGNMENT_UWORD 564 Compu_EGR_clr_eta_ECTmax -460 563.984375 /end CHARACTERISTIC
/begin COMPU_METHOD Compu_EGR_clr_eta_ECTmax " " RAT_FUNC "%.3" "deg F" COEFFS 0 64 29440 0 0 1 /end COMPU_METHOD
/begin CHARACTERISTIC EGR_clr_eta_dTmax "Air # EGR_clr_eta_dTmax (Fault Condition:and EGRT > coolant temperature +)" VALUE 0x001c0990 /* @ECU_Address@EGR_clr_eta_dTmax@0x0100F2F8@ */ ECIPP_ALIGNMENT_UWORD 1024 Compu_EGR_clr_eta_dTmax 0 1023.984375 /end CHARACTERISTIC
/begin COMPU_METHOD Compu_EGR_clr_eta_dTmax " " RAT_FUNC "%.3" "deg F" COEFFS 0 64 0 0 0 1 /end COMPU_METHOD
/begin CHARACTERISTIC PPEG_BP_fault "IOConfig # PPEG_BP_fault (Fault Condition:abs(BP offset) sample >)" VALUE 0x001c7e4c /* @ECU_Address@PPEG_BP_fault@0x0100F300@ */ ECIPP_ALIGNMENT_UWORD 256 Compu_PPEG_BP_fault 0 255.99609375 /end CHARACTERISTIC
/begin COMPU_METHOD Compu_PPEG_BP_fault " " RAT_FUNC "%.3" "psi" COEFFS 0 256 0 0 0 1 /end COMPU_METHOD
/begin CHARACTERISTIC PPEG_EBP_fault "IOConfig # PPEG_EBP_fault (Fault Condition:abs(EBP offset) sample >)" VALUE 0x001c7e52 /* @ECU_Address@PPEG_EBP_fault@0x0100F308@ */ ECIPP_ALIGNMENT_UWORD 256 Compu_PPEG_EBP_fault 0 255.99609375 /end CHARACTERISTIC
/begin COMPU_METHOD Compu_PPEG_EBP_fault " " RAT_FUNC "%.3" "psi" COEFFS 0 256 0 0 0 1 /end COMPU_METHOD
/begin CHARACTERISTIC PPEG_EGRLP_fault "IOConfig # PPEG_EGRLP_fault (Fault Condition:abs(EGRLP offset) sample >)" VALUE 0x001c0a0e /* @ECU_Address@PPEG_EGRLP_fault@0x0100F310@ */ ECIPP_ALIGNMENT_UWORD 256 Compu_PPEG_EGRLP_fault 0 255.99609375 /end CHARACTERISTIC
/begin COMPU_METHOD Compu_PPEG_EGRLP_fault " " RAT_FUNC "%.3" "psi" COEFFS 0 256 0 0 0 1 /end COMPU_METHOD
/begin CHARACTERISTIC PPEG_EGRHP_fault "IOConfig # PPEG_EGRHP_fault (Fault Condition:abs(EGRHP offset) sample >)" VALUE 0x001c0a0c /* @ECU_Address@PPEG_EGRHP_fault@0x0100F318@ */ ECIPP_ALIGNMENT_UWORD 256 Compu_PPEG_EGRHP_fault 0 255.99609375 /end CHARACTERISTIC
/begin COMPU_METHOD Compu_PPEG_EGRHP_fault " " RAT_FUNC "%.3" "psi" COEFFS 0 256 0 0 0 1 /end COMPU_METHOD
/begin CHARACTERISTIC PPEG_TIP_fault "IOConfig # PPEG_TIP_fault (Fault Condition:abs(TIP offset) sample >)" VALUE 0x001c7e56 /* @ECU_Address@PPEG_TIP_fault@0x0100F320@ */ ECIPP_ALIGNMENT_UWORD 256 Compu_PPEG_TIP_fault 0 255.99609375 /end CHARACTERISTIC
/begin COMPU_METHOD Compu_PPEG_TIP_fault " " RAT_FUNC "%.3" "psi" COEFFS 0 256 0 0 0 1 /end COMPU_METHOD
/begin CHARACTERISTIC PPEG_EGRwrP_fault "IOConfig # PPEG_EGRwrP_fault (Fault Condition:abs(EGRwrP offset) sample >)" VALUE 0x001c0a10 /* @ECU_Address@PPEG_EGRwrP_fault@0x0100F328@ */ ECIPP_ALIGNMENT_UWORD 256 Compu_PPEG_EGRwrP_fault 0 255.99609375 /end CHARACTERISTIC
/begin COMPU_METHOD Compu_PPEG_EGRwrP_fault " " RAT_FUNC "%.3" "psi" COEFFS 0 256 0 0 0 1 /end COMPU_METHOD
/begin CHARACTERISTIC PPEG_MAP_fault "IOConfig # PPEG_MAP_fault (Fault Condition:(>=2) are out-of-range and agree within <)" VALUE 0x001c7e54 /* @ECU_Address@PPEG_MAP_fault@0x0100F330@ */ ECIPP_ALIGNMENT_UWORD 256 Compu_PPEG_MAP_fault 0 255.99609375 /end CHARACTERISTIC
/begin COMPU_METHOD Compu_PPEG_MAP_fault " " RAT_FUNC "%.3" "psi" COEFFS 0 256 0 0 0 1 /end COMPU_METHOD
/begin CHARACTERISTIC CFV_mdot_pct_rms "Fuel # CFV_mdot_pct_rms (Fault Condition:(actual flow - commanded flow) RMS >)" VALUE 0x001c6dfe /* @ECU_Address@CFV_mdot_pct_rms@0x0100F400@ */ ECIPP_ALIGNMENT_UWORD 400 Compu_CFV_mdot_pct_rms 0 399.993896484375 /end CHARACTERISTIC
/begin COMPU_METHOD Compu_CFV_mdot_pct_rms " " RAT_FUNC "%.3" "%" COEFFS 0 163.84 0 0 0 1 /end COMPU_METHOD
/begin CHARACTERISTIC CL_phi_hi "Fuel # CL_phi_hi (Fault Condition:Postcat phi >)" VALUE 0x001c6e1c /* @ECU_Address@CL_phi_hi@0x0100F408@ */ ECIPP_ALIGNMENT_UWORD 4 Compu_CL_phi_hi 0 3.99993896484375 /end CHARACTERISTIC
/begin COMPU_METHOD Compu_CL_phi_hi " " RAT_FUNC "%.3" "phi" COEFFS 0 16384 0 0 0 1 /end COMPU_METHOD
/begin CHARACTERISTIC CL_phi_lo "Fuel # CL_phi_lo (Fault Condition:Postcat phi <)" VALUE 0x001c6e26 /* @ECU_Address@CL_phi_lo@0x0100F410@ */ ECIPP_ALIGNMENT_UWORD 4 Compu_CL_phi_lo 0 3.99993896484375 /end CHARACTERISTIC
/begin COMPU_METHOD Compu_CL_phi_lo " " RAT_FUNC "%.3" "phi" COEFFS 0 16384 0 0 0 1 /end COMPU_METHOD
/begin CHARACTERISTIC CL_phi_lmt_RPMmin "FaultConfig # CL_phi_lmt_RPMmin (Fault Condition:and RPM >=)" VALUE 0x001c6e24 /* @ECU_Address@CL_phi_lmt_RPMmin@0x0100F418@ */ ECIPP_ALIGNMENT_UWORD 65535 Compu_CL_phi_lmt_RPMmin 0 65535 /end CHARACTERISTIC
/begin COMPU_METHOD Compu_CL_phi_lmt_RPMmin " " RAT_FUNC "%.0" "rpm" COEFFS 0 1 0 0 0 1 /end COMPU_METHOD
/begin CHARACTERISTIC CL_phi_lmt_RPMmax "FaultConfig # CL_phi_lmt_RPMmax (Fault Condition:and RPM <=)" VALUE 0x001c6e22 /* @ECU_Address@CL_phi_lmt_RPMmax@0x0100F420@ */ ECIPP_ALIGNMENT_UWORD 65535 Compu_CL_phi_lmt_RPMmax 0 65535 /end CHARACTERISTIC
/begin COMPU_METHOD Compu_CL_phi_lmt_RPMmax " " RAT_FUNC "%.0" "rpm" COEFFS 0 1 0 0 0 1 /end COMPU_METHOD
/begin CHARACTERISTIC CL_phi_lmt_MAPmin "FaultConfig # CL_phi_lmt_MAPmin (Fault Condition:and MAP >=)" VALUE 0x001c6e20 /* @ECU_Address@CL_phi_lmt_MAPmin@0x0100F428@ */ ECIPP_ALIGNMENT_UWORD 256 Compu_CL_phi_lmt_MAPmin 0 255.99609375 /end CHARACTERISTIC
/begin COMPU_METHOD Compu_CL_phi_lmt_MAPmin " " RAT_FUNC "%.3" "psia" COEFFS 0 256 0 0 0 1 /end COMPU_METHOD
/begin CHARACTERISTIC CL_phi_lmt_MAPmax "FaultConfig # CL_phi_lmt_MAPmax (Fault Condition:and MAP <=)" VALUE 0x001c6e1e /* @ECU_Address@CL_phi_lmt_MAPmax@0x0100F430@ */ ECIPP_ALIGNMENT_UWORD 256 Compu_CL_phi_lmt_MAPmax 0 255.99609375 /end CHARACTERISTIC
/begin COMPU_METHOD Compu_CL_phi_lmt_MAPmax " " RAT_FUNC "%.3" "psia" COEFFS 0 256 0 0 0 1 /end COMPU_METHOD
/begin CHARACTERISTIC TPSerr_run_mode "{TPSerr_run_mode&0xff=0:Stopped}{TPSerr_run_mode&0xff=1:Cranking}{TPSerr_run_mode&0xff=2:Underspeed}{TPSerr_run_mode&0xff=3:Running} (Fault Condition:and run mode >)" VALUE 0x001C9C7A /* @ECU_Address@TPSerr_run_mode@0x0100F448@ */ ECIPP_ALIGNMENT_UBYTE 255 TPSerr_run_mode_COMPU_VTAB 0 255 BIT_MASK 0xff /end CHARACTERISTIC
/begin COMPU_METHOD TPSerr_run_mode_COMPU_VTAB "Verbal Table" TAB_VERB "%.0" "list" COMPU_TAB_REF TPSerr_run_mode_COMPU_VTAB_REF /end COMPU_METHOD
/begin COMPU_VTAB TPSerr_run_mode_COMPU_VTAB_REF "Verbal Table" TAB_VERB 4 0 "Stopped" 1 "Cranking" 2 "Underspeed" 3 "Running" DEFAULT_VALUE "UNKNOWN" /end COMPU_VTAB
/begin CHARACTERISTIC APSerr_run_mode "{APSerr_run_mode&0xff=0:Stopped}{APSerr_run_mode&0xff=1:Cranking}{APSerr_run_mode&0xff=2:Underspeed}{APSerr_run_mode&0xff=3:Running} (Fault Condition:and run mode >)" VALUE 0x001C9E4E /* @ECU_Address@APSerr_run_mode@0x0100F450@ */ ECIPP_ALIGNMENT_UBYTE 255 APSerr_run_mode_COMPU_VTAB 0 255 BIT_MASK 0xff /end CHARACTERISTIC
/begin COMPU_METHOD APSerr_run_mode_COMPU_VTAB "Verbal Table" TAB_VERB "%.0" "list" COMPU_TAB_REF APSerr_run_mode_COMPU_VTAB_REF /end COMPU_METHOD
/begin COMPU_VTAB APSerr_run_mode_COMPU_VTAB_REF "Verbal Table" TAB_VERB 4 0 "Stopped" 1 "Cranking" 2 "Underspeed" 3 "Running" DEFAULT_VALUE "UNKNOWN" /end COMPU_VTAB
/end MODULE
/end PROJECT
