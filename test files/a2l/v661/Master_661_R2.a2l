ASAP2_VERSION 1 61
/begin PROJECT Econtrols_4G "4G Test"
/begin HEADER "4G A2L Configuration" PROJECT_NO EControls4G /* config for version control */ VERSION "$Revision: 82130 $:" /* config for version control */ /end HEADER
/begin MODULE EControls_4G_SH2A "EControls 4G"
/begin MOD_COMMON "" DEPOSIT ABSOLUTE BYTE_ORDER MSB_FIRST /end MOD_COMMON
/* Define the Record Layouts */
/begin RECORD_LAYOUT ECIPP_ALIGNMENT_UBYTE FNC_VALUES 1 UBYTE COLUMN_DIR DIRECT /end RECORD_LAYOUT
/begin RECORD_LAYOUT ECIPP_ALIGNMENT_UWORD FNC_VALUES 1 UWORD COLUMN_DIR DIRECT /end RECORD_LAYOUT
/begin RECORD_LAYOUT ECIPP_ALIGNMENT_SWORD FNC_VALUES 1 SWORD COLUMN_DIR DIRECT /end RECORD_LAYOUT
/begin RECORD_LAYOUT ECIPP_Lookup_SWORD AXIS_PTS_X 1 SWORD INDEX_INCR DIRECT /end RECORD_LAYOUT
/begin RECORD_LAYOUT ECIPP_ALIGNMENT_ULONG FNC_VALUES 1 ULONG COLUMN_DIR DIRECT /end RECORD_LAYOUT
/begin CHARACTERISTIC FPPTPSnl_ena "FPP->TPS non-linear mode{FPPTPSnl_ena&0xff=0:Disabled}{FPPTPSnl_ena&0xff=1:Enabled - Option1}{FPPTPSnl_ena&0xff=2:Enabled - Option2}{FPPTPSnl_ena&0xff=3:Enabled - Option3}{FPPTPSnl_ena&0xff=4:Enabled - Aux PU1=Opt1/2}{FPPTPSnl_ena&0xff=5:Enabled - Aux PU2" VALUE 0x001c871e /* @ECU_Address@FPPTPSnl_ena@0x010010C8@ */ ECIPP_ALIGNMENT_UBYTE 255 FPPTPSnl_ena_COMPU_VTAB 0 255 BIT_MASK 0xff /end CHARACTERISTIC
/begin COMPU_METHOD FPPTPSnl_ena_COMPU_VTAB "Verbal Table" TAB_VERB "%.0" "list" COMPU_TAB_REF FPPTPSnl_ena_COMPU_VTAB_REF /end COMPU_METHOD
/begin COMPU_VTAB FPPTPSnl_ena_COMPU_VTAB_REF "Verbal Table" TAB_VERB 17 0 "Disabled" 1 "Enabled - Option1" 2 "Enabled - Option2" 3 "Enabled - Option3" 4 "Enabled - Aux PU1=Opt1/2" 5 "Enabled - Aux PU2=Opt1/2" 6 "Enabled - Aux PU3=Opt1/2" 7 "Enabled - Aux DIG1=Opt1/2/3" 8 "Enabled - Aux DIG2=Opt1/2/3" 9 "Enabled - Aux DIG3=Opt1/2/3" 10 "Enabled - Transmission Selected" 11 "Enabled - Use As 3-Point Table" 12 "Enabled - Use 2D Table" 13 "Network - Default Disabled" 14 "Network - Default Option1" 15 "Network - Default Option2" 16 "Network - Default Option3" DEFAULT_VALUE "UNKNOWN" /end COMPU_VTAB
/begin CHARACTERISTIC FPPTPSnl_FPP "Option1 non-linear FPP point" VALUE 0x001C80D2 /* @ECU_Address@FPPTPSnl_FPP@0x010010D0@ */ ECIPP_ALIGNMENT_UWORD 100 Compu_FPPTPSnl_FPP 0 99.9984741210938 /end CHARACTERISTIC
/begin COMPU_METHOD Compu_FPPTPSnl_FPP " " RAT_FUNC "%.1" "%" COEFFS 0 655.36 0 0 0 1 /end COMPU_METHOD
/begin CHARACTERISTIC FPPTPSnl_TPS "Option1 non-linear TPS point" VALUE 0x001C80D8 /* @ECU_Address@FPPTPSnl_TPS@0x010010D8@ */ ECIPP_ALIGNMENT_UWORD 100 Compu_FPPTPSnl_TPS 0 99.9984741210938 /end CHARACTERISTIC
/begin COMPU_METHOD Compu_FPPTPSnl_TPS " " RAT_FUNC "%.1" "%" COEFFS 0 655.36 0 0 0 1 /end COMPU_METHOD
/begin CHARACTERISTIC ESM_ena "ESM management system{ESM_ena&0xff=0:Disabled}{ESM_ena&0xff=1:Enabled}" VALUE 0x001c86f1 /* @ECU_Address@ESM_ena@0x01002EC0@ */ ECIPP_ALIGNMENT_UBYTE 255 ESM_ena_COMPU_VTAB 0 255 BIT_MASK 0xff /end CHARACTERISTIC
/begin COMPU_METHOD ESM_ena_COMPU_VTAB "Verbal Table" TAB_VERB "%.0" "list" COMPU_TAB_REF ESM_ena_COMPU_VTAB_REF /end COMPU_METHOD
/begin COMPU_VTAB ESM_ena_COMPU_VTAB_REF "Verbal Table" TAB_VERB 2 0 "Disabled" 1 "Enabled" DEFAULT_VALUE "UNKNOWN" /end COMPU_VTAB
/begin CHARACTERISTIC ESM_dly "ESM engagement delay" VALUE 0x001c6f18 /* @ECU_Address@ESM_dly@0x01002EC8@ */ ECIPP_ALIGNMENT_UWORD 66 Compu_ESM_dly 0 65.535 /end CHARACTERISTIC
/begin COMPU_METHOD Compu_ESM_dly " " RAT_FUNC "%.1" "sec" COEFFS 0 1000 0 0 0 1 /end COMPU_METHOD
/begin CHARACTERISTIC ESM_0pwf_load "ESM 0% power load" VALUE 0x001c6f0e /* @ECU_Address@ESM_0pwf_load@0x01002ED0@ */ ECIPP_ALIGNMENT_UWORD 100 Compu_ESM_0pwf_load 0 99.9984741210938 /end CHARACTERISTIC
/begin COMPU_METHOD Compu_ESM_0pwf_load " " RAT_FUNC "%.1" "% load" COEFFS 0 655.36 0 0 0 1 /end COMPU_METHOD
/begin CHARACTERISTIC ESM_1pwf_load "ESM 100% power load" VALUE 0x001c6f12 /* @ECU_Address@ESM_1pwf_load@0x01002ED8@ */ ECIPP_ALIGNMENT_UWORD 100 Compu_ESM_1pwf_load 0 99.9984741210938 /end CHARACTERISTIC
/begin COMPU_METHOD Compu_ESM_1pwf_load " " RAT_FUNC "%.1" "% load" COEFFS 0 655.36 0 0 0 1 /end COMPU_METHOD
/begin CHARACTERISTIC ESM_0pwf_dRPM "ESM 0% power delta-idle RPM" VALUE 0x001c6f0c /* @ECU_Address@ESM_0pwf_dRPM@0x01002EE0@ */ ECIPP_ALIGNMENT_UWORD 65535 Compu_ESM_0pwf_dRPM 0 65535 /end CHARACTERISTIC
/begin COMPU_METHOD Compu_ESM_0pwf_dRPM " " RAT_FUNC "%.0" "delta-rpm" COEFFS 0 1 0 0 0 1 /end COMPU_METHOD
/begin CHARACTERISTIC ESM_1pwf_RPM "ESM 100% power RPM" VALUE 0x001c6f10 /* @ECU_Address@ESM_1pwf_RPM@0x01002EE8@ */ ECIPP_ALIGNMENT_UWORD 65535 Compu_ESM_1pwf_RPM 0 65535 /end CHARACTERISTIC
/begin COMPU_METHOD Compu_ESM_1pwf_RPM " " RAT_FUNC "%.0" "rpm" COEFFS 0 1 0 0 0 1 /end COMPU_METHOD
/begin CHARACTERISTIC ESM_fast_rpmdt "Idle-return 0% power (fast) rate-limit" VALUE 0x001c6f1c /* @ECU_Address@ESM_fast_rpmdt@0x01002EF0@ */ ECIPP_ALIGNMENT_UWORD 127998 Compu_ESM_fast_rpmdt 0 127998.046875 /end CHARACTERISTIC
/begin COMPU_METHOD Compu_ESM_fast_rpmdt " " RAT_FUNC "%.0" "rpm/sec" COEFFS 0 0.512 0 0 0 1 /end COMPU_METHOD
/begin CHARACTERISTIC ESM_slow_rpmdt "Idle-return 100% power (slow) rate-limit" VALUE 0x001c6f26 /* @ECU_Address@ESM_slow_rpmdt@0x01002EF8@ */ ECIPP_ALIGNMENT_UWORD 127998 Compu_ESM_slow_rpmdt 0 127998.046875 /end CHARACTERISTIC
/begin COMPU_METHOD Compu_ESM_slow_rpmdt " " RAT_FUNC "%.0" "rpm/sec" COEFFS 0 0.512 0 0 0 1 /end COMPU_METHOD
/begin CHARACTERISTIC ESM_Ilim_max "Idle-return gov integrator limit" VALUE 0x001c44b0 /* @ECU_Address@ESM_Ilim_max@0x01002F00@ */ ECIPP_ALIGNMENT_SWORD 800 Compu_ESM_Ilim_max -800 799.9755859375 /end CHARACTERISTIC
/begin COMPU_METHOD Compu_ESM_Ilim_max " " RAT_FUNC "%.1" "load%" COEFFS 0 40.96 0 0 0 1 /end COMPU_METHOD
/begin CHARACTERISTIC ESM_gov_auth "Idle-return gov authority limit" VALUE 0x001c6f1e /* @ECU_Address@ESM_gov_auth@0x01002F08@ */ ECIPP_ALIGNMENT_UWORD 100 Compu_ESM_gov_auth 0 99.9984741210938 /end CHARACTERISTIC
/begin COMPU_METHOD Compu_ESM_gov_auth " " RAT_FUNC "%.1" "load%" COEFFS 0 655.36 0 0 0 1 /end COMPU_METHOD
/begin MEASUREMENT ESM_active "ESM state{ESM_active&0xff=0:Inactive}{ESM_active&0xff=1:Active}" UBYTE ESM_active_COMPU_VTAB 0 0 0 255 ECU_ADDRESS 0x01002F20 BIT_MASK 0xff /end MEASUREMENT
/begin COMPU_METHOD ESM_active_COMPU_VTAB "Verbal Table" TAB_VERB "%.0" "list" COMPU_TAB_REF ESM_active_COMPU_VTAB_REF /end COMPU_METHOD
/begin COMPU_VTAB ESM_active_COMPU_VTAB_REF "Verbal Table" TAB_VERB 2 0 "Inactive" 1 "Active" DEFAULT_VALUE "UNKNOWN" /end COMPU_VTAB
/begin MEASUREMENT ESM_rpmdtd "Idle-return target rate-limit" UWORD Compu_ESM_rpmdtd 0 0 0 127998.046875 ECU_ADDRESS 0x01002F28 /end MEASUREMENT
/begin COMPU_METHOD Compu_ESM_rpmdtd " " RAT_FUNC "%.0" "rpm/sec" COEFFS 0 0.512 0 0 0 1 /end COMPU_METHOD
/begin MEASUREMENT ESM_pwr_inst "ESM instantaneous power-factor" UWORD Compu_ESM_pwr_inst 0 0 0 99.9984741210938 ECU_ADDRESS 0x01002F30 /end MEASUREMENT
/begin COMPU_METHOD Compu_ESM_pwr_inst " " RAT_FUNC "%.1" "%" COEFFS 0 655.36 0 0 0 1 /end COMPU_METHOD
/begin CHARACTERISTIC ESM_Kd "Idle-return Kd" VALUE 0x001c44b2 /* @ECU_Address@ESM_Kd@0x01002F38@ */ ECIPP_ALIGNMENT_SWORD 1600 Compu_ESM_Kd -1600 1599.951171875 /end CHARACTERISTIC
/begin COMPU_METHOD Compu_ESM_Kd " " RAT_FUNC "%.1" "%/(Krpm/sec)" COEFFS 0 20.48 0 0 0 1 /end COMPU_METHOD
/begin CHARACTERISTIC ESM_Kiv "Idle-return Kiv" VALUE 0x001c44b4 /* @ECU_Address@ESM_Kiv@0x01002F40@ */ ECIPP_ALIGNMENT_SWORD 3125 Compu_ESM_Kiv -3125 3124.90463256836 /end CHARACTERISTIC
/begin COMPU_METHOD Compu_ESM_Kiv " " RAT_FUNC "%.0" "%/Krpm" COEFFS 0 10.48576 0 0 0 1 /end COMPU_METHOD
/begin CHARACTERISTIC ESM_rpmdtdz "Idle-return rpmdt dead-zone" VALUE 0x001c44b6 /* @ECU_Address@ESM_rpmdtdz@0x01002F48@ */ ECIPP_ALIGNMENT_SWORD 63998 Compu_ESM_rpmdtdz -64000 63998.046875 /end CHARACTERISTIC
/begin COMPU_METHOD Compu_ESM_rpmdtdz " " RAT_FUNC "%.0" "rpm/sec" COEFFS 0 0.512 0 0 0 1 /end COMPU_METHOD
/begin CHARACTERISTIC ESM_TPSLP "Idle-return output low-pass" VALUE 0x001c852e /* @ECU_Address@ESM_TPSLP@0x01002F50@ */ ECIPP_ALIGNMENT_UWORD 327680 Compu_ESM_TPSLP 0.45084 327680 /end CHARACTERISTIC
/begin COMPU_METHOD Compu_ESM_TPSLP " " FORM "%.1" "ms"
 /begin FORMULA "-5 / log(1 - (X1 / 65536))" FORMULA_INV "(1 - exp(-5/X1)) * 65536" /end FORMULA
/end COMPU_METHOD
/begin CHARACTERISTIC EGT_dig_test "EGT sensor configuration{EGT_dig_test&0xff=0x00:Ground = OK}{EGT_dig_test&0xff=0x01:Open = OK} (Fault Condition:EGT temperature pulled-up input)" VALUE 0x001c86de /* @ECU_Address@EGT_dig_test@0x010034D0@ */ ECIPP_ALIGNMENT_UBYTE 255 EGT_dig_test_COMPU_VTAB 0 255 BIT_MASK 0xff /end CHARACTERISTIC
/begin COMPU_METHOD EGT_dig_test_COMPU_VTAB "Verbal Table" TAB_VERB "%.0" "list" COMPU_TAB_REF EGT_dig_test_COMPU_VTAB_REF /end COMPU_METHOD
/begin COMPU_VTAB EGT_dig_test_COMPU_VTAB_REF "Verbal Table" TAB_VERB 2 0x00 "Ground = OK" 0x01 "Open = OK" DEFAULT_VALUE "UNKNOWN" /end COMPU_VTAB
/begin CHARACTERISTIC EGT_Hi_wait "EGT diagnostic start wait (Fault Condition:and run time >)" VALUE 0x001c4298 /* @ECU_Address@EGT_Hi_wait@0x010034D8@ */ ECIPP_ALIGNMENT_ULONG 4294967 Compu_EGT_Hi_wait 0 4294967.295 /end CHARACTERISTIC
/begin COMPU_METHOD Compu_EGT_Hi_wait " " RAT_FUNC "%.1" "sec" COEFFS 0 1000 0 0 0 1 /end COMPU_METHOD
/begin CHARACTERISTIC EGT_dig_trig "EGT sensor threshold (Fault Condition:a threshold voltage of)" VALUE 0x001c6f08 /* @ECU_Address@EGT_dig_trig@0x010034E0@ */ ECIPP_ALIGNMENT_UWORD 256 Compu_EGT_dig_trig 0 255.99609375 /end CHARACTERISTIC
/begin COMPU_METHOD Compu_EGT_dig_trig " " RAT_FUNC "%.2" "volts" COEFFS 0 256 0 0 0 1 /end COMPU_METHOD
/begin MEASUREMENT EGT_dig_state "EGT temperature state{EGT_dig_state&0xff=0x00:OK}{EGT_dig_state&0xff=0x01:High - Ignored}{EGT_dig_state&0xff=0x02:High}" UBYTE EGT_dig_state_COMPU_VTAB 0 0 0 255 ECU_ADDRESS 0x010034E8 BIT_MASK 0xff /end MEASUREMENT
/begin COMPU_METHOD EGT_dig_state_COMPU_VTAB "Verbal Table" TAB_VERB "%.0" "list" COMPU_TAB_REF EGT_dig_state_COMPU_VTAB_REF /end COMPU_METHOD
/begin COMPU_VTAB EGT_dig_state_COMPU_VTAB_REF "Verbal Table" TAB_VERB 3 0x00 "OK" 0x01 "High - Ignored" 0x02 "High" DEFAULT_VALUE "UNKNOWN" /end COMPU_VTAB
/begin MEASUREMENT EGT_volt "EGT input voltage" UWORD Compu_EGT_volt 0 0 0 255.99609375 ECU_ADDRESS 0x010034F0 /end MEASUREMENT
/begin COMPU_METHOD Compu_EGT_volt " " RAT_FUNC "%.2" "volts" COEFFS 0 256 0 0 0 1 /end COMPU_METHOD
/begin MEASUREMENT ME0mstr_actv "Master comm activity{ME0mstr_actv&0x80=0x00:Comm Lost}{ME0mstr_actv&0x80=0x80:Comm Active}" UBYTE ME0mstr_actv_COMPU_VTAB 0 0 0 255 ECU_ADDRESS 0x01003598 BIT_MASK 0xFF /end MEASUREMENT
/begin COMPU_METHOD ME0mstr_actv_COMPU_VTAB "Verbal Table" TAB_VERB "%.0" "list" COMPU_TAB_REF ME0mstr_actv_COMPU_VTAB_REF /end COMPU_METHOD
/begin COMPU_VTAB ME0mstr_actv_COMPU_VTAB_REF "Verbal Table" TAB_VERB 2 0x00 "Comm Lost" 0x80 "Comm Active" DEFAULT_VALUE "Unsupported Bit_Shift" /end COMPU_VTAB
/begin MEASUREMENT ME0mstr_sync "Master sync mode{ME0mstr_sync&0x70=0x00:None}{ME0mstr_sync&0x70=0x10:RPM}{ME0mstr_sync&0x70=0x20:FPP}{ME0mstr_sync&0x70=0x30:Eng Stop}{ME0mstr_sync&0x70=0x40:Match}" UBYTE ME0mstr_sync_COMPU_VTAB 0 0 0 255 ECU_ADDRESS 0x010035A0 BIT_MASK 0x70 /end MEASUREMENT
/begin COMPU_METHOD ME0mstr_sync_COMPU_VTAB "Verbal Table" TAB_VERB "%.0" "list" COMPU_TAB_REF ME0mstr_sync_COMPU_VTAB_REF /end COMPU_METHOD
/begin COMPU_VTAB ME0mstr_sync_COMPU_VTAB_REF "Verbal Table" TAB_VERB 5 0x00 "None" 0x10 "RPM" 0x20 "FPP" 0x30 "Eng Stop" 0x40 "Match" DEFAULT_VALUE "UNKNOWN" /end COMPU_VTAB
/begin MEASUREMENT ME0mstr_stat "Master status" UBYTE Compu_ME0mstr_stat 0 0 0 255 ECU_ADDRESS 0x010035A8 /end MEASUREMENT
/begin COMPU_METHOD Compu_ME0mstr_stat " " RAT_FUNC "%.0" "-" COEFFS 0 1 0 0 0 1 /end COMPU_METHOD
/begin MEASUREMENT ME0mstr_rpmd "Master speed command" UWORD Compu_ME0mstr_rpmd 0 0 0 65535 ECU_ADDRESS 0x010035B0 /end MEASUREMENT
/begin COMPU_METHOD Compu_ME0mstr_rpmd " " RAT_FUNC "%.0" "rpm" COEFFS 0 1 0 0 0 1 /end COMPU_METHOD
/begin MEASUREMENT ME0mstr_FPP "Master FPP" UBYTE Compu_ME0mstr_FPP 0 0 0 99.609375 ECU_ADDRESS 0x010035B8 /end MEASUREMENT
/begin COMPU_METHOD Compu_ME0mstr_FPP " " RAT_FUNC "%.0" "%" COEFFS 0 2.56 0 0 0 1 /end COMPU_METHOD
/begin MEASUREMENT ME0mstr_ECT "Master ECT" UBYTE Compu_ME0mstr_ECT 0 0 -40 291.5 ECU_ADDRESS 0x010035C8 /end MEASUREMENT
/begin COMPU_METHOD Compu_ME0mstr_ECT " " RAT_FUNC "%.0" "deg F" COEFFS 0 0.769230769230769 30.7692307692308 0 0 1 /end COMPU_METHOD
/begin MEASUREMENT ME0mstr_OILP "Master oil pressure" UBYTE Compu_ME0mstr_OILP 0 0 0 255 ECU_ADDRESS 0x010035D0 /end MEASUREMENT
/begin COMPU_METHOD Compu_ME0mstr_OILP " " RAT_FUNC "%.0" "psig" COEFFS 0 1 0 0 0 1 /end COMPU_METHOD
/begin MEASUREMENT ME0slv1_actv "Slave1 comm activity{ME0slv1_actv&0x80=0x00:Comm Lost}{ME0slv1_actv&0x80=0x80:Comm Active}" UBYTE ME0slv1_actv_COMPU_VTAB 0 0 0 255 ECU_ADDRESS 0x010035D8 BIT_MASK 0xFF /end MEASUREMENT
/begin COMPU_METHOD ME0slv1_actv_COMPU_VTAB "Verbal Table" TAB_VERB "%.0" "list" COMPU_TAB_REF ME0slv1_actv_COMPU_VTAB_REF /end COMPU_METHOD
/begin COMPU_VTAB ME0slv1_actv_COMPU_VTAB_REF "Verbal Table" TAB_VERB 2 0x00 "Comm Lost" 0x80 "Comm Active" DEFAULT_VALUE "Unsupported Bit_Shift" /end COMPU_VTAB
/begin MEASUREMENT ME0slv1_sync "Slave1 sync mode{ME0slv1_sync&0x70=0x00:None}{ME0slv1_sync&0x70=0x10:RPM}{ME0slv1_sync&0x70=0x20:FPP}{ME0slv1_sync&0x70=0x30:Eng Stop}{ME0slv1_sync&0x70=0x40:Match}" UBYTE ME0slv1_sync_COMPU_VTAB 0 0 0 255 ECU_ADDRESS 0x010035E0 BIT_MASK 0x70 /end MEASUREMENT
/begin COMPU_METHOD ME0slv1_sync_COMPU_VTAB "Verbal Table" TAB_VERB "%.0" "list" COMPU_TAB_REF ME0slv1_sync_COMPU_VTAB_REF /end COMPU_METHOD
/begin COMPU_VTAB ME0slv1_sync_COMPU_VTAB_REF "Verbal Table" TAB_VERB 5 0x00 "None" 0x10 "RPM" 0x20 "FPP" 0x30 "Eng Stop" 0x40 "Match" DEFAULT_VALUE "UNKNOWN" /end COMPU_VTAB
/begin MEASUREMENT ME0slv1_stat "Slave1 status" UBYTE Compu_ME0slv1_stat 0 0 0 255 ECU_ADDRESS 0x010035E8 /end MEASUREMENT
/begin COMPU_METHOD Compu_ME0slv1_stat " " RAT_FUNC "%.0" "-" COEFFS 0 1 0 0 0 1 /end COMPU_METHOD
/begin MEASUREMENT ME0slv1_rpmd "Slave1 speed command" UWORD Compu_ME0slv1_rpmd 0 0 0 65535 ECU_ADDRESS 0x010035F0 /end MEASUREMENT
/begin COMPU_METHOD Compu_ME0slv1_rpmd " " RAT_FUNC "%.0" "rpm" COEFFS 0 1 0 0 0 1 /end COMPU_METHOD
/begin MEASUREMENT ME0slv1_FPP "Slave1 FPP" UBYTE Compu_ME0slv1_FPP 0 0 0 99.609375 ECU_ADDRESS 0x010035F8 /end MEASUREMENT
/begin COMPU_METHOD Compu_ME0slv1_FPP " " RAT_FUNC "%.0" "%" COEFFS 0 2.56 0 0 0 1 /end COMPU_METHOD
/begin MEASUREMENT ME0slv1_ECT "Slave1 ECT" UBYTE Compu_ME0slv1_ECT 0 0 -40 291.5 ECU_ADDRESS 0x01003608 /end MEASUREMENT
/begin COMPU_METHOD Compu_ME0slv1_ECT " " RAT_FUNC "%.0" "deg F" COEFFS 0 0.769230769230769 30.7692307692308 0 0 1 /end COMPU_METHOD
/begin MEASUREMENT ME0slv1_OILP "Slave1 oil pressure" UBYTE Compu_ME0slv1_OILP 0 0 0 255 ECU_ADDRESS 0x01003610 /end MEASUREMENT
/begin COMPU_METHOD Compu_ME0slv1_OILP " " RAT_FUNC "%.0" "psig" COEFFS 0 1 0 0 0 1 /end COMPU_METHOD
/begin MEASUREMENT ME0slv2_actv "Slave2 comm activity{ME0slv2_actv&0x80=0x00:Comm Lost}{ME0slv2_actv&0x80=0x80:Comm Active}" UBYTE ME0slv2_actv_COMPU_VTAB 0 0 0 255 ECU_ADDRESS 0x01003618 BIT_MASK 0xFF /end MEASUREMENT
/begin COMPU_METHOD ME0slv2_actv_COMPU_VTAB "Verbal Table" TAB_VERB "%.0" "list" COMPU_TAB_REF ME0slv2_actv_COMPU_VTAB_REF /end COMPU_METHOD
/begin COMPU_VTAB ME0slv2_actv_COMPU_VTAB_REF "Verbal Table" TAB_VERB 2 0x00 "Comm Lost" 0x80 "Comm Active" DEFAULT_VALUE "Unsupported Bit_Shift" /end COMPU_VTAB
/begin MEASUREMENT ME0slv2_sync "Slave2 sync mode{ME0slv2_sync&0x70=0x00:None}{ME0slv2_sync&0x70=0x10:RPM}{ME0slv2_sync&0x70=0x20:FPP}{ME0slv2_sync&0x70=0x30:Eng Stop}{ME0slv2_sync&0x70=0x40:Match}" UBYTE ME0slv2_sync_COMPU_VTAB 0 0 0 255 ECU_ADDRESS 0x01003620 BIT_MASK 0x70 /end MEASUREMENT
/begin COMPU_METHOD ME0slv2_sync_COMPU_VTAB "Verbal Table" TAB_VERB "%.0" "list" COMPU_TAB_REF ME0slv2_sync_COMPU_VTAB_REF /end COMPU_METHOD
/begin COMPU_VTAB ME0slv2_sync_COMPU_VTAB_REF "Verbal Table" TAB_VERB 5 0x00 "None" 0x10 "RPM" 0x20 "FPP" 0x30 "Eng Stop" 0x40 "Match" DEFAULT_VALUE "UNKNOWN" /end COMPU_VTAB
/begin MEASUREMENT ME0slv2_stat "Slave2 status" UBYTE Compu_ME0slv2_stat 0 0 0 255 ECU_ADDRESS 0x01003628 /end MEASUREMENT
/begin COMPU_METHOD Compu_ME0slv2_stat " " RAT_FUNC "%.0" "-" COEFFS 0 1 0 0 0 1 /end COMPU_METHOD
/begin MEASUREMENT ME0slv2_rpmd "Slave2 speed command" UWORD Compu_ME0slv2_rpmd 0 0 0 65535 ECU_ADDRESS 0x01003630 /end MEASUREMENT
/begin COMPU_METHOD Compu_ME0slv2_rpmd " " RAT_FUNC "%.0" "rpm" COEFFS 0 1 0 0 0 1 /end COMPU_METHOD
/begin MEASUREMENT ME0slv2_FPP "Slave2 FPP" UBYTE Compu_ME0slv2_FPP 0 0 0 99.609375 ECU_ADDRESS 0x01003638 /end MEASUREMENT
/begin COMPU_METHOD Compu_ME0slv2_FPP " " RAT_FUNC "%.0" "%" COEFFS 0 2.56 0 0 0 1 /end COMPU_METHOD
/begin MEASUREMENT ME0slv2_ECT "Slave2 ECT" UBYTE Compu_ME0slv2_ECT 0 0 -40 291.5 ECU_ADDRESS 0x01003648 /end MEASUREMENT
/begin COMPU_METHOD Compu_ME0slv2_ECT " " RAT_FUNC "%.0" "deg F" COEFFS 0 0.769230769230769 30.7692307692308 0 0 1 /end COMPU_METHOD
/begin MEASUREMENT ME0slv2_OILP "Slave2 oil pressure" UBYTE Compu_ME0slv2_OILP 0 0 0 255 ECU_ADDRESS 0x01003650 /end MEASUREMENT
/begin COMPU_METHOD Compu_ME0slv2_OILP " " RAT_FUNC "%.0" "psig" COEFFS 0 1 0 0 0 1 /end COMPU_METHOD
/begin MEASUREMENT ME0slv3_actv "Slave3 comm activity{ME0slv3_actv&0x80=0x00:Comm Lost}{ME0slv3_actv&0x80=0x80:Comm Active}" UBYTE ME0slv3_actv_COMPU_VTAB 0 0 0 255 ECU_ADDRESS 0x01003658 BIT_MASK 0xFF /end MEASUREMENT
/begin COMPU_METHOD ME0slv3_actv_COMPU_VTAB "Verbal Table" TAB_VERB "%.0" "list" COMPU_TAB_REF ME0slv3_actv_COMPU_VTAB_REF /end COMPU_METHOD
/begin COMPU_VTAB ME0slv3_actv_COMPU_VTAB_REF "Verbal Table" TAB_VERB 2 0x00 "Comm Lost" 0x80 "Comm Active" DEFAULT_VALUE "Unsupported Bit_Shift" /end COMPU_VTAB
/begin MEASUREMENT ME0slv3_sync "Slave3 sync mode{ME0slv3_sync&0x70=0x00:None}{ME0slv3_sync&0x70=0x10:RPM}{ME0slv3_sync&0x70=0x20:FPP}{ME0slv3_sync&0x70=0x30:Eng Stop}{ME0slv3_sync&0x70=0x40:Match}" UBYTE ME0slv3_sync_COMPU_VTAB 0 0 0 255 ECU_ADDRESS 0x01003660 BIT_MASK 0x70 /end MEASUREMENT
/begin COMPU_METHOD ME0slv3_sync_COMPU_VTAB "Verbal Table" TAB_VERB "%.0" "list" COMPU_TAB_REF ME0slv3_sync_COMPU_VTAB_REF /end COMPU_METHOD
/begin COMPU_VTAB ME0slv3_sync_COMPU_VTAB_REF "Verbal Table" TAB_VERB 5 0x00 "None" 0x10 "RPM" 0x20 "FPP" 0x30 "Eng Stop" 0x40 "Match" DEFAULT_VALUE "UNKNOWN" /end COMPU_VTAB
/begin MEASUREMENT ME0slv3_stat "Slave3 status" UBYTE Compu_ME0slv3_stat 0 0 0 255 ECU_ADDRESS 0x01003668 /end MEASUREMENT
/begin COMPU_METHOD Compu_ME0slv3_stat " " RAT_FUNC "%.0" "-" COEFFS 0 1 0 0 0 1 /end COMPU_METHOD
/begin MEASUREMENT ME0slv3_rpmd "Slave3 speed command" UWORD Compu_ME0slv3_rpmd 0 0 0 65535 ECU_ADDRESS 0x01003670 /end MEASUREMENT
/begin COMPU_METHOD Compu_ME0slv3_rpmd " " RAT_FUNC "%.0" "rpm" COEFFS 0 1 0 0 0 1 /end COMPU_METHOD
/begin MEASUREMENT ME0slv3_FPP "Slave3 FPP" UBYTE Compu_ME0slv3_FPP 0 0 0 99.609375 ECU_ADDRESS 0x01003678 /end MEASUREMENT
/begin COMPU_METHOD Compu_ME0slv3_FPP " " RAT_FUNC "%.0" "%" COEFFS 0 2.56 0 0 0 1 /end COMPU_METHOD
/begin MEASUREMENT ME0slv3_ECT "Slave3 ECT" UBYTE Compu_ME0slv3_ECT 0 0 -40 291.5 ECU_ADDRESS 0x01003688 /end MEASUREMENT
/begin COMPU_METHOD Compu_ME0slv3_ECT " " RAT_FUNC "%.0" "deg F" COEFFS 0 0.769230769230769 30.7692307692308 0 0 1 /end COMPU_METHOD
/begin MEASUREMENT ME0slv3_OILP "Slave3 oil pressure" UBYTE Compu_ME0slv3_OILP 0 0 0 255 ECU_ADDRESS 0x01003690 /end MEASUREMENT
/begin COMPU_METHOD Compu_ME0slv3_OILP " " RAT_FUNC "%.0" "psig" COEFFS 0 1 0 0 0 1 /end COMPU_METHOD
/begin MEASUREMENT ME_DERATE1_active "Multi-engine Derate1{ME_DERATE1_active&0x01=0x00:Inactive}{ME_DERATE1_active&0x01=0x01:Active}" UBYTE ME_DERATE1_active_COMPU_VTAB 0 0 0 255 ECU_ADDRESS 0x01003698 BIT_MASK 0x01 /end MEASUREMENT
/begin COMPU_METHOD ME_DERATE1_active_COMPU_VTAB "Verbal Table" TAB_VERB "%.0" "list" COMPU_TAB_REF ME_DERATE1_active_COMPU_VTAB_REF /end COMPU_METHOD
/begin COMPU_VTAB ME_DERATE1_active_COMPU_VTAB_REF "Verbal Table" TAB_VERB 2 0x00 "Inactive" 0x01 "Active" DEFAULT_VALUE "UNKNOWN" /end COMPU_VTAB
/begin MEASUREMENT ME_DERATE2_active "Multi-engine Derate2{ME_DERATE2_active&0x01=0x00:Inactive}{ME_DERATE2_active&0x01=0x01:Active}" UBYTE ME_DERATE2_active_COMPU_VTAB 0 0 0 255 ECU_ADDRESS 0x010036A0 BIT_MASK 0x01 /end MEASUREMENT
/begin COMPU_METHOD ME_DERATE2_active_COMPU_VTAB "Verbal Table" TAB_VERB "%.0" "list" COMPU_TAB_REF ME_DERATE2_active_COMPU_VTAB_REF /end COMPU_METHOD
/begin COMPU_VTAB ME_DERATE2_active_COMPU_VTAB_REF "Verbal Table" TAB_VERB 2 0x00 "Inactive" 0x01 "Active" DEFAULT_VALUE "UNKNOWN" /end COMPU_VTAB
/begin MEASUREMENT ME_LOWREVLIM_active "Multi-engine Low rev limit{ME_LOWREVLIM_active&0x01=0x00:Inactive}{ME_LOWREVLIM_active&0x01=0x01:Active}" UBYTE ME_LOWREVLIM_active_COMPU_VTAB 0 0 0 255 ECU_ADDRESS 0x010036A8 BIT_MASK 0x01 /end MEASUREMENT
/begin COMPU_METHOD ME_LOWREVLIM_active_COMPU_VTAB "Verbal Table" TAB_VERB "%.0" "list" COMPU_TAB_REF ME_LOWREVLIM_active_COMPU_VTAB_REF /end COMPU_METHOD
/begin COMPU_VTAB ME_LOWREVLIM_active_COMPU_VTAB_REF "Verbal Table" TAB_VERB 2 0x00 "Inactive" 0x01 "Active" DEFAULT_VALUE "UNKNOWN" /end COMPU_VTAB
/begin CHARACTERISTIC ME_derate_ena "Multi-engine derate coordination{ME_derate_ena&0xff=0:Disabled}{ME_derate_ena&0xff=1:Enabled}" VALUE 0x001c8827 /* @ECU_Address@ME_derate_ena@0x010036B0@ */ ECIPP_ALIGNMENT_UBYTE 255 ME_derate_ena_COMPU_VTAB 0 255 BIT_MASK 0xff /end CHARACTERISTIC
/begin COMPU_METHOD ME_derate_ena_COMPU_VTAB "Verbal Table" TAB_VERB "%.0" "list" COMPU_TAB_REF ME_derate_ena_COMPU_VTAB_REF /end COMPU_METHOD
/begin COMPU_VTAB ME_derate_ena_COMPU_VTAB_REF "Verbal Table" TAB_VERB 2 0 "Disabled" 1 "Enabled" DEFAULT_VALUE "UNKNOWN" /end COMPU_VTAB
/begin CHARACTERISTIC ME_derate_resett "Multi-engine derate reset time" VALUE 0x001c7d80 /* @ECU_Address@ME_derate_resett@0x010036B8@ */ ECIPP_ALIGNMENT_UWORD 66 Compu_ME_derate_resett 0 65.535 /end CHARACTERISTIC
/begin COMPU_METHOD Compu_ME_derate_resett " " RAT_FUNC "%.1" "sec" COEFFS 0 1000 0 0 0 1 /end COMPU_METHOD
/begin MEASUREMENT ME_derate_state "Multi-engine derate logic state{ME_derate_state&0xff=0:Offline}{ME_derate_state&0xff=1:Monitoring}{ME_derate_state&0xff=2:Currently Active}{ME_derate_state&0xff=3:Previously Active}" UBYTE ME_derate_state_COMPU_VTAB 0 0 0 255 ECU_ADDRESS 0x010036C0 BIT_MASK 0xff /end MEASUREMENT
/begin COMPU_METHOD ME_derate_state_COMPU_VTAB "Verbal Table" TAB_VERB "%.0" "list" COMPU_TAB_REF ME_derate_state_COMPU_VTAB_REF /end COMPU_METHOD
/begin COMPU_VTAB ME_derate_state_COMPU_VTAB_REF "Verbal Table" TAB_VERB 4 0 "Offline" 1 "Monitoring" 2 "Currently Active" 3 "Previously Active" DEFAULT_VALUE "UNKNOWN" /end COMPU_VTAB
/begin CHARACTERISTIC ShftInt_ena "Shift interrupt input{ShftInt_ena&0xff=0:Disabled}{ShftInt_ena&0xff=1:Aux PU1}{ShftInt_ena&0xff=2:Aux PU2}{ShftInt_ena&0xff=3:Aux PU3}{ShftInt_ena&0xff=4:Aux PUD1}{ShftInt_ena&0xff=5:Aux PUD2}{ShftInt_ena&0xff=6:Aux PUD3}{ShftInt_ena&0xff=7:Aux DIG1}{Shft" VALUE 0x001c8ef6 /* @ECU_Address@ShftInt_ena@0x01003890@ */ ECIPP_ALIGNMENT_UBYTE 255 ShftInt_ena_COMPU_VTAB 0 255 BIT_MASK 0xff /end CHARACTERISTIC
/begin COMPU_METHOD ShftInt_ena_COMPU_VTAB "Verbal Table" TAB_VERB "%.0" "list" COMPU_TAB_REF ShftInt_ena_COMPU_VTAB_REF /end COMPU_METHOD
/begin COMPU_VTAB ShftInt_ena_COMPU_VTAB_REF "Verbal Table" TAB_VERB 12 0 "Disabled" 1 "Aux PU1" 2 "Aux PU2" 3 "Aux PU3" 4 "Aux PUD1" 5 "Aux PUD2" 6 "Aux PUD3" 7 "Aux DIG1" 8 "Aux DIG2" 9 "Aux DIG3" 10 "J1939 Neg Torque Switch - TSC1" 11 "J1939 Actual/Desired Gear - ETC2" DEFAULT_VALUE "UNKNOWN" /end COMPU_VTAB
/begin CHARACTERISTIC ShftInt_idle "Shift interrupt switch idle target" VALUE 0x001c7fce /* @ECU_Address@ShftInt_idle@0x01003898@ */ ECIPP_ALIGNMENT_UWORD 65535 Compu_ShftInt_idle 0 65535 /end CHARACTERISTIC
/begin COMPU_METHOD Compu_ShftInt_idle " " RAT_FUNC "%.0" "rpm" COEFFS 0 1 0 0 0 1 /end COMPU_METHOD
/begin CHARACTERISTIC ShftInt_revlim "Shift interrupt switch fuel rev limit" VALUE 0x001c7fd2 /* @ECU_Address@ShftInt_revlim@0x010038A0@ */ ECIPP_ALIGNMENT_UWORD 65535 Compu_ShftInt_revlim 0 65535 /end CHARACTERISTIC
/begin COMPU_METHOD Compu_ShftInt_revlim " " RAT_FUNC "%.0" "rpm" COEFFS 0 1 0 0 0 1 /end COMPU_METHOD
/begin CHARACTERISTIC ShftInt_FPPmax "Shift interrupt FPP max" VALUE 0x001c7fca /* @ECU_Address@ShftInt_FPPmax@0x010038A8@ */ ECIPP_ALIGNMENT_UWORD 100 Compu_ShftInt_FPPmax 0 99.9984741210938 /end CHARACTERISTIC
/begin COMPU_METHOD Compu_ShftInt_FPPmax " " RAT_FUNC "%.1" "%" COEFFS 0 655.36 0 0 0 1 /end COMPU_METHOD
/begin CHARACTERISTIC ShftInt_ignoret "Shift interrupt ignore timeout" VALUE 0x001c7fd0 /* @ECU_Address@ShftInt_ignoret@0x010038B0@ */ ECIPP_ALIGNMENT_UWORD 66 Compu_ShftInt_ignoret 0 65.535 /end CHARACTERISTIC
/begin COMPU_METHOD Compu_ShftInt_ignoret " " RAT_FUNC "%.3" "sec" COEFFS 0 1000 0 0 0 1 /end COMPU_METHOD
/begin MEASUREMENT ShftInt_actv_tmr "Shift interrupt active timer" UWORD Compu_ShftInt_actv_tmr 0 0 0 65.535 ECU_ADDRESS 0x010038B8 /end MEASUREMENT
/begin COMPU_METHOD Compu_ShftInt_actv_tmr " " RAT_FUNC "%.3" "sec" COEFFS 0 1000 0 0 0 1 /end COMPU_METHOD
/begin MEASUREMENT ShftInt_state "Shift interrupt state{ShftInt_state&0xff=0:Off}{ShftInt_state&0xff=1:Active}{ShftInt_state&0xff=2:Ignored}" UBYTE ShftInt_state_COMPU_VTAB 0 0 0 255 ECU_ADDRESS 0x010038C0 BIT_MASK 0xff /end MEASUREMENT
/begin COMPU_METHOD ShftInt_state_COMPU_VTAB "Verbal Table" TAB_VERB "%.0" "list" COMPU_TAB_REF ShftInt_state_COMPU_VTAB_REF /end COMPU_METHOD
/begin COMPU_VTAB ShftInt_state_COMPU_VTAB_REF "Verbal Table" TAB_VERB 3 0 "Off" 1 "Active" 2 "Ignored" DEFAULT_VALUE "UNKNOWN" /end COMPU_VTAB
/begin CHARACTERISTIC FPPTPSnl2_FPP "Option2 non-linear FPP point" VALUE 0x001C80D4 /* @ECU_Address@FPPTPSnl2_FPP@0x01003B18@ */ ECIPP_ALIGNMENT_UWORD 100 Compu_FPPTPSnl2_FPP 0 99.9984741210938 /end CHARACTERISTIC
/begin COMPU_METHOD Compu_FPPTPSnl2_FPP " " RAT_FUNC "%.1" "%" COEFFS 0 655.36 0 0 0 1 /end COMPU_METHOD
/begin CHARACTERISTIC FPPTPSnl2_TPS "Option2 non-linear TPS point" VALUE 0x001C80DA /* @ECU_Address@FPPTPSnl2_TPS@0x01003B20@ */ ECIPP_ALIGNMENT_UWORD 100 Compu_FPPTPSnl2_TPS 0 99.9984741210938 /end CHARACTERISTIC
/begin COMPU_METHOD Compu_FPPTPSnl2_TPS " " RAT_FUNC "%.1" "%" COEFFS 0 655.36 0 0 0 1 /end COMPU_METHOD
/begin CHARACTERISTIC FPPTPSnl3_FPP "Option3 non-linear FPP point" VALUE 0x001C80D6 /* @ECU_Address@FPPTPSnl3_FPP@0x01003B28@ */ ECIPP_ALIGNMENT_UWORD 100 Compu_FPPTPSnl3_FPP 0 99.9984741210938 /end CHARACTERISTIC
/begin COMPU_METHOD Compu_FPPTPSnl3_FPP " " RAT_FUNC "%.1" "%" COEFFS 0 655.36 0 0 0 1 /end COMPU_METHOD
/begin CHARACTERISTIC FPPTPSnl3_TPS "Option3 non-linear TPS point" VALUE 0x001C80DC /* @ECU_Address@FPPTPSnl3_TPS@0x01003B30@ */ ECIPP_ALIGNMENT_UWORD 100 Compu_FPPTPSnl3_TPS 0 99.9984741210938 /end CHARACTERISTIC
/begin COMPU_METHOD Compu_FPPTPSnl3_TPS " " RAT_FUNC "%.1" "%" COEFFS 0 655.36 0 0 0 1 /end COMPU_METHOD
/begin CHARACTERISTIC load_est_type "Load estimation type{load_est_type&0xff=0:MAP based only}{load_est_type&0xff=1:MAP*VE - 1 iteration}{load_est_type&0xff=2:MAP*VE - 2 iterations}{load_est_type&0xff=3:MAP*VE - 3 iterations}{load_est_type&0xff=4:MAP*VE - 4 iterations}{load_est_type&0xff=5:M" VALUE 0x001c906a /* @ECU_Address@load_est_type@0x01003BF8@ */ ECIPP_ALIGNMENT_UBYTE 255 load_est_type_COMPU_VTAB 0 255 BIT_MASK 0xff /end CHARACTERISTIC
/begin COMPU_METHOD load_est_type_COMPU_VTAB "Verbal Table" TAB_VERB "%.0" "list" COMPU_TAB_REF load_est_type_COMPU_VTAB_REF /end COMPU_METHOD
/begin COMPU_VTAB load_est_type_COMPU_VTAB_REF "Verbal Table" TAB_VERB 6 0 "MAP based only" 1 "MAP*VE - 1 iteration" 2 "MAP*VE - 2 iterations" 3 "MAP*VE - 3 iterations" 4 "MAP*VE - 4 iterations" 5 "MAP*VE - 5 iterations" DEFAULT_VALUE "UNKNOWN" /end COMPU_VTAB
/begin CHARACTERISTIC MES_ena "Multi-engine speed sync{MES_ena&0xff=0:Disabled}{MES_ena&0xff=1:Network Select}{MES_ena&0xff=2:Aux PU1}{MES_ena&0xff=3:Aux PU2}{MES_ena&0xff=4:Aux PU3}{MES_ena&0xff=5:Aux PUD1}{MES_ena&0xff=6:Aux PUD2}{MES_ena&0xff=7:Aux PUD3}{MES_ena&0xff=8:Aux DIG1}{MES" VALUE 0x001c8823 /* @ECU_Address@MES_ena@0x01003C00@ */ ECIPP_ALIGNMENT_UBYTE 255 MES_ena_COMPU_VTAB 0 255 BIT_MASK 0xff /end CHARACTERISTIC
/begin COMPU_METHOD MES_ena_COMPU_VTAB "Verbal Table" TAB_VERB "%.0" "list" COMPU_TAB_REF MES_ena_COMPU_VTAB_REF /end COMPU_METHOD
/begin COMPU_VTAB MES_ena_COMPU_VTAB_REF "Verbal Table" TAB_VERB 15 0 "Disabled" 1 "Network Select" 2 "Aux PU1" 3 "Aux PU2" 4 "Aux PU3" 5 "Aux PUD1" 6 "Aux PUD2" 7 "Aux PUD3" 8 "Aux DIG1" 9 "Aux DIG2" 10 "Aux DIG3" 11 "Always On" 12 "Aux PUD4" 13 "Aux PUD5" 14 "Aux PU2 on Slave" DEFAULT_VALUE "UNKNOWN" /end COMPU_VTAB
/begin CHARACTERISTIC MES_gain_slct "MES gain selection{MES_gain_slct&0xff=0:Isochronous Standard}{MES_gain_slct&0xff=1:Isochronous Alternate}{MES_gain_slct&0xff=2:Droop Standard}{MES_gain_slct&0xff=3:Droop Alternate}" VALUE 0x001c8824 /* @ECU_Address@MES_gain_slct@0x01003C08@ */ ECIPP_ALIGNMENT_UBYTE 255 MES_gain_slct_COMPU_VTAB 0 255 BIT_MASK 0xff /end CHARACTERISTIC
/begin COMPU_METHOD MES_gain_slct_COMPU_VTAB "Verbal Table" TAB_VERB "%.0" "list" COMPU_TAB_REF MES_gain_slct_COMPU_VTAB_REF /end COMPU_METHOD
/begin COMPU_VTAB MES_gain_slct_COMPU_VTAB_REF "Verbal Table" TAB_VERB 4 0 "Isochronous Standard" 1 "Isochronous Alternate" 2 "Droop Standard" 3 "Droop Alternate" DEFAULT_VALUE "UNKNOWN" /end COMPU_VTAB
/begin CHARACTERISTIC MES_rpmdelt_0 "MES idle delta initiate" VALUE 0x001c7d76 /* @ECU_Address@MES_rpmdelt_0@0x01003C10@ */ ECIPP_ALIGNMENT_UWORD 65535 Compu_MES_rpmdelt_0 0 65535 /end CHARACTERISTIC
/begin COMPU_METHOD Compu_MES_rpmdelt_0 " " RAT_FUNC "%.0" "rpm" COEFFS 0 1 0 0 0 1 /end COMPU_METHOD
/begin CHARACTERISTIC MES_rpmdelt_1 "MES speed phase-in delta" VALUE 0x001c7d78 /* @ECU_Address@MES_rpmdelt_1@0x01003C18@ */ ECIPP_ALIGNMENT_UWORD 65535 Compu_MES_rpmdelt_1 0 65535 /end CHARACTERISTIC
/begin COMPU_METHOD Compu_MES_rpmdelt_1 " " RAT_FUNC "%.0" "rpm" COEFFS 0 1 0 0 0 1 /end COMPU_METHOD
/begin CHARACTERISTIC MES_Ilim_pos "MES integrator +limit" VALUE 0x001c4558 /* @ECU_Address@MES_Ilim_pos@0x01003C20@ */ ECIPP_ALIGNMENT_SWORD 100 Compu_MES_Ilim_pos -100 99.9969482421875 /end CHARACTERISTIC
/begin COMPU_METHOD Compu_MES_Ilim_pos " " RAT_FUNC "%.1" "% load" COEFFS 0 327.68 0 0 0 1 /end COMPU_METHOD
/begin CHARACTERISTIC MES_Ilim_neg "MES integrator -limit" VALUE 0x001c4556 /* @ECU_Address@MES_Ilim_neg@0x01003C28@ */ ECIPP_ALIGNMENT_SWORD 100 Compu_MES_Ilim_neg -100 99.9969482421875 /end CHARACTERISTIC
/begin COMPU_METHOD Compu_MES_Ilim_neg " " RAT_FUNC "%.1" "% load" COEFFS 0 327.68 0 0 0 1 /end COMPU_METHOD
/begin CHARACTERISTIC MES_auth_pos "MES total authority +limit" VALUE 0x001c455c /* @ECU_Address@MES_auth_pos@0x01003C30@ */ ECIPP_ALIGNMENT_SWORD 100 Compu_MES_auth_pos -100 99.9969482421875 /end CHARACTERISTIC
/begin COMPU_METHOD Compu_MES_auth_pos " " RAT_FUNC "%.1" "% load" COEFFS 0 327.68 0 0 0 1 /end COMPU_METHOD
/begin CHARACTERISTIC MES_auth_neg "MES total authority -limit" VALUE 0x001c455a /* @ECU_Address@MES_auth_neg@0x01003C38@ */ ECIPP_ALIGNMENT_SWORD 100 Compu_MES_auth_neg -100 99.9969482421875 /end CHARACTERISTIC
/begin COMPU_METHOD Compu_MES_auth_neg " " RAT_FUNC "%.1" "% load" COEFFS 0 327.68 0 0 0 1 /end COMPU_METHOD
/begin CHARACTERISTIC MES_rpm_mstr_tau "MES engine master target RPM tau" VALUE 0x001c8570 /* @ECU_Address@MES_rpm_mstr_tau@0x01003C40@ */ ECIPP_ALIGNMENT_UWORD 327680 Compu_MES_rpm_mstr_tau 0.45084 327680 /end CHARACTERISTIC
/begin COMPU_METHOD Compu_MES_rpm_mstr_tau " " FORM "%.1" "ms"
 /begin FORMULA "-5 / log(1 - (X1 / 65536))" FORMULA_INV "(1 - exp(-5/X1)) * 65536" /end FORMULA
/end COMPU_METHOD
/begin CHARACTERISTIC MES_MAP_mstr_tau "MES engine master reference MAP tau" VALUE 0x001c856c /* @ECU_Address@MES_MAP_mstr_tau@0x01003C48@ */ ECIPP_ALIGNMENT_UWORD 327680 Compu_MES_MAP_mstr_tau 0.45084 327680 /end CHARACTERISTIC
/begin COMPU_METHOD Compu_MES_MAP_mstr_tau " " FORM "%.1" "ms"
 /begin FORMULA "-5 / log(1 - (X1 / 65536))" FORMULA_INV "(1 - exp(-5/X1)) * 65536" /end FORMULA
/end COMPU_METHOD
/begin CHARACTERISTIC MES_PID_tau "MES closed-loop command tau" VALUE 0x001c856e /* @ECU_Address@MES_PID_tau@0x01003C50@ */ ECIPP_ALIGNMENT_UWORD 163840 Compu_MES_PID_tau 0.16703 163840 /end CHARACTERISTIC
/begin COMPU_METHOD Compu_MES_PID_tau " " FORM "%.1" "ms"
 /begin FORMULA "-5 / log(1.0000000000001 - (X1 / 32768))" FORMULA_INV "(1.0000000000001 - exp(-5/X1)) * 32768" /end FORMULA
/end COMPU_METHOD
/begin MEASUREMENT MES_rpmdtdz_Kd "MES Kd deadzone" SWORD Compu_MES_rpmdtdz_Kd 0 0 -64000 63998.046875 ECU_ADDRESS 0x01003C58 /end MEASUREMENT
/begin COMPU_METHOD Compu_MES_rpmdtdz_Kd " " RAT_FUNC "%.0" "rpm/sec" COEFFS 0 0.512 0 0 0 1 /end COMPU_METHOD
/begin MEASUREMENT MES_rpmdz_Kp "MES Kp deadzone" SWORD Compu_MES_rpmdz_Kp 0 0 -32768 32767 ECU_ADDRESS 0x01003C60 /end MEASUREMENT
/begin COMPU_METHOD Compu_MES_rpmdz_Kp " " RAT_FUNC "%.0" "rpm" COEFFS 0 1 0 0 0 1 /end COMPU_METHOD
/begin MEASUREMENT MES_rpmdz_Ki "MES Ki deadzone" SWORD Compu_MES_rpmdz_Ki 0 0 -32768 32767 ECU_ADDRESS 0x01003C68 /end MEASUREMENT
/begin COMPU_METHOD Compu_MES_rpmdz_Ki " " RAT_FUNC "%.0" "rpm" COEFFS 0 1 0 0 0 1 /end COMPU_METHOD
/begin MEASUREMENT MES_Kp "MES Kp" SWORD Compu_MES_Kp 0 0 -3125 3124.90463256836 ECU_ADDRESS 0x01003C70 /end MEASUREMENT
/begin COMPU_METHOD Compu_MES_Kp " " RAT_FUNC "%.1" "% / krpm" COEFFS 0 10.48576 0 0 0 1 /end COMPU_METHOD
/begin MEASUREMENT MES_Kd "MES Kd" SWORD Compu_MES_Kd 0 0 -1600 1599.951171875 ECU_ADDRESS 0x01003C78 /end MEASUREMENT
/begin COMPU_METHOD Compu_MES_Kd " " RAT_FUNC "%.2" "% / (krpm/sec)" COEFFS 0 20.48 0 0 0 1 /end COMPU_METHOD
/begin MEASUREMENT MES_Ki "MES Ki" SWORD Compu_MES_Ki 0 0 -12207.03125 12206.6587209702 ECU_ADDRESS 0x01003C80 /end MEASUREMENT
/begin COMPU_METHOD Compu_MES_Ki " " RAT_FUNC "%.1" "% / krpm / sec" COEFFS 0 2.68435456 0 0 0 1 /end COMPU_METHOD
/begin MEASUREMENT MES_Kiv "MES Kiv" SWORD Compu_MES_Kiv 0 0 -6250 6249.80926513672 ECU_ADDRESS 0x01003C88 /end MEASUREMENT
/begin COMPU_METHOD Compu_MES_Kiv " " RAT_FUNC "%.2" "% / krpm" COEFFS 0 5.24288 0 0 0 1 /end COMPU_METHOD
/begin MEASUREMENT MES_FPP_mstr "MES master FPP command" UWORD Compu_MES_FPP_mstr 0 0 0 99.9984741210938 ECU_ADDRESS 0x01003C90 /end MEASUREMENT
/begin COMPU_METHOD Compu_MES_FPP_mstr " " RAT_FUNC "%.1" "% TPS" COEFFS 0 655.36 0 0 0 1 /end COMPU_METHOD
/begin MEASUREMENT MES_rpm_mstr "MES engine master target RPM" UWORD Compu_MES_rpm_mstr 0 0 0 65535 ECU_ADDRESS 0x01003C98 /end MEASUREMENT
/begin COMPU_METHOD Compu_MES_rpm_mstr " " RAT_FUNC "%.0" "rpm" COEFFS 0 1 0 0 0 1 /end COMPU_METHOD
/begin MEASUREMENT MES_MAP_mstr "MES engine master MAP" UWORD Compu_MES_MAP_mstr 0 0 0 255.99609375 ECU_ADDRESS 0x01003CA0 /end MEASUREMENT
/begin COMPU_METHOD Compu_MES_MAP_mstr " " RAT_FUNC "%.1" "psia" COEFFS 0 256 0 0 0 1 /end COMPU_METHOD
/begin MEASUREMENT MES_FPP_ntrlock "MES dis-engagement FPP interlock" UWORD Compu_MES_FPP_ntrlock 0 0 0 99.9984741210938 ECU_ADDRESS 0x01003CA8 /end MEASUREMENT
/begin COMPU_METHOD Compu_MES_FPP_ntrlock " " RAT_FUNC "%.1" "% TPS" COEFFS 0 655.36 0 0 0 1 /end COMPU_METHOD
/begin MEASUREMENT MES_FPP_cmd "MES sync (slave) FPP command" UWORD Compu_MES_FPP_cmd 0 0 0 99.9984741210938 ECU_ADDRESS 0x01003CB0 /end MEASUREMENT
/begin COMPU_METHOD Compu_MES_FPP_cmd " " RAT_FUNC "%.1" "% TPS" COEFFS 0 655.36 0 0 0 1 /end COMPU_METHOD
/begin MEASUREMENT MES_TPSest_ref "MES TM estimated reference TPS" UWORD Compu_MES_TPSest_ref 0 0 0 99.9984741210938 ECU_ADDRESS 0x01003CB8 /end MEASUREMENT
/begin COMPU_METHOD Compu_MES_TPSest_ref " " RAT_FUNC "%.1" "% TPS" COEFFS 0 655.36 0 0 0 1 /end COMPU_METHOD
/begin MEASUREMENT MES_TPSest_d "MES TM estimated target TPS" UWORD Compu_MES_TPSest_d 0 0 0 99.9984741210938 ECU_ADDRESS 0x01003CC0 /end MEASUREMENT
/begin COMPU_METHOD Compu_MES_TPSest_d " " RAT_FUNC "%.1" "% TPS" COEFFS 0 655.36 0 0 0 1 /end COMPU_METHOD
/begin MEASUREMENT MES_Iacc "MES integrator value" SWORD Compu_MES_Iacc 0 0 -800 799.9755859375 ECU_ADDRESS 0x01003CC8 /end MEASUREMENT
/begin COMPU_METHOD Compu_MES_Iacc " " RAT_FUNC "%.1" "% load" COEFFS 0 40.96 0 0 0 1 /end COMPU_METHOD
/begin MEASUREMENT MES_load_ref "MES engine load reference" UWORD Compu_MES_load_ref 0 0 0 399.993896484375 ECU_ADDRESS 0x01003CD0 /end MEASUREMENT
/begin COMPU_METHOD Compu_MES_load_ref " " RAT_FUNC "%.1" "% load" COEFFS 0 163.84 0 0 0 1 /end COMPU_METHOD
/begin MEASUREMENT MES_load_PID "MES closed-loop slave load adjustment" SWORD Compu_MES_load_PID 0 0 -200 199.993896484375 ECU_ADDRESS 0x01003CD8 /end MEASUREMENT
/begin COMPU_METHOD Compu_MES_load_PID " " RAT_FUNC "%.1" "% load" COEFFS 0 163.84 0 0 0 1 /end COMPU_METHOD
/begin MEASUREMENT MES_MAP_d "MES final slave target MAP" UWORD Compu_MES_MAP_d 0 0 0 255.99609375 ECU_ADDRESS 0x01003CE0 /end MEASUREMENT
/begin COMPU_METHOD Compu_MES_MAP_d " " RAT_FUNC "%.1" "psia" COEFFS 0 256 0 0 0 1 /end COMPU_METHOD
/begin MEASUREMENT MES_phase "MES phase-in value" SWORD Compu_MES_phase 0 0 -100 99.9969482421875 ECU_ADDRESS 0x01003CE8 /end MEASUREMENT
/begin COMPU_METHOD Compu_MES_phase " " RAT_FUNC "%.1" "%" COEFFS 0 327.68 0 0 0 1 /end COMPU_METHOD
/begin MEASUREMENT MES_sync_cmd "Sync command{MES_sync_cmd&0xff=0:None}{MES_sync_cmd&0xff=1:Request RPM Sync}{MES_sync_cmd&0xff=2:Request FPP Sync}{MES_sync_cmd&0xff=3:Req Sync w/ Mstr Stop}{MES_sync_cmd&0xff=4:Req FPP-Match Sync}" UBYTE MES_sync_cmd_COMPU_VTAB 0 0 0 255 ECU_ADDRESS 0x01003CF0 BIT_MASK 0xff /end MEASUREMENT
/begin COMPU_METHOD MES_sync_cmd_COMPU_VTAB "Verbal Table" TAB_VERB "%.0" "list" COMPU_TAB_REF MES_sync_cmd_COMPU_VTAB_REF /end COMPU_METHOD
/begin COMPU_VTAB MES_sync_cmd_COMPU_VTAB_REF "Verbal Table" TAB_VERB 5 0 "None" 1 "Request RPM Sync" 2 "Request FPP Sync" 3 "Req Sync w/ Mstr Stop" 4 "Req FPP-Match Sync" DEFAULT_VALUE "UNKNOWN" /end COMPU_VTAB
/begin MEASUREMENT MES_state "Sync state{MES_state&0xff=0:Offline}{MES_state&0xff=1:Active}{MES_state&0xff=2:Inactive Interlock}{MES_state&0xff=3:Inactive}{MES_state&0xff=4:Active - RPM}{MES_state&0xff=5:Active - FPP}{MES_state&0xff=6:Active - FPP-Match}" UBYTE MES_state_COMPU_VTAB 0 0 0 255 ECU_ADDRESS 0x01003CF8 BIT_MASK 0xff /end MEASUREMENT
/begin COMPU_METHOD MES_state_COMPU_VTAB "Verbal Table" TAB_VERB "%.0" "list" COMPU_TAB_REF MES_state_COMPU_VTAB_REF /end COMPU_METHOD
/begin COMPU_VTAB MES_state_COMPU_VTAB_REF "Verbal Table" TAB_VERB 7 0 "Offline" 1 "Active" 2 "Inactive Interlock" 3 "Inactive" 4 "Active - RPM" 5 "Active - FPP" 6 "Active - FPP-Match" DEFAULT_VALUE "UNKNOWN" /end COMPU_VTAB
/begin CHARACTERISTIC MES_loadref_max "MES reference load maximum" VALUE 0x001c7d72 /* @ECU_Address@MES_loadref_max@0x01003D18@ */ ECIPP_ALIGNMENT_UWORD 100 Compu_MES_loadref_max 0 99.9984741210938 /end CHARACTERISTIC
/begin COMPU_METHOD Compu_MES_loadref_max " " RAT_FUNC "%.1" "% load" COEFFS 0 655.36 0 0 0 1 /end COMPU_METHOD
/begin CHARACTERISTIC MES_loadref_min "MES reference load minimum" VALUE 0x001c7d74 /* @ECU_Address@MES_loadref_min@0x01003D20@ */ ECIPP_ALIGNMENT_UWORD 100 Compu_MES_loadref_min 0 99.9984741210938 /end CHARACTERISTIC
/begin COMPU_METHOD Compu_MES_loadref_min " " RAT_FUNC "%.1" "% load" COEFFS 0 655.36 0 0 0 1 /end COMPU_METHOD
/begin MEASUREMENT MES_MAP_ref "MES reference MAP" UWORD Compu_MES_MAP_ref 0 0 0 255.99609375 ECU_ADDRESS 0x01003D28 /end MEASUREMENT
/begin COMPU_METHOD Compu_MES_MAP_ref " " RAT_FUNC "%.1" "psia" COEFFS 0 256 0 0 0 1 /end COMPU_METHOD
/begin CHARACTERISTIC MES_status_lamp "MES sync indication output{MES_status_lamp&0xff=0:Disabled}{MES_status_lamp&0xff=1:Aux PWM1}{MES_status_lamp&0xff=2:Aux PWM2}{MES_status_lamp&0xff=3:Aux PWM3}{MES_status_lamp&0xff=4:Aux PWM4}{MES_status_lamp&0xff=5:Aux PWM5}{MES_status_lamp&0xff=6:Aux PWM" VALUE 0x001c8825 /* @ECU_Address@MES_status_lamp@0x01003F88@ */ ECIPP_ALIGNMENT_UBYTE 255 MES_status_lamp_COMPU_VTAB 0 255 BIT_MASK 0xff /end CHARACTERISTIC
/begin COMPU_METHOD MES_status_lamp_COMPU_VTAB "Verbal Table" TAB_VERB "%.0" "list" COMPU_TAB_REF MES_status_lamp_COMPU_VTAB_REF /end COMPU_METHOD
/begin COMPU_VTAB MES_status_lamp_COMPU_VTAB_REF "Verbal Table" TAB_VERB 14 0 "Disabled" 1 "Aux PWM1" 2 "Aux PWM2" 3 "Aux PWM3" 4 "Aux PWM4" 5 "Aux PWM5" 6 "Aux PWM6" 7 "EGOH1" 8 "EGOH2" 9 "EGOH3" 10 "EGOH4" 11 "Aux PWM7" 12 "Aux PWM8" 13 "MSP output on Slave" DEFAULT_VALUE "UNKNOWN" /end COMPU_VTAB
/begin CHARACTERISTIC MES_status_rpmtol "MES sync indication speed tolerance" VALUE 0x001c7d7a /* @ECU_Address@MES_status_rpmtol@0x01003F90@ */ ECIPP_ALIGNMENT_UWORD 65535 Compu_MES_status_rpmtol 0 65535 /end CHARACTERISTIC
/begin COMPU_METHOD Compu_MES_status_rpmtol " " RAT_FUNC "%.0" "+/- rpm" COEFFS 0 1 0 0 0 1 /end COMPU_METHOD
/begin CHARACTERISTIC MES_usblk_offt "MES unsynced indication blink-off" VALUE 0x001c7d7c /* @ECU_Address@MES_usblk_offt@0x010043E0@ */ ECIPP_ALIGNMENT_UWORD 65535 Compu_MES_usblk_offt 0 65535 /end CHARACTERISTIC
/begin COMPU_METHOD Compu_MES_usblk_offt " " RAT_FUNC "%.0" "ms" COEFFS 0 1 0 0 0 1 /end COMPU_METHOD
/begin CHARACTERISTIC MES_usblk_ont "MES unsynced indication blink-on" VALUE 0x001c7d7e /* @ECU_Address@MES_usblk_ont@0x010043E8@ */ ECIPP_ALIGNMENT_UWORD 65535 Compu_MES_usblk_ont 0 65535 /end CHARACTERISTIC
/begin COMPU_METHOD Compu_MES_usblk_ont " " RAT_FUNC "%.0" "ms" COEFFS 0 1 0 0 0 1 /end COMPU_METHOD
/begin MEASUREMENT MES_light "MES active{MES_light&0x01=0x00:Off}{MES_light&0x01=0x01:On}" UBYTE MES_light_COMPU_VTAB 0 0 0 255 ECU_ADDRESS 0x010043F0 BIT_MASK 0x01 /end MEASUREMENT
/begin COMPU_METHOD MES_light_COMPU_VTAB "Verbal Table" TAB_VERB "%.0" "list" COMPU_TAB_REF MES_light_COMPU_VTAB_REF /end COMPU_METHOD
/begin COMPU_VTAB MES_light_COMPU_VTAB_REF "Verbal Table" TAB_VERB 2 0x00 "Off" 0x01 "On" DEFAULT_VALUE "UNKNOWN" /end COMPU_VTAB
/begin MEASUREMENT ShftIntSS_RdRa "ShftIntSS_RdRa{ShftIntSS_RdRa&0xff=1:Active}{ShftIntSS_RdRa&0x00=0:Inactive}" UBYTE ShftIntSS_RdRa_COMPU_VTAB 0 0 0 255 ECU_ADDRESS 0x010043F8 BIT_MASK 0xff /end MEASUREMENT
/begin COMPU_METHOD ShftIntSS_RdRa_COMPU_VTAB "Verbal Table" TAB_VERB "%.0" "list" COMPU_TAB_REF ShftIntSS_RdRa_COMPU_VTAB_REF /end COMPU_METHOD
/begin COMPU_VTAB ShftIntSS_RdRa_COMPU_VTAB_REF "Verbal Table" TAB_VERB 2 1 "Active" 0 "Inactive" DEFAULT_VALUE "UNKNOWN" /end COMPU_VTAB
/begin MEASUREMENT ShftIntSS_RdNa "ShftIntSS_RdNa{ShftIntSS_RdNa&0xff=2:Active}{ShftIntSS_RdNa&0x00=0:Inactive}" UBYTE ShftIntSS_RdNa_COMPU_VTAB 0 0 0 255 ECU_ADDRESS 0x01004400 BIT_MASK 0xff /end MEASUREMENT
/begin COMPU_METHOD ShftIntSS_RdNa_COMPU_VTAB "Verbal Table" TAB_VERB "%.0" "list" COMPU_TAB_REF ShftIntSS_RdNa_COMPU_VTAB_REF /end COMPU_METHOD
/begin COMPU_VTAB ShftIntSS_RdNa_COMPU_VTAB_REF "Verbal Table" TAB_VERB 2 2 "Active" 0 "Inactive" DEFAULT_VALUE "UNKNOWN" /end COMPU_VTAB
/begin MEASUREMENT ShftIntSS_RdFa "ShftIntSS_RdFa{ShftIntSS_RdFa&0xff=3:Active}{ShftIntSS_RdFa&0x00=0:Inactive}" UBYTE ShftIntSS_RdFa_COMPU_VTAB 0 0 0 255 ECU_ADDRESS 0x01004408 BIT_MASK 0xff /end MEASUREMENT
/begin COMPU_METHOD ShftIntSS_RdFa_COMPU_VTAB "Verbal Table" TAB_VERB "%.0" "list" COMPU_TAB_REF ShftIntSS_RdFa_COMPU_VTAB_REF /end COMPU_METHOD
/begin COMPU_VTAB ShftIntSS_RdFa_COMPU_VTAB_REF "Verbal Table" TAB_VERB 2 3 "Active" 0 "Inactive" DEFAULT_VALUE "UNKNOWN" /end COMPU_VTAB
/begin MEASUREMENT ShftIntSS_NdRa "ShftIntSS_NdRa{ShftIntSS_NdRa&0xff=4:Active}{ShftIntSS_NdRa&0x00=0:Inactive}" UBYTE ShftIntSS_NdRa_COMPU_VTAB 0 0 0 255 ECU_ADDRESS 0x01004410 BIT_MASK 0xff /end MEASUREMENT
/begin COMPU_METHOD ShftIntSS_NdRa_COMPU_VTAB "Verbal Table" TAB_VERB "%.0" "list" COMPU_TAB_REF ShftIntSS_NdRa_COMPU_VTAB_REF /end COMPU_METHOD
/begin COMPU_VTAB ShftIntSS_NdRa_COMPU_VTAB_REF "Verbal Table" TAB_VERB 2 4 "Active" 0 "Inactive" DEFAULT_VALUE "UNKNOWN" /end COMPU_VTAB
/begin MEASUREMENT ShftIntSS_NdNa "ShftIntSS_NdNa{ShftIntSS_NdNa&0xff=5:Active}{ShftIntSS_NdNa&0x00=0:Inactive}" UBYTE ShftIntSS_NdNa_COMPU_VTAB 0 0 0 255 ECU_ADDRESS 0x01004418 BIT_MASK 0xff /end MEASUREMENT
/begin COMPU_METHOD ShftIntSS_NdNa_COMPU_VTAB "Verbal Table" TAB_VERB "%.0" "list" COMPU_TAB_REF ShftIntSS_NdNa_COMPU_VTAB_REF /end COMPU_METHOD
/begin COMPU_VTAB ShftIntSS_NdNa_COMPU_VTAB_REF "Verbal Table" TAB_VERB 2 5 "Active" 0 "Inactive" DEFAULT_VALUE "UNKNOWN" /end COMPU_VTAB
/begin MEASUREMENT ShftIntSS_NdFa "ShftIntSS_NdFa{ShftIntSS_NdFa&0xff=6:Active}{ShftIntSS_NdFa&0x00=0:Inactive}" UBYTE ShftIntSS_NdFa_COMPU_VTAB 0 0 0 255 ECU_ADDRESS 0x01004420 BIT_MASK 0xff /end MEASUREMENT
/begin COMPU_METHOD ShftIntSS_NdFa_COMPU_VTAB "Verbal Table" TAB_VERB "%.0" "list" COMPU_TAB_REF ShftIntSS_NdFa_COMPU_VTAB_REF /end COMPU_METHOD
/begin COMPU_VTAB ShftIntSS_NdFa_COMPU_VTAB_REF "Verbal Table" TAB_VERB 2 6 "Active" 0 "Inactive" DEFAULT_VALUE "UNKNOWN" /end COMPU_VTAB
/begin MEASUREMENT ShftIntSS_FdRa "ShftIntSS_FdRa{ShftIntSS_FdRa&0xff=7:Active}{ShftIntSS_FdRa&0x00=0:Inactive}" UBYTE ShftIntSS_FdRa_COMPU_VTAB 0 0 0 255 ECU_ADDRESS 0x01004428 BIT_MASK 0xff /end MEASUREMENT
/begin COMPU_METHOD ShftIntSS_FdRa_COMPU_VTAB "Verbal Table" TAB_VERB "%.0" "list" COMPU_TAB_REF ShftIntSS_FdRa_COMPU_VTAB_REF /end COMPU_METHOD
/begin COMPU_VTAB ShftIntSS_FdRa_COMPU_VTAB_REF "Verbal Table" TAB_VERB 2 7 "Active" 0 "Inactive" DEFAULT_VALUE "UNKNOWN" /end COMPU_VTAB
/begin MEASUREMENT ShftIntSS_FdNa "ShftIntSS_FdNa{ShftIntSS_FdNa&0xff=8:Active}{ShftIntSS_FdNa&0x00=0:Inactive}" UBYTE ShftIntSS_FdNa_COMPU_VTAB 0 0 0 255 ECU_ADDRESS 0x01004430 BIT_MASK 0xff /end MEASUREMENT
/begin COMPU_METHOD ShftIntSS_FdNa_COMPU_VTAB "Verbal Table" TAB_VERB "%.0" "list" COMPU_TAB_REF ShftIntSS_FdNa_COMPU_VTAB_REF /end COMPU_METHOD
/begin COMPU_VTAB ShftIntSS_FdNa_COMPU_VTAB_REF "Verbal Table" TAB_VERB 2 8 "Active" 0 "Inactive" DEFAULT_VALUE "UNKNOWN" /end COMPU_VTAB
/begin MEASUREMENT ShftIntSS_FdFa "ShftIntSS_FdFa{ShftIntSS_FdFa&0xff=9:Active}{ShftIntSS_FdFa&0x00=0:Inactive}" UBYTE ShftIntSS_FdFa_COMPU_VTAB 0 0 0 255 ECU_ADDRESS 0x01004438 BIT_MASK 0xff /end MEASUREMENT
/begin COMPU_METHOD ShftIntSS_FdFa_COMPU_VTAB "Verbal Table" TAB_VERB "%.0" "list" COMPU_TAB_REF ShftIntSS_FdFa_COMPU_VTAB_REF /end COMPU_METHOD
/begin COMPU_VTAB ShftIntSS_FdFa_COMPU_VTAB_REF "Verbal Table" TAB_VERB 2 9 "Active" 0 "Inactive" DEFAULT_VALUE "UNKNOWN" /end COMPU_VTAB
/begin CHARACTERISTIC SSBSI_NdRa_idle "Shift-status based shift-int gov idle NdRa" VALUE 0x001c7fa4 /* @ECU_Address@SSBSI_NdRa_idle@0x01004440@ */ ECIPP_ALIGNMENT_UWORD 65535 Compu_SSBSI_NdRa_idle 0 65535 /end CHARACTERISTIC
/begin COMPU_METHOD Compu_SSBSI_NdRa_idle " " RAT_FUNC "%.0" "rpm" COEFFS 0 1 0 0 0 1 /end COMPU_METHOD
/begin CHARACTERISTIC SSBSI_NdRa_revlim "Shift-status based shift-int rev lim NdRa" VALUE 0x001c7fa6 /* @ECU_Address@SSBSI_NdRa_revlim@0x01004448@ */ ECIPP_ALIGNMENT_UWORD 65535 Compu_SSBSI_NdRa_revlim 0 65535 /end CHARACTERISTIC
/begin COMPU_METHOD Compu_SSBSI_NdRa_revlim " " RAT_FUNC "%.0" "rpm" COEFFS 0 1 0 0 0 1 /end COMPU_METHOD
/begin CHARACTERISTIC SSBSI_NdRa_rldrpm "Shift-status based shift-int rev lim drpm NdRa" VALUE 0x001c7fa8 /* @ECU_Address@SSBSI_NdRa_rldrpm@0x01004450@ */ ECIPP_ALIGNMENT_UWORD 65535 Compu_SSBSI_NdRa_rldrpm 0 65535 /end CHARACTERISTIC
/begin COMPU_METHOD Compu_SSBSI_NdRa_rldrpm " " RAT_FUNC "%.0" "rpm" COEFFS 0 1 0 0 0 1 /end COMPU_METHOD
/begin CHARACTERISTIC SSBSI_FdRa_idle "Shift-status based shift-int gov idle FdRa" VALUE 0x001c7f94 /* @ECU_Address@SSBSI_FdRa_idle@0x01004458@ */ ECIPP_ALIGNMENT_UWORD 65535 Compu_SSBSI_FdRa_idle 0 65535 /end CHARACTERISTIC
/begin COMPU_METHOD Compu_SSBSI_FdRa_idle " " RAT_FUNC "%.0" "rpm" COEFFS 0 1 0 0 0 1 /end COMPU_METHOD
/begin CHARACTERISTIC SSBSI_FdRa_revlim "Shift-status based shift-int rev lim FdRa" VALUE 0x001c7f96 /* @ECU_Address@SSBSI_FdRa_revlim@0x01004460@ */ ECIPP_ALIGNMENT_UWORD 65535 Compu_SSBSI_FdRa_revlim 0 65535 /end CHARACTERISTIC
/begin COMPU_METHOD Compu_SSBSI_FdRa_revlim " " RAT_FUNC "%.0" "rpm" COEFFS 0 1 0 0 0 1 /end COMPU_METHOD
/begin CHARACTERISTIC SSBSI_FdRa_rldrpm "Shift-status based shift-int rev lim drpm FdRa" VALUE 0x001c7f98 /* @ECU_Address@SSBSI_FdRa_rldrpm@0x01004468@ */ ECIPP_ALIGNMENT_UWORD 65535 Compu_SSBSI_FdRa_rldrpm 0 65535 /end CHARACTERISTIC
/begin COMPU_METHOD Compu_SSBSI_FdRa_rldrpm " " RAT_FUNC "%.0" "rpm" COEFFS 0 1 0 0 0 1 /end COMPU_METHOD
/begin CHARACTERISTIC SSBSI_RdNa_idle "Shift-status based shift-int gov idle RdNa" VALUE 0x001c7fb4 /* @ECU_Address@SSBSI_RdNa_idle@0x01004470@ */ ECIPP_ALIGNMENT_UWORD 65535 Compu_SSBSI_RdNa_idle 0 65535 /end CHARACTERISTIC
/begin COMPU_METHOD Compu_SSBSI_RdNa_idle " " RAT_FUNC "%.0" "rpm" COEFFS 0 1 0 0 0 1 /end COMPU_METHOD
/begin CHARACTERISTIC SSBSI_RdNa_revlim "Shift-status based shift-int rev lim RdNa" VALUE 0x001c7fb6 /* @ECU_Address@SSBSI_RdNa_revlim@0x01004478@ */ ECIPP_ALIGNMENT_UWORD 65535 Compu_SSBSI_RdNa_revlim 0 65535 /end CHARACTERISTIC
/begin COMPU_METHOD Compu_SSBSI_RdNa_revlim " " RAT_FUNC "%.0" "rpm" COEFFS 0 1 0 0 0 1 /end COMPU_METHOD
/begin CHARACTERISTIC SSBSI_RdNa_rldrpm "Shift-status based shift-int rev lim drpm RdNa" VALUE 0x001c7fb8 /* @ECU_Address@SSBSI_RdNa_rldrpm@0x01004480@ */ ECIPP_ALIGNMENT_UWORD 65535 Compu_SSBSI_RdNa_rldrpm 0 65535 /end CHARACTERISTIC
/begin COMPU_METHOD Compu_SSBSI_RdNa_rldrpm " " RAT_FUNC "%.0" "rpm" COEFFS 0 1 0 0 0 1 /end COMPU_METHOD
/begin CHARACTERISTIC SSBSI_FdNa_idle "Shift-status based shift-int gov idle FdNa" VALUE 0x001c7f8c /* @ECU_Address@SSBSI_FdNa_idle@0x01004488@ */ ECIPP_ALIGNMENT_UWORD 65535 Compu_SSBSI_FdNa_idle 0 65535 /end CHARACTERISTIC
/begin COMPU_METHOD Compu_SSBSI_FdNa_idle " " RAT_FUNC "%.0" "rpm" COEFFS 0 1 0 0 0 1 /end COMPU_METHOD
/begin CHARACTERISTIC SSBSI_FdNa_revlim "Shift-status based shift-int rev lim FdNa" VALUE 0x001c7f8e /* @ECU_Address@SSBSI_FdNa_revlim@0x01004490@ */ ECIPP_ALIGNMENT_UWORD 65535 Compu_SSBSI_FdNa_revlim 0 65535 /end CHARACTERISTIC
/begin COMPU_METHOD Compu_SSBSI_FdNa_revlim " " RAT_FUNC "%.0" "rpm" COEFFS 0 1 0 0 0 1 /end COMPU_METHOD
/begin CHARACTERISTIC SSBSI_FdNa_rldrpm "Shift-status based shift-int rev lim drpm FdNa" VALUE 0x001c7f90 /* @ECU_Address@SSBSI_FdNa_rldrpm@0x01004498@ */ ECIPP_ALIGNMENT_UWORD 65535 Compu_SSBSI_FdNa_rldrpm 0 65535 /end CHARACTERISTIC
/begin COMPU_METHOD Compu_SSBSI_FdNa_rldrpm " " RAT_FUNC "%.0" "rpm" COEFFS 0 1 0 0 0 1 /end COMPU_METHOD
/begin CHARACTERISTIC SSBSI_NdFa_idle "Shift-status based shift-int gov idle NdFa" VALUE 0x001c7f9c /* @ECU_Address@SSBSI_NdFa_idle@0x010044A0@ */ ECIPP_ALIGNMENT_UWORD 65535 Compu_SSBSI_NdFa_idle 0 65535 /end CHARACTERISTIC
/begin COMPU_METHOD Compu_SSBSI_NdFa_idle " " RAT_FUNC "%.0" "rpm" COEFFS 0 1 0 0 0 1 /end COMPU_METHOD
/begin CHARACTERISTIC SSBSI_NdFa_revlim "Shift-status based shift-int rev lim NdFa" VALUE 0x001c7f9e /* @ECU_Address@SSBSI_NdFa_revlim@0x010044A8@ */ ECIPP_ALIGNMENT_UWORD 65535 Compu_SSBSI_NdFa_revlim 0 65535 /end CHARACTERISTIC
/begin COMPU_METHOD Compu_SSBSI_NdFa_revlim " " RAT_FUNC "%.0" "rpm" COEFFS 0 1 0 0 0 1 /end COMPU_METHOD
/begin CHARACTERISTIC SSBSI_NdFa_rldrpm "Shift-status based shift-int rev lim drpm NdFa" VALUE 0x001c7fa0 /* @ECU_Address@SSBSI_NdFa_rldrpm@0x010044B0@ */ ECIPP_ALIGNMENT_UWORD 65535 Compu_SSBSI_NdFa_rldrpm 0 65535 /end CHARACTERISTIC
/begin COMPU_METHOD Compu_SSBSI_NdFa_rldrpm " " RAT_FUNC "%.0" "rpm" COEFFS 0 1 0 0 0 1 /end COMPU_METHOD
/begin CHARACTERISTIC SSBSI_RdFa_idle "Shift-status based shift-int gov idle RdFa" VALUE 0x001c7fac /* @ECU_Address@SSBSI_RdFa_idle@0x010044B8@ */ ECIPP_ALIGNMENT_UWORD 65535 Compu_SSBSI_RdFa_idle 0 65535 /end CHARACTERISTIC
/begin COMPU_METHOD Compu_SSBSI_RdFa_idle " " RAT_FUNC "%.0" "rpm" COEFFS 0 1 0 0 0 1 /end COMPU_METHOD
/begin CHARACTERISTIC SSBSI_RdFa_revlim "Shift-status based shift-int rev lim RdFa" VALUE 0x001c7fae /* @ECU_Address@SSBSI_RdFa_revlim@0x010044C0@ */ ECIPP_ALIGNMENT_UWORD 65535 Compu_SSBSI_RdFa_revlim 0 65535 /end CHARACTERISTIC
/begin COMPU_METHOD Compu_SSBSI_RdFa_revlim " " RAT_FUNC "%.0" "rpm" COEFFS 0 1 0 0 0 1 /end COMPU_METHOD
/begin CHARACTERISTIC SSBSI_RdFa_rldrpm "Shift-status based shift-int rev lim drpm RdFa" VALUE 0x001c7fb0 /* @ECU_Address@SSBSI_RdFa_rldrpm@0x010044C8@ */ ECIPP_ALIGNMENT_UWORD 65535 Compu_SSBSI_RdFa_rldrpm 0 65535 /end CHARACTERISTIC
/begin COMPU_METHOD Compu_SSBSI_RdFa_rldrpm " " RAT_FUNC "%.0" "rpm" COEFFS 0 1 0 0 0 1 /end COMPU_METHOD
/begin MEASUREMENT SIS_idle "Shift interrupt idle target" UWORD Compu_SIS_idle 0 0 0 65535 ECU_ADDRESS 0x010044E0 /end MEASUREMENT
/begin COMPU_METHOD Compu_SIS_idle " " RAT_FUNC "%.0" "rpm" COEFFS 0 1 0 0 0 1 /end COMPU_METHOD
/begin MEASUREMENT SIS_revlim "Shift interrupt fuel rev limit" UWORD Compu_SIS_revlim 0 0 0 65535 ECU_ADDRESS 0x010044E8 /end MEASUREMENT
/begin COMPU_METHOD Compu_SIS_revlim " " RAT_FUNC "%.0" "rpm" COEFFS 0 1 0 0 0 1 /end COMPU_METHOD
/begin MEASUREMENT SIS_revlim_drpm "Shift interrupt rev lim delta-rpm" UWORD Compu_SIS_revlim_drpm 0 0 0 65535 ECU_ADDRESS 0x010044F0 /end MEASUREMENT
/begin COMPU_METHOD Compu_SIS_revlim_drpm " " RAT_FUNC "%.0" "rpm" COEFFS 0 1 0 0 0 1 /end COMPU_METHOD
/begin CHARACTERISTIC ShftInt_revlim_drpm "Shift interrupt switch rev lim delta-rpm" VALUE 0x001c7fd4 /* @ECU_Address@ShftInt_revlim_drpm@0x010044F8@ */ ECIPP_ALIGNMENT_UWORD 65535 Compu_ShftInt_revlim_drpm 0 65535 /end CHARACTERISTIC
/begin COMPU_METHOD Compu_ShftInt_revlim_drpm " " RAT_FUNC "%.0" "rpm" COEFFS 0 1 0 0 0 1 /end COMPU_METHOD
/begin MEASUREMENT torque_Nm_max "Max gross torque" UWORD Compu_torque_Nm_max 0 0 0 16383.75 ECU_ADDRESS 0x01004508 /end MEASUREMENT
/begin COMPU_METHOD Compu_torque_Nm_max " " RAT_FUNC "%.1" "N-m" COEFFS 0 4 0 0 0 1 /end COMPU_METHOD
/begin CHARACTERISTIC MES_FPP_mode "MES lever control mode{MES_FPP_mode&0xff=0:Master Lever}{MES_FPP_mode&0xff=1:Lever Match}" VALUE 0x001c8821 /* @ECU_Address@MES_FPP_mode@0x01004570@ */ ECIPP_ALIGNMENT_UBYTE 255 MES_FPP_mode_COMPU_VTAB 0 255 BIT_MASK 0xff /end CHARACTERISTIC
/begin COMPU_METHOD MES_FPP_mode_COMPU_VTAB "Verbal Table" TAB_VERB "%.0" "list" COMPU_TAB_REF MES_FPP_mode_COMPU_VTAB_REF /end COMPU_METHOD
/begin COMPU_VTAB MES_FPP_mode_COMPU_VTAB_REF "Verbal Table" TAB_VERB 2 0 "Master Lever" 1 "Lever Match" DEFAULT_VALUE "UNKNOWN" /end COMPU_VTAB
/begin CHARACTERISTIC MES_FPPdelt_1 "MES +/- lever match full engagement" VALUE 0x001c7d6c /* @ECU_Address@MES_FPPdelt_1@0x01004578@ */ ECIPP_ALIGNMENT_UWORD 200 Compu_MES_FPPdelt_1 0 199.996948242188 /end CHARACTERISTIC
/begin COMPU_METHOD Compu_MES_FPPdelt_1 " " RAT_FUNC "%.1" "%" COEFFS 0 327.68 0 0 0 1 /end COMPU_METHOD
/begin CHARACTERISTIC MES_FPPdelt_0 "MES +/- lever match disengaged" VALUE 0x001c7d6a /* @ECU_Address@MES_FPPdelt_0@0x01004580@ */ ECIPP_ALIGNMENT_UWORD 200 Compu_MES_FPPdelt_0 0 199.996948242188 /end CHARACTERISTIC
/begin COMPU_METHOD Compu_MES_FPPdelt_0 " " RAT_FUNC "%.1" "%" COEFFS 0 327.68 0 0 0 1 /end COMPU_METHOD
/begin CHARACTERISTIC VP_shift_rpmmax "VP maximum shift speed" VALUE 0x001c8338 /* @ECU_Address@VP_shift_rpmmax@0x01004630@ */ ECIPP_ALIGNMENT_UWORD 65535 Compu_VP_shift_rpmmax 0 65535 /end CHARACTERISTIC
/begin COMPU_METHOD Compu_VP_shift_rpmmax " " RAT_FUNC "%.0" "rpm" COEFFS 0 1 0 0 0 1 /end COMPU_METHOD
/begin CHARACTERISTIC VP_shift_rpmd "VP target shift speed" VALUE 0x001c8336 /* @ECU_Address@VP_shift_rpmd@0x01004638@ */ ECIPP_ALIGNMENT_UWORD 65535 Compu_VP_shift_rpmd 0 65535 /end CHARACTERISTIC
/begin COMPU_METHOD Compu_VP_shift_rpmd " " RAT_FUNC "%.0" "rpm" COEFFS 0 1 0 0 0 1 /end COMPU_METHOD
/begin CHARACTERISTIC VP_troll_rpmmax "VP maximum troll speed" VALUE 0x001c833c /* @ECU_Address@VP_troll_rpmmax@0x01004640@ */ ECIPP_ALIGNMENT_UWORD 65535 Compu_VP_troll_rpmmax 0 65535 /end CHARACTERISTIC
/begin COMPU_METHOD Compu_VP_troll_rpmmax " " RAT_FUNC "%.0" "rpm" COEFFS 0 1 0 0 0 1 /end COMPU_METHOD
/begin CHARACTERISTIC SSBSI_NdRa_Kspkret "Shift-status based shift-int spark ret gain NdRa" VALUE 0x001c7fa2 /* @ECU_Address@SSBSI_NdRa_Kspkret@0x010046A0@ */ ECIPP_ALIGNMENT_UWORD 128 Compu_SSBSI_NdRa_Kspkret 0 127.998046875 /end CHARACTERISTIC
/begin COMPU_METHOD Compu_SSBSI_NdRa_Kspkret " " RAT_FUNC "%.2" "CAD/rpm" COEFFS 0 512 0 0 0 1 /end COMPU_METHOD
/begin CHARACTERISTIC SSBSI_FdRa_Kspkret "Shift-status based shift-int spark ret gain FdRa" VALUE 0x001c7f92 /* @ECU_Address@SSBSI_FdRa_Kspkret@0x010046A8@ */ ECIPP_ALIGNMENT_UWORD 128 Compu_SSBSI_FdRa_Kspkret 0 127.998046875 /end CHARACTERISTIC
/begin COMPU_METHOD Compu_SSBSI_FdRa_Kspkret " " RAT_FUNC "%.2" "CAD/rpm" COEFFS 0 512 0 0 0 1 /end COMPU_METHOD
/begin CHARACTERISTIC SSBSI_RdNa_Kspkret "Shift-status based shift-int spark ret gain RdNa" VALUE 0x001c7fb2 /* @ECU_Address@SSBSI_RdNa_Kspkret@0x010046B0@ */ ECIPP_ALIGNMENT_UWORD 128 Compu_SSBSI_RdNa_Kspkret 0 127.998046875 /end CHARACTERISTIC
/begin COMPU_METHOD Compu_SSBSI_RdNa_Kspkret " " RAT_FUNC "%.2" "CAD/rpm" COEFFS 0 512 0 0 0 1 /end COMPU_METHOD
/begin CHARACTERISTIC SSBSI_FdNa_Kspkret "Shift-status based shift-int spark ret gain FdNa" VALUE 0x001c7f8a /* @ECU_Address@SSBSI_FdNa_Kspkret@0x010046B8@ */ ECIPP_ALIGNMENT_UWORD 128 Compu_SSBSI_FdNa_Kspkret 0 127.998046875 /end CHARACTERISTIC
/begin COMPU_METHOD Compu_SSBSI_FdNa_Kspkret " " RAT_FUNC "%.2" "CAD/rpm" COEFFS 0 512 0 0 0 1 /end COMPU_METHOD
/begin CHARACTERISTIC SSBSI_NdFa_Kspkret "Shift-status based shift-int spark ret gain NdFa" VALUE 0x001c7f9a /* @ECU_Address@SSBSI_NdFa_Kspkret@0x010046C0@ */ ECIPP_ALIGNMENT_UWORD 128 Compu_SSBSI_NdFa_Kspkret 0 127.998046875 /end CHARACTERISTIC
/begin COMPU_METHOD Compu_SSBSI_NdFa_Kspkret " " RAT_FUNC "%.2" "CAD/rpm" COEFFS 0 512 0 0 0 1 /end COMPU_METHOD
/begin CHARACTERISTIC SSBSI_RdFa_Kspkret "Shift-status based shift-int spark ret gain RdFa" VALUE 0x001c7faa /* @ECU_Address@SSBSI_RdFa_Kspkret@0x010046C8@ */ ECIPP_ALIGNMENT_UWORD 128 Compu_SSBSI_RdFa_Kspkret 0 127.998046875 /end CHARACTERISTIC
/begin COMPU_METHOD Compu_SSBSI_RdFa_Kspkret " " RAT_FUNC "%.2" "CAD/rpm" COEFFS 0 512 0 0 0 1 /end COMPU_METHOD
/begin CHARACTERISTIC ShftInt_Kspkret "Shift interrupt switch spark retard gain" VALUE 0x001c7fcc /* @ECU_Address@ShftInt_Kspkret@0x010046D0@ */ ECIPP_ALIGNMENT_UWORD 128 Compu_ShftInt_Kspkret 0 127.998046875 /end CHARACTERISTIC
/begin COMPU_METHOD Compu_ShftInt_Kspkret " " RAT_FUNC "%.2" "CAD/rpm" COEFFS 0 512 0 0 0 1 /end COMPU_METHOD
/begin MEASUREMENT SIS_Kspkret "Currently active shift interrupt spark ret gain" UWORD Compu_SIS_Kspkret 0 0 0 127.998046875 ECU_ADDRESS 0x010046D8 /end MEASUREMENT
/begin COMPU_METHOD Compu_SIS_Kspkret " " RAT_FUNC "%.2" "CAD/rpm" COEFFS 0 512 0 0 0 1 /end COMPU_METHOD
/begin MEASUREMENT SIS_spk_mod "Current shift interrupt spark adv modifier" SWORD Compu_SIS_spk_mod 0 0 -2048 2047.9375 ECU_ADDRESS 0x010046E0 /end MEASUREMENT
/begin COMPU_METHOD Compu_SIS_spk_mod " " RAT_FUNC "%.1" "CAD BTDC" COEFFS 0 16 0 0 0 1 /end COMPU_METHOD
/begin CHARACTERISTIC SIS_spkret_dz "Shift interrupt spark retard rpm deadzone" VALUE 0x001c7f5e /* @ECU_Address@SIS_spkret_dz@0x010046E8@ */ ECIPP_ALIGNMENT_UWORD 65535 Compu_SIS_spkret_dz 0 65535 /end CHARACTERISTIC
/begin COMPU_METHOD Compu_SIS_spkret_dz " " RAT_FUNC "%.0" "rpm" COEFFS 0 1 0 0 0 1 /end COMPU_METHOD
/begin CHARACTERISTIC SIS_spkret_max "Shift interrupt spark retard maximum" VALUE 0x001c459a /* @ECU_Address@SIS_spkret_max@0x010046F0@ */ ECIPP_ALIGNMENT_SWORD 2048 Compu_SIS_spkret_max -2048 2047.9375 /end CHARACTERISTIC
/begin COMPU_METHOD Compu_SIS_spkret_max " " RAT_FUNC "%.1" "CAD retard" COEFFS 0 16 0 0 0 1 /end COMPU_METHOD
/begin CHARACTERISTIC SIS_FF_load "Shift interrupt in-gear feedforward load" VALUE 0x001c4598 /* @ECU_Address@SIS_FF_load@0x010046F8@ */ ECIPP_ALIGNMENT_SWORD 800 Compu_SIS_FF_load -800 799.9755859375 /end CHARACTERISTIC
/begin COMPU_METHOD Compu_SIS_FF_load " " RAT_FUNC "%.1" "% load" COEFFS 0 40.96 0 0 0 1 /end COMPU_METHOD
/begin CHARACTERISTIC EMWT_HiExp1_abs "EMWT HiExp stage 1 absolute temp limit (Fault Condition:EMWT temperature >)" VALUE 0x001C9CFA /* @ECU_Address@EMWT_HiExp1_abs@0x010048D0@ */ ECIPP_ALIGNMENT_UWORD 7732 Compu_EMWT_HiExp1_abs -460 7731.875 /end CHARACTERISTIC
/begin COMPU_METHOD Compu_EMWT_HiExp1_abs " " RAT_FUNC "%.1" "deg F" COEFFS 0 8 3680 0 0 1 /end COMPU_METHOD
/begin CHARACTERISTIC EMWT_HiExp1_delt "EMWT HiExp stage 1 max delta from estimate (Fault Condition:or EMWT temp > estimated temp +)" VALUE 0x001C9CFC /* @ECU_Address@EMWT_HiExp1_delt@0x010048D8@ */ ECIPP_ALIGNMENT_UWORD 8192 Compu_EMWT_HiExp1_delt 0 8191.875 /end CHARACTERISTIC
/begin COMPU_METHOD Compu_EMWT_HiExp1_delt " " RAT_FUNC "%.1" "deg F" COEFFS 0 8 0 0 0 1 /end COMPU_METHOD
/begin CHARACTERISTIC EMWT_HiExp2_abs "EMWT HiExp stage 2 absolute temp limit (Fault Condition:EMWT temperature >)" VALUE 0x001C9CFE /* @ECU_Address@EMWT_HiExp2_abs@0x010048E0@ */ ECIPP_ALIGNMENT_UWORD 7732 Compu_EMWT_HiExp2_abs -460 7731.875 /end CHARACTERISTIC
/begin COMPU_METHOD Compu_EMWT_HiExp2_abs " " RAT_FUNC "%.1" "deg F" COEFFS 0 8 3680 0 0 1 /end COMPU_METHOD
/begin CHARACTERISTIC EMWT_HiExp2_delt "EMWT HiExp stage 2 max delta from estimate (Fault Condition:or EMWT temp > estimated temp +)" VALUE 0x001C9D00 /* @ECU_Address@EMWT_HiExp2_delt@0x010048E8@ */ ECIPP_ALIGNMENT_UWORD 8192 Compu_EMWT_HiExp2_delt 0 8191.875 /end CHARACTERISTIC
/begin COMPU_METHOD Compu_EMWT_HiExp2_delt " " RAT_FUNC "%.1" "deg F" COEFFS 0 8 0 0 0 1 /end COMPU_METHOD
/begin CHARACTERISTIC EMWT1_ena "EMWT1 sensor enable{EMWT1_ena&0xff=0:Disabled}{EMWT1_ena&0xff=1:EGT input}{EMWT1_ena&0xff=2:Aux PU1}{EMWT1_ena&0xff=3:Aux PU2}{EMWT1_ena&0xff=4:Aux PU3}{EMWT1_ena&0xff=5:Aux PUD1}{EMWT1_ena&0xff=6:Aux PUD2}{EMWT1_ena&0xff=7:Aux PUD3}{EMWT1_ena&0xff=8:Aux " VALUE 0x001c86e5 /* @ECU_Address@EMWT1_ena@0x010048F0@ */ ECIPP_ALIGNMENT_UBYTE 255 EMWT1_ena_COMPU_VTAB 0 255 BIT_MASK 0xff /end CHARACTERISTIC
/begin COMPU_METHOD EMWT1_ena_COMPU_VTAB "Verbal Table" TAB_VERB "%.0" "list" COMPU_TAB_REF EMWT1_ena_COMPU_VTAB_REF /end COMPU_METHOD
/begin COMPU_VTAB EMWT1_ena_COMPU_VTAB_REF "Verbal Table" TAB_VERB 13 0 "Disabled" 1 "EGT input" 2 "Aux PU1" 3 "Aux PU2" 4 "Aux PU3" 5 "Aux PUD1" 6 "Aux PUD2" 7 "Aux PUD3" 8 "Aux PUD4" 9 "Aux PUD5" 10 "Aux PUD6" 11 "Aux PUD7" 12 "Aux PUD8" DEFAULT_VALUE "UNKNOWN" /end COMPU_VTAB
/begin CHARACTERISTIC EMWT2_ena "EMWT2 sensor enable{EMWT2_ena&0xff=0:Disabled}{EMWT2_ena&0xff=1:EGT input}{EMWT2_ena&0xff=2:Aux PU1}{EMWT2_ena&0xff=3:Aux PU2}{EMWT2_ena&0xff=4:Aux PU3}{EMWT2_ena&0xff=5:Aux PUD1}{EMWT2_ena&0xff=6:Aux PUD2}{EMWT2_ena&0xff=7:Aux PUD3}{EMWT2_ena&0xff=8:Aux " VALUE 0x001c86e7 /* @ECU_Address@EMWT2_ena@0x010048F8@ */ ECIPP_ALIGNMENT_UBYTE 255 EMWT2_ena_COMPU_VTAB 0 255 BIT_MASK 0xff /end CHARACTERISTIC
/begin COMPU_METHOD EMWT2_ena_COMPU_VTAB "Verbal Table" TAB_VERB "%.0" "list" COMPU_TAB_REF EMWT2_ena_COMPU_VTAB_REF /end COMPU_METHOD
/begin COMPU_VTAB EMWT2_ena_COMPU_VTAB_REF "Verbal Table" TAB_VERB 13 0 "Disabled" 1 "EGT input" 2 "Aux PU1" 3 "Aux PU2" 4 "Aux PU3" 5 "Aux PUD1" 6 "Aux PUD2" 7 "Aux PUD3" 8 "Aux PUD4" 9 "Aux PUD5" 10 "Aux PUD6" 11 "Aux PUD7" 12 "Aux PUD8" DEFAULT_VALUE "UNKNOWN" /end COMPU_VTAB
/begin CHARACTERISTIC EMWT_run_wait "EMWT fault wait time after start (Fault Condition:run time wait for all HiExp faults:)" VALUE 0x001C9CEC /* @ECU_Address@EMWT_run_wait@0x01004900@ */ ECIPP_ALIGNMENT_ULONG 4294967 Compu_EMWT_run_wait 0 4294967.295 /end CHARACTERISTIC
/begin COMPU_METHOD Compu_EMWT_run_wait " " RAT_FUNC "%.1" "sec" COEFFS 0 1000 0 0 0 1 /end COMPU_METHOD
/begin CHARACTERISTIC EMWT_sensor_tau "EMWT sensor time constant" VALUE 0x001C9CF4 /* @ECU_Address@EMWT_sensor_tau@0x01004908@ */ ECIPP_ALIGNMENT_UWORD 3276795 Compu_EMWT_sensor_tau 4.5084 3276800 /end CHARACTERISTIC
/begin COMPU_METHOD Compu_EMWT_sensor_tau " " FORM "%.0" "ms"
 /begin FORMULA "-50 / log(1 - (X1 / 65536))" FORMULA_INV "(1 - exp(-50/X1)) * 65536" /end FORMULA
/end COMPU_METHOD
/begin CHARACTERISTIC EMWT_in_s "EMWT standard inlet temperature" VALUE 0x001C9CF2 /* @ECU_Address@EMWT_in_s@0x01004910@ */ ECIPP_ALIGNMENT_UWORD 7732 Compu_EMWT_in_s -460 7731.875 /end CHARACTERISTIC
/begin COMPU_METHOD Compu_EMWT_in_s " " RAT_FUNC "%.1" "deg F" COEFFS 0 8 3680 0 0 1 /end COMPU_METHOD
/begin CHARACTERISTIC EMWT_CWT_C "EMWT CWT correction coefficient" VALUE 0x001C9CF0 /* @ECU_Address@EMWT_CWT_C@0x01004918@ */ ECIPP_ALIGNMENT_SWORD 41 Compu_EMWT_CWT_C -40.96 40.95875 /end CHARACTERISTIC
/begin COMPU_METHOD Compu_EMWT_CWT_C " " RAT_FUNC "%.1" "-deg F / % CWT VE" COEFFS 0 800 0 0 0 1 /end COMPU_METHOD
/begin MEASUREMENT EMWT_in "EMWT inlet temperature" UWORD Compu_EMWT_in 0 0 -460 7731.875 ECU_ADDRESS 0x01004920 /end MEASUREMENT
/begin COMPU_METHOD Compu_EMWT_in " " RAT_FUNC "%.1" "deg F" COEFFS 0 8 3680 0 0 1 /end COMPU_METHOD
/begin MEASUREMENT EMWT_ss_rise "EMWT steady-state temp rise" SWORD Compu_EMWT_ss_rise 0 0 -4096 4095.875 ECU_ADDRESS 0x01004928 /end MEASUREMENT
/begin COMPU_METHOD Compu_EMWT_ss_rise " " RAT_FUNC "%.1" "delta deg F" COEFFS 0 8 0 0 0 1 /end COMPU_METHOD
/begin MEASUREMENT EMWT_est "EMWT model estimation" UWORD Compu_EMWT_est 0 0 -460 7731.875 ECU_ADDRESS 0x01004930 /end MEASUREMENT
/begin COMPU_METHOD Compu_EMWT_est " " RAT_FUNC "%.1" "deg F" COEFFS 0 8 3680 0 0 1 /end COMPU_METHOD
/begin MEASUREMENT EMWT1 "EMWT1 sensor temperature" UWORD Compu_EMWT1 0 0 -460 7731.875 ECU_ADDRESS 0x01004938 /end MEASUREMENT
/begin COMPU_METHOD Compu_EMWT1 " " RAT_FUNC "%.1" "deg F" COEFFS 0 8 3680 0 0 1 /end COMPU_METHOD
/begin MEASUREMENT EMWT2 "EMWT2 sensor temperature" UWORD Compu_EMWT2 0 0 -460 7731.875 ECU_ADDRESS 0x01004940 /end MEASUREMENT
/begin COMPU_METHOD Compu_EMWT2 " " RAT_FUNC "%.1" "deg F" COEFFS 0 8 3680 0 0 1 /end COMPU_METHOD
/begin MEASUREMENT FPPTPSnl_cur "Currently active non-linear option{FPPTPSnl_cur&0xff=0:Option 1}{FPPTPSnl_cur&0xff=1:Option 2}{FPPTPSnl_cur&0xff=2:Option 3}{FPPTPSnl_cur&0xff=3:3-Point Table}{FPPTPSnl_cur&0xff=4:2D Table}{FPPTPSnl_cur&0xff=5:None}" UBYTE FPPTPSnl_cur_COMPU_VTAB 0 0 0 255 ECU_ADDRESS 0x01004B98 BIT_MASK 0xff /end MEASUREMENT
/begin COMPU_METHOD FPPTPSnl_cur_COMPU_VTAB "Verbal Table" TAB_VERB "%.0" "list" COMPU_TAB_REF FPPTPSnl_cur_COMPU_VTAB_REF /end COMPU_METHOD
/begin COMPU_VTAB FPPTPSnl_cur_COMPU_VTAB_REF "Verbal Table" TAB_VERB 6 0 "Option 1" 1 "Option 2" 2 "Option 3" 3 "3-Point Table" 4 "2D Table" 5 "None" DEFAULT_VALUE "UNKNOWN" /end COMPU_VTAB
/begin CHARACTERISTIC TORM_ena "TORM system{TORM_ena&0xff=0:Disabled}{TORM_ena&0xff=1:Always Available}{TORM_ena&0xff=2:Network - Default Off}{TORM_ena&0xff=3:Network - Default On}" VALUE 0x001c8f40 /* @ECU_Address@TORM_ena@0x01004C28@ */ ECIPP_ALIGNMENT_UBYTE 255 TORM_ena_COMPU_VTAB 0 255 BIT_MASK 0xff /end CHARACTERISTIC
/begin COMPU_METHOD TORM_ena_COMPU_VTAB "Verbal Table" TAB_VERB "%.0" "list" COMPU_TAB_REF TORM_ena_COMPU_VTAB_REF /end COMPU_METHOD
/begin COMPU_VTAB TORM_ena_COMPU_VTAB_REF "Verbal Table" TAB_VERB 4 0 "Disabled" 1 "Always Available" 2 "Network - Default Off" 3 "Network - Default On" DEFAULT_VALUE "UNKNOWN" /end COMPU_VTAB
/begin CHARACTERISTIC TORM_FPPdelt_ini "TORM initialization FPP tol" VALUE 0x001c8190 /* @ECU_Address@TORM_FPPdelt_ini@0x01004C30@ */ ECIPP_ALIGNMENT_UWORD 100 Compu_TORM_FPPdelt_ini 0 99.9984741210938 /end CHARACTERISTIC
/begin COMPU_METHOD Compu_TORM_FPPdelt_ini " " RAT_FUNC "%.1" "%" COEFFS 0 655.36 0 0 0 1 /end COMPU_METHOD
/begin CHARACTERISTIC TORM_FPPdelt_mon "TORM monitor FPP tol" VALUE 0x001c8192 /* @ECU_Address@TORM_FPPdelt_mon@0x01004C38@ */ ECIPP_ALIGNMENT_UWORD 100 Compu_TORM_FPPdelt_mon 0 99.9984741210938 /end CHARACTERISTIC
/begin COMPU_METHOD Compu_TORM_FPPdelt_mon " " RAT_FUNC "%.1" "%" COEFFS 0 655.36 0 0 0 1 /end COMPU_METHOD
/begin CHARACTERISTIC TORM_FPP_rampback "TORM FPP dissipation rate" VALUE 0x001c818e /* @ECU_Address@TORM_FPP_rampback@0x01004C40@ */ ECIPP_ALIGNMENT_UWORD 391 Compu_TORM_FPP_rampback 0 390.619039535522 /end CHARACTERISTIC
/begin COMPU_METHOD Compu_TORM_FPP_rampback " " RAT_FUNC "%.1" "%/sec" COEFFS 0 167.77216 0 0 0 1 /end COMPU_METHOD
/begin CHARACTERISTIC TORM_monvalid_t "TORM initialization wait" VALUE 0x001c819a /* @ECU_Address@TORM_monvalid_t@0x01004C48@ */ ECIPP_ALIGNMENT_UWORD 65535 Compu_TORM_monvalid_t 0 65535 /end CHARACTERISTIC
/begin COMPU_METHOD Compu_TORM_monvalid_t " " RAT_FUNC "%.0" "ms" COEFFS 0 1 0 0 0 1 /end COMPU_METHOD
/begin CHARACTERISTIC TORM_FPP_tau1 "TORM init/monitor FPPss tau" VALUE 0x001c8608 /* @ECU_Address@TORM_FPP_tau1@0x01004C50@ */ ECIPP_ALIGNMENT_UWORD 327680 Compu_TORM_FPP_tau1 0.45084 327680 /end CHARACTERISTIC
/begin COMPU_METHOD Compu_TORM_FPP_tau1 " " FORM "%.0" "ms"
 /begin FORMULA "-5 / log(1 - (X1 / 65536))" FORMULA_INV "(1 - exp(-5/X1)) * 65536" /end FORMULA
/end COMPU_METHOD
/begin CHARACTERISTIC TORM_rpm_tol "TORM initialization rpm tol" VALUE 0x001c819c /* @ECU_Address@TORM_rpm_tol@0x01004C58@ */ ECIPP_ALIGNMENT_UWORD 65535 Compu_TORM_rpm_tol 0 65535 /end CHARACTERISTIC
/begin COMPU_METHOD Compu_TORM_rpm_tol " " RAT_FUNC "%.0" "rpm" COEFFS 0 1 0 0 0 1 /end COMPU_METHOD
/begin CHARACTERISTIC TORM_RS_tol "TORM initialization roadspeed tol" VALUE 0x001c8196 /* @ECU_Address@TORM_RS_tol@0x01004C60@ */ ECIPP_ALIGNMENT_UWORD 256 Compu_TORM_RS_tol 0 255.99609375 /end CHARACTERISTIC
/begin COMPU_METHOD Compu_TORM_RS_tol " " RAT_FUNC "%.1" "kph" COEFFS 0 256 0 0 0 1 /end COMPU_METHOD
/begin MEASUREMENT TORM_rpm_delt "TORM delta-rpm command" SWORD Compu_TORM_rpm_delt 0 0 -32768 32767 ECU_ADDRESS 0x01004C68 /end MEASUREMENT
/begin COMPU_METHOD Compu_TORM_rpm_delt " " RAT_FUNC "%.0" "rpm" COEFFS 0 1 0 0 0 1 /end COMPU_METHOD
/begin MEASUREMENT TORM_active "TORM active{TORM_active&0xff=0:Inactive}{TORM_active&0xff=1:Active}" UBYTE TORM_active_COMPU_VTAB 0 0 0 255 ECU_ADDRESS 0x01004C70 BIT_MASK 0xff /end MEASUREMENT
/begin COMPU_METHOD TORM_active_COMPU_VTAB "Verbal Table" TAB_VERB "%.0" "list" COMPU_TAB_REF TORM_active_COMPU_VTAB_REF /end COMPU_METHOD
/begin COMPU_VTAB TORM_active_COMPU_VTAB_REF "Verbal Table" TAB_VERB 2 0 "Inactive" 1 "Active" DEFAULT_VALUE "UNKNOWN" /end COMPU_VTAB
/begin MEASUREMENT TORM_state "TORM state{TORM_state&0xff=0:Offline}{TORM_state&0xff=1:Wait for SS}{TORM_state&0xff=2:Monitoring}{TORM_state&0xff=3:Active}" UBYTE TORM_state_COMPU_VTAB 0 0 0 255 ECU_ADDRESS 0x01004C78 BIT_MASK 0xff /end MEASUREMENT
/begin COMPU_METHOD TORM_state_COMPU_VTAB "Verbal Table" TAB_VERB "%.0" "list" COMPU_TAB_REF TORM_state_COMPU_VTAB_REF /end COMPU_METHOD
/begin COMPU_VTAB TORM_state_COMPU_VTAB_REF "Verbal Table" TAB_VERB 4 0 "Offline" 1 "Wait for SS" 2 "Monitoring" 3 "Active" DEFAULT_VALUE "UNKNOWN" /end COMPU_VTAB
/begin MEASUREMENT TORM_FPP_cmd_ss "TORM steady-state FPP" UWORD Compu_TORM_FPP_cmd_ss 0 0 0 99.9984741210938 ECU_ADDRESS 0x01004C80 /end MEASUREMENT
/begin COMPU_METHOD Compu_TORM_FPP_cmd_ss " " RAT_FUNC "%.1" "%" COEFFS 0 655.36 0 0 0 1 /end COMPU_METHOD
/begin CHARACTERISTIC TORM_RS_phaset "TORM RS control phase-in time" VALUE 0x001c8194 /* @ECU_Address@TORM_RS_phaset@0x01004C88@ */ ECIPP_ALIGNMENT_UWORD 65535 Compu_TORM_RS_phaset 0 65535 /end CHARACTERISTIC
/begin COMPU_METHOD Compu_TORM_RS_phaset " " RAT_FUNC "%.0" "ms" COEFFS 0 1 0 0 0 1 /end COMPU_METHOD
/begin MEASUREMENT TORM_RS_phase "TORM RS control phase-in" UWORD Compu_TORM_RS_phase 0 0 0 99.9984741210938 ECU_ADDRESS 0x01004CA8 /end MEASUREMENT
/begin COMPU_METHOD Compu_TORM_RS_phase " " RAT_FUNC "%.0" "%" COEFFS 0 655.36 0 0 0 1 /end COMPU_METHOD
/begin CHARACTERISTIC MES_WOT_desync "MES WOT de-sync feature{MES_WOT_desync&0xff=0:Disabled}{MES_WOT_desync&0xff=1:Enabled}" VALUE 0x001c8822 /* @ECU_Address@MES_WOT_desync@0x01004D68@ */ ECIPP_ALIGNMENT_UBYTE 255 MES_WOT_desync_COMPU_VTAB 0 255 BIT_MASK 0xff /end CHARACTERISTIC
/begin COMPU_METHOD MES_WOT_desync_COMPU_VTAB "Verbal Table" TAB_VERB "%.0" "list" COMPU_TAB_REF MES_WOT_desync_COMPU_VTAB_REF /end COMPU_METHOD
/begin COMPU_VTAB MES_WOT_desync_COMPU_VTAB_REF "Verbal Table" TAB_VERB 2 0 "Disabled" 1 "Enabled" DEFAULT_VALUE "UNKNOWN" /end COMPU_VTAB
/begin CHARACTERISTIC MES_WOTds_1 "MES WOT de-sync FPP initiate" VALUE 0x001c7d70 /* @ECU_Address@MES_WOTds_1@0x01004D70@ */ ECIPP_ALIGNMENT_UWORD 200 Compu_MES_WOTds_1 0 199.996948242188 /end CHARACTERISTIC
/begin COMPU_METHOD Compu_MES_WOTds_1 " " RAT_FUNC "%.1" "%" COEFFS 0 327.68 0 0 0 1 /end COMPU_METHOD
/begin CHARACTERISTIC MES_WOTds_0 "MES WOT de-sync FPP complete" VALUE 0x001c7d6e /* @ECU_Address@MES_WOTds_0@0x01004D78@ */ ECIPP_ALIGNMENT_UWORD 200 Compu_MES_WOTds_0 0 199.996948242188 /end CHARACTERISTIC
/begin COMPU_METHOD Compu_MES_WOTds_0 " " RAT_FUNC "%.1" "%" COEFFS 0 327.68 0 0 0 1 /end COMPU_METHOD
/begin MEASUREMENT SHIFT_FB_raw "SHIFT_FB_raw" UWORD Compu_SHIFT_FB_raw 0 0 0 5.00114468864469 ECU_ADDRESS 0x01004FB8 /end MEASUREMENT
/begin COMPU_METHOD Compu_SHIFT_FB_raw " " RAT_FUNC "%.3" "volts" COEFFS 0 13104 0 0 0 1 /end COMPU_METHOD
/begin CHARACTERISTIC ERWT_HiExp1_abs "ERWT HiExp stage 1 absolute temp limit (Fault Condition:ERWT temperature >)" VALUE 0x001C9D12 /* @ECU_Address@ERWT_HiExp1_abs@0x01004FD0@ */ ECIPP_ALIGNMENT_UWORD 7732 Compu_ERWT_HiExp1_abs -460 7731.875 /end CHARACTERISTIC
/begin COMPU_METHOD Compu_ERWT_HiExp1_abs " " RAT_FUNC "%.1" "deg F" COEFFS 0 8 3680 0 0 1 /end COMPU_METHOD
/begin CHARACTERISTIC ERWT_HiExp1_delt "ERWT HiExp stage 1 max delta from estimate (Fault Condition:or ERWT temp > estimated temp +)" VALUE 0x001C9D14 /* @ECU_Address@ERWT_HiExp1_delt@0x01004FD8@ */ ECIPP_ALIGNMENT_UWORD 8192 Compu_ERWT_HiExp1_delt 0 8191.875 /end CHARACTERISTIC
/begin COMPU_METHOD Compu_ERWT_HiExp1_delt " " RAT_FUNC "%.1" "deg F" COEFFS 0 8 0 0 0 1 /end COMPU_METHOD
/begin CHARACTERISTIC ERWT_HiExp2_abs "ERWT HiExp stage 2 absolute temp limit (Fault Condition:ERWT temperature >)" VALUE 0x001C9D16 /* @ECU_Address@ERWT_HiExp2_abs@0x01004FE0@ */ ECIPP_ALIGNMENT_UWORD 7732 Compu_ERWT_HiExp2_abs -460 7731.875 /end CHARACTERISTIC
/begin COMPU_METHOD Compu_ERWT_HiExp2_abs " " RAT_FUNC "%.1" "deg F" COEFFS 0 8 3680 0 0 1 /end COMPU_METHOD
/begin CHARACTERISTIC ERWT_HiExp2_delt "ERWT HiExp stage 2 max delta from estimate (Fault Condition:or ERWT temp > estimated temp +)" VALUE 0x001C9D18 /* @ECU_Address@ERWT_HiExp2_delt@0x01004FE8@ */ ECIPP_ALIGNMENT_UWORD 8192 Compu_ERWT_HiExp2_delt 0 8191.875 /end CHARACTERISTIC
/begin COMPU_METHOD Compu_ERWT_HiExp2_delt " " RAT_FUNC "%.1" "deg F" COEFFS 0 8 0 0 0 1 /end COMPU_METHOD
/begin CHARACTERISTIC ERWT1_ena "ERWT1 sensor enable{ERWT1_ena&0xff=0:Disabled}{ERWT1_ena&0xff=1:EGT input}{ERWT1_ena&0xff=2:Aux PU1}{ERWT1_ena&0xff=3:Aux PU2}{ERWT1_ena&0xff=4:Aux PU3}{ERWT1_ena&0xff=5:Aux PUD1}{ERWT1_ena&0xff=6:Aux PUD2}{ERWT1_ena&0xff=7:Aux PUD3}{ERWT1_ena&0xff=8:Aux " VALUE 0x001c86eb /* @ECU_Address@ERWT1_ena@0x01004FF0@ */ ECIPP_ALIGNMENT_UBYTE 255 ERWT1_ena_COMPU_VTAB 0 255 BIT_MASK 0xff /end CHARACTERISTIC
/begin COMPU_METHOD ERWT1_ena_COMPU_VTAB "Verbal Table" TAB_VERB "%.0" "list" COMPU_TAB_REF ERWT1_ena_COMPU_VTAB_REF /end COMPU_METHOD
/begin COMPU_VTAB ERWT1_ena_COMPU_VTAB_REF "Verbal Table" TAB_VERB 13 0 "Disabled" 1 "EGT input" 2 "Aux PU1" 3 "Aux PU2" 4 "Aux PU3" 5 "Aux PUD1" 6 "Aux PUD2" 7 "Aux PUD3" 8 "Aux PUD4" 9 "Aux PUD5" 10 "Aux PUD6" 11 "Aux PUD7" 12 "Aux PUD8" DEFAULT_VALUE "UNKNOWN" /end COMPU_VTAB
/begin CHARACTERISTIC ERWT2_ena "ERWT2 sensor enable{ERWT2_ena&0xff=0:Disabled}{ERWT2_ena&0xff=1:EGT input}{ERWT2_ena&0xff=2:Aux PU1}{ERWT2_ena&0xff=3:Aux PU2}{ERWT2_ena&0xff=4:Aux PU3}{ERWT2_ena&0xff=5:Aux PUD1}{ERWT2_ena&0xff=6:Aux PUD2}{ERWT2_ena&0xff=7:Aux PUD3}{ERWT2_ena&0xff=8:Aux " VALUE 0x001c86ed /* @ECU_Address@ERWT2_ena@0x01004FF8@ */ ECIPP_ALIGNMENT_UBYTE 255 ERWT2_ena_COMPU_VTAB 0 255 BIT_MASK 0xff /end CHARACTERISTIC
/begin COMPU_METHOD ERWT2_ena_COMPU_VTAB "Verbal Table" TAB_VERB "%.0" "list" COMPU_TAB_REF ERWT2_ena_COMPU_VTAB_REF /end COMPU_METHOD
/begin COMPU_VTAB ERWT2_ena_COMPU_VTAB_REF "Verbal Table" TAB_VERB 13 0 "Disabled" 1 "EGT input" 2 "Aux PU1" 3 "Aux PU2" 4 "Aux PU3" 5 "Aux PUD1" 6 "Aux PUD2" 7 "Aux PUD3" 8 "Aux PUD4" 9 "Aux PUD5" 10 "Aux PUD6" 11 "Aux PUD7" 12 "Aux PUD8" DEFAULT_VALUE "UNKNOWN" /end COMPU_VTAB
/begin CHARACTERISTIC ERWT_run_wait "ERWT fault wait time after start (Fault Condition:run time wait for all HiExp faults:)" VALUE 0x001C9D04 /* @ECU_Address@ERWT_run_wait@0x01005000@ */ ECIPP_ALIGNMENT_ULONG 4294967 Compu_ERWT_run_wait 0 4294967.295 /end CHARACTERISTIC
/begin COMPU_METHOD Compu_ERWT_run_wait " " RAT_FUNC "%.1" "sec" COEFFS 0 1000 0 0 0 1 /end COMPU_METHOD
/begin CHARACTERISTIC ERWT_sensor_tau "ERWT sensor time constant" VALUE 0x001C9D0C /* @ECU_Address@ERWT_sensor_tau@0x01005008@ */ ECIPP_ALIGNMENT_UWORD 3276795 Compu_ERWT_sensor_tau 4.5084 3276800 /end CHARACTERISTIC
/begin COMPU_METHOD Compu_ERWT_sensor_tau " " FORM "%.0" "ms"
 /begin FORMULA "-50 / log(1 - (X1 / 65536))" FORMULA_INV "(1 - exp(-50/X1)) * 65536" /end FORMULA
/end COMPU_METHOD
/begin CHARACTERISTIC ERWT_in_s "ERWT standard inlet temperature" VALUE 0x001C9D0A /* @ECU_Address@ERWT_in_s@0x01005010@ */ ECIPP_ALIGNMENT_UWORD 7732 Compu_ERWT_in_s -460 7731.875 /end CHARACTERISTIC
/begin COMPU_METHOD Compu_ERWT_in_s " " RAT_FUNC "%.1" "deg F" COEFFS 0 8 3680 0 0 1 /end COMPU_METHOD
/begin CHARACTERISTIC ERWT_CWT_C "ERWT CWT correction coefficient" VALUE 0x001C9D08 /* @ECU_Address@ERWT_CWT_C@0x01005018@ */ ECIPP_ALIGNMENT_SWORD 41 Compu_ERWT_CWT_C -40.96 40.95875 /end CHARACTERISTIC
/begin COMPU_METHOD Compu_ERWT_CWT_C " " RAT_FUNC "%.1" "-deg F / % CWT VE" COEFFS 0 800 0 0 0 1 /end COMPU_METHOD
/begin MEASUREMENT ERWT_in "ERWT inlet temperature" UWORD Compu_ERWT_in 0 0 -460 7731.875 ECU_ADDRESS 0x01005020 /end MEASUREMENT
/begin COMPU_METHOD Compu_ERWT_in " " RAT_FUNC "%.1" "deg F" COEFFS 0 8 3680 0 0 1 /end COMPU_METHOD
/begin MEASUREMENT ERWT_ss_rise "ERWT steady-state temp rise" SWORD Compu_ERWT_ss_rise 0 0 -4096 4095.875 ECU_ADDRESS 0x01005028 /end MEASUREMENT
/begin COMPU_METHOD Compu_ERWT_ss_rise " " RAT_FUNC "%.1" "delta deg F" COEFFS 0 8 0 0 0 1 /end COMPU_METHOD
/begin MEASUREMENT ERWT_est "ERWT model estimation" UWORD Compu_ERWT_est 0 0 -460 7731.875 ECU_ADDRESS 0x01005030 /end MEASUREMENT
/begin COMPU_METHOD Compu_ERWT_est " " RAT_FUNC "%.1" "deg F" COEFFS 0 8 3680 0 0 1 /end COMPU_METHOD
/begin MEASUREMENT ERWT1 "ERWT1 sensor temperature" UWORD Compu_ERWT1 0 0 -460 7731.875 ECU_ADDRESS 0x01005038 /end MEASUREMENT
/begin COMPU_METHOD Compu_ERWT1 " " RAT_FUNC "%.1" "deg F" COEFFS 0 8 3680 0 0 1 /end COMPU_METHOD
/begin MEASUREMENT ERWT2 "ERWT2 sensor temperature" UWORD Compu_ERWT2 0 0 -460 7731.875 ECU_ADDRESS 0x01005040 /end MEASUREMENT
/begin COMPU_METHOD Compu_ERWT2 " " RAT_FUNC "%.1" "deg F" COEFFS 0 8 3680 0 0 1 /end COMPU_METHOD
/begin MEASUREMENT MSC_rpm_d "MSC RPM target" UWORD Compu_MSC_rpm_d 0 0 0 65535 ECU_ADDRESS 0x010052D0 /end MEASUREMENT
/begin COMPU_METHOD Compu_MSC_rpm_d " " RAT_FUNC "%.0" "rpm" COEFFS 0 1 0 0 0 1 /end COMPU_METHOD
/begin MEASUREMENT MSC_rpmdot_d "MSC RPM accel target" SWORD Compu_MSC_rpmdot_d 0 0 -64000 63998.046875 ECU_ADDRESS 0x010052D8 /end MEASUREMENT
/begin COMPU_METHOD Compu_MSC_rpmdot_d " " RAT_FUNC "%.0" "rpm / sec" COEFFS 0 0.512 0 0 0 1 /end COMPU_METHOD
/begin MEASUREMENT MSC_kph_d "MSC KPH target" UWORD Compu_MSC_kph_d 0 0 0 255.99609375 ECU_ADDRESS 0x010052E0 /end MEASUREMENT
/begin COMPU_METHOD Compu_MSC_kph_d " " RAT_FUNC "%.1" "kph" COEFFS 0 256 0 0 0 1 /end COMPU_METHOD
/begin MEASUREMENT MSC_kphdot_d "MSC KPH accel target" SWORD Compu_MSC_kphdot_d 0 0 -32 31.9990234375 ECU_ADDRESS 0x010052E8 /end MEASUREMENT
/begin COMPU_METHOD Compu_MSC_kphdot_d " " RAT_FUNC "%.2" "kph / sec" COEFFS 0 1024 0 0 0 1 /end COMPU_METHOD
/begin MEASUREMENT MSC_sync_mode "MSC multi-engine sync command{MSC_sync_mode&0xff=0:Off}{MSC_sync_mode&0xff=1:On}{MSC_sync_mode&0xff=2:Error}{MSC_sync_mode&0xff=3:Not Available}" UBYTE MSC_sync_mode_COMPU_VTAB 0 0 0 255 ECU_ADDRESS 0x010052F0 BIT_MASK 0xff /end MEASUREMENT
/begin COMPU_METHOD MSC_sync_mode_COMPU_VTAB "Verbal Table" TAB_VERB "%.0" "list" COMPU_TAB_REF MSC_sync_mode_COMPU_VTAB_REF /end COMPU_METHOD
/begin COMPU_VTAB MSC_sync_mode_COMPU_VTAB_REF "Verbal Table" TAB_VERB 4 0 "Off" 1 "On" 2 "Error" 3 "Not Available" DEFAULT_VALUE "UNKNOWN" /end COMPU_VTAB
/begin MEASUREMENT MSC_TORM_mode "MSC throttle override command{MSC_TORM_mode&0xff=0:Off}{MSC_TORM_mode&0xff=1:On}{MSC_TORM_mode&0xff=2:Error}{MSC_TORM_mode&0xff=3:Not Available}" UBYTE MSC_TORM_mode_COMPU_VTAB 0 0 0 255 ECU_ADDRESS 0x010052F8 BIT_MASK 0xff /end MEASUREMENT
/begin COMPU_METHOD MSC_TORM_mode_COMPU_VTAB "Verbal Table" TAB_VERB "%.0" "list" COMPU_TAB_REF MSC_TORM_mode_COMPU_VTAB_REF /end COMPU_METHOD
/begin COMPU_VTAB MSC_TORM_mode_COMPU_VTAB_REF "Verbal Table" TAB_VERB 4 0 "Off" 1 "On" 2 "Error" 3 "Not Available" DEFAULT_VALUE "UNKNOWN" /end COMPU_VTAB
/begin MEASUREMENT MSC_cruise_mode "MSC cruise command{MSC_cruise_mode&0xff=0:Off}{MSC_cruise_mode&0xff=1:RPM - Tap Mode}{MSC_cruise_mode&0xff=2:KPH - Tap Mode}{MSC_cruise_mode&0xff=3:Not Available}{MSC_cruise_mode&0xff=4:RPM - Setpoint Mode}{MSC_cruise_mode&0xff=5:KPH - Setpoint Mode}" UBYTE MSC_cruise_mode_COMPU_VTAB 0 0 0 255 ECU_ADDRESS 0x01005300 BIT_MASK 0xff /end MEASUREMENT
/begin COMPU_METHOD MSC_cruise_mode_COMPU_VTAB "Verbal Table" TAB_VERB "%.0" "list" COMPU_TAB_REF MSC_cruise_mode_COMPU_VTAB_REF /end COMPU_METHOD
/begin COMPU_VTAB MSC_cruise_mode_COMPU_VTAB_REF "Verbal Table" TAB_VERB 6 0 "Off" 1 "RPM - Tap Mode" 2 "KPH - Tap Mode" 3 "Not Available" 4 "RPM - Setpoint Mode" 5 "KPH - Setpoint Mode" DEFAULT_VALUE "UNKNOWN" /end COMPU_VTAB
/begin MEASUREMENT MSC_inc_dec "MSC increment/decrement status{MSC_inc_dec&0xff=0:Inactive}{MSC_inc_dec&0xff=1:Decrement}{MSC_inc_dec&0xff=2:Increment}{MSC_inc_dec&0xff=3:Setpoint Mode}" UBYTE MSC_inc_dec_COMPU_VTAB 0 0 0 255 ECU_ADDRESS 0x01005308 BIT_MASK 0xff /end MEASUREMENT
/begin COMPU_METHOD MSC_inc_dec_COMPU_VTAB "Verbal Table" TAB_VERB "%.0" "list" COMPU_TAB_REF MSC_inc_dec_COMPU_VTAB_REF /end COMPU_METHOD
/begin COMPU_VTAB MSC_inc_dec_COMPU_VTAB_REF "Verbal Table" TAB_VERB 4 0 "Inactive" 1 "Decrement" 2 "Increment" 3 "Setpoint Mode" DEFAULT_VALUE "UNKNOWN" /end COMPU_VTAB
/begin MEASUREMENT MSC_set_clr "MSC set/clear status{MSC_set_clr&0xff=0:Inactive}{MSC_set_clr&0xff=1:Clear}{MSC_set_clr&0xff=2:Set}{MSC_set_clr&0xff=3:Setpoint Mode}" UBYTE MSC_set_clr_COMPU_VTAB 0 0 0 255 ECU_ADDRESS 0x01005310 BIT_MASK 0xff /end MEASUREMENT
/begin COMPU_METHOD MSC_set_clr_COMPU_VTAB "Verbal Table" TAB_VERB "%.0" "list" COMPU_TAB_REF MSC_set_clr_COMPU_VTAB_REF /end COMPU_METHOD
/begin COMPU_VTAB MSC_set_clr_COMPU_VTAB_REF "Verbal Table" TAB_VERB 4 0 "Inactive" 1 "Clear" 2 "Set" 3 "Setpoint Mode" DEFAULT_VALUE "UNKNOWN" /end COMPU_VTAB
/begin MEASUREMENT MES_status "Multi-engine sync engagement{MES_status&0xff=0:Off}{MES_status&0xff=1:On - Inactive}{MES_status&0xff=2:On - Active}{MES_status&0xff=3:N/A}" UBYTE MES_status_COMPU_VTAB 0 0 0 255 ECU_ADDRESS 0x01005320 BIT_MASK 0xff /end MEASUREMENT
/begin COMPU_METHOD MES_status_COMPU_VTAB "Verbal Table" TAB_VERB "%.0" "list" COMPU_TAB_REF MES_status_COMPU_VTAB_REF /end COMPU_METHOD
/begin COMPU_VTAB MES_status_COMPU_VTAB_REF "Verbal Table" TAB_VERB 4 0 "Off" 1 "On - Inactive" 2 "On - Active" 3 "N/A" DEFAULT_VALUE "UNKNOWN" /end COMPU_VTAB
/begin MEASUREMENT TORM_mode "TORM current mode{TORM_mode&0xff=0:Disabled}{TORM_mode&0xff=1:Enabled}{TORM_mode&0xff=2:Not Allowed}" UBYTE TORM_mode_COMPU_VTAB 0 0 0 255 ECU_ADDRESS 0x01005330 BIT_MASK 0xff /end MEASUREMENT
/begin COMPU_METHOD TORM_mode_COMPU_VTAB "Verbal Table" TAB_VERB "%.0" "list" COMPU_TAB_REF TORM_mode_COMPU_VTAB_REF /end COMPU_METHOD
/begin COMPU_VTAB TORM_mode_COMPU_VTAB_REF "Verbal Table" TAB_VERB 3 0 "Disabled" 1 "Enabled" 2 "Not Allowed" DEFAULT_VALUE "UNKNOWN" /end COMPU_VTAB
/begin MEASUREMENT MES_sw_source "MES switch source{MES_sw_source&0xff=0:Normal}{MES_sw_source&0xff=1:Master Engine}{MES_sw_source&0xff=2:Network Override}" UBYTE MES_sw_source_COMPU_VTAB 0 0 0 255 ECU_ADDRESS 0x01005338 BIT_MASK 0xff /end MEASUREMENT
/begin COMPU_METHOD MES_sw_source_COMPU_VTAB "Verbal Table" TAB_VERB "%.0" "list" COMPU_TAB_REF MES_sw_source_COMPU_VTAB_REF /end COMPU_METHOD
/begin COMPU_VTAB MES_sw_source_COMPU_VTAB_REF "Verbal Table" TAB_VERB 3 0 "Normal" 1 "Master Engine" 2 "Network Override" DEFAULT_VALUE "UNKNOWN" /end COMPU_VTAB
/begin CHARACTERISTIC ESM_engage_rate "Power-factor increase rate" VALUE 0x001c6f1a /* @ECU_Address@ESM_engage_rate@0x01005358@ */ ECIPP_ALIGNMENT_UWORD 391 Compu_ESM_engage_rate 0 390.619039535522 /end CHARACTERISTIC
/begin COMPU_METHOD Compu_ESM_engage_rate " " RAT_FUNC "%.0" "%/sec" COEFFS 0 167.77216 0 0 0 1 /end COMPU_METHOD
/begin CHARACTERISTIC ESM_dengage_rate "Power-factor decrease rate" VALUE 0x001c6f16 /* @ECU_Address@ESM_dengage_rate@0x01005360@ */ ECIPP_ALIGNMENT_UWORD 391 Compu_ESM_dengage_rate 0 390.619039535522 /end CHARACTERISTIC
/begin COMPU_METHOD Compu_ESM_dengage_rate " " RAT_FUNC "%.0" "%/sec" COEFFS 0 167.77216 0 0 0 1 /end COMPU_METHOD
/begin CHARACTERISTIC ESM_decel_control "Idle-return decel rate limiting (IAC){ESM_decel_control&0xff=0:Disabled}{ESM_decel_control&0xff=1:Enabled}" VALUE 0x001c86f0 /* @ECU_Address@ESM_decel_control@0x01005368@ */ ECIPP_ALIGNMENT_UBYTE 255 ESM_decel_control_COMPU_VTAB 0 255 BIT_MASK 0xff /end CHARACTERISTIC
/begin COMPU_METHOD ESM_decel_control_COMPU_VTAB "Verbal Table" TAB_VERB "%.0" "list" COMPU_TAB_REF ESM_decel_control_COMPU_VTAB_REF /end COMPU_METHOD
/begin COMPU_VTAB ESM_decel_control_COMPU_VTAB_REF "Verbal Table" TAB_VERB 2 0 "Disabled" 1 "Enabled" DEFAULT_VALUE "UNKNOWN" /end COMPU_VTAB
/begin CHARACTERISTIC ESM_idle_drpm_max "ESM idle offset max delta-rpm" VALUE 0x001c6f22 /* @ECU_Address@ESM_idle_drpm_max@0x01005370@ */ ECIPP_ALIGNMENT_UWORD 65535 Compu_ESM_idle_drpm_max 0 65535 /end CHARACTERISTIC
/begin COMPU_METHOD Compu_ESM_idle_drpm_max " " RAT_FUNC "%.0" "delta-rpm" COEFFS 0 1 0 0 0 1 /end COMPU_METHOD
/begin CHARACTERISTIC ESM_idle_dload_max "ESM idle offset max delta-load" VALUE 0x001c6f20 /* @ECU_Address@ESM_idle_dload_max@0x01005378@ */ ECIPP_ALIGNMENT_UWORD 1600 Compu_ESM_idle_dload_max 0 1599.9755859375 /end CHARACTERISTIC
/begin COMPU_METHOD Compu_ESM_idle_dload_max " " RAT_FUNC "%.1" "% load" COEFFS 0 40.96 0 0 0 1 /end COMPU_METHOD
/begin CHARACTERISTIC ESM_SIS_extend "ESM shift-interrupt inhibit extend time" VALUE 0x001c6f14 /* @ECU_Address@ESM_SIS_extend@0x01005380@ */ ECIPP_ALIGNMENT_UWORD 66 Compu_ESM_SIS_extend 0 65.535 /end CHARACTERISTIC
/begin COMPU_METHOD Compu_ESM_SIS_extend " " RAT_FUNC "%.1" "sec" COEFFS 0 1000 0 0 0 1 /end COMPU_METHOD
/begin MEASUREMENT ESM_SIS_inhibit "ESM shift-interrupt status{ESM_SIS_inhibit&0xff=0:SIS Allowed}{ESM_SIS_inhibit&0xff=1:SIS Inhibited}" UBYTE ESM_SIS_inhibit_COMPU_VTAB 0 0 0 255 ECU_ADDRESS 0x01005388 BIT_MASK 0xff /end MEASUREMENT
/begin COMPU_METHOD ESM_SIS_inhibit_COMPU_VTAB "Verbal Table" TAB_VERB "%.0" "list" COMPU_TAB_REF ESM_SIS_inhibit_COMPU_VTAB_REF /end COMPU_METHOD
/begin COMPU_VTAB ESM_SIS_inhibit_COMPU_VTAB_REF "Verbal Table" TAB_VERB 2 0 "SIS Allowed" 1 "SIS Inhibited" DEFAULT_VALUE "UNKNOWN" /end COMPU_VTAB
/begin MEASUREMENT ESM_idle_drpm "ESM current idle delta-rpm" UWORD Compu_ESM_idle_drpm 0 0 0 65535 ECU_ADDRESS 0x01005390 /end MEASUREMENT
/begin COMPU_METHOD Compu_ESM_idle_drpm " " RAT_FUNC "%.0" "delta-rpm" COEFFS 0 1 0 0 0 1 /end COMPU_METHOD
/begin MEASUREMENT ESM_idle_dload "ESM current idle delta-load" UWORD Compu_ESM_idle_dload 0 0 0 1599.9755859375 ECU_ADDRESS 0x01005398 /end MEASUREMENT
/begin COMPU_METHOD Compu_ESM_idle_dload " " RAT_FUNC "%.1" "% load" COEFFS 0 40.96 0 0 0 1 /end COMPU_METHOD
/begin MEASUREMENT ESM_pwr_slew "ESM delay/slew limited power-factor" UWORD Compu_ESM_pwr_slew 0 0 0 99.9984741210938 ECU_ADDRESS 0x010053A0 /end MEASUREMENT
/begin COMPU_METHOD Compu_ESM_pwr_slew " " RAT_FUNC "%.1" "%" COEFFS 0 655.36 0 0 0 1 /end COMPU_METHOD
/begin CHARACTERISTIC ESM_idle_pwr_max "ESM idle offset max power-factor" VALUE 0x001c6f24 /* @ECU_Address@ESM_idle_pwr_max@0x010053A8@ */ ECIPP_ALIGNMENT_UWORD 100 Compu_ESM_idle_pwr_max 0 99.9984741210938 /end CHARACTERISTIC
/begin COMPU_METHOD Compu_ESM_idle_pwr_max " " RAT_FUNC "%.1" "%" COEFFS 0 655.36 0 0 0 1 /end COMPU_METHOD
/begin MEASUREMENT MES_allspeed_mstr "MES master allspeed command" UWORD Compu_MES_allspeed_mstr 0 0 0 65535 ECU_ADDRESS 0x01005560 /end MEASUREMENT
/begin COMPU_METHOD Compu_MES_allspeed_mstr " " RAT_FUNC "%.0" "rpm" COEFFS 0 1 0 0 0 1 /end COMPU_METHOD
/begin MEASUREMENT MES_allspeed_ntrlk "MES dis-engagement allspeed ntrlk" UWORD Compu_MES_allspeed_ntrlk 0 0 0 65535 ECU_ADDRESS 0x01005568 /end MEASUREMENT
/begin COMPU_METHOD Compu_MES_allspeed_ntrlk " " RAT_FUNC "%.0" "rpm" COEFFS 0 1 0 0 0 1 /end COMPU_METHOD
/begin MEASUREMENT MES_allspeed_cmd "MES sync (slave) allspeed cmd" UWORD Compu_MES_allspeed_cmd 0 0 0 65535 ECU_ADDRESS 0x01005570 /end MEASUREMENT
/begin COMPU_METHOD Compu_MES_allspeed_cmd " " RAT_FUNC "%.0" "rpm" COEFFS 0 1 0 0 0 1 /end COMPU_METHOD
/begin CHARACTERISTIC EMWT_wt_init "EMWT power-on sensor wait" VALUE 0x001C9D02 /* @ECU_Address@EMWT_wt_init@0x01005760@ */ ECIPP_ALIGNMENT_UWORD 65535 Compu_EMWT_wt_init 0 65535 /end CHARACTERISTIC
/begin COMPU_METHOD Compu_EMWT_wt_init " " RAT_FUNC "%.0" "ms" COEFFS 0 1 0 0 0 1 /end COMPU_METHOD
/begin CHARACTERISTIC ERWT_wt_init "ERWT power-on sensor wait" VALUE 0x001C9D1A /* @ECU_Address@ERWT_wt_init@0x01005768@ */ ECIPP_ALIGNMENT_UWORD 65535 Compu_ERWT_wt_init 0 65535 /end CHARACTERISTIC
/begin COMPU_METHOD Compu_ERWT_wt_init " " RAT_FUNC "%.0" "ms" COEFFS 0 1 0 0 0 1 /end COMPU_METHOD
/begin CHARACTERISTIC OilQ_ena "Oil quality configuration{OilQ_ena&0xff=0:Disabled}{OilQ_ena&0xff=1:Enabled}" VALUE 0x001c8874 /* @ECU_Address@OilQ_ena@0x01005A78@ */ ECIPP_ALIGNMENT_UBYTE 255 OilQ_ena_COMPU_VTAB 0 255 BIT_MASK 0xff /end CHARACTERISTIC
/begin COMPU_METHOD OilQ_ena_COMPU_VTAB "Verbal Table" TAB_VERB "%.0" "list" COMPU_TAB_REF OilQ_ena_COMPU_VTAB_REF /end COMPU_METHOD
/begin COMPU_VTAB OilQ_ena_COMPU_VTAB_REF "Verbal Table" TAB_VERB 2 0 "Disabled" 1 "Enabled" DEFAULT_VALUE "UNKNOWN" /end COMPU_VTAB
/begin CHARACTERISTIC OilQ_chan "Oil quality channel{OilQ_chan&0xff=0:Aux PD1}{OilQ_chan&0xff=1:Aux PUD4}" VALUE 0x001c8873 /* @ECU_Address@OilQ_chan@0x01005A80@ */ ECIPP_ALIGNMENT_UBYTE 255 OilQ_chan_COMPU_VTAB 0 255 BIT_MASK 0xff /end CHARACTERISTIC
/begin COMPU_METHOD OilQ_chan_COMPU_VTAB "Verbal Table" TAB_VERB "%.0" "list" COMPU_TAB_REF OilQ_chan_COMPU_VTAB_REF /end COMPU_METHOD
/begin COMPU_VTAB OilQ_chan_COMPU_VTAB_REF "Verbal Table" TAB_VERB 2 0 "Aux PD1" 1 "Aux PUD4" DEFAULT_VALUE "UNKNOWN" /end COMPU_VTAB
/begin CHARACTERISTIC OilQ_trimchan "Trim sensor override{OilQ_trimchan&0xff=0:Disabled}{OilQ_trimchan&0xff=1:Volt1 gauge drive}" VALUE 0x001c8875 /* @ECU_Address@OilQ_trimchan@0x01005A88@ */ ECIPP_ALIGNMENT_UBYTE 255 OilQ_trimchan_COMPU_VTAB 0 255 BIT_MASK 0xff /end CHARACTERISTIC
/begin COMPU_METHOD OilQ_trimchan_COMPU_VTAB "Verbal Table" TAB_VERB "%.0" "list" COMPU_TAB_REF OilQ_trimchan_COMPU_VTAB_REF /end COMPU_METHOD
/begin COMPU_VTAB OilQ_trimchan_COMPU_VTAB_REF "Verbal Table" TAB_VERB 2 0 "Disabled" 1 "Volt1 gauge drive" DEFAULT_VALUE "UNKNOWN" /end COMPU_VTAB
/begin CHARACTERISTIC OilQ_trimpct "Trim upper limit" VALUE 0x001c7e48 /* @ECU_Address@OilQ_trimpct@0x01005A90@ */ ECIPP_ALIGNMENT_UWORD 400 Compu_OilQ_trimpct 0 399.993896484375 /end CHARACTERISTIC
/begin COMPU_METHOD Compu_OilQ_trimpct " " RAT_FUNC "%.1" "%" COEFFS 0 163.84 0 0 0 1 /end COMPU_METHOD
/begin MEASUREMENT OilQ_state "Oil quality status{OilQ_state&0xff=0:Invalid trim/rpm}{OilQ_state&0xff=1:Detecting sensor}{OilQ_state&0xff=2:Monitoring}{OilQ_state&0xff=3:Voltage high}{OilQ_state&0xff=4:Voltage low}{OilQ_state&0xff=5:Sensor disconnect}{OilQ_state&0xff=6:Voltage zero}{Oi" UBYTE OilQ_state_COMPU_VTAB 0 0 0 255 ECU_ADDRESS 0x01005A98 BIT_MASK 0xff /end MEASUREMENT
/begin COMPU_METHOD OilQ_state_COMPU_VTAB "Verbal Table" TAB_VERB "%.0" "list" COMPU_TAB_REF OilQ_state_COMPU_VTAB_REF /end COMPU_METHOD
/begin COMPU_VTAB OilQ_state_COMPU_VTAB_REF "Verbal Table" TAB_VERB 10 0 "Invalid trim/rpm" 1 "Detecting sensor" 2 "Monitoring" 3 "Voltage high" 4 "Voltage low" 5 "Sensor disconnect" 6 "Voltage zero" 7 "Sensor connect" 8 "Validating learn" 9 "Learn complete" DEFAULT_VALUE "UNKNOWN" /end COMPU_VTAB
/begin CHARACTERISTIC OilQ_tvalid "Oil quality input validation" VALUE 0x001c8876 /* @ECU_Address@OilQ_tvalid@0x01005AA0@ */ ECIPP_ALIGNMENT_UBYTE 13 Compu_OilQ_tvalid 0 12.75 /end CHARACTERISTIC
/begin COMPU_METHOD Compu_OilQ_tvalid " " RAT_FUNC "%.1" "sec" COEFFS 0 20 0 0 0 1 /end COMPU_METHOD
/begin MEASUREMENT OilQ_Vnom "Oil quality nominal voltage" UWORD Compu_OilQ_Vnom 0 0 0 5.00114468864469 ECU_ADDRESS 0x01005AA8 /end MEASUREMENT
/begin COMPU_METHOD Compu_OilQ_Vnom " " RAT_FUNC "%.2" "volts" COEFFS 0 13104 0 0 0 1 /end COMPU_METHOD
/begin CHARACTERISTIC OilQ_Vhi "Oil quality sensor present high limit" VALUE 0x001c7e3e /* @ECU_Address@OilQ_Vhi@0x01005AB0@ */ ECIPP_ALIGNMENT_UWORD 5 Compu_OilQ_Vhi 0 5.00114468864469 /end CHARACTERISTIC
/begin COMPU_METHOD Compu_OilQ_Vhi " " RAT_FUNC "%.2" "volts" COEFFS 0 13104 0 0 0 1 /end COMPU_METHOD
/begin CHARACTERISTIC OilQ_Vlo "Oil quality sensor present low limit" VALUE 0x001c7e40 /* @ECU_Address@OilQ_Vlo@0x01005AB8@ */ ECIPP_ALIGNMENT_UWORD 5 Compu_OilQ_Vlo 0 5.00114468864469 /end CHARACTERISTIC
/begin COMPU_METHOD Compu_OilQ_Vlo " " RAT_FUNC "%.2" "volts" COEFFS 0 13104 0 0 0 1 /end COMPU_METHOD
/begin CHARACTERISTIC OilQ_Vpdelta "Oil quality valid nominal + delta" VALUE 0x001c7e44 /* @ECU_Address@OilQ_Vpdelta@0x01005AC0@ */ ECIPP_ALIGNMENT_UWORD 5 Compu_OilQ_Vpdelta 0 5.00114468864469 /end CHARACTERISTIC
/begin COMPU_METHOD Compu_OilQ_Vpdelta " " RAT_FUNC "%.2" "volts" COEFFS 0 13104 0 0 0 1 /end COMPU_METHOD
/begin CHARACTERISTIC OilQ_Vndelta "Oil quality valid nominal - delta" VALUE 0x001c7e42 /* @ECU_Address@OilQ_Vndelta@0x01005AC8@ */ ECIPP_ALIGNMENT_UWORD 5 Compu_OilQ_Vndelta 0 5.00114468864469 /end CHARACTERISTIC
/begin COMPU_METHOD Compu_OilQ_Vndelta " " RAT_FUNC "%.2" "volts" COEFFS 0 13104 0 0 0 1 /end COMPU_METHOD
/begin MEASUREMENT OilQ_active "Oil quality monitoring{OilQ_active&0xff=0:Inactive}{OilQ_active&0xff=1:Active}" UBYTE OilQ_active_COMPU_VTAB 0 0 0 255 ECU_ADDRESS 0x01005AD0 BIT_MASK 0xff /end MEASUREMENT
/begin COMPU_METHOD OilQ_active_COMPU_VTAB "Verbal Table" TAB_VERB "%.0" "list" COMPU_TAB_REF OilQ_active_COMPU_VTAB_REF /end COMPU_METHOD
/begin COMPU_VTAB OilQ_active_COMPU_VTAB_REF "Verbal Table" TAB_VERB 2 0 "Inactive" 1 "Active" DEFAULT_VALUE "UNKNOWN" /end COMPU_VTAB
/begin CHARACTERISTIC OilQ_alertreps "Oil quality learn-complete alert reps" VALUE 0x001c8872 /* @ECU_Address@OilQ_alertreps@0x01005AE8@ */ ECIPP_ALIGNMENT_UBYTE 255 Compu_OilQ_alertreps 0 255 /end CHARACTERISTIC
/begin COMPU_METHOD Compu_OilQ_alertreps " " RAT_FUNC "%.0" "-" COEFFS 0 1 0 0 0 1 /end COMPU_METHOD
/begin CHARACTERISTIC WTRIN_ena "Water intrusion detection system{WTRIN_ena&0xff=0:Disabled}{WTRIN_ena&0xff=1:Enabled: always}{WTRIN_ena&0xff=2:Enabled: oil quality active}" VALUE 0x001c8f94 /* @ECU_Address@WTRIN_ena@0x01005AF0@ */ ECIPP_ALIGNMENT_UBYTE 255 WTRIN_ena_COMPU_VTAB 0 255 BIT_MASK 0xff /end CHARACTERISTIC
/begin COMPU_METHOD WTRIN_ena_COMPU_VTAB "Verbal Table" TAB_VERB "%.0" "list" COMPU_TAB_REF WTRIN_ena_COMPU_VTAB_REF /end COMPU_METHOD
/begin COMPU_VTAB WTRIN_ena_COMPU_VTAB_REF "Verbal Table" TAB_VERB 3 0 "Disabled" 1 "Enabled: always" 2 "Enabled: oil quality active" DEFAULT_VALUE "UNKNOWN" /end COMPU_VTAB
/begin CHARACTERISTIC WTRIN_out "Water intrusion detection output{WTRIN_out&0xff=0:Aux PWM5}{WTRIN_out&0xff=1:Aux PWM10}" VALUE 0x001c8f95 /* @ECU_Address@WTRIN_out@0x01005AF8@ */ ECIPP_ALIGNMENT_UBYTE 255 WTRIN_out_COMPU_VTAB 0 255 BIT_MASK 0xff /end CHARACTERISTIC
/begin COMPU_METHOD WTRIN_out_COMPU_VTAB "Verbal Table" TAB_VERB "%.0" "list" COMPU_TAB_REF WTRIN_out_COMPU_VTAB_REF /end COMPU_METHOD
/begin COMPU_VTAB WTRIN_out_COMPU_VTAB_REF "Verbal Table" TAB_VERB 2 0 "Aux PWM5" 1 "Aux PWM10" DEFAULT_VALUE "UNKNOWN" /end COMPU_VTAB
/begin CHARACTERISTIC OilQ_trimpctlearn "Trim upper limit during learn" VALUE 0x001c7e4a /* @ECU_Address@OilQ_trimpctlearn@0x01005B00@ */ ECIPP_ALIGNMENT_UWORD 400 Compu_OilQ_trimpctlearn 0 399.993896484375 /end CHARACTERISTIC
/begin COMPU_METHOD Compu_OilQ_trimpctlearn " " RAT_FUNC "%.1" "%" COEFFS 0 163.84 0 0 0 1 /end COMPU_METHOD
/begin MEASUREMENT MEFI_FPP_anchor "Malibu FPP anchor position" UWORD Compu_MEFI_FPP_anchor 0 0 0 99.9984741210938 ECU_ADDRESS 0x01005D08 /end MEASUREMENT
/begin COMPU_METHOD Compu_MEFI_FPP_anchor " " RAT_FUNC "%.1" "%" COEFFS 0 655.36 0 0 0 1 /end COMPU_METHOD
/begin CHARACTERISTIC TORM_drpm_dFPP_max "TORM max allowed dRPM/dFPP" VALUE 0x001c8198 /* @ECU_Address@TORM_drpm_dFPP_max@0x01005D10@ */ ECIPP_ALIGNMENT_UWORD 655 Compu_TORM_drpm_dFPP_max 0 655.35 /end CHARACTERISTIC
/begin COMPU_METHOD Compu_TORM_drpm_dFPP_max " " RAT_FUNC "%.0" "rpm/%" COEFFS 0 100 0 0 0 1 /end COMPU_METHOD
/begin CHARACTERISTIC WTRIN_rpm_lmt "Water intrusion engine speed limit (Fault Condition:in addition, RPM <)" VALUE 0x001c8392 /* @ECU_Address@WTRIN_rpm_lmt@0x01006710@ */ ECIPP_ALIGNMENT_UWORD 65535 Compu_WTRIN_rpm_lmt 0 65535 /end CHARACTERISTIC
/begin COMPU_METHOD Compu_WTRIN_rpm_lmt " " RAT_FUNC "%.0" "rpm" COEFFS 0 1 0 0 0 1 /end COMPU_METHOD
/begin CHARACTERISTIC OilQ_rpm_lmt "Oil quality engine speed limit" VALUE 0x001c7e46 /* @ECU_Address@OilQ_rpm_lmt@0x01006718@ */ ECIPP_ALIGNMENT_UWORD 65535 Compu_OilQ_rpm_lmt 0 65535 /end CHARACTERISTIC
/begin COMPU_METHOD Compu_OilQ_rpm_lmt " " RAT_FUNC "%.0" "rpm" COEFFS 0 1 0 0 0 1 /end COMPU_METHOD
/begin MEASUREMENT WTRIN_DC "Water intrusion drive duty-cycle" UWORD Compu_WTRIN_DC 0 0 0 99.9984741210938 ECU_ADDRESS 0x01006720 /end MEASUREMENT
/begin COMPU_METHOD Compu_WTRIN_DC " " RAT_FUNC "%.1" "%" COEFFS 0 655.36 0 0 0 1 /end COMPU_METHOD
/begin MEASUREMENT WTRIN_flt_cnt "Water intrusion fault latch" UWORD Compu_WTRIN_flt_cnt 0 0 0 399.993896484375 ECU_ADDRESS 0x01006728 /end MEASUREMENT
/begin COMPU_METHOD Compu_WTRIN_flt_cnt " " RAT_FUNC "%.1" "%" COEFFS 0 163.84 0 0 0 1 /end COMPU_METHOD
/begin CHARACTERISTIC torque_select "J1939 engine torque broadcast{torque_select&0xff=0:Engine Load}{torque_select&0xff=1:Torque Percent}" VALUE 0x001c908b /* @ECU_Address@torque_select@0x01006748@ */ ECIPP_ALIGNMENT_UBYTE 255 torque_select_COMPU_VTAB 0 255 BIT_MASK 0xff /end CHARACTERISTIC
/begin COMPU_METHOD torque_select_COMPU_VTAB "Verbal Table" TAB_VERB "%.0" "list" COMPU_TAB_REF torque_select_COMPU_VTAB_REF /end COMPU_METHOD
/begin COMPU_VTAB torque_select_COMPU_VTAB_REF "Verbal Table" TAB_VERB 2 0 "Engine Load" 1 "Torque Percent" DEFAULT_VALUE "UNKNOWN" /end COMPU_VTAB
/begin MEASUREMENT torque_driver "Driver demand torque" UWORD Compu_torque_driver 0 0 0 99.9984741210938 ECU_ADDRESS 0x01006758 /end MEASUREMENT
/begin COMPU_METHOD Compu_torque_driver " " RAT_FUNC "%.1" "% of ref" COEFFS 0 655.36 0 0 0 1 /end COMPU_METHOD
/begin MEASUREMENT torque_pct_max "Max gross torque" UWORD Compu_torque_pct_max 0 0 0 99.9984741210938 ECU_ADDRESS 0x01006760 /end MEASUREMENT
/begin COMPU_METHOD Compu_torque_pct_max " " RAT_FUNC "%.1" "% of ref" COEFFS 0 655.36 0 0 0 1 /end COMPU_METHOD
/begin MEASUREMENT torque_pct_gross "Actual gross torque" UWORD Compu_torque_pct_gross 0 0 0 99.9984741210938 ECU_ADDRESS 0x01006768 /end MEASUREMENT
/begin COMPU_METHOD Compu_torque_pct_gross " " RAT_FUNC "%.1" "%" COEFFS 0 655.36 0 0 0 1 /end COMPU_METHOD
/begin MEASUREMENT torque_pct_fric "Actual friction torque" UWORD Compu_torque_pct_fric 0 0 0 99.9984741210938 ECU_ADDRESS 0x01006770 /end MEASUREMENT
/begin COMPU_METHOD Compu_torque_pct_fric " " RAT_FUNC "%.1" "%" COEFFS 0 655.36 0 0 0 1 /end COMPU_METHOD
/begin CHARACTERISTIC BLST_port_stern_ena "Port astern level input{BLST_port_stern_ena&0xff=0:Disabled}{BLST_port_stern_ena&0xff=1:Aux PUD1}{BLST_port_stern_ena&0xff=2:Aux PUD2}{BLST_port_stern_ena&0xff=3:Aux PUD3}{BLST_port_stern_ena&0xff=4:Aux PUD4}{BLST_port_stern_ena&0xff=5:Aux PUD5}" VALUE 0x001c868a /* @ECU_Address@BLST_port_stern_ena@0x01006778@ */ ECIPP_ALIGNMENT_UBYTE 255 BLST_port_stern_ena_COMPU_VTAB 0 255 BIT_MASK 0xff /end CHARACTERISTIC
/begin COMPU_METHOD BLST_port_stern_ena_COMPU_VTAB "Verbal Table" TAB_VERB "%.0" "list" COMPU_TAB_REF BLST_port_stern_ena_COMPU_VTAB_REF /end COMPU_METHOD
/begin COMPU_VTAB BLST_port_stern_ena_COMPU_VTAB_REF "Verbal Table" TAB_VERB 6 0 "Disabled" 1 "Aux PUD1" 2 "Aux PUD2" 3 "Aux PUD3" 4 "Aux PUD4" 5 "Aux PUD5" DEFAULT_VALUE "UNKNOWN" /end COMPU_VTAB
/begin CHARACTERISTIC BLST_stbd_stern_ena "Stbd astern level input{BLST_stbd_stern_ena&0xff=0:Disabled}{BLST_stbd_stern_ena&0xff=1:Aux PUD1}{BLST_stbd_stern_ena&0xff=2:Aux PUD2}{BLST_stbd_stern_ena&0xff=3:Aux PUD3}{BLST_stbd_stern_ena&0xff=4:Aux PUD4}{BLST_stbd_stern_ena&0xff=5:Aux PUD5}" VALUE 0x001c868b /* @ECU_Address@BLST_stbd_stern_ena@0x01006780@ */ ECIPP_ALIGNMENT_UBYTE 255 BLST_stbd_stern_ena_COMPU_VTAB 0 255 BIT_MASK 0xff /end CHARACTERISTIC
/begin COMPU_METHOD BLST_stbd_stern_ena_COMPU_VTAB "Verbal Table" TAB_VERB "%.0" "list" COMPU_TAB_REF BLST_stbd_stern_ena_COMPU_VTAB_REF /end COMPU_METHOD
/begin COMPU_VTAB BLST_stbd_stern_ena_COMPU_VTAB_REF "Verbal Table" TAB_VERB 6 0 "Disabled" 1 "Aux PUD1" 2 "Aux PUD2" 3 "Aux PUD3" 4 "Aux PUD4" 5 "Aux PUD5" DEFAULT_VALUE "UNKNOWN" /end COMPU_VTAB
/begin CHARACTERISTIC BLST_cntr_stern_ena "Center astern level input{BLST_cntr_stern_ena&0xff=0:Disabled}{BLST_cntr_stern_ena&0xff=1:Aux PUD1}{BLST_cntr_stern_ena&0xff=2:Aux PUD2}{BLST_cntr_stern_ena&0xff=3:Aux PUD3}{BLST_cntr_stern_ena&0xff=4:Aux PUD4}{BLST_cntr_stern_ena&0xff=5:Aux PUD5}" VALUE 0x001c8689 /* @ECU_Address@BLST_cntr_stern_ena@0x01006788@ */ ECIPP_ALIGNMENT_UBYTE 255 BLST_cntr_stern_ena_COMPU_VTAB 0 255 BIT_MASK 0xff /end CHARACTERISTIC
/begin COMPU_METHOD BLST_cntr_stern_ena_COMPU_VTAB "Verbal Table" TAB_VERB "%.0" "list" COMPU_TAB_REF BLST_cntr_stern_ena_COMPU_VTAB_REF /end COMPU_METHOD
/begin COMPU_VTAB BLST_cntr_stern_ena_COMPU_VTAB_REF "Verbal Table" TAB_VERB 6 0 "Disabled" 1 "Aux PUD1" 2 "Aux PUD2" 3 "Aux PUD3" 4 "Aux PUD4" 5 "Aux PUD5" DEFAULT_VALUE "UNKNOWN" /end COMPU_VTAB
/begin CHARACTERISTIC BLST_cntr_head_ena "Center ahead level input{BLST_cntr_head_ena&0xff=0:Disabled}{BLST_cntr_head_ena&0xff=1:Aux PUD1}{BLST_cntr_head_ena&0xff=2:Aux PUD2}{BLST_cntr_head_ena&0xff=3:Aux PUD3}{BLST_cntr_head_ena&0xff=4:Aux PUD4}{BLST_cntr_head_ena&0xff=5:Aux PUD5}" VALUE 0x001c8688 /* @ECU_Address@BLST_cntr_head_ena@0x01006790@ */ ECIPP_ALIGNMENT_UBYTE 255 BLST_cntr_head_ena_COMPU_VTAB 0 255 BIT_MASK 0xff /end CHARACTERISTIC
/begin COMPU_METHOD BLST_cntr_head_ena_COMPU_VTAB "Verbal Table" TAB_VERB "%.0" "list" COMPU_TAB_REF BLST_cntr_head_ena_COMPU_VTAB_REF /end COMPU_METHOD
/begin COMPU_VTAB BLST_cntr_head_ena_COMPU_VTAB_REF "Verbal Table" TAB_VERB 6 0 "Disabled" 1 "Aux PUD1" 2 "Aux PUD2" 3 "Aux PUD3" 4 "Aux PUD4" 5 "Aux PUD5" DEFAULT_VALUE "UNKNOWN" /end COMPU_VTAB
/begin MEASUREMENT WTRIN_Vpp "Water intrusion Vp-p sense" SWORD Compu_WTRIN_Vpp 0 0 -32 31.9990234375 ECU_ADDRESS 0x01006818 /end MEASUREMENT
/begin COMPU_METHOD Compu_WTRIN_Vpp " " RAT_FUNC "%.2" "volts" COEFFS 0 1024 0 0 0 1 /end COMPU_METHOD
/begin MEASUREMENT WTRIN_Vpp_diag "Water intrusion Vp-p limit" SWORD Compu_WTRIN_Vpp_diag 0 0 -32 31.9990234375 ECU_ADDRESS 0x01006820 /end MEASUREMENT
/begin COMPU_METHOD Compu_WTRIN_Vpp_diag " " RAT_FUNC "%.2" "volts" COEFFS 0 1024 0 0 0 1 /end COMPU_METHOD
/begin MEASUREMENT WTRIN_Vavg "Water intrusion Vavg sense" SWORD Compu_WTRIN_Vavg 0 0 -32 31.9990234375 ECU_ADDRESS 0x01006828 /end MEASUREMENT
/begin COMPU_METHOD Compu_WTRIN_Vavg " " RAT_FUNC "%.2" "volts" COEFFS 0 1024 0 0 0 1 /end COMPU_METHOD
/begin CHARACTERISTIC WTRIN_Vpp_H "Upper Vp-p limit @Vavg>=2.5 (Fault Condition:if Vavg >= 2.5V and Vp-p >)" VALUE 0x001c6c24 /* @ECU_Address@WTRIN_Vpp_H@0x01006830@ */ ECIPP_ALIGNMENT_SWORD 32 Compu_WTRIN_Vpp_H -32 31.9990234375 /end CHARACTERISTIC
/begin COMPU_METHOD Compu_WTRIN_Vpp_H " " RAT_FUNC "%.2" "volts" COEFFS 0 1024 0 0 0 1 /end COMPU_METHOD
/begin CHARACTERISTIC WTRIN_Vpp_L "Lower Vp-p limit @Vavg<=Lower Vavg (Fault Condition:and corresponding Vp-p >)" VALUE 0x001c6c26 /* @ECU_Address@WTRIN_Vpp_L@0x01006838@ */ ECIPP_ALIGNMENT_SWORD 32 Compu_WTRIN_Vpp_L -32 31.9990234375 /end CHARACTERISTIC
/begin COMPU_METHOD Compu_WTRIN_Vpp_L " " RAT_FUNC "%.2" "volts" COEFFS 0 1024 0 0 0 1 /end COMPU_METHOD
/begin CHARACTERISTIC WTRIN_Vpp_VavgL "Lower Vavg value for Lower Vp-p limit (Fault Condition:or with linear interpolation down to Vavg <=)" VALUE 0x001c6c28 /* @ECU_Address@WTRIN_Vpp_VavgL@0x01006840@ */ ECIPP_ALIGNMENT_SWORD 32 Compu_WTRIN_Vpp_VavgL -32 31.9990234375 /end CHARACTERISTIC
/begin COMPU_METHOD Compu_WTRIN_Vpp_VavgL " " RAT_FUNC "%.2" "volts" COEFFS 0 1024 0 0 0 1 /end COMPU_METHOD
/begin CHARACTERISTIC WTRIN_Vavg_tau "Water intrusion Vavg low-pass tau" VALUE 0x001c864c /* @ECU_Address@WTRIN_Vavg_tau@0x01006848@ */ ECIPP_ALIGNMENT_UWORD 1638398 Compu_WTRIN_Vavg_tau 1.6703 1638400 /end CHARACTERISTIC
/begin COMPU_METHOD Compu_WTRIN_Vavg_tau " " FORM "%.0" "ms"
 /begin FORMULA "-50 / log(1.0000000000001 - (X1 / 32768))" FORMULA_INV "(1.0000000000001 - exp(-50/X1)) * 32768" /end FORMULA
/end COMPU_METHOD
/begin CHARACTERISTIC SHIFT_ena "Shift actuator control{SHIFT_ena&0xff=0:Disabled}{SHIFT_ena&0xff=1:Marine FNR H-Bridge}{SHIFT_ena&0xff=2:Marine 2-Speed Auto Solenoid}{SHIFT_ena&0xff=3:Marine FNR Solenoid Dir Monitored}" VALUE 0x001c8906 /* @ECU_Address@SHIFT_ena@0x01006888@ */ ECIPP_ALIGNMENT_UBYTE 255 SHIFT_ena_COMPU_VTAB 0 255 BIT_MASK 0xff /end CHARACTERISTIC
/begin COMPU_METHOD SHIFT_ena_COMPU_VTAB "Verbal Table" TAB_VERB "%.0" "list" COMPU_TAB_REF SHIFT_ena_COMPU_VTAB_REF /end COMPU_METHOD
/begin COMPU_VTAB SHIFT_ena_COMPU_VTAB_REF "Verbal Table" TAB_VERB 4 0 "Disabled" 1 "Marine FNR H-Bridge" 2 "Marine 2-Speed Auto Solenoid" 3 "Marine FNR Solenoid Dir Monitored" DEFAULT_VALUE "UNKNOWN" /end COMPU_VTAB
/begin CHARACTERISTIC SHIFT_Kp "Shift actuator Kp" VALUE 0x001c458e /* @ECU_Address@SHIFT_Kp@0x01006890@ */ ECIPP_ALIGNMENT_SWORD 64 Compu_SHIFT_Kp -64 63.998046875 /end CHARACTERISTIC
/begin COMPU_METHOD Compu_SHIFT_Kp " " RAT_FUNC "%.1" "%/AD" COEFFS 0 512 0 0 0 1 /end COMPU_METHOD
/begin CHARACTERISTIC SHIFT_Ki "Shift actuator Ki" VALUE 0x001c458c /* @ECU_Address@SHIFT_Ki@0x01006898@ */ ECIPP_ALIGNMENT_SWORD 2000 Compu_SHIFT_Ki -2000 1999.93896484375 /end CHARACTERISTIC
/begin COMPU_METHOD Compu_SHIFT_Ki " " RAT_FUNC "%.1" "%/AD/sec" COEFFS 0 16.384 0 0 0 1 /end COMPU_METHOD
/begin CHARACTERISTIC SHIFT_int_max "Shift integrator max" VALUE 0x001c4592 /* @ECU_Address@SHIFT_int_max@0x010068A0@ */ ECIPP_ALIGNMENT_SWORD 25599 Compu_SHIFT_int_max -25600 25599.21875 /end CHARACTERISTIC
/begin COMPU_METHOD Compu_SHIFT_int_max " " RAT_FUNC "%.1" "%" COEFFS 0 1.28 0 0 0 1 /end COMPU_METHOD
/begin CHARACTERISTIC SHIFT_int_dt_frz "Shift integrator freeze rate" VALUE 0x001c7f50 /* @ECU_Address@SHIFT_int_dt_frz@0x010068A8@ */ ECIPP_ALIGNMENT_UWORD 25000 Compu_SHIFT_int_dt_frz 0 24999.6185302734 /end CHARACTERISTIC
/begin COMPU_METHOD Compu_SHIFT_int_dt_frz " " RAT_FUNC "%.1" "%/sec" COEFFS 0 2.62144 0 0 0 1 /end COMPU_METHOD
/begin CHARACTERISTIC SHIFT_Ihard_lim "Shift hardware current limit" VALUE 0x001c4586 /* @ECU_Address@SHIFT_Ihard_lim@0x010068C0@ */ ECIPP_ALIGNMENT_SWORD 128 Compu_SHIFT_Ihard_lim -128 127.99609375 /end CHARACTERISTIC
/begin COMPU_METHOD Compu_SHIFT_Ihard_lim " " RAT_FUNC "%.1" "amps" COEFFS 0 256 0 0 0 1 /end COMPU_METHOD
/begin CHARACTERISTIC SHIFT_Ipark_ena "Shift parking current control{SHIFT_Ipark_ena&0xff=0:Disabled}{SHIFT_Ipark_ena&0xff=1:Enabled}" VALUE 0x001c8904 /* @ECU_Address@SHIFT_Ipark_ena@0x010068C8@ */ ECIPP_ALIGNMENT_UBYTE 255 SHIFT_Ipark_ena_COMPU_VTAB 0 255 BIT_MASK 0xff /end CHARACTERISTIC
/begin COMPU_METHOD SHIFT_Ipark_ena_COMPU_VTAB "Verbal Table" TAB_VERB "%.0" "list" COMPU_TAB_REF SHIFT_Ipark_ena_COMPU_VTAB_REF /end COMPU_METHOD
/begin COMPU_VTAB SHIFT_Ipark_ena_COMPU_VTAB_REF "Verbal Table" TAB_VERB 2 0 "Disabled" 1 "Enabled" DEFAULT_VALUE "UNKNOWN" /end COMPU_VTAB
/begin CHARACTERISTIC SHIFT_Ipark_lim "Shift I park limit" VALUE 0x001c7f44 /* @ECU_Address@SHIFT_Ipark_lim@0x010068D0@ */ ECIPP_ALIGNMENT_UWORD 256 Compu_SHIFT_Ipark_lim 0 255.99609375 /end CHARACTERISTIC
/begin COMPU_METHOD Compu_SHIFT_Ipark_lim " " RAT_FUNC "%.1" "amps" COEFFS 0 256 0 0 0 1 /end COMPU_METHOD
/begin CHARACTERISTIC SHIFT_Ipark_dly "Shift I park delay" VALUE 0x001c7f42 /* @ECU_Address@SHIFT_Ipark_dly@0x010068D8@ */ ECIPP_ALIGNMENT_UWORD 66 Compu_SHIFT_Ipark_dly 0 65.535 /end CHARACTERISTIC
/begin COMPU_METHOD Compu_SHIFT_Ipark_dly " " RAT_FUNC "%.2" "sec" COEFFS 0 1000 0 0 0 1 /end COMPU_METHOD
/begin CHARACTERISTIC SHIFT_Ipark_Ki "Shift I park ramp" VALUE 0x001c7f40 /* @ECU_Address@SHIFT_Ipark_Ki@0x010068E0@ */ ECIPP_ALIGNMENT_UWORD 3125 Compu_SHIFT_Ipark_Ki 0 3124.95231628418 /end CHARACTERISTIC
/begin COMPU_METHOD Compu_SHIFT_Ipark_Ki " " RAT_FUNC "%.1" "%/amp/sec" COEFFS 0 20.97152 0 0 0 1 /end COMPU_METHOD
/begin CHARACTERISTIC SHIFT_Ipark_max_att "Shift I park max attenuation" VALUE 0x001c4588 /* @ECU_Address@SHIFT_Ipark_max_att@0x010068E8@ */ ECIPP_ALIGNMENT_SWORD 100 Compu_SHIFT_Ipark_max_att -100 99.9969482421875 /end CHARACTERISTIC
/begin COMPU_METHOD Compu_SHIFT_Ipark_max_att " " RAT_FUNC "%.1" "% decrease" COEFFS 0 327.68 0 0 0 1 /end COMPU_METHOD
/begin CHARACTERISTIC SHIFT_Vcomp_min "Shift voltage comp min / std" VALUE 0x001c7f48 /* @ECU_Address@SHIFT_Vcomp_min@0x010068F0@ */ ECIPP_ALIGNMENT_UWORD 256 Compu_SHIFT_Vcomp_min 0 255.99609375 /end CHARACTERISTIC
/begin COMPU_METHOD Compu_SHIFT_Vcomp_min " " RAT_FUNC "%.1" "volts" COEFFS 0 256 0 0 0 1 /end COMPU_METHOD
/begin CHARACTERISTIC SHIFT_Vcomp_max "Shift voltage comp max" VALUE 0x001c7f46 /* @ECU_Address@SHIFT_Vcomp_max@0x010068F8@ */ ECIPP_ALIGNMENT_UWORD 256 Compu_SHIFT_Vcomp_max 0 255.99609375 /end CHARACTERISTIC
/begin COMPU_METHOD Compu_SHIFT_Vcomp_max " " RAT_FUNC "%.1" "volts" COEFFS 0 256 0 0 0 1 /end COMPU_METHOD
/begin CHARACTERISTIC SHIFT_rev_raw "SHIFT_rev_raw" VALUE 0x001c7f58 /* @ECU_Address@SHIFT_rev_raw@0x01006900@ */ ECIPP_ALIGNMENT_UWORD 5 Compu_SHIFT_rev_raw 0 5.00114468864469 /end CHARACTERISTIC
/begin COMPU_METHOD Compu_SHIFT_rev_raw " " RAT_FUNC "%.3" "volts" COEFFS 0 13104 0 0 0 1 /end COMPU_METHOD
/begin CHARACTERISTIC SHIFT_fwd_raw "SHIFT_fwd_raw" VALUE 0x001c7f4e /* @ECU_Address@SHIFT_fwd_raw@0x01006908@ */ ECIPP_ALIGNMENT_UWORD 5 Compu_SHIFT_fwd_raw 0 5.00114468864469 /end CHARACTERISTIC
/begin COMPU_METHOD Compu_SHIFT_fwd_raw " " RAT_FUNC "%.3" "volts" COEFFS 0 13104 0 0 0 1 /end COMPU_METHOD
/begin CHARACTERISTIC SHIFT_neut_raw "SHIFT_neut_raw" VALUE 0x001c7f54 /* @ECU_Address@SHIFT_neut_raw@0x01006910@ */ ECIPP_ALIGNMENT_UWORD 5 Compu_SHIFT_neut_raw 0 5.00114468864469 /end CHARACTERISTIC
/begin COMPU_METHOD Compu_SHIFT_neut_raw " " RAT_FUNC "%.3" "volts" COEFFS 0 13104 0 0 0 1 /end COMPU_METHOD
/begin CHARACTERISTIC SHIFT_rev_delta "SHIFT_rev_delta" VALUE 0x001c7f56 /* @ECU_Address@SHIFT_rev_delta@0x01006918@ */ ECIPP_ALIGNMENT_UWORD 5 Compu_SHIFT_rev_delta 0 5.00114468864469 /end CHARACTERISTIC
/begin COMPU_METHOD Compu_SHIFT_rev_delta " " RAT_FUNC "%.3" "volts" COEFFS 0 13104 0 0 0 1 /end COMPU_METHOD
/begin CHARACTERISTIC SHIFT_fwd_delta "SHIFT_fwd_delta" VALUE 0x001c7f4c /* @ECU_Address@SHIFT_fwd_delta@0x01006920@ */ ECIPP_ALIGNMENT_UWORD 5 Compu_SHIFT_fwd_delta 0 5.00114468864469 /end CHARACTERISTIC
/begin COMPU_METHOD Compu_SHIFT_fwd_delta " " RAT_FUNC "%.3" "volts" COEFFS 0 13104 0 0 0 1 /end COMPU_METHOD
/begin CHARACTERISTIC SHIFT_neut_delta "SHIFT_neut_delta" VALUE 0x001c7f52 /* @ECU_Address@SHIFT_neut_delta@0x01006928@ */ ECIPP_ALIGNMENT_UWORD 5 Compu_SHIFT_neut_delta 0 5.00114468864469 /end CHARACTERISTIC
/begin COMPU_METHOD Compu_SHIFT_neut_delta " " RAT_FUNC "%.3" "volts" COEFFS 0 13104 0 0 0 1 /end COMPU_METHOD
/begin MEASUREMENT SHIFT_ctl_max "Shift control max" SLONG Compu_SHIFT_ctl_max 0 0 -25600 25599.9999880791 ECU_ADDRESS 0x01006930 /end MEASUREMENT
/begin COMPU_METHOD Compu_SHIFT_ctl_max " " RAT_FUNC "%.1" "%" COEFFS 0 83886.08 0 0 0 1 /end COMPU_METHOD
/begin MEASUREMENT SHIFT_ctl_min "Shift control min" SLONG Compu_SHIFT_ctl_min 0 0 -25600 25599.9999880791 ECU_ADDRESS 0x01006938 /end MEASUREMENT
/begin COMPU_METHOD Compu_SHIFT_ctl_min " " RAT_FUNC "%.1" "%" COEFFS 0 83886.08 0 0 0 1 /end COMPU_METHOD
/begin MEASUREMENT SHIFT_ctl_cmd "Shift control cmd" SWORD Compu_SHIFT_ctl_cmd 0 0 -100 99.9969482421875 ECU_ADDRESS 0x01006940 /end MEASUREMENT
/begin COMPU_METHOD Compu_SHIFT_ctl_cmd " " RAT_FUNC "%.1" "%" COEFFS 0 327.68 0 0 0 1 /end COMPU_METHOD
/begin MEASUREMENT SHIFT_I_est "Shift actuator est current" SWORD Compu_SHIFT_I_est 0 0 -128 127.99609375 ECU_ADDRESS 0x01006948 /end MEASUREMENT
/begin COMPU_METHOD Compu_SHIFT_I_est " " RAT_FUNC "%.1" "amps" COEFFS 0 256 0 0 0 1 /end COMPU_METHOD
/begin MEASUREMENT SHIFT_I_meas "Shift actuator meas current" SWORD Compu_SHIFT_I_meas 0 0 -128 127.99609375 ECU_ADDRESS 0x01006950 /end MEASUREMENT
/begin COMPU_METHOD Compu_SHIFT_I_meas " " RAT_FUNC "%.1" "amps" COEFFS 0 256 0 0 0 1 /end COMPU_METHOD
/begin CHARACTERISTIC SHIFT_engage_delay "Shift mech engage delay" VALUE 0x001c7f4a /* @ECU_Address@SHIFT_engage_delay@0x01006958@ */ ECIPP_ALIGNMENT_UWORD 65535 Compu_SHIFT_engage_delay 0 65535 /end CHARACTERISTIC
/begin COMPU_METHOD Compu_SHIFT_engage_delay " " RAT_FUNC "%.0" "ms" COEFFS 0 1 0 0 0 1 /end COMPU_METHOD
/begin MEASUREMENT SHIFT_active_wt "Shift in-progress wait time" UWORD Compu_SHIFT_active_wt 0 0 0 65535 ECU_ADDRESS 0x01006960 /end MEASUREMENT
/begin COMPU_METHOD Compu_SHIFT_active_wt " " RAT_FUNC "%.0" "ms" COEFFS 0 1 0 0 0 1 /end COMPU_METHOD
/begin CHARACTERISTIC SHIFT_R_ohms "Shift actuator resistance" VALUE 0x001c4590 /* @ECU_Address@SHIFT_R_ohms@0x01006990@ */ ECIPP_ALIGNMENT_SWORD 16 Compu_SHIFT_R_ohms -16 15.99951171875 /end CHARACTERISTIC
/begin COMPU_METHOD Compu_SHIFT_R_ohms " " RAT_FUNC "%.2" "ohms" COEFFS 0 2048 0 0 0 1 /end COMPU_METHOD
/begin CHARACTERISTIC SHIFT_K_emf "Shift actuator K emf" VALUE 0x001c458a /* @ECU_Address@SHIFT_K_emf@0x01006998@ */ ECIPP_ALIGNMENT_SWORD 16 Compu_SHIFT_K_emf -16.384 16.3835 /end CHARACTERISTIC
/begin COMPU_METHOD Compu_SHIFT_K_emf " " RAT_FUNC "%.2" "volts / 5V * sec" COEFFS 0 2000 0 0 0 1 /end COMPU_METHOD
/begin MEASUREMENT SHIFT_ctl_fault "SHIFT_ctl_fault{SHIFT_ctl_fault&0x01=0x00:Off}{SHIFT_ctl_fault&0x01=0x01:On}" UBYTE SHIFT_ctl_fault_COMPU_VTAB 0 0 0 255 ECU_ADDRESS 0x010069A8 BIT_MASK 0x01 /end MEASUREMENT
/begin COMPU_METHOD SHIFT_ctl_fault_COMPU_VTAB "Verbal Table" TAB_VERB "%.0" "list" COMPU_TAB_REF SHIFT_ctl_fault_COMPU_VTAB_REF /end COMPU_METHOD
/begin COMPU_VTAB SHIFT_ctl_fault_COMPU_VTAB_REF "Verbal Table" TAB_VERB 2 0x00 "Off" 0x01 "On" DEFAULT_VALUE "UNKNOWN" /end COMPU_VTAB
/begin MEASUREMENT SHIFT_Ipark_att "SHIFT parking current attenuation" SWORD Compu_SHIFT_Ipark_att 0 0 -100 99.9969482421875 ECU_ADDRESS 0x010069B0 /end MEASUREMENT
/begin COMPU_METHOD Compu_SHIFT_Ipark_att " " RAT_FUNC "%.1" "%" COEFFS 0 327.68 0 0 0 1 /end COMPU_METHOD
/begin MEASUREMENT SHIFT_int_acc "SHIFT integral accum" SWORD Compu_SHIFT_int_acc 0 0 -25600 25599.21875 ECU_ADDRESS 0x010069B8 /end MEASUREMENT
/begin COMPU_METHOD Compu_SHIFT_int_acc " " RAT_FUNC "%.1" "%" COEFFS 0 1.28 0 0 0 1 /end COMPU_METHOD
/begin MEASUREMENT SHIFT_I_est_abs "SHIFT actuator est abs current" SWORD Compu_SHIFT_I_est_abs 0 0 -128 127.99609375 ECU_ADDRESS 0x010069C8 /end MEASUREMENT
/begin COMPU_METHOD Compu_SHIFT_I_est_abs " " RAT_FUNC "%.1" "amps" COEFFS 0 256 0 0 0 1 /end COMPU_METHOD
/begin CHARACTERISTIC SHIFT_target_dead "SHIFT target deadband" VALUE 0x001c7f5a /* @ECU_Address@SHIFT_target_dead@0x010069D0@ */ ECIPP_ALIGNMENT_UWORD 5 Compu_SHIFT_target_dead 0 5.00114468864469 /end CHARACTERISTIC
/begin COMPU_METHOD Compu_SHIFT_target_dead " " RAT_FUNC "%.3" "volts" COEFFS 0 13104 0 0 0 1 /end COMPU_METHOD
/begin MEASUREMENT drivebrake_torq_pct "Drivebrake torque pct" SWORD Compu_drivebrake_torq_pct 0 0 -200 199.993896484375 ECU_ADDRESS 0x010075E0 /end MEASUREMENT
/begin COMPU_METHOD Compu_drivebrake_torq_pct " " RAT_FUNC "%.1" "% of ref" COEFFS 0 163.84 0 0 0 1 /end COMPU_METHOD
/begin MEASUREMENT exhbrake_torq_pct "Exhbrake torque pct" SWORD Compu_exhbrake_torq_pct 0 0 -200 199.993896484375 ECU_ADDRESS 0x010075E8 /end MEASUREMENT
/begin COMPU_METHOD Compu_exhbrake_torq_pct " " RAT_FUNC "%.1" "% of ref" COEFFS 0 163.84 0 0 0 1 /end COMPU_METHOD
/begin MEASUREMENT drivebrake_torq_max "Drivebrake torque max" SWORD Compu_drivebrake_torq_max 0 0 -200 199.993896484375 ECU_ADDRESS 0x010075F0 /end MEASUREMENT
/begin COMPU_METHOD Compu_drivebrake_torq_max " " RAT_FUNC "%.1" "% of ref" COEFFS 0 163.84 0 0 0 1 /end COMPU_METHOD
/begin MEASUREMENT exhbrake_torq_max "Exhbrake torque max" SWORD Compu_exhbrake_torq_max 0 0 -200 199.993896484375 ECU_ADDRESS 0x010075F8 /end MEASUREMENT
/begin COMPU_METHOD Compu_exhbrake_torq_max " " RAT_FUNC "%.1" "% of ref" COEFFS 0 163.84 0 0 0 1 /end COMPU_METHOD
/begin MEASUREMENT eng_torque_mode "Engine torque mode{eng_torque_mode&0xff=0:None}{eng_torque_mode&0xff=1:FPP}{eng_torque_mode&0xff=2:Cruise control}{eng_torque_mode&0xff=3:Power takeoff}{eng_torque_mode&0xff=4:Roadspeed limit}{eng_torque_mode&0xff=5:ASR control}{eng_torque_mode&0xff=6:Tra" UBYTE eng_torque_mode_COMPU_VTAB 0 0 0 255 ECU_ADDRESS 0x01007640 BIT_MASK 0xff /end MEASUREMENT
/begin COMPU_METHOD eng_torque_mode_COMPU_VTAB "Verbal Table" TAB_VERB "%.0" "list" COMPU_TAB_REF eng_torque_mode_COMPU_VTAB_REF /end COMPU_METHOD
/begin COMPU_VTAB eng_torque_mode_COMPU_VTAB_REF "Verbal Table" TAB_VERB 16 0 "None" 1 "FPP" 2 "Cruise control" 3 "Power takeoff" 4 "Roadspeed limit" 5 "ASR control" 6 "Transmission" 7 "ABS control" 8 "Torque limit" 9 "Max governor" 10 "Electronic brakes" 11 "Remote FPP" 12 "Service procedure" 13 "UNDEFINED" 14 "Other" 15 "Not Available" DEFAULT_VALUE "UNKNOWN" /end COMPU_VTAB
/begin CHARACTERISTIC TWAKE_wakepos_ena "Wake plate position input{TWAKE_wakepos_ena&0xff=0:Disabled}{TWAKE_wakepos_ena&0xff=1:Aux PU1}{TWAKE_wakepos_ena&0xff=2:Aux PU2}{TWAKE_wakepos_ena&0xff=3:Aux PU3}{TWAKE_wakepos_ena&0xff=4:Aux PD1}{TWAKE_wakepos_ena&0xff=5:Aux PD2}{TWAKE_wakepos_ena&0xff=6" VALUE 0x001c8f60 /* @ECU_Address@TWAKE_wakepos_ena@0x010079C8@ */ ECIPP_ALIGNMENT_UBYTE 255 TWAKE_wakepos_ena_COMPU_VTAB 0 255 BIT_MASK 0xff /end CHARACTERISTIC
/begin COMPU_METHOD TWAKE_wakepos_ena_COMPU_VTAB "Verbal Table" TAB_VERB "%.0" "list" COMPU_TAB_REF TWAKE_wakepos_ena_COMPU_VTAB_REF /end COMPU_METHOD
/begin COMPU_VTAB TWAKE_wakepos_ena_COMPU_VTAB_REF "Verbal Table" TAB_VERB 12 0 "Disabled" 1 "Aux PU1" 2 "Aux PU2" 3 "Aux PU3" 4 "Aux PD1" 5 "Aux PD2" 6 "Aux PD3" 7 "Aux PUD1" 8 "Aux PUD2" 9 "Aux PUD3" 10 "Aux PUD4" 11 "Aux PUD5" DEFAULT_VALUE "UNKNOWN" /end COMPU_VTAB
/begin CHARACTERISTIC TWAKE_wakeup_over "Wake plate up override input{TWAKE_wakeup_over&0xff=0:Disabled}{TWAKE_wakeup_over&0xff=1:Aux PU1}{TWAKE_wakeup_over&0xff=2:Aux PU2}{TWAKE_wakeup_over&0xff=3:Aux PU3}{TWAKE_wakeup_over&0xff=4:Aux PUD1}{TWAKE_wakeup_over&0xff=5:Aux PUD2}{TWAKE_wakeup_over&0" VALUE 0x001c8f62 /* @ECU_Address@TWAKE_wakeup_over@0x010079D0@ */ ECIPP_ALIGNMENT_UBYTE 255 TWAKE_wakeup_over_COMPU_VTAB 0 255 BIT_MASK 0xff /end CHARACTERISTIC
/begin COMPU_METHOD TWAKE_wakeup_over_COMPU_VTAB "Verbal Table" TAB_VERB "%.0" "list" COMPU_TAB_REF TWAKE_wakeup_over_COMPU_VTAB_REF /end COMPU_METHOD
/begin COMPU_VTAB TWAKE_wakeup_over_COMPU_VTAB_REF "Verbal Table" TAB_VERB 10 0 "Disabled" 1 "Aux PU1" 2 "Aux PU2" 3 "Aux PU3" 4 "Aux PUD1" 5 "Aux PUD2" 6 "Aux PUD3" 7 "Aux DIG1" 8 "Aux DIG2" 9 "Aux DIG3" DEFAULT_VALUE "UNKNOWN" /end COMPU_VTAB
/begin CHARACTERISTIC TWAKE_wakeup_ena "Wake plate up output{TWAKE_wakeup_ena&0xff=0:Disabled}{TWAKE_wakeup_ena&0xff=1:Aux PWM1}{TWAKE_wakeup_ena&0xff=2:Aux PWM2}{TWAKE_wakeup_ena&0xff=3:Aux PWM3}{TWAKE_wakeup_ena&0xff=4:Aux PWM4}{TWAKE_wakeup_ena&0xff=5:Aux PWM5}{TWAKE_wakeup_ena&0xff=6:Aux PW" VALUE 0x001c8f61 /* @ECU_Address@TWAKE_wakeup_ena@0x010079D8@ */ ECIPP_ALIGNMENT_UBYTE 255 TWAKE_wakeup_ena_COMPU_VTAB 0 255 BIT_MASK 0xff /end CHARACTERISTIC
/begin COMPU_METHOD TWAKE_wakeup_ena_COMPU_VTAB "Verbal Table" TAB_VERB "%.0" "list" COMPU_TAB_REF TWAKE_wakeup_ena_COMPU_VTAB_REF /end COMPU_METHOD
/begin COMPU_VTAB TWAKE_wakeup_ena_COMPU_VTAB_REF "Verbal Table" TAB_VERB 9 0 "Disabled" 1 "Aux PWM1" 2 "Aux PWM2" 3 "Aux PWM3" 4 "Aux PWM4" 5 "Aux PWM5" 6 "Aux PWM6" 7 "Aux PWM7" 8 "Aux PWM8" DEFAULT_VALUE "UNKNOWN" /end COMPU_VTAB
/begin CHARACTERISTIC TWAKE_wakedown_ena "Wake plate down output{TWAKE_wakedown_ena&0xff=0:Disabled}{TWAKE_wakedown_ena&0xff=1:Aux PWM1}{TWAKE_wakedown_ena&0xff=2:Aux PWM2}{TWAKE_wakedown_ena&0xff=3:Aux PWM3}{TWAKE_wakedown_ena&0xff=4:Aux PWM4}{TWAKE_wakedown_ena&0xff=5:Aux PWM5}{TWAKE_wakedown_e" VALUE 0x001c8f5f /* @ECU_Address@TWAKE_wakedown_ena@0x010079E0@ */ ECIPP_ALIGNMENT_UBYTE 255 TWAKE_wakedown_ena_COMPU_VTAB 0 255 BIT_MASK 0xff /end CHARACTERISTIC
/begin COMPU_METHOD TWAKE_wakedown_ena_COMPU_VTAB "Verbal Table" TAB_VERB "%.0" "list" COMPU_TAB_REF TWAKE_wakedown_ena_COMPU_VTAB_REF /end COMPU_METHOD
/begin COMPU_VTAB TWAKE_wakedown_ena_COMPU_VTAB_REF "Verbal Table" TAB_VERB 9 0 "Disabled" 1 "Aux PWM1" 2 "Aux PWM2" 3 "Aux PWM3" 4 "Aux PWM4" 5 "Aux PWM5" 6 "Aux PWM6" 7 "Aux PWM7" 8 "Aux PWM8" DEFAULT_VALUE "UNKNOWN" /end COMPU_VTAB
/begin MEASUREMENT TWAKE_wakeup_on "Wake plate up active{TWAKE_wakeup_on&0x10=0x00:Off}{TWAKE_wakeup_on&0x10=0x10:On}" UBYTE TWAKE_wakeup_on_COMPU_VTAB 0 0 0 255 ECU_ADDRESS 0x010079E8 BIT_MASK 0xFF /end MEASUREMENT
/begin COMPU_METHOD TWAKE_wakeup_on_COMPU_VTAB "Verbal Table" TAB_VERB "%.0" "list" COMPU_TAB_REF TWAKE_wakeup_on_COMPU_VTAB_REF /end COMPU_METHOD
/begin COMPU_VTAB TWAKE_wakeup_on_COMPU_VTAB_REF "Verbal Table" TAB_VERB 2 0x00 "Off" 0x10 "On" DEFAULT_VALUE "Unsupported Bit_Shift" /end COMPU_VTAB
/begin MEASUREMENT TWAKE_wakedown_on "Wake plate down active{TWAKE_wakedown_on&0x20=0x00:Off}{TWAKE_wakedown_on&0x20=0x20:On}" UBYTE TWAKE_wakedown_on_COMPU_VTAB 0 0 0 255 ECU_ADDRESS 0x010079F0 BIT_MASK 0x20 /end MEASUREMENT
/begin COMPU_METHOD TWAKE_wakedown_on_COMPU_VTAB "Verbal Table" TAB_VERB "%.0" "list" COMPU_TAB_REF TWAKE_wakedown_on_COMPU_VTAB_REF /end COMPU_METHOD
/begin COMPU_VTAB TWAKE_wakedown_on_COMPU_VTAB_REF "Verbal Table" TAB_VERB 2 0x00 "Off" 0x20 "On" DEFAULT_VALUE "UNKNOWN" /end COMPU_VTAB
/begin MEASUREMENT FPP_cmd_pstslew "FPP_cmd_pstslew" UWORD Compu_FPP_cmd_pstslew 0 0 0 99.9984741210938 ECU_ADDRESS 0x01008AC8 /end MEASUREMENT
/begin COMPU_METHOD Compu_FPP_cmd_pstslew " " RAT_FUNC "%.1" "%" COEFFS 0 655.36 0 0 0 1 /end COMPU_METHOD
/begin MEASUREMENT SHIFT_retard "M2TC torque-cut current spark retard" UWORD Compu_SHIFT_retard 0 0 0 127.998046875 ECU_ADDRESS 0x01008CD0 /end MEASUREMENT
/begin COMPU_METHOD Compu_SHIFT_retard " " RAT_FUNC "%.1" "CAD retard" COEFFS 0 512 0 0 0 1 /end COMPU_METHOD
/begin MEASUREMENT SHIFT_LoadLim_pct "M2TC torque-cut current load limit" UWORD Compu_SHIFT_LoadLim_pct 0 0 0 99.9984741210938 ECU_ADDRESS 0x01008CD8 /end MEASUREMENT
/begin COMPU_METHOD Compu_SHIFT_LoadLim_pct " " RAT_FUNC "%.1" "% load" COEFFS 0 655.36 0 0 0 1 /end COMPU_METHOD
/begin CHARACTERISTIC TRANS_ratio1 "Transmission 1st forward gear ratio" VALUE 0x001C81C8 /* @ECU_Address@TRANS_ratio1@0x01008CE8@ */ ECIPP_ALIGNMENT_UWORD 64 Compu_TRANS_ratio1 0 63.9990234375 /end CHARACTERISTIC
/begin COMPU_METHOD Compu_TRANS_ratio1 " " RAT_FUNC "%.3" "in/out" COEFFS 0 1024 0 0 0 1 /end COMPU_METHOD
/begin CHARACTERISTIC TRANS_ratio2 "Transmission 2nd forward gear ratio" VALUE 0x001C81CA /* @ECU_Address@TRANS_ratio2@0x01008CF0@ */ ECIPP_ALIGNMENT_UWORD 64 Compu_TRANS_ratio2 0 63.9990234375 /end CHARACTERISTIC
/begin COMPU_METHOD Compu_TRANS_ratio2 " " RAT_FUNC "%.3" "in/out" COEFFS 0 1024 0 0 0 1 /end COMPU_METHOD
/begin CHARACTERISTIC M2TC_output_ena "M2TC shift solenoid output channel{M2TC_output_ena&0xff=0:Disabled}{M2TC_output_ena&0xff=1:Buzzer Output}{M2TC_output_ena&0xff=2:MIL Output}{M2TC_output_ena&0xff=3:TACH Output}{M2TC_output_ena&0xff=4:Starter Output}{M2TC_output_ena&0xff=5:EGOH1}{M2TC_outp" VALUE 0x001c8810 /* @ECU_Address@M2TC_output_ena@0x01008CF8@ */ ECIPP_ALIGNMENT_UBYTE 255 M2TC_output_ena_COMPU_VTAB 0 255 BIT_MASK 0xff /end CHARACTERISTIC
/begin COMPU_METHOD M2TC_output_ena_COMPU_VTAB "Verbal Table" TAB_VERB "%.0" "list" COMPU_TAB_REF M2TC_output_ena_COMPU_VTAB_REF /end COMPU_METHOD
/begin COMPU_VTAB M2TC_output_ena_COMPU_VTAB_REF "Verbal Table" TAB_VERB 32 0 "Disabled" 1 "Buzzer Output" 2 "MIL Output" 3 "TACH Output" 4 "Starter Output" 5 "EGOH1" 6 "EGOH2" 7 "EGOH3" 8 "EGOH4" 9 "Aux PWM1" 10 "Aux PWM2" 11 "Aux PWM3" 12 "Aux PWM4" 13 "Aux PWM5" 14 "Aux PWM6" 15 "Aux PWM7" 16 "Aux PWM8" 17 "Aux PWM9" 18 "Aux PWM10" 19 "Aux PWM11" 20 "Aux PWM12" 21 "Aux PWM13" 22 "Aux PWM14" 23 "Aux PWM15" 24 "Aux PWM16" 25 "Aux PWM17" 26 "Aux PWM18" 27 "Aux PWM19" 28 "Aux PWM20" 29 "Aux PWM21" 30 "Aux PWM22" 31 "Aux PWM23" DEFAULT_VALUE "UNKNOWN" /end COMPU_VTAB
/begin MEASUREMENT M2TC_rpmlim "M2TC current governor limit" UWORD Compu_M2TC_rpmlim 0 0 0 65535 ECU_ADDRESS 0x01008D00 /end MEASUREMENT
/begin COMPU_METHOD Compu_M2TC_rpmlim " " RAT_FUNC "%.0" "rpm" COEFFS 0 1 0 0 0 1 /end COMPU_METHOD
/begin CHARACTERISTIC M2TC_prrlim_G1 "M2TC 1st gear engine governor limit" VALUE 0x001c7d2e /* @ECU_Address@M2TC_prrlim_G1@0x01008D08@ */ ECIPP_ALIGNMENT_UWORD 100 Compu_M2TC_prrlim_G1 0 99.9984741210938 /end CHARACTERISTIC
/begin COMPU_METHOD Compu_M2TC_prrlim_G1 " " RAT_FUNC "%.1" "% rated rpm" COEFFS 0 655.36 0 0 0 1 /end COMPU_METHOD
/begin CHARACTERISTIC M2TC_prrlim_G2 "M2TC 2nd gear engine governor limit" VALUE 0x001c7d30 /* @ECU_Address@M2TC_prrlim_G2@0x01008D10@ */ ECIPP_ALIGNMENT_UWORD 100 Compu_M2TC_prrlim_G2 0 99.9984741210938 /end CHARACTERISTIC
/begin COMPU_METHOD Compu_M2TC_prrlim_G2 " " RAT_FUNC "%.1" "% rated rpm" COEFFS 0 655.36 0 0 0 1 /end COMPU_METHOD
/begin CHARACTERISTIC M2TC_prrlim_nhyst "M2TC governor limit change -hysteresis" VALUE 0x001c7d32 /* @ECU_Address@M2TC_prrlim_nhyst@0x01008D18@ */ ECIPP_ALIGNMENT_UWORD 100 Compu_M2TC_prrlim_nhyst 0 99.9984741210938 /end CHARACTERISTIC
/begin COMPU_METHOD Compu_M2TC_prrlim_nhyst " " RAT_FUNC "%.1" "% rated rpm" COEFFS 0 655.36 0 0 0 1 /end COMPU_METHOD
/begin CHARACTERISTIC M2TC_prrshift_1G2 "M2TC 1st to 2nd upshift full-speed" VALUE 0x001c7d34 /* @ECU_Address@M2TC_prrshift_1G2@0x01008D20@ */ ECIPP_ALIGNMENT_UWORD 100 Compu_M2TC_prrshift_1G2 0 99.9984741210938 /end CHARACTERISTIC
/begin COMPU_METHOD Compu_M2TC_prrshift_1G2 " " RAT_FUNC "%.1" "% rated rpm" COEFFS 0 655.36 0 0 0 1 /end COMPU_METHOD
/begin CHARACTERISTIC M2TC_timeshift_1G2 "M2TC 1st to 2nd upshift min-speed wait" VALUE 0x001c7d3c /* @ECU_Address@M2TC_timeshift_1G2@0x01008D28@ */ ECIPP_ALIGNMENT_UWORD 66 Compu_M2TC_timeshift_1G2 0 65.535 /end CHARACTERISTIC
/begin COMPU_METHOD Compu_M2TC_timeshift_1G2 " " RAT_FUNC "%.1" "sec" COEFFS 0 1000 0 0 0 1 /end COMPU_METHOD
/begin CHARACTERISTIC M2TC_prrshift_2G1 "M2TC 2nd to 1st downshift max speed" VALUE 0x001c7d36 /* @ECU_Address@M2TC_prrshift_2G1@0x01008D30@ */ ECIPP_ALIGNMENT_UWORD 100 Compu_M2TC_prrshift_2G1 0 99.9984741210938 /end CHARACTERISTIC
/begin COMPU_METHOD Compu_M2TC_prrshift_2G1 " " RAT_FUNC "%.1" "% rated rpm" COEFFS 0 655.36 0 0 0 1 /end COMPU_METHOD
/begin CHARACTERISTIC M2TC_dly_shift_1G2 "M2TC 1st to 2nd solenoid delay" VALUE 0x001c7d2a /* @ECU_Address@M2TC_dly_shift_1G2@0x01008D38@ */ ECIPP_ALIGNMENT_UWORD 65535 Compu_M2TC_dly_shift_1G2 0 65535 /end CHARACTERISTIC
/begin COMPU_METHOD Compu_M2TC_dly_shift_1G2 " " RAT_FUNC "%.0" "ms" COEFFS 0 1 0 0 0 1 /end COMPU_METHOD
/begin CHARACTERISTIC M2TC_dly_Tcut_1G2 "M2TC 1st to 2nd torque-cut delay" VALUE 0x001c7d28 /* @ECU_Address@M2TC_dly_Tcut_1G2@0x01008D40@ */ ECIPP_ALIGNMENT_UWORD 65535 Compu_M2TC_dly_Tcut_1G2 0 65535 /end CHARACTERISTIC
/begin COMPU_METHOD Compu_M2TC_dly_Tcut_1G2 " " RAT_FUNC "%.0" "ms" COEFFS 0 1 0 0 0 1 /end COMPU_METHOD
/begin CHARACTERISTIC M2TC_dur_Tcut_1G2 "M2TC 1st to 2nd torque-cut duration" VALUE 0x001c7d2c /* @ECU_Address@M2TC_dur_Tcut_1G2@0x01008D48@ */ ECIPP_ALIGNMENT_UWORD 65535 Compu_M2TC_dur_Tcut_1G2 0 65535 /end CHARACTERISTIC
/begin COMPU_METHOD Compu_M2TC_dur_Tcut_1G2 " " RAT_FUNC "%.0" "ms" COEFFS 0 1 0 0 0 1 /end COMPU_METHOD
/begin CHARACTERISTIC M2TC_retard_init "M2TC torque-cut initial spark retard" VALUE 0x001c7d3a /* @ECU_Address@M2TC_retard_init@0x01008D50@ */ ECIPP_ALIGNMENT_UWORD 128 Compu_M2TC_retard_init 0 127.998046875 /end CHARACTERISTIC
/begin COMPU_METHOD Compu_M2TC_retard_init " " RAT_FUNC "%.1" "CAD retard" COEFFS 0 512 0 0 0 1 /end COMPU_METHOD
/begin CHARACTERISTIC M2TC_ret_decay "M2TC torque-cut spark restore rate" VALUE 0x001c7d38 /* @ECU_Address@M2TC_ret_decay@0x01008D58@ */ ECIPP_ALIGNMENT_UWORD 127998 Compu_M2TC_ret_decay 0 127998.046875 /end CHARACTERISTIC
/begin COMPU_METHOD Compu_M2TC_ret_decay " " RAT_FUNC "%.0" "CAD/sec" COEFFS 0 0.512 0 0 0 1 /end COMPU_METHOD
/begin CHARACTERISTIC M2TC_LoadLim_init "M2TC torque-cut initial load limit" VALUE 0x001c7d26 /* @ECU_Address@M2TC_LoadLim_init@0x01008D60@ */ ECIPP_ALIGNMENT_UWORD 100 Compu_M2TC_LoadLim_init 0 99.9984741210938 /end CHARACTERISTIC
/begin COMPU_METHOD Compu_M2TC_LoadLim_init " " RAT_FUNC "%.1" "% load" COEFFS 0 655.36 0 0 0 1 /end COMPU_METHOD
/begin CHARACTERISTIC M2TC_LL_restore "M2TC torque-cut load restore rate" VALUE 0x001c7d24 /* @ECU_Address@M2TC_LL_restore@0x01008D68@ */ ECIPP_ALIGNMENT_UWORD 99998 Compu_M2TC_LL_restore 0 99998.4741210938 /end CHARACTERISTIC
/begin COMPU_METHOD Compu_M2TC_LL_restore " " RAT_FUNC "%.0" "%/sec" COEFFS 0 0.65536 0 0 0 1 /end COMPU_METHOD
/begin MEASUREMENT M2TC_prr "Current engine speed percent" UWORD Compu_M2TC_prr 0 0 0 99.9984741210938 ECU_ADDRESS 0x01008D70 /end MEASUREMENT
/begin COMPU_METHOD Compu_M2TC_prr " " RAT_FUNC "%.1" "% rated rpm" COEFFS 0 655.36 0 0 0 1 /end COMPU_METHOD
/begin MEASUREMENT TRANS_gear_auto "Transmission shift mode{TRANS_gear_auto&0xff=0:Manual}{TRANS_gear_auto&0xff=1:Automatic}" UBYTE TRANS_gear_auto_COMPU_VTAB 0 0 0 255 ECU_ADDRESS 0x01008D80 BIT_MASK 0xff /end MEASUREMENT
/begin COMPU_METHOD TRANS_gear_auto_COMPU_VTAB "Verbal Table" TAB_VERB "%.0" "list" COMPU_TAB_REF TRANS_gear_auto_COMPU_VTAB_REF /end COMPU_METHOD
/begin COMPU_VTAB TRANS_gear_auto_COMPU_VTAB_REF "Verbal Table" TAB_VERB 2 0 "Manual" 1 "Automatic" DEFAULT_VALUE "UNKNOWN" /end COMPU_VTAB
/begin MEASUREMENT MSC_FPPTPSnl_mode "MSC FPP non-linear mode{MSC_FPPTPSnl_mode&0xff=0:Option 1}{MSC_FPPTPSnl_mode&0xff=1:Option 2}{MSC_FPPTPSnl_mode&0xff=2:Option 3}{MSC_FPPTPSnl_mode&0xff=3:N/A - Use Default}" UBYTE MSC_FPPTPSnl_mode_COMPU_VTAB 0 0 0 255 ECU_ADDRESS 0x01009248 BIT_MASK 0xff /end MEASUREMENT
/begin COMPU_METHOD MSC_FPPTPSnl_mode_COMPU_VTAB "Verbal Table" TAB_VERB "%.0" "list" COMPU_TAB_REF MSC_FPPTPSnl_mode_COMPU_VTAB_REF /end COMPU_METHOD
/begin COMPU_VTAB MSC_FPPTPSnl_mode_COMPU_VTAB_REF "Verbal Table" TAB_VERB 4 0 "Option 1" 1 "Option 2" 2 "Option 3" 3 "N/A - Use Default" DEFAULT_VALUE "UNKNOWN" /end COMPU_VTAB
/begin MEASUREMENT MSC_FPPTPSnl_latch "MSC FPP non-linear mode idle latch{MSC_FPPTPSnl_latch&0xff=0:Option 1}{MSC_FPPTPSnl_latch&0xff=1:Option 2}{MSC_FPPTPSnl_latch&0xff=2:Option 3}{MSC_FPPTPSnl_latch&0xff=3:N/A - Use Default}" UBYTE MSC_FPPTPSnl_latch_COMPU_VTAB 0 0 0 255 ECU_ADDRESS 0x01009250 BIT_MASK 0xff /end MEASUREMENT
/begin COMPU_METHOD MSC_FPPTPSnl_latch_COMPU_VTAB "Verbal Table" TAB_VERB "%.0" "list" COMPU_TAB_REF MSC_FPPTPSnl_latch_COMPU_VTAB_REF /end COMPU_METHOD
/begin COMPU_VTAB MSC_FPPTPSnl_latch_COMPU_VTAB_REF "Verbal Table" TAB_VERB 4 0 "Option 1" 1 "Option 2" 2 "Option 3" 3 "N/A - Use Default" DEFAULT_VALUE "UNKNOWN" /end COMPU_VTAB
/begin MEASUREMENT torque_pct_eng_dmd "Engine demand torque" UWORD Compu_torque_pct_eng_dmd 0 0 0 99.9984741210938 ECU_ADDRESS 0x0100C228 /end MEASUREMENT
/begin COMPU_METHOD Compu_torque_pct_eng_dmd " " RAT_FUNC "%.1" "% of ref" COEFFS 0 655.36 0 0 0 1 /end COMPU_METHOD
/begin CHARACTERISTIC fric_cold_ena "Cold Friction{fric_cold_ena&0xff=0:Disabled}{fric_cold_ena&0xff=1:ECT}{fric_cold_ena&0xff=2:OILT}" VALUE 0x001c902e /* @ECU_Address@fric_cold_ena@0x0100C248@ */ ECIPP_ALIGNMENT_UBYTE 255 fric_cold_ena_COMPU_VTAB 0 255 BIT_MASK 0xff /end CHARACTERISTIC
/begin COMPU_METHOD fric_cold_ena_COMPU_VTAB "Verbal Table" TAB_VERB "%.0" "list" COMPU_TAB_REF fric_cold_ena_COMPU_VTAB_REF /end COMPU_METHOD
/begin COMPU_VTAB fric_cold_ena_COMPU_VTAB_REF "Verbal Table" TAB_VERB 3 0 "Disabled" 1 "ECT" 2 "OILT" DEFAULT_VALUE "UNKNOWN" /end COMPU_VTAB
/begin CHARACTERISTIC fric_cold_T "Cold Friction trigger" VALUE 0x001c843e /* @ECU_Address@fric_cold_T@0x0100C250@ */ ECIPP_ALIGNMENT_UWORD 564 Compu_fric_cold_T -460 563.984375 /end CHARACTERISTIC
/begin COMPU_METHOD Compu_fric_cold_T " " RAT_FUNC "%.1" "deg F" COEFFS 0 64 29440 0 0 1 /end COMPU_METHOD
/begin CHARACTERISTIC fric_hot_T "Hot Friction trigger" VALUE 0x001c8440 /* @ECU_Address@fric_hot_T@0x0100C258@ */ ECIPP_ALIGNMENT_UWORD 564 Compu_fric_hot_T -460 563.984375 /end CHARACTERISTIC
/begin COMPU_METHOD Compu_fric_hot_T " " RAT_FUNC "%.1" "deg F" COEFFS 0 64 29440 0 0 1 /end COMPU_METHOD
/begin MEASUREMENT torque_tbl_fric "Friction losses torque" UWORD Compu_torque_tbl_fric 0 0 0 16383.75 ECU_ADDRESS 0x0100C260 /end MEASUREMENT
/begin COMPU_METHOD Compu_torque_tbl_fric " " RAT_FUNC "%.1" "N-m" COEFFS 0 4 0 0 0 1 /end COMPU_METHOD
/begin MEASUREMENT CoolingH2OExpected "Cooling water expected flow" UWORD Compu_CoolingH2OExpected 0 0 0 255.99609375 ECU_ADDRESS 0x0100C758 /end MEASUREMENT
/begin COMPU_METHOD Compu_CoolingH2OExpected " " RAT_FUNC "%.1" "gpm" COEFFS 0 256 0 0 0 1 /end COMPU_METHOD
/begin MEASUREMENT CoolingH2OFlowRate "Cooling water flow" UWORD Compu_CoolingH2OFlowRate 0 0 0 255.99609375 ECU_ADDRESS 0x0100C760 /end MEASUREMENT
/begin COMPU_METHOD Compu_CoolingH2OFlowRate " " RAT_FUNC "%.1" "gpm" COEFFS 0 256 0 0 0 1 /end COMPU_METHOD
/begin CHARACTERISTIC J1939_torque_pct_tbl "J1939 actual engine torque{J1939_torque_pct_tbl&0xff=0:Governor Tables}{J1939_torque_pct_tbl&0xff=1:J1939 Torque Tables, Net %}{J1939_torque_pct_tbl&0xff=2:J1939 Torque Tables, Net %, BP Crct}{J1939_torque_pct_tbl&0xff=3:J1939 Torque Tables, Indicated %}{" VALUE 0x001c87b8 /* @ECU_Address@J1939_torque_pct_tbl@0x0100D8A0@ */ ECIPP_ALIGNMENT_UBYTE 255 J1939_torque_pct_tbl_COMPU_VTAB 0 255 BIT_MASK 0xff /end CHARACTERISTIC
/begin COMPU_METHOD J1939_torque_pct_tbl_COMPU_VTAB "Verbal Table" TAB_VERB "%.0" "list" COMPU_TAB_REF J1939_torque_pct_tbl_COMPU_VTAB_REF /end COMPU_METHOD
/begin COMPU_VTAB J1939_torque_pct_tbl_COMPU_VTAB_REF "Verbal Table" TAB_VERB 5 0 "Governor Tables" 1 "J1939 Torque Tables, Net %" 2 "J1939 Torque Tables, Net %, BP Crct" 3 "J1939 Torque Tables, Indicated %" 4 "J1939 Torque Tables, Ind. %, BP Crct" DEFAULT_VALUE "UNKNOWN" /end COMPU_VTAB
/begin MEASUREMENT torque_parasitic "Parasitic losses torque" UWORD Compu_torque_parasitic 0 0 0 16383.75 ECU_ADDRESS 0x0100DAF0 /end MEASUREMENT
/begin COMPU_METHOD Compu_torque_parasitic " " RAT_FUNC "%.1" "N-m" COEFFS 0 4 0 0 0 1 /end COMPU_METHOD
/begin CHARACTERISTIC FPPgear_handle "Marine throttle & gear handle FPP mode{FPPgear_handle&0xff=0:Disabled}{FPPgear_handle&0xff=1:Enabled}" VALUE 0x001c872b /* @ECU_Address@FPPgear_handle@0x0100F228@ */ ECIPP_ALIGNMENT_UBYTE 255 FPPgear_handle_COMPU_VTAB 0 255 BIT_MASK 0xff /end CHARACTERISTIC
/begin COMPU_METHOD FPPgear_handle_COMPU_VTAB "Verbal Table" TAB_VERB "%.0" "list" COMPU_TAB_REF FPPgear_handle_COMPU_VTAB_REF /end COMPU_METHOD
/begin COMPU_VTAB FPPgear_handle_COMPU_VTAB_REF "Verbal Table" TAB_VERB 2 0 "Disabled" 1 "Enabled" DEFAULT_VALUE "UNKNOWN" /end COMPU_VTAB
/begin MEASUREMENT FPPgear_indicate "Handle position indicated gear{FPPgear_indicate&0xff=0:Neutral}{FPPgear_indicate&0x80=0x80:Reverse}{FPPgear_indicate&0x80=0x00:Forward}" UBYTE FPPgear_indicate_COMPU_VTAB 0 0 0 255 ECU_ADDRESS 0x0100F230 BIT_MASK 0xff /end MEASUREMENT
/begin COMPU_METHOD FPPgear_indicate_COMPU_VTAB "Verbal Table" TAB_VERB "%.0" "list" COMPU_TAB_REF FPPgear_indicate_COMPU_VTAB_REF /end COMPU_METHOD
/begin COMPU_VTAB FPPgear_indicate_COMPU_VTAB_REF "Verbal Table" TAB_VERB 1 0 "Neutral" DEFAULT_VALUE "Unsupported Bit_Mask" /end COMPU_VTAB
/begin MEASUREMENT FPPgear_command "Handle final requested gear{FPPgear_command&0xff=0:Neutral}{FPPgear_command&0x80=0x80:Reverse}{FPPgear_command&0x80=0x00:Forward}" UBYTE FPPgear_command_COMPU_VTAB 0 0 0 255 ECU_ADDRESS 0x0100F238 BIT_MASK 0xff /end MEASUREMENT
/begin COMPU_METHOD FPPgear_command_COMPU_VTAB "Verbal Table" TAB_VERB "%.0" "list" COMPU_TAB_REF FPPgear_command_COMPU_VTAB_REF /end COMPU_METHOD
/begin COMPU_VTAB FPPgear_command_COMPU_VTAB_REF "Verbal Table" TAB_VERB 1 0 "Neutral" DEFAULT_VALUE "Unsupported Bit_Mask" /end COMPU_VTAB
/begin CHARACTERISTIC FPPgear_gear_dz "Neutral to shift deadzone" VALUE 0x001c6fb4 /* @ECU_Address@FPPgear_gear_dz@0x0100F250@ */ ECIPP_ALIGNMENT_UWORD 100 Compu_FPPgear_gear_dz 0 99.9984741210938 /end CHARACTERISTIC
/begin COMPU_METHOD Compu_FPPgear_gear_dz " " RAT_FUNC "%.1" "%" COEFFS 0 655.36 0 0 0 1 /end COMPU_METHOD
/begin MEASUREMENT MHGL_active "Gear lockout detection{MHGL_active&0xff=0:Inactive}{MHGL_active&0xff=1:Active}" UBYTE MHGL_active_COMPU_VTAB 0 0 0 255 ECU_ADDRESS 0x0100F258 BIT_MASK 0xff /end MEASUREMENT
/begin COMPU_METHOD MHGL_active_COMPU_VTAB "Verbal Table" TAB_VERB "%.0" "list" COMPU_TAB_REF MHGL_active_COMPU_VTAB_REF /end COMPU_METHOD
/begin COMPU_VTAB MHGL_active_COMPU_VTAB_REF "Verbal Table" TAB_VERB 2 0 "Inactive" 1 "Active" DEFAULT_VALUE "UNKNOWN" /end COMPU_VTAB
/begin MEASUREMENT MHGL_latched "Gear lockout latched{MHGL_latched&0xff=0:Unlatched}{MHGL_latched&0xff=1:Latched}" UBYTE MHGL_latched_COMPU_VTAB 0 0 0 255 ECU_ADDRESS 0x0100F260 BIT_MASK 0xff /end MEASUREMENT
/begin COMPU_METHOD MHGL_latched_COMPU_VTAB "Verbal Table" TAB_VERB "%.0" "list" COMPU_TAB_REF MHGL_latched_COMPU_VTAB_REF /end COMPU_METHOD
/begin COMPU_VTAB MHGL_latched_COMPU_VTAB_REF "Verbal Table" TAB_VERB 2 0 "Unlatched" 1 "Latched" DEFAULT_VALUE "UNKNOWN" /end COMPU_VTAB
/begin CHARACTERISTIC MHGL_chan "Gear lockout input{MHGL_chan&0xff=0:Disabled}{MHGL_chan&0xff=1:Aux PU1 = Gnd}{MHGL_chan&0xff=2:Aux PU2 = Gnd}{MHGL_chan&0xff=3:Aux PU3 = Gnd}{MHGL_chan&0xff=4:Aux PUD1 = Gnd}{MHGL_chan&0xff=5:Aux PUD2 = Gnd}{MHGL_chan&0xff=6:Aux PUD3 = Gnd}{MHGL_chan&0xff" VALUE 0x001c882d /* @ECU_Address@MHGL_chan@0x0100F268@ */ ECIPP_ALIGNMENT_UBYTE 255 MHGL_chan_COMPU_VTAB 0 255 BIT_MASK 0xff /end CHARACTERISTIC
/begin COMPU_METHOD MHGL_chan_COMPU_VTAB "Verbal Table" TAB_VERB "%.0" "list" COMPU_TAB_REF MHGL_chan_COMPU_VTAB_REF /end COMPU_METHOD
/begin COMPU_VTAB MHGL_chan_COMPU_VTAB_REF "Verbal Table" TAB_VERB 30 0 "Disabled" 1 "Aux PU1 = Gnd" 2 "Aux PU2 = Gnd" 3 "Aux PU3 = Gnd" 4 "Aux PUD1 = Gnd" 5 "Aux PUD2 = Gnd" 6 "Aux PUD3 = Gnd" 7 "Aux PUD4 = +V" 8 "Aux PUD5 = Gnd" 9 "Aux DIG1" 10 "Aux DIG2" 11 "Aux DIG3" 12 "Aux DIG4" 13 "Aux DIG5" 14 "Aux DIG6" 15 "Aux DIG7" 16 "Aux DIG8" 17 "Aux DIG9" 18 "Aux DIG10" 19 "Aux DIG11" 20 "Aux DIG12" 21 "Aux DIG13" 22 "Aux DIG14" 23 "Aux DIG15" 24 "Aux DIG16" 25 "Aux DIG17" 26 "Aux DIG18" 27 "Aux DIG19" 28 "Gov1" 29 "Gov2" DEFAULT_VALUE "UNKNOWN" /end COMPU_VTAB
/begin CHARACTERISTIC MHGL_chan_cfg "Gear lockout button configuration{MHGL_chan_cfg&0xff=0:Default}{MHGL_chan_cfg&0xff=1:GND}{MHGL_chan_cfg&0xff=2:GND/+V}{MHGL_chan_cfg&0xff=3:+V}{MHGL_chan_cfg&0xff=4:Open}" VALUE 0x001c882e /* @ECU_Address@MHGL_chan_cfg@0x0100F270@ */ ECIPP_ALIGNMENT_UBYTE 255 MHGL_chan_cfg_COMPU_VTAB 0 255 BIT_MASK 0xff /end CHARACTERISTIC
/begin COMPU_METHOD MHGL_chan_cfg_COMPU_VTAB "Verbal Table" TAB_VERB "%.0" "list" COMPU_TAB_REF MHGL_chan_cfg_COMPU_VTAB_REF /end COMPU_METHOD
/begin COMPU_VTAB MHGL_chan_cfg_COMPU_VTAB_REF "Verbal Table" TAB_VERB 5 0 "Default" 1 "GND" 2 "GND/+V" 3 "+V" 4 "Open" DEFAULT_VALUE "UNKNOWN" /end COMPU_VTAB
/begin CHARACTERISTIC MHGL_lamp "Gear lockout latched lamp output{MHGL_lamp&0xff=0:Disabled}{MHGL_lamp&0xff=1:Buzzer Output}{MHGL_lamp&0xff=2:MIL Output}{MHGL_lamp&0xff=3:TACH Output}{MHGL_lamp&0xff=4:Starter Output}{MHGL_lamp&0xff=5:EGOH1}{MHGL_lamp&0xff=6:EGOH2}{MHGL_lamp&0xff=7:EGOH3}" VALUE 0x001c882f /* @ECU_Address@MHGL_lamp@0x0100F278@ */ ECIPP_ALIGNMENT_UBYTE 255 MHGL_lamp_COMPU_VTAB 0 255 BIT_MASK 0xff /end CHARACTERISTIC
/begin COMPU_METHOD MHGL_lamp_COMPU_VTAB "Verbal Table" TAB_VERB "%.0" "list" COMPU_TAB_REF MHGL_lamp_COMPU_VTAB_REF /end COMPU_METHOD
/begin COMPU_VTAB MHGL_lamp_COMPU_VTAB_REF "Verbal Table" TAB_VERB 32 0 "Disabled" 1 "Buzzer Output" 2 "MIL Output" 3 "TACH Output" 4 "Starter Output" 5 "EGOH1" 6 "EGOH2" 7 "EGOH3" 8 "EGOH4" 9 "Aux PWM1" 10 "Aux PWM2" 11 "Aux PWM3" 12 "Aux PWM4" 13 "Aux PWM5" 14 "Aux PWM6" 15 "Aux PWM7" 16 "Aux PWM8" 17 "Aux PWM9" 18 "Aux PWM10" 19 "Aux PWM11" 20 "Aux PWM12" 21 "Aux PWM13" 22 "Aux PWM14" 23 "Aux PWM15" 24 "Aux PWM16" 25 "Aux PWM17" 26 "Aux PWM18" 27 "Aux PWM19" 28 "Aux PWM20" 29 "Aux PWM21" 30 "Aux PWM22" 31 "Aux PWM23" DEFAULT_VALUE "UNKNOWN" /end COMPU_VTAB
/begin CHARACTERISTIC MHGL_unlatch_tout "Gear lockout unlatch time" VALUE 0x001c7d9c /* @ECU_Address@MHGL_unlatch_tout@0x0100F280@ */ ECIPP_ALIGNMENT_UWORD 65535 Compu_MHGL_unlatch_tout 0 65535 /end CHARACTERISTIC
/begin COMPU_METHOD Compu_MHGL_unlatch_tout " " RAT_FUNC "%.0" "ms" COEFFS 0 1 0 0 0 1 /end COMPU_METHOD
/begin CHARACTERISTIC FPPgear_throt_Fdz "Neutral to Forward throttle-up deadzone" VALUE 0x001c6fb8 /* @ECU_Address@FPPgear_throt_Fdz@0x0100F288@ */ ECIPP_ALIGNMENT_UWORD 100 Compu_FPPgear_throt_Fdz 0 99.9984741210938 /end CHARACTERISTIC
/begin COMPU_METHOD Compu_FPPgear_throt_Fdz " " RAT_FUNC "%.1" "%" COEFFS 0 655.36 0 0 0 1 /end COMPU_METHOD
/begin CHARACTERISTIC FPPgear_throt_Rdz "Neutral to Reverse throttle-up deadzone" VALUE 0x001c6fba /* @ECU_Address@FPPgear_throt_Rdz@0x0100F290@ */ ECIPP_ALIGNMENT_UWORD 100 Compu_FPPgear_throt_Rdz 0 99.9984741210938 /end CHARACTERISTIC
/begin COMPU_METHOD Compu_FPPgear_throt_Rdz " " RAT_FUNC "%.1" "%" COEFFS 0 655.36 0 0 0 1 /end COMPU_METHOD
/begin CHARACTERISTIC VP_shift_rpmmax_neut "Shift max engine speed to neut" VALUE 0x001c833a /* @ECU_Address@VP_shift_rpmmax_neut@0x0100F570@ */ ECIPP_ALIGNMENT_UWORD 65535 Compu_VP_shift_rpmmax_neut 0 65535 /end CHARACTERISTIC
/begin COMPU_METHOD Compu_VP_shift_rpmmax_neut " " RAT_FUNC "%.0" "rpm" COEFFS 0 1 0 0 0 1 /end COMPU_METHOD
/begin MEASUREMENT FPPgear_ntrlk_t "Neutral interlock up-timer" UWORD Compu_FPPgear_ntrlk_t 0 0 0 65535 ECU_ADDRESS 0x0100F970 /end MEASUREMENT
/begin COMPU_METHOD Compu_FPPgear_ntrlk_t " " RAT_FUNC "%.0" "ms" COEFFS 0 1 0 0 0 1 /end COMPU_METHOD
/begin CHARACTERISTIC FPPgear_ntrlk_tout "Neutral interlock timeout" VALUE 0x001c6fb6 /* @ECU_Address@FPPgear_ntrlk_tout@0x0100F978@ */ ECIPP_ALIGNMENT_UWORD 65535 Compu_FPPgear_ntrlk_tout 0 65535 /end CHARACTERISTIC
/begin COMPU_METHOD Compu_FPPgear_ntrlk_tout " " RAT_FUNC "%.0" "ms" COEFFS 0 1 0 0 0 1 /end COMPU_METHOD
/begin CHARACTERISTIC J1939_static_pwr "J1939 EEC4 static rated power" VALUE 0x001c7cae /* @ECU_Address@J1939_static_pwr@0x010104B8@ */ ECIPP_ALIGNMENT_UWORD 4096 Compu_J1939_static_pwr 0 4095.9375 /end CHARACTERISTIC
/begin COMPU_METHOD Compu_J1939_static_pwr " " RAT_FUNC "%.1" "kW" COEFFS 0 16 0 0 0 1 /end COMPU_METHOD
/begin MEASUREMENT ME0mstr_MAP "Master MAP" UWORD Compu_ME0mstr_MAP 0 0 0 255.99609375 ECU_ADDRESS 0x01011958 /end MEASUREMENT
/begin COMPU_METHOD Compu_ME0mstr_MAP " " RAT_FUNC "%.1" "psia" COEFFS 0 256 0 0 0 1 /end COMPU_METHOD
/begin MEASUREMENT ME0slv1_MAP "Slave1 MAP" UWORD Compu_ME0slv1_MAP 0 0 0 255.99609375 ECU_ADDRESS 0x01011960 /end MEASUREMENT
/begin COMPU_METHOD Compu_ME0slv1_MAP " " RAT_FUNC "%.1" "psia" COEFFS 0 256 0 0 0 1 /end COMPU_METHOD
/begin MEASUREMENT ME0slv2_MAP "Slave2 MAP" UWORD Compu_ME0slv2_MAP 0 0 0 255.99609375 ECU_ADDRESS 0x01011968 /end MEASUREMENT
/begin COMPU_METHOD Compu_ME0slv2_MAP " " RAT_FUNC "%.1" "psia" COEFFS 0 256 0 0 0 1 /end COMPU_METHOD
/begin MEASUREMENT ME0slv3_MAP "Slave3 MAP" UWORD Compu_ME0slv3_MAP 0 0 0 255.99609375 ECU_ADDRESS 0x01011970 /end MEASUREMENT
/begin COMPU_METHOD Compu_ME0slv3_MAP " " RAT_FUNC "%.1" "psia" COEFFS 0 256 0 0 0 1 /end COMPU_METHOD
/begin CHARACTERISTIC MAP_fullload_BPlim "Full-load BP scaling limiting{MAP_fullload_BPlim&0xff=0:Disabled}{MAP_fullload_BPlim&0xff=1:Enabled}" VALUE 0x001c8817 /* @ECU_Address@MAP_fullload_BPlim@0x010128E8@ */ ECIPP_ALIGNMENT_UBYTE 255 MAP_fullload_BPlim_COMPU_VTAB 0 255 BIT_MASK 0xff /end CHARACTERISTIC
/begin COMPU_METHOD MAP_fullload_BPlim_COMPU_VTAB "Verbal Table" TAB_VERB "%.0" "list" COMPU_TAB_REF MAP_fullload_BPlim_COMPU_VTAB_REF /end COMPU_METHOD
/begin COMPU_VTAB MAP_fullload_BPlim_COMPU_VTAB_REF "Verbal Table" TAB_VERB 2 0 "Disabled" 1 "Enabled" DEFAULT_VALUE "UNKNOWN" /end COMPU_VTAB
/begin CHARACTERISTIC J1939_rc_torque_ref "J1939 retarder config reference torque" VALUE 0x001c7cac /* @ECU_Address@J1939_rc_torque_ref@0x01013038@ */ ECIPP_ALIGNMENT_UWORD 16384 Compu_J1939_rc_torque_ref 0 16383.75 /end CHARACTERISTIC
/begin COMPU_METHOD Compu_J1939_rc_torque_ref " " RAT_FUNC "%.1" "N-m" COEFFS 0 4 0 0 0 1 /end COMPU_METHOD
/begin CHARACTERISTIC J1939_exr_torque_tbl "J1939 exhaust retarder torque{J1939_exr_torque_tbl&0xff=0:Percentage}{J1939_exr_torque_tbl&0xff=1:Separate Table}" VALUE 0x001c87b4 /* @ECU_Address@J1939_exr_torque_tbl@0x01013040@ */ ECIPP_ALIGNMENT_UBYTE 255 J1939_exr_torque_tbl_COMPU_VTAB 0 255 BIT_MASK 0xff /end CHARACTERISTIC
/begin COMPU_METHOD J1939_exr_torque_tbl_COMPU_VTAB "Verbal Table" TAB_VERB "%.0" "list" COMPU_TAB_REF J1939_exr_torque_tbl_COMPU_VTAB_REF /end COMPU_METHOD
/begin COMPU_VTAB J1939_exr_torque_tbl_COMPU_VTAB_REF "Verbal Table" TAB_VERB 2 0 "Percentage" 1 "Separate Table" DEFAULT_VALUE "UNKNOWN" /end COMPU_VTAB
/begin CHARACTERISTIC J1939RC_ER_pt3_rpmd "J1939 engine retarder speed at point 3" VALUE 0x001c7c7a /* @ECU_Address@J1939RC_ER_pt3_rpmd@0x01013048@ */ ECIPP_ALIGNMENT_UWORD 65535 Compu_J1939RC_ER_pt3_rpmd 0 65535 /end CHARACTERISTIC
/begin COMPU_METHOD Compu_J1939RC_ER_pt3_rpmd " " RAT_FUNC "%.0" "rpm" COEFFS 0 1 0 0 0 1 /end COMPU_METHOD
/begin CHARACTERISTIC J1939RC_ER_pt4_rpmd "J1939 engine retarder speed at point 4" VALUE 0x001c7c7c /* @ECU_Address@J1939RC_ER_pt4_rpmd@0x01013050@ */ ECIPP_ALIGNMENT_UWORD 65535 Compu_J1939RC_ER_pt4_rpmd 0 65535 /end CHARACTERISTIC
/begin COMPU_METHOD Compu_J1939RC_ER_pt4_rpmd " " RAT_FUNC "%.0" "rpm" COEFFS 0 1 0 0 0 1 /end COMPU_METHOD
/begin CHARACTERISTIC J1939RC_EXR_pt3_rpmd "J1939 exhaust retarder speed at point 3" VALUE 0x001c7c7e /* @ECU_Address@J1939RC_EXR_pt3_rpmd@0x01013058@ */ ECIPP_ALIGNMENT_UWORD 65535 Compu_J1939RC_EXR_pt3_rpmd 0 65535 /end CHARACTERISTIC
/begin COMPU_METHOD Compu_J1939RC_EXR_pt3_rpmd " " RAT_FUNC "%.0" "rpm" COEFFS 0 1 0 0 0 1 /end COMPU_METHOD
/begin CHARACTERISTIC J1939RC_EXR_pt4_rpmd "J1939 exhaust retarder speed at point 4" VALUE 0x001c7c80 /* @ECU_Address@J1939RC_EXR_pt4_rpmd@0x01013060@ */ ECIPP_ALIGNMENT_UWORD 65535 Compu_J1939RC_EXR_pt4_rpmd 0 65535 /end CHARACTERISTIC
/begin COMPU_METHOD Compu_J1939RC_EXR_pt4_rpmd " " RAT_FUNC "%.0" "rpm" COEFFS 0 1 0 0 0 1 /end COMPU_METHOD
/begin MEASUREMENT drvtrim_angle "Drive trim angle" SWORD Compu_drvtrim_angle 0 0 -2048 2047.9375 ECU_ADDRESS 0x010138F8 /end MEASUREMENT
/begin COMPU_METHOD Compu_drvtrim_angle " " RAT_FUNC "%.1" "degrees" COEFFS 0 16 0 0 0 1 /end COMPU_METHOD
/begin CHARACTERISTIC torq_avail_mode "J1939 max available torque broadcast{torq_avail_mode&0xff=0:Engine Load}{torq_avail_mode&0xff=1:Torque Percent - Maximum}{torq_avail_mode&0xff=2:Torque Percent - Maximum, No TSC1}{torq_avail_mode&0xff=3:Torque Percent - Immediate}{torq_avail_mode&0xff=4:T" VALUE 0x001c9087 /* @ECU_Address@torq_avail_mode@0x010148D0@ */ ECIPP_ALIGNMENT_UBYTE 255 torq_avail_mode_COMPU_VTAB 0 255 BIT_MASK 0xff /end CHARACTERISTIC
/begin COMPU_METHOD torq_avail_mode_COMPU_VTAB "Verbal Table" TAB_VERB "%.0" "list" COMPU_TAB_REF torq_avail_mode_COMPU_VTAB_REF /end COMPU_METHOD
/begin COMPU_VTAB torq_avail_mode_COMPU_VTAB_REF "Verbal Table" TAB_VERB 5 0 "Engine Load" 1 "Torque Percent - Maximum" 2 "Torque Percent - Maximum, No TSC1" 3 "Torque Percent - Immediate" 4 "Torque Percent - Immediate, No TSC1" DEFAULT_VALUE "UNKNOWN" /end COMPU_VTAB
/begin CHARACTERISTIC torq_driver_dmd_mode "J1939 driver demand torque broadcast{torq_driver_dmd_mode&0xff=0:Torque Percent - Legacy}{torq_driver_dmd_mode&0xff=1:Torque Percent - Corrected, Limited}{torq_driver_dmd_mode&0xff=2:Torque Percent - Corrected, Unlimited}" VALUE 0x001c9088 /* @ECU_Address@torq_driver_dmd_mode@0x01014A38@ */ ECIPP_ALIGNMENT_UBYTE 255 torq_driver_dmd_mode_COMPU_VTAB 0 255 BIT_MASK 0xff /end CHARACTERISTIC
/begin COMPU_METHOD torq_driver_dmd_mode_COMPU_VTAB "Verbal Table" TAB_VERB "%.0" "list" COMPU_TAB_REF torq_driver_dmd_mode_COMPU_VTAB_REF /end COMPU_METHOD
/begin COMPU_VTAB torq_driver_dmd_mode_COMPU_VTAB_REF "Verbal Table" TAB_VERB 3 0 "Torque Percent - Legacy" 1 "Torque Percent - Corrected, Limited" 2 "Torque Percent - Corrected, Unlimited" DEFAULT_VALUE "UNKNOWN" /end COMPU_VTAB
/begin CHARACTERISTIC torq_parasitic_mode "J1939 parasitic torque broadcast{torq_parasitic_mode&0xff=0:SPN 514 and 2978 (Legacy)}{torq_parasitic_mode&0xff=1:SPN 2978 Only}" VALUE 0x001c908a /* @ECU_Address@torq_parasitic_mode@0x01014A40@ */ ECIPP_ALIGNMENT_UBYTE 255 torq_parasitic_mode_COMPU_VTAB 0 255 BIT_MASK 0xff /end CHARACTERISTIC
/begin COMPU_METHOD torq_parasitic_mode_COMPU_VTAB "Verbal Table" TAB_VERB "%.0" "list" COMPU_TAB_REF torq_parasitic_mode_COMPU_VTAB_REF /end COMPU_METHOD
/begin COMPU_VTAB torq_parasitic_mode_COMPU_VTAB_REF "Verbal Table" TAB_VERB 2 0 "SPN 514 and 2978 (Legacy)" 1 "SPN 2978 Only" DEFAULT_VALUE "UNKNOWN" /end COMPU_VTAB
/begin CHARACTERISTIC torq_load_convert "J1939 torque / engine load conversion{torq_load_convert&0xff=0:Disabled (Legacy)}{torq_load_convert&0xff=1:Enabled}" VALUE 0x001c9089 /* @ECU_Address@torq_load_convert@0x01014BF8@ */ ECIPP_ALIGNMENT_UBYTE 255 torq_load_convert_COMPU_VTAB 0 255 BIT_MASK 0xff /end CHARACTERISTIC
/begin COMPU_METHOD torq_load_convert_COMPU_VTAB "Verbal Table" TAB_VERB "%.0" "list" COMPU_TAB_REF torq_load_convert_COMPU_VTAB_REF /end COMPU_METHOD
/begin COMPU_VTAB torq_load_convert_COMPU_VTAB_REF "Verbal Table" TAB_VERB 2 0 "Disabled (Legacy)" 1 "Enabled" DEFAULT_VALUE "UNKNOWN" /end COMPU_VTAB
/begin MEASUREMENT torque_pct_max_avail "Max available torque" UWORD Compu_torque_pct_max_avail 0 0 0 99.9984741210938 ECU_ADDRESS 0x01014C00 /end MEASUREMENT
/begin COMPU_METHOD Compu_torque_pct_max_avail " " RAT_FUNC "%.1" "% of ref" COEFFS 0 655.36 0 0 0 1 /end COMPU_METHOD
/begin COMPU_METHOD Compu_Ttrqcal_RPM " " RAT_FUNC "%.0" "Speed (rpm)" COEFFS 0 1 0 0 0 1 /end COMPU_METHOD
/begin CHARACTERISTIC Ttrqcal_MAP_0 "Gasoline MAP Torque (psia)" CURVE 0x001CA574 /* @ECU_Address@Ttrqcal_MAP_0@0x0211A000@ */ ECIPP_ALIGNMENT_SWORD 128 Compu_Ttrqcal_MAP_0 -128 127.99609375
 /begin AXIS_DESCR COM_AXIS NO_INPUT_QUANTITY Compu_Ttrqcal_RPM 16 -32768 32767 AXIS_PTS_REF Ttrqcal_RPM /end AXIS_DESCR
/end CHARACTERISTIC
/begin AXIS_PTS Ttrqcal_RPM " " 0x001C6B20 /* @ECU_Address@Ttrqcal_RPM@0x02119000@ */ NO_INPUT_QUANTITY ECIPP_Lookup_SWORD 0 Compu_Ttrqcal_RPM 16 -32768 32767 /end AXIS_PTS
/begin COMPU_METHOD Compu_Ttrqcal_MAP_0 " " RAT_FUNC "%.2" "No Torque" COEFFS 0 256 0 0 0 1 /end COMPU_METHOD
/begin CHARACTERISTIC Ttrqcal_MAP_100 "Gasoline MAP Torque (psia)" CURVE 0x001CA5F4 /* @ECU_Address@Ttrqcal_MAP_100@0x0211B000@ */ ECIPP_ALIGNMENT_SWORD 128 Compu_Ttrqcal_MAP_100 -128 127.99609375
 /begin AXIS_DESCR COM_AXIS NO_INPUT_QUANTITY Compu_Ttrqcal_RPM 16 -32768 32767 AXIS_PTS_REF Ttrqcal_RPM /end AXIS_DESCR
/end CHARACTERISTIC
/begin COMPU_METHOD Compu_Ttrqcal_MAP_100 " " RAT_FUNC "%.2" "Full Torque" COEFFS 0 256 0 0 0 1 /end COMPU_METHOD
/begin CHARACTERISTIC Ttrqcal_trq_100 "Gasoline MAP Torque (psia)" CURVE 0x001CA6B4 /* @ECU_Address@Ttrqcal_trq_100@0x0211C000@ */ ECIPP_ALIGNMENT_SWORD 8192 Compu_Ttrqcal_trq_100 -8192 8191.75
 /begin AXIS_DESCR COM_AXIS NO_INPUT_QUANTITY Compu_Ttrqcal_RPM 16 -32768 32767 AXIS_PTS_REF Ttrqcal_RPM /end AXIS_DESCR
/end CHARACTERISTIC
/begin COMPU_METHOD Compu_Ttrqcal_trq_100 " " RAT_FUNC "%.1" "Standard Max Brake Torque" COEFFS 0 4 0 0 0 1 /end COMPU_METHOD
/begin COMPU_METHOD Compu_TEMWT_sss_rpm " " RAT_FUNC "%.0" "Speed (rpm)" COEFFS 0 1 0 0 0 1 /end COMPU_METHOD
/begin COMPU_METHOD Compu_TEMWT_sss_MAP " " RAT_FUNC "%.1" "MAP (psia)" COEFFS 0 256 0 0 0 1 /end COMPU_METHOD
/begin CHARACTERISTIC TEMWT_sss_EMWT "Steady-State EMWT Rise Above Inlet" MAP 0x001C4B58 /* @ECU_Address@TEMWT_sss_EMWT@0x0212B000@ */ ECIPP_ALIGNMENT_SWORD 4096 Compu_TEMWT_sss_EMWT -4096 4095.875
 /begin AXIS_DESCR COM_AXIS NO_INPUT_QUANTITY Compu_TEMWT_sss_MAP 6 -128 127.99609375 AXIS_PTS_REF TEMWT_sss_MAP /end AXIS_DESCR
 /begin AXIS_DESCR COM_AXIS NO_INPUT_QUANTITY Compu_TEMWT_sss_rpm 6 -32768 32767 AXIS_PTS_REF TEMWT_sss_rpm /end AXIS_DESCR
/end CHARACTERISTIC
/begin AXIS_PTS TEMWT_sss_MAP " " 0x001C4BA0 /* @ECU_Address@TEMWT_sss_MAP@0x0212A000@ */ NO_INPUT_QUANTITY ECIPP_Lookup_SWORD 0 Compu_TEMWT_sss_MAP 6 -128 127.99609375 /end AXIS_PTS
/begin AXIS_PTS TEMWT_sss_rpm " " 0x001C4BAC /* @ECU_Address@TEMWT_sss_rpm@0x02129000@ */ NO_INPUT_QUANTITY ECIPP_Lookup_SWORD 0 Compu_TEMWT_sss_rpm 6 -32768 32767 /end AXIS_PTS
/begin COMPU_METHOD Compu_TEMWT_sss_EMWT "" RAT_FUNC "%.1" "SS EMWT Rise (delta deg F)" COEFFS 0 8 0 0 0 1 /end COMPU_METHOD
/begin CHARACTERISTIC TERWT_sss_ERWT "Steady-State ERWT Rise Above Inlet" MAP 0x001C4BB8 /* @ECU_Address@TERWT_sss_ERWT@0x0215E000@ */ ECIPP_ALIGNMENT_SWORD 4096 Compu_TERWT_sss_ERWT -4096 4095.875
 /begin AXIS_DESCR COM_AXIS NO_INPUT_QUANTITY Compu_TEMWT_sss_MAP 6 -128 127.99609375 AXIS_PTS_REF TEMWT_sss_MAP /end AXIS_DESCR
 /begin AXIS_DESCR COM_AXIS NO_INPUT_QUANTITY Compu_TEMWT_sss_rpm 6 -32768 32767 AXIS_PTS_REF TEMWT_sss_rpm /end AXIS_DESCR
/end CHARACTERISTIC
/begin COMPU_METHOD Compu_TERWT_sss_ERWT "" RAT_FUNC "%.1" "SS ERWT Rise (delta deg F)" COEFFS 0 8 0 0 0 1 /end COMPU_METHOD
/begin CHARACTERISTIC Ttrqcal_fric "Gasoline MAP Torque (psia)" CURVE 0x001CA674 /* @ECU_Address@Ttrqcal_fric@0x021FD000@ */ ECIPP_ALIGNMENT_SWORD 8192 Compu_Ttrqcal_fric -8192 8191.75
 /begin AXIS_DESCR COM_AXIS NO_INPUT_QUANTITY Compu_Ttrqcal_RPM 16 -32768 32767 AXIS_PTS_REF Ttrqcal_RPM /end AXIS_DESCR
/end CHARACTERISTIC
/begin COMPU_METHOD Compu_Ttrqcal_fric " " RAT_FUNC "%.2" "Friction Torque" COEFFS 0 4 0 0 0 1 /end COMPU_METHOD
/begin COMPU_METHOD Compu_TWTRIN_DC_Vavg " " RAT_FUNC "%.2" "Vavg (volts)" COEFFS 0 1024 0 0 0 1 /end COMPU_METHOD
/begin CHARACTERISTIC TWTRIN_DC_DC "Water intrusion drive duty-cycle" CURVE 0x001C60BC /* @ECU_Address@TWTRIN_DC_DC@0x021FF000@ */ ECIPP_ALIGNMENT_SWORD 200 Compu_TWTRIN_DC_DC -200 199.993896484375
 /begin AXIS_DESCR COM_AXIS NO_INPUT_QUANTITY Compu_TWTRIN_DC_Vavg 4 -32 31.9990234375 AXIS_PTS_REF TWTRIN_DC_Vavg /end AXIS_DESCR
/end CHARACTERISTIC
/begin AXIS_PTS TWTRIN_DC_Vavg " " 0x001C60C4 /* @ECU_Address@TWTRIN_DC_Vavg@0x021FE000@ */ NO_INPUT_QUANTITY ECIPP_Lookup_SWORD 0 Compu_TWTRIN_DC_Vavg 4 -32 31.9990234375 /end AXIS_PTS
/begin COMPU_METHOD Compu_TWTRIN_DC_DC " " RAT_FUNC "%.1" "Duty-Cycle (%)" COEFFS 0 163.84 0 0 0 1 /end COMPU_METHOD
/begin CHARACTERISTIC TtrqcalLP_MAP_0 "LP MAP Torque (psia)" CURVE 0x001CA6D4 /* @ECU_Address@TtrqcalLP_MAP_0@0x02216000@ */ ECIPP_ALIGNMENT_SWORD 128 Compu_TtrqcalLP_MAP_0 -128 127.99609375
 /begin AXIS_DESCR COM_AXIS NO_INPUT_QUANTITY Compu_Ttrqcal_RPM 16 -32768 32767 AXIS_PTS_REF Ttrqcal_RPM /end AXIS_DESCR
/end CHARACTERISTIC
/begin COMPU_METHOD Compu_TtrqcalLP_MAP_0 " " RAT_FUNC "%.2" "No Torque" COEFFS 0 256 0 0 0 1 /end COMPU_METHOD
/begin CHARACTERISTIC TtrqcalNG_MAP_0 "NG MAP Torque (psia)" CURVE 0x001CA834 /* @ECU_Address@TtrqcalNG_MAP_0@0x02217000@ */ ECIPP_ALIGNMENT_SWORD 128 Compu_TtrqcalNG_MAP_0 -128 127.99609375
 /begin AXIS_DESCR COM_AXIS NO_INPUT_QUANTITY Compu_Ttrqcal_RPM 16 -32768 32767 AXIS_PTS_REF Ttrqcal_RPM /end AXIS_DESCR
/end CHARACTERISTIC
/begin COMPU_METHOD Compu_TtrqcalNG_MAP_0 " " RAT_FUNC "%.2" "No Torque" COEFFS 0 256 0 0 0 1 /end COMPU_METHOD
/begin CHARACTERISTIC Ttrqcal_MAP_low "Gasoline MAP Torque (psia)" CURVE 0x001CA594 /* @ECU_Address@Ttrqcal_MAP_low@0x02218000@ */ ECIPP_ALIGNMENT_SWORD 128 Compu_Ttrqcal_MAP_low -128 127.99609375
 /begin AXIS_DESCR COM_AXIS NO_INPUT_QUANTITY Compu_Ttrqcal_RPM 16 -32768 32767 AXIS_PTS_REF Ttrqcal_RPM /end AXIS_DESCR
/end CHARACTERISTIC
/begin COMPU_METHOD Compu_Ttrqcal_MAP_low " " RAT_FUNC "%.2" "Low Torque" COEFFS 0 256 0 0 0 1 /end COMPU_METHOD
/begin CHARACTERISTIC TtrqcalLP_MAP_low "LP MAP Torque (psia)" CURVE 0x001CA6F4 /* @ECU_Address@TtrqcalLP_MAP_low@0x02219000@ */ ECIPP_ALIGNMENT_SWORD 128 Compu_TtrqcalLP_MAP_low -128 127.99609375
 /begin AXIS_DESCR COM_AXIS NO_INPUT_QUANTITY Compu_Ttrqcal_RPM 16 -32768 32767 AXIS_PTS_REF Ttrqcal_RPM /end AXIS_DESCR
/end CHARACTERISTIC
/begin COMPU_METHOD Compu_TtrqcalLP_MAP_low " " RAT_FUNC "%.2" "Low Torque" COEFFS 0 256 0 0 0 1 /end COMPU_METHOD
/begin CHARACTERISTIC TtrqcalNG_MAP_low "NG MAP Torque (psia)" CURVE 0x001CA854 /* @ECU_Address@TtrqcalNG_MAP_low@0x0221A000@ */ ECIPP_ALIGNMENT_SWORD 128 Compu_TtrqcalNG_MAP_low -128 127.99609375
 /begin AXIS_DESCR COM_AXIS NO_INPUT_QUANTITY Compu_Ttrqcal_RPM 16 -32768 32767 AXIS_PTS_REF Ttrqcal_RPM /end AXIS_DESCR
/end CHARACTERISTIC
/begin COMPU_METHOD Compu_TtrqcalNG_MAP_low " " RAT_FUNC "%.2" "Low Torque" COEFFS 0 256 0 0 0 1 /end COMPU_METHOD
/begin CHARACTERISTIC Ttrqcal_MAP_mid "Gasoline MAP Torque (psia)" CURVE 0x001CA5B4 /* @ECU_Address@Ttrqcal_MAP_mid@0x0221B000@ */ ECIPP_ALIGNMENT_SWORD 128 Compu_Ttrqcal_MAP_mid -128 127.99609375
 /begin AXIS_DESCR COM_AXIS NO_INPUT_QUANTITY Compu_Ttrqcal_RPM 16 -32768 32767 AXIS_PTS_REF Ttrqcal_RPM /end AXIS_DESCR
/end CHARACTERISTIC
/begin COMPU_METHOD Compu_Ttrqcal_MAP_mid " " RAT_FUNC "%.2" "Mid Torque" COEFFS 0 256 0 0 0 1 /end COMPU_METHOD
/begin CHARACTERISTIC TtrqcalLP_MAP_mid "LP MAP Torque (psia)" CURVE 0x001CA714 /* @ECU_Address@TtrqcalLP_MAP_mid@0x0221C000@ */ ECIPP_ALIGNMENT_SWORD 128 Compu_TtrqcalLP_MAP_mid -128 127.99609375
 /begin AXIS_DESCR COM_AXIS NO_INPUT_QUANTITY Compu_Ttrqcal_RPM 16 -32768 32767 AXIS_PTS_REF Ttrqcal_RPM /end AXIS_DESCR
/end CHARACTERISTIC
/begin COMPU_METHOD Compu_TtrqcalLP_MAP_mid " " RAT_FUNC "%.2" "Mid Torque" COEFFS 0 256 0 0 0 1 /end COMPU_METHOD
/begin CHARACTERISTIC TtrqcalNG_MAP_mid "NG MAP Torque (psia)" CURVE 0x001CA874 /* @ECU_Address@TtrqcalNG_MAP_mid@0x0221D000@ */ ECIPP_ALIGNMENT_SWORD 128 Compu_TtrqcalNG_MAP_mid -128 127.99609375
 /begin AXIS_DESCR COM_AXIS NO_INPUT_QUANTITY Compu_Ttrqcal_RPM 16 -32768 32767 AXIS_PTS_REF Ttrqcal_RPM /end AXIS_DESCR
/end CHARACTERISTIC
/begin COMPU_METHOD Compu_TtrqcalNG_MAP_mid " " RAT_FUNC "%.2" "Mid Torque" COEFFS 0 256 0 0 0 1 /end COMPU_METHOD
/begin CHARACTERISTIC Ttrqcal_MAP_hi "Gasoline MAP Torque (psia)" CURVE 0x001CA5D4 /* @ECU_Address@Ttrqcal_MAP_hi@0x0221E000@ */ ECIPP_ALIGNMENT_SWORD 128 Compu_Ttrqcal_MAP_hi -128 127.99609375
 /begin AXIS_DESCR COM_AXIS NO_INPUT_QUANTITY Compu_Ttrqcal_RPM 16 -32768 32767 AXIS_PTS_REF Ttrqcal_RPM /end AXIS_DESCR
/end CHARACTERISTIC
/begin COMPU_METHOD Compu_Ttrqcal_MAP_hi " " RAT_FUNC "%.2" "High Torque" COEFFS 0 256 0 0 0 1 /end COMPU_METHOD
/begin CHARACTERISTIC TtrqcalLP_MAP_hi "LP MAP Torque (psia)" CURVE 0x001CA734 /* @ECU_Address@TtrqcalLP_MAP_hi@0x0221F000@ */ ECIPP_ALIGNMENT_SWORD 128 Compu_TtrqcalLP_MAP_hi -128 127.99609375
 /begin AXIS_DESCR COM_AXIS NO_INPUT_QUANTITY Compu_Ttrqcal_RPM 16 -32768 32767 AXIS_PTS_REF Ttrqcal_RPM /end AXIS_DESCR
/end CHARACTERISTIC
/begin COMPU_METHOD Compu_TtrqcalLP_MAP_hi " " RAT_FUNC "%.2" "High Torque" COEFFS 0 256 0 0 0 1 /end COMPU_METHOD
/begin CHARACTERISTIC TtrqcalNG_MAP_hi "NG MAP Torque (psia)" CURVE 0x001CA894 /* @ECU_Address@TtrqcalNG_MAP_hi@0x02220000@ */ ECIPP_ALIGNMENT_SWORD 128 Compu_TtrqcalNG_MAP_hi -128 127.99609375
 /begin AXIS_DESCR COM_AXIS NO_INPUT_QUANTITY Compu_Ttrqcal_RPM 16 -32768 32767 AXIS_PTS_REF Ttrqcal_RPM /end AXIS_DESCR
/end CHARACTERISTIC
/begin COMPU_METHOD Compu_TtrqcalNG_MAP_hi " " RAT_FUNC "%.2" "High Torque" COEFFS 0 256 0 0 0 1 /end COMPU_METHOD
/begin CHARACTERISTIC TtrqcalLP_MAP_100 "LP MAP Torque (psia)" CURVE 0x001CA754 /* @ECU_Address@TtrqcalLP_MAP_100@0x02221000@ */ ECIPP_ALIGNMENT_SWORD 128 Compu_TtrqcalLP_MAP_100 -128 127.99609375
 /begin AXIS_DESCR COM_AXIS NO_INPUT_QUANTITY Compu_Ttrqcal_RPM 16 -32768 32767 AXIS_PTS_REF Ttrqcal_RPM /end AXIS_DESCR
/end CHARACTERISTIC
/begin COMPU_METHOD Compu_TtrqcalLP_MAP_100 " " RAT_FUNC "%.2" "Full Torque" COEFFS 0 256 0 0 0 1 /end COMPU_METHOD
/begin CHARACTERISTIC TtrqcalNG_MAP_100 "NG MAP Torque (psia)" CURVE 0x001CA8B4 /* @ECU_Address@TtrqcalNG_MAP_100@0x02222000@ */ ECIPP_ALIGNMENT_SWORD 128 Compu_TtrqcalNG_MAP_100 -128 127.99609375
 /begin AXIS_DESCR COM_AXIS NO_INPUT_QUANTITY Compu_Ttrqcal_RPM 16 -32768 32767 AXIS_PTS_REF Ttrqcal_RPM /end AXIS_DESCR
/end CHARACTERISTIC
/begin COMPU_METHOD Compu_TtrqcalNG_MAP_100 " " RAT_FUNC "%.2" "Full Torque" COEFFS 0 256 0 0 0 1 /end COMPU_METHOD
/begin CHARACTERISTIC Ttrqcal_retard "Gasoline MAP Torque (psia)" CURVE 0x001CA614 /* @ECU_Address@Ttrqcal_retard@0x02223000@ */ ECIPP_ALIGNMENT_SWORD 8192 Compu_Ttrqcal_retard -8192 8191.75
 /begin AXIS_DESCR COM_AXIS NO_INPUT_QUANTITY Compu_Ttrqcal_RPM 16 -32768 32767 AXIS_PTS_REF Ttrqcal_RPM /end AXIS_DESCR
/end CHARACTERISTIC
/begin COMPU_METHOD Compu_Ttrqcal_retard " " RAT_FUNC "%.2" "Retard Torque" COEFFS 0 4 0 0 0 1 /end COMPU_METHOD
/begin CHARACTERISTIC TtrqcalLP_retard "LP MAP Torque (psia)" CURVE 0x001CA774 /* @ECU_Address@TtrqcalLP_retard@0x02224000@ */ ECIPP_ALIGNMENT_SWORD 8192 Compu_TtrqcalLP_retard -8192 8191.75
 /begin AXIS_DESCR COM_AXIS NO_INPUT_QUANTITY Compu_Ttrqcal_RPM 16 -32768 32767 AXIS_PTS_REF Ttrqcal_RPM /end AXIS_DESCR
/end CHARACTERISTIC
/begin COMPU_METHOD Compu_TtrqcalLP_retard " " RAT_FUNC "%.2" "Retard Torque" COEFFS 0 4 0 0 0 1 /end COMPU_METHOD
/begin CHARACTERISTIC TtrqcalNG_retard "NG MAP Torque (psia)" CURVE 0x001CA8D4 /* @ECU_Address@TtrqcalNG_retard@0x02225000@ */ ECIPP_ALIGNMENT_SWORD 8192 Compu_TtrqcalNG_retard -8192 8191.75
 /begin AXIS_DESCR COM_AXIS NO_INPUT_QUANTITY Compu_Ttrqcal_RPM 16 -32768 32767 AXIS_PTS_REF Ttrqcal_RPM /end AXIS_DESCR
/end CHARACTERISTIC
/begin COMPU_METHOD Compu_TtrqcalNG_retard " " RAT_FUNC "%.2" "Retard Torque" COEFFS 0 4 0 0 0 1 /end COMPU_METHOD
/begin CHARACTERISTIC TtrqcalLP_fric "LP MAP Torque (psia)" CURVE 0x001CA7D4 /* @ECU_Address@TtrqcalLP_fric@0x02226000@ */ ECIPP_ALIGNMENT_SWORD 8192 Compu_TtrqcalLP_fric -8192 8191.75
 /begin AXIS_DESCR COM_AXIS NO_INPUT_QUANTITY Compu_Ttrqcal_RPM 16 -32768 32767 AXIS_PTS_REF Ttrqcal_RPM /end AXIS_DESCR
/end CHARACTERISTIC
/begin COMPU_METHOD Compu_TtrqcalLP_fric " " RAT_FUNC "%.2" "Friction Torque" COEFFS 0 4 0 0 0 1 /end COMPU_METHOD
/begin CHARACTERISTIC TtrqcalNG_fric "NG MAP Torque (psia)" CURVE 0x001CA934 /* @ECU_Address@TtrqcalNG_fric@0x02227000@ */ ECIPP_ALIGNMENT_SWORD 8192 Compu_TtrqcalNG_fric -8192 8191.75
 /begin AXIS_DESCR COM_AXIS NO_INPUT_QUANTITY Compu_Ttrqcal_RPM 16 -32768 32767 AXIS_PTS_REF Ttrqcal_RPM /end AXIS_DESCR
/end CHARACTERISTIC
/begin COMPU_METHOD Compu_TtrqcalNG_fric " " RAT_FUNC "%.2" "Friction Torque" COEFFS 0 4 0 0 0 1 /end COMPU_METHOD
/begin CHARACTERISTIC TtrqcalLP_trq_100 "LP MAP Torque (psia)" CURVE 0x001CA814 /* @ECU_Address@TtrqcalLP_trq_100@0x02228000@ */ ECIPP_ALIGNMENT_SWORD 8192 Compu_TtrqcalLP_trq_100 -8192 8191.75
 /begin AXIS_DESCR COM_AXIS NO_INPUT_QUANTITY Compu_Ttrqcal_RPM 16 -32768 32767 AXIS_PTS_REF Ttrqcal_RPM /end AXIS_DESCR
/end CHARACTERISTIC
/begin COMPU_METHOD Compu_TtrqcalLP_trq_100 " " RAT_FUNC "%.1" "Standard Max Brake Torque" COEFFS 0 4 0 0 0 1 /end COMPU_METHOD
/begin CHARACTERISTIC TtrqcalNG_trq_100 "NG MAP Torque (psia)" CURVE 0x001CA974 /* @ECU_Address@TtrqcalNG_trq_100@0x02229000@ */ ECIPP_ALIGNMENT_SWORD 8192 Compu_TtrqcalNG_trq_100 -8192 8191.75
 /begin AXIS_DESCR COM_AXIS NO_INPUT_QUANTITY Compu_Ttrqcal_RPM 16 -32768 32767 AXIS_PTS_REF Ttrqcal_RPM /end AXIS_DESCR
/end CHARACTERISTIC
/begin COMPU_METHOD Compu_TtrqcalNG_trq_100 " " RAT_FUNC "%.1" "Standard Max Brake Torque" COEFFS 0 4 0 0 0 1 /end COMPU_METHOD
/begin CHARACTERISTIC Ttrqcal_torqpct "Torque Percent 0" VAL_BLK 0x001C6B40 /* @ECU_Address@Ttrqcal_torqpct@0x0222A000@ */ ECIPP_ALIGNMENT_SWORD 100 Compu_Ttrqcal_torqpct -100 99.9969482421875 MATRIX_DIM 5 1 1 /end CHARACTERISTIC
/begin COMPU_METHOD Compu_Ttrqcal_torqpct " " RAT_FUNC "%.1" "%" COEFFS 0 327.68 0 0 0 1 /end COMPU_METHOD
/begin CHARACTERISTIC TFPPTPS_FPP_pct "FPP->TPS Nonlinear Mapping" MAP 0x001C4CE0 /* @ECU_Address@TFPPTPS_FPP_pct@0x02284000@ */ ECIPP_ALIGNMENT_SWORD 100 Compu_TFPPTPS_FPP_pct -100 99.9969482421875
 /begin AXIS_DESCR COM_AXIS NO_INPUT_QUANTITY Compu_TFPPTPS_TPS_pct 12 -100 99.9969482421875 AXIS_PTS_REF TFPPTPS_TPS_pct /end AXIS_DESCR
 /begin AXIS_DESCR COM_AXIS NO_INPUT_QUANTITY Compu_TFPPTPS_rpm 12 -32768 32767 AXIS_PTS_REF TFPPTPS_rpm /end AXIS_DESCR
/end CHARACTERISTIC
/begin AXIS_PTS TFPPTPS_TPS_pct " " 0x001C4E00 /* @ECU_Address@TFPPTPS_TPS_pct@0x02286000@ */ NO_INPUT_QUANTITY ECIPP_Lookup_SWORD 0 Compu_TFPPTPS_TPS_pct 12 -100 99.9969482421875 /end AXIS_PTS
/begin AXIS_PTS TFPPTPS_rpm " " 0x001C4E18 /* @ECU_Address@TFPPTPS_rpm@0x02285000@ */ NO_INPUT_QUANTITY ECIPP_Lookup_SWORD 0 Compu_TFPPTPS_rpm 12 -32768 32767 /end AXIS_PTS
/begin COMPU_METHOD Compu_TFPPTPS_FPP_pct "" RAT_FUNC "%.1" "FPP Cmd (%)" COEFFS 0 327.68 0 0 0 1 /end COMPU_METHOD
/begin COMPU_METHOD Compu_TFPPTPS_rpm " " RAT_FUNC "%.0" "Speed (rpm)" COEFFS 0 1 0 0 0 1 /end COMPU_METHOD
/begin COMPU_METHOD Compu_TFPPTPS_TPS_pct " " RAT_FUNC "%.1" "Throttle Command (%)" COEFFS 0 327.68 0 0 0 1 /end COMPU_METHOD
/begin CHARACTERISTIC Ttrqcal_fric_cold "Gasoline MAP Torque (psia)" CURVE 0x001CA654 /* @ECU_Address@Ttrqcal_fric_cold@0x0235B000@ */ ECIPP_ALIGNMENT_SWORD 8192 Compu_Ttrqcal_fric_cold -8192 8191.75
 /begin AXIS_DESCR COM_AXIS NO_INPUT_QUANTITY Compu_Ttrqcal_RPM 16 -32768 32767 AXIS_PTS_REF Ttrqcal_RPM /end AXIS_DESCR
/end CHARACTERISTIC
/begin COMPU_METHOD Compu_Ttrqcal_fric_cold " " RAT_FUNC "%.2" "Cold Friction Torque" COEFFS 0 4 0 0 0 1 /end COMPU_METHOD
/begin CHARACTERISTIC TtrqcalLP_fric_cold "LP MAP Torque (psia)" CURVE 0x001CA7B4 /* @ECU_Address@TtrqcalLP_fric_cold@0x0235C000@ */ ECIPP_ALIGNMENT_SWORD 8192 Compu_TtrqcalLP_fric_cold -8192 8191.75
 /begin AXIS_DESCR COM_AXIS NO_INPUT_QUANTITY Compu_Ttrqcal_RPM 16 -32768 32767 AXIS_PTS_REF Ttrqcal_RPM /end AXIS_DESCR
/end CHARACTERISTIC
/begin COMPU_METHOD Compu_TtrqcalLP_fric_cold " " RAT_FUNC "%.2" "Cold Friction Torque" COEFFS 0 4 0 0 0 1 /end COMPU_METHOD
/begin CHARACTERISTIC TtrqcalNG_fric_cold "NG MAP Torque (psia)" CURVE 0x001CA914 /* @ECU_Address@TtrqcalNG_fric_cold@0x0235D000@ */ ECIPP_ALIGNMENT_SWORD 8192 Compu_TtrqcalNG_fric_cold -8192 8191.75
 /begin AXIS_DESCR COM_AXIS NO_INPUT_QUANTITY Compu_Ttrqcal_RPM 16 -32768 32767 AXIS_PTS_REF Ttrqcal_RPM /end AXIS_DESCR
/end CHARACTERISTIC
/begin COMPU_METHOD Compu_TtrqcalNG_fric_cold " " RAT_FUNC "%.2" "Cold Friction Torque" COEFFS 0 4 0 0 0 1 /end COMPU_METHOD
/begin COMPU_METHOD Compu_TCoolingH2O_rpm " " RAT_FUNC "%.1" "Engine Speed (rpm)" COEFFS 0 1 0 0 0 1 /end COMPU_METHOD
/begin CHARACTERISTIC TCoolingH2O_flow "Cooling Water Flow Rate" CURVE 0x001C809E /* @ECU_Address@TCoolingH2O_flow@0x02370000@ */ ECIPP_ALIGNMENT_UWORD 256 Compu_TCoolingH2O_flow 0 255.99609375
 /begin AXIS_DESCR COM_AXIS NO_INPUT_QUANTITY Compu_TCoolingH2O_rpm 6 -32768 32767 AXIS_PTS_REF TCoolingH2O_rpm /end AXIS_DESCR
/end CHARACTERISTIC
/begin AXIS_PTS TCoolingH2O_rpm " " 0x001C496C /* @ECU_Address@TCoolingH2O_rpm@0x0236F000@ */ NO_INPUT_QUANTITY ECIPP_Lookup_SWORD 0 Compu_TCoolingH2O_rpm 6 -32768 32767 /end AXIS_PTS
/begin COMPU_METHOD Compu_TCoolingH2O_flow " " RAT_FUNC "%.1" "Flow Rate" COEFFS 0 256 0 0 0 1 /end COMPU_METHOD
/begin CHARACTERISTIC Ttrqcal_parasitic "Gasoline MAP Torque (psia)" CURVE 0x001CA694 /* @ECU_Address@Ttrqcal_parasitic@0x023A6000@ */ ECIPP_ALIGNMENT_SWORD 8192 Compu_Ttrqcal_parasitic -8192 8191.75
 /begin AXIS_DESCR COM_AXIS NO_INPUT_QUANTITY Compu_Ttrqcal_RPM 16 -32768 32767 AXIS_PTS_REF Ttrqcal_RPM /end AXIS_DESCR
/end CHARACTERISTIC
/begin COMPU_METHOD Compu_Ttrqcal_parasitic " " RAT_FUNC "%.2" "Parasitic Losses" COEFFS 0 4 0 0 0 1 /end COMPU_METHOD
/begin CHARACTERISTIC TtrqcalLP_parasitic "LP MAP Torque (psia)" CURVE 0x001CA7F4 /* @ECU_Address@TtrqcalLP_parasitic@0x023A7000@ */ ECIPP_ALIGNMENT_SWORD 8192 Compu_TtrqcalLP_parasitic -8192 8191.75
 /begin AXIS_DESCR COM_AXIS NO_INPUT_QUANTITY Compu_Ttrqcal_RPM 16 -32768 32767 AXIS_PTS_REF Ttrqcal_RPM /end AXIS_DESCR
/end CHARACTERISTIC
/begin COMPU_METHOD Compu_TtrqcalLP_parasitic " " RAT_FUNC "%.2" "Parasitic Losses" COEFFS 0 4 0 0 0 1 /end COMPU_METHOD
/begin CHARACTERISTIC TtrqcalNG_parasitic "NG MAP Torque (psia)" CURVE 0x001CA954 /* @ECU_Address@TtrqcalNG_parasitic@0x023A8000@ */ ECIPP_ALIGNMENT_SWORD 8192 Compu_TtrqcalNG_parasitic -8192 8191.75
 /begin AXIS_DESCR COM_AXIS NO_INPUT_QUANTITY Compu_Ttrqcal_RPM 16 -32768 32767 AXIS_PTS_REF Ttrqcal_RPM /end AXIS_DESCR
/end CHARACTERISTIC
/begin COMPU_METHOD Compu_TtrqcalNG_parasitic " " RAT_FUNC "%.2" "Parasitic Losses" COEFFS 0 4 0 0 0 1 /end COMPU_METHOD
/begin CHARACTERISTIC Ttrqcal_exr "Gasoline MAP Torque (psia)" CURVE 0x001CA634 /* @ECU_Address@Ttrqcal_exr@0x0264F000@ */ ECIPP_ALIGNMENT_SWORD 8192 Compu_Ttrqcal_exr -8192 8191.75
 /begin AXIS_DESCR COM_AXIS NO_INPUT_QUANTITY Compu_Ttrqcal_RPM 16 -32768 32767 AXIS_PTS_REF Ttrqcal_RPM /end AXIS_DESCR
/end CHARACTERISTIC
/begin COMPU_METHOD Compu_Ttrqcal_exr " " RAT_FUNC "%.2" "Exhaust Retarder Torque" COEFFS 0 4 0 0 0 1 /end COMPU_METHOD
/begin CHARACTERISTIC TtrqcalLP_exr "LP MAP Torque (psia)" CURVE 0x001CA794 /* @ECU_Address@TtrqcalLP_exr@0x02650000@ */ ECIPP_ALIGNMENT_SWORD 8192 Compu_TtrqcalLP_exr -8192 8191.75
 /begin AXIS_DESCR COM_AXIS NO_INPUT_QUANTITY Compu_Ttrqcal_RPM 16 -32768 32767 AXIS_PTS_REF Ttrqcal_RPM /end AXIS_DESCR
/end CHARACTERISTIC
/begin COMPU_METHOD Compu_TtrqcalLP_exr " " RAT_FUNC "%.2" "Exhaust Retarder Torque" COEFFS 0 4 0 0 0 1 /end COMPU_METHOD
/begin CHARACTERISTIC TtrqcalNG_exr "NG MAP Torque (psia)" CURVE 0x001CA8F4 /* @ECU_Address@TtrqcalNG_exr@0x02651000@ */ ECIPP_ALIGNMENT_SWORD 8192 Compu_TtrqcalNG_exr -8192 8191.75
 /begin AXIS_DESCR COM_AXIS NO_INPUT_QUANTITY Compu_Ttrqcal_RPM 16 -32768 32767 AXIS_PTS_REF Ttrqcal_RPM /end AXIS_DESCR
/end CHARACTERISTIC
/begin COMPU_METHOD Compu_TtrqcalNG_exr " " RAT_FUNC "%.2" "Exhaust Retarder Torque" COEFFS 0 4 0 0 0 1 /end COMPU_METHOD
/begin MEASUREMENT J1939RC_ER_trq "Engine Retarder Torque Curve" UBYTE Compu_J1939RC_ER_trq 0 0 -125 130 ECU_ADDRESS 0x02654000 MATRIX_DIM 5 1 1 /end MEASUREMENT
/begin COMPU_METHOD Compu_J1939RC_ER_trq " " RAT_FUNC "%.0" "Engine Retarder Torque (% of ref)" COEFFS 0 1 125 0 0 1 /end COMPU_METHOD
/begin MEASUREMENT J1939RC_EXR_trq "Exhaust Retarder Torque Curve" UBYTE Compu_J1939RC_EXR_trq 0 0 -125 130 ECU_ADDRESS 0x02655000 MATRIX_DIM 5 1 1 /end MEASUREMENT
/begin COMPU_METHOD Compu_J1939RC_EXR_trq " " RAT_FUNC "%.0" "Exhaust Retarder Torque (% of ref)" COEFFS 0 1 125 0 0 1 /end COMPU_METHOD
/begin CHARACTERISTIC TJ1939EC_rpmd "J1939 EC1 desired speed points 3-5" VAL_BLK 0x001C8102 /* @ECU_Address@TJ1939EC_rpmd@0x026B2000@ */ ECIPP_ALIGNMENT_UWORD 65535 Compu_TJ1939EC_rpmd 0 65535 MATRIX_DIM 3 1 1 /end CHARACTERISTIC
/begin COMPU_METHOD Compu_TJ1939EC_rpmd " " RAT_FUNC "%.0" "rpm" COEFFS 0 1 0 0 0 1 /end COMPU_METHOD
/begin MEASUREMENT TJ1939EC_rpm "J1939 EC1 speed points 1-6" UWORD Compu_TJ1939EC_rpm 0 0 0 8191.875 ECU_ADDRESS 0x026B3000 MATRIX_DIM 6 1 1 /end MEASUREMENT
/begin COMPU_METHOD Compu_TJ1939EC_rpm " " RAT_FUNC "%.0" "rpm" COEFFS 0 8 0 0 0 1 /end COMPU_METHOD
/begin MEASUREMENT TJ1939EC_trq "J1939 EC1 torque points 1-5" UBYTE Compu_TJ1939EC_trq 0 0 -125 130 ECU_ADDRESS 0x026B4000 MATRIX_DIM 5 1 1 /end MEASUREMENT
/begin COMPU_METHOD Compu_TJ1939EC_trq " " RAT_FUNC "%.0" "% of ref" COEFFS 0 1 125 0 0 1 /end COMPU_METHOD
/begin GROUP EC_LoadCal "ECONTROLS" ROOT
 /begin REF_CHARACTERISTIC FPPTPSnl_ena FPPTPSnl_FPP FPPTPSnl_TPS FPPTPSnl2_FPP FPPTPSnl2_TPS FPPTPSnl3_FPP FPPTPSnl3_TPS load_est_type torque_select fric_cold_ena fric_cold_T fric_hot_T J1939_torque_pct_tbl J1939_static_pwr MAP_fullload_BPlim J1939_rc_torque_ref J1939_exr_torque_tbl J1939RC_ER_pt3_rpmd J1939RC_ER_pt4_rpmd J1939RC_EXR_pt3_rpmd J1939RC_EXR_pt4_rpmd torq_avail_mode torq_driver_dmd_mode torq_parasitic_mode torq_load_convert Ttrqcal_MAP_0 Ttrqcal_MAP_100 Ttrqcal_trq_100 Ttrqcal_fric TtrqcalLP_MAP_0 TtrqcalNG_MAP_0 Ttrqcal_MAP_low TtrqcalLP_MAP_low TtrqcalNG_MAP_low Ttrqcal_MAP_mid TtrqcalLP_MAP_mid TtrqcalNG_MAP_mid Ttrqcal_MAP_hi TtrqcalLP_MAP_hi TtrqcalNG_MAP_hi TtrqcalLP_MAP_100 TtrqcalNG_MAP_100 Ttrqcal_retard TtrqcalLP_retard TtrqcalNG_retard TtrqcalLP_fric TtrqcalNG_fric TtrqcalLP_trq_100 TtrqcalNG_trq_100 Ttrqcal_torqpct TFPPTPS_FPP_pct Ttrqcal_fric_cold TtrqcalLP_fric_cold TtrqcalNG_fric_cold Ttrqcal_parasitic TtrqcalLP_parasitic TtrqcalNG_parasitic Ttrqcal_exr TtrqcalLP_exr TtrqcalNG_exr TJ1939EC_rpmd /end REF_CHARACTERISTIC
 /begin REF_MEASUREMENT torque_Nm_max FPPTPSnl_cur torque_driver torque_pct_max torque_pct_gross torque_pct_fric drivebrake_torq_pct exhbrake_torq_pct drivebrake_torq_max exhbrake_torq_max eng_torque_mode FPP_cmd_pstslew torque_pct_eng_dmd torque_tbl_fric torque_parasitic torque_pct_max_avail J1939RC_ER_trq J1939RC_EXR_trq TJ1939EC_rpm TJ1939EC_trq /end REF_MEASUREMENT
/end GROUP
/begin GROUP EC_Marine "ECONTROLS" ROOT
 /begin REF_CHARACTERISTIC ESM_ena ESM_dly ESM_0pwf_load ESM_1pwf_load ESM_0pwf_dRPM ESM_1pwf_RPM ESM_fast_rpmdt ESM_slow_rpmdt ESM_Ilim_max ESM_gov_auth ESM_Kd ESM_Kiv ESM_rpmdtdz ESM_TPSLP EGT_dig_test EGT_Hi_wait EGT_dig_trig ME_derate_ena ME_derate_resett ShftInt_ena ShftInt_idle ShftInt_revlim ShftInt_FPPmax ShftInt_ignoret MES_ena MES_gain_slct MES_rpmdelt_0 MES_rpmdelt_1 MES_Ilim_pos MES_Ilim_neg MES_auth_pos MES_auth_neg MES_rpm_mstr_tau MES_MAP_mstr_tau MES_PID_tau MES_loadref_max MES_loadref_min MES_status_lamp MES_status_rpmtol MES_usblk_offt MES_usblk_ont SSBSI_NdRa_idle SSBSI_NdRa_revlim SSBSI_NdRa_rldrpm SSBSI_FdRa_idle SSBSI_FdRa_revlim SSBSI_FdRa_rldrpm SSBSI_RdNa_idle SSBSI_RdNa_revlim SSBSI_RdNa_rldrpm SSBSI_FdNa_idle SSBSI_FdNa_revlim SSBSI_FdNa_rldrpm SSBSI_NdFa_idle SSBSI_NdFa_revlim SSBSI_NdFa_rldrpm SSBSI_RdFa_idle SSBSI_RdFa_revlim SSBSI_RdFa_rldrpm ShftInt_revlim_drpm MES_FPP_mode MES_FPPdelt_1 MES_FPPdelt_0 VP_shift_rpmmax VP_shift_rpmd VP_troll_rpmmax SSBSI_NdRa_Kspkret SSBSI_FdRa_Kspkret SSBSI_RdNa_Kspkret SSBSI_FdNa_Kspkret SSBSI_NdFa_Kspkret SSBSI_RdFa_Kspkret ShftInt_Kspkret SIS_spkret_dz SIS_spkret_max SIS_FF_load EMWT_HiExp1_abs EMWT_HiExp1_delt EMWT_HiExp2_abs EMWT_HiExp2_delt EMWT1_ena EMWT2_ena EMWT_run_wait EMWT_sensor_tau EMWT_in_s EMWT_CWT_C TORM_ena TORM_FPPdelt_ini TORM_FPPdelt_mon TORM_FPP_rampback TORM_monvalid_t TORM_FPP_tau1 TORM_rpm_tol TORM_RS_tol TORM_RS_phaset MES_WOT_desync MES_WOTds_1 MES_WOTds_0 ERWT_HiExp1_abs ERWT_HiExp1_delt ERWT_HiExp2_abs ERWT_HiExp2_delt ERWT1_ena ERWT2_ena ERWT_run_wait ERWT_sensor_tau ERWT_in_s ERWT_CWT_C ESM_engage_rate ESM_dengage_rate ESM_decel_control ESM_idle_drpm_max ESM_idle_dload_max ESM_SIS_extend ESM_idle_pwr_max EMWT_wt_init ERWT_wt_init OilQ_ena OilQ_chan OilQ_trimchan OilQ_trimpct OilQ_tvalid OilQ_Vhi OilQ_Vlo OilQ_Vpdelta OilQ_Vndelta OilQ_alertreps WTRIN_ena WTRIN_out OilQ_trimpctlearn TORM_drpm_dFPP_max WTRIN_rpm_lmt OilQ_rpm_lmt BLST_port_stern_ena BLST_stbd_stern_ena BLST_cntr_stern_ena BLST_cntr_head_ena WTRIN_Vpp_H WTRIN_Vpp_L WTRIN_Vpp_VavgL WTRIN_Vavg_tau SHIFT_ena SHIFT_Kp SHIFT_Ki SHIFT_int_max SHIFT_int_dt_frz SHIFT_Ihard_lim SHIFT_Ipark_ena SHIFT_Ipark_lim SHIFT_Ipark_dly SHIFT_Ipark_Ki SHIFT_Ipark_max_att SHIFT_Vcomp_min SHIFT_Vcomp_max SHIFT_rev_raw SHIFT_fwd_raw SHIFT_neut_raw SHIFT_rev_delta SHIFT_fwd_delta SHIFT_neut_delta SHIFT_engage_delay SHIFT_R_ohms SHIFT_K_emf SHIFT_target_dead TWAKE_wakepos_ena TWAKE_wakeup_over TWAKE_wakeup_ena TWAKE_wakedown_ena TRANS_ratio1 TRANS_ratio2 M2TC_output_ena M2TC_prrlim_G1 M2TC_prrlim_G2 M2TC_prrlim_nhyst M2TC_prrshift_1G2 M2TC_timeshift_1G2 M2TC_prrshift_2G1 M2TC_dly_shift_1G2 M2TC_dly_Tcut_1G2 M2TC_dur_Tcut_1G2 M2TC_retard_init M2TC_ret_decay M2TC_LoadLim_init M2TC_LL_restore FPPgear_handle FPPgear_gear_dz MHGL_chan MHGL_chan_cfg MHGL_lamp MHGL_unlatch_tout FPPgear_throt_Fdz FPPgear_throt_Rdz VP_shift_rpmmax_neut FPPgear_ntrlk_tout TEMWT_sss_EMWT TERWT_sss_ERWT TWTRIN_DC_DC TCoolingH2O_flow /end REF_CHARACTERISTIC
 /begin REF_MEASUREMENT ESM_active ESM_rpmdtd ESM_pwr_inst EGT_dig_state EGT_volt ME0mstr_actv ME0mstr_sync ME0mstr_stat ME0mstr_rpmd ME0mstr_FPP ME0mstr_ECT ME0mstr_OILP ME0slv1_actv ME0slv1_sync ME0slv1_stat ME0slv1_rpmd ME0slv1_FPP ME0slv1_ECT ME0slv1_OILP ME0slv2_actv ME0slv2_sync ME0slv2_stat ME0slv2_rpmd ME0slv2_FPP ME0slv2_ECT ME0slv2_OILP ME0slv3_actv ME0slv3_sync ME0slv3_stat ME0slv3_rpmd ME0slv3_FPP ME0slv3_ECT ME0slv3_OILP ME_DERATE1_active ME_DERATE2_active ME_LOWREVLIM_active ME_derate_state ShftInt_actv_tmr ShftInt_state MES_rpmdtdz_Kd MES_rpmdz_Kp MES_rpmdz_Ki MES_Kp MES_Kd MES_Ki MES_Kiv MES_FPP_mstr MES_rpm_mstr MES_MAP_mstr MES_FPP_ntrlock MES_FPP_cmd MES_TPSest_ref MES_TPSest_d MES_Iacc MES_load_ref MES_load_PID MES_MAP_d MES_phase MES_sync_cmd MES_state MES_MAP_ref MES_light ShftIntSS_RdRa ShftIntSS_RdNa ShftIntSS_RdFa ShftIntSS_NdRa ShftIntSS_NdNa ShftIntSS_NdFa ShftIntSS_FdRa ShftIntSS_FdNa ShftIntSS_FdFa SIS_idle SIS_revlim SIS_revlim_drpm SIS_Kspkret SIS_spk_mod EMWT_in EMWT_ss_rise EMWT_est EMWT1 EMWT2 TORM_rpm_delt TORM_active TORM_state TORM_FPP_cmd_ss TORM_RS_phase SHIFT_FB_raw ERWT_in ERWT_ss_rise ERWT_est ERWT1 ERWT2 MSC_rpm_d MSC_rpmdot_d MSC_kph_d MSC_kphdot_d MSC_sync_mode MSC_TORM_mode MSC_cruise_mode MSC_inc_dec MSC_set_clr MES_status TORM_mode MES_sw_source ESM_SIS_inhibit ESM_idle_drpm ESM_idle_dload ESM_pwr_slew MES_allspeed_mstr MES_allspeed_ntrlk MES_allspeed_cmd OilQ_state OilQ_Vnom OilQ_active MEFI_FPP_anchor WTRIN_DC WTRIN_flt_cnt WTRIN_Vpp WTRIN_Vpp_diag WTRIN_Vavg SHIFT_ctl_max SHIFT_ctl_min SHIFT_ctl_cmd SHIFT_I_est SHIFT_I_meas SHIFT_active_wt SHIFT_ctl_fault SHIFT_Ipark_att SHIFT_int_acc SHIFT_I_est_abs TWAKE_wakeup_on TWAKE_wakedown_on SHIFT_retard SHIFT_LoadLim_pct M2TC_rpmlim M2TC_prr TRANS_gear_auto MSC_FPPTPSnl_mode MSC_FPPTPSnl_latch CoolingH2OExpected CoolingH2OFlowRate FPPgear_indicate FPPgear_command MHGL_active MHGL_latched FPPgear_ntrlk_t ME0mstr_MAP ME0slv1_MAP ME0slv2_MAP ME0slv3_MAP drvtrim_angle /end REF_MEASUREMENT
/end GROUP
/begin GROUP EC_RawVolts "ECONTROLS" ROOT /begin REF_MEASUREMENT SHIFT_FB_raw /end REF_MEASUREMENT /end GROUP
/end MODULE
/end PROJECT
