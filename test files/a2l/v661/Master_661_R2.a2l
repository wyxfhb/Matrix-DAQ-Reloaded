ASAP2_VERSION 1 61
/begin PROJECT Econtrols_4G "4G Test"
/begin HEADER "4G A2L Configuration" PROJECT_NO EControls4G /* config for version control */ VERSION "$Revision: 82130 $:" /* config for version control */ /end HEADER
/begin MODULE EControls_4G_SH2A "EControls 4G"
/begin MOD_COMMON "" DEPOSIT ABSOLUTE BYTE_ORDER MSB_FIRST /end MOD_COMMON
/* Define the Record Layouts */
/begin RECORD_LAYOUT ECIPP_ALIGNMENT_UBYTE FNC_VALUES 1 UBYTE COLUMN_DIR DIRECT /end RECORD_LAYOUT
/begin RECORD_LAYOUT ECIPP_ALIGNMENT_UWORD FNC_VALUES 1 UWORD COLUMN_DIR DIRECT /end RECORD_LAYOUT
/begin RECORD_LAYOUT ECIPP_ALIGNMENT_ULONG FNC_VALUES 1 ULONG COLUMN_DIR DIRECT /end RECORD_LAYOUT
/begin RECORD_LAYOUT ECIPP_ALIGNMENT_FLOAT32_IEEE FNC_VALUES 1 FLOAT32_IEEE COLUMN_DIR DIRECT /end RECORD_LAYOUT
/begin COMPU_METHOD Compu_IDENTITY "Discrete Values " /* Identifier */ IDENTICAL "%.0" /* Format */ "-" /* Units */ /end COMPU_METHOD
/begin CHARACTERISTIC FCdc4_start_coilshort "FCtl_DTC_0x04(163)" VALUE 0x001E41DC /* @ECU_Address@FCtl_DTC_0x04@0x024C4146@ */ ECIPP_ALIGNMENT_UWORD 65535 Compu_IDENTITY 0 65535 PHYS_UNIT "System ID + DTC" /end CHARACTERISTIC
/begin CHARACTERISTIC FCdc4_start_excess "FCtl_DTC_0x04(840)" VALUE 0x001E4726 /* @ECU_Address@FCtl_DTC_0x04@0x024C4690@ */ ECIPP_ALIGNMENT_UWORD 65535 Compu_IDENTITY 0 65535 PHYS_UNIT "System ID + DTC" /end CHARACTERISTIC
/begin CHARACTERISTIC FCdc4_start_gndshort "FCtl_DTC_0x04(161)" VALUE 0x001E41D8 /* @ECU_Address@FCtl_DTC_0x04@0x024C4142@ */ ECIPP_ALIGNMENT_UWORD 65535 Compu_IDENTITY 0 65535 PHYS_UNIT "System ID + DTC" /end CHARACTERISTIC
/begin CHARACTERISTIC FCdc4_start_stuck_active "FCtl_DTC_0x04(320)" VALUE 0x001E4316 /* @ECU_Address@FCtl_DTC_0x04@0x024C4280@ */ ECIPP_ALIGNMENT_UWORD 65535 Compu_IDENTITY 0 65535 PHYS_UNIT "System ID + DTC" /end CHARACTERISTIC
/begin CHARACTERISTIC FCdc4_SubDiagTemp "FCtl_DTC_0x04(653)" VALUE 0x001E45B0 /* @ECU_Address@FCtl_DTC_0x04@0x024C451A@ */ ECIPP_ALIGNMENT_UWORD 65535 Compu_IDENTITY 0 65535 PHYS_UNIT "System ID + DTC" /end CHARACTERISTIC
/begin CHARACTERISTIC FCdc4_tach_gndshort "FCtl_DTC_0x04(173)" VALUE 0x001E41F0 /* @ECU_Address@FCtl_DTC_0x04@0x024C415A@ */ ECIPP_ALIGNMENT_UWORD 65535 Compu_IDENTITY 0 65535 PHYS_UNIT "System ID + DTC" /end CHARACTERISTIC
/begin CHARACTERISTIC FCdc4_tach_pwrshort "FCtl_DTC_0x04(174)" VALUE 0x001E41F2 /* @ECU_Address@FCtl_DTC_0x04@0x024C415C@ */ ECIPP_ALIGNMENT_UWORD 65535 Compu_IDENTITY 0 65535 PHYS_UNIT "System ID + DTC" /end CHARACTERISTIC
/begin CHARACTERISTIC FCdc4_TANK_1_V_maxv "FCtl_DTC_0x04(871)" VALUE 0x001E4764 /* @ECU_Address@FCtl_DTC_0x04@0x024C46CE@ */ ECIPP_ALIGNMENT_UWORD 65535 Compu_IDENTITY 0 65535 PHYS_UNIT "System ID + DTC" /end CHARACTERISTIC
/begin CHARACTERISTIC FCdc4_TANK_1_V_minv "FCtl_DTC_0x04(873)" VALUE 0x001E4768 /* @ECU_Address@FCtl_DTC_0x04@0x024C46D2@ */ ECIPP_ALIGNMENT_UWORD 65535 Compu_IDENTITY 0 65535 PHYS_UNIT "System ID + DTC" /end CHARACTERISTIC
/begin CHARACTERISTIC FCdc4_TANK_1_V_slow "FCtl_DTC_0x04(875)" VALUE 0x001E476C /* @ECU_Address@FCtl_DTC_0x04@0x024C46D6@ */ ECIPP_ALIGNMENT_UWORD 65535 Compu_IDENTITY 0 65535 PHYS_UNIT "System ID + DTC" /end CHARACTERISTIC
/begin CHARACTERISTIC FCdc4_TAUX_dT1_max "FCtl_DTC_0x04(558)" VALUE 0x001E44F2 /* @ECU_Address@FCtl_DTC_0x04@0x024C445C@ */ ECIPP_ALIGNMENT_UWORD 65535 Compu_IDENTITY 0 65535 PHYS_UNIT "System ID + DTC" /end CHARACTERISTIC
/begin CHARACTERISTIC FCdc4_TAUX_dT1_min "FCtl_DTC_0x04(559)" VALUE 0x001E44F4 /* @ECU_Address@FCtl_DTC_0x04@0x024C445E@ */ ECIPP_ALIGNMENT_UWORD 65535 Compu_IDENTITY 0 65535 PHYS_UNIT "System ID + DTC" /end CHARACTERISTIC
/begin CHARACTERISTIC FCdc4_TAUX_dT2_max "FCtl_DTC_0x04(560)" VALUE 0x001E44F6 /* @ECU_Address@FCtl_DTC_0x04@0x024C4460@ */ ECIPP_ALIGNMENT_UWORD 65535 Compu_IDENTITY 0 65535 PHYS_UNIT "System ID + DTC" /end CHARACTERISTIC
/begin CHARACTERISTIC FCdc4_TAUX_dT2_min "FCtl_DTC_0x04(561)" VALUE 0x001E44F8 /* @ECU_Address@FCtl_DTC_0x04@0x024C4462@ */ ECIPP_ALIGNMENT_UWORD 65535 Compu_IDENTITY 0 65535 PHYS_UNIT "System ID + DTC" /end CHARACTERISTIC
/begin CHARACTERISTIC FCdc4_Taux1_derate_actv "FCtl_DTC_0x04(812)" VALUE 0x001E46EE /* @ECU_Address@FCtl_DTC_0x04@0x024C4658@ */ ECIPP_ALIGNMENT_UWORD 65535 Compu_IDENTITY 0 65535 PHYS_UNIT "System ID + DTC" /end CHARACTERISTIC
/begin CHARACTERISTIC FCdc4_TAUX1_max "FCtl_DTC_0x04(550)" VALUE 0x001E44E2 /* @ECU_Address@FCtl_DTC_0x04@0x024C444C@ */ ECIPP_ALIGNMENT_UWORD 65535 Compu_IDENTITY 0 65535 PHYS_UNIT "System ID + DTC" /end CHARACTERISTIC
/begin CHARACTERISTIC FCdc4_TAUX1_min "FCtl_DTC_0x04(551)" VALUE 0x001E44E4 /* @ECU_Address@FCtl_DTC_0x04@0x024C444E@ */ ECIPP_ALIGNMENT_UWORD 65535 Compu_IDENTITY 0 65535 PHYS_UNIT "System ID + DTC" /end CHARACTERISTIC
/begin CHARACTERISTIC FCdc4_Taux2_derate_actv "FCtl_DTC_0x04(813)" VALUE 0x001E46F0 /* @ECU_Address@FCtl_DTC_0x04@0x024C465A@ */ ECIPP_ALIGNMENT_UWORD 65535 Compu_IDENTITY 0 65535 PHYS_UNIT "System ID + DTC" /end CHARACTERISTIC
/begin CHARACTERISTIC FCdc4_TAUX2_max "FCtl_DTC_0x04(552)" VALUE 0x001E44E6 /* @ECU_Address@FCtl_DTC_0x04@0x024C4450@ */ ECIPP_ALIGNMENT_UWORD 65535 Compu_IDENTITY 0 65535 PHYS_UNIT "System ID + DTC" /end CHARACTERISTIC
/begin CHARACTERISTIC FCdc4_TAUX2_min "FCtl_DTC_0x04(553)" VALUE 0x001E44E8 /* @ECU_Address@FCtl_DTC_0x04@0x024C4452@ */ ECIPP_ALIGNMENT_UWORD 65535 Compu_IDENTITY 0 65535 PHYS_UNIT "System ID + DTC" /end CHARACTERISTIC
/begin CHARACTERISTIC FCdc4_TAUX3_max "FCtl_DTC_0x04(554)" VALUE 0x001E44EA /* @ECU_Address@FCtl_DTC_0x04@0x024C4454@ */ ECIPP_ALIGNMENT_UWORD 65535 Compu_IDENTITY 0 65535 PHYS_UNIT "System ID + DTC" /end CHARACTERISTIC
/begin CHARACTERISTIC FCdc4_TAUX3_min "FCtl_DTC_0x04(555)" VALUE 0x001E44EC /* @ECU_Address@FCtl_DTC_0x04@0x024C4456@ */ ECIPP_ALIGNMENT_UWORD 65535 Compu_IDENTITY 0 65535 PHYS_UNIT "System ID + DTC" /end CHARACTERISTIC
/begin CHARACTERISTIC FCdc4_TAUX4_max "FCtl_DTC_0x04(556)" VALUE 0x001E44EE /* @ECU_Address@FCtl_DTC_0x04@0x024C4458@ */ ECIPP_ALIGNMENT_UWORD 65535 Compu_IDENTITY 0 65535 PHYS_UNIT "System ID + DTC" /end CHARACTERISTIC
/begin CHARACTERISTIC FCdc4_TAUX4_min "FCtl_DTC_0x04(557)" VALUE 0x001E44F0 /* @ECU_Address@FCtl_DTC_0x04@0x024C445A@ */ ECIPP_ALIGNMENT_UWORD 65535 Compu_IDENTITY 0 65535 PHYS_UNIT "System ID + DTC" /end CHARACTERISTIC
/begin CHARACTERISTIC FCdc4_TEL_derate_actv "FCtl_DTC_0x04(647)" VALUE 0x001E45A4 /* @ECU_Address@FCtl_DTC_0x04@0x024C450E@ */ ECIPP_ALIGNMENT_UWORD 65535 Compu_IDENTITY 0 65535 PHYS_UNIT "System ID + DTC" /end CHARACTERISTIC
/begin CHARACTERISTIC FCdc4_TEL_dis "FCtl_DTC_0x04(854)" VALUE 0x001E4742 /* @ECU_Address@FCtl_DTC_0x04@0x024C46AC@ */ ECIPP_ALIGNMENT_UWORD 65535 Compu_IDENTITY 0 65535 PHYS_UNIT "System ID + DTC" /end CHARACTERISTIC
/begin CHARACTERISTIC FCdc4_TEL_intF "FCtl_DTC_0x04(855)" VALUE 0x001E4744 /* @ECU_Address@FCtl_DTC_0x04@0x024C46AE@ */ ECIPP_ALIGNMENT_UWORD 65535 Compu_IDENTITY 0 65535 PHYS_UNIT "System ID + DTC" /end CHARACTERISTIC
/begin CHARACTERISTIC FCdc4_TEL_key_invalid "FCtl_DTC_0x04(821)" VALUE 0x001E4700 /* @ECU_Address@FCtl_DTC_0x04@0x024C466A@ */ ECIPP_ALIGNMENT_UWORD 65535 Compu_IDENTITY 0 65535 PHYS_UNIT "System ID + DTC" /end CHARACTERISTIC
/begin CHARACTERISTIC FCdc4_TEL_key_to "FCtl_DTC_0x04(820)" VALUE 0x001E46FE /* @ECU_Address@FCtl_DTC_0x04@0x024C4668@ */ ECIPP_ALIGNMENT_UWORD 65535 Compu_IDENTITY 0 65535 PHYS_UNIT "System ID + DTC" /end CHARACTERISTIC
/begin CHARACTERISTIC FCdc4_TEL_req_to "FCtl_DTC_0x04(819)" VALUE 0x001E46FC /* @ECU_Address@FCtl_DTC_0x04@0x024C4666@ */ ECIPP_ALIGNMENT_UWORD 65535 Compu_IDENTITY 0 65535 PHYS_UNIT "System ID + DTC" /end CHARACTERISTIC
/begin CHARACTERISTIC FCdc4_TEL_RPM_cmd "FCtl_DTC_0x04(822)" VALUE 0x001E4702 /* @ECU_Address@FCtl_DTC_0x04@0x024C466C@ */ ECIPP_ALIGNMENT_UWORD 65535 Compu_IDENTITY 0 65535 PHYS_UNIT "System ID + DTC" /end CHARACTERISTIC
/begin CHARACTERISTIC FCdc4_TEL_RPM_psv "FCtl_DTC_0x04(825)" VALUE 0x001E4708 /* @ECU_Address@FCtl_DTC_0x04@0x024C4672@ */ ECIPP_ALIGNMENT_UWORD 65535 Compu_IDENTITY 0 65535 PHYS_UNIT "System ID + DTC" /end CHARACTERISTIC
/begin CHARACTERISTIC FCdc4_TEL_shutdown_cmd "FCtl_DTC_0x04(824)" VALUE 0x001E4706 /* @ECU_Address@FCtl_DTC_0x04@0x024C4670@ */ ECIPP_ALIGNMENT_UWORD 65535 Compu_IDENTITY 0 65535 PHYS_UNIT "System ID + DTC" /end CHARACTERISTIC
/begin CHARACTERISTIC FCdc4_TEL_shutdown_psv "FCtl_DTC_0x04(827)" VALUE 0x001E470C /* @ECU_Address@FCtl_DTC_0x04@0x024C4676@ */ ECIPP_ALIGNMENT_UWORD 65535 Compu_IDENTITY 0 65535 PHYS_UNIT "System ID + DTC" /end CHARACTERISTIC
/begin CHARACTERISTIC FCdc4_TEL_torq_cmd "FCtl_DTC_0x04(823)" VALUE 0x001E4704 /* @ECU_Address@FCtl_DTC_0x04@0x024C466E@ */ ECIPP_ALIGNMENT_UWORD 65535 Compu_IDENTITY 0 65535 PHYS_UNIT "System ID + DTC" /end CHARACTERISTIC
/begin CHARACTERISTIC FCdc4_TEL_torq_psv "FCtl_DTC_0x04(826)" VALUE 0x001E470A /* @ECU_Address@FCtl_DTC_0x04@0x024C4674@ */ ECIPP_ALIGNMENT_UWORD 65535 Compu_IDENTITY 0 65535 PHYS_UNIT "System ID + DTC" /end CHARACTERISTIC
/begin CHARACTERISTIC FCdc4_TIP_act "FCtl_DTC_0x04(145)" VALUE 0x001E41B8 /* @ECU_Address@FCtl_DTC_0x04@0x024C4122@ */ ECIPP_ALIGNMENT_UWORD 65535 Compu_IDENTITY 0 65535 PHYS_UNIT "System ID + DTC" /end CHARACTERISTIC
/begin CHARACTERISTIC FCdc4_TIP_maxv "FCtl_DTC_0x04(126)" VALUE 0x001E4192 /* @ECU_Address@FCtl_DTC_0x04@0x024C40FC@ */ ECIPP_ALIGNMENT_UWORD 65535 Compu_IDENTITY 0 65535 PHYS_UNIT "System ID + DTC" /end CHARACTERISTIC
/begin CHARACTERISTIC FCdc4_TIP_minv "FCtl_DTC_0x04(127)" VALUE 0x001E4194 /* @ECU_Address@FCtl_DTC_0x04@0x024C40FE@ */ ECIPP_ALIGNMENT_UWORD 65535 Compu_IDENTITY 0 65535 PHYS_UNIT "System ID + DTC" /end CHARACTERISTIC
/begin CHARACTERISTIC FCdc4_TPS1_max "FCtl_DTC_0x04(13)" VALUE 0x001E40B0 /* @ECU_Address@FCtl_DTC_0x04@0x024C401A@ */ ECIPP_ALIGNMENT_UWORD 65535 Compu_IDENTITY 0 65535 PHYS_UNIT "System ID + DTC" /end CHARACTERISTIC
/begin CHARACTERISTIC FCdc4_TPS1_min "FCtl_DTC_0x04(14)" VALUE 0x001E40B2 /* @ECU_Address@FCtl_DTC_0x04@0x024C401C@ */ ECIPP_ALIGNMENT_UWORD 65535 Compu_IDENTITY 0 65535 PHYS_UNIT "System ID + DTC" /end CHARACTERISTIC
/begin CHARACTERISTIC FCdc4_TPS12_OOR "FCtl_DTC_0x04(186)" VALUE 0x001E420A /* @ECU_Address@FCtl_DTC_0x04@0x024C4174@ */ ECIPP_ALIGNMENT_UWORD 65535 Compu_IDENTITY 0 65535 PHYS_UNIT "System ID + DTC" /end CHARACTERISTIC
/begin CHARACTERISTIC FCdc4_TPS12pct_hi "FCtl_DTC_0x04(17)" VALUE 0x001E40B8 /* @ECU_Address@FCtl_DTC_0x04@0x024C4022@ */ ECIPP_ALIGNMENT_UWORD 65535 Compu_IDENTITY 0 65535 PHYS_UNIT "System ID + DTC" /end CHARACTERISTIC
/begin CHARACTERISTIC FCdc4_TPS12pct_lo "FCtl_DTC_0x04(18)" VALUE 0x001E40BA /* @ECU_Address@FCtl_DTC_0x04@0x024C4024@ */ ECIPP_ALIGNMENT_UWORD 65535 Compu_IDENTITY 0 65535 PHYS_UNIT "System ID + DTC" /end CHARACTERISTIC
/begin CHARACTERISTIC FCdc4_TPS2_max "FCtl_DTC_0x04(15)" VALUE 0x001E40B4 /* @ECU_Address@FCtl_DTC_0x04@0x024C401E@ */ ECIPP_ALIGNMENT_UWORD 65535 Compu_IDENTITY 0 65535 PHYS_UNIT "System ID + DTC" /end CHARACTERISTIC
/begin CHARACTERISTIC FCdc4_TPS2_min "FCtl_DTC_0x04(16)" VALUE 0x001E40B6 /* @ECU_Address@FCtl_DTC_0x04@0x024C4020@ */ ECIPP_ALIGNMENT_UWORD 65535 Compu_IDENTITY 0 65535 PHYS_UNIT "System ID + DTC" /end CHARACTERISTIC
/begin CHARACTERISTIC FCdc4_TPSerr_neg "FCtl_DTC_0x04(91)" VALUE 0x001E414C /* @ECU_Address@FCtl_DTC_0x04@0x024C40B6@ */ ECIPP_ALIGNMENT_UWORD 65535 Compu_IDENTITY 0 65535 PHYS_UNIT "System ID + DTC" /end CHARACTERISTIC
/begin CHARACTERISTIC FCdc4_TPSerr_pos "FCtl_DTC_0x04(90)" VALUE 0x001E414A /* @ECU_Address@FCtl_DTC_0x04@0x024C40B4@ */ ECIPP_ALIGNMENT_UWORD 65535 Compu_IDENTITY 0 65535 PHYS_UNIT "System ID + DTC" /end CHARACTERISTIC
/begin CHARACTERISTIC FCdc4_TRANS_comm "FCtl_DTC_0x04(851)" VALUE 0x001E473C /* @ECU_Address@FCtl_DTC_0x04@0x024C46A6@ */ ECIPP_ALIGNMENT_UWORD 65535 Compu_IDENTITY 0 65535 PHYS_UNIT "System ID + DTC" /end CHARACTERISTIC
/begin CHARACTERISTIC FCdc4_TRANS_fuel_inh "FCtl_DTC_0x04(852)" VALUE 0x001E473E /* @ECU_Address@FCtl_DTC_0x04@0x024C46A8@ */ ECIPP_ALIGNMENT_UWORD 65535 Compu_IDENTITY 0 65535 PHYS_UNIT "System ID + DTC" /end CHARACTERISTIC
/begin CHARACTERISTIC FCdc4_TWCDiag_OSC_lo "FCtl_DTC_0x04(804)" VALUE 0x001E46DE /* @ECU_Address@FCtl_DTC_0x04@0x024C4648@ */ ECIPP_ALIGNMENT_UWORD 65535 Compu_IDENTITY 0 65535 PHYS_UNIT "System ID + DTC" /end CHARACTERISTIC
/begin CHARACTERISTIC FCdc4_UEGOH1_off_open "FCtl_DTC_0x04(427)" VALUE 0x001E43EC /* @ECU_Address@FCtl_DTC_0x04@0x024C4356@ */ ECIPP_ALIGNMENT_UWORD 65535 Compu_IDENTITY 0 65535 PHYS_UNIT "System ID + DTC" /end CHARACTERISTIC
/begin CHARACTERISTIC FCdc4_UEGOH1_on_short "FCtl_DTC_0x04(428)" VALUE 0x001E43EE /* @ECU_Address@FCtl_DTC_0x04@0x024C4358@ */ ECIPP_ALIGNMENT_UWORD 65535 Compu_IDENTITY 0 65535 PHYS_UNIT "System ID + DTC" /end CHARACTERISTIC
/begin CHARACTERISTIC FCdc4_UEGOH2_off_open "FCtl_DTC_0x04(429)" VALUE 0x001E43F0 /* @ECU_Address@FCtl_DTC_0x04@0x024C435A@ */ ECIPP_ALIGNMENT_UWORD 65535 Compu_IDENTITY 0 65535 PHYS_UNIT "System ID + DTC" /end CHARACTERISTIC
/begin CHARACTERISTIC FCdc4_UEGOH2_on_short "FCtl_DTC_0x04(430)" VALUE 0x001E43F2 /* @ECU_Address@FCtl_DTC_0x04@0x024C435C@ */ ECIPP_ALIGNMENT_UWORD 65535 Compu_IDENTITY 0 65535 PHYS_UNIT "System ID + DTC" /end CHARACTERISTIC
/begin CHARACTERISTIC FCdc4_UEGOH3_off_open "FCtl_DTC_0x04(622)" VALUE 0x001E4572 /* @ECU_Address@FCtl_DTC_0x04@0x024C44DC@ */ ECIPP_ALIGNMENT_UWORD 65535 Compu_IDENTITY 0 65535 PHYS_UNIT "System ID + DTC" /end CHARACTERISTIC
/begin CHARACTERISTIC FCdc4_UEGOH3_on_short "FCtl_DTC_0x04(623)" VALUE 0x001E4574 /* @ECU_Address@FCtl_DTC_0x04@0x024C44DE@ */ ECIPP_ALIGNMENT_UWORD 65535 Compu_IDENTITY 0 65535 PHYS_UNIT "System ID + DTC" /end CHARACTERISTIC
/begin CHARACTERISTIC FCdc4_UEGOH4_off_open "FCtl_DTC_0x04(645)" VALUE 0x001E45A0 /* @ECU_Address@FCtl_DTC_0x04@0x024C450A@ */ ECIPP_ALIGNMENT_UWORD 65535 Compu_IDENTITY 0 65535 PHYS_UNIT "System ID + DTC" /end CHARACTERISTIC
/begin CHARACTERISTIC FCdc4_UEGOH4_on_short "FCtl_DTC_0x04(646)" VALUE 0x001E45A2 /* @ECU_Address@FCtl_DTC_0x04@0x024C450C@ */ ECIPP_ALIGNMENT_UWORD 65535 Compu_IDENTITY 0 65535 PHYS_UNIT "System ID + DTC" /end CHARACTERISTIC
/begin CHARACTERISTIC FCdc4_UGF_Hv_hi "FCtl_DTC_0x04(242)" VALUE 0x001E427A /* @ECU_Address@FCtl_DTC_0x04@0x024C41E4@ */ ECIPP_ALIGNMENT_UWORD 65535 Compu_IDENTITY 0 65535 PHYS_UNIT "System ID + DTC" /end CHARACTERISTIC
/begin CHARACTERISTIC FCdc4_UGF_internal "FCtl_DTC_0x04(241)" VALUE 0x001E4278 /* @ECU_Address@FCtl_DTC_0x04@0x024C41E2@ */ ECIPP_ALIGNMENT_UWORD 65535 Compu_IDENTITY 0 65535 PHYS_UNIT "System ID + DTC" /end CHARACTERISTIC
/begin CHARACTERISTIC FCdc4_UGF_lowsupply "FCtl_DTC_0x04(530)" VALUE 0x001E44BA /* @ECU_Address@FCtl_DTC_0x04@0x024C4424@ */ ECIPP_ALIGNMENT_UWORD 65535 Compu_IDENTITY 0 65535 PHYS_UNIT "System ID + DTC" /end CHARACTERISTIC
/begin CHARACTERISTIC FCdc4_UGF1_comm_lost "FCtl_DTC_0x04(680)" VALUE 0x001E45E6 /* @ECU_Address@FCtl_DTC_0x04@0x024C4550@ */ ECIPP_ALIGNMENT_UWORD 65535 Compu_IDENTITY 0 65535 PHYS_UNIT "System ID + DTC" /end CHARACTERISTIC
/begin CHARACTERISTIC FCdc4_UGF1_drifttl2 "FCtl_DTC_0x04(536)" VALUE 0x001E44C6 /* @ECU_Address@FCtl_DTC_0x04@0x024C4430@ */ ECIPP_ALIGNMENT_UWORD 65535 Compu_IDENTITY 0 65535 PHYS_UNIT "System ID + DTC" /end CHARACTERISTIC
/begin CHARACTERISTIC FCdc4_UGF1_drifttol "FCtl_DTC_0x04(505)" VALUE 0x001E4488 /* @ECU_Address@FCtl_DTC_0x04@0x024C43F2@ */ ECIPP_ALIGNMENT_UWORD 65535 Compu_IDENTITY 0 65535 PHYS_UNIT "System ID + DTC" /end CHARACTERISTIC
/begin CHARACTERISTIC FCdc4_UGF1_R_hi "FCtl_DTC_0x04(244)" VALUE 0x001E427E /* @ECU_Address@FCtl_DTC_0x04@0x024C41E8@ */ ECIPP_ALIGNMENT_UWORD 65535 Compu_IDENTITY 0 65535 PHYS_UNIT "System ID + DTC" /end CHARACTERISTIC
/begin CHARACTERISTIC FCdc4_UGF1_SR_hi "FCtl_DTC_0x04(256)" VALUE 0x001E4296 /* @ECU_Address@FCtl_DTC_0x04@0x024C4200@ */ ECIPP_ALIGNMENT_UWORD 65535 Compu_IDENTITY 0 65535 PHYS_UNIT "System ID + DTC" /end CHARACTERISTIC
/begin CHARACTERISTIC FCdc4_UGF1_SR_slow "FCtl_DTC_0x04(254)" VALUE 0x001E4292 /* @ECU_Address@FCtl_DTC_0x04@0x024C41FC@ */ ECIPP_ALIGNMENT_UWORD 65535 Compu_IDENTITY 0 65535 PHYS_UNIT "System ID + DTC" /end CHARACTERISTIC
/begin CHARACTERISTIC FCdc4_UGF1_Sv_hi "FCtl_DTC_0x04(250)" VALUE 0x001E428A /* @ECU_Address@FCtl_DTC_0x04@0x024C41F4@ */ ECIPP_ALIGNMENT_UWORD 65535 Compu_IDENTITY 0 65535 PHYS_UNIT "System ID + DTC" /end CHARACTERISTIC
/begin CHARACTERISTIC FCdc4_UGF2_comm_lost "FCtl_DTC_0x04(681)" VALUE 0x001E45E8 /* @ECU_Address@FCtl_DTC_0x04@0x024C4552@ */ ECIPP_ALIGNMENT_UWORD 65535 Compu_IDENTITY 0 65535 PHYS_UNIT "System ID + DTC" /end CHARACTERISTIC
/begin CHARACTERISTIC FCdc4_UGF2_drifttl2 "FCtl_DTC_0x04(537)" VALUE 0x001E44C8 /* @ECU_Address@FCtl_DTC_0x04@0x024C4432@ */ ECIPP_ALIGNMENT_UWORD 65535 Compu_IDENTITY 0 65535 PHYS_UNIT "System ID + DTC" /end CHARACTERISTIC
/begin CHARACTERISTIC FPnd_start_coilshort "FPrm_pending(123)" VALUE 0x001E5208 /* @ECU_Address@FPrm_pending@0x021BE0F6@ */ ECIPP_ALIGNMENT_UWORD 65535 Compu_IDENTITY 0 65535 PHYS_UNIT "Bit Mask" /end CHARACTERISTIC
/begin CHARACTERISTIC FPnd_start_excess "FPrm_pending(667)" VALUE 0x001E5648 /* @ECU_Address@FPrm_pending@0x021BE536@ */ ECIPP_ALIGNMENT_UWORD 65535 Compu_IDENTITY 0 65535 PHYS_UNIT "Bit Mask" /end CHARACTERISTIC
/begin CHARACTERISTIC FPnd_start_gndshort "FPrm_pending(121)" VALUE 0x001E5204 /* @ECU_Address@FPrm_pending@0x021BE0F2@ */ ECIPP_ALIGNMENT_UWORD 65535 Compu_IDENTITY 0 65535 PHYS_UNIT "Bit Mask" /end CHARACTERISTIC
/begin CHARACTERISTIC FPnd_start_stuck_active "FPrm_pending(229)" VALUE 0x001E52DC /* @ECU_Address@FPrm_pending@0x021BE1CA@ */ ECIPP_ALIGNMENT_UWORD 65535 Compu_IDENTITY 0 65535 PHYS_UNIT "Bit Mask" /end CHARACTERISTIC
/begin CHARACTERISTIC FPnd_SubDiagTemp "FPrm_pending(483)" VALUE 0x001E54D8 /* @ECU_Address@FPrm_pending@0x021BE3C6@ */ ECIPP_ALIGNMENT_UWORD 65535 Compu_IDENTITY 0 65535 PHYS_UNIT "Bit Mask" /end CHARACTERISTIC
/begin CHARACTERISTIC FPnd_tach_gndshort "FPrm_pending(133)" VALUE 0x001E521C /* @ECU_Address@FPrm_pending@0x021BE10A@ */ ECIPP_ALIGNMENT_UWORD 65535 Compu_IDENTITY 0 65535 PHYS_UNIT "Bit Mask" /end CHARACTERISTIC
/begin CHARACTERISTIC FPnd_tach_pwrshort "FPrm_pending(134)" VALUE 0x001E521E /* @ECU_Address@FPrm_pending@0x021BE10C@ */ ECIPP_ALIGNMENT_UWORD 65535 Compu_IDENTITY 0 65535 PHYS_UNIT "Bit Mask" /end CHARACTERISTIC
/begin CHARACTERISTIC FPnd_TANK_1_V_maxv "FPrm_pending(698)" VALUE 0x001E5686 /* @ECU_Address@FPrm_pending@0x021BE574@ */ ECIPP_ALIGNMENT_UWORD 65535 Compu_IDENTITY 0 65535 PHYS_UNIT "Bit Mask" /end CHARACTERISTIC
/begin CHARACTERISTIC FPnd_TANK_1_V_minv "FPrm_pending(699)" VALUE 0x001E5688 /* @ECU_Address@FPrm_pending@0x021BE576@ */ ECIPP_ALIGNMENT_UWORD 65535 Compu_IDENTITY 0 65535 PHYS_UNIT "Bit Mask" /end CHARACTERISTIC
/begin CHARACTERISTIC FPnd_TANK_1_V_slow "FPrm_pending(700)" VALUE 0x001E568A /* @ECU_Address@FPrm_pending@0x021BE578@ */ ECIPP_ALIGNMENT_UWORD 65535 Compu_IDENTITY 0 65535 PHYS_UNIT "Bit Mask" /end CHARACTERISTIC
/begin CHARACTERISTIC FPnd_TAUX_dT1_max "FPrm_pending(428)" VALUE 0x001E546A /* @ECU_Address@FPrm_pending@0x021BE358@ */ ECIPP_ALIGNMENT_UWORD 65535 Compu_IDENTITY 0 65535 PHYS_UNIT "Bit Mask" /end CHARACTERISTIC
/begin CHARACTERISTIC FPnd_TAUX_dT1_min "FPrm_pending(429)" VALUE 0x001E546C /* @ECU_Address@FPrm_pending@0x021BE35A@ */ ECIPP_ALIGNMENT_UWORD 65535 Compu_IDENTITY 0 65535 PHYS_UNIT "Bit Mask" /end CHARACTERISTIC
/begin CHARACTERISTIC FPnd_TAUX_dT2_max "FPrm_pending(430)" VALUE 0x001E546E /* @ECU_Address@FPrm_pending@0x021BE35C@ */ ECIPP_ALIGNMENT_UWORD 65535 Compu_IDENTITY 0 65535 PHYS_UNIT "Bit Mask" /end CHARACTERISTIC
/begin CHARACTERISTIC FPnd_TAUX_dT2_min "FPrm_pending(431)" VALUE 0x001E5470 /* @ECU_Address@FPrm_pending@0x021BE35E@ */ ECIPP_ALIGNMENT_UWORD 65535 Compu_IDENTITY 0 65535 PHYS_UNIT "Bit Mask" /end CHARACTERISTIC
/begin CHARACTERISTIC FPnd_Taux1_derate_actv "FPrm_pending(639)" VALUE 0x001E5610 /* @ECU_Address@FPrm_pending@0x021BE4FE@ */ ECIPP_ALIGNMENT_UWORD 65535 Compu_IDENTITY 0 65535 PHYS_UNIT "Bit Mask" /end CHARACTERISTIC
/begin CHARACTERISTIC FPnd_TAUX1_max "FPrm_pending(420)" VALUE 0x001E545A /* @ECU_Address@FPrm_pending@0x021BE348@ */ ECIPP_ALIGNMENT_UWORD 65535 Compu_IDENTITY 0 65535 PHYS_UNIT "Bit Mask" /end CHARACTERISTIC
/begin CHARACTERISTIC FPnd_TAUX1_min "FPrm_pending(421)" VALUE 0x001E545C /* @ECU_Address@FPrm_pending@0x021BE34A@ */ ECIPP_ALIGNMENT_UWORD 65535 Compu_IDENTITY 0 65535 PHYS_UNIT "Bit Mask" /end CHARACTERISTIC
/begin CHARACTERISTIC FPnd_Taux2_derate_actv "FPrm_pending(640)" VALUE 0x001E5612 /* @ECU_Address@FPrm_pending@0x021BE500@ */ ECIPP_ALIGNMENT_UWORD 65535 Compu_IDENTITY 0 65535 PHYS_UNIT "Bit Mask" /end CHARACTERISTIC
/begin CHARACTERISTIC FPnd_TAUX2_max "FPrm_pending(422)" VALUE 0x001E545E /* @ECU_Address@FPrm_pending@0x021BE34C@ */ ECIPP_ALIGNMENT_UWORD 65535 Compu_IDENTITY 0 65535 PHYS_UNIT "Bit Mask" /end CHARACTERISTIC
/begin CHARACTERISTIC FPnd_TAUX2_min "FPrm_pending(423)" VALUE 0x001E5460 /* @ECU_Address@FPrm_pending@0x021BE34E@ */ ECIPP_ALIGNMENT_UWORD 65535 Compu_IDENTITY 0 65535 PHYS_UNIT "Bit Mask" /end CHARACTERISTIC
/begin CHARACTERISTIC FPnd_TAUX3_max "FPrm_pending(424)" VALUE 0x001E5462 /* @ECU_Address@FPrm_pending@0x021BE350@ */ ECIPP_ALIGNMENT_UWORD 65535 Compu_IDENTITY 0 65535 PHYS_UNIT "Bit Mask" /end CHARACTERISTIC
/begin CHARACTERISTIC FPnd_TAUX3_min "FPrm_pending(425)" VALUE 0x001E5464 /* @ECU_Address@FPrm_pending@0x021BE352@ */ ECIPP_ALIGNMENT_UWORD 65535 Compu_IDENTITY 0 65535 PHYS_UNIT "Bit Mask" /end CHARACTERISTIC
/begin CHARACTERISTIC FPnd_TAUX4_max "FPrm_pending(426)" VALUE 0x001E5466 /* @ECU_Address@FPrm_pending@0x021BE354@ */ ECIPP_ALIGNMENT_UWORD 65535 Compu_IDENTITY 0 65535 PHYS_UNIT "Bit Mask" /end CHARACTERISTIC
/begin CHARACTERISTIC FPnd_TAUX4_min "FPrm_pending(427)" VALUE 0x001E5468 /* @ECU_Address@FPrm_pending@0x021BE356@ */ ECIPP_ALIGNMENT_UWORD 65535 Compu_IDENTITY 0 65535 PHYS_UNIT "Bit Mask" /end CHARACTERISTIC
/begin CHARACTERISTIC FPnd_TEL_derate_actv "FPrm_pending(477)" VALUE 0x001E54CC /* @ECU_Address@FPrm_pending@0x021BE3BA@ */ ECIPP_ALIGNMENT_UWORD 65535 Compu_IDENTITY 0 65535 PHYS_UNIT "Bit Mask" /end CHARACTERISTIC
/begin CHARACTERISTIC FPnd_TEL_dis "FPrm_pending(681)" VALUE 0x001E5664 /* @ECU_Address@FPrm_pending@0x021BE552@ */ ECIPP_ALIGNMENT_UWORD 65535 Compu_IDENTITY 0 65535 PHYS_UNIT "Bit Mask" /end CHARACTERISTIC
/begin CHARACTERISTIC FPnd_TEL_intF "FPrm_pending(682)" VALUE 0x001E5666 /* @ECU_Address@FPrm_pending@0x021BE554@ */ ECIPP_ALIGNMENT_UWORD 65535 Compu_IDENTITY 0 65535 PHYS_UNIT "Bit Mask" /end CHARACTERISTIC
/begin CHARACTERISTIC FPnd_TEL_key_invalid "FPrm_pending(648)" VALUE 0x001E5622 /* @ECU_Address@FPrm_pending@0x021BE510@ */ ECIPP_ALIGNMENT_UWORD 65535 Compu_IDENTITY 0 65535 PHYS_UNIT "Bit Mask" /end CHARACTERISTIC
/begin CHARACTERISTIC FPnd_TEL_key_to "FPrm_pending(647)" VALUE 0x001E5620 /* @ECU_Address@FPrm_pending@0x021BE50E@ */ ECIPP_ALIGNMENT_UWORD 65535 Compu_IDENTITY 0 65535 PHYS_UNIT "Bit Mask" /end CHARACTERISTIC
/begin CHARACTERISTIC FPnd_TEL_req_to "FPrm_pending(646)" VALUE 0x001E561E /* @ECU_Address@FPrm_pending@0x021BE50C@ */ ECIPP_ALIGNMENT_UWORD 65535 Compu_IDENTITY 0 65535 PHYS_UNIT "Bit Mask" /end CHARACTERISTIC
/begin CHARACTERISTIC FPnd_TEL_RPM_cmd "FPrm_pending(649)" VALUE 0x001E5624 /* @ECU_Address@FPrm_pending@0x021BE512@ */ ECIPP_ALIGNMENT_UWORD 65535 Compu_IDENTITY 0 65535 PHYS_UNIT "Bit Mask" /end CHARACTERISTIC
/begin CHARACTERISTIC FPnd_TEL_RPM_psv "FPrm_pending(652)" VALUE 0x001E562A /* @ECU_Address@FPrm_pending@0x021BE518@ */ ECIPP_ALIGNMENT_UWORD 65535 Compu_IDENTITY 0 65535 PHYS_UNIT "Bit Mask" /end CHARACTERISTIC
/begin CHARACTERISTIC FPnd_TEL_shutdown_cmd "FPrm_pending(651)" VALUE 0x001E5628 /* @ECU_Address@FPrm_pending@0x021BE516@ */ ECIPP_ALIGNMENT_UWORD 65535 Compu_IDENTITY 0 65535 PHYS_UNIT "Bit Mask" /end CHARACTERISTIC
/begin CHARACTERISTIC FPnd_TEL_shutdown_psv "FPrm_pending(654)" VALUE 0x001E562E /* @ECU_Address@FPrm_pending@0x021BE51C@ */ ECIPP_ALIGNMENT_UWORD 65535 Compu_IDENTITY 0 65535 PHYS_UNIT "Bit Mask" /end CHARACTERISTIC
/begin CHARACTERISTIC FPnd_TEL_torq_cmd "FPrm_pending(650)" VALUE 0x001E5626 /* @ECU_Address@FPrm_pending@0x021BE514@ */ ECIPP_ALIGNMENT_UWORD 65535 Compu_IDENTITY 0 65535 PHYS_UNIT "Bit Mask" /end CHARACTERISTIC
/begin CHARACTERISTIC FPnd_TEL_torq_psv "FPrm_pending(653)" VALUE 0x001E562C /* @ECU_Address@FPrm_pending@0x021BE51A@ */ ECIPP_ALIGNMENT_UWORD 65535 Compu_IDENTITY 0 65535 PHYS_UNIT "Bit Mask" /end CHARACTERISTIC
/begin CHARACTERISTIC FPnd_TIP_act "FPrm_pending(105)" VALUE 0x001E51E4 /* @ECU_Address@FPrm_pending@0x021BE0D2@ */ ECIPP_ALIGNMENT_UWORD 65535 Compu_IDENTITY 0 65535 PHYS_UNIT "Bit Mask" /end CHARACTERISTIC
/begin CHARACTERISTIC FPnd_TIP_maxv "FPrm_pending(85)" VALUE 0x001E51BC /* @ECU_Address@FPrm_pending@0x021BE0AA@ */ ECIPP_ALIGNMENT_UWORD 65535 Compu_IDENTITY 0 65535 PHYS_UNIT "Bit Mask" /end CHARACTERISTIC
/begin CHARACTERISTIC FPnd_TIP_minv "FPrm_pending(86)" VALUE 0x001E51BE /* @ECU_Address@FPrm_pending@0x021BE0AC@ */ ECIPP_ALIGNMENT_UWORD 65535 Compu_IDENTITY 0 65535 PHYS_UNIT "Bit Mask" /end CHARACTERISTIC
/begin CHARACTERISTIC FPnd_TPS1_max "FPrm_pending(18)" VALUE 0x001E5136 /* @ECU_Address@FPrm_pending@0x021BE024@ */ ECIPP_ALIGNMENT_UWORD 65535 Compu_IDENTITY 0 65535 PHYS_UNIT "Bit Mask" /end CHARACTERISTIC
/begin CHARACTERISTIC FPnd_TPS1_min "FPrm_pending(19)" VALUE 0x001E5138 /* @ECU_Address@FPrm_pending@0x021BE026@ */ ECIPP_ALIGNMENT_UWORD 65535 Compu_IDENTITY 0 65535 PHYS_UNIT "Bit Mask" /end CHARACTERISTIC
/begin CHARACTERISTIC FPnd_TPS12_OOR "FPrm_pending(144)" VALUE 0x001E5232 /* @ECU_Address@FPrm_pending@0x021BE120@ */ ECIPP_ALIGNMENT_UWORD 65535 Compu_IDENTITY 0 65535 PHYS_UNIT "Bit Mask" /end CHARACTERISTIC
/begin CHARACTERISTIC FPnd_TPS12pct_hi "FPrm_pending(22)" VALUE 0x001E513E /* @ECU_Address@FPrm_pending@0x021BE02C@ */ ECIPP_ALIGNMENT_UWORD 65535 Compu_IDENTITY 0 65535 PHYS_UNIT "Bit Mask" /end CHARACTERISTIC
/begin CHARACTERISTIC FPnd_TPS12pct_lo "FPrm_pending(23)" VALUE 0x001E5140 /* @ECU_Address@FPrm_pending@0x021BE02E@ */ ECIPP_ALIGNMENT_UWORD 65535 Compu_IDENTITY 0 65535 PHYS_UNIT "Bit Mask" /end CHARACTERISTIC
/begin CHARACTERISTIC FPnd_TPS2_max "FPrm_pending(20)" VALUE 0x001E513A /* @ECU_Address@FPrm_pending@0x021BE028@ */ ECIPP_ALIGNMENT_UWORD 65535 Compu_IDENTITY 0 65535 PHYS_UNIT "Bit Mask" /end CHARACTERISTIC
/begin CHARACTERISTIC FPnd_TPS2_min "FPrm_pending(21)" VALUE 0x001E513C /* @ECU_Address@FPrm_pending@0x021BE02A@ */ ECIPP_ALIGNMENT_UWORD 65535 Compu_IDENTITY 0 65535 PHYS_UNIT "Bit Mask" /end CHARACTERISTIC
/begin CHARACTERISTIC FPnd_TPSerr_neg "FPrm_pending(25)" VALUE 0x001E5144 /* @ECU_Address@FPrm_pending@0x021BE032@ */ ECIPP_ALIGNMENT_UWORD 65535 Compu_IDENTITY 0 65535 PHYS_UNIT "Bit Mask" /end CHARACTERISTIC
/begin CHARACTERISTIC FPnd_TPSerr_pos "FPrm_pending(24)" VALUE 0x001E5142 /* @ECU_Address@FPrm_pending@0x021BE030@ */ ECIPP_ALIGNMENT_UWORD 65535 Compu_IDENTITY 0 65535 PHYS_UNIT "Bit Mask" /end CHARACTERISTIC
/begin CHARACTERISTIC FPnd_TRANS_comm "FPrm_pending(678)" VALUE 0x001E565E /* @ECU_Address@FPrm_pending@0x021BE54C@ */ ECIPP_ALIGNMENT_UWORD 65535 Compu_IDENTITY 0 65535 PHYS_UNIT "Bit Mask" /end CHARACTERISTIC
/begin CHARACTERISTIC FPnd_TRANS_fuel_inh "FPrm_pending(679)" VALUE 0x001E5660 /* @ECU_Address@FPrm_pending@0x021BE54E@ */ ECIPP_ALIGNMENT_UWORD 65535 Compu_IDENTITY 0 65535 PHYS_UNIT "Bit Mask" /end CHARACTERISTIC
/begin CHARACTERISTIC FPnd_TWCDiag_OSC_lo "FPrm_pending(633)" VALUE 0x001E5604 /* @ECU_Address@FPrm_pending@0x021BE4F2@ */ ECIPP_ALIGNMENT_UWORD 65535 Compu_IDENTITY 0 65535 PHYS_UNIT "Bit Mask" /end CHARACTERISTIC
/begin CHARACTERISTIC FPnd_UEGOH1_off_open "FPrm_pending(324)" VALUE 0x001E539A /* @ECU_Address@FPrm_pending@0x021BE288@ */ ECIPP_ALIGNMENT_UWORD 65535 Compu_IDENTITY 0 65535 PHYS_UNIT "Bit Mask" /end CHARACTERISTIC
/begin CHARACTERISTIC FPnd_UEGOH1_on_short "FPrm_pending(325)" VALUE 0x001E539C /* @ECU_Address@FPrm_pending@0x021BE28A@ */ ECIPP_ALIGNMENT_UWORD 65535 Compu_IDENTITY 0 65535 PHYS_UNIT "Bit Mask" /end CHARACTERISTIC
/begin CHARACTERISTIC FPnd_UEGOH2_off_open "FPrm_pending(326)" VALUE 0x001E539E /* @ECU_Address@FPrm_pending@0x021BE28C@ */ ECIPP_ALIGNMENT_UWORD 65535 Compu_IDENTITY 0 65535 PHYS_UNIT "Bit Mask" /end CHARACTERISTIC
/begin CHARACTERISTIC FPnd_UEGOH2_on_short "FPrm_pending(327)" VALUE 0x001E53A0 /* @ECU_Address@FPrm_pending@0x021BE28E@ */ ECIPP_ALIGNMENT_UWORD 65535 Compu_IDENTITY 0 65535 PHYS_UNIT "Bit Mask" /end CHARACTERISTIC
/begin CHARACTERISTIC FPnd_UEGOH3_off_open "FPrm_pending(464)" VALUE 0x001E54B2 /* @ECU_Address@FPrm_pending@0x021BE3A0@ */ ECIPP_ALIGNMENT_UWORD 65535 Compu_IDENTITY 0 65535 PHYS_UNIT "Bit Mask" /end CHARACTERISTIC
/begin CHARACTERISTIC FPnd_UEGOH3_on_short "FPrm_pending(465)" VALUE 0x001E54B4 /* @ECU_Address@FPrm_pending@0x021BE3A2@ */ ECIPP_ALIGNMENT_UWORD 65535 Compu_IDENTITY 0 65535 PHYS_UNIT "Bit Mask" /end CHARACTERISTIC
/begin CHARACTERISTIC FPnd_UEGOH4_off_open "FPrm_pending(475)" VALUE 0x001E54C8 /* @ECU_Address@FPrm_pending@0x021BE3B6@ */ ECIPP_ALIGNMENT_UWORD 65535 Compu_IDENTITY 0 65535 PHYS_UNIT "Bit Mask" /end CHARACTERISTIC
/begin CHARACTERISTIC FPnd_UEGOH4_on_short "FPrm_pending(476)" VALUE 0x001E54CA /* @ECU_Address@FPrm_pending@0x021BE3B8@ */ ECIPP_ALIGNMENT_UWORD 65535 Compu_IDENTITY 0 65535 PHYS_UNIT "Bit Mask" /end CHARACTERISTIC
/begin CHARACTERISTIC FPnd_UGF_Hv_hi "FPrm_pending(190)" VALUE 0x001E528E /* @ECU_Address@FPrm_pending@0x021BE17C@ */ ECIPP_ALIGNMENT_UWORD 65535 Compu_IDENTITY 0 65535 PHYS_UNIT "Bit Mask" /end CHARACTERISTIC
/begin CHARACTERISTIC FPnd_UGF_internal "FPrm_pending(189)" VALUE 0x001E528C /* @ECU_Address@FPrm_pending@0x021BE17A@ */ ECIPP_ALIGNMENT_UWORD 65535 Compu_IDENTITY 0 65535 PHYS_UNIT "Bit Mask" /end CHARACTERISTIC
/begin CHARACTERISTIC FPnd_UGF_lowsupply "FPrm_pending(400)" VALUE 0x001E5432 /* @ECU_Address@FPrm_pending@0x021BE320@ */ ECIPP_ALIGNMENT_UWORD 65535 Compu_IDENTITY 0 65535 PHYS_UNIT "Bit Mask" /end CHARACTERISTIC
/begin CHARACTERISTIC FPnd_UGF1_comm_lost "FPrm_pending(510)" VALUE 0x001E550E /* @ECU_Address@FPrm_pending@0x021BE3FC@ */ ECIPP_ALIGNMENT_UWORD 65535 Compu_IDENTITY 0 65535 PHYS_UNIT "Bit Mask" /end CHARACTERISTIC
/begin CHARACTERISTIC FPnd_UGF1_drifttl2 "FPrm_pending(406)" VALUE 0x001E543E /* @ECU_Address@FPrm_pending@0x021BE32C@ */ ECIPP_ALIGNMENT_UWORD 65535 Compu_IDENTITY 0 65535 PHYS_UNIT "Bit Mask" /end CHARACTERISTIC
/begin CHARACTERISTIC FPnd_UGF1_drifttol "FPrm_pending(384)" VALUE 0x001E5412 /* @ECU_Address@FPrm_pending@0x021BE300@ */ ECIPP_ALIGNMENT_UWORD 65535 Compu_IDENTITY 0 65535 PHYS_UNIT "Bit Mask" /end CHARACTERISTIC
/begin CHARACTERISTIC FPnd_UGF1_R_hi "FPrm_pending(191)" VALUE 0x001E5290 /* @ECU_Address@FPrm_pending@0x021BE17E@ */ ECIPP_ALIGNMENT_UWORD 65535 Compu_IDENTITY 0 65535 PHYS_UNIT "Bit Mask" /end CHARACTERISTIC
/begin CHARACTERISTIC FPnd_UGF1_SR_hi "FPrm_pending(194)" VALUE 0x001E5296 /* @ECU_Address@FPrm_pending@0x021BE184@ */ ECIPP_ALIGNMENT_UWORD 65535 Compu_IDENTITY 0 65535 PHYS_UNIT "Bit Mask" /end CHARACTERISTIC
/begin CHARACTERISTIC FPnd_UGF1_SR_slow "FPrm_pending(193)" VALUE 0x001E5294 /* @ECU_Address@FPrm_pending@0x021BE182@ */ ECIPP_ALIGNMENT_UWORD 65535 Compu_IDENTITY 0 65535 PHYS_UNIT "Bit Mask" /end CHARACTERISTIC
/begin CHARACTERISTIC FPnd_UGF1_Sv_hi "FPrm_pending(192)" VALUE 0x001E5292 /* @ECU_Address@FPrm_pending@0x021BE180@ */ ECIPP_ALIGNMENT_UWORD 65535 Compu_IDENTITY 0 65535 PHYS_UNIT "Bit Mask" /end CHARACTERISTIC
/begin CHARACTERISTIC FPnd_UGF2_comm_lost "FPrm_pending(511)" VALUE 0x001E5510 /* @ECU_Address@FPrm_pending@0x021BE3FE@ */ ECIPP_ALIGNMENT_UWORD 65535 Compu_IDENTITY 0 65535 PHYS_UNIT "Bit Mask" /end CHARACTERISTIC
/begin CHARACTERISTIC FPnd_UGF2_drifttl2 "FPrm_pending(407)" VALUE 0x001E5440 /* @ECU_Address@FPrm_pending@0x021BE32E@ */ ECIPP_ALIGNMENT_UWORD 65535 Compu_IDENTITY 0 65535 PHYS_UNIT "Bit Mask" /end CHARACTERISTIC
/begin CHARACTERISTIC FPsvr_start_coilshort "FPrm_severity(123)" VALUE 0x001E6890 /* @ECU_Address@FPrm_severity@0x024B307B@ */ ECIPP_ALIGNMENT_UBYTE 255 Compu_IDENTITY 0 255 PHYS_UNIT "Severity+Class" /end CHARACTERISTIC
/begin CHARACTERISTIC FPsvr_start_excess "FPrm_severity(667)" VALUE 0x001E6AB0 /* @ECU_Address@FPrm_severity@0x024B329B@ */ ECIPP_ALIGNMENT_UBYTE 255 Compu_IDENTITY 0 255 PHYS_UNIT "Severity+Class" /end CHARACTERISTIC
/begin CHARACTERISTIC FPsvr_start_gndshort "FPrm_severity(121)" VALUE 0x001E688E /* @ECU_Address@FPrm_severity@0x024B3079@ */ ECIPP_ALIGNMENT_UBYTE 255 Compu_IDENTITY 0 255 PHYS_UNIT "Severity+Class" /end CHARACTERISTIC
/begin CHARACTERISTIC FPsvr_start_stuck_active "FPrm_severity(229)" VALUE 0x001E68FA /* @ECU_Address@FPrm_severity@0x024B30E5@ */ ECIPP_ALIGNMENT_UBYTE 255 Compu_IDENTITY 0 255 PHYS_UNIT "Severity+Class" /end CHARACTERISTIC
/begin CHARACTERISTIC FPsvr_SubDiagTemp "FPrm_severity(483)" VALUE 0x001E69F8 /* @ECU_Address@FPrm_severity@0x024B31E3@ */ ECIPP_ALIGNMENT_UBYTE 255 Compu_IDENTITY 0 255 PHYS_UNIT "Severity+Class" /end CHARACTERISTIC
/begin CHARACTERISTIC FPsvr_tach_gndshort "FPrm_severity(133)" VALUE 0x001E689A /* @ECU_Address@FPrm_severity@0x024B3085@ */ ECIPP_ALIGNMENT_UBYTE 255 Compu_IDENTITY 0 255 PHYS_UNIT "Severity+Class" /end CHARACTERISTIC
/begin CHARACTERISTIC FPsvr_tach_pwrshort "FPrm_severity(134)" VALUE 0x001E689B /* @ECU_Address@FPrm_severity@0x024B3086@ */ ECIPP_ALIGNMENT_UBYTE 255 Compu_IDENTITY 0 255 PHYS_UNIT "Severity+Class" /end CHARACTERISTIC
/begin CHARACTERISTIC FPsvr_TANK_1_V_maxv "FPrm_severity(698)" VALUE 0x001E6ACF /* @ECU_Address@FPrm_severity@0x024B32BA@ */ ECIPP_ALIGNMENT_UBYTE 255 Compu_IDENTITY 0 255 PHYS_UNIT "Severity+Class" /end CHARACTERISTIC
/begin CHARACTERISTIC FPsvr_TANK_1_V_minv "FPrm_severity(699)" VALUE 0x001E6AD0 /* @ECU_Address@FPrm_severity@0x024B32BB@ */ ECIPP_ALIGNMENT_UBYTE 255 Compu_IDENTITY 0 255 PHYS_UNIT "Severity+Class" /end CHARACTERISTIC
/begin CHARACTERISTIC FPsvr_TANK_1_V_slow "FPrm_severity(700)" VALUE 0x001E6AD1 /* @ECU_Address@FPrm_severity@0x024B32BC@ */ ECIPP_ALIGNMENT_UBYTE 255 Compu_IDENTITY 0 255 PHYS_UNIT "Severity+Class" /end CHARACTERISTIC
/begin CHARACTERISTIC FPsvr_TAUX_dT1_max "FPrm_severity(428)" VALUE 0x001E69C1 /* @ECU_Address@FPrm_severity@0x024B31AC@ */ ECIPP_ALIGNMENT_UBYTE 255 Compu_IDENTITY 0 255 PHYS_UNIT "Severity+Class" /end CHARACTERISTIC
/begin CHARACTERISTIC FPsvr_TAUX_dT1_min "FPrm_severity(429)" VALUE 0x001E69C2 /* @ECU_Address@FPrm_severity@0x024B31AD@ */ ECIPP_ALIGNMENT_UBYTE 255 Compu_IDENTITY 0 255 PHYS_UNIT "Severity+Class" /end CHARACTERISTIC
/begin CHARACTERISTIC FPsvr_TAUX_dT2_max "FPrm_severity(430)" VALUE 0x001E69C3 /* @ECU_Address@FPrm_severity@0x024B31AE@ */ ECIPP_ALIGNMENT_UBYTE 255 Compu_IDENTITY 0 255 PHYS_UNIT "Severity+Class" /end CHARACTERISTIC
/begin CHARACTERISTIC FPsvr_TAUX_dT2_min "FPrm_severity(431)" VALUE 0x001E69C4 /* @ECU_Address@FPrm_severity@0x024B31AF@ */ ECIPP_ALIGNMENT_UBYTE 255 Compu_IDENTITY 0 255 PHYS_UNIT "Severity+Class" /end CHARACTERISTIC
/begin CHARACTERISTIC FPsvr_Taux1_derate_actv "FPrm_severity(639)" VALUE 0x001E6A94 /* @ECU_Address@FPrm_severity@0x024B327F@ */ ECIPP_ALIGNMENT_UBYTE 255 Compu_IDENTITY 0 255 PHYS_UNIT "Severity+Class" /end CHARACTERISTIC
/begin CHARACTERISTIC FPsvr_TAUX1_max "FPrm_severity(420)" VALUE 0x001E69B9 /* @ECU_Address@FPrm_severity@0x024B31A4@ */ ECIPP_ALIGNMENT_UBYTE 255 Compu_IDENTITY 0 255 PHYS_UNIT "Severity+Class" /end CHARACTERISTIC
/begin CHARACTERISTIC FPsvr_TAUX1_min "FPrm_severity(421)" VALUE 0x001E69BA /* @ECU_Address@FPrm_severity@0x024B31A5@ */ ECIPP_ALIGNMENT_UBYTE 255 Compu_IDENTITY 0 255 PHYS_UNIT "Severity+Class" /end CHARACTERISTIC
/begin CHARACTERISTIC FPsvr_Taux2_derate_actv "FPrm_severity(640)" VALUE 0x001E6A95 /* @ECU_Address@FPrm_severity@0x024B3280@ */ ECIPP_ALIGNMENT_UBYTE 255 Compu_IDENTITY 0 255 PHYS_UNIT "Severity+Class" /end CHARACTERISTIC
/begin CHARACTERISTIC FPsvr_TAUX2_max "FPrm_severity(422)" VALUE 0x001E69BB /* @ECU_Address@FPrm_severity@0x024B31A6@ */ ECIPP_ALIGNMENT_UBYTE 255 Compu_IDENTITY 0 255 PHYS_UNIT "Severity+Class" /end CHARACTERISTIC
/begin CHARACTERISTIC FPsvr_TAUX2_min "FPrm_severity(423)" VALUE 0x001E69BC /* @ECU_Address@FPrm_severity@0x024B31A7@ */ ECIPP_ALIGNMENT_UBYTE 255 Compu_IDENTITY 0 255 PHYS_UNIT "Severity+Class" /end CHARACTERISTIC
/begin CHARACTERISTIC FPsvr_TAUX3_max "FPrm_severity(424)" VALUE 0x001E69BD /* @ECU_Address@FPrm_severity@0x024B31A8@ */ ECIPP_ALIGNMENT_UBYTE 255 Compu_IDENTITY 0 255 PHYS_UNIT "Severity+Class" /end CHARACTERISTIC
/begin CHARACTERISTIC FPsvr_TAUX3_min "FPrm_severity(425)" VALUE 0x001E69BE /* @ECU_Address@FPrm_severity@0x024B31A9@ */ ECIPP_ALIGNMENT_UBYTE 255 Compu_IDENTITY 0 255 PHYS_UNIT "Severity+Class" /end CHARACTERISTIC
/begin CHARACTERISTIC FPsvr_TAUX4_max "FPrm_severity(426)" VALUE 0x001E69BF /* @ECU_Address@FPrm_severity@0x024B31AA@ */ ECIPP_ALIGNMENT_UBYTE 255 Compu_IDENTITY 0 255 PHYS_UNIT "Severity+Class" /end CHARACTERISTIC
/begin CHARACTERISTIC FPsvr_TAUX4_min "FPrm_severity(427)" VALUE 0x001E69C0 /* @ECU_Address@FPrm_severity@0x024B31AB@ */ ECIPP_ALIGNMENT_UBYTE 255 Compu_IDENTITY 0 255 PHYS_UNIT "Severity+Class" /end CHARACTERISTIC
/begin CHARACTERISTIC FPsvr_TEL_derate_actv "FPrm_severity(477)" VALUE 0x001E69F2 /* @ECU_Address@FPrm_severity@0x024B31DD@ */ ECIPP_ALIGNMENT_UBYTE 255 Compu_IDENTITY 0 255 PHYS_UNIT "Severity+Class" /end CHARACTERISTIC
/begin CHARACTERISTIC FPsvr_TEL_dis "FPrm_severity(681)" VALUE 0x001E6ABE /* @ECU_Address@FPrm_severity@0x024B32A9@ */ ECIPP_ALIGNMENT_UBYTE 255 Compu_IDENTITY 0 255 PHYS_UNIT "Severity+Class" /end CHARACTERISTIC
/begin CHARACTERISTIC FPsvr_TEL_intF "FPrm_severity(682)" VALUE 0x001E6ABF /* @ECU_Address@FPrm_severity@0x024B32AA@ */ ECIPP_ALIGNMENT_UBYTE 255 Compu_IDENTITY 0 255 PHYS_UNIT "Severity+Class" /end CHARACTERISTIC
/begin CHARACTERISTIC FPsvr_TEL_key_invalid "FPrm_severity(648)" VALUE 0x001E6A9D /* @ECU_Address@FPrm_severity@0x024B3288@ */ ECIPP_ALIGNMENT_UBYTE 255 Compu_IDENTITY 0 255 PHYS_UNIT "Severity+Class" /end CHARACTERISTIC
/begin CHARACTERISTIC FPsvr_TEL_key_to "FPrm_severity(647)" VALUE 0x001E6A9C /* @ECU_Address@FPrm_severity@0x024B3287@ */ ECIPP_ALIGNMENT_UBYTE 255 Compu_IDENTITY 0 255 PHYS_UNIT "Severity+Class" /end CHARACTERISTIC
/begin CHARACTERISTIC FPsvr_TEL_req_to "FPrm_severity(646)" VALUE 0x001E6A9B /* @ECU_Address@FPrm_severity@0x024B3286@ */ ECIPP_ALIGNMENT_UBYTE 255 Compu_IDENTITY 0 255 PHYS_UNIT "Severity+Class" /end CHARACTERISTIC
/begin CHARACTERISTIC FPsvr_TEL_RPM_cmd "FPrm_severity(649)" VALUE 0x001E6A9E /* @ECU_Address@FPrm_severity@0x024B3289@ */ ECIPP_ALIGNMENT_UBYTE 255 Compu_IDENTITY 0 255 PHYS_UNIT "Severity+Class" /end CHARACTERISTIC
/begin CHARACTERISTIC FPsvr_TEL_RPM_psv "FPrm_severity(652)" VALUE 0x001E6AA1 /* @ECU_Address@FPrm_severity@0x024B328C@ */ ECIPP_ALIGNMENT_UBYTE 255 Compu_IDENTITY 0 255 PHYS_UNIT "Severity+Class" /end CHARACTERISTIC
/begin CHARACTERISTIC FPsvr_TEL_shutdown_cmd "FPrm_severity(651)" VALUE 0x001E6AA0 /* @ECU_Address@FPrm_severity@0x024B328B@ */ ECIPP_ALIGNMENT_UBYTE 255 Compu_IDENTITY 0 255 PHYS_UNIT "Severity+Class" /end CHARACTERISTIC
/begin CHARACTERISTIC FPsvr_TEL_shutdown_psv "FPrm_severity(654)" VALUE 0x001E6AA3 /* @ECU_Address@FPrm_severity@0x024B328E@ */ ECIPP_ALIGNMENT_UBYTE 255 Compu_IDENTITY 0 255 PHYS_UNIT "Severity+Class" /end CHARACTERISTIC
/begin CHARACTERISTIC FPsvr_TEL_torq_cmd "FPrm_severity(650)" VALUE 0x001E6A9F /* @ECU_Address@FPrm_severity@0x024B328A@ */ ECIPP_ALIGNMENT_UBYTE 255 Compu_IDENTITY 0 255 PHYS_UNIT "Severity+Class" /end CHARACTERISTIC
/begin CHARACTERISTIC FPsvr_TEL_torq_psv "FPrm_severity(653)" VALUE 0x001E6AA2 /* @ECU_Address@FPrm_severity@0x024B328D@ */ ECIPP_ALIGNMENT_UBYTE 255 Compu_IDENTITY 0 255 PHYS_UNIT "Severity+Class" /end CHARACTERISTIC
/begin CHARACTERISTIC FPsvr_TIP_act "FPrm_severity(105)" VALUE 0x001E687E /* @ECU_Address@FPrm_severity@0x024B3069@ */ ECIPP_ALIGNMENT_UBYTE 255 Compu_IDENTITY 0 255 PHYS_UNIT "Severity+Class" /end CHARACTERISTIC
/begin CHARACTERISTIC FPsvr_TIP_maxv "FPrm_severity(85)" VALUE 0x001E686A /* @ECU_Address@FPrm_severity@0x024B3055@ */ ECIPP_ALIGNMENT_UBYTE 255 Compu_IDENTITY 0 255 PHYS_UNIT "Severity+Class" /end CHARACTERISTIC
/begin CHARACTERISTIC FPsvr_TIP_minv "FPrm_severity(86)" VALUE 0x001E686B /* @ECU_Address@FPrm_severity@0x024B3056@ */ ECIPP_ALIGNMENT_UBYTE 255 Compu_IDENTITY 0 255 PHYS_UNIT "Severity+Class" /end CHARACTERISTIC
/begin CHARACTERISTIC FPsvr_TPS1_max "FPrm_severity(18)" VALUE 0x001E6827 /* @ECU_Address@FPrm_severity@0x024B3012@ */ ECIPP_ALIGNMENT_UBYTE 255 Compu_IDENTITY 0 255 PHYS_UNIT "Severity+Class" /end CHARACTERISTIC
/begin CHARACTERISTIC FPsvr_TPS1_min "FPrm_severity(19)" VALUE 0x001E6828 /* @ECU_Address@FPrm_severity@0x024B3013@ */ ECIPP_ALIGNMENT_UBYTE 255 Compu_IDENTITY 0 255 PHYS_UNIT "Severity+Class" /end CHARACTERISTIC
/begin CHARACTERISTIC FPsvr_TPS12_OOR "FPrm_severity(144)" VALUE 0x001E68A5 /* @ECU_Address@FPrm_severity@0x024B3090@ */ ECIPP_ALIGNMENT_UBYTE 255 Compu_IDENTITY 0 255 PHYS_UNIT "Severity+Class" /end CHARACTERISTIC
/begin CHARACTERISTIC FPsvr_TPS12pct_hi "FPrm_severity(22)" VALUE 0x001E682B /* @ECU_Address@FPrm_severity@0x024B3016@ */ ECIPP_ALIGNMENT_UBYTE 255 Compu_IDENTITY 0 255 PHYS_UNIT "Severity+Class" /end CHARACTERISTIC
/begin CHARACTERISTIC FPsvr_TPS12pct_lo "FPrm_severity(23)" VALUE 0x001E682C /* @ECU_Address@FPrm_severity@0x024B3017@ */ ECIPP_ALIGNMENT_UBYTE 255 Compu_IDENTITY 0 255 PHYS_UNIT "Severity+Class" /end CHARACTERISTIC
/begin CHARACTERISTIC FPsvr_TPS2_max "FPrm_severity(20)" VALUE 0x001E6829 /* @ECU_Address@FPrm_severity@0x024B3014@ */ ECIPP_ALIGNMENT_UBYTE 255 Compu_IDENTITY 0 255 PHYS_UNIT "Severity+Class" /end CHARACTERISTIC
/begin CHARACTERISTIC FPsvr_TPS2_min "FPrm_severity(21)" VALUE 0x001E682A /* @ECU_Address@FPrm_severity@0x024B3015@ */ ECIPP_ALIGNMENT_UBYTE 255 Compu_IDENTITY 0 255 PHYS_UNIT "Severity+Class" /end CHARACTERISTIC
/begin CHARACTERISTIC FPsvr_TPSerr_neg "FPrm_severity(25)" VALUE 0x001E682E /* @ECU_Address@FPrm_severity@0x024B3019@ */ ECIPP_ALIGNMENT_UBYTE 255 Compu_IDENTITY 0 255 PHYS_UNIT "Severity+Class" /end CHARACTERISTIC
/begin CHARACTERISTIC FPsvr_TPSerr_pos "FPrm_severity(24)" VALUE 0x001E682D /* @ECU_Address@FPrm_severity@0x024B3018@ */ ECIPP_ALIGNMENT_UBYTE 255 Compu_IDENTITY 0 255 PHYS_UNIT "Severity+Class" /end CHARACTERISTIC
/begin CHARACTERISTIC FPsvr_TRANS_comm "FPrm_severity(678)" VALUE 0x001E6ABB /* @ECU_Address@FPrm_severity@0x024B32A6@ */ ECIPP_ALIGNMENT_UBYTE 255 Compu_IDENTITY 0 255 PHYS_UNIT "Severity+Class" /end CHARACTERISTIC
/begin CHARACTERISTIC FPsvr_TRANS_fuel_inh "FPrm_severity(679)" VALUE 0x001E6ABC /* @ECU_Address@FPrm_severity@0x024B32A7@ */ ECIPP_ALIGNMENT_UBYTE 255 Compu_IDENTITY 0 255 PHYS_UNIT "Severity+Class" /end CHARACTERISTIC
/begin CHARACTERISTIC FPsvr_TWCDiag_OSC_lo "FPrm_severity(633)" VALUE 0x001E6A8E /* @ECU_Address@FPrm_severity@0x024B3279@ */ ECIPP_ALIGNMENT_UBYTE 255 Compu_IDENTITY 0 255 PHYS_UNIT "Severity+Class" /end CHARACTERISTIC
/begin CHARACTERISTIC FPsvr_UEGOH1_off_open "FPrm_severity(324)" VALUE 0x001E6959 /* @ECU_Address@FPrm_severity@0x024B3144@ */ ECIPP_ALIGNMENT_UBYTE 255 Compu_IDENTITY 0 255 PHYS_UNIT "Severity+Class" /end CHARACTERISTIC
/begin CHARACTERISTIC FPsvr_UEGOH1_on_short "FPrm_severity(325)" VALUE 0x001E695A /* @ECU_Address@FPrm_severity@0x024B3145@ */ ECIPP_ALIGNMENT_UBYTE 255 Compu_IDENTITY 0 255 PHYS_UNIT "Severity+Class" /end CHARACTERISTIC
/begin CHARACTERISTIC FPsvr_UEGOH2_off_open "FPrm_severity(326)" VALUE 0x001E695B /* @ECU_Address@FPrm_severity@0x024B3146@ */ ECIPP_ALIGNMENT_UBYTE 255 Compu_IDENTITY 0 255 PHYS_UNIT "Severity+Class" /end CHARACTERISTIC
/begin CHARACTERISTIC FPsvr_UEGOH2_on_short "FPrm_severity(327)" VALUE 0x001E695C /* @ECU_Address@FPrm_severity@0x024B3147@ */ ECIPP_ALIGNMENT_UBYTE 255 Compu_IDENTITY 0 255 PHYS_UNIT "Severity+Class" /end CHARACTERISTIC
/begin CHARACTERISTIC FPsvr_UEGOH3_off_open "FPrm_severity(464)" VALUE 0x001E69E5 /* @ECU_Address@FPrm_severity@0x024B31D0@ */ ECIPP_ALIGNMENT_UBYTE 255 Compu_IDENTITY 0 255 PHYS_UNIT "Severity+Class" /end CHARACTERISTIC
/begin CHARACTERISTIC FPsvr_UEGOH3_on_short "FPrm_severity(465)" VALUE 0x001E69E6 /* @ECU_Address@FPrm_severity@0x024B31D1@ */ ECIPP_ALIGNMENT_UBYTE 255 Compu_IDENTITY 0 255 PHYS_UNIT "Severity+Class" /end CHARACTERISTIC
/begin CHARACTERISTIC FPsvr_UEGOH4_off_open "FPrm_severity(475)" VALUE 0x001E69F0 /* @ECU_Address@FPrm_severity@0x024B31DB@ */ ECIPP_ALIGNMENT_UBYTE 255 Compu_IDENTITY 0 255 PHYS_UNIT "Severity+Class" /end CHARACTERISTIC
/begin CHARACTERISTIC FPsvr_UEGOH4_on_short "FPrm_severity(476)" VALUE 0x001E69F1 /* @ECU_Address@FPrm_severity@0x024B31DC@ */ ECIPP_ALIGNMENT_UBYTE 255 Compu_IDENTITY 0 255 PHYS_UNIT "Severity+Class" /end CHARACTERISTIC
/begin CHARACTERISTIC FPsvr_UGF_Hv_hi "FPrm_severity(190)" VALUE 0x001E68D3 /* @ECU_Address@FPrm_severity@0x024B30BE@ */ ECIPP_ALIGNMENT_UBYTE 255 Compu_IDENTITY 0 255 PHYS_UNIT "Severity+Class" /end CHARACTERISTIC
/begin CHARACTERISTIC FPsvr_UGF_internal "FPrm_severity(189)" VALUE 0x001E68D2 /* @ECU_Address@FPrm_severity@0x024B30BD@ */ ECIPP_ALIGNMENT_UBYTE 255 Compu_IDENTITY 0 255 PHYS_UNIT "Severity+Class" /end CHARACTERISTIC
/begin CHARACTERISTIC FPsvr_UGF_lowsupply "FPrm_severity(400)" VALUE 0x001E69A5 /* @ECU_Address@FPrm_severity@0x024B3190@ */ ECIPP_ALIGNMENT_UBYTE 255 Compu_IDENTITY 0 255 PHYS_UNIT "Severity+Class" /end CHARACTERISTIC
/begin CHARACTERISTIC FPsvr_UGF1_comm_lost "FPrm_severity(510)" VALUE 0x001E6A13 /* @ECU_Address@FPrm_severity@0x024B31FE@ */ ECIPP_ALIGNMENT_UBYTE 255 Compu_IDENTITY 0 255 PHYS_UNIT "Severity+Class" /end CHARACTERISTIC
/begin CHARACTERISTIC FPsvr_UGF1_drifttl2 "FPrm_severity(406)" VALUE 0x001E69AB /* @ECU_Address@FPrm_severity@0x024B3196@ */ ECIPP_ALIGNMENT_UBYTE 255 Compu_IDENTITY 0 255 PHYS_UNIT "Severity+Class" /end CHARACTERISTIC
/begin CHARACTERISTIC FPsvr_UGF1_drifttol "FPrm_severity(384)" VALUE 0x001E6995 /* @ECU_Address@FPrm_severity@0x024B3180@ */ ECIPP_ALIGNMENT_UBYTE 255 Compu_IDENTITY 0 255 PHYS_UNIT "Severity+Class" /end CHARACTERISTIC
/begin CHARACTERISTIC FPsvr_UGF1_R_hi "FPrm_severity(191)" VALUE 0x001E68D4 /* @ECU_Address@FPrm_severity@0x024B30BF@ */ ECIPP_ALIGNMENT_UBYTE 255 Compu_IDENTITY 0 255 PHYS_UNIT "Severity+Class" /end CHARACTERISTIC
/begin CHARACTERISTIC FPsvr_UGF1_SR_hi "FPrm_severity(194)" VALUE 0x001E68D7 /* @ECU_Address@FPrm_severity@0x024B30C2@ */ ECIPP_ALIGNMENT_UBYTE 255 Compu_IDENTITY 0 255 PHYS_UNIT "Severity+Class" /end CHARACTERISTIC
/begin CHARACTERISTIC FPsvr_UGF1_SR_slow "FPrm_severity(193)" VALUE 0x001E68D6 /* @ECU_Address@FPrm_severity@0x024B30C1@ */ ECIPP_ALIGNMENT_UBYTE 255 Compu_IDENTITY 0 255 PHYS_UNIT "Severity+Class" /end CHARACTERISTIC
/begin CHARACTERISTIC FPsvr_UGF1_Sv_hi "FPrm_severity(192)" VALUE 0x001E68D5 /* @ECU_Address@FPrm_severity@0x024B30C0@ */ ECIPP_ALIGNMENT_UBYTE 255 Compu_IDENTITY 0 255 PHYS_UNIT "Severity+Class" /end CHARACTERISTIC
/begin CHARACTERISTIC FPsvr_UGF2_comm_lost "FPrm_severity(511)" VALUE 0x001E6A14 /* @ECU_Address@FPrm_severity@0x024B31FF@ */ ECIPP_ALIGNMENT_UBYTE 255 Compu_IDENTITY 0 255 PHYS_UNIT "Severity+Class" /end CHARACTERISTIC
/begin CHARACTERISTIC FPsvr_UGF2_drifttl2 "FPrm_severity(407)" VALUE 0x001E69AC /* @ECU_Address@FPrm_severity@0x024B3197@ */ ECIPP_ALIGNMENT_UBYTE 255 Compu_IDENTITY 0 255 PHYS_UNIT "Severity+Class" /end CHARACTERISTIC
/begin CHARACTERISTIC FPsw_ext1_start_coilshort "FPrm_switches_ext1(123)" VALUE 0x001C7674 /* @ECU_Address@FPrm_switches_ext1@0x023A50F6@ */ ECIPP_ALIGNMENT_UWORD 65535 Compu_IDENTITY 0 65535 PHYS_UNIT "Enable bits" /end CHARACTERISTIC
/begin CHARACTERISTIC FPsw_ext1_start_excess "FPrm_switches_ext1(667)" VALUE 0x001C7AB4 /* @ECU_Address@FPrm_switches_ext1@0x023A5536@ */ ECIPP_ALIGNMENT_UWORD 65535 Compu_IDENTITY 0 65535 PHYS_UNIT "Enable bits" /end CHARACTERISTIC
/begin CHARACTERISTIC FPsw_ext1_start_gndshort "FPrm_switches_ext1(121)" VALUE 0x001C7670 /* @ECU_Address@FPrm_switches_ext1@0x023A50F2@ */ ECIPP_ALIGNMENT_UWORD 65535 Compu_IDENTITY 0 65535 PHYS_UNIT "Enable bits" /end CHARACTERISTIC
/begin CHARACTERISTIC FPsw_ext1_start_stuck_active "FPrm_switches_ext1(229)" VALUE 0x001C7748 /* @ECU_Address@FPrm_switches_ext1@0x023A51CA@ */ ECIPP_ALIGNMENT_UWORD 65535 Compu_IDENTITY 0 65535 PHYS_UNIT "Enable bits" /end CHARACTERISTIC
/begin CHARACTERISTIC FPsw_ext1_SubDiagTemp "FPrm_switches_ext1(483)" VALUE 0x001C7944 /* @ECU_Address@FPrm_switches_ext1@0x023A53C6@ */ ECIPP_ALIGNMENT_UWORD 65535 Compu_IDENTITY 0 65535 PHYS_UNIT "Enable bits" /end CHARACTERISTIC
/begin CHARACTERISTIC FPsw_ext1_tach_gndshort "FPrm_switches_ext1(133)" VALUE 0x001C7688 /* @ECU_Address@FPrm_switches_ext1@0x023A510A@ */ ECIPP_ALIGNMENT_UWORD 65535 Compu_IDENTITY 0 65535 PHYS_UNIT "Enable bits" /end CHARACTERISTIC
/begin CHARACTERISTIC FPsw_ext1_tach_pwrshort "FPrm_switches_ext1(134)" VALUE 0x001C768A /* @ECU_Address@FPrm_switches_ext1@0x023A510C@ */ ECIPP_ALIGNMENT_UWORD 65535 Compu_IDENTITY 0 65535 PHYS_UNIT "Enable bits" /end CHARACTERISTIC
/begin CHARACTERISTIC FPsw_ext1_TANK_1_V_maxv "FPrm_switches_ext1(698)" VALUE 0x001C7AF2 /* @ECU_Address@FPrm_switches_ext1@0x023A5574@ */ ECIPP_ALIGNMENT_UWORD 65535 Compu_IDENTITY 0 65535 PHYS_UNIT "Enable bits" /end CHARACTERISTIC
/begin CHARACTERISTIC FPsw_ext1_TANK_1_V_minv "FPrm_switches_ext1(699)" VALUE 0x001C7AF4 /* @ECU_Address@FPrm_switches_ext1@0x023A5576@ */ ECIPP_ALIGNMENT_UWORD 65535 Compu_IDENTITY 0 65535 PHYS_UNIT "Enable bits" /end CHARACTERISTIC
/begin CHARACTERISTIC FPsw_ext1_TANK_1_V_slow "FPrm_switches_ext1(700)" VALUE 0x001C7AF6 /* @ECU_Address@FPrm_switches_ext1@0x023A5578@ */ ECIPP_ALIGNMENT_UWORD 65535 Compu_IDENTITY 0 65535 PHYS_UNIT "Enable bits" /end CHARACTERISTIC
/begin CHARACTERISTIC FPsw_ext1_TAUX_dT1_max "FPrm_switches_ext1(428)" VALUE 0x001C78D6 /* @ECU_Address@FPrm_switches_ext1@0x023A5358@ */ ECIPP_ALIGNMENT_UWORD 65535 Compu_IDENTITY 0 65535 PHYS_UNIT "Enable bits" /end CHARACTERISTIC
/begin CHARACTERISTIC FPsw_ext1_TAUX_dT1_min "FPrm_switches_ext1(429)" VALUE 0x001C78D8 /* @ECU_Address@FPrm_switches_ext1@0x023A535A@ */ ECIPP_ALIGNMENT_UWORD 65535 Compu_IDENTITY 0 65535 PHYS_UNIT "Enable bits" /end CHARACTERISTIC
/begin CHARACTERISTIC FPsw_ext1_TAUX_dT2_max "FPrm_switches_ext1(430)" VALUE 0x001C78DA /* @ECU_Address@FPrm_switches_ext1@0x023A535C@ */ ECIPP_ALIGNMENT_UWORD 65535 Compu_IDENTITY 0 65535 PHYS_UNIT "Enable bits" /end CHARACTERISTIC
/begin CHARACTERISTIC FPsw_ext1_TAUX_dT2_min "FPrm_switches_ext1(431)" VALUE 0x001C78DC /* @ECU_Address@FPrm_switches_ext1@0x023A535E@ */ ECIPP_ALIGNMENT_UWORD 65535 Compu_IDENTITY 0 65535 PHYS_UNIT "Enable bits" /end CHARACTERISTIC
/begin CHARACTERISTIC FPsw_ext1_Taux1_derate_actv "FPrm_switches_ext1(639)" VALUE 0x001C7A7C /* @ECU_Address@FPrm_switches_ext1@0x023A54FE@ */ ECIPP_ALIGNMENT_UWORD 65535 Compu_IDENTITY 0 65535 PHYS_UNIT "Enable bits" /end CHARACTERISTIC
/begin CHARACTERISTIC FPsw_ext1_TAUX1_max "FPrm_switches_ext1(420)" VALUE 0x001C78C6 /* @ECU_Address@FPrm_switches_ext1@0x023A5348@ */ ECIPP_ALIGNMENT_UWORD 65535 Compu_IDENTITY 0 65535 PHYS_UNIT "Enable bits" /end CHARACTERISTIC
/begin CHARACTERISTIC FPsw_ext1_TAUX1_min "FPrm_switches_ext1(421)" VALUE 0x001C78C8 /* @ECU_Address@FPrm_switches_ext1@0x023A534A@ */ ECIPP_ALIGNMENT_UWORD 65535 Compu_IDENTITY 0 65535 PHYS_UNIT "Enable bits" /end CHARACTERISTIC
/begin CHARACTERISTIC FPsw_ext1_Taux2_derate_actv "FPrm_switches_ext1(640)" VALUE 0x001C7A7E /* @ECU_Address@FPrm_switches_ext1@0x023A5500@ */ ECIPP_ALIGNMENT_UWORD 65535 Compu_IDENTITY 0 65535 PHYS_UNIT "Enable bits" /end CHARACTERISTIC
/begin CHARACTERISTIC FPsw_ext1_TAUX2_max "FPrm_switches_ext1(422)" VALUE 0x001C78CA /* @ECU_Address@FPrm_switches_ext1@0x023A534C@ */ ECIPP_ALIGNMENT_UWORD 65535 Compu_IDENTITY 0 65535 PHYS_UNIT "Enable bits" /end CHARACTERISTIC
/begin CHARACTERISTIC FPsw_ext1_TAUX2_min "FPrm_switches_ext1(423)" VALUE 0x001C78CC /* @ECU_Address@FPrm_switches_ext1@0x023A534E@ */ ECIPP_ALIGNMENT_UWORD 65535 Compu_IDENTITY 0 65535 PHYS_UNIT "Enable bits" /end CHARACTERISTIC
/begin CHARACTERISTIC FPsw_ext1_TAUX3_max "FPrm_switches_ext1(424)" VALUE 0x001C78CE /* @ECU_Address@FPrm_switches_ext1@0x023A5350@ */ ECIPP_ALIGNMENT_UWORD 65535 Compu_IDENTITY 0 65535 PHYS_UNIT "Enable bits" /end CHARACTERISTIC
/begin CHARACTERISTIC FPsw_ext1_TAUX3_min "FPrm_switches_ext1(425)" VALUE 0x001C78D0 /* @ECU_Address@FPrm_switches_ext1@0x023A5352@ */ ECIPP_ALIGNMENT_UWORD 65535 Compu_IDENTITY 0 65535 PHYS_UNIT "Enable bits" /end CHARACTERISTIC
/begin CHARACTERISTIC FPsw_ext1_TAUX4_max "FPrm_switches_ext1(426)" VALUE 0x001C78D2 /* @ECU_Address@FPrm_switches_ext1@0x023A5354@ */ ECIPP_ALIGNMENT_UWORD 65535 Compu_IDENTITY 0 65535 PHYS_UNIT "Enable bits" /end CHARACTERISTIC
/begin CHARACTERISTIC FPsw_ext1_TAUX4_min "FPrm_switches_ext1(427)" VALUE 0x001C78D4 /* @ECU_Address@FPrm_switches_ext1@0x023A5356@ */ ECIPP_ALIGNMENT_UWORD 65535 Compu_IDENTITY 0 65535 PHYS_UNIT "Enable bits" /end CHARACTERISTIC
/begin CHARACTERISTIC FPsw_ext1_TEL_derate_actv "FPrm_switches_ext1(477)" VALUE 0x001C7938 /* @ECU_Address@FPrm_switches_ext1@0x023A53BA@ */ ECIPP_ALIGNMENT_UWORD 65535 Compu_IDENTITY 0 65535 PHYS_UNIT "Enable bits" /end CHARACTERISTIC
/begin CHARACTERISTIC FPsw_ext1_TEL_dis "FPrm_switches_ext1(681)" VALUE 0x001C7AD0 /* @ECU_Address@FPrm_switches_ext1@0x023A5552@ */ ECIPP_ALIGNMENT_UWORD 65535 Compu_IDENTITY 0 65535 PHYS_UNIT "Enable bits" /end CHARACTERISTIC
/begin CHARACTERISTIC FPsw_ext1_TEL_intF "FPrm_switches_ext1(682)" VALUE 0x001C7AD2 /* @ECU_Address@FPrm_switches_ext1@0x023A5554@ */ ECIPP_ALIGNMENT_UWORD 65535 Compu_IDENTITY 0 65535 PHYS_UNIT "Enable bits" /end CHARACTERISTIC
/begin CHARACTERISTIC FPsw_ext1_TEL_key_invalid "FPrm_switches_ext1(648)" VALUE 0x001C7A8E /* @ECU_Address@FPrm_switches_ext1@0x023A5510@ */ ECIPP_ALIGNMENT_UWORD 65535 Compu_IDENTITY 0 65535 PHYS_UNIT "Enable bits" /end CHARACTERISTIC
/begin CHARACTERISTIC FPsw_ext1_TEL_key_to "FPrm_switches_ext1(647)" VALUE 0x001C7A8C /* @ECU_Address@FPrm_switches_ext1@0x023A550E@ */ ECIPP_ALIGNMENT_UWORD 65535 Compu_IDENTITY 0 65535 PHYS_UNIT "Enable bits" /end CHARACTERISTIC
/begin CHARACTERISTIC FPsw_ext1_TEL_req_to "FPrm_switches_ext1(646)" VALUE 0x001C7A8A /* @ECU_Address@FPrm_switches_ext1@0x023A550C@ */ ECIPP_ALIGNMENT_UWORD 65535 Compu_IDENTITY 0 65535 PHYS_UNIT "Enable bits" /end CHARACTERISTIC
/begin CHARACTERISTIC FPsw_ext1_TEL_RPM_cmd "FPrm_switches_ext1(649)" VALUE 0x001C7A90 /* @ECU_Address@FPrm_switches_ext1@0x023A5512@ */ ECIPP_ALIGNMENT_UWORD 65535 Compu_IDENTITY 0 65535 PHYS_UNIT "Enable bits" /end CHARACTERISTIC
/begin CHARACTERISTIC FPsw_ext1_TEL_RPM_psv "FPrm_switches_ext1(652)" VALUE 0x001C7A96 /* @ECU_Address@FPrm_switches_ext1@0x023A5518@ */ ECIPP_ALIGNMENT_UWORD 65535 Compu_IDENTITY 0 65535 PHYS_UNIT "Enable bits" /end CHARACTERISTIC
/begin CHARACTERISTIC FPsw_ext1_TEL_shutdown_cmd "FPrm_switches_ext1(651)" VALUE 0x001C7A94 /* @ECU_Address@FPrm_switches_ext1@0x023A5516@ */ ECIPP_ALIGNMENT_UWORD 65535 Compu_IDENTITY 0 65535 PHYS_UNIT "Enable bits" /end CHARACTERISTIC
/begin CHARACTERISTIC FPsw_ext1_TEL_shutdown_psv "FPrm_switches_ext1(654)" VALUE 0x001C7A9A /* @ECU_Address@FPrm_switches_ext1@0x023A551C@ */ ECIPP_ALIGNMENT_UWORD 65535 Compu_IDENTITY 0 65535 PHYS_UNIT "Enable bits" /end CHARACTERISTIC
/begin CHARACTERISTIC FPsw_ext1_TEL_torq_cmd "FPrm_switches_ext1(650)" VALUE 0x001C7A92 /* @ECU_Address@FPrm_switches_ext1@0x023A5514@ */ ECIPP_ALIGNMENT_UWORD 65535 Compu_IDENTITY 0 65535 PHYS_UNIT "Enable bits" /end CHARACTERISTIC
/begin CHARACTERISTIC FPsw_ext1_TEL_torq_psv "FPrm_switches_ext1(653)" VALUE 0x001C7A98 /* @ECU_Address@FPrm_switches_ext1@0x023A551A@ */ ECIPP_ALIGNMENT_UWORD 65535 Compu_IDENTITY 0 65535 PHYS_UNIT "Enable bits" /end CHARACTERISTIC
/begin CHARACTERISTIC FPsw_ext1_TIP_act "FPrm_switches_ext1(105)" VALUE 0x001C7650 /* @ECU_Address@FPrm_switches_ext1@0x023A50D2@ */ ECIPP_ALIGNMENT_UWORD 65535 Compu_IDENTITY 0 65535 PHYS_UNIT "Enable bits" /end CHARACTERISTIC
/begin CHARACTERISTIC FPsw_ext1_TIP_maxv "FPrm_switches_ext1(85)" VALUE 0x001C7628 /* @ECU_Address@FPrm_switches_ext1@0x023A50AA@ */ ECIPP_ALIGNMENT_UWORD 65535 Compu_IDENTITY 0 65535 PHYS_UNIT "Enable bits" /end CHARACTERISTIC
/begin CHARACTERISTIC FPsw_ext1_TIP_minv "FPrm_switches_ext1(86)" VALUE 0x001C762A /* @ECU_Address@FPrm_switches_ext1@0x023A50AC@ */ ECIPP_ALIGNMENT_UWORD 65535 Compu_IDENTITY 0 65535 PHYS_UNIT "Enable bits" /end CHARACTERISTIC
/begin CHARACTERISTIC FPsw_ext1_TPS1_max "FPrm_switches_ext1(18)" VALUE 0x001C75A2 /* @ECU_Address@FPrm_switches_ext1@0x023A5024@ */ ECIPP_ALIGNMENT_UWORD 65535 Compu_IDENTITY 0 65535 PHYS_UNIT "Enable bits" /end CHARACTERISTIC
/begin CHARACTERISTIC FPsw_ext1_TPS1_min "FPrm_switches_ext1(19)" VALUE 0x001C75A4 /* @ECU_Address@FPrm_switches_ext1@0x023A5026@ */ ECIPP_ALIGNMENT_UWORD 65535 Compu_IDENTITY 0 65535 PHYS_UNIT "Enable bits" /end CHARACTERISTIC
/begin CHARACTERISTIC FPsw_ext1_TPS12_OOR "FPrm_switches_ext1(144)" VALUE 0x001C769E /* @ECU_Address@FPrm_switches_ext1@0x023A5120@ */ ECIPP_ALIGNMENT_UWORD 65535 Compu_IDENTITY 0 65535 PHYS_UNIT "Enable bits" /end CHARACTERISTIC
/begin CHARACTERISTIC FPsw_ext1_TPS12pct_hi "FPrm_switches_ext1(22)" VALUE 0x001C75AA /* @ECU_Address@FPrm_switches_ext1@0x023A502C@ */ ECIPP_ALIGNMENT_UWORD 65535 Compu_IDENTITY 0 65535 PHYS_UNIT "Enable bits" /end CHARACTERISTIC
/begin CHARACTERISTIC FPsw_ext1_TPS12pct_lo "FPrm_switches_ext1(23)" VALUE 0x001C75AC /* @ECU_Address@FPrm_switches_ext1@0x023A502E@ */ ECIPP_ALIGNMENT_UWORD 65535 Compu_IDENTITY 0 65535 PHYS_UNIT "Enable bits" /end CHARACTERISTIC
/begin CHARACTERISTIC FPsw_ext1_TPS2_max "FPrm_switches_ext1(20)" VALUE 0x001C75A6 /* @ECU_Address@FPrm_switches_ext1@0x023A5028@ */ ECIPP_ALIGNMENT_UWORD 65535 Compu_IDENTITY 0 65535 PHYS_UNIT "Enable bits" /end CHARACTERISTIC
/begin CHARACTERISTIC FPsw_ext1_TPS2_min "FPrm_switches_ext1(21)" VALUE 0x001C75A8 /* @ECU_Address@FPrm_switches_ext1@0x023A502A@ */ ECIPP_ALIGNMENT_UWORD 65535 Compu_IDENTITY 0 65535 PHYS_UNIT "Enable bits" /end CHARACTERISTIC
/begin CHARACTERISTIC FPsw_ext1_TPSerr_neg "FPrm_switches_ext1(25)" VALUE 0x001C75B0 /* @ECU_Address@FPrm_switches_ext1@0x023A5032@ */ ECIPP_ALIGNMENT_UWORD 65535 Compu_IDENTITY 0 65535 PHYS_UNIT "Enable bits" /end CHARACTERISTIC
/begin CHARACTERISTIC FPsw_ext1_TPSerr_pos "FPrm_switches_ext1(24)" VALUE 0x001C75AE /* @ECU_Address@FPrm_switches_ext1@0x023A5030@ */ ECIPP_ALIGNMENT_UWORD 65535 Compu_IDENTITY 0 65535 PHYS_UNIT "Enable bits" /end CHARACTERISTIC
/begin CHARACTERISTIC FPsw_ext1_TRANS_comm "FPrm_switches_ext1(678)" VALUE 0x001C7ACA /* @ECU_Address@FPrm_switches_ext1@0x023A554C@ */ ECIPP_ALIGNMENT_UWORD 65535 Compu_IDENTITY 0 65535 PHYS_UNIT "Enable bits" /end CHARACTERISTIC
/begin CHARACTERISTIC FPsw_ext1_TRANS_fuel_inh "FPrm_switches_ext1(679)" VALUE 0x001C7ACC /* @ECU_Address@FPrm_switches_ext1@0x023A554E@ */ ECIPP_ALIGNMENT_UWORD 65535 Compu_IDENTITY 0 65535 PHYS_UNIT "Enable bits" /end CHARACTERISTIC
/begin CHARACTERISTIC FPsw_ext1_TWCDiag_OSC_lo "FPrm_switches_ext1(633)" VALUE 0x001C7A70 /* @ECU_Address@FPrm_switches_ext1@0x023A54F2@ */ ECIPP_ALIGNMENT_UWORD 65535 Compu_IDENTITY 0 65535 PHYS_UNIT "Enable bits" /end CHARACTERISTIC
/begin CHARACTERISTIC FPsw_ext1_UEGOH1_off_open "FPrm_switches_ext1(324)" VALUE 0x001C7806 /* @ECU_Address@FPrm_switches_ext1@0x023A5288@ */ ECIPP_ALIGNMENT_UWORD 65535 Compu_IDENTITY 0 65535 PHYS_UNIT "Enable bits" /end CHARACTERISTIC
/begin CHARACTERISTIC FPsw_ext1_UEGOH1_on_short "FPrm_switches_ext1(325)" VALUE 0x001C7808 /* @ECU_Address@FPrm_switches_ext1@0x023A528A@ */ ECIPP_ALIGNMENT_UWORD 65535 Compu_IDENTITY 0 65535 PHYS_UNIT "Enable bits" /end CHARACTERISTIC
/begin CHARACTERISTIC FPsw_ext1_UEGOH2_off_open "FPrm_switches_ext1(326)" VALUE 0x001C780A /* @ECU_Address@FPrm_switches_ext1@0x023A528C@ */ ECIPP_ALIGNMENT_UWORD 65535 Compu_IDENTITY 0 65535 PHYS_UNIT "Enable bits" /end CHARACTERISTIC
/begin CHARACTERISTIC FPsw_ext1_UEGOH2_on_short "FPrm_switches_ext1(327)" VALUE 0x001C780C /* @ECU_Address@FPrm_switches_ext1@0x023A528E@ */ ECIPP_ALIGNMENT_UWORD 65535 Compu_IDENTITY 0 65535 PHYS_UNIT "Enable bits" /end CHARACTERISTIC
/begin CHARACTERISTIC FPsw_ext1_UEGOH3_off_open "FPrm_switches_ext1(464)" VALUE 0x001C791E /* @ECU_Address@FPrm_switches_ext1@0x023A53A0@ */ ECIPP_ALIGNMENT_UWORD 65535 Compu_IDENTITY 0 65535 PHYS_UNIT "Enable bits" /end CHARACTERISTIC
/begin CHARACTERISTIC FPsw_ext1_UEGOH3_on_short "FPrm_switches_ext1(465)" VALUE 0x001C7920 /* @ECU_Address@FPrm_switches_ext1@0x023A53A2@ */ ECIPP_ALIGNMENT_UWORD 65535 Compu_IDENTITY 0 65535 PHYS_UNIT "Enable bits" /end CHARACTERISTIC
/begin CHARACTERISTIC FPsw_ext1_UEGOH4_off_open "FPrm_switches_ext1(475)" VALUE 0x001C7934 /* @ECU_Address@FPrm_switches_ext1@0x023A53B6@ */ ECIPP_ALIGNMENT_UWORD 65535 Compu_IDENTITY 0 65535 PHYS_UNIT "Enable bits" /end CHARACTERISTIC
/begin CHARACTERISTIC FPsw_ext1_UEGOH4_on_short "FPrm_switches_ext1(476)" VALUE 0x001C7936 /* @ECU_Address@FPrm_switches_ext1@0x023A53B8@ */ ECIPP_ALIGNMENT_UWORD 65535 Compu_IDENTITY 0 65535 PHYS_UNIT "Enable bits" /end CHARACTERISTIC
/begin CHARACTERISTIC FPsw_ext1_UGF_Hv_hi "FPrm_switches_ext1(190)" VALUE 0x001C76FA /* @ECU_Address@FPrm_switches_ext1@0x023A517C@ */ ECIPP_ALIGNMENT_UWORD 65535 Compu_IDENTITY 0 65535 PHYS_UNIT "Enable bits" /end CHARACTERISTIC
/begin CHARACTERISTIC FPsw_ext1_UGF_internal "FPrm_switches_ext1(189)" VALUE 0x001C76F8 /* @ECU_Address@FPrm_switches_ext1@0x023A517A@ */ ECIPP_ALIGNMENT_UWORD 65535 Compu_IDENTITY 0 65535 PHYS_UNIT "Enable bits" /end CHARACTERISTIC
/begin CHARACTERISTIC FPsw_ext1_UGF_lowsupply "FPrm_switches_ext1(400)" VALUE 0x001C789E /* @ECU_Address@FPrm_switches_ext1@0x023A5320@ */ ECIPP_ALIGNMENT_UWORD 65535 Compu_IDENTITY 0 65535 PHYS_UNIT "Enable bits" /end CHARACTERISTIC
/begin CHARACTERISTIC FPsw_ext1_UGF1_comm_lost "FPrm_switches_ext1(510)" VALUE 0x001C797A /* @ECU_Address@FPrm_switches_ext1@0x023A53FC@ */ ECIPP_ALIGNMENT_UWORD 65535 Compu_IDENTITY 0 65535 PHYS_UNIT "Enable bits" /end CHARACTERISTIC
/begin CHARACTERISTIC FPsw_ext1_UGF1_drifttl2 "FPrm_switches_ext1(406)" VALUE 0x001C78AA /* @ECU_Address@FPrm_switches_ext1@0x023A532C@ */ ECIPP_ALIGNMENT_UWORD 65535 Compu_IDENTITY 0 65535 PHYS_UNIT "Enable bits" /end CHARACTERISTIC
/begin CHARACTERISTIC FPsw_ext1_UGF1_drifttol "FPrm_switches_ext1(384)" VALUE 0x001C787E /* @ECU_Address@FPrm_switches_ext1@0x023A5300@ */ ECIPP_ALIGNMENT_UWORD 65535 Compu_IDENTITY 0 65535 PHYS_UNIT "Enable bits" /end CHARACTERISTIC
/begin CHARACTERISTIC FPsw_ext1_UGF1_R_hi "FPrm_switches_ext1(191)" VALUE 0x001C76FC /* @ECU_Address@FPrm_switches_ext1@0x023A517E@ */ ECIPP_ALIGNMENT_UWORD 65535 Compu_IDENTITY 0 65535 PHYS_UNIT "Enable bits" /end CHARACTERISTIC
/begin CHARACTERISTIC FPsw_ext1_UGF1_SR_hi "FPrm_switches_ext1(194)" VALUE 0x001C7702 /* @ECU_Address@FPrm_switches_ext1@0x023A5184@ */ ECIPP_ALIGNMENT_UWORD 65535 Compu_IDENTITY 0 65535 PHYS_UNIT "Enable bits" /end CHARACTERISTIC
/begin CHARACTERISTIC FPsw_ext1_UGF1_SR_slow "FPrm_switches_ext1(193)" VALUE 0x001C7700 /* @ECU_Address@FPrm_switches_ext1@0x023A5182@ */ ECIPP_ALIGNMENT_UWORD 65535 Compu_IDENTITY 0 65535 PHYS_UNIT "Enable bits" /end CHARACTERISTIC
/begin CHARACTERISTIC FPsw_ext1_UGF1_Sv_hi "FPrm_switches_ext1(192)" VALUE 0x001C76FE /* @ECU_Address@FPrm_switches_ext1@0x023A5180@ */ ECIPP_ALIGNMENT_UWORD 65535 Compu_IDENTITY 0 65535 PHYS_UNIT "Enable bits" /end CHARACTERISTIC
/begin CHARACTERISTIC FPsw_ext1_UGF2_comm_lost "FPrm_switches_ext1(511)" VALUE 0x001C797C /* @ECU_Address@FPrm_switches_ext1@0x023A53FE@ */ ECIPP_ALIGNMENT_UWORD 65535 Compu_IDENTITY 0 65535 PHYS_UNIT "Enable bits" /end CHARACTERISTIC
/begin CHARACTERISTIC FPsw_ext1_UGF2_drifttl2 "FPrm_switches_ext1(407)" VALUE 0x001C78AC /* @ECU_Address@FPrm_switches_ext1@0x023A532E@ */ ECIPP_ALIGNMENT_UWORD 65535 Compu_IDENTITY 0 65535 PHYS_UNIT "Enable bits" /end CHARACTERISTIC
/begin CHARACTERISTIC FPsw_start_coilshort "FPrm_switches(123)" VALUE 0x001C70D0 /* @ECU_Address@FPrm_switches@0x021B90F6@ */ ECIPP_ALIGNMENT_UWORD 65535 Compu_IDENTITY 0 65535 PHYS_UNIT "Enable bits" /end CHARACTERISTIC
/begin CHARACTERISTIC FPsw_start_excess "FPrm_switches(667)" VALUE 0x001C7510 /* @ECU_Address@FPrm_switches@0x021B9536@ */ ECIPP_ALIGNMENT_UWORD 65535 Compu_IDENTITY 0 65535 PHYS_UNIT "Enable bits" /end CHARACTERISTIC
/begin CHARACTERISTIC FPsw_start_gndshort "FPrm_switches(121)" VALUE 0x001C70CC /* @ECU_Address@FPrm_switches@0x021B90F2@ */ ECIPP_ALIGNMENT_UWORD 65535 Compu_IDENTITY 0 65535 PHYS_UNIT "Enable bits" /end CHARACTERISTIC
/begin CHARACTERISTIC FPsw_start_stuck_active "FPrm_switches(229)" VALUE 0x001C71A4 /* @ECU_Address@FPrm_switches@0x021B91CA@ */ ECIPP_ALIGNMENT_UWORD 65535 Compu_IDENTITY 0 65535 PHYS_UNIT "Enable bits" /end CHARACTERISTIC
/begin CHARACTERISTIC FPsw_SubDiagTemp "FPrm_switches(483)" VALUE 0x001C73A0 /* @ECU_Address@FPrm_switches@0x021B93C6@ */ ECIPP_ALIGNMENT_UWORD 65535 Compu_IDENTITY 0 65535 PHYS_UNIT "Enable bits" /end CHARACTERISTIC
/begin CHARACTERISTIC FPsw_tach_gndshort "FPrm_switches(133)" VALUE 0x001C70E4 /* @ECU_Address@FPrm_switches@0x021B910A@ */ ECIPP_ALIGNMENT_UWORD 65535 Compu_IDENTITY 0 65535 PHYS_UNIT "Enable bits" /end CHARACTERISTIC
/begin CHARACTERISTIC FPsw_tach_pwrshort "FPrm_switches(134)" VALUE 0x001C70E6 /* @ECU_Address@FPrm_switches@0x021B910C@ */ ECIPP_ALIGNMENT_UWORD 65535 Compu_IDENTITY 0 65535 PHYS_UNIT "Enable bits" /end CHARACTERISTIC
/begin CHARACTERISTIC FPsw_TANK_1_V_maxv "FPrm_switches(698)" VALUE 0x001C754E /* @ECU_Address@FPrm_switches@0x021B9574@ */ ECIPP_ALIGNMENT_UWORD 65535 Compu_IDENTITY 0 65535 PHYS_UNIT "Enable bits" /end CHARACTERISTIC
/begin CHARACTERISTIC FPsw_TANK_1_V_minv "FPrm_switches(699)" VALUE 0x001C7550 /* @ECU_Address@FPrm_switches@0x021B9576@ */ ECIPP_ALIGNMENT_UWORD 65535 Compu_IDENTITY 0 65535 PHYS_UNIT "Enable bits" /end CHARACTERISTIC
/begin CHARACTERISTIC FPsw_TANK_1_V_slow "FPrm_switches(700)" VALUE 0x001C7552 /* @ECU_Address@FPrm_switches@0x021B9578@ */ ECIPP_ALIGNMENT_UWORD 65535 Compu_IDENTITY 0 65535 PHYS_UNIT "Enable bits" /end CHARACTERISTIC
/begin CHARACTERISTIC FPsw_TAUX_dT1_max "FPrm_switches(428)" VALUE 0x001C7332 /* @ECU_Address@FPrm_switches@0x021B9358@ */ ECIPP_ALIGNMENT_UWORD 65535 Compu_IDENTITY 0 65535 PHYS_UNIT "Enable bits" /end CHARACTERISTIC
/begin CHARACTERISTIC FPsw_TAUX_dT1_min "FPrm_switches(429)" VALUE 0x001C7334 /* @ECU_Address@FPrm_switches@0x021B935A@ */ ECIPP_ALIGNMENT_UWORD 65535 Compu_IDENTITY 0 65535 PHYS_UNIT "Enable bits" /end CHARACTERISTIC
/begin CHARACTERISTIC FPsw_TAUX_dT2_max "FPrm_switches(430)" VALUE 0x001C7336 /* @ECU_Address@FPrm_switches@0x021B935C@ */ ECIPP_ALIGNMENT_UWORD 65535 Compu_IDENTITY 0 65535 PHYS_UNIT "Enable bits" /end CHARACTERISTIC
/begin CHARACTERISTIC FPsw_TAUX_dT2_min "FPrm_switches(431)" VALUE 0x001C7338 /* @ECU_Address@FPrm_switches@0x021B935E@ */ ECIPP_ALIGNMENT_UWORD 65535 Compu_IDENTITY 0 65535 PHYS_UNIT "Enable bits" /end CHARACTERISTIC
/begin CHARACTERISTIC FPsw_Taux1_derate_actv "FPrm_switches(639)" VALUE 0x001C74D8 /* @ECU_Address@FPrm_switches@0x021B94FE@ */ ECIPP_ALIGNMENT_UWORD 65535 Compu_IDENTITY 0 65535 PHYS_UNIT "Enable bits" /end CHARACTERISTIC
/begin CHARACTERISTIC FPsw_TAUX1_max "FPrm_switches(420)" VALUE 0x001C7322 /* @ECU_Address@FPrm_switches@0x021B9348@ */ ECIPP_ALIGNMENT_UWORD 65535 Compu_IDENTITY 0 65535 PHYS_UNIT "Enable bits" /end CHARACTERISTIC
/begin CHARACTERISTIC FPsw_TAUX1_min "FPrm_switches(421)" VALUE 0x001C7324 /* @ECU_Address@FPrm_switches@0x021B934A@ */ ECIPP_ALIGNMENT_UWORD 65535 Compu_IDENTITY 0 65535 PHYS_UNIT "Enable bits" /end CHARACTERISTIC
/begin CHARACTERISTIC FPsw_Taux2_derate_actv "FPrm_switches(640)" VALUE 0x001C74DA /* @ECU_Address@FPrm_switches@0x021B9500@ */ ECIPP_ALIGNMENT_UWORD 65535 Compu_IDENTITY 0 65535 PHYS_UNIT "Enable bits" /end CHARACTERISTIC
/begin CHARACTERISTIC FPsw_TAUX2_max "FPrm_switches(422)" VALUE 0x001C7326 /* @ECU_Address@FPrm_switches@0x021B934C@ */ ECIPP_ALIGNMENT_UWORD 65535 Compu_IDENTITY 0 65535 PHYS_UNIT "Enable bits" /end CHARACTERISTIC
/begin CHARACTERISTIC FPsw_TAUX2_min "FPrm_switches(423)" VALUE 0x001C7328 /* @ECU_Address@FPrm_switches@0x021B934E@ */ ECIPP_ALIGNMENT_UWORD 65535 Compu_IDENTITY 0 65535 PHYS_UNIT "Enable bits" /end CHARACTERISTIC
/begin CHARACTERISTIC FPsw_TAUX3_max "FPrm_switches(424)" VALUE 0x001C732A /* @ECU_Address@FPrm_switches@0x021B9350@ */ ECIPP_ALIGNMENT_UWORD 65535 Compu_IDENTITY 0 65535 PHYS_UNIT "Enable bits" /end CHARACTERISTIC
/begin CHARACTERISTIC FPsw_TAUX3_min "FPrm_switches(425)" VALUE 0x001C732C /* @ECU_Address@FPrm_switches@0x021B9352@ */ ECIPP_ALIGNMENT_UWORD 65535 Compu_IDENTITY 0 65535 PHYS_UNIT "Enable bits" /end CHARACTERISTIC
/begin CHARACTERISTIC FPsw_TAUX4_max "FPrm_switches(426)" VALUE 0x001C732E /* @ECU_Address@FPrm_switches@0x021B9354@ */ ECIPP_ALIGNMENT_UWORD 65535 Compu_IDENTITY 0 65535 PHYS_UNIT "Enable bits" /end CHARACTERISTIC
/begin CHARACTERISTIC FPsw_TAUX4_min "FPrm_switches(427)" VALUE 0x001C7330 /* @ECU_Address@FPrm_switches@0x021B9356@ */ ECIPP_ALIGNMENT_UWORD 65535 Compu_IDENTITY 0 65535 PHYS_UNIT "Enable bits" /end CHARACTERISTIC
/begin CHARACTERISTIC FPsw_TEL_derate_actv "FPrm_switches(477)" VALUE 0x001C7394 /* @ECU_Address@FPrm_switches@0x021B93BA@ */ ECIPP_ALIGNMENT_UWORD 65535 Compu_IDENTITY 0 65535 PHYS_UNIT "Enable bits" /end CHARACTERISTIC
/begin CHARACTERISTIC FPsw_TEL_dis "FPrm_switches(681)" VALUE 0x001C752C /* @ECU_Address@FPrm_switches@0x021B9552@ */ ECIPP_ALIGNMENT_UWORD 65535 Compu_IDENTITY 0 65535 PHYS_UNIT "Enable bits" /end CHARACTERISTIC
/begin CHARACTERISTIC FPsw_TEL_intF "FPrm_switches(682)" VALUE 0x001C752E /* @ECU_Address@FPrm_switches@0x021B9554@ */ ECIPP_ALIGNMENT_UWORD 65535 Compu_IDENTITY 0 65535 PHYS_UNIT "Enable bits" /end CHARACTERISTIC
/begin CHARACTERISTIC FPsw_TEL_key_invalid "FPrm_switches(648)" VALUE 0x001C74EA /* @ECU_Address@FPrm_switches@0x021B9510@ */ ECIPP_ALIGNMENT_UWORD 65535 Compu_IDENTITY 0 65535 PHYS_UNIT "Enable bits" /end CHARACTERISTIC
/begin CHARACTERISTIC FPsw_TEL_key_to "FPrm_switches(647)" VALUE 0x001C74E8 /* @ECU_Address@FPrm_switches@0x021B950E@ */ ECIPP_ALIGNMENT_UWORD 65535 Compu_IDENTITY 0 65535 PHYS_UNIT "Enable bits" /end CHARACTERISTIC
/begin CHARACTERISTIC FPsw_TEL_req_to "FPrm_switches(646)" VALUE 0x001C74E6 /* @ECU_Address@FPrm_switches@0x021B950C@ */ ECIPP_ALIGNMENT_UWORD 65535 Compu_IDENTITY 0 65535 PHYS_UNIT "Enable bits" /end CHARACTERISTIC
/begin CHARACTERISTIC FPsw_TEL_RPM_cmd "FPrm_switches(649)" VALUE 0x001C74EC /* @ECU_Address@FPrm_switches@0x021B9512@ */ ECIPP_ALIGNMENT_UWORD 65535 Compu_IDENTITY 0 65535 PHYS_UNIT "Enable bits" /end CHARACTERISTIC
/begin CHARACTERISTIC FPsw_TEL_RPM_psv "FPrm_switches(652)" VALUE 0x001C74F2 /* @ECU_Address@FPrm_switches@0x021B9518@ */ ECIPP_ALIGNMENT_UWORD 65535 Compu_IDENTITY 0 65535 PHYS_UNIT "Enable bits" /end CHARACTERISTIC
/begin CHARACTERISTIC FPsw_TEL_shutdown_cmd "FPrm_switches(651)" VALUE 0x001C74F0 /* @ECU_Address@FPrm_switches@0x021B9516@ */ ECIPP_ALIGNMENT_UWORD 65535 Compu_IDENTITY 0 65535 PHYS_UNIT "Enable bits" /end CHARACTERISTIC
/begin CHARACTERISTIC FPsw_TEL_shutdown_psv "FPrm_switches(654)" VALUE 0x001C74F6 /* @ECU_Address@FPrm_switches@0x021B951C@ */ ECIPP_ALIGNMENT_UWORD 65535 Compu_IDENTITY 0 65535 PHYS_UNIT "Enable bits" /end CHARACTERISTIC
/begin CHARACTERISTIC FPsw_TEL_torq_cmd "FPrm_switches(650)" VALUE 0x001C74EE /* @ECU_Address@FPrm_switches@0x021B9514@ */ ECIPP_ALIGNMENT_UWORD 65535 Compu_IDENTITY 0 65535 PHYS_UNIT "Enable bits" /end CHARACTERISTIC
/begin CHARACTERISTIC FPsw_TEL_torq_psv "FPrm_switches(653)" VALUE 0x001C74F4 /* @ECU_Address@FPrm_switches@0x021B951A@ */ ECIPP_ALIGNMENT_UWORD 65535 Compu_IDENTITY 0 65535 PHYS_UNIT "Enable bits" /end CHARACTERISTIC
/begin CHARACTERISTIC FPsw_TIP_act "FPrm_switches(105)" VALUE 0x001C70AC /* @ECU_Address@FPrm_switches@0x021B90D2@ */ ECIPP_ALIGNMENT_UWORD 65535 Compu_IDENTITY 0 65535 PHYS_UNIT "Enable bits" /end CHARACTERISTIC
/begin CHARACTERISTIC FPsw_TIP_maxv "FPrm_switches(85)" VALUE 0x001C7084 /* @ECU_Address@FPrm_switches@0x021B90AA@ */ ECIPP_ALIGNMENT_UWORD 65535 Compu_IDENTITY 0 65535 PHYS_UNIT "Enable bits" /end CHARACTERISTIC
/begin CHARACTERISTIC FPsw_TIP_minv "FPrm_switches(86)" VALUE 0x001C7086 /* @ECU_Address@FPrm_switches@0x021B90AC@ */ ECIPP_ALIGNMENT_UWORD 65535 Compu_IDENTITY 0 65535 PHYS_UNIT "Enable bits" /end CHARACTERISTIC
/begin CHARACTERISTIC FPsw_TPS1_max "FPrm_switches(18)" VALUE 0x001C6FFE /* @ECU_Address@FPrm_switches@0x021B9024@ */ ECIPP_ALIGNMENT_UWORD 65535 Compu_IDENTITY 0 65535 PHYS_UNIT "Enable bits" /end CHARACTERISTIC
/begin CHARACTERISTIC FPsw_TPS1_min "FPrm_switches(19)" VALUE 0x001C7000 /* @ECU_Address@FPrm_switches@0x021B9026@ */ ECIPP_ALIGNMENT_UWORD 65535 Compu_IDENTITY 0 65535 PHYS_UNIT "Enable bits" /end CHARACTERISTIC
/begin CHARACTERISTIC FPsw_TPS12_OOR "FPrm_switches(144)" VALUE 0x001C70FA /* @ECU_Address@FPrm_switches@0x021B9120@ */ ECIPP_ALIGNMENT_UWORD 65535 Compu_IDENTITY 0 65535 PHYS_UNIT "Enable bits" /end CHARACTERISTIC
/begin CHARACTERISTIC FPsw_TPS12pct_hi "FPrm_switches(22)" VALUE 0x001C7006 /* @ECU_Address@FPrm_switches@0x021B902C@ */ ECIPP_ALIGNMENT_UWORD 65535 Compu_IDENTITY 0 65535 PHYS_UNIT "Enable bits" /end CHARACTERISTIC
/begin CHARACTERISTIC FPsw_TPS12pct_lo "FPrm_switches(23)" VALUE 0x001C7008 /* @ECU_Address@FPrm_switches@0x021B902E@ */ ECIPP_ALIGNMENT_UWORD 65535 Compu_IDENTITY 0 65535 PHYS_UNIT "Enable bits" /end CHARACTERISTIC
/begin CHARACTERISTIC FPsw_TPS2_max "FPrm_switches(20)" VALUE 0x001C7002 /* @ECU_Address@FPrm_switches@0x021B9028@ */ ECIPP_ALIGNMENT_UWORD 65535 Compu_IDENTITY 0 65535 PHYS_UNIT "Enable bits" /end CHARACTERISTIC
/begin CHARACTERISTIC FPsw_TPS2_min "FPrm_switches(21)" VALUE 0x001C7004 /* @ECU_Address@FPrm_switches@0x021B902A@ */ ECIPP_ALIGNMENT_UWORD 65535 Compu_IDENTITY 0 65535 PHYS_UNIT "Enable bits" /end CHARACTERISTIC
/begin CHARACTERISTIC FPsw_TPSerr_neg "FPrm_switches(25)" VALUE 0x001C700C /* @ECU_Address@FPrm_switches@0x021B9032@ */ ECIPP_ALIGNMENT_UWORD 65535 Compu_IDENTITY 0 65535 PHYS_UNIT "Enable bits" /end CHARACTERISTIC
/begin CHARACTERISTIC FPsw_TPSerr_pos "FPrm_switches(24)" VALUE 0x001C700A /* @ECU_Address@FPrm_switches@0x021B9030@ */ ECIPP_ALIGNMENT_UWORD 65535 Compu_IDENTITY 0 65535 PHYS_UNIT "Enable bits" /end CHARACTERISTIC
/begin CHARACTERISTIC FPsw_TRANS_comm "FPrm_switches(678)" VALUE 0x001C7526 /* @ECU_Address@FPrm_switches@0x021B954C@ */ ECIPP_ALIGNMENT_UWORD 65535 Compu_IDENTITY 0 65535 PHYS_UNIT "Enable bits" /end CHARACTERISTIC
/begin CHARACTERISTIC FPsw_TRANS_fuel_inh "FPrm_switches(679)" VALUE 0x001C7528 /* @ECU_Address@FPrm_switches@0x021B954E@ */ ECIPP_ALIGNMENT_UWORD 65535 Compu_IDENTITY 0 65535 PHYS_UNIT "Enable bits" /end CHARACTERISTIC
/begin CHARACTERISTIC FPsw_TWCDiag_OSC_lo "FPrm_switches(633)" VALUE 0x001C74CC /* @ECU_Address@FPrm_switches@0x021B94F2@ */ ECIPP_ALIGNMENT_UWORD 65535 Compu_IDENTITY 0 65535 PHYS_UNIT "Enable bits" /end CHARACTERISTIC
/begin CHARACTERISTIC FPsw_UEGOH1_off_open "FPrm_switches(324)" VALUE 0x001C7262 /* @ECU_Address@FPrm_switches@0x021B9288@ */ ECIPP_ALIGNMENT_UWORD 65535 Compu_IDENTITY 0 65535 PHYS_UNIT "Enable bits" /end CHARACTERISTIC
/begin CHARACTERISTIC FPsw_UEGOH1_on_short "FPrm_switches(325)" VALUE 0x001C7264 /* @ECU_Address@FPrm_switches@0x021B928A@ */ ECIPP_ALIGNMENT_UWORD 65535 Compu_IDENTITY 0 65535 PHYS_UNIT "Enable bits" /end CHARACTERISTIC
/begin CHARACTERISTIC FPsw_UEGOH2_off_open "FPrm_switches(326)" VALUE 0x001C7266 /* @ECU_Address@FPrm_switches@0x021B928C@ */ ECIPP_ALIGNMENT_UWORD 65535 Compu_IDENTITY 0 65535 PHYS_UNIT "Enable bits" /end CHARACTERISTIC
/begin CHARACTERISTIC FPsw_UEGOH2_on_short "FPrm_switches(327)" VALUE 0x001C7268 /* @ECU_Address@FPrm_switches@0x021B928E@ */ ECIPP_ALIGNMENT_UWORD 65535 Compu_IDENTITY 0 65535 PHYS_UNIT "Enable bits" /end CHARACTERISTIC
/begin CHARACTERISTIC FPsw_UEGOH3_off_open "FPrm_switches(464)" VALUE 0x001C737A /* @ECU_Address@FPrm_switches@0x021B93A0@ */ ECIPP_ALIGNMENT_UWORD 65535 Compu_IDENTITY 0 65535 PHYS_UNIT "Enable bits" /end CHARACTERISTIC
/begin CHARACTERISTIC FPsw_UEGOH3_on_short "FPrm_switches(465)" VALUE 0x001C737C /* @ECU_Address@FPrm_switches@0x021B93A2@ */ ECIPP_ALIGNMENT_UWORD 65535 Compu_IDENTITY 0 65535 PHYS_UNIT "Enable bits" /end CHARACTERISTIC
/begin CHARACTERISTIC FPsw_UEGOH4_off_open "FPrm_switches(475)" VALUE 0x001C7390 /* @ECU_Address@FPrm_switches@0x021B93B6@ */ ECIPP_ALIGNMENT_UWORD 65535 Compu_IDENTITY 0 65535 PHYS_UNIT "Enable bits" /end CHARACTERISTIC
/begin CHARACTERISTIC FPsw_UEGOH4_on_short "FPrm_switches(476)" VALUE 0x001C7392 /* @ECU_Address@FPrm_switches@0x021B93B8@ */ ECIPP_ALIGNMENT_UWORD 65535 Compu_IDENTITY 0 65535 PHYS_UNIT "Enable bits" /end CHARACTERISTIC
/begin CHARACTERISTIC FPsw_UGF_Hv_hi "FPrm_switches(190)" VALUE 0x001C7156 /* @ECU_Address@FPrm_switches@0x021B917C@ */ ECIPP_ALIGNMENT_UWORD 65535 Compu_IDENTITY 0 65535 PHYS_UNIT "Enable bits" /end CHARACTERISTIC
/begin CHARACTERISTIC FPsw_UGF_internal "FPrm_switches(189)" VALUE 0x001C7154 /* @ECU_Address@FPrm_switches@0x021B917A@ */ ECIPP_ALIGNMENT_UWORD 65535 Compu_IDENTITY 0 65535 PHYS_UNIT "Enable bits" /end CHARACTERISTIC
/begin CHARACTERISTIC FPsw_UGF_lowsupply "FPrm_switches(400)" VALUE 0x001C72FA /* @ECU_Address@FPrm_switches@0x021B9320@ */ ECIPP_ALIGNMENT_UWORD 65535 Compu_IDENTITY 0 65535 PHYS_UNIT "Enable bits" /end CHARACTERISTIC
/begin CHARACTERISTIC FPsw_UGF1_comm_lost "FPrm_switches(510)" VALUE 0x001C73D6 /* @ECU_Address@FPrm_switches@0x021B93FC@ */ ECIPP_ALIGNMENT_UWORD 65535 Compu_IDENTITY 0 65535 PHYS_UNIT "Enable bits" /end CHARACTERISTIC
/begin CHARACTERISTIC FPsw_UGF1_drifttl2 "FPrm_switches(406)" VALUE 0x001C7306 /* @ECU_Address@FPrm_switches@0x021B932C@ */ ECIPP_ALIGNMENT_UWORD 65535 Compu_IDENTITY 0 65535 PHYS_UNIT "Enable bits" /end CHARACTERISTIC
/begin CHARACTERISTIC FPsw_UGF1_drifttol "FPrm_switches(384)" VALUE 0x001C72DA /* @ECU_Address@FPrm_switches@0x021B9300@ */ ECIPP_ALIGNMENT_UWORD 65535 Compu_IDENTITY 0 65535 PHYS_UNIT "Enable bits" /end CHARACTERISTIC
/begin CHARACTERISTIC FPsw_UGF1_R_hi "FPrm_switches(191)" VALUE 0x001C7158 /* @ECU_Address@FPrm_switches@0x021B917E@ */ ECIPP_ALIGNMENT_UWORD 65535 Compu_IDENTITY 0 65535 PHYS_UNIT "Enable bits" /end CHARACTERISTIC
/begin CHARACTERISTIC FPsw_UGF1_SR_hi "FPrm_switches(194)" VALUE 0x001C715E /* @ECU_Address@FPrm_switches@0x021B9184@ */ ECIPP_ALIGNMENT_UWORD 65535 Compu_IDENTITY 0 65535 PHYS_UNIT "Enable bits" /end CHARACTERISTIC
/begin CHARACTERISTIC FPsw_UGF1_SR_slow "FPrm_switches(193)" VALUE 0x001C715C /* @ECU_Address@FPrm_switches@0x021B9182@ */ ECIPP_ALIGNMENT_UWORD 65535 Compu_IDENTITY 0 65535 PHYS_UNIT "Enable bits" /end CHARACTERISTIC
/begin CHARACTERISTIC FPsw_UGF1_Sv_hi "FPrm_switches(192)" VALUE 0x001C715A /* @ECU_Address@FPrm_switches@0x021B9180@ */ ECIPP_ALIGNMENT_UWORD 65535 Compu_IDENTITY 0 65535 PHYS_UNIT "Enable bits" /end CHARACTERISTIC
/begin CHARACTERISTIC FPsw_UGF2_comm_lost "FPrm_switches(511)" VALUE 0x001C73D8 /* @ECU_Address@FPrm_switches@0x021B93FE@ */ ECIPP_ALIGNMENT_UWORD 65535 Compu_IDENTITY 0 65535 PHYS_UNIT "Enable bits" /end CHARACTERISTIC
/begin CHARACTERISTIC FPsw_UGF2_drifttl2 "FPrm_switches(407)" VALUE 0x001C7308 /* @ECU_Address@FPrm_switches@0x021B932E@ */ ECIPP_ALIGNMENT_UWORD 65535 Compu_IDENTITY 0 65535 PHYS_UNIT "Enable bits" /end CHARACTERISTIC
/begin CHARACTERISTIC FCdtc_start_coilshort "FCtl_DTC(163)" VALUE 0x001E39B0 /* @ECU_Address@FCtl_DTC@0x021B5146@ */ ECIPP_ALIGNMENT_UWORD 65535 Compu_IDENTITY 0 65535 PHYS_UNIT "DTC" /end CHARACTERISTIC
/begin CHARACTERISTIC FCdtc_start_excess "FCtl_DTC(840)" VALUE 0x001E3EFA /* @ECU_Address@FCtl_DTC@0x021B5690@ */ ECIPP_ALIGNMENT_UWORD 65535 Compu_IDENTITY 0 65535 PHYS_UNIT "DTC" /end CHARACTERISTIC
/begin CHARACTERISTIC FCdtc_start_gndshort "FCtl_DTC(161)" VALUE 0x001E39AC /* @ECU_Address@FCtl_DTC@0x021B5142@ */ ECIPP_ALIGNMENT_UWORD 65535 Compu_IDENTITY 0 65535 PHYS_UNIT "DTC" /end CHARACTERISTIC
/begin CHARACTERISTIC FCdtc_start_stuck_active "FCtl_DTC(320)" VALUE 0x001E3AEA /* @ECU_Address@FCtl_DTC@0x021B5280@ */ ECIPP_ALIGNMENT_UWORD 65535 Compu_IDENTITY 0 65535 PHYS_UNIT "DTC" /end CHARACTERISTIC
/begin CHARACTERISTIC FCdtc_SubDiagTemp "FCtl_DTC(653)" VALUE 0x001E3D84 /* @ECU_Address@FCtl_DTC@0x021B551A@ */ ECIPP_ALIGNMENT_UWORD 65535 Compu_IDENTITY 0 65535 PHYS_UNIT "DTC" /end CHARACTERISTIC
/begin CHARACTERISTIC FCdtc_tach_gndshort "FCtl_DTC(173)" VALUE 0x001E39C4 /* @ECU_Address@FCtl_DTC@0x021B515A@ */ ECIPP_ALIGNMENT_UWORD 65535 Compu_IDENTITY 0 65535 PHYS_UNIT "DTC" /end CHARACTERISTIC
/begin CHARACTERISTIC FCdtc_tach_pwrshort "FCtl_DTC(174)" VALUE 0x001E39C6 /* @ECU_Address@FCtl_DTC@0x021B515C@ */ ECIPP_ALIGNMENT_UWORD 65535 Compu_IDENTITY 0 65535 PHYS_UNIT "DTC" /end CHARACTERISTIC
/begin CHARACTERISTIC FCdtc_TANK_1_V_maxv "FCtl_DTC(871)" VALUE 0x001E3F38 /* @ECU_Address@FCtl_DTC@0x021B56CE@ */ ECIPP_ALIGNMENT_UWORD 65535 Compu_IDENTITY 0 65535 PHYS_UNIT "DTC" /end CHARACTERISTIC
/begin CHARACTERISTIC FCdtc_TANK_1_V_minv "FCtl_DTC(873)" VALUE 0x001E3F3C /* @ECU_Address@FCtl_DTC@0x021B56D2@ */ ECIPP_ALIGNMENT_UWORD 65535 Compu_IDENTITY 0 65535 PHYS_UNIT "DTC" /end CHARACTERISTIC
/begin CHARACTERISTIC FCdtc_TANK_1_V_slow "FCtl_DTC(875)" VALUE 0x001E3F40 /* @ECU_Address@FCtl_DTC@0x021B56D6@ */ ECIPP_ALIGNMENT_UWORD 65535 Compu_IDENTITY 0 65535 PHYS_UNIT "DTC" /end CHARACTERISTIC
/begin CHARACTERISTIC FCdtc_TAUX_dT1_max "FCtl_DTC(558)" VALUE 0x001E3CC6 /* @ECU_Address@FCtl_DTC@0x021B545C@ */ ECIPP_ALIGNMENT_UWORD 65535 Compu_IDENTITY 0 65535 PHYS_UNIT "DTC" /end CHARACTERISTIC
/begin CHARACTERISTIC FCdtc_TAUX_dT1_min "FCtl_DTC(559)" VALUE 0x001E3CC8 /* @ECU_Address@FCtl_DTC@0x021B545E@ */ ECIPP_ALIGNMENT_UWORD 65535 Compu_IDENTITY 0 65535 PHYS_UNIT "DTC" /end CHARACTERISTIC
/begin CHARACTERISTIC FCdtc_TAUX_dT2_max "FCtl_DTC(560)" VALUE 0x001E3CCA /* @ECU_Address@FCtl_DTC@0x021B5460@ */ ECIPP_ALIGNMENT_UWORD 65535 Compu_IDENTITY 0 65535 PHYS_UNIT "DTC" /end CHARACTERISTIC
/begin CHARACTERISTIC FCdtc_TAUX_dT2_min "FCtl_DTC(561)" VALUE 0x001E3CCC /* @ECU_Address@FCtl_DTC@0x021B5462@ */ ECIPP_ALIGNMENT_UWORD 65535 Compu_IDENTITY 0 65535 PHYS_UNIT "DTC" /end CHARACTERISTIC
/begin CHARACTERISTIC FCdtc_Taux1_derate_actv "FCtl_DTC(812)" VALUE 0x001E3EC2 /* @ECU_Address@FCtl_DTC@0x021B5658@ */ ECIPP_ALIGNMENT_UWORD 65535 Compu_IDENTITY 0 65535 PHYS_UNIT "DTC" /end CHARACTERISTIC
/begin CHARACTERISTIC FCdtc_TAUX1_max "FCtl_DTC(550)" VALUE 0x001E3CB6 /* @ECU_Address@FCtl_DTC@0x021B544C@ */ ECIPP_ALIGNMENT_UWORD 65535 Compu_IDENTITY 0 65535 PHYS_UNIT "DTC" /end CHARACTERISTIC
/begin CHARACTERISTIC FCdtc_TAUX1_min "FCtl_DTC(551)" VALUE 0x001E3CB8 /* @ECU_Address@FCtl_DTC@0x021B544E@ */ ECIPP_ALIGNMENT_UWORD 65535 Compu_IDENTITY 0 65535 PHYS_UNIT "DTC" /end CHARACTERISTIC
/begin CHARACTERISTIC FCdtc_Taux2_derate_actv "FCtl_DTC(813)" VALUE 0x001E3EC4 /* @ECU_Address@FCtl_DTC@0x021B565A@ */ ECIPP_ALIGNMENT_UWORD 65535 Compu_IDENTITY 0 65535 PHYS_UNIT "DTC" /end CHARACTERISTIC
/begin CHARACTERISTIC FCdtc_TAUX2_max "FCtl_DTC(552)" VALUE 0x001E3CBA /* @ECU_Address@FCtl_DTC@0x021B5450@ */ ECIPP_ALIGNMENT_UWORD 65535 Compu_IDENTITY 0 65535 PHYS_UNIT "DTC" /end CHARACTERISTIC
/begin CHARACTERISTIC FCdtc_TAUX2_min "FCtl_DTC(553)" VALUE 0x001E3CBC /* @ECU_Address@FCtl_DTC@0x021B5452@ */ ECIPP_ALIGNMENT_UWORD 65535 Compu_IDENTITY 0 65535 PHYS_UNIT "DTC" /end CHARACTERISTIC
/begin CHARACTERISTIC FCdtc_TAUX3_max "FCtl_DTC(554)" VALUE 0x001E3CBE /* @ECU_Address@FCtl_DTC@0x021B5454@ */ ECIPP_ALIGNMENT_UWORD 65535 Compu_IDENTITY 0 65535 PHYS_UNIT "DTC" /end CHARACTERISTIC
/begin CHARACTERISTIC FCdtc_TAUX3_min "FCtl_DTC(555)" VALUE 0x001E3CC0 /* @ECU_Address@FCtl_DTC@0x021B5456@ */ ECIPP_ALIGNMENT_UWORD 65535 Compu_IDENTITY 0 65535 PHYS_UNIT "DTC" /end CHARACTERISTIC
/begin CHARACTERISTIC FCdtc_TAUX4_max "FCtl_DTC(556)" VALUE 0x001E3CC2 /* @ECU_Address@FCtl_DTC@0x021B5458@ */ ECIPP_ALIGNMENT_UWORD 65535 Compu_IDENTITY 0 65535 PHYS_UNIT "DTC" /end CHARACTERISTIC
/begin CHARACTERISTIC FCdtc_TAUX4_min "FCtl_DTC(557)" VALUE 0x001E3CC4 /* @ECU_Address@FCtl_DTC@0x021B545A@ */ ECIPP_ALIGNMENT_UWORD 65535 Compu_IDENTITY 0 65535 PHYS_UNIT "DTC" /end CHARACTERISTIC
/begin CHARACTERISTIC FCdtc_TEL_derate_actv "FCtl_DTC(647)" VALUE 0x001E3D78 /* @ECU_Address@FCtl_DTC@0x021B550E@ */ ECIPP_ALIGNMENT_UWORD 65535 Compu_IDENTITY 0 65535 PHYS_UNIT "DTC" /end CHARACTERISTIC
/begin CHARACTERISTIC FCdtc_TEL_dis "FCtl_DTC(854)" VALUE 0x001E3F16 /* @ECU_Address@FCtl_DTC@0x021B56AC@ */ ECIPP_ALIGNMENT_UWORD 65535 Compu_IDENTITY 0 65535 PHYS_UNIT "DTC" /end CHARACTERISTIC
/begin CHARACTERISTIC FCdtc_TEL_intF "FCtl_DTC(855)" VALUE 0x001E3F18 /* @ECU_Address@FCtl_DTC@0x021B56AE@ */ ECIPP_ALIGNMENT_UWORD 65535 Compu_IDENTITY 0 65535 PHYS_UNIT "DTC" /end CHARACTERISTIC
/begin CHARACTERISTIC FCdtc_TEL_key_invalid "FCtl_DTC(821)" VALUE 0x001E3ED4 /* @ECU_Address@FCtl_DTC@0x021B566A@ */ ECIPP_ALIGNMENT_UWORD 65535 Compu_IDENTITY 0 65535 PHYS_UNIT "DTC" /end CHARACTERISTIC
/begin CHARACTERISTIC FCdtc_TEL_key_to "FCtl_DTC(820)" VALUE 0x001E3ED2 /* @ECU_Address@FCtl_DTC@0x021B5668@ */ ECIPP_ALIGNMENT_UWORD 65535 Compu_IDENTITY 0 65535 PHYS_UNIT "DTC" /end CHARACTERISTIC
/begin CHARACTERISTIC FCdtc_TEL_req_to "FCtl_DTC(819)" VALUE 0x001E3ED0 /* @ECU_Address@FCtl_DTC@0x021B5666@ */ ECIPP_ALIGNMENT_UWORD 65535 Compu_IDENTITY 0 65535 PHYS_UNIT "DTC" /end CHARACTERISTIC
/begin CHARACTERISTIC FCdtc_TEL_RPM_cmd "FCtl_DTC(822)" VALUE 0x001E3ED6 /* @ECU_Address@FCtl_DTC@0x021B566C@ */ ECIPP_ALIGNMENT_UWORD 65535 Compu_IDENTITY 0 65535 PHYS_UNIT "DTC" /end CHARACTERISTIC
/begin CHARACTERISTIC FCdtc_TEL_RPM_psv "FCtl_DTC(825)" VALUE 0x001E3EDC /* @ECU_Address@FCtl_DTC@0x021B5672@ */ ECIPP_ALIGNMENT_UWORD 65535 Compu_IDENTITY 0 65535 PHYS_UNIT "DTC" /end CHARACTERISTIC
/begin CHARACTERISTIC FCdtc_TEL_shutdown_cmd "FCtl_DTC(824)" VALUE 0x001E3EDA /* @ECU_Address@FCtl_DTC@0x021B5670@ */ ECIPP_ALIGNMENT_UWORD 65535 Compu_IDENTITY 0 65535 PHYS_UNIT "DTC" /end CHARACTERISTIC
/begin CHARACTERISTIC FCdtc_TEL_shutdown_psv "FCtl_DTC(827)" VALUE 0x001E3EE0 /* @ECU_Address@FCtl_DTC@0x021B5676@ */ ECIPP_ALIGNMENT_UWORD 65535 Compu_IDENTITY 0 65535 PHYS_UNIT "DTC" /end CHARACTERISTIC
/begin CHARACTERISTIC FCdtc_TEL_torq_cmd "FCtl_DTC(823)" VALUE 0x001E3ED8 /* @ECU_Address@FCtl_DTC@0x021B566E@ */ ECIPP_ALIGNMENT_UWORD 65535 Compu_IDENTITY 0 65535 PHYS_UNIT "DTC" /end CHARACTERISTIC
/begin CHARACTERISTIC FCdtc_TEL_torq_psv "FCtl_DTC(826)" VALUE 0x001E3EDE /* @ECU_Address@FCtl_DTC@0x021B5674@ */ ECIPP_ALIGNMENT_UWORD 65535 Compu_IDENTITY 0 65535 PHYS_UNIT "DTC" /end CHARACTERISTIC
/begin CHARACTERISTIC FCdtc_TIP_act "FCtl_DTC(145)" VALUE 0x001E398C /* @ECU_Address@FCtl_DTC@0x021B5122@ */ ECIPP_ALIGNMENT_UWORD 65535 Compu_IDENTITY 0 65535 PHYS_UNIT "DTC" /end CHARACTERISTIC
/begin CHARACTERISTIC FCdtc_TIP_maxv "FCtl_DTC(126)" VALUE 0x001E3966 /* @ECU_Address@FCtl_DTC@0x021B50FC@ */ ECIPP_ALIGNMENT_UWORD 65535 Compu_IDENTITY 0 65535 PHYS_UNIT "DTC" /end CHARACTERISTIC
/begin CHARACTERISTIC FCdtc_TIP_minv "FCtl_DTC(127)" VALUE 0x001E3968 /* @ECU_Address@FCtl_DTC@0x021B50FE@ */ ECIPP_ALIGNMENT_UWORD 65535 Compu_IDENTITY 0 65535 PHYS_UNIT "DTC" /end CHARACTERISTIC
/begin CHARACTERISTIC FCdtc_TPS1_max "FCtl_DTC(13)" VALUE 0x001E3884 /* @ECU_Address@FCtl_DTC@0x021B501A@ */ ECIPP_ALIGNMENT_UWORD 65535 Compu_IDENTITY 0 65535 PHYS_UNIT "DTC" /end CHARACTERISTIC
/begin CHARACTERISTIC FCdtc_TPS1_min "FCtl_DTC(14)" VALUE 0x001E3886 /* @ECU_Address@FCtl_DTC@0x021B501C@ */ ECIPP_ALIGNMENT_UWORD 65535 Compu_IDENTITY 0 65535 PHYS_UNIT "DTC" /end CHARACTERISTIC
/begin CHARACTERISTIC FCdtc_TPS12_OOR "FCtl_DTC(186)" VALUE 0x001E39DE /* @ECU_Address@FCtl_DTC@0x021B5174@ */ ECIPP_ALIGNMENT_UWORD 65535 Compu_IDENTITY 0 65535 PHYS_UNIT "DTC" /end CHARACTERISTIC
/begin CHARACTERISTIC FCdtc_TPS12pct_hi "FCtl_DTC(17)" VALUE 0x001E388C /* @ECU_Address@FCtl_DTC@0x021B5022@ */ ECIPP_ALIGNMENT_UWORD 65535 Compu_IDENTITY 0 65535 PHYS_UNIT "DTC" /end CHARACTERISTIC
/begin CHARACTERISTIC FCdtc_TPS12pct_lo "FCtl_DTC(18)" VALUE 0x001E388E /* @ECU_Address@FCtl_DTC@0x021B5024@ */ ECIPP_ALIGNMENT_UWORD 65535 Compu_IDENTITY 0 65535 PHYS_UNIT "DTC" /end CHARACTERISTIC
/begin CHARACTERISTIC FCdtc_TPS2_max "FCtl_DTC(15)" VALUE 0x001E3888 /* @ECU_Address@FCtl_DTC@0x021B501E@ */ ECIPP_ALIGNMENT_UWORD 65535 Compu_IDENTITY 0 65535 PHYS_UNIT "DTC" /end CHARACTERISTIC
/begin CHARACTERISTIC FCdtc_TPS2_min "FCtl_DTC(16)" VALUE 0x001E388A /* @ECU_Address@FCtl_DTC@0x021B5020@ */ ECIPP_ALIGNMENT_UWORD 65535 Compu_IDENTITY 0 65535 PHYS_UNIT "DTC" /end CHARACTERISTIC
/begin CHARACTERISTIC FCdtc_TPSerr_neg "FCtl_DTC(91)" VALUE 0x001E3920 /* @ECU_Address@FCtl_DTC@0x021B50B6@ */ ECIPP_ALIGNMENT_UWORD 65535 Compu_IDENTITY 0 65535 PHYS_UNIT "DTC" /end CHARACTERISTIC
/begin CHARACTERISTIC FCdtc_TPSerr_pos "FCtl_DTC(90)" VALUE 0x001E391E /* @ECU_Address@FCtl_DTC@0x021B50B4@ */ ECIPP_ALIGNMENT_UWORD 65535 Compu_IDENTITY 0 65535 PHYS_UNIT "DTC" /end CHARACTERISTIC
/begin CHARACTERISTIC FCdtc_TRANS_comm "FCtl_DTC(851)" VALUE 0x001E3F10 /* @ECU_Address@FCtl_DTC@0x021B56A6@ */ ECIPP_ALIGNMENT_UWORD 65535 Compu_IDENTITY 0 65535 PHYS_UNIT "DTC" /end CHARACTERISTIC
/begin CHARACTERISTIC FCdtc_TRANS_fuel_inh "FCtl_DTC(852)" VALUE 0x001E3F12 /* @ECU_Address@FCtl_DTC@0x021B56A8@ */ ECIPP_ALIGNMENT_UWORD 65535 Compu_IDENTITY 0 65535 PHYS_UNIT "DTC" /end CHARACTERISTIC
/begin CHARACTERISTIC FCdtc_TWCDiag_OSC_lo "FCtl_DTC(804)" VALUE 0x001E3EB2 /* @ECU_Address@FCtl_DTC@0x021B5648@ */ ECIPP_ALIGNMENT_UWORD 65535 Compu_IDENTITY 0 65535 PHYS_UNIT "DTC" /end CHARACTERISTIC
/begin CHARACTERISTIC FCdtc_UEGOH1_off_open "FCtl_DTC(427)" VALUE 0x001E3BC0 /* @ECU_Address@FCtl_DTC@0x021B5356@ */ ECIPP_ALIGNMENT_UWORD 65535 Compu_IDENTITY 0 65535 PHYS_UNIT "DTC" /end CHARACTERISTIC
/begin CHARACTERISTIC FCdtc_UEGOH1_on_short "FCtl_DTC(428)" VALUE 0x001E3BC2 /* @ECU_Address@FCtl_DTC@0x021B5358@ */ ECIPP_ALIGNMENT_UWORD 65535 Compu_IDENTITY 0 65535 PHYS_UNIT "DTC" /end CHARACTERISTIC
/begin CHARACTERISTIC FCdtc_UEGOH2_off_open "FCtl_DTC(429)" VALUE 0x001E3BC4 /* @ECU_Address@FCtl_DTC@0x021B535A@ */ ECIPP_ALIGNMENT_UWORD 65535 Compu_IDENTITY 0 65535 PHYS_UNIT "DTC" /end CHARACTERISTIC
/begin CHARACTERISTIC FCdtc_UEGOH2_on_short "FCtl_DTC(430)" VALUE 0x001E3BC6 /* @ECU_Address@FCtl_DTC@0x021B535C@ */ ECIPP_ALIGNMENT_UWORD 65535 Compu_IDENTITY 0 65535 PHYS_UNIT "DTC" /end CHARACTERISTIC
/begin CHARACTERISTIC FCdtc_UEGOH3_off_open "FCtl_DTC(622)" VALUE 0x001E3D46 /* @ECU_Address@FCtl_DTC@0x021B54DC@ */ ECIPP_ALIGNMENT_UWORD 65535 Compu_IDENTITY 0 65535 PHYS_UNIT "DTC" /end CHARACTERISTIC
/begin CHARACTERISTIC FCdtc_UEGOH3_on_short "FCtl_DTC(623)" VALUE 0x001E3D48 /* @ECU_Address@FCtl_DTC@0x021B54DE@ */ ECIPP_ALIGNMENT_UWORD 65535 Compu_IDENTITY 0 65535 PHYS_UNIT "DTC" /end CHARACTERISTIC
/begin CHARACTERISTIC FCdtc_UEGOH4_off_open "FCtl_DTC(645)" VALUE 0x001E3D74 /* @ECU_Address@FCtl_DTC@0x021B550A@ */ ECIPP_ALIGNMENT_UWORD 65535 Compu_IDENTITY 0 65535 PHYS_UNIT "DTC" /end CHARACTERISTIC
/begin CHARACTERISTIC FCdtc_UEGOH4_on_short "FCtl_DTC(646)" VALUE 0x001E3D76 /* @ECU_Address@FCtl_DTC@0x021B550C@ */ ECIPP_ALIGNMENT_UWORD 65535 Compu_IDENTITY 0 65535 PHYS_UNIT "DTC" /end CHARACTERISTIC
/begin CHARACTERISTIC FCdtc_UGF_Hv_hi "FCtl_DTC(242)" VALUE 0x001E3A4E /* @ECU_Address@FCtl_DTC@0x021B51E4@ */ ECIPP_ALIGNMENT_UWORD 65535 Compu_IDENTITY 0 65535 PHYS_UNIT "DTC" /end CHARACTERISTIC
/begin CHARACTERISTIC FCdtc_UGF_internal "FCtl_DTC(241)" VALUE 0x001E3A4C /* @ECU_Address@FCtl_DTC@0x021B51E2@ */ ECIPP_ALIGNMENT_UWORD 65535 Compu_IDENTITY 0 65535 PHYS_UNIT "DTC" /end CHARACTERISTIC
/begin CHARACTERISTIC FCdtc_UGF_lowsupply "FCtl_DTC(530)" VALUE 0x001E3C8E /* @ECU_Address@FCtl_DTC@0x021B5424@ */ ECIPP_ALIGNMENT_UWORD 65535 Compu_IDENTITY 0 65535 PHYS_UNIT "DTC" /end CHARACTERISTIC
/begin CHARACTERISTIC FCdtc_UGF1_comm_lost "FCtl_DTC(680)" VALUE 0x001E3DBA /* @ECU_Address@FCtl_DTC@0x021B5550@ */ ECIPP_ALIGNMENT_UWORD 65535 Compu_IDENTITY 0 65535 PHYS_UNIT "DTC" /end CHARACTERISTIC
/begin CHARACTERISTIC FCdtc_UGF1_drifttl2 "FCtl_DTC(536)" VALUE 0x001E3C9A /* @ECU_Address@FCtl_DTC@0x021B5430@ */ ECIPP_ALIGNMENT_UWORD 65535 Compu_IDENTITY 0 65535 PHYS_UNIT "DTC" /end CHARACTERISTIC
/begin CHARACTERISTIC FCdtc_UGF1_drifttol "FCtl_DTC(505)" VALUE 0x001E3C5C /* @ECU_Address@FCtl_DTC@0x021B53F2@ */ ECIPP_ALIGNMENT_UWORD 65535 Compu_IDENTITY 0 65535 PHYS_UNIT "DTC" /end CHARACTERISTIC
/begin CHARACTERISTIC FCdtc_UGF1_R_hi "FCtl_DTC(244)" VALUE 0x001E3A52 /* @ECU_Address@FCtl_DTC@0x021B51E8@ */ ECIPP_ALIGNMENT_UWORD 65535 Compu_IDENTITY 0 65535 PHYS_UNIT "DTC" /end CHARACTERISTIC
/begin CHARACTERISTIC FCdtc_UGF1_SR_hi "FCtl_DTC(256)" VALUE 0x001E3A6A /* @ECU_Address@FCtl_DTC@0x021B5200@ */ ECIPP_ALIGNMENT_UWORD 65535 Compu_IDENTITY 0 65535 PHYS_UNIT "DTC" /end CHARACTERISTIC
/begin CHARACTERISTIC FCdtc_UGF1_SR_slow "FCtl_DTC(254)" VALUE 0x001E3A66 /* @ECU_Address@FCtl_DTC@0x021B51FC@ */ ECIPP_ALIGNMENT_UWORD 65535 Compu_IDENTITY 0 65535 PHYS_UNIT "DTC" /end CHARACTERISTIC
/begin CHARACTERISTIC FCdtc_UGF1_Sv_hi "FCtl_DTC(250)" VALUE 0x001E3A5E /* @ECU_Address@FCtl_DTC@0x021B51F4@ */ ECIPP_ALIGNMENT_UWORD 65535 Compu_IDENTITY 0 65535 PHYS_UNIT "DTC" /end CHARACTERISTIC
/begin CHARACTERISTIC FCdtc_UGF2_comm_lost "FCtl_DTC(681)" VALUE 0x001E3DBC /* @ECU_Address@FCtl_DTC@0x021B5552@ */ ECIPP_ALIGNMENT_UWORD 65535 Compu_IDENTITY 0 65535 PHYS_UNIT "DTC" /end CHARACTERISTIC
/begin CHARACTERISTIC FCdtc_UGF2_drifttl2 "FCtl_DTC(537)" VALUE 0x001E3C9C /* @ECU_Address@FCtl_DTC@0x021B5432@ */ ECIPP_ALIGNMENT_UWORD 65535 Compu_IDENTITY 0 65535 PHYS_UNIT "DTC" /end CHARACTERISTIC
/begin CHARACTERISTIC FCfmi_start_coilshort "FCtl_FMI(163)" VALUE 0x001E59A4 /* @ECU_Address@FCtl_FMI@0x021B70A3@ */ ECIPP_ALIGNMENT_UBYTE 255 Compu_IDENTITY 0 255 PHYS_UNIT "FMI" /end CHARACTERISTIC
/begin CHARACTERISTIC FCfmi_start_excess "FCtl_FMI(840)" VALUE 0x001E5C49 /* @ECU_Address@FCtl_FMI@0x021B7348@ */ ECIPP_ALIGNMENT_UBYTE 255 Compu_IDENTITY 0 255 PHYS_UNIT "FMI" /end CHARACTERISTIC
/begin CHARACTERISTIC FCfmi_start_gndshort "FCtl_FMI(161)" VALUE 0x001E59A2 /* @ECU_Address@FCtl_FMI@0x021B70A1@ */ ECIPP_ALIGNMENT_UBYTE 255 Compu_IDENTITY 0 255 PHYS_UNIT "FMI" /end CHARACTERISTIC
/begin CHARACTERISTIC FCfmi_start_stuck_active "FCtl_FMI(320)" VALUE 0x001E5A41 /* @ECU_Address@FCtl_FMI@0x021B7140@ */ ECIPP_ALIGNMENT_UBYTE 255 Compu_IDENTITY 0 255 PHYS_UNIT "FMI" /end CHARACTERISTIC
/begin CHARACTERISTIC FCfmi_SubDiagTemp "FCtl_FMI(653)" VALUE 0x001E5B8E /* @ECU_Address@FCtl_FMI@0x021B728D@ */ ECIPP_ALIGNMENT_UBYTE 255 Compu_IDENTITY 0 255 PHYS_UNIT "FMI" /end CHARACTERISTIC
/begin CHARACTERISTIC FCfmi_tach_gndshort "FCtl_FMI(173)" VALUE 0x001E59AE /* @ECU_Address@FCtl_FMI@0x021B70AD@ */ ECIPP_ALIGNMENT_UBYTE 255 Compu_IDENTITY 0 255 PHYS_UNIT "FMI" /end CHARACTERISTIC
/begin CHARACTERISTIC FCfmi_tach_pwrshort "FCtl_FMI(174)" VALUE 0x001E59AF /* @ECU_Address@FCtl_FMI@0x021B70AE@ */ ECIPP_ALIGNMENT_UBYTE 255 Compu_IDENTITY 0 255 PHYS_UNIT "FMI" /end CHARACTERISTIC
/begin CHARACTERISTIC FCfmi_TANK_1_V_maxv "FCtl_FMI(871)" VALUE 0x001E5C68 /* @ECU_Address@FCtl_FMI@0x021B7367@ */ ECIPP_ALIGNMENT_UBYTE 255 Compu_IDENTITY 0 255 PHYS_UNIT "FMI" /end CHARACTERISTIC
/begin CHARACTERISTIC FCfmi_TANK_1_V_minv "FCtl_FMI(873)" VALUE 0x001E5C6A /* @ECU_Address@FCtl_FMI@0x021B7369@ */ ECIPP_ALIGNMENT_UBYTE 255 Compu_IDENTITY 0 255 PHYS_UNIT "FMI" /end CHARACTERISTIC
/begin CHARACTERISTIC FCfmi_TANK_1_V_slow "FCtl_FMI(875)" VALUE 0x001E5C6C /* @ECU_Address@FCtl_FMI@0x021B736B@ */ ECIPP_ALIGNMENT_UBYTE 255 Compu_IDENTITY 0 255 PHYS_UNIT "FMI" /end CHARACTERISTIC
/begin CHARACTERISTIC FCfmi_TAUX_dT1_max "FCtl_FMI(558)" VALUE 0x001E5B2F /* @ECU_Address@FCtl_FMI@0x021B722E@ */ ECIPP_ALIGNMENT_UBYTE 255 Compu_IDENTITY 0 255 PHYS_UNIT "FMI" /end CHARACTERISTIC
/begin CHARACTERISTIC FCfmi_TAUX_dT1_min "FCtl_FMI(559)" VALUE 0x001E5B30 /* @ECU_Address@FCtl_FMI@0x021B722F@ */ ECIPP_ALIGNMENT_UBYTE 255 Compu_IDENTITY 0 255 PHYS_UNIT "FMI" /end CHARACTERISTIC
/begin CHARACTERISTIC FCfmi_TAUX_dT2_max "FCtl_FMI(560)" VALUE 0x001E5B31 /* @ECU_Address@FCtl_FMI@0x021B7230@ */ ECIPP_ALIGNMENT_UBYTE 255 Compu_IDENTITY 0 255 PHYS_UNIT "FMI" /end CHARACTERISTIC
/begin CHARACTERISTIC FCfmi_TAUX_dT2_min "FCtl_FMI(561)" VALUE 0x001E5B32 /* @ECU_Address@FCtl_FMI@0x021B7231@ */ ECIPP_ALIGNMENT_UBYTE 255 Compu_IDENTITY 0 255 PHYS_UNIT "FMI" /end CHARACTERISTIC
/begin CHARACTERISTIC FCfmi_Taux1_derate_actv "FCtl_FMI(812)" VALUE 0x001E5C2D /* @ECU_Address@FCtl_FMI@0x021B732C@ */ ECIPP_ALIGNMENT_UBYTE 255 Compu_IDENTITY 0 255 PHYS_UNIT "FMI" /end CHARACTERISTIC
/begin CHARACTERISTIC FCfmi_TAUX1_max "FCtl_FMI(550)" VALUE 0x001E5B27 /* @ECU_Address@FCtl_FMI@0x021B7226@ */ ECIPP_ALIGNMENT_UBYTE 255 Compu_IDENTITY 0 255 PHYS_UNIT "FMI" /end CHARACTERISTIC
/begin CHARACTERISTIC FCfmi_TAUX1_min "FCtl_FMI(551)" VALUE 0x001E5B28 /* @ECU_Address@FCtl_FMI@0x021B7227@ */ ECIPP_ALIGNMENT_UBYTE 255 Compu_IDENTITY 0 255 PHYS_UNIT "FMI" /end CHARACTERISTIC
/begin CHARACTERISTIC FCfmi_Taux2_derate_actv "FCtl_FMI(813)" VALUE 0x001E5C2E /* @ECU_Address@FCtl_FMI@0x021B732D@ */ ECIPP_ALIGNMENT_UBYTE 255 Compu_IDENTITY 0 255 PHYS_UNIT "FMI" /end CHARACTERISTIC
/begin CHARACTERISTIC FCfmi_TAUX2_max "FCtl_FMI(552)" VALUE 0x001E5B29 /* @ECU_Address@FCtl_FMI@0x021B7228@ */ ECIPP_ALIGNMENT_UBYTE 255 Compu_IDENTITY 0 255 PHYS_UNIT "FMI" /end CHARACTERISTIC
/begin CHARACTERISTIC FCfmi_TAUX2_min "FCtl_FMI(553)" VALUE 0x001E5B2A /* @ECU_Address@FCtl_FMI@0x021B7229@ */ ECIPP_ALIGNMENT_UBYTE 255 Compu_IDENTITY 0 255 PHYS_UNIT "FMI" /end CHARACTERISTIC
/begin CHARACTERISTIC FCfmi_TAUX3_max "FCtl_FMI(554)" VALUE 0x001E5B2B /* @ECU_Address@FCtl_FMI@0x021B722A@ */ ECIPP_ALIGNMENT_UBYTE 255 Compu_IDENTITY 0 255 PHYS_UNIT "FMI" /end CHARACTERISTIC
/begin CHARACTERISTIC FCfmi_TAUX3_min "FCtl_FMI(555)" VALUE 0x001E5B2C /* @ECU_Address@FCtl_FMI@0x021B722B@ */ ECIPP_ALIGNMENT_UBYTE 255 Compu_IDENTITY 0 255 PHYS_UNIT "FMI" /end CHARACTERISTIC
/begin CHARACTERISTIC FCfmi_TAUX4_max "FCtl_FMI(556)" VALUE 0x001E5B2D /* @ECU_Address@FCtl_FMI@0x021B722C@ */ ECIPP_ALIGNMENT_UBYTE 255 Compu_IDENTITY 0 255 PHYS_UNIT "FMI" /end CHARACTERISTIC
/begin CHARACTERISTIC FCfmi_TAUX4_min "FCtl_FMI(557)" VALUE 0x001E5B2E /* @ECU_Address@FCtl_FMI@0x021B722D@ */ ECIPP_ALIGNMENT_UBYTE 255 Compu_IDENTITY 0 255 PHYS_UNIT "FMI" /end CHARACTERISTIC
/begin CHARACTERISTIC FCfmi_TEL_derate_actv "FCtl_FMI(647)" VALUE 0x001E5B88 /* @ECU_Address@FCtl_FMI@0x021B7287@ */ ECIPP_ALIGNMENT_UBYTE 255 Compu_IDENTITY 0 255 PHYS_UNIT "FMI" /end CHARACTERISTIC
/begin CHARACTERISTIC FCfmi_TEL_dis "FCtl_FMI(854)" VALUE 0x001E5C57 /* @ECU_Address@FCtl_FMI@0x021B7356@ */ ECIPP_ALIGNMENT_UBYTE 255 Compu_IDENTITY 0 255 PHYS_UNIT "FMI" /end CHARACTERISTIC
/begin CHARACTERISTIC FCfmi_TEL_intF "FCtl_FMI(855)" VALUE 0x001E5C58 /* @ECU_Address@FCtl_FMI@0x021B7357@ */ ECIPP_ALIGNMENT_UBYTE 255 Compu_IDENTITY 0 255 PHYS_UNIT "FMI" /end CHARACTERISTIC
/begin CHARACTERISTIC FCfmi_TEL_key_invalid "FCtl_FMI(821)" VALUE 0x001E5C36 /* @ECU_Address@FCtl_FMI@0x021B7335@ */ ECIPP_ALIGNMENT_UBYTE 255 Compu_IDENTITY 0 255 PHYS_UNIT "FMI" /end CHARACTERISTIC
/begin CHARACTERISTIC FCfmi_TEL_key_to "FCtl_FMI(820)" VALUE 0x001E5C35 /* @ECU_Address@FCtl_FMI@0x021B7334@ */ ECIPP_ALIGNMENT_UBYTE 255 Compu_IDENTITY 0 255 PHYS_UNIT "FMI" /end CHARACTERISTIC
/begin CHARACTERISTIC FCfmi_TEL_req_to "FCtl_FMI(819)" VALUE 0x001E5C34 /* @ECU_Address@FCtl_FMI@0x021B7333@ */ ECIPP_ALIGNMENT_UBYTE 255 Compu_IDENTITY 0 255 PHYS_UNIT "FMI" /end CHARACTERISTIC
/begin CHARACTERISTIC FCfmi_TEL_RPM_cmd "FCtl_FMI(822)" VALUE 0x001E5C37 /* @ECU_Address@FCtl_FMI@0x021B7336@ */ ECIPP_ALIGNMENT_UBYTE 255 Compu_IDENTITY 0 255 PHYS_UNIT "FMI" /end CHARACTERISTIC
/begin CHARACTERISTIC FCfmi_TEL_RPM_psv "FCtl_FMI(825)" VALUE 0x001E5C3A /* @ECU_Address@FCtl_FMI@0x021B7339@ */ ECIPP_ALIGNMENT_UBYTE 255 Compu_IDENTITY 0 255 PHYS_UNIT "FMI" /end CHARACTERISTIC
/begin CHARACTERISTIC FCfmi_TEL_shutdown_cmd "FCtl_FMI(824)" VALUE 0x001E5C39 /* @ECU_Address@FCtl_FMI@0x021B7338@ */ ECIPP_ALIGNMENT_UBYTE 255 Compu_IDENTITY 0 255 PHYS_UNIT "FMI" /end CHARACTERISTIC
/begin CHARACTERISTIC FCfmi_TEL_shutdown_psv "FCtl_FMI(827)" VALUE 0x001E5C3C /* @ECU_Address@FCtl_FMI@0x021B733B@ */ ECIPP_ALIGNMENT_UBYTE 255 Compu_IDENTITY 0 255 PHYS_UNIT "FMI" /end CHARACTERISTIC
/begin CHARACTERISTIC FCfmi_TEL_torq_cmd "FCtl_FMI(823)" VALUE 0x001E5C38 /* @ECU_Address@FCtl_FMI@0x021B7337@ */ ECIPP_ALIGNMENT_UBYTE 255 Compu_IDENTITY 0 255 PHYS_UNIT "FMI" /end CHARACTERISTIC
/begin CHARACTERISTIC FCfmi_TEL_torq_psv "FCtl_FMI(826)" VALUE 0x001E5C3B /* @ECU_Address@FCtl_FMI@0x021B733A@ */ ECIPP_ALIGNMENT_UBYTE 255 Compu_IDENTITY 0 255 PHYS_UNIT "FMI" /end CHARACTERISTIC
/begin CHARACTERISTIC FCfmi_TIP_act "FCtl_FMI(145)" VALUE 0x001E5992 /* @ECU_Address@FCtl_FMI@0x021B7091@ */ ECIPP_ALIGNMENT_UBYTE 255 Compu_IDENTITY 0 255 PHYS_UNIT "FMI" /end CHARACTERISTIC
/begin CHARACTERISTIC FCfmi_TIP_maxv "FCtl_FMI(126)" VALUE 0x001E597F /* @ECU_Address@FCtl_FMI@0x021B707E@ */ ECIPP_ALIGNMENT_UBYTE 255 Compu_IDENTITY 0 255 PHYS_UNIT "FMI" /end CHARACTERISTIC
/begin CHARACTERISTIC FCfmi_TIP_minv "FCtl_FMI(127)" VALUE 0x001E5980 /* @ECU_Address@FCtl_FMI@0x021B707F@ */ ECIPP_ALIGNMENT_UBYTE 255 Compu_IDENTITY 0 255 PHYS_UNIT "FMI" /end CHARACTERISTIC
/begin CHARACTERISTIC FCfmi_TPS1_max "FCtl_FMI(13)" VALUE 0x001E590E /* @ECU_Address@FCtl_FMI@0x021B700D@ */ ECIPP_ALIGNMENT_UBYTE 255 Compu_IDENTITY 0 255 PHYS_UNIT "FMI" /end CHARACTERISTIC
/begin CHARACTERISTIC FCfmi_TPS1_min "FCtl_FMI(14)" VALUE 0x001E590F /* @ECU_Address@FCtl_FMI@0x021B700E@ */ ECIPP_ALIGNMENT_UBYTE 255 Compu_IDENTITY 0 255 PHYS_UNIT "FMI" /end CHARACTERISTIC
/begin CHARACTERISTIC FCfmi_TPS12_OOR "FCtl_FMI(186)" VALUE 0x001E59BB /* @ECU_Address@FCtl_FMI@0x021B70BA@ */ ECIPP_ALIGNMENT_UBYTE 255 Compu_IDENTITY 0 255 PHYS_UNIT "FMI" /end CHARACTERISTIC
/begin CHARACTERISTIC FCfmi_TPS12pct_hi "FCtl_FMI(17)" VALUE 0x001E5912 /* @ECU_Address@FCtl_FMI@0x021B7011@ */ ECIPP_ALIGNMENT_UBYTE 255 Compu_IDENTITY 0 255 PHYS_UNIT "FMI" /end CHARACTERISTIC
/begin CHARACTERISTIC FCfmi_TPS12pct_lo "FCtl_FMI(18)" VALUE 0x001E5913 /* @ECU_Address@FCtl_FMI@0x021B7012@ */ ECIPP_ALIGNMENT_UBYTE 255 Compu_IDENTITY 0 255 PHYS_UNIT "FMI" /end CHARACTERISTIC
/begin CHARACTERISTIC FCfmi_TPS2_max "FCtl_FMI(15)" VALUE 0x001E5910 /* @ECU_Address@FCtl_FMI@0x021B700F@ */ ECIPP_ALIGNMENT_UBYTE 255 Compu_IDENTITY 0 255 PHYS_UNIT "FMI" /end CHARACTERISTIC
/begin CHARACTERISTIC FCfmi_TPS2_min "FCtl_FMI(16)" VALUE 0x001E5911 /* @ECU_Address@FCtl_FMI@0x021B7010@ */ ECIPP_ALIGNMENT_UBYTE 255 Compu_IDENTITY 0 255 PHYS_UNIT "FMI" /end CHARACTERISTIC
/begin CHARACTERISTIC FCfmi_TPSerr_neg "FCtl_FMI(91)" VALUE 0x001E595C /* @ECU_Address@FCtl_FMI@0x021B705B@ */ ECIPP_ALIGNMENT_UBYTE 255 Compu_IDENTITY 0 255 PHYS_UNIT "FMI" /end CHARACTERISTIC
/begin CHARACTERISTIC FCfmi_TPSerr_pos "FCtl_FMI(90)" VALUE 0x001E595B /* @ECU_Address@FCtl_FMI@0x021B705A@ */ ECIPP_ALIGNMENT_UBYTE 255 Compu_IDENTITY 0 255 PHYS_UNIT "FMI" /end CHARACTERISTIC
/begin CHARACTERISTIC FCfmi_TRANS_comm "FCtl_FMI(851)" VALUE 0x001E5C54 /* @ECU_Address@FCtl_FMI@0x021B7353@ */ ECIPP_ALIGNMENT_UBYTE 255 Compu_IDENTITY 0 255 PHYS_UNIT "FMI" /end CHARACTERISTIC
/begin CHARACTERISTIC FCfmi_TRANS_fuel_inh "FCtl_FMI(852)" VALUE 0x001E5C55 /* @ECU_Address@FCtl_FMI@0x021B7354@ */ ECIPP_ALIGNMENT_UBYTE 255 Compu_IDENTITY 0 255 PHYS_UNIT "FMI" /end CHARACTERISTIC
/begin CHARACTERISTIC FCfmi_TWCDiag_OSC_lo "FCtl_FMI(804)" VALUE 0x001E5C25 /* @ECU_Address@FCtl_FMI@0x021B7324@ */ ECIPP_ALIGNMENT_UBYTE 255 Compu_IDENTITY 0 255 PHYS_UNIT "FMI" /end CHARACTERISTIC
/begin CHARACTERISTIC FCfmi_UEGOH1_off_open "FCtl_FMI(427)" VALUE 0x001E5AAC /* @ECU_Address@FCtl_FMI@0x021B71AB@ */ ECIPP_ALIGNMENT_UBYTE 255 Compu_IDENTITY 0 255 PHYS_UNIT "FMI" /end CHARACTERISTIC
/begin CHARACTERISTIC FCfmi_UEGOH1_on_short "FCtl_FMI(428)" VALUE 0x001E5AAD /* @ECU_Address@FCtl_FMI@0x021B71AC@ */ ECIPP_ALIGNMENT_UBYTE 255 Compu_IDENTITY 0 255 PHYS_UNIT "FMI" /end CHARACTERISTIC
/begin CHARACTERISTIC FCfmi_UEGOH2_off_open "FCtl_FMI(429)" VALUE 0x001E5AAE /* @ECU_Address@FCtl_FMI@0x021B71AD@ */ ECIPP_ALIGNMENT_UBYTE 255 Compu_IDENTITY 0 255 PHYS_UNIT "FMI" /end CHARACTERISTIC
/begin CHARACTERISTIC FCfmi_UEGOH2_on_short "FCtl_FMI(430)" VALUE 0x001E5AAF /* @ECU_Address@FCtl_FMI@0x021B71AE@ */ ECIPP_ALIGNMENT_UBYTE 255 Compu_IDENTITY 0 255 PHYS_UNIT "FMI" /end CHARACTERISTIC
/begin CHARACTERISTIC FCfmi_UEGOH3_off_open "FCtl_FMI(622)" VALUE 0x001E5B6F /* @ECU_Address@FCtl_FMI@0x021B726E@ */ ECIPP_ALIGNMENT_UBYTE 255 Compu_IDENTITY 0 255 PHYS_UNIT "FMI" /end CHARACTERISTIC
/begin CHARACTERISTIC FCfmi_UEGOH3_on_short "FCtl_FMI(623)" VALUE 0x001E5B70 /* @ECU_Address@FCtl_FMI@0x021B726F@ */ ECIPP_ALIGNMENT_UBYTE 255 Compu_IDENTITY 0 255 PHYS_UNIT "FMI" /end CHARACTERISTIC
/begin CHARACTERISTIC FCfmi_UEGOH4_off_open "FCtl_FMI(645)" VALUE 0x001E5B86 /* @ECU_Address@FCtl_FMI@0x021B7285@ */ ECIPP_ALIGNMENT_UBYTE 255 Compu_IDENTITY 0 255 PHYS_UNIT "FMI" /end CHARACTERISTIC
/begin CHARACTERISTIC FCfmi_UEGOH4_on_short "FCtl_FMI(646)" VALUE 0x001E5B87 /* @ECU_Address@FCtl_FMI@0x021B7286@ */ ECIPP_ALIGNMENT_UBYTE 255 Compu_IDENTITY 0 255 PHYS_UNIT "FMI" /end CHARACTERISTIC
/begin CHARACTERISTIC FCfmi_UGF_Hv_hi "FCtl_FMI(242)" VALUE 0x001E59F3 /* @ECU_Address@FCtl_FMI@0x021B70F2@ */ ECIPP_ALIGNMENT_UBYTE 255 Compu_IDENTITY 0 255 PHYS_UNIT "FMI" /end CHARACTERISTIC
/begin CHARACTERISTIC FCfmi_UGF_internal "FCtl_FMI(241)" VALUE 0x001E59F2 /* @ECU_Address@FCtl_FMI@0x021B70F1@ */ ECIPP_ALIGNMENT_UBYTE 255 Compu_IDENTITY 0 255 PHYS_UNIT "FMI" /end CHARACTERISTIC
/begin CHARACTERISTIC FCfmi_UGF_lowsupply "FCtl_FMI(530)" VALUE 0x001E5B13 /* @ECU_Address@FCtl_FMI@0x021B7212@ */ ECIPP_ALIGNMENT_UBYTE 255 Compu_IDENTITY 0 255 PHYS_UNIT "FMI" /end CHARACTERISTIC
/begin CHARACTERISTIC FCfmi_UGF1_comm_lost "FCtl_FMI(680)" VALUE 0x001E5BA9 /* @ECU_Address@FCtl_FMI@0x021B72A8@ */ ECIPP_ALIGNMENT_UBYTE 255 Compu_IDENTITY 0 255 PHYS_UNIT "FMI" /end CHARACTERISTIC
/begin CHARACTERISTIC FCfmi_UGF1_drifttl2 "FCtl_FMI(536)" VALUE 0x001E5B19 /* @ECU_Address@FCtl_FMI@0x021B7218@ */ ECIPP_ALIGNMENT_UBYTE 255 Compu_IDENTITY 0 255 PHYS_UNIT "FMI" /end CHARACTERISTIC
/begin CHARACTERISTIC FCfmi_UGF1_drifttol "FCtl_FMI(505)" VALUE 0x001E5AFA /* @ECU_Address@FCtl_FMI@0x021B71F9@ */ ECIPP_ALIGNMENT_UBYTE 255 Compu_IDENTITY 0 255 PHYS_UNIT "FMI" /end CHARACTERISTIC
/begin CHARACTERISTIC FCfmi_UGF1_R_hi "FCtl_FMI(244)" VALUE 0x001E59F5 /* @ECU_Address@FCtl_FMI@0x021B70F4@ */ ECIPP_ALIGNMENT_UBYTE 255 Compu_IDENTITY 0 255 PHYS_UNIT "FMI" /end CHARACTERISTIC
/begin CHARACTERISTIC FCfmi_UGF1_SR_hi "FCtl_FMI(256)" VALUE 0x001E5A01 /* @ECU_Address@FCtl_FMI@0x021B7100@ */ ECIPP_ALIGNMENT_UBYTE 255 Compu_IDENTITY 0 255 PHYS_UNIT "FMI" /end CHARACTERISTIC
/begin CHARACTERISTIC FCfmi_UGF1_SR_slow "FCtl_FMI(254)" VALUE 0x001E59FF /* @ECU_Address@FCtl_FMI@0x021B70FE@ */ ECIPP_ALIGNMENT_UBYTE 255 Compu_IDENTITY 0 255 PHYS_UNIT "FMI" /end CHARACTERISTIC
/begin CHARACTERISTIC FCfmi_UGF1_Sv_hi "FCtl_FMI(250)" VALUE 0x001E59FB /* @ECU_Address@FCtl_FMI@0x021B70FA@ */ ECIPP_ALIGNMENT_UBYTE 255 Compu_IDENTITY 0 255 PHYS_UNIT "FMI" /end CHARACTERISTIC
/begin CHARACTERISTIC FCfmi_UGF2_comm_lost "FCtl_FMI(681)" VALUE 0x001E5BAA /* @ECU_Address@FCtl_FMI@0x021B72A9@ */ ECIPP_ALIGNMENT_UBYTE 255 Compu_IDENTITY 0 255 PHYS_UNIT "FMI" /end CHARACTERISTIC
/begin CHARACTERISTIC FCfmi_UGF2_drifttl2 "FCtl_FMI(537)" VALUE 0x001E5B1A /* @ECU_Address@FCtl_FMI@0x021B7219@ */ ECIPP_ALIGNMENT_UBYTE 255 Compu_IDENTITY 0 255 PHYS_UNIT "FMI" /end CHARACTERISTIC
/begin CHARACTERISTIC FCftb_start_coilshort "FCtl_FTB_0x04(163)" VALUE 0x001E5DBA /* @ECU_Address@FCtl_FTB_0x04@0x024C50A3@ */ ECIPP_ALIGNMENT_UBYTE 255 Compu_IDENTITY 0 255 PHYS_UNIT "FTB" /end CHARACTERISTIC
/begin CHARACTERISTIC FCftb_start_excess "FCtl_FTB_0x04(840)" VALUE 0x001E605F /* @ECU_Address@FCtl_FTB_0x04@0x024C5348@ */ ECIPP_ALIGNMENT_UBYTE 255 Compu_IDENTITY 0 255 PHYS_UNIT "FTB" /end CHARACTERISTIC
/begin CHARACTERISTIC FCftb_start_gndshort "FCtl_FTB_0x04(161)" VALUE 0x001E5DB8 /* @ECU_Address@FCtl_FTB_0x04@0x024C50A1@ */ ECIPP_ALIGNMENT_UBYTE 255 Compu_IDENTITY 0 255 PHYS_UNIT "FTB" /end CHARACTERISTIC
/begin CHARACTERISTIC FCftb_start_stuck_active "FCtl_FTB_0x04(320)" VALUE 0x001E5E57 /* @ECU_Address@FCtl_FTB_0x04@0x024C5140@ */ ECIPP_ALIGNMENT_UBYTE 255 Compu_IDENTITY 0 255 PHYS_UNIT "FTB" /end CHARACTERISTIC
/begin CHARACTERISTIC FCftb_SubDiagTemp "FCtl_FTB_0x04(653)" VALUE 0x001E5FA4 /* @ECU_Address@FCtl_FTB_0x04@0x024C528D@ */ ECIPP_ALIGNMENT_UBYTE 255 Compu_IDENTITY 0 255 PHYS_UNIT "FTB" /end CHARACTERISTIC
/begin CHARACTERISTIC FCftb_tach_gndshort "FCtl_FTB_0x04(173)" VALUE 0x001E5DC4 /* @ECU_Address@FCtl_FTB_0x04@0x024C50AD@ */ ECIPP_ALIGNMENT_UBYTE 255 Compu_IDENTITY 0 255 PHYS_UNIT "FTB" /end CHARACTERISTIC
/begin CHARACTERISTIC FCftb_tach_pwrshort "FCtl_FTB_0x04(174)" VALUE 0x001E5DC5 /* @ECU_Address@FCtl_FTB_0x04@0x024C50AE@ */ ECIPP_ALIGNMENT_UBYTE 255 Compu_IDENTITY 0 255 PHYS_UNIT "FTB" /end CHARACTERISTIC
/begin CHARACTERISTIC FCftb_TANK_1_V_maxv "FCtl_FTB_0x04(871)" VALUE 0x001E607E /* @ECU_Address@FCtl_FTB_0x04@0x024C5367@ */ ECIPP_ALIGNMENT_UBYTE 255 Compu_IDENTITY 0 255 PHYS_UNIT "FTB" /end CHARACTERISTIC
/begin CHARACTERISTIC FCftb_TANK_1_V_minv "FCtl_FTB_0x04(873)" VALUE 0x001E6080 /* @ECU_Address@FCtl_FTB_0x04@0x024C5369@ */ ECIPP_ALIGNMENT_UBYTE 255 Compu_IDENTITY 0 255 PHYS_UNIT "FTB" /end CHARACTERISTIC
/begin CHARACTERISTIC FCftb_TANK_1_V_slow "FCtl_FTB_0x04(875)" VALUE 0x001E6082 /* @ECU_Address@FCtl_FTB_0x04@0x024C536B@ */ ECIPP_ALIGNMENT_UBYTE 255 Compu_IDENTITY 0 255 PHYS_UNIT "FTB" /end CHARACTERISTIC
/begin CHARACTERISTIC FCftb_TAUX_dT1_max "FCtl_FTB_0x04(558)" VALUE 0x001E5F45 /* @ECU_Address@FCtl_FTB_0x04@0x024C522E@ */ ECIPP_ALIGNMENT_UBYTE 255 Compu_IDENTITY 0 255 PHYS_UNIT "FTB" /end CHARACTERISTIC
/begin CHARACTERISTIC FCftb_TAUX_dT1_min "FCtl_FTB_0x04(559)" VALUE 0x001E5F46 /* @ECU_Address@FCtl_FTB_0x04@0x024C522F@ */ ECIPP_ALIGNMENT_UBYTE 255 Compu_IDENTITY 0 255 PHYS_UNIT "FTB" /end CHARACTERISTIC
/begin CHARACTERISTIC FCftb_TAUX_dT2_max "FCtl_FTB_0x04(560)" VALUE 0x001E5F47 /* @ECU_Address@FCtl_FTB_0x04@0x024C5230@ */ ECIPP_ALIGNMENT_UBYTE 255 Compu_IDENTITY 0 255 PHYS_UNIT "FTB" /end CHARACTERISTIC
/begin CHARACTERISTIC FCftb_TAUX_dT2_min "FCtl_FTB_0x04(561)" VALUE 0x001E5F48 /* @ECU_Address@FCtl_FTB_0x04@0x024C5231@ */ ECIPP_ALIGNMENT_UBYTE 255 Compu_IDENTITY 0 255 PHYS_UNIT "FTB" /end CHARACTERISTIC
/begin CHARACTERISTIC FCftb_Taux1_derate_actv "FCtl_FTB_0x04(812)" VALUE 0x001E6043 /* @ECU_Address@FCtl_FTB_0x04@0x024C532C@ */ ECIPP_ALIGNMENT_UBYTE 255 Compu_IDENTITY 0 255 PHYS_UNIT "FTB" /end CHARACTERISTIC
/begin CHARACTERISTIC FCftb_TAUX1_max "FCtl_FTB_0x04(550)" VALUE 0x001E5F3D /* @ECU_Address@FCtl_FTB_0x04@0x024C5226@ */ ECIPP_ALIGNMENT_UBYTE 255 Compu_IDENTITY 0 255 PHYS_UNIT "FTB" /end CHARACTERISTIC
/begin CHARACTERISTIC FCftb_TAUX1_min "FCtl_FTB_0x04(551)" VALUE 0x001E5F3E /* @ECU_Address@FCtl_FTB_0x04@0x024C5227@ */ ECIPP_ALIGNMENT_UBYTE 255 Compu_IDENTITY 0 255 PHYS_UNIT "FTB" /end CHARACTERISTIC
/begin CHARACTERISTIC FCftb_Taux2_derate_actv "FCtl_FTB_0x04(813)" VALUE 0x001E6044 /* @ECU_Address@FCtl_FTB_0x04@0x024C532D@ */ ECIPP_ALIGNMENT_UBYTE 255 Compu_IDENTITY 0 255 PHYS_UNIT "FTB" /end CHARACTERISTIC
/begin CHARACTERISTIC FCftb_TAUX2_max "FCtl_FTB_0x04(552)" VALUE 0x001E5F3F /* @ECU_Address@FCtl_FTB_0x04@0x024C5228@ */ ECIPP_ALIGNMENT_UBYTE 255 Compu_IDENTITY 0 255 PHYS_UNIT "FTB" /end CHARACTERISTIC
/begin CHARACTERISTIC FCftb_TAUX2_min "FCtl_FTB_0x04(553)" VALUE 0x001E5F40 /* @ECU_Address@FCtl_FTB_0x04@0x024C5229@ */ ECIPP_ALIGNMENT_UBYTE 255 Compu_IDENTITY 0 255 PHYS_UNIT "FTB" /end CHARACTERISTIC
/begin CHARACTERISTIC FCftb_TAUX3_max "FCtl_FTB_0x04(554)" VALUE 0x001E5F41 /* @ECU_Address@FCtl_FTB_0x04@0x024C522A@ */ ECIPP_ALIGNMENT_UBYTE 255 Compu_IDENTITY 0 255 PHYS_UNIT "FTB" /end CHARACTERISTIC
/begin CHARACTERISTIC FCftb_TAUX3_min "FCtl_FTB_0x04(555)" VALUE 0x001E5F42 /* @ECU_Address@FCtl_FTB_0x04@0x024C522B@ */ ECIPP_ALIGNMENT_UBYTE 255 Compu_IDENTITY 0 255 PHYS_UNIT "FTB" /end CHARACTERISTIC
/begin CHARACTERISTIC FCftb_TAUX4_max "FCtl_FTB_0x04(556)" VALUE 0x001E5F43 /* @ECU_Address@FCtl_FTB_0x04@0x024C522C@ */ ECIPP_ALIGNMENT_UBYTE 255 Compu_IDENTITY 0 255 PHYS_UNIT "FTB" /end CHARACTERISTIC
/begin CHARACTERISTIC FCftb_TAUX4_min "FCtl_FTB_0x04(557)" VALUE 0x001E5F44 /* @ECU_Address@FCtl_FTB_0x04@0x024C522D@ */ ECIPP_ALIGNMENT_UBYTE 255 Compu_IDENTITY 0 255 PHYS_UNIT "FTB" /end CHARACTERISTIC
/begin CHARACTERISTIC FCftb_TEL_derate_actv "FCtl_FTB_0x04(647)" VALUE 0x001E5F9E /* @ECU_Address@FCtl_FTB_0x04@0x024C5287@ */ ECIPP_ALIGNMENT_UBYTE 255 Compu_IDENTITY 0 255 PHYS_UNIT "FTB" /end CHARACTERISTIC
/begin CHARACTERISTIC FCftb_TEL_dis "FCtl_FTB_0x04(854)" VALUE 0x001E606D /* @ECU_Address@FCtl_FTB_0x04@0x024C5356@ */ ECIPP_ALIGNMENT_UBYTE 255 Compu_IDENTITY 0 255 PHYS_UNIT "FTB" /end CHARACTERISTIC
/begin CHARACTERISTIC FCftb_TEL_intF "FCtl_FTB_0x04(855)" VALUE 0x001E606E /* @ECU_Address@FCtl_FTB_0x04@0x024C5357@ */ ECIPP_ALIGNMENT_UBYTE 255 Compu_IDENTITY 0 255 PHYS_UNIT "FTB" /end CHARACTERISTIC
/begin CHARACTERISTIC FCftb_TEL_key_invalid "FCtl_FTB_0x04(821)" VALUE 0x001E604C /* @ECU_Address@FCtl_FTB_0x04@0x024C5335@ */ ECIPP_ALIGNMENT_UBYTE 255 Compu_IDENTITY 0 255 PHYS_UNIT "FTB" /end CHARACTERISTIC
/begin CHARACTERISTIC FCftb_TEL_key_to "FCtl_FTB_0x04(820)" VALUE 0x001E604B /* @ECU_Address@FCtl_FTB_0x04@0x024C5334@ */ ECIPP_ALIGNMENT_UBYTE 255 Compu_IDENTITY 0 255 PHYS_UNIT "FTB" /end CHARACTERISTIC
/begin CHARACTERISTIC FCftb_TEL_req_to "FCtl_FTB_0x04(819)" VALUE 0x001E604A /* @ECU_Address@FCtl_FTB_0x04@0x024C5333@ */ ECIPP_ALIGNMENT_UBYTE 255 Compu_IDENTITY 0 255 PHYS_UNIT "FTB" /end CHARACTERISTIC
/begin CHARACTERISTIC FCftb_TEL_RPM_cmd "FCtl_FTB_0x04(822)" VALUE 0x001E604D /* @ECU_Address@FCtl_FTB_0x04@0x024C5336@ */ ECIPP_ALIGNMENT_UBYTE 255 Compu_IDENTITY 0 255 PHYS_UNIT "FTB" /end CHARACTERISTIC
/begin CHARACTERISTIC FCftb_TEL_RPM_psv "FCtl_FTB_0x04(825)" VALUE 0x001E6050 /* @ECU_Address@FCtl_FTB_0x04@0x024C5339@ */ ECIPP_ALIGNMENT_UBYTE 255 Compu_IDENTITY 0 255 PHYS_UNIT "FTB" /end CHARACTERISTIC
/begin CHARACTERISTIC FCftb_TEL_shutdown_cmd "FCtl_FTB_0x04(824)" VALUE 0x001E604F /* @ECU_Address@FCtl_FTB_0x04@0x024C5338@ */ ECIPP_ALIGNMENT_UBYTE 255 Compu_IDENTITY 0 255 PHYS_UNIT "FTB" /end CHARACTERISTIC
/begin CHARACTERISTIC FCftb_TEL_shutdown_psv "FCtl_FTB_0x04(827)" VALUE 0x001E6052 /* @ECU_Address@FCtl_FTB_0x04@0x024C533B@ */ ECIPP_ALIGNMENT_UBYTE 255 Compu_IDENTITY 0 255 PHYS_UNIT "FTB" /end CHARACTERISTIC
/begin CHARACTERISTIC FCftb_TEL_torq_cmd "FCtl_FTB_0x04(823)" VALUE 0x001E604E /* @ECU_Address@FCtl_FTB_0x04@0x024C5337@ */ ECIPP_ALIGNMENT_UBYTE 255 Compu_IDENTITY 0 255 PHYS_UNIT "FTB" /end CHARACTERISTIC
/begin CHARACTERISTIC FCftb_TEL_torq_psv "FCtl_FTB_0x04(826)" VALUE 0x001E6051 /* @ECU_Address@FCtl_FTB_0x04@0x024C533A@ */ ECIPP_ALIGNMENT_UBYTE 255 Compu_IDENTITY 0 255 PHYS_UNIT "FTB" /end CHARACTERISTIC
/begin CHARACTERISTIC FCftb_TIP_act "FCtl_FTB_0x04(145)" VALUE 0x001E5DA8 /* @ECU_Address@FCtl_FTB_0x04@0x024C5091@ */ ECIPP_ALIGNMENT_UBYTE 255 Compu_IDENTITY 0 255 PHYS_UNIT "FTB" /end CHARACTERISTIC
/begin CHARACTERISTIC FCftb_TIP_maxv "FCtl_FTB_0x04(126)" VALUE 0x001E5D95 /* @ECU_Address@FCtl_FTB_0x04@0x024C507E@ */ ECIPP_ALIGNMENT_UBYTE 255 Compu_IDENTITY 0 255 PHYS_UNIT "FTB" /end CHARACTERISTIC
/begin CHARACTERISTIC FCftb_TIP_minv "FCtl_FTB_0x04(127)" VALUE 0x001E5D96 /* @ECU_Address@FCtl_FTB_0x04@0x024C507F@ */ ECIPP_ALIGNMENT_UBYTE 255 Compu_IDENTITY 0 255 PHYS_UNIT "FTB" /end CHARACTERISTIC
/begin CHARACTERISTIC FCftb_TPS1_max "FCtl_FTB_0x04(13)" VALUE 0x001E5D24 /* @ECU_Address@FCtl_FTB_0x04@0x024C500D@ */ ECIPP_ALIGNMENT_UBYTE 255 Compu_IDENTITY 0 255 PHYS_UNIT "FTB" /end CHARACTERISTIC
/begin CHARACTERISTIC FCftb_TPS1_min "FCtl_FTB_0x04(14)" VALUE 0x001E5D25 /* @ECU_Address@FCtl_FTB_0x04@0x024C500E@ */ ECIPP_ALIGNMENT_UBYTE 255 Compu_IDENTITY 0 255 PHYS_UNIT "FTB" /end CHARACTERISTIC
/begin CHARACTERISTIC FCftb_TPS12_OOR "FCtl_FTB_0x04(186)" VALUE 0x001E5DD1 /* @ECU_Address@FCtl_FTB_0x04@0x024C50BA@ */ ECIPP_ALIGNMENT_UBYTE 255 Compu_IDENTITY 0 255 PHYS_UNIT "FTB" /end CHARACTERISTIC
/begin CHARACTERISTIC FCftb_TPS12pct_hi "FCtl_FTB_0x04(17)" VALUE 0x001E5D28 /* @ECU_Address@FCtl_FTB_0x04@0x024C5011@ */ ECIPP_ALIGNMENT_UBYTE 255 Compu_IDENTITY 0 255 PHYS_UNIT "FTB" /end CHARACTERISTIC
/begin CHARACTERISTIC FCftb_TPS12pct_lo "FCtl_FTB_0x04(18)" VALUE 0x001E5D29 /* @ECU_Address@FCtl_FTB_0x04@0x024C5012@ */ ECIPP_ALIGNMENT_UBYTE 255 Compu_IDENTITY 0 255 PHYS_UNIT "FTB" /end CHARACTERISTIC
/begin CHARACTERISTIC FCftb_TPS2_max "FCtl_FTB_0x04(15)" VALUE 0x001E5D26 /* @ECU_Address@FCtl_FTB_0x04@0x024C500F@ */ ECIPP_ALIGNMENT_UBYTE 255 Compu_IDENTITY 0 255 PHYS_UNIT "FTB" /end CHARACTERISTIC
/begin CHARACTERISTIC FCftb_TPS2_min "FCtl_FTB_0x04(16)" VALUE 0x001E5D27 /* @ECU_Address@FCtl_FTB_0x04@0x024C5010@ */ ECIPP_ALIGNMENT_UBYTE 255 Compu_IDENTITY 0 255 PHYS_UNIT "FTB" /end CHARACTERISTIC
/begin CHARACTERISTIC FCftb_TPSerr_neg "FCtl_FTB_0x04(91)" VALUE 0x001E5D72 /* @ECU_Address@FCtl_FTB_0x04@0x024C505B@ */ ECIPP_ALIGNMENT_UBYTE 255 Compu_IDENTITY 0 255 PHYS_UNIT "FTB" /end CHARACTERISTIC
/begin CHARACTERISTIC FCftb_TPSerr_pos "FCtl_FTB_0x04(90)" VALUE 0x001E5D71 /* @ECU_Address@FCtl_FTB_0x04@0x024C505A@ */ ECIPP_ALIGNMENT_UBYTE 255 Compu_IDENTITY 0 255 PHYS_UNIT "FTB" /end CHARACTERISTIC
/begin CHARACTERISTIC FCftb_TRANS_comm "FCtl_FTB_0x04(851)" VALUE 0x001E606A /* @ECU_Address@FCtl_FTB_0x04@0x024C5353@ */ ECIPP_ALIGNMENT_UBYTE 255 Compu_IDENTITY 0 255 PHYS_UNIT "FTB" /end CHARACTERISTIC
/begin CHARACTERISTIC FCftb_TRANS_fuel_inh "FCtl_FTB_0x04(852)" VALUE 0x001E606B /* @ECU_Address@FCtl_FTB_0x04@0x024C5354@ */ ECIPP_ALIGNMENT_UBYTE 255 Compu_IDENTITY 0 255 PHYS_UNIT "FTB" /end CHARACTERISTIC
/begin CHARACTERISTIC FCftb_TWCDiag_OSC_lo "FCtl_FTB_0x04(804)" VALUE 0x001E603B /* @ECU_Address@FCtl_FTB_0x04@0x024C5324@ */ ECIPP_ALIGNMENT_UBYTE 255 Compu_IDENTITY 0 255 PHYS_UNIT "FTB" /end CHARACTERISTIC
/begin CHARACTERISTIC FCftb_UEGOH1_off_open "FCtl_FTB_0x04(427)" VALUE 0x001E5EC2 /* @ECU_Address@FCtl_FTB_0x04@0x024C51AB@ */ ECIPP_ALIGNMENT_UBYTE 255 Compu_IDENTITY 0 255 PHYS_UNIT "FTB" /end CHARACTERISTIC
/begin CHARACTERISTIC FCftb_UEGOH1_on_short "FCtl_FTB_0x04(428)" VALUE 0x001E5EC3 /* @ECU_Address@FCtl_FTB_0x04@0x024C51AC@ */ ECIPP_ALIGNMENT_UBYTE 255 Compu_IDENTITY 0 255 PHYS_UNIT "FTB" /end CHARACTERISTIC
/begin CHARACTERISTIC FCftb_UEGOH2_off_open "FCtl_FTB_0x04(429)" VALUE 0x001E5EC4 /* @ECU_Address@FCtl_FTB_0x04@0x024C51AD@ */ ECIPP_ALIGNMENT_UBYTE 255 Compu_IDENTITY 0 255 PHYS_UNIT "FTB" /end CHARACTERISTIC
/begin CHARACTERISTIC FCftb_UEGOH2_on_short "FCtl_FTB_0x04(430)" VALUE 0x001E5EC5 /* @ECU_Address@FCtl_FTB_0x04@0x024C51AE@ */ ECIPP_ALIGNMENT_UBYTE 255 Compu_IDENTITY 0 255 PHYS_UNIT "FTB" /end CHARACTERISTIC
/begin CHARACTERISTIC FCftb_UEGOH3_off_open "FCtl_FTB_0x04(622)" VALUE 0x001E5F85 /* @ECU_Address@FCtl_FTB_0x04@0x024C526E@ */ ECIPP_ALIGNMENT_UBYTE 255 Compu_IDENTITY 0 255 PHYS_UNIT "FTB" /end CHARACTERISTIC
/begin CHARACTERISTIC FCftb_UEGOH3_on_short "FCtl_FTB_0x04(623)" VALUE 0x001E5F86 /* @ECU_Address@FCtl_FTB_0x04@0x024C526F@ */ ECIPP_ALIGNMENT_UBYTE 255 Compu_IDENTITY 0 255 PHYS_UNIT "FTB" /end CHARACTERISTIC
/begin CHARACTERISTIC FCftb_UEGOH4_off_open "FCtl_FTB_0x04(645)" VALUE 0x001E5F9C /* @ECU_Address@FCtl_FTB_0x04@0x024C5285@ */ ECIPP_ALIGNMENT_UBYTE 255 Compu_IDENTITY 0 255 PHYS_UNIT "FTB" /end CHARACTERISTIC
/begin CHARACTERISTIC FCftb_UEGOH4_on_short "FCtl_FTB_0x04(646)" VALUE 0x001E5F9D /* @ECU_Address@FCtl_FTB_0x04@0x024C5286@ */ ECIPP_ALIGNMENT_UBYTE 255 Compu_IDENTITY 0 255 PHYS_UNIT "FTB" /end CHARACTERISTIC
/begin CHARACTERISTIC FCftb_UGF_Hv_hi "FCtl_FTB_0x04(242)" VALUE 0x001E5E09 /* @ECU_Address@FCtl_FTB_0x04@0x024C50F2@ */ ECIPP_ALIGNMENT_UBYTE 255 Compu_IDENTITY 0 255 PHYS_UNIT "FTB" /end CHARACTERISTIC
/begin CHARACTERISTIC FCftb_UGF_internal "FCtl_FTB_0x04(241)" VALUE 0x001E5E08 /* @ECU_Address@FCtl_FTB_0x04@0x024C50F1@ */ ECIPP_ALIGNMENT_UBYTE 255 Compu_IDENTITY 0 255 PHYS_UNIT "FTB" /end CHARACTERISTIC
/begin CHARACTERISTIC FCftb_UGF_lowsupply "FCtl_FTB_0x04(530)" VALUE 0x001E5F29 /* @ECU_Address@FCtl_FTB_0x04@0x024C5212@ */ ECIPP_ALIGNMENT_UBYTE 255 Compu_IDENTITY 0 255 PHYS_UNIT "FTB" /end CHARACTERISTIC
/begin CHARACTERISTIC FCftb_UGF1_comm_lost "FCtl_FTB_0x04(680)" VALUE 0x001E5FBF /* @ECU_Address@FCtl_FTB_0x04@0x024C52A8@ */ ECIPP_ALIGNMENT_UBYTE 255 Compu_IDENTITY 0 255 PHYS_UNIT "FTB" /end CHARACTERISTIC
/begin CHARACTERISTIC FCftb_UGF1_drifttl2 "FCtl_FTB_0x04(536)" VALUE 0x001E5F2F /* @ECU_Address@FCtl_FTB_0x04@0x024C5218@ */ ECIPP_ALIGNMENT_UBYTE 255 Compu_IDENTITY 0 255 PHYS_UNIT "FTB" /end CHARACTERISTIC
/begin CHARACTERISTIC FCftb_UGF1_drifttol "FCtl_FTB_0x04(505)" VALUE 0x001E5F10 /* @ECU_Address@FCtl_FTB_0x04@0x024C51F9@ */ ECIPP_ALIGNMENT_UBYTE 255 Compu_IDENTITY 0 255 PHYS_UNIT "FTB" /end CHARACTERISTIC
/begin CHARACTERISTIC FCftb_UGF1_R_hi "FCtl_FTB_0x04(244)" VALUE 0x001E5E0B /* @ECU_Address@FCtl_FTB_0x04@0x024C50F4@ */ ECIPP_ALIGNMENT_UBYTE 255 Compu_IDENTITY 0 255 PHYS_UNIT "FTB" /end CHARACTERISTIC
/begin CHARACTERISTIC FCftb_UGF1_SR_hi "FCtl_FTB_0x04(256)" VALUE 0x001E5E17 /* @ECU_Address@FCtl_FTB_0x04@0x024C5100@ */ ECIPP_ALIGNMENT_UBYTE 255 Compu_IDENTITY 0 255 PHYS_UNIT "FTB" /end CHARACTERISTIC
/begin CHARACTERISTIC FCftb_UGF1_SR_slow "FCtl_FTB_0x04(254)" VALUE 0x001E5E15 /* @ECU_Address@FCtl_FTB_0x04@0x024C50FE@ */ ECIPP_ALIGNMENT_UBYTE 255 Compu_IDENTITY 0 255 PHYS_UNIT "FTB" /end CHARACTERISTIC
/begin CHARACTERISTIC FCftb_UGF1_Sv_hi "FCtl_FTB_0x04(250)" VALUE 0x001E5E11 /* @ECU_Address@FCtl_FTB_0x04@0x024C50FA@ */ ECIPP_ALIGNMENT_UBYTE 255 Compu_IDENTITY 0 255 PHYS_UNIT "FTB" /end CHARACTERISTIC
/begin CHARACTERISTIC FCftb_UGF2_comm_lost "FCtl_FTB_0x04(681)" VALUE 0x001E5FC0 /* @ECU_Address@FCtl_FTB_0x04@0x024C52A9@ */ ECIPP_ALIGNMENT_UBYTE 255 Compu_IDENTITY 0 255 PHYS_UNIT "FTB" /end CHARACTERISTIC
/begin CHARACTERISTIC FCftb_UGF2_drifttl2 "FCtl_FTB_0x04(537)" VALUE 0x001E5F30 /* @ECU_Address@FCtl_FTB_0x04@0x024C5219@ */ ECIPP_ALIGNMENT_UBYTE 255 Compu_IDENTITY 0 255 PHYS_UNIT "FTB" /end CHARACTERISTIC
/begin CHARACTERISTIC FCspn_start_coilshort "FCtl_SPN(163)" VALUE 0x001E1FF0 /* @ECU_Address@FCtl_SPN@0x21B6028C@ */ ECIPP_ALIGNMENT_ULONG 4294967295 Compu_IDENTITY 0 4294967295 PHYS_UNIT "SPN" /end CHARACTERISTIC
/begin CHARACTERISTIC FCspn_start_excess "FCtl_SPN(840)" VALUE 0x001E2A84 /* @ECU_Address@FCtl_SPN@0x21B60D20@ */ ECIPP_ALIGNMENT_ULONG 4294967295 Compu_IDENTITY 0 4294967295 PHYS_UNIT "SPN" /end CHARACTERISTIC
/begin CHARACTERISTIC FCspn_start_gndshort "FCtl_SPN(161)" VALUE 0x001E1FE8 /* @ECU_Address@FCtl_SPN@0x21B60284@ */ ECIPP_ALIGNMENT_ULONG 4294967295 Compu_IDENTITY 0 4294967295 PHYS_UNIT "SPN" /end CHARACTERISTIC
/begin CHARACTERISTIC FCspn_start_stuck_active "FCtl_SPN(320)" VALUE 0x001E2264 /* @ECU_Address@FCtl_SPN@0x21B60500@ */ ECIPP_ALIGNMENT_ULONG 4294967295 Compu_IDENTITY 0 4294967295 PHYS_UNIT "SPN" /end CHARACTERISTIC
/begin CHARACTERISTIC FCspn_SubDiagTemp "FCtl_SPN(653)" VALUE 0x001E2798 /* @ECU_Address@FCtl_SPN@0x21B60A34@ */ ECIPP_ALIGNMENT_ULONG 4294967295 Compu_IDENTITY 0 4294967295 PHYS_UNIT "SPN" /end CHARACTERISTIC
/begin CHARACTERISTIC FCspn_tach_gndshort "FCtl_SPN(173)" VALUE 0x001E2018 /* @ECU_Address@FCtl_SPN@0x21B602B4@ */ ECIPP_ALIGNMENT_ULONG 4294967295 Compu_IDENTITY 0 4294967295 PHYS_UNIT "SPN" /end CHARACTERISTIC
/begin CHARACTERISTIC FCspn_tach_pwrshort "FCtl_SPN(174)" VALUE 0x001E201C /* @ECU_Address@FCtl_SPN@0x21B602B8@ */ ECIPP_ALIGNMENT_ULONG 4294967295 Compu_IDENTITY 0 4294967295 PHYS_UNIT "SPN" /end CHARACTERISTIC
/begin CHARACTERISTIC FCspn_TANK_1_V_maxv "FCtl_SPN(871)" VALUE 0x001E2B00 /* @ECU_Address@FCtl_SPN@0x21B60D9C@ */ ECIPP_ALIGNMENT_ULONG 4294967295 Compu_IDENTITY 0 4294967295 PHYS_UNIT "SPN" /end CHARACTERISTIC
/begin CHARACTERISTIC FCspn_TANK_1_V_minv "FCtl_SPN(873)" VALUE 0x001E2B08 /* @ECU_Address@FCtl_SPN@0x21B60DA4@ */ ECIPP_ALIGNMENT_ULONG 4294967295 Compu_IDENTITY 0 4294967295 PHYS_UNIT "SPN" /end CHARACTERISTIC
/begin CHARACTERISTIC FCspn_TANK_1_V_slow "FCtl_SPN(875)" VALUE 0x001E2B10 /* @ECU_Address@FCtl_SPN@0x21B60DAC@ */ ECIPP_ALIGNMENT_ULONG 4294967295 Compu_IDENTITY 0 4294967295 PHYS_UNIT "SPN" /end CHARACTERISTIC
/begin CHARACTERISTIC FCspn_TAUX_dT1_max "FCtl_SPN(558)" VALUE 0x001E261C /* @ECU_Address@FCtl_SPN@0x21B608B8@ */ ECIPP_ALIGNMENT_ULONG 4294967295 Compu_IDENTITY 0 4294967295 PHYS_UNIT "SPN" /end CHARACTERISTIC
/begin CHARACTERISTIC FCspn_TAUX_dT1_min "FCtl_SPN(559)" VALUE 0x001E2620 /* @ECU_Address@FCtl_SPN@0x21B608BC@ */ ECIPP_ALIGNMENT_ULONG 4294967295 Compu_IDENTITY 0 4294967295 PHYS_UNIT "SPN" /end CHARACTERISTIC
/begin CHARACTERISTIC FCspn_TAUX_dT2_max "FCtl_SPN(560)" VALUE 0x001E2624 /* @ECU_Address@FCtl_SPN@0x21B608C0@ */ ECIPP_ALIGNMENT_ULONG 4294967295 Compu_IDENTITY 0 4294967295 PHYS_UNIT "SPN" /end CHARACTERISTIC
/begin CHARACTERISTIC FCspn_TAUX_dT2_min "FCtl_SPN(561)" VALUE 0x001E2628 /* @ECU_Address@FCtl_SPN@0x21B608C4@ */ ECIPP_ALIGNMENT_ULONG 4294967295 Compu_IDENTITY 0 4294967295 PHYS_UNIT "SPN" /end CHARACTERISTIC
/begin CHARACTERISTIC FCspn_Taux1_derate_actv "FCtl_SPN(812)" VALUE 0x001E2A14 /* @ECU_Address@FCtl_SPN@0x21B60CB0@ */ ECIPP_ALIGNMENT_ULONG 4294967295 Compu_IDENTITY 0 4294967295 PHYS_UNIT "SPN" /end CHARACTERISTIC
/begin CHARACTERISTIC FCspn_TAUX1_max "FCtl_SPN(550)" VALUE 0x001E25FC /* @ECU_Address@FCtl_SPN@0x21B60898@ */ ECIPP_ALIGNMENT_ULONG 4294967295 Compu_IDENTITY 0 4294967295 PHYS_UNIT "SPN" /end CHARACTERISTIC
/begin CHARACTERISTIC FCspn_TAUX1_min "FCtl_SPN(551)" VALUE 0x001E2600 /* @ECU_Address@FCtl_SPN@0x21B6089C@ */ ECIPP_ALIGNMENT_ULONG 4294967295 Compu_IDENTITY 0 4294967295 PHYS_UNIT "SPN" /end CHARACTERISTIC
/begin CHARACTERISTIC FCspn_Taux2_derate_actv "FCtl_SPN(813)" VALUE 0x001E2A18 /* @ECU_Address@FCtl_SPN@0x21B60CB4@ */ ECIPP_ALIGNMENT_ULONG 4294967295 Compu_IDENTITY 0 4294967295 PHYS_UNIT "SPN" /end CHARACTERISTIC
/begin CHARACTERISTIC FCspn_TAUX2_max "FCtl_SPN(552)" VALUE 0x001E2604 /* @ECU_Address@FCtl_SPN@0x21B608A0@ */ ECIPP_ALIGNMENT_ULONG 4294967295 Compu_IDENTITY 0 4294967295 PHYS_UNIT "SPN" /end CHARACTERISTIC
/begin CHARACTERISTIC FCspn_TAUX2_min "FCtl_SPN(553)" VALUE 0x001E2608 /* @ECU_Address@FCtl_SPN@0x21B608A4@ */ ECIPP_ALIGNMENT_ULONG 4294967295 Compu_IDENTITY 0 4294967295 PHYS_UNIT "SPN" /end CHARACTERISTIC
/begin CHARACTERISTIC FCspn_TAUX3_max "FCtl_SPN(554)" VALUE 0x001E260C /* @ECU_Address@FCtl_SPN@0x21B608A8@ */ ECIPP_ALIGNMENT_ULONG 4294967295 Compu_IDENTITY 0 4294967295 PHYS_UNIT "SPN" /end CHARACTERISTIC
/begin CHARACTERISTIC FCspn_TAUX3_min "FCtl_SPN(555)" VALUE 0x001E2610 /* @ECU_Address@FCtl_SPN@0x21B608AC@ */ ECIPP_ALIGNMENT_ULONG 4294967295 Compu_IDENTITY 0 4294967295 PHYS_UNIT "SPN" /end CHARACTERISTIC
/begin CHARACTERISTIC FCspn_TAUX4_max "FCtl_SPN(556)" VALUE 0x001E2614 /* @ECU_Address@FCtl_SPN@0x21B608B0@ */ ECIPP_ALIGNMENT_ULONG 4294967295 Compu_IDENTITY 0 4294967295 PHYS_UNIT "SPN" /end CHARACTERISTIC
/begin CHARACTERISTIC FCspn_TAUX4_min "FCtl_SPN(557)" VALUE 0x001E2618 /* @ECU_Address@FCtl_SPN@0x21B608B4@ */ ECIPP_ALIGNMENT_ULONG 4294967295 Compu_IDENTITY 0 4294967295 PHYS_UNIT "SPN" /end CHARACTERISTIC
/begin CHARACTERISTIC FCspn_TEL_derate_actv "FCtl_SPN(647)" VALUE 0x001E2780 /* @ECU_Address@FCtl_SPN@0x21B60A1C@ */ ECIPP_ALIGNMENT_ULONG 4294967295 Compu_IDENTITY 0 4294967295 PHYS_UNIT "SPN" /end CHARACTERISTIC
/begin CHARACTERISTIC FCspn_TEL_dis "FCtl_SPN(854)" VALUE 0x001E2ABC /* @ECU_Address@FCtl_SPN@0x21B60D58@ */ ECIPP_ALIGNMENT_ULONG 4294967295 Compu_IDENTITY 0 4294967295 PHYS_UNIT "SPN" /end CHARACTERISTIC
/begin CHARACTERISTIC FCspn_TEL_intF "FCtl_SPN(855)" VALUE 0x001E2AC0 /* @ECU_Address@FCtl_SPN@0x21B60D5C@ */ ECIPP_ALIGNMENT_ULONG 4294967295 Compu_IDENTITY 0 4294967295 PHYS_UNIT "SPN" /end CHARACTERISTIC
/begin CHARACTERISTIC FCspn_TEL_key_invalid "FCtl_SPN(821)" VALUE 0x001E2A38 /* @ECU_Address@FCtl_SPN@0x21B60CD4@ */ ECIPP_ALIGNMENT_ULONG 4294967295 Compu_IDENTITY 0 4294967295 PHYS_UNIT "SPN" /end CHARACTERISTIC
/begin CHARACTERISTIC FCspn_TEL_key_to "FCtl_SPN(820)" VALUE 0x001E2A34 /* @ECU_Address@FCtl_SPN@0x21B60CD0@ */ ECIPP_ALIGNMENT_ULONG 4294967295 Compu_IDENTITY 0 4294967295 PHYS_UNIT "SPN" /end CHARACTERISTIC
/begin CHARACTERISTIC FCspn_TEL_req_to "FCtl_SPN(819)" VALUE 0x001E2A30 /* @ECU_Address@FCtl_SPN@0x21B60CCC@ */ ECIPP_ALIGNMENT_ULONG 4294967295 Compu_IDENTITY 0 4294967295 PHYS_UNIT "SPN" /end CHARACTERISTIC
/begin CHARACTERISTIC FCspn_TEL_RPM_cmd "FCtl_SPN(822)" VALUE 0x001E2A3C /* @ECU_Address@FCtl_SPN@0x21B60CD8@ */ ECIPP_ALIGNMENT_ULONG 4294967295 Compu_IDENTITY 0 4294967295 PHYS_UNIT "SPN" /end CHARACTERISTIC
/begin CHARACTERISTIC FCspn_TEL_RPM_psv "FCtl_SPN(825)" VALUE 0x001E2A48 /* @ECU_Address@FCtl_SPN@0x21B60CE4@ */ ECIPP_ALIGNMENT_ULONG 4294967295 Compu_IDENTITY 0 4294967295 PHYS_UNIT "SPN" /end CHARACTERISTIC
/begin CHARACTERISTIC FCspn_TEL_shutdown_cmd "FCtl_SPN(824)" VALUE 0x001E2A44 /* @ECU_Address@FCtl_SPN@0x21B60CE0@ */ ECIPP_ALIGNMENT_ULONG 4294967295 Compu_IDENTITY 0 4294967295 PHYS_UNIT "SPN" /end CHARACTERISTIC
/begin CHARACTERISTIC FCspn_TEL_shutdown_psv "FCtl_SPN(827)" VALUE 0x001E2A50 /* @ECU_Address@FCtl_SPN@0x21B60CEC@ */ ECIPP_ALIGNMENT_ULONG 4294967295 Compu_IDENTITY 0 4294967295 PHYS_UNIT "SPN" /end CHARACTERISTIC
/begin CHARACTERISTIC FCspn_TEL_torq_cmd "FCtl_SPN(823)" VALUE 0x001E2A40 /* @ECU_Address@FCtl_SPN@0x21B60CDC@ */ ECIPP_ALIGNMENT_ULONG 4294967295 Compu_IDENTITY 0 4294967295 PHYS_UNIT "SPN" /end CHARACTERISTIC
/begin CHARACTERISTIC FCspn_TEL_torq_psv "FCtl_SPN(826)" VALUE 0x001E2A4C /* @ECU_Address@FCtl_SPN@0x21B60CE8@ */ ECIPP_ALIGNMENT_ULONG 4294967295 Compu_IDENTITY 0 4294967295 PHYS_UNIT "SPN" /end CHARACTERISTIC
/begin CHARACTERISTIC FCspn_TIP_act "FCtl_SPN(145)" VALUE 0x001E1FA8 /* @ECU_Address@FCtl_SPN@0x21B60244@ */ ECIPP_ALIGNMENT_ULONG 4294967295 Compu_IDENTITY 0 4294967295 PHYS_UNIT "SPN" /end CHARACTERISTIC
/begin CHARACTERISTIC FCspn_TIP_maxv "FCtl_SPN(126)" VALUE 0x001E1F5C /* @ECU_Address@FCtl_SPN@0x21B601F8@ */ ECIPP_ALIGNMENT_ULONG 4294967295 Compu_IDENTITY 0 4294967295 PHYS_UNIT "SPN" /end CHARACTERISTIC
/begin CHARACTERISTIC FCspn_TIP_minv "FCtl_SPN(127)" VALUE 0x001E1F60 /* @ECU_Address@FCtl_SPN@0x21B601FC@ */ ECIPP_ALIGNMENT_ULONG 4294967295 Compu_IDENTITY 0 4294967295 PHYS_UNIT "SPN" /end CHARACTERISTIC
/begin CHARACTERISTIC FCspn_TPS1_max "FCtl_SPN(13)" VALUE 0x001E1D98 /* @ECU_Address@FCtl_SPN@0x21B60034@ */ ECIPP_ALIGNMENT_ULONG 4294967295 Compu_IDENTITY 0 4294967295 PHYS_UNIT "SPN" /end CHARACTERISTIC
/begin CHARACTERISTIC FCspn_TPS1_min "FCtl_SPN(14)" VALUE 0x001E1D9C /* @ECU_Address@FCtl_SPN@0x21B60038@ */ ECIPP_ALIGNMENT_ULONG 4294967295 Compu_IDENTITY 0 4294967295 PHYS_UNIT "SPN" /end CHARACTERISTIC
/begin CHARACTERISTIC FCspn_TPS12_OOR "FCtl_SPN(186)" VALUE 0x001E204C /* @ECU_Address@FCtl_SPN@0x21B602E8@ */ ECIPP_ALIGNMENT_ULONG 4294967295 Compu_IDENTITY 0 4294967295 PHYS_UNIT "SPN" /end CHARACTERISTIC
/begin CHARACTERISTIC FCspn_TPS12pct_hi "FCtl_SPN(17)" VALUE 0x001E1DA8 /* @ECU_Address@FCtl_SPN@0x21B60044@ */ ECIPP_ALIGNMENT_ULONG 4294967295 Compu_IDENTITY 0 4294967295 PHYS_UNIT "SPN" /end CHARACTERISTIC
/begin CHARACTERISTIC FCspn_TPS12pct_lo "FCtl_SPN(18)" VALUE 0x001E1DAC /* @ECU_Address@FCtl_SPN@0x21B60048@ */ ECIPP_ALIGNMENT_ULONG 4294967295 Compu_IDENTITY 0 4294967295 PHYS_UNIT "SPN" /end CHARACTERISTIC
/begin CHARACTERISTIC FCspn_TPS2_max "FCtl_SPN(15)" VALUE 0x001E1DA0 /* @ECU_Address@FCtl_SPN@0x21B6003C@ */ ECIPP_ALIGNMENT_ULONG 4294967295 Compu_IDENTITY 0 4294967295 PHYS_UNIT "SPN" /end CHARACTERISTIC
/begin CHARACTERISTIC FCspn_TPS2_min "FCtl_SPN(16)" VALUE 0x001E1DA4 /* @ECU_Address@FCtl_SPN@0x21B60040@ */ ECIPP_ALIGNMENT_ULONG 4294967295 Compu_IDENTITY 0 4294967295 PHYS_UNIT "SPN" /end CHARACTERISTIC
/begin CHARACTERISTIC FCspn_TPSerr_neg "FCtl_SPN(91)" VALUE 0x001E1ED0 /* @ECU_Address@FCtl_SPN@0x21B6016C@ */ ECIPP_ALIGNMENT_ULONG 4294967295 Compu_IDENTITY 0 4294967295 PHYS_UNIT "SPN" /end CHARACTERISTIC
/begin CHARACTERISTIC FCspn_TPSerr_pos "FCtl_SPN(90)" VALUE 0x001E1ECC /* @ECU_Address@FCtl_SPN@0x21B60168@ */ ECIPP_ALIGNMENT_ULONG 4294967295 Compu_IDENTITY 0 4294967295 PHYS_UNIT "SPN" /end CHARACTERISTIC
/begin CHARACTERISTIC FCspn_TRANS_comm "FCtl_SPN(851)" VALUE 0x001E2AB0 /* @ECU_Address@FCtl_SPN@0x21B60D4C@ */ ECIPP_ALIGNMENT_ULONG 4294967295 Compu_IDENTITY 0 4294967295 PHYS_UNIT "SPN" /end CHARACTERISTIC
/begin CHARACTERISTIC FCspn_TRANS_fuel_inh "FCtl_SPN(852)" VALUE 0x001E2AB4 /* @ECU_Address@FCtl_SPN@0x21B60D50@ */ ECIPP_ALIGNMENT_ULONG 4294967295 Compu_IDENTITY 0 4294967295 PHYS_UNIT "SPN" /end CHARACTERISTIC
/begin CHARACTERISTIC FCspn_TWCDiag_OSC_lo "FCtl_SPN(804)" VALUE 0x001E29F4 /* @ECU_Address@FCtl_SPN@0x21B60C90@ */ ECIPP_ALIGNMENT_ULONG 4294967295 Compu_IDENTITY 0 4294967295 PHYS_UNIT "SPN" /end CHARACTERISTIC
/begin CHARACTERISTIC FCspn_UEGOH1_off_open "FCtl_SPN(427)" VALUE 0x001E2410 /* @ECU_Address@FCtl_SPN@0x21B606AC@ */ ECIPP_ALIGNMENT_ULONG 4294967295 Compu_IDENTITY 0 4294967295 PHYS_UNIT "SPN" /end CHARACTERISTIC
/begin CHARACTERISTIC FCspn_UEGOH1_on_short "FCtl_SPN(428)" VALUE 0x001E2414 /* @ECU_Address@FCtl_SPN@0x21B606B0@ */ ECIPP_ALIGNMENT_ULONG 4294967295 Compu_IDENTITY 0 4294967295 PHYS_UNIT "SPN" /end CHARACTERISTIC
/begin CHARACTERISTIC FCspn_UEGOH2_off_open "FCtl_SPN(429)" VALUE 0x001E2418 /* @ECU_Address@FCtl_SPN@0x21B606B4@ */ ECIPP_ALIGNMENT_ULONG 4294967295 Compu_IDENTITY 0 4294967295 PHYS_UNIT "SPN" /end CHARACTERISTIC
/begin CHARACTERISTIC FCspn_UEGOH2_on_short "FCtl_SPN(430)" VALUE 0x001E241C /* @ECU_Address@FCtl_SPN@0x21B606B8@ */ ECIPP_ALIGNMENT_ULONG 4294967295 Compu_IDENTITY 0 4294967295 PHYS_UNIT "SPN" /end CHARACTERISTIC
/begin CHARACTERISTIC FCspn_UEGOH3_off_open "FCtl_SPN(622)" VALUE 0x001E271C /* @ECU_Address@FCtl_SPN@0x21B609B8@ */ ECIPP_ALIGNMENT_ULONG 4294967295 Compu_IDENTITY 0 4294967295 PHYS_UNIT "SPN" /end CHARACTERISTIC
/begin CHARACTERISTIC FCspn_UEGOH3_on_short "FCtl_SPN(623)" VALUE 0x001E2720 /* @ECU_Address@FCtl_SPN@0x21B609BC@ */ ECIPP_ALIGNMENT_ULONG 4294967295 Compu_IDENTITY 0 4294967295 PHYS_UNIT "SPN" /end CHARACTERISTIC
/begin CHARACTERISTIC FCspn_UEGOH4_off_open "FCtl_SPN(645)" VALUE 0x001E2778 /* @ECU_Address@FCtl_SPN@0x21B60A14@ */ ECIPP_ALIGNMENT_ULONG 4294967295 Compu_IDENTITY 0 4294967295 PHYS_UNIT "SPN" /end CHARACTERISTIC
/begin CHARACTERISTIC FCspn_UEGOH4_on_short "FCtl_SPN(646)" VALUE 0x001E277C /* @ECU_Address@FCtl_SPN@0x21B60A18@ */ ECIPP_ALIGNMENT_ULONG 4294967295 Compu_IDENTITY 0 4294967295 PHYS_UNIT "SPN" /end CHARACTERISTIC
/begin CHARACTERISTIC FCspn_UGF_Hv_hi "FCtl_SPN(242)" VALUE 0x001E212C /* @ECU_Address@FCtl_SPN@0x21B603C8@ */ ECIPP_ALIGNMENT_ULONG 4294967295 Compu_IDENTITY 0 4294967295 PHYS_UNIT "SPN" /end CHARACTERISTIC
/begin CHARACTERISTIC FCspn_UGF_internal "FCtl_SPN(241)" VALUE 0x001E2128 /* @ECU_Address@FCtl_SPN@0x21B603C4@ */ ECIPP_ALIGNMENT_ULONG 4294967295 Compu_IDENTITY 0 4294967295 PHYS_UNIT "SPN" /end CHARACTERISTIC
/begin CHARACTERISTIC FCspn_UGF_lowsupply "FCtl_SPN(530)" VALUE 0x001E25AC /* @ECU_Address@FCtl_SPN@0x21B60848@ */ ECIPP_ALIGNMENT_ULONG 4294967295 Compu_IDENTITY 0 4294967295 PHYS_UNIT "SPN" /end CHARACTERISTIC
/begin CHARACTERISTIC FCspn_UGF1_comm_lost "FCtl_SPN(680)" VALUE 0x001E2804 /* @ECU_Address@FCtl_SPN@0x21B60AA0@ */ ECIPP_ALIGNMENT_ULONG 4294967295 Compu_IDENTITY 0 4294967295 PHYS_UNIT "SPN" /end CHARACTERISTIC
/begin CHARACTERISTIC FCspn_UGF1_drifttl2 "FCtl_SPN(536)" VALUE 0x001E25C4 /* @ECU_Address@FCtl_SPN@0x21B60860@ */ ECIPP_ALIGNMENT_ULONG 4294967295 Compu_IDENTITY 0 4294967295 PHYS_UNIT "SPN" /end CHARACTERISTIC
/begin CHARACTERISTIC FCspn_UGF1_drifttol "FCtl_SPN(505)" VALUE 0x001E2548 /* @ECU_Address@FCtl_SPN@0x21B607E4@ */ ECIPP_ALIGNMENT_ULONG 4294967295 Compu_IDENTITY 0 4294967295 PHYS_UNIT "SPN" /end CHARACTERISTIC
/begin CHARACTERISTIC FCspn_UGF1_R_hi "FCtl_SPN(244)" VALUE 0x001E2134 /* @ECU_Address@FCtl_SPN@0x21B603D0@ */ ECIPP_ALIGNMENT_ULONG 4294967295 Compu_IDENTITY 0 4294967295 PHYS_UNIT "SPN" /end CHARACTERISTIC
/begin CHARACTERISTIC FCspn_UGF1_SR_hi "FCtl_SPN(256)" VALUE 0x001E2164 /* @ECU_Address@FCtl_SPN@0x21B60400@ */ ECIPP_ALIGNMENT_ULONG 4294967295 Compu_IDENTITY 0 4294967295 PHYS_UNIT "SPN" /end CHARACTERISTIC
/begin CHARACTERISTIC FCspn_UGF1_SR_slow "FCtl_SPN(254)" VALUE 0x001E215C /* @ECU_Address@FCtl_SPN@0x21B603F8@ */ ECIPP_ALIGNMENT_ULONG 4294967295 Compu_IDENTITY 0 4294967295 PHYS_UNIT "SPN" /end CHARACTERISTIC
/begin CHARACTERISTIC FCspn_UGF1_Sv_hi "FCtl_SPN(250)" VALUE 0x001E214C /* @ECU_Address@FCtl_SPN@0x21B603E8@ */ ECIPP_ALIGNMENT_ULONG 4294967295 Compu_IDENTITY 0 4294967295 PHYS_UNIT "SPN" /end CHARACTERISTIC
/begin CHARACTERISTIC FCspn_UGF2_comm_lost "FCtl_SPN(681)" VALUE 0x001E2808 /* @ECU_Address@FCtl_SPN@0x21B60AA4@ */ ECIPP_ALIGNMENT_ULONG 4294967295 Compu_IDENTITY 0 4294967295 PHYS_UNIT "SPN" /end CHARACTERISTIC
/begin CHARACTERISTIC FCspn_UGF2_drifttl2 "FCtl_SPN(537)" VALUE 0x001E25C8 /* @ECU_Address@FCtl_SPN@0x21B60864@ */ ECIPP_ALIGNMENT_ULONG 4294967295 Compu_IDENTITY 0 4294967295 PHYS_UNIT "SPN" /end CHARACTERISTIC
/begin CHARACTERISTIC FPfl_start_coilshort "FPrm_latch(123)" VALUE 0x001E0204 /* @ECU_Address@FPrm_latch@0x021BB1EC@ */ ECIPP_ALIGNMENT_FLOAT32_IEEE 10000000000 Compu_IDENTITY -10000000000 10000000000 PHYS_UNIT "samples" /end CHARACTERISTIC
/begin CHARACTERISTIC FPfl_start_excess "FPrm_latch(667)" VALUE 0x001E0A84 /* @ECU_Address@FPrm_latch@0x021BBA6C@ */ ECIPP_ALIGNMENT_FLOAT32_IEEE 10000000000 Compu_IDENTITY -10000000000 10000000000 PHYS_UNIT "starts" /end CHARACTERISTIC
/begin CHARACTERISTIC FPfl_start_gndshort "FPrm_latch(121)" VALUE 0x001E01FC /* @ECU_Address@FPrm_latch@0x021BB1E4@ */ ECIPP_ALIGNMENT_FLOAT32_IEEE 10000000000 Compu_IDENTITY -10000000000 10000000000 PHYS_UNIT "samples" /end CHARACTERISTIC
/begin CHARACTERISTIC FPfl_start_stuck_active "FPrm_latch(229)" VALUE 0x001E03AC /* @ECU_Address@FPrm_latch@0x021BB394@ */ ECIPP_ALIGNMENT_FLOAT32_IEEE 10000000000 Compu_IDENTITY -10000000000 10000000000 PHYS_UNIT "ms" /end CHARACTERISTIC
/begin CHARACTERISTIC FPfl_SubDiagTemp "FPrm_latch(483)" VALUE 0x001E07A4 /* @ECU_Address@FPrm_latch@0x021BB78C@ */ ECIPP_ALIGNMENT_FLOAT32_IEEE 10000000000 Compu_IDENTITY -10000000000 10000000000 PHYS_UNIT "ms" /end CHARACTERISTIC
/begin CHARACTERISTIC FPfl_tach_gndshort "FPrm_latch(133)" VALUE 0x001E022C /* @ECU_Address@FPrm_latch@0x021BB214@ */ ECIPP_ALIGNMENT_FLOAT32_IEEE 10000000000 Compu_IDENTITY -10000000000 10000000000 PHYS_UNIT "samples" /end CHARACTERISTIC
/begin CHARACTERISTIC FPfl_tach_pwrshort "FPrm_latch(134)" VALUE 0x001E0230 /* @ECU_Address@FPrm_latch@0x021BB218@ */ ECIPP_ALIGNMENT_FLOAT32_IEEE 10000000000 Compu_IDENTITY -10000000000 10000000000 PHYS_UNIT "samples" /end CHARACTERISTIC
/begin CHARACTERISTIC FPfl_TANK_1_V_maxv "FPrm_latch(698)" VALUE 0x001E0B00 /* @ECU_Address@FPrm_latch@0x021BBAE8@ */ ECIPP_ALIGNMENT_FLOAT32_IEEE 10000000000 Compu_IDENTITY -10000000000 10000000000 PHYS_UNIT "ms" /end CHARACTERISTIC
/begin CHARACTERISTIC FPfl_TANK_1_V_minv "FPrm_latch(699)" VALUE 0x001E0B04 /* @ECU_Address@FPrm_latch@0x021BBAEC@ */ ECIPP_ALIGNMENT_FLOAT32_IEEE 10000000000 Compu_IDENTITY -10000000000 10000000000 PHYS_UNIT "ms" /end CHARACTERISTIC
/begin CHARACTERISTIC FPfl_TANK_1_V_slow "FPrm_latch(700)" VALUE 0x001E0B08 /* @ECU_Address@FPrm_latch@0x021BBAF0@ */ ECIPP_ALIGNMENT_FLOAT32_IEEE 10000000000 Compu_IDENTITY -10000000000 10000000000 PHYS_UNIT "ms" /end CHARACTERISTIC
/begin CHARACTERISTIC FPfl_TAUX_dT1_max "FPrm_latch(428)" VALUE 0x001E06C8 /* @ECU_Address@FPrm_latch@0x021BB6B0@ */ ECIPP_ALIGNMENT_FLOAT32_IEEE 10000000000 Compu_IDENTITY -10000000000 10000000000 PHYS_UNIT "ms" /end CHARACTERISTIC
/begin CHARACTERISTIC FPfl_TAUX_dT1_min "FPrm_latch(429)" VALUE 0x001E06CC /* @ECU_Address@FPrm_latch@0x021BB6B4@ */ ECIPP_ALIGNMENT_FLOAT32_IEEE 10000000000 Compu_IDENTITY -10000000000 10000000000 PHYS_UNIT "ms" /end CHARACTERISTIC
/begin CHARACTERISTIC FPfl_TAUX_dT2_max "FPrm_latch(430)" VALUE 0x001E06D0 /* @ECU_Address@FPrm_latch@0x021BB6B8@ */ ECIPP_ALIGNMENT_FLOAT32_IEEE 10000000000 Compu_IDENTITY -10000000000 10000000000 PHYS_UNIT "ms" /end CHARACTERISTIC
/begin CHARACTERISTIC FPfl_TAUX_dT2_min "FPrm_latch(431)" VALUE 0x001E06D4 /* @ECU_Address@FPrm_latch@0x021BB6BC@ */ ECIPP_ALIGNMENT_FLOAT32_IEEE 10000000000 Compu_IDENTITY -10000000000 10000000000 PHYS_UNIT "ms" /end CHARACTERISTIC
/begin CHARACTERISTIC FPfl_Taux1_derate_actv "FPrm_latch(639)" VALUE 0x001E0A14 /* @ECU_Address@FPrm_latch@0x021BB9FC@ */ ECIPP_ALIGNMENT_FLOAT32_IEEE 10000000000 Compu_IDENTITY -10000000000 10000000000 PHYS_UNIT "ms" /end CHARACTERISTIC
/begin CHARACTERISTIC FPfl_TAUX1_max "FPrm_latch(420)" VALUE 0x001E06A8 /* @ECU_Address@FPrm_latch@0x021BB690@ */ ECIPP_ALIGNMENT_FLOAT32_IEEE 10000000000 Compu_IDENTITY -10000000000 10000000000 PHYS_UNIT "ms" /end CHARACTERISTIC
/begin CHARACTERISTIC FPfl_TAUX1_min "FPrm_latch(421)" VALUE 0x001E06AC /* @ECU_Address@FPrm_latch@0x021BB694@ */ ECIPP_ALIGNMENT_FLOAT32_IEEE 10000000000 Compu_IDENTITY -10000000000 10000000000 PHYS_UNIT "ms" /end CHARACTERISTIC
/begin CHARACTERISTIC FPfl_Taux2_derate_actv "FPrm_latch(640)" VALUE 0x001E0A18 /* @ECU_Address@FPrm_latch@0x021BBA00@ */ ECIPP_ALIGNMENT_FLOAT32_IEEE 10000000000 Compu_IDENTITY -10000000000 10000000000 PHYS_UNIT "ms" /end CHARACTERISTIC
/begin CHARACTERISTIC FPfl_TAUX2_max "FPrm_latch(422)" VALUE 0x001E06B0 /* @ECU_Address@FPrm_latch@0x021BB698@ */ ECIPP_ALIGNMENT_FLOAT32_IEEE 10000000000 Compu_IDENTITY -10000000000 10000000000 PHYS_UNIT "ms" /end CHARACTERISTIC
/begin CHARACTERISTIC FPfl_TAUX2_min "FPrm_latch(423)" VALUE 0x001E06B4 /* @ECU_Address@FPrm_latch@0x021BB69C@ */ ECIPP_ALIGNMENT_FLOAT32_IEEE 10000000000 Compu_IDENTITY -10000000000 10000000000 PHYS_UNIT "ms" /end CHARACTERISTIC
/begin CHARACTERISTIC FPfl_TAUX3_max "FPrm_latch(424)" VALUE 0x001E06B8 /* @ECU_Address@FPrm_latch@0x021BB6A0@ */ ECIPP_ALIGNMENT_FLOAT32_IEEE 10000000000 Compu_IDENTITY -10000000000 10000000000 PHYS_UNIT "ms" /end CHARACTERISTIC
/begin CHARACTERISTIC FPfl_TAUX3_min "FPrm_latch(425)" VALUE 0x001E06BC /* @ECU_Address@FPrm_latch@0x021BB6A4@ */ ECIPP_ALIGNMENT_FLOAT32_IEEE 10000000000 Compu_IDENTITY -10000000000 10000000000 PHYS_UNIT "ms" /end CHARACTERISTIC
/begin CHARACTERISTIC FPfl_TAUX4_max "FPrm_latch(426)" VALUE 0x001E06C0 /* @ECU_Address@FPrm_latch@0x021BB6A8@ */ ECIPP_ALIGNMENT_FLOAT32_IEEE 10000000000 Compu_IDENTITY -10000000000 10000000000 PHYS_UNIT "ms" /end CHARACTERISTIC
/begin CHARACTERISTIC FPfl_TAUX4_min "FPrm_latch(427)" VALUE 0x001E06C4 /* @ECU_Address@FPrm_latch@0x021BB6AC@ */ ECIPP_ALIGNMENT_FLOAT32_IEEE 10000000000 Compu_IDENTITY -10000000000 10000000000 PHYS_UNIT "ms" /end CHARACTERISTIC
/begin CHARACTERISTIC FPfl_TEL_derate_actv "FPrm_latch(477)" VALUE 0x001E078C /* @ECU_Address@FPrm_latch@0x021BB774@ */ ECIPP_ALIGNMENT_FLOAT32_IEEE 10000000000 Compu_IDENTITY -10000000000 10000000000 PHYS_UNIT "ms" /end CHARACTERISTIC
/begin CHARACTERISTIC FPfl_TEL_dis "FPrm_latch(681)" VALUE 0x001E0ABC /* @ECU_Address@FPrm_latch@0x021BBAA4@ */ ECIPP_ALIGNMENT_FLOAT32_IEEE 10000000000 Compu_IDENTITY -10000000000 10000000000 PHYS_UNIT "ms" /end CHARACTERISTIC
/begin CHARACTERISTIC FPfl_TEL_intF "FPrm_latch(682)" VALUE 0x001E0AC0 /* @ECU_Address@FPrm_latch@0x021BBAA8@ */ ECIPP_ALIGNMENT_FLOAT32_IEEE 10000000000 Compu_IDENTITY -10000000000 10000000000 PHYS_UNIT "ms" /end CHARACTERISTIC
/begin CHARACTERISTIC FPfl_TEL_key_invalid "FPrm_latch(648)" VALUE 0x001E0A38 /* @ECU_Address@FPrm_latch@0x021BBA20@ */ ECIPP_ALIGNMENT_FLOAT32_IEEE 10000000000 Compu_IDENTITY -10000000000 10000000000 PHYS_UNIT "ms" /end CHARACTERISTIC
/begin CHARACTERISTIC FPfl_TEL_key_to "FPrm_latch(647)" VALUE 0x001E0A34 /* @ECU_Address@FPrm_latch@0x021BBA1C@ */ ECIPP_ALIGNMENT_FLOAT32_IEEE 10000000000 Compu_IDENTITY -10000000000 10000000000 PHYS_UNIT "ms" /end CHARACTERISTIC
/begin CHARACTERISTIC FPfl_TEL_req_to "FPrm_latch(646)" VALUE 0x001E0A30 /* @ECU_Address@FPrm_latch@0x021BBA18@ */ ECIPP_ALIGNMENT_FLOAT32_IEEE 10000000000 Compu_IDENTITY -10000000000 10000000000 PHYS_UNIT "ms" /end CHARACTERISTIC
/begin CHARACTERISTIC FPfl_TEL_RPM_cmd "FPrm_latch(649)" VALUE 0x001E0A3C /* @ECU_Address@FPrm_latch@0x021BBA24@ */ ECIPP_ALIGNMENT_FLOAT32_IEEE 10000000000 Compu_IDENTITY -10000000000 10000000000 PHYS_UNIT "ms" /end CHARACTERISTIC
/begin CHARACTERISTIC FPfl_TEL_RPM_psv "FPrm_latch(652)" VALUE 0x001E0A48 /* @ECU_Address@FPrm_latch@0x021BBA30@ */ ECIPP_ALIGNMENT_FLOAT32_IEEE 10000000000 Compu_IDENTITY -10000000000 10000000000 PHYS_UNIT "ms" /end CHARACTERISTIC
/begin CHARACTERISTIC FPfl_TEL_shutdown_cmd "FPrm_latch(651)" VALUE 0x001E0A44 /* @ECU_Address@FPrm_latch@0x021BBA2C@ */ ECIPP_ALIGNMENT_FLOAT32_IEEE 10000000000 Compu_IDENTITY -10000000000 10000000000 PHYS_UNIT "ms" /end CHARACTERISTIC
/begin CHARACTERISTIC FPfl_TEL_shutdown_psv "FPrm_latch(654)" VALUE 0x001E0A50 /* @ECU_Address@FPrm_latch@0x021BBA38@ */ ECIPP_ALIGNMENT_FLOAT32_IEEE 10000000000 Compu_IDENTITY -10000000000 10000000000 PHYS_UNIT "ms" /end CHARACTERISTIC
/begin CHARACTERISTIC FPfl_TEL_torq_cmd "FPrm_latch(650)" VALUE 0x001E0A40 /* @ECU_Address@FPrm_latch@0x021BBA28@ */ ECIPP_ALIGNMENT_FLOAT32_IEEE 10000000000 Compu_IDENTITY -10000000000 10000000000 PHYS_UNIT "ms" /end CHARACTERISTIC
/begin CHARACTERISTIC FPfl_TEL_torq_psv "FPrm_latch(653)" VALUE 0x001E0A4C /* @ECU_Address@FPrm_latch@0x021BBA34@ */ ECIPP_ALIGNMENT_FLOAT32_IEEE 10000000000 Compu_IDENTITY -10000000000 10000000000 PHYS_UNIT "ms" /end CHARACTERISTIC
/begin CHARACTERISTIC FPfl_TIP_act "FPrm_latch(105)" VALUE 0x001E01BC /* @ECU_Address@FPrm_latch@0x021BB1A4@ */ ECIPP_ALIGNMENT_FLOAT32_IEEE 10000000000 Compu_IDENTITY -10000000000 10000000000 PHYS_UNIT "ms" /end CHARACTERISTIC
/begin CHARACTERISTIC FPfl_TIP_maxv "FPrm_latch(85)" VALUE 0x001E016C /* @ECU_Address@FPrm_latch@0x021BB154@ */ ECIPP_ALIGNMENT_FLOAT32_IEEE 10000000000 Compu_IDENTITY -10000000000 10000000000 PHYS_UNIT "ms" /end CHARACTERISTIC
/begin CHARACTERISTIC FPfl_TIP_minv "FPrm_latch(86)" VALUE 0x001E0170 /* @ECU_Address@FPrm_latch@0x021BB158@ */ ECIPP_ALIGNMENT_FLOAT32_IEEE 10000000000 Compu_IDENTITY -10000000000 10000000000 PHYS_UNIT "ms" /end CHARACTERISTIC
/begin CHARACTERISTIC FPfl_TPS1_max "FPrm_latch(18)" VALUE 0x001E0060 /* @ECU_Address@FPrm_latch@0x021BB048@ */ ECIPP_ALIGNMENT_FLOAT32_IEEE 10000000000 Compu_IDENTITY -10000000000 10000000000 PHYS_UNIT "ms" /end CHARACTERISTIC
/begin CHARACTERISTIC FPfl_TPS1_min "FPrm_latch(19)" VALUE 0x001E0064 /* @ECU_Address@FPrm_latch@0x021BB04C@ */ ECIPP_ALIGNMENT_FLOAT32_IEEE 10000000000 Compu_IDENTITY -10000000000 10000000000 PHYS_UNIT "ms" /end CHARACTERISTIC
/begin CHARACTERISTIC FPfl_TPS12_OOR "FPrm_latch(144)" VALUE 0x001E0258 /* @ECU_Address@FPrm_latch@0x021BB240@ */ ECIPP_ALIGNMENT_FLOAT32_IEEE 10000000000 Compu_IDENTITY -10000000000 10000000000 PHYS_UNIT "ms" /end CHARACTERISTIC
/begin CHARACTERISTIC FPfl_TPS12pct_hi "FPrm_latch(22)" VALUE 0x001E0070 /* @ECU_Address@FPrm_latch@0x021BB058@ */ ECIPP_ALIGNMENT_FLOAT32_IEEE 10000000000 Compu_IDENTITY -10000000000 10000000000 PHYS_UNIT "ms" /end CHARACTERISTIC
/begin CHARACTERISTIC FPfl_TPS12pct_lo "FPrm_latch(23)" VALUE 0x001E0074 /* @ECU_Address@FPrm_latch@0x021BB05C@ */ ECIPP_ALIGNMENT_FLOAT32_IEEE 10000000000 Compu_IDENTITY -10000000000 10000000000 PHYS_UNIT "ms" /end CHARACTERISTIC
/begin CHARACTERISTIC FPfl_TPS2_max "FPrm_latch(20)" VALUE 0x001E0068 /* @ECU_Address@FPrm_latch@0x021BB050@ */ ECIPP_ALIGNMENT_FLOAT32_IEEE 10000000000 Compu_IDENTITY -10000000000 10000000000 PHYS_UNIT "ms" /end CHARACTERISTIC
/begin CHARACTERISTIC FPfl_TPS2_min "FPrm_latch(21)" VALUE 0x001E006C /* @ECU_Address@FPrm_latch@0x021BB054@ */ ECIPP_ALIGNMENT_FLOAT32_IEEE 10000000000 Compu_IDENTITY -10000000000 10000000000 PHYS_UNIT "ms" /end CHARACTERISTIC
/begin CHARACTERISTIC FPfl_TPSerr_neg "FPrm_latch(25)" VALUE 0x001E007C /* @ECU_Address@FPrm_latch@0x021BB064@ */ ECIPP_ALIGNMENT_FLOAT32_IEEE 10000000000 Compu_IDENTITY -10000000000 10000000000 PHYS_UNIT "ms" /end CHARACTERISTIC
/begin CHARACTERISTIC FPfl_TPSerr_pos "FPrm_latch(24)" VALUE 0x001E0078 /* @ECU_Address@FPrm_latch@0x021BB060@ */ ECIPP_ALIGNMENT_FLOAT32_IEEE 10000000000 Compu_IDENTITY -10000000000 10000000000 PHYS_UNIT "ms" /end CHARACTERISTIC
/begin CHARACTERISTIC FPfl_TRANS_comm "FPrm_latch(678)" VALUE 0x001E0AB0 /* @ECU_Address@FPrm_latch@0x021BBA98@ */ ECIPP_ALIGNMENT_FLOAT32_IEEE 10000000000 Compu_IDENTITY -10000000000 10000000000 PHYS_UNIT "ms" /end CHARACTERISTIC
/begin CHARACTERISTIC FPfl_TRANS_fuel_inh "FPrm_latch(679)" VALUE 0x001E0AB4 /* @ECU_Address@FPrm_latch@0x021BBA9C@ */ ECIPP_ALIGNMENT_FLOAT32_IEEE 10000000000 Compu_IDENTITY -10000000000 10000000000 PHYS_UNIT "ms" /end CHARACTERISTIC
/begin CHARACTERISTIC FPfl_TWCDiag_OSC_lo "FPrm_latch(633)" VALUE 0x001E09FC /* @ECU_Address@FPrm_latch@0x021BB9E4@ */ ECIPP_ALIGNMENT_FLOAT32_IEEE 10000000000 Compu_IDENTITY -10000000000 10000000000 PHYS_UNIT "samples" /end CHARACTERISTIC
/begin CHARACTERISTIC FPfl_UEGOH1_off_open "FPrm_latch(324)" VALUE 0x001E0528 /* @ECU_Address@FPrm_latch@0x021BB510@ */ ECIPP_ALIGNMENT_FLOAT32_IEEE 10000000000 Compu_IDENTITY -10000000000 10000000000 PHYS_UNIT "ms" /end CHARACTERISTIC
/begin CHARACTERISTIC FPfl_UEGOH1_on_short "FPrm_latch(325)" VALUE 0x001E052C /* @ECU_Address@FPrm_latch@0x021BB514@ */ ECIPP_ALIGNMENT_FLOAT32_IEEE 10000000000 Compu_IDENTITY -10000000000 10000000000 PHYS_UNIT "ms" /end CHARACTERISTIC
/begin CHARACTERISTIC FPfl_UEGOH2_off_open "FPrm_latch(326)" VALUE 0x001E0530 /* @ECU_Address@FPrm_latch@0x021BB518@ */ ECIPP_ALIGNMENT_FLOAT32_IEEE 10000000000 Compu_IDENTITY -10000000000 10000000000 PHYS_UNIT "ms" /end CHARACTERISTIC
/begin CHARACTERISTIC FPfl_UEGOH2_on_short "FPrm_latch(327)" VALUE 0x001E0534 /* @ECU_Address@FPrm_latch@0x021BB51C@ */ ECIPP_ALIGNMENT_FLOAT32_IEEE 10000000000 Compu_IDENTITY -10000000000 10000000000 PHYS_UNIT "ms" /end CHARACTERISTIC
/begin CHARACTERISTIC FPfl_UEGOH3_off_open "FPrm_latch(464)" VALUE 0x001E0758 /* @ECU_Address@FPrm_latch@0x021BB740@ */ ECIPP_ALIGNMENT_FLOAT32_IEEE 10000000000 Compu_IDENTITY -10000000000 10000000000 PHYS_UNIT "ms" /end CHARACTERISTIC
/begin CHARACTERISTIC FPfl_UEGOH3_on_short "FPrm_latch(465)" VALUE 0x001E075C /* @ECU_Address@FPrm_latch@0x021BB744@ */ ECIPP_ALIGNMENT_FLOAT32_IEEE 10000000000 Compu_IDENTITY -10000000000 10000000000 PHYS_UNIT "ms" /end CHARACTERISTIC
/begin CHARACTERISTIC FPfl_UEGOH4_off_open "FPrm_latch(475)" VALUE 0x001E0784 /* @ECU_Address@FPrm_latch@0x021BB76C@ */ ECIPP_ALIGNMENT_FLOAT32_IEEE 10000000000 Compu_IDENTITY -10000000000 10000000000 PHYS_UNIT "ms" /end CHARACTERISTIC
/begin CHARACTERISTIC FPfl_UEGOH4_on_short "FPrm_latch(476)" VALUE 0x001E0788 /* @ECU_Address@FPrm_latch@0x021BB770@ */ ECIPP_ALIGNMENT_FLOAT32_IEEE 10000000000 Compu_IDENTITY -10000000000 10000000000 PHYS_UNIT "ms" /end CHARACTERISTIC
/begin CHARACTERISTIC FPfl_UGF_Hv_hi "FPrm_latch(190)" VALUE 0x001E0310 /* @ECU_Address@FPrm_latch@0x021BB2F8@ */ ECIPP_ALIGNMENT_FLOAT32_IEEE 10000000000 Compu_IDENTITY -10000000000 10000000000 PHYS_UNIT "ms" /end CHARACTERISTIC
/begin CHARACTERISTIC FPfl_UGF_internal "FPrm_latch(189)" VALUE 0x001E030C /* @ECU_Address@FPrm_latch@0x021BB2F4@ */ ECIPP_ALIGNMENT_FLOAT32_IEEE 10000000000 Compu_IDENTITY -10000000000 10000000000 PHYS_UNIT "ms" /end CHARACTERISTIC
/begin CHARACTERISTIC FPfl_UGF_lowsupply "FPrm_latch(400)" VALUE 0x001E0658 /* @ECU_Address@FPrm_latch@0x021BB640@ */ ECIPP_ALIGNMENT_FLOAT32_IEEE 10000000000 Compu_IDENTITY -10000000000 10000000000 PHYS_UNIT "ms" /end CHARACTERISTIC
/begin CHARACTERISTIC FPfl_UGF1_comm_lost "FPrm_latch(510)" VALUE 0x001E0810 /* @ECU_Address@FPrm_latch@0x021BB7F8@ */ ECIPP_ALIGNMENT_FLOAT32_IEEE 10000000000 Compu_IDENTITY -10000000000 10000000000 PHYS_UNIT "ms" /end CHARACTERISTIC
/begin CHARACTERISTIC FPfl_UGF1_drifttl2 "FPrm_latch(406)" VALUE 0x001E0670 /* @ECU_Address@FPrm_latch@0x021BB658@ */ ECIPP_ALIGNMENT_FLOAT32_IEEE 10000000000 Compu_IDENTITY -10000000000 10000000000 PHYS_UNIT "ms" /end CHARACTERISTIC
/begin CHARACTERISTIC FPfl_UGF1_drifttol "FPrm_latch(384)" VALUE 0x001E0618 /* @ECU_Address@FPrm_latch@0x021BB600@ */ ECIPP_ALIGNMENT_FLOAT32_IEEE 10000000000 Compu_IDENTITY -10000000000 10000000000 PHYS_UNIT "ms" /end CHARACTERISTIC
/begin CHARACTERISTIC FPfl_UGF1_R_hi "FPrm_latch(191)" VALUE 0x001E0314 /* @ECU_Address@FPrm_latch@0x021BB2FC@ */ ECIPP_ALIGNMENT_FLOAT32_IEEE 10000000000 Compu_IDENTITY -10000000000 10000000000 PHYS_UNIT "ms" /end CHARACTERISTIC
/begin CHARACTERISTIC FPfl_UGF1_SR_hi "FPrm_latch(194)" VALUE 0x001E0320 /* @ECU_Address@FPrm_latch@0x021BB308@ */ ECIPP_ALIGNMENT_FLOAT32_IEEE 10000000000 Compu_IDENTITY -10000000000 10000000000 PHYS_UNIT "ms" /end CHARACTERISTIC
/begin CHARACTERISTIC FPfl_UGF1_SR_slow "FPrm_latch(193)" VALUE 0x001E031C /* @ECU_Address@FPrm_latch@0x021BB304@ */ ECIPP_ALIGNMENT_FLOAT32_IEEE 10000000000 Compu_IDENTITY -10000000000 10000000000 PHYS_UNIT "ms" /end CHARACTERISTIC
/begin CHARACTERISTIC FPfl_UGF1_Sv_hi "FPrm_latch(192)" VALUE 0x001E0318 /* @ECU_Address@FPrm_latch@0x021BB300@ */ ECIPP_ALIGNMENT_FLOAT32_IEEE 10000000000 Compu_IDENTITY -10000000000 10000000000 PHYS_UNIT "ms" /end CHARACTERISTIC
/begin CHARACTERISTIC FPfl_UGF2_comm_lost "FPrm_latch(511)" VALUE 0x001E0814 /* @ECU_Address@FPrm_latch@0x021BB7FC@ */ ECIPP_ALIGNMENT_FLOAT32_IEEE 10000000000 Compu_IDENTITY -10000000000 10000000000 PHYS_UNIT "ms" /end CHARACTERISTIC
/begin CHARACTERISTIC FPfl_UGF2_drifttl2 "FPrm_latch(407)" VALUE 0x001E0674 /* @ECU_Address@FPrm_latch@0x021BB65C@ */ ECIPP_ALIGNMENT_FLOAT32_IEEE 10000000000 Compu_IDENTITY -10000000000 10000000000 PHYS_UNIT "ms" /end CHARACTERISTIC
/begin CHARACTERISTIC FPfu_start_coilshort "FPrm_unlatch(123)" VALUE 0x001E0D4C /* @ECU_Address@FPrm_unlatch@0x021BD1EC@ */ ECIPP_ALIGNMENT_FLOAT32_IEEE 10000000000 Compu_IDENTITY -10000000000 10000000000 PHYS_UNIT "samples" /end CHARACTERISTIC
/begin CHARACTERISTIC FPfu_start_excess "FPrm_unlatch(667)" VALUE 0x001E15CC /* @ECU_Address@FPrm_unlatch@0x021BDA6C@ */ ECIPP_ALIGNMENT_FLOAT32_IEEE 10000000000 Compu_IDENTITY -10000000000 10000000000 PHYS_UNIT "starts" /end CHARACTERISTIC
/begin CHARACTERISTIC FPfu_start_gndshort "FPrm_unlatch(121)" VALUE 0x001E0D44 /* @ECU_Address@FPrm_unlatch@0x021BD1E4@ */ ECIPP_ALIGNMENT_FLOAT32_IEEE 10000000000 Compu_IDENTITY -10000000000 10000000000 PHYS_UNIT "samples" /end CHARACTERISTIC
/begin CHARACTERISTIC FPfu_start_stuck_active "FPrm_unlatch(229)" VALUE 0x001E0EF4 /* @ECU_Address@FPrm_unlatch@0x021BD394@ */ ECIPP_ALIGNMENT_FLOAT32_IEEE 10000000000 Compu_IDENTITY -10000000000 10000000000 PHYS_UNIT "ms" /end CHARACTERISTIC
/begin CHARACTERISTIC FPfu_SubDiagTemp "FPrm_unlatch(483)" VALUE 0x001E12EC /* @ECU_Address@FPrm_unlatch@0x021BD78C@ */ ECIPP_ALIGNMENT_FLOAT32_IEEE 10000000000 Compu_IDENTITY -10000000000 10000000000 PHYS_UNIT "ms" /end CHARACTERISTIC
/begin CHARACTERISTIC FPfu_tach_gndshort "FPrm_unlatch(133)" VALUE 0x001E0D74 /* @ECU_Address@FPrm_unlatch@0x021BD214@ */ ECIPP_ALIGNMENT_FLOAT32_IEEE 10000000000 Compu_IDENTITY -10000000000 10000000000 PHYS_UNIT "samples" /end CHARACTERISTIC
/begin CHARACTERISTIC FPfu_tach_pwrshort "FPrm_unlatch(134)" VALUE 0x001E0D78 /* @ECU_Address@FPrm_unlatch@0x021BD218@ */ ECIPP_ALIGNMENT_FLOAT32_IEEE 10000000000 Compu_IDENTITY -10000000000 10000000000 PHYS_UNIT "samples" /end CHARACTERISTIC
/begin CHARACTERISTIC FPfu_TANK_1_V_maxv "FPrm_unlatch(698)" VALUE 0x001E1648 /* @ECU_Address@FPrm_unlatch@0x021BDAE8@ */ ECIPP_ALIGNMENT_FLOAT32_IEEE 10000000000 Compu_IDENTITY -10000000000 10000000000 PHYS_UNIT "ms" /end CHARACTERISTIC
/begin CHARACTERISTIC FPfu_TANK_1_V_minv "FPrm_unlatch(699)" VALUE 0x001E164C /* @ECU_Address@FPrm_unlatch@0x021BDAEC@ */ ECIPP_ALIGNMENT_FLOAT32_IEEE 10000000000 Compu_IDENTITY -10000000000 10000000000 PHYS_UNIT "ms" /end CHARACTERISTIC
/begin CHARACTERISTIC FPfu_TANK_1_V_slow "FPrm_unlatch(700)" VALUE 0x001E1650 /* @ECU_Address@FPrm_unlatch@0x021BDAF0@ */ ECIPP_ALIGNMENT_FLOAT32_IEEE 10000000000 Compu_IDENTITY -10000000000 10000000000 PHYS_UNIT "ms" /end CHARACTERISTIC
/begin CHARACTERISTIC FPfu_TAUX_dT1_max "FPrm_unlatch(428)" VALUE 0x001E1210 /* @ECU_Address@FPrm_unlatch@0x021BD6B0@ */ ECIPP_ALIGNMENT_FLOAT32_IEEE 10000000000 Compu_IDENTITY -10000000000 10000000000 PHYS_UNIT "ms" /end CHARACTERISTIC
/begin CHARACTERISTIC FPfu_TAUX_dT1_min "FPrm_unlatch(429)" VALUE 0x001E1214 /* @ECU_Address@FPrm_unlatch@0x021BD6B4@ */ ECIPP_ALIGNMENT_FLOAT32_IEEE 10000000000 Compu_IDENTITY -10000000000 10000000000 PHYS_UNIT "ms" /end CHARACTERISTIC
/begin CHARACTERISTIC FPfu_TAUX_dT2_max "FPrm_unlatch(430)" VALUE 0x001E1218 /* @ECU_Address@FPrm_unlatch@0x021BD6B8@ */ ECIPP_ALIGNMENT_FLOAT32_IEEE 10000000000 Compu_IDENTITY -10000000000 10000000000 PHYS_UNIT "ms" /end CHARACTERISTIC
/begin CHARACTERISTIC FPfu_TAUX_dT2_min "FPrm_unlatch(431)" VALUE 0x001E121C /* @ECU_Address@FPrm_unlatch@0x021BD6BC@ */ ECIPP_ALIGNMENT_FLOAT32_IEEE 10000000000 Compu_IDENTITY -10000000000 10000000000 PHYS_UNIT "ms" /end CHARACTERISTIC
/begin CHARACTERISTIC FPfu_Taux1_derate_actv "FPrm_unlatch(639)" VALUE 0x001E155C /* @ECU_Address@FPrm_unlatch@0x021BD9FC@ */ ECIPP_ALIGNMENT_FLOAT32_IEEE 10000000000 Compu_IDENTITY -10000000000 10000000000 PHYS_UNIT "ms" /end CHARACTERISTIC
/begin CHARACTERISTIC FPfu_TAUX1_max "FPrm_unlatch(420)" VALUE 0x001E11F0 /* @ECU_Address@FPrm_unlatch@0x021BD690@ */ ECIPP_ALIGNMENT_FLOAT32_IEEE 10000000000 Compu_IDENTITY -10000000000 10000000000 PHYS_UNIT "ms" /end CHARACTERISTIC
/begin CHARACTERISTIC FPfu_TAUX1_min "FPrm_unlatch(421)" VALUE 0x001E11F4 /* @ECU_Address@FPrm_unlatch@0x021BD694@ */ ECIPP_ALIGNMENT_FLOAT32_IEEE 10000000000 Compu_IDENTITY -10000000000 10000000000 PHYS_UNIT "ms" /end CHARACTERISTIC
/begin CHARACTERISTIC FPfu_Taux2_derate_actv "FPrm_unlatch(640)" VALUE 0x001E1560 /* @ECU_Address@FPrm_unlatch@0x021BDA00@ */ ECIPP_ALIGNMENT_FLOAT32_IEEE 10000000000 Compu_IDENTITY -10000000000 10000000000 PHYS_UNIT "ms" /end CHARACTERISTIC
/begin CHARACTERISTIC FPfu_TAUX2_max "FPrm_unlatch(422)" VALUE 0x001E11F8 /* @ECU_Address@FPrm_unlatch@0x021BD698@ */ ECIPP_ALIGNMENT_FLOAT32_IEEE 10000000000 Compu_IDENTITY -10000000000 10000000000 PHYS_UNIT "ms" /end CHARACTERISTIC
/begin CHARACTERISTIC FPfu_TAUX2_min "FPrm_unlatch(423)" VALUE 0x001E11FC /* @ECU_Address@FPrm_unlatch@0x021BD69C@ */ ECIPP_ALIGNMENT_FLOAT32_IEEE 10000000000 Compu_IDENTITY -10000000000 10000000000 PHYS_UNIT "ms" /end CHARACTERISTIC
/begin CHARACTERISTIC FPfu_TAUX3_max "FPrm_unlatch(424)" VALUE 0x001E1200 /* @ECU_Address@FPrm_unlatch@0x021BD6A0@ */ ECIPP_ALIGNMENT_FLOAT32_IEEE 10000000000 Compu_IDENTITY -10000000000 10000000000 PHYS_UNIT "ms" /end CHARACTERISTIC
/begin CHARACTERISTIC FPfu_TAUX3_min "FPrm_unlatch(425)" VALUE 0x001E1204 /* @ECU_Address@FPrm_unlatch@0x021BD6A4@ */ ECIPP_ALIGNMENT_FLOAT32_IEEE 10000000000 Compu_IDENTITY -10000000000 10000000000 PHYS_UNIT "ms" /end CHARACTERISTIC
/begin CHARACTERISTIC FPfu_TAUX4_max "FPrm_unlatch(426)" VALUE 0x001E1208 /* @ECU_Address@FPrm_unlatch@0x021BD6A8@ */ ECIPP_ALIGNMENT_FLOAT32_IEEE 10000000000 Compu_IDENTITY -10000000000 10000000000 PHYS_UNIT "ms" /end CHARACTERISTIC
/begin CHARACTERISTIC FPfu_TAUX4_min "FPrm_unlatch(427)" VALUE 0x001E120C /* @ECU_Address@FPrm_unlatch@0x021BD6AC@ */ ECIPP_ALIGNMENT_FLOAT32_IEEE 10000000000 Compu_IDENTITY -10000000000 10000000000 PHYS_UNIT "ms" /end CHARACTERISTIC
/begin CHARACTERISTIC FPfu_TEL_derate_actv "FPrm_unlatch(477)" VALUE 0x001E12D4 /* @ECU_Address@FPrm_unlatch@0x021BD774@ */ ECIPP_ALIGNMENT_FLOAT32_IEEE 10000000000 Compu_IDENTITY -10000000000 10000000000 PHYS_UNIT "ms" /end CHARACTERISTIC
/begin CHARACTERISTIC FPfu_TEL_dis "FPrm_unlatch(681)" VALUE 0x001E1604 /* @ECU_Address@FPrm_unlatch@0x021BDAA4@ */ ECIPP_ALIGNMENT_FLOAT32_IEEE 10000000000 Compu_IDENTITY -10000000000 10000000000 PHYS_UNIT "ms" /end CHARACTERISTIC
/begin CHARACTERISTIC FPfu_TEL_intF "FPrm_unlatch(682)" VALUE 0x001E1608 /* @ECU_Address@FPrm_unlatch@0x021BDAA8@ */ ECIPP_ALIGNMENT_FLOAT32_IEEE 10000000000 Compu_IDENTITY -10000000000 10000000000 PHYS_UNIT "ms" /end CHARACTERISTIC
/begin CHARACTERISTIC FPfu_TEL_key_invalid "FPrm_unlatch(648)" VALUE 0x001E1580 /* @ECU_Address@FPrm_unlatch@0x021BDA20@ */ ECIPP_ALIGNMENT_FLOAT32_IEEE 10000000000 Compu_IDENTITY -10000000000 10000000000 PHYS_UNIT "ms" /end CHARACTERISTIC
/begin CHARACTERISTIC FPfu_TEL_key_to "FPrm_unlatch(647)" VALUE 0x001E157C /* @ECU_Address@FPrm_unlatch@0x021BDA1C@ */ ECIPP_ALIGNMENT_FLOAT32_IEEE 10000000000 Compu_IDENTITY -10000000000 10000000000 PHYS_UNIT "ms" /end CHARACTERISTIC
/begin CHARACTERISTIC FPfu_TEL_req_to "FPrm_unlatch(646)" VALUE 0x001E1578 /* @ECU_Address@FPrm_unlatch@0x021BDA18@ */ ECIPP_ALIGNMENT_FLOAT32_IEEE 10000000000 Compu_IDENTITY -10000000000 10000000000 PHYS_UNIT "ms" /end CHARACTERISTIC
/begin CHARACTERISTIC FPfu_TEL_RPM_cmd "FPrm_unlatch(649)" VALUE 0x001E1584 /* @ECU_Address@FPrm_unlatch@0x021BDA24@ */ ECIPP_ALIGNMENT_FLOAT32_IEEE 10000000000 Compu_IDENTITY -10000000000 10000000000 PHYS_UNIT "ms" /end CHARACTERISTIC
/begin CHARACTERISTIC FPfu_TEL_RPM_psv "FPrm_unlatch(652)" VALUE 0x001E1590 /* @ECU_Address@FPrm_unlatch@0x021BDA30@ */ ECIPP_ALIGNMENT_FLOAT32_IEEE 10000000000 Compu_IDENTITY -10000000000 10000000000 PHYS_UNIT "ms" /end CHARACTERISTIC
/begin CHARACTERISTIC FPfu_TEL_shutdown_cmd "FPrm_unlatch(651)" VALUE 0x001E158C /* @ECU_Address@FPrm_unlatch@0x021BDA2C@ */ ECIPP_ALIGNMENT_FLOAT32_IEEE 10000000000 Compu_IDENTITY -10000000000 10000000000 PHYS_UNIT "ms" /end CHARACTERISTIC
/begin CHARACTERISTIC FPfu_TEL_shutdown_psv "FPrm_unlatch(654)" VALUE 0x001E1598 /* @ECU_Address@FPrm_unlatch@0x021BDA38@ */ ECIPP_ALIGNMENT_FLOAT32_IEEE 10000000000 Compu_IDENTITY -10000000000 10000000000 PHYS_UNIT "ms" /end CHARACTERISTIC
/begin CHARACTERISTIC FPfu_TEL_torq_cmd "FPrm_unlatch(650)" VALUE 0x001E1588 /* @ECU_Address@FPrm_unlatch@0x021BDA28@ */ ECIPP_ALIGNMENT_FLOAT32_IEEE 10000000000 Compu_IDENTITY -10000000000 10000000000 PHYS_UNIT "ms" /end CHARACTERISTIC
/begin CHARACTERISTIC FPfu_TEL_torq_psv "FPrm_unlatch(653)" VALUE 0x001E1594 /* @ECU_Address@FPrm_unlatch@0x021BDA34@ */ ECIPP_ALIGNMENT_FLOAT32_IEEE 10000000000 Compu_IDENTITY -10000000000 10000000000 PHYS_UNIT "ms" /end CHARACTERISTIC
/begin CHARACTERISTIC FPfu_TIP_act "FPrm_unlatch(105)" VALUE 0x001E0D04 /* @ECU_Address@FPrm_unlatch@0x021BD1A4@ */ ECIPP_ALIGNMENT_FLOAT32_IEEE 10000000000 Compu_IDENTITY -10000000000 10000000000 PHYS_UNIT "ms" /end CHARACTERISTIC
/begin CHARACTERISTIC FPfu_TIP_maxv "FPrm_unlatch(85)" VALUE 0x001E0CB4 /* @ECU_Address@FPrm_unlatch@0x021BD154@ */ ECIPP_ALIGNMENT_FLOAT32_IEEE 10000000000 Compu_IDENTITY -10000000000 10000000000 PHYS_UNIT "ms" /end CHARACTERISTIC
/begin CHARACTERISTIC FPfu_TIP_minv "FPrm_unlatch(86)" VALUE 0x001E0CB8 /* @ECU_Address@FPrm_unlatch@0x021BD158@ */ ECIPP_ALIGNMENT_FLOAT32_IEEE 10000000000 Compu_IDENTITY -10000000000 10000000000 PHYS_UNIT "ms" /end CHARACTERISTIC
/begin CHARACTERISTIC FPfu_TPS1_max "FPrm_unlatch(18)" VALUE 0x001E0BA8 /* @ECU_Address@FPrm_unlatch@0x021BD048@ */ ECIPP_ALIGNMENT_FLOAT32_IEEE 10000000000 Compu_IDENTITY -10000000000 10000000000 PHYS_UNIT "ms" /end CHARACTERISTIC
/begin CHARACTERISTIC FPfu_TPS1_min "FPrm_unlatch(19)" VALUE 0x001E0BAC /* @ECU_Address@FPrm_unlatch@0x021BD04C@ */ ECIPP_ALIGNMENT_FLOAT32_IEEE 10000000000 Compu_IDENTITY -10000000000 10000000000 PHYS_UNIT "ms" /end CHARACTERISTIC
/begin CHARACTERISTIC FPfu_TPS12_OOR "FPrm_unlatch(144)" VALUE 0x001E0DA0 /* @ECU_Address@FPrm_unlatch@0x021BD240@ */ ECIPP_ALIGNMENT_FLOAT32_IEEE 10000000000 Compu_IDENTITY -10000000000 10000000000 PHYS_UNIT "ms" /end CHARACTERISTIC
/begin CHARACTERISTIC FPfu_TPS12pct_hi "FPrm_unlatch(22)" VALUE 0x001E0BB8 /* @ECU_Address@FPrm_unlatch@0x021BD058@ */ ECIPP_ALIGNMENT_FLOAT32_IEEE 10000000000 Compu_IDENTITY -10000000000 10000000000 PHYS_UNIT "ms" /end CHARACTERISTIC
/begin CHARACTERISTIC FPfu_TPS12pct_lo "FPrm_unlatch(23)" VALUE 0x001E0BBC /* @ECU_Address@FPrm_unlatch@0x021BD05C@ */ ECIPP_ALIGNMENT_FLOAT32_IEEE 10000000000 Compu_IDENTITY -10000000000 10000000000 PHYS_UNIT "ms" /end CHARACTERISTIC
/begin CHARACTERISTIC FPfu_TPS2_max "FPrm_unlatch(20)" VALUE 0x001E0BB0 /* @ECU_Address@FPrm_unlatch@0x021BD050@ */ ECIPP_ALIGNMENT_FLOAT32_IEEE 10000000000 Compu_IDENTITY -10000000000 10000000000 PHYS_UNIT "ms" /end CHARACTERISTIC
/begin CHARACTERISTIC FPfu_TPS2_min "FPrm_unlatch(21)" VALUE 0x001E0BB4 /* @ECU_Address@FPrm_unlatch@0x021BD054@ */ ECIPP_ALIGNMENT_FLOAT32_IEEE 10000000000 Compu_IDENTITY -10000000000 10000000000 PHYS_UNIT "ms" /end CHARACTERISTIC
/begin CHARACTERISTIC FPfu_TPSerr_neg "FPrm_unlatch(25)" VALUE 0x001E0BC4 /* @ECU_Address@FPrm_unlatch@0x021BD064@ */ ECIPP_ALIGNMENT_FLOAT32_IEEE 10000000000 Compu_IDENTITY -10000000000 10000000000 PHYS_UNIT "ms" /end CHARACTERISTIC
/begin CHARACTERISTIC FPfu_TPSerr_pos "FPrm_unlatch(24)" VALUE 0x001E0BC0 /* @ECU_Address@FPrm_unlatch@0x021BD060@ */ ECIPP_ALIGNMENT_FLOAT32_IEEE 10000000000 Compu_IDENTITY -10000000000 10000000000 PHYS_UNIT "ms" /end CHARACTERISTIC
/begin CHARACTERISTIC FPfu_TRANS_comm "FPrm_unlatch(678)" VALUE 0x001E15F8 /* @ECU_Address@FPrm_unlatch@0x021BDA98@ */ ECIPP_ALIGNMENT_FLOAT32_IEEE 10000000000 Compu_IDENTITY -10000000000 10000000000 PHYS_UNIT "ms" /end CHARACTERISTIC
/begin CHARACTERISTIC FPfu_TRANS_fuel_inh "FPrm_unlatch(679)" VALUE 0x001E15FC /* @ECU_Address@FPrm_unlatch@0x021BDA9C@ */ ECIPP_ALIGNMENT_FLOAT32_IEEE 10000000000 Compu_IDENTITY -10000000000 10000000000 PHYS_UNIT "ms" /end CHARACTERISTIC
/begin CHARACTERISTIC FPfu_TWCDiag_OSC_lo "FPrm_unlatch(633)" VALUE 0x001E1544 /* @ECU_Address@FPrm_unlatch@0x021BD9E4@ */ ECIPP_ALIGNMENT_FLOAT32_IEEE 10000000000 Compu_IDENTITY -10000000000 10000000000 PHYS_UNIT "samples" /end CHARACTERISTIC
/begin CHARACTERISTIC FPfu_UEGOH1_off_open "FPrm_unlatch(324)" VALUE 0x001E1070 /* @ECU_Address@FPrm_unlatch@0x021BD510@ */ ECIPP_ALIGNMENT_FLOAT32_IEEE 10000000000 Compu_IDENTITY -10000000000 10000000000 PHYS_UNIT "ms" /end CHARACTERISTIC
/begin CHARACTERISTIC FPfu_UEGOH1_on_short "FPrm_unlatch(325)" VALUE 0x001E1074 /* @ECU_Address@FPrm_unlatch@0x021BD514@ */ ECIPP_ALIGNMENT_FLOAT32_IEEE 10000000000 Compu_IDENTITY -10000000000 10000000000 PHYS_UNIT "ms" /end CHARACTERISTIC
/begin CHARACTERISTIC FPfu_UEGOH2_off_open "FPrm_unlatch(326)" VALUE 0x001E1078 /* @ECU_Address@FPrm_unlatch@0x021BD518@ */ ECIPP_ALIGNMENT_FLOAT32_IEEE 10000000000 Compu_IDENTITY -10000000000 10000000000 PHYS_UNIT "ms" /end CHARACTERISTIC
/begin CHARACTERISTIC FPfu_UEGOH2_on_short "FPrm_unlatch(327)" VALUE 0x001E107C /* @ECU_Address@FPrm_unlatch@0x021BD51C@ */ ECIPP_ALIGNMENT_FLOAT32_IEEE 10000000000 Compu_IDENTITY -10000000000 10000000000 PHYS_UNIT "ms" /end CHARACTERISTIC
/begin CHARACTERISTIC FPfu_UEGOH3_off_open "FPrm_unlatch(464)" VALUE 0x001E12A0 /* @ECU_Address@FPrm_unlatch@0x021BD740@ */ ECIPP_ALIGNMENT_FLOAT32_IEEE 10000000000 Compu_IDENTITY -10000000000 10000000000 PHYS_UNIT "ms" /end CHARACTERISTIC
/begin CHARACTERISTIC FPfu_UEGOH3_on_short "FPrm_unlatch(465)" VALUE 0x001E12A4 /* @ECU_Address@FPrm_unlatch@0x021BD744@ */ ECIPP_ALIGNMENT_FLOAT32_IEEE 10000000000 Compu_IDENTITY -10000000000 10000000000 PHYS_UNIT "ms" /end CHARACTERISTIC
/begin CHARACTERISTIC FPfu_UEGOH4_off_open "FPrm_unlatch(475)" VALUE 0x001E12CC /* @ECU_Address@FPrm_unlatch@0x021BD76C@ */ ECIPP_ALIGNMENT_FLOAT32_IEEE 10000000000 Compu_IDENTITY -10000000000 10000000000 PHYS_UNIT "ms" /end CHARACTERISTIC
/begin CHARACTERISTIC FPfu_UEGOH4_on_short "FPrm_unlatch(476)" VALUE 0x001E12D0 /* @ECU_Address@FPrm_unlatch@0x021BD770@ */ ECIPP_ALIGNMENT_FLOAT32_IEEE 10000000000 Compu_IDENTITY -10000000000 10000000000 PHYS_UNIT "ms" /end CHARACTERISTIC
/begin CHARACTERISTIC FPfu_UGF_Hv_hi "FPrm_unlatch(190)" VALUE 0x001E0E58 /* @ECU_Address@FPrm_unlatch@0x021BD2F8@ */ ECIPP_ALIGNMENT_FLOAT32_IEEE 10000000000 Compu_IDENTITY -10000000000 10000000000 PHYS_UNIT "ms" /end CHARACTERISTIC
/begin CHARACTERISTIC FPfu_UGF_internal "FPrm_unlatch(189)" VALUE 0x001E0E54 /* @ECU_Address@FPrm_unlatch@0x021BD2F4@ */ ECIPP_ALIGNMENT_FLOAT32_IEEE 10000000000 Compu_IDENTITY -10000000000 10000000000 PHYS_UNIT "ms" /end CHARACTERISTIC
/begin CHARACTERISTIC FPfu_UGF_lowsupply "FPrm_unlatch(400)" VALUE 0x001E11A0 /* @ECU_Address@FPrm_unlatch@0x021BD640@ */ ECIPP_ALIGNMENT_FLOAT32_IEEE 10000000000 Compu_IDENTITY -10000000000 10000000000 PHYS_UNIT "ms" /end CHARACTERISTIC
/begin CHARACTERISTIC FPfu_UGF1_comm_lost "FPrm_unlatch(510)" VALUE 0x001E1358 /* @ECU_Address@FPrm_unlatch@0x021BD7F8@ */ ECIPP_ALIGNMENT_FLOAT32_IEEE 10000000000 Compu_IDENTITY -10000000000 10000000000 PHYS_UNIT "ms" /end CHARACTERISTIC
/begin CHARACTERISTIC FPfu_UGF1_drifttl2 "FPrm_unlatch(406)" VALUE 0x001E11B8 /* @ECU_Address@FPrm_unlatch@0x021BD658@ */ ECIPP_ALIGNMENT_FLOAT32_IEEE 10000000000 Compu_IDENTITY -10000000000 10000000000 PHYS_UNIT "ms" /end CHARACTERISTIC
/begin CHARACTERISTIC FPfu_UGF1_drifttol "FPrm_unlatch(384)" VALUE 0x001E1160 /* @ECU_Address@FPrm_unlatch@0x021BD600@ */ ECIPP_ALIGNMENT_FLOAT32_IEEE 10000000000 Compu_IDENTITY -10000000000 10000000000 PHYS_UNIT "ms" /end CHARACTERISTIC
/begin CHARACTERISTIC FPfu_UGF1_R_hi "FPrm_unlatch(191)" VALUE 0x001E0E5C /* @ECU_Address@FPrm_unlatch@0x021BD2FC@ */ ECIPP_ALIGNMENT_FLOAT32_IEEE 10000000000 Compu_IDENTITY -10000000000 10000000000 PHYS_UNIT "ms" /end CHARACTERISTIC
/begin CHARACTERISTIC FPfu_UGF1_SR_hi "FPrm_unlatch(194)" VALUE 0x001E0E68 /* @ECU_Address@FPrm_unlatch@0x021BD308@ */ ECIPP_ALIGNMENT_FLOAT32_IEEE 10000000000 Compu_IDENTITY -10000000000 10000000000 PHYS_UNIT "ms" /end CHARACTERISTIC
/begin CHARACTERISTIC FPfu_UGF1_SR_slow "FPrm_unlatch(193)" VALUE 0x001E0E64 /* @ECU_Address@FPrm_unlatch@0x021BD304@ */ ECIPP_ALIGNMENT_FLOAT32_IEEE 10000000000 Compu_IDENTITY -10000000000 10000000000 PHYS_UNIT "ms" /end CHARACTERISTIC
/begin CHARACTERISTIC FPfu_UGF1_Sv_hi "FPrm_unlatch(192)" VALUE 0x001E0E60 /* @ECU_Address@FPrm_unlatch@0x021BD300@ */ ECIPP_ALIGNMENT_FLOAT32_IEEE 10000000000 Compu_IDENTITY -10000000000 10000000000 PHYS_UNIT "ms" /end CHARACTERISTIC
/begin CHARACTERISTIC FPfu_UGF2_comm_lost "FPrm_unlatch(511)" VALUE 0x001E135C /* @ECU_Address@FPrm_unlatch@0x021BD7FC@ */ ECIPP_ALIGNMENT_FLOAT32_IEEE 10000000000 Compu_IDENTITY -10000000000 10000000000 PHYS_UNIT "ms" /end CHARACTERISTIC
/begin CHARACTERISTIC FPfu_UGF2_drifttl2 "FPrm_unlatch(407)" VALUE 0x001E11BC /* @ECU_Address@FPrm_unlatch@0x021BD65C@ */ ECIPP_ALIGNMENT_FLOAT32_IEEE 10000000000 Compu_IDENTITY -10000000000 10000000000 PHYS_UNIT "ms" /end CHARACTERISTIC
/begin GROUP start_coilshort_EC_Fault "Start relay coil short to power"
 /begin REF_CHARACTERISTIC FCdc4_start_coilshort FCdtc_start_coilshort FCfmi_start_coilshort FCftb_start_coilshort FCspn_start_coilshort FPfl_start_coilshort FPfu_start_coilshort FPnd_start_coilshort FPsvr_start_coilshort FPsw_ext1_start_coilshort FPsw_start_coilshort /end REF_CHARACTERISTIC
/end GROUP
/begin GROUP start_excess_EC_Fault "Excessive start attempts"
 /begin REF_CHARACTERISTIC FCdc4_start_excess FCdtc_start_excess FCfmi_start_excess FCftb_start_excess FCspn_start_excess FPfl_start_excess FPfu_start_excess FPnd_start_excess FPsvr_start_excess FPsw_ext1_start_excess FPsw_start_excess /end REF_CHARACTERISTIC
/end GROUP
/begin GROUP start_gndshort_EC_Fault "Start relay control ground short"
 /begin REF_CHARACTERISTIC FCdc4_start_gndshort FCdtc_start_gndshort FCfmi_start_gndshort FCftb_start_gndshort FCspn_start_gndshort FPfl_start_gndshort FPfu_start_gndshort FPnd_start_gndshort FPsvr_start_gndshort FPsw_ext1_start_gndshort FPsw_start_gndshort /end REF_CHARACTERISTIC
/end GROUP
/begin GROUP start_stuck_active_EC_Fault "Start command stuck active"
 /begin REF_CHARACTERISTIC FCdc4_start_stuck_active FCdtc_start_stuck_active FCfmi_start_stuck_active FCftb_start_stuck_active FCspn_start_stuck_active FPfl_start_stuck_active FPfu_start_stuck_active FPnd_start_stuck_active FPsvr_start_stuck_active FPsw_ext1_start_stuck_active FPsw_start_stuck_active /end REF_CHARACTERISTIC
/end GROUP
/begin GROUP SubDiagTemp_EC_Fault "ECT dropped below diagnostics temperature"
 /begin REF_CHARACTERISTIC FCdc4_SubDiagTemp FCdtc_SubDiagTemp FCfmi_SubDiagTemp FCftb_SubDiagTemp FCspn_SubDiagTemp FPfl_SubDiagTemp FPfu_SubDiagTemp FPnd_SubDiagTemp FPsvr_SubDiagTemp FPsw_ext1_SubDiagTemp FPsw_SubDiagTemp /end REF_CHARACTERISTIC
/end GROUP
/begin GROUP tach_gndshort_EC_Fault "Tach output ground short"
 /begin REF_CHARACTERISTIC FCdc4_tach_gndshort FCdtc_tach_gndshort FCfmi_tach_gndshort FCftb_tach_gndshort FCspn_tach_gndshort FPfl_tach_gndshort FPfu_tach_gndshort FPnd_tach_gndshort FPsvr_tach_gndshort FPsw_ext1_tach_gndshort FPsw_tach_gndshort /end REF_CHARACTERISTIC
/end GROUP
/begin GROUP tach_pwrshort_EC_Fault "Tach output short to power"
 /begin REF_CHARACTERISTIC FCdc4_tach_pwrshort FCdtc_tach_pwrshort FCfmi_tach_pwrshort FCftb_tach_pwrshort FCspn_tach_pwrshort FPfl_tach_pwrshort FPfu_tach_pwrshort FPnd_tach_pwrshort FPsvr_tach_pwrshort FPsw_ext1_tach_pwrshort FPsw_tach_pwrshort /end REF_CHARACTERISTIC
/end GROUP
/begin GROUP TANK_1_V_maxv_EC_Fault "TANK_1_V high voltage"
 /begin REF_CHARACTERISTIC FCdc4_TANK_1_V_maxv FCdtc_TANK_1_V_maxv FCfmi_TANK_1_V_maxv FCftb_TANK_1_V_maxv FCspn_TANK_1_V_maxv FPfl_TANK_1_V_maxv FPfu_TANK_1_V_maxv FPnd_TANK_1_V_maxv FPsvr_TANK_1_V_maxv FPsw_ext1_TANK_1_V_maxv FPsw_TANK_1_V_maxv /end REF_CHARACTERISTIC
/end GROUP
/begin GROUP TANK_1_V_minv_EC_Fault "TANK_1_V low voltage"
 /begin REF_CHARACTERISTIC FCdc4_TANK_1_V_minv FCdtc_TANK_1_V_minv FCfmi_TANK_1_V_minv FCftb_TANK_1_V_minv FCspn_TANK_1_V_minv FPfl_TANK_1_V_minv FPfu_TANK_1_V_minv FPnd_TANK_1_V_minv FPsvr_TANK_1_V_minv FPsw_ext1_TANK_1_V_minv FPsw_TANK_1_V_minv /end REF_CHARACTERISTIC
/end GROUP
/begin GROUP TANK_1_V_slow_EC_Fault "TANK_1_V slow recovery"
 /begin REF_CHARACTERISTIC FCdc4_TANK_1_V_slow FCdtc_TANK_1_V_slow FCfmi_TANK_1_V_slow FCftb_TANK_1_V_slow FCspn_TANK_1_V_slow FPfl_TANK_1_V_slow FPfu_TANK_1_V_slow FPnd_TANK_1_V_slow FPsvr_TANK_1_V_slow FPsw_ext1_TANK_1_V_slow FPsw_TANK_1_V_slow /end REF_CHARACTERISTIC
/end GROUP
/begin GROUP TAUX_dT1_max_EC_Fault "AUX Temperature delta T 1 high"
 /begin REF_CHARACTERISTIC FCdc4_TAUX_dT1_max FCdtc_TAUX_dT1_max FCfmi_TAUX_dT1_max FCftb_TAUX_dT1_max FCspn_TAUX_dT1_max FPfl_TAUX_dT1_max FPfu_TAUX_dT1_max FPnd_TAUX_dT1_max FPsvr_TAUX_dT1_max FPsw_ext1_TAUX_dT1_max FPsw_TAUX_dT1_max /end REF_CHARACTERISTIC
/end GROUP
/begin GROUP TAUX_dT1_min_EC_Fault "AUX Temperature delta T 1 low"
 /begin REF_CHARACTERISTIC FCdc4_TAUX_dT1_min FCdtc_TAUX_dT1_min FCfmi_TAUX_dT1_min FCftb_TAUX_dT1_min FCspn_TAUX_dT1_min FPfl_TAUX_dT1_min FPfu_TAUX_dT1_min FPnd_TAUX_dT1_min FPsvr_TAUX_dT1_min FPsw_ext1_TAUX_dT1_min FPsw_TAUX_dT1_min /end REF_CHARACTERISTIC
/end GROUP
/begin GROUP TAUX_dT2_max_EC_Fault "AUX Temperature delta T 2 high"
 /begin REF_CHARACTERISTIC FCdc4_TAUX_dT2_max FCdtc_TAUX_dT2_max FCfmi_TAUX_dT2_max FCftb_TAUX_dT2_max FCspn_TAUX_dT2_max FPfl_TAUX_dT2_max FPfu_TAUX_dT2_max FPnd_TAUX_dT2_max FPsvr_TAUX_dT2_max FPsw_ext1_TAUX_dT2_max FPsw_TAUX_dT2_max /end REF_CHARACTERISTIC
/end GROUP
/begin GROUP TAUX_dT2_min_EC_Fault "AUX Temperature delta T 2 low"
 /begin REF_CHARACTERISTIC FCdc4_TAUX_dT2_min FCdtc_TAUX_dT2_min FCfmi_TAUX_dT2_min FCftb_TAUX_dT2_min FCspn_TAUX_dT2_min FPfl_TAUX_dT2_min FPfu_TAUX_dT2_min FPnd_TAUX_dT2_min FPsvr_TAUX_dT2_min FPsw_ext1_TAUX_dT2_min FPsw_TAUX_dT2_min /end REF_CHARACTERISTIC
/end GROUP
/begin GROUP Taux1_derate_actv_EC_Fault "Auxiliary temperature 1 derate active"
 /begin REF_CHARACTERISTIC FCdc4_Taux1_derate_actv FCdtc_Taux1_derate_actv FCfmi_Taux1_derate_actv FCftb_Taux1_derate_actv FCspn_Taux1_derate_actv FPfl_Taux1_derate_actv FPfu_Taux1_derate_actv FPnd_Taux1_derate_actv FPsvr_Taux1_derate_actv FPsw_ext1_Taux1_derate_actv FPsw_Taux1_derate_actv /end REF_CHARACTERISTIC
/end GROUP
/begin GROUP TAUX1_max_EC_Fault "Auxiliary temperature 1 high"
 /begin REF_CHARACTERISTIC FCdc4_TAUX1_max FCdtc_TAUX1_max FCfmi_TAUX1_max FCftb_TAUX1_max FCspn_TAUX1_max FPfl_TAUX1_max FPfu_TAUX1_max FPnd_TAUX1_max FPsvr_TAUX1_max FPsw_ext1_TAUX1_max FPsw_TAUX1_max /end REF_CHARACTERISTIC
/end GROUP
/begin GROUP TAUX1_min_EC_Fault "Auxiliary temperature 1 low"
 /begin REF_CHARACTERISTIC FCdc4_TAUX1_min FCdtc_TAUX1_min FCfmi_TAUX1_min FCftb_TAUX1_min FCspn_TAUX1_min FPfl_TAUX1_min FPfu_TAUX1_min FPnd_TAUX1_min FPsvr_TAUX1_min FPsw_ext1_TAUX1_min FPsw_TAUX1_min /end REF_CHARACTERISTIC
/end GROUP
/begin GROUP Taux2_derate_actv_EC_Fault "Auxiliary temperature 2 derate active"
 /begin REF_CHARACTERISTIC FCdc4_Taux2_derate_actv FCdtc_Taux2_derate_actv FCfmi_Taux2_derate_actv FCftb_Taux2_derate_actv FCspn_Taux2_derate_actv FPfl_Taux2_derate_actv FPfu_Taux2_derate_actv FPnd_Taux2_derate_actv FPsvr_Taux2_derate_actv FPsw_ext1_Taux2_derate_actv FPsw_Taux2_derate_actv /end REF_CHARACTERISTIC
/end GROUP
/begin GROUP TAUX2_max_EC_Fault "Auxiliary temperature 2 high"
 /begin REF_CHARACTERISTIC FCdc4_TAUX2_max FCdtc_TAUX2_max FCfmi_TAUX2_max FCftb_TAUX2_max FCspn_TAUX2_max FPfl_TAUX2_max FPfu_TAUX2_max FPnd_TAUX2_max FPsvr_TAUX2_max FPsw_ext1_TAUX2_max FPsw_TAUX2_max /end REF_CHARACTERISTIC
/end GROUP
/begin GROUP TAUX2_min_EC_Fault "Auxiliary temperature 2 low"
 /begin REF_CHARACTERISTIC FCdc4_TAUX2_min FCdtc_TAUX2_min FCfmi_TAUX2_min FCftb_TAUX2_min FCspn_TAUX2_min FPfl_TAUX2_min FPfu_TAUX2_min FPnd_TAUX2_min FPsvr_TAUX2_min FPsw_ext1_TAUX2_min FPsw_TAUX2_min /end REF_CHARACTERISTIC
/end GROUP
/begin GROUP TAUX3_max_EC_Fault "Auxiliary temperature 3 high"
 /begin REF_CHARACTERISTIC FCdc4_TAUX3_max FCdtc_TAUX3_max FCfmi_TAUX3_max FCftb_TAUX3_max FCspn_TAUX3_max FPfl_TAUX3_max FPfu_TAUX3_max FPnd_TAUX3_max FPsvr_TAUX3_max FPsw_ext1_TAUX3_max FPsw_TAUX3_max /end REF_CHARACTERISTIC
/end GROUP
/begin GROUP TAUX3_min_EC_Fault "Auxiliary temperature 3 low"
 /begin REF_CHARACTERISTIC FCdc4_TAUX3_min FCdtc_TAUX3_min FCfmi_TAUX3_min FCftb_TAUX3_min FCspn_TAUX3_min FPfl_TAUX3_min FPfu_TAUX3_min FPnd_TAUX3_min FPsvr_TAUX3_min FPsw_ext1_TAUX3_min FPsw_TAUX3_min /end REF_CHARACTERISTIC
/end GROUP
/begin GROUP TAUX4_max_EC_Fault "Auxiliary temperature 4 high"
 /begin REF_CHARACTERISTIC FCdc4_TAUX4_max FCdtc_TAUX4_max FCfmi_TAUX4_max FCftb_TAUX4_max FCspn_TAUX4_max FPfl_TAUX4_max FPfu_TAUX4_max FPnd_TAUX4_max FPsvr_TAUX4_max FPsw_ext1_TAUX4_max FPsw_TAUX4_max /end REF_CHARACTERISTIC
/end GROUP
/begin GROUP TAUX4_min_EC_Fault "Auxiliary temperature 4 low"
 /begin REF_CHARACTERISTIC FCdc4_TAUX4_min FCdtc_TAUX4_min FCfmi_TAUX4_min FCftb_TAUX4_min FCspn_TAUX4_min FPfl_TAUX4_min FPfu_TAUX4_min FPnd_TAUX4_min FPsvr_TAUX4_min FPsw_ext1_TAUX4_min FPsw_TAUX4_min /end REF_CHARACTERISTIC
/end GROUP
/begin GROUP TEL_derate_actv_EC_Fault "Telematics derate active"
 /begin REF_CHARACTERISTIC FCdc4_TEL_derate_actv FCdtc_TEL_derate_actv FCfmi_TEL_derate_actv FCftb_TEL_derate_actv FCspn_TEL_derate_actv FPfl_TEL_derate_actv FPfu_TEL_derate_actv FPnd_TEL_derate_actv FPsvr_TEL_derate_actv FPsw_ext1_TEL_derate_actv FPsw_TEL_derate_actv /end REF_CHARACTERISTIC
/end GROUP
/begin GROUP TEL_dis_EC_Fault "Telematics unit disconnected"
 /begin REF_CHARACTERISTIC FCdc4_TEL_dis FCdtc_TEL_dis FCfmi_TEL_dis FCftb_TEL_dis FCspn_TEL_dis FPfl_TEL_dis FPfu_TEL_dis FPnd_TEL_dis FPsvr_TEL_dis FPsw_ext1_TEL_dis FPsw_TEL_dis /end REF_CHARACTERISTIC
/end GROUP
/begin GROUP TEL_intF_EC_Fault "Telematics unit internal fault"
 /begin REF_CHARACTERISTIC FCdc4_TEL_intF FCdtc_TEL_intF FCfmi_TEL_intF FCftb_TEL_intF FCspn_TEL_intF FPfl_TEL_intF FPfu_TEL_intF FPnd_TEL_intF FPsvr_TEL_intF FPsw_ext1_TEL_intF FPsw_TEL_intF /end REF_CHARACTERISTIC
/end GROUP
/begin GROUP TEL_key_invalid_EC_Fault "Telematics invalid key"
 /begin REF_CHARACTERISTIC FCdc4_TEL_key_invalid FCdtc_TEL_key_invalid FCfmi_TEL_key_invalid FCftb_TEL_key_invalid FCspn_TEL_key_invalid FPfl_TEL_key_invalid FPfu_TEL_key_invalid FPnd_TEL_key_invalid FPsvr_TEL_key_invalid FPsw_ext1_TEL_key_invalid FPsw_TEL_key_invalid /end REF_CHARACTERISTIC
/end GROUP
/begin GROUP TEL_key_to_EC_Fault "Telematics timeout waiting for key"
 /begin REF_CHARACTERISTIC FCdc4_TEL_key_to FCdtc_TEL_key_to FCfmi_TEL_key_to FCftb_TEL_key_to FCspn_TEL_key_to FPfl_TEL_key_to FPfu_TEL_key_to FPnd_TEL_key_to FPsvr_TEL_key_to FPsw_ext1_TEL_key_to FPsw_TEL_key_to /end REF_CHARACTERISTIC
/end GROUP
/begin GROUP TEL_req_to_EC_Fault "Telematics timeout waiting for request"
 /begin REF_CHARACTERISTIC FCdc4_TEL_req_to FCdtc_TEL_req_to FCfmi_TEL_req_to FCftb_TEL_req_to FCspn_TEL_req_to FPfl_TEL_req_to FPfu_TEL_req_to FPnd_TEL_req_to FPsvr_TEL_req_to FPsw_ext1_TEL_req_to FPsw_TEL_req_to /end REF_CHARACTERISTIC
/end GROUP
/begin GROUP TEL_RPM_cmd_EC_Fault "Telematics commanded RPM limit"
 /begin REF_CHARACTERISTIC FCdc4_TEL_RPM_cmd FCdtc_TEL_RPM_cmd FCfmi_TEL_RPM_cmd FCftb_TEL_RPM_cmd FCspn_TEL_RPM_cmd FPfl_TEL_RPM_cmd FPfu_TEL_RPM_cmd FPnd_TEL_RPM_cmd FPsvr_TEL_RPM_cmd FPsw_ext1_TEL_RPM_cmd FPsw_TEL_RPM_cmd /end REF_CHARACTERISTIC
/end GROUP
/begin GROUP TEL_RPM_psv_EC_Fault "Telematics passive RPM limit"
 /begin REF_CHARACTERISTIC FCdc4_TEL_RPM_psv FCdtc_TEL_RPM_psv FCfmi_TEL_RPM_psv FCftb_TEL_RPM_psv FCspn_TEL_RPM_psv FPfl_TEL_RPM_psv FPfu_TEL_RPM_psv FPnd_TEL_RPM_psv FPsvr_TEL_RPM_psv FPsw_ext1_TEL_RPM_psv FPsw_TEL_RPM_psv /end REF_CHARACTERISTIC
/end GROUP
/begin GROUP TEL_shutdown_cmd_EC_Fault "Telematics commanded engine shut-down"
 /begin REF_CHARACTERISTIC FCdc4_TEL_shutdown_cmd FCdtc_TEL_shutdown_cmd FCfmi_TEL_shutdown_cmd FCftb_TEL_shutdown_cmd FCspn_TEL_shutdown_cmd FPfl_TEL_shutdown_cmd FPfu_TEL_shutdown_cmd FPnd_TEL_shutdown_cmd FPsvr_TEL_shutdown_cmd FPsw_ext1_TEL_shutdown_cmd FPsw_TEL_shutdown_cmd /end REF_CHARACTERISTIC
/end GROUP
/begin GROUP TEL_shutdown_psv_EC_Fault "Telematics passive shut-down"
 /begin REF_CHARACTERISTIC FCdc4_TEL_shutdown_psv FCdtc_TEL_shutdown_psv FCfmi_TEL_shutdown_psv FCftb_TEL_shutdown_psv FCspn_TEL_shutdown_psv FPfl_TEL_shutdown_psv FPfu_TEL_shutdown_psv FPnd_TEL_shutdown_psv FPsvr_TEL_shutdown_psv FPsw_ext1_TEL_shutdown_psv FPsw_TEL_shutdown_psv /end REF_CHARACTERISTIC
/end GROUP
/begin GROUP TEL_torq_cmd_EC_Fault "Telematics commanded torque limit"
 /begin REF_CHARACTERISTIC FCdc4_TEL_torq_cmd FCdtc_TEL_torq_cmd FCfmi_TEL_torq_cmd FCftb_TEL_torq_cmd FCspn_TEL_torq_cmd FPfl_TEL_torq_cmd FPfu_TEL_torq_cmd FPnd_TEL_torq_cmd FPsvr_TEL_torq_cmd FPsw_ext1_TEL_torq_cmd FPsw_TEL_torq_cmd /end REF_CHARACTERISTIC
/end GROUP
/begin GROUP TEL_torq_psv_EC_Fault "Telematics passive torque limit"
 /begin REF_CHARACTERISTIC FCdc4_TEL_torq_psv FCdtc_TEL_torq_psv FCfmi_TEL_torq_psv FCftb_TEL_torq_psv FCspn_TEL_torq_psv FPfl_TEL_torq_psv FPfu_TEL_torq_psv FPnd_TEL_torq_psv FPsvr_TEL_torq_psv FPsw_ext1_TEL_torq_psv FPsw_TEL_torq_psv /end REF_CHARACTERISTIC
/end GROUP
/begin GROUP TIP_act_EC_Fault "TIP/TOP active"
 /begin REF_CHARACTERISTIC FCdc4_TIP_act FCdtc_TIP_act FCfmi_TIP_act FCftb_TIP_act FCspn_TIP_act FPfl_TIP_act FPfu_TIP_act FPnd_TIP_act FPsvr_TIP_act FPsw_ext1_TIP_act FPsw_TIP_act /end REF_CHARACTERISTIC
/end GROUP
/begin GROUP TIP_maxv_EC_Fault "TIP/TOP high voltage"
 /begin REF_CHARACTERISTIC FCdc4_TIP_maxv FCdtc_TIP_maxv FCfmi_TIP_maxv FCftb_TIP_maxv FCspn_TIP_maxv FPfl_TIP_maxv FPfu_TIP_maxv FPnd_TIP_maxv FPsvr_TIP_maxv FPsw_ext1_TIP_maxv FPsw_TIP_maxv /end REF_CHARACTERISTIC
/end GROUP
/begin GROUP TIP_minv_EC_Fault "TIP/TOP low voltage"
 /begin REF_CHARACTERISTIC FCdc4_TIP_minv FCdtc_TIP_minv FCfmi_TIP_minv FCftb_TIP_minv FCspn_TIP_minv FPfl_TIP_minv FPfu_TIP_minv FPnd_TIP_minv FPsvr_TIP_minv FPsw_ext1_TIP_minv FPsw_TIP_minv /end REF_CHARACTERISTIC
/end GROUP
/begin GROUP TPS1_max_EC_Fault "TPS1 high voltage"
 /begin REF_CHARACTERISTIC FCdc4_TPS1_max FCdtc_TPS1_max FCfmi_TPS1_max FCftb_TPS1_max FCspn_TPS1_max FPfl_TPS1_max FPfu_TPS1_max FPnd_TPS1_max FPsvr_TPS1_max FPsw_ext1_TPS1_max FPsw_TPS1_max /end REF_CHARACTERISTIC
/end GROUP
/begin GROUP TPS1_min_EC_Fault "TPS1 low voltage"
 /begin REF_CHARACTERISTIC FCdc4_TPS1_min FCdtc_TPS1_min FCfmi_TPS1_min FCftb_TPS1_min FCspn_TPS1_min FPfl_TPS1_min FPfu_TPS1_min FPnd_TPS1_min FPsvr_TPS1_min FPsw_ext1_TPS1_min FPsw_TPS1_min /end REF_CHARACTERISTIC
/end GROUP
/begin GROUP TPS12_OOR_EC_Fault "TPS1/2 simultaneous voltages"
 /begin REF_CHARACTERISTIC FCdc4_TPS12_OOR FCdtc_TPS12_OOR FCfmi_TPS12_OOR FCftb_TPS12_OOR FCspn_TPS12_OOR FPfl_TPS12_OOR FPfu_TPS12_OOR FPnd_TPS12_OOR FPsvr_TPS12_OOR FPsw_ext1_TPS12_OOR FPsw_TPS12_OOR /end REF_CHARACTERISTIC
/end GROUP
/begin GROUP TPS12pct_hi_EC_Fault "TPS1 higher than TPS2"
 /begin REF_CHARACTERISTIC FCdc4_TPS12pct_hi FCdtc_TPS12pct_hi FCfmi_TPS12pct_hi FCftb_TPS12pct_hi FCspn_TPS12pct_hi FPfl_TPS12pct_hi FPfu_TPS12pct_hi FPnd_TPS12pct_hi FPsvr_TPS12pct_hi FPsw_ext1_TPS12pct_hi FPsw_TPS12pct_hi /end REF_CHARACTERISTIC
/end GROUP
/begin GROUP TPS12pct_lo_EC_Fault "TPS1 lower than TPS2"
 /begin REF_CHARACTERISTIC FCdc4_TPS12pct_lo FCdtc_TPS12pct_lo FCfmi_TPS12pct_lo FCftb_TPS12pct_lo FCspn_TPS12pct_lo FPfl_TPS12pct_lo FPfu_TPS12pct_lo FPnd_TPS12pct_lo FPsvr_TPS12pct_lo FPsw_ext1_TPS12pct_lo FPsw_TPS12pct_lo /end REF_CHARACTERISTIC
/end GROUP
/begin GROUP TPS2_max_EC_Fault "TPS2 high voltage"
 /begin REF_CHARACTERISTIC FCdc4_TPS2_max FCdtc_TPS2_max FCfmi_TPS2_max FCftb_TPS2_max FCspn_TPS2_max FPfl_TPS2_max FPfu_TPS2_max FPnd_TPS2_max FPsvr_TPS2_max FPsw_ext1_TPS2_max FPsw_TPS2_max /end REF_CHARACTERISTIC
/end GROUP
/begin GROUP TPS2_min_EC_Fault "TPS2 low voltage"
 /begin REF_CHARACTERISTIC FCdc4_TPS2_min FCdtc_TPS2_min FCfmi_TPS2_min FCftb_TPS2_min FCspn_TPS2_min FPfl_TPS2_min FPfu_TPS2_min FPnd_TPS2_min FPsvr_TPS2_min FPsw_ext1_TPS2_min FPsw_TPS2_min /end REF_CHARACTERISTIC
/end GROUP
/begin GROUP TPSerr_neg_EC_Fault "Unable to reach lower TPS"
 /begin REF_CHARACTERISTIC FCdc4_TPSerr_neg FCdtc_TPSerr_neg FCfmi_TPSerr_neg FCftb_TPSerr_neg FCspn_TPSerr_neg FPfl_TPSerr_neg FPfu_TPSerr_neg FPnd_TPSerr_neg FPsvr_TPSerr_neg FPsw_ext1_TPSerr_neg FPsw_TPSerr_neg /end REF_CHARACTERISTIC
/end GROUP
/begin GROUP TPSerr_pos_EC_Fault "Unable to reach higher TPS"
 /begin REF_CHARACTERISTIC FCdc4_TPSerr_pos FCdtc_TPSerr_pos FCfmi_TPSerr_pos FCftb_TPSerr_pos FCspn_TPSerr_pos FPfl_TPSerr_pos FPfu_TPSerr_pos FPnd_TPSerr_pos FPsvr_TPSerr_pos FPsw_ext1_TPSerr_pos FPsw_TPSerr_pos /end REF_CHARACTERISTIC
/end GROUP
/begin GROUP TRANS_comm_EC_Fault "Transmission communication lost"
 /begin REF_CHARACTERISTIC FCdc4_TRANS_comm FCdtc_TRANS_comm FCfmi_TRANS_comm FCftb_TRANS_comm FCspn_TRANS_comm FPfl_TRANS_comm FPfu_TRANS_comm FPnd_TRANS_comm FPsvr_TRANS_comm FPsw_ext1_TRANS_comm FPsw_TRANS_comm /end REF_CHARACTERISTIC
/end GROUP
/begin GROUP TRANS_fuel_inh_EC_Fault "Transmission inhibiting fueling"
 /begin REF_CHARACTERISTIC FCdc4_TRANS_fuel_inh FCdtc_TRANS_fuel_inh FCfmi_TRANS_fuel_inh FCftb_TRANS_fuel_inh FCspn_TRANS_fuel_inh FPfl_TRANS_fuel_inh FPfu_TRANS_fuel_inh FPnd_TRANS_fuel_inh FPsvr_TRANS_fuel_inh FPsw_ext1_TRANS_fuel_inh FPsw_TRANS_fuel_inh /end REF_CHARACTERISTIC
/end GROUP
/begin GROUP TWCDiag_OSC_lo_EC_Fault "TWC oxygen storage monitor"
 /begin REF_CHARACTERISTIC FCdc4_TWCDiag_OSC_lo FCdtc_TWCDiag_OSC_lo FCfmi_TWCDiag_OSC_lo FCftb_TWCDiag_OSC_lo FCspn_TWCDiag_OSC_lo FPfl_TWCDiag_OSC_lo FPfu_TWCDiag_OSC_lo FPnd_TWCDiag_OSC_lo FPsvr_TWCDiag_OSC_lo FPsw_ext1_TWCDiag_OSC_lo FPsw_TWCDiag_OSC_lo /end REF_CHARACTERISTIC
/end GROUP
/begin GROUP UEGOH1_off_open_EC_Fault "UEGO1 heater open / ground short"
 /begin REF_CHARACTERISTIC FCdc4_UEGOH1_off_open FCdtc_UEGOH1_off_open FCfmi_UEGOH1_off_open FCftb_UEGOH1_off_open FCspn_UEGOH1_off_open FPfl_UEGOH1_off_open FPfu_UEGOH1_off_open FPnd_UEGOH1_off_open FPsvr_UEGOH1_off_open FPsw_ext1_UEGOH1_off_open FPsw_UEGOH1_off_open /end REF_CHARACTERISTIC
/end GROUP
/begin GROUP UEGOH1_on_short_EC_Fault "UEGO1 heater short to power"
 /begin REF_CHARACTERISTIC FCdc4_UEGOH1_on_short FCdtc_UEGOH1_on_short FCfmi_UEGOH1_on_short FCftb_UEGOH1_on_short FCspn_UEGOH1_on_short FPfl_UEGOH1_on_short FPfu_UEGOH1_on_short FPnd_UEGOH1_on_short FPsvr_UEGOH1_on_short FPsw_ext1_UEGOH1_on_short FPsw_UEGOH1_on_short /end REF_CHARACTERISTIC
/end GROUP
/begin GROUP UEGOH2_off_open_EC_Fault "UEGO2 heater open / ground short"
 /begin REF_CHARACTERISTIC FCdc4_UEGOH2_off_open FCdtc_UEGOH2_off_open FCfmi_UEGOH2_off_open FCftb_UEGOH2_off_open FCspn_UEGOH2_off_open FPfl_UEGOH2_off_open FPfu_UEGOH2_off_open FPnd_UEGOH2_off_open FPsvr_UEGOH2_off_open FPsw_ext1_UEGOH2_off_open FPsw_UEGOH2_off_open /end REF_CHARACTERISTIC
/end GROUP
/begin GROUP UEGOH2_on_short_EC_Fault "UEGO2 heater short to power"
 /begin REF_CHARACTERISTIC FCdc4_UEGOH2_on_short FCdtc_UEGOH2_on_short FCfmi_UEGOH2_on_short FCftb_UEGOH2_on_short FCspn_UEGOH2_on_short FPfl_UEGOH2_on_short FPfu_UEGOH2_on_short FPnd_UEGOH2_on_short FPsvr_UEGOH2_on_short FPsw_ext1_UEGOH2_on_short FPsw_UEGOH2_on_short /end REF_CHARACTERISTIC
/end GROUP
/begin GROUP UEGOH3_off_open_EC_Fault "UEGO3 heater open / ground short"
 /begin REF_CHARACTERISTIC FCdc4_UEGOH3_off_open FCdtc_UEGOH3_off_open FCfmi_UEGOH3_off_open FCftb_UEGOH3_off_open FCspn_UEGOH3_off_open FPfl_UEGOH3_off_open FPfu_UEGOH3_off_open FPnd_UEGOH3_off_open FPsvr_UEGOH3_off_open FPsw_ext1_UEGOH3_off_open FPsw_UEGOH3_off_open /end REF_CHARACTERISTIC
/end GROUP
/begin GROUP UEGOH3_on_short_EC_Fault "UEGO3 heater short to power"
 /begin REF_CHARACTERISTIC FCdc4_UEGOH3_on_short FCdtc_UEGOH3_on_short FCfmi_UEGOH3_on_short FCftb_UEGOH3_on_short FCspn_UEGOH3_on_short FPfl_UEGOH3_on_short FPfu_UEGOH3_on_short FPnd_UEGOH3_on_short FPsvr_UEGOH3_on_short FPsw_ext1_UEGOH3_on_short FPsw_UEGOH3_on_short /end REF_CHARACTERISTIC
/end GROUP
/begin GROUP UEGOH4_off_open_EC_Fault "UEGO4 heater open / ground short"
 /begin REF_CHARACTERISTIC FCdc4_UEGOH4_off_open FCdtc_UEGOH4_off_open FCfmi_UEGOH4_off_open FCftb_UEGOH4_off_open FCspn_UEGOH4_off_open FPfl_UEGOH4_off_open FPfu_UEGOH4_off_open FPnd_UEGOH4_off_open FPsvr_UEGOH4_off_open FPsw_ext1_UEGOH4_off_open FPsw_UEGOH4_off_open /end REF_CHARACTERISTIC
/end GROUP
/begin GROUP UEGOH4_on_short_EC_Fault "UEGO4 heater short to power"
 /begin REF_CHARACTERISTIC FCdc4_UEGOH4_on_short FCdtc_UEGOH4_on_short FCfmi_UEGOH4_on_short FCftb_UEGOH4_on_short FCspn_UEGOH4_on_short FPfl_UEGOH4_on_short FPfu_UEGOH4_on_short FPnd_UEGOH4_on_short FPsvr_UEGOH4_on_short FPsw_ext1_UEGOH4_on_short FPsw_UEGOH4_on_short /end REF_CHARACTERISTIC
/end GROUP
/begin GROUP UGF_Hv_hi_EC_Fault "UEGO1 heater supply high voltage"
 /begin REF_CHARACTERISTIC FCdc4_UGF_Hv_hi FCdtc_UGF_Hv_hi FCfmi_UGF_Hv_hi FCftb_UGF_Hv_hi FCspn_UGF_Hv_hi FPfl_UGF_Hv_hi FPfu_UGF_Hv_hi FPnd_UGF_Hv_hi FPsvr_UGF_Hv_hi FPsw_ext1_UGF_Hv_hi FPsw_UGF_Hv_hi /end REF_CHARACTERISTIC
/end GROUP
/begin GROUP UGF_internal_EC_Fault "UEGO1 internal processor fault"
 /begin REF_CHARACTERISTIC FCdc4_UGF_internal FCdtc_UGF_internal FCfmi_UGF_internal FCftb_UGF_internal FCspn_UGF_internal FPfl_UGF_internal FPfu_UGF_internal FPnd_UGF_internal FPsvr_UGF_internal FPsw_ext1_UGF_internal FPsw_UGF_internal /end REF_CHARACTERISTIC
/end GROUP
/begin GROUP UGF_lowsupply_EC_Fault "UEGO1 internal supply voltage low"
 /begin REF_CHARACTERISTIC FCdc4_UGF_lowsupply FCdtc_UGF_lowsupply FCfmi_UGF_lowsupply FCftb_UGF_lowsupply FCspn_UGF_lowsupply FPfl_UGF_lowsupply FPfu_UGF_lowsupply FPnd_UGF_lowsupply FPsvr_UGF_lowsupply FPsw_ext1_UGF_lowsupply FPsw_UGF_lowsupply /end REF_CHARACTERISTIC
/end GROUP
/begin GROUP UGF1_comm_lost_EC_Fault "UEGO1 CAN sensor communication lost"
 /begin REF_CHARACTERISTIC FCdc4_UGF1_comm_lost FCdtc_UGF1_comm_lost FCfmi_UGF1_comm_lost FCftb_UGF1_comm_lost FCspn_UGF1_comm_lost FPfl_UGF1_comm_lost FPfu_UGF1_comm_lost FPnd_UGF1_comm_lost FPsvr_UGF1_comm_lost FPsw_ext1_UGF1_comm_lost FPsw_UGF1_comm_lost /end REF_CHARACTERISTIC
/end GROUP
/begin GROUP UGF1_drifttl2_EC_Fault "UEGO1 drift is out-of-tolerance - level 2"
 /begin REF_CHARACTERISTIC FCdc4_UGF1_drifttl2 FCdtc_UGF1_drifttl2 FCfmi_UGF1_drifttl2 FCftb_UGF1_drifttl2 FCspn_UGF1_drifttl2 FPfl_UGF1_drifttl2 FPfu_UGF1_drifttl2 FPnd_UGF1_drifttl2 FPsvr_UGF1_drifttl2 FPsw_ext1_UGF1_drifttl2 FPsw_UGF1_drifttl2 /end REF_CHARACTERISTIC
/end GROUP
/begin GROUP UGF1_drifttol_EC_Fault "UEGO1 drift is out-of-tolerance"
 /begin REF_CHARACTERISTIC FCdc4_UGF1_drifttol FCdtc_UGF1_drifttol FCfmi_UGF1_drifttol FCftb_UGF1_drifttol FCspn_UGF1_drifttol FPfl_UGF1_drifttol FPfu_UGF1_drifttol FPnd_UGF1_drifttol FPsvr_UGF1_drifttol FPsw_ext1_UGF1_drifttol FPsw_UGF1_drifttol /end REF_CHARACTERISTIC
/end GROUP
/begin GROUP UGF1_R_hi_EC_Fault "UEGO1 cal resistor voltage high"
 /begin REF_CHARACTERISTIC FCdc4_UGF1_R_hi FCdtc_UGF1_R_hi FCfmi_UGF1_R_hi FCftb_UGF1_R_hi FCspn_UGF1_R_hi FPfl_UGF1_R_hi FPfu_UGF1_R_hi FPnd_UGF1_R_hi FPsvr_UGF1_R_hi FPsw_ext1_UGF1_R_hi FPsw_UGF1_R_hi /end REF_CHARACTERISTIC
/end GROUP
/begin GROUP UGF1_SR_hi_EC_Fault "UEGO1 sense cell impedance high"
 /begin REF_CHARACTERISTIC FCdc4_UGF1_SR_hi FCdtc_UGF1_SR_hi FCfmi_UGF1_SR_hi FCftb_UGF1_SR_hi FCspn_UGF1_SR_hi FPfl_UGF1_SR_hi FPfu_UGF1_SR_hi FPnd_UGF1_SR_hi FPsvr_UGF1_SR_hi FPsw_ext1_UGF1_SR_hi FPsw_UGF1_SR_hi /end REF_CHARACTERISTIC
/end GROUP
/begin GROUP UGF1_SR_slow_EC_Fault "UEGO1 sense cell slow to warm up"
 /begin REF_CHARACTERISTIC FCdc4_UGF1_SR_slow FCdtc_UGF1_SR_slow FCfmi_UGF1_SR_slow FCftb_UGF1_SR_slow FCspn_UGF1_SR_slow FPfl_UGF1_SR_slow FPfu_UGF1_SR_slow FPnd_UGF1_SR_slow FPsvr_UGF1_SR_slow FPsw_ext1_UGF1_SR_slow FPsw_UGF1_SR_slow /end REF_CHARACTERISTIC
/end GROUP
/begin GROUP UGF1_Sv_hi_EC_Fault "UEGO1 sense cell voltage high"
 /begin REF_CHARACTERISTIC FCdc4_UGF1_Sv_hi FCdtc_UGF1_Sv_hi FCfmi_UGF1_Sv_hi FCftb_UGF1_Sv_hi FCspn_UGF1_Sv_hi FPfl_UGF1_Sv_hi FPfu_UGF1_Sv_hi FPnd_UGF1_Sv_hi FPsvr_UGF1_Sv_hi FPsw_ext1_UGF1_Sv_hi FPsw_UGF1_Sv_hi /end REF_CHARACTERISTIC
/end GROUP
/begin GROUP UGF2_comm_lost_EC_Fault "UEGO2 CAN sensor communication lost"
 /begin REF_CHARACTERISTIC FCdc4_UGF2_comm_lost FCdtc_UGF2_comm_lost FCfmi_UGF2_comm_lost FCftb_UGF2_comm_lost FCspn_UGF2_comm_lost FPfl_UGF2_comm_lost FPfu_UGF2_comm_lost FPnd_UGF2_comm_lost FPsvr_UGF2_comm_lost FPsw_ext1_UGF2_comm_lost FPsw_UGF2_comm_lost /end REF_CHARACTERISTIC
/end GROUP
/begin GROUP UGF2_drifttl2_EC_Fault "UEGO2 drift is out-of-tolerance - level 2"
 /begin REF_CHARACTERISTIC FCdc4_UGF2_drifttl2 FCdtc_UGF2_drifttl2 FCfmi_UGF2_drifttl2 FCftb_UGF2_drifttl2 FCspn_UGF2_drifttl2 FPfl_UGF2_drifttl2 FPfu_UGF2_drifttl2 FPnd_UGF2_drifttl2 FPsvr_UGF2_drifttl2 FPsw_ext1_UGF2_drifttl2 FPsw_UGF2_drifttl2 /end REF_CHARACTERISTIC
/end GROUP
/end MODULE
/end PROJECT
