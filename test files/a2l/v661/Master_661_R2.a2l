ASAP2_VERSION 1 61
/begin PROJECT Econtrols_4G "4G Test"
/begin HEADER "4G A2L Configuration" PROJECT_NO EControls4G /* config for version control */ VERSION "$Revision: 82130 $:" /* config for version control */ /end HEADER
/begin MODULE EControls_4G_SH2A "EControls 4G"
/begin MOD_COMMON "" DEPOSIT ABSOLUTE BYTE_ORDER MSB_FIRST /end MOD_COMMON
/* Define the Record Layouts */
/begin RECORD_LAYOUT ECIPP_ALIGNMENT_UBYTE FNC_VALUES 1 UBYTE COLUMN_DIR DIRECT /end RECORD_LAYOUT
/begin RECORD_LAYOUT ECIPP_ALIGNMENT_UWORD FNC_VALUES 1 UWORD COLUMN_DIR DIRECT /end RECORD_LAYOUT
/begin RECORD_LAYOUT ECIPP_ALIGNMENT_ULONG FNC_VALUES 1 ULONG COLUMN_DIR DIRECT /end RECORD_LAYOUT
/begin RECORD_LAYOUT ECIPP_ALIGNMENT_FLOAT32_IEEE FNC_VALUES 1 FLOAT32_IEEE COLUMN_DIR DIRECT /end RECORD_LAYOUT
/begin COMPU_METHOD Compu_IDENTITY "Discrete Values " /* Identifier */ IDENTICAL "%.0" /* Format */ "-" /* Units */ /end COMPU_METHOD
/begin CHARACTERISTIC FCdc4_CL_phi_hi "FCtl_DTC_0x04(677)" VALUE 0x001E45E0 /* @ECU_Address@FCtl_DTC_0x04@0x024C454A@ */ ECIPP_ALIGNMENT_UWORD 65535 Compu_IDENTITY 0 65535 PHYS_UNIT "System ID + DTC" /end CHARACTERISTIC
/begin CHARACTERISTIC FCdc4_CL_phi_lo "FCtl_DTC_0x04(678)" VALUE 0x001E45E2 /* @ECU_Address@FCtl_DTC_0x04@0x024C454C@ */ ECIPP_ALIGNMENT_UWORD 65535 Compu_IDENTITY 0 65535 PHYS_UNIT "System ID + DTC" /end CHARACTERISTIC
/begin CHARACTERISTIC FCdc4_CLLP_hi "FCtl_DTC_0x04(36)" VALUE 0x001E40DE /* @ECU_Address@FCtl_DTC_0x04@0x024C4048@ */ ECIPP_ALIGNMENT_UWORD 65535 Compu_IDENTITY 0 65535 PHYS_UNIT "System ID + DTC" /end CHARACTERISTIC
/begin CHARACTERISTIC FCdc4_CLLP_lo "FCtl_DTC_0x04(37)" VALUE 0x001E40E0 /* @ECU_Address@FCtl_DTC_0x04@0x024C404A@ */ ECIPP_ALIGNMENT_UWORD 65535 Compu_IDENTITY 0 65535 PHYS_UNIT "System ID + DTC" /end CHARACTERISTIC
/begin CHARACTERISTIC FCdc4_CLNG_hi "FCtl_DTC_0x04(38)" VALUE 0x001E40E2 /* @ECU_Address@FCtl_DTC_0x04@0x024C404C@ */ ECIPP_ALIGNMENT_UWORD 65535 Compu_IDENTITY 0 65535 PHYS_UNIT "System ID + DTC" /end CHARACTERISTIC
/begin CHARACTERISTIC FCdc4_CLNG_lo "FCtl_DTC_0x04(39)" VALUE 0x001E40E4 /* @ECU_Address@FCtl_DTC_0x04@0x024C404E@ */ ECIPP_ALIGNMENT_UWORD 65535 Compu_IDENTITY 0 65535 PHYS_UNIT "System ID + DTC" /end CHARACTERISTIC
/begin CHARACTERISTIC FCdc4_CM_unresp "FCtl_DTC_0x04(799)" VALUE 0x001E46D4 /* @ECU_Address@FCtl_DTC_0x04@0x024C463E@ */ ECIPP_ALIGNMENT_UWORD 65535 Compu_IDENTITY 0 65535 PHYS_UNIT "System ID + DTC" /end CHARACTERISTIC
/begin CHARACTERISTIC FCdc4_CMgsln_inact "FCtl_DTC_0x04(130)" VALUE 0x001E419A /* @ECU_Address@FCtl_DTC_0x04@0x024C4104@ */ ECIPP_ALIGNMENT_UWORD 65535 Compu_IDENTITY 0 65535 PHYS_UNIT "System ID + DTC" /end CHARACTERISTIC
/begin CHARACTERISTIC FCdc4_CMLP_inact "FCtl_DTC_0x04(131)" VALUE 0x001E419C /* @ECU_Address@FCtl_DTC_0x04@0x024C4106@ */ ECIPP_ALIGNMENT_UWORD 65535 Compu_IDENTITY 0 65535 PHYS_UNIT "System ID + DTC" /end CHARACTERISTIC
/begin CHARACTERISTIC FCdc4_CMNG_inact "FCtl_DTC_0x04(132)" VALUE 0x001E419E /* @ECU_Address@FCtl_DTC_0x04@0x024C4108@ */ ECIPP_ALIGNMENT_UWORD 65535 Compu_IDENTITY 0 65535 PHYS_UNIT "System ID + DTC" /end CHARACTERISTIC
/begin CHARACTERISTIC FCdc4_COPfail "FCtl_DTC_0x04(99)" VALUE 0x001E415C /* @ECU_Address@FCtl_DTC_0x04@0x024C40C6@ */ ECIPP_ALIGNMENT_UWORD 65535 Compu_IDENTITY 0 65535 PHYS_UNIT "System ID + DTC" /end CHARACTERISTIC
/begin CHARACTERISTIC FCdc4_COT_hi "FCtl_DTC_0x04(657)" VALUE 0x001E45B8 /* @ECU_Address@FCtl_DTC_0x04@0x024C4522@ */ ECIPP_ALIGNMENT_UWORD 65535 Compu_IDENTITY 0 65535 PHYS_UNIT "System ID + DTC" /end CHARACTERISTIC
/begin CHARACTERISTIC FCdc4_crkloss "FCtl_DTC_0x04(152)" VALUE 0x001E41C6 /* @ECU_Address@FCtl_DTC_0x04@0x024C4130@ */ ECIPP_ALIGNMENT_UWORD 65535 Compu_IDENTITY 0 65535 PHYS_UNIT "System ID + DTC" /end CHARACTERISTIC
/begin CHARACTERISTIC FCdc4_crknever "FCtl_DTC_0x04(98)" VALUE 0x001E415A /* @ECU_Address@FCtl_DTC_0x04@0x024C40C4@ */ ECIPP_ALIGNMENT_UWORD 65535 Compu_IDENTITY 0 65535 PHYS_UNIT "System ID + DTC" /end CHARACTERISTIC
/begin CHARACTERISTIC FCdc4_crknoise "FCtl_DTC_0x04(97)" VALUE 0x001E4158 /* @ECU_Address@FCtl_DTC_0x04@0x024C40C2@ */ ECIPP_ALIGNMENT_UWORD 65535 Compu_IDENTITY 0 65535 PHYS_UNIT "System ID + DTC" /end CHARACTERISTIC
/begin CHARACTERISTIC FCdc4_CVCS_discon "FCtl_DTC_0x04(747)" VALUE 0x001E466C /* @ECU_Address@FCtl_DTC_0x04@0x024C45D6@ */ ECIPP_ALIGNMENT_UWORD 65535 Compu_IDENTITY 0 65535 PHYS_UNIT "System ID + DTC" /end CHARACTERISTIC
/begin CHARACTERISTIC FCdc4_CVDS_discon "FCtl_DTC_0x04(748)" VALUE 0x001E466E /* @ECU_Address@FCtl_DTC_0x04@0x024C45D8@ */ ECIPP_ALIGNMENT_UWORD 65535 Compu_IDENTITY 0 65535 PHYS_UNIT "System ID + DTC" /end CHARACTERISTIC
/begin CHARACTERISTIC FCdc4_CVP1_hi "FCtl_DTC_0x04(794)" VALUE 0x001E46CA /* @ECU_Address@FCtl_DTC_0x04@0x024C4634@ */ ECIPP_ALIGNMENT_UWORD 65535 Compu_IDENTITY 0 65535 PHYS_UNIT "System ID + DTC" /end CHARACTERISTIC
/begin CHARACTERISTIC FCdc4_CVP1_lo "FCtl_DTC_0x04(795)" VALUE 0x001E46CC /* @ECU_Address@FCtl_DTC_0x04@0x024C4636@ */ ECIPP_ALIGNMENT_UWORD 65535 Compu_IDENTITY 0 65535 PHYS_UNIT "System ID + DTC" /end CHARACTERISTIC
/begin CHARACTERISTIC FCdc4_CVP2_hi "FCtl_DTC_0x04(796)" VALUE 0x001E46CE /* @ECU_Address@FCtl_DTC_0x04@0x024C4638@ */ ECIPP_ALIGNMENT_UWORD 65535 Compu_IDENTITY 0 65535 PHYS_UNIT "System ID + DTC" /end CHARACTERISTIC
/begin CHARACTERISTIC FCdc4_CVP2_lo "FCtl_DTC_0x04(797)" VALUE 0x001E46D0 /* @ECU_Address@FCtl_DTC_0x04@0x024C463A@ */ ECIPP_ALIGNMENT_UWORD 65535 Compu_IDENTITY 0 65535 PHYS_UNIT "System ID + DTC" /end CHARACTERISTIC
/begin CHARACTERISTIC FCdc4_DBW_I_max "FCtl_DTC_0x04(527)" VALUE 0x001E44B4 /* @ECU_Address@FCtl_DTC_0x04@0x024C441E@ */ ECIPP_ALIGNMENT_UWORD 65535 Compu_IDENTITY 0 65535 PHYS_UNIT "System ID + DTC" /end CHARACTERISTIC
/begin CHARACTERISTIC FCdc4_ECam_maxerr "FCtl_DTC_0x04(289)" VALUE 0x001E42D8 /* @ECU_Address@FCtl_DTC_0x04@0x024C4242@ */ ECIPP_ALIGNMENT_UWORD 65535 Compu_IDENTITY 0 65535 PHYS_UNIT "System ID + DTC" /end CHARACTERISTIC
/begin CHARACTERISTIC FCdc4_ECL_low "FCtl_DTC_0x04(733)" VALUE 0x001E4650 /* @ECU_Address@FCtl_DTC_0x04@0x024C45BA@ */ ECIPP_ALIGNMENT_UWORD 65535 Compu_IDENTITY 0 65535 PHYS_UNIT "System ID + DTC" /end CHARACTERISTIC
/begin CHARACTERISTIC FCdc4_ECP_hiP "FCtl_DTC_0x04(1044)" VALUE 0x001E48BE /* @ECU_Address@FCtl_DTC_0x04@0x024C4828@ */ ECIPP_ALIGNMENT_UWORD 65535 Compu_IDENTITY 0 65535 PHYS_UNIT "System ID + DTC" /end CHARACTERISTIC
/begin CHARACTERISTIC FCdc4_ECP_loP "FCtl_DTC_0x04(1043)" VALUE 0x001E48BC /* @ECU_Address@FCtl_DTC_0x04@0x024C4826@ */ ECIPP_ALIGNMENT_UWORD 65535 Compu_IDENTITY 0 65535 PHYS_UNIT "System ID + DTC" /end CHARACTERISTIC
/begin CHARACTERISTIC FCdc4_ECT_AAT_dT_max "FCtl_DTC_0x04(842)" VALUE 0x001E472A /* @ECU_Address@FCtl_DTC_0x04@0x024C4694@ */ ECIPP_ALIGNMENT_UWORD 65535 Compu_IDENTITY 0 65535 PHYS_UNIT "System ID + DTC" /end CHARACTERISTIC
/begin CHARACTERISTIC FCdc4_ECT_derate_actv "FCtl_DTC_0x04(828)" VALUE 0x001E470E /* @ECU_Address@FCtl_DTC_0x04@0x024C4678@ */ ECIPP_ALIGNMENT_UWORD 65535 Compu_IDENTITY 0 65535 PHYS_UNIT "System ID + DTC" /end CHARACTERISTIC
/begin CHARACTERISTIC FCdc4_ECT_dT_max "FCtl_DTC_0x04(850)" VALUE 0x001E473A /* @ECU_Address@FCtl_DTC_0x04@0x024C46A4@ */ ECIPP_ALIGNMENT_UWORD 65535 Compu_IDENTITY 0 65535 PHYS_UNIT "System ID + DTC" /end CHARACTERISTIC
/begin CHARACTERISTIC FCdc4_ECT_EGRT_dT_max "FCtl_DTC_0x04(843)" VALUE 0x001E472C /* @ECU_Address@FCtl_DTC_0x04@0x024C4696@ */ ECIPP_ALIGNMENT_UWORD 65535 Compu_IDENTITY 0 65535 PHYS_UNIT "System ID + DTC" /end CHARACTERISTIC
/begin CHARACTERISTIC FCdc4_ECT_EGT_dT_max "FCtl_DTC_0x04(846)" VALUE 0x001E4732 /* @ECU_Address@FCtl_DTC_0x04@0x024C469C@ */ ECIPP_ALIGNMENT_UWORD 65535 Compu_IDENTITY 0 65535 PHYS_UNIT "System ID + DTC" /end CHARACTERISTIC
/begin CHARACTERISTIC FCdc4_ECT_FT_dT_max "FCtl_DTC_0x04(844)" VALUE 0x001E472E /* @ECU_Address@FCtl_DTC_0x04@0x024C4698@ */ ECIPP_ALIGNMENT_UWORD 65535 Compu_IDENTITY 0 65535 PHYS_UNIT "System ID + DTC" /end CHARACTERISTIC
/begin CHARACTERISTIC FCdc4_ECT_HiExp "FCtl_DTC_0x04(4)" VALUE 0x001E409E /* @ECU_Address@FCtl_DTC_0x04@0x024C4008@ */ ECIPP_ALIGNMENT_UWORD 65535 Compu_IDENTITY 0 65535 PHYS_UNIT "System ID + DTC" /end CHARACTERISTIC
/begin CHARACTERISTIC FCdc4_ECT_HiExp2 "FCtl_DTC_0x04(86)" VALUE 0x001E4142 /* @ECU_Address@FCtl_DTC_0x04@0x024C40AC@ */ ECIPP_ALIGNMENT_UWORD 65535 Compu_IDENTITY 0 65535 PHYS_UNIT "System ID + DTC" /end CHARACTERISTIC
/begin CHARACTERISTIC FCdc4_ECT_IAT_dT_max "FCtl_DTC_0x04(841)" VALUE 0x001E4728 /* @ECU_Address@FCtl_DTC_0x04@0x024C4692@ */ ECIPP_ALIGNMENT_UWORD 65535 Compu_IDENTITY 0 65535 PHYS_UNIT "System ID + DTC" /end CHARACTERISTIC
/begin CHARACTERISTIC FCdc4_ECT_LoExp "FCtl_DTC_0x04(648)" VALUE 0x001E45A6 /* @ECU_Address@FCtl_DTC_0x04@0x024C4510@ */ ECIPP_ALIGNMENT_UWORD 65535 Compu_IDENTITY 0 65535 PHYS_UNIT "System ID + DTC" /end CHARACTERISTIC
/begin CHARACTERISTIC FCdc4_ECT_LoExp2 "FCtl_DTC_0x04(649)" VALUE 0x001E45A8 /* @ECU_Address@FCtl_DTC_0x04@0x024C4512@ */ ECIPP_ALIGNMENT_UWORD 65535 Compu_IDENTITY 0 65535 PHYS_UNIT "System ID + DTC" /end CHARACTERISTIC
/begin CHARACTERISTIC FCdc4_ECT_maxv "FCtl_DTC_0x04(2)" VALUE 0x001E409A /* @ECU_Address@FCtl_DTC_0x04@0x024C4004@ */ ECIPP_ALIGNMENT_UWORD 65535 Compu_IDENTITY 0 65535 PHYS_UNIT "System ID + DTC" /end CHARACTERISTIC
/begin CHARACTERISTIC FCdc4_ECT_minv "FCtl_DTC_0x04(3)" VALUE 0x001E409C /* @ECU_Address@FCtl_DTC_0x04@0x024C4006@ */ ECIPP_ALIGNMENT_UWORD 65535 Compu_IDENTITY 0 65535 PHYS_UNIT "System ID + DTC" /end CHARACTERISTIC
/begin CHARACTERISTIC FCdc4_ECT_OILT_dT_max "FCtl_DTC_0x04(845)" VALUE 0x001E4730 /* @ECU_Address@FCtl_DTC_0x04@0x024C469A@ */ ECIPP_ALIGNMENT_UWORD 65535 Compu_IDENTITY 0 65535 PHYS_UNIT "System ID + DTC" /end CHARACTERISTIC
/begin CHARACTERISTIC FCdc4_ECT_TAUX_dT1_max "FCtl_DTC_0x04(848)" VALUE 0x001E4736 /* @ECU_Address@FCtl_DTC_0x04@0x024C46A0@ */ ECIPP_ALIGNMENT_UWORD 65535 Compu_IDENTITY 0 65535 PHYS_UNIT "System ID + DTC" /end CHARACTERISTIC
/begin CHARACTERISTIC FCdc4_ECT_TAUX_dT2_max "FCtl_DTC_0x04(849)" VALUE 0x001E4738 /* @ECU_Address@FCtl_DTC_0x04@0x024C46A2@ */ ECIPP_ALIGNMENT_UWORD 65535 Compu_IDENTITY 0 65535 PHYS_UNIT "System ID + DTC" /end CHARACTERISTIC
/begin CHARACTERISTIC FCdc4_ECT_TIAT_dT_max "FCtl_DTC_0x04(847)" VALUE 0x001E4734 /* @ECU_Address@FCtl_DTC_0x04@0x024C469E@ */ ECIPP_ALIGNMENT_UWORD 65535 Compu_IDENTITY 0 65535 PHYS_UNIT "System ID + DTC" /end CHARACTERISTIC
/begin CHARACTERISTIC FCdc4_EGO1_open "FCtl_DTC_0x04(111)" VALUE 0x001E4174 /* @ECU_Address@FCtl_DTC_0x04@0x024C40DE@ */ ECIPP_ALIGNMENT_UWORD 65535 Compu_IDENTITY 0 65535 PHYS_UNIT "System ID + DTC" /end CHARACTERISTIC
/begin CHARACTERISTIC FCdc4_EGO2_open "FCtl_DTC_0x04(112)" VALUE 0x001E4176 /* @ECU_Address@FCtl_DTC_0x04@0x024C40E0@ */ ECIPP_ALIGNMENT_UWORD 65535 Compu_IDENTITY 0 65535 PHYS_UNIT "System ID + DTC" /end CHARACTERISTIC
/begin CHARACTERISTIC FCdc4_EGO3_open "FCtl_DTC_0x04(113)" VALUE 0x001E4178 /* @ECU_Address@FCtl_DTC_0x04@0x024C40E2@ */ ECIPP_ALIGNMENT_UWORD 65535 Compu_IDENTITY 0 65535 PHYS_UNIT "System ID + DTC" /end CHARACTERISTIC
/begin CHARACTERISTIC FCdc4_EGOH1_off_open "FCtl_DTC_0x04(321)" VALUE 0x001E4318 /* @ECU_Address@FCtl_DTC_0x04@0x024C4282@ */ ECIPP_ALIGNMENT_UWORD 65535 Compu_IDENTITY 0 65535 PHYS_UNIT "System ID + DTC" /end CHARACTERISTIC
/begin CHARACTERISTIC FCdc4_EGOH1_on_short "FCtl_DTC_0x04(322)" VALUE 0x001E431A /* @ECU_Address@FCtl_DTC_0x04@0x024C4284@ */ ECIPP_ALIGNMENT_UWORD 65535 Compu_IDENTITY 0 65535 PHYS_UNIT "System ID + DTC" /end CHARACTERISTIC
/begin CHARACTERISTIC FCdc4_EGOH2_off_open "FCtl_DTC_0x04(323)" VALUE 0x001E431C /* @ECU_Address@FCtl_DTC_0x04@0x024C4286@ */ ECIPP_ALIGNMENT_UWORD 65535 Compu_IDENTITY 0 65535 PHYS_UNIT "System ID + DTC" /end CHARACTERISTIC
/begin CHARACTERISTIC FCdc4_EGOH2_on_short "FCtl_DTC_0x04(324)" VALUE 0x001E431E /* @ECU_Address@FCtl_DTC_0x04@0x024C4288@ */ ECIPP_ALIGNMENT_UWORD 65535 Compu_IDENTITY 0 65535 PHYS_UNIT "System ID + DTC" /end CHARACTERISTIC
/begin CHARACTERISTIC FCdc4_EGOH3_off_open "FCtl_DTC_0x04(325)" VALUE 0x001E4320 /* @ECU_Address@FCtl_DTC_0x04@0x024C428A@ */ ECIPP_ALIGNMENT_UWORD 65535 Compu_IDENTITY 0 65535 PHYS_UNIT "System ID + DTC" /end CHARACTERISTIC
/begin CHARACTERISTIC FCdc4_EGOH3_on_short "FCtl_DTC_0x04(326)" VALUE 0x001E4322 /* @ECU_Address@FCtl_DTC_0x04@0x024C428C@ */ ECIPP_ALIGNMENT_UWORD 65535 Compu_IDENTITY 0 65535 PHYS_UNIT "System ID + DTC" /end CHARACTERISTIC
/begin CHARACTERISTIC FCdc4_EGOH4_off_open "FCtl_DTC_0x04(327)" VALUE 0x001E4324 /* @ECU_Address@FCtl_DTC_0x04@0x024C428E@ */ ECIPP_ALIGNMENT_UWORD 65535 Compu_IDENTITY 0 65535 PHYS_UNIT "System ID + DTC" /end CHARACTERISTIC
/begin CHARACTERISTIC FCdc4_EGOH4_on_short "FCtl_DTC_0x04(328)" VALUE 0x001E4326 /* @ECU_Address@FCtl_DTC_0x04@0x024C4290@ */ ECIPP_ALIGNMENT_UWORD 65535 Compu_IDENTITY 0 65535 PHYS_UNIT "System ID + DTC" /end CHARACTERISTIC
/begin CHARACTERISTIC FCdc4_EGR_clr_eta_lo "FCtl_DTC_0x04(666)" VALUE 0x001E45CA /* @ECU_Address@FCtl_DTC_0x04@0x024C4534@ */ ECIPP_ALIGNMENT_UWORD 65535 Compu_IDENTITY 0 65535 PHYS_UNIT "System ID + DTC" /end CHARACTERISTIC
/begin CHARACTERISTIC FCdc4_EGR_clr_eta_lo2 "FCtl_DTC_0x04(685)" VALUE 0x001E45F0 /* @ECU_Address@FCtl_DTC_0x04@0x024C455A@ */ ECIPP_ALIGNMENT_UWORD 65535 Compu_IDENTITY 0 65535 PHYS_UNIT "System ID + DTC" /end CHARACTERISTIC
/begin CHARACTERISTIC FCdc4_EGR_deice_excess "FCtl_DTC_0x04(829)" VALUE 0x001E4710 /* @ECU_Address@FCtl_DTC_0x04@0x024C467A@ */ ECIPP_ALIGNMENT_UWORD 65535 Compu_IDENTITY 0 65535 PHYS_UNIT "System ID + DTC" /end CHARACTERISTIC
/begin CHARACTERISTIC FCdc4_EGR_offmin_excess "FCtl_DTC_0x04(665)" VALUE 0x001E45C8 /* @ECU_Address@FCtl_DTC_0x04@0x024C4532@ */ ECIPP_ALIGNMENT_UWORD 65535 Compu_IDENTITY 0 65535 PHYS_UNIT "System ID + DTC" /end CHARACTERISTIC
/begin CHARACTERISTIC FCdc4_EGR_OOA_hi "FCtl_DTC_0x04(661)" VALUE 0x001E45C0 /* @ECU_Address@FCtl_DTC_0x04@0x024C452A@ */ ECIPP_ALIGNMENT_UWORD 65535 Compu_IDENTITY 0 65535 PHYS_UNIT "System ID + DTC" /end CHARACTERISTIC
/begin CHARACTERISTIC FCdc4_EGR_OOA_lo "FCtl_DTC_0x04(662)" VALUE 0x001E45C2 /* @ECU_Address@FCtl_DTC_0x04@0x024C452C@ */ ECIPP_ALIGNMENT_UWORD 65535 Compu_IDENTITY 0 65535 PHYS_UNIT "System ID + DTC" /end CHARACTERISTIC
/begin CHARACTERISTIC FCdc4_EGR_slowdec "FCtl_DTC_0x04(660)" VALUE 0x001E45BE /* @ECU_Address@FCtl_DTC_0x04@0x024C4528@ */ ECIPP_ALIGNMENT_UWORD 65535 Compu_IDENTITY 0 65535 PHYS_UNIT "System ID + DTC" /end CHARACTERISTIC
/begin CHARACTERISTIC FCdc4_EGR_slowinc "FCtl_DTC_0x04(659)" VALUE 0x001E45BC /* @ECU_Address@FCtl_DTC_0x04@0x024C4526@ */ ECIPP_ALIGNMENT_UWORD 65535 Compu_IDENTITY 0 65535 PHYS_UNIT "System ID + DTC" /end CHARACTERISTIC
/begin CHARACTERISTIC FCdc4_EGR_UEGOdP_hi "FCtl_DTC_0x04(663)" VALUE 0x001E45C4 /* @ECU_Address@FCtl_DTC_0x04@0x024C452E@ */ ECIPP_ALIGNMENT_UWORD 65535 Compu_IDENTITY 0 65535 PHYS_UNIT "System ID + DTC" /end CHARACTERISTIC
/begin CHARACTERISTIC FCdc4_EGR_UEGOdP_lo "FCtl_DTC_0x04(664)" VALUE 0x001E45C6 /* @ECU_Address@FCtl_DTC_0x04@0x024C4530@ */ ECIPP_ALIGNMENT_UWORD 65535 Compu_IDENTITY 0 65535 PHYS_UNIT "System ID + DTC" /end CHARACTERISTIC
/begin CHARACTERISTIC FCdc4_EGR_vlv_DC_lim "FCtl_DTC_0x04(743)" VALUE 0x001E4664 /* @ECU_Address@FCtl_DTC_0x04@0x024C45CE@ */ ECIPP_ALIGNMENT_UWORD 65535 Compu_IDENTITY 0 65535 PHYS_UNIT "System ID + DTC" /end CHARACTERISTIC
/begin CHARACTERISTIC FCdc4_EGR_vlv_HP_discon "FCtl_DTC_0x04(867)" VALUE 0x001E475C /* @ECU_Address@FCtl_DTC_0x04@0x024C46C6@ */ ECIPP_ALIGNMENT_UWORD 65535 Compu_IDENTITY 0 65535 PHYS_UNIT "System ID + DTC" /end CHARACTERISTIC
/begin CHARACTERISTIC FCdc4_EGR_vlv_stuck "FCtl_DTC_0x04(833)" VALUE 0x001E4718 /* @ECU_Address@FCtl_DTC_0x04@0x024C4682@ */ ECIPP_ALIGNMENT_UWORD 65535 Compu_IDENTITY 0 65535 PHYS_UNIT "System ID + DTC" /end CHARACTERISTIC
/begin CHARACTERISTIC FCdc4_EGR_vlv_temp_hi "FCtl_DTC_0x04(744)" VALUE 0x001E4666 /* @ECU_Address@FCtl_DTC_0x04@0x024C45D0@ */ ECIPP_ALIGNMENT_UWORD 65535 Compu_IDENTITY 0 65535 PHYS_UNIT "System ID + DTC" /end CHARACTERISTIC
/begin CHARACTERISTIC FCdc4_EGR_vlvCAN_commlost "FCtl_DTC_0x04(667)" VALUE 0x001E45CC /* @ECU_Address@FCtl_DTC_0x04@0x024C4536@ */ ECIPP_ALIGNMENT_UWORD 65535 Compu_IDENTITY 0 65535 PHYS_UNIT "System ID + DTC" /end CHARACTERISTIC
/begin CHARACTERISTIC FCdc4_EGR_vlvCAN_lowfunc "FCtl_DTC_0x04(669)" VALUE 0x001E45D0 /* @ECU_Address@FCtl_DTC_0x04@0x024C453A@ */ ECIPP_ALIGNMENT_UWORD 65535 Compu_IDENTITY 0 65535 PHYS_UNIT "System ID + DTC" /end CHARACTERISTIC
/begin CHARACTERISTIC FCdc4_EGR_vlvCAN_nofunc "FCtl_DTC_0x04(668)" VALUE 0x001E45CE /* @ECU_Address@FCtl_DTC_0x04@0x024C4538@ */ ECIPP_ALIGNMENT_UWORD 65535 Compu_IDENTITY 0 65535 PHYS_UNIT "System ID + DTC" /end CHARACTERISTIC
/begin CHARACTERISTIC FPnd_CL_phi_hi "FPrm_pending(507)" VALUE 0x001E5508 /* @ECU_Address@FPrm_pending@0x021BE3F6@ */ ECIPP_ALIGNMENT_UWORD 65535 Compu_IDENTITY 0 65535 PHYS_UNIT "Bit Mask" /end CHARACTERISTIC
/begin CHARACTERISTIC FPnd_CL_phi_lo "FPrm_pending(508)" VALUE 0x001E550A /* @ECU_Address@FPrm_pending@0x021BE3F8@ */ ECIPP_ALIGNMENT_UWORD 65535 Compu_IDENTITY 0 65535 PHYS_UNIT "Bit Mask" /end CHARACTERISTIC
/begin CHARACTERISTIC FPnd_CLLP_hi "FPrm_pending(49)" VALUE 0x001E5174 /* @ECU_Address@FPrm_pending@0x021BE062@ */ ECIPP_ALIGNMENT_UWORD 65535 Compu_IDENTITY 0 65535 PHYS_UNIT "Bit Mask" /end CHARACTERISTIC
/begin CHARACTERISTIC FPnd_CLLP_lo "FPrm_pending(50)" VALUE 0x001E5176 /* @ECU_Address@FPrm_pending@0x021BE064@ */ ECIPP_ALIGNMENT_UWORD 65535 Compu_IDENTITY 0 65535 PHYS_UNIT "Bit Mask" /end CHARACTERISTIC
/begin CHARACTERISTIC FPnd_CLNG_hi "FPrm_pending(51)" VALUE 0x001E5178 /* @ECU_Address@FPrm_pending@0x021BE066@ */ ECIPP_ALIGNMENT_UWORD 65535 Compu_IDENTITY 0 65535 PHYS_UNIT "Bit Mask" /end CHARACTERISTIC
/begin CHARACTERISTIC FPnd_CLNG_lo "FPrm_pending(52)" VALUE 0x001E517A /* @ECU_Address@FPrm_pending@0x021BE068@ */ ECIPP_ALIGNMENT_UWORD 65535 Compu_IDENTITY 0 65535 PHYS_UNIT "Bit Mask" /end CHARACTERISTIC
/begin CHARACTERISTIC FPnd_CM_unresp "FPrm_pending(629)" VALUE 0x001E55FC /* @ECU_Address@FPrm_pending@0x021BE4EA@ */ ECIPP_ALIGNMENT_UWORD 65535 Compu_IDENTITY 0 65535 PHYS_UNIT "Bit Mask" /end CHARACTERISTIC
/begin CHARACTERISTIC FPnd_CMgsln_inact "FPrm_pending(89)" VALUE 0x001E51C4 /* @ECU_Address@FPrm_pending@0x021BE0B2@ */ ECIPP_ALIGNMENT_UWORD 65535 Compu_IDENTITY 0 65535 PHYS_UNIT "Bit Mask" /end CHARACTERISTIC
/begin CHARACTERISTIC FPnd_CMLP_inact "FPrm_pending(90)" VALUE 0x001E51C6 /* @ECU_Address@FPrm_pending@0x021BE0B4@ */ ECIPP_ALIGNMENT_UWORD 65535 Compu_IDENTITY 0 65535 PHYS_UNIT "Bit Mask" /end CHARACTERISTIC
/begin CHARACTERISTIC FPnd_CMNG_inact "FPrm_pending(91)" VALUE 0x001E51C8 /* @ECU_Address@FPrm_pending@0x021BE0B6@ */ ECIPP_ALIGNMENT_UWORD 65535 Compu_IDENTITY 0 65535 PHYS_UNIT "Bit Mask" /end CHARACTERISTIC
/begin CHARACTERISTIC FPnd_COPfail "FPrm_pending(63)" VALUE 0x001E5190 /* @ECU_Address@FPrm_pending@0x021BE07E@ */ ECIPP_ALIGNMENT_UWORD 65535 Compu_IDENTITY 0 65535 PHYS_UNIT "Bit Mask" /end CHARACTERISTIC
/begin CHARACTERISTIC FPnd_COT_hi "FPrm_pending(487)" VALUE 0x001E54E0 /* @ECU_Address@FPrm_pending@0x021BE3CE@ */ ECIPP_ALIGNMENT_UWORD 65535 Compu_IDENTITY 0 65535 PHYS_UNIT "Bit Mask" /end CHARACTERISTIC
/begin CHARACTERISTIC FPnd_crkloss "FPrm_pending(112)" VALUE 0x001E51F2 /* @ECU_Address@FPrm_pending@0x021BE0E0@ */ ECIPP_ALIGNMENT_UWORD 65535 Compu_IDENTITY 0 65535 PHYS_UNIT "Bit Mask" /end CHARACTERISTIC
/begin CHARACTERISTIC FPnd_crknever "FPrm_pending(62)" VALUE 0x001E518E /* @ECU_Address@FPrm_pending@0x021BE07C@ */ ECIPP_ALIGNMENT_UWORD 65535 Compu_IDENTITY 0 65535 PHYS_UNIT "Bit Mask" /end CHARACTERISTIC
/begin CHARACTERISTIC FPnd_crknoise "FPrm_pending(61)" VALUE 0x001E518C /* @ECU_Address@FPrm_pending@0x021BE07A@ */ ECIPP_ALIGNMENT_UWORD 65535 Compu_IDENTITY 0 65535 PHYS_UNIT "Bit Mask" /end CHARACTERISTIC
/begin CHARACTERISTIC FPnd_CVCS_discon "FPrm_pending(577)" VALUE 0x001E5594 /* @ECU_Address@FPrm_pending@0x021BE482@ */ ECIPP_ALIGNMENT_UWORD 65535 Compu_IDENTITY 0 65535 PHYS_UNIT "Bit Mask" /end CHARACTERISTIC
/begin CHARACTERISTIC FPnd_CVDS_discon "FPrm_pending(578)" VALUE 0x001E5596 /* @ECU_Address@FPrm_pending@0x021BE484@ */ ECIPP_ALIGNMENT_UWORD 65535 Compu_IDENTITY 0 65535 PHYS_UNIT "Bit Mask" /end CHARACTERISTIC
/begin CHARACTERISTIC FPnd_CVP1_hi "FPrm_pending(624)" VALUE 0x001E55F2 /* @ECU_Address@FPrm_pending@0x021BE4E0@ */ ECIPP_ALIGNMENT_UWORD 65535 Compu_IDENTITY 0 65535 PHYS_UNIT "Bit Mask" /end CHARACTERISTIC
/begin CHARACTERISTIC FPnd_CVP1_lo "FPrm_pending(625)" VALUE 0x001E55F4 /* @ECU_Address@FPrm_pending@0x021BE4E2@ */ ECIPP_ALIGNMENT_UWORD 65535 Compu_IDENTITY 0 65535 PHYS_UNIT "Bit Mask" /end CHARACTERISTIC
/begin CHARACTERISTIC FPnd_CVP2_hi "FPrm_pending(626)" VALUE 0x001E55F6 /* @ECU_Address@FPrm_pending@0x021BE4E4@ */ ECIPP_ALIGNMENT_UWORD 65535 Compu_IDENTITY 0 65535 PHYS_UNIT "Bit Mask" /end CHARACTERISTIC
/begin CHARACTERISTIC FPnd_CVP2_lo "FPrm_pending(627)" VALUE 0x001E55F8 /* @ECU_Address@FPrm_pending@0x021BE4E6@ */ ECIPP_ALIGNMENT_UWORD 65535 Compu_IDENTITY 0 65535 PHYS_UNIT "Bit Mask" /end CHARACTERISTIC
/begin CHARACTERISTIC FPnd_DBW_I_max "FPrm_pending(397)" VALUE 0x001E542C /* @ECU_Address@FPrm_pending@0x021BE31A@ */ ECIPP_ALIGNMENT_UWORD 65535 Compu_IDENTITY 0 65535 PHYS_UNIT "Bit Mask" /end CHARACTERISTIC
/begin CHARACTERISTIC FPnd_ECam_maxerr "FPrm_pending(211)" VALUE 0x001E52B8 /* @ECU_Address@FPrm_pending@0x021BE1A6@ */ ECIPP_ALIGNMENT_UWORD 65535 Compu_IDENTITY 0 65535 PHYS_UNIT "Bit Mask" /end CHARACTERISTIC
/begin CHARACTERISTIC FPnd_ECL_low "FPrm_pending(563)" VALUE 0x001E5578 /* @ECU_Address@FPrm_pending@0x021BE466@ */ ECIPP_ALIGNMENT_UWORD 65535 Compu_IDENTITY 0 65535 PHYS_UNIT "Bit Mask" /end CHARACTERISTIC
/begin CHARACTERISTIC FPnd_ECP_hiP "FPrm_pending(720)" VALUE 0x001E56B2 /* @ECU_Address@FPrm_pending@0x021BE5A0@ */ ECIPP_ALIGNMENT_UWORD 65535 Compu_IDENTITY 0 65535 PHYS_UNIT "Bit Mask" /end CHARACTERISTIC
/begin CHARACTERISTIC FPnd_ECP_loP "FPrm_pending(719)" VALUE 0x001E56B0 /* @ECU_Address@FPrm_pending@0x021BE59E@ */ ECIPP_ALIGNMENT_UWORD 65535 Compu_IDENTITY 0 65535 PHYS_UNIT "Bit Mask" /end CHARACTERISTIC
/begin CHARACTERISTIC FPnd_ECT_AAT_dT_max "FPrm_pending(669)" VALUE 0x001E564C /* @ECU_Address@FPrm_pending@0x021BE53A@ */ ECIPP_ALIGNMENT_UWORD 65535 Compu_IDENTITY 0 65535 PHYS_UNIT "Bit Mask" /end CHARACTERISTIC
/begin CHARACTERISTIC FPnd_ECT_derate_actv "FPrm_pending(655)" VALUE 0x001E5630 /* @ECU_Address@FPrm_pending@0x021BE51E@ */ ECIPP_ALIGNMENT_UWORD 65535 Compu_IDENTITY 0 65535 PHYS_UNIT "Bit Mask" /end CHARACTERISTIC
/begin CHARACTERISTIC FPnd_ECT_dT_max "FPrm_pending(677)" VALUE 0x001E565C /* @ECU_Address@FPrm_pending@0x021BE54A@ */ ECIPP_ALIGNMENT_UWORD 65535 Compu_IDENTITY 0 65535 PHYS_UNIT "Bit Mask" /end CHARACTERISTIC
/begin CHARACTERISTIC FPnd_ECT_EGRT_dT_max "FPrm_pending(670)" VALUE 0x001E564E /* @ECU_Address@FPrm_pending@0x021BE53C@ */ ECIPP_ALIGNMENT_UWORD 65535 Compu_IDENTITY 0 65535 PHYS_UNIT "Bit Mask" /end CHARACTERISTIC
/begin CHARACTERISTIC FPnd_ECT_EGT_dT_max "FPrm_pending(673)" VALUE 0x001E5654 /* @ECU_Address@FPrm_pending@0x021BE542@ */ ECIPP_ALIGNMENT_UWORD 65535 Compu_IDENTITY 0 65535 PHYS_UNIT "Bit Mask" /end CHARACTERISTIC
/begin CHARACTERISTIC FPnd_ECT_FT_dT_max "FPrm_pending(671)" VALUE 0x001E5650 /* @ECU_Address@FPrm_pending@0x021BE53E@ */ ECIPP_ALIGNMENT_UWORD 65535 Compu_IDENTITY 0 65535 PHYS_UNIT "Bit Mask" /end CHARACTERISTIC
/begin CHARACTERISTIC FPnd_ECT_HiExp "FPrm_pending(4)" VALUE 0x001E511A /* @ECU_Address@FPrm_pending@0x021BE008@ */ ECIPP_ALIGNMENT_UWORD 65535 Compu_IDENTITY 0 65535 PHYS_UNIT "Bit Mask" /end CHARACTERISTIC
/begin CHARACTERISTIC FPnd_ECT_HiExp2 "FPrm_pending(5)" VALUE 0x001E511C /* @ECU_Address@FPrm_pending@0x021BE00A@ */ ECIPP_ALIGNMENT_UWORD 65535 Compu_IDENTITY 0 65535 PHYS_UNIT "Bit Mask" /end CHARACTERISTIC
/begin CHARACTERISTIC FPnd_ECT_IAT_dT_max "FPrm_pending(668)" VALUE 0x001E564A /* @ECU_Address@FPrm_pending@0x021BE538@ */ ECIPP_ALIGNMENT_UWORD 65535 Compu_IDENTITY 0 65535 PHYS_UNIT "Bit Mask" /end CHARACTERISTIC
/begin CHARACTERISTIC FPnd_ECT_LoExp "FPrm_pending(478)" VALUE 0x001E54CE /* @ECU_Address@FPrm_pending@0x021BE3BC@ */ ECIPP_ALIGNMENT_UWORD 65535 Compu_IDENTITY 0 65535 PHYS_UNIT "Bit Mask" /end CHARACTERISTIC
/begin CHARACTERISTIC FPnd_ECT_LoExp2 "FPrm_pending(479)" VALUE 0x001E54D0 /* @ECU_Address@FPrm_pending@0x021BE3BE@ */ ECIPP_ALIGNMENT_UWORD 65535 Compu_IDENTITY 0 65535 PHYS_UNIT "Bit Mask" /end CHARACTERISTIC
/begin CHARACTERISTIC FPnd_ECT_maxv "FPrm_pending(2)" VALUE 0x001E5116 /* @ECU_Address@FPrm_pending@0x021BE004@ */ ECIPP_ALIGNMENT_UWORD 65535 Compu_IDENTITY 0 65535 PHYS_UNIT "Bit Mask" /end CHARACTERISTIC
/begin CHARACTERISTIC FPnd_ECT_minv "FPrm_pending(3)" VALUE 0x001E5118 /* @ECU_Address@FPrm_pending@0x021BE006@ */ ECIPP_ALIGNMENT_UWORD 65535 Compu_IDENTITY 0 65535 PHYS_UNIT "Bit Mask" /end CHARACTERISTIC
/begin CHARACTERISTIC FPnd_ECT_OILT_dT_max "FPrm_pending(672)" VALUE 0x001E5652 /* @ECU_Address@FPrm_pending@0x021BE540@ */ ECIPP_ALIGNMENT_UWORD 65535 Compu_IDENTITY 0 65535 PHYS_UNIT "Bit Mask" /end CHARACTERISTIC
/begin CHARACTERISTIC FPnd_ECT_TAUX_dT1_max "FPrm_pending(675)" VALUE 0x001E5658 /* @ECU_Address@FPrm_pending@0x021BE546@ */ ECIPP_ALIGNMENT_UWORD 65535 Compu_IDENTITY 0 65535 PHYS_UNIT "Bit Mask" /end CHARACTERISTIC
/begin CHARACTERISTIC FPnd_ECT_TAUX_dT2_max "FPrm_pending(676)" VALUE 0x001E565A /* @ECU_Address@FPrm_pending@0x021BE548@ */ ECIPP_ALIGNMENT_UWORD 65535 Compu_IDENTITY 0 65535 PHYS_UNIT "Bit Mask" /end CHARACTERISTIC
/begin CHARACTERISTIC FPnd_ECT_TIAT_dT_max "FPrm_pending(674)" VALUE 0x001E5656 /* @ECU_Address@FPrm_pending@0x021BE544@ */ ECIPP_ALIGNMENT_UWORD 65535 Compu_IDENTITY 0 65535 PHYS_UNIT "Bit Mask" /end CHARACTERISTIC
/begin CHARACTERISTIC FPnd_EGO1_open "FPrm_pending(71)" VALUE 0x001E51A0 /* @ECU_Address@FPrm_pending@0x021BE08E@ */ ECIPP_ALIGNMENT_UWORD 65535 Compu_IDENTITY 0 65535 PHYS_UNIT "Bit Mask" /end CHARACTERISTIC
/begin CHARACTERISTIC FPnd_EGO2_open "FPrm_pending(100)" VALUE 0x001E51DA /* @ECU_Address@FPrm_pending@0x021BE0C8@ */ ECIPP_ALIGNMENT_UWORD 65535 Compu_IDENTITY 0 65535 PHYS_UNIT "Bit Mask" /end CHARACTERISTIC
/begin CHARACTERISTIC FPnd_EGO3_open "FPrm_pending(72)" VALUE 0x001E51A2 /* @ECU_Address@FPrm_pending@0x021BE090@ */ ECIPP_ALIGNMENT_UWORD 65535 Compu_IDENTITY 0 65535 PHYS_UNIT "Bit Mask" /end CHARACTERISTIC
/begin CHARACTERISTIC FPnd_EGOH1_off_open "FPrm_pending(230)" VALUE 0x001E52DE /* @ECU_Address@FPrm_pending@0x021BE1CC@ */ ECIPP_ALIGNMENT_UWORD 65535 Compu_IDENTITY 0 65535 PHYS_UNIT "Bit Mask" /end CHARACTERISTIC
/begin CHARACTERISTIC FPnd_EGOH1_on_short "FPrm_pending(231)" VALUE 0x001E52E0 /* @ECU_Address@FPrm_pending@0x021BE1CE@ */ ECIPP_ALIGNMENT_UWORD 65535 Compu_IDENTITY 0 65535 PHYS_UNIT "Bit Mask" /end CHARACTERISTIC
/begin CHARACTERISTIC FPnd_EGOH2_off_open "FPrm_pending(232)" VALUE 0x001E52E2 /* @ECU_Address@FPrm_pending@0x021BE1D0@ */ ECIPP_ALIGNMENT_UWORD 65535 Compu_IDENTITY 0 65535 PHYS_UNIT "Bit Mask" /end CHARACTERISTIC
/begin CHARACTERISTIC FPnd_EGOH2_on_short "FPrm_pending(233)" VALUE 0x001E52E4 /* @ECU_Address@FPrm_pending@0x021BE1D2@ */ ECIPP_ALIGNMENT_UWORD 65535 Compu_IDENTITY 0 65535 PHYS_UNIT "Bit Mask" /end CHARACTERISTIC
/begin CHARACTERISTIC FPnd_EGOH3_off_open "FPrm_pending(234)" VALUE 0x001E52E6 /* @ECU_Address@FPrm_pending@0x021BE1D4@ */ ECIPP_ALIGNMENT_UWORD 65535 Compu_IDENTITY 0 65535 PHYS_UNIT "Bit Mask" /end CHARACTERISTIC
/begin CHARACTERISTIC FPnd_EGOH3_on_short "FPrm_pending(235)" VALUE 0x001E52E8 /* @ECU_Address@FPrm_pending@0x021BE1D6@ */ ECIPP_ALIGNMENT_UWORD 65535 Compu_IDENTITY 0 65535 PHYS_UNIT "Bit Mask" /end CHARACTERISTIC
/begin CHARACTERISTIC FPnd_EGOH4_off_open "FPrm_pending(236)" VALUE 0x001E52EA /* @ECU_Address@FPrm_pending@0x021BE1D8@ */ ECIPP_ALIGNMENT_UWORD 65535 Compu_IDENTITY 0 65535 PHYS_UNIT "Bit Mask" /end CHARACTERISTIC
/begin CHARACTERISTIC FPnd_EGOH4_on_short "FPrm_pending(237)" VALUE 0x001E52EC /* @ECU_Address@FPrm_pending@0x021BE1DA@ */ ECIPP_ALIGNMENT_UWORD 65535 Compu_IDENTITY 0 65535 PHYS_UNIT "Bit Mask" /end CHARACTERISTIC
/begin CHARACTERISTIC FPnd_EGR_clr_eta_lo "FPrm_pending(496)" VALUE 0x001E54F2 /* @ECU_Address@FPrm_pending@0x021BE3E0@ */ ECIPP_ALIGNMENT_UWORD 65535 Compu_IDENTITY 0 65535 PHYS_UNIT "Bit Mask" /end CHARACTERISTIC
/begin CHARACTERISTIC FPnd_EGR_clr_eta_lo2 "FPrm_pending(515)" VALUE 0x001E5518 /* @ECU_Address@FPrm_pending@0x021BE406@ */ ECIPP_ALIGNMENT_UWORD 65535 Compu_IDENTITY 0 65535 PHYS_UNIT "Bit Mask" /end CHARACTERISTIC
/begin CHARACTERISTIC FPnd_EGR_deice_excess "FPrm_pending(656)" VALUE 0x001E5632 /* @ECU_Address@FPrm_pending@0x021BE520@ */ ECIPP_ALIGNMENT_UWORD 65535 Compu_IDENTITY 0 65535 PHYS_UNIT "Bit Mask" /end CHARACTERISTIC
/begin CHARACTERISTIC FPnd_EGR_offmin_excess "FPrm_pending(495)" VALUE 0x001E54F0 /* @ECU_Address@FPrm_pending@0x021BE3DE@ */ ECIPP_ALIGNMENT_UWORD 65535 Compu_IDENTITY 0 65535 PHYS_UNIT "Bit Mask" /end CHARACTERISTIC
/begin CHARACTERISTIC FPnd_EGR_OOA_hi "FPrm_pending(491)" VALUE 0x001E54E8 /* @ECU_Address@FPrm_pending@0x021BE3D6@ */ ECIPP_ALIGNMENT_UWORD 65535 Compu_IDENTITY 0 65535 PHYS_UNIT "Bit Mask" /end CHARACTERISTIC
/begin CHARACTERISTIC FPnd_EGR_OOA_lo "FPrm_pending(492)" VALUE 0x001E54EA /* @ECU_Address@FPrm_pending@0x021BE3D8@ */ ECIPP_ALIGNMENT_UWORD 65535 Compu_IDENTITY 0 65535 PHYS_UNIT "Bit Mask" /end CHARACTERISTIC
/begin CHARACTERISTIC FPnd_EGR_slowdec "FPrm_pending(490)" VALUE 0x001E54E6 /* @ECU_Address@FPrm_pending@0x021BE3D4@ */ ECIPP_ALIGNMENT_UWORD 65535 Compu_IDENTITY 0 65535 PHYS_UNIT "Bit Mask" /end CHARACTERISTIC
/begin CHARACTERISTIC FPnd_EGR_slowinc "FPrm_pending(489)" VALUE 0x001E54E4 /* @ECU_Address@FPrm_pending@0x021BE3D2@ */ ECIPP_ALIGNMENT_UWORD 65535 Compu_IDENTITY 0 65535 PHYS_UNIT "Bit Mask" /end CHARACTERISTIC
/begin CHARACTERISTIC FPnd_EGR_UEGOdP_hi "FPrm_pending(493)" VALUE 0x001E54EC /* @ECU_Address@FPrm_pending@0x021BE3DA@ */ ECIPP_ALIGNMENT_UWORD 65535 Compu_IDENTITY 0 65535 PHYS_UNIT "Bit Mask" /end CHARACTERISTIC
/begin CHARACTERISTIC FPnd_EGR_UEGOdP_lo "FPrm_pending(494)" VALUE 0x001E54EE /* @ECU_Address@FPrm_pending@0x021BE3DC@ */ ECIPP_ALIGNMENT_UWORD 65535 Compu_IDENTITY 0 65535 PHYS_UNIT "Bit Mask" /end CHARACTERISTIC
/begin CHARACTERISTIC FPnd_EGR_vlv_DC_lim "FPrm_pending(573)" VALUE 0x001E558C /* @ECU_Address@FPrm_pending@0x021BE47A@ */ ECIPP_ALIGNMENT_UWORD 65535 Compu_IDENTITY 0 65535 PHYS_UNIT "Bit Mask" /end CHARACTERISTIC
/begin CHARACTERISTIC FPnd_EGR_vlv_HP_discon "FPrm_pending(694)" VALUE 0x001E567E /* @ECU_Address@FPrm_pending@0x021BE56C@ */ ECIPP_ALIGNMENT_UWORD 65535 Compu_IDENTITY 0 65535 PHYS_UNIT "Bit Mask" /end CHARACTERISTIC
/begin CHARACTERISTIC FPnd_EGR_vlv_stuck "FPrm_pending(660)" VALUE 0x001E563A /* @ECU_Address@FPrm_pending@0x021BE528@ */ ECIPP_ALIGNMENT_UWORD 65535 Compu_IDENTITY 0 65535 PHYS_UNIT "Bit Mask" /end CHARACTERISTIC
/begin CHARACTERISTIC FPnd_EGR_vlv_temp_hi "FPrm_pending(574)" VALUE 0x001E558E /* @ECU_Address@FPrm_pending@0x021BE47C@ */ ECIPP_ALIGNMENT_UWORD 65535 Compu_IDENTITY 0 65535 PHYS_UNIT "Bit Mask" /end CHARACTERISTIC
/begin CHARACTERISTIC FPnd_EGR_vlvCAN_commlost "FPrm_pending(497)" VALUE 0x001E54F4 /* @ECU_Address@FPrm_pending@0x021BE3E2@ */ ECIPP_ALIGNMENT_UWORD 65535 Compu_IDENTITY 0 65535 PHYS_UNIT "Bit Mask" /end CHARACTERISTIC
/begin CHARACTERISTIC FPnd_EGR_vlvCAN_lowfunc "FPrm_pending(499)" VALUE 0x001E54F8 /* @ECU_Address@FPrm_pending@0x021BE3E6@ */ ECIPP_ALIGNMENT_UWORD 65535 Compu_IDENTITY 0 65535 PHYS_UNIT "Bit Mask" /end CHARACTERISTIC
/begin CHARACTERISTIC FPnd_EGR_vlvCAN_nofunc "FPrm_pending(498)" VALUE 0x001E54F6 /* @ECU_Address@FPrm_pending@0x021BE3E4@ */ ECIPP_ALIGNMENT_UWORD 65535 Compu_IDENTITY 0 65535 PHYS_UNIT "Bit Mask" /end CHARACTERISTIC
/begin CHARACTERISTIC FPsvr_CL_phi_hi "FPrm_severity(507)" VALUE 0x001E6A10 /* @ECU_Address@FPrm_severity@0x024B31FB@ */ ECIPP_ALIGNMENT_UBYTE 255 Compu_IDENTITY 0 255 PHYS_UNIT "Severity+Class" /end CHARACTERISTIC
/begin CHARACTERISTIC FPsvr_CL_phi_lo "FPrm_severity(508)" VALUE 0x001E6A11 /* @ECU_Address@FPrm_severity@0x024B31FC@ */ ECIPP_ALIGNMENT_UBYTE 255 Compu_IDENTITY 0 255 PHYS_UNIT "Severity+Class" /end CHARACTERISTIC
/begin CHARACTERISTIC FPsvr_CLLP_hi "FPrm_severity(49)" VALUE 0x001E6846 /* @ECU_Address@FPrm_severity@0x024B3031@ */ ECIPP_ALIGNMENT_UBYTE 255 Compu_IDENTITY 0 255 PHYS_UNIT "Severity+Class" /end CHARACTERISTIC
/begin CHARACTERISTIC FPsvr_CLLP_lo "FPrm_severity(50)" VALUE 0x001E6847 /* @ECU_Address@FPrm_severity@0x024B3032@ */ ECIPP_ALIGNMENT_UBYTE 255 Compu_IDENTITY 0 255 PHYS_UNIT "Severity+Class" /end CHARACTERISTIC
/begin CHARACTERISTIC FPsvr_CLNG_hi "FPrm_severity(51)" VALUE 0x001E6848 /* @ECU_Address@FPrm_severity@0x024B3033@ */ ECIPP_ALIGNMENT_UBYTE 255 Compu_IDENTITY 0 255 PHYS_UNIT "Severity+Class" /end CHARACTERISTIC
/begin CHARACTERISTIC FPsvr_CLNG_lo "FPrm_severity(52)" VALUE 0x001E6849 /* @ECU_Address@FPrm_severity@0x024B3034@ */ ECIPP_ALIGNMENT_UBYTE 255 Compu_IDENTITY 0 255 PHYS_UNIT "Severity+Class" /end CHARACTERISTIC
/begin CHARACTERISTIC FPsvr_CM_unresp "FPrm_severity(629)" VALUE 0x001E6A8A /* @ECU_Address@FPrm_severity@0x024B3275@ */ ECIPP_ALIGNMENT_UBYTE 255 Compu_IDENTITY 0 255 PHYS_UNIT "Severity+Class" /end CHARACTERISTIC
/begin CHARACTERISTIC FPsvr_CMgsln_inact "FPrm_severity(89)" VALUE 0x001E686E /* @ECU_Address@FPrm_severity@0x024B3059@ */ ECIPP_ALIGNMENT_UBYTE 255 Compu_IDENTITY 0 255 PHYS_UNIT "Severity+Class" /end CHARACTERISTIC
/begin CHARACTERISTIC FPsvr_CMLP_inact "FPrm_severity(90)" VALUE 0x001E686F /* @ECU_Address@FPrm_severity@0x024B305A@ */ ECIPP_ALIGNMENT_UBYTE 255 Compu_IDENTITY 0 255 PHYS_UNIT "Severity+Class" /end CHARACTERISTIC
/begin CHARACTERISTIC FPsvr_CMNG_inact "FPrm_severity(91)" VALUE 0x001E6870 /* @ECU_Address@FPrm_severity@0x024B305B@ */ ECIPP_ALIGNMENT_UBYTE 255 Compu_IDENTITY 0 255 PHYS_UNIT "Severity+Class" /end CHARACTERISTIC
/begin CHARACTERISTIC FPsvr_COPfail "FPrm_severity(63)" VALUE 0x001E6854 /* @ECU_Address@FPrm_severity@0x024B303F@ */ ECIPP_ALIGNMENT_UBYTE 255 Compu_IDENTITY 0 255 PHYS_UNIT "Severity+Class" /end CHARACTERISTIC
/begin CHARACTERISTIC FPsvr_COT_hi "FPrm_severity(487)" VALUE 0x001E69FC /* @ECU_Address@FPrm_severity@0x024B31E7@ */ ECIPP_ALIGNMENT_UBYTE 255 Compu_IDENTITY 0 255 PHYS_UNIT "Severity+Class" /end CHARACTERISTIC
/begin CHARACTERISTIC FPsvr_crkloss "FPrm_severity(112)" VALUE 0x001E6885 /* @ECU_Address@FPrm_severity@0x024B3070@ */ ECIPP_ALIGNMENT_UBYTE 255 Compu_IDENTITY 0 255 PHYS_UNIT "Severity+Class" /end CHARACTERISTIC
/begin CHARACTERISTIC FPsvr_crknever "FPrm_severity(62)" VALUE 0x001E6853 /* @ECU_Address@FPrm_severity@0x024B303E@ */ ECIPP_ALIGNMENT_UBYTE 255 Compu_IDENTITY 0 255 PHYS_UNIT "Severity+Class" /end CHARACTERISTIC
/begin CHARACTERISTIC FPsvr_crknoise "FPrm_severity(61)" VALUE 0x001E6852 /* @ECU_Address@FPrm_severity@0x024B303D@ */ ECIPP_ALIGNMENT_UBYTE 255 Compu_IDENTITY 0 255 PHYS_UNIT "Severity+Class" /end CHARACTERISTIC
/begin CHARACTERISTIC FPsvr_CVCS_discon "FPrm_severity(577)" VALUE 0x001E6A56 /* @ECU_Address@FPrm_severity@0x024B3241@ */ ECIPP_ALIGNMENT_UBYTE 255 Compu_IDENTITY 0 255 PHYS_UNIT "Severity+Class" /end CHARACTERISTIC
/begin CHARACTERISTIC FPsvr_CVDS_discon "FPrm_severity(578)" VALUE 0x001E6A57 /* @ECU_Address@FPrm_severity@0x024B3242@ */ ECIPP_ALIGNMENT_UBYTE 255 Compu_IDENTITY 0 255 PHYS_UNIT "Severity+Class" /end CHARACTERISTIC
/begin CHARACTERISTIC FPsvr_CVP1_hi "FPrm_severity(624)" VALUE 0x001E6A85 /* @ECU_Address@FPrm_severity@0x024B3270@ */ ECIPP_ALIGNMENT_UBYTE 255 Compu_IDENTITY 0 255 PHYS_UNIT "Severity+Class" /end CHARACTERISTIC
/begin CHARACTERISTIC FPsvr_CVP1_lo "FPrm_severity(625)" VALUE 0x001E6A86 /* @ECU_Address@FPrm_severity@0x024B3271@ */ ECIPP_ALIGNMENT_UBYTE 255 Compu_IDENTITY 0 255 PHYS_UNIT "Severity+Class" /end CHARACTERISTIC
/begin CHARACTERISTIC FPsvr_CVP2_hi "FPrm_severity(626)" VALUE 0x001E6A87 /* @ECU_Address@FPrm_severity@0x024B3272@ */ ECIPP_ALIGNMENT_UBYTE 255 Compu_IDENTITY 0 255 PHYS_UNIT "Severity+Class" /end CHARACTERISTIC
/begin CHARACTERISTIC FPsvr_CVP2_lo "FPrm_severity(627)" VALUE 0x001E6A88 /* @ECU_Address@FPrm_severity@0x024B3273@ */ ECIPP_ALIGNMENT_UBYTE 255 Compu_IDENTITY 0 255 PHYS_UNIT "Severity+Class" /end CHARACTERISTIC
/begin CHARACTERISTIC FPsvr_DBW_I_max "FPrm_severity(397)" VALUE 0x001E69A2 /* @ECU_Address@FPrm_severity@0x024B318D@ */ ECIPP_ALIGNMENT_UBYTE 255 Compu_IDENTITY 0 255 PHYS_UNIT "Severity+Class" /end CHARACTERISTIC
/begin CHARACTERISTIC FPsvr_ECam_maxerr "FPrm_severity(211)" VALUE 0x001E68E8 /* @ECU_Address@FPrm_severity@0x024B30D3@ */ ECIPP_ALIGNMENT_UBYTE 255 Compu_IDENTITY 0 255 PHYS_UNIT "Severity+Class" /end CHARACTERISTIC
/begin CHARACTERISTIC FPsvr_ECL_low "FPrm_severity(563)" VALUE 0x001E6A48 /* @ECU_Address@FPrm_severity@0x024B3233@ */ ECIPP_ALIGNMENT_UBYTE 255 Compu_IDENTITY 0 255 PHYS_UNIT "Severity+Class" /end CHARACTERISTIC
/begin CHARACTERISTIC FPsvr_ECP_hiP "FPrm_severity(720)" VALUE 0x001E6AE5 /* @ECU_Address@FPrm_severity@0x024B32D0@ */ ECIPP_ALIGNMENT_UBYTE 255 Compu_IDENTITY 0 255 PHYS_UNIT "Severity+Class" /end CHARACTERISTIC
/begin CHARACTERISTIC FPsvr_ECP_loP "FPrm_severity(719)" VALUE 0x001E6AE4 /* @ECU_Address@FPrm_severity@0x024B32CF@ */ ECIPP_ALIGNMENT_UBYTE 255 Compu_IDENTITY 0 255 PHYS_UNIT "Severity+Class" /end CHARACTERISTIC
/begin CHARACTERISTIC FPsvr_ECT_AAT_dT_max "FPrm_severity(669)" VALUE 0x001E6AB2 /* @ECU_Address@FPrm_severity@0x024B329D@ */ ECIPP_ALIGNMENT_UBYTE 255 Compu_IDENTITY 0 255 PHYS_UNIT "Severity+Class" /end CHARACTERISTIC
/begin CHARACTERISTIC FPsvr_ECT_derate_actv "FPrm_severity(655)" VALUE 0x001E6AA4 /* @ECU_Address@FPrm_severity@0x024B328F@ */ ECIPP_ALIGNMENT_UBYTE 255 Compu_IDENTITY 0 255 PHYS_UNIT "Severity+Class" /end CHARACTERISTIC
/begin CHARACTERISTIC FPsvr_ECT_dT_max "FPrm_severity(677)" VALUE 0x001E6ABA /* @ECU_Address@FPrm_severity@0x024B32A5@ */ ECIPP_ALIGNMENT_UBYTE 255 Compu_IDENTITY 0 255 PHYS_UNIT "Severity+Class" /end CHARACTERISTIC
/begin CHARACTERISTIC FPsvr_ECT_EGRT_dT_max "FPrm_severity(670)" VALUE 0x001E6AB3 /* @ECU_Address@FPrm_severity@0x024B329E@ */ ECIPP_ALIGNMENT_UBYTE 255 Compu_IDENTITY 0 255 PHYS_UNIT "Severity+Class" /end CHARACTERISTIC
/begin CHARACTERISTIC FPsvr_ECT_EGT_dT_max "FPrm_severity(673)" VALUE 0x001E6AB6 /* @ECU_Address@FPrm_severity@0x024B32A1@ */ ECIPP_ALIGNMENT_UBYTE 255 Compu_IDENTITY 0 255 PHYS_UNIT "Severity+Class" /end CHARACTERISTIC
/begin CHARACTERISTIC FPsvr_ECT_FT_dT_max "FPrm_severity(671)" VALUE 0x001E6AB4 /* @ECU_Address@FPrm_severity@0x024B329F@ */ ECIPP_ALIGNMENT_UBYTE 255 Compu_IDENTITY 0 255 PHYS_UNIT "Severity+Class" /end CHARACTERISTIC
/begin CHARACTERISTIC FPsvr_ECT_HiExp "FPrm_severity(4)" VALUE 0x001E6819 /* @ECU_Address@FPrm_severity@0x024B3004@ */ ECIPP_ALIGNMENT_UBYTE 255 Compu_IDENTITY 0 255 PHYS_UNIT "Severity+Class" /end CHARACTERISTIC
/begin CHARACTERISTIC FPsvr_ECT_HiExp2 "FPrm_severity(5)" VALUE 0x001E681A /* @ECU_Address@FPrm_severity@0x024B3005@ */ ECIPP_ALIGNMENT_UBYTE 255 Compu_IDENTITY 0 255 PHYS_UNIT "Severity+Class" /end CHARACTERISTIC
/begin CHARACTERISTIC FPsvr_ECT_IAT_dT_max "FPrm_severity(668)" VALUE 0x001E6AB1 /* @ECU_Address@FPrm_severity@0x024B329C@ */ ECIPP_ALIGNMENT_UBYTE 255 Compu_IDENTITY 0 255 PHYS_UNIT "Severity+Class" /end CHARACTERISTIC
/begin CHARACTERISTIC FPsvr_ECT_LoExp "FPrm_severity(478)" VALUE 0x001E69F3 /* @ECU_Address@FPrm_severity@0x024B31DE@ */ ECIPP_ALIGNMENT_UBYTE 255 Compu_IDENTITY 0 255 PHYS_UNIT "Severity+Class" /end CHARACTERISTIC
/begin CHARACTERISTIC FPsvr_ECT_LoExp2 "FPrm_severity(479)" VALUE 0x001E69F4 /* @ECU_Address@FPrm_severity@0x024B31DF@ */ ECIPP_ALIGNMENT_UBYTE 255 Compu_IDENTITY 0 255 PHYS_UNIT "Severity+Class" /end CHARACTERISTIC
/begin CHARACTERISTIC FPsvr_ECT_maxv "FPrm_severity(2)" VALUE 0x001E6817 /* @ECU_Address@FPrm_severity@0x024B3002@ */ ECIPP_ALIGNMENT_UBYTE 255 Compu_IDENTITY 0 255 PHYS_UNIT "Severity+Class" /end CHARACTERISTIC
/begin CHARACTERISTIC FPsvr_ECT_minv "FPrm_severity(3)" VALUE 0x001E6818 /* @ECU_Address@FPrm_severity@0x024B3003@ */ ECIPP_ALIGNMENT_UBYTE 255 Compu_IDENTITY 0 255 PHYS_UNIT "Severity+Class" /end CHARACTERISTIC
/begin CHARACTERISTIC FPsvr_ECT_OILT_dT_max "FPrm_severity(672)" VALUE 0x001E6AB5 /* @ECU_Address@FPrm_severity@0x024B32A0@ */ ECIPP_ALIGNMENT_UBYTE 255 Compu_IDENTITY 0 255 PHYS_UNIT "Severity+Class" /end CHARACTERISTIC
/begin CHARACTERISTIC FPsvr_ECT_TAUX_dT1_max "FPrm_severity(675)" VALUE 0x001E6AB8 /* @ECU_Address@FPrm_severity@0x024B32A3@ */ ECIPP_ALIGNMENT_UBYTE 255 Compu_IDENTITY 0 255 PHYS_UNIT "Severity+Class" /end CHARACTERISTIC
/begin CHARACTERISTIC FPsvr_ECT_TAUX_dT2_max "FPrm_severity(676)" VALUE 0x001E6AB9 /* @ECU_Address@FPrm_severity@0x024B32A4@ */ ECIPP_ALIGNMENT_UBYTE 255 Compu_IDENTITY 0 255 PHYS_UNIT "Severity+Class" /end CHARACTERISTIC
/begin CHARACTERISTIC FPsvr_ECT_TIAT_dT_max "FPrm_severity(674)" VALUE 0x001E6AB7 /* @ECU_Address@FPrm_severity@0x024B32A2@ */ ECIPP_ALIGNMENT_UBYTE 255 Compu_IDENTITY 0 255 PHYS_UNIT "Severity+Class" /end CHARACTERISTIC
/begin CHARACTERISTIC FPsvr_EGO1_open "FPrm_severity(71)" VALUE 0x001E685C /* @ECU_Address@FPrm_severity@0x024B3047@ */ ECIPP_ALIGNMENT_UBYTE 255 Compu_IDENTITY 0 255 PHYS_UNIT "Severity+Class" /end CHARACTERISTIC
/begin CHARACTERISTIC FPsvr_EGO2_open "FPrm_severity(100)" VALUE 0x001E6879 /* @ECU_Address@FPrm_severity@0x024B3064@ */ ECIPP_ALIGNMENT_UBYTE 255 Compu_IDENTITY 0 255 PHYS_UNIT "Severity+Class" /end CHARACTERISTIC
/begin CHARACTERISTIC FPsvr_EGO3_open "FPrm_severity(72)" VALUE 0x001E685D /* @ECU_Address@FPrm_severity@0x024B3048@ */ ECIPP_ALIGNMENT_UBYTE 255 Compu_IDENTITY 0 255 PHYS_UNIT "Severity+Class" /end CHARACTERISTIC
/begin CHARACTERISTIC FPsvr_EGOH1_off_open "FPrm_severity(230)" VALUE 0x001E68FB /* @ECU_Address@FPrm_severity@0x024B30E6@ */ ECIPP_ALIGNMENT_UBYTE 255 Compu_IDENTITY 0 255 PHYS_UNIT "Severity+Class" /end CHARACTERISTIC
/begin CHARACTERISTIC FPsvr_EGOH1_on_short "FPrm_severity(231)" VALUE 0x001E68FC /* @ECU_Address@FPrm_severity@0x024B30E7@ */ ECIPP_ALIGNMENT_UBYTE 255 Compu_IDENTITY 0 255 PHYS_UNIT "Severity+Class" /end CHARACTERISTIC
/begin CHARACTERISTIC FPsvr_EGOH2_off_open "FPrm_severity(232)" VALUE 0x001E68FD /* @ECU_Address@FPrm_severity@0x024B30E8@ */ ECIPP_ALIGNMENT_UBYTE 255 Compu_IDENTITY 0 255 PHYS_UNIT "Severity+Class" /end CHARACTERISTIC
/begin CHARACTERISTIC FPsvr_EGOH2_on_short "FPrm_severity(233)" VALUE 0x001E68FE /* @ECU_Address@FPrm_severity@0x024B30E9@ */ ECIPP_ALIGNMENT_UBYTE 255 Compu_IDENTITY 0 255 PHYS_UNIT "Severity+Class" /end CHARACTERISTIC
/begin CHARACTERISTIC FPsvr_EGOH3_off_open "FPrm_severity(234)" VALUE 0x001E68FF /* @ECU_Address@FPrm_severity@0x024B30EA@ */ ECIPP_ALIGNMENT_UBYTE 255 Compu_IDENTITY 0 255 PHYS_UNIT "Severity+Class" /end CHARACTERISTIC
/begin CHARACTERISTIC FPsvr_EGOH3_on_short "FPrm_severity(235)" VALUE 0x001E6900 /* @ECU_Address@FPrm_severity@0x024B30EB@ */ ECIPP_ALIGNMENT_UBYTE 255 Compu_IDENTITY 0 255 PHYS_UNIT "Severity+Class" /end CHARACTERISTIC
/begin CHARACTERISTIC FPsvr_EGOH4_off_open "FPrm_severity(236)" VALUE 0x001E6901 /* @ECU_Address@FPrm_severity@0x024B30EC@ */ ECIPP_ALIGNMENT_UBYTE 255 Compu_IDENTITY 0 255 PHYS_UNIT "Severity+Class" /end CHARACTERISTIC
/begin CHARACTERISTIC FPsvr_EGOH4_on_short "FPrm_severity(237)" VALUE 0x001E6902 /* @ECU_Address@FPrm_severity@0x024B30ED@ */ ECIPP_ALIGNMENT_UBYTE 255 Compu_IDENTITY 0 255 PHYS_UNIT "Severity+Class" /end CHARACTERISTIC
/begin CHARACTERISTIC FPsvr_EGR_clr_eta_lo "FPrm_severity(496)" VALUE 0x001E6A05 /* @ECU_Address@FPrm_severity@0x024B31F0@ */ ECIPP_ALIGNMENT_UBYTE 255 Compu_IDENTITY 0 255 PHYS_UNIT "Severity+Class" /end CHARACTERISTIC
/begin CHARACTERISTIC FPsvr_EGR_clr_eta_lo2 "FPrm_severity(515)" VALUE 0x001E6A18 /* @ECU_Address@FPrm_severity@0x024B3203@ */ ECIPP_ALIGNMENT_UBYTE 255 Compu_IDENTITY 0 255 PHYS_UNIT "Severity+Class" /end CHARACTERISTIC
/begin CHARACTERISTIC FPsvr_EGR_deice_excess "FPrm_severity(656)" VALUE 0x001E6AA5 /* @ECU_Address@FPrm_severity@0x024B3290@ */ ECIPP_ALIGNMENT_UBYTE 255 Compu_IDENTITY 0 255 PHYS_UNIT "Severity+Class" /end CHARACTERISTIC
/begin CHARACTERISTIC FPsvr_EGR_offmin_excess "FPrm_severity(495)" VALUE 0x001E6A04 /* @ECU_Address@FPrm_severity@0x024B31EF@ */ ECIPP_ALIGNMENT_UBYTE 255 Compu_IDENTITY 0 255 PHYS_UNIT "Severity+Class" /end CHARACTERISTIC
/begin CHARACTERISTIC FPsvr_EGR_OOA_hi "FPrm_severity(491)" VALUE 0x001E6A00 /* @ECU_Address@FPrm_severity@0x024B31EB@ */ ECIPP_ALIGNMENT_UBYTE 255 Compu_IDENTITY 0 255 PHYS_UNIT "Severity+Class" /end CHARACTERISTIC
/begin CHARACTERISTIC FPsvr_EGR_OOA_lo "FPrm_severity(492)" VALUE 0x001E6A01 /* @ECU_Address@FPrm_severity@0x024B31EC@ */ ECIPP_ALIGNMENT_UBYTE 255 Compu_IDENTITY 0 255 PHYS_UNIT "Severity+Class" /end CHARACTERISTIC
/begin CHARACTERISTIC FPsvr_EGR_slowdec "FPrm_severity(490)" VALUE 0x001E69FF /* @ECU_Address@FPrm_severity@0x024B31EA@ */ ECIPP_ALIGNMENT_UBYTE 255 Compu_IDENTITY 0 255 PHYS_UNIT "Severity+Class" /end CHARACTERISTIC
/begin CHARACTERISTIC FPsvr_EGR_slowinc "FPrm_severity(489)" VALUE 0x001E69FE /* @ECU_Address@FPrm_severity@0x024B31E9@ */ ECIPP_ALIGNMENT_UBYTE 255 Compu_IDENTITY 0 255 PHYS_UNIT "Severity+Class" /end CHARACTERISTIC
/begin CHARACTERISTIC FPsvr_EGR_UEGOdP_hi "FPrm_severity(493)" VALUE 0x001E6A02 /* @ECU_Address@FPrm_severity@0x024B31ED@ */ ECIPP_ALIGNMENT_UBYTE 255 Compu_IDENTITY 0 255 PHYS_UNIT "Severity+Class" /end CHARACTERISTIC
/begin CHARACTERISTIC FPsvr_EGR_UEGOdP_lo "FPrm_severity(494)" VALUE 0x001E6A03 /* @ECU_Address@FPrm_severity@0x024B31EE@ */ ECIPP_ALIGNMENT_UBYTE 255 Compu_IDENTITY 0 255 PHYS_UNIT "Severity+Class" /end CHARACTERISTIC
/begin CHARACTERISTIC FPsvr_EGR_vlv_DC_lim "FPrm_severity(573)" VALUE 0x001E6A52 /* @ECU_Address@FPrm_severity@0x024B323D@ */ ECIPP_ALIGNMENT_UBYTE 255 Compu_IDENTITY 0 255 PHYS_UNIT "Severity+Class" /end CHARACTERISTIC
/begin CHARACTERISTIC FPsvr_EGR_vlv_HP_discon "FPrm_severity(694)" VALUE 0x001E6ACB /* @ECU_Address@FPrm_severity@0x024B32B6@ */ ECIPP_ALIGNMENT_UBYTE 255 Compu_IDENTITY 0 255 PHYS_UNIT "Severity+Class" /end CHARACTERISTIC
/begin CHARACTERISTIC FPsvr_EGR_vlv_stuck "FPrm_severity(660)" VALUE 0x001E6AA9 /* @ECU_Address@FPrm_severity@0x024B3294@ */ ECIPP_ALIGNMENT_UBYTE 255 Compu_IDENTITY 0 255 PHYS_UNIT "Severity+Class" /end CHARACTERISTIC
/begin CHARACTERISTIC FPsvr_EGR_vlv_temp_hi "FPrm_severity(574)" VALUE 0x001E6A53 /* @ECU_Address@FPrm_severity@0x024B323E@ */ ECIPP_ALIGNMENT_UBYTE 255 Compu_IDENTITY 0 255 PHYS_UNIT "Severity+Class" /end CHARACTERISTIC
/begin CHARACTERISTIC FPsvr_EGR_vlvCAN_commlost "FPrm_severity(497)" VALUE 0x001E6A06 /* @ECU_Address@FPrm_severity@0x024B31F1@ */ ECIPP_ALIGNMENT_UBYTE 255 Compu_IDENTITY 0 255 PHYS_UNIT "Severity+Class" /end CHARACTERISTIC
/begin CHARACTERISTIC FPsvr_EGR_vlvCAN_lowfunc "FPrm_severity(499)" VALUE 0x001E6A08 /* @ECU_Address@FPrm_severity@0x024B31F3@ */ ECIPP_ALIGNMENT_UBYTE 255 Compu_IDENTITY 0 255 PHYS_UNIT "Severity+Class" /end CHARACTERISTIC
/begin CHARACTERISTIC FPsvr_EGR_vlvCAN_nofunc "FPrm_severity(498)" VALUE 0x001E6A07 /* @ECU_Address@FPrm_severity@0x024B31F2@ */ ECIPP_ALIGNMENT_UBYTE 255 Compu_IDENTITY 0 255 PHYS_UNIT "Severity+Class" /end CHARACTERISTIC
/begin CHARACTERISTIC FPsw_CL_phi_hi "FPrm_switches(507)" VALUE 0x001C73D0 /* @ECU_Address@FPrm_switches@0x021B93F6@ */ ECIPP_ALIGNMENT_UWORD 65535 Compu_IDENTITY 0 65535 PHYS_UNIT "Enable bits" /end CHARACTERISTIC
/begin CHARACTERISTIC FPsw_CL_phi_lo "FPrm_switches(508)" VALUE 0x001C73D2 /* @ECU_Address@FPrm_switches@0x021B93F8@ */ ECIPP_ALIGNMENT_UWORD 65535 Compu_IDENTITY 0 65535 PHYS_UNIT "Enable bits" /end CHARACTERISTIC
/begin CHARACTERISTIC FPsw_CLLP_hi "FPrm_switches(49)" VALUE 0x001C703C /* @ECU_Address@FPrm_switches@0x021B9062@ */ ECIPP_ALIGNMENT_UWORD 65535 Compu_IDENTITY 0 65535 PHYS_UNIT "Enable bits" /end CHARACTERISTIC
/begin CHARACTERISTIC FPsw_CLLP_lo "FPrm_switches(50)" VALUE 0x001C703E /* @ECU_Address@FPrm_switches@0x021B9064@ */ ECIPP_ALIGNMENT_UWORD 65535 Compu_IDENTITY 0 65535 PHYS_UNIT "Enable bits" /end CHARACTERISTIC
/begin CHARACTERISTIC FPsw_CLNG_hi "FPrm_switches(51)" VALUE 0x001C7040 /* @ECU_Address@FPrm_switches@0x021B9066@ */ ECIPP_ALIGNMENT_UWORD 65535 Compu_IDENTITY 0 65535 PHYS_UNIT "Enable bits" /end CHARACTERISTIC
/begin CHARACTERISTIC FPsw_CLNG_lo "FPrm_switches(52)" VALUE 0x001C7042 /* @ECU_Address@FPrm_switches@0x021B9068@ */ ECIPP_ALIGNMENT_UWORD 65535 Compu_IDENTITY 0 65535 PHYS_UNIT "Enable bits" /end CHARACTERISTIC
/begin CHARACTERISTIC FPsw_CM_unresp "FPrm_switches(629)" VALUE 0x001C74C4 /* @ECU_Address@FPrm_switches@0x021B94EA@ */ ECIPP_ALIGNMENT_UWORD 65535 Compu_IDENTITY 0 65535 PHYS_UNIT "Enable bits" /end CHARACTERISTIC
/begin CHARACTERISTIC FPsw_CMgsln_inact "FPrm_switches(89)" VALUE 0x001C708C /* @ECU_Address@FPrm_switches@0x021B90B2@ */ ECIPP_ALIGNMENT_UWORD 65535 Compu_IDENTITY 0 65535 PHYS_UNIT "Enable bits" /end CHARACTERISTIC
/begin CHARACTERISTIC FPsw_CMLP_inact "FPrm_switches(90)" VALUE 0x001C708E /* @ECU_Address@FPrm_switches@0x021B90B4@ */ ECIPP_ALIGNMENT_UWORD 65535 Compu_IDENTITY 0 65535 PHYS_UNIT "Enable bits" /end CHARACTERISTIC
/begin CHARACTERISTIC FPsw_CMNG_inact "FPrm_switches(91)" VALUE 0x001C7090 /* @ECU_Address@FPrm_switches@0x021B90B6@ */ ECIPP_ALIGNMENT_UWORD 65535 Compu_IDENTITY 0 65535 PHYS_UNIT "Enable bits" /end CHARACTERISTIC
/begin CHARACTERISTIC FPsw_COPfail "FPrm_switches(63)" VALUE 0x001C7058 /* @ECU_Address@FPrm_switches@0x021B907E@ */ ECIPP_ALIGNMENT_UWORD 65535 Compu_IDENTITY 0 65535 PHYS_UNIT "Enable bits" /end CHARACTERISTIC
/begin CHARACTERISTIC FPsw_COT_hi "FPrm_switches(487)" VALUE 0x001C73A8 /* @ECU_Address@FPrm_switches@0x021B93CE@ */ ECIPP_ALIGNMENT_UWORD 65535 Compu_IDENTITY 0 65535 PHYS_UNIT "Enable bits" /end CHARACTERISTIC
/begin CHARACTERISTIC FPsw_crkloss "FPrm_switches(112)" VALUE 0x001C70BA /* @ECU_Address@FPrm_switches@0x021B90E0@ */ ECIPP_ALIGNMENT_UWORD 65535 Compu_IDENTITY 0 65535 PHYS_UNIT "Enable bits" /end CHARACTERISTIC
/begin CHARACTERISTIC FPsw_crknever "FPrm_switches(62)" VALUE 0x001C7056 /* @ECU_Address@FPrm_switches@0x021B907C@ */ ECIPP_ALIGNMENT_UWORD 65535 Compu_IDENTITY 0 65535 PHYS_UNIT "Enable bits" /end CHARACTERISTIC
/begin CHARACTERISTIC FPsw_crknoise "FPrm_switches(61)" VALUE 0x001C7054 /* @ECU_Address@FPrm_switches@0x021B907A@ */ ECIPP_ALIGNMENT_UWORD 65535 Compu_IDENTITY 0 65535 PHYS_UNIT "Enable bits" /end CHARACTERISTIC
/begin CHARACTERISTIC FPsw_CVCS_discon "FPrm_switches(577)" VALUE 0x001C745C /* @ECU_Address@FPrm_switches@0x021B9482@ */ ECIPP_ALIGNMENT_UWORD 65535 Compu_IDENTITY 0 65535 PHYS_UNIT "Enable bits" /end CHARACTERISTIC
/begin CHARACTERISTIC FPsw_CVDS_discon "FPrm_switches(578)" VALUE 0x001C745E /* @ECU_Address@FPrm_switches@0x021B9484@ */ ECIPP_ALIGNMENT_UWORD 65535 Compu_IDENTITY 0 65535 PHYS_UNIT "Enable bits" /end CHARACTERISTIC
/begin CHARACTERISTIC FPsw_CVP1_hi "FPrm_switches(624)" VALUE 0x001C74BA /* @ECU_Address@FPrm_switches@0x021B94E0@ */ ECIPP_ALIGNMENT_UWORD 65535 Compu_IDENTITY 0 65535 PHYS_UNIT "Enable bits" /end CHARACTERISTIC
/begin CHARACTERISTIC FPsw_CVP1_lo "FPrm_switches(625)" VALUE 0x001C74BC /* @ECU_Address@FPrm_switches@0x021B94E2@ */ ECIPP_ALIGNMENT_UWORD 65535 Compu_IDENTITY 0 65535 PHYS_UNIT "Enable bits" /end CHARACTERISTIC
/begin CHARACTERISTIC FPsw_CVP2_hi "FPrm_switches(626)" VALUE 0x001C74BE /* @ECU_Address@FPrm_switches@0x021B94E4@ */ ECIPP_ALIGNMENT_UWORD 65535 Compu_IDENTITY 0 65535 PHYS_UNIT "Enable bits" /end CHARACTERISTIC
/begin CHARACTERISTIC FPsw_CVP2_lo "FPrm_switches(627)" VALUE 0x001C74C0 /* @ECU_Address@FPrm_switches@0x021B94E6@ */ ECIPP_ALIGNMENT_UWORD 65535 Compu_IDENTITY 0 65535 PHYS_UNIT "Enable bits" /end CHARACTERISTIC
/begin CHARACTERISTIC FPsw_DBW_I_max "FPrm_switches(397)" VALUE 0x001C72F4 /* @ECU_Address@FPrm_switches@0x021B931A@ */ ECIPP_ALIGNMENT_UWORD 65535 Compu_IDENTITY 0 65535 PHYS_UNIT "Enable bits" /end CHARACTERISTIC
/begin CHARACTERISTIC FPsw_ECam_maxerr "FPrm_switches(211)" VALUE 0x001C7180 /* @ECU_Address@FPrm_switches@0x021B91A6@ */ ECIPP_ALIGNMENT_UWORD 65535 Compu_IDENTITY 0 65535 PHYS_UNIT "Enable bits" /end CHARACTERISTIC
/begin CHARACTERISTIC FPsw_ECL_low "FPrm_switches(563)" VALUE 0x001C7440 /* @ECU_Address@FPrm_switches@0x021B9466@ */ ECIPP_ALIGNMENT_UWORD 65535 Compu_IDENTITY 0 65535 PHYS_UNIT "Enable bits" /end CHARACTERISTIC
/begin CHARACTERISTIC FPsw_ECP_hiP "FPrm_switches(720)" VALUE 0x001C757A /* @ECU_Address@FPrm_switches@0x021B95A0@ */ ECIPP_ALIGNMENT_UWORD 65535 Compu_IDENTITY 0 65535 PHYS_UNIT "Enable bits" /end CHARACTERISTIC
/begin CHARACTERISTIC FPsw_ECP_loP "FPrm_switches(719)" VALUE 0x001C7578 /* @ECU_Address@FPrm_switches@0x021B959E@ */ ECIPP_ALIGNMENT_UWORD 65535 Compu_IDENTITY 0 65535 PHYS_UNIT "Enable bits" /end CHARACTERISTIC
/begin CHARACTERISTIC FPsw_ECT_AAT_dT_max "FPrm_switches(669)" VALUE 0x001C7514 /* @ECU_Address@FPrm_switches@0x021B953A@ */ ECIPP_ALIGNMENT_UWORD 65535 Compu_IDENTITY 0 65535 PHYS_UNIT "Enable bits" /end CHARACTERISTIC
/begin CHARACTERISTIC FPsw_ECT_derate_actv "FPrm_switches(655)" VALUE 0x001C74F8 /* @ECU_Address@FPrm_switches@0x021B951E@ */ ECIPP_ALIGNMENT_UWORD 65535 Compu_IDENTITY 0 65535 PHYS_UNIT "Enable bits" /end CHARACTERISTIC
/begin CHARACTERISTIC FPsw_ECT_dT_max "FPrm_switches(677)" VALUE 0x001C7524 /* @ECU_Address@FPrm_switches@0x021B954A@ */ ECIPP_ALIGNMENT_UWORD 65535 Compu_IDENTITY 0 65535 PHYS_UNIT "Enable bits" /end CHARACTERISTIC
/begin CHARACTERISTIC FPsw_ECT_EGRT_dT_max "FPrm_switches(670)" VALUE 0x001C7516 /* @ECU_Address@FPrm_switches@0x021B953C@ */ ECIPP_ALIGNMENT_UWORD 65535 Compu_IDENTITY 0 65535 PHYS_UNIT "Enable bits" /end CHARACTERISTIC
/begin CHARACTERISTIC FPsw_ECT_EGT_dT_max "FPrm_switches(673)" VALUE 0x001C751C /* @ECU_Address@FPrm_switches@0x021B9542@ */ ECIPP_ALIGNMENT_UWORD 65535 Compu_IDENTITY 0 65535 PHYS_UNIT "Enable bits" /end CHARACTERISTIC
/begin CHARACTERISTIC FPsw_ECT_FT_dT_max "FPrm_switches(671)" VALUE 0x001C7518 /* @ECU_Address@FPrm_switches@0x021B953E@ */ ECIPP_ALIGNMENT_UWORD 65535 Compu_IDENTITY 0 65535 PHYS_UNIT "Enable bits" /end CHARACTERISTIC
/begin CHARACTERISTIC FPsw_ECT_HiExp "FPrm_switches(4)" VALUE 0x001C6FE2 /* @ECU_Address@FPrm_switches@0x021B9008@ */ ECIPP_ALIGNMENT_UWORD 65535 Compu_IDENTITY 0 65535 PHYS_UNIT "Enable bits" /end CHARACTERISTIC
/begin CHARACTERISTIC FPsw_ECT_HiExp2 "FPrm_switches(5)" VALUE 0x001C6FE4 /* @ECU_Address@FPrm_switches@0x021B900A@ */ ECIPP_ALIGNMENT_UWORD 65535 Compu_IDENTITY 0 65535 PHYS_UNIT "Enable bits" /end CHARACTERISTIC
/begin CHARACTERISTIC FPsw_ECT_IAT_dT_max "FPrm_switches(668)" VALUE 0x001C7512 /* @ECU_Address@FPrm_switches@0x021B9538@ */ ECIPP_ALIGNMENT_UWORD 65535 Compu_IDENTITY 0 65535 PHYS_UNIT "Enable bits" /end CHARACTERISTIC
/begin CHARACTERISTIC FPsw_ECT_LoExp "FPrm_switches(478)" VALUE 0x001C7396 /* @ECU_Address@FPrm_switches@0x021B93BC@ */ ECIPP_ALIGNMENT_UWORD 65535 Compu_IDENTITY 0 65535 PHYS_UNIT "Enable bits" /end CHARACTERISTIC
/begin CHARACTERISTIC FPsw_ECT_LoExp2 "FPrm_switches(479)" VALUE 0x001C7398 /* @ECU_Address@FPrm_switches@0x021B93BE@ */ ECIPP_ALIGNMENT_UWORD 65535 Compu_IDENTITY 0 65535 PHYS_UNIT "Enable bits" /end CHARACTERISTIC
/begin CHARACTERISTIC FPsw_ECT_maxv "FPrm_switches(2)" VALUE 0x001C6FDE /* @ECU_Address@FPrm_switches@0x021B9004@ */ ECIPP_ALIGNMENT_UWORD 65535 Compu_IDENTITY 0 65535 PHYS_UNIT "Enable bits" /end CHARACTERISTIC
/begin CHARACTERISTIC FPsw_ECT_minv "FPrm_switches(3)" VALUE 0x001C6FE0 /* @ECU_Address@FPrm_switches@0x021B9006@ */ ECIPP_ALIGNMENT_UWORD 65535 Compu_IDENTITY 0 65535 PHYS_UNIT "Enable bits" /end CHARACTERISTIC
/begin CHARACTERISTIC FPsw_ECT_OILT_dT_max "FPrm_switches(672)" VALUE 0x001C751A /* @ECU_Address@FPrm_switches@0x021B9540@ */ ECIPP_ALIGNMENT_UWORD 65535 Compu_IDENTITY 0 65535 PHYS_UNIT "Enable bits" /end CHARACTERISTIC
/begin CHARACTERISTIC FPsw_ECT_TAUX_dT1_max "FPrm_switches(675)" VALUE 0x001C7520 /* @ECU_Address@FPrm_switches@0x021B9546@ */ ECIPP_ALIGNMENT_UWORD 65535 Compu_IDENTITY 0 65535 PHYS_UNIT "Enable bits" /end CHARACTERISTIC
/begin CHARACTERISTIC FPsw_ECT_TAUX_dT2_max "FPrm_switches(676)" VALUE 0x001C7522 /* @ECU_Address@FPrm_switches@0x021B9548@ */ ECIPP_ALIGNMENT_UWORD 65535 Compu_IDENTITY 0 65535 PHYS_UNIT "Enable bits" /end CHARACTERISTIC
/begin CHARACTERISTIC FPsw_ECT_TIAT_dT_max "FPrm_switches(674)" VALUE 0x001C751E /* @ECU_Address@FPrm_switches@0x021B9544@ */ ECIPP_ALIGNMENT_UWORD 65535 Compu_IDENTITY 0 65535 PHYS_UNIT "Enable bits" /end CHARACTERISTIC
/begin CHARACTERISTIC FPsw_EGO1_open "FPrm_switches(71)" VALUE 0x001C7068 /* @ECU_Address@FPrm_switches@0x021B908E@ */ ECIPP_ALIGNMENT_UWORD 65535 Compu_IDENTITY 0 65535 PHYS_UNIT "Enable bits" /end CHARACTERISTIC
/begin CHARACTERISTIC FPsw_EGO2_open "FPrm_switches(100)" VALUE 0x001C70A2 /* @ECU_Address@FPrm_switches@0x021B90C8@ */ ECIPP_ALIGNMENT_UWORD 65535 Compu_IDENTITY 0 65535 PHYS_UNIT "Enable bits" /end CHARACTERISTIC
/begin CHARACTERISTIC FPsw_EGO3_open "FPrm_switches(72)" VALUE 0x001C706A /* @ECU_Address@FPrm_switches@0x021B9090@ */ ECIPP_ALIGNMENT_UWORD 65535 Compu_IDENTITY 0 65535 PHYS_UNIT "Enable bits" /end CHARACTERISTIC
/begin CHARACTERISTIC FPsw_EGOH1_off_open "FPrm_switches(230)" VALUE 0x001C71A6 /* @ECU_Address@FPrm_switches@0x021B91CC@ */ ECIPP_ALIGNMENT_UWORD 65535 Compu_IDENTITY 0 65535 PHYS_UNIT "Enable bits" /end CHARACTERISTIC
/begin CHARACTERISTIC FPsw_EGOH1_on_short "FPrm_switches(231)" VALUE 0x001C71A8 /* @ECU_Address@FPrm_switches@0x021B91CE@ */ ECIPP_ALIGNMENT_UWORD 65535 Compu_IDENTITY 0 65535 PHYS_UNIT "Enable bits" /end CHARACTERISTIC
/begin CHARACTERISTIC FPsw_EGOH2_off_open "FPrm_switches(232)" VALUE 0x001C71AA /* @ECU_Address@FPrm_switches@0x021B91D0@ */ ECIPP_ALIGNMENT_UWORD 65535 Compu_IDENTITY 0 65535 PHYS_UNIT "Enable bits" /end CHARACTERISTIC
/begin CHARACTERISTIC FPsw_EGOH2_on_short "FPrm_switches(233)" VALUE 0x001C71AC /* @ECU_Address@FPrm_switches@0x021B91D2@ */ ECIPP_ALIGNMENT_UWORD 65535 Compu_IDENTITY 0 65535 PHYS_UNIT "Enable bits" /end CHARACTERISTIC
/begin CHARACTERISTIC FPsw_EGOH3_off_open "FPrm_switches(234)" VALUE 0x001C71AE /* @ECU_Address@FPrm_switches@0x021B91D4@ */ ECIPP_ALIGNMENT_UWORD 65535 Compu_IDENTITY 0 65535 PHYS_UNIT "Enable bits" /end CHARACTERISTIC
/begin CHARACTERISTIC FPsw_EGOH3_on_short "FPrm_switches(235)" VALUE 0x001C71B0 /* @ECU_Address@FPrm_switches@0x021B91D6@ */ ECIPP_ALIGNMENT_UWORD 65535 Compu_IDENTITY 0 65535 PHYS_UNIT "Enable bits" /end CHARACTERISTIC
/begin CHARACTERISTIC FPsw_EGOH4_off_open "FPrm_switches(236)" VALUE 0x001C71B2 /* @ECU_Address@FPrm_switches@0x021B91D8@ */ ECIPP_ALIGNMENT_UWORD 65535 Compu_IDENTITY 0 65535 PHYS_UNIT "Enable bits" /end CHARACTERISTIC
/begin CHARACTERISTIC FPsw_EGOH4_on_short "FPrm_switches(237)" VALUE 0x001C71B4 /* @ECU_Address@FPrm_switches@0x021B91DA@ */ ECIPP_ALIGNMENT_UWORD 65535 Compu_IDENTITY 0 65535 PHYS_UNIT "Enable bits" /end CHARACTERISTIC
/begin CHARACTERISTIC FPsw_EGR_clr_eta_lo "FPrm_switches(496)" VALUE 0x001C73BA /* @ECU_Address@FPrm_switches@0x021B93E0@ */ ECIPP_ALIGNMENT_UWORD 65535 Compu_IDENTITY 0 65535 PHYS_UNIT "Enable bits" /end CHARACTERISTIC
/begin CHARACTERISTIC FPsw_EGR_clr_eta_lo2 "FPrm_switches(515)" VALUE 0x001C73E0 /* @ECU_Address@FPrm_switches@0x021B9406@ */ ECIPP_ALIGNMENT_UWORD 65535 Compu_IDENTITY 0 65535 PHYS_UNIT "Enable bits" /end CHARACTERISTIC
/begin CHARACTERISTIC FPsw_EGR_deice_excess "FPrm_switches(656)" VALUE 0x001C74FA /* @ECU_Address@FPrm_switches@0x021B9520@ */ ECIPP_ALIGNMENT_UWORD 65535 Compu_IDENTITY 0 65535 PHYS_UNIT "Enable bits" /end CHARACTERISTIC
/begin CHARACTERISTIC FPsw_EGR_offmin_excess "FPrm_switches(495)" VALUE 0x001C73B8 /* @ECU_Address@FPrm_switches@0x021B93DE@ */ ECIPP_ALIGNMENT_UWORD 65535 Compu_IDENTITY 0 65535 PHYS_UNIT "Enable bits" /end CHARACTERISTIC
/begin CHARACTERISTIC FPsw_EGR_OOA_hi "FPrm_switches(491)" VALUE 0x001C73B0 /* @ECU_Address@FPrm_switches@0x021B93D6@ */ ECIPP_ALIGNMENT_UWORD 65535 Compu_IDENTITY 0 65535 PHYS_UNIT "Enable bits" /end CHARACTERISTIC
/begin CHARACTERISTIC FPsw_EGR_OOA_lo "FPrm_switches(492)" VALUE 0x001C73B2 /* @ECU_Address@FPrm_switches@0x021B93D8@ */ ECIPP_ALIGNMENT_UWORD 65535 Compu_IDENTITY 0 65535 PHYS_UNIT "Enable bits" /end CHARACTERISTIC
/begin CHARACTERISTIC FPsw_EGR_slowdec "FPrm_switches(490)" VALUE 0x001C73AE /* @ECU_Address@FPrm_switches@0x021B93D4@ */ ECIPP_ALIGNMENT_UWORD 65535 Compu_IDENTITY 0 65535 PHYS_UNIT "Enable bits" /end CHARACTERISTIC
/begin CHARACTERISTIC FPsw_EGR_slowinc "FPrm_switches(489)" VALUE 0x001C73AC /* @ECU_Address@FPrm_switches@0x021B93D2@ */ ECIPP_ALIGNMENT_UWORD 65535 Compu_IDENTITY 0 65535 PHYS_UNIT "Enable bits" /end CHARACTERISTIC
/begin CHARACTERISTIC FPsw_EGR_UEGOdP_hi "FPrm_switches(493)" VALUE 0x001C73B4 /* @ECU_Address@FPrm_switches@0x021B93DA@ */ ECIPP_ALIGNMENT_UWORD 65535 Compu_IDENTITY 0 65535 PHYS_UNIT "Enable bits" /end CHARACTERISTIC
/begin CHARACTERISTIC FPsw_EGR_UEGOdP_lo "FPrm_switches(494)" VALUE 0x001C73B6 /* @ECU_Address@FPrm_switches@0x021B93DC@ */ ECIPP_ALIGNMENT_UWORD 65535 Compu_IDENTITY 0 65535 PHYS_UNIT "Enable bits" /end CHARACTERISTIC
/begin CHARACTERISTIC FPsw_EGR_vlv_DC_lim "FPrm_switches(573)" VALUE 0x001C7454 /* @ECU_Address@FPrm_switches@0x021B947A@ */ ECIPP_ALIGNMENT_UWORD 65535 Compu_IDENTITY 0 65535 PHYS_UNIT "Enable bits" /end CHARACTERISTIC
/begin CHARACTERISTIC FPsw_EGR_vlv_HP_discon "FPrm_switches(694)" VALUE 0x001C7546 /* @ECU_Address@FPrm_switches@0x021B956C@ */ ECIPP_ALIGNMENT_UWORD 65535 Compu_IDENTITY 0 65535 PHYS_UNIT "Enable bits" /end CHARACTERISTIC
/begin CHARACTERISTIC FPsw_EGR_vlv_stuck "FPrm_switches(660)" VALUE 0x001C7502 /* @ECU_Address@FPrm_switches@0x021B9528@ */ ECIPP_ALIGNMENT_UWORD 65535 Compu_IDENTITY 0 65535 PHYS_UNIT "Enable bits" /end CHARACTERISTIC
/begin CHARACTERISTIC FPsw_EGR_vlv_temp_hi "FPrm_switches(574)" VALUE 0x001C7456 /* @ECU_Address@FPrm_switches@0x021B947C@ */ ECIPP_ALIGNMENT_UWORD 65535 Compu_IDENTITY 0 65535 PHYS_UNIT "Enable bits" /end CHARACTERISTIC
/begin CHARACTERISTIC FPsw_EGR_vlvCAN_commlost "FPrm_switches(497)" VALUE 0x001C73BC /* @ECU_Address@FPrm_switches@0x021B93E2@ */ ECIPP_ALIGNMENT_UWORD 65535 Compu_IDENTITY 0 65535 PHYS_UNIT "Enable bits" /end CHARACTERISTIC
/begin CHARACTERISTIC FPsw_EGR_vlvCAN_lowfunc "FPrm_switches(499)" VALUE 0x001C73C0 /* @ECU_Address@FPrm_switches@0x021B93E6@ */ ECIPP_ALIGNMENT_UWORD 65535 Compu_IDENTITY 0 65535 PHYS_UNIT "Enable bits" /end CHARACTERISTIC
/begin CHARACTERISTIC FPsw_EGR_vlvCAN_nofunc "FPrm_switches(498)" VALUE 0x001C73BE /* @ECU_Address@FPrm_switches@0x021B93E4@ */ ECIPP_ALIGNMENT_UWORD 65535 Compu_IDENTITY 0 65535 PHYS_UNIT "Enable bits" /end CHARACTERISTIC
/begin CHARACTERISTIC FPsw_ext1_CL_phi_hi "FPrm_switches_ext1(507)" VALUE 0x001C7974 /* @ECU_Address@FPrm_switches_ext1@0x023A53F6@ */ ECIPP_ALIGNMENT_UWORD 65535 Compu_IDENTITY 0 65535 PHYS_UNIT "Enable bits" /end CHARACTERISTIC
/begin CHARACTERISTIC FPsw_ext1_CL_phi_lo "FPrm_switches_ext1(508)" VALUE 0x001C7976 /* @ECU_Address@FPrm_switches_ext1@0x023A53F8@ */ ECIPP_ALIGNMENT_UWORD 65535 Compu_IDENTITY 0 65535 PHYS_UNIT "Enable bits" /end CHARACTERISTIC
/begin CHARACTERISTIC FPsw_ext1_CLLP_hi "FPrm_switches_ext1(49)" VALUE 0x001C75E0 /* @ECU_Address@FPrm_switches_ext1@0x023A5062@ */ ECIPP_ALIGNMENT_UWORD 65535 Compu_IDENTITY 0 65535 PHYS_UNIT "Enable bits" /end CHARACTERISTIC
/begin CHARACTERISTIC FPsw_ext1_CLLP_lo "FPrm_switches_ext1(50)" VALUE 0x001C75E2 /* @ECU_Address@FPrm_switches_ext1@0x023A5064@ */ ECIPP_ALIGNMENT_UWORD 65535 Compu_IDENTITY 0 65535 PHYS_UNIT "Enable bits" /end CHARACTERISTIC
/begin CHARACTERISTIC FPsw_ext1_CLNG_hi "FPrm_switches_ext1(51)" VALUE 0x001C75E4 /* @ECU_Address@FPrm_switches_ext1@0x023A5066@ */ ECIPP_ALIGNMENT_UWORD 65535 Compu_IDENTITY 0 65535 PHYS_UNIT "Enable bits" /end CHARACTERISTIC
/begin CHARACTERISTIC FPsw_ext1_CLNG_lo "FPrm_switches_ext1(52)" VALUE 0x001C75E6 /* @ECU_Address@FPrm_switches_ext1@0x023A5068@ */ ECIPP_ALIGNMENT_UWORD 65535 Compu_IDENTITY 0 65535 PHYS_UNIT "Enable bits" /end CHARACTERISTIC
/begin CHARACTERISTIC FPsw_ext1_CM_unresp "FPrm_switches_ext1(629)" VALUE 0x001C7A68 /* @ECU_Address@FPrm_switches_ext1@0x023A54EA@ */ ECIPP_ALIGNMENT_UWORD 65535 Compu_IDENTITY 0 65535 PHYS_UNIT "Enable bits" /end CHARACTERISTIC
/begin CHARACTERISTIC FPsw_ext1_CMgsln_inact "FPrm_switches_ext1(89)" VALUE 0x001C7630 /* @ECU_Address@FPrm_switches_ext1@0x023A50B2@ */ ECIPP_ALIGNMENT_UWORD 65535 Compu_IDENTITY 0 65535 PHYS_UNIT "Enable bits" /end CHARACTERISTIC
/begin CHARACTERISTIC FPsw_ext1_CMLP_inact "FPrm_switches_ext1(90)" VALUE 0x001C7632 /* @ECU_Address@FPrm_switches_ext1@0x023A50B4@ */ ECIPP_ALIGNMENT_UWORD 65535 Compu_IDENTITY 0 65535 PHYS_UNIT "Enable bits" /end CHARACTERISTIC
/begin CHARACTERISTIC FPsw_ext1_CMNG_inact "FPrm_switches_ext1(91)" VALUE 0x001C7634 /* @ECU_Address@FPrm_switches_ext1@0x023A50B6@ */ ECIPP_ALIGNMENT_UWORD 65535 Compu_IDENTITY 0 65535 PHYS_UNIT "Enable bits" /end CHARACTERISTIC
/begin CHARACTERISTIC FPsw_ext1_COPfail "FPrm_switches_ext1(63)" VALUE 0x001C75FC /* @ECU_Address@FPrm_switches_ext1@0x023A507E@ */ ECIPP_ALIGNMENT_UWORD 65535 Compu_IDENTITY 0 65535 PHYS_UNIT "Enable bits" /end CHARACTERISTIC
/begin CHARACTERISTIC FPsw_ext1_COT_hi "FPrm_switches_ext1(487)" VALUE 0x001C794C /* @ECU_Address@FPrm_switches_ext1@0x023A53CE@ */ ECIPP_ALIGNMENT_UWORD 65535 Compu_IDENTITY 0 65535 PHYS_UNIT "Enable bits" /end CHARACTERISTIC
/begin CHARACTERISTIC FPsw_ext1_crkloss "FPrm_switches_ext1(112)" VALUE 0x001C765E /* @ECU_Address@FPrm_switches_ext1@0x023A50E0@ */ ECIPP_ALIGNMENT_UWORD 65535 Compu_IDENTITY 0 65535 PHYS_UNIT "Enable bits" /end CHARACTERISTIC
/begin CHARACTERISTIC FPsw_ext1_crknever "FPrm_switches_ext1(62)" VALUE 0x001C75FA /* @ECU_Address@FPrm_switches_ext1@0x023A507C@ */ ECIPP_ALIGNMENT_UWORD 65535 Compu_IDENTITY 0 65535 PHYS_UNIT "Enable bits" /end CHARACTERISTIC
/begin CHARACTERISTIC FPsw_ext1_crknoise "FPrm_switches_ext1(61)" VALUE 0x001C75F8 /* @ECU_Address@FPrm_switches_ext1@0x023A507A@ */ ECIPP_ALIGNMENT_UWORD 65535 Compu_IDENTITY 0 65535 PHYS_UNIT "Enable bits" /end CHARACTERISTIC
/begin CHARACTERISTIC FPsw_ext1_CVCS_discon "FPrm_switches_ext1(577)" VALUE 0x001C7A00 /* @ECU_Address@FPrm_switches_ext1@0x023A5482@ */ ECIPP_ALIGNMENT_UWORD 65535 Compu_IDENTITY 0 65535 PHYS_UNIT "Enable bits" /end CHARACTERISTIC
/begin CHARACTERISTIC FPsw_ext1_CVDS_discon "FPrm_switches_ext1(578)" VALUE 0x001C7A02 /* @ECU_Address@FPrm_switches_ext1@0x023A5484@ */ ECIPP_ALIGNMENT_UWORD 65535 Compu_IDENTITY 0 65535 PHYS_UNIT "Enable bits" /end CHARACTERISTIC
/begin CHARACTERISTIC FPsw_ext1_CVP1_hi "FPrm_switches_ext1(624)" VALUE 0x001C7A5E /* @ECU_Address@FPrm_switches_ext1@0x023A54E0@ */ ECIPP_ALIGNMENT_UWORD 65535 Compu_IDENTITY 0 65535 PHYS_UNIT "Enable bits" /end CHARACTERISTIC
/begin CHARACTERISTIC FPsw_ext1_CVP1_lo "FPrm_switches_ext1(625)" VALUE 0x001C7A60 /* @ECU_Address@FPrm_switches_ext1@0x023A54E2@ */ ECIPP_ALIGNMENT_UWORD 65535 Compu_IDENTITY 0 65535 PHYS_UNIT "Enable bits" /end CHARACTERISTIC
/begin CHARACTERISTIC FPsw_ext1_CVP2_hi "FPrm_switches_ext1(626)" VALUE 0x001C7A62 /* @ECU_Address@FPrm_switches_ext1@0x023A54E4@ */ ECIPP_ALIGNMENT_UWORD 65535 Compu_IDENTITY 0 65535 PHYS_UNIT "Enable bits" /end CHARACTERISTIC
/begin CHARACTERISTIC FPsw_ext1_CVP2_lo "FPrm_switches_ext1(627)" VALUE 0x001C7A64 /* @ECU_Address@FPrm_switches_ext1@0x023A54E6@ */ ECIPP_ALIGNMENT_UWORD 65535 Compu_IDENTITY 0 65535 PHYS_UNIT "Enable bits" /end CHARACTERISTIC
/begin CHARACTERISTIC FPsw_ext1_DBW_I_max "FPrm_switches_ext1(397)" VALUE 0x001C7898 /* @ECU_Address@FPrm_switches_ext1@0x023A531A@ */ ECIPP_ALIGNMENT_UWORD 65535 Compu_IDENTITY 0 65535 PHYS_UNIT "Enable bits" /end CHARACTERISTIC
/begin CHARACTERISTIC FPsw_ext1_ECam_maxerr "FPrm_switches_ext1(211)" VALUE 0x001C7724 /* @ECU_Address@FPrm_switches_ext1@0x023A51A6@ */ ECIPP_ALIGNMENT_UWORD 65535 Compu_IDENTITY 0 65535 PHYS_UNIT "Enable bits" /end CHARACTERISTIC
/begin CHARACTERISTIC FPsw_ext1_ECL_low "FPrm_switches_ext1(563)" VALUE 0x001C79E4 /* @ECU_Address@FPrm_switches_ext1@0x023A5466@ */ ECIPP_ALIGNMENT_UWORD 65535 Compu_IDENTITY 0 65535 PHYS_UNIT "Enable bits" /end CHARACTERISTIC
/begin CHARACTERISTIC FPsw_ext1_ECP_hiP "FPrm_switches_ext1(720)" VALUE 0x001C7B1E /* @ECU_Address@FPrm_switches_ext1@0x023A55A0@ */ ECIPP_ALIGNMENT_UWORD 65535 Compu_IDENTITY 0 65535 PHYS_UNIT "Enable bits" /end CHARACTERISTIC
/begin CHARACTERISTIC FPsw_ext1_ECP_loP "FPrm_switches_ext1(719)" VALUE 0x001C7B1C /* @ECU_Address@FPrm_switches_ext1@0x023A559E@ */ ECIPP_ALIGNMENT_UWORD 65535 Compu_IDENTITY 0 65535 PHYS_UNIT "Enable bits" /end CHARACTERISTIC
/begin CHARACTERISTIC FPsw_ext1_ECT_AAT_dT_max "FPrm_switches_ext1(669)" VALUE 0x001C7AB8 /* @ECU_Address@FPrm_switches_ext1@0x023A553A@ */ ECIPP_ALIGNMENT_UWORD 65535 Compu_IDENTITY 0 65535 PHYS_UNIT "Enable bits" /end CHARACTERISTIC
/begin CHARACTERISTIC FPsw_ext1_ECT_derate_actv "FPrm_switches_ext1(655)" VALUE 0x001C7A9C /* @ECU_Address@FPrm_switches_ext1@0x023A551E@ */ ECIPP_ALIGNMENT_UWORD 65535 Compu_IDENTITY 0 65535 PHYS_UNIT "Enable bits" /end CHARACTERISTIC
/begin CHARACTERISTIC FPsw_ext1_ECT_dT_max "FPrm_switches_ext1(677)" VALUE 0x001C7AC8 /* @ECU_Address@FPrm_switches_ext1@0x023A554A@ */ ECIPP_ALIGNMENT_UWORD 65535 Compu_IDENTITY 0 65535 PHYS_UNIT "Enable bits" /end CHARACTERISTIC
/begin CHARACTERISTIC FPsw_ext1_ECT_EGRT_dT_max "FPrm_switches_ext1(670)" VALUE 0x001C7ABA /* @ECU_Address@FPrm_switches_ext1@0x023A553C@ */ ECIPP_ALIGNMENT_UWORD 65535 Compu_IDENTITY 0 65535 PHYS_UNIT "Enable bits" /end CHARACTERISTIC
/begin CHARACTERISTIC FPsw_ext1_ECT_EGT_dT_max "FPrm_switches_ext1(673)" VALUE 0x001C7AC0 /* @ECU_Address@FPrm_switches_ext1@0x023A5542@ */ ECIPP_ALIGNMENT_UWORD 65535 Compu_IDENTITY 0 65535 PHYS_UNIT "Enable bits" /end CHARACTERISTIC
/begin CHARACTERISTIC FPsw_ext1_ECT_FT_dT_max "FPrm_switches_ext1(671)" VALUE 0x001C7ABC /* @ECU_Address@FPrm_switches_ext1@0x023A553E@ */ ECIPP_ALIGNMENT_UWORD 65535 Compu_IDENTITY 0 65535 PHYS_UNIT "Enable bits" /end CHARACTERISTIC
/begin CHARACTERISTIC FPsw_ext1_ECT_HiExp "FPrm_switches_ext1(4)" VALUE 0x001C7586 /* @ECU_Address@FPrm_switches_ext1@0x023A5008@ */ ECIPP_ALIGNMENT_UWORD 65535 Compu_IDENTITY 0 65535 PHYS_UNIT "Enable bits" /end CHARACTERISTIC
/begin CHARACTERISTIC FPsw_ext1_ECT_HiExp2 "FPrm_switches_ext1(5)" VALUE 0x001C7588 /* @ECU_Address@FPrm_switches_ext1@0x023A500A@ */ ECIPP_ALIGNMENT_UWORD 65535 Compu_IDENTITY 0 65535 PHYS_UNIT "Enable bits" /end CHARACTERISTIC
/begin CHARACTERISTIC FPsw_ext1_ECT_IAT_dT_max "FPrm_switches_ext1(668)" VALUE 0x001C7AB6 /* @ECU_Address@FPrm_switches_ext1@0x023A5538@ */ ECIPP_ALIGNMENT_UWORD 65535 Compu_IDENTITY 0 65535 PHYS_UNIT "Enable bits" /end CHARACTERISTIC
/begin CHARACTERISTIC FPsw_ext1_ECT_LoExp "FPrm_switches_ext1(478)" VALUE 0x001C793A /* @ECU_Address@FPrm_switches_ext1@0x023A53BC@ */ ECIPP_ALIGNMENT_UWORD 65535 Compu_IDENTITY 0 65535 PHYS_UNIT "Enable bits" /end CHARACTERISTIC
/begin CHARACTERISTIC FPsw_ext1_ECT_LoExp2 "FPrm_switches_ext1(479)" VALUE 0x001C793C /* @ECU_Address@FPrm_switches_ext1@0x023A53BE@ */ ECIPP_ALIGNMENT_UWORD 65535 Compu_IDENTITY 0 65535 PHYS_UNIT "Enable bits" /end CHARACTERISTIC
/begin CHARACTERISTIC FPsw_ext1_ECT_maxv "FPrm_switches_ext1(2)" VALUE 0x001C7582 /* @ECU_Address@FPrm_switches_ext1@0x023A5004@ */ ECIPP_ALIGNMENT_UWORD 65535 Compu_IDENTITY 0 65535 PHYS_UNIT "Enable bits" /end CHARACTERISTIC
/begin CHARACTERISTIC FPsw_ext1_ECT_minv "FPrm_switches_ext1(3)" VALUE 0x001C7584 /* @ECU_Address@FPrm_switches_ext1@0x023A5006@ */ ECIPP_ALIGNMENT_UWORD 65535 Compu_IDENTITY 0 65535 PHYS_UNIT "Enable bits" /end CHARACTERISTIC
/begin CHARACTERISTIC FPsw_ext1_ECT_OILT_dT_max "FPrm_switches_ext1(672)" VALUE 0x001C7ABE /* @ECU_Address@FPrm_switches_ext1@0x023A5540@ */ ECIPP_ALIGNMENT_UWORD 65535 Compu_IDENTITY 0 65535 PHYS_UNIT "Enable bits" /end CHARACTERISTIC
/begin CHARACTERISTIC FPsw_ext1_ECT_TAUX_dT1_max "FPrm_switches_ext1(675)" VALUE 0x001C7AC4 /* @ECU_Address@FPrm_switches_ext1@0x023A5546@ */ ECIPP_ALIGNMENT_UWORD 65535 Compu_IDENTITY 0 65535 PHYS_UNIT "Enable bits" /end CHARACTERISTIC
/begin CHARACTERISTIC FPsw_ext1_ECT_TAUX_dT2_max "FPrm_switches_ext1(676)" VALUE 0x001C7AC6 /* @ECU_Address@FPrm_switches_ext1@0x023A5548@ */ ECIPP_ALIGNMENT_UWORD 65535 Compu_IDENTITY 0 65535 PHYS_UNIT "Enable bits" /end CHARACTERISTIC
/begin CHARACTERISTIC FPsw_ext1_ECT_TIAT_dT_max "FPrm_switches_ext1(674)" VALUE 0x001C7AC2 /* @ECU_Address@FPrm_switches_ext1@0x023A5544@ */ ECIPP_ALIGNMENT_UWORD 65535 Compu_IDENTITY 0 65535 PHYS_UNIT "Enable bits" /end CHARACTERISTIC
/begin CHARACTERISTIC FPsw_ext1_EGO1_open "FPrm_switches_ext1(71)" VALUE 0x001C760C /* @ECU_Address@FPrm_switches_ext1@0x023A508E@ */ ECIPP_ALIGNMENT_UWORD 65535 Compu_IDENTITY 0 65535 PHYS_UNIT "Enable bits" /end CHARACTERISTIC
/begin CHARACTERISTIC FPsw_ext1_EGO2_open "FPrm_switches_ext1(100)" VALUE 0x001C7646 /* @ECU_Address@FPrm_switches_ext1@0x023A50C8@ */ ECIPP_ALIGNMENT_UWORD 65535 Compu_IDENTITY 0 65535 PHYS_UNIT "Enable bits" /end CHARACTERISTIC
/begin CHARACTERISTIC FPsw_ext1_EGO3_open "FPrm_switches_ext1(72)" VALUE 0x001C760E /* @ECU_Address@FPrm_switches_ext1@0x023A5090@ */ ECIPP_ALIGNMENT_UWORD 65535 Compu_IDENTITY 0 65535 PHYS_UNIT "Enable bits" /end CHARACTERISTIC
/begin CHARACTERISTIC FPsw_ext1_EGOH1_off_open "FPrm_switches_ext1(230)" VALUE 0x001C774A /* @ECU_Address@FPrm_switches_ext1@0x023A51CC@ */ ECIPP_ALIGNMENT_UWORD 65535 Compu_IDENTITY 0 65535 PHYS_UNIT "Enable bits" /end CHARACTERISTIC
/begin CHARACTERISTIC FPsw_ext1_EGOH1_on_short "FPrm_switches_ext1(231)" VALUE 0x001C774C /* @ECU_Address@FPrm_switches_ext1@0x023A51CE@ */ ECIPP_ALIGNMENT_UWORD 65535 Compu_IDENTITY 0 65535 PHYS_UNIT "Enable bits" /end CHARACTERISTIC
/begin CHARACTERISTIC FPsw_ext1_EGOH2_off_open "FPrm_switches_ext1(232)" VALUE 0x001C774E /* @ECU_Address@FPrm_switches_ext1@0x023A51D0@ */ ECIPP_ALIGNMENT_UWORD 65535 Compu_IDENTITY 0 65535 PHYS_UNIT "Enable bits" /end CHARACTERISTIC
/begin CHARACTERISTIC FPsw_ext1_EGOH2_on_short "FPrm_switches_ext1(233)" VALUE 0x001C7750 /* @ECU_Address@FPrm_switches_ext1@0x023A51D2@ */ ECIPP_ALIGNMENT_UWORD 65535 Compu_IDENTITY 0 65535 PHYS_UNIT "Enable bits" /end CHARACTERISTIC
/begin CHARACTERISTIC FPsw_ext1_EGOH3_off_open "FPrm_switches_ext1(234)" VALUE 0x001C7752 /* @ECU_Address@FPrm_switches_ext1@0x023A51D4@ */ ECIPP_ALIGNMENT_UWORD 65535 Compu_IDENTITY 0 65535 PHYS_UNIT "Enable bits" /end CHARACTERISTIC
/begin CHARACTERISTIC FPsw_ext1_EGOH3_on_short "FPrm_switches_ext1(235)" VALUE 0x001C7754 /* @ECU_Address@FPrm_switches_ext1@0x023A51D6@ */ ECIPP_ALIGNMENT_UWORD 65535 Compu_IDENTITY 0 65535 PHYS_UNIT "Enable bits" /end CHARACTERISTIC
/begin CHARACTERISTIC FPsw_ext1_EGOH4_off_open "FPrm_switches_ext1(236)" VALUE 0x001C7756 /* @ECU_Address@FPrm_switches_ext1@0x023A51D8@ */ ECIPP_ALIGNMENT_UWORD 65535 Compu_IDENTITY 0 65535 PHYS_UNIT "Enable bits" /end CHARACTERISTIC
/begin CHARACTERISTIC FPsw_ext1_EGOH4_on_short "FPrm_switches_ext1(237)" VALUE 0x001C7758 /* @ECU_Address@FPrm_switches_ext1@0x023A51DA@ */ ECIPP_ALIGNMENT_UWORD 65535 Compu_IDENTITY 0 65535 PHYS_UNIT "Enable bits" /end CHARACTERISTIC
/begin CHARACTERISTIC FPsw_ext1_EGR_clr_eta_lo "FPrm_switches_ext1(496)" VALUE 0x001C795E /* @ECU_Address@FPrm_switches_ext1@0x023A53E0@ */ ECIPP_ALIGNMENT_UWORD 65535 Compu_IDENTITY 0 65535 PHYS_UNIT "Enable bits" /end CHARACTERISTIC
/begin CHARACTERISTIC FPsw_ext1_EGR_clr_eta_lo2 "FPrm_switches_ext1(515)" VALUE 0x001C7984 /* @ECU_Address@FPrm_switches_ext1@0x023A5406@ */ ECIPP_ALIGNMENT_UWORD 65535 Compu_IDENTITY 0 65535 PHYS_UNIT "Enable bits" /end CHARACTERISTIC
/begin CHARACTERISTIC FPsw_ext1_EGR_deice_excess "FPrm_switches_ext1(656)" VALUE 0x001C7A9E /* @ECU_Address@FPrm_switches_ext1@0x023A5520@ */ ECIPP_ALIGNMENT_UWORD 65535 Compu_IDENTITY 0 65535 PHYS_UNIT "Enable bits" /end CHARACTERISTIC
/begin CHARACTERISTIC FPsw_ext1_EGR_offmin_excess "FPrm_switches_ext1(495)" VALUE 0x001C795C /* @ECU_Address@FPrm_switches_ext1@0x023A53DE@ */ ECIPP_ALIGNMENT_UWORD 65535 Compu_IDENTITY 0 65535 PHYS_UNIT "Enable bits" /end CHARACTERISTIC
/begin CHARACTERISTIC FPsw_ext1_EGR_OOA_hi "FPrm_switches_ext1(491)" VALUE 0x001C7954 /* @ECU_Address@FPrm_switches_ext1@0x023A53D6@ */ ECIPP_ALIGNMENT_UWORD 65535 Compu_IDENTITY 0 65535 PHYS_UNIT "Enable bits" /end CHARACTERISTIC
/begin CHARACTERISTIC FPsw_ext1_EGR_OOA_lo "FPrm_switches_ext1(492)" VALUE 0x001C7956 /* @ECU_Address@FPrm_switches_ext1@0x023A53D8@ */ ECIPP_ALIGNMENT_UWORD 65535 Compu_IDENTITY 0 65535 PHYS_UNIT "Enable bits" /end CHARACTERISTIC
/begin CHARACTERISTIC FPsw_ext1_EGR_slowdec "FPrm_switches_ext1(490)" VALUE 0x001C7952 /* @ECU_Address@FPrm_switches_ext1@0x023A53D4@ */ ECIPP_ALIGNMENT_UWORD 65535 Compu_IDENTITY 0 65535 PHYS_UNIT "Enable bits" /end CHARACTERISTIC
/begin CHARACTERISTIC FPsw_ext1_EGR_slowinc "FPrm_switches_ext1(489)" VALUE 0x001C7950 /* @ECU_Address@FPrm_switches_ext1@0x023A53D2@ */ ECIPP_ALIGNMENT_UWORD 65535 Compu_IDENTITY 0 65535 PHYS_UNIT "Enable bits" /end CHARACTERISTIC
/begin CHARACTERISTIC FPsw_ext1_EGR_UEGOdP_hi "FPrm_switches_ext1(493)" VALUE 0x001C7958 /* @ECU_Address@FPrm_switches_ext1@0x023A53DA@ */ ECIPP_ALIGNMENT_UWORD 65535 Compu_IDENTITY 0 65535 PHYS_UNIT "Enable bits" /end CHARACTERISTIC
/begin CHARACTERISTIC FPsw_ext1_EGR_UEGOdP_lo "FPrm_switches_ext1(494)" VALUE 0x001C795A /* @ECU_Address@FPrm_switches_ext1@0x023A53DC@ */ ECIPP_ALIGNMENT_UWORD 65535 Compu_IDENTITY 0 65535 PHYS_UNIT "Enable bits" /end CHARACTERISTIC
/begin CHARACTERISTIC FPsw_ext1_EGR_vlv_DC_lim "FPrm_switches_ext1(573)" VALUE 0x001C79F8 /* @ECU_Address@FPrm_switches_ext1@0x023A547A@ */ ECIPP_ALIGNMENT_UWORD 65535 Compu_IDENTITY 0 65535 PHYS_UNIT "Enable bits" /end CHARACTERISTIC
/begin CHARACTERISTIC FPsw_ext1_EGR_vlv_HP_discon "FPrm_switches_ext1(694)" VALUE 0x001C7AEA /* @ECU_Address@FPrm_switches_ext1@0x023A556C@ */ ECIPP_ALIGNMENT_UWORD 65535 Compu_IDENTITY 0 65535 PHYS_UNIT "Enable bits" /end CHARACTERISTIC
/begin CHARACTERISTIC FPsw_ext1_EGR_vlv_stuck "FPrm_switches_ext1(660)" VALUE 0x001C7AA6 /* @ECU_Address@FPrm_switches_ext1@0x023A5528@ */ ECIPP_ALIGNMENT_UWORD 65535 Compu_IDENTITY 0 65535 PHYS_UNIT "Enable bits" /end CHARACTERISTIC
/begin CHARACTERISTIC FPsw_ext1_EGR_vlv_temp_hi "FPrm_switches_ext1(574)" VALUE 0x001C79FA /* @ECU_Address@FPrm_switches_ext1@0x023A547C@ */ ECIPP_ALIGNMENT_UWORD 65535 Compu_IDENTITY 0 65535 PHYS_UNIT "Enable bits" /end CHARACTERISTIC
/begin CHARACTERISTIC FPsw_ext1_EGR_vlvCAN_commlost "FPrm_switches_ext1(497)" VALUE 0x001C7960 /* @ECU_Address@FPrm_switches_ext1@0x023A53E2@ */ ECIPP_ALIGNMENT_UWORD 65535 Compu_IDENTITY 0 65535 PHYS_UNIT "Enable bits" /end CHARACTERISTIC
/begin CHARACTERISTIC FPsw_ext1_EGR_vlvCAN_lowfunc "FPrm_switches_ext1(499)" VALUE 0x001C7964 /* @ECU_Address@FPrm_switches_ext1@0x023A53E6@ */ ECIPP_ALIGNMENT_UWORD 65535 Compu_IDENTITY 0 65535 PHYS_UNIT "Enable bits" /end CHARACTERISTIC
/begin CHARACTERISTIC FPsw_ext1_EGR_vlvCAN_nofunc "FPrm_switches_ext1(498)" VALUE 0x001C7962 /* @ECU_Address@FPrm_switches_ext1@0x023A53E4@ */ ECIPP_ALIGNMENT_UWORD 65535 Compu_IDENTITY 0 65535 PHYS_UNIT "Enable bits" /end CHARACTERISTIC
/begin CHARACTERISTIC FCdtc_CL_phi_hi "FCtl_DTC(677)" VALUE 0x001E3DB4 /* @ECU_Address@FCtl_DTC@0x021B554A@ */ ECIPP_ALIGNMENT_UWORD 65535 Compu_IDENTITY 0 65535 PHYS_UNIT "DTC" /end CHARACTERISTIC
/begin CHARACTERISTIC FCdtc_CL_phi_lo "FCtl_DTC(678)" VALUE 0x001E3DB6 /* @ECU_Address@FCtl_DTC@0x021B554C@ */ ECIPP_ALIGNMENT_UWORD 65535 Compu_IDENTITY 0 65535 PHYS_UNIT "DTC" /end CHARACTERISTIC
/begin CHARACTERISTIC FCdtc_CLLP_hi "FCtl_DTC(36)" VALUE 0x001E38B2 /* @ECU_Address@FCtl_DTC@0x021B5048@ */ ECIPP_ALIGNMENT_UWORD 65535 Compu_IDENTITY 0 65535 PHYS_UNIT "DTC" /end CHARACTERISTIC
/begin CHARACTERISTIC FCdtc_CLLP_lo "FCtl_DTC(37)" VALUE 0x001E38B4 /* @ECU_Address@FCtl_DTC@0x021B504A@ */ ECIPP_ALIGNMENT_UWORD 65535 Compu_IDENTITY 0 65535 PHYS_UNIT "DTC" /end CHARACTERISTIC
/begin CHARACTERISTIC FCdtc_CLNG_hi "FCtl_DTC(38)" VALUE 0x001E38B6 /* @ECU_Address@FCtl_DTC@0x021B504C@ */ ECIPP_ALIGNMENT_UWORD 65535 Compu_IDENTITY 0 65535 PHYS_UNIT "DTC" /end CHARACTERISTIC
/begin CHARACTERISTIC FCdtc_CLNG_lo "FCtl_DTC(39)" VALUE 0x001E38B8 /* @ECU_Address@FCtl_DTC@0x021B504E@ */ ECIPP_ALIGNMENT_UWORD 65535 Compu_IDENTITY 0 65535 PHYS_UNIT "DTC" /end CHARACTERISTIC
/begin CHARACTERISTIC FCdtc_CM_unresp "FCtl_DTC(799)" VALUE 0x001E3EA8 /* @ECU_Address@FCtl_DTC@0x021B563E@ */ ECIPP_ALIGNMENT_UWORD 65535 Compu_IDENTITY 0 65535 PHYS_UNIT "DTC" /end CHARACTERISTIC
/begin CHARACTERISTIC FCdtc_CMgsln_inact "FCtl_DTC(130)" VALUE 0x001E396E /* @ECU_Address@FCtl_DTC@0x021B5104@ */ ECIPP_ALIGNMENT_UWORD 65535 Compu_IDENTITY 0 65535 PHYS_UNIT "DTC" /end CHARACTERISTIC
/begin CHARACTERISTIC FCdtc_CMLP_inact "FCtl_DTC(131)" VALUE 0x001E3970 /* @ECU_Address@FCtl_DTC@0x021B5106@ */ ECIPP_ALIGNMENT_UWORD 65535 Compu_IDENTITY 0 65535 PHYS_UNIT "DTC" /end CHARACTERISTIC
/begin CHARACTERISTIC FCdtc_CMNG_inact "FCtl_DTC(132)" VALUE 0x001E3972 /* @ECU_Address@FCtl_DTC@0x021B5108@ */ ECIPP_ALIGNMENT_UWORD 65535 Compu_IDENTITY 0 65535 PHYS_UNIT "DTC" /end CHARACTERISTIC
/begin CHARACTERISTIC FCdtc_COPfail "FCtl_DTC(99)" VALUE 0x001E3930 /* @ECU_Address@FCtl_DTC@0x021B50C6@ */ ECIPP_ALIGNMENT_UWORD 65535 Compu_IDENTITY 0 65535 PHYS_UNIT "DTC" /end CHARACTERISTIC
/begin CHARACTERISTIC FCdtc_COT_hi "FCtl_DTC(657)" VALUE 0x001E3D8C /* @ECU_Address@FCtl_DTC@0x021B5522@ */ ECIPP_ALIGNMENT_UWORD 65535 Compu_IDENTITY 0 65535 PHYS_UNIT "DTC" /end CHARACTERISTIC
/begin CHARACTERISTIC FCdtc_crkloss "FCtl_DTC(152)" VALUE 0x001E399A /* @ECU_Address@FCtl_DTC@0x021B5130@ */ ECIPP_ALIGNMENT_UWORD 65535 Compu_IDENTITY 0 65535 PHYS_UNIT "DTC" /end CHARACTERISTIC
/begin CHARACTERISTIC FCdtc_crknever "FCtl_DTC(98)" VALUE 0x001E392E /* @ECU_Address@FCtl_DTC@0x021B50C4@ */ ECIPP_ALIGNMENT_UWORD 65535 Compu_IDENTITY 0 65535 PHYS_UNIT "DTC" /end CHARACTERISTIC
/begin CHARACTERISTIC FCdtc_crknoise "FCtl_DTC(97)" VALUE 0x001E392C /* @ECU_Address@FCtl_DTC@0x021B50C2@ */ ECIPP_ALIGNMENT_UWORD 65535 Compu_IDENTITY 0 65535 PHYS_UNIT "DTC" /end CHARACTERISTIC
/begin CHARACTERISTIC FCdtc_CVCS_discon "FCtl_DTC(747)" VALUE 0x001E3E40 /* @ECU_Address@FCtl_DTC@0x021B55D6@ */ ECIPP_ALIGNMENT_UWORD 65535 Compu_IDENTITY 0 65535 PHYS_UNIT "DTC" /end CHARACTERISTIC
/begin CHARACTERISTIC FCdtc_CVDS_discon "FCtl_DTC(748)" VALUE 0x001E3E42 /* @ECU_Address@FCtl_DTC@0x021B55D8@ */ ECIPP_ALIGNMENT_UWORD 65535 Compu_IDENTITY 0 65535 PHYS_UNIT "DTC" /end CHARACTERISTIC
/begin CHARACTERISTIC FCdtc_CVP1_hi "FCtl_DTC(794)" VALUE 0x001E3E9E /* @ECU_Address@FCtl_DTC@0x021B5634@ */ ECIPP_ALIGNMENT_UWORD 65535 Compu_IDENTITY 0 65535 PHYS_UNIT "DTC" /end CHARACTERISTIC
/begin CHARACTERISTIC FCdtc_CVP1_lo "FCtl_DTC(795)" VALUE 0x001E3EA0 /* @ECU_Address@FCtl_DTC@0x021B5636@ */ ECIPP_ALIGNMENT_UWORD 65535 Compu_IDENTITY 0 65535 PHYS_UNIT "DTC" /end CHARACTERISTIC
/begin CHARACTERISTIC FCdtc_CVP2_hi "FCtl_DTC(796)" VALUE 0x001E3EA2 /* @ECU_Address@FCtl_DTC@0x021B5638@ */ ECIPP_ALIGNMENT_UWORD 65535 Compu_IDENTITY 0 65535 PHYS_UNIT "DTC" /end CHARACTERISTIC
/begin CHARACTERISTIC FCdtc_CVP2_lo "FCtl_DTC(797)" VALUE 0x001E3EA4 /* @ECU_Address@FCtl_DTC@0x021B563A@ */ ECIPP_ALIGNMENT_UWORD 65535 Compu_IDENTITY 0 65535 PHYS_UNIT "DTC" /end CHARACTERISTIC
/begin CHARACTERISTIC FCdtc_DBW_I_max "FCtl_DTC(527)" VALUE 0x001E3C88 /* @ECU_Address@FCtl_DTC@0x021B541E@ */ ECIPP_ALIGNMENT_UWORD 65535 Compu_IDENTITY 0 65535 PHYS_UNIT "DTC" /end CHARACTERISTIC
/begin CHARACTERISTIC FCdtc_ECam_maxerr "FCtl_DTC(289)" VALUE 0x001E3AAC /* @ECU_Address@FCtl_DTC@0x021B5242@ */ ECIPP_ALIGNMENT_UWORD 65535 Compu_IDENTITY 0 65535 PHYS_UNIT "DTC" /end CHARACTERISTIC
/begin CHARACTERISTIC FCdtc_ECL_low "FCtl_DTC(733)" VALUE 0x001E3E24 /* @ECU_Address@FCtl_DTC@0x021B55BA@ */ ECIPP_ALIGNMENT_UWORD 65535 Compu_IDENTITY 0 65535 PHYS_UNIT "DTC" /end CHARACTERISTIC
/begin CHARACTERISTIC FCdtc_ECP_hiP "FCtl_DTC(1044)" VALUE 0x001E4092 /* @ECU_Address@FCtl_DTC@0x021B5828@ */ ECIPP_ALIGNMENT_UWORD 65535 Compu_IDENTITY 0 65535 PHYS_UNIT "DTC" /end CHARACTERISTIC
/begin CHARACTERISTIC FCdtc_ECP_loP "FCtl_DTC(1043)" VALUE 0x001E4090 /* @ECU_Address@FCtl_DTC@0x021B5826@ */ ECIPP_ALIGNMENT_UWORD 65535 Compu_IDENTITY 0 65535 PHYS_UNIT "DTC" /end CHARACTERISTIC
/begin CHARACTERISTIC FCdtc_ECT_AAT_dT_max "FCtl_DTC(842)" VALUE 0x001E3EFE /* @ECU_Address@FCtl_DTC@0x021B5694@ */ ECIPP_ALIGNMENT_UWORD 65535 Compu_IDENTITY 0 65535 PHYS_UNIT "DTC" /end CHARACTERISTIC
/begin CHARACTERISTIC FCdtc_ECT_derate_actv "FCtl_DTC(828)" VALUE 0x001E3EE2 /* @ECU_Address@FCtl_DTC@0x021B5678@ */ ECIPP_ALIGNMENT_UWORD 65535 Compu_IDENTITY 0 65535 PHYS_UNIT "DTC" /end CHARACTERISTIC
/begin CHARACTERISTIC FCdtc_ECT_dT_max "FCtl_DTC(850)" VALUE 0x001E3F0E /* @ECU_Address@FCtl_DTC@0x021B56A4@ */ ECIPP_ALIGNMENT_UWORD 65535 Compu_IDENTITY 0 65535 PHYS_UNIT "DTC" /end CHARACTERISTIC
/begin CHARACTERISTIC FCdtc_ECT_EGRT_dT_max "FCtl_DTC(843)" VALUE 0x001E3F00 /* @ECU_Address@FCtl_DTC@0x021B5696@ */ ECIPP_ALIGNMENT_UWORD 65535 Compu_IDENTITY 0 65535 PHYS_UNIT "DTC" /end CHARACTERISTIC
/begin CHARACTERISTIC FCdtc_ECT_EGT_dT_max "FCtl_DTC(846)" VALUE 0x001E3F06 /* @ECU_Address@FCtl_DTC@0x021B569C@ */ ECIPP_ALIGNMENT_UWORD 65535 Compu_IDENTITY 0 65535 PHYS_UNIT "DTC" /end CHARACTERISTIC
/begin CHARACTERISTIC FCdtc_ECT_FT_dT_max "FCtl_DTC(844)" VALUE 0x001E3F02 /* @ECU_Address@FCtl_DTC@0x021B5698@ */ ECIPP_ALIGNMENT_UWORD 65535 Compu_IDENTITY 0 65535 PHYS_UNIT "DTC" /end CHARACTERISTIC
/begin CHARACTERISTIC FCdtc_ECT_HiExp "FCtl_DTC(4)" VALUE 0x001E3872 /* @ECU_Address@FCtl_DTC@0x021B5008@ */ ECIPP_ALIGNMENT_UWORD 65535 Compu_IDENTITY 0 65535 PHYS_UNIT "DTC" /end CHARACTERISTIC
/begin CHARACTERISTIC FCdtc_ECT_HiExp2 "FCtl_DTC(86)" VALUE 0x001E3916 /* @ECU_Address@FCtl_DTC@0x021B50AC@ */ ECIPP_ALIGNMENT_UWORD 65535 Compu_IDENTITY 0 65535 PHYS_UNIT "DTC" /end CHARACTERISTIC
/begin CHARACTERISTIC FCdtc_ECT_IAT_dT_max "FCtl_DTC(841)" VALUE 0x001E3EFC /* @ECU_Address@FCtl_DTC@0x021B5692@ */ ECIPP_ALIGNMENT_UWORD 65535 Compu_IDENTITY 0 65535 PHYS_UNIT "DTC" /end CHARACTERISTIC
/begin CHARACTERISTIC FCdtc_ECT_LoExp "FCtl_DTC(648)" VALUE 0x001E3D7A /* @ECU_Address@FCtl_DTC@0x021B5510@ */ ECIPP_ALIGNMENT_UWORD 65535 Compu_IDENTITY 0 65535 PHYS_UNIT "DTC" /end CHARACTERISTIC
/begin CHARACTERISTIC FCdtc_ECT_LoExp2 "FCtl_DTC(649)" VALUE 0x001E3D7C /* @ECU_Address@FCtl_DTC@0x021B5512@ */ ECIPP_ALIGNMENT_UWORD 65535 Compu_IDENTITY 0 65535 PHYS_UNIT "DTC" /end CHARACTERISTIC
/begin CHARACTERISTIC FCdtc_ECT_maxv "FCtl_DTC(2)" VALUE 0x001E386E /* @ECU_Address@FCtl_DTC@0x021B5004@ */ ECIPP_ALIGNMENT_UWORD 65535 Compu_IDENTITY 0 65535 PHYS_UNIT "DTC" /end CHARACTERISTIC
/begin CHARACTERISTIC FCdtc_ECT_minv "FCtl_DTC(3)" VALUE 0x001E3870 /* @ECU_Address@FCtl_DTC@0x021B5006@ */ ECIPP_ALIGNMENT_UWORD 65535 Compu_IDENTITY 0 65535 PHYS_UNIT "DTC" /end CHARACTERISTIC
/begin CHARACTERISTIC FCdtc_ECT_OILT_dT_max "FCtl_DTC(845)" VALUE 0x001E3F04 /* @ECU_Address@FCtl_DTC@0x021B569A@ */ ECIPP_ALIGNMENT_UWORD 65535 Compu_IDENTITY 0 65535 PHYS_UNIT "DTC" /end CHARACTERISTIC
/begin CHARACTERISTIC FCdtc_ECT_TAUX_dT1_max "FCtl_DTC(848)" VALUE 0x001E3F0A /* @ECU_Address@FCtl_DTC@0x021B56A0@ */ ECIPP_ALIGNMENT_UWORD 65535 Compu_IDENTITY 0 65535 PHYS_UNIT "DTC" /end CHARACTERISTIC
/begin CHARACTERISTIC FCdtc_ECT_TAUX_dT2_max "FCtl_DTC(849)" VALUE 0x001E3F0C /* @ECU_Address@FCtl_DTC@0x021B56A2@ */ ECIPP_ALIGNMENT_UWORD 65535 Compu_IDENTITY 0 65535 PHYS_UNIT "DTC" /end CHARACTERISTIC
/begin CHARACTERISTIC FCdtc_ECT_TIAT_dT_max "FCtl_DTC(847)" VALUE 0x001E3F08 /* @ECU_Address@FCtl_DTC@0x021B569E@ */ ECIPP_ALIGNMENT_UWORD 65535 Compu_IDENTITY 0 65535 PHYS_UNIT "DTC" /end CHARACTERISTIC
/begin CHARACTERISTIC FCdtc_EGO1_open "FCtl_DTC(111)" VALUE 0x001E3948 /* @ECU_Address@FCtl_DTC@0x021B50DE@ */ ECIPP_ALIGNMENT_UWORD 65535 Compu_IDENTITY 0 65535 PHYS_UNIT "DTC" /end CHARACTERISTIC
/begin CHARACTERISTIC FCdtc_EGO2_open "FCtl_DTC(112)" VALUE 0x001E394A /* @ECU_Address@FCtl_DTC@0x021B50E0@ */ ECIPP_ALIGNMENT_UWORD 65535 Compu_IDENTITY 0 65535 PHYS_UNIT "DTC" /end CHARACTERISTIC
/begin CHARACTERISTIC FCdtc_EGO3_open "FCtl_DTC(113)" VALUE 0x001E394C /* @ECU_Address@FCtl_DTC@0x021B50E2@ */ ECIPP_ALIGNMENT_UWORD 65535 Compu_IDENTITY 0 65535 PHYS_UNIT "DTC" /end CHARACTERISTIC
/begin CHARACTERISTIC FCdtc_EGOH1_off_open "FCtl_DTC(321)" VALUE 0x001E3AEC /* @ECU_Address@FCtl_DTC@0x021B5282@ */ ECIPP_ALIGNMENT_UWORD 65535 Compu_IDENTITY 0 65535 PHYS_UNIT "DTC" /end CHARACTERISTIC
/begin CHARACTERISTIC FCdtc_EGOH1_on_short "FCtl_DTC(322)" VALUE 0x001E3AEE /* @ECU_Address@FCtl_DTC@0x021B5284@ */ ECIPP_ALIGNMENT_UWORD 65535 Compu_IDENTITY 0 65535 PHYS_UNIT "DTC" /end CHARACTERISTIC
/begin CHARACTERISTIC FCdtc_EGOH2_off_open "FCtl_DTC(323)" VALUE 0x001E3AF0 /* @ECU_Address@FCtl_DTC@0x021B5286@ */ ECIPP_ALIGNMENT_UWORD 65535 Compu_IDENTITY 0 65535 PHYS_UNIT "DTC" /end CHARACTERISTIC
/begin CHARACTERISTIC FCdtc_EGOH2_on_short "FCtl_DTC(324)" VALUE 0x001E3AF2 /* @ECU_Address@FCtl_DTC@0x021B5288@ */ ECIPP_ALIGNMENT_UWORD 65535 Compu_IDENTITY 0 65535 PHYS_UNIT "DTC" /end CHARACTERISTIC
/begin CHARACTERISTIC FCdtc_EGOH3_off_open "FCtl_DTC(325)" VALUE 0x001E3AF4 /* @ECU_Address@FCtl_DTC@0x021B528A@ */ ECIPP_ALIGNMENT_UWORD 65535 Compu_IDENTITY 0 65535 PHYS_UNIT "DTC" /end CHARACTERISTIC
/begin CHARACTERISTIC FCdtc_EGOH3_on_short "FCtl_DTC(326)" VALUE 0x001E3AF6 /* @ECU_Address@FCtl_DTC@0x021B528C@ */ ECIPP_ALIGNMENT_UWORD 65535 Compu_IDENTITY 0 65535 PHYS_UNIT "DTC" /end CHARACTERISTIC
/begin CHARACTERISTIC FCdtc_EGOH4_off_open "FCtl_DTC(327)" VALUE 0x001E3AF8 /* @ECU_Address@FCtl_DTC@0x021B528E@ */ ECIPP_ALIGNMENT_UWORD 65535 Compu_IDENTITY 0 65535 PHYS_UNIT "DTC" /end CHARACTERISTIC
/begin CHARACTERISTIC FCdtc_EGOH4_on_short "FCtl_DTC(328)" VALUE 0x001E3AFA /* @ECU_Address@FCtl_DTC@0x021B5290@ */ ECIPP_ALIGNMENT_UWORD 65535 Compu_IDENTITY 0 65535 PHYS_UNIT "DTC" /end CHARACTERISTIC
/begin CHARACTERISTIC FCdtc_EGR_clr_eta_lo "FCtl_DTC(666)" VALUE 0x001E3D9E /* @ECU_Address@FCtl_DTC@0x021B5534@ */ ECIPP_ALIGNMENT_UWORD 65535 Compu_IDENTITY 0 65535 PHYS_UNIT "DTC" /end CHARACTERISTIC
/begin CHARACTERISTIC FCdtc_EGR_clr_eta_lo2 "FCtl_DTC(685)" VALUE 0x001E3DC4 /* @ECU_Address@FCtl_DTC@0x021B555A@ */ ECIPP_ALIGNMENT_UWORD 65535 Compu_IDENTITY 0 65535 PHYS_UNIT "DTC" /end CHARACTERISTIC
/begin CHARACTERISTIC FCdtc_EGR_deice_excess "FCtl_DTC(829)" VALUE 0x001E3EE4 /* @ECU_Address@FCtl_DTC@0x021B567A@ */ ECIPP_ALIGNMENT_UWORD 65535 Compu_IDENTITY 0 65535 PHYS_UNIT "DTC" /end CHARACTERISTIC
/begin CHARACTERISTIC FCdtc_EGR_offmin_excess "FCtl_DTC(665)" VALUE 0x001E3D9C /* @ECU_Address@FCtl_DTC@0x021B5532@ */ ECIPP_ALIGNMENT_UWORD 65535 Compu_IDENTITY 0 65535 PHYS_UNIT "DTC" /end CHARACTERISTIC
/begin CHARACTERISTIC FCdtc_EGR_OOA_hi "FCtl_DTC(661)" VALUE 0x001E3D94 /* @ECU_Address@FCtl_DTC@0x021B552A@ */ ECIPP_ALIGNMENT_UWORD 65535 Compu_IDENTITY 0 65535 PHYS_UNIT "DTC" /end CHARACTERISTIC
/begin CHARACTERISTIC FCdtc_EGR_OOA_lo "FCtl_DTC(662)" VALUE 0x001E3D96 /* @ECU_Address@FCtl_DTC@0x021B552C@ */ ECIPP_ALIGNMENT_UWORD 65535 Compu_IDENTITY 0 65535 PHYS_UNIT "DTC" /end CHARACTERISTIC
/begin CHARACTERISTIC FCdtc_EGR_slowdec "FCtl_DTC(660)" VALUE 0x001E3D92 /* @ECU_Address@FCtl_DTC@0x021B5528@ */ ECIPP_ALIGNMENT_UWORD 65535 Compu_IDENTITY 0 65535 PHYS_UNIT "DTC" /end CHARACTERISTIC
/begin CHARACTERISTIC FCdtc_EGR_slowinc "FCtl_DTC(659)" VALUE 0x001E3D90 /* @ECU_Address@FCtl_DTC@0x021B5526@ */ ECIPP_ALIGNMENT_UWORD 65535 Compu_IDENTITY 0 65535 PHYS_UNIT "DTC" /end CHARACTERISTIC
/begin CHARACTERISTIC FCdtc_EGR_UEGOdP_hi "FCtl_DTC(663)" VALUE 0x001E3D98 /* @ECU_Address@FCtl_DTC@0x021B552E@ */ ECIPP_ALIGNMENT_UWORD 65535 Compu_IDENTITY 0 65535 PHYS_UNIT "DTC" /end CHARACTERISTIC
/begin CHARACTERISTIC FCdtc_EGR_UEGOdP_lo "FCtl_DTC(664)" VALUE 0x001E3D9A /* @ECU_Address@FCtl_DTC@0x021B5530@ */ ECIPP_ALIGNMENT_UWORD 65535 Compu_IDENTITY 0 65535 PHYS_UNIT "DTC" /end CHARACTERISTIC
/begin CHARACTERISTIC FCdtc_EGR_vlv_DC_lim "FCtl_DTC(743)" VALUE 0x001E3E38 /* @ECU_Address@FCtl_DTC@0x021B55CE@ */ ECIPP_ALIGNMENT_UWORD 65535 Compu_IDENTITY 0 65535 PHYS_UNIT "DTC" /end CHARACTERISTIC
/begin CHARACTERISTIC FCdtc_EGR_vlv_HP_discon "FCtl_DTC(867)" VALUE 0x001E3F30 /* @ECU_Address@FCtl_DTC@0x021B56C6@ */ ECIPP_ALIGNMENT_UWORD 65535 Compu_IDENTITY 0 65535 PHYS_UNIT "DTC" /end CHARACTERISTIC
/begin CHARACTERISTIC FCdtc_EGR_vlv_stuck "FCtl_DTC(833)" VALUE 0x001E3EEC /* @ECU_Address@FCtl_DTC@0x021B5682@ */ ECIPP_ALIGNMENT_UWORD 65535 Compu_IDENTITY 0 65535 PHYS_UNIT "DTC" /end CHARACTERISTIC
/begin CHARACTERISTIC FCdtc_EGR_vlv_temp_hi "FCtl_DTC(744)" VALUE 0x001E3E3A /* @ECU_Address@FCtl_DTC@0x021B55D0@ */ ECIPP_ALIGNMENT_UWORD 65535 Compu_IDENTITY 0 65535 PHYS_UNIT "DTC" /end CHARACTERISTIC
/begin CHARACTERISTIC FCdtc_EGR_vlvCAN_commlost "FCtl_DTC(667)" VALUE 0x001E3DA0 /* @ECU_Address@FCtl_DTC@0x021B5536@ */ ECIPP_ALIGNMENT_UWORD 65535 Compu_IDENTITY 0 65535 PHYS_UNIT "DTC" /end CHARACTERISTIC
/begin CHARACTERISTIC FCdtc_EGR_vlvCAN_lowfunc "FCtl_DTC(669)" VALUE 0x001E3DA4 /* @ECU_Address@FCtl_DTC@0x021B553A@ */ ECIPP_ALIGNMENT_UWORD 65535 Compu_IDENTITY 0 65535 PHYS_UNIT "DTC" /end CHARACTERISTIC
/begin CHARACTERISTIC FCdtc_EGR_vlvCAN_nofunc "FCtl_DTC(668)" VALUE 0x001E3DA2 /* @ECU_Address@FCtl_DTC@0x021B5538@ */ ECIPP_ALIGNMENT_UWORD 65535 Compu_IDENTITY 0 65535 PHYS_UNIT "DTC" /end CHARACTERISTIC
/begin CHARACTERISTIC FCfmi_CL_phi_hi "FCtl_FMI(677)" VALUE 0x001E5BA6 /* @ECU_Address@FCtl_FMI@0x021B72A5@ */ ECIPP_ALIGNMENT_UBYTE 255 Compu_IDENTITY 0 255 PHYS_UNIT "FMI" /end CHARACTERISTIC
/begin CHARACTERISTIC FCfmi_CL_phi_lo "FCtl_FMI(678)" VALUE 0x001E5BA7 /* @ECU_Address@FCtl_FMI@0x021B72A6@ */ ECIPP_ALIGNMENT_UBYTE 255 Compu_IDENTITY 0 255 PHYS_UNIT "FMI" /end CHARACTERISTIC
/begin CHARACTERISTIC FCfmi_CLLP_hi "FCtl_FMI(36)" VALUE 0x001E5925 /* @ECU_Address@FCtl_FMI@0x021B7024@ */ ECIPP_ALIGNMENT_UBYTE 255 Compu_IDENTITY 0 255 PHYS_UNIT "FMI" /end CHARACTERISTIC
/begin CHARACTERISTIC FCfmi_CLLP_lo "FCtl_FMI(37)" VALUE 0x001E5926 /* @ECU_Address@FCtl_FMI@0x021B7025@ */ ECIPP_ALIGNMENT_UBYTE 255 Compu_IDENTITY 0 255 PHYS_UNIT "FMI" /end CHARACTERISTIC
/begin CHARACTERISTIC FCfmi_CLNG_hi "FCtl_FMI(38)" VALUE 0x001E5927 /* @ECU_Address@FCtl_FMI@0x021B7026@ */ ECIPP_ALIGNMENT_UBYTE 255 Compu_IDENTITY 0 255 PHYS_UNIT "FMI" /end CHARACTERISTIC
/begin CHARACTERISTIC FCfmi_CLNG_lo "FCtl_FMI(39)" VALUE 0x001E5928 /* @ECU_Address@FCtl_FMI@0x021B7027@ */ ECIPP_ALIGNMENT_UBYTE 255 Compu_IDENTITY 0 255 PHYS_UNIT "FMI" /end CHARACTERISTIC
/begin CHARACTERISTIC FCfmi_CM_unresp "FCtl_FMI(799)" VALUE 0x001E5C20 /* @ECU_Address@FCtl_FMI@0x021B731F@ */ ECIPP_ALIGNMENT_UBYTE 255 Compu_IDENTITY 0 255 PHYS_UNIT "FMI" /end CHARACTERISTIC
/begin CHARACTERISTIC FCfmi_CMgsln_inact "FCtl_FMI(130)" VALUE 0x001E5983 /* @ECU_Address@FCtl_FMI@0x021B7082@ */ ECIPP_ALIGNMENT_UBYTE 255 Compu_IDENTITY 0 255 PHYS_UNIT "FMI" /end CHARACTERISTIC
/begin CHARACTERISTIC FCfmi_CMLP_inact "FCtl_FMI(131)" VALUE 0x001E5984 /* @ECU_Address@FCtl_FMI@0x021B7083@ */ ECIPP_ALIGNMENT_UBYTE 255 Compu_IDENTITY 0 255 PHYS_UNIT "FMI" /end CHARACTERISTIC
/begin CHARACTERISTIC FCfmi_CMNG_inact "FCtl_FMI(132)" VALUE 0x001E5985 /* @ECU_Address@FCtl_FMI@0x021B7084@ */ ECIPP_ALIGNMENT_UBYTE 255 Compu_IDENTITY 0 255 PHYS_UNIT "FMI" /end CHARACTERISTIC
/begin CHARACTERISTIC FCfmi_COPfail "FCtl_FMI(99)" VALUE 0x001E5964 /* @ECU_Address@FCtl_FMI@0x021B7063@ */ ECIPP_ALIGNMENT_UBYTE 255 Compu_IDENTITY 0 255 PHYS_UNIT "FMI" /end CHARACTERISTIC
/begin CHARACTERISTIC FCfmi_COT_hi "FCtl_FMI(657)" VALUE 0x001E5B92 /* @ECU_Address@FCtl_FMI@0x021B7291@ */ ECIPP_ALIGNMENT_UBYTE 255 Compu_IDENTITY 0 255 PHYS_UNIT "FMI" /end CHARACTERISTIC
/begin CHARACTERISTIC FCfmi_crkloss "FCtl_FMI(152)" VALUE 0x001E5999 /* @ECU_Address@FCtl_FMI@0x021B7098@ */ ECIPP_ALIGNMENT_UBYTE 255 Compu_IDENTITY 0 255 PHYS_UNIT "FMI" /end CHARACTERISTIC
/begin CHARACTERISTIC FCfmi_crknever "FCtl_FMI(98)" VALUE 0x001E5963 /* @ECU_Address@FCtl_FMI@0x021B7062@ */ ECIPP_ALIGNMENT_UBYTE 255 Compu_IDENTITY 0 255 PHYS_UNIT "FMI" /end CHARACTERISTIC
/begin CHARACTERISTIC FCfmi_crknoise "FCtl_FMI(97)" VALUE 0x001E5962 /* @ECU_Address@FCtl_FMI@0x021B7061@ */ ECIPP_ALIGNMENT_UBYTE 255 Compu_IDENTITY 0 255 PHYS_UNIT "FMI" /end CHARACTERISTIC
/begin CHARACTERISTIC FCfmi_CVCS_discon "FCtl_FMI(747)" VALUE 0x001E5BEC /* @ECU_Address@FCtl_FMI@0x021B72EB@ */ ECIPP_ALIGNMENT_UBYTE 255 Compu_IDENTITY 0 255 PHYS_UNIT "FMI" /end CHARACTERISTIC
/begin CHARACTERISTIC FCfmi_CVDS_discon "FCtl_FMI(748)" VALUE 0x001E5BED /* @ECU_Address@FCtl_FMI@0x021B72EC@ */ ECIPP_ALIGNMENT_UBYTE 255 Compu_IDENTITY 0 255 PHYS_UNIT "FMI" /end CHARACTERISTIC
/begin CHARACTERISTIC FCfmi_CVP1_hi "FCtl_FMI(794)" VALUE 0x001E5C1B /* @ECU_Address@FCtl_FMI@0x021B731A@ */ ECIPP_ALIGNMENT_UBYTE 255 Compu_IDENTITY 0 255 PHYS_UNIT "FMI" /end CHARACTERISTIC
/begin CHARACTERISTIC FCfmi_CVP1_lo "FCtl_FMI(795)" VALUE 0x001E5C1C /* @ECU_Address@FCtl_FMI@0x021B731B@ */ ECIPP_ALIGNMENT_UBYTE 255 Compu_IDENTITY 0 255 PHYS_UNIT "FMI" /end CHARACTERISTIC
/begin CHARACTERISTIC FCfmi_CVP2_hi "FCtl_FMI(796)" VALUE 0x001E5C1D /* @ECU_Address@FCtl_FMI@0x021B731C@ */ ECIPP_ALIGNMENT_UBYTE 255 Compu_IDENTITY 0 255 PHYS_UNIT "FMI" /end CHARACTERISTIC
/begin CHARACTERISTIC FCfmi_CVP2_lo "FCtl_FMI(797)" VALUE 0x001E5C1E /* @ECU_Address@FCtl_FMI@0x021B731D@ */ ECIPP_ALIGNMENT_UBYTE 255 Compu_IDENTITY 0 255 PHYS_UNIT "FMI" /end CHARACTERISTIC
/begin CHARACTERISTIC FCfmi_DBW_I_max "FCtl_FMI(527)" VALUE 0x001E5B10 /* @ECU_Address@FCtl_FMI@0x021B720F@ */ ECIPP_ALIGNMENT_UBYTE 255 Compu_IDENTITY 0 255 PHYS_UNIT "FMI" /end CHARACTERISTIC
/begin CHARACTERISTIC FCfmi_ECam_maxerr "FCtl_FMI(289)" VALUE 0x001E5A22 /* @ECU_Address@FCtl_FMI@0x021B7121@ */ ECIPP_ALIGNMENT_UBYTE 255 Compu_IDENTITY 0 255 PHYS_UNIT "FMI" /end CHARACTERISTIC
/begin CHARACTERISTIC FCfmi_ECL_low "FCtl_FMI(733)" VALUE 0x001E5BDE /* @ECU_Address@FCtl_FMI@0x021B72DD@ */ ECIPP_ALIGNMENT_UBYTE 255 Compu_IDENTITY 0 255 PHYS_UNIT "FMI" /end CHARACTERISTIC
/begin CHARACTERISTIC FCfmi_ECP_hiP "FCtl_FMI(1044)" VALUE 0x001E5D15 /* @ECU_Address@FCtl_FMI@0x021B7414@ */ ECIPP_ALIGNMENT_UBYTE 255 Compu_IDENTITY 0 255 PHYS_UNIT "FMI" /end CHARACTERISTIC
/begin CHARACTERISTIC FCfmi_ECP_loP "FCtl_FMI(1043)" VALUE 0x001E5D14 /* @ECU_Address@FCtl_FMI@0x021B7413@ */ ECIPP_ALIGNMENT_UBYTE 255 Compu_IDENTITY 0 255 PHYS_UNIT "FMI" /end CHARACTERISTIC
/begin CHARACTERISTIC FCfmi_ECT_AAT_dT_max "FCtl_FMI(842)" VALUE 0x001E5C4B /* @ECU_Address@FCtl_FMI@0x021B734A@ */ ECIPP_ALIGNMENT_UBYTE 255 Compu_IDENTITY 0 255 PHYS_UNIT "FMI" /end CHARACTERISTIC
/begin CHARACTERISTIC FCfmi_ECT_derate_actv "FCtl_FMI(828)" VALUE 0x001E5C3D /* @ECU_Address@FCtl_FMI@0x021B733C@ */ ECIPP_ALIGNMENT_UBYTE 255 Compu_IDENTITY 0 255 PHYS_UNIT "FMI" /end CHARACTERISTIC
/begin CHARACTERISTIC FCfmi_ECT_dT_max "FCtl_FMI(850)" VALUE 0x001E5C53 /* @ECU_Address@FCtl_FMI@0x021B7352@ */ ECIPP_ALIGNMENT_UBYTE 255 Compu_IDENTITY 0 255 PHYS_UNIT "FMI" /end CHARACTERISTIC
/begin CHARACTERISTIC FCfmi_ECT_EGRT_dT_max "FCtl_FMI(843)" VALUE 0x001E5C4C /* @ECU_Address@FCtl_FMI@0x021B734B@ */ ECIPP_ALIGNMENT_UBYTE 255 Compu_IDENTITY 0 255 PHYS_UNIT "FMI" /end CHARACTERISTIC
/begin CHARACTERISTIC FCfmi_ECT_EGT_dT_max "FCtl_FMI(846)" VALUE 0x001E5C4F /* @ECU_Address@FCtl_FMI@0x021B734E@ */ ECIPP_ALIGNMENT_UBYTE 255 Compu_IDENTITY 0 255 PHYS_UNIT "FMI" /end CHARACTERISTIC
/begin CHARACTERISTIC FCfmi_ECT_FT_dT_max "FCtl_FMI(844)" VALUE 0x001E5C4D /* @ECU_Address@FCtl_FMI@0x021B734C@ */ ECIPP_ALIGNMENT_UBYTE 255 Compu_IDENTITY 0 255 PHYS_UNIT "FMI" /end CHARACTERISTIC
/begin CHARACTERISTIC FCfmi_ECT_HiExp "FCtl_FMI(4)" VALUE 0x001E5905 /* @ECU_Address@FCtl_FMI@0x021B7004@ */ ECIPP_ALIGNMENT_UBYTE 255 Compu_IDENTITY 0 255 PHYS_UNIT "FMI" /end CHARACTERISTIC
/begin CHARACTERISTIC FCfmi_ECT_HiExp2 "FCtl_FMI(86)" VALUE 0x001E5957 /* @ECU_Address@FCtl_FMI@0x021B7056@ */ ECIPP_ALIGNMENT_UBYTE 255 Compu_IDENTITY 0 255 PHYS_UNIT "FMI" /end CHARACTERISTIC
/begin CHARACTERISTIC FCfmi_ECT_IAT_dT_max "FCtl_FMI(841)" VALUE 0x001E5C4A /* @ECU_Address@FCtl_FMI@0x021B7349@ */ ECIPP_ALIGNMENT_UBYTE 255 Compu_IDENTITY 0 255 PHYS_UNIT "FMI" /end CHARACTERISTIC
/begin CHARACTERISTIC FCfmi_ECT_LoExp "FCtl_FMI(648)" VALUE 0x001E5B89 /* @ECU_Address@FCtl_FMI@0x021B7288@ */ ECIPP_ALIGNMENT_UBYTE 255 Compu_IDENTITY 0 255 PHYS_UNIT "FMI" /end CHARACTERISTIC
/begin CHARACTERISTIC FCfmi_ECT_LoExp2 "FCtl_FMI(649)" VALUE 0x001E5B8A /* @ECU_Address@FCtl_FMI@0x021B7289@ */ ECIPP_ALIGNMENT_UBYTE 255 Compu_IDENTITY 0 255 PHYS_UNIT "FMI" /end CHARACTERISTIC
/begin CHARACTERISTIC FCfmi_ECT_maxv "FCtl_FMI(2)" VALUE 0x001E5903 /* @ECU_Address@FCtl_FMI@0x021B7002@ */ ECIPP_ALIGNMENT_UBYTE 255 Compu_IDENTITY 0 255 PHYS_UNIT "FMI" /end CHARACTERISTIC
/begin CHARACTERISTIC FCfmi_ECT_minv "FCtl_FMI(3)" VALUE 0x001E5904 /* @ECU_Address@FCtl_FMI@0x021B7003@ */ ECIPP_ALIGNMENT_UBYTE 255 Compu_IDENTITY 0 255 PHYS_UNIT "FMI" /end CHARACTERISTIC
/begin CHARACTERISTIC FCfmi_ECT_OILT_dT_max "FCtl_FMI(845)" VALUE 0x001E5C4E /* @ECU_Address@FCtl_FMI@0x021B734D@ */ ECIPP_ALIGNMENT_UBYTE 255 Compu_IDENTITY 0 255 PHYS_UNIT "FMI" /end CHARACTERISTIC
/begin CHARACTERISTIC FCfmi_ECT_TAUX_dT1_max "FCtl_FMI(848)" VALUE 0x001E5C51 /* @ECU_Address@FCtl_FMI@0x021B7350@ */ ECIPP_ALIGNMENT_UBYTE 255 Compu_IDENTITY 0 255 PHYS_UNIT "FMI" /end CHARACTERISTIC
/begin CHARACTERISTIC FCfmi_ECT_TAUX_dT2_max "FCtl_FMI(849)" VALUE 0x001E5C52 /* @ECU_Address@FCtl_FMI@0x021B7351@ */ ECIPP_ALIGNMENT_UBYTE 255 Compu_IDENTITY 0 255 PHYS_UNIT "FMI" /end CHARACTERISTIC
/begin CHARACTERISTIC FCfmi_ECT_TIAT_dT_max "FCtl_FMI(847)" VALUE 0x001E5C50 /* @ECU_Address@FCtl_FMI@0x021B734F@ */ ECIPP_ALIGNMENT_UBYTE 255 Compu_IDENTITY 0 255 PHYS_UNIT "FMI" /end CHARACTERISTIC
/begin CHARACTERISTIC FCfmi_EGO1_open "FCtl_FMI(111)" VALUE 0x001E5970 /* @ECU_Address@FCtl_FMI@0x021B706F@ */ ECIPP_ALIGNMENT_UBYTE 255 Compu_IDENTITY 0 255 PHYS_UNIT "FMI" /end CHARACTERISTIC
/begin CHARACTERISTIC FCfmi_EGO2_open "FCtl_FMI(112)" VALUE 0x001E5971 /* @ECU_Address@FCtl_FMI@0x021B7070@ */ ECIPP_ALIGNMENT_UBYTE 255 Compu_IDENTITY 0 255 PHYS_UNIT "FMI" /end CHARACTERISTIC
/begin CHARACTERISTIC FCfmi_EGO3_open "FCtl_FMI(113)" VALUE 0x001E5972 /* @ECU_Address@FCtl_FMI@0x021B7071@ */ ECIPP_ALIGNMENT_UBYTE 255 Compu_IDENTITY 0 255 PHYS_UNIT "FMI" /end CHARACTERISTIC
/begin CHARACTERISTIC FCfmi_EGOH1_off_open "FCtl_FMI(321)" VALUE 0x001E5A42 /* @ECU_Address@FCtl_FMI@0x021B7141@ */ ECIPP_ALIGNMENT_UBYTE 255 Compu_IDENTITY 0 255 PHYS_UNIT "FMI" /end CHARACTERISTIC
/begin CHARACTERISTIC FCfmi_EGOH1_on_short "FCtl_FMI(322)" VALUE 0x001E5A43 /* @ECU_Address@FCtl_FMI@0x021B7142@ */ ECIPP_ALIGNMENT_UBYTE 255 Compu_IDENTITY 0 255 PHYS_UNIT "FMI" /end CHARACTERISTIC
/begin CHARACTERISTIC FCfmi_EGOH2_off_open "FCtl_FMI(323)" VALUE 0x001E5A44 /* @ECU_Address@FCtl_FMI@0x021B7143@ */ ECIPP_ALIGNMENT_UBYTE 255 Compu_IDENTITY 0 255 PHYS_UNIT "FMI" /end CHARACTERISTIC
/begin CHARACTERISTIC FCfmi_EGOH2_on_short "FCtl_FMI(324)" VALUE 0x001E5A45 /* @ECU_Address@FCtl_FMI@0x021B7144@ */ ECIPP_ALIGNMENT_UBYTE 255 Compu_IDENTITY 0 255 PHYS_UNIT "FMI" /end CHARACTERISTIC
/begin CHARACTERISTIC FCfmi_EGOH3_off_open "FCtl_FMI(325)" VALUE 0x001E5A46 /* @ECU_Address@FCtl_FMI@0x021B7145@ */ ECIPP_ALIGNMENT_UBYTE 255 Compu_IDENTITY 0 255 PHYS_UNIT "FMI" /end CHARACTERISTIC
/begin CHARACTERISTIC FCfmi_EGOH3_on_short "FCtl_FMI(326)" VALUE 0x001E5A47 /* @ECU_Address@FCtl_FMI@0x021B7146@ */ ECIPP_ALIGNMENT_UBYTE 255 Compu_IDENTITY 0 255 PHYS_UNIT "FMI" /end CHARACTERISTIC
/begin CHARACTERISTIC FCfmi_EGOH4_off_open "FCtl_FMI(327)" VALUE 0x001E5A48 /* @ECU_Address@FCtl_FMI@0x021B7147@ */ ECIPP_ALIGNMENT_UBYTE 255 Compu_IDENTITY 0 255 PHYS_UNIT "FMI" /end CHARACTERISTIC
/begin CHARACTERISTIC FCfmi_EGOH4_on_short "FCtl_FMI(328)" VALUE 0x001E5A49 /* @ECU_Address@FCtl_FMI@0x021B7148@ */ ECIPP_ALIGNMENT_UBYTE 255 Compu_IDENTITY 0 255 PHYS_UNIT "FMI" /end CHARACTERISTIC
/begin CHARACTERISTIC FCfmi_EGR_clr_eta_lo "FCtl_FMI(666)" VALUE 0x001E5B9B /* @ECU_Address@FCtl_FMI@0x021B729A@ */ ECIPP_ALIGNMENT_UBYTE 255 Compu_IDENTITY 0 255 PHYS_UNIT "FMI" /end CHARACTERISTIC
/begin CHARACTERISTIC FCfmi_EGR_clr_eta_lo2 "FCtl_FMI(685)" VALUE 0x001E5BAE /* @ECU_Address@FCtl_FMI@0x021B72AD@ */ ECIPP_ALIGNMENT_UBYTE 255 Compu_IDENTITY 0 255 PHYS_UNIT "FMI" /end CHARACTERISTIC
/begin CHARACTERISTIC FCfmi_EGR_deice_excess "FCtl_FMI(829)" VALUE 0x001E5C3E /* @ECU_Address@FCtl_FMI@0x021B733D@ */ ECIPP_ALIGNMENT_UBYTE 255 Compu_IDENTITY 0 255 PHYS_UNIT "FMI" /end CHARACTERISTIC
/begin CHARACTERISTIC FCfmi_EGR_offmin_excess "FCtl_FMI(665)" VALUE 0x001E5B9A /* @ECU_Address@FCtl_FMI@0x021B7299@ */ ECIPP_ALIGNMENT_UBYTE 255 Compu_IDENTITY 0 255 PHYS_UNIT "FMI" /end CHARACTERISTIC
/begin CHARACTERISTIC FCfmi_EGR_OOA_hi "FCtl_FMI(661)" VALUE 0x001E5B96 /* @ECU_Address@FCtl_FMI@0x021B7295@ */ ECIPP_ALIGNMENT_UBYTE 255 Compu_IDENTITY 0 255 PHYS_UNIT "FMI" /end CHARACTERISTIC
/begin CHARACTERISTIC FCfmi_EGR_OOA_lo "FCtl_FMI(662)" VALUE 0x001E5B97 /* @ECU_Address@FCtl_FMI@0x021B7296@ */ ECIPP_ALIGNMENT_UBYTE 255 Compu_IDENTITY 0 255 PHYS_UNIT "FMI" /end CHARACTERISTIC
/begin CHARACTERISTIC FCfmi_EGR_slowdec "FCtl_FMI(660)" VALUE 0x001E5B95 /* @ECU_Address@FCtl_FMI@0x021B7294@ */ ECIPP_ALIGNMENT_UBYTE 255 Compu_IDENTITY 0 255 PHYS_UNIT "FMI" /end CHARACTERISTIC
/begin CHARACTERISTIC FCfmi_EGR_slowinc "FCtl_FMI(659)" VALUE 0x001E5B94 /* @ECU_Address@FCtl_FMI@0x021B7293@ */ ECIPP_ALIGNMENT_UBYTE 255 Compu_IDENTITY 0 255 PHYS_UNIT "FMI" /end CHARACTERISTIC
/begin CHARACTERISTIC FCfmi_EGR_UEGOdP_hi "FCtl_FMI(663)" VALUE 0x001E5B98 /* @ECU_Address@FCtl_FMI@0x021B7297@ */ ECIPP_ALIGNMENT_UBYTE 255 Compu_IDENTITY 0 255 PHYS_UNIT "FMI" /end CHARACTERISTIC
/begin CHARACTERISTIC FCfmi_EGR_UEGOdP_lo "FCtl_FMI(664)" VALUE 0x001E5B99 /* @ECU_Address@FCtl_FMI@0x021B7298@ */ ECIPP_ALIGNMENT_UBYTE 255 Compu_IDENTITY 0 255 PHYS_UNIT "FMI" /end CHARACTERISTIC
/begin CHARACTERISTIC FCfmi_EGR_vlv_DC_lim "FCtl_FMI(743)" VALUE 0x001E5BE8 /* @ECU_Address@FCtl_FMI@0x021B72E7@ */ ECIPP_ALIGNMENT_UBYTE 255 Compu_IDENTITY 0 255 PHYS_UNIT "FMI" /end CHARACTERISTIC
/begin CHARACTERISTIC FCfmi_EGR_vlv_HP_discon "FCtl_FMI(867)" VALUE 0x001E5C64 /* @ECU_Address@FCtl_FMI@0x021B7363@ */ ECIPP_ALIGNMENT_UBYTE 255 Compu_IDENTITY 0 255 PHYS_UNIT "FMI" /end CHARACTERISTIC
/begin CHARACTERISTIC FCfmi_EGR_vlv_stuck "FCtl_FMI(833)" VALUE 0x001E5C42 /* @ECU_Address@FCtl_FMI@0x021B7341@ */ ECIPP_ALIGNMENT_UBYTE 255 Compu_IDENTITY 0 255 PHYS_UNIT "FMI" /end CHARACTERISTIC
/begin CHARACTERISTIC FCfmi_EGR_vlv_temp_hi "FCtl_FMI(744)" VALUE 0x001E5BE9 /* @ECU_Address@FCtl_FMI@0x021B72E8@ */ ECIPP_ALIGNMENT_UBYTE 255 Compu_IDENTITY 0 255 PHYS_UNIT "FMI" /end CHARACTERISTIC
/begin CHARACTERISTIC FCfmi_EGR_vlvCAN_commlost "FCtl_FMI(667)" VALUE 0x001E5B9C /* @ECU_Address@FCtl_FMI@0x021B729B@ */ ECIPP_ALIGNMENT_UBYTE 255 Compu_IDENTITY 0 255 PHYS_UNIT "FMI" /end CHARACTERISTIC
/begin CHARACTERISTIC FCfmi_EGR_vlvCAN_lowfunc "FCtl_FMI(669)" VALUE 0x001E5B9E /* @ECU_Address@FCtl_FMI@0x021B729D@ */ ECIPP_ALIGNMENT_UBYTE 255 Compu_IDENTITY 0 255 PHYS_UNIT "FMI" /end CHARACTERISTIC
/begin CHARACTERISTIC FCfmi_EGR_vlvCAN_nofunc "FCtl_FMI(668)" VALUE 0x001E5B9D /* @ECU_Address@FCtl_FMI@0x021B729C@ */ ECIPP_ALIGNMENT_UBYTE 255 Compu_IDENTITY 0 255 PHYS_UNIT "FMI" /end CHARACTERISTIC
/begin CHARACTERISTIC FCftb_CL_phi_hi "FCtl_FTB_0x04(677)" VALUE 0x001E5FBC /* @ECU_Address@FCtl_FTB_0x04@0x024C52A5@ */ ECIPP_ALIGNMENT_UBYTE 255 Compu_IDENTITY 0 255 PHYS_UNIT "FTB" /end CHARACTERISTIC
/begin CHARACTERISTIC FCftb_CL_phi_lo "FCtl_FTB_0x04(678)" VALUE 0x001E5FBD /* @ECU_Address@FCtl_FTB_0x04@0x024C52A6@ */ ECIPP_ALIGNMENT_UBYTE 255 Compu_IDENTITY 0 255 PHYS_UNIT "FTB" /end CHARACTERISTIC
/begin CHARACTERISTIC FCftb_CLLP_hi "FCtl_FTB_0x04(36)" VALUE 0x001E5D3B /* @ECU_Address@FCtl_FTB_0x04@0x024C5024@ */ ECIPP_ALIGNMENT_UBYTE 255 Compu_IDENTITY 0 255 PHYS_UNIT "FTB" /end CHARACTERISTIC
/begin CHARACTERISTIC FCftb_CLLP_lo "FCtl_FTB_0x04(37)" VALUE 0x001E5D3C /* @ECU_Address@FCtl_FTB_0x04@0x024C5025@ */ ECIPP_ALIGNMENT_UBYTE 255 Compu_IDENTITY 0 255 PHYS_UNIT "FTB" /end CHARACTERISTIC
/begin CHARACTERISTIC FCftb_CLNG_hi "FCtl_FTB_0x04(38)" VALUE 0x001E5D3D /* @ECU_Address@FCtl_FTB_0x04@0x024C5026@ */ ECIPP_ALIGNMENT_UBYTE 255 Compu_IDENTITY 0 255 PHYS_UNIT "FTB" /end CHARACTERISTIC
/begin CHARACTERISTIC FCftb_CLNG_lo "FCtl_FTB_0x04(39)" VALUE 0x001E5D3E /* @ECU_Address@FCtl_FTB_0x04@0x024C5027@ */ ECIPP_ALIGNMENT_UBYTE 255 Compu_IDENTITY 0 255 PHYS_UNIT "FTB" /end CHARACTERISTIC
/begin CHARACTERISTIC FCftb_CM_unresp "FCtl_FTB_0x04(799)" VALUE 0x001E6036 /* @ECU_Address@FCtl_FTB_0x04@0x024C531F@ */ ECIPP_ALIGNMENT_UBYTE 255 Compu_IDENTITY 0 255 PHYS_UNIT "FTB" /end CHARACTERISTIC
/begin CHARACTERISTIC FCftb_CMgsln_inact "FCtl_FTB_0x04(130)" VALUE 0x001E5D99 /* @ECU_Address@FCtl_FTB_0x04@0x024C5082@ */ ECIPP_ALIGNMENT_UBYTE 255 Compu_IDENTITY 0 255 PHYS_UNIT "FTB" /end CHARACTERISTIC
/begin CHARACTERISTIC FCftb_CMLP_inact "FCtl_FTB_0x04(131)" VALUE 0x001E5D9A /* @ECU_Address@FCtl_FTB_0x04@0x024C5083@ */ ECIPP_ALIGNMENT_UBYTE 255 Compu_IDENTITY 0 255 PHYS_UNIT "FTB" /end CHARACTERISTIC
/begin CHARACTERISTIC FCftb_CMNG_inact "FCtl_FTB_0x04(132)" VALUE 0x001E5D9B /* @ECU_Address@FCtl_FTB_0x04@0x024C5084@ */ ECIPP_ALIGNMENT_UBYTE 255 Compu_IDENTITY 0 255 PHYS_UNIT "FTB" /end CHARACTERISTIC
/begin CHARACTERISTIC FCftb_COPfail "FCtl_FTB_0x04(99)" VALUE 0x001E5D7A /* @ECU_Address@FCtl_FTB_0x04@0x024C5063@ */ ECIPP_ALIGNMENT_UBYTE 255 Compu_IDENTITY 0 255 PHYS_UNIT "FTB" /end CHARACTERISTIC
/begin CHARACTERISTIC FCftb_COT_hi "FCtl_FTB_0x04(657)" VALUE 0x001E5FA8 /* @ECU_Address@FCtl_FTB_0x04@0x024C5291@ */ ECIPP_ALIGNMENT_UBYTE 255 Compu_IDENTITY 0 255 PHYS_UNIT "FTB" /end CHARACTERISTIC
/begin CHARACTERISTIC FCftb_crkloss "FCtl_FTB_0x04(152)" VALUE 0x001E5DAF /* @ECU_Address@FCtl_FTB_0x04@0x024C5098@ */ ECIPP_ALIGNMENT_UBYTE 255 Compu_IDENTITY 0 255 PHYS_UNIT "FTB" /end CHARACTERISTIC
/begin CHARACTERISTIC FCftb_crknever "FCtl_FTB_0x04(98)" VALUE 0x001E5D79 /* @ECU_Address@FCtl_FTB_0x04@0x024C5062@ */ ECIPP_ALIGNMENT_UBYTE 255 Compu_IDENTITY 0 255 PHYS_UNIT "FTB" /end CHARACTERISTIC
/begin CHARACTERISTIC FCftb_crknoise "FCtl_FTB_0x04(97)" VALUE 0x001E5D78 /* @ECU_Address@FCtl_FTB_0x04@0x024C5061@ */ ECIPP_ALIGNMENT_UBYTE 255 Compu_IDENTITY 0 255 PHYS_UNIT "FTB" /end CHARACTERISTIC
/begin CHARACTERISTIC FCftb_CVCS_discon "FCtl_FTB_0x04(747)" VALUE 0x001E6002 /* @ECU_Address@FCtl_FTB_0x04@0x024C52EB@ */ ECIPP_ALIGNMENT_UBYTE 255 Compu_IDENTITY 0 255 PHYS_UNIT "FTB" /end CHARACTERISTIC
/begin CHARACTERISTIC FCftb_CVDS_discon "FCtl_FTB_0x04(748)" VALUE 0x001E6003 /* @ECU_Address@FCtl_FTB_0x04@0x024C52EC@ */ ECIPP_ALIGNMENT_UBYTE 255 Compu_IDENTITY 0 255 PHYS_UNIT "FTB" /end CHARACTERISTIC
/begin CHARACTERISTIC FCftb_CVP1_hi "FCtl_FTB_0x04(794)" VALUE 0x001E6031 /* @ECU_Address@FCtl_FTB_0x04@0x024C531A@ */ ECIPP_ALIGNMENT_UBYTE 255 Compu_IDENTITY 0 255 PHYS_UNIT "FTB" /end CHARACTERISTIC
/begin CHARACTERISTIC FCftb_CVP1_lo "FCtl_FTB_0x04(795)" VALUE 0x001E6032 /* @ECU_Address@FCtl_FTB_0x04@0x024C531B@ */ ECIPP_ALIGNMENT_UBYTE 255 Compu_IDENTITY 0 255 PHYS_UNIT "FTB" /end CHARACTERISTIC
/begin CHARACTERISTIC FCftb_CVP2_hi "FCtl_FTB_0x04(796)" VALUE 0x001E6033 /* @ECU_Address@FCtl_FTB_0x04@0x024C531C@ */ ECIPP_ALIGNMENT_UBYTE 255 Compu_IDENTITY 0 255 PHYS_UNIT "FTB" /end CHARACTERISTIC
/begin CHARACTERISTIC FCftb_CVP2_lo "FCtl_FTB_0x04(797)" VALUE 0x001E6034 /* @ECU_Address@FCtl_FTB_0x04@0x024C531D@ */ ECIPP_ALIGNMENT_UBYTE 255 Compu_IDENTITY 0 255 PHYS_UNIT "FTB" /end CHARACTERISTIC
/begin CHARACTERISTIC FCftb_DBW_I_max "FCtl_FTB_0x04(527)" VALUE 0x001E5F26 /* @ECU_Address@FCtl_FTB_0x04@0x024C520F@ */ ECIPP_ALIGNMENT_UBYTE 255 Compu_IDENTITY 0 255 PHYS_UNIT "FTB" /end CHARACTERISTIC
/begin CHARACTERISTIC FCftb_ECam_maxerr "FCtl_FTB_0x04(289)" VALUE 0x001E5E38 /* @ECU_Address@FCtl_FTB_0x04@0x024C5121@ */ ECIPP_ALIGNMENT_UBYTE 255 Compu_IDENTITY 0 255 PHYS_UNIT "FTB" /end CHARACTERISTIC
/begin CHARACTERISTIC FCftb_ECL_low "FCtl_FTB_0x04(733)" VALUE 0x001E5FF4 /* @ECU_Address@FCtl_FTB_0x04@0x024C52DD@ */ ECIPP_ALIGNMENT_UBYTE 255 Compu_IDENTITY 0 255 PHYS_UNIT "FTB" /end CHARACTERISTIC
/begin CHARACTERISTIC FCftb_ECP_hiP "FCtl_FTB_0x04(1044)" VALUE 0x001E612B /* @ECU_Address@FCtl_FTB_0x04@0x024C5414@ */ ECIPP_ALIGNMENT_UBYTE 255 Compu_IDENTITY 0 255 PHYS_UNIT "FTB" /end CHARACTERISTIC
/begin CHARACTERISTIC FCftb_ECP_loP "FCtl_FTB_0x04(1043)" VALUE 0x001E612A /* @ECU_Address@FCtl_FTB_0x04@0x024C5413@ */ ECIPP_ALIGNMENT_UBYTE 255 Compu_IDENTITY 0 255 PHYS_UNIT "FTB" /end CHARACTERISTIC
/begin CHARACTERISTIC FCftb_ECT_AAT_dT_max "FCtl_FTB_0x04(842)" VALUE 0x001E6061 /* @ECU_Address@FCtl_FTB_0x04@0x024C534A@ */ ECIPP_ALIGNMENT_UBYTE 255 Compu_IDENTITY 0 255 PHYS_UNIT "FTB" /end CHARACTERISTIC
/begin CHARACTERISTIC FCftb_ECT_derate_actv "FCtl_FTB_0x04(828)" VALUE 0x001E6053 /* @ECU_Address@FCtl_FTB_0x04@0x024C533C@ */ ECIPP_ALIGNMENT_UBYTE 255 Compu_IDENTITY 0 255 PHYS_UNIT "FTB" /end CHARACTERISTIC
/begin CHARACTERISTIC FCftb_ECT_dT_max "FCtl_FTB_0x04(850)" VALUE 0x001E6069 /* @ECU_Address@FCtl_FTB_0x04@0x024C5352@ */ ECIPP_ALIGNMENT_UBYTE 255 Compu_IDENTITY 0 255 PHYS_UNIT "FTB" /end CHARACTERISTIC
/begin CHARACTERISTIC FCftb_ECT_EGRT_dT_max "FCtl_FTB_0x04(843)" VALUE 0x001E6062 /* @ECU_Address@FCtl_FTB_0x04@0x024C534B@ */ ECIPP_ALIGNMENT_UBYTE 255 Compu_IDENTITY 0 255 PHYS_UNIT "FTB" /end CHARACTERISTIC
/begin CHARACTERISTIC FCftb_ECT_EGT_dT_max "FCtl_FTB_0x04(846)" VALUE 0x001E6065 /* @ECU_Address@FCtl_FTB_0x04@0x024C534E@ */ ECIPP_ALIGNMENT_UBYTE 255 Compu_IDENTITY 0 255 PHYS_UNIT "FTB" /end CHARACTERISTIC
/begin CHARACTERISTIC FCftb_ECT_FT_dT_max "FCtl_FTB_0x04(844)" VALUE 0x001E6063 /* @ECU_Address@FCtl_FTB_0x04@0x024C534C@ */ ECIPP_ALIGNMENT_UBYTE 255 Compu_IDENTITY 0 255 PHYS_UNIT "FTB" /end CHARACTERISTIC
/begin CHARACTERISTIC FCftb_ECT_HiExp "FCtl_FTB_0x04(4)" VALUE 0x001E5D1B /* @ECU_Address@FCtl_FTB_0x04@0x024C5004@ */ ECIPP_ALIGNMENT_UBYTE 255 Compu_IDENTITY 0 255 PHYS_UNIT "FTB" /end CHARACTERISTIC
/begin CHARACTERISTIC FCftb_ECT_HiExp2 "FCtl_FTB_0x04(86)" VALUE 0x001E5D6D /* @ECU_Address@FCtl_FTB_0x04@0x024C5056@ */ ECIPP_ALIGNMENT_UBYTE 255 Compu_IDENTITY 0 255 PHYS_UNIT "FTB" /end CHARACTERISTIC
/begin CHARACTERISTIC FCftb_ECT_IAT_dT_max "FCtl_FTB_0x04(841)" VALUE 0x001E6060 /* @ECU_Address@FCtl_FTB_0x04@0x024C5349@ */ ECIPP_ALIGNMENT_UBYTE 255 Compu_IDENTITY 0 255 PHYS_UNIT "FTB" /end CHARACTERISTIC
/begin CHARACTERISTIC FCftb_ECT_LoExp "FCtl_FTB_0x04(648)" VALUE 0x001E5F9F /* @ECU_Address@FCtl_FTB_0x04@0x024C5288@ */ ECIPP_ALIGNMENT_UBYTE 255 Compu_IDENTITY 0 255 PHYS_UNIT "FTB" /end CHARACTERISTIC
/begin CHARACTERISTIC FCftb_ECT_LoExp2 "FCtl_FTB_0x04(649)" VALUE 0x001E5FA0 /* @ECU_Address@FCtl_FTB_0x04@0x024C5289@ */ ECIPP_ALIGNMENT_UBYTE 255 Compu_IDENTITY 0 255 PHYS_UNIT "FTB" /end CHARACTERISTIC
/begin CHARACTERISTIC FCftb_ECT_maxv "FCtl_FTB_0x04(2)" VALUE 0x001E5D19 /* @ECU_Address@FCtl_FTB_0x04@0x024C5002@ */ ECIPP_ALIGNMENT_UBYTE 255 Compu_IDENTITY 0 255 PHYS_UNIT "FTB" /end CHARACTERISTIC
/begin CHARACTERISTIC FCftb_ECT_minv "FCtl_FTB_0x04(3)" VALUE 0x001E5D1A /* @ECU_Address@FCtl_FTB_0x04@0x024C5003@ */ ECIPP_ALIGNMENT_UBYTE 255 Compu_IDENTITY 0 255 PHYS_UNIT "FTB" /end CHARACTERISTIC
/begin CHARACTERISTIC FCftb_ECT_OILT_dT_max "FCtl_FTB_0x04(845)" VALUE 0x001E6064 /* @ECU_Address@FCtl_FTB_0x04@0x024C534D@ */ ECIPP_ALIGNMENT_UBYTE 255 Compu_IDENTITY 0 255 PHYS_UNIT "FTB" /end CHARACTERISTIC
/begin CHARACTERISTIC FCftb_ECT_TAUX_dT1_max "FCtl_FTB_0x04(848)" VALUE 0x001E6067 /* @ECU_Address@FCtl_FTB_0x04@0x024C5350@ */ ECIPP_ALIGNMENT_UBYTE 255 Compu_IDENTITY 0 255 PHYS_UNIT "FTB" /end CHARACTERISTIC
/begin CHARACTERISTIC FCftb_ECT_TAUX_dT2_max "FCtl_FTB_0x04(849)" VALUE 0x001E6068 /* @ECU_Address@FCtl_FTB_0x04@0x024C5351@ */ ECIPP_ALIGNMENT_UBYTE 255 Compu_IDENTITY 0 255 PHYS_UNIT "FTB" /end CHARACTERISTIC
/begin CHARACTERISTIC FCftb_ECT_TIAT_dT_max "FCtl_FTB_0x04(847)" VALUE 0x001E6066 /* @ECU_Address@FCtl_FTB_0x04@0x024C534F@ */ ECIPP_ALIGNMENT_UBYTE 255 Compu_IDENTITY 0 255 PHYS_UNIT "FTB" /end CHARACTERISTIC
/begin CHARACTERISTIC FCftb_EGO1_open "FCtl_FTB_0x04(111)" VALUE 0x001E5D86 /* @ECU_Address@FCtl_FTB_0x04@0x024C506F@ */ ECIPP_ALIGNMENT_UBYTE 255 Compu_IDENTITY 0 255 PHYS_UNIT "FTB" /end CHARACTERISTIC
/begin CHARACTERISTIC FCftb_EGO2_open "FCtl_FTB_0x04(112)" VALUE 0x001E5D87 /* @ECU_Address@FCtl_FTB_0x04@0x024C5070@ */ ECIPP_ALIGNMENT_UBYTE 255 Compu_IDENTITY 0 255 PHYS_UNIT "FTB" /end CHARACTERISTIC
/begin CHARACTERISTIC FCftb_EGO3_open "FCtl_FTB_0x04(113)" VALUE 0x001E5D88 /* @ECU_Address@FCtl_FTB_0x04@0x024C5071@ */ ECIPP_ALIGNMENT_UBYTE 255 Compu_IDENTITY 0 255 PHYS_UNIT "FTB" /end CHARACTERISTIC
/begin CHARACTERISTIC FCftb_EGOH1_off_open "FCtl_FTB_0x04(321)" VALUE 0x001E5E58 /* @ECU_Address@FCtl_FTB_0x04@0x024C5141@ */ ECIPP_ALIGNMENT_UBYTE 255 Compu_IDENTITY 0 255 PHYS_UNIT "FTB" /end CHARACTERISTIC
/begin CHARACTERISTIC FCftb_EGOH1_on_short "FCtl_FTB_0x04(322)" VALUE 0x001E5E59 /* @ECU_Address@FCtl_FTB_0x04@0x024C5142@ */ ECIPP_ALIGNMENT_UBYTE 255 Compu_IDENTITY 0 255 PHYS_UNIT "FTB" /end CHARACTERISTIC
/begin CHARACTERISTIC FCftb_EGOH2_off_open "FCtl_FTB_0x04(323)" VALUE 0x001E5E5A /* @ECU_Address@FCtl_FTB_0x04@0x024C5143@ */ ECIPP_ALIGNMENT_UBYTE 255 Compu_IDENTITY 0 255 PHYS_UNIT "FTB" /end CHARACTERISTIC
/begin CHARACTERISTIC FCftb_EGOH2_on_short "FCtl_FTB_0x04(324)" VALUE 0x001E5E5B /* @ECU_Address@FCtl_FTB_0x04@0x024C5144@ */ ECIPP_ALIGNMENT_UBYTE 255 Compu_IDENTITY 0 255 PHYS_UNIT "FTB" /end CHARACTERISTIC
/begin CHARACTERISTIC FCftb_EGOH3_off_open "FCtl_FTB_0x04(325)" VALUE 0x001E5E5C /* @ECU_Address@FCtl_FTB_0x04@0x024C5145@ */ ECIPP_ALIGNMENT_UBYTE 255 Compu_IDENTITY 0 255 PHYS_UNIT "FTB" /end CHARACTERISTIC
/begin CHARACTERISTIC FCftb_EGOH3_on_short "FCtl_FTB_0x04(326)" VALUE 0x001E5E5D /* @ECU_Address@FCtl_FTB_0x04@0x024C5146@ */ ECIPP_ALIGNMENT_UBYTE 255 Compu_IDENTITY 0 255 PHYS_UNIT "FTB" /end CHARACTERISTIC
/begin CHARACTERISTIC FCftb_EGOH4_off_open "FCtl_FTB_0x04(327)" VALUE 0x001E5E5E /* @ECU_Address@FCtl_FTB_0x04@0x024C5147@ */ ECIPP_ALIGNMENT_UBYTE 255 Compu_IDENTITY 0 255 PHYS_UNIT "FTB" /end CHARACTERISTIC
/begin CHARACTERISTIC FCftb_EGOH4_on_short "FCtl_FTB_0x04(328)" VALUE 0x001E5E5F /* @ECU_Address@FCtl_FTB_0x04@0x024C5148@ */ ECIPP_ALIGNMENT_UBYTE 255 Compu_IDENTITY 0 255 PHYS_UNIT "FTB" /end CHARACTERISTIC
/begin CHARACTERISTIC FCftb_EGR_clr_eta_lo "FCtl_FTB_0x04(666)" VALUE 0x001E5FB1 /* @ECU_Address@FCtl_FTB_0x04@0x024C529A@ */ ECIPP_ALIGNMENT_UBYTE 255 Compu_IDENTITY 0 255 PHYS_UNIT "FTB" /end CHARACTERISTIC
/begin CHARACTERISTIC FCftb_EGR_clr_eta_lo2 "FCtl_FTB_0x04(685)" VALUE 0x001E5FC4 /* @ECU_Address@FCtl_FTB_0x04@0x024C52AD@ */ ECIPP_ALIGNMENT_UBYTE 255 Compu_IDENTITY 0 255 PHYS_UNIT "FTB" /end CHARACTERISTIC
/begin CHARACTERISTIC FCftb_EGR_deice_excess "FCtl_FTB_0x04(829)" VALUE 0x001E6054 /* @ECU_Address@FCtl_FTB_0x04@0x024C533D@ */ ECIPP_ALIGNMENT_UBYTE 255 Compu_IDENTITY 0 255 PHYS_UNIT "FTB" /end CHARACTERISTIC
/begin CHARACTERISTIC FCftb_EGR_offmin_excess "FCtl_FTB_0x04(665)" VALUE 0x001E5FB0 /* @ECU_Address@FCtl_FTB_0x04@0x024C5299@ */ ECIPP_ALIGNMENT_UBYTE 255 Compu_IDENTITY 0 255 PHYS_UNIT "FTB" /end CHARACTERISTIC
/begin CHARACTERISTIC FCftb_EGR_OOA_hi "FCtl_FTB_0x04(661)" VALUE 0x001E5FAC /* @ECU_Address@FCtl_FTB_0x04@0x024C5295@ */ ECIPP_ALIGNMENT_UBYTE 255 Compu_IDENTITY 0 255 PHYS_UNIT "FTB" /end CHARACTERISTIC
/begin CHARACTERISTIC FCftb_EGR_OOA_lo "FCtl_FTB_0x04(662)" VALUE 0x001E5FAD /* @ECU_Address@FCtl_FTB_0x04@0x024C5296@ */ ECIPP_ALIGNMENT_UBYTE 255 Compu_IDENTITY 0 255 PHYS_UNIT "FTB" /end CHARACTERISTIC
/begin CHARACTERISTIC FCftb_EGR_slowdec "FCtl_FTB_0x04(660)" VALUE 0x001E5FAB /* @ECU_Address@FCtl_FTB_0x04@0x024C5294@ */ ECIPP_ALIGNMENT_UBYTE 255 Compu_IDENTITY 0 255 PHYS_UNIT "FTB" /end CHARACTERISTIC
/begin CHARACTERISTIC FCftb_EGR_slowinc "FCtl_FTB_0x04(659)" VALUE 0x001E5FAA /* @ECU_Address@FCtl_FTB_0x04@0x024C5293@ */ ECIPP_ALIGNMENT_UBYTE 255 Compu_IDENTITY 0 255 PHYS_UNIT "FTB" /end CHARACTERISTIC
/begin CHARACTERISTIC FCftb_EGR_UEGOdP_hi "FCtl_FTB_0x04(663)" VALUE 0x001E5FAE /* @ECU_Address@FCtl_FTB_0x04@0x024C5297@ */ ECIPP_ALIGNMENT_UBYTE 255 Compu_IDENTITY 0 255 PHYS_UNIT "FTB" /end CHARACTERISTIC
/begin CHARACTERISTIC FCftb_EGR_UEGOdP_lo "FCtl_FTB_0x04(664)" VALUE 0x001E5FAF /* @ECU_Address@FCtl_FTB_0x04@0x024C5298@ */ ECIPP_ALIGNMENT_UBYTE 255 Compu_IDENTITY 0 255 PHYS_UNIT "FTB" /end CHARACTERISTIC
/begin CHARACTERISTIC FCftb_EGR_vlv_DC_lim "FCtl_FTB_0x04(743)" VALUE 0x001E5FFE /* @ECU_Address@FCtl_FTB_0x04@0x024C52E7@ */ ECIPP_ALIGNMENT_UBYTE 255 Compu_IDENTITY 0 255 PHYS_UNIT "FTB" /end CHARACTERISTIC
/begin CHARACTERISTIC FCftb_EGR_vlv_HP_discon "FCtl_FTB_0x04(867)" VALUE 0x001E607A /* @ECU_Address@FCtl_FTB_0x04@0x024C5363@ */ ECIPP_ALIGNMENT_UBYTE 255 Compu_IDENTITY 0 255 PHYS_UNIT "FTB" /end CHARACTERISTIC
/begin CHARACTERISTIC FCftb_EGR_vlv_stuck "FCtl_FTB_0x04(833)" VALUE 0x001E6058 /* @ECU_Address@FCtl_FTB_0x04@0x024C5341@ */ ECIPP_ALIGNMENT_UBYTE 255 Compu_IDENTITY 0 255 PHYS_UNIT "FTB" /end CHARACTERISTIC
/begin CHARACTERISTIC FCftb_EGR_vlv_temp_hi "FCtl_FTB_0x04(744)" VALUE 0x001E5FFF /* @ECU_Address@FCtl_FTB_0x04@0x024C52E8@ */ ECIPP_ALIGNMENT_UBYTE 255 Compu_IDENTITY 0 255 PHYS_UNIT "FTB" /end CHARACTERISTIC
/begin CHARACTERISTIC FCftb_EGR_vlvCAN_commlost "FCtl_FTB_0x04(667)" VALUE 0x001E5FB2 /* @ECU_Address@FCtl_FTB_0x04@0x024C529B@ */ ECIPP_ALIGNMENT_UBYTE 255 Compu_IDENTITY 0 255 PHYS_UNIT "FTB" /end CHARACTERISTIC
/begin CHARACTERISTIC FCftb_EGR_vlvCAN_lowfunc "FCtl_FTB_0x04(669)" VALUE 0x001E5FB4 /* @ECU_Address@FCtl_FTB_0x04@0x024C529D@ */ ECIPP_ALIGNMENT_UBYTE 255 Compu_IDENTITY 0 255 PHYS_UNIT "FTB" /end CHARACTERISTIC
/begin CHARACTERISTIC FCftb_EGR_vlvCAN_nofunc "FCtl_FTB_0x04(668)" VALUE 0x001E5FB3 /* @ECU_Address@FCtl_FTB_0x04@0x024C529C@ */ ECIPP_ALIGNMENT_UBYTE 255 Compu_IDENTITY 0 255 PHYS_UNIT "FTB" /end CHARACTERISTIC
/begin CHARACTERISTIC FCspn_CL_phi_hi "FCtl_SPN(677)" VALUE 0x001E27F8 /* @ECU_Address@FCtl_SPN@0x21B60A94@ */ ECIPP_ALIGNMENT_ULONG 4294967295 Compu_IDENTITY 0 4294967295 PHYS_UNIT "SPN" /end CHARACTERISTIC
/begin CHARACTERISTIC FCspn_CL_phi_lo "FCtl_SPN(678)" VALUE 0x001E27FC /* @ECU_Address@FCtl_SPN@0x21B60A98@ */ ECIPP_ALIGNMENT_ULONG 4294967295 Compu_IDENTITY 0 4294967295 PHYS_UNIT "SPN" /end CHARACTERISTIC
/begin CHARACTERISTIC FCspn_CLLP_hi "FCtl_SPN(36)" VALUE 0x001E1DF4 /* @ECU_Address@FCtl_SPN@0x21B60090@ */ ECIPP_ALIGNMENT_ULONG 4294967295 Compu_IDENTITY 0 4294967295 PHYS_UNIT "SPN" /end CHARACTERISTIC
/begin CHARACTERISTIC FCspn_CLLP_lo "FCtl_SPN(37)" VALUE 0x001E1DF8 /* @ECU_Address@FCtl_SPN@0x21B60094@ */ ECIPP_ALIGNMENT_ULONG 4294967295 Compu_IDENTITY 0 4294967295 PHYS_UNIT "SPN" /end CHARACTERISTIC
/begin CHARACTERISTIC FCspn_CLNG_hi "FCtl_SPN(38)" VALUE 0x001E1DFC /* @ECU_Address@FCtl_SPN@0x21B60098@ */ ECIPP_ALIGNMENT_ULONG 4294967295 Compu_IDENTITY 0 4294967295 PHYS_UNIT "SPN" /end CHARACTERISTIC
/begin CHARACTERISTIC FCspn_CLNG_lo "FCtl_SPN(39)" VALUE 0x001E1E00 /* @ECU_Address@FCtl_SPN@0x21B6009C@ */ ECIPP_ALIGNMENT_ULONG 4294967295 Compu_IDENTITY 0 4294967295 PHYS_UNIT "SPN" /end CHARACTERISTIC
/begin CHARACTERISTIC FCspn_CM_unresp "FCtl_SPN(799)" VALUE 0x001E29E0 /* @ECU_Address@FCtl_SPN@0x21B60C7C@ */ ECIPP_ALIGNMENT_ULONG 4294967295 Compu_IDENTITY 0 4294967295 PHYS_UNIT "SPN" /end CHARACTERISTIC
/begin CHARACTERISTIC FCspn_CMgsln_inact "FCtl_SPN(130)" VALUE 0x001E1F6C /* @ECU_Address@FCtl_SPN@0x21B60208@ */ ECIPP_ALIGNMENT_ULONG 4294967295 Compu_IDENTITY 0 4294967295 PHYS_UNIT "SPN" /end CHARACTERISTIC
/begin CHARACTERISTIC FCspn_CMLP_inact "FCtl_SPN(131)" VALUE 0x001E1F70 /* @ECU_Address@FCtl_SPN@0x21B6020C@ */ ECIPP_ALIGNMENT_ULONG 4294967295 Compu_IDENTITY 0 4294967295 PHYS_UNIT "SPN" /end CHARACTERISTIC
/begin CHARACTERISTIC FCspn_CMNG_inact "FCtl_SPN(132)" VALUE 0x001E1F74 /* @ECU_Address@FCtl_SPN@0x21B60210@ */ ECIPP_ALIGNMENT_ULONG 4294967295 Compu_IDENTITY 0 4294967295 PHYS_UNIT "SPN" /end CHARACTERISTIC
/begin CHARACTERISTIC FCspn_COPfail "FCtl_SPN(99)" VALUE 0x001E1EF0 /* @ECU_Address@FCtl_SPN@0x21B6018C@ */ ECIPP_ALIGNMENT_ULONG 4294967295 Compu_IDENTITY 0 4294967295 PHYS_UNIT "SPN" /end CHARACTERISTIC
/begin CHARACTERISTIC FCspn_COT_hi "FCtl_SPN(657)" VALUE 0x001E27A8 /* @ECU_Address@FCtl_SPN@0x21B60A44@ */ ECIPP_ALIGNMENT_ULONG 4294967295 Compu_IDENTITY 0 4294967295 PHYS_UNIT "SPN" /end CHARACTERISTIC
/begin CHARACTERISTIC FCspn_crkloss "FCtl_SPN(152)" VALUE 0x001E1FC4 /* @ECU_Address@FCtl_SPN@0x21B60260@ */ ECIPP_ALIGNMENT_ULONG 4294967295 Compu_IDENTITY 0 4294967295 PHYS_UNIT "SPN" /end CHARACTERISTIC
/begin CHARACTERISTIC FCspn_crknever "FCtl_SPN(98)" VALUE 0x001E1EEC /* @ECU_Address@FCtl_SPN@0x21B60188@ */ ECIPP_ALIGNMENT_ULONG 4294967295 Compu_IDENTITY 0 4294967295 PHYS_UNIT "SPN" /end CHARACTERISTIC
/begin CHARACTERISTIC FCspn_crknoise "FCtl_SPN(97)" VALUE 0x001E1EE8 /* @ECU_Address@FCtl_SPN@0x21B60184@ */ ECIPP_ALIGNMENT_ULONG 4294967295 Compu_IDENTITY 0 4294967295 PHYS_UNIT "SPN" /end CHARACTERISTIC
/begin CHARACTERISTIC FCspn_CVCS_discon "FCtl_SPN(747)" VALUE 0x001E2910 /* @ECU_Address@FCtl_SPN@0x21B60BAC@ */ ECIPP_ALIGNMENT_ULONG 4294967295 Compu_IDENTITY 0 4294967295 PHYS_UNIT "SPN" /end CHARACTERISTIC
/begin CHARACTERISTIC FCspn_CVDS_discon "FCtl_SPN(748)" VALUE 0x001E2914 /* @ECU_Address@FCtl_SPN@0x21B60BB0@ */ ECIPP_ALIGNMENT_ULONG 4294967295 Compu_IDENTITY 0 4294967295 PHYS_UNIT "SPN" /end CHARACTERISTIC
/begin CHARACTERISTIC FCspn_CVP1_hi "FCtl_SPN(794)" VALUE 0x001E29CC /* @ECU_Address@FCtl_SPN@0x21B60C68@ */ ECIPP_ALIGNMENT_ULONG 4294967295 Compu_IDENTITY 0 4294967295 PHYS_UNIT "SPN" /end CHARACTERISTIC
/begin CHARACTERISTIC FCspn_CVP1_lo "FCtl_SPN(795)" VALUE 0x001E29D0 /* @ECU_Address@FCtl_SPN@0x21B60C6C@ */ ECIPP_ALIGNMENT_ULONG 4294967295 Compu_IDENTITY 0 4294967295 PHYS_UNIT "SPN" /end CHARACTERISTIC
/begin CHARACTERISTIC FCspn_CVP2_hi "FCtl_SPN(796)" VALUE 0x001E29D4 /* @ECU_Address@FCtl_SPN@0x21B60C70@ */ ECIPP_ALIGNMENT_ULONG 4294967295 Compu_IDENTITY 0 4294967295 PHYS_UNIT "SPN" /end CHARACTERISTIC
/begin CHARACTERISTIC FCspn_CVP2_lo "FCtl_SPN(797)" VALUE 0x001E29D8 /* @ECU_Address@FCtl_SPN@0x21B60C74@ */ ECIPP_ALIGNMENT_ULONG 4294967295 Compu_IDENTITY 0 4294967295 PHYS_UNIT "SPN" /end CHARACTERISTIC
/begin CHARACTERISTIC FCspn_DBW_I_max "FCtl_SPN(527)" VALUE 0x001E25A0 /* @ECU_Address@FCtl_SPN@0x21B6083C@ */ ECIPP_ALIGNMENT_ULONG 4294967295 Compu_IDENTITY 0 4294967295 PHYS_UNIT "SPN" /end CHARACTERISTIC
/begin CHARACTERISTIC FCspn_ECam_maxerr "FCtl_SPN(289)" VALUE 0x001E21E8 /* @ECU_Address@FCtl_SPN@0x21B60484@ */ ECIPP_ALIGNMENT_ULONG 4294967295 Compu_IDENTITY 0 4294967295 PHYS_UNIT "SPN" /end CHARACTERISTIC
/begin CHARACTERISTIC FCspn_ECL_low "FCtl_SPN(733)" VALUE 0x001E28D8 /* @ECU_Address@FCtl_SPN@0x21B60B74@ */ ECIPP_ALIGNMENT_ULONG 4294967295 Compu_IDENTITY 0 4294967295 PHYS_UNIT "SPN" /end CHARACTERISTIC
/begin CHARACTERISTIC FCspn_ECP_hiP "FCtl_SPN(1044)" VALUE 0x001E2DB4 /* @ECU_Address@FCtl_SPN@0x21B61050@ */ ECIPP_ALIGNMENT_ULONG 4294967295 Compu_IDENTITY 0 4294967295 PHYS_UNIT "SPN" /end CHARACTERISTIC
/begin CHARACTERISTIC FCspn_ECP_loP "FCtl_SPN(1043)" VALUE 0x001E2DB0 /* @ECU_Address@FCtl_SPN@0x21B6104C@ */ ECIPP_ALIGNMENT_ULONG 4294967295 Compu_IDENTITY 0 4294967295 PHYS_UNIT "SPN" /end CHARACTERISTIC
/begin CHARACTERISTIC FCspn_ECT_AAT_dT_max "FCtl_SPN(842)" VALUE 0x001E2A8C /* @ECU_Address@FCtl_SPN@0x21B60D28@ */ ECIPP_ALIGNMENT_ULONG 4294967295 Compu_IDENTITY 0 4294967295 PHYS_UNIT "SPN" /end CHARACTERISTIC
/begin CHARACTERISTIC FCspn_ECT_derate_actv "FCtl_SPN(828)" VALUE 0x001E2A54 /* @ECU_Address@FCtl_SPN@0x21B60CF0@ */ ECIPP_ALIGNMENT_ULONG 4294967295 Compu_IDENTITY 0 4294967295 PHYS_UNIT "SPN" /end CHARACTERISTIC
/begin CHARACTERISTIC FCspn_ECT_dT_max "FCtl_SPN(850)" VALUE 0x001E2AAC /* @ECU_Address@FCtl_SPN@0x21B60D48@ */ ECIPP_ALIGNMENT_ULONG 4294967295 Compu_IDENTITY 0 4294967295 PHYS_UNIT "SPN" /end CHARACTERISTIC
/begin CHARACTERISTIC FCspn_ECT_EGRT_dT_max "FCtl_SPN(843)" VALUE 0x001E2A90 /* @ECU_Address@FCtl_SPN@0x21B60D2C@ */ ECIPP_ALIGNMENT_ULONG 4294967295 Compu_IDENTITY 0 4294967295 PHYS_UNIT "SPN" /end CHARACTERISTIC
/begin CHARACTERISTIC FCspn_ECT_EGT_dT_max "FCtl_SPN(846)" VALUE 0x001E2A9C /* @ECU_Address@FCtl_SPN@0x21B60D38@ */ ECIPP_ALIGNMENT_ULONG 4294967295 Compu_IDENTITY 0 4294967295 PHYS_UNIT "SPN" /end CHARACTERISTIC
/begin CHARACTERISTIC FCspn_ECT_FT_dT_max "FCtl_SPN(844)" VALUE 0x001E2A94 /* @ECU_Address@FCtl_SPN@0x21B60D30@ */ ECIPP_ALIGNMENT_ULONG 4294967295 Compu_IDENTITY 0 4294967295 PHYS_UNIT "SPN" /end CHARACTERISTIC
/begin CHARACTERISTIC FCspn_ECT_HiExp "FCtl_SPN(4)" VALUE 0x001E1D74 /* @ECU_Address@FCtl_SPN@0x21B60010@ */ ECIPP_ALIGNMENT_ULONG 4294967295 Compu_IDENTITY 0 4294967295 PHYS_UNIT "SPN" /end CHARACTERISTIC
/begin CHARACTERISTIC FCspn_ECT_HiExp2 "FCtl_SPN(86)" VALUE 0x001E1EBC /* @ECU_Address@FCtl_SPN@0x21B60158@ */ ECIPP_ALIGNMENT_ULONG 4294967295 Compu_IDENTITY 0 4294967295 PHYS_UNIT "SPN" /end CHARACTERISTIC
/begin CHARACTERISTIC FCspn_ECT_IAT_dT_max "FCtl_SPN(841)" VALUE 0x001E2A88 /* @ECU_Address@FCtl_SPN@0x21B60D24@ */ ECIPP_ALIGNMENT_ULONG 4294967295 Compu_IDENTITY 0 4294967295 PHYS_UNIT "SPN" /end CHARACTERISTIC
/begin CHARACTERISTIC FCspn_ECT_LoExp "FCtl_SPN(648)" VALUE 0x001E2784 /* @ECU_Address@FCtl_SPN@0x21B60A20@ */ ECIPP_ALIGNMENT_ULONG 4294967295 Compu_IDENTITY 0 4294967295 PHYS_UNIT "SPN" /end CHARACTERISTIC
/begin CHARACTERISTIC FCspn_ECT_LoExp2 "FCtl_SPN(649)" VALUE 0x001E2788 /* @ECU_Address@FCtl_SPN@0x21B60A24@ */ ECIPP_ALIGNMENT_ULONG 4294967295 Compu_IDENTITY 0 4294967295 PHYS_UNIT "SPN" /end CHARACTERISTIC
/begin CHARACTERISTIC FCspn_ECT_maxv "FCtl_SPN(2)" VALUE 0x001E1D6C /* @ECU_Address@FCtl_SPN@0x21B60008@ */ ECIPP_ALIGNMENT_ULONG 4294967295 Compu_IDENTITY 0 4294967295 PHYS_UNIT "SPN" /end CHARACTERISTIC
/begin CHARACTERISTIC FCspn_ECT_minv "FCtl_SPN(3)" VALUE 0x001E1D70 /* @ECU_Address@FCtl_SPN@0x21B6000C@ */ ECIPP_ALIGNMENT_ULONG 4294967295 Compu_IDENTITY 0 4294967295 PHYS_UNIT "SPN" /end CHARACTERISTIC
/begin CHARACTERISTIC FCspn_ECT_OILT_dT_max "FCtl_SPN(845)" VALUE 0x001E2A98 /* @ECU_Address@FCtl_SPN@0x21B60D34@ */ ECIPP_ALIGNMENT_ULONG 4294967295 Compu_IDENTITY 0 4294967295 PHYS_UNIT "SPN" /end CHARACTERISTIC
/begin CHARACTERISTIC FCspn_ECT_TAUX_dT1_max "FCtl_SPN(848)" VALUE 0x001E2AA4 /* @ECU_Address@FCtl_SPN@0x21B60D40@ */ ECIPP_ALIGNMENT_ULONG 4294967295 Compu_IDENTITY 0 4294967295 PHYS_UNIT "SPN" /end CHARACTERISTIC
/begin CHARACTERISTIC FCspn_ECT_TAUX_dT2_max "FCtl_SPN(849)" VALUE 0x001E2AA8 /* @ECU_Address@FCtl_SPN@0x21B60D44@ */ ECIPP_ALIGNMENT_ULONG 4294967295 Compu_IDENTITY 0 4294967295 PHYS_UNIT "SPN" /end CHARACTERISTIC
/begin CHARACTERISTIC FCspn_ECT_TIAT_dT_max "FCtl_SPN(847)" VALUE 0x001E2AA0 /* @ECU_Address@FCtl_SPN@0x21B60D3C@ */ ECIPP_ALIGNMENT_ULONG 4294967295 Compu_IDENTITY 0 4294967295 PHYS_UNIT "SPN" /end CHARACTERISTIC
/begin CHARACTERISTIC FCspn_EGO1_open "FCtl_SPN(111)" VALUE 0x001E1F20 /* @ECU_Address@FCtl_SPN@0x21B601BC@ */ ECIPP_ALIGNMENT_ULONG 4294967295 Compu_IDENTITY 0 4294967295 PHYS_UNIT "SPN" /end CHARACTERISTIC
/begin CHARACTERISTIC FCspn_EGO2_open "FCtl_SPN(112)" VALUE 0x001E1F24 /* @ECU_Address@FCtl_SPN@0x21B601C0@ */ ECIPP_ALIGNMENT_ULONG 4294967295 Compu_IDENTITY 0 4294967295 PHYS_UNIT "SPN" /end CHARACTERISTIC
/begin CHARACTERISTIC FCspn_EGO3_open "FCtl_SPN(113)" VALUE 0x001E1F28 /* @ECU_Address@FCtl_SPN@0x21B601C4@ */ ECIPP_ALIGNMENT_ULONG 4294967295 Compu_IDENTITY 0 4294967295 PHYS_UNIT "SPN" /end CHARACTERISTIC
/begin CHARACTERISTIC FCspn_EGOH1_off_open "FCtl_SPN(321)" VALUE 0x001E2268 /* @ECU_Address@FCtl_SPN@0x21B60504@ */ ECIPP_ALIGNMENT_ULONG 4294967295 Compu_IDENTITY 0 4294967295 PHYS_UNIT "SPN" /end CHARACTERISTIC
/begin CHARACTERISTIC FCspn_EGOH1_on_short "FCtl_SPN(322)" VALUE 0x001E226C /* @ECU_Address@FCtl_SPN@0x21B60508@ */ ECIPP_ALIGNMENT_ULONG 4294967295 Compu_IDENTITY 0 4294967295 PHYS_UNIT "SPN" /end CHARACTERISTIC
/begin CHARACTERISTIC FCspn_EGOH2_off_open "FCtl_SPN(323)" VALUE 0x001E2270 /* @ECU_Address@FCtl_SPN@0x21B6050C@ */ ECIPP_ALIGNMENT_ULONG 4294967295 Compu_IDENTITY 0 4294967295 PHYS_UNIT "SPN" /end CHARACTERISTIC
/begin CHARACTERISTIC FCspn_EGOH2_on_short "FCtl_SPN(324)" VALUE 0x001E2274 /* @ECU_Address@FCtl_SPN@0x21B60510@ */ ECIPP_ALIGNMENT_ULONG 4294967295 Compu_IDENTITY 0 4294967295 PHYS_UNIT "SPN" /end CHARACTERISTIC
/begin CHARACTERISTIC FCspn_EGOH3_off_open "FCtl_SPN(325)" VALUE 0x001E2278 /* @ECU_Address@FCtl_SPN@0x21B60514@ */ ECIPP_ALIGNMENT_ULONG 4294967295 Compu_IDENTITY 0 4294967295 PHYS_UNIT "SPN" /end CHARACTERISTIC
/begin CHARACTERISTIC FCspn_EGOH3_on_short "FCtl_SPN(326)" VALUE 0x001E227C /* @ECU_Address@FCtl_SPN@0x21B60518@ */ ECIPP_ALIGNMENT_ULONG 4294967295 Compu_IDENTITY 0 4294967295 PHYS_UNIT "SPN" /end CHARACTERISTIC
/begin CHARACTERISTIC FCspn_EGOH4_off_open "FCtl_SPN(327)" VALUE 0x001E2280 /* @ECU_Address@FCtl_SPN@0x21B6051C@ */ ECIPP_ALIGNMENT_ULONG 4294967295 Compu_IDENTITY 0 4294967295 PHYS_UNIT "SPN" /end CHARACTERISTIC
/begin CHARACTERISTIC FCspn_EGOH4_on_short "FCtl_SPN(328)" VALUE 0x001E2284 /* @ECU_Address@FCtl_SPN@0x21B60520@ */ ECIPP_ALIGNMENT_ULONG 4294967295 Compu_IDENTITY 0 4294967295 PHYS_UNIT "SPN" /end CHARACTERISTIC
/begin CHARACTERISTIC FCspn_EGR_clr_eta_lo "FCtl_SPN(666)" VALUE 0x001E27CC /* @ECU_Address@FCtl_SPN@0x21B60A68@ */ ECIPP_ALIGNMENT_ULONG 4294967295 Compu_IDENTITY 0 4294967295 PHYS_UNIT "SPN" /end CHARACTERISTIC
/begin CHARACTERISTIC FCspn_EGR_clr_eta_lo2 "FCtl_SPN(685)" VALUE 0x001E2818 /* @ECU_Address@FCtl_SPN@0x21B60AB4@ */ ECIPP_ALIGNMENT_ULONG 4294967295 Compu_IDENTITY 0 4294967295 PHYS_UNIT "SPN" /end CHARACTERISTIC
/begin CHARACTERISTIC FCspn_EGR_deice_excess "FCtl_SPN(829)" VALUE 0x001E2A58 /* @ECU_Address@FCtl_SPN@0x21B60CF4@ */ ECIPP_ALIGNMENT_ULONG 4294967295 Compu_IDENTITY 0 4294967295 PHYS_UNIT "SPN" /end CHARACTERISTIC
/begin CHARACTERISTIC FCspn_EGR_offmin_excess "FCtl_SPN(665)" VALUE 0x001E27C8 /* @ECU_Address@FCtl_SPN@0x21B60A64@ */ ECIPP_ALIGNMENT_ULONG 4294967295 Compu_IDENTITY 0 4294967295 PHYS_UNIT "SPN" /end CHARACTERISTIC
/begin CHARACTERISTIC FCspn_EGR_OOA_hi "FCtl_SPN(661)" VALUE 0x001E27B8 /* @ECU_Address@FCtl_SPN@0x21B60A54@ */ ECIPP_ALIGNMENT_ULONG 4294967295 Compu_IDENTITY 0 4294967295 PHYS_UNIT "SPN" /end CHARACTERISTIC
/begin CHARACTERISTIC FCspn_EGR_OOA_lo "FCtl_SPN(662)" VALUE 0x001E27BC /* @ECU_Address@FCtl_SPN@0x21B60A58@ */ ECIPP_ALIGNMENT_ULONG 4294967295 Compu_IDENTITY 0 4294967295 PHYS_UNIT "SPN" /end CHARACTERISTIC
/begin CHARACTERISTIC FCspn_EGR_slowdec "FCtl_SPN(660)" VALUE 0x001E27B4 /* @ECU_Address@FCtl_SPN@0x21B60A50@ */ ECIPP_ALIGNMENT_ULONG 4294967295 Compu_IDENTITY 0 4294967295 PHYS_UNIT "SPN" /end CHARACTERISTIC
/begin CHARACTERISTIC FCspn_EGR_slowinc "FCtl_SPN(659)" VALUE 0x001E27B0 /* @ECU_Address@FCtl_SPN@0x21B60A4C@ */ ECIPP_ALIGNMENT_ULONG 4294967295 Compu_IDENTITY 0 4294967295 PHYS_UNIT "SPN" /end CHARACTERISTIC
/begin CHARACTERISTIC FCspn_EGR_UEGOdP_hi "FCtl_SPN(663)" VALUE 0x001E27C0 /* @ECU_Address@FCtl_SPN@0x21B60A5C@ */ ECIPP_ALIGNMENT_ULONG 4294967295 Compu_IDENTITY 0 4294967295 PHYS_UNIT "SPN" /end CHARACTERISTIC
/begin CHARACTERISTIC FCspn_EGR_UEGOdP_lo "FCtl_SPN(664)" VALUE 0x001E27C4 /* @ECU_Address@FCtl_SPN@0x21B60A60@ */ ECIPP_ALIGNMENT_ULONG 4294967295 Compu_IDENTITY 0 4294967295 PHYS_UNIT "SPN" /end CHARACTERISTIC
/begin CHARACTERISTIC FCspn_EGR_vlv_DC_lim "FCtl_SPN(743)" VALUE 0x001E2900 /* @ECU_Address@FCtl_SPN@0x21B60B9C@ */ ECIPP_ALIGNMENT_ULONG 4294967295 Compu_IDENTITY 0 4294967295 PHYS_UNIT "SPN" /end CHARACTERISTIC
/begin CHARACTERISTIC FCspn_EGR_vlv_HP_discon "FCtl_SPN(867)" VALUE 0x001E2AF0 /* @ECU_Address@FCtl_SPN@0x21B60D8C@ */ ECIPP_ALIGNMENT_ULONG 4294967295 Compu_IDENTITY 0 4294967295 PHYS_UNIT "SPN" /end CHARACTERISTIC
/begin CHARACTERISTIC FCspn_EGR_vlv_stuck "FCtl_SPN(833)" VALUE 0x001E2A68 /* @ECU_Address@FCtl_SPN@0x21B60D04@ */ ECIPP_ALIGNMENT_ULONG 4294967295 Compu_IDENTITY 0 4294967295 PHYS_UNIT "SPN" /end CHARACTERISTIC
/begin CHARACTERISTIC FCspn_EGR_vlv_temp_hi "FCtl_SPN(744)" VALUE 0x001E2904 /* @ECU_Address@FCtl_SPN@0x21B60BA0@ */ ECIPP_ALIGNMENT_ULONG 4294967295 Compu_IDENTITY 0 4294967295 PHYS_UNIT "SPN" /end CHARACTERISTIC
/begin CHARACTERISTIC FCspn_EGR_vlvCAN_commlost "FCtl_SPN(667)" VALUE 0x001E27D0 /* @ECU_Address@FCtl_SPN@0x21B60A6C@ */ ECIPP_ALIGNMENT_ULONG 4294967295 Compu_IDENTITY 0 4294967295 PHYS_UNIT "SPN" /end CHARACTERISTIC
/begin CHARACTERISTIC FCspn_EGR_vlvCAN_lowfunc "FCtl_SPN(669)" VALUE 0x001E27D8 /* @ECU_Address@FCtl_SPN@0x21B60A74@ */ ECIPP_ALIGNMENT_ULONG 4294967295 Compu_IDENTITY 0 4294967295 PHYS_UNIT "SPN" /end CHARACTERISTIC
/begin CHARACTERISTIC FCspn_EGR_vlvCAN_nofunc "FCtl_SPN(668)" VALUE 0x001E27D4 /* @ECU_Address@FCtl_SPN@0x21B60A70@ */ ECIPP_ALIGNMENT_ULONG 4294967295 Compu_IDENTITY 0 4294967295 PHYS_UNIT "SPN" /end CHARACTERISTIC
/begin CHARACTERISTIC FPfl_CL_phi_hi "FPrm_latch(507)" VALUE 0x001E0804 /* @ECU_Address@FPrm_latch@0x021BB7EC@ */ ECIPP_ALIGNMENT_FLOAT32_IEEE 10000000000 Compu_IDENTITY -10000000000 10000000000 PHYS_UNIT "updates" /end CHARACTERISTIC
/begin CHARACTERISTIC FPfl_CL_phi_lo "FPrm_latch(508)" VALUE 0x001E0808 /* @ECU_Address@FPrm_latch@0x021BB7F0@ */ ECIPP_ALIGNMENT_FLOAT32_IEEE 10000000000 Compu_IDENTITY -10000000000 10000000000 PHYS_UNIT "updates" /end CHARACTERISTIC
/begin CHARACTERISTIC FPfl_CLLP_hi "FPrm_latch(49)" VALUE 0x001E00DC /* @ECU_Address@FPrm_latch@0x021BB0C4@ */ ECIPP_ALIGNMENT_FLOAT32_IEEE 10000000000 Compu_IDENTITY -10000000000 10000000000 PHYS_UNIT "updates" /end CHARACTERISTIC
/begin CHARACTERISTIC FPfl_CLLP_lo "FPrm_latch(50)" VALUE 0x001E00E0 /* @ECU_Address@FPrm_latch@0x021BB0C8@ */ ECIPP_ALIGNMENT_FLOAT32_IEEE 10000000000 Compu_IDENTITY -10000000000 10000000000 PHYS_UNIT "updates" /end CHARACTERISTIC
/begin CHARACTERISTIC FPfl_CLNG_hi "FPrm_latch(51)" VALUE 0x001E00E4 /* @ECU_Address@FPrm_latch@0x021BB0CC@ */ ECIPP_ALIGNMENT_FLOAT32_IEEE 10000000000 Compu_IDENTITY -10000000000 10000000000 PHYS_UNIT "updates" /end CHARACTERISTIC
/begin CHARACTERISTIC FPfl_CLNG_lo "FPrm_latch(52)" VALUE 0x001E00E8 /* @ECU_Address@FPrm_latch@0x021BB0D0@ */ ECIPP_ALIGNMENT_FLOAT32_IEEE 10000000000 Compu_IDENTITY -10000000000 10000000000 PHYS_UNIT "updates" /end CHARACTERISTIC
/begin CHARACTERISTIC FPfl_CM_unresp "FPrm_latch(629)" VALUE 0x001E09EC /* @ECU_Address@FPrm_latch@0x021BB9D4@ */ ECIPP_ALIGNMENT_FLOAT32_IEEE 10000000000 Compu_IDENTITY -10000000000 10000000000 PHYS_UNIT "ms" /end CHARACTERISTIC
/begin CHARACTERISTIC FPfl_CMgsln_inact "FPrm_latch(89)" VALUE 0x001E017C /* @ECU_Address@FPrm_latch@0x021BB164@ */ ECIPP_ALIGNMENT_FLOAT32_IEEE 10000000000 Compu_IDENTITY -10000000000 10000000000 PHYS_UNIT "updates" /end CHARACTERISTIC
/begin CHARACTERISTIC FPfl_CMLP_inact "FPrm_latch(90)" VALUE 0x001E0180 /* @ECU_Address@FPrm_latch@0x021BB168@ */ ECIPP_ALIGNMENT_FLOAT32_IEEE 10000000000 Compu_IDENTITY -10000000000 10000000000 PHYS_UNIT "updates" /end CHARACTERISTIC
/begin CHARACTERISTIC FPfl_CMNG_inact "FPrm_latch(91)" VALUE 0x001E0184 /* @ECU_Address@FPrm_latch@0x021BB16C@ */ ECIPP_ALIGNMENT_FLOAT32_IEEE 10000000000 Compu_IDENTITY -10000000000 10000000000 PHYS_UNIT "updates" /end CHARACTERISTIC
/begin CHARACTERISTIC FPfl_COPfail "FPrm_latch(63)" VALUE 0x001E0114 /* @ECU_Address@FPrm_latch@0x021BB0FC@ */ ECIPP_ALIGNMENT_FLOAT32_IEEE 10000000000 Compu_IDENTITY -10000000000 10000000000 PHYS_UNIT "ms" /end CHARACTERISTIC
/begin CHARACTERISTIC FPfl_COT_hi "FPrm_latch(487)" VALUE 0x001E07B4 /* @ECU_Address@FPrm_latch@0x021BB79C@ */ ECIPP_ALIGNMENT_FLOAT32_IEEE 10000000000 Compu_IDENTITY -10000000000 10000000000 PHYS_UNIT "ms" /end CHARACTERISTIC
/begin CHARACTERISTIC FPfl_crkloss "FPrm_latch(112)" VALUE 0x001E01D8 /* @ECU_Address@FPrm_latch@0x021BB1C0@ */ ECIPP_ALIGNMENT_FLOAT32_IEEE 10000000000 Compu_IDENTITY -10000000000 10000000000 PHYS_UNIT "ms" /end CHARACTERISTIC
/begin CHARACTERISTIC FPfl_crknever "FPrm_latch(62)" VALUE 0x001E0110 /* @ECU_Address@FPrm_latch@0x021BB0F8@ */ ECIPP_ALIGNMENT_FLOAT32_IEEE 10000000000 Compu_IDENTITY -10000000000 10000000000 PHYS_UNIT "ms" /end CHARACTERISTIC
/begin CHARACTERISTIC FPfl_crknoise "FPrm_latch(61)" VALUE 0x001E010C /* @ECU_Address@FPrm_latch@0x021BB0F4@ */ ECIPP_ALIGNMENT_FLOAT32_IEEE 10000000000 Compu_IDENTITY -10000000000 10000000000 PHYS_UNIT "ms" /end CHARACTERISTIC
/begin CHARACTERISTIC FPfl_CVCS_discon "FPrm_latch(577)" VALUE 0x001E091C /* @ECU_Address@FPrm_latch@0x021BB904@ */ ECIPP_ALIGNMENT_FLOAT32_IEEE 10000000000 Compu_IDENTITY -10000000000 10000000000 PHYS_UNIT "ms" /end CHARACTERISTIC
/begin CHARACTERISTIC FPfl_CVDS_discon "FPrm_latch(578)" VALUE 0x001E0920 /* @ECU_Address@FPrm_latch@0x021BB908@ */ ECIPP_ALIGNMENT_FLOAT32_IEEE 10000000000 Compu_IDENTITY -10000000000 10000000000 PHYS_UNIT "ms" /end CHARACTERISTIC
/begin CHARACTERISTIC FPfl_CVP1_hi "FPrm_latch(624)" VALUE 0x001E09D8 /* @ECU_Address@FPrm_latch@0x021BB9C0@ */ ECIPP_ALIGNMENT_FLOAT32_IEEE 10000000000 Compu_IDENTITY -10000000000 10000000000 PHYS_UNIT "ms" /end CHARACTERISTIC
/begin CHARACTERISTIC FPfl_CVP1_lo "FPrm_latch(625)" VALUE 0x001E09DC /* @ECU_Address@FPrm_latch@0x021BB9C4@ */ ECIPP_ALIGNMENT_FLOAT32_IEEE 10000000000 Compu_IDENTITY -10000000000 10000000000 PHYS_UNIT "ms" /end CHARACTERISTIC
/begin CHARACTERISTIC FPfl_CVP2_hi "FPrm_latch(626)" VALUE 0x001E09E0 /* @ECU_Address@FPrm_latch@0x021BB9C8@ */ ECIPP_ALIGNMENT_FLOAT32_IEEE 10000000000 Compu_IDENTITY -10000000000 10000000000 PHYS_UNIT "ms" /end CHARACTERISTIC
/begin CHARACTERISTIC FPfl_CVP2_lo "FPrm_latch(627)" VALUE 0x001E09E4 /* @ECU_Address@FPrm_latch@0x021BB9CC@ */ ECIPP_ALIGNMENT_FLOAT32_IEEE 10000000000 Compu_IDENTITY -10000000000 10000000000 PHYS_UNIT "ms" /end CHARACTERISTIC
/begin CHARACTERISTIC FPfl_DBW_I_max "FPrm_latch(397)" VALUE 0x001E064C /* @ECU_Address@FPrm_latch@0x021BB634@ */ ECIPP_ALIGNMENT_FLOAT32_IEEE 10000000000 Compu_IDENTITY -10000000000 10000000000 PHYS_UNIT "ms" /end CHARACTERISTIC
/begin CHARACTERISTIC FPfl_ECam_maxerr "FPrm_latch(211)" VALUE 0x001E0364 /* @ECU_Address@FPrm_latch@0x021BB34C@ */ ECIPP_ALIGNMENT_FLOAT32_IEEE 10000000000 Compu_IDENTITY -10000000000 10000000000 PHYS_UNIT "ms" /end CHARACTERISTIC
/begin CHARACTERISTIC FPfl_ECL_low "FPrm_latch(563)" VALUE 0x001E08E4 /* @ECU_Address@FPrm_latch@0x021BB8CC@ */ ECIPP_ALIGNMENT_FLOAT32_IEEE 10000000000 Compu_IDENTITY -10000000000 10000000000 PHYS_UNIT "ms" /end CHARACTERISTIC
/begin CHARACTERISTIC FPfl_ECP_hiP "FPrm_latch(720)" VALUE 0x001E0B58 /* @ECU_Address@FPrm_latch@0x021BBB40@ */ ECIPP_ALIGNMENT_FLOAT32_IEEE 10000000000 Compu_IDENTITY -10000000000 10000000000 PHYS_UNIT "ms" /end CHARACTERISTIC
/begin CHARACTERISTIC FPfl_ECP_loP "FPrm_latch(719)" VALUE 0x001E0B54 /* @ECU_Address@FPrm_latch@0x021BBB3C@ */ ECIPP_ALIGNMENT_FLOAT32_IEEE 10000000000 Compu_IDENTITY -10000000000 10000000000 PHYS_UNIT "ms" /end CHARACTERISTIC
/begin CHARACTERISTIC FPfl_ECT_AAT_dT_max "FPrm_latch(669)" VALUE 0x001E0A8C /* @ECU_Address@FPrm_latch@0x021BBA74@ */ ECIPP_ALIGNMENT_FLOAT32_IEEE 10000000000 Compu_IDENTITY -10000000000 10000000000 PHYS_UNIT "ms" /end CHARACTERISTIC
/begin CHARACTERISTIC FPfl_ECT_derate_actv "FPrm_latch(655)" VALUE 0x001E0A54 /* @ECU_Address@FPrm_latch@0x021BBA3C@ */ ECIPP_ALIGNMENT_FLOAT32_IEEE 10000000000 Compu_IDENTITY -10000000000 10000000000 PHYS_UNIT "ms" /end CHARACTERISTIC
/begin CHARACTERISTIC FPfl_ECT_dT_max "FPrm_latch(677)" VALUE 0x001E0AAC /* @ECU_Address@FPrm_latch@0x021BBA94@ */ ECIPP_ALIGNMENT_FLOAT32_IEEE 10000000000 Compu_IDENTITY -10000000000 10000000000 PHYS_UNIT "ms" /end CHARACTERISTIC
/begin CHARACTERISTIC FPfl_ECT_EGRT_dT_max "FPrm_latch(670)" VALUE 0x001E0A90 /* @ECU_Address@FPrm_latch@0x021BBA78@ */ ECIPP_ALIGNMENT_FLOAT32_IEEE 10000000000 Compu_IDENTITY -10000000000 10000000000 PHYS_UNIT "ms" /end CHARACTERISTIC
/begin CHARACTERISTIC FPfl_ECT_EGT_dT_max "FPrm_latch(673)" VALUE 0x001E0A9C /* @ECU_Address@FPrm_latch@0x021BBA84@ */ ECIPP_ALIGNMENT_FLOAT32_IEEE 10000000000 Compu_IDENTITY -10000000000 10000000000 PHYS_UNIT "ms" /end CHARACTERISTIC
/begin CHARACTERISTIC FPfl_ECT_FT_dT_max "FPrm_latch(671)" VALUE 0x001E0A94 /* @ECU_Address@FPrm_latch@0x021BBA7C@ */ ECIPP_ALIGNMENT_FLOAT32_IEEE 10000000000 Compu_IDENTITY -10000000000 10000000000 PHYS_UNIT "ms" /end CHARACTERISTIC
/begin CHARACTERISTIC FPfl_ECT_HiExp "FPrm_latch(4)" VALUE 0x001E0028 /* @ECU_Address@FPrm_latch@0x021BB010@ */ ECIPP_ALIGNMENT_FLOAT32_IEEE 10000000000 Compu_IDENTITY -10000000000 10000000000 PHYS_UNIT "ms" /end CHARACTERISTIC
/begin CHARACTERISTIC FPfl_ECT_HiExp2 "FPrm_latch(5)" VALUE 0x001E002C /* @ECU_Address@FPrm_latch@0x021BB014@ */ ECIPP_ALIGNMENT_FLOAT32_IEEE 10000000000 Compu_IDENTITY -10000000000 10000000000 PHYS_UNIT "ms" /end CHARACTERISTIC
/begin CHARACTERISTIC FPfl_ECT_IAT_dT_max "FPrm_latch(668)" VALUE 0x001E0A88 /* @ECU_Address@FPrm_latch@0x021BBA70@ */ ECIPP_ALIGNMENT_FLOAT32_IEEE 10000000000 Compu_IDENTITY -10000000000 10000000000 PHYS_UNIT "ms" /end CHARACTERISTIC
/begin CHARACTERISTIC FPfl_ECT_LoExp "FPrm_latch(478)" VALUE 0x001E0790 /* @ECU_Address@FPrm_latch@0x021BB778@ */ ECIPP_ALIGNMENT_FLOAT32_IEEE 10000000000 Compu_IDENTITY -10000000000 10000000000 PHYS_UNIT "ms" /end CHARACTERISTIC
/begin CHARACTERISTIC FPfl_ECT_LoExp2 "FPrm_latch(479)" VALUE 0x001E0794 /* @ECU_Address@FPrm_latch@0x021BB77C@ */ ECIPP_ALIGNMENT_FLOAT32_IEEE 10000000000 Compu_IDENTITY -10000000000 10000000000 PHYS_UNIT "ms" /end CHARACTERISTIC
/begin CHARACTERISTIC FPfl_ECT_maxv "FPrm_latch(2)" VALUE 0x001E0020 /* @ECU_Address@FPrm_latch@0x021BB008@ */ ECIPP_ALIGNMENT_FLOAT32_IEEE 10000000000 Compu_IDENTITY -10000000000 10000000000 PHYS_UNIT "ms" /end CHARACTERISTIC
/begin CHARACTERISTIC FPfl_ECT_minv "FPrm_latch(3)" VALUE 0x001E0024 /* @ECU_Address@FPrm_latch@0x021BB00C@ */ ECIPP_ALIGNMENT_FLOAT32_IEEE 10000000000 Compu_IDENTITY -10000000000 10000000000 PHYS_UNIT "ms" /end CHARACTERISTIC
/begin CHARACTERISTIC FPfl_ECT_OILT_dT_max "FPrm_latch(672)" VALUE 0x001E0A98 /* @ECU_Address@FPrm_latch@0x021BBA80@ */ ECIPP_ALIGNMENT_FLOAT32_IEEE 10000000000 Compu_IDENTITY -10000000000 10000000000 PHYS_UNIT "ms" /end CHARACTERISTIC
/begin CHARACTERISTIC FPfl_ECT_TAUX_dT1_max "FPrm_latch(675)" VALUE 0x001E0AA4 /* @ECU_Address@FPrm_latch@0x021BBA8C@ */ ECIPP_ALIGNMENT_FLOAT32_IEEE 10000000000 Compu_IDENTITY -10000000000 10000000000 PHYS_UNIT "ms" /end CHARACTERISTIC
/begin CHARACTERISTIC FPfl_ECT_TAUX_dT2_max "FPrm_latch(676)" VALUE 0x001E0AA8 /* @ECU_Address@FPrm_latch@0x021BBA90@ */ ECIPP_ALIGNMENT_FLOAT32_IEEE 10000000000 Compu_IDENTITY -10000000000 10000000000 PHYS_UNIT "ms" /end CHARACTERISTIC
/begin CHARACTERISTIC FPfl_ECT_TIAT_dT_max "FPrm_latch(674)" VALUE 0x001E0AA0 /* @ECU_Address@FPrm_latch@0x021BBA88@ */ ECIPP_ALIGNMENT_FLOAT32_IEEE 10000000000 Compu_IDENTITY -10000000000 10000000000 PHYS_UNIT "ms" /end CHARACTERISTIC
/begin CHARACTERISTIC FPfl_EGO1_open "FPrm_latch(71)" VALUE 0x001E0134 /* @ECU_Address@FPrm_latch@0x021BB11C@ */ ECIPP_ALIGNMENT_FLOAT32_IEEE 10000000000 Compu_IDENTITY -10000000000 10000000000 PHYS_UNIT "ms" /end CHARACTERISTIC
/begin CHARACTERISTIC FPfl_EGO2_open "FPrm_latch(100)" VALUE 0x001E01A8 /* @ECU_Address@FPrm_latch@0x021BB190@ */ ECIPP_ALIGNMENT_FLOAT32_IEEE 10000000000 Compu_IDENTITY -10000000000 10000000000 PHYS_UNIT "ms" /end CHARACTERISTIC
/begin CHARACTERISTIC FPfl_EGO3_open "FPrm_latch(72)" VALUE 0x001E0138 /* @ECU_Address@FPrm_latch@0x021BB120@ */ ECIPP_ALIGNMENT_FLOAT32_IEEE 10000000000 Compu_IDENTITY -10000000000 10000000000 PHYS_UNIT "ms" /end CHARACTERISTIC
/begin CHARACTERISTIC FPfl_EGOH1_off_open "FPrm_latch(230)" VALUE 0x001E03B0 /* @ECU_Address@FPrm_latch@0x021BB398@ */ ECIPP_ALIGNMENT_FLOAT32_IEEE 10000000000 Compu_IDENTITY -10000000000 10000000000 PHYS_UNIT "ms" /end CHARACTERISTIC
/begin CHARACTERISTIC FPfl_EGOH1_on_short "FPrm_latch(231)" VALUE 0x001E03B4 /* @ECU_Address@FPrm_latch@0x021BB39C@ */ ECIPP_ALIGNMENT_FLOAT32_IEEE 10000000000 Compu_IDENTITY -10000000000 10000000000 PHYS_UNIT "ms" /end CHARACTERISTIC
/begin CHARACTERISTIC FPfl_EGOH2_off_open "FPrm_latch(232)" VALUE 0x001E03B8 /* @ECU_Address@FPrm_latch@0x021BB3A0@ */ ECIPP_ALIGNMENT_FLOAT32_IEEE 10000000000 Compu_IDENTITY -10000000000 10000000000 PHYS_UNIT "ms" /end CHARACTERISTIC
/begin CHARACTERISTIC FPfl_EGOH2_on_short "FPrm_latch(233)" VALUE 0x001E03BC /* @ECU_Address@FPrm_latch@0x021BB3A4@ */ ECIPP_ALIGNMENT_FLOAT32_IEEE 10000000000 Compu_IDENTITY -10000000000 10000000000 PHYS_UNIT "ms" /end CHARACTERISTIC
/begin CHARACTERISTIC FPfl_EGOH3_off_open "FPrm_latch(234)" VALUE 0x001E03C0 /* @ECU_Address@FPrm_latch@0x021BB3A8@ */ ECIPP_ALIGNMENT_FLOAT32_IEEE 10000000000 Compu_IDENTITY -10000000000 10000000000 PHYS_UNIT "ms" /end CHARACTERISTIC
/begin CHARACTERISTIC FPfl_EGOH3_on_short "FPrm_latch(235)" VALUE 0x001E03C4 /* @ECU_Address@FPrm_latch@0x021BB3AC@ */ ECIPP_ALIGNMENT_FLOAT32_IEEE 10000000000 Compu_IDENTITY -10000000000 10000000000 PHYS_UNIT "ms" /end CHARACTERISTIC
/begin CHARACTERISTIC FPfl_EGOH4_off_open "FPrm_latch(236)" VALUE 0x001E03C8 /* @ECU_Address@FPrm_latch@0x021BB3B0@ */ ECIPP_ALIGNMENT_FLOAT32_IEEE 10000000000 Compu_IDENTITY -10000000000 10000000000 PHYS_UNIT "ms" /end CHARACTERISTIC
/begin CHARACTERISTIC FPfl_EGOH4_on_short "FPrm_latch(237)" VALUE 0x001E03CC /* @ECU_Address@FPrm_latch@0x021BB3B4@ */ ECIPP_ALIGNMENT_FLOAT32_IEEE 10000000000 Compu_IDENTITY -10000000000 10000000000 PHYS_UNIT "ms" /end CHARACTERISTIC
/begin CHARACTERISTIC FPfl_EGR_clr_eta_lo "FPrm_latch(496)" VALUE 0x001E07D8 /* @ECU_Address@FPrm_latch@0x021BB7C0@ */ ECIPP_ALIGNMENT_FLOAT32_IEEE 10000000000 Compu_IDENTITY -10000000000 10000000000 PHYS_UNIT "ms" /end CHARACTERISTIC
/begin CHARACTERISTIC FPfl_EGR_clr_eta_lo2 "FPrm_latch(515)" VALUE 0x001E0824 /* @ECU_Address@FPrm_latch@0x021BB80C@ */ ECIPP_ALIGNMENT_FLOAT32_IEEE 10000000000 Compu_IDENTITY -10000000000 10000000000 PHYS_UNIT "ms" /end CHARACTERISTIC
/begin CHARACTERISTIC FPfl_EGR_deice_excess "FPrm_latch(656)" VALUE 0x001E0A58 /* @ECU_Address@FPrm_latch@0x021BBA40@ */ ECIPP_ALIGNMENT_FLOAT32_IEEE 10000000000 Compu_IDENTITY -10000000000 10000000000 PHYS_UNIT "ms" /end CHARACTERISTIC
/begin CHARACTERISTIC FPfl_EGR_offmin_excess "FPrm_latch(495)" VALUE 0x001E07D4 /* @ECU_Address@FPrm_latch@0x021BB7BC@ */ ECIPP_ALIGNMENT_FLOAT32_IEEE 10000000000 Compu_IDENTITY -10000000000 10000000000 PHYS_UNIT "ms" /end CHARACTERISTIC
/begin CHARACTERISTIC FPfl_EGR_OOA_hi "FPrm_latch(491)" VALUE 0x001E07C4 /* @ECU_Address@FPrm_latch@0x021BB7AC@ */ ECIPP_ALIGNMENT_FLOAT32_IEEE 10000000000 Compu_IDENTITY -10000000000 10000000000 PHYS_UNIT "ms" /end CHARACTERISTIC
/begin CHARACTERISTIC FPfl_EGR_OOA_lo "FPrm_latch(492)" VALUE 0x001E07C8 /* @ECU_Address@FPrm_latch@0x021BB7B0@ */ ECIPP_ALIGNMENT_FLOAT32_IEEE 10000000000 Compu_IDENTITY -10000000000 10000000000 PHYS_UNIT "ms" /end CHARACTERISTIC
/begin CHARACTERISTIC FPfl_EGR_slowdec "FPrm_latch(490)" VALUE 0x001E07C0 /* @ECU_Address@FPrm_latch@0x021BB7A8@ */ ECIPP_ALIGNMENT_FLOAT32_IEEE 10000000000 Compu_IDENTITY -10000000000 10000000000 PHYS_UNIT "ms" /end CHARACTERISTIC
/begin CHARACTERISTIC FPfl_EGR_slowinc "FPrm_latch(489)" VALUE 0x001E07BC /* @ECU_Address@FPrm_latch@0x021BB7A4@ */ ECIPP_ALIGNMENT_FLOAT32_IEEE 10000000000 Compu_IDENTITY -10000000000 10000000000 PHYS_UNIT "ms" /end CHARACTERISTIC
/begin CHARACTERISTIC FPfl_EGR_UEGOdP_hi "FPrm_latch(493)" VALUE 0x001E07CC /* @ECU_Address@FPrm_latch@0x021BB7B4@ */ ECIPP_ALIGNMENT_FLOAT32_IEEE 10000000000 Compu_IDENTITY -10000000000 10000000000 PHYS_UNIT "ms" /end CHARACTERISTIC
/begin CHARACTERISTIC FPfl_EGR_UEGOdP_lo "FPrm_latch(494)" VALUE 0x001E07D0 /* @ECU_Address@FPrm_latch@0x021BB7B8@ */ ECIPP_ALIGNMENT_FLOAT32_IEEE 10000000000 Compu_IDENTITY -10000000000 10000000000 PHYS_UNIT "ms" /end CHARACTERISTIC
/begin CHARACTERISTIC FPfl_EGR_vlv_DC_lim "FPrm_latch(573)" VALUE 0x001E090C /* @ECU_Address@FPrm_latch@0x021BB8F4@ */ ECIPP_ALIGNMENT_FLOAT32_IEEE 10000000000 Compu_IDENTITY -10000000000 10000000000 PHYS_UNIT "ms" /end CHARACTERISTIC
/begin CHARACTERISTIC FPfl_EGR_vlv_HP_discon "FPrm_latch(694)" VALUE 0x001E0AF0 /* @ECU_Address@FPrm_latch@0x021BBAD8@ */ ECIPP_ALIGNMENT_FLOAT32_IEEE 10000000000 Compu_IDENTITY -10000000000 10000000000 PHYS_UNIT "ms" /end CHARACTERISTIC
/begin CHARACTERISTIC FPfl_EGR_vlv_stuck "FPrm_latch(660)" VALUE 0x001E0A68 /* @ECU_Address@FPrm_latch@0x021BBA50@ */ ECIPP_ALIGNMENT_FLOAT32_IEEE 10000000000 Compu_IDENTITY -10000000000 10000000000 PHYS_UNIT "ms" /end CHARACTERISTIC
/begin CHARACTERISTIC FPfl_EGR_vlv_temp_hi "FPrm_latch(574)" VALUE 0x001E0910 /* @ECU_Address@FPrm_latch@0x021BB8F8@ */ ECIPP_ALIGNMENT_FLOAT32_IEEE 10000000000 Compu_IDENTITY -10000000000 10000000000 PHYS_UNIT "ms" /end CHARACTERISTIC
/begin CHARACTERISTIC FPfl_EGR_vlvCAN_commlost "FPrm_latch(497)" VALUE 0x001E07DC /* @ECU_Address@FPrm_latch@0x021BB7C4@ */ ECIPP_ALIGNMENT_FLOAT32_IEEE 10000000000 Compu_IDENTITY -10000000000 10000000000 PHYS_UNIT "ms" /end CHARACTERISTIC
/begin CHARACTERISTIC FPfl_EGR_vlvCAN_lowfunc "FPrm_latch(499)" VALUE 0x001E07E4 /* @ECU_Address@FPrm_latch@0x021BB7CC@ */ ECIPP_ALIGNMENT_FLOAT32_IEEE 10000000000 Compu_IDENTITY -10000000000 10000000000 PHYS_UNIT "ms" /end CHARACTERISTIC
/begin CHARACTERISTIC FPfl_EGR_vlvCAN_nofunc "FPrm_latch(498)" VALUE 0x001E07E0 /* @ECU_Address@FPrm_latch@0x021BB7C8@ */ ECIPP_ALIGNMENT_FLOAT32_IEEE 10000000000 Compu_IDENTITY -10000000000 10000000000 PHYS_UNIT "ms" /end CHARACTERISTIC
/begin CHARACTERISTIC FPfu_CL_phi_hi "FPrm_unlatch(507)" VALUE 0x001E134C /* @ECU_Address@FPrm_unlatch@0x021BD7EC@ */ ECIPP_ALIGNMENT_FLOAT32_IEEE 10000000000 Compu_IDENTITY -10000000000 10000000000 PHYS_UNIT "updates" /end CHARACTERISTIC
/begin CHARACTERISTIC FPfu_CL_phi_lo "FPrm_unlatch(508)" VALUE 0x001E1350 /* @ECU_Address@FPrm_unlatch@0x021BD7F0@ */ ECIPP_ALIGNMENT_FLOAT32_IEEE 10000000000 Compu_IDENTITY -10000000000 10000000000 PHYS_UNIT "updates" /end CHARACTERISTIC
/begin CHARACTERISTIC FPfu_CLLP_hi "FPrm_unlatch(49)" VALUE 0x001E0C24 /* @ECU_Address@FPrm_unlatch@0x021BD0C4@ */ ECIPP_ALIGNMENT_FLOAT32_IEEE 10000000000 Compu_IDENTITY -10000000000 10000000000 PHYS_UNIT "updates" /end CHARACTERISTIC
/begin CHARACTERISTIC FPfu_CLLP_lo "FPrm_unlatch(50)" VALUE 0x001E0C28 /* @ECU_Address@FPrm_unlatch@0x021BD0C8@ */ ECIPP_ALIGNMENT_FLOAT32_IEEE 10000000000 Compu_IDENTITY -10000000000 10000000000 PHYS_UNIT "updates" /end CHARACTERISTIC
/begin CHARACTERISTIC FPfu_CLNG_hi "FPrm_unlatch(51)" VALUE 0x001E0C2C /* @ECU_Address@FPrm_unlatch@0x021BD0CC@ */ ECIPP_ALIGNMENT_FLOAT32_IEEE 10000000000 Compu_IDENTITY -10000000000 10000000000 PHYS_UNIT "updates" /end CHARACTERISTIC
/begin CHARACTERISTIC FPfu_CLNG_lo "FPrm_unlatch(52)" VALUE 0x001E0C30 /* @ECU_Address@FPrm_unlatch@0x021BD0D0@ */ ECIPP_ALIGNMENT_FLOAT32_IEEE 10000000000 Compu_IDENTITY -10000000000 10000000000 PHYS_UNIT "updates" /end CHARACTERISTIC
/begin CHARACTERISTIC FPfu_CM_unresp "FPrm_unlatch(629)" VALUE 0x001E1534 /* @ECU_Address@FPrm_unlatch@0x021BD9D4@ */ ECIPP_ALIGNMENT_FLOAT32_IEEE 10000000000 Compu_IDENTITY -10000000000 10000000000 PHYS_UNIT "ms" /end CHARACTERISTIC
/begin CHARACTERISTIC FPfu_CMgsln_inact "FPrm_unlatch(89)" VALUE 0x001E0CC4 /* @ECU_Address@FPrm_unlatch@0x021BD164@ */ ECIPP_ALIGNMENT_FLOAT32_IEEE 10000000000 Compu_IDENTITY -10000000000 10000000000 PHYS_UNIT "updates" /end CHARACTERISTIC
/begin CHARACTERISTIC FPfu_CMLP_inact "FPrm_unlatch(90)" VALUE 0x001E0CC8 /* @ECU_Address@FPrm_unlatch@0x021BD168@ */ ECIPP_ALIGNMENT_FLOAT32_IEEE 10000000000 Compu_IDENTITY -10000000000 10000000000 PHYS_UNIT "updates" /end CHARACTERISTIC
/begin CHARACTERISTIC FPfu_CMNG_inact "FPrm_unlatch(91)" VALUE 0x001E0CCC /* @ECU_Address@FPrm_unlatch@0x021BD16C@ */ ECIPP_ALIGNMENT_FLOAT32_IEEE 10000000000 Compu_IDENTITY -10000000000 10000000000 PHYS_UNIT "updates" /end CHARACTERISTIC
/begin CHARACTERISTIC FPfu_COPfail "FPrm_unlatch(63)" VALUE 0x001E0C5C /* @ECU_Address@FPrm_unlatch@0x021BD0FC@ */ ECIPP_ALIGNMENT_FLOAT32_IEEE 10000000000 Compu_IDENTITY -10000000000 10000000000 PHYS_UNIT "ms" /end CHARACTERISTIC
/begin CHARACTERISTIC FPfu_COT_hi "FPrm_unlatch(487)" VALUE 0x001E12FC /* @ECU_Address@FPrm_unlatch@0x021BD79C@ */ ECIPP_ALIGNMENT_FLOAT32_IEEE 10000000000 Compu_IDENTITY -10000000000 10000000000 PHYS_UNIT "ms" /end CHARACTERISTIC
/begin CHARACTERISTIC FPfu_crkloss "FPrm_unlatch(112)" VALUE 0x001E0D20 /* @ECU_Address@FPrm_unlatch@0x021BD1C0@ */ ECIPP_ALIGNMENT_FLOAT32_IEEE 10000000000 Compu_IDENTITY -10000000000 10000000000 PHYS_UNIT "ms" /end CHARACTERISTIC
/begin CHARACTERISTIC FPfu_crknever "FPrm_unlatch(62)" VALUE 0x001E0C58 /* @ECU_Address@FPrm_unlatch@0x021BD0F8@ */ ECIPP_ALIGNMENT_FLOAT32_IEEE 10000000000 Compu_IDENTITY -10000000000 10000000000 PHYS_UNIT "ms" /end CHARACTERISTIC
/begin CHARACTERISTIC FPfu_crknoise "FPrm_unlatch(61)" VALUE 0x001E0C54 /* @ECU_Address@FPrm_unlatch@0x021BD0F4@ */ ECIPP_ALIGNMENT_FLOAT32_IEEE 10000000000 Compu_IDENTITY -10000000000 10000000000 PHYS_UNIT "ms" /end CHARACTERISTIC
/begin CHARACTERISTIC FPfu_CVCS_discon "FPrm_unlatch(577)" VALUE 0x001E1464 /* @ECU_Address@FPrm_unlatch@0x021BD904@ */ ECIPP_ALIGNMENT_FLOAT32_IEEE 10000000000 Compu_IDENTITY -10000000000 10000000000 PHYS_UNIT "ms" /end CHARACTERISTIC
/begin CHARACTERISTIC FPfu_CVDS_discon "FPrm_unlatch(578)" VALUE 0x001E1468 /* @ECU_Address@FPrm_unlatch@0x021BD908@ */ ECIPP_ALIGNMENT_FLOAT32_IEEE 10000000000 Compu_IDENTITY -10000000000 10000000000 PHYS_UNIT "ms" /end CHARACTERISTIC
/begin CHARACTERISTIC FPfu_CVP1_hi "FPrm_unlatch(624)" VALUE 0x001E1520 /* @ECU_Address@FPrm_unlatch@0x021BD9C0@ */ ECIPP_ALIGNMENT_FLOAT32_IEEE 10000000000 Compu_IDENTITY -10000000000 10000000000 PHYS_UNIT "ms" /end CHARACTERISTIC
/begin CHARACTERISTIC FPfu_CVP1_lo "FPrm_unlatch(625)" VALUE 0x001E1524 /* @ECU_Address@FPrm_unlatch@0x021BD9C4@ */ ECIPP_ALIGNMENT_FLOAT32_IEEE 10000000000 Compu_IDENTITY -10000000000 10000000000 PHYS_UNIT "ms" /end CHARACTERISTIC
/begin CHARACTERISTIC FPfu_CVP2_hi "FPrm_unlatch(626)" VALUE 0x001E1528 /* @ECU_Address@FPrm_unlatch@0x021BD9C8@ */ ECIPP_ALIGNMENT_FLOAT32_IEEE 10000000000 Compu_IDENTITY -10000000000 10000000000 PHYS_UNIT "ms" /end CHARACTERISTIC
/begin CHARACTERISTIC FPfu_CVP2_lo "FPrm_unlatch(627)" VALUE 0x001E152C /* @ECU_Address@FPrm_unlatch@0x021BD9CC@ */ ECIPP_ALIGNMENT_FLOAT32_IEEE 10000000000 Compu_IDENTITY -10000000000 10000000000 PHYS_UNIT "ms" /end CHARACTERISTIC
/begin CHARACTERISTIC FPfu_DBW_I_max "FPrm_unlatch(397)" VALUE 0x001E1194 /* @ECU_Address@FPrm_unlatch@0x021BD634@ */ ECIPP_ALIGNMENT_FLOAT32_IEEE 10000000000 Compu_IDENTITY -10000000000 10000000000 PHYS_UNIT "ms" /end CHARACTERISTIC
/begin CHARACTERISTIC FPfu_ECam_maxerr "FPrm_unlatch(211)" VALUE 0x001E0EAC /* @ECU_Address@FPrm_unlatch@0x021BD34C@ */ ECIPP_ALIGNMENT_FLOAT32_IEEE 10000000000 Compu_IDENTITY -10000000000 10000000000 PHYS_UNIT "ms" /end CHARACTERISTIC
/begin CHARACTERISTIC FPfu_ECL_low "FPrm_unlatch(563)" VALUE 0x001E142C /* @ECU_Address@FPrm_unlatch@0x021BD8CC@ */ ECIPP_ALIGNMENT_FLOAT32_IEEE 10000000000 Compu_IDENTITY -10000000000 10000000000 PHYS_UNIT "ms" /end CHARACTERISTIC
/begin CHARACTERISTIC FPfu_ECP_hiP "FPrm_unlatch(720)" VALUE 0x001E16A0 /* @ECU_Address@FPrm_unlatch@0x021BDB40@ */ ECIPP_ALIGNMENT_FLOAT32_IEEE 10000000000 Compu_IDENTITY -10000000000 10000000000 PHYS_UNIT "ms" /end CHARACTERISTIC
/begin CHARACTERISTIC FPfu_ECP_loP "FPrm_unlatch(719)" VALUE 0x001E169C /* @ECU_Address@FPrm_unlatch@0x021BDB3C@ */ ECIPP_ALIGNMENT_FLOAT32_IEEE 10000000000 Compu_IDENTITY -10000000000 10000000000 PHYS_UNIT "ms" /end CHARACTERISTIC
/begin CHARACTERISTIC FPfu_ECT_AAT_dT_max "FPrm_unlatch(669)" VALUE 0x001E15D4 /* @ECU_Address@FPrm_unlatch@0x021BDA74@ */ ECIPP_ALIGNMENT_FLOAT32_IEEE 10000000000 Compu_IDENTITY -10000000000 10000000000 PHYS_UNIT "ms" /end CHARACTERISTIC
/begin CHARACTERISTIC FPfu_ECT_derate_actv "FPrm_unlatch(655)" VALUE 0x001E159C /* @ECU_Address@FPrm_unlatch@0x021BDA3C@ */ ECIPP_ALIGNMENT_FLOAT32_IEEE 10000000000 Compu_IDENTITY -10000000000 10000000000 PHYS_UNIT "ms" /end CHARACTERISTIC
/begin CHARACTERISTIC FPfu_ECT_dT_max "FPrm_unlatch(677)" VALUE 0x001E15F4 /* @ECU_Address@FPrm_unlatch@0x021BDA94@ */ ECIPP_ALIGNMENT_FLOAT32_IEEE 10000000000 Compu_IDENTITY -10000000000 10000000000 PHYS_UNIT "ms" /end CHARACTERISTIC
/begin CHARACTERISTIC FPfu_ECT_EGRT_dT_max "FPrm_unlatch(670)" VALUE 0x001E15D8 /* @ECU_Address@FPrm_unlatch@0x021BDA78@ */ ECIPP_ALIGNMENT_FLOAT32_IEEE 10000000000 Compu_IDENTITY -10000000000 10000000000 PHYS_UNIT "ms" /end CHARACTERISTIC
/begin CHARACTERISTIC FPfu_ECT_EGT_dT_max "FPrm_unlatch(673)" VALUE 0x001E15E4 /* @ECU_Address@FPrm_unlatch@0x021BDA84@ */ ECIPP_ALIGNMENT_FLOAT32_IEEE 10000000000 Compu_IDENTITY -10000000000 10000000000 PHYS_UNIT "ms" /end CHARACTERISTIC
/begin CHARACTERISTIC FPfu_ECT_FT_dT_max "FPrm_unlatch(671)" VALUE 0x001E15DC /* @ECU_Address@FPrm_unlatch@0x021BDA7C@ */ ECIPP_ALIGNMENT_FLOAT32_IEEE 10000000000 Compu_IDENTITY -10000000000 10000000000 PHYS_UNIT "ms" /end CHARACTERISTIC
/begin CHARACTERISTIC FPfu_ECT_HiExp "FPrm_unlatch(4)" VALUE 0x001E0B70 /* @ECU_Address@FPrm_unlatch@0x021BD010@ */ ECIPP_ALIGNMENT_FLOAT32_IEEE 10000000000 Compu_IDENTITY -10000000000 10000000000 PHYS_UNIT "ms" /end CHARACTERISTIC
/begin CHARACTERISTIC FPfu_ECT_HiExp2 "FPrm_unlatch(5)" VALUE 0x001E0B74 /* @ECU_Address@FPrm_unlatch@0x021BD014@ */ ECIPP_ALIGNMENT_FLOAT32_IEEE 10000000000 Compu_IDENTITY -10000000000 10000000000 PHYS_UNIT "ms" /end CHARACTERISTIC
/begin CHARACTERISTIC FPfu_ECT_IAT_dT_max "FPrm_unlatch(668)" VALUE 0x001E15D0 /* @ECU_Address@FPrm_unlatch@0x021BDA70@ */ ECIPP_ALIGNMENT_FLOAT32_IEEE 10000000000 Compu_IDENTITY -10000000000 10000000000 PHYS_UNIT "ms" /end CHARACTERISTIC
/begin CHARACTERISTIC FPfu_ECT_LoExp "FPrm_unlatch(478)" VALUE 0x001E12D8 /* @ECU_Address@FPrm_unlatch@0x021BD778@ */ ECIPP_ALIGNMENT_FLOAT32_IEEE 10000000000 Compu_IDENTITY -10000000000 10000000000 PHYS_UNIT "ms" /end CHARACTERISTIC
/begin CHARACTERISTIC FPfu_ECT_LoExp2 "FPrm_unlatch(479)" VALUE 0x001E12DC /* @ECU_Address@FPrm_unlatch@0x021BD77C@ */ ECIPP_ALIGNMENT_FLOAT32_IEEE 10000000000 Compu_IDENTITY -10000000000 10000000000 PHYS_UNIT "ms" /end CHARACTERISTIC
/begin CHARACTERISTIC FPfu_ECT_maxv "FPrm_unlatch(2)" VALUE 0x001E0B68 /* @ECU_Address@FPrm_unlatch@0x021BD008@ */ ECIPP_ALIGNMENT_FLOAT32_IEEE 10000000000 Compu_IDENTITY -10000000000 10000000000 PHYS_UNIT "ms" /end CHARACTERISTIC
/begin CHARACTERISTIC FPfu_ECT_minv "FPrm_unlatch(3)" VALUE 0x001E0B6C /* @ECU_Address@FPrm_unlatch@0x021BD00C@ */ ECIPP_ALIGNMENT_FLOAT32_IEEE 10000000000 Compu_IDENTITY -10000000000 10000000000 PHYS_UNIT "ms" /end CHARACTERISTIC
/begin CHARACTERISTIC FPfu_ECT_OILT_dT_max "FPrm_unlatch(672)" VALUE 0x001E15E0 /* @ECU_Address@FPrm_unlatch@0x021BDA80@ */ ECIPP_ALIGNMENT_FLOAT32_IEEE 10000000000 Compu_IDENTITY -10000000000 10000000000 PHYS_UNIT "ms" /end CHARACTERISTIC
/begin CHARACTERISTIC FPfu_ECT_TAUX_dT1_max "FPrm_unlatch(675)" VALUE 0x001E15EC /* @ECU_Address@FPrm_unlatch@0x021BDA8C@ */ ECIPP_ALIGNMENT_FLOAT32_IEEE 10000000000 Compu_IDENTITY -10000000000 10000000000 PHYS_UNIT "ms" /end CHARACTERISTIC
/begin CHARACTERISTIC FPfu_ECT_TAUX_dT2_max "FPrm_unlatch(676)" VALUE 0x001E15F0 /* @ECU_Address@FPrm_unlatch@0x021BDA90@ */ ECIPP_ALIGNMENT_FLOAT32_IEEE 10000000000 Compu_IDENTITY -10000000000 10000000000 PHYS_UNIT "ms" /end CHARACTERISTIC
/begin CHARACTERISTIC FPfu_ECT_TIAT_dT_max "FPrm_unlatch(674)" VALUE 0x001E15E8 /* @ECU_Address@FPrm_unlatch@0x021BDA88@ */ ECIPP_ALIGNMENT_FLOAT32_IEEE 10000000000 Compu_IDENTITY -10000000000 10000000000 PHYS_UNIT "ms" /end CHARACTERISTIC
/begin CHARACTERISTIC FPfu_EGO1_open "FPrm_unlatch(71)" VALUE 0x001E0C7C /* @ECU_Address@FPrm_unlatch@0x021BD11C@ */ ECIPP_ALIGNMENT_FLOAT32_IEEE 10000000000 Compu_IDENTITY -10000000000 10000000000 PHYS_UNIT "ms" /end CHARACTERISTIC
/begin CHARACTERISTIC FPfu_EGO2_open "FPrm_unlatch(100)" VALUE 0x001E0CF0 /* @ECU_Address@FPrm_unlatch@0x021BD190@ */ ECIPP_ALIGNMENT_FLOAT32_IEEE 10000000000 Compu_IDENTITY -10000000000 10000000000 PHYS_UNIT "ms" /end CHARACTERISTIC
/begin CHARACTERISTIC FPfu_EGO3_open "FPrm_unlatch(72)" VALUE 0x001E0C80 /* @ECU_Address@FPrm_unlatch@0x021BD120@ */ ECIPP_ALIGNMENT_FLOAT32_IEEE 10000000000 Compu_IDENTITY -10000000000 10000000000 PHYS_UNIT "ms" /end CHARACTERISTIC
/begin CHARACTERISTIC FPfu_EGOH1_off_open "FPrm_unlatch(230)" VALUE 0x001E0EF8 /* @ECU_Address@FPrm_unlatch@0x021BD398@ */ ECIPP_ALIGNMENT_FLOAT32_IEEE 10000000000 Compu_IDENTITY -10000000000 10000000000 PHYS_UNIT "ms" /end CHARACTERISTIC
/begin CHARACTERISTIC FPfu_EGOH1_on_short "FPrm_unlatch(231)" VALUE 0x001E0EFC /* @ECU_Address@FPrm_unlatch@0x021BD39C@ */ ECIPP_ALIGNMENT_FLOAT32_IEEE 10000000000 Compu_IDENTITY -10000000000 10000000000 PHYS_UNIT "ms" /end CHARACTERISTIC
/begin CHARACTERISTIC FPfu_EGOH2_off_open "FPrm_unlatch(232)" VALUE 0x001E0F00 /* @ECU_Address@FPrm_unlatch@0x021BD3A0@ */ ECIPP_ALIGNMENT_FLOAT32_IEEE 10000000000 Compu_IDENTITY -10000000000 10000000000 PHYS_UNIT "ms" /end CHARACTERISTIC
/begin CHARACTERISTIC FPfu_EGOH2_on_short "FPrm_unlatch(233)" VALUE 0x001E0F04 /* @ECU_Address@FPrm_unlatch@0x021BD3A4@ */ ECIPP_ALIGNMENT_FLOAT32_IEEE 10000000000 Compu_IDENTITY -10000000000 10000000000 PHYS_UNIT "ms" /end CHARACTERISTIC
/begin CHARACTERISTIC FPfu_EGOH3_off_open "FPrm_unlatch(234)" VALUE 0x001E0F08 /* @ECU_Address@FPrm_unlatch@0x021BD3A8@ */ ECIPP_ALIGNMENT_FLOAT32_IEEE 10000000000 Compu_IDENTITY -10000000000 10000000000 PHYS_UNIT "ms" /end CHARACTERISTIC
/begin CHARACTERISTIC FPfu_EGOH3_on_short "FPrm_unlatch(235)" VALUE 0x001E0F0C /* @ECU_Address@FPrm_unlatch@0x021BD3AC@ */ ECIPP_ALIGNMENT_FLOAT32_IEEE 10000000000 Compu_IDENTITY -10000000000 10000000000 PHYS_UNIT "ms" /end CHARACTERISTIC
/begin CHARACTERISTIC FPfu_EGOH4_off_open "FPrm_unlatch(236)" VALUE 0x001E0F10 /* @ECU_Address@FPrm_unlatch@0x021BD3B0@ */ ECIPP_ALIGNMENT_FLOAT32_IEEE 10000000000 Compu_IDENTITY -10000000000 10000000000 PHYS_UNIT "ms" /end CHARACTERISTIC
/begin CHARACTERISTIC FPfu_EGOH4_on_short "FPrm_unlatch(237)" VALUE 0x001E0F14 /* @ECU_Address@FPrm_unlatch@0x021BD3B4@ */ ECIPP_ALIGNMENT_FLOAT32_IEEE 10000000000 Compu_IDENTITY -10000000000 10000000000 PHYS_UNIT "ms" /end CHARACTERISTIC
/begin CHARACTERISTIC FPfu_EGR_clr_eta_lo "FPrm_unlatch(496)" VALUE 0x001E1320 /* @ECU_Address@FPrm_unlatch@0x021BD7C0@ */ ECIPP_ALIGNMENT_FLOAT32_IEEE 10000000000 Compu_IDENTITY -10000000000 10000000000 PHYS_UNIT "ms" /end CHARACTERISTIC
/begin CHARACTERISTIC FPfu_EGR_clr_eta_lo2 "FPrm_unlatch(515)" VALUE 0x001E136C /* @ECU_Address@FPrm_unlatch@0x021BD80C@ */ ECIPP_ALIGNMENT_FLOAT32_IEEE 10000000000 Compu_IDENTITY -10000000000 10000000000 PHYS_UNIT "ms" /end CHARACTERISTIC
/begin CHARACTERISTIC FPfu_EGR_deice_excess "FPrm_unlatch(656)" VALUE 0x001E15A0 /* @ECU_Address@FPrm_unlatch@0x021BDA40@ */ ECIPP_ALIGNMENT_FLOAT32_IEEE 10000000000 Compu_IDENTITY -10000000000 10000000000 PHYS_UNIT "ms" /end CHARACTERISTIC
/begin CHARACTERISTIC FPfu_EGR_offmin_excess "FPrm_unlatch(495)" VALUE 0x001E131C /* @ECU_Address@FPrm_unlatch@0x021BD7BC@ */ ECIPP_ALIGNMENT_FLOAT32_IEEE 10000000000 Compu_IDENTITY -10000000000 10000000000 PHYS_UNIT "ms" /end CHARACTERISTIC
/begin CHARACTERISTIC FPfu_EGR_OOA_hi "FPrm_unlatch(491)" VALUE 0x001E130C /* @ECU_Address@FPrm_unlatch@0x021BD7AC@ */ ECIPP_ALIGNMENT_FLOAT32_IEEE 10000000000 Compu_IDENTITY -10000000000 10000000000 PHYS_UNIT "ms" /end CHARACTERISTIC
/begin CHARACTERISTIC FPfu_EGR_OOA_lo "FPrm_unlatch(492)" VALUE 0x001E1310 /* @ECU_Address@FPrm_unlatch@0x021BD7B0@ */ ECIPP_ALIGNMENT_FLOAT32_IEEE 10000000000 Compu_IDENTITY -10000000000 10000000000 PHYS_UNIT "ms" /end CHARACTERISTIC
/begin CHARACTERISTIC FPfu_EGR_slowdec "FPrm_unlatch(490)" VALUE 0x001E1308 /* @ECU_Address@FPrm_unlatch@0x021BD7A8@ */ ECIPP_ALIGNMENT_FLOAT32_IEEE 10000000000 Compu_IDENTITY -10000000000 10000000000 PHYS_UNIT "ms" /end CHARACTERISTIC
/begin CHARACTERISTIC FPfu_EGR_slowinc "FPrm_unlatch(489)" VALUE 0x001E1304 /* @ECU_Address@FPrm_unlatch@0x021BD7A4@ */ ECIPP_ALIGNMENT_FLOAT32_IEEE 10000000000 Compu_IDENTITY -10000000000 10000000000 PHYS_UNIT "ms" /end CHARACTERISTIC
/begin CHARACTERISTIC FPfu_EGR_UEGOdP_hi "FPrm_unlatch(493)" VALUE 0x001E1314 /* @ECU_Address@FPrm_unlatch@0x021BD7B4@ */ ECIPP_ALIGNMENT_FLOAT32_IEEE 10000000000 Compu_IDENTITY -10000000000 10000000000 PHYS_UNIT "ms" /end CHARACTERISTIC
/begin CHARACTERISTIC FPfu_EGR_UEGOdP_lo "FPrm_unlatch(494)" VALUE 0x001E1318 /* @ECU_Address@FPrm_unlatch@0x021BD7B8@ */ ECIPP_ALIGNMENT_FLOAT32_IEEE 10000000000 Compu_IDENTITY -10000000000 10000000000 PHYS_UNIT "ms" /end CHARACTERISTIC
/begin CHARACTERISTIC FPfu_EGR_vlv_DC_lim "FPrm_unlatch(573)" VALUE 0x001E1454 /* @ECU_Address@FPrm_unlatch@0x021BD8F4@ */ ECIPP_ALIGNMENT_FLOAT32_IEEE 10000000000 Compu_IDENTITY -10000000000 10000000000 PHYS_UNIT "ms" /end CHARACTERISTIC
/begin CHARACTERISTIC FPfu_EGR_vlv_HP_discon "FPrm_unlatch(694)" VALUE 0x001E1638 /* @ECU_Address@FPrm_unlatch@0x021BDAD8@ */ ECIPP_ALIGNMENT_FLOAT32_IEEE 10000000000 Compu_IDENTITY -10000000000 10000000000 PHYS_UNIT "ms" /end CHARACTERISTIC
/begin CHARACTERISTIC FPfu_EGR_vlv_stuck "FPrm_unlatch(660)" VALUE 0x001E15B0 /* @ECU_Address@FPrm_unlatch@0x021BDA50@ */ ECIPP_ALIGNMENT_FLOAT32_IEEE 10000000000 Compu_IDENTITY -10000000000 10000000000 PHYS_UNIT "ms" /end CHARACTERISTIC
/begin CHARACTERISTIC FPfu_EGR_vlv_temp_hi "FPrm_unlatch(574)" VALUE 0x001E1458 /* @ECU_Address@FPrm_unlatch@0x021BD8F8@ */ ECIPP_ALIGNMENT_FLOAT32_IEEE 10000000000 Compu_IDENTITY -10000000000 10000000000 PHYS_UNIT "ms" /end CHARACTERISTIC
/begin CHARACTERISTIC FPfu_EGR_vlvCAN_commlost "FPrm_unlatch(497)" VALUE 0x001E1324 /* @ECU_Address@FPrm_unlatch@0x021BD7C4@ */ ECIPP_ALIGNMENT_FLOAT32_IEEE 10000000000 Compu_IDENTITY -10000000000 10000000000 PHYS_UNIT "ms" /end CHARACTERISTIC
/begin CHARACTERISTIC FPfu_EGR_vlvCAN_lowfunc "FPrm_unlatch(499)" VALUE 0x001E132C /* @ECU_Address@FPrm_unlatch@0x021BD7CC@ */ ECIPP_ALIGNMENT_FLOAT32_IEEE 10000000000 Compu_IDENTITY -10000000000 10000000000 PHYS_UNIT "ms" /end CHARACTERISTIC
/begin CHARACTERISTIC FPfu_EGR_vlvCAN_nofunc "FPrm_unlatch(498)" VALUE 0x001E1328 /* @ECU_Address@FPrm_unlatch@0x021BD7C8@ */ ECIPP_ALIGNMENT_FLOAT32_IEEE 10000000000 Compu_IDENTITY -10000000000 10000000000 PHYS_UNIT "ms" /end CHARACTERISTIC
/begin GROUP CL_phi_hi_EC_Fault "CL air/fuel ratio control at limit - too rich"
 /begin REF_CHARACTERISTIC FCdc4_CL_phi_hi FCdtc_CL_phi_hi FCfmi_CL_phi_hi FCftb_CL_phi_hi FCspn_CL_phi_hi FPfl_CL_phi_hi FPfu_CL_phi_hi FPnd_CL_phi_hi FPsvr_CL_phi_hi FPsw_ext1_CL_phi_hi FPsw_CL_phi_hi /end REF_CHARACTERISTIC
/end GROUP
/begin GROUP CL_phi_lo_EC_Fault "CL air/fuel ratio control at limit - too lean"
 /begin REF_CHARACTERISTIC FCdc4_CL_phi_lo FCdtc_CL_phi_lo FCfmi_CL_phi_lo FCftb_CL_phi_lo FCspn_CL_phi_lo FPfl_CL_phi_lo FPfu_CL_phi_lo FPnd_CL_phi_lo FPsvr_CL_phi_lo FPsw_ext1_CL_phi_lo FPsw_CL_phi_lo /end REF_CHARACTERISTIC
/end GROUP
/begin GROUP CLLP_hi_EC_Fault "CL high LPG"
 /begin REF_CHARACTERISTIC FCdc4_CLLP_hi FCdtc_CLLP_hi FCfmi_CLLP_hi FCftb_CLLP_hi FCspn_CLLP_hi FPfl_CLLP_hi FPfu_CLLP_hi FPnd_CLLP_hi FPsvr_CLLP_hi FPsw_ext1_CLLP_hi FPsw_CLLP_hi /end REF_CHARACTERISTIC
/end GROUP
/begin GROUP CLLP_lo_EC_Fault "CL low LPG"
 /begin REF_CHARACTERISTIC FCdc4_CLLP_lo FCdtc_CLLP_lo FCfmi_CLLP_lo FCftb_CLLP_lo FCspn_CLLP_lo FPfl_CLLP_lo FPfu_CLLP_lo FPnd_CLLP_lo FPsvr_CLLP_lo FPsw_ext1_CLLP_lo FPsw_CLLP_lo /end REF_CHARACTERISTIC
/end GROUP
/begin GROUP CLNG_hi_EC_Fault "CL high NG"
 /begin REF_CHARACTERISTIC FCdc4_CLNG_hi FCdtc_CLNG_hi FCfmi_CLNG_hi FCftb_CLNG_hi FCspn_CLNG_hi FPfl_CLNG_hi FPfu_CLNG_hi FPnd_CLNG_hi FPsvr_CLNG_hi FPsw_ext1_CLNG_hi FPsw_CLNG_hi /end REF_CHARACTERISTIC
/end GROUP
/begin GROUP CLNG_lo_EC_Fault "CL low NG"
 /begin REF_CHARACTERISTIC FCdc4_CLNG_lo FCdtc_CLNG_lo FCfmi_CLNG_lo FCftb_CLNG_lo FCspn_CLNG_lo FPfl_CLNG_lo FPfu_CLNG_lo FPnd_CLNG_lo FPsvr_CLNG_lo FPsw_ext1_CLNG_lo FPsw_CLNG_lo /end REF_CHARACTERISTIC
/end GROUP
/begin GROUP CM_unresp_EC_Fault "Post-catalyst sensor 1 unresponsive"
 /begin REF_CHARACTERISTIC FCdc4_CM_unresp FCdtc_CM_unresp FCfmi_CM_unresp FCftb_CM_unresp FCspn_CM_unresp FPfl_CM_unresp FPfu_CM_unresp FPnd_CM_unresp FPsvr_CM_unresp FPsw_ext1_CM_unresp FPsw_CM_unresp /end REF_CHARACTERISTIC
/end GROUP
/begin GROUP CMgsln_inact_EC_Fault "Gasoline cat monitor"
 /begin REF_CHARACTERISTIC FCdc4_CMgsln_inact FCdtc_CMgsln_inact FCfmi_CMgsln_inact FCftb_CMgsln_inact FCspn_CMgsln_inact FPfl_CMgsln_inact FPfu_CMgsln_inact FPnd_CMgsln_inact FPsvr_CMgsln_inact FPsw_ext1_CMgsln_inact FPsw_CMgsln_inact /end REF_CHARACTERISTIC
/end GROUP
/begin GROUP CMLP_inact_EC_Fault "LPG cat monitor"
 /begin REF_CHARACTERISTIC FCdc4_CMLP_inact FCdtc_CMLP_inact FCfmi_CMLP_inact FCftb_CMLP_inact FCspn_CMLP_inact FPfl_CMLP_inact FPfu_CMLP_inact FPnd_CMLP_inact FPsvr_CMLP_inact FPsw_ext1_CMLP_inact FPsw_CMLP_inact /end REF_CHARACTERISTIC
/end GROUP
/begin GROUP CMNG_inact_EC_Fault "NG cat monitor"
 /begin REF_CHARACTERISTIC FCdc4_CMNG_inact FCdtc_CMNG_inact FCfmi_CMNG_inact FCftb_CMNG_inact FCspn_CMNG_inact FPfl_CMNG_inact FPfu_CMNG_inact FPnd_CMNG_inact FPsvr_CMNG_inact FPsw_ext1_CMNG_inact FPsw_CMNG_inact /end REF_CHARACTERISTIC
/end GROUP
/begin GROUP COPfail_EC_Fault "COP failure"
 /begin REF_CHARACTERISTIC FCdc4_COPfail FCdtc_COPfail FCfmi_COPfail FCftb_COPfail FCspn_COPfail FPfl_COPfail FPfu_COPfail FPnd_COPfail FPsvr_COPfail FPsw_ext1_COPfail FPsw_COPfail /end REF_CHARACTERISTIC
/end GROUP
/begin GROUP COT_hi_EC_Fault "COT higher than expected"
 /begin REF_CHARACTERISTIC FCdc4_COT_hi FCdtc_COT_hi FCfmi_COT_hi FCftb_COT_hi FCspn_COT_hi FPfl_COT_hi FPfu_COT_hi FPnd_COT_hi FPsvr_COT_hi FPsw_ext1_COT_hi FPsw_COT_hi /end REF_CHARACTERISTIC
/end GROUP
/begin GROUP crkloss_EC_Fault "Crank loss"
 /begin REF_CHARACTERISTIC FCdc4_crkloss FCdtc_crkloss FCfmi_crkloss FCftb_crkloss FCspn_crkloss FPfl_crkloss FPfu_crkloss FPnd_crkloss FPsvr_crkloss FPsw_ext1_crkloss FPsw_crkloss /end REF_CHARACTERISTIC
/end GROUP
/begin GROUP crknever_EC_Fault "Never crank synced at start"
 /begin REF_CHARACTERISTIC FCdc4_crknever FCdtc_crknever FCfmi_crknever FCftb_crknever FCspn_crknever FPfl_crknever FPfu_crknever FPnd_crknever FPsvr_crknever FPsw_ext1_crknever FPsw_crknever /end REF_CHARACTERISTIC
/end GROUP
/begin GROUP crknoise_EC_Fault "Crank sync noise"
 /begin REF_CHARACTERISTIC FCdc4_crknoise FCdtc_crknoise FCfmi_crknoise FCftb_crknoise FCspn_crknoise FPfl_crknoise FPfu_crknoise FPnd_crknoise FPsvr_crknoise FPsw_ext1_crknoise FPsw_crknoise /end REF_CHARACTERISTIC
/end GROUP
/begin GROUP CVCS_discon_EC_Fault "Crankcase ventilation clean side disconnected"
 /begin REF_CHARACTERISTIC FCdc4_CVCS_discon FCdtc_CVCS_discon FCfmi_CVCS_discon FCftb_CVCS_discon FCspn_CVCS_discon FPfl_CVCS_discon FPfu_CVCS_discon FPnd_CVCS_discon FPsvr_CVCS_discon FPsw_ext1_CVCS_discon FPsw_CVCS_discon /end REF_CHARACTERISTIC
/end GROUP
/begin GROUP CVDS_discon_EC_Fault "Crankcase ventilation dirty side disconnected"
 /begin REF_CHARACTERISTIC FCdc4_CVDS_discon FCdtc_CVDS_discon FCfmi_CVDS_discon FCftb_CVDS_discon FCspn_CVDS_discon FPfl_CVDS_discon FPfu_CVDS_discon FPnd_CVDS_discon FPsvr_CVDS_discon FPsw_ext1_CVDS_discon FPsw_CVDS_discon /end REF_CHARACTERISTIC
/end GROUP
/begin GROUP CVP1_hi_EC_Fault "Crankcase pressure 1 high"
 /begin REF_CHARACTERISTIC FCdc4_CVP1_hi FCdtc_CVP1_hi FCfmi_CVP1_hi FCftb_CVP1_hi FCspn_CVP1_hi FPfl_CVP1_hi FPfu_CVP1_hi FPnd_CVP1_hi FPsvr_CVP1_hi FPsw_ext1_CVP1_hi FPsw_CVP1_hi /end REF_CHARACTERISTIC
/end GROUP
/begin GROUP CVP1_lo_EC_Fault "Crankcase pressure 1 low"
 /begin REF_CHARACTERISTIC FCdc4_CVP1_lo FCdtc_CVP1_lo FCfmi_CVP1_lo FCftb_CVP1_lo FCspn_CVP1_lo FPfl_CVP1_lo FPfu_CVP1_lo FPnd_CVP1_lo FPsvr_CVP1_lo FPsw_ext1_CVP1_lo FPsw_CVP1_lo /end REF_CHARACTERISTIC
/end GROUP
/begin GROUP CVP2_hi_EC_Fault "Crankcase pressure 2 high"
 /begin REF_CHARACTERISTIC FCdc4_CVP2_hi FCdtc_CVP2_hi FCfmi_CVP2_hi FCftb_CVP2_hi FCspn_CVP2_hi FPfl_CVP2_hi FPfu_CVP2_hi FPnd_CVP2_hi FPsvr_CVP2_hi FPsw_ext1_CVP2_hi FPsw_CVP2_hi /end REF_CHARACTERISTIC
/end GROUP
/begin GROUP CVP2_lo_EC_Fault "Crankcase pressure 2 low"
 /begin REF_CHARACTERISTIC FCdc4_CVP2_lo FCdtc_CVP2_lo FCfmi_CVP2_lo FCftb_CVP2_lo FCspn_CVP2_lo FPfl_CVP2_lo FPfu_CVP2_lo FPnd_CVP2_lo FPsvr_CVP2_lo FPsw_ext1_CVP2_lo FPsw_CVP2_lo /end REF_CHARACTERISTIC
/end GROUP
/begin GROUP DBW_I_max_EC_Fault "DBW drive current high"
 /begin REF_CHARACTERISTIC FCdc4_DBW_I_max FCdtc_DBW_I_max FCfmi_DBW_I_max FCftb_DBW_I_max FCspn_DBW_I_max FPfl_DBW_I_max FPfu_DBW_I_max FPnd_DBW_I_max FPsvr_DBW_I_max FPsw_ext1_DBW_I_max FPsw_DBW_I_max /end REF_CHARACTERISTIC
/end GROUP
/begin GROUP ECam_maxerr_EC_Fault "Exhaust cam position"
 /begin REF_CHARACTERISTIC FCdc4_ECam_maxerr FCdtc_ECam_maxerr FCfmi_ECam_maxerr FCftb_ECam_maxerr FCspn_ECam_maxerr FPfl_ECam_maxerr FPfu_ECam_maxerr FPnd_ECam_maxerr FPsvr_ECam_maxerr FPsw_ext1_ECam_maxerr FPsw_ECam_maxerr /end REF_CHARACTERISTIC
/end GROUP
/begin GROUP ECL_low_EC_Fault "Engine coolant level low"
 /begin REF_CHARACTERISTIC FCdc4_ECL_low FCdtc_ECL_low FCfmi_ECL_low FCftb_ECL_low FCspn_ECL_low FPfl_ECL_low FPfu_ECL_low FPnd_ECL_low FPsvr_ECL_low FPsw_ext1_ECL_low FPsw_ECL_low /end REF_CHARACTERISTIC
/end GROUP
/begin GROUP ECP_hiP_EC_Fault "Engine coolant pressure high"
 /begin REF_CHARACTERISTIC FCdc4_ECP_hiP FCdtc_ECP_hiP FCfmi_ECP_hiP FCftb_ECP_hiP FCspn_ECP_hiP FPfl_ECP_hiP FPfu_ECP_hiP FPnd_ECP_hiP FPsvr_ECP_hiP FPsw_ext1_ECP_hiP FPsw_ECP_hiP /end REF_CHARACTERISTIC
/end GROUP
/begin GROUP ECP_loP_EC_Fault "Engine coolant pressure low"
 /begin REF_CHARACTERISTIC FCdc4_ECP_loP FCdtc_ECP_loP FCfmi_ECP_loP FCftb_ECP_loP FCspn_ECP_loP FPfl_ECP_loP FPfu_ECP_loP FPnd_ECP_loP FPsvr_ECP_loP FPsw_ext1_ECP_loP FPsw_ECP_loP /end REF_CHARACTERISTIC
/end GROUP
/begin GROUP ECT_AAT_dT_max_EC_Fault "ECT / AAT delta T high"
 /begin REF_CHARACTERISTIC FCdc4_ECT_AAT_dT_max FCdtc_ECT_AAT_dT_max FCfmi_ECT_AAT_dT_max FCftb_ECT_AAT_dT_max FCspn_ECT_AAT_dT_max FPfl_ECT_AAT_dT_max FPfu_ECT_AAT_dT_max FPnd_ECT_AAT_dT_max FPsvr_ECT_AAT_dT_max FPsw_ext1_ECT_AAT_dT_max FPsw_ECT_AAT_dT_max /end REF_CHARACTERISTIC
/end GROUP
/begin GROUP ECT_derate_actv_EC_Fault "ECT-based derate active"
 /begin REF_CHARACTERISTIC FCdc4_ECT_derate_actv FCdtc_ECT_derate_actv FCfmi_ECT_derate_actv FCftb_ECT_derate_actv FCspn_ECT_derate_actv FPfl_ECT_derate_actv FPfu_ECT_derate_actv FPnd_ECT_derate_actv FPsvr_ECT_derate_actv FPsw_ext1_ECT_derate_actv FPsw_ECT_derate_actv /end REF_CHARACTERISTIC
/end GROUP
/begin GROUP ECT_dT_max_EC_Fault "ECT reference out-of-range"
 /begin REF_CHARACTERISTIC FCdc4_ECT_dT_max FCdtc_ECT_dT_max FCfmi_ECT_dT_max FCftb_ECT_dT_max FCspn_ECT_dT_max FPfl_ECT_dT_max FPfu_ECT_dT_max FPnd_ECT_dT_max FPsvr_ECT_dT_max FPsw_ext1_ECT_dT_max FPsw_ECT_dT_max /end REF_CHARACTERISTIC
/end GROUP
/begin GROUP ECT_EGRT_dT_max_EC_Fault "ECT / EGRT delta T high"
 /begin REF_CHARACTERISTIC FCdc4_ECT_EGRT_dT_max FCdtc_ECT_EGRT_dT_max FCfmi_ECT_EGRT_dT_max FCftb_ECT_EGRT_dT_max FCspn_ECT_EGRT_dT_max FPfl_ECT_EGRT_dT_max FPfu_ECT_EGRT_dT_max FPnd_ECT_EGRT_dT_max FPsvr_ECT_EGRT_dT_max FPsw_ext1_ECT_EGRT_dT_max FPsw_ECT_EGRT_dT_max /end REF_CHARACTERISTIC
/end GROUP
/begin GROUP ECT_EGT_dT_max_EC_Fault "ECT / EGT delta T high"
 /begin REF_CHARACTERISTIC FCdc4_ECT_EGT_dT_max FCdtc_ECT_EGT_dT_max FCfmi_ECT_EGT_dT_max FCftb_ECT_EGT_dT_max FCspn_ECT_EGT_dT_max FPfl_ECT_EGT_dT_max FPfu_ECT_EGT_dT_max FPnd_ECT_EGT_dT_max FPsvr_ECT_EGT_dT_max FPsw_ext1_ECT_EGT_dT_max FPsw_ECT_EGT_dT_max /end REF_CHARACTERISTIC
/end GROUP
/begin GROUP ECT_FT_dT_max_EC_Fault "ECT / FT delta T high"
 /begin REF_CHARACTERISTIC FCdc4_ECT_FT_dT_max FCdtc_ECT_FT_dT_max FCfmi_ECT_FT_dT_max FCftb_ECT_FT_dT_max FCspn_ECT_FT_dT_max FPfl_ECT_FT_dT_max FPfu_ECT_FT_dT_max FPnd_ECT_FT_dT_max FPsvr_ECT_FT_dT_max FPsw_ext1_ECT_FT_dT_max FPsw_ECT_FT_dT_max /end REF_CHARACTERISTIC
/end GROUP
/begin GROUP ECT_HiExp_EC_Fault "ECT higher than expected 1"
 /begin REF_CHARACTERISTIC FCdc4_ECT_HiExp FCdtc_ECT_HiExp FCfmi_ECT_HiExp FCftb_ECT_HiExp FCspn_ECT_HiExp FPfl_ECT_HiExp FPfu_ECT_HiExp FPnd_ECT_HiExp FPsvr_ECT_HiExp FPsw_ext1_ECT_HiExp FPsw_ECT_HiExp /end REF_CHARACTERISTIC
/end GROUP
/begin GROUP ECT_HiExp2_EC_Fault "ECT higher than expected 2"
 /begin REF_CHARACTERISTIC FCdc4_ECT_HiExp2 FCdtc_ECT_HiExp2 FCfmi_ECT_HiExp2 FCftb_ECT_HiExp2 FCspn_ECT_HiExp2 FPfl_ECT_HiExp2 FPfu_ECT_HiExp2 FPnd_ECT_HiExp2 FPsvr_ECT_HiExp2 FPsw_ext1_ECT_HiExp2 FPsw_ECT_HiExp2 /end REF_CHARACTERISTIC
/end GROUP
/begin GROUP ECT_IAT_dT_max_EC_Fault "ECT / IAT delta T high"
 /begin REF_CHARACTERISTIC FCdc4_ECT_IAT_dT_max FCdtc_ECT_IAT_dT_max FCfmi_ECT_IAT_dT_max FCftb_ECT_IAT_dT_max FCspn_ECT_IAT_dT_max FPfl_ECT_IAT_dT_max FPfu_ECT_IAT_dT_max FPnd_ECT_IAT_dT_max FPsvr_ECT_IAT_dT_max FPsw_ext1_ECT_IAT_dT_max FPsw_ECT_IAT_dT_max /end REF_CHARACTERISTIC
/end GROUP
/begin GROUP ECT_LoExp_EC_Fault "ECT lower than expected 1"
 /begin REF_CHARACTERISTIC FCdc4_ECT_LoExp FCdtc_ECT_LoExp FCfmi_ECT_LoExp FCftb_ECT_LoExp FCspn_ECT_LoExp FPfl_ECT_LoExp FPfu_ECT_LoExp FPnd_ECT_LoExp FPsvr_ECT_LoExp FPsw_ext1_ECT_LoExp FPsw_ECT_LoExp /end REF_CHARACTERISTIC
/end GROUP
/begin GROUP ECT_LoExp2_EC_Fault "ECT lower than expected 2"
 /begin REF_CHARACTERISTIC FCdc4_ECT_LoExp2 FCdtc_ECT_LoExp2 FCfmi_ECT_LoExp2 FCftb_ECT_LoExp2 FCspn_ECT_LoExp2 FPfl_ECT_LoExp2 FPfu_ECT_LoExp2 FPnd_ECT_LoExp2 FPsvr_ECT_LoExp2 FPsw_ext1_ECT_LoExp2 FPsw_ECT_LoExp2 /end REF_CHARACTERISTIC
/end GROUP
/begin GROUP ECT_maxv_EC_Fault "ECT / CHT high voltage"
 /begin REF_CHARACTERISTIC FCdc4_ECT_maxv FCdtc_ECT_maxv FCfmi_ECT_maxv FCftb_ECT_maxv FCspn_ECT_maxv FPfl_ECT_maxv FPfu_ECT_maxv FPnd_ECT_maxv FPsvr_ECT_maxv FPsw_ext1_ECT_maxv FPsw_ECT_maxv /end REF_CHARACTERISTIC
/end GROUP
/begin GROUP ECT_minv_EC_Fault "ECT / CHT low voltage"
 /begin REF_CHARACTERISTIC FCdc4_ECT_minv FCdtc_ECT_minv FCfmi_ECT_minv FCftb_ECT_minv FCspn_ECT_minv FPfl_ECT_minv FPfu_ECT_minv FPnd_ECT_minv FPsvr_ECT_minv FPsw_ext1_ECT_minv FPsw_ECT_minv /end REF_CHARACTERISTIC
/end GROUP
/begin GROUP ECT_OILT_dT_max_EC_Fault "ECT / OILT delta T high"
 /begin REF_CHARACTERISTIC FCdc4_ECT_OILT_dT_max FCdtc_ECT_OILT_dT_max FCfmi_ECT_OILT_dT_max FCftb_ECT_OILT_dT_max FCspn_ECT_OILT_dT_max FPfl_ECT_OILT_dT_max FPfu_ECT_OILT_dT_max FPnd_ECT_OILT_dT_max FPsvr_ECT_OILT_dT_max FPsw_ext1_ECT_OILT_dT_max FPsw_ECT_OILT_dT_max /end REF_CHARACTERISTIC
/end GROUP
/begin GROUP ECT_TAUX_dT1_max_EC_Fault "ECT / AUX Temp delta T 1 high"
 /begin REF_CHARACTERISTIC FCdc4_ECT_TAUX_dT1_max FCdtc_ECT_TAUX_dT1_max FCfmi_ECT_TAUX_dT1_max FCftb_ECT_TAUX_dT1_max FCspn_ECT_TAUX_dT1_max FPfl_ECT_TAUX_dT1_max FPfu_ECT_TAUX_dT1_max FPnd_ECT_TAUX_dT1_max FPsvr_ECT_TAUX_dT1_max FPsw_ext1_ECT_TAUX_dT1_max FPsw_ECT_TAUX_dT1_max /end REF_CHARACTERISTIC
/end GROUP
/begin GROUP ECT_TAUX_dT2_max_EC_Fault "ECT / AUX Temp delta T 2 high"
 /begin REF_CHARACTERISTIC FCdc4_ECT_TAUX_dT2_max FCdtc_ECT_TAUX_dT2_max FCfmi_ECT_TAUX_dT2_max FCftb_ECT_TAUX_dT2_max FCspn_ECT_TAUX_dT2_max FPfl_ECT_TAUX_dT2_max FPfu_ECT_TAUX_dT2_max FPnd_ECT_TAUX_dT2_max FPsvr_ECT_TAUX_dT2_max FPsw_ext1_ECT_TAUX_dT2_max FPsw_ECT_TAUX_dT2_max /end REF_CHARACTERISTIC
/end GROUP
/begin GROUP ECT_TIAT_dT_max_EC_Fault "ECT / TIAT delta T high"
 /begin REF_CHARACTERISTIC FCdc4_ECT_TIAT_dT_max FCdtc_ECT_TIAT_dT_max FCfmi_ECT_TIAT_dT_max FCftb_ECT_TIAT_dT_max FCspn_ECT_TIAT_dT_max FPfl_ECT_TIAT_dT_max FPfu_ECT_TIAT_dT_max FPnd_ECT_TIAT_dT_max FPsvr_ECT_TIAT_dT_max FPsw_ext1_ECT_TIAT_dT_max FPsw_ECT_TIAT_dT_max /end REF_CHARACTERISTIC
/end GROUP
/begin GROUP EGO1_open_EC_Fault "EGO1 open / lazy"
 /begin REF_CHARACTERISTIC FCdc4_EGO1_open FCdtc_EGO1_open FCfmi_EGO1_open FCftb_EGO1_open FCspn_EGO1_open FPfl_EGO1_open FPfu_EGO1_open FPnd_EGO1_open FPsvr_EGO1_open FPsw_ext1_EGO1_open FPsw_EGO1_open /end REF_CHARACTERISTIC
/end GROUP
/begin GROUP EGO2_open_EC_Fault "EGO2 open / lazy"
 /begin REF_CHARACTERISTIC FCdc4_EGO2_open FCdtc_EGO2_open FCfmi_EGO2_open FCftb_EGO2_open FCspn_EGO2_open FPfl_EGO2_open FPfu_EGO2_open FPnd_EGO2_open FPsvr_EGO2_open FPsw_ext1_EGO2_open FPsw_EGO2_open /end REF_CHARACTERISTIC
/end GROUP
/begin GROUP EGO3_open_EC_Fault "EGO3 open / lazy"
 /begin REF_CHARACTERISTIC FCdc4_EGO3_open FCdtc_EGO3_open FCfmi_EGO3_open FCftb_EGO3_open FCspn_EGO3_open FPfl_EGO3_open FPfu_EGO3_open FPnd_EGO3_open FPsvr_EGO3_open FPsw_ext1_EGO3_open FPsw_EGO3_open /end REF_CHARACTERISTIC
/end GROUP
/begin GROUP EGOH1_off_open_EC_Fault "EGOH1 open / ground short"
 /begin REF_CHARACTERISTIC FCdc4_EGOH1_off_open FCdtc_EGOH1_off_open FCfmi_EGOH1_off_open FCftb_EGOH1_off_open FCspn_EGOH1_off_open FPfl_EGOH1_off_open FPfu_EGOH1_off_open FPnd_EGOH1_off_open FPsvr_EGOH1_off_open FPsw_ext1_EGOH1_off_open FPsw_EGOH1_off_open /end REF_CHARACTERISTIC
/end GROUP
/begin GROUP EGOH1_on_short_EC_Fault "EGOH1 short to power"
 /begin REF_CHARACTERISTIC FCdc4_EGOH1_on_short FCdtc_EGOH1_on_short FCfmi_EGOH1_on_short FCftb_EGOH1_on_short FCspn_EGOH1_on_short FPfl_EGOH1_on_short FPfu_EGOH1_on_short FPnd_EGOH1_on_short FPsvr_EGOH1_on_short FPsw_ext1_EGOH1_on_short FPsw_EGOH1_on_short /end REF_CHARACTERISTIC
/end GROUP
/begin GROUP EGOH2_off_open_EC_Fault "EGOH2 open / ground short"
 /begin REF_CHARACTERISTIC FCdc4_EGOH2_off_open FCdtc_EGOH2_off_open FCfmi_EGOH2_off_open FCftb_EGOH2_off_open FCspn_EGOH2_off_open FPfl_EGOH2_off_open FPfu_EGOH2_off_open FPnd_EGOH2_off_open FPsvr_EGOH2_off_open FPsw_ext1_EGOH2_off_open FPsw_EGOH2_off_open /end REF_CHARACTERISTIC
/end GROUP
/begin GROUP EGOH2_on_short_EC_Fault "EGOH2 short to power"
 /begin REF_CHARACTERISTIC FCdc4_EGOH2_on_short FCdtc_EGOH2_on_short FCfmi_EGOH2_on_short FCftb_EGOH2_on_short FCspn_EGOH2_on_short FPfl_EGOH2_on_short FPfu_EGOH2_on_short FPnd_EGOH2_on_short FPsvr_EGOH2_on_short FPsw_ext1_EGOH2_on_short FPsw_EGOH2_on_short /end REF_CHARACTERISTIC
/end GROUP
/begin GROUP EGOH3_off_open_EC_Fault "EGOH3 open / ground short"
 /begin REF_CHARACTERISTIC FCdc4_EGOH3_off_open FCdtc_EGOH3_off_open FCfmi_EGOH3_off_open FCftb_EGOH3_off_open FCspn_EGOH3_off_open FPfl_EGOH3_off_open FPfu_EGOH3_off_open FPnd_EGOH3_off_open FPsvr_EGOH3_off_open FPsw_ext1_EGOH3_off_open FPsw_EGOH3_off_open /end REF_CHARACTERISTIC
/end GROUP
/begin GROUP EGOH3_on_short_EC_Fault "EGOH3 short to power"
 /begin REF_CHARACTERISTIC FCdc4_EGOH3_on_short FCdtc_EGOH3_on_short FCfmi_EGOH3_on_short FCftb_EGOH3_on_short FCspn_EGOH3_on_short FPfl_EGOH3_on_short FPfu_EGOH3_on_short FPnd_EGOH3_on_short FPsvr_EGOH3_on_short FPsw_ext1_EGOH3_on_short FPsw_EGOH3_on_short /end REF_CHARACTERISTIC
/end GROUP
/begin GROUP EGOH4_off_open_EC_Fault "EGOH4 open / ground short"
 /begin REF_CHARACTERISTIC FCdc4_EGOH4_off_open FCdtc_EGOH4_off_open FCfmi_EGOH4_off_open FCftb_EGOH4_off_open FCspn_EGOH4_off_open FPfl_EGOH4_off_open FPfu_EGOH4_off_open FPnd_EGOH4_off_open FPsvr_EGOH4_off_open FPsw_ext1_EGOH4_off_open FPsw_EGOH4_off_open /end REF_CHARACTERISTIC
/end GROUP
/begin GROUP EGOH4_on_short_EC_Fault "EGOH4 short to power"
 /begin REF_CHARACTERISTIC FCdc4_EGOH4_on_short FCdtc_EGOH4_on_short FCfmi_EGOH4_on_short FCftb_EGOH4_on_short FCspn_EGOH4_on_short FPfl_EGOH4_on_short FPfu_EGOH4_on_short FPnd_EGOH4_on_short FPsvr_EGOH4_on_short FPsw_ext1_EGOH4_on_short FPsw_EGOH4_on_short /end REF_CHARACTERISTIC
/end GROUP
/begin GROUP EGR_clr_eta_lo_EC_Fault "EGR cooler efficiency low 1"
 /begin REF_CHARACTERISTIC FCdc4_EGR_clr_eta_lo FCdtc_EGR_clr_eta_lo FCfmi_EGR_clr_eta_lo FCftb_EGR_clr_eta_lo FCspn_EGR_clr_eta_lo FPfl_EGR_clr_eta_lo FPfu_EGR_clr_eta_lo FPnd_EGR_clr_eta_lo FPsvr_EGR_clr_eta_lo FPsw_ext1_EGR_clr_eta_lo FPsw_EGR_clr_eta_lo /end REF_CHARACTERISTIC
/end GROUP
/begin GROUP EGR_clr_eta_lo2_EC_Fault "EGR cooler efficiency low 2"
 /begin REF_CHARACTERISTIC FCdc4_EGR_clr_eta_lo2 FCdtc_EGR_clr_eta_lo2 FCfmi_EGR_clr_eta_lo2 FCftb_EGR_clr_eta_lo2 FCspn_EGR_clr_eta_lo2 FPfl_EGR_clr_eta_lo2 FPfu_EGR_clr_eta_lo2 FPnd_EGR_clr_eta_lo2 FPsvr_EGR_clr_eta_lo2 FPsw_ext1_EGR_clr_eta_lo2 FPsw_EGR_clr_eta_lo2 /end REF_CHARACTERISTIC
/end GROUP
/begin GROUP EGR_deice_excess_EC_Fault "EGR excessive de-icing operation"
 /begin REF_CHARACTERISTIC FCdc4_EGR_deice_excess FCdtc_EGR_deice_excess FCfmi_EGR_deice_excess FCftb_EGR_deice_excess FCspn_EGR_deice_excess FPfl_EGR_deice_excess FPfu_EGR_deice_excess FPnd_EGR_deice_excess FPsvr_EGR_deice_excess FPsw_ext1_EGR_deice_excess FPsw_EGR_deice_excess /end REF_CHARACTERISTIC
/end GROUP
/begin GROUP EGR_offmin_excess_EC_Fault "EGR excessive off/min table operation"
 /begin REF_CHARACTERISTIC FCdc4_EGR_offmin_excess FCdtc_EGR_offmin_excess FCfmi_EGR_offmin_excess FCftb_EGR_offmin_excess FCspn_EGR_offmin_excess FPfl_EGR_offmin_excess FPfu_EGR_offmin_excess FPnd_EGR_offmin_excess FPsvr_EGR_offmin_excess FPsw_ext1_EGR_offmin_excess FPsw_EGR_offmin_excess /end REF_CHARACTERISTIC
/end GROUP
/begin GROUP EGR_OOA_hi_EC_Fault "EGR system out-of-authority high"
 /begin REF_CHARACTERISTIC FCdc4_EGR_OOA_hi FCdtc_EGR_OOA_hi FCfmi_EGR_OOA_hi FCftb_EGR_OOA_hi FCspn_EGR_OOA_hi FPfl_EGR_OOA_hi FPfu_EGR_OOA_hi FPnd_EGR_OOA_hi FPsvr_EGR_OOA_hi FPsw_ext1_EGR_OOA_hi FPsw_EGR_OOA_hi /end REF_CHARACTERISTIC
/end GROUP
/begin GROUP EGR_OOA_lo_EC_Fault "EGR system out-of-authority low"
 /begin REF_CHARACTERISTIC FCdc4_EGR_OOA_lo FCdtc_EGR_OOA_lo FCfmi_EGR_OOA_lo FCftb_EGR_OOA_lo FCspn_EGR_OOA_lo FPfl_EGR_OOA_lo FPfu_EGR_OOA_lo FPnd_EGR_OOA_lo FPsvr_EGR_OOA_lo FPsw_ext1_EGR_OOA_lo FPsw_EGR_OOA_lo /end REF_CHARACTERISTIC
/end GROUP
/begin GROUP EGR_slowdec_EC_Fault "EGR flow slow to decrease / stuck open"
 /begin REF_CHARACTERISTIC FCdc4_EGR_slowdec FCdtc_EGR_slowdec FCfmi_EGR_slowdec FCftb_EGR_slowdec FCspn_EGR_slowdec FPfl_EGR_slowdec FPfu_EGR_slowdec FPnd_EGR_slowdec FPsvr_EGR_slowdec FPsw_ext1_EGR_slowdec FPsw_EGR_slowdec /end REF_CHARACTERISTIC
/end GROUP
/begin GROUP EGR_slowinc_EC_Fault "EGR flow slow to increase / stuck closed"
 /begin REF_CHARACTERISTIC FCdc4_EGR_slowinc FCdtc_EGR_slowinc FCfmi_EGR_slowinc FCftb_EGR_slowinc FCspn_EGR_slowinc FPfl_EGR_slowinc FPfu_EGR_slowinc FPnd_EGR_slowinc FPsvr_EGR_slowinc FPsw_ext1_EGR_slowinc FPsw_EGR_slowinc /end REF_CHARACTERISTIC
/end GROUP
/begin GROUP EGR_UEGOdP_hi_EC_Fault "EGR UEGO - dP feedback mismatch high"
 /begin REF_CHARACTERISTIC FCdc4_EGR_UEGOdP_hi FCdtc_EGR_UEGOdP_hi FCfmi_EGR_UEGOdP_hi FCftb_EGR_UEGOdP_hi FCspn_EGR_UEGOdP_hi FPfl_EGR_UEGOdP_hi FPfu_EGR_UEGOdP_hi FPnd_EGR_UEGOdP_hi FPsvr_EGR_UEGOdP_hi FPsw_ext1_EGR_UEGOdP_hi FPsw_EGR_UEGOdP_hi /end REF_CHARACTERISTIC
/end GROUP
/begin GROUP EGR_UEGOdP_lo_EC_Fault "EGR UEGO - dP feedback mismatch low"
 /begin REF_CHARACTERISTIC FCdc4_EGR_UEGOdP_lo FCdtc_EGR_UEGOdP_lo FCfmi_EGR_UEGOdP_lo FCftb_EGR_UEGOdP_lo FCspn_EGR_UEGOdP_lo FPfl_EGR_UEGOdP_lo FPfu_EGR_UEGOdP_lo FPnd_EGR_UEGOdP_lo FPsvr_EGR_UEGOdP_lo FPsw_ext1_EGR_UEGOdP_lo FPsw_EGR_UEGOdP_lo /end REF_CHARACTERISTIC
/end GROUP
/begin GROUP EGR_vlv_DC_lim_EC_Fault "EGR brushed valve duty cycle limit"
 /begin REF_CHARACTERISTIC FCdc4_EGR_vlv_DC_lim FCdtc_EGR_vlv_DC_lim FCfmi_EGR_vlv_DC_lim FCftb_EGR_vlv_DC_lim FCspn_EGR_vlv_DC_lim FPfl_EGR_vlv_DC_lim FPfu_EGR_vlv_DC_lim FPnd_EGR_vlv_DC_lim FPsvr_EGR_vlv_DC_lim FPsw_ext1_EGR_vlv_DC_lim FPsw_EGR_vlv_DC_lim /end REF_CHARACTERISTIC
/end GROUP
/begin GROUP EGR_vlv_HP_discon_EC_Fault "EGR valve high pressure tube disconnected"
 /begin REF_CHARACTERISTIC FCdc4_EGR_vlv_HP_discon FCdtc_EGR_vlv_HP_discon FCfmi_EGR_vlv_HP_discon FCftb_EGR_vlv_HP_discon FCspn_EGR_vlv_HP_discon FPfl_EGR_vlv_HP_discon FPfu_EGR_vlv_HP_discon FPnd_EGR_vlv_HP_discon FPsvr_EGR_vlv_HP_discon FPsw_ext1_EGR_vlv_HP_discon FPsw_EGR_vlv_HP_discon /end REF_CHARACTERISTIC
/end GROUP
/begin GROUP EGR_vlv_stuck_EC_Fault "EGR valve sticking"
 /begin REF_CHARACTERISTIC FCdc4_EGR_vlv_stuck FCdtc_EGR_vlv_stuck FCfmi_EGR_vlv_stuck FCftb_EGR_vlv_stuck FCspn_EGR_vlv_stuck FPfl_EGR_vlv_stuck FPfu_EGR_vlv_stuck FPnd_EGR_vlv_stuck FPsvr_EGR_vlv_stuck FPsw_ext1_EGR_vlv_stuck FPsw_EGR_vlv_stuck /end REF_CHARACTERISTIC
/end GROUP
/begin GROUP EGR_vlv_temp_hi_EC_Fault "EGR brushed valve temperature high"
 /begin REF_CHARACTERISTIC FCdc4_EGR_vlv_temp_hi FCdtc_EGR_vlv_temp_hi FCfmi_EGR_vlv_temp_hi FCftb_EGR_vlv_temp_hi FCspn_EGR_vlv_temp_hi FPfl_EGR_vlv_temp_hi FPfu_EGR_vlv_temp_hi FPnd_EGR_vlv_temp_hi FPsvr_EGR_vlv_temp_hi FPsw_ext1_EGR_vlv_temp_hi FPsw_EGR_vlv_temp_hi /end REF_CHARACTERISTIC
/end GROUP
/begin GROUP EGR_vlvCAN_commlost_EC_Fault "EGR CAN valve communication lost"
 /begin REF_CHARACTERISTIC FCdc4_EGR_vlvCAN_commlost FCdtc_EGR_vlvCAN_commlost FCfmi_EGR_vlvCAN_commlost FCftb_EGR_vlvCAN_commlost FCspn_EGR_vlvCAN_commlost FPfl_EGR_vlvCAN_commlost FPfu_EGR_vlvCAN_commlost FPnd_EGR_vlvCAN_commlost FPsvr_EGR_vlvCAN_commlost FPsw_ext1_EGR_vlvCAN_commlost FPsw_EGR_vlvCAN_commlost /end REF_CHARACTERISTIC
/end GROUP
/begin GROUP EGR_vlvCAN_lowfunc_EC_Fault "EGR CAN valve reduced functionality"
 /begin REF_CHARACTERISTIC FCdc4_EGR_vlvCAN_lowfunc FCdtc_EGR_vlvCAN_lowfunc FCfmi_EGR_vlvCAN_lowfunc FCftb_EGR_vlvCAN_lowfunc FCspn_EGR_vlvCAN_lowfunc FPfl_EGR_vlvCAN_lowfunc FPfu_EGR_vlvCAN_lowfunc FPnd_EGR_vlvCAN_lowfunc FPsvr_EGR_vlvCAN_lowfunc FPsw_ext1_EGR_vlvCAN_lowfunc FPsw_EGR_vlvCAN_lowfunc /end REF_CHARACTERISTIC
/end GROUP
/begin GROUP EGR_vlvCAN_nofunc_EC_Fault "EGR CAN valve loss of function"
 /begin REF_CHARACTERISTIC FCdc4_EGR_vlvCAN_nofunc FCdtc_EGR_vlvCAN_nofunc FCfmi_EGR_vlvCAN_nofunc FCftb_EGR_vlvCAN_nofunc FCspn_EGR_vlvCAN_nofunc FPfl_EGR_vlvCAN_nofunc FPfu_EGR_vlvCAN_nofunc FPnd_EGR_vlvCAN_nofunc FPsvr_EGR_vlvCAN_nofunc FPsw_ext1_EGR_vlvCAN_nofunc FPsw_EGR_vlvCAN_nofunc /end REF_CHARACTERISTIC
/end GROUP
/end MODULE
/end PROJECT
