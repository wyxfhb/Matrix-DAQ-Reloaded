ASAP2_VERSION 1 61
/begin PROJECT Econtrols_4G "4G Test"
/begin HEADER "4G A2L Configuration" PROJECT_NO EControls4G /* config for version control */ VERSION "$Revision: 82130 $:" /* config for version control */ /end HEADER
/begin MODULE EControls_4G_SH2A "EControls 4G"
/begin MOD_COMMON "" DEPOSIT ABSOLUTE BYTE_ORDER MSB_FIRST /end MOD_COMMON
/* Define the Record Layouts */
/begin RECORD_LAYOUT ECIPP_ALIGNMENT_UBYTE FNC_VALUES 1 UBYTE COLUMN_DIR DIRECT /end RECORD_LAYOUT
/begin RECORD_LAYOUT ECIPP_ALIGNMENT_UWORD FNC_VALUES 1 UWORD COLUMN_DIR DIRECT /end RECORD_LAYOUT
/begin RECORD_LAYOUT ECIPP_ALIGNMENT_SWORD FNC_VALUES 1 SWORD COLUMN_DIR DIRECT /end RECORD_LAYOUT
/begin RECORD_LAYOUT ECIPP_Lookup_SWORD AXIS_PTS_X 1 SWORD INDEX_INCR DIRECT /end RECORD_LAYOUT
/begin RECORD_LAYOUT ECIPP_ALIGNMENT_ULONG FNC_VALUES 1 ULONG COLUMN_DIR DIRECT /end RECORD_LAYOUT
/begin RECORD_LAYOUT ECIPP_ALIGNMENT_SLONG FNC_VALUES 1 SLONG COLUMN_DIR DIRECT /end RECORD_LAYOUT
/begin RECORD_LAYOUT ECIPP_ALIGNMENT_FLOAT32_IEEE FNC_VALUES 1 FLOAT32_IEEE COLUMN_DIR DIRECT /end RECORD_LAYOUT
/* Define generic COMPU_METHODS used in the A2L */ /* NOTE: most of the parameters from ECIPP use unique/specific COMPU_METHODS */
/begin COMPU_METHOD Compu_ECIPP_STRINGS "ECIPP Strings " /* Identifier */ RAT_FUNC "%.0" /* Format */ "ASCII" /* Units */ COEFFS 0 1 0 0 0 1 /end COMPU_METHOD
/begin MEASUREMENT spk_adv "Total Spark Advance" SWORD Compu_spk_adv 0 0 -2048 2047.9375 ECU_ADDRESS 0x01000020 /end MEASUREMENT
/begin COMPU_METHOD Compu_spk_adv " " RAT_FUNC "%.1" "CAD BTDC" COEFFS 0 16 0 0 0 1 /end COMPU_METHOD
/begin MEASUREMENT Phi_cmd "Phi command" UWORD Compu_Phi_cmd 0 0 0 3.99993896484375 ECU_ADDRESS 0x01000108 /end MEASUREMENT
/begin COMPU_METHOD Compu_Phi_cmd " " RAT_FUNC "%.3" "-" COEFFS 0 16384 0 0 0 1 /end COMPU_METHOD
/begin MEASUREMENT mdot_a_ports "mdot_a_ports" UWORD Compu_mdot_a_ports 0 0 0 1023.984375 ECU_ADDRESS 0x01000128 /end MEASUREMENT
/begin COMPU_METHOD Compu_mdot_a_ports " " RAT_FUNC "%.1" "g/sec" COEFFS 0 64 0 0 0 1 /end COMPU_METHOD
/begin MEASUREMENT mdot_f_ports "mdot_f_ports" UWORD Compu_mdot_f_ports 0 0 0 127.998046875 ECU_ADDRESS 0x01000130 /end MEASUREMENT
/begin COMPU_METHOD Compu_mdot_f_ports " " RAT_FUNC "%.2" "g/sec" COEFFS 0 512 0 0 0 1 /end COMPU_METHOD
/begin MEASUREMENT CL_BM1 "Closed-loop correction 1" SWORD Compu_CL_BM1 0 0 -100 99.9969482421875 ECU_ADDRESS 0x010001F8 /end MEASUREMENT
/begin COMPU_METHOD Compu_CL_BM1 " " RAT_FUNC "%.1" "%" COEFFS 0 327.68 0 0 0 1 /end COMPU_METHOD
/begin MEASUREMENT A_BM1 "Adaptive correction 1" SWORD Compu_A_BM1 0 0 -100 99.9969482421875 ECU_ADDRESS 0x01000200 /end MEASUREMENT
/begin COMPU_METHOD Compu_A_BM1 " " RAT_FUNC "%.1" "%" COEFFS 0 327.68 0 0 0 1 /end COMPU_METHOD
/begin MEASUREMENT run_tmr_sec "Run Time" UWORD Compu_run_tmr_sec 0 0 0 65535 ECU_ADDRESS 0x010002E0 /end MEASUREMENT
/begin COMPU_METHOD Compu_run_tmr_sec " " RAT_FUNC "%.0" "sec" COEFFS 0 1 0 0 0 1 /end COMPU_METHOD
/begin MEASUREMENT CL_BM2 "Closed-loop correction 2" SWORD Compu_CL_BM2 0 0 -100 99.9969482421875 ECU_ADDRESS 0x01000328 /end MEASUREMENT
/begin COMPU_METHOD Compu_CL_BM2 " " RAT_FUNC "%.1" "%" COEFFS 0 327.68 0 0 0 1 /end COMPU_METHOD
/begin MEASUREMENT A_BM2 "Adaptive correction 2" SWORD Compu_A_BM2 0 0 -100 99.9969482421875 ECU_ADDRESS 0x01000330 /end MEASUREMENT
/begin COMPU_METHOD Compu_A_BM2 " " RAT_FUNC "%.1" "%" COEFFS 0 327.68 0 0 0 1 /end COMPU_METHOD
/begin MEASUREMENT ICam_timing_a "Cam1 open actual" SWORD Compu_ICam_timing_a 0 0 -2048 2047.9375 ECU_ADDRESS 0x010004B0 /end MEASUREMENT
/begin COMPU_METHOD Compu_ICam_timing_a " " RAT_FUNC "%.1" "CAD BTDC" COEFFS 0 16 0 0 0 1 /end COMPU_METHOD
/begin MEASUREMENT ECam_timing_a "Cam2 close actual" SWORD Compu_ECam_timing_a 0 0 -2048 2047.9375 ECU_ADDRESS 0x010004B8 /end MEASUREMENT
/begin COMPU_METHOD Compu_ECam_timing_a " " RAT_FUNC "%.1" "CAD BTDC" COEFFS 0 16 0 0 0 1 /end COMPU_METHOD
/begin MEASUREMENT spk_off_global "Global Adv Offset" SWORD Compu_spk_off_global 0 0 -2048 2047.9375 ECU_ADDRESS 0x01000800 /end MEASUREMENT
/begin COMPU_METHOD Compu_spk_off_global " " RAT_FUNC "%.1" "CAD BTDC" COEFFS 0 16 0 0 0 1 /end COMPU_METHOD
/begin MEASUREMENT CBT "CBT (catalyst bed temperature)" UWORD Compu_CBT 0 0 -460 7731.875 ECU_ADDRESS 0x01000A38 /end MEASUREMENT
/begin COMPU_METHOD Compu_CBT " " RAT_FUNC "%.0" "deg F" COEFFS 0 8 3680 0 0 1 /end COMPU_METHOD
/begin MEASUREMENT CTM_enrich_mod "CTM enrichment" SWORD Compu_CTM_enrich_mod 0 0 -200 199.993896484375 ECU_ADDRESS 0x01000A40 /end MEASUREMENT
/begin COMPU_METHOD Compu_CTM_enrich_mod " " RAT_FUNC "%.1" "%" COEFFS 0 163.84 0 0 0 1 /end COMPU_METHOD
/begin MEASUREMENT CTM_advance_mod "CTM spark advance" SWORD Compu_CTM_advance_mod 0 0 -2048 2047.9375 ECU_ADDRESS 0x01000A48 /end MEASUREMENT
/begin COMPU_METHOD Compu_CTM_advance_mod " " RAT_FUNC "%.1" "CAD BTDC" COEFFS 0 16 0 0 0 1 /end COMPU_METHOD
/begin CHARACTERISTIC CTM_enr "Gsln CTM max enrichment" VALUE 0x001C9BEE /* @ECU_Address@CTM_enr@0x01000A50@ */ ECIPP_ALIGNMENT_SWORD 200 Compu_CTM_enr -200 199.993896484375 /end CHARACTERISTIC
/begin COMPU_METHOD Compu_CTM_enr " " RAT_FUNC "%.1" "%" COEFFS 0 163.84 0 0 0 1 /end COMPU_METHOD
/begin CHARACTERISTIC CTM_adv "Gsln CTM max spark advance" VALUE 0x001C9BF0 /* @ECU_Address@CTM_adv@0x01000A58@ */ ECIPP_ALIGNMENT_SWORD 2048 Compu_CTM_adv -2048 2047.9375 /end CHARACTERISTIC
/begin COMPU_METHOD Compu_CTM_adv " " RAT_FUNC "%.1" "CAD BTDC" COEFFS 0 16 0 0 0 1 /end COMPU_METHOD
/begin CHARACTERISTIC CTM_tau "Gsln CTM single-pt time constant" VALUE 0x001C9BEC /* @ECU_Address@CTM_tau@0x01000A60@ */ ECIPP_ALIGNMENT_UWORD 66 Compu_CTM_tau 0 65.535 /end CHARACTERISTIC
/begin COMPU_METHOD Compu_CTM_tau " " RAT_FUNC "%.0" "seconds" COEFFS 0 1000 0 0 0 1 /end COMPU_METHOD
/begin CHARACTERISTIC CTM_init "Gsln CTM initiation temperature" VALUE 0x001C9BE8 /* @ECU_Address@CTM_init@0x01000A68@ */ ECIPP_ALIGNMENT_UWORD 7732 Compu_CTM_init -460 7731.875 /end CHARACTERISTIC
/begin COMPU_METHOD Compu_CTM_init " " RAT_FUNC "%.0" "deg F" COEFFS 0 8 3680 0 0 1 /end COMPU_METHOD
/begin CHARACTERISTIC CTM_finish "Gsln CTM finish temperature" VALUE 0x001C9BEA /* @ECU_Address@CTM_finish@0x01000A70@ */ ECIPP_ALIGNMENT_UWORD 7732 Compu_CTM_finish -460 7731.875 /end CHARACTERISTIC
/begin COMPU_METHOD Compu_CTM_finish " " RAT_FUNC "%.0" "deg F" COEFFS 0 8 3680 0 0 1 /end COMPU_METHOD
/begin CHARACTERISTIC CTM_ena "CTM control{CTM_ena&0xff=0x00:Disabled}{CTM_ena&0xff=0x01:Enabled}" VALUE 0x001c86ae /* @ECU_Address@CTM_ena@0x01000A78@ */ ECIPP_ALIGNMENT_UBYTE 255 CTM_ena_COMPU_VTAB 0 255 BIT_MASK 0xff /end CHARACTERISTIC
/begin COMPU_METHOD CTM_ena_COMPU_VTAB "Verbal Table" TAB_VERB "%.0" "list" COMPU_TAB_REF CTM_ena_COMPU_VTAB_REF /end COMPU_METHOD
/begin COMPU_VTAB CTM_ena_COMPU_VTAB_REF "Verbal Table" TAB_VERB 2 0x00 "Disabled" 0x01 "Enabled" DEFAULT_VALUE "UNKNOWN" /end COMPU_VTAB
/begin MEASUREMENT Phi_global_offset "Phi_global_offset" SWORD Compu_Phi_global_offset 0 0 -200 199.993896484375 ECU_ADDRESS 0x01000A80 /end MEASUREMENT
/begin COMPU_METHOD Compu_Phi_global_offset " " RAT_FUNC "%.1" "%" COEFFS 0 163.84 0 0 0 1 /end COMPU_METHOD
/begin CHARACTERISTIC CTMA_enr "Alt CTM max enrichment" VALUE 0x001C9BCE /* @ECU_Address@CTMA_enr@0x01000C88@ */ ECIPP_ALIGNMENT_SWORD 200 Compu_CTMA_enr -200 199.993896484375 /end CHARACTERISTIC
/begin COMPU_METHOD Compu_CTMA_enr " " RAT_FUNC "%.1" "%" COEFFS 0 163.84 0 0 0 1 /end COMPU_METHOD
/begin CHARACTERISTIC CTMA_adv "Alt CTM max spark advance" VALUE 0x001C9BD0 /* @ECU_Address@CTMA_adv@0x01000C90@ */ ECIPP_ALIGNMENT_SWORD 2048 Compu_CTMA_adv -2048 2047.9375 /end CHARACTERISTIC
/begin COMPU_METHOD Compu_CTMA_adv " " RAT_FUNC "%.1" "CAD BTDC" COEFFS 0 16 0 0 0 1 /end COMPU_METHOD
/begin CHARACTERISTIC CTMA_tau "Alt CTM single-pt time constant" VALUE 0x001C9BCC /* @ECU_Address@CTMA_tau@0x01000C98@ */ ECIPP_ALIGNMENT_UWORD 66 Compu_CTMA_tau 0 65.535 /end CHARACTERISTIC
/begin COMPU_METHOD Compu_CTMA_tau " " RAT_FUNC "%.0" "seconds" COEFFS 0 1000 0 0 0 1 /end COMPU_METHOD
/begin CHARACTERISTIC CTMA_init "Alt CTM initiation temperature" VALUE 0x001C9BC8 /* @ECU_Address@CTMA_init@0x01000CA0@ */ ECIPP_ALIGNMENT_UWORD 7732 Compu_CTMA_init -460 7731.875 /end CHARACTERISTIC
/begin COMPU_METHOD Compu_CTMA_init " " RAT_FUNC "%.0" "deg F" COEFFS 0 8 3680 0 0 1 /end COMPU_METHOD
/begin CHARACTERISTIC CTMA_finish "Alt CTM finish temperature" VALUE 0x001C9BCA /* @ECU_Address@CTMA_finish@0x01000CA8@ */ ECIPP_ALIGNMENT_UWORD 7732 Compu_CTMA_finish -460 7731.875 /end CHARACTERISTIC
/begin COMPU_METHOD Compu_CTMA_finish " " RAT_FUNC "%.0" "deg F" COEFFS 0 8 3680 0 0 1 /end COMPU_METHOD
/begin MEASUREMENT brake_open_released "Brake input level{brake_open_released&0xff=0x00:Depressed}{brake_open_released&0xff=0x01:Released}" UBYTE brake_open_released_COMPU_VTAB 0 0 0 255 ECU_ADDRESS 0x010012E0 BIT_MASK 0xff /end MEASUREMENT
/begin COMPU_METHOD brake_open_released_COMPU_VTAB "Verbal Table" TAB_VERB "%.0" "list" COMPU_TAB_REF brake_open_released_COMPU_VTAB_REF /end COMPU_METHOD
/begin COMPU_VTAB brake_open_released_COMPU_VTAB_REF "Verbal Table" TAB_VERB 2 0x00 "Depressed" 0x01 "Released" DEFAULT_VALUE "UNKNOWN" /end COMPU_VTAB
/begin MEASUREMENT EBP_gauge "EBP gauge" UWORD Compu_EBP_gauge 0 0 0 255.99609375 ECU_ADDRESS 0x01001C88 /end MEASUREMENT
/begin COMPU_METHOD Compu_EBP_gauge " " RAT_FUNC "%.2" "psig" COEFFS 0 256 0 0 0 1 /end COMPU_METHOD
/begin MEASUREMENT manual_ext_pwr "External power{manual_ext_pwr&0xff=0:Automatic}{manual_ext_pwr&0xff=1:Relay On}{manual_ext_pwr&0xff=2:All On}" UBYTE manual_ext_pwr_COMPU_VTAB 0 0 0 255 ECU_ADDRESS 0x01001CB8 BIT_MASK 0xff /end MEASUREMENT
/begin COMPU_METHOD manual_ext_pwr_COMPU_VTAB "Verbal Table" TAB_VERB "%.0" "list" COMPU_TAB_REF manual_ext_pwr_COMPU_VTAB_REF /end COMPU_METHOD
/begin COMPU_VTAB manual_ext_pwr_COMPU_VTAB_REF "Verbal Table" TAB_VERB 3 0 "Automatic" 1 "Relay On" 2 "All On" DEFAULT_VALUE "UNKNOWN" /end COMPU_VTAB
/begin CHARACTERISTIC CTM_CL_ena "CTM CL control{CTM_CL_ena&0xff=0:Disabled}{CTM_CL_ena&0xff=1:Enabled}" VALUE 0x001C9C05 /* @ECU_Address@CTM_CL_ena@0x01001E00@ */ ECIPP_ALIGNMENT_UBYTE 255 CTM_CL_ena_COMPU_VTAB 0 255 BIT_MASK 0xff /end CHARACTERISTIC
/begin COMPU_METHOD CTM_CL_ena_COMPU_VTAB "Verbal Table" TAB_VERB "%.0" "list" COMPU_TAB_REF CTM_CL_ena_COMPU_VTAB_REF /end COMPU_METHOD
/begin COMPU_VTAB CTM_CL_ena_COMPU_VTAB_REF "Verbal Table" TAB_VERB 2 0 "Disabled" 1 "Enabled" DEFAULT_VALUE "UNKNOWN" /end COMPU_VTAB
/begin CHARACTERISTIC CTM_CL_space "CTM CL pulse spacing" VALUE 0x001C9BF4 /* @ECU_Address@CTM_CL_space@0x01001E08@ */ ECIPP_ALIGNMENT_UWORD 66 Compu_CTM_CL_space 0 65.535 /end CHARACTERISTIC
/begin COMPU_METHOD Compu_CTM_CL_space " " RAT_FUNC "%.1" "sec" COEFFS 0 1000 0 0 0 1 /end COMPU_METHOD
/begin CHARACTERISTIC CTM_CL_ramp "CTM CL ramp rate" VALUE 0x001C9BF8 /* @ECU_Address@CTM_CL_ramp@0x01001E10@ */ ECIPP_ALIGNMENT_UWORD 781 Compu_CTM_CL_ramp 0 781.238079071045 /end CHARACTERISTIC
/begin COMPU_METHOD Compu_CTM_CL_ramp " " RAT_FUNC "%.1" "% / sec" COEFFS 0 83.88608 0 0 0 1 /end COMPU_METHOD
/begin CHARACTERISTIC CTM_CL_UL "CTM CL max excursion" VALUE 0x001C9BFA /* @ECU_Address@CTM_CL_UL@0x01001E18@ */ ECIPP_ALIGNMENT_UWORD 200 Compu_CTM_CL_UL 0 199.996948242188 /end CHARACTERISTIC
/begin COMPU_METHOD Compu_CTM_CL_UL " " RAT_FUNC "%.1" "%" COEFFS 0 327.68 0 0 0 1 /end COMPU_METHOD
/begin MEASUREMENT CTM_CL_BM "CTM CL_BM" SWORD Compu_CTM_CL_BM 0 0 -100 99.9969482421875 ECU_ADDRESS 0x01001E20 /end MEASUREMENT
/begin COMPU_METHOD Compu_CTM_CL_BM " " RAT_FUNC "%.1" "%" COEFFS 0 327.68 0 0 0 1 /end COMPU_METHOD
/begin CHARACTERISTIC CTMA_CL_ena "CTM CL control{CTMA_CL_ena&0xff=0:Disabled}{CTMA_CL_ena&0xff=1:Enabled}" VALUE 0x001C9BE5 /* @ECU_Address@CTMA_CL_ena@0x01001E40@ */ ECIPP_ALIGNMENT_UBYTE 255 CTMA_CL_ena_COMPU_VTAB 0 255 BIT_MASK 0xff /end CHARACTERISTIC
/begin COMPU_METHOD CTMA_CL_ena_COMPU_VTAB "Verbal Table" TAB_VERB "%.0" "list" COMPU_TAB_REF CTMA_CL_ena_COMPU_VTAB_REF /end COMPU_METHOD
/begin COMPU_VTAB CTMA_CL_ena_COMPU_VTAB_REF "Verbal Table" TAB_VERB 2 0 "Disabled" 1 "Enabled" DEFAULT_VALUE "UNKNOWN" /end COMPU_VTAB
/begin CHARACTERISTIC CTMA_CL_space "CTM CL pulse spacing" VALUE 0x001C9BD4 /* @ECU_Address@CTMA_CL_space@0x01001E48@ */ ECIPP_ALIGNMENT_UWORD 66 Compu_CTMA_CL_space 0 65.535 /end CHARACTERISTIC
/begin COMPU_METHOD Compu_CTMA_CL_space " " RAT_FUNC "%.1" "sec" COEFFS 0 1000 0 0 0 1 /end COMPU_METHOD
/begin CHARACTERISTIC CTMA_CL_ramp "CTM CL ramp rate" VALUE 0x001C9BD8 /* @ECU_Address@CTMA_CL_ramp@0x01001E50@ */ ECIPP_ALIGNMENT_UWORD 781 Compu_CTMA_CL_ramp 0 781.238079071045 /end CHARACTERISTIC
/begin COMPU_METHOD Compu_CTMA_CL_ramp " " RAT_FUNC "%.1" "% / sec" COEFFS 0 83.88608 0 0 0 1 /end COMPU_METHOD
/begin CHARACTERISTIC CTMA_CL_UL "CTM CL max excursion" VALUE 0x001C9BDA /* @ECU_Address@CTMA_CL_UL@0x01001E58@ */ ECIPP_ALIGNMENT_UWORD 200 Compu_CTMA_CL_UL 0 199.996948242188 /end CHARACTERISTIC
/begin COMPU_METHOD Compu_CTMA_CL_UL " " RAT_FUNC "%.1" "%" COEFFS 0 327.68 0 0 0 1 /end COMPU_METHOD
/begin CHARACTERISTIC CTM_phi_lim "CTM phi upper limit" VALUE 0x001C9BF2 /* @ECU_Address@CTM_phi_lim@0x01001E60@ */ ECIPP_ALIGNMENT_UWORD 4 Compu_CTM_phi_lim 0 3.99993896484375 /end CHARACTERISTIC
/begin COMPU_METHOD Compu_CTM_phi_lim " " RAT_FUNC "%.3" "phi" COEFFS 0 16384 0 0 0 1 /end COMPU_METHOD
/begin CHARACTERISTIC CTMA_phi_lim "CTM phi upper limit" VALUE 0x001C9BD2 /* @ECU_Address@CTMA_phi_lim@0x01001E68@ */ ECIPP_ALIGNMENT_UWORD 4 Compu_CTMA_phi_lim 0 3.99993896484375 /end CHARACTERISTIC
/begin COMPU_METHOD Compu_CTMA_phi_lim " " RAT_FUNC "%.3" "phi" COEFFS 0 16384 0 0 0 1 /end COMPU_METHOD
/begin CHARACTERISTIC CTM_CL_tgEGO "CTM CL trigger EGO" VALUE 0x001C9BFE /* @ECU_Address@CTM_CL_tgEGO@0x01001E70@ */ ECIPP_ALIGNMENT_UWORD 16000 Compu_CTM_CL_tgEGO 0 15999.755859375 /end CHARACTERISTIC
/begin COMPU_METHOD Compu_CTM_CL_tgEGO " " RAT_FUNC "%.0" "mV" COEFFS 0 4.096 0 0 0 1 /end COMPU_METHOD
/begin CHARACTERISTIC CTM_CL_tgphi "CTM CL trigger phi" VALUE 0x001C9BFC /* @ECU_Address@CTM_CL_tgphi@0x01001E78@ */ ECIPP_ALIGNMENT_UWORD 4 Compu_CTM_CL_tgphi 0 3.99993896484375 /end CHARACTERISTIC
/begin COMPU_METHOD Compu_CTM_CL_tgphi " " RAT_FUNC "%.3" "phi" COEFFS 0 16384 0 0 0 1 /end COMPU_METHOD
/begin CHARACTERISTIC CTM_CL_forcewt "CTM CL pulse force wait" VALUE 0x001C9BF6 /* @ECU_Address@CTM_CL_forcewt@0x01001E80@ */ ECIPP_ALIGNMENT_UWORD 66 Compu_CTM_CL_forcewt 0 65.535 /end CHARACTERISTIC
/begin COMPU_METHOD Compu_CTM_CL_forcewt " " RAT_FUNC "%.1" "sec" COEFFS 0 1000 0 0 0 1 /end COMPU_METHOD
/begin CHARACTERISTIC CTMA_CL_tgEGO "CTM CL trigger EGO" VALUE 0x001C9BDE /* @ECU_Address@CTMA_CL_tgEGO@0x01001E88@ */ ECIPP_ALIGNMENT_UWORD 16000 Compu_CTMA_CL_tgEGO 0 15999.755859375 /end CHARACTERISTIC
/begin COMPU_METHOD Compu_CTMA_CL_tgEGO " " RAT_FUNC "%.0" "mV" COEFFS 0 4.096 0 0 0 1 /end COMPU_METHOD
/begin CHARACTERISTIC CTMA_CL_tgphi "CTM CL trigger phi" VALUE 0x001C9BDC /* @ECU_Address@CTMA_CL_tgphi@0x01001E90@ */ ECIPP_ALIGNMENT_UWORD 4 Compu_CTMA_CL_tgphi 0 3.99993896484375 /end CHARACTERISTIC
/begin COMPU_METHOD Compu_CTMA_CL_tgphi " " RAT_FUNC "%.3" "phi" COEFFS 0 16384 0 0 0 1 /end COMPU_METHOD
/begin CHARACTERISTIC CTMA_CL_forcewt "CTM CL pulse force wait" VALUE 0x001C9BD6 /* @ECU_Address@CTMA_CL_forcewt@0x01001E98@ */ ECIPP_ALIGNMENT_UWORD 66 Compu_CTMA_CL_forcewt 0 65.535 /end CHARACTERISTIC
/begin COMPU_METHOD Compu_CTMA_CL_forcewt " " RAT_FUNC "%.1" "sec" COEFFS 0 1000 0 0 0 1 /end COMPU_METHOD
/begin MEASUREMENT CLp_wave_RMS "CL1 perturbation wave RMS" UWORD Compu_CLp_wave_RMS 0 0 0 3.99993896484375 ECU_ADDRESS 0x01001EC8 /end MEASUREMENT
/begin COMPU_METHOD Compu_CLp_wave_RMS " " RAT_FUNC "%.3" "phi" COEFFS 0 16384 0 0 0 1 /end COMPU_METHOD
/begin MEASUREMENT CM1_RMScomp "CM1 current RMS limit" UWORD Compu_CM1_RMScomp 0 0 0 3.99993896484375 ECU_ADDRESS 0x01001ED0 /end MEASUREMENT
/begin COMPU_METHOD Compu_CM1_RMScomp " " RAT_FUNC "%.3" "phi" COEFFS 0 16384 0 0 0 1 /end COMPU_METHOD
/begin MEASUREMENT EGO1_phiFB_RMS "EGO1 RMS" UWORD Compu_EGO1_phiFB_RMS 0 0 0 3.99993896484375 ECU_ADDRESS 0x01001ED8 /end MEASUREMENT
/begin COMPU_METHOD Compu_EGO1_phiFB_RMS " " RAT_FUNC "%.3" "phi" COEFFS 0 16384 0 0 0 1 /end COMPU_METHOD
/begin MEASUREMENT EGO2_phiFB_RMS "EGO2 RMS" UWORD Compu_EGO2_phiFB_RMS 0 0 0 3.99993896484375 ECU_ADDRESS 0x01001EE0 /end MEASUREMENT
/begin COMPU_METHOD Compu_EGO2_phiFB_RMS " " RAT_FUNC "%.3" "phi" COEFFS 0 16384 0 0 0 1 /end COMPU_METHOD
/begin MEASUREMENT EGO3_phiFB_RMS "EGO3 RMS" UWORD Compu_EGO3_phiFB_RMS 0 0 0 3.99993896484375 ECU_ADDRESS 0x01001EE8 /end MEASUREMENT
/begin COMPU_METHOD Compu_EGO3_phiFB_RMS " " RAT_FUNC "%.3" "phi" COEFFS 0 16384 0 0 0 1 /end COMPU_METHOD
/begin MEASUREMENT CM1_RMSsrc "CM1 RMS comparison source{CM1_RMSsrc&0xff=0:Off}{CM1_RMSsrc&0xff=1:Inactive}{CM1_RMSsrc&0xff=2:Bank 1 Pre-cat}{CM1_RMSsrc&0xff=3:Bank 2 Pre-cat}{CM1_RMSsrc&0xff=4:CL Input Wave}{CM1_RMSsrc&0xff=5:Fixed Value}" UBYTE CM1_RMSsrc_COMPU_VTAB 0 0 0 255 ECU_ADDRESS 0x01001F38 BIT_MASK 0xff /end MEASUREMENT
/begin COMPU_METHOD CM1_RMSsrc_COMPU_VTAB "Verbal Table" TAB_VERB "%.0" "list" COMPU_TAB_REF CM1_RMSsrc_COMPU_VTAB_REF /end COMPU_METHOD
/begin COMPU_VTAB CM1_RMSsrc_COMPU_VTAB_REF "Verbal Table" TAB_VERB 6 0 "Off" 1 "Inactive" 2 "Bank 1 Pre-cat" 3 "Bank 2 Pre-cat" 4 "CL Input Wave" 5 "Fixed Value" DEFAULT_VALUE "UNKNOWN" /end COMPU_VTAB
/begin CHARACTERISTIC CL_CM_min_RMS "CM fixed min RMS (Fault Condition:EGO3/4 RMS >)" VALUE 0x001C34BA /* @ECU_Address@CL_CM_min_RMS@0x01001FA0@ */ ECIPP_ALIGNMENT_UWORD 4 Compu_CL_CM_min_RMS 0 3.99993896484375 /end CHARACTERISTIC
/begin COMPU_METHOD Compu_CL_CM_min_RMS " " RAT_FUNC "%.3" "phi" COEFFS 0 16384 0 0 0 1 /end COMPU_METHOD
/begin CHARACTERISTIC CLLP_CM_min_RMS "CM fixed min RMS (Fault Condition:EGO3 RMS >)" VALUE 0x001C19FE /* @ECU_Address@CLLP_CM_min_RMS@0x01001FA8@ */ ECIPP_ALIGNMENT_UWORD 4 Compu_CLLP_CM_min_RMS 0 3.99993896484375 /end CHARACTERISTIC
/begin COMPU_METHOD Compu_CLLP_CM_min_RMS " " RAT_FUNC "%.3" "phi" COEFFS 0 16384 0 0 0 1 /end COMPU_METHOD
/begin CHARACTERISTIC CLNG_CM_min_RMS "CM fixed min RMS (Fault Condition:EGO3 RMS >)" VALUE 0x001C2968 /* @ECU_Address@CLNG_CM_min_RMS@0x01001FB0@ */ ECIPP_ALIGNMENT_UWORD 4 Compu_CLNG_CM_min_RMS 0 3.99993896484375 /end CHARACTERISTIC
/begin COMPU_METHOD Compu_CLNG_CM_min_RMS " " RAT_FUNC "%.3" "phi" COEFFS 0 16384 0 0 0 1 /end COMPU_METHOD
/begin CHARACTERISTIC CL_CM_waveRMSatt "CM CL wave RMS attenuation (Fault Condition:and EGO3/4 RMS > CL waveform RMS *)" VALUE 0x001C34BC /* @ECU_Address@CL_CM_waveRMSatt@0x01001FB8@ */ ECIPP_ALIGNMENT_UWORD 100 Compu_CL_CM_waveRMSatt 0 99.9984741210938 /end CHARACTERISTIC
/begin COMPU_METHOD Compu_CL_CM_waveRMSatt " " RAT_FUNC "%.1" "%" COEFFS 0 655.36 0 0 0 1 /end COMPU_METHOD
/begin CHARACTERISTIC CLLP_CM_waveRMSatt "CM CL wave RMS attenuation (Fault Condition:and EGO3 RMS > CL waveform RMS *)" VALUE 0x001C1A00 /* @ECU_Address@CLLP_CM_waveRMSatt@0x01001FC0@ */ ECIPP_ALIGNMENT_UWORD 100 Compu_CLLP_CM_waveRMSatt 0 99.9984741210938 /end CHARACTERISTIC
/begin COMPU_METHOD Compu_CLLP_CM_waveRMSatt " " RAT_FUNC "%.1" "%" COEFFS 0 655.36 0 0 0 1 /end COMPU_METHOD
/begin CHARACTERISTIC CLNG_CM_waveRMSatt "CM CL wave RMS attenuation (Fault Condition:and EGO3 RMS > CL waveform RMS *)" VALUE 0x001C296A /* @ECU_Address@CLNG_CM_waveRMSatt@0x01001FC8@ */ ECIPP_ALIGNMENT_UWORD 100 Compu_CLNG_CM_waveRMSatt 0 99.9984741210938 /end CHARACTERISTIC
/begin COMPU_METHOD Compu_CLNG_CM_waveRMSatt " " RAT_FUNC "%.1" "%" COEFFS 0 655.36 0 0 0 1 /end COMPU_METHOD
/begin CHARACTERISTIC CL_CM_preRMSatt "CM pre-cat EGO RMS attenuation (Fault Condition:and EGO3/4 RMS > EGO1/2 RMS *)" VALUE 0x001C34BE /* @ECU_Address@CL_CM_preRMSatt@0x01001FD0@ */ ECIPP_ALIGNMENT_UWORD 100 Compu_CL_CM_preRMSatt 0 99.9984741210938 /end CHARACTERISTIC
/begin COMPU_METHOD Compu_CL_CM_preRMSatt " " RAT_FUNC "%.1" "%" COEFFS 0 655.36 0 0 0 1 /end COMPU_METHOD
/begin CHARACTERISTIC CLLP_CM_preRMSatt "CM pre-cat EGO RMS attenuation (Fault Condition:and EGO3 RMS > EGO1/2 RMS *)" VALUE 0x001C1A02 /* @ECU_Address@CLLP_CM_preRMSatt@0x01001FD8@ */ ECIPP_ALIGNMENT_UWORD 100 Compu_CLLP_CM_preRMSatt 0 99.9984741210938 /end CHARACTERISTIC
/begin COMPU_METHOD Compu_CLLP_CM_preRMSatt " " RAT_FUNC "%.1" "%" COEFFS 0 655.36 0 0 0 1 /end COMPU_METHOD
/begin CHARACTERISTIC CLNG_CM_preRMSatt "CM pre-cat EGO RMS attenuation (Fault Condition:and EGO3 RMS > EGO1/2 RMS *)" VALUE 0x001C296C /* @ECU_Address@CLNG_CM_preRMSatt@0x01001FE0@ */ ECIPP_ALIGNMENT_UWORD 100 Compu_CLNG_CM_preRMSatt 0 99.9984741210938 /end CHARACTERISTIC
/begin COMPU_METHOD Compu_CLNG_CM_preRMSatt " " RAT_FUNC "%.1" "%" COEFFS 0 655.36 0 0 0 1 /end COMPU_METHOD
/begin MEASUREMENT sim_engine_mode "Engine simulation mode{sim_engine_mode&0xff=0:Disabled}{sim_engine_mode&0xff=1:Enabled}" UBYTE sim_engine_mode_COMPU_VTAB 0 0 0 255 ECU_ADDRESS 0x01002D00 BIT_MASK 0xff /end MEASUREMENT
/begin COMPU_METHOD sim_engine_mode_COMPU_VTAB "Verbal Table" TAB_VERB "%.0" "list" COMPU_TAB_REF sim_engine_mode_COMPU_VTAB_REF /end COMPU_METHOD
/begin COMPU_VTAB sim_engine_mode_COMPU_VTAB_REF "Verbal Table" TAB_VERB 2 0 "Disabled" 1 "Enabled" DEFAULT_VALUE "UNKNOWN" /end COMPU_VTAB
/begin MEASUREMENT simulation_key "Simulation mode key" UWORD Compu_simulation_key 0 0 0 65535 ECU_ADDRESS 0x01002D08 /end MEASUREMENT
/begin COMPU_METHOD Compu_simulation_key " " RAT_FUNC "%.0" "-1234" COEFFS 0 1 0 0 0 1 /end COMPU_METHOD
/begin MEASUREMENT EGO4_phiFB_RMS "EGO4 RMS" UWORD Compu_EGO4_phiFB_RMS 0 0 0 3.99993896484375 ECU_ADDRESS 0x01003908 /end MEASUREMENT
/begin COMPU_METHOD Compu_EGO4_phiFB_RMS " " RAT_FUNC "%.3" "phi" COEFFS 0 16384 0 0 0 1 /end COMPU_METHOD
/begin MEASUREMENT CM2_RMSsrc "CM2 RMS comparison source{CM2_RMSsrc&0xff=0:Off}{CM2_RMSsrc&0xff=1:Inactive}{CM2_RMSsrc&0xff=2:Bank 1 Pre-cat}{CM2_RMSsrc&0xff=3:Bank 2 Pre-cat}{CM2_RMSsrc&0xff=4:CL Input Wave}{CM2_RMSsrc&0xff=5:Fixed Value}" UBYTE CM2_RMSsrc_COMPU_VTAB 0 0 0 255 ECU_ADDRESS 0x01003920 BIT_MASK 0xff /end MEASUREMENT
/begin COMPU_METHOD CM2_RMSsrc_COMPU_VTAB "Verbal Table" TAB_VERB "%.0" "list" COMPU_TAB_REF CM2_RMSsrc_COMPU_VTAB_REF /end COMPU_METHOD
/begin COMPU_VTAB CM2_RMSsrc_COMPU_VTAB_REF "Verbal Table" TAB_VERB 6 0 "Off" 1 "Inactive" 2 "Bank 1 Pre-cat" 3 "Bank 2 Pre-cat" 4 "CL Input Wave" 5 "Fixed Value" DEFAULT_VALUE "UNKNOWN" /end COMPU_VTAB
/begin MEASUREMENT CL2_wave_RMS "CL2 perturbation wave RMS" UWORD Compu_CL2_wave_RMS 0 0 0 3.99993896484375 ECU_ADDRESS 0x01003928 /end MEASUREMENT
/begin COMPU_METHOD Compu_CL2_wave_RMS " " RAT_FUNC "%.3" "phi" COEFFS 0 16384 0 0 0 1 /end COMPU_METHOD
/begin MEASUREMENT CM2_RMScomp "CM2 current RMS limit" UWORD Compu_CM2_RMScomp 0 0 0 3.99993896484375 ECU_ADDRESS 0x01003930 /end MEASUREMENT
/begin COMPU_METHOD Compu_CM2_RMScomp " " RAT_FUNC "%.3" "phi" COEFFS 0 16384 0 0 0 1 /end COMPU_METHOD
/begin MEASUREMENT ICam_samp_BTDC "Cam1 edge sample" SWORD Compu_ICam_samp_BTDC 0 0 -2048 2047.9375 ECU_ADDRESS 0x010041C8 /end MEASUREMENT
/begin COMPU_METHOD Compu_ICam_samp_BTDC " " RAT_FUNC "%.1" "CAD BTDC" COEFFS 0 16 0 0 0 1 /end COMPU_METHOD
/begin MEASUREMENT ECam_samp_BTDC "Cam2 edge sample" SWORD Compu_ECam_samp_BTDC 0 0 -2048 2047.9375 ECU_ADDRESS 0x010041D0 /end MEASUREMENT
/begin COMPU_METHOD Compu_ECam_samp_BTDC " " RAT_FUNC "%.1" "CAD BTDC" COEFFS 0 16 0 0 0 1 /end COMPU_METHOD
/begin MEASUREMENT ICam_timing_d "Cam1 open target" SWORD Compu_ICam_timing_d 0 0 -2048 2047.9375 ECU_ADDRESS 0x010041D8 /end MEASUREMENT
/begin COMPU_METHOD Compu_ICam_timing_d " " RAT_FUNC "%.1" "CAD BTDC" COEFFS 0 16 0 0 0 1 /end COMPU_METHOD
/begin MEASUREMENT ECam_timing_d "Cam2 close target" SWORD Compu_ECam_timing_d 0 0 -2048 2047.9375 ECU_ADDRESS 0x010041E0 /end MEASUREMENT
/begin COMPU_METHOD Compu_ECam_timing_d " " RAT_FUNC "%.1" "CAD BTDC" COEFFS 0 16 0 0 0 1 /end COMPU_METHOD
/begin MEASUREMENT ICam_control "Cam1 control cmd" SWORD Compu_ICam_control 0 0 -100 99.9969482421875 ECU_ADDRESS 0x010041E8 /end MEASUREMENT
/begin COMPU_METHOD Compu_ICam_control " " RAT_FUNC "%.1" "%" COEFFS 0 327.68 0 0 0 1 /end COMPU_METHOD
/begin MEASUREMENT ICam_PWM_DC "Cam1 control PWM DC" UWORD Compu_ICam_PWM_DC 0 0 0 99.9984741210938 ECU_ADDRESS 0x010041F0 /end MEASUREMENT
/begin COMPU_METHOD Compu_ICam_PWM_DC " " RAT_FUNC "%.1" "%" COEFFS 0 655.36 0 0 0 1 /end COMPU_METHOD
/begin CHARACTERISTIC ICam_PWM_taud "ICam control PWM tau" VALUE 0x001C9F34 /* @ECU_Address@ICam_PWM_taud@0x010041F8@ */ ECIPP_ALIGNMENT_UWORD 210 Compu_ICam_PWM_taud 0 209.712 /end CHARACTERISTIC
/begin COMPU_METHOD Compu_ICam_PWM_taud " " RAT_FUNC "%.1" "ms" COEFFS 0 312.5 0 0 0 1 /end COMPU_METHOD
/begin MEASUREMENT ECam_control "Cam2 control cmd" SWORD Compu_ECam_control 0 0 -100 99.9969482421875 ECU_ADDRESS 0x01004200 /end MEASUREMENT
/begin COMPU_METHOD Compu_ECam_control " " RAT_FUNC "%.1" "%" COEFFS 0 327.68 0 0 0 1 /end COMPU_METHOD
/begin MEASUREMENT ECam_PWM_DC "Cam2 control PWM DC" UWORD Compu_ECam_PWM_DC 0 0 0 99.9984741210938 ECU_ADDRESS 0x01004208 /end MEASUREMENT
/begin COMPU_METHOD Compu_ECam_PWM_DC " " RAT_FUNC "%.1" "%" COEFFS 0 655.36 0 0 0 1 /end COMPU_METHOD
/begin CHARACTERISTIC ECam_PWM_taud "ECam control PWM tau" VALUE 0x001C9CC0 /* @ECU_Address@ECam_PWM_taud@0x01004210@ */ ECIPP_ALIGNMENT_UWORD 210 Compu_ECam_PWM_taud 0 209.712 /end CHARACTERISTIC
/begin COMPU_METHOD Compu_ECam_PWM_taud " " RAT_FUNC "%.1" "ms" COEFFS 0 312.5 0 0 0 1 /end COMPU_METHOD
/begin MEASUREMENT ICam_PWM_mode "Cam1 PWM mode{ICam_PWM_mode&0xff=0:Automatic}{ICam_PWM_mode&0xff=1:Manual Timing}{ICam_PWM_mode&0xff=2:Manual DC}" UBYTE ICam_PWM_mode_COMPU_VTAB 0 0 0 255 ECU_ADDRESS 0x01004218 BIT_MASK 0xff /end MEASUREMENT
/begin COMPU_METHOD ICam_PWM_mode_COMPU_VTAB "Verbal Table" TAB_VERB "%.0" "list" COMPU_TAB_REF ICam_PWM_mode_COMPU_VTAB_REF /end COMPU_METHOD
/begin COMPU_VTAB ICam_PWM_mode_COMPU_VTAB_REF "Verbal Table" TAB_VERB 3 0 "Automatic" 1 "Manual Timing" 2 "Manual DC" DEFAULT_VALUE "UNKNOWN" /end COMPU_VTAB
/begin MEASUREMENT ECam_PWM_mode "Cam2 PWM mode{ECam_PWM_mode&0xff=0:Automatic}{ECam_PWM_mode&0xff=1:Manual Timing}{ECam_PWM_mode&0xff=2:Manual DC}" UBYTE ECam_PWM_mode_COMPU_VTAB 0 0 0 255 ECU_ADDRESS 0x01004220 BIT_MASK 0xff /end MEASUREMENT
/begin COMPU_METHOD ECam_PWM_mode_COMPU_VTAB "Verbal Table" TAB_VERB "%.0" "list" COMPU_TAB_REF ECam_PWM_mode_COMPU_VTAB_REF /end COMPU_METHOD
/begin COMPU_VTAB ECam_PWM_mode_COMPU_VTAB_REF "Verbal Table" TAB_VERB 3 0 "Automatic" 1 "Manual Timing" 2 "Manual DC" DEFAULT_VALUE "UNKNOWN" /end COMPU_VTAB
/begin CHARACTERISTIC ICam_timing_ctrl "Cam1 / ICam timing control{ICam_timing_ctrl&0xff=0:Disabled}{ICam_timing_ctrl&0xff=1:Aux PWM1}{ICam_timing_ctrl&0xff=2:Aux PWM2}{ICam_timing_ctrl&0xff=3:Aux PWM3}{ICam_timing_ctrl&0xff=4:Aux PWM4}{ICam_timing_ctrl&0xff=5:Aux PWM5}{ICam_timing_ctrl&0xff=6:" VALUE 0x001C9F5C /* @ECU_Address@ICam_timing_ctrl@0x01004228@ */ ECIPP_ALIGNMENT_UBYTE 255 ICam_timing_ctrl_COMPU_VTAB 0 255 BIT_MASK 0xff /end CHARACTERISTIC
/begin COMPU_METHOD ICam_timing_ctrl_COMPU_VTAB "Verbal Table" TAB_VERB "%.0" "list" COMPU_TAB_REF ICam_timing_ctrl_COMPU_VTAB_REF /end COMPU_METHOD
/begin COMPU_VTAB ICam_timing_ctrl_COMPU_VTAB_REF "Verbal Table" TAB_VERB 11 0 "Disabled" 1 "Aux PWM1" 2 "Aux PWM2" 3 "Aux PWM3" 4 "Aux PWM4" 5 "Aux PWM5" 6 "Aux PWM6" 7 "EGOH1" 8 "EGOH2" 9 "EGOH3" 10 "EGOH4" DEFAULT_VALUE "UNKNOWN" /end COMPU_VTAB
/begin CHARACTERISTIC ECam_timing_ctrl "Cam2 / ECam timing control{ECam_timing_ctrl&0xff=0:Disabled}{ECam_timing_ctrl&0xff=1:Aux PWM1}{ECam_timing_ctrl&0xff=2:Aux PWM2}{ECam_timing_ctrl&0xff=3:Aux PWM3}{ECam_timing_ctrl&0xff=4:Aux PWM4}{ECam_timing_ctrl&0xff=5:Aux PWM5}{ECam_timing_ctrl&0xff=6:" VALUE 0x001C9CE8 /* @ECU_Address@ECam_timing_ctrl@0x01004230@ */ ECIPP_ALIGNMENT_UBYTE 255 ECam_timing_ctrl_COMPU_VTAB 0 255 BIT_MASK 0xff /end CHARACTERISTIC
/begin COMPU_METHOD ECam_timing_ctrl_COMPU_VTAB "Verbal Table" TAB_VERB "%.0" "list" COMPU_TAB_REF ECam_timing_ctrl_COMPU_VTAB_REF /end COMPU_METHOD
/begin COMPU_VTAB ECam_timing_ctrl_COMPU_VTAB_REF "Verbal Table" TAB_VERB 11 0 "Disabled" 1 "Aux PWM1" 2 "Aux PWM2" 3 "Aux PWM3" 4 "Aux PWM4" 5 "Aux PWM5" 6 "Aux PWM6" 7 "EGOH1" 8 "EGOH2" 9 "EGOH3" 10 "EGOH4" DEFAULT_VALUE "UNKNOWN" /end COMPU_VTAB
/begin MEASUREMENT ICam_I_acc "Cam1 integrator value" SLONG Compu_ICam_I_acc 0 0 -3200 3199.99999850988 ECU_ADDRESS 0x01004238 /end MEASUREMENT
/begin COMPU_METHOD Compu_ICam_I_acc " " RAT_FUNC "%.1" "%" COEFFS 0 671088.64 0 0 0 1 /end COMPU_METHOD
/begin CHARACTERISTIC ICam_I_min "ICam integrator min" VALUE 0x001C9F50 /* @ECU_Address@ICam_I_min@0x01004240@ */ ECIPP_ALIGNMENT_SLONG 3200 Compu_ICam_I_min -3200 3199.99999850988 /end CHARACTERISTIC
/begin COMPU_METHOD Compu_ICam_I_min " " RAT_FUNC "%.1" "%" COEFFS 0 671088.64 0 0 0 1 /end COMPU_METHOD
/begin CHARACTERISTIC ICam_I_max "ICam integrator max" VALUE 0x001C9F4C /* @ECU_Address@ICam_I_max@0x01004248@ */ ECIPP_ALIGNMENT_SLONG 3200 Compu_ICam_I_max -3200 3199.99999850988 /end CHARACTERISTIC
/begin COMPU_METHOD Compu_ICam_I_max " " RAT_FUNC "%.1" "%" COEFFS 0 671088.64 0 0 0 1 /end COMPU_METHOD
/begin CHARACTERISTIC ECam_I_min "ECam integrator min" VALUE 0x001C9CDC /* @ECU_Address@ECam_I_min@0x01004250@ */ ECIPP_ALIGNMENT_SLONG 3200 Compu_ECam_I_min -3200 3199.99999850988 /end CHARACTERISTIC
/begin COMPU_METHOD Compu_ECam_I_min " " RAT_FUNC "%.1" "%" COEFFS 0 671088.64 0 0 0 1 /end COMPU_METHOD
/begin CHARACTERISTIC ECam_I_max "ECam integrator max" VALUE 0x001C9CD8 /* @ECU_Address@ECam_I_max@0x01004258@ */ ECIPP_ALIGNMENT_SLONG 3200 Compu_ECam_I_max -3200 3199.99999850988 /end CHARACTERISTIC
/begin COMPU_METHOD Compu_ECam_I_max " " RAT_FUNC "%.1" "%" COEFFS 0 671088.64 0 0 0 1 /end COMPU_METHOD
/begin CHARACTERISTIC ICam_coil_Inom "ICam coil nominal current" VALUE 0x001C9F44 /* @ECU_Address@ICam_coil_Inom@0x01004290@ */ ECIPP_ALIGNMENT_UWORD 64 Compu_ICam_coil_Inom 0 63.9990234375 /end CHARACTERISTIC
/begin COMPU_METHOD Compu_ICam_coil_Inom " " RAT_FUNC "%.2" "amps" COEFFS 0 1024 0 0 0 1 /end COMPU_METHOD
/begin CHARACTERISTIC ECam_coil_Inom "ECam coil nominal current" VALUE 0x001C9CD0 /* @ECU_Address@ECam_coil_Inom@0x010042A8@ */ ECIPP_ALIGNMENT_UWORD 64 Compu_ECam_coil_Inom 0 63.9990234375 /end CHARACTERISTIC
/begin COMPU_METHOD Compu_ECam_coil_Inom " " RAT_FUNC "%.2" "amps" COEFFS 0 1024 0 0 0 1 /end COMPU_METHOD
/begin MEASUREMENT ICam_coil_Id "Cam1 coil desired current" UWORD Compu_ICam_coil_Id 0 0 0 63.9990234375 ECU_ADDRESS 0x010042C0 /end MEASUREMENT
/begin COMPU_METHOD Compu_ICam_coil_Id " " RAT_FUNC "%.2" "amps" COEFFS 0 1024 0 0 0 1 /end COMPU_METHOD
/begin MEASUREMENT ICam_coil_R "Cam1 coil resistance" UWORD Compu_ICam_coil_R 0 0 0 63.9990234375 ECU_ADDRESS 0x010042C8 /end MEASUREMENT
/begin COMPU_METHOD Compu_ICam_coil_R " " RAT_FUNC "%.2" "ohms" COEFFS 0 1024 0 0 0 1 /end COMPU_METHOD
/begin CHARACTERISTIC ICam_Kp "ICam Kp" VALUE 0x001C9F46 /* @ECU_Address@ICam_Kp@0x010042D0@ */ ECIPP_ALIGNMENT_SWORD 100 Compu_ICam_Kp -100 99.9969482421875 /end CHARACTERISTIC
/begin COMPU_METHOD Compu_ICam_Kp " " RAT_FUNC "%.1" "%/CAD" COEFFS 0 327.68 0 0 0 1 /end COMPU_METHOD
/begin CHARACTERISTIC ECam_Kp "ECam Kp" VALUE 0x001C9CD2 /* @ECU_Address@ECam_Kp@0x010042D8@ */ ECIPP_ALIGNMENT_SWORD 100 Compu_ECam_Kp -100 99.9969482421875 /end CHARACTERISTIC
/begin COMPU_METHOD Compu_ECam_Kp " " RAT_FUNC "%.1" "%/CAD" COEFFS 0 327.68 0 0 0 1 /end COMPU_METHOD
/begin CHARACTERISTIC ICam_Ki "ICam Ki" VALUE 0x001C9F48 /* @ECU_Address@ICam_Ki@0x010042E0@ */ ECIPP_ALIGNMENT_SWORD 781 Compu_ICam_Ki -781.25 781.22615814209 /end CHARACTERISTIC
/begin COMPU_METHOD Compu_ICam_Ki " " RAT_FUNC "%.1" "%/CAD/sec" COEFFS 0 41.94304 0 0 0 1 /end COMPU_METHOD
/begin CHARACTERISTIC ECam_Ki "ECam Ki" VALUE 0x001C9CD4 /* @ECU_Address@ECam_Ki@0x010042E8@ */ ECIPP_ALIGNMENT_SWORD 781 Compu_ECam_Ki -781.25 781.22615814209 /end CHARACTERISTIC
/begin COMPU_METHOD Compu_ECam_Ki " " RAT_FUNC "%.1" "%/CAD/sec" COEFFS 0 41.94304 0 0 0 1 /end COMPU_METHOD
/begin MEASUREMENT ECam_I_acc "Cam2 integrator value" SLONG Compu_ECam_I_acc 0 0 -3200 3199.99999850988 ECU_ADDRESS 0x01004310 /end MEASUREMENT
/begin COMPU_METHOD Compu_ECam_I_acc " " RAT_FUNC "%.1" "%" COEFFS 0 671088.64 0 0 0 1 /end COMPU_METHOD
/begin MEASUREMENT ECam_coil_Id "Cam2 coil desired current" UWORD Compu_ECam_coil_Id 0 0 0 63.9990234375 ECU_ADDRESS 0x01004318 /end MEASUREMENT
/begin COMPU_METHOD Compu_ECam_coil_Id " " RAT_FUNC "%.2" "amps" COEFFS 0 1024 0 0 0 1 /end COMPU_METHOD
/begin MEASUREMENT ECam_coil_R "Cam2 coil resistance" UWORD Compu_ECam_coil_R 0 0 0 63.9990234375 ECU_ADDRESS 0x01004320 /end MEASUREMENT
/begin COMPU_METHOD Compu_ECam_coil_R " " RAT_FUNC "%.2" "ohms" COEFFS 0 1024 0 0 0 1 /end COMPU_METHOD
/begin CHARACTERISTIC Cam_strt_I "Cam engine-starting current" VALUE 0x001c6e58 /* @ECU_Address@Cam_strt_I@0x010047C0@ */ ECIPP_ALIGNMENT_UWORD 64 Compu_Cam_strt_I 0 63.9990234375 /end CHARACTERISTIC
/begin COMPU_METHOD Compu_Cam_strt_I " " RAT_FUNC "%.2" "amps" COEFFS 0 1024 0 0 0 1 /end COMPU_METHOD
/begin CHARACTERISTIC Cam_strt_tout "Cam engine-starting base timeout" VALUE 0x001c4278 /* @ECU_Address@Cam_strt_tout@0x010047C8@ */ ECIPP_ALIGNMENT_ULONG 4294967 Compu_Cam_strt_tout 0 4294967.295 /end CHARACTERISTIC
/begin COMPU_METHOD Compu_Cam_strt_tout " " RAT_FUNC "%.3" "sec" COEFFS 0 1000 0 0 0 1 /end COMPU_METHOD
/begin MEASUREMENT CBT_ss "Steady-state catalyst bed temperature" UWORD Compu_CBT_ss 0 0 -460 7731.875 ECU_ADDRESS 0x010047D8 /end MEASUREMENT
/begin COMPU_METHOD Compu_CBT_ss " " RAT_FUNC "%.0" "deg F" COEFFS 0 8 3680 0 0 1 /end COMPU_METHOD
/begin MEASUREMENT CBT_tauactv "CTM currently active time constant" UWORD Compu_CBT_tauactv 0 0 0 1048.56 ECU_ADDRESS 0x010047E0 /end MEASUREMENT
/begin COMPU_METHOD Compu_CBT_tauactv " " RAT_FUNC "%.1" "sec" COEFFS 0 62.5 0 0 0 1 /end COMPU_METHOD
/begin MEASUREMENT CTM_dppredT "CTM pre-cat delta-phi/delta-T gain" SWORD Compu_CTM_dppredT 0 0 -0.09765625 9.76532697677612E-02 ECU_ADDRESS 0x010047E8 /end MEASUREMENT
/begin COMPU_METHOD Compu_CTM_dppredT " " RAT_FUNC "%.4" "dphi/100 F" COEFFS 0 335544.32 0 0 0 1 /end COMPU_METHOD
/begin MEASUREMENT CTM_dppre "CTM pre-cat delta-phi adjustment" SWORD Compu_CTM_dppre 0 0 -2 1.99993896484375 ECU_ADDRESS 0x010047F0 /end MEASUREMENT
/begin COMPU_METHOD Compu_CTM_dppre " " RAT_FUNC "%.3" "delta-phi" COEFFS 0 16384 0 0 0 1 /end COMPU_METHOD
/begin CHARACTERISTIC CTM_tau_source "CTM tau source{CTM_tau_source&0xff=0:Single-Point}{CTM_tau_source&0xff=1:Table-Based}" VALUE 0x001C9C06 /* @ECU_Address@CTM_tau_source@0x01004808@ */ ECIPP_ALIGNMENT_UBYTE 255 CTM_tau_source_COMPU_VTAB 0 255 BIT_MASK 0xff /end CHARACTERISTIC
/begin COMPU_METHOD CTM_tau_source_COMPU_VTAB "Verbal Table" TAB_VERB "%.0" "list" COMPU_TAB_REF CTM_tau_source_COMPU_VTAB_REF /end COMPU_METHOD
/begin COMPU_VTAB CTM_tau_source_COMPU_VTAB_REF "Verbal Table" TAB_VERB 2 0 "Single-Point" 1 "Table-Based" DEFAULT_VALUE "UNKNOWN" /end COMPU_VTAB
/begin CHARACTERISTIC CTMA_tau_source "CTM tau source{CTMA_tau_source&0xff=0:Single-Point}{CTMA_tau_source&0xff=1:Table-Based}" VALUE 0x001C9BE6 /* @ECU_Address@CTMA_tau_source@0x01004810@ */ ECIPP_ALIGNMENT_UBYTE 255 CTMA_tau_source_COMPU_VTAB 0 255 BIT_MASK 0xff /end CHARACTERISTIC
/begin COMPU_METHOD CTMA_tau_source_COMPU_VTAB "Verbal Table" TAB_VERB "%.0" "list" COMPU_TAB_REF CTMA_tau_source_COMPU_VTAB_REF /end COMPU_METHOD
/begin COMPU_VTAB CTMA_tau_source_COMPU_VTAB_REF "Verbal Table" TAB_VERB 2 0 "Single-Point" 1 "Table-Based" DEFAULT_VALUE "UNKNOWN" /end COMPU_VTAB
/begin MEASUREMENT sim_fault_latch "Fault simulation action{sim_fault_latch&0xff=0:Immediately latch}{sim_fault_latch&0xff=1:Simulate latch}{sim_fault_latch&0xff=2:Simulate unlatch}{sim_fault_latch&0xff=3:Clear active}{sim_fault_latch&0xff=4:Reset count}{sim_fault_latch&0xff=5:Allow numer i" UBYTE sim_fault_latch_COMPU_VTAB 0 0 0 255 ECU_ADDRESS 0x01005608 BIT_MASK 0xff /end MEASUREMENT
/begin COMPU_METHOD sim_fault_latch_COMPU_VTAB "Verbal Table" TAB_VERB "%.0" "list" COMPU_TAB_REF sim_fault_latch_COMPU_VTAB_REF /end COMPU_METHOD
/begin COMPU_VTAB sim_fault_latch_COMPU_VTAB_REF "Verbal Table" TAB_VERB 8 0 "Immediately latch" 1 "Simulate latch" 2 "Simulate unlatch" 3 "Clear active" 4 "Reset count" 5 "Allow numer inc" 6 "Allow denom inc" 7 "None" DEFAULT_VALUE "UNKNOWN" /end COMPU_VTAB
/begin MEASUREMENT sim_fault_mode "Fault simulation mode{sim_fault_mode&0xff=0:Disabled}{sim_fault_mode&0xff=1:Enabled}" UBYTE sim_fault_mode_COMPU_VTAB 0 0 0 255 ECU_ADDRESS 0x01006C38 BIT_MASK 0xff /end MEASUREMENT
/begin COMPU_METHOD sim_fault_mode_COMPU_VTAB "Verbal Table" TAB_VERB "%.0" "list" COMPU_TAB_REF sim_fault_mode_COMPU_VTAB_REF /end COMPU_METHOD
/begin COMPU_VTAB sim_fault_mode_COMPU_VTAB_REF "Verbal Table" TAB_VERB 2 0 "Disabled" 1 "Enabled" DEFAULT_VALUE "UNKNOWN" /end COMPU_VTAB
/begin MEASUREMENT sim_fault_prohibit "Non-simulated indexes{sim_fault_prohibit&0xff=0:Normal handling}{sim_fault_prohibit&0xff=1:Prohibit faults}" UBYTE sim_fault_prohibit_COMPU_VTAB 0 0 0 255 ECU_ADDRESS 0x01006C40 BIT_MASK 0xff /end MEASUREMENT
/begin COMPU_METHOD sim_fault_prohibit_COMPU_VTAB "Verbal Table" TAB_VERB "%.0" "list" COMPU_TAB_REF sim_fault_prohibit_COMPU_VTAB_REF /end COMPU_METHOD
/begin COMPU_VTAB sim_fault_prohibit_COMPU_VTAB_REF "Verbal Table" TAB_VERB 2 0 "Normal handling" 1 "Prohibit faults" DEFAULT_VALUE "UNKNOWN" /end COMPU_VTAB
/begin MEASUREMENT CAN_Rx_tout_add "CAN Rx timeout adder" UWORD Compu_CAN_Rx_tout_add 0 0 0 327675 ECU_ADDRESS 0x01007188 /end MEASUREMENT
/begin COMPU_METHOD Compu_CAN_Rx_tout_add " " RAT_FUNC "%.0" "ms" COEFFS 0 0.2 0 0 0 1 /end COMPU_METHOD
/begin MEASUREMENT calibration_key "Calibration only unlock key" UWORD Compu_calibration_key 0 0 0 65535 ECU_ADDRESS 0x01007190 /end MEASUREMENT
/begin COMPU_METHOD Compu_calibration_key " " RAT_FUNC "%.0" "-42405" COEFFS 0 1 0 0 0 1 /end COMPU_METHOD
/begin MEASUREMENT brake_fault "Primary/secondary brake fault{brake_fault&0xff=0:NO}{brake_fault&0xff=1:YES}" UBYTE brake_fault_COMPU_VTAB 0 0 0 255 ECU_ADDRESS 0x01007928 BIT_MASK 0xff /end MEASUREMENT
/begin COMPU_METHOD brake_fault_COMPU_VTAB "Verbal Table" TAB_VERB "%.0" "list" COMPU_TAB_REF brake_fault_COMPU_VTAB_REF /end COMPU_METHOD
/begin COMPU_VTAB brake_fault_COMPU_VTAB_REF "Verbal Table" TAB_VERB 2 0 "NO" 1 "YES" DEFAULT_VALUE "UNKNOWN" /end COMPU_VTAB
/begin MEASUREMENT DBW_toggle_cmd1 "DBW toggle cmd 1" UWORD Compu_DBW_toggle_cmd1 0 0 0 99.9984741210938 ECU_ADDRESS 0x01007A78 /end MEASUREMENT
/begin COMPU_METHOD Compu_DBW_toggle_cmd1 " " RAT_FUNC "%.1" "%" COEFFS 0 655.36 0 0 0 1 /end COMPU_METHOD
/begin MEASUREMENT DBW_toggle_cmd2 "DBW toggle cmd 2" UWORD Compu_DBW_toggle_cmd2 0 0 0 99.9984741210938 ECU_ADDRESS 0x01007A80 /end MEASUREMENT
/begin COMPU_METHOD Compu_DBW_toggle_cmd2 " " RAT_FUNC "%.1" "%" COEFFS 0 655.36 0 0 0 1 /end COMPU_METHOD
/begin MEASUREMENT DBW_toggle_ena "DBW toggle enable{DBW_toggle_ena&0xff=0:Disabled}{DBW_toggle_ena&0xff=1:Enabled}" UBYTE DBW_toggle_ena_COMPU_VTAB 0 0 0 255 ECU_ADDRESS 0x01007A88 BIT_MASK 0xff /end MEASUREMENT
/begin COMPU_METHOD DBW_toggle_ena_COMPU_VTAB "Verbal Table" TAB_VERB "%.0" "list" COMPU_TAB_REF DBW_toggle_ena_COMPU_VTAB_REF /end COMPU_METHOD
/begin COMPU_VTAB DBW_toggle_ena_COMPU_VTAB_REF "Verbal Table" TAB_VERB 2 0 "Disabled" 1 "Enabled" DEFAULT_VALUE "UNKNOWN" /end COMPU_VTAB
/begin MEASUREMENT DBW_toggle_ms "DBW toggle period" UWORD Compu_DBW_toggle_ms 0 0 0 65535 ECU_ADDRESS 0x01007A90 /end MEASUREMENT
/begin COMPU_METHOD Compu_DBW_toggle_ms " " RAT_FUNC "%.0" "ms" COEFFS 0 1 0 0 0 1 /end COMPU_METHOD
/begin MEASUREMENT FPP_calmode_ena "FPP cal mode select" UBYTE Compu_FPP_calmode_ena 0 0 0 255 ECU_ADDRESS 0x01007A98 /end MEASUREMENT
/begin COMPU_METHOD Compu_FPP_calmode_ena " " RAT_FUNC "%.0" "-" COEFFS 0 1 0 0 0 1 /end COMPU_METHOD
/begin MEASUREMENT FPP_calmode_latch "FPP cal mode latch" UBYTE Compu_FPP_calmode_latch 0 0 0 255 ECU_ADDRESS 0x01007AA0 /end MEASUREMENT
/begin COMPU_METHOD Compu_FPP_calmode_latch " " RAT_FUNC "%.0" "-" COEFFS 0 1 0 0 0 1 /end COMPU_METHOD
/begin MEASUREMENT FPP_calmode_pct1 "FPP cal mode pct 1" UWORD Compu_FPP_calmode_pct1 0 0 0 99.9984741210938 ECU_ADDRESS 0x01007AA8 /end MEASUREMENT
/begin COMPU_METHOD Compu_FPP_calmode_pct1 " " RAT_FUNC "%.1" "%" COEFFS 0 655.36 0 0 0 1 /end COMPU_METHOD
/begin MEASUREMENT FPP_calmode_pct2 "FPP cal mode pct 2" UWORD Compu_FPP_calmode_pct2 0 0 0 99.9984741210938 ECU_ADDRESS 0x01007AB0 /end MEASUREMENT
/begin COMPU_METHOD Compu_FPP_calmode_pct2 " " RAT_FUNC "%.1" "%" COEFFS 0 655.36 0 0 0 1 /end COMPU_METHOD
/begin MEASUREMENT FPP_calmode_pct3 "FPP cal mode pct 3" UWORD Compu_FPP_calmode_pct3 0 0 0 99.9984741210938 ECU_ADDRESS 0x01007AB8 /end MEASUREMENT
/begin COMPU_METHOD Compu_FPP_calmode_pct3 " " RAT_FUNC "%.1" "%" COEFFS 0 655.36 0 0 0 1 /end COMPU_METHOD
/begin MEASUREMENT FPP_calmode_pct4 "FPP cal mode pct 4" UWORD Compu_FPP_calmode_pct4 0 0 0 99.9984741210938 ECU_ADDRESS 0x01007AC0 /end MEASUREMENT
/begin COMPU_METHOD Compu_FPP_calmode_pct4 " " RAT_FUNC "%.1" "%" COEFFS 0 655.36 0 0 0 1 /end COMPU_METHOD
/begin MEASUREMENT Cam_strt_textra "Cam engine-starting additional timeout" ULONG Compu_Cam_strt_textra 0 0 0 4294967.295 ECU_ADDRESS 0x01008678 /end MEASUREMENT
/begin COMPU_METHOD Compu_Cam_strt_textra " " RAT_FUNC "%.3" "sec" COEFFS 0 1000 0 0 0 1 /end COMPU_METHOD
/begin CHARACTERISTIC Cam_pin_ena "Cam fault auto pin-unlock phase1-3 logic{Cam_pin_ena&0xff=0:Disabled}{Cam_pin_ena&0xff=1:Enabled}" VALUE 0x001c86b2 /* @ECU_Address@Cam_pin_ena@0x01008680@ */ ECIPP_ALIGNMENT_UBYTE 255 Cam_pin_ena_COMPU_VTAB 0 255 BIT_MASK 0xff /end CHARACTERISTIC
/begin COMPU_METHOD Cam_pin_ena_COMPU_VTAB "Verbal Table" TAB_VERB "%.0" "list" COMPU_TAB_REF Cam_pin_ena_COMPU_VTAB_REF /end COMPU_METHOD
/begin COMPU_VTAB Cam_pin_ena_COMPU_VTAB_REF "Verbal Table" TAB_VERB 2 0 "Disabled" 1 "Enabled" DEFAULT_VALUE "UNKNOWN" /end COMPU_VTAB
/begin CHARACTERISTIC Cam_pin_tout "Cam fault phase1 start-current pulse time" VALUE 0x001c6e56 /* @ECU_Address@Cam_pin_tout@0x01008688@ */ ECIPP_ALIGNMENT_UWORD 65535 Compu_Cam_pin_tout 0 65535 /end CHARACTERISTIC
/begin COMPU_METHOD Compu_Cam_pin_tout " " RAT_FUNC "%.0" "ms" COEFFS 0 1 0 0 0 1 /end COMPU_METHOD
/begin MEASUREMENT IC_pin_pulse_try "Cam1 fault pin-unlock activity{IC_pin_pulse_try&0xff=0:Inactive}{IC_pin_pulse_try&0xff=1:Pulsing}" UBYTE IC_pin_pulse_try_COMPU_VTAB 0 0 0 255 ECU_ADDRESS 0x01008690 BIT_MASK 0xff /end MEASUREMENT
/begin COMPU_METHOD IC_pin_pulse_try_COMPU_VTAB "Verbal Table" TAB_VERB "%.0" "list" COMPU_TAB_REF IC_pin_pulse_try_COMPU_VTAB_REF /end COMPU_METHOD
/begin COMPU_VTAB IC_pin_pulse_try_COMPU_VTAB_REF "Verbal Table" TAB_VERB 2 0 "Inactive" 1 "Pulsing" DEFAULT_VALUE "UNKNOWN" /end COMPU_VTAB
/begin MEASUREMENT EC_pin_pulse_try "Cam2 fault pin-unlock activity{EC_pin_pulse_try&0xff=0:Inactive}{EC_pin_pulse_try&0xff=1:Pulsing}" UBYTE EC_pin_pulse_try_COMPU_VTAB 0 0 0 255 ECU_ADDRESS 0x01008698 BIT_MASK 0xff /end MEASUREMENT
/begin COMPU_METHOD EC_pin_pulse_try_COMPU_VTAB "Verbal Table" TAB_VERB "%.0" "list" COMPU_TAB_REF EC_pin_pulse_try_COMPU_VTAB_REF /end COMPU_METHOD
/begin COMPU_VTAB EC_pin_pulse_try_COMPU_VTAB_REF "Verbal Table" TAB_VERB 2 0 "Inactive" 1 "Pulsing" DEFAULT_VALUE "UNKNOWN" /end COMPU_VTAB
/begin MEASUREMENT IC_pin_pulse_arm "Cam1 fault pin-unlock logic{IC_pin_pulse_arm&0xff=0:Disarmed}{IC_pin_pulse_arm&0xff=1:Armed}" UBYTE IC_pin_pulse_arm_COMPU_VTAB 0 0 0 255 ECU_ADDRESS 0x010086A0 BIT_MASK 0xff /end MEASUREMENT
/begin COMPU_METHOD IC_pin_pulse_arm_COMPU_VTAB "Verbal Table" TAB_VERB "%.0" "list" COMPU_TAB_REF IC_pin_pulse_arm_COMPU_VTAB_REF /end COMPU_METHOD
/begin COMPU_VTAB IC_pin_pulse_arm_COMPU_VTAB_REF "Verbal Table" TAB_VERB 2 0 "Disarmed" 1 "Armed" DEFAULT_VALUE "UNKNOWN" /end COMPU_VTAB
/begin MEASUREMENT EC_pin_pulse_arm "Cam2 fault pin-unlock logic{EC_pin_pulse_arm&0xff=0:Disarmed}{EC_pin_pulse_arm&0xff=1:Armed}" UBYTE EC_pin_pulse_arm_COMPU_VTAB 0 0 0 255 ECU_ADDRESS 0x010086A8 BIT_MASK 0xff /end MEASUREMENT
/begin COMPU_METHOD EC_pin_pulse_arm_COMPU_VTAB "Verbal Table" TAB_VERB "%.0" "list" COMPU_TAB_REF EC_pin_pulse_arm_COMPU_VTAB_REF /end COMPU_METHOD
/begin COMPU_VTAB EC_pin_pulse_arm_COMPU_VTAB_REF "Verbal Table" TAB_VERB 2 0 "Disarmed" 1 "Armed" DEFAULT_VALUE "UNKNOWN" /end COMPU_VTAB
/begin MEASUREMENT PAUX_LP_tau "Auxiliary pressure low-pass" UWORD Compu_PAUX_LP_tau 0 0 0.45084 327680 ECU_ADDRESS 0x010097C0 /end MEASUREMENT
/begin COMPU_METHOD Compu_PAUX_LP_tau " " FORM "%.0" "ms"
 /begin FORMULA "-5 / log(1 - (X1 / 65536))" FORMULA_INV "(1 - exp(-5/X1)) * 65536" /end FORMULA
/end COMPU_METHOD
/begin MEASUREMENT TAUX_LP_tau "Auxiliary temp low-pass" UWORD Compu_TAUX_LP_tau 0 0 4.5084 3276800 ECU_ADDRESS 0x010097C8 /end MEASUREMENT
/begin COMPU_METHOD Compu_TAUX_LP_tau " " FORM "%.0" "ms"
 /begin FORMULA "-50 / log(1 - (X1 / 65536))" FORMULA_INV "(1 - exp(-50/X1)) * 65536" /end FORMULA
/end COMPU_METHOD
/begin MEASUREMENT HBA_toggle_cmd1 "HBA toggle cmd 1" UWORD Compu_HBA_toggle_cmd1 0 0 0 99.9984741210938 ECU_ADDRESS 0x01009E80 /end MEASUREMENT
/begin COMPU_METHOD Compu_HBA_toggle_cmd1 " " RAT_FUNC "%.1" "%" COEFFS 0 655.36 0 0 0 1 /end COMPU_METHOD
/begin MEASUREMENT HBA_toggle_cmd2 "HBA toggle cmd 2" UWORD Compu_HBA_toggle_cmd2 0 0 0 99.9984741210938 ECU_ADDRESS 0x01009E88 /end MEASUREMENT
/begin COMPU_METHOD Compu_HBA_toggle_cmd2 " " RAT_FUNC "%.1" "%" COEFFS 0 655.36 0 0 0 1 /end COMPU_METHOD
/begin MEASUREMENT HBA_toggle_ena "HBA toggle enable{HBA_toggle_ena&0xff=0:Disabled}{HBA_toggle_ena&0xff=1:Enabled}" UBYTE HBA_toggle_ena_COMPU_VTAB 0 0 0 255 ECU_ADDRESS 0x01009E90 BIT_MASK 0xff /end MEASUREMENT
/begin COMPU_METHOD HBA_toggle_ena_COMPU_VTAB "Verbal Table" TAB_VERB "%.0" "list" COMPU_TAB_REF HBA_toggle_ena_COMPU_VTAB_REF /end COMPU_METHOD
/begin COMPU_VTAB HBA_toggle_ena_COMPU_VTAB_REF "Verbal Table" TAB_VERB 2 0 "Disabled" 1 "Enabled" DEFAULT_VALUE "UNKNOWN" /end COMPU_VTAB
/begin MEASUREMENT HBA_toggle_ms "HBA toggle period" UWORD Compu_HBA_toggle_ms 0 0 0 65535 ECU_ADDRESS 0x01009E98 /end MEASUREMENT
/begin COMPU_METHOD Compu_HBA_toggle_ms " " RAT_FUNC "%.0" "ms" COEFFS 0 1 0 0 0 1 /end COMPU_METHOD
/begin MEASUREMENT HBB_toggle_cmd1 "HBB toggle cmd 1" UWORD Compu_HBB_toggle_cmd1 0 0 0 99.9984741210938 ECU_ADDRESS 0x01009EA0 /end MEASUREMENT
/begin COMPU_METHOD Compu_HBB_toggle_cmd1 " " RAT_FUNC "%.1" "%" COEFFS 0 655.36 0 0 0 1 /end COMPU_METHOD
/begin MEASUREMENT HBB_toggle_cmd2 "HBB toggle cmd 2" UWORD Compu_HBB_toggle_cmd2 0 0 0 99.9984741210938 ECU_ADDRESS 0x01009EA8 /end MEASUREMENT
/begin COMPU_METHOD Compu_HBB_toggle_cmd2 " " RAT_FUNC "%.1" "%" COEFFS 0 655.36 0 0 0 1 /end COMPU_METHOD
/begin MEASUREMENT HBB_toggle_ena "HBB toggle enable{HBB_toggle_ena&0xff=0:Disabled}{HBB_toggle_ena&0xff=1:Enabled}" UBYTE HBB_toggle_ena_COMPU_VTAB 0 0 0 255 ECU_ADDRESS 0x01009EB0 BIT_MASK 0xff /end MEASUREMENT
/begin COMPU_METHOD HBB_toggle_ena_COMPU_VTAB "Verbal Table" TAB_VERB "%.0" "list" COMPU_TAB_REF HBB_toggle_ena_COMPU_VTAB_REF /end COMPU_METHOD
/begin COMPU_VTAB HBB_toggle_ena_COMPU_VTAB_REF "Verbal Table" TAB_VERB 2 0 "Disabled" 1 "Enabled" DEFAULT_VALUE "UNKNOWN" /end COMPU_VTAB
/begin MEASUREMENT HBB_toggle_ms "HBB toggle period" UWORD Compu_HBB_toggle_ms 0 0 0 65535 ECU_ADDRESS 0x01009EB8 /end MEASUREMENT
/begin COMPU_METHOD Compu_HBB_toggle_ms " " RAT_FUNC "%.0" "ms" COEFFS 0 1 0 0 0 1 /end COMPU_METHOD
/begin MEASUREMENT bst_WGP_toggle_P1 "Boost WGP toggle P1" UWORD Compu_bst_WGP_toggle_P1 0 0 0 255.99609375 ECU_ADDRESS 0x01009EF0 /end MEASUREMENT
/begin COMPU_METHOD Compu_bst_WGP_toggle_P1 " " RAT_FUNC "%.2" "psi" COEFFS 0 256 0 0 0 1 /end COMPU_METHOD
/begin MEASUREMENT bst_WGP_toggle_P2 "Boost WGP toggle P2" UWORD Compu_bst_WGP_toggle_P2 0 0 0 255.99609375 ECU_ADDRESS 0x01009EF8 /end MEASUREMENT
/begin COMPU_METHOD Compu_bst_WGP_toggle_P2 " " RAT_FUNC "%.2" "psi" COEFFS 0 256 0 0 0 1 /end COMPU_METHOD
/begin MEASUREMENT bst_WGP_toggle_ena "Boost WGP toggle enable{bst_WGP_toggle_ena&0xff=0:Disabled}{bst_WGP_toggle_ena&0xff=1:Enabled}" UBYTE bst_WGP_toggle_ena_COMPU_VTAB 0 0 0 255 ECU_ADDRESS 0x01009F00 BIT_MASK 0xff /end MEASUREMENT
/begin COMPU_METHOD bst_WGP_toggle_ena_COMPU_VTAB "Verbal Table" TAB_VERB "%.0" "list" COMPU_TAB_REF bst_WGP_toggle_ena_COMPU_VTAB_REF /end COMPU_METHOD
/begin COMPU_VTAB bst_WGP_toggle_ena_COMPU_VTAB_REF "Verbal Table" TAB_VERB 2 0 "Disabled" 1 "Enabled" DEFAULT_VALUE "UNKNOWN" /end COMPU_VTAB
/begin MEASUREMENT bst_WGP_toggle_ms "Boost WGP toggle period" UWORD Compu_bst_WGP_toggle_ms 0 0 0 65535 ECU_ADDRESS 0x01009F08 /end MEASUREMENT
/begin COMPU_METHOD Compu_bst_WGP_toggle_ms " " RAT_FUNC "%.0" "ms" COEFFS 0 1 0 0 0 1 /end COMPU_METHOD
/begin MEASUREMENT bst_TIP_toggle_P1 "Boost TIP toggle P1" UWORD Compu_bst_TIP_toggle_P1 0 0 0 255.99609375 ECU_ADDRESS 0x01009F10 /end MEASUREMENT
/begin COMPU_METHOD Compu_bst_TIP_toggle_P1 " " RAT_FUNC "%.2" "psia" COEFFS 0 256 0 0 0 1 /end COMPU_METHOD
/begin MEASUREMENT bst_TIP_toggle_P2 "Boost TIP toggle P2" UWORD Compu_bst_TIP_toggle_P2 0 0 0 255.99609375 ECU_ADDRESS 0x01009F18 /end MEASUREMENT
/begin COMPU_METHOD Compu_bst_TIP_toggle_P2 " " RAT_FUNC "%.2" "psia" COEFFS 0 256 0 0 0 1 /end COMPU_METHOD
/begin MEASUREMENT bst_TIP_toggle_ena "Boost TIP toggle enable{bst_TIP_toggle_ena&0xff=0:Disabled}{bst_TIP_toggle_ena&0xff=1:Enabled}" UBYTE bst_TIP_toggle_ena_COMPU_VTAB 0 0 0 255 ECU_ADDRESS 0x01009F20 BIT_MASK 0xff /end MEASUREMENT
/begin COMPU_METHOD bst_TIP_toggle_ena_COMPU_VTAB "Verbal Table" TAB_VERB "%.0" "list" COMPU_TAB_REF bst_TIP_toggle_ena_COMPU_VTAB_REF /end COMPU_METHOD
/begin COMPU_VTAB bst_TIP_toggle_ena_COMPU_VTAB_REF "Verbal Table" TAB_VERB 2 0 "Disabled" 1 "Enabled" DEFAULT_VALUE "UNKNOWN" /end COMPU_VTAB
/begin MEASUREMENT bst_TIP_toggle_ms "Boost TIP toggle period" UWORD Compu_bst_TIP_toggle_ms 0 0 0 65535 ECU_ADDRESS 0x01009F28 /end MEASUREMENT
/begin COMPU_METHOD Compu_bst_TIP_toggle_ms " " RAT_FUNC "%.0" "ms" COEFFS 0 1 0 0 0 1 /end COMPU_METHOD
/begin MEASUREMENT FPP_toggle_ena "FPP toggle enable{FPP_toggle_ena&0xff=0:Disabled}{FPP_toggle_ena&0xff=1:Enabled}" UBYTE FPP_toggle_ena_COMPU_VTAB 0 0 0 255 ECU_ADDRESS 0x01009F98 BIT_MASK 0xff /end MEASUREMENT
/begin COMPU_METHOD FPP_toggle_ena_COMPU_VTAB "Verbal Table" TAB_VERB "%.0" "list" COMPU_TAB_REF FPP_toggle_ena_COMPU_VTAB_REF /end COMPU_METHOD
/begin COMPU_VTAB FPP_toggle_ena_COMPU_VTAB_REF "Verbal Table" TAB_VERB 2 0 "Disabled" 1 "Enabled" DEFAULT_VALUE "UNKNOWN" /end COMPU_VTAB
/begin MEASUREMENT FPP_toggle_ms "FPP toggle period" UWORD Compu_FPP_toggle_ms 0 0 0 65535 ECU_ADDRESS 0x01009FA0 /end MEASUREMENT
/begin COMPU_METHOD Compu_FPP_toggle_ms " " RAT_FUNC "%.0" "ms" COEFFS 0 1 0 0 0 1 /end COMPU_METHOD
/begin CHARACTERISTIC Tcambmp_dur "Cam-bump pulse duration" VALUE 0x001c8282 /* @ECU_Address@Tcambmp_dur@0x0100B4A8@ */ ECIPP_ALIGNMENT_UWORD 65535 Compu_Tcambmp_dur 0 65535 /end CHARACTERISTIC
/begin COMPU_METHOD Compu_Tcambmp_dur " " RAT_FUNC "%.0" "ms" COEFFS 0 1 0 0 0 1 /end COMPU_METHOD
/begin CHARACTERISTIC Tcambmp_I "Cam-bump pulse current" VALUE 0x001c8280 /* @ECU_Address@Tcambmp_I@0x0100B4B0@ */ ECIPP_ALIGNMENT_UWORD 64 Compu_Tcambmp_I 0 63.9990234375 /end CHARACTERISTIC
/begin COMPU_METHOD Compu_Tcambmp_I " " RAT_FUNC "%.2" "amps" COEFFS 0 1024 0 0 0 1 /end COMPU_METHOD
/begin CHARACTERISTIC Tcambmp_keyon "Cam-bump at key-on/engine-stopped{Tcambmp_keyon&0xff=0:Disabled}{Tcambmp_keyon&0xff=1:Enabled}" VALUE 0x001c8f6c /* @ECU_Address@Tcambmp_keyon@0x0100B8C0@ */ ECIPP_ALIGNMENT_UBYTE 255 Tcambmp_keyon_COMPU_VTAB 0 255 BIT_MASK 0xff /end CHARACTERISTIC
/begin COMPU_METHOD Tcambmp_keyon_COMPU_VTAB "Verbal Table" TAB_VERB "%.0" "list" COMPU_TAB_REF Tcambmp_keyon_COMPU_VTAB_REF /end COMPU_METHOD
/begin COMPU_VTAB Tcambmp_keyon_COMPU_VTAB_REF "Verbal Table" TAB_VERB 2 0 "Disabled" 1 "Enabled" DEFAULT_VALUE "UNKNOWN" /end COMPU_VTAB
/begin CHARACTERISTIC Tcambmp_auto "Cam fault phase3 bump{Tcambmp_auto&0xff=0:Disabled}{Tcambmp_auto&0xff=1:Enabled}" VALUE 0x001c8f6b /* @ECU_Address@Tcambmp_auto@0x0100B8C8@ */ ECIPP_ALIGNMENT_UBYTE 255 Tcambmp_auto_COMPU_VTAB 0 255 BIT_MASK 0xff /end CHARACTERISTIC
/begin COMPU_METHOD Tcambmp_auto_COMPU_VTAB "Verbal Table" TAB_VERB "%.0" "list" COMPU_TAB_REF Tcambmp_auto_COMPU_VTAB_REF /end COMPU_METHOD
/begin COMPU_VTAB Tcambmp_auto_COMPU_VTAB_REF "Verbal Table" TAB_VERB 2 0 "Disabled" 1 "Enabled" DEFAULT_VALUE "UNKNOWN" /end COMPU_VTAB
/begin CHARACTERISTIC Camrat_ena "Cam fault phase2 rattle{Camrat_ena&0xff=0:Disabled}{Camrat_ena&0xff=1:Enabled}" VALUE 0x001c86b3 /* @ECU_Address@Camrat_ena@0x0100B8D0@ */ ECIPP_ALIGNMENT_UBYTE 255 Camrat_ena_COMPU_VTAB 0 255 BIT_MASK 0xff /end CHARACTERISTIC
/begin COMPU_METHOD Camrat_ena_COMPU_VTAB "Verbal Table" TAB_VERB "%.0" "list" COMPU_TAB_REF Camrat_ena_COMPU_VTAB_REF /end COMPU_METHOD
/begin COMPU_VTAB Camrat_ena_COMPU_VTAB_REF "Verbal Table" TAB_VERB 2 0 "Disabled" 1 "Enabled" DEFAULT_VALUE "UNKNOWN" /end COMPU_VTAB
/begin CHARACTERISTIC Camrat_pulse_cnt "Cam fault phase2 rattle pulse count" VALUE 0x001c6e66 /* @ECU_Address@Camrat_pulse_cnt@0x0100B8D8@ */ ECIPP_ALIGNMENT_UWORD 65535 Compu_Camrat_pulse_cnt 0 65535 /end CHARACTERISTIC
/begin COMPU_METHOD Compu_Camrat_pulse_cnt " " RAT_FUNC "%.0" "pulses" COEFFS 0 1 0 0 0 1 /end COMPU_METHOD
/begin CHARACTERISTIC Camrat_hi_time "Cam fault phase2 rattle hi-time" VALUE 0x001c6e60 /* @ECU_Address@Camrat_hi_time@0x0100B8E0@ */ ECIPP_ALIGNMENT_UWORD 65535 Compu_Camrat_hi_time 0 65535 /end CHARACTERISTIC
/begin COMPU_METHOD Compu_Camrat_hi_time " " RAT_FUNC "%.0" "ms" COEFFS 0 1 0 0 0 1 /end COMPU_METHOD
/begin CHARACTERISTIC Camrat_lo_time "Cam fault phase2 rattle lo-time" VALUE 0x001c6e64 /* @ECU_Address@Camrat_lo_time@0x0100B8E8@ */ ECIPP_ALIGNMENT_UWORD 65535 Compu_Camrat_lo_time 0 65535 /end CHARACTERISTIC
/begin COMPU_METHOD Compu_Camrat_lo_time " " RAT_FUNC "%.0" "ms" COEFFS 0 1 0 0 0 1 /end COMPU_METHOD
/begin CHARACTERISTIC Camrat_hi_start_I "Cam fault phase2 rattle hi start current" VALUE 0x001c6e5e /* @ECU_Address@Camrat_hi_start_I@0x0100B8F0@ */ ECIPP_ALIGNMENT_UWORD 64 Compu_Camrat_hi_start_I 0 63.9990234375 /end CHARACTERISTIC
/begin COMPU_METHOD Compu_Camrat_hi_start_I " " RAT_FUNC "%.2" "amps" COEFFS 0 1024 0 0 0 1 /end COMPU_METHOD
/begin CHARACTERISTIC Camrat_hi_end_I "Cam fault phase2 rattle hi end current" VALUE 0x001c6e5c /* @ECU_Address@Camrat_hi_end_I@0x0100B8F8@ */ ECIPP_ALIGNMENT_UWORD 64 Compu_Camrat_hi_end_I 0 63.9990234375 /end CHARACTERISTIC
/begin COMPU_METHOD Compu_Camrat_hi_end_I " " RAT_FUNC "%.2" "amps" COEFFS 0 1024 0 0 0 1 /end COMPU_METHOD
/begin CHARACTERISTIC Camrat_lo_I "Cam fault phase2 rattle lo current" VALUE 0x001c6e62 /* @ECU_Address@Camrat_lo_I@0x0100B900@ */ ECIPP_ALIGNMENT_UWORD 64 Compu_Camrat_lo_I 0 63.9990234375 /end CHARACTERISTIC
/begin COMPU_METHOD Compu_Camrat_lo_I " " RAT_FUNC "%.2" "amps" COEFFS 0 1024 0 0 0 1 /end COMPU_METHOD
/begin MEASUREMENT IC_pin_pulse_state "Cam1 fault pin-unlock state machine{IC_pin_pulse_state&0xff=0:Inactive}{IC_pin_pulse_state&0xff=1:Initiated}{IC_pin_pulse_state&0xff=2:Start-current pulse active}{IC_pin_pulse_state&0xff=3:Waiting - Cam-rattle next}{IC_pin_pulse_state&0xff=4:Cam-rattle pu" UBYTE IC_pin_pulse_state_COMPU_VTAB 0 0 0 255 ECU_ADDRESS 0x0100B908 BIT_MASK 0xff /end MEASUREMENT
/begin COMPU_METHOD IC_pin_pulse_state_COMPU_VTAB "Verbal Table" TAB_VERB "%.0" "list" COMPU_TAB_REF IC_pin_pulse_state_COMPU_VTAB_REF /end COMPU_METHOD
/begin COMPU_VTAB IC_pin_pulse_state_COMPU_VTAB_REF "Verbal Table" TAB_VERB 8 0 "Inactive" 1 "Initiated" 2 "Start-current pulse active" 3 "Waiting - Cam-rattle next" 4 "Cam-rattle pulsing low" 5 "Cam-rattle pulsing high" 6 "Waiting - Cam-bump next" 7 "Cam-bump pulse active" DEFAULT_VALUE "UNKNOWN" /end COMPU_VTAB
/begin MEASUREMENT EC_pin_pulse_state "Cam2 fault pin-unlock state machine{EC_pin_pulse_state&0xff=0:Inactive}{EC_pin_pulse_state&0xff=1:Initiated}{EC_pin_pulse_state&0xff=2:Start-current pulse active}{EC_pin_pulse_state&0xff=3:Waiting - Cam-rattle next}{EC_pin_pulse_state&0xff=4:Cam-rattle pu" UBYTE EC_pin_pulse_state_COMPU_VTAB 0 0 0 255 ECU_ADDRESS 0x0100B910 BIT_MASK 0xff /end MEASUREMENT
/begin COMPU_METHOD EC_pin_pulse_state_COMPU_VTAB "Verbal Table" TAB_VERB "%.0" "list" COMPU_TAB_REF EC_pin_pulse_state_COMPU_VTAB_REF /end COMPU_METHOD
/begin COMPU_VTAB EC_pin_pulse_state_COMPU_VTAB_REF "Verbal Table" TAB_VERB 8 0 "Inactive" 1 "Initiated" 2 "Start-current pulse active" 3 "Waiting - Cam-rattle next" 4 "Cam-rattle pulsing low" 5 "Cam-rattle pulsing high" 6 "Waiting - Cam-bump next" 7 "Cam-bump pulse active" DEFAULT_VALUE "UNKNOWN" /end COMPU_VTAB
/begin CHARACTERISTIC Camini_slew_tout "Cam post engine-start soft-start duration" VALUE 0x001c6e5a /* @ECU_Address@Camini_slew_tout@0x0100B980@ */ ECIPP_ALIGNMENT_UWORD 65535 Compu_Camini_slew_tout 0 65535 /end CHARACTERISTIC
/begin COMPU_METHOD Compu_Camini_slew_tout " " RAT_FUNC "%.0" "ms" COEFFS 0 1 0 0 0 1 /end COMPU_METHOD
/begin CHARACTERISTIC ECam_control_cal "Cam2 control calibration{ECam_control_cal&0xff=0:Exhaust / Normal}{ECam_control_cal&0xff=1:Intake / Cam1}" VALUE 0x001c86d0 /* @ECU_Address@ECam_control_cal@0x0100BC38@ */ ECIPP_ALIGNMENT_UBYTE 255 ECam_control_cal_COMPU_VTAB 0 255 BIT_MASK 0xff /end CHARACTERISTIC
/begin COMPU_METHOD ECam_control_cal_COMPU_VTAB "Verbal Table" TAB_VERB "%.0" "list" COMPU_TAB_REF ECam_control_cal_COMPU_VTAB_REF /end COMPU_METHOD
/begin COMPU_VTAB ECam_control_cal_COMPU_VTAB_REF "Verbal Table" TAB_VERB 2 0 "Exhaust / Normal" 1 "Intake / Cam1" DEFAULT_VALUE "UNKNOWN" /end COMPU_VTAB
/begin CHARACTERISTIC CATdP_ena "Catalyst delta-P{CATdP_ena&0xff=0:Disabled}{CATdP_ena&0xff=1:Aux PD1}{CATdP_ena&0xff=2:Aux PD2}{CATdP_ena&0xff=3:Aux PD3}{CATdP_ena&0xff=4:Aux PUD1}{CATdP_ena&0xff=5:Aux PUD2}{CATdP_ena&0xff=6:Aux PUD3}{CATdP_ena&0xff=7:Aux PUD4}{CATdP_ena&0xff=8:Aux PUD5" VALUE 0x001c8696 /* @ECU_Address@CATdP_ena@0x0100C2E8@ */ ECIPP_ALIGNMENT_UBYTE 255 CATdP_ena_COMPU_VTAB 0 255 BIT_MASK 0xff /end CHARACTERISTIC
/begin COMPU_METHOD CATdP_ena_COMPU_VTAB "Verbal Table" TAB_VERB "%.0" "list" COMPU_TAB_REF CATdP_ena_COMPU_VTAB_REF /end COMPU_METHOD
/begin COMPU_VTAB CATdP_ena_COMPU_VTAB_REF "Verbal Table" TAB_VERB 31 0 "Disabled" 1 "Aux PD1" 2 "Aux PD2" 3 "Aux PD3" 4 "Aux PUD1" 5 "Aux PUD2" 6 "Aux PUD3" 7 "Aux PUD4" 8 "Aux PUD5" 9 "Aux PUD6" 10 "Aux PUD7" 11 "Aux PUD8" 12 "Aux PUD9" 13 "Aux PUD10" 14 "Aux PUD11" 15 "Aux PUD12" 16 "Aux PUD13" 17 "Aux PUD14" 18 "Aux PUD15" 19 "CAN sourced" 20 "FPP2 Input" 21 "Aux PUD16" 22 "Aux PUD17" 23 "Aux PUD18" 24 "Aux PUD19" 25 "Aux PUD20" 26 "Aux PUD21" 27 "Aux PUD22" 28 "Aux PUD23" 29 "Aux PUD24" 30 "Aux PUD25" DEFAULT_VALUE "UNKNOWN" /end COMPU_VTAB
/begin MEASUREMENT CATdP "Catalyst delta-P value" SWORD Compu_CATdP 0 0 -32 31.9990234375 ECU_ADDRESS 0x0100C2F0 /end MEASUREMENT
/begin COMPU_METHOD Compu_CATdP " " RAT_FUNC "%.2" "psi" COEFFS 0 1024 0 0 0 1 /end COMPU_METHOD
/begin MEASUREMENT FAUX1_units "FAUX1_units{FAUX1_units&0xff=0:gpm}{FAUX1_units&0xff=1:Lpm}" UBYTE FAUX1_units_COMPU_VTAB 0 0 0 255 ECU_ADDRESS 0x0100C6F8 BIT_MASK 0xff /end MEASUREMENT
/begin COMPU_METHOD FAUX1_units_COMPU_VTAB "Verbal Table" TAB_VERB "%.0" "list" COMPU_TAB_REF FAUX1_units_COMPU_VTAB_REF /end COMPU_METHOD
/begin COMPU_VTAB FAUX1_units_COMPU_VTAB_REF "Verbal Table" TAB_VERB 2 0 "gpm" 1 "Lpm" DEFAULT_VALUE "UNKNOWN" /end COMPU_VTAB
/begin MEASUREMENT FAUX2_units "FAUX2_units{FAUX2_units&0xff=0:gpm}{FAUX2_units&0xff=1:Lpm}" UBYTE FAUX2_units_COMPU_VTAB 0 0 0 255 ECU_ADDRESS 0x0100C700 BIT_MASK 0xff /end MEASUREMENT
/begin COMPU_METHOD FAUX2_units_COMPU_VTAB "Verbal Table" TAB_VERB "%.0" "list" COMPU_TAB_REF FAUX2_units_COMPU_VTAB_REF /end COMPU_METHOD
/begin COMPU_VTAB FAUX2_units_COMPU_VTAB_REF "Verbal Table" TAB_VERB 2 0 "gpm" 1 "Lpm" DEFAULT_VALUE "UNKNOWN" /end COMPU_VTAB
/begin CHARACTERISTIC FauxAcal_LP_tau "FauxAcal_LP_tau" VALUE 0x001c7baa /* @ECU_Address@FauxAcal_LP_tau@0x0100C728@ */ ECIPP_ALIGNMENT_UWORD 65535 Compu_FauxAcal_LP_tau 0 65535 /end CHARACTERISTIC
/begin COMPU_METHOD Compu_FauxAcal_LP_tau " " RAT_FUNC "%.0" "ms" COEFFS 0 1 0 0 0 1 /end COMPU_METHOD
/begin MEASUREMENT FAUX1_volts "Flow sensor 1" UWORD Compu_FAUX1_volts 0 0 0 255.99609375 ECU_ADDRESS 0x0100C730 /end MEASUREMENT
/begin COMPU_METHOD Compu_FAUX1_volts " " RAT_FUNC "%.3" "volts" COEFFS 0 256 0 0 0 1 /end COMPU_METHOD
/begin MEASUREMENT FAUX2_volts "Flow sensor 2" UWORD Compu_FAUX2_volts 0 0 0 255.99609375 ECU_ADDRESS 0x0100C738 /end MEASUREMENT
/begin COMPU_METHOD Compu_FAUX2_volts " " RAT_FUNC "%.3" "volts" COEFFS 0 256 0 0 0 1 /end COMPU_METHOD
/begin MEASUREMENT FAUX1 "Auxiliary flow 1" UWORD Compu_FAUX1 0 0 0 255.99609375 ECU_ADDRESS 0x0100C740 /end MEASUREMENT
/begin COMPU_METHOD Compu_FAUX1 " " RAT_FUNC "%.1" "gpm" COEFFS 0 256 0 0 0 1 /end COMPU_METHOD
/begin MEASUREMENT FAUX2 "Auxiliary flow 2" UWORD Compu_FAUX2 0 0 0 255.99609375 ECU_ADDRESS 0x0100C748 /end MEASUREMENT
/begin COMPU_METHOD Compu_FAUX2 " " RAT_FUNC "%.1" "gpm" COEFFS 0 256 0 0 0 1 /end COMPU_METHOD
/begin CHARACTERISTIC EBP_ena "EBP sensor{EBP_ena&0xff=0:Disabled}{EBP_ena&0xff=1:Aux PD1}{EBP_ena&0xff=2:Aux PD2}{EBP_ena&0xff=3:Aux PD3}{EBP_ena&0xff=4:Aux PUD1}{EBP_ena&0xff=5:Aux PUD2}{EBP_ena&0xff=6:Aux PUD3}{EBP_ena&0xff=7:Aux PUD4}{EBP_ena&0xff=8:Aux PUD5}{EBP_ena&0xff=9:Aux PUD" VALUE 0x001c86c2 /* @ECU_Address@EBP_ena@0x0100C7F0@ */ ECIPP_ALIGNMENT_UBYTE 255 EBP_ena_COMPU_VTAB 0 255 BIT_MASK 0xff /end CHARACTERISTIC
/begin COMPU_METHOD EBP_ena_COMPU_VTAB "Verbal Table" TAB_VERB "%.0" "list" COMPU_TAB_REF EBP_ena_COMPU_VTAB_REF /end COMPU_METHOD
/begin COMPU_VTAB EBP_ena_COMPU_VTAB_REF "Verbal Table" TAB_VERB 31 0 "Disabled" 1 "Aux PD1" 2 "Aux PD2" 3 "Aux PD3" 4 "Aux PUD1" 5 "Aux PUD2" 6 "Aux PUD3" 7 "Aux PUD4" 8 "Aux PUD5" 9 "Aux PUD6" 10 "Aux PUD7" 11 "Aux PUD8" 12 "Aux PUD9" 13 "Aux PUD10" 14 "Aux PUD11" 15 "Aux PUD12" 16 "Aux PUD13" 17 "Aux PUD14" 18 "Aux PUD15" 19 "CAN sourced" 20 "FPP2 Input" 21 "Aux PUD16" 22 "Aux PUD17" 23 "Aux PUD18" 24 "Aux PUD19" 25 "Aux PUD20" 26 "Aux PUD21" 27 "Aux PUD22" 28 "Aux PUD23" 29 "Aux PUD24" 30 "Aux PUD25" DEFAULT_VALUE "UNKNOWN" /end COMPU_VTAB
/begin CHARACTERISTIC EBP_tau "EBP low-pass tau" VALUE 0x001c8526 /* @ECU_Address@EBP_tau@0x0100C800@ */ ECIPP_ALIGNMENT_UWORD 327680 Compu_EBP_tau 0.45084 327680 /end CHARACTERISTIC
/begin COMPU_METHOD Compu_EBP_tau " " FORM "%.0" "ms"
 /begin FORMULA "-5 / log(1 - (X1 / 65536))" FORMULA_INV "(1 - exp(-5/X1)) * 65536" /end FORMULA
/end COMPU_METHOD
/begin MEASUREMENT EBP_raw "EBP raw" UWORD Compu_EBP_raw 0 0 0 255.99609375 ECU_ADDRESS 0x0100C808 /end MEASUREMENT
/begin COMPU_METHOD Compu_EBP_raw " " RAT_FUNC "%.2" "psia" COEFFS 0 256 0 0 0 1 /end COMPU_METHOD
/begin CHARACTERISTIC CATdP_P_select "Monitor source{CATdP_P_select&0xff=0:Catalyst delta-P}{CATdP_P_select&0xff=1:EBP absolute}{CATdP_P_select&0xff=2:EBP gauge}" VALUE 0x001c8694 /* @ECU_Address@CATdP_P_select@0x0100C810@ */ ECIPP_ALIGNMENT_UBYTE 255 CATdP_P_select_COMPU_VTAB 0 255 BIT_MASK 0xff /end CHARACTERISTIC
/begin COMPU_METHOD CATdP_P_select_COMPU_VTAB "Verbal Table" TAB_VERB "%.0" "list" COMPU_TAB_REF CATdP_P_select_COMPU_VTAB_REF /end COMPU_METHOD
/begin COMPU_VTAB CATdP_P_select_COMPU_VTAB_REF "Verbal Table" TAB_VERB 3 0 "Catalyst delta-P" 1 "EBP absolute" 2 "EBP gauge" DEFAULT_VALUE "UNKNOWN" /end COMPU_VTAB
/begin CHARACTERISTIC CATdP_tau "CATdP low-pass" VALUE 0x001c8516 /* @ECU_Address@CATdP_tau@0x0100C840@ */ ECIPP_ALIGNMENT_UWORD 1638398 Compu_CATdP_tau 1.6703 1638400 /end CHARACTERISTIC
/begin COMPU_METHOD Compu_CATdP_tau " " FORM "%.0" "ms"
 /begin FORMULA "-50 / log(1.0000000000001 - (X1 / 32768))" FORMULA_INV "(1.0000000000001 - exp(-50/X1)) * 32768" /end FORMULA
/end COMPU_METHOD
/begin MEASUREMENT CATdP_raw "CATdp raw" SWORD Compu_CATdP_raw 0 0 -32 31.9990234375 ECU_ADDRESS 0x0100C848 /end MEASUREMENT
/begin COMPU_METHOD Compu_CATdP_raw " " RAT_FUNC "%.2" "psi" COEFFS 0 1024 0 0 0 1 /end COMPU_METHOD
/begin MEASUREMENT EBP_acc "EBP" UWORD Compu_EBP_acc 0 0 0 255.99609375 ECU_ADDRESS 0x0100C850 /end MEASUREMENT
/begin COMPU_METHOD Compu_EBP_acc " " RAT_FUNC "%.2" "psia" COEFFS 0 256 0 0 0 1 /end COMPU_METHOD
/begin CHARACTERISTIC TAUX_dT1_ndx1 "Aux delta T 1 TAUX index 1 (Fault Condition:where AUX Temperature X is TAUX)" VALUE 0x001ECD50 /* @ECU_Address@TAUX_dT1_ndx1@0x0100CDB0@ */ ECIPP_ALIGNMENT_UBYTE 255 Compu_TAUX_dT1_ndx1 1 256 /end CHARACTERISTIC
/begin COMPU_METHOD Compu_TAUX_dT1_ndx1 " " RAT_FUNC "%.0" "-" COEFFS 0 1 -1 0 0 1 /end COMPU_METHOD
/begin CHARACTERISTIC TAUX_dT1_ndx2 "Aux delta T 1 TAUX index 2 (Fault Condition:and Aux Temperature Y is TAUX)" VALUE 0x001ECD51 /* @ECU_Address@TAUX_dT1_ndx2@0x0100CDB8@ */ ECIPP_ALIGNMENT_UBYTE 255 Compu_TAUX_dT1_ndx2 1 256 /end CHARACTERISTIC
/begin COMPU_METHOD Compu_TAUX_dT1_ndx2 " " RAT_FUNC "%.0" "-" COEFFS 0 1 -1 0 0 1 /end COMPU_METHOD
/begin MEASUREMENT TAUX_dT1_delta "Aux temperature delta T 1" SWORD Compu_TAUX_dT1_delta 0 0 -4096 4095.875 ECU_ADDRESS 0x0100CDC0 /end MEASUREMENT
/begin COMPU_METHOD Compu_TAUX_dT1_delta " " RAT_FUNC "%.2" "deg F" COEFFS 0 8 0 0 0 1 /end COMPU_METHOD
/begin CHARACTERISTIC TAUX_dT2_ndx1 "Aux delta T 2 TAUX index 1 (Fault Condition:where AUX Temperature X is TAUX)" VALUE 0x001ECD56 /* @ECU_Address@TAUX_dT2_ndx1@0x0100CDD8@ */ ECIPP_ALIGNMENT_UBYTE 255 Compu_TAUX_dT2_ndx1 1 256 /end CHARACTERISTIC
/begin COMPU_METHOD Compu_TAUX_dT2_ndx1 " " RAT_FUNC "%.0" "-" COEFFS 0 1 -1 0 0 1 /end COMPU_METHOD
/begin CHARACTERISTIC TAUX_dT2_ndx2 "Aux delta T 2 TAUX index 2 (Fault Condition:and Aux Temperature Y is TAUX)" VALUE 0x001ECD57 /* @ECU_Address@TAUX_dT2_ndx2@0x0100CDE0@ */ ECIPP_ALIGNMENT_UBYTE 255 Compu_TAUX_dT2_ndx2 1 256 /end CHARACTERISTIC
/begin COMPU_METHOD Compu_TAUX_dT2_ndx2 " " RAT_FUNC "%.0" "-" COEFFS 0 1 -1 0 0 1 /end COMPU_METHOD
/begin MEASUREMENT TAUX_dT2_delta "Aux temperature delta T 2" SWORD Compu_TAUX_dT2_delta 0 0 -4096 4095.875 ECU_ADDRESS 0x0100CDE8 /end MEASUREMENT
/begin COMPU_METHOD Compu_TAUX_dT2_delta " " RAT_FUNC "%.2" "deg F" COEFFS 0 8 0 0 0 1 /end COMPU_METHOD
/begin CHARACTERISTIC PAUX_dP1_ndx1 "Aux delta P 1 PAUX index 1 (Fault Condition:where AUX Pressure X is PAUX)" VALUE 0x001ECD34 /* @ECU_Address@PAUX_dP1_ndx1@0x0100CE40@ */ ECIPP_ALIGNMENT_UBYTE 255 Compu_PAUX_dP1_ndx1 1 256 /end CHARACTERISTIC
/begin COMPU_METHOD Compu_PAUX_dP1_ndx1 " " RAT_FUNC "%.0" "-" COEFFS 0 1 -1 0 0 1 /end COMPU_METHOD
/begin CHARACTERISTIC PAUX_dP1_ndx2 "Aux delta P 1 PAUX index 2 (Fault Condition:and Aux Pressure Y is PAUX)" VALUE 0x001ECD35 /* @ECU_Address@PAUX_dP1_ndx2@0x0100CE48@ */ ECIPP_ALIGNMENT_UBYTE 255 Compu_PAUX_dP1_ndx2 1 256 /end CHARACTERISTIC
/begin COMPU_METHOD Compu_PAUX_dP1_ndx2 " " RAT_FUNC "%.0" "-" COEFFS 0 1 -1 0 0 1 /end COMPU_METHOD
/begin MEASUREMENT PAUX_dP1_delta "Aux pressure delta P 1" SWORD Compu_PAUX_dP1_delta 0 0 -128 127.99609375 ECU_ADDRESS 0x0100CE50 /end MEASUREMENT
/begin COMPU_METHOD Compu_PAUX_dP1_delta " " RAT_FUNC "%.3" "psi" COEFFS 0 256 0 0 0 1 /end COMPU_METHOD
/begin CHARACTERISTIC PAUX_dP2_ndx1 "Aux delta P 2 PAUX index 1 (Fault Condition:where AUX Pressure X is PAUX)" VALUE 0x001ECD3A /* @ECU_Address@PAUX_dP2_ndx1@0x0100CE68@ */ ECIPP_ALIGNMENT_UBYTE 255 Compu_PAUX_dP2_ndx1 1 256 /end CHARACTERISTIC
/begin COMPU_METHOD Compu_PAUX_dP2_ndx1 " " RAT_FUNC "%.0" "-" COEFFS 0 1 -1 0 0 1 /end COMPU_METHOD
/begin CHARACTERISTIC PAUX_dP2_ndx2 "Aux delta P 2 PAUX index 2 (Fault Condition:and Aux Pressure Y is PAUX)" VALUE 0x001ECD3B /* @ECU_Address@PAUX_dP2_ndx2@0x0100CE70@ */ ECIPP_ALIGNMENT_UBYTE 255 Compu_PAUX_dP2_ndx2 1 256 /end CHARACTERISTIC
/begin COMPU_METHOD Compu_PAUX_dP2_ndx2 " " RAT_FUNC "%.0" "-" COEFFS 0 1 -1 0 0 1 /end COMPU_METHOD
/begin MEASUREMENT PAUX_dP2_delta "Aux pressure delta P 2" SWORD Compu_PAUX_dP2_delta 0 0 -128 127.99609375 ECU_ADDRESS 0x0100CE78 /end MEASUREMENT
/begin COMPU_METHOD Compu_PAUX_dP2_delta " " RAT_FUNC "%.3" "psi" COEFFS 0 256 0 0 0 1 /end COMPU_METHOD
/begin MEASUREMENT CB1pre_name "Bank 1 pre-cat  sensor name{CB1pre_name&0xff=0:Not Present}{CB1pre_name&0xff=1:EGO1}{CB1pre_name&0xff=2:EGO2}{CB1pre_name&0xff=3:EGO3}{CB1pre_name&0xff=4:EGO4}{CB1pre_name&0xff=5:UEGO1}{CB1pre_name&0xff=6:UEGO2}{CB1pre_name&0xff=7:UEGO3}{CB1pre_name&0xff=" UBYTE CB1pre_name_COMPU_VTAB 0 0 0 255 ECU_ADDRESS 0x0100CFB8 BIT_MASK 0xff /end MEASUREMENT
/begin COMPU_METHOD CB1pre_name_COMPU_VTAB "Verbal Table" TAB_VERB "%.0" "list" COMPU_TAB_REF CB1pre_name_COMPU_VTAB_REF /end COMPU_METHOD
/begin COMPU_VTAB CB1pre_name_COMPU_VTAB_REF "Verbal Table" TAB_VERB 9 0 "Not Present" 1 "EGO1" 2 "EGO2" 3 "EGO3" 4 "EGO4" 5 "UEGO1" 6 "UEGO2" 7 "UEGO3" 8 "UEGO4" DEFAULT_VALUE "UNKNOWN" /end COMPU_VTAB
/begin MEASUREMENT CB1pst_name "Bank 1 post-cat sensor name{CB1pst_name&0xff=0:Not Present}{CB1pst_name&0xff=1:EGO1}{CB1pst_name&0xff=2:EGO2}{CB1pst_name&0xff=3:EGO3}{CB1pst_name&0xff=4:EGO4}{CB1pst_name&0xff=5:UEGO1}{CB1pst_name&0xff=6:UEGO2}{CB1pst_name&0xff=7:UEGO3}{CB1pst_name&0xff=" UBYTE CB1pst_name_COMPU_VTAB 0 0 0 255 ECU_ADDRESS 0x0100CFC0 BIT_MASK 0xff /end MEASUREMENT
/begin COMPU_METHOD CB1pst_name_COMPU_VTAB "Verbal Table" TAB_VERB "%.0" "list" COMPU_TAB_REF CB1pst_name_COMPU_VTAB_REF /end COMPU_METHOD
/begin COMPU_VTAB CB1pst_name_COMPU_VTAB_REF "Verbal Table" TAB_VERB 9 0 "Not Present" 1 "EGO1" 2 "EGO2" 3 "EGO3" 4 "EGO4" 5 "UEGO1" 6 "UEGO2" 7 "UEGO3" 8 "UEGO4" DEFAULT_VALUE "UNKNOWN" /end COMPU_VTAB
/begin MEASUREMENT CB2pre_name "Bank 2 pre-cat  sensor name{CB2pre_name&0xff=0:Not Present}{CB2pre_name&0xff=1:EGO1}{CB2pre_name&0xff=2:EGO2}{CB2pre_name&0xff=3:EGO3}{CB2pre_name&0xff=4:EGO4}{CB2pre_name&0xff=5:UEGO1}{CB2pre_name&0xff=6:UEGO2}{CB2pre_name&0xff=7:UEGO3}{CB2pre_name&0xff=" UBYTE CB2pre_name_COMPU_VTAB 0 0 0 255 ECU_ADDRESS 0x0100CFC8 BIT_MASK 0xff /end MEASUREMENT
/begin COMPU_METHOD CB2pre_name_COMPU_VTAB "Verbal Table" TAB_VERB "%.0" "list" COMPU_TAB_REF CB2pre_name_COMPU_VTAB_REF /end COMPU_METHOD
/begin COMPU_VTAB CB2pre_name_COMPU_VTAB_REF "Verbal Table" TAB_VERB 9 0 "Not Present" 1 "EGO1" 2 "EGO2" 3 "EGO3" 4 "EGO4" 5 "UEGO1" 6 "UEGO2" 7 "UEGO3" 8 "UEGO4" DEFAULT_VALUE "UNKNOWN" /end COMPU_VTAB
/begin MEASUREMENT CB2pst_name "Bank 2 post-cat sensor name{CB2pst_name&0xff=0:Not Present}{CB2pst_name&0xff=1:EGO1}{CB2pst_name&0xff=2:EGO2}{CB2pst_name&0xff=3:EGO3}{CB2pst_name&0xff=4:EGO4}{CB2pst_name&0xff=5:UEGO1}{CB2pst_name&0xff=6:UEGO2}{CB2pst_name&0xff=7:UEGO3}{CB2pst_name&0xff=" UBYTE CB2pst_name_COMPU_VTAB 0 0 0 255 ECU_ADDRESS 0x0100CFD0 BIT_MASK 0xff /end MEASUREMENT
/begin COMPU_METHOD CB2pst_name_COMPU_VTAB "Verbal Table" TAB_VERB "%.0" "list" COMPU_TAB_REF CB2pst_name_COMPU_VTAB_REF /end COMPU_METHOD
/begin COMPU_VTAB CB2pst_name_COMPU_VTAB_REF "Verbal Table" TAB_VERB 9 0 "Not Present" 1 "EGO1" 2 "EGO2" 3 "EGO3" 4 "EGO4" 5 "UEGO1" 6 "UEGO2" 7 "UEGO3" 8 "UEGO4" DEFAULT_VALUE "UNKNOWN" /end COMPU_VTAB
/begin MEASUREMENT CB1pre_phiFB_RMS "Bank 1 pre-cat phi feedback RMS" UWORD Compu_CB1pre_phiFB_RMS 0 0 0 3.99993896484375 ECU_ADDRESS 0x0100CFF8 /end MEASUREMENT
/begin COMPU_METHOD Compu_CB1pre_phiFB_RMS " " RAT_FUNC "%.3" "phi" COEFFS 0 16384 0 0 0 1 /end COMPU_METHOD
/begin MEASUREMENT CB1pst_phiFB_RMS "Bank 1 post-cat phi feedback RMS" UWORD Compu_CB1pst_phiFB_RMS 0 0 0 3.99993896484375 ECU_ADDRESS 0x0100D000 /end MEASUREMENT
/begin COMPU_METHOD Compu_CB1pst_phiFB_RMS " " RAT_FUNC "%.3" "phi" COEFFS 0 16384 0 0 0 1 /end COMPU_METHOD
/begin MEASUREMENT CB2pre_phiFB_RMS "Bank 2 pre-cat phi feedback RMS" UWORD Compu_CB2pre_phiFB_RMS 0 0 0 3.99993896484375 ECU_ADDRESS 0x0100D008 /end MEASUREMENT
/begin COMPU_METHOD Compu_CB2pre_phiFB_RMS " " RAT_FUNC "%.3" "phi" COEFFS 0 16384 0 0 0 1 /end COMPU_METHOD
/begin MEASUREMENT CB2pst_phiFB_RMS "Bank 2 post-cat phi feedback RMS" UWORD Compu_CB2pst_phiFB_RMS 0 0 0 3.99993896484375 ECU_ADDRESS 0x0100D010 /end MEASUREMENT
/begin COMPU_METHOD Compu_CB2pst_phiFB_RMS " " RAT_FUNC "%.3" "phi" COEFFS 0 16384 0 0 0 1 /end COMPU_METHOD
/begin MEASUREMENT HSDL_samp_mode "Sampling Interval{HSDL_samp_mode&0xff=0:Disabled}{HSDL_samp_mode&0xff=1:0.5ms}{HSDL_samp_mode&0xff=2:1.0ms}{HSDL_samp_mode&0xff=3:1.5ms}{HSDL_samp_mode&0xff=4:2.0ms}{HSDL_samp_mode&0xff=5:2.5ms}{HSDL_samp_mode&0xff=6:3.0ms}{HSDL_samp_mode&0xff=7:3.5ms}{HS" UBYTE HSDL_samp_mode_COMPU_VTAB 0 0 0 255 ECU_ADDRESS 0x0100D068 BIT_MASK 0xff /end MEASUREMENT
/begin COMPU_METHOD HSDL_samp_mode_COMPU_VTAB "Verbal Table" TAB_VERB "%.0" "list" COMPU_TAB_REF HSDL_samp_mode_COMPU_VTAB_REF /end COMPU_METHOD
/begin COMPU_VTAB HSDL_samp_mode_COMPU_VTAB_REF "Verbal Table" TAB_VERB 22 0 "Disabled" 1 "0.5ms" 2 "1.0ms" 3 "1.5ms" 4 "2.0ms" 5 "2.5ms" 6 "3.0ms" 7 "3.5ms" 8 "4.0ms" 9 "4.5ms" 10 "5.0ms" 11 "Custom Development" 12 "Crank Trigger" 13 "Cam1 Trigger" 14 "Cam2 Trigger" 15 "Roadspeed Trigger" 16 "EGR Pressures" 17 "CRI Injection Current" 18 "EGO Impedance" 19 "IEPR VC Current" 20 "EGR Pressures 2" 21 "Crank Accel Sync" DEFAULT_VALUE "UNKNOWN" /end COMPU_VTAB
/begin MEASUREMENT HSDL_status "Status{HSDL_status&0xff=0:Offline}{HSDL_status&0xff=1:Initializing}{HSDL_status&0xff=2:Armed - Waiting for Trig}{HSDL_status&0xff=3:Triggered - Acquiring...}{HSDL_status&0xff=4:Holding - Data Acquired}" UBYTE HSDL_status_COMPU_VTAB 0 0 0 255 ECU_ADDRESS 0x0100D070 BIT_MASK 0xff /end MEASUREMENT
/begin COMPU_METHOD HSDL_status_COMPU_VTAB "Verbal Table" TAB_VERB "%.0" "list" COMPU_TAB_REF HSDL_status_COMPU_VTAB_REF /end COMPU_METHOD
/begin COMPU_VTAB HSDL_status_COMPU_VTAB_REF "Verbal Table" TAB_VERB 5 0 "Offline" 1 "Initializing" 2 "Armed - Waiting for Trig" 3 "Triggered - Acquiring..." 4 "Holding - Data Acquired" DEFAULT_VALUE "UNKNOWN" /end COMPU_VTAB
/begin MEASUREMENT HSDL_ECIPP1 "ECIPP index 1" ULONG Compu_HSDL_ECIPP1 0 0 0 4294967295 ECU_ADDRESS 0x0100D078 /end MEASUREMENT
/begin COMPU_METHOD Compu_HSDL_ECIPP1 " " RAT_FUNC "%.0" "-" COEFFS 0 1 0 0 0 1 /end COMPU_METHOD
/begin MEASUREMENT HSDL_ECIPP2 "ECIPP index 2" ULONG Compu_HSDL_ECIPP2 0 0 0 4294967295 ECU_ADDRESS 0x0100D080 /end MEASUREMENT
/begin COMPU_METHOD Compu_HSDL_ECIPP2 " " RAT_FUNC "%.0" "-" COEFFS 0 1 0 0 0 1 /end COMPU_METHOD
/begin MEASUREMENT HSDL_ECIPP3 "ECIPP index 3" ULONG Compu_HSDL_ECIPP3 0 0 0 4294967295 ECU_ADDRESS 0x0100D088 /end MEASUREMENT
/begin COMPU_METHOD Compu_HSDL_ECIPP3 " " RAT_FUNC "%.0" "-" COEFFS 0 1 0 0 0 1 /end COMPU_METHOD
/begin MEASUREMENT HSDL_ECIPP4 "ECIPP index 4" ULONG Compu_HSDL_ECIPP4 0 0 0 4294967295 ECU_ADDRESS 0x0100D090 /end MEASUREMENT
/begin COMPU_METHOD Compu_HSDL_ECIPP4 " " RAT_FUNC "%.0" "-" COEFFS 0 1 0 0 0 1 /end COMPU_METHOD
/begin MEASUREMENT HSDL_post_pct "Post-trigger sampling" UWORD Compu_HSDL_post_pct 0 0 0 99.9984741210938 ECU_ADDRESS 0x0100D098 /end MEASUREMENT
/begin COMPU_METHOD Compu_HSDL_post_pct " " RAT_FUNC "%.1" "%" COEFFS 0 655.36 0 0 0 1 /end COMPU_METHOD
/begin MEASUREMENT HSDL_post_cnt "Post-trigger sample count" UWORD Compu_HSDL_post_cnt 0 0 0 65535 ECU_ADDRESS 0x0100D0A0 /end MEASUREMENT
/begin COMPU_METHOD Compu_HSDL_post_cnt " " RAT_FUNC "%.0" "-" COEFFS 0 1 0 0 0 1 /end COMPU_METHOD
/begin MEASUREMENT HSDL_trig_ndx "Trigger index" UWORD Compu_HSDL_trig_ndx 0 0 0 65535 ECU_ADDRESS 0x0100D0A8 /end MEASUREMENT
/begin COMPU_METHOD Compu_HSDL_trig_ndx " " RAT_FUNC "%.0" "-" COEFFS 0 1 0 0 0 1 /end COMPU_METHOD
/begin MEASUREMENT HSDL_samp_remain "Samples remaining" UWORD Compu_HSDL_samp_remain 0 0 0 65535 ECU_ADDRESS 0x0100D0B0 /end MEASUREMENT
/begin COMPU_METHOD Compu_HSDL_samp_remain " " RAT_FUNC "%.0" "-" COEFFS 0 1 0 0 0 1 /end COMPU_METHOD
/begin MEASUREMENT HSDL_reset "HSDL reset{HSDL_reset&0xff=0:Reset}{HSDL_reset&0xff=1:Resetting...}" UBYTE HSDL_reset_COMPU_VTAB 0 0 0 255 ECU_ADDRESS 0x0100D0B8 BIT_MASK 0xff /end MEASUREMENT
/begin COMPU_METHOD HSDL_reset_COMPU_VTAB "Verbal Table" TAB_VERB "%.0" "list" COMPU_TAB_REF HSDL_reset_COMPU_VTAB_REF /end COMPU_METHOD
/begin COMPU_VTAB HSDL_reset_COMPU_VTAB_REF "Verbal Table" TAB_VERB 2 0 "Reset" 1 "Resetting..." DEFAULT_VALUE "UNKNOWN" /end COMPU_VTAB
/begin MEASUREMENT HSDL_forcetrig "HSDL force trigger{HSDL_forcetrig&0xff=0:Force Trig}{HSDL_forcetrig&0xff=1:Triggering...}" UBYTE HSDL_forcetrig_COMPU_VTAB 0 0 0 255 ECU_ADDRESS 0x0100D0C0 BIT_MASK 0xff /end MEASUREMENT
/begin COMPU_METHOD HSDL_forcetrig_COMPU_VTAB "Verbal Table" TAB_VERB "%.0" "list" COMPU_TAB_REF HSDL_forcetrig_COMPU_VTAB_REF /end COMPU_METHOD
/begin COMPU_VTAB HSDL_forcetrig_COMPU_VTAB_REF "Verbal Table" TAB_VERB 2 0 "Force Trig" 1 "Triggering..." DEFAULT_VALUE "UNKNOWN" /end COMPU_VTAB
/begin MEASUREMENT HSDL_samp_rqst "Sampling Interval{HSDL_samp_rqst&0xff=0:Disabled}{HSDL_samp_rqst&0xff=1:0.5ms}{HSDL_samp_rqst&0xff=2:1.0ms}{HSDL_samp_rqst&0xff=3:1.5ms}{HSDL_samp_rqst&0xff=4:2.0ms}{HSDL_samp_rqst&0xff=5:2.5ms}{HSDL_samp_rqst&0xff=6:3.0ms}{HSDL_samp_rqst&0xff=7:3.5ms}{HS" UBYTE HSDL_samp_rqst_COMPU_VTAB 0 0 0 255 ECU_ADDRESS 0x0100D0C8 BIT_MASK 0xff /end MEASUREMENT
/begin COMPU_METHOD HSDL_samp_rqst_COMPU_VTAB "Verbal Table" TAB_VERB "%.0" "list" COMPU_TAB_REF HSDL_samp_rqst_COMPU_VTAB_REF /end COMPU_METHOD
/begin COMPU_VTAB HSDL_samp_rqst_COMPU_VTAB_REF "Verbal Table" TAB_VERB 22 0 "Disabled" 1 "0.5ms" 2 "1.0ms" 3 "1.5ms" 4 "2.0ms" 5 "2.5ms" 6 "3.0ms" 7 "3.5ms" 8 "4.0ms" 9 "4.5ms" 10 "5.0ms" 11 "Custom Development" 12 "Crank Trigger" 13 "Cam1 Trigger" 14 "Cam2 Trigger" 15 "Roadspeed Trigger" 16 "EGR Pressures" 17 "CRI Injection Current" 18 "EGO Impedance" 19 "IEPR VC Current" 20 "EGR Pressures 2" 21 "Crank Accel Sync" DEFAULT_VALUE "UNKNOWN" /end COMPU_VTAB
/begin MEASUREMENT HSDL_buffer_size "HSDL latched buffer size" UWORD Compu_HSDL_buffer_size 0 0 0 65535 ECU_ADDRESS 0x0100D350 /end MEASUREMENT
/begin COMPU_METHOD Compu_HSDL_buffer_size " " RAT_FUNC "%.0" "-" COEFFS 0 1 0 0 0 1 /end COMPU_METHOD
/begin MEASUREMENT sim_fault_context "Simulated call context{sim_fault_context&0xff=0:1ms loop}{sim_fault_context&0xff=1:5ms loop}{sim_fault_context&0xff=2:50ms loop}" UBYTE sim_fault_context_COMPU_VTAB 0 0 0 255 ECU_ADDRESS 0x0100EA80 BIT_MASK 0xff /end MEASUREMENT
/begin COMPU_METHOD sim_fault_context_COMPU_VTAB "Verbal Table" TAB_VERB "%.0" "list" COMPU_TAB_REF sim_fault_context_COMPU_VTAB_REF /end COMPU_METHOD
/begin COMPU_VTAB sim_fault_context_COMPU_VTAB_REF "Verbal Table" TAB_VERB 3 0 "1ms loop" 1 "5ms loop" 2 "50ms loop" DEFAULT_VALUE "UNKNOWN" /end COMPU_VTAB
/begin MEASUREMENT sim_fault_calls "Simulated calls{sim_fault_calls&0xff=0:Disabled}{sim_fault_calls&0xff=1:Enabled}" UBYTE sim_fault_calls_COMPU_VTAB 0 0 0 255 ECU_ADDRESS 0x0100EA88 BIT_MASK 0xff /end MEASUREMENT
/begin COMPU_METHOD sim_fault_calls_COMPU_VTAB "Verbal Table" TAB_VERB "%.0" "list" COMPU_TAB_REF sim_fault_calls_COMPU_VTAB_REF /end COMPU_METHOD
/begin COMPU_VTAB sim_fault_calls_COMPU_VTAB_REF "Verbal Table" TAB_VERB 2 0 "Disabled" 1 "Enabled" DEFAULT_VALUE "UNKNOWN" /end COMPU_VTAB
/begin MEASUREMENT sim_entry_cond_valid "Simulated entry conditions{sim_entry_cond_valid&0xff=0:Invalid}{sim_entry_cond_valid&0xff=1:Valid}" UBYTE sim_entry_cond_valid_COMPU_VTAB 0 0 0 255 ECU_ADDRESS 0x0100F568 BIT_MASK 0xff /end MEASUREMENT
/begin COMPU_METHOD sim_entry_cond_valid_COMPU_VTAB "Verbal Table" TAB_VERB "%.0" "list" COMPU_TAB_REF sim_entry_cond_valid_COMPU_VTAB_REF /end COMPU_METHOD
/begin COMPU_VTAB sim_entry_cond_valid_COMPU_VTAB_REF "Verbal Table" TAB_VERB 2 0 "Invalid" 1 "Valid" DEFAULT_VALUE "UNKNOWN" /end COMPU_VTAB
/begin CHARACTERISTIC CAT1_ena "Catalyst Tin source{CAT1_ena&0xff=0:Disabled}{CAT1_ena&0xff=1:Aux PU1}{CAT1_ena&0xff=2:Aux PU2}{CAT1_ena&0xff=3:Aux PU3}{CAT1_ena&0xff=4:Aux PUD1}{CAT1_ena&0xff=5:Aux PUD2}{CAT1_ena&0xff=6:Aux PUD3}{CAT1_ena&0xff=7:EGT Input}{CAT1_ena&0xff=8:Aux PUD4}{CAT" VALUE 0x001c8691 /* @ECU_Address@CAT1_ena@0x0100F578@ */ ECIPP_ALIGNMENT_UBYTE 255 CAT1_ena_COMPU_VTAB 0 255 BIT_MASK 0xff /end CHARACTERISTIC
/begin COMPU_METHOD CAT1_ena_COMPU_VTAB "Verbal Table" TAB_VERB "%.0" "list" COMPU_TAB_REF CAT1_ena_COMPU_VTAB_REF /end COMPU_METHOD
/begin COMPU_VTAB CAT1_ena_COMPU_VTAB_REF "Verbal Table" TAB_VERB 31 0 "Disabled" 1 "Aux PU1" 2 "Aux PU2" 3 "Aux PU3" 4 "Aux PUD1" 5 "Aux PUD2" 6 "Aux PUD3" 7 "EGT Input" 8 "Aux PUD4" 9 "Aux PUD5" 10 "Aux PUD6" 11 "Aux PUD7" 12 "Aux PUD8" 13 "Aux PUD9" 14 "Aux PUD10" 15 "Aux PUD11" 16 "Aux PUD12" 17 "Aux PUD13" 18 "Aux PUD14" 19 "Aux PUD15" 20 "Aux PUD16" 21 "Aux PUD17" 22 "Aux PUD18" 23 "Aux PUD19" 24 "Aux PUD20" 25 "Aux PUD21" 26 "Aux PUD22" 27 "Aux PUD23" 28 "Aux PUD24" 29 "Aux PUD25" 30 "CAN sourced" DEFAULT_VALUE "UNKNOWN" /end COMPU_VTAB
/begin CHARACTERISTIC CAT2_ena "Catalyst Tout source{CAT2_ena&0xff=0:Disabled}{CAT2_ena&0xff=1:Aux PU1}{CAT2_ena&0xff=2:Aux PU2}{CAT2_ena&0xff=3:Aux PU3}{CAT2_ena&0xff=4:Aux PUD1}{CAT2_ena&0xff=5:Aux PUD2}{CAT2_ena&0xff=6:Aux PUD3}{CAT2_ena&0xff=7:EGT Input}{CAT2_ena&0xff=8:Aux PUD4}{CA" VALUE 0x001c8693 /* @ECU_Address@CAT2_ena@0x0100F580@ */ ECIPP_ALIGNMENT_UBYTE 255 CAT2_ena_COMPU_VTAB 0 255 BIT_MASK 0xff /end CHARACTERISTIC
/begin COMPU_METHOD CAT2_ena_COMPU_VTAB "Verbal Table" TAB_VERB "%.0" "list" COMPU_TAB_REF CAT2_ena_COMPU_VTAB_REF /end COMPU_METHOD
/begin COMPU_VTAB CAT2_ena_COMPU_VTAB_REF "Verbal Table" TAB_VERB 31 0 "Disabled" 1 "Aux PU1" 2 "Aux PU2" 3 "Aux PU3" 4 "Aux PUD1" 5 "Aux PUD2" 6 "Aux PUD3" 7 "EGT Input" 8 "Aux PUD4" 9 "Aux PUD5" 10 "Aux PUD6" 11 "Aux PUD7" 12 "Aux PUD8" 13 "Aux PUD9" 14 "Aux PUD10" 15 "Aux PUD11" 16 "Aux PUD12" 17 "Aux PUD13" 18 "Aux PUD14" 19 "Aux PUD15" 20 "Aux PUD16" 21 "Aux PUD17" 22 "Aux PUD18" 23 "Aux PUD19" 24 "Aux PUD20" 25 "Aux PUD21" 26 "Aux PUD22" 27 "Aux PUD23" 28 "Aux PUD24" 29 "Aux PUD25" 30 "CAN sourced" DEFAULT_VALUE "UNKNOWN" /end COMPU_VTAB
/begin MEASUREMENT CAT_Tin "Catalyst inlet temperature" UWORD Compu_CAT_Tin 0 0 -460 7731.875 ECU_ADDRESS 0x0100F5C0 /end MEASUREMENT
/begin COMPU_METHOD Compu_CAT_Tin " " RAT_FUNC "%.1" "deg F" COEFFS 0 8 3680 0 0 1 /end COMPU_METHOD
/begin MEASUREMENT CAT_Tout "Catalyst outlet temperature" UWORD Compu_CAT_Tout 0 0 -460 7731.875 ECU_ADDRESS 0x0100F5C8 /end MEASUREMENT
/begin COMPU_METHOD Compu_CAT_Tout " " RAT_FUNC "%.1" "deg F" COEFFS 0 8 3680 0 0 1 /end COMPU_METHOD
/begin MEASUREMENT HSDL_samp_skip "Samples to skip" UWORD Compu_HSDL_samp_skip 0 0 0 65535 ECU_ADDRESS 0x0100F648 /end MEASUREMENT
/begin COMPU_METHOD Compu_HSDL_samp_skip " " RAT_FUNC "%.0" "-" COEFFS 0 1 0 0 0 1 /end COMPU_METHOD
/begin MEASUREMENT HSDL_custom_min1 "HSDL_custom_min1" FLOAT32_IEEE Compu_HSDL_custom_min1 0 0 -10000000000 10000000000 ECU_ADDRESS 0x0100F650 /end MEASUREMENT
/begin COMPU_METHOD Compu_HSDL_custom_min1 " " RAT_FUNC "%.0" "-" COEFFS 0 1 0 0 0 1 /end COMPU_METHOD
/begin MEASUREMENT HSDL_custom_min2 "HSDL_custom_min2" FLOAT32_IEEE Compu_HSDL_custom_min2 0 0 -10000000000 10000000000 ECU_ADDRESS 0x0100F658 /end MEASUREMENT
/begin COMPU_METHOD Compu_HSDL_custom_min2 " " RAT_FUNC "%.0" "-" COEFFS 0 1 0 0 0 1 /end COMPU_METHOD
/begin MEASUREMENT HSDL_custom_min3 "HSDL_custom_min3" FLOAT32_IEEE Compu_HSDL_custom_min3 0 0 -10000000000 10000000000 ECU_ADDRESS 0x0100F660 /end MEASUREMENT
/begin COMPU_METHOD Compu_HSDL_custom_min3 " " RAT_FUNC "%.0" "-" COEFFS 0 1 0 0 0 1 /end COMPU_METHOD
/begin MEASUREMENT HSDL_custom_min4 "HSDL_custom_min4" FLOAT32_IEEE Compu_HSDL_custom_min4 0 0 -10000000000 10000000000 ECU_ADDRESS 0x0100F668 /end MEASUREMENT
/begin COMPU_METHOD Compu_HSDL_custom_min4 " " RAT_FUNC "%.0" "-" COEFFS 0 1 0 0 0 1 /end COMPU_METHOD
/begin MEASUREMENT HSDL_custom_max1 "HSDL_custom_max1" FLOAT32_IEEE Compu_HSDL_custom_max1 0 0 -10000000000 10000000000 ECU_ADDRESS 0x0100F670 /end MEASUREMENT
/begin COMPU_METHOD Compu_HSDL_custom_max1 " " RAT_FUNC "%.0" "-" COEFFS 0 1 0 0 0 1 /end COMPU_METHOD
/begin MEASUREMENT HSDL_custom_max2 "HSDL_custom_max2" FLOAT32_IEEE Compu_HSDL_custom_max2 0 0 -10000000000 10000000000 ECU_ADDRESS 0x0100F678 /end MEASUREMENT
/begin COMPU_METHOD Compu_HSDL_custom_max2 " " RAT_FUNC "%.0" "-" COEFFS 0 1 0 0 0 1 /end COMPU_METHOD
/begin MEASUREMENT HSDL_custom_max3 "HSDL_custom_max3" FLOAT32_IEEE Compu_HSDL_custom_max3 0 0 -10000000000 10000000000 ECU_ADDRESS 0x0100F680 /end MEASUREMENT
/begin COMPU_METHOD Compu_HSDL_custom_max3 " " RAT_FUNC "%.0" "-" COEFFS 0 1 0 0 0 1 /end COMPU_METHOD
/begin MEASUREMENT HSDL_custom_max4 "HSDL_custom_max4" FLOAT32_IEEE Compu_HSDL_custom_max4 0 0 -10000000000 10000000000 ECU_ADDRESS 0x0100F688 /end MEASUREMENT
/begin COMPU_METHOD Compu_HSDL_custom_max4 " " RAT_FUNC "%.0" "-" COEFFS 0 1 0 0 0 1 /end COMPU_METHOD
/begin MEASUREMENT sim_fsys_action "Fault system sim action{sim_fsys_action&0xff=0:None}{sim_fsys_action&0xff=1:Inc warmup cycle}{sim_fsys_action&0xff=2:Inc general denom}{sim_fsys_action&0xff=3:Inc drive cycle}{sim_fsys_action&0xff=4:Adj Induce EGR}{sim_fsys_action&0xff=5:Adj Induce EGR dn" UBYTE sim_fsys_action_COMPU_VTAB 0 0 0 255 ECU_ADDRESS 0x0100FC58 BIT_MASK 0xff /end MEASUREMENT
/begin COMPU_METHOD sim_fsys_action_COMPU_VTAB "Verbal Table" TAB_VERB "%.0" "list" COMPU_TAB_REF sim_fsys_action_COMPU_VTAB_REF /end COMPU_METHOD
/begin COMPU_VTAB sim_fsys_action_COMPU_VTAB_REF "Verbal Table" TAB_VERB 15 0 "None" 1 "Inc warmup cycle" 2 "Inc general denom" 3 "Inc drive cycle" 4 "Adj Induce EGR" 5 "Adj Induce EGR dn" 6 "Adj Induce Mon" 7 "Adj Induce Mon dn" 8 "Adj Induce 8-hr" 9 "Adj B1 counter" 10 "Adj cont-MI counter" 11 "Inc cyc since cont-MI" 12 "Set cont-MI warm-ups" 13 "Adj cont-MI eng hours" 14 "Adj cumulative cont-MI" DEFAULT_VALUE "UNKNOWN" /end COMPU_VTAB
/begin MEASUREMENT sim_fsys_state "Fault system sim state{sim_fsys_state&0xff=0:Idle}{sim_fsys_state&0xff=1:General error}{sim_fsys_state&0xff=2:Invalid sim mode key}{sim_fsys_state&0xff=3:Engine not running}{sim_fsys_state&0xff=4:Warmup cycle inc}{sim_fsys_state&0xff=5:General denom inc}{" UBYTE sim_fsys_state_COMPU_VTAB 0 0 0 255 ECU_ADDRESS 0x0100FC60 BIT_MASK 0xff /end MEASUREMENT
/begin COMPU_METHOD sim_fsys_state_COMPU_VTAB "Verbal Table" TAB_VERB "%.0" "list" COMPU_TAB_REF sim_fsys_state_COMPU_VTAB_REF /end COMPU_METHOD
/begin COMPU_VTAB sim_fsys_state_COMPU_VTAB_REF "Verbal Table" TAB_VERB 15 0 "Idle" 1 "General error" 2 "Invalid sim mode key" 3 "Engine not running" 4 "Warmup cycle inc" 5 "General denom inc" 6 "Drive cycle inc" 7 "Inducement adjusted" 8 "B1 counter adjusted" 9 "Cont-MI counter adjusted" 10 "Cont-MI cycles inc" 11 "Cont-MI warm-ups set" 12 "Cont-MI eng hours adj" 13 "Failed: cont-MI active" 14 "Cumulative cont-MI adj" DEFAULT_VALUE "UNKNOWN" /end COMPU_VTAB
/begin MEASUREMENT HSDL_at_mode "Auto-trigger mode{HSDL_at_mode&0xff=0:Disabled}{HSDL_at_mode&0xff=1:Rising edge}{HSDL_at_mode&0xff=2:Falling edge}{HSDL_at_mode&0xff=3:Always triggered}" UBYTE HSDL_at_mode_COMPU_VTAB 0 0 0 255 ECU_ADDRESS 0x01010140 BIT_MASK 0xff /end MEASUREMENT
/begin COMPU_METHOD HSDL_at_mode_COMPU_VTAB "Verbal Table" TAB_VERB "%.0" "list" COMPU_TAB_REF HSDL_at_mode_COMPU_VTAB_REF /end COMPU_METHOD
/begin COMPU_VTAB HSDL_at_mode_COMPU_VTAB_REF "Verbal Table" TAB_VERB 4 0 "Disabled" 1 "Rising edge" 2 "Falling edge" 3 "Always triggered" DEFAULT_VALUE "UNKNOWN" /end COMPU_VTAB
/begin MEASUREMENT HSDL_at_ecipp_index "Auto-trigger ECIPP index" ULONG Compu_HSDL_at_ecipp_index 0 0 0 4294967295 ECU_ADDRESS 0x01010148 /end MEASUREMENT
/begin COMPU_METHOD Compu_HSDL_at_ecipp_index " " RAT_FUNC "%.0" "-" COEFFS 0 1 0 0 0 1 /end COMPU_METHOD
/begin MEASUREMENT HSDL_at_target_val "Auto-trigger target" ULONG Compu_HSDL_at_target_val 0 0 0 4294967295 ECU_ADDRESS 0x01010150 /end MEASUREMENT
/begin COMPU_METHOD Compu_HSDL_at_target_val " " RAT_FUNC "%.3" "-" COEFFS 0 1 0 0 0 1 /end COMPU_METHOD
/begin MEASUREMENT HSDL_at_target_type "Auto-trigger target type (hidden)" UBYTE Compu_HSDL_at_target_type 0 0 0 255 ECU_ADDRESS 0x01010158 /end MEASUREMENT
/begin COMPU_METHOD Compu_HSDL_at_target_type " " RAT_FUNC "%.0" "-" COEFFS 0 1 0 0 0 1 /end COMPU_METHOD
/begin MEASUREMENT sim_fsys_adjust "Fault system sim adjust" SLONG Compu_sim_fsys_adjust 0 0 -596523.235555556 596523.235277778 ECU_ADDRESS 0x01010EA0 /end MEASUREMENT
/begin COMPU_METHOD Compu_sim_fsys_adjust " " RAT_FUNC "%.3" "hours" COEFFS 0 3600 0 0 0 1 /end COMPU_METHOD
/begin CHARACTERISTIC CTM_FSO_mode "Gsln CTM FSO single-pt mode{CTM_FSO_mode&0xff=0:Disabled}{CTM_FSO_mode&0xff=1:Enabled}" VALUE 0x001C9C04 /* @ECU_Address@CTM_FSO_mode@0x01011C00@ */ ECIPP_ALIGNMENT_UBYTE 255 CTM_FSO_mode_COMPU_VTAB 0 255 BIT_MASK 0xff /end CHARACTERISTIC
/begin COMPU_METHOD CTM_FSO_mode_COMPU_VTAB "Verbal Table" TAB_VERB "%.0" "list" COMPU_TAB_REF CTM_FSO_mode_COMPU_VTAB_REF /end COMPU_METHOD
/begin COMPU_VTAB CTM_FSO_mode_COMPU_VTAB_REF "Verbal Table" TAB_VERB 2 0 "Disabled" 1 "Enabled" DEFAULT_VALUE "UNKNOWN" /end COMPU_VTAB
/begin CHARACTERISTIC CTM_FSO_CBT "Gsln CTM FSO CBT" VALUE 0x001C9C00 /* @ECU_Address@CTM_FSO_CBT@0x01011C08@ */ ECIPP_ALIGNMENT_UWORD 7732 Compu_CTM_FSO_CBT -460 7731.875 /end CHARACTERISTIC
/begin COMPU_METHOD Compu_CTM_FSO_CBT " " RAT_FUNC "%.0" "deg F" COEFFS 0 8 3680 0 0 1 /end COMPU_METHOD
/begin CHARACTERISTIC CTM_FSO_tau "Gsln CTM FSO tau" VALUE 0x001C9C02 /* @ECU_Address@CTM_FSO_tau@0x01011C10@ */ ECIPP_ALIGNMENT_UWORD 1049 Compu_CTM_FSO_tau 0 1048.56 /end CHARACTERISTIC
/begin COMPU_METHOD Compu_CTM_FSO_tau " " RAT_FUNC "%.1" "seconds" COEFFS 0 62.5 0 0 0 1 /end COMPU_METHOD
/begin CHARACTERISTIC CTMA_FSO_mode "Alt CTM FSO mode{CTMA_FSO_mode&0xff=0:Disabled}{CTMA_FSO_mode&0xff=1:Single-Point}{CTMA_FSO_mode&0xff=2:Table-Based}" VALUE 0x001C9BE4 /* @ECU_Address@CTMA_FSO_mode@0x01011C18@ */ ECIPP_ALIGNMENT_UBYTE 255 CTMA_FSO_mode_COMPU_VTAB 0 255 BIT_MASK 0xff /end CHARACTERISTIC
/begin COMPU_METHOD CTMA_FSO_mode_COMPU_VTAB "Verbal Table" TAB_VERB "%.0" "list" COMPU_TAB_REF CTMA_FSO_mode_COMPU_VTAB_REF /end COMPU_METHOD
/begin COMPU_VTAB CTMA_FSO_mode_COMPU_VTAB_REF "Verbal Table" TAB_VERB 3 0 "Disabled" 1 "Single-Point" 2 "Table-Based" DEFAULT_VALUE "UNKNOWN" /end COMPU_VTAB
/begin CHARACTERISTIC CTMA_FSO_CBT "Alt CTM FSO single-point CBT" VALUE 0x001C9BE0 /* @ECU_Address@CTMA_FSO_CBT@0x01011C20@ */ ECIPP_ALIGNMENT_UWORD 7732 Compu_CTMA_FSO_CBT -460 7731.875 /end CHARACTERISTIC
/begin COMPU_METHOD Compu_CTMA_FSO_CBT " " RAT_FUNC "%.0" "deg F" COEFFS 0 8 3680 0 0 1 /end COMPU_METHOD
/begin CHARACTERISTIC CTMA_FSO_tau "Alt CTM FSO single-point tau" VALUE 0x001C9BE2 /* @ECU_Address@CTMA_FSO_tau@0x01011C28@ */ ECIPP_ALIGNMENT_UWORD 1049 Compu_CTMA_FSO_tau 0 1048.56 /end CHARACTERISTIC
/begin COMPU_METHOD Compu_CTMA_FSO_tau " " RAT_FUNC "%.1" "seconds" COEFFS 0 62.5 0 0 0 1 /end COMPU_METHOD
/begin MEASUREMENT TWCmod_ROL "TWC relative oxygen level" FLOAT32_IEEE Compu_TWCmod_ROL 0 0 -10000000000 10000000000 ECU_ADDRESS 0x01011C90 /end MEASUREMENT
/begin COMPU_METHOD Compu_TWCmod_ROL " " RAT_FUNC "%.1" "%" COEFFS 0 0.01 0 0 0 1 /end COMPU_METHOD
/begin MEASUREMENT TWCmod_rho "TWC oxygen transfer fraction" FLOAT32_IEEE Compu_TWCmod_rho 0 0 -10000000000 10000000000 ECU_ADDRESS 0x01011C98 /end MEASUREMENT
/begin COMPU_METHOD Compu_TWCmod_rho " " RAT_FUNC "%.1" "-" COEFFS 0 1 0 0 0 1 /end COMPU_METHOD
/begin MEASUREMENT TWCmod_dROLdt "TWC relative oxygen level rate of change" FLOAT32_IEEE Compu_TWCmod_dROLdt 0 0 -10000000000 10000000000 ECU_ADDRESS 0x01011CA0 /end MEASUREMENT
/begin COMPU_METHOD Compu_TWCmod_dROLdt " " RAT_FUNC "%.1" "%/sec" COEFFS 0 1 0 0 0 1 /end COMPU_METHOD
/begin MEASUREMENT TWCmod_phi_post "TWC post cat phi" FLOAT32_IEEE Compu_TWCmod_phi_post 0 0 -10000000000 10000000000 ECU_ADDRESS 0x01011CA8 /end MEASUREMENT
/begin COMPU_METHOD Compu_TWCmod_phi_post " " RAT_FUNC "%.2" "-" COEFFS 0 1 0 0 0 1 /end COMPU_METHOD
/begin CHARACTERISTIC TWCmod_OSC "Fresh oxygen storage capacity" VALUE 0x001c3d88 /* @ECU_Address@TWCmod_OSC@0x01011CB0@ */ ECIPP_ALIGNMENT_FLOAT32_IEEE 10000000000 Compu_TWCmod_OSC -10000000000 10000000000 /end CHARACTERISTIC
/begin COMPU_METHOD Compu_TWCmod_OSC " " RAT_FUNC "%.1" "g" COEFFS 0 1 0 0 0 1 /end COMPU_METHOD
/begin CHARACTERISTIC TWCmod_aL "TWC lean coefficient" VALUE 0x001c3d8c /* @ECU_Address@TWCmod_aL@0x01011CB8@ */ ECIPP_ALIGNMENT_FLOAT32_IEEE 10000000000 Compu_TWCmod_aL -10000000000 10000000000 /end CHARACTERISTIC
/begin COMPU_METHOD Compu_TWCmod_aL " " RAT_FUNC "%.2" "-" COEFFS 0 1 0 0 0 1 /end COMPU_METHOD
/begin CHARACTERISTIC TWCmod_aR "TWC rich coefficient" VALUE 0x001c3d90 /* @ECU_Address@TWCmod_aR@0x01011CC0@ */ ECIPP_ALIGNMENT_FLOAT32_IEEE 10000000000 Compu_TWCmod_aR -10000000000 10000000000 /end CHARACTERISTIC
/begin COMPU_METHOD Compu_TWCmod_aR " " RAT_FUNC "%.2" "-" COEFFS 0 1 0 0 0 1 /end COMPU_METHOD
/begin CHARACTERISTIC TWCmod_cL "TWC lean exponent" VALUE 0x001c3d94 /* @ECU_Address@TWCmod_cL@0x01011CC8@ */ ECIPP_ALIGNMENT_FLOAT32_IEEE 10000000000 Compu_TWCmod_cL -10000000000 10000000000 /end CHARACTERISTIC
/begin COMPU_METHOD Compu_TWCmod_cL " " RAT_FUNC "%.1" "-" COEFFS 0 1 0 0 0 1 /end COMPU_METHOD
/begin CHARACTERISTIC TWCmod_cR "TWC rich exponent" VALUE 0x001c3d98 /* @ECU_Address@TWCmod_cR@0x01011CD0@ */ ECIPP_ALIGNMENT_FLOAT32_IEEE 10000000000 Compu_TWCmod_cR -10000000000 10000000000 /end CHARACTERISTIC
/begin COMPU_METHOD Compu_TWCmod_cR " " RAT_FUNC "%.1" "-" COEFFS 0 1 0 0 0 1 /end COMPU_METHOD
/begin CHARACTERISTIC TWCdiag_mdot_min "TWC fault min port air flow" VALUE 0x001c8268 /* @ECU_Address@TWCdiag_mdot_min@0x01011E18@ */ ECIPP_ALIGNMENT_UWORD 1024 Compu_TWCdiag_mdot_min 0 1023.984375 /end CHARACTERISTIC
/begin COMPU_METHOD Compu_TWCdiag_mdot_min " " RAT_FUNC "%.1" "g/sec" COEFFS 0 64 0 0 0 1 /end COMPU_METHOD
/begin CHARACTERISTIC TWCdiag_ECT_min "TWC fault min ECT" VALUE 0x001c8264 /* @ECU_Address@TWCdiag_ECT_min@0x01011E20@ */ ECIPP_ALIGNMENT_UWORD 564 Compu_TWCdiag_ECT_min -460 563.984375 /end CHARACTERISTIC
/begin COMPU_METHOD Compu_TWCdiag_ECT_min " " RAT_FUNC "%.1" "deg F" COEFFS 0 64 29440 0 0 1 /end COMPU_METHOD
/begin CHARACTERISTIC TWCdiag_CBT_min "TWC fault min CBT" VALUE 0x001c8262 /* @ECU_Address@TWCdiag_CBT_min@0x01011E28@ */ ECIPP_ALIGNMENT_UWORD 7732 Compu_TWCdiag_CBT_min -460 7731.875 /end CHARACTERISTIC
/begin COMPU_METHOD Compu_TWCdiag_CBT_min " " RAT_FUNC "%.0" "deg F" COEFFS 0 8 3680 0 0 1 /end COMPU_METHOD
/begin CHARACTERISTIC TWCdiag_phi_d "TWC fault pre-cat phi target" VALUE 0x001c826a /* @ECU_Address@TWCdiag_phi_d@0x01011E30@ */ ECIPP_ALIGNMENT_UWORD 4 Compu_TWCdiag_phi_d 0 3.99993896484375 /end CHARACTERISTIC
/begin COMPU_METHOD Compu_TWCdiag_phi_d " " RAT_FUNC "%.3" "phi" COEFFS 0 16384 0 0 0 1 /end COMPU_METHOD
/begin CHARACTERISTIC TWCdiag_phi_pst_thld "TWC fault post-cat phi threshold" VALUE 0x001c8270 /* @ECU_Address@TWCdiag_phi_pst_thld@0x01011E38@ */ ECIPP_ALIGNMENT_UWORD 4 Compu_TWCdiag_phi_pst_thld 0 3.99993896484375 /end CHARACTERISTIC
/begin COMPU_METHOD Compu_TWCdiag_phi_pst_thld " " RAT_FUNC "%.3" "phi" COEFFS 0 16384 0 0 0 1 /end COMPU_METHOD
/begin CHARACTERISTIC TWCdiag_phi_pst_lean "TWC fault post-cat lean value" VALUE 0x001c826e /* @ECU_Address@TWCdiag_phi_pst_lean@0x01011E40@ */ ECIPP_ALIGNMENT_UWORD 4 Compu_TWCdiag_phi_pst_lean 0 3.99993896484375 /end CHARACTERISTIC
/begin COMPU_METHOD Compu_TWCdiag_phi_pst_lean " " RAT_FUNC "%.3" "phi" COEFFS 0 16384 0 0 0 1 /end COMPU_METHOD
/begin CHARACTERISTIC TWCdiag_tlean_min "TWC fault min lean time for saturation" VALUE 0x001c8272 /* @ECU_Address@TWCdiag_tlean_min@0x01011E48@ */ ECIPP_ALIGNMENT_UWORD 66 Compu_TWCdiag_tlean_min 0 65.535 /end CHARACTERISTIC
/begin COMPU_METHOD Compu_TWCdiag_tlean_min " " RAT_FUNC "%.1" "sec" COEFFS 0 1000 0 0 0 1 /end COMPU_METHOD
/begin CHARACTERISTIC TWCdiag_tmon_max "TWC fault max monitor time" VALUE 0x001c8274 /* @ECU_Address@TWCdiag_tmon_max@0x01011E50@ */ ECIPP_ALIGNMENT_UWORD 66 Compu_TWCdiag_tmon_max 0 65.535 /end CHARACTERISTIC
/begin COMPU_METHOD Compu_TWCdiag_tmon_max " " RAT_FUNC "%.1" "sec" COEFFS 0 1000 0 0 0 1 /end COMPU_METHOD
/begin CHARACTERISTIC TWCdiag_max_events "TWC fault max number of monitors" VALUE 0x001c8f68 /* @ECU_Address@TWCdiag_max_events@0x01011E58@ */ ECIPP_ALIGNMENT_UBYTE 255 Compu_TWCdiag_max_events 0 255 /end CHARACTERISTIC
/begin COMPU_METHOD Compu_TWCdiag_max_events " " RAT_FUNC "%.0" "mon/cyc" COEFFS 0 1 0 0 0 1 /end COMPU_METHOD
/begin CHARACTERISTIC TWCdiag_K_norm "TWC fault normalization constant" VALUE 0x001c3d70 /* @ECU_Address@TWCdiag_K_norm@0x01011E60@ */ ECIPP_ALIGNMENT_FLOAT32_IEEE 10000000000 Compu_TWCdiag_K_norm -10000000000 10000000000 /end CHARACTERISTIC
/begin COMPU_METHOD Compu_TWCdiag_K_norm " " RAT_FUNC "%.2" "-" COEFFS 0 1 0 0 0 1 /end COMPU_METHOD
/begin MEASUREMENT TWCdiag_state "TWC fault status{TWCdiag_state&0xff=0:Inactive}{TWCdiag_state&0xff=1:Waiting}{TWCdiag_state&0xff=2:Ready}{TWCdiag_state&0xff=3:Running}{TWCdiag_state&0xff=4:Complete}{TWCdiag_state&0xff=5:Inactive: FSO/RMT_stop}{TWCdiag_state&0xff=6:Inactive: Max Time}{TW" UBYTE TWCdiag_state_COMPU_VTAB 0 0 0 255 ECU_ADDRESS 0x01011E68 BIT_MASK 0xff /end MEASUREMENT
/begin COMPU_METHOD TWCdiag_state_COMPU_VTAB "Verbal Table" TAB_VERB "%.0" "list" COMPU_TAB_REF TWCdiag_state_COMPU_VTAB_REF /end COMPU_METHOD
/begin COMPU_VTAB TWCdiag_state_COMPU_VTAB_REF "Verbal Table" TAB_VERB 15 0 "Inactive" 1 "Waiting" 2 "Ready" 3 "Running" 4 "Complete" 5 "Inactive: FSO/RMT_stop" 6 "Inactive: Max Time" 7 "Inactive: CBT Low" 8 "Inactive: ECT Low" 9 "Inactive: Max Count" 10 "Inactive: Flow Low" 11 "Inactive: Faults" 12 "Inactive: XEGO validity" 13 "Inactive: Invalid meas." 14 "Inactive: FSO Duration" DEFAULT_VALUE "UNKNOWN" /end COMPU_VTAB
/begin MEASUREMENT TWCdiag_monitor_ms "TWC fault monitor timer" UWORD Compu_TWCdiag_monitor_ms 0 0 0 65.535 ECU_ADDRESS 0x01011E70 /end MEASUREMENT
/begin COMPU_METHOD Compu_TWCdiag_monitor_ms " " RAT_FUNC "%.1" "sec" COEFFS 0 1000 0 0 0 1 /end COMPU_METHOD
/begin MEASUREMENT TWCdiag_event_cntr "TWC fault monitor events" UBYTE Compu_TWCdiag_event_cntr 0 0 0 255 ECU_ADDRESS 0x01011E78 /end MEASUREMENT
/begin COMPU_METHOD Compu_TWCdiag_event_cntr " " RAT_FUNC "%.0" "events" COEFFS 0 1 0 0 0 1 /end COMPU_METHOD
/begin MEASUREMENT TWCdiag_OSC_est "TWC fault OSC estimate" FLOAT32_IEEE Compu_TWCdiag_OSC_est 0 0 -10000000000 10000000000 ECU_ADDRESS 0x01011E80 /end MEASUREMENT
/begin COMPU_METHOD Compu_TWCdiag_OSC_est " " RAT_FUNC "%.1" "g" COEFFS 0 1 0 0 0 1 /end COMPU_METHOD
/begin CHARACTERISTIC TWCdiag_ena "TWC fault monitoring condition{TWCdiag_ena&0xff=0:Disabled}{TWCdiag_ena&0xff=1:Fuel shutoff or remote stop}{TWCdiag_ena&0xff=2:Fuel shutoff only}{TWCdiag_ena&0xff=3:Remote stop only}" VALUE 0x001c8f67 /* @ECU_Address@TWCdiag_ena@0x01011E88@ */ ECIPP_ALIGNMENT_UBYTE 255 TWCdiag_ena_COMPU_VTAB 0 255 BIT_MASK 0xff /end CHARACTERISTIC
/begin COMPU_METHOD TWCdiag_ena_COMPU_VTAB "Verbal Table" TAB_VERB "%.0" "list" COMPU_TAB_REF TWCdiag_ena_COMPU_VTAB_REF /end COMPU_METHOD
/begin COMPU_VTAB TWCdiag_ena_COMPU_VTAB_REF "Verbal Table" TAB_VERB 4 0 "Disabled" 1 "Fuel shutoff or remote stop" 2 "Fuel shutoff only" 3 "Remote stop only" DEFAULT_VALUE "UNKNOWN" /end COMPU_VTAB
/begin MEASUREMENT TWCmod_ROL_avg "TWC relative oxygen level average" FLOAT32_IEEE Compu_TWCmod_ROL_avg 0 0 -10000000000 10000000000 ECU_ADDRESS 0x01011F88 /end MEASUREMENT
/begin COMPU_METHOD Compu_TWCmod_ROL_avg " " RAT_FUNC "%.1" "%" COEFFS 0 0.01 0 0 0 1 /end COMPU_METHOD
/begin MEASUREMENT sim_fsys_set "Fault system sim set" UWORD Compu_sim_fsys_set 0 0 0 4095.9375 ECU_ADDRESS 0x01011FA0 /end MEASUREMENT
/begin COMPU_METHOD Compu_sim_fsys_set " " RAT_FUNC "%.1" "-" COEFFS 0 16 0 0 0 1 /end COMPU_METHOD
/begin CHARACTERISTIC TWCdiag_cat_temp "TWC monitor catalyst temperature selection{TWCdiag_cat_temp&0xff=0:Bed temperature (model)}{TWCdiag_cat_temp&0xff=1:Inlet temperature}{TWCdiag_cat_temp&0xff=2:Outlet temperature}" VALUE 0x001c8f66 /* @ECU_Address@TWCdiag_cat_temp@0x01012268@ */ ECIPP_ALIGNMENT_UBYTE 255 TWCdiag_cat_temp_COMPU_VTAB 0 255 BIT_MASK 0xff /end CHARACTERISTIC
/begin COMPU_METHOD TWCdiag_cat_temp_COMPU_VTAB "Verbal Table" TAB_VERB "%.0" "list" COMPU_TAB_REF TWCdiag_cat_temp_COMPU_VTAB_REF /end COMPU_METHOD
/begin COMPU_VTAB TWCdiag_cat_temp_COMPU_VTAB_REF "Verbal Table" TAB_VERB 3 0 "Bed temperature (model)" 1 "Inlet temperature" 2 "Outlet temperature" DEFAULT_VALUE "UNKNOWN" /end COMPU_VTAB
/begin MEASUREMENT TWCdiag_OSC_est_avg "TWC monitor average OSC value" FLOAT32_IEEE Compu_TWCdiag_OSC_est_avg 0 0 -10000000000 10000000000 ECU_ADDRESS 0x010122B0 /end MEASUREMENT
/begin COMPU_METHOD Compu_TWCdiag_OSC_est_avg " " RAT_FUNC "%.1" "g" COEFFS 0 1 0 0 0 1 /end COMPU_METHOD
/begin CHARACTERISTIC TWCdiag_OSC_min "Minimum valid OSC" VALUE 0x001c3d7c /* @ECU_Address@TWCdiag_OSC_min@0x010122B8@ */ ECIPP_ALIGNMENT_FLOAT32_IEEE 10000000000 Compu_TWCdiag_OSC_min -10000000000 10000000000 /end CHARACTERISTIC
/begin COMPU_METHOD Compu_TWCdiag_OSC_min " " RAT_FUNC "%.1" "g" COEFFS 0 1 0 0 0 1 /end COMPU_METHOD
/begin CHARACTERISTIC TWCdiag_OSC_max "Maximum valid OSC" VALUE 0x001c3d78 /* @ECU_Address@TWCdiag_OSC_max@0x010122C0@ */ ECIPP_ALIGNMENT_FLOAT32_IEEE 10000000000 Compu_TWCdiag_OSC_max -10000000000 10000000000 /end CHARACTERISTIC
/begin COMPU_METHOD Compu_TWCdiag_OSC_max " " RAT_FUNC "%.1" "g" COEFFS 0 1 0 0 0 1 /end COMPU_METHOD
/begin CHARACTERISTIC CBT_taustopped "CTM engine stopped tau" VALUE 0x001c8518 /* @ECU_Address@CBT_taustopped@0x01012918@ */ ECIPP_ALIGNMENT_UWORD 3277 Compu_CBT_taustopped 0.0045084 3276.8 /end CHARACTERISTIC
/begin COMPU_METHOD Compu_CBT_taustopped " " FORM "%.1" "sec"
 /begin FORMULA "-0.05 / log(1 - (X1 / 65536))" FORMULA_INV "(1 - exp(-0.05/X1)) * 65536" /end FORMULA
/end COMPU_METHOD
/begin MEASUREMENT HSDL_buffer_sizerqst "HSDL buffer size" UWORD Compu_HSDL_buffer_sizerqst 0 0 0 65535 ECU_ADDRESS 0x01012AF8 /end MEASUREMENT
/begin COMPU_METHOD Compu_HSDL_buffer_sizerqst " " RAT_FUNC "%.0" "-" COEFFS 0 1 0 0 0 1 /end COMPU_METHOD
/begin MEASUREMENT DLOG_base_ptr "Data logger start address" ULONG Compu_DLOG_base_ptr 0 0 0 4294967295 ECU_ADDRESS 0x01012B00 /end MEASUREMENT
/begin COMPU_METHOD Compu_DLOG_base_ptr " " RAT_FUNC "%.0" "-" COEFFS 0 1 0 0 0 1 /end COMPU_METHOD
/begin MEASUREMENT HSDL_pack_mode "Data encoding{HSDL_pack_mode&0xff=0:Up to 4 32-bit ECIPP vars, column-major}{HSDL_pack_mode&0xff=1:Up to 4 floats, column-major}{HSDL_pack_mode&0xff=2:Up to 4 ECIPP vars, packed, row-major}" UBYTE HSDL_pack_mode_COMPU_VTAB 0 0 0 255 ECU_ADDRESS 0x01012B08 BIT_MASK 0xff /end MEASUREMENT
/begin COMPU_METHOD HSDL_pack_mode_COMPU_VTAB "Verbal Table" TAB_VERB "%.0" "list" COMPU_TAB_REF HSDL_pack_mode_COMPU_VTAB_REF /end COMPU_METHOD
/begin COMPU_VTAB HSDL_pack_mode_COMPU_VTAB_REF "Verbal Table" TAB_VERB 3 0 "Up to 4 32-bit ECIPP vars, column-major" 1 "Up to 4 floats, column-major" 2 "Up to 4 ECIPP vars, packed, row-major" DEFAULT_VALUE "UNKNOWN" /end COMPU_VTAB
/begin MEASUREMENT HSDL_samp_interval "Sample interval" ULONG Compu_HSDL_samp_interval 0 0 0 4294.967295 ECU_ADDRESS 0x01012B10 /end MEASUREMENT
/begin COMPU_METHOD Compu_HSDL_samp_interval " " RAT_FUNC "%.0" "-" COEFFS 0 1000000 0 0 0 1 /end COMPU_METHOD
/begin MEASUREMENT HSDL_entries "HSDL column count" UBYTE Compu_HSDL_entries 0 0 0 255 ECU_ADDRESS 0x01012C80 /end MEASUREMENT
/begin COMPU_METHOD Compu_HSDL_entries " " RAT_FUNC "%.0" "-" COEFFS 0 1 0 0 0 1 /end COMPU_METHOD
/begin MEASUREMENT HSDL_ECIPP5 "ECIPP index 5" ULONG Compu_HSDL_ECIPP5 0 0 0 4294967295 ECU_ADDRESS 0x01012C88 /end MEASUREMENT
/begin COMPU_METHOD Compu_HSDL_ECIPP5 " " RAT_FUNC "%.0" "-" COEFFS 0 1 0 0 0 1 /end COMPU_METHOD
/begin MEASUREMENT HSDL_ECIPP6 "ECIPP index 6" ULONG Compu_HSDL_ECIPP6 0 0 0 4294967295 ECU_ADDRESS 0x01012C90 /end MEASUREMENT
/begin COMPU_METHOD Compu_HSDL_ECIPP6 " " RAT_FUNC "%.0" "-" COEFFS 0 1 0 0 0 1 /end COMPU_METHOD
/begin MEASUREMENT HSDL_ECIPP7 "ECIPP index 7" ULONG Compu_HSDL_ECIPP7 0 0 0 4294967295 ECU_ADDRESS 0x01012C98 /end MEASUREMENT
/begin COMPU_METHOD Compu_HSDL_ECIPP7 " " RAT_FUNC "%.0" "-" COEFFS 0 1 0 0 0 1 /end COMPU_METHOD
/begin MEASUREMENT HSDL_ECIPP8 "ECIPP index 8" ULONG Compu_HSDL_ECIPP8 0 0 0 4294967295 ECU_ADDRESS 0x01012CA0 /end MEASUREMENT
/begin COMPU_METHOD Compu_HSDL_ECIPP8 " " RAT_FUNC "%.0" "-" COEFFS 0 1 0 0 0 1 /end COMPU_METHOD
/begin MEASUREMENT HSDL_ECIPP9 "ECIPP index 9" ULONG Compu_HSDL_ECIPP9 0 0 0 4294967295 ECU_ADDRESS 0x01012CA8 /end MEASUREMENT
/begin COMPU_METHOD Compu_HSDL_ECIPP9 " " RAT_FUNC "%.0" "-" COEFFS 0 1 0 0 0 1 /end COMPU_METHOD
/begin MEASUREMENT HSDL_ECIPP10 "ECIPP index 10" ULONG Compu_HSDL_ECIPP10 0 0 0 4294967295 ECU_ADDRESS 0x01012CB0 /end MEASUREMENT
/begin COMPU_METHOD Compu_HSDL_ECIPP10 " " RAT_FUNC "%.0" "-" COEFFS 0 1 0 0 0 1 /end COMPU_METHOD
/begin MEASUREMENT HSDL_ECIPP11 "ECIPP index 11" ULONG Compu_HSDL_ECIPP11 0 0 0 4294967295 ECU_ADDRESS 0x01012CB8 /end MEASUREMENT
/begin COMPU_METHOD Compu_HSDL_ECIPP11 " " RAT_FUNC "%.0" "-" COEFFS 0 1 0 0 0 1 /end COMPU_METHOD
/begin MEASUREMENT HSDL_ECIPP12 "ECIPP index 12" ULONG Compu_HSDL_ECIPP12 0 0 0 4294967295 ECU_ADDRESS 0x01012CC0 /end MEASUREMENT
/begin COMPU_METHOD Compu_HSDL_ECIPP12 " " RAT_FUNC "%.0" "-" COEFFS 0 1 0 0 0 1 /end COMPU_METHOD
/begin MEASUREMENT TWCmod_ROL_dly "Relative oxygen level delayed" FLOAT32_IEEE Compu_TWCmod_ROL_dly 0 0 -10000000000 10000000000 ECU_ADDRESS 0x01013370 /end MEASUREMENT
/begin COMPU_METHOD Compu_TWCmod_ROL_dly " " RAT_FUNC "%.1" "%" COEFFS 0 0.01 0 0 0 1 /end COMPU_METHOD
/begin CHARACTERISTIC TWCdiag_phi_d_app "TWC fault pre-cat phi app tgt" VALUE 0x001c826c /* @ECU_Address@TWCdiag_phi_d_app@0x01013378@ */ ECIPP_ALIGNMENT_UWORD 4 Compu_TWCdiag_phi_d_app 0 3.99993896484375 /end CHARACTERISTIC
/begin COMPU_METHOD Compu_TWCdiag_phi_d_app " " RAT_FUNC "%.3" "phi" COEFFS 0 16384 0 0 0 1 /end COMPU_METHOD
/begin CHARACTERISTIC TWCdiag_pst_rich_rst "TWC fault post-cat thres reset{TWCdiag_pst_rich_rst&0xff=0:First monitor only}{TWCdiag_pst_rich_rst&0xff=1:Each monitor}" VALUE 0x001c8f69 /* @ECU_Address@TWCdiag_pst_rich_rst@0x010138A0@ */ ECIPP_ALIGNMENT_UBYTE 255 TWCdiag_pst_rich_rst_COMPU_VTAB 0 255 BIT_MASK 0xff /end CHARACTERISTIC
/begin COMPU_METHOD TWCdiag_pst_rich_rst_COMPU_VTAB "Verbal Table" TAB_VERB "%.0" "list" COMPU_TAB_REF TWCdiag_pst_rich_rst_COMPU_VTAB_REF /end COMPU_METHOD
/begin COMPU_VTAB TWCdiag_pst_rich_rst_COMPU_VTAB_REF "Verbal Table" TAB_VERB 2 0 "First monitor only" 1 "Each monitor" DEFAULT_VALUE "UNKNOWN" /end COMPU_VTAB
/begin CHARACTERISTIC TWCmod_OSC_error_Kp "TWC OSC error Kp" VALUE 0x001c8276 /* @ECU_Address@TWCmod_OSC_error_Kp@0x010138B0@ */ ECIPP_ALIGNMENT_UWORD 100 Compu_TWCmod_OSC_error_Kp 0 99.9984741210938 /end CHARACTERISTIC
/begin COMPU_METHOD Compu_TWCmod_OSC_error_Kp " " RAT_FUNC "%.1" "%/mon" COEFFS 0 655.36 0 0 0 1 /end COMPU_METHOD
/begin CHARACTERISTIC TWCdiag_OSC_marg "TWC fault diagnostic margin" VALUE 0x001c3d74 /* @ECU_Address@TWCdiag_OSC_marg@0x01013910@ */ ECIPP_ALIGNMENT_FLOAT32_IEEE 10000000000 Compu_TWCdiag_OSC_marg -10000000000 10000000000 /end CHARACTERISTIC
/begin COMPU_METHOD Compu_TWCdiag_OSC_marg " " RAT_FUNC "%.1" "g" COEFFS 0 1 0 0 0 1 /end COMPU_METHOD
/begin MEASUREMENT HSDL_ECIPP13 "HSDL index 13" ULONG Compu_HSDL_ECIPP13 0 0 0 4294967295 ECU_ADDRESS 0x01013AF0 /end MEASUREMENT
/begin COMPU_METHOD Compu_HSDL_ECIPP13 " " RAT_FUNC "%.0" "-" COEFFS 0 1 0 0 0 1 /end COMPU_METHOD
/begin MEASUREMENT HSDL_ECIPP14 "HSDL index 14" ULONG Compu_HSDL_ECIPP14 0 0 0 4294967295 ECU_ADDRESS 0x01013AF8 /end MEASUREMENT
/begin COMPU_METHOD Compu_HSDL_ECIPP14 " " RAT_FUNC "%.0" "-" COEFFS 0 1 0 0 0 1 /end COMPU_METHOD
/begin MEASUREMENT HSDL_ECIPP15 "HSDL index 15" ULONG Compu_HSDL_ECIPP15 0 0 0 4294967295 ECU_ADDRESS 0x01013B00 /end MEASUREMENT
/begin COMPU_METHOD Compu_HSDL_ECIPP15 " " RAT_FUNC "%.0" "-" COEFFS 0 1 0 0 0 1 /end COMPU_METHOD
/begin MEASUREMENT HSDL_ECIPP16 "HSDL index 16" ULONG Compu_HSDL_ECIPP16 0 0 0 4294967295 ECU_ADDRESS 0x01013B08 /end MEASUREMENT
/begin COMPU_METHOD Compu_HSDL_ECIPP16 " " RAT_FUNC "%.0" "-" COEFFS 0 1 0 0 0 1 /end COMPU_METHOD
/begin MEASUREMENT HSDL_ECIPP17 "HSDL index 17" ULONG Compu_HSDL_ECIPP17 0 0 0 4294967295 ECU_ADDRESS 0x01013B10 /end MEASUREMENT
/begin COMPU_METHOD Compu_HSDL_ECIPP17 " " RAT_FUNC "%.0" "-" COEFFS 0 1 0 0 0 1 /end COMPU_METHOD
/begin MEASUREMENT HSDL_ECIPP18 "HSDL index 18" ULONG Compu_HSDL_ECIPP18 0 0 0 4294967295 ECU_ADDRESS 0x01013B18 /end MEASUREMENT
/begin COMPU_METHOD Compu_HSDL_ECIPP18 " " RAT_FUNC "%.0" "-" COEFFS 0 1 0 0 0 1 /end COMPU_METHOD
/begin MEASUREMENT HSDL_ECIPP19 "HSDL index 19" ULONG Compu_HSDL_ECIPP19 0 0 0 4294967295 ECU_ADDRESS 0x01013B20 /end MEASUREMENT
/begin COMPU_METHOD Compu_HSDL_ECIPP19 " " RAT_FUNC "%.0" "-" COEFFS 0 1 0 0 0 1 /end COMPU_METHOD
/begin MEASUREMENT HSDL_ECIPP20 "HSDL index 20" ULONG Compu_HSDL_ECIPP20 0 0 0 4294967295 ECU_ADDRESS 0x01013B28 /end MEASUREMENT
/begin COMPU_METHOD Compu_HSDL_ECIPP20 " " RAT_FUNC "%.0" "-" COEFFS 0 1 0 0 0 1 /end COMPU_METHOD
/begin MEASUREMENT HSDL_ECIPP21 "HSDL index 21" ULONG Compu_HSDL_ECIPP21 0 0 0 4294967295 ECU_ADDRESS 0x01013B30 /end MEASUREMENT
/begin COMPU_METHOD Compu_HSDL_ECIPP21 " " RAT_FUNC "%.0" "-" COEFFS 0 1 0 0 0 1 /end COMPU_METHOD
/begin MEASUREMENT HSDL_ECIPP22 "HSDL index 22" ULONG Compu_HSDL_ECIPP22 0 0 0 4294967295 ECU_ADDRESS 0x01013B38 /end MEASUREMENT
/begin COMPU_METHOD Compu_HSDL_ECIPP22 " " RAT_FUNC "%.0" "-" COEFFS 0 1 0 0 0 1 /end COMPU_METHOD
/begin MEASUREMENT HSDL_ECIPP23 "HSDL index 23" ULONG Compu_HSDL_ECIPP23 0 0 0 4294967295 ECU_ADDRESS 0x01013B40 /end MEASUREMENT
/begin COMPU_METHOD Compu_HSDL_ECIPP23 " " RAT_FUNC "%.0" "-" COEFFS 0 1 0 0 0 1 /end COMPU_METHOD
/begin MEASUREMENT HSDL_ECIPP24 "HSDL index 24" ULONG Compu_HSDL_ECIPP24 0 0 0 4294967295 ECU_ADDRESS 0x01013B48 /end MEASUREMENT
/begin COMPU_METHOD Compu_HSDL_ECIPP24 " " RAT_FUNC "%.0" "-" COEFFS 0 1 0 0 0 1 /end COMPU_METHOD
/begin CHARACTERISTIC TWCdiag_OSC_drv_cyc "TWC OSC complete monitor interval" VALUE 0x001c8f65 /* @ECU_Address@TWCdiag_OSC_drv_cyc@0x01014F08@ */ ECIPP_ALIGNMENT_UBYTE 255 Compu_TWCdiag_OSC_drv_cyc 0 255 /end CHARACTERISTIC
/begin COMPU_METHOD Compu_TWCdiag_OSC_drv_cyc " " RAT_FUNC "%.0" "drive cycles" COEFFS 0 1 0 0 0 1 /end COMPU_METHOD
/begin MEASUREMENT TWCdiag_drive_cycles "TWC diagnostic drive cycle count" UBYTE Compu_TWCdiag_drive_cycles 0 0 0 255 ECU_ADDRESS 0x01014F10 /end MEASUREMENT
/begin COMPU_METHOD Compu_TWCdiag_drive_cycles " " RAT_FUNC "%.0" "drive cycles" COEFFS 0 1 0 0 0 1 /end COMPU_METHOD
/begin MEASUREMENT TWCdiag_comp_secs "TWC OSC last completion" ULONG Compu_TWCdiag_comp_secs 0 0 0 1193046.47083333 ECU_ADDRESS 0x01014F80 /end MEASUREMENT
/begin COMPU_METHOD Compu_TWCdiag_comp_secs " " RAT_FUNC "%.3" "hours" COEFFS 0 3600 0 0 0 1 /end COMPU_METHOD
/begin CHARACTERISTIC TWCdiag_OSC_period "TWC complete monitor interval" VALUE 0x001c43d8 /* @ECU_Address@TWCdiag_OSC_period@0x01014F88@ */ ECIPP_ALIGNMENT_ULONG 1193046 Compu_TWCdiag_OSC_period 0 1193046.47083333 /end CHARACTERISTIC
/begin COMPU_METHOD Compu_TWCdiag_OSC_period " " RAT_FUNC "%.3" "hours" COEFFS 0 3600 0 0 0 1 /end COMPU_METHOD
/begin MEASUREMENT TWCdiag_margin_dis "TWC diag. margin disabled{TWCdiag_margin_dis&0xff=0:No}{TWCdiag_margin_dis&0xff=1:Yes}" UBYTE TWCdiag_margin_dis_COMPU_VTAB 0 0 0 255 ECU_ADDRESS 0x01014F90 BIT_MASK 0xff /end MEASUREMENT
/begin COMPU_METHOD TWCdiag_margin_dis_COMPU_VTAB "Verbal Table" TAB_VERB "%.0" "list" COMPU_TAB_REF TWCdiag_margin_dis_COMPU_VTAB_REF /end COMPU_METHOD
/begin COMPU_VTAB TWCdiag_margin_dis_COMPU_VTAB_REF "Verbal Table" TAB_VERB 2 0 "No" 1 "Yes" DEFAULT_VALUE "UNKNOWN" /end COMPU_VTAB
/begin CHARACTERISTIC TWCdiag_FSO_dur_max "TWC fault max FSO duration" VALUE 0x001c8266 /* @ECU_Address@TWCdiag_FSO_dur_max@0x01015538@ */ ECIPP_ALIGNMENT_UWORD 65535 Compu_TWCdiag_FSO_dur_max 0 65535 /end CHARACTERISTIC
/begin COMPU_METHOD Compu_TWCdiag_FSO_dur_max " " RAT_FUNC "%.0" "sec" COEFFS 0 1 0 0 0 1 /end COMPU_METHOD
/begin CHARACTERISTIC CTMA_FSO_cold_AAT "Alt CTM FSO table Cold AAT" VALUE 0x001c6e46 /* @ECU_Address@CTMA_FSO_cold_AAT@0x01015540@ */ ECIPP_ALIGNMENT_UWORD 564 Compu_CTMA_FSO_cold_AAT -460 563.984375 /end CHARACTERISTIC
/begin COMPU_METHOD Compu_CTMA_FSO_cold_AAT " " RAT_FUNC "%.0" "deg F" COEFFS 0 64 29440 0 0 1 /end COMPU_METHOD
/begin CHARACTERISTIC CTMA_FSO_hot_AAT "Alt CTM FSO table Hot AAT" VALUE 0x001c6e4a /* @ECU_Address@CTMA_FSO_hot_AAT@0x01015548@ */ ECIPP_ALIGNMENT_UWORD 564 Compu_CTMA_FSO_hot_AAT -460 563.984375 /end CHARACTERISTIC
/begin COMPU_METHOD Compu_CTMA_FSO_hot_AAT " " RAT_FUNC "%.0" "deg F" COEFFS 0 64 29440 0 0 1 /end COMPU_METHOD
/begin CHARACTERISTIC CTMA_FSO_cold_CBT "Alt CTM FSO table CBT - Cold AAT" VALUE 0x001c6e48 /* @ECU_Address@CTMA_FSO_cold_CBT@0x01015550@ */ ECIPP_ALIGNMENT_UWORD 7732 Compu_CTMA_FSO_cold_CBT -460 7731.875 /end CHARACTERISTIC
/begin COMPU_METHOD Compu_CTMA_FSO_cold_CBT " " RAT_FUNC "%.0" "deg F" COEFFS 0 8 3680 0 0 1 /end COMPU_METHOD
/begin CHARACTERISTIC CTMA_FSO_hot_CBT "Alt CTM FSO table CBT - Hot AAT" VALUE 0x001c6e4c /* @ECU_Address@CTMA_FSO_hot_CBT@0x01015558@ */ ECIPP_ALIGNMENT_UWORD 7732 Compu_CTMA_FSO_hot_CBT -460 7731.875 /end CHARACTERISTIC
/begin COMPU_METHOD Compu_CTMA_FSO_hot_CBT " " RAT_FUNC "%.0" "deg F" COEFFS 0 8 3680 0 0 1 /end COMPU_METHOD
/begin COMPU_METHOD Compu_TCTM_mdot_a " " RAT_FUNC "%.1" "Mdot Air (g/sec)" COEFFS 0 64 0 0 0 1 /end COMPU_METHOD
/begin CHARACTERISTIC TCTM_Temp "CBT Gasoline SS Cal" CURVE 0x001C470C /* @ECU_Address@TCTM_Temp@0x0203C000@ */ ECIPP_ALIGNMENT_SWORD 3636 Compu_TCTM_Temp -4556 3635.875
 /begin AXIS_DESCR COM_AXIS NO_INPUT_QUANTITY Compu_TCTM_mdot_a 8 -512 511.984375 AXIS_PTS_REF TCTM_mdot_a /end AXIS_DESCR
/end CHARACTERISTIC
/begin AXIS_PTS TCTM_mdot_a " " 0x001C472C /* @ECU_Address@TCTM_mdot_a@0x0203B000@ */ NO_INPUT_QUANTITY ECIPP_Lookup_SWORD 0 Compu_TCTM_mdot_a 8 -512 511.984375 /end AXIS_PTS
/begin COMPU_METHOD Compu_TCTM_Temp " " RAT_FUNC "%.0" "CBT (deg F)" COEFFS 0 8 3680 0 0 1 /end COMPU_METHOD
/begin COMPU_METHOD Compu_TCTMA_mdot_a " " RAT_FUNC "%.1" "Mdot Air (g/sec)" COEFFS 0 64 0 0 0 1 /end COMPU_METHOD
/begin CHARACTERISTIC TCTMA_Temp "CBT Gaseous Fuel SS Cal" CURVE 0x001C46CC /* @ECU_Address@TCTMA_Temp@0x0207C000@ */ ECIPP_ALIGNMENT_SWORD 3636 Compu_TCTMA_Temp -4556 3635.875
 /begin AXIS_DESCR COM_AXIS NO_INPUT_QUANTITY Compu_TCTMA_mdot_a 8 -512 511.984375 AXIS_PTS_REF TCTMA_mdot_a /end AXIS_DESCR
/end CHARACTERISTIC
/begin AXIS_PTS TCTMA_mdot_a " " 0x001C46EC /* @ECU_Address@TCTMA_mdot_a@0x0207B000@ */ NO_INPUT_QUANTITY ECIPP_Lookup_SWORD 0 Compu_TCTMA_mdot_a 8 -512 511.984375 /end AXIS_PTS
/begin COMPU_METHOD Compu_TCTMA_Temp " " RAT_FUNC "%.0" "CBT (deg F)" COEFFS 0 8 3680 0 0 1 /end COMPU_METHOD
/begin COMPU_METHOD Compu_TICam_CAD_rpm " " RAT_FUNC "%.0" "Speed (rpm)" COEFFS 0 1 0 0 0 1 /end COMPU_METHOD
/begin COMPU_METHOD Compu_TICam_CAD_MAP " " RAT_FUNC "%.1" "MAP (psia)" COEFFS 0 256 0 0 0 1 /end COMPU_METHOD
/begin CHARACTERISTIC TICam_CAD_CAD "Intake Valve Timing" MAP 0x001C5140 /* @ECU_Address@TICam_CAD_CAD@0x02110000@ */ ECIPP_ALIGNMENT_SWORD 2048 Compu_TICam_CAD_CAD -2048 2047.9375
 /begin AXIS_DESCR COM_AXIS NO_INPUT_QUANTITY Compu_TICam_CAD_MAP 8 -128 127.99609375 AXIS_PTS_REF TICam_CAD_MAP /end AXIS_DESCR
 /begin AXIS_DESCR COM_AXIS NO_INPUT_QUANTITY Compu_TICam_CAD_rpm 8 -32768 32767 AXIS_PTS_REF TICam_CAD_rpm /end AXIS_DESCR
/end CHARACTERISTIC
/begin AXIS_PTS TICam_CAD_MAP " " 0x001C51C0 /* @ECU_Address@TICam_CAD_MAP@0x0210F000@ */ NO_INPUT_QUANTITY ECIPP_Lookup_SWORD 0 Compu_TICam_CAD_MAP 8 -128 127.99609375 /end AXIS_PTS
/begin AXIS_PTS TICam_CAD_rpm " " 0x001C51D0 /* @ECU_Address@TICam_CAD_rpm@0x0210E000@ */ NO_INPUT_QUANTITY ECIPP_Lookup_SWORD 0 Compu_TICam_CAD_rpm 8 -32768 32767 /end AXIS_PTS
/begin COMPU_METHOD Compu_TICam_CAD_CAD "" RAT_FUNC "%.1" "Open CAD BTDC" COEFFS 0 16 0 0 0 1 /end COMPU_METHOD
/begin COMPU_METHOD Compu_TECam_CAD_rpm " " RAT_FUNC "%.0" "Speed (rpm)" COEFFS 0 1 0 0 0 1 /end COMPU_METHOD
/begin COMPU_METHOD Compu_TECam_CAD_MAP " " RAT_FUNC "%.1" "MAP (psia)" COEFFS 0 256 0 0 0 1 /end COMPU_METHOD
/begin CHARACTERISTIC TECam_CAD_CAD "Exhaust Valve Timing" MAP 0x001C4A5C /* @ECU_Address@TECam_CAD_CAD@0x02113000@ */ ECIPP_ALIGNMENT_SWORD 2048 Compu_TECam_CAD_CAD -2048 2047.9375
 /begin AXIS_DESCR COM_AXIS NO_INPUT_QUANTITY Compu_TECam_CAD_MAP 8 -128 127.99609375 AXIS_PTS_REF TECam_CAD_MAP /end AXIS_DESCR
 /begin AXIS_DESCR COM_AXIS NO_INPUT_QUANTITY Compu_TECam_CAD_rpm 8 -32768 32767 AXIS_PTS_REF TECam_CAD_rpm /end AXIS_DESCR
/end CHARACTERISTIC
/begin AXIS_PTS TECam_CAD_MAP " " 0x001C4ADC /* @ECU_Address@TECam_CAD_MAP@0x02112000@ */ NO_INPUT_QUANTITY ECIPP_Lookup_SWORD 0 Compu_TECam_CAD_MAP 8 -128 127.99609375 /end AXIS_PTS
/begin AXIS_PTS TECam_CAD_rpm " " 0x001C4AEC /* @ECU_Address@TECam_CAD_rpm@0x02111000@ */ NO_INPUT_QUANTITY ECIPP_Lookup_SWORD 0 Compu_TECam_CAD_rpm 8 -32768 32767 /end AXIS_PTS
/begin COMPU_METHOD Compu_TECam_CAD_CAD "" RAT_FUNC "%.1" "Close CAD BTDC" COEFFS 0 16 0 0 0 1 /end COMPU_METHOD
/begin CHARACTERISTIC TCTM_tau "CBT Gasoline Tau" CURVE 0x001C473C /* @ECU_Address@TCTM_tau@0x0211D000@ */ ECIPP_ALIGNMENT_SWORD 524 Compu_TCTM_tau -524.288 524.272
 /begin AXIS_DESCR COM_AXIS NO_INPUT_QUANTITY Compu_TCTM_mdot_a 8 -512 511.984375 AXIS_PTS_REF TCTM_mdot_a /end AXIS_DESCR
/end CHARACTERISTIC
/begin COMPU_METHOD Compu_TCTM_tau " " RAT_FUNC "%.1" "Tau (sec)" COEFFS 0 62.5 0 0 0 1 /end COMPU_METHOD
/begin CHARACTERISTIC TCTM_dppredT "CBT Gasoline pre-cat dphi/dT" CURVE 0x001C471C /* @ECU_Address@TCTM_dppredT@0x0211E000@ */ ECIPP_ALIGNMENT_SWORD 0 Compu_TCTM_dppredT -0.09765625 9.76532697677612E-02
 /begin AXIS_DESCR COM_AXIS NO_INPUT_QUANTITY Compu_TCTM_mdot_a 8 -512 511.984375 AXIS_PTS_REF TCTM_mdot_a /end AXIS_DESCR
/end CHARACTERISTIC
/begin COMPU_METHOD Compu_TCTM_dppredT " " RAT_FUNC "%.4" "dphi/100 F" COEFFS 0 335544.32 0 0 0 1 /end COMPU_METHOD
/begin CHARACTERISTIC TCTMA_tau "CBT Gaseous Tau" CURVE 0x001C46FC /* @ECU_Address@TCTMA_tau@0x0211F000@ */ ECIPP_ALIGNMENT_SWORD 524 Compu_TCTMA_tau -524.288 524.272
 /begin AXIS_DESCR COM_AXIS NO_INPUT_QUANTITY Compu_TCTMA_mdot_a 8 -512 511.984375 AXIS_PTS_REF TCTMA_mdot_a /end AXIS_DESCR
/end CHARACTERISTIC
/begin COMPU_METHOD Compu_TCTMA_tau " " RAT_FUNC "%.1" "Tau (sec)" COEFFS 0 62.5 0 0 0 1 /end COMPU_METHOD
/begin CHARACTERISTIC TCTMA_dppredT "CBT Gaseous pre-cat dphi/dT" CURVE 0x001C46DC /* @ECU_Address@TCTMA_dppredT@0x02120000@ */ ECIPP_ALIGNMENT_SWORD 0 Compu_TCTMA_dppredT -0.09765625 9.76532697677612E-02
 /begin AXIS_DESCR COM_AXIS NO_INPUT_QUANTITY Compu_TCTMA_mdot_a 8 -512 511.984375 AXIS_PTS_REF TCTMA_mdot_a /end AXIS_DESCR
/end CHARACTERISTIC
/begin COMPU_METHOD Compu_TCTMA_dppredT " " RAT_FUNC "%.4" "dphi/100 F" COEFFS 0 335544.32 0 0 0 1 /end COMPU_METHOD
/begin MEASUREMENT sim_fault_ndx "Simulated fault index 1" UWORD Compu_sim_fault_ndx 0 0 0 65535 ECU_ADDRESS 0x02203000 MATRIX_DIM 5 1 1 /end MEASUREMENT
/begin COMPU_METHOD Compu_sim_fault_ndx " " RAT_FUNC "%.0" "-" COEFFS 0 1 0 0 0 1 /end COMPU_METHOD
/begin COMPU_METHOD Compu_TCam_strt_ECT " " RAT_FUNC "%.1" "ECT (deg F)" COEFFS 0 32 14720 0 0 1 /end COMPU_METHOD
/begin CHARACTERISTIC TCam_strt_tex "Cam Engine-Starting Additional Timeout" CURVE 0x001C4964 /* @ECU_Address@TCam_strt_tex@0x02262000@ */ ECIPP_ALIGNMENT_SWORD 524 Compu_TCam_strt_tex -524.288 524.272
 /begin AXIS_DESCR COM_AXIS NO_INPUT_QUANTITY Compu_TCam_strt_ECT 4 -1484 563.96875 AXIS_PTS_REF TCam_strt_ECT /end AXIS_DESCR
/end CHARACTERISTIC
/begin AXIS_PTS TCam_strt_ECT " " 0x001C495C /* @ECU_Address@TCam_strt_ECT@0x02261000@ */ NO_INPUT_QUANTITY ECIPP_Lookup_SWORD 0 Compu_TCam_strt_ECT 4 -1484 563.96875 /end AXIS_PTS
/begin COMPU_METHOD Compu_TCam_strt_tex " " RAT_FUNC "%.2" "Additional Timeout (sec)" COEFFS 0 62.5 0 0 0 1 /end COMPU_METHOD
/begin MEASUREMENT PAUX "Auxilary pressure 1" UWORD Compu_PAUX 0 0 0 255.99609375 ECU_ADDRESS 0x0234C000 MATRIX_DIM 16 1 1 /end MEASUREMENT
/begin COMPU_METHOD Compu_PAUX " " RAT_FUNC "%.2" "psi" COEFFS 0 256 0 0 0 1 /end COMPU_METHOD
/begin MEASUREMENT TAUX "Auxilary temperature 1" UWORD Compu_TAUX 0 0 -459.67 7732.205 ECU_ADDRESS 0x0234D000 MATRIX_DIM 24 1 1 /end MEASUREMENT
/begin COMPU_METHOD Compu_TAUX " " RAT_FUNC "%.1" "deg F" COEFFS 0 8 3677.36 0 0 1 /end COMPU_METHOD
/begin MEASUREMENT STR_HSDL_custom_tag1 "HSDL custom tag 1" UBYTE Compu_ECIPP_STRINGS 0 0 0 255 ECU_ADDRESS 0x02520000 MATRIX_DIM 19 1 1 /end MEASUREMENT
/begin MEASUREMENT STR_HSDL_custom_tag2 "HSDL custom tag 2" UBYTE Compu_ECIPP_STRINGS 0 0 0 255 ECU_ADDRESS 0x02521000 MATRIX_DIM 19 1 1 /end MEASUREMENT
/begin MEASUREMENT STR_HSDL_custom_tag3 "HSDL custom tag 3" UBYTE Compu_ECIPP_STRINGS 0 0 0 255 ECU_ADDRESS 0x02522000 MATRIX_DIM 19 1 1 /end MEASUREMENT
/begin MEASUREMENT STR_HSDL_custom_tag4 "HSDL custom tag 4" UBYTE Compu_ECIPP_STRINGS 0 0 0 255 ECU_ADDRESS 0x02523000 MATRIX_DIM 19 1 1 /end MEASUREMENT
/begin CHARACTERISTIC TCTMA_FSO_cold_tau "Gaseous FSO CBT Tau - Cold AAT" CURVE 0x001C8048 /* @ECU_Address@TCTMA_FSO_cold_tau@0x026E6000@ */ ECIPP_ALIGNMENT_UWORD 1049 Compu_TCTMA_FSO_cold_tau 0 1048.56
 /begin AXIS_DESCR COM_AXIS NO_INPUT_QUANTITY Compu_TCTMA_mdot_a 8 -512 511.984375 AXIS_PTS_REF TCTMA_mdot_a /end AXIS_DESCR
/end CHARACTERISTIC
/begin COMPU_METHOD Compu_TCTMA_FSO_cold_tau " " RAT_FUNC "%.0" "Tau (sec)" COEFFS 0 62.5 0 0 0 1 /end COMPU_METHOD
/begin CHARACTERISTIC TCTMA_FSO_hot_tau "Gaseous FSO CBT Tau - Hot AAT" CURVE 0x001C8058 /* @ECU_Address@TCTMA_FSO_hot_tau@0x026E7000@ */ ECIPP_ALIGNMENT_UWORD 1049 Compu_TCTMA_FSO_hot_tau 0 1048.56
 /begin AXIS_DESCR COM_AXIS NO_INPUT_QUANTITY Compu_TCTMA_mdot_a 8 -512 511.984375 AXIS_PTS_REF TCTMA_mdot_a /end AXIS_DESCR
/end CHARACTERISTIC
/begin COMPU_METHOD Compu_TCTMA_FSO_hot_tau " " RAT_FUNC "%.0" "Tau (sec)" COEFFS 0 62.5 0 0 0 1 /end COMPU_METHOD
/begin GROUP EC_CalTools "ECONTROLS" ROOT
 /begin REF_CHARACTERISTIC FauxAcal_LP_tau TAUX_dT1_ndx1 TAUX_dT1_ndx2 TAUX_dT2_ndx1 TAUX_dT2_ndx2 PAUX_dP1_ndx1 PAUX_dP1_ndx2 PAUX_dP2_ndx1 PAUX_dP2_ndx2 /end REF_CHARACTERISTIC
 /begin REF_MEASUREMENT run_tmr_sec brake_open_released manual_ext_pwr sim_engine_mode simulation_key sim_fault_latch sim_fault_mode sim_fault_prohibit CAN_Rx_tout_add calibration_key brake_fault DBW_toggle_cmd1 DBW_toggle_cmd2 DBW_toggle_ena DBW_toggle_ms FPP_calmode_ena FPP_calmode_latch FPP_calmode_pct1 FPP_calmode_pct2 FPP_calmode_pct3 FPP_calmode_pct4 PAUX_LP_tau TAUX_LP_tau HBA_toggle_cmd1 HBA_toggle_cmd2 HBA_toggle_ena HBA_toggle_ms HBB_toggle_cmd1 HBB_toggle_cmd2 HBB_toggle_ena HBB_toggle_ms bst_WGP_toggle_P1 bst_WGP_toggle_P2 bst_WGP_toggle_ena bst_WGP_toggle_ms bst_TIP_toggle_P1 bst_TIP_toggle_P2 bst_TIP_toggle_ena bst_TIP_toggle_ms FPP_toggle_ena FPP_toggle_ms FAUX1_units FAUX2_units FAUX1_volts FAUX2_volts FAUX1 FAUX2 TAUX_dT1_delta TAUX_dT2_delta PAUX_dP1_delta PAUX_dP2_delta HSDL_samp_mode HSDL_status HSDL_ECIPP1 HSDL_ECIPP2 HSDL_ECIPP3 HSDL_ECIPP4 HSDL_post_pct HSDL_post_cnt HSDL_trig_ndx HSDL_samp_remain HSDL_reset HSDL_forcetrig HSDL_samp_rqst HSDL_buffer_size sim_fault_context sim_fault_calls sim_entry_cond_valid HSDL_samp_skip HSDL_custom_min1 HSDL_custom_min2 HSDL_custom_min3 HSDL_custom_min4 HSDL_custom_max1 HSDL_custom_max2 HSDL_custom_max3 HSDL_custom_max4 sim_fsys_action sim_fsys_state HSDL_at_mode HSDL_at_ecipp_index HSDL_at_target_val HSDL_at_target_type sim_fsys_adjust sim_fsys_set HSDL_buffer_sizerqst DLOG_base_ptr HSDL_pack_mode HSDL_samp_interval HSDL_entries HSDL_ECIPP5 HSDL_ECIPP6 HSDL_ECIPP7 HSDL_ECIPP8 HSDL_ECIPP9 HSDL_ECIPP10 HSDL_ECIPP11 HSDL_ECIPP12 HSDL_ECIPP13 HSDL_ECIPP14 HSDL_ECIPP15 HSDL_ECIPP16 HSDL_ECIPP17 HSDL_ECIPP18 HSDL_ECIPP19 HSDL_ECIPP20 HSDL_ECIPP21 HSDL_ECIPP22 HSDL_ECIPP23 HSDL_ECIPP24 sim_fault_ndx PAUX TAUX STR_HSDL_custom_tag1 STR_HSDL_custom_tag2 STR_HSDL_custom_tag3 STR_HSDL_custom_tag4 /end REF_MEASUREMENT
/end GROUP
/begin GROUP EC_Cam "ECONTROLS" ROOT
 /begin REF_CHARACTERISTIC ICam_PWM_taud ECam_PWM_taud ICam_timing_ctrl ECam_timing_ctrl ICam_I_min ICam_I_max ECam_I_min ECam_I_max ICam_coil_Inom ECam_coil_Inom ICam_Kp ECam_Kp ICam_Ki ECam_Ki Cam_strt_I Cam_strt_tout Cam_pin_ena Cam_pin_tout Tcambmp_dur Tcambmp_I Tcambmp_keyon Tcambmp_auto Camrat_ena Camrat_pulse_cnt Camrat_hi_time Camrat_lo_time Camrat_hi_start_I Camrat_hi_end_I Camrat_lo_I Camini_slew_tout ECam_control_cal TICam_CAD_CAD TECam_CAD_CAD TCam_strt_tex /end REF_CHARACTERISTIC
 /begin REF_MEASUREMENT spk_adv Phi_cmd ICam_timing_a ECam_timing_a spk_off_global Phi_global_offset ICam_samp_BTDC ECam_samp_BTDC ICam_timing_d ECam_timing_d ICam_control ICam_PWM_DC ECam_control ECam_PWM_DC ICam_PWM_mode ECam_PWM_mode ICam_I_acc ICam_coil_Id ICam_coil_R ECam_I_acc ECam_coil_Id ECam_coil_R Cam_strt_textra IC_pin_pulse_try EC_pin_pulse_try IC_pin_pulse_arm EC_pin_pulse_arm IC_pin_pulse_state EC_pin_pulse_state /end REF_MEASUREMENT
/end GROUP
/begin GROUP EC_Catalyst "ECONTROLS" ROOT
 /begin REF_CHARACTERISTIC CTM_enr CTM_adv CTM_tau CTM_init CTM_finish CTM_ena CTMA_enr CTMA_adv CTMA_tau CTMA_init CTMA_finish CTM_CL_ena CTM_CL_space CTM_CL_ramp CTM_CL_UL CTMA_CL_ena CTMA_CL_space CTMA_CL_ramp CTMA_CL_UL CTM_phi_lim CTMA_phi_lim CTM_CL_tgEGO CTM_CL_tgphi CTM_CL_forcewt CTMA_CL_tgEGO CTMA_CL_tgphi CTMA_CL_forcewt CL_CM_min_RMS CLLP_CM_min_RMS CLNG_CM_min_RMS CL_CM_waveRMSatt CLLP_CM_waveRMSatt CLNG_CM_waveRMSatt CL_CM_preRMSatt CLLP_CM_preRMSatt CLNG_CM_preRMSatt CTM_tau_source CTMA_tau_source CATdP_ena EBP_ena EBP_tau CATdP_P_select CATdP_tau CAT1_ena CAT2_ena CTM_FSO_mode CTM_FSO_CBT CTM_FSO_tau CTMA_FSO_mode CTMA_FSO_CBT CTMA_FSO_tau TWCmod_OSC TWCmod_aL TWCmod_aR TWCmod_cL TWCmod_cR TWCdiag_mdot_min TWCdiag_ECT_min TWCdiag_CBT_min TWCdiag_phi_d TWCdiag_phi_pst_thld TWCdiag_phi_pst_lean TWCdiag_tlean_min TWCdiag_tmon_max TWCdiag_max_events TWCdiag_K_norm TWCdiag_ena TWCdiag_cat_temp TWCdiag_OSC_min TWCdiag_OSC_max CBT_taustopped TWCdiag_phi_d_app TWCdiag_pst_rich_rst TWCmod_OSC_error_Kp TWCdiag_OSC_marg TWCdiag_OSC_drv_cyc TWCdiag_OSC_period TWCdiag_FSO_dur_max CTMA_FSO_cold_AAT CTMA_FSO_hot_AAT CTMA_FSO_cold_CBT CTMA_FSO_hot_CBT TCTM_Temp TCTMA_Temp TCTM_tau TCTM_dppredT TCTMA_tau TCTMA_dppredT TCTMA_FSO_cold_tau TCTMA_FSO_hot_tau /end REF_CHARACTERISTIC
 /begin REF_MEASUREMENT spk_adv Phi_cmd mdot_a_ports mdot_f_ports CL_BM1 A_BM1 CL_BM2 A_BM2 spk_off_global CBT CTM_enrich_mod CTM_advance_mod Phi_global_offset EBP_gauge CTM_CL_BM CLp_wave_RMS CM1_RMScomp EGO1_phiFB_RMS EGO2_phiFB_RMS EGO3_phiFB_RMS CM1_RMSsrc EGO4_phiFB_RMS CM2_RMSsrc CL2_wave_RMS CM2_RMScomp CBT_ss CBT_tauactv CTM_dppredT CTM_dppre CATdP EBP_raw CATdP_raw EBP_acc CB1pre_name CB1pst_name CB2pre_name CB2pst_name CB1pre_phiFB_RMS CB1pst_phiFB_RMS CB2pre_phiFB_RMS CB2pst_phiFB_RMS CAT_Tin CAT_Tout TWCmod_ROL TWCmod_rho TWCmod_dROLdt TWCmod_phi_post TWCdiag_state TWCdiag_monitor_ms TWCdiag_event_cntr TWCdiag_OSC_est TWCmod_ROL_avg TWCdiag_OSC_est_avg TWCmod_ROL_dly TWCdiag_drive_cycles TWCdiag_comp_secs TWCdiag_margin_dis /end REF_MEASUREMENT
/end GROUP
/begin GROUP EC_CLCalGsln "ECONTROLS" ROOT
 /begin REF_MEASUREMENT Phi_cmd CL_BM1 A_BM1 CL_BM2 A_BM2 CB1pre_name CB1pst_name CB2pre_name CB2pst_name /end REF_MEASUREMENT
/end GROUP
/begin GROUP EC_CLCalLP "ECONTROLS" ROOT /begin REF_MEASUREMENT Phi_cmd CL_BM1 A_BM1 CB1pre_name CB1pst_name CB2pre_name /end REF_MEASUREMENT /end GROUP
/begin GROUP EC_CLCalNG "ECONTROLS" ROOT /begin REF_MEASUREMENT Phi_cmd CL_BM1 A_BM1 CB1pre_name CB1pst_name CB2pre_name /end REF_MEASUREMENT /end GROUP
/begin GROUP EC_Comms "ECONTROLS" ROOT /begin REF_MEASUREMENT brake_open_released brake_fault /end REF_MEASUREMENT /end GROUP
/begin GROUP EC_ConfigApp "ECONTROLS" ROOT /begin REF_MEASUREMENT mdot_f_ports brake_open_released brake_fault /end REF_MEASUREMENT /end GROUP
/begin GROUP EC_ConfigEng "ECONTROLS" ROOT /begin REF_MEASUREMENT brake_open_released brake_fault /end REF_MEASUREMENT /end GROUP
/begin GROUP EC_EGOConfig "ECONTROLS" ROOT
 /begin REF_MEASUREMENT run_tmr_sec CB1pre_name CB1pst_name CB2pre_name CB2pst_name /end REF_MEASUREMENT
/end GROUP
/begin GROUP EC_EGRAux "ECONTROLS" ROOT /begin REF_MEASUREMENT spk_adv spk_off_global /end REF_MEASUREMENT /end GROUP
/begin GROUP EC_EGRCommand "ECONTROLS" ROOT /begin REF_MEASUREMENT spk_adv spk_off_global /end REF_MEASUREMENT /end GROUP
/begin GROUP EC_EGRControl "ECONTROLS" ROOT /begin REF_MEASUREMENT spk_adv spk_off_global /end REF_MEASUREMENT /end GROUP
/begin GROUP EC_Faults "ECONTROLS" ROOT
 /begin REF_MEASUREMENT spk_adv CL_BM1 A_BM1 CL_BM2 A_BM2 brake_open_released manual_ext_pwr brake_fault /end REF_MEASUREMENT
/end GROUP
/begin GROUP EC_Fuel "ECONTROLS" ROOT /begin REF_MEASUREMENT mdot_f_ports /end REF_MEASUREMENT /end GROUP
/begin GROUP EC_FuelSecond "ECONTROLS" ROOT /begin REF_MEASUREMENT mdot_f_ports /end REF_MEASUREMENT /end GROUP
/begin GROUP EC_GovCal "ECONTROLS" ROOT /begin REF_MEASUREMENT spk_adv brake_open_released brake_fault /end REF_MEASUREMENT /end GROUP
/begin GROUP EC_GovCalAlt "ECONTROLS" ROOT /begin REF_MEASUREMENT spk_adv brake_open_released brake_fault /end REF_MEASUREMENT /end GROUP
/begin GROUP EC_HDService "ECONTROLS" ROOT /begin REF_CHARACTERISTIC TWCmod_OSC /end REF_CHARACTERISTIC /begin REF_MEASUREMENT spk_adv Phi_cmd /end REF_MEASUREMENT /end GROUP
/begin GROUP EC_IOMap "ECONTROLS" ROOT /begin REF_MEASUREMENT PAUX TAUX /end REF_MEASUREMENT /end GROUP
/begin GROUP EC_Knock "ECONTROLS" ROOT /begin REF_MEASUREMENT spk_adv spk_off_global CTM_advance_mod /end REF_MEASUREMENT /end GROUP
/begin GROUP EC_LDService "ECONTROLS" ROOT /begin REF_MEASUREMENT spk_adv CL_BM1 A_BM1 manual_ext_pwr /end REF_MEASUREMENT /end GROUP
/begin GROUP EC_LEService "ECONTROLS" ROOT /begin REF_MEASUREMENT spk_adv Phi_cmd CL_BM1 A_BM1 CAT_Tin CAT_Tout PAUX TAUX /end REF_MEASUREMENT /end GROUP
/begin GROUP EC_Marine "ECONTROLS" ROOT /begin REF_MEASUREMENT spk_adv FAUX1_units /end REF_MEASUREMENT /end GROUP
/begin GROUP EC_Misfire "ECONTROLS" ROOT /begin REF_MEASUREMENT run_tmr_sec /end REF_MEASUREMENT /end GROUP
/begin GROUP EC_PhiGsln "ECONTROLS" ROOT
 /begin REF_MEASUREMENT spk_adv Phi_cmd CL_BM1 A_BM1 CL_BM2 A_BM2 spk_off_global CTM_enrich_mod Phi_global_offset /end REF_MEASUREMENT
/end GROUP
/begin GROUP EC_PhiLP "ECONTROLS" ROOT /begin REF_MEASUREMENT Phi_cmd CL_BM1 A_BM1 /end REF_MEASUREMENT /end GROUP
/begin GROUP EC_PhiNG "ECONTROLS" ROOT /begin REF_MEASUREMENT Phi_cmd CL_BM1 A_BM1 Phi_global_offset /end REF_MEASUREMENT /end GROUP
/begin GROUP EC_PowerMon "ECONTROLS" ROOT /begin REF_MEASUREMENT spk_adv Phi_cmd /end REF_MEASUREMENT /end GROUP
/begin GROUP EC_Service1 "ECONTROLS" ROOT /begin REF_MEASUREMENT spk_adv /end REF_MEASUREMENT /end GROUP
/begin GROUP EC_Service2 "ECONTROLS" ROOT /begin REF_MEASUREMENT spk_adv CL_BM1 A_BM1 /end REF_MEASUREMENT /end GROUP
/begin GROUP EC_Simulink "ECONTROLS" ROOT /begin REF_MEASUREMENT spk_adv /end REF_MEASUREMENT /end GROUP
/begin GROUP EC_SparkCal "ECONTROLS" ROOT /begin REF_MEASUREMENT spk_adv spk_off_global CTM_advance_mod /end REF_MEASUREMENT /end GROUP
/begin GROUP EC_SparkCalLP "ECONTROLS" ROOT /begin REF_MEASUREMENT spk_adv spk_off_global CTM_advance_mod /end REF_MEASUREMENT /end GROUP
/begin GROUP EC_SparkCalNG "ECONTROLS" ROOT /begin REF_MEASUREMENT spk_adv spk_off_global CTM_advance_mod /end REF_MEASUREMENT /end GROUP
/begin GROUP EC_SparkCD "ECONTROLS" ROOT /begin REF_MEASUREMENT spk_adv /end REF_MEASUREMENT /end GROUP
/begin GROUP EC_SparkOfst "ECONTROLS" ROOT /begin REF_MEASUREMENT spk_adv spk_off_global CTM_advance_mod /end REF_MEASUREMENT /end GROUP
/begin GROUP EC_Starting "ECONTROLS" ROOT /begin REF_MEASUREMENT spk_adv run_tmr_sec /end REF_MEASUREMENT /end GROUP
/begin GROUP EC_Tests "ECONTROLS" ROOT /begin REF_CHARACTERISTIC Tcambmp_dur Tcambmp_I /end REF_CHARACTERISTIC /begin REF_MEASUREMENT spk_adv CL_BM1 manual_ext_pwr /end REF_MEASUREMENT /end GROUP
/begin GROUP EC_TranCal "ECONTROLS" ROOT
 /begin REF_MEASUREMENT spk_adv mdot_f_ports run_tmr_sec CB1pre_name CB1pst_name CB2pre_name CB2pst_name /end REF_MEASUREMENT
/end GROUP
/begin GROUP EC_VECal "ECONTROLS" ROOT
 /begin REF_MEASUREMENT spk_adv Phi_cmd mdot_a_ports mdot_f_ports CL_BM1 A_BM1 CL_BM2 A_BM2 spk_off_global Phi_global_offset EBP_gauge CB1pre_name CB1pst_name CB2pre_name CB2pst_name /end REF_MEASUREMENT
/end GROUP
/end MODULE
/end PROJECT
