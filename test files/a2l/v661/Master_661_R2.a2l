ASAP2_VERSION 1 61
/begin PROJECT Econtrols_4G "4G Test"
/begin HEADER "4G A2L Configuration" PROJECT_NO EControls4G /* config for version control */ VERSION "$Revision: 82130 $:" /* config for version control */ /end HEADER
/begin MODULE EControls_4G_SH2A "EControls 4G"
/begin MOD_COMMON "" DEPOSIT ABSOLUTE BYTE_ORDER MSB_FIRST /end MOD_COMMON
/* Define the Record Layouts */
/begin RECORD_LAYOUT ECIPP_ALIGNMENT_UBYTE FNC_VALUES 1 UBYTE COLUMN_DIR DIRECT /end RECORD_LAYOUT
/begin RECORD_LAYOUT ECIPP_ALIGNMENT_UWORD FNC_VALUES 1 UWORD COLUMN_DIR DIRECT /end RECORD_LAYOUT
/begin RECORD_LAYOUT ECIPP_ALIGNMENT_ULONG FNC_VALUES 1 ULONG COLUMN_DIR DIRECT /end RECORD_LAYOUT
/begin RECORD_LAYOUT ECIPP_ALIGNMENT_FLOAT32_IEEE FNC_VALUES 1 FLOAT32_IEEE COLUMN_DIR DIRECT /end RECORD_LAYOUT
/begin COMPU_METHOD Compu_IDENTITY "Discrete Values " /* Identifier */ IDENTICAL "%.0" /* Format */ "-" /* Units */ /end COMPU_METHOD
/begin CHARACTERISTIC FCdc4_MJ_intF_circ "FCtl_DTC_0x04(139)" VALUE 0x001E41AC /* @ECU_Address@FCtl_DTC_0x04@0x024C4116@ */ ECIPP_ALIGNMENT_UWORD 65535 Compu_IDENTITY 0 65535 PHYS_UNIT "System ID + DTC" /end CHARACTERISTIC
/begin CHARACTERISTIC FCdc4_MJ_intF_comm "FCtl_DTC_0x04(140)" VALUE 0x001E41AE /* @ECU_Address@FCtl_DTC_0x04@0x024C4118@ */ ECIPP_ALIGNMENT_UWORD 65535 Compu_IDENTITY 0 65535 PHYS_UNIT "System ID + DTC" /end CHARACTERISTIC
/begin CHARACTERISTIC FCdc4_MJ_intF_Vhi "FCtl_DTC_0x04(136)" VALUE 0x001E41A6 /* @ECU_Address@FCtl_DTC_0x04@0x024C4110@ */ ECIPP_ALIGNMENT_UWORD 65535 Compu_IDENTITY 0 65535 PHYS_UNIT "System ID + DTC" /end CHARACTERISTIC
/begin CHARACTERISTIC FCdc4_MJ_intF_Vlo "FCtl_DTC_0x04(137)" VALUE 0x001E41A8 /* @ECU_Address@FCtl_DTC_0x04@0x024C4112@ */ ECIPP_ALIGNMENT_UWORD 65535 Compu_IDENTITY 0 65535 PHYS_UNIT "System ID + DTC" /end CHARACTERISTIC
/begin CHARACTERISTIC FCdc4_MJ_Pe_HiExp "FCtl_DTC_0x04(133)" VALUE 0x001E41A0 /* @ECU_Address@FCtl_DTC_0x04@0x024C410A@ */ ECIPP_ALIGNMENT_UWORD 65535 Compu_IDENTITY 0 65535 PHYS_UNIT "System ID + DTC" /end CHARACTERISTIC
/begin CHARACTERISTIC FCdc4_MJ_Pe_LoExp "FCtl_DTC_0x04(134)" VALUE 0x001E41A2 /* @ECU_Address@FCtl_DTC_0x04@0x024C410C@ */ ECIPP_ALIGNMENT_UWORD 65535 Compu_IDENTITY 0 65535 PHYS_UNIT "System ID + DTC" /end CHARACTERISTIC
/begin CHARACTERISTIC FCdc4_MJ2_comm_tout "FCtl_DTC_0x04(726)" VALUE 0x001E4642 /* @ECU_Address@FCtl_DTC_0x04@0x024C45AC@ */ ECIPP_ALIGNMENT_UWORD 65535 Compu_IDENTITY 0 65535 PHYS_UNIT "System ID + DTC" /end CHARACTERISTIC
/begin CHARACTERISTIC FCdc4_MJ2_intF_act "FCtl_DTC_0x04(729)" VALUE 0x001E4648 /* @ECU_Address@FCtl_DTC_0x04@0x024C45B2@ */ ECIPP_ALIGNMENT_UWORD 65535 Compu_IDENTITY 0 65535 PHYS_UNIT "System ID + DTC" /end CHARACTERISTIC
/begin CHARACTERISTIC FCdc4_MJ2_intF_circ "FCtl_DTC_0x04(730)" VALUE 0x001E464A /* @ECU_Address@FCtl_DTC_0x04@0x024C45B4@ */ ECIPP_ALIGNMENT_UWORD 65535 Compu_IDENTITY 0 65535 PHYS_UNIT "System ID + DTC" /end CHARACTERISTIC
/begin CHARACTERISTIC FCdc4_MJ2_intF_comm "FCtl_DTC_0x04(731)" VALUE 0x001E464C /* @ECU_Address@FCtl_DTC_0x04@0x024C45B6@ */ ECIPP_ALIGNMENT_UWORD 65535 Compu_IDENTITY 0 65535 PHYS_UNIT "System ID + DTC" /end CHARACTERISTIC
/begin CHARACTERISTIC FCdc4_MJ2_intF_Vhi "FCtl_DTC_0x04(727)" VALUE 0x001E4644 /* @ECU_Address@FCtl_DTC_0x04@0x024C45AE@ */ ECIPP_ALIGNMENT_UWORD 65535 Compu_IDENTITY 0 65535 PHYS_UNIT "System ID + DTC" /end CHARACTERISTIC
/begin CHARACTERISTIC FCdc4_MJ2_intF_Vlo "FCtl_DTC_0x04(728)" VALUE 0x001E4646 /* @ECU_Address@FCtl_DTC_0x04@0x024C45B0@ */ ECIPP_ALIGNMENT_UWORD 65535 Compu_IDENTITY 0 65535 PHYS_UNIT "System ID + DTC" /end CHARACTERISTIC
/begin CHARACTERISTIC FCdc4_MJ2_Pe_HiExp "FCtl_DTC_0x04(724)" VALUE 0x001E463E /* @ECU_Address@FCtl_DTC_0x04@0x024C45A8@ */ ECIPP_ALIGNMENT_UWORD 65535 Compu_IDENTITY 0 65535 PHYS_UNIT "System ID + DTC" /end CHARACTERISTIC
/begin CHARACTERISTIC FCdc4_MJ2_Pe_LoExp "FCtl_DTC_0x04(725)" VALUE 0x001E4640 /* @ECU_Address@FCtl_DTC_0x04@0x024C45AA@ */ ECIPP_ALIGNMENT_UWORD 65535 Compu_IDENTITY 0 65535 PHYS_UNIT "System ID + DTC" /end CHARACTERISTIC
/begin CHARACTERISTIC FCdc4_NOx_hi "FCtl_DTC_0x04(793)" VALUE 0x001E46C8 /* @ECU_Address@FCtl_DTC_0x04@0x024C4632@ */ ECIPP_ALIGNMENT_UWORD 65535 Compu_IDENTITY 0 65535 PHYS_UNIT "System ID + DTC" /end CHARACTERISTIC
/begin CHARACTERISTIC FCdc4_OilP_comm_lost "FCtl_DTC_0x04(1045)" VALUE 0x001E48C0 /* @ECU_Address@FCtl_DTC_0x04@0x024C482A@ */ ECIPP_ALIGNMENT_UWORD 65535 Compu_IDENTITY 0 65535 PHYS_UNIT "System ID + DTC" /end CHARACTERISTIC
/begin CHARACTERISTIC FCdc4_OilP_hiP "FCtl_DTC_0x04(149)" VALUE 0x001E41C0 /* @ECU_Address@FCtl_DTC_0x04@0x024C412A@ */ ECIPP_ALIGNMENT_UWORD 65535 Compu_IDENTITY 0 65535 PHYS_UNIT "System ID + DTC" /end CHARACTERISTIC
/begin CHARACTERISTIC FCdc4_OilP_loP "FCtl_DTC_0x04(148)" VALUE 0x001E41BE /* @ECU_Address@FCtl_DTC_0x04@0x024C4128@ */ ECIPP_ALIGNMENT_UWORD 65535 Compu_IDENTITY 0 65535 PHYS_UNIT "System ID + DTC" /end CHARACTERISTIC
/begin CHARACTERISTIC FCdc4_OilP_maxV "FCtl_DTC_0x04(150)" VALUE 0x001E41C2 /* @ECU_Address@FCtl_DTC_0x04@0x024C412C@ */ ECIPP_ALIGNMENT_UWORD 65535 Compu_IDENTITY 0 65535 PHYS_UNIT "System ID + DTC" /end CHARACTERISTIC
/begin CHARACTERISTIC FCdc4_OilP_minV "FCtl_DTC_0x04(151)" VALUE 0x001E41C4 /* @ECU_Address@FCtl_DTC_0x04@0x024C412E@ */ ECIPP_ALIGNMENT_UWORD 65535 Compu_IDENTITY 0 65535 PHYS_UNIT "System ID + DTC" /end CHARACTERISTIC
/begin CHARACTERISTIC FCdc4_OILP_test "FCtl_DTC_0x04(29)" VALUE 0x001E40D0 /* @ECU_Address@FCtl_DTC_0x04@0x024C403A@ */ ECIPP_ALIGNMENT_UWORD 65535 Compu_IDENTITY 0 65535 PHYS_UNIT "System ID + DTC" /end CHARACTERISTIC
/begin CHARACTERISTIC FCdc4_OilP_VlvStk "FCtl_DTC_0x04(1042)" VALUE 0x001E48BA /* @ECU_Address@FCtl_DTC_0x04@0x024C4824@ */ ECIPP_ALIGNMENT_UWORD 65535 Compu_IDENTITY 0 65535 PHYS_UNIT "System ID + DTC" /end CHARACTERISTIC
/begin CHARACTERISTIC FCdc4_OilP2_loP "FCtl_DTC_0x04(293)" VALUE 0x001E42E0 /* @ECU_Address@FCtl_DTC_0x04@0x024C424A@ */ ECIPP_ALIGNMENT_UWORD 65535 Compu_IDENTITY 0 65535 PHYS_UNIT "System ID + DTC" /end CHARACTERISTIC
/begin CHARACTERISTIC FCdc4_OILTL_loss "FCtl_DTC_0x04(737)" VALUE 0x001E4658 /* @ECU_Address@FCtl_DTC_0x04@0x024C45C2@ */ ECIPP_ALIGNMENT_UWORD 65535 Compu_IDENTITY 0 65535 PHYS_UNIT "System ID + DTC" /end CHARACTERISTIC
/begin CHARACTERISTIC FCdc4_OILTL_Lvl_lo "FCtl_DTC_0x04(741)" VALUE 0x001E4660 /* @ECU_Address@FCtl_DTC_0x04@0x024C45CA@ */ ECIPP_ALIGNMENT_UWORD 65535 Compu_IDENTITY 0 65535 PHYS_UNIT "System ID + DTC" /end CHARACTERISTIC
/begin CHARACTERISTIC FCdc4_OILTL_Lvl_OOR "FCtl_DTC_0x04(739)" VALUE 0x001E465C /* @ECU_Address@FCtl_DTC_0x04@0x024C45C6@ */ ECIPP_ALIGNMENT_UWORD 65535 Compu_IDENTITY 0 65535 PHYS_UNIT "System ID + DTC" /end CHARACTERISTIC
/begin CHARACTERISTIC FCdc4_OILTL_T_hi "FCtl_DTC_0x04(742)" VALUE 0x001E4662 /* @ECU_Address@FCtl_DTC_0x04@0x024C45CC@ */ ECIPP_ALIGNMENT_UWORD 65535 Compu_IDENTITY 0 65535 PHYS_UNIT "System ID + DTC" /end CHARACTERISTIC
/begin CHARACTERISTIC FCdc4_OILTL_T_OOR "FCtl_DTC_0x04(740)" VALUE 0x001E465E /* @ECU_Address@FCtl_DTC_0x04@0x024C45C8@ */ ECIPP_ALIGNMENT_UWORD 65535 Compu_IDENTITY 0 65535 PHYS_UNIT "System ID + DTC" /end CHARACTERISTIC
/begin CHARACTERISTIC FCdc4_OILTL_V_OOR "FCtl_DTC_0x04(738)" VALUE 0x001E465A /* @ECU_Address@FCtl_DTC_0x04@0x024C45C4@ */ ECIPP_ALIGNMENT_UWORD 65535 Compu_IDENTITY 0 65535 PHYS_UNIT "System ID + DTC" /end CHARACTERISTIC
/begin CHARACTERISTIC FCdc4_PAUX_dP1_max "FCtl_DTC_0x04(546)" VALUE 0x001E44DA /* @ECU_Address@FCtl_DTC_0x04@0x024C4444@ */ ECIPP_ALIGNMENT_UWORD 65535 Compu_IDENTITY 0 65535 PHYS_UNIT "System ID + DTC" /end CHARACTERISTIC
/begin CHARACTERISTIC FCdc4_PAUX_dP1_min "FCtl_DTC_0x04(547)" VALUE 0x001E44DC /* @ECU_Address@FCtl_DTC_0x04@0x024C4446@ */ ECIPP_ALIGNMENT_UWORD 65535 Compu_IDENTITY 0 65535 PHYS_UNIT "System ID + DTC" /end CHARACTERISTIC
/begin CHARACTERISTIC FCdc4_PAUX_dP2_max "FCtl_DTC_0x04(548)" VALUE 0x001E44DE /* @ECU_Address@FCtl_DTC_0x04@0x024C4448@ */ ECIPP_ALIGNMENT_UWORD 65535 Compu_IDENTITY 0 65535 PHYS_UNIT "System ID + DTC" /end CHARACTERISTIC
/begin CHARACTERISTIC FCdc4_PAUX_dP2_min "FCtl_DTC_0x04(549)" VALUE 0x001E44E0 /* @ECU_Address@FCtl_DTC_0x04@0x024C444A@ */ ECIPP_ALIGNMENT_UWORD 65535 Compu_IDENTITY 0 65535 PHYS_UNIT "System ID + DTC" /end CHARACTERISTIC
/begin CHARACTERISTIC FCdc4_PAUX1_max "FCtl_DTC_0x04(538)" VALUE 0x001E44CA /* @ECU_Address@FCtl_DTC_0x04@0x024C4434@ */ ECIPP_ALIGNMENT_UWORD 65535 Compu_IDENTITY 0 65535 PHYS_UNIT "System ID + DTC" /end CHARACTERISTIC
/begin CHARACTERISTIC FCdc4_PAUX1_min "FCtl_DTC_0x04(539)" VALUE 0x001E44CC /* @ECU_Address@FCtl_DTC_0x04@0x024C4436@ */ ECIPP_ALIGNMENT_UWORD 65535 Compu_IDENTITY 0 65535 PHYS_UNIT "System ID + DTC" /end CHARACTERISTIC
/begin CHARACTERISTIC FCdc4_PAUX2_max "FCtl_DTC_0x04(540)" VALUE 0x001E44CE /* @ECU_Address@FCtl_DTC_0x04@0x024C4438@ */ ECIPP_ALIGNMENT_UWORD 65535 Compu_IDENTITY 0 65535 PHYS_UNIT "System ID + DTC" /end CHARACTERISTIC
/begin CHARACTERISTIC FCdc4_PAUX2_min "FCtl_DTC_0x04(541)" VALUE 0x001E44D0 /* @ECU_Address@FCtl_DTC_0x04@0x024C443A@ */ ECIPP_ALIGNMENT_UWORD 65535 Compu_IDENTITY 0 65535 PHYS_UNIT "System ID + DTC" /end CHARACTERISTIC
/begin CHARACTERISTIC FCdc4_PAUX3_max "FCtl_DTC_0x04(542)" VALUE 0x001E44D2 /* @ECU_Address@FCtl_DTC_0x04@0x024C443C@ */ ECIPP_ALIGNMENT_UWORD 65535 Compu_IDENTITY 0 65535 PHYS_UNIT "System ID + DTC" /end CHARACTERISTIC
/begin CHARACTERISTIC FCdc4_PAUX3_min "FCtl_DTC_0x04(543)" VALUE 0x001E44D4 /* @ECU_Address@FCtl_DTC_0x04@0x024C443E@ */ ECIPP_ALIGNMENT_UWORD 65535 Compu_IDENTITY 0 65535 PHYS_UNIT "System ID + DTC" /end CHARACTERISTIC
/begin CHARACTERISTIC FCdc4_PAUX4_max "FCtl_DTC_0x04(544)" VALUE 0x001E44D6 /* @ECU_Address@FCtl_DTC_0x04@0x024C4440@ */ ECIPP_ALIGNMENT_UWORD 65535 Compu_IDENTITY 0 65535 PHYS_UNIT "System ID + DTC" /end CHARACTERISTIC
/begin CHARACTERISTIC FCdc4_PAUX4_min "FCtl_DTC_0x04(545)" VALUE 0x001E44D8 /* @ECU_Address@FCtl_DTC_0x04@0x024C4442@ */ ECIPP_ALIGNMENT_UWORD 65535 Compu_IDENTITY 0 65535 PHYS_UNIT "System ID + DTC" /end CHARACTERISTIC
/begin CHARACTERISTIC FCdc4_post_cntrl_hi_lmt "FCtl_DTC_0x04(1041)" VALUE 0x001E48B8 /* @ECU_Address@FCtl_DTC_0x04@0x024C4822@ */ ECIPP_ALIGNMENT_UWORD 65535 Compu_IDENTITY 0 65535 PHYS_UNIT "System ID + DTC" /end CHARACTERISTIC
/begin CHARACTERISTIC FCdc4_post_cntrl_lo_lmt "FCtl_DTC_0x04(1040)" VALUE 0x001E48B6 /* @ECU_Address@FCtl_DTC_0x04@0x024C4820@ */ ECIPP_ALIGNMENT_UWORD 65535 Compu_IDENTITY 0 65535 PHYS_UNIT "System ID + DTC" /end CHARACTERISTIC
/begin CHARACTERISTIC FCdc4_PPEG_BP "FCtl_DTC_0x04(670)" VALUE 0x001E45D2 /* @ECU_Address@FCtl_DTC_0x04@0x024C453C@ */ ECIPP_ALIGNMENT_UWORD 65535 Compu_IDENTITY 0 65535 PHYS_UNIT "System ID + DTC" /end CHARACTERISTIC
/begin CHARACTERISTIC FCdc4_PPEG_CVP1 "FCtl_DTC_0x04(745)" VALUE 0x001E4668 /* @ECU_Address@FCtl_DTC_0x04@0x024C45D2@ */ ECIPP_ALIGNMENT_UWORD 65535 Compu_IDENTITY 0 65535 PHYS_UNIT "System ID + DTC" /end CHARACTERISTIC
/begin CHARACTERISTIC FCdc4_PPEG_CVP2 "FCtl_DTC_0x04(746)" VALUE 0x001E466A /* @ECU_Address@FCtl_DTC_0x04@0x024C45D4@ */ ECIPP_ALIGNMENT_UWORD 65535 Compu_IDENTITY 0 65535 PHYS_UNIT "System ID + DTC" /end CHARACTERISTIC
/begin CHARACTERISTIC FCdc4_PPEG_EBP "FCtl_DTC_0x04(671)" VALUE 0x001E45D4 /* @ECU_Address@FCtl_DTC_0x04@0x024C453E@ */ ECIPP_ALIGNMENT_UWORD 65535 Compu_IDENTITY 0 65535 PHYS_UNIT "System ID + DTC" /end CHARACTERISTIC
/begin CHARACTERISTIC FCdc4_PPEG_EGRdP "FCtl_DTC_0x04(756)" VALUE 0x001E467E /* @ECU_Address@FCtl_DTC_0x04@0x024C45E8@ */ ECIPP_ALIGNMENT_UWORD 65535 Compu_IDENTITY 0 65535 PHYS_UNIT "System ID + DTC" /end CHARACTERISTIC
/begin CHARACTERISTIC FCdc4_PPEG_EGRHP "FCtl_DTC_0x04(673)" VALUE 0x001E45D8 /* @ECU_Address@FCtl_DTC_0x04@0x024C4542@ */ ECIPP_ALIGNMENT_UWORD 65535 Compu_IDENTITY 0 65535 PHYS_UNIT "System ID + DTC" /end CHARACTERISTIC
/begin CHARACTERISTIC FCdc4_PPEG_EGRLP "FCtl_DTC_0x04(672)" VALUE 0x001E45D6 /* @ECU_Address@FCtl_DTC_0x04@0x024C4540@ */ ECIPP_ALIGNMENT_UWORD 65535 Compu_IDENTITY 0 65535 PHYS_UNIT "System ID + DTC" /end CHARACTERISTIC
/begin CHARACTERISTIC FCdc4_PPEG_EGRwrP "FCtl_DTC_0x04(675)" VALUE 0x001E45DC /* @ECU_Address@FCtl_DTC_0x04@0x024C4546@ */ ECIPP_ALIGNMENT_UWORD 65535 Compu_IDENTITY 0 65535 PHYS_UNIT "System ID + DTC" /end CHARACTERISTIC
/begin CHARACTERISTIC FCdc4_PPEG_MAP "FCtl_DTC_0x04(676)" VALUE 0x001E45DE /* @ECU_Address@FCtl_DTC_0x04@0x024C4548@ */ ECIPP_ALIGNMENT_UWORD 65535 Compu_IDENTITY 0 65535 PHYS_UNIT "System ID + DTC" /end CHARACTERISTIC
/begin CHARACTERISTIC FCdc4_PPEG_TIP "FCtl_DTC_0x04(674)" VALUE 0x001E45DA /* @ECU_Address@FCtl_DTC_0x04@0x024C4544@ */ ECIPP_ALIGNMENT_UWORD 65535 Compu_IDENTITY 0 65535 PHYS_UNIT "System ID + DTC" /end CHARACTERISTIC
/begin CHARACTERISTIC FCdc4_Pri1_open "FCtl_DTC_0x04(901)" VALUE 0x001E47A0 /* @ECU_Address@FCtl_DTC_0x04@0x024C470A@ */ ECIPP_ALIGNMENT_UWORD 65535 Compu_IDENTITY 0 65535 PHYS_UNIT "System ID + DTC" /end CHARACTERISTIC
/begin CHARACTERISTIC FCdc4_Pri1_short "FCtl_DTC_0x04(913)" VALUE 0x001E47B8 /* @ECU_Address@FCtl_DTC_0x04@0x024C4722@ */ ECIPP_ALIGNMENT_UWORD 65535 Compu_IDENTITY 0 65535 PHYS_UNIT "System ID + DTC" /end CHARACTERISTIC
/begin CHARACTERISTIC FCdc4_PWM1_off_loVf "FCtl_DTC_0x04(189)" VALUE 0x001E4210 /* @ECU_Address@FCtl_DTC_0x04@0x024C417A@ */ ECIPP_ALIGNMENT_UWORD 65535 Compu_IDENTITY 0 65535 PHYS_UNIT "System ID + DTC" /end CHARACTERISTIC
/begin CHARACTERISTIC FCdc4_PWM1_on_hiVf "FCtl_DTC_0x04(190)" VALUE 0x001E4212 /* @ECU_Address@FCtl_DTC_0x04@0x024C417C@ */ ECIPP_ALIGNMENT_UWORD 65535 Compu_IDENTITY 0 65535 PHYS_UNIT "System ID + DTC" /end CHARACTERISTIC
/begin CHARACTERISTIC FCdc4_PWM10_off_loVf "FCtl_DTC_0x04(433)" VALUE 0x001E43F8 /* @ECU_Address@FCtl_DTC_0x04@0x024C4362@ */ ECIPP_ALIGNMENT_UWORD 65535 Compu_IDENTITY 0 65535 PHYS_UNIT "System ID + DTC" /end CHARACTERISTIC
/begin CHARACTERISTIC FCdc4_PWM10_on_hiVf "FCtl_DTC_0x04(434)" VALUE 0x001E43FA /* @ECU_Address@FCtl_DTC_0x04@0x024C4364@ */ ECIPP_ALIGNMENT_UWORD 65535 Compu_IDENTITY 0 65535 PHYS_UNIT "System ID + DTC" /end CHARACTERISTIC
/begin CHARACTERISTIC FCdc4_PWM11_off_loVf "FCtl_DTC_0x04(435)" VALUE 0x001E43FC /* @ECU_Address@FCtl_DTC_0x04@0x024C4366@ */ ECIPP_ALIGNMENT_UWORD 65535 Compu_IDENTITY 0 65535 PHYS_UNIT "System ID + DTC" /end CHARACTERISTIC
/begin CHARACTERISTIC FCdc4_PWM11_on_hiVf "FCtl_DTC_0x04(436)" VALUE 0x001E43FE /* @ECU_Address@FCtl_DTC_0x04@0x024C4368@ */ ECIPP_ALIGNMENT_UWORD 65535 Compu_IDENTITY 0 65535 PHYS_UNIT "System ID + DTC" /end CHARACTERISTIC
/begin CHARACTERISTIC FCdc4_PWM12_off_loVf "FCtl_DTC_0x04(437)" VALUE 0x001E4400 /* @ECU_Address@FCtl_DTC_0x04@0x024C436A@ */ ECIPP_ALIGNMENT_UWORD 65535 Compu_IDENTITY 0 65535 PHYS_UNIT "System ID + DTC" /end CHARACTERISTIC
/begin CHARACTERISTIC FCdc4_PWM12_on_hiVf "FCtl_DTC_0x04(438)" VALUE 0x001E4402 /* @ECU_Address@FCtl_DTC_0x04@0x024C436C@ */ ECIPP_ALIGNMENT_UWORD 65535 Compu_IDENTITY 0 65535 PHYS_UNIT "System ID + DTC" /end CHARACTERISTIC
/begin CHARACTERISTIC FCdc4_PWM13_off_loVf "FCtl_DTC_0x04(439)" VALUE 0x001E4404 /* @ECU_Address@FCtl_DTC_0x04@0x024C436E@ */ ECIPP_ALIGNMENT_UWORD 65535 Compu_IDENTITY 0 65535 PHYS_UNIT "System ID + DTC" /end CHARACTERISTIC
/begin CHARACTERISTIC FCdc4_PWM13_on_hiVf "FCtl_DTC_0x04(440)" VALUE 0x001E4406 /* @ECU_Address@FCtl_DTC_0x04@0x024C4370@ */ ECIPP_ALIGNMENT_UWORD 65535 Compu_IDENTITY 0 65535 PHYS_UNIT "System ID + DTC" /end CHARACTERISTIC
/begin CHARACTERISTIC FCdc4_PWM14_off_loVf "FCtl_DTC_0x04(441)" VALUE 0x001E4408 /* @ECU_Address@FCtl_DTC_0x04@0x024C4372@ */ ECIPP_ALIGNMENT_UWORD 65535 Compu_IDENTITY 0 65535 PHYS_UNIT "System ID + DTC" /end CHARACTERISTIC
/begin CHARACTERISTIC FCdc4_PWM14_on_hiVf "FCtl_DTC_0x04(442)" VALUE 0x001E440A /* @ECU_Address@FCtl_DTC_0x04@0x024C4374@ */ ECIPP_ALIGNMENT_UWORD 65535 Compu_IDENTITY 0 65535 PHYS_UNIT "System ID + DTC" /end CHARACTERISTIC
/begin CHARACTERISTIC FCdc4_PWM15_off_loVf "FCtl_DTC_0x04(443)" VALUE 0x001E440C /* @ECU_Address@FCtl_DTC_0x04@0x024C4376@ */ ECIPP_ALIGNMENT_UWORD 65535 Compu_IDENTITY 0 65535 PHYS_UNIT "System ID + DTC" /end CHARACTERISTIC
/begin CHARACTERISTIC FCdc4_PWM15_on_hiVf "FCtl_DTC_0x04(444)" VALUE 0x001E440E /* @ECU_Address@FCtl_DTC_0x04@0x024C4378@ */ ECIPP_ALIGNMENT_UWORD 65535 Compu_IDENTITY 0 65535 PHYS_UNIT "System ID + DTC" /end CHARACTERISTIC
/begin CHARACTERISTIC FCdc4_PWM16_off_loVf "FCtl_DTC_0x04(445)" VALUE 0x001E4410 /* @ECU_Address@FCtl_DTC_0x04@0x024C437A@ */ ECIPP_ALIGNMENT_UWORD 65535 Compu_IDENTITY 0 65535 PHYS_UNIT "System ID + DTC" /end CHARACTERISTIC
/begin CHARACTERISTIC FCdc4_PWM16_on_hiVf "FCtl_DTC_0x04(446)" VALUE 0x001E4412 /* @ECU_Address@FCtl_DTC_0x04@0x024C437C@ */ ECIPP_ALIGNMENT_UWORD 65535 Compu_IDENTITY 0 65535 PHYS_UNIT "System ID + DTC" /end CHARACTERISTIC
/begin CHARACTERISTIC FPnd_MJ_intF_circ "FPrm_pending(98)" VALUE 0x001E51D6 /* @ECU_Address@FPrm_pending@0x021BE0C4@ */ ECIPP_ALIGNMENT_UWORD 65535 Compu_IDENTITY 0 65535 PHYS_UNIT "Bit Mask" /end CHARACTERISTIC
/begin CHARACTERISTIC FPnd_MJ_intF_comm "FPrm_pending(99)" VALUE 0x001E51D8 /* @ECU_Address@FPrm_pending@0x021BE0C6@ */ ECIPP_ALIGNMENT_UWORD 65535 Compu_IDENTITY 0 65535 PHYS_UNIT "Bit Mask" /end CHARACTERISTIC
/begin CHARACTERISTIC FPnd_MJ_intF_Vhi "FPrm_pending(95)" VALUE 0x001E51D0 /* @ECU_Address@FPrm_pending@0x021BE0BE@ */ ECIPP_ALIGNMENT_UWORD 65535 Compu_IDENTITY 0 65535 PHYS_UNIT "Bit Mask" /end CHARACTERISTIC
/begin CHARACTERISTIC FPnd_MJ_intF_Vlo "FPrm_pending(96)" VALUE 0x001E51D2 /* @ECU_Address@FPrm_pending@0x021BE0C0@ */ ECIPP_ALIGNMENT_UWORD 65535 Compu_IDENTITY 0 65535 PHYS_UNIT "Bit Mask" /end CHARACTERISTIC
/begin CHARACTERISTIC FPnd_MJ_Pe_HiExp "FPrm_pending(92)" VALUE 0x001E51CA /* @ECU_Address@FPrm_pending@0x021BE0B8@ */ ECIPP_ALIGNMENT_UWORD 65535 Compu_IDENTITY 0 65535 PHYS_UNIT "Bit Mask" /end CHARACTERISTIC
/begin CHARACTERISTIC FPnd_MJ_Pe_LoExp "FPrm_pending(93)" VALUE 0x001E51CC /* @ECU_Address@FPrm_pending@0x021BE0BA@ */ ECIPP_ALIGNMENT_UWORD 65535 Compu_IDENTITY 0 65535 PHYS_UNIT "Bit Mask" /end CHARACTERISTIC
/begin CHARACTERISTIC FPnd_MJ2_comm_tout "FPrm_pending(556)" VALUE 0x001E556A /* @ECU_Address@FPrm_pending@0x021BE458@ */ ECIPP_ALIGNMENT_UWORD 65535 Compu_IDENTITY 0 65535 PHYS_UNIT "Bit Mask" /end CHARACTERISTIC
/begin CHARACTERISTIC FPnd_MJ2_intF_act "FPrm_pending(559)" VALUE 0x001E5570 /* @ECU_Address@FPrm_pending@0x021BE45E@ */ ECIPP_ALIGNMENT_UWORD 65535 Compu_IDENTITY 0 65535 PHYS_UNIT "Bit Mask" /end CHARACTERISTIC
/begin CHARACTERISTIC FPnd_MJ2_intF_circ "FPrm_pending(560)" VALUE 0x001E5572 /* @ECU_Address@FPrm_pending@0x021BE460@ */ ECIPP_ALIGNMENT_UWORD 65535 Compu_IDENTITY 0 65535 PHYS_UNIT "Bit Mask" /end CHARACTERISTIC
/begin CHARACTERISTIC FPnd_MJ2_intF_comm "FPrm_pending(561)" VALUE 0x001E5574 /* @ECU_Address@FPrm_pending@0x021BE462@ */ ECIPP_ALIGNMENT_UWORD 65535 Compu_IDENTITY 0 65535 PHYS_UNIT "Bit Mask" /end CHARACTERISTIC
/begin CHARACTERISTIC FPnd_MJ2_intF_Vhi "FPrm_pending(557)" VALUE 0x001E556C /* @ECU_Address@FPrm_pending@0x021BE45A@ */ ECIPP_ALIGNMENT_UWORD 65535 Compu_IDENTITY 0 65535 PHYS_UNIT "Bit Mask" /end CHARACTERISTIC
/begin CHARACTERISTIC FPnd_MJ2_intF_Vlo "FPrm_pending(558)" VALUE 0x001E556E /* @ECU_Address@FPrm_pending@0x021BE45C@ */ ECIPP_ALIGNMENT_UWORD 65535 Compu_IDENTITY 0 65535 PHYS_UNIT "Bit Mask" /end CHARACTERISTIC
/begin CHARACTERISTIC FPnd_MJ2_Pe_HiExp "FPrm_pending(554)" VALUE 0x001E5566 /* @ECU_Address@FPrm_pending@0x021BE454@ */ ECIPP_ALIGNMENT_UWORD 65535 Compu_IDENTITY 0 65535 PHYS_UNIT "Bit Mask" /end CHARACTERISTIC
/begin CHARACTERISTIC FPnd_MJ2_Pe_LoExp "FPrm_pending(555)" VALUE 0x001E5568 /* @ECU_Address@FPrm_pending@0x021BE456@ */ ECIPP_ALIGNMENT_UWORD 65535 Compu_IDENTITY 0 65535 PHYS_UNIT "Bit Mask" /end CHARACTERISTIC
/begin CHARACTERISTIC FPnd_NOx_hi "FPrm_pending(623)" VALUE 0x001E55F0 /* @ECU_Address@FPrm_pending@0x021BE4DE@ */ ECIPP_ALIGNMENT_UWORD 65535 Compu_IDENTITY 0 65535 PHYS_UNIT "Bit Mask" /end CHARACTERISTIC
/begin CHARACTERISTIC FPnd_OilP_comm_lost "FPrm_pending(721)" VALUE 0x001E56B4 /* @ECU_Address@FPrm_pending@0x021BE5A2@ */ ECIPP_ALIGNMENT_UWORD 65535 Compu_IDENTITY 0 65535 PHYS_UNIT "Bit Mask" /end CHARACTERISTIC
/begin CHARACTERISTIC FPnd_OilP_hiP "FPrm_pending(109)" VALUE 0x001E51EC /* @ECU_Address@FPrm_pending@0x021BE0DA@ */ ECIPP_ALIGNMENT_UWORD 65535 Compu_IDENTITY 0 65535 PHYS_UNIT "Bit Mask" /end CHARACTERISTIC
/begin CHARACTERISTIC FPnd_OilP_loP "FPrm_pending(108)" VALUE 0x001E51EA /* @ECU_Address@FPrm_pending@0x021BE0D8@ */ ECIPP_ALIGNMENT_UWORD 65535 Compu_IDENTITY 0 65535 PHYS_UNIT "Bit Mask" /end CHARACTERISTIC
/begin CHARACTERISTIC FPnd_OilP_maxV "FPrm_pending(110)" VALUE 0x001E51EE /* @ECU_Address@FPrm_pending@0x021BE0DC@ */ ECIPP_ALIGNMENT_UWORD 65535 Compu_IDENTITY 0 65535 PHYS_UNIT "Bit Mask" /end CHARACTERISTIC
/begin CHARACTERISTIC FPnd_OilP_minV "FPrm_pending(111)" VALUE 0x001E51F0 /* @ECU_Address@FPrm_pending@0x021BE0DE@ */ ECIPP_ALIGNMENT_UWORD 65535 Compu_IDENTITY 0 65535 PHYS_UNIT "Bit Mask" /end CHARACTERISTIC
/begin CHARACTERISTIC FPnd_OILP_test "FPrm_pending(40)" VALUE 0x001E5162 /* @ECU_Address@FPrm_pending@0x021BE050@ */ ECIPP_ALIGNMENT_UWORD 65535 Compu_IDENTITY 0 65535 PHYS_UNIT "Bit Mask" /end CHARACTERISTIC
/begin CHARACTERISTIC FPnd_OilP_VlvStk "FPrm_pending(718)" VALUE 0x001E56AE /* @ECU_Address@FPrm_pending@0x021BE59C@ */ ECIPP_ALIGNMENT_UWORD 65535 Compu_IDENTITY 0 65535 PHYS_UNIT "Bit Mask" /end CHARACTERISTIC
/begin CHARACTERISTIC FPnd_OilP2_loP "FPrm_pending(215)" VALUE 0x001E52C0 /* @ECU_Address@FPrm_pending@0x021BE1AE@ */ ECIPP_ALIGNMENT_UWORD 65535 Compu_IDENTITY 0 65535 PHYS_UNIT "Bit Mask" /end CHARACTERISTIC
/begin CHARACTERISTIC FPnd_OILTL_loss "FPrm_pending(567)" VALUE 0x001E5580 /* @ECU_Address@FPrm_pending@0x021BE46E@ */ ECIPP_ALIGNMENT_UWORD 65535 Compu_IDENTITY 0 65535 PHYS_UNIT "Bit Mask" /end CHARACTERISTIC
/begin CHARACTERISTIC FPnd_OILTL_Lvl_lo "FPrm_pending(571)" VALUE 0x001E5588 /* @ECU_Address@FPrm_pending@0x021BE476@ */ ECIPP_ALIGNMENT_UWORD 65535 Compu_IDENTITY 0 65535 PHYS_UNIT "Bit Mask" /end CHARACTERISTIC
/begin CHARACTERISTIC FPnd_OILTL_Lvl_OOR "FPrm_pending(569)" VALUE 0x001E5584 /* @ECU_Address@FPrm_pending@0x021BE472@ */ ECIPP_ALIGNMENT_UWORD 65535 Compu_IDENTITY 0 65535 PHYS_UNIT "Bit Mask" /end CHARACTERISTIC
/begin CHARACTERISTIC FPnd_OILTL_T_hi "FPrm_pending(572)" VALUE 0x001E558A /* @ECU_Address@FPrm_pending@0x021BE478@ */ ECIPP_ALIGNMENT_UWORD 65535 Compu_IDENTITY 0 65535 PHYS_UNIT "Bit Mask" /end CHARACTERISTIC
/begin CHARACTERISTIC FPnd_OILTL_T_OOR "FPrm_pending(570)" VALUE 0x001E5586 /* @ECU_Address@FPrm_pending@0x021BE474@ */ ECIPP_ALIGNMENT_UWORD 65535 Compu_IDENTITY 0 65535 PHYS_UNIT "Bit Mask" /end CHARACTERISTIC
/begin CHARACTERISTIC FPnd_OILTL_V_OOR "FPrm_pending(568)" VALUE 0x001E5582 /* @ECU_Address@FPrm_pending@0x021BE470@ */ ECIPP_ALIGNMENT_UWORD 65535 Compu_IDENTITY 0 65535 PHYS_UNIT "Bit Mask" /end CHARACTERISTIC
/begin CHARACTERISTIC FPnd_PAUX_dP1_max "FPrm_pending(416)" VALUE 0x001E5452 /* @ECU_Address@FPrm_pending@0x021BE340@ */ ECIPP_ALIGNMENT_UWORD 65535 Compu_IDENTITY 0 65535 PHYS_UNIT "Bit Mask" /end CHARACTERISTIC
/begin CHARACTERISTIC FPnd_PAUX_dP1_min "FPrm_pending(417)" VALUE 0x001E5454 /* @ECU_Address@FPrm_pending@0x021BE342@ */ ECIPP_ALIGNMENT_UWORD 65535 Compu_IDENTITY 0 65535 PHYS_UNIT "Bit Mask" /end CHARACTERISTIC
/begin CHARACTERISTIC FPnd_PAUX_dP2_max "FPrm_pending(418)" VALUE 0x001E5456 /* @ECU_Address@FPrm_pending@0x021BE344@ */ ECIPP_ALIGNMENT_UWORD 65535 Compu_IDENTITY 0 65535 PHYS_UNIT "Bit Mask" /end CHARACTERISTIC
/begin CHARACTERISTIC FPnd_PAUX_dP2_min "FPrm_pending(419)" VALUE 0x001E5458 /* @ECU_Address@FPrm_pending@0x021BE346@ */ ECIPP_ALIGNMENT_UWORD 65535 Compu_IDENTITY 0 65535 PHYS_UNIT "Bit Mask" /end CHARACTERISTIC
/begin CHARACTERISTIC FPnd_PAUX1_max "FPrm_pending(408)" VALUE 0x001E5442 /* @ECU_Address@FPrm_pending@0x021BE330@ */ ECIPP_ALIGNMENT_UWORD 65535 Compu_IDENTITY 0 65535 PHYS_UNIT "Bit Mask" /end CHARACTERISTIC
/begin CHARACTERISTIC FPnd_PAUX1_min "FPrm_pending(409)" VALUE 0x001E5444 /* @ECU_Address@FPrm_pending@0x021BE332@ */ ECIPP_ALIGNMENT_UWORD 65535 Compu_IDENTITY 0 65535 PHYS_UNIT "Bit Mask" /end CHARACTERISTIC
/begin CHARACTERISTIC FPnd_PAUX2_max "FPrm_pending(410)" VALUE 0x001E5446 /* @ECU_Address@FPrm_pending@0x021BE334@ */ ECIPP_ALIGNMENT_UWORD 65535 Compu_IDENTITY 0 65535 PHYS_UNIT "Bit Mask" /end CHARACTERISTIC
/begin CHARACTERISTIC FPnd_PAUX2_min "FPrm_pending(411)" VALUE 0x001E5448 /* @ECU_Address@FPrm_pending@0x021BE336@ */ ECIPP_ALIGNMENT_UWORD 65535 Compu_IDENTITY 0 65535 PHYS_UNIT "Bit Mask" /end CHARACTERISTIC
/begin CHARACTERISTIC FPnd_PAUX3_max "FPrm_pending(412)" VALUE 0x001E544A /* @ECU_Address@FPrm_pending@0x021BE338@ */ ECIPP_ALIGNMENT_UWORD 65535 Compu_IDENTITY 0 65535 PHYS_UNIT "Bit Mask" /end CHARACTERISTIC
/begin CHARACTERISTIC FPnd_PAUX3_min "FPrm_pending(413)" VALUE 0x001E544C /* @ECU_Address@FPrm_pending@0x021BE33A@ */ ECIPP_ALIGNMENT_UWORD 65535 Compu_IDENTITY 0 65535 PHYS_UNIT "Bit Mask" /end CHARACTERISTIC
/begin CHARACTERISTIC FPnd_PAUX4_max "FPrm_pending(414)" VALUE 0x001E544E /* @ECU_Address@FPrm_pending@0x021BE33C@ */ ECIPP_ALIGNMENT_UWORD 65535 Compu_IDENTITY 0 65535 PHYS_UNIT "Bit Mask" /end CHARACTERISTIC
/begin CHARACTERISTIC FPnd_PAUX4_min "FPrm_pending(415)" VALUE 0x001E5450 /* @ECU_Address@FPrm_pending@0x021BE33E@ */ ECIPP_ALIGNMENT_UWORD 65535 Compu_IDENTITY 0 65535 PHYS_UNIT "Bit Mask" /end CHARACTERISTIC
/begin CHARACTERISTIC FPnd_post_cntrl_hi_lmt "FPrm_pending(717)" VALUE 0x001E56AC /* @ECU_Address@FPrm_pending@0x021BE59A@ */ ECIPP_ALIGNMENT_UWORD 65535 Compu_IDENTITY 0 65535 PHYS_UNIT "Bit Mask" /end CHARACTERISTIC
/begin CHARACTERISTIC FPnd_post_cntrl_lo_lmt "FPrm_pending(716)" VALUE 0x001E56AA /* @ECU_Address@FPrm_pending@0x021BE598@ */ ECIPP_ALIGNMENT_UWORD 65535 Compu_IDENTITY 0 65535 PHYS_UNIT "Bit Mask" /end CHARACTERISTIC
/begin CHARACTERISTIC FPnd_PPEG_BP "FPrm_pending(500)" VALUE 0x001E54FA /* @ECU_Address@FPrm_pending@0x021BE3E8@ */ ECIPP_ALIGNMENT_UWORD 65535 Compu_IDENTITY 0 65535 PHYS_UNIT "Bit Mask" /end CHARACTERISTIC
/begin CHARACTERISTIC FPnd_PPEG_CVP1 "FPrm_pending(575)" VALUE 0x001E5590 /* @ECU_Address@FPrm_pending@0x021BE47E@ */ ECIPP_ALIGNMENT_UWORD 65535 Compu_IDENTITY 0 65535 PHYS_UNIT "Bit Mask" /end CHARACTERISTIC
/begin CHARACTERISTIC FPnd_PPEG_CVP2 "FPrm_pending(576)" VALUE 0x001E5592 /* @ECU_Address@FPrm_pending@0x021BE480@ */ ECIPP_ALIGNMENT_UWORD 65535 Compu_IDENTITY 0 65535 PHYS_UNIT "Bit Mask" /end CHARACTERISTIC
/begin CHARACTERISTIC FPnd_PPEG_EBP "FPrm_pending(501)" VALUE 0x001E54FC /* @ECU_Address@FPrm_pending@0x021BE3EA@ */ ECIPP_ALIGNMENT_UWORD 65535 Compu_IDENTITY 0 65535 PHYS_UNIT "Bit Mask" /end CHARACTERISTIC
/begin CHARACTERISTIC FPnd_PPEG_EGRdP "FPrm_pending(586)" VALUE 0x001E55A6 /* @ECU_Address@FPrm_pending@0x021BE494@ */ ECIPP_ALIGNMENT_UWORD 65535 Compu_IDENTITY 0 65535 PHYS_UNIT "Bit Mask" /end CHARACTERISTIC
/begin CHARACTERISTIC FPnd_PPEG_EGRHP "FPrm_pending(503)" VALUE 0x001E5500 /* @ECU_Address@FPrm_pending@0x021BE3EE@ */ ECIPP_ALIGNMENT_UWORD 65535 Compu_IDENTITY 0 65535 PHYS_UNIT "Bit Mask" /end CHARACTERISTIC
/begin CHARACTERISTIC FPnd_PPEG_EGRLP "FPrm_pending(502)" VALUE 0x001E54FE /* @ECU_Address@FPrm_pending@0x021BE3EC@ */ ECIPP_ALIGNMENT_UWORD 65535 Compu_IDENTITY 0 65535 PHYS_UNIT "Bit Mask" /end CHARACTERISTIC
/begin CHARACTERISTIC FPnd_PPEG_EGRwrP "FPrm_pending(505)" VALUE 0x001E5504 /* @ECU_Address@FPrm_pending@0x021BE3F2@ */ ECIPP_ALIGNMENT_UWORD 65535 Compu_IDENTITY 0 65535 PHYS_UNIT "Bit Mask" /end CHARACTERISTIC
/begin CHARACTERISTIC FPnd_PPEG_MAP "FPrm_pending(506)" VALUE 0x001E5506 /* @ECU_Address@FPrm_pending@0x021BE3F4@ */ ECIPP_ALIGNMENT_UWORD 65535 Compu_IDENTITY 0 65535 PHYS_UNIT "Bit Mask" /end CHARACTERISTIC
/begin CHARACTERISTIC FPnd_PPEG_TIP "FPrm_pending(504)" VALUE 0x001E5502 /* @ECU_Address@FPrm_pending@0x021BE3F0@ */ ECIPP_ALIGNMENT_UWORD 65535 Compu_IDENTITY 0 65535 PHYS_UNIT "Bit Mask" /end CHARACTERISTIC
/begin CHARACTERISTIC FPnd_Pri1_open "FPrm_pending(703)" VALUE 0x001E5690 /* @ECU_Address@FPrm_pending@0x021BE57E@ */ ECIPP_ALIGNMENT_UWORD 65535 Compu_IDENTITY 0 65535 PHYS_UNIT "Bit Mask" /end CHARACTERISTIC
/begin CHARACTERISTIC FPnd_Pri1_short "FPrm_pending(704)" VALUE 0x001E5692 /* @ECU_Address@FPrm_pending@0x021BE580@ */ ECIPP_ALIGNMENT_UWORD 65535 Compu_IDENTITY 0 65535 PHYS_UNIT "Bit Mask" /end CHARACTERISTIC
/begin CHARACTERISTIC FPnd_PWM1_off_loVf "FPrm_pending(147)" VALUE 0x001E5238 /* @ECU_Address@FPrm_pending@0x021BE126@ */ ECIPP_ALIGNMENT_UWORD 65535 Compu_IDENTITY 0 65535 PHYS_UNIT "Bit Mask" /end CHARACTERISTIC
/begin CHARACTERISTIC FPnd_PWM1_on_hiVf "FPrm_pending(148)" VALUE 0x001E523A /* @ECU_Address@FPrm_pending@0x021BE128@ */ ECIPP_ALIGNMENT_UWORD 65535 Compu_IDENTITY 0 65535 PHYS_UNIT "Bit Mask" /end CHARACTERISTIC
/begin CHARACTERISTIC FPnd_PWM10_off_loVf "FPrm_pending(330)" VALUE 0x001E53A6 /* @ECU_Address@FPrm_pending@0x021BE294@ */ ECIPP_ALIGNMENT_UWORD 65535 Compu_IDENTITY 0 65535 PHYS_UNIT "Bit Mask" /end CHARACTERISTIC
/begin CHARACTERISTIC FPnd_PWM10_on_hiVf "FPrm_pending(331)" VALUE 0x001E53A8 /* @ECU_Address@FPrm_pending@0x021BE296@ */ ECIPP_ALIGNMENT_UWORD 65535 Compu_IDENTITY 0 65535 PHYS_UNIT "Bit Mask" /end CHARACTERISTIC
/begin CHARACTERISTIC FPnd_PWM11_off_loVf "FPrm_pending(332)" VALUE 0x001E53AA /* @ECU_Address@FPrm_pending@0x021BE298@ */ ECIPP_ALIGNMENT_UWORD 65535 Compu_IDENTITY 0 65535 PHYS_UNIT "Bit Mask" /end CHARACTERISTIC
/begin CHARACTERISTIC FPnd_PWM11_on_hiVf "FPrm_pending(333)" VALUE 0x001E53AC /* @ECU_Address@FPrm_pending@0x021BE29A@ */ ECIPP_ALIGNMENT_UWORD 65535 Compu_IDENTITY 0 65535 PHYS_UNIT "Bit Mask" /end CHARACTERISTIC
/begin CHARACTERISTIC FPnd_PWM12_off_loVf "FPrm_pending(334)" VALUE 0x001E53AE /* @ECU_Address@FPrm_pending@0x021BE29C@ */ ECIPP_ALIGNMENT_UWORD 65535 Compu_IDENTITY 0 65535 PHYS_UNIT "Bit Mask" /end CHARACTERISTIC
/begin CHARACTERISTIC FPnd_PWM12_on_hiVf "FPrm_pending(335)" VALUE 0x001E53B0 /* @ECU_Address@FPrm_pending@0x021BE29E@ */ ECIPP_ALIGNMENT_UWORD 65535 Compu_IDENTITY 0 65535 PHYS_UNIT "Bit Mask" /end CHARACTERISTIC
/begin CHARACTERISTIC FPnd_PWM13_off_loVf "FPrm_pending(336)" VALUE 0x001E53B2 /* @ECU_Address@FPrm_pending@0x021BE2A0@ */ ECIPP_ALIGNMENT_UWORD 65535 Compu_IDENTITY 0 65535 PHYS_UNIT "Bit Mask" /end CHARACTERISTIC
/begin CHARACTERISTIC FPnd_PWM13_on_hiVf "FPrm_pending(337)" VALUE 0x001E53B4 /* @ECU_Address@FPrm_pending@0x021BE2A2@ */ ECIPP_ALIGNMENT_UWORD 65535 Compu_IDENTITY 0 65535 PHYS_UNIT "Bit Mask" /end CHARACTERISTIC
/begin CHARACTERISTIC FPnd_PWM14_off_loVf "FPrm_pending(338)" VALUE 0x001E53B6 /* @ECU_Address@FPrm_pending@0x021BE2A4@ */ ECIPP_ALIGNMENT_UWORD 65535 Compu_IDENTITY 0 65535 PHYS_UNIT "Bit Mask" /end CHARACTERISTIC
/begin CHARACTERISTIC FPnd_PWM14_on_hiVf "FPrm_pending(339)" VALUE 0x001E53B8 /* @ECU_Address@FPrm_pending@0x021BE2A6@ */ ECIPP_ALIGNMENT_UWORD 65535 Compu_IDENTITY 0 65535 PHYS_UNIT "Bit Mask" /end CHARACTERISTIC
/begin CHARACTERISTIC FPnd_PWM15_off_loVf "FPrm_pending(340)" VALUE 0x001E53BA /* @ECU_Address@FPrm_pending@0x021BE2A8@ */ ECIPP_ALIGNMENT_UWORD 65535 Compu_IDENTITY 0 65535 PHYS_UNIT "Bit Mask" /end CHARACTERISTIC
/begin CHARACTERISTIC FPnd_PWM15_on_hiVf "FPrm_pending(341)" VALUE 0x001E53BC /* @ECU_Address@FPrm_pending@0x021BE2AA@ */ ECIPP_ALIGNMENT_UWORD 65535 Compu_IDENTITY 0 65535 PHYS_UNIT "Bit Mask" /end CHARACTERISTIC
/begin CHARACTERISTIC FPnd_PWM16_off_loVf "FPrm_pending(342)" VALUE 0x001E53BE /* @ECU_Address@FPrm_pending@0x021BE2AC@ */ ECIPP_ALIGNMENT_UWORD 65535 Compu_IDENTITY 0 65535 PHYS_UNIT "Bit Mask" /end CHARACTERISTIC
/begin CHARACTERISTIC FPnd_PWM16_on_hiVf "FPrm_pending(343)" VALUE 0x001E53C0 /* @ECU_Address@FPrm_pending@0x021BE2AE@ */ ECIPP_ALIGNMENT_UWORD 65535 Compu_IDENTITY 0 65535 PHYS_UNIT "Bit Mask" /end CHARACTERISTIC
/begin CHARACTERISTIC FPsvr_MJ_intF_circ "FPrm_severity(98)" VALUE 0x001E6877 /* @ECU_Address@FPrm_severity@0x024B3062@ */ ECIPP_ALIGNMENT_UBYTE 255 Compu_IDENTITY 0 255 PHYS_UNIT "Severity+Class" /end CHARACTERISTIC
/begin CHARACTERISTIC FPsvr_MJ_intF_comm "FPrm_severity(99)" VALUE 0x001E6878 /* @ECU_Address@FPrm_severity@0x024B3063@ */ ECIPP_ALIGNMENT_UBYTE 255 Compu_IDENTITY 0 255 PHYS_UNIT "Severity+Class" /end CHARACTERISTIC
/begin CHARACTERISTIC FPsvr_MJ_intF_Vhi "FPrm_severity(95)" VALUE 0x001E6874 /* @ECU_Address@FPrm_severity@0x024B305F@ */ ECIPP_ALIGNMENT_UBYTE 255 Compu_IDENTITY 0 255 PHYS_UNIT "Severity+Class" /end CHARACTERISTIC
/begin CHARACTERISTIC FPsvr_MJ_intF_Vlo "FPrm_severity(96)" VALUE 0x001E6875 /* @ECU_Address@FPrm_severity@0x024B3060@ */ ECIPP_ALIGNMENT_UBYTE 255 Compu_IDENTITY 0 255 PHYS_UNIT "Severity+Class" /end CHARACTERISTIC
/begin CHARACTERISTIC FPsvr_MJ_Pe_HiExp "FPrm_severity(92)" VALUE 0x001E6871 /* @ECU_Address@FPrm_severity@0x024B305C@ */ ECIPP_ALIGNMENT_UBYTE 255 Compu_IDENTITY 0 255 PHYS_UNIT "Severity+Class" /end CHARACTERISTIC
/begin CHARACTERISTIC FPsvr_MJ_Pe_LoExp "FPrm_severity(93)" VALUE 0x001E6872 /* @ECU_Address@FPrm_severity@0x024B305D@ */ ECIPP_ALIGNMENT_UBYTE 255 Compu_IDENTITY 0 255 PHYS_UNIT "Severity+Class" /end CHARACTERISTIC
/begin CHARACTERISTIC FPsvr_MJ2_comm_tout "FPrm_severity(556)" VALUE 0x001E6A41 /* @ECU_Address@FPrm_severity@0x024B322C@ */ ECIPP_ALIGNMENT_UBYTE 255 Compu_IDENTITY 0 255 PHYS_UNIT "Severity+Class" /end CHARACTERISTIC
/begin CHARACTERISTIC FPsvr_MJ2_intF_act "FPrm_severity(559)" VALUE 0x001E6A44 /* @ECU_Address@FPrm_severity@0x024B322F@ */ ECIPP_ALIGNMENT_UBYTE 255 Compu_IDENTITY 0 255 PHYS_UNIT "Severity+Class" /end CHARACTERISTIC
/begin CHARACTERISTIC FPsvr_MJ2_intF_circ "FPrm_severity(560)" VALUE 0x001E6A45 /* @ECU_Address@FPrm_severity@0x024B3230@ */ ECIPP_ALIGNMENT_UBYTE 255 Compu_IDENTITY 0 255 PHYS_UNIT "Severity+Class" /end CHARACTERISTIC
/begin CHARACTERISTIC FPsvr_MJ2_intF_comm "FPrm_severity(561)" VALUE 0x001E6A46 /* @ECU_Address@FPrm_severity@0x024B3231@ */ ECIPP_ALIGNMENT_UBYTE 255 Compu_IDENTITY 0 255 PHYS_UNIT "Severity+Class" /end CHARACTERISTIC
/begin CHARACTERISTIC FPsvr_MJ2_intF_Vhi "FPrm_severity(557)" VALUE 0x001E6A42 /* @ECU_Address@FPrm_severity@0x024B322D@ */ ECIPP_ALIGNMENT_UBYTE 255 Compu_IDENTITY 0 255 PHYS_UNIT "Severity+Class" /end CHARACTERISTIC
/begin CHARACTERISTIC FPsvr_MJ2_intF_Vlo "FPrm_severity(558)" VALUE 0x001E6A43 /* @ECU_Address@FPrm_severity@0x024B322E@ */ ECIPP_ALIGNMENT_UBYTE 255 Compu_IDENTITY 0 255 PHYS_UNIT "Severity+Class" /end CHARACTERISTIC
/begin CHARACTERISTIC FPsvr_MJ2_Pe_HiExp "FPrm_severity(554)" VALUE 0x001E6A3F /* @ECU_Address@FPrm_severity@0x024B322A@ */ ECIPP_ALIGNMENT_UBYTE 255 Compu_IDENTITY 0 255 PHYS_UNIT "Severity+Class" /end CHARACTERISTIC
/begin CHARACTERISTIC FPsvr_MJ2_Pe_LoExp "FPrm_severity(555)" VALUE 0x001E6A40 /* @ECU_Address@FPrm_severity@0x024B322B@ */ ECIPP_ALIGNMENT_UBYTE 255 Compu_IDENTITY 0 255 PHYS_UNIT "Severity+Class" /end CHARACTERISTIC
/begin CHARACTERISTIC FPsvr_NOx_hi "FPrm_severity(623)" VALUE 0x001E6A84 /* @ECU_Address@FPrm_severity@0x024B326F@ */ ECIPP_ALIGNMENT_UBYTE 255 Compu_IDENTITY 0 255 PHYS_UNIT "Severity+Class" /end CHARACTERISTIC
/begin CHARACTERISTIC FPsvr_OilP_comm_lost "FPrm_severity(721)" VALUE 0x001E6AE6 /* @ECU_Address@FPrm_severity@0x024B32D1@ */ ECIPP_ALIGNMENT_UBYTE 255 Compu_IDENTITY 0 255 PHYS_UNIT "Severity+Class" /end CHARACTERISTIC
/begin CHARACTERISTIC FPsvr_OilP_hiP "FPrm_severity(109)" VALUE 0x001E6882 /* @ECU_Address@FPrm_severity@0x024B306D@ */ ECIPP_ALIGNMENT_UBYTE 255 Compu_IDENTITY 0 255 PHYS_UNIT "Severity+Class" /end CHARACTERISTIC
/begin CHARACTERISTIC FPsvr_OilP_loP "FPrm_severity(108)" VALUE 0x001E6881 /* @ECU_Address@FPrm_severity@0x024B306C@ */ ECIPP_ALIGNMENT_UBYTE 255 Compu_IDENTITY 0 255 PHYS_UNIT "Severity+Class" /end CHARACTERISTIC
/begin CHARACTERISTIC FPsvr_OilP_maxV "FPrm_severity(110)" VALUE 0x001E6883 /* @ECU_Address@FPrm_severity@0x024B306E@ */ ECIPP_ALIGNMENT_UBYTE 255 Compu_IDENTITY 0 255 PHYS_UNIT "Severity+Class" /end CHARACTERISTIC
/begin CHARACTERISTIC FPsvr_OilP_minV "FPrm_severity(111)" VALUE 0x001E6884 /* @ECU_Address@FPrm_severity@0x024B306F@ */ ECIPP_ALIGNMENT_UBYTE 255 Compu_IDENTITY 0 255 PHYS_UNIT "Severity+Class" /end CHARACTERISTIC
/begin CHARACTERISTIC FPsvr_OILP_test "FPrm_severity(40)" VALUE 0x001E683D /* @ECU_Address@FPrm_severity@0x024B3028@ */ ECIPP_ALIGNMENT_UBYTE 255 Compu_IDENTITY 0 255 PHYS_UNIT "Severity+Class" /end CHARACTERISTIC
/begin CHARACTERISTIC FPsvr_OilP_VlvStk "FPrm_severity(718)" VALUE 0x001E6AE3 /* @ECU_Address@FPrm_severity@0x024B32CE@ */ ECIPP_ALIGNMENT_UBYTE 255 Compu_IDENTITY 0 255 PHYS_UNIT "Severity+Class" /end CHARACTERISTIC
/begin CHARACTERISTIC FPsvr_OilP2_loP "FPrm_severity(215)" VALUE 0x001E68EC /* @ECU_Address@FPrm_severity@0x024B30D7@ */ ECIPP_ALIGNMENT_UBYTE 255 Compu_IDENTITY 0 255 PHYS_UNIT "Severity+Class" /end CHARACTERISTIC
/begin CHARACTERISTIC FPsvr_OILTL_loss "FPrm_severity(567)" VALUE 0x001E6A4C /* @ECU_Address@FPrm_severity@0x024B3237@ */ ECIPP_ALIGNMENT_UBYTE 255 Compu_IDENTITY 0 255 PHYS_UNIT "Severity+Class" /end CHARACTERISTIC
/begin CHARACTERISTIC FPsvr_OILTL_Lvl_lo "FPrm_severity(571)" VALUE 0x001E6A50 /* @ECU_Address@FPrm_severity@0x024B323B@ */ ECIPP_ALIGNMENT_UBYTE 255 Compu_IDENTITY 0 255 PHYS_UNIT "Severity+Class" /end CHARACTERISTIC
/begin CHARACTERISTIC FPsvr_OILTL_Lvl_OOR "FPrm_severity(569)" VALUE 0x001E6A4E /* @ECU_Address@FPrm_severity@0x024B3239@ */ ECIPP_ALIGNMENT_UBYTE 255 Compu_IDENTITY 0 255 PHYS_UNIT "Severity+Class" /end CHARACTERISTIC
/begin CHARACTERISTIC FPsvr_OILTL_T_hi "FPrm_severity(572)" VALUE 0x001E6A51 /* @ECU_Address@FPrm_severity@0x024B323C@ */ ECIPP_ALIGNMENT_UBYTE 255 Compu_IDENTITY 0 255 PHYS_UNIT "Severity+Class" /end CHARACTERISTIC
/begin CHARACTERISTIC FPsvr_OILTL_T_OOR "FPrm_severity(570)" VALUE 0x001E6A4F /* @ECU_Address@FPrm_severity@0x024B323A@ */ ECIPP_ALIGNMENT_UBYTE 255 Compu_IDENTITY 0 255 PHYS_UNIT "Severity+Class" /end CHARACTERISTIC
/begin CHARACTERISTIC FPsvr_OILTL_V_OOR "FPrm_severity(568)" VALUE 0x001E6A4D /* @ECU_Address@FPrm_severity@0x024B3238@ */ ECIPP_ALIGNMENT_UBYTE 255 Compu_IDENTITY 0 255 PHYS_UNIT "Severity+Class" /end CHARACTERISTIC
/begin CHARACTERISTIC FPsvr_PAUX_dP1_max "FPrm_severity(416)" VALUE 0x001E69B5 /* @ECU_Address@FPrm_severity@0x024B31A0@ */ ECIPP_ALIGNMENT_UBYTE 255 Compu_IDENTITY 0 255 PHYS_UNIT "Severity+Class" /end CHARACTERISTIC
/begin CHARACTERISTIC FPsvr_PAUX_dP1_min "FPrm_severity(417)" VALUE 0x001E69B6 /* @ECU_Address@FPrm_severity@0x024B31A1@ */ ECIPP_ALIGNMENT_UBYTE 255 Compu_IDENTITY 0 255 PHYS_UNIT "Severity+Class" /end CHARACTERISTIC
/begin CHARACTERISTIC FPsvr_PAUX_dP2_max "FPrm_severity(418)" VALUE 0x001E69B7 /* @ECU_Address@FPrm_severity@0x024B31A2@ */ ECIPP_ALIGNMENT_UBYTE 255 Compu_IDENTITY 0 255 PHYS_UNIT "Severity+Class" /end CHARACTERISTIC
/begin CHARACTERISTIC FPsvr_PAUX_dP2_min "FPrm_severity(419)" VALUE 0x001E69B8 /* @ECU_Address@FPrm_severity@0x024B31A3@ */ ECIPP_ALIGNMENT_UBYTE 255 Compu_IDENTITY 0 255 PHYS_UNIT "Severity+Class" /end CHARACTERISTIC
/begin CHARACTERISTIC FPsvr_PAUX1_max "FPrm_severity(408)" VALUE 0x001E69AD /* @ECU_Address@FPrm_severity@0x024B3198@ */ ECIPP_ALIGNMENT_UBYTE 255 Compu_IDENTITY 0 255 PHYS_UNIT "Severity+Class" /end CHARACTERISTIC
/begin CHARACTERISTIC FPsvr_PAUX1_min "FPrm_severity(409)" VALUE 0x001E69AE /* @ECU_Address@FPrm_severity@0x024B3199@ */ ECIPP_ALIGNMENT_UBYTE 255 Compu_IDENTITY 0 255 PHYS_UNIT "Severity+Class" /end CHARACTERISTIC
/begin CHARACTERISTIC FPsvr_PAUX2_max "FPrm_severity(410)" VALUE 0x001E69AF /* @ECU_Address@FPrm_severity@0x024B319A@ */ ECIPP_ALIGNMENT_UBYTE 255 Compu_IDENTITY 0 255 PHYS_UNIT "Severity+Class" /end CHARACTERISTIC
/begin CHARACTERISTIC FPsvr_PAUX2_min "FPrm_severity(411)" VALUE 0x001E69B0 /* @ECU_Address@FPrm_severity@0x024B319B@ */ ECIPP_ALIGNMENT_UBYTE 255 Compu_IDENTITY 0 255 PHYS_UNIT "Severity+Class" /end CHARACTERISTIC
/begin CHARACTERISTIC FPsvr_PAUX3_max "FPrm_severity(412)" VALUE 0x001E69B1 /* @ECU_Address@FPrm_severity@0x024B319C@ */ ECIPP_ALIGNMENT_UBYTE 255 Compu_IDENTITY 0 255 PHYS_UNIT "Severity+Class" /end CHARACTERISTIC
/begin CHARACTERISTIC FPsvr_PAUX3_min "FPrm_severity(413)" VALUE 0x001E69B2 /* @ECU_Address@FPrm_severity@0x024B319D@ */ ECIPP_ALIGNMENT_UBYTE 255 Compu_IDENTITY 0 255 PHYS_UNIT "Severity+Class" /end CHARACTERISTIC
/begin CHARACTERISTIC FPsvr_PAUX4_max "FPrm_severity(414)" VALUE 0x001E69B3 /* @ECU_Address@FPrm_severity@0x024B319E@ */ ECIPP_ALIGNMENT_UBYTE 255 Compu_IDENTITY 0 255 PHYS_UNIT "Severity+Class" /end CHARACTERISTIC
/begin CHARACTERISTIC FPsvr_PAUX4_min "FPrm_severity(415)" VALUE 0x001E69B4 /* @ECU_Address@FPrm_severity@0x024B319F@ */ ECIPP_ALIGNMENT_UBYTE 255 Compu_IDENTITY 0 255 PHYS_UNIT "Severity+Class" /end CHARACTERISTIC
/begin CHARACTERISTIC FPsvr_post_cntrl_hi_lmt "FPrm_severity(717)" VALUE 0x001E6AE2 /* @ECU_Address@FPrm_severity@0x024B32CD@ */ ECIPP_ALIGNMENT_UBYTE 255 Compu_IDENTITY 0 255 PHYS_UNIT "Severity+Class" /end CHARACTERISTIC
/begin CHARACTERISTIC FPsvr_post_cntrl_lo_lmt "FPrm_severity(716)" VALUE 0x001E6AE1 /* @ECU_Address@FPrm_severity@0x024B32CC@ */ ECIPP_ALIGNMENT_UBYTE 255 Compu_IDENTITY 0 255 PHYS_UNIT "Severity+Class" /end CHARACTERISTIC
/begin CHARACTERISTIC FPsvr_PPEG_BP "FPrm_severity(500)" VALUE 0x001E6A09 /* @ECU_Address@FPrm_severity@0x024B31F4@ */ ECIPP_ALIGNMENT_UBYTE 255 Compu_IDENTITY 0 255 PHYS_UNIT "Severity+Class" /end CHARACTERISTIC
/begin CHARACTERISTIC FPsvr_PPEG_CVP1 "FPrm_severity(575)" VALUE 0x001E6A54 /* @ECU_Address@FPrm_severity@0x024B323F@ */ ECIPP_ALIGNMENT_UBYTE 255 Compu_IDENTITY 0 255 PHYS_UNIT "Severity+Class" /end CHARACTERISTIC
/begin CHARACTERISTIC FPsvr_PPEG_CVP2 "FPrm_severity(576)" VALUE 0x001E6A55 /* @ECU_Address@FPrm_severity@0x024B3240@ */ ECIPP_ALIGNMENT_UBYTE 255 Compu_IDENTITY 0 255 PHYS_UNIT "Severity+Class" /end CHARACTERISTIC
/begin CHARACTERISTIC FPsvr_PPEG_EBP "FPrm_severity(501)" VALUE 0x001E6A0A /* @ECU_Address@FPrm_severity@0x024B31F5@ */ ECIPP_ALIGNMENT_UBYTE 255 Compu_IDENTITY 0 255 PHYS_UNIT "Severity+Class" /end CHARACTERISTIC
/begin CHARACTERISTIC FPsvr_PPEG_EGRdP "FPrm_severity(586)" VALUE 0x001E6A5F /* @ECU_Address@FPrm_severity@0x024B324A@ */ ECIPP_ALIGNMENT_UBYTE 255 Compu_IDENTITY 0 255 PHYS_UNIT "Severity+Class" /end CHARACTERISTIC
/begin CHARACTERISTIC FPsvr_PPEG_EGRHP "FPrm_severity(503)" VALUE 0x001E6A0C /* @ECU_Address@FPrm_severity@0x024B31F7@ */ ECIPP_ALIGNMENT_UBYTE 255 Compu_IDENTITY 0 255 PHYS_UNIT "Severity+Class" /end CHARACTERISTIC
/begin CHARACTERISTIC FPsvr_PPEG_EGRLP "FPrm_severity(502)" VALUE 0x001E6A0B /* @ECU_Address@FPrm_severity@0x024B31F6@ */ ECIPP_ALIGNMENT_UBYTE 255 Compu_IDENTITY 0 255 PHYS_UNIT "Severity+Class" /end CHARACTERISTIC
/begin CHARACTERISTIC FPsvr_PPEG_EGRwrP "FPrm_severity(505)" VALUE 0x001E6A0E /* @ECU_Address@FPrm_severity@0x024B31F9@ */ ECIPP_ALIGNMENT_UBYTE 255 Compu_IDENTITY 0 255 PHYS_UNIT "Severity+Class" /end CHARACTERISTIC
/begin CHARACTERISTIC FPsvr_PPEG_MAP "FPrm_severity(506)" VALUE 0x001E6A0F /* @ECU_Address@FPrm_severity@0x024B31FA@ */ ECIPP_ALIGNMENT_UBYTE 255 Compu_IDENTITY 0 255 PHYS_UNIT "Severity+Class" /end CHARACTERISTIC
/begin CHARACTERISTIC FPsvr_PPEG_TIP "FPrm_severity(504)" VALUE 0x001E6A0D /* @ECU_Address@FPrm_severity@0x024B31F8@ */ ECIPP_ALIGNMENT_UBYTE 255 Compu_IDENTITY 0 255 PHYS_UNIT "Severity+Class" /end CHARACTERISTIC
/begin CHARACTERISTIC FPsvr_Pri1_open "FPrm_severity(703)" VALUE 0x001E6AD4 /* @ECU_Address@FPrm_severity@0x024B32BF@ */ ECIPP_ALIGNMENT_UBYTE 255 Compu_IDENTITY 0 255 PHYS_UNIT "Severity+Class" /end CHARACTERISTIC
/begin CHARACTERISTIC FPsvr_Pri1_short "FPrm_severity(704)" VALUE 0x001E6AD5 /* @ECU_Address@FPrm_severity@0x024B32C0@ */ ECIPP_ALIGNMENT_UBYTE 255 Compu_IDENTITY 0 255 PHYS_UNIT "Severity+Class" /end CHARACTERISTIC
/begin CHARACTERISTIC FPsvr_PWM1_off_loVf "FPrm_severity(147)" VALUE 0x001E68A8 /* @ECU_Address@FPrm_severity@0x024B3093@ */ ECIPP_ALIGNMENT_UBYTE 255 Compu_IDENTITY 0 255 PHYS_UNIT "Severity+Class" /end CHARACTERISTIC
/begin CHARACTERISTIC FPsvr_PWM1_on_hiVf "FPrm_severity(148)" VALUE 0x001E68A9 /* @ECU_Address@FPrm_severity@0x024B3094@ */ ECIPP_ALIGNMENT_UBYTE 255 Compu_IDENTITY 0 255 PHYS_UNIT "Severity+Class" /end CHARACTERISTIC
/begin CHARACTERISTIC FPsvr_PWM10_off_loVf "FPrm_severity(330)" VALUE 0x001E695F /* @ECU_Address@FPrm_severity@0x024B314A@ */ ECIPP_ALIGNMENT_UBYTE 255 Compu_IDENTITY 0 255 PHYS_UNIT "Severity+Class" /end CHARACTERISTIC
/begin CHARACTERISTIC FPsvr_PWM10_on_hiVf "FPrm_severity(331)" VALUE 0x001E6960 /* @ECU_Address@FPrm_severity@0x024B314B@ */ ECIPP_ALIGNMENT_UBYTE 255 Compu_IDENTITY 0 255 PHYS_UNIT "Severity+Class" /end CHARACTERISTIC
/begin CHARACTERISTIC FPsvr_PWM11_off_loVf "FPrm_severity(332)" VALUE 0x001E6961 /* @ECU_Address@FPrm_severity@0x024B314C@ */ ECIPP_ALIGNMENT_UBYTE 255 Compu_IDENTITY 0 255 PHYS_UNIT "Severity+Class" /end CHARACTERISTIC
/begin CHARACTERISTIC FPsvr_PWM11_on_hiVf "FPrm_severity(333)" VALUE 0x001E6962 /* @ECU_Address@FPrm_severity@0x024B314D@ */ ECIPP_ALIGNMENT_UBYTE 255 Compu_IDENTITY 0 255 PHYS_UNIT "Severity+Class" /end CHARACTERISTIC
/begin CHARACTERISTIC FPsvr_PWM12_off_loVf "FPrm_severity(334)" VALUE 0x001E6963 /* @ECU_Address@FPrm_severity@0x024B314E@ */ ECIPP_ALIGNMENT_UBYTE 255 Compu_IDENTITY 0 255 PHYS_UNIT "Severity+Class" /end CHARACTERISTIC
/begin CHARACTERISTIC FPsvr_PWM12_on_hiVf "FPrm_severity(335)" VALUE 0x001E6964 /* @ECU_Address@FPrm_severity@0x024B314F@ */ ECIPP_ALIGNMENT_UBYTE 255 Compu_IDENTITY 0 255 PHYS_UNIT "Severity+Class" /end CHARACTERISTIC
/begin CHARACTERISTIC FPsvr_PWM13_off_loVf "FPrm_severity(336)" VALUE 0x001E6965 /* @ECU_Address@FPrm_severity@0x024B3150@ */ ECIPP_ALIGNMENT_UBYTE 255 Compu_IDENTITY 0 255 PHYS_UNIT "Severity+Class" /end CHARACTERISTIC
/begin CHARACTERISTIC FPsvr_PWM13_on_hiVf "FPrm_severity(337)" VALUE 0x001E6966 /* @ECU_Address@FPrm_severity@0x024B3151@ */ ECIPP_ALIGNMENT_UBYTE 255 Compu_IDENTITY 0 255 PHYS_UNIT "Severity+Class" /end CHARACTERISTIC
/begin CHARACTERISTIC FPsvr_PWM14_off_loVf "FPrm_severity(338)" VALUE 0x001E6967 /* @ECU_Address@FPrm_severity@0x024B3152@ */ ECIPP_ALIGNMENT_UBYTE 255 Compu_IDENTITY 0 255 PHYS_UNIT "Severity+Class" /end CHARACTERISTIC
/begin CHARACTERISTIC FPsvr_PWM14_on_hiVf "FPrm_severity(339)" VALUE 0x001E6968 /* @ECU_Address@FPrm_severity@0x024B3153@ */ ECIPP_ALIGNMENT_UBYTE 255 Compu_IDENTITY 0 255 PHYS_UNIT "Severity+Class" /end CHARACTERISTIC
/begin CHARACTERISTIC FPsvr_PWM15_off_loVf "FPrm_severity(340)" VALUE 0x001E6969 /* @ECU_Address@FPrm_severity@0x024B3154@ */ ECIPP_ALIGNMENT_UBYTE 255 Compu_IDENTITY 0 255 PHYS_UNIT "Severity+Class" /end CHARACTERISTIC
/begin CHARACTERISTIC FPsvr_PWM15_on_hiVf "FPrm_severity(341)" VALUE 0x001E696A /* @ECU_Address@FPrm_severity@0x024B3155@ */ ECIPP_ALIGNMENT_UBYTE 255 Compu_IDENTITY 0 255 PHYS_UNIT "Severity+Class" /end CHARACTERISTIC
/begin CHARACTERISTIC FPsvr_PWM16_off_loVf "FPrm_severity(342)" VALUE 0x001E696B /* @ECU_Address@FPrm_severity@0x024B3156@ */ ECIPP_ALIGNMENT_UBYTE 255 Compu_IDENTITY 0 255 PHYS_UNIT "Severity+Class" /end CHARACTERISTIC
/begin CHARACTERISTIC FPsvr_PWM16_on_hiVf "FPrm_severity(343)" VALUE 0x001E696C /* @ECU_Address@FPrm_severity@0x024B3157@ */ ECIPP_ALIGNMENT_UBYTE 255 Compu_IDENTITY 0 255 PHYS_UNIT "Severity+Class" /end CHARACTERISTIC
/begin CHARACTERISTIC FPsw_ext1_MJ_intF_circ "FPrm_switches_ext1(98)" VALUE 0x001C7642 /* @ECU_Address@FPrm_switches_ext1@0x023A50C4@ */ ECIPP_ALIGNMENT_UWORD 65535 Compu_IDENTITY 0 65535 PHYS_UNIT "Enable bits" /end CHARACTERISTIC
/begin CHARACTERISTIC FPsw_ext1_MJ_intF_comm "FPrm_switches_ext1(99)" VALUE 0x001C7644 /* @ECU_Address@FPrm_switches_ext1@0x023A50C6@ */ ECIPP_ALIGNMENT_UWORD 65535 Compu_IDENTITY 0 65535 PHYS_UNIT "Enable bits" /end CHARACTERISTIC
/begin CHARACTERISTIC FPsw_ext1_MJ_intF_Vhi "FPrm_switches_ext1(95)" VALUE 0x001C763C /* @ECU_Address@FPrm_switches_ext1@0x023A50BE@ */ ECIPP_ALIGNMENT_UWORD 65535 Compu_IDENTITY 0 65535 PHYS_UNIT "Enable bits" /end CHARACTERISTIC
/begin CHARACTERISTIC FPsw_ext1_MJ_intF_Vlo "FPrm_switches_ext1(96)" VALUE 0x001C763E /* @ECU_Address@FPrm_switches_ext1@0x023A50C0@ */ ECIPP_ALIGNMENT_UWORD 65535 Compu_IDENTITY 0 65535 PHYS_UNIT "Enable bits" /end CHARACTERISTIC
/begin CHARACTERISTIC FPsw_ext1_MJ_Pe_HiExp "FPrm_switches_ext1(92)" VALUE 0x001C7636 /* @ECU_Address@FPrm_switches_ext1@0x023A50B8@ */ ECIPP_ALIGNMENT_UWORD 65535 Compu_IDENTITY 0 65535 PHYS_UNIT "Enable bits" /end CHARACTERISTIC
/begin CHARACTERISTIC FPsw_ext1_MJ_Pe_LoExp "FPrm_switches_ext1(93)" VALUE 0x001C7638 /* @ECU_Address@FPrm_switches_ext1@0x023A50BA@ */ ECIPP_ALIGNMENT_UWORD 65535 Compu_IDENTITY 0 65535 PHYS_UNIT "Enable bits" /end CHARACTERISTIC
/begin CHARACTERISTIC FPsw_ext1_MJ2_comm_tout "FPrm_switches_ext1(556)" VALUE 0x001C79D6 /* @ECU_Address@FPrm_switches_ext1@0x023A5458@ */ ECIPP_ALIGNMENT_UWORD 65535 Compu_IDENTITY 0 65535 PHYS_UNIT "Enable bits" /end CHARACTERISTIC
/begin CHARACTERISTIC FPsw_ext1_MJ2_intF_act "FPrm_switches_ext1(559)" VALUE 0x001C79DC /* @ECU_Address@FPrm_switches_ext1@0x023A545E@ */ ECIPP_ALIGNMENT_UWORD 65535 Compu_IDENTITY 0 65535 PHYS_UNIT "Enable bits" /end CHARACTERISTIC
/begin CHARACTERISTIC FPsw_ext1_MJ2_intF_circ "FPrm_switches_ext1(560)" VALUE 0x001C79DE /* @ECU_Address@FPrm_switches_ext1@0x023A5460@ */ ECIPP_ALIGNMENT_UWORD 65535 Compu_IDENTITY 0 65535 PHYS_UNIT "Enable bits" /end CHARACTERISTIC
/begin CHARACTERISTIC FPsw_ext1_MJ2_intF_comm "FPrm_switches_ext1(561)" VALUE 0x001C79E0 /* @ECU_Address@FPrm_switches_ext1@0x023A5462@ */ ECIPP_ALIGNMENT_UWORD 65535 Compu_IDENTITY 0 65535 PHYS_UNIT "Enable bits" /end CHARACTERISTIC
/begin CHARACTERISTIC FPsw_ext1_MJ2_intF_Vhi "FPrm_switches_ext1(557)" VALUE 0x001C79D8 /* @ECU_Address@FPrm_switches_ext1@0x023A545A@ */ ECIPP_ALIGNMENT_UWORD 65535 Compu_IDENTITY 0 65535 PHYS_UNIT "Enable bits" /end CHARACTERISTIC
/begin CHARACTERISTIC FPsw_ext1_MJ2_intF_Vlo "FPrm_switches_ext1(558)" VALUE 0x001C79DA /* @ECU_Address@FPrm_switches_ext1@0x023A545C@ */ ECIPP_ALIGNMENT_UWORD 65535 Compu_IDENTITY 0 65535 PHYS_UNIT "Enable bits" /end CHARACTERISTIC
/begin CHARACTERISTIC FPsw_ext1_MJ2_Pe_HiExp "FPrm_switches_ext1(554)" VALUE 0x001C79D2 /* @ECU_Address@FPrm_switches_ext1@0x023A5454@ */ ECIPP_ALIGNMENT_UWORD 65535 Compu_IDENTITY 0 65535 PHYS_UNIT "Enable bits" /end CHARACTERISTIC
/begin CHARACTERISTIC FPsw_ext1_MJ2_Pe_LoExp "FPrm_switches_ext1(555)" VALUE 0x001C79D4 /* @ECU_Address@FPrm_switches_ext1@0x023A5456@ */ ECIPP_ALIGNMENT_UWORD 65535 Compu_IDENTITY 0 65535 PHYS_UNIT "Enable bits" /end CHARACTERISTIC
/begin CHARACTERISTIC FPsw_ext1_NOx_hi "FPrm_switches_ext1(623)" VALUE 0x001C7A5C /* @ECU_Address@FPrm_switches_ext1@0x023A54DE@ */ ECIPP_ALIGNMENT_UWORD 65535 Compu_IDENTITY 0 65535 PHYS_UNIT "Enable bits" /end CHARACTERISTIC
/begin CHARACTERISTIC FPsw_ext1_OilP_comm_lost "FPrm_switches_ext1(721)" VALUE 0x001C7B20 /* @ECU_Address@FPrm_switches_ext1@0x023A55A2@ */ ECIPP_ALIGNMENT_UWORD 65535 Compu_IDENTITY 0 65535 PHYS_UNIT "Enable bits" /end CHARACTERISTIC
/begin CHARACTERISTIC FPsw_ext1_OilP_hiP "FPrm_switches_ext1(109)" VALUE 0x001C7658 /* @ECU_Address@FPrm_switches_ext1@0x023A50DA@ */ ECIPP_ALIGNMENT_UWORD 65535 Compu_IDENTITY 0 65535 PHYS_UNIT "Enable bits" /end CHARACTERISTIC
/begin CHARACTERISTIC FPsw_ext1_OilP_loP "FPrm_switches_ext1(108)" VALUE 0x001C7656 /* @ECU_Address@FPrm_switches_ext1@0x023A50D8@ */ ECIPP_ALIGNMENT_UWORD 65535 Compu_IDENTITY 0 65535 PHYS_UNIT "Enable bits" /end CHARACTERISTIC
/begin CHARACTERISTIC FPsw_ext1_OilP_maxV "FPrm_switches_ext1(110)" VALUE 0x001C765A /* @ECU_Address@FPrm_switches_ext1@0x023A50DC@ */ ECIPP_ALIGNMENT_UWORD 65535 Compu_IDENTITY 0 65535 PHYS_UNIT "Enable bits" /end CHARACTERISTIC
/begin CHARACTERISTIC FPsw_ext1_OilP_minV "FPrm_switches_ext1(111)" VALUE 0x001C765C /* @ECU_Address@FPrm_switches_ext1@0x023A50DE@ */ ECIPP_ALIGNMENT_UWORD 65535 Compu_IDENTITY 0 65535 PHYS_UNIT "Enable bits" /end CHARACTERISTIC
/begin CHARACTERISTIC FPsw_ext1_OILP_test "FPrm_switches_ext1(40)" VALUE 0x001C75CE /* @ECU_Address@FPrm_switches_ext1@0x023A5050@ */ ECIPP_ALIGNMENT_UWORD 65535 Compu_IDENTITY 0 65535 PHYS_UNIT "Enable bits" /end CHARACTERISTIC
/begin CHARACTERISTIC FPsw_ext1_OilP_VlvStk "FPrm_switches_ext1(718)" VALUE 0x001C7B1A /* @ECU_Address@FPrm_switches_ext1@0x023A559C@ */ ECIPP_ALIGNMENT_UWORD 65535 Compu_IDENTITY 0 65535 PHYS_UNIT "Enable bits" /end CHARACTERISTIC
/begin CHARACTERISTIC FPsw_ext1_OilP2_loP "FPrm_switches_ext1(215)" VALUE 0x001C772C /* @ECU_Address@FPrm_switches_ext1@0x023A51AE@ */ ECIPP_ALIGNMENT_UWORD 65535 Compu_IDENTITY 0 65535 PHYS_UNIT "Enable bits" /end CHARACTERISTIC
/begin CHARACTERISTIC FPsw_ext1_OILTL_loss "FPrm_switches_ext1(567)" VALUE 0x001C79EC /* @ECU_Address@FPrm_switches_ext1@0x023A546E@ */ ECIPP_ALIGNMENT_UWORD 65535 Compu_IDENTITY 0 65535 PHYS_UNIT "Enable bits" /end CHARACTERISTIC
/begin CHARACTERISTIC FPsw_ext1_OILTL_Lvl_lo "FPrm_switches_ext1(571)" VALUE 0x001C79F4 /* @ECU_Address@FPrm_switches_ext1@0x023A5476@ */ ECIPP_ALIGNMENT_UWORD 65535 Compu_IDENTITY 0 65535 PHYS_UNIT "Enable bits" /end CHARACTERISTIC
/begin CHARACTERISTIC FPsw_ext1_OILTL_Lvl_OOR "FPrm_switches_ext1(569)" VALUE 0x001C79F0 /* @ECU_Address@FPrm_switches_ext1@0x023A5472@ */ ECIPP_ALIGNMENT_UWORD 65535 Compu_IDENTITY 0 65535 PHYS_UNIT "Enable bits" /end CHARACTERISTIC
/begin CHARACTERISTIC FPsw_ext1_OILTL_T_hi "FPrm_switches_ext1(572)" VALUE 0x001C79F6 /* @ECU_Address@FPrm_switches_ext1@0x023A5478@ */ ECIPP_ALIGNMENT_UWORD 65535 Compu_IDENTITY 0 65535 PHYS_UNIT "Enable bits" /end CHARACTERISTIC
/begin CHARACTERISTIC FPsw_ext1_OILTL_T_OOR "FPrm_switches_ext1(570)" VALUE 0x001C79F2 /* @ECU_Address@FPrm_switches_ext1@0x023A5474@ */ ECIPP_ALIGNMENT_UWORD 65535 Compu_IDENTITY 0 65535 PHYS_UNIT "Enable bits" /end CHARACTERISTIC
/begin CHARACTERISTIC FPsw_ext1_OILTL_V_OOR "FPrm_switches_ext1(568)" VALUE 0x001C79EE /* @ECU_Address@FPrm_switches_ext1@0x023A5470@ */ ECIPP_ALIGNMENT_UWORD 65535 Compu_IDENTITY 0 65535 PHYS_UNIT "Enable bits" /end CHARACTERISTIC
/begin CHARACTERISTIC FPsw_ext1_PAUX_dP1_max "FPrm_switches_ext1(416)" VALUE 0x001C78BE /* @ECU_Address@FPrm_switches_ext1@0x023A5340@ */ ECIPP_ALIGNMENT_UWORD 65535 Compu_IDENTITY 0 65535 PHYS_UNIT "Enable bits" /end CHARACTERISTIC
/begin CHARACTERISTIC FPsw_ext1_PAUX_dP1_min "FPrm_switches_ext1(417)" VALUE 0x001C78C0 /* @ECU_Address@FPrm_switches_ext1@0x023A5342@ */ ECIPP_ALIGNMENT_UWORD 65535 Compu_IDENTITY 0 65535 PHYS_UNIT "Enable bits" /end CHARACTERISTIC
/begin CHARACTERISTIC FPsw_ext1_PAUX_dP2_max "FPrm_switches_ext1(418)" VALUE 0x001C78C2 /* @ECU_Address@FPrm_switches_ext1@0x023A5344@ */ ECIPP_ALIGNMENT_UWORD 65535 Compu_IDENTITY 0 65535 PHYS_UNIT "Enable bits" /end CHARACTERISTIC
/begin CHARACTERISTIC FPsw_ext1_PAUX_dP2_min "FPrm_switches_ext1(419)" VALUE 0x001C78C4 /* @ECU_Address@FPrm_switches_ext1@0x023A5346@ */ ECIPP_ALIGNMENT_UWORD 65535 Compu_IDENTITY 0 65535 PHYS_UNIT "Enable bits" /end CHARACTERISTIC
/begin CHARACTERISTIC FPsw_ext1_PAUX1_max "FPrm_switches_ext1(408)" VALUE 0x001C78AE /* @ECU_Address@FPrm_switches_ext1@0x023A5330@ */ ECIPP_ALIGNMENT_UWORD 65535 Compu_IDENTITY 0 65535 PHYS_UNIT "Enable bits" /end CHARACTERISTIC
/begin CHARACTERISTIC FPsw_ext1_PAUX1_min "FPrm_switches_ext1(409)" VALUE 0x001C78B0 /* @ECU_Address@FPrm_switches_ext1@0x023A5332@ */ ECIPP_ALIGNMENT_UWORD 65535 Compu_IDENTITY 0 65535 PHYS_UNIT "Enable bits" /end CHARACTERISTIC
/begin CHARACTERISTIC FPsw_ext1_PAUX2_max "FPrm_switches_ext1(410)" VALUE 0x001C78B2 /* @ECU_Address@FPrm_switches_ext1@0x023A5334@ */ ECIPP_ALIGNMENT_UWORD 65535 Compu_IDENTITY 0 65535 PHYS_UNIT "Enable bits" /end CHARACTERISTIC
/begin CHARACTERISTIC FPsw_ext1_PAUX2_min "FPrm_switches_ext1(411)" VALUE 0x001C78B4 /* @ECU_Address@FPrm_switches_ext1@0x023A5336@ */ ECIPP_ALIGNMENT_UWORD 65535 Compu_IDENTITY 0 65535 PHYS_UNIT "Enable bits" /end CHARACTERISTIC
/begin CHARACTERISTIC FPsw_ext1_PAUX3_max "FPrm_switches_ext1(412)" VALUE 0x001C78B6 /* @ECU_Address@FPrm_switches_ext1@0x023A5338@ */ ECIPP_ALIGNMENT_UWORD 65535 Compu_IDENTITY 0 65535 PHYS_UNIT "Enable bits" /end CHARACTERISTIC
/begin CHARACTERISTIC FPsw_ext1_PAUX3_min "FPrm_switches_ext1(413)" VALUE 0x001C78B8 /* @ECU_Address@FPrm_switches_ext1@0x023A533A@ */ ECIPP_ALIGNMENT_UWORD 65535 Compu_IDENTITY 0 65535 PHYS_UNIT "Enable bits" /end CHARACTERISTIC
/begin CHARACTERISTIC FPsw_ext1_PAUX4_max "FPrm_switches_ext1(414)" VALUE 0x001C78BA /* @ECU_Address@FPrm_switches_ext1@0x023A533C@ */ ECIPP_ALIGNMENT_UWORD 65535 Compu_IDENTITY 0 65535 PHYS_UNIT "Enable bits" /end CHARACTERISTIC
/begin CHARACTERISTIC FPsw_ext1_PAUX4_min "FPrm_switches_ext1(415)" VALUE 0x001C78BC /* @ECU_Address@FPrm_switches_ext1@0x023A533E@ */ ECIPP_ALIGNMENT_UWORD 65535 Compu_IDENTITY 0 65535 PHYS_UNIT "Enable bits" /end CHARACTERISTIC
/begin CHARACTERISTIC FPsw_ext1_post_cntrl_hi_lmt "FPrm_switches_ext1(717)" VALUE 0x001C7B18 /* @ECU_Address@FPrm_switches_ext1@0x023A559A@ */ ECIPP_ALIGNMENT_UWORD 65535 Compu_IDENTITY 0 65535 PHYS_UNIT "Enable bits" /end CHARACTERISTIC
/begin CHARACTERISTIC FPsw_ext1_post_cntrl_lo_lmt "FPrm_switches_ext1(716)" VALUE 0x001C7B16 /* @ECU_Address@FPrm_switches_ext1@0x023A5598@ */ ECIPP_ALIGNMENT_UWORD 65535 Compu_IDENTITY 0 65535 PHYS_UNIT "Enable bits" /end CHARACTERISTIC
/begin CHARACTERISTIC FPsw_ext1_PPEG_BP "FPrm_switches_ext1(500)" VALUE 0x001C7966 /* @ECU_Address@FPrm_switches_ext1@0x023A53E8@ */ ECIPP_ALIGNMENT_UWORD 65535 Compu_IDENTITY 0 65535 PHYS_UNIT "Enable bits" /end CHARACTERISTIC
/begin CHARACTERISTIC FPsw_ext1_PPEG_CVP1 "FPrm_switches_ext1(575)" VALUE 0x001C79FC /* @ECU_Address@FPrm_switches_ext1@0x023A547E@ */ ECIPP_ALIGNMENT_UWORD 65535 Compu_IDENTITY 0 65535 PHYS_UNIT "Enable bits" /end CHARACTERISTIC
/begin CHARACTERISTIC FPsw_ext1_PPEG_CVP2 "FPrm_switches_ext1(576)" VALUE 0x001C79FE /* @ECU_Address@FPrm_switches_ext1@0x023A5480@ */ ECIPP_ALIGNMENT_UWORD 65535 Compu_IDENTITY 0 65535 PHYS_UNIT "Enable bits" /end CHARACTERISTIC
/begin CHARACTERISTIC FPsw_ext1_PPEG_EBP "FPrm_switches_ext1(501)" VALUE 0x001C7968 /* @ECU_Address@FPrm_switches_ext1@0x023A53EA@ */ ECIPP_ALIGNMENT_UWORD 65535 Compu_IDENTITY 0 65535 PHYS_UNIT "Enable bits" /end CHARACTERISTIC
/begin CHARACTERISTIC FPsw_ext1_PPEG_EGRdP "FPrm_switches_ext1(586)" VALUE 0x001C7A12 /* @ECU_Address@FPrm_switches_ext1@0x023A5494@ */ ECIPP_ALIGNMENT_UWORD 65535 Compu_IDENTITY 0 65535 PHYS_UNIT "Enable bits" /end CHARACTERISTIC
/begin CHARACTERISTIC FPsw_ext1_PPEG_EGRHP "FPrm_switches_ext1(503)" VALUE 0x001C796C /* @ECU_Address@FPrm_switches_ext1@0x023A53EE@ */ ECIPP_ALIGNMENT_UWORD 65535 Compu_IDENTITY 0 65535 PHYS_UNIT "Enable bits" /end CHARACTERISTIC
/begin CHARACTERISTIC FPsw_ext1_PPEG_EGRLP "FPrm_switches_ext1(502)" VALUE 0x001C796A /* @ECU_Address@FPrm_switches_ext1@0x023A53EC@ */ ECIPP_ALIGNMENT_UWORD 65535 Compu_IDENTITY 0 65535 PHYS_UNIT "Enable bits" /end CHARACTERISTIC
/begin CHARACTERISTIC FPsw_ext1_PPEG_EGRwrP "FPrm_switches_ext1(505)" VALUE 0x001C7970 /* @ECU_Address@FPrm_switches_ext1@0x023A53F2@ */ ECIPP_ALIGNMENT_UWORD 65535 Compu_IDENTITY 0 65535 PHYS_UNIT "Enable bits" /end CHARACTERISTIC
/begin CHARACTERISTIC FPsw_ext1_PPEG_MAP "FPrm_switches_ext1(506)" VALUE 0x001C7972 /* @ECU_Address@FPrm_switches_ext1@0x023A53F4@ */ ECIPP_ALIGNMENT_UWORD 65535 Compu_IDENTITY 0 65535 PHYS_UNIT "Enable bits" /end CHARACTERISTIC
/begin CHARACTERISTIC FPsw_ext1_PPEG_TIP "FPrm_switches_ext1(504)" VALUE 0x001C796E /* @ECU_Address@FPrm_switches_ext1@0x023A53F0@ */ ECIPP_ALIGNMENT_UWORD 65535 Compu_IDENTITY 0 65535 PHYS_UNIT "Enable bits" /end CHARACTERISTIC
/begin CHARACTERISTIC FPsw_ext1_Pri1_open "FPrm_switches_ext1(703)" VALUE 0x001C7AFC /* @ECU_Address@FPrm_switches_ext1@0x023A557E@ */ ECIPP_ALIGNMENT_UWORD 65535 Compu_IDENTITY 0 65535 PHYS_UNIT "Enable bits" /end CHARACTERISTIC
/begin CHARACTERISTIC FPsw_ext1_Pri1_short "FPrm_switches_ext1(704)" VALUE 0x001C7AFE /* @ECU_Address@FPrm_switches_ext1@0x023A5580@ */ ECIPP_ALIGNMENT_UWORD 65535 Compu_IDENTITY 0 65535 PHYS_UNIT "Enable bits" /end CHARACTERISTIC
/begin CHARACTERISTIC FPsw_ext1_PWM1_off_loVf "FPrm_switches_ext1(147)" VALUE 0x001C76A4 /* @ECU_Address@FPrm_switches_ext1@0x023A5126@ */ ECIPP_ALIGNMENT_UWORD 65535 Compu_IDENTITY 0 65535 PHYS_UNIT "Enable bits" /end CHARACTERISTIC
/begin CHARACTERISTIC FPsw_ext1_PWM1_on_hiVf "FPrm_switches_ext1(148)" VALUE 0x001C76A6 /* @ECU_Address@FPrm_switches_ext1@0x023A5128@ */ ECIPP_ALIGNMENT_UWORD 65535 Compu_IDENTITY 0 65535 PHYS_UNIT "Enable bits" /end CHARACTERISTIC
/begin CHARACTERISTIC FPsw_ext1_PWM10_off_loVf "FPrm_switches_ext1(330)" VALUE 0x001C7812 /* @ECU_Address@FPrm_switches_ext1@0x023A5294@ */ ECIPP_ALIGNMENT_UWORD 65535 Compu_IDENTITY 0 65535 PHYS_UNIT "Enable bits" /end CHARACTERISTIC
/begin CHARACTERISTIC FPsw_ext1_PWM10_on_hiVf "FPrm_switches_ext1(331)" VALUE 0x001C7814 /* @ECU_Address@FPrm_switches_ext1@0x023A5296@ */ ECIPP_ALIGNMENT_UWORD 65535 Compu_IDENTITY 0 65535 PHYS_UNIT "Enable bits" /end CHARACTERISTIC
/begin CHARACTERISTIC FPsw_ext1_PWM11_off_loVf "FPrm_switches_ext1(332)" VALUE 0x001C7816 /* @ECU_Address@FPrm_switches_ext1@0x023A5298@ */ ECIPP_ALIGNMENT_UWORD 65535 Compu_IDENTITY 0 65535 PHYS_UNIT "Enable bits" /end CHARACTERISTIC
/begin CHARACTERISTIC FPsw_ext1_PWM11_on_hiVf "FPrm_switches_ext1(333)" VALUE 0x001C7818 /* @ECU_Address@FPrm_switches_ext1@0x023A529A@ */ ECIPP_ALIGNMENT_UWORD 65535 Compu_IDENTITY 0 65535 PHYS_UNIT "Enable bits" /end CHARACTERISTIC
/begin CHARACTERISTIC FPsw_ext1_PWM12_off_loVf "FPrm_switches_ext1(334)" VALUE 0x001C781A /* @ECU_Address@FPrm_switches_ext1@0x023A529C@ */ ECIPP_ALIGNMENT_UWORD 65535 Compu_IDENTITY 0 65535 PHYS_UNIT "Enable bits" /end CHARACTERISTIC
/begin CHARACTERISTIC FPsw_ext1_PWM12_on_hiVf "FPrm_switches_ext1(335)" VALUE 0x001C781C /* @ECU_Address@FPrm_switches_ext1@0x023A529E@ */ ECIPP_ALIGNMENT_UWORD 65535 Compu_IDENTITY 0 65535 PHYS_UNIT "Enable bits" /end CHARACTERISTIC
/begin CHARACTERISTIC FPsw_ext1_PWM13_off_loVf "FPrm_switches_ext1(336)" VALUE 0x001C781E /* @ECU_Address@FPrm_switches_ext1@0x023A52A0@ */ ECIPP_ALIGNMENT_UWORD 65535 Compu_IDENTITY 0 65535 PHYS_UNIT "Enable bits" /end CHARACTERISTIC
/begin CHARACTERISTIC FPsw_ext1_PWM13_on_hiVf "FPrm_switches_ext1(337)" VALUE 0x001C7820 /* @ECU_Address@FPrm_switches_ext1@0x023A52A2@ */ ECIPP_ALIGNMENT_UWORD 65535 Compu_IDENTITY 0 65535 PHYS_UNIT "Enable bits" /end CHARACTERISTIC
/begin CHARACTERISTIC FPsw_ext1_PWM14_off_loVf "FPrm_switches_ext1(338)" VALUE 0x001C7822 /* @ECU_Address@FPrm_switches_ext1@0x023A52A4@ */ ECIPP_ALIGNMENT_UWORD 65535 Compu_IDENTITY 0 65535 PHYS_UNIT "Enable bits" /end CHARACTERISTIC
/begin CHARACTERISTIC FPsw_ext1_PWM14_on_hiVf "FPrm_switches_ext1(339)" VALUE 0x001C7824 /* @ECU_Address@FPrm_switches_ext1@0x023A52A6@ */ ECIPP_ALIGNMENT_UWORD 65535 Compu_IDENTITY 0 65535 PHYS_UNIT "Enable bits" /end CHARACTERISTIC
/begin CHARACTERISTIC FPsw_ext1_PWM15_off_loVf "FPrm_switches_ext1(340)" VALUE 0x001C7826 /* @ECU_Address@FPrm_switches_ext1@0x023A52A8@ */ ECIPP_ALIGNMENT_UWORD 65535 Compu_IDENTITY 0 65535 PHYS_UNIT "Enable bits" /end CHARACTERISTIC
/begin CHARACTERISTIC FPsw_ext1_PWM15_on_hiVf "FPrm_switches_ext1(341)" VALUE 0x001C7828 /* @ECU_Address@FPrm_switches_ext1@0x023A52AA@ */ ECIPP_ALIGNMENT_UWORD 65535 Compu_IDENTITY 0 65535 PHYS_UNIT "Enable bits" /end CHARACTERISTIC
/begin CHARACTERISTIC FPsw_ext1_PWM16_off_loVf "FPrm_switches_ext1(342)" VALUE 0x001C782A /* @ECU_Address@FPrm_switches_ext1@0x023A52AC@ */ ECIPP_ALIGNMENT_UWORD 65535 Compu_IDENTITY 0 65535 PHYS_UNIT "Enable bits" /end CHARACTERISTIC
/begin CHARACTERISTIC FPsw_ext1_PWM16_on_hiVf "FPrm_switches_ext1(343)" VALUE 0x001C782C /* @ECU_Address@FPrm_switches_ext1@0x023A52AE@ */ ECIPP_ALIGNMENT_UWORD 65535 Compu_IDENTITY 0 65535 PHYS_UNIT "Enable bits" /end CHARACTERISTIC
/begin CHARACTERISTIC FPsw_MJ_intF_circ "FPrm_switches(98)" VALUE 0x001C709E /* @ECU_Address@FPrm_switches@0x021B90C4@ */ ECIPP_ALIGNMENT_UWORD 65535 Compu_IDENTITY 0 65535 PHYS_UNIT "Enable bits" /end CHARACTERISTIC
/begin CHARACTERISTIC FPsw_MJ_intF_comm "FPrm_switches(99)" VALUE 0x001C70A0 /* @ECU_Address@FPrm_switches@0x021B90C6@ */ ECIPP_ALIGNMENT_UWORD 65535 Compu_IDENTITY 0 65535 PHYS_UNIT "Enable bits" /end CHARACTERISTIC
/begin CHARACTERISTIC FPsw_MJ_intF_Vhi "FPrm_switches(95)" VALUE 0x001C7098 /* @ECU_Address@FPrm_switches@0x021B90BE@ */ ECIPP_ALIGNMENT_UWORD 65535 Compu_IDENTITY 0 65535 PHYS_UNIT "Enable bits" /end CHARACTERISTIC
/begin CHARACTERISTIC FPsw_MJ_intF_Vlo "FPrm_switches(96)" VALUE 0x001C709A /* @ECU_Address@FPrm_switches@0x021B90C0@ */ ECIPP_ALIGNMENT_UWORD 65535 Compu_IDENTITY 0 65535 PHYS_UNIT "Enable bits" /end CHARACTERISTIC
/begin CHARACTERISTIC FPsw_MJ_Pe_HiExp "FPrm_switches(92)" VALUE 0x001C7092 /* @ECU_Address@FPrm_switches@0x021B90B8@ */ ECIPP_ALIGNMENT_UWORD 65535 Compu_IDENTITY 0 65535 PHYS_UNIT "Enable bits" /end CHARACTERISTIC
/begin CHARACTERISTIC FPsw_MJ_Pe_LoExp "FPrm_switches(93)" VALUE 0x001C7094 /* @ECU_Address@FPrm_switches@0x021B90BA@ */ ECIPP_ALIGNMENT_UWORD 65535 Compu_IDENTITY 0 65535 PHYS_UNIT "Enable bits" /end CHARACTERISTIC
/begin CHARACTERISTIC FPsw_MJ2_comm_tout "FPrm_switches(556)" VALUE 0x001C7432 /* @ECU_Address@FPrm_switches@0x021B9458@ */ ECIPP_ALIGNMENT_UWORD 65535 Compu_IDENTITY 0 65535 PHYS_UNIT "Enable bits" /end CHARACTERISTIC
/begin CHARACTERISTIC FPsw_MJ2_intF_act "FPrm_switches(559)" VALUE 0x001C7438 /* @ECU_Address@FPrm_switches@0x021B945E@ */ ECIPP_ALIGNMENT_UWORD 65535 Compu_IDENTITY 0 65535 PHYS_UNIT "Enable bits" /end CHARACTERISTIC
/begin CHARACTERISTIC FPsw_MJ2_intF_circ "FPrm_switches(560)" VALUE 0x001C743A /* @ECU_Address@FPrm_switches@0x021B9460@ */ ECIPP_ALIGNMENT_UWORD 65535 Compu_IDENTITY 0 65535 PHYS_UNIT "Enable bits" /end CHARACTERISTIC
/begin CHARACTERISTIC FPsw_MJ2_intF_comm "FPrm_switches(561)" VALUE 0x001C743C /* @ECU_Address@FPrm_switches@0x021B9462@ */ ECIPP_ALIGNMENT_UWORD 65535 Compu_IDENTITY 0 65535 PHYS_UNIT "Enable bits" /end CHARACTERISTIC
/begin CHARACTERISTIC FPsw_MJ2_intF_Vhi "FPrm_switches(557)" VALUE 0x001C7434 /* @ECU_Address@FPrm_switches@0x021B945A@ */ ECIPP_ALIGNMENT_UWORD 65535 Compu_IDENTITY 0 65535 PHYS_UNIT "Enable bits" /end CHARACTERISTIC
/begin CHARACTERISTIC FPsw_MJ2_intF_Vlo "FPrm_switches(558)" VALUE 0x001C7436 /* @ECU_Address@FPrm_switches@0x021B945C@ */ ECIPP_ALIGNMENT_UWORD 65535 Compu_IDENTITY 0 65535 PHYS_UNIT "Enable bits" /end CHARACTERISTIC
/begin CHARACTERISTIC FPsw_MJ2_Pe_HiExp "FPrm_switches(554)" VALUE 0x001C742E /* @ECU_Address@FPrm_switches@0x021B9454@ */ ECIPP_ALIGNMENT_UWORD 65535 Compu_IDENTITY 0 65535 PHYS_UNIT "Enable bits" /end CHARACTERISTIC
/begin CHARACTERISTIC FPsw_MJ2_Pe_LoExp "FPrm_switches(555)" VALUE 0x001C7430 /* @ECU_Address@FPrm_switches@0x021B9456@ */ ECIPP_ALIGNMENT_UWORD 65535 Compu_IDENTITY 0 65535 PHYS_UNIT "Enable bits" /end CHARACTERISTIC
/begin CHARACTERISTIC FPsw_NOx_hi "FPrm_switches(623)" VALUE 0x001C74B8 /* @ECU_Address@FPrm_switches@0x021B94DE@ */ ECIPP_ALIGNMENT_UWORD 65535 Compu_IDENTITY 0 65535 PHYS_UNIT "Enable bits" /end CHARACTERISTIC
/begin CHARACTERISTIC FPsw_OilP_comm_lost "FPrm_switches(721)" VALUE 0x001C757C /* @ECU_Address@FPrm_switches@0x021B95A2@ */ ECIPP_ALIGNMENT_UWORD 65535 Compu_IDENTITY 0 65535 PHYS_UNIT "Enable bits" /end CHARACTERISTIC
/begin CHARACTERISTIC FPsw_OilP_hiP "FPrm_switches(109)" VALUE 0x001C70B4 /* @ECU_Address@FPrm_switches@0x021B90DA@ */ ECIPP_ALIGNMENT_UWORD 65535 Compu_IDENTITY 0 65535 PHYS_UNIT "Enable bits" /end CHARACTERISTIC
/begin CHARACTERISTIC FPsw_OilP_loP "FPrm_switches(108)" VALUE 0x001C70B2 /* @ECU_Address@FPrm_switches@0x021B90D8@ */ ECIPP_ALIGNMENT_UWORD 65535 Compu_IDENTITY 0 65535 PHYS_UNIT "Enable bits" /end CHARACTERISTIC
/begin CHARACTERISTIC FPsw_OilP_maxV "FPrm_switches(110)" VALUE 0x001C70B6 /* @ECU_Address@FPrm_switches@0x021B90DC@ */ ECIPP_ALIGNMENT_UWORD 65535 Compu_IDENTITY 0 65535 PHYS_UNIT "Enable bits" /end CHARACTERISTIC
/begin CHARACTERISTIC FPsw_OilP_minV "FPrm_switches(111)" VALUE 0x001C70B8 /* @ECU_Address@FPrm_switches@0x021B90DE@ */ ECIPP_ALIGNMENT_UWORD 65535 Compu_IDENTITY 0 65535 PHYS_UNIT "Enable bits" /end CHARACTERISTIC
/begin CHARACTERISTIC FPsw_OILP_test "FPrm_switches(40)" VALUE 0x001C702A /* @ECU_Address@FPrm_switches@0x021B9050@ */ ECIPP_ALIGNMENT_UWORD 65535 Compu_IDENTITY 0 65535 PHYS_UNIT "Enable bits" /end CHARACTERISTIC
/begin CHARACTERISTIC FPsw_OilP_VlvStk "FPrm_switches(718)" VALUE 0x001C7576 /* @ECU_Address@FPrm_switches@0x021B959C@ */ ECIPP_ALIGNMENT_UWORD 65535 Compu_IDENTITY 0 65535 PHYS_UNIT "Enable bits" /end CHARACTERISTIC
/begin CHARACTERISTIC FPsw_OilP2_loP "FPrm_switches(215)" VALUE 0x001C7188 /* @ECU_Address@FPrm_switches@0x021B91AE@ */ ECIPP_ALIGNMENT_UWORD 65535 Compu_IDENTITY 0 65535 PHYS_UNIT "Enable bits" /end CHARACTERISTIC
/begin CHARACTERISTIC FPsw_OILTL_loss "FPrm_switches(567)" VALUE 0x001C7448 /* @ECU_Address@FPrm_switches@0x021B946E@ */ ECIPP_ALIGNMENT_UWORD 65535 Compu_IDENTITY 0 65535 PHYS_UNIT "Enable bits" /end CHARACTERISTIC
/begin CHARACTERISTIC FPsw_OILTL_Lvl_lo "FPrm_switches(571)" VALUE 0x001C7450 /* @ECU_Address@FPrm_switches@0x021B9476@ */ ECIPP_ALIGNMENT_UWORD 65535 Compu_IDENTITY 0 65535 PHYS_UNIT "Enable bits" /end CHARACTERISTIC
/begin CHARACTERISTIC FPsw_OILTL_Lvl_OOR "FPrm_switches(569)" VALUE 0x001C744C /* @ECU_Address@FPrm_switches@0x021B9472@ */ ECIPP_ALIGNMENT_UWORD 65535 Compu_IDENTITY 0 65535 PHYS_UNIT "Enable bits" /end CHARACTERISTIC
/begin CHARACTERISTIC FPsw_OILTL_T_hi "FPrm_switches(572)" VALUE 0x001C7452 /* @ECU_Address@FPrm_switches@0x021B9478@ */ ECIPP_ALIGNMENT_UWORD 65535 Compu_IDENTITY 0 65535 PHYS_UNIT "Enable bits" /end CHARACTERISTIC
/begin CHARACTERISTIC FPsw_OILTL_T_OOR "FPrm_switches(570)" VALUE 0x001C744E /* @ECU_Address@FPrm_switches@0x021B9474@ */ ECIPP_ALIGNMENT_UWORD 65535 Compu_IDENTITY 0 65535 PHYS_UNIT "Enable bits" /end CHARACTERISTIC
/begin CHARACTERISTIC FPsw_OILTL_V_OOR "FPrm_switches(568)" VALUE 0x001C744A /* @ECU_Address@FPrm_switches@0x021B9470@ */ ECIPP_ALIGNMENT_UWORD 65535 Compu_IDENTITY 0 65535 PHYS_UNIT "Enable bits" /end CHARACTERISTIC
/begin CHARACTERISTIC FPsw_PAUX_dP1_max "FPrm_switches(416)" VALUE 0x001C731A /* @ECU_Address@FPrm_switches@0x021B9340@ */ ECIPP_ALIGNMENT_UWORD 65535 Compu_IDENTITY 0 65535 PHYS_UNIT "Enable bits" /end CHARACTERISTIC
/begin CHARACTERISTIC FPsw_PAUX_dP1_min "FPrm_switches(417)" VALUE 0x001C731C /* @ECU_Address@FPrm_switches@0x021B9342@ */ ECIPP_ALIGNMENT_UWORD 65535 Compu_IDENTITY 0 65535 PHYS_UNIT "Enable bits" /end CHARACTERISTIC
/begin CHARACTERISTIC FPsw_PAUX_dP2_max "FPrm_switches(418)" VALUE 0x001C731E /* @ECU_Address@FPrm_switches@0x021B9344@ */ ECIPP_ALIGNMENT_UWORD 65535 Compu_IDENTITY 0 65535 PHYS_UNIT "Enable bits" /end CHARACTERISTIC
/begin CHARACTERISTIC FPsw_PAUX_dP2_min "FPrm_switches(419)" VALUE 0x001C7320 /* @ECU_Address@FPrm_switches@0x021B9346@ */ ECIPP_ALIGNMENT_UWORD 65535 Compu_IDENTITY 0 65535 PHYS_UNIT "Enable bits" /end CHARACTERISTIC
/begin CHARACTERISTIC FPsw_PAUX1_max "FPrm_switches(408)" VALUE 0x001C730A /* @ECU_Address@FPrm_switches@0x021B9330@ */ ECIPP_ALIGNMENT_UWORD 65535 Compu_IDENTITY 0 65535 PHYS_UNIT "Enable bits" /end CHARACTERISTIC
/begin CHARACTERISTIC FPsw_PAUX1_min "FPrm_switches(409)" VALUE 0x001C730C /* @ECU_Address@FPrm_switches@0x021B9332@ */ ECIPP_ALIGNMENT_UWORD 65535 Compu_IDENTITY 0 65535 PHYS_UNIT "Enable bits" /end CHARACTERISTIC
/begin CHARACTERISTIC FPsw_PAUX2_max "FPrm_switches(410)" VALUE 0x001C730E /* @ECU_Address@FPrm_switches@0x021B9334@ */ ECIPP_ALIGNMENT_UWORD 65535 Compu_IDENTITY 0 65535 PHYS_UNIT "Enable bits" /end CHARACTERISTIC
/begin CHARACTERISTIC FPsw_PAUX2_min "FPrm_switches(411)" VALUE 0x001C7310 /* @ECU_Address@FPrm_switches@0x021B9336@ */ ECIPP_ALIGNMENT_UWORD 65535 Compu_IDENTITY 0 65535 PHYS_UNIT "Enable bits" /end CHARACTERISTIC
/begin CHARACTERISTIC FPsw_PAUX3_max "FPrm_switches(412)" VALUE 0x001C7312 /* @ECU_Address@FPrm_switches@0x021B9338@ */ ECIPP_ALIGNMENT_UWORD 65535 Compu_IDENTITY 0 65535 PHYS_UNIT "Enable bits" /end CHARACTERISTIC
/begin CHARACTERISTIC FPsw_PAUX3_min "FPrm_switches(413)" VALUE 0x001C7314 /* @ECU_Address@FPrm_switches@0x021B933A@ */ ECIPP_ALIGNMENT_UWORD 65535 Compu_IDENTITY 0 65535 PHYS_UNIT "Enable bits" /end CHARACTERISTIC
/begin CHARACTERISTIC FPsw_PAUX4_max "FPrm_switches(414)" VALUE 0x001C7316 /* @ECU_Address@FPrm_switches@0x021B933C@ */ ECIPP_ALIGNMENT_UWORD 65535 Compu_IDENTITY 0 65535 PHYS_UNIT "Enable bits" /end CHARACTERISTIC
/begin CHARACTERISTIC FPsw_PAUX4_min "FPrm_switches(415)" VALUE 0x001C7318 /* @ECU_Address@FPrm_switches@0x021B933E@ */ ECIPP_ALIGNMENT_UWORD 65535 Compu_IDENTITY 0 65535 PHYS_UNIT "Enable bits" /end CHARACTERISTIC
/begin CHARACTERISTIC FPsw_post_cntrl_hi_lmt "FPrm_switches(717)" VALUE 0x001C7574 /* @ECU_Address@FPrm_switches@0x021B959A@ */ ECIPP_ALIGNMENT_UWORD 65535 Compu_IDENTITY 0 65535 PHYS_UNIT "Enable bits" /end CHARACTERISTIC
/begin CHARACTERISTIC FPsw_post_cntrl_lo_lmt "FPrm_switches(716)" VALUE 0x001C7572 /* @ECU_Address@FPrm_switches@0x021B9598@ */ ECIPP_ALIGNMENT_UWORD 65535 Compu_IDENTITY 0 65535 PHYS_UNIT "Enable bits" /end CHARACTERISTIC
/begin CHARACTERISTIC FPsw_PPEG_BP "FPrm_switches(500)" VALUE 0x001C73C2 /* @ECU_Address@FPrm_switches@0x021B93E8@ */ ECIPP_ALIGNMENT_UWORD 65535 Compu_IDENTITY 0 65535 PHYS_UNIT "Enable bits" /end CHARACTERISTIC
/begin CHARACTERISTIC FPsw_PPEG_CVP1 "FPrm_switches(575)" VALUE 0x001C7458 /* @ECU_Address@FPrm_switches@0x021B947E@ */ ECIPP_ALIGNMENT_UWORD 65535 Compu_IDENTITY 0 65535 PHYS_UNIT "Enable bits" /end CHARACTERISTIC
/begin CHARACTERISTIC FPsw_PPEG_CVP2 "FPrm_switches(576)" VALUE 0x001C745A /* @ECU_Address@FPrm_switches@0x021B9480@ */ ECIPP_ALIGNMENT_UWORD 65535 Compu_IDENTITY 0 65535 PHYS_UNIT "Enable bits" /end CHARACTERISTIC
/begin CHARACTERISTIC FPsw_PPEG_EBP "FPrm_switches(501)" VALUE 0x001C73C4 /* @ECU_Address@FPrm_switches@0x021B93EA@ */ ECIPP_ALIGNMENT_UWORD 65535 Compu_IDENTITY 0 65535 PHYS_UNIT "Enable bits" /end CHARACTERISTIC
/begin CHARACTERISTIC FPsw_PPEG_EGRdP "FPrm_switches(586)" VALUE 0x001C746E /* @ECU_Address@FPrm_switches@0x021B9494@ */ ECIPP_ALIGNMENT_UWORD 65535 Compu_IDENTITY 0 65535 PHYS_UNIT "Enable bits" /end CHARACTERISTIC
/begin CHARACTERISTIC FPsw_PPEG_EGRHP "FPrm_switches(503)" VALUE 0x001C73C8 /* @ECU_Address@FPrm_switches@0x021B93EE@ */ ECIPP_ALIGNMENT_UWORD 65535 Compu_IDENTITY 0 65535 PHYS_UNIT "Enable bits" /end CHARACTERISTIC
/begin CHARACTERISTIC FPsw_PPEG_EGRLP "FPrm_switches(502)" VALUE 0x001C73C6 /* @ECU_Address@FPrm_switches@0x021B93EC@ */ ECIPP_ALIGNMENT_UWORD 65535 Compu_IDENTITY 0 65535 PHYS_UNIT "Enable bits" /end CHARACTERISTIC
/begin CHARACTERISTIC FPsw_PPEG_EGRwrP "FPrm_switches(505)" VALUE 0x001C73CC /* @ECU_Address@FPrm_switches@0x021B93F2@ */ ECIPP_ALIGNMENT_UWORD 65535 Compu_IDENTITY 0 65535 PHYS_UNIT "Enable bits" /end CHARACTERISTIC
/begin CHARACTERISTIC FPsw_PPEG_MAP "FPrm_switches(506)" VALUE 0x001C73CE /* @ECU_Address@FPrm_switches@0x021B93F4@ */ ECIPP_ALIGNMENT_UWORD 65535 Compu_IDENTITY 0 65535 PHYS_UNIT "Enable bits" /end CHARACTERISTIC
/begin CHARACTERISTIC FPsw_PPEG_TIP "FPrm_switches(504)" VALUE 0x001C73CA /* @ECU_Address@FPrm_switches@0x021B93F0@ */ ECIPP_ALIGNMENT_UWORD 65535 Compu_IDENTITY 0 65535 PHYS_UNIT "Enable bits" /end CHARACTERISTIC
/begin CHARACTERISTIC FPsw_Pri1_open "FPrm_switches(703)" VALUE 0x001C7558 /* @ECU_Address@FPrm_switches@0x021B957E@ */ ECIPP_ALIGNMENT_UWORD 65535 Compu_IDENTITY 0 65535 PHYS_UNIT "Enable bits" /end CHARACTERISTIC
/begin CHARACTERISTIC FPsw_Pri1_short "FPrm_switches(704)" VALUE 0x001C755A /* @ECU_Address@FPrm_switches@0x021B9580@ */ ECIPP_ALIGNMENT_UWORD 65535 Compu_IDENTITY 0 65535 PHYS_UNIT "Enable bits" /end CHARACTERISTIC
/begin CHARACTERISTIC FPsw_PWM1_off_loVf "FPrm_switches(147)" VALUE 0x001C7100 /* @ECU_Address@FPrm_switches@0x021B9126@ */ ECIPP_ALIGNMENT_UWORD 65535 Compu_IDENTITY 0 65535 PHYS_UNIT "Enable bits" /end CHARACTERISTIC
/begin CHARACTERISTIC FPsw_PWM1_on_hiVf "FPrm_switches(148)" VALUE 0x001C7102 /* @ECU_Address@FPrm_switches@0x021B9128@ */ ECIPP_ALIGNMENT_UWORD 65535 Compu_IDENTITY 0 65535 PHYS_UNIT "Enable bits" /end CHARACTERISTIC
/begin CHARACTERISTIC FPsw_PWM10_off_loVf "FPrm_switches(330)" VALUE 0x001C726E /* @ECU_Address@FPrm_switches@0x021B9294@ */ ECIPP_ALIGNMENT_UWORD 65535 Compu_IDENTITY 0 65535 PHYS_UNIT "Enable bits" /end CHARACTERISTIC
/begin CHARACTERISTIC FPsw_PWM10_on_hiVf "FPrm_switches(331)" VALUE 0x001C7270 /* @ECU_Address@FPrm_switches@0x021B9296@ */ ECIPP_ALIGNMENT_UWORD 65535 Compu_IDENTITY 0 65535 PHYS_UNIT "Enable bits" /end CHARACTERISTIC
/begin CHARACTERISTIC FPsw_PWM11_off_loVf "FPrm_switches(332)" VALUE 0x001C7272 /* @ECU_Address@FPrm_switches@0x021B9298@ */ ECIPP_ALIGNMENT_UWORD 65535 Compu_IDENTITY 0 65535 PHYS_UNIT "Enable bits" /end CHARACTERISTIC
/begin CHARACTERISTIC FPsw_PWM11_on_hiVf "FPrm_switches(333)" VALUE 0x001C7274 /* @ECU_Address@FPrm_switches@0x021B929A@ */ ECIPP_ALIGNMENT_UWORD 65535 Compu_IDENTITY 0 65535 PHYS_UNIT "Enable bits" /end CHARACTERISTIC
/begin CHARACTERISTIC FPsw_PWM12_off_loVf "FPrm_switches(334)" VALUE 0x001C7276 /* @ECU_Address@FPrm_switches@0x021B929C@ */ ECIPP_ALIGNMENT_UWORD 65535 Compu_IDENTITY 0 65535 PHYS_UNIT "Enable bits" /end CHARACTERISTIC
/begin CHARACTERISTIC FPsw_PWM12_on_hiVf "FPrm_switches(335)" VALUE 0x001C7278 /* @ECU_Address@FPrm_switches@0x021B929E@ */ ECIPP_ALIGNMENT_UWORD 65535 Compu_IDENTITY 0 65535 PHYS_UNIT "Enable bits" /end CHARACTERISTIC
/begin CHARACTERISTIC FPsw_PWM13_off_loVf "FPrm_switches(336)" VALUE 0x001C727A /* @ECU_Address@FPrm_switches@0x021B92A0@ */ ECIPP_ALIGNMENT_UWORD 65535 Compu_IDENTITY 0 65535 PHYS_UNIT "Enable bits" /end CHARACTERISTIC
/begin CHARACTERISTIC FPsw_PWM13_on_hiVf "FPrm_switches(337)" VALUE 0x001C727C /* @ECU_Address@FPrm_switches@0x021B92A2@ */ ECIPP_ALIGNMENT_UWORD 65535 Compu_IDENTITY 0 65535 PHYS_UNIT "Enable bits" /end CHARACTERISTIC
/begin CHARACTERISTIC FPsw_PWM14_off_loVf "FPrm_switches(338)" VALUE 0x001C727E /* @ECU_Address@FPrm_switches@0x021B92A4@ */ ECIPP_ALIGNMENT_UWORD 65535 Compu_IDENTITY 0 65535 PHYS_UNIT "Enable bits" /end CHARACTERISTIC
/begin CHARACTERISTIC FPsw_PWM14_on_hiVf "FPrm_switches(339)" VALUE 0x001C7280 /* @ECU_Address@FPrm_switches@0x021B92A6@ */ ECIPP_ALIGNMENT_UWORD 65535 Compu_IDENTITY 0 65535 PHYS_UNIT "Enable bits" /end CHARACTERISTIC
/begin CHARACTERISTIC FPsw_PWM15_off_loVf "FPrm_switches(340)" VALUE 0x001C7282 /* @ECU_Address@FPrm_switches@0x021B92A8@ */ ECIPP_ALIGNMENT_UWORD 65535 Compu_IDENTITY 0 65535 PHYS_UNIT "Enable bits" /end CHARACTERISTIC
/begin CHARACTERISTIC FPsw_PWM15_on_hiVf "FPrm_switches(341)" VALUE 0x001C7284 /* @ECU_Address@FPrm_switches@0x021B92AA@ */ ECIPP_ALIGNMENT_UWORD 65535 Compu_IDENTITY 0 65535 PHYS_UNIT "Enable bits" /end CHARACTERISTIC
/begin CHARACTERISTIC FPsw_PWM16_off_loVf "FPrm_switches(342)" VALUE 0x001C7286 /* @ECU_Address@FPrm_switches@0x021B92AC@ */ ECIPP_ALIGNMENT_UWORD 65535 Compu_IDENTITY 0 65535 PHYS_UNIT "Enable bits" /end CHARACTERISTIC
/begin CHARACTERISTIC FPsw_PWM16_on_hiVf "FPrm_switches(343)" VALUE 0x001C7288 /* @ECU_Address@FPrm_switches@0x021B92AE@ */ ECIPP_ALIGNMENT_UWORD 65535 Compu_IDENTITY 0 65535 PHYS_UNIT "Enable bits" /end CHARACTERISTIC
/begin CHARACTERISTIC FCdtc_MJ_intF_circ "FCtl_DTC(139)" VALUE 0x001E3980 /* @ECU_Address@FCtl_DTC@0x021B5116@ */ ECIPP_ALIGNMENT_UWORD 65535 Compu_IDENTITY 0 65535 PHYS_UNIT "DTC" /end CHARACTERISTIC
/begin CHARACTERISTIC FCdtc_MJ_intF_comm "FCtl_DTC(140)" VALUE 0x001E3982 /* @ECU_Address@FCtl_DTC@0x021B5118@ */ ECIPP_ALIGNMENT_UWORD 65535 Compu_IDENTITY 0 65535 PHYS_UNIT "DTC" /end CHARACTERISTIC
/begin CHARACTERISTIC FCdtc_MJ_intF_Vhi "FCtl_DTC(136)" VALUE 0x001E397A /* @ECU_Address@FCtl_DTC@0x021B5110@ */ ECIPP_ALIGNMENT_UWORD 65535 Compu_IDENTITY 0 65535 PHYS_UNIT "DTC" /end CHARACTERISTIC
/begin CHARACTERISTIC FCdtc_MJ_intF_Vlo "FCtl_DTC(137)" VALUE 0x001E397C /* @ECU_Address@FCtl_DTC@0x021B5112@ */ ECIPP_ALIGNMENT_UWORD 65535 Compu_IDENTITY 0 65535 PHYS_UNIT "DTC" /end CHARACTERISTIC
/begin CHARACTERISTIC FCdtc_MJ_Pe_HiExp "FCtl_DTC(133)" VALUE 0x001E3974 /* @ECU_Address@FCtl_DTC@0x021B510A@ */ ECIPP_ALIGNMENT_UWORD 65535 Compu_IDENTITY 0 65535 PHYS_UNIT "DTC" /end CHARACTERISTIC
/begin CHARACTERISTIC FCdtc_MJ_Pe_LoExp "FCtl_DTC(134)" VALUE 0x001E3976 /* @ECU_Address@FCtl_DTC@0x021B510C@ */ ECIPP_ALIGNMENT_UWORD 65535 Compu_IDENTITY 0 65535 PHYS_UNIT "DTC" /end CHARACTERISTIC
/begin CHARACTERISTIC FCdtc_MJ2_comm_tout "FCtl_DTC(726)" VALUE 0x001E3E16 /* @ECU_Address@FCtl_DTC@0x021B55AC@ */ ECIPP_ALIGNMENT_UWORD 65535 Compu_IDENTITY 0 65535 PHYS_UNIT "DTC" /end CHARACTERISTIC
/begin CHARACTERISTIC FCdtc_MJ2_intF_act "FCtl_DTC(729)" VALUE 0x001E3E1C /* @ECU_Address@FCtl_DTC@0x021B55B2@ */ ECIPP_ALIGNMENT_UWORD 65535 Compu_IDENTITY 0 65535 PHYS_UNIT "DTC" /end CHARACTERISTIC
/begin CHARACTERISTIC FCdtc_MJ2_intF_circ "FCtl_DTC(730)" VALUE 0x001E3E1E /* @ECU_Address@FCtl_DTC@0x021B55B4@ */ ECIPP_ALIGNMENT_UWORD 65535 Compu_IDENTITY 0 65535 PHYS_UNIT "DTC" /end CHARACTERISTIC
/begin CHARACTERISTIC FCdtc_MJ2_intF_comm "FCtl_DTC(731)" VALUE 0x001E3E20 /* @ECU_Address@FCtl_DTC@0x021B55B6@ */ ECIPP_ALIGNMENT_UWORD 65535 Compu_IDENTITY 0 65535 PHYS_UNIT "DTC" /end CHARACTERISTIC
/begin CHARACTERISTIC FCdtc_MJ2_intF_Vhi "FCtl_DTC(727)" VALUE 0x001E3E18 /* @ECU_Address@FCtl_DTC@0x021B55AE@ */ ECIPP_ALIGNMENT_UWORD 65535 Compu_IDENTITY 0 65535 PHYS_UNIT "DTC" /end CHARACTERISTIC
/begin CHARACTERISTIC FCdtc_MJ2_intF_Vlo "FCtl_DTC(728)" VALUE 0x001E3E1A /* @ECU_Address@FCtl_DTC@0x021B55B0@ */ ECIPP_ALIGNMENT_UWORD 65535 Compu_IDENTITY 0 65535 PHYS_UNIT "DTC" /end CHARACTERISTIC
/begin CHARACTERISTIC FCdtc_MJ2_Pe_HiExp "FCtl_DTC(724)" VALUE 0x001E3E12 /* @ECU_Address@FCtl_DTC@0x021B55A8@ */ ECIPP_ALIGNMENT_UWORD 65535 Compu_IDENTITY 0 65535 PHYS_UNIT "DTC" /end CHARACTERISTIC
/begin CHARACTERISTIC FCdtc_MJ2_Pe_LoExp "FCtl_DTC(725)" VALUE 0x001E3E14 /* @ECU_Address@FCtl_DTC@0x021B55AA@ */ ECIPP_ALIGNMENT_UWORD 65535 Compu_IDENTITY 0 65535 PHYS_UNIT "DTC" /end CHARACTERISTIC
/begin CHARACTERISTIC FCdtc_NOx_hi "FCtl_DTC(793)" VALUE 0x001E3E9C /* @ECU_Address@FCtl_DTC@0x021B5632@ */ ECIPP_ALIGNMENT_UWORD 65535 Compu_IDENTITY 0 65535 PHYS_UNIT "DTC" /end CHARACTERISTIC
/begin CHARACTERISTIC FCdtc_OilP_comm_lost "FCtl_DTC(1045)" VALUE 0x001E4094 /* @ECU_Address@FCtl_DTC@0x021B582A@ */ ECIPP_ALIGNMENT_UWORD 65535 Compu_IDENTITY 0 65535 PHYS_UNIT "DTC" /end CHARACTERISTIC
/begin CHARACTERISTIC FCdtc_OilP_hiP "FCtl_DTC(149)" VALUE 0x001E3994 /* @ECU_Address@FCtl_DTC@0x021B512A@ */ ECIPP_ALIGNMENT_UWORD 65535 Compu_IDENTITY 0 65535 PHYS_UNIT "DTC" /end CHARACTERISTIC
/begin CHARACTERISTIC FCdtc_OilP_loP "FCtl_DTC(148)" VALUE 0x001E3992 /* @ECU_Address@FCtl_DTC@0x021B5128@ */ ECIPP_ALIGNMENT_UWORD 65535 Compu_IDENTITY 0 65535 PHYS_UNIT "DTC" /end CHARACTERISTIC
/begin CHARACTERISTIC FCdtc_OilP_maxV "FCtl_DTC(150)" VALUE 0x001E3996 /* @ECU_Address@FCtl_DTC@0x021B512C@ */ ECIPP_ALIGNMENT_UWORD 65535 Compu_IDENTITY 0 65535 PHYS_UNIT "DTC" /end CHARACTERISTIC
/begin CHARACTERISTIC FCdtc_OilP_minV "FCtl_DTC(151)" VALUE 0x001E3998 /* @ECU_Address@FCtl_DTC@0x021B512E@ */ ECIPP_ALIGNMENT_UWORD 65535 Compu_IDENTITY 0 65535 PHYS_UNIT "DTC" /end CHARACTERISTIC
/begin CHARACTERISTIC FCdtc_OILP_test "FCtl_DTC(29)" VALUE 0x001E38A4 /* @ECU_Address@FCtl_DTC@0x021B503A@ */ ECIPP_ALIGNMENT_UWORD 65535 Compu_IDENTITY 0 65535 PHYS_UNIT "DTC" /end CHARACTERISTIC
/begin CHARACTERISTIC FCdtc_OilP_VlvStk "FCtl_DTC(1042)" VALUE 0x001E408E /* @ECU_Address@FCtl_DTC@0x021B5824@ */ ECIPP_ALIGNMENT_UWORD 65535 Compu_IDENTITY 0 65535 PHYS_UNIT "DTC" /end CHARACTERISTIC
/begin CHARACTERISTIC FCdtc_OilP2_loP "FCtl_DTC(293)" VALUE 0x001E3AB4 /* @ECU_Address@FCtl_DTC@0x021B524A@ */ ECIPP_ALIGNMENT_UWORD 65535 Compu_IDENTITY 0 65535 PHYS_UNIT "DTC" /end CHARACTERISTIC
/begin CHARACTERISTIC FCdtc_OILTL_loss "FCtl_DTC(737)" VALUE 0x001E3E2C /* @ECU_Address@FCtl_DTC@0x021B55C2@ */ ECIPP_ALIGNMENT_UWORD 65535 Compu_IDENTITY 0 65535 PHYS_UNIT "DTC" /end CHARACTERISTIC
/begin CHARACTERISTIC FCdtc_OILTL_Lvl_lo "FCtl_DTC(741)" VALUE 0x001E3E34 /* @ECU_Address@FCtl_DTC@0x021B55CA@ */ ECIPP_ALIGNMENT_UWORD 65535 Compu_IDENTITY 0 65535 PHYS_UNIT "DTC" /end CHARACTERISTIC
/begin CHARACTERISTIC FCdtc_OILTL_Lvl_OOR "FCtl_DTC(739)" VALUE 0x001E3E30 /* @ECU_Address@FCtl_DTC@0x021B55C6@ */ ECIPP_ALIGNMENT_UWORD 65535 Compu_IDENTITY 0 65535 PHYS_UNIT "DTC" /end CHARACTERISTIC
/begin CHARACTERISTIC FCdtc_OILTL_T_hi "FCtl_DTC(742)" VALUE 0x001E3E36 /* @ECU_Address@FCtl_DTC@0x021B55CC@ */ ECIPP_ALIGNMENT_UWORD 65535 Compu_IDENTITY 0 65535 PHYS_UNIT "DTC" /end CHARACTERISTIC
/begin CHARACTERISTIC FCdtc_OILTL_T_OOR "FCtl_DTC(740)" VALUE 0x001E3E32 /* @ECU_Address@FCtl_DTC@0x021B55C8@ */ ECIPP_ALIGNMENT_UWORD 65535 Compu_IDENTITY 0 65535 PHYS_UNIT "DTC" /end CHARACTERISTIC
/begin CHARACTERISTIC FCdtc_OILTL_V_OOR "FCtl_DTC(738)" VALUE 0x001E3E2E /* @ECU_Address@FCtl_DTC@0x021B55C4@ */ ECIPP_ALIGNMENT_UWORD 65535 Compu_IDENTITY 0 65535 PHYS_UNIT "DTC" /end CHARACTERISTIC
/begin CHARACTERISTIC FCdtc_PAUX_dP1_max "FCtl_DTC(546)" VALUE 0x001E3CAE /* @ECU_Address@FCtl_DTC@0x021B5444@ */ ECIPP_ALIGNMENT_UWORD 65535 Compu_IDENTITY 0 65535 PHYS_UNIT "DTC" /end CHARACTERISTIC
/begin CHARACTERISTIC FCdtc_PAUX_dP1_min "FCtl_DTC(547)" VALUE 0x001E3CB0 /* @ECU_Address@FCtl_DTC@0x021B5446@ */ ECIPP_ALIGNMENT_UWORD 65535 Compu_IDENTITY 0 65535 PHYS_UNIT "DTC" /end CHARACTERISTIC
/begin CHARACTERISTIC FCdtc_PAUX_dP2_max "FCtl_DTC(548)" VALUE 0x001E3CB2 /* @ECU_Address@FCtl_DTC@0x021B5448@ */ ECIPP_ALIGNMENT_UWORD 65535 Compu_IDENTITY 0 65535 PHYS_UNIT "DTC" /end CHARACTERISTIC
/begin CHARACTERISTIC FCdtc_PAUX_dP2_min "FCtl_DTC(549)" VALUE 0x001E3CB4 /* @ECU_Address@FCtl_DTC@0x021B544A@ */ ECIPP_ALIGNMENT_UWORD 65535 Compu_IDENTITY 0 65535 PHYS_UNIT "DTC" /end CHARACTERISTIC
/begin CHARACTERISTIC FCdtc_PAUX1_max "FCtl_DTC(538)" VALUE 0x001E3C9E /* @ECU_Address@FCtl_DTC@0x021B5434@ */ ECIPP_ALIGNMENT_UWORD 65535 Compu_IDENTITY 0 65535 PHYS_UNIT "DTC" /end CHARACTERISTIC
/begin CHARACTERISTIC FCdtc_PAUX1_min "FCtl_DTC(539)" VALUE 0x001E3CA0 /* @ECU_Address@FCtl_DTC@0x021B5436@ */ ECIPP_ALIGNMENT_UWORD 65535 Compu_IDENTITY 0 65535 PHYS_UNIT "DTC" /end CHARACTERISTIC
/begin CHARACTERISTIC FCdtc_PAUX2_max "FCtl_DTC(540)" VALUE 0x001E3CA2 /* @ECU_Address@FCtl_DTC@0x021B5438@ */ ECIPP_ALIGNMENT_UWORD 65535 Compu_IDENTITY 0 65535 PHYS_UNIT "DTC" /end CHARACTERISTIC
/begin CHARACTERISTIC FCdtc_PAUX2_min "FCtl_DTC(541)" VALUE 0x001E3CA4 /* @ECU_Address@FCtl_DTC@0x021B543A@ */ ECIPP_ALIGNMENT_UWORD 65535 Compu_IDENTITY 0 65535 PHYS_UNIT "DTC" /end CHARACTERISTIC
/begin CHARACTERISTIC FCdtc_PAUX3_max "FCtl_DTC(542)" VALUE 0x001E3CA6 /* @ECU_Address@FCtl_DTC@0x021B543C@ */ ECIPP_ALIGNMENT_UWORD 65535 Compu_IDENTITY 0 65535 PHYS_UNIT "DTC" /end CHARACTERISTIC
/begin CHARACTERISTIC FCdtc_PAUX3_min "FCtl_DTC(543)" VALUE 0x001E3CA8 /* @ECU_Address@FCtl_DTC@0x021B543E@ */ ECIPP_ALIGNMENT_UWORD 65535 Compu_IDENTITY 0 65535 PHYS_UNIT "DTC" /end CHARACTERISTIC
/begin CHARACTERISTIC FCdtc_PAUX4_max "FCtl_DTC(544)" VALUE 0x001E3CAA /* @ECU_Address@FCtl_DTC@0x021B5440@ */ ECIPP_ALIGNMENT_UWORD 65535 Compu_IDENTITY 0 65535 PHYS_UNIT "DTC" /end CHARACTERISTIC
/begin CHARACTERISTIC FCdtc_PAUX4_min "FCtl_DTC(545)" VALUE 0x001E3CAC /* @ECU_Address@FCtl_DTC@0x021B5442@ */ ECIPP_ALIGNMENT_UWORD 65535 Compu_IDENTITY 0 65535 PHYS_UNIT "DTC" /end CHARACTERISTIC
/begin CHARACTERISTIC FCdtc_post_cntrl_hi_lmt "FCtl_DTC(1041)" VALUE 0x001E408C /* @ECU_Address@FCtl_DTC@0x021B5822@ */ ECIPP_ALIGNMENT_UWORD 65535 Compu_IDENTITY 0 65535 PHYS_UNIT "DTC" /end CHARACTERISTIC
/begin CHARACTERISTIC FCdtc_post_cntrl_lo_lmt "FCtl_DTC(1040)" VALUE 0x001E408A /* @ECU_Address@FCtl_DTC@0x021B5820@ */ ECIPP_ALIGNMENT_UWORD 65535 Compu_IDENTITY 0 65535 PHYS_UNIT "DTC" /end CHARACTERISTIC
/begin CHARACTERISTIC FCdtc_PPEG_BP "FCtl_DTC(670)" VALUE 0x001E3DA6 /* @ECU_Address@FCtl_DTC@0x021B553C@ */ ECIPP_ALIGNMENT_UWORD 65535 Compu_IDENTITY 0 65535 PHYS_UNIT "DTC" /end CHARACTERISTIC
/begin CHARACTERISTIC FCdtc_PPEG_CVP1 "FCtl_DTC(745)" VALUE 0x001E3E3C /* @ECU_Address@FCtl_DTC@0x021B55D2@ */ ECIPP_ALIGNMENT_UWORD 65535 Compu_IDENTITY 0 65535 PHYS_UNIT "DTC" /end CHARACTERISTIC
/begin CHARACTERISTIC FCdtc_PPEG_CVP2 "FCtl_DTC(746)" VALUE 0x001E3E3E /* @ECU_Address@FCtl_DTC@0x021B55D4@ */ ECIPP_ALIGNMENT_UWORD 65535 Compu_IDENTITY 0 65535 PHYS_UNIT "DTC" /end CHARACTERISTIC
/begin CHARACTERISTIC FCdtc_PPEG_EBP "FCtl_DTC(671)" VALUE 0x001E3DA8 /* @ECU_Address@FCtl_DTC@0x021B553E@ */ ECIPP_ALIGNMENT_UWORD 65535 Compu_IDENTITY 0 65535 PHYS_UNIT "DTC" /end CHARACTERISTIC
/begin CHARACTERISTIC FCdtc_PPEG_EGRdP "FCtl_DTC(756)" VALUE 0x001E3E52 /* @ECU_Address@FCtl_DTC@0x021B55E8@ */ ECIPP_ALIGNMENT_UWORD 65535 Compu_IDENTITY 0 65535 PHYS_UNIT "DTC" /end CHARACTERISTIC
/begin CHARACTERISTIC FCdtc_PPEG_EGRHP "FCtl_DTC(673)" VALUE 0x001E3DAC /* @ECU_Address@FCtl_DTC@0x021B5542@ */ ECIPP_ALIGNMENT_UWORD 65535 Compu_IDENTITY 0 65535 PHYS_UNIT "DTC" /end CHARACTERISTIC
/begin CHARACTERISTIC FCdtc_PPEG_EGRLP "FCtl_DTC(672)" VALUE 0x001E3DAA /* @ECU_Address@FCtl_DTC@0x021B5540@ */ ECIPP_ALIGNMENT_UWORD 65535 Compu_IDENTITY 0 65535 PHYS_UNIT "DTC" /end CHARACTERISTIC
/begin CHARACTERISTIC FCdtc_PPEG_EGRwrP "FCtl_DTC(675)" VALUE 0x001E3DB0 /* @ECU_Address@FCtl_DTC@0x021B5546@ */ ECIPP_ALIGNMENT_UWORD 65535 Compu_IDENTITY 0 65535 PHYS_UNIT "DTC" /end CHARACTERISTIC
/begin CHARACTERISTIC FCdtc_PPEG_MAP "FCtl_DTC(676)" VALUE 0x001E3DB2 /* @ECU_Address@FCtl_DTC@0x021B5548@ */ ECIPP_ALIGNMENT_UWORD 65535 Compu_IDENTITY 0 65535 PHYS_UNIT "DTC" /end CHARACTERISTIC
/begin CHARACTERISTIC FCdtc_PPEG_TIP "FCtl_DTC(674)" VALUE 0x001E3DAE /* @ECU_Address@FCtl_DTC@0x021B5544@ */ ECIPP_ALIGNMENT_UWORD 65535 Compu_IDENTITY 0 65535 PHYS_UNIT "DTC" /end CHARACTERISTIC
/begin CHARACTERISTIC FCdtc_Pri1_open "FCtl_DTC(901)" VALUE 0x001E3F74 /* @ECU_Address@FCtl_DTC@0x021B570A@ */ ECIPP_ALIGNMENT_UWORD 65535 Compu_IDENTITY 0 65535 PHYS_UNIT "DTC" /end CHARACTERISTIC
/begin CHARACTERISTIC FCdtc_Pri1_short "FCtl_DTC(913)" VALUE 0x001E3F8C /* @ECU_Address@FCtl_DTC@0x021B5722@ */ ECIPP_ALIGNMENT_UWORD 65535 Compu_IDENTITY 0 65535 PHYS_UNIT "DTC" /end CHARACTERISTIC
/begin CHARACTERISTIC FCdtc_PWM1_off_loVf "FCtl_DTC(189)" VALUE 0x001E39E4 /* @ECU_Address@FCtl_DTC@0x021B517A@ */ ECIPP_ALIGNMENT_UWORD 65535 Compu_IDENTITY 0 65535 PHYS_UNIT "DTC" /end CHARACTERISTIC
/begin CHARACTERISTIC FCdtc_PWM1_on_hiVf "FCtl_DTC(190)" VALUE 0x001E39E6 /* @ECU_Address@FCtl_DTC@0x021B517C@ */ ECIPP_ALIGNMENT_UWORD 65535 Compu_IDENTITY 0 65535 PHYS_UNIT "DTC" /end CHARACTERISTIC
/begin CHARACTERISTIC FCdtc_PWM10_off_loVf "FCtl_DTC(433)" VALUE 0x001E3BCC /* @ECU_Address@FCtl_DTC@0x021B5362@ */ ECIPP_ALIGNMENT_UWORD 65535 Compu_IDENTITY 0 65535 PHYS_UNIT "DTC" /end CHARACTERISTIC
/begin CHARACTERISTIC FCdtc_PWM10_on_hiVf "FCtl_DTC(434)" VALUE 0x001E3BCE /* @ECU_Address@FCtl_DTC@0x021B5364@ */ ECIPP_ALIGNMENT_UWORD 65535 Compu_IDENTITY 0 65535 PHYS_UNIT "DTC" /end CHARACTERISTIC
/begin CHARACTERISTIC FCdtc_PWM11_off_loVf "FCtl_DTC(435)" VALUE 0x001E3BD0 /* @ECU_Address@FCtl_DTC@0x021B5366@ */ ECIPP_ALIGNMENT_UWORD 65535 Compu_IDENTITY 0 65535 PHYS_UNIT "DTC" /end CHARACTERISTIC
/begin CHARACTERISTIC FCdtc_PWM11_on_hiVf "FCtl_DTC(436)" VALUE 0x001E3BD2 /* @ECU_Address@FCtl_DTC@0x021B5368@ */ ECIPP_ALIGNMENT_UWORD 65535 Compu_IDENTITY 0 65535 PHYS_UNIT "DTC" /end CHARACTERISTIC
/begin CHARACTERISTIC FCdtc_PWM12_off_loVf "FCtl_DTC(437)" VALUE 0x001E3BD4 /* @ECU_Address@FCtl_DTC@0x021B536A@ */ ECIPP_ALIGNMENT_UWORD 65535 Compu_IDENTITY 0 65535 PHYS_UNIT "DTC" /end CHARACTERISTIC
/begin CHARACTERISTIC FCdtc_PWM12_on_hiVf "FCtl_DTC(438)" VALUE 0x001E3BD6 /* @ECU_Address@FCtl_DTC@0x021B536C@ */ ECIPP_ALIGNMENT_UWORD 65535 Compu_IDENTITY 0 65535 PHYS_UNIT "DTC" /end CHARACTERISTIC
/begin CHARACTERISTIC FCdtc_PWM13_off_loVf "FCtl_DTC(439)" VALUE 0x001E3BD8 /* @ECU_Address@FCtl_DTC@0x021B536E@ */ ECIPP_ALIGNMENT_UWORD 65535 Compu_IDENTITY 0 65535 PHYS_UNIT "DTC" /end CHARACTERISTIC
/begin CHARACTERISTIC FCdtc_PWM13_on_hiVf "FCtl_DTC(440)" VALUE 0x001E3BDA /* @ECU_Address@FCtl_DTC@0x021B5370@ */ ECIPP_ALIGNMENT_UWORD 65535 Compu_IDENTITY 0 65535 PHYS_UNIT "DTC" /end CHARACTERISTIC
/begin CHARACTERISTIC FCdtc_PWM14_off_loVf "FCtl_DTC(441)" VALUE 0x001E3BDC /* @ECU_Address@FCtl_DTC@0x021B5372@ */ ECIPP_ALIGNMENT_UWORD 65535 Compu_IDENTITY 0 65535 PHYS_UNIT "DTC" /end CHARACTERISTIC
/begin CHARACTERISTIC FCdtc_PWM14_on_hiVf "FCtl_DTC(442)" VALUE 0x001E3BDE /* @ECU_Address@FCtl_DTC@0x021B5374@ */ ECIPP_ALIGNMENT_UWORD 65535 Compu_IDENTITY 0 65535 PHYS_UNIT "DTC" /end CHARACTERISTIC
/begin CHARACTERISTIC FCdtc_PWM15_off_loVf "FCtl_DTC(443)" VALUE 0x001E3BE0 /* @ECU_Address@FCtl_DTC@0x021B5376@ */ ECIPP_ALIGNMENT_UWORD 65535 Compu_IDENTITY 0 65535 PHYS_UNIT "DTC" /end CHARACTERISTIC
/begin CHARACTERISTIC FCdtc_PWM15_on_hiVf "FCtl_DTC(444)" VALUE 0x001E3BE2 /* @ECU_Address@FCtl_DTC@0x021B5378@ */ ECIPP_ALIGNMENT_UWORD 65535 Compu_IDENTITY 0 65535 PHYS_UNIT "DTC" /end CHARACTERISTIC
/begin CHARACTERISTIC FCdtc_PWM16_off_loVf "FCtl_DTC(445)" VALUE 0x001E3BE4 /* @ECU_Address@FCtl_DTC@0x021B537A@ */ ECIPP_ALIGNMENT_UWORD 65535 Compu_IDENTITY 0 65535 PHYS_UNIT "DTC" /end CHARACTERISTIC
/begin CHARACTERISTIC FCdtc_PWM16_on_hiVf "FCtl_DTC(446)" VALUE 0x001E3BE6 /* @ECU_Address@FCtl_DTC@0x021B537C@ */ ECIPP_ALIGNMENT_UWORD 65535 Compu_IDENTITY 0 65535 PHYS_UNIT "DTC" /end CHARACTERISTIC
/begin CHARACTERISTIC FCfmi_MJ_intF_circ "FCtl_FMI(139)" VALUE 0x001E598C /* @ECU_Address@FCtl_FMI@0x021B708B@ */ ECIPP_ALIGNMENT_UBYTE 255 Compu_IDENTITY 0 255 PHYS_UNIT "FMI" /end CHARACTERISTIC
/begin CHARACTERISTIC FCfmi_MJ_intF_comm "FCtl_FMI(140)" VALUE 0x001E598D /* @ECU_Address@FCtl_FMI@0x021B708C@ */ ECIPP_ALIGNMENT_UBYTE 255 Compu_IDENTITY 0 255 PHYS_UNIT "FMI" /end CHARACTERISTIC
/begin CHARACTERISTIC FCfmi_MJ_intF_Vhi "FCtl_FMI(136)" VALUE 0x001E5989 /* @ECU_Address@FCtl_FMI@0x021B7088@ */ ECIPP_ALIGNMENT_UBYTE 255 Compu_IDENTITY 0 255 PHYS_UNIT "FMI" /end CHARACTERISTIC
/begin CHARACTERISTIC FCfmi_MJ_intF_Vlo "FCtl_FMI(137)" VALUE 0x001E598A /* @ECU_Address@FCtl_FMI@0x021B7089@ */ ECIPP_ALIGNMENT_UBYTE 255 Compu_IDENTITY 0 255 PHYS_UNIT "FMI" /end CHARACTERISTIC
/begin CHARACTERISTIC FCfmi_MJ_Pe_HiExp "FCtl_FMI(133)" VALUE 0x001E5986 /* @ECU_Address@FCtl_FMI@0x021B7085@ */ ECIPP_ALIGNMENT_UBYTE 255 Compu_IDENTITY 0 255 PHYS_UNIT "FMI" /end CHARACTERISTIC
/begin CHARACTERISTIC FCfmi_MJ_Pe_LoExp "FCtl_FMI(134)" VALUE 0x001E5987 /* @ECU_Address@FCtl_FMI@0x021B7086@ */ ECIPP_ALIGNMENT_UBYTE 255 Compu_IDENTITY 0 255 PHYS_UNIT "FMI" /end CHARACTERISTIC
/begin CHARACTERISTIC FCfmi_MJ2_comm_tout "FCtl_FMI(726)" VALUE 0x001E5BD7 /* @ECU_Address@FCtl_FMI@0x021B72D6@ */ ECIPP_ALIGNMENT_UBYTE 255 Compu_IDENTITY 0 255 PHYS_UNIT "FMI" /end CHARACTERISTIC
/begin CHARACTERISTIC FCfmi_MJ2_intF_act "FCtl_FMI(729)" VALUE 0x001E5BDA /* @ECU_Address@FCtl_FMI@0x021B72D9@ */ ECIPP_ALIGNMENT_UBYTE 255 Compu_IDENTITY 0 255 PHYS_UNIT "FMI" /end CHARACTERISTIC
/begin CHARACTERISTIC FCfmi_MJ2_intF_circ "FCtl_FMI(730)" VALUE 0x001E5BDB /* @ECU_Address@FCtl_FMI@0x021B72DA@ */ ECIPP_ALIGNMENT_UBYTE 255 Compu_IDENTITY 0 255 PHYS_UNIT "FMI" /end CHARACTERISTIC
/begin CHARACTERISTIC FCfmi_MJ2_intF_comm "FCtl_FMI(731)" VALUE 0x001E5BDC /* @ECU_Address@FCtl_FMI@0x021B72DB@ */ ECIPP_ALIGNMENT_UBYTE 255 Compu_IDENTITY 0 255 PHYS_UNIT "FMI" /end CHARACTERISTIC
/begin CHARACTERISTIC FCfmi_MJ2_intF_Vhi "FCtl_FMI(727)" VALUE 0x001E5BD8 /* @ECU_Address@FCtl_FMI@0x021B72D7@ */ ECIPP_ALIGNMENT_UBYTE 255 Compu_IDENTITY 0 255 PHYS_UNIT "FMI" /end CHARACTERISTIC
/begin CHARACTERISTIC FCfmi_MJ2_intF_Vlo "FCtl_FMI(728)" VALUE 0x001E5BD9 /* @ECU_Address@FCtl_FMI@0x021B72D8@ */ ECIPP_ALIGNMENT_UBYTE 255 Compu_IDENTITY 0 255 PHYS_UNIT "FMI" /end CHARACTERISTIC
/begin CHARACTERISTIC FCfmi_MJ2_Pe_HiExp "FCtl_FMI(724)" VALUE 0x001E5BD5 /* @ECU_Address@FCtl_FMI@0x021B72D4@ */ ECIPP_ALIGNMENT_UBYTE 255 Compu_IDENTITY 0 255 PHYS_UNIT "FMI" /end CHARACTERISTIC
/begin CHARACTERISTIC FCfmi_MJ2_Pe_LoExp "FCtl_FMI(725)" VALUE 0x001E5BD6 /* @ECU_Address@FCtl_FMI@0x021B72D5@ */ ECIPP_ALIGNMENT_UBYTE 255 Compu_IDENTITY 0 255 PHYS_UNIT "FMI" /end CHARACTERISTIC
/begin CHARACTERISTIC FCfmi_NOx_hi "FCtl_FMI(793)" VALUE 0x001E5C1A /* @ECU_Address@FCtl_FMI@0x021B7319@ */ ECIPP_ALIGNMENT_UBYTE 255 Compu_IDENTITY 0 255 PHYS_UNIT "FMI" /end CHARACTERISTIC
/begin CHARACTERISTIC FCfmi_OilP_comm_lost "FCtl_FMI(1045)" VALUE 0x001E5D16 /* @ECU_Address@FCtl_FMI@0x021B7415@ */ ECIPP_ALIGNMENT_UBYTE 255 Compu_IDENTITY 0 255 PHYS_UNIT "FMI" /end CHARACTERISTIC
/begin CHARACTERISTIC FCfmi_OilP_hiP "FCtl_FMI(149)" VALUE 0x001E5996 /* @ECU_Address@FCtl_FMI@0x021B7095@ */ ECIPP_ALIGNMENT_UBYTE 255 Compu_IDENTITY 0 255 PHYS_UNIT "FMI" /end CHARACTERISTIC
/begin CHARACTERISTIC FCfmi_OilP_loP "FCtl_FMI(148)" VALUE 0x001E5995 /* @ECU_Address@FCtl_FMI@0x021B7094@ */ ECIPP_ALIGNMENT_UBYTE 255 Compu_IDENTITY 0 255 PHYS_UNIT "FMI" /end CHARACTERISTIC
/begin CHARACTERISTIC FCfmi_OilP_maxV "FCtl_FMI(150)" VALUE 0x001E5997 /* @ECU_Address@FCtl_FMI@0x021B7096@ */ ECIPP_ALIGNMENT_UBYTE 255 Compu_IDENTITY 0 255 PHYS_UNIT "FMI" /end CHARACTERISTIC
/begin CHARACTERISTIC FCfmi_OilP_minV "FCtl_FMI(151)" VALUE 0x001E5998 /* @ECU_Address@FCtl_FMI@0x021B7097@ */ ECIPP_ALIGNMENT_UBYTE 255 Compu_IDENTITY 0 255 PHYS_UNIT "FMI" /end CHARACTERISTIC
/begin CHARACTERISTIC FCfmi_OILP_test "FCtl_FMI(29)" VALUE 0x001E591E /* @ECU_Address@FCtl_FMI@0x021B701D@ */ ECIPP_ALIGNMENT_UBYTE 255 Compu_IDENTITY 0 255 PHYS_UNIT "FMI" /end CHARACTERISTIC
/begin CHARACTERISTIC FCfmi_OilP_VlvStk "FCtl_FMI(1042)" VALUE 0x001E5D13 /* @ECU_Address@FCtl_FMI@0x021B7412@ */ ECIPP_ALIGNMENT_UBYTE 255 Compu_IDENTITY 0 255 PHYS_UNIT "FMI" /end CHARACTERISTIC
/begin CHARACTERISTIC FCfmi_OilP2_loP "FCtl_FMI(293)" VALUE 0x001E5A26 /* @ECU_Address@FCtl_FMI@0x021B7125@ */ ECIPP_ALIGNMENT_UBYTE 255 Compu_IDENTITY 0 255 PHYS_UNIT "FMI" /end CHARACTERISTIC
/begin CHARACTERISTIC FCfmi_OILTL_loss "FCtl_FMI(737)" VALUE 0x001E5BE2 /* @ECU_Address@FCtl_FMI@0x021B72E1@ */ ECIPP_ALIGNMENT_UBYTE 255 Compu_IDENTITY 0 255 PHYS_UNIT "FMI" /end CHARACTERISTIC
/begin CHARACTERISTIC FCfmi_OILTL_Lvl_lo "FCtl_FMI(741)" VALUE 0x001E5BE6 /* @ECU_Address@FCtl_FMI@0x021B72E5@ */ ECIPP_ALIGNMENT_UBYTE 255 Compu_IDENTITY 0 255 PHYS_UNIT "FMI" /end CHARACTERISTIC
/begin CHARACTERISTIC FCfmi_OILTL_Lvl_OOR "FCtl_FMI(739)" VALUE 0x001E5BE4 /* @ECU_Address@FCtl_FMI@0x021B72E3@ */ ECIPP_ALIGNMENT_UBYTE 255 Compu_IDENTITY 0 255 PHYS_UNIT "FMI" /end CHARACTERISTIC
/begin CHARACTERISTIC FCfmi_OILTL_T_hi "FCtl_FMI(742)" VALUE 0x001E5BE7 /* @ECU_Address@FCtl_FMI@0x021B72E6@ */ ECIPP_ALIGNMENT_UBYTE 255 Compu_IDENTITY 0 255 PHYS_UNIT "FMI" /end CHARACTERISTIC
/begin CHARACTERISTIC FCfmi_OILTL_T_OOR "FCtl_FMI(740)" VALUE 0x001E5BE5 /* @ECU_Address@FCtl_FMI@0x021B72E4@ */ ECIPP_ALIGNMENT_UBYTE 255 Compu_IDENTITY 0 255 PHYS_UNIT "FMI" /end CHARACTERISTIC
/begin CHARACTERISTIC FCfmi_OILTL_V_OOR "FCtl_FMI(738)" VALUE 0x001E5BE3 /* @ECU_Address@FCtl_FMI@0x021B72E2@ */ ECIPP_ALIGNMENT_UBYTE 255 Compu_IDENTITY 0 255 PHYS_UNIT "FMI" /end CHARACTERISTIC
/begin CHARACTERISTIC FCfmi_PAUX_dP1_max "FCtl_FMI(546)" VALUE 0x001E5B23 /* @ECU_Address@FCtl_FMI@0x021B7222@ */ ECIPP_ALIGNMENT_UBYTE 255 Compu_IDENTITY 0 255 PHYS_UNIT "FMI" /end CHARACTERISTIC
/begin CHARACTERISTIC FCfmi_PAUX_dP1_min "FCtl_FMI(547)" VALUE 0x001E5B24 /* @ECU_Address@FCtl_FMI@0x021B7223@ */ ECIPP_ALIGNMENT_UBYTE 255 Compu_IDENTITY 0 255 PHYS_UNIT "FMI" /end CHARACTERISTIC
/begin CHARACTERISTIC FCfmi_PAUX_dP2_max "FCtl_FMI(548)" VALUE 0x001E5B25 /* @ECU_Address@FCtl_FMI@0x021B7224@ */ ECIPP_ALIGNMENT_UBYTE 255 Compu_IDENTITY 0 255 PHYS_UNIT "FMI" /end CHARACTERISTIC
/begin CHARACTERISTIC FCfmi_PAUX_dP2_min "FCtl_FMI(549)" VALUE 0x001E5B26 /* @ECU_Address@FCtl_FMI@0x021B7225@ */ ECIPP_ALIGNMENT_UBYTE 255 Compu_IDENTITY 0 255 PHYS_UNIT "FMI" /end CHARACTERISTIC
/begin CHARACTERISTIC FCfmi_PAUX1_max "FCtl_FMI(538)" VALUE 0x001E5B1B /* @ECU_Address@FCtl_FMI@0x021B721A@ */ ECIPP_ALIGNMENT_UBYTE 255 Compu_IDENTITY 0 255 PHYS_UNIT "FMI" /end CHARACTERISTIC
/begin CHARACTERISTIC FCfmi_PAUX1_min "FCtl_FMI(539)" VALUE 0x001E5B1C /* @ECU_Address@FCtl_FMI@0x021B721B@ */ ECIPP_ALIGNMENT_UBYTE 255 Compu_IDENTITY 0 255 PHYS_UNIT "FMI" /end CHARACTERISTIC
/begin CHARACTERISTIC FCfmi_PAUX2_max "FCtl_FMI(540)" VALUE 0x001E5B1D /* @ECU_Address@FCtl_FMI@0x021B721C@ */ ECIPP_ALIGNMENT_UBYTE 255 Compu_IDENTITY 0 255 PHYS_UNIT "FMI" /end CHARACTERISTIC
/begin CHARACTERISTIC FCfmi_PAUX2_min "FCtl_FMI(541)" VALUE 0x001E5B1E /* @ECU_Address@FCtl_FMI@0x021B721D@ */ ECIPP_ALIGNMENT_UBYTE 255 Compu_IDENTITY 0 255 PHYS_UNIT "FMI" /end CHARACTERISTIC
/begin CHARACTERISTIC FCfmi_PAUX3_max "FCtl_FMI(542)" VALUE 0x001E5B1F /* @ECU_Address@FCtl_FMI@0x021B721E@ */ ECIPP_ALIGNMENT_UBYTE 255 Compu_IDENTITY 0 255 PHYS_UNIT "FMI" /end CHARACTERISTIC
/begin CHARACTERISTIC FCfmi_PAUX3_min "FCtl_FMI(543)" VALUE 0x001E5B20 /* @ECU_Address@FCtl_FMI@0x021B721F@ */ ECIPP_ALIGNMENT_UBYTE 255 Compu_IDENTITY 0 255 PHYS_UNIT "FMI" /end CHARACTERISTIC
/begin CHARACTERISTIC FCfmi_PAUX4_max "FCtl_FMI(544)" VALUE 0x001E5B21 /* @ECU_Address@FCtl_FMI@0x021B7220@ */ ECIPP_ALIGNMENT_UBYTE 255 Compu_IDENTITY 0 255 PHYS_UNIT "FMI" /end CHARACTERISTIC
/begin CHARACTERISTIC FCfmi_PAUX4_min "FCtl_FMI(545)" VALUE 0x001E5B22 /* @ECU_Address@FCtl_FMI@0x021B7221@ */ ECIPP_ALIGNMENT_UBYTE 255 Compu_IDENTITY 0 255 PHYS_UNIT "FMI" /end CHARACTERISTIC
/begin CHARACTERISTIC FCfmi_post_cntrl_hi_lmt "FCtl_FMI(1041)" VALUE 0x001E5D12 /* @ECU_Address@FCtl_FMI@0x021B7411@ */ ECIPP_ALIGNMENT_UBYTE 255 Compu_IDENTITY 0 255 PHYS_UNIT "FMI" /end CHARACTERISTIC
/begin CHARACTERISTIC FCfmi_post_cntrl_lo_lmt "FCtl_FMI(1040)" VALUE 0x001E5D11 /* @ECU_Address@FCtl_FMI@0x021B7410@ */ ECIPP_ALIGNMENT_UBYTE 255 Compu_IDENTITY 0 255 PHYS_UNIT "FMI" /end CHARACTERISTIC
/begin CHARACTERISTIC FCfmi_PPEG_BP "FCtl_FMI(670)" VALUE 0x001E5B9F /* @ECU_Address@FCtl_FMI@0x021B729E@ */ ECIPP_ALIGNMENT_UBYTE 255 Compu_IDENTITY 0 255 PHYS_UNIT "FMI" /end CHARACTERISTIC
/begin CHARACTERISTIC FCfmi_PPEG_CVP1 "FCtl_FMI(745)" VALUE 0x001E5BEA /* @ECU_Address@FCtl_FMI@0x021B72E9@ */ ECIPP_ALIGNMENT_UBYTE 255 Compu_IDENTITY 0 255 PHYS_UNIT "FMI" /end CHARACTERISTIC
/begin CHARACTERISTIC FCfmi_PPEG_CVP2 "FCtl_FMI(746)" VALUE 0x001E5BEB /* @ECU_Address@FCtl_FMI@0x021B72EA@ */ ECIPP_ALIGNMENT_UBYTE 255 Compu_IDENTITY 0 255 PHYS_UNIT "FMI" /end CHARACTERISTIC
/begin CHARACTERISTIC FCfmi_PPEG_EBP "FCtl_FMI(671)" VALUE 0x001E5BA0 /* @ECU_Address@FCtl_FMI@0x021B729F@ */ ECIPP_ALIGNMENT_UBYTE 255 Compu_IDENTITY 0 255 PHYS_UNIT "FMI" /end CHARACTERISTIC
/begin CHARACTERISTIC FCfmi_PPEG_EGRdP "FCtl_FMI(756)" VALUE 0x001E5BF5 /* @ECU_Address@FCtl_FMI@0x021B72F4@ */ ECIPP_ALIGNMENT_UBYTE 255 Compu_IDENTITY 0 255 PHYS_UNIT "FMI" /end CHARACTERISTIC
/begin CHARACTERISTIC FCfmi_PPEG_EGRHP "FCtl_FMI(673)" VALUE 0x001E5BA2 /* @ECU_Address@FCtl_FMI@0x021B72A1@ */ ECIPP_ALIGNMENT_UBYTE 255 Compu_IDENTITY 0 255 PHYS_UNIT "FMI" /end CHARACTERISTIC
/begin CHARACTERISTIC FCfmi_PPEG_EGRLP "FCtl_FMI(672)" VALUE 0x001E5BA1 /* @ECU_Address@FCtl_FMI@0x021B72A0@ */ ECIPP_ALIGNMENT_UBYTE 255 Compu_IDENTITY 0 255 PHYS_UNIT "FMI" /end CHARACTERISTIC
/begin CHARACTERISTIC FCfmi_PPEG_EGRwrP "FCtl_FMI(675)" VALUE 0x001E5BA4 /* @ECU_Address@FCtl_FMI@0x021B72A3@ */ ECIPP_ALIGNMENT_UBYTE 255 Compu_IDENTITY 0 255 PHYS_UNIT "FMI" /end CHARACTERISTIC
/begin CHARACTERISTIC FCfmi_PPEG_MAP "FCtl_FMI(676)" VALUE 0x001E5BA5 /* @ECU_Address@FCtl_FMI@0x021B72A4@ */ ECIPP_ALIGNMENT_UBYTE 255 Compu_IDENTITY 0 255 PHYS_UNIT "FMI" /end CHARACTERISTIC
/begin CHARACTERISTIC FCfmi_PPEG_TIP "FCtl_FMI(674)" VALUE 0x001E5BA3 /* @ECU_Address@FCtl_FMI@0x021B72A2@ */ ECIPP_ALIGNMENT_UBYTE 255 Compu_IDENTITY 0 255 PHYS_UNIT "FMI" /end CHARACTERISTIC
/begin CHARACTERISTIC FCfmi_Pri1_open "FCtl_FMI(901)" VALUE 0x001E5C86 /* @ECU_Address@FCtl_FMI@0x021B7385@ */ ECIPP_ALIGNMENT_UBYTE 255 Compu_IDENTITY 0 255 PHYS_UNIT "FMI" /end CHARACTERISTIC
/begin CHARACTERISTIC FCfmi_Pri1_short "FCtl_FMI(913)" VALUE 0x001E5C92 /* @ECU_Address@FCtl_FMI@0x021B7391@ */ ECIPP_ALIGNMENT_UBYTE 255 Compu_IDENTITY 0 255 PHYS_UNIT "FMI" /end CHARACTERISTIC
/begin CHARACTERISTIC FCfmi_PWM1_off_loVf "FCtl_FMI(189)" VALUE 0x001E59BE /* @ECU_Address@FCtl_FMI@0x021B70BD@ */ ECIPP_ALIGNMENT_UBYTE 255 Compu_IDENTITY 0 255 PHYS_UNIT "FMI" /end CHARACTERISTIC
/begin CHARACTERISTIC FCfmi_PWM1_on_hiVf "FCtl_FMI(190)" VALUE 0x001E59BF /* @ECU_Address@FCtl_FMI@0x021B70BE@ */ ECIPP_ALIGNMENT_UBYTE 255 Compu_IDENTITY 0 255 PHYS_UNIT "FMI" /end CHARACTERISTIC
/begin CHARACTERISTIC FCfmi_PWM10_off_loVf "FCtl_FMI(433)" VALUE 0x001E5AB2 /* @ECU_Address@FCtl_FMI@0x021B71B1@ */ ECIPP_ALIGNMENT_UBYTE 255 Compu_IDENTITY 0 255 PHYS_UNIT "FMI" /end CHARACTERISTIC
/begin CHARACTERISTIC FCfmi_PWM10_on_hiVf "FCtl_FMI(434)" VALUE 0x001E5AB3 /* @ECU_Address@FCtl_FMI@0x021B71B2@ */ ECIPP_ALIGNMENT_UBYTE 255 Compu_IDENTITY 0 255 PHYS_UNIT "FMI" /end CHARACTERISTIC
/begin CHARACTERISTIC FCfmi_PWM11_off_loVf "FCtl_FMI(435)" VALUE 0x001E5AB4 /* @ECU_Address@FCtl_FMI@0x021B71B3@ */ ECIPP_ALIGNMENT_UBYTE 255 Compu_IDENTITY 0 255 PHYS_UNIT "FMI" /end CHARACTERISTIC
/begin CHARACTERISTIC FCfmi_PWM11_on_hiVf "FCtl_FMI(436)" VALUE 0x001E5AB5 /* @ECU_Address@FCtl_FMI@0x021B71B4@ */ ECIPP_ALIGNMENT_UBYTE 255 Compu_IDENTITY 0 255 PHYS_UNIT "FMI" /end CHARACTERISTIC
/begin CHARACTERISTIC FCfmi_PWM12_off_loVf "FCtl_FMI(437)" VALUE 0x001E5AB6 /* @ECU_Address@FCtl_FMI@0x021B71B5@ */ ECIPP_ALIGNMENT_UBYTE 255 Compu_IDENTITY 0 255 PHYS_UNIT "FMI" /end CHARACTERISTIC
/begin CHARACTERISTIC FCfmi_PWM12_on_hiVf "FCtl_FMI(438)" VALUE 0x001E5AB7 /* @ECU_Address@FCtl_FMI@0x021B71B6@ */ ECIPP_ALIGNMENT_UBYTE 255 Compu_IDENTITY 0 255 PHYS_UNIT "FMI" /end CHARACTERISTIC
/begin CHARACTERISTIC FCfmi_PWM13_off_loVf "FCtl_FMI(439)" VALUE 0x001E5AB8 /* @ECU_Address@FCtl_FMI@0x021B71B7@ */ ECIPP_ALIGNMENT_UBYTE 255 Compu_IDENTITY 0 255 PHYS_UNIT "FMI" /end CHARACTERISTIC
/begin CHARACTERISTIC FCfmi_PWM13_on_hiVf "FCtl_FMI(440)" VALUE 0x001E5AB9 /* @ECU_Address@FCtl_FMI@0x021B71B8@ */ ECIPP_ALIGNMENT_UBYTE 255 Compu_IDENTITY 0 255 PHYS_UNIT "FMI" /end CHARACTERISTIC
/begin CHARACTERISTIC FCfmi_PWM14_off_loVf "FCtl_FMI(441)" VALUE 0x001E5ABA /* @ECU_Address@FCtl_FMI@0x021B71B9@ */ ECIPP_ALIGNMENT_UBYTE 255 Compu_IDENTITY 0 255 PHYS_UNIT "FMI" /end CHARACTERISTIC
/begin CHARACTERISTIC FCfmi_PWM14_on_hiVf "FCtl_FMI(442)" VALUE 0x001E5ABB /* @ECU_Address@FCtl_FMI@0x021B71BA@ */ ECIPP_ALIGNMENT_UBYTE 255 Compu_IDENTITY 0 255 PHYS_UNIT "FMI" /end CHARACTERISTIC
/begin CHARACTERISTIC FCfmi_PWM15_off_loVf "FCtl_FMI(443)" VALUE 0x001E5ABC /* @ECU_Address@FCtl_FMI@0x021B71BB@ */ ECIPP_ALIGNMENT_UBYTE 255 Compu_IDENTITY 0 255 PHYS_UNIT "FMI" /end CHARACTERISTIC
/begin CHARACTERISTIC FCfmi_PWM15_on_hiVf "FCtl_FMI(444)" VALUE 0x001E5ABD /* @ECU_Address@FCtl_FMI@0x021B71BC@ */ ECIPP_ALIGNMENT_UBYTE 255 Compu_IDENTITY 0 255 PHYS_UNIT "FMI" /end CHARACTERISTIC
/begin CHARACTERISTIC FCfmi_PWM16_off_loVf "FCtl_FMI(445)" VALUE 0x001E5ABE /* @ECU_Address@FCtl_FMI@0x021B71BD@ */ ECIPP_ALIGNMENT_UBYTE 255 Compu_IDENTITY 0 255 PHYS_UNIT "FMI" /end CHARACTERISTIC
/begin CHARACTERISTIC FCfmi_PWM16_on_hiVf "FCtl_FMI(446)" VALUE 0x001E5ABF /* @ECU_Address@FCtl_FMI@0x021B71BE@ */ ECIPP_ALIGNMENT_UBYTE 255 Compu_IDENTITY 0 255 PHYS_UNIT "FMI" /end CHARACTERISTIC
/begin CHARACTERISTIC FCftb_MJ_intF_circ "FCtl_FTB_0x04(139)" VALUE 0x001E5DA2 /* @ECU_Address@FCtl_FTB_0x04@0x024C508B@ */ ECIPP_ALIGNMENT_UBYTE 255 Compu_IDENTITY 0 255 PHYS_UNIT "FTB" /end CHARACTERISTIC
/begin CHARACTERISTIC FCftb_MJ_intF_comm "FCtl_FTB_0x04(140)" VALUE 0x001E5DA3 /* @ECU_Address@FCtl_FTB_0x04@0x024C508C@ */ ECIPP_ALIGNMENT_UBYTE 255 Compu_IDENTITY 0 255 PHYS_UNIT "FTB" /end CHARACTERISTIC
/begin CHARACTERISTIC FCftb_MJ_intF_Vhi "FCtl_FTB_0x04(136)" VALUE 0x001E5D9F /* @ECU_Address@FCtl_FTB_0x04@0x024C5088@ */ ECIPP_ALIGNMENT_UBYTE 255 Compu_IDENTITY 0 255 PHYS_UNIT "FTB" /end CHARACTERISTIC
/begin CHARACTERISTIC FCftb_MJ_intF_Vlo "FCtl_FTB_0x04(137)" VALUE 0x001E5DA0 /* @ECU_Address@FCtl_FTB_0x04@0x024C5089@ */ ECIPP_ALIGNMENT_UBYTE 255 Compu_IDENTITY 0 255 PHYS_UNIT "FTB" /end CHARACTERISTIC
/begin CHARACTERISTIC FCftb_MJ_Pe_HiExp "FCtl_FTB_0x04(133)" VALUE 0x001E5D9C /* @ECU_Address@FCtl_FTB_0x04@0x024C5085@ */ ECIPP_ALIGNMENT_UBYTE 255 Compu_IDENTITY 0 255 PHYS_UNIT "FTB" /end CHARACTERISTIC
/begin CHARACTERISTIC FCftb_MJ_Pe_LoExp "FCtl_FTB_0x04(134)" VALUE 0x001E5D9D /* @ECU_Address@FCtl_FTB_0x04@0x024C5086@ */ ECIPP_ALIGNMENT_UBYTE 255 Compu_IDENTITY 0 255 PHYS_UNIT "FTB" /end CHARACTERISTIC
/begin CHARACTERISTIC FCftb_MJ2_comm_tout "FCtl_FTB_0x04(726)" VALUE 0x001E5FED /* @ECU_Address@FCtl_FTB_0x04@0x024C52D6@ */ ECIPP_ALIGNMENT_UBYTE 255 Compu_IDENTITY 0 255 PHYS_UNIT "FTB" /end CHARACTERISTIC
/begin CHARACTERISTIC FCftb_MJ2_intF_act "FCtl_FTB_0x04(729)" VALUE 0x001E5FF0 /* @ECU_Address@FCtl_FTB_0x04@0x024C52D9@ */ ECIPP_ALIGNMENT_UBYTE 255 Compu_IDENTITY 0 255 PHYS_UNIT "FTB" /end CHARACTERISTIC
/begin CHARACTERISTIC FCftb_MJ2_intF_circ "FCtl_FTB_0x04(730)" VALUE 0x001E5FF1 /* @ECU_Address@FCtl_FTB_0x04@0x024C52DA@ */ ECIPP_ALIGNMENT_UBYTE 255 Compu_IDENTITY 0 255 PHYS_UNIT "FTB" /end CHARACTERISTIC
/begin CHARACTERISTIC FCftb_MJ2_intF_comm "FCtl_FTB_0x04(731)" VALUE 0x001E5FF2 /* @ECU_Address@FCtl_FTB_0x04@0x024C52DB@ */ ECIPP_ALIGNMENT_UBYTE 255 Compu_IDENTITY 0 255 PHYS_UNIT "FTB" /end CHARACTERISTIC
/begin CHARACTERISTIC FCftb_MJ2_intF_Vhi "FCtl_FTB_0x04(727)" VALUE 0x001E5FEE /* @ECU_Address@FCtl_FTB_0x04@0x024C52D7@ */ ECIPP_ALIGNMENT_UBYTE 255 Compu_IDENTITY 0 255 PHYS_UNIT "FTB" /end CHARACTERISTIC
/begin CHARACTERISTIC FCftb_MJ2_intF_Vlo "FCtl_FTB_0x04(728)" VALUE 0x001E5FEF /* @ECU_Address@FCtl_FTB_0x04@0x024C52D8@ */ ECIPP_ALIGNMENT_UBYTE 255 Compu_IDENTITY 0 255 PHYS_UNIT "FTB" /end CHARACTERISTIC
/begin CHARACTERISTIC FCftb_MJ2_Pe_HiExp "FCtl_FTB_0x04(724)" VALUE 0x001E5FEB /* @ECU_Address@FCtl_FTB_0x04@0x024C52D4@ */ ECIPP_ALIGNMENT_UBYTE 255 Compu_IDENTITY 0 255 PHYS_UNIT "FTB" /end CHARACTERISTIC
/begin CHARACTERISTIC FCftb_MJ2_Pe_LoExp "FCtl_FTB_0x04(725)" VALUE 0x001E5FEC /* @ECU_Address@FCtl_FTB_0x04@0x024C52D5@ */ ECIPP_ALIGNMENT_UBYTE 255 Compu_IDENTITY 0 255 PHYS_UNIT "FTB" /end CHARACTERISTIC
/begin CHARACTERISTIC FCftb_NOx_hi "FCtl_FTB_0x04(793)" VALUE 0x001E6030 /* @ECU_Address@FCtl_FTB_0x04@0x024C5319@ */ ECIPP_ALIGNMENT_UBYTE 255 Compu_IDENTITY 0 255 PHYS_UNIT "FTB" /end CHARACTERISTIC
/begin CHARACTERISTIC FCftb_OilP_comm_lost "FCtl_FTB_0x04(1045)" VALUE 0x001E612C /* @ECU_Address@FCtl_FTB_0x04@0x024C5415@ */ ECIPP_ALIGNMENT_UBYTE 255 Compu_IDENTITY 0 255 PHYS_UNIT "FTB" /end CHARACTERISTIC
/begin CHARACTERISTIC FCftb_OilP_hiP "FCtl_FTB_0x04(149)" VALUE 0x001E5DAC /* @ECU_Address@FCtl_FTB_0x04@0x024C5095@ */ ECIPP_ALIGNMENT_UBYTE 255 Compu_IDENTITY 0 255 PHYS_UNIT "FTB" /end CHARACTERISTIC
/begin CHARACTERISTIC FCftb_OilP_loP "FCtl_FTB_0x04(148)" VALUE 0x001E5DAB /* @ECU_Address@FCtl_FTB_0x04@0x024C5094@ */ ECIPP_ALIGNMENT_UBYTE 255 Compu_IDENTITY 0 255 PHYS_UNIT "FTB" /end CHARACTERISTIC
/begin CHARACTERISTIC FCftb_OilP_maxV "FCtl_FTB_0x04(150)" VALUE 0x001E5DAD /* @ECU_Address@FCtl_FTB_0x04@0x024C5096@ */ ECIPP_ALIGNMENT_UBYTE 255 Compu_IDENTITY 0 255 PHYS_UNIT "FTB" /end CHARACTERISTIC
/begin CHARACTERISTIC FCftb_OilP_minV "FCtl_FTB_0x04(151)" VALUE 0x001E5DAE /* @ECU_Address@FCtl_FTB_0x04@0x024C5097@ */ ECIPP_ALIGNMENT_UBYTE 255 Compu_IDENTITY 0 255 PHYS_UNIT "FTB" /end CHARACTERISTIC
/begin CHARACTERISTIC FCftb_OILP_test "FCtl_FTB_0x04(29)" VALUE 0x001E5D34 /* @ECU_Address@FCtl_FTB_0x04@0x024C501D@ */ ECIPP_ALIGNMENT_UBYTE 255 Compu_IDENTITY 0 255 PHYS_UNIT "FTB" /end CHARACTERISTIC
/begin CHARACTERISTIC FCftb_OilP_VlvStk "FCtl_FTB_0x04(1042)" VALUE 0x001E6129 /* @ECU_Address@FCtl_FTB_0x04@0x024C5412@ */ ECIPP_ALIGNMENT_UBYTE 255 Compu_IDENTITY 0 255 PHYS_UNIT "FTB" /end CHARACTERISTIC
/begin CHARACTERISTIC FCftb_OilP2_loP "FCtl_FTB_0x04(293)" VALUE 0x001E5E3C /* @ECU_Address@FCtl_FTB_0x04@0x024C5125@ */ ECIPP_ALIGNMENT_UBYTE 255 Compu_IDENTITY 0 255 PHYS_UNIT "FTB" /end CHARACTERISTIC
/begin CHARACTERISTIC FCftb_OILTL_loss "FCtl_FTB_0x04(737)" VALUE 0x001E5FF8 /* @ECU_Address@FCtl_FTB_0x04@0x024C52E1@ */ ECIPP_ALIGNMENT_UBYTE 255 Compu_IDENTITY 0 255 PHYS_UNIT "FTB" /end CHARACTERISTIC
/begin CHARACTERISTIC FCftb_OILTL_Lvl_lo "FCtl_FTB_0x04(741)" VALUE 0x001E5FFC /* @ECU_Address@FCtl_FTB_0x04@0x024C52E5@ */ ECIPP_ALIGNMENT_UBYTE 255 Compu_IDENTITY 0 255 PHYS_UNIT "FTB" /end CHARACTERISTIC
/begin CHARACTERISTIC FCftb_OILTL_Lvl_OOR "FCtl_FTB_0x04(739)" VALUE 0x001E5FFA /* @ECU_Address@FCtl_FTB_0x04@0x024C52E3@ */ ECIPP_ALIGNMENT_UBYTE 255 Compu_IDENTITY 0 255 PHYS_UNIT "FTB" /end CHARACTERISTIC
/begin CHARACTERISTIC FCftb_OILTL_T_hi "FCtl_FTB_0x04(742)" VALUE 0x001E5FFD /* @ECU_Address@FCtl_FTB_0x04@0x024C52E6@ */ ECIPP_ALIGNMENT_UBYTE 255 Compu_IDENTITY 0 255 PHYS_UNIT "FTB" /end CHARACTERISTIC
/begin CHARACTERISTIC FCftb_OILTL_T_OOR "FCtl_FTB_0x04(740)" VALUE 0x001E5FFB /* @ECU_Address@FCtl_FTB_0x04@0x024C52E4@ */ ECIPP_ALIGNMENT_UBYTE 255 Compu_IDENTITY 0 255 PHYS_UNIT "FTB" /end CHARACTERISTIC
/begin CHARACTERISTIC FCftb_OILTL_V_OOR "FCtl_FTB_0x04(738)" VALUE 0x001E5FF9 /* @ECU_Address@FCtl_FTB_0x04@0x024C52E2@ */ ECIPP_ALIGNMENT_UBYTE 255 Compu_IDENTITY 0 255 PHYS_UNIT "FTB" /end CHARACTERISTIC
/begin CHARACTERISTIC FCftb_PAUX_dP1_max "FCtl_FTB_0x04(546)" VALUE 0x001E5F39 /* @ECU_Address@FCtl_FTB_0x04@0x024C5222@ */ ECIPP_ALIGNMENT_UBYTE 255 Compu_IDENTITY 0 255 PHYS_UNIT "FTB" /end CHARACTERISTIC
/begin CHARACTERISTIC FCftb_PAUX_dP1_min "FCtl_FTB_0x04(547)" VALUE 0x001E5F3A /* @ECU_Address@FCtl_FTB_0x04@0x024C5223@ */ ECIPP_ALIGNMENT_UBYTE 255 Compu_IDENTITY 0 255 PHYS_UNIT "FTB" /end CHARACTERISTIC
/begin CHARACTERISTIC FCftb_PAUX_dP2_max "FCtl_FTB_0x04(548)" VALUE 0x001E5F3B /* @ECU_Address@FCtl_FTB_0x04@0x024C5224@ */ ECIPP_ALIGNMENT_UBYTE 255 Compu_IDENTITY 0 255 PHYS_UNIT "FTB" /end CHARACTERISTIC
/begin CHARACTERISTIC FCftb_PAUX_dP2_min "FCtl_FTB_0x04(549)" VALUE 0x001E5F3C /* @ECU_Address@FCtl_FTB_0x04@0x024C5225@ */ ECIPP_ALIGNMENT_UBYTE 255 Compu_IDENTITY 0 255 PHYS_UNIT "FTB" /end CHARACTERISTIC
/begin CHARACTERISTIC FCftb_PAUX1_max "FCtl_FTB_0x04(538)" VALUE 0x001E5F31 /* @ECU_Address@FCtl_FTB_0x04@0x024C521A@ */ ECIPP_ALIGNMENT_UBYTE 255 Compu_IDENTITY 0 255 PHYS_UNIT "FTB" /end CHARACTERISTIC
/begin CHARACTERISTIC FCftb_PAUX1_min "FCtl_FTB_0x04(539)" VALUE 0x001E5F32 /* @ECU_Address@FCtl_FTB_0x04@0x024C521B@ */ ECIPP_ALIGNMENT_UBYTE 255 Compu_IDENTITY 0 255 PHYS_UNIT "FTB" /end CHARACTERISTIC
/begin CHARACTERISTIC FCftb_PAUX2_max "FCtl_FTB_0x04(540)" VALUE 0x001E5F33 /* @ECU_Address@FCtl_FTB_0x04@0x024C521C@ */ ECIPP_ALIGNMENT_UBYTE 255 Compu_IDENTITY 0 255 PHYS_UNIT "FTB" /end CHARACTERISTIC
/begin CHARACTERISTIC FCftb_PAUX2_min "FCtl_FTB_0x04(541)" VALUE 0x001E5F34 /* @ECU_Address@FCtl_FTB_0x04@0x024C521D@ */ ECIPP_ALIGNMENT_UBYTE 255 Compu_IDENTITY 0 255 PHYS_UNIT "FTB" /end CHARACTERISTIC
/begin CHARACTERISTIC FCftb_PAUX3_max "FCtl_FTB_0x04(542)" VALUE 0x001E5F35 /* @ECU_Address@FCtl_FTB_0x04@0x024C521E@ */ ECIPP_ALIGNMENT_UBYTE 255 Compu_IDENTITY 0 255 PHYS_UNIT "FTB" /end CHARACTERISTIC
/begin CHARACTERISTIC FCftb_PAUX3_min "FCtl_FTB_0x04(543)" VALUE 0x001E5F36 /* @ECU_Address@FCtl_FTB_0x04@0x024C521F@ */ ECIPP_ALIGNMENT_UBYTE 255 Compu_IDENTITY 0 255 PHYS_UNIT "FTB" /end CHARACTERISTIC
/begin CHARACTERISTIC FCftb_PAUX4_max "FCtl_FTB_0x04(544)" VALUE 0x001E5F37 /* @ECU_Address@FCtl_FTB_0x04@0x024C5220@ */ ECIPP_ALIGNMENT_UBYTE 255 Compu_IDENTITY 0 255 PHYS_UNIT "FTB" /end CHARACTERISTIC
/begin CHARACTERISTIC FCftb_PAUX4_min "FCtl_FTB_0x04(545)" VALUE 0x001E5F38 /* @ECU_Address@FCtl_FTB_0x04@0x024C5221@ */ ECIPP_ALIGNMENT_UBYTE 255 Compu_IDENTITY 0 255 PHYS_UNIT "FTB" /end CHARACTERISTIC
/begin CHARACTERISTIC FCftb_post_cntrl_hi_lmt "FCtl_FTB_0x04(1041)" VALUE 0x001E6128 /* @ECU_Address@FCtl_FTB_0x04@0x024C5411@ */ ECIPP_ALIGNMENT_UBYTE 255 Compu_IDENTITY 0 255 PHYS_UNIT "FTB" /end CHARACTERISTIC
/begin CHARACTERISTIC FCftb_post_cntrl_lo_lmt "FCtl_FTB_0x04(1040)" VALUE 0x001E6127 /* @ECU_Address@FCtl_FTB_0x04@0x024C5410@ */ ECIPP_ALIGNMENT_UBYTE 255 Compu_IDENTITY 0 255 PHYS_UNIT "FTB" /end CHARACTERISTIC
/begin CHARACTERISTIC FCftb_PPEG_BP "FCtl_FTB_0x04(670)" VALUE 0x001E5FB5 /* @ECU_Address@FCtl_FTB_0x04@0x024C529E@ */ ECIPP_ALIGNMENT_UBYTE 255 Compu_IDENTITY 0 255 PHYS_UNIT "FTB" /end CHARACTERISTIC
/begin CHARACTERISTIC FCftb_PPEG_CVP1 "FCtl_FTB_0x04(745)" VALUE 0x001E6000 /* @ECU_Address@FCtl_FTB_0x04@0x024C52E9@ */ ECIPP_ALIGNMENT_UBYTE 255 Compu_IDENTITY 0 255 PHYS_UNIT "FTB" /end CHARACTERISTIC
/begin CHARACTERISTIC FCftb_PPEG_CVP2 "FCtl_FTB_0x04(746)" VALUE 0x001E6001 /* @ECU_Address@FCtl_FTB_0x04@0x024C52EA@ */ ECIPP_ALIGNMENT_UBYTE 255 Compu_IDENTITY 0 255 PHYS_UNIT "FTB" /end CHARACTERISTIC
/begin CHARACTERISTIC FCftb_PPEG_EBP "FCtl_FTB_0x04(671)" VALUE 0x001E5FB6 /* @ECU_Address@FCtl_FTB_0x04@0x024C529F@ */ ECIPP_ALIGNMENT_UBYTE 255 Compu_IDENTITY 0 255 PHYS_UNIT "FTB" /end CHARACTERISTIC
/begin CHARACTERISTIC FCftb_PPEG_EGRdP "FCtl_FTB_0x04(756)" VALUE 0x001E600B /* @ECU_Address@FCtl_FTB_0x04@0x024C52F4@ */ ECIPP_ALIGNMENT_UBYTE 255 Compu_IDENTITY 0 255 PHYS_UNIT "FTB" /end CHARACTERISTIC
/begin CHARACTERISTIC FCftb_PPEG_EGRHP "FCtl_FTB_0x04(673)" VALUE 0x001E5FB8 /* @ECU_Address@FCtl_FTB_0x04@0x024C52A1@ */ ECIPP_ALIGNMENT_UBYTE 255 Compu_IDENTITY 0 255 PHYS_UNIT "FTB" /end CHARACTERISTIC
/begin CHARACTERISTIC FCftb_PPEG_EGRLP "FCtl_FTB_0x04(672)" VALUE 0x001E5FB7 /* @ECU_Address@FCtl_FTB_0x04@0x024C52A0@ */ ECIPP_ALIGNMENT_UBYTE 255 Compu_IDENTITY 0 255 PHYS_UNIT "FTB" /end CHARACTERISTIC
/begin CHARACTERISTIC FCftb_PPEG_EGRwrP "FCtl_FTB_0x04(675)" VALUE 0x001E5FBA /* @ECU_Address@FCtl_FTB_0x04@0x024C52A3@ */ ECIPP_ALIGNMENT_UBYTE 255 Compu_IDENTITY 0 255 PHYS_UNIT "FTB" /end CHARACTERISTIC
/begin CHARACTERISTIC FCftb_PPEG_MAP "FCtl_FTB_0x04(676)" VALUE 0x001E5FBB /* @ECU_Address@FCtl_FTB_0x04@0x024C52A4@ */ ECIPP_ALIGNMENT_UBYTE 255 Compu_IDENTITY 0 255 PHYS_UNIT "FTB" /end CHARACTERISTIC
/begin CHARACTERISTIC FCftb_PPEG_TIP "FCtl_FTB_0x04(674)" VALUE 0x001E5FB9 /* @ECU_Address@FCtl_FTB_0x04@0x024C52A2@ */ ECIPP_ALIGNMENT_UBYTE 255 Compu_IDENTITY 0 255 PHYS_UNIT "FTB" /end CHARACTERISTIC
/begin CHARACTERISTIC FCftb_Pri1_open "FCtl_FTB_0x04(901)" VALUE 0x001E609C /* @ECU_Address@FCtl_FTB_0x04@0x024C5385@ */ ECIPP_ALIGNMENT_UBYTE 255 Compu_IDENTITY 0 255 PHYS_UNIT "FTB" /end CHARACTERISTIC
/begin CHARACTERISTIC FCftb_Pri1_short "FCtl_FTB_0x04(913)" VALUE 0x001E60A8 /* @ECU_Address@FCtl_FTB_0x04@0x024C5391@ */ ECIPP_ALIGNMENT_UBYTE 255 Compu_IDENTITY 0 255 PHYS_UNIT "FTB" /end CHARACTERISTIC
/begin CHARACTERISTIC FCftb_PWM1_off_loVf "FCtl_FTB_0x04(189)" VALUE 0x001E5DD4 /* @ECU_Address@FCtl_FTB_0x04@0x024C50BD@ */ ECIPP_ALIGNMENT_UBYTE 255 Compu_IDENTITY 0 255 PHYS_UNIT "FTB" /end CHARACTERISTIC
/begin CHARACTERISTIC FCftb_PWM1_on_hiVf "FCtl_FTB_0x04(190)" VALUE 0x001E5DD5 /* @ECU_Address@FCtl_FTB_0x04@0x024C50BE@ */ ECIPP_ALIGNMENT_UBYTE 255 Compu_IDENTITY 0 255 PHYS_UNIT "FTB" /end CHARACTERISTIC
/begin CHARACTERISTIC FCftb_PWM10_off_loVf "FCtl_FTB_0x04(433)" VALUE 0x001E5EC8 /* @ECU_Address@FCtl_FTB_0x04@0x024C51B1@ */ ECIPP_ALIGNMENT_UBYTE 255 Compu_IDENTITY 0 255 PHYS_UNIT "FTB" /end CHARACTERISTIC
/begin CHARACTERISTIC FCftb_PWM10_on_hiVf "FCtl_FTB_0x04(434)" VALUE 0x001E5EC9 /* @ECU_Address@FCtl_FTB_0x04@0x024C51B2@ */ ECIPP_ALIGNMENT_UBYTE 255 Compu_IDENTITY 0 255 PHYS_UNIT "FTB" /end CHARACTERISTIC
/begin CHARACTERISTIC FCftb_PWM11_off_loVf "FCtl_FTB_0x04(435)" VALUE 0x001E5ECA /* @ECU_Address@FCtl_FTB_0x04@0x024C51B3@ */ ECIPP_ALIGNMENT_UBYTE 255 Compu_IDENTITY 0 255 PHYS_UNIT "FTB" /end CHARACTERISTIC
/begin CHARACTERISTIC FCftb_PWM11_on_hiVf "FCtl_FTB_0x04(436)" VALUE 0x001E5ECB /* @ECU_Address@FCtl_FTB_0x04@0x024C51B4@ */ ECIPP_ALIGNMENT_UBYTE 255 Compu_IDENTITY 0 255 PHYS_UNIT "FTB" /end CHARACTERISTIC
/begin CHARACTERISTIC FCftb_PWM12_off_loVf "FCtl_FTB_0x04(437)" VALUE 0x001E5ECC /* @ECU_Address@FCtl_FTB_0x04@0x024C51B5@ */ ECIPP_ALIGNMENT_UBYTE 255 Compu_IDENTITY 0 255 PHYS_UNIT "FTB" /end CHARACTERISTIC
/begin CHARACTERISTIC FCftb_PWM12_on_hiVf "FCtl_FTB_0x04(438)" VALUE 0x001E5ECD /* @ECU_Address@FCtl_FTB_0x04@0x024C51B6@ */ ECIPP_ALIGNMENT_UBYTE 255 Compu_IDENTITY 0 255 PHYS_UNIT "FTB" /end CHARACTERISTIC
/begin CHARACTERISTIC FCftb_PWM13_off_loVf "FCtl_FTB_0x04(439)" VALUE 0x001E5ECE /* @ECU_Address@FCtl_FTB_0x04@0x024C51B7@ */ ECIPP_ALIGNMENT_UBYTE 255 Compu_IDENTITY 0 255 PHYS_UNIT "FTB" /end CHARACTERISTIC
/begin CHARACTERISTIC FCftb_PWM13_on_hiVf "FCtl_FTB_0x04(440)" VALUE 0x001E5ECF /* @ECU_Address@FCtl_FTB_0x04@0x024C51B8@ */ ECIPP_ALIGNMENT_UBYTE 255 Compu_IDENTITY 0 255 PHYS_UNIT "FTB" /end CHARACTERISTIC
/begin CHARACTERISTIC FCftb_PWM14_off_loVf "FCtl_FTB_0x04(441)" VALUE 0x001E5ED0 /* @ECU_Address@FCtl_FTB_0x04@0x024C51B9@ */ ECIPP_ALIGNMENT_UBYTE 255 Compu_IDENTITY 0 255 PHYS_UNIT "FTB" /end CHARACTERISTIC
/begin CHARACTERISTIC FCftb_PWM14_on_hiVf "FCtl_FTB_0x04(442)" VALUE 0x001E5ED1 /* @ECU_Address@FCtl_FTB_0x04@0x024C51BA@ */ ECIPP_ALIGNMENT_UBYTE 255 Compu_IDENTITY 0 255 PHYS_UNIT "FTB" /end CHARACTERISTIC
/begin CHARACTERISTIC FCftb_PWM15_off_loVf "FCtl_FTB_0x04(443)" VALUE 0x001E5ED2 /* @ECU_Address@FCtl_FTB_0x04@0x024C51BB@ */ ECIPP_ALIGNMENT_UBYTE 255 Compu_IDENTITY 0 255 PHYS_UNIT "FTB" /end CHARACTERISTIC
/begin CHARACTERISTIC FCftb_PWM15_on_hiVf "FCtl_FTB_0x04(444)" VALUE 0x001E5ED3 /* @ECU_Address@FCtl_FTB_0x04@0x024C51BC@ */ ECIPP_ALIGNMENT_UBYTE 255 Compu_IDENTITY 0 255 PHYS_UNIT "FTB" /end CHARACTERISTIC
/begin CHARACTERISTIC FCftb_PWM16_off_loVf "FCtl_FTB_0x04(445)" VALUE 0x001E5ED4 /* @ECU_Address@FCtl_FTB_0x04@0x024C51BD@ */ ECIPP_ALIGNMENT_UBYTE 255 Compu_IDENTITY 0 255 PHYS_UNIT "FTB" /end CHARACTERISTIC
/begin CHARACTERISTIC FCftb_PWM16_on_hiVf "FCtl_FTB_0x04(446)" VALUE 0x001E5ED5 /* @ECU_Address@FCtl_FTB_0x04@0x024C51BE@ */ ECIPP_ALIGNMENT_UBYTE 255 Compu_IDENTITY 0 255 PHYS_UNIT "FTB" /end CHARACTERISTIC
/begin CHARACTERISTIC FCspn_MJ_intF_circ "FCtl_SPN(139)" VALUE 0x001E1F90 /* @ECU_Address@FCtl_SPN@0x21B6022C@ */ ECIPP_ALIGNMENT_ULONG 4294967295 Compu_IDENTITY 0 4294967295 PHYS_UNIT "SPN" /end CHARACTERISTIC
/begin CHARACTERISTIC FCspn_MJ_intF_comm "FCtl_SPN(140)" VALUE 0x001E1F94 /* @ECU_Address@FCtl_SPN@0x21B60230@ */ ECIPP_ALIGNMENT_ULONG 4294967295 Compu_IDENTITY 0 4294967295 PHYS_UNIT "SPN" /end CHARACTERISTIC
/begin CHARACTERISTIC FCspn_MJ_intF_Vhi "FCtl_SPN(136)" VALUE 0x001E1F84 /* @ECU_Address@FCtl_SPN@0x21B60220@ */ ECIPP_ALIGNMENT_ULONG 4294967295 Compu_IDENTITY 0 4294967295 PHYS_UNIT "SPN" /end CHARACTERISTIC
/begin CHARACTERISTIC FCspn_MJ_intF_Vlo "FCtl_SPN(137)" VALUE 0x001E1F88 /* @ECU_Address@FCtl_SPN@0x21B60224@ */ ECIPP_ALIGNMENT_ULONG 4294967295 Compu_IDENTITY 0 4294967295 PHYS_UNIT "SPN" /end CHARACTERISTIC
/begin CHARACTERISTIC FCspn_MJ_Pe_HiExp "FCtl_SPN(133)" VALUE 0x001E1F78 /* @ECU_Address@FCtl_SPN@0x21B60214@ */ ECIPP_ALIGNMENT_ULONG 4294967295 Compu_IDENTITY 0 4294967295 PHYS_UNIT "SPN" /end CHARACTERISTIC
/begin CHARACTERISTIC FCspn_MJ_Pe_LoExp "FCtl_SPN(134)" VALUE 0x001E1F7C /* @ECU_Address@FCtl_SPN@0x21B60218@ */ ECIPP_ALIGNMENT_ULONG 4294967295 Compu_IDENTITY 0 4294967295 PHYS_UNIT "SPN" /end CHARACTERISTIC
/begin CHARACTERISTIC FCspn_MJ2_comm_tout "FCtl_SPN(726)" VALUE 0x001E28BC /* @ECU_Address@FCtl_SPN@0x21B60B58@ */ ECIPP_ALIGNMENT_ULONG 4294967295 Compu_IDENTITY 0 4294967295 PHYS_UNIT "SPN" /end CHARACTERISTIC
/begin CHARACTERISTIC FCspn_MJ2_intF_act "FCtl_SPN(729)" VALUE 0x001E28C8 /* @ECU_Address@FCtl_SPN@0x21B60B64@ */ ECIPP_ALIGNMENT_ULONG 4294967295 Compu_IDENTITY 0 4294967295 PHYS_UNIT "SPN" /end CHARACTERISTIC
/begin CHARACTERISTIC FCspn_MJ2_intF_circ "FCtl_SPN(730)" VALUE 0x001E28CC /* @ECU_Address@FCtl_SPN@0x21B60B68@ */ ECIPP_ALIGNMENT_ULONG 4294967295 Compu_IDENTITY 0 4294967295 PHYS_UNIT "SPN" /end CHARACTERISTIC
/begin CHARACTERISTIC FCspn_MJ2_intF_comm "FCtl_SPN(731)" VALUE 0x001E28D0 /* @ECU_Address@FCtl_SPN@0x21B60B6C@ */ ECIPP_ALIGNMENT_ULONG 4294967295 Compu_IDENTITY 0 4294967295 PHYS_UNIT "SPN" /end CHARACTERISTIC
/begin CHARACTERISTIC FCspn_MJ2_intF_Vhi "FCtl_SPN(727)" VALUE 0x001E28C0 /* @ECU_Address@FCtl_SPN@0x21B60B5C@ */ ECIPP_ALIGNMENT_ULONG 4294967295 Compu_IDENTITY 0 4294967295 PHYS_UNIT "SPN" /end CHARACTERISTIC
/begin CHARACTERISTIC FCspn_MJ2_intF_Vlo "FCtl_SPN(728)" VALUE 0x001E28C4 /* @ECU_Address@FCtl_SPN@0x21B60B60@ */ ECIPP_ALIGNMENT_ULONG 4294967295 Compu_IDENTITY 0 4294967295 PHYS_UNIT "SPN" /end CHARACTERISTIC
/begin CHARACTERISTIC FCspn_MJ2_Pe_HiExp "FCtl_SPN(724)" VALUE 0x001E28B4 /* @ECU_Address@FCtl_SPN@0x21B60B50@ */ ECIPP_ALIGNMENT_ULONG 4294967295 Compu_IDENTITY 0 4294967295 PHYS_UNIT "SPN" /end CHARACTERISTIC
/begin CHARACTERISTIC FCspn_MJ2_Pe_LoExp "FCtl_SPN(725)" VALUE 0x001E28B8 /* @ECU_Address@FCtl_SPN@0x21B60B54@ */ ECIPP_ALIGNMENT_ULONG 4294967295 Compu_IDENTITY 0 4294967295 PHYS_UNIT "SPN" /end CHARACTERISTIC
/begin CHARACTERISTIC FCspn_NOx_hi "FCtl_SPN(793)" VALUE 0x001E29C8 /* @ECU_Address@FCtl_SPN@0x21B60C64@ */ ECIPP_ALIGNMENT_ULONG 4294967295 Compu_IDENTITY 0 4294967295 PHYS_UNIT "SPN" /end CHARACTERISTIC
/begin CHARACTERISTIC FCspn_OilP_comm_lost "FCtl_SPN(1045)" VALUE 0x001E2DB8 /* @ECU_Address@FCtl_SPN@0x21B61054@ */ ECIPP_ALIGNMENT_ULONG 4294967295 Compu_IDENTITY 0 4294967295 PHYS_UNIT "SPN" /end CHARACTERISTIC
/begin CHARACTERISTIC FCspn_OilP_hiP "FCtl_SPN(149)" VALUE 0x001E1FB8 /* @ECU_Address@FCtl_SPN@0x21B60254@ */ ECIPP_ALIGNMENT_ULONG 4294967295 Compu_IDENTITY 0 4294967295 PHYS_UNIT "SPN" /end CHARACTERISTIC
/begin CHARACTERISTIC FCspn_OilP_loP "FCtl_SPN(148)" VALUE 0x001E1FB4 /* @ECU_Address@FCtl_SPN@0x21B60250@ */ ECIPP_ALIGNMENT_ULONG 4294967295 Compu_IDENTITY 0 4294967295 PHYS_UNIT "SPN" /end CHARACTERISTIC
/begin CHARACTERISTIC FCspn_OilP_maxV "FCtl_SPN(150)" VALUE 0x001E1FBC /* @ECU_Address@FCtl_SPN@0x21B60258@ */ ECIPP_ALIGNMENT_ULONG 4294967295 Compu_IDENTITY 0 4294967295 PHYS_UNIT "SPN" /end CHARACTERISTIC
/begin CHARACTERISTIC FCspn_OilP_minV "FCtl_SPN(151)" VALUE 0x001E1FC0 /* @ECU_Address@FCtl_SPN@0x21B6025C@ */ ECIPP_ALIGNMENT_ULONG 4294967295 Compu_IDENTITY 0 4294967295 PHYS_UNIT "SPN" /end CHARACTERISTIC
/begin CHARACTERISTIC FCspn_OILP_test "FCtl_SPN(29)" VALUE 0x001E1DD8 /* @ECU_Address@FCtl_SPN@0x21B60074@ */ ECIPP_ALIGNMENT_ULONG 4294967295 Compu_IDENTITY 0 4294967295 PHYS_UNIT "SPN" /end CHARACTERISTIC
/begin CHARACTERISTIC FCspn_OilP_VlvStk "FCtl_SPN(1042)" VALUE 0x001E2DAC /* @ECU_Address@FCtl_SPN@0x21B61048@ */ ECIPP_ALIGNMENT_ULONG 4294967295 Compu_IDENTITY 0 4294967295 PHYS_UNIT "SPN" /end CHARACTERISTIC
/begin CHARACTERISTIC FCspn_OilP2_loP "FCtl_SPN(293)" VALUE 0x001E21F8 /* @ECU_Address@FCtl_SPN@0x21B60494@ */ ECIPP_ALIGNMENT_ULONG 4294967295 Compu_IDENTITY 0 4294967295 PHYS_UNIT "SPN" /end CHARACTERISTIC
/begin CHARACTERISTIC FCspn_OILTL_loss "FCtl_SPN(737)" VALUE 0x001E28E8 /* @ECU_Address@FCtl_SPN@0x21B60B84@ */ ECIPP_ALIGNMENT_ULONG 4294967295 Compu_IDENTITY 0 4294967295 PHYS_UNIT "SPN" /end CHARACTERISTIC
/begin CHARACTERISTIC FCspn_OILTL_Lvl_lo "FCtl_SPN(741)" VALUE 0x001E28F8 /* @ECU_Address@FCtl_SPN@0x21B60B94@ */ ECIPP_ALIGNMENT_ULONG 4294967295 Compu_IDENTITY 0 4294967295 PHYS_UNIT "SPN" /end CHARACTERISTIC
/begin CHARACTERISTIC FCspn_OILTL_Lvl_OOR "FCtl_SPN(739)" VALUE 0x001E28F0 /* @ECU_Address@FCtl_SPN@0x21B60B8C@ */ ECIPP_ALIGNMENT_ULONG 4294967295 Compu_IDENTITY 0 4294967295 PHYS_UNIT "SPN" /end CHARACTERISTIC
/begin CHARACTERISTIC FCspn_OILTL_T_hi "FCtl_SPN(742)" VALUE 0x001E28FC /* @ECU_Address@FCtl_SPN@0x21B60B98@ */ ECIPP_ALIGNMENT_ULONG 4294967295 Compu_IDENTITY 0 4294967295 PHYS_UNIT "SPN" /end CHARACTERISTIC
/begin CHARACTERISTIC FCspn_OILTL_T_OOR "FCtl_SPN(740)" VALUE 0x001E28F4 /* @ECU_Address@FCtl_SPN@0x21B60B90@ */ ECIPP_ALIGNMENT_ULONG 4294967295 Compu_IDENTITY 0 4294967295 PHYS_UNIT "SPN" /end CHARACTERISTIC
/begin CHARACTERISTIC FCspn_OILTL_V_OOR "FCtl_SPN(738)" VALUE 0x001E28EC /* @ECU_Address@FCtl_SPN@0x21B60B88@ */ ECIPP_ALIGNMENT_ULONG 4294967295 Compu_IDENTITY 0 4294967295 PHYS_UNIT "SPN" /end CHARACTERISTIC
/begin CHARACTERISTIC FCspn_PAUX_dP1_max "FCtl_SPN(546)" VALUE 0x001E25EC /* @ECU_Address@FCtl_SPN@0x21B60888@ */ ECIPP_ALIGNMENT_ULONG 4294967295 Compu_IDENTITY 0 4294967295 PHYS_UNIT "SPN" /end CHARACTERISTIC
/begin CHARACTERISTIC FCspn_PAUX_dP1_min "FCtl_SPN(547)" VALUE 0x001E25F0 /* @ECU_Address@FCtl_SPN@0x21B6088C@ */ ECIPP_ALIGNMENT_ULONG 4294967295 Compu_IDENTITY 0 4294967295 PHYS_UNIT "SPN" /end CHARACTERISTIC
/begin CHARACTERISTIC FCspn_PAUX_dP2_max "FCtl_SPN(548)" VALUE 0x001E25F4 /* @ECU_Address@FCtl_SPN@0x21B60890@ */ ECIPP_ALIGNMENT_ULONG 4294967295 Compu_IDENTITY 0 4294967295 PHYS_UNIT "SPN" /end CHARACTERISTIC
/begin CHARACTERISTIC FCspn_PAUX_dP2_min "FCtl_SPN(549)" VALUE 0x001E25F8 /* @ECU_Address@FCtl_SPN@0x21B60894@ */ ECIPP_ALIGNMENT_ULONG 4294967295 Compu_IDENTITY 0 4294967295 PHYS_UNIT "SPN" /end CHARACTERISTIC
/begin CHARACTERISTIC FCspn_PAUX1_max "FCtl_SPN(538)" VALUE 0x001E25CC /* @ECU_Address@FCtl_SPN@0x21B60868@ */ ECIPP_ALIGNMENT_ULONG 4294967295 Compu_IDENTITY 0 4294967295 PHYS_UNIT "SPN" /end CHARACTERISTIC
/begin CHARACTERISTIC FCspn_PAUX1_min "FCtl_SPN(539)" VALUE 0x001E25D0 /* @ECU_Address@FCtl_SPN@0x21B6086C@ */ ECIPP_ALIGNMENT_ULONG 4294967295 Compu_IDENTITY 0 4294967295 PHYS_UNIT "SPN" /end CHARACTERISTIC
/begin CHARACTERISTIC FCspn_PAUX2_max "FCtl_SPN(540)" VALUE 0x001E25D4 /* @ECU_Address@FCtl_SPN@0x21B60870@ */ ECIPP_ALIGNMENT_ULONG 4294967295 Compu_IDENTITY 0 4294967295 PHYS_UNIT "SPN" /end CHARACTERISTIC
/begin CHARACTERISTIC FCspn_PAUX2_min "FCtl_SPN(541)" VALUE 0x001E25D8 /* @ECU_Address@FCtl_SPN@0x21B60874@ */ ECIPP_ALIGNMENT_ULONG 4294967295 Compu_IDENTITY 0 4294967295 PHYS_UNIT "SPN" /end CHARACTERISTIC
/begin CHARACTERISTIC FCspn_PAUX3_max "FCtl_SPN(542)" VALUE 0x001E25DC /* @ECU_Address@FCtl_SPN@0x21B60878@ */ ECIPP_ALIGNMENT_ULONG 4294967295 Compu_IDENTITY 0 4294967295 PHYS_UNIT "SPN" /end CHARACTERISTIC
/begin CHARACTERISTIC FCspn_PAUX3_min "FCtl_SPN(543)" VALUE 0x001E25E0 /* @ECU_Address@FCtl_SPN@0x21B6087C@ */ ECIPP_ALIGNMENT_ULONG 4294967295 Compu_IDENTITY 0 4294967295 PHYS_UNIT "SPN" /end CHARACTERISTIC
/begin CHARACTERISTIC FCspn_PAUX4_max "FCtl_SPN(544)" VALUE 0x001E25E4 /* @ECU_Address@FCtl_SPN@0x21B60880@ */ ECIPP_ALIGNMENT_ULONG 4294967295 Compu_IDENTITY 0 4294967295 PHYS_UNIT "SPN" /end CHARACTERISTIC
/begin CHARACTERISTIC FCspn_PAUX4_min "FCtl_SPN(545)" VALUE 0x001E25E8 /* @ECU_Address@FCtl_SPN@0x21B60884@ */ ECIPP_ALIGNMENT_ULONG 4294967295 Compu_IDENTITY 0 4294967295 PHYS_UNIT "SPN" /end CHARACTERISTIC
/begin CHARACTERISTIC FCspn_post_cntrl_hi_lmt "FCtl_SPN(1041)" VALUE 0x001E2DA8 /* @ECU_Address@FCtl_SPN@0x21B61044@ */ ECIPP_ALIGNMENT_ULONG 4294967295 Compu_IDENTITY 0 4294967295 PHYS_UNIT "SPN" /end CHARACTERISTIC
/begin CHARACTERISTIC FCspn_post_cntrl_lo_lmt "FCtl_SPN(1040)" VALUE 0x001E2DA4 /* @ECU_Address@FCtl_SPN@0x21B61040@ */ ECIPP_ALIGNMENT_ULONG 4294967295 Compu_IDENTITY 0 4294967295 PHYS_UNIT "SPN" /end CHARACTERISTIC
/begin CHARACTERISTIC FCspn_PPEG_BP "FCtl_SPN(670)" VALUE 0x001E27DC /* @ECU_Address@FCtl_SPN@0x21B60A78@ */ ECIPP_ALIGNMENT_ULONG 4294967295 Compu_IDENTITY 0 4294967295 PHYS_UNIT "SPN" /end CHARACTERISTIC
/begin CHARACTERISTIC FCspn_PPEG_CVP1 "FCtl_SPN(745)" VALUE 0x001E2908 /* @ECU_Address@FCtl_SPN@0x21B60BA4@ */ ECIPP_ALIGNMENT_ULONG 4294967295 Compu_IDENTITY 0 4294967295 PHYS_UNIT "SPN" /end CHARACTERISTIC
/begin CHARACTERISTIC FCspn_PPEG_CVP2 "FCtl_SPN(746)" VALUE 0x001E290C /* @ECU_Address@FCtl_SPN@0x21B60BA8@ */ ECIPP_ALIGNMENT_ULONG 4294967295 Compu_IDENTITY 0 4294967295 PHYS_UNIT "SPN" /end CHARACTERISTIC
/begin CHARACTERISTIC FCspn_PPEG_EBP "FCtl_SPN(671)" VALUE 0x001E27E0 /* @ECU_Address@FCtl_SPN@0x21B60A7C@ */ ECIPP_ALIGNMENT_ULONG 4294967295 Compu_IDENTITY 0 4294967295 PHYS_UNIT "SPN" /end CHARACTERISTIC
/begin CHARACTERISTIC FCspn_PPEG_EGRdP "FCtl_SPN(756)" VALUE 0x001E2934 /* @ECU_Address@FCtl_SPN@0x21B60BD0@ */ ECIPP_ALIGNMENT_ULONG 4294967295 Compu_IDENTITY 0 4294967295 PHYS_UNIT "SPN" /end CHARACTERISTIC
/begin CHARACTERISTIC FCspn_PPEG_EGRHP "FCtl_SPN(673)" VALUE 0x001E27E8 /* @ECU_Address@FCtl_SPN@0x21B60A84@ */ ECIPP_ALIGNMENT_ULONG 4294967295 Compu_IDENTITY 0 4294967295 PHYS_UNIT "SPN" /end CHARACTERISTIC
/begin CHARACTERISTIC FCspn_PPEG_EGRLP "FCtl_SPN(672)" VALUE 0x001E27E4 /* @ECU_Address@FCtl_SPN@0x21B60A80@ */ ECIPP_ALIGNMENT_ULONG 4294967295 Compu_IDENTITY 0 4294967295 PHYS_UNIT "SPN" /end CHARACTERISTIC
/begin CHARACTERISTIC FCspn_PPEG_EGRwrP "FCtl_SPN(675)" VALUE 0x001E27F0 /* @ECU_Address@FCtl_SPN@0x21B60A8C@ */ ECIPP_ALIGNMENT_ULONG 4294967295 Compu_IDENTITY 0 4294967295 PHYS_UNIT "SPN" /end CHARACTERISTIC
/begin CHARACTERISTIC FCspn_PPEG_MAP "FCtl_SPN(676)" VALUE 0x001E27F4 /* @ECU_Address@FCtl_SPN@0x21B60A90@ */ ECIPP_ALIGNMENT_ULONG 4294967295 Compu_IDENTITY 0 4294967295 PHYS_UNIT "SPN" /end CHARACTERISTIC
/begin CHARACTERISTIC FCspn_PPEG_TIP "FCtl_SPN(674)" VALUE 0x001E27EC /* @ECU_Address@FCtl_SPN@0x21B60A88@ */ ECIPP_ALIGNMENT_ULONG 4294967295 Compu_IDENTITY 0 4294967295 PHYS_UNIT "SPN" /end CHARACTERISTIC
/begin CHARACTERISTIC FCspn_Pri1_open "FCtl_SPN(901)" VALUE 0x001E2B78 /* @ECU_Address@FCtl_SPN@0x21B60E14@ */ ECIPP_ALIGNMENT_ULONG 4294967295 Compu_IDENTITY 0 4294967295 PHYS_UNIT "SPN" /end CHARACTERISTIC
/begin CHARACTERISTIC FCspn_Pri1_short "FCtl_SPN(913)" VALUE 0x001E2BA8 /* @ECU_Address@FCtl_SPN@0x21B60E44@ */ ECIPP_ALIGNMENT_ULONG 4294967295 Compu_IDENTITY 0 4294967295 PHYS_UNIT "SPN" /end CHARACTERISTIC
/begin CHARACTERISTIC FCspn_PWM1_off_loVf "FCtl_SPN(189)" VALUE 0x001E2058 /* @ECU_Address@FCtl_SPN@0x21B602F4@ */ ECIPP_ALIGNMENT_ULONG 4294967295 Compu_IDENTITY 0 4294967295 PHYS_UNIT "SPN" /end CHARACTERISTIC
/begin CHARACTERISTIC FCspn_PWM1_on_hiVf "FCtl_SPN(190)" VALUE 0x001E205C /* @ECU_Address@FCtl_SPN@0x21B602F8@ */ ECIPP_ALIGNMENT_ULONG 4294967295 Compu_IDENTITY 0 4294967295 PHYS_UNIT "SPN" /end CHARACTERISTIC
/begin CHARACTERISTIC FCspn_PWM10_off_loVf "FCtl_SPN(433)" VALUE 0x001E2428 /* @ECU_Address@FCtl_SPN@0x21B606C4@ */ ECIPP_ALIGNMENT_ULONG 4294967295 Compu_IDENTITY 0 4294967295 PHYS_UNIT "SPN" /end CHARACTERISTIC
/begin CHARACTERISTIC FCspn_PWM10_on_hiVf "FCtl_SPN(434)" VALUE 0x001E242C /* @ECU_Address@FCtl_SPN@0x21B606C8@ */ ECIPP_ALIGNMENT_ULONG 4294967295 Compu_IDENTITY 0 4294967295 PHYS_UNIT "SPN" /end CHARACTERISTIC
/begin CHARACTERISTIC FCspn_PWM11_off_loVf "FCtl_SPN(435)" VALUE 0x001E2430 /* @ECU_Address@FCtl_SPN@0x21B606CC@ */ ECIPP_ALIGNMENT_ULONG 4294967295 Compu_IDENTITY 0 4294967295 PHYS_UNIT "SPN" /end CHARACTERISTIC
/begin CHARACTERISTIC FCspn_PWM11_on_hiVf "FCtl_SPN(436)" VALUE 0x001E2434 /* @ECU_Address@FCtl_SPN@0x21B606D0@ */ ECIPP_ALIGNMENT_ULONG 4294967295 Compu_IDENTITY 0 4294967295 PHYS_UNIT "SPN" /end CHARACTERISTIC
/begin CHARACTERISTIC FCspn_PWM12_off_loVf "FCtl_SPN(437)" VALUE 0x001E2438 /* @ECU_Address@FCtl_SPN@0x21B606D4@ */ ECIPP_ALIGNMENT_ULONG 4294967295 Compu_IDENTITY 0 4294967295 PHYS_UNIT "SPN" /end CHARACTERISTIC
/begin CHARACTERISTIC FCspn_PWM12_on_hiVf "FCtl_SPN(438)" VALUE 0x001E243C /* @ECU_Address@FCtl_SPN@0x21B606D8@ */ ECIPP_ALIGNMENT_ULONG 4294967295 Compu_IDENTITY 0 4294967295 PHYS_UNIT "SPN" /end CHARACTERISTIC
/begin CHARACTERISTIC FCspn_PWM13_off_loVf "FCtl_SPN(439)" VALUE 0x001E2440 /* @ECU_Address@FCtl_SPN@0x21B606DC@ */ ECIPP_ALIGNMENT_ULONG 4294967295 Compu_IDENTITY 0 4294967295 PHYS_UNIT "SPN" /end CHARACTERISTIC
/begin CHARACTERISTIC FCspn_PWM13_on_hiVf "FCtl_SPN(440)" VALUE 0x001E2444 /* @ECU_Address@FCtl_SPN@0x21B606E0@ */ ECIPP_ALIGNMENT_ULONG 4294967295 Compu_IDENTITY 0 4294967295 PHYS_UNIT "SPN" /end CHARACTERISTIC
/begin CHARACTERISTIC FCspn_PWM14_off_loVf "FCtl_SPN(441)" VALUE 0x001E2448 /* @ECU_Address@FCtl_SPN@0x21B606E4@ */ ECIPP_ALIGNMENT_ULONG 4294967295 Compu_IDENTITY 0 4294967295 PHYS_UNIT "SPN" /end CHARACTERISTIC
/begin CHARACTERISTIC FCspn_PWM14_on_hiVf "FCtl_SPN(442)" VALUE 0x001E244C /* @ECU_Address@FCtl_SPN@0x21B606E8@ */ ECIPP_ALIGNMENT_ULONG 4294967295 Compu_IDENTITY 0 4294967295 PHYS_UNIT "SPN" /end CHARACTERISTIC
/begin CHARACTERISTIC FCspn_PWM15_off_loVf "FCtl_SPN(443)" VALUE 0x001E2450 /* @ECU_Address@FCtl_SPN@0x21B606EC@ */ ECIPP_ALIGNMENT_ULONG 4294967295 Compu_IDENTITY 0 4294967295 PHYS_UNIT "SPN" /end CHARACTERISTIC
/begin CHARACTERISTIC FCspn_PWM15_on_hiVf "FCtl_SPN(444)" VALUE 0x001E2454 /* @ECU_Address@FCtl_SPN@0x21B606F0@ */ ECIPP_ALIGNMENT_ULONG 4294967295 Compu_IDENTITY 0 4294967295 PHYS_UNIT "SPN" /end CHARACTERISTIC
/begin CHARACTERISTIC FCspn_PWM16_off_loVf "FCtl_SPN(445)" VALUE 0x001E2458 /* @ECU_Address@FCtl_SPN@0x21B606F4@ */ ECIPP_ALIGNMENT_ULONG 4294967295 Compu_IDENTITY 0 4294967295 PHYS_UNIT "SPN" /end CHARACTERISTIC
/begin CHARACTERISTIC FCspn_PWM16_on_hiVf "FCtl_SPN(446)" VALUE 0x001E245C /* @ECU_Address@FCtl_SPN@0x21B606F8@ */ ECIPP_ALIGNMENT_ULONG 4294967295 Compu_IDENTITY 0 4294967295 PHYS_UNIT "SPN" /end CHARACTERISTIC
/begin CHARACTERISTIC FPfl_MJ_intF_circ "FPrm_latch(98)" VALUE 0x001E01A0 /* @ECU_Address@FPrm_latch@0x021BB188@ */ ECIPP_ALIGNMENT_FLOAT32_IEEE 10000000000 Compu_IDENTITY -10000000000 10000000000 PHYS_UNIT "ms" /end CHARACTERISTIC
/begin CHARACTERISTIC FPfl_MJ_intF_comm "FPrm_latch(99)" VALUE 0x001E01A4 /* @ECU_Address@FPrm_latch@0x021BB18C@ */ ECIPP_ALIGNMENT_FLOAT32_IEEE 10000000000 Compu_IDENTITY -10000000000 10000000000 PHYS_UNIT "ms" /end CHARACTERISTIC
/begin CHARACTERISTIC FPfl_MJ_intF_Vhi "FPrm_latch(95)" VALUE 0x001E0194 /* @ECU_Address@FPrm_latch@0x021BB17C@ */ ECIPP_ALIGNMENT_FLOAT32_IEEE 10000000000 Compu_IDENTITY -10000000000 10000000000 PHYS_UNIT "ms" /end CHARACTERISTIC
/begin CHARACTERISTIC FPfl_MJ_intF_Vlo "FPrm_latch(96)" VALUE 0x001E0198 /* @ECU_Address@FPrm_latch@0x021BB180@ */ ECIPP_ALIGNMENT_FLOAT32_IEEE 10000000000 Compu_IDENTITY -10000000000 10000000000 PHYS_UNIT "ms" /end CHARACTERISTIC
/begin CHARACTERISTIC FPfl_MJ_Pe_HiExp "FPrm_latch(92)" VALUE 0x001E0188 /* @ECU_Address@FPrm_latch@0x021BB170@ */ ECIPP_ALIGNMENT_FLOAT32_IEEE 10000000000 Compu_IDENTITY -10000000000 10000000000 PHYS_UNIT "ms" /end CHARACTERISTIC
/begin CHARACTERISTIC FPfl_MJ_Pe_LoExp "FPrm_latch(93)" VALUE 0x001E018C /* @ECU_Address@FPrm_latch@0x021BB174@ */ ECIPP_ALIGNMENT_FLOAT32_IEEE 10000000000 Compu_IDENTITY -10000000000 10000000000 PHYS_UNIT "ms" /end CHARACTERISTIC
/begin CHARACTERISTIC FPfl_MJ2_comm_tout "FPrm_latch(556)" VALUE 0x001E08C8 /* @ECU_Address@FPrm_latch@0x021BB8B0@ */ ECIPP_ALIGNMENT_FLOAT32_IEEE 10000000000 Compu_IDENTITY -10000000000 10000000000 PHYS_UNIT "ms" /end CHARACTERISTIC
/begin CHARACTERISTIC FPfl_MJ2_intF_act "FPrm_latch(559)" VALUE 0x001E08D4 /* @ECU_Address@FPrm_latch@0x021BB8BC@ */ ECIPP_ALIGNMENT_FLOAT32_IEEE 10000000000 Compu_IDENTITY -10000000000 10000000000 PHYS_UNIT "ms" /end CHARACTERISTIC
/begin CHARACTERISTIC FPfl_MJ2_intF_circ "FPrm_latch(560)" VALUE 0x001E08D8 /* @ECU_Address@FPrm_latch@0x021BB8C0@ */ ECIPP_ALIGNMENT_FLOAT32_IEEE 10000000000 Compu_IDENTITY -10000000000 10000000000 PHYS_UNIT "ms" /end CHARACTERISTIC
/begin CHARACTERISTIC FPfl_MJ2_intF_comm "FPrm_latch(561)" VALUE 0x001E08DC /* @ECU_Address@FPrm_latch@0x021BB8C4@ */ ECIPP_ALIGNMENT_FLOAT32_IEEE 10000000000 Compu_IDENTITY -10000000000 10000000000 PHYS_UNIT "ms" /end CHARACTERISTIC
/begin CHARACTERISTIC FPfl_MJ2_intF_Vhi "FPrm_latch(557)" VALUE 0x001E08CC /* @ECU_Address@FPrm_latch@0x021BB8B4@ */ ECIPP_ALIGNMENT_FLOAT32_IEEE 10000000000 Compu_IDENTITY -10000000000 10000000000 PHYS_UNIT "ms" /end CHARACTERISTIC
/begin CHARACTERISTIC FPfl_MJ2_intF_Vlo "FPrm_latch(558)" VALUE 0x001E08D0 /* @ECU_Address@FPrm_latch@0x021BB8B8@ */ ECIPP_ALIGNMENT_FLOAT32_IEEE 10000000000 Compu_IDENTITY -10000000000 10000000000 PHYS_UNIT "ms" /end CHARACTERISTIC
/begin CHARACTERISTIC FPfl_MJ2_Pe_HiExp "FPrm_latch(554)" VALUE 0x001E08C0 /* @ECU_Address@FPrm_latch@0x021BB8A8@ */ ECIPP_ALIGNMENT_FLOAT32_IEEE 10000000000 Compu_IDENTITY -10000000000 10000000000 PHYS_UNIT "ms" /end CHARACTERISTIC
/begin CHARACTERISTIC FPfl_MJ2_Pe_LoExp "FPrm_latch(555)" VALUE 0x001E08C4 /* @ECU_Address@FPrm_latch@0x021BB8AC@ */ ECIPP_ALIGNMENT_FLOAT32_IEEE 10000000000 Compu_IDENTITY -10000000000 10000000000 PHYS_UNIT "ms" /end CHARACTERISTIC
/begin CHARACTERISTIC FPfl_NOx_hi "FPrm_latch(623)" VALUE 0x001E09D4 /* @ECU_Address@FPrm_latch@0x021BB9BC@ */ ECIPP_ALIGNMENT_FLOAT32_IEEE 10000000000 Compu_IDENTITY -10000000000 10000000000 PHYS_UNIT "ms" /end CHARACTERISTIC
/begin CHARACTERISTIC FPfl_OilP_comm_lost "FPrm_latch(721)" VALUE 0x001E0B5C /* @ECU_Address@FPrm_latch@0x021BBB44@ */ ECIPP_ALIGNMENT_FLOAT32_IEEE 10000000000 Compu_IDENTITY -10000000000 10000000000 PHYS_UNIT "ms" /end CHARACTERISTIC
/begin CHARACTERISTIC FPfl_OilP_hiP "FPrm_latch(109)" VALUE 0x001E01CC /* @ECU_Address@FPrm_latch@0x021BB1B4@ */ ECIPP_ALIGNMENT_FLOAT32_IEEE 10000000000 Compu_IDENTITY -10000000000 10000000000 PHYS_UNIT "ms" /end CHARACTERISTIC
/begin CHARACTERISTIC FPfl_OilP_loP "FPrm_latch(108)" VALUE 0x001E01C8 /* @ECU_Address@FPrm_latch@0x021BB1B0@ */ ECIPP_ALIGNMENT_FLOAT32_IEEE 10000000000 Compu_IDENTITY -10000000000 10000000000 PHYS_UNIT "ms" /end CHARACTERISTIC
/begin CHARACTERISTIC FPfl_OilP_maxV "FPrm_latch(110)" VALUE 0x001E01D0 /* @ECU_Address@FPrm_latch@0x021BB1B8@ */ ECIPP_ALIGNMENT_FLOAT32_IEEE 10000000000 Compu_IDENTITY -10000000000 10000000000 PHYS_UNIT "ms" /end CHARACTERISTIC
/begin CHARACTERISTIC FPfl_OilP_minV "FPrm_latch(111)" VALUE 0x001E01D4 /* @ECU_Address@FPrm_latch@0x021BB1BC@ */ ECIPP_ALIGNMENT_FLOAT32_IEEE 10000000000 Compu_IDENTITY -10000000000 10000000000 PHYS_UNIT "ms" /end CHARACTERISTIC
/begin CHARACTERISTIC FPfl_OILP_test "FPrm_latch(40)" VALUE 0x001E00B8 /* @ECU_Address@FPrm_latch@0x021BB0A0@ */ ECIPP_ALIGNMENT_FLOAT32_IEEE 10000000000 Compu_IDENTITY -10000000000 10000000000 PHYS_UNIT "ms" /end CHARACTERISTIC
/begin CHARACTERISTIC FPfl_OilP_VlvStk "FPrm_latch(718)" VALUE 0x001E0B50 /* @ECU_Address@FPrm_latch@0x021BBB38@ */ ECIPP_ALIGNMENT_FLOAT32_IEEE 10000000000 Compu_IDENTITY -10000000000 10000000000 PHYS_UNIT "ms" /end CHARACTERISTIC
/begin CHARACTERISTIC FPfl_OilP2_loP "FPrm_latch(215)" VALUE 0x001E0374 /* @ECU_Address@FPrm_latch@0x021BB35C@ */ ECIPP_ALIGNMENT_FLOAT32_IEEE 10000000000 Compu_IDENTITY -10000000000 10000000000 PHYS_UNIT "ms" /end CHARACTERISTIC
/begin CHARACTERISTIC FPfl_OILTL_loss "FPrm_latch(567)" VALUE 0x001E08F4 /* @ECU_Address@FPrm_latch@0x021BB8DC@ */ ECIPP_ALIGNMENT_FLOAT32_IEEE 10000000000 Compu_IDENTITY -10000000000 10000000000 PHYS_UNIT "ms" /end CHARACTERISTIC
/begin CHARACTERISTIC FPfl_OILTL_Lvl_lo "FPrm_latch(571)" VALUE 0x001E0904 /* @ECU_Address@FPrm_latch@0x021BB8EC@ */ ECIPP_ALIGNMENT_FLOAT32_IEEE 10000000000 Compu_IDENTITY -10000000000 10000000000 PHYS_UNIT "ms" /end CHARACTERISTIC
/begin CHARACTERISTIC FPfl_OILTL_Lvl_OOR "FPrm_latch(569)" VALUE 0x001E08FC /* @ECU_Address@FPrm_latch@0x021BB8E4@ */ ECIPP_ALIGNMENT_FLOAT32_IEEE 10000000000 Compu_IDENTITY -10000000000 10000000000 PHYS_UNIT "ms" /end CHARACTERISTIC
/begin CHARACTERISTIC FPfl_OILTL_T_hi "FPrm_latch(572)" VALUE 0x001E0908 /* @ECU_Address@FPrm_latch@0x021BB8F0@ */ ECIPP_ALIGNMENT_FLOAT32_IEEE 10000000000 Compu_IDENTITY -10000000000 10000000000 PHYS_UNIT "ms" /end CHARACTERISTIC
/begin CHARACTERISTIC FPfl_OILTL_T_OOR "FPrm_latch(570)" VALUE 0x001E0900 /* @ECU_Address@FPrm_latch@0x021BB8E8@ */ ECIPP_ALIGNMENT_FLOAT32_IEEE 10000000000 Compu_IDENTITY -10000000000 10000000000 PHYS_UNIT "ms" /end CHARACTERISTIC
/begin CHARACTERISTIC FPfl_OILTL_V_OOR "FPrm_latch(568)" VALUE 0x001E08F8 /* @ECU_Address@FPrm_latch@0x021BB8E0@ */ ECIPP_ALIGNMENT_FLOAT32_IEEE 10000000000 Compu_IDENTITY -10000000000 10000000000 PHYS_UNIT "ms" /end CHARACTERISTIC
/begin CHARACTERISTIC FPfl_PAUX_dP1_max "FPrm_latch(416)" VALUE 0x001E0698 /* @ECU_Address@FPrm_latch@0x021BB680@ */ ECIPP_ALIGNMENT_FLOAT32_IEEE 10000000000 Compu_IDENTITY -10000000000 10000000000 PHYS_UNIT "ms" /end CHARACTERISTIC
/begin CHARACTERISTIC FPfl_PAUX_dP1_min "FPrm_latch(417)" VALUE 0x001E069C /* @ECU_Address@FPrm_latch@0x021BB684@ */ ECIPP_ALIGNMENT_FLOAT32_IEEE 10000000000 Compu_IDENTITY -10000000000 10000000000 PHYS_UNIT "ms" /end CHARACTERISTIC
/begin CHARACTERISTIC FPfl_PAUX_dP2_max "FPrm_latch(418)" VALUE 0x001E06A0 /* @ECU_Address@FPrm_latch@0x021BB688@ */ ECIPP_ALIGNMENT_FLOAT32_IEEE 10000000000 Compu_IDENTITY -10000000000 10000000000 PHYS_UNIT "ms" /end CHARACTERISTIC
/begin CHARACTERISTIC FPfl_PAUX_dP2_min "FPrm_latch(419)" VALUE 0x001E06A4 /* @ECU_Address@FPrm_latch@0x021BB68C@ */ ECIPP_ALIGNMENT_FLOAT32_IEEE 10000000000 Compu_IDENTITY -10000000000 10000000000 PHYS_UNIT "ms" /end CHARACTERISTIC
/begin CHARACTERISTIC FPfl_PAUX1_max "FPrm_latch(408)" VALUE 0x001E0678 /* @ECU_Address@FPrm_latch@0x021BB660@ */ ECIPP_ALIGNMENT_FLOAT32_IEEE 10000000000 Compu_IDENTITY -10000000000 10000000000 PHYS_UNIT "ms" /end CHARACTERISTIC
/begin CHARACTERISTIC FPfl_PAUX1_min "FPrm_latch(409)" VALUE 0x001E067C /* @ECU_Address@FPrm_latch@0x021BB664@ */ ECIPP_ALIGNMENT_FLOAT32_IEEE 10000000000 Compu_IDENTITY -10000000000 10000000000 PHYS_UNIT "ms" /end CHARACTERISTIC
/begin CHARACTERISTIC FPfl_PAUX2_max "FPrm_latch(410)" VALUE 0x001E0680 /* @ECU_Address@FPrm_latch@0x021BB668@ */ ECIPP_ALIGNMENT_FLOAT32_IEEE 10000000000 Compu_IDENTITY -10000000000 10000000000 PHYS_UNIT "ms" /end CHARACTERISTIC
/begin CHARACTERISTIC FPfl_PAUX2_min "FPrm_latch(411)" VALUE 0x001E0684 /* @ECU_Address@FPrm_latch@0x021BB66C@ */ ECIPP_ALIGNMENT_FLOAT32_IEEE 10000000000 Compu_IDENTITY -10000000000 10000000000 PHYS_UNIT "ms" /end CHARACTERISTIC
/begin CHARACTERISTIC FPfl_PAUX3_max "FPrm_latch(412)" VALUE 0x001E0688 /* @ECU_Address@FPrm_latch@0x021BB670@ */ ECIPP_ALIGNMENT_FLOAT32_IEEE 10000000000 Compu_IDENTITY -10000000000 10000000000 PHYS_UNIT "ms" /end CHARACTERISTIC
/begin CHARACTERISTIC FPfl_PAUX3_min "FPrm_latch(413)" VALUE 0x001E068C /* @ECU_Address@FPrm_latch@0x021BB674@ */ ECIPP_ALIGNMENT_FLOAT32_IEEE 10000000000 Compu_IDENTITY -10000000000 10000000000 PHYS_UNIT "ms" /end CHARACTERISTIC
/begin CHARACTERISTIC FPfl_PAUX4_max "FPrm_latch(414)" VALUE 0x001E0690 /* @ECU_Address@FPrm_latch@0x021BB678@ */ ECIPP_ALIGNMENT_FLOAT32_IEEE 10000000000 Compu_IDENTITY -10000000000 10000000000 PHYS_UNIT "ms" /end CHARACTERISTIC
/begin CHARACTERISTIC FPfl_PAUX4_min "FPrm_latch(415)" VALUE 0x001E0694 /* @ECU_Address@FPrm_latch@0x021BB67C@ */ ECIPP_ALIGNMENT_FLOAT32_IEEE 10000000000 Compu_IDENTITY -10000000000 10000000000 PHYS_UNIT "ms" /end CHARACTERISTIC
/begin CHARACTERISTIC FPfl_post_cntrl_hi_lmt "FPrm_latch(717)" VALUE 0x001E0B4C /* @ECU_Address@FPrm_latch@0x021BBB34@ */ ECIPP_ALIGNMENT_FLOAT32_IEEE 10000000000 Compu_IDENTITY -10000000000 10000000000 PHYS_UNIT "updates" /end CHARACTERISTIC
/begin CHARACTERISTIC FPfl_post_cntrl_lo_lmt "FPrm_latch(716)" VALUE 0x001E0B48 /* @ECU_Address@FPrm_latch@0x021BBB30@ */ ECIPP_ALIGNMENT_FLOAT32_IEEE 10000000000 Compu_IDENTITY -10000000000 10000000000 PHYS_UNIT "updates" /end CHARACTERISTIC
/begin CHARACTERISTIC FPfl_PPEG_BP "FPrm_latch(500)" VALUE 0x001E07E8 /* @ECU_Address@FPrm_latch@0x021BB7D0@ */ ECIPP_ALIGNMENT_FLOAT32_IEEE 10000000000 Compu_IDENTITY -10000000000 10000000000 PHYS_UNIT "ms" /end CHARACTERISTIC
/begin CHARACTERISTIC FPfl_PPEG_CVP1 "FPrm_latch(575)" VALUE 0x001E0914 /* @ECU_Address@FPrm_latch@0x021BB8FC@ */ ECIPP_ALIGNMENT_FLOAT32_IEEE 10000000000 Compu_IDENTITY -10000000000 10000000000 PHYS_UNIT "ms" /end CHARACTERISTIC
/begin CHARACTERISTIC FPfl_PPEG_CVP2 "FPrm_latch(576)" VALUE 0x001E0918 /* @ECU_Address@FPrm_latch@0x021BB900@ */ ECIPP_ALIGNMENT_FLOAT32_IEEE 10000000000 Compu_IDENTITY -10000000000 10000000000 PHYS_UNIT "ms" /end CHARACTERISTIC
/begin CHARACTERISTIC FPfl_PPEG_EBP "FPrm_latch(501)" VALUE 0x001E07EC /* @ECU_Address@FPrm_latch@0x021BB7D4@ */ ECIPP_ALIGNMENT_FLOAT32_IEEE 10000000000 Compu_IDENTITY -10000000000 10000000000 PHYS_UNIT "ms" /end CHARACTERISTIC
/begin CHARACTERISTIC FPfl_PPEG_EGRdP "FPrm_latch(586)" VALUE 0x001E0940 /* @ECU_Address@FPrm_latch@0x021BB928@ */ ECIPP_ALIGNMENT_FLOAT32_IEEE 10000000000 Compu_IDENTITY -10000000000 10000000000 PHYS_UNIT "ms" /end CHARACTERISTIC
/begin CHARACTERISTIC FPfl_PPEG_EGRHP "FPrm_latch(503)" VALUE 0x001E07F4 /* @ECU_Address@FPrm_latch@0x021BB7DC@ */ ECIPP_ALIGNMENT_FLOAT32_IEEE 10000000000 Compu_IDENTITY -10000000000 10000000000 PHYS_UNIT "ms" /end CHARACTERISTIC
/begin CHARACTERISTIC FPfl_PPEG_EGRLP "FPrm_latch(502)" VALUE 0x001E07F0 /* @ECU_Address@FPrm_latch@0x021BB7D8@ */ ECIPP_ALIGNMENT_FLOAT32_IEEE 10000000000 Compu_IDENTITY -10000000000 10000000000 PHYS_UNIT "ms" /end CHARACTERISTIC
/begin CHARACTERISTIC FPfl_PPEG_EGRwrP "FPrm_latch(505)" VALUE 0x001E07FC /* @ECU_Address@FPrm_latch@0x021BB7E4@ */ ECIPP_ALIGNMENT_FLOAT32_IEEE 10000000000 Compu_IDENTITY -10000000000 10000000000 PHYS_UNIT "ms" /end CHARACTERISTIC
/begin CHARACTERISTIC FPfl_PPEG_MAP "FPrm_latch(506)" VALUE 0x001E0800 /* @ECU_Address@FPrm_latch@0x021BB7E8@ */ ECIPP_ALIGNMENT_FLOAT32_IEEE 10000000000 Compu_IDENTITY -10000000000 10000000000 PHYS_UNIT "ms" /end CHARACTERISTIC
/begin CHARACTERISTIC FPfl_PPEG_TIP "FPrm_latch(504)" VALUE 0x001E07F8 /* @ECU_Address@FPrm_latch@0x021BB7E0@ */ ECIPP_ALIGNMENT_FLOAT32_IEEE 10000000000 Compu_IDENTITY -10000000000 10000000000 PHYS_UNIT "ms" /end CHARACTERISTIC
/begin CHARACTERISTIC FPfl_Pri1_open "FPrm_latch(703)" VALUE 0x001E0B14 /* @ECU_Address@FPrm_latch@0x021BBAFC@ */ ECIPP_ALIGNMENT_FLOAT32_IEEE 10000000000 Compu_IDENTITY -10000000000 10000000000 PHYS_UNIT "ms" /end CHARACTERISTIC
/begin CHARACTERISTIC FPfl_Pri1_short "FPrm_latch(704)" VALUE 0x001E0B18 /* @ECU_Address@FPrm_latch@0x021BBB00@ */ ECIPP_ALIGNMENT_FLOAT32_IEEE 10000000000 Compu_IDENTITY -10000000000 10000000000 PHYS_UNIT "ms" /end CHARACTERISTIC
/begin CHARACTERISTIC FPfl_PWM1_off_loVf "FPrm_latch(147)" VALUE 0x001E0264 /* @ECU_Address@FPrm_latch@0x021BB24C@ */ ECIPP_ALIGNMENT_FLOAT32_IEEE 10000000000 Compu_IDENTITY -10000000000 10000000000 PHYS_UNIT "ms" /end CHARACTERISTIC
/begin CHARACTERISTIC FPfl_PWM1_on_hiVf "FPrm_latch(148)" VALUE 0x001E0268 /* @ECU_Address@FPrm_latch@0x021BB250@ */ ECIPP_ALIGNMENT_FLOAT32_IEEE 10000000000 Compu_IDENTITY -10000000000 10000000000 PHYS_UNIT "ms" /end CHARACTERISTIC
/begin CHARACTERISTIC FPfl_PWM10_off_loVf "FPrm_latch(330)" VALUE 0x001E0540 /* @ECU_Address@FPrm_latch@0x021BB528@ */ ECIPP_ALIGNMENT_FLOAT32_IEEE 10000000000 Compu_IDENTITY -10000000000 10000000000 PHYS_UNIT "ms" /end CHARACTERISTIC
/begin CHARACTERISTIC FPfl_PWM10_on_hiVf "FPrm_latch(331)" VALUE 0x001E0544 /* @ECU_Address@FPrm_latch@0x021BB52C@ */ ECIPP_ALIGNMENT_FLOAT32_IEEE 10000000000 Compu_IDENTITY -10000000000 10000000000 PHYS_UNIT "ms" /end CHARACTERISTIC
/begin CHARACTERISTIC FPfl_PWM11_off_loVf "FPrm_latch(332)" VALUE 0x001E0548 /* @ECU_Address@FPrm_latch@0x021BB530@ */ ECIPP_ALIGNMENT_FLOAT32_IEEE 10000000000 Compu_IDENTITY -10000000000 10000000000 PHYS_UNIT "ms" /end CHARACTERISTIC
/begin CHARACTERISTIC FPfl_PWM11_on_hiVf "FPrm_latch(333)" VALUE 0x001E054C /* @ECU_Address@FPrm_latch@0x021BB534@ */ ECIPP_ALIGNMENT_FLOAT32_IEEE 10000000000 Compu_IDENTITY -10000000000 10000000000 PHYS_UNIT "ms" /end CHARACTERISTIC
/begin CHARACTERISTIC FPfl_PWM12_off_loVf "FPrm_latch(334)" VALUE 0x001E0550 /* @ECU_Address@FPrm_latch@0x021BB538@ */ ECIPP_ALIGNMENT_FLOAT32_IEEE 10000000000 Compu_IDENTITY -10000000000 10000000000 PHYS_UNIT "ms" /end CHARACTERISTIC
/begin CHARACTERISTIC FPfl_PWM12_on_hiVf "FPrm_latch(335)" VALUE 0x001E0554 /* @ECU_Address@FPrm_latch@0x021BB53C@ */ ECIPP_ALIGNMENT_FLOAT32_IEEE 10000000000 Compu_IDENTITY -10000000000 10000000000 PHYS_UNIT "ms" /end CHARACTERISTIC
/begin CHARACTERISTIC FPfl_PWM13_off_loVf "FPrm_latch(336)" VALUE 0x001E0558 /* @ECU_Address@FPrm_latch@0x021BB540@ */ ECIPP_ALIGNMENT_FLOAT32_IEEE 10000000000 Compu_IDENTITY -10000000000 10000000000 PHYS_UNIT "ms" /end CHARACTERISTIC
/begin CHARACTERISTIC FPfl_PWM13_on_hiVf "FPrm_latch(337)" VALUE 0x001E055C /* @ECU_Address@FPrm_latch@0x021BB544@ */ ECIPP_ALIGNMENT_FLOAT32_IEEE 10000000000 Compu_IDENTITY -10000000000 10000000000 PHYS_UNIT "ms" /end CHARACTERISTIC
/begin CHARACTERISTIC FPfl_PWM14_off_loVf "FPrm_latch(338)" VALUE 0x001E0560 /* @ECU_Address@FPrm_latch@0x021BB548@ */ ECIPP_ALIGNMENT_FLOAT32_IEEE 10000000000 Compu_IDENTITY -10000000000 10000000000 PHYS_UNIT "ms" /end CHARACTERISTIC
/begin CHARACTERISTIC FPfl_PWM14_on_hiVf "FPrm_latch(339)" VALUE 0x001E0564 /* @ECU_Address@FPrm_latch@0x021BB54C@ */ ECIPP_ALIGNMENT_FLOAT32_IEEE 10000000000 Compu_IDENTITY -10000000000 10000000000 PHYS_UNIT "ms" /end CHARACTERISTIC
/begin CHARACTERISTIC FPfl_PWM15_off_loVf "FPrm_latch(340)" VALUE 0x001E0568 /* @ECU_Address@FPrm_latch@0x021BB550@ */ ECIPP_ALIGNMENT_FLOAT32_IEEE 10000000000 Compu_IDENTITY -10000000000 10000000000 PHYS_UNIT "ms" /end CHARACTERISTIC
/begin CHARACTERISTIC FPfl_PWM15_on_hiVf "FPrm_latch(341)" VALUE 0x001E056C /* @ECU_Address@FPrm_latch@0x021BB554@ */ ECIPP_ALIGNMENT_FLOAT32_IEEE 10000000000 Compu_IDENTITY -10000000000 10000000000 PHYS_UNIT "ms" /end CHARACTERISTIC
/begin CHARACTERISTIC FPfl_PWM16_off_loVf "FPrm_latch(342)" VALUE 0x001E0570 /* @ECU_Address@FPrm_latch@0x021BB558@ */ ECIPP_ALIGNMENT_FLOAT32_IEEE 10000000000 Compu_IDENTITY -10000000000 10000000000 PHYS_UNIT "ms" /end CHARACTERISTIC
/begin CHARACTERISTIC FPfl_PWM16_on_hiVf "FPrm_latch(343)" VALUE 0x001E0574 /* @ECU_Address@FPrm_latch@0x021BB55C@ */ ECIPP_ALIGNMENT_FLOAT32_IEEE 10000000000 Compu_IDENTITY -10000000000 10000000000 PHYS_UNIT "ms" /end CHARACTERISTIC
/begin CHARACTERISTIC FPfu_MJ_intF_circ "FPrm_unlatch(98)" VALUE 0x001E0CE8 /* @ECU_Address@FPrm_unlatch@0x021BD188@ */ ECIPP_ALIGNMENT_FLOAT32_IEEE 10000000000 Compu_IDENTITY -10000000000 10000000000 PHYS_UNIT "ms" /end CHARACTERISTIC
/begin CHARACTERISTIC FPfu_MJ_intF_comm "FPrm_unlatch(99)" VALUE 0x001E0CEC /* @ECU_Address@FPrm_unlatch@0x021BD18C@ */ ECIPP_ALIGNMENT_FLOAT32_IEEE 10000000000 Compu_IDENTITY -10000000000 10000000000 PHYS_UNIT "ms" /end CHARACTERISTIC
/begin CHARACTERISTIC FPfu_MJ_intF_Vhi "FPrm_unlatch(95)" VALUE 0x001E0CDC /* @ECU_Address@FPrm_unlatch@0x021BD17C@ */ ECIPP_ALIGNMENT_FLOAT32_IEEE 10000000000 Compu_IDENTITY -10000000000 10000000000 PHYS_UNIT "ms" /end CHARACTERISTIC
/begin CHARACTERISTIC FPfu_MJ_intF_Vlo "FPrm_unlatch(96)" VALUE 0x001E0CE0 /* @ECU_Address@FPrm_unlatch@0x021BD180@ */ ECIPP_ALIGNMENT_FLOAT32_IEEE 10000000000 Compu_IDENTITY -10000000000 10000000000 PHYS_UNIT "ms" /end CHARACTERISTIC
/begin CHARACTERISTIC FPfu_MJ_Pe_HiExp "FPrm_unlatch(92)" VALUE 0x001E0CD0 /* @ECU_Address@FPrm_unlatch@0x021BD170@ */ ECIPP_ALIGNMENT_FLOAT32_IEEE 10000000000 Compu_IDENTITY -10000000000 10000000000 PHYS_UNIT "ms" /end CHARACTERISTIC
/begin CHARACTERISTIC FPfu_MJ_Pe_LoExp "FPrm_unlatch(93)" VALUE 0x001E0CD4 /* @ECU_Address@FPrm_unlatch@0x021BD174@ */ ECIPP_ALIGNMENT_FLOAT32_IEEE 10000000000 Compu_IDENTITY -10000000000 10000000000 PHYS_UNIT "ms" /end CHARACTERISTIC
/begin CHARACTERISTIC FPfu_MJ2_comm_tout "FPrm_unlatch(556)" VALUE 0x001E1410 /* @ECU_Address@FPrm_unlatch@0x021BD8B0@ */ ECIPP_ALIGNMENT_FLOAT32_IEEE 10000000000 Compu_IDENTITY -10000000000 10000000000 PHYS_UNIT "ms" /end CHARACTERISTIC
/begin CHARACTERISTIC FPfu_MJ2_intF_act "FPrm_unlatch(559)" VALUE 0x001E141C /* @ECU_Address@FPrm_unlatch@0x021BD8BC@ */ ECIPP_ALIGNMENT_FLOAT32_IEEE 10000000000 Compu_IDENTITY -10000000000 10000000000 PHYS_UNIT "ms" /end CHARACTERISTIC
/begin CHARACTERISTIC FPfu_MJ2_intF_circ "FPrm_unlatch(560)" VALUE 0x001E1420 /* @ECU_Address@FPrm_unlatch@0x021BD8C0@ */ ECIPP_ALIGNMENT_FLOAT32_IEEE 10000000000 Compu_IDENTITY -10000000000 10000000000 PHYS_UNIT "ms" /end CHARACTERISTIC
/begin CHARACTERISTIC FPfu_MJ2_intF_comm "FPrm_unlatch(561)" VALUE 0x001E1424 /* @ECU_Address@FPrm_unlatch@0x021BD8C4@ */ ECIPP_ALIGNMENT_FLOAT32_IEEE 10000000000 Compu_IDENTITY -10000000000 10000000000 PHYS_UNIT "ms" /end CHARACTERISTIC
/begin CHARACTERISTIC FPfu_MJ2_intF_Vhi "FPrm_unlatch(557)" VALUE 0x001E1414 /* @ECU_Address@FPrm_unlatch@0x021BD8B4@ */ ECIPP_ALIGNMENT_FLOAT32_IEEE 10000000000 Compu_IDENTITY -10000000000 10000000000 PHYS_UNIT "ms" /end CHARACTERISTIC
/begin CHARACTERISTIC FPfu_MJ2_intF_Vlo "FPrm_unlatch(558)" VALUE 0x001E1418 /* @ECU_Address@FPrm_unlatch@0x021BD8B8@ */ ECIPP_ALIGNMENT_FLOAT32_IEEE 10000000000 Compu_IDENTITY -10000000000 10000000000 PHYS_UNIT "ms" /end CHARACTERISTIC
/begin CHARACTERISTIC FPfu_MJ2_Pe_HiExp "FPrm_unlatch(554)" VALUE 0x001E1408 /* @ECU_Address@FPrm_unlatch@0x021BD8A8@ */ ECIPP_ALIGNMENT_FLOAT32_IEEE 10000000000 Compu_IDENTITY -10000000000 10000000000 PHYS_UNIT "ms" /end CHARACTERISTIC
/begin CHARACTERISTIC FPfu_MJ2_Pe_LoExp "FPrm_unlatch(555)" VALUE 0x001E140C /* @ECU_Address@FPrm_unlatch@0x021BD8AC@ */ ECIPP_ALIGNMENT_FLOAT32_IEEE 10000000000 Compu_IDENTITY -10000000000 10000000000 PHYS_UNIT "ms" /end CHARACTERISTIC
/begin CHARACTERISTIC FPfu_NOx_hi "FPrm_unlatch(623)" VALUE 0x001E151C /* @ECU_Address@FPrm_unlatch@0x021BD9BC@ */ ECIPP_ALIGNMENT_FLOAT32_IEEE 10000000000 Compu_IDENTITY -10000000000 10000000000 PHYS_UNIT "ms" /end CHARACTERISTIC
/begin CHARACTERISTIC FPfu_OilP_comm_lost "FPrm_unlatch(721)" VALUE 0x001E16A4 /* @ECU_Address@FPrm_unlatch@0x021BDB44@ */ ECIPP_ALIGNMENT_FLOAT32_IEEE 10000000000 Compu_IDENTITY -10000000000 10000000000 PHYS_UNIT "ms" /end CHARACTERISTIC
/begin CHARACTERISTIC FPfu_OilP_hiP "FPrm_unlatch(109)" VALUE 0x001E0D14 /* @ECU_Address@FPrm_unlatch@0x021BD1B4@ */ ECIPP_ALIGNMENT_FLOAT32_IEEE 10000000000 Compu_IDENTITY -10000000000 10000000000 PHYS_UNIT "ms" /end CHARACTERISTIC
/begin CHARACTERISTIC FPfu_OilP_loP "FPrm_unlatch(108)" VALUE 0x001E0D10 /* @ECU_Address@FPrm_unlatch@0x021BD1B0@ */ ECIPP_ALIGNMENT_FLOAT32_IEEE 10000000000 Compu_IDENTITY -10000000000 10000000000 PHYS_UNIT "ms" /end CHARACTERISTIC
/begin CHARACTERISTIC FPfu_OilP_maxV "FPrm_unlatch(110)" VALUE 0x001E0D18 /* @ECU_Address@FPrm_unlatch@0x021BD1B8@ */ ECIPP_ALIGNMENT_FLOAT32_IEEE 10000000000 Compu_IDENTITY -10000000000 10000000000 PHYS_UNIT "ms" /end CHARACTERISTIC
/begin CHARACTERISTIC FPfu_OilP_minV "FPrm_unlatch(111)" VALUE 0x001E0D1C /* @ECU_Address@FPrm_unlatch@0x021BD1BC@ */ ECIPP_ALIGNMENT_FLOAT32_IEEE 10000000000 Compu_IDENTITY -10000000000 10000000000 PHYS_UNIT "ms" /end CHARACTERISTIC
/begin CHARACTERISTIC FPfu_OILP_test "FPrm_unlatch(40)" VALUE 0x001E0C00 /* @ECU_Address@FPrm_unlatch@0x021BD0A0@ */ ECIPP_ALIGNMENT_FLOAT32_IEEE 10000000000 Compu_IDENTITY -10000000000 10000000000 PHYS_UNIT "ms" /end CHARACTERISTIC
/begin CHARACTERISTIC FPfu_OilP_VlvStk "FPrm_unlatch(718)" VALUE 0x001E1698 /* @ECU_Address@FPrm_unlatch@0x021BDB38@ */ ECIPP_ALIGNMENT_FLOAT32_IEEE 10000000000 Compu_IDENTITY -10000000000 10000000000 PHYS_UNIT "ms" /end CHARACTERISTIC
/begin CHARACTERISTIC FPfu_OilP2_loP "FPrm_unlatch(215)" VALUE 0x001E0EBC /* @ECU_Address@FPrm_unlatch@0x021BD35C@ */ ECIPP_ALIGNMENT_FLOAT32_IEEE 10000000000 Compu_IDENTITY -10000000000 10000000000 PHYS_UNIT "ms" /end CHARACTERISTIC
/begin CHARACTERISTIC FPfu_OILTL_loss "FPrm_unlatch(567)" VALUE 0x001E143C /* @ECU_Address@FPrm_unlatch@0x021BD8DC@ */ ECIPP_ALIGNMENT_FLOAT32_IEEE 10000000000 Compu_IDENTITY -10000000000 10000000000 PHYS_UNIT "ms" /end CHARACTERISTIC
/begin CHARACTERISTIC FPfu_OILTL_Lvl_lo "FPrm_unlatch(571)" VALUE 0x001E144C /* @ECU_Address@FPrm_unlatch@0x021BD8EC@ */ ECIPP_ALIGNMENT_FLOAT32_IEEE 10000000000 Compu_IDENTITY -10000000000 10000000000 PHYS_UNIT "ms" /end CHARACTERISTIC
/begin CHARACTERISTIC FPfu_OILTL_Lvl_OOR "FPrm_unlatch(569)" VALUE 0x001E1444 /* @ECU_Address@FPrm_unlatch@0x021BD8E4@ */ ECIPP_ALIGNMENT_FLOAT32_IEEE 10000000000 Compu_IDENTITY -10000000000 10000000000 PHYS_UNIT "ms" /end CHARACTERISTIC
/begin CHARACTERISTIC FPfu_OILTL_T_hi "FPrm_unlatch(572)" VALUE 0x001E1450 /* @ECU_Address@FPrm_unlatch@0x021BD8F0@ */ ECIPP_ALIGNMENT_FLOAT32_IEEE 10000000000 Compu_IDENTITY -10000000000 10000000000 PHYS_UNIT "ms" /end CHARACTERISTIC
/begin CHARACTERISTIC FPfu_OILTL_T_OOR "FPrm_unlatch(570)" VALUE 0x001E1448 /* @ECU_Address@FPrm_unlatch@0x021BD8E8@ */ ECIPP_ALIGNMENT_FLOAT32_IEEE 10000000000 Compu_IDENTITY -10000000000 10000000000 PHYS_UNIT "ms" /end CHARACTERISTIC
/begin CHARACTERISTIC FPfu_OILTL_V_OOR "FPrm_unlatch(568)" VALUE 0x001E1440 /* @ECU_Address@FPrm_unlatch@0x021BD8E0@ */ ECIPP_ALIGNMENT_FLOAT32_IEEE 10000000000 Compu_IDENTITY -10000000000 10000000000 PHYS_UNIT "ms" /end CHARACTERISTIC
/begin CHARACTERISTIC FPfu_PAUX_dP1_max "FPrm_unlatch(416)" VALUE 0x001E11E0 /* @ECU_Address@FPrm_unlatch@0x021BD680@ */ ECIPP_ALIGNMENT_FLOAT32_IEEE 10000000000 Compu_IDENTITY -10000000000 10000000000 PHYS_UNIT "ms" /end CHARACTERISTIC
/begin CHARACTERISTIC FPfu_PAUX_dP1_min "FPrm_unlatch(417)" VALUE 0x001E11E4 /* @ECU_Address@FPrm_unlatch@0x021BD684@ */ ECIPP_ALIGNMENT_FLOAT32_IEEE 10000000000 Compu_IDENTITY -10000000000 10000000000 PHYS_UNIT "ms" /end CHARACTERISTIC
/begin CHARACTERISTIC FPfu_PAUX_dP2_max "FPrm_unlatch(418)" VALUE 0x001E11E8 /* @ECU_Address@FPrm_unlatch@0x021BD688@ */ ECIPP_ALIGNMENT_FLOAT32_IEEE 10000000000 Compu_IDENTITY -10000000000 10000000000 PHYS_UNIT "ms" /end CHARACTERISTIC
/begin CHARACTERISTIC FPfu_PAUX_dP2_min "FPrm_unlatch(419)" VALUE 0x001E11EC /* @ECU_Address@FPrm_unlatch@0x021BD68C@ */ ECIPP_ALIGNMENT_FLOAT32_IEEE 10000000000 Compu_IDENTITY -10000000000 10000000000 PHYS_UNIT "ms" /end CHARACTERISTIC
/begin CHARACTERISTIC FPfu_PAUX1_max "FPrm_unlatch(408)" VALUE 0x001E11C0 /* @ECU_Address@FPrm_unlatch@0x021BD660@ */ ECIPP_ALIGNMENT_FLOAT32_IEEE 10000000000 Compu_IDENTITY -10000000000 10000000000 PHYS_UNIT "ms" /end CHARACTERISTIC
/begin CHARACTERISTIC FPfu_PAUX1_min "FPrm_unlatch(409)" VALUE 0x001E11C4 /* @ECU_Address@FPrm_unlatch@0x021BD664@ */ ECIPP_ALIGNMENT_FLOAT32_IEEE 10000000000 Compu_IDENTITY -10000000000 10000000000 PHYS_UNIT "ms" /end CHARACTERISTIC
/begin CHARACTERISTIC FPfu_PAUX2_max "FPrm_unlatch(410)" VALUE 0x001E11C8 /* @ECU_Address@FPrm_unlatch@0x021BD668@ */ ECIPP_ALIGNMENT_FLOAT32_IEEE 10000000000 Compu_IDENTITY -10000000000 10000000000 PHYS_UNIT "ms" /end CHARACTERISTIC
/begin CHARACTERISTIC FPfu_PAUX2_min "FPrm_unlatch(411)" VALUE 0x001E11CC /* @ECU_Address@FPrm_unlatch@0x021BD66C@ */ ECIPP_ALIGNMENT_FLOAT32_IEEE 10000000000 Compu_IDENTITY -10000000000 10000000000 PHYS_UNIT "ms" /end CHARACTERISTIC
/begin CHARACTERISTIC FPfu_PAUX3_max "FPrm_unlatch(412)" VALUE 0x001E11D0 /* @ECU_Address@FPrm_unlatch@0x021BD670@ */ ECIPP_ALIGNMENT_FLOAT32_IEEE 10000000000 Compu_IDENTITY -10000000000 10000000000 PHYS_UNIT "ms" /end CHARACTERISTIC
/begin CHARACTERISTIC FPfu_PAUX3_min "FPrm_unlatch(413)" VALUE 0x001E11D4 /* @ECU_Address@FPrm_unlatch@0x021BD674@ */ ECIPP_ALIGNMENT_FLOAT32_IEEE 10000000000 Compu_IDENTITY -10000000000 10000000000 PHYS_UNIT "ms" /end CHARACTERISTIC
/begin CHARACTERISTIC FPfu_PAUX4_max "FPrm_unlatch(414)" VALUE 0x001E11D8 /* @ECU_Address@FPrm_unlatch@0x021BD678@ */ ECIPP_ALIGNMENT_FLOAT32_IEEE 10000000000 Compu_IDENTITY -10000000000 10000000000 PHYS_UNIT "ms" /end CHARACTERISTIC
/begin CHARACTERISTIC FPfu_PAUX4_min "FPrm_unlatch(415)" VALUE 0x001E11DC /* @ECU_Address@FPrm_unlatch@0x021BD67C@ */ ECIPP_ALIGNMENT_FLOAT32_IEEE 10000000000 Compu_IDENTITY -10000000000 10000000000 PHYS_UNIT "ms" /end CHARACTERISTIC
/begin CHARACTERISTIC FPfu_post_cntrl_hi_lmt "FPrm_unlatch(717)" VALUE 0x001E1694 /* @ECU_Address@FPrm_unlatch@0x021BDB34@ */ ECIPP_ALIGNMENT_FLOAT32_IEEE 10000000000 Compu_IDENTITY -10000000000 10000000000 PHYS_UNIT "updates" /end CHARACTERISTIC
/begin CHARACTERISTIC FPfu_post_cntrl_lo_lmt "FPrm_unlatch(716)" VALUE 0x001E1690 /* @ECU_Address@FPrm_unlatch@0x021BDB30@ */ ECIPP_ALIGNMENT_FLOAT32_IEEE 10000000000 Compu_IDENTITY -10000000000 10000000000 PHYS_UNIT "updates" /end CHARACTERISTIC
/begin CHARACTERISTIC FPfu_PPEG_BP "FPrm_unlatch(500)" VALUE 0x001E1330 /* @ECU_Address@FPrm_unlatch@0x021BD7D0@ */ ECIPP_ALIGNMENT_FLOAT32_IEEE 10000000000 Compu_IDENTITY -10000000000 10000000000 PHYS_UNIT "ms" /end CHARACTERISTIC
/begin CHARACTERISTIC FPfu_PPEG_CVP1 "FPrm_unlatch(575)" VALUE 0x001E145C /* @ECU_Address@FPrm_unlatch@0x021BD8FC@ */ ECIPP_ALIGNMENT_FLOAT32_IEEE 10000000000 Compu_IDENTITY -10000000000 10000000000 PHYS_UNIT "ms" /end CHARACTERISTIC
/begin CHARACTERISTIC FPfu_PPEG_CVP2 "FPrm_unlatch(576)" VALUE 0x001E1460 /* @ECU_Address@FPrm_unlatch@0x021BD900@ */ ECIPP_ALIGNMENT_FLOAT32_IEEE 10000000000 Compu_IDENTITY -10000000000 10000000000 PHYS_UNIT "ms" /end CHARACTERISTIC
/begin CHARACTERISTIC FPfu_PPEG_EBP "FPrm_unlatch(501)" VALUE 0x001E1334 /* @ECU_Address@FPrm_unlatch@0x021BD7D4@ */ ECIPP_ALIGNMENT_FLOAT32_IEEE 10000000000 Compu_IDENTITY -10000000000 10000000000 PHYS_UNIT "ms" /end CHARACTERISTIC
/begin CHARACTERISTIC FPfu_PPEG_EGRdP "FPrm_unlatch(586)" VALUE 0x001E1488 /* @ECU_Address@FPrm_unlatch@0x021BD928@ */ ECIPP_ALIGNMENT_FLOAT32_IEEE 10000000000 Compu_IDENTITY -10000000000 10000000000 PHYS_UNIT "ms" /end CHARACTERISTIC
/begin CHARACTERISTIC FPfu_PPEG_EGRHP "FPrm_unlatch(503)" VALUE 0x001E133C /* @ECU_Address@FPrm_unlatch@0x021BD7DC@ */ ECIPP_ALIGNMENT_FLOAT32_IEEE 10000000000 Compu_IDENTITY -10000000000 10000000000 PHYS_UNIT "ms" /end CHARACTERISTIC
/begin CHARACTERISTIC FPfu_PPEG_EGRLP "FPrm_unlatch(502)" VALUE 0x001E1338 /* @ECU_Address@FPrm_unlatch@0x021BD7D8@ */ ECIPP_ALIGNMENT_FLOAT32_IEEE 10000000000 Compu_IDENTITY -10000000000 10000000000 PHYS_UNIT "ms" /end CHARACTERISTIC
/begin CHARACTERISTIC FPfu_PPEG_EGRwrP "FPrm_unlatch(505)" VALUE 0x001E1344 /* @ECU_Address@FPrm_unlatch@0x021BD7E4@ */ ECIPP_ALIGNMENT_FLOAT32_IEEE 10000000000 Compu_IDENTITY -10000000000 10000000000 PHYS_UNIT "ms" /end CHARACTERISTIC
/begin CHARACTERISTIC FPfu_PPEG_MAP "FPrm_unlatch(506)" VALUE 0x001E1348 /* @ECU_Address@FPrm_unlatch@0x021BD7E8@ */ ECIPP_ALIGNMENT_FLOAT32_IEEE 10000000000 Compu_IDENTITY -10000000000 10000000000 PHYS_UNIT "ms" /end CHARACTERISTIC
/begin CHARACTERISTIC FPfu_PPEG_TIP "FPrm_unlatch(504)" VALUE 0x001E1340 /* @ECU_Address@FPrm_unlatch@0x021BD7E0@ */ ECIPP_ALIGNMENT_FLOAT32_IEEE 10000000000 Compu_IDENTITY -10000000000 10000000000 PHYS_UNIT "ms" /end CHARACTERISTIC
/begin CHARACTERISTIC FPfu_Pri1_open "FPrm_unlatch(703)" VALUE 0x001E165C /* @ECU_Address@FPrm_unlatch@0x021BDAFC@ */ ECIPP_ALIGNMENT_FLOAT32_IEEE 10000000000 Compu_IDENTITY -10000000000 10000000000 PHYS_UNIT "ms" /end CHARACTERISTIC
/begin CHARACTERISTIC FPfu_Pri1_short "FPrm_unlatch(704)" VALUE 0x001E1660 /* @ECU_Address@FPrm_unlatch@0x021BDB00@ */ ECIPP_ALIGNMENT_FLOAT32_IEEE 10000000000 Compu_IDENTITY -10000000000 10000000000 PHYS_UNIT "ms" /end CHARACTERISTIC
/begin CHARACTERISTIC FPfu_PWM1_off_loVf "FPrm_unlatch(147)" VALUE 0x001E0DAC /* @ECU_Address@FPrm_unlatch@0x021BD24C@ */ ECIPP_ALIGNMENT_FLOAT32_IEEE 10000000000 Compu_IDENTITY -10000000000 10000000000 PHYS_UNIT "ms" /end CHARACTERISTIC
/begin CHARACTERISTIC FPfu_PWM1_on_hiVf "FPrm_unlatch(148)" VALUE 0x001E0DB0 /* @ECU_Address@FPrm_unlatch@0x021BD250@ */ ECIPP_ALIGNMENT_FLOAT32_IEEE 10000000000 Compu_IDENTITY -10000000000 10000000000 PHYS_UNIT "ms" /end CHARACTERISTIC
/begin CHARACTERISTIC FPfu_PWM10_off_loVf "FPrm_unlatch(330)" VALUE 0x001E1088 /* @ECU_Address@FPrm_unlatch@0x021BD528@ */ ECIPP_ALIGNMENT_FLOAT32_IEEE 10000000000 Compu_IDENTITY -10000000000 10000000000 PHYS_UNIT "ms" /end CHARACTERISTIC
/begin CHARACTERISTIC FPfu_PWM10_on_hiVf "FPrm_unlatch(331)" VALUE 0x001E108C /* @ECU_Address@FPrm_unlatch@0x021BD52C@ */ ECIPP_ALIGNMENT_FLOAT32_IEEE 10000000000 Compu_IDENTITY -10000000000 10000000000 PHYS_UNIT "ms" /end CHARACTERISTIC
/begin CHARACTERISTIC FPfu_PWM11_off_loVf "FPrm_unlatch(332)" VALUE 0x001E1090 /* @ECU_Address@FPrm_unlatch@0x021BD530@ */ ECIPP_ALIGNMENT_FLOAT32_IEEE 10000000000 Compu_IDENTITY -10000000000 10000000000 PHYS_UNIT "ms" /end CHARACTERISTIC
/begin CHARACTERISTIC FPfu_PWM11_on_hiVf "FPrm_unlatch(333)" VALUE 0x001E1094 /* @ECU_Address@FPrm_unlatch@0x021BD534@ */ ECIPP_ALIGNMENT_FLOAT32_IEEE 10000000000 Compu_IDENTITY -10000000000 10000000000 PHYS_UNIT "ms" /end CHARACTERISTIC
/begin CHARACTERISTIC FPfu_PWM12_off_loVf "FPrm_unlatch(334)" VALUE 0x001E1098 /* @ECU_Address@FPrm_unlatch@0x021BD538@ */ ECIPP_ALIGNMENT_FLOAT32_IEEE 10000000000 Compu_IDENTITY -10000000000 10000000000 PHYS_UNIT "ms" /end CHARACTERISTIC
/begin CHARACTERISTIC FPfu_PWM12_on_hiVf "FPrm_unlatch(335)" VALUE 0x001E109C /* @ECU_Address@FPrm_unlatch@0x021BD53C@ */ ECIPP_ALIGNMENT_FLOAT32_IEEE 10000000000 Compu_IDENTITY -10000000000 10000000000 PHYS_UNIT "ms" /end CHARACTERISTIC
/begin CHARACTERISTIC FPfu_PWM13_off_loVf "FPrm_unlatch(336)" VALUE 0x001E10A0 /* @ECU_Address@FPrm_unlatch@0x021BD540@ */ ECIPP_ALIGNMENT_FLOAT32_IEEE 10000000000 Compu_IDENTITY -10000000000 10000000000 PHYS_UNIT "ms" /end CHARACTERISTIC
/begin CHARACTERISTIC FPfu_PWM13_on_hiVf "FPrm_unlatch(337)" VALUE 0x001E10A4 /* @ECU_Address@FPrm_unlatch@0x021BD544@ */ ECIPP_ALIGNMENT_FLOAT32_IEEE 10000000000 Compu_IDENTITY -10000000000 10000000000 PHYS_UNIT "ms" /end CHARACTERISTIC
/begin CHARACTERISTIC FPfu_PWM14_off_loVf "FPrm_unlatch(338)" VALUE 0x001E10A8 /* @ECU_Address@FPrm_unlatch@0x021BD548@ */ ECIPP_ALIGNMENT_FLOAT32_IEEE 10000000000 Compu_IDENTITY -10000000000 10000000000 PHYS_UNIT "ms" /end CHARACTERISTIC
/begin CHARACTERISTIC FPfu_PWM14_on_hiVf "FPrm_unlatch(339)" VALUE 0x001E10AC /* @ECU_Address@FPrm_unlatch@0x021BD54C@ */ ECIPP_ALIGNMENT_FLOAT32_IEEE 10000000000 Compu_IDENTITY -10000000000 10000000000 PHYS_UNIT "ms" /end CHARACTERISTIC
/begin CHARACTERISTIC FPfu_PWM15_off_loVf "FPrm_unlatch(340)" VALUE 0x001E10B0 /* @ECU_Address@FPrm_unlatch@0x021BD550@ */ ECIPP_ALIGNMENT_FLOAT32_IEEE 10000000000 Compu_IDENTITY -10000000000 10000000000 PHYS_UNIT "ms" /end CHARACTERISTIC
/begin CHARACTERISTIC FPfu_PWM15_on_hiVf "FPrm_unlatch(341)" VALUE 0x001E10B4 /* @ECU_Address@FPrm_unlatch@0x021BD554@ */ ECIPP_ALIGNMENT_FLOAT32_IEEE 10000000000 Compu_IDENTITY -10000000000 10000000000 PHYS_UNIT "ms" /end CHARACTERISTIC
/begin CHARACTERISTIC FPfu_PWM16_off_loVf "FPrm_unlatch(342)" VALUE 0x001E10B8 /* @ECU_Address@FPrm_unlatch@0x021BD558@ */ ECIPP_ALIGNMENT_FLOAT32_IEEE 10000000000 Compu_IDENTITY -10000000000 10000000000 PHYS_UNIT "ms" /end CHARACTERISTIC
/begin CHARACTERISTIC FPfu_PWM16_on_hiVf "FPrm_unlatch(343)" VALUE 0x001E10BC /* @ECU_Address@FPrm_unlatch@0x021BD55C@ */ ECIPP_ALIGNMENT_FLOAT32_IEEE 10000000000 Compu_IDENTITY -10000000000 10000000000 PHYS_UNIT "ms" /end CHARACTERISTIC
/begin GROUP MJ_intF_circ_EC_Fault "EPR / CFV external Vrelay intermittent or internal circuitry fault detection"
 /begin REF_CHARACTERISTIC FCdc4_MJ_intF_circ FCdtc_MJ_intF_circ FCfmi_MJ_intF_circ FCftb_MJ_intF_circ FCspn_MJ_intF_circ FPfl_MJ_intF_circ FPfu_MJ_intF_circ FPnd_MJ_intF_circ FPsvr_MJ_intF_circ FPsw_ext1_MJ_intF_circ FPsw_MJ_intF_circ /end REF_CHARACTERISTIC
/end GROUP
/begin GROUP MJ_intF_comm_EC_Fault "EPR / CFV comm fault detection"
 /begin REF_CHARACTERISTIC FCdc4_MJ_intF_comm FCdtc_MJ_intF_comm FCfmi_MJ_intF_comm FCftb_MJ_intF_comm FCspn_MJ_intF_comm FPfl_MJ_intF_comm FPfu_MJ_intF_comm FPnd_MJ_intF_comm FPsvr_MJ_intF_comm FPsw_ext1_MJ_intF_comm FPsw_MJ_intF_comm /end REF_CHARACTERISTIC
/end GROUP
/begin GROUP MJ_intF_Vhi_EC_Fault "EPR / CFV voltage supply high"
 /begin REF_CHARACTERISTIC FCdc4_MJ_intF_Vhi FCdtc_MJ_intF_Vhi FCfmi_MJ_intF_Vhi FCftb_MJ_intF_Vhi FCspn_MJ_intF_Vhi FPfl_MJ_intF_Vhi FPfu_MJ_intF_Vhi FPnd_MJ_intF_Vhi FPsvr_MJ_intF_Vhi FPsw_ext1_MJ_intF_Vhi FPsw_MJ_intF_Vhi /end REF_CHARACTERISTIC
/end GROUP
/begin GROUP MJ_intF_Vlo_EC_Fault "EPR / CFV voltage supply low"
 /begin REF_CHARACTERISTIC FCdc4_MJ_intF_Vlo FCdtc_MJ_intF_Vlo FCfmi_MJ_intF_Vlo FCftb_MJ_intF_Vlo FCspn_MJ_intF_Vlo FPfl_MJ_intF_Vlo FPfu_MJ_intF_Vlo FPnd_MJ_intF_Vlo FPsvr_MJ_intF_Vlo FPsw_ext1_MJ_intF_Vlo FPsw_MJ_intF_Vlo /end REF_CHARACTERISTIC
/end GROUP
/begin GROUP MJ_Pe_HiExp_EC_Fault "EPR / CFV regulation pressure higher than expected"
 /begin REF_CHARACTERISTIC FCdc4_MJ_Pe_HiExp FCdtc_MJ_Pe_HiExp FCfmi_MJ_Pe_HiExp FCftb_MJ_Pe_HiExp FCspn_MJ_Pe_HiExp FPfl_MJ_Pe_HiExp FPfu_MJ_Pe_HiExp FPnd_MJ_Pe_HiExp FPsvr_MJ_Pe_HiExp FPsw_ext1_MJ_Pe_HiExp FPsw_MJ_Pe_HiExp /end REF_CHARACTERISTIC
/end GROUP
/begin GROUP MJ_Pe_LoExp_EC_Fault "EPR / CFV regulation pressure lower than expected"
 /begin REF_CHARACTERISTIC FCdc4_MJ_Pe_LoExp FCdtc_MJ_Pe_LoExp FCfmi_MJ_Pe_LoExp FCftb_MJ_Pe_LoExp FCspn_MJ_Pe_LoExp FPfl_MJ_Pe_LoExp FPfu_MJ_Pe_LoExp FPnd_MJ_Pe_LoExp FPsvr_MJ_Pe_LoExp FPsw_ext1_MJ_Pe_LoExp FPsw_MJ_Pe_LoExp /end REF_CHARACTERISTIC
/end GROUP
/begin GROUP MJ2_comm_tout_EC_Fault "EPR secondary comm lost"
 /begin REF_CHARACTERISTIC FCdc4_MJ2_comm_tout FCdtc_MJ2_comm_tout FCfmi_MJ2_comm_tout FCftb_MJ2_comm_tout FCspn_MJ2_comm_tout FPfl_MJ2_comm_tout FPfu_MJ2_comm_tout FPnd_MJ2_comm_tout FPsvr_MJ2_comm_tout FPsw_ext1_MJ2_comm_tout FPsw_MJ2_comm_tout /end REF_CHARACTERISTIC
/end GROUP
/begin GROUP MJ2_intF_act_EC_Fault "EPR secondary internal actuator fault detection"
 /begin REF_CHARACTERISTIC FCdc4_MJ2_intF_act FCdtc_MJ2_intF_act FCfmi_MJ2_intF_act FCftb_MJ2_intF_act FCspn_MJ2_intF_act FPfl_MJ2_intF_act FPfu_MJ2_intF_act FPnd_MJ2_intF_act FPsvr_MJ2_intF_act FPsw_ext1_MJ2_intF_act FPsw_MJ2_intF_act /end REF_CHARACTERISTIC
/end GROUP
/begin GROUP MJ2_intF_circ_EC_Fault "EPR secondary internal circuitry fault detection"
 /begin REF_CHARACTERISTIC FCdc4_MJ2_intF_circ FCdtc_MJ2_intF_circ FCfmi_MJ2_intF_circ FCftb_MJ2_intF_circ FCspn_MJ2_intF_circ FPfl_MJ2_intF_circ FPfu_MJ2_intF_circ FPnd_MJ2_intF_circ FPsvr_MJ2_intF_circ FPsw_ext1_MJ2_intF_circ FPsw_MJ2_intF_circ /end REF_CHARACTERISTIC
/end GROUP
/begin GROUP MJ2_intF_comm_EC_Fault "EPR secondary internal comm fault detection"
 /begin REF_CHARACTERISTIC FCdc4_MJ2_intF_comm FCdtc_MJ2_intF_comm FCfmi_MJ2_intF_comm FCftb_MJ2_intF_comm FCspn_MJ2_intF_comm FPfl_MJ2_intF_comm FPfu_MJ2_intF_comm FPnd_MJ2_intF_comm FPsvr_MJ2_intF_comm FPsw_ext1_MJ2_intF_comm FPsw_MJ2_intF_comm /end REF_CHARACTERISTIC
/end GROUP
/begin GROUP MJ2_intF_Vhi_EC_Fault "EPR secondary voltage supply high"
 /begin REF_CHARACTERISTIC FCdc4_MJ2_intF_Vhi FCdtc_MJ2_intF_Vhi FCfmi_MJ2_intF_Vhi FCftb_MJ2_intF_Vhi FCspn_MJ2_intF_Vhi FPfl_MJ2_intF_Vhi FPfu_MJ2_intF_Vhi FPnd_MJ2_intF_Vhi FPsvr_MJ2_intF_Vhi FPsw_ext1_MJ2_intF_Vhi FPsw_MJ2_intF_Vhi /end REF_CHARACTERISTIC
/end GROUP
/begin GROUP MJ2_intF_Vlo_EC_Fault "EPR secondary voltage supply low"
 /begin REF_CHARACTERISTIC FCdc4_MJ2_intF_Vlo FCdtc_MJ2_intF_Vlo FCfmi_MJ2_intF_Vlo FCftb_MJ2_intF_Vlo FCspn_MJ2_intF_Vlo FPfl_MJ2_intF_Vlo FPfu_MJ2_intF_Vlo FPnd_MJ2_intF_Vlo FPsvr_MJ2_intF_Vlo FPsw_ext1_MJ2_intF_Vlo FPsw_MJ2_intF_Vlo /end REF_CHARACTERISTIC
/end GROUP
/begin GROUP MJ2_Pe_HiExp_EC_Fault "EPR secondary regulation pressure higher than expected"
 /begin REF_CHARACTERISTIC FCdc4_MJ2_Pe_HiExp FCdtc_MJ2_Pe_HiExp FCfmi_MJ2_Pe_HiExp FCftb_MJ2_Pe_HiExp FCspn_MJ2_Pe_HiExp FPfl_MJ2_Pe_HiExp FPfu_MJ2_Pe_HiExp FPnd_MJ2_Pe_HiExp FPsvr_MJ2_Pe_HiExp FPsw_ext1_MJ2_Pe_HiExp FPsw_MJ2_Pe_HiExp /end REF_CHARACTERISTIC
/end GROUP
/begin GROUP MJ2_Pe_LoExp_EC_Fault "EPR secondary regulation pressure lower than expected"
 /begin REF_CHARACTERISTIC FCdc4_MJ2_Pe_LoExp FCdtc_MJ2_Pe_LoExp FCfmi_MJ2_Pe_LoExp FCftb_MJ2_Pe_LoExp FCspn_MJ2_Pe_LoExp FPfl_MJ2_Pe_LoExp FPfu_MJ2_Pe_LoExp FPnd_MJ2_Pe_LoExp FPsvr_MJ2_Pe_LoExp FPsw_ext1_MJ2_Pe_LoExp FPsw_MJ2_Pe_LoExp /end REF_CHARACTERISTIC
/end GROUP
/begin GROUP NOx_hi_EC_Fault "NOx Exceedance - NOx control monitoring system"
 /begin REF_CHARACTERISTIC FCdc4_NOx_hi FCdtc_NOx_hi FCfmi_NOx_hi FCftb_NOx_hi FCspn_NOx_hi FPfl_NOx_hi FPfu_NOx_hi FPnd_NOx_hi FPsvr_NOx_hi FPsw_ext1_NOx_hi FPsw_NOx_hi /end REF_CHARACTERISTIC
/end GROUP
/begin GROUP OilP_comm_lost_EC_Fault "Oil pressure communication lost (SENT)"
 /begin REF_CHARACTERISTIC FCdc4_OilP_comm_lost FCdtc_OilP_comm_lost FCfmi_OilP_comm_lost FCftb_OilP_comm_lost FCspn_OilP_comm_lost FPfl_OilP_comm_lost FPfu_OilP_comm_lost FPnd_OilP_comm_lost FPsvr_OilP_comm_lost FPsw_ext1_OilP_comm_lost FPsw_OilP_comm_lost /end REF_CHARACTERISTIC
/end GROUP
/begin GROUP OilP_hiP_EC_Fault "Oil pressure high (sender or SENT)"
 /begin REF_CHARACTERISTIC FCdc4_OilP_hiP FCdtc_OilP_hiP FCfmi_OilP_hiP FCftb_OilP_hiP FCspn_OilP_hiP FPfl_OilP_hiP FPfu_OilP_hiP FPnd_OilP_hiP FPsvr_OilP_hiP FPsw_ext1_OilP_hiP FPsw_OilP_hiP /end REF_CHARACTERISTIC
/end GROUP
/begin GROUP OilP_loP_EC_Fault "Oil pressure low stage 2 (sender or SENT)"
 /begin REF_CHARACTERISTIC FCdc4_OilP_loP FCdtc_OilP_loP FCfmi_OilP_loP FCftb_OilP_loP FCspn_OilP_loP FPfl_OilP_loP FPfu_OilP_loP FPnd_OilP_loP FPsvr_OilP_loP FPsw_ext1_OilP_loP FPsw_OilP_loP /end REF_CHARACTERISTIC
/end GROUP
/begin GROUP OilP_maxV_EC_Fault "Oil pressure high voltage (switch or sender)"
 /begin REF_CHARACTERISTIC FCdc4_OilP_maxV FCdtc_OilP_maxV FCfmi_OilP_maxV FCftb_OilP_maxV FCspn_OilP_maxV FPfl_OilP_maxV FPfu_OilP_maxV FPnd_OilP_maxV FPsvr_OilP_maxV FPsw_ext1_OilP_maxV FPsw_OilP_maxV /end REF_CHARACTERISTIC
/end GROUP
/begin GROUP OilP_minV_EC_Fault "Oil pressure low voltage (switch or sender)"
 /begin REF_CHARACTERISTIC FCdc4_OilP_minV FCdtc_OilP_minV FCfmi_OilP_minV FCftb_OilP_minV FCspn_OilP_minV FPfl_OilP_minV FPfu_OilP_minV FPnd_OilP_minV FPsvr_OilP_minV FPsw_ext1_OilP_minV FPsw_OilP_minV /end REF_CHARACTERISTIC
/end GROUP
/begin GROUP OILP_test_EC_Fault "Oil pressure low (switch)"
 /begin REF_CHARACTERISTIC FCdc4_OILP_test FCdtc_OILP_test FCfmi_OILP_test FCftb_OILP_test FCspn_OILP_test FPfl_OILP_test FPfu_OILP_test FPnd_OILP_test FPsvr_OILP_test FPsw_ext1_OILP_test FPsw_OILP_test /end REF_CHARACTERISTIC
/end GROUP
/begin GROUP OilP_VlvStk_EC_Fault "Oil pressure valve error"
 /begin REF_CHARACTERISTIC FCdc4_OilP_VlvStk FCdtc_OilP_VlvStk FCfmi_OilP_VlvStk FCftb_OilP_VlvStk FCspn_OilP_VlvStk FPfl_OilP_VlvStk FPfu_OilP_VlvStk FPnd_OilP_VlvStk FPsvr_OilP_VlvStk FPsw_ext1_OilP_VlvStk FPsw_OilP_VlvStk /end REF_CHARACTERISTIC
/end GROUP
/begin GROUP OilP2_loP_EC_Fault "Oil pressure low stage 1 (sender or SENT)"
 /begin REF_CHARACTERISTIC FCdc4_OilP2_loP FCdtc_OilP2_loP FCfmi_OilP2_loP FCftb_OilP2_loP FCspn_OilP2_loP FPfl_OilP2_loP FPfu_OilP2_loP FPnd_OilP2_loP FPsvr_OilP2_loP FPsw_ext1_OilP2_loP FPsw_OilP2_loP /end REF_CHARACTERISTIC
/end GROUP
/begin GROUP OILTL_loss_EC_Fault "Oil level and temperature sensor loss"
 /begin REF_CHARACTERISTIC FCdc4_OILTL_loss FCdtc_OILTL_loss FCfmi_OILTL_loss FCftb_OILTL_loss FCspn_OILTL_loss FPfl_OILTL_loss FPfu_OILTL_loss FPnd_OILTL_loss FPsvr_OILTL_loss FPsw_ext1_OILTL_loss FPsw_OILTL_loss /end REF_CHARACTERISTIC
/end GROUP
/begin GROUP OILTL_Lvl_lo_EC_Fault "Oil level too low"
 /begin REF_CHARACTERISTIC FCdc4_OILTL_Lvl_lo FCdtc_OILTL_Lvl_lo FCfmi_OILTL_Lvl_lo FCftb_OILTL_Lvl_lo FCspn_OILTL_Lvl_lo FPfl_OILTL_Lvl_lo FPfu_OILTL_Lvl_lo FPnd_OILTL_Lvl_lo FPsvr_OILTL_Lvl_lo FPsw_ext1_OILTL_Lvl_lo FPsw_OILTL_Lvl_lo /end REF_CHARACTERISTIC
/end GROUP
/begin GROUP OILTL_Lvl_OOR_EC_Fault "Oil level out of range"
 /begin REF_CHARACTERISTIC FCdc4_OILTL_Lvl_OOR FCdtc_OILTL_Lvl_OOR FCfmi_OILTL_Lvl_OOR FCftb_OILTL_Lvl_OOR FCspn_OILTL_Lvl_OOR FPfl_OILTL_Lvl_OOR FPfu_OILTL_Lvl_OOR FPnd_OILTL_Lvl_OOR FPsvr_OILTL_Lvl_OOR FPsw_ext1_OILTL_Lvl_OOR FPsw_OILTL_Lvl_OOR /end REF_CHARACTERISTIC
/end GROUP
/begin GROUP OILTL_T_hi_EC_Fault "Oil temperature too high"
 /begin REF_CHARACTERISTIC FCdc4_OILTL_T_hi FCdtc_OILTL_T_hi FCfmi_OILTL_T_hi FCftb_OILTL_T_hi FCspn_OILTL_T_hi FPfl_OILTL_T_hi FPfu_OILTL_T_hi FPnd_OILTL_T_hi FPsvr_OILTL_T_hi FPsw_ext1_OILTL_T_hi FPsw_OILTL_T_hi /end REF_CHARACTERISTIC
/end GROUP
/begin GROUP OILTL_T_OOR_EC_Fault "Oil temperature out of range"
 /begin REF_CHARACTERISTIC FCdc4_OILTL_T_OOR FCdtc_OILTL_T_OOR FCfmi_OILTL_T_OOR FCftb_OILTL_T_OOR FCspn_OILTL_T_OOR FPfl_OILTL_T_OOR FPfu_OILTL_T_OOR FPnd_OILTL_T_OOR FPsvr_OILTL_T_OOR FPsw_ext1_OILTL_T_OOR FPsw_OILTL_T_OOR /end REF_CHARACTERISTIC
/end GROUP
/begin GROUP OILTL_V_OOR_EC_Fault "Oil level and temperature sensor voltage out of range"
 /begin REF_CHARACTERISTIC FCdc4_OILTL_V_OOR FCdtc_OILTL_V_OOR FCfmi_OILTL_V_OOR FCftb_OILTL_V_OOR FCspn_OILTL_V_OOR FPfl_OILTL_V_OOR FPfu_OILTL_V_OOR FPnd_OILTL_V_OOR FPsvr_OILTL_V_OOR FPsw_ext1_OILTL_V_OOR FPsw_OILTL_V_OOR /end REF_CHARACTERISTIC
/end GROUP
/begin GROUP PAUX_dP1_max_EC_Fault "AUX Pressure delta P 1 high"
 /begin REF_CHARACTERISTIC FCdc4_PAUX_dP1_max FCdtc_PAUX_dP1_max FCfmi_PAUX_dP1_max FCftb_PAUX_dP1_max FCspn_PAUX_dP1_max FPfl_PAUX_dP1_max FPfu_PAUX_dP1_max FPnd_PAUX_dP1_max FPsvr_PAUX_dP1_max FPsw_ext1_PAUX_dP1_max FPsw_PAUX_dP1_max /end REF_CHARACTERISTIC
/end GROUP
/begin GROUP PAUX_dP1_min_EC_Fault "AUX Pressure delta P 1 low"
 /begin REF_CHARACTERISTIC FCdc4_PAUX_dP1_min FCdtc_PAUX_dP1_min FCfmi_PAUX_dP1_min FCftb_PAUX_dP1_min FCspn_PAUX_dP1_min FPfl_PAUX_dP1_min FPfu_PAUX_dP1_min FPnd_PAUX_dP1_min FPsvr_PAUX_dP1_min FPsw_ext1_PAUX_dP1_min FPsw_PAUX_dP1_min /end REF_CHARACTERISTIC
/end GROUP
/begin GROUP PAUX_dP2_max_EC_Fault "AUX Pressure delta P 2 high"
 /begin REF_CHARACTERISTIC FCdc4_PAUX_dP2_max FCdtc_PAUX_dP2_max FCfmi_PAUX_dP2_max FCftb_PAUX_dP2_max FCspn_PAUX_dP2_max FPfl_PAUX_dP2_max FPfu_PAUX_dP2_max FPnd_PAUX_dP2_max FPsvr_PAUX_dP2_max FPsw_ext1_PAUX_dP2_max FPsw_PAUX_dP2_max /end REF_CHARACTERISTIC
/end GROUP
/begin GROUP PAUX_dP2_min_EC_Fault "AUX Pressure delta P 2 low"
 /begin REF_CHARACTERISTIC FCdc4_PAUX_dP2_min FCdtc_PAUX_dP2_min FCfmi_PAUX_dP2_min FCftb_PAUX_dP2_min FCspn_PAUX_dP2_min FPfl_PAUX_dP2_min FPfu_PAUX_dP2_min FPnd_PAUX_dP2_min FPsvr_PAUX_dP2_min FPsw_ext1_PAUX_dP2_min FPsw_PAUX_dP2_min /end REF_CHARACTERISTIC
/end GROUP
/begin GROUP PAUX1_max_EC_Fault "Auxiliary pressure 1 high"
 /begin REF_CHARACTERISTIC FCdc4_PAUX1_max FCdtc_PAUX1_max FCfmi_PAUX1_max FCftb_PAUX1_max FCspn_PAUX1_max FPfl_PAUX1_max FPfu_PAUX1_max FPnd_PAUX1_max FPsvr_PAUX1_max FPsw_ext1_PAUX1_max FPsw_PAUX1_max /end REF_CHARACTERISTIC
/end GROUP
/begin GROUP PAUX1_min_EC_Fault "Auxiliary pressure 1 low"
 /begin REF_CHARACTERISTIC FCdc4_PAUX1_min FCdtc_PAUX1_min FCfmi_PAUX1_min FCftb_PAUX1_min FCspn_PAUX1_min FPfl_PAUX1_min FPfu_PAUX1_min FPnd_PAUX1_min FPsvr_PAUX1_min FPsw_ext1_PAUX1_min FPsw_PAUX1_min /end REF_CHARACTERISTIC
/end GROUP
/begin GROUP PAUX2_max_EC_Fault "Auxiliary pressure 2 high"
 /begin REF_CHARACTERISTIC FCdc4_PAUX2_max FCdtc_PAUX2_max FCfmi_PAUX2_max FCftb_PAUX2_max FCspn_PAUX2_max FPfl_PAUX2_max FPfu_PAUX2_max FPnd_PAUX2_max FPsvr_PAUX2_max FPsw_ext1_PAUX2_max FPsw_PAUX2_max /end REF_CHARACTERISTIC
/end GROUP
/begin GROUP PAUX2_min_EC_Fault "Auxiliary pressure 2 low"
 /begin REF_CHARACTERISTIC FCdc4_PAUX2_min FCdtc_PAUX2_min FCfmi_PAUX2_min FCftb_PAUX2_min FCspn_PAUX2_min FPfl_PAUX2_min FPfu_PAUX2_min FPnd_PAUX2_min FPsvr_PAUX2_min FPsw_ext1_PAUX2_min FPsw_PAUX2_min /end REF_CHARACTERISTIC
/end GROUP
/begin GROUP PAUX3_max_EC_Fault "Auxiliary pressure 3 high"
 /begin REF_CHARACTERISTIC FCdc4_PAUX3_max FCdtc_PAUX3_max FCfmi_PAUX3_max FCftb_PAUX3_max FCspn_PAUX3_max FPfl_PAUX3_max FPfu_PAUX3_max FPnd_PAUX3_max FPsvr_PAUX3_max FPsw_ext1_PAUX3_max FPsw_PAUX3_max /end REF_CHARACTERISTIC
/end GROUP
/begin GROUP PAUX3_min_EC_Fault "Auxiliary pressure 3 low"
 /begin REF_CHARACTERISTIC FCdc4_PAUX3_min FCdtc_PAUX3_min FCfmi_PAUX3_min FCftb_PAUX3_min FCspn_PAUX3_min FPfl_PAUX3_min FPfu_PAUX3_min FPnd_PAUX3_min FPsvr_PAUX3_min FPsw_ext1_PAUX3_min FPsw_PAUX3_min /end REF_CHARACTERISTIC
/end GROUP
/begin GROUP PAUX4_max_EC_Fault "Auxiliary pressure 4 high"
 /begin REF_CHARACTERISTIC FCdc4_PAUX4_max FCdtc_PAUX4_max FCfmi_PAUX4_max FCftb_PAUX4_max FCspn_PAUX4_max FPfl_PAUX4_max FPfu_PAUX4_max FPnd_PAUX4_max FPsvr_PAUX4_max FPsw_ext1_PAUX4_max FPsw_PAUX4_max /end REF_CHARACTERISTIC
/end GROUP
/begin GROUP PAUX4_min_EC_Fault "Auxiliary pressure 4 low"
 /begin REF_CHARACTERISTIC FCdc4_PAUX4_min FCdtc_PAUX4_min FCfmi_PAUX4_min FCftb_PAUX4_min FCspn_PAUX4_min FPfl_PAUX4_min FPfu_PAUX4_min FPnd_PAUX4_min FPsvr_PAUX4_min FPsw_ext1_PAUX4_min FPsw_PAUX4_min /end REF_CHARACTERISTIC
/end GROUP
/begin GROUP post_cntrl_hi_lmt_EC_Fault "Post-catalyst delta-phi at max limit"
 /begin REF_CHARACTERISTIC FCdc4_post_cntrl_hi_lmt FCdtc_post_cntrl_hi_lmt FCfmi_post_cntrl_hi_lmt FCftb_post_cntrl_hi_lmt FCspn_post_cntrl_hi_lmt FPfl_post_cntrl_hi_lmt FPfu_post_cntrl_hi_lmt FPnd_post_cntrl_hi_lmt FPsvr_post_cntrl_hi_lmt FPsw_ext1_post_cntrl_hi_lmt FPsw_post_cntrl_hi_lmt /end REF_CHARACTERISTIC
/end GROUP
/begin GROUP post_cntrl_lo_lmt_EC_Fault "Post-catalyst delta-phi at min limit"
 /begin REF_CHARACTERISTIC FCdc4_post_cntrl_lo_lmt FCdtc_post_cntrl_lo_lmt FCfmi_post_cntrl_lo_lmt FCftb_post_cntrl_lo_lmt FCspn_post_cntrl_lo_lmt FPfl_post_cntrl_lo_lmt FPfu_post_cntrl_lo_lmt FPnd_post_cntrl_lo_lmt FPsvr_post_cntrl_lo_lmt FPsw_ext1_post_cntrl_lo_lmt FPsw_post_cntrl_lo_lmt /end REF_CHARACTERISTIC
/end GROUP
/begin GROUP PPEG_BP_EC_Fault "BP pegging offset out-of-range"
 /begin REF_CHARACTERISTIC FCdc4_PPEG_BP FCdtc_PPEG_BP FCfmi_PPEG_BP FCftb_PPEG_BP FCspn_PPEG_BP FPfl_PPEG_BP FPfu_PPEG_BP FPnd_PPEG_BP FPsvr_PPEG_BP FPsw_ext1_PPEG_BP FPsw_PPEG_BP /end REF_CHARACTERISTIC
/end GROUP
/begin GROUP PPEG_CVP1_EC_Fault "CVP1 pegging offset out-of-range"
 /begin REF_CHARACTERISTIC FCdc4_PPEG_CVP1 FCdtc_PPEG_CVP1 FCfmi_PPEG_CVP1 FCftb_PPEG_CVP1 FCspn_PPEG_CVP1 FPfl_PPEG_CVP1 FPfu_PPEG_CVP1 FPnd_PPEG_CVP1 FPsvr_PPEG_CVP1 FPsw_ext1_PPEG_CVP1 FPsw_PPEG_CVP1 /end REF_CHARACTERISTIC
/end GROUP
/begin GROUP PPEG_CVP2_EC_Fault "CVP2 pegging offset out-of-range"
 /begin REF_CHARACTERISTIC FCdc4_PPEG_CVP2 FCdtc_PPEG_CVP2 FCfmi_PPEG_CVP2 FCftb_PPEG_CVP2 FCspn_PPEG_CVP2 FPfl_PPEG_CVP2 FPfu_PPEG_CVP2 FPnd_PPEG_CVP2 FPsvr_PPEG_CVP2 FPsw_ext1_PPEG_CVP2 FPsw_PPEG_CVP2 /end REF_CHARACTERISTIC
/end GROUP
/begin GROUP PPEG_EBP_EC_Fault "EBP pegging offset out-of-range"
 /begin REF_CHARACTERISTIC FCdc4_PPEG_EBP FCdtc_PPEG_EBP FCfmi_PPEG_EBP FCftb_PPEG_EBP FCspn_PPEG_EBP FPfl_PPEG_EBP FPfu_PPEG_EBP FPnd_PPEG_EBP FPsvr_PPEG_EBP FPsw_ext1_PPEG_EBP FPsw_PPEG_EBP /end REF_CHARACTERISTIC
/end GROUP
/begin GROUP PPEG_EGRdP_EC_Fault "EGRdP pegging offset out-of-range"
 /begin REF_CHARACTERISTIC FCdc4_PPEG_EGRdP FCdtc_PPEG_EGRdP FCfmi_PPEG_EGRdP FCftb_PPEG_EGRdP FCspn_PPEG_EGRdP FPfl_PPEG_EGRdP FPfu_PPEG_EGRdP FPnd_PPEG_EGRdP FPsvr_PPEG_EGRdP FPsw_ext1_PPEG_EGRdP FPsw_PPEG_EGRdP /end REF_CHARACTERISTIC
/end GROUP
/begin GROUP PPEG_EGRHP_EC_Fault "EGRHP pegging offset out-of-range"
 /begin REF_CHARACTERISTIC FCdc4_PPEG_EGRHP FCdtc_PPEG_EGRHP FCfmi_PPEG_EGRHP FCftb_PPEG_EGRHP FCspn_PPEG_EGRHP FPfl_PPEG_EGRHP FPfu_PPEG_EGRHP FPnd_PPEG_EGRHP FPsvr_PPEG_EGRHP FPsw_ext1_PPEG_EGRHP FPsw_PPEG_EGRHP /end REF_CHARACTERISTIC
/end GROUP
/begin GROUP PPEG_EGRLP_EC_Fault "EGRLP pegging offset out-of-range"
 /begin REF_CHARACTERISTIC FCdc4_PPEG_EGRLP FCdtc_PPEG_EGRLP FCfmi_PPEG_EGRLP FCftb_PPEG_EGRLP FCspn_PPEG_EGRLP FPfl_PPEG_EGRLP FPfu_PPEG_EGRLP FPnd_PPEG_EGRLP FPsvr_PPEG_EGRLP FPsw_ext1_PPEG_EGRLP FPsw_PPEG_EGRLP /end REF_CHARACTERISTIC
/end GROUP
/begin GROUP PPEG_EGRwrP_EC_Fault "EGRwrP pegging offset out-of-range"
 /begin REF_CHARACTERISTIC FCdc4_PPEG_EGRwrP FCdtc_PPEG_EGRwrP FCfmi_PPEG_EGRwrP FCftb_PPEG_EGRwrP FCspn_PPEG_EGRwrP FPfl_PPEG_EGRwrP FPfu_PPEG_EGRwrP FPnd_PPEG_EGRwrP FPsvr_PPEG_EGRwrP FPsw_ext1_PPEG_EGRwrP FPsw_PPEG_EGRwrP /end REF_CHARACTERISTIC
/end GROUP
/begin GROUP PPEG_MAP_EC_Fault "MAP pegging reference out-of-range"
 /begin REF_CHARACTERISTIC FCdc4_PPEG_MAP FCdtc_PPEG_MAP FCfmi_PPEG_MAP FCftb_PPEG_MAP FCspn_PPEG_MAP FPfl_PPEG_MAP FPfu_PPEG_MAP FPnd_PPEG_MAP FPsvr_PPEG_MAP FPsw_ext1_PPEG_MAP FPsw_PPEG_MAP /end REF_CHARACTERISTIC
/end GROUP
/begin GROUP PPEG_TIP_EC_Fault "TIP pegging offset out-of-range"
 /begin REF_CHARACTERISTIC FCdc4_PPEG_TIP FCdtc_PPEG_TIP FCfmi_PPEG_TIP FCftb_PPEG_TIP FCspn_PPEG_TIP FPfl_PPEG_TIP FPfu_PPEG_TIP FPnd_PPEG_TIP FPsvr_PPEG_TIP FPsw_ext1_PPEG_TIP FPsw_PPEG_TIP /end REF_CHARACTERISTIC
/end GROUP
/begin GROUP Pri1_open_EC_Fault "Spark 1 Open Primary"
 /begin REF_CHARACTERISTIC FCdc4_Pri1_open FCdtc_Pri1_open FCfmi_Pri1_open FCftb_Pri1_open FCspn_Pri1_open FPfl_Pri1_open FPfu_Pri1_open FPnd_Pri1_open FPsvr_Pri1_open FPsw_ext1_Pri1_open FPsw_Pri1_open /end REF_CHARACTERISTIC
/end GROUP
/begin GROUP Pri1_short_EC_Fault "Spark 1 Shorted Primary"
 /begin REF_CHARACTERISTIC FCdc4_Pri1_short FCdtc_Pri1_short FCfmi_Pri1_short FCftb_Pri1_short FCspn_Pri1_short FPfl_Pri1_short FPfu_Pri1_short FPnd_Pri1_short FPsvr_Pri1_short FPsw_ext1_Pri1_short FPsw_Pri1_short /end REF_CHARACTERISTIC
/end GROUP
/begin GROUP PWM1_off_loVf_EC_Fault "PWM1-Gauge1 open / ground short"
 /begin REF_CHARACTERISTIC FCdc4_PWM1_off_loVf FCdtc_PWM1_off_loVf FCfmi_PWM1_off_loVf FCftb_PWM1_off_loVf FCspn_PWM1_off_loVf FPfl_PWM1_off_loVf FPfu_PWM1_off_loVf FPnd_PWM1_off_loVf FPsvr_PWM1_off_loVf FPsw_ext1_PWM1_off_loVf FPsw_PWM1_off_loVf /end REF_CHARACTERISTIC
/end GROUP
/begin GROUP PWM1_on_hiVf_EC_Fault "PWM1-Gauge1 short to power"
 /begin REF_CHARACTERISTIC FCdc4_PWM1_on_hiVf FCdtc_PWM1_on_hiVf FCfmi_PWM1_on_hiVf FCftb_PWM1_on_hiVf FCspn_PWM1_on_hiVf FPfl_PWM1_on_hiVf FPfu_PWM1_on_hiVf FPnd_PWM1_on_hiVf FPsvr_PWM1_on_hiVf FPsw_ext1_PWM1_on_hiVf FPsw_PWM1_on_hiVf /end REF_CHARACTERISTIC
/end GROUP
/begin GROUP PWM10_off_loVf_EC_Fault "PWM10 open / ground short"
 /begin REF_CHARACTERISTIC FCdc4_PWM10_off_loVf FCdtc_PWM10_off_loVf FCfmi_PWM10_off_loVf FCftb_PWM10_off_loVf FCspn_PWM10_off_loVf FPfl_PWM10_off_loVf FPfu_PWM10_off_loVf FPnd_PWM10_off_loVf FPsvr_PWM10_off_loVf FPsw_ext1_PWM10_off_loVf FPsw_PWM10_off_loVf /end REF_CHARACTERISTIC
/end GROUP
/begin GROUP PWM10_on_hiVf_EC_Fault "PWM10 short to power"
 /begin REF_CHARACTERISTIC FCdc4_PWM10_on_hiVf FCdtc_PWM10_on_hiVf FCfmi_PWM10_on_hiVf FCftb_PWM10_on_hiVf FCspn_PWM10_on_hiVf FPfl_PWM10_on_hiVf FPfu_PWM10_on_hiVf FPnd_PWM10_on_hiVf FPsvr_PWM10_on_hiVf FPsw_ext1_PWM10_on_hiVf FPsw_PWM10_on_hiVf /end REF_CHARACTERISTIC
/end GROUP
/begin GROUP PWM11_off_loVf_EC_Fault "PWM11 open / ground short"
 /begin REF_CHARACTERISTIC FCdc4_PWM11_off_loVf FCdtc_PWM11_off_loVf FCfmi_PWM11_off_loVf FCftb_PWM11_off_loVf FCspn_PWM11_off_loVf FPfl_PWM11_off_loVf FPfu_PWM11_off_loVf FPnd_PWM11_off_loVf FPsvr_PWM11_off_loVf FPsw_ext1_PWM11_off_loVf FPsw_PWM11_off_loVf /end REF_CHARACTERISTIC
/end GROUP
/begin GROUP PWM11_on_hiVf_EC_Fault "PWM11 short to power"
 /begin REF_CHARACTERISTIC FCdc4_PWM11_on_hiVf FCdtc_PWM11_on_hiVf FCfmi_PWM11_on_hiVf FCftb_PWM11_on_hiVf FCspn_PWM11_on_hiVf FPfl_PWM11_on_hiVf FPfu_PWM11_on_hiVf FPnd_PWM11_on_hiVf FPsvr_PWM11_on_hiVf FPsw_ext1_PWM11_on_hiVf FPsw_PWM11_on_hiVf /end REF_CHARACTERISTIC
/end GROUP
/begin GROUP PWM12_off_loVf_EC_Fault "PWM12 open / ground short"
 /begin REF_CHARACTERISTIC FCdc4_PWM12_off_loVf FCdtc_PWM12_off_loVf FCfmi_PWM12_off_loVf FCftb_PWM12_off_loVf FCspn_PWM12_off_loVf FPfl_PWM12_off_loVf FPfu_PWM12_off_loVf FPnd_PWM12_off_loVf FPsvr_PWM12_off_loVf FPsw_ext1_PWM12_off_loVf FPsw_PWM12_off_loVf /end REF_CHARACTERISTIC
/end GROUP
/begin GROUP PWM12_on_hiVf_EC_Fault "PWM12 short to power"
 /begin REF_CHARACTERISTIC FCdc4_PWM12_on_hiVf FCdtc_PWM12_on_hiVf FCfmi_PWM12_on_hiVf FCftb_PWM12_on_hiVf FCspn_PWM12_on_hiVf FPfl_PWM12_on_hiVf FPfu_PWM12_on_hiVf FPnd_PWM12_on_hiVf FPsvr_PWM12_on_hiVf FPsw_ext1_PWM12_on_hiVf FPsw_PWM12_on_hiVf /end REF_CHARACTERISTIC
/end GROUP
/begin GROUP PWM13_off_loVf_EC_Fault "PWM13 open / ground short"
 /begin REF_CHARACTERISTIC FCdc4_PWM13_off_loVf FCdtc_PWM13_off_loVf FCfmi_PWM13_off_loVf FCftb_PWM13_off_loVf FCspn_PWM13_off_loVf FPfl_PWM13_off_loVf FPfu_PWM13_off_loVf FPnd_PWM13_off_loVf FPsvr_PWM13_off_loVf FPsw_ext1_PWM13_off_loVf FPsw_PWM13_off_loVf /end REF_CHARACTERISTIC
/end GROUP
/begin GROUP PWM13_on_hiVf_EC_Fault "PWM13 short to power"
 /begin REF_CHARACTERISTIC FCdc4_PWM13_on_hiVf FCdtc_PWM13_on_hiVf FCfmi_PWM13_on_hiVf FCftb_PWM13_on_hiVf FCspn_PWM13_on_hiVf FPfl_PWM13_on_hiVf FPfu_PWM13_on_hiVf FPnd_PWM13_on_hiVf FPsvr_PWM13_on_hiVf FPsw_ext1_PWM13_on_hiVf FPsw_PWM13_on_hiVf /end REF_CHARACTERISTIC
/end GROUP
/begin GROUP PWM14_off_loVf_EC_Fault "PWM14 open / ground short"
 /begin REF_CHARACTERISTIC FCdc4_PWM14_off_loVf FCdtc_PWM14_off_loVf FCfmi_PWM14_off_loVf FCftb_PWM14_off_loVf FCspn_PWM14_off_loVf FPfl_PWM14_off_loVf FPfu_PWM14_off_loVf FPnd_PWM14_off_loVf FPsvr_PWM14_off_loVf FPsw_ext1_PWM14_off_loVf FPsw_PWM14_off_loVf /end REF_CHARACTERISTIC
/end GROUP
/begin GROUP PWM14_on_hiVf_EC_Fault "PWM14 short to power"
 /begin REF_CHARACTERISTIC FCdc4_PWM14_on_hiVf FCdtc_PWM14_on_hiVf FCfmi_PWM14_on_hiVf FCftb_PWM14_on_hiVf FCspn_PWM14_on_hiVf FPfl_PWM14_on_hiVf FPfu_PWM14_on_hiVf FPnd_PWM14_on_hiVf FPsvr_PWM14_on_hiVf FPsw_ext1_PWM14_on_hiVf FPsw_PWM14_on_hiVf /end REF_CHARACTERISTIC
/end GROUP
/begin GROUP PWM15_off_loVf_EC_Fault "PWM15 open / ground short"
 /begin REF_CHARACTERISTIC FCdc4_PWM15_off_loVf FCdtc_PWM15_off_loVf FCfmi_PWM15_off_loVf FCftb_PWM15_off_loVf FCspn_PWM15_off_loVf FPfl_PWM15_off_loVf FPfu_PWM15_off_loVf FPnd_PWM15_off_loVf FPsvr_PWM15_off_loVf FPsw_ext1_PWM15_off_loVf FPsw_PWM15_off_loVf /end REF_CHARACTERISTIC
/end GROUP
/begin GROUP PWM15_on_hiVf_EC_Fault "PWM15 short to power"
 /begin REF_CHARACTERISTIC FCdc4_PWM15_on_hiVf FCdtc_PWM15_on_hiVf FCfmi_PWM15_on_hiVf FCftb_PWM15_on_hiVf FCspn_PWM15_on_hiVf FPfl_PWM15_on_hiVf FPfu_PWM15_on_hiVf FPnd_PWM15_on_hiVf FPsvr_PWM15_on_hiVf FPsw_ext1_PWM15_on_hiVf FPsw_PWM15_on_hiVf /end REF_CHARACTERISTIC
/end GROUP
/begin GROUP PWM16_off_loVf_EC_Fault "PWM16 open / ground short"
 /begin REF_CHARACTERISTIC FCdc4_PWM16_off_loVf FCdtc_PWM16_off_loVf FCfmi_PWM16_off_loVf FCftb_PWM16_off_loVf FCspn_PWM16_off_loVf FPfl_PWM16_off_loVf FPfu_PWM16_off_loVf FPnd_PWM16_off_loVf FPsvr_PWM16_off_loVf FPsw_ext1_PWM16_off_loVf FPsw_PWM16_off_loVf /end REF_CHARACTERISTIC
/end GROUP
/begin GROUP PWM16_on_hiVf_EC_Fault "PWM16 short to power"
 /begin REF_CHARACTERISTIC FCdc4_PWM16_on_hiVf FCdtc_PWM16_on_hiVf FCfmi_PWM16_on_hiVf FCftb_PWM16_on_hiVf FCspn_PWM16_on_hiVf FPfl_PWM16_on_hiVf FPfu_PWM16_on_hiVf FPnd_PWM16_on_hiVf FPsvr_PWM16_on_hiVf FPsw_ext1_PWM16_on_hiVf FPsw_PWM16_on_hiVf /end REF_CHARACTERISTIC
/end GROUP
/end MODULE
/end PROJECT
