ASAP2_VERSION 1 61
/begin PROJECT Econtrols_4G "4G Test"
/begin HEADER "4G A2L Configuration" PROJECT_NO EControls4G /* config for version control */ VERSION "$Revision: 82130 $:" /* config for version control */ /end HEADER
/begin MODULE EControls_4G_SH2A "EControls 4G"
/begin MOD_COMMON "" DEPOSIT ABSOLUTE BYTE_ORDER MSB_FIRST /end MOD_COMMON
/* Define the Record Layouts */
/begin RECORD_LAYOUT ECIPP_ALIGNMENT_UBYTE FNC_VALUES 1 UBYTE COLUMN_DIR DIRECT /end RECORD_LAYOUT
/begin RECORD_LAYOUT ECIPP_ALIGNMENT_UWORD FNC_VALUES 1 UWORD COLUMN_DIR DIRECT /end RECORD_LAYOUT
/begin RECORD_LAYOUT ECIPP_ALIGNMENT_ULONG FNC_VALUES 1 ULONG COLUMN_DIR DIRECT /end RECORD_LAYOUT
/begin RECORD_LAYOUT ECIPP_ALIGNMENT_FLOAT32_IEEE FNC_VALUES 1 FLOAT32_IEEE COLUMN_DIR DIRECT /end RECORD_LAYOUT
/begin COMPU_METHOD Compu_IDENTITY "Discrete Values " /* Identifier */ IDENTICAL "%.0" /* Format */ "-" /* Units */ /end COMPU_METHOD
/begin CHARACTERISTIC FCdc4_EGRdP_HiExp "FCtl_DTC_0x04(752)" VALUE 0x001E4676 /* @ECU_Address@FCtl_DTC_0x04@0x024C45E0@ */ ECIPP_ALIGNMENT_UWORD 65535 Compu_IDENTITY 0 65535 PHYS_UNIT "System ID + DTC" /end CHARACTERISTIC
/begin CHARACTERISTIC FCdc4_EGRdP_lo_LP_discon "FCtl_DTC_0x04(866)" VALUE 0x001E475A /* @ECU_Address@FCtl_DTC_0x04@0x024C46C4@ */ ECIPP_ALIGNMENT_UWORD 65535 Compu_IDENTITY 0 65535 PHYS_UNIT "System ID + DTC" /end CHARACTERISTIC
/begin CHARACTERISTIC FCdc4_EGRdP_lo_reversed "FCtl_DTC_0x04(865)" VALUE 0x001E4758 /* @ECU_Address@FCtl_DTC_0x04@0x024C46C2@ */ ECIPP_ALIGNMENT_UWORD 65535 Compu_IDENTITY 0 65535 PHYS_UNIT "System ID + DTC" /end CHARACTERISTIC
/begin CHARACTERISTIC FCdc4_EGRdP_LoExp "FCtl_DTC_0x04(751)" VALUE 0x001E4674 /* @ECU_Address@FCtl_DTC_0x04@0x024C45DE@ */ ECIPP_ALIGNMENT_UWORD 65535 Compu_IDENTITY 0 65535 PHYS_UNIT "System ID + DTC" /end CHARACTERISTIC
/begin CHARACTERISTIC FCdc4_EGRdP_maxv "FCtl_DTC_0x04(749)" VALUE 0x001E4670 /* @ECU_Address@FCtl_DTC_0x04@0x024C45DA@ */ ECIPP_ALIGNMENT_UWORD 65535 Compu_IDENTITY 0 65535 PHYS_UNIT "System ID + DTC" /end CHARACTERISTIC
/begin CHARACTERISTIC FCdc4_EGRdP_minv "FCtl_DTC_0x04(750)" VALUE 0x001E4672 /* @ECU_Address@FCtl_DTC_0x04@0x024C45DC@ */ ECIPP_ALIGNMENT_UWORD 65535 Compu_IDENTITY 0 65535 PHYS_UNIT "System ID + DTC" /end CHARACTERISTIC
/begin CHARACTERISTIC FCdc4_EGRflow_HiExp "FCtl_DTC_0x04(597)" VALUE 0x001E4540 /* @ECU_Address@FCtl_DTC_0x04@0x024C44AA@ */ ECIPP_ALIGNMENT_UWORD 65535 Compu_IDENTITY 0 65535 PHYS_UNIT "System ID + DTC" /end CHARACTERISTIC
/begin CHARACTERISTIC FCdc4_EGRflow_LoExp "FCtl_DTC_0x04(596)" VALUE 0x001E453E /* @ECU_Address@FCtl_DTC_0x04@0x024C44A8@ */ ECIPP_ALIGNMENT_UWORD 65535 Compu_IDENTITY 0 65535 PHYS_UNIT "System ID + DTC" /end CHARACTERISTIC
/begin CHARACTERISTIC FCdc4_EGRflow_LoExp2 "FCtl_DTC_0x04(684)" VALUE 0x001E45EE /* @ECU_Address@FCtl_DTC_0x04@0x024C4558@ */ ECIPP_ALIGNMENT_UWORD 65535 Compu_IDENTITY 0 65535 PHYS_UNIT "System ID + DTC" /end CHARACTERISTIC
/begin CHARACTERISTIC FCdc4_EGRHP_maxv "FCtl_DTC_0x04(753)" VALUE 0x001E4678 /* @ECU_Address@FCtl_DTC_0x04@0x024C45E2@ */ ECIPP_ALIGNMENT_UWORD 65535 Compu_IDENTITY 0 65535 PHYS_UNIT "System ID + DTC" /end CHARACTERISTIC
/begin CHARACTERISTIC FCdc4_EGRHP_minv "FCtl_DTC_0x04(754)" VALUE 0x001E467A /* @ECU_Address@FCtl_DTC_0x04@0x024C45E4@ */ ECIPP_ALIGNMENT_UWORD 65535 Compu_IDENTITY 0 65535 PHYS_UNIT "System ID + DTC" /end CHARACTERISTIC
/begin CHARACTERISTIC FCdc4_EGRHP_OOR "FCtl_DTC_0x04(755)" VALUE 0x001E467C /* @ECU_Address@FCtl_DTC_0x04@0x024C45E6@ */ ECIPP_ALIGNMENT_UWORD 65535 Compu_IDENTITY 0 65535 PHYS_UNIT "System ID + DTC" /end CHARACTERISTIC
/begin CHARACTERISTIC FCdc4_EGRO_postlk "FCtl_DTC_0x04(798)" VALUE 0x001E46D2 /* @ECU_Address@FCtl_DTC_0x04@0x024C463C@ */ ECIPP_ALIGNMENT_UWORD 65535 Compu_IDENTITY 0 65535 PHYS_UNIT "System ID + DTC" /end CHARACTERISTIC
/begin CHARACTERISTIC FCdc4_EGRT_hi "FCtl_DTC_0x04(694)" VALUE 0x001E4602 /* @ECU_Address@FCtl_DTC_0x04@0x024C456C@ */ ECIPP_ALIGNMENT_UWORD 65535 Compu_IDENTITY 0 65535 PHYS_UNIT "System ID + DTC" /end CHARACTERISTIC
/begin CHARACTERISTIC FCdc4_EGRT_maxv "FCtl_DTC_0x04(692)" VALUE 0x001E45FE /* @ECU_Address@FCtl_DTC_0x04@0x024C4568@ */ ECIPP_ALIGNMENT_UWORD 65535 Compu_IDENTITY 0 65535 PHYS_UNIT "System ID + DTC" /end CHARACTERISTIC
/begin CHARACTERISTIC FCdc4_EGRT_minv "FCtl_DTC_0x04(693)" VALUE 0x001E4600 /* @ECU_Address@FCtl_DTC_0x04@0x024C456A@ */ ECIPP_ALIGNMENT_UWORD 65535 Compu_IDENTITY 0 65535 PHYS_UNIT "System ID + DTC" /end CHARACTERISTIC
/begin CHARACTERISTIC FCdc4_EGT_dig_Hi "FCtl_DTC_0x04(187)" VALUE 0x001E420C /* @ECU_Address@FCtl_DTC_0x04@0x024C4176@ */ ECIPP_ALIGNMENT_UWORD 65535 Compu_IDENTITY 0 65535 PHYS_UNIT "System ID + DTC" /end CHARACTERISTIC
/begin CHARACTERISTIC FCdc4_EGT_maxv "FCtl_DTC_0x04(808)" VALUE 0x001E46E6 /* @ECU_Address@FCtl_DTC_0x04@0x024C4650@ */ ECIPP_ALIGNMENT_UWORD 65535 Compu_IDENTITY 0 65535 PHYS_UNIT "System ID + DTC" /end CHARACTERISTIC
/begin CHARACTERISTIC FCdc4_EGT_minv "FCtl_DTC_0x04(809)" VALUE 0x001E46E8 /* @ECU_Address@FCtl_DTC_0x04@0x024C4652@ */ ECIPP_ALIGNMENT_UWORD 65535 Compu_IDENTITY 0 65535 PHYS_UNIT "System ID + DTC" /end CHARACTERISTIC
/begin CHARACTERISTIC FCdc4_EMWT1_HiExp1 "FCtl_DTC_0x04(225)" VALUE 0x001E4258 /* @ECU_Address@FCtl_DTC_0x04@0x024C41C2@ */ ECIPP_ALIGNMENT_UWORD 65535 Compu_IDENTITY 0 65535 PHYS_UNIT "System ID + DTC" /end CHARACTERISTIC
/begin CHARACTERISTIC FCdc4_EMWT1_HiExp2 "FCtl_DTC_0x04(227)" VALUE 0x001E425C /* @ECU_Address@FCtl_DTC_0x04@0x024C41C6@ */ ECIPP_ALIGNMENT_UWORD 65535 Compu_IDENTITY 0 65535 PHYS_UNIT "System ID + DTC" /end CHARACTERISTIC
/begin CHARACTERISTIC FCdc4_EMWT1_maxv "FCtl_DTC_0x04(221)" VALUE 0x001E4250 /* @ECU_Address@FCtl_DTC_0x04@0x024C41BA@ */ ECIPP_ALIGNMENT_UWORD 65535 Compu_IDENTITY 0 65535 PHYS_UNIT "System ID + DTC" /end CHARACTERISTIC
/begin CHARACTERISTIC FCdc4_EMWT1_minv "FCtl_DTC_0x04(223)" VALUE 0x001E4254 /* @ECU_Address@FCtl_DTC_0x04@0x024C41BE@ */ ECIPP_ALIGNMENT_UWORD 65535 Compu_IDENTITY 0 65535 PHYS_UNIT "System ID + DTC" /end CHARACTERISTIC
/begin CHARACTERISTIC FCdc4_envtech_AAT_inv "FCtl_DTC_0x04(814)" VALUE 0x001E46F2 /* @ECU_Address@FCtl_DTC_0x04@0x024C465C@ */ ECIPP_ALIGNMENT_UWORD 65535 Compu_IDENTITY 0 65535 PHYS_UNIT "System ID + DTC" /end CHARACTERISTIC
/begin CHARACTERISTIC FCdc4_envtech_BP_inv "FCtl_DTC_0x04(815)" VALUE 0x001E46F4 /* @ECU_Address@FCtl_DTC_0x04@0x024C465E@ */ ECIPP_ALIGNMENT_UWORD 65535 Compu_IDENTITY 0 65535 PHYS_UNIT "System ID + DTC" /end CHARACTERISTIC
/begin CHARACTERISTIC FCdc4_envtech_comm "FCtl_DTC_0x04(358)" VALUE 0x001E4362 /* @ECU_Address@FCtl_DTC_0x04@0x024C42CC@ */ ECIPP_ALIGNMENT_UWORD 65535 Compu_IDENTITY 0 65535 PHYS_UNIT "System ID + DTC" /end CHARACTERISTIC
/begin CHARACTERISTIC FCdc4_envtech_general "FCtl_DTC_0x04(817)" VALUE 0x001E46F8 /* @ECU_Address@FCtl_DTC_0x04@0x024C4662@ */ ECIPP_ALIGNMENT_UWORD 65535 Compu_IDENTITY 0 65535 PHYS_UNIT "System ID + DTC" /end CHARACTERISTIC
/begin CHARACTERISTIC FCdc4_envtech_RH_inv "FCtl_DTC_0x04(816)" VALUE 0x001E46F6 /* @ECU_Address@FCtl_DTC_0x04@0x024C4660@ */ ECIPP_ALIGNMENT_UWORD 65535 Compu_IDENTITY 0 65535 PHYS_UNIT "System ID + DTC" /end CHARACTERISTIC
/begin CHARACTERISTIC FCdc4_envtech_RH_uns "FCtl_DTC_0x04(818)" VALUE 0x001E46FA /* @ECU_Address@FCtl_DTC_0x04@0x024C4664@ */ ECIPP_ALIGNMENT_UWORD 65535 Compu_IDENTITY 0 65535 PHYS_UNIT "System ID + DTC" /end CHARACTERISTIC
/begin CHARACTERISTIC FCdc4_ERCV_speed_OOR "FCtl_DTC_0x04(853)" VALUE 0x001E4740 /* @ECU_Address@FCtl_DTC_0x04@0x024C46AA@ */ ECIPP_ALIGNMENT_UWORD 65535 Compu_IDENTITY 0 65535 PHYS_UNIT "System ID + DTC" /end CHARACTERISTIC
/begin CHARACTERISTIC FCdc4_ERWT1_HiExp1 "FCtl_DTC_0x04(237)" VALUE 0x001E4270 /* @ECU_Address@FCtl_DTC_0x04@0x024C41DA@ */ ECIPP_ALIGNMENT_UWORD 65535 Compu_IDENTITY 0 65535 PHYS_UNIT "System ID + DTC" /end CHARACTERISTIC
/begin CHARACTERISTIC FCdc4_ERWT1_HiExp2 "FCtl_DTC_0x04(239)" VALUE 0x001E4274 /* @ECU_Address@FCtl_DTC_0x04@0x024C41DE@ */ ECIPP_ALIGNMENT_UWORD 65535 Compu_IDENTITY 0 65535 PHYS_UNIT "System ID + DTC" /end CHARACTERISTIC
/begin CHARACTERISTIC FCdc4_ERWT1_maxv "FCtl_DTC_0x04(233)" VALUE 0x001E4268 /* @ECU_Address@FCtl_DTC_0x04@0x024C41D2@ */ ECIPP_ALIGNMENT_UWORD 65535 Compu_IDENTITY 0 65535 PHYS_UNIT "System ID + DTC" /end CHARACTERISTIC
/begin CHARACTERISTIC FCdc4_ERWT1_minv "FCtl_DTC_0x04(235)" VALUE 0x001E426C /* @ECU_Address@FCtl_DTC_0x04@0x024C41D6@ */ ECIPP_ALIGNMENT_UWORD 65535 Compu_IDENTITY 0 65535 PHYS_UNIT "System ID + DTC" /end CHARACTERISTIC
/begin CHARACTERISTIC FCdc4_F1OOR_F2IVS "FCtl_DTC_0x04(178)" VALUE 0x001E41FA /* @ECU_Address@FCtl_DTC_0x04@0x024C4164@ */ ECIPP_ALIGNMENT_UWORD 65535 Compu_IDENTITY 0 65535 PHYS_UNIT "System ID + DTC" /end CHARACTERISTIC
/begin CHARACTERISTIC FCdc4_F2OOR_F1IVS "FCtl_DTC_0x04(179)" VALUE 0x001E41FC /* @ECU_Address@FCtl_DTC_0x04@0x024C4166@ */ ECIPP_ALIGNMENT_UWORD 65535 Compu_IDENTITY 0 65535 PHYS_UNIT "System ID + DTC" /end CHARACTERISTIC
/begin CHARACTERISTIC FCdc4_FCoolH2O_lo "FCtl_DTC_0x04(532)" VALUE 0x001E44BE /* @ECU_Address@FCtl_DTC_0x04@0x024C4428@ */ ECIPP_ALIGNMENT_UWORD 65535 Compu_IDENTITY 0 65535 PHYS_UNIT "System ID + DTC" /end CHARACTERISTIC
/begin CHARACTERISTIC FCdc4_FIMP_pct_high "FCtl_DTC_0x04(282)" VALUE 0x001E42CA /* @ECU_Address@FCtl_DTC_0x04@0x024C4234@ */ ECIPP_ALIGNMENT_UWORD 65535 Compu_IDENTITY 0 65535 PHYS_UNIT "System ID + DTC" /end CHARACTERISTIC
/begin CHARACTERISTIC FCdc4_FIP_LoExp "FCtl_DTC_0x04(695)" VALUE 0x001E4604 /* @ECU_Address@FCtl_DTC_0x04@0x024C456E@ */ ECIPP_ALIGNMENT_UWORD 65535 Compu_IDENTITY 0 65535 PHYS_UNIT "System ID + DTC" /end CHARACTERISTIC
/begin CHARACTERISTIC FCdc4_flash_fail "FCtl_DTC_0x04(105)" VALUE 0x001E4168 /* @ECU_Address@FCtl_DTC_0x04@0x024C40D2@ */ ECIPP_ALIGNMENT_UWORD 65535 Compu_IDENTITY 0 65535 PHYS_UNIT "System ID + DTC" /end CHARACTERISTIC
/begin CHARACTERISTIC FCdc4_FOP_start "FCtl_DTC_0x04(1016)" VALUE 0x001E4886 /* @ECU_Address@FCtl_DTC_0x04@0x024C47F0@ */ ECIPP_ALIGNMENT_UWORD 65535 Compu_IDENTITY 0 65535 PHYS_UNIT "System ID + DTC" /end CHARACTERISTIC
/begin CHARACTERISTIC FCdc4_FP_high "FCtl_DTC_0x04(290)" VALUE 0x001E42DA /* @ECU_Address@FCtl_DTC_0x04@0x024C4244@ */ ECIPP_ALIGNMENT_UWORD 65535 Compu_IDENTITY 0 65535 PHYS_UNIT "System ID + DTC" /end CHARACTERISTIC
/begin CHARACTERISTIC FCdc4_FP_low "FCtl_DTC_0x04(291)" VALUE 0x001E42DC /* @ECU_Address@FCtl_DTC_0x04@0x024C4246@ */ ECIPP_ALIGNMENT_UWORD 65535 Compu_IDENTITY 0 65535 PHYS_UNIT "System ID + DTC" /end CHARACTERISTIC
/begin CHARACTERISTIC FCdc4_FP_maxv "FCtl_DTC_0x04(128)" VALUE 0x001E4196 /* @ECU_Address@FCtl_DTC_0x04@0x024C4100@ */ ECIPP_ALIGNMENT_UWORD 65535 Compu_IDENTITY 0 65535 PHYS_UNIT "System ID + DTC" /end CHARACTERISTIC
/begin CHARACTERISTIC FCdc4_FP_minv "FCtl_DTC_0x04(129)" VALUE 0x001E4198 /* @ECU_Address@FCtl_DTC_0x04@0x024C4102@ */ ECIPP_ALIGNMENT_UWORD 65535 Compu_IDENTITY 0 65535 PHYS_UNIT "System ID + DTC" /end CHARACTERISTIC
/begin CHARACTERISTIC FCdc4_FP2_high "FCtl_DTC_0x04(463)" VALUE 0x001E4434 /* @ECU_Address@FCtl_DTC_0x04@0x024C439E@ */ ECIPP_ALIGNMENT_UWORD 65535 Compu_IDENTITY 0 65535 PHYS_UNIT "System ID + DTC" /end CHARACTERISTIC
/begin CHARACTERISTIC FCdc4_FP2_low "FCtl_DTC_0x04(464)" VALUE 0x001E4436 /* @ECU_Address@FCtl_DTC_0x04@0x024C43A0@ */ ECIPP_ALIGNMENT_UWORD 65535 Compu_IDENTITY 0 65535 PHYS_UNIT "System ID + DTC" /end CHARACTERISTIC
/begin CHARACTERISTIC FCdc4_FP2_maxv "FCtl_DTC_0x04(461)" VALUE 0x001E4430 /* @ECU_Address@FCtl_DTC_0x04@0x024C439A@ */ ECIPP_ALIGNMENT_UWORD 65535 Compu_IDENTITY 0 65535 PHYS_UNIT "System ID + DTC" /end CHARACTERISTIC
/begin CHARACTERISTIC FCdc4_FP2_minv "FCtl_DTC_0x04(462)" VALUE 0x001E4432 /* @ECU_Address@FCtl_DTC_0x04@0x024C439C@ */ ECIPP_ALIGNMENT_UWORD 65535 Compu_IDENTITY 0 65535 PHYS_UNIT "System ID + DTC" /end CHARACTERISTIC
/begin CHARACTERISTIC FCdc4_FPD_off_hi "FCtl_DTC_0x04(94)" VALUE 0x001E4152 /* @ECU_Address@FCtl_DTC_0x04@0x024C40BC@ */ ECIPP_ALIGNMENT_UWORD 65535 Compu_IDENTITY 0 65535 PHYS_UNIT "System ID + DTC" /end CHARACTERISTIC
/begin CHARACTERISTIC FCdc4_FPD_on_lo "FCtl_DTC_0x04(93)" VALUE 0x001E4150 /* @ECU_Address@FCtl_DTC_0x04@0x024C40BA@ */ ECIPP_ALIGNMENT_UWORD 65535 Compu_IDENTITY 0 65535 PHYS_UNIT "System ID + DTC" /end CHARACTERISTIC
/begin CHARACTERISTIC FCdc4_FPlo_derate_actv "FCtl_DTC_0x04(807)" VALUE 0x001E46E4 /* @ECU_Address@FCtl_DTC_0x04@0x024C464E@ */ ECIPP_ALIGNMENT_UWORD 65535 Compu_IDENTITY 0 65535 PHYS_UNIT "System ID + DTC" /end CHARACTERISTIC
/begin CHARACTERISTIC FCdc4_FPlo_derate_excess "FCtl_DTC_0x04(810)" VALUE 0x001E46EA /* @ECU_Address@FCtl_DTC_0x04@0x024C4654@ */ ECIPP_ALIGNMENT_UWORD 65535 Compu_IDENTITY 0 65535 PHYS_UNIT "System ID + DTC" /end CHARACTERISTIC
/begin CHARACTERISTIC FCdc4_FPP_NeutLock_fail "FCtl_DTC_0x04(658)" VALUE 0x001E45BA /* @ECU_Address@FCtl_DTC_0x04@0x024C4524@ */ ECIPP_ALIGNMENT_UWORD 65535 Compu_IDENTITY 0 65535 PHYS_UNIT "System ID + DTC" /end CHARACTERISTIC
/begin CHARACTERISTIC FCdc4_FPP1_IVS_max "FCtl_DTC_0x04(23)" VALUE 0x001E40C4 /* @ECU_Address@FCtl_DTC_0x04@0x024C402E@ */ ECIPP_ALIGNMENT_UWORD 65535 Compu_IDENTITY 0 65535 PHYS_UNIT "System ID + DTC" /end CHARACTERISTIC
/begin CHARACTERISTIC FCdc4_FPP1_IVS_min "FCtl_DTC_0x04(24)" VALUE 0x001E40C6 /* @ECU_Address@FCtl_DTC_0x04@0x024C4030@ */ ECIPP_ALIGNMENT_UWORD 65535 Compu_IDENTITY 0 65535 PHYS_UNIT "System ID + DTC" /end CHARACTERISTIC
/begin CHARACTERISTIC FCdc4_FPP1_max "FCtl_DTC_0x04(19)" VALUE 0x001E40BC /* @ECU_Address@FCtl_DTC_0x04@0x024C4026@ */ ECIPP_ALIGNMENT_UWORD 65535 Compu_IDENTITY 0 65535 PHYS_UNIT "System ID + DTC" /end CHARACTERISTIC
/begin CHARACTERISTIC FCdc4_FPP1_min "FCtl_DTC_0x04(20)" VALUE 0x001E40BE /* @ECU_Address@FCtl_DTC_0x04@0x024C4028@ */ ECIPP_ALIGNMENT_UWORD 65535 Compu_IDENTITY 0 65535 PHYS_UNIT "System ID + DTC" /end CHARACTERISTIC
/begin CHARACTERISTIC FCdc4_FPP12_IVS_max "FCtl_DTC_0x04(175)" VALUE 0x001E41F4 /* @ECU_Address@FCtl_DTC_0x04@0x024C415E@ */ ECIPP_ALIGNMENT_UWORD 65535 Compu_IDENTITY 0 65535 PHYS_UNIT "System ID + DTC" /end CHARACTERISTIC
/begin CHARACTERISTIC FCdc4_FPP12_IVS_min "FCtl_DTC_0x04(176)" VALUE 0x001E41F6 /* @ECU_Address@FCtl_DTC_0x04@0x024C4160@ */ ECIPP_ALIGNMENT_UWORD 65535 Compu_IDENTITY 0 65535 PHYS_UNIT "System ID + DTC" /end CHARACTERISTIC
/begin CHARACTERISTIC FCdc4_FPP12_OOR "FCtl_DTC_0x04(177)" VALUE 0x001E41F8 /* @ECU_Address@FCtl_DTC_0x04@0x024C4162@ */ ECIPP_ALIGNMENT_UWORD 65535 Compu_IDENTITY 0 65535 PHYS_UNIT "System ID + DTC" /end CHARACTERISTIC
/begin CHARACTERISTIC FCdc4_FPP12IVS_TSC1 "FCtl_DTC_0x04(734)" VALUE 0x001E4652 /* @ECU_Address@FCtl_DTC_0x04@0x024C45BC@ */ ECIPP_ALIGNMENT_UWORD 65535 Compu_IDENTITY 0 65535 PHYS_UNIT "System ID + DTC" /end CHARACTERISTIC
/begin CHARACTERISTIC FCdc4_FPP12MM_IVSMM "FCtl_DTC_0x04(180)" VALUE 0x001E41FE /* @ECU_Address@FCtl_DTC_0x04@0x024C4168@ */ ECIPP_ALIGNMENT_UWORD 65535 Compu_IDENTITY 0 65535 PHYS_UNIT "System ID + DTC" /end CHARACTERISTIC
/begin CHARACTERISTIC FCdc4_FPP12pct_hi "FCtl_DTC_0x04(27)" VALUE 0x001E40CC /* @ECU_Address@FCtl_DTC_0x04@0x024C4036@ */ ECIPP_ALIGNMENT_UWORD 65535 Compu_IDENTITY 0 65535 PHYS_UNIT "System ID + DTC" /end CHARACTERISTIC
/begin CHARACTERISTIC FCdc4_FPP12pct_lo "FCtl_DTC_0x04(28)" VALUE 0x001E40CE /* @ECU_Address@FCtl_DTC_0x04@0x024C4038@ */ ECIPP_ALIGNMENT_UWORD 65535 Compu_IDENTITY 0 65535 PHYS_UNIT "System ID + DTC" /end CHARACTERISTIC
/begin CHARACTERISTIC FCdc4_FPP2_IVS_max "FCtl_DTC_0x04(25)" VALUE 0x001E40C8 /* @ECU_Address@FCtl_DTC_0x04@0x024C4032@ */ ECIPP_ALIGNMENT_UWORD 65535 Compu_IDENTITY 0 65535 PHYS_UNIT "System ID + DTC" /end CHARACTERISTIC
/begin CHARACTERISTIC FCdc4_FPP2_IVS_min "FCtl_DTC_0x04(26)" VALUE 0x001E40CA /* @ECU_Address@FCtl_DTC_0x04@0x024C4034@ */ ECIPP_ALIGNMENT_UWORD 65535 Compu_IDENTITY 0 65535 PHYS_UNIT "System ID + DTC" /end CHARACTERISTIC
/begin CHARACTERISTIC FCdc4_FPP2_max "FCtl_DTC_0x04(21)" VALUE 0x001E40C0 /* @ECU_Address@FCtl_DTC_0x04@0x024C402A@ */ ECIPP_ALIGNMENT_UWORD 65535 Compu_IDENTITY 0 65535 PHYS_UNIT "System ID + DTC" /end CHARACTERISTIC
/begin CHARACTERISTIC FCdc4_FPP2_min "FCtl_DTC_0x04(22)" VALUE 0x001E40C2 /* @ECU_Address@FCtl_DTC_0x04@0x024C402C@ */ ECIPP_ALIGNMENT_UWORD 65535 Compu_IDENTITY 0 65535 PHYS_UNIT "System ID + DTC" /end CHARACTERISTIC
/begin CHARACTERISTIC FCdc4_FPP2V_TSC1 "FCtl_DTC_0x04(839)" VALUE 0x001E4724 /* @ECU_Address@FCtl_DTC_0x04@0x024C468E@ */ ECIPP_ALIGNMENT_UWORD 65535 Compu_IDENTITY 0 65535 PHYS_UNIT "System ID + DTC" /end CHARACTERISTIC
/begin CHARACTERISTIC FCdc4_FPrly_coilopen "FCtl_DTC_0x04(168)" VALUE 0x001E41E6 /* @ECU_Address@FCtl_DTC_0x04@0x024C4150@ */ ECIPP_ALIGNMENT_UWORD 65535 Compu_IDENTITY 0 65535 PHYS_UNIT "System ID + DTC" /end CHARACTERISTIC
/begin CHARACTERISTIC FPnd_EGRdP_HiExp "FPrm_pending(582)" VALUE 0x001E559E /* @ECU_Address@FPrm_pending@0x021BE48C@ */ ECIPP_ALIGNMENT_UWORD 65535 Compu_IDENTITY 0 65535 PHYS_UNIT "Bit Mask" /end CHARACTERISTIC
/begin CHARACTERISTIC FPnd_EGRdP_lo_LP_discon "FPrm_pending(693)" VALUE 0x001E567C /* @ECU_Address@FPrm_pending@0x021BE56A@ */ ECIPP_ALIGNMENT_UWORD 65535 Compu_IDENTITY 0 65535 PHYS_UNIT "Bit Mask" /end CHARACTERISTIC
/begin CHARACTERISTIC FPnd_EGRdP_lo_reversed "FPrm_pending(692)" VALUE 0x001E567A /* @ECU_Address@FPrm_pending@0x021BE568@ */ ECIPP_ALIGNMENT_UWORD 65535 Compu_IDENTITY 0 65535 PHYS_UNIT "Bit Mask" /end CHARACTERISTIC
/begin CHARACTERISTIC FPnd_EGRdP_LoExp "FPrm_pending(581)" VALUE 0x001E559C /* @ECU_Address@FPrm_pending@0x021BE48A@ */ ECIPP_ALIGNMENT_UWORD 65535 Compu_IDENTITY 0 65535 PHYS_UNIT "Bit Mask" /end CHARACTERISTIC
/begin CHARACTERISTIC FPnd_EGRdP_maxv "FPrm_pending(579)" VALUE 0x001E5598 /* @ECU_Address@FPrm_pending@0x021BE486@ */ ECIPP_ALIGNMENT_UWORD 65535 Compu_IDENTITY 0 65535 PHYS_UNIT "Bit Mask" /end CHARACTERISTIC
/begin CHARACTERISTIC FPnd_EGRdP_minv "FPrm_pending(580)" VALUE 0x001E559A /* @ECU_Address@FPrm_pending@0x021BE488@ */ ECIPP_ALIGNMENT_UWORD 65535 Compu_IDENTITY 0 65535 PHYS_UNIT "Bit Mask" /end CHARACTERISTIC
/begin CHARACTERISTIC FPnd_EGRflow_HiExp "FPrm_pending(451)" VALUE 0x001E5498 /* @ECU_Address@FPrm_pending@0x021BE386@ */ ECIPP_ALIGNMENT_UWORD 65535 Compu_IDENTITY 0 65535 PHYS_UNIT "Bit Mask" /end CHARACTERISTIC
/begin CHARACTERISTIC FPnd_EGRflow_LoExp "FPrm_pending(450)" VALUE 0x001E5496 /* @ECU_Address@FPrm_pending@0x021BE384@ */ ECIPP_ALIGNMENT_UWORD 65535 Compu_IDENTITY 0 65535 PHYS_UNIT "Bit Mask" /end CHARACTERISTIC
/begin CHARACTERISTIC FPnd_EGRflow_LoExp2 "FPrm_pending(514)" VALUE 0x001E5516 /* @ECU_Address@FPrm_pending@0x021BE404@ */ ECIPP_ALIGNMENT_UWORD 65535 Compu_IDENTITY 0 65535 PHYS_UNIT "Bit Mask" /end CHARACTERISTIC
/begin CHARACTERISTIC FPnd_EGRHP_maxv "FPrm_pending(583)" VALUE 0x001E55A0 /* @ECU_Address@FPrm_pending@0x021BE48E@ */ ECIPP_ALIGNMENT_UWORD 65535 Compu_IDENTITY 0 65535 PHYS_UNIT "Bit Mask" /end CHARACTERISTIC
/begin CHARACTERISTIC FPnd_EGRHP_minv "FPrm_pending(584)" VALUE 0x001E55A2 /* @ECU_Address@FPrm_pending@0x021BE490@ */ ECIPP_ALIGNMENT_UWORD 65535 Compu_IDENTITY 0 65535 PHYS_UNIT "Bit Mask" /end CHARACTERISTIC
/begin CHARACTERISTIC FPnd_EGRHP_OOR "FPrm_pending(585)" VALUE 0x001E55A4 /* @ECU_Address@FPrm_pending@0x021BE492@ */ ECIPP_ALIGNMENT_UWORD 65535 Compu_IDENTITY 0 65535 PHYS_UNIT "Bit Mask" /end CHARACTERISTIC
/begin CHARACTERISTIC FPnd_EGRO_postlk "FPrm_pending(628)" VALUE 0x001E55FA /* @ECU_Address@FPrm_pending@0x021BE4E8@ */ ECIPP_ALIGNMENT_UWORD 65535 Compu_IDENTITY 0 65535 PHYS_UNIT "Bit Mask" /end CHARACTERISTIC
/begin CHARACTERISTIC FPnd_EGRT_hi "FPrm_pending(524)" VALUE 0x001E552A /* @ECU_Address@FPrm_pending@0x021BE418@ */ ECIPP_ALIGNMENT_UWORD 65535 Compu_IDENTITY 0 65535 PHYS_UNIT "Bit Mask" /end CHARACTERISTIC
/begin CHARACTERISTIC FPnd_EGRT_maxv "FPrm_pending(522)" VALUE 0x001E5526 /* @ECU_Address@FPrm_pending@0x021BE414@ */ ECIPP_ALIGNMENT_UWORD 65535 Compu_IDENTITY 0 65535 PHYS_UNIT "Bit Mask" /end CHARACTERISTIC
/begin CHARACTERISTIC FPnd_EGRT_minv "FPrm_pending(523)" VALUE 0x001E5528 /* @ECU_Address@FPrm_pending@0x021BE416@ */ ECIPP_ALIGNMENT_UWORD 65535 Compu_IDENTITY 0 65535 PHYS_UNIT "Bit Mask" /end CHARACTERISTIC
/begin CHARACTERISTIC FPnd_EGT_dig_Hi "FPrm_pending(145)" VALUE 0x001E5234 /* @ECU_Address@FPrm_pending@0x021BE122@ */ ECIPP_ALIGNMENT_UWORD 65535 Compu_IDENTITY 0 65535 PHYS_UNIT "Bit Mask" /end CHARACTERISTIC
/begin CHARACTERISTIC FPnd_EGT_maxv "FPrm_pending(635)" VALUE 0x001E5608 /* @ECU_Address@FPrm_pending@0x021BE4F6@ */ ECIPP_ALIGNMENT_UWORD 65535 Compu_IDENTITY 0 65535 PHYS_UNIT "Bit Mask" /end CHARACTERISTIC
/begin CHARACTERISTIC FPnd_EGT_minv "FPrm_pending(636)" VALUE 0x001E560A /* @ECU_Address@FPrm_pending@0x021BE4F8@ */ ECIPP_ALIGNMENT_UWORD 65535 Compu_IDENTITY 0 65535 PHYS_UNIT "Bit Mask" /end CHARACTERISTIC
/begin CHARACTERISTIC FPnd_EMWT1_HiExp1 "FPrm_pending(179)" VALUE 0x001E5278 /* @ECU_Address@FPrm_pending@0x021BE166@ */ ECIPP_ALIGNMENT_UWORD 65535 Compu_IDENTITY 0 65535 PHYS_UNIT "Bit Mask" /end CHARACTERISTIC
/begin CHARACTERISTIC FPnd_EMWT1_HiExp2 "FPrm_pending(180)" VALUE 0x001E527A /* @ECU_Address@FPrm_pending@0x021BE168@ */ ECIPP_ALIGNMENT_UWORD 65535 Compu_IDENTITY 0 65535 PHYS_UNIT "Bit Mask" /end CHARACTERISTIC
/begin CHARACTERISTIC FPnd_EMWT1_maxv "FPrm_pending(177)" VALUE 0x001E5274 /* @ECU_Address@FPrm_pending@0x021BE162@ */ ECIPP_ALIGNMENT_UWORD 65535 Compu_IDENTITY 0 65535 PHYS_UNIT "Bit Mask" /end CHARACTERISTIC
/begin CHARACTERISTIC FPnd_EMWT1_minv "FPrm_pending(178)" VALUE 0x001E5276 /* @ECU_Address@FPrm_pending@0x021BE164@ */ ECIPP_ALIGNMENT_UWORD 65535 Compu_IDENTITY 0 65535 PHYS_UNIT "Bit Mask" /end CHARACTERISTIC
/begin CHARACTERISTIC FPnd_envtech_AAT_inv "FPrm_pending(641)" VALUE 0x001E5614 /* @ECU_Address@FPrm_pending@0x021BE502@ */ ECIPP_ALIGNMENT_UWORD 65535 Compu_IDENTITY 0 65535 PHYS_UNIT "Bit Mask" /end CHARACTERISTIC
/begin CHARACTERISTIC FPnd_envtech_BP_inv "FPrm_pending(642)" VALUE 0x001E5616 /* @ECU_Address@FPrm_pending@0x021BE504@ */ ECIPP_ALIGNMENT_UWORD 65535 Compu_IDENTITY 0 65535 PHYS_UNIT "Bit Mask" /end CHARACTERISTIC
/begin CHARACTERISTIC FPnd_envtech_comm "FPrm_pending(267)" VALUE 0x001E5328 /* @ECU_Address@FPrm_pending@0x021BE216@ */ ECIPP_ALIGNMENT_UWORD 65535 Compu_IDENTITY 0 65535 PHYS_UNIT "Bit Mask" /end CHARACTERISTIC
/begin CHARACTERISTIC FPnd_envtech_general "FPrm_pending(644)" VALUE 0x001E561A /* @ECU_Address@FPrm_pending@0x021BE508@ */ ECIPP_ALIGNMENT_UWORD 65535 Compu_IDENTITY 0 65535 PHYS_UNIT "Bit Mask" /end CHARACTERISTIC
/begin CHARACTERISTIC FPnd_envtech_RH_inv "FPrm_pending(643)" VALUE 0x001E5618 /* @ECU_Address@FPrm_pending@0x021BE506@ */ ECIPP_ALIGNMENT_UWORD 65535 Compu_IDENTITY 0 65535 PHYS_UNIT "Bit Mask" /end CHARACTERISTIC
/begin CHARACTERISTIC FPnd_envtech_RH_uns "FPrm_pending(645)" VALUE 0x001E561C /* @ECU_Address@FPrm_pending@0x021BE50A@ */ ECIPP_ALIGNMENT_UWORD 65535 Compu_IDENTITY 0 65535 PHYS_UNIT "Bit Mask" /end CHARACTERISTIC
/begin CHARACTERISTIC FPnd_ERCV_speed_OOR "FPrm_pending(680)" VALUE 0x001E5662 /* @ECU_Address@FPrm_pending@0x021BE550@ */ ECIPP_ALIGNMENT_UWORD 65535 Compu_IDENTITY 0 65535 PHYS_UNIT "Bit Mask" /end CHARACTERISTIC
/begin CHARACTERISTIC FPnd_ERWT1_HiExp1 "FPrm_pending(187)" VALUE 0x001E5288 /* @ECU_Address@FPrm_pending@0x021BE176@ */ ECIPP_ALIGNMENT_UWORD 65535 Compu_IDENTITY 0 65535 PHYS_UNIT "Bit Mask" /end CHARACTERISTIC
/begin CHARACTERISTIC FPnd_ERWT1_HiExp2 "FPrm_pending(188)" VALUE 0x001E528A /* @ECU_Address@FPrm_pending@0x021BE178@ */ ECIPP_ALIGNMENT_UWORD 65535 Compu_IDENTITY 0 65535 PHYS_UNIT "Bit Mask" /end CHARACTERISTIC
/begin CHARACTERISTIC FPnd_ERWT1_maxv "FPrm_pending(185)" VALUE 0x001E5284 /* @ECU_Address@FPrm_pending@0x021BE172@ */ ECIPP_ALIGNMENT_UWORD 65535 Compu_IDENTITY 0 65535 PHYS_UNIT "Bit Mask" /end CHARACTERISTIC
/begin CHARACTERISTIC FPnd_ERWT1_minv "FPrm_pending(186)" VALUE 0x001E5286 /* @ECU_Address@FPrm_pending@0x021BE174@ */ ECIPP_ALIGNMENT_UWORD 65535 Compu_IDENTITY 0 65535 PHYS_UNIT "Bit Mask" /end CHARACTERISTIC
/begin CHARACTERISTIC FPnd_F1OOR_F2IVS "FPrm_pending(138)" VALUE 0x001E5226 /* @ECU_Address@FPrm_pending@0x021BE114@ */ ECIPP_ALIGNMENT_UWORD 65535 Compu_IDENTITY 0 65535 PHYS_UNIT "Bit Mask" /end CHARACTERISTIC
/begin CHARACTERISTIC FPnd_F2OOR_F1IVS "FPrm_pending(139)" VALUE 0x001E5228 /* @ECU_Address@FPrm_pending@0x021BE116@ */ ECIPP_ALIGNMENT_UWORD 65535 Compu_IDENTITY 0 65535 PHYS_UNIT "Bit Mask" /end CHARACTERISTIC
/begin CHARACTERISTIC FPnd_FCoolH2O_lo "FPrm_pending(402)" VALUE 0x001E5436 /* @ECU_Address@FPrm_pending@0x021BE324@ */ ECIPP_ALIGNMENT_UWORD 65535 Compu_IDENTITY 0 65535 PHYS_UNIT "Bit Mask" /end CHARACTERISTIC
/begin CHARACTERISTIC FPnd_FIMP_pct_high "FPrm_pending(204)" VALUE 0x001E52AA /* @ECU_Address@FPrm_pending@0x021BE198@ */ ECIPP_ALIGNMENT_UWORD 65535 Compu_IDENTITY 0 65535 PHYS_UNIT "Bit Mask" /end CHARACTERISTIC
/begin CHARACTERISTIC FPnd_FIP_LoExp "FPrm_pending(525)" VALUE 0x001E552C /* @ECU_Address@FPrm_pending@0x021BE41A@ */ ECIPP_ALIGNMENT_UWORD 65535 Compu_IDENTITY 0 65535 PHYS_UNIT "Bit Mask" /end CHARACTERISTIC
/begin CHARACTERISTIC FPnd_flash_fail "FPrm_pending(69)" VALUE 0x001E519C /* @ECU_Address@FPrm_pending@0x021BE08A@ */ ECIPP_ALIGNMENT_UWORD 65535 Compu_IDENTITY 0 65535 PHYS_UNIT "Bit Mask" /end CHARACTERISTIC
/begin CHARACTERISTIC FPnd_FOP_start "FPrm_pending(712)" VALUE 0x001E56A2 /* @ECU_Address@FPrm_pending@0x021BE590@ */ ECIPP_ALIGNMENT_UWORD 65535 Compu_IDENTITY 0 65535 PHYS_UNIT "Bit Mask" /end CHARACTERISTIC
/begin CHARACTERISTIC FPnd_FP_high "FPrm_pending(212)" VALUE 0x001E52BA /* @ECU_Address@FPrm_pending@0x021BE1A8@ */ ECIPP_ALIGNMENT_UWORD 65535 Compu_IDENTITY 0 65535 PHYS_UNIT "Bit Mask" /end CHARACTERISTIC
/begin CHARACTERISTIC FPnd_FP_low "FPrm_pending(213)" VALUE 0x001E52BC /* @ECU_Address@FPrm_pending@0x021BE1AA@ */ ECIPP_ALIGNMENT_UWORD 65535 Compu_IDENTITY 0 65535 PHYS_UNIT "Bit Mask" /end CHARACTERISTIC
/begin CHARACTERISTIC FPnd_FP_maxv "FPrm_pending(87)" VALUE 0x001E51C0 /* @ECU_Address@FPrm_pending@0x021BE0AE@ */ ECIPP_ALIGNMENT_UWORD 65535 Compu_IDENTITY 0 65535 PHYS_UNIT "Bit Mask" /end CHARACTERISTIC
/begin CHARACTERISTIC FPnd_FP_minv "FPrm_pending(88)" VALUE 0x001E51C2 /* @ECU_Address@FPrm_pending@0x021BE0B0@ */ ECIPP_ALIGNMENT_UWORD 65535 Compu_IDENTITY 0 65535 PHYS_UNIT "Bit Mask" /end CHARACTERISTIC
/begin CHARACTERISTIC FPnd_FP2_high "FPrm_pending(360)" VALUE 0x001E53E2 /* @ECU_Address@FPrm_pending@0x021BE2D0@ */ ECIPP_ALIGNMENT_UWORD 65535 Compu_IDENTITY 0 65535 PHYS_UNIT "Bit Mask" /end CHARACTERISTIC
/begin CHARACTERISTIC FPnd_FP2_low "FPrm_pending(361)" VALUE 0x001E53E4 /* @ECU_Address@FPrm_pending@0x021BE2D2@ */ ECIPP_ALIGNMENT_UWORD 65535 Compu_IDENTITY 0 65535 PHYS_UNIT "Bit Mask" /end CHARACTERISTIC
/begin CHARACTERISTIC FPnd_FP2_maxv "FPrm_pending(358)" VALUE 0x001E53DE /* @ECU_Address@FPrm_pending@0x021BE2CC@ */ ECIPP_ALIGNMENT_UWORD 65535 Compu_IDENTITY 0 65535 PHYS_UNIT "Bit Mask" /end CHARACTERISTIC
/begin CHARACTERISTIC FPnd_FP2_minv "FPrm_pending(359)" VALUE 0x001E53E0 /* @ECU_Address@FPrm_pending@0x021BE2CE@ */ ECIPP_ALIGNMENT_UWORD 65535 Compu_IDENTITY 0 65535 PHYS_UNIT "Bit Mask" /end CHARACTERISTIC
/begin CHARACTERISTIC FPnd_FPD_off_hi "FPrm_pending(58)" VALUE 0x001E5186 /* @ECU_Address@FPrm_pending@0x021BE074@ */ ECIPP_ALIGNMENT_UWORD 65535 Compu_IDENTITY 0 65535 PHYS_UNIT "Bit Mask" /end CHARACTERISTIC
/begin CHARACTERISTIC FPnd_FPD_on_lo "FPrm_pending(57)" VALUE 0x001E5184 /* @ECU_Address@FPrm_pending@0x021BE072@ */ ECIPP_ALIGNMENT_UWORD 65535 Compu_IDENTITY 0 65535 PHYS_UNIT "Bit Mask" /end CHARACTERISTIC
/begin CHARACTERISTIC FPnd_FPlo_derate_actv "FPrm_pending(634)" VALUE 0x001E5606 /* @ECU_Address@FPrm_pending@0x021BE4F4@ */ ECIPP_ALIGNMENT_UWORD 65535 Compu_IDENTITY 0 65535 PHYS_UNIT "Bit Mask" /end CHARACTERISTIC
/begin CHARACTERISTIC FPnd_FPlo_derate_excess "FPrm_pending(637)" VALUE 0x001E560C /* @ECU_Address@FPrm_pending@0x021BE4FA@ */ ECIPP_ALIGNMENT_UWORD 65535 Compu_IDENTITY 0 65535 PHYS_UNIT "Bit Mask" /end CHARACTERISTIC
/begin CHARACTERISTIC FPnd_FPP_NeutLock_fail "FPrm_pending(488)" VALUE 0x001E54E2 /* @ECU_Address@FPrm_pending@0x021BE3D0@ */ ECIPP_ALIGNMENT_UWORD 65535 Compu_IDENTITY 0 65535 PHYS_UNIT "Bit Mask" /end CHARACTERISTIC
/begin CHARACTERISTIC FPnd_FPP1_IVS_max "FPrm_pending(30)" VALUE 0x001E514E /* @ECU_Address@FPrm_pending@0x021BE03C@ */ ECIPP_ALIGNMENT_UWORD 65535 Compu_IDENTITY 0 65535 PHYS_UNIT "Bit Mask" /end CHARACTERISTIC
/begin CHARACTERISTIC FPnd_FPP1_IVS_min "FPrm_pending(31)" VALUE 0x001E5150 /* @ECU_Address@FPrm_pending@0x021BE03E@ */ ECIPP_ALIGNMENT_UWORD 65535 Compu_IDENTITY 0 65535 PHYS_UNIT "Bit Mask" /end CHARACTERISTIC
/begin CHARACTERISTIC FPnd_FPP1_max "FPrm_pending(26)" VALUE 0x001E5146 /* @ECU_Address@FPrm_pending@0x021BE034@ */ ECIPP_ALIGNMENT_UWORD 65535 Compu_IDENTITY 0 65535 PHYS_UNIT "Bit Mask" /end CHARACTERISTIC
/begin CHARACTERISTIC FPnd_FPP1_min "FPrm_pending(27)" VALUE 0x001E5148 /* @ECU_Address@FPrm_pending@0x021BE036@ */ ECIPP_ALIGNMENT_UWORD 65535 Compu_IDENTITY 0 65535 PHYS_UNIT "Bit Mask" /end CHARACTERISTIC
/begin CHARACTERISTIC FPnd_FPP12_IVS_max "FPrm_pending(135)" VALUE 0x001E5220 /* @ECU_Address@FPrm_pending@0x021BE10E@ */ ECIPP_ALIGNMENT_UWORD 65535 Compu_IDENTITY 0 65535 PHYS_UNIT "Bit Mask" /end CHARACTERISTIC
/begin CHARACTERISTIC FPnd_FPP12_IVS_min "FPrm_pending(136)" VALUE 0x001E5222 /* @ECU_Address@FPrm_pending@0x021BE110@ */ ECIPP_ALIGNMENT_UWORD 65535 Compu_IDENTITY 0 65535 PHYS_UNIT "Bit Mask" /end CHARACTERISTIC
/begin CHARACTERISTIC FPnd_FPP12_OOR "FPrm_pending(137)" VALUE 0x001E5224 /* @ECU_Address@FPrm_pending@0x021BE112@ */ ECIPP_ALIGNMENT_UWORD 65535 Compu_IDENTITY 0 65535 PHYS_UNIT "Bit Mask" /end CHARACTERISTIC
/begin CHARACTERISTIC FPnd_FPP12IVS_TSC1 "FPrm_pending(564)" VALUE 0x001E557A /* @ECU_Address@FPrm_pending@0x021BE468@ */ ECIPP_ALIGNMENT_UWORD 65535 Compu_IDENTITY 0 65535 PHYS_UNIT "Bit Mask" /end CHARACTERISTIC
/begin CHARACTERISTIC FPnd_FPP12MM_IVSMM "FPrm_pending(140)" VALUE 0x001E522A /* @ECU_Address@FPrm_pending@0x021BE118@ */ ECIPP_ALIGNMENT_UWORD 65535 Compu_IDENTITY 0 65535 PHYS_UNIT "Bit Mask" /end CHARACTERISTIC
/begin CHARACTERISTIC FPnd_FPP12pct_hi "FPrm_pending(34)" VALUE 0x001E5156 /* @ECU_Address@FPrm_pending@0x021BE044@ */ ECIPP_ALIGNMENT_UWORD 65535 Compu_IDENTITY 0 65535 PHYS_UNIT "Bit Mask" /end CHARACTERISTIC
/begin CHARACTERISTIC FPnd_FPP12pct_lo "FPrm_pending(35)" VALUE 0x001E5158 /* @ECU_Address@FPrm_pending@0x021BE046@ */ ECIPP_ALIGNMENT_UWORD 65535 Compu_IDENTITY 0 65535 PHYS_UNIT "Bit Mask" /end CHARACTERISTIC
/begin CHARACTERISTIC FPnd_FPP2_IVS_max "FPrm_pending(32)" VALUE 0x001E5152 /* @ECU_Address@FPrm_pending@0x021BE040@ */ ECIPP_ALIGNMENT_UWORD 65535 Compu_IDENTITY 0 65535 PHYS_UNIT "Bit Mask" /end CHARACTERISTIC
/begin CHARACTERISTIC FPnd_FPP2_IVS_min "FPrm_pending(33)" VALUE 0x001E5154 /* @ECU_Address@FPrm_pending@0x021BE042@ */ ECIPP_ALIGNMENT_UWORD 65535 Compu_IDENTITY 0 65535 PHYS_UNIT "Bit Mask" /end CHARACTERISTIC
/begin CHARACTERISTIC FPnd_FPP2_max "FPrm_pending(28)" VALUE 0x001E514A /* @ECU_Address@FPrm_pending@0x021BE038@ */ ECIPP_ALIGNMENT_UWORD 65535 Compu_IDENTITY 0 65535 PHYS_UNIT "Bit Mask" /end CHARACTERISTIC
/begin CHARACTERISTIC FPnd_FPP2_min "FPrm_pending(29)" VALUE 0x001E514C /* @ECU_Address@FPrm_pending@0x021BE03A@ */ ECIPP_ALIGNMENT_UWORD 65535 Compu_IDENTITY 0 65535 PHYS_UNIT "Bit Mask" /end CHARACTERISTIC
/begin CHARACTERISTIC FPnd_FPP2V_TSC1 "FPrm_pending(666)" VALUE 0x001E5646 /* @ECU_Address@FPrm_pending@0x021BE534@ */ ECIPP_ALIGNMENT_UWORD 65535 Compu_IDENTITY 0 65535 PHYS_UNIT "Bit Mask" /end CHARACTERISTIC
/begin CHARACTERISTIC FPnd_FPrly_coilopen "FPrm_pending(128)" VALUE 0x001E5212 /* @ECU_Address@FPrm_pending@0x021BE100@ */ ECIPP_ALIGNMENT_UWORD 65535 Compu_IDENTITY 0 65535 PHYS_UNIT "Bit Mask" /end CHARACTERISTIC
/begin CHARACTERISTIC FPsvr_EGRdP_HiExp "FPrm_severity(582)" VALUE 0x001E6A5B /* @ECU_Address@FPrm_severity@0x024B3246@ */ ECIPP_ALIGNMENT_UBYTE 255 Compu_IDENTITY 0 255 PHYS_UNIT "Severity+Class" /end CHARACTERISTIC
/begin CHARACTERISTIC FPsvr_EGRdP_lo_LP_discon "FPrm_severity(693)" VALUE 0x001E6ACA /* @ECU_Address@FPrm_severity@0x024B32B5@ */ ECIPP_ALIGNMENT_UBYTE 255 Compu_IDENTITY 0 255 PHYS_UNIT "Severity+Class" /end CHARACTERISTIC
/begin CHARACTERISTIC FPsvr_EGRdP_lo_reversed "FPrm_severity(692)" VALUE 0x001E6AC9 /* @ECU_Address@FPrm_severity@0x024B32B4@ */ ECIPP_ALIGNMENT_UBYTE 255 Compu_IDENTITY 0 255 PHYS_UNIT "Severity+Class" /end CHARACTERISTIC
/begin CHARACTERISTIC FPsvr_EGRdP_LoExp "FPrm_severity(581)" VALUE 0x001E6A5A /* @ECU_Address@FPrm_severity@0x024B3245@ */ ECIPP_ALIGNMENT_UBYTE 255 Compu_IDENTITY 0 255 PHYS_UNIT "Severity+Class" /end CHARACTERISTIC
/begin CHARACTERISTIC FPsvr_EGRdP_maxv "FPrm_severity(579)" VALUE 0x001E6A58 /* @ECU_Address@FPrm_severity@0x024B3243@ */ ECIPP_ALIGNMENT_UBYTE 255 Compu_IDENTITY 0 255 PHYS_UNIT "Severity+Class" /end CHARACTERISTIC
/begin CHARACTERISTIC FPsvr_EGRdP_minv "FPrm_severity(580)" VALUE 0x001E6A59 /* @ECU_Address@FPrm_severity@0x024B3244@ */ ECIPP_ALIGNMENT_UBYTE 255 Compu_IDENTITY 0 255 PHYS_UNIT "Severity+Class" /end CHARACTERISTIC
/begin CHARACTERISTIC FPsvr_EGRflow_HiExp "FPrm_severity(451)" VALUE 0x001E69D8 /* @ECU_Address@FPrm_severity@0x024B31C3@ */ ECIPP_ALIGNMENT_UBYTE 255 Compu_IDENTITY 0 255 PHYS_UNIT "Severity+Class" /end CHARACTERISTIC
/begin CHARACTERISTIC FPsvr_EGRflow_LoExp "FPrm_severity(450)" VALUE 0x001E69D7 /* @ECU_Address@FPrm_severity@0x024B31C2@ */ ECIPP_ALIGNMENT_UBYTE 255 Compu_IDENTITY 0 255 PHYS_UNIT "Severity+Class" /end CHARACTERISTIC
/begin CHARACTERISTIC FPsvr_EGRflow_LoExp2 "FPrm_severity(514)" VALUE 0x001E6A17 /* @ECU_Address@FPrm_severity@0x024B3202@ */ ECIPP_ALIGNMENT_UBYTE 255 Compu_IDENTITY 0 255 PHYS_UNIT "Severity+Class" /end CHARACTERISTIC
/begin CHARACTERISTIC FPsvr_EGRHP_maxv "FPrm_severity(583)" VALUE 0x001E6A5C /* @ECU_Address@FPrm_severity@0x024B3247@ */ ECIPP_ALIGNMENT_UBYTE 255 Compu_IDENTITY 0 255 PHYS_UNIT "Severity+Class" /end CHARACTERISTIC
/begin CHARACTERISTIC FPsvr_EGRHP_minv "FPrm_severity(584)" VALUE 0x001E6A5D /* @ECU_Address@FPrm_severity@0x024B3248@ */ ECIPP_ALIGNMENT_UBYTE 255 Compu_IDENTITY 0 255 PHYS_UNIT "Severity+Class" /end CHARACTERISTIC
/begin CHARACTERISTIC FPsvr_EGRHP_OOR "FPrm_severity(585)" VALUE 0x001E6A5E /* @ECU_Address@FPrm_severity@0x024B3249@ */ ECIPP_ALIGNMENT_UBYTE 255 Compu_IDENTITY 0 255 PHYS_UNIT "Severity+Class" /end CHARACTERISTIC
/begin CHARACTERISTIC FPsvr_EGRO_postlk "FPrm_severity(628)" VALUE 0x001E6A89 /* @ECU_Address@FPrm_severity@0x024B3274@ */ ECIPP_ALIGNMENT_UBYTE 255 Compu_IDENTITY 0 255 PHYS_UNIT "Severity+Class" /end CHARACTERISTIC
/begin CHARACTERISTIC FPsvr_EGRT_hi "FPrm_severity(524)" VALUE 0x001E6A21 /* @ECU_Address@FPrm_severity@0x024B320C@ */ ECIPP_ALIGNMENT_UBYTE 255 Compu_IDENTITY 0 255 PHYS_UNIT "Severity+Class" /end CHARACTERISTIC
/begin CHARACTERISTIC FPsvr_EGRT_maxv "FPrm_severity(522)" VALUE 0x001E6A1F /* @ECU_Address@FPrm_severity@0x024B320A@ */ ECIPP_ALIGNMENT_UBYTE 255 Compu_IDENTITY 0 255 PHYS_UNIT "Severity+Class" /end CHARACTERISTIC
/begin CHARACTERISTIC FPsvr_EGRT_minv "FPrm_severity(523)" VALUE 0x001E6A20 /* @ECU_Address@FPrm_severity@0x024B320B@ */ ECIPP_ALIGNMENT_UBYTE 255 Compu_IDENTITY 0 255 PHYS_UNIT "Severity+Class" /end CHARACTERISTIC
/begin CHARACTERISTIC FPsvr_EGT_dig_Hi "FPrm_severity(145)" VALUE 0x001E68A6 /* @ECU_Address@FPrm_severity@0x024B3091@ */ ECIPP_ALIGNMENT_UBYTE 255 Compu_IDENTITY 0 255 PHYS_UNIT "Severity+Class" /end CHARACTERISTIC
/begin CHARACTERISTIC FPsvr_EGT_maxv "FPrm_severity(635)" VALUE 0x001E6A90 /* @ECU_Address@FPrm_severity@0x024B327B@ */ ECIPP_ALIGNMENT_UBYTE 255 Compu_IDENTITY 0 255 PHYS_UNIT "Severity+Class" /end CHARACTERISTIC
/begin CHARACTERISTIC FPsvr_EGT_minv "FPrm_severity(636)" VALUE 0x001E6A91 /* @ECU_Address@FPrm_severity@0x024B327C@ */ ECIPP_ALIGNMENT_UBYTE 255 Compu_IDENTITY 0 255 PHYS_UNIT "Severity+Class" /end CHARACTERISTIC
/begin CHARACTERISTIC FPsvr_EMWT1_HiExp1 "FPrm_severity(179)" VALUE 0x001E68C8 /* @ECU_Address@FPrm_severity@0x024B30B3@ */ ECIPP_ALIGNMENT_UBYTE 255 Compu_IDENTITY 0 255 PHYS_UNIT "Severity+Class" /end CHARACTERISTIC
/begin CHARACTERISTIC FPsvr_EMWT1_HiExp2 "FPrm_severity(180)" VALUE 0x001E68C9 /* @ECU_Address@FPrm_severity@0x024B30B4@ */ ECIPP_ALIGNMENT_UBYTE 255 Compu_IDENTITY 0 255 PHYS_UNIT "Severity+Class" /end CHARACTERISTIC
/begin CHARACTERISTIC FPsvr_EMWT1_maxv "FPrm_severity(177)" VALUE 0x001E68C6 /* @ECU_Address@FPrm_severity@0x024B30B1@ */ ECIPP_ALIGNMENT_UBYTE 255 Compu_IDENTITY 0 255 PHYS_UNIT "Severity+Class" /end CHARACTERISTIC
/begin CHARACTERISTIC FPsvr_EMWT1_minv "FPrm_severity(178)" VALUE 0x001E68C7 /* @ECU_Address@FPrm_severity@0x024B30B2@ */ ECIPP_ALIGNMENT_UBYTE 255 Compu_IDENTITY 0 255 PHYS_UNIT "Severity+Class" /end CHARACTERISTIC
/begin CHARACTERISTIC FPsvr_envtech_AAT_inv "FPrm_severity(641)" VALUE 0x001E6A96 /* @ECU_Address@FPrm_severity@0x024B3281@ */ ECIPP_ALIGNMENT_UBYTE 255 Compu_IDENTITY 0 255 PHYS_UNIT "Severity+Class" /end CHARACTERISTIC
/begin CHARACTERISTIC FPsvr_envtech_BP_inv "FPrm_severity(642)" VALUE 0x001E6A97 /* @ECU_Address@FPrm_severity@0x024B3282@ */ ECIPP_ALIGNMENT_UBYTE 255 Compu_IDENTITY 0 255 PHYS_UNIT "Severity+Class" /end CHARACTERISTIC
/begin CHARACTERISTIC FPsvr_envtech_comm "FPrm_severity(267)" VALUE 0x001E6920 /* @ECU_Address@FPrm_severity@0x024B310B@ */ ECIPP_ALIGNMENT_UBYTE 255 Compu_IDENTITY 0 255 PHYS_UNIT "Severity+Class" /end CHARACTERISTIC
/begin CHARACTERISTIC FPsvr_envtech_general "FPrm_severity(644)" VALUE 0x001E6A99 /* @ECU_Address@FPrm_severity@0x024B3284@ */ ECIPP_ALIGNMENT_UBYTE 255 Compu_IDENTITY 0 255 PHYS_UNIT "Severity+Class" /end CHARACTERISTIC
/begin CHARACTERISTIC FPsvr_envtech_RH_inv "FPrm_severity(643)" VALUE 0x001E6A98 /* @ECU_Address@FPrm_severity@0x024B3283@ */ ECIPP_ALIGNMENT_UBYTE 255 Compu_IDENTITY 0 255 PHYS_UNIT "Severity+Class" /end CHARACTERISTIC
/begin CHARACTERISTIC FPsvr_envtech_RH_uns "FPrm_severity(645)" VALUE 0x001E6A9A /* @ECU_Address@FPrm_severity@0x024B3285@ */ ECIPP_ALIGNMENT_UBYTE 255 Compu_IDENTITY 0 255 PHYS_UNIT "Severity+Class" /end CHARACTERISTIC
/begin CHARACTERISTIC FPsvr_ERCV_speed_OOR "FPrm_severity(680)" VALUE 0x001E6ABD /* @ECU_Address@FPrm_severity@0x024B32A8@ */ ECIPP_ALIGNMENT_UBYTE 255 Compu_IDENTITY 0 255 PHYS_UNIT "Severity+Class" /end CHARACTERISTIC
/begin CHARACTERISTIC FPsvr_ERWT1_HiExp1 "FPrm_severity(187)" VALUE 0x001E68D0 /* @ECU_Address@FPrm_severity@0x024B30BB@ */ ECIPP_ALIGNMENT_UBYTE 255 Compu_IDENTITY 0 255 PHYS_UNIT "Severity+Class" /end CHARACTERISTIC
/begin CHARACTERISTIC FPsvr_ERWT1_HiExp2 "FPrm_severity(188)" VALUE 0x001E68D1 /* @ECU_Address@FPrm_severity@0x024B30BC@ */ ECIPP_ALIGNMENT_UBYTE 255 Compu_IDENTITY 0 255 PHYS_UNIT "Severity+Class" /end CHARACTERISTIC
/begin CHARACTERISTIC FPsvr_ERWT1_maxv "FPrm_severity(185)" VALUE 0x001E68CE /* @ECU_Address@FPrm_severity@0x024B30B9@ */ ECIPP_ALIGNMENT_UBYTE 255 Compu_IDENTITY 0 255 PHYS_UNIT "Severity+Class" /end CHARACTERISTIC
/begin CHARACTERISTIC FPsvr_ERWT1_minv "FPrm_severity(186)" VALUE 0x001E68CF /* @ECU_Address@FPrm_severity@0x024B30BA@ */ ECIPP_ALIGNMENT_UBYTE 255 Compu_IDENTITY 0 255 PHYS_UNIT "Severity+Class" /end CHARACTERISTIC
/begin CHARACTERISTIC FPsvr_F1OOR_F2IVS "FPrm_severity(138)" VALUE 0x001E689F /* @ECU_Address@FPrm_severity@0x024B308A@ */ ECIPP_ALIGNMENT_UBYTE 255 Compu_IDENTITY 0 255 PHYS_UNIT "Severity+Class" /end CHARACTERISTIC
/begin CHARACTERISTIC FPsvr_F2OOR_F1IVS "FPrm_severity(139)" VALUE 0x001E68A0 /* @ECU_Address@FPrm_severity@0x024B308B@ */ ECIPP_ALIGNMENT_UBYTE 255 Compu_IDENTITY 0 255 PHYS_UNIT "Severity+Class" /end CHARACTERISTIC
/begin CHARACTERISTIC FPsvr_FCoolH2O_lo "FPrm_severity(402)" VALUE 0x001E69A7 /* @ECU_Address@FPrm_severity@0x024B3192@ */ ECIPP_ALIGNMENT_UBYTE 255 Compu_IDENTITY 0 255 PHYS_UNIT "Severity+Class" /end CHARACTERISTIC
/begin CHARACTERISTIC FPsvr_FIMP_pct_high "FPrm_severity(204)" VALUE 0x001E68E1 /* @ECU_Address@FPrm_severity@0x024B30CC@ */ ECIPP_ALIGNMENT_UBYTE 255 Compu_IDENTITY 0 255 PHYS_UNIT "Severity+Class" /end CHARACTERISTIC
/begin CHARACTERISTIC FPsvr_FIP_LoExp "FPrm_severity(525)" VALUE 0x001E6A22 /* @ECU_Address@FPrm_severity@0x024B320D@ */ ECIPP_ALIGNMENT_UBYTE 255 Compu_IDENTITY 0 255 PHYS_UNIT "Severity+Class" /end CHARACTERISTIC
/begin CHARACTERISTIC FPsvr_flash_fail "FPrm_severity(69)" VALUE 0x001E685A /* @ECU_Address@FPrm_severity@0x024B3045@ */ ECIPP_ALIGNMENT_UBYTE 255 Compu_IDENTITY 0 255 PHYS_UNIT "Severity+Class" /end CHARACTERISTIC
/begin CHARACTERISTIC FPsvr_FOP_start "FPrm_severity(712)" VALUE 0x001E6ADD /* @ECU_Address@FPrm_severity@0x024B32C8@ */ ECIPP_ALIGNMENT_UBYTE 255 Compu_IDENTITY 0 255 PHYS_UNIT "Severity+Class" /end CHARACTERISTIC
/begin CHARACTERISTIC FPsvr_FP_high "FPrm_severity(212)" VALUE 0x001E68E9 /* @ECU_Address@FPrm_severity@0x024B30D4@ */ ECIPP_ALIGNMENT_UBYTE 255 Compu_IDENTITY 0 255 PHYS_UNIT "Severity+Class" /end CHARACTERISTIC
/begin CHARACTERISTIC FPsvr_FP_low "FPrm_severity(213)" VALUE 0x001E68EA /* @ECU_Address@FPrm_severity@0x024B30D5@ */ ECIPP_ALIGNMENT_UBYTE 255 Compu_IDENTITY 0 255 PHYS_UNIT "Severity+Class" /end CHARACTERISTIC
/begin CHARACTERISTIC FPsvr_FP_maxv "FPrm_severity(87)" VALUE 0x001E686C /* @ECU_Address@FPrm_severity@0x024B3057@ */ ECIPP_ALIGNMENT_UBYTE 255 Compu_IDENTITY 0 255 PHYS_UNIT "Severity+Class" /end CHARACTERISTIC
/begin CHARACTERISTIC FPsvr_FP_minv "FPrm_severity(88)" VALUE 0x001E686D /* @ECU_Address@FPrm_severity@0x024B3058@ */ ECIPP_ALIGNMENT_UBYTE 255 Compu_IDENTITY 0 255 PHYS_UNIT "Severity+Class" /end CHARACTERISTIC
/begin CHARACTERISTIC FPsvr_FP2_high "FPrm_severity(360)" VALUE 0x001E697D /* @ECU_Address@FPrm_severity@0x024B3168@ */ ECIPP_ALIGNMENT_UBYTE 255 Compu_IDENTITY 0 255 PHYS_UNIT "Severity+Class" /end CHARACTERISTIC
/begin CHARACTERISTIC FPsvr_FP2_low "FPrm_severity(361)" VALUE 0x001E697E /* @ECU_Address@FPrm_severity@0x024B3169@ */ ECIPP_ALIGNMENT_UBYTE 255 Compu_IDENTITY 0 255 PHYS_UNIT "Severity+Class" /end CHARACTERISTIC
/begin CHARACTERISTIC FPsvr_FP2_maxv "FPrm_severity(358)" VALUE 0x001E697B /* @ECU_Address@FPrm_severity@0x024B3166@ */ ECIPP_ALIGNMENT_UBYTE 255 Compu_IDENTITY 0 255 PHYS_UNIT "Severity+Class" /end CHARACTERISTIC
/begin CHARACTERISTIC FPsvr_FP2_minv "FPrm_severity(359)" VALUE 0x001E697C /* @ECU_Address@FPrm_severity@0x024B3167@ */ ECIPP_ALIGNMENT_UBYTE 255 Compu_IDENTITY 0 255 PHYS_UNIT "Severity+Class" /end CHARACTERISTIC
/begin CHARACTERISTIC FPsvr_FPD_off_hi "FPrm_severity(58)" VALUE 0x001E684F /* @ECU_Address@FPrm_severity@0x024B303A@ */ ECIPP_ALIGNMENT_UBYTE 255 Compu_IDENTITY 0 255 PHYS_UNIT "Severity+Class" /end CHARACTERISTIC
/begin CHARACTERISTIC FPsvr_FPD_on_lo "FPrm_severity(57)" VALUE 0x001E684E /* @ECU_Address@FPrm_severity@0x024B3039@ */ ECIPP_ALIGNMENT_UBYTE 255 Compu_IDENTITY 0 255 PHYS_UNIT "Severity+Class" /end CHARACTERISTIC
/begin CHARACTERISTIC FPsvr_FPlo_derate_actv "FPrm_severity(634)" VALUE 0x001E6A8F /* @ECU_Address@FPrm_severity@0x024B327A@ */ ECIPP_ALIGNMENT_UBYTE 255 Compu_IDENTITY 0 255 PHYS_UNIT "Severity+Class" /end CHARACTERISTIC
/begin CHARACTERISTIC FPsvr_FPlo_derate_excess "FPrm_severity(637)" VALUE 0x001E6A92 /* @ECU_Address@FPrm_severity@0x024B327D@ */ ECIPP_ALIGNMENT_UBYTE 255 Compu_IDENTITY 0 255 PHYS_UNIT "Severity+Class" /end CHARACTERISTIC
/begin CHARACTERISTIC FPsvr_FPP_NeutLock_fail "FPrm_severity(488)" VALUE 0x001E69FD /* @ECU_Address@FPrm_severity@0x024B31E8@ */ ECIPP_ALIGNMENT_UBYTE 255 Compu_IDENTITY 0 255 PHYS_UNIT "Severity+Class" /end CHARACTERISTIC
/begin CHARACTERISTIC FPsvr_FPP1_IVS_max "FPrm_severity(30)" VALUE 0x001E6833 /* @ECU_Address@FPrm_severity@0x024B301E@ */ ECIPP_ALIGNMENT_UBYTE 255 Compu_IDENTITY 0 255 PHYS_UNIT "Severity+Class" /end CHARACTERISTIC
/begin CHARACTERISTIC FPsvr_FPP1_IVS_min "FPrm_severity(31)" VALUE 0x001E6834 /* @ECU_Address@FPrm_severity@0x024B301F@ */ ECIPP_ALIGNMENT_UBYTE 255 Compu_IDENTITY 0 255 PHYS_UNIT "Severity+Class" /end CHARACTERISTIC
/begin CHARACTERISTIC FPsvr_FPP1_max "FPrm_severity(26)" VALUE 0x001E682F /* @ECU_Address@FPrm_severity@0x024B301A@ */ ECIPP_ALIGNMENT_UBYTE 255 Compu_IDENTITY 0 255 PHYS_UNIT "Severity+Class" /end CHARACTERISTIC
/begin CHARACTERISTIC FPsvr_FPP1_min "FPrm_severity(27)" VALUE 0x001E6830 /* @ECU_Address@FPrm_severity@0x024B301B@ */ ECIPP_ALIGNMENT_UBYTE 255 Compu_IDENTITY 0 255 PHYS_UNIT "Severity+Class" /end CHARACTERISTIC
/begin CHARACTERISTIC FPsvr_FPP12_IVS_max "FPrm_severity(135)" VALUE 0x001E689C /* @ECU_Address@FPrm_severity@0x024B3087@ */ ECIPP_ALIGNMENT_UBYTE 255 Compu_IDENTITY 0 255 PHYS_UNIT "Severity+Class" /end CHARACTERISTIC
/begin CHARACTERISTIC FPsvr_FPP12_IVS_min "FPrm_severity(136)" VALUE 0x001E689D /* @ECU_Address@FPrm_severity@0x024B3088@ */ ECIPP_ALIGNMENT_UBYTE 255 Compu_IDENTITY 0 255 PHYS_UNIT "Severity+Class" /end CHARACTERISTIC
/begin CHARACTERISTIC FPsvr_FPP12_OOR "FPrm_severity(137)" VALUE 0x001E689E /* @ECU_Address@FPrm_severity@0x024B3089@ */ ECIPP_ALIGNMENT_UBYTE 255 Compu_IDENTITY 0 255 PHYS_UNIT "Severity+Class" /end CHARACTERISTIC
/begin CHARACTERISTIC FPsvr_FPP12IVS_TSC1 "FPrm_severity(564)" VALUE 0x001E6A49 /* @ECU_Address@FPrm_severity@0x024B3234@ */ ECIPP_ALIGNMENT_UBYTE 255 Compu_IDENTITY 0 255 PHYS_UNIT "Severity+Class" /end CHARACTERISTIC
/begin CHARACTERISTIC FPsvr_FPP12MM_IVSMM "FPrm_severity(140)" VALUE 0x001E68A1 /* @ECU_Address@FPrm_severity@0x024B308C@ */ ECIPP_ALIGNMENT_UBYTE 255 Compu_IDENTITY 0 255 PHYS_UNIT "Severity+Class" /end CHARACTERISTIC
/begin CHARACTERISTIC FPsvr_FPP12pct_hi "FPrm_severity(34)" VALUE 0x001E6837 /* @ECU_Address@FPrm_severity@0x024B3022@ */ ECIPP_ALIGNMENT_UBYTE 255 Compu_IDENTITY 0 255 PHYS_UNIT "Severity+Class" /end CHARACTERISTIC
/begin CHARACTERISTIC FPsvr_FPP12pct_lo "FPrm_severity(35)" VALUE 0x001E6838 /* @ECU_Address@FPrm_severity@0x024B3023@ */ ECIPP_ALIGNMENT_UBYTE 255 Compu_IDENTITY 0 255 PHYS_UNIT "Severity+Class" /end CHARACTERISTIC
/begin CHARACTERISTIC FPsvr_FPP2_IVS_max "FPrm_severity(32)" VALUE 0x001E6835 /* @ECU_Address@FPrm_severity@0x024B3020@ */ ECIPP_ALIGNMENT_UBYTE 255 Compu_IDENTITY 0 255 PHYS_UNIT "Severity+Class" /end CHARACTERISTIC
/begin CHARACTERISTIC FPsvr_FPP2_IVS_min "FPrm_severity(33)" VALUE 0x001E6836 /* @ECU_Address@FPrm_severity@0x024B3021@ */ ECIPP_ALIGNMENT_UBYTE 255 Compu_IDENTITY 0 255 PHYS_UNIT "Severity+Class" /end CHARACTERISTIC
/begin CHARACTERISTIC FPsvr_FPP2_max "FPrm_severity(28)" VALUE 0x001E6831 /* @ECU_Address@FPrm_severity@0x024B301C@ */ ECIPP_ALIGNMENT_UBYTE 255 Compu_IDENTITY 0 255 PHYS_UNIT "Severity+Class" /end CHARACTERISTIC
/begin CHARACTERISTIC FPsvr_FPP2_min "FPrm_severity(29)" VALUE 0x001E6832 /* @ECU_Address@FPrm_severity@0x024B301D@ */ ECIPP_ALIGNMENT_UBYTE 255 Compu_IDENTITY 0 255 PHYS_UNIT "Severity+Class" /end CHARACTERISTIC
/begin CHARACTERISTIC FPsvr_FPP2V_TSC1 "FPrm_severity(666)" VALUE 0x001E6AAF /* @ECU_Address@FPrm_severity@0x024B329A@ */ ECIPP_ALIGNMENT_UBYTE 255 Compu_IDENTITY 0 255 PHYS_UNIT "Severity+Class" /end CHARACTERISTIC
/begin CHARACTERISTIC FPsvr_FPrly_coilopen "FPrm_severity(128)" VALUE 0x001E6895 /* @ECU_Address@FPrm_severity@0x024B3080@ */ ECIPP_ALIGNMENT_UBYTE 255 Compu_IDENTITY 0 255 PHYS_UNIT "Severity+Class" /end CHARACTERISTIC
/begin CHARACTERISTIC FPsw_EGRdP_HiExp "FPrm_switches(582)" VALUE 0x001C7466 /* @ECU_Address@FPrm_switches@0x021B948C@ */ ECIPP_ALIGNMENT_UWORD 65535 Compu_IDENTITY 0 65535 PHYS_UNIT "Enable bits" /end CHARACTERISTIC
/begin CHARACTERISTIC FPsw_EGRdP_lo_LP_discon "FPrm_switches(693)" VALUE 0x001C7544 /* @ECU_Address@FPrm_switches@0x021B956A@ */ ECIPP_ALIGNMENT_UWORD 65535 Compu_IDENTITY 0 65535 PHYS_UNIT "Enable bits" /end CHARACTERISTIC
/begin CHARACTERISTIC FPsw_EGRdP_lo_reversed "FPrm_switches(692)" VALUE 0x001C7542 /* @ECU_Address@FPrm_switches@0x021B9568@ */ ECIPP_ALIGNMENT_UWORD 65535 Compu_IDENTITY 0 65535 PHYS_UNIT "Enable bits" /end CHARACTERISTIC
/begin CHARACTERISTIC FPsw_EGRdP_LoExp "FPrm_switches(581)" VALUE 0x001C7464 /* @ECU_Address@FPrm_switches@0x021B948A@ */ ECIPP_ALIGNMENT_UWORD 65535 Compu_IDENTITY 0 65535 PHYS_UNIT "Enable bits" /end CHARACTERISTIC
/begin CHARACTERISTIC FPsw_EGRdP_maxv "FPrm_switches(579)" VALUE 0x001C7460 /* @ECU_Address@FPrm_switches@0x021B9486@ */ ECIPP_ALIGNMENT_UWORD 65535 Compu_IDENTITY 0 65535 PHYS_UNIT "Enable bits" /end CHARACTERISTIC
/begin CHARACTERISTIC FPsw_EGRdP_minv "FPrm_switches(580)" VALUE 0x001C7462 /* @ECU_Address@FPrm_switches@0x021B9488@ */ ECIPP_ALIGNMENT_UWORD 65535 Compu_IDENTITY 0 65535 PHYS_UNIT "Enable bits" /end CHARACTERISTIC
/begin CHARACTERISTIC FPsw_EGRflow_HiExp "FPrm_switches(451)" VALUE 0x001C7360 /* @ECU_Address@FPrm_switches@0x021B9386@ */ ECIPP_ALIGNMENT_UWORD 65535 Compu_IDENTITY 0 65535 PHYS_UNIT "Enable bits" /end CHARACTERISTIC
/begin CHARACTERISTIC FPsw_EGRflow_LoExp "FPrm_switches(450)" VALUE 0x001C735E /* @ECU_Address@FPrm_switches@0x021B9384@ */ ECIPP_ALIGNMENT_UWORD 65535 Compu_IDENTITY 0 65535 PHYS_UNIT "Enable bits" /end CHARACTERISTIC
/begin CHARACTERISTIC FPsw_EGRflow_LoExp2 "FPrm_switches(514)" VALUE 0x001C73DE /* @ECU_Address@FPrm_switches@0x021B9404@ */ ECIPP_ALIGNMENT_UWORD 65535 Compu_IDENTITY 0 65535 PHYS_UNIT "Enable bits" /end CHARACTERISTIC
/begin CHARACTERISTIC FPsw_EGRHP_maxv "FPrm_switches(583)" VALUE 0x001C7468 /* @ECU_Address@FPrm_switches@0x021B948E@ */ ECIPP_ALIGNMENT_UWORD 65535 Compu_IDENTITY 0 65535 PHYS_UNIT "Enable bits" /end CHARACTERISTIC
/begin CHARACTERISTIC FPsw_EGRHP_minv "FPrm_switches(584)" VALUE 0x001C746A /* @ECU_Address@FPrm_switches@0x021B9490@ */ ECIPP_ALIGNMENT_UWORD 65535 Compu_IDENTITY 0 65535 PHYS_UNIT "Enable bits" /end CHARACTERISTIC
/begin CHARACTERISTIC FPsw_EGRHP_OOR "FPrm_switches(585)" VALUE 0x001C746C /* @ECU_Address@FPrm_switches@0x021B9492@ */ ECIPP_ALIGNMENT_UWORD 65535 Compu_IDENTITY 0 65535 PHYS_UNIT "Enable bits" /end CHARACTERISTIC
/begin CHARACTERISTIC FPsw_EGRO_postlk "FPrm_switches(628)" VALUE 0x001C74C2 /* @ECU_Address@FPrm_switches@0x021B94E8@ */ ECIPP_ALIGNMENT_UWORD 65535 Compu_IDENTITY 0 65535 PHYS_UNIT "Enable bits" /end CHARACTERISTIC
/begin CHARACTERISTIC FPsw_EGRT_hi "FPrm_switches(524)" VALUE 0x001C73F2 /* @ECU_Address@FPrm_switches@0x021B9418@ */ ECIPP_ALIGNMENT_UWORD 65535 Compu_IDENTITY 0 65535 PHYS_UNIT "Enable bits" /end CHARACTERISTIC
/begin CHARACTERISTIC FPsw_EGRT_maxv "FPrm_switches(522)" VALUE 0x001C73EE /* @ECU_Address@FPrm_switches@0x021B9414@ */ ECIPP_ALIGNMENT_UWORD 65535 Compu_IDENTITY 0 65535 PHYS_UNIT "Enable bits" /end CHARACTERISTIC
/begin CHARACTERISTIC FPsw_EGRT_minv "FPrm_switches(523)" VALUE 0x001C73F0 /* @ECU_Address@FPrm_switches@0x021B9416@ */ ECIPP_ALIGNMENT_UWORD 65535 Compu_IDENTITY 0 65535 PHYS_UNIT "Enable bits" /end CHARACTERISTIC
/begin CHARACTERISTIC FPsw_EGT_dig_Hi "FPrm_switches(145)" VALUE 0x001C70FC /* @ECU_Address@FPrm_switches@0x021B9122@ */ ECIPP_ALIGNMENT_UWORD 65535 Compu_IDENTITY 0 65535 PHYS_UNIT "Enable bits" /end CHARACTERISTIC
/begin CHARACTERISTIC FPsw_EGT_maxv "FPrm_switches(635)" VALUE 0x001C74D0 /* @ECU_Address@FPrm_switches@0x021B94F6@ */ ECIPP_ALIGNMENT_UWORD 65535 Compu_IDENTITY 0 65535 PHYS_UNIT "Enable bits" /end CHARACTERISTIC
/begin CHARACTERISTIC FPsw_EGT_minv "FPrm_switches(636)" VALUE 0x001C74D2 /* @ECU_Address@FPrm_switches@0x021B94F8@ */ ECIPP_ALIGNMENT_UWORD 65535 Compu_IDENTITY 0 65535 PHYS_UNIT "Enable bits" /end CHARACTERISTIC
/begin CHARACTERISTIC FPsw_EMWT1_HiExp1 "FPrm_switches(179)" VALUE 0x001C7140 /* @ECU_Address@FPrm_switches@0x021B9166@ */ ECIPP_ALIGNMENT_UWORD 65535 Compu_IDENTITY 0 65535 PHYS_UNIT "Enable bits" /end CHARACTERISTIC
/begin CHARACTERISTIC FPsw_EMWT1_HiExp2 "FPrm_switches(180)" VALUE 0x001C7142 /* @ECU_Address@FPrm_switches@0x021B9168@ */ ECIPP_ALIGNMENT_UWORD 65535 Compu_IDENTITY 0 65535 PHYS_UNIT "Enable bits" /end CHARACTERISTIC
/begin CHARACTERISTIC FPsw_EMWT1_maxv "FPrm_switches(177)" VALUE 0x001C713C /* @ECU_Address@FPrm_switches@0x021B9162@ */ ECIPP_ALIGNMENT_UWORD 65535 Compu_IDENTITY 0 65535 PHYS_UNIT "Enable bits" /end CHARACTERISTIC
/begin CHARACTERISTIC FPsw_EMWT1_minv "FPrm_switches(178)" VALUE 0x001C713E /* @ECU_Address@FPrm_switches@0x021B9164@ */ ECIPP_ALIGNMENT_UWORD 65535 Compu_IDENTITY 0 65535 PHYS_UNIT "Enable bits" /end CHARACTERISTIC
/begin CHARACTERISTIC FPsw_envtech_AAT_inv "FPrm_switches(641)" VALUE 0x001C74DC /* @ECU_Address@FPrm_switches@0x021B9502@ */ ECIPP_ALIGNMENT_UWORD 65535 Compu_IDENTITY 0 65535 PHYS_UNIT "Enable bits" /end CHARACTERISTIC
/begin CHARACTERISTIC FPsw_envtech_BP_inv "FPrm_switches(642)" VALUE 0x001C74DE /* @ECU_Address@FPrm_switches@0x021B9504@ */ ECIPP_ALIGNMENT_UWORD 65535 Compu_IDENTITY 0 65535 PHYS_UNIT "Enable bits" /end CHARACTERISTIC
/begin CHARACTERISTIC FPsw_envtech_comm "FPrm_switches(267)" VALUE 0x001C71F0 /* @ECU_Address@FPrm_switches@0x021B9216@ */ ECIPP_ALIGNMENT_UWORD 65535 Compu_IDENTITY 0 65535 PHYS_UNIT "Enable bits" /end CHARACTERISTIC
/begin CHARACTERISTIC FPsw_envtech_general "FPrm_switches(644)" VALUE 0x001C74E2 /* @ECU_Address@FPrm_switches@0x021B9508@ */ ECIPP_ALIGNMENT_UWORD 65535 Compu_IDENTITY 0 65535 PHYS_UNIT "Enable bits" /end CHARACTERISTIC
/begin CHARACTERISTIC FPsw_envtech_RH_inv "FPrm_switches(643)" VALUE 0x001C74E0 /* @ECU_Address@FPrm_switches@0x021B9506@ */ ECIPP_ALIGNMENT_UWORD 65535 Compu_IDENTITY 0 65535 PHYS_UNIT "Enable bits" /end CHARACTERISTIC
/begin CHARACTERISTIC FPsw_envtech_RH_uns "FPrm_switches(645)" VALUE 0x001C74E4 /* @ECU_Address@FPrm_switches@0x021B950A@ */ ECIPP_ALIGNMENT_UWORD 65535 Compu_IDENTITY 0 65535 PHYS_UNIT "Enable bits" /end CHARACTERISTIC
/begin CHARACTERISTIC FPsw_ERCV_speed_OOR "FPrm_switches(680)" VALUE 0x001C752A /* @ECU_Address@FPrm_switches@0x021B9550@ */ ECIPP_ALIGNMENT_UWORD 65535 Compu_IDENTITY 0 65535 PHYS_UNIT "Enable bits" /end CHARACTERISTIC
/begin CHARACTERISTIC FPsw_ERWT1_HiExp1 "FPrm_switches(187)" VALUE 0x001C7150 /* @ECU_Address@FPrm_switches@0x021B9176@ */ ECIPP_ALIGNMENT_UWORD 65535 Compu_IDENTITY 0 65535 PHYS_UNIT "Enable bits" /end CHARACTERISTIC
/begin CHARACTERISTIC FPsw_ERWT1_HiExp2 "FPrm_switches(188)" VALUE 0x001C7152 /* @ECU_Address@FPrm_switches@0x021B9178@ */ ECIPP_ALIGNMENT_UWORD 65535 Compu_IDENTITY 0 65535 PHYS_UNIT "Enable bits" /end CHARACTERISTIC
/begin CHARACTERISTIC FPsw_ERWT1_maxv "FPrm_switches(185)" VALUE 0x001C714C /* @ECU_Address@FPrm_switches@0x021B9172@ */ ECIPP_ALIGNMENT_UWORD 65535 Compu_IDENTITY 0 65535 PHYS_UNIT "Enable bits" /end CHARACTERISTIC
/begin CHARACTERISTIC FPsw_ERWT1_minv "FPrm_switches(186)" VALUE 0x001C714E /* @ECU_Address@FPrm_switches@0x021B9174@ */ ECIPP_ALIGNMENT_UWORD 65535 Compu_IDENTITY 0 65535 PHYS_UNIT "Enable bits" /end CHARACTERISTIC
/begin CHARACTERISTIC FPsw_ext1_EGRdP_HiExp "FPrm_switches_ext1(582)" VALUE 0x001C7A0A /* @ECU_Address@FPrm_switches_ext1@0x023A548C@ */ ECIPP_ALIGNMENT_UWORD 65535 Compu_IDENTITY 0 65535 PHYS_UNIT "Enable bits" /end CHARACTERISTIC
/begin CHARACTERISTIC FPsw_ext1_EGRdP_lo_LP_discon "FPrm_switches_ext1(693)" VALUE 0x001C7AE8 /* @ECU_Address@FPrm_switches_ext1@0x023A556A@ */ ECIPP_ALIGNMENT_UWORD 65535 Compu_IDENTITY 0 65535 PHYS_UNIT "Enable bits" /end CHARACTERISTIC
/begin CHARACTERISTIC FPsw_ext1_EGRdP_lo_reversed "FPrm_switches_ext1(692)" VALUE 0x001C7AE6 /* @ECU_Address@FPrm_switches_ext1@0x023A5568@ */ ECIPP_ALIGNMENT_UWORD 65535 Compu_IDENTITY 0 65535 PHYS_UNIT "Enable bits" /end CHARACTERISTIC
/begin CHARACTERISTIC FPsw_ext1_EGRdP_LoExp "FPrm_switches_ext1(581)" VALUE 0x001C7A08 /* @ECU_Address@FPrm_switches_ext1@0x023A548A@ */ ECIPP_ALIGNMENT_UWORD 65535 Compu_IDENTITY 0 65535 PHYS_UNIT "Enable bits" /end CHARACTERISTIC
/begin CHARACTERISTIC FPsw_ext1_EGRdP_maxv "FPrm_switches_ext1(579)" VALUE 0x001C7A04 /* @ECU_Address@FPrm_switches_ext1@0x023A5486@ */ ECIPP_ALIGNMENT_UWORD 65535 Compu_IDENTITY 0 65535 PHYS_UNIT "Enable bits" /end CHARACTERISTIC
/begin CHARACTERISTIC FPsw_ext1_EGRdP_minv "FPrm_switches_ext1(580)" VALUE 0x001C7A06 /* @ECU_Address@FPrm_switches_ext1@0x023A5488@ */ ECIPP_ALIGNMENT_UWORD 65535 Compu_IDENTITY 0 65535 PHYS_UNIT "Enable bits" /end CHARACTERISTIC
/begin CHARACTERISTIC FPsw_ext1_EGRflow_HiExp "FPrm_switches_ext1(451)" VALUE 0x001C7904 /* @ECU_Address@FPrm_switches_ext1@0x023A5386@ */ ECIPP_ALIGNMENT_UWORD 65535 Compu_IDENTITY 0 65535 PHYS_UNIT "Enable bits" /end CHARACTERISTIC
/begin CHARACTERISTIC FPsw_ext1_EGRflow_LoExp "FPrm_switches_ext1(450)" VALUE 0x001C7902 /* @ECU_Address@FPrm_switches_ext1@0x023A5384@ */ ECIPP_ALIGNMENT_UWORD 65535 Compu_IDENTITY 0 65535 PHYS_UNIT "Enable bits" /end CHARACTERISTIC
/begin CHARACTERISTIC FPsw_ext1_EGRflow_LoExp2 "FPrm_switches_ext1(514)" VALUE 0x001C7982 /* @ECU_Address@FPrm_switches_ext1@0x023A5404@ */ ECIPP_ALIGNMENT_UWORD 65535 Compu_IDENTITY 0 65535 PHYS_UNIT "Enable bits" /end CHARACTERISTIC
/begin CHARACTERISTIC FPsw_ext1_EGRHP_maxv "FPrm_switches_ext1(583)" VALUE 0x001C7A0C /* @ECU_Address@FPrm_switches_ext1@0x023A548E@ */ ECIPP_ALIGNMENT_UWORD 65535 Compu_IDENTITY 0 65535 PHYS_UNIT "Enable bits" /end CHARACTERISTIC
/begin CHARACTERISTIC FPsw_ext1_EGRHP_minv "FPrm_switches_ext1(584)" VALUE 0x001C7A0E /* @ECU_Address@FPrm_switches_ext1@0x023A5490@ */ ECIPP_ALIGNMENT_UWORD 65535 Compu_IDENTITY 0 65535 PHYS_UNIT "Enable bits" /end CHARACTERISTIC
/begin CHARACTERISTIC FPsw_ext1_EGRHP_OOR "FPrm_switches_ext1(585)" VALUE 0x001C7A10 /* @ECU_Address@FPrm_switches_ext1@0x023A5492@ */ ECIPP_ALIGNMENT_UWORD 65535 Compu_IDENTITY 0 65535 PHYS_UNIT "Enable bits" /end CHARACTERISTIC
/begin CHARACTERISTIC FPsw_ext1_EGRO_postlk "FPrm_switches_ext1(628)" VALUE 0x001C7A66 /* @ECU_Address@FPrm_switches_ext1@0x023A54E8@ */ ECIPP_ALIGNMENT_UWORD 65535 Compu_IDENTITY 0 65535 PHYS_UNIT "Enable bits" /end CHARACTERISTIC
/begin CHARACTERISTIC FPsw_ext1_EGRT_hi "FPrm_switches_ext1(524)" VALUE 0x001C7996 /* @ECU_Address@FPrm_switches_ext1@0x023A5418@ */ ECIPP_ALIGNMENT_UWORD 65535 Compu_IDENTITY 0 65535 PHYS_UNIT "Enable bits" /end CHARACTERISTIC
/begin CHARACTERISTIC FPsw_ext1_EGRT_maxv "FPrm_switches_ext1(522)" VALUE 0x001C7992 /* @ECU_Address@FPrm_switches_ext1@0x023A5414@ */ ECIPP_ALIGNMENT_UWORD 65535 Compu_IDENTITY 0 65535 PHYS_UNIT "Enable bits" /end CHARACTERISTIC
/begin CHARACTERISTIC FPsw_ext1_EGRT_minv "FPrm_switches_ext1(523)" VALUE 0x001C7994 /* @ECU_Address@FPrm_switches_ext1@0x023A5416@ */ ECIPP_ALIGNMENT_UWORD 65535 Compu_IDENTITY 0 65535 PHYS_UNIT "Enable bits" /end CHARACTERISTIC
/begin CHARACTERISTIC FPsw_ext1_EGT_dig_Hi "FPrm_switches_ext1(145)" VALUE 0x001C76A0 /* @ECU_Address@FPrm_switches_ext1@0x023A5122@ */ ECIPP_ALIGNMENT_UWORD 65535 Compu_IDENTITY 0 65535 PHYS_UNIT "Enable bits" /end CHARACTERISTIC
/begin CHARACTERISTIC FPsw_ext1_EGT_maxv "FPrm_switches_ext1(635)" VALUE 0x001C7A74 /* @ECU_Address@FPrm_switches_ext1@0x023A54F6@ */ ECIPP_ALIGNMENT_UWORD 65535 Compu_IDENTITY 0 65535 PHYS_UNIT "Enable bits" /end CHARACTERISTIC
/begin CHARACTERISTIC FPsw_ext1_EGT_minv "FPrm_switches_ext1(636)" VALUE 0x001C7A76 /* @ECU_Address@FPrm_switches_ext1@0x023A54F8@ */ ECIPP_ALIGNMENT_UWORD 65535 Compu_IDENTITY 0 65535 PHYS_UNIT "Enable bits" /end CHARACTERISTIC
/begin CHARACTERISTIC FPsw_ext1_EMWT1_HiExp1 "FPrm_switches_ext1(179)" VALUE 0x001C76E4 /* @ECU_Address@FPrm_switches_ext1@0x023A5166@ */ ECIPP_ALIGNMENT_UWORD 65535 Compu_IDENTITY 0 65535 PHYS_UNIT "Enable bits" /end CHARACTERISTIC
/begin CHARACTERISTIC FPsw_ext1_EMWT1_HiExp2 "FPrm_switches_ext1(180)" VALUE 0x001C76E6 /* @ECU_Address@FPrm_switches_ext1@0x023A5168@ */ ECIPP_ALIGNMENT_UWORD 65535 Compu_IDENTITY 0 65535 PHYS_UNIT "Enable bits" /end CHARACTERISTIC
/begin CHARACTERISTIC FPsw_ext1_EMWT1_maxv "FPrm_switches_ext1(177)" VALUE 0x001C76E0 /* @ECU_Address@FPrm_switches_ext1@0x023A5162@ */ ECIPP_ALIGNMENT_UWORD 65535 Compu_IDENTITY 0 65535 PHYS_UNIT "Enable bits" /end CHARACTERISTIC
/begin CHARACTERISTIC FPsw_ext1_EMWT1_minv "FPrm_switches_ext1(178)" VALUE 0x001C76E2 /* @ECU_Address@FPrm_switches_ext1@0x023A5164@ */ ECIPP_ALIGNMENT_UWORD 65535 Compu_IDENTITY 0 65535 PHYS_UNIT "Enable bits" /end CHARACTERISTIC
/begin CHARACTERISTIC FPsw_ext1_envtech_AAT_inv "FPrm_switches_ext1(641)" VALUE 0x001C7A80 /* @ECU_Address@FPrm_switches_ext1@0x023A5502@ */ ECIPP_ALIGNMENT_UWORD 65535 Compu_IDENTITY 0 65535 PHYS_UNIT "Enable bits" /end CHARACTERISTIC
/begin CHARACTERISTIC FPsw_ext1_envtech_BP_inv "FPrm_switches_ext1(642)" VALUE 0x001C7A82 /* @ECU_Address@FPrm_switches_ext1@0x023A5504@ */ ECIPP_ALIGNMENT_UWORD 65535 Compu_IDENTITY 0 65535 PHYS_UNIT "Enable bits" /end CHARACTERISTIC
/begin CHARACTERISTIC FPsw_ext1_envtech_comm "FPrm_switches_ext1(267)" VALUE 0x001C7794 /* @ECU_Address@FPrm_switches_ext1@0x023A5216@ */ ECIPP_ALIGNMENT_UWORD 65535 Compu_IDENTITY 0 65535 PHYS_UNIT "Enable bits" /end CHARACTERISTIC
/begin CHARACTERISTIC FPsw_ext1_envtech_general "FPrm_switches_ext1(644)" VALUE 0x001C7A86 /* @ECU_Address@FPrm_switches_ext1@0x023A5508@ */ ECIPP_ALIGNMENT_UWORD 65535 Compu_IDENTITY 0 65535 PHYS_UNIT "Enable bits" /end CHARACTERISTIC
/begin CHARACTERISTIC FPsw_ext1_envtech_RH_inv "FPrm_switches_ext1(643)" VALUE 0x001C7A84 /* @ECU_Address@FPrm_switches_ext1@0x023A5506@ */ ECIPP_ALIGNMENT_UWORD 65535 Compu_IDENTITY 0 65535 PHYS_UNIT "Enable bits" /end CHARACTERISTIC
/begin CHARACTERISTIC FPsw_ext1_envtech_RH_uns "FPrm_switches_ext1(645)" VALUE 0x001C7A88 /* @ECU_Address@FPrm_switches_ext1@0x023A550A@ */ ECIPP_ALIGNMENT_UWORD 65535 Compu_IDENTITY 0 65535 PHYS_UNIT "Enable bits" /end CHARACTERISTIC
/begin CHARACTERISTIC FPsw_ext1_ERCV_speed_OOR "FPrm_switches_ext1(680)" VALUE 0x001C7ACE /* @ECU_Address@FPrm_switches_ext1@0x023A5550@ */ ECIPP_ALIGNMENT_UWORD 65535 Compu_IDENTITY 0 65535 PHYS_UNIT "Enable bits" /end CHARACTERISTIC
/begin CHARACTERISTIC FPsw_ext1_ERWT1_HiExp1 "FPrm_switches_ext1(187)" VALUE 0x001C76F4 /* @ECU_Address@FPrm_switches_ext1@0x023A5176@ */ ECIPP_ALIGNMENT_UWORD 65535 Compu_IDENTITY 0 65535 PHYS_UNIT "Enable bits" /end CHARACTERISTIC
/begin CHARACTERISTIC FPsw_ext1_ERWT1_HiExp2 "FPrm_switches_ext1(188)" VALUE 0x001C76F6 /* @ECU_Address@FPrm_switches_ext1@0x023A5178@ */ ECIPP_ALIGNMENT_UWORD 65535 Compu_IDENTITY 0 65535 PHYS_UNIT "Enable bits" /end CHARACTERISTIC
/begin CHARACTERISTIC FPsw_ext1_ERWT1_maxv "FPrm_switches_ext1(185)" VALUE 0x001C76F0 /* @ECU_Address@FPrm_switches_ext1@0x023A5172@ */ ECIPP_ALIGNMENT_UWORD 65535 Compu_IDENTITY 0 65535 PHYS_UNIT "Enable bits" /end CHARACTERISTIC
/begin CHARACTERISTIC FPsw_ext1_ERWT1_minv "FPrm_switches_ext1(186)" VALUE 0x001C76F2 /* @ECU_Address@FPrm_switches_ext1@0x023A5174@ */ ECIPP_ALIGNMENT_UWORD 65535 Compu_IDENTITY 0 65535 PHYS_UNIT "Enable bits" /end CHARACTERISTIC
/begin CHARACTERISTIC FPsw_ext1_F1OOR_F2IVS "FPrm_switches_ext1(138)" VALUE 0x001C7692 /* @ECU_Address@FPrm_switches_ext1@0x023A5114@ */ ECIPP_ALIGNMENT_UWORD 65535 Compu_IDENTITY 0 65535 PHYS_UNIT "Enable bits" /end CHARACTERISTIC
/begin CHARACTERISTIC FPsw_ext1_F2OOR_F1IVS "FPrm_switches_ext1(139)" VALUE 0x001C7694 /* @ECU_Address@FPrm_switches_ext1@0x023A5116@ */ ECIPP_ALIGNMENT_UWORD 65535 Compu_IDENTITY 0 65535 PHYS_UNIT "Enable bits" /end CHARACTERISTIC
/begin CHARACTERISTIC FPsw_ext1_FCoolH2O_lo "FPrm_switches_ext1(402)" VALUE 0x001C78A2 /* @ECU_Address@FPrm_switches_ext1@0x023A5324@ */ ECIPP_ALIGNMENT_UWORD 65535 Compu_IDENTITY 0 65535 PHYS_UNIT "Enable bits" /end CHARACTERISTIC
/begin CHARACTERISTIC FPsw_ext1_FIMP_pct_high "FPrm_switches_ext1(204)" VALUE 0x001C7716 /* @ECU_Address@FPrm_switches_ext1@0x023A5198@ */ ECIPP_ALIGNMENT_UWORD 65535 Compu_IDENTITY 0 65535 PHYS_UNIT "Enable bits" /end CHARACTERISTIC
/begin CHARACTERISTIC FPsw_ext1_FIP_LoExp "FPrm_switches_ext1(525)" VALUE 0x001C7998 /* @ECU_Address@FPrm_switches_ext1@0x023A541A@ */ ECIPP_ALIGNMENT_UWORD 65535 Compu_IDENTITY 0 65535 PHYS_UNIT "Enable bits" /end CHARACTERISTIC
/begin CHARACTERISTIC FPsw_ext1_flash_fail "FPrm_switches_ext1(69)" VALUE 0x001C7608 /* @ECU_Address@FPrm_switches_ext1@0x023A508A@ */ ECIPP_ALIGNMENT_UWORD 65535 Compu_IDENTITY 0 65535 PHYS_UNIT "Enable bits" /end CHARACTERISTIC
/begin CHARACTERISTIC FPsw_ext1_FOP_start "FPrm_switches_ext1(712)" VALUE 0x001C7B0E /* @ECU_Address@FPrm_switches_ext1@0x023A5590@ */ ECIPP_ALIGNMENT_UWORD 65535 Compu_IDENTITY 0 65535 PHYS_UNIT "Enable bits" /end CHARACTERISTIC
/begin CHARACTERISTIC FPsw_ext1_FP_high "FPrm_switches_ext1(212)" VALUE 0x001C7726 /* @ECU_Address@FPrm_switches_ext1@0x023A51A8@ */ ECIPP_ALIGNMENT_UWORD 65535 Compu_IDENTITY 0 65535 PHYS_UNIT "Enable bits" /end CHARACTERISTIC
/begin CHARACTERISTIC FPsw_ext1_FP_low "FPrm_switches_ext1(213)" VALUE 0x001C7728 /* @ECU_Address@FPrm_switches_ext1@0x023A51AA@ */ ECIPP_ALIGNMENT_UWORD 65535 Compu_IDENTITY 0 65535 PHYS_UNIT "Enable bits" /end CHARACTERISTIC
/begin CHARACTERISTIC FPsw_ext1_FP_maxv "FPrm_switches_ext1(87)" VALUE 0x001C762C /* @ECU_Address@FPrm_switches_ext1@0x023A50AE@ */ ECIPP_ALIGNMENT_UWORD 65535 Compu_IDENTITY 0 65535 PHYS_UNIT "Enable bits" /end CHARACTERISTIC
/begin CHARACTERISTIC FPsw_ext1_FP_minv "FPrm_switches_ext1(88)" VALUE 0x001C762E /* @ECU_Address@FPrm_switches_ext1@0x023A50B0@ */ ECIPP_ALIGNMENT_UWORD 65535 Compu_IDENTITY 0 65535 PHYS_UNIT "Enable bits" /end CHARACTERISTIC
/begin CHARACTERISTIC FPsw_ext1_FP2_high "FPrm_switches_ext1(360)" VALUE 0x001C784E /* @ECU_Address@FPrm_switches_ext1@0x023A52D0@ */ ECIPP_ALIGNMENT_UWORD 65535 Compu_IDENTITY 0 65535 PHYS_UNIT "Enable bits" /end CHARACTERISTIC
/begin CHARACTERISTIC FPsw_ext1_FP2_low "FPrm_switches_ext1(361)" VALUE 0x001C7850 /* @ECU_Address@FPrm_switches_ext1@0x023A52D2@ */ ECIPP_ALIGNMENT_UWORD 65535 Compu_IDENTITY 0 65535 PHYS_UNIT "Enable bits" /end CHARACTERISTIC
/begin CHARACTERISTIC FPsw_ext1_FP2_maxv "FPrm_switches_ext1(358)" VALUE 0x001C784A /* @ECU_Address@FPrm_switches_ext1@0x023A52CC@ */ ECIPP_ALIGNMENT_UWORD 65535 Compu_IDENTITY 0 65535 PHYS_UNIT "Enable bits" /end CHARACTERISTIC
/begin CHARACTERISTIC FPsw_ext1_FP2_minv "FPrm_switches_ext1(359)" VALUE 0x001C784C /* @ECU_Address@FPrm_switches_ext1@0x023A52CE@ */ ECIPP_ALIGNMENT_UWORD 65535 Compu_IDENTITY 0 65535 PHYS_UNIT "Enable bits" /end CHARACTERISTIC
/begin CHARACTERISTIC FPsw_ext1_FPD_off_hi "FPrm_switches_ext1(58)" VALUE 0x001C75F2 /* @ECU_Address@FPrm_switches_ext1@0x023A5074@ */ ECIPP_ALIGNMENT_UWORD 65535 Compu_IDENTITY 0 65535 PHYS_UNIT "Enable bits" /end CHARACTERISTIC
/begin CHARACTERISTIC FPsw_ext1_FPD_on_lo "FPrm_switches_ext1(57)" VALUE 0x001C75F0 /* @ECU_Address@FPrm_switches_ext1@0x023A5072@ */ ECIPP_ALIGNMENT_UWORD 65535 Compu_IDENTITY 0 65535 PHYS_UNIT "Enable bits" /end CHARACTERISTIC
/begin CHARACTERISTIC FPsw_ext1_FPlo_derate_actv "FPrm_switches_ext1(634)" VALUE 0x001C7A72 /* @ECU_Address@FPrm_switches_ext1@0x023A54F4@ */ ECIPP_ALIGNMENT_UWORD 65535 Compu_IDENTITY 0 65535 PHYS_UNIT "Enable bits" /end CHARACTERISTIC
/begin CHARACTERISTIC FPsw_ext1_FPlo_derate_excess "FPrm_switches_ext1(637)" VALUE 0x001C7A78 /* @ECU_Address@FPrm_switches_ext1@0x023A54FA@ */ ECIPP_ALIGNMENT_UWORD 65535 Compu_IDENTITY 0 65535 PHYS_UNIT "Enable bits" /end CHARACTERISTIC
/begin CHARACTERISTIC FPsw_ext1_FPP_NeutLock_fail "FPrm_switches_ext1(488)" VALUE 0x001C794E /* @ECU_Address@FPrm_switches_ext1@0x023A53D0@ */ ECIPP_ALIGNMENT_UWORD 65535 Compu_IDENTITY 0 65535 PHYS_UNIT "Enable bits" /end CHARACTERISTIC
/begin CHARACTERISTIC FPsw_ext1_FPP1_IVS_max "FPrm_switches_ext1(30)" VALUE 0x001C75BA /* @ECU_Address@FPrm_switches_ext1@0x023A503C@ */ ECIPP_ALIGNMENT_UWORD 65535 Compu_IDENTITY 0 65535 PHYS_UNIT "Enable bits" /end CHARACTERISTIC
/begin CHARACTERISTIC FPsw_ext1_FPP1_IVS_min "FPrm_switches_ext1(31)" VALUE 0x001C75BC /* @ECU_Address@FPrm_switches_ext1@0x023A503E@ */ ECIPP_ALIGNMENT_UWORD 65535 Compu_IDENTITY 0 65535 PHYS_UNIT "Enable bits" /end CHARACTERISTIC
/begin CHARACTERISTIC FPsw_ext1_FPP1_max "FPrm_switches_ext1(26)" VALUE 0x001C75B2 /* @ECU_Address@FPrm_switches_ext1@0x023A5034@ */ ECIPP_ALIGNMENT_UWORD 65535 Compu_IDENTITY 0 65535 PHYS_UNIT "Enable bits" /end CHARACTERISTIC
/begin CHARACTERISTIC FPsw_ext1_FPP1_min "FPrm_switches_ext1(27)" VALUE 0x001C75B4 /* @ECU_Address@FPrm_switches_ext1@0x023A5036@ */ ECIPP_ALIGNMENT_UWORD 65535 Compu_IDENTITY 0 65535 PHYS_UNIT "Enable bits" /end CHARACTERISTIC
/begin CHARACTERISTIC FPsw_ext1_FPP12_IVS_max "FPrm_switches_ext1(135)" VALUE 0x001C768C /* @ECU_Address@FPrm_switches_ext1@0x023A510E@ */ ECIPP_ALIGNMENT_UWORD 65535 Compu_IDENTITY 0 65535 PHYS_UNIT "Enable bits" /end CHARACTERISTIC
/begin CHARACTERISTIC FPsw_ext1_FPP12_IVS_min "FPrm_switches_ext1(136)" VALUE 0x001C768E /* @ECU_Address@FPrm_switches_ext1@0x023A5110@ */ ECIPP_ALIGNMENT_UWORD 65535 Compu_IDENTITY 0 65535 PHYS_UNIT "Enable bits" /end CHARACTERISTIC
/begin CHARACTERISTIC FPsw_ext1_FPP12_OOR "FPrm_switches_ext1(137)" VALUE 0x001C7690 /* @ECU_Address@FPrm_switches_ext1@0x023A5112@ */ ECIPP_ALIGNMENT_UWORD 65535 Compu_IDENTITY 0 65535 PHYS_UNIT "Enable bits" /end CHARACTERISTIC
/begin CHARACTERISTIC FPsw_ext1_FPP12IVS_TSC1 "FPrm_switches_ext1(564)" VALUE 0x001C79E6 /* @ECU_Address@FPrm_switches_ext1@0x023A5468@ */ ECIPP_ALIGNMENT_UWORD 65535 Compu_IDENTITY 0 65535 PHYS_UNIT "Enable bits" /end CHARACTERISTIC
/begin CHARACTERISTIC FPsw_ext1_FPP12MM_IVSMM "FPrm_switches_ext1(140)" VALUE 0x001C7696 /* @ECU_Address@FPrm_switches_ext1@0x023A5118@ */ ECIPP_ALIGNMENT_UWORD 65535 Compu_IDENTITY 0 65535 PHYS_UNIT "Enable bits" /end CHARACTERISTIC
/begin CHARACTERISTIC FPsw_ext1_FPP12pct_hi "FPrm_switches_ext1(34)" VALUE 0x001C75C2 /* @ECU_Address@FPrm_switches_ext1@0x023A5044@ */ ECIPP_ALIGNMENT_UWORD 65535 Compu_IDENTITY 0 65535 PHYS_UNIT "Enable bits" /end CHARACTERISTIC
/begin CHARACTERISTIC FPsw_ext1_FPP12pct_lo "FPrm_switches_ext1(35)" VALUE 0x001C75C4 /* @ECU_Address@FPrm_switches_ext1@0x023A5046@ */ ECIPP_ALIGNMENT_UWORD 65535 Compu_IDENTITY 0 65535 PHYS_UNIT "Enable bits" /end CHARACTERISTIC
/begin CHARACTERISTIC FPsw_ext1_FPP2_IVS_max "FPrm_switches_ext1(32)" VALUE 0x001C75BE /* @ECU_Address@FPrm_switches_ext1@0x023A5040@ */ ECIPP_ALIGNMENT_UWORD 65535 Compu_IDENTITY 0 65535 PHYS_UNIT "Enable bits" /end CHARACTERISTIC
/begin CHARACTERISTIC FPsw_ext1_FPP2_IVS_min "FPrm_switches_ext1(33)" VALUE 0x001C75C0 /* @ECU_Address@FPrm_switches_ext1@0x023A5042@ */ ECIPP_ALIGNMENT_UWORD 65535 Compu_IDENTITY 0 65535 PHYS_UNIT "Enable bits" /end CHARACTERISTIC
/begin CHARACTERISTIC FPsw_ext1_FPP2_max "FPrm_switches_ext1(28)" VALUE 0x001C75B6 /* @ECU_Address@FPrm_switches_ext1@0x023A5038@ */ ECIPP_ALIGNMENT_UWORD 65535 Compu_IDENTITY 0 65535 PHYS_UNIT "Enable bits" /end CHARACTERISTIC
/begin CHARACTERISTIC FPsw_ext1_FPP2_min "FPrm_switches_ext1(29)" VALUE 0x001C75B8 /* @ECU_Address@FPrm_switches_ext1@0x023A503A@ */ ECIPP_ALIGNMENT_UWORD 65535 Compu_IDENTITY 0 65535 PHYS_UNIT "Enable bits" /end CHARACTERISTIC
/begin CHARACTERISTIC FPsw_ext1_FPP2V_TSC1 "FPrm_switches_ext1(666)" VALUE 0x001C7AB2 /* @ECU_Address@FPrm_switches_ext1@0x023A5534@ */ ECIPP_ALIGNMENT_UWORD 65535 Compu_IDENTITY 0 65535 PHYS_UNIT "Enable bits" /end CHARACTERISTIC
/begin CHARACTERISTIC FPsw_ext1_FPrly_coilopen "FPrm_switches_ext1(128)" VALUE 0x001C767E /* @ECU_Address@FPrm_switches_ext1@0x023A5100@ */ ECIPP_ALIGNMENT_UWORD 65535 Compu_IDENTITY 0 65535 PHYS_UNIT "Enable bits" /end CHARACTERISTIC
/begin CHARACTERISTIC FPsw_F1OOR_F2IVS "FPrm_switches(138)" VALUE 0x001C70EE /* @ECU_Address@FPrm_switches@0x021B9114@ */ ECIPP_ALIGNMENT_UWORD 65535 Compu_IDENTITY 0 65535 PHYS_UNIT "Enable bits" /end CHARACTERISTIC
/begin CHARACTERISTIC FPsw_F2OOR_F1IVS "FPrm_switches(139)" VALUE 0x001C70F0 /* @ECU_Address@FPrm_switches@0x021B9116@ */ ECIPP_ALIGNMENT_UWORD 65535 Compu_IDENTITY 0 65535 PHYS_UNIT "Enable bits" /end CHARACTERISTIC
/begin CHARACTERISTIC FPsw_FCoolH2O_lo "FPrm_switches(402)" VALUE 0x001C72FE /* @ECU_Address@FPrm_switches@0x021B9324@ */ ECIPP_ALIGNMENT_UWORD 65535 Compu_IDENTITY 0 65535 PHYS_UNIT "Enable bits" /end CHARACTERISTIC
/begin CHARACTERISTIC FPsw_FIMP_pct_high "FPrm_switches(204)" VALUE 0x001C7172 /* @ECU_Address@FPrm_switches@0x021B9198@ */ ECIPP_ALIGNMENT_UWORD 65535 Compu_IDENTITY 0 65535 PHYS_UNIT "Enable bits" /end CHARACTERISTIC
/begin CHARACTERISTIC FPsw_FIP_LoExp "FPrm_switches(525)" VALUE 0x001C73F4 /* @ECU_Address@FPrm_switches@0x021B941A@ */ ECIPP_ALIGNMENT_UWORD 65535 Compu_IDENTITY 0 65535 PHYS_UNIT "Enable bits" /end CHARACTERISTIC
/begin CHARACTERISTIC FPsw_flash_fail "FPrm_switches(69)" VALUE 0x001C7064 /* @ECU_Address@FPrm_switches@0x021B908A@ */ ECIPP_ALIGNMENT_UWORD 65535 Compu_IDENTITY 0 65535 PHYS_UNIT "Enable bits" /end CHARACTERISTIC
/begin CHARACTERISTIC FPsw_FOP_start "FPrm_switches(712)" VALUE 0x001C756A /* @ECU_Address@FPrm_switches@0x021B9590@ */ ECIPP_ALIGNMENT_UWORD 65535 Compu_IDENTITY 0 65535 PHYS_UNIT "Enable bits" /end CHARACTERISTIC
/begin CHARACTERISTIC FPsw_FP_high "FPrm_switches(212)" VALUE 0x001C7182 /* @ECU_Address@FPrm_switches@0x021B91A8@ */ ECIPP_ALIGNMENT_UWORD 65535 Compu_IDENTITY 0 65535 PHYS_UNIT "Enable bits" /end CHARACTERISTIC
/begin CHARACTERISTIC FPsw_FP_low "FPrm_switches(213)" VALUE 0x001C7184 /* @ECU_Address@FPrm_switches@0x021B91AA@ */ ECIPP_ALIGNMENT_UWORD 65535 Compu_IDENTITY 0 65535 PHYS_UNIT "Enable bits" /end CHARACTERISTIC
/begin CHARACTERISTIC FPsw_FP_maxv "FPrm_switches(87)" VALUE 0x001C7088 /* @ECU_Address@FPrm_switches@0x021B90AE@ */ ECIPP_ALIGNMENT_UWORD 65535 Compu_IDENTITY 0 65535 PHYS_UNIT "Enable bits" /end CHARACTERISTIC
/begin CHARACTERISTIC FPsw_FP_minv "FPrm_switches(88)" VALUE 0x001C708A /* @ECU_Address@FPrm_switches@0x021B90B0@ */ ECIPP_ALIGNMENT_UWORD 65535 Compu_IDENTITY 0 65535 PHYS_UNIT "Enable bits" /end CHARACTERISTIC
/begin CHARACTERISTIC FPsw_FP2_high "FPrm_switches(360)" VALUE 0x001C72AA /* @ECU_Address@FPrm_switches@0x021B92D0@ */ ECIPP_ALIGNMENT_UWORD 65535 Compu_IDENTITY 0 65535 PHYS_UNIT "Enable bits" /end CHARACTERISTIC
/begin CHARACTERISTIC FPsw_FP2_low "FPrm_switches(361)" VALUE 0x001C72AC /* @ECU_Address@FPrm_switches@0x021B92D2@ */ ECIPP_ALIGNMENT_UWORD 65535 Compu_IDENTITY 0 65535 PHYS_UNIT "Enable bits" /end CHARACTERISTIC
/begin CHARACTERISTIC FPsw_FP2_maxv "FPrm_switches(358)" VALUE 0x001C72A6 /* @ECU_Address@FPrm_switches@0x021B92CC@ */ ECIPP_ALIGNMENT_UWORD 65535 Compu_IDENTITY 0 65535 PHYS_UNIT "Enable bits" /end CHARACTERISTIC
/begin CHARACTERISTIC FPsw_FP2_minv "FPrm_switches(359)" VALUE 0x001C72A8 /* @ECU_Address@FPrm_switches@0x021B92CE@ */ ECIPP_ALIGNMENT_UWORD 65535 Compu_IDENTITY 0 65535 PHYS_UNIT "Enable bits" /end CHARACTERISTIC
/begin CHARACTERISTIC FPsw_FPD_off_hi "FPrm_switches(58)" VALUE 0x001C704E /* @ECU_Address@FPrm_switches@0x021B9074@ */ ECIPP_ALIGNMENT_UWORD 65535 Compu_IDENTITY 0 65535 PHYS_UNIT "Enable bits" /end CHARACTERISTIC
/begin CHARACTERISTIC FPsw_FPD_on_lo "FPrm_switches(57)" VALUE 0x001C704C /* @ECU_Address@FPrm_switches@0x021B9072@ */ ECIPP_ALIGNMENT_UWORD 65535 Compu_IDENTITY 0 65535 PHYS_UNIT "Enable bits" /end CHARACTERISTIC
/begin CHARACTERISTIC FPsw_FPlo_derate_actv "FPrm_switches(634)" VALUE 0x001C74CE /* @ECU_Address@FPrm_switches@0x021B94F4@ */ ECIPP_ALIGNMENT_UWORD 65535 Compu_IDENTITY 0 65535 PHYS_UNIT "Enable bits" /end CHARACTERISTIC
/begin CHARACTERISTIC FPsw_FPlo_derate_excess "FPrm_switches(637)" VALUE 0x001C74D4 /* @ECU_Address@FPrm_switches@0x021B94FA@ */ ECIPP_ALIGNMENT_UWORD 65535 Compu_IDENTITY 0 65535 PHYS_UNIT "Enable bits" /end CHARACTERISTIC
/begin CHARACTERISTIC FPsw_FPP_NeutLock_fail "FPrm_switches(488)" VALUE 0x001C73AA /* @ECU_Address@FPrm_switches@0x021B93D0@ */ ECIPP_ALIGNMENT_UWORD 65535 Compu_IDENTITY 0 65535 PHYS_UNIT "Enable bits" /end CHARACTERISTIC
/begin CHARACTERISTIC FPsw_FPP1_IVS_max "FPrm_switches(30)" VALUE 0x001C7016 /* @ECU_Address@FPrm_switches@0x021B903C@ */ ECIPP_ALIGNMENT_UWORD 65535 Compu_IDENTITY 0 65535 PHYS_UNIT "Enable bits" /end CHARACTERISTIC
/begin CHARACTERISTIC FPsw_FPP1_IVS_min "FPrm_switches(31)" VALUE 0x001C7018 /* @ECU_Address@FPrm_switches@0x021B903E@ */ ECIPP_ALIGNMENT_UWORD 65535 Compu_IDENTITY 0 65535 PHYS_UNIT "Enable bits" /end CHARACTERISTIC
/begin CHARACTERISTIC FPsw_FPP1_max "FPrm_switches(26)" VALUE 0x001C700E /* @ECU_Address@FPrm_switches@0x021B9034@ */ ECIPP_ALIGNMENT_UWORD 65535 Compu_IDENTITY 0 65535 PHYS_UNIT "Enable bits" /end CHARACTERISTIC
/begin CHARACTERISTIC FPsw_FPP1_min "FPrm_switches(27)" VALUE 0x001C7010 /* @ECU_Address@FPrm_switches@0x021B9036@ */ ECIPP_ALIGNMENT_UWORD 65535 Compu_IDENTITY 0 65535 PHYS_UNIT "Enable bits" /end CHARACTERISTIC
/begin CHARACTERISTIC FPsw_FPP12_IVS_max "FPrm_switches(135)" VALUE 0x001C70E8 /* @ECU_Address@FPrm_switches@0x021B910E@ */ ECIPP_ALIGNMENT_UWORD 65535 Compu_IDENTITY 0 65535 PHYS_UNIT "Enable bits" /end CHARACTERISTIC
/begin CHARACTERISTIC FPsw_FPP12_IVS_min "FPrm_switches(136)" VALUE 0x001C70EA /* @ECU_Address@FPrm_switches@0x021B9110@ */ ECIPP_ALIGNMENT_UWORD 65535 Compu_IDENTITY 0 65535 PHYS_UNIT "Enable bits" /end CHARACTERISTIC
/begin CHARACTERISTIC FPsw_FPP12_OOR "FPrm_switches(137)" VALUE 0x001C70EC /* @ECU_Address@FPrm_switches@0x021B9112@ */ ECIPP_ALIGNMENT_UWORD 65535 Compu_IDENTITY 0 65535 PHYS_UNIT "Enable bits" /end CHARACTERISTIC
/begin CHARACTERISTIC FPsw_FPP12IVS_TSC1 "FPrm_switches(564)" VALUE 0x001C7442 /* @ECU_Address@FPrm_switches@0x021B9468@ */ ECIPP_ALIGNMENT_UWORD 65535 Compu_IDENTITY 0 65535 PHYS_UNIT "Enable bits" /end CHARACTERISTIC
/begin CHARACTERISTIC FPsw_FPP12MM_IVSMM "FPrm_switches(140)" VALUE 0x001C70F2 /* @ECU_Address@FPrm_switches@0x021B9118@ */ ECIPP_ALIGNMENT_UWORD 65535 Compu_IDENTITY 0 65535 PHYS_UNIT "Enable bits" /end CHARACTERISTIC
/begin CHARACTERISTIC FPsw_FPP12pct_hi "FPrm_switches(34)" VALUE 0x001C701E /* @ECU_Address@FPrm_switches@0x021B9044@ */ ECIPP_ALIGNMENT_UWORD 65535 Compu_IDENTITY 0 65535 PHYS_UNIT "Enable bits" /end CHARACTERISTIC
/begin CHARACTERISTIC FPsw_FPP12pct_lo "FPrm_switches(35)" VALUE 0x001C7020 /* @ECU_Address@FPrm_switches@0x021B9046@ */ ECIPP_ALIGNMENT_UWORD 65535 Compu_IDENTITY 0 65535 PHYS_UNIT "Enable bits" /end CHARACTERISTIC
/begin CHARACTERISTIC FPsw_FPP2_IVS_max "FPrm_switches(32)" VALUE 0x001C701A /* @ECU_Address@FPrm_switches@0x021B9040@ */ ECIPP_ALIGNMENT_UWORD 65535 Compu_IDENTITY 0 65535 PHYS_UNIT "Enable bits" /end CHARACTERISTIC
/begin CHARACTERISTIC FPsw_FPP2_IVS_min "FPrm_switches(33)" VALUE 0x001C701C /* @ECU_Address@FPrm_switches@0x021B9042@ */ ECIPP_ALIGNMENT_UWORD 65535 Compu_IDENTITY 0 65535 PHYS_UNIT "Enable bits" /end CHARACTERISTIC
/begin CHARACTERISTIC FPsw_FPP2_max "FPrm_switches(28)" VALUE 0x001C7012 /* @ECU_Address@FPrm_switches@0x021B9038@ */ ECIPP_ALIGNMENT_UWORD 65535 Compu_IDENTITY 0 65535 PHYS_UNIT "Enable bits" /end CHARACTERISTIC
/begin CHARACTERISTIC FPsw_FPP2_min "FPrm_switches(29)" VALUE 0x001C7014 /* @ECU_Address@FPrm_switches@0x021B903A@ */ ECIPP_ALIGNMENT_UWORD 65535 Compu_IDENTITY 0 65535 PHYS_UNIT "Enable bits" /end CHARACTERISTIC
/begin CHARACTERISTIC FPsw_FPP2V_TSC1 "FPrm_switches(666)" VALUE 0x001C750E /* @ECU_Address@FPrm_switches@0x021B9534@ */ ECIPP_ALIGNMENT_UWORD 65535 Compu_IDENTITY 0 65535 PHYS_UNIT "Enable bits" /end CHARACTERISTIC
/begin CHARACTERISTIC FPsw_FPrly_coilopen "FPrm_switches(128)" VALUE 0x001C70DA /* @ECU_Address@FPrm_switches@0x021B9100@ */ ECIPP_ALIGNMENT_UWORD 65535 Compu_IDENTITY 0 65535 PHYS_UNIT "Enable bits" /end CHARACTERISTIC
/begin CHARACTERISTIC FCdtc_EGRdP_HiExp "FCtl_DTC(752)" VALUE 0x001E3E4A /* @ECU_Address@FCtl_DTC@0x021B55E0@ */ ECIPP_ALIGNMENT_UWORD 65535 Compu_IDENTITY 0 65535 PHYS_UNIT "DTC" /end CHARACTERISTIC
/begin CHARACTERISTIC FCdtc_EGRdP_lo_LP_discon "FCtl_DTC(866)" VALUE 0x001E3F2E /* @ECU_Address@FCtl_DTC@0x021B56C4@ */ ECIPP_ALIGNMENT_UWORD 65535 Compu_IDENTITY 0 65535 PHYS_UNIT "DTC" /end CHARACTERISTIC
/begin CHARACTERISTIC FCdtc_EGRdP_lo_reversed "FCtl_DTC(865)" VALUE 0x001E3F2C /* @ECU_Address@FCtl_DTC@0x021B56C2@ */ ECIPP_ALIGNMENT_UWORD 65535 Compu_IDENTITY 0 65535 PHYS_UNIT "DTC" /end CHARACTERISTIC
/begin CHARACTERISTIC FCdtc_EGRdP_LoExp "FCtl_DTC(751)" VALUE 0x001E3E48 /* @ECU_Address@FCtl_DTC@0x021B55DE@ */ ECIPP_ALIGNMENT_UWORD 65535 Compu_IDENTITY 0 65535 PHYS_UNIT "DTC" /end CHARACTERISTIC
/begin CHARACTERISTIC FCdtc_EGRdP_maxv "FCtl_DTC(749)" VALUE 0x001E3E44 /* @ECU_Address@FCtl_DTC@0x021B55DA@ */ ECIPP_ALIGNMENT_UWORD 65535 Compu_IDENTITY 0 65535 PHYS_UNIT "DTC" /end CHARACTERISTIC
/begin CHARACTERISTIC FCdtc_EGRdP_minv "FCtl_DTC(750)" VALUE 0x001E3E46 /* @ECU_Address@FCtl_DTC@0x021B55DC@ */ ECIPP_ALIGNMENT_UWORD 65535 Compu_IDENTITY 0 65535 PHYS_UNIT "DTC" /end CHARACTERISTIC
/begin CHARACTERISTIC FCdtc_EGRflow_HiExp "FCtl_DTC(597)" VALUE 0x001E3D14 /* @ECU_Address@FCtl_DTC@0x021B54AA@ */ ECIPP_ALIGNMENT_UWORD 65535 Compu_IDENTITY 0 65535 PHYS_UNIT "DTC" /end CHARACTERISTIC
/begin CHARACTERISTIC FCdtc_EGRflow_LoExp "FCtl_DTC(596)" VALUE 0x001E3D12 /* @ECU_Address@FCtl_DTC@0x021B54A8@ */ ECIPP_ALIGNMENT_UWORD 65535 Compu_IDENTITY 0 65535 PHYS_UNIT "DTC" /end CHARACTERISTIC
/begin CHARACTERISTIC FCdtc_EGRflow_LoExp2 "FCtl_DTC(684)" VALUE 0x001E3DC2 /* @ECU_Address@FCtl_DTC@0x021B5558@ */ ECIPP_ALIGNMENT_UWORD 65535 Compu_IDENTITY 0 65535 PHYS_UNIT "DTC" /end CHARACTERISTIC
/begin CHARACTERISTIC FCdtc_EGRHP_maxv "FCtl_DTC(753)" VALUE 0x001E3E4C /* @ECU_Address@FCtl_DTC@0x021B55E2@ */ ECIPP_ALIGNMENT_UWORD 65535 Compu_IDENTITY 0 65535 PHYS_UNIT "DTC" /end CHARACTERISTIC
/begin CHARACTERISTIC FCdtc_EGRHP_minv "FCtl_DTC(754)" VALUE 0x001E3E4E /* @ECU_Address@FCtl_DTC@0x021B55E4@ */ ECIPP_ALIGNMENT_UWORD 65535 Compu_IDENTITY 0 65535 PHYS_UNIT "DTC" /end CHARACTERISTIC
/begin CHARACTERISTIC FCdtc_EGRHP_OOR "FCtl_DTC(755)" VALUE 0x001E3E50 /* @ECU_Address@FCtl_DTC@0x021B55E6@ */ ECIPP_ALIGNMENT_UWORD 65535 Compu_IDENTITY 0 65535 PHYS_UNIT "DTC" /end CHARACTERISTIC
/begin CHARACTERISTIC FCdtc_EGRO_postlk "FCtl_DTC(798)" VALUE 0x001E3EA6 /* @ECU_Address@FCtl_DTC@0x021B563C@ */ ECIPP_ALIGNMENT_UWORD 65535 Compu_IDENTITY 0 65535 PHYS_UNIT "DTC" /end CHARACTERISTIC
/begin CHARACTERISTIC FCdtc_EGRT_hi "FCtl_DTC(694)" VALUE 0x001E3DD6 /* @ECU_Address@FCtl_DTC@0x021B556C@ */ ECIPP_ALIGNMENT_UWORD 65535 Compu_IDENTITY 0 65535 PHYS_UNIT "DTC" /end CHARACTERISTIC
/begin CHARACTERISTIC FCdtc_EGRT_maxv "FCtl_DTC(692)" VALUE 0x001E3DD2 /* @ECU_Address@FCtl_DTC@0x021B5568@ */ ECIPP_ALIGNMENT_UWORD 65535 Compu_IDENTITY 0 65535 PHYS_UNIT "DTC" /end CHARACTERISTIC
/begin CHARACTERISTIC FCdtc_EGRT_minv "FCtl_DTC(693)" VALUE 0x001E3DD4 /* @ECU_Address@FCtl_DTC@0x021B556A@ */ ECIPP_ALIGNMENT_UWORD 65535 Compu_IDENTITY 0 65535 PHYS_UNIT "DTC" /end CHARACTERISTIC
/begin CHARACTERISTIC FCdtc_EGT_dig_Hi "FCtl_DTC(187)" VALUE 0x001E39E0 /* @ECU_Address@FCtl_DTC@0x021B5176@ */ ECIPP_ALIGNMENT_UWORD 65535 Compu_IDENTITY 0 65535 PHYS_UNIT "DTC" /end CHARACTERISTIC
/begin CHARACTERISTIC FCdtc_EGT_maxv "FCtl_DTC(808)" VALUE 0x001E3EBA /* @ECU_Address@FCtl_DTC@0x021B5650@ */ ECIPP_ALIGNMENT_UWORD 65535 Compu_IDENTITY 0 65535 PHYS_UNIT "DTC" /end CHARACTERISTIC
/begin CHARACTERISTIC FCdtc_EGT_minv "FCtl_DTC(809)" VALUE 0x001E3EBC /* @ECU_Address@FCtl_DTC@0x021B5652@ */ ECIPP_ALIGNMENT_UWORD 65535 Compu_IDENTITY 0 65535 PHYS_UNIT "DTC" /end CHARACTERISTIC
/begin CHARACTERISTIC FCdtc_EMWT1_HiExp1 "FCtl_DTC(225)" VALUE 0x001E3A2C /* @ECU_Address@FCtl_DTC@0x021B51C2@ */ ECIPP_ALIGNMENT_UWORD 65535 Compu_IDENTITY 0 65535 PHYS_UNIT "DTC" /end CHARACTERISTIC
/begin CHARACTERISTIC FCdtc_EMWT1_HiExp2 "FCtl_DTC(227)" VALUE 0x001E3A30 /* @ECU_Address@FCtl_DTC@0x021B51C6@ */ ECIPP_ALIGNMENT_UWORD 65535 Compu_IDENTITY 0 65535 PHYS_UNIT "DTC" /end CHARACTERISTIC
/begin CHARACTERISTIC FCdtc_EMWT1_maxv "FCtl_DTC(221)" VALUE 0x001E3A24 /* @ECU_Address@FCtl_DTC@0x021B51BA@ */ ECIPP_ALIGNMENT_UWORD 65535 Compu_IDENTITY 0 65535 PHYS_UNIT "DTC" /end CHARACTERISTIC
/begin CHARACTERISTIC FCdtc_EMWT1_minv "FCtl_DTC(223)" VALUE 0x001E3A28 /* @ECU_Address@FCtl_DTC@0x021B51BE@ */ ECIPP_ALIGNMENT_UWORD 65535 Compu_IDENTITY 0 65535 PHYS_UNIT "DTC" /end CHARACTERISTIC
/begin CHARACTERISTIC FCdtc_envtech_AAT_inv "FCtl_DTC(814)" VALUE 0x001E3EC6 /* @ECU_Address@FCtl_DTC@0x021B565C@ */ ECIPP_ALIGNMENT_UWORD 65535 Compu_IDENTITY 0 65535 PHYS_UNIT "DTC" /end CHARACTERISTIC
/begin CHARACTERISTIC FCdtc_envtech_BP_inv "FCtl_DTC(815)" VALUE 0x001E3EC8 /* @ECU_Address@FCtl_DTC@0x021B565E@ */ ECIPP_ALIGNMENT_UWORD 65535 Compu_IDENTITY 0 65535 PHYS_UNIT "DTC" /end CHARACTERISTIC
/begin CHARACTERISTIC FCdtc_envtech_comm "FCtl_DTC(358)" VALUE 0x001E3B36 /* @ECU_Address@FCtl_DTC@0x021B52CC@ */ ECIPP_ALIGNMENT_UWORD 65535 Compu_IDENTITY 0 65535 PHYS_UNIT "DTC" /end CHARACTERISTIC
/begin CHARACTERISTIC FCdtc_envtech_general "FCtl_DTC(817)" VALUE 0x001E3ECC /* @ECU_Address@FCtl_DTC@0x021B5662@ */ ECIPP_ALIGNMENT_UWORD 65535 Compu_IDENTITY 0 65535 PHYS_UNIT "DTC" /end CHARACTERISTIC
/begin CHARACTERISTIC FCdtc_envtech_RH_inv "FCtl_DTC(816)" VALUE 0x001E3ECA /* @ECU_Address@FCtl_DTC@0x021B5660@ */ ECIPP_ALIGNMENT_UWORD 65535 Compu_IDENTITY 0 65535 PHYS_UNIT "DTC" /end CHARACTERISTIC
/begin CHARACTERISTIC FCdtc_envtech_RH_uns "FCtl_DTC(818)" VALUE 0x001E3ECE /* @ECU_Address@FCtl_DTC@0x021B5664@ */ ECIPP_ALIGNMENT_UWORD 65535 Compu_IDENTITY 0 65535 PHYS_UNIT "DTC" /end CHARACTERISTIC
/begin CHARACTERISTIC FCdtc_ERCV_speed_OOR "FCtl_DTC(853)" VALUE 0x001E3F14 /* @ECU_Address@FCtl_DTC@0x021B56AA@ */ ECIPP_ALIGNMENT_UWORD 65535 Compu_IDENTITY 0 65535 PHYS_UNIT "DTC" /end CHARACTERISTIC
/begin CHARACTERISTIC FCdtc_ERWT1_HiExp1 "FCtl_DTC(237)" VALUE 0x001E3A44 /* @ECU_Address@FCtl_DTC@0x021B51DA@ */ ECIPP_ALIGNMENT_UWORD 65535 Compu_IDENTITY 0 65535 PHYS_UNIT "DTC" /end CHARACTERISTIC
/begin CHARACTERISTIC FCdtc_ERWT1_HiExp2 "FCtl_DTC(239)" VALUE 0x001E3A48 /* @ECU_Address@FCtl_DTC@0x021B51DE@ */ ECIPP_ALIGNMENT_UWORD 65535 Compu_IDENTITY 0 65535 PHYS_UNIT "DTC" /end CHARACTERISTIC
/begin CHARACTERISTIC FCdtc_ERWT1_maxv "FCtl_DTC(233)" VALUE 0x001E3A3C /* @ECU_Address@FCtl_DTC@0x021B51D2@ */ ECIPP_ALIGNMENT_UWORD 65535 Compu_IDENTITY 0 65535 PHYS_UNIT "DTC" /end CHARACTERISTIC
/begin CHARACTERISTIC FCdtc_ERWT1_minv "FCtl_DTC(235)" VALUE 0x001E3A40 /* @ECU_Address@FCtl_DTC@0x021B51D6@ */ ECIPP_ALIGNMENT_UWORD 65535 Compu_IDENTITY 0 65535 PHYS_UNIT "DTC" /end CHARACTERISTIC
/begin CHARACTERISTIC FCdtc_F1OOR_F2IVS "FCtl_DTC(178)" VALUE 0x001E39CE /* @ECU_Address@FCtl_DTC@0x021B5164@ */ ECIPP_ALIGNMENT_UWORD 65535 Compu_IDENTITY 0 65535 PHYS_UNIT "DTC" /end CHARACTERISTIC
/begin CHARACTERISTIC FCdtc_F2OOR_F1IVS "FCtl_DTC(179)" VALUE 0x001E39D0 /* @ECU_Address@FCtl_DTC@0x021B5166@ */ ECIPP_ALIGNMENT_UWORD 65535 Compu_IDENTITY 0 65535 PHYS_UNIT "DTC" /end CHARACTERISTIC
/begin CHARACTERISTIC FCdtc_FCoolH2O_lo "FCtl_DTC(532)" VALUE 0x001E3C92 /* @ECU_Address@FCtl_DTC@0x021B5428@ */ ECIPP_ALIGNMENT_UWORD 65535 Compu_IDENTITY 0 65535 PHYS_UNIT "DTC" /end CHARACTERISTIC
/begin CHARACTERISTIC FCdtc_FIMP_pct_high "FCtl_DTC(282)" VALUE 0x001E3A9E /* @ECU_Address@FCtl_DTC@0x021B5234@ */ ECIPP_ALIGNMENT_UWORD 65535 Compu_IDENTITY 0 65535 PHYS_UNIT "DTC" /end CHARACTERISTIC
/begin CHARACTERISTIC FCdtc_FIP_LoExp "FCtl_DTC(695)" VALUE 0x001E3DD8 /* @ECU_Address@FCtl_DTC@0x021B556E@ */ ECIPP_ALIGNMENT_UWORD 65535 Compu_IDENTITY 0 65535 PHYS_UNIT "DTC" /end CHARACTERISTIC
/begin CHARACTERISTIC FCdtc_flash_fail "FCtl_DTC(105)" VALUE 0x001E393C /* @ECU_Address@FCtl_DTC@0x021B50D2@ */ ECIPP_ALIGNMENT_UWORD 65535 Compu_IDENTITY 0 65535 PHYS_UNIT "DTC" /end CHARACTERISTIC
/begin CHARACTERISTIC FCdtc_FOP_start "FCtl_DTC(1016)" VALUE 0x001E405A /* @ECU_Address@FCtl_DTC@0x021B57F0@ */ ECIPP_ALIGNMENT_UWORD 65535 Compu_IDENTITY 0 65535 PHYS_UNIT "DTC" /end CHARACTERISTIC
/begin CHARACTERISTIC FCdtc_FP_high "FCtl_DTC(290)" VALUE 0x001E3AAE /* @ECU_Address@FCtl_DTC@0x021B5244@ */ ECIPP_ALIGNMENT_UWORD 65535 Compu_IDENTITY 0 65535 PHYS_UNIT "DTC" /end CHARACTERISTIC
/begin CHARACTERISTIC FCdtc_FP_low "FCtl_DTC(291)" VALUE 0x001E3AB0 /* @ECU_Address@FCtl_DTC@0x021B5246@ */ ECIPP_ALIGNMENT_UWORD 65535 Compu_IDENTITY 0 65535 PHYS_UNIT "DTC" /end CHARACTERISTIC
/begin CHARACTERISTIC FCdtc_FP_maxv "FCtl_DTC(128)" VALUE 0x001E396A /* @ECU_Address@FCtl_DTC@0x021B5100@ */ ECIPP_ALIGNMENT_UWORD 65535 Compu_IDENTITY 0 65535 PHYS_UNIT "DTC" /end CHARACTERISTIC
/begin CHARACTERISTIC FCdtc_FP_minv "FCtl_DTC(129)" VALUE 0x001E396C /* @ECU_Address@FCtl_DTC@0x021B5102@ */ ECIPP_ALIGNMENT_UWORD 65535 Compu_IDENTITY 0 65535 PHYS_UNIT "DTC" /end CHARACTERISTIC
/begin CHARACTERISTIC FCdtc_FP2_high "FCtl_DTC(463)" VALUE 0x001E3C08 /* @ECU_Address@FCtl_DTC@0x021B539E@ */ ECIPP_ALIGNMENT_UWORD 65535 Compu_IDENTITY 0 65535 PHYS_UNIT "DTC" /end CHARACTERISTIC
/begin CHARACTERISTIC FCdtc_FP2_low "FCtl_DTC(464)" VALUE 0x001E3C0A /* @ECU_Address@FCtl_DTC@0x021B53A0@ */ ECIPP_ALIGNMENT_UWORD 65535 Compu_IDENTITY 0 65535 PHYS_UNIT "DTC" /end CHARACTERISTIC
/begin CHARACTERISTIC FCdtc_FP2_maxv "FCtl_DTC(461)" VALUE 0x001E3C04 /* @ECU_Address@FCtl_DTC@0x021B539A@ */ ECIPP_ALIGNMENT_UWORD 65535 Compu_IDENTITY 0 65535 PHYS_UNIT "DTC" /end CHARACTERISTIC
/begin CHARACTERISTIC FCdtc_FP2_minv "FCtl_DTC(462)" VALUE 0x001E3C06 /* @ECU_Address@FCtl_DTC@0x021B539C@ */ ECIPP_ALIGNMENT_UWORD 65535 Compu_IDENTITY 0 65535 PHYS_UNIT "DTC" /end CHARACTERISTIC
/begin CHARACTERISTIC FCdtc_FPD_off_hi "FCtl_DTC(94)" VALUE 0x001E3926 /* @ECU_Address@FCtl_DTC@0x021B50BC@ */ ECIPP_ALIGNMENT_UWORD 65535 Compu_IDENTITY 0 65535 PHYS_UNIT "DTC" /end CHARACTERISTIC
/begin CHARACTERISTIC FCdtc_FPD_on_lo "FCtl_DTC(93)" VALUE 0x001E3924 /* @ECU_Address@FCtl_DTC@0x021B50BA@ */ ECIPP_ALIGNMENT_UWORD 65535 Compu_IDENTITY 0 65535 PHYS_UNIT "DTC" /end CHARACTERISTIC
/begin CHARACTERISTIC FCdtc_FPlo_derate_actv "FCtl_DTC(807)" VALUE 0x001E3EB8 /* @ECU_Address@FCtl_DTC@0x021B564E@ */ ECIPP_ALIGNMENT_UWORD 65535 Compu_IDENTITY 0 65535 PHYS_UNIT "DTC" /end CHARACTERISTIC
/begin CHARACTERISTIC FCdtc_FPlo_derate_excess "FCtl_DTC(810)" VALUE 0x001E3EBE /* @ECU_Address@FCtl_DTC@0x021B5654@ */ ECIPP_ALIGNMENT_UWORD 65535 Compu_IDENTITY 0 65535 PHYS_UNIT "DTC" /end CHARACTERISTIC
/begin CHARACTERISTIC FCdtc_FPP_NeutLock_fail "FCtl_DTC(658)" VALUE 0x001E3D8E /* @ECU_Address@FCtl_DTC@0x021B5524@ */ ECIPP_ALIGNMENT_UWORD 65535 Compu_IDENTITY 0 65535 PHYS_UNIT "DTC" /end CHARACTERISTIC
/begin CHARACTERISTIC FCdtc_FPP1_IVS_max "FCtl_DTC(23)" VALUE 0x001E3898 /* @ECU_Address@FCtl_DTC@0x021B502E@ */ ECIPP_ALIGNMENT_UWORD 65535 Compu_IDENTITY 0 65535 PHYS_UNIT "DTC" /end CHARACTERISTIC
/begin CHARACTERISTIC FCdtc_FPP1_IVS_min "FCtl_DTC(24)" VALUE 0x001E389A /* @ECU_Address@FCtl_DTC@0x021B5030@ */ ECIPP_ALIGNMENT_UWORD 65535 Compu_IDENTITY 0 65535 PHYS_UNIT "DTC" /end CHARACTERISTIC
/begin CHARACTERISTIC FCdtc_FPP1_max "FCtl_DTC(19)" VALUE 0x001E3890 /* @ECU_Address@FCtl_DTC@0x021B5026@ */ ECIPP_ALIGNMENT_UWORD 65535 Compu_IDENTITY 0 65535 PHYS_UNIT "DTC" /end CHARACTERISTIC
/begin CHARACTERISTIC FCdtc_FPP1_min "FCtl_DTC(20)" VALUE 0x001E3892 /* @ECU_Address@FCtl_DTC@0x021B5028@ */ ECIPP_ALIGNMENT_UWORD 65535 Compu_IDENTITY 0 65535 PHYS_UNIT "DTC" /end CHARACTERISTIC
/begin CHARACTERISTIC FCdtc_FPP12_IVS_max "FCtl_DTC(175)" VALUE 0x001E39C8 /* @ECU_Address@FCtl_DTC@0x021B515E@ */ ECIPP_ALIGNMENT_UWORD 65535 Compu_IDENTITY 0 65535 PHYS_UNIT "DTC" /end CHARACTERISTIC
/begin CHARACTERISTIC FCdtc_FPP12_IVS_min "FCtl_DTC(176)" VALUE 0x001E39CA /* @ECU_Address@FCtl_DTC@0x021B5160@ */ ECIPP_ALIGNMENT_UWORD 65535 Compu_IDENTITY 0 65535 PHYS_UNIT "DTC" /end CHARACTERISTIC
/begin CHARACTERISTIC FCdtc_FPP12_OOR "FCtl_DTC(177)" VALUE 0x001E39CC /* @ECU_Address@FCtl_DTC@0x021B5162@ */ ECIPP_ALIGNMENT_UWORD 65535 Compu_IDENTITY 0 65535 PHYS_UNIT "DTC" /end CHARACTERISTIC
/begin CHARACTERISTIC FCdtc_FPP12IVS_TSC1 "FCtl_DTC(734)" VALUE 0x001E3E26 /* @ECU_Address@FCtl_DTC@0x021B55BC@ */ ECIPP_ALIGNMENT_UWORD 65535 Compu_IDENTITY 0 65535 PHYS_UNIT "DTC" /end CHARACTERISTIC
/begin CHARACTERISTIC FCdtc_FPP12MM_IVSMM "FCtl_DTC(180)" VALUE 0x001E39D2 /* @ECU_Address@FCtl_DTC@0x021B5168@ */ ECIPP_ALIGNMENT_UWORD 65535 Compu_IDENTITY 0 65535 PHYS_UNIT "DTC" /end CHARACTERISTIC
/begin CHARACTERISTIC FCdtc_FPP12pct_hi "FCtl_DTC(27)" VALUE 0x001E38A0 /* @ECU_Address@FCtl_DTC@0x021B5036@ */ ECIPP_ALIGNMENT_UWORD 65535 Compu_IDENTITY 0 65535 PHYS_UNIT "DTC" /end CHARACTERISTIC
/begin CHARACTERISTIC FCdtc_FPP12pct_lo "FCtl_DTC(28)" VALUE 0x001E38A2 /* @ECU_Address@FCtl_DTC@0x021B5038@ */ ECIPP_ALIGNMENT_UWORD 65535 Compu_IDENTITY 0 65535 PHYS_UNIT "DTC" /end CHARACTERISTIC
/begin CHARACTERISTIC FCdtc_FPP2_IVS_max "FCtl_DTC(25)" VALUE 0x001E389C /* @ECU_Address@FCtl_DTC@0x021B5032@ */ ECIPP_ALIGNMENT_UWORD 65535 Compu_IDENTITY 0 65535 PHYS_UNIT "DTC" /end CHARACTERISTIC
/begin CHARACTERISTIC FCdtc_FPP2_IVS_min "FCtl_DTC(26)" VALUE 0x001E389E /* @ECU_Address@FCtl_DTC@0x021B5034@ */ ECIPP_ALIGNMENT_UWORD 65535 Compu_IDENTITY 0 65535 PHYS_UNIT "DTC" /end CHARACTERISTIC
/begin CHARACTERISTIC FCdtc_FPP2_max "FCtl_DTC(21)" VALUE 0x001E3894 /* @ECU_Address@FCtl_DTC@0x021B502A@ */ ECIPP_ALIGNMENT_UWORD 65535 Compu_IDENTITY 0 65535 PHYS_UNIT "DTC" /end CHARACTERISTIC
/begin CHARACTERISTIC FCdtc_FPP2_min "FCtl_DTC(22)" VALUE 0x001E3896 /* @ECU_Address@FCtl_DTC@0x021B502C@ */ ECIPP_ALIGNMENT_UWORD 65535 Compu_IDENTITY 0 65535 PHYS_UNIT "DTC" /end CHARACTERISTIC
/begin CHARACTERISTIC FCdtc_FPP2V_TSC1 "FCtl_DTC(839)" VALUE 0x001E3EF8 /* @ECU_Address@FCtl_DTC@0x021B568E@ */ ECIPP_ALIGNMENT_UWORD 65535 Compu_IDENTITY 0 65535 PHYS_UNIT "DTC" /end CHARACTERISTIC
/begin CHARACTERISTIC FCdtc_FPrly_coilopen "FCtl_DTC(168)" VALUE 0x001E39BA /* @ECU_Address@FCtl_DTC@0x021B5150@ */ ECIPP_ALIGNMENT_UWORD 65535 Compu_IDENTITY 0 65535 PHYS_UNIT "DTC" /end CHARACTERISTIC
/begin CHARACTERISTIC FCfmi_EGRdP_HiExp "FCtl_FMI(752)" VALUE 0x001E5BF1 /* @ECU_Address@FCtl_FMI@0x021B72F0@ */ ECIPP_ALIGNMENT_UBYTE 255 Compu_IDENTITY 0 255 PHYS_UNIT "FMI" /end CHARACTERISTIC
/begin CHARACTERISTIC FCfmi_EGRdP_lo_LP_discon "FCtl_FMI(866)" VALUE 0x001E5C63 /* @ECU_Address@FCtl_FMI@0x021B7362@ */ ECIPP_ALIGNMENT_UBYTE 255 Compu_IDENTITY 0 255 PHYS_UNIT "FMI" /end CHARACTERISTIC
/begin CHARACTERISTIC FCfmi_EGRdP_lo_reversed "FCtl_FMI(865)" VALUE 0x001E5C62 /* @ECU_Address@FCtl_FMI@0x021B7361@ */ ECIPP_ALIGNMENT_UBYTE 255 Compu_IDENTITY 0 255 PHYS_UNIT "FMI" /end CHARACTERISTIC
/begin CHARACTERISTIC FCfmi_EGRdP_LoExp "FCtl_FMI(751)" VALUE 0x001E5BF0 /* @ECU_Address@FCtl_FMI@0x021B72EF@ */ ECIPP_ALIGNMENT_UBYTE 255 Compu_IDENTITY 0 255 PHYS_UNIT "FMI" /end CHARACTERISTIC
/begin CHARACTERISTIC FCfmi_EGRdP_maxv "FCtl_FMI(749)" VALUE 0x001E5BEE /* @ECU_Address@FCtl_FMI@0x021B72ED@ */ ECIPP_ALIGNMENT_UBYTE 255 Compu_IDENTITY 0 255 PHYS_UNIT "FMI" /end CHARACTERISTIC
/begin CHARACTERISTIC FCfmi_EGRdP_minv "FCtl_FMI(750)" VALUE 0x001E5BEF /* @ECU_Address@FCtl_FMI@0x021B72EE@ */ ECIPP_ALIGNMENT_UBYTE 255 Compu_IDENTITY 0 255 PHYS_UNIT "FMI" /end CHARACTERISTIC
/begin CHARACTERISTIC FCfmi_EGRflow_HiExp "FCtl_FMI(597)" VALUE 0x001E5B56 /* @ECU_Address@FCtl_FMI@0x021B7255@ */ ECIPP_ALIGNMENT_UBYTE 255 Compu_IDENTITY 0 255 PHYS_UNIT "FMI" /end CHARACTERISTIC
/begin CHARACTERISTIC FCfmi_EGRflow_LoExp "FCtl_FMI(596)" VALUE 0x001E5B55 /* @ECU_Address@FCtl_FMI@0x021B7254@ */ ECIPP_ALIGNMENT_UBYTE 255 Compu_IDENTITY 0 255 PHYS_UNIT "FMI" /end CHARACTERISTIC
/begin CHARACTERISTIC FCfmi_EGRflow_LoExp2 "FCtl_FMI(684)" VALUE 0x001E5BAD /* @ECU_Address@FCtl_FMI@0x021B72AC@ */ ECIPP_ALIGNMENT_UBYTE 255 Compu_IDENTITY 0 255 PHYS_UNIT "FMI" /end CHARACTERISTIC
/begin CHARACTERISTIC FCfmi_EGRHP_maxv "FCtl_FMI(753)" VALUE 0x001E5BF2 /* @ECU_Address@FCtl_FMI@0x021B72F1@ */ ECIPP_ALIGNMENT_UBYTE 255 Compu_IDENTITY 0 255 PHYS_UNIT "FMI" /end CHARACTERISTIC
/begin CHARACTERISTIC FCfmi_EGRHP_minv "FCtl_FMI(754)" VALUE 0x001E5BF3 /* @ECU_Address@FCtl_FMI@0x021B72F2@ */ ECIPP_ALIGNMENT_UBYTE 255 Compu_IDENTITY 0 255 PHYS_UNIT "FMI" /end CHARACTERISTIC
/begin CHARACTERISTIC FCfmi_EGRHP_OOR "FCtl_FMI(755)" VALUE 0x001E5BF4 /* @ECU_Address@FCtl_FMI@0x021B72F3@ */ ECIPP_ALIGNMENT_UBYTE 255 Compu_IDENTITY 0 255 PHYS_UNIT "FMI" /end CHARACTERISTIC
/begin CHARACTERISTIC FCfmi_EGRO_postlk "FCtl_FMI(798)" VALUE 0x001E5C1F /* @ECU_Address@FCtl_FMI@0x021B731E@ */ ECIPP_ALIGNMENT_UBYTE 255 Compu_IDENTITY 0 255 PHYS_UNIT "FMI" /end CHARACTERISTIC
/begin CHARACTERISTIC FCfmi_EGRT_hi "FCtl_FMI(694)" VALUE 0x001E5BB7 /* @ECU_Address@FCtl_FMI@0x021B72B6@ */ ECIPP_ALIGNMENT_UBYTE 255 Compu_IDENTITY 0 255 PHYS_UNIT "FMI" /end CHARACTERISTIC
/begin CHARACTERISTIC FCfmi_EGRT_maxv "FCtl_FMI(692)" VALUE 0x001E5BB5 /* @ECU_Address@FCtl_FMI@0x021B72B4@ */ ECIPP_ALIGNMENT_UBYTE 255 Compu_IDENTITY 0 255 PHYS_UNIT "FMI" /end CHARACTERISTIC
/begin CHARACTERISTIC FCfmi_EGRT_minv "FCtl_FMI(693)" VALUE 0x001E5BB6 /* @ECU_Address@FCtl_FMI@0x021B72B5@ */ ECIPP_ALIGNMENT_UBYTE 255 Compu_IDENTITY 0 255 PHYS_UNIT "FMI" /end CHARACTERISTIC
/begin CHARACTERISTIC FCfmi_EGT_dig_Hi "FCtl_FMI(187)" VALUE 0x001E59BC /* @ECU_Address@FCtl_FMI@0x021B70BB@ */ ECIPP_ALIGNMENT_UBYTE 255 Compu_IDENTITY 0 255 PHYS_UNIT "FMI" /end CHARACTERISTIC
/begin CHARACTERISTIC FCfmi_EGT_maxv "FCtl_FMI(808)" VALUE 0x001E5C29 /* @ECU_Address@FCtl_FMI@0x021B7328@ */ ECIPP_ALIGNMENT_UBYTE 255 Compu_IDENTITY 0 255 PHYS_UNIT "FMI" /end CHARACTERISTIC
/begin CHARACTERISTIC FCfmi_EGT_minv "FCtl_FMI(809)" VALUE 0x001E5C2A /* @ECU_Address@FCtl_FMI@0x021B7329@ */ ECIPP_ALIGNMENT_UBYTE 255 Compu_IDENTITY 0 255 PHYS_UNIT "FMI" /end CHARACTERISTIC
/begin CHARACTERISTIC FCfmi_EMWT1_HiExp1 "FCtl_FMI(225)" VALUE 0x001E59E2 /* @ECU_Address@FCtl_FMI@0x021B70E1@ */ ECIPP_ALIGNMENT_UBYTE 255 Compu_IDENTITY 0 255 PHYS_UNIT "FMI" /end CHARACTERISTIC
/begin CHARACTERISTIC FCfmi_EMWT1_HiExp2 "FCtl_FMI(227)" VALUE 0x001E59E4 /* @ECU_Address@FCtl_FMI@0x021B70E3@ */ ECIPP_ALIGNMENT_UBYTE 255 Compu_IDENTITY 0 255 PHYS_UNIT "FMI" /end CHARACTERISTIC
/begin CHARACTERISTIC FCfmi_EMWT1_maxv "FCtl_FMI(221)" VALUE 0x001E59DE /* @ECU_Address@FCtl_FMI@0x021B70DD@ */ ECIPP_ALIGNMENT_UBYTE 255 Compu_IDENTITY 0 255 PHYS_UNIT "FMI" /end CHARACTERISTIC
/begin CHARACTERISTIC FCfmi_EMWT1_minv "FCtl_FMI(223)" VALUE 0x001E59E0 /* @ECU_Address@FCtl_FMI@0x021B70DF@ */ ECIPP_ALIGNMENT_UBYTE 255 Compu_IDENTITY 0 255 PHYS_UNIT "FMI" /end CHARACTERISTIC
/begin CHARACTERISTIC FCfmi_envtech_AAT_inv "FCtl_FMI(814)" VALUE 0x001E5C2F /* @ECU_Address@FCtl_FMI@0x021B732E@ */ ECIPP_ALIGNMENT_UBYTE 255 Compu_IDENTITY 0 255 PHYS_UNIT "FMI" /end CHARACTERISTIC
/begin CHARACTERISTIC FCfmi_envtech_BP_inv "FCtl_FMI(815)" VALUE 0x001E5C30 /* @ECU_Address@FCtl_FMI@0x021B732F@ */ ECIPP_ALIGNMENT_UBYTE 255 Compu_IDENTITY 0 255 PHYS_UNIT "FMI" /end CHARACTERISTIC
/begin CHARACTERISTIC FCfmi_envtech_comm "FCtl_FMI(358)" VALUE 0x001E5A67 /* @ECU_Address@FCtl_FMI@0x021B7166@ */ ECIPP_ALIGNMENT_UBYTE 255 Compu_IDENTITY 0 255 PHYS_UNIT "FMI" /end CHARACTERISTIC
/begin CHARACTERISTIC FCfmi_envtech_general "FCtl_FMI(817)" VALUE 0x001E5C32 /* @ECU_Address@FCtl_FMI@0x021B7331@ */ ECIPP_ALIGNMENT_UBYTE 255 Compu_IDENTITY 0 255 PHYS_UNIT "FMI" /end CHARACTERISTIC
/begin CHARACTERISTIC FCfmi_envtech_RH_inv "FCtl_FMI(816)" VALUE 0x001E5C31 /* @ECU_Address@FCtl_FMI@0x021B7330@ */ ECIPP_ALIGNMENT_UBYTE 255 Compu_IDENTITY 0 255 PHYS_UNIT "FMI" /end CHARACTERISTIC
/begin CHARACTERISTIC FCfmi_envtech_RH_uns "FCtl_FMI(818)" VALUE 0x001E5C33 /* @ECU_Address@FCtl_FMI@0x021B7332@ */ ECIPP_ALIGNMENT_UBYTE 255 Compu_IDENTITY 0 255 PHYS_UNIT "FMI" /end CHARACTERISTIC
/begin CHARACTERISTIC FCfmi_ERCV_speed_OOR "FCtl_FMI(853)" VALUE 0x001E5C56 /* @ECU_Address@FCtl_FMI@0x021B7355@ */ ECIPP_ALIGNMENT_UBYTE 255 Compu_IDENTITY 0 255 PHYS_UNIT "FMI" /end CHARACTERISTIC
/begin CHARACTERISTIC FCfmi_ERWT1_HiExp1 "FCtl_FMI(237)" VALUE 0x001E59EE /* @ECU_Address@FCtl_FMI@0x021B70ED@ */ ECIPP_ALIGNMENT_UBYTE 255 Compu_IDENTITY 0 255 PHYS_UNIT "FMI" /end CHARACTERISTIC
/begin CHARACTERISTIC FCfmi_ERWT1_HiExp2 "FCtl_FMI(239)" VALUE 0x001E59F0 /* @ECU_Address@FCtl_FMI@0x021B70EF@ */ ECIPP_ALIGNMENT_UBYTE 255 Compu_IDENTITY 0 255 PHYS_UNIT "FMI" /end CHARACTERISTIC
/begin CHARACTERISTIC FCfmi_ERWT1_maxv "FCtl_FMI(233)" VALUE 0x001E59EA /* @ECU_Address@FCtl_FMI@0x021B70E9@ */ ECIPP_ALIGNMENT_UBYTE 255 Compu_IDENTITY 0 255 PHYS_UNIT "FMI" /end CHARACTERISTIC
/begin CHARACTERISTIC FCfmi_ERWT1_minv "FCtl_FMI(235)" VALUE 0x001E59EC /* @ECU_Address@FCtl_FMI@0x021B70EB@ */ ECIPP_ALIGNMENT_UBYTE 255 Compu_IDENTITY 0 255 PHYS_UNIT "FMI" /end CHARACTERISTIC
/begin CHARACTERISTIC FCfmi_F1OOR_F2IVS "FCtl_FMI(178)" VALUE 0x001E59B3 /* @ECU_Address@FCtl_FMI@0x021B70B2@ */ ECIPP_ALIGNMENT_UBYTE 255 Compu_IDENTITY 0 255 PHYS_UNIT "FMI" /end CHARACTERISTIC
/begin CHARACTERISTIC FCfmi_F2OOR_F1IVS "FCtl_FMI(179)" VALUE 0x001E59B4 /* @ECU_Address@FCtl_FMI@0x021B70B3@ */ ECIPP_ALIGNMENT_UBYTE 255 Compu_IDENTITY 0 255 PHYS_UNIT "FMI" /end CHARACTERISTIC
/begin CHARACTERISTIC FCfmi_FCoolH2O_lo "FCtl_FMI(532)" VALUE 0x001E5B15 /* @ECU_Address@FCtl_FMI@0x021B7214@ */ ECIPP_ALIGNMENT_UBYTE 255 Compu_IDENTITY 0 255 PHYS_UNIT "FMI" /end CHARACTERISTIC
/begin CHARACTERISTIC FCfmi_FIMP_pct_high "FCtl_FMI(282)" VALUE 0x001E5A1B /* @ECU_Address@FCtl_FMI@0x021B711A@ */ ECIPP_ALIGNMENT_UBYTE 255 Compu_IDENTITY 0 255 PHYS_UNIT "FMI" /end CHARACTERISTIC
/begin CHARACTERISTIC FCfmi_FIP_LoExp "FCtl_FMI(695)" VALUE 0x001E5BB8 /* @ECU_Address@FCtl_FMI@0x021B72B7@ */ ECIPP_ALIGNMENT_UBYTE 255 Compu_IDENTITY 0 255 PHYS_UNIT "FMI" /end CHARACTERISTIC
/begin CHARACTERISTIC FCfmi_flash_fail "FCtl_FMI(105)" VALUE 0x001E596A /* @ECU_Address@FCtl_FMI@0x021B7069@ */ ECIPP_ALIGNMENT_UBYTE 255 Compu_IDENTITY 0 255 PHYS_UNIT "FMI" /end CHARACTERISTIC
/begin CHARACTERISTIC FCfmi_FOP_start "FCtl_FMI(1016)" VALUE 0x001E5CF9 /* @ECU_Address@FCtl_FMI@0x021B73F8@ */ ECIPP_ALIGNMENT_UBYTE 255 Compu_IDENTITY 0 255 PHYS_UNIT "FMI" /end CHARACTERISTIC
/begin CHARACTERISTIC FCfmi_FP_high "FCtl_FMI(290)" VALUE 0x001E5A23 /* @ECU_Address@FCtl_FMI@0x021B7122@ */ ECIPP_ALIGNMENT_UBYTE 255 Compu_IDENTITY 0 255 PHYS_UNIT "FMI" /end CHARACTERISTIC
/begin CHARACTERISTIC FCfmi_FP_low "FCtl_FMI(291)" VALUE 0x001E5A24 /* @ECU_Address@FCtl_FMI@0x021B7123@ */ ECIPP_ALIGNMENT_UBYTE 255 Compu_IDENTITY 0 255 PHYS_UNIT "FMI" /end CHARACTERISTIC
/begin CHARACTERISTIC FCfmi_FP_maxv "FCtl_FMI(128)" VALUE 0x001E5981 /* @ECU_Address@FCtl_FMI@0x021B7080@ */ ECIPP_ALIGNMENT_UBYTE 255 Compu_IDENTITY 0 255 PHYS_UNIT "FMI" /end CHARACTERISTIC
/begin CHARACTERISTIC FCfmi_FP_minv "FCtl_FMI(129)" VALUE 0x001E5982 /* @ECU_Address@FCtl_FMI@0x021B7081@ */ ECIPP_ALIGNMENT_UBYTE 255 Compu_IDENTITY 0 255 PHYS_UNIT "FMI" /end CHARACTERISTIC
/begin CHARACTERISTIC FCfmi_FP2_high "FCtl_FMI(463)" VALUE 0x001E5AD0 /* @ECU_Address@FCtl_FMI@0x021B71CF@ */ ECIPP_ALIGNMENT_UBYTE 255 Compu_IDENTITY 0 255 PHYS_UNIT "FMI" /end CHARACTERISTIC
/begin CHARACTERISTIC FCfmi_FP2_low "FCtl_FMI(464)" VALUE 0x001E5AD1 /* @ECU_Address@FCtl_FMI@0x021B71D0@ */ ECIPP_ALIGNMENT_UBYTE 255 Compu_IDENTITY 0 255 PHYS_UNIT "FMI" /end CHARACTERISTIC
/begin CHARACTERISTIC FCfmi_FP2_maxv "FCtl_FMI(461)" VALUE 0x001E5ACE /* @ECU_Address@FCtl_FMI@0x021B71CD@ */ ECIPP_ALIGNMENT_UBYTE 255 Compu_IDENTITY 0 255 PHYS_UNIT "FMI" /end CHARACTERISTIC
/begin CHARACTERISTIC FCfmi_FP2_minv "FCtl_FMI(462)" VALUE 0x001E5ACF /* @ECU_Address@FCtl_FMI@0x021B71CE@ */ ECIPP_ALIGNMENT_UBYTE 255 Compu_IDENTITY 0 255 PHYS_UNIT "FMI" /end CHARACTERISTIC
/begin CHARACTERISTIC FCfmi_FPD_off_hi "FCtl_FMI(94)" VALUE 0x001E595F /* @ECU_Address@FCtl_FMI@0x021B705E@ */ ECIPP_ALIGNMENT_UBYTE 255 Compu_IDENTITY 0 255 PHYS_UNIT "FMI" /end CHARACTERISTIC
/begin CHARACTERISTIC FCfmi_FPD_on_lo "FCtl_FMI(93)" VALUE 0x001E595E /* @ECU_Address@FCtl_FMI@0x021B705D@ */ ECIPP_ALIGNMENT_UBYTE 255 Compu_IDENTITY 0 255 PHYS_UNIT "FMI" /end CHARACTERISTIC
/begin CHARACTERISTIC FCfmi_FPlo_derate_actv "FCtl_FMI(807)" VALUE 0x001E5C28 /* @ECU_Address@FCtl_FMI@0x021B7327@ */ ECIPP_ALIGNMENT_UBYTE 255 Compu_IDENTITY 0 255 PHYS_UNIT "FMI" /end CHARACTERISTIC
/begin CHARACTERISTIC FCfmi_FPlo_derate_excess "FCtl_FMI(810)" VALUE 0x001E5C2B /* @ECU_Address@FCtl_FMI@0x021B732A@ */ ECIPP_ALIGNMENT_UBYTE 255 Compu_IDENTITY 0 255 PHYS_UNIT "FMI" /end CHARACTERISTIC
/begin CHARACTERISTIC FCfmi_FPP_NeutLock_fail "FCtl_FMI(658)" VALUE 0x001E5B93 /* @ECU_Address@FCtl_FMI@0x021B7292@ */ ECIPP_ALIGNMENT_UBYTE 255 Compu_IDENTITY 0 255 PHYS_UNIT "FMI" /end CHARACTERISTIC
/begin CHARACTERISTIC FCfmi_FPP1_IVS_max "FCtl_FMI(23)" VALUE 0x001E5918 /* @ECU_Address@FCtl_FMI@0x021B7017@ */ ECIPP_ALIGNMENT_UBYTE 255 Compu_IDENTITY 0 255 PHYS_UNIT "FMI" /end CHARACTERISTIC
/begin CHARACTERISTIC FCfmi_FPP1_IVS_min "FCtl_FMI(24)" VALUE 0x001E5919 /* @ECU_Address@FCtl_FMI@0x021B7018@ */ ECIPP_ALIGNMENT_UBYTE 255 Compu_IDENTITY 0 255 PHYS_UNIT "FMI" /end CHARACTERISTIC
/begin CHARACTERISTIC FCfmi_FPP1_max "FCtl_FMI(19)" VALUE 0x001E5914 /* @ECU_Address@FCtl_FMI@0x021B7013@ */ ECIPP_ALIGNMENT_UBYTE 255 Compu_IDENTITY 0 255 PHYS_UNIT "FMI" /end CHARACTERISTIC
/begin CHARACTERISTIC FCfmi_FPP1_min "FCtl_FMI(20)" VALUE 0x001E5915 /* @ECU_Address@FCtl_FMI@0x021B7014@ */ ECIPP_ALIGNMENT_UBYTE 255 Compu_IDENTITY 0 255 PHYS_UNIT "FMI" /end CHARACTERISTIC
/begin CHARACTERISTIC FCfmi_FPP12_IVS_max "FCtl_FMI(175)" VALUE 0x001E59B0 /* @ECU_Address@FCtl_FMI@0x021B70AF@ */ ECIPP_ALIGNMENT_UBYTE 255 Compu_IDENTITY 0 255 PHYS_UNIT "FMI" /end CHARACTERISTIC
/begin CHARACTERISTIC FCfmi_FPP12_IVS_min "FCtl_FMI(176)" VALUE 0x001E59B1 /* @ECU_Address@FCtl_FMI@0x021B70B0@ */ ECIPP_ALIGNMENT_UBYTE 255 Compu_IDENTITY 0 255 PHYS_UNIT "FMI" /end CHARACTERISTIC
/begin CHARACTERISTIC FCfmi_FPP12_OOR "FCtl_FMI(177)" VALUE 0x001E59B2 /* @ECU_Address@FCtl_FMI@0x021B70B1@ */ ECIPP_ALIGNMENT_UBYTE 255 Compu_IDENTITY 0 255 PHYS_UNIT "FMI" /end CHARACTERISTIC
/begin CHARACTERISTIC FCfmi_FPP12IVS_TSC1 "FCtl_FMI(734)" VALUE 0x001E5BDF /* @ECU_Address@FCtl_FMI@0x021B72DE@ */ ECIPP_ALIGNMENT_UBYTE 255 Compu_IDENTITY 0 255 PHYS_UNIT "FMI" /end CHARACTERISTIC
/begin CHARACTERISTIC FCfmi_FPP12MM_IVSMM "FCtl_FMI(180)" VALUE 0x001E59B5 /* @ECU_Address@FCtl_FMI@0x021B70B4@ */ ECIPP_ALIGNMENT_UBYTE 255 Compu_IDENTITY 0 255 PHYS_UNIT "FMI" /end CHARACTERISTIC
/begin CHARACTERISTIC FCfmi_FPP12pct_hi "FCtl_FMI(27)" VALUE 0x001E591C /* @ECU_Address@FCtl_FMI@0x021B701B@ */ ECIPP_ALIGNMENT_UBYTE 255 Compu_IDENTITY 0 255 PHYS_UNIT "FMI" /end CHARACTERISTIC
/begin CHARACTERISTIC FCfmi_FPP12pct_lo "FCtl_FMI(28)" VALUE 0x001E591D /* @ECU_Address@FCtl_FMI@0x021B701C@ */ ECIPP_ALIGNMENT_UBYTE 255 Compu_IDENTITY 0 255 PHYS_UNIT "FMI" /end CHARACTERISTIC
/begin CHARACTERISTIC FCfmi_FPP2_IVS_max "FCtl_FMI(25)" VALUE 0x001E591A /* @ECU_Address@FCtl_FMI@0x021B7019@ */ ECIPP_ALIGNMENT_UBYTE 255 Compu_IDENTITY 0 255 PHYS_UNIT "FMI" /end CHARACTERISTIC
/begin CHARACTERISTIC FCfmi_FPP2_IVS_min "FCtl_FMI(26)" VALUE 0x001E591B /* @ECU_Address@FCtl_FMI@0x021B701A@ */ ECIPP_ALIGNMENT_UBYTE 255 Compu_IDENTITY 0 255 PHYS_UNIT "FMI" /end CHARACTERISTIC
/begin CHARACTERISTIC FCfmi_FPP2_max "FCtl_FMI(21)" VALUE 0x001E5916 /* @ECU_Address@FCtl_FMI@0x021B7015@ */ ECIPP_ALIGNMENT_UBYTE 255 Compu_IDENTITY 0 255 PHYS_UNIT "FMI" /end CHARACTERISTIC
/begin CHARACTERISTIC FCfmi_FPP2_min "FCtl_FMI(22)" VALUE 0x001E5917 /* @ECU_Address@FCtl_FMI@0x021B7016@ */ ECIPP_ALIGNMENT_UBYTE 255 Compu_IDENTITY 0 255 PHYS_UNIT "FMI" /end CHARACTERISTIC
/begin CHARACTERISTIC FCfmi_FPP2V_TSC1 "FCtl_FMI(839)" VALUE 0x001E5C48 /* @ECU_Address@FCtl_FMI@0x021B7347@ */ ECIPP_ALIGNMENT_UBYTE 255 Compu_IDENTITY 0 255 PHYS_UNIT "FMI" /end CHARACTERISTIC
/begin CHARACTERISTIC FCfmi_FPrly_coilopen "FCtl_FMI(168)" VALUE 0x001E59A9 /* @ECU_Address@FCtl_FMI@0x021B70A8@ */ ECIPP_ALIGNMENT_UBYTE 255 Compu_IDENTITY 0 255 PHYS_UNIT "FMI" /end CHARACTERISTIC
/begin CHARACTERISTIC FCftb_EGRdP_HiExp "FCtl_FTB_0x04(752)" VALUE 0x001E6007 /* @ECU_Address@FCtl_FTB_0x04@0x024C52F0@ */ ECIPP_ALIGNMENT_UBYTE 255 Compu_IDENTITY 0 255 PHYS_UNIT "FTB" /end CHARACTERISTIC
/begin CHARACTERISTIC FCftb_EGRdP_lo_LP_discon "FCtl_FTB_0x04(866)" VALUE 0x001E6079 /* @ECU_Address@FCtl_FTB_0x04@0x024C5362@ */ ECIPP_ALIGNMENT_UBYTE 255 Compu_IDENTITY 0 255 PHYS_UNIT "FTB" /end CHARACTERISTIC
/begin CHARACTERISTIC FCftb_EGRdP_lo_reversed "FCtl_FTB_0x04(865)" VALUE 0x001E6078 /* @ECU_Address@FCtl_FTB_0x04@0x024C5361@ */ ECIPP_ALIGNMENT_UBYTE 255 Compu_IDENTITY 0 255 PHYS_UNIT "FTB" /end CHARACTERISTIC
/begin CHARACTERISTIC FCftb_EGRdP_LoExp "FCtl_FTB_0x04(751)" VALUE 0x001E6006 /* @ECU_Address@FCtl_FTB_0x04@0x024C52EF@ */ ECIPP_ALIGNMENT_UBYTE 255 Compu_IDENTITY 0 255 PHYS_UNIT "FTB" /end CHARACTERISTIC
/begin CHARACTERISTIC FCftb_EGRdP_maxv "FCtl_FTB_0x04(749)" VALUE 0x001E6004 /* @ECU_Address@FCtl_FTB_0x04@0x024C52ED@ */ ECIPP_ALIGNMENT_UBYTE 255 Compu_IDENTITY 0 255 PHYS_UNIT "FTB" /end CHARACTERISTIC
/begin CHARACTERISTIC FCftb_EGRdP_minv "FCtl_FTB_0x04(750)" VALUE 0x001E6005 /* @ECU_Address@FCtl_FTB_0x04@0x024C52EE@ */ ECIPP_ALIGNMENT_UBYTE 255 Compu_IDENTITY 0 255 PHYS_UNIT "FTB" /end CHARACTERISTIC
/begin CHARACTERISTIC FCftb_EGRflow_HiExp "FCtl_FTB_0x04(597)" VALUE 0x001E5F6C /* @ECU_Address@FCtl_FTB_0x04@0x024C5255@ */ ECIPP_ALIGNMENT_UBYTE 255 Compu_IDENTITY 0 255 PHYS_UNIT "FTB" /end CHARACTERISTIC
/begin CHARACTERISTIC FCftb_EGRflow_LoExp "FCtl_FTB_0x04(596)" VALUE 0x001E5F6B /* @ECU_Address@FCtl_FTB_0x04@0x024C5254@ */ ECIPP_ALIGNMENT_UBYTE 255 Compu_IDENTITY 0 255 PHYS_UNIT "FTB" /end CHARACTERISTIC
/begin CHARACTERISTIC FCftb_EGRflow_LoExp2 "FCtl_FTB_0x04(684)" VALUE 0x001E5FC3 /* @ECU_Address@FCtl_FTB_0x04@0x024C52AC@ */ ECIPP_ALIGNMENT_UBYTE 255 Compu_IDENTITY 0 255 PHYS_UNIT "FTB" /end CHARACTERISTIC
/begin CHARACTERISTIC FCftb_EGRHP_maxv "FCtl_FTB_0x04(753)" VALUE 0x001E6008 /* @ECU_Address@FCtl_FTB_0x04@0x024C52F1@ */ ECIPP_ALIGNMENT_UBYTE 255 Compu_IDENTITY 0 255 PHYS_UNIT "FTB" /end CHARACTERISTIC
/begin CHARACTERISTIC FCftb_EGRHP_minv "FCtl_FTB_0x04(754)" VALUE 0x001E6009 /* @ECU_Address@FCtl_FTB_0x04@0x024C52F2@ */ ECIPP_ALIGNMENT_UBYTE 255 Compu_IDENTITY 0 255 PHYS_UNIT "FTB" /end CHARACTERISTIC
/begin CHARACTERISTIC FCftb_EGRHP_OOR "FCtl_FTB_0x04(755)" VALUE 0x001E600A /* @ECU_Address@FCtl_FTB_0x04@0x024C52F3@ */ ECIPP_ALIGNMENT_UBYTE 255 Compu_IDENTITY 0 255 PHYS_UNIT "FTB" /end CHARACTERISTIC
/begin CHARACTERISTIC FCftb_EGRO_postlk "FCtl_FTB_0x04(798)" VALUE 0x001E6035 /* @ECU_Address@FCtl_FTB_0x04@0x024C531E@ */ ECIPP_ALIGNMENT_UBYTE 255 Compu_IDENTITY 0 255 PHYS_UNIT "FTB" /end CHARACTERISTIC
/begin CHARACTERISTIC FCftb_EGRT_hi "FCtl_FTB_0x04(694)" VALUE 0x001E5FCD /* @ECU_Address@FCtl_FTB_0x04@0x024C52B6@ */ ECIPP_ALIGNMENT_UBYTE 255 Compu_IDENTITY 0 255 PHYS_UNIT "FTB" /end CHARACTERISTIC
/begin CHARACTERISTIC FCftb_EGRT_maxv "FCtl_FTB_0x04(692)" VALUE 0x001E5FCB /* @ECU_Address@FCtl_FTB_0x04@0x024C52B4@ */ ECIPP_ALIGNMENT_UBYTE 255 Compu_IDENTITY 0 255 PHYS_UNIT "FTB" /end CHARACTERISTIC
/begin CHARACTERISTIC FCftb_EGRT_minv "FCtl_FTB_0x04(693)" VALUE 0x001E5FCC /* @ECU_Address@FCtl_FTB_0x04@0x024C52B5@ */ ECIPP_ALIGNMENT_UBYTE 255 Compu_IDENTITY 0 255 PHYS_UNIT "FTB" /end CHARACTERISTIC
/begin CHARACTERISTIC FCftb_EGT_dig_Hi "FCtl_FTB_0x04(187)" VALUE 0x001E5DD2 /* @ECU_Address@FCtl_FTB_0x04@0x024C50BB@ */ ECIPP_ALIGNMENT_UBYTE 255 Compu_IDENTITY 0 255 PHYS_UNIT "FTB" /end CHARACTERISTIC
/begin CHARACTERISTIC FCftb_EGT_maxv "FCtl_FTB_0x04(808)" VALUE 0x001E603F /* @ECU_Address@FCtl_FTB_0x04@0x024C5328@ */ ECIPP_ALIGNMENT_UBYTE 255 Compu_IDENTITY 0 255 PHYS_UNIT "FTB" /end CHARACTERISTIC
/begin CHARACTERISTIC FCftb_EGT_minv "FCtl_FTB_0x04(809)" VALUE 0x001E6040 /* @ECU_Address@FCtl_FTB_0x04@0x024C5329@ */ ECIPP_ALIGNMENT_UBYTE 255 Compu_IDENTITY 0 255 PHYS_UNIT "FTB" /end CHARACTERISTIC
/begin CHARACTERISTIC FCftb_EMWT1_HiExp1 "FCtl_FTB_0x04(225)" VALUE 0x001E5DF8 /* @ECU_Address@FCtl_FTB_0x04@0x024C50E1@ */ ECIPP_ALIGNMENT_UBYTE 255 Compu_IDENTITY 0 255 PHYS_UNIT "FTB" /end CHARACTERISTIC
/begin CHARACTERISTIC FCftb_EMWT1_HiExp2 "FCtl_FTB_0x04(227)" VALUE 0x001E5DFA /* @ECU_Address@FCtl_FTB_0x04@0x024C50E3@ */ ECIPP_ALIGNMENT_UBYTE 255 Compu_IDENTITY 0 255 PHYS_UNIT "FTB" /end CHARACTERISTIC
/begin CHARACTERISTIC FCftb_EMWT1_maxv "FCtl_FTB_0x04(221)" VALUE 0x001E5DF4 /* @ECU_Address@FCtl_FTB_0x04@0x024C50DD@ */ ECIPP_ALIGNMENT_UBYTE 255 Compu_IDENTITY 0 255 PHYS_UNIT "FTB" /end CHARACTERISTIC
/begin CHARACTERISTIC FCftb_EMWT1_minv "FCtl_FTB_0x04(223)" VALUE 0x001E5DF6 /* @ECU_Address@FCtl_FTB_0x04@0x024C50DF@ */ ECIPP_ALIGNMENT_UBYTE 255 Compu_IDENTITY 0 255 PHYS_UNIT "FTB" /end CHARACTERISTIC
/begin CHARACTERISTIC FCftb_envtech_AAT_inv "FCtl_FTB_0x04(814)" VALUE 0x001E6045 /* @ECU_Address@FCtl_FTB_0x04@0x024C532E@ */ ECIPP_ALIGNMENT_UBYTE 255 Compu_IDENTITY 0 255 PHYS_UNIT "FTB" /end CHARACTERISTIC
/begin CHARACTERISTIC FCftb_envtech_BP_inv "FCtl_FTB_0x04(815)" VALUE 0x001E6046 /* @ECU_Address@FCtl_FTB_0x04@0x024C532F@ */ ECIPP_ALIGNMENT_UBYTE 255 Compu_IDENTITY 0 255 PHYS_UNIT "FTB" /end CHARACTERISTIC
/begin CHARACTERISTIC FCftb_envtech_comm "FCtl_FTB_0x04(358)" VALUE 0x001E5E7D /* @ECU_Address@FCtl_FTB_0x04@0x024C5166@ */ ECIPP_ALIGNMENT_UBYTE 255 Compu_IDENTITY 0 255 PHYS_UNIT "FTB" /end CHARACTERISTIC
/begin CHARACTERISTIC FCftb_envtech_general "FCtl_FTB_0x04(817)" VALUE 0x001E6048 /* @ECU_Address@FCtl_FTB_0x04@0x024C5331@ */ ECIPP_ALIGNMENT_UBYTE 255 Compu_IDENTITY 0 255 PHYS_UNIT "FTB" /end CHARACTERISTIC
/begin CHARACTERISTIC FCftb_envtech_RH_inv "FCtl_FTB_0x04(816)" VALUE 0x001E6047 /* @ECU_Address@FCtl_FTB_0x04@0x024C5330@ */ ECIPP_ALIGNMENT_UBYTE 255 Compu_IDENTITY 0 255 PHYS_UNIT "FTB" /end CHARACTERISTIC
/begin CHARACTERISTIC FCftb_envtech_RH_uns "FCtl_FTB_0x04(818)" VALUE 0x001E6049 /* @ECU_Address@FCtl_FTB_0x04@0x024C5332@ */ ECIPP_ALIGNMENT_UBYTE 255 Compu_IDENTITY 0 255 PHYS_UNIT "FTB" /end CHARACTERISTIC
/begin CHARACTERISTIC FCftb_ERCV_speed_OOR "FCtl_FTB_0x04(853)" VALUE 0x001E606C /* @ECU_Address@FCtl_FTB_0x04@0x024C5355@ */ ECIPP_ALIGNMENT_UBYTE 255 Compu_IDENTITY 0 255 PHYS_UNIT "FTB" /end CHARACTERISTIC
/begin CHARACTERISTIC FCftb_ERWT1_HiExp1 "FCtl_FTB_0x04(237)" VALUE 0x001E5E04 /* @ECU_Address@FCtl_FTB_0x04@0x024C50ED@ */ ECIPP_ALIGNMENT_UBYTE 255 Compu_IDENTITY 0 255 PHYS_UNIT "FTB" /end CHARACTERISTIC
/begin CHARACTERISTIC FCftb_ERWT1_HiExp2 "FCtl_FTB_0x04(239)" VALUE 0x001E5E06 /* @ECU_Address@FCtl_FTB_0x04@0x024C50EF@ */ ECIPP_ALIGNMENT_UBYTE 255 Compu_IDENTITY 0 255 PHYS_UNIT "FTB" /end CHARACTERISTIC
/begin CHARACTERISTIC FCftb_ERWT1_maxv "FCtl_FTB_0x04(233)" VALUE 0x001E5E00 /* @ECU_Address@FCtl_FTB_0x04@0x024C50E9@ */ ECIPP_ALIGNMENT_UBYTE 255 Compu_IDENTITY 0 255 PHYS_UNIT "FTB" /end CHARACTERISTIC
/begin CHARACTERISTIC FCftb_ERWT1_minv "FCtl_FTB_0x04(235)" VALUE 0x001E5E02 /* @ECU_Address@FCtl_FTB_0x04@0x024C50EB@ */ ECIPP_ALIGNMENT_UBYTE 255 Compu_IDENTITY 0 255 PHYS_UNIT "FTB" /end CHARACTERISTIC
/begin CHARACTERISTIC FCftb_F1OOR_F2IVS "FCtl_FTB_0x04(178)" VALUE 0x001E5DC9 /* @ECU_Address@FCtl_FTB_0x04@0x024C50B2@ */ ECIPP_ALIGNMENT_UBYTE 255 Compu_IDENTITY 0 255 PHYS_UNIT "FTB" /end CHARACTERISTIC
/begin CHARACTERISTIC FCftb_F2OOR_F1IVS "FCtl_FTB_0x04(179)" VALUE 0x001E5DCA /* @ECU_Address@FCtl_FTB_0x04@0x024C50B3@ */ ECIPP_ALIGNMENT_UBYTE 255 Compu_IDENTITY 0 255 PHYS_UNIT "FTB" /end CHARACTERISTIC
/begin CHARACTERISTIC FCftb_FCoolH2O_lo "FCtl_FTB_0x04(532)" VALUE 0x001E5F2B /* @ECU_Address@FCtl_FTB_0x04@0x024C5214@ */ ECIPP_ALIGNMENT_UBYTE 255 Compu_IDENTITY 0 255 PHYS_UNIT "FTB" /end CHARACTERISTIC
/begin CHARACTERISTIC FCftb_FIMP_pct_high "FCtl_FTB_0x04(282)" VALUE 0x001E5E31 /* @ECU_Address@FCtl_FTB_0x04@0x024C511A@ */ ECIPP_ALIGNMENT_UBYTE 255 Compu_IDENTITY 0 255 PHYS_UNIT "FTB" /end CHARACTERISTIC
/begin CHARACTERISTIC FCftb_FIP_LoExp "FCtl_FTB_0x04(695)" VALUE 0x001E5FCE /* @ECU_Address@FCtl_FTB_0x04@0x024C52B7@ */ ECIPP_ALIGNMENT_UBYTE 255 Compu_IDENTITY 0 255 PHYS_UNIT "FTB" /end CHARACTERISTIC
/begin CHARACTERISTIC FCftb_flash_fail "FCtl_FTB_0x04(105)" VALUE 0x001E5D80 /* @ECU_Address@FCtl_FTB_0x04@0x024C5069@ */ ECIPP_ALIGNMENT_UBYTE 255 Compu_IDENTITY 0 255 PHYS_UNIT "FTB" /end CHARACTERISTIC
/begin CHARACTERISTIC FCftb_FOP_start "FCtl_FTB_0x04(1016)" VALUE 0x001E610F /* @ECU_Address@FCtl_FTB_0x04@0x024C53F8@ */ ECIPP_ALIGNMENT_UBYTE 255 Compu_IDENTITY 0 255 PHYS_UNIT "FTB" /end CHARACTERISTIC
/begin CHARACTERISTIC FCftb_FP_high "FCtl_FTB_0x04(290)" VALUE 0x001E5E39 /* @ECU_Address@FCtl_FTB_0x04@0x024C5122@ */ ECIPP_ALIGNMENT_UBYTE 255 Compu_IDENTITY 0 255 PHYS_UNIT "FTB" /end CHARACTERISTIC
/begin CHARACTERISTIC FCftb_FP_low "FCtl_FTB_0x04(291)" VALUE 0x001E5E3A /* @ECU_Address@FCtl_FTB_0x04@0x024C5123@ */ ECIPP_ALIGNMENT_UBYTE 255 Compu_IDENTITY 0 255 PHYS_UNIT "FTB" /end CHARACTERISTIC
/begin CHARACTERISTIC FCftb_FP_maxv "FCtl_FTB_0x04(128)" VALUE 0x001E5D97 /* @ECU_Address@FCtl_FTB_0x04@0x024C5080@ */ ECIPP_ALIGNMENT_UBYTE 255 Compu_IDENTITY 0 255 PHYS_UNIT "FTB" /end CHARACTERISTIC
/begin CHARACTERISTIC FCftb_FP_minv "FCtl_FTB_0x04(129)" VALUE 0x001E5D98 /* @ECU_Address@FCtl_FTB_0x04@0x024C5081@ */ ECIPP_ALIGNMENT_UBYTE 255 Compu_IDENTITY 0 255 PHYS_UNIT "FTB" /end CHARACTERISTIC
/begin CHARACTERISTIC FCftb_FP2_high "FCtl_FTB_0x04(463)" VALUE 0x001E5EE6 /* @ECU_Address@FCtl_FTB_0x04@0x024C51CF@ */ ECIPP_ALIGNMENT_UBYTE 255 Compu_IDENTITY 0 255 PHYS_UNIT "FTB" /end CHARACTERISTIC
/begin CHARACTERISTIC FCftb_FP2_low "FCtl_FTB_0x04(464)" VALUE 0x001E5EE7 /* @ECU_Address@FCtl_FTB_0x04@0x024C51D0@ */ ECIPP_ALIGNMENT_UBYTE 255 Compu_IDENTITY 0 255 PHYS_UNIT "FTB" /end CHARACTERISTIC
/begin CHARACTERISTIC FCftb_FP2_maxv "FCtl_FTB_0x04(461)" VALUE 0x001E5EE4 /* @ECU_Address@FCtl_FTB_0x04@0x024C51CD@ */ ECIPP_ALIGNMENT_UBYTE 255 Compu_IDENTITY 0 255 PHYS_UNIT "FTB" /end CHARACTERISTIC
/begin CHARACTERISTIC FCftb_FP2_minv "FCtl_FTB_0x04(462)" VALUE 0x001E5EE5 /* @ECU_Address@FCtl_FTB_0x04@0x024C51CE@ */ ECIPP_ALIGNMENT_UBYTE 255 Compu_IDENTITY 0 255 PHYS_UNIT "FTB" /end CHARACTERISTIC
/begin CHARACTERISTIC FCftb_FPD_off_hi "FCtl_FTB_0x04(94)" VALUE 0x001E5D75 /* @ECU_Address@FCtl_FTB_0x04@0x024C505E@ */ ECIPP_ALIGNMENT_UBYTE 255 Compu_IDENTITY 0 255 PHYS_UNIT "FTB" /end CHARACTERISTIC
/begin CHARACTERISTIC FCftb_FPD_on_lo "FCtl_FTB_0x04(93)" VALUE 0x001E5D74 /* @ECU_Address@FCtl_FTB_0x04@0x024C505D@ */ ECIPP_ALIGNMENT_UBYTE 255 Compu_IDENTITY 0 255 PHYS_UNIT "FTB" /end CHARACTERISTIC
/begin CHARACTERISTIC FCftb_FPlo_derate_actv "FCtl_FTB_0x04(807)" VALUE 0x001E603E /* @ECU_Address@FCtl_FTB_0x04@0x024C5327@ */ ECIPP_ALIGNMENT_UBYTE 255 Compu_IDENTITY 0 255 PHYS_UNIT "FTB" /end CHARACTERISTIC
/begin CHARACTERISTIC FCftb_FPlo_derate_excess "FCtl_FTB_0x04(810)" VALUE 0x001E6041 /* @ECU_Address@FCtl_FTB_0x04@0x024C532A@ */ ECIPP_ALIGNMENT_UBYTE 255 Compu_IDENTITY 0 255 PHYS_UNIT "FTB" /end CHARACTERISTIC
/begin CHARACTERISTIC FCftb_FPP_NeutLock_fail "FCtl_FTB_0x04(658)" VALUE 0x001E5FA9 /* @ECU_Address@FCtl_FTB_0x04@0x024C5292@ */ ECIPP_ALIGNMENT_UBYTE 255 Compu_IDENTITY 0 255 PHYS_UNIT "FTB" /end CHARACTERISTIC
/begin CHARACTERISTIC FCftb_FPP1_IVS_max "FCtl_FTB_0x04(23)" VALUE 0x001E5D2E /* @ECU_Address@FCtl_FTB_0x04@0x024C5017@ */ ECIPP_ALIGNMENT_UBYTE 255 Compu_IDENTITY 0 255 PHYS_UNIT "FTB" /end CHARACTERISTIC
/begin CHARACTERISTIC FCftb_FPP1_IVS_min "FCtl_FTB_0x04(24)" VALUE 0x001E5D2F /* @ECU_Address@FCtl_FTB_0x04@0x024C5018@ */ ECIPP_ALIGNMENT_UBYTE 255 Compu_IDENTITY 0 255 PHYS_UNIT "FTB" /end CHARACTERISTIC
/begin CHARACTERISTIC FCftb_FPP1_max "FCtl_FTB_0x04(19)" VALUE 0x001E5D2A /* @ECU_Address@FCtl_FTB_0x04@0x024C5013@ */ ECIPP_ALIGNMENT_UBYTE 255 Compu_IDENTITY 0 255 PHYS_UNIT "FTB" /end CHARACTERISTIC
/begin CHARACTERISTIC FCftb_FPP1_min "FCtl_FTB_0x04(20)" VALUE 0x001E5D2B /* @ECU_Address@FCtl_FTB_0x04@0x024C5014@ */ ECIPP_ALIGNMENT_UBYTE 255 Compu_IDENTITY 0 255 PHYS_UNIT "FTB" /end CHARACTERISTIC
/begin CHARACTERISTIC FCftb_FPP12_IVS_max "FCtl_FTB_0x04(175)" VALUE 0x001E5DC6 /* @ECU_Address@FCtl_FTB_0x04@0x024C50AF@ */ ECIPP_ALIGNMENT_UBYTE 255 Compu_IDENTITY 0 255 PHYS_UNIT "FTB" /end CHARACTERISTIC
/begin CHARACTERISTIC FCftb_FPP12_IVS_min "FCtl_FTB_0x04(176)" VALUE 0x001E5DC7 /* @ECU_Address@FCtl_FTB_0x04@0x024C50B0@ */ ECIPP_ALIGNMENT_UBYTE 255 Compu_IDENTITY 0 255 PHYS_UNIT "FTB" /end CHARACTERISTIC
/begin CHARACTERISTIC FCftb_FPP12_OOR "FCtl_FTB_0x04(177)" VALUE 0x001E5DC8 /* @ECU_Address@FCtl_FTB_0x04@0x024C50B1@ */ ECIPP_ALIGNMENT_UBYTE 255 Compu_IDENTITY 0 255 PHYS_UNIT "FTB" /end CHARACTERISTIC
/begin CHARACTERISTIC FCftb_FPP12IVS_TSC1 "FCtl_FTB_0x04(734)" VALUE 0x001E5FF5 /* @ECU_Address@FCtl_FTB_0x04@0x024C52DE@ */ ECIPP_ALIGNMENT_UBYTE 255 Compu_IDENTITY 0 255 PHYS_UNIT "FTB" /end CHARACTERISTIC
/begin CHARACTERISTIC FCftb_FPP12MM_IVSMM "FCtl_FTB_0x04(180)" VALUE 0x001E5DCB /* @ECU_Address@FCtl_FTB_0x04@0x024C50B4@ */ ECIPP_ALIGNMENT_UBYTE 255 Compu_IDENTITY 0 255 PHYS_UNIT "FTB" /end CHARACTERISTIC
/begin CHARACTERISTIC FCftb_FPP12pct_hi "FCtl_FTB_0x04(27)" VALUE 0x001E5D32 /* @ECU_Address@FCtl_FTB_0x04@0x024C501B@ */ ECIPP_ALIGNMENT_UBYTE 255 Compu_IDENTITY 0 255 PHYS_UNIT "FTB" /end CHARACTERISTIC
/begin CHARACTERISTIC FCftb_FPP12pct_lo "FCtl_FTB_0x04(28)" VALUE 0x001E5D33 /* @ECU_Address@FCtl_FTB_0x04@0x024C501C@ */ ECIPP_ALIGNMENT_UBYTE 255 Compu_IDENTITY 0 255 PHYS_UNIT "FTB" /end CHARACTERISTIC
/begin CHARACTERISTIC FCftb_FPP2_IVS_max "FCtl_FTB_0x04(25)" VALUE 0x001E5D30 /* @ECU_Address@FCtl_FTB_0x04@0x024C5019@ */ ECIPP_ALIGNMENT_UBYTE 255 Compu_IDENTITY 0 255 PHYS_UNIT "FTB" /end CHARACTERISTIC
/begin CHARACTERISTIC FCftb_FPP2_IVS_min "FCtl_FTB_0x04(26)" VALUE 0x001E5D31 /* @ECU_Address@FCtl_FTB_0x04@0x024C501A@ */ ECIPP_ALIGNMENT_UBYTE 255 Compu_IDENTITY 0 255 PHYS_UNIT "FTB" /end CHARACTERISTIC
/begin CHARACTERISTIC FCftb_FPP2_max "FCtl_FTB_0x04(21)" VALUE 0x001E5D2C /* @ECU_Address@FCtl_FTB_0x04@0x024C5015@ */ ECIPP_ALIGNMENT_UBYTE 255 Compu_IDENTITY 0 255 PHYS_UNIT "FTB" /end CHARACTERISTIC
/begin CHARACTERISTIC FCftb_FPP2_min "FCtl_FTB_0x04(22)" VALUE 0x001E5D2D /* @ECU_Address@FCtl_FTB_0x04@0x024C5016@ */ ECIPP_ALIGNMENT_UBYTE 255 Compu_IDENTITY 0 255 PHYS_UNIT "FTB" /end CHARACTERISTIC
/begin CHARACTERISTIC FCftb_FPP2V_TSC1 "FCtl_FTB_0x04(839)" VALUE 0x001E605E /* @ECU_Address@FCtl_FTB_0x04@0x024C5347@ */ ECIPP_ALIGNMENT_UBYTE 255 Compu_IDENTITY 0 255 PHYS_UNIT "FTB" /end CHARACTERISTIC
/begin CHARACTERISTIC FCftb_FPrly_coilopen "FCtl_FTB_0x04(168)" VALUE 0x001E5DBF /* @ECU_Address@FCtl_FTB_0x04@0x024C50A8@ */ ECIPP_ALIGNMENT_UBYTE 255 Compu_IDENTITY 0 255 PHYS_UNIT "FTB" /end CHARACTERISTIC
/begin CHARACTERISTIC FCspn_EGRdP_HiExp "FCtl_SPN(752)" VALUE 0x001E2924 /* @ECU_Address@FCtl_SPN@0x21B60BC0@ */ ECIPP_ALIGNMENT_ULONG 4294967295 Compu_IDENTITY 0 4294967295 PHYS_UNIT "SPN" /end CHARACTERISTIC
/begin CHARACTERISTIC FCspn_EGRdP_lo_LP_discon "FCtl_SPN(866)" VALUE 0x001E2AEC /* @ECU_Address@FCtl_SPN@0x21B60D88@ */ ECIPP_ALIGNMENT_ULONG 4294967295 Compu_IDENTITY 0 4294967295 PHYS_UNIT "SPN" /end CHARACTERISTIC
/begin CHARACTERISTIC FCspn_EGRdP_lo_reversed "FCtl_SPN(865)" VALUE 0x001E2AE8 /* @ECU_Address@FCtl_SPN@0x21B60D84@ */ ECIPP_ALIGNMENT_ULONG 4294967295 Compu_IDENTITY 0 4294967295 PHYS_UNIT "SPN" /end CHARACTERISTIC
/begin CHARACTERISTIC FCspn_EGRdP_LoExp "FCtl_SPN(751)" VALUE 0x001E2920 /* @ECU_Address@FCtl_SPN@0x21B60BBC@ */ ECIPP_ALIGNMENT_ULONG 4294967295 Compu_IDENTITY 0 4294967295 PHYS_UNIT "SPN" /end CHARACTERISTIC
/begin CHARACTERISTIC FCspn_EGRdP_maxv "FCtl_SPN(749)" VALUE 0x001E2918 /* @ECU_Address@FCtl_SPN@0x21B60BB4@ */ ECIPP_ALIGNMENT_ULONG 4294967295 Compu_IDENTITY 0 4294967295 PHYS_UNIT "SPN" /end CHARACTERISTIC
/begin CHARACTERISTIC FCspn_EGRdP_minv "FCtl_SPN(750)" VALUE 0x001E291C /* @ECU_Address@FCtl_SPN@0x21B60BB8@ */ ECIPP_ALIGNMENT_ULONG 4294967295 Compu_IDENTITY 0 4294967295 PHYS_UNIT "SPN" /end CHARACTERISTIC
/begin CHARACTERISTIC FCspn_EGRflow_HiExp "FCtl_SPN(597)" VALUE 0x001E26B8 /* @ECU_Address@FCtl_SPN@0x21B60954@ */ ECIPP_ALIGNMENT_ULONG 4294967295 Compu_IDENTITY 0 4294967295 PHYS_UNIT "SPN" /end CHARACTERISTIC
/begin CHARACTERISTIC FCspn_EGRflow_LoExp "FCtl_SPN(596)" VALUE 0x001E26B4 /* @ECU_Address@FCtl_SPN@0x21B60950@ */ ECIPP_ALIGNMENT_ULONG 4294967295 Compu_IDENTITY 0 4294967295 PHYS_UNIT "SPN" /end CHARACTERISTIC
/begin CHARACTERISTIC FCspn_EGRflow_LoExp2 "FCtl_SPN(684)" VALUE 0x001E2814 /* @ECU_Address@FCtl_SPN@0x21B60AB0@ */ ECIPP_ALIGNMENT_ULONG 4294967295 Compu_IDENTITY 0 4294967295 PHYS_UNIT "SPN" /end CHARACTERISTIC
/begin CHARACTERISTIC FCspn_EGRHP_maxv "FCtl_SPN(753)" VALUE 0x001E2928 /* @ECU_Address@FCtl_SPN@0x21B60BC4@ */ ECIPP_ALIGNMENT_ULONG 4294967295 Compu_IDENTITY 0 4294967295 PHYS_UNIT "SPN" /end CHARACTERISTIC
/begin CHARACTERISTIC FCspn_EGRHP_minv "FCtl_SPN(754)" VALUE 0x001E292C /* @ECU_Address@FCtl_SPN@0x21B60BC8@ */ ECIPP_ALIGNMENT_ULONG 4294967295 Compu_IDENTITY 0 4294967295 PHYS_UNIT "SPN" /end CHARACTERISTIC
/begin CHARACTERISTIC FCspn_EGRHP_OOR "FCtl_SPN(755)" VALUE 0x001E2930 /* @ECU_Address@FCtl_SPN@0x21B60BCC@ */ ECIPP_ALIGNMENT_ULONG 4294967295 Compu_IDENTITY 0 4294967295 PHYS_UNIT "SPN" /end CHARACTERISTIC
/begin CHARACTERISTIC FCspn_EGRO_postlk "FCtl_SPN(798)" VALUE 0x001E29DC /* @ECU_Address@FCtl_SPN@0x21B60C78@ */ ECIPP_ALIGNMENT_ULONG 4294967295 Compu_IDENTITY 0 4294967295 PHYS_UNIT "SPN" /end CHARACTERISTIC
/begin CHARACTERISTIC FCspn_EGRT_hi "FCtl_SPN(694)" VALUE 0x001E283C /* @ECU_Address@FCtl_SPN@0x21B60AD8@ */ ECIPP_ALIGNMENT_ULONG 4294967295 Compu_IDENTITY 0 4294967295 PHYS_UNIT "SPN" /end CHARACTERISTIC
/begin CHARACTERISTIC FCspn_EGRT_maxv "FCtl_SPN(692)" VALUE 0x001E2834 /* @ECU_Address@FCtl_SPN@0x21B60AD0@ */ ECIPP_ALIGNMENT_ULONG 4294967295 Compu_IDENTITY 0 4294967295 PHYS_UNIT "SPN" /end CHARACTERISTIC
/begin CHARACTERISTIC FCspn_EGRT_minv "FCtl_SPN(693)" VALUE 0x001E2838 /* @ECU_Address@FCtl_SPN@0x21B60AD4@ */ ECIPP_ALIGNMENT_ULONG 4294967295 Compu_IDENTITY 0 4294967295 PHYS_UNIT "SPN" /end CHARACTERISTIC
/begin CHARACTERISTIC FCspn_EGT_dig_Hi "FCtl_SPN(187)" VALUE 0x001E2050 /* @ECU_Address@FCtl_SPN@0x21B602EC@ */ ECIPP_ALIGNMENT_ULONG 4294967295 Compu_IDENTITY 0 4294967295 PHYS_UNIT "SPN" /end CHARACTERISTIC
/begin CHARACTERISTIC FCspn_EGT_maxv "FCtl_SPN(808)" VALUE 0x001E2A04 /* @ECU_Address@FCtl_SPN@0x21B60CA0@ */ ECIPP_ALIGNMENT_ULONG 4294967295 Compu_IDENTITY 0 4294967295 PHYS_UNIT "SPN" /end CHARACTERISTIC
/begin CHARACTERISTIC FCspn_EGT_minv "FCtl_SPN(809)" VALUE 0x001E2A08 /* @ECU_Address@FCtl_SPN@0x21B60CA4@ */ ECIPP_ALIGNMENT_ULONG 4294967295 Compu_IDENTITY 0 4294967295 PHYS_UNIT "SPN" /end CHARACTERISTIC
/begin CHARACTERISTIC FCspn_EMWT1_HiExp1 "FCtl_SPN(225)" VALUE 0x001E20E8 /* @ECU_Address@FCtl_SPN@0x21B60384@ */ ECIPP_ALIGNMENT_ULONG 4294967295 Compu_IDENTITY 0 4294967295 PHYS_UNIT "SPN" /end CHARACTERISTIC
/begin CHARACTERISTIC FCspn_EMWT1_HiExp2 "FCtl_SPN(227)" VALUE 0x001E20F0 /* @ECU_Address@FCtl_SPN@0x21B6038C@ */ ECIPP_ALIGNMENT_ULONG 4294967295 Compu_IDENTITY 0 4294967295 PHYS_UNIT "SPN" /end CHARACTERISTIC
/begin CHARACTERISTIC FCspn_EMWT1_maxv "FCtl_SPN(221)" VALUE 0x001E20D8 /* @ECU_Address@FCtl_SPN@0x21B60374@ */ ECIPP_ALIGNMENT_ULONG 4294967295 Compu_IDENTITY 0 4294967295 PHYS_UNIT "SPN" /end CHARACTERISTIC
/begin CHARACTERISTIC FCspn_EMWT1_minv "FCtl_SPN(223)" VALUE 0x001E20E0 /* @ECU_Address@FCtl_SPN@0x21B6037C@ */ ECIPP_ALIGNMENT_ULONG 4294967295 Compu_IDENTITY 0 4294967295 PHYS_UNIT "SPN" /end CHARACTERISTIC
/begin CHARACTERISTIC FCspn_envtech_AAT_inv "FCtl_SPN(814)" VALUE 0x001E2A1C /* @ECU_Address@FCtl_SPN@0x21B60CB8@ */ ECIPP_ALIGNMENT_ULONG 4294967295 Compu_IDENTITY 0 4294967295 PHYS_UNIT "SPN" /end CHARACTERISTIC
/begin CHARACTERISTIC FCspn_envtech_BP_inv "FCtl_SPN(815)" VALUE 0x001E2A20 /* @ECU_Address@FCtl_SPN@0x21B60CBC@ */ ECIPP_ALIGNMENT_ULONG 4294967295 Compu_IDENTITY 0 4294967295 PHYS_UNIT "SPN" /end CHARACTERISTIC
/begin CHARACTERISTIC FCspn_envtech_comm "FCtl_SPN(358)" VALUE 0x001E22FC /* @ECU_Address@FCtl_SPN@0x21B60598@ */ ECIPP_ALIGNMENT_ULONG 4294967295 Compu_IDENTITY 0 4294967295 PHYS_UNIT "SPN" /end CHARACTERISTIC
/begin CHARACTERISTIC FCspn_envtech_general "FCtl_SPN(817)" VALUE 0x001E2A28 /* @ECU_Address@FCtl_SPN@0x21B60CC4@ */ ECIPP_ALIGNMENT_ULONG 4294967295 Compu_IDENTITY 0 4294967295 PHYS_UNIT "SPN" /end CHARACTERISTIC
/begin CHARACTERISTIC FCspn_envtech_RH_inv "FCtl_SPN(816)" VALUE 0x001E2A24 /* @ECU_Address@FCtl_SPN@0x21B60CC0@ */ ECIPP_ALIGNMENT_ULONG 4294967295 Compu_IDENTITY 0 4294967295 PHYS_UNIT "SPN" /end CHARACTERISTIC
/begin CHARACTERISTIC FCspn_envtech_RH_uns "FCtl_SPN(818)" VALUE 0x001E2A2C /* @ECU_Address@FCtl_SPN@0x21B60CC8@ */ ECIPP_ALIGNMENT_ULONG 4294967295 Compu_IDENTITY 0 4294967295 PHYS_UNIT "SPN" /end CHARACTERISTIC
/begin CHARACTERISTIC FCspn_ERCV_speed_OOR "FCtl_SPN(853)" VALUE 0x001E2AB8 /* @ECU_Address@FCtl_SPN@0x21B60D54@ */ ECIPP_ALIGNMENT_ULONG 4294967295 Compu_IDENTITY 0 4294967295 PHYS_UNIT "SPN" /end CHARACTERISTIC
/begin CHARACTERISTIC FCspn_ERWT1_HiExp1 "FCtl_SPN(237)" VALUE 0x001E2118 /* @ECU_Address@FCtl_SPN@0x21B603B4@ */ ECIPP_ALIGNMENT_ULONG 4294967295 Compu_IDENTITY 0 4294967295 PHYS_UNIT "SPN" /end CHARACTERISTIC
/begin CHARACTERISTIC FCspn_ERWT1_HiExp2 "FCtl_SPN(239)" VALUE 0x001E2120 /* @ECU_Address@FCtl_SPN@0x21B603BC@ */ ECIPP_ALIGNMENT_ULONG 4294967295 Compu_IDENTITY 0 4294967295 PHYS_UNIT "SPN" /end CHARACTERISTIC
/begin CHARACTERISTIC FCspn_ERWT1_maxv "FCtl_SPN(233)" VALUE 0x001E2108 /* @ECU_Address@FCtl_SPN@0x21B603A4@ */ ECIPP_ALIGNMENT_ULONG 4294967295 Compu_IDENTITY 0 4294967295 PHYS_UNIT "SPN" /end CHARACTERISTIC
/begin CHARACTERISTIC FCspn_ERWT1_minv "FCtl_SPN(235)" VALUE 0x001E2110 /* @ECU_Address@FCtl_SPN@0x21B603AC@ */ ECIPP_ALIGNMENT_ULONG 4294967295 Compu_IDENTITY 0 4294967295 PHYS_UNIT "SPN" /end CHARACTERISTIC
/begin CHARACTERISTIC FCspn_F1OOR_F2IVS "FCtl_SPN(178)" VALUE 0x001E202C /* @ECU_Address@FCtl_SPN@0x21B602C8@ */ ECIPP_ALIGNMENT_ULONG 4294967295 Compu_IDENTITY 0 4294967295 PHYS_UNIT "SPN" /end CHARACTERISTIC
/begin CHARACTERISTIC FCspn_F2OOR_F1IVS "FCtl_SPN(179)" VALUE 0x001E2030 /* @ECU_Address@FCtl_SPN@0x21B602CC@ */ ECIPP_ALIGNMENT_ULONG 4294967295 Compu_IDENTITY 0 4294967295 PHYS_UNIT "SPN" /end CHARACTERISTIC
/begin CHARACTERISTIC FCspn_FCoolH2O_lo "FCtl_SPN(532)" VALUE 0x001E25B4 /* @ECU_Address@FCtl_SPN@0x21B60850@ */ ECIPP_ALIGNMENT_ULONG 4294967295 Compu_IDENTITY 0 4294967295 PHYS_UNIT "SPN" /end CHARACTERISTIC
/begin CHARACTERISTIC FCspn_FIMP_pct_high "FCtl_SPN(282)" VALUE 0x001E21CC /* @ECU_Address@FCtl_SPN@0x21B60468@ */ ECIPP_ALIGNMENT_ULONG 4294967295 Compu_IDENTITY 0 4294967295 PHYS_UNIT "SPN" /end CHARACTERISTIC
/begin CHARACTERISTIC FCspn_FIP_LoExp "FCtl_SPN(695)" VALUE 0x001E2840 /* @ECU_Address@FCtl_SPN@0x21B60ADC@ */ ECIPP_ALIGNMENT_ULONG 4294967295 Compu_IDENTITY 0 4294967295 PHYS_UNIT "SPN" /end CHARACTERISTIC
/begin CHARACTERISTIC FCspn_flash_fail "FCtl_SPN(105)" VALUE 0x001E1F08 /* @ECU_Address@FCtl_SPN@0x21B601A4@ */ ECIPP_ALIGNMENT_ULONG 4294967295 Compu_IDENTITY 0 4294967295 PHYS_UNIT "SPN" /end CHARACTERISTIC
/begin CHARACTERISTIC FCspn_FOP_start "FCtl_SPN(1016)" VALUE 0x001E2D44 /* @ECU_Address@FCtl_SPN@0x21B60FE0@ */ ECIPP_ALIGNMENT_ULONG 4294967295 Compu_IDENTITY 0 4294967295 PHYS_UNIT "SPN" /end CHARACTERISTIC
/begin CHARACTERISTIC FCspn_FP_high "FCtl_SPN(290)" VALUE 0x001E21EC /* @ECU_Address@FCtl_SPN@0x21B60488@ */ ECIPP_ALIGNMENT_ULONG 4294967295 Compu_IDENTITY 0 4294967295 PHYS_UNIT "SPN" /end CHARACTERISTIC
/begin CHARACTERISTIC FCspn_FP_low "FCtl_SPN(291)" VALUE 0x001E21F0 /* @ECU_Address@FCtl_SPN@0x21B6048C@ */ ECIPP_ALIGNMENT_ULONG 4294967295 Compu_IDENTITY 0 4294967295 PHYS_UNIT "SPN" /end CHARACTERISTIC
/begin CHARACTERISTIC FCspn_FP_maxv "FCtl_SPN(128)" VALUE 0x001E1F64 /* @ECU_Address@FCtl_SPN@0x21B60200@ */ ECIPP_ALIGNMENT_ULONG 4294967295 Compu_IDENTITY 0 4294967295 PHYS_UNIT "SPN" /end CHARACTERISTIC
/begin CHARACTERISTIC FCspn_FP_minv "FCtl_SPN(129)" VALUE 0x001E1F68 /* @ECU_Address@FCtl_SPN@0x21B60204@ */ ECIPP_ALIGNMENT_ULONG 4294967295 Compu_IDENTITY 0 4294967295 PHYS_UNIT "SPN" /end CHARACTERISTIC
/begin CHARACTERISTIC FCspn_FP2_high "FCtl_SPN(463)" VALUE 0x001E24A0 /* @ECU_Address@FCtl_SPN@0x21B6073C@ */ ECIPP_ALIGNMENT_ULONG 4294967295 Compu_IDENTITY 0 4294967295 PHYS_UNIT "SPN" /end CHARACTERISTIC
/begin CHARACTERISTIC FCspn_FP2_low "FCtl_SPN(464)" VALUE 0x001E24A4 /* @ECU_Address@FCtl_SPN@0x21B60740@ */ ECIPP_ALIGNMENT_ULONG 4294967295 Compu_IDENTITY 0 4294967295 PHYS_UNIT "SPN" /end CHARACTERISTIC
/begin CHARACTERISTIC FCspn_FP2_maxv "FCtl_SPN(461)" VALUE 0x001E2498 /* @ECU_Address@FCtl_SPN@0x21B60734@ */ ECIPP_ALIGNMENT_ULONG 4294967295 Compu_IDENTITY 0 4294967295 PHYS_UNIT "SPN" /end CHARACTERISTIC
/begin CHARACTERISTIC FCspn_FP2_minv "FCtl_SPN(462)" VALUE 0x001E249C /* @ECU_Address@FCtl_SPN@0x21B60738@ */ ECIPP_ALIGNMENT_ULONG 4294967295 Compu_IDENTITY 0 4294967295 PHYS_UNIT "SPN" /end CHARACTERISTIC
/begin CHARACTERISTIC FCspn_FPD_off_hi "FCtl_SPN(94)" VALUE 0x001E1EDC /* @ECU_Address@FCtl_SPN@0x21B60178@ */ ECIPP_ALIGNMENT_ULONG 4294967295 Compu_IDENTITY 0 4294967295 PHYS_UNIT "SPN" /end CHARACTERISTIC
/begin CHARACTERISTIC FCspn_FPD_on_lo "FCtl_SPN(93)" VALUE 0x001E1ED8 /* @ECU_Address@FCtl_SPN@0x21B60174@ */ ECIPP_ALIGNMENT_ULONG 4294967295 Compu_IDENTITY 0 4294967295 PHYS_UNIT "SPN" /end CHARACTERISTIC
/begin CHARACTERISTIC FCspn_FPlo_derate_actv "FCtl_SPN(807)" VALUE 0x001E2A00 /* @ECU_Address@FCtl_SPN@0x21B60C9C@ */ ECIPP_ALIGNMENT_ULONG 4294967295 Compu_IDENTITY 0 4294967295 PHYS_UNIT "SPN" /end CHARACTERISTIC
/begin CHARACTERISTIC FCspn_FPlo_derate_excess "FCtl_SPN(810)" VALUE 0x001E2A0C /* @ECU_Address@FCtl_SPN@0x21B60CA8@ */ ECIPP_ALIGNMENT_ULONG 4294967295 Compu_IDENTITY 0 4294967295 PHYS_UNIT "SPN" /end CHARACTERISTIC
/begin CHARACTERISTIC FCspn_FPP_NeutLock_fail "FCtl_SPN(658)" VALUE 0x001E27AC /* @ECU_Address@FCtl_SPN@0x21B60A48@ */ ECIPP_ALIGNMENT_ULONG 4294967295 Compu_IDENTITY 0 4294967295 PHYS_UNIT "SPN" /end CHARACTERISTIC
/begin CHARACTERISTIC FCspn_FPP1_IVS_max "FCtl_SPN(23)" VALUE 0x001E1DC0 /* @ECU_Address@FCtl_SPN@0x21B6005C@ */ ECIPP_ALIGNMENT_ULONG 4294967295 Compu_IDENTITY 0 4294967295 PHYS_UNIT "SPN" /end CHARACTERISTIC
/begin CHARACTERISTIC FCspn_FPP1_IVS_min "FCtl_SPN(24)" VALUE 0x001E1DC4 /* @ECU_Address@FCtl_SPN@0x21B60060@ */ ECIPP_ALIGNMENT_ULONG 4294967295 Compu_IDENTITY 0 4294967295 PHYS_UNIT "SPN" /end CHARACTERISTIC
/begin CHARACTERISTIC FCspn_FPP1_max "FCtl_SPN(19)" VALUE 0x001E1DB0 /* @ECU_Address@FCtl_SPN@0x21B6004C@ */ ECIPP_ALIGNMENT_ULONG 4294967295 Compu_IDENTITY 0 4294967295 PHYS_UNIT "SPN" /end CHARACTERISTIC
/begin CHARACTERISTIC FCspn_FPP1_min "FCtl_SPN(20)" VALUE 0x001E1DB4 /* @ECU_Address@FCtl_SPN@0x21B60050@ */ ECIPP_ALIGNMENT_ULONG 4294967295 Compu_IDENTITY 0 4294967295 PHYS_UNIT "SPN" /end CHARACTERISTIC
/begin CHARACTERISTIC FCspn_FPP12_IVS_max "FCtl_SPN(175)" VALUE 0x001E2020 /* @ECU_Address@FCtl_SPN@0x21B602BC@ */ ECIPP_ALIGNMENT_ULONG 4294967295 Compu_IDENTITY 0 4294967295 PHYS_UNIT "SPN" /end CHARACTERISTIC
/begin CHARACTERISTIC FCspn_FPP12_IVS_min "FCtl_SPN(176)" VALUE 0x001E2024 /* @ECU_Address@FCtl_SPN@0x21B602C0@ */ ECIPP_ALIGNMENT_ULONG 4294967295 Compu_IDENTITY 0 4294967295 PHYS_UNIT "SPN" /end CHARACTERISTIC
/begin CHARACTERISTIC FCspn_FPP12_OOR "FCtl_SPN(177)" VALUE 0x001E2028 /* @ECU_Address@FCtl_SPN@0x21B602C4@ */ ECIPP_ALIGNMENT_ULONG 4294967295 Compu_IDENTITY 0 4294967295 PHYS_UNIT "SPN" /end CHARACTERISTIC
/begin CHARACTERISTIC FCspn_FPP12IVS_TSC1 "FCtl_SPN(734)" VALUE 0x001E28DC /* @ECU_Address@FCtl_SPN@0x21B60B78@ */ ECIPP_ALIGNMENT_ULONG 4294967295 Compu_IDENTITY 0 4294967295 PHYS_UNIT "SPN" /end CHARACTERISTIC
/begin CHARACTERISTIC FCspn_FPP12MM_IVSMM "FCtl_SPN(180)" VALUE 0x001E2034 /* @ECU_Address@FCtl_SPN@0x21B602D0@ */ ECIPP_ALIGNMENT_ULONG 4294967295 Compu_IDENTITY 0 4294967295 PHYS_UNIT "SPN" /end CHARACTERISTIC
/begin CHARACTERISTIC FCspn_FPP12pct_hi "FCtl_SPN(27)" VALUE 0x001E1DD0 /* @ECU_Address@FCtl_SPN@0x21B6006C@ */ ECIPP_ALIGNMENT_ULONG 4294967295 Compu_IDENTITY 0 4294967295 PHYS_UNIT "SPN" /end CHARACTERISTIC
/begin CHARACTERISTIC FCspn_FPP12pct_lo "FCtl_SPN(28)" VALUE 0x001E1DD4 /* @ECU_Address@FCtl_SPN@0x21B60070@ */ ECIPP_ALIGNMENT_ULONG 4294967295 Compu_IDENTITY 0 4294967295 PHYS_UNIT "SPN" /end CHARACTERISTIC
/begin CHARACTERISTIC FCspn_FPP2_IVS_max "FCtl_SPN(25)" VALUE 0x001E1DC8 /* @ECU_Address@FCtl_SPN@0x21B60064@ */ ECIPP_ALIGNMENT_ULONG 4294967295 Compu_IDENTITY 0 4294967295 PHYS_UNIT "SPN" /end CHARACTERISTIC
/begin CHARACTERISTIC FCspn_FPP2_IVS_min "FCtl_SPN(26)" VALUE 0x001E1DCC /* @ECU_Address@FCtl_SPN@0x21B60068@ */ ECIPP_ALIGNMENT_ULONG 4294967295 Compu_IDENTITY 0 4294967295 PHYS_UNIT "SPN" /end CHARACTERISTIC
/begin CHARACTERISTIC FCspn_FPP2_max "FCtl_SPN(21)" VALUE 0x001E1DB8 /* @ECU_Address@FCtl_SPN@0x21B60054@ */ ECIPP_ALIGNMENT_ULONG 4294967295 Compu_IDENTITY 0 4294967295 PHYS_UNIT "SPN" /end CHARACTERISTIC
/begin CHARACTERISTIC FCspn_FPP2_min "FCtl_SPN(22)" VALUE 0x001E1DBC /* @ECU_Address@FCtl_SPN@0x21B60058@ */ ECIPP_ALIGNMENT_ULONG 4294967295 Compu_IDENTITY 0 4294967295 PHYS_UNIT "SPN" /end CHARACTERISTIC
/begin CHARACTERISTIC FCspn_FPP2V_TSC1 "FCtl_SPN(839)" VALUE 0x001E2A80 /* @ECU_Address@FCtl_SPN@0x21B60D1C@ */ ECIPP_ALIGNMENT_ULONG 4294967295 Compu_IDENTITY 0 4294967295 PHYS_UNIT "SPN" /end CHARACTERISTIC
/begin CHARACTERISTIC FCspn_FPrly_coilopen "FCtl_SPN(168)" VALUE 0x001E2004 /* @ECU_Address@FCtl_SPN@0x21B602A0@ */ ECIPP_ALIGNMENT_ULONG 4294967295 Compu_IDENTITY 0 4294967295 PHYS_UNIT "SPN" /end CHARACTERISTIC
/begin CHARACTERISTIC FPfl_EGRdP_HiExp "FPrm_latch(582)" VALUE 0x001E0930 /* @ECU_Address@FPrm_latch@0x021BB918@ */ ECIPP_ALIGNMENT_FLOAT32_IEEE 10000000000 Compu_IDENTITY -10000000000 10000000000 PHYS_UNIT "ms" /end CHARACTERISTIC
/begin CHARACTERISTIC FPfl_EGRdP_lo_LP_discon "FPrm_latch(693)" VALUE 0x001E0AEC /* @ECU_Address@FPrm_latch@0x021BBAD4@ */ ECIPP_ALIGNMENT_FLOAT32_IEEE 10000000000 Compu_IDENTITY -10000000000 10000000000 PHYS_UNIT "ms" /end CHARACTERISTIC
/begin CHARACTERISTIC FPfl_EGRdP_lo_reversed "FPrm_latch(692)" VALUE 0x001E0AE8 /* @ECU_Address@FPrm_latch@0x021BBAD0@ */ ECIPP_ALIGNMENT_FLOAT32_IEEE 10000000000 Compu_IDENTITY -10000000000 10000000000 PHYS_UNIT "ms" /end CHARACTERISTIC
/begin CHARACTERISTIC FPfl_EGRdP_LoExp "FPrm_latch(581)" VALUE 0x001E092C /* @ECU_Address@FPrm_latch@0x021BB914@ */ ECIPP_ALIGNMENT_FLOAT32_IEEE 10000000000 Compu_IDENTITY -10000000000 10000000000 PHYS_UNIT "ms" /end CHARACTERISTIC
/begin CHARACTERISTIC FPfl_EGRdP_maxv "FPrm_latch(579)" VALUE 0x001E0924 /* @ECU_Address@FPrm_latch@0x021BB90C@ */ ECIPP_ALIGNMENT_FLOAT32_IEEE 10000000000 Compu_IDENTITY -10000000000 10000000000 PHYS_UNIT "ms" /end CHARACTERISTIC
/begin CHARACTERISTIC FPfl_EGRdP_minv "FPrm_latch(580)" VALUE 0x001E0928 /* @ECU_Address@FPrm_latch@0x021BB910@ */ ECIPP_ALIGNMENT_FLOAT32_IEEE 10000000000 Compu_IDENTITY -10000000000 10000000000 PHYS_UNIT "ms" /end CHARACTERISTIC
/begin CHARACTERISTIC FPfl_EGRflow_HiExp "FPrm_latch(451)" VALUE 0x001E0724 /* @ECU_Address@FPrm_latch@0x021BB70C@ */ ECIPP_ALIGNMENT_FLOAT32_IEEE 10000000000 Compu_IDENTITY -10000000000 10000000000 PHYS_UNIT "ms" /end CHARACTERISTIC
/begin CHARACTERISTIC FPfl_EGRflow_LoExp "FPrm_latch(450)" VALUE 0x001E0720 /* @ECU_Address@FPrm_latch@0x021BB708@ */ ECIPP_ALIGNMENT_FLOAT32_IEEE 10000000000 Compu_IDENTITY -10000000000 10000000000 PHYS_UNIT "ms" /end CHARACTERISTIC
/begin CHARACTERISTIC FPfl_EGRflow_LoExp2 "FPrm_latch(514)" VALUE 0x001E0820 /* @ECU_Address@FPrm_latch@0x021BB808@ */ ECIPP_ALIGNMENT_FLOAT32_IEEE 10000000000 Compu_IDENTITY -10000000000 10000000000 PHYS_UNIT "ms" /end CHARACTERISTIC
/begin CHARACTERISTIC FPfl_EGRHP_maxv "FPrm_latch(583)" VALUE 0x001E0934 /* @ECU_Address@FPrm_latch@0x021BB91C@ */ ECIPP_ALIGNMENT_FLOAT32_IEEE 10000000000 Compu_IDENTITY -10000000000 10000000000 PHYS_UNIT "ms" /end CHARACTERISTIC
/begin CHARACTERISTIC FPfl_EGRHP_minv "FPrm_latch(584)" VALUE 0x001E0938 /* @ECU_Address@FPrm_latch@0x021BB920@ */ ECIPP_ALIGNMENT_FLOAT32_IEEE 10000000000 Compu_IDENTITY -10000000000 10000000000 PHYS_UNIT "ms" /end CHARACTERISTIC
/begin CHARACTERISTIC FPfl_EGRHP_OOR "FPrm_latch(585)" VALUE 0x001E093C /* @ECU_Address@FPrm_latch@0x021BB924@ */ ECIPP_ALIGNMENT_FLOAT32_IEEE 10000000000 Compu_IDENTITY -10000000000 10000000000 PHYS_UNIT "ms" /end CHARACTERISTIC
/begin CHARACTERISTIC FPfl_EGRO_postlk "FPrm_latch(628)" VALUE 0x001E09E8 /* @ECU_Address@FPrm_latch@0x021BB9D0@ */ ECIPP_ALIGNMENT_FLOAT32_IEEE 10000000000 Compu_IDENTITY -10000000000 10000000000 PHYS_UNIT "ms" /end CHARACTERISTIC
/begin CHARACTERISTIC FPfl_EGRT_hi "FPrm_latch(524)" VALUE 0x001E0848 /* @ECU_Address@FPrm_latch@0x021BB830@ */ ECIPP_ALIGNMENT_FLOAT32_IEEE 10000000000 Compu_IDENTITY -10000000000 10000000000 PHYS_UNIT "ms" /end CHARACTERISTIC
/begin CHARACTERISTIC FPfl_EGRT_maxv "FPrm_latch(522)" VALUE 0x001E0840 /* @ECU_Address@FPrm_latch@0x021BB828@ */ ECIPP_ALIGNMENT_FLOAT32_IEEE 10000000000 Compu_IDENTITY -10000000000 10000000000 PHYS_UNIT "ms" /end CHARACTERISTIC
/begin CHARACTERISTIC FPfl_EGRT_minv "FPrm_latch(523)" VALUE 0x001E0844 /* @ECU_Address@FPrm_latch@0x021BB82C@ */ ECIPP_ALIGNMENT_FLOAT32_IEEE 10000000000 Compu_IDENTITY -10000000000 10000000000 PHYS_UNIT "ms" /end CHARACTERISTIC
/begin CHARACTERISTIC FPfl_EGT_dig_Hi "FPrm_latch(145)" VALUE 0x001E025C /* @ECU_Address@FPrm_latch@0x021BB244@ */ ECIPP_ALIGNMENT_FLOAT32_IEEE 10000000000 Compu_IDENTITY -10000000000 10000000000 PHYS_UNIT "ms" /end CHARACTERISTIC
/begin CHARACTERISTIC FPfl_EGT_maxv "FPrm_latch(635)" VALUE 0x001E0A04 /* @ECU_Address@FPrm_latch@0x021BB9EC@ */ ECIPP_ALIGNMENT_FLOAT32_IEEE 10000000000 Compu_IDENTITY -10000000000 10000000000 PHYS_UNIT "ms" /end CHARACTERISTIC
/begin CHARACTERISTIC FPfl_EGT_minv "FPrm_latch(636)" VALUE 0x001E0A08 /* @ECU_Address@FPrm_latch@0x021BB9F0@ */ ECIPP_ALIGNMENT_FLOAT32_IEEE 10000000000 Compu_IDENTITY -10000000000 10000000000 PHYS_UNIT "ms" /end CHARACTERISTIC
/begin CHARACTERISTIC FPfl_EMWT1_HiExp1 "FPrm_latch(179)" VALUE 0x001E02E4 /* @ECU_Address@FPrm_latch@0x021BB2CC@ */ ECIPP_ALIGNMENT_FLOAT32_IEEE 10000000000 Compu_IDENTITY -10000000000 10000000000 PHYS_UNIT "ms" /end CHARACTERISTIC
/begin CHARACTERISTIC FPfl_EMWT1_HiExp2 "FPrm_latch(180)" VALUE 0x001E02E8 /* @ECU_Address@FPrm_latch@0x021BB2D0@ */ ECIPP_ALIGNMENT_FLOAT32_IEEE 10000000000 Compu_IDENTITY -10000000000 10000000000 PHYS_UNIT "ms" /end CHARACTERISTIC
/begin CHARACTERISTIC FPfl_EMWT1_maxv "FPrm_latch(177)" VALUE 0x001E02DC /* @ECU_Address@FPrm_latch@0x021BB2C4@ */ ECIPP_ALIGNMENT_FLOAT32_IEEE 10000000000 Compu_IDENTITY -10000000000 10000000000 PHYS_UNIT "ms" /end CHARACTERISTIC
/begin CHARACTERISTIC FPfl_EMWT1_minv "FPrm_latch(178)" VALUE 0x001E02E0 /* @ECU_Address@FPrm_latch@0x021BB2C8@ */ ECIPP_ALIGNMENT_FLOAT32_IEEE 10000000000 Compu_IDENTITY -10000000000 10000000000 PHYS_UNIT "ms" /end CHARACTERISTIC
/begin CHARACTERISTIC FPfl_envtech_AAT_inv "FPrm_latch(641)" VALUE 0x001E0A1C /* @ECU_Address@FPrm_latch@0x021BBA04@ */ ECIPP_ALIGNMENT_FLOAT32_IEEE 10000000000 Compu_IDENTITY -10000000000 10000000000 PHYS_UNIT "ms" /end CHARACTERISTIC
/begin CHARACTERISTIC FPfl_envtech_BP_inv "FPrm_latch(642)" VALUE 0x001E0A20 /* @ECU_Address@FPrm_latch@0x021BBA08@ */ ECIPP_ALIGNMENT_FLOAT32_IEEE 10000000000 Compu_IDENTITY -10000000000 10000000000 PHYS_UNIT "ms" /end CHARACTERISTIC
/begin CHARACTERISTIC FPfl_envtech_comm "FPrm_latch(267)" VALUE 0x001E0444 /* @ECU_Address@FPrm_latch@0x021BB42C@ */ ECIPP_ALIGNMENT_FLOAT32_IEEE 10000000000 Compu_IDENTITY -10000000000 10000000000 PHYS_UNIT "ms" /end CHARACTERISTIC
/begin CHARACTERISTIC FPfl_envtech_general "FPrm_latch(644)" VALUE 0x001E0A28 /* @ECU_Address@FPrm_latch@0x021BBA10@ */ ECIPP_ALIGNMENT_FLOAT32_IEEE 10000000000 Compu_IDENTITY -10000000000 10000000000 PHYS_UNIT "ms" /end CHARACTERISTIC
/begin CHARACTERISTIC FPfl_envtech_RH_inv "FPrm_latch(643)" VALUE 0x001E0A24 /* @ECU_Address@FPrm_latch@0x021BBA0C@ */ ECIPP_ALIGNMENT_FLOAT32_IEEE 10000000000 Compu_IDENTITY -10000000000 10000000000 PHYS_UNIT "ms" /end CHARACTERISTIC
/begin CHARACTERISTIC FPfl_envtech_RH_uns "FPrm_latch(645)" VALUE 0x001E0A2C /* @ECU_Address@FPrm_latch@0x021BBA14@ */ ECIPP_ALIGNMENT_FLOAT32_IEEE 10000000000 Compu_IDENTITY -10000000000 10000000000 PHYS_UNIT "ms" /end CHARACTERISTIC
/begin CHARACTERISTIC FPfl_ERCV_speed_OOR "FPrm_latch(680)" VALUE 0x001E0AB8 /* @ECU_Address@FPrm_latch@0x021BBAA0@ */ ECIPP_ALIGNMENT_FLOAT32_IEEE 10000000000 Compu_IDENTITY -10000000000 10000000000 PHYS_UNIT "ms" /end CHARACTERISTIC
/begin CHARACTERISTIC FPfl_ERWT1_HiExp1 "FPrm_latch(187)" VALUE 0x001E0304 /* @ECU_Address@FPrm_latch@0x021BB2EC@ */ ECIPP_ALIGNMENT_FLOAT32_IEEE 10000000000 Compu_IDENTITY -10000000000 10000000000 PHYS_UNIT "ms" /end CHARACTERISTIC
/begin CHARACTERISTIC FPfl_ERWT1_HiExp2 "FPrm_latch(188)" VALUE 0x001E0308 /* @ECU_Address@FPrm_latch@0x021BB2F0@ */ ECIPP_ALIGNMENT_FLOAT32_IEEE 10000000000 Compu_IDENTITY -10000000000 10000000000 PHYS_UNIT "ms" /end CHARACTERISTIC
/begin CHARACTERISTIC FPfl_ERWT1_maxv "FPrm_latch(185)" VALUE 0x001E02FC /* @ECU_Address@FPrm_latch@0x021BB2E4@ */ ECIPP_ALIGNMENT_FLOAT32_IEEE 10000000000 Compu_IDENTITY -10000000000 10000000000 PHYS_UNIT "ms" /end CHARACTERISTIC
/begin CHARACTERISTIC FPfl_ERWT1_minv "FPrm_latch(186)" VALUE 0x001E0300 /* @ECU_Address@FPrm_latch@0x021BB2E8@ */ ECIPP_ALIGNMENT_FLOAT32_IEEE 10000000000 Compu_IDENTITY -10000000000 10000000000 PHYS_UNIT "ms" /end CHARACTERISTIC
/begin CHARACTERISTIC FPfl_F1OOR_F2IVS "FPrm_latch(138)" VALUE 0x001E0240 /* @ECU_Address@FPrm_latch@0x021BB228@ */ ECIPP_ALIGNMENT_FLOAT32_IEEE 10000000000 Compu_IDENTITY -10000000000 10000000000 PHYS_UNIT "ms" /end CHARACTERISTIC
/begin CHARACTERISTIC FPfl_F2OOR_F1IVS "FPrm_latch(139)" VALUE 0x001E0244 /* @ECU_Address@FPrm_latch@0x021BB22C@ */ ECIPP_ALIGNMENT_FLOAT32_IEEE 10000000000 Compu_IDENTITY -10000000000 10000000000 PHYS_UNIT "ms" /end CHARACTERISTIC
/begin CHARACTERISTIC FPfl_FCoolH2O_lo "FPrm_latch(402)" VALUE 0x001E0660 /* @ECU_Address@FPrm_latch@0x021BB648@ */ ECIPP_ALIGNMENT_FLOAT32_IEEE 10000000000 Compu_IDENTITY -10000000000 10000000000 PHYS_UNIT "ms" /end CHARACTERISTIC
/begin CHARACTERISTIC FPfl_FIMP_pct_high "FPrm_latch(204)" VALUE 0x001E0348 /* @ECU_Address@FPrm_latch@0x021BB330@ */ ECIPP_ALIGNMENT_FLOAT32_IEEE 10000000000 Compu_IDENTITY -10000000000 10000000000 PHYS_UNIT "ms" /end CHARACTERISTIC
/begin CHARACTERISTIC FPfl_FIP_LoExp "FPrm_latch(525)" VALUE 0x001E084C /* @ECU_Address@FPrm_latch@0x021BB834@ */ ECIPP_ALIGNMENT_FLOAT32_IEEE 10000000000 Compu_IDENTITY -10000000000 10000000000 PHYS_UNIT "ms" /end CHARACTERISTIC
/begin CHARACTERISTIC FPfl_flash_fail "FPrm_latch(69)" VALUE 0x001E012C /* @ECU_Address@FPrm_latch@0x021BB114@ */ ECIPP_ALIGNMENT_FLOAT32_IEEE 10000000000 Compu_IDENTITY -10000000000 10000000000 PHYS_UNIT "ms" /end CHARACTERISTIC
/begin CHARACTERISTIC FPfl_FOP_start "FPrm_latch(712)" VALUE 0x001E0B38 /* @ECU_Address@FPrm_latch@0x021BBB20@ */ ECIPP_ALIGNMENT_FLOAT32_IEEE 10000000000 Compu_IDENTITY -10000000000 10000000000 PHYS_UNIT "ms" /end CHARACTERISTIC
/begin CHARACTERISTIC FPfl_FP_high "FPrm_latch(212)" VALUE 0x001E0368 /* @ECU_Address@FPrm_latch@0x021BB350@ */ ECIPP_ALIGNMENT_FLOAT32_IEEE 10000000000 Compu_IDENTITY -10000000000 10000000000 PHYS_UNIT "ms" /end CHARACTERISTIC
/begin CHARACTERISTIC FPfl_FP_low "FPrm_latch(213)" VALUE 0x001E036C /* @ECU_Address@FPrm_latch@0x021BB354@ */ ECIPP_ALIGNMENT_FLOAT32_IEEE 10000000000 Compu_IDENTITY -10000000000 10000000000 PHYS_UNIT "ms" /end CHARACTERISTIC
/begin CHARACTERISTIC FPfl_FP_maxv "FPrm_latch(87)" VALUE 0x001E0174 /* @ECU_Address@FPrm_latch@0x021BB15C@ */ ECIPP_ALIGNMENT_FLOAT32_IEEE 10000000000 Compu_IDENTITY -10000000000 10000000000 PHYS_UNIT "ms" /end CHARACTERISTIC
/begin CHARACTERISTIC FPfl_FP_minv "FPrm_latch(88)" VALUE 0x001E0178 /* @ECU_Address@FPrm_latch@0x021BB160@ */ ECIPP_ALIGNMENT_FLOAT32_IEEE 10000000000 Compu_IDENTITY -10000000000 10000000000 PHYS_UNIT "ms" /end CHARACTERISTIC
/begin CHARACTERISTIC FPfl_FP2_high "FPrm_latch(360)" VALUE 0x001E05B8 /* @ECU_Address@FPrm_latch@0x021BB5A0@ */ ECIPP_ALIGNMENT_FLOAT32_IEEE 10000000000 Compu_IDENTITY -10000000000 10000000000 PHYS_UNIT "ms" /end CHARACTERISTIC
/begin CHARACTERISTIC FPfl_FP2_low "FPrm_latch(361)" VALUE 0x001E05BC /* @ECU_Address@FPrm_latch@0x021BB5A4@ */ ECIPP_ALIGNMENT_FLOAT32_IEEE 10000000000 Compu_IDENTITY -10000000000 10000000000 PHYS_UNIT "ms" /end CHARACTERISTIC
/begin CHARACTERISTIC FPfl_FP2_maxv "FPrm_latch(358)" VALUE 0x001E05B0 /* @ECU_Address@FPrm_latch@0x021BB598@ */ ECIPP_ALIGNMENT_FLOAT32_IEEE 10000000000 Compu_IDENTITY -10000000000 10000000000 PHYS_UNIT "ms" /end CHARACTERISTIC
/begin CHARACTERISTIC FPfl_FP2_minv "FPrm_latch(359)" VALUE 0x001E05B4 /* @ECU_Address@FPrm_latch@0x021BB59C@ */ ECIPP_ALIGNMENT_FLOAT32_IEEE 10000000000 Compu_IDENTITY -10000000000 10000000000 PHYS_UNIT "ms" /end CHARACTERISTIC
/begin CHARACTERISTIC FPfl_FPD_off_hi "FPrm_latch(58)" VALUE 0x001E0100 /* @ECU_Address@FPrm_latch@0x021BB0E8@ */ ECIPP_ALIGNMENT_FLOAT32_IEEE 10000000000 Compu_IDENTITY -10000000000 10000000000 PHYS_UNIT "ms" /end CHARACTERISTIC
/begin CHARACTERISTIC FPfl_FPD_on_lo "FPrm_latch(57)" VALUE 0x001E00FC /* @ECU_Address@FPrm_latch@0x021BB0E4@ */ ECIPP_ALIGNMENT_FLOAT32_IEEE 10000000000 Compu_IDENTITY -10000000000 10000000000 PHYS_UNIT "ms" /end CHARACTERISTIC
/begin CHARACTERISTIC FPfl_FPlo_derate_actv "FPrm_latch(634)" VALUE 0x001E0A00 /* @ECU_Address@FPrm_latch@0x021BB9E8@ */ ECIPP_ALIGNMENT_FLOAT32_IEEE 10000000000 Compu_IDENTITY -10000000000 10000000000 PHYS_UNIT "ms" /end CHARACTERISTIC
/begin CHARACTERISTIC FPfl_FPlo_derate_excess "FPrm_latch(637)" VALUE 0x001E0A0C /* @ECU_Address@FPrm_latch@0x021BB9F4@ */ ECIPP_ALIGNMENT_FLOAT32_IEEE 10000000000 Compu_IDENTITY -10000000000 10000000000 PHYS_UNIT "ms" /end CHARACTERISTIC
/begin CHARACTERISTIC FPfl_FPP_NeutLock_fail "FPrm_latch(488)" VALUE 0x001E07B8 /* @ECU_Address@FPrm_latch@0x021BB7A0@ */ ECIPP_ALIGNMENT_FLOAT32_IEEE 10000000000 Compu_IDENTITY -10000000000 10000000000 PHYS_UNIT "ms" /end CHARACTERISTIC
/begin CHARACTERISTIC FPfl_FPP1_IVS_max "FPrm_latch(30)" VALUE 0x001E0090 /* @ECU_Address@FPrm_latch@0x021BB078@ */ ECIPP_ALIGNMENT_FLOAT32_IEEE 10000000000 Compu_IDENTITY -10000000000 10000000000 PHYS_UNIT "ms" /end CHARACTERISTIC
/begin CHARACTERISTIC FPfl_FPP1_IVS_min "FPrm_latch(31)" VALUE 0x001E0094 /* @ECU_Address@FPrm_latch@0x021BB07C@ */ ECIPP_ALIGNMENT_FLOAT32_IEEE 10000000000 Compu_IDENTITY -10000000000 10000000000 PHYS_UNIT "ms" /end CHARACTERISTIC
/begin CHARACTERISTIC FPfl_FPP1_max "FPrm_latch(26)" VALUE 0x001E0080 /* @ECU_Address@FPrm_latch@0x021BB068@ */ ECIPP_ALIGNMENT_FLOAT32_IEEE 10000000000 Compu_IDENTITY -10000000000 10000000000 PHYS_UNIT "ms" /end CHARACTERISTIC
/begin CHARACTERISTIC FPfl_FPP1_min "FPrm_latch(27)" VALUE 0x001E0084 /* @ECU_Address@FPrm_latch@0x021BB06C@ */ ECIPP_ALIGNMENT_FLOAT32_IEEE 10000000000 Compu_IDENTITY -10000000000 10000000000 PHYS_UNIT "ms" /end CHARACTERISTIC
/begin CHARACTERISTIC FPfl_FPP12_IVS_max "FPrm_latch(135)" VALUE 0x001E0234 /* @ECU_Address@FPrm_latch@0x021BB21C@ */ ECIPP_ALIGNMENT_FLOAT32_IEEE 10000000000 Compu_IDENTITY -10000000000 10000000000 PHYS_UNIT "ms" /end CHARACTERISTIC
/begin CHARACTERISTIC FPfl_FPP12_IVS_min "FPrm_latch(136)" VALUE 0x001E0238 /* @ECU_Address@FPrm_latch@0x021BB220@ */ ECIPP_ALIGNMENT_FLOAT32_IEEE 10000000000 Compu_IDENTITY -10000000000 10000000000 PHYS_UNIT "ms" /end CHARACTERISTIC
/begin CHARACTERISTIC FPfl_FPP12_OOR "FPrm_latch(137)" VALUE 0x001E023C /* @ECU_Address@FPrm_latch@0x021BB224@ */ ECIPP_ALIGNMENT_FLOAT32_IEEE 10000000000 Compu_IDENTITY -10000000000 10000000000 PHYS_UNIT "ms" /end CHARACTERISTIC
/begin CHARACTERISTIC FPfl_FPP12IVS_TSC1 "FPrm_latch(564)" VALUE 0x001E08E8 /* @ECU_Address@FPrm_latch@0x021BB8D0@ */ ECIPP_ALIGNMENT_FLOAT32_IEEE 10000000000 Compu_IDENTITY -10000000000 10000000000 PHYS_UNIT "ms" /end CHARACTERISTIC
/begin CHARACTERISTIC FPfl_FPP12MM_IVSMM "FPrm_latch(140)" VALUE 0x001E0248 /* @ECU_Address@FPrm_latch@0x021BB230@ */ ECIPP_ALIGNMENT_FLOAT32_IEEE 10000000000 Compu_IDENTITY -10000000000 10000000000 PHYS_UNIT "ms" /end CHARACTERISTIC
/begin CHARACTERISTIC FPfl_FPP12pct_hi "FPrm_latch(34)" VALUE 0x001E00A0 /* @ECU_Address@FPrm_latch@0x021BB088@ */ ECIPP_ALIGNMENT_FLOAT32_IEEE 10000000000 Compu_IDENTITY -10000000000 10000000000 PHYS_UNIT "ms" /end CHARACTERISTIC
/begin CHARACTERISTIC FPfl_FPP12pct_lo "FPrm_latch(35)" VALUE 0x001E00A4 /* @ECU_Address@FPrm_latch@0x021BB08C@ */ ECIPP_ALIGNMENT_FLOAT32_IEEE 10000000000 Compu_IDENTITY -10000000000 10000000000 PHYS_UNIT "ms" /end CHARACTERISTIC
/begin CHARACTERISTIC FPfl_FPP2_IVS_max "FPrm_latch(32)" VALUE 0x001E0098 /* @ECU_Address@FPrm_latch@0x021BB080@ */ ECIPP_ALIGNMENT_FLOAT32_IEEE 10000000000 Compu_IDENTITY -10000000000 10000000000 PHYS_UNIT "ms" /end CHARACTERISTIC
/begin CHARACTERISTIC FPfl_FPP2_IVS_min "FPrm_latch(33)" VALUE 0x001E009C /* @ECU_Address@FPrm_latch@0x021BB084@ */ ECIPP_ALIGNMENT_FLOAT32_IEEE 10000000000 Compu_IDENTITY -10000000000 10000000000 PHYS_UNIT "ms" /end CHARACTERISTIC
/begin CHARACTERISTIC FPfl_FPP2_max "FPrm_latch(28)" VALUE 0x001E0088 /* @ECU_Address@FPrm_latch@0x021BB070@ */ ECIPP_ALIGNMENT_FLOAT32_IEEE 10000000000 Compu_IDENTITY -10000000000 10000000000 PHYS_UNIT "ms" /end CHARACTERISTIC
/begin CHARACTERISTIC FPfl_FPP2_min "FPrm_latch(29)" VALUE 0x001E008C /* @ECU_Address@FPrm_latch@0x021BB074@ */ ECIPP_ALIGNMENT_FLOAT32_IEEE 10000000000 Compu_IDENTITY -10000000000 10000000000 PHYS_UNIT "ms" /end CHARACTERISTIC
/begin CHARACTERISTIC FPfl_FPP2V_TSC1 "FPrm_latch(666)" VALUE 0x001E0A80 /* @ECU_Address@FPrm_latch@0x021BBA68@ */ ECIPP_ALIGNMENT_FLOAT32_IEEE 10000000000 Compu_IDENTITY -10000000000 10000000000 PHYS_UNIT "ms" /end CHARACTERISTIC
/begin CHARACTERISTIC FPfl_FPrly_coilopen "FPrm_latch(128)" VALUE 0x001E0218 /* @ECU_Address@FPrm_latch@0x021BB200@ */ ECIPP_ALIGNMENT_FLOAT32_IEEE 10000000000 Compu_IDENTITY -10000000000 10000000000 PHYS_UNIT "samples" /end CHARACTERISTIC
/begin CHARACTERISTIC FPfu_EGRdP_HiExp "FPrm_unlatch(582)" VALUE 0x001E1478 /* @ECU_Address@FPrm_unlatch@0x021BD918@ */ ECIPP_ALIGNMENT_FLOAT32_IEEE 10000000000 Compu_IDENTITY -10000000000 10000000000 PHYS_UNIT "ms" /end CHARACTERISTIC
/begin CHARACTERISTIC FPfu_EGRdP_lo_LP_discon "FPrm_unlatch(693)" VALUE 0x001E1634 /* @ECU_Address@FPrm_unlatch@0x021BDAD4@ */ ECIPP_ALIGNMENT_FLOAT32_IEEE 10000000000 Compu_IDENTITY -10000000000 10000000000 PHYS_UNIT "ms" /end CHARACTERISTIC
/begin CHARACTERISTIC FPfu_EGRdP_lo_reversed "FPrm_unlatch(692)" VALUE 0x001E1630 /* @ECU_Address@FPrm_unlatch@0x021BDAD0@ */ ECIPP_ALIGNMENT_FLOAT32_IEEE 10000000000 Compu_IDENTITY -10000000000 10000000000 PHYS_UNIT "ms" /end CHARACTERISTIC
/begin CHARACTERISTIC FPfu_EGRdP_LoExp "FPrm_unlatch(581)" VALUE 0x001E1474 /* @ECU_Address@FPrm_unlatch@0x021BD914@ */ ECIPP_ALIGNMENT_FLOAT32_IEEE 10000000000 Compu_IDENTITY -10000000000 10000000000 PHYS_UNIT "ms" /end CHARACTERISTIC
/begin CHARACTERISTIC FPfu_EGRdP_maxv "FPrm_unlatch(579)" VALUE 0x001E146C /* @ECU_Address@FPrm_unlatch@0x021BD90C@ */ ECIPP_ALIGNMENT_FLOAT32_IEEE 10000000000 Compu_IDENTITY -10000000000 10000000000 PHYS_UNIT "ms" /end CHARACTERISTIC
/begin CHARACTERISTIC FPfu_EGRdP_minv "FPrm_unlatch(580)" VALUE 0x001E1470 /* @ECU_Address@FPrm_unlatch@0x021BD910@ */ ECIPP_ALIGNMENT_FLOAT32_IEEE 10000000000 Compu_IDENTITY -10000000000 10000000000 PHYS_UNIT "ms" /end CHARACTERISTIC
/begin CHARACTERISTIC FPfu_EGRflow_HiExp "FPrm_unlatch(451)" VALUE 0x001E126C /* @ECU_Address@FPrm_unlatch@0x021BD70C@ */ ECIPP_ALIGNMENT_FLOAT32_IEEE 10000000000 Compu_IDENTITY -10000000000 10000000000 PHYS_UNIT "ms" /end CHARACTERISTIC
/begin CHARACTERISTIC FPfu_EGRflow_LoExp "FPrm_unlatch(450)" VALUE 0x001E1268 /* @ECU_Address@FPrm_unlatch@0x021BD708@ */ ECIPP_ALIGNMENT_FLOAT32_IEEE 10000000000 Compu_IDENTITY -10000000000 10000000000 PHYS_UNIT "ms" /end CHARACTERISTIC
/begin CHARACTERISTIC FPfu_EGRflow_LoExp2 "FPrm_unlatch(514)" VALUE 0x001E1368 /* @ECU_Address@FPrm_unlatch@0x021BD808@ */ ECIPP_ALIGNMENT_FLOAT32_IEEE 10000000000 Compu_IDENTITY -10000000000 10000000000 PHYS_UNIT "ms" /end CHARACTERISTIC
/begin CHARACTERISTIC FPfu_EGRHP_maxv "FPrm_unlatch(583)" VALUE 0x001E147C /* @ECU_Address@FPrm_unlatch@0x021BD91C@ */ ECIPP_ALIGNMENT_FLOAT32_IEEE 10000000000 Compu_IDENTITY -10000000000 10000000000 PHYS_UNIT "ms" /end CHARACTERISTIC
/begin CHARACTERISTIC FPfu_EGRHP_minv "FPrm_unlatch(584)" VALUE 0x001E1480 /* @ECU_Address@FPrm_unlatch@0x021BD920@ */ ECIPP_ALIGNMENT_FLOAT32_IEEE 10000000000 Compu_IDENTITY -10000000000 10000000000 PHYS_UNIT "ms" /end CHARACTERISTIC
/begin CHARACTERISTIC FPfu_EGRHP_OOR "FPrm_unlatch(585)" VALUE 0x001E1484 /* @ECU_Address@FPrm_unlatch@0x021BD924@ */ ECIPP_ALIGNMENT_FLOAT32_IEEE 10000000000 Compu_IDENTITY -10000000000 10000000000 PHYS_UNIT "ms" /end CHARACTERISTIC
/begin CHARACTERISTIC FPfu_EGRO_postlk "FPrm_unlatch(628)" VALUE 0x001E1530 /* @ECU_Address@FPrm_unlatch@0x021BD9D0@ */ ECIPP_ALIGNMENT_FLOAT32_IEEE 10000000000 Compu_IDENTITY -10000000000 10000000000 PHYS_UNIT "ms" /end CHARACTERISTIC
/begin CHARACTERISTIC FPfu_EGRT_hi "FPrm_unlatch(524)" VALUE 0x001E1390 /* @ECU_Address@FPrm_unlatch@0x021BD830@ */ ECIPP_ALIGNMENT_FLOAT32_IEEE 10000000000 Compu_IDENTITY -10000000000 10000000000 PHYS_UNIT "ms" /end CHARACTERISTIC
/begin CHARACTERISTIC FPfu_EGRT_maxv "FPrm_unlatch(522)" VALUE 0x001E1388 /* @ECU_Address@FPrm_unlatch@0x021BD828@ */ ECIPP_ALIGNMENT_FLOAT32_IEEE 10000000000 Compu_IDENTITY -10000000000 10000000000 PHYS_UNIT "ms" /end CHARACTERISTIC
/begin CHARACTERISTIC FPfu_EGRT_minv "FPrm_unlatch(523)" VALUE 0x001E138C /* @ECU_Address@FPrm_unlatch@0x021BD82C@ */ ECIPP_ALIGNMENT_FLOAT32_IEEE 10000000000 Compu_IDENTITY -10000000000 10000000000 PHYS_UNIT "ms" /end CHARACTERISTIC
/begin CHARACTERISTIC FPfu_EGT_dig_Hi "FPrm_unlatch(145)" VALUE 0x001E0DA4 /* @ECU_Address@FPrm_unlatch@0x021BD244@ */ ECIPP_ALIGNMENT_FLOAT32_IEEE 10000000000 Compu_IDENTITY -10000000000 10000000000 PHYS_UNIT "ms" /end CHARACTERISTIC
/begin CHARACTERISTIC FPfu_EGT_maxv "FPrm_unlatch(635)" VALUE 0x001E154C /* @ECU_Address@FPrm_unlatch@0x021BD9EC@ */ ECIPP_ALIGNMENT_FLOAT32_IEEE 10000000000 Compu_IDENTITY -10000000000 10000000000 PHYS_UNIT "ms" /end CHARACTERISTIC
/begin CHARACTERISTIC FPfu_EGT_minv "FPrm_unlatch(636)" VALUE 0x001E1550 /* @ECU_Address@FPrm_unlatch@0x021BD9F0@ */ ECIPP_ALIGNMENT_FLOAT32_IEEE 10000000000 Compu_IDENTITY -10000000000 10000000000 PHYS_UNIT "ms" /end CHARACTERISTIC
/begin CHARACTERISTIC FPfu_EMWT1_HiExp1 "FPrm_unlatch(179)" VALUE 0x001E0E2C /* @ECU_Address@FPrm_unlatch@0x021BD2CC@ */ ECIPP_ALIGNMENT_FLOAT32_IEEE 10000000000 Compu_IDENTITY -10000000000 10000000000 PHYS_UNIT "ms" /end CHARACTERISTIC
/begin CHARACTERISTIC FPfu_EMWT1_HiExp2 "FPrm_unlatch(180)" VALUE 0x001E0E30 /* @ECU_Address@FPrm_unlatch@0x021BD2D0@ */ ECIPP_ALIGNMENT_FLOAT32_IEEE 10000000000 Compu_IDENTITY -10000000000 10000000000 PHYS_UNIT "ms" /end CHARACTERISTIC
/begin CHARACTERISTIC FPfu_EMWT1_maxv "FPrm_unlatch(177)" VALUE 0x001E0E24 /* @ECU_Address@FPrm_unlatch@0x021BD2C4@ */ ECIPP_ALIGNMENT_FLOAT32_IEEE 10000000000 Compu_IDENTITY -10000000000 10000000000 PHYS_UNIT "ms" /end CHARACTERISTIC
/begin CHARACTERISTIC FPfu_EMWT1_minv "FPrm_unlatch(178)" VALUE 0x001E0E28 /* @ECU_Address@FPrm_unlatch@0x021BD2C8@ */ ECIPP_ALIGNMENT_FLOAT32_IEEE 10000000000 Compu_IDENTITY -10000000000 10000000000 PHYS_UNIT "ms" /end CHARACTERISTIC
/begin CHARACTERISTIC FPfu_envtech_AAT_inv "FPrm_unlatch(641)" VALUE 0x001E1564 /* @ECU_Address@FPrm_unlatch@0x021BDA04@ */ ECIPP_ALIGNMENT_FLOAT32_IEEE 10000000000 Compu_IDENTITY -10000000000 10000000000 PHYS_UNIT "ms" /end CHARACTERISTIC
/begin CHARACTERISTIC FPfu_envtech_BP_inv "FPrm_unlatch(642)" VALUE 0x001E1568 /* @ECU_Address@FPrm_unlatch@0x021BDA08@ */ ECIPP_ALIGNMENT_FLOAT32_IEEE 10000000000 Compu_IDENTITY -10000000000 10000000000 PHYS_UNIT "ms" /end CHARACTERISTIC
/begin CHARACTERISTIC FPfu_envtech_comm "FPrm_unlatch(267)" VALUE 0x001E0F8C /* @ECU_Address@FPrm_unlatch@0x021BD42C@ */ ECIPP_ALIGNMENT_FLOAT32_IEEE 10000000000 Compu_IDENTITY -10000000000 10000000000 PHYS_UNIT "ms" /end CHARACTERISTIC
/begin CHARACTERISTIC FPfu_envtech_general "FPrm_unlatch(644)" VALUE 0x001E1570 /* @ECU_Address@FPrm_unlatch@0x021BDA10@ */ ECIPP_ALIGNMENT_FLOAT32_IEEE 10000000000 Compu_IDENTITY -10000000000 10000000000 PHYS_UNIT "ms" /end CHARACTERISTIC
/begin CHARACTERISTIC FPfu_envtech_RH_inv "FPrm_unlatch(643)" VALUE 0x001E156C /* @ECU_Address@FPrm_unlatch@0x021BDA0C@ */ ECIPP_ALIGNMENT_FLOAT32_IEEE 10000000000 Compu_IDENTITY -10000000000 10000000000 PHYS_UNIT "ms" /end CHARACTERISTIC
/begin CHARACTERISTIC FPfu_envtech_RH_uns "FPrm_unlatch(645)" VALUE 0x001E1574 /* @ECU_Address@FPrm_unlatch@0x021BDA14@ */ ECIPP_ALIGNMENT_FLOAT32_IEEE 10000000000 Compu_IDENTITY -10000000000 10000000000 PHYS_UNIT "ms" /end CHARACTERISTIC
/begin CHARACTERISTIC FPfu_ERCV_speed_OOR "FPrm_unlatch(680)" VALUE 0x001E1600 /* @ECU_Address@FPrm_unlatch@0x021BDAA0@ */ ECIPP_ALIGNMENT_FLOAT32_IEEE 10000000000 Compu_IDENTITY -10000000000 10000000000 PHYS_UNIT "ms" /end CHARACTERISTIC
/begin CHARACTERISTIC FPfu_ERWT1_HiExp1 "FPrm_unlatch(187)" VALUE 0x001E0E4C /* @ECU_Address@FPrm_unlatch@0x021BD2EC@ */ ECIPP_ALIGNMENT_FLOAT32_IEEE 10000000000 Compu_IDENTITY -10000000000 10000000000 PHYS_UNIT "ms" /end CHARACTERISTIC
/begin CHARACTERISTIC FPfu_ERWT1_HiExp2 "FPrm_unlatch(188)" VALUE 0x001E0E50 /* @ECU_Address@FPrm_unlatch@0x021BD2F0@ */ ECIPP_ALIGNMENT_FLOAT32_IEEE 10000000000 Compu_IDENTITY -10000000000 10000000000 PHYS_UNIT "ms" /end CHARACTERISTIC
/begin CHARACTERISTIC FPfu_ERWT1_maxv "FPrm_unlatch(185)" VALUE 0x001E0E44 /* @ECU_Address@FPrm_unlatch@0x021BD2E4@ */ ECIPP_ALIGNMENT_FLOAT32_IEEE 10000000000 Compu_IDENTITY -10000000000 10000000000 PHYS_UNIT "ms" /end CHARACTERISTIC
/begin CHARACTERISTIC FPfu_ERWT1_minv "FPrm_unlatch(186)" VALUE 0x001E0E48 /* @ECU_Address@FPrm_unlatch@0x021BD2E8@ */ ECIPP_ALIGNMENT_FLOAT32_IEEE 10000000000 Compu_IDENTITY -10000000000 10000000000 PHYS_UNIT "ms" /end CHARACTERISTIC
/begin CHARACTERISTIC FPfu_F1OOR_F2IVS "FPrm_unlatch(138)" VALUE 0x001E0D88 /* @ECU_Address@FPrm_unlatch@0x021BD228@ */ ECIPP_ALIGNMENT_FLOAT32_IEEE 10000000000 Compu_IDENTITY -10000000000 10000000000 PHYS_UNIT "ms" /end CHARACTERISTIC
/begin CHARACTERISTIC FPfu_F2OOR_F1IVS "FPrm_unlatch(139)" VALUE 0x001E0D8C /* @ECU_Address@FPrm_unlatch@0x021BD22C@ */ ECIPP_ALIGNMENT_FLOAT32_IEEE 10000000000 Compu_IDENTITY -10000000000 10000000000 PHYS_UNIT "ms" /end CHARACTERISTIC
/begin CHARACTERISTIC FPfu_FCoolH2O_lo "FPrm_unlatch(402)" VALUE 0x001E11A8 /* @ECU_Address@FPrm_unlatch@0x021BD648@ */ ECIPP_ALIGNMENT_FLOAT32_IEEE 10000000000 Compu_IDENTITY -10000000000 10000000000 PHYS_UNIT "ms" /end CHARACTERISTIC
/begin CHARACTERISTIC FPfu_FIMP_pct_high "FPrm_unlatch(204)" VALUE 0x001E0E90 /* @ECU_Address@FPrm_unlatch@0x021BD330@ */ ECIPP_ALIGNMENT_FLOAT32_IEEE 10000000000 Compu_IDENTITY -10000000000 10000000000 PHYS_UNIT "ms" /end CHARACTERISTIC
/begin CHARACTERISTIC FPfu_FIP_LoExp "FPrm_unlatch(525)" VALUE 0x001E1394 /* @ECU_Address@FPrm_unlatch@0x021BD834@ */ ECIPP_ALIGNMENT_FLOAT32_IEEE 10000000000 Compu_IDENTITY -10000000000 10000000000 PHYS_UNIT "ms" /end CHARACTERISTIC
/begin CHARACTERISTIC FPfu_flash_fail "FPrm_unlatch(69)" VALUE 0x001E0C74 /* @ECU_Address@FPrm_unlatch@0x021BD114@ */ ECIPP_ALIGNMENT_FLOAT32_IEEE 10000000000 Compu_IDENTITY -10000000000 10000000000 PHYS_UNIT "ms" /end CHARACTERISTIC
/begin CHARACTERISTIC FPfu_FOP_start "FPrm_unlatch(712)" VALUE 0x001E1680 /* @ECU_Address@FPrm_unlatch@0x021BDB20@ */ ECIPP_ALIGNMENT_FLOAT32_IEEE 10000000000 Compu_IDENTITY -10000000000 10000000000 PHYS_UNIT "ms" /end CHARACTERISTIC
/begin CHARACTERISTIC FPfu_FP_high "FPrm_unlatch(212)" VALUE 0x001E0EB0 /* @ECU_Address@FPrm_unlatch@0x021BD350@ */ ECIPP_ALIGNMENT_FLOAT32_IEEE 10000000000 Compu_IDENTITY -10000000000 10000000000 PHYS_UNIT "ms" /end CHARACTERISTIC
/begin CHARACTERISTIC FPfu_FP_low "FPrm_unlatch(213)" VALUE 0x001E0EB4 /* @ECU_Address@FPrm_unlatch@0x021BD354@ */ ECIPP_ALIGNMENT_FLOAT32_IEEE 10000000000 Compu_IDENTITY -10000000000 10000000000 PHYS_UNIT "ms" /end CHARACTERISTIC
/begin CHARACTERISTIC FPfu_FP_maxv "FPrm_unlatch(87)" VALUE 0x001E0CBC /* @ECU_Address@FPrm_unlatch@0x021BD15C@ */ ECIPP_ALIGNMENT_FLOAT32_IEEE 10000000000 Compu_IDENTITY -10000000000 10000000000 PHYS_UNIT "ms" /end CHARACTERISTIC
/begin CHARACTERISTIC FPfu_FP_minv "FPrm_unlatch(88)" VALUE 0x001E0CC0 /* @ECU_Address@FPrm_unlatch@0x021BD160@ */ ECIPP_ALIGNMENT_FLOAT32_IEEE 10000000000 Compu_IDENTITY -10000000000 10000000000 PHYS_UNIT "ms" /end CHARACTERISTIC
/begin CHARACTERISTIC FPfu_FP2_high "FPrm_unlatch(360)" VALUE 0x001E1100 /* @ECU_Address@FPrm_unlatch@0x021BD5A0@ */ ECIPP_ALIGNMENT_FLOAT32_IEEE 10000000000 Compu_IDENTITY -10000000000 10000000000 PHYS_UNIT "ms" /end CHARACTERISTIC
/begin CHARACTERISTIC FPfu_FP2_low "FPrm_unlatch(361)" VALUE 0x001E1104 /* @ECU_Address@FPrm_unlatch@0x021BD5A4@ */ ECIPP_ALIGNMENT_FLOAT32_IEEE 10000000000 Compu_IDENTITY -10000000000 10000000000 PHYS_UNIT "ms" /end CHARACTERISTIC
/begin CHARACTERISTIC FPfu_FP2_maxv "FPrm_unlatch(358)" VALUE 0x001E10F8 /* @ECU_Address@FPrm_unlatch@0x021BD598@ */ ECIPP_ALIGNMENT_FLOAT32_IEEE 10000000000 Compu_IDENTITY -10000000000 10000000000 PHYS_UNIT "ms" /end CHARACTERISTIC
/begin CHARACTERISTIC FPfu_FP2_minv "FPrm_unlatch(359)" VALUE 0x001E10FC /* @ECU_Address@FPrm_unlatch@0x021BD59C@ */ ECIPP_ALIGNMENT_FLOAT32_IEEE 10000000000 Compu_IDENTITY -10000000000 10000000000 PHYS_UNIT "ms" /end CHARACTERISTIC
/begin CHARACTERISTIC FPfu_FPD_off_hi "FPrm_unlatch(58)" VALUE 0x001E0C48 /* @ECU_Address@FPrm_unlatch@0x021BD0E8@ */ ECIPP_ALIGNMENT_FLOAT32_IEEE 10000000000 Compu_IDENTITY -10000000000 10000000000 PHYS_UNIT "ms" /end CHARACTERISTIC
/begin CHARACTERISTIC FPfu_FPD_on_lo "FPrm_unlatch(57)" VALUE 0x001E0C44 /* @ECU_Address@FPrm_unlatch@0x021BD0E4@ */ ECIPP_ALIGNMENT_FLOAT32_IEEE 10000000000 Compu_IDENTITY -10000000000 10000000000 PHYS_UNIT "ms" /end CHARACTERISTIC
/begin CHARACTERISTIC FPfu_FPlo_derate_actv "FPrm_unlatch(634)" VALUE 0x001E1548 /* @ECU_Address@FPrm_unlatch@0x021BD9E8@ */ ECIPP_ALIGNMENT_FLOAT32_IEEE 10000000000 Compu_IDENTITY -10000000000 10000000000 PHYS_UNIT "ms" /end CHARACTERISTIC
/begin CHARACTERISTIC FPfu_FPlo_derate_excess "FPrm_unlatch(637)" VALUE 0x001E1554 /* @ECU_Address@FPrm_unlatch@0x021BD9F4@ */ ECIPP_ALIGNMENT_FLOAT32_IEEE 10000000000 Compu_IDENTITY -10000000000 10000000000 PHYS_UNIT "ms" /end CHARACTERISTIC
/begin CHARACTERISTIC FPfu_FPP_NeutLock_fail "FPrm_unlatch(488)" VALUE 0x001E1300 /* @ECU_Address@FPrm_unlatch@0x021BD7A0@ */ ECIPP_ALIGNMENT_FLOAT32_IEEE 10000000000 Compu_IDENTITY -10000000000 10000000000 PHYS_UNIT "ms" /end CHARACTERISTIC
/begin CHARACTERISTIC FPfu_FPP1_IVS_max "FPrm_unlatch(30)" VALUE 0x001E0BD8 /* @ECU_Address@FPrm_unlatch@0x021BD078@ */ ECIPP_ALIGNMENT_FLOAT32_IEEE 10000000000 Compu_IDENTITY -10000000000 10000000000 PHYS_UNIT "ms" /end CHARACTERISTIC
/begin CHARACTERISTIC FPfu_FPP1_IVS_min "FPrm_unlatch(31)" VALUE 0x001E0BDC /* @ECU_Address@FPrm_unlatch@0x021BD07C@ */ ECIPP_ALIGNMENT_FLOAT32_IEEE 10000000000 Compu_IDENTITY -10000000000 10000000000 PHYS_UNIT "ms" /end CHARACTERISTIC
/begin CHARACTERISTIC FPfu_FPP1_max "FPrm_unlatch(26)" VALUE 0x001E0BC8 /* @ECU_Address@FPrm_unlatch@0x021BD068@ */ ECIPP_ALIGNMENT_FLOAT32_IEEE 10000000000 Compu_IDENTITY -10000000000 10000000000 PHYS_UNIT "ms" /end CHARACTERISTIC
/begin CHARACTERISTIC FPfu_FPP1_min "FPrm_unlatch(27)" VALUE 0x001E0BCC /* @ECU_Address@FPrm_unlatch@0x021BD06C@ */ ECIPP_ALIGNMENT_FLOAT32_IEEE 10000000000 Compu_IDENTITY -10000000000 10000000000 PHYS_UNIT "ms" /end CHARACTERISTIC
/begin CHARACTERISTIC FPfu_FPP12_IVS_max "FPrm_unlatch(135)" VALUE 0x001E0D7C /* @ECU_Address@FPrm_unlatch@0x021BD21C@ */ ECIPP_ALIGNMENT_FLOAT32_IEEE 10000000000 Compu_IDENTITY -10000000000 10000000000 PHYS_UNIT "ms" /end CHARACTERISTIC
/begin CHARACTERISTIC FPfu_FPP12_IVS_min "FPrm_unlatch(136)" VALUE 0x001E0D80 /* @ECU_Address@FPrm_unlatch@0x021BD220@ */ ECIPP_ALIGNMENT_FLOAT32_IEEE 10000000000 Compu_IDENTITY -10000000000 10000000000 PHYS_UNIT "ms" /end CHARACTERISTIC
/begin CHARACTERISTIC FPfu_FPP12_OOR "FPrm_unlatch(137)" VALUE 0x001E0D84 /* @ECU_Address@FPrm_unlatch@0x021BD224@ */ ECIPP_ALIGNMENT_FLOAT32_IEEE 10000000000 Compu_IDENTITY -10000000000 10000000000 PHYS_UNIT "ms" /end CHARACTERISTIC
/begin CHARACTERISTIC FPfu_FPP12IVS_TSC1 "FPrm_unlatch(564)" VALUE 0x001E1430 /* @ECU_Address@FPrm_unlatch@0x021BD8D0@ */ ECIPP_ALIGNMENT_FLOAT32_IEEE 10000000000 Compu_IDENTITY -10000000000 10000000000 PHYS_UNIT "ms" /end CHARACTERISTIC
/begin CHARACTERISTIC FPfu_FPP12MM_IVSMM "FPrm_unlatch(140)" VALUE 0x001E0D90 /* @ECU_Address@FPrm_unlatch@0x021BD230@ */ ECIPP_ALIGNMENT_FLOAT32_IEEE 10000000000 Compu_IDENTITY -10000000000 10000000000 PHYS_UNIT "ms" /end CHARACTERISTIC
/begin CHARACTERISTIC FPfu_FPP12pct_hi "FPrm_unlatch(34)" VALUE 0x001E0BE8 /* @ECU_Address@FPrm_unlatch@0x021BD088@ */ ECIPP_ALIGNMENT_FLOAT32_IEEE 10000000000 Compu_IDENTITY -10000000000 10000000000 PHYS_UNIT "ms" /end CHARACTERISTIC
/begin CHARACTERISTIC FPfu_FPP12pct_lo "FPrm_unlatch(35)" VALUE 0x001E0BEC /* @ECU_Address@FPrm_unlatch@0x021BD08C@ */ ECIPP_ALIGNMENT_FLOAT32_IEEE 10000000000 Compu_IDENTITY -10000000000 10000000000 PHYS_UNIT "ms" /end CHARACTERISTIC
/begin CHARACTERISTIC FPfu_FPP2_IVS_max "FPrm_unlatch(32)" VALUE 0x001E0BE0 /* @ECU_Address@FPrm_unlatch@0x021BD080@ */ ECIPP_ALIGNMENT_FLOAT32_IEEE 10000000000 Compu_IDENTITY -10000000000 10000000000 PHYS_UNIT "ms" /end CHARACTERISTIC
/begin CHARACTERISTIC FPfu_FPP2_IVS_min "FPrm_unlatch(33)" VALUE 0x001E0BE4 /* @ECU_Address@FPrm_unlatch@0x021BD084@ */ ECIPP_ALIGNMENT_FLOAT32_IEEE 10000000000 Compu_IDENTITY -10000000000 10000000000 PHYS_UNIT "ms" /end CHARACTERISTIC
/begin CHARACTERISTIC FPfu_FPP2_max "FPrm_unlatch(28)" VALUE 0x001E0BD0 /* @ECU_Address@FPrm_unlatch@0x021BD070@ */ ECIPP_ALIGNMENT_FLOAT32_IEEE 10000000000 Compu_IDENTITY -10000000000 10000000000 PHYS_UNIT "ms" /end CHARACTERISTIC
/begin CHARACTERISTIC FPfu_FPP2_min "FPrm_unlatch(29)" VALUE 0x001E0BD4 /* @ECU_Address@FPrm_unlatch@0x021BD074@ */ ECIPP_ALIGNMENT_FLOAT32_IEEE 10000000000 Compu_IDENTITY -10000000000 10000000000 PHYS_UNIT "ms" /end CHARACTERISTIC
/begin CHARACTERISTIC FPfu_FPP2V_TSC1 "FPrm_unlatch(666)" VALUE 0x001E15C8 /* @ECU_Address@FPrm_unlatch@0x021BDA68@ */ ECIPP_ALIGNMENT_FLOAT32_IEEE 10000000000 Compu_IDENTITY -10000000000 10000000000 PHYS_UNIT "ms" /end CHARACTERISTIC
/begin CHARACTERISTIC FPfu_FPrly_coilopen "FPrm_unlatch(128)" VALUE 0x001E0D60 /* @ECU_Address@FPrm_unlatch@0x021BD200@ */ ECIPP_ALIGNMENT_FLOAT32_IEEE 10000000000 Compu_IDENTITY -10000000000 10000000000 PHYS_UNIT "samples" /end CHARACTERISTIC
/begin GROUP EGRdP_HiExp_EC_Fault "EGRdP higher than expected"
 /begin REF_CHARACTERISTIC FCdc4_EGRdP_HiExp FCdtc_EGRdP_HiExp FCfmi_EGRdP_HiExp FCftb_EGRdP_HiExp FCspn_EGRdP_HiExp FPfl_EGRdP_HiExp FPfu_EGRdP_HiExp FPnd_EGRdP_HiExp FPsvr_EGRdP_HiExp FPsw_ext1_EGRdP_HiExp FPsw_EGRdP_HiExp /end REF_CHARACTERISTIC
/end GROUP
/begin GROUP EGRdP_lo_LP_discon_EC_Fault "EGR valve dP lower than expected - LP tube disconnected"
 /begin REF_CHARACTERISTIC FCdc4_EGRdP_lo_LP_discon FCdtc_EGRdP_lo_LP_discon FCfmi_EGRdP_lo_LP_discon FCftb_EGRdP_lo_LP_discon FCspn_EGRdP_lo_LP_discon FPfl_EGRdP_lo_LP_discon FPfu_EGRdP_lo_LP_discon FPnd_EGRdP_lo_LP_discon FPsvr_EGRdP_lo_LP_discon FPsw_ext1_EGRdP_lo_LP_discon FPsw_EGRdP_lo_LP_discon /end REF_CHARACTERISTIC
/end GROUP
/begin GROUP EGRdP_lo_reversed_EC_Fault "EGR valve dP lower than expected - tubes reversed"
 /begin REF_CHARACTERISTIC FCdc4_EGRdP_lo_reversed FCdtc_EGRdP_lo_reversed FCfmi_EGRdP_lo_reversed FCftb_EGRdP_lo_reversed FCspn_EGRdP_lo_reversed FPfl_EGRdP_lo_reversed FPfu_EGRdP_lo_reversed FPnd_EGRdP_lo_reversed FPsvr_EGRdP_lo_reversed FPsw_ext1_EGRdP_lo_reversed FPsw_EGRdP_lo_reversed /end REF_CHARACTERISTIC
/end GROUP
/begin GROUP EGRdP_LoExp_EC_Fault "EGRdP lower than expected"
 /begin REF_CHARACTERISTIC FCdc4_EGRdP_LoExp FCdtc_EGRdP_LoExp FCfmi_EGRdP_LoExp FCftb_EGRdP_LoExp FCspn_EGRdP_LoExp FPfl_EGRdP_LoExp FPfu_EGRdP_LoExp FPnd_EGRdP_LoExp FPsvr_EGRdP_LoExp FPsw_ext1_EGRdP_LoExp FPsw_EGRdP_LoExp /end REF_CHARACTERISTIC
/end GROUP
/begin GROUP EGRdP_maxv_EC_Fault "EGRdP high voltage"
 /begin REF_CHARACTERISTIC FCdc4_EGRdP_maxv FCdtc_EGRdP_maxv FCfmi_EGRdP_maxv FCftb_EGRdP_maxv FCspn_EGRdP_maxv FPfl_EGRdP_maxv FPfu_EGRdP_maxv FPnd_EGRdP_maxv FPsvr_EGRdP_maxv FPsw_ext1_EGRdP_maxv FPsw_EGRdP_maxv /end REF_CHARACTERISTIC
/end GROUP
/begin GROUP EGRdP_minv_EC_Fault "EGRdP low voltage"
 /begin REF_CHARACTERISTIC FCdc4_EGRdP_minv FCdtc_EGRdP_minv FCfmi_EGRdP_minv FCftb_EGRdP_minv FCspn_EGRdP_minv FPfl_EGRdP_minv FPfu_EGRdP_minv FPnd_EGRdP_minv FPsvr_EGRdP_minv FPsw_ext1_EGRdP_minv FPsw_EGRdP_minv /end REF_CHARACTERISTIC
/end GROUP
/begin GROUP EGRflow_HiExp_EC_Fault "EGR flow higher than expected"
 /begin REF_CHARACTERISTIC FCdc4_EGRflow_HiExp FCdtc_EGRflow_HiExp FCfmi_EGRflow_HiExp FCftb_EGRflow_HiExp FCspn_EGRflow_HiExp FPfl_EGRflow_HiExp FPfu_EGRflow_HiExp FPnd_EGRflow_HiExp FPsvr_EGRflow_HiExp FPsw_ext1_EGRflow_HiExp FPsw_EGRflow_HiExp /end REF_CHARACTERISTIC
/end GROUP
/begin GROUP EGRflow_LoExp_EC_Fault "EGR flow lower than expected 1"
 /begin REF_CHARACTERISTIC FCdc4_EGRflow_LoExp FCdtc_EGRflow_LoExp FCfmi_EGRflow_LoExp FCftb_EGRflow_LoExp FCspn_EGRflow_LoExp FPfl_EGRflow_LoExp FPfu_EGRflow_LoExp FPnd_EGRflow_LoExp FPsvr_EGRflow_LoExp FPsw_ext1_EGRflow_LoExp FPsw_EGRflow_LoExp /end REF_CHARACTERISTIC
/end GROUP
/begin GROUP EGRflow_LoExp2_EC_Fault "EGR flow lower than expected 2"
 /begin REF_CHARACTERISTIC FCdc4_EGRflow_LoExp2 FCdtc_EGRflow_LoExp2 FCfmi_EGRflow_LoExp2 FCftb_EGRflow_LoExp2 FCspn_EGRflow_LoExp2 FPfl_EGRflow_LoExp2 FPfu_EGRflow_LoExp2 FPnd_EGRflow_LoExp2 FPsvr_EGRflow_LoExp2 FPsw_ext1_EGRflow_LoExp2 FPsw_EGRflow_LoExp2 /end REF_CHARACTERISTIC
/end GROUP
/begin GROUP EGRHP_maxv_EC_Fault "EGRHP high voltage"
 /begin REF_CHARACTERISTIC FCdc4_EGRHP_maxv FCdtc_EGRHP_maxv FCfmi_EGRHP_maxv FCftb_EGRHP_maxv FCspn_EGRHP_maxv FPfl_EGRHP_maxv FPfu_EGRHP_maxv FPnd_EGRHP_maxv FPsvr_EGRHP_maxv FPsw_ext1_EGRHP_maxv FPsw_EGRHP_maxv /end REF_CHARACTERISTIC
/end GROUP
/begin GROUP EGRHP_minv_EC_Fault "EGRHP low voltage"
 /begin REF_CHARACTERISTIC FCdc4_EGRHP_minv FCdtc_EGRHP_minv FCfmi_EGRHP_minv FCftb_EGRHP_minv FCspn_EGRHP_minv FPfl_EGRHP_minv FPfu_EGRHP_minv FPnd_EGRHP_minv FPsvr_EGRHP_minv FPsw_ext1_EGRHP_minv FPsw_EGRHP_minv /end REF_CHARACTERISTIC
/end GROUP
/begin GROUP EGRHP_OOR_EC_Fault "EGRHP out of range"
 /begin REF_CHARACTERISTIC FCdc4_EGRHP_OOR FCdtc_EGRHP_OOR FCfmi_EGRHP_OOR FCftb_EGRHP_OOR FCspn_EGRHP_OOR FPfl_EGRHP_OOR FPfu_EGRHP_OOR FPnd_EGRHP_OOR FPsvr_EGRHP_OOR FPsw_ext1_EGRHP_OOR FPsw_EGRHP_OOR /end REF_CHARACTERISTIC
/end GROUP
/begin GROUP EGRO_postlk_EC_Fault "EGR post-orifice leak detected"
 /begin REF_CHARACTERISTIC FCdc4_EGRO_postlk FCdtc_EGRO_postlk FCfmi_EGRO_postlk FCftb_EGRO_postlk FCspn_EGRO_postlk FPfl_EGRO_postlk FPfu_EGRO_postlk FPnd_EGRO_postlk FPsvr_EGRO_postlk FPsw_ext1_EGRO_postlk FPsw_EGRO_postlk /end REF_CHARACTERISTIC
/end GROUP
/begin GROUP EGRT_hi_EC_Fault "EGRT temperature high"
 /begin REF_CHARACTERISTIC FCdc4_EGRT_hi FCdtc_EGRT_hi FCfmi_EGRT_hi FCftb_EGRT_hi FCspn_EGRT_hi FPfl_EGRT_hi FPfu_EGRT_hi FPnd_EGRT_hi FPsvr_EGRT_hi FPsw_ext1_EGRT_hi FPsw_EGRT_hi /end REF_CHARACTERISTIC
/end GROUP
/begin GROUP EGRT_maxv_EC_Fault "EGRT high voltage"
 /begin REF_CHARACTERISTIC FCdc4_EGRT_maxv FCdtc_EGRT_maxv FCfmi_EGRT_maxv FCftb_EGRT_maxv FCspn_EGRT_maxv FPfl_EGRT_maxv FPfu_EGRT_maxv FPnd_EGRT_maxv FPsvr_EGRT_maxv FPsw_ext1_EGRT_maxv FPsw_EGRT_maxv /end REF_CHARACTERISTIC
/end GROUP
/begin GROUP EGRT_minv_EC_Fault "EGRT low voltage"
 /begin REF_CHARACTERISTIC FCdc4_EGRT_minv FCdtc_EGRT_minv FCfmi_EGRT_minv FCftb_EGRT_minv FCspn_EGRT_minv FPfl_EGRT_minv FPfu_EGRT_minv FPnd_EGRT_minv FPsvr_EGRT_minv FPsw_ext1_EGRT_minv FPsw_EGRT_minv /end REF_CHARACTERISTIC
/end GROUP
/begin GROUP EGT_dig_Hi_EC_Fault "Exhaust gas temperature high"
 /begin REF_CHARACTERISTIC FCdc4_EGT_dig_Hi FCdtc_EGT_dig_Hi FCfmi_EGT_dig_Hi FCftb_EGT_dig_Hi FCspn_EGT_dig_Hi FPfl_EGT_dig_Hi FPfu_EGT_dig_Hi FPnd_EGT_dig_Hi FPsvr_EGT_dig_Hi FPsw_ext1_EGT_dig_Hi FPsw_EGT_dig_Hi /end REF_CHARACTERISTIC
/end GROUP
/begin GROUP EGT_maxv_EC_Fault "Exhaust gas temperature high voltage"
 /begin REF_CHARACTERISTIC FCdc4_EGT_maxv FCdtc_EGT_maxv FCfmi_EGT_maxv FCftb_EGT_maxv FCspn_EGT_maxv FPfl_EGT_maxv FPfu_EGT_maxv FPnd_EGT_maxv FPsvr_EGT_maxv FPsw_ext1_EGT_maxv FPsw_EGT_maxv /end REF_CHARACTERISTIC
/end GROUP
/begin GROUP EGT_minv_EC_Fault "Exhaust gas temperature low voltage"
 /begin REF_CHARACTERISTIC FCdc4_EGT_minv FCdtc_EGT_minv FCfmi_EGT_minv FCftb_EGT_minv FCspn_EGT_minv FPfl_EGT_minv FPfu_EGT_minv FPnd_EGT_minv FPsvr_EGT_minv FPsw_ext1_EGT_minv FPsw_EGT_minv /end REF_CHARACTERISTIC
/end GROUP
/begin GROUP EMWT1_HiExp1_EC_Fault "EMWT1/2 higher than expected level 1"
 /begin REF_CHARACTERISTIC FCdc4_EMWT1_HiExp1 FCdtc_EMWT1_HiExp1 FCfmi_EMWT1_HiExp1 FCftb_EMWT1_HiExp1 FCspn_EMWT1_HiExp1 FPfl_EMWT1_HiExp1 FPfu_EMWT1_HiExp1 FPnd_EMWT1_HiExp1 FPsvr_EMWT1_HiExp1 FPsw_ext1_EMWT1_HiExp1 FPsw_EMWT1_HiExp1 /end REF_CHARACTERISTIC
/end GROUP
/begin GROUP EMWT1_HiExp2_EC_Fault "EMWT1/2 higher than expected level 2"
 /begin REF_CHARACTERISTIC FCdc4_EMWT1_HiExp2 FCdtc_EMWT1_HiExp2 FCfmi_EMWT1_HiExp2 FCftb_EMWT1_HiExp2 FCspn_EMWT1_HiExp2 FPfl_EMWT1_HiExp2 FPfu_EMWT1_HiExp2 FPnd_EMWT1_HiExp2 FPsvr_EMWT1_HiExp2 FPsw_ext1_EMWT1_HiExp2 FPsw_EMWT1_HiExp2 /end REF_CHARACTERISTIC
/end GROUP
/begin GROUP EMWT1_maxv_EC_Fault "EMWT1/2 high voltage"
 /begin REF_CHARACTERISTIC FCdc4_EMWT1_maxv FCdtc_EMWT1_maxv FCfmi_EMWT1_maxv FCftb_EMWT1_maxv FCspn_EMWT1_maxv FPfl_EMWT1_maxv FPfu_EMWT1_maxv FPnd_EMWT1_maxv FPsvr_EMWT1_maxv FPsw_ext1_EMWT1_maxv FPsw_EMWT1_maxv /end REF_CHARACTERISTIC
/end GROUP
/begin GROUP EMWT1_minv_EC_Fault "EMWT1/2 low voltage"
 /begin REF_CHARACTERISTIC FCdc4_EMWT1_minv FCdtc_EMWT1_minv FCfmi_EMWT1_minv FCftb_EMWT1_minv FCspn_EMWT1_minv FPfl_EMWT1_minv FPfu_EMWT1_minv FPnd_EMWT1_minv FPsvr_EMWT1_minv FPsw_ext1_EMWT1_minv FPsw_EMWT1_minv /end REF_CHARACTERISTIC
/end GROUP
/begin GROUP envtech_AAT_inv_EC_Fault "Environmental sensor ambient air temperature invalid"
 /begin REF_CHARACTERISTIC FCdc4_envtech_AAT_inv FCdtc_envtech_AAT_inv FCfmi_envtech_AAT_inv FCftb_envtech_AAT_inv FCspn_envtech_AAT_inv FPfl_envtech_AAT_inv FPfu_envtech_AAT_inv FPnd_envtech_AAT_inv FPsvr_envtech_AAT_inv FPsw_ext1_envtech_AAT_inv FPsw_envtech_AAT_inv /end REF_CHARACTERISTIC
/end GROUP
/begin GROUP envtech_BP_inv_EC_Fault "Environmental sensor barometric pressure invalid"
 /begin REF_CHARACTERISTIC FCdc4_envtech_BP_inv FCdtc_envtech_BP_inv FCfmi_envtech_BP_inv FCftb_envtech_BP_inv FCspn_envtech_BP_inv FPfl_envtech_BP_inv FPfu_envtech_BP_inv FPnd_envtech_BP_inv FPsvr_envtech_BP_inv FPsw_ext1_envtech_BP_inv FPsw_envtech_BP_inv /end REF_CHARACTERISTIC
/end GROUP
/begin GROUP envtech_comm_EC_Fault "Environmental sensor receipt lost"
 /begin REF_CHARACTERISTIC FCdc4_envtech_comm FCdtc_envtech_comm FCfmi_envtech_comm FCftb_envtech_comm FCspn_envtech_comm FPfl_envtech_comm FPfu_envtech_comm FPnd_envtech_comm FPsvr_envtech_comm FPsw_ext1_envtech_comm FPsw_envtech_comm /end REF_CHARACTERISTIC
/end GROUP
/begin GROUP envtech_general_EC_Fault "Environmental sensor general fault"
 /begin REF_CHARACTERISTIC FCdc4_envtech_general FCdtc_envtech_general FCfmi_envtech_general FCftb_envtech_general FCspn_envtech_general FPfl_envtech_general FPfu_envtech_general FPnd_envtech_general FPsvr_envtech_general FPsw_ext1_envtech_general FPsw_envtech_general /end REF_CHARACTERISTIC
/end GROUP
/begin GROUP envtech_RH_inv_EC_Fault "Environmental sensor relative humidity invalid"
 /begin REF_CHARACTERISTIC FCdc4_envtech_RH_inv FCdtc_envtech_RH_inv FCfmi_envtech_RH_inv FCftb_envtech_RH_inv FCspn_envtech_RH_inv FPfl_envtech_RH_inv FPfu_envtech_RH_inv FPnd_envtech_RH_inv FPsvr_envtech_RH_inv FPsw_ext1_envtech_RH_inv FPsw_envtech_RH_inv /end REF_CHARACTERISTIC
/end GROUP
/begin GROUP envtech_RH_uns_EC_Fault "Envirotech relative humidity unstable"
 /begin REF_CHARACTERISTIC FCdc4_envtech_RH_uns FCdtc_envtech_RH_uns FCfmi_envtech_RH_uns FCftb_envtech_RH_uns FCspn_envtech_RH_uns FPfl_envtech_RH_uns FPfu_envtech_RH_uns FPnd_envtech_RH_uns FPsvr_envtech_RH_uns FPsw_ext1_envtech_RH_uns FPsw_envtech_RH_uns /end REF_CHARACTERISTIC
/end GROUP
/begin GROUP ERCV_speed_OOR_EC_Fault "Electronic Rotating Crankcase Ventilation (ERCV) motor speed out-of-range"
 /begin REF_CHARACTERISTIC FCdc4_ERCV_speed_OOR FCdtc_ERCV_speed_OOR FCfmi_ERCV_speed_OOR FCftb_ERCV_speed_OOR FCspn_ERCV_speed_OOR FPfl_ERCV_speed_OOR FPfu_ERCV_speed_OOR FPnd_ERCV_speed_OOR FPsvr_ERCV_speed_OOR FPsw_ext1_ERCV_speed_OOR FPsw_ERCV_speed_OOR /end REF_CHARACTERISTIC
/end GROUP
/begin GROUP ERWT1_HiExp1_EC_Fault "ERWT1/2 higher than expected level 1"
 /begin REF_CHARACTERISTIC FCdc4_ERWT1_HiExp1 FCdtc_ERWT1_HiExp1 FCfmi_ERWT1_HiExp1 FCftb_ERWT1_HiExp1 FCspn_ERWT1_HiExp1 FPfl_ERWT1_HiExp1 FPfu_ERWT1_HiExp1 FPnd_ERWT1_HiExp1 FPsvr_ERWT1_HiExp1 FPsw_ext1_ERWT1_HiExp1 FPsw_ERWT1_HiExp1 /end REF_CHARACTERISTIC
/end GROUP
/begin GROUP ERWT1_HiExp2_EC_Fault "ERWT1/2 higher than expected level 2"
 /begin REF_CHARACTERISTIC FCdc4_ERWT1_HiExp2 FCdtc_ERWT1_HiExp2 FCfmi_ERWT1_HiExp2 FCftb_ERWT1_HiExp2 FCspn_ERWT1_HiExp2 FPfl_ERWT1_HiExp2 FPfu_ERWT1_HiExp2 FPnd_ERWT1_HiExp2 FPsvr_ERWT1_HiExp2 FPsw_ext1_ERWT1_HiExp2 FPsw_ERWT1_HiExp2 /end REF_CHARACTERISTIC
/end GROUP
/begin GROUP ERWT1_maxv_EC_Fault "ERWT1/2 high voltage"
 /begin REF_CHARACTERISTIC FCdc4_ERWT1_maxv FCdtc_ERWT1_maxv FCfmi_ERWT1_maxv FCftb_ERWT1_maxv FCspn_ERWT1_maxv FPfl_ERWT1_maxv FPfu_ERWT1_maxv FPnd_ERWT1_maxv FPsvr_ERWT1_maxv FPsw_ext1_ERWT1_maxv FPsw_ERWT1_maxv /end REF_CHARACTERISTIC
/end GROUP
/begin GROUP ERWT1_minv_EC_Fault "ERWT1/2 low voltage"
 /begin REF_CHARACTERISTIC FCdc4_ERWT1_minv FCdtc_ERWT1_minv FCfmi_ERWT1_minv FCftb_ERWT1_minv FCspn_ERWT1_minv FPfl_ERWT1_minv FPfu_ERWT1_minv FPnd_ERWT1_minv FPsvr_ERWT1_minv FPsw_ext1_ERWT1_minv FPsw_ERWT1_minv /end REF_CHARACTERISTIC
/end GROUP
/begin GROUP F1OOR_F2IVS_EC_Fault "FPP1 invalid voltage and FPP2"
 /begin REF_CHARACTERISTIC FCdc4_F1OOR_F2IVS FCdtc_F1OOR_F2IVS FCfmi_F1OOR_F2IVS FCftb_F1OOR_F2IVS FCspn_F1OOR_F2IVS FPfl_F1OOR_F2IVS FPfu_F1OOR_F2IVS FPnd_F1OOR_F2IVS FPsvr_F1OOR_F2IVS FPsw_ext1_F1OOR_F2IVS FPsw_F1OOR_F2IVS /end REF_CHARACTERISTIC
/end GROUP
/begin GROUP F2OOR_F1IVS_EC_Fault "FPP2 invalid voltage and FPP1"
 /begin REF_CHARACTERISTIC FCdc4_F2OOR_F1IVS FCdtc_F2OOR_F1IVS FCfmi_F2OOR_F1IVS FCftb_F2OOR_F1IVS FCspn_F2OOR_F1IVS FPfl_F2OOR_F1IVS FPfu_F2OOR_F1IVS FPnd_F2OOR_F1IVS FPsvr_F2OOR_F1IVS FPsw_ext1_F2OOR_F1IVS FPsw_F2OOR_F1IVS /end REF_CHARACTERISTIC
/end GROUP
/begin GROUP FCoolH2O_lo_EC_Fault "Cooling water flow"
 /begin REF_CHARACTERISTIC FCdc4_FCoolH2O_lo FCdtc_FCoolH2O_lo FCfmi_FCoolH2O_lo FCftb_FCoolH2O_lo FCspn_FCoolH2O_lo FPfl_FCoolH2O_lo FPfu_FCoolH2O_lo FPnd_FCoolH2O_lo FPsvr_FCoolH2O_lo FPsw_ext1_FCoolH2O_lo FPsw_FCoolH2O_lo /end REF_CHARACTERISTIC
/end GROUP
/begin GROUP FIMP_pct_high_EC_Fault "Fuel impurity level high"
 /begin REF_CHARACTERISTIC FCdc4_FIMP_pct_high FCdtc_FIMP_pct_high FCfmi_FIMP_pct_high FCftb_FIMP_pct_high FCspn_FIMP_pct_high FPfl_FIMP_pct_high FPfu_FIMP_pct_high FPnd_FIMP_pct_high FPsvr_FIMP_pct_high FPsw_ext1_FIMP_pct_high FPsw_FIMP_pct_high /end REF_CHARACTERISTIC
/end GROUP
/begin GROUP FIP_LoExp_EC_Fault "FIP lower than expected"
 /begin REF_CHARACTERISTIC FCdc4_FIP_LoExp FCdtc_FIP_LoExp FCfmi_FIP_LoExp FCftb_FIP_LoExp FCspn_FIP_LoExp FPfl_FIP_LoExp FPfu_FIP_LoExp FPnd_FIP_LoExp FPsvr_FIP_LoExp FPsw_ext1_FIP_LoExp FPsw_FIP_LoExp /end REF_CHARACTERISTIC
/end GROUP
/begin GROUP flash_fail_EC_Fault "Flash checksum invalid"
 /begin REF_CHARACTERISTIC FCdc4_flash_fail FCdtc_flash_fail FCfmi_flash_fail FCftb_flash_fail FCspn_flash_fail FPfl_flash_fail FPfu_flash_fail FPnd_flash_fail FPsvr_flash_fail FPsw_ext1_flash_fail FPsw_flash_fail /end REF_CHARACTERISTIC
/end GROUP
/begin GROUP FOP_start_EC_Fault "Fuel pressure high during start"
 /begin REF_CHARACTERISTIC FCdc4_FOP_start FCdtc_FOP_start FCfmi_FOP_start FCftb_FOP_start FCspn_FOP_start FPfl_FOP_start FPfu_FOP_start FPnd_FOP_start FPsvr_FOP_start FPsw_ext1_FOP_start FPsw_FOP_start /end REF_CHARACTERISTIC
/end GROUP
/begin GROUP FP_high_EC_Fault "Primary fuel pressure high"
 /begin REF_CHARACTERISTIC FCdc4_FP_high FCdtc_FP_high FCfmi_FP_high FCftb_FP_high FCspn_FP_high FPfl_FP_high FPfu_FP_high FPnd_FP_high FPsvr_FP_high FPsw_ext1_FP_high FPsw_FP_high /end REF_CHARACTERISTIC
/end GROUP
/begin GROUP FP_low_EC_Fault "Primary fuel pressure low"
 /begin REF_CHARACTERISTIC FCdc4_FP_low FCdtc_FP_low FCfmi_FP_low FCftb_FP_low FCspn_FP_low FPfl_FP_low FPfu_FP_low FPnd_FP_low FPsvr_FP_low FPsw_ext1_FP_low FPsw_FP_low /end REF_CHARACTERISTIC
/end GROUP
/begin GROUP FP_maxv_EC_Fault "Primary FP high voltage"
 /begin REF_CHARACTERISTIC FCdc4_FP_maxv FCdtc_FP_maxv FCfmi_FP_maxv FCftb_FP_maxv FCspn_FP_maxv FPfl_FP_maxv FPfu_FP_maxv FPnd_FP_maxv FPsvr_FP_maxv FPsw_ext1_FP_maxv FPsw_FP_maxv /end REF_CHARACTERISTIC
/end GROUP
/begin GROUP FP_minv_EC_Fault "Primary FP low voltage"
 /begin REF_CHARACTERISTIC FCdc4_FP_minv FCdtc_FP_minv FCfmi_FP_minv FCftb_FP_minv FCspn_FP_minv FPfl_FP_minv FPfu_FP_minv FPnd_FP_minv FPsvr_FP_minv FPsw_ext1_FP_minv FPsw_FP_minv /end REF_CHARACTERISTIC
/end GROUP
/begin GROUP FP2_high_EC_Fault "Secondary fuel pressure high"
 /begin REF_CHARACTERISTIC FCdc4_FP2_high FCdtc_FP2_high FCfmi_FP2_high FCftb_FP2_high FCspn_FP2_high FPfl_FP2_high FPfu_FP2_high FPnd_FP2_high FPsvr_FP2_high FPsw_ext1_FP2_high FPsw_FP2_high /end REF_CHARACTERISTIC
/end GROUP
/begin GROUP FP2_low_EC_Fault "Secondary fuel pressure low"
 /begin REF_CHARACTERISTIC FCdc4_FP2_low FCdtc_FP2_low FCfmi_FP2_low FCftb_FP2_low FCspn_FP2_low FPfl_FP2_low FPfu_FP2_low FPnd_FP2_low FPsvr_FP2_low FPsw_ext1_FP2_low FPsw_FP2_low /end REF_CHARACTERISTIC
/end GROUP
/begin GROUP FP2_maxv_EC_Fault "Secondary FP high voltage"
 /begin REF_CHARACTERISTIC FCdc4_FP2_maxv FCdtc_FP2_maxv FCfmi_FP2_maxv FCftb_FP2_maxv FCspn_FP2_maxv FPfl_FP2_maxv FPfu_FP2_maxv FPnd_FP2_maxv FPsvr_FP2_maxv FPsw_ext1_FP2_maxv FPsw_FP2_maxv /end REF_CHARACTERISTIC
/end GROUP
/begin GROUP FP2_minv_EC_Fault "Secondary FP low voltage"
 /begin REF_CHARACTERISTIC FCdc4_FP2_minv FCdtc_FP2_minv FCfmi_FP2_minv FCftb_FP2_minv FCspn_FP2_minv FPfl_FP2_minv FPfu_FP2_minv FPnd_FP2_minv FPsvr_FP2_minv FPsw_ext1_FP2_minv FPsw_FP2_minv /end REF_CHARACTERISTIC
/end GROUP
/begin GROUP FPD_off_hi_EC_Fault "Fuel pump motor shorted to power"
 /begin REF_CHARACTERISTIC FCdc4_FPD_off_hi FCdtc_FPD_off_hi FCfmi_FPD_off_hi FCftb_FPD_off_hi FCspn_FPD_off_hi FPfl_FPD_off_hi FPfu_FPD_off_hi FPnd_FPD_off_hi FPsvr_FPD_off_hi FPsw_ext1_FPD_off_hi FPsw_FPD_off_hi /end REF_CHARACTERISTIC
/end GROUP
/begin GROUP FPD_on_lo_EC_Fault "Fuel pump motor loop open or shorted to ground"
 /begin REF_CHARACTERISTIC FCdc4_FPD_on_lo FCdtc_FPD_on_lo FCfmi_FPD_on_lo FCftb_FPD_on_lo FCspn_FPD_on_lo FPfl_FPD_on_lo FPfu_FPD_on_lo FPnd_FPD_on_lo FPsvr_FPD_on_lo FPsw_ext1_FPD_on_lo FPsw_FPD_on_lo /end REF_CHARACTERISTIC
/end GROUP
/begin GROUP FPlo_derate_actv_EC_Fault "Low fuel pressure - forced limited power"
 /begin REF_CHARACTERISTIC FCdc4_FPlo_derate_actv FCdtc_FPlo_derate_actv FCfmi_FPlo_derate_actv FCftb_FPlo_derate_actv FCspn_FPlo_derate_actv FPfl_FPlo_derate_actv FPfu_FPlo_derate_actv FPnd_FPlo_derate_actv FPsvr_FPlo_derate_actv FPsw_ext1_FPlo_derate_actv FPsw_FPlo_derate_actv /end REF_CHARACTERISTIC
/end GROUP
/begin GROUP FPlo_derate_excess_EC_Fault "Low fuel pressure - forced limited power excessive duration"
 /begin REF_CHARACTERISTIC FCdc4_FPlo_derate_excess FCdtc_FPlo_derate_excess FCfmi_FPlo_derate_excess FCftb_FPlo_derate_excess FCspn_FPlo_derate_excess FPfl_FPlo_derate_excess FPfu_FPlo_derate_excess FPnd_FPlo_derate_excess FPsvr_FPlo_derate_excess FPsw_ext1_FPlo_derate_excess FPsw_FPlo_derate_excess /end REF_CHARACTERISTIC
/end GROUP
/begin GROUP FPP_NeutLock_fail_EC_Fault "FPP indicates marine handle neutral lock failed"
 /begin REF_CHARACTERISTIC FCdc4_FPP_NeutLock_fail FCdtc_FPP_NeutLock_fail FCfmi_FPP_NeutLock_fail FCftb_FPP_NeutLock_fail FCspn_FPP_NeutLock_fail FPfl_FPP_NeutLock_fail FPfu_FPP_NeutLock_fail FPnd_FPP_NeutLock_fail FPsvr_FPP_NeutLock_fail FPsw_ext1_FPP_NeutLock_fail FPsw_FPP_NeutLock_fail /end REF_CHARACTERISTIC
/end GROUP
/begin GROUP FPP1_IVS_max_EC_Fault "FPP1 higher than IVS limit"
 /begin REF_CHARACTERISTIC FCdc4_FPP1_IVS_max FCdtc_FPP1_IVS_max FCfmi_FPP1_IVS_max FCftb_FPP1_IVS_max FCspn_FPP1_IVS_max FPfl_FPP1_IVS_max FPfu_FPP1_IVS_max FPnd_FPP1_IVS_max FPsvr_FPP1_IVS_max FPsw_ext1_FPP1_IVS_max FPsw_FPP1_IVS_max /end REF_CHARACTERISTIC
/end GROUP
/begin GROUP FPP1_IVS_min_EC_Fault "FPP1 lower than IVS limit"
 /begin REF_CHARACTERISTIC FCdc4_FPP1_IVS_min FCdtc_FPP1_IVS_min FCfmi_FPP1_IVS_min FCftb_FPP1_IVS_min FCspn_FPP1_IVS_min FPfl_FPP1_IVS_min FPfu_FPP1_IVS_min FPnd_FPP1_IVS_min FPsvr_FPP1_IVS_min FPsw_ext1_FPP1_IVS_min FPsw_FPP1_IVS_min /end REF_CHARACTERISTIC
/end GROUP
/begin GROUP FPP1_max_EC_Fault "FPP1 high voltage"
 /begin REF_CHARACTERISTIC FCdc4_FPP1_max FCdtc_FPP1_max FCfmi_FPP1_max FCftb_FPP1_max FCspn_FPP1_max FPfl_FPP1_max FPfu_FPP1_max FPnd_FPP1_max FPsvr_FPP1_max FPsw_ext1_FPP1_max FPsw_FPP1_max /end REF_CHARACTERISTIC
/end GROUP
/begin GROUP FPP1_min_EC_Fault "FPP1 low voltage"
 /begin REF_CHARACTERISTIC FCdc4_FPP1_min FCdtc_FPP1_min FCfmi_FPP1_min FCftb_FPP1_min FCspn_FPP1_min FPfl_FPP1_min FPfu_FPP1_min FPnd_FPP1_min FPsvr_FPP1_min FPsw_ext1_FPP1_min FPsw_FPP1_min /end REF_CHARACTERISTIC
/end GROUP
/begin GROUP FPP12_IVS_max_EC_Fault "IVS stuck at-idle, FPP1/2 match"
 /begin REF_CHARACTERISTIC FCdc4_FPP12_IVS_max FCdtc_FPP12_IVS_max FCfmi_FPP12_IVS_max FCftb_FPP12_IVS_max FCspn_FPP12_IVS_max FPfl_FPP12_IVS_max FPfu_FPP12_IVS_max FPnd_FPP12_IVS_max FPsvr_FPP12_IVS_max FPsw_ext1_FPP12_IVS_max FPsw_FPP12_IVS_max /end REF_CHARACTERISTIC
/end GROUP
/begin GROUP FPP12_IVS_min_EC_Fault "IVS stuck off-idle, FPP1/2 match"
 /begin REF_CHARACTERISTIC FCdc4_FPP12_IVS_min FCdtc_FPP12_IVS_min FCfmi_FPP12_IVS_min FCftb_FPP12_IVS_min FCspn_FPP12_IVS_min FPfl_FPP12_IVS_min FPfu_FPP12_IVS_min FPnd_FPP12_IVS_min FPsvr_FPP12_IVS_min FPsw_ext1_FPP12_IVS_min FPsw_FPP12_IVS_min /end REF_CHARACTERISTIC
/end GROUP
/begin GROUP FPP12_OOR_EC_Fault "FPP1/2 simultaneous voltages"
 /begin REF_CHARACTERISTIC FCdc4_FPP12_OOR FCdtc_FPP12_OOR FCfmi_FPP12_OOR FCftb_FPP12_OOR FCspn_FPP12_OOR FPfl_FPP12_OOR FPfu_FPP12_OOR FPnd_FPP12_OOR FPsvr_FPP12_OOR FPsw_ext1_FPP12_OOR FPsw_FPP12_OOR /end REF_CHARACTERISTIC
/end GROUP
/begin GROUP FPP12IVS_TSC1_EC_Fault "FPP fault and J1939 TSC1 message receipt lost"
 /begin REF_CHARACTERISTIC FCdc4_FPP12IVS_TSC1 FCdtc_FPP12IVS_TSC1 FCfmi_FPP12IVS_TSC1 FCftb_FPP12IVS_TSC1 FCspn_FPP12IVS_TSC1 FPfl_FPP12IVS_TSC1 FPfu_FPP12IVS_TSC1 FPnd_FPP12IVS_TSC1 FPsvr_FPP12IVS_TSC1 FPsw_ext1_FPP12IVS_TSC1 FPsw_FPP12IVS_TSC1 /end REF_CHARACTERISTIC
/end GROUP
/begin GROUP FPP12MM_IVSMM_EC_Fault "FPP1/2 do not match each other"
 /begin REF_CHARACTERISTIC FCdc4_FPP12MM_IVSMM FCdtc_FPP12MM_IVSMM FCfmi_FPP12MM_IVSMM FCftb_FPP12MM_IVSMM FCspn_FPP12MM_IVSMM FPfl_FPP12MM_IVSMM FPfu_FPP12MM_IVSMM FPnd_FPP12MM_IVSMM FPsvr_FPP12MM_IVSMM FPsw_ext1_FPP12MM_IVSMM FPsw_FPP12MM_IVSMM /end REF_CHARACTERISTIC
/end GROUP
/begin GROUP FPP12pct_hi_EC_Fault "FPP1 higher than FPP2"
 /begin REF_CHARACTERISTIC FCdc4_FPP12pct_hi FCdtc_FPP12pct_hi FCfmi_FPP12pct_hi FCftb_FPP12pct_hi FCspn_FPP12pct_hi FPfl_FPP12pct_hi FPfu_FPP12pct_hi FPnd_FPP12pct_hi FPsvr_FPP12pct_hi FPsw_ext1_FPP12pct_hi FPsw_FPP12pct_hi /end REF_CHARACTERISTIC
/end GROUP
/begin GROUP FPP12pct_lo_EC_Fault "FPP1 lower than FPP2"
 /begin REF_CHARACTERISTIC FCdc4_FPP12pct_lo FCdtc_FPP12pct_lo FCfmi_FPP12pct_lo FCftb_FPP12pct_lo FCspn_FPP12pct_lo FPfl_FPP12pct_lo FPfu_FPP12pct_lo FPnd_FPP12pct_lo FPsvr_FPP12pct_lo FPsw_ext1_FPP12pct_lo FPsw_FPP12pct_lo /end REF_CHARACTERISTIC
/end GROUP
/begin GROUP FPP2_IVS_max_EC_Fault "FPP2 higher than IVS limit"
 /begin REF_CHARACTERISTIC FCdc4_FPP2_IVS_max FCdtc_FPP2_IVS_max FCfmi_FPP2_IVS_max FCftb_FPP2_IVS_max FCspn_FPP2_IVS_max FPfl_FPP2_IVS_max FPfu_FPP2_IVS_max FPnd_FPP2_IVS_max FPsvr_FPP2_IVS_max FPsw_ext1_FPP2_IVS_max FPsw_FPP2_IVS_max /end REF_CHARACTERISTIC
/end GROUP
/begin GROUP FPP2_IVS_min_EC_Fault "FPP2 lower than IVS limit"
 /begin REF_CHARACTERISTIC FCdc4_FPP2_IVS_min FCdtc_FPP2_IVS_min FCfmi_FPP2_IVS_min FCftb_FPP2_IVS_min FCspn_FPP2_IVS_min FPfl_FPP2_IVS_min FPfu_FPP2_IVS_min FPnd_FPP2_IVS_min FPsvr_FPP2_IVS_min FPsw_ext1_FPP2_IVS_min FPsw_FPP2_IVS_min /end REF_CHARACTERISTIC
/end GROUP
/begin GROUP FPP2_max_EC_Fault "FPP2 high voltage"
 /begin REF_CHARACTERISTIC FCdc4_FPP2_max FCdtc_FPP2_max FCfmi_FPP2_max FCftb_FPP2_max FCspn_FPP2_max FPfl_FPP2_max FPfu_FPP2_max FPnd_FPP2_max FPsvr_FPP2_max FPsw_ext1_FPP2_max FPsw_FPP2_max /end REF_CHARACTERISTIC
/end GROUP
/begin GROUP FPP2_min_EC_Fault "FPP2 low voltage"
 /begin REF_CHARACTERISTIC FCdc4_FPP2_min FCdtc_FPP2_min FCfmi_FPP2_min FCftb_FPP2_min FCspn_FPP2_min FPfl_FPP2_min FPfu_FPP2_min FPnd_FPP2_min FPsvr_FPP2_min FPsw_ext1_FPP2_min FPsw_FPP2_min /end REF_CHARACTERISTIC
/end GROUP
/begin GROUP FPP2V_TSC1_EC_Fault "FPP2 fault and J1939 TSC1 message receipt lost"
 /begin REF_CHARACTERISTIC FCdc4_FPP2V_TSC1 FCdtc_FPP2V_TSC1 FCfmi_FPP2V_TSC1 FCftb_FPP2V_TSC1 FCspn_FPP2V_TSC1 FPfl_FPP2V_TSC1 FPfu_FPP2V_TSC1 FPnd_FPP2V_TSC1 FPsvr_FPP2V_TSC1 FPsw_ext1_FPP2V_TSC1 FPsw_FPP2V_TSC1 /end REF_CHARACTERISTIC
/end GROUP
/begin GROUP FPrly_coilopen_EC_Fault "Fuel pump relay coil open"
 /begin REF_CHARACTERISTIC FCdc4_FPrly_coilopen FCdtc_FPrly_coilopen FCfmi_FPrly_coilopen FCftb_FPrly_coilopen FCspn_FPrly_coilopen FPfl_FPrly_coilopen FPfu_FPrly_coilopen FPnd_FPrly_coilopen FPsvr_FPrly_coilopen FPsw_ext1_FPrly_coilopen FPsw_FPrly_coilopen /end REF_CHARACTERISTIC
/end GROUP
/end MODULE
/end PROJECT
