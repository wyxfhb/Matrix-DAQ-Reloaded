ASAP2_VERSION 1 61
/begin PROJECT Econtrols_4G "4G Test"
/begin HEADER "4G A2L Configuration" PROJECT_NO EControls4G /* config for version control */ VERSION "$Revision: 82130 $:" /* config for version control */ /end HEADER
/begin MODULE EControls_4G_SH2A "EControls 4G"
/begin MOD_COMMON "" DEPOSIT ABSOLUTE BYTE_ORDER MSB_FIRST /end MOD_COMMON
/* Define the Record Layouts */
/begin RECORD_LAYOUT ECIPP_ALIGNMENT_UBYTE FNC_VALUES 1 UBYTE COLUMN_DIR DIRECT /end RECORD_LAYOUT
/begin RECORD_LAYOUT ECIPP_ALIGNMENT_UWORD FNC_VALUES 1 UWORD COLUMN_DIR DIRECT /end RECORD_LAYOUT
/begin RECORD_LAYOUT ECIPP_ALIGNMENT_SWORD FNC_VALUES 1 SWORD COLUMN_DIR DIRECT /end RECORD_LAYOUT
/begin RECORD_LAYOUT ECIPP_Lookup_SWORD AXIS_PTS_X 1 SWORD INDEX_INCR DIRECT /end RECORD_LAYOUT
/begin RECORD_LAYOUT ECIPP_ALIGNMENT_ULONG FNC_VALUES 1 ULONG COLUMN_DIR DIRECT /end RECORD_LAYOUT
/begin RECORD_LAYOUT ECIPP_ALIGNMENT_FLOAT32_IEEE FNC_VALUES 1 FLOAT32_IEEE COLUMN_DIR DIRECT /end RECORD_LAYOUT
/begin MEASUREMENT ETHC_state "ETHC output state{ETHC_state&0xff=0x00:Off}{ETHC_state&0xff=0x01:100% On}{ETHC_state&0xff=0x02:Pulse Off}" UBYTE ETHC_state_COMPU_VTAB 0 0 0 255 ECU_ADDRESS 0x01000320 BIT_MASK 0xff /end MEASUREMENT
/begin COMPU_METHOD ETHC_state_COMPU_VTAB "Verbal Table" TAB_VERB "%.0" "list" COMPU_TAB_REF ETHC_state_COMPU_VTAB_REF /end COMPU_METHOD
/begin COMPU_VTAB ETHC_state_COMPU_VTAB_REF "Verbal Table" TAB_VERB 3 0x00 "Off" 0x01 "100% On" 0x02 "Pulse Off" DEFAULT_VALUE "UNKNOWN" /end COMPU_VTAB
/begin MEASUREMENT ETHC_CHT_th "ETHC CHT threshold" UWORD Compu_ETHC_CHT_th 0 0 -460 563.984375 ECU_ADDRESS 0x01000C58 /end MEASUREMENT
/begin COMPU_METHOD Compu_ETHC_CHT_th " " RAT_FUNC "%.1" "deg F" COEFFS 0 64 29440 0 0 1 /end COMPU_METHOD
/begin MEASUREMENT ETHC_DC "ETHC duty cycle" UWORD Compu_ETHC_DC 0 0 0 99.9984741210938 ECU_ADDRESS 0x01000C60 /end MEASUREMENT
/begin COMPU_METHOD Compu_ETHC_DC " " RAT_FUNC "%.1" "%" COEFFS 0 655.36 0 0 0 1 /end COMPU_METHOD
/begin MEASUREMENT ETHC_dT "ETHC threshold delta-T" SWORD Compu_ETHC_dT 0 0 -512 511.984375 ECU_ADDRESS 0x01000C80 /end MEASUREMENT
/begin COMPU_METHOD Compu_ETHC_dT " " RAT_FUNC "%.1" "deg F" COEFFS 0 64 0 0 0 1 /end COMPU_METHOD
/begin MEASUREMENT CHTdt "CHTdt" SWORD Compu_CHTdt 0 0 -256 255.9921875 ECU_ADDRESS 0x01000EF8 /end MEASUREMENT
/begin COMPU_METHOD Compu_CHTdt " " RAT_FUNC "%.2" "deg F/sec" COEFFS 0 128 0 0 0 1 /end COMPU_METHOD
/begin MEASUREMENT cfgout_state "Current output #1 state{cfgout_state&0xff=0x00:Off (open)}{cfgout_state&0xff=0x01:On (grounded)}" UBYTE cfgout_state_COMPU_VTAB 0 0 0 255 ECU_ADDRESS 0x01001238 BIT_MASK 0xff /end MEASUREMENT
/begin COMPU_METHOD cfgout_state_COMPU_VTAB "Verbal Table" TAB_VERB "%.0" "list" COMPU_TAB_REF cfgout_state_COMPU_VTAB_REF /end COMPU_METHOD
/begin COMPU_VTAB cfgout_state_COMPU_VTAB_REF "Verbal Table" TAB_VERB 2 0x00 "Off (open)" 0x01 "On (grounded)" DEFAULT_VALUE "UNKNOWN" /end COMPU_VTAB
/begin MEASUREMENT crank_latch_cnt "Crank limiter duty-cycle" UWORD Compu_crank_latch_cnt 0 0 0 99.9984741210938 ECU_ADDRESS 0x010013A0 /end MEASUREMENT
/begin COMPU_METHOD Compu_crank_latch_cnt " " RAT_FUNC "%.1" "%" COEFFS 0 655.36 0 0 0 1 /end COMPU_METHOD
/begin MEASUREMENT crank_total "Cumulative crank-time" UWORD Compu_crank_total 0 0 0 65.535 ECU_ADDRESS 0x010013B0 /end MEASUREMENT
/begin COMPU_METHOD Compu_crank_total " " RAT_FUNC "%.1" "sec" COEFFS 0 1000 0 0 0 1 /end COMPU_METHOD
/begin MEASUREMENT cfgout2_state "Current output #2 state{cfgout2_state&0xff=0x00:Off (open)}{cfgout2_state&0xff=0x01:On (grounded)}" UBYTE cfgout2_state_COMPU_VTAB 0 0 0 255 ECU_ADDRESS 0x01001BE0 BIT_MASK 0xff /end MEASUREMENT
/begin COMPU_METHOD cfgout2_state_COMPU_VTAB "Verbal Table" TAB_VERB "%.0" "list" COMPU_TAB_REF cfgout2_state_COMPU_VTAB_REF /end COMPU_METHOD
/begin COMPU_VTAB cfgout2_state_COMPU_VTAB_REF "Verbal Table" TAB_VERB 2 0x00 "Off (open)" 0x01 "On (grounded)" DEFAULT_VALUE "UNKNOWN" /end COMPU_VTAB
/begin MEASUREMENT cfgout3_state "Current output #3 state{cfgout3_state&0xff=0x00:Off (open)}{cfgout3_state&0xff=0x01:On (grounded)}" UBYTE cfgout3_state_COMPU_VTAB 0 0 0 255 ECU_ADDRESS 0x01001D88 BIT_MASK 0xff /end MEASUREMENT
/begin COMPU_METHOD cfgout3_state_COMPU_VTAB "Verbal Table" TAB_VERB "%.0" "list" COMPU_TAB_REF cfgout3_state_COMPU_VTAB_REF /end COMPU_METHOD
/begin COMPU_VTAB cfgout3_state_COMPU_VTAB_REF "Verbal Table" TAB_VERB 2 0x00 "Off (open)" 0x01 "On (grounded)" DEFAULT_VALUE "UNKNOWN" /end COMPU_VTAB
/begin MEASUREMENT TransFPP_DC "Trans FPP current duty-cycle" UWORD Compu_TransFPP_DC 0 0 0 99.9984741210938 ECU_ADDRESS 0x01002830 /end MEASUREMENT
/begin COMPU_METHOD Compu_TransFPP_DC " " RAT_FUNC "%.1" "%" COEFFS 0 655.36 0 0 0 1 /end COMPU_METHOD
/begin MEASUREMENT MaxSetPt_light "Active{MaxSetPt_light&0x01=0x00:Off}{MaxSetPt_light&0x01=0x01:On}" UBYTE MaxSetPt_light_COMPU_VTAB 0 0 0 255 ECU_ADDRESS 0x01003118 BIT_MASK 0x01 /end MEASUREMENT
/begin COMPU_METHOD MaxSetPt_light_COMPU_VTAB "Verbal Table" TAB_VERB "%.0" "list" COMPU_TAB_REF MaxSetPt_light_COMPU_VTAB_REF /end COMPU_METHOD
/begin COMPU_VTAB MaxSetPt_light_COMPU_VTAB_REF "Verbal Table" TAB_VERB 2 0x00 "Off" 0x01 "On" DEFAULT_VALUE "UNKNOWN" /end COMPU_VTAB
/begin MEASUREMENT flag1_HWARN "Hard warning{flag1_HWARN&0x02=0x00:Off}{flag1_HWARN&0x02=0x02:On}" UBYTE flag1_HWARN_COMPU_VTAB 0 0 0 255 ECU_ADDRESS 0x01003248 BIT_MASK 0x02 /end MEASUREMENT
/begin COMPU_METHOD flag1_HWARN_COMPU_VTAB "Verbal Table" TAB_VERB "%.0" "list" COMPU_TAB_REF flag1_HWARN_COMPU_VTAB_REF /end COMPU_METHOD
/begin COMPU_VTAB flag1_HWARN_COMPU_VTAB_REF "Verbal Table" TAB_VERB 2 0x00 "Off" 0x02 "On" DEFAULT_VALUE "UNKNOWN" /end COMPU_VTAB
/begin MEASUREMENT flag1_SWARN "Soft warning{flag1_SWARN&0x01=0x00:Off}{flag1_SWARN&0x01=0x01:On}" UBYTE flag1_SWARN_COMPU_VTAB 0 0 0 255 ECU_ADDRESS 0x01003250 BIT_MASK 0x01 /end MEASUREMENT
/begin COMPU_METHOD flag1_SWARN_COMPU_VTAB "Verbal Table" TAB_VERB "%.0" "list" COMPU_TAB_REF flag1_SWARN_COMPU_VTAB_REF /end COMPU_METHOD
/begin COMPU_VTAB flag1_SWARN_COMPU_VTAB_REF "Verbal Table" TAB_VERB 2 0x00 "Off" 0x01 "On" DEFAULT_VALUE "UNKNOWN" /end COMPU_VTAB
/begin CHARACTERISTIC cfgout2_DG1on "DIG1_on" VALUE 0x001CA4AC /* @ECU_Address@cfgout2_DG1on@0x01003E90@ */ ECIPP_ALIGNMENT_UWORD 256 Compu_cfgout2_DG1on 0 255.99609375 /end CHARACTERISTIC
/begin COMPU_METHOD Compu_cfgout2_DG1on " " RAT_FUNC "%.2" "volts" COEFFS 0 256 0 0 0 1 /end COMPU_METHOD
/begin CHARACTERISTIC cfgout2_DG1off "DIG1_off" VALUE 0x001CA4C4 /* @ECU_Address@cfgout2_DG1off@0x01003E98@ */ ECIPP_ALIGNMENT_UWORD 256 Compu_cfgout2_DG1off 0 255.99609375 /end CHARACTERISTIC
/begin COMPU_METHOD Compu_cfgout2_DG1off " " RAT_FUNC "%.2" "volts" COEFFS 0 256 0 0 0 1 /end COMPU_METHOD
/begin CHARACTERISTIC cfgout3_DG1on "DIG1_on" VALUE 0x001CA504 /* @ECU_Address@cfgout3_DG1on@0x01003EA0@ */ ECIPP_ALIGNMENT_UWORD 256 Compu_cfgout3_DG1on 0 255.99609375 /end CHARACTERISTIC
/begin COMPU_METHOD Compu_cfgout3_DG1on " " RAT_FUNC "%.2" "volts" COEFFS 0 256 0 0 0 1 /end COMPU_METHOD
/begin CHARACTERISTIC cfgout3_DG1off "DIG1_off" VALUE 0x001CA51C /* @ECU_Address@cfgout3_DG1off@0x01003EA8@ */ ECIPP_ALIGNMENT_UWORD 256 Compu_cfgout3_DG1off 0 255.99609375 /end CHARACTERISTIC
/begin COMPU_METHOD Compu_cfgout3_DG1off " " RAT_FUNC "%.2" "volts" COEFFS 0 256 0 0 0 1 /end COMPU_METHOD
/begin CHARACTERISTIC start_lock_output "Starter control output channel{start_lock_output&0xff=0:Standard}{start_lock_output&0xff=1:Aux PWM1}{start_lock_output&0xff=2:Aux PWM2}{start_lock_output&0xff=3:Aux PWM3}{start_lock_output&0xff=4:Aux PWM4}{start_lock_output&0xff=5:Aux PWM5}{start_lock_out" VALUE 0x001c9080 /* @ECU_Address@start_lock_output@0x01003F40@ */ ECIPP_ALIGNMENT_UBYTE 255 start_lock_output_COMPU_VTAB 0 255 BIT_MASK 0xff /end CHARACTERISTIC
/begin COMPU_METHOD start_lock_output_COMPU_VTAB "Verbal Table" TAB_VERB "%.0" "list" COMPU_TAB_REF start_lock_output_COMPU_VTAB_REF /end COMPU_METHOD
/begin COMPU_VTAB start_lock_output_COMPU_VTAB_REF "Verbal Table" TAB_VERB 20 0 "Standard" 1 "Aux PWM1" 2 "Aux PWM2" 3 "Aux PWM3" 4 "Aux PWM4" 5 "Aux PWM5" 6 "Aux PWM6" 7 "EGOH1" 8 "EGOH2" 9 "EGOH3" 10 "EGOH4" 11 "Aux PWM7" 12 "Aux PWM8" 13 "Aux PWM9" 14 "Aux PWM10" 15 "Aux PWM11" 16 "Aux PWM12" 17 "Aux PWM13" 18 "Aux PWM14" 19 "Aux PWM15" DEFAULT_VALUE "UNKNOWN" /end COMPU_VTAB
/begin CHARACTERISTIC cfgout_keyoff "Output behavior with key off{cfgout_keyoff&0xff=0:All Outputs Off}{cfgout_keyoff&0xff=1:Engine Stopped State}" VALUE 0x001c8fcf /* @ECU_Address@cfgout_keyoff@0x01004328@ */ ECIPP_ALIGNMENT_UBYTE 255 cfgout_keyoff_COMPU_VTAB 0 255 BIT_MASK 0xff /end CHARACTERISTIC
/begin COMPU_METHOD cfgout_keyoff_COMPU_VTAB "Verbal Table" TAB_VERB "%.0" "list" COMPU_TAB_REF cfgout_keyoff_COMPU_VTAB_REF /end COMPU_METHOD
/begin COMPU_VTAB cfgout_keyoff_COMPU_VTAB_REF "Verbal Table" TAB_VERB 2 0 "All Outputs Off" 1 "Engine Stopped State" DEFAULT_VALUE "UNKNOWN" /end COMPU_VTAB
/begin CHARACTERISTIC MaxSetPt_appup_kph "Approach indication KPH window" VALUE 0x001CA00C /* @ECU_Address@MaxSetPt_appup_kph@0x01004728@ */ ECIPP_ALIGNMENT_UWORD 256 Compu_MaxSetPt_appup_kph 0 255.99609375 /end CHARACTERISTIC
/begin COMPU_METHOD Compu_MaxSetPt_appup_kph " " RAT_FUNC "%.1" "kph" COEFFS 0 256 0 0 0 1 /end COMPU_METHOD
/begin CHARACTERISTIC MaxSetPt_appdn_kph "Fall-off indication KPH window" VALUE 0x001CA00E /* @ECU_Address@MaxSetPt_appdn_kph@0x01004730@ */ ECIPP_ALIGNMENT_UWORD 256 Compu_MaxSetPt_appdn_kph 0 255.99609375 /end CHARACTERISTIC
/begin COMPU_METHOD Compu_MaxSetPt_appdn_kph " " RAT_FUNC "%.1" "kph" COEFFS 0 256 0 0 0 1 /end COMPU_METHOD
/begin CHARACTERISTIC MSP2_appup_kph "Approach indication KPH window" VALUE 0x001CA01E /* @ECU_Address@MSP2_appup_kph@0x01004738@ */ ECIPP_ALIGNMENT_UWORD 256 Compu_MSP2_appup_kph 0 255.99609375 /end CHARACTERISTIC
/begin COMPU_METHOD Compu_MSP2_appup_kph " " RAT_FUNC "%.1" "kph" COEFFS 0 256 0 0 0 1 /end COMPU_METHOD
/begin CHARACTERISTIC MSP2_appdn_kph "Fall-off indication KPH window" VALUE 0x001CA020 /* @ECU_Address@MSP2_appdn_kph@0x01004740@ */ ECIPP_ALIGNMENT_UWORD 256 Compu_MSP2_appdn_kph 0 255.99609375 /end CHARACTERISTIC
/begin COMPU_METHOD Compu_MSP2_appdn_kph " " RAT_FUNC "%.1" "kph" COEFFS 0 256 0 0 0 1 /end COMPU_METHOD
/begin CHARACTERISTIC MSP2_appup_rpm "Approach indication RPM window" VALUE 0x001CA01A /* @ECU_Address@MSP2_appup_rpm@0x01004748@ */ ECIPP_ALIGNMENT_UWORD 65535 Compu_MSP2_appup_rpm 0 65535 /end CHARACTERISTIC
/begin COMPU_METHOD Compu_MSP2_appup_rpm " " RAT_FUNC "%.0" "rpm" COEFFS 0 1 0 0 0 1 /end COMPU_METHOD
/begin CHARACTERISTIC MSP2_appdn_rpm "Fall-off indication RPM window" VALUE 0x001CA01C /* @ECU_Address@MSP2_appdn_rpm@0x01004750@ */ ECIPP_ALIGNMENT_UWORD 65535 Compu_MSP2_appdn_rpm 0 65535 /end CHARACTERISTIC
/begin COMPU_METHOD Compu_MSP2_appdn_rpm " " RAT_FUNC "%.0" "rpm" COEFFS 0 1 0 0 0 1 /end COMPU_METHOD
/begin CHARACTERISTIC MSP2_blkup_ont "Approach indication blink-on" VALUE 0x001CA024 /* @ECU_Address@MSP2_blkup_ont@0x01004758@ */ ECIPP_ALIGNMENT_UWORD 65535 Compu_MSP2_blkup_ont 0 65535 /end CHARACTERISTIC
/begin COMPU_METHOD Compu_MSP2_blkup_ont " " RAT_FUNC "%.0" "ms" COEFFS 0 1 0 0 0 1 /end COMPU_METHOD
/begin CHARACTERISTIC MSP2_blkup_offt "Approach indication blink-off" VALUE 0x001CA026 /* @ECU_Address@MSP2_blkup_offt@0x01004760@ */ ECIPP_ALIGNMENT_UWORD 65535 Compu_MSP2_blkup_offt 0 65535 /end CHARACTERISTIC
/begin COMPU_METHOD Compu_MSP2_blkup_offt " " RAT_FUNC "%.0" "ms" COEFFS 0 1 0 0 0 1 /end COMPU_METHOD
/begin CHARACTERISTIC MSP2_blkdn_ont "Fall-off indication blink-on" VALUE 0x001CA028 /* @ECU_Address@MSP2_blkdn_ont@0x01004768@ */ ECIPP_ALIGNMENT_UWORD 65535 Compu_MSP2_blkdn_ont 0 65535 /end CHARACTERISTIC
/begin COMPU_METHOD Compu_MSP2_blkdn_ont " " RAT_FUNC "%.0" "ms" COEFFS 0 1 0 0 0 1 /end COMPU_METHOD
/begin CHARACTERISTIC MSP2_blkdn_offt "Fall-off indication blink-off" VALUE 0x001CA02A /* @ECU_Address@MSP2_blkdn_offt@0x01004770@ */ ECIPP_ALIGNMENT_UWORD 65535 Compu_MSP2_blkdn_offt 0 65535 /end CHARACTERISTIC
/begin COMPU_METHOD Compu_MSP2_blkdn_offt " " RAT_FUNC "%.0" "ms" COEFFS 0 1 0 0 0 1 /end COMPU_METHOD
/begin CHARACTERISTIC MSP_app_lock_kph "Locked KPH tolerance" VALUE 0x001CA010 /* @ECU_Address@MSP_app_lock_kph@0x01004778@ */ ECIPP_ALIGNMENT_UWORD 256 Compu_MSP_app_lock_kph 0 255.99609375 /end CHARACTERISTIC
/begin COMPU_METHOD Compu_MSP_app_lock_kph " " RAT_FUNC "%.1" "kph" COEFFS 0 256 0 0 0 1 /end COMPU_METHOD
/begin CHARACTERISTIC MSP2_app_lock_kph "Locked KPH tolerance" VALUE 0x001CA022 /* @ECU_Address@MSP2_app_lock_kph@0x01004780@ */ ECIPP_ALIGNMENT_UWORD 256 Compu_MSP2_app_lock_kph 0 255.99609375 /end CHARACTERISTIC
/begin COMPU_METHOD Compu_MSP2_app_lock_kph " " RAT_FUNC "%.1" "kph" COEFFS 0 256 0 0 0 1 /end COMPU_METHOD
/begin CHARACTERISTIC cfgout_Vbatlon "and Batt Voltage is{cfgout_Vbatlon&0xff=0x00:Ignored}{cfgout_Vbatlon&0xff=0x01:<}{cfgout_Vbatlon&0xff=0x02:>}{cfgout_Vbatlon&0xff=0x03:<=}{cfgout_Vbatlon&0xff=0x04:>=}{cfgout_Vbatlon&0xff=0x05:=}{cfgout_Vbatlon&0xff=0x06:<>}" VALUE 0x001CA437 /* @ECU_Address@cfgout_Vbatlon@0x01004CB8@ */ ECIPP_ALIGNMENT_UBYTE 255 cfgout_Vbatlon_COMPU_VTAB 0 255 BIT_MASK 0xff /end CHARACTERISTIC
/begin COMPU_METHOD cfgout_Vbatlon_COMPU_VTAB "Verbal Table" TAB_VERB "%.0" "list" COMPU_TAB_REF cfgout_Vbatlon_COMPU_VTAB_REF /end COMPU_METHOD
/begin COMPU_VTAB cfgout_Vbatlon_COMPU_VTAB_REF "Verbal Table" TAB_VERB 7 0x00 "Ignored" 0x01 "<" 0x02 ">" 0x03 "<=" 0x04 ">=" 0x05 "=" 0x06 "<>" DEFAULT_VALUE "UNKNOWN" /end COMPU_VTAB
/begin CHARACTERISTIC cfgout_Vbatloff "and Batt Voltage is{cfgout_Vbatloff&0xff=0x00:Ignored}{cfgout_Vbatloff&0xff=0x01:<}{cfgout_Vbatloff&0xff=0x02:>}{cfgout_Vbatloff&0xff=0x03:<=}{cfgout_Vbatloff&0xff=0x04:>=}{cfgout_Vbatloff&0xff=0x05:=}{cfgout_Vbatloff&0xff=0x06:<>}" VALUE 0x001CA443 /* @ECU_Address@cfgout_Vbatloff@0x01004CC0@ */ ECIPP_ALIGNMENT_UBYTE 255 cfgout_Vbatloff_COMPU_VTAB 0 255 BIT_MASK 0xff /end CHARACTERISTIC
/begin COMPU_METHOD cfgout_Vbatloff_COMPU_VTAB "Verbal Table" TAB_VERB "%.0" "list" COMPU_TAB_REF cfgout_Vbatloff_COMPU_VTAB_REF /end COMPU_METHOD
/begin COMPU_VTAB cfgout_Vbatloff_COMPU_VTAB_REF "Verbal Table" TAB_VERB 7 0x00 "Ignored" 0x01 "<" 0x02 ">" 0x03 "<=" 0x04 ">=" 0x05 "=" 0x06 "<>" DEFAULT_VALUE "UNKNOWN" /end COMPU_VTAB
/begin CHARACTERISTIC cfgout2_Vbatlon "and Batt Voltage is{cfgout2_Vbatlon&0xff=0x00:Ignored}{cfgout2_Vbatlon&0xff=0x01:<}{cfgout2_Vbatlon&0xff=0x02:>}{cfgout2_Vbatlon&0xff=0x03:<=}{cfgout2_Vbatlon&0xff=0x04:>=}{cfgout2_Vbatlon&0xff=0x05:=}{cfgout2_Vbatlon&0xff=0x06:<>}" VALUE 0x001CA48F /* @ECU_Address@cfgout2_Vbatlon@0x01004CC8@ */ ECIPP_ALIGNMENT_UBYTE 255 cfgout2_Vbatlon_COMPU_VTAB 0 255 BIT_MASK 0xff /end CHARACTERISTIC
/begin COMPU_METHOD cfgout2_Vbatlon_COMPU_VTAB "Verbal Table" TAB_VERB "%.0" "list" COMPU_TAB_REF cfgout2_Vbatlon_COMPU_VTAB_REF /end COMPU_METHOD
/begin COMPU_VTAB cfgout2_Vbatlon_COMPU_VTAB_REF "Verbal Table" TAB_VERB 7 0x00 "Ignored" 0x01 "<" 0x02 ">" 0x03 "<=" 0x04 ">=" 0x05 "=" 0x06 "<>" DEFAULT_VALUE "UNKNOWN" /end COMPU_VTAB
/begin CHARACTERISTIC cfgout2_Vbatloff "and Batt Voltage is{cfgout2_Vbatloff&0xff=0x00:Ignored}{cfgout2_Vbatloff&0xff=0x01:<}{cfgout2_Vbatloff&0xff=0x02:>}{cfgout2_Vbatloff&0xff=0x03:<=}{cfgout2_Vbatloff&0xff=0x04:>=}{cfgout2_Vbatloff&0xff=0x05:=}{cfgout2_Vbatloff&0xff=0x06:<>}" VALUE 0x001CA49B /* @ECU_Address@cfgout2_Vbatloff@0x01004CD0@ */ ECIPP_ALIGNMENT_UBYTE 255 cfgout2_Vbatloff_COMPU_VTAB 0 255 BIT_MASK 0xff /end CHARACTERISTIC
/begin COMPU_METHOD cfgout2_Vbatloff_COMPU_VTAB "Verbal Table" TAB_VERB "%.0" "list" COMPU_TAB_REF cfgout2_Vbatloff_COMPU_VTAB_REF /end COMPU_METHOD
/begin COMPU_VTAB cfgout2_Vbatloff_COMPU_VTAB_REF "Verbal Table" TAB_VERB 7 0x00 "Ignored" 0x01 "<" 0x02 ">" 0x03 "<=" 0x04 ">=" 0x05 "=" 0x06 "<>" DEFAULT_VALUE "UNKNOWN" /end COMPU_VTAB
/begin CHARACTERISTIC cfgout3_Vbatlon "and Batt Voltage is{cfgout3_Vbatlon&0xff=0x00:Ignored}{cfgout3_Vbatlon&0xff=0x01:<}{cfgout3_Vbatlon&0xff=0x02:>}{cfgout3_Vbatlon&0xff=0x03:<=}{cfgout3_Vbatlon&0xff=0x04:>=}{cfgout3_Vbatlon&0xff=0x05:=}{cfgout3_Vbatlon&0xff=0x06:<>}" VALUE 0x001CA4E7 /* @ECU_Address@cfgout3_Vbatlon@0x01004CD8@ */ ECIPP_ALIGNMENT_UBYTE 255 cfgout3_Vbatlon_COMPU_VTAB 0 255 BIT_MASK 0xff /end CHARACTERISTIC
/begin COMPU_METHOD cfgout3_Vbatlon_COMPU_VTAB "Verbal Table" TAB_VERB "%.0" "list" COMPU_TAB_REF cfgout3_Vbatlon_COMPU_VTAB_REF /end COMPU_METHOD
/begin COMPU_VTAB cfgout3_Vbatlon_COMPU_VTAB_REF "Verbal Table" TAB_VERB 7 0x00 "Ignored" 0x01 "<" 0x02 ">" 0x03 "<=" 0x04 ">=" 0x05 "=" 0x06 "<>" DEFAULT_VALUE "UNKNOWN" /end COMPU_VTAB
/begin CHARACTERISTIC cfgout3_Vbatloff "and Batt Voltage is{cfgout3_Vbatloff&0xff=0x00:Ignored}{cfgout3_Vbatloff&0xff=0x01:<}{cfgout3_Vbatloff&0xff=0x02:>}{cfgout3_Vbatloff&0xff=0x03:<=}{cfgout3_Vbatloff&0xff=0x04:>=}{cfgout3_Vbatloff&0xff=0x05:=}{cfgout3_Vbatloff&0xff=0x06:<>}" VALUE 0x001CA4F3 /* @ECU_Address@cfgout3_Vbatloff@0x01004CE0@ */ ECIPP_ALIGNMENT_UBYTE 255 cfgout3_Vbatloff_COMPU_VTAB 0 255 BIT_MASK 0xff /end CHARACTERISTIC
/begin COMPU_METHOD cfgout3_Vbatloff_COMPU_VTAB "Verbal Table" TAB_VERB "%.0" "list" COMPU_TAB_REF cfgout3_Vbatloff_COMPU_VTAB_REF /end COMPU_METHOD
/begin COMPU_VTAB cfgout3_Vbatloff_COMPU_VTAB_REF "Verbal Table" TAB_VERB 7 0x00 "Ignored" 0x01 "<" 0x02 ">" 0x03 "<=" 0x04 ">=" 0x05 "=" 0x06 "<>" DEFAULT_VALUE "UNKNOWN" /end COMPU_VTAB
/begin CHARACTERISTIC cfgout_Vbaton "Vbat_on" VALUE 0x001CA456 /* @ECU_Address@cfgout_Vbaton@0x01004CE8@ */ ECIPP_ALIGNMENT_UWORD 256 Compu_cfgout_Vbaton 0 255.99609375 /end CHARACTERISTIC
/begin COMPU_METHOD Compu_cfgout_Vbaton " " RAT_FUNC "%.1" "volts" COEFFS 0 256 0 0 0 1 /end COMPU_METHOD
/begin CHARACTERISTIC cfgout_Vbatoff "Vbat_off" VALUE 0x001CA46E /* @ECU_Address@cfgout_Vbatoff@0x01004CF0@ */ ECIPP_ALIGNMENT_UWORD 256 Compu_cfgout_Vbatoff 0 255.99609375 /end CHARACTERISTIC
/begin COMPU_METHOD Compu_cfgout_Vbatoff " " RAT_FUNC "%.1" "volts" COEFFS 0 256 0 0 0 1 /end COMPU_METHOD
/begin CHARACTERISTIC cfgout2_Vbaton "Vbat_on" VALUE 0x001CA4AE /* @ECU_Address@cfgout2_Vbaton@0x01004CF8@ */ ECIPP_ALIGNMENT_UWORD 256 Compu_cfgout2_Vbaton 0 255.99609375 /end CHARACTERISTIC
/begin COMPU_METHOD Compu_cfgout2_Vbaton " " RAT_FUNC "%.1" "volts" COEFFS 0 256 0 0 0 1 /end COMPU_METHOD
/begin CHARACTERISTIC cfgout2_Vbatoff "Vbat_off" VALUE 0x001CA4C6 /* @ECU_Address@cfgout2_Vbatoff@0x01004D00@ */ ECIPP_ALIGNMENT_UWORD 256 Compu_cfgout2_Vbatoff 0 255.99609375 /end CHARACTERISTIC
/begin COMPU_METHOD Compu_cfgout2_Vbatoff " " RAT_FUNC "%.1" "volts" COEFFS 0 256 0 0 0 1 /end COMPU_METHOD
/begin CHARACTERISTIC cfgout3_Vbaton "Vbat_on" VALUE 0x001CA506 /* @ECU_Address@cfgout3_Vbaton@0x01004D08@ */ ECIPP_ALIGNMENT_UWORD 256 Compu_cfgout3_Vbaton 0 255.99609375 /end CHARACTERISTIC
/begin COMPU_METHOD Compu_cfgout3_Vbaton " " RAT_FUNC "%.1" "volts" COEFFS 0 256 0 0 0 1 /end COMPU_METHOD
/begin CHARACTERISTIC cfgout3_Vbatoff "Vbat_off" VALUE 0x001CA51E /* @ECU_Address@cfgout3_Vbatoff@0x01004D10@ */ ECIPP_ALIGNMENT_UWORD 256 Compu_cfgout3_Vbatoff 0 255.99609375 /end CHARACTERISTIC
/begin COMPU_METHOD Compu_cfgout3_Vbatoff " " RAT_FUNC "%.1" "volts" COEFFS 0 256 0 0 0 1 /end COMPU_METHOD
/begin MEASUREMENT run_mode_latch "Latched run mode{run_mode_latch&0xff=0x00:Stopped}{run_mode_latch&0xff=0x01:Cranking}{run_mode_latch&0xff=0x02:Underspeed}{run_mode_latch&0xff=0x03:Running}{run_mode_latch&0xff=0x04:Running (latched)}" UBYTE run_mode_latch_COMPU_VTAB 0 0 0 255 ECU_ADDRESS 0x01004DB0 BIT_MASK 0xff /end MEASUREMENT
/begin COMPU_METHOD run_mode_latch_COMPU_VTAB "Verbal Table" TAB_VERB "%.0" "list" COMPU_TAB_REF run_mode_latch_COMPU_VTAB_REF /end COMPU_METHOD
/begin COMPU_VTAB run_mode_latch_COMPU_VTAB_REF "Verbal Table" TAB_VERB 5 0x00 "Stopped" 0x01 "Cranking" 0x02 "Underspeed" 0x03 "Running" 0x04 "Running (latched)" DEFAULT_VALUE "UNKNOWN" /end COMPU_VTAB
/begin CHARACTERISTIC run_latch_wait "Engine running latch time" VALUE 0x001c4414 /* @ECU_Address@run_latch_wait@0x01004DB8@ */ ECIPP_ALIGNMENT_ULONG 4294967 Compu_run_latch_wait 0 4294967.295 /end CHARACTERISTIC
/begin COMPU_METHOD Compu_run_latch_wait " " RAT_FUNC "%.1" "sec" COEFFS 0 1000 0 0 0 1 /end COMPU_METHOD
/begin CHARACTERISTIC stop_latch_wait "Engine stopped latch time" VALUE 0x001c4418 /* @ECU_Address@stop_latch_wait@0x01004DC0@ */ ECIPP_ALIGNMENT_ULONG 4294967 Compu_stop_latch_wait 0 4294967.295 /end CHARACTERISTIC
/begin COMPU_METHOD Compu_stop_latch_wait " " RAT_FUNC "%.1" "sec" COEFFS 0 1000 0 0 0 1 /end COMPU_METHOD
/begin CHARACTERISTIC crank_SD_latch "Auto-crank shutdown latch{crank_SD_latch&0xff=0:Disabled}{crank_SD_latch&0xff=1:Enabled}" VALUE 0x001c8fdb /* @ECU_Address@crank_SD_latch@0x01004DC8@ */ ECIPP_ALIGNMENT_UBYTE 255 crank_SD_latch_COMPU_VTAB 0 255 BIT_MASK 0xff /end CHARACTERISTIC
/begin COMPU_METHOD crank_SD_latch_COMPU_VTAB "Verbal Table" TAB_VERB "%.0" "list" COMPU_TAB_REF crank_SD_latch_COMPU_VTAB_REF /end COMPU_METHOD
/begin COMPU_VTAB crank_SD_latch_COMPU_VTAB_REF "Verbal Table" TAB_VERB 2 0 "Disabled" 1 "Enabled" DEFAULT_VALUE "UNKNOWN" /end COMPU_VTAB
/begin CHARACTERISTIC drivebrake_mode "Driveline brake mode{drivebrake_mode&0xff=0:Disabled}{drivebrake_mode&0xff=1:Compression Brake}{drivebrake_mode&0xff=2:Transmission Retarder}" VALUE 0x001c8ff7 /* @ECU_Address@drivebrake_mode@0x01005578@ */ ECIPP_ALIGNMENT_UBYTE 255 drivebrake_mode_COMPU_VTAB 0 255 BIT_MASK 0xff /end CHARACTERISTIC
/begin COMPU_METHOD drivebrake_mode_COMPU_VTAB "Verbal Table" TAB_VERB "%.0" "list" COMPU_TAB_REF drivebrake_mode_COMPU_VTAB_REF /end COMPU_METHOD
/begin COMPU_VTAB drivebrake_mode_COMPU_VTAB_REF "Verbal Table" TAB_VERB 3 0 "Disabled" 1 "Compression Brake" 2 "Transmission Retarder" DEFAULT_VALUE "UNKNOWN" /end COMPU_VTAB
/begin CHARACTERISTIC drivebrake_chan "Driveline brake output channel{drivebrake_chan&0xff=0:Aux PWM1}{drivebrake_chan&0xff=1:Aux PWM2}{drivebrake_chan&0xff=2:Aux PWM3}{drivebrake_chan&0xff=3:Aux PWM4}{drivebrake_chan&0xff=4:Aux PWM5}{drivebrake_chan&0xff=5:Aux PWM6}{drivebrake_chan&0xff=6:Aux" VALUE 0x001c8ff6 /* @ECU_Address@drivebrake_chan@0x01005580@ */ ECIPP_ALIGNMENT_UBYTE 255 drivebrake_chan_COMPU_VTAB 0 255 BIT_MASK 0xff /end CHARACTERISTIC
/begin COMPU_METHOD drivebrake_chan_COMPU_VTAB "Verbal Table" TAB_VERB "%.0" "list" COMPU_TAB_REF drivebrake_chan_COMPU_VTAB_REF /end COMPU_METHOD
/begin COMPU_VTAB drivebrake_chan_COMPU_VTAB_REF "Verbal Table" TAB_VERB 8 0 "Aux PWM1" 1 "Aux PWM2" 2 "Aux PWM3" 3 "Aux PWM4" 4 "Aux PWM5" 5 "Aux PWM6" 6 "Aux PWM7" 7 "Aux PWM8" DEFAULT_VALUE "UNKNOWN" /end COMPU_VTAB
/begin CHARACTERISTIC crank_trans_neut "Trans in-gear override{crank_trans_neut&0xff=0:Disabled}{crank_trans_neut&0xff=1:J1939 ETC2}{crank_trans_neut&0xff=2:Starter Output Feedback}{crank_trans_neut&0xff=3:Park/Neut Switch}{crank_trans_neut&0xff=4:Park/Neut or Clutch Switch}{crank_trans_neut&0x" VALUE 0x001c8fdf /* @ECU_Address@crank_trans_neut@0x01005638@ */ ECIPP_ALIGNMENT_UBYTE 255 crank_trans_neut_COMPU_VTAB 0 255 BIT_MASK 0xff /end CHARACTERISTIC
/begin COMPU_METHOD crank_trans_neut_COMPU_VTAB "Verbal Table" TAB_VERB "%.0" "list" COMPU_TAB_REF crank_trans_neut_COMPU_VTAB_REF /end COMPU_METHOD
/begin COMPU_VTAB crank_trans_neut_COMPU_VTAB_REF "Verbal Table" TAB_VERB 8 0 "Disabled" 1 "J1939 ETC2" 2 "Starter Output Feedback" 3 "Park/Neut Switch" 4 "Park/Neut or Clutch Switch" 5 "Park/Neut or Clutch Switch and ETC7" 6 "Park/Neut w/ FPP=0 or MHGL Active" 7 "Park/Neut Switch and ETC7 Required" DEFAULT_VALUE "UNKNOWN" /end COMPU_VTAB
/begin CHARACTERISTIC SWARNblk_open_on "Soft warning open blink/pulse on-time" VALUE 0x001c8ef4 /* @ECU_Address@SWARNblk_open_on@0x01005770@ */ ECIPP_ALIGNMENT_UBYTE 12750 Compu_SWARNblk_open_on 0 12750 /end CHARACTERISTIC
/begin COMPU_METHOD Compu_SWARNblk_open_on " " RAT_FUNC "%.0" "ms" COEFFS 0 0.02 0 0 0 1 /end COMPU_METHOD
/begin CHARACTERISTIC SWARNblk_open_off "Soft warning open blink/pulse off-time" VALUE 0x001c7fc8 /* @ECU_Address@SWARNblk_open_off@0x01005778@ */ ECIPP_ALIGNMENT_UWORD 3276750 Compu_SWARNblk_open_off 0 3276750 /end CHARACTERISTIC
/begin COMPU_METHOD Compu_SWARNblk_open_off " " RAT_FUNC "%.0" "ms" COEFFS 0 0.02 0 0 0 1 /end COMPU_METHOD
/begin CHARACTERISTIC HWARNblk_open_on "Hard warning open blink/pulse on-time" VALUE 0x001c8765 /* @ECU_Address@HWARNblk_open_on@0x01005780@ */ ECIPP_ALIGNMENT_UBYTE 12750 Compu_HWARNblk_open_on 0 12750 /end CHARACTERISTIC
/begin COMPU_METHOD Compu_HWARNblk_open_on " " RAT_FUNC "%.0" "ms" COEFFS 0 0.02 0 0 0 1 /end COMPU_METHOD
/begin CHARACTERISTIC HWARNblk_open_off "Hard warning open blink/pulse off-time" VALUE 0x001c7be6 /* @ECU_Address@HWARNblk_open_off@0x01005788@ */ ECIPP_ALIGNMENT_UWORD 3276750 Compu_HWARNblk_open_off 0 3276750 /end CHARACTERISTIC
/begin COMPU_METHOD Compu_HWARNblk_open_off " " RAT_FUNC "%.0" "ms" COEFFS 0 0.02 0 0 0 1 /end COMPU_METHOD
/begin CHARACTERISTIC MILblk_open_on "MIL open blink/pulse on-time" VALUE 0x001c8834 /* @ECU_Address@MILblk_open_on@0x01005790@ */ ECIPP_ALIGNMENT_UBYTE 12750 Compu_MILblk_open_on 0 12750 /end CHARACTERISTIC
/begin COMPU_METHOD Compu_MILblk_open_on " " RAT_FUNC "%.0" "ms" COEFFS 0 0.02 0 0 0 1 /end COMPU_METHOD
/begin CHARACTERISTIC MILblk_open_off "MIL open blink/pulse off-time" VALUE 0x001c7da2 /* @ECU_Address@MILblk_open_off@0x01005798@ */ ECIPP_ALIGNMENT_UWORD 3276750 Compu_MILblk_open_off 0 3276750 /end CHARACTERISTIC
/begin COMPU_METHOD Compu_MILblk_open_off " " RAT_FUNC "%.0" "ms" COEFFS 0 0.02 0 0 0 1 /end COMPU_METHOD
/begin CHARACTERISTIC MILblk_open_ini "MIL open blink/pulse initial time" VALUE 0x001c8833 /* @ECU_Address@MILblk_open_ini@0x010057A0@ */ ECIPP_ALIGNMENT_UBYTE 12750 Compu_MILblk_open_ini 0 12750 /end CHARACTERISTIC
/begin COMPU_METHOD Compu_MILblk_open_ini " " RAT_FUNC "%.0" "ms" COEFFS 0 0.02 0 0 0 1 /end COMPU_METHOD
/begin CHARACTERISTIC SWARNchan_open "Soft warning open-output transfer{SWARNchan_open&0xff=0:Disabled}{SWARNchan_open&0xff=1:Hard warning}" VALUE 0x001c8ef5 /* @ECU_Address@SWARNchan_open@0x010057A8@ */ ECIPP_ALIGNMENT_UBYTE 255 SWARNchan_open_COMPU_VTAB 0 255 BIT_MASK 0xff /end CHARACTERISTIC
/begin COMPU_METHOD SWARNchan_open_COMPU_VTAB "Verbal Table" TAB_VERB "%.0" "list" COMPU_TAB_REF SWARNchan_open_COMPU_VTAB_REF /end COMPU_METHOD
/begin COMPU_VTAB SWARNchan_open_COMPU_VTAB_REF "Verbal Table" TAB_VERB 2 0 "Disabled" 1 "Hard warning" DEFAULT_VALUE "UNKNOWN" /end COMPU_VTAB
/begin CHARACTERISTIC HWARNchan_open "Hard warning open-output transfer{HWARNchan_open&0xff=0:Disabled}{HWARNchan_open&0xff=1:Soft warning}" VALUE 0x001c8766 /* @ECU_Address@HWARNchan_open@0x010057B0@ */ ECIPP_ALIGNMENT_UBYTE 255 HWARNchan_open_COMPU_VTAB 0 255 BIT_MASK 0xff /end CHARACTERISTIC
/begin COMPU_METHOD HWARNchan_open_COMPU_VTAB "Verbal Table" TAB_VERB "%.0" "list" COMPU_TAB_REF HWARNchan_open_COMPU_VTAB_REF /end COMPU_METHOD
/begin COMPU_VTAB HWARNchan_open_COMPU_VTAB_REF "Verbal Table" TAB_VERB 2 0 "Disabled" 1 "Soft warning" DEFAULT_VALUE "UNKNOWN" /end COMPU_VTAB
/begin CHARACTERISTIC MILchan_open "MIL open-output transfer{MILchan_open&0xff=0:Disabled}{MILchan_open&0xff=1:Soft warning}{MILchan_open&0xff=2:Hard warning}" VALUE 0x001c8835 /* @ECU_Address@MILchan_open@0x010057B8@ */ ECIPP_ALIGNMENT_UBYTE 255 MILchan_open_COMPU_VTAB 0 255 BIT_MASK 0xff /end CHARACTERISTIC
/begin COMPU_METHOD MILchan_open_COMPU_VTAB "Verbal Table" TAB_VERB "%.0" "list" COMPU_TAB_REF MILchan_open_COMPU_VTAB_REF /end COMPU_METHOD
/begin COMPU_VTAB MILchan_open_COMPU_VTAB_REF "Verbal Table" TAB_VERB 3 0 "Disabled" 1 "Soft warning" 2 "Hard warning" DEFAULT_VALUE "UNKNOWN" /end COMPU_VTAB
/begin MEASUREMENT SWARNfcn "Soft warning function{SWARNfcn&0xff=0:Disconnected}{SWARNfcn&0xff=1:Idle off}{SWARNfcn&0xff=2:MIL}{SWARNfcn&0xff=3:Hard warning}{SWARNfcn&0xff=4:Soft warning}{SWARNfcn&0xff=5:Audible alert}" UBYTE SWARNfcn_COMPU_VTAB 0 0 0 255 ECU_ADDRESS 0x010057C0 BIT_MASK 0xff /end MEASUREMENT
/begin COMPU_METHOD SWARNfcn_COMPU_VTAB "Verbal Table" TAB_VERB "%.0" "list" COMPU_TAB_REF SWARNfcn_COMPU_VTAB_REF /end COMPU_METHOD
/begin COMPU_VTAB SWARNfcn_COMPU_VTAB_REF "Verbal Table" TAB_VERB 6 0 "Disconnected" 1 "Idle off" 2 "MIL" 3 "Hard warning" 4 "Soft warning" 5 "Audible alert" DEFAULT_VALUE "UNKNOWN" /end COMPU_VTAB
/begin MEASUREMENT HWARNfcn "Hard warning function{HWARNfcn&0xff=0:Disconnected}{HWARNfcn&0xff=1:Idle off}{HWARNfcn&0xff=2:MIL}{HWARNfcn&0xff=3:Hard warning}{HWARNfcn&0xff=4:Soft warning}{HWARNfcn&0xff=5:Audible alert}" UBYTE HWARNfcn_COMPU_VTAB 0 0 0 255 ECU_ADDRESS 0x010057C8 BIT_MASK 0xff /end MEASUREMENT
/begin COMPU_METHOD HWARNfcn_COMPU_VTAB "Verbal Table" TAB_VERB "%.0" "list" COMPU_TAB_REF HWARNfcn_COMPU_VTAB_REF /end COMPU_METHOD
/begin COMPU_VTAB HWARNfcn_COMPU_VTAB_REF "Verbal Table" TAB_VERB 6 0 "Disconnected" 1 "Idle off" 2 "MIL" 3 "Hard warning" 4 "Soft warning" 5 "Audible alert" DEFAULT_VALUE "UNKNOWN" /end COMPU_VTAB
/begin CHARACTERISTIC WARN_engstop "Hard/soft warn key-on/eng stop{WARN_engstop&0xff=0:On for bulb-check}{WARN_engstop&0xff=1:On for bulb-check + soft/hard}{WARN_engstop&0xff=2:On for bulb-check + soft only}{WARN_engstop&0xff=3:On for bulb-check + hard only}" VALUE 0x001c8f91 /* @ECU_Address@WARN_engstop@0x01005870@ */ ECIPP_ALIGNMENT_UBYTE 255 WARN_engstop_COMPU_VTAB 0 255 BIT_MASK 0xff /end CHARACTERISTIC
/begin COMPU_METHOD WARN_engstop_COMPU_VTAB "Verbal Table" TAB_VERB "%.0" "list" COMPU_TAB_REF WARN_engstop_COMPU_VTAB_REF /end COMPU_METHOD
/begin COMPU_VTAB WARN_engstop_COMPU_VTAB_REF "Verbal Table" TAB_VERB 4 0 "On for bulb-check" 1 "On for bulb-check + soft/hard" 2 "On for bulb-check + soft only" 3 "On for bulb-check + hard only" DEFAULT_VALUE "UNKNOWN" /end COMPU_VTAB
/begin CHARACTERISTIC AWARN_ena "Audible alert: new warning{AWARN_ena&0xff=0:Disabled}{AWARN_ena&0xff=1:MIL}{AWARN_ena&0xff=2:Non-audible warn}{AWARN_ena&0xff=3:MIL + non-audible warn}" VALUE 0x001c8680 /* @ECU_Address@AWARN_ena@0x010059E0@ */ ECIPP_ALIGNMENT_UBYTE 255 AWARN_ena_COMPU_VTAB 0 255 BIT_MASK 0xff /end CHARACTERISTIC
/begin COMPU_METHOD AWARN_ena_COMPU_VTAB "Verbal Table" TAB_VERB "%.0" "list" COMPU_TAB_REF AWARN_ena_COMPU_VTAB_REF /end COMPU_METHOD
/begin COMPU_VTAB AWARN_ena_COMPU_VTAB_REF "Verbal Table" TAB_VERB 4 0 "Disabled" 1 "MIL" 2 "Non-audible warn" 3 "MIL + non-audible warn" DEFAULT_VALUE "UNKNOWN" /end COMPU_VTAB
/begin CHARACTERISTIC AWARN_chan "Audible output{AWARN_chan&0xff=0:Soft warning}{AWARN_chan&0xff=1:Hard warning}" VALUE 0x001c867f /* @ECU_Address@AWARN_chan@0x010059E8@ */ ECIPP_ALIGNMENT_UBYTE 255 AWARN_chan_COMPU_VTAB 0 255 BIT_MASK 0xff /end CHARACTERISTIC
/begin COMPU_METHOD AWARN_chan_COMPU_VTAB "Verbal Table" TAB_VERB "%.0" "list" COMPU_TAB_REF AWARN_chan_COMPU_VTAB_REF /end COMPU_METHOD
/begin COMPU_VTAB AWARN_chan_COMPU_VTAB_REF "Verbal Table" TAB_VERB 2 0 "Soft warning" 1 "Hard warning" DEFAULT_VALUE "UNKNOWN" /end COMPU_VTAB
/begin CHARACTERISTIC AWARNblk_ini "Audible alert initial blink" VALUE 0x001c8681 /* @ECU_Address@AWARNblk_ini@0x010059F0@ */ ECIPP_ALIGNMENT_UBYTE 12750 Compu_AWARNblk_ini 0 12750 /end CHARACTERISTIC
/begin COMPU_METHOD Compu_AWARNblk_ini " " RAT_FUNC "%.0" "ms" COEFFS 0 0.02 0 0 0 1 /end COMPU_METHOD
/begin CHARACTERISTIC AWARNblk_on "Audible alert blink on-time" VALUE 0x001c8683 /* @ECU_Address@AWARNblk_on@0x010059F8@ */ ECIPP_ALIGNMENT_UBYTE 12750 Compu_AWARNblk_on 0 12750 /end CHARACTERISTIC
/begin COMPU_METHOD Compu_AWARNblk_on " " RAT_FUNC "%.0" "ms" COEFFS 0 0.02 0 0 0 1 /end COMPU_METHOD
/begin CHARACTERISTIC AWARNblk_off "Audible alert blink off-time" VALUE 0x001c8682 /* @ECU_Address@AWARNblk_off@0x01005A00@ */ ECIPP_ALIGNMENT_UBYTE 12750 Compu_AWARNblk_off 0 12750 /end CHARACTERISTIC
/begin COMPU_METHOD Compu_AWARNblk_off " " RAT_FUNC "%.0" "ms" COEFFS 0 0.02 0 0 0 1 /end COMPU_METHOD
/begin CHARACTERISTIC AWARNblk_reps "Audible alert on/off repeats" VALUE 0x001c8684 /* @ECU_Address@AWARNblk_reps@0x01005A08@ */ ECIPP_ALIGNMENT_UBYTE 255 Compu_AWARNblk_reps 0 255 /end CHARACTERISTIC
/begin COMPU_METHOD Compu_AWARNblk_reps " " RAT_FUNC "%.0" "-" COEFFS 0 1 0 0 0 1 /end COMPU_METHOD
/begin CHARACTERISTIC cfgout_andor_on "AND/OR logic{cfgout_andor_on&0xff=0:AND}{cfgout_andor_on&0xff=1:OR}" VALUE 0x001CA428 /* @ECU_Address@cfgout_andor_on@0x01005BB8@ */ ECIPP_ALIGNMENT_UBYTE 255 cfgout_andor_on_COMPU_VTAB 0 255 BIT_MASK 0xff /end CHARACTERISTIC
/begin COMPU_METHOD cfgout_andor_on_COMPU_VTAB "Verbal Table" TAB_VERB "%.0" "list" COMPU_TAB_REF cfgout_andor_on_COMPU_VTAB_REF /end COMPU_METHOD
/begin COMPU_VTAB cfgout_andor_on_COMPU_VTAB_REF "Verbal Table" TAB_VERB 2 0 "AND" 1 "OR" DEFAULT_VALUE "UNKNOWN" /end COMPU_VTAB
/begin CHARACTERISTIC cfgout_andor_off "AND/OR logic{cfgout_andor_off&0xff=0:AND}{cfgout_andor_off&0xff=1:OR}" VALUE 0x001CA429 /* @ECU_Address@cfgout_andor_off@0x01005BC0@ */ ECIPP_ALIGNMENT_UBYTE 255 cfgout_andor_off_COMPU_VTAB 0 255 BIT_MASK 0xff /end CHARACTERISTIC
/begin COMPU_METHOD cfgout_andor_off_COMPU_VTAB "Verbal Table" TAB_VERB "%.0" "list" COMPU_TAB_REF cfgout_andor_off_COMPU_VTAB_REF /end COMPU_METHOD
/begin COMPU_VTAB cfgout_andor_off_COMPU_VTAB_REF "Verbal Table" TAB_VERB 2 0 "AND" 1 "OR" DEFAULT_VALUE "UNKNOWN" /end COMPU_VTAB
/begin CHARACTERISTIC cfgout2_andor_on "AND/OR logic{cfgout2_andor_on&0xff=0:AND}{cfgout2_andor_on&0xff=1:OR}" VALUE 0x001CA480 /* @ECU_Address@cfgout2_andor_on@0x01005BC8@ */ ECIPP_ALIGNMENT_UBYTE 255 cfgout2_andor_on_COMPU_VTAB 0 255 BIT_MASK 0xff /end CHARACTERISTIC
/begin COMPU_METHOD cfgout2_andor_on_COMPU_VTAB "Verbal Table" TAB_VERB "%.0" "list" COMPU_TAB_REF cfgout2_andor_on_COMPU_VTAB_REF /end COMPU_METHOD
/begin COMPU_VTAB cfgout2_andor_on_COMPU_VTAB_REF "Verbal Table" TAB_VERB 2 0 "AND" 1 "OR" DEFAULT_VALUE "UNKNOWN" /end COMPU_VTAB
/begin CHARACTERISTIC cfgout2_andor_off "AND/OR logic{cfgout2_andor_off&0xff=0:AND}{cfgout2_andor_off&0xff=1:OR}" VALUE 0x001CA481 /* @ECU_Address@cfgout2_andor_off@0x01005BD0@ */ ECIPP_ALIGNMENT_UBYTE 255 cfgout2_andor_off_COMPU_VTAB 0 255 BIT_MASK 0xff /end CHARACTERISTIC
/begin COMPU_METHOD cfgout2_andor_off_COMPU_VTAB "Verbal Table" TAB_VERB "%.0" "list" COMPU_TAB_REF cfgout2_andor_off_COMPU_VTAB_REF /end COMPU_METHOD
/begin COMPU_VTAB cfgout2_andor_off_COMPU_VTAB_REF "Verbal Table" TAB_VERB 2 0 "AND" 1 "OR" DEFAULT_VALUE "UNKNOWN" /end COMPU_VTAB
/begin CHARACTERISTIC cfgout3_andor_on "AND/OR logic{cfgout3_andor_on&0xff=0:AND}{cfgout3_andor_on&0xff=1:OR}" VALUE 0x001CA4D8 /* @ECU_Address@cfgout3_andor_on@0x01005BD8@ */ ECIPP_ALIGNMENT_UBYTE 255 cfgout3_andor_on_COMPU_VTAB 0 255 BIT_MASK 0xff /end CHARACTERISTIC
/begin COMPU_METHOD cfgout3_andor_on_COMPU_VTAB "Verbal Table" TAB_VERB "%.0" "list" COMPU_TAB_REF cfgout3_andor_on_COMPU_VTAB_REF /end COMPU_METHOD
/begin COMPU_VTAB cfgout3_andor_on_COMPU_VTAB_REF "Verbal Table" TAB_VERB 2 0 "AND" 1 "OR" DEFAULT_VALUE "UNKNOWN" /end COMPU_VTAB
/begin CHARACTERISTIC cfgout3_andor_off "AND/OR logic{cfgout3_andor_off&0xff=0:AND}{cfgout3_andor_off&0xff=1:OR}" VALUE 0x001CA4D9 /* @ECU_Address@cfgout3_andor_off@0x01005BE0@ */ ECIPP_ALIGNMENT_UBYTE 255 cfgout3_andor_off_COMPU_VTAB 0 255 BIT_MASK 0xff /end CHARACTERISTIC
/begin COMPU_METHOD cfgout3_andor_off_COMPU_VTAB "Verbal Table" TAB_VERB "%.0" "list" COMPU_TAB_REF cfgout3_andor_off_COMPU_VTAB_REF /end COMPU_METHOD
/begin COMPU_VTAB cfgout3_andor_off_COMPU_VTAB_REF "Verbal Table" TAB_VERB 2 0 "AND" 1 "OR" DEFAULT_VALUE "UNKNOWN" /end COMPU_VTAB
/begin CHARACTERISTIC cfgout_CLlon "and/or CL is{cfgout_CLlon&0xff=0x00:Ignored}{cfgout_CLlon&0xff=0x01:<}{cfgout_CLlon&0xff=0x02:>}{cfgout_CLlon&0xff=0x03:<=}{cfgout_CLlon&0xff=0x04:>=}{cfgout_CLlon&0xff=0x05:=}{cfgout_CLlon&0xff=0x06:<>}" VALUE 0x001CA438 /* @ECU_Address@cfgout_CLlon@0x01005BE8@ */ ECIPP_ALIGNMENT_UBYTE 255 cfgout_CLlon_COMPU_VTAB 0 255 BIT_MASK 0xff /end CHARACTERISTIC
/begin COMPU_METHOD cfgout_CLlon_COMPU_VTAB "Verbal Table" TAB_VERB "%.0" "list" COMPU_TAB_REF cfgout_CLlon_COMPU_VTAB_REF /end COMPU_METHOD
/begin COMPU_VTAB cfgout_CLlon_COMPU_VTAB_REF "Verbal Table" TAB_VERB 7 0x00 "Ignored" 0x01 "<" 0x02 ">" 0x03 "<=" 0x04 ">=" 0x05 "=" 0x06 "<>" DEFAULT_VALUE "UNKNOWN" /end COMPU_VTAB
/begin CHARACTERISTIC cfgout_CLloff "and/or CL is{cfgout_CLloff&0xff=0x00:Ignored}{cfgout_CLloff&0xff=0x01:<}{cfgout_CLloff&0xff=0x02:>}{cfgout_CLloff&0xff=0x03:<=}{cfgout_CLloff&0xff=0x04:>=}{cfgout_CLloff&0xff=0x05:=}{cfgout_CLloff&0xff=0x06:<>}" VALUE 0x001CA444 /* @ECU_Address@cfgout_CLloff@0x01005BF0@ */ ECIPP_ALIGNMENT_UBYTE 255 cfgout_CLloff_COMPU_VTAB 0 255 BIT_MASK 0xff /end CHARACTERISTIC
/begin COMPU_METHOD cfgout_CLloff_COMPU_VTAB "Verbal Table" TAB_VERB "%.0" "list" COMPU_TAB_REF cfgout_CLloff_COMPU_VTAB_REF /end COMPU_METHOD
/begin COMPU_VTAB cfgout_CLloff_COMPU_VTAB_REF "Verbal Table" TAB_VERB 7 0x00 "Ignored" 0x01 "<" 0x02 ">" 0x03 "<=" 0x04 ">=" 0x05 "=" 0x06 "<>" DEFAULT_VALUE "UNKNOWN" /end COMPU_VTAB
/begin CHARACTERISTIC cfgout_CLon "CL status is{cfgout_CLon&0xff=0:CL not supported}{cfgout_CLon&0xff=1:OL: system conditions}{cfgout_CLon&0xff=2:OL: driving conditions}{cfgout_CLon&0xff=3:OL: fault}{cfgout_CLon&0xff=4:CL active}{cfgout_CLon&0xff=5:CL + adapt active}" VALUE 0x001CA458 /* @ECU_Address@cfgout_CLon@0x01005BF8@ */ ECIPP_ALIGNMENT_UWORD 65535 cfgout_CLon_COMPU_VTAB 0 65535 BIT_MASK 0xff /end CHARACTERISTIC
/begin COMPU_METHOD cfgout_CLon_COMPU_VTAB "Verbal Table" TAB_VERB "%.0" "list" COMPU_TAB_REF cfgout_CLon_COMPU_VTAB_REF /end COMPU_METHOD
/begin COMPU_VTAB cfgout_CLon_COMPU_VTAB_REF "Verbal Table" TAB_VERB 6 0 "CL not supported" 1 "OL: system conditions" 2 "OL: driving conditions" 3 "OL: fault" 4 "CL active" 5 "CL + adapt active" DEFAULT_VALUE "UNKNOWN" /end COMPU_VTAB
/begin CHARACTERISTIC cfgout_CLoff "CL status is{cfgout_CLoff&0xff=0:CL not supported}{cfgout_CLoff&0xff=1:OL: system conditions}{cfgout_CLoff&0xff=2:OL: driving conditions}{cfgout_CLoff&0xff=3:OL: fault}{cfgout_CLoff&0xff=4:CL active}{cfgout_CLoff&0xff=5:CL + adapt active}" VALUE 0x001CA470 /* @ECU_Address@cfgout_CLoff@0x01005C00@ */ ECIPP_ALIGNMENT_UWORD 65535 cfgout_CLoff_COMPU_VTAB 0 65535 BIT_MASK 0xff /end CHARACTERISTIC
/begin COMPU_METHOD cfgout_CLoff_COMPU_VTAB "Verbal Table" TAB_VERB "%.0" "list" COMPU_TAB_REF cfgout_CLoff_COMPU_VTAB_REF /end COMPU_METHOD
/begin COMPU_VTAB cfgout_CLoff_COMPU_VTAB_REF "Verbal Table" TAB_VERB 6 0 "CL not supported" 1 "OL: system conditions" 2 "OL: driving conditions" 3 "OL: fault" 4 "CL active" 5 "CL + adapt active" DEFAULT_VALUE "UNKNOWN" /end COMPU_VTAB
/begin CHARACTERISTIC cfgout_MILlon "and/or MIL is{cfgout_MILlon&0xff=0x00:Ignored}{cfgout_MILlon&0xff=0x01:<}{cfgout_MILlon&0xff=0x02:>}{cfgout_MILlon&0xff=0x03:<=}{cfgout_MILlon&0xff=0x04:>=}{cfgout_MILlon&0xff=0x05:=}{cfgout_MILlon&0xff=0x06:<>}" VALUE 0x001CA439 /* @ECU_Address@cfgout_MILlon@0x01005C08@ */ ECIPP_ALIGNMENT_UBYTE 255 cfgout_MILlon_COMPU_VTAB 0 255 BIT_MASK 0xff /end CHARACTERISTIC
/begin COMPU_METHOD cfgout_MILlon_COMPU_VTAB "Verbal Table" TAB_VERB "%.0" "list" COMPU_TAB_REF cfgout_MILlon_COMPU_VTAB_REF /end COMPU_METHOD
/begin COMPU_VTAB cfgout_MILlon_COMPU_VTAB_REF "Verbal Table" TAB_VERB 7 0x00 "Ignored" 0x01 "<" 0x02 ">" 0x03 "<=" 0x04 ">=" 0x05 "=" 0x06 "<>" DEFAULT_VALUE "UNKNOWN" /end COMPU_VTAB
/begin CHARACTERISTIC cfgout_MILloff "and/or MIL is{cfgout_MILloff&0xff=0x00:Ignored}{cfgout_MILloff&0xff=0x01:<}{cfgout_MILloff&0xff=0x02:>}{cfgout_MILloff&0xff=0x03:<=}{cfgout_MILloff&0xff=0x04:>=}{cfgout_MILloff&0xff=0x05:=}{cfgout_MILloff&0xff=0x06:<>}" VALUE 0x001CA445 /* @ECU_Address@cfgout_MILloff@0x01005C10@ */ ECIPP_ALIGNMENT_UBYTE 255 cfgout_MILloff_COMPU_VTAB 0 255 BIT_MASK 0xff /end CHARACTERISTIC
/begin COMPU_METHOD cfgout_MILloff_COMPU_VTAB "Verbal Table" TAB_VERB "%.0" "list" COMPU_TAB_REF cfgout_MILloff_COMPU_VTAB_REF /end COMPU_METHOD
/begin COMPU_VTAB cfgout_MILloff_COMPU_VTAB_REF "Verbal Table" TAB_VERB 7 0x00 "Ignored" 0x01 "<" 0x02 ">" 0x03 "<=" 0x04 ">=" 0x05 "=" 0x06 "<>" DEFAULT_VALUE "UNKNOWN" /end COMPU_VTAB
/begin CHARACTERISTIC cfgout_MILon "MIL status is{cfgout_MILon&0xff=0:Off}{cfgout_MILon&0xff=1:On: Bulb check}{cfgout_MILon&0xff=2:On: MIL persistence}{cfgout_MILon&0xff=3:On: Active fault}" VALUE 0x001CA45A /* @ECU_Address@cfgout_MILon@0x01005C18@ */ ECIPP_ALIGNMENT_UWORD 65535 cfgout_MILon_COMPU_VTAB 0 65535 BIT_MASK 0xff /end CHARACTERISTIC
/begin COMPU_METHOD cfgout_MILon_COMPU_VTAB "Verbal Table" TAB_VERB "%.0" "list" COMPU_TAB_REF cfgout_MILon_COMPU_VTAB_REF /end COMPU_METHOD
/begin COMPU_VTAB cfgout_MILon_COMPU_VTAB_REF "Verbal Table" TAB_VERB 4 0 "Off" 1 "On: Bulb check" 2 "On: MIL persistence" 3 "On: Active fault" DEFAULT_VALUE "UNKNOWN" /end COMPU_VTAB
/begin CHARACTERISTIC cfgout_MILoff "MIL status is{cfgout_MILoff&0xff=0:Off}{cfgout_MILoff&0xff=1:On: Bulb check}{cfgout_MILoff&0xff=2:On: MIL persistence}{cfgout_MILoff&0xff=3:On: Active fault}" VALUE 0x001CA472 /* @ECU_Address@cfgout_MILoff@0x01005C20@ */ ECIPP_ALIGNMENT_UWORD 65535 cfgout_MILoff_COMPU_VTAB 0 65535 BIT_MASK 0xff /end CHARACTERISTIC
/begin COMPU_METHOD cfgout_MILoff_COMPU_VTAB "Verbal Table" TAB_VERB "%.0" "list" COMPU_TAB_REF cfgout_MILoff_COMPU_VTAB_REF /end COMPU_METHOD
/begin COMPU_VTAB cfgout_MILoff_COMPU_VTAB_REF "Verbal Table" TAB_VERB 4 0 "Off" 1 "On: Bulb check" 2 "On: MIL persistence" 3 "On: Active fault" DEFAULT_VALUE "UNKNOWN" /end COMPU_VTAB
/begin CHARACTERISTIC cfgout2_CLlon "and/or CL is{cfgout2_CLlon&0xff=0x00:Ignored}{cfgout2_CLlon&0xff=0x01:<}{cfgout2_CLlon&0xff=0x02:>}{cfgout2_CLlon&0xff=0x03:<=}{cfgout2_CLlon&0xff=0x04:>=}{cfgout2_CLlon&0xff=0x05:=}{cfgout2_CLlon&0xff=0x06:<>}" VALUE 0x001CA490 /* @ECU_Address@cfgout2_CLlon@0x01005C28@ */ ECIPP_ALIGNMENT_UBYTE 255 cfgout2_CLlon_COMPU_VTAB 0 255 BIT_MASK 0xff /end CHARACTERISTIC
/begin COMPU_METHOD cfgout2_CLlon_COMPU_VTAB "Verbal Table" TAB_VERB "%.0" "list" COMPU_TAB_REF cfgout2_CLlon_COMPU_VTAB_REF /end COMPU_METHOD
/begin COMPU_VTAB cfgout2_CLlon_COMPU_VTAB_REF "Verbal Table" TAB_VERB 7 0x00 "Ignored" 0x01 "<" 0x02 ">" 0x03 "<=" 0x04 ">=" 0x05 "=" 0x06 "<>" DEFAULT_VALUE "UNKNOWN" /end COMPU_VTAB
/begin CHARACTERISTIC cfgout2_CLloff "and/or CL is{cfgout2_CLloff&0xff=0x00:Ignored}{cfgout2_CLloff&0xff=0x01:<}{cfgout2_CLloff&0xff=0x02:>}{cfgout2_CLloff&0xff=0x03:<=}{cfgout2_CLloff&0xff=0x04:>=}{cfgout2_CLloff&0xff=0x05:=}{cfgout2_CLloff&0xff=0x06:<>}" VALUE 0x001CA49C /* @ECU_Address@cfgout2_CLloff@0x01005C30@ */ ECIPP_ALIGNMENT_UBYTE 255 cfgout2_CLloff_COMPU_VTAB 0 255 BIT_MASK 0xff /end CHARACTERISTIC
/begin COMPU_METHOD cfgout2_CLloff_COMPU_VTAB "Verbal Table" TAB_VERB "%.0" "list" COMPU_TAB_REF cfgout2_CLloff_COMPU_VTAB_REF /end COMPU_METHOD
/begin COMPU_VTAB cfgout2_CLloff_COMPU_VTAB_REF "Verbal Table" TAB_VERB 7 0x00 "Ignored" 0x01 "<" 0x02 ">" 0x03 "<=" 0x04 ">=" 0x05 "=" 0x06 "<>" DEFAULT_VALUE "UNKNOWN" /end COMPU_VTAB
/begin CHARACTERISTIC cfgout2_CLon "CL status is{cfgout2_CLon&0xff=0:CL not supported}{cfgout2_CLon&0xff=1:OL: system conditions}{cfgout2_CLon&0xff=2:OL: driving conditions}{cfgout2_CLon&0xff=3:OL: fault}{cfgout2_CLon&0xff=4:CL active}{cfgout2_CLon&0xff=5:CL + adapt active}" VALUE 0x001CA4B0 /* @ECU_Address@cfgout2_CLon@0x01005C38@ */ ECIPP_ALIGNMENT_UWORD 65535 cfgout2_CLon_COMPU_VTAB 0 65535 BIT_MASK 0xff /end CHARACTERISTIC
/begin COMPU_METHOD cfgout2_CLon_COMPU_VTAB "Verbal Table" TAB_VERB "%.0" "list" COMPU_TAB_REF cfgout2_CLon_COMPU_VTAB_REF /end COMPU_METHOD
/begin COMPU_VTAB cfgout2_CLon_COMPU_VTAB_REF "Verbal Table" TAB_VERB 6 0 "CL not supported" 1 "OL: system conditions" 2 "OL: driving conditions" 3 "OL: fault" 4 "CL active" 5 "CL + adapt active" DEFAULT_VALUE "UNKNOWN" /end COMPU_VTAB
/begin CHARACTERISTIC cfgout2_CLoff "CL status is{cfgout2_CLoff&0xff=0:CL not supported}{cfgout2_CLoff&0xff=1:OL: system conditions}{cfgout2_CLoff&0xff=2:OL: driving conditions}{cfgout2_CLoff&0xff=3:OL: fault}{cfgout2_CLoff&0xff=4:CL active}{cfgout2_CLoff&0xff=5:CL + adapt active}" VALUE 0x001CA4C8 /* @ECU_Address@cfgout2_CLoff@0x01005C40@ */ ECIPP_ALIGNMENT_UWORD 65535 cfgout2_CLoff_COMPU_VTAB 0 65535 BIT_MASK 0xff /end CHARACTERISTIC
/begin COMPU_METHOD cfgout2_CLoff_COMPU_VTAB "Verbal Table" TAB_VERB "%.0" "list" COMPU_TAB_REF cfgout2_CLoff_COMPU_VTAB_REF /end COMPU_METHOD
/begin COMPU_VTAB cfgout2_CLoff_COMPU_VTAB_REF "Verbal Table" TAB_VERB 6 0 "CL not supported" 1 "OL: system conditions" 2 "OL: driving conditions" 3 "OL: fault" 4 "CL active" 5 "CL + adapt active" DEFAULT_VALUE "UNKNOWN" /end COMPU_VTAB
/begin CHARACTERISTIC cfgout2_MILlon "and/or MIL is{cfgout2_MILlon&0xff=0x00:Ignored}{cfgout2_MILlon&0xff=0x01:<}{cfgout2_MILlon&0xff=0x02:>}{cfgout2_MILlon&0xff=0x03:<=}{cfgout2_MILlon&0xff=0x04:>=}{cfgout2_MILlon&0xff=0x05:=}{cfgout2_MILlon&0xff=0x06:<>}" VALUE 0x001CA491 /* @ECU_Address@cfgout2_MILlon@0x01005C48@ */ ECIPP_ALIGNMENT_UBYTE 255 cfgout2_MILlon_COMPU_VTAB 0 255 BIT_MASK 0xff /end CHARACTERISTIC
/begin COMPU_METHOD cfgout2_MILlon_COMPU_VTAB "Verbal Table" TAB_VERB "%.0" "list" COMPU_TAB_REF cfgout2_MILlon_COMPU_VTAB_REF /end COMPU_METHOD
/begin COMPU_VTAB cfgout2_MILlon_COMPU_VTAB_REF "Verbal Table" TAB_VERB 7 0x00 "Ignored" 0x01 "<" 0x02 ">" 0x03 "<=" 0x04 ">=" 0x05 "=" 0x06 "<>" DEFAULT_VALUE "UNKNOWN" /end COMPU_VTAB
/begin CHARACTERISTIC cfgout2_MILloff "and/or MIL is{cfgout2_MILloff&0xff=0x00:Ignored}{cfgout2_MILloff&0xff=0x01:<}{cfgout2_MILloff&0xff=0x02:>}{cfgout2_MILloff&0xff=0x03:<=}{cfgout2_MILloff&0xff=0x04:>=}{cfgout2_MILloff&0xff=0x05:=}{cfgout2_MILloff&0xff=0x06:<>}" VALUE 0x001CA49D /* @ECU_Address@cfgout2_MILloff@0x01005C50@ */ ECIPP_ALIGNMENT_UBYTE 255 cfgout2_MILloff_COMPU_VTAB 0 255 BIT_MASK 0xff /end CHARACTERISTIC
/begin COMPU_METHOD cfgout2_MILloff_COMPU_VTAB "Verbal Table" TAB_VERB "%.0" "list" COMPU_TAB_REF cfgout2_MILloff_COMPU_VTAB_REF /end COMPU_METHOD
/begin COMPU_VTAB cfgout2_MILloff_COMPU_VTAB_REF "Verbal Table" TAB_VERB 7 0x00 "Ignored" 0x01 "<" 0x02 ">" 0x03 "<=" 0x04 ">=" 0x05 "=" 0x06 "<>" DEFAULT_VALUE "UNKNOWN" /end COMPU_VTAB
/begin CHARACTERISTIC cfgout2_MILon "MIL status is{cfgout2_MILon&0xff=0:Off}{cfgout2_MILon&0xff=1:On: Bulb check}{cfgout2_MILon&0xff=2:On: MIL persistence}{cfgout2_MILon&0xff=3:On: Active fault}" VALUE 0x001CA4B2 /* @ECU_Address@cfgout2_MILon@0x01005C58@ */ ECIPP_ALIGNMENT_UWORD 65535 cfgout2_MILon_COMPU_VTAB 0 65535 BIT_MASK 0xff /end CHARACTERISTIC
/begin COMPU_METHOD cfgout2_MILon_COMPU_VTAB "Verbal Table" TAB_VERB "%.0" "list" COMPU_TAB_REF cfgout2_MILon_COMPU_VTAB_REF /end COMPU_METHOD
/begin COMPU_VTAB cfgout2_MILon_COMPU_VTAB_REF "Verbal Table" TAB_VERB 4 0 "Off" 1 "On: Bulb check" 2 "On: MIL persistence" 3 "On: Active fault" DEFAULT_VALUE "UNKNOWN" /end COMPU_VTAB
/begin CHARACTERISTIC cfgout2_MILoff "MIL status is{cfgout2_MILoff&0xff=0:Off}{cfgout2_MILoff&0xff=1:On: Bulb check}{cfgout2_MILoff&0xff=2:On: MIL persistence}{cfgout2_MILoff&0xff=3:On: Active fault}" VALUE 0x001CA4CA /* @ECU_Address@cfgout2_MILoff@0x01005C60@ */ ECIPP_ALIGNMENT_UWORD 65535 cfgout2_MILoff_COMPU_VTAB 0 65535 BIT_MASK 0xff /end CHARACTERISTIC
/begin COMPU_METHOD cfgout2_MILoff_COMPU_VTAB "Verbal Table" TAB_VERB "%.0" "list" COMPU_TAB_REF cfgout2_MILoff_COMPU_VTAB_REF /end COMPU_METHOD
/begin COMPU_VTAB cfgout2_MILoff_COMPU_VTAB_REF "Verbal Table" TAB_VERB 4 0 "Off" 1 "On: Bulb check" 2 "On: MIL persistence" 3 "On: Active fault" DEFAULT_VALUE "UNKNOWN" /end COMPU_VTAB
/begin CHARACTERISTIC cfgout3_CLlon "and/or CL is{cfgout3_CLlon&0xff=0x00:Ignored}{cfgout3_CLlon&0xff=0x01:<}{cfgout3_CLlon&0xff=0x02:>}{cfgout3_CLlon&0xff=0x03:<=}{cfgout3_CLlon&0xff=0x04:>=}{cfgout3_CLlon&0xff=0x05:=}{cfgout3_CLlon&0xff=0x06:<>}" VALUE 0x001CA4E8 /* @ECU_Address@cfgout3_CLlon@0x01005C68@ */ ECIPP_ALIGNMENT_UBYTE 255 cfgout3_CLlon_COMPU_VTAB 0 255 BIT_MASK 0xff /end CHARACTERISTIC
/begin COMPU_METHOD cfgout3_CLlon_COMPU_VTAB "Verbal Table" TAB_VERB "%.0" "list" COMPU_TAB_REF cfgout3_CLlon_COMPU_VTAB_REF /end COMPU_METHOD
/begin COMPU_VTAB cfgout3_CLlon_COMPU_VTAB_REF "Verbal Table" TAB_VERB 7 0x00 "Ignored" 0x01 "<" 0x02 ">" 0x03 "<=" 0x04 ">=" 0x05 "=" 0x06 "<>" DEFAULT_VALUE "UNKNOWN" /end COMPU_VTAB
/begin CHARACTERISTIC cfgout3_CLloff "and/or CL is{cfgout3_CLloff&0xff=0x00:Ignored}{cfgout3_CLloff&0xff=0x01:<}{cfgout3_CLloff&0xff=0x02:>}{cfgout3_CLloff&0xff=0x03:<=}{cfgout3_CLloff&0xff=0x04:>=}{cfgout3_CLloff&0xff=0x05:=}{cfgout3_CLloff&0xff=0x06:<>}" VALUE 0x001CA4F4 /* @ECU_Address@cfgout3_CLloff@0x01005C70@ */ ECIPP_ALIGNMENT_UBYTE 255 cfgout3_CLloff_COMPU_VTAB 0 255 BIT_MASK 0xff /end CHARACTERISTIC
/begin COMPU_METHOD cfgout3_CLloff_COMPU_VTAB "Verbal Table" TAB_VERB "%.0" "list" COMPU_TAB_REF cfgout3_CLloff_COMPU_VTAB_REF /end COMPU_METHOD
/begin COMPU_VTAB cfgout3_CLloff_COMPU_VTAB_REF "Verbal Table" TAB_VERB 7 0x00 "Ignored" 0x01 "<" 0x02 ">" 0x03 "<=" 0x04 ">=" 0x05 "=" 0x06 "<>" DEFAULT_VALUE "UNKNOWN" /end COMPU_VTAB
/begin CHARACTERISTIC cfgout3_CLon "CL status is{cfgout3_CLon&0xff=0:CL not supported}{cfgout3_CLon&0xff=1:OL: system conditions}{cfgout3_CLon&0xff=2:OL: driving conditions}{cfgout3_CLon&0xff=3:OL: fault}{cfgout3_CLon&0xff=4:CL active}{cfgout3_CLon&0xff=5:CL + adapt active}" VALUE 0x001CA508 /* @ECU_Address@cfgout3_CLon@0x01005C78@ */ ECIPP_ALIGNMENT_UWORD 65535 cfgout3_CLon_COMPU_VTAB 0 65535 BIT_MASK 0xff /end CHARACTERISTIC
/begin COMPU_METHOD cfgout3_CLon_COMPU_VTAB "Verbal Table" TAB_VERB "%.0" "list" COMPU_TAB_REF cfgout3_CLon_COMPU_VTAB_REF /end COMPU_METHOD
/begin COMPU_VTAB cfgout3_CLon_COMPU_VTAB_REF "Verbal Table" TAB_VERB 6 0 "CL not supported" 1 "OL: system conditions" 2 "OL: driving conditions" 3 "OL: fault" 4 "CL active" 5 "CL + adapt active" DEFAULT_VALUE "UNKNOWN" /end COMPU_VTAB
/begin CHARACTERISTIC cfgout3_CLoff "CL status is{cfgout3_CLoff&0xff=0:CL not supported}{cfgout3_CLoff&0xff=1:OL: system conditions}{cfgout3_CLoff&0xff=2:OL: driving conditions}{cfgout3_CLoff&0xff=3:OL: fault}{cfgout3_CLoff&0xff=4:CL active}{cfgout3_CLoff&0xff=5:CL + adapt active}" VALUE 0x001CA520 /* @ECU_Address@cfgout3_CLoff@0x01005C80@ */ ECIPP_ALIGNMENT_UWORD 65535 cfgout3_CLoff_COMPU_VTAB 0 65535 BIT_MASK 0xff /end CHARACTERISTIC
/begin COMPU_METHOD cfgout3_CLoff_COMPU_VTAB "Verbal Table" TAB_VERB "%.0" "list" COMPU_TAB_REF cfgout3_CLoff_COMPU_VTAB_REF /end COMPU_METHOD
/begin COMPU_VTAB cfgout3_CLoff_COMPU_VTAB_REF "Verbal Table" TAB_VERB 6 0 "CL not supported" 1 "OL: system conditions" 2 "OL: driving conditions" 3 "OL: fault" 4 "CL active" 5 "CL + adapt active" DEFAULT_VALUE "UNKNOWN" /end COMPU_VTAB
/begin CHARACTERISTIC cfgout3_MILlon "and/or MIL is{cfgout3_MILlon&0xff=0x00:Ignored}{cfgout3_MILlon&0xff=0x01:<}{cfgout3_MILlon&0xff=0x02:>}{cfgout3_MILlon&0xff=0x03:<=}{cfgout3_MILlon&0xff=0x04:>=}{cfgout3_MILlon&0xff=0x05:=}{cfgout3_MILlon&0xff=0x06:<>}" VALUE 0x001CA4E9 /* @ECU_Address@cfgout3_MILlon@0x01005C88@ */ ECIPP_ALIGNMENT_UBYTE 255 cfgout3_MILlon_COMPU_VTAB 0 255 BIT_MASK 0xff /end CHARACTERISTIC
/begin COMPU_METHOD cfgout3_MILlon_COMPU_VTAB "Verbal Table" TAB_VERB "%.0" "list" COMPU_TAB_REF cfgout3_MILlon_COMPU_VTAB_REF /end COMPU_METHOD
/begin COMPU_VTAB cfgout3_MILlon_COMPU_VTAB_REF "Verbal Table" TAB_VERB 7 0x00 "Ignored" 0x01 "<" 0x02 ">" 0x03 "<=" 0x04 ">=" 0x05 "=" 0x06 "<>" DEFAULT_VALUE "UNKNOWN" /end COMPU_VTAB
/begin CHARACTERISTIC cfgout3_MILloff "and/or MIL is{cfgout3_MILloff&0xff=0x00:Ignored}{cfgout3_MILloff&0xff=0x01:<}{cfgout3_MILloff&0xff=0x02:>}{cfgout3_MILloff&0xff=0x03:<=}{cfgout3_MILloff&0xff=0x04:>=}{cfgout3_MILloff&0xff=0x05:=}{cfgout3_MILloff&0xff=0x06:<>}" VALUE 0x001CA4F5 /* @ECU_Address@cfgout3_MILloff@0x01005C90@ */ ECIPP_ALIGNMENT_UBYTE 255 cfgout3_MILloff_COMPU_VTAB 0 255 BIT_MASK 0xff /end CHARACTERISTIC
/begin COMPU_METHOD cfgout3_MILloff_COMPU_VTAB "Verbal Table" TAB_VERB "%.0" "list" COMPU_TAB_REF cfgout3_MILloff_COMPU_VTAB_REF /end COMPU_METHOD
/begin COMPU_VTAB cfgout3_MILloff_COMPU_VTAB_REF "Verbal Table" TAB_VERB 7 0x00 "Ignored" 0x01 "<" 0x02 ">" 0x03 "<=" 0x04 ">=" 0x05 "=" 0x06 "<>" DEFAULT_VALUE "UNKNOWN" /end COMPU_VTAB
/begin CHARACTERISTIC cfgout3_MILon "MIL status is{cfgout3_MILon&0xff=0:Off}{cfgout3_MILon&0xff=1:On: Bulb check}{cfgout3_MILon&0xff=2:On: MIL persistence}{cfgout3_MILon&0xff=3:On: Active fault}" VALUE 0x001CA50A /* @ECU_Address@cfgout3_MILon@0x01005C98@ */ ECIPP_ALIGNMENT_UWORD 65535 cfgout3_MILon_COMPU_VTAB 0 65535 BIT_MASK 0xff /end CHARACTERISTIC
/begin COMPU_METHOD cfgout3_MILon_COMPU_VTAB "Verbal Table" TAB_VERB "%.0" "list" COMPU_TAB_REF cfgout3_MILon_COMPU_VTAB_REF /end COMPU_METHOD
/begin COMPU_VTAB cfgout3_MILon_COMPU_VTAB_REF "Verbal Table" TAB_VERB 4 0 "Off" 1 "On: Bulb check" 2 "On: MIL persistence" 3 "On: Active fault" DEFAULT_VALUE "UNKNOWN" /end COMPU_VTAB
/begin CHARACTERISTIC cfgout3_MILoff "MIL status is{cfgout3_MILoff&0xff=0:Off}{cfgout3_MILoff&0xff=1:On: Bulb check}{cfgout3_MILoff&0xff=2:On: MIL persistence}{cfgout3_MILoff&0xff=3:On: Active fault}" VALUE 0x001CA522 /* @ECU_Address@cfgout3_MILoff@0x01005CA0@ */ ECIPP_ALIGNMENT_UWORD 65535 cfgout3_MILoff_COMPU_VTAB 0 65535 BIT_MASK 0xff /end CHARACTERISTIC
/begin COMPU_METHOD cfgout3_MILoff_COMPU_VTAB "Verbal Table" TAB_VERB "%.0" "list" COMPU_TAB_REF cfgout3_MILoff_COMPU_VTAB_REF /end COMPU_METHOD
/begin COMPU_VTAB cfgout3_MILoff_COMPU_VTAB_REF "Verbal Table" TAB_VERB 4 0 "Off" 1 "On: Bulb check" 2 "On: MIL persistence" 3 "On: Active fault" DEFAULT_VALUE "UNKNOWN" /end COMPU_VTAB
/begin CHARACTERISTIC autocrk_reset "Auto-crank trigger reset{autocrk_reset&0xff=0:Disabled}{autocrk_reset&0xff=1:Enabled}" VALUE 0x001c8f9c /* @ECU_Address@autocrk_reset@0x01005D88@ */ ECIPP_ALIGNMENT_UBYTE 255 autocrk_reset_COMPU_VTAB 0 255 BIT_MASK 0xff /end CHARACTERISTIC
/begin COMPU_METHOD autocrk_reset_COMPU_VTAB "Verbal Table" TAB_VERB "%.0" "list" COMPU_TAB_REF autocrk_reset_COMPU_VTAB_REF /end COMPU_METHOD
/begin COMPU_VTAB autocrk_reset_COMPU_VTAB_REF "Verbal Table" TAB_VERB 2 0 "Disabled" 1 "Enabled" DEFAULT_VALUE "UNKNOWN" /end COMPU_VTAB
/begin CHARACTERISTIC autocrk_starttmr "Auto-crank starter-on wind-up{autocrk_starttmr&0xff=0:Disabled}{autocrk_starttmr&0xff=1:Enabled}" VALUE 0x001c8f9d /* @ECU_Address@autocrk_starttmr@0x01005D90@ */ ECIPP_ALIGNMENT_UBYTE 255 autocrk_starttmr_COMPU_VTAB 0 255 BIT_MASK 0xff /end CHARACTERISTIC
/begin COMPU_METHOD autocrk_starttmr_COMPU_VTAB "Verbal Table" TAB_VERB "%.0" "list" COMPU_TAB_REF autocrk_starttmr_COMPU_VTAB_REF /end COMPU_METHOD
/begin COMPU_VTAB autocrk_starttmr_COMPU_VTAB_REF "Verbal Table" TAB_VERB 2 0 "Disabled" 1 "Enabled" DEFAULT_VALUE "UNKNOWN" /end COMPU_VTAB
/begin CHARACTERISTIC crank_trans_FBlim "Trans in-gear LS FB limit" VALUE 0x001c83ea /* @ECU_Address@crank_trans_FBlim@0x01005E60@ */ ECIPP_ALIGNMENT_UWORD 256 Compu_crank_trans_FBlim 0 255.99609375 /end CHARACTERISTIC
/begin COMPU_METHOD Compu_crank_trans_FBlim " " RAT_FUNC "%.2" "volts" COEFFS 0 256 0 0 0 1 /end COMPU_METHOD
/begin CHARACTERISTIC start_autocrk_wt "Start signal additional debounce time" VALUE 0x001c84ea /* @ECU_Address@start_autocrk_wt@0x01006708@ */ ECIPP_ALIGNMENT_UWORD 65535 Compu_start_autocrk_wt 0 65535 /end CHARACTERISTIC
/begin COMPU_METHOD Compu_start_autocrk_wt " " RAT_FUNC "%.0" "ms" COEFFS 0 1 0 0 0 1 /end COMPU_METHOD
/begin CHARACTERISTIC crank_trans_wait "Transmission in-gear crank wait" VALUE 0x001c83ee /* @ECU_Address@crank_trans_wait@0x010069D8@ */ ECIPP_ALIGNMENT_UWORD 65535 Compu_crank_trans_wait 0 65535 /end CHARACTERISTIC
/begin COMPU_METHOD Compu_crank_trans_wait " " RAT_FUNC "%.0" "ms" COEFFS 0 1 0 0 0 1 /end COMPU_METHOD
/begin CHARACTERISTIC IOPWM_hydraulic_ena "Hydraulic enable solenoid{IOPWM_hydraulic_ena&0xff=0:Disabled}{IOPWM_hydraulic_ena&0xff=1:Buzzer Output}{IOPWM_hydraulic_ena&0xff=2:MIL Output}{IOPWM_hydraulic_ena&0xff=3:TACH Output}{IOPWM_hydraulic_ena&0xff=4:Starter Output}{IOPWM_hydraulic_ena&0xff=5:E" VALUE 0x001c8796 /* @ECU_Address@IOPWM_hydraulic_ena@0x01006C68@ */ ECIPP_ALIGNMENT_UBYTE 255 IOPWM_hydraulic_ena_COMPU_VTAB 0 255 BIT_MASK 0xff /end CHARACTERISTIC
/begin COMPU_METHOD IOPWM_hydraulic_ena_COMPU_VTAB "Verbal Table" TAB_VERB "%.0" "list" COMPU_TAB_REF IOPWM_hydraulic_ena_COMPU_VTAB_REF /end COMPU_METHOD
/begin COMPU_VTAB IOPWM_hydraulic_ena_COMPU_VTAB_REF "Verbal Table" TAB_VERB 32 0 "Disabled" 1 "Buzzer Output" 2 "MIL Output" 3 "TACH Output" 4 "Starter Output" 5 "EGOH1" 6 "EGOH2" 7 "EGOH3" 8 "EGOH4" 9 "Aux PWM1" 10 "Aux PWM2" 11 "Aux PWM3" 12 "Aux PWM4" 13 "Aux PWM5" 14 "Aux PWM6" 15 "Aux PWM7" 16 "Aux PWM8" 17 "Aux PWM9" 18 "Aux PWM10" 19 "Aux PWM11" 20 "Aux PWM12" 21 "Aux PWM13" 22 "Aux PWM14" 23 "Aux PWM15" 24 "Aux PWM16" 25 "Aux PWM17" 26 "Aux PWM18" 27 "Aux PWM19" 28 "Aux PWM20" 29 "Aux PWM21" 30 "Aux PWM22" 31 "Aux PWM23" DEFAULT_VALUE "UNKNOWN" /end COMPU_VTAB
/begin CHARACTERISTIC IOPWM_hydraulic_fwd "Hydraulic forward solenoid{IOPWM_hydraulic_fwd&0xff=0:Disabled}{IOPWM_hydraulic_fwd&0xff=1:Buzzer Output}{IOPWM_hydraulic_fwd&0xff=2:MIL Output}{IOPWM_hydraulic_fwd&0xff=3:TACH Output}{IOPWM_hydraulic_fwd&0xff=4:Starter Output}{IOPWM_hydraulic_fwd&0xff=5:" VALUE 0x001CA1E0 /* @ECU_Address@IOPWM_hydraulic_fwd@0x01006C70@ */ ECIPP_ALIGNMENT_UBYTE 255 IOPWM_hydraulic_fwd_COMPU_VTAB 0 255 BIT_MASK 0xff /end CHARACTERISTIC
/begin COMPU_METHOD IOPWM_hydraulic_fwd_COMPU_VTAB "Verbal Table" TAB_VERB "%.0" "list" COMPU_TAB_REF IOPWM_hydraulic_fwd_COMPU_VTAB_REF /end COMPU_METHOD
/begin COMPU_VTAB IOPWM_hydraulic_fwd_COMPU_VTAB_REF "Verbal Table" TAB_VERB 32 0 "Disabled" 1 "Buzzer Output" 2 "MIL Output" 3 "TACH Output" 4 "Starter Output" 5 "EGOH1" 6 "EGOH2" 7 "EGOH3" 8 "EGOH4" 9 "Aux PWM1" 10 "Aux PWM2" 11 "Aux PWM3" 12 "Aux PWM4" 13 "Aux PWM5" 14 "Aux PWM6" 15 "Aux PWM7" 16 "Aux PWM8" 17 "Aux PWM9" 18 "Aux PWM10" 19 "Aux PWM11" 20 "Aux PWM12" 21 "Aux PWM13" 22 "Aux PWM14" 23 "Aux PWM15" 24 "Aux PWM16" 25 "Aux PWM17" 26 "Aux PWM18" 27 "Aux PWM19" 28 "Aux PWM20" 29 "Aux PWM21" 30 "Aux PWM22" 31 "Aux PWM23" DEFAULT_VALUE "UNKNOWN" /end COMPU_VTAB
/begin CHARACTERISTIC IOPWM_hydraulic_rev "Hydraulic reverse solenoid{IOPWM_hydraulic_rev&0xff=0:Disabled}{IOPWM_hydraulic_rev&0xff=1:Buzzer Output}{IOPWM_hydraulic_rev&0xff=2:MIL Output}{IOPWM_hydraulic_rev&0xff=3:TACH Output}{IOPWM_hydraulic_rev&0xff=4:Starter Output}{IOPWM_hydraulic_rev&0xff=5:" VALUE 0x001CA208 /* @ECU_Address@IOPWM_hydraulic_rev@0x01006C78@ */ ECIPP_ALIGNMENT_UBYTE 255 IOPWM_hydraulic_rev_COMPU_VTAB 0 255 BIT_MASK 0xff /end CHARACTERISTIC
/begin COMPU_METHOD IOPWM_hydraulic_rev_COMPU_VTAB "Verbal Table" TAB_VERB "%.0" "list" COMPU_TAB_REF IOPWM_hydraulic_rev_COMPU_VTAB_REF /end COMPU_METHOD
/begin COMPU_VTAB IOPWM_hydraulic_rev_COMPU_VTAB_REF "Verbal Table" TAB_VERB 32 0 "Disabled" 1 "Buzzer Output" 2 "MIL Output" 3 "TACH Output" 4 "Starter Output" 5 "EGOH1" 6 "EGOH2" 7 "EGOH3" 8 "EGOH4" 9 "Aux PWM1" 10 "Aux PWM2" 11 "Aux PWM3" 12 "Aux PWM4" 13 "Aux PWM5" 14 "Aux PWM6" 15 "Aux PWM7" 16 "Aux PWM8" 17 "Aux PWM9" 18 "Aux PWM10" 19 "Aux PWM11" 20 "Aux PWM12" 21 "Aux PWM13" 22 "Aux PWM14" 23 "Aux PWM15" 24 "Aux PWM16" 25 "Aux PWM17" 26 "Aux PWM18" 27 "Aux PWM19" 28 "Aux PWM20" 29 "Aux PWM21" 30 "Aux PWM22" 31 "Aux PWM23" DEFAULT_VALUE "UNKNOWN" /end COMPU_VTAB
/begin CHARACTERISTIC IODO_bkup_alm_light "Back-up alarm / light{IODO_bkup_alm_light&0xff=0:Disabled}{IODO_bkup_alm_light&0xff=1:Buzzer Output}{IODO_bkup_alm_light&0xff=2:MIL Output}{IODO_bkup_alm_light&0xff=3:TACH Output}{IODO_bkup_alm_light&0xff=4:Starter Output}{IODO_bkup_alm_light&0xff=5:EGOH1" VALUE 0x001c8790 /* @ECU_Address@IODO_bkup_alm_light@0x01006C80@ */ ECIPP_ALIGNMENT_UBYTE 255 IODO_bkup_alm_light_COMPU_VTAB 0 255 BIT_MASK 0xff /end CHARACTERISTIC
/begin COMPU_METHOD IODO_bkup_alm_light_COMPU_VTAB "Verbal Table" TAB_VERB "%.0" "list" COMPU_TAB_REF IODO_bkup_alm_light_COMPU_VTAB_REF /end COMPU_METHOD
/begin COMPU_VTAB IODO_bkup_alm_light_COMPU_VTAB_REF "Verbal Table" TAB_VERB 32 0 "Disabled" 1 "Buzzer Output" 2 "MIL Output" 3 "TACH Output" 4 "Starter Output" 5 "EGOH1" 6 "EGOH2" 7 "EGOH3" 8 "EGOH4" 9 "Aux PWM1" 10 "Aux PWM2" 11 "Aux PWM3" 12 "Aux PWM4" 13 "Aux PWM5" 14 "Aux PWM6" 15 "Aux PWM7" 16 "Aux PWM8" 17 "Aux PWM9" 18 "Aux PWM10" 19 "Aux PWM11" 20 "Aux PWM12" 21 "Aux PWM13" 22 "Aux PWM14" 23 "Aux PWM15" 24 "Aux PWM16" 25 "Aux PWM17" 26 "Aux PWM18" 27 "Aux PWM19" 28 "Aux PWM20" 29 "Aux PWM21" 30 "Aux PWM22" 31 "Aux PWM23" DEFAULT_VALUE "UNKNOWN" /end COMPU_VTAB
/begin CHARACTERISTIC IODO_light_work_frnt "Front work light{IODO_light_work_frnt&0xff=0:Disabled}{IODO_light_work_frnt&0xff=1:Buzzer Output}{IODO_light_work_frnt&0xff=2:MIL Output}{IODO_light_work_frnt&0xff=3:TACH Output}{IODO_light_work_frnt&0xff=4:Starter Output}{IODO_light_work_frnt&0xff=5:EGOH" VALUE 0x001c8793 /* @ECU_Address@IODO_light_work_frnt@0x01006C88@ */ ECIPP_ALIGNMENT_UBYTE 255 IODO_light_work_frnt_COMPU_VTAB 0 255 BIT_MASK 0xff /end CHARACTERISTIC
/begin COMPU_METHOD IODO_light_work_frnt_COMPU_VTAB "Verbal Table" TAB_VERB "%.0" "list" COMPU_TAB_REF IODO_light_work_frnt_COMPU_VTAB_REF /end COMPU_METHOD
/begin COMPU_VTAB IODO_light_work_frnt_COMPU_VTAB_REF "Verbal Table" TAB_VERB 32 0 "Disabled" 1 "Buzzer Output" 2 "MIL Output" 3 "TACH Output" 4 "Starter Output" 5 "EGOH1" 6 "EGOH2" 7 "EGOH3" 8 "EGOH4" 9 "Aux PWM1" 10 "Aux PWM2" 11 "Aux PWM3" 12 "Aux PWM4" 13 "Aux PWM5" 14 "Aux PWM6" 15 "Aux PWM7" 16 "Aux PWM8" 17 "Aux PWM9" 18 "Aux PWM10" 19 "Aux PWM11" 20 "Aux PWM12" 21 "Aux PWM13" 22 "Aux PWM14" 23 "Aux PWM15" 24 "Aux PWM16" 25 "Aux PWM17" 26 "Aux PWM18" 27 "Aux PWM19" 28 "Aux PWM20" 29 "Aux PWM21" 30 "Aux PWM22" 31 "Aux PWM23" DEFAULT_VALUE "UNKNOWN" /end COMPU_VTAB
/begin CHARACTERISTIC IODO_light_work_rear "Rear work light{IODO_light_work_rear&0xff=0:Disabled}{IODO_light_work_rear&0xff=1:Buzzer Output}{IODO_light_work_rear&0xff=2:MIL Output}{IODO_light_work_rear&0xff=3:TACH Output}{IODO_light_work_rear&0xff=4:Starter Output}{IODO_light_work_rear&0xff=5:EGOH1" VALUE 0x001c8794 /* @ECU_Address@IODO_light_work_rear@0x01006C90@ */ ECIPP_ALIGNMENT_UBYTE 255 IODO_light_work_rear_COMPU_VTAB 0 255 BIT_MASK 0xff /end CHARACTERISTIC
/begin COMPU_METHOD IODO_light_work_rear_COMPU_VTAB "Verbal Table" TAB_VERB "%.0" "list" COMPU_TAB_REF IODO_light_work_rear_COMPU_VTAB_REF /end COMPU_METHOD
/begin COMPU_VTAB IODO_light_work_rear_COMPU_VTAB_REF "Verbal Table" TAB_VERB 32 0 "Disabled" 1 "Buzzer Output" 2 "MIL Output" 3 "TACH Output" 4 "Starter Output" 5 "EGOH1" 6 "EGOH2" 7 "EGOH3" 8 "EGOH4" 9 "Aux PWM1" 10 "Aux PWM2" 11 "Aux PWM3" 12 "Aux PWM4" 13 "Aux PWM5" 14 "Aux PWM6" 15 "Aux PWM7" 16 "Aux PWM8" 17 "Aux PWM9" 18 "Aux PWM10" 19 "Aux PWM11" 20 "Aux PWM12" 21 "Aux PWM13" 22 "Aux PWM14" 23 "Aux PWM15" 24 "Aux PWM16" 25 "Aux PWM17" 26 "Aux PWM18" 27 "Aux PWM19" 28 "Aux PWM20" 29 "Aux PWM21" 30 "Aux PWM22" 31 "Aux PWM23" DEFAULT_VALUE "UNKNOWN" /end COMPU_VTAB
/begin CHARACTERISTIC IODO_light_brake "Brake light{IODO_light_brake&0xff=0:Disabled}{IODO_light_brake&0xff=1:Buzzer Output}{IODO_light_brake&0xff=2:MIL Output}{IODO_light_brake&0xff=3:TACH Output}{IODO_light_brake&0xff=4:Starter Output}{IODO_light_brake&0xff=5:EGOH1}{IODO_light_brake&0xff=6:EG" VALUE 0x001c8792 /* @ECU_Address@IODO_light_brake@0x01006C98@ */ ECIPP_ALIGNMENT_UBYTE 255 IODO_light_brake_COMPU_VTAB 0 255 BIT_MASK 0xff /end CHARACTERISTIC
/begin COMPU_METHOD IODO_light_brake_COMPU_VTAB "Verbal Table" TAB_VERB "%.0" "list" COMPU_TAB_REF IODO_light_brake_COMPU_VTAB_REF /end COMPU_METHOD
/begin COMPU_VTAB IODO_light_brake_COMPU_VTAB_REF "Verbal Table" TAB_VERB 32 0 "Disabled" 1 "Buzzer Output" 2 "MIL Output" 3 "TACH Output" 4 "Starter Output" 5 "EGOH1" 6 "EGOH2" 7 "EGOH3" 8 "EGOH4" 9 "Aux PWM1" 10 "Aux PWM2" 11 "Aux PWM3" 12 "Aux PWM4" 13 "Aux PWM5" 14 "Aux PWM6" 15 "Aux PWM7" 16 "Aux PWM8" 17 "Aux PWM9" 18 "Aux PWM10" 19 "Aux PWM11" 20 "Aux PWM12" 21 "Aux PWM13" 22 "Aux PWM14" 23 "Aux PWM15" 24 "Aux PWM16" 25 "Aux PWM17" 26 "Aux PWM18" 27 "Aux PWM19" 28 "Aux PWM20" 29 "Aux PWM21" 30 "Aux PWM22" 31 "Aux PWM23" DEFAULT_VALUE "UNKNOWN" /end COMPU_VTAB
/begin CHARACTERISTIC IODO_trans_enable "Transmission enable{IODO_trans_enable&0xff=0:Disabled}{IODO_trans_enable&0xff=1:Buzzer Output}{IODO_trans_enable&0xff=2:MIL Output}{IODO_trans_enable&0xff=3:TACH Output}{IODO_trans_enable&0xff=4:Starter Output}{IODO_trans_enable&0xff=5:EGOH1}{IODO_trans_e" VALUE 0x001c8795 /* @ECU_Address@IODO_trans_enable@0x01006CA0@ */ ECIPP_ALIGNMENT_UBYTE 255 IODO_trans_enable_COMPU_VTAB 0 255 BIT_MASK 0xff /end CHARACTERISTIC
/begin COMPU_METHOD IODO_trans_enable_COMPU_VTAB "Verbal Table" TAB_VERB "%.0" "list" COMPU_TAB_REF IODO_trans_enable_COMPU_VTAB_REF /end COMPU_METHOD
/begin COMPU_VTAB IODO_trans_enable_COMPU_VTAB_REF "Verbal Table" TAB_VERB 32 0 "Disabled" 1 "Buzzer Output" 2 "MIL Output" 3 "TACH Output" 4 "Starter Output" 5 "EGOH1" 6 "EGOH2" 7 "EGOH3" 8 "EGOH4" 9 "Aux PWM1" 10 "Aux PWM2" 11 "Aux PWM3" 12 "Aux PWM4" 13 "Aux PWM5" 14 "Aux PWM6" 15 "Aux PWM7" 16 "Aux PWM8" 17 "Aux PWM9" 18 "Aux PWM10" 19 "Aux PWM11" 20 "Aux PWM12" 21 "Aux PWM13" 22 "Aux PWM14" 23 "Aux PWM15" 24 "Aux PWM16" 25 "Aux PWM17" 26 "Aux PWM18" 27 "Aux PWM19" 28 "Aux PWM20" 29 "Aux PWM21" 30 "Aux PWM22" 31 "Aux PWM23" DEFAULT_VALUE "UNKNOWN" /end COMPU_VTAB
/begin CHARACTERISTIC IOAI_hydraulic_fwd "Forward hydraulic pressure{IOAI_hydraulic_fwd&0xff=0:Disabled}{IOAI_hydraulic_fwd&0xff=1:Aux PU1}{IOAI_hydraulic_fwd&0xff=2:Aux PU2}{IOAI_hydraulic_fwd&0xff=3:Aux PU3}{IOAI_hydraulic_fwd&0xff=4:Aux PD1}{IOAI_hydraulic_fwd&0xff=5:Aux PD2}{IOAI_hydraulic_fw" VALUE 0x001c8789 /* @ECU_Address@IOAI_hydraulic_fwd@0x01006CA8@ */ ECIPP_ALIGNMENT_UBYTE 255 IOAI_hydraulic_fwd_COMPU_VTAB 0 255 BIT_MASK 0xff /end CHARACTERISTIC
/begin COMPU_METHOD IOAI_hydraulic_fwd_COMPU_VTAB "Verbal Table" TAB_VERB "%.0" "list" COMPU_TAB_REF IOAI_hydraulic_fwd_COMPU_VTAB_REF /end COMPU_METHOD
/begin COMPU_VTAB IOAI_hydraulic_fwd_COMPU_VTAB_REF "Verbal Table" TAB_VERB 32 0 "Disabled" 1 "Aux PU1" 2 "Aux PU2" 3 "Aux PU3" 4 "Aux PD1" 5 "Aux PD2" 6 "Aux PD3" 7 "Aux PUD1" 8 "Aux PUD2" 9 "Aux PUD3" 10 "Aux PUD4" 11 "Aux PUD5" 12 "Aux PUD6" 13 "Aux PUD7" 14 "Aux PUD8" 15 "Aux PUD9" 16 "Aux PUD10" 17 "Aux PUD11" 18 "Aux PUD12" 19 "Aux PUD13" 20 "Aux PUD14" 21 "Aux PUD15" 22 "Aux PUD16" 23 "Aux PUD17" 24 "Aux PUD18" 25 "Aux PUD19" 26 "Aux PUD20" 27 "Aux PUD21" 28 "Aux PUD22" 29 "Aux PUD23" 30 "Aux PUD24" 31 "Aux PUD25" DEFAULT_VALUE "UNKNOWN" /end COMPU_VTAB
/begin CHARACTERISTIC IOAI_hydraulic_rev "Reverse hydraulic pressure{IOAI_hydraulic_rev&0xff=0:Disabled}{IOAI_hydraulic_rev&0xff=1:Aux PU1}{IOAI_hydraulic_rev&0xff=2:Aux PU2}{IOAI_hydraulic_rev&0xff=3:Aux PU3}{IOAI_hydraulic_rev&0xff=4:Aux PD1}{IOAI_hydraulic_rev&0xff=5:Aux PD2}{IOAI_hydraulic_re" VALUE 0x001c878a /* @ECU_Address@IOAI_hydraulic_rev@0x01006CB0@ */ ECIPP_ALIGNMENT_UBYTE 255 IOAI_hydraulic_rev_COMPU_VTAB 0 255 BIT_MASK 0xff /end CHARACTERISTIC
/begin COMPU_METHOD IOAI_hydraulic_rev_COMPU_VTAB "Verbal Table" TAB_VERB "%.0" "list" COMPU_TAB_REF IOAI_hydraulic_rev_COMPU_VTAB_REF /end COMPU_METHOD
/begin COMPU_VTAB IOAI_hydraulic_rev_COMPU_VTAB_REF "Verbal Table" TAB_VERB 32 0 "Disabled" 1 "Aux PU1" 2 "Aux PU2" 3 "Aux PU3" 4 "Aux PD1" 5 "Aux PD2" 6 "Aux PD3" 7 "Aux PUD1" 8 "Aux PUD2" 9 "Aux PUD3" 10 "Aux PUD4" 11 "Aux PUD5" 12 "Aux PUD6" 13 "Aux PUD7" 14 "Aux PUD8" 15 "Aux PUD9" 16 "Aux PUD10" 17 "Aux PUD11" 18 "Aux PUD12" 19 "Aux PUD13" 20 "Aux PUD14" 21 "Aux PUD15" 22 "Aux PUD16" 23 "Aux PUD17" 24 "Aux PUD18" 25 "Aux PUD19" 26 "Aux PUD20" 27 "Aux PUD21" 28 "Aux PUD22" 29 "Aux PUD23" 30 "Aux PUD24" 31 "Aux PUD25" DEFAULT_VALUE "UNKNOWN" /end COMPU_VTAB
/begin CHARACTERISTIC IOAI_trans_temp "Transmission temperature{IOAI_trans_temp&0xff=0:Disabled}{IOAI_trans_temp&0xff=1:Aux PU1}{IOAI_trans_temp&0xff=2:Aux PU2}{IOAI_trans_temp&0xff=3:Aux PU3}{IOAI_trans_temp&0xff=4:Aux PD1}{IOAI_trans_temp&0xff=5:Aux PD2}{IOAI_trans_temp&0xff=6:Aux PD3}{IOAI_" VALUE 0x001c878d /* @ECU_Address@IOAI_trans_temp@0x01006CB8@ */ ECIPP_ALIGNMENT_UBYTE 255 IOAI_trans_temp_COMPU_VTAB 0 255 BIT_MASK 0xff /end CHARACTERISTIC
/begin COMPU_METHOD IOAI_trans_temp_COMPU_VTAB "Verbal Table" TAB_VERB "%.0" "list" COMPU_TAB_REF IOAI_trans_temp_COMPU_VTAB_REF /end COMPU_METHOD
/begin COMPU_VTAB IOAI_trans_temp_COMPU_VTAB_REF "Verbal Table" TAB_VERB 32 0 "Disabled" 1 "Aux PU1" 2 "Aux PU2" 3 "Aux PU3" 4 "Aux PD1" 5 "Aux PD2" 6 "Aux PD3" 7 "Aux PUD1" 8 "Aux PUD2" 9 "Aux PUD3" 10 "Aux PUD4" 11 "Aux PUD5" 12 "Aux PUD6" 13 "Aux PUD7" 14 "Aux PUD8" 15 "Aux PUD9" 16 "Aux PUD10" 17 "Aux PUD11" 18 "Aux PUD12" 19 "Aux PUD13" 20 "Aux PUD14" 21 "Aux PUD15" 22 "Aux PUD16" 23 "Aux PUD17" 24 "Aux PUD18" 25 "Aux PUD19" 26 "Aux PUD20" 27 "Aux PUD21" 28 "Aux PUD22" 29 "Aux PUD23" 30 "Aux PUD24" 31 "Aux PUD25" DEFAULT_VALUE "UNKNOWN" /end COMPU_VTAB
/begin CHARACTERISTIC IOAI_brake_pedal_pos "Brake pedal position{IOAI_brake_pedal_pos&0xff=0:Disabled}{IOAI_brake_pedal_pos&0xff=1:Aux PU1}{IOAI_brake_pedal_pos&0xff=2:Aux PU2}{IOAI_brake_pedal_pos&0xff=3:Aux PU3}{IOAI_brake_pedal_pos&0xff=4:Aux PD1}{IOAI_brake_pedal_pos&0xff=5:Aux PD2}{IOAI_brake_" VALUE 0x001c8788 /* @ECU_Address@IOAI_brake_pedal_pos@0x01006CC0@ */ ECIPP_ALIGNMENT_UBYTE 255 IOAI_brake_pedal_pos_COMPU_VTAB 0 255 BIT_MASK 0xff /end CHARACTERISTIC
/begin COMPU_METHOD IOAI_brake_pedal_pos_COMPU_VTAB "Verbal Table" TAB_VERB "%.0" "list" COMPU_TAB_REF IOAI_brake_pedal_pos_COMPU_VTAB_REF /end COMPU_METHOD
/begin COMPU_VTAB IOAI_brake_pedal_pos_COMPU_VTAB_REF "Verbal Table" TAB_VERB 32 0 "Disabled" 1 "Aux PU1" 2 "Aux PU2" 3 "Aux PU3" 4 "Aux PD1" 5 "Aux PD2" 6 "Aux PD3" 7 "Aux PUD1" 8 "Aux PUD2" 9 "Aux PUD3" 10 "Aux PUD4" 11 "Aux PUD5" 12 "Aux PUD6" 13 "Aux PUD7" 14 "Aux PUD8" 15 "Aux PUD9" 16 "Aux PUD10" 17 "Aux PUD11" 18 "Aux PUD12" 19 "Aux PUD13" 20 "Aux PUD14" 21 "Aux PUD15" 22 "Aux PUD16" 23 "Aux PUD17" 24 "Aux PUD18" 25 "Aux PUD19" 26 "Aux PUD20" 27 "Aux PUD21" 28 "Aux PUD22" 29 "Aux PUD23" 30 "Aux PUD24" 31 "Aux PUD25" DEFAULT_VALUE "UNKNOWN" /end COMPU_VTAB
/begin CHARACTERISTIC IOAI_park_brake_pos "Parking brake position input{IOAI_park_brake_pos&0xff=0:Disabled}{IOAI_park_brake_pos&0xff=1:Aux PU1}{IOAI_park_brake_pos&0xff=2:Aux PU2}{IOAI_park_brake_pos&0xff=3:Aux PU3}{IOAI_park_brake_pos&0xff=4:Aux PD1}{IOAI_park_brake_pos&0xff=5:Aux PD2}{IOAI_park" VALUE 0x001c878b /* @ECU_Address@IOAI_park_brake_pos@0x01006CC8@ */ ECIPP_ALIGNMENT_UBYTE 255 IOAI_park_brake_pos_COMPU_VTAB 0 255 BIT_MASK 0xff /end CHARACTERISTIC
/begin COMPU_METHOD IOAI_park_brake_pos_COMPU_VTAB "Verbal Table" TAB_VERB "%.0" "list" COMPU_TAB_REF IOAI_park_brake_pos_COMPU_VTAB_REF /end COMPU_METHOD
/begin COMPU_VTAB IOAI_park_brake_pos_COMPU_VTAB_REF "Verbal Table" TAB_VERB 61 0 "Disabled" 1 "Aux PU1" 2 "Aux PU2" 3 "Aux PU3" 4 "Aux PD1" 5 "Aux PD2" 6 "Aux PD3" 7 "Aux PUD1" 8 "Aux PUD2" 9 "Aux PUD3" 10 "Aux PUD4" 11 "Aux PUD5" 12 "Aux PUD6" 13 "Aux PUD7" 14 "Aux PUD8" 15 "Aux PUD9" 16 "Aux PUD10" 17 "Aux PUD11" 18 "Aux PUD12" 19 "Aux PUD13" 20 "Aux PUD14" 21 "Aux PUD15" 22 "Aux PUD16" 23 "Aux PUD17" 24 "Aux PUD18" 25 "Aux PUD19" 26 "Aux PUD20" 27 "Aux PUD21" 28 "Aux PUD22" 29 "Aux PUD23" 30 "Aux PUD24" 31 "Aux PUD25" 32 "Aux PU1 = Gnd" 33 "Aux PU2 = Gnd" 34 "Aux PU3 = Gnd" 35 "Aux PUD1 = Gnd" 36 "Aux PUD2 = Gnd" 37 "Aux PUD3 = Gnd" 38 "Aux PUD4 = +V" 39 "Aux PUD5 = Gnd" 40 "Aux DIG1 = Gnd" 41 "Aux DIG2 = +V/Gnd" 42 "Aux DIG3 = Gnd" 43 "Aux DIG4 = +V/Gnd" 44 "Aux DIG5 = +V/Gnd" 45 "Aux DIG6 = +V/Gnd" 46 "Aux DIG7 = +V/Gnd" 47 "Aux DIG8 = +V/Gnd" 48 "Aux DIG9 = Gnd" 49 "Aux DIG10 = Gnd" 50 "Aux DIG11 = Gnd" 51 "Aux DIG12 = Gnd" 52 "Aux DIG13 = Gnd" 53 "Aux DIG14 = Gnd" 54 "Aux DIG15 = Gnd" 55 "Aux DIG16 = Gnd" 56 "Aux DIG17 = Gnd" 57 "Aux DIG18 = Gnd" 58 "Aux DIG19 = Gnd" 59 "Gov1 = Gnd" 60 "Gov2 = Gnd" DEFAULT_VALUE "UNKNOWN" /end COMPU_VTAB
/begin CHARACTERISTIC IOAI_seat_occupancy "Seat occupancy sensor{IOAI_seat_occupancy&0xff=0:Disabled}{IOAI_seat_occupancy&0xff=1:Aux PU1}{IOAI_seat_occupancy&0xff=2:Aux PU2}{IOAI_seat_occupancy&0xff=3:Aux PU3}{IOAI_seat_occupancy&0xff=4:Aux PD1}{IOAI_seat_occupancy&0xff=5:Aux PD2}{IOAI_seat_occupa" VALUE 0x001c878c /* @ECU_Address@IOAI_seat_occupancy@0x01006CD0@ */ ECIPP_ALIGNMENT_UBYTE 255 IOAI_seat_occupancy_COMPU_VTAB 0 255 BIT_MASK 0xff /end CHARACTERISTIC
/begin COMPU_METHOD IOAI_seat_occupancy_COMPU_VTAB "Verbal Table" TAB_VERB "%.0" "list" COMPU_TAB_REF IOAI_seat_occupancy_COMPU_VTAB_REF /end COMPU_METHOD
/begin COMPU_VTAB IOAI_seat_occupancy_COMPU_VTAB_REF "Verbal Table" TAB_VERB 32 0 "Disabled" 1 "Aux PU1" 2 "Aux PU2" 3 "Aux PU3" 4 "Aux PD1" 5 "Aux PD2" 6 "Aux PD3" 7 "Aux PUD1" 8 "Aux PUD2" 9 "Aux PUD3" 10 "Aux PUD4" 11 "Aux PUD5" 12 "Aux PUD6" 13 "Aux PUD7" 14 "Aux PUD8" 15 "Aux PUD9" 16 "Aux PUD10" 17 "Aux PUD11" 18 "Aux PUD12" 19 "Aux PUD13" 20 "Aux PUD14" 21 "Aux PUD15" 22 "Aux PUD16" 23 "Aux PUD17" 24 "Aux PUD18" 25 "Aux PUD19" 26 "Aux PUD20" 27 "Aux PUD21" 28 "Aux PUD22" 29 "Aux PUD23" 30 "Aux PUD24" 31 "Aux PUD25" DEFAULT_VALUE "UNKNOWN" /end COMPU_VTAB
/begin CHARACTERISTIC IODI_fuel_pressure "Fuel pressure sensor switch{IODI_fuel_pressure&0xff=0:Disabled}{IODI_fuel_pressure&0xff=1:Aux PU1 = Gnd}{IODI_fuel_pressure&0xff=2:Aux PU2 = Gnd}{IODI_fuel_pressure&0xff=3:Aux PU3 = Gnd}{IODI_fuel_pressure&0xff=4:Aux PUD1 = Gnd}{IODI_fuel_pressure&0xff=5:" VALUE 0x001c878f /* @ECU_Address@IODI_fuel_pressure@0x01006CD8@ */ ECIPP_ALIGNMENT_UBYTE 255 IODI_fuel_pressure_COMPU_VTAB 0 255 BIT_MASK 0xff /end CHARACTERISTIC
/begin COMPU_METHOD IODI_fuel_pressure_COMPU_VTAB "Verbal Table" TAB_VERB "%.0" "list" COMPU_TAB_REF IODI_fuel_pressure_COMPU_VTAB_REF /end COMPU_METHOD
/begin COMPU_VTAB IODI_fuel_pressure_COMPU_VTAB_REF "Verbal Table" TAB_VERB 30 0 "Disabled" 1 "Aux PU1 = Gnd" 2 "Aux PU2 = Gnd" 3 "Aux PU3 = Gnd" 4 "Aux PUD1 = Gnd" 5 "Aux PUD2 = Gnd" 6 "Aux PUD3 = Gnd" 7 "Aux PUD4 = +V" 8 "Aux PUD5 = Gnd" 9 "Aux DIG1 = Gnd" 10 "Aux DIG2 = +V/Gnd" 11 "Aux DIG3 = Gnd" 12 "Aux DIG4 = +V/Gnd" 13 "Aux DIG5 = +V/Gnd" 14 "Aux DIG6 = +V/Gnd" 15 "Aux DIG7 = +V/Gnd" 16 "Aux DIG8 = +V/Gnd" 17 "Aux DIG9 = Gnd" 18 "Aux DIG10 = Gnd" 19 "Aux DIG11 = Gnd" 20 "Aux DIG12 = Gnd" 21 "Aux DIG13 = Gnd" 22 "Aux DIG14 = Gnd" 23 "Aux DIG15 = Gnd" 24 "Aux DIG16 = Gnd" 25 "Aux DIG17 = Gnd" 26 "Aux DIG18 = Gnd" 27 "Aux DIG19 = Gnd" 28 "Gov1 = Gnd" 29 "Gov2 = Gnd" DEFAULT_VALUE "UNKNOWN" /end COMPU_VTAB
/begin CHARACTERISTIC IODI_brake_fluid_lvl "Brake fluid level switch{IODI_brake_fluid_lvl&0xff=0:Disabled}{IODI_brake_fluid_lvl&0xff=1:Aux PU1 = Gnd}{IODI_brake_fluid_lvl&0xff=2:Aux PU2 = Gnd}{IODI_brake_fluid_lvl&0xff=3:Aux PU3 = Gnd}{IODI_brake_fluid_lvl&0xff=4:Aux PUD1 = Gnd}{IODI_brake_fluid_lv" VALUE 0x001c878e /* @ECU_Address@IODI_brake_fluid_lvl@0x01006CE0@ */ ECIPP_ALIGNMENT_UBYTE 255 IODI_brake_fluid_lvl_COMPU_VTAB 0 255 BIT_MASK 0xff /end CHARACTERISTIC
/begin COMPU_METHOD IODI_brake_fluid_lvl_COMPU_VTAB "Verbal Table" TAB_VERB "%.0" "list" COMPU_TAB_REF IODI_brake_fluid_lvl_COMPU_VTAB_REF /end COMPU_METHOD
/begin COMPU_VTAB IODI_brake_fluid_lvl_COMPU_VTAB_REF "Verbal Table" TAB_VERB 30 0 "Disabled" 1 "Aux PU1 = Gnd" 2 "Aux PU2 = Gnd" 3 "Aux PU3 = Gnd" 4 "Aux PUD1 = Gnd" 5 "Aux PUD2 = Gnd" 6 "Aux PUD3 = Gnd" 7 "Aux PUD4 = +V" 8 "Aux PUD5 = Gnd" 9 "Aux DIG1 = Gnd" 10 "Aux DIG2 = +V/Gnd" 11 "Aux DIG3 = Gnd" 12 "Aux DIG4 = +V/Gnd" 13 "Aux DIG5 = +V/Gnd" 14 "Aux DIG6 = +V/Gnd" 15 "Aux DIG7 = +V/Gnd" 16 "Aux DIG8 = +V/Gnd" 17 "Aux DIG9 = Gnd" 18 "Aux DIG10 = Gnd" 19 "Aux DIG11 = Gnd" 20 "Aux DIG12 = Gnd" 21 "Aux DIG13 = Gnd" 22 "Aux DIG14 = Gnd" 23 "Aux DIG15 = Gnd" 24 "Aux DIG16 = Gnd" 25 "Aux DIG17 = Gnd" 26 "Aux DIG18 = Gnd" 27 "Aux DIG19 = Gnd" 28 "Gov1 = Gnd" 29 "Gov2 = Gnd" DEFAULT_VALUE "UNKNOWN" /end COMPU_VTAB
/begin CHARACTERISTIC SCC1_L "SCC 1 - Solenoid Inductance (L)" VALUE 0x001CA1E4 /* @ECU_Address@SCC1_L@0x01006CE8@ */ ECIPP_ALIGNMENT_FLOAT32_IEEE 10000000000 Compu_SCC1_L -10000000000 10000000000 /end CHARACTERISTIC
/begin COMPU_METHOD Compu_SCC1_L " " RAT_FUNC "%.0" "mH" COEFFS 0 0.001 0 0 0 1 /end COMPU_METHOD
/begin CHARACTERISTIC SCC1_R "SCC 1 - Solenoid Resistance (R)" VALUE 0x001CA1E8 /* @ECU_Address@SCC1_R@0x01006CF0@ */ ECIPP_ALIGNMENT_FLOAT32_IEEE 10000000000 Compu_SCC1_R -10000000000 10000000000 /end CHARACTERISTIC
/begin COMPU_METHOD Compu_SCC1_R " " RAT_FUNC "%.0" "Ohms" COEFFS 0 1 0 0 0 1 /end COMPU_METHOD
/begin CHARACTERISTIC SCC1_Vd "SCC 1 - Re-circulation diode voltage drop (Vd)" VALUE 0x001CA1EC /* @ECU_Address@SCC1_Vd@0x01006CF8@ */ ECIPP_ALIGNMENT_FLOAT32_IEEE 10000000000 Compu_SCC1_Vd -10000000000 10000000000 /end CHARACTERISTIC
/begin COMPU_METHOD Compu_SCC1_Vd " " RAT_FUNC "%.0" "Volts" COEFFS 0 1 0 0 0 1 /end COMPU_METHOD
/begin CHARACTERISTIC SCC1_Ki "SCC 1 - Ki_SCC" VALUE 0x001CA1FC /* @ECU_Address@SCC1_Ki@0x01006D00@ */ ECIPP_ALIGNMENT_FLOAT32_IEEE 10000000000 Compu_SCC1_Ki -10000000000 10000000000 /end CHARACTERISTIC
/begin COMPU_METHOD Compu_SCC1_Ki " " RAT_FUNC "%.0" "% / amp / sec" COEFFS 0 0.01 0 0 0 1 /end COMPU_METHOD
/begin CHARACTERISTIC SCC1_Imin "SCC 1 - I_SCC_min" VALUE 0x001CA204 /* @ECU_Address@SCC1_Imin@0x01006D08@ */ ECIPP_ALIGNMENT_FLOAT32_IEEE 10000000000 Compu_SCC1_Imin -10000000000 10000000000 /end CHARACTERISTIC
/begin COMPU_METHOD Compu_SCC1_Imin " " RAT_FUNC "%.0" "%" COEFFS 0 0.01 0 0 0 1 /end COMPU_METHOD
/begin CHARACTERISTIC SCC1_Imax "SCC 1 - I_SCC_max" VALUE 0x001CA200 /* @ECU_Address@SCC1_Imax@0x01006D10@ */ ECIPP_ALIGNMENT_FLOAT32_IEEE 10000000000 Compu_SCC1_Imax -10000000000 10000000000 /end CHARACTERISTIC
/begin COMPU_METHOD Compu_SCC1_Imax " " RAT_FUNC "%.0" "%" COEFFS 0 0.01 0 0 0 1 /end COMPU_METHOD
/begin CHARACTERISTIC SCC1_cmd_min "SCC 1 - Minimum Command Threshold" VALUE 0x001CA1F4 /* @ECU_Address@SCC1_cmd_min@0x01006D18@ */ ECIPP_ALIGNMENT_FLOAT32_IEEE 10000000000 Compu_SCC1_cmd_min -10000000000 10000000000 /end CHARACTERISTIC
/begin COMPU_METHOD Compu_SCC1_cmd_min " " RAT_FUNC "%.0" "mA" COEFFS 0 0.001 0 0 0 1 /end COMPU_METHOD
/begin CHARACTERISTIC SCC1_calc_min "SCC 1 - I_fall Calculation Threshold" VALUE 0x001CA1F0 /* @ECU_Address@SCC1_calc_min@0x01006D20@ */ ECIPP_ALIGNMENT_FLOAT32_IEEE 10000000000 Compu_SCC1_calc_min -10000000000 10000000000 /end CHARACTERISTIC
/begin COMPU_METHOD Compu_SCC1_calc_min " " RAT_FUNC "%.0" "mA" COEFFS 0 0.001 0 0 0 1 /end COMPU_METHOD
/begin CHARACTERISTIC SCC2_L "SCC 2 - Solenoid Inductance (L)" VALUE 0x001CA20C /* @ECU_Address@SCC2_L@0x01006D28@ */ ECIPP_ALIGNMENT_FLOAT32_IEEE 10000000000 Compu_SCC2_L -10000000000 10000000000 /end CHARACTERISTIC
/begin COMPU_METHOD Compu_SCC2_L " " RAT_FUNC "%.0" "mH" COEFFS 0 0.001 0 0 0 1 /end COMPU_METHOD
/begin CHARACTERISTIC SCC2_R "SCC 2 - Solenoid Resistance (R)" VALUE 0x001CA210 /* @ECU_Address@SCC2_R@0x01006D30@ */ ECIPP_ALIGNMENT_FLOAT32_IEEE 10000000000 Compu_SCC2_R -10000000000 10000000000 /end CHARACTERISTIC
/begin COMPU_METHOD Compu_SCC2_R " " RAT_FUNC "%.0" "Ohms" COEFFS 0 1 0 0 0 1 /end COMPU_METHOD
/begin CHARACTERISTIC SCC2_Vd "SCC 2 - Re-circulation diode voltage drop (Vd)" VALUE 0x001CA214 /* @ECU_Address@SCC2_Vd@0x01006D38@ */ ECIPP_ALIGNMENT_FLOAT32_IEEE 10000000000 Compu_SCC2_Vd -10000000000 10000000000 /end CHARACTERISTIC
/begin COMPU_METHOD Compu_SCC2_Vd " " RAT_FUNC "%.0" "Volts" COEFFS 0 1 0 0 0 1 /end COMPU_METHOD
/begin CHARACTERISTIC SCC2_Ki "SCC 2 - Ki_SCC" VALUE 0x001CA224 /* @ECU_Address@SCC2_Ki@0x01006D40@ */ ECIPP_ALIGNMENT_FLOAT32_IEEE 10000000000 Compu_SCC2_Ki -10000000000 10000000000 /end CHARACTERISTIC
/begin COMPU_METHOD Compu_SCC2_Ki " " RAT_FUNC "%.0" "% / amp / sec" COEFFS 0 0.01 0 0 0 1 /end COMPU_METHOD
/begin CHARACTERISTIC SCC2_Imin "SCC 2 - I_SCC_min" VALUE 0x001CA22C /* @ECU_Address@SCC2_Imin@0x01006D48@ */ ECIPP_ALIGNMENT_FLOAT32_IEEE 10000000000 Compu_SCC2_Imin -10000000000 10000000000 /end CHARACTERISTIC
/begin COMPU_METHOD Compu_SCC2_Imin " " RAT_FUNC "%.0" "%" COEFFS 0 0.01 0 0 0 1 /end COMPU_METHOD
/begin CHARACTERISTIC SCC2_Imax "SCC 2 - I_SCC_max" VALUE 0x001CA228 /* @ECU_Address@SCC2_Imax@0x01006D50@ */ ECIPP_ALIGNMENT_FLOAT32_IEEE 10000000000 Compu_SCC2_Imax -10000000000 10000000000 /end CHARACTERISTIC
/begin COMPU_METHOD Compu_SCC2_Imax " " RAT_FUNC "%.0" "%" COEFFS 0 0.01 0 0 0 1 /end COMPU_METHOD
/begin CHARACTERISTIC SCC2_cmd_min "SCC 2 - Minimum Command Threshold" VALUE 0x001CA21C /* @ECU_Address@SCC2_cmd_min@0x01006D58@ */ ECIPP_ALIGNMENT_FLOAT32_IEEE 10000000000 Compu_SCC2_cmd_min -10000000000 10000000000 /end CHARACTERISTIC
/begin COMPU_METHOD Compu_SCC2_cmd_min " " RAT_FUNC "%.0" "mA" COEFFS 0 0.001 0 0 0 1 /end COMPU_METHOD
/begin CHARACTERISTIC SCC2_calc_min "SCC 2 - I_fall Calculation Threshold" VALUE 0x001CA218 /* @ECU_Address@SCC2_calc_min@0x01006D60@ */ ECIPP_ALIGNMENT_FLOAT32_IEEE 10000000000 Compu_SCC2_calc_min -10000000000 10000000000 /end CHARACTERISTIC
/begin COMPU_METHOD Compu_SCC2_calc_min " " RAT_FUNC "%.0" "mA" COEFFS 0 0.001 0 0 0 1 /end COMPU_METHOD
/begin CHARACTERISTIC SCC1_cmd_max "SCC 1 - Maximum Command Threshold" VALUE 0x001CA1F8 /* @ECU_Address@SCC1_cmd_max@0x01006D68@ */ ECIPP_ALIGNMENT_FLOAT32_IEEE 10000000000 Compu_SCC1_cmd_max -10000000000 10000000000 /end CHARACTERISTIC
/begin COMPU_METHOD Compu_SCC1_cmd_max " " RAT_FUNC "%.0" "mA" COEFFS 0 0.001 0 0 0 1 /end COMPU_METHOD
/begin CHARACTERISTIC SCC2_cmd_max "SCC 2 - Maximum Command Threshold" VALUE 0x001CA220 /* @ECU_Address@SCC2_cmd_max@0x01006D70@ */ ECIPP_ALIGNMENT_FLOAT32_IEEE 10000000000 Compu_SCC2_cmd_max -10000000000 10000000000 /end CHARACTERISTIC
/begin COMPU_METHOD Compu_SCC2_cmd_max " " RAT_FUNC "%.0" "mA" COEFFS 0 0.001 0 0 0 1 /end COMPU_METHOD
/begin MEASUREMENT SCC1_pwm_duty_cycle "SCC1 - PWM Duty Cycle" UWORD Compu_SCC1_pwm_duty_cycle 0 0 0 99.9984741210938 ECU_ADDRESS 0x01006D78 /end MEASUREMENT
/begin COMPU_METHOD Compu_SCC1_pwm_duty_cycle " " RAT_FUNC "%.0" "-" COEFFS 0 655.36 0 0 0 1 /end COMPU_METHOD
/begin MEASUREMENT SCC1_Iavg_d_mA "SCC1 - Iavg Command" UWORD Compu_SCC1_Iavg_d_mA 0 0 0 65535 ECU_ADDRESS 0x01006D80 /end MEASUREMENT
/begin COMPU_METHOD Compu_SCC1_Iavg_d_mA " " RAT_FUNC "%.0" "-" COEFFS 0 1 0 0 0 1 /end COMPU_METHOD
/begin MEASUREMENT SCC1_Iavg_a "SCC1 - Iavg Actual" FLOAT32_IEEE Compu_SCC1_Iavg_a 0 0 -10000000000 10000000000 ECU_ADDRESS 0x01006D88 /end MEASUREMENT
/begin COMPU_METHOD Compu_SCC1_Iavg_a " " RAT_FUNC "%.0" "-" COEFFS 0 0.001 0 0 0 1 /end COMPU_METHOD
/begin MEASUREMENT SCC1_I_acc "SCC1 - Integrator Value" FLOAT32_IEEE Compu_SCC1_I_acc 0 0 -10000000000 10000000000 ECU_ADDRESS 0x01006D90 /end MEASUREMENT
/begin COMPU_METHOD Compu_SCC1_I_acc " " RAT_FUNC "%.0" "-" COEFFS 0 0.01 0 0 0 1 /end COMPU_METHOD
/begin MEASUREMENT SCC2_pwm_duty_cycle "SCC2 - PWM Duty Cycle" UWORD Compu_SCC2_pwm_duty_cycle 0 0 0 99.9984741210938 ECU_ADDRESS 0x01006D98 /end MEASUREMENT
/begin COMPU_METHOD Compu_SCC2_pwm_duty_cycle " " RAT_FUNC "%.0" "-" COEFFS 0 655.36 0 0 0 1 /end COMPU_METHOD
/begin MEASUREMENT SCC2_Iavg_d_mA "SCC2 - Iavg Command" UWORD Compu_SCC2_Iavg_d_mA 0 0 0 65535 ECU_ADDRESS 0x01006DA0 /end MEASUREMENT
/begin COMPU_METHOD Compu_SCC2_Iavg_d_mA " " RAT_FUNC "%.0" "-" COEFFS 0 1 0 0 0 1 /end COMPU_METHOD
/begin MEASUREMENT SCC2_Iavg_a "SCC2 - Iavg Actual" FLOAT32_IEEE Compu_SCC2_Iavg_a 0 0 -10000000000 10000000000 ECU_ADDRESS 0x01006DA8 /end MEASUREMENT
/begin COMPU_METHOD Compu_SCC2_Iavg_a " " RAT_FUNC "%.0" "-" COEFFS 0 0.001 0 0 0 1 /end COMPU_METHOD
/begin MEASUREMENT SCC2_I_acc "SCC2 - Integrator Value" FLOAT32_IEEE Compu_SCC2_I_acc 0 0 -10000000000 10000000000 ECU_ADDRESS 0x01006DB0 /end MEASUREMENT
/begin COMPU_METHOD Compu_SCC2_I_acc " " RAT_FUNC "%.0" "-" COEFFS 0 0.01 0 0 0 1 /end COMPU_METHOD
/begin CHARACTERISTIC tach_override_dis "Tachometer output override{tach_override_dis&0xff=0:Allow Override}{tach_override_dis&0xff=1:Disable Override}" VALUE 0x001c9086 /* @ECU_Address@tach_override_dis@0x01007008@ */ ECIPP_ALIGNMENT_UBYTE 255 tach_override_dis_COMPU_VTAB 0 255 BIT_MASK 0xff /end CHARACTERISTIC
/begin COMPU_METHOD tach_override_dis_COMPU_VTAB "Verbal Table" TAB_VERB "%.0" "list" COMPU_TAB_REF tach_override_dis_COMPU_VTAB_REF /end COMPU_METHOD
/begin COMPU_VTAB tach_override_dis_COMPU_VTAB_REF "Verbal Table" TAB_VERB 2 0 "Allow Override" 1 "Disable Override" DEFAULT_VALUE "UNKNOWN" /end COMPU_VTAB
/begin MEASUREMENT IO_light_brake "IO_light_brake{IO_light_brake&0xc000=0x0000:OFF}{IO_light_brake&0xc000=0x4000:ON}" UWORD IO_light_brake_COMPU_VTAB 0 0 0 65535 ECU_ADDRESS 0x01007010 BIT_MASK 0xc000 /end MEASUREMENT
/begin COMPU_METHOD IO_light_brake_COMPU_VTAB "Verbal Table" TAB_VERB "%.0" "list" COMPU_TAB_REF IO_light_brake_COMPU_VTAB_REF /end COMPU_METHOD
/begin COMPU_VTAB IO_light_brake_COMPU_VTAB_REF "Verbal Table" TAB_VERB 2 0x0000 "OFF" 0x4000 "ON" DEFAULT_VALUE "UNKNOWN" /end COMPU_VTAB
/begin CHARACTERISTIC exhbrake_chan "Exhaust brake output{exhbrake_chan&0xff=0:Aux PWM1}{exhbrake_chan&0xff=1:Aux PWM2}{exhbrake_chan&0xff=2:Aux PWM3}{exhbrake_chan&0xff=3:Aux PWM4}{exhbrake_chan&0xff=4:Aux PWM5}{exhbrake_chan&0xff=5:Aux PWM6}{exhbrake_chan&0xff=6:Aux PWM7}{exhbrake_chan&0xf" VALUE 0x001c9011 /* @ECU_Address@exhbrake_chan@0x010072D0@ */ ECIPP_ALIGNMENT_UBYTE 255 exhbrake_chan_COMPU_VTAB 0 255 BIT_MASK 0xff /end CHARACTERISTIC
/begin COMPU_METHOD exhbrake_chan_COMPU_VTAB "Verbal Table" TAB_VERB "%.0" "list" COMPU_TAB_REF exhbrake_chan_COMPU_VTAB_REF /end COMPU_METHOD
/begin COMPU_VTAB exhbrake_chan_COMPU_VTAB_REF "Verbal Table" TAB_VERB 8 0 "Aux PWM1" 1 "Aux PWM2" 2 "Aux PWM3" 3 "Aux PWM4" 4 "Aux PWM5" 5 "Aux PWM6" 6 "Aux PWM7" 7 "Aux PWM8" DEFAULT_VALUE "UNKNOWN" /end COMPU_VTAB
/begin CHARACTERISTIC exhbrake_mode "Exhaust brake oper mode{exhbrake_mode&0xff=0:Disabled}{exhbrake_mode&0xff=1:Foot pedal at idle}{exhbrake_mode&0xff=2:Remotely controlled}{exhbrake_mode&0xff=3:Foot pedal at idle + remote}" VALUE 0x001c9012 /* @ECU_Address@exhbrake_mode@0x010072D8@ */ ECIPP_ALIGNMENT_UBYTE 255 exhbrake_mode_COMPU_VTAB 0 255 BIT_MASK 0xff /end CHARACTERISTIC
/begin COMPU_METHOD exhbrake_mode_COMPU_VTAB "Verbal Table" TAB_VERB "%.0" "list" COMPU_TAB_REF exhbrake_mode_COMPU_VTAB_REF /end COMPU_METHOD
/begin COMPU_VTAB exhbrake_mode_COMPU_VTAB_REF "Verbal Table" TAB_VERB 4 0 "Disabled" 1 "Foot pedal at idle" 2 "Remotely controlled" 3 "Foot pedal at idle + remote" DEFAULT_VALUE "UNKNOWN" /end COMPU_VTAB
/begin CHARACTERISTIC exhbrake_retard_pct "Exhaust brake retard pct" VALUE 0x001c842e /* @ECU_Address@exhbrake_retard_pct@0x010072E0@ */ ECIPP_ALIGNMENT_UWORD 100 Compu_exhbrake_retard_pct 0 99.9984741210938 /end CHARACTERISTIC
/begin COMPU_METHOD Compu_exhbrake_retard_pct " " RAT_FUNC "%.1" "%" COEFFS 0 655.36 0 0 0 1 /end COMPU_METHOD
/begin CHARACTERISTIC RBC_outofgear "Out-of-gear engine / exhaust brake{RBC_outofgear&0xff=0:Allow engagement}{RBC_outofgear&0xff=1:Do not engage}" VALUE 0x001c88ba /* @ECU_Address@RBC_outofgear@0x010078F0@ */ ECIPP_ALIGNMENT_UBYTE 255 RBC_outofgear_COMPU_VTAB 0 255 BIT_MASK 0xff /end CHARACTERISTIC
/begin COMPU_METHOD RBC_outofgear_COMPU_VTAB "Verbal Table" TAB_VERB "%.0" "list" COMPU_TAB_REF RBC_outofgear_COMPU_VTAB_REF /end COMPU_METHOD
/begin COMPU_VTAB RBC_outofgear_COMPU_VTAB_REF "Verbal Table" TAB_VERB 2 0 "Allow engagement" 1 "Do not engage" DEFAULT_VALUE "UNKNOWN" /end COMPU_VTAB
/begin CHARACTERISTIC RBC_enabled "Retarder braking enabled input{RBC_enabled&0xff=0:Retarders always enabled}{RBC_enabled&0xff=1:Aux PU1}{RBC_enabled&0xff=2:Aux PU2}{RBC_enabled&0xff=3:Aux PU3}{RBC_enabled&0xff=4:Aux PUD1 = +V}{RBC_enabled&0xff=5:Aux PUD2 = Gnd}{RBC_enabled&0xff=6:Aux PUD" VALUE 0x001c88b7 /* @ECU_Address@RBC_enabled@0x01007938@ */ ECIPP_ALIGNMENT_UBYTE 255 RBC_enabled_COMPU_VTAB 0 255 BIT_MASK 0xff /end CHARACTERISTIC
/begin COMPU_METHOD RBC_enabled_COMPU_VTAB "Verbal Table" TAB_VERB "%.0" "list" COMPU_TAB_REF RBC_enabled_COMPU_VTAB_REF /end COMPU_METHOD
/begin COMPU_VTAB RBC_enabled_COMPU_VTAB_REF "Verbal Table" TAB_VERB 21 0 "Retarders always enabled" 1 "Aux PU1" 2 "Aux PU2" 3 "Aux PU3" 4 "Aux PUD1 = +V" 5 "Aux PUD2 = Gnd" 6 "Aux PUD3 = +V" 7 "Aux DIG1" 8 "Aux DIG2" 9 "Aux DIG3" 10 "Aux DIG4" 11 "Aux DIG5" 12 "Aux DIG6" 13 "Aux DIG7" 14 "Aux DIG8" 15 "Aux DIG9" 16 "Aux DIG10" 17 "Aux DIG11" 18 "Aux DIG12" 19 "CAN sourced (legacy)" 20 "Disabled" DEFAULT_VALUE "UNKNOWN" /end COMPU_VTAB
/begin CHARACTERISTIC cfgout_IATon "IAT_on" VALUE 0x001CA45C /* @ECU_Address@cfgout_IATon@0x01007BF8@ */ ECIPP_ALIGNMENT_UWORD 564 Compu_cfgout_IATon -460 563.984375 /end CHARACTERISTIC
/begin COMPU_METHOD Compu_cfgout_IATon " " RAT_FUNC "%.1" "deg F" COEFFS 0 64 29440 0 0 1 /end COMPU_METHOD
/begin CHARACTERISTIC cfgout_IAToff "IAT_off" VALUE 0x001CA474 /* @ECU_Address@cfgout_IAToff@0x01007C00@ */ ECIPP_ALIGNMENT_UWORD 564 Compu_cfgout_IAToff -460 563.984375 /end CHARACTERISTIC
/begin COMPU_METHOD Compu_cfgout_IAToff " " RAT_FUNC "%.1" "deg F" COEFFS 0 64 29440 0 0 1 /end COMPU_METHOD
/begin CHARACTERISTIC cfgout_IATlon "and IAT is{cfgout_IATlon&0xff=0x00:Ignored}{cfgout_IATlon&0xff=0x01:<}{cfgout_IATlon&0xff=0x02:>}{cfgout_IATlon&0xff=0x03:<=}{cfgout_IATlon&0xff=0x04:>=}{cfgout_IATlon&0xff=0x05:=}{cfgout_IATlon&0xff=0x06:<>}" VALUE 0x001CA43A /* @ECU_Address@cfgout_IATlon@0x01007C08@ */ ECIPP_ALIGNMENT_UBYTE 255 cfgout_IATlon_COMPU_VTAB 0 255 BIT_MASK 0xff /end CHARACTERISTIC
/begin COMPU_METHOD cfgout_IATlon_COMPU_VTAB "Verbal Table" TAB_VERB "%.0" "list" COMPU_TAB_REF cfgout_IATlon_COMPU_VTAB_REF /end COMPU_METHOD
/begin COMPU_VTAB cfgout_IATlon_COMPU_VTAB_REF "Verbal Table" TAB_VERB 7 0x00 "Ignored" 0x01 "<" 0x02 ">" 0x03 "<=" 0x04 ">=" 0x05 "=" 0x06 "<>" DEFAULT_VALUE "UNKNOWN" /end COMPU_VTAB
/begin CHARACTERISTIC cfgout_IATloff "and IAT is{cfgout_IATloff&0xff=0x00:Ignored}{cfgout_IATloff&0xff=0x01:<}{cfgout_IATloff&0xff=0x02:>}{cfgout_IATloff&0xff=0x03:<=}{cfgout_IATloff&0xff=0x04:>=}{cfgout_IATloff&0xff=0x05:=}{cfgout_IATloff&0xff=0x06:<>}" VALUE 0x001CA446 /* @ECU_Address@cfgout_IATloff@0x01007C10@ */ ECIPP_ALIGNMENT_UBYTE 255 cfgout_IATloff_COMPU_VTAB 0 255 BIT_MASK 0xff /end CHARACTERISTIC
/begin COMPU_METHOD cfgout_IATloff_COMPU_VTAB "Verbal Table" TAB_VERB "%.0" "list" COMPU_TAB_REF cfgout_IATloff_COMPU_VTAB_REF /end COMPU_METHOD
/begin COMPU_VTAB cfgout_IATloff_COMPU_VTAB_REF "Verbal Table" TAB_VERB 7 0x00 "Ignored" 0x01 "<" 0x02 ">" 0x03 "<=" 0x04 ">=" 0x05 "=" 0x06 "<>" DEFAULT_VALUE "UNKNOWN" /end COMPU_VTAB
/begin CHARACTERISTIC cfgout2_IATon "IAT_on" VALUE 0x001CA4B4 /* @ECU_Address@cfgout2_IATon@0x01007C18@ */ ECIPP_ALIGNMENT_UWORD 564 Compu_cfgout2_IATon -460 563.984375 /end CHARACTERISTIC
/begin COMPU_METHOD Compu_cfgout2_IATon " " RAT_FUNC "%.1" "deg F" COEFFS 0 64 29440 0 0 1 /end COMPU_METHOD
/begin CHARACTERISTIC cfgout2_IAToff "IAT_off" VALUE 0x001CA4CC /* @ECU_Address@cfgout2_IAToff@0x01007C20@ */ ECIPP_ALIGNMENT_UWORD 564 Compu_cfgout2_IAToff -460 563.984375 /end CHARACTERISTIC
/begin COMPU_METHOD Compu_cfgout2_IAToff " " RAT_FUNC "%.1" "deg F" COEFFS 0 64 29440 0 0 1 /end COMPU_METHOD
/begin CHARACTERISTIC cfgout2_IATlon "and IAT is{cfgout2_IATlon&0xff=0x00:Ignored}{cfgout2_IATlon&0xff=0x01:<}{cfgout2_IATlon&0xff=0x02:>}{cfgout2_IATlon&0xff=0x03:<=}{cfgout2_IATlon&0xff=0x04:>=}{cfgout2_IATlon&0xff=0x05:=}{cfgout2_IATlon&0xff=0x06:<>}" VALUE 0x001CA492 /* @ECU_Address@cfgout2_IATlon@0x01007C28@ */ ECIPP_ALIGNMENT_UBYTE 255 cfgout2_IATlon_COMPU_VTAB 0 255 BIT_MASK 0xff /end CHARACTERISTIC
/begin COMPU_METHOD cfgout2_IATlon_COMPU_VTAB "Verbal Table" TAB_VERB "%.0" "list" COMPU_TAB_REF cfgout2_IATlon_COMPU_VTAB_REF /end COMPU_METHOD
/begin COMPU_VTAB cfgout2_IATlon_COMPU_VTAB_REF "Verbal Table" TAB_VERB 7 0x00 "Ignored" 0x01 "<" 0x02 ">" 0x03 "<=" 0x04 ">=" 0x05 "=" 0x06 "<>" DEFAULT_VALUE "UNKNOWN" /end COMPU_VTAB
/begin CHARACTERISTIC cfgout2_IATloff "and IAT is{cfgout2_IATloff&0xff=0x00:Ignored}{cfgout2_IATloff&0xff=0x01:<}{cfgout2_IATloff&0xff=0x02:>}{cfgout2_IATloff&0xff=0x03:<=}{cfgout2_IATloff&0xff=0x04:>=}{cfgout2_IATloff&0xff=0x05:=}{cfgout2_IATloff&0xff=0x06:<>}" VALUE 0x001CA49E /* @ECU_Address@cfgout2_IATloff@0x01007C30@ */ ECIPP_ALIGNMENT_UBYTE 255 cfgout2_IATloff_COMPU_VTAB 0 255 BIT_MASK 0xff /end CHARACTERISTIC
/begin COMPU_METHOD cfgout2_IATloff_COMPU_VTAB "Verbal Table" TAB_VERB "%.0" "list" COMPU_TAB_REF cfgout2_IATloff_COMPU_VTAB_REF /end COMPU_METHOD
/begin COMPU_VTAB cfgout2_IATloff_COMPU_VTAB_REF "Verbal Table" TAB_VERB 7 0x00 "Ignored" 0x01 "<" 0x02 ">" 0x03 "<=" 0x04 ">=" 0x05 "=" 0x06 "<>" DEFAULT_VALUE "UNKNOWN" /end COMPU_VTAB
/begin CHARACTERISTIC cfgout3_IATon "IAT_on" VALUE 0x001CA50C /* @ECU_Address@cfgout3_IATon@0x01007C38@ */ ECIPP_ALIGNMENT_UWORD 564 Compu_cfgout3_IATon -460 563.984375 /end CHARACTERISTIC
/begin COMPU_METHOD Compu_cfgout3_IATon " " RAT_FUNC "%.1" "deg F" COEFFS 0 64 29440 0 0 1 /end COMPU_METHOD
/begin CHARACTERISTIC cfgout3_IAToff "IAT_off" VALUE 0x001CA524 /* @ECU_Address@cfgout3_IAToff@0x01007C40@ */ ECIPP_ALIGNMENT_UWORD 564 Compu_cfgout3_IAToff -460 563.984375 /end CHARACTERISTIC
/begin COMPU_METHOD Compu_cfgout3_IAToff " " RAT_FUNC "%.1" "deg F" COEFFS 0 64 29440 0 0 1 /end COMPU_METHOD
/begin CHARACTERISTIC cfgout3_IATlon "and IAT is{cfgout3_IATlon&0xff=0x00:Ignored}{cfgout3_IATlon&0xff=0x01:<}{cfgout3_IATlon&0xff=0x02:>}{cfgout3_IATlon&0xff=0x03:<=}{cfgout3_IATlon&0xff=0x04:>=}{cfgout3_IATlon&0xff=0x05:=}{cfgout3_IATlon&0xff=0x06:<>}" VALUE 0x001CA4EA /* @ECU_Address@cfgout3_IATlon@0x01007C48@ */ ECIPP_ALIGNMENT_UBYTE 255 cfgout3_IATlon_COMPU_VTAB 0 255 BIT_MASK 0xff /end CHARACTERISTIC
/begin COMPU_METHOD cfgout3_IATlon_COMPU_VTAB "Verbal Table" TAB_VERB "%.0" "list" COMPU_TAB_REF cfgout3_IATlon_COMPU_VTAB_REF /end COMPU_METHOD
/begin COMPU_VTAB cfgout3_IATlon_COMPU_VTAB_REF "Verbal Table" TAB_VERB 7 0x00 "Ignored" 0x01 "<" 0x02 ">" 0x03 "<=" 0x04 ">=" 0x05 "=" 0x06 "<>" DEFAULT_VALUE "UNKNOWN" /end COMPU_VTAB
/begin CHARACTERISTIC cfgout3_IATloff "and IAT is{cfgout3_IATloff&0xff=0x00:Ignored}{cfgout3_IATloff&0xff=0x01:<}{cfgout3_IATloff&0xff=0x02:>}{cfgout3_IATloff&0xff=0x03:<=}{cfgout3_IATloff&0xff=0x04:>=}{cfgout3_IATloff&0xff=0x05:=}{cfgout3_IATloff&0xff=0x06:<>}" VALUE 0x001CA4F6 /* @ECU_Address@cfgout3_IATloff@0x01007C50@ */ ECIPP_ALIGNMENT_UBYTE 255 cfgout3_IATloff_COMPU_VTAB 0 255 BIT_MASK 0xff /end CHARACTERISTIC
/begin COMPU_METHOD cfgout3_IATloff_COMPU_VTAB "Verbal Table" TAB_VERB "%.0" "list" COMPU_TAB_REF cfgout3_IATloff_COMPU_VTAB_REF /end COMPU_METHOD
/begin COMPU_VTAB cfgout3_IATloff_COMPU_VTAB_REF "Verbal Table" TAB_VERB 7 0x00 "Ignored" 0x01 "<" 0x02 ">" 0x03 "<=" 0x04 ">=" 0x05 "=" 0x06 "<>" DEFAULT_VALUE "UNKNOWN" /end COMPU_VTAB
/begin CHARACTERISTIC BTN_stop_ena "Push button stop enabled{BTN_stop_ena&0xff=0:Disabled}{BTN_stop_ena&0xff=1:Enabled}" VALUE 0x001c868d /* @ECU_Address@BTN_stop_ena@0x01008A50@ */ ECIPP_ALIGNMENT_UBYTE 255 BTN_stop_ena_COMPU_VTAB 0 255 BIT_MASK 0xff /end CHARACTERISTIC
/begin COMPU_METHOD BTN_stop_ena_COMPU_VTAB "Verbal Table" TAB_VERB "%.0" "list" COMPU_TAB_REF BTN_stop_ena_COMPU_VTAB_REF /end COMPU_METHOD
/begin COMPU_VTAB BTN_stop_ena_COMPU_VTAB_REF "Verbal Table" TAB_VERB 2 0 "Disabled" 1 "Enabled" DEFAULT_VALUE "UNKNOWN" /end COMPU_VTAB
/begin CHARACTERISTIC BTN_stop_rpm_min "Push button stop rpm min" VALUE 0x001c6d84 /* @ECU_Address@BTN_stop_rpm_min@0x01008A58@ */ ECIPP_ALIGNMENT_UWORD 65535 Compu_BTN_stop_rpm_min 0 65535 /end CHARACTERISTIC
/begin COMPU_METHOD Compu_BTN_stop_rpm_min " " RAT_FUNC "%.0" "rpm" COEFFS 0 1 0 0 0 1 /end COMPU_METHOD
/begin CHARACTERISTIC BTN_stop_wt "Push button additional debounce" VALUE 0x001c6d86 /* @ECU_Address@BTN_stop_wt@0x01008A60@ */ ECIPP_ALIGNMENT_UWORD 65535 Compu_BTN_stop_wt 0 65535 /end CHARACTERISTIC
/begin COMPU_METHOD Compu_BTN_stop_wt " " RAT_FUNC "%.0" "ms" COEFFS 0 1 0 0 0 1 /end COMPU_METHOD
/begin CHARACTERISTIC MILblk_trigger_ena "Blink sequence trigger{MILblk_trigger_ena&0xff=0:Disabled}{MILblk_trigger_ena&0xff=1:Aux PU1 = Gnd}{MILblk_trigger_ena&0xff=2:Aux PU2 = Gnd}{MILblk_trigger_ena&0xff=3:Aux PU3 = Gnd}{MILblk_trigger_ena&0xff=4:Aux PUD1 = Gnd}{MILblk_trigger_ena&0xff=5:Aux P" VALUE 0x001e6df4 /* @ECU_Address@MILblk_trigger_ena@0x01008BF8@ */ ECIPP_ALIGNMENT_UBYTE 255 MILblk_trigger_ena_COMPU_VTAB 0 255 BIT_MASK 0xff /end CHARACTERISTIC
/begin COMPU_METHOD MILblk_trigger_ena_COMPU_VTAB "Verbal Table" TAB_VERB "%.0" "list" COMPU_TAB_REF MILblk_trigger_ena_COMPU_VTAB_REF /end COMPU_METHOD
/begin COMPU_VTAB MILblk_trigger_ena_COMPU_VTAB_REF "Verbal Table" TAB_VERB 30 0 "Disabled" 1 "Aux PU1 = Gnd" 2 "Aux PU2 = Gnd" 3 "Aux PU3 = Gnd" 4 "Aux PUD1 = Gnd" 5 "Aux PUD2 = Gnd" 6 "Aux PUD3 = Gnd" 7 "Aux PUD4 = +V" 8 "Aux PUD5 = Gnd" 9 "Aux DIG1" 10 "Aux DIG2" 11 "Aux DIG3" 12 "Aux DIG4" 13 "Aux DIG5" 14 "Aux DIG6" 15 "Aux DIG7" 16 "Aux DIG8" 17 "Aux DIG9" 18 "Aux DIG10" 19 "Aux DIG11" 20 "Aux DIG12" 21 "Aux DIG13" 22 "Aux DIG14" 23 "Aux DIG15" 24 "Aux DIG16" 25 "Aux DIG17" 26 "Aux DIG18" 27 "Aux DIG19" 28 "Gov1" 29 "Gov2" DEFAULT_VALUE "UNKNOWN" /end COMPU_VTAB
/begin CHARACTERISTIC ETC_loss_crank_wt "Trans in-gear ETC2 loss wait" VALUE 0x001c6f28 /* @ECU_Address@ETC_loss_crank_wt@0x01008C80@ */ ECIPP_ALIGNMENT_UWORD 65535 Compu_ETC_loss_crank_wt 0 65535 /end CHARACTERISTIC
/begin COMPU_METHOD Compu_ETC_loss_crank_wt " " RAT_FUNC "%.0" "ms" COEFFS 0 1 0 0 0 1 /end COMPU_METHOD
/begin CHARACTERISTIC autocrk_trig_windup "Auto-crank trigger wind-up mode{autocrk_trig_windup&0xff=0:When zero}{autocrk_trig_windup&0xff=1:Override}{autocrk_trig_windup&0xff=2:Start signal when zero}" VALUE 0x001c8f9f /* @ECU_Address@autocrk_trig_windup@0x01008C98@ */ ECIPP_ALIGNMENT_UBYTE 255 autocrk_trig_windup_COMPU_VTAB 0 255 BIT_MASK 0xff /end CHARACTERISTIC
/begin COMPU_METHOD autocrk_trig_windup_COMPU_VTAB "Verbal Table" TAB_VERB "%.0" "list" COMPU_TAB_REF autocrk_trig_windup_COMPU_VTAB_REF /end COMPU_METHOD
/begin COMPU_VTAB autocrk_trig_windup_COMPU_VTAB_REF "Verbal Table" TAB_VERB 3 0 "When zero" 1 "Override" 2 "Start signal when zero" DEFAULT_VALUE "UNKNOWN" /end COMPU_VTAB
/begin CHARACTERISTIC IODO_fuel_type_light "Fuel type indicator light output{IODO_fuel_type_light&0xff=0:Disabled}{IODO_fuel_type_light&0xff=1:Buzzer Output}{IODO_fuel_type_light&0xff=2:MIL Output}{IODO_fuel_type_light&0xff=3:TACH Output}{IODO_fuel_type_light&0xff=4:Starter Output}{IODO_fuel_type_l" VALUE 0x001c8791 /* @ECU_Address@IODO_fuel_type_light@0x01009228@ */ ECIPP_ALIGNMENT_UBYTE 255 IODO_fuel_type_light_COMPU_VTAB 0 255 BIT_MASK 0xff /end CHARACTERISTIC
/begin COMPU_METHOD IODO_fuel_type_light_COMPU_VTAB "Verbal Table" TAB_VERB "%.0" "list" COMPU_TAB_REF IODO_fuel_type_light_COMPU_VTAB_REF /end COMPU_METHOD
/begin COMPU_VTAB IODO_fuel_type_light_COMPU_VTAB_REF "Verbal Table" TAB_VERB 32 0 "Disabled" 1 "Buzzer Output" 2 "MIL Output" 3 "TACH Output" 4 "Starter Output" 5 "EGOH1" 6 "EGOH2" 7 "EGOH3" 8 "EGOH4" 9 "Aux PWM1" 10 "Aux PWM2" 11 "Aux PWM3" 12 "Aux PWM4" 13 "Aux PWM5" 14 "Aux PWM6" 15 "Aux PWM7" 16 "Aux PWM8" 17 "Aux PWM9" 18 "Aux PWM10" 19 "Aux PWM11" 20 "Aux PWM12" 21 "Aux PWM13" 22 "Aux PWM14" 23 "Aux PWM15" 24 "Aux PWM16" 25 "Aux PWM17" 26 "Aux PWM18" 27 "Aux PWM19" 28 "Aux PWM20" 29 "Aux PWM21" 30 "Aux PWM22" 31 "Aux PWM23" DEFAULT_VALUE "UNKNOWN" /end COMPU_VTAB
/begin CHARACTERISTIC fuel_type_indicate "Turn light on for this fuel type:{fuel_type_indicate&0xff=0x00:Gasoline}{fuel_type_indicate&0xff=0x01:Propane}{fuel_type_indicate&0xff=0x02:Natural Gas}" VALUE 0x001c9038 /* @ECU_Address@fuel_type_indicate@0x01009230@ */ ECIPP_ALIGNMENT_UBYTE 255 fuel_type_indicate_COMPU_VTAB 0 255 BIT_MASK 0xff /end CHARACTERISTIC
/begin COMPU_METHOD fuel_type_indicate_COMPU_VTAB "Verbal Table" TAB_VERB "%.0" "list" COMPU_TAB_REF fuel_type_indicate_COMPU_VTAB_REF /end COMPU_METHOD
/begin COMPU_VTAB fuel_type_indicate_COMPU_VTAB_REF "Verbal Table" TAB_VERB 3 0x00 "Gasoline" 0x01 "Propane" 0x02 "Natural Gas" DEFAULT_VALUE "UNKNOWN" /end COMPU_VTAB
/begin CHARACTERISTIC VSFan_ena "Fan control{VSFan_ena&0xff=0:Disabled}{VSFan_ena&0xff=1:Enabled}" VALUE 0x001c8f8e /* @ECU_Address@VSFan_ena@0x0100D6A8@ */ ECIPP_ALIGNMENT_UBYTE 255 VSFan_ena_COMPU_VTAB 0 255 BIT_MASK 0xff /end CHARACTERISTIC
/begin COMPU_METHOD VSFan_ena_COMPU_VTAB "Verbal Table" TAB_VERB "%.0" "list" COMPU_TAB_REF VSFan_ena_COMPU_VTAB_REF /end COMPU_METHOD
/begin COMPU_VTAB VSFan_ena_COMPU_VTAB_REF "Verbal Table" TAB_VERB 2 0 "Disabled" 1 "Enabled" DEFAULT_VALUE "UNKNOWN" /end COMPU_VTAB
/begin CHARACTERISTIC VSFan_channel "Fan PWM output channel{VSFan_channel&0xff=0:Aux PWM1}{VSFan_channel&0xff=1:Aux PWM2}{VSFan_channel&0xff=2:Aux PWM3}{VSFan_channel&0xff=3:Aux PWM4}{VSFan_channel&0xff=4:Aux PWM5}{VSFan_channel&0xff=5:Aux PWM6}{VSFan_channel&0xff=6:Aux PWM8}{VSFan_channel&0" VALUE 0x001c8f8d /* @ECU_Address@VSFan_channel@0x0100D6B0@ */ ECIPP_ALIGNMENT_UBYTE 255 VSFan_channel_COMPU_VTAB 0 255 BIT_MASK 0xff /end CHARACTERISTIC
/begin COMPU_METHOD VSFan_channel_COMPU_VTAB "Verbal Table" TAB_VERB "%.0" "list" COMPU_TAB_REF VSFan_channel_COMPU_VTAB_REF /end COMPU_METHOD
/begin COMPU_VTAB VSFan_channel_COMPU_VTAB_REF "Verbal Table" TAB_VERB 8 0 "Aux PWM1" 1 "Aux PWM2" 2 "Aux PWM3" 3 "Aux PWM4" 4 "Aux PWM5" 5 "Aux PWM6" 6 "Aux PWM8" 7 "Aux PWM9" DEFAULT_VALUE "UNKNOWN" /end COMPU_VTAB
/begin CHARACTERISTIC VSFan_output_Hz "Fan PWM frequency" VALUE 0x001c441c /* @ECU_Address@VSFan_output_Hz@0x0100D6B8@ */ ECIPP_ALIGNMENT_ULONG 10000000000 Compu_VSFan_output_Hz 0 10000000000 /end CHARACTERISTIC
/begin COMPU_METHOD Compu_VSFan_output_Hz " " RAT_FUNC "%.0" "Hz" COEFFS 0 0 1 0 0.00000005 0 /end COMPU_METHOD
/begin CHARACTERISTIC VSFan_pulses_rev "Fan speed scaling divisor" VALUE 0x001c8368 /* @ECU_Address@VSFan_pulses_rev@0x0100D6C0@ */ ECIPP_ALIGNMENT_UWORD 1024 Compu_VSFan_pulses_rev 0 1023.984375 /end CHARACTERISTIC
/begin COMPU_METHOD Compu_VSFan_pulses_rev " " RAT_FUNC "%.1" "pulses/rev" COEFFS 0 64 0 0 0 1 /end COMPU_METHOD
/begin CHARACTERISTIC VSFan_drive_ratio "Fan drive ratio" VALUE 0x001c834a /* @ECU_Address@VSFan_drive_ratio@0x0100D6C8@ */ ECIPP_ALIGNMENT_UWORD 4 Compu_VSFan_drive_ratio 0 3.99993896484375 /end CHARACTERISTIC
/begin COMPU_METHOD Compu_VSFan_drive_ratio " " RAT_FUNC "%.3" "ratio" COEFFS 0 16384 0 0 0 1 /end COMPU_METHOD
/begin CHARACTERISTIC VSFan_slip_x "Fan belt slip correction factor" VALUE 0x001c836e /* @ECU_Address@VSFan_slip_x@0x0100D6D0@ */ ECIPP_ALIGNMENT_UWORD 1 Compu_VSFan_slip_x 0 0.999984741210938 /end CHARACTERISTIC
/begin COMPU_METHOD Compu_VSFan_slip_x " " RAT_FUNC "%.2" "-" COEFFS 0 65536 0 0 0 1 /end COMPU_METHOD
/begin CHARACTERISTIC VSFan_ac "AC running fan max" VALUE 0x001c8340 /* @ECU_Address@VSFan_ac@0x0100D6D8@ */ ECIPP_ALIGNMENT_UWORD 100 Compu_VSFan_ac 0 99.9984741210938 /end CHARACTERISTIC
/begin COMPU_METHOD Compu_VSFan_ac " " RAT_FUNC "%.1" "%" COEFFS 0 655.36 0 0 0 1 /end COMPU_METHOD
/begin CHARACTERISTIC VSFan_drivebrake "Engine braking fan max" VALUE 0x001c834c /* @ECU_Address@VSFan_drivebrake@0x0100D6E0@ */ ECIPP_ALIGNMENT_UWORD 100 Compu_VSFan_drivebrake 0 99.9984741210938 /end CHARACTERISTIC
/begin COMPU_METHOD Compu_VSFan_drivebrake " " RAT_FUNC "%.1" "%" COEFFS 0 655.36 0 0 0 1 /end COMPU_METHOD
/begin CHARACTERISTIC VSFan_dz "Fan deadzone" VALUE 0x001c8362 /* @ECU_Address@VSFan_dz@0x0100D6E8@ */ ECIPP_ALIGNMENT_UWORD 100 Compu_VSFan_dz 0 99.9984741210938 /end CHARACTERISTIC
/begin COMPU_METHOD Compu_VSFan_dz " " RAT_FUNC "%.1" "%" COEFFS 0 655.36 0 0 0 1 /end COMPU_METHOD
/begin CHARACTERISTIC VSFan_off_DC "Fan disengage duty-cycle" VALUE 0x001c8366 /* @ECU_Address@VSFan_off_DC@0x0100D6F0@ */ ECIPP_ALIGNMENT_UWORD 100 Compu_VSFan_off_DC 0 99.9984741210938 /end CHARACTERISTIC
/begin COMPU_METHOD Compu_VSFan_off_DC " " RAT_FUNC "%.1" "%" COEFFS 0 655.36 0 0 0 1 /end COMPU_METHOD
/begin CHARACTERISTIC VSFan_inc_ldramp "Engine load ramp up rate" VALUE 0x001c8364 /* @ECU_Address@VSFan_inc_ldramp@0x0100D6F8@ */ ECIPP_ALIGNMENT_UWORD 200 Compu_VSFan_inc_ldramp 0 199.996948242188 /end CHARACTERISTIC
/begin COMPU_METHOD Compu_VSFan_inc_ldramp " " RAT_FUNC "%.1" "%" COEFFS 0 327.68 0 0 0 1 /end COMPU_METHOD
/begin CHARACTERISTIC VSFan_dec_ldramp "Engine load ramp down rate" VALUE 0x001c8348 /* @ECU_Address@VSFan_dec_ldramp@0x0100D700@ */ ECIPP_ALIGNMENT_UWORD 200 Compu_VSFan_dec_ldramp 0 199.996948242188 /end CHARACTERISTIC
/begin COMPU_METHOD Compu_VSFan_dec_ldramp " " RAT_FUNC "%.1" "%" COEFFS 0 327.68 0 0 0 1 /end COMPU_METHOD
/begin CHARACTERISTIC AC_sw_chan "AC request switch{AC_sw_chan&0xff=0:Disabled}{AC_sw_chan&0xff=1:Aux PU1 = Gnd}{AC_sw_chan&0xff=2:Aux PU2 = Gnd}{AC_sw_chan&0xff=3:Aux PU3 = Gnd}{AC_sw_chan&0xff=4:Aux PUD1 = Gnd}{AC_sw_chan&0xff=5:Aux PUD2 = Gnd}{AC_sw_chan&0xff=6:Aux PUD3 = Gnd}{AC_sw_ch" VALUE 0x001c866f /* @ECU_Address@AC_sw_chan@0x0100D730@ */ ECIPP_ALIGNMENT_UBYTE 255 AC_sw_chan_COMPU_VTAB 0 255 BIT_MASK 0xff /end CHARACTERISTIC
/begin COMPU_METHOD AC_sw_chan_COMPU_VTAB "Verbal Table" TAB_VERB "%.0" "list" COMPU_TAB_REF AC_sw_chan_COMPU_VTAB_REF /end COMPU_METHOD
/begin COMPU_VTAB AC_sw_chan_COMPU_VTAB_REF "Verbal Table" TAB_VERB 32 0 "Disabled" 1 "Aux PU1 = Gnd" 2 "Aux PU2 = Gnd" 3 "Aux PU3 = Gnd" 4 "Aux PUD1 = Gnd" 5 "Aux PUD2 = Gnd" 6 "Aux PUD3 = Gnd" 7 "Aux PUD4 = +V" 8 "Aux PUD5 = Gnd" 9 "Aux DIG1" 10 "Aux DIG2" 11 "Aux DIG3" 12 "Aux DIG4" 13 "Aux DIG5" 14 "Aux DIG6" 15 "Aux DIG7" 16 "Aux DIG8" 17 "Aux DIG9" 18 "Aux DIG10" 19 "Aux DIG11" 20 "Aux DIG12" 21 "Aux DIG13" 22 "Aux DIG14" 23 "Aux DIG15" 24 "Aux DIG16" 25 "Aux DIG17" 26 "Aux DIG18" 27 "Aux DIG19" 28 "Gov1" 29 "Gov2" 30 "CAN - PGN 65284" 31 "CAN - PGN 65295" DEFAULT_VALUE "UNKNOWN" /end COMPU_VTAB
/begin CHARACTERISTIC AC_ctl_chan "AC relay output{AC_ctl_chan&0xff=0:Disabled}{AC_ctl_chan&0xff=1:Aux PWM1}{AC_ctl_chan&0xff=2:Aux PWM2}{AC_ctl_chan&0xff=3:Aux PWM3}{AC_ctl_chan&0xff=4:Aux PWM4}{AC_ctl_chan&0xff=5:Aux PWM5}{AC_ctl_chan&0xff=6:Aux PWM6}{AC_ctl_chan&0xff=7:Aux PWM7}{AC_ctl_" VALUE 0x001c866b /* @ECU_Address@AC_ctl_chan@0x0100D738@ */ ECIPP_ALIGNMENT_UBYTE 255 AC_ctl_chan_COMPU_VTAB 0 255 BIT_MASK 0xff /end CHARACTERISTIC
/begin COMPU_METHOD AC_ctl_chan_COMPU_VTAB "Verbal Table" TAB_VERB "%.0" "list" COMPU_TAB_REF AC_ctl_chan_COMPU_VTAB_REF /end COMPU_METHOD
/begin COMPU_VTAB AC_ctl_chan_COMPU_VTAB_REF "Verbal Table" TAB_VERB 16 0 "Disabled" 1 "Aux PWM1" 2 "Aux PWM2" 3 "Aux PWM3" 4 "Aux PWM4" 5 "Aux PWM5" 6 "Aux PWM6" 7 "Aux PWM7" 8 "Aux PWM8" 9 "Aux PWM9" 10 "Aux PWM10" 11 "Aux PWM11" 12 "Aux PWM12" 13 "Aux PWM13" 14 "Aux PWM14" 15 "Aux PWM15" DEFAULT_VALUE "UNKNOWN" /end COMPU_VTAB
/begin CHARACTERISTIC AC_idle_rpm "AC idle target" VALUE 0x001c6d5c /* @ECU_Address@AC_idle_rpm@0x0100D740@ */ ECIPP_ALIGNMENT_UWORD 65535 Compu_AC_idle_rpm 0 65535 /end CHARACTERISTIC
/begin COMPU_METHOD Compu_AC_idle_rpm " " RAT_FUNC "%.0" "rpm" COEFFS 0 1 0 0 0 1 /end COMPU_METHOD
/begin CHARACTERISTIC AC_ctl_mode "AC control mode{AC_ctl_mode&0xff=0:Disabled}{AC_ctl_mode&0xff=1:Use Boost TEI}" VALUE 0x001c866c /* @ECU_Address@AC_ctl_mode@0x0100D748@ */ ECIPP_ALIGNMENT_UBYTE 255 AC_ctl_mode_COMPU_VTAB 0 255 BIT_MASK 0xff /end CHARACTERISTIC
/begin COMPU_METHOD AC_ctl_mode_COMPU_VTAB "Verbal Table" TAB_VERB "%.0" "list" COMPU_TAB_REF AC_ctl_mode_COMPU_VTAB_REF /end COMPU_METHOD
/begin COMPU_VTAB AC_ctl_mode_COMPU_VTAB_REF "Verbal Table" TAB_VERB 2 0 "Disabled" 1 "Use Boost TEI" DEFAULT_VALUE "UNKNOWN" /end COMPU_VTAB
/begin CHARACTERISTIC AC_ctl_mode_t "AC control minimum off-time" VALUE 0x001c6d5a /* @ECU_Address@AC_ctl_mode_t@0x0100D750@ */ ECIPP_ALIGNMENT_UWORD 65535 Compu_AC_ctl_mode_t 0 65535 /end CHARACTERISTIC
/begin COMPU_METHOD Compu_AC_ctl_mode_t " " RAT_FUNC "%.0" "ms" COEFFS 0 1 0 0 0 1 /end COMPU_METHOD
/begin CHARACTERISTIC MILblk_trigger_cfg "Blink Aux DIG config{MILblk_trigger_cfg&0xff=0:Default}{MILblk_trigger_cfg&0xff=1:GND}{MILblk_trigger_cfg&0xff=2:GND/+V}{MILblk_trigger_cfg&0xff=3:+V}{MILblk_trigger_cfg&0xff=4:Open}" VALUE 0x001e6df3 /* @ECU_Address@MILblk_trigger_cfg@0x0100D770@ */ ECIPP_ALIGNMENT_UBYTE 255 MILblk_trigger_cfg_COMPU_VTAB 0 255 BIT_MASK 0xff /end CHARACTERISTIC
/begin COMPU_METHOD MILblk_trigger_cfg_COMPU_VTAB "Verbal Table" TAB_VERB "%.0" "list" COMPU_TAB_REF MILblk_trigger_cfg_COMPU_VTAB_REF /end COMPU_METHOD
/begin COMPU_VTAB MILblk_trigger_cfg_COMPU_VTAB_REF "Verbal Table" TAB_VERB 5 0 "Default" 1 "GND" 2 "GND/+V" 3 "+V" 4 "Open" DEFAULT_VALUE "UNKNOWN" /end COMPU_VTAB
/begin CHARACTERISTIC MILblk_input_moment "Blink switch type{MILblk_input_moment&0xff=0:Toggle switch}{MILblk_input_moment&0xff=1:Momentary switch}" VALUE 0x001e6dee /* @ECU_Address@MILblk_input_moment@0x0100D7C8@ */ ECIPP_ALIGNMENT_UBYTE 255 MILblk_input_moment_COMPU_VTAB 0 255 BIT_MASK 0xff /end CHARACTERISTIC
/begin COMPU_METHOD MILblk_input_moment_COMPU_VTAB "Verbal Table" TAB_VERB "%.0" "list" COMPU_TAB_REF MILblk_input_moment_COMPU_VTAB_REF /end COMPU_METHOD
/begin COMPU_VTAB MILblk_input_moment_COMPU_VTAB_REF "Verbal Table" TAB_VERB 2 0 "Toggle switch" 1 "Momentary switch" DEFAULT_VALUE "UNKNOWN" /end COMPU_VTAB
/begin CHARACTERISTIC AC_sw_chan_cfg "AC request Aux DIG config{AC_sw_chan_cfg&0xff=0:Default}{AC_sw_chan_cfg&0xff=1:GND}{AC_sw_chan_cfg&0xff=2:GND/+V}{AC_sw_chan_cfg&0xff=3:+V}{AC_sw_chan_cfg&0xff=4:Open}" VALUE 0x001c8670 /* @ECU_Address@AC_sw_chan_cfg@0x0100D858@ */ ECIPP_ALIGNMENT_UBYTE 255 AC_sw_chan_cfg_COMPU_VTAB 0 255 BIT_MASK 0xff /end CHARACTERISTIC
/begin COMPU_METHOD AC_sw_chan_cfg_COMPU_VTAB "Verbal Table" TAB_VERB "%.0" "list" COMPU_TAB_REF AC_sw_chan_cfg_COMPU_VTAB_REF /end COMPU_METHOD
/begin COMPU_VTAB AC_sw_chan_cfg_COMPU_VTAB_REF "Verbal Table" TAB_VERB 5 0 "Default" 1 "GND" 2 "GND/+V" 3 "+V" 4 "Open" DEFAULT_VALUE "UNKNOWN" /end COMPU_VTAB
/begin CHARACTERISTIC MIL_output_chan "MIL output channel{MIL_output_chan&0xff=0:MIL}{MIL_output_chan&0xff=1:Buzzer Output}{MIL_output_chan&0xff=2:Aux PWM1}{MIL_output_chan&0xff=3:Aux PWM2}{MIL_output_chan&0xff=4:Aux PWM3}{MIL_output_chan&0xff=5:Aux PWM4}{MIL_output_chan&0xff=6:Aux PWM5}{MIL_o" VALUE 0x001c8831 /* @ECU_Address@MIL_output_chan@0x0100D860@ */ ECIPP_ALIGNMENT_UBYTE 255 MIL_output_chan_COMPU_VTAB 0 255 BIT_MASK 0xff /end CHARACTERISTIC
/begin COMPU_METHOD MIL_output_chan_COMPU_VTAB "Verbal Table" TAB_VERB "%.0" "list" COMPU_TAB_REF MIL_output_chan_COMPU_VTAB_REF /end COMPU_METHOD
/begin COMPU_VTAB MIL_output_chan_COMPU_VTAB_REF "Verbal Table" TAB_VERB 12 0 "MIL" 1 "Buzzer Output" 2 "Aux PWM1" 3 "Aux PWM2" 4 "Aux PWM3" 5 "Aux PWM4" 6 "Aux PWM5" 7 "Aux PWM6" 8 "Aux PWM7" 9 "Aux PWM8" 10 "Aux PWM9" 11 "Starter Output" DEFAULT_VALUE "UNKNOWN" /end COMPU_VTAB
/begin CHARACTERISTIC crank_trans_lim "Trans in-gear override limit" VALUE 0x001c83ec /* @ECU_Address@crank_trans_lim@0x0100D8B8@ */ ECIPP_ALIGNMENT_UWORD 66 Compu_crank_trans_lim 0 65.535 /end CHARACTERISTIC
/begin COMPU_METHOD Compu_crank_trans_lim " " RAT_FUNC "%.1" "sec" COEFFS 0 1000 0 0 0 1 /end COMPU_METHOD
/begin CHARACTERISTIC AC_ctl_min_ECT "AC control minimum ECT" VALUE 0x001c6d56 /* @ECU_Address@AC_ctl_min_ECT@0x0100DAF8@ */ ECIPP_ALIGNMENT_UWORD 564 Compu_AC_ctl_min_ECT -460 563.984375 /end CHARACTERISTIC
/begin COMPU_METHOD Compu_AC_ctl_min_ECT " " RAT_FUNC "%.1" "deg F" COEFFS 0 64 29440 0 0 1 /end COMPU_METHOD
/begin CHARACTERISTIC AC_ctl_min_RPM "AC control minimum RPM" VALUE 0x001c6d58 /* @ECU_Address@AC_ctl_min_RPM@0x0100DB00@ */ ECIPP_ALIGNMENT_UWORD 65535 Compu_AC_ctl_min_RPM 0 65535 /end CHARACTERISTIC
/begin COMPU_METHOD Compu_AC_ctl_min_RPM " " RAT_FUNC "%.0" "rpm" COEFFS 0 1 0 0 0 1 /end COMPU_METHOD
/begin CHARACTERISTIC AC_ctl_max_RPM "AC control maximum RPM" VALUE 0x001c6d54 /* @ECU_Address@AC_ctl_max_RPM@0x0100DB08@ */ ECIPP_ALIGNMENT_UWORD 65535 Compu_AC_ctl_max_RPM 0 65535 /end CHARACTERISTIC
/begin COMPU_METHOD Compu_AC_ctl_max_RPM " " RAT_FUNC "%.0" "rpm" COEFFS 0 1 0 0 0 1 /end COMPU_METHOD
/begin CHARACTERISTIC RBC_ABS_disable "Retarder disabled by ABS{RBC_ABS_disable&0xff=0:No}{RBC_ABS_disable&0xff=1:Yes}" VALUE 0x001c88b3 /* @ECU_Address@RBC_ABS_disable@0x0100DB30@ */ ECIPP_ALIGNMENT_UBYTE 255 RBC_ABS_disable_COMPU_VTAB 0 255 BIT_MASK 0xff /end CHARACTERISTIC
/begin COMPU_METHOD RBC_ABS_disable_COMPU_VTAB "Verbal Table" TAB_VERB "%.0" "list" COMPU_TAB_REF RBC_ABS_disable_COMPU_VTAB_REF /end COMPU_METHOD
/begin COMPU_VTAB RBC_ABS_disable_COMPU_VTAB_REF "Verbal Table" TAB_VERB 2 0 "No" 1 "Yes" DEFAULT_VALUE "UNKNOWN" /end COMPU_VTAB
/begin CHARACTERISTIC RBC_min_ECT_ena "Retarder disabled by min ECT{RBC_min_ECT_ena&0xff=0:No}{RBC_min_ECT_ena&0xff=1:Yes}" VALUE 0x001c88b9 /* @ECU_Address@RBC_min_ECT_ena@0x0100E588@ */ ECIPP_ALIGNMENT_UBYTE 255 RBC_min_ECT_ena_COMPU_VTAB 0 255 BIT_MASK 0xff /end CHARACTERISTIC
/begin COMPU_METHOD RBC_min_ECT_ena_COMPU_VTAB "Verbal Table" TAB_VERB "%.0" "list" COMPU_TAB_REF RBC_min_ECT_ena_COMPU_VTAB_REF /end COMPU_METHOD
/begin COMPU_VTAB RBC_min_ECT_ena_COMPU_VTAB_REF "Verbal Table" TAB_VERB 2 0 "No" 1 "Yes" DEFAULT_VALUE "UNKNOWN" /end COMPU_VTAB
/begin CHARACTERISTIC RBC_min_ECT_override "Retarder run time override ECT" VALUE 0x001c42d8 /* @ECU_Address@RBC_min_ECT_override@0x0100E590@ */ ECIPP_ALIGNMENT_ULONG 4294967 Compu_RBC_min_ECT_override 0 4294967.295 /end CHARACTERISTIC
/begin COMPU_METHOD Compu_RBC_min_ECT_override " " RAT_FUNC "%.1" "sec" COEFFS 0 1000 0 0 0 1 /end COMPU_METHOD
/begin CHARACTERISTIC drivebrake_min_ECT "Driveline brake minimum ECT" VALUE 0x001c8416 /* @ECU_Address@drivebrake_min_ECT@0x0100E598@ */ ECIPP_ALIGNMENT_UWORD 564 Compu_drivebrake_min_ECT -460 563.984375 /end CHARACTERISTIC
/begin COMPU_METHOD Compu_drivebrake_min_ECT " " RAT_FUNC "%.1" "deg F" COEFFS 0 64 29440 0 0 1 /end COMPU_METHOD
/begin CHARACTERISTIC exhbrake_min_ECT "Exhaust brake minimum ECT" VALUE 0x001c842c /* @ECU_Address@exhbrake_min_ECT@0x0100E5A0@ */ ECIPP_ALIGNMENT_UWORD 564 Compu_exhbrake_min_ECT -460 563.984375 /end CHARACTERISTIC
/begin COMPU_METHOD Compu_exhbrake_min_ECT " " RAT_FUNC "%.1" "deg F" COEFFS 0 64 29440 0 0 1 /end COMPU_METHOD
/begin CHARACTERISTIC RBC_enabled_cfg "Retarder braking Aux DIG config{RBC_enabled_cfg&0xff=0:Default}{RBC_enabled_cfg&0xff=1:GND}{RBC_enabled_cfg&0xff=2:GND/+V}{RBC_enabled_cfg&0xff=3:+V}{RBC_enabled_cfg&0xff=4:Open}" VALUE 0x001c88b8 /* @ECU_Address@RBC_enabled_cfg@0x0100EE88@ */ ECIPP_ALIGNMENT_UBYTE 255 RBC_enabled_cfg_COMPU_VTAB 0 255 BIT_MASK 0xff /end CHARACTERISTIC
/begin COMPU_METHOD RBC_enabled_cfg_COMPU_VTAB "Verbal Table" TAB_VERB "%.0" "list" COMPU_TAB_REF RBC_enabled_cfg_COMPU_VTAB_REF /end COMPU_METHOD
/begin COMPU_VTAB RBC_enabled_cfg_COMPU_VTAB_REF "Verbal Table" TAB_VERB 5 0 "Default" 1 "GND" 2 "GND/+V" 3 "+V" 4 "Open" DEFAULT_VALUE "UNKNOWN" /end COMPU_VTAB
/begin CHARACTERISTIC fc_blink_output "Blink output channel{fc_blink_output&0xff=0:MIL}{fc_blink_output&0xff=1:Soft warning}{fc_blink_output&0xff=2:Hard warning}" VALUE 0x001ecc9b /* @ECU_Address@fc_blink_output@0x0100F8D8@ */ ECIPP_ALIGNMENT_UBYTE 255 fc_blink_output_COMPU_VTAB 0 255 BIT_MASK 0xff /end CHARACTERISTIC
/begin COMPU_METHOD fc_blink_output_COMPU_VTAB "Verbal Table" TAB_VERB "%.0" "list" COMPU_TAB_REF fc_blink_output_COMPU_VTAB_REF /end COMPU_METHOD
/begin COMPU_VTAB fc_blink_output_COMPU_VTAB_REF "Verbal Table" TAB_VERB 3 0 "MIL" 1 "Soft warning" 2 "Hard warning" DEFAULT_VALUE "UNKNOWN" /end COMPU_VTAB
/begin CHARACTERISTIC cfgout1_dg_input_on "DIG_input_on{cfgout1_dg_input_on&0xff=0:Aux DIG1}{cfgout1_dg_input_on&0xff=1:Aux DIG2}{cfgout1_dg_input_on&0xff=2:Aux DIG3}{cfgout1_dg_input_on&0xff=3:Aux DIG4}{cfgout1_dg_input_on&0xff=4:Aux DIG5}{cfgout1_dg_input_on&0xff=5:Aux DIG6}{cfgout1_dg_input_on&" VALUE 0x001CA42A /* @ECU_Address@cfgout1_dg_input_on@0x01010638@ */ ECIPP_ALIGNMENT_UBYTE 255 cfgout1_dg_input_on_COMPU_VTAB 0 255 BIT_MASK 0xff /end CHARACTERISTIC
/begin COMPU_METHOD cfgout1_dg_input_on_COMPU_VTAB "Verbal Table" TAB_VERB "%.0" "list" COMPU_TAB_REF cfgout1_dg_input_on_COMPU_VTAB_REF /end COMPU_METHOD
/begin COMPU_VTAB cfgout1_dg_input_on_COMPU_VTAB_REF "Verbal Table" TAB_VERB 25 0 "Aux DIG1" 1 "Aux DIG2" 2 "Aux DIG3" 3 "Aux DIG4" 4 "Aux DIG5" 5 "Aux DIG6" 6 "Aux DIG7" 7 "Aux DIG8" 8 "Aux DIG9" 9 "Aux DIG10" 10 "Aux DIG11" 11 "Aux DIG12" 12 "Aux DIG13" 13 "Aux DIG14" 14 "Aux DIG15" 15 "Aux DIG16" 16 "Aux DIG17" 17 "Aux DIG18" 18 "Aux DIG19" 19 "Aux DIG20" 20 "Aux DIG21" 21 "Aux DIG22" 22 "Aux DIG23" 23 "Aux DIG24" 24 "Aux DIG25" DEFAULT_VALUE "UNKNOWN" /end COMPU_VTAB
/begin CHARACTERISTIC cfgout1_dg_input_off "DIG input off{cfgout1_dg_input_off&0xff=0:Aux DIG1}{cfgout1_dg_input_off&0xff=1:Aux DIG2}{cfgout1_dg_input_off&0xff=2:Aux DIG3}{cfgout1_dg_input_off&0xff=3:Aux DIG4}{cfgout1_dg_input_off&0xff=4:Aux DIG5}{cfgout1_dg_input_off&0xff=5:Aux DIG6}{cfgout1_dg_in" VALUE 0x001CA42B /* @ECU_Address@cfgout1_dg_input_off@0x01010640@ */ ECIPP_ALIGNMENT_UBYTE 255 cfgout1_dg_input_off_COMPU_VTAB 0 255 BIT_MASK 0xff /end CHARACTERISTIC
/begin COMPU_METHOD cfgout1_dg_input_off_COMPU_VTAB "Verbal Table" TAB_VERB "%.0" "list" COMPU_TAB_REF cfgout1_dg_input_off_COMPU_VTAB_REF /end COMPU_METHOD
/begin COMPU_VTAB cfgout1_dg_input_off_COMPU_VTAB_REF "Verbal Table" TAB_VERB 25 0 "Aux DIG1" 1 "Aux DIG2" 2 "Aux DIG3" 3 "Aux DIG4" 4 "Aux DIG5" 5 "Aux DIG6" 6 "Aux DIG7" 7 "Aux DIG8" 8 "Aux DIG9" 9 "Aux DIG10" 10 "Aux DIG11" 11 "Aux DIG12" 12 "Aux DIG13" 13 "Aux DIG14" 14 "Aux DIG15" 15 "Aux DIG16" 16 "Aux DIG17" 17 "Aux DIG18" 18 "Aux DIG19" 19 "Aux DIG20" 20 "Aux DIG21" 21 "Aux DIG22" 22 "Aux DIG23" 23 "Aux DIG24" 24 "Aux DIG25" DEFAULT_VALUE "UNKNOWN" /end COMPU_VTAB
/begin CHARACTERISTIC cfgout2_dg_input_on "DIG input on{cfgout2_dg_input_on&0xff=0:Aux DIG1}{cfgout2_dg_input_on&0xff=1:Aux DIG2}{cfgout2_dg_input_on&0xff=2:Aux DIG3}{cfgout2_dg_input_on&0xff=3:Aux DIG4}{cfgout2_dg_input_on&0xff=4:Aux DIG5}{cfgout2_dg_input_on&0xff=5:Aux DIG6}{cfgout2_dg_input_on&" VALUE 0x001CA482 /* @ECU_Address@cfgout2_dg_input_on@0x01010648@ */ ECIPP_ALIGNMENT_UBYTE 255 cfgout2_dg_input_on_COMPU_VTAB 0 255 BIT_MASK 0xff /end CHARACTERISTIC
/begin COMPU_METHOD cfgout2_dg_input_on_COMPU_VTAB "Verbal Table" TAB_VERB "%.0" "list" COMPU_TAB_REF cfgout2_dg_input_on_COMPU_VTAB_REF /end COMPU_METHOD
/begin COMPU_VTAB cfgout2_dg_input_on_COMPU_VTAB_REF "Verbal Table" TAB_VERB 25 0 "Aux DIG1" 1 "Aux DIG2" 2 "Aux DIG3" 3 "Aux DIG4" 4 "Aux DIG5" 5 "Aux DIG6" 6 "Aux DIG7" 7 "Aux DIG8" 8 "Aux DIG9" 9 "Aux DIG10" 10 "Aux DIG11" 11 "Aux DIG12" 12 "Aux DIG13" 13 "Aux DIG14" 14 "Aux DIG15" 15 "Aux DIG16" 16 "Aux DIG17" 17 "Aux DIG18" 18 "Aux DIG19" 19 "Aux DIG20" 20 "Aux DIG21" 21 "Aux DIG22" 22 "Aux DIG23" 23 "Aux DIG24" 24 "Aux DIG25" DEFAULT_VALUE "UNKNOWN" /end COMPU_VTAB
/begin CHARACTERISTIC cfgout2_dg_input_off "DIG input off{cfgout2_dg_input_off&0xff=0:Aux DIG1}{cfgout2_dg_input_off&0xff=1:Aux DIG2}{cfgout2_dg_input_off&0xff=2:Aux DIG3}{cfgout2_dg_input_off&0xff=3:Aux DIG4}{cfgout2_dg_input_off&0xff=4:Aux DIG5}{cfgout2_dg_input_off&0xff=5:Aux DIG6}{cfgout2_dg_in" VALUE 0x001CA483 /* @ECU_Address@cfgout2_dg_input_off@0x01010650@ */ ECIPP_ALIGNMENT_UBYTE 255 cfgout2_dg_input_off_COMPU_VTAB 0 255 BIT_MASK 0xff /end CHARACTERISTIC
/begin COMPU_METHOD cfgout2_dg_input_off_COMPU_VTAB "Verbal Table" TAB_VERB "%.0" "list" COMPU_TAB_REF cfgout2_dg_input_off_COMPU_VTAB_REF /end COMPU_METHOD
/begin COMPU_VTAB cfgout2_dg_input_off_COMPU_VTAB_REF "Verbal Table" TAB_VERB 25 0 "Aux DIG1" 1 "Aux DIG2" 2 "Aux DIG3" 3 "Aux DIG4" 4 "Aux DIG5" 5 "Aux DIG6" 6 "Aux DIG7" 7 "Aux DIG8" 8 "Aux DIG9" 9 "Aux DIG10" 10 "Aux DIG11" 11 "Aux DIG12" 12 "Aux DIG13" 13 "Aux DIG14" 14 "Aux DIG15" 15 "Aux DIG16" 16 "Aux DIG17" 17 "Aux DIG18" 18 "Aux DIG19" 19 "Aux DIG20" 20 "Aux DIG21" 21 "Aux DIG22" 22 "Aux DIG23" 23 "Aux DIG24" 24 "Aux DIG25" DEFAULT_VALUE "UNKNOWN" /end COMPU_VTAB
/begin CHARACTERISTIC cfgout3_dg_input_on "DIG input on{cfgout3_dg_input_on&0xff=0:Aux DIG1}{cfgout3_dg_input_on&0xff=1:Aux DIG2}{cfgout3_dg_input_on&0xff=2:Aux DIG3}{cfgout3_dg_input_on&0xff=3:Aux DIG4}{cfgout3_dg_input_on&0xff=4:Aux DIG5}{cfgout3_dg_input_on&0xff=5:Aux DIG6}{cfgout3_dg_input_on&" VALUE 0x001CA4DA /* @ECU_Address@cfgout3_dg_input_on@0x01010658@ */ ECIPP_ALIGNMENT_UBYTE 255 cfgout3_dg_input_on_COMPU_VTAB 0 255 BIT_MASK 0xff /end CHARACTERISTIC
/begin COMPU_METHOD cfgout3_dg_input_on_COMPU_VTAB "Verbal Table" TAB_VERB "%.0" "list" COMPU_TAB_REF cfgout3_dg_input_on_COMPU_VTAB_REF /end COMPU_METHOD
/begin COMPU_VTAB cfgout3_dg_input_on_COMPU_VTAB_REF "Verbal Table" TAB_VERB 25 0 "Aux DIG1" 1 "Aux DIG2" 2 "Aux DIG3" 3 "Aux DIG4" 4 "Aux DIG5" 5 "Aux DIG6" 6 "Aux DIG7" 7 "Aux DIG8" 8 "Aux DIG9" 9 "Aux DIG10" 10 "Aux DIG11" 11 "Aux DIG12" 12 "Aux DIG13" 13 "Aux DIG14" 14 "Aux DIG15" 15 "Aux DIG16" 16 "Aux DIG17" 17 "Aux DIG18" 18 "Aux DIG19" 19 "Aux DIG20" 20 "Aux DIG21" 21 "Aux DIG22" 22 "Aux DIG23" 23 "Aux DIG24" 24 "Aux DIG25" DEFAULT_VALUE "UNKNOWN" /end COMPU_VTAB
/begin CHARACTERISTIC cfgout3_dg_input_off "DIG input off{cfgout3_dg_input_off&0xff=0:Aux DIG1}{cfgout3_dg_input_off&0xff=1:Aux DIG2}{cfgout3_dg_input_off&0xff=2:Aux DIG3}{cfgout3_dg_input_off&0xff=3:Aux DIG4}{cfgout3_dg_input_off&0xff=4:Aux DIG5}{cfgout3_dg_input_off&0xff=5:Aux DIG6}{cfgout3_dg_in" VALUE 0x001CA4DB /* @ECU_Address@cfgout3_dg_input_off@0x01010660@ */ ECIPP_ALIGNMENT_UBYTE 255 cfgout3_dg_input_off_COMPU_VTAB 0 255 BIT_MASK 0xff /end CHARACTERISTIC
/begin COMPU_METHOD cfgout3_dg_input_off_COMPU_VTAB "Verbal Table" TAB_VERB "%.0" "list" COMPU_TAB_REF cfgout3_dg_input_off_COMPU_VTAB_REF /end COMPU_METHOD
/begin COMPU_VTAB cfgout3_dg_input_off_COMPU_VTAB_REF "Verbal Table" TAB_VERB 25 0 "Aux DIG1" 1 "Aux DIG2" 2 "Aux DIG3" 3 "Aux DIG4" 4 "Aux DIG5" 5 "Aux DIG6" 6 "Aux DIG7" 7 "Aux DIG8" 8 "Aux DIG9" 9 "Aux DIG10" 10 "Aux DIG11" 11 "Aux DIG12" 12 "Aux DIG13" 13 "Aux DIG14" 14 "Aux DIG15" 15 "Aux DIG16" 16 "Aux DIG17" 17 "Aux DIG18" 18 "Aux DIG19" 19 "Aux DIG20" 20 "Aux DIG21" 21 "Aux DIG22" 22 "Aux DIG23" 23 "Aux DIG24" 24 "Aux DIG25" DEFAULT_VALUE "UNKNOWN" /end COMPU_VTAB
/begin CHARACTERISTIC cfgout1_pd_input_on "PD input on{cfgout1_pd_input_on&0xff=0:Aux PD1}{cfgout1_pd_input_on&0xff=1:Aux PD2}{cfgout1_pd_input_on&0xff=2:Aux PD3}{cfgout1_pd_input_on&0xff=3:Aux PUD1}{cfgout1_pd_input_on&0xff=4:Aux PUD2}{cfgout1_pd_input_on&0xff=5:Aux PUD3}{cfgout1_pd_input_on&0xff" VALUE 0x001CA42C /* @ECU_Address@cfgout1_pd_input_on@0x01010668@ */ ECIPP_ALIGNMENT_UBYTE 255 cfgout1_pd_input_on_COMPU_VTAB 0 255 BIT_MASK 0xff /end CHARACTERISTIC
/begin COMPU_METHOD cfgout1_pd_input_on_COMPU_VTAB "Verbal Table" TAB_VERB "%.0" "list" COMPU_TAB_REF cfgout1_pd_input_on_COMPU_VTAB_REF /end COMPU_METHOD
/begin COMPU_VTAB cfgout1_pd_input_on_COMPU_VTAB_REF "Verbal Table" TAB_VERB 8 0 "Aux PD1" 1 "Aux PD2" 2 "Aux PD3" 3 "Aux PUD1" 4 "Aux PUD2" 5 "Aux PUD3" 6 "Aux PUD4" 7 "Aux PUD5" DEFAULT_VALUE "UNKNOWN" /end COMPU_VTAB
/begin CHARACTERISTIC cfgout1_pd_input_off "PD input off{cfgout1_pd_input_off&0xff=0:Aux PD1}{cfgout1_pd_input_off&0xff=1:Aux PD2}{cfgout1_pd_input_off&0xff=2:Aux PD3}{cfgout1_pd_input_off&0xff=3:Aux PUD1}{cfgout1_pd_input_off&0xff=4:Aux PUD2}{cfgout1_pd_input_off&0xff=5:Aux PUD3}{cfgout1_pd_input_" VALUE 0x001CA42D /* @ECU_Address@cfgout1_pd_input_off@0x01010670@ */ ECIPP_ALIGNMENT_UBYTE 255 cfgout1_pd_input_off_COMPU_VTAB 0 255 BIT_MASK 0xff /end CHARACTERISTIC
/begin COMPU_METHOD cfgout1_pd_input_off_COMPU_VTAB "Verbal Table" TAB_VERB "%.0" "list" COMPU_TAB_REF cfgout1_pd_input_off_COMPU_VTAB_REF /end COMPU_METHOD
/begin COMPU_VTAB cfgout1_pd_input_off_COMPU_VTAB_REF "Verbal Table" TAB_VERB 8 0 "Aux PD1" 1 "Aux PD2" 2 "Aux PD3" 3 "Aux PUD1" 4 "Aux PUD2" 5 "Aux PUD3" 6 "Aux PUD4" 7 "Aux PUD5" DEFAULT_VALUE "UNKNOWN" /end COMPU_VTAB
/begin CHARACTERISTIC cfgout2_pd_input_on "PD input on{cfgout2_pd_input_on&0xff=0:Aux PD1}{cfgout2_pd_input_on&0xff=1:Aux PD2}{cfgout2_pd_input_on&0xff=2:Aux PD3}{cfgout2_pd_input_on&0xff=3:Aux PUD1}{cfgout2_pd_input_on&0xff=4:Aux PUD2}{cfgout2_pd_input_on&0xff=5:Aux PUD3}{cfgout2_pd_input_on&0xff" VALUE 0x001CA484 /* @ECU_Address@cfgout2_pd_input_on@0x01010678@ */ ECIPP_ALIGNMENT_UBYTE 255 cfgout2_pd_input_on_COMPU_VTAB 0 255 BIT_MASK 0xff /end CHARACTERISTIC
/begin COMPU_METHOD cfgout2_pd_input_on_COMPU_VTAB "Verbal Table" TAB_VERB "%.0" "list" COMPU_TAB_REF cfgout2_pd_input_on_COMPU_VTAB_REF /end COMPU_METHOD
/begin COMPU_VTAB cfgout2_pd_input_on_COMPU_VTAB_REF "Verbal Table" TAB_VERB 8 0 "Aux PD1" 1 "Aux PD2" 2 "Aux PD3" 3 "Aux PUD1" 4 "Aux PUD2" 5 "Aux PUD3" 6 "Aux PUD4" 7 "Aux PUD5" DEFAULT_VALUE "UNKNOWN" /end COMPU_VTAB
/begin CHARACTERISTIC cfgout2_pd_input_off "PD input off{cfgout2_pd_input_off&0xff=0:Aux PD1}{cfgout2_pd_input_off&0xff=1:Aux PD2}{cfgout2_pd_input_off&0xff=2:Aux PD3}{cfgout2_pd_input_off&0xff=3:Aux PUD1}{cfgout2_pd_input_off&0xff=4:Aux PUD2}{cfgout2_pd_input_off&0xff=5:Aux PUD3}{cfgout2_pd_input_" VALUE 0x001CA485 /* @ECU_Address@cfgout2_pd_input_off@0x01010680@ */ ECIPP_ALIGNMENT_UBYTE 255 cfgout2_pd_input_off_COMPU_VTAB 0 255 BIT_MASK 0xff /end CHARACTERISTIC
/begin COMPU_METHOD cfgout2_pd_input_off_COMPU_VTAB "Verbal Table" TAB_VERB "%.0" "list" COMPU_TAB_REF cfgout2_pd_input_off_COMPU_VTAB_REF /end COMPU_METHOD
/begin COMPU_VTAB cfgout2_pd_input_off_COMPU_VTAB_REF "Verbal Table" TAB_VERB 8 0 "Aux PD1" 1 "Aux PD2" 2 "Aux PD3" 3 "Aux PUD1" 4 "Aux PUD2" 5 "Aux PUD3" 6 "Aux PUD4" 7 "Aux PUD5" DEFAULT_VALUE "UNKNOWN" /end COMPU_VTAB
/begin CHARACTERISTIC cfgout3_pd_input_on "PD input on{cfgout3_pd_input_on&0xff=0:Aux PD1}{cfgout3_pd_input_on&0xff=1:Aux PD2}{cfgout3_pd_input_on&0xff=2:Aux PD3}{cfgout3_pd_input_on&0xff=3:Aux PUD1}{cfgout3_pd_input_on&0xff=4:Aux PUD2}{cfgout3_pd_input_on&0xff=5:Aux PUD3}{cfgout3_pd_input_on&0xff" VALUE 0x001CA4DC /* @ECU_Address@cfgout3_pd_input_on@0x01010688@ */ ECIPP_ALIGNMENT_UBYTE 255 cfgout3_pd_input_on_COMPU_VTAB 0 255 BIT_MASK 0xff /end CHARACTERISTIC
/begin COMPU_METHOD cfgout3_pd_input_on_COMPU_VTAB "Verbal Table" TAB_VERB "%.0" "list" COMPU_TAB_REF cfgout3_pd_input_on_COMPU_VTAB_REF /end COMPU_METHOD
/begin COMPU_VTAB cfgout3_pd_input_on_COMPU_VTAB_REF "Verbal Table" TAB_VERB 8 0 "Aux PD1" 1 "Aux PD2" 2 "Aux PD3" 3 "Aux PUD1" 4 "Aux PUD2" 5 "Aux PUD3" 6 "Aux PUD4" 7 "Aux PUD5" DEFAULT_VALUE "UNKNOWN" /end COMPU_VTAB
/begin CHARACTERISTIC cfgout3_pd_input_off "PD input off{cfgout3_pd_input_off&0xff=0:Aux PD1}{cfgout3_pd_input_off&0xff=1:Aux PD2}{cfgout3_pd_input_off&0xff=2:Aux PD3}{cfgout3_pd_input_off&0xff=3:Aux PUD1}{cfgout3_pd_input_off&0xff=4:Aux PUD2}{cfgout3_pd_input_off&0xff=5:Aux PUD3}{cfgout3_pd_input_" VALUE 0x001CA4DD /* @ECU_Address@cfgout3_pd_input_off@0x01010690@ */ ECIPP_ALIGNMENT_UBYTE 255 cfgout3_pd_input_off_COMPU_VTAB 0 255 BIT_MASK 0xff /end CHARACTERISTIC
/begin COMPU_METHOD cfgout3_pd_input_off_COMPU_VTAB "Verbal Table" TAB_VERB "%.0" "list" COMPU_TAB_REF cfgout3_pd_input_off_COMPU_VTAB_REF /end COMPU_METHOD
/begin COMPU_VTAB cfgout3_pd_input_off_COMPU_VTAB_REF "Verbal Table" TAB_VERB 8 0 "Aux PD1" 1 "Aux PD2" 2 "Aux PD3" 3 "Aux PUD1" 4 "Aux PUD2" 5 "Aux PUD3" 6 "Aux PUD4" 7 "Aux PUD5" DEFAULT_VALUE "UNKNOWN" /end COMPU_VTAB
/begin CHARACTERISTIC cfgout1_pu_input_on "PU input on{cfgout1_pu_input_on&0xff=0:Aux PU1}{cfgout1_pu_input_on&0xff=1:Aux PU2}{cfgout1_pu_input_on&0xff=2:Aux PU3}{cfgout1_pu_input_on&0xff=3:Aux PUD1}{cfgout1_pu_input_on&0xff=4:Aux PUD2}{cfgout1_pu_input_on&0xff=5:Aux PUD3}{cfgout1_pu_input_on&0xff" VALUE 0x001CA42E /* @ECU_Address@cfgout1_pu_input_on@0x01010698@ */ ECIPP_ALIGNMENT_UBYTE 255 cfgout1_pu_input_on_COMPU_VTAB 0 255 BIT_MASK 0xff /end CHARACTERISTIC
/begin COMPU_METHOD cfgout1_pu_input_on_COMPU_VTAB "Verbal Table" TAB_VERB "%.0" "list" COMPU_TAB_REF cfgout1_pu_input_on_COMPU_VTAB_REF /end COMPU_METHOD
/begin COMPU_VTAB cfgout1_pu_input_on_COMPU_VTAB_REF "Verbal Table" TAB_VERB 8 0 "Aux PU1" 1 "Aux PU2" 2 "Aux PU3" 3 "Aux PUD1" 4 "Aux PUD2" 5 "Aux PUD3" 6 "Aux PUD4" 7 "Aux PUD5" DEFAULT_VALUE "UNKNOWN" /end COMPU_VTAB
/begin CHARACTERISTIC cfgout1_pu_input_off "PU input off{cfgout1_pu_input_off&0xff=0:Aux PU1}{cfgout1_pu_input_off&0xff=1:Aux PU2}{cfgout1_pu_input_off&0xff=2:Aux PU3}{cfgout1_pu_input_off&0xff=3:Aux PUD1}{cfgout1_pu_input_off&0xff=4:Aux PUD2}{cfgout1_pu_input_off&0xff=5:Aux PUD3}{cfgout1_pu_input_" VALUE 0x001CA42F /* @ECU_Address@cfgout1_pu_input_off@0x010106A0@ */ ECIPP_ALIGNMENT_UBYTE 255 cfgout1_pu_input_off_COMPU_VTAB 0 255 BIT_MASK 0xff /end CHARACTERISTIC
/begin COMPU_METHOD cfgout1_pu_input_off_COMPU_VTAB "Verbal Table" TAB_VERB "%.0" "list" COMPU_TAB_REF cfgout1_pu_input_off_COMPU_VTAB_REF /end COMPU_METHOD
/begin COMPU_VTAB cfgout1_pu_input_off_COMPU_VTAB_REF "Verbal Table" TAB_VERB 8 0 "Aux PU1" 1 "Aux PU2" 2 "Aux PU3" 3 "Aux PUD1" 4 "Aux PUD2" 5 "Aux PUD3" 6 "Aux PUD4" 7 "Aux PUD5" DEFAULT_VALUE "UNKNOWN" /end COMPU_VTAB
/begin CHARACTERISTIC cfgout2_pu_input_on "PU input on{cfgout2_pu_input_on&0xff=0:Aux PU1}{cfgout2_pu_input_on&0xff=1:Aux PU2}{cfgout2_pu_input_on&0xff=2:Aux PU3}{cfgout2_pu_input_on&0xff=3:Aux PUD1}{cfgout2_pu_input_on&0xff=4:Aux PUD2}{cfgout2_pu_input_on&0xff=5:Aux PUD3}{cfgout2_pu_input_on&0xff" VALUE 0x001CA486 /* @ECU_Address@cfgout2_pu_input_on@0x010106A8@ */ ECIPP_ALIGNMENT_UBYTE 255 cfgout2_pu_input_on_COMPU_VTAB 0 255 BIT_MASK 0xff /end CHARACTERISTIC
/begin COMPU_METHOD cfgout2_pu_input_on_COMPU_VTAB "Verbal Table" TAB_VERB "%.0" "list" COMPU_TAB_REF cfgout2_pu_input_on_COMPU_VTAB_REF /end COMPU_METHOD
/begin COMPU_VTAB cfgout2_pu_input_on_COMPU_VTAB_REF "Verbal Table" TAB_VERB 8 0 "Aux PU1" 1 "Aux PU2" 2 "Aux PU3" 3 "Aux PUD1" 4 "Aux PUD2" 5 "Aux PUD3" 6 "Aux PUD4" 7 "Aux PUD5" DEFAULT_VALUE "UNKNOWN" /end COMPU_VTAB
/begin CHARACTERISTIC cfgout2_pu_input_off "PU input off{cfgout2_pu_input_off&0xff=0:Aux PU1}{cfgout2_pu_input_off&0xff=1:Aux PU2}{cfgout2_pu_input_off&0xff=2:Aux PU3}{cfgout2_pu_input_off&0xff=3:Aux PUD1}{cfgout2_pu_input_off&0xff=4:Aux PUD2}{cfgout2_pu_input_off&0xff=5:Aux PUD3}{cfgout2_pu_input_" VALUE 0x001CA487 /* @ECU_Address@cfgout2_pu_input_off@0x010106B0@ */ ECIPP_ALIGNMENT_UBYTE 255 cfgout2_pu_input_off_COMPU_VTAB 0 255 BIT_MASK 0xff /end CHARACTERISTIC
/begin COMPU_METHOD cfgout2_pu_input_off_COMPU_VTAB "Verbal Table" TAB_VERB "%.0" "list" COMPU_TAB_REF cfgout2_pu_input_off_COMPU_VTAB_REF /end COMPU_METHOD
/begin COMPU_VTAB cfgout2_pu_input_off_COMPU_VTAB_REF "Verbal Table" TAB_VERB 8 0 "Aux PU1" 1 "Aux PU2" 2 "Aux PU3" 3 "Aux PUD1" 4 "Aux PUD2" 5 "Aux PUD3" 6 "Aux PUD4" 7 "Aux PUD5" DEFAULT_VALUE "UNKNOWN" /end COMPU_VTAB
/begin CHARACTERISTIC cfgout3_pu_input_on "PU input on{cfgout3_pu_input_on&0xff=0:Aux PU1}{cfgout3_pu_input_on&0xff=1:Aux PU2}{cfgout3_pu_input_on&0xff=2:Aux PU3}{cfgout3_pu_input_on&0xff=3:Aux PUD1}{cfgout3_pu_input_on&0xff=4:Aux PUD2}{cfgout3_pu_input_on&0xff=5:Aux PUD3}{cfgout3_pu_input_on&0xff" VALUE 0x001CA4DE /* @ECU_Address@cfgout3_pu_input_on@0x010106B8@ */ ECIPP_ALIGNMENT_UBYTE 255 cfgout3_pu_input_on_COMPU_VTAB 0 255 BIT_MASK 0xff /end CHARACTERISTIC
/begin COMPU_METHOD cfgout3_pu_input_on_COMPU_VTAB "Verbal Table" TAB_VERB "%.0" "list" COMPU_TAB_REF cfgout3_pu_input_on_COMPU_VTAB_REF /end COMPU_METHOD
/begin COMPU_VTAB cfgout3_pu_input_on_COMPU_VTAB_REF "Verbal Table" TAB_VERB 8 0 "Aux PU1" 1 "Aux PU2" 2 "Aux PU3" 3 "Aux PUD1" 4 "Aux PUD2" 5 "Aux PUD3" 6 "Aux PUD4" 7 "Aux PUD5" DEFAULT_VALUE "UNKNOWN" /end COMPU_VTAB
/begin CHARACTERISTIC cfgout3_pu_input_off "PU input off{cfgout3_pu_input_off&0xff=0:Aux PU1}{cfgout3_pu_input_off&0xff=1:Aux PU2}{cfgout3_pu_input_off&0xff=2:Aux PU3}{cfgout3_pu_input_off&0xff=3:Aux PUD1}{cfgout3_pu_input_off&0xff=4:Aux PUD2}{cfgout3_pu_input_off&0xff=5:Aux PUD3}{cfgout3_pu_input_" VALUE 0x001CA4DF /* @ECU_Address@cfgout3_pu_input_off@0x010106C0@ */ ECIPP_ALIGNMENT_UBYTE 255 cfgout3_pu_input_off_COMPU_VTAB 0 255 BIT_MASK 0xff /end CHARACTERISTIC
/begin COMPU_METHOD cfgout3_pu_input_off_COMPU_VTAB "Verbal Table" TAB_VERB "%.0" "list" COMPU_TAB_REF cfgout3_pu_input_off_COMPU_VTAB_REF /end COMPU_METHOD
/begin COMPU_VTAB cfgout3_pu_input_off_COMPU_VTAB_REF "Verbal Table" TAB_VERB 8 0 "Aux PU1" 1 "Aux PU2" 2 "Aux PU3" 3 "Aux PUD1" 4 "Aux PUD2" 5 "Aux PUD3" 6 "Aux PUD4" 7 "Aux PUD5" DEFAULT_VALUE "UNKNOWN" /end COMPU_VTAB
/begin CHARACTERISTIC cfgout_OilLlon "and/or Oil Level is{cfgout_OilLlon&0xff=0x00:Ignored}{cfgout_OilLlon&0xff=0x01:<}{cfgout_OilLlon&0xff=0x02:>}{cfgout_OilLlon&0xff=0x03:<=}{cfgout_OilLlon&0xff=0x04:>=}{cfgout_OilLlon&0xff=0x05:=}{cfgout_OilLlon&0xff=0x06:<>}" VALUE 0x001CA43B /* @ECU_Address@cfgout_OilLlon@0x010109A8@ */ ECIPP_ALIGNMENT_UBYTE 255 cfgout_OilLlon_COMPU_VTAB 0 255 BIT_MASK 0xff /end CHARACTERISTIC
/begin COMPU_METHOD cfgout_OilLlon_COMPU_VTAB "Verbal Table" TAB_VERB "%.0" "list" COMPU_TAB_REF cfgout_OilLlon_COMPU_VTAB_REF /end COMPU_METHOD
/begin COMPU_VTAB cfgout_OilLlon_COMPU_VTAB_REF "Verbal Table" TAB_VERB 7 0x00 "Ignored" 0x01 "<" 0x02 ">" 0x03 "<=" 0x04 ">=" 0x05 "=" 0x06 "<>" DEFAULT_VALUE "UNKNOWN" /end COMPU_VTAB
/begin CHARACTERISTIC cfgout_OilLloff "and/or Oil Level is{cfgout_OilLloff&0xff=0x00:Ignored}{cfgout_OilLloff&0xff=0x01:<}{cfgout_OilLloff&0xff=0x02:>}{cfgout_OilLloff&0xff=0x03:<=}{cfgout_OilLloff&0xff=0x04:>=}{cfgout_OilLloff&0xff=0x05:=}{cfgout_OilLloff&0xff=0x06:<>}" VALUE 0x001CA447 /* @ECU_Address@cfgout_OilLloff@0x010109B0@ */ ECIPP_ALIGNMENT_UBYTE 255 cfgout_OilLloff_COMPU_VTAB 0 255 BIT_MASK 0xff /end CHARACTERISTIC
/begin COMPU_METHOD cfgout_OilLloff_COMPU_VTAB "Verbal Table" TAB_VERB "%.0" "list" COMPU_TAB_REF cfgout_OilLloff_COMPU_VTAB_REF /end COMPU_METHOD
/begin COMPU_VTAB cfgout_OilLloff_COMPU_VTAB_REF "Verbal Table" TAB_VERB 7 0x00 "Ignored" 0x01 "<" 0x02 ">" 0x03 "<=" 0x04 ">=" 0x05 "=" 0x06 "<>" DEFAULT_VALUE "UNKNOWN" /end COMPU_VTAB
/begin CHARACTERISTIC cfgout2_OilLlon "and/or Oil Level is{cfgout2_OilLlon&0xff=0x00:Ignored}{cfgout2_OilLlon&0xff=0x01:<}{cfgout2_OilLlon&0xff=0x02:>}{cfgout2_OilLlon&0xff=0x03:<=}{cfgout2_OilLlon&0xff=0x04:>=}{cfgout2_OilLlon&0xff=0x05:=}{cfgout2_OilLlon&0xff=0x06:<>}" VALUE 0x001CA493 /* @ECU_Address@cfgout2_OilLlon@0x010109B8@ */ ECIPP_ALIGNMENT_UBYTE 255 cfgout2_OilLlon_COMPU_VTAB 0 255 BIT_MASK 0xff /end CHARACTERISTIC
/begin COMPU_METHOD cfgout2_OilLlon_COMPU_VTAB "Verbal Table" TAB_VERB "%.0" "list" COMPU_TAB_REF cfgout2_OilLlon_COMPU_VTAB_REF /end COMPU_METHOD
/begin COMPU_VTAB cfgout2_OilLlon_COMPU_VTAB_REF "Verbal Table" TAB_VERB 7 0x00 "Ignored" 0x01 "<" 0x02 ">" 0x03 "<=" 0x04 ">=" 0x05 "=" 0x06 "<>" DEFAULT_VALUE "UNKNOWN" /end COMPU_VTAB
/begin CHARACTERISTIC cfgout2_OilLloff "and/or Oil Level is{cfgout2_OilLloff&0xff=0x00:Ignored}{cfgout2_OilLloff&0xff=0x01:<}{cfgout2_OilLloff&0xff=0x02:>}{cfgout2_OilLloff&0xff=0x03:<=}{cfgout2_OilLloff&0xff=0x04:>=}{cfgout2_OilLloff&0xff=0x05:=}{cfgout2_OilLloff&0xff=0x06:<>}" VALUE 0x001CA49F /* @ECU_Address@cfgout2_OilLloff@0x010109C0@ */ ECIPP_ALIGNMENT_UBYTE 255 cfgout2_OilLloff_COMPU_VTAB 0 255 BIT_MASK 0xff /end CHARACTERISTIC
/begin COMPU_METHOD cfgout2_OilLloff_COMPU_VTAB "Verbal Table" TAB_VERB "%.0" "list" COMPU_TAB_REF cfgout2_OilLloff_COMPU_VTAB_REF /end COMPU_METHOD
/begin COMPU_VTAB cfgout2_OilLloff_COMPU_VTAB_REF "Verbal Table" TAB_VERB 7 0x00 "Ignored" 0x01 "<" 0x02 ">" 0x03 "<=" 0x04 ">=" 0x05 "=" 0x06 "<>" DEFAULT_VALUE "UNKNOWN" /end COMPU_VTAB
/begin CHARACTERISTIC cfgout3_OilLlon "and/or Oil Level is{cfgout3_OilLlon&0xff=0x00:Ignored}{cfgout3_OilLlon&0xff=0x01:<}{cfgout3_OilLlon&0xff=0x02:>}{cfgout3_OilLlon&0xff=0x03:<=}{cfgout3_OilLlon&0xff=0x04:>=}{cfgout3_OilLlon&0xff=0x05:=}{cfgout3_OilLlon&0xff=0x06:<>}" VALUE 0x001CA4EB /* @ECU_Address@cfgout3_OilLlon@0x010109C8@ */ ECIPP_ALIGNMENT_UBYTE 255 cfgout3_OilLlon_COMPU_VTAB 0 255 BIT_MASK 0xff /end CHARACTERISTIC
/begin COMPU_METHOD cfgout3_OilLlon_COMPU_VTAB "Verbal Table" TAB_VERB "%.0" "list" COMPU_TAB_REF cfgout3_OilLlon_COMPU_VTAB_REF /end COMPU_METHOD
/begin COMPU_VTAB cfgout3_OilLlon_COMPU_VTAB_REF "Verbal Table" TAB_VERB 7 0x00 "Ignored" 0x01 "<" 0x02 ">" 0x03 "<=" 0x04 ">=" 0x05 "=" 0x06 "<>" DEFAULT_VALUE "UNKNOWN" /end COMPU_VTAB
/begin CHARACTERISTIC cfgout3_OilLloff "and/or Oil Level is{cfgout3_OilLloff&0xff=0x00:Ignored}{cfgout3_OilLloff&0xff=0x01:<}{cfgout3_OilLloff&0xff=0x02:>}{cfgout3_OilLloff&0xff=0x03:<=}{cfgout3_OilLloff&0xff=0x04:>=}{cfgout3_OilLloff&0xff=0x05:=}{cfgout3_OilLloff&0xff=0x06:<>}" VALUE 0x001CA4F7 /* @ECU_Address@cfgout3_OilLloff@0x010109D0@ */ ECIPP_ALIGNMENT_UBYTE 255 cfgout3_OilLloff_COMPU_VTAB 0 255 BIT_MASK 0xff /end CHARACTERISTIC
/begin COMPU_METHOD cfgout3_OilLloff_COMPU_VTAB "Verbal Table" TAB_VERB "%.0" "list" COMPU_TAB_REF cfgout3_OilLloff_COMPU_VTAB_REF /end COMPU_METHOD
/begin COMPU_VTAB cfgout3_OilLloff_COMPU_VTAB_REF "Verbal Table" TAB_VERB 7 0x00 "Ignored" 0x01 "<" 0x02 ">" 0x03 "<=" 0x04 ">=" 0x05 "=" 0x06 "<>" DEFAULT_VALUE "UNKNOWN" /end COMPU_VTAB
/begin CHARACTERISTIC cfgout_OilLon "OilL_on" VALUE 0x001CA45E /* @ECU_Address@cfgout_OilLon@0x010109D8@ */ ECIPP_ALIGNMENT_UWORD 25600 Compu_cfgout_OilLon 0 25599.609375 /end CHARACTERISTIC
/begin COMPU_METHOD Compu_cfgout_OilLon " " RAT_FUNC "%.0" "%" COEFFS 0 2.56 0 0 0 1 /end COMPU_METHOD
/begin CHARACTERISTIC cfgout_OilLoff "OilL_off" VALUE 0x001CA476 /* @ECU_Address@cfgout_OilLoff@0x010109E0@ */ ECIPP_ALIGNMENT_UWORD 25600 Compu_cfgout_OilLoff 0 25599.609375 /end CHARACTERISTIC
/begin COMPU_METHOD Compu_cfgout_OilLoff " " RAT_FUNC "%.0" "%" COEFFS 0 2.56 0 0 0 1 /end COMPU_METHOD
/begin CHARACTERISTIC cfgout2_OilLon "OilL_on" VALUE 0x001CA4B6 /* @ECU_Address@cfgout2_OilLon@0x010109E8@ */ ECIPP_ALIGNMENT_UWORD 25600 Compu_cfgout2_OilLon 0 25599.609375 /end CHARACTERISTIC
/begin COMPU_METHOD Compu_cfgout2_OilLon " " RAT_FUNC "%.0" "%" COEFFS 0 2.56 0 0 0 1 /end COMPU_METHOD
/begin CHARACTERISTIC cfgout2_OilLoff "OilL_off" VALUE 0x001CA4CE /* @ECU_Address@cfgout2_OilLoff@0x010109F0@ */ ECIPP_ALIGNMENT_UWORD 25600 Compu_cfgout2_OilLoff 0 25599.609375 /end CHARACTERISTIC
/begin COMPU_METHOD Compu_cfgout2_OilLoff " " RAT_FUNC "%.0" "%" COEFFS 0 2.56 0 0 0 1 /end COMPU_METHOD
/begin CHARACTERISTIC cfgout3_OilLon "OilL_on" VALUE 0x001CA50E /* @ECU_Address@cfgout3_OilLon@0x010109F8@ */ ECIPP_ALIGNMENT_UWORD 25600 Compu_cfgout3_OilLon 0 25599.609375 /end CHARACTERISTIC
/begin COMPU_METHOD Compu_cfgout3_OilLon " " RAT_FUNC "%.0" "%" COEFFS 0 2.56 0 0 0 1 /end COMPU_METHOD
/begin CHARACTERISTIC cfgout3_OilLoff "OilL_off" VALUE 0x001CA526 /* @ECU_Address@cfgout3_OilLoff@0x01010A00@ */ ECIPP_ALIGNMENT_UWORD 25600 Compu_cfgout3_OilLoff 0 25599.609375 /end CHARACTERISTIC
/begin COMPU_METHOD Compu_cfgout3_OilLoff " " RAT_FUNC "%.0" "%" COEFFS 0 2.56 0 0 0 1 /end COMPU_METHOD
/begin CHARACTERISTIC MILblk_on "MIL blink/pulse on-time" VALUE 0x001e6df0 /* @ECU_Address@MILblk_on@0x01010AB8@ */ ECIPP_ALIGNMENT_UBYTE 12750 Compu_MILblk_on 0 12750 /end CHARACTERISTIC
/begin COMPU_METHOD Compu_MILblk_on " " RAT_FUNC "%.0" "ms" COEFFS 0 0.02 0 0 0 1 /end COMPU_METHOD
/begin CHARACTERISTIC MILblk_off "MIL blink/pulse off-time" VALUE 0x001e6def /* @ECU_Address@MILblk_off@0x01010AC0@ */ ECIPP_ALIGNMENT_UBYTE 12750 Compu_MILblk_off 0 12750 /end CHARACTERISTIC
/begin COMPU_METHOD Compu_MILblk_off " " RAT_FUNC "%.0" "ms" COEFFS 0 0.02 0 0 0 1 /end COMPU_METHOD
/begin CHARACTERISTIC VSFan_CL_ena "Fan speed closed loop control{VSFan_CL_ena&0xff=0:Disabled}{VSFan_CL_ena&0xff=1:Enabled}" VALUE 0x001c8f89 /* @ECU_Address@VSFan_CL_ena@0x01012628@ */ ECIPP_ALIGNMENT_UBYTE 255 VSFan_CL_ena_COMPU_VTAB 0 255 BIT_MASK 0xff /end CHARACTERISTIC
/begin COMPU_METHOD VSFan_CL_ena_COMPU_VTAB "Verbal Table" TAB_VERB "%.0" "list" COMPU_TAB_REF VSFan_CL_ena_COMPU_VTAB_REF /end COMPU_METHOD
/begin COMPU_VTAB VSFan_CL_ena_COMPU_VTAB_REF "Verbal Table" TAB_VERB 2 0 "Disabled" 1 "Enabled" DEFAULT_VALUE "UNKNOWN" /end COMPU_VTAB
/begin CHARACTERISTIC VSFan_rpm_dot_window "Fan speed derivative window" VALUE 0x001c836c /* @ECU_Address@VSFan_rpm_dot_window@0x01012630@ */ ECIPP_ALIGNMENT_UWORD 65535 Compu_VSFan_rpm_dot_window 0 65535 /end CHARACTERISTIC
/begin COMPU_METHOD Compu_VSFan_rpm_dot_window " " RAT_FUNC "%.0" "ms" COEFFS 0 1 0 0 0 1 /end COMPU_METHOD
/begin CHARACTERISTIC VSFan_rpm_dot_tau "Fan speed derivative low-pass" VALUE 0x001c8642 /* @ECU_Address@VSFan_rpm_dot_tau@0x01012638@ */ ECIPP_ALIGNMENT_UWORD 1638398 Compu_VSFan_rpm_dot_tau 1.6703 1638400 /end CHARACTERISTIC
/begin COMPU_METHOD Compu_VSFan_rpm_dot_tau " " FORM "%.1" "ms"
 /begin FORMULA "-50 / log(1.0000000000001 - (X1 / 32768))" FORMULA_INV "(1.0000000000001 - exp(-50/X1)) * 32768" /end FORMULA
/end COMPU_METHOD
/begin CHARACTERISTIC VSFan_pctd_tau "Fan max low-pass tau" VALUE 0x001c8640 /* @ECU_Address@VSFan_pctd_tau@0x01012640@ */ ECIPP_ALIGNMENT_UWORD 3276795 Compu_VSFan_pctd_tau 4.5084 3276800 /end CHARACTERISTIC
/begin COMPU_METHOD Compu_VSFan_pctd_tau " " FORM "%.1" "ms"
 /begin FORMULA "-50 / log(1 - (X1 / 65536))" FORMULA_INV "(1 - exp(-50/X1)) * 65536" /end FORMULA
/end COMPU_METHOD
/begin CHARACTERISTIC VSFan_ac_rpm "AC running fan speed" VALUE 0x001c8346 /* @ECU_Address@VSFan_ac_rpm@0x01012668@ */ ECIPP_ALIGNMENT_UWORD 65535 Compu_VSFan_ac_rpm 0 65535 /end CHARACTERISTIC
/begin COMPU_METHOD Compu_VSFan_ac_rpm " " RAT_FUNC "%.0" "rpm" COEFFS 0 1 0 0 0 1 /end COMPU_METHOD
/begin CHARACTERISTIC VSFan_ac_RSmax "AC fan speed control RS limit" VALUE 0x001c8342 /* @ECU_Address@VSFan_ac_RSmax@0x01012670@ */ ECIPP_ALIGNMENT_UWORD 256 Compu_VSFan_ac_RSmax 0 255.99609375 /end CHARACTERISTIC
/begin COMPU_METHOD Compu_VSFan_ac_RSmax " " RAT_FUNC "%.1" "km/hr" COEFFS 0 256 0 0 0 1 /end COMPU_METHOD
/begin CHARACTERISTIC VSFan_drvbrk_rpm "Engine braking fan speed" VALUE 0x001c834e /* @ECU_Address@VSFan_drvbrk_rpm@0x01012678@ */ ECIPP_ALIGNMENT_UWORD 65535 Compu_VSFan_drvbrk_rpm 0 65535 /end CHARACTERISTIC
/begin COMPU_METHOD Compu_VSFan_drvbrk_rpm " " RAT_FUNC "%.0" "rpm" COEFFS 0 1 0 0 0 1 /end COMPU_METHOD
/begin CHARACTERISTIC VSFan_rpmd_tau "Fan speed target low-pass tau" VALUE 0x001c8644 /* @ECU_Address@VSFan_rpmd_tau@0x01012690@ */ ECIPP_ALIGNMENT_UWORD 3276795 Compu_VSFan_rpmd_tau 4.5084 3276800 /end CHARACTERISTIC
/begin COMPU_METHOD Compu_VSFan_rpmd_tau " " FORM "%.1" "ms"
 /begin FORMULA "-50 / log(1 - (X1 / 65536))" FORMULA_INV "(1 - exp(-50/X1)) * 65536" /end FORMULA
/end COMPU_METHOD
/begin CHARACTERISTIC VSFan_Taux_chan "Aux temperature source input{VSFan_Taux_chan&0xff=0:Disabled}{VSFan_Taux_chan&0xff=1:EGRT}{VSFan_Taux_chan&0xff=2:Aux Temp 1}{VSFan_Taux_chan&0xff=3:Aux Temp 2}{VSFan_Taux_chan&0xff=4:Aux Temp 3}{VSFan_Taux_chan&0xff=5:Aux Temp 4}{VSFan_Taux_chan&0xff=6:A" VALUE 0x001c8f8b /* @ECU_Address@VSFan_Taux_chan@0x01012858@ */ ECIPP_ALIGNMENT_UBYTE 255 VSFan_Taux_chan_COMPU_VTAB 0 255 BIT_MASK 0xff /end CHARACTERISTIC
/begin COMPU_METHOD VSFan_Taux_chan_COMPU_VTAB "Verbal Table" TAB_VERB "%.0" "list" COMPU_TAB_REF VSFan_Taux_chan_COMPU_VTAB_REF /end COMPU_METHOD
/begin COMPU_VTAB VSFan_Taux_chan_COMPU_VTAB_REF "Verbal Table" TAB_VERB 19 0 "Disabled" 1 "EGRT" 2 "Aux Temp 1" 3 "Aux Temp 2" 4 "Aux Temp 3" 5 "Aux Temp 4" 6 "Aux Temp 5" 7 "Aux Temp 6" 8 "Aux Temp 7" 9 "Aux Temp 8" 10 "Aux Temp 9" 11 "Aux Temp 10" 12 "Aux Temp 11" 13 "Aux Temp 12" 14 "Aux Temp 13" 15 "Aux Temp 14" 16 "Aux Temp 15" 17 "Aux Temp 16" 18 "CAN sourced" DEFAULT_VALUE "UNKNOWN" /end COMPU_VTAB
/begin CHARACTERISTIC VSFan_load_src "Load-based fan max source{VSFan_load_src&0xff=0:IAT}{VSFan_load_src&0xff=1:TIAT}" VALUE 0x001c8f8f /* @ECU_Address@VSFan_load_src@0x01012860@ */ ECIPP_ALIGNMENT_UBYTE 255 VSFan_load_src_COMPU_VTAB 0 255 BIT_MASK 0xff /end CHARACTERISTIC
/begin COMPU_METHOD VSFan_load_src_COMPU_VTAB "Verbal Table" TAB_VERB "%.0" "deg F" COMPU_TAB_REF VSFan_load_src_COMPU_VTAB_REF /end COMPU_METHOD
/begin COMPU_VTAB VSFan_load_src_COMPU_VTAB_REF "Verbal Table" TAB_VERB 2 0 "IAT" 1 "TIAT" DEFAULT_VALUE "UNKNOWN" /end COMPU_VTAB
/begin CHARACTERISTIC VSFan_Taux_tau "Aux temperature low-pass tau" VALUE 0x001c863e /* @ECU_Address@VSFan_Taux_tau@0x01012868@ */ ECIPP_ALIGNMENT_UWORD 3276795 Compu_VSFan_Taux_tau 4.5084 3276800 /end CHARACTERISTIC
/begin COMPU_METHOD Compu_VSFan_Taux_tau " " FORM "%.1" "ms"
 /begin FORMULA "-50 / log(1 - (X1 / 65536))" FORMULA_INV "(1 - exp(-50/X1)) * 65536" /end FORMULA
/end COMPU_METHOD
/begin CHARACTERISTIC VSFan_retard_rpm "Retarder active fan speed" VALUE 0x001c836a /* @ECU_Address@VSFan_retard_rpm@0x01012870@ */ ECIPP_ALIGNMENT_UWORD 65535 Compu_VSFan_retard_rpm 0 65535 /end CHARACTERISTIC
/begin COMPU_METHOD Compu_VSFan_retard_rpm " " RAT_FUNC "%.0" "rpm" COEFFS 0 1 0 0 0 1 /end COMPU_METHOD
/begin CHARACTERISTIC AWP_ctl_ena "AWP control{AWP_ctl_ena&0xff=0:Disabled}{AWP_ctl_ena&0xff=1:Enabled}" VALUE 0x001c8685 /* @ECU_Address@AWP_ctl_ena@0x01012B88@ */ ECIPP_ALIGNMENT_UBYTE 255 AWP_ctl_ena_COMPU_VTAB 0 255 BIT_MASK 0xff /end CHARACTERISTIC
/begin COMPU_METHOD AWP_ctl_ena_COMPU_VTAB "Verbal Table" TAB_VERB "%.0" "list" COMPU_TAB_REF AWP_ctl_ena_COMPU_VTAB_REF /end COMPU_METHOD
/begin COMPU_VTAB AWP_ctl_ena_COMPU_VTAB_REF "Verbal Table" TAB_VERB 2 0 "Disabled" 1 "Enabled" DEFAULT_VALUE "UNKNOWN" /end COMPU_VTAB
/begin CHARACTERISTIC AWP_ctl_ECT_min "AWP control minimum ECT" VALUE 0x001c6d66 /* @ECU_Address@AWP_ctl_ECT_min@0x01012B90@ */ ECIPP_ALIGNMENT_UWORD 564 Compu_AWP_ctl_ECT_min -460 563.984375 /end CHARACTERISTIC
/begin COMPU_METHOD Compu_AWP_ctl_ECT_min " " RAT_FUNC "%.1" "deg F" COEFFS 0 64 29440 0 0 1 /end COMPU_METHOD
/begin CHARACTERISTIC AWP_rpmd "AWP motor target speed" VALUE 0x001c6d68 /* @ECU_Address@AWP_rpmd@0x01012B98@ */ ECIPP_ALIGNMENT_UWORD 65535 Compu_AWP_rpmd 0 65535 /end CHARACTERISTIC
/begin COMPU_METHOD Compu_AWP_rpmd " " RAT_FUNC "%.0" "rpm" COEFFS 0 1 0 0 0 1 /end COMPU_METHOD
/begin CHARACTERISTIC AWP_restart_runtime "AWP engine restart run time" VALUE 0x001c4254 /* @ECU_Address@AWP_restart_runtime@0x01012BA0@ */ ECIPP_ALIGNMENT_ULONG 4294967 Compu_AWP_restart_runtime 0 4294967.295 /end CHARACTERISTIC
/begin COMPU_METHOD Compu_AWP_restart_runtime " " RAT_FUNC "%.1" "sec" COEFFS 0 1000 0 0 0 1 /end COMPU_METHOD
/begin CHARACTERISTIC RBC_CAN_ena "Retarder braking CAN source{RBC_CAN_ena&0xff=0:Disabled}{RBC_CAN_ena&0xff=1:Enabled}" VALUE 0x001c88b4 /* @ECU_Address@RBC_CAN_ena@0x01013030@ */ ECIPP_ALIGNMENT_UBYTE 255 RBC_CAN_ena_COMPU_VTAB 0 255 BIT_MASK 0xff /end CHARACTERISTIC
/begin COMPU_METHOD RBC_CAN_ena_COMPU_VTAB "Verbal Table" TAB_VERB "%.0" "list" COMPU_TAB_REF RBC_CAN_ena_COMPU_VTAB_REF /end COMPU_METHOD
/begin COMPU_VTAB RBC_CAN_ena_COMPU_VTAB_REF "Verbal Table" TAB_VERB 2 0 "Disabled" 1 "Enabled" DEFAULT_VALUE "UNKNOWN" /end COMPU_VTAB
/begin CHARACTERISTIC RBC_ovrspd_ena "Overspeed retarder braking{RBC_ovrspd_ena&0xff=0:Disabled}{RBC_ovrspd_ena&0xff=1:Engage at spark rev limit}{RBC_ovrspd_ena&0xff=2:Engage at fixed speed limit}" VALUE 0x001c88bb /* @ECU_Address@RBC_ovrspd_ena@0x010130C8@ */ ECIPP_ALIGNMENT_UBYTE 255 RBC_ovrspd_ena_COMPU_VTAB 0 255 BIT_MASK 0xff /end CHARACTERISTIC
/begin COMPU_METHOD RBC_ovrspd_ena_COMPU_VTAB "Verbal Table" TAB_VERB "%.0" "list" COMPU_TAB_REF RBC_ovrspd_ena_COMPU_VTAB_REF /end COMPU_METHOD
/begin COMPU_VTAB RBC_ovrspd_ena_COMPU_VTAB_REF "Verbal Table" TAB_VERB 3 0 "Disabled" 1 "Engage at spark rev limit" 2 "Engage at fixed speed limit" DEFAULT_VALUE "UNKNOWN" /end COMPU_VTAB
/begin CHARACTERISTIC RBC_ovrspd_engage "Overspeed braking engage{RBC_ovrspd_engage&0xff=0:Driveline brake}{RBC_ovrspd_engage&0xff=1:Exhaust brake}{RBC_ovrspd_engage&0xff=2:Driveline + exhaust}" VALUE 0x001c88bc /* @ECU_Address@RBC_ovrspd_engage@0x010130D0@ */ ECIPP_ALIGNMENT_UBYTE 255 RBC_ovrspd_engage_COMPU_VTAB 0 255 BIT_MASK 0xff /end CHARACTERISTIC
/begin COMPU_METHOD RBC_ovrspd_engage_COMPU_VTAB "Verbal Table" TAB_VERB "%.0" "list" COMPU_TAB_REF RBC_ovrspd_engage_COMPU_VTAB_REF /end COMPU_METHOD
/begin COMPU_VTAB RBC_ovrspd_engage_COMPU_VTAB_REF "Verbal Table" TAB_VERB 3 0 "Driveline brake" 1 "Exhaust brake" 2 "Driveline + exhaust" DEFAULT_VALUE "UNKNOWN" /end COMPU_VTAB
/begin CHARACTERISTIC RBC_ovrspd_rpm_lmt "Overspeed braking fixed limit" VALUE 0x001c7e96 /* @ECU_Address@RBC_ovrspd_rpm_lmt@0x010130D8@ */ ECIPP_ALIGNMENT_UWORD 65535 Compu_RBC_ovrspd_rpm_lmt 0 65535 /end CHARACTERISTIC
/begin COMPU_METHOD Compu_RBC_ovrspd_rpm_lmt " " RAT_FUNC "%.0" "rpm" COEFFS 0 1 0 0 0 1 /end COMPU_METHOD
/begin CHARACTERISTIC RBC_ovrspd_RS_min "Overspeed braking min roadspeed" VALUE 0x001c7e94 /* @ECU_Address@RBC_ovrspd_RS_min@0x010130E0@ */ ECIPP_ALIGNMENT_UWORD 256 Compu_RBC_ovrspd_RS_min 0 255.99609375 /end CHARACTERISTIC
/begin COMPU_METHOD Compu_RBC_ovrspd_RS_min " " RAT_FUNC "%.1" "km/hr" COEFFS 0 256 0 0 0 1 /end COMPU_METHOD
/begin CHARACTERISTIC VSFan_ac_hi_pres_rpm "AC high pressure fan speed" VALUE 0x001c8344 /* @ECU_Address@VSFan_ac_hi_pres_rpm@0x010132D8@ */ ECIPP_ALIGNMENT_UWORD 65535 Compu_VSFan_ac_hi_pres_rpm 0 65535 /end CHARACTERISTIC
/begin COMPU_METHOD Compu_VSFan_ac_hi_pres_rpm " " RAT_FUNC "%.0" "rpm" COEFFS 0 1 0 0 0 1 /end COMPU_METHOD
/begin CHARACTERISTIC AC_hi_pres_chan "AC high pressure switch{AC_hi_pres_chan&0xff=0:Disabled}{AC_hi_pres_chan&0xff=1:Aux PU1 = Gnd}{AC_hi_pres_chan&0xff=2:Aux PU2 = Gnd}{AC_hi_pres_chan&0xff=3:Aux PU3 = Gnd}{AC_hi_pres_chan&0xff=4:Aux PUD1 = Gnd}{AC_hi_pres_chan&0xff=5:Aux PUD2 = Gnd}{AC_hi_" VALUE 0x001c866e /* @ECU_Address@AC_hi_pres_chan@0x01013308@ */ ECIPP_ALIGNMENT_UBYTE 255 AC_hi_pres_chan_COMPU_VTAB 0 255 BIT_MASK 0xff /end CHARACTERISTIC
/begin COMPU_METHOD AC_hi_pres_chan_COMPU_VTAB "Verbal Table" TAB_VERB "%.0" "list" COMPU_TAB_REF AC_hi_pres_chan_COMPU_VTAB_REF /end COMPU_METHOD
/begin COMPU_VTAB AC_hi_pres_chan_COMPU_VTAB_REF "Verbal Table" TAB_VERB 30 0 "Disabled" 1 "Aux PU1 = Gnd" 2 "Aux PU2 = Gnd" 3 "Aux PU3 = Gnd" 4 "Aux PUD1 = Gnd" 5 "Aux PUD2 = Gnd" 6 "Aux PUD3 = Gnd" 7 "Aux PUD4 = +V" 8 "Aux PUD5 = Gnd" 9 "Aux DIG1" 10 "Aux DIG2" 11 "Aux DIG3" 12 "Aux DIG4" 13 "Aux DIG5" 14 "Aux DIG6" 15 "Aux DIG7" 16 "Aux DIG8" 17 "Aux DIG9" 18 "Aux DIG10" 19 "Aux DIG11" 20 "Aux DIG12" 21 "Aux DIG13" 22 "Aux DIG14" 23 "Aux DIG15" 24 "Aux DIG16" 25 "Aux DIG17" 26 "Aux DIG18" 27 "Aux DIG19" 28 "Gov1" 29 "Gov2" DEFAULT_VALUE "UNKNOWN" /end COMPU_VTAB
/begin CHARACTERISTIC AC_hi_pres_cfg "AC high pres Aux DIG config{AC_hi_pres_cfg&0xff=0:Default}{AC_hi_pres_cfg&0xff=1:GND}{AC_hi_pres_cfg&0xff=2:GND/+V}{AC_hi_pres_cfg&0xff=3:+V}{AC_hi_pres_cfg&0xff=4:Open}" VALUE 0x001c866d /* @ECU_Address@AC_hi_pres_cfg@0x01013310@ */ ECIPP_ALIGNMENT_UBYTE 255 AC_hi_pres_cfg_COMPU_VTAB 0 255 BIT_MASK 0xff /end CHARACTERISTIC
/begin COMPU_METHOD AC_hi_pres_cfg_COMPU_VTAB "Verbal Table" TAB_VERB "%.0" "list" COMPU_TAB_REF AC_hi_pres_cfg_COMPU_VTAB_REF /end COMPU_METHOD
/begin COMPU_VTAB AC_hi_pres_cfg_COMPU_VTAB_REF "Verbal Table" TAB_VERB 5 0 "Default" 1 "GND" 2 "GND/+V" 3 "+V" 4 "Open" DEFAULT_VALUE "UNKNOWN" /end COMPU_VTAB
/begin CHARACTERISTIC VSFan_AGS_min1 "Minimum grille #1 position" VALUE 0x001c833e /* @ECU_Address@VSFan_AGS_min1@0x010133E8@ */ ECIPP_ALIGNMENT_UWORD 100 Compu_VSFan_AGS_min1 0 99.9984741210938 /end CHARACTERISTIC
/begin COMPU_METHOD Compu_VSFan_AGS_min1 " " RAT_FUNC "%.1" "%" COEFFS 0 655.36 0 0 0 1 /end COMPU_METHOD
/begin CHARACTERISTIC ECWP_chan "ECWP output{ECWP_chan&0xff=0:Disabled}{ECWP_chan&0xff=1:Buzzer Output}{ECWP_chan&0xff=2:MIL Output}{ECWP_chan&0xff=3:TACH Output}{ECWP_chan&0xff=4:Starter Output}{ECWP_chan&0xff=5:EGOH1}{ECWP_chan&0xff=6:EGOH2}{ECWP_chan&0xff=7:EGOH3}{ECWP_chan&0xff=8:EGO" VALUE 0x001c86cf /* @ECU_Address@ECWP_chan@0x01013408@ */ ECIPP_ALIGNMENT_UBYTE 255 ECWP_chan_COMPU_VTAB 0 255 BIT_MASK 0xff /end CHARACTERISTIC
/begin COMPU_METHOD ECWP_chan_COMPU_VTAB "Verbal Table" TAB_VERB "%.0" "list" COMPU_TAB_REF ECWP_chan_COMPU_VTAB_REF /end COMPU_METHOD
/begin COMPU_VTAB ECWP_chan_COMPU_VTAB_REF "Verbal Table" TAB_VERB 32 0 "Disabled" 1 "Buzzer Output" 2 "MIL Output" 3 "TACH Output" 4 "Starter Output" 5 "EGOH1" 6 "EGOH2" 7 "EGOH3" 8 "EGOH4" 9 "Aux PWM1" 10 "Aux PWM2" 11 "Aux PWM3" 12 "Aux PWM4" 13 "Aux PWM5" 14 "Aux PWM6" 15 "Aux PWM7" 16 "Aux PWM8" 17 "Aux PWM9" 18 "Aux PWM10" 19 "Aux PWM11" 20 "Aux PWM12" 21 "Aux PWM13" 22 "Aux PWM14" 23 "Aux PWM15" 24 "Aux PWM16" 25 "Aux PWM17" 26 "Aux PWM18" 27 "Aux PWM19" 28 "Aux PWM20" 29 "Aux PWM21" 30 "Aux PWM22" 31 "Aux PWM23" DEFAULT_VALUE "UNKNOWN" /end COMPU_VTAB
/begin CHARACTERISTIC ECWP_idle_rpm "ECWP idle maximum engine speed" VALUE 0x001c6ecc /* @ECU_Address@ECWP_idle_rpm@0x01013410@ */ ECIPP_ALIGNMENT_UWORD 65535 Compu_ECWP_idle_rpm 0 65535 /end CHARACTERISTIC
/begin COMPU_METHOD Compu_ECWP_idle_rpm " " RAT_FUNC "%.0" "rpm" COEFFS 0 1 0 0 0 1 /end COMPU_METHOD
/begin CHARACTERISTIC ECWP_idle_MAP_load "ECWP idle maximum MAP load" VALUE 0x001c6eca /* @ECU_Address@ECWP_idle_MAP_load@0x01013418@ */ ECIPP_ALIGNMENT_UWORD 256 Compu_ECWP_idle_MAP_load 0 255.99609375 /end CHARACTERISTIC
/begin COMPU_METHOD Compu_ECWP_idle_MAP_load " " RAT_FUNC "%.1" "psia" COEFFS 0 256 0 0 0 1 /end COMPU_METHOD
/begin CHARACTERISTIC ECWP_idle_tm_max "ECWP maximum time at idle" VALUE 0x001c6ece /* @ECU_Address@ECWP_idle_tm_max@0x01013428@ */ ECIPP_ALIGNMENT_UWORD 65535 Compu_ECWP_idle_tm_max 0 65535 /end CHARACTERISTIC
/begin COMPU_METHOD Compu_ECWP_idle_tm_max " " RAT_FUNC "%.1" "sec" COEFFS 0 1 0 0 0 1 /end COMPU_METHOD
/begin CHARACTERISTIC ECWP_ECT_max "ECWP maximum ECT" VALUE 0x001c6ec4 /* @ECU_Address@ECWP_ECT_max@0x01013430@ */ ECIPP_ALIGNMENT_UWORD 564 Compu_ECWP_ECT_max -460 563.984375 /end CHARACTERISTIC
/begin COMPU_METHOD Compu_ECWP_ECT_max " " RAT_FUNC "%.1" "deg F" COEFFS 0 64 29440 0 0 1 /end COMPU_METHOD
/begin CHARACTERISTIC ECWP_EGRT_max "ECWP maximum EGRT" VALUE 0x001c6ec6 /* @ECU_Address@ECWP_EGRT_max@0x01013438@ */ ECIPP_ALIGNMENT_UWORD 7732 Compu_ECWP_EGRT_max -460 7731.875 /end CHARACTERISTIC
/begin COMPU_METHOD Compu_ECWP_EGRT_max " " RAT_FUNC "%.1" "deg F" COEFFS 0 8 3680 0 0 1 /end COMPU_METHOD
/begin CHARACTERISTIC ECWP_FT_min "ECWP minimum FT" VALUE 0x001c6ec8 /* @ECU_Address@ECWP_FT_min@0x01013440@ */ ECIPP_ALIGNMENT_UWORD 7732 Compu_ECWP_FT_min -460 7731.875 /end CHARACTERISTIC
/begin COMPU_METHOD Compu_ECWP_FT_min " " RAT_FUNC "%.1" "deg F" COEFFS 0 8 3680 0 0 1 /end COMPU_METHOD
/begin CHARACTERISTIC ECWP_temp_wait "ECWP temp validation wait" VALUE 0x001c6ed0 /* @ECU_Address@ECWP_temp_wait@0x01013450@ */ ECIPP_ALIGNMENT_UWORD 66 Compu_ECWP_temp_wait 0 65.535 /end CHARACTERISTIC
/begin COMPU_METHOD Compu_ECWP_temp_wait " " RAT_FUNC "%.1" "sec" COEFFS 0 1000 0 0 0 1 /end COMPU_METHOD
/begin CHARACTERISTIC ECWP_wait "ECWP output validation wait" VALUE 0x001c6ed2 /* @ECU_Address@ECWP_wait@0x01013458@ */ ECIPP_ALIGNMENT_UWORD 65535 Compu_ECWP_wait 0 65535 /end CHARACTERISTIC
/begin COMPU_METHOD Compu_ECWP_wait " " RAT_FUNC "%.0" "ms" COEFFS 0 1 0 0 0 1 /end COMPU_METHOD
/begin CHARACTERISTIC crank_rst_mode "Crank limiter reset mode{crank_rst_mode&0xff=0:Reset at key off}{crank_rst_mode&0xff=1:Decay after key off}{crank_rst_mode&0xff=2:Decay from 100% after engine stop}" VALUE 0x001c8fdd /* @ECU_Address@crank_rst_mode@0x010134C0@ */ ECIPP_ALIGNMENT_UBYTE 255 crank_rst_mode_COMPU_VTAB 0 255 BIT_MASK 0xff /end CHARACTERISTIC
/begin COMPU_METHOD crank_rst_mode_COMPU_VTAB "Verbal Table" TAB_VERB "%.0" "list" COMPU_TAB_REF crank_rst_mode_COMPU_VTAB_REF /end COMPU_METHOD
/begin COMPU_VTAB crank_rst_mode_COMPU_VTAB_REF "Verbal Table" TAB_VERB 3 0 "Reset at key off" 1 "Decay after key off" 2 "Decay from 100% after engine stop" DEFAULT_VALUE "UNKNOWN" /end COMPU_VTAB
/begin CHARACTERISTIC ERCV_ACTIV_output "ERCV enable output{ERCV_ACTIV_output&0xff=0:Disabled}{ERCV_ACTIV_output&0xff=1:Buzzer Output}{ERCV_ACTIV_output&0xff=2:MIL Output}{ERCV_ACTIV_output&0xff=3:TACH Output}{ERCV_ACTIV_output&0xff=4:Starter Output}{ERCV_ACTIV_output&0xff=5:EGOH1}{ERCV_ACTIV_ou" VALUE 0x001c86e8 /* @ECU_Address@ERCV_ACTIV_output@0x01013638@ */ ECIPP_ALIGNMENT_UBYTE 255 ERCV_ACTIV_output_COMPU_VTAB 0 255 BIT_MASK 0xff /end CHARACTERISTIC
/begin COMPU_METHOD ERCV_ACTIV_output_COMPU_VTAB "Verbal Table" TAB_VERB "%.0" "list" COMPU_TAB_REF ERCV_ACTIV_output_COMPU_VTAB_REF /end COMPU_METHOD
/begin COMPU_VTAB ERCV_ACTIV_output_COMPU_VTAB_REF "Verbal Table" TAB_VERB 32 0 "Disabled" 1 "Buzzer Output" 2 "MIL Output" 3 "TACH Output" 4 "Starter Output" 5 "EGOH1" 6 "EGOH2" 7 "EGOH3" 8 "EGOH4" 9 "Aux PWM1" 10 "Aux PWM2" 11 "Aux PWM3" 12 "Aux PWM4" 13 "Aux PWM5" 14 "Aux PWM6" 15 "Aux PWM7" 16 "Aux PWM8" 17 "Aux PWM9" 18 "Aux PWM10" 19 "Aux PWM11" 20 "Aux PWM12" 21 "Aux PWM13" 22 "Aux PWM14" 23 "Aux PWM15" 24 "Aux PWM16" 25 "Aux PWM17" 26 "Aux PWM18" 27 "Aux PWM19" 28 "Aux PWM20" 29 "Aux PWM21" 30 "Aux PWM22" 31 "Aux PWM23" DEFAULT_VALUE "UNKNOWN" /end COMPU_VTAB
/begin CHARACTERISTIC ERCV_SPEED_input "ERCV speed input{ERCV_SPEED_input&0xff=0:Disabled}{ERCV_SPEED_input&0xff=1:Pulse in}{ERCV_SPEED_input&0xff=2:Roadspeed}{ERCV_SPEED_input&0xff=3:Aux DIG23 comparator}{ERCV_SPEED_input&0xff=4:Aux DIG24 comparator}{ERCV_SPEED_input&0xff=5:Aux DIG25 comparato" VALUE 0x001c86e9 /* @ECU_Address@ERCV_SPEED_input@0x01013640@ */ ECIPP_ALIGNMENT_UBYTE 255 ERCV_SPEED_input_COMPU_VTAB 0 255 BIT_MASK 0xff /end CHARACTERISTIC
/begin COMPU_METHOD ERCV_SPEED_input_COMPU_VTAB "Verbal Table" TAB_VERB "%.0" "list" COMPU_TAB_REF ERCV_SPEED_input_COMPU_VTAB_REF /end COMPU_METHOD
/begin COMPU_VTAB ERCV_SPEED_input_COMPU_VTAB_REF "Verbal Table" TAB_VERB 6 0 "Disabled" 1 "Pulse in" 2 "Roadspeed" 3 "Aux DIG23 comparator" 4 "Aux DIG24 comparator" 5 "Aux DIG25 comparator" DEFAULT_VALUE "UNKNOWN" /end COMPU_VTAB
/begin CHARACTERISTIC CCH_chan "Crankcase heater output channel{CCH_chan&0xff=0:Disabled}{CCH_chan&0xff=1:Buzzer Output}{CCH_chan&0xff=2:MIL Output}{CCH_chan&0xff=3:TACH Output}{CCH_chan&0xff=4:Starter Output}{CCH_chan&0xff=5:EGOH1}{CCH_chan&0xff=6:EGOH2}{CCH_chan&0xff=7:EGOH3}{CCH_chan" VALUE 0x001c8698 /* @ECU_Address@CCH_chan@0x01013710@ */ ECIPP_ALIGNMENT_UBYTE 255 CCH_chan_COMPU_VTAB 0 255 BIT_MASK 0xff /end CHARACTERISTIC
/begin COMPU_METHOD CCH_chan_COMPU_VTAB "Verbal Table" TAB_VERB "%.0" "list" COMPU_TAB_REF CCH_chan_COMPU_VTAB_REF /end COMPU_METHOD
/begin COMPU_VTAB CCH_chan_COMPU_VTAB_REF "Verbal Table" TAB_VERB 32 0 "Disabled" 1 "Buzzer Output" 2 "MIL Output" 3 "TACH Output" 4 "Starter Output" 5 "EGOH1" 6 "EGOH2" 7 "EGOH3" 8 "EGOH4" 9 "Aux PWM1" 10 "Aux PWM2" 11 "Aux PWM3" 12 "Aux PWM4" 13 "Aux PWM5" 14 "Aux PWM6" 15 "Aux PWM7" 16 "Aux PWM8" 17 "Aux PWM9" 18 "Aux PWM10" 19 "Aux PWM11" 20 "Aux PWM12" 21 "Aux PWM13" 22 "Aux PWM14" 23 "Aux PWM15" 24 "Aux PWM16" 25 "Aux PWM17" 26 "Aux PWM18" 27 "Aux PWM19" 28 "Aux PWM20" 29 "Aux PWM21" 30 "Aux PWM22" 31 "Aux PWM23" DEFAULT_VALUE "UNKNOWN" /end COMPU_VTAB
/begin CHARACTERISTIC CCH_on_CCT "Crankcase heater 'on' temperature" VALUE 0x001c6dd2 /* @ECU_Address@CCH_on_CCT@0x01013718@ */ ECIPP_ALIGNMENT_UWORD 564 Compu_CCH_on_CCT -460 563.984375 /end CHARACTERISTIC
/begin COMPU_METHOD Compu_CCH_on_CCT " " RAT_FUNC "%.1" "deg F" COEFFS 0 64 29440 0 0 1 /end COMPU_METHOD
/begin CHARACTERISTIC CCH_on_dly "Crankcase heater 'on' debounce time" VALUE 0x001c6dd4 /* @ECU_Address@CCH_on_dly@0x01013720@ */ ECIPP_ALIGNMENT_UWORD 3277 Compu_CCH_on_dly 0 3276.75 /end CHARACTERISTIC
/begin COMPU_METHOD Compu_CCH_on_dly " " RAT_FUNC "%.1" "sec" COEFFS 0 20 0 0 0 1 /end COMPU_METHOD
/begin CHARACTERISTIC CCH_off_CCT "Crankcase heater 'off' temperature" VALUE 0x001c6dce /* @ECU_Address@CCH_off_CCT@0x01013728@ */ ECIPP_ALIGNMENT_UWORD 564 Compu_CCH_off_CCT -460 563.984375 /end CHARACTERISTIC
/begin COMPU_METHOD Compu_CCH_off_CCT " " RAT_FUNC "%.1" "deg F" COEFFS 0 64 29440 0 0 1 /end COMPU_METHOD
/begin CHARACTERISTIC CCH_off_dly "Crankcase heater 'off' debounce time" VALUE 0x001c6dd0 /* @ECU_Address@CCH_off_dly@0x01013730@ */ ECIPP_ALIGNMENT_UWORD 3277 Compu_CCH_off_dly 0 3276.75 /end CHARACTERISTIC
/begin COMPU_METHOD Compu_CCH_off_dly " " RAT_FUNC "%.1" "sec" COEFFS 0 20 0 0 0 1 /end COMPU_METHOD
/begin CHARACTERISTIC CCH_flt_on_tm "Crankcase heater open-loop 'on' time max" VALUE 0x001c6dcc /* @ECU_Address@CCH_flt_on_tm@0x01013738@ */ ECIPP_ALIGNMENT_UWORD 3277 Compu_CCH_flt_on_tm 0 3276.75 /end CHARACTERISTIC
/begin COMPU_METHOD Compu_CCH_flt_on_tm " " RAT_FUNC "%.1" "sec" COEFFS 0 20 0 0 0 1 /end COMPU_METHOD
/begin CHARACTERISTIC CCH_flt_off_tm "Crankcase heater open-loop 'off' time min" VALUE 0x001c6dc8 /* @ECU_Address@CCH_flt_off_tm@0x01013740@ */ ECIPP_ALIGNMENT_UWORD 3277 Compu_CCH_flt_off_tm 0 3276.75 /end CHARACTERISTIC
/begin COMPU_METHOD Compu_CCH_flt_off_tm " " RAT_FUNC "%.1" "sec" COEFFS 0 20 0 0 0 1 /end COMPU_METHOD
/begin CHARACTERISTIC CCH_CCTflt_cold_OILT "Crankcase heater open-loop long 'on' temp" VALUE 0x001c6dc2 /* @ECU_Address@CCH_CCTflt_cold_OILT@0x01013748@ */ ECIPP_ALIGNMENT_UWORD 564 Compu_CCH_CCTflt_cold_OILT -460 563.984375 /end CHARACTERISTIC
/begin COMPU_METHOD Compu_CCH_CCTflt_cold_OILT " " RAT_FUNC "%.1" "deg F" COEFFS 0 64 29440 0 0 1 /end COMPU_METHOD
/begin CHARACTERISTIC CCH_flt_cold_tm "Crankcase heater open-loop long 'on' time max" VALUE 0x001c6dc4 /* @ECU_Address@CCH_flt_cold_tm@0x01013750@ */ ECIPP_ALIGNMENT_UWORD 3277 Compu_CCH_flt_cold_tm 0 3276.75 /end CHARACTERISTIC
/begin COMPU_METHOD Compu_CCH_flt_cold_tm " " RAT_FUNC "%.1" "sec" COEFFS 0 20 0 0 0 1 /end COMPU_METHOD
/begin CHARACTERISTIC START_CMD_loV "Start signal input low trigger" VALUE 0x001c7fbc /* @ECU_Address@START_CMD_loV@0x010138D0@ */ ECIPP_ALIGNMENT_UWORD 256 Compu_START_CMD_loV 0 255.99609375 /end CHARACTERISTIC
/begin COMPU_METHOD Compu_START_CMD_loV " " RAT_FUNC "%.3" "volts" COEFFS 0 256 0 0 0 1 /end COMPU_METHOD
/begin CHARACTERISTIC START_CMD_hiV "Start signal input high trigger" VALUE 0x001c7fba /* @ECU_Address@START_CMD_hiV@0x010138D8@ */ ECIPP_ALIGNMENT_UWORD 256 Compu_START_CMD_hiV 0 255.99609375 /end CHARACTERISTIC
/begin COMPU_METHOD Compu_START_CMD_hiV " " RAT_FUNC "%.3" "volts" COEFFS 0 256 0 0 0 1 /end COMPU_METHOD
/begin CHARACTERISTIC crank_LFP_mode "Low fuel pressure crank limiter{crank_LFP_mode&0xff=0:Disabled}{crank_LFP_mode&0xff=1:Modify wind-up time only}{crank_LFP_mode&0xff=2:Modify wind-up/down times}" VALUE 0x001c8fd9 /* @ECU_Address@crank_LFP_mode@0x01013B88@ */ ECIPP_ALIGNMENT_UBYTE 255 crank_LFP_mode_COMPU_VTAB 0 255 BIT_MASK 0xff /end CHARACTERISTIC
/begin COMPU_METHOD crank_LFP_mode_COMPU_VTAB "Verbal Table" TAB_VERB "%.0" "list" COMPU_TAB_REF crank_LFP_mode_COMPU_VTAB_REF /end COMPU_METHOD
/begin COMPU_VTAB crank_LFP_mode_COMPU_VTAB_REF "Verbal Table" TAB_VERB 3 0 "Disabled" 1 "Modify wind-up time only" 2 "Modify wind-up/down times" DEFAULT_VALUE "UNKNOWN" /end COMPU_VTAB
/begin CHARACTERISTIC crank_LFP_lim_mult "Low fuel pressure wind-up mult" VALUE 0x001c83dc /* @ECU_Address@crank_LFP_lim_mult@0x01013B90@ */ ECIPP_ALIGNMENT_UWORD 1 Compu_crank_LFP_lim_mult 0 0.999984741210938 /end CHARACTERISTIC
/begin COMPU_METHOD Compu_crank_LFP_lim_mult " " RAT_FUNC "%.2" "-" COEFFS 0 65536 0 0 0 1 /end COMPU_METHOD
/begin CHARACTERISTIC crank_LFP_rst_mult "Low fuel pressure wind-down mult" VALUE 0x001c83e0 /* @ECU_Address@crank_LFP_rst_mult@0x01013B98@ */ ECIPP_ALIGNMENT_UWORD 16 Compu_crank_LFP_rst_mult 0 15.999755859375 /end CHARACTERISTIC
/begin COMPU_METHOD Compu_crank_LFP_rst_mult " " RAT_FUNC "%.2" "-" COEFFS 0 4096 0 0 0 1 /end COMPU_METHOD
/begin CHARACTERISTIC RBC_TSC1_arb_mode "Retarder TSC1 arbitration mode{RBC_TSC1_arb_mode&0xff=0:Normal}{RBC_TSC1_arb_mode&0xff=1:Full authority override}{RBC_TSC1_arb_mode&0xff=2:Remove from arbitration}" VALUE 0x001c88b5 /* @ECU_Address@RBC_TSC1_arb_mode@0x01013BB0@ */ ECIPP_ALIGNMENT_UBYTE 255 RBC_TSC1_arb_mode_COMPU_VTAB 0 255 BIT_MASK 0xff /end CHARACTERISTIC
/begin COMPU_METHOD RBC_TSC1_arb_mode_COMPU_VTAB "Verbal Table" TAB_VERB "%.0" "list" COMPU_TAB_REF RBC_TSC1_arb_mode_COMPU_VTAB_REF /end COMPU_METHOD
/begin COMPU_VTAB RBC_TSC1_arb_mode_COMPU_VTAB_REF "Verbal Table" TAB_VERB 3 0 "Normal" 1 "Full authority override" 2 "Remove from arbitration" DEFAULT_VALUE "UNKNOWN" /end COMPU_VTAB
/begin CHARACTERISTIC VSFan_Taux_mode "Aux temperature active mode{VSFan_Taux_mode&0xff=0:Always Active}{VSFan_Taux_mode&0xff=1:Retarder Active}" VALUE 0x001c8f8c /* @ECU_Address@VSFan_Taux_mode@0x01014898@ */ ECIPP_ALIGNMENT_UBYTE 255 VSFan_Taux_mode_COMPU_VTAB 0 255 BIT_MASK 0xff /end CHARACTERISTIC
/begin COMPU_METHOD VSFan_Taux_mode_COMPU_VTAB "Verbal Table" TAB_VERB "%.0" "list" COMPU_TAB_REF VSFan_Taux_mode_COMPU_VTAB_REF /end COMPU_METHOD
/begin COMPU_VTAB VSFan_Taux_mode_COMPU_VTAB_REF "Verbal Table" TAB_VERB 2 0 "Always Active" 1 "Retarder Active" DEFAULT_VALUE "UNKNOWN" /end COMPU_VTAB
/begin CHARACTERISTIC RBC_TSC1_disengage "Retarder TSC1 disengage requests{RBC_TSC1_disengage&0xff=0:Arbitrate All}{RBC_TSC1_disengage&0xff=1:Remove 42491 (Legacy)}{RBC_TSC1_disengage&0xff=2:Disable Retarder Braking}" VALUE 0x001c88b6 /* @ECU_Address@RBC_TSC1_disengage@0x01014938@ */ ECIPP_ALIGNMENT_UBYTE 255 RBC_TSC1_disengage_COMPU_VTAB 0 255 BIT_MASK 0xff /end CHARACTERISTIC
/begin COMPU_METHOD RBC_TSC1_disengage_COMPU_VTAB "Verbal Table" TAB_VERB "%.0" "list" COMPU_TAB_REF RBC_TSC1_disengage_COMPU_VTAB_REF /end COMPU_METHOD
/begin COMPU_VTAB RBC_TSC1_disengage_COMPU_VTAB_REF "Verbal Table" TAB_VERB 3 0 "Arbitrate All" 1 "Remove 42491 (Legacy)" 2 "Disable Retarder Braking" DEFAULT_VALUE "UNKNOWN" /end COMPU_VTAB
/begin CHARACTERISTIC CCH_CL_control "Crankcase heater closed-loop control{CCH_CL_control&0xff=0:Disabled - Open-Loop Only}{CCH_CL_control&0xff=1:Enabled}" VALUE 0x001c8697 /* @ECU_Address@CCH_CL_control@0x01014C48@ */ ECIPP_ALIGNMENT_UBYTE 255 CCH_CL_control_COMPU_VTAB 0 255 BIT_MASK 0xff /end CHARACTERISTIC
/begin COMPU_METHOD CCH_CL_control_COMPU_VTAB "Verbal Table" TAB_VERB "%.0" "list" COMPU_TAB_REF CCH_CL_control_COMPU_VTAB_REF /end COMPU_METHOD
/begin COMPU_VTAB CCH_CL_control_COMPU_VTAB_REF "Verbal Table" TAB_VERB 2 0 "Disabled - Open-Loop Only" 1 "Enabled" DEFAULT_VALUE "UNKNOWN" /end COMPU_VTAB
/begin CHARACTERISTIC CCH_flt_control "Crankcase heater open-loop control{CCH_flt_control&0xff=0:Enabled - AAT and OILT}{CCH_flt_control&0xff=1:Enabled - AAT, IAT key-on}" VALUE 0x001c8699 /* @ECU_Address@CCH_flt_control@0x01014C50@ */ ECIPP_ALIGNMENT_UBYTE 255 CCH_flt_control_COMPU_VTAB 0 255 BIT_MASK 0xff /end CHARACTERISTIC
/begin COMPU_METHOD CCH_flt_control_COMPU_VTAB "Verbal Table" TAB_VERB "%.0" "list" COMPU_TAB_REF CCH_flt_control_COMPU_VTAB_REF /end COMPU_METHOD
/begin COMPU_VTAB CCH_flt_control_COMPU_VTAB_REF "Verbal Table" TAB_VERB 2 0 "Enabled - AAT and OILT" 1 "Enabled - AAT, IAT key-on" DEFAULT_VALUE "UNKNOWN" /end COMPU_VTAB
/begin CHARACTERISTIC CCH_flt_on_temp "Crankcase heater open-loop 'on' temp" VALUE 0x001c6dca /* @ECU_Address@CCH_flt_on_temp@0x01014C58@ */ ECIPP_ALIGNMENT_UWORD 564 Compu_CCH_flt_on_temp -460 563.984375 /end CHARACTERISTIC
/begin COMPU_METHOD Compu_CCH_flt_on_temp " " RAT_FUNC "%.1" "deg F" COEFFS 0 64 29440 0 0 1 /end COMPU_METHOD
/begin CHARACTERISTIC CCH_flt_off_temp "Crankcase heater open-loop 'off' temp" VALUE 0x001c6dc6 /* @ECU_Address@CCH_flt_off_temp@0x01014C60@ */ ECIPP_ALIGNMENT_UWORD 564 Compu_CCH_flt_off_temp -460 563.984375 /end CHARACTERISTIC
/begin COMPU_METHOD Compu_CCH_flt_off_temp " " RAT_FUNC "%.1" "deg F" COEFFS 0 64 29440 0 0 1 /end COMPU_METHOD
/begin CHARACTERISTIC VSFan_SHP_ena "Fan slip heat protection{VSFan_SHP_ena&0xff=0x00:Disabled}{VSFan_SHP_ena&0xff=0x01:Enabled}" VALUE 0x001c8f8a /* @ECU_Address@VSFan_SHP_ena@0x01014E38@ */ ECIPP_ALIGNMENT_UBYTE 255 VSFan_SHP_ena_COMPU_VTAB 0 255 BIT_MASK 0xff /end CHARACTERISTIC
/begin COMPU_METHOD VSFan_SHP_ena_COMPU_VTAB "Verbal Table" TAB_VERB "%.0" "list" COMPU_TAB_REF VSFan_SHP_ena_COMPU_VTAB_REF /end COMPU_METHOD
/begin COMPU_VTAB VSFan_SHP_ena_COMPU_VTAB_REF "Verbal Table" TAB_VERB 2 0x00 "Disabled" 0x01 "Enabled" DEFAULT_VALUE "UNKNOWN" /end COMPU_VTAB
/begin CHARACTERISTIC OPC_ena "Oil pressure control{OPC_ena&0xff=0:Disabled}{OPC_ena&0xff=1:Enabled}" VALUE 0x001c886c /* @ECU_Address@OPC_ena@0x01015358@ */ ECIPP_ALIGNMENT_UBYTE 255 OPC_ena_COMPU_VTAB 0 255 BIT_MASK 0xff /end CHARACTERISTIC
/begin COMPU_METHOD OPC_ena_COMPU_VTAB "Verbal Table" TAB_VERB "%.0" "list" COMPU_TAB_REF OPC_ena_COMPU_VTAB_REF /end COMPU_METHOD
/begin COMPU_VTAB OPC_ena_COMPU_VTAB_REF "Verbal Table" TAB_VERB 2 0 "Disabled" 1 "Enabled" DEFAULT_VALUE "UNKNOWN" /end COMPU_VTAB
/begin CHARACTERISTIC OPC_outchn "OPC output channel{OPC_outchn&0xff=0:Disabled}{OPC_outchn&0xff=1:Aux PWM1}{OPC_outchn&0xff=2:Aux PWM2}{OPC_outchn&0xff=3:Aux PWM3}{OPC_outchn&0xff=4:Aux PWM4}{OPC_outchn&0xff=5:Aux PWM5}{OPC_outchn&0xff=6:Aux PWM6}{OPC_outchn&0xff=7:Aux PWM8}{OPC_outchn&0" VALUE 0x001c886d /* @ECU_Address@OPC_outchn@0x01015360@ */ ECIPP_ALIGNMENT_UBYTE 255 OPC_outchn_COMPU_VTAB 0 255 BIT_MASK 0xff /end CHARACTERISTIC
/begin COMPU_METHOD OPC_outchn_COMPU_VTAB "Verbal Table" TAB_VERB "%.0" "list" COMPU_TAB_REF OPC_outchn_COMPU_VTAB_REF /end COMPU_METHOD
/begin COMPU_VTAB OPC_outchn_COMPU_VTAB_REF "Verbal Table" TAB_VERB 9 0 "Disabled" 1 "Aux PWM1" 2 "Aux PWM2" 3 "Aux PWM3" 4 "Aux PWM4" 5 "Aux PWM5" 6 "Aux PWM6" 7 "Aux PWM8" 8 "Aux PWM9" DEFAULT_VALUE "UNKNOWN" /end COMPU_VTAB
/begin CHARACTERISTIC OPC_lowpass_tau "OPC lowpass tau" VALUE 0x001c8582 /* @ECU_Address@OPC_lowpass_tau@0x01015368@ */ ECIPP_ALIGNMENT_UWORD 3277 Compu_OPC_lowpass_tau 0.0045084 3276.8 /end CHARACTERISTIC
/begin COMPU_METHOD Compu_OPC_lowpass_tau " " FORM "%.2" "sec"
 /begin FORMULA "-0.05 / log(1 - (X1 / 65536))" FORMULA_INV "(1 - exp(-0.05/X1)) * 65536" /end FORMULA
/end COMPU_METHOD
/begin CHARACTERISTIC OPC_DCuplmt "OPC duty cycle upper limit" VALUE 0x001c7e1c /* @ECU_Address@OPC_DCuplmt@0x01015390@ */ ECIPP_ALIGNMENT_UWORD 100 Compu_OPC_DCuplmt 0 99.9984741210938 /end CHARACTERISTIC
/begin COMPU_METHOD Compu_OPC_DCuplmt " " RAT_FUNC "%.1" "%" COEFFS 0 655.36 0 0 0 1 /end COMPU_METHOD
/begin CHARACTERISTIC OPC_DCdnlmt "OPC duty cycle lower limit" VALUE 0x001c7e1a /* @ECU_Address@OPC_DCdnlmt@0x01015398@ */ ECIPP_ALIGNMENT_UWORD 100 Compu_OPC_DCdnlmt 0 99.9984741210938 /end CHARACTERISTIC
/begin COMPU_METHOD Compu_OPC_DCdnlmt " " RAT_FUNC "%.1" "%" COEFFS 0 655.36 0 0 0 1 /end COMPU_METHOD
/begin CHARACTERISTIC crank_LFP_src "Low fuel pressure source{crank_LFP_src&0xff=0:IODI fuel pressure switch}{crank_LFP_src&0xff=1:Secondary fuel rail (LPG)}" VALUE 0x001c8fda /* @ECU_Address@crank_LFP_src@0x01015438@ */ ECIPP_ALIGNMENT_UBYTE 255 crank_LFP_src_COMPU_VTAB 0 255 BIT_MASK 0xff /end CHARACTERISTIC
/begin COMPU_METHOD crank_LFP_src_COMPU_VTAB "Verbal Table" TAB_VERB "%.0" "list" COMPU_TAB_REF crank_LFP_src_COMPU_VTAB_REF /end COMPU_METHOD
/begin COMPU_VTAB crank_LFP_src_COMPU_VTAB_REF "Verbal Table" TAB_VERB 2 0 "IODI fuel pressure switch" 1 "Secondary fuel rail (LPG)" DEFAULT_VALUE "UNKNOWN" /end COMPU_VTAB
/begin CHARACTERISTIC crank_LFP_open_wait "Low fuel pressure wait" VALUE 0x001c83de /* @ECU_Address@crank_LFP_open_wait@0x01015440@ */ ECIPP_ALIGNMENT_UWORD 65535 Compu_crank_LFP_open_wait 0 65535 /end CHARACTERISTIC
/begin COMPU_METHOD Compu_crank_LFP_open_wait " " RAT_FUNC "%.0" "ms" COEFFS 0 1 0 0 0 1 /end COMPU_METHOD
/begin CHARACTERISTIC crank_LFP_Ptgt_mult "Low fuel pressure multiplier" VALUE 0x001c83da /* @ECU_Address@crank_LFP_Ptgt_mult@0x01015448@ */ ECIPP_ALIGNMENT_UWORD 100 Compu_crank_LFP_Ptgt_mult 0 99.9984741210938 /end CHARACTERISTIC
/begin COMPU_METHOD Compu_crank_LFP_Ptgt_mult " " RAT_FUNC "%.0" "%" COEFFS 0 655.36 0 0 0 1 /end COMPU_METHOD
/begin COMPU_METHOD Compu_ETHCth_MAP " " RAT_FUNC "%.2" "MAP (psia)" COEFFS 0 256 0 0 0 1 /end COMPU_METHOD
/begin CHARACTERISTIC ETHCth_CHT "ETHC Threshold" CURVE 0x001C44BC /* @ECU_Address@ETHCth_CHT@0x02077000@ */ ECIPP_ALIGNMENT_SWORD 564 Compu_ETHCth_CHT -1484 563.96875
 /begin AXIS_DESCR COM_AXIS NO_INPUT_QUANTITY Compu_ETHCth_MAP 4 -128 127.99609375 AXIS_PTS_REF ETHCth_MAP /end AXIS_DESCR
/end CHARACTERISTIC
/begin AXIS_PTS ETHCth_MAP " " 0x001C44C4 /* @ECU_Address@ETHCth_MAP@0x02076000@ */ NO_INPUT_QUANTITY ECIPP_Lookup_SWORD 0 Compu_ETHCth_MAP 4 -128 127.99609375 /end AXIS_PTS
/begin COMPU_METHOD Compu_ETHCth_CHT " " RAT_FUNC "%.0" "CHT (deg F)" COEFFS 0 32 14720 0 0 1 /end COMPU_METHOD
/begin CHARACTERISTIC ETHCth_nomDC "ETHC Nominal Duty Cycle" CURVE 0x001C44CC /* @ECU_Address@ETHCth_nomDC@0x02092000@ */ ECIPP_ALIGNMENT_SWORD 100 Compu_ETHCth_nomDC -100 99.9969482421875
 /begin AXIS_DESCR COM_AXIS NO_INPUT_QUANTITY Compu_ETHCth_MAP 4 -128 127.99609375 AXIS_PTS_REF ETHCth_MAP /end AXIS_DESCR
/end CHARACTERISTIC
/begin COMPU_METHOD Compu_ETHCth_nomDC " " RAT_FUNC "%.1" "Nominal DC (%)" COEFFS 0 327.68 0 0 0 1 /end COMPU_METHOD
/begin COMPU_METHOD Compu_TVSFanMaxECT_ECT " " RAT_FUNC "%.1" "ECT (deg F)" COEFFS 0 32 14720 0 0 1 /end COMPU_METHOD
/begin CHARACTERISTIC TVSFanMaxECT_pct "ECT Based Fan Max" CURVE 0x001C5F5C /* @ECU_Address@TVSFanMaxECT_pct@0x0239B000@ */ ECIPP_ALIGNMENT_SWORD 200 Compu_TVSFanMaxECT_pct -200 199.993896484375
 /begin AXIS_DESCR COM_AXIS NO_INPUT_QUANTITY Compu_TVSFanMaxECT_ECT 8 -1484 563.96875 AXIS_PTS_REF TVSFanMaxECT_ECT /end AXIS_DESCR
/end CHARACTERISTIC
/begin AXIS_PTS TVSFanMaxECT_ECT " " 0x001C5F4C /* @ECU_Address@TVSFanMaxECT_ECT@0x0239A000@ */ NO_INPUT_QUANTITY ECIPP_Lookup_SWORD 0 Compu_TVSFanMaxECT_ECT 8 -1484 563.96875 /end AXIS_PTS
/begin COMPU_METHOD Compu_TVSFanMaxECT_pct " " RAT_FUNC "%.1" "Fan Max (%)" COEFFS 0 163.84 0 0 0 1 /end COMPU_METHOD
/begin COMPU_METHOD Compu_TVSFanMax_IATld_ldpct " " RAT_FUNC "%.1" "Ramp rate limited load (%)" COEFFS 0 163.84 0 0 0 1 /end COMPU_METHOD
/begin COMPU_METHOD Compu_TVSFanMax_IATld_IAT " " RAT_FUNC "%.1" "(deg F)" COEFFS 0 32 14720 0 0 1 /end COMPU_METHOD
/begin CHARACTERISTIC TVSFanMax_IATld_pct "Engine Load Fan Max" MAP 0x001C5FA6 /* @ECU_Address@TVSFanMax_IATld_pct@0x0239E000@ */ ECIPP_ALIGNMENT_SWORD 200 Compu_TVSFanMax_IATld_pct -200 199.993896484375
 /begin AXIS_DESCR COM_AXIS NO_INPUT_QUANTITY Compu_TVSFanMax_IATld_ldpct 5 -200 199.993896484375 AXIS_PTS_REF TVSFanMax_IATld_ldpct /end AXIS_DESCR
 /begin AXIS_DESCR COM_AXIS NO_INPUT_QUANTITY Compu_TVSFanMax_IATld_IAT 8 -1484 563.96875 AXIS_PTS_REF TVSFanMax_IATld_IAT /end AXIS_DESCR
/end CHARACTERISTIC
/begin AXIS_PTS TVSFanMax_IATld_ldpct " " 0x001C5F9C /* @ECU_Address@TVSFanMax_IATld_ldpct@0x0239C000@ */ NO_INPUT_QUANTITY ECIPP_Lookup_SWORD 0 Compu_TVSFanMax_IATld_ldpct 5 -200 199.993896484375 /end AXIS_PTS
/begin AXIS_PTS TVSFanMax_IATld_IAT " " 0x001C5F8C /* @ECU_Address@TVSFanMax_IATld_IAT@0x0239D000@ */ NO_INPUT_QUANTITY ECIPP_Lookup_SWORD 0 Compu_TVSFanMax_IATld_IAT 8 -1484 563.96875 /end AXIS_PTS
/begin COMPU_METHOD Compu_TVSFanMax_IATld_pct "" RAT_FUNC "%.1" "Fan max (%)" COEFFS 0 163.84 0 0 0 1 /end COMPU_METHOD
/begin COMPU_METHOD Compu_TVSFan_DC_fanmax " " RAT_FUNC "%.1" "Fan max (%)" COEFFS 0 163.84 0 0 0 1 /end COMPU_METHOD
/begin COMPU_METHOD Compu_TVSFan_DC_rpm " " RAT_FUNC "%.0" "Engine Speed (rpm)" COEFFS 0 1 0 0 0 1 /end COMPU_METHOD
/begin CHARACTERISTIC TVSFan_DC_pct "Fan Control Schedule" MAP 0x001C5FFC /* @ECU_Address@TVSFan_DC_pct@0x023A1000@ */ ECIPP_ALIGNMENT_SWORD 200 Compu_TVSFan_DC_pct -200 199.993896484375
 /begin AXIS_DESCR COM_AXIS NO_INPUT_QUANTITY Compu_TVSFan_DC_fanmax 3 -200 199.993896484375 AXIS_PTS_REF TVSFan_DC_fanmax /end AXIS_DESCR
 /begin AXIS_DESCR COM_AXIS NO_INPUT_QUANTITY Compu_TVSFan_DC_rpm 6 -32768 32767 AXIS_PTS_REF TVSFan_DC_rpm /end AXIS_DESCR
/end CHARACTERISTIC
/begin AXIS_PTS TVSFan_DC_fanmax " " 0x001C5FF6 /* @ECU_Address@TVSFan_DC_fanmax@0x0239F000@ */ NO_INPUT_QUANTITY ECIPP_Lookup_SWORD 0 Compu_TVSFan_DC_fanmax 3 -200 199.993896484375 /end AXIS_PTS
/begin AXIS_PTS TVSFan_DC_rpm " " 0x001C6020 /* @ECU_Address@TVSFan_DC_rpm@0x023A0000@ */ NO_INPUT_QUANTITY ECIPP_Lookup_SWORD 0 Compu_TVSFan_DC_rpm 6 -32768 32767 /end AXIS_PTS
/begin COMPU_METHOD Compu_TVSFan_DC_pct "" RAT_FUNC "%.1" "Duty-Cycle (%)" COEFFS 0 163.84 0 0 0 1 /end COMPU_METHOD
/begin COMPU_METHOD Compu_TVSFan_rpm_rpm " " RAT_FUNC "%.0" "Engine Speed (rpm)" COEFFS 0 1 0 0 0 1 /end COMPU_METHOD
/begin CHARACTERISTIC TVSFan_rpm_Kp "Fan Speed Gains Kp" CURVE 0x001C6080 /* @ECU_Address@TVSFan_rpm_Kp@0x02629000@ */ ECIPP_ALIGNMENT_SWORD 3125 Compu_TVSFan_rpm_Kp -3125 3124.90463256836
 /begin AXIS_DESCR COM_AXIS NO_INPUT_QUANTITY Compu_TVSFan_rpm_rpm 6 -32768 32767 AXIS_PTS_REF TVSFan_rpm_rpm /end AXIS_DESCR
/end CHARACTERISTIC
/begin AXIS_PTS TVSFan_rpm_rpm " " 0x001C60B0 /* @ECU_Address@TVSFan_rpm_rpm@0x02628000@ */ NO_INPUT_QUANTITY ECIPP_Lookup_SWORD 0 Compu_TVSFan_rpm_rpm 6 -32768 32767 /end AXIS_PTS
/begin COMPU_METHOD Compu_TVSFan_rpm_Kp " " RAT_FUNC "%.1" "Fan Speed Kp (%/Kprm)" COEFFS 0 10.48576 0 0 0 1 /end COMPU_METHOD
/begin CHARACTERISTIC TVSFan_rpm_Ki "Fan Speed Gains Ki" CURVE 0x001C6068 /* @ECU_Address@TVSFan_rpm_Ki@0x0262A000@ */ ECIPP_ALIGNMENT_SWORD 12207 Compu_TVSFan_rpm_Ki -12207.03125 12206.6587209702
 /begin AXIS_DESCR COM_AXIS NO_INPUT_QUANTITY Compu_TVSFan_rpm_rpm 6 -32768 32767 AXIS_PTS_REF TVSFan_rpm_rpm /end AXIS_DESCR
/end CHARACTERISTIC
/begin COMPU_METHOD Compu_TVSFan_rpm_Ki " " RAT_FUNC "%.1" "Fan Speed Ki (%/Kprm/sec)" COEFFS 0 2.68435456 0 0 0 1 /end COMPU_METHOD
/begin CHARACTERISTIC TVSFan_rpm_Kd "Fan Speed Gains Kd" CURVE 0x001C605C /* @ECU_Address@TVSFan_rpm_Kd@0x0262B000@ */ ECIPP_ALIGNMENT_SWORD 1600 Compu_TVSFan_rpm_Kd -1600 1599.951171875
 /begin AXIS_DESCR COM_AXIS NO_INPUT_QUANTITY Compu_TVSFan_rpm_rpm 6 -32768 32767 AXIS_PTS_REF TVSFan_rpm_rpm /end AXIS_DESCR
/end CHARACTERISTIC
/begin COMPU_METHOD Compu_TVSFan_rpm_Kd " " RAT_FUNC "%.2" "Fan Speed Kd (%/(Kprm/sec))" COEFFS 0 20.48 0 0 0 1 /end COMPU_METHOD
/begin CHARACTERISTIC TVSFan_rpm_Kiv "Fan Speed Gains Kiv" CURVE 0x001C6074 /* @ECU_Address@TVSFan_rpm_Kiv@0x0262C000@ */ ECIPP_ALIGNMENT_SWORD 6250 Compu_TVSFan_rpm_Kiv -6250 6249.80926513672
 /begin AXIS_DESCR COM_AXIS NO_INPUT_QUANTITY Compu_TVSFan_rpm_rpm 6 -32768 32767 AXIS_PTS_REF TVSFan_rpm_rpm /end AXIS_DESCR
/end CHARACTERISTIC
/begin COMPU_METHOD Compu_TVSFan_rpm_Kiv " " RAT_FUNC "%.2" "Fan Speed Kiv (%/Kprm)" COEFFS 0 5.24288 0 0 0 1 /end COMPU_METHOD
/begin CHARACTERISTIC TVSFan_rpm_dzKp "Proportional Dead-zone" CURVE 0x001C60A4 /* @ECU_Address@TVSFan_rpm_dzKp@0x0262D000@ */ ECIPP_ALIGNMENT_SWORD 32767 Compu_TVSFan_rpm_dzKp -32768 32767
 /begin AXIS_DESCR COM_AXIS NO_INPUT_QUANTITY Compu_TVSFan_rpm_rpm 6 -32768 32767 AXIS_PTS_REF TVSFan_rpm_rpm /end AXIS_DESCR
/end CHARACTERISTIC
/begin COMPU_METHOD Compu_TVSFan_rpm_dzKp " " RAT_FUNC "%.0" "Kp dz (rpm)" COEFFS 0 1 0 0 0 1 /end COMPU_METHOD
/begin CHARACTERISTIC TVSFan_rpm_dzKi "Integrator Dead-zone" CURVE 0x001C6098 /* @ECU_Address@TVSFan_rpm_dzKi@0x0262E000@ */ ECIPP_ALIGNMENT_SWORD 32767 Compu_TVSFan_rpm_dzKi -32768 32767
 /begin AXIS_DESCR COM_AXIS NO_INPUT_QUANTITY Compu_TVSFan_rpm_rpm 6 -32768 32767 AXIS_PTS_REF TVSFan_rpm_rpm /end AXIS_DESCR
/end CHARACTERISTIC
/begin COMPU_METHOD Compu_TVSFan_rpm_dzKi " " RAT_FUNC "%.0" "Ki dz (rpm)" COEFFS 0 1 0 0 0 1 /end COMPU_METHOD
/begin CHARACTERISTIC TVSFan_rpm_dzKd "Derivative Dead-zone" CURVE 0x001C608C /* @ECU_Address@TVSFan_rpm_dzKd@0x0262F000@ */ ECIPP_ALIGNMENT_SWORD 64 Compu_TVSFan_rpm_dzKd -64 63.998046875
 /begin AXIS_DESCR COM_AXIS NO_INPUT_QUANTITY Compu_TVSFan_rpm_rpm 6 -32768 32767 AXIS_PTS_REF TVSFan_rpm_rpm /end AXIS_DESCR
/end CHARACTERISTIC
/begin COMPU_METHOD Compu_TVSFan_rpm_dzKd " " RAT_FUNC "%.2" "Kd dz (rpm/ms)" COEFFS 0 512 0 0 0 1 /end COMPU_METHOD
/begin COMPU_METHOD Compu_TVSFan_mult_fanmax " " RAT_FUNC "%.1" "Fan Maximum (%)" COEFFS 0 327.68 0 0 0 1 /end COMPU_METHOD
/begin CHARACTERISTIC TVSFan_Kdm "Fan Maximum Gain Adjustments" CURVE 0x001C602C /* @ECU_Address@TVSFan_Kdm@0x02631000@ */ ECIPP_ALIGNMENT_SWORD 8 Compu_TVSFan_Kdm -8 7.999755859375
 /begin AXIS_DESCR COM_AXIS NO_INPUT_QUANTITY Compu_TVSFan_mult_fanmax 6 -100 99.9969482421875 AXIS_PTS_REF TVSFan_mult_fanmax /end AXIS_DESCR
/end CHARACTERISTIC
/begin AXIS_PTS TVSFan_mult_fanmax " " 0x001C6050 /* @ECU_Address@TVSFan_mult_fanmax@0x02630000@ */ NO_INPUT_QUANTITY ECIPP_Lookup_SWORD 0 Compu_TVSFan_mult_fanmax 6 -100 99.9969482421875 /end AXIS_PTS
/begin COMPU_METHOD Compu_TVSFan_Kdm " " RAT_FUNC "%.2" "Kd Multiplier" COEFFS 0 4096 0 0 0 1 /end COMPU_METHOD
/begin CHARACTERISTIC TVSFan_Kivm "Fan Max Gain Adjustments Kivm" CURVE 0x001C6038 /* @ECU_Address@TVSFan_Kivm@0x02632000@ */ ECIPP_ALIGNMENT_SWORD 64 Compu_TVSFan_Kivm -64 63.998046875
 /begin AXIS_DESCR COM_AXIS NO_INPUT_QUANTITY Compu_TVSFan_mult_fanmax 6 -100 99.9969482421875 AXIS_PTS_REF TVSFan_mult_fanmax /end AXIS_DESCR
/end CHARACTERISTIC
/begin COMPU_METHOD Compu_TVSFan_Kivm " " RAT_FUNC "%.2" "Kiv Multiplier" COEFFS 0 512 0 0 0 1 /end COMPU_METHOD
/begin COMPU_METHOD Compu_TVSFanMaxTaux_T " " RAT_FUNC "%.1" "Temp (deg F)" COEFFS 0 8 3680 0 0 1 /end COMPU_METHOD
/begin CHARACTERISTIC TVSFanMaxTaux_pct "Aux Temp Based Fan Max" CURVE 0x001C5F7C /* @ECU_Address@TVSFanMaxTaux_pct@0x0263C000@ */ ECIPP_ALIGNMENT_SWORD 100 Compu_TVSFanMaxTaux_pct -100 99.9969482421875
 /begin AXIS_DESCR COM_AXIS NO_INPUT_QUANTITY Compu_TVSFanMaxTaux_T 8 -4556 3635.875 AXIS_PTS_REF TVSFanMaxTaux_T /end AXIS_DESCR
/end CHARACTERISTIC
/begin AXIS_PTS TVSFanMaxTaux_T " " 0x001C5F6C /* @ECU_Address@TVSFanMaxTaux_T@0x0263B000@ */ NO_INPUT_QUANTITY ECIPP_Lookup_SWORD 0 Compu_TVSFanMaxTaux_T 8 -4556 3635.875 /end AXIS_PTS
/begin COMPU_METHOD Compu_TVSFanMaxTaux_pct " " RAT_FUNC "%.1" "Fan Max (%)" COEFFS 0 327.68 0 0 0 1 /end COMPU_METHOD
/begin COMPU_METHOD Compu_TVSFanMaxACT_AAT " " RAT_FUNC "%.1" "AAT (deg F)" COEFFS 0 32 14720 0 0 1 /end COMPU_METHOD
/begin COMPU_METHOD Compu_TVSFanMaxACT_pct " " RAT_FUNC "%.1" "Fan max (%)" COEFFS 0 163.84 0 0 0 1 /end COMPU_METHOD
/begin CHARACTERISTIC TVSFanMaxACT_ACT "ACT Based Fan Maximum" MAP 0x001C5F22 /* @ECU_Address@TVSFanMaxACT_ACT@0x0268E000@ */ ECIPP_ALIGNMENT_SWORD 564 Compu_TVSFanMaxACT_ACT -1484 563.96875
 /begin AXIS_DESCR COM_AXIS NO_INPUT_QUANTITY Compu_TVSFanMaxACT_pct 3 -200 199.993896484375 AXIS_PTS_REF TVSFanMaxACT_pct /end AXIS_DESCR
 /begin AXIS_DESCR COM_AXIS NO_INPUT_QUANTITY Compu_TVSFanMaxACT_AAT 6 -1484 563.96875 AXIS_PTS_REF TVSFanMaxACT_AAT /end AXIS_DESCR
/end CHARACTERISTIC
/begin AXIS_PTS TVSFanMaxACT_pct " " 0x001C5F46 /* @ECU_Address@TVSFanMaxACT_pct@0x0268D000@ */ NO_INPUT_QUANTITY ECIPP_Lookup_SWORD 0 Compu_TVSFanMaxACT_pct 3 -200 199.993896484375 /end AXIS_PTS
/begin AXIS_PTS TVSFanMaxACT_AAT " " 0x001C5F16 /* @ECU_Address@TVSFanMaxACT_AAT@0x0268C000@ */ NO_INPUT_QUANTITY ECIPP_Lookup_SWORD 0 Compu_TVSFanMaxACT_AAT 6 -1484 563.96875 /end AXIS_PTS
/begin COMPU_METHOD Compu_TVSFanMaxACT_ACT "" RAT_FUNC "%.1" "ACT (deg F)" COEFFS 0 32 14720 0 0 1 /end COMPU_METHOD
/begin COMPU_METHOD Compu_TVSFan_SHP_eng_rpm " " RAT_FUNC "%.0" "Speed (rpm)" COEFFS 0 1 0 0 0 1 /end COMPU_METHOD
/begin CHARACTERISTIC TVSFan_SHP_lwr_lmt "Fan Slip Heat Protection" CURVE 0x001C823C /* @ECU_Address@TVSFan_SHP_lwr_lmt@0x026BA000@ */ ECIPP_ALIGNMENT_UWORD 65535 Compu_TVSFan_SHP_lwr_lmt 0 65535
 /begin AXIS_DESCR COM_AXIS NO_INPUT_QUANTITY Compu_TVSFan_SHP_eng_rpm 6 -32768 32767 AXIS_PTS_REF TVSFan_SHP_eng_rpm /end AXIS_DESCR
/end CHARACTERISTIC
/begin AXIS_PTS TVSFan_SHP_eng_rpm " " 0x001C6044 /* @ECU_Address@TVSFan_SHP_eng_rpm@0x026B9000@ */ NO_INPUT_QUANTITY ECIPP_Lookup_SWORD 0 Compu_TVSFan_SHP_eng_rpm 6 -32768 32767 /end AXIS_PTS
/begin COMPU_METHOD Compu_TVSFan_SHP_lwr_lmt " " RAT_FUNC "%.0" "Lower Limit (rpm)" COEFFS 0 1 0 0 0 1 /end COMPU_METHOD
/begin CHARACTERISTIC TVSFan_SHP_lwr_hyst "Fan Slip Heat Protection" CURVE 0x001C8230 /* @ECU_Address@TVSFan_SHP_lwr_hyst@0x026BB000@ */ ECIPP_ALIGNMENT_UWORD 65535 Compu_TVSFan_SHP_lwr_hyst 0 65535
 /begin AXIS_DESCR COM_AXIS NO_INPUT_QUANTITY Compu_TVSFan_SHP_eng_rpm 6 -32768 32767 AXIS_PTS_REF TVSFan_SHP_eng_rpm /end AXIS_DESCR
/end CHARACTERISTIC
/begin COMPU_METHOD Compu_TVSFan_SHP_lwr_hyst " " RAT_FUNC "%.0" "Lower Hysteresis (rpm)" COEFFS 0 1 0 0 0 1 /end COMPU_METHOD
/begin CHARACTERISTIC TVSFan_SHP_upr_hyst "Fan Slip Heat Protection" CURVE 0x001C8248 /* @ECU_Address@TVSFan_SHP_upr_hyst@0x026BC000@ */ ECIPP_ALIGNMENT_UWORD 65535 Compu_TVSFan_SHP_upr_hyst 0 65535
 /begin AXIS_DESCR COM_AXIS NO_INPUT_QUANTITY Compu_TVSFan_SHP_eng_rpm 6 -32768 32767 AXIS_PTS_REF TVSFan_SHP_eng_rpm /end AXIS_DESCR
/end CHARACTERISTIC
/begin COMPU_METHOD Compu_TVSFan_SHP_upr_hyst " " RAT_FUNC "%.0" "Upper Hysteresis (rpm)" COEFFS 0 1 0 0 0 1 /end COMPU_METHOD
/begin CHARACTERISTIC TVSFan_SHP_upr_lmt "Fan Slip Heat Protection" CURVE 0x001C8254 /* @ECU_Address@TVSFan_SHP_upr_lmt@0x026BD000@ */ ECIPP_ALIGNMENT_UWORD 65535 Compu_TVSFan_SHP_upr_lmt 0 65535
 /begin AXIS_DESCR COM_AXIS NO_INPUT_QUANTITY Compu_TVSFan_SHP_eng_rpm 6 -32768 32767 AXIS_PTS_REF TVSFan_SHP_eng_rpm /end AXIS_DESCR
/end CHARACTERISTIC
/begin COMPU_METHOD Compu_TVSFan_SHP_upr_lmt " " RAT_FUNC "%.0" "Upper Limit (rpm)" COEFFS 0 1 0 0 0 1 /end COMPU_METHOD
/begin COMPU_METHOD Compu_TOPC_CUV_FAC_ECT " " RAT_FUNC "%.1" "ECT (deg F)" COEFFS 0 32 14720 0 0 1 /end COMPU_METHOD
/begin CHARACTERISTIC TOPC_CUV_FAC_OILT "ECT to OilT Fallback" CURVE 0x001C813E /* @ECU_Address@TOPC_CUV_FAC_OILT@0x026D3000@ */ ECIPP_ALIGNMENT_UWORD 7732 Compu_TOPC_CUV_FAC_OILT -460 7731.875
 /begin AXIS_DESCR COM_AXIS NO_INPUT_QUANTITY Compu_TOPC_CUV_FAC_ECT 8 -1484 563.96875 AXIS_PTS_REF TOPC_CUV_FAC_ECT /end AXIS_DESCR
/end CHARACTERISTIC
/begin AXIS_PTS TOPC_CUV_FAC_ECT " " 0x001C56AE /* @ECU_Address@TOPC_CUV_FAC_ECT@0x026D2000@ */ NO_INPUT_QUANTITY ECIPP_Lookup_SWORD 0 Compu_TOPC_CUV_FAC_ECT 8 -1484 563.96875 /end AXIS_PTS
/begin COMPU_METHOD Compu_TOPC_CUV_FAC_OILT " " RAT_FUNC "%.1" "OilT (deg F)" COEFFS 0 8 3680 0 0 1 /end COMPU_METHOD
/begin COMPU_METHOD Compu_TOPC_CUV_rpmlimit " " RAT_FUNC "%.0" "Engine Speed (rpm)" COEFFS 0 1 0 0 0 1 /end COMPU_METHOD
/begin CHARACTERISTIC TOPC_CUV_psi_max "OilP Target Pressure Limit" CURVE 0x001C814E /* @ECU_Address@TOPC_CUV_psi_max@0x026D5000@ */ ECIPP_ALIGNMENT_UWORD 256 Compu_TOPC_CUV_psi_max 0 255.99609375
 /begin AXIS_DESCR COM_AXIS NO_INPUT_QUANTITY Compu_TOPC_CUV_rpmlimit 8 -32768 32767 AXIS_PTS_REF TOPC_CUV_rpmlimit /end AXIS_DESCR
/end CHARACTERISTIC
/begin AXIS_PTS TOPC_CUV_rpmlimit " " 0x001C56DE /* @ECU_Address@TOPC_CUV_rpmlimit@0x026D4000@ */ NO_INPUT_QUANTITY ECIPP_Lookup_SWORD 0 Compu_TOPC_CUV_rpmlimit 8 -32768 32767 /end AXIS_PTS
/begin COMPU_METHOD Compu_TOPC_CUV_psi_max " " RAT_FUNC "%.1" "Upper Limit (psia)" COEFFS 0 256 0 0 0 1 /end COMPU_METHOD
/begin CHARACTERISTIC TOPC_CUV_psi_min "OilP Target Pressure Limit" CURVE 0x001C815E /* @ECU_Address@TOPC_CUV_psi_min@0x026D6000@ */ ECIPP_ALIGNMENT_UWORD 256 Compu_TOPC_CUV_psi_min 0 255.99609375
 /begin AXIS_DESCR COM_AXIS NO_INPUT_QUANTITY Compu_TOPC_CUV_rpmlimit 8 -32768 32767 AXIS_PTS_REF TOPC_CUV_rpmlimit /end AXIS_DESCR
/end CHARACTERISTIC
/begin COMPU_METHOD Compu_TOPC_CUV_psi_min " " RAT_FUNC "%.1" "Lower Limit (psia)" COEFFS 0 256 0 0 0 1 /end COMPU_METHOD
/begin CHARACTERISTIC TOPC_BRK_psi "OilP Target for Engine Brake" CURVE 0x001C812E /* @ECU_Address@TOPC_BRK_psi@0x026D7000@ */ ECIPP_ALIGNMENT_UWORD 256 Compu_TOPC_BRK_psi 0 255.99609375
 /begin AXIS_DESCR COM_AXIS NO_INPUT_QUANTITY Compu_TOPC_CUV_rpmlimit 8 -32768 32767 AXIS_PTS_REF TOPC_CUV_rpmlimit /end AXIS_DESCR
/end CHARACTERISTIC
/begin COMPU_METHOD Compu_TOPC_BRK_psi " " RAT_FUNC "%.1" "OilP Target (psia)" COEFFS 0 256 0 0 0 1 /end COMPU_METHOD
/begin COMPU_METHOD Compu_TOPC_oilt " " RAT_FUNC "%.1" "OilT (deg F)" COEFFS 0 8 3680 0 0 1 /end COMPU_METHOD
/begin CHARACTERISTIC TOPC_oilpct "OilT-Based Multiplier" CURVE 0x001C817E /* @ECU_Address@TOPC_oilpct@0x026D9000@ */ ECIPP_ALIGNMENT_UWORD 200 Compu_TOPC_oilpct 0 199.996948242188
 /begin AXIS_DESCR COM_AXIS NO_INPUT_QUANTITY Compu_TOPC_oilt 8 -4556 3635.875 AXIS_PTS_REF TOPC_oilt /end AXIS_DESCR
/end CHARACTERISTIC
/begin AXIS_PTS TOPC_oilt " " 0x001C583E /* @ECU_Address@TOPC_oilt@0x026D8000@ */ NO_INPUT_QUANTITY ECIPP_Lookup_SWORD 0 Compu_TOPC_oilt 8 -4556 3635.875 /end AXIS_PTS
/begin COMPU_METHOD Compu_TOPC_oilpct " " RAT_FUNC "%.1" "Coefficient (%)" COEFFS 0 327.68 0 0 0 1 /end COMPU_METHOD
/begin COMPU_METHOD Compu_TOPC_barot " " RAT_FUNC "%.1" "BP (psia)" COEFFS 0 256 0 0 0 1 /end COMPU_METHOD
/begin CHARACTERISTIC TOPC_baropct "BP-Based Multiplier" CURVE 0x001C816E /* @ECU_Address@TOPC_baropct@0x026DB000@ */ ECIPP_ALIGNMENT_UWORD 200 Compu_TOPC_baropct 0 199.996948242188
 /begin AXIS_DESCR COM_AXIS NO_INPUT_QUANTITY Compu_TOPC_barot 8 -128 127.99609375 AXIS_PTS_REF TOPC_barot /end AXIS_DESCR
/end CHARACTERISTIC
/begin AXIS_PTS TOPC_barot " " 0x001C582E /* @ECU_Address@TOPC_barot@0x026DA000@ */ NO_INPUT_QUANTITY ECIPP_Lookup_SWORD 0 Compu_TOPC_barot 8 -128 127.99609375 /end AXIS_PTS
/begin COMPU_METHOD Compu_TOPC_baropct " " RAT_FUNC "%.1" "Coefficient (%)" COEFFS 0 327.68 0 0 0 1 /end COMPU_METHOD
/begin COMPU_METHOD Compu_TOPC_CUV_MAPLOAD " " RAT_FUNC "%.1" "MAP load (psia)" COEFFS 0 256 0 0 0 1 /end COMPU_METHOD
/begin COMPU_METHOD Compu_TOPC_CUV_rpm " " RAT_FUNC "%.0" "Engine Speed (rpm)" COEFFS 0 1 0 0 0 1 /end COMPU_METHOD
/begin CHARACTERISTIC TOPC_BASE_pressW "OilP Base Target" MAP 0x001C55AE /* @ECU_Address@TOPC_BASE_pressW@0x026DE000@ */ ECIPP_ALIGNMENT_SWORD 128 Compu_TOPC_BASE_pressW -128 127.99609375
 /begin AXIS_DESCR COM_AXIS NO_INPUT_QUANTITY Compu_TOPC_CUV_MAPLOAD 8 -128 127.99609375 AXIS_PTS_REF TOPC_CUV_MAPLOAD /end AXIS_DESCR
 /begin AXIS_DESCR COM_AXIS NO_INPUT_QUANTITY Compu_TOPC_CUV_rpm 8 -32768 32767 AXIS_PTS_REF TOPC_CUV_rpm /end AXIS_DESCR
/end CHARACTERISTIC
/begin AXIS_PTS TOPC_CUV_MAPLOAD " " 0x001C56BE /* @ECU_Address@TOPC_CUV_MAPLOAD@0x026DC000@ */ NO_INPUT_QUANTITY ECIPP_Lookup_SWORD 0 Compu_TOPC_CUV_MAPLOAD 8 -128 127.99609375 /end AXIS_PTS
/begin AXIS_PTS TOPC_CUV_rpm " " 0x001C56CE /* @ECU_Address@TOPC_CUV_rpm@0x026DD000@ */ NO_INPUT_QUANTITY ECIPP_Lookup_SWORD 0 Compu_TOPC_CUV_rpm 8 -32768 32767 /end AXIS_PTS
/begin COMPU_METHOD Compu_TOPC_BASE_pressW "" RAT_FUNC "%.2" "Pressure (psia)" COEFFS 0 256 0 0 0 1 /end COMPU_METHOD
/begin CHARACTERISTIC TOPC_OIL_pressW "OilT-Based Target Offset" MAP 0x001C57AE /* @ECU_Address@TOPC_OIL_pressW@0x026DF000@ */ ECIPP_ALIGNMENT_SWORD 128 Compu_TOPC_OIL_pressW -128 127.99609375
 /begin AXIS_DESCR COM_AXIS NO_INPUT_QUANTITY Compu_TOPC_CUV_MAPLOAD 8 -128 127.99609375 AXIS_PTS_REF TOPC_CUV_MAPLOAD /end AXIS_DESCR
 /begin AXIS_DESCR COM_AXIS NO_INPUT_QUANTITY Compu_TOPC_CUV_rpm 8 -32768 32767 AXIS_PTS_REF TOPC_CUV_rpm /end AXIS_DESCR
/end CHARACTERISTIC
/begin COMPU_METHOD Compu_TOPC_OIL_pressW "" RAT_FUNC "%.2" "Pressure (psia)" COEFFS 0 256 0 0 0 1 /end COMPU_METHOD
/begin CHARACTERISTIC TOPC_BP_pressW "BP-Based Target Offset" MAP 0x001C562E /* @ECU_Address@TOPC_BP_pressW@0x026E0000@ */ ECIPP_ALIGNMENT_SWORD 128 Compu_TOPC_BP_pressW -128 127.99609375
 /begin AXIS_DESCR COM_AXIS NO_INPUT_QUANTITY Compu_TOPC_CUV_MAPLOAD 8 -128 127.99609375 AXIS_PTS_REF TOPC_CUV_MAPLOAD /end AXIS_DESCR
 /begin AXIS_DESCR COM_AXIS NO_INPUT_QUANTITY Compu_TOPC_CUV_rpm 8 -32768 32767 AXIS_PTS_REF TOPC_CUV_rpm /end AXIS_DESCR
/end CHARACTERISTIC
/begin COMPU_METHOD Compu_TOPC_BP_pressW "" RAT_FUNC "%.2" "Pressure (psia)" COEFFS 0 256 0 0 0 1 /end COMPU_METHOD
/begin COMPU_METHOD Compu_TOPC_FF_pressW " " RAT_FUNC "%.1" "Desired Pressure (psia)" COEFFS 0 256 0 0 0 1 /end COMPU_METHOD
/begin CHARACTERISTIC TOPC_FF_W "OPC Feedforward Command" MAP 0x001C56EE /* @ECU_Address@TOPC_FF_W@0x026E2000@ */ ECIPP_ALIGNMENT_SWORD 200 Compu_TOPC_FF_W -200 199.993896484375
 /begin AXIS_DESCR COM_AXIS NO_INPUT_QUANTITY Compu_TOPC_FF_pressW 8 -128 127.99609375 AXIS_PTS_REF TOPC_FF_pressW /end AXIS_DESCR
 /begin AXIS_DESCR COM_AXIS NO_INPUT_QUANTITY Compu_TOPC_CUV_rpm 8 -32768 32767 AXIS_PTS_REF TOPC_CUV_rpm /end AXIS_DESCR
/end CHARACTERISTIC
/begin AXIS_PTS TOPC_FF_pressW " " 0x001C576E /* @ECU_Address@TOPC_FF_pressW@0x026E1000@ */ NO_INPUT_QUANTITY ECIPP_Lookup_SWORD 0 Compu_TOPC_FF_pressW 8 -128 127.99609375 /end AXIS_PTS
/begin COMPU_METHOD Compu_TOPC_FF_W "" RAT_FUNC "%.2" "Duty Cycle (%)" COEFFS 0 163.84 0 0 0 1 /end COMPU_METHOD
/begin CHARACTERISTIC TOPC_Kp "OPC Feedback Gains" CURVE 0x001C579E /* @ECU_Address@TOPC_Kp@0x026E3000@ */ ECIPP_ALIGNMENT_SWORD 32 Compu_TOPC_Kp -32 31.9990234375
 /begin AXIS_DESCR COM_AXIS NO_INPUT_QUANTITY Compu_TOPC_CUV_rpm 8 -32768 32767 AXIS_PTS_REF TOPC_CUV_rpm /end AXIS_DESCR
/end CHARACTERISTIC
/begin COMPU_METHOD Compu_TOPC_Kp " " RAT_FUNC "%.3" "Kp (volts/psi)" COEFFS 0 1024 0 0 0 1 /end COMPU_METHOD
/begin CHARACTERISTIC TOPC_Ki "OPC Feedback Gains" CURVE 0x001C578E /* @ECU_Address@TOPC_Ki@0x026E4000@ */ ECIPP_ALIGNMENT_SWORD 32 Compu_TOPC_Ki -32 31.9990234375
 /begin AXIS_DESCR COM_AXIS NO_INPUT_QUANTITY Compu_TOPC_CUV_rpm 8 -32768 32767 AXIS_PTS_REF TOPC_CUV_rpm /end AXIS_DESCR
/end CHARACTERISTIC
/begin COMPU_METHOD Compu_TOPC_Ki " " RAT_FUNC "%.3" "Ki (volts/psi/sec)" COEFFS 0 1024 0 0 0 1 /end COMPU_METHOD
/begin CHARACTERISTIC TOPC_Kd "OPC Feedback Gains" CURVE 0x001C577E /* @ECU_Address@TOPC_Kd@0x026E5000@ */ ECIPP_ALIGNMENT_SWORD 32 Compu_TOPC_Kd -32 31.9990234375
 /begin AXIS_DESCR COM_AXIS NO_INPUT_QUANTITY Compu_TOPC_CUV_rpm 8 -32768 32767 AXIS_PTS_REF TOPC_CUV_rpm /end AXIS_DESCR
/end CHARACTERISTIC
/begin COMPU_METHOD Compu_TOPC_Kd " " RAT_FUNC "%.3" "Kd (volts/psi*sec)" COEFFS 0 1024 0 0 0 1 /end COMPU_METHOD
/begin GROUP EC_Outputs "ECONTROLS" ROOT
 /begin REF_CHARACTERISTIC cfgout2_DG1on cfgout2_DG1off cfgout3_DG1on cfgout3_DG1off start_lock_output cfgout_keyoff MaxSetPt_appup_kph MaxSetPt_appdn_kph MSP2_appup_kph MSP2_appdn_kph MSP2_appup_rpm MSP2_appdn_rpm MSP2_blkup_ont MSP2_blkup_offt MSP2_blkdn_ont MSP2_blkdn_offt MSP_app_lock_kph MSP2_app_lock_kph cfgout_Vbatlon cfgout_Vbatloff cfgout2_Vbatlon cfgout2_Vbatloff cfgout3_Vbatlon cfgout3_Vbatloff cfgout_Vbaton cfgout_Vbatoff cfgout2_Vbaton cfgout2_Vbatoff cfgout3_Vbaton cfgout3_Vbatoff run_latch_wait stop_latch_wait crank_SD_latch drivebrake_mode drivebrake_chan crank_trans_neut SWARNblk_open_on SWARNblk_open_off HWARNblk_open_on HWARNblk_open_off MILblk_open_on MILblk_open_off MILblk_open_ini SWARNchan_open HWARNchan_open MILchan_open WARN_engstop AWARN_ena AWARN_chan AWARNblk_ini AWARNblk_on AWARNblk_off AWARNblk_reps cfgout_andor_on cfgout_andor_off cfgout2_andor_on cfgout2_andor_off cfgout3_andor_on cfgout3_andor_off cfgout_CLlon cfgout_CLloff cfgout_CLon cfgout_CLoff cfgout_MILlon cfgout_MILloff cfgout_MILon cfgout_MILoff cfgout2_CLlon cfgout2_CLloff cfgout2_CLon cfgout2_CLoff cfgout2_MILlon cfgout2_MILloff cfgout2_MILon cfgout2_MILoff cfgout3_CLlon cfgout3_CLloff cfgout3_CLon cfgout3_CLoff cfgout3_MILlon cfgout3_MILloff cfgout3_MILon cfgout3_MILoff autocrk_reset autocrk_starttmr crank_trans_FBlim start_autocrk_wt crank_trans_wait IOPWM_hydraulic_ena IOPWM_hydraulic_fwd IOPWM_hydraulic_rev IODO_bkup_alm_light IODO_light_work_frnt IODO_light_work_rear IODO_light_brake IODO_trans_enable IOAI_hydraulic_fwd IOAI_hydraulic_rev IOAI_trans_temp IOAI_brake_pedal_pos IOAI_park_brake_pos IOAI_seat_occupancy IODI_fuel_pressure IODI_brake_fluid_lvl SCC1_L SCC1_R SCC1_Vd SCC1_Ki SCC1_Imin SCC1_Imax SCC1_cmd_min SCC1_calc_min SCC2_L SCC2_R SCC2_Vd SCC2_Ki SCC2_Imin SCC2_Imax SCC2_cmd_min SCC2_calc_min SCC1_cmd_max SCC2_cmd_max tach_override_dis exhbrake_chan exhbrake_mode exhbrake_retard_pct RBC_outofgear RBC_enabled cfgout_IATon cfgout_IAToff cfgout_IATlon cfgout_IATloff cfgout2_IATon cfgout2_IAToff cfgout2_IATlon cfgout2_IATloff cfgout3_IATon cfgout3_IAToff cfgout3_IATlon cfgout3_IATloff BTN_stop_ena BTN_stop_rpm_min BTN_stop_wt MILblk_trigger_ena ETC_loss_crank_wt autocrk_trig_windup IODO_fuel_type_light fuel_type_indicate VSFan_ena VSFan_channel VSFan_output_Hz VSFan_pulses_rev VSFan_drive_ratio VSFan_slip_x VSFan_ac VSFan_drivebrake VSFan_dz VSFan_off_DC VSFan_inc_ldramp VSFan_dec_ldramp AC_sw_chan AC_ctl_chan AC_idle_rpm AC_ctl_mode AC_ctl_mode_t MILblk_trigger_cfg MILblk_input_moment AC_sw_chan_cfg MIL_output_chan crank_trans_lim AC_ctl_min_ECT AC_ctl_min_RPM AC_ctl_max_RPM RBC_ABS_disable RBC_min_ECT_ena RBC_min_ECT_override drivebrake_min_ECT exhbrake_min_ECT RBC_enabled_cfg fc_blink_output cfgout1_dg_input_on cfgout1_dg_input_off cfgout2_dg_input_on cfgout2_dg_input_off cfgout3_dg_input_on cfgout3_dg_input_off cfgout1_pd_input_on cfgout1_pd_input_off cfgout2_pd_input_on cfgout2_pd_input_off cfgout3_pd_input_on cfgout3_pd_input_off cfgout1_pu_input_on cfgout1_pu_input_off cfgout2_pu_input_on cfgout2_pu_input_off cfgout3_pu_input_on cfgout3_pu_input_off cfgout_OilLlon cfgout_OilLloff cfgout2_OilLlon cfgout2_OilLloff cfgout3_OilLlon cfgout3_OilLloff cfgout_OilLon cfgout_OilLoff cfgout2_OilLon cfgout2_OilLoff cfgout3_OilLon cfgout3_OilLoff MILblk_on MILblk_off VSFan_CL_ena VSFan_rpm_dot_window VSFan_rpm_dot_tau VSFan_pctd_tau VSFan_ac_rpm VSFan_ac_RSmax VSFan_drvbrk_rpm VSFan_rpmd_tau VSFan_Taux_chan VSFan_load_src VSFan_Taux_tau VSFan_retard_rpm AWP_ctl_ena AWP_ctl_ECT_min AWP_rpmd AWP_restart_runtime RBC_CAN_ena RBC_ovrspd_ena RBC_ovrspd_engage RBC_ovrspd_rpm_lmt RBC_ovrspd_RS_min VSFan_ac_hi_pres_rpm AC_hi_pres_chan AC_hi_pres_cfg VSFan_AGS_min1 ECWP_chan ECWP_idle_rpm ECWP_idle_MAP_load ECWP_idle_tm_max ECWP_ECT_max ECWP_EGRT_max ECWP_FT_min ECWP_temp_wait ECWP_wait crank_rst_mode ERCV_ACTIV_output ERCV_SPEED_input CCH_chan CCH_on_CCT CCH_on_dly CCH_off_CCT CCH_off_dly CCH_flt_on_tm CCH_flt_off_tm CCH_CCTflt_cold_OILT CCH_flt_cold_tm START_CMD_loV START_CMD_hiV crank_LFP_mode crank_LFP_lim_mult crank_LFP_rst_mult RBC_TSC1_arb_mode VSFan_Taux_mode RBC_TSC1_disengage CCH_CL_control CCH_flt_control CCH_flt_on_temp CCH_flt_off_temp VSFan_SHP_ena OPC_ena OPC_outchn OPC_lowpass_tau OPC_DCuplmt OPC_DCdnlmt crank_LFP_src crank_LFP_open_wait crank_LFP_Ptgt_mult ETHCth_CHT ETHCth_nomDC TVSFanMaxECT_pct TVSFanMax_IATld_pct TVSFan_DC_pct TVSFan_rpm_Kp TVSFan_rpm_Ki TVSFan_rpm_Kd TVSFan_rpm_Kiv TVSFan_rpm_dzKp TVSFan_rpm_dzKi TVSFan_rpm_dzKd TVSFan_Kdm TVSFan_Kivm TVSFanMaxTaux_pct TVSFanMaxACT_ACT TVSFan_SHP_lwr_lmt TVSFan_SHP_lwr_hyst TVSFan_SHP_upr_hyst TVSFan_SHP_upr_lmt TOPC_CUV_FAC_OILT TOPC_CUV_psi_max TOPC_CUV_psi_min TOPC_BRK_psi TOPC_oilpct TOPC_baropct TOPC_BASE_pressW TOPC_OIL_pressW TOPC_BP_pressW TOPC_FF_W TOPC_Kp TOPC_Ki TOPC_Kd /end REF_CHARACTERISTIC
 /begin REF_MEASUREMENT ETHC_state ETHC_CHT_th ETHC_DC ETHC_dT CHTdt cfgout_state crank_latch_cnt crank_total cfgout2_state cfgout3_state TransFPP_DC MaxSetPt_light flag1_HWARN flag1_SWARN run_mode_latch SWARNfcn HWARNfcn SCC1_pwm_duty_cycle SCC1_Iavg_d_mA SCC1_Iavg_a SCC1_I_acc SCC2_pwm_duty_cycle SCC2_Iavg_d_mA SCC2_Iavg_a SCC2_I_acc IO_light_brake /end REF_MEASUREMENT
/end GROUP
/end MODULE
/end PROJECT
