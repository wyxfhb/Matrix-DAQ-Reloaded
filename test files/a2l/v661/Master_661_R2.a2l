ASAP2_VERSION 1 61
/begin PROJECT Econtrols_4G "4G Test"
/begin HEADER "4G A2L Configuration" PROJECT_NO EControls4G /* config for version control */ VERSION "$Revision: 82130 $:" /* config for version control */ /end HEADER
/begin MODULE EControls_4G_SH2A "EControls 4G"
/begin MOD_COMMON "" DEPOSIT ABSOLUTE BYTE_ORDER MSB_FIRST /end MOD_COMMON
/* Define the Record Layouts */
/begin RECORD_LAYOUT ECIPP_ALIGNMENT_UBYTE FNC_VALUES 1 UBYTE COLUMN_DIR DIRECT /end RECORD_LAYOUT
/begin RECORD_LAYOUT ECIPP_ALIGNMENT_UWORD FNC_VALUES 1 UWORD COLUMN_DIR DIRECT /end RECORD_LAYOUT
/begin RECORD_LAYOUT ECIPP_ALIGNMENT_ULONG FNC_VALUES 1 ULONG COLUMN_DIR DIRECT /end RECORD_LAYOUT
/begin RECORD_LAYOUT ECIPP_ALIGNMENT_FLOAT32_IEEE FNC_VALUES 1 FLOAT32_IEEE COLUMN_DIR DIRECT /end RECORD_LAYOUT
/begin COMPU_METHOD Compu_IDENTITY "Discrete Values " /* Identifier */ IDENTICAL "%.0" /* Format */ "-" /* Units */ /end COMPU_METHOD
/begin CHARACTERISTIC FCdc4_APUD2_max "FCtl_DTC_0x04(205)" VALUE 0x001E4230 /* @ECU_Address@FCtl_DTC_0x04@0x024C419A@ */ ECIPP_ALIGNMENT_UWORD 65535 Compu_IDENTITY 0 65535 PHYS_UNIT "System ID + DTC" /end CHARACTERISTIC
/begin CHARACTERISTIC FCdc4_APUD2_min "FCtl_DTC_0x04(206)" VALUE 0x001E4232 /* @ECU_Address@FCtl_DTC_0x04@0x024C419C@ */ ECIPP_ALIGNMENT_UWORD 65535 Compu_IDENTITY 0 65535 PHYS_UNIT "System ID + DTC" /end CHARACTERISTIC
/begin CHARACTERISTIC FCdc4_APUD20_max "FCtl_DTC_0x04(381)" VALUE 0x001E4390 /* @ECU_Address@FCtl_DTC_0x04@0x024C42FA@ */ ECIPP_ALIGNMENT_UWORD 65535 Compu_IDENTITY 0 65535 PHYS_UNIT "System ID + DTC" /end CHARACTERISTIC
/begin CHARACTERISTIC FCdc4_APUD20_min "FCtl_DTC_0x04(382)" VALUE 0x001E4392 /* @ECU_Address@FCtl_DTC_0x04@0x024C42FC@ */ ECIPP_ALIGNMENT_UWORD 65535 Compu_IDENTITY 0 65535 PHYS_UNIT "System ID + DTC" /end CHARACTERISTIC
/begin CHARACTERISTIC FCdc4_APUD21_max "FCtl_DTC_0x04(383)" VALUE 0x001E4394 /* @ECU_Address@FCtl_DTC_0x04@0x024C42FE@ */ ECIPP_ALIGNMENT_UWORD 65535 Compu_IDENTITY 0 65535 PHYS_UNIT "System ID + DTC" /end CHARACTERISTIC
/begin CHARACTERISTIC FCdc4_APUD21_min "FCtl_DTC_0x04(384)" VALUE 0x001E4396 /* @ECU_Address@FCtl_DTC_0x04@0x024C4300@ */ ECIPP_ALIGNMENT_UWORD 65535 Compu_IDENTITY 0 65535 PHYS_UNIT "System ID + DTC" /end CHARACTERISTIC
/begin CHARACTERISTIC FCdc4_APUD22_max "FCtl_DTC_0x04(385)" VALUE 0x001E4398 /* @ECU_Address@FCtl_DTC_0x04@0x024C4302@ */ ECIPP_ALIGNMENT_UWORD 65535 Compu_IDENTITY 0 65535 PHYS_UNIT "System ID + DTC" /end CHARACTERISTIC
/begin CHARACTERISTIC FCdc4_APUD22_min "FCtl_DTC_0x04(386)" VALUE 0x001E439A /* @ECU_Address@FCtl_DTC_0x04@0x024C4304@ */ ECIPP_ALIGNMENT_UWORD 65535 Compu_IDENTITY 0 65535 PHYS_UNIT "System ID + DTC" /end CHARACTERISTIC
/begin CHARACTERISTIC FCdc4_APUD23_max "FCtl_DTC_0x04(387)" VALUE 0x001E439C /* @ECU_Address@FCtl_DTC_0x04@0x024C4306@ */ ECIPP_ALIGNMENT_UWORD 65535 Compu_IDENTITY 0 65535 PHYS_UNIT "System ID + DTC" /end CHARACTERISTIC
/begin CHARACTERISTIC FCdc4_APUD23_min "FCtl_DTC_0x04(388)" VALUE 0x001E439E /* @ECU_Address@FCtl_DTC_0x04@0x024C4308@ */ ECIPP_ALIGNMENT_UWORD 65535 Compu_IDENTITY 0 65535 PHYS_UNIT "System ID + DTC" /end CHARACTERISTIC
/begin CHARACTERISTIC FCdc4_APUD24_max "FCtl_DTC_0x04(389)" VALUE 0x001E43A0 /* @ECU_Address@FCtl_DTC_0x04@0x024C430A@ */ ECIPP_ALIGNMENT_UWORD 65535 Compu_IDENTITY 0 65535 PHYS_UNIT "System ID + DTC" /end CHARACTERISTIC
/begin CHARACTERISTIC FCdc4_APUD24_min "FCtl_DTC_0x04(390)" VALUE 0x001E43A2 /* @ECU_Address@FCtl_DTC_0x04@0x024C430C@ */ ECIPP_ALIGNMENT_UWORD 65535 Compu_IDENTITY 0 65535 PHYS_UNIT "System ID + DTC" /end CHARACTERISTIC
/begin CHARACTERISTIC FCdc4_APUD25_max "FCtl_DTC_0x04(391)" VALUE 0x001E43A4 /* @ECU_Address@FCtl_DTC_0x04@0x024C430E@ */ ECIPP_ALIGNMENT_UWORD 65535 Compu_IDENTITY 0 65535 PHYS_UNIT "System ID + DTC" /end CHARACTERISTIC
/begin CHARACTERISTIC FCdc4_APUD25_min "FCtl_DTC_0x04(392)" VALUE 0x001E43A6 /* @ECU_Address@FCtl_DTC_0x04@0x024C4310@ */ ECIPP_ALIGNMENT_UWORD 65535 Compu_IDENTITY 0 65535 PHYS_UNIT "System ID + DTC" /end CHARACTERISTIC
/begin CHARACTERISTIC FCdc4_APUD3_max "FCtl_DTC_0x04(207)" VALUE 0x001E4234 /* @ECU_Address@FCtl_DTC_0x04@0x024C419E@ */ ECIPP_ALIGNMENT_UWORD 65535 Compu_IDENTITY 0 65535 PHYS_UNIT "System ID + DTC" /end CHARACTERISTIC
/begin CHARACTERISTIC FCdc4_APUD3_min "FCtl_DTC_0x04(208)" VALUE 0x001E4236 /* @ECU_Address@FCtl_DTC_0x04@0x024C41A0@ */ ECIPP_ALIGNMENT_UWORD 65535 Compu_IDENTITY 0 65535 PHYS_UNIT "System ID + DTC" /end CHARACTERISTIC
/begin CHARACTERISTIC FCdc4_APUD4_max "FCtl_DTC_0x04(280)" VALUE 0x001E42C6 /* @ECU_Address@FCtl_DTC_0x04@0x024C4230@ */ ECIPP_ALIGNMENT_UWORD 65535 Compu_IDENTITY 0 65535 PHYS_UNIT "System ID + DTC" /end CHARACTERISTIC
/begin CHARACTERISTIC FCdc4_APUD4_min "FCtl_DTC_0x04(281)" VALUE 0x001E42C8 /* @ECU_Address@FCtl_DTC_0x04@0x024C4232@ */ ECIPP_ALIGNMENT_UWORD 65535 Compu_IDENTITY 0 65535 PHYS_UNIT "System ID + DTC" /end CHARACTERISTIC
/begin CHARACTERISTIC FCdc4_APUD5_max "FCtl_DTC_0x04(331)" VALUE 0x001E432C /* @ECU_Address@FCtl_DTC_0x04@0x024C4296@ */ ECIPP_ALIGNMENT_UWORD 65535 Compu_IDENTITY 0 65535 PHYS_UNIT "System ID + DTC" /end CHARACTERISTIC
/begin CHARACTERISTIC FCdc4_APUD5_min "FCtl_DTC_0x04(332)" VALUE 0x001E432E /* @ECU_Address@FCtl_DTC_0x04@0x024C4298@ */ ECIPP_ALIGNMENT_UWORD 65535 Compu_IDENTITY 0 65535 PHYS_UNIT "System ID + DTC" /end CHARACTERISTIC
/begin CHARACTERISTIC FCdc4_APUD6_max "FCtl_DTC_0x04(333)" VALUE 0x001E4330 /* @ECU_Address@FCtl_DTC_0x04@0x024C429A@ */ ECIPP_ALIGNMENT_UWORD 65535 Compu_IDENTITY 0 65535 PHYS_UNIT "System ID + DTC" /end CHARACTERISTIC
/begin CHARACTERISTIC FCdc4_APUD6_min "FCtl_DTC_0x04(334)" VALUE 0x001E4332 /* @ECU_Address@FCtl_DTC_0x04@0x024C429C@ */ ECIPP_ALIGNMENT_UWORD 65535 Compu_IDENTITY 0 65535 PHYS_UNIT "System ID + DTC" /end CHARACTERISTIC
/begin CHARACTERISTIC FCdc4_APUD7_max "FCtl_DTC_0x04(335)" VALUE 0x001E4334 /* @ECU_Address@FCtl_DTC_0x04@0x024C429E@ */ ECIPP_ALIGNMENT_UWORD 65535 Compu_IDENTITY 0 65535 PHYS_UNIT "System ID + DTC" /end CHARACTERISTIC
/begin CHARACTERISTIC FCdc4_APUD7_min "FCtl_DTC_0x04(336)" VALUE 0x001E4336 /* @ECU_Address@FCtl_DTC_0x04@0x024C42A0@ */ ECIPP_ALIGNMENT_UWORD 65535 Compu_IDENTITY 0 65535 PHYS_UNIT "System ID + DTC" /end CHARACTERISTIC
/begin CHARACTERISTIC FCdc4_APUD8_max "FCtl_DTC_0x04(352)" VALUE 0x001E4356 /* @ECU_Address@FCtl_DTC_0x04@0x024C42C0@ */ ECIPP_ALIGNMENT_UWORD 65535 Compu_IDENTITY 0 65535 PHYS_UNIT "System ID + DTC" /end CHARACTERISTIC
/begin CHARACTERISTIC FCdc4_APUD8_min "FCtl_DTC_0x04(353)" VALUE 0x001E4358 /* @ECU_Address@FCtl_DTC_0x04@0x024C42C2@ */ ECIPP_ALIGNMENT_UWORD 65535 Compu_IDENTITY 0 65535 PHYS_UNIT "System ID + DTC" /end CHARACTERISTIC
/begin CHARACTERISTIC FCdc4_APUD9_max "FCtl_DTC_0x04(359)" VALUE 0x001E4364 /* @ECU_Address@FCtl_DTC_0x04@0x024C42CE@ */ ECIPP_ALIGNMENT_UWORD 65535 Compu_IDENTITY 0 65535 PHYS_UNIT "System ID + DTC" /end CHARACTERISTIC
/begin CHARACTERISTIC FCdc4_APUD9_min "FCtl_DTC_0x04(360)" VALUE 0x001E4366 /* @ECU_Address@FCtl_DTC_0x04@0x024C42D0@ */ ECIPP_ALIGNMENT_UWORD 65535 Compu_IDENTITY 0 65535 PHYS_UNIT "System ID + DTC" /end CHARACTERISTIC
/begin CHARACTERISTIC FCdc4_AWP_intF "FCtl_DTC_0x04(832)" VALUE 0x001E4716 /* @ECU_Address@FCtl_DTC_0x04@0x024C4680@ */ ECIPP_ALIGNMENT_UWORD 65535 Compu_IDENTITY 0 65535 PHYS_UNIT "System ID + DTC" /end CHARACTERISTIC
/begin CHARACTERISTIC FCdc4_BP_max "FCtl_DTC_0x04(7)" VALUE 0x001E40A4 /* @ECU_Address@FCtl_DTC_0x04@0x024C400E@ */ ECIPP_ALIGNMENT_UWORD 65535 Compu_IDENTITY 0 65535 PHYS_UNIT "System ID + DTC" /end CHARACTERISTIC
/begin CHARACTERISTIC FCdc4_BP_min "FCtl_DTC_0x04(8)" VALUE 0x001E40A6 /* @ECU_Address@FCtl_DTC_0x04@0x024C4010@ */ ECIPP_ALIGNMENT_UWORD 65535 Compu_IDENTITY 0 65535 PHYS_UNIT "System ID + DTC" /end CHARACTERISTIC
/begin CHARACTERISTIC FCdc4_BPS1_max "FCtl_DTC_0x04(474)" VALUE 0x001E444A /* @ECU_Address@FCtl_DTC_0x04@0x024C43B4@ */ ECIPP_ALIGNMENT_UWORD 65535 Compu_IDENTITY 0 65535 PHYS_UNIT "System ID + DTC" /end CHARACTERISTIC
/begin CHARACTERISTIC FCdc4_BPS1_min "FCtl_DTC_0x04(475)" VALUE 0x001E444C /* @ECU_Address@FCtl_DTC_0x04@0x024C43B6@ */ ECIPP_ALIGNMENT_UWORD 65535 Compu_IDENTITY 0 65535 PHYS_UNIT "System ID + DTC" /end CHARACTERISTIC
/begin CHARACTERISTIC FCdc4_BPS12_OOR "FCtl_DTC_0x04(482)" VALUE 0x001E445A /* @ECU_Address@FCtl_DTC_0x04@0x024C43C4@ */ ECIPP_ALIGNMENT_UWORD 65535 Compu_IDENTITY 0 65535 PHYS_UNIT "System ID + DTC" /end CHARACTERISTIC
/begin CHARACTERISTIC FCdc4_BPS12pct_hi "FCtl_DTC_0x04(478)" VALUE 0x001E4452 /* @ECU_Address@FCtl_DTC_0x04@0x024C43BC@ */ ECIPP_ALIGNMENT_UWORD 65535 Compu_IDENTITY 0 65535 PHYS_UNIT "System ID + DTC" /end CHARACTERISTIC
/begin CHARACTERISTIC FCdc4_BPS12pct_lo "FCtl_DTC_0x04(479)" VALUE 0x001E4454 /* @ECU_Address@FCtl_DTC_0x04@0x024C43BE@ */ ECIPP_ALIGNMENT_UWORD 65535 Compu_IDENTITY 0 65535 PHYS_UNIT "System ID + DTC" /end CHARACTERISTIC
/begin CHARACTERISTIC FCdc4_BPS2_max "FCtl_DTC_0x04(476)" VALUE 0x001E444E /* @ECU_Address@FCtl_DTC_0x04@0x024C43B8@ */ ECIPP_ALIGNMENT_UWORD 65535 Compu_IDENTITY 0 65535 PHYS_UNIT "System ID + DTC" /end CHARACTERISTIC
/begin CHARACTERISTIC FCdc4_BPS2_min "FCtl_DTC_0x04(477)" VALUE 0x001E4450 /* @ECU_Address@FCtl_DTC_0x04@0x024C43BA@ */ ECIPP_ALIGNMENT_UWORD 65535 Compu_IDENTITY 0 65535 PHYS_UNIT "System ID + DTC" /end CHARACTERISTIC
/begin CHARACTERISTIC FCdc4_BPSerr_neg "FCtl_DTC_0x04(481)" VALUE 0x001E4458 /* @ECU_Address@FCtl_DTC_0x04@0x024C43C2@ */ ECIPP_ALIGNMENT_UWORD 65535 Compu_IDENTITY 0 65535 PHYS_UNIT "System ID + DTC" /end CHARACTERISTIC
/begin CHARACTERISTIC FCdc4_BPSerr_pos "FCtl_DTC_0x04(480)" VALUE 0x001E4456 /* @ECU_Address@FCtl_DTC_0x04@0x024C43C0@ */ ECIPP_ALIGNMENT_UWORD 65535 Compu_IDENTITY 0 65535 PHYS_UNIT "System ID + DTC" /end CHARACTERISTIC
/begin CHARACTERISTIC FCdc4_brake_gndshort "FCtl_DTC_0x04(329)" VALUE 0x001E4328 /* @ECU_Address@FCtl_DTC_0x04@0x024C4292@ */ ECIPP_ALIGNMENT_UWORD 65535 Compu_IDENTITY 0 65535 PHYS_UNIT "System ID + DTC" /end CHARACTERISTIC
/begin CHARACTERISTIC FCdc4_brake_pwrshort "FCtl_DTC_0x04(330)" VALUE 0x001E432A /* @ECU_Address@FCtl_DTC_0x04@0x024C4294@ */ ECIPP_ALIGNMENT_UWORD 65535 Compu_IDENTITY 0 65535 PHYS_UNIT "System ID + DTC" /end CHARACTERISTIC
/begin CHARACTERISTIC FCdc4_bst_MAT_derate_actv "FCtl_DTC_0x04(811)" VALUE 0x001E46EC /* @ECU_Address@FCtl_DTC_0x04@0x024C4656@ */ ECIPP_ALIGNMENT_UWORD 65535 Compu_IDENTITY 0 65535 PHYS_UNIT "System ID + DTC" /end CHARACTERISTIC
/begin CHARACTERISTIC FCdc4_BstTIP_Hi "FCtl_DTC_0x04(143)" VALUE 0x001E41B4 /* @ECU_Address@FCtl_DTC_0x04@0x024C411E@ */ ECIPP_ALIGNMENT_UWORD 65535 Compu_IDENTITY 0 65535 PHYS_UNIT "System ID + DTC" /end CHARACTERISTIC
/begin CHARACTERISTIC FCdc4_BstTIP_Lo "FCtl_DTC_0x04(144)" VALUE 0x001E41B6 /* @ECU_Address@FCtl_DTC_0x04@0x024C4120@ */ ECIPP_ALIGNMENT_UWORD 65535 Compu_IDENTITY 0 65535 PHYS_UNIT "System ID + DTC" /end CHARACTERISTIC
/begin CHARACTERISTIC FCdc4_BstTIP_Lo2 "FCtl_DTC_0x04(686)" VALUE 0x001E45F2 /* @ECU_Address@FCtl_DTC_0x04@0x024C455C@ */ ECIPP_ALIGNMENT_UWORD 65535 Compu_IDENTITY 0 65535 PHYS_UNIT "System ID + DTC" /end CHARACTERISTIC
/begin CHARACTERISTIC FCdc4_BstTIP_slow "FCtl_DTC_0x04(655)" VALUE 0x001E45B4 /* @ECU_Address@FCtl_DTC_0x04@0x024C451E@ */ ECIPP_ALIGNMENT_UWORD 65535 Compu_IDENTITY 0 65535 PHYS_UNIT "System ID + DTC" /end CHARACTERISTIC
/begin CHARACTERISTIC FCdc4_buzz_coilopen "FCtl_DTC_0x04(165)" VALUE 0x001E41E0 /* @ECU_Address@FCtl_DTC_0x04@0x024C414A@ */ ECIPP_ALIGNMENT_UWORD 65535 Compu_IDENTITY 0 65535 PHYS_UNIT "System ID + DTC" /end CHARACTERISTIC
/begin CHARACTERISTIC FCdc4_buzz_coilshort "FCtl_DTC_0x04(166)" VALUE 0x001E41E2 /* @ECU_Address@FCtl_DTC_0x04@0x024C414C@ */ ECIPP_ALIGNMENT_UWORD 65535 Compu_IDENTITY 0 65535 PHYS_UNIT "System ID + DTC" /end CHARACTERISTIC
/begin CHARACTERISTIC FCdc4_buzz_gndshort "FCtl_DTC_0x04(164)" VALUE 0x001E41DE /* @ECU_Address@FCtl_DTC_0x04@0x024C4148@ */ ECIPP_ALIGNMENT_UWORD 65535 Compu_IDENTITY 0 65535 PHYS_UNIT "System ID + DTC" /end CHARACTERISTIC
/begin CHARACTERISTIC FCdc4_CAC_eta_lo "FCtl_DTC_0x04(656)" VALUE 0x001E45B6 /* @ECU_Address@FCtl_DTC_0x04@0x024C4520@ */ ECIPP_ALIGNMENT_UWORD 65535 Compu_IDENTITY 0 65535 PHYS_UNIT "System ID + DTC" /end CHARACTERISTIC
/begin CHARACTERISTIC FCdc4_cal_config "FCtl_DTC_0x04(319)" VALUE 0x001E4314 /* @ECU_Address@FCtl_DTC_0x04@0x024C427E@ */ ECIPP_ALIGNMENT_UWORD 65535 Compu_IDENTITY 0 65535 PHYS_UNIT "System ID + DTC" /end CHARACTERISTIC
/begin CHARACTERISTIC FCdc4_cam2loss "FCtl_DTC_0x04(690)" VALUE 0x001E45FA /* @ECU_Address@FCtl_DTC_0x04@0x024C4564@ */ ECIPP_ALIGNMENT_UWORD 65535 Compu_IDENTITY 0 65535 PHYS_UNIT "System ID + DTC" /end CHARACTERISTIC
/begin CHARACTERISTIC FCdc4_camloss "FCtl_DTC_0x04(95)" VALUE 0x001E4154 /* @ECU_Address@FCtl_DTC_0x04@0x024C40BE@ */ ECIPP_ALIGNMENT_UWORD 65535 Compu_IDENTITY 0 65535 PHYS_UNIT "System ID + DTC" /end CHARACTERISTIC
/begin CHARACTERISTIC FCdc4_camnoise "FCtl_DTC_0x04(96)" VALUE 0x001E4156 /* @ECU_Address@FCtl_DTC_0x04@0x024C40C0@ */ ECIPP_ALIGNMENT_UWORD 65535 Compu_IDENTITY 0 65535 PHYS_UNIT "System ID + DTC" /end CHARACTERISTIC
/begin CHARACTERISTIC FCdc4_CATdP_hi "FCtl_DTC_0x04(526)" VALUE 0x001E44B2 /* @ECU_Address@FCtl_DTC_0x04@0x024C441C@ */ ECIPP_ALIGNMENT_UWORD 65535 Compu_IDENTITY 0 65535 PHYS_UNIT "System ID + DTC" /end CHARACTERISTIC
/begin CHARACTERISTIC FCdc4_CATdP_lo "FCtl_DTC_0x04(525)" VALUE 0x001E44B0 /* @ECU_Address@FCtl_DTC_0x04@0x024C441A@ */ ECIPP_ALIGNMENT_UWORD 65535 Compu_IDENTITY 0 65535 PHYS_UNIT "System ID + DTC" /end CHARACTERISTIC
/begin CHARACTERISTIC FCdc4_CATout_OOR "FCtl_DTC_0x04(831)" VALUE 0x001E4714 /* @ECU_Address@FCtl_DTC_0x04@0x024C467E@ */ ECIPP_ALIGNMENT_UWORD 65535 Compu_IDENTITY 0 65535 PHYS_UNIT "System ID + DTC" /end CHARACTERISTIC
/begin CHARACTERISTIC FCdc4_CD_MF1 "FCtl_DTC_0x04(985)" VALUE 0x001E4848 /* @ECU_Address@FCtl_DTC_0x04@0x024C47B2@ */ ECIPP_ALIGNMENT_UWORD 65535 Compu_IDENTITY 0 65535 PHYS_UNIT "System ID + DTC" /end CHARACTERISTIC
/begin CHARACTERISTIC FCdc4_CFV_FP_minv "FCtl_DTC_0x04(687)" VALUE 0x001E45F4 /* @ECU_Address@FCtl_DTC_0x04@0x024C455E@ */ ECIPP_ALIGNMENT_UWORD 65535 Compu_IDENTITY 0 65535 PHYS_UNIT "System ID + DTC" /end CHARACTERISTIC
/begin CHARACTERISTIC FCdc4_CFV_FT_maxv "FCtl_DTC_0x04(688)" VALUE 0x001E45F6 /* @ECU_Address@FCtl_DTC_0x04@0x024C4560@ */ ECIPP_ALIGNMENT_UWORD 65535 Compu_IDENTITY 0 65535 PHYS_UNIT "System ID + DTC" /end CHARACTERISTIC
/begin CHARACTERISTIC FCdc4_CFV_FT_minv "FCtl_DTC_0x04(689)" VALUE 0x001E45F8 /* @ECU_Address@FCtl_DTC_0x04@0x024C4562@ */ ECIPP_ALIGNMENT_UWORD 65535 Compu_IDENTITY 0 65535 PHYS_UNIT "System ID + DTC" /end CHARACTERISTIC
/begin CHARACTERISTIC FCdc4_CFV_mdot_hi "FCtl_DTC_0x04(523)" VALUE 0x001E44AC /* @ECU_Address@FCtl_DTC_0x04@0x024C4416@ */ ECIPP_ALIGNMENT_UWORD 65535 Compu_IDENTITY 0 65535 PHYS_UNIT "System ID + DTC" /end CHARACTERISTIC
/begin CHARACTERISTIC FCdc4_CFV_mdot_lo "FCtl_DTC_0x04(524)" VALUE 0x001E44AE /* @ECU_Address@FCtl_DTC_0x04@0x024C4418@ */ ECIPP_ALIGNMENT_UWORD 65535 Compu_IDENTITY 0 65535 PHYS_UNIT "System ID + DTC" /end CHARACTERISTIC
/begin CHARACTERISTIC FCdc4_CFV_mdot_rms_hi "FCtl_DTC_0x04(679)" VALUE 0x001E45E4 /* @ECU_Address@FCtl_DTC_0x04@0x024C454E@ */ ECIPP_ALIGNMENT_UWORD 65535 Compu_IDENTITY 0 65535 PHYS_UNIT "System ID + DTC" /end CHARACTERISTIC
/begin CHARACTERISTIC FCdc4_CFV_pwr_loss "FCtl_DTC_0x04(830)" VALUE 0x001E4712 /* @ECU_Address@FCtl_DTC_0x04@0x024C467C@ */ ECIPP_ALIGNMENT_UWORD 65535 Compu_IDENTITY 0 65535 PHYS_UNIT "System ID + DTC" /end CHARACTERISTIC
/begin CHARACTERISTIC FCdc4_CFV_RLV_fail "FCtl_DTC_0x04(535)" VALUE 0x001E44C4 /* @ECU_Address@FCtl_DTC_0x04@0x024C442E@ */ ECIPP_ALIGNMENT_UWORD 65535 Compu_IDENTITY 0 65535 PHYS_UNIT "System ID + DTC" /end CHARACTERISTIC
/begin CHARACTERISTIC FCdc4_CFV_RLV_P_min "FCtl_DTC_0x04(534)" VALUE 0x001E44C2 /* @ECU_Address@FCtl_DTC_0x04@0x024C442C@ */ ECIPP_ALIGNMENT_UWORD 65535 Compu_IDENTITY 0 65535 PHYS_UNIT "System ID + DTC" /end CHARACTERISTIC
/begin CHARACTERISTIC FCdc4_CHT_HiExp "FCtl_DTC_0x04(114)" VALUE 0x001E417A /* @ECU_Address@FCtl_DTC_0x04@0x024C40E4@ */ ECIPP_ALIGNMENT_UWORD 65535 Compu_IDENTITY 0 65535 PHYS_UNIT "System ID + DTC" /end CHARACTERISTIC
/begin CHARACTERISTIC FCdc4_CHT_HiExp2 "FCtl_DTC_0x04(115)" VALUE 0x001E417C /* @ECU_Address@FCtl_DTC_0x04@0x024C40E6@ */ ECIPP_ALIGNMENT_UWORD 65535 Compu_IDENTITY 0 65535 PHYS_UNIT "System ID + DTC" /end CHARACTERISTIC
/begin CHARACTERISTIC FCdc4_CL_hi "FCtl_DTC_0x04(32)" VALUE 0x001E40D6 /* @ECU_Address@FCtl_DTC_0x04@0x024C4040@ */ ECIPP_ALIGNMENT_UWORD 65535 Compu_IDENTITY 0 65535 PHYS_UNIT "System ID + DTC" /end CHARACTERISTIC
/begin CHARACTERISTIC FCdc4_CL_lo "FCtl_DTC_0x04(33)" VALUE 0x001E40D8 /* @ECU_Address@FCtl_DTC_0x04@0x024C4042@ */ ECIPP_ALIGNMENT_UWORD 65535 Compu_IDENTITY 0 65535 PHYS_UNIT "System ID + DTC" /end CHARACTERISTIC
/begin CHARACTERISTIC FPnd_APUD2_max "FPrm_pending(161)" VALUE 0x001E5254 /* @ECU_Address@FPrm_pending@0x021BE142@ */ ECIPP_ALIGNMENT_UWORD 65535 Compu_IDENTITY 0 65535 PHYS_UNIT "Bit Mask" /end CHARACTERISTIC
/begin CHARACTERISTIC FPnd_APUD2_min "FPrm_pending(162)" VALUE 0x001E5256 /* @ECU_Address@FPrm_pending@0x021BE144@ */ ECIPP_ALIGNMENT_UWORD 65535 Compu_IDENTITY 0 65535 PHYS_UNIT "Bit Mask" /end CHARACTERISTIC
/begin CHARACTERISTIC FPnd_APUD20_max "FPrm_pending(290)" VALUE 0x001E5356 /* @ECU_Address@FPrm_pending@0x021BE244@ */ ECIPP_ALIGNMENT_UWORD 65535 Compu_IDENTITY 0 65535 PHYS_UNIT "Bit Mask" /end CHARACTERISTIC
/begin CHARACTERISTIC FPnd_APUD20_min "FPrm_pending(291)" VALUE 0x001E5358 /* @ECU_Address@FPrm_pending@0x021BE246@ */ ECIPP_ALIGNMENT_UWORD 65535 Compu_IDENTITY 0 65535 PHYS_UNIT "Bit Mask" /end CHARACTERISTIC
/begin CHARACTERISTIC FPnd_APUD21_max "FPrm_pending(292)" VALUE 0x001E535A /* @ECU_Address@FPrm_pending@0x021BE248@ */ ECIPP_ALIGNMENT_UWORD 65535 Compu_IDENTITY 0 65535 PHYS_UNIT "Bit Mask" /end CHARACTERISTIC
/begin CHARACTERISTIC FPnd_APUD21_min "FPrm_pending(293)" VALUE 0x001E535C /* @ECU_Address@FPrm_pending@0x021BE24A@ */ ECIPP_ALIGNMENT_UWORD 65535 Compu_IDENTITY 0 65535 PHYS_UNIT "Bit Mask" /end CHARACTERISTIC
/begin CHARACTERISTIC FPnd_APUD22_max "FPrm_pending(294)" VALUE 0x001E535E /* @ECU_Address@FPrm_pending@0x021BE24C@ */ ECIPP_ALIGNMENT_UWORD 65535 Compu_IDENTITY 0 65535 PHYS_UNIT "Bit Mask" /end CHARACTERISTIC
/begin CHARACTERISTIC FPnd_APUD22_min "FPrm_pending(295)" VALUE 0x001E5360 /* @ECU_Address@FPrm_pending@0x021BE24E@ */ ECIPP_ALIGNMENT_UWORD 65535 Compu_IDENTITY 0 65535 PHYS_UNIT "Bit Mask" /end CHARACTERISTIC
/begin CHARACTERISTIC FPnd_APUD23_max "FPrm_pending(296)" VALUE 0x001E5362 /* @ECU_Address@FPrm_pending@0x021BE250@ */ ECIPP_ALIGNMENT_UWORD 65535 Compu_IDENTITY 0 65535 PHYS_UNIT "Bit Mask" /end CHARACTERISTIC
/begin CHARACTERISTIC FPnd_APUD23_min "FPrm_pending(297)" VALUE 0x001E5364 /* @ECU_Address@FPrm_pending@0x021BE252@ */ ECIPP_ALIGNMENT_UWORD 65535 Compu_IDENTITY 0 65535 PHYS_UNIT "Bit Mask" /end CHARACTERISTIC
/begin CHARACTERISTIC FPnd_APUD24_max "FPrm_pending(298)" VALUE 0x001E5366 /* @ECU_Address@FPrm_pending@0x021BE254@ */ ECIPP_ALIGNMENT_UWORD 65535 Compu_IDENTITY 0 65535 PHYS_UNIT "Bit Mask" /end CHARACTERISTIC
/begin CHARACTERISTIC FPnd_APUD24_min "FPrm_pending(299)" VALUE 0x001E5368 /* @ECU_Address@FPrm_pending@0x021BE256@ */ ECIPP_ALIGNMENT_UWORD 65535 Compu_IDENTITY 0 65535 PHYS_UNIT "Bit Mask" /end CHARACTERISTIC
/begin CHARACTERISTIC FPnd_APUD25_max "FPrm_pending(300)" VALUE 0x001E536A /* @ECU_Address@FPrm_pending@0x021BE258@ */ ECIPP_ALIGNMENT_UWORD 65535 Compu_IDENTITY 0 65535 PHYS_UNIT "Bit Mask" /end CHARACTERISTIC
/begin CHARACTERISTIC FPnd_APUD25_min "FPrm_pending(301)" VALUE 0x001E536C /* @ECU_Address@FPrm_pending@0x021BE25A@ */ ECIPP_ALIGNMENT_UWORD 65535 Compu_IDENTITY 0 65535 PHYS_UNIT "Bit Mask" /end CHARACTERISTIC
/begin CHARACTERISTIC FPnd_APUD3_max "FPrm_pending(163)" VALUE 0x001E5258 /* @ECU_Address@FPrm_pending@0x021BE146@ */ ECIPP_ALIGNMENT_UWORD 65535 Compu_IDENTITY 0 65535 PHYS_UNIT "Bit Mask" /end CHARACTERISTIC
/begin CHARACTERISTIC FPnd_APUD3_min "FPrm_pending(164)" VALUE 0x001E525A /* @ECU_Address@FPrm_pending@0x021BE148@ */ ECIPP_ALIGNMENT_UWORD 65535 Compu_IDENTITY 0 65535 PHYS_UNIT "Bit Mask" /end CHARACTERISTIC
/begin CHARACTERISTIC FPnd_APUD4_max "FPrm_pending(202)" VALUE 0x001E52A6 /* @ECU_Address@FPrm_pending@0x021BE194@ */ ECIPP_ALIGNMENT_UWORD 65535 Compu_IDENTITY 0 65535 PHYS_UNIT "Bit Mask" /end CHARACTERISTIC
/begin CHARACTERISTIC FPnd_APUD4_min "FPrm_pending(203)" VALUE 0x001E52A8 /* @ECU_Address@FPrm_pending@0x021BE196@ */ ECIPP_ALIGNMENT_UWORD 65535 Compu_IDENTITY 0 65535 PHYS_UNIT "Bit Mask" /end CHARACTERISTIC
/begin CHARACTERISTIC FPnd_APUD5_max "FPrm_pending(240)" VALUE 0x001E52F2 /* @ECU_Address@FPrm_pending@0x021BE1E0@ */ ECIPP_ALIGNMENT_UWORD 65535 Compu_IDENTITY 0 65535 PHYS_UNIT "Bit Mask" /end CHARACTERISTIC
/begin CHARACTERISTIC FPnd_APUD5_min "FPrm_pending(241)" VALUE 0x001E52F4 /* @ECU_Address@FPrm_pending@0x021BE1E2@ */ ECIPP_ALIGNMENT_UWORD 65535 Compu_IDENTITY 0 65535 PHYS_UNIT "Bit Mask" /end CHARACTERISTIC
/begin CHARACTERISTIC FPnd_APUD6_max "FPrm_pending(242)" VALUE 0x001E52F6 /* @ECU_Address@FPrm_pending@0x021BE1E4@ */ ECIPP_ALIGNMENT_UWORD 65535 Compu_IDENTITY 0 65535 PHYS_UNIT "Bit Mask" /end CHARACTERISTIC
/begin CHARACTERISTIC FPnd_APUD6_min "FPrm_pending(243)" VALUE 0x001E52F8 /* @ECU_Address@FPrm_pending@0x021BE1E6@ */ ECIPP_ALIGNMENT_UWORD 65535 Compu_IDENTITY 0 65535 PHYS_UNIT "Bit Mask" /end CHARACTERISTIC
/begin CHARACTERISTIC FPnd_APUD7_max "FPrm_pending(244)" VALUE 0x001E52FA /* @ECU_Address@FPrm_pending@0x021BE1E8@ */ ECIPP_ALIGNMENT_UWORD 65535 Compu_IDENTITY 0 65535 PHYS_UNIT "Bit Mask" /end CHARACTERISTIC
/begin CHARACTERISTIC FPnd_APUD7_min "FPrm_pending(245)" VALUE 0x001E52FC /* @ECU_Address@FPrm_pending@0x021BE1EA@ */ ECIPP_ALIGNMENT_UWORD 65535 Compu_IDENTITY 0 65535 PHYS_UNIT "Bit Mask" /end CHARACTERISTIC
/begin CHARACTERISTIC FPnd_APUD8_max "FPrm_pending(261)" VALUE 0x001E531C /* @ECU_Address@FPrm_pending@0x021BE20A@ */ ECIPP_ALIGNMENT_UWORD 65535 Compu_IDENTITY 0 65535 PHYS_UNIT "Bit Mask" /end CHARACTERISTIC
/begin CHARACTERISTIC FPnd_APUD8_min "FPrm_pending(262)" VALUE 0x001E531E /* @ECU_Address@FPrm_pending@0x021BE20C@ */ ECIPP_ALIGNMENT_UWORD 65535 Compu_IDENTITY 0 65535 PHYS_UNIT "Bit Mask" /end CHARACTERISTIC
/begin CHARACTERISTIC FPnd_APUD9_max "FPrm_pending(268)" VALUE 0x001E532A /* @ECU_Address@FPrm_pending@0x021BE218@ */ ECIPP_ALIGNMENT_UWORD 65535 Compu_IDENTITY 0 65535 PHYS_UNIT "Bit Mask" /end CHARACTERISTIC
/begin CHARACTERISTIC FPnd_APUD9_min "FPrm_pending(269)" VALUE 0x001E532C /* @ECU_Address@FPrm_pending@0x021BE21A@ */ ECIPP_ALIGNMENT_UWORD 65535 Compu_IDENTITY 0 65535 PHYS_UNIT "Bit Mask" /end CHARACTERISTIC
/begin CHARACTERISTIC FPnd_AWP_intF "FPrm_pending(659)" VALUE 0x001E5638 /* @ECU_Address@FPrm_pending@0x021BE526@ */ ECIPP_ALIGNMENT_UWORD 65535 Compu_IDENTITY 0 65535 PHYS_UNIT "Bit Mask" /end CHARACTERISTIC
/begin CHARACTERISTIC FPnd_BP_max "FPrm_pending(10)" VALUE 0x001E5126 /* @ECU_Address@FPrm_pending@0x021BE014@ */ ECIPP_ALIGNMENT_UWORD 65535 Compu_IDENTITY 0 65535 PHYS_UNIT "Bit Mask" /end CHARACTERISTIC
/begin CHARACTERISTIC FPnd_BP_min "FPrm_pending(11)" VALUE 0x001E5128 /* @ECU_Address@FPrm_pending@0x021BE016@ */ ECIPP_ALIGNMENT_UWORD 65535 Compu_IDENTITY 0 65535 PHYS_UNIT "Bit Mask" /end CHARACTERISTIC
/begin CHARACTERISTIC FPnd_BPS1_max "FPrm_pending(371)" VALUE 0x001E53F8 /* @ECU_Address@FPrm_pending@0x021BE2E6@ */ ECIPP_ALIGNMENT_UWORD 65535 Compu_IDENTITY 0 65535 PHYS_UNIT "Bit Mask" /end CHARACTERISTIC
/begin CHARACTERISTIC FPnd_BPS1_min "FPrm_pending(372)" VALUE 0x001E53FA /* @ECU_Address@FPrm_pending@0x021BE2E8@ */ ECIPP_ALIGNMENT_UWORD 65535 Compu_IDENTITY 0 65535 PHYS_UNIT "Bit Mask" /end CHARACTERISTIC
/begin CHARACTERISTIC FPnd_BPS12_OOR "FPrm_pending(379)" VALUE 0x001E5408 /* @ECU_Address@FPrm_pending@0x021BE2F6@ */ ECIPP_ALIGNMENT_UWORD 65535 Compu_IDENTITY 0 65535 PHYS_UNIT "Bit Mask" /end CHARACTERISTIC
/begin CHARACTERISTIC FPnd_BPS12pct_hi "FPrm_pending(375)" VALUE 0x001E5400 /* @ECU_Address@FPrm_pending@0x021BE2EE@ */ ECIPP_ALIGNMENT_UWORD 65535 Compu_IDENTITY 0 65535 PHYS_UNIT "Bit Mask" /end CHARACTERISTIC
/begin CHARACTERISTIC FPnd_BPS12pct_lo "FPrm_pending(376)" VALUE 0x001E5402 /* @ECU_Address@FPrm_pending@0x021BE2F0@ */ ECIPP_ALIGNMENT_UWORD 65535 Compu_IDENTITY 0 65535 PHYS_UNIT "Bit Mask" /end CHARACTERISTIC
/begin CHARACTERISTIC FPnd_BPS2_max "FPrm_pending(373)" VALUE 0x001E53FC /* @ECU_Address@FPrm_pending@0x021BE2EA@ */ ECIPP_ALIGNMENT_UWORD 65535 Compu_IDENTITY 0 65535 PHYS_UNIT "Bit Mask" /end CHARACTERISTIC
/begin CHARACTERISTIC FPnd_BPS2_min "FPrm_pending(374)" VALUE 0x001E53FE /* @ECU_Address@FPrm_pending@0x021BE2EC@ */ ECIPP_ALIGNMENT_UWORD 65535 Compu_IDENTITY 0 65535 PHYS_UNIT "Bit Mask" /end CHARACTERISTIC
/begin CHARACTERISTIC FPnd_BPSerr_neg "FPrm_pending(378)" VALUE 0x001E5406 /* @ECU_Address@FPrm_pending@0x021BE2F4@ */ ECIPP_ALIGNMENT_UWORD 65535 Compu_IDENTITY 0 65535 PHYS_UNIT "Bit Mask" /end CHARACTERISTIC
/begin CHARACTERISTIC FPnd_BPSerr_pos "FPrm_pending(377)" VALUE 0x001E5404 /* @ECU_Address@FPrm_pending@0x021BE2F2@ */ ECIPP_ALIGNMENT_UWORD 65535 Compu_IDENTITY 0 65535 PHYS_UNIT "Bit Mask" /end CHARACTERISTIC
/begin CHARACTERISTIC FPnd_brake_gndshort "FPrm_pending(238)" VALUE 0x001E52EE /* @ECU_Address@FPrm_pending@0x021BE1DC@ */ ECIPP_ALIGNMENT_UWORD 65535 Compu_IDENTITY 0 65535 PHYS_UNIT "Bit Mask" /end CHARACTERISTIC
/begin CHARACTERISTIC FPnd_brake_pwrshort "FPrm_pending(239)" VALUE 0x001E52F0 /* @ECU_Address@FPrm_pending@0x021BE1DE@ */ ECIPP_ALIGNMENT_UWORD 65535 Compu_IDENTITY 0 65535 PHYS_UNIT "Bit Mask" /end CHARACTERISTIC
/begin CHARACTERISTIC FPnd_bst_MAT_derate_actv "FPrm_pending(638)" VALUE 0x001E560E /* @ECU_Address@FPrm_pending@0x021BE4FC@ */ ECIPP_ALIGNMENT_UWORD 65535 Compu_IDENTITY 0 65535 PHYS_UNIT "Bit Mask" /end CHARACTERISTIC
/begin CHARACTERISTIC FPnd_BstTIP_Hi "FPrm_pending(103)" VALUE 0x001E51E0 /* @ECU_Address@FPrm_pending@0x021BE0CE@ */ ECIPP_ALIGNMENT_UWORD 65535 Compu_IDENTITY 0 65535 PHYS_UNIT "Bit Mask" /end CHARACTERISTIC
/begin CHARACTERISTIC FPnd_BstTIP_Lo "FPrm_pending(104)" VALUE 0x001E51E2 /* @ECU_Address@FPrm_pending@0x021BE0D0@ */ ECIPP_ALIGNMENT_UWORD 65535 Compu_IDENTITY 0 65535 PHYS_UNIT "Bit Mask" /end CHARACTERISTIC
/begin CHARACTERISTIC FPnd_BstTIP_Lo2 "FPrm_pending(516)" VALUE 0x001E551A /* @ECU_Address@FPrm_pending@0x021BE408@ */ ECIPP_ALIGNMENT_UWORD 65535 Compu_IDENTITY 0 65535 PHYS_UNIT "Bit Mask" /end CHARACTERISTIC
/begin CHARACTERISTIC FPnd_BstTIP_slow "FPrm_pending(485)" VALUE 0x001E54DC /* @ECU_Address@FPrm_pending@0x021BE3CA@ */ ECIPP_ALIGNMENT_UWORD 65535 Compu_IDENTITY 0 65535 PHYS_UNIT "Bit Mask" /end CHARACTERISTIC
/begin CHARACTERISTIC FPnd_buzz_coilopen "FPrm_pending(125)" VALUE 0x001E520C /* @ECU_Address@FPrm_pending@0x021BE0FA@ */ ECIPP_ALIGNMENT_UWORD 65535 Compu_IDENTITY 0 65535 PHYS_UNIT "Bit Mask" /end CHARACTERISTIC
/begin CHARACTERISTIC FPnd_buzz_coilshort "FPrm_pending(126)" VALUE 0x001E520E /* @ECU_Address@FPrm_pending@0x021BE0FC@ */ ECIPP_ALIGNMENT_UWORD 65535 Compu_IDENTITY 0 65535 PHYS_UNIT "Bit Mask" /end CHARACTERISTIC
/begin CHARACTERISTIC FPnd_buzz_gndshort "FPrm_pending(124)" VALUE 0x001E520A /* @ECU_Address@FPrm_pending@0x021BE0F8@ */ ECIPP_ALIGNMENT_UWORD 65535 Compu_IDENTITY 0 65535 PHYS_UNIT "Bit Mask" /end CHARACTERISTIC
/begin CHARACTERISTIC FPnd_CAC_eta_lo "FPrm_pending(486)" VALUE 0x001E54DE /* @ECU_Address@FPrm_pending@0x021BE3CC@ */ ECIPP_ALIGNMENT_UWORD 65535 Compu_IDENTITY 0 65535 PHYS_UNIT "Bit Mask" /end CHARACTERISTIC
/begin CHARACTERISTIC FPnd_cal_config "FPrm_pending(228)" VALUE 0x001E52DA /* @ECU_Address@FPrm_pending@0x021BE1C8@ */ ECIPP_ALIGNMENT_UWORD 65535 Compu_IDENTITY 0 65535 PHYS_UNIT "Bit Mask" /end CHARACTERISTIC
/begin CHARACTERISTIC FPnd_cam2loss "FPrm_pending(520)" VALUE 0x001E5522 /* @ECU_Address@FPrm_pending@0x021BE410@ */ ECIPP_ALIGNMENT_UWORD 65535 Compu_IDENTITY 0 65535 PHYS_UNIT "Bit Mask" /end CHARACTERISTIC
/begin CHARACTERISTIC FPnd_camloss "FPrm_pending(59)" VALUE 0x001E5188 /* @ECU_Address@FPrm_pending@0x021BE076@ */ ECIPP_ALIGNMENT_UWORD 65535 Compu_IDENTITY 0 65535 PHYS_UNIT "Bit Mask" /end CHARACTERISTIC
/begin CHARACTERISTIC FPnd_camnoise "FPrm_pending(60)" VALUE 0x001E518A /* @ECU_Address@FPrm_pending@0x021BE078@ */ ECIPP_ALIGNMENT_UWORD 65535 Compu_IDENTITY 0 65535 PHYS_UNIT "Bit Mask" /end CHARACTERISTIC
/begin CHARACTERISTIC FPnd_CATdP_hi "FPrm_pending(396)" VALUE 0x001E542A /* @ECU_Address@FPrm_pending@0x021BE318@ */ ECIPP_ALIGNMENT_UWORD 65535 Compu_IDENTITY 0 65535 PHYS_UNIT "Bit Mask" /end CHARACTERISTIC
/begin CHARACTERISTIC FPnd_CATdP_lo "FPrm_pending(395)" VALUE 0x001E5428 /* @ECU_Address@FPrm_pending@0x021BE316@ */ ECIPP_ALIGNMENT_UWORD 65535 Compu_IDENTITY 0 65535 PHYS_UNIT "Bit Mask" /end CHARACTERISTIC
/begin CHARACTERISTIC FPnd_CATout_OOR "FPrm_pending(658)" VALUE 0x001E5636 /* @ECU_Address@FPrm_pending@0x021BE524@ */ ECIPP_ALIGNMENT_UWORD 65535 Compu_IDENTITY 0 65535 PHYS_UNIT "Bit Mask" /end CHARACTERISTIC
/begin CHARACTERISTIC FPnd_CD_MF1 "FPrm_pending(710)" VALUE 0x001E569E /* @ECU_Address@FPrm_pending@0x021BE58C@ */ ECIPP_ALIGNMENT_UWORD 65535 Compu_IDENTITY 0 65535 PHYS_UNIT "Bit Mask" /end CHARACTERISTIC
/begin CHARACTERISTIC FPnd_CFV_FP_minv "FPrm_pending(517)" VALUE 0x001E551C /* @ECU_Address@FPrm_pending@0x021BE40A@ */ ECIPP_ALIGNMENT_UWORD 65535 Compu_IDENTITY 0 65535 PHYS_UNIT "Bit Mask" /end CHARACTERISTIC
/begin CHARACTERISTIC FPnd_CFV_FT_maxv "FPrm_pending(518)" VALUE 0x001E551E /* @ECU_Address@FPrm_pending@0x021BE40C@ */ ECIPP_ALIGNMENT_UWORD 65535 Compu_IDENTITY 0 65535 PHYS_UNIT "Bit Mask" /end CHARACTERISTIC
/begin CHARACTERISTIC FPnd_CFV_FT_minv "FPrm_pending(519)" VALUE 0x001E5520 /* @ECU_Address@FPrm_pending@0x021BE40E@ */ ECIPP_ALIGNMENT_UWORD 65535 Compu_IDENTITY 0 65535 PHYS_UNIT "Bit Mask" /end CHARACTERISTIC
/begin CHARACTERISTIC FPnd_CFV_mdot_hi "FPrm_pending(393)" VALUE 0x001E5424 /* @ECU_Address@FPrm_pending@0x021BE312@ */ ECIPP_ALIGNMENT_UWORD 65535 Compu_IDENTITY 0 65535 PHYS_UNIT "Bit Mask" /end CHARACTERISTIC
/begin CHARACTERISTIC FPnd_CFV_mdot_lo "FPrm_pending(394)" VALUE 0x001E5426 /* @ECU_Address@FPrm_pending@0x021BE314@ */ ECIPP_ALIGNMENT_UWORD 65535 Compu_IDENTITY 0 65535 PHYS_UNIT "Bit Mask" /end CHARACTERISTIC
/begin CHARACTERISTIC FPnd_CFV_mdot_rms_hi "FPrm_pending(509)" VALUE 0x001E550C /* @ECU_Address@FPrm_pending@0x021BE3FA@ */ ECIPP_ALIGNMENT_UWORD 65535 Compu_IDENTITY 0 65535 PHYS_UNIT "Bit Mask" /end CHARACTERISTIC
/begin CHARACTERISTIC FPnd_CFV_pwr_loss "FPrm_pending(657)" VALUE 0x001E5634 /* @ECU_Address@FPrm_pending@0x021BE522@ */ ECIPP_ALIGNMENT_UWORD 65535 Compu_IDENTITY 0 65535 PHYS_UNIT "Bit Mask" /end CHARACTERISTIC
/begin CHARACTERISTIC FPnd_CFV_RLV_fail "FPrm_pending(405)" VALUE 0x001E543C /* @ECU_Address@FPrm_pending@0x021BE32A@ */ ECIPP_ALIGNMENT_UWORD 65535 Compu_IDENTITY 0 65535 PHYS_UNIT "Bit Mask" /end CHARACTERISTIC
/begin CHARACTERISTIC FPnd_CFV_RLV_P_min "FPrm_pending(404)" VALUE 0x001E543A /* @ECU_Address@FPrm_pending@0x021BE328@ */ ECIPP_ALIGNMENT_UWORD 65535 Compu_IDENTITY 0 65535 PHYS_UNIT "Bit Mask" /end CHARACTERISTIC
/begin CHARACTERISTIC FPnd_CHT_HiExp "FPrm_pending(73)" VALUE 0x001E51A4 /* @ECU_Address@FPrm_pending@0x021BE092@ */ ECIPP_ALIGNMENT_UWORD 65535 Compu_IDENTITY 0 65535 PHYS_UNIT "Bit Mask" /end CHARACTERISTIC
/begin CHARACTERISTIC FPnd_CHT_HiExp2 "FPrm_pending(74)" VALUE 0x001E51A6 /* @ECU_Address@FPrm_pending@0x021BE094@ */ ECIPP_ALIGNMENT_UWORD 65535 Compu_IDENTITY 0 65535 PHYS_UNIT "Bit Mask" /end CHARACTERISTIC
/begin CHARACTERISTIC FPnd_CL_hi "FPrm_pending(47)" VALUE 0x001E5170 /* @ECU_Address@FPrm_pending@0x021BE05E@ */ ECIPP_ALIGNMENT_UWORD 65535 Compu_IDENTITY 0 65535 PHYS_UNIT "Bit Mask" /end CHARACTERISTIC
/begin CHARACTERISTIC FPnd_CL_lo "FPrm_pending(48)" VALUE 0x001E5172 /* @ECU_Address@FPrm_pending@0x021BE060@ */ ECIPP_ALIGNMENT_UWORD 65535 Compu_IDENTITY 0 65535 PHYS_UNIT "Bit Mask" /end CHARACTERISTIC
/begin CHARACTERISTIC FPsvr_APUD2_max "FPrm_severity(161)" VALUE 0x001E68B6 /* @ECU_Address@FPrm_severity@0x024B30A1@ */ ECIPP_ALIGNMENT_UBYTE 255 Compu_IDENTITY 0 255 PHYS_UNIT "Severity+Class" /end CHARACTERISTIC
/begin CHARACTERISTIC FPsvr_APUD2_min "FPrm_severity(162)" VALUE 0x001E68B7 /* @ECU_Address@FPrm_severity@0x024B30A2@ */ ECIPP_ALIGNMENT_UBYTE 255 Compu_IDENTITY 0 255 PHYS_UNIT "Severity+Class" /end CHARACTERISTIC
/begin CHARACTERISTIC FPsvr_APUD20_max "FPrm_severity(290)" VALUE 0x001E6937 /* @ECU_Address@FPrm_severity@0x024B3122@ */ ECIPP_ALIGNMENT_UBYTE 255 Compu_IDENTITY 0 255 PHYS_UNIT "Severity+Class" /end CHARACTERISTIC
/begin CHARACTERISTIC FPsvr_APUD20_min "FPrm_severity(291)" VALUE 0x001E6938 /* @ECU_Address@FPrm_severity@0x024B3123@ */ ECIPP_ALIGNMENT_UBYTE 255 Compu_IDENTITY 0 255 PHYS_UNIT "Severity+Class" /end CHARACTERISTIC
/begin CHARACTERISTIC FPsvr_APUD21_max "FPrm_severity(292)" VALUE 0x001E6939 /* @ECU_Address@FPrm_severity@0x024B3124@ */ ECIPP_ALIGNMENT_UBYTE 255 Compu_IDENTITY 0 255 PHYS_UNIT "Severity+Class" /end CHARACTERISTIC
/begin CHARACTERISTIC FPsvr_APUD21_min "FPrm_severity(293)" VALUE 0x001E693A /* @ECU_Address@FPrm_severity@0x024B3125@ */ ECIPP_ALIGNMENT_UBYTE 255 Compu_IDENTITY 0 255 PHYS_UNIT "Severity+Class" /end CHARACTERISTIC
/begin CHARACTERISTIC FPsvr_APUD22_max "FPrm_severity(294)" VALUE 0x001E693B /* @ECU_Address@FPrm_severity@0x024B3126@ */ ECIPP_ALIGNMENT_UBYTE 255 Compu_IDENTITY 0 255 PHYS_UNIT "Severity+Class" /end CHARACTERISTIC
/begin CHARACTERISTIC FPsvr_APUD22_min "FPrm_severity(295)" VALUE 0x001E693C /* @ECU_Address@FPrm_severity@0x024B3127@ */ ECIPP_ALIGNMENT_UBYTE 255 Compu_IDENTITY 0 255 PHYS_UNIT "Severity+Class" /end CHARACTERISTIC
/begin CHARACTERISTIC FPsvr_APUD23_max "FPrm_severity(296)" VALUE 0x001E693D /* @ECU_Address@FPrm_severity@0x024B3128@ */ ECIPP_ALIGNMENT_UBYTE 255 Compu_IDENTITY 0 255 PHYS_UNIT "Severity+Class" /end CHARACTERISTIC
/begin CHARACTERISTIC FPsvr_APUD23_min "FPrm_severity(297)" VALUE 0x001E693E /* @ECU_Address@FPrm_severity@0x024B3129@ */ ECIPP_ALIGNMENT_UBYTE 255 Compu_IDENTITY 0 255 PHYS_UNIT "Severity+Class" /end CHARACTERISTIC
/begin CHARACTERISTIC FPsvr_APUD24_max "FPrm_severity(298)" VALUE 0x001E693F /* @ECU_Address@FPrm_severity@0x024B312A@ */ ECIPP_ALIGNMENT_UBYTE 255 Compu_IDENTITY 0 255 PHYS_UNIT "Severity+Class" /end CHARACTERISTIC
/begin CHARACTERISTIC FPsvr_APUD24_min "FPrm_severity(299)" VALUE 0x001E6940 /* @ECU_Address@FPrm_severity@0x024B312B@ */ ECIPP_ALIGNMENT_UBYTE 255 Compu_IDENTITY 0 255 PHYS_UNIT "Severity+Class" /end CHARACTERISTIC
/begin CHARACTERISTIC FPsvr_APUD25_max "FPrm_severity(300)" VALUE 0x001E6941 /* @ECU_Address@FPrm_severity@0x024B312C@ */ ECIPP_ALIGNMENT_UBYTE 255 Compu_IDENTITY 0 255 PHYS_UNIT "Severity+Class" /end CHARACTERISTIC
/begin CHARACTERISTIC FPsvr_APUD25_min "FPrm_severity(301)" VALUE 0x001E6942 /* @ECU_Address@FPrm_severity@0x024B312D@ */ ECIPP_ALIGNMENT_UBYTE 255 Compu_IDENTITY 0 255 PHYS_UNIT "Severity+Class" /end CHARACTERISTIC
/begin CHARACTERISTIC FPsvr_APUD3_max "FPrm_severity(163)" VALUE 0x001E68B8 /* @ECU_Address@FPrm_severity@0x024B30A3@ */ ECIPP_ALIGNMENT_UBYTE 255 Compu_IDENTITY 0 255 PHYS_UNIT "Severity+Class" /end CHARACTERISTIC
/begin CHARACTERISTIC FPsvr_APUD3_min "FPrm_severity(164)" VALUE 0x001E68B9 /* @ECU_Address@FPrm_severity@0x024B30A4@ */ ECIPP_ALIGNMENT_UBYTE 255 Compu_IDENTITY 0 255 PHYS_UNIT "Severity+Class" /end CHARACTERISTIC
/begin CHARACTERISTIC FPsvr_APUD4_max "FPrm_severity(202)" VALUE 0x001E68DF /* @ECU_Address@FPrm_severity@0x024B30CA@ */ ECIPP_ALIGNMENT_UBYTE 255 Compu_IDENTITY 0 255 PHYS_UNIT "Severity+Class" /end CHARACTERISTIC
/begin CHARACTERISTIC FPsvr_APUD4_min "FPrm_severity(203)" VALUE 0x001E68E0 /* @ECU_Address@FPrm_severity@0x024B30CB@ */ ECIPP_ALIGNMENT_UBYTE 255 Compu_IDENTITY 0 255 PHYS_UNIT "Severity+Class" /end CHARACTERISTIC
/begin CHARACTERISTIC FPsvr_APUD5_max "FPrm_severity(240)" VALUE 0x001E6905 /* @ECU_Address@FPrm_severity@0x024B30F0@ */ ECIPP_ALIGNMENT_UBYTE 255 Compu_IDENTITY 0 255 PHYS_UNIT "Severity+Class" /end CHARACTERISTIC
/begin CHARACTERISTIC FPsvr_APUD5_min "FPrm_severity(241)" VALUE 0x001E6906 /* @ECU_Address@FPrm_severity@0x024B30F1@ */ ECIPP_ALIGNMENT_UBYTE 255 Compu_IDENTITY 0 255 PHYS_UNIT "Severity+Class" /end CHARACTERISTIC
/begin CHARACTERISTIC FPsvr_APUD6_max "FPrm_severity(242)" VALUE 0x001E6907 /* @ECU_Address@FPrm_severity@0x024B30F2@ */ ECIPP_ALIGNMENT_UBYTE 255 Compu_IDENTITY 0 255 PHYS_UNIT "Severity+Class" /end CHARACTERISTIC
/begin CHARACTERISTIC FPsvr_APUD6_min "FPrm_severity(243)" VALUE 0x001E6908 /* @ECU_Address@FPrm_severity@0x024B30F3@ */ ECIPP_ALIGNMENT_UBYTE 255 Compu_IDENTITY 0 255 PHYS_UNIT "Severity+Class" /end CHARACTERISTIC
/begin CHARACTERISTIC FPsvr_APUD7_max "FPrm_severity(244)" VALUE 0x001E6909 /* @ECU_Address@FPrm_severity@0x024B30F4@ */ ECIPP_ALIGNMENT_UBYTE 255 Compu_IDENTITY 0 255 PHYS_UNIT "Severity+Class" /end CHARACTERISTIC
/begin CHARACTERISTIC FPsvr_APUD7_min "FPrm_severity(245)" VALUE 0x001E690A /* @ECU_Address@FPrm_severity@0x024B30F5@ */ ECIPP_ALIGNMENT_UBYTE 255 Compu_IDENTITY 0 255 PHYS_UNIT "Severity+Class" /end CHARACTERISTIC
/begin CHARACTERISTIC FPsvr_APUD8_max "FPrm_severity(261)" VALUE 0x001E691A /* @ECU_Address@FPrm_severity@0x024B3105@ */ ECIPP_ALIGNMENT_UBYTE 255 Compu_IDENTITY 0 255 PHYS_UNIT "Severity+Class" /end CHARACTERISTIC
/begin CHARACTERISTIC FPsvr_APUD8_min "FPrm_severity(262)" VALUE 0x001E691B /* @ECU_Address@FPrm_severity@0x024B3106@ */ ECIPP_ALIGNMENT_UBYTE 255 Compu_IDENTITY 0 255 PHYS_UNIT "Severity+Class" /end CHARACTERISTIC
/begin CHARACTERISTIC FPsvr_APUD9_max "FPrm_severity(268)" VALUE 0x001E6921 /* @ECU_Address@FPrm_severity@0x024B310C@ */ ECIPP_ALIGNMENT_UBYTE 255 Compu_IDENTITY 0 255 PHYS_UNIT "Severity+Class" /end CHARACTERISTIC
/begin CHARACTERISTIC FPsvr_APUD9_min "FPrm_severity(269)" VALUE 0x001E6922 /* @ECU_Address@FPrm_severity@0x024B310D@ */ ECIPP_ALIGNMENT_UBYTE 255 Compu_IDENTITY 0 255 PHYS_UNIT "Severity+Class" /end CHARACTERISTIC
/begin CHARACTERISTIC FPsvr_AWP_intF "FPrm_severity(659)" VALUE 0x001E6AA8 /* @ECU_Address@FPrm_severity@0x024B3293@ */ ECIPP_ALIGNMENT_UBYTE 255 Compu_IDENTITY 0 255 PHYS_UNIT "Severity+Class" /end CHARACTERISTIC
/begin CHARACTERISTIC FPsvr_BP_max "FPrm_severity(10)" VALUE 0x001E681F /* @ECU_Address@FPrm_severity@0x024B300A@ */ ECIPP_ALIGNMENT_UBYTE 255 Compu_IDENTITY 0 255 PHYS_UNIT "Severity+Class" /end CHARACTERISTIC
/begin CHARACTERISTIC FPsvr_BP_min "FPrm_severity(11)" VALUE 0x001E6820 /* @ECU_Address@FPrm_severity@0x024B300B@ */ ECIPP_ALIGNMENT_UBYTE 255 Compu_IDENTITY 0 255 PHYS_UNIT "Severity+Class" /end CHARACTERISTIC
/begin CHARACTERISTIC FPsvr_BPS1_max "FPrm_severity(371)" VALUE 0x001E6988 /* @ECU_Address@FPrm_severity@0x024B3173@ */ ECIPP_ALIGNMENT_UBYTE 255 Compu_IDENTITY 0 255 PHYS_UNIT "Severity+Class" /end CHARACTERISTIC
/begin CHARACTERISTIC FPsvr_BPS1_min "FPrm_severity(372)" VALUE 0x001E6989 /* @ECU_Address@FPrm_severity@0x024B3174@ */ ECIPP_ALIGNMENT_UBYTE 255 Compu_IDENTITY 0 255 PHYS_UNIT "Severity+Class" /end CHARACTERISTIC
/begin CHARACTERISTIC FPsvr_BPS12_OOR "FPrm_severity(379)" VALUE 0x001E6990 /* @ECU_Address@FPrm_severity@0x024B317B@ */ ECIPP_ALIGNMENT_UBYTE 255 Compu_IDENTITY 0 255 PHYS_UNIT "Severity+Class" /end CHARACTERISTIC
/begin CHARACTERISTIC FPsvr_BPS12pct_hi "FPrm_severity(375)" VALUE 0x001E698C /* @ECU_Address@FPrm_severity@0x024B3177@ */ ECIPP_ALIGNMENT_UBYTE 255 Compu_IDENTITY 0 255 PHYS_UNIT "Severity+Class" /end CHARACTERISTIC
/begin CHARACTERISTIC FPsvr_BPS12pct_lo "FPrm_severity(376)" VALUE 0x001E698D /* @ECU_Address@FPrm_severity@0x024B3178@ */ ECIPP_ALIGNMENT_UBYTE 255 Compu_IDENTITY 0 255 PHYS_UNIT "Severity+Class" /end CHARACTERISTIC
/begin CHARACTERISTIC FPsvr_BPS2_max "FPrm_severity(373)" VALUE 0x001E698A /* @ECU_Address@FPrm_severity@0x024B3175@ */ ECIPP_ALIGNMENT_UBYTE 255 Compu_IDENTITY 0 255 PHYS_UNIT "Severity+Class" /end CHARACTERISTIC
/begin CHARACTERISTIC FPsvr_BPS2_min "FPrm_severity(374)" VALUE 0x001E698B /* @ECU_Address@FPrm_severity@0x024B3176@ */ ECIPP_ALIGNMENT_UBYTE 255 Compu_IDENTITY 0 255 PHYS_UNIT "Severity+Class" /end CHARACTERISTIC
/begin CHARACTERISTIC FPsvr_BPSerr_neg "FPrm_severity(378)" VALUE 0x001E698F /* @ECU_Address@FPrm_severity@0x024B317A@ */ ECIPP_ALIGNMENT_UBYTE 255 Compu_IDENTITY 0 255 PHYS_UNIT "Severity+Class" /end CHARACTERISTIC
/begin CHARACTERISTIC FPsvr_BPSerr_pos "FPrm_severity(377)" VALUE 0x001E698E /* @ECU_Address@FPrm_severity@0x024B3179@ */ ECIPP_ALIGNMENT_UBYTE 255 Compu_IDENTITY 0 255 PHYS_UNIT "Severity+Class" /end CHARACTERISTIC
/begin CHARACTERISTIC FPsvr_brake_gndshort "FPrm_severity(238)" VALUE 0x001E6903 /* @ECU_Address@FPrm_severity@0x024B30EE@ */ ECIPP_ALIGNMENT_UBYTE 255 Compu_IDENTITY 0 255 PHYS_UNIT "Severity+Class" /end CHARACTERISTIC
/begin CHARACTERISTIC FPsvr_brake_pwrshort "FPrm_severity(239)" VALUE 0x001E6904 /* @ECU_Address@FPrm_severity@0x024B30EF@ */ ECIPP_ALIGNMENT_UBYTE 255 Compu_IDENTITY 0 255 PHYS_UNIT "Severity+Class" /end CHARACTERISTIC
/begin CHARACTERISTIC FPsvr_bst_MAT_derate_actv "FPrm_severity(638)" VALUE 0x001E6A93 /* @ECU_Address@FPrm_severity@0x024B327E@ */ ECIPP_ALIGNMENT_UBYTE 255 Compu_IDENTITY 0 255 PHYS_UNIT "Severity+Class" /end CHARACTERISTIC
/begin CHARACTERISTIC FPsvr_BstTIP_Hi "FPrm_severity(103)" VALUE 0x001E687C /* @ECU_Address@FPrm_severity@0x024B3067@ */ ECIPP_ALIGNMENT_UBYTE 255 Compu_IDENTITY 0 255 PHYS_UNIT "Severity+Class" /end CHARACTERISTIC
/begin CHARACTERISTIC FPsvr_BstTIP_Lo "FPrm_severity(104)" VALUE 0x001E687D /* @ECU_Address@FPrm_severity@0x024B3068@ */ ECIPP_ALIGNMENT_UBYTE 255 Compu_IDENTITY 0 255 PHYS_UNIT "Severity+Class" /end CHARACTERISTIC
/begin CHARACTERISTIC FPsvr_BstTIP_Lo2 "FPrm_severity(516)" VALUE 0x001E6A19 /* @ECU_Address@FPrm_severity@0x024B3204@ */ ECIPP_ALIGNMENT_UBYTE 255 Compu_IDENTITY 0 255 PHYS_UNIT "Severity+Class" /end CHARACTERISTIC
/begin CHARACTERISTIC FPsvr_BstTIP_slow "FPrm_severity(485)" VALUE 0x001E69FA /* @ECU_Address@FPrm_severity@0x024B31E5@ */ ECIPP_ALIGNMENT_UBYTE 255 Compu_IDENTITY 0 255 PHYS_UNIT "Severity+Class" /end CHARACTERISTIC
/begin CHARACTERISTIC FPsvr_buzz_coilopen "FPrm_severity(125)" VALUE 0x001E6892 /* @ECU_Address@FPrm_severity@0x024B307D@ */ ECIPP_ALIGNMENT_UBYTE 255 Compu_IDENTITY 0 255 PHYS_UNIT "Severity+Class" /end CHARACTERISTIC
/begin CHARACTERISTIC FPsvr_buzz_coilshort "FPrm_severity(126)" VALUE 0x001E6893 /* @ECU_Address@FPrm_severity@0x024B307E@ */ ECIPP_ALIGNMENT_UBYTE 255 Compu_IDENTITY 0 255 PHYS_UNIT "Severity+Class" /end CHARACTERISTIC
/begin CHARACTERISTIC FPsvr_buzz_gndshort "FPrm_severity(124)" VALUE 0x001E6891 /* @ECU_Address@FPrm_severity@0x024B307C@ */ ECIPP_ALIGNMENT_UBYTE 255 Compu_IDENTITY 0 255 PHYS_UNIT "Severity+Class" /end CHARACTERISTIC
/begin CHARACTERISTIC FPsvr_CAC_eta_lo "FPrm_severity(486)" VALUE 0x001E69FB /* @ECU_Address@FPrm_severity@0x024B31E6@ */ ECIPP_ALIGNMENT_UBYTE 255 Compu_IDENTITY 0 255 PHYS_UNIT "Severity+Class" /end CHARACTERISTIC
/begin CHARACTERISTIC FPsvr_cal_config "FPrm_severity(228)" VALUE 0x001E68F9 /* @ECU_Address@FPrm_severity@0x024B30E4@ */ ECIPP_ALIGNMENT_UBYTE 255 Compu_IDENTITY 0 255 PHYS_UNIT "Severity+Class" /end CHARACTERISTIC
/begin CHARACTERISTIC FPsvr_cam2loss "FPrm_severity(520)" VALUE 0x001E6A1D /* @ECU_Address@FPrm_severity@0x024B3208@ */ ECIPP_ALIGNMENT_UBYTE 255 Compu_IDENTITY 0 255 PHYS_UNIT "Severity+Class" /end CHARACTERISTIC
/begin CHARACTERISTIC FPsvr_camloss "FPrm_severity(59)" VALUE 0x001E6850 /* @ECU_Address@FPrm_severity@0x024B303B@ */ ECIPP_ALIGNMENT_UBYTE 255 Compu_IDENTITY 0 255 PHYS_UNIT "Severity+Class" /end CHARACTERISTIC
/begin CHARACTERISTIC FPsvr_camnoise "FPrm_severity(60)" VALUE 0x001E6851 /* @ECU_Address@FPrm_severity@0x024B303C@ */ ECIPP_ALIGNMENT_UBYTE 255 Compu_IDENTITY 0 255 PHYS_UNIT "Severity+Class" /end CHARACTERISTIC
/begin CHARACTERISTIC FPsvr_CATdP_hi "FPrm_severity(396)" VALUE 0x001E69A1 /* @ECU_Address@FPrm_severity@0x024B318C@ */ ECIPP_ALIGNMENT_UBYTE 255 Compu_IDENTITY 0 255 PHYS_UNIT "Severity+Class" /end CHARACTERISTIC
/begin CHARACTERISTIC FPsvr_CATdP_lo "FPrm_severity(395)" VALUE 0x001E69A0 /* @ECU_Address@FPrm_severity@0x024B318B@ */ ECIPP_ALIGNMENT_UBYTE 255 Compu_IDENTITY 0 255 PHYS_UNIT "Severity+Class" /end CHARACTERISTIC
/begin CHARACTERISTIC FPsvr_CATout_OOR "FPrm_severity(658)" VALUE 0x001E6AA7 /* @ECU_Address@FPrm_severity@0x024B3292@ */ ECIPP_ALIGNMENT_UBYTE 255 Compu_IDENTITY 0 255 PHYS_UNIT "Severity+Class" /end CHARACTERISTIC
/begin CHARACTERISTIC FPsvr_CD_MF1 "FPrm_severity(710)" VALUE 0x001E6ADB /* @ECU_Address@FPrm_severity@0x024B32C6@ */ ECIPP_ALIGNMENT_UBYTE 255 Compu_IDENTITY 0 255 PHYS_UNIT "Severity+Class" /end CHARACTERISTIC
/begin CHARACTERISTIC FPsvr_CFV_FP_minv "FPrm_severity(517)" VALUE 0x001E6A1A /* @ECU_Address@FPrm_severity@0x024B3205@ */ ECIPP_ALIGNMENT_UBYTE 255 Compu_IDENTITY 0 255 PHYS_UNIT "Severity+Class" /end CHARACTERISTIC
/begin CHARACTERISTIC FPsvr_CFV_FT_maxv "FPrm_severity(518)" VALUE 0x001E6A1B /* @ECU_Address@FPrm_severity@0x024B3206@ */ ECIPP_ALIGNMENT_UBYTE 255 Compu_IDENTITY 0 255 PHYS_UNIT "Severity+Class" /end CHARACTERISTIC
/begin CHARACTERISTIC FPsvr_CFV_FT_minv "FPrm_severity(519)" VALUE 0x001E6A1C /* @ECU_Address@FPrm_severity@0x024B3207@ */ ECIPP_ALIGNMENT_UBYTE 255 Compu_IDENTITY 0 255 PHYS_UNIT "Severity+Class" /end CHARACTERISTIC
/begin CHARACTERISTIC FPsvr_CFV_mdot_hi "FPrm_severity(393)" VALUE 0x001E699E /* @ECU_Address@FPrm_severity@0x024B3189@ */ ECIPP_ALIGNMENT_UBYTE 255 Compu_IDENTITY 0 255 PHYS_UNIT "Severity+Class" /end CHARACTERISTIC
/begin CHARACTERISTIC FPsvr_CFV_mdot_lo "FPrm_severity(394)" VALUE 0x001E699F /* @ECU_Address@FPrm_severity@0x024B318A@ */ ECIPP_ALIGNMENT_UBYTE 255 Compu_IDENTITY 0 255 PHYS_UNIT "Severity+Class" /end CHARACTERISTIC
/begin CHARACTERISTIC FPsvr_CFV_mdot_rms_hi "FPrm_severity(509)" VALUE 0x001E6A12 /* @ECU_Address@FPrm_severity@0x024B31FD@ */ ECIPP_ALIGNMENT_UBYTE 255 Compu_IDENTITY 0 255 PHYS_UNIT "Severity+Class" /end CHARACTERISTIC
/begin CHARACTERISTIC FPsvr_CFV_pwr_loss "FPrm_severity(657)" VALUE 0x001E6AA6 /* @ECU_Address@FPrm_severity@0x024B3291@ */ ECIPP_ALIGNMENT_UBYTE 255 Compu_IDENTITY 0 255 PHYS_UNIT "Severity+Class" /end CHARACTERISTIC
/begin CHARACTERISTIC FPsvr_CFV_RLV_fail "FPrm_severity(405)" VALUE 0x001E69AA /* @ECU_Address@FPrm_severity@0x024B3195@ */ ECIPP_ALIGNMENT_UBYTE 255 Compu_IDENTITY 0 255 PHYS_UNIT "Severity+Class" /end CHARACTERISTIC
/begin CHARACTERISTIC FPsvr_CFV_RLV_P_min "FPrm_severity(404)" VALUE 0x001E69A9 /* @ECU_Address@FPrm_severity@0x024B3194@ */ ECIPP_ALIGNMENT_UBYTE 255 Compu_IDENTITY 0 255 PHYS_UNIT "Severity+Class" /end CHARACTERISTIC
/begin CHARACTERISTIC FPsvr_CHT_HiExp "FPrm_severity(73)" VALUE 0x001E685E /* @ECU_Address@FPrm_severity@0x024B3049@ */ ECIPP_ALIGNMENT_UBYTE 255 Compu_IDENTITY 0 255 PHYS_UNIT "Severity+Class" /end CHARACTERISTIC
/begin CHARACTERISTIC FPsvr_CHT_HiExp2 "FPrm_severity(74)" VALUE 0x001E685F /* @ECU_Address@FPrm_severity@0x024B304A@ */ ECIPP_ALIGNMENT_UBYTE 255 Compu_IDENTITY 0 255 PHYS_UNIT "Severity+Class" /end CHARACTERISTIC
/begin CHARACTERISTIC FPsvr_CL_hi "FPrm_severity(47)" VALUE 0x001E6844 /* @ECU_Address@FPrm_severity@0x024B302F@ */ ECIPP_ALIGNMENT_UBYTE 255 Compu_IDENTITY 0 255 PHYS_UNIT "Severity+Class" /end CHARACTERISTIC
/begin CHARACTERISTIC FPsvr_CL_lo "FPrm_severity(48)" VALUE 0x001E6845 /* @ECU_Address@FPrm_severity@0x024B3030@ */ ECIPP_ALIGNMENT_UBYTE 255 Compu_IDENTITY 0 255 PHYS_UNIT "Severity+Class" /end CHARACTERISTIC
/begin CHARACTERISTIC FPsw_APUD2_max "FPrm_switches(161)" VALUE 0x001C711C /* @ECU_Address@FPrm_switches@0x021B9142@ */ ECIPP_ALIGNMENT_UWORD 65535 Compu_IDENTITY 0 65535 PHYS_UNIT "Enable bits" /end CHARACTERISTIC
/begin CHARACTERISTIC FPsw_APUD2_min "FPrm_switches(162)" VALUE 0x001C711E /* @ECU_Address@FPrm_switches@0x021B9144@ */ ECIPP_ALIGNMENT_UWORD 65535 Compu_IDENTITY 0 65535 PHYS_UNIT "Enable bits" /end CHARACTERISTIC
/begin CHARACTERISTIC FPsw_APUD20_max "FPrm_switches(290)" VALUE 0x001C721E /* @ECU_Address@FPrm_switches@0x021B9244@ */ ECIPP_ALIGNMENT_UWORD 65535 Compu_IDENTITY 0 65535 PHYS_UNIT "Enable bits" /end CHARACTERISTIC
/begin CHARACTERISTIC FPsw_APUD20_min "FPrm_switches(291)" VALUE 0x001C7220 /* @ECU_Address@FPrm_switches@0x021B9246@ */ ECIPP_ALIGNMENT_UWORD 65535 Compu_IDENTITY 0 65535 PHYS_UNIT "Enable bits" /end CHARACTERISTIC
/begin CHARACTERISTIC FPsw_APUD21_max "FPrm_switches(292)" VALUE 0x001C7222 /* @ECU_Address@FPrm_switches@0x021B9248@ */ ECIPP_ALIGNMENT_UWORD 65535 Compu_IDENTITY 0 65535 PHYS_UNIT "Enable bits" /end CHARACTERISTIC
/begin CHARACTERISTIC FPsw_APUD21_min "FPrm_switches(293)" VALUE 0x001C7224 /* @ECU_Address@FPrm_switches@0x021B924A@ */ ECIPP_ALIGNMENT_UWORD 65535 Compu_IDENTITY 0 65535 PHYS_UNIT "Enable bits" /end CHARACTERISTIC
/begin CHARACTERISTIC FPsw_APUD22_max "FPrm_switches(294)" VALUE 0x001C7226 /* @ECU_Address@FPrm_switches@0x021B924C@ */ ECIPP_ALIGNMENT_UWORD 65535 Compu_IDENTITY 0 65535 PHYS_UNIT "Enable bits" /end CHARACTERISTIC
/begin CHARACTERISTIC FPsw_APUD22_min "FPrm_switches(295)" VALUE 0x001C7228 /* @ECU_Address@FPrm_switches@0x021B924E@ */ ECIPP_ALIGNMENT_UWORD 65535 Compu_IDENTITY 0 65535 PHYS_UNIT "Enable bits" /end CHARACTERISTIC
/begin CHARACTERISTIC FPsw_APUD23_max "FPrm_switches(296)" VALUE 0x001C722A /* @ECU_Address@FPrm_switches@0x021B9250@ */ ECIPP_ALIGNMENT_UWORD 65535 Compu_IDENTITY 0 65535 PHYS_UNIT "Enable bits" /end CHARACTERISTIC
/begin CHARACTERISTIC FPsw_APUD23_min "FPrm_switches(297)" VALUE 0x001C722C /* @ECU_Address@FPrm_switches@0x021B9252@ */ ECIPP_ALIGNMENT_UWORD 65535 Compu_IDENTITY 0 65535 PHYS_UNIT "Enable bits" /end CHARACTERISTIC
/begin CHARACTERISTIC FPsw_APUD24_max "FPrm_switches(298)" VALUE 0x001C722E /* @ECU_Address@FPrm_switches@0x021B9254@ */ ECIPP_ALIGNMENT_UWORD 65535 Compu_IDENTITY 0 65535 PHYS_UNIT "Enable bits" /end CHARACTERISTIC
/begin CHARACTERISTIC FPsw_APUD24_min "FPrm_switches(299)" VALUE 0x001C7230 /* @ECU_Address@FPrm_switches@0x021B9256@ */ ECIPP_ALIGNMENT_UWORD 65535 Compu_IDENTITY 0 65535 PHYS_UNIT "Enable bits" /end CHARACTERISTIC
/begin CHARACTERISTIC FPsw_APUD25_max "FPrm_switches(300)" VALUE 0x001C7232 /* @ECU_Address@FPrm_switches@0x021B9258@ */ ECIPP_ALIGNMENT_UWORD 65535 Compu_IDENTITY 0 65535 PHYS_UNIT "Enable bits" /end CHARACTERISTIC
/begin CHARACTERISTIC FPsw_APUD25_min "FPrm_switches(301)" VALUE 0x001C7234 /* @ECU_Address@FPrm_switches@0x021B925A@ */ ECIPP_ALIGNMENT_UWORD 65535 Compu_IDENTITY 0 65535 PHYS_UNIT "Enable bits" /end CHARACTERISTIC
/begin CHARACTERISTIC FPsw_APUD3_max "FPrm_switches(163)" VALUE 0x001C7120 /* @ECU_Address@FPrm_switches@0x021B9146@ */ ECIPP_ALIGNMENT_UWORD 65535 Compu_IDENTITY 0 65535 PHYS_UNIT "Enable bits" /end CHARACTERISTIC
/begin CHARACTERISTIC FPsw_APUD3_min "FPrm_switches(164)" VALUE 0x001C7122 /* @ECU_Address@FPrm_switches@0x021B9148@ */ ECIPP_ALIGNMENT_UWORD 65535 Compu_IDENTITY 0 65535 PHYS_UNIT "Enable bits" /end CHARACTERISTIC
/begin CHARACTERISTIC FPsw_APUD4_max "FPrm_switches(202)" VALUE 0x001C716E /* @ECU_Address@FPrm_switches@0x021B9194@ */ ECIPP_ALIGNMENT_UWORD 65535 Compu_IDENTITY 0 65535 PHYS_UNIT "Enable bits" /end CHARACTERISTIC
/begin CHARACTERISTIC FPsw_APUD4_min "FPrm_switches(203)" VALUE 0x001C7170 /* @ECU_Address@FPrm_switches@0x021B9196@ */ ECIPP_ALIGNMENT_UWORD 65535 Compu_IDENTITY 0 65535 PHYS_UNIT "Enable bits" /end CHARACTERISTIC
/begin CHARACTERISTIC FPsw_APUD5_max "FPrm_switches(240)" VALUE 0x001C71BA /* @ECU_Address@FPrm_switches@0x021B91E0@ */ ECIPP_ALIGNMENT_UWORD 65535 Compu_IDENTITY 0 65535 PHYS_UNIT "Enable bits" /end CHARACTERISTIC
/begin CHARACTERISTIC FPsw_APUD5_min "FPrm_switches(241)" VALUE 0x001C71BC /* @ECU_Address@FPrm_switches@0x021B91E2@ */ ECIPP_ALIGNMENT_UWORD 65535 Compu_IDENTITY 0 65535 PHYS_UNIT "Enable bits" /end CHARACTERISTIC
/begin CHARACTERISTIC FPsw_APUD6_max "FPrm_switches(242)" VALUE 0x001C71BE /* @ECU_Address@FPrm_switches@0x021B91E4@ */ ECIPP_ALIGNMENT_UWORD 65535 Compu_IDENTITY 0 65535 PHYS_UNIT "Enable bits" /end CHARACTERISTIC
/begin CHARACTERISTIC FPsw_APUD6_min "FPrm_switches(243)" VALUE 0x001C71C0 /* @ECU_Address@FPrm_switches@0x021B91E6@ */ ECIPP_ALIGNMENT_UWORD 65535 Compu_IDENTITY 0 65535 PHYS_UNIT "Enable bits" /end CHARACTERISTIC
/begin CHARACTERISTIC FPsw_APUD7_max "FPrm_switches(244)" VALUE 0x001C71C2 /* @ECU_Address@FPrm_switches@0x021B91E8@ */ ECIPP_ALIGNMENT_UWORD 65535 Compu_IDENTITY 0 65535 PHYS_UNIT "Enable bits" /end CHARACTERISTIC
/begin CHARACTERISTIC FPsw_APUD7_min "FPrm_switches(245)" VALUE 0x001C71C4 /* @ECU_Address@FPrm_switches@0x021B91EA@ */ ECIPP_ALIGNMENT_UWORD 65535 Compu_IDENTITY 0 65535 PHYS_UNIT "Enable bits" /end CHARACTERISTIC
/begin CHARACTERISTIC FPsw_APUD8_max "FPrm_switches(261)" VALUE 0x001C71E4 /* @ECU_Address@FPrm_switches@0x021B920A@ */ ECIPP_ALIGNMENT_UWORD 65535 Compu_IDENTITY 0 65535 PHYS_UNIT "Enable bits" /end CHARACTERISTIC
/begin CHARACTERISTIC FPsw_APUD8_min "FPrm_switches(262)" VALUE 0x001C71E6 /* @ECU_Address@FPrm_switches@0x021B920C@ */ ECIPP_ALIGNMENT_UWORD 65535 Compu_IDENTITY 0 65535 PHYS_UNIT "Enable bits" /end CHARACTERISTIC
/begin CHARACTERISTIC FPsw_APUD9_max "FPrm_switches(268)" VALUE 0x001C71F2 /* @ECU_Address@FPrm_switches@0x021B9218@ */ ECIPP_ALIGNMENT_UWORD 65535 Compu_IDENTITY 0 65535 PHYS_UNIT "Enable bits" /end CHARACTERISTIC
/begin CHARACTERISTIC FPsw_APUD9_min "FPrm_switches(269)" VALUE 0x001C71F4 /* @ECU_Address@FPrm_switches@0x021B921A@ */ ECIPP_ALIGNMENT_UWORD 65535 Compu_IDENTITY 0 65535 PHYS_UNIT "Enable bits" /end CHARACTERISTIC
/begin CHARACTERISTIC FPsw_AWP_intF "FPrm_switches(659)" VALUE 0x001C7500 /* @ECU_Address@FPrm_switches@0x021B9526@ */ ECIPP_ALIGNMENT_UWORD 65535 Compu_IDENTITY 0 65535 PHYS_UNIT "Enable bits" /end CHARACTERISTIC
/begin CHARACTERISTIC FPsw_BP_max "FPrm_switches(10)" VALUE 0x001C6FEE /* @ECU_Address@FPrm_switches@0x021B9014@ */ ECIPP_ALIGNMENT_UWORD 65535 Compu_IDENTITY 0 65535 PHYS_UNIT "Enable bits" /end CHARACTERISTIC
/begin CHARACTERISTIC FPsw_BP_min "FPrm_switches(11)" VALUE 0x001C6FF0 /* @ECU_Address@FPrm_switches@0x021B9016@ */ ECIPP_ALIGNMENT_UWORD 65535 Compu_IDENTITY 0 65535 PHYS_UNIT "Enable bits" /end CHARACTERISTIC
/begin CHARACTERISTIC FPsw_BPS1_max "FPrm_switches(371)" VALUE 0x001C72C0 /* @ECU_Address@FPrm_switches@0x021B92E6@ */ ECIPP_ALIGNMENT_UWORD 65535 Compu_IDENTITY 0 65535 PHYS_UNIT "Enable bits" /end CHARACTERISTIC
/begin CHARACTERISTIC FPsw_BPS1_min "FPrm_switches(372)" VALUE 0x001C72C2 /* @ECU_Address@FPrm_switches@0x021B92E8@ */ ECIPP_ALIGNMENT_UWORD 65535 Compu_IDENTITY 0 65535 PHYS_UNIT "Enable bits" /end CHARACTERISTIC
/begin CHARACTERISTIC FPsw_BPS12_OOR "FPrm_switches(379)" VALUE 0x001C72D0 /* @ECU_Address@FPrm_switches@0x021B92F6@ */ ECIPP_ALIGNMENT_UWORD 65535 Compu_IDENTITY 0 65535 PHYS_UNIT "Enable bits" /end CHARACTERISTIC
/begin CHARACTERISTIC FPsw_BPS12pct_hi "FPrm_switches(375)" VALUE 0x001C72C8 /* @ECU_Address@FPrm_switches@0x021B92EE@ */ ECIPP_ALIGNMENT_UWORD 65535 Compu_IDENTITY 0 65535 PHYS_UNIT "Enable bits" /end CHARACTERISTIC
/begin CHARACTERISTIC FPsw_BPS12pct_lo "FPrm_switches(376)" VALUE 0x001C72CA /* @ECU_Address@FPrm_switches@0x021B92F0@ */ ECIPP_ALIGNMENT_UWORD 65535 Compu_IDENTITY 0 65535 PHYS_UNIT "Enable bits" /end CHARACTERISTIC
/begin CHARACTERISTIC FPsw_BPS2_max "FPrm_switches(373)" VALUE 0x001C72C4 /* @ECU_Address@FPrm_switches@0x021B92EA@ */ ECIPP_ALIGNMENT_UWORD 65535 Compu_IDENTITY 0 65535 PHYS_UNIT "Enable bits" /end CHARACTERISTIC
/begin CHARACTERISTIC FPsw_BPS2_min "FPrm_switches(374)" VALUE 0x001C72C6 /* @ECU_Address@FPrm_switches@0x021B92EC@ */ ECIPP_ALIGNMENT_UWORD 65535 Compu_IDENTITY 0 65535 PHYS_UNIT "Enable bits" /end CHARACTERISTIC
/begin CHARACTERISTIC FPsw_BPSerr_neg "FPrm_switches(378)" VALUE 0x001C72CE /* @ECU_Address@FPrm_switches@0x021B92F4@ */ ECIPP_ALIGNMENT_UWORD 65535 Compu_IDENTITY 0 65535 PHYS_UNIT "Enable bits" /end CHARACTERISTIC
/begin CHARACTERISTIC FPsw_BPSerr_pos "FPrm_switches(377)" VALUE 0x001C72CC /* @ECU_Address@FPrm_switches@0x021B92F2@ */ ECIPP_ALIGNMENT_UWORD 65535 Compu_IDENTITY 0 65535 PHYS_UNIT "Enable bits" /end CHARACTERISTIC
/begin CHARACTERISTIC FPsw_brake_gndshort "FPrm_switches(238)" VALUE 0x001C71B6 /* @ECU_Address@FPrm_switches@0x021B91DC@ */ ECIPP_ALIGNMENT_UWORD 65535 Compu_IDENTITY 0 65535 PHYS_UNIT "Enable bits" /end CHARACTERISTIC
/begin CHARACTERISTIC FPsw_brake_pwrshort "FPrm_switches(239)" VALUE 0x001C71B8 /* @ECU_Address@FPrm_switches@0x021B91DE@ */ ECIPP_ALIGNMENT_UWORD 65535 Compu_IDENTITY 0 65535 PHYS_UNIT "Enable bits" /end CHARACTERISTIC
/begin CHARACTERISTIC FPsw_bst_MAT_derate_actv "FPrm_switches(638)" VALUE 0x001C74D6 /* @ECU_Address@FPrm_switches@0x021B94FC@ */ ECIPP_ALIGNMENT_UWORD 65535 Compu_IDENTITY 0 65535 PHYS_UNIT "Enable bits" /end CHARACTERISTIC
/begin CHARACTERISTIC FPsw_BstTIP_Hi "FPrm_switches(103)" VALUE 0x001C70A8 /* @ECU_Address@FPrm_switches@0x021B90CE@ */ ECIPP_ALIGNMENT_UWORD 65535 Compu_IDENTITY 0 65535 PHYS_UNIT "Enable bits" /end CHARACTERISTIC
/begin CHARACTERISTIC FPsw_BstTIP_Lo "FPrm_switches(104)" VALUE 0x001C70AA /* @ECU_Address@FPrm_switches@0x021B90D0@ */ ECIPP_ALIGNMENT_UWORD 65535 Compu_IDENTITY 0 65535 PHYS_UNIT "Enable bits" /end CHARACTERISTIC
/begin CHARACTERISTIC FPsw_BstTIP_Lo2 "FPrm_switches(516)" VALUE 0x001C73E2 /* @ECU_Address@FPrm_switches@0x021B9408@ */ ECIPP_ALIGNMENT_UWORD 65535 Compu_IDENTITY 0 65535 PHYS_UNIT "Enable bits" /end CHARACTERISTIC
/begin CHARACTERISTIC FPsw_BstTIP_slow "FPrm_switches(485)" VALUE 0x001C73A4 /* @ECU_Address@FPrm_switches@0x021B93CA@ */ ECIPP_ALIGNMENT_UWORD 65535 Compu_IDENTITY 0 65535 PHYS_UNIT "Enable bits" /end CHARACTERISTIC
/begin CHARACTERISTIC FPsw_buzz_coilopen "FPrm_switches(125)" VALUE 0x001C70D4 /* @ECU_Address@FPrm_switches@0x021B90FA@ */ ECIPP_ALIGNMENT_UWORD 65535 Compu_IDENTITY 0 65535 PHYS_UNIT "Enable bits" /end CHARACTERISTIC
/begin CHARACTERISTIC FPsw_buzz_coilshort "FPrm_switches(126)" VALUE 0x001C70D6 /* @ECU_Address@FPrm_switches@0x021B90FC@ */ ECIPP_ALIGNMENT_UWORD 65535 Compu_IDENTITY 0 65535 PHYS_UNIT "Enable bits" /end CHARACTERISTIC
/begin CHARACTERISTIC FPsw_buzz_gndshort "FPrm_switches(124)" VALUE 0x001C70D2 /* @ECU_Address@FPrm_switches@0x021B90F8@ */ ECIPP_ALIGNMENT_UWORD 65535 Compu_IDENTITY 0 65535 PHYS_UNIT "Enable bits" /end CHARACTERISTIC
/begin CHARACTERISTIC FPsw_CAC_eta_lo "FPrm_switches(486)" VALUE 0x001C73A6 /* @ECU_Address@FPrm_switches@0x021B93CC@ */ ECIPP_ALIGNMENT_UWORD 65535 Compu_IDENTITY 0 65535 PHYS_UNIT "Enable bits" /end CHARACTERISTIC
/begin CHARACTERISTIC FPsw_cal_config "FPrm_switches(228)" VALUE 0x001C71A2 /* @ECU_Address@FPrm_switches@0x021B91C8@ */ ECIPP_ALIGNMENT_UWORD 65535 Compu_IDENTITY 0 65535 PHYS_UNIT "Enable bits" /end CHARACTERISTIC
/begin CHARACTERISTIC FPsw_cam2loss "FPrm_switches(520)" VALUE 0x001C73EA /* @ECU_Address@FPrm_switches@0x021B9410@ */ ECIPP_ALIGNMENT_UWORD 65535 Compu_IDENTITY 0 65535 PHYS_UNIT "Enable bits" /end CHARACTERISTIC
/begin CHARACTERISTIC FPsw_camloss "FPrm_switches(59)" VALUE 0x001C7050 /* @ECU_Address@FPrm_switches@0x021B9076@ */ ECIPP_ALIGNMENT_UWORD 65535 Compu_IDENTITY 0 65535 PHYS_UNIT "Enable bits" /end CHARACTERISTIC
/begin CHARACTERISTIC FPsw_camnoise "FPrm_switches(60)" VALUE 0x001C7052 /* @ECU_Address@FPrm_switches@0x021B9078@ */ ECIPP_ALIGNMENT_UWORD 65535 Compu_IDENTITY 0 65535 PHYS_UNIT "Enable bits" /end CHARACTERISTIC
/begin CHARACTERISTIC FPsw_CATdP_hi "FPrm_switches(396)" VALUE 0x001C72F2 /* @ECU_Address@FPrm_switches@0x021B9318@ */ ECIPP_ALIGNMENT_UWORD 65535 Compu_IDENTITY 0 65535 PHYS_UNIT "Enable bits" /end CHARACTERISTIC
/begin CHARACTERISTIC FPsw_CATdP_lo "FPrm_switches(395)" VALUE 0x001C72F0 /* @ECU_Address@FPrm_switches@0x021B9316@ */ ECIPP_ALIGNMENT_UWORD 65535 Compu_IDENTITY 0 65535 PHYS_UNIT "Enable bits" /end CHARACTERISTIC
/begin CHARACTERISTIC FPsw_CATout_OOR "FPrm_switches(658)" VALUE 0x001C74FE /* @ECU_Address@FPrm_switches@0x021B9524@ */ ECIPP_ALIGNMENT_UWORD 65535 Compu_IDENTITY 0 65535 PHYS_UNIT "Enable bits" /end CHARACTERISTIC
/begin CHARACTERISTIC FPsw_CD_MF1 "FPrm_switches(710)" VALUE 0x001C7566 /* @ECU_Address@FPrm_switches@0x021B958C@ */ ECIPP_ALIGNMENT_UWORD 65535 Compu_IDENTITY 0 65535 PHYS_UNIT "Enable bits" /end CHARACTERISTIC
/begin CHARACTERISTIC FPsw_CFV_FP_minv "FPrm_switches(517)" VALUE 0x001C73E4 /* @ECU_Address@FPrm_switches@0x021B940A@ */ ECIPP_ALIGNMENT_UWORD 65535 Compu_IDENTITY 0 65535 PHYS_UNIT "Enable bits" /end CHARACTERISTIC
/begin CHARACTERISTIC FPsw_CFV_FT_maxv "FPrm_switches(518)" VALUE 0x001C73E6 /* @ECU_Address@FPrm_switches@0x021B940C@ */ ECIPP_ALIGNMENT_UWORD 65535 Compu_IDENTITY 0 65535 PHYS_UNIT "Enable bits" /end CHARACTERISTIC
/begin CHARACTERISTIC FPsw_CFV_FT_minv "FPrm_switches(519)" VALUE 0x001C73E8 /* @ECU_Address@FPrm_switches@0x021B940E@ */ ECIPP_ALIGNMENT_UWORD 65535 Compu_IDENTITY 0 65535 PHYS_UNIT "Enable bits" /end CHARACTERISTIC
/begin CHARACTERISTIC FPsw_CFV_mdot_hi "FPrm_switches(393)" VALUE 0x001C72EC /* @ECU_Address@FPrm_switches@0x021B9312@ */ ECIPP_ALIGNMENT_UWORD 65535 Compu_IDENTITY 0 65535 PHYS_UNIT "Enable bits" /end CHARACTERISTIC
/begin CHARACTERISTIC FPsw_CFV_mdot_lo "FPrm_switches(394)" VALUE 0x001C72EE /* @ECU_Address@FPrm_switches@0x021B9314@ */ ECIPP_ALIGNMENT_UWORD 65535 Compu_IDENTITY 0 65535 PHYS_UNIT "Enable bits" /end CHARACTERISTIC
/begin CHARACTERISTIC FPsw_CFV_mdot_rms_hi "FPrm_switches(509)" VALUE 0x001C73D4 /* @ECU_Address@FPrm_switches@0x021B93FA@ */ ECIPP_ALIGNMENT_UWORD 65535 Compu_IDENTITY 0 65535 PHYS_UNIT "Enable bits" /end CHARACTERISTIC
/begin CHARACTERISTIC FPsw_CFV_pwr_loss "FPrm_switches(657)" VALUE 0x001C74FC /* @ECU_Address@FPrm_switches@0x021B9522@ */ ECIPP_ALIGNMENT_UWORD 65535 Compu_IDENTITY 0 65535 PHYS_UNIT "Enable bits" /end CHARACTERISTIC
/begin CHARACTERISTIC FPsw_CFV_RLV_fail "FPrm_switches(405)" VALUE 0x001C7304 /* @ECU_Address@FPrm_switches@0x021B932A@ */ ECIPP_ALIGNMENT_UWORD 65535 Compu_IDENTITY 0 65535 PHYS_UNIT "Enable bits" /end CHARACTERISTIC
/begin CHARACTERISTIC FPsw_CFV_RLV_P_min "FPrm_switches(404)" VALUE 0x001C7302 /* @ECU_Address@FPrm_switches@0x021B9328@ */ ECIPP_ALIGNMENT_UWORD 65535 Compu_IDENTITY 0 65535 PHYS_UNIT "Enable bits" /end CHARACTERISTIC
/begin CHARACTERISTIC FPsw_CHT_HiExp "FPrm_switches(73)" VALUE 0x001C706C /* @ECU_Address@FPrm_switches@0x021B9092@ */ ECIPP_ALIGNMENT_UWORD 65535 Compu_IDENTITY 0 65535 PHYS_UNIT "Enable bits" /end CHARACTERISTIC
/begin CHARACTERISTIC FPsw_CHT_HiExp2 "FPrm_switches(74)" VALUE 0x001C706E /* @ECU_Address@FPrm_switches@0x021B9094@ */ ECIPP_ALIGNMENT_UWORD 65535 Compu_IDENTITY 0 65535 PHYS_UNIT "Enable bits" /end CHARACTERISTIC
/begin CHARACTERISTIC FPsw_CL_hi "FPrm_switches(47)" VALUE 0x001C7038 /* @ECU_Address@FPrm_switches@0x021B905E@ */ ECIPP_ALIGNMENT_UWORD 65535 Compu_IDENTITY 0 65535 PHYS_UNIT "Enable bits" /end CHARACTERISTIC
/begin CHARACTERISTIC FPsw_CL_lo "FPrm_switches(48)" VALUE 0x001C703A /* @ECU_Address@FPrm_switches@0x021B9060@ */ ECIPP_ALIGNMENT_UWORD 65535 Compu_IDENTITY 0 65535 PHYS_UNIT "Enable bits" /end CHARACTERISTIC
/begin CHARACTERISTIC FPsw_ext1_APUD2_max "FPrm_switches_ext1(161)" VALUE 0x001C76C0 /* @ECU_Address@FPrm_switches_ext1@0x023A5142@ */ ECIPP_ALIGNMENT_UWORD 65535 Compu_IDENTITY 0 65535 PHYS_UNIT "Enable bits" /end CHARACTERISTIC
/begin CHARACTERISTIC FPsw_ext1_APUD2_min "FPrm_switches_ext1(162)" VALUE 0x001C76C2 /* @ECU_Address@FPrm_switches_ext1@0x023A5144@ */ ECIPP_ALIGNMENT_UWORD 65535 Compu_IDENTITY 0 65535 PHYS_UNIT "Enable bits" /end CHARACTERISTIC
/begin CHARACTERISTIC FPsw_ext1_APUD20_max "FPrm_switches_ext1(290)" VALUE 0x001C77C2 /* @ECU_Address@FPrm_switches_ext1@0x023A5244@ */ ECIPP_ALIGNMENT_UWORD 65535 Compu_IDENTITY 0 65535 PHYS_UNIT "Enable bits" /end CHARACTERISTIC
/begin CHARACTERISTIC FPsw_ext1_APUD20_min "FPrm_switches_ext1(291)" VALUE 0x001C77C4 /* @ECU_Address@FPrm_switches_ext1@0x023A5246@ */ ECIPP_ALIGNMENT_UWORD 65535 Compu_IDENTITY 0 65535 PHYS_UNIT "Enable bits" /end CHARACTERISTIC
/begin CHARACTERISTIC FPsw_ext1_APUD21_max "FPrm_switches_ext1(292)" VALUE 0x001C77C6 /* @ECU_Address@FPrm_switches_ext1@0x023A5248@ */ ECIPP_ALIGNMENT_UWORD 65535 Compu_IDENTITY 0 65535 PHYS_UNIT "Enable bits" /end CHARACTERISTIC
/begin CHARACTERISTIC FPsw_ext1_APUD21_min "FPrm_switches_ext1(293)" VALUE 0x001C77C8 /* @ECU_Address@FPrm_switches_ext1@0x023A524A@ */ ECIPP_ALIGNMENT_UWORD 65535 Compu_IDENTITY 0 65535 PHYS_UNIT "Enable bits" /end CHARACTERISTIC
/begin CHARACTERISTIC FPsw_ext1_APUD22_max "FPrm_switches_ext1(294)" VALUE 0x001C77CA /* @ECU_Address@FPrm_switches_ext1@0x023A524C@ */ ECIPP_ALIGNMENT_UWORD 65535 Compu_IDENTITY 0 65535 PHYS_UNIT "Enable bits" /end CHARACTERISTIC
/begin CHARACTERISTIC FPsw_ext1_APUD22_min "FPrm_switches_ext1(295)" VALUE 0x001C77CC /* @ECU_Address@FPrm_switches_ext1@0x023A524E@ */ ECIPP_ALIGNMENT_UWORD 65535 Compu_IDENTITY 0 65535 PHYS_UNIT "Enable bits" /end CHARACTERISTIC
/begin CHARACTERISTIC FPsw_ext1_APUD23_max "FPrm_switches_ext1(296)" VALUE 0x001C77CE /* @ECU_Address@FPrm_switches_ext1@0x023A5250@ */ ECIPP_ALIGNMENT_UWORD 65535 Compu_IDENTITY 0 65535 PHYS_UNIT "Enable bits" /end CHARACTERISTIC
/begin CHARACTERISTIC FPsw_ext1_APUD23_min "FPrm_switches_ext1(297)" VALUE 0x001C77D0 /* @ECU_Address@FPrm_switches_ext1@0x023A5252@ */ ECIPP_ALIGNMENT_UWORD 65535 Compu_IDENTITY 0 65535 PHYS_UNIT "Enable bits" /end CHARACTERISTIC
/begin CHARACTERISTIC FPsw_ext1_APUD24_max "FPrm_switches_ext1(298)" VALUE 0x001C77D2 /* @ECU_Address@FPrm_switches_ext1@0x023A5254@ */ ECIPP_ALIGNMENT_UWORD 65535 Compu_IDENTITY 0 65535 PHYS_UNIT "Enable bits" /end CHARACTERISTIC
/begin CHARACTERISTIC FPsw_ext1_APUD24_min "FPrm_switches_ext1(299)" VALUE 0x001C77D4 /* @ECU_Address@FPrm_switches_ext1@0x023A5256@ */ ECIPP_ALIGNMENT_UWORD 65535 Compu_IDENTITY 0 65535 PHYS_UNIT "Enable bits" /end CHARACTERISTIC
/begin CHARACTERISTIC FPsw_ext1_APUD25_max "FPrm_switches_ext1(300)" VALUE 0x001C77D6 /* @ECU_Address@FPrm_switches_ext1@0x023A5258@ */ ECIPP_ALIGNMENT_UWORD 65535 Compu_IDENTITY 0 65535 PHYS_UNIT "Enable bits" /end CHARACTERISTIC
/begin CHARACTERISTIC FPsw_ext1_APUD25_min "FPrm_switches_ext1(301)" VALUE 0x001C77D8 /* @ECU_Address@FPrm_switches_ext1@0x023A525A@ */ ECIPP_ALIGNMENT_UWORD 65535 Compu_IDENTITY 0 65535 PHYS_UNIT "Enable bits" /end CHARACTERISTIC
/begin CHARACTERISTIC FPsw_ext1_APUD3_max "FPrm_switches_ext1(163)" VALUE 0x001C76C4 /* @ECU_Address@FPrm_switches_ext1@0x023A5146@ */ ECIPP_ALIGNMENT_UWORD 65535 Compu_IDENTITY 0 65535 PHYS_UNIT "Enable bits" /end CHARACTERISTIC
/begin CHARACTERISTIC FPsw_ext1_APUD3_min "FPrm_switches_ext1(164)" VALUE 0x001C76C6 /* @ECU_Address@FPrm_switches_ext1@0x023A5148@ */ ECIPP_ALIGNMENT_UWORD 65535 Compu_IDENTITY 0 65535 PHYS_UNIT "Enable bits" /end CHARACTERISTIC
/begin CHARACTERISTIC FPsw_ext1_APUD4_max "FPrm_switches_ext1(202)" VALUE 0x001C7712 /* @ECU_Address@FPrm_switches_ext1@0x023A5194@ */ ECIPP_ALIGNMENT_UWORD 65535 Compu_IDENTITY 0 65535 PHYS_UNIT "Enable bits" /end CHARACTERISTIC
/begin CHARACTERISTIC FPsw_ext1_APUD4_min "FPrm_switches_ext1(203)" VALUE 0x001C7714 /* @ECU_Address@FPrm_switches_ext1@0x023A5196@ */ ECIPP_ALIGNMENT_UWORD 65535 Compu_IDENTITY 0 65535 PHYS_UNIT "Enable bits" /end CHARACTERISTIC
/begin CHARACTERISTIC FPsw_ext1_APUD5_max "FPrm_switches_ext1(240)" VALUE 0x001C775E /* @ECU_Address@FPrm_switches_ext1@0x023A51E0@ */ ECIPP_ALIGNMENT_UWORD 65535 Compu_IDENTITY 0 65535 PHYS_UNIT "Enable bits" /end CHARACTERISTIC
/begin CHARACTERISTIC FPsw_ext1_APUD5_min "FPrm_switches_ext1(241)" VALUE 0x001C7760 /* @ECU_Address@FPrm_switches_ext1@0x023A51E2@ */ ECIPP_ALIGNMENT_UWORD 65535 Compu_IDENTITY 0 65535 PHYS_UNIT "Enable bits" /end CHARACTERISTIC
/begin CHARACTERISTIC FPsw_ext1_APUD6_max "FPrm_switches_ext1(242)" VALUE 0x001C7762 /* @ECU_Address@FPrm_switches_ext1@0x023A51E4@ */ ECIPP_ALIGNMENT_UWORD 65535 Compu_IDENTITY 0 65535 PHYS_UNIT "Enable bits" /end CHARACTERISTIC
/begin CHARACTERISTIC FPsw_ext1_APUD6_min "FPrm_switches_ext1(243)" VALUE 0x001C7764 /* @ECU_Address@FPrm_switches_ext1@0x023A51E6@ */ ECIPP_ALIGNMENT_UWORD 65535 Compu_IDENTITY 0 65535 PHYS_UNIT "Enable bits" /end CHARACTERISTIC
/begin CHARACTERISTIC FPsw_ext1_APUD7_max "FPrm_switches_ext1(244)" VALUE 0x001C7766 /* @ECU_Address@FPrm_switches_ext1@0x023A51E8@ */ ECIPP_ALIGNMENT_UWORD 65535 Compu_IDENTITY 0 65535 PHYS_UNIT "Enable bits" /end CHARACTERISTIC
/begin CHARACTERISTIC FPsw_ext1_APUD7_min "FPrm_switches_ext1(245)" VALUE 0x001C7768 /* @ECU_Address@FPrm_switches_ext1@0x023A51EA@ */ ECIPP_ALIGNMENT_UWORD 65535 Compu_IDENTITY 0 65535 PHYS_UNIT "Enable bits" /end CHARACTERISTIC
/begin CHARACTERISTIC FPsw_ext1_APUD8_max "FPrm_switches_ext1(261)" VALUE 0x001C7788 /* @ECU_Address@FPrm_switches_ext1@0x023A520A@ */ ECIPP_ALIGNMENT_UWORD 65535 Compu_IDENTITY 0 65535 PHYS_UNIT "Enable bits" /end CHARACTERISTIC
/begin CHARACTERISTIC FPsw_ext1_APUD8_min "FPrm_switches_ext1(262)" VALUE 0x001C778A /* @ECU_Address@FPrm_switches_ext1@0x023A520C@ */ ECIPP_ALIGNMENT_UWORD 65535 Compu_IDENTITY 0 65535 PHYS_UNIT "Enable bits" /end CHARACTERISTIC
/begin CHARACTERISTIC FPsw_ext1_APUD9_max "FPrm_switches_ext1(268)" VALUE 0x001C7796 /* @ECU_Address@FPrm_switches_ext1@0x023A5218@ */ ECIPP_ALIGNMENT_UWORD 65535 Compu_IDENTITY 0 65535 PHYS_UNIT "Enable bits" /end CHARACTERISTIC
/begin CHARACTERISTIC FPsw_ext1_APUD9_min "FPrm_switches_ext1(269)" VALUE 0x001C7798 /* @ECU_Address@FPrm_switches_ext1@0x023A521A@ */ ECIPP_ALIGNMENT_UWORD 65535 Compu_IDENTITY 0 65535 PHYS_UNIT "Enable bits" /end CHARACTERISTIC
/begin CHARACTERISTIC FPsw_ext1_AWP_intF "FPrm_switches_ext1(659)" VALUE 0x001C7AA4 /* @ECU_Address@FPrm_switches_ext1@0x023A5526@ */ ECIPP_ALIGNMENT_UWORD 65535 Compu_IDENTITY 0 65535 PHYS_UNIT "Enable bits" /end CHARACTERISTIC
/begin CHARACTERISTIC FPsw_ext1_BP_max "FPrm_switches_ext1(10)" VALUE 0x001C7592 /* @ECU_Address@FPrm_switches_ext1@0x023A5014@ */ ECIPP_ALIGNMENT_UWORD 65535 Compu_IDENTITY 0 65535 PHYS_UNIT "Enable bits" /end CHARACTERISTIC
/begin CHARACTERISTIC FPsw_ext1_BP_min "FPrm_switches_ext1(11)" VALUE 0x001C7594 /* @ECU_Address@FPrm_switches_ext1@0x023A5016@ */ ECIPP_ALIGNMENT_UWORD 65535 Compu_IDENTITY 0 65535 PHYS_UNIT "Enable bits" /end CHARACTERISTIC
/begin CHARACTERISTIC FPsw_ext1_BPS1_max "FPrm_switches_ext1(371)" VALUE 0x001C7864 /* @ECU_Address@FPrm_switches_ext1@0x023A52E6@ */ ECIPP_ALIGNMENT_UWORD 65535 Compu_IDENTITY 0 65535 PHYS_UNIT "Enable bits" /end CHARACTERISTIC
/begin CHARACTERISTIC FPsw_ext1_BPS1_min "FPrm_switches_ext1(372)" VALUE 0x001C7866 /* @ECU_Address@FPrm_switches_ext1@0x023A52E8@ */ ECIPP_ALIGNMENT_UWORD 65535 Compu_IDENTITY 0 65535 PHYS_UNIT "Enable bits" /end CHARACTERISTIC
/begin CHARACTERISTIC FPsw_ext1_BPS12_OOR "FPrm_switches_ext1(379)" VALUE 0x001C7874 /* @ECU_Address@FPrm_switches_ext1@0x023A52F6@ */ ECIPP_ALIGNMENT_UWORD 65535 Compu_IDENTITY 0 65535 PHYS_UNIT "Enable bits" /end CHARACTERISTIC
/begin CHARACTERISTIC FPsw_ext1_BPS12pct_hi "FPrm_switches_ext1(375)" VALUE 0x001C786C /* @ECU_Address@FPrm_switches_ext1@0x023A52EE@ */ ECIPP_ALIGNMENT_UWORD 65535 Compu_IDENTITY 0 65535 PHYS_UNIT "Enable bits" /end CHARACTERISTIC
/begin CHARACTERISTIC FPsw_ext1_BPS12pct_lo "FPrm_switches_ext1(376)" VALUE 0x001C786E /* @ECU_Address@FPrm_switches_ext1@0x023A52F0@ */ ECIPP_ALIGNMENT_UWORD 65535 Compu_IDENTITY 0 65535 PHYS_UNIT "Enable bits" /end CHARACTERISTIC
/begin CHARACTERISTIC FPsw_ext1_BPS2_max "FPrm_switches_ext1(373)" VALUE 0x001C7868 /* @ECU_Address@FPrm_switches_ext1@0x023A52EA@ */ ECIPP_ALIGNMENT_UWORD 65535 Compu_IDENTITY 0 65535 PHYS_UNIT "Enable bits" /end CHARACTERISTIC
/begin CHARACTERISTIC FPsw_ext1_BPS2_min "FPrm_switches_ext1(374)" VALUE 0x001C786A /* @ECU_Address@FPrm_switches_ext1@0x023A52EC@ */ ECIPP_ALIGNMENT_UWORD 65535 Compu_IDENTITY 0 65535 PHYS_UNIT "Enable bits" /end CHARACTERISTIC
/begin CHARACTERISTIC FPsw_ext1_BPSerr_neg "FPrm_switches_ext1(378)" VALUE 0x001C7872 /* @ECU_Address@FPrm_switches_ext1@0x023A52F4@ */ ECIPP_ALIGNMENT_UWORD 65535 Compu_IDENTITY 0 65535 PHYS_UNIT "Enable bits" /end CHARACTERISTIC
/begin CHARACTERISTIC FPsw_ext1_BPSerr_pos "FPrm_switches_ext1(377)" VALUE 0x001C7870 /* @ECU_Address@FPrm_switches_ext1@0x023A52F2@ */ ECIPP_ALIGNMENT_UWORD 65535 Compu_IDENTITY 0 65535 PHYS_UNIT "Enable bits" /end CHARACTERISTIC
/begin CHARACTERISTIC FPsw_ext1_brake_gndshort "FPrm_switches_ext1(238)" VALUE 0x001C775A /* @ECU_Address@FPrm_switches_ext1@0x023A51DC@ */ ECIPP_ALIGNMENT_UWORD 65535 Compu_IDENTITY 0 65535 PHYS_UNIT "Enable bits" /end CHARACTERISTIC
/begin CHARACTERISTIC FPsw_ext1_brake_pwrshort "FPrm_switches_ext1(239)" VALUE 0x001C775C /* @ECU_Address@FPrm_switches_ext1@0x023A51DE@ */ ECIPP_ALIGNMENT_UWORD 65535 Compu_IDENTITY 0 65535 PHYS_UNIT "Enable bits" /end CHARACTERISTIC
/begin CHARACTERISTIC FPsw_ext1_bst_MAT_derate_actv "FPrm_switches_ext1(638)" VALUE 0x001C7A7A /* @ECU_Address@FPrm_switches_ext1@0x023A54FC@ */ ECIPP_ALIGNMENT_UWORD 65535 Compu_IDENTITY 0 65535 PHYS_UNIT "Enable bits" /end CHARACTERISTIC
/begin CHARACTERISTIC FPsw_ext1_BstTIP_Hi "FPrm_switches_ext1(103)" VALUE 0x001C764C /* @ECU_Address@FPrm_switches_ext1@0x023A50CE@ */ ECIPP_ALIGNMENT_UWORD 65535 Compu_IDENTITY 0 65535 PHYS_UNIT "Enable bits" /end CHARACTERISTIC
/begin CHARACTERISTIC FPsw_ext1_BstTIP_Lo "FPrm_switches_ext1(104)" VALUE 0x001C764E /* @ECU_Address@FPrm_switches_ext1@0x023A50D0@ */ ECIPP_ALIGNMENT_UWORD 65535 Compu_IDENTITY 0 65535 PHYS_UNIT "Enable bits" /end CHARACTERISTIC
/begin CHARACTERISTIC FPsw_ext1_BstTIP_Lo2 "FPrm_switches_ext1(516)" VALUE 0x001C7986 /* @ECU_Address@FPrm_switches_ext1@0x023A5408@ */ ECIPP_ALIGNMENT_UWORD 65535 Compu_IDENTITY 0 65535 PHYS_UNIT "Enable bits" /end CHARACTERISTIC
/begin CHARACTERISTIC FPsw_ext1_BstTIP_slow "FPrm_switches_ext1(485)" VALUE 0x001C7948 /* @ECU_Address@FPrm_switches_ext1@0x023A53CA@ */ ECIPP_ALIGNMENT_UWORD 65535 Compu_IDENTITY 0 65535 PHYS_UNIT "Enable bits" /end CHARACTERISTIC
/begin CHARACTERISTIC FPsw_ext1_buzz_coilopen "FPrm_switches_ext1(125)" VALUE 0x001C7678 /* @ECU_Address@FPrm_switches_ext1@0x023A50FA@ */ ECIPP_ALIGNMENT_UWORD 65535 Compu_IDENTITY 0 65535 PHYS_UNIT "Enable bits" /end CHARACTERISTIC
/begin CHARACTERISTIC FPsw_ext1_buzz_coilshort "FPrm_switches_ext1(126)" VALUE 0x001C767A /* @ECU_Address@FPrm_switches_ext1@0x023A50FC@ */ ECIPP_ALIGNMENT_UWORD 65535 Compu_IDENTITY 0 65535 PHYS_UNIT "Enable bits" /end CHARACTERISTIC
/begin CHARACTERISTIC FPsw_ext1_buzz_gndshort "FPrm_switches_ext1(124)" VALUE 0x001C7676 /* @ECU_Address@FPrm_switches_ext1@0x023A50F8@ */ ECIPP_ALIGNMENT_UWORD 65535 Compu_IDENTITY 0 65535 PHYS_UNIT "Enable bits" /end CHARACTERISTIC
/begin CHARACTERISTIC FPsw_ext1_CAC_eta_lo "FPrm_switches_ext1(486)" VALUE 0x001C794A /* @ECU_Address@FPrm_switches_ext1@0x023A53CC@ */ ECIPP_ALIGNMENT_UWORD 65535 Compu_IDENTITY 0 65535 PHYS_UNIT "Enable bits" /end CHARACTERISTIC
/begin CHARACTERISTIC FPsw_ext1_cal_config "FPrm_switches_ext1(228)" VALUE 0x001C7746 /* @ECU_Address@FPrm_switches_ext1@0x023A51C8@ */ ECIPP_ALIGNMENT_UWORD 65535 Compu_IDENTITY 0 65535 PHYS_UNIT "Enable bits" /end CHARACTERISTIC
/begin CHARACTERISTIC FPsw_ext1_cam2loss "FPrm_switches_ext1(520)" VALUE 0x001C798E /* @ECU_Address@FPrm_switches_ext1@0x023A5410@ */ ECIPP_ALIGNMENT_UWORD 65535 Compu_IDENTITY 0 65535 PHYS_UNIT "Enable bits" /end CHARACTERISTIC
/begin CHARACTERISTIC FPsw_ext1_camloss "FPrm_switches_ext1(59)" VALUE 0x001C75F4 /* @ECU_Address@FPrm_switches_ext1@0x023A5076@ */ ECIPP_ALIGNMENT_UWORD 65535 Compu_IDENTITY 0 65535 PHYS_UNIT "Enable bits" /end CHARACTERISTIC
/begin CHARACTERISTIC FPsw_ext1_camnoise "FPrm_switches_ext1(60)" VALUE 0x001C75F6 /* @ECU_Address@FPrm_switches_ext1@0x023A5078@ */ ECIPP_ALIGNMENT_UWORD 65535 Compu_IDENTITY 0 65535 PHYS_UNIT "Enable bits" /end CHARACTERISTIC
/begin CHARACTERISTIC FPsw_ext1_CATdP_hi "FPrm_switches_ext1(396)" VALUE 0x001C7896 /* @ECU_Address@FPrm_switches_ext1@0x023A5318@ */ ECIPP_ALIGNMENT_UWORD 65535 Compu_IDENTITY 0 65535 PHYS_UNIT "Enable bits" /end CHARACTERISTIC
/begin CHARACTERISTIC FPsw_ext1_CATdP_lo "FPrm_switches_ext1(395)" VALUE 0x001C7894 /* @ECU_Address@FPrm_switches_ext1@0x023A5316@ */ ECIPP_ALIGNMENT_UWORD 65535 Compu_IDENTITY 0 65535 PHYS_UNIT "Enable bits" /end CHARACTERISTIC
/begin CHARACTERISTIC FPsw_ext1_CATout_OOR "FPrm_switches_ext1(658)" VALUE 0x001C7AA2 /* @ECU_Address@FPrm_switches_ext1@0x023A5524@ */ ECIPP_ALIGNMENT_UWORD 65535 Compu_IDENTITY 0 65535 PHYS_UNIT "Enable bits" /end CHARACTERISTIC
/begin CHARACTERISTIC FPsw_ext1_CD_MF1 "FPrm_switches_ext1(710)" VALUE 0x001C7B0A /* @ECU_Address@FPrm_switches_ext1@0x023A558C@ */ ECIPP_ALIGNMENT_UWORD 65535 Compu_IDENTITY 0 65535 PHYS_UNIT "Enable bits" /end CHARACTERISTIC
/begin CHARACTERISTIC FPsw_ext1_CFV_FP_minv "FPrm_switches_ext1(517)" VALUE 0x001C7988 /* @ECU_Address@FPrm_switches_ext1@0x023A540A@ */ ECIPP_ALIGNMENT_UWORD 65535 Compu_IDENTITY 0 65535 PHYS_UNIT "Enable bits" /end CHARACTERISTIC
/begin CHARACTERISTIC FPsw_ext1_CFV_FT_maxv "FPrm_switches_ext1(518)" VALUE 0x001C798A /* @ECU_Address@FPrm_switches_ext1@0x023A540C@ */ ECIPP_ALIGNMENT_UWORD 65535 Compu_IDENTITY 0 65535 PHYS_UNIT "Enable bits" /end CHARACTERISTIC
/begin CHARACTERISTIC FPsw_ext1_CFV_FT_minv "FPrm_switches_ext1(519)" VALUE 0x001C798C /* @ECU_Address@FPrm_switches_ext1@0x023A540E@ */ ECIPP_ALIGNMENT_UWORD 65535 Compu_IDENTITY 0 65535 PHYS_UNIT "Enable bits" /end CHARACTERISTIC
/begin CHARACTERISTIC FPsw_ext1_CFV_mdot_hi "FPrm_switches_ext1(393)" VALUE 0x001C7890 /* @ECU_Address@FPrm_switches_ext1@0x023A5312@ */ ECIPP_ALIGNMENT_UWORD 65535 Compu_IDENTITY 0 65535 PHYS_UNIT "Enable bits" /end CHARACTERISTIC
/begin CHARACTERISTIC FPsw_ext1_CFV_mdot_lo "FPrm_switches_ext1(394)" VALUE 0x001C7892 /* @ECU_Address@FPrm_switches_ext1@0x023A5314@ */ ECIPP_ALIGNMENT_UWORD 65535 Compu_IDENTITY 0 65535 PHYS_UNIT "Enable bits" /end CHARACTERISTIC
/begin CHARACTERISTIC FPsw_ext1_CFV_mdot_rms_hi "FPrm_switches_ext1(509)" VALUE 0x001C7978 /* @ECU_Address@FPrm_switches_ext1@0x023A53FA@ */ ECIPP_ALIGNMENT_UWORD 65535 Compu_IDENTITY 0 65535 PHYS_UNIT "Enable bits" /end CHARACTERISTIC
/begin CHARACTERISTIC FPsw_ext1_CFV_pwr_loss "FPrm_switches_ext1(657)" VALUE 0x001C7AA0 /* @ECU_Address@FPrm_switches_ext1@0x023A5522@ */ ECIPP_ALIGNMENT_UWORD 65535 Compu_IDENTITY 0 65535 PHYS_UNIT "Enable bits" /end CHARACTERISTIC
/begin CHARACTERISTIC FPsw_ext1_CFV_RLV_fail "FPrm_switches_ext1(405)" VALUE 0x001C78A8 /* @ECU_Address@FPrm_switches_ext1@0x023A532A@ */ ECIPP_ALIGNMENT_UWORD 65535 Compu_IDENTITY 0 65535 PHYS_UNIT "Enable bits" /end CHARACTERISTIC
/begin CHARACTERISTIC FPsw_ext1_CFV_RLV_P_min "FPrm_switches_ext1(404)" VALUE 0x001C78A6 /* @ECU_Address@FPrm_switches_ext1@0x023A5328@ */ ECIPP_ALIGNMENT_UWORD 65535 Compu_IDENTITY 0 65535 PHYS_UNIT "Enable bits" /end CHARACTERISTIC
/begin CHARACTERISTIC FPsw_ext1_CHT_HiExp "FPrm_switches_ext1(73)" VALUE 0x001C7610 /* @ECU_Address@FPrm_switches_ext1@0x023A5092@ */ ECIPP_ALIGNMENT_UWORD 65535 Compu_IDENTITY 0 65535 PHYS_UNIT "Enable bits" /end CHARACTERISTIC
/begin CHARACTERISTIC FPsw_ext1_CHT_HiExp2 "FPrm_switches_ext1(74)" VALUE 0x001C7612 /* @ECU_Address@FPrm_switches_ext1@0x023A5094@ */ ECIPP_ALIGNMENT_UWORD 65535 Compu_IDENTITY 0 65535 PHYS_UNIT "Enable bits" /end CHARACTERISTIC
/begin CHARACTERISTIC FPsw_ext1_CL_hi "FPrm_switches_ext1(47)" VALUE 0x001C75DC /* @ECU_Address@FPrm_switches_ext1@0x023A505E@ */ ECIPP_ALIGNMENT_UWORD 65535 Compu_IDENTITY 0 65535 PHYS_UNIT "Enable bits" /end CHARACTERISTIC
/begin CHARACTERISTIC FPsw_ext1_CL_lo "FPrm_switches_ext1(48)" VALUE 0x001C75DE /* @ECU_Address@FPrm_switches_ext1@0x023A5060@ */ ECIPP_ALIGNMENT_UWORD 65535 Compu_IDENTITY 0 65535 PHYS_UNIT "Enable bits" /end CHARACTERISTIC
/begin CHARACTERISTIC FCdtc_APUD2_max "FCtl_DTC(205)" VALUE 0x001E3A04 /* @ECU_Address@FCtl_DTC@0x021B519A@ */ ECIPP_ALIGNMENT_UWORD 65535 Compu_IDENTITY 0 65535 PHYS_UNIT "DTC" /end CHARACTERISTIC
/begin CHARACTERISTIC FCdtc_APUD2_min "FCtl_DTC(206)" VALUE 0x001E3A06 /* @ECU_Address@FCtl_DTC@0x021B519C@ */ ECIPP_ALIGNMENT_UWORD 65535 Compu_IDENTITY 0 65535 PHYS_UNIT "DTC" /end CHARACTERISTIC
/begin CHARACTERISTIC FCdtc_APUD20_max "FCtl_DTC(381)" VALUE 0x001E3B64 /* @ECU_Address@FCtl_DTC@0x021B52FA@ */ ECIPP_ALIGNMENT_UWORD 65535 Compu_IDENTITY 0 65535 PHYS_UNIT "DTC" /end CHARACTERISTIC
/begin CHARACTERISTIC FCdtc_APUD20_min "FCtl_DTC(382)" VALUE 0x001E3B66 /* @ECU_Address@FCtl_DTC@0x021B52FC@ */ ECIPP_ALIGNMENT_UWORD 65535 Compu_IDENTITY 0 65535 PHYS_UNIT "DTC" /end CHARACTERISTIC
/begin CHARACTERISTIC FCdtc_APUD21_max "FCtl_DTC(383)" VALUE 0x001E3B68 /* @ECU_Address@FCtl_DTC@0x021B52FE@ */ ECIPP_ALIGNMENT_UWORD 65535 Compu_IDENTITY 0 65535 PHYS_UNIT "DTC" /end CHARACTERISTIC
/begin CHARACTERISTIC FCdtc_APUD21_min "FCtl_DTC(384)" VALUE 0x001E3B6A /* @ECU_Address@FCtl_DTC@0x021B5300@ */ ECIPP_ALIGNMENT_UWORD 65535 Compu_IDENTITY 0 65535 PHYS_UNIT "DTC" /end CHARACTERISTIC
/begin CHARACTERISTIC FCdtc_APUD22_max "FCtl_DTC(385)" VALUE 0x001E3B6C /* @ECU_Address@FCtl_DTC@0x021B5302@ */ ECIPP_ALIGNMENT_UWORD 65535 Compu_IDENTITY 0 65535 PHYS_UNIT "DTC" /end CHARACTERISTIC
/begin CHARACTERISTIC FCdtc_APUD22_min "FCtl_DTC(386)" VALUE 0x001E3B6E /* @ECU_Address@FCtl_DTC@0x021B5304@ */ ECIPP_ALIGNMENT_UWORD 65535 Compu_IDENTITY 0 65535 PHYS_UNIT "DTC" /end CHARACTERISTIC
/begin CHARACTERISTIC FCdtc_APUD23_max "FCtl_DTC(387)" VALUE 0x001E3B70 /* @ECU_Address@FCtl_DTC@0x021B5306@ */ ECIPP_ALIGNMENT_UWORD 65535 Compu_IDENTITY 0 65535 PHYS_UNIT "DTC" /end CHARACTERISTIC
/begin CHARACTERISTIC FCdtc_APUD23_min "FCtl_DTC(388)" VALUE 0x001E3B72 /* @ECU_Address@FCtl_DTC@0x021B5308@ */ ECIPP_ALIGNMENT_UWORD 65535 Compu_IDENTITY 0 65535 PHYS_UNIT "DTC" /end CHARACTERISTIC
/begin CHARACTERISTIC FCdtc_APUD24_max "FCtl_DTC(389)" VALUE 0x001E3B74 /* @ECU_Address@FCtl_DTC@0x021B530A@ */ ECIPP_ALIGNMENT_UWORD 65535 Compu_IDENTITY 0 65535 PHYS_UNIT "DTC" /end CHARACTERISTIC
/begin CHARACTERISTIC FCdtc_APUD24_min "FCtl_DTC(390)" VALUE 0x001E3B76 /* @ECU_Address@FCtl_DTC@0x021B530C@ */ ECIPP_ALIGNMENT_UWORD 65535 Compu_IDENTITY 0 65535 PHYS_UNIT "DTC" /end CHARACTERISTIC
/begin CHARACTERISTIC FCdtc_APUD25_max "FCtl_DTC(391)" VALUE 0x001E3B78 /* @ECU_Address@FCtl_DTC@0x021B530E@ */ ECIPP_ALIGNMENT_UWORD 65535 Compu_IDENTITY 0 65535 PHYS_UNIT "DTC" /end CHARACTERISTIC
/begin CHARACTERISTIC FCdtc_APUD25_min "FCtl_DTC(392)" VALUE 0x001E3B7A /* @ECU_Address@FCtl_DTC@0x021B5310@ */ ECIPP_ALIGNMENT_UWORD 65535 Compu_IDENTITY 0 65535 PHYS_UNIT "DTC" /end CHARACTERISTIC
/begin CHARACTERISTIC FCdtc_APUD3_max "FCtl_DTC(207)" VALUE 0x001E3A08 /* @ECU_Address@FCtl_DTC@0x021B519E@ */ ECIPP_ALIGNMENT_UWORD 65535 Compu_IDENTITY 0 65535 PHYS_UNIT "DTC" /end CHARACTERISTIC
/begin CHARACTERISTIC FCdtc_APUD3_min "FCtl_DTC(208)" VALUE 0x001E3A0A /* @ECU_Address@FCtl_DTC@0x021B51A0@ */ ECIPP_ALIGNMENT_UWORD 65535 Compu_IDENTITY 0 65535 PHYS_UNIT "DTC" /end CHARACTERISTIC
/begin CHARACTERISTIC FCdtc_APUD4_max "FCtl_DTC(280)" VALUE 0x001E3A9A /* @ECU_Address@FCtl_DTC@0x021B5230@ */ ECIPP_ALIGNMENT_UWORD 65535 Compu_IDENTITY 0 65535 PHYS_UNIT "DTC" /end CHARACTERISTIC
/begin CHARACTERISTIC FCdtc_APUD4_min "FCtl_DTC(281)" VALUE 0x001E3A9C /* @ECU_Address@FCtl_DTC@0x021B5232@ */ ECIPP_ALIGNMENT_UWORD 65535 Compu_IDENTITY 0 65535 PHYS_UNIT "DTC" /end CHARACTERISTIC
/begin CHARACTERISTIC FCdtc_APUD5_max "FCtl_DTC(331)" VALUE 0x001E3B00 /* @ECU_Address@FCtl_DTC@0x021B5296@ */ ECIPP_ALIGNMENT_UWORD 65535 Compu_IDENTITY 0 65535 PHYS_UNIT "DTC" /end CHARACTERISTIC
/begin CHARACTERISTIC FCdtc_APUD5_min "FCtl_DTC(332)" VALUE 0x001E3B02 /* @ECU_Address@FCtl_DTC@0x021B5298@ */ ECIPP_ALIGNMENT_UWORD 65535 Compu_IDENTITY 0 65535 PHYS_UNIT "DTC" /end CHARACTERISTIC
/begin CHARACTERISTIC FCdtc_APUD6_max "FCtl_DTC(333)" VALUE 0x001E3B04 /* @ECU_Address@FCtl_DTC@0x021B529A@ */ ECIPP_ALIGNMENT_UWORD 65535 Compu_IDENTITY 0 65535 PHYS_UNIT "DTC" /end CHARACTERISTIC
/begin CHARACTERISTIC FCdtc_APUD6_min "FCtl_DTC(334)" VALUE 0x001E3B06 /* @ECU_Address@FCtl_DTC@0x021B529C@ */ ECIPP_ALIGNMENT_UWORD 65535 Compu_IDENTITY 0 65535 PHYS_UNIT "DTC" /end CHARACTERISTIC
/begin CHARACTERISTIC FCdtc_APUD7_max "FCtl_DTC(335)" VALUE 0x001E3B08 /* @ECU_Address@FCtl_DTC@0x021B529E@ */ ECIPP_ALIGNMENT_UWORD 65535 Compu_IDENTITY 0 65535 PHYS_UNIT "DTC" /end CHARACTERISTIC
/begin CHARACTERISTIC FCdtc_APUD7_min "FCtl_DTC(336)" VALUE 0x001E3B0A /* @ECU_Address@FCtl_DTC@0x021B52A0@ */ ECIPP_ALIGNMENT_UWORD 65535 Compu_IDENTITY 0 65535 PHYS_UNIT "DTC" /end CHARACTERISTIC
/begin CHARACTERISTIC FCdtc_APUD8_max "FCtl_DTC(352)" VALUE 0x001E3B2A /* @ECU_Address@FCtl_DTC@0x021B52C0@ */ ECIPP_ALIGNMENT_UWORD 65535 Compu_IDENTITY 0 65535 PHYS_UNIT "DTC" /end CHARACTERISTIC
/begin CHARACTERISTIC FCdtc_APUD8_min "FCtl_DTC(353)" VALUE 0x001E3B2C /* @ECU_Address@FCtl_DTC@0x021B52C2@ */ ECIPP_ALIGNMENT_UWORD 65535 Compu_IDENTITY 0 65535 PHYS_UNIT "DTC" /end CHARACTERISTIC
/begin CHARACTERISTIC FCdtc_APUD9_max "FCtl_DTC(359)" VALUE 0x001E3B38 /* @ECU_Address@FCtl_DTC@0x021B52CE@ */ ECIPP_ALIGNMENT_UWORD 65535 Compu_IDENTITY 0 65535 PHYS_UNIT "DTC" /end CHARACTERISTIC
/begin CHARACTERISTIC FCdtc_APUD9_min "FCtl_DTC(360)" VALUE 0x001E3B3A /* @ECU_Address@FCtl_DTC@0x021B52D0@ */ ECIPP_ALIGNMENT_UWORD 65535 Compu_IDENTITY 0 65535 PHYS_UNIT "DTC" /end CHARACTERISTIC
/begin CHARACTERISTIC FCdtc_AWP_intF "FCtl_DTC(832)" VALUE 0x001E3EEA /* @ECU_Address@FCtl_DTC@0x021B5680@ */ ECIPP_ALIGNMENT_UWORD 65535 Compu_IDENTITY 0 65535 PHYS_UNIT "DTC" /end CHARACTERISTIC
/begin CHARACTERISTIC FCdtc_BP_max "FCtl_DTC(7)" VALUE 0x001E3878 /* @ECU_Address@FCtl_DTC@0x021B500E@ */ ECIPP_ALIGNMENT_UWORD 65535 Compu_IDENTITY 0 65535 PHYS_UNIT "DTC" /end CHARACTERISTIC
/begin CHARACTERISTIC FCdtc_BP_min "FCtl_DTC(8)" VALUE 0x001E387A /* @ECU_Address@FCtl_DTC@0x021B5010@ */ ECIPP_ALIGNMENT_UWORD 65535 Compu_IDENTITY 0 65535 PHYS_UNIT "DTC" /end CHARACTERISTIC
/begin CHARACTERISTIC FCdtc_BPS1_max "FCtl_DTC(474)" VALUE 0x001E3C1E /* @ECU_Address@FCtl_DTC@0x021B53B4@ */ ECIPP_ALIGNMENT_UWORD 65535 Compu_IDENTITY 0 65535 PHYS_UNIT "DTC" /end CHARACTERISTIC
/begin CHARACTERISTIC FCdtc_BPS1_min "FCtl_DTC(475)" VALUE 0x001E3C20 /* @ECU_Address@FCtl_DTC@0x021B53B6@ */ ECIPP_ALIGNMENT_UWORD 65535 Compu_IDENTITY 0 65535 PHYS_UNIT "DTC" /end CHARACTERISTIC
/begin CHARACTERISTIC FCdtc_BPS12_OOR "FCtl_DTC(482)" VALUE 0x001E3C2E /* @ECU_Address@FCtl_DTC@0x021B53C4@ */ ECIPP_ALIGNMENT_UWORD 65535 Compu_IDENTITY 0 65535 PHYS_UNIT "DTC" /end CHARACTERISTIC
/begin CHARACTERISTIC FCdtc_BPS12pct_hi "FCtl_DTC(478)" VALUE 0x001E3C26 /* @ECU_Address@FCtl_DTC@0x021B53BC@ */ ECIPP_ALIGNMENT_UWORD 65535 Compu_IDENTITY 0 65535 PHYS_UNIT "DTC" /end CHARACTERISTIC
/begin CHARACTERISTIC FCdtc_BPS12pct_lo "FCtl_DTC(479)" VALUE 0x001E3C28 /* @ECU_Address@FCtl_DTC@0x021B53BE@ */ ECIPP_ALIGNMENT_UWORD 65535 Compu_IDENTITY 0 65535 PHYS_UNIT "DTC" /end CHARACTERISTIC
/begin CHARACTERISTIC FCdtc_BPS2_max "FCtl_DTC(476)" VALUE 0x001E3C22 /* @ECU_Address@FCtl_DTC@0x021B53B8@ */ ECIPP_ALIGNMENT_UWORD 65535 Compu_IDENTITY 0 65535 PHYS_UNIT "DTC" /end CHARACTERISTIC
/begin CHARACTERISTIC FCdtc_BPS2_min "FCtl_DTC(477)" VALUE 0x001E3C24 /* @ECU_Address@FCtl_DTC@0x021B53BA@ */ ECIPP_ALIGNMENT_UWORD 65535 Compu_IDENTITY 0 65535 PHYS_UNIT "DTC" /end CHARACTERISTIC
/begin CHARACTERISTIC FCdtc_BPSerr_neg "FCtl_DTC(481)" VALUE 0x001E3C2C /* @ECU_Address@FCtl_DTC@0x021B53C2@ */ ECIPP_ALIGNMENT_UWORD 65535 Compu_IDENTITY 0 65535 PHYS_UNIT "DTC" /end CHARACTERISTIC
/begin CHARACTERISTIC FCdtc_BPSerr_pos "FCtl_DTC(480)" VALUE 0x001E3C2A /* @ECU_Address@FCtl_DTC@0x021B53C0@ */ ECIPP_ALIGNMENT_UWORD 65535 Compu_IDENTITY 0 65535 PHYS_UNIT "DTC" /end CHARACTERISTIC
/begin CHARACTERISTIC FCdtc_brake_gndshort "FCtl_DTC(329)" VALUE 0x001E3AFC /* @ECU_Address@FCtl_DTC@0x021B5292@ */ ECIPP_ALIGNMENT_UWORD 65535 Compu_IDENTITY 0 65535 PHYS_UNIT "DTC" /end CHARACTERISTIC
/begin CHARACTERISTIC FCdtc_brake_pwrshort "FCtl_DTC(330)" VALUE 0x001E3AFE /* @ECU_Address@FCtl_DTC@0x021B5294@ */ ECIPP_ALIGNMENT_UWORD 65535 Compu_IDENTITY 0 65535 PHYS_UNIT "DTC" /end CHARACTERISTIC
/begin CHARACTERISTIC FCdtc_bst_MAT_derate_actv "FCtl_DTC(811)" VALUE 0x001E3EC0 /* @ECU_Address@FCtl_DTC@0x021B5656@ */ ECIPP_ALIGNMENT_UWORD 65535 Compu_IDENTITY 0 65535 PHYS_UNIT "DTC" /end CHARACTERISTIC
/begin CHARACTERISTIC FCdtc_BstTIP_Hi "FCtl_DTC(143)" VALUE 0x001E3988 /* @ECU_Address@FCtl_DTC@0x021B511E@ */ ECIPP_ALIGNMENT_UWORD 65535 Compu_IDENTITY 0 65535 PHYS_UNIT "DTC" /end CHARACTERISTIC
/begin CHARACTERISTIC FCdtc_BstTIP_Lo "FCtl_DTC(144)" VALUE 0x001E398A /* @ECU_Address@FCtl_DTC@0x021B5120@ */ ECIPP_ALIGNMENT_UWORD 65535 Compu_IDENTITY 0 65535 PHYS_UNIT "DTC" /end CHARACTERISTIC
/begin CHARACTERISTIC FCdtc_BstTIP_Lo2 "FCtl_DTC(686)" VALUE 0x001E3DC6 /* @ECU_Address@FCtl_DTC@0x021B555C@ */ ECIPP_ALIGNMENT_UWORD 65535 Compu_IDENTITY 0 65535 PHYS_UNIT "DTC" /end CHARACTERISTIC
/begin CHARACTERISTIC FCdtc_BstTIP_slow "FCtl_DTC(655)" VALUE 0x001E3D88 /* @ECU_Address@FCtl_DTC@0x021B551E@ */ ECIPP_ALIGNMENT_UWORD 65535 Compu_IDENTITY 0 65535 PHYS_UNIT "DTC" /end CHARACTERISTIC
/begin CHARACTERISTIC FCdtc_buzz_coilopen "FCtl_DTC(165)" VALUE 0x001E39B4 /* @ECU_Address@FCtl_DTC@0x021B514A@ */ ECIPP_ALIGNMENT_UWORD 65535 Compu_IDENTITY 0 65535 PHYS_UNIT "DTC" /end CHARACTERISTIC
/begin CHARACTERISTIC FCdtc_buzz_coilshort "FCtl_DTC(166)" VALUE 0x001E39B6 /* @ECU_Address@FCtl_DTC@0x021B514C@ */ ECIPP_ALIGNMENT_UWORD 65535 Compu_IDENTITY 0 65535 PHYS_UNIT "DTC" /end CHARACTERISTIC
/begin CHARACTERISTIC FCdtc_buzz_gndshort "FCtl_DTC(164)" VALUE 0x001E39B2 /* @ECU_Address@FCtl_DTC@0x021B5148@ */ ECIPP_ALIGNMENT_UWORD 65535 Compu_IDENTITY 0 65535 PHYS_UNIT "DTC" /end CHARACTERISTIC
/begin CHARACTERISTIC FCdtc_CAC_eta_lo "FCtl_DTC(656)" VALUE 0x001E3D8A /* @ECU_Address@FCtl_DTC@0x021B5520@ */ ECIPP_ALIGNMENT_UWORD 65535 Compu_IDENTITY 0 65535 PHYS_UNIT "DTC" /end CHARACTERISTIC
/begin CHARACTERISTIC FCdtc_cal_config "FCtl_DTC(319)" VALUE 0x001E3AE8 /* @ECU_Address@FCtl_DTC@0x021B527E@ */ ECIPP_ALIGNMENT_UWORD 65535 Compu_IDENTITY 0 65535 PHYS_UNIT "DTC" /end CHARACTERISTIC
/begin CHARACTERISTIC FCdtc_cam2loss "FCtl_DTC(690)" VALUE 0x001E3DCE /* @ECU_Address@FCtl_DTC@0x021B5564@ */ ECIPP_ALIGNMENT_UWORD 65535 Compu_IDENTITY 0 65535 PHYS_UNIT "DTC" /end CHARACTERISTIC
/begin CHARACTERISTIC FCdtc_camloss "FCtl_DTC(95)" VALUE 0x001E3928 /* @ECU_Address@FCtl_DTC@0x021B50BE@ */ ECIPP_ALIGNMENT_UWORD 65535 Compu_IDENTITY 0 65535 PHYS_UNIT "DTC" /end CHARACTERISTIC
/begin CHARACTERISTIC FCdtc_camnoise "FCtl_DTC(96)" VALUE 0x001E392A /* @ECU_Address@FCtl_DTC@0x021B50C0@ */ ECIPP_ALIGNMENT_UWORD 65535 Compu_IDENTITY 0 65535 PHYS_UNIT "DTC" /end CHARACTERISTIC
/begin CHARACTERISTIC FCdtc_CATdP_hi "FCtl_DTC(526)" VALUE 0x001E3C86 /* @ECU_Address@FCtl_DTC@0x021B541C@ */ ECIPP_ALIGNMENT_UWORD 65535 Compu_IDENTITY 0 65535 PHYS_UNIT "DTC" /end CHARACTERISTIC
/begin CHARACTERISTIC FCdtc_CATdP_lo "FCtl_DTC(525)" VALUE 0x001E3C84 /* @ECU_Address@FCtl_DTC@0x021B541A@ */ ECIPP_ALIGNMENT_UWORD 65535 Compu_IDENTITY 0 65535 PHYS_UNIT "DTC" /end CHARACTERISTIC
/begin CHARACTERISTIC FCdtc_CATout_OOR "FCtl_DTC(831)" VALUE 0x001E3EE8 /* @ECU_Address@FCtl_DTC@0x021B567E@ */ ECIPP_ALIGNMENT_UWORD 65535 Compu_IDENTITY 0 65535 PHYS_UNIT "DTC" /end CHARACTERISTIC
/begin CHARACTERISTIC FCdtc_CD_MF1 "FCtl_DTC(985)" VALUE 0x001E401C /* @ECU_Address@FCtl_DTC@0x021B57B2@ */ ECIPP_ALIGNMENT_UWORD 65535 Compu_IDENTITY 0 65535 PHYS_UNIT "DTC" /end CHARACTERISTIC
/begin CHARACTERISTIC FCdtc_CFV_FP_minv "FCtl_DTC(687)" VALUE 0x001E3DC8 /* @ECU_Address@FCtl_DTC@0x021B555E@ */ ECIPP_ALIGNMENT_UWORD 65535 Compu_IDENTITY 0 65535 PHYS_UNIT "DTC" /end CHARACTERISTIC
/begin CHARACTERISTIC FCdtc_CFV_FT_maxv "FCtl_DTC(688)" VALUE 0x001E3DCA /* @ECU_Address@FCtl_DTC@0x021B5560@ */ ECIPP_ALIGNMENT_UWORD 65535 Compu_IDENTITY 0 65535 PHYS_UNIT "DTC" /end CHARACTERISTIC
/begin CHARACTERISTIC FCdtc_CFV_FT_minv "FCtl_DTC(689)" VALUE 0x001E3DCC /* @ECU_Address@FCtl_DTC@0x021B5562@ */ ECIPP_ALIGNMENT_UWORD 65535 Compu_IDENTITY 0 65535 PHYS_UNIT "DTC" /end CHARACTERISTIC
/begin CHARACTERISTIC FCdtc_CFV_mdot_hi "FCtl_DTC(523)" VALUE 0x001E3C80 /* @ECU_Address@FCtl_DTC@0x021B5416@ */ ECIPP_ALIGNMENT_UWORD 65535 Compu_IDENTITY 0 65535 PHYS_UNIT "DTC" /end CHARACTERISTIC
/begin CHARACTERISTIC FCdtc_CFV_mdot_lo "FCtl_DTC(524)" VALUE 0x001E3C82 /* @ECU_Address@FCtl_DTC@0x021B5418@ */ ECIPP_ALIGNMENT_UWORD 65535 Compu_IDENTITY 0 65535 PHYS_UNIT "DTC" /end CHARACTERISTIC
/begin CHARACTERISTIC FCdtc_CFV_mdot_rms_hi "FCtl_DTC(679)" VALUE 0x001E3DB8 /* @ECU_Address@FCtl_DTC@0x021B554E@ */ ECIPP_ALIGNMENT_UWORD 65535 Compu_IDENTITY 0 65535 PHYS_UNIT "DTC" /end CHARACTERISTIC
/begin CHARACTERISTIC FCdtc_CFV_pwr_loss "FCtl_DTC(830)" VALUE 0x001E3EE6 /* @ECU_Address@FCtl_DTC@0x021B567C@ */ ECIPP_ALIGNMENT_UWORD 65535 Compu_IDENTITY 0 65535 PHYS_UNIT "DTC" /end CHARACTERISTIC
/begin CHARACTERISTIC FCdtc_CFV_RLV_fail "FCtl_DTC(535)" VALUE 0x001E3C98 /* @ECU_Address@FCtl_DTC@0x021B542E@ */ ECIPP_ALIGNMENT_UWORD 65535 Compu_IDENTITY 0 65535 PHYS_UNIT "DTC" /end CHARACTERISTIC
/begin CHARACTERISTIC FCdtc_CFV_RLV_P_min "FCtl_DTC(534)" VALUE 0x001E3C96 /* @ECU_Address@FCtl_DTC@0x021B542C@ */ ECIPP_ALIGNMENT_UWORD 65535 Compu_IDENTITY 0 65535 PHYS_UNIT "DTC" /end CHARACTERISTIC
/begin CHARACTERISTIC FCdtc_CHT_HiExp "FCtl_DTC(114)" VALUE 0x001E394E /* @ECU_Address@FCtl_DTC@0x021B50E4@ */ ECIPP_ALIGNMENT_UWORD 65535 Compu_IDENTITY 0 65535 PHYS_UNIT "DTC" /end CHARACTERISTIC
/begin CHARACTERISTIC FCdtc_CHT_HiExp2 "FCtl_DTC(115)" VALUE 0x001E3950 /* @ECU_Address@FCtl_DTC@0x021B50E6@ */ ECIPP_ALIGNMENT_UWORD 65535 Compu_IDENTITY 0 65535 PHYS_UNIT "DTC" /end CHARACTERISTIC
/begin CHARACTERISTIC FCdtc_CL_hi "FCtl_DTC(32)" VALUE 0x001E38AA /* @ECU_Address@FCtl_DTC@0x021B5040@ */ ECIPP_ALIGNMENT_UWORD 65535 Compu_IDENTITY 0 65535 PHYS_UNIT "DTC" /end CHARACTERISTIC
/begin CHARACTERISTIC FCdtc_CL_lo "FCtl_DTC(33)" VALUE 0x001E38AC /* @ECU_Address@FCtl_DTC@0x021B5042@ */ ECIPP_ALIGNMENT_UWORD 65535 Compu_IDENTITY 0 65535 PHYS_UNIT "DTC" /end CHARACTERISTIC
/begin CHARACTERISTIC FCfmi_APUD2_max "FCtl_FMI(205)" VALUE 0x001E59CE /* @ECU_Address@FCtl_FMI@0x021B70CD@ */ ECIPP_ALIGNMENT_UBYTE 255 Compu_IDENTITY 0 255 PHYS_UNIT "FMI" /end CHARACTERISTIC
/begin CHARACTERISTIC FCfmi_APUD2_min "FCtl_FMI(206)" VALUE 0x001E59CF /* @ECU_Address@FCtl_FMI@0x021B70CE@ */ ECIPP_ALIGNMENT_UBYTE 255 Compu_IDENTITY 0 255 PHYS_UNIT "FMI" /end CHARACTERISTIC
/begin CHARACTERISTIC FCfmi_APUD20_max "FCtl_FMI(381)" VALUE 0x001E5A7E /* @ECU_Address@FCtl_FMI@0x021B717D@ */ ECIPP_ALIGNMENT_UBYTE 255 Compu_IDENTITY 0 255 PHYS_UNIT "FMI" /end CHARACTERISTIC
/begin CHARACTERISTIC FCfmi_APUD20_min "FCtl_FMI(382)" VALUE 0x001E5A7F /* @ECU_Address@FCtl_FMI@0x021B717E@ */ ECIPP_ALIGNMENT_UBYTE 255 Compu_IDENTITY 0 255 PHYS_UNIT "FMI" /end CHARACTERISTIC
/begin CHARACTERISTIC FCfmi_APUD21_max "FCtl_FMI(383)" VALUE 0x001E5A80 /* @ECU_Address@FCtl_FMI@0x021B717F@ */ ECIPP_ALIGNMENT_UBYTE 255 Compu_IDENTITY 0 255 PHYS_UNIT "FMI" /end CHARACTERISTIC
/begin CHARACTERISTIC FCfmi_APUD21_min "FCtl_FMI(384)" VALUE 0x001E5A81 /* @ECU_Address@FCtl_FMI@0x021B7180@ */ ECIPP_ALIGNMENT_UBYTE 255 Compu_IDENTITY 0 255 PHYS_UNIT "FMI" /end CHARACTERISTIC
/begin CHARACTERISTIC FCfmi_APUD22_max "FCtl_FMI(385)" VALUE 0x001E5A82 /* @ECU_Address@FCtl_FMI@0x021B7181@ */ ECIPP_ALIGNMENT_UBYTE 255 Compu_IDENTITY 0 255 PHYS_UNIT "FMI" /end CHARACTERISTIC
/begin CHARACTERISTIC FCfmi_APUD22_min "FCtl_FMI(386)" VALUE 0x001E5A83 /* @ECU_Address@FCtl_FMI@0x021B7182@ */ ECIPP_ALIGNMENT_UBYTE 255 Compu_IDENTITY 0 255 PHYS_UNIT "FMI" /end CHARACTERISTIC
/begin CHARACTERISTIC FCfmi_APUD23_max "FCtl_FMI(387)" VALUE 0x001E5A84 /* @ECU_Address@FCtl_FMI@0x021B7183@ */ ECIPP_ALIGNMENT_UBYTE 255 Compu_IDENTITY 0 255 PHYS_UNIT "FMI" /end CHARACTERISTIC
/begin CHARACTERISTIC FCfmi_APUD23_min "FCtl_FMI(388)" VALUE 0x001E5A85 /* @ECU_Address@FCtl_FMI@0x021B7184@ */ ECIPP_ALIGNMENT_UBYTE 255 Compu_IDENTITY 0 255 PHYS_UNIT "FMI" /end CHARACTERISTIC
/begin CHARACTERISTIC FCfmi_APUD24_max "FCtl_FMI(389)" VALUE 0x001E5A86 /* @ECU_Address@FCtl_FMI@0x021B7185@ */ ECIPP_ALIGNMENT_UBYTE 255 Compu_IDENTITY 0 255 PHYS_UNIT "FMI" /end CHARACTERISTIC
/begin CHARACTERISTIC FCfmi_APUD24_min "FCtl_FMI(390)" VALUE 0x001E5A87 /* @ECU_Address@FCtl_FMI@0x021B7186@ */ ECIPP_ALIGNMENT_UBYTE 255 Compu_IDENTITY 0 255 PHYS_UNIT "FMI" /end CHARACTERISTIC
/begin CHARACTERISTIC FCfmi_APUD25_max "FCtl_FMI(391)" VALUE 0x001E5A88 /* @ECU_Address@FCtl_FMI@0x021B7187@ */ ECIPP_ALIGNMENT_UBYTE 255 Compu_IDENTITY 0 255 PHYS_UNIT "FMI" /end CHARACTERISTIC
/begin CHARACTERISTIC FCfmi_APUD25_min "FCtl_FMI(392)" VALUE 0x001E5A89 /* @ECU_Address@FCtl_FMI@0x021B7188@ */ ECIPP_ALIGNMENT_UBYTE 255 Compu_IDENTITY 0 255 PHYS_UNIT "FMI" /end CHARACTERISTIC
/begin CHARACTERISTIC FCfmi_APUD3_max "FCtl_FMI(207)" VALUE 0x001E59D0 /* @ECU_Address@FCtl_FMI@0x021B70CF@ */ ECIPP_ALIGNMENT_UBYTE 255 Compu_IDENTITY 0 255 PHYS_UNIT "FMI" /end CHARACTERISTIC
/begin CHARACTERISTIC FCfmi_APUD3_min "FCtl_FMI(208)" VALUE 0x001E59D1 /* @ECU_Address@FCtl_FMI@0x021B70D0@ */ ECIPP_ALIGNMENT_UBYTE 255 Compu_IDENTITY 0 255 PHYS_UNIT "FMI" /end CHARACTERISTIC
/begin CHARACTERISTIC FCfmi_APUD4_max "FCtl_FMI(280)" VALUE 0x001E5A19 /* @ECU_Address@FCtl_FMI@0x021B7118@ */ ECIPP_ALIGNMENT_UBYTE 255 Compu_IDENTITY 0 255 PHYS_UNIT "FMI" /end CHARACTERISTIC
/begin CHARACTERISTIC FCfmi_APUD4_min "FCtl_FMI(281)" VALUE 0x001E5A1A /* @ECU_Address@FCtl_FMI@0x021B7119@ */ ECIPP_ALIGNMENT_UBYTE 255 Compu_IDENTITY 0 255 PHYS_UNIT "FMI" /end CHARACTERISTIC
/begin CHARACTERISTIC FCfmi_APUD5_max "FCtl_FMI(331)" VALUE 0x001E5A4C /* @ECU_Address@FCtl_FMI@0x021B714B@ */ ECIPP_ALIGNMENT_UBYTE 255 Compu_IDENTITY 0 255 PHYS_UNIT "FMI" /end CHARACTERISTIC
/begin CHARACTERISTIC FCfmi_APUD5_min "FCtl_FMI(332)" VALUE 0x001E5A4D /* @ECU_Address@FCtl_FMI@0x021B714C@ */ ECIPP_ALIGNMENT_UBYTE 255 Compu_IDENTITY 0 255 PHYS_UNIT "FMI" /end CHARACTERISTIC
/begin CHARACTERISTIC FCfmi_APUD6_max "FCtl_FMI(333)" VALUE 0x001E5A4E /* @ECU_Address@FCtl_FMI@0x021B714D@ */ ECIPP_ALIGNMENT_UBYTE 255 Compu_IDENTITY 0 255 PHYS_UNIT "FMI" /end CHARACTERISTIC
/begin CHARACTERISTIC FCfmi_APUD6_min "FCtl_FMI(334)" VALUE 0x001E5A4F /* @ECU_Address@FCtl_FMI@0x021B714E@ */ ECIPP_ALIGNMENT_UBYTE 255 Compu_IDENTITY 0 255 PHYS_UNIT "FMI" /end CHARACTERISTIC
/begin CHARACTERISTIC FCfmi_APUD7_max "FCtl_FMI(335)" VALUE 0x001E5A50 /* @ECU_Address@FCtl_FMI@0x021B714F@ */ ECIPP_ALIGNMENT_UBYTE 255 Compu_IDENTITY 0 255 PHYS_UNIT "FMI" /end CHARACTERISTIC
/begin CHARACTERISTIC FCfmi_APUD7_min "FCtl_FMI(336)" VALUE 0x001E5A51 /* @ECU_Address@FCtl_FMI@0x021B7150@ */ ECIPP_ALIGNMENT_UBYTE 255 Compu_IDENTITY 0 255 PHYS_UNIT "FMI" /end CHARACTERISTIC
/begin CHARACTERISTIC FCfmi_APUD8_max "FCtl_FMI(352)" VALUE 0x001E5A61 /* @ECU_Address@FCtl_FMI@0x021B7160@ */ ECIPP_ALIGNMENT_UBYTE 255 Compu_IDENTITY 0 255 PHYS_UNIT "FMI" /end CHARACTERISTIC
/begin CHARACTERISTIC FCfmi_APUD8_min "FCtl_FMI(353)" VALUE 0x001E5A62 /* @ECU_Address@FCtl_FMI@0x021B7161@ */ ECIPP_ALIGNMENT_UBYTE 255 Compu_IDENTITY 0 255 PHYS_UNIT "FMI" /end CHARACTERISTIC
/begin CHARACTERISTIC FCfmi_APUD9_max "FCtl_FMI(359)" VALUE 0x001E5A68 /* @ECU_Address@FCtl_FMI@0x021B7167@ */ ECIPP_ALIGNMENT_UBYTE 255 Compu_IDENTITY 0 255 PHYS_UNIT "FMI" /end CHARACTERISTIC
/begin CHARACTERISTIC FCfmi_APUD9_min "FCtl_FMI(360)" VALUE 0x001E5A69 /* @ECU_Address@FCtl_FMI@0x021B7168@ */ ECIPP_ALIGNMENT_UBYTE 255 Compu_IDENTITY 0 255 PHYS_UNIT "FMI" /end CHARACTERISTIC
/begin CHARACTERISTIC FCfmi_AWP_intF "FCtl_FMI(832)" VALUE 0x001E5C41 /* @ECU_Address@FCtl_FMI@0x021B7340@ */ ECIPP_ALIGNMENT_UBYTE 255 Compu_IDENTITY 0 255 PHYS_UNIT "FMI" /end CHARACTERISTIC
/begin CHARACTERISTIC FCfmi_BP_max "FCtl_FMI(7)" VALUE 0x001E5908 /* @ECU_Address@FCtl_FMI@0x021B7007@ */ ECIPP_ALIGNMENT_UBYTE 255 Compu_IDENTITY 0 255 PHYS_UNIT "FMI" /end CHARACTERISTIC
/begin CHARACTERISTIC FCfmi_BP_min "FCtl_FMI(8)" VALUE 0x001E5909 /* @ECU_Address@FCtl_FMI@0x021B7008@ */ ECIPP_ALIGNMENT_UBYTE 255 Compu_IDENTITY 0 255 PHYS_UNIT "FMI" /end CHARACTERISTIC
/begin CHARACTERISTIC FCfmi_BPS1_max "FCtl_FMI(474)" VALUE 0x001E5ADB /* @ECU_Address@FCtl_FMI@0x021B71DA@ */ ECIPP_ALIGNMENT_UBYTE 255 Compu_IDENTITY 0 255 PHYS_UNIT "FMI" /end CHARACTERISTIC
/begin CHARACTERISTIC FCfmi_BPS1_min "FCtl_FMI(475)" VALUE 0x001E5ADC /* @ECU_Address@FCtl_FMI@0x021B71DB@ */ ECIPP_ALIGNMENT_UBYTE 255 Compu_IDENTITY 0 255 PHYS_UNIT "FMI" /end CHARACTERISTIC
/begin CHARACTERISTIC FCfmi_BPS12_OOR "FCtl_FMI(482)" VALUE 0x001E5AE3 /* @ECU_Address@FCtl_FMI@0x021B71E2@ */ ECIPP_ALIGNMENT_UBYTE 255 Compu_IDENTITY 0 255 PHYS_UNIT "FMI" /end CHARACTERISTIC
/begin CHARACTERISTIC FCfmi_BPS12pct_hi "FCtl_FMI(478)" VALUE 0x001E5ADF /* @ECU_Address@FCtl_FMI@0x021B71DE@ */ ECIPP_ALIGNMENT_UBYTE 255 Compu_IDENTITY 0 255 PHYS_UNIT "FMI" /end CHARACTERISTIC
/begin CHARACTERISTIC FCfmi_BPS12pct_lo "FCtl_FMI(479)" VALUE 0x001E5AE0 /* @ECU_Address@FCtl_FMI@0x021B71DF@ */ ECIPP_ALIGNMENT_UBYTE 255 Compu_IDENTITY 0 255 PHYS_UNIT "FMI" /end CHARACTERISTIC
/begin CHARACTERISTIC FCfmi_BPS2_max "FCtl_FMI(476)" VALUE 0x001E5ADD /* @ECU_Address@FCtl_FMI@0x021B71DC@ */ ECIPP_ALIGNMENT_UBYTE 255 Compu_IDENTITY 0 255 PHYS_UNIT "FMI" /end CHARACTERISTIC
/begin CHARACTERISTIC FCfmi_BPS2_min "FCtl_FMI(477)" VALUE 0x001E5ADE /* @ECU_Address@FCtl_FMI@0x021B71DD@ */ ECIPP_ALIGNMENT_UBYTE 255 Compu_IDENTITY 0 255 PHYS_UNIT "FMI" /end CHARACTERISTIC
/begin CHARACTERISTIC FCfmi_BPSerr_neg "FCtl_FMI(481)" VALUE 0x001E5AE2 /* @ECU_Address@FCtl_FMI@0x021B71E1@ */ ECIPP_ALIGNMENT_UBYTE 255 Compu_IDENTITY 0 255 PHYS_UNIT "FMI" /end CHARACTERISTIC
/begin CHARACTERISTIC FCfmi_BPSerr_pos "FCtl_FMI(480)" VALUE 0x001E5AE1 /* @ECU_Address@FCtl_FMI@0x021B71E0@ */ ECIPP_ALIGNMENT_UBYTE 255 Compu_IDENTITY 0 255 PHYS_UNIT "FMI" /end CHARACTERISTIC
/begin CHARACTERISTIC FCfmi_brake_gndshort "FCtl_FMI(329)" VALUE 0x001E5A4A /* @ECU_Address@FCtl_FMI@0x021B7149@ */ ECIPP_ALIGNMENT_UBYTE 255 Compu_IDENTITY 0 255 PHYS_UNIT "FMI" /end CHARACTERISTIC
/begin CHARACTERISTIC FCfmi_brake_pwrshort "FCtl_FMI(330)" VALUE 0x001E5A4B /* @ECU_Address@FCtl_FMI@0x021B714A@ */ ECIPP_ALIGNMENT_UBYTE 255 Compu_IDENTITY 0 255 PHYS_UNIT "FMI" /end CHARACTERISTIC
/begin CHARACTERISTIC FCfmi_bst_MAT_derate_actv "FCtl_FMI(811)" VALUE 0x001E5C2C /* @ECU_Address@FCtl_FMI@0x021B732B@ */ ECIPP_ALIGNMENT_UBYTE 255 Compu_IDENTITY 0 255 PHYS_UNIT "FMI" /end CHARACTERISTIC
/begin CHARACTERISTIC FCfmi_BstTIP_Hi "FCtl_FMI(143)" VALUE 0x001E5990 /* @ECU_Address@FCtl_FMI@0x021B708F@ */ ECIPP_ALIGNMENT_UBYTE 255 Compu_IDENTITY 0 255 PHYS_UNIT "FMI" /end CHARACTERISTIC
/begin CHARACTERISTIC FCfmi_BstTIP_Lo "FCtl_FMI(144)" VALUE 0x001E5991 /* @ECU_Address@FCtl_FMI@0x021B7090@ */ ECIPP_ALIGNMENT_UBYTE 255 Compu_IDENTITY 0 255 PHYS_UNIT "FMI" /end CHARACTERISTIC
/begin CHARACTERISTIC FCfmi_BstTIP_Lo2 "FCtl_FMI(686)" VALUE 0x001E5BAF /* @ECU_Address@FCtl_FMI@0x021B72AE@ */ ECIPP_ALIGNMENT_UBYTE 255 Compu_IDENTITY 0 255 PHYS_UNIT "FMI" /end CHARACTERISTIC
/begin CHARACTERISTIC FCfmi_BstTIP_slow "FCtl_FMI(655)" VALUE 0x001E5B90 /* @ECU_Address@FCtl_FMI@0x021B728F@ */ ECIPP_ALIGNMENT_UBYTE 255 Compu_IDENTITY 0 255 PHYS_UNIT "FMI" /end CHARACTERISTIC
/begin CHARACTERISTIC FCfmi_buzz_coilopen "FCtl_FMI(165)" VALUE 0x001E59A6 /* @ECU_Address@FCtl_FMI@0x021B70A5@ */ ECIPP_ALIGNMENT_UBYTE 255 Compu_IDENTITY 0 255 PHYS_UNIT "FMI" /end CHARACTERISTIC
/begin CHARACTERISTIC FCfmi_buzz_coilshort "FCtl_FMI(166)" VALUE 0x001E59A7 /* @ECU_Address@FCtl_FMI@0x021B70A6@ */ ECIPP_ALIGNMENT_UBYTE 255 Compu_IDENTITY 0 255 PHYS_UNIT "FMI" /end CHARACTERISTIC
/begin CHARACTERISTIC FCfmi_buzz_gndshort "FCtl_FMI(164)" VALUE 0x001E59A5 /* @ECU_Address@FCtl_FMI@0x021B70A4@ */ ECIPP_ALIGNMENT_UBYTE 255 Compu_IDENTITY 0 255 PHYS_UNIT "FMI" /end CHARACTERISTIC
/begin CHARACTERISTIC FCfmi_CAC_eta_lo "FCtl_FMI(656)" VALUE 0x001E5B91 /* @ECU_Address@FCtl_FMI@0x021B7290@ */ ECIPP_ALIGNMENT_UBYTE 255 Compu_IDENTITY 0 255 PHYS_UNIT "FMI" /end CHARACTERISTIC
/begin CHARACTERISTIC FCfmi_cal_config "FCtl_FMI(319)" VALUE 0x001E5A40 /* @ECU_Address@FCtl_FMI@0x021B713F@ */ ECIPP_ALIGNMENT_UBYTE 255 Compu_IDENTITY 0 255 PHYS_UNIT "FMI" /end CHARACTERISTIC
/begin CHARACTERISTIC FCfmi_cam2loss "FCtl_FMI(690)" VALUE 0x001E5BB3 /* @ECU_Address@FCtl_FMI@0x021B72B2@ */ ECIPP_ALIGNMENT_UBYTE 255 Compu_IDENTITY 0 255 PHYS_UNIT "FMI" /end CHARACTERISTIC
/begin CHARACTERISTIC FCfmi_camloss "FCtl_FMI(95)" VALUE 0x001E5960 /* @ECU_Address@FCtl_FMI@0x021B705F@ */ ECIPP_ALIGNMENT_UBYTE 255 Compu_IDENTITY 0 255 PHYS_UNIT "FMI" /end CHARACTERISTIC
/begin CHARACTERISTIC FCfmi_camnoise "FCtl_FMI(96)" VALUE 0x001E5961 /* @ECU_Address@FCtl_FMI@0x021B7060@ */ ECIPP_ALIGNMENT_UBYTE 255 Compu_IDENTITY 0 255 PHYS_UNIT "FMI" /end CHARACTERISTIC
/begin CHARACTERISTIC FCfmi_CATdP_hi "FCtl_FMI(526)" VALUE 0x001E5B0F /* @ECU_Address@FCtl_FMI@0x021B720E@ */ ECIPP_ALIGNMENT_UBYTE 255 Compu_IDENTITY 0 255 PHYS_UNIT "FMI" /end CHARACTERISTIC
/begin CHARACTERISTIC FCfmi_CATdP_lo "FCtl_FMI(525)" VALUE 0x001E5B0E /* @ECU_Address@FCtl_FMI@0x021B720D@ */ ECIPP_ALIGNMENT_UBYTE 255 Compu_IDENTITY 0 255 PHYS_UNIT "FMI" /end CHARACTERISTIC
/begin CHARACTERISTIC FCfmi_CATout_OOR "FCtl_FMI(831)" VALUE 0x001E5C40 /* @ECU_Address@FCtl_FMI@0x021B733F@ */ ECIPP_ALIGNMENT_UBYTE 255 Compu_IDENTITY 0 255 PHYS_UNIT "FMI" /end CHARACTERISTIC
/begin CHARACTERISTIC FCfmi_CD_MF1 "FCtl_FMI(985)" VALUE 0x001E5CDA /* @ECU_Address@FCtl_FMI@0x021B73D9@ */ ECIPP_ALIGNMENT_UBYTE 255 Compu_IDENTITY 0 255 PHYS_UNIT "FMI" /end CHARACTERISTIC
/begin CHARACTERISTIC FCfmi_CFV_FP_minv "FCtl_FMI(687)" VALUE 0x001E5BB0 /* @ECU_Address@FCtl_FMI@0x021B72AF@ */ ECIPP_ALIGNMENT_UBYTE 255 Compu_IDENTITY 0 255 PHYS_UNIT "FMI" /end CHARACTERISTIC
/begin CHARACTERISTIC FCfmi_CFV_FT_maxv "FCtl_FMI(688)" VALUE 0x001E5BB1 /* @ECU_Address@FCtl_FMI@0x021B72B0@ */ ECIPP_ALIGNMENT_UBYTE 255 Compu_IDENTITY 0 255 PHYS_UNIT "FMI" /end CHARACTERISTIC
/begin CHARACTERISTIC FCfmi_CFV_FT_minv "FCtl_FMI(689)" VALUE 0x001E5BB2 /* @ECU_Address@FCtl_FMI@0x021B72B1@ */ ECIPP_ALIGNMENT_UBYTE 255 Compu_IDENTITY 0 255 PHYS_UNIT "FMI" /end CHARACTERISTIC
/begin CHARACTERISTIC FCfmi_CFV_mdot_hi "FCtl_FMI(523)" VALUE 0x001E5B0C /* @ECU_Address@FCtl_FMI@0x021B720B@ */ ECIPP_ALIGNMENT_UBYTE 255 Compu_IDENTITY 0 255 PHYS_UNIT "FMI" /end CHARACTERISTIC
/begin CHARACTERISTIC FCfmi_CFV_mdot_lo "FCtl_FMI(524)" VALUE 0x001E5B0D /* @ECU_Address@FCtl_FMI@0x021B720C@ */ ECIPP_ALIGNMENT_UBYTE 255 Compu_IDENTITY 0 255 PHYS_UNIT "FMI" /end CHARACTERISTIC
/begin CHARACTERISTIC FCfmi_CFV_mdot_rms_hi "FCtl_FMI(679)" VALUE 0x001E5BA8 /* @ECU_Address@FCtl_FMI@0x021B72A7@ */ ECIPP_ALIGNMENT_UBYTE 255 Compu_IDENTITY 0 255 PHYS_UNIT "FMI" /end CHARACTERISTIC
/begin CHARACTERISTIC FCfmi_CFV_pwr_loss "FCtl_FMI(830)" VALUE 0x001E5C3F /* @ECU_Address@FCtl_FMI@0x021B733E@ */ ECIPP_ALIGNMENT_UBYTE 255 Compu_IDENTITY 0 255 PHYS_UNIT "FMI" /end CHARACTERISTIC
/begin CHARACTERISTIC FCfmi_CFV_RLV_fail "FCtl_FMI(535)" VALUE 0x001E5B18 /* @ECU_Address@FCtl_FMI@0x021B7217@ */ ECIPP_ALIGNMENT_UBYTE 255 Compu_IDENTITY 0 255 PHYS_UNIT "FMI" /end CHARACTERISTIC
/begin CHARACTERISTIC FCfmi_CFV_RLV_P_min "FCtl_FMI(534)" VALUE 0x001E5B17 /* @ECU_Address@FCtl_FMI@0x021B7216@ */ ECIPP_ALIGNMENT_UBYTE 255 Compu_IDENTITY 0 255 PHYS_UNIT "FMI" /end CHARACTERISTIC
/begin CHARACTERISTIC FCfmi_CHT_HiExp "FCtl_FMI(114)" VALUE 0x001E5973 /* @ECU_Address@FCtl_FMI@0x021B7072@ */ ECIPP_ALIGNMENT_UBYTE 255 Compu_IDENTITY 0 255 PHYS_UNIT "FMI" /end CHARACTERISTIC
/begin CHARACTERISTIC FCfmi_CHT_HiExp2 "FCtl_FMI(115)" VALUE 0x001E5974 /* @ECU_Address@FCtl_FMI@0x021B7073@ */ ECIPP_ALIGNMENT_UBYTE 255 Compu_IDENTITY 0 255 PHYS_UNIT "FMI" /end CHARACTERISTIC
/begin CHARACTERISTIC FCfmi_CL_hi "FCtl_FMI(32)" VALUE 0x001E5921 /* @ECU_Address@FCtl_FMI@0x021B7020@ */ ECIPP_ALIGNMENT_UBYTE 255 Compu_IDENTITY 0 255 PHYS_UNIT "FMI" /end CHARACTERISTIC
/begin CHARACTERISTIC FCfmi_CL_lo "FCtl_FMI(33)" VALUE 0x001E5922 /* @ECU_Address@FCtl_FMI@0x021B7021@ */ ECIPP_ALIGNMENT_UBYTE 255 Compu_IDENTITY 0 255 PHYS_UNIT "FMI" /end CHARACTERISTIC
/begin CHARACTERISTIC FCftb_APUD2_max "FCtl_FTB_0x04(205)" VALUE 0x001E5DE4 /* @ECU_Address@FCtl_FTB_0x04@0x024C50CD@ */ ECIPP_ALIGNMENT_UBYTE 255 Compu_IDENTITY 0 255 PHYS_UNIT "FTB" /end CHARACTERISTIC
/begin CHARACTERISTIC FCftb_APUD2_min "FCtl_FTB_0x04(206)" VALUE 0x001E5DE5 /* @ECU_Address@FCtl_FTB_0x04@0x024C50CE@ */ ECIPP_ALIGNMENT_UBYTE 255 Compu_IDENTITY 0 255 PHYS_UNIT "FTB" /end CHARACTERISTIC
/begin CHARACTERISTIC FCftb_APUD20_max "FCtl_FTB_0x04(381)" VALUE 0x001E5E94 /* @ECU_Address@FCtl_FTB_0x04@0x024C517D@ */ ECIPP_ALIGNMENT_UBYTE 255 Compu_IDENTITY 0 255 PHYS_UNIT "FTB" /end CHARACTERISTIC
/begin CHARACTERISTIC FCftb_APUD20_min "FCtl_FTB_0x04(382)" VALUE 0x001E5E95 /* @ECU_Address@FCtl_FTB_0x04@0x024C517E@ */ ECIPP_ALIGNMENT_UBYTE 255 Compu_IDENTITY 0 255 PHYS_UNIT "FTB" /end CHARACTERISTIC
/begin CHARACTERISTIC FCftb_APUD21_max "FCtl_FTB_0x04(383)" VALUE 0x001E5E96 /* @ECU_Address@FCtl_FTB_0x04@0x024C517F@ */ ECIPP_ALIGNMENT_UBYTE 255 Compu_IDENTITY 0 255 PHYS_UNIT "FTB" /end CHARACTERISTIC
/begin CHARACTERISTIC FCftb_APUD21_min "FCtl_FTB_0x04(384)" VALUE 0x001E5E97 /* @ECU_Address@FCtl_FTB_0x04@0x024C5180@ */ ECIPP_ALIGNMENT_UBYTE 255 Compu_IDENTITY 0 255 PHYS_UNIT "FTB" /end CHARACTERISTIC
/begin CHARACTERISTIC FCftb_APUD22_max "FCtl_FTB_0x04(385)" VALUE 0x001E5E98 /* @ECU_Address@FCtl_FTB_0x04@0x024C5181@ */ ECIPP_ALIGNMENT_UBYTE 255 Compu_IDENTITY 0 255 PHYS_UNIT "FTB" /end CHARACTERISTIC
/begin CHARACTERISTIC FCftb_APUD22_min "FCtl_FTB_0x04(386)" VALUE 0x001E5E99 /* @ECU_Address@FCtl_FTB_0x04@0x024C5182@ */ ECIPP_ALIGNMENT_UBYTE 255 Compu_IDENTITY 0 255 PHYS_UNIT "FTB" /end CHARACTERISTIC
/begin CHARACTERISTIC FCftb_APUD23_max "FCtl_FTB_0x04(387)" VALUE 0x001E5E9A /* @ECU_Address@FCtl_FTB_0x04@0x024C5183@ */ ECIPP_ALIGNMENT_UBYTE 255 Compu_IDENTITY 0 255 PHYS_UNIT "FTB" /end CHARACTERISTIC
/begin CHARACTERISTIC FCftb_APUD23_min "FCtl_FTB_0x04(388)" VALUE 0x001E5E9B /* @ECU_Address@FCtl_FTB_0x04@0x024C5184@ */ ECIPP_ALIGNMENT_UBYTE 255 Compu_IDENTITY 0 255 PHYS_UNIT "FTB" /end CHARACTERISTIC
/begin CHARACTERISTIC FCftb_APUD24_max "FCtl_FTB_0x04(389)" VALUE 0x001E5E9C /* @ECU_Address@FCtl_FTB_0x04@0x024C5185@ */ ECIPP_ALIGNMENT_UBYTE 255 Compu_IDENTITY 0 255 PHYS_UNIT "FTB" /end CHARACTERISTIC
/begin CHARACTERISTIC FCftb_APUD24_min "FCtl_FTB_0x04(390)" VALUE 0x001E5E9D /* @ECU_Address@FCtl_FTB_0x04@0x024C5186@ */ ECIPP_ALIGNMENT_UBYTE 255 Compu_IDENTITY 0 255 PHYS_UNIT "FTB" /end CHARACTERISTIC
/begin CHARACTERISTIC FCftb_APUD25_max "FCtl_FTB_0x04(391)" VALUE 0x001E5E9E /* @ECU_Address@FCtl_FTB_0x04@0x024C5187@ */ ECIPP_ALIGNMENT_UBYTE 255 Compu_IDENTITY 0 255 PHYS_UNIT "FTB" /end CHARACTERISTIC
/begin CHARACTERISTIC FCftb_APUD25_min "FCtl_FTB_0x04(392)" VALUE 0x001E5E9F /* @ECU_Address@FCtl_FTB_0x04@0x024C5188@ */ ECIPP_ALIGNMENT_UBYTE 255 Compu_IDENTITY 0 255 PHYS_UNIT "FTB" /end CHARACTERISTIC
/begin CHARACTERISTIC FCftb_APUD3_max "FCtl_FTB_0x04(207)" VALUE 0x001E5DE6 /* @ECU_Address@FCtl_FTB_0x04@0x024C50CF@ */ ECIPP_ALIGNMENT_UBYTE 255 Compu_IDENTITY 0 255 PHYS_UNIT "FTB" /end CHARACTERISTIC
/begin CHARACTERISTIC FCftb_APUD3_min "FCtl_FTB_0x04(208)" VALUE 0x001E5DE7 /* @ECU_Address@FCtl_FTB_0x04@0x024C50D0@ */ ECIPP_ALIGNMENT_UBYTE 255 Compu_IDENTITY 0 255 PHYS_UNIT "FTB" /end CHARACTERISTIC
/begin CHARACTERISTIC FCftb_APUD4_max "FCtl_FTB_0x04(280)" VALUE 0x001E5E2F /* @ECU_Address@FCtl_FTB_0x04@0x024C5118@ */ ECIPP_ALIGNMENT_UBYTE 255 Compu_IDENTITY 0 255 PHYS_UNIT "FTB" /end CHARACTERISTIC
/begin CHARACTERISTIC FCftb_APUD4_min "FCtl_FTB_0x04(281)" VALUE 0x001E5E30 /* @ECU_Address@FCtl_FTB_0x04@0x024C5119@ */ ECIPP_ALIGNMENT_UBYTE 255 Compu_IDENTITY 0 255 PHYS_UNIT "FTB" /end CHARACTERISTIC
/begin CHARACTERISTIC FCftb_APUD5_max "FCtl_FTB_0x04(331)" VALUE 0x001E5E62 /* @ECU_Address@FCtl_FTB_0x04@0x024C514B@ */ ECIPP_ALIGNMENT_UBYTE 255 Compu_IDENTITY 0 255 PHYS_UNIT "FTB" /end CHARACTERISTIC
/begin CHARACTERISTIC FCftb_APUD5_min "FCtl_FTB_0x04(332)" VALUE 0x001E5E63 /* @ECU_Address@FCtl_FTB_0x04@0x024C514C@ */ ECIPP_ALIGNMENT_UBYTE 255 Compu_IDENTITY 0 255 PHYS_UNIT "FTB" /end CHARACTERISTIC
/begin CHARACTERISTIC FCftb_APUD6_max "FCtl_FTB_0x04(333)" VALUE 0x001E5E64 /* @ECU_Address@FCtl_FTB_0x04@0x024C514D@ */ ECIPP_ALIGNMENT_UBYTE 255 Compu_IDENTITY 0 255 PHYS_UNIT "FTB" /end CHARACTERISTIC
/begin CHARACTERISTIC FCftb_APUD6_min "FCtl_FTB_0x04(334)" VALUE 0x001E5E65 /* @ECU_Address@FCtl_FTB_0x04@0x024C514E@ */ ECIPP_ALIGNMENT_UBYTE 255 Compu_IDENTITY 0 255 PHYS_UNIT "FTB" /end CHARACTERISTIC
/begin CHARACTERISTIC FCftb_APUD7_max "FCtl_FTB_0x04(335)" VALUE 0x001E5E66 /* @ECU_Address@FCtl_FTB_0x04@0x024C514F@ */ ECIPP_ALIGNMENT_UBYTE 255 Compu_IDENTITY 0 255 PHYS_UNIT "FTB" /end CHARACTERISTIC
/begin CHARACTERISTIC FCftb_APUD7_min "FCtl_FTB_0x04(336)" VALUE 0x001E5E67 /* @ECU_Address@FCtl_FTB_0x04@0x024C5150@ */ ECIPP_ALIGNMENT_UBYTE 255 Compu_IDENTITY 0 255 PHYS_UNIT "FTB" /end CHARACTERISTIC
/begin CHARACTERISTIC FCftb_APUD8_max "FCtl_FTB_0x04(352)" VALUE 0x001E5E77 /* @ECU_Address@FCtl_FTB_0x04@0x024C5160@ */ ECIPP_ALIGNMENT_UBYTE 255 Compu_IDENTITY 0 255 PHYS_UNIT "FTB" /end CHARACTERISTIC
/begin CHARACTERISTIC FCftb_APUD8_min "FCtl_FTB_0x04(353)" VALUE 0x001E5E78 /* @ECU_Address@FCtl_FTB_0x04@0x024C5161@ */ ECIPP_ALIGNMENT_UBYTE 255 Compu_IDENTITY 0 255 PHYS_UNIT "FTB" /end CHARACTERISTIC
/begin CHARACTERISTIC FCftb_APUD9_max "FCtl_FTB_0x04(359)" VALUE 0x001E5E7E /* @ECU_Address@FCtl_FTB_0x04@0x024C5167@ */ ECIPP_ALIGNMENT_UBYTE 255 Compu_IDENTITY 0 255 PHYS_UNIT "FTB" /end CHARACTERISTIC
/begin CHARACTERISTIC FCftb_APUD9_min "FCtl_FTB_0x04(360)" VALUE 0x001E5E7F /* @ECU_Address@FCtl_FTB_0x04@0x024C5168@ */ ECIPP_ALIGNMENT_UBYTE 255 Compu_IDENTITY 0 255 PHYS_UNIT "FTB" /end CHARACTERISTIC
/begin CHARACTERISTIC FCftb_AWP_intF "FCtl_FTB_0x04(832)" VALUE 0x001E6057 /* @ECU_Address@FCtl_FTB_0x04@0x024C5340@ */ ECIPP_ALIGNMENT_UBYTE 255 Compu_IDENTITY 0 255 PHYS_UNIT "FTB" /end CHARACTERISTIC
/begin CHARACTERISTIC FCftb_BP_max "FCtl_FTB_0x04(7)" VALUE 0x001E5D1E /* @ECU_Address@FCtl_FTB_0x04@0x024C5007@ */ ECIPP_ALIGNMENT_UBYTE 255 Compu_IDENTITY 0 255 PHYS_UNIT "FTB" /end CHARACTERISTIC
/begin CHARACTERISTIC FCftb_BP_min "FCtl_FTB_0x04(8)" VALUE 0x001E5D1F /* @ECU_Address@FCtl_FTB_0x04@0x024C5008@ */ ECIPP_ALIGNMENT_UBYTE 255 Compu_IDENTITY 0 255 PHYS_UNIT "FTB" /end CHARACTERISTIC
/begin CHARACTERISTIC FCftb_BPS1_max "FCtl_FTB_0x04(474)" VALUE 0x001E5EF1 /* @ECU_Address@FCtl_FTB_0x04@0x024C51DA@ */ ECIPP_ALIGNMENT_UBYTE 255 Compu_IDENTITY 0 255 PHYS_UNIT "FTB" /end CHARACTERISTIC
/begin CHARACTERISTIC FCftb_BPS1_min "FCtl_FTB_0x04(475)" VALUE 0x001E5EF2 /* @ECU_Address@FCtl_FTB_0x04@0x024C51DB@ */ ECIPP_ALIGNMENT_UBYTE 255 Compu_IDENTITY 0 255 PHYS_UNIT "FTB" /end CHARACTERISTIC
/begin CHARACTERISTIC FCftb_BPS12_OOR "FCtl_FTB_0x04(482)" VALUE 0x001E5EF9 /* @ECU_Address@FCtl_FTB_0x04@0x024C51E2@ */ ECIPP_ALIGNMENT_UBYTE 255 Compu_IDENTITY 0 255 PHYS_UNIT "FTB" /end CHARACTERISTIC
/begin CHARACTERISTIC FCftb_BPS12pct_hi "FCtl_FTB_0x04(478)" VALUE 0x001E5EF5 /* @ECU_Address@FCtl_FTB_0x04@0x024C51DE@ */ ECIPP_ALIGNMENT_UBYTE 255 Compu_IDENTITY 0 255 PHYS_UNIT "FTB" /end CHARACTERISTIC
/begin CHARACTERISTIC FCftb_BPS12pct_lo "FCtl_FTB_0x04(479)" VALUE 0x001E5EF6 /* @ECU_Address@FCtl_FTB_0x04@0x024C51DF@ */ ECIPP_ALIGNMENT_UBYTE 255 Compu_IDENTITY 0 255 PHYS_UNIT "FTB" /end CHARACTERISTIC
/begin CHARACTERISTIC FCftb_BPS2_max "FCtl_FTB_0x04(476)" VALUE 0x001E5EF3 /* @ECU_Address@FCtl_FTB_0x04@0x024C51DC@ */ ECIPP_ALIGNMENT_UBYTE 255 Compu_IDENTITY 0 255 PHYS_UNIT "FTB" /end CHARACTERISTIC
/begin CHARACTERISTIC FCftb_BPS2_min "FCtl_FTB_0x04(477)" VALUE 0x001E5EF4 /* @ECU_Address@FCtl_FTB_0x04@0x024C51DD@ */ ECIPP_ALIGNMENT_UBYTE 255 Compu_IDENTITY 0 255 PHYS_UNIT "FTB" /end CHARACTERISTIC
/begin CHARACTERISTIC FCftb_BPSerr_neg "FCtl_FTB_0x04(481)" VALUE 0x001E5EF8 /* @ECU_Address@FCtl_FTB_0x04@0x024C51E1@ */ ECIPP_ALIGNMENT_UBYTE 255 Compu_IDENTITY 0 255 PHYS_UNIT "FTB" /end CHARACTERISTIC
/begin CHARACTERISTIC FCftb_BPSerr_pos "FCtl_FTB_0x04(480)" VALUE 0x001E5EF7 /* @ECU_Address@FCtl_FTB_0x04@0x024C51E0@ */ ECIPP_ALIGNMENT_UBYTE 255 Compu_IDENTITY 0 255 PHYS_UNIT "FTB" /end CHARACTERISTIC
/begin CHARACTERISTIC FCftb_brake_gndshort "FCtl_FTB_0x04(329)" VALUE 0x001E5E60 /* @ECU_Address@FCtl_FTB_0x04@0x024C5149@ */ ECIPP_ALIGNMENT_UBYTE 255 Compu_IDENTITY 0 255 PHYS_UNIT "FTB" /end CHARACTERISTIC
/begin CHARACTERISTIC FCftb_brake_pwrshort "FCtl_FTB_0x04(330)" VALUE 0x001E5E61 /* @ECU_Address@FCtl_FTB_0x04@0x024C514A@ */ ECIPP_ALIGNMENT_UBYTE 255 Compu_IDENTITY 0 255 PHYS_UNIT "FTB" /end CHARACTERISTIC
/begin CHARACTERISTIC FCftb_bst_MAT_derate_actv "FCtl_FTB_0x04(811)" VALUE 0x001E6042 /* @ECU_Address@FCtl_FTB_0x04@0x024C532B@ */ ECIPP_ALIGNMENT_UBYTE 255 Compu_IDENTITY 0 255 PHYS_UNIT "FTB" /end CHARACTERISTIC
/begin CHARACTERISTIC FCftb_BstTIP_Hi "FCtl_FTB_0x04(143)" VALUE 0x001E5DA6 /* @ECU_Address@FCtl_FTB_0x04@0x024C508F@ */ ECIPP_ALIGNMENT_UBYTE 255 Compu_IDENTITY 0 255 PHYS_UNIT "FTB" /end CHARACTERISTIC
/begin CHARACTERISTIC FCftb_BstTIP_Lo "FCtl_FTB_0x04(144)" VALUE 0x001E5DA7 /* @ECU_Address@FCtl_FTB_0x04@0x024C5090@ */ ECIPP_ALIGNMENT_UBYTE 255 Compu_IDENTITY 0 255 PHYS_UNIT "FTB" /end CHARACTERISTIC
/begin CHARACTERISTIC FCftb_BstTIP_Lo2 "FCtl_FTB_0x04(686)" VALUE 0x001E5FC5 /* @ECU_Address@FCtl_FTB_0x04@0x024C52AE@ */ ECIPP_ALIGNMENT_UBYTE 255 Compu_IDENTITY 0 255 PHYS_UNIT "FTB" /end CHARACTERISTIC
/begin CHARACTERISTIC FCftb_BstTIP_slow "FCtl_FTB_0x04(655)" VALUE 0x001E5FA6 /* @ECU_Address@FCtl_FTB_0x04@0x024C528F@ */ ECIPP_ALIGNMENT_UBYTE 255 Compu_IDENTITY 0 255 PHYS_UNIT "FTB" /end CHARACTERISTIC
/begin CHARACTERISTIC FCftb_buzz_coilopen "FCtl_FTB_0x04(165)" VALUE 0x001E5DBC /* @ECU_Address@FCtl_FTB_0x04@0x024C50A5@ */ ECIPP_ALIGNMENT_UBYTE 255 Compu_IDENTITY 0 255 PHYS_UNIT "FTB" /end CHARACTERISTIC
/begin CHARACTERISTIC FCftb_buzz_coilshort "FCtl_FTB_0x04(166)" VALUE 0x001E5DBD /* @ECU_Address@FCtl_FTB_0x04@0x024C50A6@ */ ECIPP_ALIGNMENT_UBYTE 255 Compu_IDENTITY 0 255 PHYS_UNIT "FTB" /end CHARACTERISTIC
/begin CHARACTERISTIC FCftb_buzz_gndshort "FCtl_FTB_0x04(164)" VALUE 0x001E5DBB /* @ECU_Address@FCtl_FTB_0x04@0x024C50A4@ */ ECIPP_ALIGNMENT_UBYTE 255 Compu_IDENTITY 0 255 PHYS_UNIT "FTB" /end CHARACTERISTIC
/begin CHARACTERISTIC FCftb_CAC_eta_lo "FCtl_FTB_0x04(656)" VALUE 0x001E5FA7 /* @ECU_Address@FCtl_FTB_0x04@0x024C5290@ */ ECIPP_ALIGNMENT_UBYTE 255 Compu_IDENTITY 0 255 PHYS_UNIT "FTB" /end CHARACTERISTIC
/begin CHARACTERISTIC FCftb_cal_config "FCtl_FTB_0x04(319)" VALUE 0x001E5E56 /* @ECU_Address@FCtl_FTB_0x04@0x024C513F@ */ ECIPP_ALIGNMENT_UBYTE 255 Compu_IDENTITY 0 255 PHYS_UNIT "FTB" /end CHARACTERISTIC
/begin CHARACTERISTIC FCftb_cam2loss "FCtl_FTB_0x04(690)" VALUE 0x001E5FC9 /* @ECU_Address@FCtl_FTB_0x04@0x024C52B2@ */ ECIPP_ALIGNMENT_UBYTE 255 Compu_IDENTITY 0 255 PHYS_UNIT "FTB" /end CHARACTERISTIC
/begin CHARACTERISTIC FCftb_camloss "FCtl_FTB_0x04(95)" VALUE 0x001E5D76 /* @ECU_Address@FCtl_FTB_0x04@0x024C505F@ */ ECIPP_ALIGNMENT_UBYTE 255 Compu_IDENTITY 0 255 PHYS_UNIT "FTB" /end CHARACTERISTIC
/begin CHARACTERISTIC FCftb_camnoise "FCtl_FTB_0x04(96)" VALUE 0x001E5D77 /* @ECU_Address@FCtl_FTB_0x04@0x024C5060@ */ ECIPP_ALIGNMENT_UBYTE 255 Compu_IDENTITY 0 255 PHYS_UNIT "FTB" /end CHARACTERISTIC
/begin CHARACTERISTIC FCftb_CATdP_hi "FCtl_FTB_0x04(526)" VALUE 0x001E5F25 /* @ECU_Address@FCtl_FTB_0x04@0x024C520E@ */ ECIPP_ALIGNMENT_UBYTE 255 Compu_IDENTITY 0 255 PHYS_UNIT "FTB" /end CHARACTERISTIC
/begin CHARACTERISTIC FCftb_CATdP_lo "FCtl_FTB_0x04(525)" VALUE 0x001E5F24 /* @ECU_Address@FCtl_FTB_0x04@0x024C520D@ */ ECIPP_ALIGNMENT_UBYTE 255 Compu_IDENTITY 0 255 PHYS_UNIT "FTB" /end CHARACTERISTIC
/begin CHARACTERISTIC FCftb_CATout_OOR "FCtl_FTB_0x04(831)" VALUE 0x001E6056 /* @ECU_Address@FCtl_FTB_0x04@0x024C533F@ */ ECIPP_ALIGNMENT_UBYTE 255 Compu_IDENTITY 0 255 PHYS_UNIT "FTB" /end CHARACTERISTIC
/begin CHARACTERISTIC FCftb_CD_MF1 "FCtl_FTB_0x04(985)" VALUE 0x001E60F0 /* @ECU_Address@FCtl_FTB_0x04@0x024C53D9@ */ ECIPP_ALIGNMENT_UBYTE 255 Compu_IDENTITY 0 255 PHYS_UNIT "FTB" /end CHARACTERISTIC
/begin CHARACTERISTIC FCftb_CFV_FP_minv "FCtl_FTB_0x04(687)" VALUE 0x001E5FC6 /* @ECU_Address@FCtl_FTB_0x04@0x024C52AF@ */ ECIPP_ALIGNMENT_UBYTE 255 Compu_IDENTITY 0 255 PHYS_UNIT "FTB" /end CHARACTERISTIC
/begin CHARACTERISTIC FCftb_CFV_FT_maxv "FCtl_FTB_0x04(688)" VALUE 0x001E5FC7 /* @ECU_Address@FCtl_FTB_0x04@0x024C52B0@ */ ECIPP_ALIGNMENT_UBYTE 255 Compu_IDENTITY 0 255 PHYS_UNIT "FTB" /end CHARACTERISTIC
/begin CHARACTERISTIC FCftb_CFV_FT_minv "FCtl_FTB_0x04(689)" VALUE 0x001E5FC8 /* @ECU_Address@FCtl_FTB_0x04@0x024C52B1@ */ ECIPP_ALIGNMENT_UBYTE 255 Compu_IDENTITY 0 255 PHYS_UNIT "FTB" /end CHARACTERISTIC
/begin CHARACTERISTIC FCftb_CFV_mdot_hi "FCtl_FTB_0x04(523)" VALUE 0x001E5F22 /* @ECU_Address@FCtl_FTB_0x04@0x024C520B@ */ ECIPP_ALIGNMENT_UBYTE 255 Compu_IDENTITY 0 255 PHYS_UNIT "FTB" /end CHARACTERISTIC
/begin CHARACTERISTIC FCftb_CFV_mdot_lo "FCtl_FTB_0x04(524)" VALUE 0x001E5F23 /* @ECU_Address@FCtl_FTB_0x04@0x024C520C@ */ ECIPP_ALIGNMENT_UBYTE 255 Compu_IDENTITY 0 255 PHYS_UNIT "FTB" /end CHARACTERISTIC
/begin CHARACTERISTIC FCftb_CFV_mdot_rms_hi "FCtl_FTB_0x04(679)" VALUE 0x001E5FBE /* @ECU_Address@FCtl_FTB_0x04@0x024C52A7@ */ ECIPP_ALIGNMENT_UBYTE 255 Compu_IDENTITY 0 255 PHYS_UNIT "FTB" /end CHARACTERISTIC
/begin CHARACTERISTIC FCftb_CFV_pwr_loss "FCtl_FTB_0x04(830)" VALUE 0x001E6055 /* @ECU_Address@FCtl_FTB_0x04@0x024C533E@ */ ECIPP_ALIGNMENT_UBYTE 255 Compu_IDENTITY 0 255 PHYS_UNIT "FTB" /end CHARACTERISTIC
/begin CHARACTERISTIC FCftb_CFV_RLV_fail "FCtl_FTB_0x04(535)" VALUE 0x001E5F2E /* @ECU_Address@FCtl_FTB_0x04@0x024C5217@ */ ECIPP_ALIGNMENT_UBYTE 255 Compu_IDENTITY 0 255 PHYS_UNIT "FTB" /end CHARACTERISTIC
/begin CHARACTERISTIC FCftb_CFV_RLV_P_min "FCtl_FTB_0x04(534)" VALUE 0x001E5F2D /* @ECU_Address@FCtl_FTB_0x04@0x024C5216@ */ ECIPP_ALIGNMENT_UBYTE 255 Compu_IDENTITY 0 255 PHYS_UNIT "FTB" /end CHARACTERISTIC
/begin CHARACTERISTIC FCftb_CHT_HiExp "FCtl_FTB_0x04(114)" VALUE 0x001E5D89 /* @ECU_Address@FCtl_FTB_0x04@0x024C5072@ */ ECIPP_ALIGNMENT_UBYTE 255 Compu_IDENTITY 0 255 PHYS_UNIT "FTB" /end CHARACTERISTIC
/begin CHARACTERISTIC FCftb_CHT_HiExp2 "FCtl_FTB_0x04(115)" VALUE 0x001E5D8A /* @ECU_Address@FCtl_FTB_0x04@0x024C5073@ */ ECIPP_ALIGNMENT_UBYTE 255 Compu_IDENTITY 0 255 PHYS_UNIT "FTB" /end CHARACTERISTIC
/begin CHARACTERISTIC FCftb_CL_hi "FCtl_FTB_0x04(32)" VALUE 0x001E5D37 /* @ECU_Address@FCtl_FTB_0x04@0x024C5020@ */ ECIPP_ALIGNMENT_UBYTE 255 Compu_IDENTITY 0 255 PHYS_UNIT "FTB" /end CHARACTERISTIC
/begin CHARACTERISTIC FCftb_CL_lo "FCtl_FTB_0x04(33)" VALUE 0x001E5D38 /* @ECU_Address@FCtl_FTB_0x04@0x024C5021@ */ ECIPP_ALIGNMENT_UBYTE 255 Compu_IDENTITY 0 255 PHYS_UNIT "FTB" /end CHARACTERISTIC
/begin CHARACTERISTIC FCspn_APUD2_max "FCtl_SPN(205)" VALUE 0x001E2098 /* @ECU_Address@FCtl_SPN@0x21B60334@ */ ECIPP_ALIGNMENT_ULONG 4294967295 Compu_IDENTITY 0 4294967295 PHYS_UNIT "SPN" /end CHARACTERISTIC
/begin CHARACTERISTIC FCspn_APUD2_min "FCtl_SPN(206)" VALUE 0x001E209C /* @ECU_Address@FCtl_SPN@0x21B60338@ */ ECIPP_ALIGNMENT_ULONG 4294967295 Compu_IDENTITY 0 4294967295 PHYS_UNIT "SPN" /end CHARACTERISTIC
/begin CHARACTERISTIC FCspn_APUD20_max "FCtl_SPN(381)" VALUE 0x001E2358 /* @ECU_Address@FCtl_SPN@0x21B605F4@ */ ECIPP_ALIGNMENT_ULONG 4294967295 Compu_IDENTITY 0 4294967295 PHYS_UNIT "SPN" /end CHARACTERISTIC
/begin CHARACTERISTIC FCspn_APUD20_min "FCtl_SPN(382)" VALUE 0x001E235C /* @ECU_Address@FCtl_SPN@0x21B605F8@ */ ECIPP_ALIGNMENT_ULONG 4294967295 Compu_IDENTITY 0 4294967295 PHYS_UNIT "SPN" /end CHARACTERISTIC
/begin CHARACTERISTIC FCspn_APUD21_max "FCtl_SPN(383)" VALUE 0x001E2360 /* @ECU_Address@FCtl_SPN@0x21B605FC@ */ ECIPP_ALIGNMENT_ULONG 4294967295 Compu_IDENTITY 0 4294967295 PHYS_UNIT "SPN" /end CHARACTERISTIC
/begin CHARACTERISTIC FCspn_APUD21_min "FCtl_SPN(384)" VALUE 0x001E2364 /* @ECU_Address@FCtl_SPN@0x21B60600@ */ ECIPP_ALIGNMENT_ULONG 4294967295 Compu_IDENTITY 0 4294967295 PHYS_UNIT "SPN" /end CHARACTERISTIC
/begin CHARACTERISTIC FCspn_APUD22_max "FCtl_SPN(385)" VALUE 0x001E2368 /* @ECU_Address@FCtl_SPN@0x21B60604@ */ ECIPP_ALIGNMENT_ULONG 4294967295 Compu_IDENTITY 0 4294967295 PHYS_UNIT "SPN" /end CHARACTERISTIC
/begin CHARACTERISTIC FCspn_APUD22_min "FCtl_SPN(386)" VALUE 0x001E236C /* @ECU_Address@FCtl_SPN@0x21B60608@ */ ECIPP_ALIGNMENT_ULONG 4294967295 Compu_IDENTITY 0 4294967295 PHYS_UNIT "SPN" /end CHARACTERISTIC
/begin CHARACTERISTIC FCspn_APUD23_max "FCtl_SPN(387)" VALUE 0x001E2370 /* @ECU_Address@FCtl_SPN@0x21B6060C@ */ ECIPP_ALIGNMENT_ULONG 4294967295 Compu_IDENTITY 0 4294967295 PHYS_UNIT "SPN" /end CHARACTERISTIC
/begin CHARACTERISTIC FCspn_APUD23_min "FCtl_SPN(388)" VALUE 0x001E2374 /* @ECU_Address@FCtl_SPN@0x21B60610@ */ ECIPP_ALIGNMENT_ULONG 4294967295 Compu_IDENTITY 0 4294967295 PHYS_UNIT "SPN" /end CHARACTERISTIC
/begin CHARACTERISTIC FCspn_APUD24_max "FCtl_SPN(389)" VALUE 0x001E2378 /* @ECU_Address@FCtl_SPN@0x21B60614@ */ ECIPP_ALIGNMENT_ULONG 4294967295 Compu_IDENTITY 0 4294967295 PHYS_UNIT "SPN" /end CHARACTERISTIC
/begin CHARACTERISTIC FCspn_APUD24_min "FCtl_SPN(390)" VALUE 0x001E237C /* @ECU_Address@FCtl_SPN@0x21B60618@ */ ECIPP_ALIGNMENT_ULONG 4294967295 Compu_IDENTITY 0 4294967295 PHYS_UNIT "SPN" /end CHARACTERISTIC
/begin CHARACTERISTIC FCspn_APUD25_max "FCtl_SPN(391)" VALUE 0x001E2380 /* @ECU_Address@FCtl_SPN@0x21B6061C@ */ ECIPP_ALIGNMENT_ULONG 4294967295 Compu_IDENTITY 0 4294967295 PHYS_UNIT "SPN" /end CHARACTERISTIC
/begin CHARACTERISTIC FCspn_APUD25_min "FCtl_SPN(392)" VALUE 0x001E2384 /* @ECU_Address@FCtl_SPN@0x21B60620@ */ ECIPP_ALIGNMENT_ULONG 4294967295 Compu_IDENTITY 0 4294967295 PHYS_UNIT "SPN" /end CHARACTERISTIC
/begin CHARACTERISTIC FCspn_APUD3_max "FCtl_SPN(207)" VALUE 0x001E20A0 /* @ECU_Address@FCtl_SPN@0x21B6033C@ */ ECIPP_ALIGNMENT_ULONG 4294967295 Compu_IDENTITY 0 4294967295 PHYS_UNIT "SPN" /end CHARACTERISTIC
/begin CHARACTERISTIC FCspn_APUD3_min "FCtl_SPN(208)" VALUE 0x001E20A4 /* @ECU_Address@FCtl_SPN@0x21B60340@ */ ECIPP_ALIGNMENT_ULONG 4294967295 Compu_IDENTITY 0 4294967295 PHYS_UNIT "SPN" /end CHARACTERISTIC
/begin CHARACTERISTIC FCspn_APUD4_max "FCtl_SPN(280)" VALUE 0x001E21C4 /* @ECU_Address@FCtl_SPN@0x21B60460@ */ ECIPP_ALIGNMENT_ULONG 4294967295 Compu_IDENTITY 0 4294967295 PHYS_UNIT "SPN" /end CHARACTERISTIC
/begin CHARACTERISTIC FCspn_APUD4_min "FCtl_SPN(281)" VALUE 0x001E21C8 /* @ECU_Address@FCtl_SPN@0x21B60464@ */ ECIPP_ALIGNMENT_ULONG 4294967295 Compu_IDENTITY 0 4294967295 PHYS_UNIT "SPN" /end CHARACTERISTIC
/begin CHARACTERISTIC FCspn_APUD5_max "FCtl_SPN(331)" VALUE 0x001E2290 /* @ECU_Address@FCtl_SPN@0x21B6052C@ */ ECIPP_ALIGNMENT_ULONG 4294967295 Compu_IDENTITY 0 4294967295 PHYS_UNIT "SPN" /end CHARACTERISTIC
/begin CHARACTERISTIC FCspn_APUD5_min "FCtl_SPN(332)" VALUE 0x001E2294 /* @ECU_Address@FCtl_SPN@0x21B60530@ */ ECIPP_ALIGNMENT_ULONG 4294967295 Compu_IDENTITY 0 4294967295 PHYS_UNIT "SPN" /end CHARACTERISTIC
/begin CHARACTERISTIC FCspn_APUD6_max "FCtl_SPN(333)" VALUE 0x001E2298 /* @ECU_Address@FCtl_SPN@0x21B60534@ */ ECIPP_ALIGNMENT_ULONG 4294967295 Compu_IDENTITY 0 4294967295 PHYS_UNIT "SPN" /end CHARACTERISTIC
/begin CHARACTERISTIC FCspn_APUD6_min "FCtl_SPN(334)" VALUE 0x001E229C /* @ECU_Address@FCtl_SPN@0x21B60538@ */ ECIPP_ALIGNMENT_ULONG 4294967295 Compu_IDENTITY 0 4294967295 PHYS_UNIT "SPN" /end CHARACTERISTIC
/begin CHARACTERISTIC FCspn_APUD7_max "FCtl_SPN(335)" VALUE 0x001E22A0 /* @ECU_Address@FCtl_SPN@0x21B6053C@ */ ECIPP_ALIGNMENT_ULONG 4294967295 Compu_IDENTITY 0 4294967295 PHYS_UNIT "SPN" /end CHARACTERISTIC
/begin CHARACTERISTIC FCspn_APUD7_min "FCtl_SPN(336)" VALUE 0x001E22A4 /* @ECU_Address@FCtl_SPN@0x21B60540@ */ ECIPP_ALIGNMENT_ULONG 4294967295 Compu_IDENTITY 0 4294967295 PHYS_UNIT "SPN" /end CHARACTERISTIC
/begin CHARACTERISTIC FCspn_APUD8_max "FCtl_SPN(352)" VALUE 0x001E22E4 /* @ECU_Address@FCtl_SPN@0x21B60580@ */ ECIPP_ALIGNMENT_ULONG 4294967295 Compu_IDENTITY 0 4294967295 PHYS_UNIT "SPN" /end CHARACTERISTIC
/begin CHARACTERISTIC FCspn_APUD8_min "FCtl_SPN(353)" VALUE 0x001E22E8 /* @ECU_Address@FCtl_SPN@0x21B60584@ */ ECIPP_ALIGNMENT_ULONG 4294967295 Compu_IDENTITY 0 4294967295 PHYS_UNIT "SPN" /end CHARACTERISTIC
/begin CHARACTERISTIC FCspn_APUD9_max "FCtl_SPN(359)" VALUE 0x001E2300 /* @ECU_Address@FCtl_SPN@0x21B6059C@ */ ECIPP_ALIGNMENT_ULONG 4294967295 Compu_IDENTITY 0 4294967295 PHYS_UNIT "SPN" /end CHARACTERISTIC
/begin CHARACTERISTIC FCspn_APUD9_min "FCtl_SPN(360)" VALUE 0x001E2304 /* @ECU_Address@FCtl_SPN@0x21B605A0@ */ ECIPP_ALIGNMENT_ULONG 4294967295 Compu_IDENTITY 0 4294967295 PHYS_UNIT "SPN" /end CHARACTERISTIC
/begin CHARACTERISTIC FCspn_AWP_intF "FCtl_SPN(832)" VALUE 0x001E2A64 /* @ECU_Address@FCtl_SPN@0x21B60D00@ */ ECIPP_ALIGNMENT_ULONG 4294967295 Compu_IDENTITY 0 4294967295 PHYS_UNIT "SPN" /end CHARACTERISTIC
/begin CHARACTERISTIC FCspn_BP_max "FCtl_SPN(7)" VALUE 0x001E1D80 /* @ECU_Address@FCtl_SPN@0x21B6001C@ */ ECIPP_ALIGNMENT_ULONG 4294967295 Compu_IDENTITY 0 4294967295 PHYS_UNIT "SPN" /end CHARACTERISTIC
/begin CHARACTERISTIC FCspn_BP_min "FCtl_SPN(8)" VALUE 0x001E1D84 /* @ECU_Address@FCtl_SPN@0x21B60020@ */ ECIPP_ALIGNMENT_ULONG 4294967295 Compu_IDENTITY 0 4294967295 PHYS_UNIT "SPN" /end CHARACTERISTIC
/begin CHARACTERISTIC FCspn_BPS1_max "FCtl_SPN(474)" VALUE 0x001E24CC /* @ECU_Address@FCtl_SPN@0x21B60768@ */ ECIPP_ALIGNMENT_ULONG 4294967295 Compu_IDENTITY 0 4294967295 PHYS_UNIT "SPN" /end CHARACTERISTIC
/begin CHARACTERISTIC FCspn_BPS1_min "FCtl_SPN(475)" VALUE 0x001E24D0 /* @ECU_Address@FCtl_SPN@0x21B6076C@ */ ECIPP_ALIGNMENT_ULONG 4294967295 Compu_IDENTITY 0 4294967295 PHYS_UNIT "SPN" /end CHARACTERISTIC
/begin CHARACTERISTIC FCspn_BPS12_OOR "FCtl_SPN(482)" VALUE 0x001E24EC /* @ECU_Address@FCtl_SPN@0x21B60788@ */ ECIPP_ALIGNMENT_ULONG 4294967295 Compu_IDENTITY 0 4294967295 PHYS_UNIT "SPN" /end CHARACTERISTIC
/begin CHARACTERISTIC FCspn_BPS12pct_hi "FCtl_SPN(478)" VALUE 0x001E24DC /* @ECU_Address@FCtl_SPN@0x21B60778@ */ ECIPP_ALIGNMENT_ULONG 4294967295 Compu_IDENTITY 0 4294967295 PHYS_UNIT "SPN" /end CHARACTERISTIC
/begin CHARACTERISTIC FCspn_BPS12pct_lo "FCtl_SPN(479)" VALUE 0x001E24E0 /* @ECU_Address@FCtl_SPN@0x21B6077C@ */ ECIPP_ALIGNMENT_ULONG 4294967295 Compu_IDENTITY 0 4294967295 PHYS_UNIT "SPN" /end CHARACTERISTIC
/begin CHARACTERISTIC FCspn_BPS2_max "FCtl_SPN(476)" VALUE 0x001E24D4 /* @ECU_Address@FCtl_SPN@0x21B60770@ */ ECIPP_ALIGNMENT_ULONG 4294967295 Compu_IDENTITY 0 4294967295 PHYS_UNIT "SPN" /end CHARACTERISTIC
/begin CHARACTERISTIC FCspn_BPS2_min "FCtl_SPN(477)" VALUE 0x001E24D8 /* @ECU_Address@FCtl_SPN@0x21B60774@ */ ECIPP_ALIGNMENT_ULONG 4294967295 Compu_IDENTITY 0 4294967295 PHYS_UNIT "SPN" /end CHARACTERISTIC
/begin CHARACTERISTIC FCspn_BPSerr_neg "FCtl_SPN(481)" VALUE 0x001E24E8 /* @ECU_Address@FCtl_SPN@0x21B60784@ */ ECIPP_ALIGNMENT_ULONG 4294967295 Compu_IDENTITY 0 4294967295 PHYS_UNIT "SPN" /end CHARACTERISTIC
/begin CHARACTERISTIC FCspn_BPSerr_pos "FCtl_SPN(480)" VALUE 0x001E24E4 /* @ECU_Address@FCtl_SPN@0x21B60780@ */ ECIPP_ALIGNMENT_ULONG 4294967295 Compu_IDENTITY 0 4294967295 PHYS_UNIT "SPN" /end CHARACTERISTIC
/begin CHARACTERISTIC FCspn_brake_gndshort "FCtl_SPN(329)" VALUE 0x001E2288 /* @ECU_Address@FCtl_SPN@0x21B60524@ */ ECIPP_ALIGNMENT_ULONG 4294967295 Compu_IDENTITY 0 4294967295 PHYS_UNIT "SPN" /end CHARACTERISTIC
/begin CHARACTERISTIC FCspn_brake_pwrshort "FCtl_SPN(330)" VALUE 0x001E228C /* @ECU_Address@FCtl_SPN@0x21B60528@ */ ECIPP_ALIGNMENT_ULONG 4294967295 Compu_IDENTITY 0 4294967295 PHYS_UNIT "SPN" /end CHARACTERISTIC
/begin CHARACTERISTIC FCspn_bst_MAT_derate_actv "FCtl_SPN(811)" VALUE 0x001E2A10 /* @ECU_Address@FCtl_SPN@0x21B60CAC@ */ ECIPP_ALIGNMENT_ULONG 4294967295 Compu_IDENTITY 0 4294967295 PHYS_UNIT "SPN" /end CHARACTERISTIC
/begin CHARACTERISTIC FCspn_BstTIP_Hi "FCtl_SPN(143)" VALUE 0x001E1FA0 /* @ECU_Address@FCtl_SPN@0x21B6023C@ */ ECIPP_ALIGNMENT_ULONG 4294967295 Compu_IDENTITY 0 4294967295 PHYS_UNIT "SPN" /end CHARACTERISTIC
/begin CHARACTERISTIC FCspn_BstTIP_Lo "FCtl_SPN(144)" VALUE 0x001E1FA4 /* @ECU_Address@FCtl_SPN@0x21B60240@ */ ECIPP_ALIGNMENT_ULONG 4294967295 Compu_IDENTITY 0 4294967295 PHYS_UNIT "SPN" /end CHARACTERISTIC
/begin CHARACTERISTIC FCspn_BstTIP_Lo2 "FCtl_SPN(686)" VALUE 0x001E281C /* @ECU_Address@FCtl_SPN@0x21B60AB8@ */ ECIPP_ALIGNMENT_ULONG 4294967295 Compu_IDENTITY 0 4294967295 PHYS_UNIT "SPN" /end CHARACTERISTIC
/begin CHARACTERISTIC FCspn_BstTIP_slow "FCtl_SPN(655)" VALUE 0x001E27A0 /* @ECU_Address@FCtl_SPN@0x21B60A3C@ */ ECIPP_ALIGNMENT_ULONG 4294967295 Compu_IDENTITY 0 4294967295 PHYS_UNIT "SPN" /end CHARACTERISTIC
/begin CHARACTERISTIC FCspn_buzz_coilopen "FCtl_SPN(165)" VALUE 0x001E1FF8 /* @ECU_Address@FCtl_SPN@0x21B60294@ */ ECIPP_ALIGNMENT_ULONG 4294967295 Compu_IDENTITY 0 4294967295 PHYS_UNIT "SPN" /end CHARACTERISTIC
/begin CHARACTERISTIC FCspn_buzz_coilshort "FCtl_SPN(166)" VALUE 0x001E1FFC /* @ECU_Address@FCtl_SPN@0x21B60298@ */ ECIPP_ALIGNMENT_ULONG 4294967295 Compu_IDENTITY 0 4294967295 PHYS_UNIT "SPN" /end CHARACTERISTIC
/begin CHARACTERISTIC FCspn_buzz_gndshort "FCtl_SPN(164)" VALUE 0x001E1FF4 /* @ECU_Address@FCtl_SPN@0x21B60290@ */ ECIPP_ALIGNMENT_ULONG 4294967295 Compu_IDENTITY 0 4294967295 PHYS_UNIT "SPN" /end CHARACTERISTIC
/begin CHARACTERISTIC FCspn_CAC_eta_lo "FCtl_SPN(656)" VALUE 0x001E27A4 /* @ECU_Address@FCtl_SPN@0x21B60A40@ */ ECIPP_ALIGNMENT_ULONG 4294967295 Compu_IDENTITY 0 4294967295 PHYS_UNIT "SPN" /end CHARACTERISTIC
/begin CHARACTERISTIC FCspn_cal_config "FCtl_SPN(319)" VALUE 0x001E2260 /* @ECU_Address@FCtl_SPN@0x21B604FC@ */ ECIPP_ALIGNMENT_ULONG 4294967295 Compu_IDENTITY 0 4294967295 PHYS_UNIT "SPN" /end CHARACTERISTIC
/begin CHARACTERISTIC FCspn_cam2loss "FCtl_SPN(690)" VALUE 0x001E282C /* @ECU_Address@FCtl_SPN@0x21B60AC8@ */ ECIPP_ALIGNMENT_ULONG 4294967295 Compu_IDENTITY 0 4294967295 PHYS_UNIT "SPN" /end CHARACTERISTIC
/begin CHARACTERISTIC FCspn_camloss "FCtl_SPN(95)" VALUE 0x001E1EE0 /* @ECU_Address@FCtl_SPN@0x21B6017C@ */ ECIPP_ALIGNMENT_ULONG 4294967295 Compu_IDENTITY 0 4294967295 PHYS_UNIT "SPN" /end CHARACTERISTIC
/begin CHARACTERISTIC FCspn_camnoise "FCtl_SPN(96)" VALUE 0x001E1EE4 /* @ECU_Address@FCtl_SPN@0x21B60180@ */ ECIPP_ALIGNMENT_ULONG 4294967295 Compu_IDENTITY 0 4294967295 PHYS_UNIT "SPN" /end CHARACTERISTIC
/begin CHARACTERISTIC FCspn_CATdP_hi "FCtl_SPN(526)" VALUE 0x001E259C /* @ECU_Address@FCtl_SPN@0x21B60838@ */ ECIPP_ALIGNMENT_ULONG 4294967295 Compu_IDENTITY 0 4294967295 PHYS_UNIT "SPN" /end CHARACTERISTIC
/begin CHARACTERISTIC FCspn_CATdP_lo "FCtl_SPN(525)" VALUE 0x001E2598 /* @ECU_Address@FCtl_SPN@0x21B60834@ */ ECIPP_ALIGNMENT_ULONG 4294967295 Compu_IDENTITY 0 4294967295 PHYS_UNIT "SPN" /end CHARACTERISTIC
/begin CHARACTERISTIC FCspn_CATout_OOR "FCtl_SPN(831)" VALUE 0x001E2A60 /* @ECU_Address@FCtl_SPN@0x21B60CFC@ */ ECIPP_ALIGNMENT_ULONG 4294967295 Compu_IDENTITY 0 4294967295 PHYS_UNIT "SPN" /end CHARACTERISTIC
/begin CHARACTERISTIC FCspn_CD_MF1 "FCtl_SPN(985)" VALUE 0x001E2CC8 /* @ECU_Address@FCtl_SPN@0x21B60F64@ */ ECIPP_ALIGNMENT_ULONG 4294967295 Compu_IDENTITY 0 4294967295 PHYS_UNIT "SPN" /end CHARACTERISTIC
/begin CHARACTERISTIC FCspn_CFV_FP_minv "FCtl_SPN(687)" VALUE 0x001E2820 /* @ECU_Address@FCtl_SPN@0x21B60ABC@ */ ECIPP_ALIGNMENT_ULONG 4294967295 Compu_IDENTITY 0 4294967295 PHYS_UNIT "SPN" /end CHARACTERISTIC
/begin CHARACTERISTIC FCspn_CFV_FT_maxv "FCtl_SPN(688)" VALUE 0x001E2824 /* @ECU_Address@FCtl_SPN@0x21B60AC0@ */ ECIPP_ALIGNMENT_ULONG 4294967295 Compu_IDENTITY 0 4294967295 PHYS_UNIT "SPN" /end CHARACTERISTIC
/begin CHARACTERISTIC FCspn_CFV_FT_minv "FCtl_SPN(689)" VALUE 0x001E2828 /* @ECU_Address@FCtl_SPN@0x21B60AC4@ */ ECIPP_ALIGNMENT_ULONG 4294967295 Compu_IDENTITY 0 4294967295 PHYS_UNIT "SPN" /end CHARACTERISTIC
/begin CHARACTERISTIC FCspn_CFV_mdot_hi "FCtl_SPN(523)" VALUE 0x001E2590 /* @ECU_Address@FCtl_SPN@0x21B6082C@ */ ECIPP_ALIGNMENT_ULONG 4294967295 Compu_IDENTITY 0 4294967295 PHYS_UNIT "SPN" /end CHARACTERISTIC
/begin CHARACTERISTIC FCspn_CFV_mdot_lo "FCtl_SPN(524)" VALUE 0x001E2594 /* @ECU_Address@FCtl_SPN@0x21B60830@ */ ECIPP_ALIGNMENT_ULONG 4294967295 Compu_IDENTITY 0 4294967295 PHYS_UNIT "SPN" /end CHARACTERISTIC
/begin CHARACTERISTIC FCspn_CFV_mdot_rms_hi "FCtl_SPN(679)" VALUE 0x001E2800 /* @ECU_Address@FCtl_SPN@0x21B60A9C@ */ ECIPP_ALIGNMENT_ULONG 4294967295 Compu_IDENTITY 0 4294967295 PHYS_UNIT "SPN" /end CHARACTERISTIC
/begin CHARACTERISTIC FCspn_CFV_pwr_loss "FCtl_SPN(830)" VALUE 0x001E2A5C /* @ECU_Address@FCtl_SPN@0x21B60CF8@ */ ECIPP_ALIGNMENT_ULONG 4294967295 Compu_IDENTITY 0 4294967295 PHYS_UNIT "SPN" /end CHARACTERISTIC
/begin CHARACTERISTIC FCspn_CFV_RLV_fail "FCtl_SPN(535)" VALUE 0x001E25C0 /* @ECU_Address@FCtl_SPN@0x21B6085C@ */ ECIPP_ALIGNMENT_ULONG 4294967295 Compu_IDENTITY 0 4294967295 PHYS_UNIT "SPN" /end CHARACTERISTIC
/begin CHARACTERISTIC FCspn_CFV_RLV_P_min "FCtl_SPN(534)" VALUE 0x001E25BC /* @ECU_Address@FCtl_SPN@0x21B60858@ */ ECIPP_ALIGNMENT_ULONG 4294967295 Compu_IDENTITY 0 4294967295 PHYS_UNIT "SPN" /end CHARACTERISTIC
/begin CHARACTERISTIC FCspn_CHT_HiExp "FCtl_SPN(114)" VALUE 0x001E1F2C /* @ECU_Address@FCtl_SPN@0x21B601C8@ */ ECIPP_ALIGNMENT_ULONG 4294967295 Compu_IDENTITY 0 4294967295 PHYS_UNIT "SPN" /end CHARACTERISTIC
/begin CHARACTERISTIC FCspn_CHT_HiExp2 "FCtl_SPN(115)" VALUE 0x001E1F30 /* @ECU_Address@FCtl_SPN@0x21B601CC@ */ ECIPP_ALIGNMENT_ULONG 4294967295 Compu_IDENTITY 0 4294967295 PHYS_UNIT "SPN" /end CHARACTERISTIC
/begin CHARACTERISTIC FCspn_CL_hi "FCtl_SPN(32)" VALUE 0x001E1DE4 /* @ECU_Address@FCtl_SPN@0x21B60080@ */ ECIPP_ALIGNMENT_ULONG 4294967295 Compu_IDENTITY 0 4294967295 PHYS_UNIT "SPN" /end CHARACTERISTIC
/begin CHARACTERISTIC FCspn_CL_lo "FCtl_SPN(33)" VALUE 0x001E1DE8 /* @ECU_Address@FCtl_SPN@0x21B60084@ */ ECIPP_ALIGNMENT_ULONG 4294967295 Compu_IDENTITY 0 4294967295 PHYS_UNIT "SPN" /end CHARACTERISTIC
/begin CHARACTERISTIC FPfl_APUD2_max "FPrm_latch(161)" VALUE 0x001E029C /* @ECU_Address@FPrm_latch@0x021BB284@ */ ECIPP_ALIGNMENT_FLOAT32_IEEE 10000000000 Compu_IDENTITY -10000000000 10000000000 PHYS_UNIT "ms" /end CHARACTERISTIC
/begin CHARACTERISTIC FPfl_APUD2_min "FPrm_latch(162)" VALUE 0x001E02A0 /* @ECU_Address@FPrm_latch@0x021BB288@ */ ECIPP_ALIGNMENT_FLOAT32_IEEE 10000000000 Compu_IDENTITY -10000000000 10000000000 PHYS_UNIT "ms" /end CHARACTERISTIC
/begin CHARACTERISTIC FPfl_APUD20_max "FPrm_latch(290)" VALUE 0x001E04A0 /* @ECU_Address@FPrm_latch@0x021BB488@ */ ECIPP_ALIGNMENT_FLOAT32_IEEE 10000000000 Compu_IDENTITY -10000000000 10000000000 PHYS_UNIT "ms" /end CHARACTERISTIC
/begin CHARACTERISTIC FPfl_APUD20_min "FPrm_latch(291)" VALUE 0x001E04A4 /* @ECU_Address@FPrm_latch@0x021BB48C@ */ ECIPP_ALIGNMENT_FLOAT32_IEEE 10000000000 Compu_IDENTITY -10000000000 10000000000 PHYS_UNIT "ms" /end CHARACTERISTIC
/begin CHARACTERISTIC FPfl_APUD21_max "FPrm_latch(292)" VALUE 0x001E04A8 /* @ECU_Address@FPrm_latch@0x021BB490@ */ ECIPP_ALIGNMENT_FLOAT32_IEEE 10000000000 Compu_IDENTITY -10000000000 10000000000 PHYS_UNIT "ms" /end CHARACTERISTIC
/begin CHARACTERISTIC FPfl_APUD21_min "FPrm_latch(293)" VALUE 0x001E04AC /* @ECU_Address@FPrm_latch@0x021BB494@ */ ECIPP_ALIGNMENT_FLOAT32_IEEE 10000000000 Compu_IDENTITY -10000000000 10000000000 PHYS_UNIT "ms" /end CHARACTERISTIC
/begin CHARACTERISTIC FPfl_APUD22_max "FPrm_latch(294)" VALUE 0x001E04B0 /* @ECU_Address@FPrm_latch@0x021BB498@ */ ECIPP_ALIGNMENT_FLOAT32_IEEE 10000000000 Compu_IDENTITY -10000000000 10000000000 PHYS_UNIT "ms" /end CHARACTERISTIC
/begin CHARACTERISTIC FPfl_APUD22_min "FPrm_latch(295)" VALUE 0x001E04B4 /* @ECU_Address@FPrm_latch@0x021BB49C@ */ ECIPP_ALIGNMENT_FLOAT32_IEEE 10000000000 Compu_IDENTITY -10000000000 10000000000 PHYS_UNIT "ms" /end CHARACTERISTIC
/begin CHARACTERISTIC FPfl_APUD23_max "FPrm_latch(296)" VALUE 0x001E04B8 /* @ECU_Address@FPrm_latch@0x021BB4A0@ */ ECIPP_ALIGNMENT_FLOAT32_IEEE 10000000000 Compu_IDENTITY -10000000000 10000000000 PHYS_UNIT "ms" /end CHARACTERISTIC
/begin CHARACTERISTIC FPfl_APUD23_min "FPrm_latch(297)" VALUE 0x001E04BC /* @ECU_Address@FPrm_latch@0x021BB4A4@ */ ECIPP_ALIGNMENT_FLOAT32_IEEE 10000000000 Compu_IDENTITY -10000000000 10000000000 PHYS_UNIT "ms" /end CHARACTERISTIC
/begin CHARACTERISTIC FPfl_APUD24_max "FPrm_latch(298)" VALUE 0x001E04C0 /* @ECU_Address@FPrm_latch@0x021BB4A8@ */ ECIPP_ALIGNMENT_FLOAT32_IEEE 10000000000 Compu_IDENTITY -10000000000 10000000000 PHYS_UNIT "ms" /end CHARACTERISTIC
/begin CHARACTERISTIC FPfl_APUD24_min "FPrm_latch(299)" VALUE 0x001E04C4 /* @ECU_Address@FPrm_latch@0x021BB4AC@ */ ECIPP_ALIGNMENT_FLOAT32_IEEE 10000000000 Compu_IDENTITY -10000000000 10000000000 PHYS_UNIT "ms" /end CHARACTERISTIC
/begin CHARACTERISTIC FPfl_APUD25_max "FPrm_latch(300)" VALUE 0x001E04C8 /* @ECU_Address@FPrm_latch@0x021BB4B0@ */ ECIPP_ALIGNMENT_FLOAT32_IEEE 10000000000 Compu_IDENTITY -10000000000 10000000000 PHYS_UNIT "ms" /end CHARACTERISTIC
/begin CHARACTERISTIC FPfl_APUD25_min "FPrm_latch(301)" VALUE 0x001E04CC /* @ECU_Address@FPrm_latch@0x021BB4B4@ */ ECIPP_ALIGNMENT_FLOAT32_IEEE 10000000000 Compu_IDENTITY -10000000000 10000000000 PHYS_UNIT "ms" /end CHARACTERISTIC
/begin CHARACTERISTIC FPfl_APUD3_max "FPrm_latch(163)" VALUE 0x001E02A4 /* @ECU_Address@FPrm_latch@0x021BB28C@ */ ECIPP_ALIGNMENT_FLOAT32_IEEE 10000000000 Compu_IDENTITY -10000000000 10000000000 PHYS_UNIT "ms" /end CHARACTERISTIC
/begin CHARACTERISTIC FPfl_APUD3_min "FPrm_latch(164)" VALUE 0x001E02A8 /* @ECU_Address@FPrm_latch@0x021BB290@ */ ECIPP_ALIGNMENT_FLOAT32_IEEE 10000000000 Compu_IDENTITY -10000000000 10000000000 PHYS_UNIT "ms" /end CHARACTERISTIC
/begin CHARACTERISTIC FPfl_APUD4_max "FPrm_latch(202)" VALUE 0x001E0340 /* @ECU_Address@FPrm_latch@0x021BB328@ */ ECIPP_ALIGNMENT_FLOAT32_IEEE 10000000000 Compu_IDENTITY -10000000000 10000000000 PHYS_UNIT "ms" /end CHARACTERISTIC
/begin CHARACTERISTIC FPfl_APUD4_min "FPrm_latch(203)" VALUE 0x001E0344 /* @ECU_Address@FPrm_latch@0x021BB32C@ */ ECIPP_ALIGNMENT_FLOAT32_IEEE 10000000000 Compu_IDENTITY -10000000000 10000000000 PHYS_UNIT "ms" /end CHARACTERISTIC
/begin CHARACTERISTIC FPfl_APUD5_max "FPrm_latch(240)" VALUE 0x001E03D8 /* @ECU_Address@FPrm_latch@0x021BB3C0@ */ ECIPP_ALIGNMENT_FLOAT32_IEEE 10000000000 Compu_IDENTITY -10000000000 10000000000 PHYS_UNIT "ms" /end CHARACTERISTIC
/begin CHARACTERISTIC FPfl_APUD5_min "FPrm_latch(241)" VALUE 0x001E03DC /* @ECU_Address@FPrm_latch@0x021BB3C4@ */ ECIPP_ALIGNMENT_FLOAT32_IEEE 10000000000 Compu_IDENTITY -10000000000 10000000000 PHYS_UNIT "ms" /end CHARACTERISTIC
/begin CHARACTERISTIC FPfl_APUD6_max "FPrm_latch(242)" VALUE 0x001E03E0 /* @ECU_Address@FPrm_latch@0x021BB3C8@ */ ECIPP_ALIGNMENT_FLOAT32_IEEE 10000000000 Compu_IDENTITY -10000000000 10000000000 PHYS_UNIT "ms" /end CHARACTERISTIC
/begin CHARACTERISTIC FPfl_APUD6_min "FPrm_latch(243)" VALUE 0x001E03E4 /* @ECU_Address@FPrm_latch@0x021BB3CC@ */ ECIPP_ALIGNMENT_FLOAT32_IEEE 10000000000 Compu_IDENTITY -10000000000 10000000000 PHYS_UNIT "ms" /end CHARACTERISTIC
/begin CHARACTERISTIC FPfl_APUD7_max "FPrm_latch(244)" VALUE 0x001E03E8 /* @ECU_Address@FPrm_latch@0x021BB3D0@ */ ECIPP_ALIGNMENT_FLOAT32_IEEE 10000000000 Compu_IDENTITY -10000000000 10000000000 PHYS_UNIT "ms" /end CHARACTERISTIC
/begin CHARACTERISTIC FPfl_APUD7_min "FPrm_latch(245)" VALUE 0x001E03EC /* @ECU_Address@FPrm_latch@0x021BB3D4@ */ ECIPP_ALIGNMENT_FLOAT32_IEEE 10000000000 Compu_IDENTITY -10000000000 10000000000 PHYS_UNIT "ms" /end CHARACTERISTIC
/begin CHARACTERISTIC FPfl_APUD8_max "FPrm_latch(261)" VALUE 0x001E042C /* @ECU_Address@FPrm_latch@0x021BB414@ */ ECIPP_ALIGNMENT_FLOAT32_IEEE 10000000000 Compu_IDENTITY -10000000000 10000000000 PHYS_UNIT "ms" /end CHARACTERISTIC
/begin CHARACTERISTIC FPfl_APUD8_min "FPrm_latch(262)" VALUE 0x001E0430 /* @ECU_Address@FPrm_latch@0x021BB418@ */ ECIPP_ALIGNMENT_FLOAT32_IEEE 10000000000 Compu_IDENTITY -10000000000 10000000000 PHYS_UNIT "ms" /end CHARACTERISTIC
/begin CHARACTERISTIC FPfl_APUD9_max "FPrm_latch(268)" VALUE 0x001E0448 /* @ECU_Address@FPrm_latch@0x021BB430@ */ ECIPP_ALIGNMENT_FLOAT32_IEEE 10000000000 Compu_IDENTITY -10000000000 10000000000 PHYS_UNIT "ms" /end CHARACTERISTIC
/begin CHARACTERISTIC FPfl_APUD9_min "FPrm_latch(269)" VALUE 0x001E044C /* @ECU_Address@FPrm_latch@0x021BB434@ */ ECIPP_ALIGNMENT_FLOAT32_IEEE 10000000000 Compu_IDENTITY -10000000000 10000000000 PHYS_UNIT "ms" /end CHARACTERISTIC
/begin CHARACTERISTIC FPfl_AWP_intF "FPrm_latch(659)" VALUE 0x001E0A64 /* @ECU_Address@FPrm_latch@0x021BBA4C@ */ ECIPP_ALIGNMENT_FLOAT32_IEEE 10000000000 Compu_IDENTITY -10000000000 10000000000 PHYS_UNIT "ms" /end CHARACTERISTIC
/begin CHARACTERISTIC FPfl_BP_max "FPrm_latch(10)" VALUE 0x001E0040 /* @ECU_Address@FPrm_latch@0x021BB028@ */ ECIPP_ALIGNMENT_FLOAT32_IEEE 10000000000 Compu_IDENTITY -10000000000 10000000000 PHYS_UNIT "ms" /end CHARACTERISTIC
/begin CHARACTERISTIC FPfl_BP_min "FPrm_latch(11)" VALUE 0x001E0044 /* @ECU_Address@FPrm_latch@0x021BB02C@ */ ECIPP_ALIGNMENT_FLOAT32_IEEE 10000000000 Compu_IDENTITY -10000000000 10000000000 PHYS_UNIT "ms" /end CHARACTERISTIC
/begin CHARACTERISTIC FPfl_BPS1_max "FPrm_latch(371)" VALUE 0x001E05E4 /* @ECU_Address@FPrm_latch@0x021BB5CC@ */ ECIPP_ALIGNMENT_FLOAT32_IEEE 10000000000 Compu_IDENTITY -10000000000 10000000000 PHYS_UNIT "ms" /end CHARACTERISTIC
/begin CHARACTERISTIC FPfl_BPS1_min "FPrm_latch(372)" VALUE 0x001E05E8 /* @ECU_Address@FPrm_latch@0x021BB5D0@ */ ECIPP_ALIGNMENT_FLOAT32_IEEE 10000000000 Compu_IDENTITY -10000000000 10000000000 PHYS_UNIT "ms" /end CHARACTERISTIC
/begin CHARACTERISTIC FPfl_BPS12_OOR "FPrm_latch(379)" VALUE 0x001E0604 /* @ECU_Address@FPrm_latch@0x021BB5EC@ */ ECIPP_ALIGNMENT_FLOAT32_IEEE 10000000000 Compu_IDENTITY -10000000000 10000000000 PHYS_UNIT "ms" /end CHARACTERISTIC
/begin CHARACTERISTIC FPfl_BPS12pct_hi "FPrm_latch(375)" VALUE 0x001E05F4 /* @ECU_Address@FPrm_latch@0x021BB5DC@ */ ECIPP_ALIGNMENT_FLOAT32_IEEE 10000000000 Compu_IDENTITY -10000000000 10000000000 PHYS_UNIT "ms" /end CHARACTERISTIC
/begin CHARACTERISTIC FPfl_BPS12pct_lo "FPrm_latch(376)" VALUE 0x001E05F8 /* @ECU_Address@FPrm_latch@0x021BB5E0@ */ ECIPP_ALIGNMENT_FLOAT32_IEEE 10000000000 Compu_IDENTITY -10000000000 10000000000 PHYS_UNIT "ms" /end CHARACTERISTIC
/begin CHARACTERISTIC FPfl_BPS2_max "FPrm_latch(373)" VALUE 0x001E05EC /* @ECU_Address@FPrm_latch@0x021BB5D4@ */ ECIPP_ALIGNMENT_FLOAT32_IEEE 10000000000 Compu_IDENTITY -10000000000 10000000000 PHYS_UNIT "ms" /end CHARACTERISTIC
/begin CHARACTERISTIC FPfl_BPS2_min "FPrm_latch(374)" VALUE 0x001E05F0 /* @ECU_Address@FPrm_latch@0x021BB5D8@ */ ECIPP_ALIGNMENT_FLOAT32_IEEE 10000000000 Compu_IDENTITY -10000000000 10000000000 PHYS_UNIT "ms" /end CHARACTERISTIC
/begin CHARACTERISTIC FPfl_BPSerr_neg "FPrm_latch(378)" VALUE 0x001E0600 /* @ECU_Address@FPrm_latch@0x021BB5E8@ */ ECIPP_ALIGNMENT_FLOAT32_IEEE 10000000000 Compu_IDENTITY -10000000000 10000000000 PHYS_UNIT "ms" /end CHARACTERISTIC
/begin CHARACTERISTIC FPfl_BPSerr_pos "FPrm_latch(377)" VALUE 0x001E05FC /* @ECU_Address@FPrm_latch@0x021BB5E4@ */ ECIPP_ALIGNMENT_FLOAT32_IEEE 10000000000 Compu_IDENTITY -10000000000 10000000000 PHYS_UNIT "ms" /end CHARACTERISTIC
/begin CHARACTERISTIC FPfl_brake_gndshort "FPrm_latch(238)" VALUE 0x001E03D0 /* @ECU_Address@FPrm_latch@0x021BB3B8@ */ ECIPP_ALIGNMENT_FLOAT32_IEEE 10000000000 Compu_IDENTITY -10000000000 10000000000 PHYS_UNIT "samples" /end CHARACTERISTIC
/begin CHARACTERISTIC FPfl_brake_pwrshort "FPrm_latch(239)" VALUE 0x001E03D4 /* @ECU_Address@FPrm_latch@0x021BB3BC@ */ ECIPP_ALIGNMENT_FLOAT32_IEEE 10000000000 Compu_IDENTITY -10000000000 10000000000 PHYS_UNIT "samples" /end CHARACTERISTIC
/begin CHARACTERISTIC FPfl_bst_MAT_derate_actv "FPrm_latch(638)" VALUE 0x001E0A10 /* @ECU_Address@FPrm_latch@0x021BB9F8@ */ ECIPP_ALIGNMENT_FLOAT32_IEEE 10000000000 Compu_IDENTITY -10000000000 10000000000 PHYS_UNIT "ms" /end CHARACTERISTIC
/begin CHARACTERISTIC FPfl_BstTIP_Hi "FPrm_latch(103)" VALUE 0x001E01B4 /* @ECU_Address@FPrm_latch@0x021BB19C@ */ ECIPP_ALIGNMENT_FLOAT32_IEEE 10000000000 Compu_IDENTITY -10000000000 10000000000 PHYS_UNIT "ms" /end CHARACTERISTIC
/begin CHARACTERISTIC FPfl_BstTIP_Lo "FPrm_latch(104)" VALUE 0x001E01B8 /* @ECU_Address@FPrm_latch@0x021BB1A0@ */ ECIPP_ALIGNMENT_FLOAT32_IEEE 10000000000 Compu_IDENTITY -10000000000 10000000000 PHYS_UNIT "ms" /end CHARACTERISTIC
/begin CHARACTERISTIC FPfl_BstTIP_Lo2 "FPrm_latch(516)" VALUE 0x001E0828 /* @ECU_Address@FPrm_latch@0x021BB810@ */ ECIPP_ALIGNMENT_FLOAT32_IEEE 10000000000 Compu_IDENTITY -10000000000 10000000000 PHYS_UNIT "ms" /end CHARACTERISTIC
/begin CHARACTERISTIC FPfl_BstTIP_slow "FPrm_latch(485)" VALUE 0x001E07AC /* @ECU_Address@FPrm_latch@0x021BB794@ */ ECIPP_ALIGNMENT_FLOAT32_IEEE 10000000000 Compu_IDENTITY -10000000000 10000000000 PHYS_UNIT "ms" /end CHARACTERISTIC
/begin CHARACTERISTIC FPfl_buzz_coilopen "FPrm_latch(125)" VALUE 0x001E020C /* @ECU_Address@FPrm_latch@0x021BB1F4@ */ ECIPP_ALIGNMENT_FLOAT32_IEEE 10000000000 Compu_IDENTITY -10000000000 10000000000 PHYS_UNIT "samples" /end CHARACTERISTIC
/begin CHARACTERISTIC FPfl_buzz_coilshort "FPrm_latch(126)" VALUE 0x001E0210 /* @ECU_Address@FPrm_latch@0x021BB1F8@ */ ECIPP_ALIGNMENT_FLOAT32_IEEE 10000000000 Compu_IDENTITY -10000000000 10000000000 PHYS_UNIT "samples" /end CHARACTERISTIC
/begin CHARACTERISTIC FPfl_buzz_gndshort "FPrm_latch(124)" VALUE 0x001E0208 /* @ECU_Address@FPrm_latch@0x021BB1F0@ */ ECIPP_ALIGNMENT_FLOAT32_IEEE 10000000000 Compu_IDENTITY -10000000000 10000000000 PHYS_UNIT "samples" /end CHARACTERISTIC
/begin CHARACTERISTIC FPfl_CAC_eta_lo "FPrm_latch(486)" VALUE 0x001E07B0 /* @ECU_Address@FPrm_latch@0x021BB798@ */ ECIPP_ALIGNMENT_FLOAT32_IEEE 10000000000 Compu_IDENTITY -10000000000 10000000000 PHYS_UNIT "ms" /end CHARACTERISTIC
/begin CHARACTERISTIC FPfl_cal_config "FPrm_latch(228)" VALUE 0x001E03A8 /* @ECU_Address@FPrm_latch@0x021BB390@ */ ECIPP_ALIGNMENT_FLOAT32_IEEE 10000000000 Compu_IDENTITY -10000000000 10000000000 PHYS_UNIT "ms" /end CHARACTERISTIC
/begin CHARACTERISTIC FPfl_cam2loss "FPrm_latch(520)" VALUE 0x001E0838 /* @ECU_Address@FPrm_latch@0x021BB820@ */ ECIPP_ALIGNMENT_FLOAT32_IEEE 10000000000 Compu_IDENTITY -10000000000 10000000000 PHYS_UNIT "ms" /end CHARACTERISTIC
/begin CHARACTERISTIC FPfl_camloss "FPrm_latch(59)" VALUE 0x001E0104 /* @ECU_Address@FPrm_latch@0x021BB0EC@ */ ECIPP_ALIGNMENT_FLOAT32_IEEE 10000000000 Compu_IDENTITY -10000000000 10000000000 PHYS_UNIT "ms" /end CHARACTERISTIC
/begin CHARACTERISTIC FPfl_camnoise "FPrm_latch(60)" VALUE 0x001E0108 /* @ECU_Address@FPrm_latch@0x021BB0F0@ */ ECIPP_ALIGNMENT_FLOAT32_IEEE 10000000000 Compu_IDENTITY -10000000000 10000000000 PHYS_UNIT "ms" /end CHARACTERISTIC
/begin CHARACTERISTIC FPfl_CATdP_hi "FPrm_latch(396)" VALUE 0x001E0648 /* @ECU_Address@FPrm_latch@0x021BB630@ */ ECIPP_ALIGNMENT_FLOAT32_IEEE 10000000000 Compu_IDENTITY -10000000000 10000000000 PHYS_UNIT "ms" /end CHARACTERISTIC
/begin CHARACTERISTIC FPfl_CATdP_lo "FPrm_latch(395)" VALUE 0x001E0644 /* @ECU_Address@FPrm_latch@0x021BB62C@ */ ECIPP_ALIGNMENT_FLOAT32_IEEE 10000000000 Compu_IDENTITY -10000000000 10000000000 PHYS_UNIT "ms" /end CHARACTERISTIC
/begin CHARACTERISTIC FPfl_CATout_OOR "FPrm_latch(658)" VALUE 0x001E0A60 /* @ECU_Address@FPrm_latch@0x021BBA48@ */ ECIPP_ALIGNMENT_FLOAT32_IEEE 10000000000 Compu_IDENTITY -10000000000 10000000000 PHYS_UNIT "ms" /end CHARACTERISTIC
/begin CHARACTERISTIC FPfl_CD_MF1 "FPrm_latch(710)" VALUE 0x001E0B30 /* @ECU_Address@FPrm_latch@0x021BBB18@ */ ECIPP_ALIGNMENT_FLOAT32_IEEE 10000000000 Compu_IDENTITY -10000000000 10000000000 PHYS_UNIT "sparks" /end CHARACTERISTIC
/begin CHARACTERISTIC FPfl_CFV_FP_minv "FPrm_latch(517)" VALUE 0x001E082C /* @ECU_Address@FPrm_latch@0x021BB814@ */ ECIPP_ALIGNMENT_FLOAT32_IEEE 10000000000 Compu_IDENTITY -10000000000 10000000000 PHYS_UNIT "ms" /end CHARACTERISTIC
/begin CHARACTERISTIC FPfl_CFV_FT_maxv "FPrm_latch(518)" VALUE 0x001E0830 /* @ECU_Address@FPrm_latch@0x021BB818@ */ ECIPP_ALIGNMENT_FLOAT32_IEEE 10000000000 Compu_IDENTITY -10000000000 10000000000 PHYS_UNIT "ms" /end CHARACTERISTIC
/begin CHARACTERISTIC FPfl_CFV_FT_minv "FPrm_latch(519)" VALUE 0x001E0834 /* @ECU_Address@FPrm_latch@0x021BB81C@ */ ECIPP_ALIGNMENT_FLOAT32_IEEE 10000000000 Compu_IDENTITY -10000000000 10000000000 PHYS_UNIT "ms" /end CHARACTERISTIC
/begin CHARACTERISTIC FPfl_CFV_mdot_hi "FPrm_latch(393)" VALUE 0x001E063C /* @ECU_Address@FPrm_latch@0x021BB624@ */ ECIPP_ALIGNMENT_FLOAT32_IEEE 10000000000 Compu_IDENTITY -10000000000 10000000000 PHYS_UNIT "ms" /end CHARACTERISTIC
/begin CHARACTERISTIC FPfl_CFV_mdot_lo "FPrm_latch(394)" VALUE 0x001E0640 /* @ECU_Address@FPrm_latch@0x021BB628@ */ ECIPP_ALIGNMENT_FLOAT32_IEEE 10000000000 Compu_IDENTITY -10000000000 10000000000 PHYS_UNIT "ms" /end CHARACTERISTIC
/begin CHARACTERISTIC FPfl_CFV_mdot_rms_hi "FPrm_latch(509)" VALUE 0x001E080C /* @ECU_Address@FPrm_latch@0x021BB7F4@ */ ECIPP_ALIGNMENT_FLOAT32_IEEE 10000000000 Compu_IDENTITY -10000000000 10000000000 PHYS_UNIT "ms" /end CHARACTERISTIC
/begin CHARACTERISTIC FPfl_CFV_pwr_loss "FPrm_latch(657)" VALUE 0x001E0A5C /* @ECU_Address@FPrm_latch@0x021BBA44@ */ ECIPP_ALIGNMENT_FLOAT32_IEEE 10000000000 Compu_IDENTITY -10000000000 10000000000 PHYS_UNIT "ms" /end CHARACTERISTIC
/begin CHARACTERISTIC FPfl_CFV_RLV_fail "FPrm_latch(405)" VALUE 0x001E066C /* @ECU_Address@FPrm_latch@0x021BB654@ */ ECIPP_ALIGNMENT_FLOAT32_IEEE 10000000000 Compu_IDENTITY -10000000000 10000000000 PHYS_UNIT "none" /end CHARACTERISTIC
/begin CHARACTERISTIC FPfl_CFV_RLV_P_min "FPrm_latch(404)" VALUE 0x001E0668 /* @ECU_Address@FPrm_latch@0x021BB650@ */ ECIPP_ALIGNMENT_FLOAT32_IEEE 10000000000 Compu_IDENTITY -10000000000 10000000000 PHYS_UNIT "updates" /end CHARACTERISTIC
/begin CHARACTERISTIC FPfl_CHT_HiExp "FPrm_latch(73)" VALUE 0x001E013C /* @ECU_Address@FPrm_latch@0x021BB124@ */ ECIPP_ALIGNMENT_FLOAT32_IEEE 10000000000 Compu_IDENTITY -10000000000 10000000000 PHYS_UNIT "ms" /end CHARACTERISTIC
/begin CHARACTERISTIC FPfl_CHT_HiExp2 "FPrm_latch(74)" VALUE 0x001E0140 /* @ECU_Address@FPrm_latch@0x021BB128@ */ ECIPP_ALIGNMENT_FLOAT32_IEEE 10000000000 Compu_IDENTITY -10000000000 10000000000 PHYS_UNIT "ms" /end CHARACTERISTIC
/begin CHARACTERISTIC FPfl_CL_hi "FPrm_latch(47)" VALUE 0x001E00D4 /* @ECU_Address@FPrm_latch@0x021BB0BC@ */ ECIPP_ALIGNMENT_FLOAT32_IEEE 10000000000 Compu_IDENTITY -10000000000 10000000000 PHYS_UNIT "updates" /end CHARACTERISTIC
/begin CHARACTERISTIC FPfl_CL_lo "FPrm_latch(48)" VALUE 0x001E00D8 /* @ECU_Address@FPrm_latch@0x021BB0C0@ */ ECIPP_ALIGNMENT_FLOAT32_IEEE 10000000000 Compu_IDENTITY -10000000000 10000000000 PHYS_UNIT "updates" /end CHARACTERISTIC
/begin CHARACTERISTIC FPfu_APUD2_max "FPrm_unlatch(161)" VALUE 0x001E0DE4 /* @ECU_Address@FPrm_unlatch@0x021BD284@ */ ECIPP_ALIGNMENT_FLOAT32_IEEE 10000000000 Compu_IDENTITY -10000000000 10000000000 PHYS_UNIT "ms" /end CHARACTERISTIC
/begin CHARACTERISTIC FPfu_APUD2_min "FPrm_unlatch(162)" VALUE 0x001E0DE8 /* @ECU_Address@FPrm_unlatch@0x021BD288@ */ ECIPP_ALIGNMENT_FLOAT32_IEEE 10000000000 Compu_IDENTITY -10000000000 10000000000 PHYS_UNIT "ms" /end CHARACTERISTIC
/begin CHARACTERISTIC FPfu_APUD20_max "FPrm_unlatch(290)" VALUE 0x001E0FE8 /* @ECU_Address@FPrm_unlatch@0x021BD488@ */ ECIPP_ALIGNMENT_FLOAT32_IEEE 10000000000 Compu_IDENTITY -10000000000 10000000000 PHYS_UNIT "ms" /end CHARACTERISTIC
/begin CHARACTERISTIC FPfu_APUD20_min "FPrm_unlatch(291)" VALUE 0x001E0FEC /* @ECU_Address@FPrm_unlatch@0x021BD48C@ */ ECIPP_ALIGNMENT_FLOAT32_IEEE 10000000000 Compu_IDENTITY -10000000000 10000000000 PHYS_UNIT "ms" /end CHARACTERISTIC
/begin CHARACTERISTIC FPfu_APUD21_max "FPrm_unlatch(292)" VALUE 0x001E0FF0 /* @ECU_Address@FPrm_unlatch@0x021BD490@ */ ECIPP_ALIGNMENT_FLOAT32_IEEE 10000000000 Compu_IDENTITY -10000000000 10000000000 PHYS_UNIT "ms" /end CHARACTERISTIC
/begin CHARACTERISTIC FPfu_APUD21_min "FPrm_unlatch(293)" VALUE 0x001E0FF4 /* @ECU_Address@FPrm_unlatch@0x021BD494@ */ ECIPP_ALIGNMENT_FLOAT32_IEEE 10000000000 Compu_IDENTITY -10000000000 10000000000 PHYS_UNIT "ms" /end CHARACTERISTIC
/begin CHARACTERISTIC FPfu_APUD22_max "FPrm_unlatch(294)" VALUE 0x001E0FF8 /* @ECU_Address@FPrm_unlatch@0x021BD498@ */ ECIPP_ALIGNMENT_FLOAT32_IEEE 10000000000 Compu_IDENTITY -10000000000 10000000000 PHYS_UNIT "ms" /end CHARACTERISTIC
/begin CHARACTERISTIC FPfu_APUD22_min "FPrm_unlatch(295)" VALUE 0x001E0FFC /* @ECU_Address@FPrm_unlatch@0x021BD49C@ */ ECIPP_ALIGNMENT_FLOAT32_IEEE 10000000000 Compu_IDENTITY -10000000000 10000000000 PHYS_UNIT "ms" /end CHARACTERISTIC
/begin CHARACTERISTIC FPfu_APUD23_max "FPrm_unlatch(296)" VALUE 0x001E1000 /* @ECU_Address@FPrm_unlatch@0x021BD4A0@ */ ECIPP_ALIGNMENT_FLOAT32_IEEE 10000000000 Compu_IDENTITY -10000000000 10000000000 PHYS_UNIT "ms" /end CHARACTERISTIC
/begin CHARACTERISTIC FPfu_APUD23_min "FPrm_unlatch(297)" VALUE 0x001E1004 /* @ECU_Address@FPrm_unlatch@0x021BD4A4@ */ ECIPP_ALIGNMENT_FLOAT32_IEEE 10000000000 Compu_IDENTITY -10000000000 10000000000 PHYS_UNIT "ms" /end CHARACTERISTIC
/begin CHARACTERISTIC FPfu_APUD24_max "FPrm_unlatch(298)" VALUE 0x001E1008 /* @ECU_Address@FPrm_unlatch@0x021BD4A8@ */ ECIPP_ALIGNMENT_FLOAT32_IEEE 10000000000 Compu_IDENTITY -10000000000 10000000000 PHYS_UNIT "ms" /end CHARACTERISTIC
/begin CHARACTERISTIC FPfu_APUD24_min "FPrm_unlatch(299)" VALUE 0x001E100C /* @ECU_Address@FPrm_unlatch@0x021BD4AC@ */ ECIPP_ALIGNMENT_FLOAT32_IEEE 10000000000 Compu_IDENTITY -10000000000 10000000000 PHYS_UNIT "ms" /end CHARACTERISTIC
/begin CHARACTERISTIC FPfu_APUD25_max "FPrm_unlatch(300)" VALUE 0x001E1010 /* @ECU_Address@FPrm_unlatch@0x021BD4B0@ */ ECIPP_ALIGNMENT_FLOAT32_IEEE 10000000000 Compu_IDENTITY -10000000000 10000000000 PHYS_UNIT "ms" /end CHARACTERISTIC
/begin CHARACTERISTIC FPfu_APUD25_min "FPrm_unlatch(301)" VALUE 0x001E1014 /* @ECU_Address@FPrm_unlatch@0x021BD4B4@ */ ECIPP_ALIGNMENT_FLOAT32_IEEE 10000000000 Compu_IDENTITY -10000000000 10000000000 PHYS_UNIT "ms" /end CHARACTERISTIC
/begin CHARACTERISTIC FPfu_APUD3_max "FPrm_unlatch(163)" VALUE 0x001E0DEC /* @ECU_Address@FPrm_unlatch@0x021BD28C@ */ ECIPP_ALIGNMENT_FLOAT32_IEEE 10000000000 Compu_IDENTITY -10000000000 10000000000 PHYS_UNIT "ms" /end CHARACTERISTIC
/begin CHARACTERISTIC FPfu_APUD3_min "FPrm_unlatch(164)" VALUE 0x001E0DF0 /* @ECU_Address@FPrm_unlatch@0x021BD290@ */ ECIPP_ALIGNMENT_FLOAT32_IEEE 10000000000 Compu_IDENTITY -10000000000 10000000000 PHYS_UNIT "ms" /end CHARACTERISTIC
/begin CHARACTERISTIC FPfu_APUD4_max "FPrm_unlatch(202)" VALUE 0x001E0E88 /* @ECU_Address@FPrm_unlatch@0x021BD328@ */ ECIPP_ALIGNMENT_FLOAT32_IEEE 10000000000 Compu_IDENTITY -10000000000 10000000000 PHYS_UNIT "ms" /end CHARACTERISTIC
/begin CHARACTERISTIC FPfu_APUD4_min "FPrm_unlatch(203)" VALUE 0x001E0E8C /* @ECU_Address@FPrm_unlatch@0x021BD32C@ */ ECIPP_ALIGNMENT_FLOAT32_IEEE 10000000000 Compu_IDENTITY -10000000000 10000000000 PHYS_UNIT "ms" /end CHARACTERISTIC
/begin CHARACTERISTIC FPfu_APUD5_max "FPrm_unlatch(240)" VALUE 0x001E0F20 /* @ECU_Address@FPrm_unlatch@0x021BD3C0@ */ ECIPP_ALIGNMENT_FLOAT32_IEEE 10000000000 Compu_IDENTITY -10000000000 10000000000 PHYS_UNIT "ms" /end CHARACTERISTIC
/begin CHARACTERISTIC FPfu_APUD5_min "FPrm_unlatch(241)" VALUE 0x001E0F24 /* @ECU_Address@FPrm_unlatch@0x021BD3C4@ */ ECIPP_ALIGNMENT_FLOAT32_IEEE 10000000000 Compu_IDENTITY -10000000000 10000000000 PHYS_UNIT "ms" /end CHARACTERISTIC
/begin CHARACTERISTIC FPfu_APUD6_max "FPrm_unlatch(242)" VALUE 0x001E0F28 /* @ECU_Address@FPrm_unlatch@0x021BD3C8@ */ ECIPP_ALIGNMENT_FLOAT32_IEEE 10000000000 Compu_IDENTITY -10000000000 10000000000 PHYS_UNIT "ms" /end CHARACTERISTIC
/begin CHARACTERISTIC FPfu_APUD6_min "FPrm_unlatch(243)" VALUE 0x001E0F2C /* @ECU_Address@FPrm_unlatch@0x021BD3CC@ */ ECIPP_ALIGNMENT_FLOAT32_IEEE 10000000000 Compu_IDENTITY -10000000000 10000000000 PHYS_UNIT "ms" /end CHARACTERISTIC
/begin CHARACTERISTIC FPfu_APUD7_max "FPrm_unlatch(244)" VALUE 0x001E0F30 /* @ECU_Address@FPrm_unlatch@0x021BD3D0@ */ ECIPP_ALIGNMENT_FLOAT32_IEEE 10000000000 Compu_IDENTITY -10000000000 10000000000 PHYS_UNIT "ms" /end CHARACTERISTIC
/begin CHARACTERISTIC FPfu_APUD7_min "FPrm_unlatch(245)" VALUE 0x001E0F34 /* @ECU_Address@FPrm_unlatch@0x021BD3D4@ */ ECIPP_ALIGNMENT_FLOAT32_IEEE 10000000000 Compu_IDENTITY -10000000000 10000000000 PHYS_UNIT "ms" /end CHARACTERISTIC
/begin CHARACTERISTIC FPfu_APUD8_max "FPrm_unlatch(261)" VALUE 0x001E0F74 /* @ECU_Address@FPrm_unlatch@0x021BD414@ */ ECIPP_ALIGNMENT_FLOAT32_IEEE 10000000000 Compu_IDENTITY -10000000000 10000000000 PHYS_UNIT "ms" /end CHARACTERISTIC
/begin CHARACTERISTIC FPfu_APUD8_min "FPrm_unlatch(262)" VALUE 0x001E0F78 /* @ECU_Address@FPrm_unlatch@0x021BD418@ */ ECIPP_ALIGNMENT_FLOAT32_IEEE 10000000000 Compu_IDENTITY -10000000000 10000000000 PHYS_UNIT "ms" /end CHARACTERISTIC
/begin CHARACTERISTIC FPfu_APUD9_max "FPrm_unlatch(268)" VALUE 0x001E0F90 /* @ECU_Address@FPrm_unlatch@0x021BD430@ */ ECIPP_ALIGNMENT_FLOAT32_IEEE 10000000000 Compu_IDENTITY -10000000000 10000000000 PHYS_UNIT "ms" /end CHARACTERISTIC
/begin CHARACTERISTIC FPfu_APUD9_min "FPrm_unlatch(269)" VALUE 0x001E0F94 /* @ECU_Address@FPrm_unlatch@0x021BD434@ */ ECIPP_ALIGNMENT_FLOAT32_IEEE 10000000000 Compu_IDENTITY -10000000000 10000000000 PHYS_UNIT "ms" /end CHARACTERISTIC
/begin CHARACTERISTIC FPfu_AWP_intF "FPrm_unlatch(659)" VALUE 0x001E15AC /* @ECU_Address@FPrm_unlatch@0x021BDA4C@ */ ECIPP_ALIGNMENT_FLOAT32_IEEE 10000000000 Compu_IDENTITY -10000000000 10000000000 PHYS_UNIT "ms" /end CHARACTERISTIC
/begin CHARACTERISTIC FPfu_BP_max "FPrm_unlatch(10)" VALUE 0x001E0B88 /* @ECU_Address@FPrm_unlatch@0x021BD028@ */ ECIPP_ALIGNMENT_FLOAT32_IEEE 10000000000 Compu_IDENTITY -10000000000 10000000000 PHYS_UNIT "ms" /end CHARACTERISTIC
/begin CHARACTERISTIC FPfu_BP_min "FPrm_unlatch(11)" VALUE 0x001E0B8C /* @ECU_Address@FPrm_unlatch@0x021BD02C@ */ ECIPP_ALIGNMENT_FLOAT32_IEEE 10000000000 Compu_IDENTITY -10000000000 10000000000 PHYS_UNIT "ms" /end CHARACTERISTIC
/begin CHARACTERISTIC FPfu_BPS1_max "FPrm_unlatch(371)" VALUE 0x001E112C /* @ECU_Address@FPrm_unlatch@0x021BD5CC@ */ ECIPP_ALIGNMENT_FLOAT32_IEEE 10000000000 Compu_IDENTITY -10000000000 10000000000 PHYS_UNIT "ms" /end CHARACTERISTIC
/begin CHARACTERISTIC FPfu_BPS1_min "FPrm_unlatch(372)" VALUE 0x001E1130 /* @ECU_Address@FPrm_unlatch@0x021BD5D0@ */ ECIPP_ALIGNMENT_FLOAT32_IEEE 10000000000 Compu_IDENTITY -10000000000 10000000000 PHYS_UNIT "ms" /end CHARACTERISTIC
/begin CHARACTERISTIC FPfu_BPS12_OOR "FPrm_unlatch(379)" VALUE 0x001E114C /* @ECU_Address@FPrm_unlatch@0x021BD5EC@ */ ECIPP_ALIGNMENT_FLOAT32_IEEE 10000000000 Compu_IDENTITY -10000000000 10000000000 PHYS_UNIT "ms" /end CHARACTERISTIC
/begin CHARACTERISTIC FPfu_BPS12pct_hi "FPrm_unlatch(375)" VALUE 0x001E113C /* @ECU_Address@FPrm_unlatch@0x021BD5DC@ */ ECIPP_ALIGNMENT_FLOAT32_IEEE 10000000000 Compu_IDENTITY -10000000000 10000000000 PHYS_UNIT "ms" /end CHARACTERISTIC
/begin CHARACTERISTIC FPfu_BPS12pct_lo "FPrm_unlatch(376)" VALUE 0x001E1140 /* @ECU_Address@FPrm_unlatch@0x021BD5E0@ */ ECIPP_ALIGNMENT_FLOAT32_IEEE 10000000000 Compu_IDENTITY -10000000000 10000000000 PHYS_UNIT "ms" /end CHARACTERISTIC
/begin CHARACTERISTIC FPfu_BPS2_max "FPrm_unlatch(373)" VALUE 0x001E1134 /* @ECU_Address@FPrm_unlatch@0x021BD5D4@ */ ECIPP_ALIGNMENT_FLOAT32_IEEE 10000000000 Compu_IDENTITY -10000000000 10000000000 PHYS_UNIT "ms" /end CHARACTERISTIC
/begin CHARACTERISTIC FPfu_BPS2_min "FPrm_unlatch(374)" VALUE 0x001E1138 /* @ECU_Address@FPrm_unlatch@0x021BD5D8@ */ ECIPP_ALIGNMENT_FLOAT32_IEEE 10000000000 Compu_IDENTITY -10000000000 10000000000 PHYS_UNIT "ms" /end CHARACTERISTIC
/begin CHARACTERISTIC FPfu_BPSerr_neg "FPrm_unlatch(378)" VALUE 0x001E1148 /* @ECU_Address@FPrm_unlatch@0x021BD5E8@ */ ECIPP_ALIGNMENT_FLOAT32_IEEE 10000000000 Compu_IDENTITY -10000000000 10000000000 PHYS_UNIT "ms" /end CHARACTERISTIC
/begin CHARACTERISTIC FPfu_BPSerr_pos "FPrm_unlatch(377)" VALUE 0x001E1144 /* @ECU_Address@FPrm_unlatch@0x021BD5E4@ */ ECIPP_ALIGNMENT_FLOAT32_IEEE 10000000000 Compu_IDENTITY -10000000000 10000000000 PHYS_UNIT "ms" /end CHARACTERISTIC
/begin CHARACTERISTIC FPfu_brake_gndshort "FPrm_unlatch(238)" VALUE 0x001E0F18 /* @ECU_Address@FPrm_unlatch@0x021BD3B8@ */ ECIPP_ALIGNMENT_FLOAT32_IEEE 10000000000 Compu_IDENTITY -10000000000 10000000000 PHYS_UNIT "samples" /end CHARACTERISTIC
/begin CHARACTERISTIC FPfu_brake_pwrshort "FPrm_unlatch(239)" VALUE 0x001E0F1C /* @ECU_Address@FPrm_unlatch@0x021BD3BC@ */ ECIPP_ALIGNMENT_FLOAT32_IEEE 10000000000 Compu_IDENTITY -10000000000 10000000000 PHYS_UNIT "samples" /end CHARACTERISTIC
/begin CHARACTERISTIC FPfu_bst_MAT_derate_actv "FPrm_unlatch(638)" VALUE 0x001E1558 /* @ECU_Address@FPrm_unlatch@0x021BD9F8@ */ ECIPP_ALIGNMENT_FLOAT32_IEEE 10000000000 Compu_IDENTITY -10000000000 10000000000 PHYS_UNIT "ms" /end CHARACTERISTIC
/begin CHARACTERISTIC FPfu_BstTIP_Hi "FPrm_unlatch(103)" VALUE 0x001E0CFC /* @ECU_Address@FPrm_unlatch@0x021BD19C@ */ ECIPP_ALIGNMENT_FLOAT32_IEEE 10000000000 Compu_IDENTITY -10000000000 10000000000 PHYS_UNIT "ms" /end CHARACTERISTIC
/begin CHARACTERISTIC FPfu_BstTIP_Lo "FPrm_unlatch(104)" VALUE 0x001E0D00 /* @ECU_Address@FPrm_unlatch@0x021BD1A0@ */ ECIPP_ALIGNMENT_FLOAT32_IEEE 10000000000 Compu_IDENTITY -10000000000 10000000000 PHYS_UNIT "ms" /end CHARACTERISTIC
/begin CHARACTERISTIC FPfu_BstTIP_Lo2 "FPrm_unlatch(516)" VALUE 0x001E1370 /* @ECU_Address@FPrm_unlatch@0x021BD810@ */ ECIPP_ALIGNMENT_FLOAT32_IEEE 10000000000 Compu_IDENTITY -10000000000 10000000000 PHYS_UNIT "ms" /end CHARACTERISTIC
/begin CHARACTERISTIC FPfu_BstTIP_slow "FPrm_unlatch(485)" VALUE 0x001E12F4 /* @ECU_Address@FPrm_unlatch@0x021BD794@ */ ECIPP_ALIGNMENT_FLOAT32_IEEE 10000000000 Compu_IDENTITY -10000000000 10000000000 PHYS_UNIT "ms" /end CHARACTERISTIC
/begin CHARACTERISTIC FPfu_buzz_coilopen "FPrm_unlatch(125)" VALUE 0x001E0D54 /* @ECU_Address@FPrm_unlatch@0x021BD1F4@ */ ECIPP_ALIGNMENT_FLOAT32_IEEE 10000000000 Compu_IDENTITY -10000000000 10000000000 PHYS_UNIT "samples" /end CHARACTERISTIC
/begin CHARACTERISTIC FPfu_buzz_coilshort "FPrm_unlatch(126)" VALUE 0x001E0D58 /* @ECU_Address@FPrm_unlatch@0x021BD1F8@ */ ECIPP_ALIGNMENT_FLOAT32_IEEE 10000000000 Compu_IDENTITY -10000000000 10000000000 PHYS_UNIT "samples" /end CHARACTERISTIC
/begin CHARACTERISTIC FPfu_buzz_gndshort "FPrm_unlatch(124)" VALUE 0x001E0D50 /* @ECU_Address@FPrm_unlatch@0x021BD1F0@ */ ECIPP_ALIGNMENT_FLOAT32_IEEE 10000000000 Compu_IDENTITY -10000000000 10000000000 PHYS_UNIT "samples" /end CHARACTERISTIC
/begin CHARACTERISTIC FPfu_CAC_eta_lo "FPrm_unlatch(486)" VALUE 0x001E12F8 /* @ECU_Address@FPrm_unlatch@0x021BD798@ */ ECIPP_ALIGNMENT_FLOAT32_IEEE 10000000000 Compu_IDENTITY -10000000000 10000000000 PHYS_UNIT "ms" /end CHARACTERISTIC
/begin CHARACTERISTIC FPfu_cal_config "FPrm_unlatch(228)" VALUE 0x001E0EF0 /* @ECU_Address@FPrm_unlatch@0x021BD390@ */ ECIPP_ALIGNMENT_FLOAT32_IEEE 10000000000 Compu_IDENTITY -10000000000 10000000000 PHYS_UNIT "ms" /end CHARACTERISTIC
/begin CHARACTERISTIC FPfu_cam2loss "FPrm_unlatch(520)" VALUE 0x001E1380 /* @ECU_Address@FPrm_unlatch@0x021BD820@ */ ECIPP_ALIGNMENT_FLOAT32_IEEE 10000000000 Compu_IDENTITY -10000000000 10000000000 PHYS_UNIT "ms" /end CHARACTERISTIC
/begin CHARACTERISTIC FPfu_camloss "FPrm_unlatch(59)" VALUE 0x001E0C4C /* @ECU_Address@FPrm_unlatch@0x021BD0EC@ */ ECIPP_ALIGNMENT_FLOAT32_IEEE 10000000000 Compu_IDENTITY -10000000000 10000000000 PHYS_UNIT "ms" /end CHARACTERISTIC
/begin CHARACTERISTIC FPfu_camnoise "FPrm_unlatch(60)" VALUE 0x001E0C50 /* @ECU_Address@FPrm_unlatch@0x021BD0F0@ */ ECIPP_ALIGNMENT_FLOAT32_IEEE 10000000000 Compu_IDENTITY -10000000000 10000000000 PHYS_UNIT "ms" /end CHARACTERISTIC
/begin CHARACTERISTIC FPfu_CATdP_hi "FPrm_unlatch(396)" VALUE 0x001E1190 /* @ECU_Address@FPrm_unlatch@0x021BD630@ */ ECIPP_ALIGNMENT_FLOAT32_IEEE 10000000000 Compu_IDENTITY -10000000000 10000000000 PHYS_UNIT "ms" /end CHARACTERISTIC
/begin CHARACTERISTIC FPfu_CATdP_lo "FPrm_unlatch(395)" VALUE 0x001E118C /* @ECU_Address@FPrm_unlatch@0x021BD62C@ */ ECIPP_ALIGNMENT_FLOAT32_IEEE 10000000000 Compu_IDENTITY -10000000000 10000000000 PHYS_UNIT "ms" /end CHARACTERISTIC
/begin CHARACTERISTIC FPfu_CATout_OOR "FPrm_unlatch(658)" VALUE 0x001E15A8 /* @ECU_Address@FPrm_unlatch@0x021BDA48@ */ ECIPP_ALIGNMENT_FLOAT32_IEEE 10000000000 Compu_IDENTITY -10000000000 10000000000 PHYS_UNIT "ms" /end CHARACTERISTIC
/begin CHARACTERISTIC FPfu_CD_MF1 "FPrm_unlatch(710)" VALUE 0x001E1678 /* @ECU_Address@FPrm_unlatch@0x021BDB18@ */ ECIPP_ALIGNMENT_FLOAT32_IEEE 10000000000 Compu_IDENTITY -10000000000 10000000000 PHYS_UNIT "sparks" /end CHARACTERISTIC
/begin CHARACTERISTIC FPfu_CFV_FP_minv "FPrm_unlatch(517)" VALUE 0x001E1374 /* @ECU_Address@FPrm_unlatch@0x021BD814@ */ ECIPP_ALIGNMENT_FLOAT32_IEEE 10000000000 Compu_IDENTITY -10000000000 10000000000 PHYS_UNIT "ms" /end CHARACTERISTIC
/begin CHARACTERISTIC FPfu_CFV_FT_maxv "FPrm_unlatch(518)" VALUE 0x001E1378 /* @ECU_Address@FPrm_unlatch@0x021BD818@ */ ECIPP_ALIGNMENT_FLOAT32_IEEE 10000000000 Compu_IDENTITY -10000000000 10000000000 PHYS_UNIT "ms" /end CHARACTERISTIC
/begin CHARACTERISTIC FPfu_CFV_FT_minv "FPrm_unlatch(519)" VALUE 0x001E137C /* @ECU_Address@FPrm_unlatch@0x021BD81C@ */ ECIPP_ALIGNMENT_FLOAT32_IEEE 10000000000 Compu_IDENTITY -10000000000 10000000000 PHYS_UNIT "ms" /end CHARACTERISTIC
/begin CHARACTERISTIC FPfu_CFV_mdot_hi "FPrm_unlatch(393)" VALUE 0x001E1184 /* @ECU_Address@FPrm_unlatch@0x021BD624@ */ ECIPP_ALIGNMENT_FLOAT32_IEEE 10000000000 Compu_IDENTITY -10000000000 10000000000 PHYS_UNIT "ms" /end CHARACTERISTIC
/begin CHARACTERISTIC FPfu_CFV_mdot_lo "FPrm_unlatch(394)" VALUE 0x001E1188 /* @ECU_Address@FPrm_unlatch@0x021BD628@ */ ECIPP_ALIGNMENT_FLOAT32_IEEE 10000000000 Compu_IDENTITY -10000000000 10000000000 PHYS_UNIT "ms" /end CHARACTERISTIC
/begin CHARACTERISTIC FPfu_CFV_mdot_rms_hi "FPrm_unlatch(509)" VALUE 0x001E1354 /* @ECU_Address@FPrm_unlatch@0x021BD7F4@ */ ECIPP_ALIGNMENT_FLOAT32_IEEE 10000000000 Compu_IDENTITY -10000000000 10000000000 PHYS_UNIT "ms" /end CHARACTERISTIC
/begin CHARACTERISTIC FPfu_CFV_pwr_loss "FPrm_unlatch(657)" VALUE 0x001E15A4 /* @ECU_Address@FPrm_unlatch@0x021BDA44@ */ ECIPP_ALIGNMENT_FLOAT32_IEEE 10000000000 Compu_IDENTITY -10000000000 10000000000 PHYS_UNIT "ms" /end CHARACTERISTIC
/begin CHARACTERISTIC FPfu_CFV_RLV_fail "FPrm_unlatch(405)" VALUE 0x001E11B4 /* @ECU_Address@FPrm_unlatch@0x021BD654@ */ ECIPP_ALIGNMENT_FLOAT32_IEEE 10000000000 Compu_IDENTITY -10000000000 10000000000 PHYS_UNIT "none" /end CHARACTERISTIC
/begin CHARACTERISTIC FPfu_CFV_RLV_P_min "FPrm_unlatch(404)" VALUE 0x001E11B0 /* @ECU_Address@FPrm_unlatch@0x021BD650@ */ ECIPP_ALIGNMENT_FLOAT32_IEEE 10000000000 Compu_IDENTITY -10000000000 10000000000 PHYS_UNIT "updates" /end CHARACTERISTIC
/begin CHARACTERISTIC FPfu_CHT_HiExp "FPrm_unlatch(73)" VALUE 0x001E0C84 /* @ECU_Address@FPrm_unlatch@0x021BD124@ */ ECIPP_ALIGNMENT_FLOAT32_IEEE 10000000000 Compu_IDENTITY -10000000000 10000000000 PHYS_UNIT "ms" /end CHARACTERISTIC
/begin CHARACTERISTIC FPfu_CHT_HiExp2 "FPrm_unlatch(74)" VALUE 0x001E0C88 /* @ECU_Address@FPrm_unlatch@0x021BD128@ */ ECIPP_ALIGNMENT_FLOAT32_IEEE 10000000000 Compu_IDENTITY -10000000000 10000000000 PHYS_UNIT "ms" /end CHARACTERISTIC
/begin CHARACTERISTIC FPfu_CL_hi "FPrm_unlatch(47)" VALUE 0x001E0C1C /* @ECU_Address@FPrm_unlatch@0x021BD0BC@ */ ECIPP_ALIGNMENT_FLOAT32_IEEE 10000000000 Compu_IDENTITY -10000000000 10000000000 PHYS_UNIT "updates" /end CHARACTERISTIC
/begin CHARACTERISTIC FPfu_CL_lo "FPrm_unlatch(48)" VALUE 0x001E0C20 /* @ECU_Address@FPrm_unlatch@0x021BD0C0@ */ ECIPP_ALIGNMENT_FLOAT32_IEEE 10000000000 Compu_IDENTITY -10000000000 10000000000 PHYS_UNIT "updates" /end CHARACTERISTIC
/begin GROUP APUD2_max_EC_Fault "AUX analog Pull-Up/Down 2 high voltage"
 /begin REF_CHARACTERISTIC FCdc4_APUD2_max FCdtc_APUD2_max FCfmi_APUD2_max FCftb_APUD2_max FCspn_APUD2_max FPfl_APUD2_max FPfu_APUD2_max FPnd_APUD2_max FPsvr_APUD2_max FPsw_ext1_APUD2_max FPsw_APUD2_max /end REF_CHARACTERISTIC
/end GROUP
/begin GROUP APUD2_min_EC_Fault "AUX analog Pull-Up/Down 2 low voltage"
 /begin REF_CHARACTERISTIC FCdc4_APUD2_min FCdtc_APUD2_min FCfmi_APUD2_min FCftb_APUD2_min FCspn_APUD2_min FPfl_APUD2_min FPfu_APUD2_min FPnd_APUD2_min FPsvr_APUD2_min FPsw_ext1_APUD2_min FPsw_APUD2_min /end REF_CHARACTERISTIC
/end GROUP
/begin GROUP APUD20_max_EC_Fault "AUX analog Pull-Up/Down 20 high voltage"
 /begin REF_CHARACTERISTIC FCdc4_APUD20_max FCdtc_APUD20_max FCfmi_APUD20_max FCftb_APUD20_max FCspn_APUD20_max FPfl_APUD20_max FPfu_APUD20_max FPnd_APUD20_max FPsvr_APUD20_max FPsw_ext1_APUD20_max FPsw_APUD20_max /end REF_CHARACTERISTIC
/end GROUP
/begin GROUP APUD20_min_EC_Fault "AUX analog Pull-Up/Down 20 low voltage"
 /begin REF_CHARACTERISTIC FCdc4_APUD20_min FCdtc_APUD20_min FCfmi_APUD20_min FCftb_APUD20_min FCspn_APUD20_min FPfl_APUD20_min FPfu_APUD20_min FPnd_APUD20_min FPsvr_APUD20_min FPsw_ext1_APUD20_min FPsw_APUD20_min /end REF_CHARACTERISTIC
/end GROUP
/begin GROUP APUD21_max_EC_Fault "AUX analog Pull-Up/Down 21 high voltage"
 /begin REF_CHARACTERISTIC FCdc4_APUD21_max FCdtc_APUD21_max FCfmi_APUD21_max FCftb_APUD21_max FCspn_APUD21_max FPfl_APUD21_max FPfu_APUD21_max FPnd_APUD21_max FPsvr_APUD21_max FPsw_ext1_APUD21_max FPsw_APUD21_max /end REF_CHARACTERISTIC
/end GROUP
/begin GROUP APUD21_min_EC_Fault "AUX analog Pull-Up/Down 21 low voltage"
 /begin REF_CHARACTERISTIC FCdc4_APUD21_min FCdtc_APUD21_min FCfmi_APUD21_min FCftb_APUD21_min FCspn_APUD21_min FPfl_APUD21_min FPfu_APUD21_min FPnd_APUD21_min FPsvr_APUD21_min FPsw_ext1_APUD21_min FPsw_APUD21_min /end REF_CHARACTERISTIC
/end GROUP
/begin GROUP APUD22_max_EC_Fault "AUX analog Pull-Up/Down 22 high voltage"
 /begin REF_CHARACTERISTIC FCdc4_APUD22_max FCdtc_APUD22_max FCfmi_APUD22_max FCftb_APUD22_max FCspn_APUD22_max FPfl_APUD22_max FPfu_APUD22_max FPnd_APUD22_max FPsvr_APUD22_max FPsw_ext1_APUD22_max FPsw_APUD22_max /end REF_CHARACTERISTIC
/end GROUP
/begin GROUP APUD22_min_EC_Fault "AUX analog Pull-Up/Down 22 low voltage"
 /begin REF_CHARACTERISTIC FCdc4_APUD22_min FCdtc_APUD22_min FCfmi_APUD22_min FCftb_APUD22_min FCspn_APUD22_min FPfl_APUD22_min FPfu_APUD22_min FPnd_APUD22_min FPsvr_APUD22_min FPsw_ext1_APUD22_min FPsw_APUD22_min /end REF_CHARACTERISTIC
/end GROUP
/begin GROUP APUD23_max_EC_Fault "AUX analog Pull-Up/Down 23 high voltage"
 /begin REF_CHARACTERISTIC FCdc4_APUD23_max FCdtc_APUD23_max FCfmi_APUD23_max FCftb_APUD23_max FCspn_APUD23_max FPfl_APUD23_max FPfu_APUD23_max FPnd_APUD23_max FPsvr_APUD23_max FPsw_ext1_APUD23_max FPsw_APUD23_max /end REF_CHARACTERISTIC
/end GROUP
/begin GROUP APUD23_min_EC_Fault "AUX analog Pull-Up/Down 23 low voltage"
 /begin REF_CHARACTERISTIC FCdc4_APUD23_min FCdtc_APUD23_min FCfmi_APUD23_min FCftb_APUD23_min FCspn_APUD23_min FPfl_APUD23_min FPfu_APUD23_min FPnd_APUD23_min FPsvr_APUD23_min FPsw_ext1_APUD23_min FPsw_APUD23_min /end REF_CHARACTERISTIC
/end GROUP
/begin GROUP APUD24_max_EC_Fault "AUX analog Pull-Up/Down 24 high voltage"
 /begin REF_CHARACTERISTIC FCdc4_APUD24_max FCdtc_APUD24_max FCfmi_APUD24_max FCftb_APUD24_max FCspn_APUD24_max FPfl_APUD24_max FPfu_APUD24_max FPnd_APUD24_max FPsvr_APUD24_max FPsw_ext1_APUD24_max FPsw_APUD24_max /end REF_CHARACTERISTIC
/end GROUP
/begin GROUP APUD24_min_EC_Fault "AUX analog Pull-Up/Down 24 low voltage"
 /begin REF_CHARACTERISTIC FCdc4_APUD24_min FCdtc_APUD24_min FCfmi_APUD24_min FCftb_APUD24_min FCspn_APUD24_min FPfl_APUD24_min FPfu_APUD24_min FPnd_APUD24_min FPsvr_APUD24_min FPsw_ext1_APUD24_min FPsw_APUD24_min /end REF_CHARACTERISTIC
/end GROUP
/begin GROUP APUD25_max_EC_Fault "AUX analog Pull-Up/Down 25 high voltage"
 /begin REF_CHARACTERISTIC FCdc4_APUD25_max FCdtc_APUD25_max FCfmi_APUD25_max FCftb_APUD25_max FCspn_APUD25_max FPfl_APUD25_max FPfu_APUD25_max FPnd_APUD25_max FPsvr_APUD25_max FPsw_ext1_APUD25_max FPsw_APUD25_max /end REF_CHARACTERISTIC
/end GROUP
/begin GROUP APUD25_min_EC_Fault "AUX analog Pull-Up/Down 25 low voltage"
 /begin REF_CHARACTERISTIC FCdc4_APUD25_min FCdtc_APUD25_min FCfmi_APUD25_min FCftb_APUD25_min FCspn_APUD25_min FPfl_APUD25_min FPfu_APUD25_min FPnd_APUD25_min FPsvr_APUD25_min FPsw_ext1_APUD25_min FPsw_APUD25_min /end REF_CHARACTERISTIC
/end GROUP
/begin GROUP APUD3_max_EC_Fault "AUX analog Pull-Up/Down 3 high voltage"
 /begin REF_CHARACTERISTIC FCdc4_APUD3_max FCdtc_APUD3_max FCfmi_APUD3_max FCftb_APUD3_max FCspn_APUD3_max FPfl_APUD3_max FPfu_APUD3_max FPnd_APUD3_max FPsvr_APUD3_max FPsw_ext1_APUD3_max FPsw_APUD3_max /end REF_CHARACTERISTIC
/end GROUP
/begin GROUP APUD3_min_EC_Fault "AUX analog Pull-Up/Down 3 low voltage"
 /begin REF_CHARACTERISTIC FCdc4_APUD3_min FCdtc_APUD3_min FCfmi_APUD3_min FCftb_APUD3_min FCspn_APUD3_min FPfl_APUD3_min FPfu_APUD3_min FPnd_APUD3_min FPsvr_APUD3_min FPsw_ext1_APUD3_min FPsw_APUD3_min /end REF_CHARACTERISTIC
/end GROUP
/begin GROUP APUD4_max_EC_Fault "AUX analog Pull-Up/Down 4 high voltage"
 /begin REF_CHARACTERISTIC FCdc4_APUD4_max FCdtc_APUD4_max FCfmi_APUD4_max FCftb_APUD4_max FCspn_APUD4_max FPfl_APUD4_max FPfu_APUD4_max FPnd_APUD4_max FPsvr_APUD4_max FPsw_ext1_APUD4_max FPsw_APUD4_max /end REF_CHARACTERISTIC
/end GROUP
/begin GROUP APUD4_min_EC_Fault "AUX analog Pull-Up/Down 4 low voltage"
 /begin REF_CHARACTERISTIC FCdc4_APUD4_min FCdtc_APUD4_min FCfmi_APUD4_min FCftb_APUD4_min FCspn_APUD4_min FPfl_APUD4_min FPfu_APUD4_min FPnd_APUD4_min FPsvr_APUD4_min FPsw_ext1_APUD4_min FPsw_APUD4_min /end REF_CHARACTERISTIC
/end GROUP
/begin GROUP APUD5_max_EC_Fault "AUX analog Pull-Up/Down 5 high voltage"
 /begin REF_CHARACTERISTIC FCdc4_APUD5_max FCdtc_APUD5_max FCfmi_APUD5_max FCftb_APUD5_max FCspn_APUD5_max FPfl_APUD5_max FPfu_APUD5_max FPnd_APUD5_max FPsvr_APUD5_max FPsw_ext1_APUD5_max FPsw_APUD5_max /end REF_CHARACTERISTIC
/end GROUP
/begin GROUP APUD5_min_EC_Fault "AUX analog Pull-Up/Down 5 low voltage"
 /begin REF_CHARACTERISTIC FCdc4_APUD5_min FCdtc_APUD5_min FCfmi_APUD5_min FCftb_APUD5_min FCspn_APUD5_min FPfl_APUD5_min FPfu_APUD5_min FPnd_APUD5_min FPsvr_APUD5_min FPsw_ext1_APUD5_min FPsw_APUD5_min /end REF_CHARACTERISTIC
/end GROUP
/begin GROUP APUD6_max_EC_Fault "AUX analog Pull-Up/Down 6 high voltage"
 /begin REF_CHARACTERISTIC FCdc4_APUD6_max FCdtc_APUD6_max FCfmi_APUD6_max FCftb_APUD6_max FCspn_APUD6_max FPfl_APUD6_max FPfu_APUD6_max FPnd_APUD6_max FPsvr_APUD6_max FPsw_ext1_APUD6_max FPsw_APUD6_max /end REF_CHARACTERISTIC
/end GROUP
/begin GROUP APUD6_min_EC_Fault "AUX analog Pull-Up/Down 6 low voltage"
 /begin REF_CHARACTERISTIC FCdc4_APUD6_min FCdtc_APUD6_min FCfmi_APUD6_min FCftb_APUD6_min FCspn_APUD6_min FPfl_APUD6_min FPfu_APUD6_min FPnd_APUD6_min FPsvr_APUD6_min FPsw_ext1_APUD6_min FPsw_APUD6_min /end REF_CHARACTERISTIC
/end GROUP
/begin GROUP APUD7_max_EC_Fault "AUX analog Pull-Up/Down 7 high voltage"
 /begin REF_CHARACTERISTIC FCdc4_APUD7_max FCdtc_APUD7_max FCfmi_APUD7_max FCftb_APUD7_max FCspn_APUD7_max FPfl_APUD7_max FPfu_APUD7_max FPnd_APUD7_max FPsvr_APUD7_max FPsw_ext1_APUD7_max FPsw_APUD7_max /end REF_CHARACTERISTIC
/end GROUP
/begin GROUP APUD7_min_EC_Fault "AUX analog Pull-Up/Down 7 low voltage"
 /begin REF_CHARACTERISTIC FCdc4_APUD7_min FCdtc_APUD7_min FCfmi_APUD7_min FCftb_APUD7_min FCspn_APUD7_min FPfl_APUD7_min FPfu_APUD7_min FPnd_APUD7_min FPsvr_APUD7_min FPsw_ext1_APUD7_min FPsw_APUD7_min /end REF_CHARACTERISTIC
/end GROUP
/begin GROUP APUD8_max_EC_Fault "AUX analog Pull-Up/Down 8 high voltage"
 /begin REF_CHARACTERISTIC FCdc4_APUD8_max FCdtc_APUD8_max FCfmi_APUD8_max FCftb_APUD8_max FCspn_APUD8_max FPfl_APUD8_max FPfu_APUD8_max FPnd_APUD8_max FPsvr_APUD8_max FPsw_ext1_APUD8_max FPsw_APUD8_max /end REF_CHARACTERISTIC
/end GROUP
/begin GROUP APUD8_min_EC_Fault "AUX analog Pull-Up/Down 8 low voltage"
 /begin REF_CHARACTERISTIC FCdc4_APUD8_min FCdtc_APUD8_min FCfmi_APUD8_min FCftb_APUD8_min FCspn_APUD8_min FPfl_APUD8_min FPfu_APUD8_min FPnd_APUD8_min FPsvr_APUD8_min FPsw_ext1_APUD8_min FPsw_APUD8_min /end REF_CHARACTERISTIC
/end GROUP
/begin GROUP APUD9_max_EC_Fault "AUX analog Pull-Up/Down 9 high voltage"
 /begin REF_CHARACTERISTIC FCdc4_APUD9_max FCdtc_APUD9_max FCfmi_APUD9_max FCftb_APUD9_max FCspn_APUD9_max FPfl_APUD9_max FPfu_APUD9_max FPnd_APUD9_max FPsvr_APUD9_max FPsw_ext1_APUD9_max FPsw_APUD9_max /end REF_CHARACTERISTIC
/end GROUP
/begin GROUP APUD9_min_EC_Fault "AUX analog Pull-Up/Down 9 low voltage"
 /begin REF_CHARACTERISTIC FCdc4_APUD9_min FCdtc_APUD9_min FCfmi_APUD9_min FCftb_APUD9_min FCspn_APUD9_min FPfl_APUD9_min FPfu_APUD9_min FPnd_APUD9_min FPsvr_APUD9_min FPsw_ext1_APUD9_min FPsw_APUD9_min /end REF_CHARACTERISTIC
/end GROUP
/begin GROUP AWP_intF_EC_Fault "Auxiliary water pump internal fault detection"
 /begin REF_CHARACTERISTIC FCdc4_AWP_intF FCdtc_AWP_intF FCfmi_AWP_intF FCftb_AWP_intF FCspn_AWP_intF FPfl_AWP_intF FPfu_AWP_intF FPnd_AWP_intF FPsvr_AWP_intF FPsw_ext1_AWP_intF FPsw_AWP_intF /end REF_CHARACTERISTIC
/end GROUP
/begin GROUP BP_max_EC_Fault "BP high pressure"
 /begin REF_CHARACTERISTIC FCdc4_BP_max FCdtc_BP_max FCfmi_BP_max FCftb_BP_max FCspn_BP_max FPfl_BP_max FPfu_BP_max FPnd_BP_max FPsvr_BP_max FPsw_ext1_BP_max FPsw_BP_max /end REF_CHARACTERISTIC
/end GROUP
/begin GROUP BP_min_EC_Fault "BP low pressure"
 /begin REF_CHARACTERISTIC FCdc4_BP_min FCdtc_BP_min FCfmi_BP_min FCftb_BP_min FCspn_BP_min FPfl_BP_min FPfu_BP_min FPnd_BP_min FPsvr_BP_min FPsw_ext1_BP_min FPsw_BP_min /end REF_CHARACTERISTIC
/end GROUP
/begin GROUP BPS1_max_EC_Fault "BPS1 high voltage"
 /begin REF_CHARACTERISTIC FCdc4_BPS1_max FCdtc_BPS1_max FCfmi_BPS1_max FCftb_BPS1_max FCspn_BPS1_max FPfl_BPS1_max FPfu_BPS1_max FPnd_BPS1_max FPsvr_BPS1_max FPsw_ext1_BPS1_max FPsw_BPS1_max /end REF_CHARACTERISTIC
/end GROUP
/begin GROUP BPS1_min_EC_Fault "BPS1 low voltage"
 /begin REF_CHARACTERISTIC FCdc4_BPS1_min FCdtc_BPS1_min FCfmi_BPS1_min FCftb_BPS1_min FCspn_BPS1_min FPfl_BPS1_min FPfu_BPS1_min FPnd_BPS1_min FPsvr_BPS1_min FPsw_ext1_BPS1_min FPsw_BPS1_min /end REF_CHARACTERISTIC
/end GROUP
/begin GROUP BPS12_OOR_EC_Fault "BPS1/2 simultaneous voltages"
 /begin REF_CHARACTERISTIC FCdc4_BPS12_OOR FCdtc_BPS12_OOR FCfmi_BPS12_OOR FCftb_BPS12_OOR FCspn_BPS12_OOR FPfl_BPS12_OOR FPfu_BPS12_OOR FPnd_BPS12_OOR FPsvr_BPS12_OOR FPsw_ext1_BPS12_OOR FPsw_BPS12_OOR /end REF_CHARACTERISTIC
/end GROUP
/begin GROUP BPS12pct_hi_EC_Fault "BPS1 higher than BPS2"
 /begin REF_CHARACTERISTIC FCdc4_BPS12pct_hi FCdtc_BPS12pct_hi FCfmi_BPS12pct_hi FCftb_BPS12pct_hi FCspn_BPS12pct_hi FPfl_BPS12pct_hi FPfu_BPS12pct_hi FPnd_BPS12pct_hi FPsvr_BPS12pct_hi FPsw_ext1_BPS12pct_hi FPsw_BPS12pct_hi /end REF_CHARACTERISTIC
/end GROUP
/begin GROUP BPS12pct_lo_EC_Fault "BPS1 lower than BPS2"
 /begin REF_CHARACTERISTIC FCdc4_BPS12pct_lo FCdtc_BPS12pct_lo FCfmi_BPS12pct_lo FCftb_BPS12pct_lo FCspn_BPS12pct_lo FPfl_BPS12pct_lo FPfu_BPS12pct_lo FPnd_BPS12pct_lo FPsvr_BPS12pct_lo FPsw_ext1_BPS12pct_lo FPsw_BPS12pct_lo /end REF_CHARACTERISTIC
/end GROUP
/begin GROUP BPS2_max_EC_Fault "BPS2 high voltage"
 /begin REF_CHARACTERISTIC FCdc4_BPS2_max FCdtc_BPS2_max FCfmi_BPS2_max FCftb_BPS2_max FCspn_BPS2_max FPfl_BPS2_max FPfu_BPS2_max FPnd_BPS2_max FPsvr_BPS2_max FPsw_ext1_BPS2_max FPsw_BPS2_max /end REF_CHARACTERISTIC
/end GROUP
/begin GROUP BPS2_min_EC_Fault "BPS2 low voltage"
 /begin REF_CHARACTERISTIC FCdc4_BPS2_min FCdtc_BPS2_min FCfmi_BPS2_min FCftb_BPS2_min FCspn_BPS2_min FPfl_BPS2_min FPfu_BPS2_min FPnd_BPS2_min FPsvr_BPS2_min FPsw_ext1_BPS2_min FPsw_BPS2_min /end REF_CHARACTERISTIC
/end GROUP
/begin GROUP BPSerr_neg_EC_Fault "Unable to reach lower BPS"
 /begin REF_CHARACTERISTIC FCdc4_BPSerr_neg FCdtc_BPSerr_neg FCfmi_BPSerr_neg FCftb_BPSerr_neg FCspn_BPSerr_neg FPfl_BPSerr_neg FPfu_BPSerr_neg FPnd_BPSerr_neg FPsvr_BPSerr_neg FPsw_ext1_BPSerr_neg FPsw_BPSerr_neg /end REF_CHARACTERISTIC
/end GROUP
/begin GROUP BPSerr_pos_EC_Fault "Unable to reach higher BPS"
 /begin REF_CHARACTERISTIC FCdc4_BPSerr_pos FCdtc_BPSerr_pos FCfmi_BPSerr_pos FCftb_BPSerr_pos FCspn_BPSerr_pos FPfl_BPSerr_pos FPfu_BPSerr_pos FPnd_BPSerr_pos FPsvr_BPSerr_pos FPsw_ext1_BPSerr_pos FPsw_BPSerr_pos /end REF_CHARACTERISTIC
/end GROUP
/begin GROUP brake_gndshort_EC_Fault "Brake output open / ground short"
 /begin REF_CHARACTERISTIC FCdc4_brake_gndshort FCdtc_brake_gndshort FCfmi_brake_gndshort FCftb_brake_gndshort FCspn_brake_gndshort FPfl_brake_gndshort FPfu_brake_gndshort FPnd_brake_gndshort FPsvr_brake_gndshort FPsw_ext1_brake_gndshort FPsw_brake_gndshort /end REF_CHARACTERISTIC
/end GROUP
/begin GROUP brake_pwrshort_EC_Fault "Brake output short to power"
 /begin REF_CHARACTERISTIC FCdc4_brake_pwrshort FCdtc_brake_pwrshort FCfmi_brake_pwrshort FCftb_brake_pwrshort FCspn_brake_pwrshort FPfl_brake_pwrshort FPfu_brake_pwrshort FPnd_brake_pwrshort FPsvr_brake_pwrshort FPsw_ext1_brake_pwrshort FPsw_brake_pwrshort /end REF_CHARACTERISTIC
/end GROUP
/begin GROUP bst_MAT_derate_actv_EC_Fault "Boost target MAT derate active"
 /begin REF_CHARACTERISTIC FCdc4_bst_MAT_derate_actv FCdtc_bst_MAT_derate_actv FCfmi_bst_MAT_derate_actv FCftb_bst_MAT_derate_actv FCspn_bst_MAT_derate_actv FPfl_bst_MAT_derate_actv FPfu_bst_MAT_derate_actv FPnd_bst_MAT_derate_actv FPsvr_bst_MAT_derate_actv FPsw_ext1_bst_MAT_derate_actv FPsw_bst_MAT_derate_actv /end REF_CHARACTERISTIC
/end GROUP
/begin GROUP BstTIP_Hi_EC_Fault "Control overboost"
 /begin REF_CHARACTERISTIC FCdc4_BstTIP_Hi FCdtc_BstTIP_Hi FCfmi_BstTIP_Hi FCftb_BstTIP_Hi FCspn_BstTIP_Hi FPfl_BstTIP_Hi FPfu_BstTIP_Hi FPnd_BstTIP_Hi FPsvr_BstTIP_Hi FPsw_ext1_BstTIP_Hi FPsw_BstTIP_Hi /end REF_CHARACTERISTIC
/end GROUP
/begin GROUP BstTIP_Lo_EC_Fault "Control underboost 1"
 /begin REF_CHARACTERISTIC FCdc4_BstTIP_Lo FCdtc_BstTIP_Lo FCfmi_BstTIP_Lo FCftb_BstTIP_Lo FCspn_BstTIP_Lo FPfl_BstTIP_Lo FPfu_BstTIP_Lo FPnd_BstTIP_Lo FPsvr_BstTIP_Lo FPsw_ext1_BstTIP_Lo FPsw_BstTIP_Lo /end REF_CHARACTERISTIC
/end GROUP
/begin GROUP BstTIP_Lo2_EC_Fault "Control underboost 2"
 /begin REF_CHARACTERISTIC FCdc4_BstTIP_Lo2 FCdtc_BstTIP_Lo2 FCfmi_BstTIP_Lo2 FCftb_BstTIP_Lo2 FCspn_BstTIP_Lo2 FPfl_BstTIP_Lo2 FPfu_BstTIP_Lo2 FPnd_BstTIP_Lo2 FPsvr_BstTIP_Lo2 FPsw_ext1_BstTIP_Lo2 FPsw_BstTIP_Lo2 /end REF_CHARACTERISTIC
/end GROUP
/begin GROUP BstTIP_slow_EC_Fault "Boost control slow to respond"
 /begin REF_CHARACTERISTIC FCdc4_BstTIP_slow FCdtc_BstTIP_slow FCfmi_BstTIP_slow FCftb_BstTIP_slow FCspn_BstTIP_slow FPfl_BstTIP_slow FPfu_BstTIP_slow FPnd_BstTIP_slow FPsvr_BstTIP_slow FPsw_ext1_BstTIP_slow FPsw_BstTIP_slow /end REF_CHARACTERISTIC
/end GROUP
/begin GROUP buzz_coilopen_EC_Fault "Buzzer open"
 /begin REF_CHARACTERISTIC FCdc4_buzz_coilopen FCdtc_buzz_coilopen FCfmi_buzz_coilopen FCftb_buzz_coilopen FCspn_buzz_coilopen FPfl_buzz_coilopen FPfu_buzz_coilopen FPnd_buzz_coilopen FPsvr_buzz_coilopen FPsw_ext1_buzz_coilopen FPsw_buzz_coilopen /end REF_CHARACTERISTIC
/end GROUP
/begin GROUP buzz_coilshort_EC_Fault "Buzzer control short to power"
 /begin REF_CHARACTERISTIC FCdc4_buzz_coilshort FCdtc_buzz_coilshort FCfmi_buzz_coilshort FCftb_buzz_coilshort FCspn_buzz_coilshort FPfl_buzz_coilshort FPfu_buzz_coilshort FPnd_buzz_coilshort FPsvr_buzz_coilshort FPsw_ext1_buzz_coilshort FPsw_buzz_coilshort /end REF_CHARACTERISTIC
/end GROUP
/begin GROUP buzz_gndshort_EC_Fault "Buzzer control ground short"
 /begin REF_CHARACTERISTIC FCdc4_buzz_gndshort FCdtc_buzz_gndshort FCfmi_buzz_gndshort FCftb_buzz_gndshort FCspn_buzz_gndshort FPfl_buzz_gndshort FPfu_buzz_gndshort FPnd_buzz_gndshort FPsvr_buzz_gndshort FPsw_ext1_buzz_gndshort FPsw_buzz_gndshort /end REF_CHARACTERISTIC
/end GROUP
/begin GROUP CAC_eta_lo_EC_Fault "CAC efficiency lower than expected"
 /begin REF_CHARACTERISTIC FCdc4_CAC_eta_lo FCdtc_CAC_eta_lo FCfmi_CAC_eta_lo FCftb_CAC_eta_lo FCspn_CAC_eta_lo FPfl_CAC_eta_lo FPfu_CAC_eta_lo FPnd_CAC_eta_lo FPsvr_CAC_eta_lo FPsw_ext1_CAC_eta_lo FPsw_CAC_eta_lo /end REF_CHARACTERISTIC
/end GROUP
/begin GROUP cal_config_EC_Fault "Calibration Configuration Error"
 /begin REF_CHARACTERISTIC FCdc4_cal_config FCdtc_cal_config FCfmi_cal_config FCftb_cal_config FCspn_cal_config FPfl_cal_config FPfu_cal_config FPnd_cal_config FPsvr_cal_config FPsw_ext1_cal_config FPsw_cal_config /end REF_CHARACTERISTIC
/end GROUP
/begin GROUP cam2loss_EC_Fault "Cam2 loss (exhaust)"
 /begin REF_CHARACTERISTIC FCdc4_cam2loss FCdtc_cam2loss FCfmi_cam2loss FCftb_cam2loss FCspn_cam2loss FPfl_cam2loss FPfu_cam2loss FPnd_cam2loss FPsvr_cam2loss FPsw_ext1_cam2loss FPsw_cam2loss /end REF_CHARACTERISTIC
/end GROUP
/begin GROUP camloss_EC_Fault "Cam1 loss (intake)"
 /begin REF_CHARACTERISTIC FCdc4_camloss FCdtc_camloss FCfmi_camloss FCftb_camloss FCspn_camloss FPfl_camloss FPfu_camloss FPnd_camloss FPsvr_camloss FPsw_ext1_camloss FPsw_camloss /end REF_CHARACTERISTIC
/end GROUP
/begin GROUP camnoise_EC_Fault "Cam sync noise"
 /begin REF_CHARACTERISTIC FCdc4_camnoise FCdtc_camnoise FCfmi_camnoise FCftb_camnoise FCspn_camnoise FPfl_camnoise FPfu_camnoise FPnd_camnoise FPsvr_camnoise FPsw_ext1_camnoise FPsw_camnoise /end REF_CHARACTERISTIC
/end GROUP
/begin GROUP CATdP_hi_EC_Fault "Catalyst monitor - exhaust P high"
 /begin REF_CHARACTERISTIC FCdc4_CATdP_hi FCdtc_CATdP_hi FCfmi_CATdP_hi FCftb_CATdP_hi FCspn_CATdP_hi FPfl_CATdP_hi FPfu_CATdP_hi FPnd_CATdP_hi FPsvr_CATdP_hi FPsw_ext1_CATdP_hi FPsw_CATdP_hi /end REF_CHARACTERISTIC
/end GROUP
/begin GROUP CATdP_lo_EC_Fault "Catalyst monitor - exhaust P low"
 /begin REF_CHARACTERISTIC FCdc4_CATdP_lo FCdtc_CATdP_lo FCfmi_CATdP_lo FCftb_CATdP_lo FCspn_CATdP_lo FPfl_CATdP_lo FPfu_CATdP_lo FPnd_CATdP_lo FPsvr_CATdP_lo FPsw_ext1_CATdP_lo FPsw_CATdP_lo /end REF_CHARACTERISTIC
/end GROUP
/begin GROUP CATout_OOR_EC_Fault "Catalyst outlet temperature out of range"
 /begin REF_CHARACTERISTIC FCdc4_CATout_OOR FCdtc_CATout_OOR FCfmi_CATout_OOR FCftb_CATout_OOR FCspn_CATout_OOR FPfl_CATout_OOR FPfu_CATout_OOR FPnd_CATout_OOR FPsvr_CATout_OOR FPsw_ext1_CATout_OOR FPsw_CATout_OOR /end REF_CHARACTERISTIC
/end GROUP
/begin GROUP CD_MF1_EC_Fault "Spark 1 Misfire Detected"
 /begin REF_CHARACTERISTIC FCdc4_CD_MF1 FCdtc_CD_MF1 FCfmi_CD_MF1 FCftb_CD_MF1 FCspn_CD_MF1 FPfl_CD_MF1 FPfu_CD_MF1 FPnd_CD_MF1 FPsvr_CD_MF1 FPsw_ext1_CD_MF1 FPsw_CD_MF1 /end REF_CHARACTERISTIC
/end GROUP
/begin GROUP CFV_FP_minv_EC_Fault "CFV FP low voltage"
 /begin REF_CHARACTERISTIC FCdc4_CFV_FP_minv FCdtc_CFV_FP_minv FCfmi_CFV_FP_minv FCftb_CFV_FP_minv FCspn_CFV_FP_minv FPfl_CFV_FP_minv FPfu_CFV_FP_minv FPnd_CFV_FP_minv FPsvr_CFV_FP_minv FPsw_ext1_CFV_FP_minv FPsw_CFV_FP_minv /end REF_CHARACTERISTIC
/end GROUP
/begin GROUP CFV_FT_maxv_EC_Fault "CFV FT high voltage"
 /begin REF_CHARACTERISTIC FCdc4_CFV_FT_maxv FCdtc_CFV_FT_maxv FCfmi_CFV_FT_maxv FCftb_CFV_FT_maxv FCspn_CFV_FT_maxv FPfl_CFV_FT_maxv FPfu_CFV_FT_maxv FPnd_CFV_FT_maxv FPsvr_CFV_FT_maxv FPsw_ext1_CFV_FT_maxv FPsw_CFV_FT_maxv /end REF_CHARACTERISTIC
/end GROUP
/begin GROUP CFV_FT_minv_EC_Fault "CFV FT low voltage"
 /begin REF_CHARACTERISTIC FCdc4_CFV_FT_minv FCdtc_CFV_FT_minv FCfmi_CFV_FT_minv FCftb_CFV_FT_minv FCspn_CFV_FT_minv FPfl_CFV_FT_minv FPfu_CFV_FT_minv FPnd_CFV_FT_minv FPsvr_CFV_FT_minv FPsw_ext1_CFV_FT_minv FPsw_CFV_FT_minv /end REF_CHARACTERISTIC
/end GROUP
/begin GROUP CFV_mdot_hi_EC_Fault "CFV flow higher than commanded"
 /begin REF_CHARACTERISTIC FCdc4_CFV_mdot_hi FCdtc_CFV_mdot_hi FCfmi_CFV_mdot_hi FCftb_CFV_mdot_hi FCspn_CFV_mdot_hi FPfl_CFV_mdot_hi FPfu_CFV_mdot_hi FPnd_CFV_mdot_hi FPsvr_CFV_mdot_hi FPsw_ext1_CFV_mdot_hi FPsw_CFV_mdot_hi /end REF_CHARACTERISTIC
/end GROUP
/begin GROUP CFV_mdot_lo_EC_Fault "CFV flow lower than commanded"
 /begin REF_CHARACTERISTIC FCdc4_CFV_mdot_lo FCdtc_CFV_mdot_lo FCfmi_CFV_mdot_lo FCftb_CFV_mdot_lo FCspn_CFV_mdot_lo FPfl_CFV_mdot_lo FPfu_CFV_mdot_lo FPnd_CFV_mdot_lo FPsvr_CFV_mdot_lo FPsw_ext1_CFV_mdot_lo FPsw_CFV_mdot_lo /end REF_CHARACTERISTIC
/end GROUP
/begin GROUP CFV_mdot_rms_hi_EC_Fault "CFV flow error higher than expected"
 /begin REF_CHARACTERISTIC FCdc4_CFV_mdot_rms_hi FCdtc_CFV_mdot_rms_hi FCfmi_CFV_mdot_rms_hi FCftb_CFV_mdot_rms_hi FCspn_CFV_mdot_rms_hi FPfl_CFV_mdot_rms_hi FPfu_CFV_mdot_rms_hi FPnd_CFV_mdot_rms_hi FPsvr_CFV_mdot_rms_hi FPsw_ext1_CFV_mdot_rms_hi FPsw_CFV_mdot_rms_hi /end REF_CHARACTERISTIC
/end GROUP
/begin GROUP CFV_pwr_loss_EC_Fault "CFV power loss fault detection"
 /begin REF_CHARACTERISTIC FCdc4_CFV_pwr_loss FCdtc_CFV_pwr_loss FCfmi_CFV_pwr_loss FCftb_CFV_pwr_loss FCspn_CFV_pwr_loss FPfl_CFV_pwr_loss FPfu_CFV_pwr_loss FPnd_CFV_pwr_loss FPsvr_CFV_pwr_loss FPsw_ext1_CFV_pwr_loss FPsw_CFV_pwr_loss /end REF_CHARACTERISTIC
/end GROUP
/begin GROUP CFV_RLV_fail_EC_Fault "CFV RLV test failed"
 /begin REF_CHARACTERISTIC FCdc4_CFV_RLV_fail FCdtc_CFV_RLV_fail FCfmi_CFV_RLV_fail FCftb_CFV_RLV_fail FCspn_CFV_RLV_fail FPfl_CFV_RLV_fail FPfu_CFV_RLV_fail FPnd_CFV_RLV_fail FPsvr_CFV_RLV_fail FPsw_ext1_CFV_RLV_fail FPsw_CFV_RLV_fail /end REF_CHARACTERISTIC
/end GROUP
/begin GROUP CFV_RLV_P_min_EC_Fault "CFV RLV charge pressure low"
 /begin REF_CHARACTERISTIC FCdc4_CFV_RLV_P_min FCdtc_CFV_RLV_P_min FCfmi_CFV_RLV_P_min FCftb_CFV_RLV_P_min FCspn_CFV_RLV_P_min FPfl_CFV_RLV_P_min FPfu_CFV_RLV_P_min FPnd_CFV_RLV_P_min FPsvr_CFV_RLV_P_min FPsw_ext1_CFV_RLV_P_min FPsw_CFV_RLV_P_min /end REF_CHARACTERISTIC
/end GROUP
/begin GROUP CHT_HiExp_EC_Fault "CHT higher than expected 1"
 /begin REF_CHARACTERISTIC FCdc4_CHT_HiExp FCdtc_CHT_HiExp FCfmi_CHT_HiExp FCftb_CHT_HiExp FCspn_CHT_HiExp FPfl_CHT_HiExp FPfu_CHT_HiExp FPnd_CHT_HiExp FPsvr_CHT_HiExp FPsw_ext1_CHT_HiExp FPsw_CHT_HiExp /end REF_CHARACTERISTIC
/end GROUP
/begin GROUP CHT_HiExp2_EC_Fault "CHT higher than expected 2"
 /begin REF_CHARACTERISTIC FCdc4_CHT_HiExp2 FCdtc_CHT_HiExp2 FCfmi_CHT_HiExp2 FCftb_CHT_HiExp2 FCspn_CHT_HiExp2 FPfl_CHT_HiExp2 FPfu_CHT_HiExp2 FPnd_CHT_HiExp2 FPsvr_CHT_HiExp2 FPsw_ext1_CHT_HiExp2 FPsw_CHT_HiExp2 /end REF_CHARACTERISTIC
/end GROUP
/begin GROUP CL_hi_EC_Fault "CL high gasoline bank1"
 /begin REF_CHARACTERISTIC FCdc4_CL_hi FCdtc_CL_hi FCfmi_CL_hi FCftb_CL_hi FCspn_CL_hi FPfl_CL_hi FPfu_CL_hi FPnd_CL_hi FPsvr_CL_hi FPsw_ext1_CL_hi FPsw_CL_hi /end REF_CHARACTERISTIC
/end GROUP
/begin GROUP CL_lo_EC_Fault "CL low gasoline bank1"
 /begin REF_CHARACTERISTIC FCdc4_CL_lo FCdtc_CL_lo FCfmi_CL_lo FCftb_CL_lo FCspn_CL_lo FPfl_CL_lo FPfu_CL_lo FPnd_CL_lo FPsvr_CL_lo FPsw_ext1_CL_lo FPsw_CL_lo /end REF_CHARACTERISTIC
/end GROUP
/end MODULE
/end PROJECT
