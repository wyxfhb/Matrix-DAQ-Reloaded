ASAP2_VERSION 1 61
/begin PROJECT Econtrols_4G "4G Test"
/begin HEADER "4G A2L Configuration" PROJECT_NO EControls4G /* config for version control */ VERSION "$Revision: 82130 $:" /* config for version control */ /end HEADER
/begin MODULE EControls_4G_SH2A "EControls 4G"
/begin MOD_COMMON "" DEPOSIT ABSOLUTE BYTE_ORDER MSB_FIRST /end MOD_COMMON
/* Define the Record Layouts */
/begin RECORD_LAYOUT ECIPP_ALIGNMENT_UBYTE FNC_VALUES 1 UBYTE COLUMN_DIR DIRECT /end RECORD_LAYOUT
/begin RECORD_LAYOUT ECIPP_Lookup_SBYTE AXIS_PTS_X 1 SBYTE INDEX_INCR DIRECT /end RECORD_LAYOUT
/begin RECORD_LAYOUT ECIPP_ALIGNMENT_UWORD FNC_VALUES 1 UWORD COLUMN_DIR DIRECT /end RECORD_LAYOUT
/begin RECORD_LAYOUT ECIPP_ALIGNMENT_SWORD FNC_VALUES 1 SWORD COLUMN_DIR DIRECT /end RECORD_LAYOUT
/begin RECORD_LAYOUT ECIPP_Lookup_SWORD AXIS_PTS_X 1 SWORD INDEX_INCR DIRECT /end RECORD_LAYOUT
/begin RECORD_LAYOUT ECIPP_ALIGNMENT_ULONG FNC_VALUES 1 ULONG COLUMN_DIR DIRECT /end RECORD_LAYOUT
/begin RECORD_LAYOUT ECIPP_ALIGNMENT_FLOAT32_IEEE FNC_VALUES 1 FLOAT32_IEEE COLUMN_DIR DIRECT /end RECORD_LAYOUT
/* Define generic COMPU_METHODS used in the A2L */ /* NOTE: most of the parameters from ECIPP use unique/specific COMPU_METHODS */
/begin COMPU_METHOD Compu_ECIPP_STRINGS "ECIPP Strings " /* Identifier */ RAT_FUNC "%.0" /* Format */ "ASCII" /* Units */ COEFFS 0 1 0 0 0 1 /end COMPU_METHOD
/begin CHARACTERISTIC BPSerr_run_mode "{BPSerr_run_mode&0xff=0:Stopped}{BPSerr_run_mode&0xff=1:Cranking}{BPSerr_run_mode&0xff=2:Underspeed}{BPSerr_run_mode&0xff=3:Running} (Fault Condition:and run mode >)" VALUE 0x001C9EEE /* @ECU_Address@BPSerr_run_mode@0x0100F458@ */ ECIPP_ALIGNMENT_UBYTE 255 BPSerr_run_mode_COMPU_VTAB 0 255 BIT_MASK 0xff /end CHARACTERISTIC
/begin COMPU_METHOD BPSerr_run_mode_COMPU_VTAB "Verbal Table" TAB_VERB "%.0" "list" COMPU_TAB_REF BPSerr_run_mode_COMPU_VTAB_REF /end COMPU_METHOD
/begin COMPU_VTAB BPSerr_run_mode_COMPU_VTAB_REF "Verbal Table" TAB_VERB 4 0 "Stopped" 1 "Cranking" 2 "Underspeed" 3 "Running" DEFAULT_VALUE "UNKNOWN" /end COMPU_VTAB
/begin CHARACTERISTIC EGR_offmin_nomcmd "Air # EGR_offmin_nomcmd (Fault Condition:EGR nominal command >)" VALUE 0x001c09b8 /* @ECU_Address@EGR_offmin_nomcmd@0x0100F460@ */ ECIPP_ALIGNMENT_UWORD 400 Compu_EGR_offmin_nomcmd 0 399.993896484375 /end CHARACTERISTIC
/begin COMPU_METHOD Compu_EGR_offmin_nomcmd " " RAT_FUNC "%.3" "%" COEFFS 0 163.84 0 0 0 1 /end COMPU_METHOD
/begin CHARACTERISTIC EGR_offmin_mincmd "Air # EGR_offmin_mincmd (Fault Condition:and EGR minimum command >)" VALUE 0x001c09b6 /* @ECU_Address@EGR_offmin_mincmd@0x0100F468@ */ ECIPP_ALIGNMENT_UWORD 400 Compu_EGR_offmin_mincmd 0 399.993896484375 /end CHARACTERISTIC
/begin COMPU_METHOD Compu_EGR_offmin_mincmd " " RAT_FUNC "%.3" "%" COEFFS 0 163.84 0 0 0 1 /end COMPU_METHOD
/begin CHARACTERISTIC CAT1_Taux_cal "{CAT1_Taux_cal&0xff=0:Fuel source}{CAT1_Taux_cal&0xff=1:Exhaust manifold/riser}{CAT1_Taux_cal&0xff=2:Aux Temp A}{CAT1_Taux_cal&0xff=3:Aux Temp B}{CAT1_Taux_cal&0xff=4:Aux Temp C}{CAT1_Taux_cal&0xff=5:Aux Temp D}" VALUE 0x001c8690 /* @ECU_Address@CAT1_Taux_cal@0x0100F590@ */ ECIPP_ALIGNMENT_UBYTE 255 CAT1_Taux_cal_COMPU_VTAB 0 255 BIT_MASK 0xff /end CHARACTERISTIC
/begin COMPU_METHOD CAT1_Taux_cal_COMPU_VTAB "Verbal Table" TAB_VERB "%.0" "list" COMPU_TAB_REF CAT1_Taux_cal_COMPU_VTAB_REF /end COMPU_METHOD
/begin COMPU_VTAB CAT1_Taux_cal_COMPU_VTAB_REF "Verbal Table" TAB_VERB 6 0 "Fuel source" 1 "Exhaust manifold/riser" 2 "Aux Temp A" 3 "Aux Temp B" 4 "Aux Temp C" 5 "Aux Temp D" DEFAULT_VALUE "UNKNOWN" /end COMPU_VTAB
/begin CHARACTERISTIC CAT2_Taux_cal "{CAT2_Taux_cal&0xff=0:Fuel source}{CAT2_Taux_cal&0xff=1:Exhaust manifold/riser}{CAT2_Taux_cal&0xff=2:Aux Temp A}{CAT2_Taux_cal&0xff=3:Aux Temp B}{CAT2_Taux_cal&0xff=4:Aux Temp C}{CAT2_Taux_cal&0xff=5:Aux Temp D}" VALUE 0x001c8692 /* @ECU_Address@CAT2_Taux_cal@0x0100F598@ */ ECIPP_ALIGNMENT_UBYTE 255 CAT2_Taux_cal_COMPU_VTAB 0 255 BIT_MASK 0xff /end CHARACTERISTIC
/begin COMPU_METHOD CAT2_Taux_cal_COMPU_VTAB "Verbal Table" TAB_VERB "%.0" "list" COMPU_TAB_REF CAT2_Taux_cal_COMPU_VTAB_REF /end COMPU_METHOD
/begin COMPU_VTAB CAT2_Taux_cal_COMPU_VTAB_REF "Verbal Table" TAB_VERB 6 0 "Fuel source" 1 "Exhaust manifold/riser" 2 "Aux Temp A" 3 "Aux Temp B" 4 "Aux Temp C" 5 "Aux Temp D" DEFAULT_VALUE "UNKNOWN" /end COMPU_VTAB
/begin CHARACTERISTIC CAT1_vdr "IOConfig # CAT1_vdr" VALUE 0x001c3a74 /* @ECU_Address@CAT1_vdr@0x0100F5A8@ */ ECIPP_ALIGNMENT_FLOAT32_IEEE 10000000000 Compu_CAT1_vdr -10000000000 10000000000 /end CHARACTERISTIC
/begin COMPU_METHOD Compu_CAT1_vdr " " RAT_FUNC "%.3" "ohms" COEFFS 0 1 0 0 0 1 /end COMPU_METHOD
/begin CHARACTERISTIC CAT2_vdr "IOConfig # CAT2_vdr" VALUE 0x001c3a78 /* @ECU_Address@CAT2_vdr@0x0100F5B0@ */ ECIPP_ALIGNMENT_FLOAT32_IEEE 10000000000 Compu_CAT2_vdr -10000000000 10000000000 /end CHARACTERISTIC
/begin COMPU_METHOD Compu_CAT2_vdr " " RAT_FUNC "%.3" "ohms" COEFFS 0 1 0 0 0 1 /end COMPU_METHOD
/begin CHARACTERISTIC EGR_PR_mdlerr_max "Air # EGR_PR_mdlerr_max (Fault Condition:EGR valve PR <)" VALUE 0x001c097a /* @ECU_Address@EGR_PR_mdlerr_max@0x0100F640@ */ ECIPP_ALIGNMENT_UWORD 1 Compu_EGR_PR_mdlerr_max 0 0.999984741210938 /end CHARACTERISTIC
/begin COMPU_METHOD Compu_EGR_PR_mdlerr_max " " RAT_FUNC "%.3" "LP/HP" COEFFS 0 65536 0 0 0 1 /end COMPU_METHOD
/begin CHARACTERISTIC sf_blink_output "{sf_blink_output&0xff=0:Disabled}{sf_blink_output&0xff=1:MIL}{sf_blink_output&0xff=2:Soft warning}{sf_blink_output&0xff=3:Hard warning}" VALUE 0x001eccaa /* @ECU_Address@sf_blink_output@0x0100F8E0@ */ ECIPP_ALIGNMENT_UBYTE 255 sf_blink_output_COMPU_VTAB 0 255 BIT_MASK 0xff /end CHARACTERISTIC
/begin COMPU_METHOD sf_blink_output_COMPU_VTAB "Verbal Table" TAB_VERB "%.0" "list" COMPU_TAB_REF sf_blink_output_COMPU_VTAB_REF /end COMPU_METHOD
/begin COMPU_VTAB sf_blink_output_COMPU_VTAB_REF "Verbal Table" TAB_VERB 4 0 "Disabled" 1 "MIL" 2 "Soft warning" 3 "Hard warning" DEFAULT_VALUE "UNKNOWN" /end COMPU_VTAB
/begin CHARACTERISTIC EGR_LoExp2_mdot "Air # EGR_LoExp2_mdot (Fault Condition:EGR flow command >)" VALUE 0x001c096c /* @ECU_Address@EGR_LoExp2_mdot@0x0100F8E8@ */ ECIPP_ALIGNMENT_UWORD 1024 Compu_EGR_LoExp2_mdot 0 1023.984375 /end CHARACTERISTIC
/begin COMPU_METHOD Compu_EGR_LoExp2_mdot " " RAT_FUNC "%.3" "g/sec" COEFFS 0 64 0 0 0 1 /end COMPU_METHOD
/begin CHARACTERISTIC EGR_LoExp2_pctmin "Air # EGR_LoExp2_pctmin (Fault Condition:and command >)" VALUE 0x001c0970 /* @ECU_Address@EGR_LoExp2_pctmin@0x0100F8F0@ */ ECIPP_ALIGNMENT_UWORD 400 Compu_EGR_LoExp2_pctmin 0 399.993896484375 /end CHARACTERISTIC
/begin COMPU_METHOD Compu_EGR_LoExp2_pctmin " " RAT_FUNC "%.3" "% dil" COEFFS 0 163.84 0 0 0 1 /end COMPU_METHOD
/begin CHARACTERISTIC EGR_LoExp2_pcterr "Air # EGR_LoExp2_pcterr (Fault Condition:and command - actual >)" VALUE 0x001c096e /* @ECU_Address@EGR_LoExp2_pcterr@0x0100F8F8@ */ ECIPP_ALIGNMENT_UWORD 400 Compu_EGR_LoExp2_pcterr 0 399.993896484375 /end CHARACTERISTIC
/begin COMPU_METHOD Compu_EGR_LoExp2_pcterr " " RAT_FUNC "%.3" "% dil" COEFFS 0 163.84 0 0 0 1 /end COMPU_METHOD
/begin CHARACTERISTIC EGR_clr_eta2_ECTmin "Air # EGR_clr_eta2_ECTmin (Fault Condition:Coolant temperature >)" VALUE 0x001c0988 /* @ECU_Address@EGR_clr_eta2_ECTmin@0x0100F900@ */ ECIPP_ALIGNMENT_UWORD 564 Compu_EGR_clr_eta2_ECTmin -460 563.984375 /end CHARACTERISTIC
/begin COMPU_METHOD Compu_EGR_clr_eta2_ECTmin " " RAT_FUNC "%.3" "deg F" COEFFS 0 64 29440 0 0 1 /end COMPU_METHOD
/begin CHARACTERISTIC EGR_clr_eta2_ECTmax "Air # EGR_clr_eta2_ECTmax (Fault Condition:and coolant temperature <)" VALUE 0x001c0986 /* @ECU_Address@EGR_clr_eta2_ECTmax@0x0100F908@ */ ECIPP_ALIGNMENT_UWORD 564 Compu_EGR_clr_eta2_ECTmax -460 563.984375 /end CHARACTERISTIC
/begin COMPU_METHOD Compu_EGR_clr_eta2_ECTmax " " RAT_FUNC "%.3" "deg F" COEFFS 0 64 29440 0 0 1 /end COMPU_METHOD
/begin CHARACTERISTIC EGR_clr_eta2_Tmax "Air # EGR_clr_eta2_Tmax (Fault Condition:and EGRT >)" VALUE 0x001c098a /* @ECU_Address@EGR_clr_eta2_Tmax@0x0100F910@ */ ECIPP_ALIGNMENT_UWORD 7732 Compu_EGR_clr_eta2_Tmax -460 7731.875 /end CHARACTERISTIC
/begin COMPU_METHOD Compu_EGR_clr_eta2_Tmax " " RAT_FUNC "%.3" "deg F" COEFFS 0 8 3680 0 0 1 /end COMPU_METHOD
/begin CHARACTERISTIC EGRwrT_vdr "IOConfig # EGRwrT_vdr" VALUE 0x001c3a98 /* @ECU_Address@EGRwrT_vdr@0x0100F920@ */ ECIPP_ALIGNMENT_FLOAT32_IEEE 10000000000 Compu_EGRwrT_vdr -10000000000 10000000000 /end CHARACTERISTIC
/begin COMPU_METHOD Compu_EGRwrT_vdr " " RAT_FUNC "%.3" "ohms" COEFFS 0 1 0 0 0 1 /end COMPU_METHOD
/begin CHARACTERISTIC EGRwrT_Taux_cal "{EGRwrT_Taux_cal&0xff=0:Fuel source}{EGRwrT_Taux_cal&0xff=1:Exhaust manifold/riser}{EGRwrT_Taux_cal&0xff=2:Aux Temp A}{EGRwrT_Taux_cal&0xff=3:Aux Temp B}{EGRwrT_Taux_cal&0xff=4:Aux Temp C}{EGRwrT_Taux_cal&0xff=5:Aux Temp D}" VALUE 0x001c86db /* @ECU_Address@EGRwrT_Taux_cal@0x0100F928@ */ ECIPP_ALIGNMENT_UBYTE 255 EGRwrT_Taux_cal_COMPU_VTAB 0 255 BIT_MASK 0xff /end CHARACTERISTIC
/begin COMPU_METHOD EGRwrT_Taux_cal_COMPU_VTAB "Verbal Table" TAB_VERB "%.0" "list" COMPU_TAB_REF EGRwrT_Taux_cal_COMPU_VTAB_REF /end COMPU_METHOD
/begin COMPU_VTAB EGRwrT_Taux_cal_COMPU_VTAB_REF "Verbal Table" TAB_VERB 6 0 "Fuel source" 1 "Exhaust manifold/riser" 2 "Aux Temp A" 3 "Aux Temp B" 4 "Aux Temp C" 5 "Aux Temp D" DEFAULT_VALUE "UNKNOWN" /end COMPU_VTAB
/begin CHARACTERISTIC BstTIP_Lo2 "FaultConfig # BstTIP_Lo2 (Fault Condition:P < P target -)" VALUE 0x001c6d90 /* @ECU_Address@BstTIP_Lo2@0x0100F980@ */ ECIPP_ALIGNMENT_UWORD 256 Compu_BstTIP_Lo2 0 255.99609375 /end CHARACTERISTIC
/begin COMPU_METHOD Compu_BstTIP_Lo2 " " RAT_FUNC "%.3" "psi" COEFFS 0 256 0 0 0 1 /end COMPU_METHOD
/begin CHARACTERISTIC BstTIP_Lo2_abs "FaultConfig # BstTIP_Lo2_abs (Fault Condition:and P target >)" VALUE 0x001c6d98 /* @ECU_Address@BstTIP_Lo2_abs@0x0100F988@ */ ECIPP_ALIGNMENT_UWORD 256 Compu_BstTIP_Lo2_abs 0 255.99609375 /end CHARACTERISTIC
/begin COMPU_METHOD Compu_BstTIP_Lo2_abs " " RAT_FUNC "%.3" "psia" COEFFS 0 256 0 0 0 1 /end COMPU_METHOD
/begin CHARACTERISTIC BstTIP_Lo2_dtdz "FaultConfig # BstTIP_Lo2_dtdz (Fault Condition:and dP/dt <=)" VALUE 0x001c4424 /* @ECU_Address@BstTIP_Lo2_dtdz@0x0100F990@ */ ECIPP_ALIGNMENT_SWORD 512 Compu_BstTIP_Lo2_dtdz -512 511.984375 /end CHARACTERISTIC
/begin COMPU_METHOD Compu_BstTIP_Lo2_dtdz " " RAT_FUNC "%.3" "psi/sec" COEFFS 0 64 0 0 0 1 /end COMPU_METHOD
/begin CHARACTERISTIC BstTIP_Lo2_RPM "FaultConfig # BstTIP_Lo2_RPM (Fault Condition:and RPM >)" VALUE 0x001c6d94 /* @ECU_Address@BstTIP_Lo2_RPM@0x0100F998@ */ ECIPP_ALIGNMENT_UWORD 65535 Compu_BstTIP_Lo2_RPM 0 65535 /end CHARACTERISTIC
/begin COMPU_METHOD Compu_BstTIP_Lo2_RPM " " RAT_FUNC "%.0" "rpm" COEFFS 0 1 0 0 0 1 /end COMPU_METHOD
/begin CHARACTERISTIC BstTIP_Lo2_ECT "FaultConfig # BstTIP_Lo2_ECT (Fault Condition:and ECT >)" VALUE 0x001c6d92 /* @ECU_Address@BstTIP_Lo2_ECT@0x0100F9A0@ */ ECIPP_ALIGNMENT_UWORD 564 Compu_BstTIP_Lo2_ECT -460 563.984375 /end CHARACTERISTIC
/begin COMPU_METHOD Compu_BstTIP_Lo2_ECT " " RAT_FUNC "%.3" "deg F" COEFFS 0 64 29440 0 0 1 /end COMPU_METHOD
/begin CHARACTERISTIC FIMP_SW_input_pin "{FIMP_SW_input_pin&0xff=0:Disabled}{FIMP_SW_input_pin&0xff=1:Aux DIG1}{FIMP_SW_input_pin&0xff=2:Aux DIG2}{FIMP_SW_input_pin&0xff=3:Aux DIG3}{FIMP_SW_input_pin&0xff=4:Aux DIG4}{FIMP_SW_input_pin&0xff=5:Aux DIG5}{FIMP_SW_input_pin&0xff=6:Aux DIG6}{FIMP_SW_i" VALUE 0x001c8701 /* @ECU_Address@FIMP_SW_input_pin@0x0100FB58@ */ ECIPP_ALIGNMENT_UBYTE 255 FIMP_SW_input_pin_COMPU_VTAB 0 255 BIT_MASK 0xff /end CHARACTERISTIC
/begin COMPU_METHOD FIMP_SW_input_pin_COMPU_VTAB "Verbal Table" TAB_VERB "%.0" "list" COMPU_TAB_REF FIMP_SW_input_pin_COMPU_VTAB_REF /end COMPU_METHOD
/begin COMPU_VTAB FIMP_SW_input_pin_COMPU_VTAB_REF "Verbal Table" TAB_VERB 20 0 "Disabled" 1 "Aux DIG1" 2 "Aux DIG2" 3 "Aux DIG3" 4 "Aux DIG4" 5 "Aux DIG5" 6 "Aux DIG6" 7 "Aux DIG7" 8 "Aux DIG8" 9 "Aux DIG9" 10 "Aux DIG10" 11 "Aux DIG11" 12 "Aux DIG12" 13 "Aux DIG13" 14 "Aux DIG14" 15 "Aux DIG15" 16 "Aux DIG16" 17 "Aux DIG17" 18 "Aux DIG18" 19 "Aux DIG19" DEFAULT_VALUE "UNKNOWN" /end COMPU_VTAB
/begin CHARACTERISTIC FIMP_SW_input_cfg "{FIMP_SW_input_cfg&0xff=0x00:Disabled}{FIMP_SW_input_cfg&0xff=0x01:Gnd=0, Open=50, +V=100}{FIMP_SW_input_cfg&0xff=0x02:Gnd=0, Open=100, +V=50}{FIMP_SW_input_cfg&0xff=0x03:Gnd=50, Open=0, +V=100}{FIMP_SW_input_cfg&0xff=0x04:Gnd=50, Open=100, +V=0}{FIMP_SW_" VALUE 0x001c8700 /* @ECU_Address@FIMP_SW_input_cfg@0x0100FB60@ */ ECIPP_ALIGNMENT_UBYTE 255 FIMP_SW_input_cfg_COMPU_VTAB 0 255 BIT_MASK 0xff /end CHARACTERISTIC
/begin COMPU_METHOD FIMP_SW_input_cfg_COMPU_VTAB "Verbal Table" TAB_VERB "%.0" "list" COMPU_TAB_REF FIMP_SW_input_cfg_COMPU_VTAB_REF /end COMPU_METHOD
/begin COMPU_VTAB FIMP_SW_input_cfg_COMPU_VTAB_REF "Verbal Table" TAB_VERB 7 0x00 "Disabled" 0x01 "Gnd=0, Open=50, +V=100" 0x02 "Gnd=0, Open=100, +V=50" 0x03 "Gnd=50, Open=0, +V=100" 0x04 "Gnd=50, Open=100, +V=0" 0x05 "Gnd=100, Open=0, +V=50" 0x06 "Gnd=100, Open=50, +V=0" DEFAULT_VALUE "UNKNOWN" /end COMPU_VTAB
/begin CHARACTERISTIC FIMP_extV_input_pin "{FIMP_extV_input_pin&0xff=0:Disabled}{FIMP_extV_input_pin&0xff=1:Aux PU1}{FIMP_extV_input_pin&0xff=2:Aux PU2}{FIMP_extV_input_pin&0xff=3:Aux PU3}{FIMP_extV_input_pin&0xff=4:Aux PD1}{FIMP_extV_input_pin&0xff=5:Aux PD2}{FIMP_extV_input_pin&0xff=6:Aux PD3}{F" VALUE 0x001c8703 /* @ECU_Address@FIMP_extV_input_pin@0x0100FB68@ */ ECIPP_ALIGNMENT_UBYTE 255 FIMP_extV_input_pin_COMPU_VTAB 0 255 BIT_MASK 0xff /end CHARACTERISTIC
/begin COMPU_METHOD FIMP_extV_input_pin_COMPU_VTAB "Verbal Table" TAB_VERB "%.0" "list" COMPU_TAB_REF FIMP_extV_input_pin_COMPU_VTAB_REF /end COMPU_METHOD
/begin COMPU_VTAB FIMP_extV_input_pin_COMPU_VTAB_REF "Verbal Table" TAB_VERB 32 0 "Disabled" 1 "Aux PU1" 2 "Aux PU2" 3 "Aux PU3" 4 "Aux PD1" 5 "Aux PD2" 6 "Aux PD3" 7 "Aux PUD1" 8 "Aux PUD2" 9 "Aux PUD3" 10 "Aux PUD4" 11 "Aux PUD5" 12 "Aux PUD6" 13 "Aux PUD7" 14 "Aux PUD8" 15 "Aux PUD9" 16 "Aux PUD10" 17 "Aux PUD11" 18 "Aux PUD12" 19 "Aux PUD13" 20 "Aux PUD14" 21 "Aux PUD15" 22 "Aux PUD16" 23 "Aux PUD17" 24 "Aux PUD18" 25 "Aux PUD19" 26 "Aux PUD20" 27 "Aux PUD21" 28 "Aux PUD22" 29 "Aux PUD23" 30 "Aux PUD24" 31 "Aux PUD25" DEFAULT_VALUE "UNKNOWN" /end COMPU_VTAB
/begin CHARACTERISTIC FIMP_extV_tau "IOConfig # FIMP_extV_tau" VALUE 0x001c8536 /* @ECU_Address@FIMP_extV_tau@0x0100FB70@ */ ECIPP_ALIGNMENT_UWORD 327680 Compu_FIMP_extV_tau 0.45084 327680 /end CHARACTERISTIC
/begin COMPU_METHOD Compu_FIMP_extV_tau " " FORM "%.3" "ms"
 /begin FORMULA "-5 / log(1 - (X1 / 65536))" FORMULA_INV "(1 - exp(-5/X1)) * 65536" /end FORMULA
/end COMPU_METHOD
/begin CHARACTERISTIC FIMP_extV_0pct "IOConfig # FIMP_extV_0pct" VALUE 0x001c6f54 /* @ECU_Address@FIMP_extV_0pct@0x0100FB78@ */ ECIPP_ALIGNMENT_UWORD 5 Compu_FIMP_extV_0pct 0 5.00114468864469 /end CHARACTERISTIC
/begin COMPU_METHOD Compu_FIMP_extV_0pct " " RAT_FUNC "%.3" "volts" COEFFS 0 13104 0 0 0 1 /end COMPU_METHOD
/begin CHARACTERISTIC FIMP_extV_100pct "IOConfig # FIMP_extV_100pct" VALUE 0x001c6f56 /* @ECU_Address@FIMP_extV_100pct@0x0100FB80@ */ ECIPP_ALIGNMENT_UWORD 5 Compu_FIMP_extV_100pct 0 5.00114468864469 /end CHARACTERISTIC
/begin COMPU_METHOD Compu_FIMP_extV_100pct " " RAT_FUNC "%.3" "volts" COEFFS 0 13104 0 0 0 1 /end COMPU_METHOD
/begin CHARACTERISTIC cam2loss_rpm "FaultConfig # cam2loss_rpm (Fault Condition:and RPM >)" VALUE 0x001c83c0 /* @ECU_Address@cam2loss_rpm@0x0100FC38@ */ ECIPP_ALIGNMENT_UWORD 65535 Compu_cam2loss_rpm 0 65535 /end CHARACTERISTIC
/begin COMPU_METHOD Compu_cam2loss_rpm " " RAT_FUNC "%.0" "rpm" COEFFS 0 1 0 0 0 1 /end COMPU_METHOD
/begin CHARACTERISTIC cam2loss "FaultConfig # cam2loss (Fault Condition:No cam pulse in)" VALUE 0x001c8fcb /* @ECU_Address@cam2loss@0x0100FC40@ */ ECIPP_ALIGNMENT_UBYTE 64 Compu_cam2loss 0 63.75 /end CHARACTERISTIC
/begin COMPU_METHOD Compu_cam2loss " " RAT_FUNC "%.3" "cycles" COEFFS 0 4 0 0 0 1 /end COMPU_METHOD
/begin CHARACTERISTIC FIP_Paux_cal "{FIP_Paux_cal&0xff=0:Aux Press A}{FIP_Paux_cal&0xff=1:Aux Press B}{FIP_Paux_cal&0xff=2:Aux Press C}{FIP_Paux_cal&0xff=3:Aux Press D}" VALUE 0x001c8707 /* @ECU_Address@FIP_Paux_cal@0x0100FD08@ */ ECIPP_ALIGNMENT_UBYTE 255 FIP_Paux_cal_COMPU_VTAB 0 255 BIT_MASK 0xff /end CHARACTERISTIC
/begin COMPU_METHOD FIP_Paux_cal_COMPU_VTAB "Verbal Table" TAB_VERB "%.0" "list" COMPU_TAB_REF FIP_Paux_cal_COMPU_VTAB_REF /end COMPU_METHOD
/begin COMPU_VTAB FIP_Paux_cal_COMPU_VTAB_REF "Verbal Table" TAB_VERB 4 0 "Aux Press A" 1 "Aux Press B" 2 "Aux Press C" 3 "Aux Press D" DEFAULT_VALUE "UNKNOWN" /end COMPU_VTAB
/begin MEASUREMENT enov_slnk_1ms_ena "{enov_slnk_1ms_ena&0xff=0:NO}{enov_slnk_1ms_ena&0xff=1:YES}" UBYTE enov_slnk_1ms_ena_COMPU_VTAB 0 0 0 255 ECU_ADDRESS 0x0100FEA0 BIT_MASK 0xff /end MEASUREMENT
/begin COMPU_METHOD enov_slnk_1ms_ena_COMPU_VTAB "Verbal Table" TAB_VERB "%.0" "list" COMPU_TAB_REF enov_slnk_1ms_ena_COMPU_VTAB_REF /end COMPU_METHOD
/begin COMPU_VTAB enov_slnk_1ms_ena_COMPU_VTAB_REF "Verbal Table" TAB_VERB 2 0 "NO" 1 "YES" DEFAULT_VALUE "UNKNOWN" /end COMPU_VTAB
/begin MEASUREMENT enov_slnk_5ms_ena "{enov_slnk_5ms_ena&0xff=0:NO}{enov_slnk_5ms_ena&0xff=1:YES}" UBYTE enov_slnk_5ms_ena_COMPU_VTAB 0 0 0 255 ECU_ADDRESS 0x0100FEC8 BIT_MASK 0xff /end MEASUREMENT
/begin COMPU_METHOD enov_slnk_5ms_ena_COMPU_VTAB "Verbal Table" TAB_VERB "%.0" "list" COMPU_TAB_REF enov_slnk_5ms_ena_COMPU_VTAB_REF /end COMPU_METHOD
/begin COMPU_VTAB enov_slnk_5ms_ena_COMPU_VTAB_REF "Verbal Table" TAB_VERB 2 0 "NO" 1 "YES" DEFAULT_VALUE "UNKNOWN" /end COMPU_VTAB
/begin MEASUREMENT enov_slnk_50ms_ena "{enov_slnk_50ms_ena&0xff=0:NO}{enov_slnk_50ms_ena&0xff=1:YES}" UBYTE enov_slnk_50ms_ena_COMPU_VTAB 0 0 0 255 ECU_ADDRESS 0x0100FEF0 BIT_MASK 0xff /end MEASUREMENT
/begin COMPU_METHOD enov_slnk_50ms_ena_COMPU_VTAB "Verbal Table" TAB_VERB "%.0" "list" COMPU_TAB_REF enov_slnk_50ms_ena_COMPU_VTAB_REF /end COMPU_METHOD
/begin COMPU_VTAB enov_slnk_50ms_ena_COMPU_VTAB_REF "Verbal Table" TAB_VERB 2 0 "NO" 1 "YES" DEFAULT_VALUE "UNKNOWN" /end COMPU_VTAB
/begin CHARACTERISTIC EGRT_maxv "Air # EGRT_maxv (Fault Condition:EGRT voltage >)" VALUE 0x001c0960 /* @ECU_Address@EGRT_maxv@0x0100FFA8@ */ ECIPP_ALIGNMENT_UWORD 5 Compu_EGRT_maxv 0 5.00114468864469 /end CHARACTERISTIC
/begin COMPU_METHOD Compu_EGRT_maxv " " RAT_FUNC "%.3" "volts" COEFFS 0 13104 0 0 0 1 /end COMPU_METHOD
/begin CHARACTERISTIC EGRT_maxv_ECTmin "Air # EGRT_maxv_ECTmin (Fault Condition:and coolant temperature >)" VALUE 0x001c0962 /* @ECU_Address@EGRT_maxv_ECTmin@0x0100FFB0@ */ ECIPP_ALIGNMENT_UWORD 564 Compu_EGRT_maxv_ECTmin -460 563.984375 /end CHARACTERISTIC
/begin COMPU_METHOD Compu_EGRT_maxv_ECTmin " " RAT_FUNC "%.3" "deg F" COEFFS 0 64 29440 0 0 1 /end COMPU_METHOD
/begin CHARACTERISTIC EGRT_minv "Air # EGRT_minv (Fault Condition:EGRT voltage <)" VALUE 0x001c0964 /* @ECU_Address@EGRT_minv@0x0100FFB8@ */ ECIPP_ALIGNMENT_UWORD 5 Compu_EGRT_minv 0 5.00114468864469 /end CHARACTERISTIC
/begin COMPU_METHOD Compu_EGRT_minv " " RAT_FUNC "%.3" "volts" COEFFS 0 13104 0 0 0 1 /end COMPU_METHOD
/begin CHARACTERISTIC EGRT_hi_ECTmin "Air # EGRT_hi_ECTmin (Fault Condition:Coolant temperature >)" VALUE 0x001c095a /* @ECU_Address@EGRT_hi_ECTmin@0x0100FFC0@ */ ECIPP_ALIGNMENT_UWORD 564 Compu_EGRT_hi_ECTmin -460 563.984375 /end CHARACTERISTIC
/begin COMPU_METHOD Compu_EGRT_hi_ECTmin " " RAT_FUNC "%.3" "deg F" COEFFS 0 64 29440 0 0 1 /end COMPU_METHOD
/begin CHARACTERISTIC EGRT_hi_ECTmax "Air # EGRT_hi_ECTmax (Fault Condition:and coolant temperature <)" VALUE 0x001c0958 /* @ECU_Address@EGRT_hi_ECTmax@0x0100FFC8@ */ ECIPP_ALIGNMENT_UWORD 564 Compu_EGRT_hi_ECTmax -460 563.984375 /end CHARACTERISTIC
/begin COMPU_METHOD Compu_EGRT_hi_ECTmax " " RAT_FUNC "%.3" "deg F" COEFFS 0 64 29440 0 0 1 /end COMPU_METHOD
/begin CHARACTERISTIC EGRT_hi_Tmax "Air # EGRT_hi_Tmax (Fault Condition:EGRT >)" VALUE 0x001c095c /* @ECU_Address@EGRT_hi_Tmax@0x0100FFD0@ */ ECIPP_ALIGNMENT_UWORD 7732 Compu_EGRT_hi_Tmax -460 7731.875 /end CHARACTERISTIC
/begin COMPU_METHOD Compu_EGRT_hi_Tmax " " RAT_FUNC "%.3" "deg F" COEFFS 0 8 3680 0 0 1 /end COMPU_METHOD
/begin CHARACTERISTIC FIP_LoExp_mdot "Fuel # FIP_LoExp_mdot (Fault Condition:and fuel flow >)" VALUE 0x001c6f60 /* @ECU_Address@FIP_LoExp_mdot@0x0100FFD8@ */ ECIPP_ALIGNMENT_UWORD 128 Compu_FIP_LoExp_mdot 0 127.998046875 /end CHARACTERISTIC
/begin COMPU_METHOD Compu_FIP_LoExp_mdot " " RAT_FUNC "%.3" "g/sec" COEFFS 0 512 0 0 0 1 /end COMPU_METHOD
/begin CHARACTERISTIC WGPerr_pos "FaultConfig # WGPerr_pos (Fault Condition:(target WGP - actual WGP) >)" VALUE 0x001c6c22 /* @ECU_Address@WGPerr_pos@0x0100FFE0@ */ ECIPP_ALIGNMENT_SWORD 100 Compu_WGPerr_pos -100 99.9969482421875 /end CHARACTERISTIC
/begin COMPU_METHOD Compu_WGPerr_pos " " RAT_FUNC "%.3" "%" COEFFS 0 327.68 0 0 0 1 /end COMPU_METHOD
/begin CHARACTERISTIC WGPerr_neg "FaultConfig # WGPerr_neg (Fault Condition:(target WGP - actual WGP) <)" VALUE 0x001c6c20 /* @ECU_Address@WGPerr_neg@0x0100FFE8@ */ ECIPP_ALIGNMENT_SWORD 100 Compu_WGPerr_neg -100 99.9969482421875 /end CHARACTERISTIC
/begin COMPU_METHOD Compu_WGPerr_neg " " RAT_FUNC "%.3" "%" COEFFS 0 327.68 0 0 0 1 /end COMPU_METHOD
/begin CHARACTERISTIC WGPerr_dtdz "FaultConfig # WGPerr_dtdz (Fault Condition:and abs(dTIP/dt) <=)" VALUE 0x001c6c1e /* @ECU_Address@WGPerr_dtdz@0x0100FFF0@ */ ECIPP_ALIGNMENT_SWORD 512 Compu_WGPerr_dtdz -512 511.984375 /end CHARACTERISTIC
/begin COMPU_METHOD Compu_WGPerr_dtdz " " RAT_FUNC "%.3" "psi/sec" COEFFS 0 64 0 0 0 1 /end COMPU_METHOD
/begin CHARACTERISTIC KNK_retardlmt_MAX "FaultConfig # KNK_retardlmt_MAX (Fault Condition:and knock spark retard at percent of maximum)" VALUE 0x001c7cc8 /* @ECU_Address@KNK_retardlmt_MAX@0x01010000@ */ ECIPP_ALIGNMENT_UWORD 100 Compu_KNK_retardlmt_MAX 0 99.9984741210938 /end CHARACTERISTIC
/begin COMPU_METHOD Compu_KNK_retardlmt_MAX " " RAT_FUNC "%.3" "%" COEFFS 0 655.36 0 0 0 1 /end COMPU_METHOD
/begin CHARACTERISTIC KNK_retardlmt_MAX2 "FaultConfig # KNK_retardlmt_MAX2 (Fault Condition:and knock spark retard at percent of maximum)" VALUE 0x001c7cca /* @ECU_Address@KNK_retardlmt_MAX2@0x01010008@ */ ECIPP_ALIGNMENT_UWORD 100 Compu_KNK_retardlmt_MAX2 0 99.9984741210938 /end CHARACTERISTIC
/begin COMPU_METHOD Compu_KNK_retardlmt_MAX2 " " RAT_FUNC "%.3" "%" COEFFS 0 655.36 0 0 0 1 /end COMPU_METHOD
/begin CHARACTERISTIC KNK_retardlmt_RPM2 "FaultConfig # KNK_retardlmt_RPM2 (Fault Condition:RPM >)" VALUE 0x001c7cce /* @ECU_Address@KNK_retardlmt_RPM2@0x01010010@ */ ECIPP_ALIGNMENT_UWORD 65535 Compu_KNK_retardlmt_RPM2 0 65535 /end CHARACTERISTIC
/begin COMPU_METHOD Compu_KNK_retardlmt_RPM2 " " RAT_FUNC "%.0" "rpm" COEFFS 0 1 0 0 0 1 /end COMPU_METHOD
/begin CHARACTERISTIC KNK_retardlmt_MAP2 "FaultConfig # KNK_retardlmt_MAP2 (Fault Condition:and MAP >)" VALUE 0x001c7cc6 /* @ECU_Address@KNK_retardlmt_MAP2@0x01010018@ */ ECIPP_ALIGNMENT_UWORD 256 Compu_KNK_retardlmt_MAP2 0 255.99609375 /end CHARACTERISTIC
/begin COMPU_METHOD Compu_KNK_retardlmt_MAP2 " " RAT_FUNC "%.3" "psia" COEFFS 0 256 0 0 0 1 /end COMPU_METHOD
/begin CHARACTERISTIC imu_temp_max "FaultConfig # imu_temp_max (Fault Condition:IMU temperature >=)" VALUE 0x001c6d1c /* @ECU_Address@imu_temp_max@0x010101E8@ */ ECIPP_ALIGNMENT_SWORD 2073 Compu_imu_temp_max -2023 2072.9375 /end CHARACTERISTIC
/begin COMPU_METHOD Compu_imu_temp_max " " RAT_FUNC "%.3" "deg C" COEFFS 0 16 -400 0 0 1 /end COMPU_METHOD
/begin CHARACTERISTIC imu_temp_min "FaultConfig # imu_temp_min (Fault Condition:IMU temperature <=)" VALUE 0x001c6d1e /* @ECU_Address@imu_temp_min@0x010101F0@ */ ECIPP_ALIGNMENT_SWORD 2073 Compu_imu_temp_min -2023 2072.9375 /end CHARACTERISTIC
/begin COMPU_METHOD Compu_imu_temp_min " " RAT_FUNC "%.3" "deg C" COEFFS 0 16 -400 0 0 1 /end COMPU_METHOD
/begin CHARACTERISTIC imu_temp_min_wait "FaultConfig # imu_temp_min_wait (Fault Condition:and  key-on time >=)" VALUE 0x001c4400 /* @ECU_Address@imu_temp_min_wait@0x010101F8@ */ ECIPP_ALIGNMENT_ULONG 4294967 Compu_imu_temp_min_wait 0 4294967.295 /end CHARACTERISTIC
/begin COMPU_METHOD Compu_imu_temp_min_wait " " RAT_FUNC "%.3" "seconds" COEFFS 0 1000 0 0 0 1 /end COMPU_METHOD
/begin CHARACTERISTIC imu_accel_x_max "FaultConfig # imu_accel_x_max (Fault Condition:X-axis linear acceleration >=)" VALUE 0x001c3e08 /* @ECU_Address@imu_accel_x_max@0x01010200@ */ ECIPP_ALIGNMENT_FLOAT32_IEEE 10000000000 Compu_imu_accel_x_max -10000000000 10000000000 /end CHARACTERISTIC
/begin COMPU_METHOD Compu_imu_accel_x_max " " RAT_FUNC "%.3" "g" COEFFS 0 1 0 0 0 1 /end COMPU_METHOD
/begin CHARACTERISTIC imu_accel_x_min "FaultConfig # imu_accel_x_min (Fault Condition:X-axis linear acceleration <=)" VALUE 0x001c3e0c /* @ECU_Address@imu_accel_x_min@0x01010208@ */ ECIPP_ALIGNMENT_FLOAT32_IEEE 10000000000 Compu_imu_accel_x_min -10000000000 10000000000 /end CHARACTERISTIC
/begin COMPU_METHOD Compu_imu_accel_x_min " " RAT_FUNC "%.3" "g" COEFFS 0 1 0 0 0 1 /end COMPU_METHOD
/begin CHARACTERISTIC imu_accel_y_max "FaultConfig # imu_accel_y_max (Fault Condition:Y-axis linear acceleration >=)" VALUE 0x001c3e10 /* @ECU_Address@imu_accel_y_max@0x01010210@ */ ECIPP_ALIGNMENT_FLOAT32_IEEE 10000000000 Compu_imu_accel_y_max -10000000000 10000000000 /end CHARACTERISTIC
/begin COMPU_METHOD Compu_imu_accel_y_max " " RAT_FUNC "%.3" "g" COEFFS 0 1 0 0 0 1 /end COMPU_METHOD
/begin CHARACTERISTIC imu_accel_y_min "FaultConfig # imu_accel_y_min (Fault Condition:Y-axis linear acceleration <=)" VALUE 0x001c3e14 /* @ECU_Address@imu_accel_y_min@0x01010218@ */ ECIPP_ALIGNMENT_FLOAT32_IEEE 10000000000 Compu_imu_accel_y_min -10000000000 10000000000 /end CHARACTERISTIC
/begin COMPU_METHOD Compu_imu_accel_y_min " " RAT_FUNC "%.3" "g" COEFFS 0 1 0 0 0 1 /end COMPU_METHOD
/begin CHARACTERISTIC imu_accel_z_max "FaultConfig # imu_accel_z_max (Fault Condition:Z-axis linear acceleration >=)" VALUE 0x001c3e18 /* @ECU_Address@imu_accel_z_max@0x01010220@ */ ECIPP_ALIGNMENT_FLOAT32_IEEE 10000000000 Compu_imu_accel_z_max -10000000000 10000000000 /end CHARACTERISTIC
/begin COMPU_METHOD Compu_imu_accel_z_max " " RAT_FUNC "%.3" "g" COEFFS 0 1 0 0 0 1 /end COMPU_METHOD
/begin CHARACTERISTIC imu_accel_z_min "FaultConfig # imu_accel_z_min (Fault Condition:Z-axis linear acceleration <=)" VALUE 0x001c3e1c /* @ECU_Address@imu_accel_z_min@0x01010228@ */ ECIPP_ALIGNMENT_FLOAT32_IEEE 10000000000 Compu_imu_accel_z_min -10000000000 10000000000 /end CHARACTERISTIC
/begin COMPU_METHOD Compu_imu_accel_z_min " " RAT_FUNC "%.3" "g" COEFFS 0 1 0 0 0 1 /end COMPU_METHOD
/begin CHARACTERISTIC imu_gyro_x_max "FaultConfig # imu_gyro_x_max (Fault Condition:X-axis angular rate >=)" VALUE 0x001c3e20 /* @ECU_Address@imu_gyro_x_max@0x01010230@ */ ECIPP_ALIGNMENT_FLOAT32_IEEE 10000000000 Compu_imu_gyro_x_max -10000000000 10000000000 /end CHARACTERISTIC
/begin COMPU_METHOD Compu_imu_gyro_x_max " " RAT_FUNC "%.3" "dps" COEFFS 0 1 0 0 0 1 /end COMPU_METHOD
/begin CHARACTERISTIC imu_gyro_x_min "FaultConfig # imu_gyro_x_min (Fault Condition:X-axis angular rate <=)" VALUE 0x001c3e24 /* @ECU_Address@imu_gyro_x_min@0x01010238@ */ ECIPP_ALIGNMENT_FLOAT32_IEEE 10000000000 Compu_imu_gyro_x_min -10000000000 10000000000 /end CHARACTERISTIC
/begin COMPU_METHOD Compu_imu_gyro_x_min " " RAT_FUNC "%.3" "dps" COEFFS 0 1 0 0 0 1 /end COMPU_METHOD
/begin CHARACTERISTIC imu_gyro_y_max "FaultConfig # imu_gyro_y_max (Fault Condition:Y-axis angular rate >=)" VALUE 0x001c3e28 /* @ECU_Address@imu_gyro_y_max@0x01010240@ */ ECIPP_ALIGNMENT_FLOAT32_IEEE 10000000000 Compu_imu_gyro_y_max -10000000000 10000000000 /end CHARACTERISTIC
/begin COMPU_METHOD Compu_imu_gyro_y_max " " RAT_FUNC "%.3" "dps" COEFFS 0 1 0 0 0 1 /end COMPU_METHOD
/begin CHARACTERISTIC imu_gyro_y_min "FaultConfig # imu_gyro_y_min (Fault Condition:Y-axis angular rate <=)" VALUE 0x001c3e2c /* @ECU_Address@imu_gyro_y_min@0x01010248@ */ ECIPP_ALIGNMENT_FLOAT32_IEEE 10000000000 Compu_imu_gyro_y_min -10000000000 10000000000 /end CHARACTERISTIC
/begin COMPU_METHOD Compu_imu_gyro_y_min " " RAT_FUNC "%.3" "dps" COEFFS 0 1 0 0 0 1 /end COMPU_METHOD
/begin CHARACTERISTIC imu_gyro_z_max "FaultConfig # imu_gyro_z_max (Fault Condition:Z-axis angular rate >=)" VALUE 0x001c3e30 /* @ECU_Address@imu_gyro_z_max@0x01010250@ */ ECIPP_ALIGNMENT_FLOAT32_IEEE 10000000000 Compu_imu_gyro_z_max -10000000000 10000000000 /end CHARACTERISTIC
/begin COMPU_METHOD Compu_imu_gyro_z_max " " RAT_FUNC "%.3" "dps" COEFFS 0 1 0 0 0 1 /end COMPU_METHOD
/begin CHARACTERISTIC imu_gyro_z_min "FaultConfig # imu_gyro_z_min (Fault Condition:Z-axis angular rate <=)" VALUE 0x001c3e34 /* @ECU_Address@imu_gyro_z_min@0x01010258@ */ ECIPP_ALIGNMENT_FLOAT32_IEEE 10000000000 Compu_imu_gyro_z_min -10000000000 10000000000 /end CHARACTERISTIC
/begin COMPU_METHOD Compu_imu_gyro_z_min " " RAT_FUNC "%.3" "dps" COEFFS 0 1 0 0 0 1 /end COMPU_METHOD
/begin CHARACTERISTIC controller_type "{controller_type&0xff=0:Engine controller}{controller_type&0xff=1:Suspension controller}{controller_type&0xff=2:Spark and knock controller}" VALUE 0x001ecc81 /* @ECU_Address@controller_type@0x01010268@ */ ECIPP_ALIGNMENT_UBYTE 255 controller_type_COMPU_VTAB 0 255 BIT_MASK 0xff /end CHARACTERISTIC
/begin COMPU_METHOD controller_type_COMPU_VTAB "Verbal Table" TAB_VERB "%.0" "list" COMPU_TAB_REF controller_type_COMPU_VTAB_REF /end COMPU_METHOD
/begin COMPU_VTAB controller_type_COMPU_VTAB_REF "Verbal Table" TAB_VERB 3 0 "Engine controller" 1 "Suspension controller" 2 "Spark and knock controller" DEFAULT_VALUE "UNKNOWN" /end COMPU_VTAB
/begin CHARACTERISTIC KNK_retardlmt_ECT2 "FaultConfig # KNK_retardlmt_ECT2 (Fault Condition:and ECT >)" VALUE 0x001c7cc2 /* @ECU_Address@KNK_retardlmt_ECT2@0x010102B0@ */ ECIPP_ALIGNMENT_UWORD 564 Compu_KNK_retardlmt_ECT2 -460 563.984375 /end CHARACTERISTIC
/begin COMPU_METHOD Compu_KNK_retardlmt_ECT2 " " RAT_FUNC "%.3" "deg F" COEFFS 0 64 29440 0 0 1 /end COMPU_METHOD
/begin CHARACTERISTIC KNK_retardlmt_wt2 "FaultConfig # KNK_retardlmt_wt2 (Fault Condition:and engine run time >)" VALUE 0x001c42bc /* @ECU_Address@KNK_retardlmt_wt2@0x010102B8@ */ ECIPP_ALIGNMENT_ULONG 4294967 Compu_KNK_retardlmt_wt2 0 4294967.295 /end CHARACTERISTIC
/begin COMPU_METHOD Compu_KNK_retardlmt_wt2 " " RAT_FUNC "%.3" "sec" COEFFS 0 1000 0 0 0 1 /end COMPU_METHOD
/begin CHARACTERISTIC J1939_PGN_tout_runtm "FaultConfig # J1939_PGN_tout_runtm (Fault Condition:Run-time >)" VALUE 0x001c7ca2 /* @ECU_Address@J1939_PGN_tout_runtm@0x01010340@ */ ECIPP_ALIGNMENT_UWORD 66 Compu_J1939_PGN_tout_runtm 0 65.535 /end CHARACTERISTIC
/begin COMPU_METHOD Compu_J1939_PGN_tout_runtm " " RAT_FUNC "%.3" "sec" COEFFS 0 1000 0 0 0 1 /end COMPU_METHOD
/begin CHARACTERISTIC J1939_PGN_tout_keytm "FaultConfig # J1939_PGN_tout_keytm (Fault Condition:and key-on time >)" VALUE 0x001c7ca0 /* @ECU_Address@J1939_PGN_tout_keytm@0x01010380@ */ ECIPP_ALIGNMENT_UWORD 66 Compu_J1939_PGN_tout_keytm 0 65.535 /end CHARACTERISTIC
/begin COMPU_METHOD Compu_J1939_PGN_tout_keytm " " RAT_FUNC "%.3" "sec" COEFFS 0 1000 0 0 0 1 /end COMPU_METHOD
/begin MEASUREMENT VDS_state "Calibration Source{VDS_state&0xff=0:Standard is Loaded}{VDS_state&0xff=1:Variant is Loaded}{VDS_state&0xff=2:Request Standard}{VDS_state&0xff=3:Request Variant}" UBYTE VDS_state_COMPU_VTAB 0 0 0 255 ECU_ADDRESS 0x010104B0 BIT_MASK 0xff /end MEASUREMENT
/begin COMPU_METHOD VDS_state_COMPU_VTAB "Verbal Table" TAB_VERB "%.0" "list" COMPU_TAB_REF VDS_state_COMPU_VTAB_REF /end COMPU_METHOD
/begin COMPU_VTAB VDS_state_COMPU_VTAB_REF "Verbal Table" TAB_VERB 4 0 "Standard is Loaded" 1 "Variant is Loaded" 2 "Request Standard" 3 "Request Variant" DEFAULT_VALUE "UNKNOWN" /end COMPU_VTAB
/begin CHARACTERISTIC IAT_HiExp_FSOdis "{IAT_HiExp_FSOdis&0xff=0:No}{IAT_HiExp_FSOdis&0xff=1:Yes} (Fault Condition:Disable all IAT HiExp faults during fuel shut off)" VALUE 0x001e6dd9 /* @ECU_Address@IAT_HiExp_FSOdis@0x010104D0@ */ ECIPP_ALIGNMENT_UBYTE 255 IAT_HiExp_FSOdis_COMPU_VTAB 0 255 BIT_MASK 0xff /end CHARACTERISTIC
/begin COMPU_METHOD IAT_HiExp_FSOdis_COMPU_VTAB "Verbal Table" TAB_VERB "%.0" "list" COMPU_TAB_REF IAT_HiExp_FSOdis_COMPU_VTAB_REF /end COMPU_METHOD
/begin COMPU_VTAB IAT_HiExp_FSOdis_COMPU_VTAB_REF "Verbal Table" TAB_VERB 2 0 "No" 1 "Yes" DEFAULT_VALUE "UNKNOWN" /end COMPU_VTAB
/begin CHARACTERISTIC J1939_TP_BAM "{J1939_TP_BAM&0xff=0x00:Disabled}{J1939_TP_BAM&0xff=0x01:Enabled}" VALUE 0x001e6dde /* @ECU_Address@J1939_TP_BAM@0x010104D8@ */ ECIPP_ALIGNMENT_UBYTE 255 J1939_TP_BAM_COMPU_VTAB 0 255 BIT_MASK 0xff /end CHARACTERISTIC
/begin COMPU_METHOD J1939_TP_BAM_COMPU_VTAB "Verbal Table" TAB_VERB "%.0" "list" COMPU_TAB_REF J1939_TP_BAM_COMPU_VTAB_REF /end COMPU_METHOD
/begin COMPU_VTAB J1939_TP_BAM_COMPU_VTAB_REF "Verbal Table" TAB_VERB 2 0x00 "Disabled" 0x01 "Enabled" DEFAULT_VALUE "UNKNOWN" /end COMPU_VTAB
/begin CHARACTERISTIC TEL_enable_FAW "Telematics system 3{TEL_enable_FAW&0xff=0:Disabled}{TEL_enable_FAW&0xff=1:Enabled}" VALUE 0x001c8f2c /* @ECU_Address@TEL_enable_FAW@0x010104E0@ */ ECIPP_ALIGNMENT_UBYTE 255 TEL_enable_FAW_COMPU_VTAB 0 255 MAX_REFRESH 6 1 BIT_MASK 0xff /end CHARACTERISTIC
/begin COMPU_METHOD TEL_enable_FAW_COMPU_VTAB "Verbal Table" TAB_VERB "%.0" "list" COMPU_TAB_REF TEL_enable_FAW_COMPU_VTAB_REF /end COMPU_METHOD
/begin COMPU_VTAB TEL_enable_FAW_COMPU_VTAB_REF "Verbal Table" TAB_VERB 2 0 "Disabled" 1 "Enabled" DEFAULT_VALUE "UNKNOWN" /end COMPU_VTAB
/begin CHARACTERISTIC LOD_min_ECT "FaultConfig # LOD_min_ECT (Fault Condition:and ECT >)" VALUE 0x001e5712 /* @ECU_Address@LOD_min_ECT@0x010104E8@ */ ECIPP_ALIGNMENT_UWORD 564 Compu_LOD_min_ECT -460 563.984375 /end CHARACTERISTIC
/begin COMPU_METHOD Compu_LOD_min_ECT " " RAT_FUNC "%.3" "deg F" COEFFS 0 64 29440 0 0 1 /end COMPU_METHOD
/begin CHARACTERISTIC LOD_min_ECT_tm "FaultConfig # LOD_min_ECT_tm (Fault Condition:and ECT > above temp for)" VALUE 0x001e2efc /* @ECU_Address@LOD_min_ECT_tm@0x010104F0@ */ ECIPP_ALIGNMENT_ULONG 4294967 Compu_LOD_min_ECT_tm 0 4294967.295 /end CHARACTERISTIC
/begin COMPU_METHOD Compu_LOD_min_ECT_tm " " RAT_FUNC "%.3" "sec" COEFFS 0 1000 0 0 0 1 /end COMPU_METHOD
/begin CHARACTERISTIC LOD_slk_Pinc "FaultConfig # LOD_slk_Pinc (Fault Condition:EPR feedback pressure rise >)" VALUE 0x001e2f30 /* @ECU_Address@LOD_slk_Pinc@0x010104F8@ */ ECIPP_ALIGNMENT_SWORD 222 Compu_LOD_slk_Pinc -222 221.993225097656 /end CHARACTERISTIC
/begin COMPU_METHOD Compu_LOD_slk_Pinc " " RAT_FUNC "%.3" "in H2O" COEFFS 0 147.603603603604 0 0 0 1 /end COMPU_METHOD
/begin CHARACTERISTIC LOD_slk_tm "FaultConfig # LOD_slk_tm (Fault Condition:during test time limit of)" VALUE 0x001e5714 /* @ECU_Address@LOD_slk_tm@0x01010500@ */ ECIPP_ALIGNMENT_UWORD 66 Compu_LOD_slk_tm 0 65.535 /end CHARACTERISTIC
/begin COMPU_METHOD Compu_LOD_slk_tm " " RAT_FUNC "%.3" "sec" COEFFS 0 1000 0 0 0 1 /end COMPU_METHOD
/begin CHARACTERISTIC LOD_slk_eng_cyc "FaultConfig # LOD_slk_eng_cyc (Fault Condition:Number of engine warm cycles between runs)" VALUE 0x001e6de4 /* @ECU_Address@LOD_slk_eng_cyc@0x01010508@ */ ECIPP_ALIGNMENT_UBYTE 255 Compu_LOD_slk_eng_cyc 0 255 /end CHARACTERISTIC
/begin COMPU_METHOD Compu_LOD_slk_eng_cyc " " RAT_FUNC "%.0" "cycles" COEFFS 0 1 0 0 0 1 /end COMPU_METHOD
/begin CHARACTERISTIC LOD_slk_cyc_force "FaultConfig # LOD_slk_cyc_force (Fault Condition:Number of engine cycles before forced test run)" VALUE 0x001e6de3 /* @ECU_Address@LOD_slk_cyc_force@0x01010510@ */ ECIPP_ALIGNMENT_UBYTE 255 Compu_LOD_slk_cyc_force 0 255 /end CHARACTERISTIC
/begin COMPU_METHOD Compu_LOD_slk_cyc_force " " RAT_FUNC "%.0" "cycles" COEFFS 0 1 0 0 0 1 /end COMPU_METHOD
/begin CHARACTERISTIC LOD_flk_Pdec "FaultConfig # LOD_flk_Pdec (Fault Condition:EPR feedback pressure fall >)" VALUE 0x001e2f2e /* @ECU_Address@LOD_flk_Pdec@0x01010518@ */ ECIPP_ALIGNMENT_SWORD 222 Compu_LOD_flk_Pdec -222 221.993225097656 /end CHARACTERISTIC
/begin COMPU_METHOD Compu_LOD_flk_Pdec " " RAT_FUNC "%.3" "in H2O" COEFFS 0 147.603603603604 0 0 0 1 /end COMPU_METHOD
/begin CHARACTERISTIC LOD_flk_tm "FaultConfig # LOD_flk_tm (Fault Condition:during test time limit of)" VALUE 0x001e5710 /* @ECU_Address@LOD_flk_tm@0x01010520@ */ ECIPP_ALIGNMENT_UWORD 66 Compu_LOD_flk_tm 0 65.535 /end CHARACTERISTIC
/begin COMPU_METHOD Compu_LOD_flk_tm " " RAT_FUNC "%.3" "sec" COEFFS 0 1000 0 0 0 1 /end COMPU_METHOD
/begin CHARACTERISTIC LOD_flk_eng_cyc "FaultConfig # LOD_flk_eng_cyc (Fault Condition:Number of engine warm cycles between runs)" VALUE 0x001e6de1 /* @ECU_Address@LOD_flk_eng_cyc@0x01010528@ */ ECIPP_ALIGNMENT_UBYTE 255 Compu_LOD_flk_eng_cyc 0 255 /end CHARACTERISTIC
/begin COMPU_METHOD Compu_LOD_flk_eng_cyc " " RAT_FUNC "%.0" "cycles" COEFFS 0 1 0 0 0 1 /end COMPU_METHOD
/begin CHARACTERISTIC LOD_flk_spk_inh_cyc "FaultConfig # LOD_flk_spk_inh_cyc (Fault Condition:Num crank cycles to inhibit spark on next start)" VALUE 0x001e6de2 /* @ECU_Address@LOD_flk_spk_inh_cyc@0x01010530@ */ ECIPP_ALIGNMENT_UBYTE 255 Compu_LOD_flk_spk_inh_cyc 0 255 /end CHARACTERISTIC
/begin COMPU_METHOD Compu_LOD_flk_spk_inh_cyc " " RAT_FUNC "%.0" "cycles" COEFFS 0 1 0 0 0 1 /end COMPU_METHOD
/begin CHARACTERISTIC LOD_flk_spk_inh_ECT "FaultConfig # LOD_flk_spk_inh_ECT (Fault Condition:when ECT >)" VALUE 0x001e570e /* @ECU_Address@LOD_flk_spk_inh_ECT@0x01010538@ */ ECIPP_ALIGNMENT_UWORD 564 Compu_LOD_flk_spk_inh_ECT -460 563.984375 /end CHARACTERISTIC
/begin COMPU_METHOD Compu_LOD_flk_spk_inh_ECT " " RAT_FUNC "%.3" "deg F" COEFFS 0 64 29440 0 0 1 /end COMPU_METHOD
/begin CHARACTERISTIC LOD_flk_cyc_force "FaultConfig # LOD_flk_cyc_force (Fault Condition:Number of engine cycles before forced test run)" VALUE 0x001e6de0 /* @ECU_Address@LOD_flk_cyc_force@0x01010540@ */ ECIPP_ALIGNMENT_UBYTE 255 Compu_LOD_flk_cyc_force 0 255 /end CHARACTERISTIC
/begin COMPU_METHOD Compu_LOD_flk_cyc_force " " RAT_FUNC "%.0" "cycles" COEFFS 0 1 0 0 0 1 /end COMPU_METHOD
/begin CHARACTERISTIC J1939_NG_Vdot_ratio "Fuel # J1939_NG_Vdot_ratio" VALUE 0x001e570a /* @ECU_Address@J1939_NG_Vdot_ratio@0x010106E8@ */ ECIPP_ALIGNMENT_UWORD 65535 Compu_J1939_NG_Vdot_ratio 0 65535 /end CHARACTERISTIC
/begin COMPU_METHOD Compu_J1939_NG_Vdot_ratio " " RAT_FUNC "%.0" "-" COEFFS 0 1 0 0 0 1 /end COMPU_METHOD
/begin CHARACTERISTIC LOD_flk_WARN_force "{LOD_flk_WARN_force&0xff=0:Disabled}{LOD_flk_WARN_force&0xff=1:Soft Warning}{LOD_flk_WARN_force&0xff=2:Hard Warning} (Fault Condition:Historic fault forced indication)" VALUE 0x001c87d7 /* @ECU_Address@LOD_flk_WARN_force@0x01010708@ */ ECIPP_ALIGNMENT_UBYTE 255 LOD_flk_WARN_force_COMPU_VTAB 0 255 BIT_MASK 0xff /end CHARACTERISTIC
/begin COMPU_METHOD LOD_flk_WARN_force_COMPU_VTAB "Verbal Table" TAB_VERB "%.0" "list" COMPU_TAB_REF LOD_flk_WARN_force_COMPU_VTAB_REF /end COMPU_METHOD
/begin COMPU_VTAB LOD_flk_WARN_force_COMPU_VTAB_REF "Verbal Table" TAB_VERB 3 0 "Disabled" 1 "Soft Warning" 2 "Hard Warning" DEFAULT_VALUE "UNKNOWN" /end COMPU_VTAB
/begin CHARACTERISTIC OILTL_temp_hi "FaultConfig # OILTL_temp_hi (Fault Condition:Oil temperature >)" VALUE 0x001c7e10 /* @ECU_Address@OILTL_temp_hi@0x01010960@ */ ECIPP_ALIGNMENT_UWORD 7732 Compu_OILTL_temp_hi -460 7731.875 /end CHARACTERISTIC
/begin COMPU_METHOD Compu_OILTL_temp_hi " " RAT_FUNC "%.3" "deg F" COEFFS 0 8 3680 0 0 1 /end COMPU_METHOD
/begin CHARACTERISTIC EGR_vlv_type "{EGR_vlv_type&0xff=0:Bidirectional}{EGR_vlv_type&0xff=1:Spring return}" VALUE 0x001c86da /* @ECU_Address@EGR_vlv_type@0x01010968@ */ ECIPP_ALIGNMENT_UBYTE 255 EGR_vlv_type_COMPU_VTAB 0 255 BIT_MASK 0xff /end CHARACTERISTIC
/begin COMPU_METHOD EGR_vlv_type_COMPU_VTAB "Verbal Table" TAB_VERB "%.0" "list" COMPU_TAB_REF EGR_vlv_type_COMPU_VTAB_REF /end COMPU_METHOD
/begin COMPU_VTAB EGR_vlv_type_COMPU_VTAB_REF "Verbal Table" TAB_VERB 2 0 "Bidirectional" 1 "Spring return" DEFAULT_VALUE "UNKNOWN" /end COMPU_VTAB
/begin CHARACTERISTIC EGR_vlv_DC_hi "FaultConfig # EGR_vlv_DC_hi (Fault Condition:EGR valve PWM duty cycle >)" VALUE 0x001c44ae /* @ECU_Address@EGR_vlv_DC_hi@0x01010970@ */ ECIPP_ALIGNMENT_SWORD 100 Compu_EGR_vlv_DC_hi -100 99.9969482421875 /end CHARACTERISTIC
/begin COMPU_METHOD Compu_EGR_vlv_DC_hi " " RAT_FUNC "%.3" "%" COEFFS 0 327.68 0 0 0 1 /end COMPU_METHOD
/begin CHARACTERISTIC EGR_vlv_0pct_dly "General # EGR_vlv_0pct_dly" VALUE 0x001c6efc /* @ECU_Address@EGR_vlv_0pct_dly@0x01010978@ */ ECIPP_ALIGNMENT_UWORD 65535 Compu_EGR_vlv_0pct_dly 0 65535 /end CHARACTERISTIC
/begin COMPU_METHOD Compu_EGR_vlv_0pct_dly " " RAT_FUNC "%.0" "ms" COEFFS 0 1 0 0 0 1 /end COMPU_METHOD
/begin CHARACTERISTIC EGR_vlv_temp_max "FaultConfig # EGR_vlv_temp_max (Fault Condition:Estimated EGR valve temperature >)" VALUE 0x001c3a94 /* @ECU_Address@EGR_vlv_temp_max@0x01010980@ */ ECIPP_ALIGNMENT_FLOAT32_IEEE 10000000000 Compu_EGR_vlv_temp_max -10000000000 10000000000 /end CHARACTERISTIC
/begin COMPU_METHOD Compu_EGR_vlv_temp_max " " RAT_FUNC "%.3" "deg C" COEFFS 0 1 0 0 0 1 /end COMPU_METHOD
/begin CHARACTERISTIC J1939_VI_fmt "{J1939_VI_fmt&0xff=0:Engine PN*SN*VIN}{J1939_VI_fmt&0xff=1:VIN*Engine PN*SN}" VALUE 0x001e6ddf /* @ECU_Address@J1939_VI_fmt@0x01010AB0@ */ ECIPP_ALIGNMENT_UBYTE 255 J1939_VI_fmt_COMPU_VTAB 0 255 BIT_MASK 0xff /end CHARACTERISTIC
/begin COMPU_METHOD J1939_VI_fmt_COMPU_VTAB "Verbal Table" TAB_VERB "%.0" "list" COMPU_TAB_REF J1939_VI_fmt_COMPU_VTAB_REF /end COMPU_METHOD
/begin COMPU_VTAB J1939_VI_fmt_COMPU_VTAB_REF "Verbal Table" TAB_VERB 2 0 "Engine PN*SN*VIN" 1 "VIN*Engine PN*SN" DEFAULT_VALUE "UNKNOWN" /end COMPU_VTAB
/begin CHARACTERISTIC CAC_eta_lo_Tsrc "{CAC_eta_lo_Tsrc&0xff=0:COT}{CAC_eta_lo_Tsrc&0xff=1:IAT}{CAC_eta_lo_Tsrc&0xff=2:TIAT} (Fault Condition:and temperature source)" VALUE 0x001e58eb /* @ECU_Address@CAC_eta_lo_Tsrc@0x01010B30@ */ ECIPP_ALIGNMENT_UBYTE 255 CAC_eta_lo_Tsrc_COMPU_VTAB 0 255 BIT_MASK 0xff /end CHARACTERISTIC
/begin COMPU_METHOD CAC_eta_lo_Tsrc_COMPU_VTAB "Verbal Table" TAB_VERB "%.0" "list" COMPU_TAB_REF CAC_eta_lo_Tsrc_COMPU_VTAB_REF /end COMPU_METHOD
/begin COMPU_VTAB CAC_eta_lo_Tsrc_COMPU_VTAB_REF "Verbal Table" TAB_VERB 3 0 "COT" 1 "IAT" 2 "TIAT" DEFAULT_VALUE "UNKNOWN" /end COMPU_VTAB
/begin CHARACTERISTIC CAC_eta_lo_TIP "FaultConfig # CAC_eta_lo_TIP (Fault Condition:and TIP >)" VALUE 0x001e37e0 /* @ECU_Address@CAC_eta_lo_TIP@0x01010B38@ */ ECIPP_ALIGNMENT_UWORD 256 Compu_CAC_eta_lo_TIP 0 255.99609375 /end CHARACTERISTIC
/begin COMPU_METHOD Compu_CAC_eta_lo_TIP " " RAT_FUNC "%.3" "psia" COEFFS 0 256 0 0 0 1 /end COMPU_METHOD
/begin CHARACTERISTIC PPEG_CVP1_fault "IOConfig # PPEG_CVP1_fault (Fault Condition:abs(CVP1 offset) sample >)" VALUE 0x001c7e4e /* @ECU_Address@PPEG_CVP1_fault@0x01010C30@ */ ECIPP_ALIGNMENT_UWORD 256 Compu_PPEG_CVP1_fault 0 255.99609375 /end CHARACTERISTIC
/begin COMPU_METHOD Compu_PPEG_CVP1_fault " " RAT_FUNC "%.3" "psi" COEFFS 0 256 0 0 0 1 /end COMPU_METHOD
/begin CHARACTERISTIC PPEG_CVP2_fault "IOConfig # PPEG_CVP2_fault (Fault Condition:abs(CVP2 offset) sample >)" VALUE 0x001c7e50 /* @ECU_Address@PPEG_CVP2_fault@0x01010C38@ */ ECIPP_ALIGNMENT_UWORD 256 Compu_PPEG_CVP2_fault 0 255.99609375 /end CHARACTERISTIC
/begin COMPU_METHOD Compu_PPEG_CVP2_fault " " RAT_FUNC "%.3" "psi" COEFFS 0 256 0 0 0 1 /end COMPU_METHOD
/begin CHARACTERISTIC CVCSP_Paux_cal "{CVCSP_Paux_cal&0xff=0:Aux Press A}{CVCSP_Paux_cal&0xff=1:Aux Press B}{CVCSP_Paux_cal&0xff=2:Aux Press C}{CVCSP_Paux_cal&0xff=3:Aux Press D}" VALUE 0x001C9C09 /* @ECU_Address@CVCSP_Paux_cal@0x01010C48@ */ ECIPP_ALIGNMENT_UBYTE 255 CVCSP_Paux_cal_COMPU_VTAB 0 255 BIT_MASK 0xff /end CHARACTERISTIC
/begin COMPU_METHOD CVCSP_Paux_cal_COMPU_VTAB "Verbal Table" TAB_VERB "%.0" "list" COMPU_TAB_REF CVCSP_Paux_cal_COMPU_VTAB_REF /end COMPU_METHOD
/begin COMPU_VTAB CVCSP_Paux_cal_COMPU_VTAB_REF "Verbal Table" TAB_VERB 4 0 "Aux Press A" 1 "Aux Press B" 2 "Aux Press C" 3 "Aux Press D" DEFAULT_VALUE "UNKNOWN" /end COMPU_VTAB
/begin CHARACTERISTIC CVDSP_Paux_cal "{CVDSP_Paux_cal&0xff=0:Aux Press A}{CVDSP_Paux_cal&0xff=1:Aux Press B}{CVDSP_Paux_cal&0xff=2:Aux Press C}{CVDSP_Paux_cal&0xff=3:Aux Press D}" VALUE 0x001C9C0F /* @ECU_Address@CVDSP_Paux_cal@0x01010C68@ */ ECIPP_ALIGNMENT_UBYTE 255 CVDSP_Paux_cal_COMPU_VTAB 0 255 BIT_MASK 0xff /end CHARACTERISTIC
/begin COMPU_METHOD CVDSP_Paux_cal_COMPU_VTAB "Verbal Table" TAB_VERB "%.0" "list" COMPU_TAB_REF CVDSP_Paux_cal_COMPU_VTAB_REF /end COMPU_METHOD
/begin COMPU_VTAB CVDSP_Paux_cal_COMPU_VTAB_REF "Verbal Table" TAB_VERB 4 0 "Aux Press A" 1 "Aux Press B" 2 "Aux Press C" 3 "Aux Press D" DEFAULT_VALUE "UNKNOWN" /end COMPU_VTAB
/begin CHARACTERISTIC CVPAUX1_Paux_cal "{CVPAUX1_Paux_cal&0xff=0:Aux Press A}{CVPAUX1_Paux_cal&0xff=1:Aux Press B}{CVPAUX1_Paux_cal&0xff=2:Aux Press C}{CVPAUX1_Paux_cal&0xff=3:Aux Press D}" VALUE 0x001C9C15 /* @ECU_Address@CVPAUX1_Paux_cal@0x01010C88@ */ ECIPP_ALIGNMENT_UBYTE 255 CVPAUX1_Paux_cal_COMPU_VTAB 0 255 BIT_MASK 0xff /end CHARACTERISTIC
/begin COMPU_METHOD CVPAUX1_Paux_cal_COMPU_VTAB "Verbal Table" TAB_VERB "%.0" "list" COMPU_TAB_REF CVPAUX1_Paux_cal_COMPU_VTAB_REF /end COMPU_METHOD
/begin COMPU_VTAB CVPAUX1_Paux_cal_COMPU_VTAB_REF "Verbal Table" TAB_VERB 4 0 "Aux Press A" 1 "Aux Press B" 2 "Aux Press C" 3 "Aux Press D" DEFAULT_VALUE "UNKNOWN" /end COMPU_VTAB
/begin CHARACTERISTIC CVPAUX2_Paux_cal "{CVPAUX2_Paux_cal&0xff=0:Aux Press A}{CVPAUX2_Paux_cal&0xff=1:Aux Press B}{CVPAUX2_Paux_cal&0xff=2:Aux Press C}{CVPAUX2_Paux_cal&0xff=3:Aux Press D}" VALUE 0x001C9C1B /* @ECU_Address@CVPAUX2_Paux_cal@0x01010CA8@ */ ECIPP_ALIGNMENT_UBYTE 255 CVPAUX2_Paux_cal_COMPU_VTAB 0 255 BIT_MASK 0xff /end CHARACTERISTIC
/begin COMPU_METHOD CVPAUX2_Paux_cal_COMPU_VTAB "Verbal Table" TAB_VERB "%.0" "list" COMPU_TAB_REF CVPAUX2_Paux_cal_COMPU_VTAB_REF /end COMPU_METHOD
/begin COMPU_VTAB CVPAUX2_Paux_cal_COMPU_VTAB_REF "Verbal Table" TAB_VERB 4 0 "Aux Press A" 1 "Aux Press B" 2 "Aux Press C" 3 "Aux Press D" DEFAULT_VALUE "UNKNOWN" /end COMPU_VTAB
/begin CHARACTERISTIC CVP_abs_def "General # CVP_abs_def" VALUE 0x001c4468 /* @ECU_Address@CVP_abs_def@0x01010D10@ */ ECIPP_ALIGNMENT_SWORD 32 Compu_CVP_abs_def -32 31.9990234375 /end CHARACTERISTIC
/begin COMPU_METHOD Compu_CVP_abs_def " " RAT_FUNC "%.3" "psia" COEFFS 0 1024 0 0 0 1 /end COMPU_METHOD
/begin CHARACTERISTIC CVP_dP_def "General # CVP_dP_def" VALUE 0x001c446a /* @ECU_Address@CVP_dP_def@0x01010D18@ */ ECIPP_ALIGNMENT_SWORD 32 Compu_CVP_dP_def -32 31.9990234375 /end CHARACTERISTIC
/begin COMPU_METHOD Compu_CVP_dP_def " " RAT_FUNC "%.3" "psia" COEFFS 0 1024 0 0 0 1 /end COMPU_METHOD
/begin CHARACTERISTIC CVCS_discon_mdota_min "FaultConfig # CVCS_discon_mdota_min (Fault Condition:Air mass  flow >)" VALUE 0x001e37f6 /* @ECU_Address@CVCS_discon_mdota_min@0x01010D20@ */ ECIPP_ALIGNMENT_UWORD 1024 Compu_CVCS_discon_mdota_min 0 1023.984375 /end CHARACTERISTIC
/begin COMPU_METHOD Compu_CVCS_discon_mdota_min " " RAT_FUNC "%.3" "g/sec" COEFFS 0 64 0 0 0 1 /end COMPU_METHOD
/begin CHARACTERISTIC CVCS_discon_pct "FaultConfig # CVCS_discon_pct (Fault Condition:a threshold of)" VALUE 0x001e37f8 /* @ECU_Address@CVCS_discon_pct@0x01010D28@ */ ECIPP_ALIGNMENT_UWORD 100 Compu_CVCS_discon_pct 0 99.9984741210938 /end CHARACTERISTIC
/begin COMPU_METHOD Compu_CVCS_discon_pct " " RAT_FUNC "%.3" "%" COEFFS 0 655.36 0 0 0 1 /end COMPU_METHOD
/begin CHARACTERISTIC CVCS_discon_tbl "{CVCS_discon_tbl&0xff=0:Pressure 1 lookup}{CVCS_discon_tbl&0xff=1:Pressure 2 lookup} (Fault Condition:of)" VALUE 0x001e58f4 /* @ECU_Address@CVCS_discon_tbl@0x01010D30@ */ ECIPP_ALIGNMENT_UBYTE 255 CVCS_discon_tbl_COMPU_VTAB 0 255 BIT_MASK 0xff /end CHARACTERISTIC
/begin COMPU_METHOD CVCS_discon_tbl_COMPU_VTAB "Verbal Table" TAB_VERB "%.0" "list" COMPU_TAB_REF CVCS_discon_tbl_COMPU_VTAB_REF /end COMPU_METHOD
/begin COMPU_VTAB CVCS_discon_tbl_COMPU_VTAB_REF "Verbal Table" TAB_VERB 2 0 "Pressure 1 lookup" 1 "Pressure 2 lookup" DEFAULT_VALUE "UNKNOWN" /end COMPU_VTAB
/begin CHARACTERISTIC CVDS_discon_mdota_min "FaultConfig # CVDS_discon_mdota_min (Fault Condition:Air mass  flow >)" VALUE 0x001e37fe /* @ECU_Address@CVDS_discon_mdota_min@0x01010D38@ */ ECIPP_ALIGNMENT_UWORD 1024 Compu_CVDS_discon_mdota_min 0 1023.984375 /end CHARACTERISTIC
/begin COMPU_METHOD Compu_CVDS_discon_mdota_min " " RAT_FUNC "%.3" "g/sec" COEFFS 0 64 0 0 0 1 /end COMPU_METHOD
/begin CHARACTERISTIC CVDS_discon_pct "FaultConfig # CVDS_discon_pct (Fault Condition:a threshold of)" VALUE 0x001e3800 /* @ECU_Address@CVDS_discon_pct@0x01010D40@ */ ECIPP_ALIGNMENT_UWORD 100 Compu_CVDS_discon_pct 0 99.9984741210938 /end CHARACTERISTIC
/begin COMPU_METHOD Compu_CVDS_discon_pct " " RAT_FUNC "%.3" "%" COEFFS 0 655.36 0 0 0 1 /end COMPU_METHOD
/begin CHARACTERISTIC CVDS_discon_tbl "{CVDS_discon_tbl&0xff=0:Pressure 1 lookup}{CVDS_discon_tbl&0xff=1:Pressure 2 lookup} (Fault Condition:of)" VALUE 0x001e58f6 /* @ECU_Address@CVDS_discon_tbl@0x01010D48@ */ ECIPP_ALIGNMENT_UBYTE 255 CVDS_discon_tbl_COMPU_VTAB 0 255 BIT_MASK 0xff /end CHARACTERISTIC
/begin COMPU_METHOD CVDS_discon_tbl_COMPU_VTAB "Verbal Table" TAB_VERB "%.0" "list" COMPU_TAB_REF CVDS_discon_tbl_COMPU_VTAB_REF /end COMPU_METHOD
/begin COMPU_VTAB CVDS_discon_tbl_COMPU_VTAB_REF "Verbal Table" TAB_VERB 2 0 "Pressure 1 lookup" 1 "Pressure 2 lookup" DEFAULT_VALUE "UNKNOWN" /end COMPU_VTAB
/begin CHARACTERISTIC ECT_sel "{ECT_sel&0xff=0:Standard input}{ECT_sel&0xff=1:Oil temperature input}" VALUE 0x001c86cd /* @ECU_Address@ECT_sel@0x01010D60@ */ ECIPP_ALIGNMENT_UBYTE 255 ECT_sel_COMPU_VTAB 0 255 BIT_MASK 0xff /end CHARACTERISTIC
/begin COMPU_METHOD ECT_sel_COMPU_VTAB "Verbal Table" TAB_VERB "%.0" "list" COMPU_TAB_REF ECT_sel_COMPU_VTAB_REF /end COMPU_METHOD
/begin COMPU_VTAB ECT_sel_COMPU_VTAB_REF "Verbal Table" TAB_VERB 2 0 "Standard input" 1 "Oil temperature input" DEFAULT_VALUE "UNKNOWN" /end COMPU_VTAB
/begin CHARACTERISTIC CVCS_discon_mdota_max "FaultConfig # CVCS_discon_mdota_max (Fault Condition:and air mass flow <)" VALUE 0x001e37f4 /* @ECU_Address@CVCS_discon_mdota_max@0x01010D98@ */ ECIPP_ALIGNMENT_UWORD 1024 Compu_CVCS_discon_mdota_max 0 1023.984375 /end CHARACTERISTIC
/begin COMPU_METHOD Compu_CVCS_discon_mdota_max " " RAT_FUNC "%.3" "g/sec" COEFFS 0 64 0 0 0 1 /end COMPU_METHOD
/begin CHARACTERISTIC CVDS_discon_mdota_max "FaultConfig # CVDS_discon_mdota_max (Fault Condition:and air mass flow <)" VALUE 0x001e37fc /* @ECU_Address@CVDS_discon_mdota_max@0x01010DA0@ */ ECIPP_ALIGNMENT_UWORD 1024 Compu_CVDS_discon_mdota_max 0 1023.984375 /end CHARACTERISTIC
/begin COMPU_METHOD Compu_CVDS_discon_mdota_max " " RAT_FUNC "%.3" "g/sec" COEFFS 0 64 0 0 0 1 /end COMPU_METHOD
/begin CHARACTERISTIC CVCS_discon_test "FaultConfig # CVCS_discon_test (Fault Condition:and pressure is)" VALUE 0x001e58f5 /* @ECU_Address@CVCS_discon_test@0x01010DA8@ */ ECIPP_ALIGNMENT_UBYTE 255 Compu_CVCS_discon_test 1 256 /end CHARACTERISTIC
/begin COMPU_METHOD Compu_CVCS_discon_test " " RAT_FUNC "%.0" "-" COEFFS 0 1 -1 0 0 1 /end COMPU_METHOD
/begin CHARACTERISTIC CVDS_discon_test "FaultConfig # CVDS_discon_test (Fault Condition:and pressure is)" VALUE 0x001e58f7 /* @ECU_Address@CVDS_discon_test@0x01010DB0@ */ ECIPP_ALIGNMENT_UBYTE 255 Compu_CVDS_discon_test 1 256 /end CHARACTERISTIC
/begin COMPU_METHOD Compu_CVDS_discon_test " " RAT_FUNC "%.0" "-" COEFFS 0 1 -1 0 0 1 /end COMPU_METHOD
/begin CHARACTERISTIC EGRdP_HiExp_p "Air # EGRdP_HiExp_p (Fault Condition:EGRdP (single point) >)" VALUE 0x001e2f1e /* @ECU_Address@EGRdP_HiExp_p@0x01010DC0@ */ ECIPP_ALIGNMENT_SWORD 32 Compu_EGRdP_HiExp_p -32 31.9990234375 /end CHARACTERISTIC
/begin COMPU_METHOD Compu_EGRdP_HiExp_p " " RAT_FUNC "%.3" "psi" COEFFS 0 1024 0 0 0 1 /end COMPU_METHOD
/begin CHARACTERISTIC EGRdP_LoExp_p "Air # EGRdP_LoExp_p (Fault Condition:EGRdP <)" VALUE 0x001e2f20 /* @ECU_Address@EGRdP_LoExp_p@0x01010DC8@ */ ECIPP_ALIGNMENT_SWORD 32 Compu_EGRdP_LoExp_p -32 31.9990234375 /end CHARACTERISTIC
/begin COMPU_METHOD Compu_EGRdP_LoExp_p " " RAT_FUNC "%.3" "psi" COEFFS 0 1024 0 0 0 1 /end COMPU_METHOD
/begin CHARACTERISTIC EGRdP_HiExp_mdot "Air # EGRdP_HiExp_mdot (Fault Condition:and EGR modeled flow <)" VALUE 0x001e0008 /* @ECU_Address@EGRdP_HiExp_mdot@0x01010DD0@ */ ECIPP_ALIGNMENT_FLOAT32_IEEE 10000000000 Compu_EGRdP_HiExp_mdot -10000000000 10000000000 /end CHARACTERISTIC
/begin COMPU_METHOD Compu_EGRdP_HiExp_mdot " " RAT_FUNC "%.3" "g/sec" COEFFS 0 1 0 0 0 1 /end COMPU_METHOD
/begin CHARACTERISTIC EGRdP_LoExp_mdot "Air # EGRdP_LoExp_mdot (Fault Condition:and EGR modeled flow >)" VALUE 0x001e000c /* @ECU_Address@EGRdP_LoExp_mdot@0x01010DD8@ */ ECIPP_ALIGNMENT_FLOAT32_IEEE 10000000000 Compu_EGRdP_LoExp_mdot -10000000000 10000000000 /end CHARACTERISTIC
/begin COMPU_METHOD Compu_EGRdP_LoExp_mdot " " RAT_FUNC "%.3" "g/sec" COEFFS 0 1 0 0 0 1 /end COMPU_METHOD
/begin CHARACTERISTIC EGRHP_OOR_minMAP "Air # EGRHP_OOR_minMAP (Fault Condition:and MAP load >)" VALUE 0x001e383e /* @ECU_Address@EGRHP_OOR_minMAP@0x01010DE0@ */ ECIPP_ALIGNMENT_UWORD 256 Compu_EGRHP_OOR_minMAP 0 255.99609375 /end CHARACTERISTIC
/begin COMPU_METHOD Compu_EGRHP_OOR_minMAP " " RAT_FUNC "%.3" "psia" COEFFS 0 256 0 0 0 1 /end COMPU_METHOD
/begin CHARACTERISTIC EGRHP_OOR_maxMAP "Air # EGRHP_OOR_maxMAP (Fault Condition:and MAP load <)" VALUE 0x001e383a /* @ECU_Address@EGRHP_OOR_maxMAP@0x01010DE8@ */ ECIPP_ALIGNMENT_UWORD 256 Compu_EGRHP_OOR_maxMAP 0 255.99609375 /end CHARACTERISTIC
/begin COMPU_METHOD Compu_EGRHP_OOR_maxMAP " " RAT_FUNC "%.3" "psia" COEFFS 0 256 0 0 0 1 /end COMPU_METHOD
/begin CHARACTERISTIC EGRHP_OOR_minRPM "Air # EGRHP_OOR_minRPM (Fault Condition:and RPM >)" VALUE 0x001e3840 /* @ECU_Address@EGRHP_OOR_minRPM@0x01010DF0@ */ ECIPP_ALIGNMENT_UWORD 65535 Compu_EGRHP_OOR_minRPM 0 65535 /end CHARACTERISTIC
/begin COMPU_METHOD Compu_EGRHP_OOR_minRPM " " RAT_FUNC "%.0" "rpm" COEFFS 0 1 0 0 0 1 /end COMPU_METHOD
/begin CHARACTERISTIC EGRHP_OOR_maxRPM "Air # EGRHP_OOR_maxRPM (Fault Condition:and RPM <)" VALUE 0x001e383c /* @ECU_Address@EGRHP_OOR_maxRPM@0x01010DF8@ */ ECIPP_ALIGNMENT_UWORD 65535 Compu_EGRHP_OOR_maxRPM 0 65535 /end CHARACTERISTIC
/begin COMPU_METHOD Compu_EGRHP_OOR_maxRPM " " RAT_FUNC "%.0" "rpm" COEFFS 0 1 0 0 0 1 /end COMPU_METHOD
/begin CHARACTERISTIC EGRHP_OOR_vlv_min "Air # EGRHP_OOR_vlv_min (Fault Condition:and EGR valve position >)" VALUE 0x001e3842 /* @ECU_Address@EGRHP_OOR_vlv_min@0x01010E00@ */ ECIPP_ALIGNMENT_UWORD 100 Compu_EGRHP_OOR_vlv_min 0 99.9984741210938 /end CHARACTERISTIC
/begin COMPU_METHOD Compu_EGRHP_OOR_vlv_min " " RAT_FUNC "%.3" "%" COEFFS 0 655.36 0 0 0 1 /end COMPU_METHOD
/begin CHARACTERISTIC EGRHP_OOR_lim_neg "Air # EGRHP_OOR_lim_neg (Fault Condition:EGRHP < (TIP - EGR Cooler Drop) -)" VALUE 0x001e0000 /* @ECU_Address@EGRHP_OOR_lim_neg@0x01010E08@ */ ECIPP_ALIGNMENT_FLOAT32_IEEE 10000000000 Compu_EGRHP_OOR_lim_neg -10000000000 10000000000 /end CHARACTERISTIC
/begin COMPU_METHOD Compu_EGRHP_OOR_lim_neg " " RAT_FUNC "%.3" "psi" COEFFS 0 1 0 0 0 1 /end COMPU_METHOD
/begin CHARACTERISTIC EGRHP_OOR_lim_pos "Air # EGRHP_OOR_lim_pos (Fault Condition:or EGRHP > (TIP - EGR Cooler Drop) +)" VALUE 0x001e0004 /* @ECU_Address@EGRHP_OOR_lim_pos@0x01010E10@ */ ECIPP_ALIGNMENT_FLOAT32_IEEE 10000000000 Compu_EGRHP_OOR_lim_pos -10000000000 10000000000 /end CHARACTERISTIC
/begin COMPU_METHOD Compu_EGRHP_OOR_lim_pos " " RAT_FUNC "%.3" "psi" COEFFS 0 1 0 0 0 1 /end COMPU_METHOD
/begin CHARACTERISTIC PPEG_EGRdP_fault "IOConfig # PPEG_EGRdP_fault (Fault Condition:abs(EGRdP offset) sample >)" VALUE 0x001e2f34 /* @ECU_Address@PPEG_EGRdP_fault@0x01010E18@ */ ECIPP_ALIGNMENT_SWORD 32 Compu_PPEG_EGRdP_fault -32 31.9990234375 /end CHARACTERISTIC
/begin COMPU_METHOD Compu_PPEG_EGRdP_fault " " RAT_FUNC "%.3" "psi" COEFFS 0 1024 0 0 0 1 /end COMPU_METHOD
/begin CHARACTERISTIC EGRHP_maxv "Air # EGRHP_maxv (Fault Condition:EGRHP voltage >)" VALUE 0x001e3844 /* @ECU_Address@EGRHP_maxv@0x01010E20@ */ ECIPP_ALIGNMENT_UWORD 5 Compu_EGRHP_maxv 0 5.00114468864469 /end CHARACTERISTIC
/begin COMPU_METHOD Compu_EGRHP_maxv " " RAT_FUNC "%.3" "volts" COEFFS 0 13104 0 0 0 1 /end COMPU_METHOD
/begin CHARACTERISTIC EGRHP_minv "Air # EGRHP_minv (Fault Condition:EGRHP voltage <)" VALUE 0x001e3846 /* @ECU_Address@EGRHP_minv@0x01010E28@ */ ECIPP_ALIGNMENT_UWORD 5 Compu_EGRHP_minv 0 5.00114468864469 /end CHARACTERISTIC
/begin COMPU_METHOD Compu_EGRHP_minv " " RAT_FUNC "%.3" "volts" COEFFS 0 13104 0 0 0 1 /end COMPU_METHOD
/begin CHARACTERISTIC EGRdP_maxv "Air # EGRdP_maxv (Fault Condition:EGRdP voltage >)" VALUE 0x001e3854 /* @ECU_Address@EGRdP_maxv@0x01010E30@ */ ECIPP_ALIGNMENT_UWORD 5 Compu_EGRdP_maxv 0 5.00114468864469 /end CHARACTERISTIC
/begin COMPU_METHOD Compu_EGRdP_maxv " " RAT_FUNC "%.3" "volts" COEFFS 0 13104 0 0 0 1 /end COMPU_METHOD
/begin CHARACTERISTIC EGRdP_minv "Air # EGRdP_minv (Fault Condition:EGRdP voltage <)" VALUE 0x001e3856 /* @ECU_Address@EGRdP_minv@0x01010E38@ */ ECIPP_ALIGNMENT_UWORD 5 Compu_EGRdP_minv 0 5.00114468864469 /end CHARACTERISTIC
/begin COMPU_METHOD Compu_EGRdP_minv " " RAT_FUNC "%.3" "volts" COEFFS 0 13104 0 0 0 1 /end COMPU_METHOD
/begin CHARACTERISTIC fm_induce_l1_ll "{fm_induce_l1_ll&0xff=0:Disabled}{fm_induce_l1_ll&0xff=1:Table 1 / Gasoline Load-Limit}{fm_induce_l1_ll&0xff=2:Table 2 / LPG Load-Limit}{fm_induce_l1_ll&0xff=3:Table 3 / NG Load-Limit}{fm_induce_l1_ll&0xff=4:Table 4 / Power Load-Limit}{fm_induce_l1_ll&0xf" VALUE 0x001ecc9c /* @ECU_Address@fm_induce_l1_ll@0x01010E58@ */ ECIPP_ALIGNMENT_UBYTE 255 fm_induce_l1_ll_COMPU_VTAB 0 255 BIT_MASK 0xff /end CHARACTERISTIC
/begin COMPU_METHOD fm_induce_l1_ll_COMPU_VTAB "Verbal Table" TAB_VERB "%.0" "list" COMPU_TAB_REF fm_induce_l1_ll_COMPU_VTAB_REF /end COMPU_METHOD
/begin COMPU_VTAB fm_induce_l1_ll_COMPU_VTAB_REF "Verbal Table" TAB_VERB 9 0 "Disabled" 1 "Table 1 / Gasoline Load-Limit" 2 "Table 2 / LPG Load-Limit" 3 "Table 3 / NG Load-Limit" 4 "Table 4 / Power Load-Limit" 5 "Table 5" 6 "Table 6" 7 "Table 7" 8 "Table 8" DEFAULT_VALUE "UNKNOWN" /end COMPU_VTAB
/begin CHARACTERISTIC fm_induce_l3_km "FaultConfig # fm_induce_l3_km" VALUE 0x001e58d8 /* @ECU_Address@fm_induce_l3_km@0x01010E60@ */ ECIPP_ALIGNMENT_UWORD 256 Compu_fm_induce_l3_km 0 255.99609375 /end CHARACTERISTIC
/begin COMPU_METHOD Compu_fm_induce_l3_km " " RAT_FUNC "%.3" "km/hr" COEFFS 0 256 0 0 0 1 /end COMPU_METHOD
/begin MEASUREMENT VDS_ena "Calibration Switch{VDS_ena&0xff=0:Request Standard}{VDS_ena&0xff=1:Request Variant}" UBYTE VDS_ena_COMPU_VTAB 0 0 0 255 ECU_ADDRESS 0x01010EB0 BIT_MASK 0xff /end MEASUREMENT
/begin COMPU_METHOD VDS_ena_COMPU_VTAB "Verbal Table" TAB_VERB "%.0" "list" COMPU_TAB_REF VDS_ena_COMPU_VTAB_REF /end COMPU_METHOD
/begin COMPU_VTAB VDS_ena_COMPU_VTAB_REF "Verbal Table" TAB_VERB 2 0 "Request Standard" 1 "Request Variant" DEFAULT_VALUE "UNKNOWN" /end COMPU_VTAB
/begin CHARACTERISTIC CATmon_disable "{CATmon_disable&0xff=0:None}{CATmon_disable&0xff=1:Sensor low voltage faulted}{CATmon_disable&0xff=2:Sensor high voltage faulted}" VALUE 0x001e58ec /* @ECU_Address@CATmon_disable@0x01010ED0@ */ ECIPP_ALIGNMENT_UBYTE 255 CATmon_disable_COMPU_VTAB 0 255 BIT_MASK 0xff /end CHARACTERISTIC
/begin COMPU_METHOD CATmon_disable_COMPU_VTAB "Verbal Table" TAB_VERB "%.0" "list" COMPU_TAB_REF CATmon_disable_COMPU_VTAB_REF /end COMPU_METHOD
/begin COMPU_VTAB CATmon_disable_COMPU_VTAB_REF "Verbal Table" TAB_VERB 3 0 "None" 1 "Sensor low voltage faulted" 2 "Sensor high voltage faulted" DEFAULT_VALUE "UNKNOWN" /end COMPU_VTAB
/begin CHARACTERISTIC OILTL_level_lo "FaultConfig # OILTL_level_lo (Fault Condition:Oil level <)" VALUE 0x001c7e0e /* @ECU_Address@OILTL_level_lo@0x01010EE8@ */ ECIPP_ALIGNMENT_UWORD 250 Compu_OILTL_level_lo 0 249.996185302734 /end CHARACTERISTIC
/begin COMPU_METHOD Compu_OILTL_level_lo " " RAT_FUNC "%.3" "level %" COEFFS 0 262.144 0 0 0 1 /end COMPU_METHOD
/begin CHARACTERISTIC AFILTdP_Paux_cal "{AFILTdP_Paux_cal&0xff=0:Aux Press A}{AFILTdP_Paux_cal&0xff=1:Aux Press B}{AFILTdP_Paux_cal&0xff=2:Aux Press C}{AFILTdP_Paux_cal&0xff=3:Aux Press D}" VALUE 0x001c8673 /* @ECU_Address@AFILTdP_Paux_cal@0x01011448@ */ ECIPP_ALIGNMENT_UBYTE 255 AFILTdP_Paux_cal_COMPU_VTAB 0 255 BIT_MASK 0xff /end CHARACTERISTIC
/begin COMPU_METHOD AFILTdP_Paux_cal_COMPU_VTAB "Verbal Table" TAB_VERB "%.0" "list" COMPU_TAB_REF AFILTdP_Paux_cal_COMPU_VTAB_REF /end COMPU_METHOD
/begin COMPU_VTAB AFILTdP_Paux_cal_COMPU_VTAB_REF "Verbal Table" TAB_VERB 4 0 "Aux Press A" 1 "Aux Press B" 2 "Aux Press C" 3 "Aux Press D" DEFAULT_VALUE "UNKNOWN" /end COMPU_VTAB
/begin CHARACTERISTIC MFG_comm_tout "FaultConfig # MFG_comm_tout (Fault Condition:No packets received within)" VALUE 0x001CA000 /* @ECU_Address@MFG_comm_tout@0x01011648@ */ ECIPP_ALIGNMENT_UWORD 65535 Compu_MFG_comm_tout 0 65535 /end CHARACTERISTIC
/begin COMPU_METHOD Compu_MFG_comm_tout " " RAT_FUNC "%.0" "ms" COEFFS 0 1 0 0 0 1 /end COMPU_METHOD
/begin CHARACTERISTIC MFA_comm_tout "FaultConfig # MFA_comm_tout (Fault Condition:No packets received within)" VALUE 0x001C9FEC /* @ECU_Address@MFA_comm_tout@0x01011738@ */ ECIPP_ALIGNMENT_UWORD 65535 Compu_MFA_comm_tout 0 65535 /end CHARACTERISTIC
/begin COMPU_METHOD Compu_MFA_comm_tout " " RAT_FUNC "%.0" "ms" COEFFS 0 1 0 0 0 1 /end COMPU_METHOD
/begin CHARACTERISTIC MFG_hsd_comm_tout "FaultConfig # MFG_hsd_comm_tout (Fault Condition:No high speed data packets received within)" VALUE 0x001CA002 /* @ECU_Address@MFG_hsd_comm_tout@0x01011808@ */ ECIPP_ALIGNMENT_UWORD 65535 Compu_MFG_hsd_comm_tout 0 65535 /end CHARACTERISTIC
/begin COMPU_METHOD Compu_MFG_hsd_comm_tout " " RAT_FUNC "%.0" "ms" COEFFS 0 1 0 0 0 1 /end COMPU_METHOD
/begin CHARACTERISTIC MFA_hsd_comm_tout "FaultConfig # MFA_hsd_comm_tout (Fault Condition:No high speed data packets received within)" VALUE 0x001C9FEE /* @ECU_Address@MFA_hsd_comm_tout@0x01011810@ */ ECIPP_ALIGNMENT_UWORD 65535 Compu_MFA_hsd_comm_tout 0 65535 /end CHARACTERISTIC
/begin COMPU_METHOD Compu_MFA_hsd_comm_tout " " RAT_FUNC "%.0" "ms" COEFFS 0 1 0 0 0 1 /end COMPU_METHOD
/begin CHARACTERISTIC NOx_hi_ECT "FaultConfig # NOx_hi_ECT (Fault Condition:ECT >)" VALUE 0x001e571a /* @ECU_Address@NOx_hi_ECT@0x010118A8@ */ ECIPP_ALIGNMENT_UWORD 564 Compu_NOx_hi_ECT -460 563.984375 /end CHARACTERISTIC
/begin COMPU_METHOD Compu_NOx_hi_ECT " " RAT_FUNC "%.3" "deg F" COEFFS 0 64 29440 0 0 1 /end COMPU_METHOD
/begin CHARACTERISTIC NOx_hi_ppm "FaultConfig # NOx_hi_ppm (Fault Condition:and Postcat NOx >)" VALUE 0x001e571c /* @ECU_Address@NOx_hi_ppm@0x010118B8@ */ ECIPP_ALIGNMENT_UWORD 4096 Compu_NOx_hi_ppm 0 4095.9375 /end CHARACTERISTIC
/begin COMPU_METHOD Compu_NOx_hi_ppm " " RAT_FUNC "%.3" "ppm" COEFFS 0 16 0 0 0 1 /end COMPU_METHOD
/begin CHARACTERISTIC CVP1_hi "FaultConfig # CVP1_hi (Fault Condition:and CVP1 >)" VALUE 0x001e2f12 /* @ECU_Address@CVP1_hi@0x010118D0@ */ ECIPP_ALIGNMENT_SWORD 32 Compu_CVP1_hi -32 31.9990234375 /end CHARACTERISTIC
/begin COMPU_METHOD Compu_CVP1_hi " " RAT_FUNC "%.3" "psi[a]" COEFFS 0 1024 0 0 0 1 /end COMPU_METHOD
/begin CHARACTERISTIC CVP1_lo "FaultConfig # CVP1_lo (Fault Condition:and CVP1 <)" VALUE 0x001e2f14 /* @ECU_Address@CVP1_lo@0x010118D8@ */ ECIPP_ALIGNMENT_SWORD 32 Compu_CVP1_lo -32 31.9990234375 /end CHARACTERISTIC
/begin COMPU_METHOD Compu_CVP1_lo " " RAT_FUNC "%.3" "psi[a]" COEFFS 0 1024 0 0 0 1 /end COMPU_METHOD
/begin CHARACTERISTIC CVP2_hi "FaultConfig # CVP2_hi (Fault Condition:and CVP2 >)" VALUE 0x001e2f16 /* @ECU_Address@CVP2_hi@0x010118E0@ */ ECIPP_ALIGNMENT_SWORD 32 Compu_CVP2_hi -32 31.9990234375 /end CHARACTERISTIC
/begin COMPU_METHOD Compu_CVP2_hi " " RAT_FUNC "%.3" "psi[a]" COEFFS 0 1024 0 0 0 1 /end COMPU_METHOD
/begin CHARACTERISTIC CVP2_lo "FaultConfig # CVP2_lo (Fault Condition:and CVP2 <)" VALUE 0x001e2f18 /* @ECU_Address@CVP2_lo@0x010118E8@ */ ECIPP_ALIGNMENT_SWORD 32 Compu_CVP2_lo -32 31.9990234375 /end CHARACTERISTIC
/begin COMPU_METHOD Compu_CVP2_lo " " RAT_FUNC "%.3" "psi[a]" COEFFS 0 1024 0 0 0 1 /end COMPU_METHOD
/begin CHARACTERISTIC CVP1_hi_MAP "FaultConfig # CVP1_hi_MAP (Fault Condition:MAP >)" VALUE 0x001e3802 /* @ECU_Address@CVP1_hi_MAP@0x010118F0@ */ ECIPP_ALIGNMENT_UWORD 256 Compu_CVP1_hi_MAP 0 255.99609375 /end CHARACTERISTIC
/begin COMPU_METHOD Compu_CVP1_hi_MAP " " RAT_FUNC "%.3" "psia" COEFFS 0 256 0 0 0 1 /end COMPU_METHOD
/begin CHARACTERISTIC CVP1_lo_MAP "FaultConfig # CVP1_lo_MAP (Fault Condition:MAP >)" VALUE 0x001e3804 /* @ECU_Address@CVP1_lo_MAP@0x010118F8@ */ ECIPP_ALIGNMENT_UWORD 256 Compu_CVP1_lo_MAP 0 255.99609375 /end CHARACTERISTIC
/begin COMPU_METHOD Compu_CVP1_lo_MAP " " RAT_FUNC "%.3" "psia" COEFFS 0 256 0 0 0 1 /end COMPU_METHOD
/begin CHARACTERISTIC CVP2_hi_MAP "FaultConfig # CVP2_hi_MAP (Fault Condition:MAP >)" VALUE 0x001e3806 /* @ECU_Address@CVP2_hi_MAP@0x01011900@ */ ECIPP_ALIGNMENT_UWORD 256 Compu_CVP2_hi_MAP 0 255.99609375 /end CHARACTERISTIC
/begin COMPU_METHOD Compu_CVP2_hi_MAP " " RAT_FUNC "%.3" "psia" COEFFS 0 256 0 0 0 1 /end COMPU_METHOD
/begin CHARACTERISTIC CVP2_lo_MAP "FaultConfig # CVP2_lo_MAP (Fault Condition:MAP >)" VALUE 0x001e3808 /* @ECU_Address@CVP2_lo_MAP@0x01011908@ */ ECIPP_ALIGNMENT_UWORD 256 Compu_CVP2_lo_MAP 0 255.99609375 /end CHARACTERISTIC
/begin COMPU_METHOD Compu_CVP2_lo_MAP " " RAT_FUNC "%.3" "psia" COEFFS 0 256 0 0 0 1 /end COMPU_METHOD
/begin CHARACTERISTIC controller_flash "{controller_flash&0xff=0:SH Base}{controller_flash&0xff=1:SH Extended}" VALUE 0x001ecc80 /* @ECU_Address@controller_flash@0x01011930@ */ ECIPP_ALIGNMENT_UBYTE 255 controller_flash_COMPU_VTAB 0 255 BIT_MASK 0xff /end CHARACTERISTIC
/begin COMPU_METHOD controller_flash_COMPU_VTAB "Verbal Table" TAB_VERB "%.0" "list" COMPU_TAB_REF controller_flash_COMPU_VTAB_REF /end COMPU_METHOD
/begin COMPU_VTAB controller_flash_COMPU_VTAB_REF "Verbal Table" TAB_VERB 2 0 "SH Base" 1 "SH Extended" DEFAULT_VALUE "UNKNOWN" /end COMPU_VTAB
/begin CHARACTERISTIC FRO_sleep "{FRO_sleep&0xff=0:Disabled}{FRO_sleep&0xff=1:Enabled}" VALUE 0x001e6db9 /* @ECU_Address@FRO_sleep@0x01011978@ */ ECIPP_ALIGNMENT_UBYTE 255 FRO_sleep_COMPU_VTAB 0 255 BIT_MASK 0xff /end CHARACTERISTIC
/begin COMPU_METHOD FRO_sleep_COMPU_VTAB "Verbal Table" TAB_VERB "%.0" "list" COMPU_TAB_REF FRO_sleep_COMPU_VTAB_REF /end COMPU_METHOD
/begin COMPU_VTAB FRO_sleep_COMPU_VTAB_REF "Verbal Table" TAB_VERB 2 0 "Disabled" 1 "Enabled" DEFAULT_VALUE "UNKNOWN" /end COMPU_VTAB
/begin CHARACTERISTIC EGRO_postlk_EGRdP "Air # EGRO_postlk_EGRdP (Fault Condition:EGRdP (single point) >)" VALUE 0x001c0272 /* @ECU_Address@EGRO_postlk_EGRdP@0x01011AD0@ */ ECIPP_ALIGNMENT_SWORD 32 Compu_EGRO_postlk_EGRdP -32 31.9990234375 /end CHARACTERISTIC
/begin COMPU_METHOD Compu_EGRO_postlk_EGRdP " " RAT_FUNC "%.3" "psi" COEFFS 0 1024 0 0 0 1 /end COMPU_METHOD
/begin CHARACTERISTIC EGRO_postlk_rpmdt "Air # EGRO_postlk_rpmdt (Fault Condition:and dRPM/dt <)" VALUE 0x001c0050 /* @ECU_Address@EGRO_postlk_rpmdt@0x01011AD8@ */ ECIPP_ALIGNMENT_FLOAT32_IEEE 10000000000 Compu_EGRO_postlk_rpmdt -10000000000 10000000000 /end CHARACTERISTIC
/begin COMPU_METHOD Compu_EGRO_postlk_rpmdt " " RAT_FUNC "%.3" "rpm/s" COEFFS 0 0.001 0 0 0 1 /end COMPU_METHOD
/begin CHARACTERISTIC CM_unresp_FSO_tm "CL # CM_unresp_FSO_tm (Fault Condition:throttle open FSO active for >)" VALUE 0x001e37e2 /* @ECU_Address@CM_unresp_FSO_tm@0x01011BD0@ */ ECIPP_ALIGNMENT_UWORD 66 Compu_CM_unresp_FSO_tm 0 65.535 /end CHARACTERISTIC
/begin COMPU_METHOD Compu_CM_unresp_FSO_tm " " RAT_FUNC "%.3" "sec" COEFFS 0 1000 0 0 0 1 /end COMPU_METHOD
/begin CHARACTERISTIC CM_unresp_phi_tm "CL # CM_unresp_phi_tm (Fault Condition:for this time after FSO exit:)" VALUE 0x001e37ec /* @ECU_Address@CM_unresp_phi_tm@0x01011BD8@ */ ECIPP_ALIGNMENT_UWORD 66 Compu_CM_unresp_phi_tm 0 65.535 /end CHARACTERISTIC
/begin COMPU_METHOD Compu_CM_unresp_phi_tm " " RAT_FUNC "%.3" "sec" COEFFS 0 1000 0 0 0 1 /end COMPU_METHOD
/begin CHARACTERISTIC CM_unresp_maxV "CL # CM_unresp_maxV (Fault Condition:and post-cat sensor voltage >)" VALUE 0x001e37e4 /* @ECU_Address@CM_unresp_maxV@0x01011BE0@ */ ECIPP_ALIGNMENT_UWORD 16 Compu_CM_unresp_maxV 0 15.999755859375 /end CHARACTERISTIC
/begin COMPU_METHOD Compu_CM_unresp_maxV " " RAT_FUNC "%.3" "volts" COEFFS 0 4096 0 0 0 1 /end COMPU_METHOD
/begin CHARACTERISTIC CM_unresp_min_MAP "CL # CM_unresp_min_MAP (Fault Condition:MAP >)" VALUE 0x001e37e6 /* @ECU_Address@CM_unresp_min_MAP@0x01011BE8@ */ ECIPP_ALIGNMENT_UWORD 256 Compu_CM_unresp_min_MAP 0 255.99609375 /end CHARACTERISTIC
/begin COMPU_METHOD Compu_CM_unresp_min_MAP " " RAT_FUNC "%.3" "psia" COEFFS 0 256 0 0 0 1 /end COMPU_METHOD
/begin CHARACTERISTIC CM_unresp_min_RPM "CL # CM_unresp_min_RPM (Fault Condition:and RPM >)" VALUE 0x001e37e8 /* @ECU_Address@CM_unresp_min_RPM@0x01011BF0@ */ ECIPP_ALIGNMENT_UWORD 65535 Compu_CM_unresp_min_RPM 0 65535 /end CHARACTERISTIC
/begin COMPU_METHOD Compu_CM_unresp_min_RPM " " RAT_FUNC "%.0" "rpm" COEFFS 0 1 0 0 0 1 /end COMPU_METHOD
/begin CHARACTERISTIC CM_unresp_pst_sw "CL # CM_unresp_pst_sw (Fault Condition:and post-cat sensor voltage <)" VALUE 0x001e37ee /* @ECU_Address@CM_unresp_pst_sw@0x01011BF8@ */ ECIPP_ALIGNMENT_UWORD 16 Compu_CM_unresp_pst_sw 0 15.999755859375 /end CHARACTERISTIC
/begin COMPU_METHOD Compu_CM_unresp_pst_sw " " RAT_FUNC "%.3" "volts" COEFFS 0 4096 0 0 0 1 /end COMPU_METHOD
/begin CHARACTERISTIC MFG_RLV_FROmax "FaultConfig # MFG_RLV_FROmax (Fault Condition:Fuel run-out engine run time >)" VALUE 0x001c7d8e /* @ECU_Address@MFG_RLV_FROmax@0x01011C40@ */ ECIPP_ALIGNMENT_UWORD 65535 Compu_MFG_RLV_FROmax 0 65535 /end CHARACTERISTIC
/begin COMPU_METHOD Compu_MFG_RLV_FROmax " " RAT_FUNC "%.0" "ms" COEFFS 0 1 0 0 0 1 /end COMPU_METHOD
/begin CHARACTERISTIC MFG_RLV_eng_cyc "FaultConfig # MFG_RLV_eng_cyc (Fault Condition:Number of engine warm cycles between runs)" VALUE 0x001e6de6 /* @ECU_Address@MFG_RLV_eng_cyc@0x01011C48@ */ ECIPP_ALIGNMENT_UBYTE 255 Compu_MFG_RLV_eng_cyc 0 255 /end CHARACTERISTIC
/begin COMPU_METHOD Compu_MFG_RLV_eng_cyc " " RAT_FUNC "%.0" "cycles" COEFFS 0 1 0 0 0 1 /end COMPU_METHOD
/begin CHARACTERISTIC MFG_RLV_run_force "FaultConfig # MFG_RLV_run_force (Fault Condition:Engine hours elapsed before forced test run)" VALUE 0x001e2f00 /* @ECU_Address@MFG_RLV_run_force@0x01011C50@ */ ECIPP_ALIGNMENT_ULONG 1193046 Compu_MFG_RLV_run_force 0 1193046.47083333 /end CHARACTERISTIC
/begin COMPU_METHOD Compu_MFG_RLV_run_force " " RAT_FUNC "%.3" "hours" COEFFS 0 3600 0 0 0 1 /end COMPU_METHOD
/begin CHARACTERISTIC inj_sweep_tout "Injector individual kill timeout" VALUE 0x001c8486 /* @ECU_Address@inj_sweep_tout@0x01011C78@ */ ECIPP_ALIGNMENT_UWORD 66 Compu_inj_sweep_tout 0 65.535 MAX_REFRESH 6 1 /end CHARACTERISTIC
/begin COMPU_METHOD Compu_inj_sweep_tout " " RAT_FUNC "%.1" "sec" COEFFS 0 1000 0 0 0 1 /end COMPU_METHOD
/begin CHARACTERISTIC inj_sweep_delta "Injector good CL BM delta" VALUE 0x001c6d20 /* @ECU_Address@inj_sweep_delta@0x01011C80@ */ ECIPP_ALIGNMENT_SWORD 100 Compu_inj_sweep_delta -100 99.9969482421875 MAX_REFRESH 6 1 /end CHARACTERISTIC
/begin COMPU_METHOD Compu_inj_sweep_delta " " RAT_FUNC "%.1" "%" COEFFS 0 327.68 0 0 0 1 /end COMPU_METHOD
/begin CHARACTERISTIC inj_sweep_CL_delay "Injector sweep CL reset delay" VALUE 0x001c4404 /* @ECU_Address@inj_sweep_CL_delay@0x01011C88@ */ ECIPP_ALIGNMENT_ULONG 4294967 Compu_inj_sweep_CL_delay 0 4294967.295 MAX_REFRESH 6 1 /end CHARACTERISTIC
/begin COMPU_METHOD Compu_inj_sweep_CL_delay " " RAT_FUNC "%.1" "sec" COEFFS 0 1000 0 0 0 1 /end COMPU_METHOD
/begin CHARACTERISTIC TWCmod_Kphi_gain "TWC observer gain" VALUE 0x001c3d84 /* @ECU_Address@TWCmod_Kphi_gain@0x01011CD8@ */ ECIPP_ALIGNMENT_FLOAT32_IEEE 10000000000 Compu_TWCmod_Kphi_gain -10000000000 10000000000 /end CHARACTERISTIC
/begin COMPU_METHOD Compu_TWCmod_Kphi_gain " " RAT_FUNC "%.3" "-" COEFFS 0 1 0 0 0 1 /end COMPU_METHOD
/begin CHARACTERISTIC TWCmod_K_OSC "TWC phi drift delay constant" VALUE 0x001c3d80 /* @ECU_Address@TWCmod_K_OSC@0x01011CF0@ */ ECIPP_ALIGNMENT_FLOAT32_IEEE 10000000000 Compu_TWCmod_K_OSC -10000000000 10000000000 /end CHARACTERISTIC
/begin COMPU_METHOD Compu_TWCmod_K_OSC " " RAT_FUNC "%.1" "-" COEFFS 0 1 0 0 0 1 /end COMPU_METHOD
/begin CHARACTERISTIC TWCmod_phi_corr_max "TWC model phi correction upper limit" VALUE 0x001c3d9c /* @ECU_Address@TWCmod_phi_corr_max@0x01011D08@ */ ECIPP_ALIGNMENT_FLOAT32_IEEE 10000000000 Compu_TWCmod_phi_corr_max -10000000000 10000000000 /end CHARACTERISTIC
/begin COMPU_METHOD Compu_TWCmod_phi_corr_max " " RAT_FUNC "%.3" "-" COEFFS 0 1 0 0 0 1 /end COMPU_METHOD
/begin CHARACTERISTIC TWCmod_phi_corr_min "TWC model phi correction lower limit" VALUE 0x001c3da0 /* @ECU_Address@TWCmod_phi_corr_min@0x01011D10@ */ ECIPP_ALIGNMENT_FLOAT32_IEEE 10000000000 Compu_TWCmod_phi_corr_min -10000000000 10000000000 /end CHARACTERISTIC
/begin COMPU_METHOD Compu_TWCmod_phi_corr_min " " RAT_FUNC "%.3" "-" COEFFS 0 1 0 0 0 1 /end COMPU_METHOD
/begin CHARACTERISTIC XEGOi_OOR_phi_min "FaultConfig # XEGOi_OOR_phi_min (Fault Condition:Pre-cat phi <)" VALUE 0x001e58cc /* @ECU_Address@XEGOi_OOR_phi_min@0x01011D20@ */ ECIPP_ALIGNMENT_UWORD 4 Compu_XEGOi_OOR_phi_min 0 3.99993896484375 /end CHARACTERISTIC
/begin COMPU_METHOD Compu_XEGOi_OOR_phi_min " " RAT_FUNC "%.3" "phi" COEFFS 0 16384 0 0 0 1 /end COMPU_METHOD
/begin CHARACTERISTIC XEGOi_OOR_phi_max "FaultConfig # XEGOi_OOR_phi_max (Fault Condition:or Pre-cat phi >)" VALUE 0x001e58ca /* @ECU_Address@XEGOi_OOR_phi_max@0x01011D28@ */ ECIPP_ALIGNMENT_UWORD 4 Compu_XEGOi_OOR_phi_max 0 3.99993896484375 /end CHARACTERISTIC
/begin COMPU_METHOD Compu_XEGOi_OOR_phi_max " " RAT_FUNC "%.3" "phi" COEFFS 0 16384 0 0 0 1 /end COMPU_METHOD
/begin CHARACTERISTIC XEGOi_OOR_MAP_min "FaultConfig # XEGOi_OOR_MAP_min (Fault Condition:with MAP load >)" VALUE 0x001e58c4 /* @ECU_Address@XEGOi_OOR_MAP_min@0x01011D30@ */ ECIPP_ALIGNMENT_UWORD 256 Compu_XEGOi_OOR_MAP_min 0 255.99609375 /end CHARACTERISTIC
/begin COMPU_METHOD Compu_XEGOi_OOR_MAP_min " " RAT_FUNC "%.3" "psia" COEFFS 0 256 0 0 0 1 /end COMPU_METHOD
/begin CHARACTERISTIC XEGOi_OOR_MAP_max "FaultConfig # XEGOi_OOR_MAP_max (Fault Condition:and MAP load <)" VALUE 0x001e58c2 /* @ECU_Address@XEGOi_OOR_MAP_max@0x01011D38@ */ ECIPP_ALIGNMENT_UWORD 256 Compu_XEGOi_OOR_MAP_max 0 255.99609375 /end CHARACTERISTIC
/begin COMPU_METHOD Compu_XEGOi_OOR_MAP_max " " RAT_FUNC "%.3" "psia" COEFFS 0 256 0 0 0 1 /end COMPU_METHOD
/begin CHARACTERISTIC XEGOi_OOR_RPM_min "FaultConfig # XEGOi_OOR_RPM_min (Fault Condition:and RPM >)" VALUE 0x001e58c8 /* @ECU_Address@XEGOi_OOR_RPM_min@0x01011D40@ */ ECIPP_ALIGNMENT_UWORD 65535 Compu_XEGOi_OOR_RPM_min 0 65535 /end CHARACTERISTIC
/begin COMPU_METHOD Compu_XEGOi_OOR_RPM_min " " RAT_FUNC "%.0" "rpm" COEFFS 0 1 0 0 0 1 /end COMPU_METHOD
/begin CHARACTERISTIC XEGOi_OOR_RPM_max "FaultConfig # XEGOi_OOR_RPM_max (Fault Condition:and RPM <)" VALUE 0x001e58c6 /* @ECU_Address@XEGOi_OOR_RPM_max@0x01011D48@ */ ECIPP_ALIGNMENT_UWORD 65535 Compu_XEGOi_OOR_RPM_max 0 65535 /end CHARACTERISTIC
/begin COMPU_METHOD Compu_XEGOi_OOR_RPM_max " " RAT_FUNC "%.0" "rpm" COEFFS 0 1 0 0 0 1 /end COMPU_METHOD
/begin CHARACTERISTIC TWCdiag_OSC_est_thld "CL # TWCdiag_OSC_est_thld (Fault Condition:and TWC oxygen storage capacity <)" VALUE 0x001e1d48 /* @ECU_Address@TWCdiag_OSC_est_thld@0x01011EA0@ */ ECIPP_ALIGNMENT_FLOAT32_IEEE 10000000000 Compu_TWCdiag_OSC_est_thld -10000000000 10000000000 /end CHARACTERISTIC
/begin COMPU_METHOD Compu_TWCdiag_OSC_est_thld " " RAT_FUNC "%.3" "g" COEFFS 0 1 0 0 0 1 /end COMPU_METHOD
/begin CHARACTERISTIC CM_unresp_min_phi "CL # CM_unresp_min_phi (Fault Condition:and pre-cat phi >)" VALUE 0x001e37ea /* @ECU_Address@CM_unresp_min_phi@0x01011FE0@ */ ECIPP_ALIGNMENT_UWORD 4 Compu_CM_unresp_min_phi 0 3.99993896484375 /end CHARACTERISTIC
/begin COMPU_METHOD Compu_CM_unresp_min_phi " " RAT_FUNC "%.3" "phi" COEFFS 0 16384 0 0 0 1 /end COMPU_METHOD
/begin CHARACTERISTIC engine_SNPN_flash "Reprogram # engine_SNPN_flash" VALUE 0x001e58d4 /* @ECU_Address@engine_SNPN_flash@0x01012018@ */ ECIPP_ALIGNMENT_UWORD 65535 Compu_engine_SNPN_flash 0 65535 /end CHARACTERISTIC
/begin COMPU_METHOD Compu_engine_SNPN_flash " " RAT_FUNC "%.0" "NONE" COEFFS 0 1 0 0 0 1 /end COMPU_METHOD
/begin CHARACTERISTIC fm_induce_l3_ll "{fm_induce_l3_ll&0xff=0:Disabled}{fm_induce_l3_ll&0xff=1:Table 1 / Gasoline Load-Limit}{fm_induce_l3_ll&0xff=2:Table 2 / LPG Load-Limit}{fm_induce_l3_ll&0xff=3:Table 3 / NG Load-Limit}{fm_induce_l3_ll&0xff=4:Table 4 / Power Load-Limit}{fm_induce_l3_ll&0xf" VALUE 0x001ecc9d /* @ECU_Address@fm_induce_l3_ll@0x01012020@ */ ECIPP_ALIGNMENT_UBYTE 255 fm_induce_l3_ll_COMPU_VTAB 0 255 BIT_MASK 0xff /end CHARACTERISTIC
/begin COMPU_METHOD fm_induce_l3_ll_COMPU_VTAB "Verbal Table" TAB_VERB "%.0" "list" COMPU_TAB_REF fm_induce_l3_ll_COMPU_VTAB_REF /end COMPU_METHOD
/begin COMPU_VTAB fm_induce_l3_ll_COMPU_VTAB_REF "Verbal Table" TAB_VERB 9 0 "Disabled" 1 "Table 1 / Gasoline Load-Limit" 2 "Table 2 / LPG Load-Limit" 3 "Table 3 / NG Load-Limit" 4 "Table 4 / Power Load-Limit" 5 "Table 5" 6 "Table 6" 7 "Table 7" 8 "Table 8" DEFAULT_VALUE "UNKNOWN" /end COMPU_VTAB
/begin CHARACTERISTIC camloss_crkng_ena "{camloss_crkng_ena&0xff=0:Disabled}{camloss_crkng_ena&0xff=1:Enabled} (Fault Condition:Cam1 loss during cranking)" VALUE 0x001ecc7e /* @ECU_Address@camloss_crkng_ena@0x01012070@ */ ECIPP_ALIGNMENT_UBYTE 255 camloss_crkng_ena_COMPU_VTAB 0 255 BIT_MASK 0xff /end CHARACTERISTIC
/begin COMPU_METHOD camloss_crkng_ena_COMPU_VTAB "Verbal Table" TAB_VERB "%.0" "list" COMPU_TAB_REF camloss_crkng_ena_COMPU_VTAB_REF /end COMPU_METHOD
/begin COMPU_VTAB camloss_crkng_ena_COMPU_VTAB_REF "Verbal Table" TAB_VERB 2 0 "Disabled" 1 "Enabled" DEFAULT_VALUE "UNKNOWN" /end COMPU_VTAB
/begin CHARACTERISTIC camloss_crkng "FaultConfig # camloss_crkng (Fault Condition:No cam pulse during cranking in)" VALUE 0x001ecc7d /* @ECU_Address@camloss_crkng@0x01012078@ */ ECIPP_ALIGNMENT_UBYTE 64 Compu_camloss_crkng 0 63.75 /end CHARACTERISTIC
/begin COMPU_METHOD Compu_camloss_crkng " " RAT_FUNC "%.3" "cycles" COEFFS 0 4 0 0 0 1 /end COMPU_METHOD
/begin CHARACTERISTIC cam2loss_crkng_ena "{cam2loss_crkng_ena&0xff=0:Disabled}{cam2loss_crkng_ena&0xff=1:Enabled} (Fault Condition:Cam2 loss during cranking)" VALUE 0x001ecc7c /* @ECU_Address@cam2loss_crkng_ena@0x01012088@ */ ECIPP_ALIGNMENT_UBYTE 255 cam2loss_crkng_ena_COMPU_VTAB 0 255 BIT_MASK 0xff /end CHARACTERISTIC
/begin COMPU_METHOD cam2loss_crkng_ena_COMPU_VTAB "Verbal Table" TAB_VERB "%.0" "list" COMPU_TAB_REF cam2loss_crkng_ena_COMPU_VTAB_REF /end COMPU_METHOD
/begin COMPU_VTAB cam2loss_crkng_ena_COMPU_VTAB_REF "Verbal Table" TAB_VERB 2 0 "Disabled" 1 "Enabled" DEFAULT_VALUE "UNKNOWN" /end COMPU_VTAB
/begin CHARACTERISTIC cam2loss_crkng "FaultConfig # cam2loss_crkng (Fault Condition:No cam pulse during cranking in)" VALUE 0x001ecc7b /* @ECU_Address@cam2loss_crkng@0x01012090@ */ ECIPP_ALIGNMENT_UBYTE 64 Compu_cam2loss_crkng 0 63.75 /end CHARACTERISTIC
/begin COMPU_METHOD Compu_cam2loss_crkng " " RAT_FUNC "%.3" "cycles" COEFFS 0 4 0 0 0 1 /end COMPU_METHOD
/begin CHARACTERISTIC OILTL_def "IOConfig # OILTL_def" VALUE 0x001e2f32 /* @ECU_Address@OILTL_def@0x010120A0@ */ ECIPP_ALIGNMENT_SWORD 125 Compu_OILTL_def -125 124.996185302734 /end CHARACTERISTIC
/begin COMPU_METHOD Compu_OILTL_def " " RAT_FUNC "%.3" "%" COEFFS 0 262.144 0 0 0 1 /end COMPU_METHOD
/begin CHARACTERISTIC ntwk_node_family "General # ntwk_node_family" VALUE 0x001e58de /* @ECU_Address@ntwk_node_family@0x010120E0@ */ ECIPP_ALIGNMENT_UWORD 65535 Compu_ntwk_node_family 0 65535 /end CHARACTERISTIC
/begin COMPU_METHOD Compu_ntwk_node_family " " RAT_FUNC "%.0" "NONE" COEFFS 0 1 0 0 0 1 /end COMPU_METHOD
/begin CHARACTERISTIC ntwk_node_type "General # ntwk_node_type" VALUE 0x001e58e2 /* @ECU_Address@ntwk_node_type@0x010120E8@ */ ECIPP_ALIGNMENT_UWORD 65535 Compu_ntwk_node_type 0 65535 /end CHARACTERISTIC
/begin COMPU_METHOD Compu_ntwk_node_type " " RAT_FUNC "%.0" "NONE" COEFFS 0 1 0 0 0 1 /end COMPU_METHOD
/begin CHARACTERISTIC ntwk_node_pos "General # ntwk_node_pos" VALUE 0x001e58e0 /* @ECU_Address@ntwk_node_pos@0x010120F0@ */ ECIPP_ALIGNMENT_UWORD 65535 Compu_ntwk_node_pos 0 65535 /end CHARACTERISTIC
/begin COMPU_METHOD Compu_ntwk_node_pos " " RAT_FUNC "%.0" "NONE" COEFFS 0 1 0 0 0 1 /end COMPU_METHOD
/begin CHARACTERISTIC EGT_maxv "FaultConfig # EGT_maxv (Fault Condition:EGT voltage >)" VALUE 0x001e3858 /* @ECU_Address@EGT_maxv@0x01012160@ */ ECIPP_ALIGNMENT_UWORD 5 Compu_EGT_maxv 0 5.00114468864469 /end CHARACTERISTIC
/begin COMPU_METHOD Compu_EGT_maxv " " RAT_FUNC "%.3" "volts" COEFFS 0 13104 0 0 0 1 /end COMPU_METHOD
/begin CHARACTERISTIC EGT_minv "FaultConfig # EGT_minv (Fault Condition:EGT voltage <)" VALUE 0x001e385e /* @ECU_Address@EGT_minv@0x01012168@ */ ECIPP_ALIGNMENT_UWORD 5 Compu_EGT_minv 0 5.00114468864469 /end CHARACTERISTIC
/begin COMPU_METHOD Compu_EGT_minv " " RAT_FUNC "%.3" "volts" COEFFS 0 13104 0 0 0 1 /end COMPU_METHOD
/begin CHARACTERISTIC FPlo_derate_time "FaultConfig # FPlo_derate_time (Fault Condition:Low fuel pressure derate active >)" VALUE 0x001c6fd8 /* @ECU_Address@FPlo_derate_time@0x01012180@ */ ECIPP_ALIGNMENT_UWORD 65535 Compu_FPlo_derate_time 0 65535 /end CHARACTERISTIC
/begin COMPU_METHOD Compu_FPlo_derate_time " " RAT_FUNC "%.0" "seconds" COEFFS 0 1 0 0 0 1 /end COMPU_METHOD
/begin CHARACTERISTIC EGR_LoExp_dmdot "Air # EGR_LoExp_dmdot (Fault Condition:EGR flow command dt <=)" VALUE 0x001c3a90 /* @ECU_Address@EGR_LoExp_dmdot@0x01012258@ */ ECIPP_ALIGNMENT_FLOAT32_IEEE 10000000000 Compu_EGR_LoExp_dmdot -10000000000 10000000000 /end CHARACTERISTIC
/begin COMPU_METHOD Compu_EGR_LoExp_dmdot " " RAT_FUNC "%.3" "g/sec^2" COEFFS 0 1 0 0 0 1 /end COMPU_METHOD
/begin CHARACTERISTIC EGR_LoExp_dmdot_wait "Air # EGR_LoExp_dmdot_wait (Fault Condition:for at least)" VALUE 0x001c6efa /* @ECU_Address@EGR_LoExp_dmdot_wait@0x01012260@ */ ECIPP_ALIGNMENT_UWORD 66 Compu_EGR_LoExp_dmdot_wait 0 65.535 /end CHARACTERISTIC
/begin COMPU_METHOD Compu_EGR_LoExp_dmdot_wait " " RAT_FUNC "%.3" "seconds" COEFFS 0 1000 0 0 0 1 /end COMPU_METHOD
/begin CHARACTERISTIC EGRO_postlk_RPMmax "Air # EGRO_postlk_RPMmax (Fault Condition:and RPM <)" VALUE 0x001e3848 /* @ECU_Address@EGRO_postlk_RPMmax@0x010122C8@ */ ECIPP_ALIGNMENT_UWORD 65535 Compu_EGRO_postlk_RPMmax 0 65535 /end CHARACTERISTIC
/begin COMPU_METHOD Compu_EGRO_postlk_RPMmax " " RAT_FUNC "%.0" "rpm" COEFFS 0 1 0 0 0 1 /end COMPU_METHOD
/begin CHARACTERISTIC IAT_HiExp_mdota_min "FaultConfig # IAT_HiExp_mdota_min (Fault Condition:and air mass flow >)" VALUE 0x001e5708 /* @ECU_Address@IAT_HiExp_mdota_min@0x010122D0@ */ ECIPP_ALIGNMENT_UWORD 1024 Compu_IAT_HiExp_mdota_min 0 1023.984375 /end CHARACTERISTIC
/begin COMPU_METHOD Compu_IAT_HiExp_mdota_min " " RAT_FUNC "%.3" "g/sec" COEFFS 0 64 0 0 0 1 /end COMPU_METHOD
/begin CHARACTERISTIC IAT_HiExp2_mdota_min "FaultConfig # IAT_HiExp2_mdota_min (Fault Condition:and air mass flow >)" VALUE 0x001e5706 /* @ECU_Address@IAT_HiExp2_mdota_min@0x010122D8@ */ ECIPP_ALIGNMENT_UWORD 1024 Compu_IAT_HiExp2_mdota_min 0 1023.984375 /end CHARACTERISTIC
/begin COMPU_METHOD Compu_IAT_HiExp2_mdota_min " " RAT_FUNC "%.3" "g/sec" COEFFS 0 64 0 0 0 1 /end COMPU_METHOD
/begin CHARACTERISTIC EGRO_postlk_source "{EGRO_postlk_source&0xff=0:Single Point}{EGRO_postlk_source&0xff=1:Table Based} (Fault Condition:EGRdP threshold source)" VALUE 0x001c86d9 /* @ECU_Address@EGRO_postlk_source@0x010124F0@ */ ECIPP_ALIGNMENT_UBYTE 255 EGRO_postlk_source_COMPU_VTAB 0 255 BIT_MASK 0xff /end CHARACTERISTIC
/begin COMPU_METHOD EGRO_postlk_source_COMPU_VTAB "Verbal Table" TAB_VERB "%.0" "list" COMPU_TAB_REF EGRO_postlk_source_COMPU_VTAB_REF /end COMPU_METHOD
/begin COMPU_VTAB EGRO_postlk_source_COMPU_VTAB_REF "Verbal Table" TAB_VERB 2 0 "Single Point" 1 "Table Based" DEFAULT_VALUE "UNKNOWN" /end COMPU_VTAB
/begin CHARACTERISTIC EGRO_postlk_vlvdP_lo "Air # EGRO_postlk_vlvdP_lo" VALUE 0x001c44ac /* @ECU_Address@EGRO_postlk_vlvdP_lo@0x010124F8@ */ ECIPP_ALIGNMENT_SWORD 128 Compu_EGRO_postlk_vlvdP_lo -128 127.99609375 /end CHARACTERISTIC
/begin COMPU_METHOD Compu_EGRO_postlk_vlvdP_lo " " RAT_FUNC "%.3" "psi" COEFFS 0 256 0 0 0 1 /end COMPU_METHOD
/begin CHARACTERISTIC EGRO_postlk_vlvdP_hi "Air # EGRO_postlk_vlvdP_hi" VALUE 0x001c44aa /* @ECU_Address@EGRO_postlk_vlvdP_hi@0x01012500@ */ ECIPP_ALIGNMENT_SWORD 128 Compu_EGRO_postlk_vlvdP_hi -128 127.99609375 /end CHARACTERISTIC
/begin COMPU_METHOD Compu_EGRO_postlk_vlvdP_hi " " RAT_FUNC "%.3" "psi" COEFFS 0 256 0 0 0 1 /end COMPU_METHOD
/begin CHARACTERISTIC EGRO_postlk_tbl_pct "Air # EGRO_postlk_tbl_pct" VALUE 0x001c6ef8 /* @ECU_Address@EGRO_postlk_tbl_pct@0x01012508@ */ ECIPP_ALIGNMENT_UWORD 400 Compu_EGRO_postlk_tbl_pct 0 399.993896484375 /end CHARACTERISTIC
/begin COMPU_METHOD Compu_EGRO_postlk_tbl_pct " " RAT_FUNC "%.3" "%" COEFFS 0 163.84 0 0 0 1 /end COMPU_METHOD
/begin CHARACTERISTIC WGPerr_minRS "FaultConfig # WGPerr_minRS (Fault Condition:and roadspeed >=)" VALUE 0x001c8390 /* @ECU_Address@WGPerr_minRS@0x01012510@ */ ECIPP_ALIGNMENT_UWORD 256 Compu_WGPerr_minRS 0 255.99609375 /end CHARACTERISTIC
/begin COMPU_METHOD Compu_WGPerr_minRS " " RAT_FUNC "%.3" "km/hr" COEFFS 0 256 0 0 0 1 /end COMPU_METHOD
/begin CHARACTERISTIC EGRO_postlk_FSO_min "Air # EGRO_postlk_FSO_min" VALUE 0x001c6ef6 /* @ECU_Address@EGRO_postlk_FSO_min@0x01012518@ */ ECIPP_ALIGNMENT_UWORD 66 Compu_EGRO_postlk_FSO_min 0 65.535 /end CHARACTERISTIC
/begin COMPU_METHOD Compu_EGRO_postlk_FSO_min " " RAT_FUNC "%.3" "sec" COEFFS 0 1000 0 0 0 1 /end COMPU_METHOD
/begin CHARACTERISTIC EGRO_postlk_FSO_max "Air # EGRO_postlk_FSO_max" VALUE 0x001c6ef4 /* @ECU_Address@EGRO_postlk_FSO_max@0x01012520@ */ ECIPP_ALIGNMENT_UWORD 66 Compu_EGRO_postlk_FSO_max 0 65.535 /end CHARACTERISTIC
/begin COMPU_METHOD Compu_EGRO_postlk_FSO_max " " RAT_FUNC "%.3" "sec" COEFFS 0 1000 0 0 0 1 /end COMPU_METHOD
/begin CHARACTERISTIC fuelclr_chan "{fuelclr_chan&0xff=0:Disabled}{fuelclr_chan&0xff=1:Aux PU1 = Gnd}{fuelclr_chan&0xff=2:Aux PU2 = Gnd}{fuelclr_chan&0xff=3:Aux PU3 = Gnd}{fuelclr_chan&0xff=4:Aux PUD1 = Gnd}{fuelclr_chan&0xff=5:Aux PUD2 = Gnd}{fuelclr_chan&0xff=6:Aux PUD3 = Gnd}{fuelclr_cha" VALUE 0x001ecc9e /* @ECU_Address@fuelclr_chan@0x01012570@ */ ECIPP_ALIGNMENT_UBYTE 255 fuelclr_chan_COMPU_VTAB 0 255 BIT_MASK 0xff /end CHARACTERISTIC
/begin COMPU_METHOD fuelclr_chan_COMPU_VTAB "Verbal Table" TAB_VERB "%.0" "list" COMPU_TAB_REF fuelclr_chan_COMPU_VTAB_REF /end COMPU_METHOD
/begin COMPU_VTAB fuelclr_chan_COMPU_VTAB_REF "Verbal Table" TAB_VERB 30 0 "Disabled" 1 "Aux PU1 = Gnd" 2 "Aux PU2 = Gnd" 3 "Aux PU3 = Gnd" 4 "Aux PUD1 = Gnd" 5 "Aux PUD2 = Gnd" 6 "Aux PUD3 = Gnd" 7 "Aux PUD4 = +V" 8 "Aux PUD5 = Gnd" 9 "Aux DIG1" 10 "Aux DIG2" 11 "Aux DIG3" 12 "Aux DIG4" 13 "Aux DIG5" 14 "Aux DIG6" 15 "Aux DIG7" 16 "Aux DIG8" 17 "Aux DIG9" 18 "Aux DIG10" 19 "Aux DIG11" 20 "Aux DIG12" 21 "Aux DIG13" 22 "Aux DIG14" 23 "Aux DIG15" 24 "Aux DIG16" 25 "Aux DIG17" 26 "Aux DIG18" 27 "Aux DIG19" 28 "Gov1" 29 "Gov2" DEFAULT_VALUE "UNKNOWN" /end COMPU_VTAB
/begin CHARACTERISTIC fuelclr_chan_cfg "{fuelclr_chan_cfg&0xff=0:Default}{fuelclr_chan_cfg&0xff=1:GND}{fuelclr_chan_cfg&0xff=2:GND/+V}{fuelclr_chan_cfg&0xff=3:+V}{fuelclr_chan_cfg&0xff=4:Open}" VALUE 0x001ecc9f /* @ECU_Address@fuelclr_chan_cfg@0x01012578@ */ ECIPP_ALIGNMENT_UBYTE 255 fuelclr_chan_cfg_COMPU_VTAB 0 255 BIT_MASK 0xff /end CHARACTERISTIC
/begin COMPU_METHOD fuelclr_chan_cfg_COMPU_VTAB "Verbal Table" TAB_VERB "%.0" "list" COMPU_TAB_REF fuelclr_chan_cfg_COMPU_VTAB_REF /end COMPU_METHOD
/begin COMPU_VTAB fuelclr_chan_cfg_COMPU_VTAB_REF "Verbal Table" TAB_VERB 5 0 "Default" 1 "GND" 2 "GND/+V" 3 "+V" 4 "Open" DEFAULT_VALUE "UNKNOWN" /end COMPU_VTAB
/begin CHARACTERISTIC fuelclr_debounce "Fuel # fuelclr_debounce" VALUE 0x001e58dc /* @ECU_Address@fuelclr_debounce@0x01012580@ */ ECIPP_ALIGNMENT_UWORD 66 Compu_fuelclr_debounce 0 65.535 /end CHARACTERISTIC
/begin COMPU_METHOD Compu_fuelclr_debounce " " RAT_FUNC "%.3" "sec" COEFFS 0 1000 0 0 0 1 /end COMPU_METHOD
/begin CHARACTERISTIC KNK_retardlmt_oct "FaultConfig # KNK_retardlmt_oct (Fault Condition:and octane rating <=)" VALUE 0x001c7cd0 /* @ECU_Address@KNK_retardlmt_oct@0x010125B0@ */ ECIPP_ALIGNMENT_UWORD 100 Compu_KNK_retardlmt_oct 0 99.9984741210938 /end CHARACTERISTIC
/begin COMPU_METHOD Compu_KNK_retardlmt_oct " " RAT_FUNC "%.3" "%" COEFFS 0 655.36 0 0 0 1 /end COMPU_METHOD
/begin CHARACTERISTIC KNK_retardlmt_oct2 "FaultConfig # KNK_retardlmt_oct2 (Fault Condition:and octane rating <=)" VALUE 0x001c7cd2 /* @ECU_Address@KNK_retardlmt_oct2@0x010125B8@ */ ECIPP_ALIGNMENT_UWORD 100 Compu_KNK_retardlmt_oct2 0 99.9984741210938 /end CHARACTERISTIC
/begin COMPU_METHOD Compu_KNK_retardlmt_oct2 " " RAT_FUNC "%.3" "%" COEFFS 0 655.36 0 0 0 1 /end COMPU_METHOD
/begin CHARACTERISTIC J1939_DM19_cksum "General # J1939_DM19_cksum" VALUE 0x001e6ddc /* @ECU_Address@J1939_DM19_cksum@0x010126C0@ */ ECIPP_ALIGNMENT_UBYTE 255 Compu_J1939_DM19_cksum 1 256 /end CHARACTERISTIC
/begin COMPU_METHOD Compu_J1939_DM19_cksum " " RAT_FUNC "%.0" "-" COEFFS 0 1 -1 0 0 1 /end COMPU_METHOD
/begin CHARACTERISTIC WGPerr_delta "FaultConfig # WGPerr_delta (Fault Condition:and abs(target WGP - actual WGP) >)" VALUE 0x001c6c1c /* @ECU_Address@WGPerr_delta@0x01012710@ */ ECIPP_ALIGNMENT_SWORD 128 Compu_WGPerr_delta -128 127.99609375 /end CHARACTERISTIC
/begin COMPU_METHOD Compu_WGPerr_delta " " RAT_FUNC "%.3" "psi" COEFFS 0 256 0 0 0 1 /end COMPU_METHOD
/begin CHARACTERISTIC EGRdP_HiExp_source "{EGRdP_HiExp_source&0xff=0:Single Point}{EGRdP_HiExp_source&0xff=1:Table Based} (Fault Condition:EGRdP threshold source)" VALUE 0x001c0ab4 /* @ECU_Address@EGRdP_HiExp_source@0x01012720@ */ ECIPP_ALIGNMENT_UBYTE 255 EGRdP_HiExp_source_COMPU_VTAB 0 255 BIT_MASK 0xff /end CHARACTERISTIC
/begin COMPU_METHOD EGRdP_HiExp_source_COMPU_VTAB "Verbal Table" TAB_VERB "%.0" "list" COMPU_TAB_REF EGRdP_HiExp_source_COMPU_VTAB_REF /end COMPU_METHOD
/begin COMPU_VTAB EGRdP_HiExp_source_COMPU_VTAB_REF "Verbal Table" TAB_VERB 2 0 "Single Point" 1 "Table Based" DEFAULT_VALUE "UNKNOWN" /end COMPU_VTAB
/begin CHARACTERISTIC module_load_ECM_ID "General # module_load_ECM_ID" VALUE 0x001ecca3 /* @ECU_Address@module_load_ECM_ID@0x01012768@ */ ECIPP_ALIGNMENT_UBYTE 255 Compu_module_load_ECM_ID 0 255 /end CHARACTERISTIC
/begin COMPU_METHOD Compu_module_load_ECM_ID " " RAT_FUNC "%.0" "-" COEFFS 0 1 0 0 0 1 /end COMPU_METHOD
/begin CHARACTERISTIC OILP_wait_source "{OILP_wait_source&0xff=0:Single Point}{OILP_wait_source&0xff=1:Table Based} (Fault Condition:Run time wait threshold source)" VALUE 0x001c8865 /* @ECU_Address@OILP_wait_source@0x01012770@ */ ECIPP_ALIGNMENT_UBYTE 255 OILP_wait_source_COMPU_VTAB 0 255 BIT_MASK 0xff /end CHARACTERISTIC
/begin COMPU_METHOD OILP_wait_source_COMPU_VTAB "Verbal Table" TAB_VERB "%.0" "list" COMPU_TAB_REF OILP_wait_source_COMPU_VTAB_REF /end COMPU_METHOD
/begin COMPU_VTAB OILP_wait_source_COMPU_VTAB_REF "Verbal Table" TAB_VERB 2 0 "Single Point" 1 "Table Based" DEFAULT_VALUE "UNKNOWN" /end COMPU_VTAB
/begin CHARACTERISTIC F201_security "IOConfig # F201_security" VALUE 0x001e5900 /* @ECU_Address@F201_security@0x010127D8@ */ ECIPP_ALIGNMENT_UBYTE 255 Compu_F201_security 0 255 /end CHARACTERISTIC
/begin COMPU_METHOD Compu_F201_security " " RAT_FUNC "%.0" "-" COEFFS 0 1 0 0 0 1 /end COMPU_METHOD
/begin CHARACTERISTIC F201_version "IOConfig # F201_version" VALUE 0x001e3868 /* @ECU_Address@F201_version@0x010127E0@ */ ECIPP_ALIGNMENT_UWORD 65535 Compu_F201_version 0 65535 /end CHARACTERISTIC
/begin COMPU_METHOD Compu_F201_version " " RAT_FUNC "%.0" "-" COEFFS 0 1 0 0 0 1 /end COMPU_METHOD
/begin CHARACTERISTIC CL_ROL_reinit_hi "ROL state re-init high value" VALUE 0x001C34E6 /* @ECU_Address@CL_ROL_reinit_hi@0x01012810@ */ ECIPP_ALIGNMENT_UWORD 100 Compu_CL_ROL_reinit_hi 0 99.9984741210938 MAX_REFRESH 6 1 /end CHARACTERISTIC
/begin COMPU_METHOD Compu_CL_ROL_reinit_hi " " RAT_FUNC "%.0" "%" COEFFS 0 655.36 0 0 0 1 /end COMPU_METHOD
/begin CHARACTERISTIC CLLP_ROL_reinit_hi "ROL state re-init high value" VALUE 0x001C1A2A /* @ECU_Address@CLLP_ROL_reinit_hi@0x01012818@ */ ECIPP_ALIGNMENT_UWORD 100 Compu_CLLP_ROL_reinit_hi 0 99.9984741210938 MAX_REFRESH 6 1 /end CHARACTERISTIC
/begin COMPU_METHOD Compu_CLLP_ROL_reinit_hi " " RAT_FUNC "%.0" "%" COEFFS 0 655.36 0 0 0 1 /end COMPU_METHOD
/begin CHARACTERISTIC CLNG_ROL_reinit_hi "ROL state re-init high value" VALUE 0x001C2994 /* @ECU_Address@CLNG_ROL_reinit_hi@0x01012820@ */ ECIPP_ALIGNMENT_UWORD 100 Compu_CLNG_ROL_reinit_hi 0 99.9984741210938 MAX_REFRESH 6 1 /end CHARACTERISTIC
/begin COMPU_METHOD Compu_CLNG_ROL_reinit_hi " " RAT_FUNC "%.0" "%" COEFFS 0 655.36 0 0 0 1 /end COMPU_METHOD
/begin CHARACTERISTIC CL_ROL_reinit_lo "ROL state re-init low value" VALUE 0x001C34E8 /* @ECU_Address@CL_ROL_reinit_lo@0x01012828@ */ ECIPP_ALIGNMENT_UWORD 100 Compu_CL_ROL_reinit_lo 0 99.9984741210938 MAX_REFRESH 6 1 /end CHARACTERISTIC
/begin COMPU_METHOD Compu_CL_ROL_reinit_lo " " RAT_FUNC "%.0" "%" COEFFS 0 655.36 0 0 0 1 /end COMPU_METHOD
/begin CHARACTERISTIC CLLP_ROL_reinit_lo "ROL state re-init low value" VALUE 0x001C1A2C /* @ECU_Address@CLLP_ROL_reinit_lo@0x01012830@ */ ECIPP_ALIGNMENT_UWORD 100 Compu_CLLP_ROL_reinit_lo 0 99.9984741210938 MAX_REFRESH 6 1 /end CHARACTERISTIC
/begin COMPU_METHOD Compu_CLLP_ROL_reinit_lo " " RAT_FUNC "%.0" "%" COEFFS 0 655.36 0 0 0 1 /end COMPU_METHOD
/begin CHARACTERISTIC CLNG_ROL_reinit_lo "ROL state re-init low value" VALUE 0x001C2996 /* @ECU_Address@CLNG_ROL_reinit_lo@0x01012838@ */ ECIPP_ALIGNMENT_UWORD 100 Compu_CLNG_ROL_reinit_lo 0 99.9984741210938 MAX_REFRESH 6 1 /end CHARACTERISTIC
/begin COMPU_METHOD Compu_CLNG_ROL_reinit_lo " " RAT_FUNC "%.0" "%" COEFFS 0 655.36 0 0 0 1 /end COMPU_METHOD
/begin CHARACTERISTIC CL_ROL_reinit_ena "Re-initialize on ROL re-entry{CL_ROL_reinit_ena&0xff=0:No}{CL_ROL_reinit_ena&0xff=1:Yes}" VALUE 0x001C34EA /* @ECU_Address@CL_ROL_reinit_ena@0x01012840@ */ ECIPP_ALIGNMENT_UBYTE 255 CL_ROL_reinit_ena_COMPU_VTAB 0 255 MAX_REFRESH 6 1 BIT_MASK 0xff /end CHARACTERISTIC
/begin COMPU_METHOD CL_ROL_reinit_ena_COMPU_VTAB "Verbal Table" TAB_VERB "%.0" "list" COMPU_TAB_REF CL_ROL_reinit_ena_COMPU_VTAB_REF /end COMPU_METHOD
/begin COMPU_VTAB CL_ROL_reinit_ena_COMPU_VTAB_REF "Verbal Table" TAB_VERB 2 0 "No" 1 "Yes" DEFAULT_VALUE "UNKNOWN" /end COMPU_VTAB
/begin CHARACTERISTIC CLLP_ROL_reinit_ena "Re-initialize on ROL re-entry{CLLP_ROL_reinit_ena&0xff=0:No}{CLLP_ROL_reinit_ena&0xff=1:Yes}" VALUE 0x001C1A2E /* @ECU_Address@CLLP_ROL_reinit_ena@0x01012848@ */ ECIPP_ALIGNMENT_UBYTE 255 CLLP_ROL_reinit_ena_COMPU_VTAB 0 255 MAX_REFRESH 6 1 BIT_MASK 0xff /end CHARACTERISTIC
/begin COMPU_METHOD CLLP_ROL_reinit_ena_COMPU_VTAB "Verbal Table" TAB_VERB "%.0" "list" COMPU_TAB_REF CLLP_ROL_reinit_ena_COMPU_VTAB_REF /end COMPU_METHOD
/begin COMPU_VTAB CLLP_ROL_reinit_ena_COMPU_VTAB_REF "Verbal Table" TAB_VERB 2 0 "No" 1 "Yes" DEFAULT_VALUE "UNKNOWN" /end COMPU_VTAB
/begin CHARACTERISTIC CLNG_ROL_reinit_ena "Re-initialize on ROL re-entry{CLNG_ROL_reinit_ena&0xff=0:No}{CLNG_ROL_reinit_ena&0xff=1:Yes}" VALUE 0x001C2998 /* @ECU_Address@CLNG_ROL_reinit_ena@0x01012850@ */ ECIPP_ALIGNMENT_UBYTE 255 CLNG_ROL_reinit_ena_COMPU_VTAB 0 255 MAX_REFRESH 6 1 BIT_MASK 0xff /end CHARACTERISTIC
/begin COMPU_METHOD CLNG_ROL_reinit_ena_COMPU_VTAB "Verbal Table" TAB_VERB "%.0" "list" COMPU_TAB_REF CLNG_ROL_reinit_ena_COMPU_VTAB_REF /end COMPU_METHOD
/begin COMPU_VTAB CLNG_ROL_reinit_ena_COMPU_VTAB_REF "Verbal Table" TAB_VERB 2 0 "No" 1 "Yes" DEFAULT_VALUE "UNKNOWN" /end COMPU_VTAB
/begin CHARACTERISTIC CVCS_discon_RPM_max "FaultConfig # CVCS_discon_RPM_max (Fault Condition:and RPM <)" VALUE 0x001e37f2 /* @ECU_Address@CVCS_discon_RPM_max@0x01012878@ */ ECIPP_ALIGNMENT_UWORD 65535 Compu_CVCS_discon_RPM_max 0 65535 /end CHARACTERISTIC
/begin COMPU_METHOD Compu_CVCS_discon_RPM_max " " RAT_FUNC "%.0" "rpm" COEFFS 0 1 0 0 0 1 /end COMPU_METHOD
/begin CHARACTERISTIC CVDS_discon_RPM_max "FaultConfig # CVDS_discon_RPM_max (Fault Condition:and RPM <)" VALUE 0x001e37fa /* @ECU_Address@CVDS_discon_RPM_max@0x01012880@ */ ECIPP_ALIGNMENT_UWORD 65535 Compu_CVDS_discon_RPM_max 0 65535 /end CHARACTERISTIC
/begin COMPU_METHOD Compu_CVDS_discon_RPM_max " " RAT_FUNC "%.0" "rpm" COEFFS 0 1 0 0 0 1 /end COMPU_METHOD
/begin CHARACTERISTIC PWMLO_pwr_src "{PWMLO_pwr_src&0xff=0:Key switch powered}{PWMLO_pwr_src&0xff=1:Relay powered} (Fault Condition:Power source)" VALUE 0x001e6df9 /* @ECU_Address@PWMLO_pwr_src@0x010128D0@ */ ECIPP_ALIGNMENT_UBYTE 255 PWMLO_pwr_src_COMPU_VTAB 0 255 BIT_MASK 0xff /end CHARACTERISTIC
/begin COMPU_METHOD PWMLO_pwr_src_COMPU_VTAB "Verbal Table" TAB_VERB "%.0" "list" COMPU_TAB_REF PWMLO_pwr_src_COMPU_VTAB_REF /end COMPU_METHOD
/begin COMPU_VTAB PWMLO_pwr_src_COMPU_VTAB_REF "Verbal Table" TAB_VERB 2 0 "Key switch powered" 1 "Relay powered" DEFAULT_VALUE "UNKNOWN" /end COMPU_VTAB
/begin CHARACTERISTIC EGT_maxv_MAP "FaultConfig # EGT_maxv_MAP (Fault Condition:and MAP >=)" VALUE 0x001e385a /* @ECU_Address@EGT_maxv_MAP@0x01012968@ */ ECIPP_ALIGNMENT_UWORD 256 Compu_EGT_maxv_MAP 0 255.99609375 /end CHARACTERISTIC
/begin COMPU_METHOD Compu_EGT_maxv_MAP " " RAT_FUNC "%.3" "psia" COEFFS 0 256 0 0 0 1 /end COMPU_METHOD
/begin CHARACTERISTIC EGT_maxv_rpm "FaultConfig # EGT_maxv_rpm (Fault Condition:and RPM >=)" VALUE 0x001e385c /* @ECU_Address@EGT_maxv_rpm@0x01012970@ */ ECIPP_ALIGNMENT_UWORD 65535 Compu_EGT_maxv_rpm 0 65535 /end CHARACTERISTIC
/begin COMPU_METHOD Compu_EGT_maxv_rpm " " RAT_FUNC "%.0" "rpm" COEFFS 0 1 0 0 0 1 /end COMPU_METHOD
/begin CHARACTERISTIC EGT_maxv_wait "FaultConfig # EGT_maxv_wait (Fault Condition:and run time >=)" VALUE 0x001e1d5c /* @ECU_Address@EGT_maxv_wait@0x01012978@ */ ECIPP_ALIGNMENT_ULONG 4294967 Compu_EGT_maxv_wait 0 4294967.295 /end CHARACTERISTIC
/begin COMPU_METHOD Compu_EGT_maxv_wait " " RAT_FUNC "%.3" "seconds" COEFFS 0 1000 0 0 0 1 /end COMPU_METHOD
/begin CHARACTERISTIC EGT_minv_MAP "FaultConfig # EGT_minv_MAP (Fault Condition:and MAP >=)" VALUE 0x001e3860 /* @ECU_Address@EGT_minv_MAP@0x01012980@ */ ECIPP_ALIGNMENT_UWORD 256 Compu_EGT_minv_MAP 0 255.99609375 /end CHARACTERISTIC
/begin COMPU_METHOD Compu_EGT_minv_MAP " " RAT_FUNC "%.3" "psia" COEFFS 0 256 0 0 0 1 /end COMPU_METHOD
/begin CHARACTERISTIC EGT_minv_rpm "FaultConfig # EGT_minv_rpm (Fault Condition:and RPM >=)" VALUE 0x001e3862 /* @ECU_Address@EGT_minv_rpm@0x01012988@ */ ECIPP_ALIGNMENT_UWORD 65535 Compu_EGT_minv_rpm 0 65535 /end CHARACTERISTIC
/begin COMPU_METHOD Compu_EGT_minv_rpm " " RAT_FUNC "%.0" "rpm" COEFFS 0 1 0 0 0 1 /end COMPU_METHOD
/begin CHARACTERISTIC EGT_minv_wait "FaultConfig # EGT_minv_wait (Fault Condition:and run time >=)" VALUE 0x001e1d60 /* @ECU_Address@EGT_minv_wait@0x01012990@ */ ECIPP_ALIGNMENT_ULONG 4294967 Compu_EGT_minv_wait 0 4294967.295 /end CHARACTERISTIC
/begin COMPU_METHOD Compu_EGT_minv_wait " " RAT_FUNC "%.3" "seconds" COEFFS 0 1000 0 0 0 1 /end COMPU_METHOD
/begin CHARACTERISTIC CATout_OOR_delta "FaultConfig # CATout_OOR_delta (Fault Condition:abs(CBT - CAT outlet) >)" VALUE 0x001c6dba /* @ECU_Address@CATout_OOR_delta@0x01012A68@ */ ECIPP_ALIGNMENT_UWORD 8192 Compu_CATout_OOR_delta 0 8191.875 /end CHARACTERISTIC
/begin COMPU_METHOD Compu_CATout_OOR_delta " " RAT_FUNC "%.3" "deg F" COEFFS 0 8 0 0 0 1 /end COMPU_METHOD
/begin CHARACTERISTIC CATout_OOR_CBT "FaultConfig # CATout_OOR_CBT (Fault Condition:and CBT >)" VALUE 0x001c6db6 /* @ECU_Address@CATout_OOR_CBT@0x01012A70@ */ ECIPP_ALIGNMENT_UWORD 7732 Compu_CATout_OOR_CBT -460 7731.875 /end CHARACTERISTIC
/begin COMPU_METHOD Compu_CATout_OOR_CBT " " RAT_FUNC "%.3" "deg F" COEFFS 0 8 3680 0 0 1 /end COMPU_METHOD
/begin CHARACTERISTIC CATout_OOR_rpm "FaultConfig # CATout_OOR_rpm (Fault Condition:and RPM >)" VALUE 0x001c6dbe /* @ECU_Address@CATout_OOR_rpm@0x01012A78@ */ ECIPP_ALIGNMENT_UWORD 65535 Compu_CATout_OOR_rpm 0 65535 /end CHARACTERISTIC
/begin COMPU_METHOD Compu_CATout_OOR_rpm " " RAT_FUNC "%.0" "rpm" COEFFS 0 1 0 0 0 1 /end COMPU_METHOD
/begin CHARACTERISTIC CATout_OOR_MAPload "FaultConfig # CATout_OOR_MAPload (Fault Condition:and MAP load >)" VALUE 0x001c6db8 /* @ECU_Address@CATout_OOR_MAPload@0x01012A80@ */ ECIPP_ALIGNMENT_UWORD 256 Compu_CATout_OOR_MAPload 0 255.99609375 /end CHARACTERISTIC
/begin COMPU_METHOD Compu_CATout_OOR_MAPload " " RAT_FUNC "%.3" "psia" COEFFS 0 256 0 0 0 1 /end COMPU_METHOD
/begin CHARACTERISTIC CATout_OOR_wt "FaultConfig # CATout_OOR_wt (Fault Condition:and engine run time >)" VALUE 0x001c4260 /* @ECU_Address@CATout_OOR_wt@0x01012A88@ */ ECIPP_ALIGNMENT_ULONG 4294967 Compu_CATout_OOR_wt 0 4294967.295 /end CHARACTERISTIC
/begin COMPU_METHOD Compu_CATout_OOR_wt " " RAT_FUNC "%.3" "seconds" COEFFS 0 1000 0 0 0 1 /end COMPU_METHOD
/begin CHARACTERISTIC CATout_OOR_latch_wt "FaultConfig # CATout_OOR_latch_wt (Fault Condition:and CBT, RPM, MAP load conditions persist for)" VALUE 0x001c6dbc /* @ECU_Address@CATout_OOR_latch_wt@0x01012A90@ */ ECIPP_ALIGNMENT_UWORD 66 Compu_CATout_OOR_latch_wt 0 65.535 /end CHARACTERISTIC
/begin COMPU_METHOD Compu_CATout_OOR_latch_wt " " RAT_FUNC "%.3" "seconds" COEFFS 0 1000 0 0 0 1 /end COMPU_METHOD
/begin CHARACTERISTIC CRI_purge_cranktime "{CRI_purge_cranktime&0xff=0x00:Disabled}{CRI_purge_cranktime&0xff=0x01:Enabled}" VALUE 0x001e58f3 /* @ECU_Address@CRI_purge_cranktime@0x01012A98@ */ ECIPP_ALIGNMENT_UBYTE 255 CRI_purge_cranktime_COMPU_VTAB 0 255 BIT_MASK 0xff /end CHARACTERISTIC
/begin COMPU_METHOD CRI_purge_cranktime_COMPU_VTAB "Verbal Table" TAB_VERB "%.0" "list" COMPU_TAB_REF CRI_purge_cranktime_COMPU_VTAB_REF /end COMPU_METHOD
/begin COMPU_VTAB CRI_purge_cranktime_COMPU_VTAB_REF "Verbal Table" TAB_VERB 2 0x00 "Disabled" 0x01 "Enabled" DEFAULT_VALUE "UNKNOWN" /end COMPU_VTAB
/begin CHARACTERISTIC CRI_purge_T2 "Fuel # CRI_purge_T2" VALUE 0x001e58ee /* @ECU_Address@CRI_purge_T2@0x01012AA0@ */ ECIPP_ALIGNMENT_UBYTE 255 Compu_CRI_purge_T2 0 255 /end CHARACTERISTIC
/begin COMPU_METHOD Compu_CRI_purge_T2 " " RAT_FUNC "%.0" "sec" COEFFS 0 1 0 0 0 1 /end COMPU_METHOD
/begin CHARACTERISTIC CRI_purge_T3 "Fuel # CRI_purge_T3" VALUE 0x001e58ef /* @ECU_Address@CRI_purge_T3@0x01012AA8@ */ ECIPP_ALIGNMENT_UBYTE 255 Compu_CRI_purge_T3 0 255 /end CHARACTERISTIC
/begin COMPU_METHOD Compu_CRI_purge_T3 " " RAT_FUNC "%.0" "sec" COEFFS 0 1 0 0 0 1 /end COMPU_METHOD
/begin CHARACTERISTIC CRI_purge_T4 "Fuel # CRI_purge_T4" VALUE 0x001e58f0 /* @ECU_Address@CRI_purge_T4@0x01012AB0@ */ ECIPP_ALIGNMENT_UBYTE 255 Compu_CRI_purge_T4 0 255 /end CHARACTERISTIC
/begin COMPU_METHOD Compu_CRI_purge_T4 " " RAT_FUNC "%.0" "sec" COEFFS 0 1 0 0 0 1 /end COMPU_METHOD
/begin CHARACTERISTIC CRI_purge_T5 "Fuel # CRI_purge_T5" VALUE 0x001e58f1 /* @ECU_Address@CRI_purge_T5@0x01012AB8@ */ ECIPP_ALIGNMENT_UBYTE 255 Compu_CRI_purge_T5 0 255 /end CHARACTERISTIC
/begin COMPU_METHOD Compu_CRI_purge_T5 " " RAT_FUNC "%.0" "sec" COEFFS 0 1 0 0 0 1 /end COMPU_METHOD
/begin CHARACTERISTIC CRI_purge_T6 "Fuel # CRI_purge_T6" VALUE 0x001e58f2 /* @ECU_Address@CRI_purge_T6@0x01012AC0@ */ ECIPP_ALIGNMENT_UBYTE 255 Compu_CRI_purge_T6 0 255 /end CHARACTERISTIC
/begin COMPU_METHOD Compu_CRI_purge_T6 " " RAT_FUNC "%.0" "sec" COEFFS 0 1 0 0 0 1 /end COMPU_METHOD
/begin CHARACTERISTIC CRI_purge_rpm_limit "Fuel # CRI_purge_rpm_limit" VALUE 0x001e37f0 /* @ECU_Address@CRI_purge_rpm_limit@0x01012AC8@ */ ECIPP_ALIGNMENT_UWORD 65535 Compu_CRI_purge_rpm_limit 0 65535 /end CHARACTERISTIC
/begin COMPU_METHOD Compu_CRI_purge_rpm_limit " " RAT_FUNC "%.0" "rpm" COEFFS 0 1 0 0 0 1 /end COMPU_METHOD
/begin CHARACTERISTIC CRI_purge_accel_limit "Fuel # CRI_purge_accel_limit" VALUE 0x001e2f10 /* @ECU_Address@CRI_purge_accel_limit@0x01012AD0@ */ ECIPP_ALIGNMENT_SWORD 32767 Compu_CRI_purge_accel_limit -32768 32767 /end CHARACTERISTIC
/begin COMPU_METHOD Compu_CRI_purge_accel_limit " " RAT_FUNC "%.0" "rpm/sec" COEFFS 0 1 0 0 0 1 /end COMPU_METHOD
/begin CHARACTERISTIC CRI_width_Npr "Fuel # CRI_width_Npr" VALUE 0x001e1d50 /* @ECU_Address@CRI_width_Npr@0x01012AD8@ */ ECIPP_ALIGNMENT_ULONG 214748365 Compu_CRI_width_Npr 0 214748364.75 /end CHARACTERISTIC
/begin COMPU_METHOD Compu_CRI_width_Npr " " RAT_FUNC "%.3" "us" COEFFS 0 20 0 0 0 1 /end COMPU_METHOD
/begin CHARACTERISTIC CRI_cad_Npr "Fuel # CRI_cad_Npr" VALUE 0x001e2f0e /* @ECU_Address@CRI_cad_Npr@0x01012AE0@ */ ECIPP_ALIGNMENT_SWORD 2048 Compu_CRI_cad_Npr -2048 2047.9375 /end CHARACTERISTIC
/begin COMPU_METHOD Compu_CRI_cad_Npr " " RAT_FUNC "%.3" "CAD BTDC" COEFFS 0 16 0 0 0 1 /end COMPU_METHOD
/begin CHARACTERISTIC CRI_width_Gpr "Fuel # CRI_width_Gpr" VALUE 0x001e1d4c /* @ECU_Address@CRI_width_Gpr@0x01012AE8@ */ ECIPP_ALIGNMENT_ULONG 214748365 Compu_CRI_width_Gpr 0 214748364.75 /end CHARACTERISTIC
/begin COMPU_METHOD Compu_CRI_width_Gpr " " RAT_FUNC "%.3" "us" COEFFS 0 20 0 0 0 1 /end COMPU_METHOD
/begin CHARACTERISTIC CRI_cad_Gpr "Fuel # CRI_cad_Gpr" VALUE 0x001e2f0c /* @ECU_Address@CRI_cad_Gpr@0x01012AF0@ */ ECIPP_ALIGNMENT_SWORD 2048 Compu_CRI_cad_Gpr -2048 2047.9375 /end CHARACTERISTIC
/begin COMPU_METHOD Compu_CRI_cad_Gpr " " RAT_FUNC "%.3" "CAD BTDC" COEFFS 0 16 0 0 0 1 /end COMPU_METHOD
/begin CHARACTERISTIC OILP_stopped_wait "FaultConfig # OILP_stopped_wait (Fault Condition:Stopped wait time for oil pressure switch voltage faults)" VALUE 0x001c7e0a /* @ECU_Address@OILP_stopped_wait@0x01012B50@ */ ECIPP_ALIGNMENT_UWORD 66 Compu_OILP_stopped_wait 0 65.535 /end CHARACTERISTIC
/begin COMPU_METHOD Compu_OILP_stopped_wait " " RAT_FUNC "%.3" "seconds" COEFFS 0 1000 0 0 0 1 /end COMPU_METHOD
/begin CHARACTERISTIC OCT_adapt_fault_mode "{OCT_adapt_fault_mode&0xff=0:Set to 0%}{OCT_adapt_fault_mode&0xff=1:Use last value}" VALUE 0x001c8850 /* @ECU_Address@OCT_adapt_fault_mode@0x01012C00@ */ ECIPP_ALIGNMENT_UBYTE 255 OCT_adapt_fault_mode_COMPU_VTAB 0 255 BIT_MASK 0xff /end CHARACTERISTIC
/begin COMPU_METHOD OCT_adapt_fault_mode_COMPU_VTAB "Verbal Table" TAB_VERB "%.0" "list" COMPU_TAB_REF OCT_adapt_fault_mode_COMPU_VTAB_REF /end COMPU_METHOD
/begin COMPU_VTAB OCT_adapt_fault_mode_COMPU_VTAB_REF "Verbal Table" TAB_VERB 2 0 "Set to 0%" 1 "Use last value" DEFAULT_VALUE "UNKNOWN" /end COMPU_VTAB
/begin CHARACTERISTIC EV_RH_rat_mode "{EV_RH_rat_mode&0xff=0:Disabled}{EV_RH_rat_mode&0xff=1:Enabled}" VALUE 0x001e58ff /* @ECU_Address@EV_RH_rat_mode@0x01012D60@ */ ECIPP_ALIGNMENT_UBYTE 255 EV_RH_rat_mode_COMPU_VTAB 0 255 BIT_MASK 0xff /end CHARACTERISTIC
/begin COMPU_METHOD EV_RH_rat_mode_COMPU_VTAB "Verbal Table" TAB_VERB "%.0" "list" COMPU_TAB_REF EV_RH_rat_mode_COMPU_VTAB_REF /end COMPU_METHOD
/begin COMPU_VTAB EV_RH_rat_mode_COMPU_VTAB_REF "Verbal Table" TAB_VERB 2 0 "Disabled" 1 "Enabled" DEFAULT_VALUE "UNKNOWN" /end COMPU_VTAB
/begin CHARACTERISTIC EV_RH_uns_latch_tm "FaultConfig # EV_RH_uns_latch_tm" VALUE 0x001e3864 /* @ECU_Address@EV_RH_uns_latch_tm@0x01012D70@ */ ECIPP_ALIGNMENT_UWORD 66 Compu_EV_RH_uns_latch_tm 0 65.535 /end CHARACTERISTIC
/begin COMPU_METHOD Compu_EV_RH_uns_latch_tm " " RAT_FUNC "%.3" "seconds" COEFFS 0 1000 0 0 0 1 /end COMPU_METHOD
/begin CHARACTERISTIC EV_RH_uns_unlatch_tm "FaultConfig # EV_RH_uns_unlatch_tm" VALUE 0x001e3866 /* @ECU_Address@EV_RH_uns_unlatch_tm@0x01012D78@ */ ECIPP_ALIGNMENT_UWORD 66 Compu_EV_RH_uns_unlatch_tm 0 65.535 /end CHARACTERISTIC
/begin COMPU_METHOD Compu_EV_RH_uns_unlatch_tm " " RAT_FUNC "%.3" "seconds" COEFFS 0 1000 0 0 0 1 /end COMPU_METHOD
/begin CHARACTERISTIC FIMP_fault_def "Fuel # FIMP_fault_def" VALUE 0x001e2f2c /* @ECU_Address@FIMP_fault_def@0x01012EA0@ */ ECIPP_ALIGNMENT_SWORD 200 Compu_FIMP_fault_def -200 199.993896484375 /end CHARACTERISTIC
/begin COMPU_METHOD Compu_FIMP_fault_def " " RAT_FUNC "%.3" "%" COEFFS 0 163.84 0 0 0 1 /end COMPU_METHOD
/begin CHARACTERISTIC INDUCEblk_on "FaultConfig # INDUCEblk_on" VALUE 0x001c8786 /* @ECU_Address@INDUCEblk_on@0x01012EA8@ */ ECIPP_ALIGNMENT_UBYTE 12750 Compu_INDUCEblk_on 0 12750 /end CHARACTERISTIC
/begin COMPU_METHOD Compu_INDUCEblk_on " " RAT_FUNC "%.3" "On-Time (ms)" COEFFS 0 0.02 0 0 0 1 /end COMPU_METHOD
/begin CHARACTERISTIC INDUCEblk_off "FaultConfig # INDUCEblk_off" VALUE 0x001c8785 /* @ECU_Address@INDUCEblk_off@0x01012EB0@ */ ECIPP_ALIGNMENT_UBYTE 12750 Compu_INDUCEblk_off 0 12750 /end CHARACTERISTIC
/begin COMPU_METHOD Compu_INDUCEblk_off " " RAT_FUNC "%.3" "Off-Time (ms)" COEFFS 0 0.02 0 0 0 1 /end COMPU_METHOD
/begin CHARACTERISTIC INDUCE_bulbchk "FaultConfig # INDUCE_bulbchk" VALUE 0x001c7c52 /* @ECU_Address@INDUCE_bulbchk@0x01012EB8@ */ ECIPP_ALIGNMENT_UWORD 65535 Compu_INDUCE_bulbchk 0 65535 /end CHARACTERISTIC
/begin COMPU_METHOD Compu_INDUCE_bulbchk " " RAT_FUNC "%.0" "Time (ms)" COEFFS 0 1 0 0 0 1 /end COMPU_METHOD
/begin CHARACTERISTIC INDUCE_bulbon "{INDUCE_bulbon&0xff=0:Blink}{INDUCE_bulbon&0xff=1:On}" VALUE 0x001c8783 /* @ECU_Address@INDUCE_bulbon@0x01012EC0@ */ ECIPP_ALIGNMENT_UBYTE 255 INDUCE_bulbon_COMPU_VTAB 0 255 BIT_MASK 0xff /end CHARACTERISTIC
/begin COMPU_METHOD INDUCE_bulbon_COMPU_VTAB "Verbal Table" TAB_VERB "%.0" "list" COMPU_TAB_REF INDUCE_bulbon_COMPU_VTAB_REF /end COMPU_METHOD
/begin COMPU_VTAB INDUCE_bulbon_COMPU_VTAB_REF "Verbal Table" TAB_VERB 2 0 "Blink" 1 "On" DEFAULT_VALUE "UNKNOWN" /end COMPU_VTAB
/begin CHARACTERISTIC EGR_stuckvlv_dc_min "Air # EGR_stuckvlv_dc_min" VALUE 0x001e2f1c /* @ECU_Address@EGR_stuckvlv_dc_min@0x01012ED0@ */ ECIPP_ALIGNMENT_SWORD 100 Compu_EGR_stuckvlv_dc_min -100 99.9969482421875 /end CHARACTERISTIC
/begin COMPU_METHOD Compu_EGR_stuckvlv_dc_min " " RAT_FUNC "%.3" "%" COEFFS 0 327.68 0 0 0 1 /end COMPU_METHOD
/begin CHARACTERISTIC EGR_stuckvlv_dc_max "Air # EGR_stuckvlv_dc_max" VALUE 0x001e2f1a /* @ECU_Address@EGR_stuckvlv_dc_max@0x01012ED8@ */ ECIPP_ALIGNMENT_SWORD 100 Compu_EGR_stuckvlv_dc_max -100 99.9969482421875 /end CHARACTERISTIC
/begin COMPU_METHOD Compu_EGR_stuckvlv_dc_max " " RAT_FUNC "%.3" "%" COEFFS 0 327.68 0 0 0 1 /end COMPU_METHOD
/begin CHARACTERISTIC EGR_stuckvlv_dc_tau "Air # EGR_stuckvlv_dc_tau" VALUE 0x001e58e4 /* @ECU_Address@EGR_stuckvlv_dc_tau@0x01012EE0@ */ ECIPP_ALIGNMENT_UWORD 163840 Compu_EGR_stuckvlv_dc_tau 0.16703 163840 /end CHARACTERISTIC
/begin COMPU_METHOD Compu_EGR_stuckvlv_dc_tau " " FORM "%.3" "ms"
 /begin FORMULA "-5 / log(1.0000000000001 - (X1 / 32768))" FORMULA_INV "(1.0000000000001 - exp(-5/X1)) * 32768" /end FORMULA
/end COMPU_METHOD
/begin CHARACTERISTIC EGR_stuckvlv_DChi_tm "Air # EGR_stuckvlv_DChi_tm" VALUE 0x001e384a /* @ECU_Address@EGR_stuckvlv_DChi_tm@0x01012EE8@ */ ECIPP_ALIGNMENT_UWORD 65535 Compu_EGR_stuckvlv_DChi_tm 0 65535 /end CHARACTERISTIC
/begin COMPU_METHOD Compu_EGR_stuckvlv_DChi_tm " " RAT_FUNC "%.0" "ms" COEFFS 0 1 0 0 0 1 /end COMPU_METHOD
/begin CHARACTERISTIC EGR_stuckvlv_rest_tm "Air # EGR_stuckvlv_rest_tm" VALUE 0x001e3852 /* @ECU_Address@EGR_stuckvlv_rest_tm@0x01012EF0@ */ ECIPP_ALIGNMENT_UWORD 65535 Compu_EGR_stuckvlv_rest_tm 0 65535 /end CHARACTERISTIC
/begin COMPU_METHOD Compu_EGR_stuckvlv_rest_tm " " RAT_FUNC "%.0" "ms" COEFFS 0 1 0 0 0 1 /end COMPU_METHOD
/begin CHARACTERISTIC EGR_stuckvlv_movepct "Air # EGR_stuckvlv_movepct" VALUE 0x001e384e /* @ECU_Address@EGR_stuckvlv_movepct@0x01012EF8@ */ ECIPP_ALIGNMENT_UWORD 100 Compu_EGR_stuckvlv_movepct 0 99.9984741210938 /end CHARACTERISTIC
/begin COMPU_METHOD Compu_EGR_stuckvlv_movepct " " RAT_FUNC "%.3" "%" COEFFS 0 655.36 0 0 0 1 /end COMPU_METHOD
/begin CHARACTERISTIC EGR_stuckvlv_move_tm "Air # EGR_stuckvlv_move_tm" VALUE 0x001e384c /* @ECU_Address@EGR_stuckvlv_move_tm@0x01012F00@ */ ECIPP_ALIGNMENT_UWORD 65535 Compu_EGR_stuckvlv_move_tm 0 65535 /end CHARACTERISTIC
/begin COMPU_METHOD Compu_EGR_stuckvlv_move_tm " " RAT_FUNC "%.0" "ms" COEFFS 0 1 0 0 0 1 /end COMPU_METHOD
/begin CHARACTERISTIC EGR_stuckvlv_nearpct "Air # EGR_stuckvlv_nearpct" VALUE 0x001e3850 /* @ECU_Address@EGR_stuckvlv_nearpct@0x01012F08@ */ ECIPP_ALIGNMENT_UWORD 100 Compu_EGR_stuckvlv_nearpct 0 99.9984741210938 /end CHARACTERISTIC
/begin COMPU_METHOD Compu_EGR_stuckvlv_nearpct " " RAT_FUNC "%.3" "%" COEFFS 0 655.36 0 0 0 1 /end COMPU_METHOD
/begin CHARACTERISTIC EGR_stuckvlv_cnt_max "Air # EGR_stuckvlv_cnt_max" VALUE 0x001e58f8 /* @ECU_Address@EGR_stuckvlv_cnt_max@0x01012F10@ */ ECIPP_ALIGNMENT_UBYTE 255 Compu_EGR_stuckvlv_cnt_max 0 255 /end CHARACTERISTIC
/begin COMPU_METHOD Compu_EGR_stuckvlv_cnt_max " " RAT_FUNC "%.0" "attempts" COEFFS 0 1 0 0 0 1 /end COMPU_METHOD
/begin CHARACTERISTIC LOD_FRO_vehspd_max "FaultConfig # LOD_FRO_vehspd_max (Fault Condition:and vehicle speed <)" VALUE 0x001e570c /* @ECU_Address@LOD_FRO_vehspd_max@0x01012F48@ */ ECIPP_ALIGNMENT_UWORD 256 Compu_LOD_FRO_vehspd_max 0 255.99609375 /end CHARACTERISTIC
/begin COMPU_METHOD Compu_LOD_FRO_vehspd_max " " RAT_FUNC "%.3" "kph" COEFFS 0 256 0 0 0 1 /end COMPU_METHOD
/begin CHARACTERISTIC fm_gd_oper_AAT_max "FaultConfig # fm_gd_oper_AAT_max" VALUE 0x001e58d6 /* @ECU_Address@fm_gd_oper_AAT_max@0x01012FE8@ */ ECIPP_ALIGNMENT_UWORD 564 Compu_fm_gd_oper_AAT_max -460 563.984375 /end CHARACTERISTIC
/begin COMPU_METHOD Compu_fm_gd_oper_AAT_max " " RAT_FUNC "%.3" "deg F" COEFFS 0 64 29440 0 0 1 /end COMPU_METHOD
/begin CHARACTERISTIC BstTIP_Lo_RPM_max "FaultConfig # BstTIP_Lo_RPM_max (Fault Condition:and RPM <)" VALUE 0x001c6d9e /* @ECU_Address@BstTIP_Lo_RPM_max@0x01012FF0@ */ ECIPP_ALIGNMENT_UWORD 65535 Compu_BstTIP_Lo_RPM_max 0 65535 /end CHARACTERISTIC
/begin COMPU_METHOD Compu_BstTIP_Lo_RPM_max " " RAT_FUNC "%.0" "rpm" COEFFS 0 1 0 0 0 1 /end COMPU_METHOD
/begin CHARACTERISTIC BstTIP_Lo2_RPM_max "FaultConfig # BstTIP_Lo2_RPM_max (Fault Condition:and RPM <)" VALUE 0x001c6d96 /* @ECU_Address@BstTIP_Lo2_RPM_max@0x01012FF8@ */ ECIPP_ALIGNMENT_UWORD 65535 Compu_BstTIP_Lo2_RPM_max 0 65535 /end CHARACTERISTIC
/begin COMPU_METHOD Compu_BstTIP_Lo2_RPM_max " " RAT_FUNC "%.0" "rpm" COEFFS 0 1 0 0 0 1 /end COMPU_METHOD
/begin CHARACTERISTIC BstTIP_Lo_speed_exec "{BstTIP_Lo_speed_exec&0xff=0:No}{BstTIP_Lo_speed_exec&0xff=1:Yes} (Fault Condition:full authority discrete speed governing is active)" VALUE 0x001c868e /* @ECU_Address@BstTIP_Lo_speed_exec@0x01013000@ */ ECIPP_ALIGNMENT_UBYTE 255 BstTIP_Lo_speed_exec_COMPU_VTAB 0 255 BIT_MASK 0xff /end CHARACTERISTIC
/begin COMPU_METHOD BstTIP_Lo_speed_exec_COMPU_VTAB "Verbal Table" TAB_VERB "%.0" "list" COMPU_TAB_REF BstTIP_Lo_speed_exec_COMPU_VTAB_REF /end COMPU_METHOD
/begin COMPU_VTAB BstTIP_Lo_speed_exec_COMPU_VTAB_REF "Verbal Table" TAB_VERB 2 0 "No" 1 "Yes" DEFAULT_VALUE "UNKNOWN" /end COMPU_VTAB
/begin CHARACTERISTIC LOD_flk_abort_Vbat "FaultConfig # LOD_flk_abort_Vbat (Fault Condition:Battery voltage drop >)" VALUE 0x001c7d02 /* @ECU_Address@LOD_flk_abort_Vbat@0x01013008@ */ ECIPP_ALIGNMENT_UWORD 256 Compu_LOD_flk_abort_Vbat 0 255.99609375 /end CHARACTERISTIC
/begin COMPU_METHOD Compu_LOD_flk_abort_Vbat " " RAT_FUNC "%.3" "volts" COEFFS 0 256 0 0 0 1 /end COMPU_METHOD
/begin CHARACTERISTIC LOD_flk_abort_Vbatdt "FaultConfig # LOD_flk_abort_Vbatdt (Fault Condition:and dVbat/dt >)" VALUE 0x001c4532 /* @ECU_Address@LOD_flk_abort_Vbatdt@0x01013010@ */ ECIPP_ALIGNMENT_SWORD 1024 Compu_LOD_flk_abort_Vbatdt -1024 1023.96875 /end CHARACTERISTIC
/begin COMPU_METHOD Compu_LOD_flk_abort_Vbatdt " " RAT_FUNC "%.3" "volts/sec" COEFFS 0 32 0 0 0 1 /end COMPU_METHOD
/begin CHARACTERISTIC FPD_off_loVf "FaultConfig # FPD_off_loVf (Fault Condition:PWM low-side feedback <)" VALUE 0x001e5104 /* @ECU_Address@FPD_off_loVf@0x010130A0@ */ ECIPP_ALIGNMENT_UWORD 100 Compu_FPD_off_loVf 0 99.9984741210938 /end CHARACTERISTIC
/begin COMPU_METHOD Compu_FPD_off_loVf " " RAT_FUNC "%.3" "% Vbat" COEFFS 0 655.36 0 0 0 1 /end COMPU_METHOD
/begin CHARACTERISTIC FPD_on_hiVf "FaultConfig # FPD_on_hiVf (Fault Condition:PWM low-side feedback >)" VALUE 0x001e5108 /* @ECU_Address@FPD_on_hiVf@0x010130A8@ */ ECIPP_ALIGNMENT_UWORD 100 Compu_FPD_on_hiVf 0 99.9984741210938 /end CHARACTERISTIC
/begin COMPU_METHOD Compu_FPD_on_hiVf " " RAT_FUNC "%.3" "% Vbat" COEFFS 0 655.36 0 0 0 1 /end COMPU_METHOD
/begin CHARACTERISTIC FPD_off_loDC "FaultConfig # FPD_off_loDC (Fault Condition:and PWM duty-cycle <)" VALUE 0x001e5102 /* @ECU_Address@FPD_off_loDC@0x010130B0@ */ ECIPP_ALIGNMENT_UWORD 100 Compu_FPD_off_loDC 0 99.9984741210938 /end CHARACTERISTIC
/begin COMPU_METHOD Compu_FPD_off_loDC " " RAT_FUNC "%.3" "%" COEFFS 0 655.36 0 0 0 1 /end COMPU_METHOD
/begin CHARACTERISTIC FPD_on_hiDC "FaultConfig # FPD_on_hiDC (Fault Condition:and PWM duty-cycle >)" VALUE 0x001e5106 /* @ECU_Address@FPD_on_hiDC@0x010130B8@ */ ECIPP_ALIGNMENT_UWORD 100 Compu_FPD_on_hiDC 0 99.9984741210938 /end CHARACTERISTIC
/begin COMPU_METHOD Compu_FPD_on_hiDC " " RAT_FUNC "%.3" "%" COEFFS 0 655.36 0 0 0 1 /end COMPU_METHOD
/begin CHARACTERISTIC HEX_CCP_svc_key "IOConfig # HEX_CCP_svc_key" VALUE 0x001c42a4 /* @ECU_Address@HEX_CCP_svc_key@0x010132B8@ */ ECIPP_ALIGNMENT_ULONG 4294967295 Compu_HEX_CCP_svc_key 0 4294967295 /end CHARACTERISTIC
/begin COMPU_METHOD Compu_HEX_CCP_svc_key " " RAT_FUNC "%.0" "-" COEFFS 0 1 0 0 0 1 /end COMPU_METHOD
/begin CHARACTERISTIC HEX_CCP_oem_key "IOConfig # HEX_CCP_oem_key" VALUE 0x001c42a0 /* @ECU_Address@HEX_CCP_oem_key@0x010132C0@ */ ECIPP_ALIGNMENT_ULONG 4294967295 Compu_HEX_CCP_oem_key 0 4294967295 /end CHARACTERISTIC
/begin COMPU_METHOD Compu_HEX_CCP_oem_key " " RAT_FUNC "%.0" "-" COEFFS 0 1 0 0 0 1 /end COMPU_METHOD
/begin CHARACTERISTIC HEX_UDS_svc_key "IOConfig # HEX_UDS_svc_key" VALUE 0x001c42ac /* @ECU_Address@HEX_UDS_svc_key@0x010132C8@ */ ECIPP_ALIGNMENT_ULONG 4294967295 Compu_HEX_UDS_svc_key 0 4294967295 /end CHARACTERISTIC
/begin COMPU_METHOD Compu_HEX_UDS_svc_key " " RAT_FUNC "%.0" "-" COEFFS 0 1 0 0 0 1 /end COMPU_METHOD
/begin CHARACTERISTIC HEX_UDS_oem_key "IOConfig # HEX_UDS_oem_key" VALUE 0x001c42a8 /* @ECU_Address@HEX_UDS_oem_key@0x010132D0@ */ ECIPP_ALIGNMENT_ULONG 4294967295 Compu_HEX_UDS_oem_key 0 4294967295 /end CHARACTERISTIC
/begin COMPU_METHOD Compu_HEX_UDS_oem_key " " RAT_FUNC "%.0" "-" COEFFS 0 1 0 0 0 1 /end COMPU_METHOD
/begin CHARACTERISTIC FPUMP_off_loVf "FaultConfig # FPUMP_off_loVf (Fault Condition:OR low-side driver off-state feedback <)" VALUE 0x001c6fc4 /* @ECU_Address@FPUMP_off_loVf@0x010132F0@ */ ECIPP_ALIGNMENT_UWORD 100 Compu_FPUMP_off_loVf 0 99.9984741210938 /end CHARACTERISTIC
/begin COMPU_METHOD Compu_FPUMP_off_loVf " " RAT_FUNC "%.3" "% Vbat" COEFFS 0 655.36 0 0 0 1 /end COMPU_METHOD
/begin CHARACTERISTIC FPUMP_off_hiVf "FaultConfig # FPUMP_off_hiVf (Fault Condition:OR high-side driver off-state feedback >)" VALUE 0x001c6fc0 /* @ECU_Address@FPUMP_off_hiVf@0x010132F8@ */ ECIPP_ALIGNMENT_UWORD 100 Compu_FPUMP_off_hiVf 0 99.9984741210938 /end CHARACTERISTIC
/begin COMPU_METHOD Compu_FPUMP_off_hiVf " " RAT_FUNC "%.3" "% Vbat" COEFFS 0 655.36 0 0 0 1 /end COMPU_METHOD
/begin CHARACTERISTIC FTgasf_minECT "Fuel # FTgasf_minECT (Fault Condition:and ECT >=)" VALUE 0x001c7ba0 /* @ECU_Address@FTgasf_minECT@0x01013300@ */ ECIPP_ALIGNMENT_UWORD 564 Compu_FTgasf_minECT -460 563.984375 /end CHARACTERISTIC
/begin COMPU_METHOD Compu_FTgasf_minECT " " RAT_FUNC "%.3" "deg F" COEFFS 0 64 29440 0 0 1 /end COMPU_METHOD
/begin CHARACTERISTIC MILblk_code_strt_max "General # MILblk_code_strt_max" VALUE 0x001e6deb /* @ECU_Address@MILblk_code_strt_max@0x01013478@ */ ECIPP_ALIGNMENT_UBYTE 255 Compu_MILblk_code_strt_max 0 255 /end CHARACTERISTIC
/begin COMPU_METHOD Compu_MILblk_code_strt_max " " RAT_FUNC "%.0" "cycles" COEFFS 0 1 0 0 0 1 /end COMPU_METHOD
/begin CHARACTERISTIC MFG_RLV_FRO_RS_ena "{MFG_RLV_FRO_RS_ena&0xff=0:Disabled}{MFG_RLV_FRO_RS_ena&0xff=1:Enabled} (Fault Condition:'Fuel run-out longer than expected' road speed conditions)" VALUE 0x001c8829 /* @ECU_Address@MFG_RLV_FRO_RS_ena@0x010134B0@ */ ECIPP_ALIGNMENT_UBYTE 255 MFG_RLV_FRO_RS_ena_COMPU_VTAB 0 255 BIT_MASK 0xff /end CHARACTERISTIC
/begin COMPU_METHOD MFG_RLV_FRO_RS_ena_COMPU_VTAB "Verbal Table" TAB_VERB "%.0" "list" COMPU_TAB_REF MFG_RLV_FRO_RS_ena_COMPU_VTAB_REF /end COMPU_METHOD
/begin COMPU_VTAB MFG_RLV_FRO_RS_ena_COMPU_VTAB_REF "Verbal Table" TAB_VERB 2 0 "Disabled" 1 "Enabled" DEFAULT_VALUE "UNKNOWN" /end COMPU_VTAB
/begin CHARACTERISTIC MFG_RLV_FROWARNforce "{MFG_RLV_FROWARNforce&0xff=0:Disabled}{MFG_RLV_FROWARNforce&0xff=1:Soft Warning}{MFG_RLV_FROWARNforce&0xff=2:Hard Warning} (Fault Condition:Historic fault forced indication)" VALUE 0x001c8828 /* @ECU_Address@MFG_RLV_FROWARNforce@0x010134B8@ */ ECIPP_ALIGNMENT_UBYTE 255 MFG_RLV_FROWARNforce_COMPU_VTAB 0 255 BIT_MASK 0xff /end CHARACTERISTIC
/begin COMPU_METHOD MFG_RLV_FROWARNforce_COMPU_VTAB "Verbal Table" TAB_VERB "%.0" "list" COMPU_TAB_REF MFG_RLV_FROWARNforce_COMPU_VTAB_REF /end COMPU_METHOD
/begin COMPU_VTAB MFG_RLV_FROWARNforce_COMPU_VTAB_REF "Verbal Table" TAB_VERB 3 0 "Disabled" 1 "Soft Warning" 2 "Hard Warning" DEFAULT_VALUE "UNKNOWN" /end COMPU_VTAB
/begin CHARACTERISTIC TRAT_engstop_tm "FaultConfig # TRAT_engstop_tm" VALUE 0x001e9be1 /* @ECU_Address@TRAT_engstop_tm@0x010134D8@ */ ECIPP_ALIGNMENT_UBYTE 1 Compu_TRAT_engstop_tm 0 0.99609375 /end CHARACTERISTIC
/begin COMPU_METHOD Compu_TRAT_engstop_tm " " RAT_FUNC "%.3" "hours" COEFFS 0 256 0 0 0 1 /end COMPU_METHOD
/begin CHARACTERISTIC TRAT_samp_tm "FaultConfig # TRAT_samp_tm" VALUE 0x001e5854 /* @ECU_Address@TRAT_samp_tm@0x010134F0@ */ ECIPP_ALIGNMENT_UWORD 66 Compu_TRAT_samp_tm 0 65.535 /end CHARACTERISTIC
/begin COMPU_METHOD Compu_TRAT_samp_tm " " RAT_FUNC "%.3" "sec" COEFFS 0 1000 0 0 0 1 /end COMPU_METHOD
/begin CHARACTERISTIC TRAT_ana_samp_cnt "FaultConfig # TRAT_ana_samp_cnt" VALUE 0x001e9be0 /* @ECU_Address@TRAT_ana_samp_cnt@0x010134F8@ */ ECIPP_ALIGNMENT_UBYTE 255 Compu_TRAT_ana_samp_cnt 0 255 /end CHARACTERISTIC
/begin COMPU_METHOD Compu_TRAT_ana_samp_cnt " " RAT_FUNC "%.0" "samples" COEFFS 0 1 0 0 0 1 /end COMPU_METHOD
/begin CHARACTERISTIC TRAT_crank_total_lim "FaultConfig # TRAT_crank_total_lim" VALUE 0x001e5852 /* @ECU_Address@TRAT_crank_total_lim@0x01013500@ */ ECIPP_ALIGNMENT_UWORD 66 Compu_TRAT_crank_total_lim 0 65.535 /end CHARACTERISTIC
/begin COMPU_METHOD Compu_TRAT_crank_total_lim " " RAT_FUNC "%.3" "sec" COEFFS 0 1000 0 0 0 1 /end COMPU_METHOD
/begin CHARACTERISTIC TRAT_IAT_dT_max "FaultConfig # TRAT_IAT_dT_max (Fault Condition:abs(ECT - IAT) >)" VALUE 0x001E5856 /* @ECU_Address@TRAT_IAT_dT_max@0x01013518@ */ ECIPP_ALIGNMENT_UWORD 1024 Compu_TRAT_IAT_dT_max 0 1023.984375 /end CHARACTERISTIC
/begin COMPU_METHOD Compu_TRAT_IAT_dT_max " " RAT_FUNC "%.3" "deg F" COEFFS 0 64 0 0 0 1 /end COMPU_METHOD
/begin CHARACTERISTIC TRAT_AAT_dT_max "FaultConfig # TRAT_AAT_dT_max (Fault Condition:abs(ECT - AAT) >)" VALUE 0x001E5858 /* @ECU_Address@TRAT_AAT_dT_max@0x01013530@ */ ECIPP_ALIGNMENT_UWORD 1024 Compu_TRAT_AAT_dT_max 0 1023.984375 /end CHARACTERISTIC
/begin COMPU_METHOD Compu_TRAT_AAT_dT_max " " RAT_FUNC "%.3" "deg F" COEFFS 0 64 0 0 0 1 /end COMPU_METHOD
/begin CHARACTERISTIC TRAT_EGRT_dT_max "FaultConfig # TRAT_EGRT_dT_max (Fault Condition:abs(ECT - EGRT) >)" VALUE 0x001E585A /* @ECU_Address@TRAT_EGRT_dT_max@0x01013548@ */ ECIPP_ALIGNMENT_UWORD 1024 Compu_TRAT_EGRT_dT_max 0 1023.984375 /end CHARACTERISTIC
/begin COMPU_METHOD Compu_TRAT_EGRT_dT_max " " RAT_FUNC "%.3" "deg F" COEFFS 0 64 0 0 0 1 /end COMPU_METHOD
/begin CHARACTERISTIC TRAT_FT_dT_max "FaultConfig # TRAT_FT_dT_max (Fault Condition:abs(ECT - FT) >)" VALUE 0x001E585C /* @ECU_Address@TRAT_FT_dT_max@0x01013560@ */ ECIPP_ALIGNMENT_UWORD 1024 Compu_TRAT_FT_dT_max 0 1023.984375 /end CHARACTERISTIC
/begin COMPU_METHOD Compu_TRAT_FT_dT_max " " RAT_FUNC "%.3" "deg F" COEFFS 0 64 0 0 0 1 /end COMPU_METHOD
/begin CHARACTERISTIC TRAT_OILT_dT_max "FaultConfig # TRAT_OILT_dT_max (Fault Condition:abs(ECT - OILT) >)" VALUE 0x001E585E /* @ECU_Address@TRAT_OILT_dT_max@0x01013578@ */ ECIPP_ALIGNMENT_UWORD 1024 Compu_TRAT_OILT_dT_max 0 1023.984375 /end CHARACTERISTIC
/begin COMPU_METHOD Compu_TRAT_OILT_dT_max " " RAT_FUNC "%.3" "deg F" COEFFS 0 64 0 0 0 1 /end COMPU_METHOD
/begin CHARACTERISTIC TRAT_EGT_dT_max "FaultConfig # TRAT_EGT_dT_max (Fault Condition:abs(ECT - EGT) >)" VALUE 0x001E5860 /* @ECU_Address@TRAT_EGT_dT_max@0x01013590@ */ ECIPP_ALIGNMENT_UWORD 1024 Compu_TRAT_EGT_dT_max 0 1023.984375 /end CHARACTERISTIC
/begin COMPU_METHOD Compu_TRAT_EGT_dT_max " " RAT_FUNC "%.3" "deg F" COEFFS 0 64 0 0 0 1 /end COMPU_METHOD
/begin CHARACTERISTIC TRAT_TIAT_dT_max "FaultConfig # TRAT_TIAT_dT_max (Fault Condition:abs(ECT - TIAT) >)" VALUE 0x001E5862 /* @ECU_Address@TRAT_TIAT_dT_max@0x010135A8@ */ ECIPP_ALIGNMENT_UWORD 1024 Compu_TRAT_TIAT_dT_max 0 1023.984375 /end CHARACTERISTIC
/begin COMPU_METHOD Compu_TRAT_TIAT_dT_max " " RAT_FUNC "%.3" "deg F" COEFFS 0 64 0 0 0 1 /end COMPU_METHOD
/begin CHARACTERISTIC TRAT_TAUX_n1_dT_max "FaultConfig # TRAT_TAUX_n1_dT_max (Fault Condition:abs(ECT - AUX Temperature X) >)" VALUE 0x001E5864 /* @ECU_Address@TRAT_TAUX_n1_dT_max@0x010135C0@ */ ECIPP_ALIGNMENT_UWORD 1024 Compu_TRAT_TAUX_n1_dT_max 0 1023.984375 /end CHARACTERISTIC
/begin COMPU_METHOD Compu_TRAT_TAUX_n1_dT_max " " RAT_FUNC "%.3" "deg F" COEFFS 0 64 0 0 0 1 /end COMPU_METHOD
/begin CHARACTERISTIC TRAT_TAUX_n2_dT_max "FaultConfig # TRAT_TAUX_n2_dT_max (Fault Condition:abs(ECT - AUX Temperature X) >)" VALUE 0x001E5866 /* @ECU_Address@TRAT_TAUX_n2_dT_max@0x010135E0@ */ ECIPP_ALIGNMENT_UWORD 1024 Compu_TRAT_TAUX_n2_dT_max 0 1023.984375 /end CHARACTERISTIC
/begin COMPU_METHOD Compu_TRAT_TAUX_n2_dT_max " " RAT_FUNC "%.3" "deg F" COEFFS 0 64 0 0 0 1 /end COMPU_METHOD
/begin CHARACTERISTIC TRAT_AAT_min "FaultConfig # TRAT_AAT_min" VALUE 0x001e5850 /* @ECU_Address@TRAT_AAT_min@0x01013610@ */ ECIPP_ALIGNMENT_UWORD 564 Compu_TRAT_AAT_min -460 563.984375 /end CHARACTERISTIC
/begin COMPU_METHOD Compu_TRAT_AAT_min " " RAT_FUNC "%.3" "deg F" COEFFS 0 64 29440 0 0 1 /end COMPU_METHOD
/begin CHARACTERISTIC ERCV_diag_run_wait "FaultConfig # ERCV_diag_run_wait (Fault Condition:Time in “Run” state >)" VALUE 0x001e58fd /* @ECU_Address@ERCV_diag_run_wait@0x01013658@ */ ECIPP_ALIGNMENT_UBYTE 255 Compu_ERCV_diag_run_wait 0 255 /end CHARACTERISTIC
/begin COMPU_METHOD Compu_ERCV_diag_run_wait " " RAT_FUNC "%.0" "sec" COEFFS 0 1 0 0 0 1 /end COMPU_METHOD
/begin CHARACTERISTIC ERCV_diag_stop_wait "FaultConfig # ERCV_diag_stop_wait (Fault Condition:OR engine stopped time >)" VALUE 0x001e58fe /* @ECU_Address@ERCV_diag_stop_wait@0x01013660@ */ ECIPP_ALIGNMENT_UBYTE 255 Compu_ERCV_diag_stop_wait 0 255 /end CHARACTERISTIC
/begin COMPU_METHOD Compu_ERCV_diag_stop_wait " " RAT_FUNC "%.0" "sec" COEFFS 0 1 0 0 0 1 /end COMPU_METHOD
/begin CHARACTERISTIC ERCV_speed_freq_min "FaultConfig # ERCV_speed_freq_min (Fault Condition:and frequency is not >=)" VALUE 0x001e0014 /* @ECU_Address@ERCV_speed_freq_min@0x01013668@ */ ECIPP_ALIGNMENT_FLOAT32_IEEE 10000000000 Compu_ERCV_speed_freq_min -10000000000 10000000000 /end CHARACTERISTIC
/begin COMPU_METHOD Compu_ERCV_speed_freq_min " " RAT_FUNC "%.3" "Hz" COEFFS 0 1 0 0 0 1 /end COMPU_METHOD
/begin CHARACTERISTIC ERCV_speed_freq_max "FaultConfig # ERCV_speed_freq_max (Fault Condition:and frequency is not <=)" VALUE 0x001e0010 /* @ECU_Address@ERCV_speed_freq_max@0x01013670@ */ ECIPP_ALIGNMENT_FLOAT32_IEEE 10000000000 Compu_ERCV_speed_freq_max -10000000000 10000000000 /end CHARACTERISTIC
/begin COMPU_METHOD Compu_ERCV_speed_freq_max " " RAT_FUNC "%.3" "Hz" COEFFS 0 1 0 0 0 1 /end COMPU_METHOD
/begin CHARACTERISTIC tech_LLgear_write_en "{tech_LLgear_write_en&0xff=0:Not allowed}{tech_LLgear_write_en&0xff=1:Allowed}" VALUE 0x001eccac /* @ECU_Address@tech_LLgear_write_en@0x01013678@ */ ECIPP_ALIGNMENT_UBYTE 255 tech_LLgear_write_en_COMPU_VTAB 0 255 BIT_MASK 0xff /end CHARACTERISTIC
/begin COMPU_METHOD tech_LLgear_write_en_COMPU_VTAB "Verbal Table" TAB_VERB "%.0" "list" COMPU_TAB_REF tech_LLgear_write_en_COMPU_VTAB_REF /end COMPU_METHOD
/begin COMPU_VTAB tech_LLgear_write_en_COMPU_VTAB_REF "Verbal Table" TAB_VERB 2 0 "Not allowed" 1 "Allowed" DEFAULT_VALUE "UNKNOWN" /end COMPU_VTAB
/begin CHARACTERISTIC CCT_Taux_cal "{CCT_Taux_cal&0xff=0:Fuel source}{CCT_Taux_cal&0xff=1:Exhaust manifold/riser}{CCT_Taux_cal&0xff=2:Aux Temp A}{CCT_Taux_cal&0xff=3:Aux Temp B}{CCT_Taux_cal&0xff=4:Aux Temp C}{CCT_Taux_cal&0xff=5:Aux Temp D}" VALUE 0x001c869c /* @ECU_Address@CCT_Taux_cal@0x010136F8@ */ ECIPP_ALIGNMENT_UBYTE 255 CCT_Taux_cal_COMPU_VTAB 0 255 BIT_MASK 0xff /end CHARACTERISTIC
/begin COMPU_METHOD CCT_Taux_cal_COMPU_VTAB "Verbal Table" TAB_VERB "%.0" "list" COMPU_TAB_REF CCT_Taux_cal_COMPU_VTAB_REF /end COMPU_METHOD
/begin COMPU_VTAB CCT_Taux_cal_COMPU_VTAB_REF "Verbal Table" TAB_VERB 6 0 "Fuel source" 1 "Exhaust manifold/riser" 2 "Aux Temp A" 3 "Aux Temp B" 4 "Aux Temp C" 5 "Aux Temp D" DEFAULT_VALUE "UNKNOWN" /end COMPU_VTAB
/begin CHARACTERISTIC CCT_vdr "IOConfig # CCT_vdr" VALUE 0x001c3a7c /* @ECU_Address@CCT_vdr@0x01013700@ */ ECIPP_ALIGNMENT_FLOAT32_IEEE 10000000000 Compu_CCT_vdr -10000000000 10000000000 /end CHARACTERISTIC
/begin COMPU_METHOD Compu_CCT_vdr " " RAT_FUNC "%.3" "ohms" COEFFS 0 1 0 0 0 1 /end COMPU_METHOD
/begin CHARACTERISTIC J1939_SOFT_mode "{J1939_SOFT_mode&0xff=0:Standard}{J1939_SOFT_mode&0xff=1:Alternate}" VALUE 0x001e6ddd /* @ECU_Address@J1939_SOFT_mode@0x010137C0@ */ ECIPP_ALIGNMENT_UBYTE 255 J1939_SOFT_mode_COMPU_VTAB 0 255 BIT_MASK 0xff /end CHARACTERISTIC
/begin COMPU_METHOD J1939_SOFT_mode_COMPU_VTAB "Verbal Table" TAB_VERB "%.0" "list" COMPU_TAB_REF J1939_SOFT_mode_COMPU_VTAB_REF /end COMPU_METHOD
/begin COMPU_VTAB J1939_SOFT_mode_COMPU_VTAB_REF "Verbal Table" TAB_VERB 2 0 "Standard" 1 "Alternate" DEFAULT_VALUE "UNKNOWN" /end COMPU_VTAB
/begin MEASUREMENT TWCmod_OSC_crct "Current oxygen storage capacity" FLOAT32_IEEE Compu_TWCmod_OSC_crct 0 0 -10000000000 10000000000 ECU_ADDRESS 0x010138A8 /end MEASUREMENT
/begin COMPU_METHOD Compu_TWCmod_OSC_crct " " RAT_FUNC "%.1" "g" COEFFS 0 1 0 0 0 1 /end COMPU_METHOD
/begin CHARACTERISTIC CM_unresp_nstoich_en "{CM_unresp_nstoich_en&0xff=0:before FSO}{CM_unresp_nstoich_en&0xff=1:during FSO} (Fault Condition:and phi command is within excursion limits)" VALUE 0x001e58ed /* @ECU_Address@CM_unresp_nstoich_en@0x010138C0@ */ ECIPP_ALIGNMENT_UBYTE 255 CM_unresp_nstoich_en_COMPU_VTAB 0 255 BIT_MASK 0xff /end CHARACTERISTIC
/begin COMPU_METHOD CM_unresp_nstoich_en_COMPU_VTAB "Verbal Table" TAB_VERB "%.0" "list" COMPU_TAB_REF CM_unresp_nstoich_en_COMPU_VTAB_REF /end COMPU_METHOD
/begin COMPU_VTAB CM_unresp_nstoich_en_COMPU_VTAB_REF "Verbal Table" TAB_VERB 2 0 "before FSO" 1 "during FSO" DEFAULT_VALUE "UNKNOWN" /end COMPU_VTAB
/begin CHARACTERISTIC VDS_reprog_mode "{VDS_reprog_mode&0xff=0:Standard}{VDS_reprog_mode&0xff=1:Variant Data Set}" VALUE 0x001e9be4 /* @ECU_Address@VDS_reprog_mode@0x01013918@ */ ECIPP_ALIGNMENT_UBYTE 255 VDS_reprog_mode_COMPU_VTAB 0 255 BIT_MASK 0xff /end CHARACTERISTIC
/begin COMPU_METHOD VDS_reprog_mode_COMPU_VTAB "Verbal Table" TAB_VERB "%.0" "list" COMPU_TAB_REF VDS_reprog_mode_COMPU_VTAB_REF /end COMPU_METHOD
/begin COMPU_VTAB VDS_reprog_mode_COMPU_VTAB_REF "Verbal Table" TAB_VERB 2 0 "Standard" 1 "Variant Data Set" DEFAULT_VALUE "UNKNOWN" /end COMPU_VTAB
/begin CHARACTERISTIC ICam_ref_offset "IOConfig # ICam_ref_offset" VALUE 0x001C9F56 /* @ECU_Address@ICam_ref_offset@0x01013928@ */ ECIPP_ALIGNMENT_SWORD 2048 Compu_ICam_ref_offset -2048 2047.9375 /end CHARACTERISTIC
/begin COMPU_METHOD Compu_ICam_ref_offset " " RAT_FUNC "%.3" "CAD BTDC" COEFFS 0 16 0 0 0 1 /end COMPU_METHOD
/begin CHARACTERISTIC ECam_ref_offset "IOConfig # ECam_ref_offset" VALUE 0x001C9CE2 /* @ECU_Address@ECam_ref_offset@0x01013930@ */ ECIPP_ALIGNMENT_SWORD 2048 Compu_ECam_ref_offset -2048 2047.9375 /end CHARACTERISTIC
/begin COMPU_METHOD Compu_ECam_ref_offset " " RAT_FUNC "%.3" "CAD BTDC" COEFFS 0 16 0 0 0 1 /end COMPU_METHOD
/begin CHARACTERISTIC MFA_lo_flow_pct "FaultConfig # MFA_lo_flow_pct (Fault Condition:(actual flow - VE estimated flow) <)" VALUE 0x001c4560 /* @ECU_Address@MFA_lo_flow_pct@0x01013A08@ */ ECIPP_ALIGNMENT_SWORD 400 Compu_MFA_lo_flow_pct -400 399.98779296875 /end CHARACTERISTIC
/begin COMPU_METHOD Compu_MFA_lo_flow_pct " " RAT_FUNC "%.3" "%" COEFFS 0 81.92 0 0 0 1 /end COMPU_METHOD
/begin CHARACTERISTIC MFA_hi_flow_pct "FaultConfig # MFA_hi_flow_pct (Fault Condition:(actual flow - VE estimated flow) >)" VALUE 0x001c455e /* @ECU_Address@MFA_hi_flow_pct@0x01013A10@ */ ECIPP_ALIGNMENT_SWORD 400 Compu_MFA_hi_flow_pct -400 399.98779296875 /end CHARACTERISTIC
/begin COMPU_METHOD Compu_MFA_hi_flow_pct " " RAT_FUNC "%.3" "%" COEFFS 0 81.92 0 0 0 1 /end COMPU_METHOD
/begin CHARACTERISTIC MFA_flow_min_RPM "FaultConfig # MFA_flow_min_RPM (Fault Condition:and RPM >)" VALUE 0x001c7d8a /* @ECU_Address@MFA_flow_min_RPM@0x01013A18@ */ ECIPP_ALIGNMENT_UWORD 65535 Compu_MFA_flow_min_RPM 0 65535 /end CHARACTERISTIC
/begin COMPU_METHOD Compu_MFA_flow_min_RPM " " RAT_FUNC "%.0" "rpm" COEFFS 0 1 0 0 0 1 /end COMPU_METHOD
/begin CHARACTERISTIC MFA_flow_min_MAP "FaultConfig # MFA_flow_min_MAP (Fault Condition:and MAP >)" VALUE 0x001c7d88 /* @ECU_Address@MFA_flow_min_MAP@0x01013A20@ */ ECIPP_ALIGNMENT_UWORD 256 Compu_MFA_flow_min_MAP 0 255.99609375 /end CHARACTERISTIC
/begin COMPU_METHOD Compu_MFA_flow_min_MAP " " RAT_FUNC "%.3" "psia" COEFFS 0 256 0 0 0 1 /end COMPU_METHOD
/begin CHARACTERISTIC MFG_lo_flow_pct "FaultConfig # MFG_lo_flow_pct (Fault Condition:(actual flow - commanded flow) <)" VALUE 0x001c4564 /* @ECU_Address@MFG_lo_flow_pct@0x01013A30@ */ ECIPP_ALIGNMENT_SWORD 400 Compu_MFG_lo_flow_pct -400 399.98779296875 /end CHARACTERISTIC
/begin COMPU_METHOD Compu_MFG_lo_flow_pct " " RAT_FUNC "%.3" "%" COEFFS 0 81.92 0 0 0 1 /end COMPU_METHOD
/begin CHARACTERISTIC MFG_hi_flow_pct "FaultConfig # MFG_hi_flow_pct (Fault Condition:(actual flow - commanded flow) >)" VALUE 0x001c4562 /* @ECU_Address@MFG_hi_flow_pct@0x01013A38@ */ ECIPP_ALIGNMENT_SWORD 400 Compu_MFG_hi_flow_pct -400 399.98779296875 /end CHARACTERISTIC
/begin COMPU_METHOD Compu_MFG_hi_flow_pct " " RAT_FUNC "%.3" "%" COEFFS 0 81.92 0 0 0 1 /end COMPU_METHOD
/begin CHARACTERISTIC MFG_flow_min_RPM "FaultConfig # MFG_flow_min_RPM (Fault Condition:and RPM >)" VALUE 0x001c7d96 /* @ECU_Address@MFG_flow_min_RPM@0x01013A40@ */ ECIPP_ALIGNMENT_UWORD 65535 Compu_MFG_flow_min_RPM 0 65535 /end CHARACTERISTIC
/begin COMPU_METHOD Compu_MFG_flow_min_RPM " " RAT_FUNC "%.0" "rpm" COEFFS 0 1 0 0 0 1 /end COMPU_METHOD
/begin CHARACTERISTIC MFG_flow_min_MAP "FaultConfig # MFG_flow_min_MAP (Fault Condition:and MAP >)" VALUE 0x001c7d94 /* @ECU_Address@MFG_flow_min_MAP@0x01013A48@ */ ECIPP_ALIGNMENT_UWORD 256 Compu_MFG_flow_min_MAP 0 255.99609375 /end CHARACTERISTIC
/begin COMPU_METHOD Compu_MFG_flow_min_MAP " " RAT_FUNC "%.3" "psia" COEFFS 0 256 0 0 0 1 /end COMPU_METHOD
/begin CHARACTERISTIC FSO_TPS_diag_pct "FaultConfig # FSO_TPS_diag_pct" VALUE 0x001e56b6 /* @ECU_Address@FSO_TPS_diag_pct@0x01013A70@ */ ECIPP_ALIGNMENT_UWORD 100 Compu_FSO_TPS_diag_pct 0 99.9984741210938 /end CHARACTERISTIC
/begin COMPU_METHOD Compu_FSO_TPS_diag_pct " " RAT_FUNC "%.3" "%" COEFFS 0 655.36 0 0 0 1 /end COMPU_METHOD
/begin CHARACTERISTIC IBF_fault_events "FaultConfig # IBF_fault_events (Fault Condition:Intake backfire events >=)" VALUE 0x001e6dda /* @ECU_Address@IBF_fault_events@0x01013AD0@ */ ECIPP_ALIGNMENT_UBYTE 255 Compu_IBF_fault_events 0 255 /end CHARACTERISTIC
/begin COMPU_METHOD Compu_IBF_fault_events " " RAT_FUNC "%.0" "events" COEFFS 0 1 0 0 0 1 /end COMPU_METHOD
/begin CHARACTERISTIC IBF_fault_hours "FaultConfig # IBF_fault_hours (Fault Condition:Timeframe <=)" VALUE 0x001e6ddb /* @ECU_Address@IBF_fault_hours@0x01013AD8@ */ ECIPP_ALIGNMENT_UBYTE 255 Compu_IBF_fault_hours 0 255 /end CHARACTERISTIC
/begin COMPU_METHOD Compu_IBF_fault_hours " " RAT_FUNC "%.0" "hours" COEFFS 0 1 0 0 0 1 /end COMPU_METHOD
/begin CHARACTERISTIC MAP_addtl_flt_react "{MAP_addtl_flt_react&0xff=0x00:None}{MAP_addtl_flt_react&0x01=0x01:MAP higher than expected fault}{MAP_addtl_flt_react&0x02=0x02:MAP pegging reference out-of-range fault}{MAP_addtl_flt_react&0x03=0x03:Both faults}" VALUE 0x001e6de5 /* @ECU_Address@MAP_addtl_flt_react@0x01013AE0@ */ ECIPP_ALIGNMENT_UBYTE 255 MAP_addtl_flt_react_COMPU_VTAB 0 255 BIT_MASK 0xff /end CHARACTERISTIC
/begin COMPU_METHOD MAP_addtl_flt_react_COMPU_VTAB "Verbal Table" TAB_VERB "%.0" "list" COMPU_TAB_REF MAP_addtl_flt_react_COMPU_VTAB_REF /end COMPU_METHOD
/begin COMPU_VTAB MAP_addtl_flt_react_COMPU_VTAB_REF "Verbal Table" TAB_VERB 1 0x00 "None" DEFAULT_VALUE "Unsupported Bit_Mask" /end COMPU_VTAB
/begin CHARACTERISTIC RS_loss_PTO_stat "{RS_loss_PTO_stat&0xff=0x00:Ignored}{RS_loss_PTO_stat&0xff=0x01:Inactive} (Fault Condition:and PTO status is)" VALUE 0x001e6dfa /* @ECU_Address@RS_loss_PTO_stat@0x01013AE8@ */ ECIPP_ALIGNMENT_UBYTE 255 RS_loss_PTO_stat_COMPU_VTAB 0 255 BIT_MASK 0xff /end CHARACTERISTIC
/begin COMPU_METHOD RS_loss_PTO_stat_COMPU_VTAB "Verbal Table" TAB_VERB "%.0" "list" COMPU_TAB_REF RS_loss_PTO_stat_COMPU_VTAB_REF /end COMPU_METHOD
/begin COMPU_VTAB RS_loss_PTO_stat_COMPU_VTAB_REF "Verbal Table" TAB_VERB 2 0x00 "Ignored" 0x01 "Inactive" DEFAULT_VALUE "UNKNOWN" /end COMPU_VTAB
/begin CHARACTERISTIC fuellev_pct_def "IOConfig # fuellev_pct_def" VALUE 0x001c8456 /* @ECU_Address@fuellev_pct_def@0x01013BB8@ */ ECIPP_ALIGNMENT_UWORD 100 Compu_fuellev_pct_def 0 99.9984741210938 /end CHARACTERISTIC
/begin COMPU_METHOD Compu_fuellev_pct_def " " RAT_FUNC "%.3" "%" COEFFS 0 655.36 0 0 0 1 /end COMPU_METHOD
/begin CHARACTERISTIC TM_SG_crct_ena "{TM_SG_crct_ena&0xff=0:Disabled}{TM_SG_crct_ena&0xff=1:Enabled}" VALUE 0x001c8f3a /* @ECU_Address@TM_SG_crct_ena@0x01013C70@ */ ECIPP_ALIGNMENT_UBYTE 255 TM_SG_crct_ena_COMPU_VTAB 0 255 BIT_MASK 0xff /end CHARACTERISTIC
/begin COMPU_METHOD TM_SG_crct_ena_COMPU_VTAB "Verbal Table" TAB_VERB "%.0" "list" COMPU_TAB_REF TM_SG_crct_ena_COMPU_VTAB_REF /end COMPU_METHOD
/begin COMPU_VTAB TM_SG_crct_ena_COMPU_VTAB_REF "Verbal Table" TAB_VERB 2 0 "Disabled" 1 "Enabled" DEFAULT_VALUE "UNKNOWN" /end COMPU_VTAB
/begin CHARACTERISTIC ACT_ena "{ACT_ena&0xff=0:Disabled}{ACT_ena&0xff=1:Aux PU1}{ACT_ena&0xff=2:Aux PU2}{ACT_ena&0xff=3:Aux PU3}{ACT_ena&0xff=4:Aux PUD1}{ACT_ena&0xff=5:Aux PUD2}{ACT_ena&0xff=6:Aux PUD3}{ACT_ena&0xff=7:EGT Input}{ACT_ena&0xff=8:Aux PUD4}{ACT_ena&0xff=9:Aux PUD5}{ACT_en" VALUE 0x001c866a /* @ECU_Address@ACT_ena@0x01013D60@ */ ECIPP_ALIGNMENT_UBYTE 255 ACT_ena_COMPU_VTAB 0 255 BIT_MASK 0xff /end CHARACTERISTIC
/begin COMPU_METHOD ACT_ena_COMPU_VTAB "Verbal Table" TAB_VERB "%.0" "list" COMPU_TAB_REF ACT_ena_COMPU_VTAB_REF /end COMPU_METHOD
/begin COMPU_VTAB ACT_ena_COMPU_VTAB_REF "Verbal Table" TAB_VERB 31 0 "Disabled" 1 "Aux PU1" 2 "Aux PU2" 3 "Aux PU3" 4 "Aux PUD1" 5 "Aux PUD2" 6 "Aux PUD3" 7 "EGT Input" 8 "Aux PUD4" 9 "Aux PUD5" 10 "Aux PUD6" 11 "Aux PUD7" 12 "Aux PUD8" 13 "Aux PUD9" 14 "Aux PUD10" 15 "Aux PUD11" 16 "Aux PUD12" 17 "Aux PUD13" 18 "Aux PUD14" 19 "Aux PUD15" 20 "Aux PUD16" 21 "Aux PUD17" 22 "Aux PUD18" 23 "Aux PUD19" 24 "Aux PUD20" 25 "Aux PUD21" 26 "Aux PUD22" 27 "Aux PUD23" 28 "Aux PUD24" 29 "Aux PUD25" 30 "CAN sourced" DEFAULT_VALUE "UNKNOWN" /end COMPU_VTAB
/begin CHARACTERISTIC ACT_vdr "IOConfig # ACT_vdr" VALUE 0x001c3a58 /* @ECU_Address@ACT_vdr@0x01013D68@ */ ECIPP_ALIGNMENT_FLOAT32_IEEE 10000000000 Compu_ACT_vdr -10000000000 10000000000 /end CHARACTERISTIC
/begin COMPU_METHOD Compu_ACT_vdr " " RAT_FUNC "%.3" "ohms" COEFFS 0 1 0 0 0 1 /end COMPU_METHOD
/begin CHARACTERISTIC ACT_Taux_cal "{ACT_Taux_cal&0xff=0:Fuel source}{ACT_Taux_cal&0xff=1:Exhaust manifold/riser}{ACT_Taux_cal&0xff=2:Aux Temp A}{ACT_Taux_cal&0xff=3:Aux Temp B}{ACT_Taux_cal&0xff=4:Aux Temp C}{ACT_Taux_cal&0xff=5:Aux Temp D}" VALUE 0x001c8669 /* @ECU_Address@ACT_Taux_cal@0x01013D70@ */ ECIPP_ALIGNMENT_UBYTE 255 ACT_Taux_cal_COMPU_VTAB 0 255 BIT_MASK 0xff /end CHARACTERISTIC
/begin COMPU_METHOD ACT_Taux_cal_COMPU_VTAB "Verbal Table" TAB_VERB "%.0" "list" COMPU_TAB_REF ACT_Taux_cal_COMPU_VTAB_REF /end COMPU_METHOD
/begin COMPU_VTAB ACT_Taux_cal_COMPU_VTAB_REF "Verbal Table" TAB_VERB 6 0 "Fuel source" 1 "Exhaust manifold/riser" 2 "Aux Temp A" 3 "Aux Temp B" 4 "Aux Temp C" 5 "Aux Temp D" DEFAULT_VALUE "UNKNOWN" /end COMPU_VTAB
/begin CHARACTERISTIC EGRwrP_def "General # EGRwrP_def" VALUE 0x001c0a04 /* @ECU_Address@EGRwrP_def@0x01013DE0@ */ ECIPP_ALIGNMENT_UWORD 256 Compu_EGRwrP_def 0 255.99609375 /end CHARACTERISTIC
/begin COMPU_METHOD Compu_EGRwrP_def " " RAT_FUNC "%.3" "psia" COEFFS 0 256 0 0 0 1 /end COMPU_METHOD
/begin CHARACTERISTIC TIAT_def_sel "{TIAT_def_sel&0xff=0:COT}{TIAT_def_sel&0xff=1:IAT}" VALUE 0x001c8f31 /* @ECU_Address@TIAT_def_sel@0x01013F78@ */ ECIPP_ALIGNMENT_UBYTE 255 TIAT_def_sel_COMPU_VTAB 0 255 BIT_MASK 0xff /end CHARACTERISTIC
/begin COMPU_METHOD TIAT_def_sel_COMPU_VTAB "Verbal Table" TAB_VERB "%.0" "list" COMPU_TAB_REF TIAT_def_sel_COMPU_VTAB_REF /end COMPU_METHOD
/begin COMPU_VTAB TIAT_def_sel_COMPU_VTAB_REF "Verbal Table" TAB_VERB 2 0 "COT" 1 "IAT" DEFAULT_VALUE "UNKNOWN" /end COMPU_VTAB
/begin CHARACTERISTIC ICCOT_ena "{ICCOT_ena&0xff=0:Disabled}{ICCOT_ena&0xff=1:Aux PU1}{ICCOT_ena&0xff=2:Aux PU2}{ICCOT_ena&0xff=3:Aux PU3}{ICCOT_ena&0xff=4:Aux PUD1}{ICCOT_ena&0xff=5:Aux PUD2}{ICCOT_ena&0xff=6:Aux PUD3}{ICCOT_ena&0xff=7:EGT Input}{ICCOT_ena&0xff=8:Aux PUD4}{ICCOT_ena&0xf" VALUE 0x001c8780 /* @ECU_Address@ICCOT_ena@0x01013F98@ */ ECIPP_ALIGNMENT_UBYTE 255 ICCOT_ena_COMPU_VTAB 0 255 BIT_MASK 0xff /end CHARACTERISTIC
/begin COMPU_METHOD ICCOT_ena_COMPU_VTAB "Verbal Table" TAB_VERB "%.0" "list" COMPU_TAB_REF ICCOT_ena_COMPU_VTAB_REF /end COMPU_METHOD
/begin COMPU_VTAB ICCOT_ena_COMPU_VTAB_REF "Verbal Table" TAB_VERB 31 0 "Disabled" 1 "Aux PU1" 2 "Aux PU2" 3 "Aux PU3" 4 "Aux PUD1" 5 "Aux PUD2" 6 "Aux PUD3" 7 "EGT Input" 8 "Aux PUD4" 9 "Aux PUD5" 10 "Aux PUD6" 11 "Aux PUD7" 12 "Aux PUD8" 13 "Aux PUD9" 14 "Aux PUD10" 15 "Aux PUD11" 16 "Aux PUD12" 17 "Aux PUD13" 18 "Aux PUD14" 19 "Aux PUD15" 20 "Aux PUD16" 21 "Aux PUD17" 22 "Aux PUD18" 23 "Aux PUD19" 24 "Aux PUD20" 25 "Aux PUD21" 26 "Aux PUD22" 27 "Aux PUD23" 28 "Aux PUD24" 29 "Aux PUD25" 30 "CAN sourced" DEFAULT_VALUE "UNKNOWN" /end COMPU_VTAB
/begin CHARACTERISTIC ICCOT_vdr "IOConfig # ICCOT_vdr" VALUE 0x001c3ad4 /* @ECU_Address@ICCOT_vdr@0x01013FA0@ */ ECIPP_ALIGNMENT_FLOAT32_IEEE 10000000000 Compu_ICCOT_vdr -10000000000 10000000000 /end CHARACTERISTIC
/begin COMPU_METHOD Compu_ICCOT_vdr " " RAT_FUNC "%.3" "ohms" COEFFS 0 1 0 0 0 1 /end COMPU_METHOD
/begin CHARACTERISTIC ICCOT_Taux_cal "{ICCOT_Taux_cal&0xff=0:Fuel source}{ICCOT_Taux_cal&0xff=1:Exhaust manifold/riser}{ICCOT_Taux_cal&0xff=2:Aux Temp A}{ICCOT_Taux_cal&0xff=3:Aux Temp B}{ICCOT_Taux_cal&0xff=4:Aux Temp C}{ICCOT_Taux_cal&0xff=5:Aux Temp D}" VALUE 0x001c877f /* @ECU_Address@ICCOT_Taux_cal@0x01013FA8@ */ ECIPP_ALIGNMENT_UBYTE 255 ICCOT_Taux_cal_COMPU_VTAB 0 255 BIT_MASK 0xff /end CHARACTERISTIC
/begin COMPU_METHOD ICCOT_Taux_cal_COMPU_VTAB "Verbal Table" TAB_VERB "%.0" "list" COMPU_TAB_REF ICCOT_Taux_cal_COMPU_VTAB_REF /end COMPU_METHOD
/begin COMPU_VTAB ICCOT_Taux_cal_COMPU_VTAB_REF "Verbal Table" TAB_VERB 6 0 "Fuel source" 1 "Exhaust manifold/riser" 2 "Aux Temp A" 3 "Aux Temp B" 4 "Aux Temp C" 5 "Aux Temp D" DEFAULT_VALUE "UNKNOWN" /end COMPU_VTAB
/begin MEASUREMENT ACLT_intTlim_crct "Flow correction" FLOAT32_IEEE Compu_ACLT_intTlim_crct 0 0 -10000000000 10000000000 ECU_ADDRESS 0x01014018 /end MEASUREMENT
/begin COMPU_METHOD Compu_ACLT_intTlim_crct " " RAT_FUNC "%.3" "%" COEFFS 0 0.01 0 0 0 1 /end COMPU_METHOD
/begin CHARACTERISTIC ACLT_intTlim_crctini "General # ACLT_intTlim_crctini" VALUE 0x001e36e2 /* @ECU_Address@ACLT_intTlim_crctini@0x01014020@ */ ECIPP_ALIGNMENT_UWORD 6400 Compu_ACLT_intTlim_crctini 0 6399.90234375 /end CHARACTERISTIC
/begin COMPU_METHOD Compu_ACLT_intTlim_crctini " " RAT_FUNC "%.3" "%" COEFFS 0 10.24 0 0 0 1 /end COMPU_METHOD
/begin CHARACTERISTIC EGR_clr_eta_mdot "Air # EGR_clr_eta_mdot (Fault Condition:EGR flow >)" VALUE 0x001c0282 /* @ECU_Address@EGR_clr_eta_mdot@0x01014098@ */ ECIPP_ALIGNMENT_SWORD 512 Compu_EGR_clr_eta_mdot -512 511.984375 /end CHARACTERISTIC
/begin COMPU_METHOD Compu_EGR_clr_eta_mdot " " RAT_FUNC "%.3" "g/sec" COEFFS 0 64 0 0 0 1 /end COMPU_METHOD
/begin CHARACTERISTIC EGR_clr_eta_mdot_wt "Air # EGR_clr_eta_mdot_wt (Fault Condition:for at least)" VALUE 0x001c0992 /* @ECU_Address@EGR_clr_eta_mdot_wt@0x010140A0@ */ ECIPP_ALIGNMENT_UWORD 66 Compu_EGR_clr_eta_mdot_wt 0 65.535 /end CHARACTERISTIC
/begin COMPU_METHOD Compu_EGR_clr_eta_mdot_wt " " RAT_FUNC "%.3" "seconds" COEFFS 0 1000 0 0 0 1 /end COMPU_METHOD
/begin CHARACTERISTIC EGRT_hi_mdot "Air # EGRT_hi_mdot (Fault Condition:and EGR flow >)" VALUE 0x001c0274 /* @ECU_Address@EGRT_hi_mdot@0x010140A8@ */ ECIPP_ALIGNMENT_SWORD 512 Compu_EGRT_hi_mdot -512 511.984375 /end CHARACTERISTIC
/begin COMPU_METHOD Compu_EGRT_hi_mdot " " RAT_FUNC "%.3" "g/sec" COEFFS 0 64 0 0 0 1 /end COMPU_METHOD
/begin CHARACTERISTIC EGRT_hi_mdot_wt "Air # EGRT_hi_mdot_wt (Fault Condition:for at least)" VALUE 0x001c095e /* @ECU_Address@EGRT_hi_mdot_wt@0x010140B0@ */ ECIPP_ALIGNMENT_UWORD 66 Compu_EGRT_hi_mdot_wt 0 65.535 /end CHARACTERISTIC
/begin COMPU_METHOD Compu_EGRT_hi_mdot_wt " " RAT_FUNC "%.3" "seconds" COEFFS 0 1000 0 0 0 1 /end COMPU_METHOD
/begin CHARACTERISTIC ACT_hi_Tmax "FaultConfig # ACT_hi_Tmax (Fault Condition:ACT >)" VALUE 0x001c6d52 /* @ECU_Address@ACT_hi_Tmax@0x010140B8@ */ ECIPP_ALIGNMENT_UWORD 564 Compu_ACT_hi_Tmax -460 563.984375 /end CHARACTERISTIC
/begin COMPU_METHOD Compu_ACT_hi_Tmax " " RAT_FUNC "%.3" "deg F" COEFFS 0 64 29440 0 0 1 /end COMPU_METHOD
/begin CHARACTERISTIC ACT_hi_RPMmin "FaultConfig # ACT_hi_RPMmin (Fault Condition:and engine speed >)" VALUE 0x001c6d50 /* @ECU_Address@ACT_hi_RPMmin@0x010140C0@ */ ECIPP_ALIGNMENT_UWORD 65535 Compu_ACT_hi_RPMmin 0 65535 /end CHARACTERISTIC
/begin COMPU_METHOD Compu_ACT_hi_RPMmin " " RAT_FUNC "%.0" "rpm" COEFFS 0 1 0 0 0 1 /end COMPU_METHOD
/begin CHARACTERISTIC ACT_hi_wait "FaultConfig # ACT_hi_wait (Fault Condition:and run-time >)" VALUE 0x001c4250 /* @ECU_Address@ACT_hi_wait@0x010140C8@ */ ECIPP_ALIGNMENT_ULONG 4294967 Compu_ACT_hi_wait 0 4294967.295 /end CHARACTERISTIC
/begin COMPU_METHOD Compu_ACT_hi_wait " " RAT_FUNC "%.3" "seconds" COEFFS 0 1000 0 0 0 1 /end COMPU_METHOD
/begin CHARACTERISTIC ICCOT_hi_Tmax "FaultConfig # ICCOT_hi_Tmax (Fault Condition:ICCOT >)" VALUE 0x001c7c4e /* @ECU_Address@ICCOT_hi_Tmax@0x010140D0@ */ ECIPP_ALIGNMENT_UWORD 564 Compu_ICCOT_hi_Tmax -460 563.984375 /end CHARACTERISTIC
/begin COMPU_METHOD Compu_ICCOT_hi_Tmax " " RAT_FUNC "%.3" "deg F" COEFFS 0 64 29440 0 0 1 /end COMPU_METHOD
/begin CHARACTERISTIC ICCOT_hi_RPMmin "FaultConfig # ICCOT_hi_RPMmin (Fault Condition:and engine speed >)" VALUE 0x001c7c4c /* @ECU_Address@ICCOT_hi_RPMmin@0x010140D8@ */ ECIPP_ALIGNMENT_UWORD 65535 Compu_ICCOT_hi_RPMmin 0 65535 /end CHARACTERISTIC
/begin COMPU_METHOD Compu_ICCOT_hi_RPMmin " " RAT_FUNC "%.0" "rpm" COEFFS 0 1 0 0 0 1 /end COMPU_METHOD
/begin CHARACTERISTIC ICCOT_hi_wait "FaultConfig # ICCOT_hi_wait (Fault Condition:and run-time >)" VALUE 0x001c42b8 /* @ECU_Address@ICCOT_hi_wait@0x010140E0@ */ ECIPP_ALIGNMENT_ULONG 4294967 Compu_ICCOT_hi_wait 0 4294967.295 /end CHARACTERISTIC
/begin COMPU_METHOD Compu_ICCOT_hi_wait " " RAT_FUNC "%.3" "seconds" COEFFS 0 1000 0 0 0 1 /end COMPU_METHOD
/begin CHARACTERISTIC ACLT_intTlim_OOA_dT "FaultConfig # ACLT_intTlim_OOA_dT (Fault Condition:and projected outlet temperature > limit +)" VALUE 0x001c0942 /* @ECU_Address@ACLT_intTlim_OOA_dT@0x010140E8@ */ ECIPP_ALIGNMENT_UWORD 564 Compu_ACLT_intTlim_OOA_dT -460 563.984375 /end CHARACTERISTIC
/begin COMPU_METHOD Compu_ACLT_intTlim_OOA_dT " " RAT_FUNC "%.3" "deg F" COEFFS 0 64 29440 0 0 1 /end COMPU_METHOD
/begin CHARACTERISTIC EGRdP_lo_rev_mdot "FaultConfig # EGRdP_lo_rev_mdot (Fault Condition:EGR flow command >)" VALUE 0x001c09ea /* @ECU_Address@EGRdP_lo_rev_mdot@0x010140F0@ */ ECIPP_ALIGNMENT_UWORD 1024 Compu_EGRdP_lo_rev_mdot 0 1023.984375 /end CHARACTERISTIC
/begin COMPU_METHOD Compu_EGRdP_lo_rev_mdot " " RAT_FUNC "%.3" "g/sec" COEFFS 0 64 0 0 0 1 /end COMPU_METHOD
/begin CHARACTERISTIC EGRdP_lo_rev_err "FaultConfig # EGRdP_lo_rev_err (Fault Condition:and target dP - actual dP >)" VALUE 0x001c02b2 /* @ECU_Address@EGRdP_lo_rev_err@0x010140F8@ */ ECIPP_ALIGNMENT_SWORD 128 Compu_EGRdP_lo_rev_err -128 127.99609375 /end CHARACTERISTIC
/begin COMPU_METHOD Compu_EGRdP_lo_rev_err " " RAT_FUNC "%.3" "psi" COEFFS 0 256 0 0 0 1 /end COMPU_METHOD
/begin CHARACTERISTIC EGRdP_lo_rev_dP "FaultConfig # EGRdP_lo_rev_dP (Fault Condition:and EGR valve dP <)" VALUE 0x001c02b0 /* @ECU_Address@EGRdP_lo_rev_dP@0x01014100@ */ ECIPP_ALIGNMENT_SWORD 128 Compu_EGRdP_lo_rev_dP -128 127.99609375 /end CHARACTERISTIC
/begin COMPU_METHOD Compu_EGRdP_lo_rev_dP " " RAT_FUNC "%.3" "psi" COEFFS 0 256 0 0 0 1 /end COMPU_METHOD
/begin CHARACTERISTIC EGRdP_lo_LP_mdot "FaultConfig # EGRdP_lo_LP_mdot (Fault Condition:EGR flow command >)" VALUE 0x001c09e8 /* @ECU_Address@EGRdP_lo_LP_mdot@0x01014108@ */ ECIPP_ALIGNMENT_UWORD 1024 Compu_EGRdP_lo_LP_mdot 0 1023.984375 /end CHARACTERISTIC
/begin COMPU_METHOD Compu_EGRdP_lo_LP_mdot " " RAT_FUNC "%.3" "g/sec" COEFFS 0 64 0 0 0 1 /end COMPU_METHOD
/begin CHARACTERISTIC EGRdP_lo_LP_err "FaultConfig # EGRdP_lo_LP_err (Fault Condition:and target dP - actual dP >)" VALUE 0x001c02ae /* @ECU_Address@EGRdP_lo_LP_err@0x01014110@ */ ECIPP_ALIGNMENT_SWORD 128 Compu_EGRdP_lo_LP_err -128 127.99609375 /end CHARACTERISTIC
/begin COMPU_METHOD Compu_EGRdP_lo_LP_err " " RAT_FUNC "%.3" "psi" COEFFS 0 256 0 0 0 1 /end COMPU_METHOD
/begin CHARACTERISTIC EGRdP_lo_LP_dP "FaultConfig # EGRdP_lo_LP_dP (Fault Condition:and abs(EGR valve dP) <)" VALUE 0x001c02ac /* @ECU_Address@EGRdP_lo_LP_dP@0x01014118@ */ ECIPP_ALIGNMENT_SWORD 128 Compu_EGRdP_lo_LP_dP -128 127.99609375 /end CHARACTERISTIC
/begin COMPU_METHOD Compu_EGRdP_lo_LP_dP " " RAT_FUNC "%.3" "psi" COEFFS 0 256 0 0 0 1 /end COMPU_METHOD
/begin CHARACTERISTIC EGRdP_lo_LP_dBP "FaultConfig # EGRdP_lo_LP_dBP (Fault Condition:and EGRLP < BP -)" VALUE 0x001c02aa /* @ECU_Address@EGRdP_lo_LP_dBP@0x01014120@ */ ECIPP_ALIGNMENT_SWORD 128 Compu_EGRdP_lo_LP_dBP -128 127.99609375 /end CHARACTERISTIC
/begin COMPU_METHOD Compu_EGRdP_lo_LP_dBP " " RAT_FUNC "%.3" "psi" COEFFS 0 256 0 0 0 1 /end COMPU_METHOD
/begin CHARACTERISTIC EGR_vlv_HP_pcterr "FaultConfig # EGR_vlv_HP_pcterr (Fault Condition:and abs(EGR modeled flow - actual flow) >)" VALUE 0x001c09c6 /* @ECU_Address@EGR_vlv_HP_pcterr@0x01014128@ */ ECIPP_ALIGNMENT_UWORD 400 Compu_EGR_vlv_HP_pcterr 0 399.993896484375 /end CHARACTERISTIC
/begin COMPU_METHOD Compu_EGR_vlv_HP_pcterr " " RAT_FUNC "%.3" "%" COEFFS 0 163.84 0 0 0 1 /end COMPU_METHOD
/begin CHARACTERISTIC EGR_vlv_HP_mdot "FaultConfig # EGR_vlv_HP_mdot (Fault Condition:EGR flow command >)" VALUE 0x001c09c4 /* @ECU_Address@EGR_vlv_HP_mdot@0x01014130@ */ ECIPP_ALIGNMENT_UWORD 1024 Compu_EGR_vlv_HP_mdot 0 1023.984375 /end CHARACTERISTIC
/begin COMPU_METHOD Compu_EGR_vlv_HP_mdot " " RAT_FUNC "%.3" "g/sec" COEFFS 0 64 0 0 0 1 /end COMPU_METHOD
/begin CHARACTERISTIC intby_poserr_err "FaultConfig # intby_poserr_err (Fault Condition:abs(target position - actual position) >)" VALUE 0x001c8488 /* @ECU_Address@intby_poserr_err@0x01014140@ */ ECIPP_ALIGNMENT_UWORD 200 Compu_intby_poserr_err 0 199.996948242188 /end CHARACTERISTIC
/begin COMPU_METHOD Compu_intby_poserr_err " " RAT_FUNC "%.3" "%" COEFFS 0 327.68 0 0 0 1 /end COMPU_METHOD
/begin CHARACTERISTIC intby_poserr_wait "FaultConfig # intby_poserr_wait (Fault Condition:persistently longer than)" VALUE 0x001c848c /* @ECU_Address@intby_poserr_wait@0x01014148@ */ ECIPP_ALIGNMENT_UWORD 65535 Compu_intby_poserr_wait 0 65535 /end CHARACTERISTIC
/begin COMPU_METHOD Compu_intby_poserr_wait " " RAT_FUNC "%.0" "ms" COEFFS 0 1 0 0 0 1 /end COMPU_METHOD
/begin CHARACTERISTIC intby_poserr_minVbat "FaultConfig # intby_poserr_minVbat (Fault Condition:while battery voltage >)" VALUE 0x001c848a /* @ECU_Address@intby_poserr_minVbat@0x01014150@ */ ECIPP_ALIGNMENT_UWORD 256 Compu_intby_poserr_minVbat 0 255.99609375 /end CHARACTERISTIC
/begin COMPU_METHOD Compu_intby_poserr_minVbat " " RAT_FUNC "%.3" "volts" COEFFS 0 256 0 0 0 1 /end COMPU_METHOD
/begin CHARACTERISTIC radby_poserr_err "FaultConfig # radby_poserr_err (Fault Condition:abs(target position - actual position) >)" VALUE 0x001c84b2 /* @ECU_Address@radby_poserr_err@0x01014158@ */ ECIPP_ALIGNMENT_UWORD 200 Compu_radby_poserr_err 0 199.996948242188 /end CHARACTERISTIC
/begin COMPU_METHOD Compu_radby_poserr_err " " RAT_FUNC "%.3" "%" COEFFS 0 327.68 0 0 0 1 /end COMPU_METHOD
/begin CHARACTERISTIC radby_poserr_wait "FaultConfig # radby_poserr_wait (Fault Condition:persistently longer than)" VALUE 0x001c84b6 /* @ECU_Address@radby_poserr_wait@0x01014160@ */ ECIPP_ALIGNMENT_UWORD 65535 Compu_radby_poserr_wait 0 65535 /end CHARACTERISTIC
/begin COMPU_METHOD Compu_radby_poserr_wait " " RAT_FUNC "%.0" "ms" COEFFS 0 1 0 0 0 1 /end COMPU_METHOD
/begin CHARACTERISTIC radby_poserr_minVbat "FaultConfig # radby_poserr_minVbat (Fault Condition:while battery voltage >)" VALUE 0x001c84b4 /* @ECU_Address@radby_poserr_minVbat@0x01014168@ */ ECIPP_ALIGNMENT_UWORD 256 Compu_radby_poserr_minVbat 0 255.99609375 /end CHARACTERISTIC
/begin COMPU_METHOD Compu_radby_poserr_minVbat " " RAT_FUNC "%.3" "volts" COEFFS 0 256 0 0 0 1 /end COMPU_METHOD
/begin CHARACTERISTIC BP_LPEGR_tau "Air # BP_LPEGR_tau" VALUE 0x001c0a7e /* @ECU_Address@BP_LPEGR_tau@0x01014200@ */ ECIPP_ALIGNMENT_UWORD 328 Compu_BP_LPEGR_tau 0.00045084 327.68 /end CHARACTERISTIC
/begin COMPU_METHOD Compu_BP_LPEGR_tau " " FORM "%.3" "sec"
 /begin FORMULA "-0.005 / log(1 - (X1 / 65536))" FORMULA_INV "(1 - exp(-0.005/X1)) * 65536" /end FORMULA
/end COMPU_METHOD
/begin CHARACTERISTIC Min_KV "General # Min_KV" VALUE 0x001ecee6 /* @ECU_Address@Min_KV@0x010145F0@ */ ECIPP_ALIGNMENT_UWORD 66 Compu_Min_KV 0 65.535 /end CHARACTERISTIC
/begin COMPU_METHOD Compu_Min_KV " " RAT_FUNC "%.3" "KV" COEFFS 0 1000 0 0 0 1 /end COMPU_METHOD
/begin CHARACTERISTIC KV_diag_tau "General # KV_diag_tau" VALUE 0x001ecf0a /* @ECU_Address@KV_diag_tau@0x010145F8@ */ ECIPP_ALIGNMENT_UWORD 3276795 Compu_KV_diag_tau 4.5084 3276800 /end CHARACTERISTIC
/begin COMPU_METHOD Compu_KV_diag_tau " " FORM "%.3" "ms"
 /begin FORMULA "-50 / log(1 - (X1 / 65536))" FORMULA_INV "(1 - exp(-50/X1)) * 65536" /end FORMULA
/end COMPU_METHOD
/begin CHARACTERISTIC KV_MFskip "General # KV_MFskip" VALUE 0x001ecdb2 /* @ECU_Address@KV_MFskip@0x01014600@ */ ECIPP_ALIGNMENT_SWORD 66 Compu_KV_MFskip -65.536 65.534 /end CHARACTERISTIC
/begin COMPU_METHOD Compu_KV_MFskip " " RAT_FUNC "%.3" "KV" COEFFS 0 500 0 0 0 1 /end COMPU_METHOD
/begin CHARACTERISTIC SparkKV_deltaHi "General # SparkKV_deltaHi" VALUE 0x001eceee /* @ECU_Address@SparkKV_deltaHi@0x01014610@ */ ECIPP_ALIGNMENT_UWORD 66 Compu_SparkKV_deltaHi 0 65.535 /end CHARACTERISTIC
/begin COMPU_METHOD Compu_SparkKV_deltaHi " " RAT_FUNC "%.3" "KV" COEFFS 0 1000 0 0 0 1 /end COMPU_METHOD
/begin CHARACTERISTIC SparkKV_deltaLo "General # SparkKV_deltaLo" VALUE 0x001ecef0 /* @ECU_Address@SparkKV_deltaLo@0x01014618@ */ ECIPP_ALIGNMENT_UWORD 66 Compu_SparkKV_deltaLo 0 65.535 /end CHARACTERISTIC
/begin COMPU_METHOD Compu_SparkKV_deltaLo " " RAT_FUNC "%.3" "KV" COEFFS 0 1000 0 0 0 1 /end COMPU_METHOD
/begin CHARACTERISTIC module_load_CD "General # module_load_CD" VALUE 0x001ecca1 /* @ECU_Address@module_load_CD@0x01014640@ */ ECIPP_ALIGNMENT_UBYTE 255 Compu_module_load_CD 0 255 /end CHARACTERISTIC
/begin COMPU_METHOD Compu_module_load_CD " " RAT_FUNC "%.0" "-" COEFFS 0 1 0 0 0 1 /end COMPU_METHOD
/begin CHARACTERISTIC WGPerr_delta_pos "FaultConfig # WGPerr_delta_pos (Fault Condition:and abs(target WGP - actual WGP) >=)" VALUE 0x001c838e /* @ECU_Address@WGPerr_delta_pos@0x010148D8@ */ ECIPP_ALIGNMENT_UWORD 256 Compu_WGPerr_delta_pos 0 255.99609375 /end CHARACTERISTIC
/begin COMPU_METHOD Compu_WGPerr_delta_pos " " RAT_FUNC "%.3" "psi" COEFFS 0 256 0 0 0 1 /end COMPU_METHOD
/begin MEASUREMENT SD_trigger_ndx_slv "General # SD_trigger_ndx_slv" UWORD Compu_SD_trigger_ndx_slv 0 0 0 65535 ECU_ADDRESS 0x01014908 /end MEASUREMENT
/begin COMPU_METHOD Compu_SD_trigger_ndx_slv " " RAT_FUNC "%.0" "-" COEFFS 0 1 0 0 0 1 /end COMPU_METHOD
/begin MEASUREMENT SD_trigger_ndx_mstr "General # SD_trigger_ndx_mstr" UWORD Compu_SD_trigger_ndx_mstr 0 0 0 65535 ECU_ADDRESS 0x01014910 /end MEASUREMENT
/begin COMPU_METHOD Compu_SD_trigger_ndx_mstr " " RAT_FUNC "%.0" "-" COEFFS 0 1 0 0 0 1 /end COMPU_METHOD
/begin CHARACTERISTIC Inj11_bank "{Inj11_bank&0xff=0:Disabled}{Inj11_bank&0xff=1:Bank 1}{Inj11_bank&0xff=2:Bank 2}" VALUE 0x001C9060 /* @ECU_Address@Inj11_bank@0x01014B40@ */ ECIPP_ALIGNMENT_UBYTE 255 Inj11_bank_COMPU_VTAB 0 255 BIT_MASK 0xff /end CHARACTERISTIC
/begin COMPU_METHOD Inj11_bank_COMPU_VTAB "Verbal Table" TAB_VERB "%.0" "list" COMPU_TAB_REF Inj11_bank_COMPU_VTAB_REF /end COMPU_METHOD
/begin COMPU_VTAB Inj11_bank_COMPU_VTAB_REF "Verbal Table" TAB_VERB 3 0 "Disabled" 1 "Bank 1" 2 "Bank 2" DEFAULT_VALUE "UNKNOWN" /end COMPU_VTAB
/begin CHARACTERISTIC Inj12_bank "{Inj12_bank&0xff=0:Disabled}{Inj12_bank&0xff=1:Bank 1}{Inj12_bank&0xff=2:Bank 2}" VALUE 0x001C9061 /* @ECU_Address@Inj12_bank@0x01014B48@ */ ECIPP_ALIGNMENT_UBYTE 255 Inj12_bank_COMPU_VTAB 0 255 BIT_MASK 0xff /end CHARACTERISTIC
/begin COMPU_METHOD Inj12_bank_COMPU_VTAB "Verbal Table" TAB_VERB "%.0" "list" COMPU_TAB_REF Inj12_bank_COMPU_VTAB_REF /end COMPU_METHOD
/begin COMPU_VTAB Inj12_bank_COMPU_VTAB_REF "Verbal Table" TAB_VERB 3 0 "Disabled" 1 "Bank 1" 2 "Bank 2" DEFAULT_VALUE "UNKNOWN" /end COMPU_VTAB
/begin CHARACTERISTIC XEGOH_short_update "{XEGOH_short_update&0xff=0:Conditional (Legacy)}{XEGOH_short_update&0xff=1:Unconditional}" VALUE 0x001c8f96 /* @ECU_Address@XEGOH_short_update@0x01014C38@ */ ECIPP_ALIGNMENT_UBYTE 255 XEGOH_short_update_COMPU_VTAB 0 255 BIT_MASK 0xff /end CHARACTERISTIC
/begin COMPU_METHOD XEGOH_short_update_COMPU_VTAB "Verbal Table" TAB_VERB "%.0" "list" COMPU_TAB_REF XEGOH_short_update_COMPU_VTAB_REF /end COMPU_METHOD
/begin COMPU_VTAB XEGOH_short_update_COMPU_VTAB_REF "Verbal Table" TAB_VERB 2 0 "Conditional (Legacy)" 1 "Unconditional" DEFAULT_VALUE "UNKNOWN" /end COMPU_VTAB
/begin CHARACTERISTIC FRO_ESD_ena "{FRO_ESD_ena&0xff=0:Disabled}{FRO_ESD_ena&0xff=1:Enabled}" VALUE 0x001ecf10 /* @ECU_Address@FRO_ESD_ena@0x01014D20@ */ ECIPP_ALIGNMENT_UBYTE 255 FRO_ESD_ena_COMPU_VTAB 0 255 BIT_MASK 0xff /end CHARACTERISTIC
/begin COMPU_METHOD FRO_ESD_ena_COMPU_VTAB "Verbal Table" TAB_VERB "%.0" "list" COMPU_TAB_REF FRO_ESD_ena_COMPU_VTAB_REF /end COMPU_METHOD
/begin COMPU_VTAB FRO_ESD_ena_COMPU_VTAB_REF "Verbal Table" TAB_VERB 2 0 "Disabled" 1 "Enabled" DEFAULT_VALUE "UNKNOWN" /end COMPU_VTAB
/begin CHARACTERISTIC FRO_IGN_DIS_ena "{FRO_IGN_DIS_ena&0xff=0:Disabled}{FRO_IGN_DIS_ena&0xff=1:Enabled}" VALUE 0x001ecf11 /* @ECU_Address@FRO_IGN_DIS_ena@0x01014D28@ */ ECIPP_ALIGNMENT_UBYTE 255 FRO_IGN_DIS_ena_COMPU_VTAB 0 255 BIT_MASK 0xff /end CHARACTERISTIC
/begin COMPU_METHOD FRO_IGN_DIS_ena_COMPU_VTAB "Verbal Table" TAB_VERB "%.0" "list" COMPU_TAB_REF FRO_IGN_DIS_ena_COMPU_VTAB_REF /end COMPU_METHOD
/begin COMPU_VTAB FRO_IGN_DIS_ena_COMPU_VTAB_REF "Verbal Table" TAB_VERB 2 0 "Disabled" 1 "Enabled" DEFAULT_VALUE "UNKNOWN" /end COMPU_VTAB
/begin CHARACTERISTIC fm_induce_l3_ll_pre "{fm_induce_l3_ll_pre&0xff=0:Disabled}{fm_induce_l3_ll_pre&0xff=1:Enabled - Before RS Limit}{fm_induce_l3_ll_pre&0xff=2:Enabled - Always}" VALUE 0x001c9029 /* @ECU_Address@fm_induce_l3_ll_pre@0x01014E28@ */ ECIPP_ALIGNMENT_UBYTE 255 fm_induce_l3_ll_pre_COMPU_VTAB 0 255 BIT_MASK 0xff /end CHARACTERISTIC
/begin COMPU_METHOD fm_induce_l3_ll_pre_COMPU_VTAB "Verbal Table" TAB_VERB "%.0" "list" COMPU_TAB_REF fm_induce_l3_ll_pre_COMPU_VTAB_REF /end COMPU_METHOD
/begin COMPU_VTAB fm_induce_l3_ll_pre_COMPU_VTAB_REF "Verbal Table" TAB_VERB 3 0 "Disabled" 1 "Enabled - Before RS Limit" 2 "Enabled - Always" DEFAULT_VALUE "UNKNOWN" /end COMPU_VTAB
/begin CHARACTERISTIC fm_induce_l3_ll_flt "{fm_induce_l3_ll_flt&0xff=0:Disabled}{fm_induce_l3_ll_flt&0xff=1:Table 1 / Gasoline Load-Limit}{fm_induce_l3_ll_flt&0xff=2:Table 2 / LPG Load-Limit}{fm_induce_l3_ll_flt&0xff=3:Table 3 / NG Load-Limit}{fm_induce_l3_ll_flt&0xff=4:Table 4 / Power Load-Limit}" VALUE 0x001c9028 /* @ECU_Address@fm_induce_l3_ll_flt@0x01014E30@ */ ECIPP_ALIGNMENT_UBYTE 255 fm_induce_l3_ll_flt_COMPU_VTAB 0 255 BIT_MASK 0xff /end CHARACTERISTIC
/begin COMPU_METHOD fm_induce_l3_ll_flt_COMPU_VTAB "Verbal Table" TAB_VERB "%.0" "list" COMPU_TAB_REF fm_induce_l3_ll_flt_COMPU_VTAB_REF /end COMPU_METHOD
/begin COMPU_VTAB fm_induce_l3_ll_flt_COMPU_VTAB_REF "Verbal Table" TAB_VERB 9 0 "Disabled" 1 "Table 1 / Gasoline Load-Limit" 2 "Table 2 / LPG Load-Limit" 3 "Table 3 / NG Load-Limit" 4 "Table 4 / Power Load-Limit" 5 "Table 5" 6 "Table 6" 7 "Table 7" 8 "Table 8" DEFAULT_VALUE "UNKNOWN" /end COMPU_VTAB
/begin CHARACTERISTIC camloss_pulse_cnt "{camloss_pulse_cnt&0xff=0:Legacy}{camloss_pulse_cnt&0xff=1:Exact} (Fault Condition:Pulse counting)" VALUE 0x001ecc7f /* @ECU_Address@camloss_pulse_cnt@0x010150D8@ */ ECIPP_ALIGNMENT_UBYTE 255 camloss_pulse_cnt_COMPU_VTAB 0 255 BIT_MASK 0xff /end CHARACTERISTIC
/begin COMPU_METHOD camloss_pulse_cnt_COMPU_VTAB "Verbal Table" TAB_VERB "%.0" "list" COMPU_TAB_REF camloss_pulse_cnt_COMPU_VTAB_REF /end COMPU_METHOD
/begin COMPU_VTAB camloss_pulse_cnt_COMPU_VTAB_REF "Verbal Table" TAB_VERB 2 0 "Legacy" 1 "Exact" DEFAULT_VALUE "UNKNOWN" /end COMPU_VTAB
/begin CHARACTERISTIC CM_post_delt_phi_hi "FaultConfig # CM_post_delt_phi_hi (Fault Condition:post-cat delta-phi >= delta-phi max -)" VALUE 0x001c6e3a /* @ECU_Address@CM_post_delt_phi_hi@0x01015110@ */ ECIPP_ALIGNMENT_UWORD 4 Compu_CM_post_delt_phi_hi 0 3.99993896484375 /end CHARACTERISTIC
/begin COMPU_METHOD Compu_CM_post_delt_phi_hi " " RAT_FUNC "%.3" "phi" COEFFS 0 16384 0 0 0 1 /end COMPU_METHOD
/begin CHARACTERISTIC CM_post_delt_phi_lo "FaultConfig # CM_post_delt_phi_lo (Fault Condition:post-cat delta-phi <= delta-phi min +)" VALUE 0x001c6e3c /* @ECU_Address@CM_post_delt_phi_lo@0x01015118@ */ ECIPP_ALIGNMENT_UWORD 4 Compu_CM_post_delt_phi_lo 0 3.99993896484375 /end CHARACTERISTIC
/begin COMPU_METHOD Compu_CM_post_delt_phi_lo " " RAT_FUNC "%.3" "phi" COEFFS 0 16384 0 0 0 1 /end COMPU_METHOD
/begin CHARACTERISTIC CM_post_delt_CBT "FaultConfig # CM_post_delt_CBT (Fault Condition:and CBT >)" VALUE 0x001c6e36 /* @ECU_Address@CM_post_delt_CBT@0x01015120@ */ ECIPP_ALIGNMENT_UWORD 7732 Compu_CM_post_delt_CBT -460 7731.875 /end CHARACTERISTIC
/begin COMPU_METHOD Compu_CM_post_delt_CBT " " RAT_FUNC "%.3" "deg F" COEFFS 0 8 3680 0 0 1 /end COMPU_METHOD
/begin CHARACTERISTIC CM_post_delt_mdot "FaultConfig # CM_post_delt_mdot (Fault Condition:and catalyst exhaust mass flow >)" VALUE 0x001c6e38 /* @ECU_Address@CM_post_delt_mdot@0x01015128@ */ ECIPP_ALIGNMENT_UWORD 1024 Compu_CM_post_delt_mdot 0 1023.984375 /end CHARACTERISTIC
/begin COMPU_METHOD Compu_CM_post_delt_mdot " " RAT_FUNC "%.3" "g/sec" COEFFS 0 64 0 0 0 1 /end COMPU_METHOD
/begin CHARACTERISTIC RPM_stat_reset_key "General # RPM_stat_reset_key" VALUE 0x001c7eb0 /* @ECU_Address@RPM_stat_reset_key@0x01015140@ */ ECIPP_ALIGNMENT_UWORD 65535 Compu_RPM_stat_reset_key 0 65535 /end CHARACTERISTIC
/begin COMPU_METHOD Compu_RPM_stat_reset_key " " RAT_FUNC "%.0" "-" COEFFS 0 1 0 0 0 1 /end COMPU_METHOD
/begin CHARACTERISTIC OILT_stat_reset_key "General # OILT_stat_reset_key" VALUE 0x001c7e16 /* @ECU_Address@OILT_stat_reset_key@0x01015170@ */ ECIPP_ALIGNMENT_UWORD 65535 Compu_OILT_stat_reset_key 0 65535 /end CHARACTERISTIC
/begin COMPU_METHOD Compu_OILT_stat_reset_key " " RAT_FUNC "%.0" "-" COEFFS 0 1 0 0 0 1 /end COMPU_METHOD
/begin CHARACTERISTIC OILP_stat_reset_key "General # OILP_stat_reset_key" VALUE 0x001c7e08 /* @ECU_Address@OILP_stat_reset_key@0x010151A0@ */ ECIPP_ALIGNMENT_UWORD 65535 Compu_OILP_stat_reset_key 0 65535 /end CHARACTERISTIC
/begin COMPU_METHOD Compu_OILP_stat_reset_key " " RAT_FUNC "%.0" "-" COEFFS 0 1 0 0 0 1 /end COMPU_METHOD
/begin CHARACTERISTIC OilP_VlvStk "FaultConfig # OilP_VlvStk (Fault Condition:abs(Oil pressure control error) >)" VALUE 0x001c7e22 /* @ECU_Address@OilP_VlvStk@0x010153C0@ */ ECIPP_ALIGNMENT_UWORD 256 Compu_OilP_VlvStk 0 255.99609375 /end CHARACTERISTIC
/begin COMPU_METHOD Compu_OilP_VlvStk " " RAT_FUNC "%.3" "psi" COEFFS 0 256 0 0 0 1 /end COMPU_METHOD
/begin CHARACTERISTIC ECP_loRPM "FaultConfig # ECP_loRPM (Fault Condition:For RPM <=)" VALUE 0x001c6e86 /* @ECU_Address@ECP_loRPM@0x010153D8@ */ ECIPP_ALIGNMENT_UWORD 65535 Compu_ECP_loRPM 0 65535 /end CHARACTERISTIC
/begin COMPU_METHOD Compu_ECP_loRPM " " RAT_FUNC "%.0" "rpm" COEFFS 0 1 0 0 0 1 /end COMPU_METHOD
/begin CHARACTERISTIC ECP_loRPM2 "FaultConfig # ECP_loRPM2 (Fault Condition:For RPM >=)" VALUE 0x001c6e88 /* @ECU_Address@ECP_loRPM2@0x010153E0@ */ ECIPP_ALIGNMENT_UWORD 65535 Compu_ECP_loRPM2 0 65535 /end CHARACTERISTIC
/begin COMPU_METHOD Compu_ECP_loRPM2 " " RAT_FUNC "%.0" "rpm" COEFFS 0 1 0 0 0 1 /end COMPU_METHOD
/begin CHARACTERISTIC ECP_loP "FaultConfig # ECP_loP (Fault Condition:coolant pressure <)" VALUE 0x001c6e82 /* @ECU_Address@ECP_loP@0x010153E8@ */ ECIPP_ALIGNMENT_UWORD 256 Compu_ECP_loP 0 255.99609375 /end CHARACTERISTIC
/begin COMPU_METHOD Compu_ECP_loP " " RAT_FUNC "%.3" "psig" COEFFS 0 256 0 0 0 1 /end COMPU_METHOD
/begin CHARACTERISTIC ECP_loP2 "FaultConfig # ECP_loP2 (Fault Condition:coolant pressure <)" VALUE 0x001c6e84 /* @ECU_Address@ECP_loP2@0x010153F0@ */ ECIPP_ALIGNMENT_UWORD 256 Compu_ECP_loP2 0 255.99609375 /end CHARACTERISTIC
/begin COMPU_METHOD Compu_ECP_loP2 " " RAT_FUNC "%.3" "psig" COEFFS 0 256 0 0 0 1 /end COMPU_METHOD
/begin CHARACTERISTIC ECP_hiP "FaultConfig # ECP_hiP (Fault Condition:coolant pressure >)" VALUE 0x001c6e80 /* @ECU_Address@ECP_hiP@0x010153F8@ */ ECIPP_ALIGNMENT_UWORD 256 Compu_ECP_hiP 0 255.99609375 /end CHARACTERISTIC
/begin COMPU_METHOD Compu_ECP_hiP " " RAT_FUNC "%.3" "psig" COEFFS 0 256 0 0 0 1 /end COMPU_METHOD
/begin CHARACTERISTIC ECP_Paux_cal "{ECP_Paux_cal&0xff=0:Aux Press A}{ECP_Paux_cal&0xff=1:Aux Press B}{ECP_Paux_cal&0xff=2:Aux Press C}{ECP_Paux_cal&0xff=3:Aux Press D}" VALUE 0x001c86c8 /* @ECU_Address@ECP_Paux_cal@0x01015408@ */ ECIPP_ALIGNMENT_UBYTE 255 ECP_Paux_cal_COMPU_VTAB 0 255 BIT_MASK 0xff /end CHARACTERISTIC
/begin COMPU_METHOD ECP_Paux_cal_COMPU_VTAB "Verbal Table" TAB_VERB "%.0" "list" COMPU_TAB_REF ECP_Paux_cal_COMPU_VTAB_REF /end COMPU_METHOD
/begin COMPU_VTAB ECP_Paux_cal_COMPU_VTAB_REF "Verbal Table" TAB_VERB 4 0 "Aux Press A" 1 "Aux Press B" 2 "Aux Press C" 3 "Aux Press D" DEFAULT_VALUE "UNKNOWN" /end COMPU_VTAB
/begin CHARACTERISTIC EGR_slowinc_cmd "Air # EGR_slowinc_cmd (Fault Condition:when EGR commanded >=)" VALUE 0x001c028e /* @ECU_Address@EGR_slowinc_cmd@0x01015498@ */ ECIPP_ALIGNMENT_SWORD 200 Compu_EGR_slowinc_cmd -200 199.993896484375 /end CHARACTERISTIC
/begin COMPU_METHOD Compu_EGR_slowinc_cmd " " RAT_FUNC "%.3" "%" COEFFS 0 163.84 0 0 0 1 /end COMPU_METHOD
/begin CHARACTERISTIC EGR_slowdec_mdl "Air # EGR_slowdec_mdl (Fault Condition:when EGR model estimated >=)" VALUE 0x001c028c /* @ECU_Address@EGR_slowdec_mdl@0x010154A0@ */ ECIPP_ALIGNMENT_SWORD 200 Compu_EGR_slowdec_mdl -200 199.993896484375 /end CHARACTERISTIC
/begin COMPU_METHOD Compu_EGR_slowdec_mdl " " RAT_FUNC "%.3" "%" COEFFS 0 163.84 0 0 0 1 /end COMPU_METHOD
/begin CHARACTERISTIC EGR_OOA_hi_cmd "Air # EGR_OOA_hi_cmd (Fault Condition:when EGR commanded >=)" VALUE 0x001c0276 /* @ECU_Address@EGR_OOA_hi_cmd@0x010154A8@ */ ECIPP_ALIGNMENT_SWORD 200 Compu_EGR_OOA_hi_cmd -200 199.993896484375 /end CHARACTERISTIC
/begin COMPU_METHOD Compu_EGR_OOA_hi_cmd " " RAT_FUNC "%.3" "%" COEFFS 0 163.84 0 0 0 1 /end COMPU_METHOD
/begin CHARACTERISTIC EGR_OOA_lo_mdl "Air # EGR_OOA_lo_mdl (Fault Condition:when EGR model estimated >=)" VALUE 0x001c027c /* @ECU_Address@EGR_OOA_lo_mdl@0x010154B0@ */ ECIPP_ALIGNMENT_SWORD 200 Compu_EGR_OOA_lo_mdl -200 199.993896484375 /end CHARACTERISTIC
/begin COMPU_METHOD Compu_EGR_OOA_lo_mdl " " RAT_FUNC "%.3" "%" COEFFS 0 163.84 0 0 0 1 /end COMPU_METHOD
/begin CHARACTERISTIC CTM_flt_min_T "FaultConfig # CTM_flt_min_T (Fault Condition:and CBT)" VALUE 0x001c6e4e /* @ECU_Address@CTM_flt_min_T@0x010154B8@ */ ECIPP_ALIGNMENT_UWORD 7732 Compu_CTM_flt_min_T -460 7731.875 /end CHARACTERISTIC
/begin COMPU_METHOD Compu_CTM_flt_min_T " " RAT_FUNC "%.3" "deg F" COEFFS 0 8 3680 0 0 1 /end COMPU_METHOD
/begin CHARACTERISTIC OilP_comm_tout "FaultConfig # OilP_comm_tout (Fault Condition:Oil pressure communication lost >)" VALUE 0x001c7e24 /* @ECU_Address@OilP_comm_tout@0x010154E0@ */ ECIPP_ALIGNMENT_UWORD 65535 Compu_OilP_comm_tout 0 65535 /end CHARACTERISTIC
/begin COMPU_METHOD Compu_OilP_comm_tout " " RAT_FUNC "%.0" "ms" COEFFS 0 1 0 0 0 1 /end COMPU_METHOD
/begin MEASUREMENT TSoftID_table_def "General # TSoftID_table_def" ULONG Compu_TSoftID_table_def 0 0 0 4294967295 ECU_ADDRESS 0x02007000 MATRIX_DIM 4 1 1 /end MEASUREMENT
/begin COMPU_METHOD Compu_TSoftID_table_def " " RAT_FUNC "%.0" "-" COEFFS 0 1 0 0 0 1 /end COMPU_METHOD
/begin MEASUREMENT TCalID_table "Current calibration model" ULONG Compu_TCalID_table 0 0 0 4294967295 ECU_ADDRESS 0x02008000 MATRIX_DIM 4 1 1 /end MEASUREMENT
/begin COMPU_METHOD Compu_TCalID_table " " RAT_FUNC "%.0" "-" COEFFS 0 1 0 0 0 1 /end COMPU_METHOD
/begin CHARACTERISTIC STR_CalBaseName "Calibration file base name" ASCII 0x001C8911 /* @ECU_Address@STR_CalBaseName@0x0200C000@ */ ECIPP_ALIGNMENT_UBYTE 255 Compu_ECIPP_STRINGS 0 255 MATRIX_DIM 159 1 1 /end CHARACTERISTIC
/begin CHARACTERISTIC STR_engine_defPN "General # STR_engine_defPN" ASCII 0x001E9A3C /* @ECU_Address@STR_engine_defPN@0x0200F000@ */ ECIPP_ALIGNMENT_UBYTE 255 Compu_ECIPP_STRINGS 0 255 MATRIX_DIM 19 1 1 /end CHARACTERISTIC
/begin CHARACTERISTIC STR_engine_defSN "General # STR_engine_defSN" ASCII 0x001E9A50 /* @ECU_Address@STR_engine_defSN@0x02010000@ */ ECIPP_ALIGNMENT_UBYTE 255 Compu_ECIPP_STRINGS 0 255 MATRIX_DIM 19 1 1 /end CHARACTERISTIC
/begin CHARACTERISTIC AdaptMAP "CL # AdaptMAP" VAL_BLK 0x001C29A4 /* @ECU_Address@AdaptMAP@0x02020000@ */ ECIPP_ALIGNMENT_SWORD 128 Compu_AdaptMAP -128 127.99609375 MATRIX_DIM 8 1 1 /end CHARACTERISTIC
/begin COMPU_METHOD Compu_AdaptMAP " " RAT_FUNC "%.1" "MAP (psia)" COEFFS 0 256 0 0 0 1 /end COMPU_METHOD
/begin CHARACTERISTIC AdaptRPM "CL # AdaptRPM" VAL_BLK 0x001C29B4 /* @ECU_Address@AdaptRPM@0x02021000@ */ ECIPP_ALIGNMENT_SWORD 32767 Compu_AdaptRPM -32768 32767 MATRIX_DIM 5 1 1 /end CHARACTERISTIC
/begin COMPU_METHOD Compu_AdaptRPM " " RAT_FUNC "%.0" "Speed (rpm)" COEFFS 0 1 0 0 0 1 /end COMPU_METHOD
/begin MEASUREMENT AdaptTbl1 "Gasoline Bank1 Adaptive Table" SWORD Compu_AdaptTbl1 0 0 -100 99.9969482421875 ECU_ADDRESS 0x02022000 MATRIX_DIM 40 1 1 /end MEASUREMENT
/begin COMPU_METHOD Compu_AdaptTbl1 " " RAT_FUNC "%.1" "A_BM1 (%)" COEFFS 0 327.68 0 0 0 1 /end COMPU_METHOD
/begin CHARACTERISTIC AdaptMAPP "CL # AdaptMAPP" VAL_BLK 0x001C0AD0 /* @ECU_Address@AdaptMAPP@0x0205B000@ */ ECIPP_ALIGNMENT_SWORD 128 Compu_AdaptMAPP -128 127.99609375 MATRIX_DIM 8 1 1 /end CHARACTERISTIC
/begin COMPU_METHOD Compu_AdaptMAPP " " RAT_FUNC "%.1" "MAP (psia)" COEFFS 0 256 0 0 0 1 /end COMPU_METHOD
/begin CHARACTERISTIC AdaptRPMP "CL # AdaptRPMP" VAL_BLK 0x001C0AE0 /* @ECU_Address@AdaptRPMP@0x0205C000@ */ ECIPP_ALIGNMENT_SWORD 32767 Compu_AdaptRPMP -32768 32767 MATRIX_DIM 5 1 1 /end CHARACTERISTIC
/begin COMPU_METHOD Compu_AdaptRPMP " " RAT_FUNC "%.0" "Speed (rpm)" COEFFS 0 1 0 0 0 1 /end COMPU_METHOD
/begin MEASUREMENT AdaptTblP "LPG Adaptive Table" SWORD Compu_AdaptTblP 0 0 -100 99.9969482421875 ECU_ADDRESS 0x0205D000 MATRIX_DIM 40 1 1 /end MEASUREMENT
/begin COMPU_METHOD Compu_AdaptTblP " " RAT_FUNC "%.1" "A_BM (%)" COEFFS 0 327.68 0 0 0 1 /end COMPU_METHOD
/begin CHARACTERISTIC AdaptMAPNG "CL # AdaptMAPNG" VAL_BLK 0x001C1A3A /* @ECU_Address@AdaptMAPNG@0x0205E000@ */ ECIPP_ALIGNMENT_SWORD 128 Compu_AdaptMAPNG -128 127.99609375 MATRIX_DIM 8 1 1 /end CHARACTERISTIC
/begin COMPU_METHOD Compu_AdaptMAPNG " " RAT_FUNC "%.1" "MAP (psia)" COEFFS 0 256 0 0 0 1 /end COMPU_METHOD
/begin CHARACTERISTIC AdaptRPMNG "CL # AdaptRPMNG" VAL_BLK 0x001C1A4A /* @ECU_Address@AdaptRPMNG@0x0205F000@ */ ECIPP_ALIGNMENT_SWORD 32767 Compu_AdaptRPMNG -32768 32767 MATRIX_DIM 5 1 1 /end CHARACTERISTIC
/begin COMPU_METHOD Compu_AdaptRPMNG " " RAT_FUNC "%.0" "Speed (rpm)" COEFFS 0 1 0 0 0 1 /end COMPU_METHOD
/begin MEASUREMENT AdaptTblNG "NG Adaptive Table" SWORD Compu_AdaptTblNG 0 0 -100 99.9969482421875 ECU_ADDRESS 0x02060000 MATRIX_DIM 40 1 1 /end MEASUREMENT
/begin COMPU_METHOD Compu_AdaptTblNG " " RAT_FUNC "%.1" "A_BM (%)" COEFFS 0 327.68 0 0 0 1 /end COMPU_METHOD
/begin MEASUREMENT AdaptTbl2 "Gasoline Bank2 Adaptive Table" SWORD Compu_AdaptTbl2 0 0 -100 99.9969482421875 ECU_ADDRESS 0x0209D000 MATRIX_DIM 40 1 1 /end MEASUREMENT
/begin COMPU_METHOD Compu_AdaptTbl2 " " RAT_FUNC "%.1" "A_BM2 (%)" COEFFS 0 327.68 0 0 0 1 /end COMPU_METHOD
/begin CHARACTERISTIC TOCTadpt_MAP "Spark # TOCTadpt_MAP" VAL_BLK 0x001C3990 /* @ECU_Address@TOCTadpt_MAP@0x020EA000@ */ ECIPP_ALIGNMENT_SWORD 128 Compu_TOCTadpt_MAP -128 127.99609375 MATRIX_DIM 4 1 1 /end CHARACTERISTIC
/begin COMPU_METHOD Compu_TOCTadpt_MAP " " RAT_FUNC "%.1" "MAP_load (psia)" COEFFS 0 256 0 0 0 1 /end COMPU_METHOD
/begin CHARACTERISTIC TOCTadpt_RPM "Spark # TOCTadpt_RPM" VAL_BLK 0x001C3998 /* @ECU_Address@TOCTadpt_RPM@0x020EB000@ */ ECIPP_ALIGNMENT_SWORD 32767 Compu_TOCTadpt_RPM -32768 32767 MATRIX_DIM 5 1 1 /end CHARACTERISTIC
/begin COMPU_METHOD Compu_TOCTadpt_RPM " " RAT_FUNC "%.0" "Speed (rpm)" COEFFS 0 1 0 0 0 1 /end COMPU_METHOD
/begin MEASUREMENT TOCTadpt_oct "Adaptive Octane Learn Table" SWORD Compu_TOCTadpt_oct 0 0 -100 99.9969482421875 ECU_ADDRESS 0x020EC000 MATRIX_DIM 20 1 1 /end MEASUREMENT
/begin COMPU_METHOD Compu_TOCTadpt_oct " " RAT_FUNC "%.1" "Octane (%)" COEFFS 0 327.68 0 0 0 1 /end COMPU_METHOD
/begin CHARACTERISTIC TIAC_step_Vbat "Gov # TIAC_step_Vbat" VAL_BLK 0x001C4E8C /* @ECU_Address@TIAC_step_Vbat@0x020F2000@ */ ECIPP_ALIGNMENT_SWORD 128 Compu_TIAC_step_Vbat -128 127.99609375 MATRIX_DIM 4 1 1 /end CHARACTERISTIC
/begin COMPU_METHOD Compu_TIAC_step_Vbat " " RAT_FUNC "%.3" "(volts)" COEFFS 0 256 0 0 0 1 /end COMPU_METHOD
/begin CHARACTERISTIC TIAC_step_int "Gov # TIAC_step_int" VAL_BLK 0x001C4E94 /* @ECU_Address@TIAC_step_int@0x020F3000@ */ ECIPP_ALIGNMENT_SWORD 128 Compu_TIAC_step_int -128 127.99609375 MATRIX_DIM 4 1 1 /end CHARACTERISTIC
/begin COMPU_METHOD Compu_TIAC_step_int " " RAT_FUNC "%.3" "(ms)" COEFFS 0 256 0 0 0 1 /end COMPU_METHOD
/begin CHARACTERISTIC HstSL_Tbl_MAPdf "FaultConfig # HstSL_Tbl_MAPdf" VAL_BLK 0x001ECCEC /* @ECU_Address@HstSL_Tbl_MAPdf@0x02141000@ */ ECIPP_ALIGNMENT_UWORD 256 Compu_HstSL_Tbl_MAPdf 0 255.99609375 MATRIX_DIM 6 1 1 /end CHARACTERISTIC
/begin COMPU_METHOD Compu_HstSL_Tbl_MAPdf " " RAT_FUNC "%.3" "MAP load (psia)" COEFFS 0 256 0 0 0 1 /end COMPU_METHOD
/begin MEASUREMENT HstSL_Tbl_MAP "General # HstSL_Tbl_MAP" UWORD Compu_HstSL_Tbl_MAP 0 0 0 255.99609375 ECU_ADDRESS 0x02143000 MATRIX_DIM 6 1 1 /end MEASUREMENT
/begin COMPU_METHOD Compu_HstSL_Tbl_MAP " " RAT_FUNC "%.1" "MAP (psia)" COEFFS 0 256 0 0 0 1 /end COMPU_METHOD
/begin CHARACTERISTIC TTM_IACA_POS "Air # TTM_IACA_POS" VAL_BLK 0x001E354E /* @ECU_Address@TTM_IACA_POS@0x02147000@ */ ECIPP_ALIGNMENT_SWORD 100 Compu_TTM_IACA_POS -100 99.9969482421875 MATRIX_DIM 16 1 1 /end CHARACTERISTIC
/begin COMPU_METHOD Compu_TTM_IACA_POS " " RAT_FUNC "%.3" "(%)" COEFFS 0 327.68 0 0 0 1 /end COMPU_METHOD
/begin CHARACTERISTIC TTM_IACA_A "Air # TTM_IACA_A" VAL_BLK 0x001E352E /* @ECU_Address@TTM_IACA_A@0x02148000@ */ ECIPP_ALIGNMENT_SWORD 2 Compu_TTM_IACA_A -2 1.99993896484375 MATRIX_DIM 16 1 1 /end CHARACTERISTIC
/begin COMPU_METHOD Compu_TTM_IACA_A " " RAT_FUNC "%.3" "(in^2)" COEFFS 0 16384 0 0 0 1 /end COMPU_METHOD
/begin CHARACTERISTIC FPcal_V "IOConfig # FPcal_V" VAL_BLK 0x001C44F0 /* @ECU_Address@FPcal_V@0x02152000@ */ ECIPP_ALIGNMENT_SWORD 5 Compu_FPcal_V -5 4.99984741210938 MATRIX_DIM 2 1 1 /end CHARACTERISTIC
/begin COMPU_METHOD Compu_FPcal_V " " RAT_FUNC "%.3" "(volts)" COEFFS 0 6553.6 0 0 0 1 /end COMPU_METHOD
/begin CHARACTERISTIC FPcal_P "IOConfig # FPcal_P" VAL_BLK 0x001C44E8 /* @ECU_Address@FPcal_P@0x02153000@ */ ECIPP_ALIGNMENT_SWORD 256 Compu_FPcal_P -256 255.9921875 MATRIX_DIM 2 1 1 /end CHARACTERISTIC
/begin COMPU_METHOD Compu_FPcal_P " " RAT_FUNC "%.3" "-" COEFFS 0 128 0 0 0 1 /end COMPU_METHOD
/begin CHARACTERISTIC FTPcal_V "IOConfig # FTPcal_V" VAL_BLK 0x001C44FE /* @ECU_Address@FTPcal_V@0x02154000@ */ ECIPP_ALIGNMENT_SWORD 5 Compu_FTPcal_V -5 4.99984741210938 MATRIX_DIM 2 1 1 /end CHARACTERISTIC
/begin COMPU_METHOD Compu_FTPcal_V " " RAT_FUNC "%.3" "(volts)" COEFFS 0 6553.6 0 0 0 1 /end COMPU_METHOD
/begin CHARACTERISTIC FTPcal_P "IOConfig # FTPcal_P" VAL_BLK 0x001C44FA /* @ECU_Address@FTPcal_P@0x02155000@ */ ECIPP_ALIGNMENT_SWORD 8192 Compu_FTPcal_P -8192 8191.75 MATRIX_DIM 2 1 1 /end CHARACTERISTIC
/begin COMPU_METHOD Compu_FTPcal_P " " RAT_FUNC "%.3" "-" COEFFS 0 4 0 0 0 1 /end COMPU_METHOD
/begin COMPU_METHOD Compu_TDPS_K_Pcmd " " RAT_FUNC "%.1" "Pcmd (inH2O)" COEFFS 0 512 0 0 0 1 /end COMPU_METHOD
/begin CHARACTERISTIC TDPS_Kp "EPR DP Gain Schedule" CURVE 0x001C49C8 /* @ECU_Address@TDPS_Kp@0x02157000@ */ ECIPP_ALIGNMENT_SWORD 200 Compu_TDPS_Kp -200 199.993896484375 MAX_REFRESH 6 1
 /begin AXIS_DESCR COM_AXIS NO_INPUT_QUANTITY Compu_TDPS_K_Pcmd 8 -64 63.998046875 AXIS_PTS_REF TDPS_K_Pcmd /end AXIS_DESCR
/end CHARACTERISTIC
/begin AXIS_PTS TDPS_K_Pcmd " " 0x001C4998 /* @ECU_Address@TDPS_K_Pcmd@0x02156000@ */ NO_INPUT_QUANTITY ECIPP_Lookup_SWORD 0 Compu_TDPS_K_Pcmd 8 -64 63.998046875 /end AXIS_PTS
/begin COMPU_METHOD Compu_TDPS_Kp " " RAT_FUNC "%.3" "Kp (%/inH2O)" COEFFS 0 163.84 0 0 0 1 /end COMPU_METHOD
/begin CHARACTERISTIC TDPS_Ki "EPR DP Gain Schedule" CURVE 0x001C49B8 /* @ECU_Address@TDPS_Ki@0x02158000@ */ ECIPP_ALIGNMENT_SWORD 3 Compu_TDPS_Ki -3.125 3.12490463256836 MAX_REFRESH 6 1
 /begin AXIS_DESCR COM_AXIS NO_INPUT_QUANTITY Compu_TDPS_K_Pcmd 8 -64 63.998046875 AXIS_PTS_REF TDPS_K_Pcmd /end AXIS_DESCR
/end CHARACTERISTIC
/begin COMPU_METHOD Compu_TDPS_Ki " " RAT_FUNC "%.3" "Ki (%/inH2O/ms)" COEFFS 0 10485.76 0 0 0 1 /end COMPU_METHOD
/begin CHARACTERISTIC TDPS_Kd "EPR DP Gain Schedule" CURVE 0x001C49A8 /* @ECU_Address@TDPS_Kd@0x02159000@ */ ECIPP_ALIGNMENT_SWORD 12800 Compu_TDPS_Kd -12800 12799.609375 MAX_REFRESH 6 1
 /begin AXIS_DESCR COM_AXIS NO_INPUT_QUANTITY Compu_TDPS_K_Pcmd 8 -64 63.998046875 AXIS_PTS_REF TDPS_K_Pcmd /end AXIS_DESCR
/end CHARACTERISTIC
/begin COMPU_METHOD Compu_TDPS_Kd " " RAT_FUNC "%.1" "Kd (%/inH2O*ms)" COEFFS 0 2.56 0 0 0 1 /end COMPU_METHOD
/begin COMPU_METHOD Compu_TDP_FF_Pcmd " " RAT_FUNC "%.1" "Pcmd (inH2O)" COEFFS 0 512 0 0 0 1 /end COMPU_METHOD
/begin CHARACTERISTIC TDP_FF_pct "EPR Feedforward Schedule" CURVE 0x001C49FC /* @ECU_Address@TDP_FF_pct@0x0215B000@ */ ECIPP_ALIGNMENT_SWORD 100 Compu_TDP_FF_pct -100 99.9969482421875 MAX_REFRESH 6 1
 /begin AXIS_DESCR COM_AXIS NO_INPUT_QUANTITY Compu_TDP_FF_Pcmd 8 -64 63.998046875 AXIS_PTS_REF TDP_FF_Pcmd /end AXIS_DESCR
/end CHARACTERISTIC
/begin AXIS_PTS TDP_FF_Pcmd " " 0x001C49EC /* @ECU_Address@TDP_FF_Pcmd@0x0215A000@ */ NO_INPUT_QUANTITY ECIPP_Lookup_SWORD 0 Compu_TDP_FF_Pcmd 8 -64 63.998046875 /end AXIS_PTS
/begin COMPU_METHOD Compu_TDP_FF_pct " " RAT_FUNC "%.1" "Feedforward (%)" COEFFS 0 327.68 0 0 0 1 /end COMPU_METHOD
/begin MEASUREMENT TFltCfg "FaultConfig # TFltCfg" UWORD Compu_TFltCfg 0 0 0 65535 ECU_ADDRESS 0x0215F000 MATRIX_DIM 16 1 1 /end MEASUREMENT
/begin COMPU_METHOD Compu_TFltCfg " " RAT_FUNC "%.0" "-" COEFFS 0 1 0 0 0 1 /end COMPU_METHOD
/begin MEASUREMENT TFltMiniHst "FaultConfig # TFltMiniHst" UWORD Compu_TFltMiniHst 0 0 0 65535 ECU_ADDRESS 0x02160000 MATRIX_DIM 14 1 1 /end MEASUREMENT
/begin COMPU_METHOD Compu_TFltMiniHst " " RAT_FUNC "%.0" "-" COEFFS 0 1 0 0 0 1 /end COMPU_METHOD
/begin MEASUREMENT TFltMiniAct "FaultConfig # TFltMiniAct" UWORD Compu_TFltMiniAct 0 0 0 65535 ECU_ADDRESS 0x02161000 MATRIX_DIM 14 1 1 /end MEASUREMENT
/begin COMPU_METHOD Compu_TFltMiniAct " " RAT_FUNC "%.0" "-" COEFFS 0 1 0 0 0 1 /end COMPU_METHOD
/begin MEASUREMENT TFltMiniPnd "FaultConfig # TFltMiniPnd" UWORD Compu_TFltMiniPnd 0 0 0 65535 ECU_ADDRESS 0x02162000 MATRIX_DIM 14 1 1 /end MEASUREMENT
/begin COMPU_METHOD Compu_TFltMiniPnd " " RAT_FUNC "%.0" "-" COEFFS 0 1 0 0 0 1 /end COMPU_METHOD
/begin MEASUREMENT ICAV_mis_cyls "Misfire cylinder count - 1" UWORD Compu_ICAV_mis_cyls 0 0 0 65535 ECU_ADDRESS 0x0216C000 MATRIX_DIM 10 1 1 /end MEASUREMENT
/begin COMPU_METHOD Compu_ICAV_mis_cyls " " RAT_FUNC "%.0" "-" COEFFS 0 1 0 0 0 1 /end COMPU_METHOD
/begin CHARACTERISTIC TPW_VC_volts "Fuel # TPW_VC_volts" VAL_BLK 0x001E32CE /* @ECU_Address@TPW_VC_volts@0x0218A000@ */ ECIPP_ALIGNMENT_SWORD 128 Compu_TPW_VC_volts -128 127.99609375 MATRIX_DIM 16 1 1 /end CHARACTERISTIC
/begin COMPU_METHOD Compu_TPW_VC_volts " " RAT_FUNC "%.3" "(volts)" COEFFS 0 256 0 0 0 1 /end COMPU_METHOD
/begin CHARACTERISTIC TPW_VC_time "Fuel # TPW_VC_time" VAL_BLK 0x001E328E /* @ECU_Address@TPW_VC_time@0x0218B000@ */ ECIPP_ALIGNMENT_SWORD 105 Compu_TPW_VC_time -104.8576 104.8544 MATRIX_DIM 16 1 1 /end CHARACTERISTIC
/begin COMPU_METHOD Compu_TPW_VC_time " " RAT_FUNC "%.3" "(ms)" COEFFS 0 312.5 0 0 0 1 /end COMPU_METHOD
/begin CHARACTERISTIC TICAV_hst_prog "FaultConfig # TICAV_hst_prog" VAL_BLK 0x001C4F7C /* @ECU_Address@TICAV_hst_prog@0x0218C000@ */ ECIPP_ALIGNMENT_SWORD 32767 Compu_TICAV_hst_prog -32768 32767 MATRIX_DIM 7 1 1 /end CHARACTERISTIC
/begin COMPU_METHOD Compu_TICAV_hst_prog " " RAT_FUNC "%.0" "Progress (cycles)" COEFFS 0 1 0 0 0 1 /end COMPU_METHOD
/begin CHARACTERISTIC TICAV_hst_tmult "FaultConfig # TICAV_hst_tmult" VAL_BLK 0x001C4F8A /* @ECU_Address@TICAV_hst_tmult@0x0218D000@ */ ECIPP_ALIGNMENT_SWORD 4 Compu_TICAV_hst_tmult -4 3.9998779296875 MATRIX_DIM 7 1 1 /end CHARACTERISTIC
/begin COMPU_METHOD Compu_TICAV_hst_tmult " " RAT_FUNC "%.2" "Thres Multiplier" COEFFS 0 8192 0 0 0 1 /end COMPU_METHOD
/begin MEASUREMENT ICAV_chst_cnts "ICAV Continuous Misfires" SWORD Compu_ICAV_chst_cnts 0 0 -1024 1023.96875 ECU_ADDRESS 0x0218E000 MATRIX_DIM 32 1 1 /end MEASUREMENT
/begin COMPU_METHOD Compu_ICAV_chst_cnts " " RAT_FUNC "%.0" "misfires" COEFFS 0 32 0 0 0 1 /end COMPU_METHOD
/begin MEASUREMENT ICAV_rhst_cnts "ICAV Random Misfires" SWORD Compu_ICAV_rhst_cnts 0 0 -1024 1023.96875 ECU_ADDRESS 0x0218F000 MATRIX_DIM 32 1 1 /end MEASUREMENT
/begin COMPU_METHOD Compu_ICAV_rhst_cnts " " RAT_FUNC "%.0" "misfires" COEFFS 0 32 0 0 0 1 /end COMPU_METHOD
/begin MEASUREMENT ICAV_chst_prog "Continuous Misfire Adapt Prog" UBYTE Compu_ICAV_chst_prog 0 0 0 255 ECU_ADDRESS 0x02190000 MATRIX_DIM 7 1 1 /end MEASUREMENT
/begin COMPU_METHOD Compu_ICAV_chst_prog " " RAT_FUNC "%.0" "Misfires" COEFFS 0 1 0 0 0 1 /end COMPU_METHOD
/begin MEASUREMENT ICAV_rhst_prog "Random Misfire Adapt Prog" UBYTE Compu_ICAV_rhst_prog 0 0 0 255 ECU_ADDRESS 0x02191000 MATRIX_DIM 7 1 1 /end MEASUREMENT
/begin COMPU_METHOD Compu_ICAV_rhst_prog " " RAT_FUNC "%.0" "Misfires" COEFFS 0 1 0 0 0 1 /end COMPU_METHOD
/begin MEASUREMENT ICAV_chst_tmult "Continuous Misfire Thres Mult" UBYTE Compu_ICAV_chst_tmult 0 0 0 255 ECU_ADDRESS 0x02192000 MATRIX_DIM 7 1 1 /end MEASUREMENT
/begin COMPU_METHOD Compu_ICAV_chst_tmult " " RAT_FUNC "%.0" "Misfires" COEFFS 0 1 0 0 0 1 /end COMPU_METHOD
/begin MEASUREMENT ICAV_rhst_tmult "Random Misfire Thres Mult" UBYTE Compu_ICAV_rhst_tmult 0 0 0 255 ECU_ADDRESS 0x02193000 MATRIX_DIM 7 1 1 /end MEASUREMENT
/begin COMPU_METHOD Compu_ICAV_rhst_tmult " " RAT_FUNC "%.0" "Misfires" COEFFS 0 1 0 0 0 1 /end COMPU_METHOD
/begin CHARACTERISTIC TCHT_CHT "General # TCHT_CHT" VAL_BLK 0x001E16A8 /* @ECU_Address@TCHT_CHT@0x021BF000@ */ ECIPP_ALIGNMENT_FLOAT32_IEEE 10000000000 Compu_TCHT_CHT -10000000000 10000000000 MATRIX_DIM 16 1 1 /end CHARACTERISTIC
/begin COMPU_METHOD Compu_TCHT_CHT " " RAT_FUNC "%.3" "Temp (deg F)" COEFFS 0 1 460 0 0 1 /end COMPU_METHOD
/begin CHARACTERISTIC TECT_ECT "General # TECT_ECT" VAL_BLK 0x001C3BA4 /* @ECU_Address@TECT_ECT@0x021C0000@ */ ECIPP_ALIGNMENT_FLOAT32_IEEE 10000000000 Compu_TECT_ECT -10000000000 10000000000 MATRIX_DIM 16 1 1 /end CHARACTERISTIC
/begin COMPU_METHOD Compu_TECT_ECT " " RAT_FUNC "%.3" "Temp (deg F)" COEFFS 0 1 460 0 0 1 /end COMPU_METHOD
/begin CHARACTERISTIC TEGO_phiFB_v "General # TEGO_phiFB_v" VAL_BLK 0x001E306E /* @ECU_Address@TEGO_phiFB_v@0x021C1000@ */ ECIPP_ALIGNMENT_SWORD 8 Compu_TEGO_phiFB_v -8 7.999755859375 MATRIX_DIM 16 1 1 /end CHARACTERISTIC
/begin COMPU_METHOD Compu_TEGO_phiFB_v " " RAT_FUNC "%.3" "EGO Volts" COEFFS 0 4096 0 0 0 1 /end COMPU_METHOD
/begin CHARACTERISTIC TEGOpre_phiFB_phi "General # TEGOpre_phiFB_phi" VAL_BLK 0x001E308E /* @ECU_Address@TEGOpre_phiFB_phi@0x021C2000@ */ ECIPP_ALIGNMENT_SWORD 2 Compu_TEGOpre_phiFB_phi -2 1.99993896484375 MATRIX_DIM 16 1 1 /end CHARACTERISTIC
/begin COMPU_METHOD Compu_TEGOpre_phiFB_phi " " RAT_FUNC "%.3" "EGO Phi" COEFFS 0 16384 0 0 0 1 /end COMPU_METHOD
/begin CHARACTERISTIC TEGOpst_phiFB_phi "General # TEGOpst_phiFB_phi" VAL_BLK 0x001E30AE /* @ECU_Address@TEGOpst_phiFB_phi@0x021C3000@ */ ECIPP_ALIGNMENT_SWORD 2 Compu_TEGOpst_phiFB_phi -2 1.99993896484375 MATRIX_DIM 16 1 1 /end CHARACTERISTIC
/begin COMPU_METHOD Compu_TEGOpst_phiFB_phi " " RAT_FUNC "%.3" "EGO Phi" COEFFS 0 16384 0 0 0 1 /end COMPU_METHOD
/begin CHARACTERISTIC TEMWT_EMWT "General # TEMWT_EMWT" VAL_BLK 0x001E1728 /* @ECU_Address@TEMWT_EMWT@0x021C4000@ */ ECIPP_ALIGNMENT_FLOAT32_IEEE 10000000000 Compu_TEMWT_EMWT -10000000000 10000000000 MATRIX_DIM 16 1 1 /end CHARACTERISTIC
/begin COMPU_METHOD Compu_TEMWT_EMWT " " RAT_FUNC "%.3" "Temp (deg F)" COEFFS 0 1 460 0 0 1 /end COMPU_METHOD
/begin CHARACTERISTIC TFR_TinKt_Kt "General # TFR_TinKt_Kt" VAL_BLK 0x001E30E6 /* @ECU_Address@TFR_TinKt_Kt@0x021C5000@ */ ECIPP_ALIGNMENT_SWORD 32 Compu_TFR_TinKt_Kt -32 31.9990234375 MATRIX_DIM 16 1 1 /end CHARACTERISTIC
/begin COMPU_METHOD Compu_TFR_TinKt_Kt " " RAT_FUNC "%.3" "(g/sec/psia/in^2)" COEFFS 0 1024 0 0 0 1 /end COMPU_METHOD
/begin CHARACTERISTIC TFR_TinKt_Tin "General # TFR_TinKt_Tin" VAL_BLK 0x001E3106 /* @ECU_Address@TFR_TinKt_Tin@0x021C6000@ */ ECIPP_ALIGNMENT_SWORD 7732 Compu_TFR_TinKt_Tin -8652 7731.75 MATRIX_DIM 16 1 1 /end CHARACTERISTIC
/begin COMPU_METHOD Compu_TFR_TinKt_Tin " " RAT_FUNC "%.3" "(deg F)" COEFFS 0 4 1840 0 0 1 /end COMPU_METHOD
/begin CHARACTERISTIC TFST_FST "General # TFST_FST" VAL_BLK 0x001E17A8 /* @ECU_Address@TFST_FST@0x021C7000@ */ ECIPP_ALIGNMENT_FLOAT32_IEEE 10000000000 Compu_TFST_FST -10000000000 10000000000 MATRIX_DIM 16 1 1 /end CHARACTERISTIC
/begin COMPU_METHOD Compu_TFST_FST " " RAT_FUNC "%.3" "Temp (deg F)" COEFFS 0 1 460 0 0 1 /end COMPU_METHOD
/begin CHARACTERISTIC TFTT_FTT "General # TFTT_FTT" VAL_BLK 0x001E1828 /* @ECU_Address@TFTT_FTT@0x021C8000@ */ ECIPP_ALIGNMENT_FLOAT32_IEEE 10000000000 Compu_TFTT_FTT -10000000000 10000000000 MATRIX_DIM 16 1 1 /end CHARACTERISTIC
/begin COMPU_METHOD Compu_TFTT_FTT " " RAT_FUNC "%.3" "Temp (deg F)" COEFFS 0 1 460 0 0 1 /end COMPU_METHOD
/begin CHARACTERISTIC TFT_FT "General # TFT_FT" VAL_BLK 0x001E18A8 /* @ECU_Address@TFT_FT@0x021C9000@ */ ECIPP_ALIGNMENT_FLOAT32_IEEE 10000000000 Compu_TFT_FT -10000000000 10000000000 MATRIX_DIM 16 1 1 /end CHARACTERISTIC
/begin COMPU_METHOD Compu_TFT_FT " " RAT_FUNC "%.3" "Temp (deg F)" COEFFS 0 1 460 0 0 1 /end COMPU_METHOD
/begin CHARACTERISTIC TFTgaseous_FT "General # TFTgaseous_FT" VAL_BLK 0x001E1928 /* @ECU_Address@TFTgaseous_FT@0x021CA000@ */ ECIPP_ALIGNMENT_FLOAT32_IEEE 10000000000 Compu_TFTgaseous_FT -10000000000 10000000000 MATRIX_DIM 16 1 1 /end CHARACTERISTIC
/begin COMPU_METHOD Compu_TFTgaseous_FT " " RAT_FUNC "%.3" "Temp (deg F)" COEFFS 0 1 460 0 0 1 /end COMPU_METHOD
/begin CHARACTERISTIC TIAT_IAT "General # TIAT_IAT" VAL_BLK 0x001E1A08 /* @ECU_Address@TIAT_IAT@0x021CB000@ */ ECIPP_ALIGNMENT_FLOAT32_IEEE 10000000000 Compu_TIAT_IAT -10000000000 10000000000 MATRIX_DIM 16 1 1 /end CHARACTERISTIC
/begin COMPU_METHOD Compu_TIAT_IAT " " RAT_FUNC "%.3" "Temp (deg F)" COEFFS 0 1 460 0 0 1 /end COMPU_METHOD
/begin CHARACTERISTIC TMJ_TinKtN_Kt "General # TMJ_TinKtN_Kt" VAL_BLK 0x001E31EE /* @ECU_Address@TMJ_TinKtN_Kt@0x021CF000@ */ ECIPP_ALIGNMENT_SWORD 32 Compu_TMJ_TinKtN_Kt -32 31.9990234375 MATRIX_DIM 16 1 1 /end CHARACTERISTIC
/begin COMPU_METHOD Compu_TMJ_TinKtN_Kt " " RAT_FUNC "%.3" "(g/sec/psia/in^2)" COEFFS 0 1024 0 0 0 1 /end COMPU_METHOD
/begin CHARACTERISTIC TMJ_TinKtP_Kt "General # TMJ_TinKtP_Kt" VAL_BLK 0x001E320E /* @ECU_Address@TMJ_TinKtP_Kt@0x021D0000@ */ ECIPP_ALIGNMENT_SWORD 32 Compu_TMJ_TinKtP_Kt -32 31.9990234375 MATRIX_DIM 16 1 1 /end CHARACTERISTIC
/begin COMPU_METHOD Compu_TMJ_TinKtP_Kt " " RAT_FUNC "%.3" "(g/sec/psia/in^2)" COEFFS 0 1024 0 0 0 1 /end COMPU_METHOD
/begin CHARACTERISTIC TMJ_TinKt_Tin "General # TMJ_TinKt_Tin" VAL_BLK 0x001E322E /* @ECU_Address@TMJ_TinKt_Tin@0x021D1000@ */ ECIPP_ALIGNMENT_SWORD 564 Compu_TMJ_TinKt_Tin -1484 563.96875 MATRIX_DIM 16 1 1 /end CHARACTERISTIC
/begin COMPU_METHOD Compu_TMJ_TinKt_Tin " " RAT_FUNC "%.3" "(deg F)" COEFFS 0 32 14720 0 0 1 /end COMPU_METHOD
/begin CHARACTERISTIC PW_emg_data "General # PW_emg_data" VAL_BLK 0x001E2F36 /* @ECU_Address@PW_emg_data@0x021D2000@ */ ECIPP_ALIGNMENT_SWORD 2048 Compu_PW_emg_data -2048 2047.9375 MATRIX_DIM 16 1 1 /end CHARACTERISTIC
/begin COMPU_METHOD Compu_PW_emg_data " " RAT_FUNC "%.3" "(mg/inj)" COEFFS 0 16 0 0 0 1 /end COMPU_METHOD
/begin CHARACTERISTIC PW_ems_data "General # PW_ems_data" VAL_BLK 0x001E2F56 /* @ECU_Address@PW_ems_data@0x021D3000@ */ ECIPP_ALIGNMENT_SWORD 1024 Compu_PW_ems_data -1024 1023.96875 MATRIX_DIM 16 1 1 /end CHARACTERISTIC
/begin COMPU_METHOD Compu_PW_ems_data " " RAT_FUNC "%.3" "(ms)" COEFFS 0 32 0 0 0 1 /end COMPU_METHOD
/begin CHARACTERISTIC PW_mg_data "General # PW_mg_data" VAL_BLK 0x001E2F76 /* @ECU_Address@PW_mg_data@0x021D4000@ */ ECIPP_ALIGNMENT_SWORD 512 Compu_PW_mg_data -512 511.984375 MATRIX_DIM 16 1 1 /end CHARACTERISTIC
/begin COMPU_METHOD Compu_PW_mg_data " " RAT_FUNC "%.3" "(mg/inj)" COEFFS 0 64 0 0 0 1 /end COMPU_METHOD
/begin CHARACTERISTIC PW_ms_data "General # PW_ms_data" VAL_BLK 0x001E2FB6 /* @ECU_Address@PW_ms_data@0x021D5000@ */ ECIPP_ALIGNMENT_SWORD 105 Compu_PW_ms_data -104.8576 104.8544 MATRIX_DIM 16 1 1 /end CHARACTERISTIC
/begin COMPU_METHOD Compu_PW_ms_data " " RAT_FUNC "%.3" "(ms)" COEFFS 0 312.5 0 0 0 1 /end COMPU_METHOD
/begin CHARACTERISTIC TTM_TinKt_Kt "General # TTM_TinKt_Kt" VAL_BLK 0x001E35EE /* @ECU_Address@TTM_TinKt_Kt@0x021D8000@ */ ECIPP_ALIGNMENT_SWORD 32 Compu_TTM_TinKt_Kt -32 31.9990234375 MATRIX_DIM 16 1 1 /end CHARACTERISTIC
/begin COMPU_METHOD Compu_TTM_TinKt_Kt " " RAT_FUNC "%.3" "(g/sec/psia/in^2)" COEFFS 0 1024 0 0 0 1 /end COMPU_METHOD
/begin CHARACTERISTIC TTM_TinKt_Tin "General # TTM_TinKt_Tin" VAL_BLK 0x001E360E /* @ECU_Address@TTM_TinKt_Tin@0x021D9000@ */ ECIPP_ALIGNMENT_SWORD 564 Compu_TTM_TinKt_Tin -1484 563.96875 MATRIX_DIM 16 1 1 /end CHARACTERISTIC
/begin COMPU_METHOD Compu_TTM_TinKt_Tin " " RAT_FUNC "%.3" "(deg F)" COEFFS 0 32 14720 0 0 1 /end COMPU_METHOD
/begin CHARACTERISTIC TVEmod_ECT_ECT "General # TVEmod_ECT_ECT" VAL_BLK 0x001E362E /* @ECU_Address@TVEmod_ECT_ECT@0x021DA000@ */ ECIPP_ALIGNMENT_SWORD 564 Compu_TVEmod_ECT_ECT -1484 563.96875 MATRIX_DIM 16 1 1 /end CHARACTERISTIC
/begin COMPU_METHOD Compu_TVEmod_ECT_ECT " " RAT_FUNC "%.3" "(deg F)" COEFFS 0 32 14720 0 0 1 /end COMPU_METHOD
/begin CHARACTERISTIC TVEmod_MAT_MAT "General # TVEmod_MAT_MAT" VAL_BLK 0x001E366E /* @ECU_Address@TVEmod_MAT_MAT@0x021DC000@ */ ECIPP_ALIGNMENT_SWORD 564 Compu_TVEmod_MAT_MAT -1484 563.96875 MATRIX_DIM 16 1 1 /end CHARACTERISTIC
/begin COMPU_METHOD Compu_TVEmod_MAT_MAT " " RAT_FUNC "%.3" "(deg F)" COEFFS 0 32 14720 0 0 1 /end COMPU_METHOD
/begin CHARACTERISTIC WGPcal_V "General # WGPcal_V" VAL_BLK 0x001C6C18 /* @ECU_Address@WGPcal_V@0x021DF000@ */ ECIPP_ALIGNMENT_SWORD 5 Compu_WGPcal_V -5 4.99984741210938 MATRIX_DIM 2 1 1 /end CHARACTERISTIC
/begin COMPU_METHOD Compu_WGPcal_V " " RAT_FUNC "%.3" "(volts)" COEFFS 0 6553.6 0 0 0 1 /end COMPU_METHOD
/begin CHARACTERISTIC WGPcal_P "General # WGPcal_P" VAL_BLK 0x001C6C14 /* @ECU_Address@WGPcal_P@0x021E0000@ */ ECIPP_ALIGNMENT_SWORD 128 Compu_WGPcal_P -128 127.99609375 MATRIX_DIM 2 1 1 /end CHARACTERISTIC
/begin COMPU_METHOD Compu_WGPcal_P " " RAT_FUNC "%.3" "-" COEFFS 0 256 0 0 0 1 /end COMPU_METHOD
/begin CHARACTERISTIC TIAT_ohms "IOConfig # TIAT_ohms" VAL_BLK 0x001E1A48 /* @ECU_Address@TIAT_ohms@0x021ED000@ */ ECIPP_ALIGNMENT_FLOAT32_IEEE 10000000000 Compu_TIAT_ohms -10000000000 10000000000 MATRIX_DIM 16 1 1 /end CHARACTERISTIC
/begin COMPU_METHOD Compu_TIAT_ohms " " RAT_FUNC "%.3" "Ohms" COEFFS 0 1 0 0 0 1 /end COMPU_METHOD
/begin CHARACTERISTIC TECT_ohms "IOConfig # TECT_ohms" VAL_BLK 0x001C3BE4 /* @ECU_Address@TECT_ohms@0x021EE000@ */ ECIPP_ALIGNMENT_FLOAT32_IEEE 10000000000 Compu_TECT_ohms -10000000000 10000000000 MATRIX_DIM 16 1 1 /end CHARACTERISTIC
/begin COMPU_METHOD Compu_TECT_ohms " " RAT_FUNC "%.3" "Ohms" COEFFS 0 1 0 0 0 1 /end COMPU_METHOD
/begin CHARACTERISTIC TFT_ohms "IOConfig # TFT_ohms" VAL_BLK 0x001E18E8 /* @ECU_Address@TFT_ohms@0x021EF000@ */ ECIPP_ALIGNMENT_FLOAT32_IEEE 10000000000 Compu_TFT_ohms -10000000000 10000000000 MATRIX_DIM 16 1 1 /end CHARACTERISTIC
/begin COMPU_METHOD Compu_TFT_ohms " " RAT_FUNC "%.3" "Ohms" COEFFS 0 1 0 0 0 1 /end COMPU_METHOD
/begin CHARACTERISTIC TCHT_ohms "IOConfig # TCHT_ohms" VAL_BLK 0x001E16E8 /* @ECU_Address@TCHT_ohms@0x021F0000@ */ ECIPP_ALIGNMENT_FLOAT32_IEEE 10000000000 Compu_TCHT_ohms -10000000000 10000000000 MATRIX_DIM 16 1 1 /end CHARACTERISTIC
/begin COMPU_METHOD Compu_TCHT_ohms " " RAT_FUNC "%.3" "Ohms" COEFFS 0 1 0 0 0 1 /end COMPU_METHOD
/begin CHARACTERISTIC TFTgaseous_ohms "IOConfig # TFTgaseous_ohms" VAL_BLK 0x001E1968 /* @ECU_Address@TFTgaseous_ohms@0x021F1000@ */ ECIPP_ALIGNMENT_FLOAT32_IEEE 10000000000 Compu_TFTgaseous_ohms -10000000000 10000000000 MATRIX_DIM 16 1 1 /end CHARACTERISTIC
/begin COMPU_METHOD Compu_TFTgaseous_ohms " " RAT_FUNC "%.3" "Ohms" COEFFS 0 1 0 0 0 1 /end COMPU_METHOD
/begin CHARACTERISTIC TFTT_ohms "IOConfig # TFTT_ohms" VAL_BLK 0x001E1868 /* @ECU_Address@TFTT_ohms@0x021F2000@ */ ECIPP_ALIGNMENT_FLOAT32_IEEE 10000000000 Compu_TFTT_ohms -10000000000 10000000000 MATRIX_DIM 16 1 1 /end CHARACTERISTIC
/begin COMPU_METHOD Compu_TFTT_ohms " " RAT_FUNC "%.3" "Ohms" COEFFS 0 1 0 0 0 1 /end COMPU_METHOD
/begin CHARACTERISTIC TFST_ohms "IOConfig # TFST_ohms" VAL_BLK 0x001E17E8 /* @ECU_Address@TFST_ohms@0x021F3000@ */ ECIPP_ALIGNMENT_FLOAT32_IEEE 10000000000 Compu_TFST_ohms -10000000000 10000000000 MATRIX_DIM 16 1 1 /end CHARACTERISTIC
/begin COMPU_METHOD Compu_TFST_ohms " " RAT_FUNC "%.3" "Ohms" COEFFS 0 1 0 0 0 1 /end COMPU_METHOD
/begin CHARACTERISTIC TEMWT_ohms "IOConfig # TEMWT_ohms" VAL_BLK 0x001E1768 /* @ECU_Address@TEMWT_ohms@0x021F4000@ */ ECIPP_ALIGNMENT_FLOAT32_IEEE 10000000000 Compu_TEMWT_ohms -10000000000 10000000000 MATRIX_DIM 16 1 1 /end CHARACTERISTIC
/begin COMPU_METHOD Compu_TEMWT_ohms " " RAT_FUNC "%.3" "Ohms" COEFFS 0 1 0 0 0 1 /end COMPU_METHOD
/begin CHARACTERISTIC TUEGOB_Vheater "CL # TUEGOB_Vheater" VAL_BLK 0x001CA2F6 /* @ECU_Address@TUEGOB_Vheater@0x0222C000@ */ ECIPP_ALIGNMENT_SWORD 32 Compu_TUEGOB_Vheater -32 31.9990234375 MATRIX_DIM 16 1 1 /end CHARACTERISTIC
/begin COMPU_METHOD Compu_TUEGOB_Vheater " " RAT_FUNC "%.3" "Cmd (volts)" COEFFS 0 1024 0 0 0 1 /end COMPU_METHOD
/begin CHARACTERISTIC TUEGOB_Vheater_sec "CL # TUEGOB_Vheater_sec" VAL_BLK 0x001CA316 /* @ECU_Address@TUEGOB_Vheater_sec@0x02234000@ */ ECIPP_ALIGNMENT_SWORD 524 Compu_TUEGOB_Vheater_sec -524.288 524.272 MATRIX_DIM 16 1 1 /end CHARACTERISTIC
/begin COMPU_METHOD Compu_TUEGOB_Vheater_sec " " RAT_FUNC "%.3" "(seconds)" COEFFS 0 62.5 0 0 0 1 /end COMPU_METHOD
/begin CHARACTERISTIC KNKHst_Tbl_RPMdf "FaultConfig # KNKHst_Tbl_RPMdf" VAL_BLK 0x001ECD28 /* @ECU_Address@KNKHst_Tbl_RPMdf@0x02235000@ */ ECIPP_ALIGNMENT_UWORD 65535 Compu_KNKHst_Tbl_RPMdf 0 65535 MATRIX_DIM 6 1 1 /end CHARACTERISTIC
/begin COMPU_METHOD Compu_KNKHst_Tbl_RPMdf " " RAT_FUNC "%.0" "-" COEFFS 0 1 0 0 0 1 /end COMPU_METHOD
/begin CHARACTERISTIC KNKHst_Tbl_MAPdf "FaultConfig # KNKHst_Tbl_MAPdf" VAL_BLK 0x001ECD1C /* @ECU_Address@KNKHst_Tbl_MAPdf@0x02236000@ */ ECIPP_ALIGNMENT_UWORD 256 Compu_KNKHst_Tbl_MAPdf 0 255.99609375 MATRIX_DIM 6 1 1 /end CHARACTERISTIC
/begin COMPU_METHOD Compu_KNKHst_Tbl_MAPdf " " RAT_FUNC "%.3" "MAP load (psia)" COEFFS 0 256 0 0 0 1 /end COMPU_METHOD
/begin MEASUREMENT KNKHst_Tbl_RPM "General # KNKHst_Tbl_RPM" UWORD Compu_KNKHst_Tbl_RPM 0 0 0 65535 ECU_ADDRESS 0x02237000 MATRIX_DIM 6 1 1 /end MEASUREMENT
/begin COMPU_METHOD Compu_KNKHst_Tbl_RPM " " RAT_FUNC "%.0" "Speed (rpm)" COEFFS 0 1 0 0 0 1 /end COMPU_METHOD
/begin MEASUREMENT KNKHst_Tbl_MAP "General # KNKHst_Tbl_MAP" UWORD Compu_KNKHst_Tbl_MAP 0 0 0 255.99609375 ECU_ADDRESS 0x02238000 MATRIX_DIM 6 1 1 /end MEASUREMENT
/begin COMPU_METHOD Compu_KNKHst_Tbl_MAP " " RAT_FUNC "%.1" "MAP (psia)" COEFFS 0 256 0 0 0 1 /end COMPU_METHOD
/begin CHARACTERISTIC STR_Calibration_File "General # STR_Calibration_File" ASCII 0x001E6EC3 /* @ECU_Address@STR_Calibration_File@0x0223A000@ */ ECIPP_ALIGNMENT_UBYTE 255 Compu_ECIPP_STRINGS 0 255 MATRIX_DIM 199 1 1 /end CHARACTERISTIC
/begin CHARACTERISTIC STR_ECTgd_comment "General # STR_ECTgd_comment" ASCII 0x001E6F8B /* @ECU_Address@STR_ECTgd_comment@0x0223B000@ */ ECIPP_ALIGNMENT_UBYTE 255 Compu_ECIPP_STRINGS 0 255 MATRIX_DIM 39 1 1 /end CHARACTERISTIC
/begin CHARACTERISTIC STR_EGOCmt "General # STR_EGOCmt" ASCII 0x001E6FB3 /* @ECU_Address@STR_EGOCmt@0x0223C000@ */ ECIPP_ALIGNMENT_UBYTE 255 Compu_ECIPP_STRINGS 0 255 MATRIX_DIM 99 1 1 /end CHARACTERISTIC
/begin CHARACTERISTIC STR_EGOCmtNG "General # STR_EGOCmtNG" ASCII 0x001E7017 /* @ECU_Address@STR_EGOCmtNG@0x0223D000@ */ ECIPP_ALIGNMENT_UBYTE 255 Compu_ECIPP_STRINGS 0 255 MATRIX_DIM 99 1 1 /end CHARACTERISTIC
/begin CHARACTERISTIC STR_EGOCmtP "General # STR_EGOCmtP" ASCII 0x001E707B /* @ECU_Address@STR_EGOCmtP@0x0223E000@ */ ECIPP_ALIGNMENT_UBYTE 255 Compu_ECIPP_STRINGS 0 255 MATRIX_DIM 99 1 1 /end CHARACTERISTIC
/begin CHARACTERISTIC STR_Eng_Description "General # STR_Eng_Description" ASCII 0x001E70DF /* @ECU_Address@STR_Eng_Description@0x0223F000@ */ ECIPP_ALIGNMENT_UBYTE 255 Compu_ECIPP_STRINGS 0 255 MATRIX_DIM 199 1 1 /end CHARACTERISTIC
/begin CHARACTERISTIC STR_IgnAdvCmt "General # STR_IgnAdvCmt" ASCII 0x001E71BC /* @ECU_Address@STR_IgnAdvCmt@0x02240000@ */ ECIPP_ALIGNMENT_UBYTE 255 Compu_ECIPP_STRINGS 0 255 MATRIX_DIM 99 1 1 /end CHARACTERISTIC
/end MODULE
/end PROJECT
