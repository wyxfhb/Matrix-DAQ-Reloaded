ASAP2_VERSION 1 61
/begin PROJECT Econtrols_4G "4G Test"
/begin HEADER "4G A2L Configuration" PROJECT_NO EControls4G /* config for version control */ VERSION "$Revision: 82130 $:" /* config for version control */ /end HEADER
/begin MODULE EControls_4G_SH2A "EControls 4G"
/begin MOD_COMMON "" DEPOSIT ABSOLUTE BYTE_ORDER MSB_FIRST /end MOD_COMMON
/* Define the Record Layouts */
/begin RECORD_LAYOUT ECIPP_ALIGNMENT_UBYTE FNC_VALUES 1 UBYTE COLUMN_DIR DIRECT /end RECORD_LAYOUT
/begin RECORD_LAYOUT ECIPP_ALIGNMENT_UWORD FNC_VALUES 1 UWORD COLUMN_DIR DIRECT /end RECORD_LAYOUT
/begin RECORD_LAYOUT ECIPP_ALIGNMENT_SWORD FNC_VALUES 1 SWORD COLUMN_DIR DIRECT /end RECORD_LAYOUT
/begin RECORD_LAYOUT ECIPP_Lookup_SWORD AXIS_PTS_X 1 SWORD INDEX_INCR DIRECT /end RECORD_LAYOUT
/begin RECORD_LAYOUT ECIPP_ALIGNMENT_ULONG FNC_VALUES 1 ULONG COLUMN_DIR DIRECT /end RECORD_LAYOUT
/begin RECORD_LAYOUT ECIPP_ALIGNMENT_FLOAT32_IEEE FNC_VALUES 1 FLOAT32_IEEE COLUMN_DIR DIRECT /end RECORD_LAYOUT
/begin MEASUREMENT TFBdt "TFBdt" SWORD Compu_TFBdt 0 0 -12500 12499.6185302734 ECU_ADDRESS 0x010000B0 /end MEASUREMENT
/begin COMPU_METHOD Compu_TFBdt " " RAT_FUNC "%.1" "%/sec" COEFFS 0 2.62144 0 0 0 1 /end COMPU_METHOD
/begin MEASUREMENT TPS1_rawfilt "TPS1_rawfilt" UWORD Compu_TPS1_rawfilt 0 0 0 5.00114468864469 ECU_ADDRESS 0x010000B8 /end MEASUREMENT
/begin COMPU_METHOD Compu_TPS1_rawfilt " " RAT_FUNC "%.3" "volts" COEFFS 0 13104 0 0 0 1 /end COMPU_METHOD
/begin MEASUREMENT TPS2_rawfilt "TPS2_rawfilt" UWORD Compu_TPS2_rawfilt 0 0 0 5.00114468864469 ECU_ADDRESS 0x010000C0 /end MEASUREMENT
/begin COMPU_METHOD Compu_TPS2_rawfilt " " RAT_FUNC "%.3" "volts" COEFFS 0 13104 0 0 0 1 /end COMPU_METHOD
/begin MEASUREMENT FPP1_rawfilt "FPP1_rawfilt" UWORD Compu_FPP1_rawfilt 0 0 0 5.00114468864469 ECU_ADDRESS 0x010000C8 /end MEASUREMENT
/begin COMPU_METHOD Compu_FPP1_rawfilt " " RAT_FUNC "%.3" "volts" COEFFS 0 13104 0 0 0 1 /end COMPU_METHOD
/begin MEASUREMENT FPP2_rawfilt "FPP2_rawfilt" UWORD Compu_FPP2_rawfilt 0 0 0 5.00114468864469 ECU_ADDRESS 0x010000D0 /end MEASUREMENT
/begin COMPU_METHOD Compu_FPP2_rawfilt " " RAT_FUNC "%.3" "volts" COEFFS 0 13104 0 0 0 1 /end COMPU_METHOD
/begin MEASUREMENT FPP1_pct "FPP1_pct" UWORD Compu_FPP1_pct 0 0 0 99.9984741210938 ECU_ADDRESS 0x01000188 /end MEASUREMENT
/begin COMPU_METHOD Compu_FPP1_pct " " RAT_FUNC "%.1" "%" COEFFS 0 655.36 0 0 0 1 /end COMPU_METHOD
/begin MEASUREMENT FPP2_pct "FPP2_pct" UWORD Compu_FPP2_pct 0 0 0 99.9984741210938 ECU_ADDRESS 0x01000190 /end MEASUREMENT
/begin COMPU_METHOD Compu_FPP2_pct " " RAT_FUNC "%.1" "%" COEFFS 0 655.36 0 0 0 1 /end COMPU_METHOD
/begin MEASUREMENT TPS1_pct "TPS1_pct" UWORD Compu_TPS1_pct 0 0 0 99.9984741210938 ECU_ADDRESS 0x01000198 /end MEASUREMENT
/begin COMPU_METHOD Compu_TPS1_pct " " RAT_FUNC "%.1" "%" COEFFS 0 655.36 0 0 0 1 /end COMPU_METHOD
/begin MEASUREMENT TPS2_pct "TPS2_pct" UWORD Compu_TPS2_pct 0 0 0 99.9984741210938 ECU_ADDRESS 0x010001A0 /end MEASUREMENT
/begin COMPU_METHOD Compu_TPS2_pct " " RAT_FUNC "%.1" "%" COEFFS 0 655.36 0 0 0 1 /end COMPU_METHOD
/begin MEASUREMENT FPP_cmd_pct "FPP_cmd_pct" UWORD Compu_FPP_cmd_pct 0 0 0 99.9984741210938 ECU_ADDRESS 0x010001B0 /end MEASUREMENT
/begin COMPU_METHOD Compu_FPP_cmd_pct " " RAT_FUNC "%.1" "%" COEFFS 0 655.36 0 0 0 1 /end COMPU_METHOD
/begin MEASUREMENT TPS_cmd_pct "TPS_cmd_pct" UWORD Compu_TPS_cmd_pct 0 0 0 99.9984741210938 ECU_ADDRESS 0x010001C0 /end MEASUREMENT
/begin COMPU_METHOD Compu_TPS_cmd_pct " " RAT_FUNC "%.1" "%" COEFFS 0 655.36 0 0 0 1 /end COMPU_METHOD
/begin MEASUREMENT TPS_cmd_AD "TPS_cmd_AD" UWORD Compu_TPS_cmd_AD 0 0 0 5.00114468864469 ECU_ADDRESS 0x010001C8 /end MEASUREMENT
/begin COMPU_METHOD Compu_TPS_cmd_AD " " RAT_FUNC "%.3" "volts" COEFFS 0 13104 0 0 0 1 /end COMPU_METHOD
/begin MEASUREMENT DBW_ctl_cmd "DBW_ctl_cmd" SWORD Compu_DBW_ctl_cmd 0 0 -100 99.9969482421875 ECU_ADDRESS 0x01000298 /end MEASUREMENT
/begin COMPU_METHOD Compu_DBW_ctl_cmd " " RAT_FUNC "%.1" "%" COEFFS 0 327.68 0 0 0 1 /end COMPU_METHOD
/begin MEASUREMENT FSO_retard "Start/FSO Retard" SWORD Compu_FSO_retard 0 0 -2048 2047.9375 ECU_ADDRESS 0x010002F8 /end MEASUREMENT
/begin COMPU_METHOD Compu_FSO_retard " " RAT_FUNC "%.1" "CAD ret" COEFFS 0 16 0 0 0 1 /end COMPU_METHOD
/begin MEASUREMENT TPS_MinMAP_pct "Min-MAP TPS command" UWORD Compu_TPS_MinMAP_pct 0 0 0 99.9984741210938 ECU_ADDRESS 0x01000340 /end MEASUREMENT
/begin COMPU_METHOD Compu_TPS_MinMAP_pct " " RAT_FUNC "%.1" "%TPS" COEFFS 0 655.36 0 0 0 1 /end COMPU_METHOD
/begin MEASUREMENT MinMAP_psd "Min-MAP pseudo" UWORD Compu_MinMAP_psd 0 0 0 255.99609375 ECU_ADDRESS 0x01000350 /end MEASUREMENT
/begin COMPU_METHOD Compu_MinMAP_psd " " RAT_FUNC "%.2" "psia" COEFFS 0 256 0 0 0 1 /end COMPU_METHOD
/begin MEASUREMENT FPP_cmd_final "FPP_cmd_final" UWORD Compu_FPP_cmd_final 0 0 0 99.9984741210938 ECU_ADDRESS 0x010004F0 /end MEASUREMENT
/begin COMPU_METHOD Compu_FPP_cmd_final " " RAT_FUNC "%.1" "%" COEFFS 0 655.36 0 0 0 1 /end COMPU_METHOD
/begin CHARACTERISTIC Kp_TFB "Kp_TFB" VALUE 0x001C9C48 /* @ECU_Address@Kp_TFB@0x01000880@ */ ECIPP_ALIGNMENT_SWORD 64 Compu_Kp_TFB -64 63.998046875 /end CHARACTERISTIC
/begin COMPU_METHOD Compu_Kp_TFB " " RAT_FUNC "%.1" "% / %" COEFFS 0 512 0 0 0 1 /end COMPU_METHOD
/begin CHARACTERISTIC Ki_TFB "Ki_TFB" VALUE 0x001C9C4C /* @ECU_Address@Ki_TFB@0x01000888@ */ ECIPP_ALIGNMENT_SWORD 2000 Compu_Ki_TFB -2000 1999.93896484375 /end CHARACTERISTIC
/begin COMPU_METHOD Compu_Ki_TFB " " RAT_FUNC "%.1" "% / % / sec" COEFFS 0 16.384 0 0 0 1 /end COMPU_METHOD
/begin CHARACTERISTIC Kd_TFB "Kd_TFB" VALUE 0x001C9C4E /* @ECU_Address@Kd_TFB@0x01000890@ */ ECIPP_ALIGNMENT_SWORD 1 Compu_Kd_TFB -1.024 1.02396875 /end CHARACTERISTIC
/begin COMPU_METHOD Compu_Kd_TFB " " RAT_FUNC "%.3" "% / % * sec" COEFFS 0 32000 0 0 0 1 /end COMPU_METHOD
/begin CHARACTERISTIC I_TFB_min "I_TFB_min" VALUE 0x001C9C52 /* @ECU_Address@I_TFB_min@0x01000898@ */ ECIPP_ALIGNMENT_SWORD 25599 Compu_I_TFB_min -25600 25599.21875 /end CHARACTERISTIC
/begin COMPU_METHOD Compu_I_TFB_min " " RAT_FUNC "%.0" "%" COEFFS 0 1.28 0 0 0 1 /end COMPU_METHOD
/begin CHARACTERISTIC I_TFB_max "I_TFB_max" VALUE 0x001C9C54 /* @ECU_Address@I_TFB_max@0x010008A0@ */ ECIPP_ALIGNMENT_SWORD 25599 Compu_I_TFB_max -25600 25599.21875 /end CHARACTERISTIC
/begin COMPU_METHOD Compu_I_TFB_max " " RAT_FUNC "%.0" "%" COEFFS 0 1.28 0 0 0 1 /end COMPU_METHOD
/begin CHARACTERISTIC I_TFBdt_frz "I_TFBdt_frz" VALUE 0x001C9C56 /* @ECU_Address@I_TFBdt_frz@0x010008A8@ */ ECIPP_ALIGNMENT_SWORD 12500 Compu_I_TFBdt_frz -12500 12499.6185302734 /end CHARACTERISTIC
/begin COMPU_METHOD Compu_I_TFBdt_frz " " RAT_FUNC "%.1" "% / sec" COEFFS 0 2.62144 0 0 0 1 /end COMPU_METHOD
/begin CHARACTERISTIC DBW_ctl_min "DBW_ctl_min" VALUE 0x001C9C58 /* @ECU_Address@DBW_ctl_min@0x010008B0@ */ ECIPP_ALIGNMENT_SWORD 25599 Compu_DBW_ctl_min -25600 25599.21875 /end CHARACTERISTIC
/begin COMPU_METHOD Compu_DBW_ctl_min " " RAT_FUNC "%.0" "%" COEFFS 0 1.28 0 0 0 1 /end COMPU_METHOD
/begin CHARACTERISTIC DBW_ctl_max "DBW_ctl_max" VALUE 0x001C9C5A /* @ECU_Address@DBW_ctl_max@0x010008B8@ */ ECIPP_ALIGNMENT_SWORD 25599 Compu_DBW_ctl_max -25600 25599.21875 /end CHARACTERISTIC
/begin COMPU_METHOD Compu_DBW_ctl_max " " RAT_FUNC "%.0" "%" COEFFS 0 1.28 0 0 0 1 /end COMPU_METHOD
/begin MEASUREMENT FPP1_idle "FPP1_idle" UWORD Compu_FPP1_idle 0 0 0 5.00114468864469 ECU_ADDRESS 0x010008C8 /end MEASUREMENT
/begin COMPU_METHOD Compu_FPP1_idle " " RAT_FUNC "%.3" "volts" COEFFS 0 13104 0 0 0 1 /end COMPU_METHOD
/begin MEASUREMENT FPP1_full "FPP1_full" UWORD Compu_FPP1_full 0 0 0 5.00114468864469 ECU_ADDRESS 0x010008D0 /end MEASUREMENT
/begin COMPU_METHOD Compu_FPP1_full " " RAT_FUNC "%.3" "volts" COEFFS 0 13104 0 0 0 1 /end COMPU_METHOD
/begin MEASUREMENT FPP2_idle "FPP2_idle" UWORD Compu_FPP2_idle 0 0 0 5.00114468864469 ECU_ADDRESS 0x010008D8 /end MEASUREMENT
/begin COMPU_METHOD Compu_FPP2_idle " " RAT_FUNC "%.3" "volts" COEFFS 0 13104 0 0 0 1 /end COMPU_METHOD
/begin MEASUREMENT FPP2_full "FPP2_full" UWORD Compu_FPP2_full 0 0 0 5.00114468864469 ECU_ADDRESS 0x010008E0 /end MEASUREMENT
/begin COMPU_METHOD Compu_FPP2_full " " RAT_FUNC "%.3" "volts" COEFFS 0 13104 0 0 0 1 /end COMPU_METHOD
/begin MEASUREMENT TPS1_idle "TPS1_idle" UWORD Compu_TPS1_idle 0 0 0 5.00114468864469 ECU_ADDRESS 0x010008E8 /end MEASUREMENT
/begin COMPU_METHOD Compu_TPS1_idle " " RAT_FUNC "%.3" "volts" COEFFS 0 13104 0 0 0 1 /end COMPU_METHOD
/begin MEASUREMENT TPS1_full "TPS1_full" UWORD Compu_TPS1_full 0 0 0 5.00114468864469 ECU_ADDRESS 0x010008F0 /end MEASUREMENT
/begin COMPU_METHOD Compu_TPS1_full " " RAT_FUNC "%.3" "volts" COEFFS 0 13104 0 0 0 1 /end COMPU_METHOD
/begin MEASUREMENT TPS2_idle "TPS2_idle" UWORD Compu_TPS2_idle 0 0 0 5.00114468864469 ECU_ADDRESS 0x010008F8 /end MEASUREMENT
/begin COMPU_METHOD Compu_TPS2_idle " " RAT_FUNC "%.3" "volts" COEFFS 0 13104 0 0 0 1 /end COMPU_METHOD
/begin MEASUREMENT TPS2_full "TPS2_full" UWORD Compu_TPS2_full 0 0 0 5.00114468864469 ECU_ADDRESS 0x01000900 /end MEASUREMENT
/begin COMPU_METHOD Compu_TPS2_full " " RAT_FUNC "%.3" "volts" COEFFS 0 13104 0 0 0 1 /end COMPU_METHOD
/begin CHARACTERISTIC FPPdp_max "FPP dashpot max" VALUE 0x001c6fb2 /* @ECU_Address@FPPdp_max@0x01000AA8@ */ ECIPP_ALIGNMENT_UWORD 100 Compu_FPPdp_max 0 99.9984741210938 /end CHARACTERISTIC
/begin COMPU_METHOD Compu_FPPdp_max " " RAT_FUNC "%.1" "%" COEFFS 0 655.36 0 0 0 1 /end COMPU_METHOD
/begin CHARACTERISTIC FPPdp_dcy "FPP dashpot decay" VALUE 0x001c6fb0 /* @ECU_Address@FPPdp_dcy@0x01000AB0@ */ ECIPP_ALIGNMENT_UWORD 2 Compu_FPPdp_dcy 0 1.52585562318563 /end CHARACTERISTIC
/begin COMPU_METHOD Compu_FPPdp_dcy " " RAT_FUNC "%.1" "% / sec" COEFFS 0 42949.67296 0 0 0 1 /end COMPU_METHOD
/begin CHARACTERISTIC FSO_ena "FSO control{FSO_ena&0xff=0x00:Disabled}{FSO_ena&0xff=0x01:Enabled - FPP Only}{FSO_ena&0xff=0x02:Enabled - UEGO Cal Only}{FSO_ena&0xff=0x03:Enabled - FPP and Gov3}" VALUE 0x001c8739 /* @ECU_Address@FSO_ena@0x01000AC0@ */ ECIPP_ALIGNMENT_UBYTE 255 FSO_ena_COMPU_VTAB 0 255 BIT_MASK 0xff /end CHARACTERISTIC
/begin COMPU_METHOD FSO_ena_COMPU_VTAB "Verbal Table" TAB_VERB "%.0" "list" COMPU_TAB_REF FSO_ena_COMPU_VTAB_REF /end COMPU_METHOD
/begin COMPU_VTAB FSO_ena_COMPU_VTAB_REF "Verbal Table" TAB_VERB 4 0x00 "Disabled" 0x01 "Enabled - FPP Only" 0x02 "Enabled - UEGO Cal Only" 0x03 "Enabled - FPP and Gov3" DEFAULT_VALUE "UNKNOWN" /end COMPU_VTAB
/begin CHARACTERISTIC FSO_idle_off "FSO idle relative lockout" VALUE 0x001c7b4e /* @ECU_Address@FSO_idle_off@0x01000AC8@ */ ECIPP_ALIGNMENT_UWORD 65535 Compu_FSO_idle_off 0 65535 /end CHARACTERISTIC
/begin COMPU_METHOD Compu_FSO_idle_off " " RAT_FUNC "%.0" "rpm" COEFFS 0 1 0 0 0 1 /end COMPU_METHOD
/begin CHARACTERISTIC FSO_TPSmin "FSO throttle open position" VALUE 0x001c7b42 /* @ECU_Address@FSO_TPSmin@0x01000AD0@ */ ECIPP_ALIGNMENT_UWORD 100 Compu_FSO_TPSmin 0 99.9984741210938 /end CHARACTERISTIC
/begin COMPU_METHOD Compu_FSO_TPSmin " " RAT_FUNC "%.1" "%" COEFFS 0 655.36 0 0 0 1 /end COMPU_METHOD
/begin CHARACTERISTIC FSO_rpm_low "FSO disengage speed" VALUE 0x001c7b60 /* @ECU_Address@FSO_rpm_low@0x01000AD8@ */ ECIPP_ALIGNMENT_UWORD 65535 Compu_FSO_rpm_low 0 65535 /end CHARACTERISTIC
/begin COMPU_METHOD Compu_FSO_rpm_low " " RAT_FUNC "%.0" "rpm" COEFFS 0 1 0 0 0 1 /end COMPU_METHOD
/begin CHARACTERISTIC FSO_rpm_high "FSO engage speed" VALUE 0x001c7b5e /* @ECU_Address@FSO_rpm_high@0x01000AE0@ */ ECIPP_ALIGNMENT_UWORD 65535 Compu_FSO_rpm_high 0 65535 /end CHARACTERISTIC
/begin COMPU_METHOD Compu_FSO_rpm_high " " RAT_FUNC "%.0" "rpm" COEFFS 0 1 0 0 0 1 /end COMPU_METHOD
/begin CHARACTERISTIC FSO_rpm_TPSoff "FSO throttle open speed" VALUE 0x001c7b5c /* @ECU_Address@FSO_rpm_TPSoff@0x01000AE8@ */ ECIPP_ALIGNMENT_UWORD 65535 Compu_FSO_rpm_TPSoff 0 65535 /end CHARACTERISTIC
/begin COMPU_METHOD Compu_FSO_rpm_TPSoff " " RAT_FUNC "%.0" "rpm" COEFFS 0 1 0 0 0 1 /end COMPU_METHOD
/begin CHARACTERISTIC FSO_MAP "MAP FSO engage" VALUE 0x001c7b34 /* @ECU_Address@FSO_MAP@0x01000AF0@ */ ECIPP_ALIGNMENT_UWORD 256 Compu_FSO_MAP 0 255.99609375 /end CHARACTERISTIC
/begin COMPU_METHOD Compu_FSO_MAP " " RAT_FUNC "%.2" "psia" COEFFS 0 256 0 0 0 1 /end COMPU_METHOD
/begin CHARACTERISTIC FSO_ECT_lockout "FSO cold ECT lockout" VALUE 0x001c7b28 /* @ECU_Address@FSO_ECT_lockout@0x01000B08@ */ ECIPP_ALIGNMENT_UWORD 564 Compu_FSO_ECT_lockout -460 563.984375 /end CHARACTERISTIC
/begin COMPU_METHOD Compu_FSO_ECT_lockout " " RAT_FUNC "%.1" "deg F" COEFFS 0 64 29440 0 0 1 /end COMPU_METHOD
/begin CHARACTERISTIC FPPslew_max_lo "Low FPP maximum slew rate" VALUE 0x001c6fbe /* @ECU_Address@FPPslew_max_lo@0x01000B10@ */ ECIPP_ALIGNMENT_UWORD 99998 Compu_FPPslew_max_lo 0 99998.4741210938 /end CHARACTERISTIC
/begin COMPU_METHOD Compu_FPPslew_max_lo " " RAT_FUNC "%.1" "% / sec" COEFFS 0 0.65536 0 0 0 1 /end COMPU_METHOD
/begin CHARACTERISTIC FPPslew_max_hi "High FPP maximum slew rate" VALUE 0x001c6fbc /* @ECU_Address@FPPslew_max_hi@0x01000B18@ */ ECIPP_ALIGNMENT_UWORD 99998 Compu_FPPslew_max_hi 0 99998.4741210938 /end CHARACTERISTIC
/begin COMPU_METHOD Compu_FPPslew_max_hi " " RAT_FUNC "%.1" "% / sec" COEFFS 0 0.65536 0 0 0 1 /end COMPU_METHOD
/begin CHARACTERISTIC Kp_clo_TFB "Kp_TFB closing offset" VALUE 0x001C9C4A /* @ECU_Address@Kp_clo_TFB@0x01000B98@ */ ECIPP_ALIGNMENT_SWORD 64 Compu_Kp_clo_TFB -64 63.998046875 /end CHARACTERISTIC
/begin COMPU_METHOD Compu_Kp_clo_TFB " " RAT_FUNC "%.1" "% / %" COEFFS 0 512 0 0 0 1 /end COMPU_METHOD
/begin CHARACTERISTIC Kd_clo_TFB "Kd_TFB closing offset" VALUE 0x001C9C50 /* @ECU_Address@Kd_clo_TFB@0x01000BA0@ */ ECIPP_ALIGNMENT_SWORD 1 Compu_Kd_clo_TFB -1.024 1.02396875 /end CHARACTERISTIC
/begin COMPU_METHOD Compu_Kd_clo_TFB " " RAT_FUNC "%.3" "% / % * sec" COEFFS 0 32000 0 0 0 1 /end COMPU_METHOD
/begin CHARACTERISTIC FPP_mode "Primary foot pedal mode{FPP_mode&0xff=0:Disabled}{FPP_mode&0xff=1:Throttle Control}{FPP_mode&0xff=2:Speed Control}{FPP_mode&0xff=3:IVS Only}{FPP_mode&0xff=4:Network Throttle}{FPP_mode&0xff=5:Network Allspeed}" VALUE 0x001c8724 /* @ECU_Address@FPP_mode@0x01000F20@ */ ECIPP_ALIGNMENT_UBYTE 255 FPP_mode_COMPU_VTAB 0 255 BIT_MASK 0xff /end CHARACTERISTIC
/begin COMPU_METHOD FPP_mode_COMPU_VTAB "Verbal Table" TAB_VERB "%.0" "list" COMPU_TAB_REF FPP_mode_COMPU_VTAB_REF /end COMPU_METHOD
/begin COMPU_VTAB FPP_mode_COMPU_VTAB_REF "Verbal Table" TAB_VERB 6 0 "Disabled" 1 "Throttle Control" 2 "Speed Control" 3 "IVS Only" 4 "Network Throttle" 5 "Network Allspeed" DEFAULT_VALUE "UNKNOWN" /end COMPU_VTAB
/begin CHARACTERISTIC MinMAP_ena "Min-MAP control{MinMAP_ena&0xff=0x00:Disabled}{MinMAP_ena&0xff=0x01:Enabled}" VALUE 0x001c884b /* @ECU_Address@MinMAP_ena@0x01000F88@ */ ECIPP_ALIGNMENT_UBYTE 255 MinMAP_ena_COMPU_VTAB 0 255 BIT_MASK 0xff /end CHARACTERISTIC
/begin COMPU_METHOD MinMAP_ena_COMPU_VTAB "Verbal Table" TAB_VERB "%.0" "list" COMPU_TAB_REF MinMAP_ena_COMPU_VTAB_REF /end COMPU_METHOD
/begin COMPU_VTAB MinMAP_ena_COMPU_VTAB_REF "Verbal Table" TAB_VERB 2 0x00 "Disabled" 0x01 "Enabled" DEFAULT_VALUE "UNKNOWN" /end COMPU_VTAB
/begin CHARACTERISTIC MinMAP_target "Min-MAP target" VALUE 0x001c7dee /* @ECU_Address@MinMAP_target@0x01000F90@ */ ECIPP_ALIGNMENT_UWORD 256 Compu_MinMAP_target 0 255.99609375 /end CHARACTERISTIC
/begin COMPU_METHOD Compu_MinMAP_target " " RAT_FUNC "%.2" "psia" COEFFS 0 256 0 0 0 1 /end COMPU_METHOD
/begin CHARACTERISTIC MinMAP_slew "Min-MAP slew limit" VALUE 0x001c7dec /* @ECU_Address@MinMAP_slew@0x01000F98@ */ ECIPP_ALIGNMENT_UWORD 62 Compu_MinMAP_slew 0 62.4990463256836 /end CHARACTERISTIC
/begin COMPU_METHOD Compu_MinMAP_slew " " RAT_FUNC "%.2" "psi/sec" COEFFS 0 1048.576 0 0 0 1 /end COMPU_METHOD
/begin CHARACTERISTIC MinMAP_maxTPS "Min-MAP TPS authority" VALUE 0x001c7dea /* @ECU_Address@MinMAP_maxTPS@0x01000FA0@ */ ECIPP_ALIGNMENT_UWORD 100 Compu_MinMAP_maxTPS 0 99.9984741210938 /end CHARACTERISTIC
/begin COMPU_METHOD Compu_MinMAP_maxTPS " " RAT_FUNC "%.1" "%TPS" COEFFS 0 655.36 0 0 0 1 /end COMPU_METHOD
/begin CHARACTERISTIC Ki_MinMAP "Min-MAP Ki" VALUE 0x001c4528 /* @ECU_Address@Ki_MinMAP@0x01000FA8@ */ ECIPP_ALIGNMENT_SWORD 31 Compu_Ki_MinMAP -31.25 31.2490463256836 /end CHARACTERISTIC
/begin COMPU_METHOD Compu_Ki_MinMAP " " RAT_FUNC "%.2" "psi/psi/sec" COEFFS 0 1048.576 0 0 0 1 /end COMPU_METHOD
/begin MEASUREMENT IVS_volt "IVS voltage" UBYTE Compu_IVS_volt 0 0 0 31.875 ECU_ADDRESS 0x010012A0 /end MEASUREMENT
/begin COMPU_METHOD Compu_IVS_volt " " RAT_FUNC "%.1" "volts" COEFFS 0 8 0 0 0 1 /end COMPU_METHOD
/begin CHARACTERISTIC FPPIVS_ena "IVS pedal configuration{FPPIVS_ena&0xff=0x00:Disabled}{FPPIVS_ena&0xff=0x01:Enabled - Gnd=Idle}{FPPIVS_ena&0xff=0x02:Enabled - Open=Idle}{FPPIVS_ena&0xff=0x03:Enabled - Network}" VALUE 0x001c8719 /* @ECU_Address@FPPIVS_ena@0x010012F0@ */ ECIPP_ALIGNMENT_UBYTE 255 FPPIVS_ena_COMPU_VTAB 0 255 BIT_MASK 0xff /end CHARACTERISTIC
/begin COMPU_METHOD FPPIVS_ena_COMPU_VTAB "Verbal Table" TAB_VERB "%.0" "list" COMPU_TAB_REF FPPIVS_ena_COMPU_VTAB_REF /end COMPU_METHOD
/begin COMPU_VTAB FPPIVS_ena_COMPU_VTAB_REF "Verbal Table" TAB_VERB 4 0x00 "Disabled" 0x01 "Enabled - Gnd=Idle" 0x02 "Enabled - Open=Idle" 0x03 "Enabled - Network" DEFAULT_VALUE "UNKNOWN" /end COMPU_VTAB
/begin MEASUREMENT flag4_ACTIVE_FPP "Active FPP source{flag4_ACTIVE_FPP&0x08=0x00:FPP1}{flag4_ACTIVE_FPP&0x08=0x08:FPP2}" UBYTE flag4_ACTIVE_FPP_COMPU_VTAB 0 0 0 255 ECU_ADDRESS 0x010012F8 BIT_MASK 0x08 /end MEASUREMENT
/begin COMPU_METHOD flag4_ACTIVE_FPP_COMPU_VTAB "Verbal Table" TAB_VERB "%.0" "list" COMPU_TAB_REF flag4_ACTIVE_FPP_COMPU_VTAB_REF /end COMPU_METHOD
/begin COMPU_VTAB flag4_ACTIVE_FPP_COMPU_VTAB_REF "Verbal Table" TAB_VERB 2 0x00 "FPP1" 0x08 "FPP2" DEFAULT_VALUE "UNKNOWN" /end COMPU_VTAB
/begin MEASUREMENT flag2_IVS_AT_IDLE "IVS state{flag2_IVS_AT_IDLE&0x20=0x00:Off Idle}{flag2_IVS_AT_IDLE&0x20=0x20:At Idle}" UBYTE flag2_IVS_AT_IDLE_COMPU_VTAB 0 0 0 255 ECU_ADDRESS 0x01001300 BIT_MASK 0x20 /end MEASUREMENT
/begin COMPU_METHOD flag2_IVS_AT_IDLE_COMPU_VTAB "Verbal Table" TAB_VERB "%.0" "list" COMPU_TAB_REF flag2_IVS_AT_IDLE_COMPU_VTAB_REF /end COMPU_METHOD
/begin COMPU_VTAB flag2_IVS_AT_IDLE_COMPU_VTAB_REF "Verbal Table" TAB_VERB 2 0x00 "Off Idle" 0x20 "At Idle" DEFAULT_VALUE "UNKNOWN" /end COMPU_VTAB
/begin MEASUREMENT DBW_test_ena "DBW test mode{DBW_test_ena&0xff=0x00:Off}{DBW_test_ena&0xff=0x01:Enabled}" UBYTE DBW_test_ena_COMPU_VTAB 0 0 0 255 ECU_ADDRESS 0x01001380 BIT_MASK 0xff /end MEASUREMENT
/begin COMPU_METHOD DBW_test_ena_COMPU_VTAB "Verbal Table" TAB_VERB "%.0" "list" COMPU_TAB_REF DBW_test_ena_COMPU_VTAB_REF /end COMPU_METHOD
/begin COMPU_VTAB DBW_test_ena_COMPU_VTAB_REF "Verbal Table" TAB_VERB 2 0x00 "Off" 0x01 "Enabled" DEFAULT_VALUE "UNKNOWN" /end COMPU_VTAB
/begin CHARACTERISTIC FPP2_mode "Secondary foot pedal mode{FPP2_mode&0xff=0x00:Disabled}{FPP2_mode&0xff=0x01:Throttle Control}{FPP2_mode&0xff=0x02:Speed Control}" VALUE 0x001c8715 /* @ECU_Address@FPP2_mode@0x01001690@ */ ECIPP_ALIGNMENT_UBYTE 255 FPP2_mode_COMPU_VTAB 0 255 BIT_MASK 0xff /end CHARACTERISTIC
/begin COMPU_METHOD FPP2_mode_COMPU_VTAB "Verbal Table" TAB_VERB "%.0" "list" COMPU_TAB_REF FPP2_mode_COMPU_VTAB_REF /end COMPU_METHOD
/begin COMPU_VTAB FPP2_mode_COMPU_VTAB_REF "Verbal Table" TAB_VERB 3 0x00 "Disabled" 0x01 "Throttle Control" 0x02 "Speed Control" DEFAULT_VALUE "UNKNOWN" /end COMPU_VTAB
/begin MEASUREMENT active_FPP_mode "Active foot pedal mode{active_FPP_mode&0xff=0:Disabled}{active_FPP_mode&0xff=1:Throttle Control}{active_FPP_mode&0xff=2:Speed Control}{active_FPP_mode&0xff=3:IVS Only}{active_FPP_mode&0xff=4:Network Throttle}{active_FPP_mode&0xff=5:Network Allspeed}" UBYTE active_FPP_mode_COMPU_VTAB 0 0 0 255 ECU_ADDRESS 0x01001698 BIT_MASK 0xff /end MEASUREMENT
/begin COMPU_METHOD active_FPP_mode_COMPU_VTAB "Verbal Table" TAB_VERB "%.0" "list" COMPU_TAB_REF active_FPP_mode_COMPU_VTAB_REF /end COMPU_METHOD
/begin COMPU_VTAB active_FPP_mode_COMPU_VTAB_REF "Verbal Table" TAB_VERB 6 0 "Disabled" 1 "Throttle Control" 2 "Speed Control" 3 "IVS Only" 4 "Network Throttle" 5 "Network Allspeed" DEFAULT_VALUE "UNKNOWN" /end COMPU_VTAB
/begin CHARACTERISTIC FPPdual_pedal "Second foot pedal control{FPPdual_pedal&0xff=0x00:Disabled}{FPPdual_pedal&0xff=0x01:Enabled BRAKE=FPP2}{FPPdual_pedal&0xff=0x02:Enabled BRAKE=FPP max}{FPPdual_pedal&0xff=0x03:Enabled input=FPP2}" VALUE 0x001c8727 /* @ECU_Address@FPPdual_pedal@0x010016A0@ */ ECIPP_ALIGNMENT_UBYTE 255 FPPdual_pedal_COMPU_VTAB 0 255 BIT_MASK 0xff /end CHARACTERISTIC
/begin COMPU_METHOD FPPdual_pedal_COMPU_VTAB "Verbal Table" TAB_VERB "%.0" "list" COMPU_TAB_REF FPPdual_pedal_COMPU_VTAB_REF /end COMPU_METHOD
/begin COMPU_VTAB FPPdual_pedal_COMPU_VTAB_REF "Verbal Table" TAB_VERB 4 0x00 "Disabled" 0x01 "Enabled BRAKE=FPP2" 0x02 "Enabled BRAKE=FPP max" 0x03 "Enabled input=FPP2" DEFAULT_VALUE "UNKNOWN" /end COMPU_VTAB
/begin CHARACTERISTIC FPP_idle_valid "FPP idle valid (default)" VALUE 0x001c6f94 /* @ECU_Address@FPP_idle_valid@0x01001930@ */ ECIPP_ALIGNMENT_UWORD 100 Compu_FPP_idle_valid 0 99.9984741210938 /end CHARACTERISTIC
/begin COMPU_METHOD Compu_FPP_idle_valid " " RAT_FUNC "%.1" "%" COEFFS 0 655.36 0 0 0 1 /end COMPU_METHOD
/begin CHARACTERISTIC FPP_full_valid "FPP full validation" VALUE 0x001c6f92 /* @ECU_Address@FPP_full_valid@0x01001938@ */ ECIPP_ALIGNMENT_UWORD 100 Compu_FPP_full_valid 0 99.9984741210938 /end CHARACTERISTIC
/begin COMPU_METHOD Compu_FPP_full_valid " " RAT_FUNC "%.1" "%" COEFFS 0 655.36 0 0 0 1 /end COMPU_METHOD
/begin MEASUREMENT FPPatidle_mode "FPP1 @idle checking state{FPPatidle_mode&0xff=0:Disabled}{FPPatidle_mode&0xff=1:Init1}{FPPatidle_mode&0xff=2:Init2}{FPPatidle_mode&0xff=3:Enabled}" UBYTE FPPatidle_mode_COMPU_VTAB 0 0 0 255 ECU_ADDRESS 0x01001950 BIT_MASK 0xff /end MEASUREMENT
/begin COMPU_METHOD FPPatidle_mode_COMPU_VTAB "Verbal Table" TAB_VERB "%.0" "list" COMPU_TAB_REF FPPatidle_mode_COMPU_VTAB_REF /end COMPU_METHOD
/begin COMPU_VTAB FPPatidle_mode_COMPU_VTAB_REF "Verbal Table" TAB_VERB 4 0 "Disabled" 1 "Init1" 2 "Init2" 3 "Enabled" DEFAULT_VALUE "UNKNOWN" /end COMPU_VTAB
/begin CHARACTERISTIC FSO_MAP_hyst "MAP FSO hysteresis delta" VALUE 0x001c7b36 /* @ECU_Address@FSO_MAP_hyst@0x010025D0@ */ ECIPP_ALIGNMENT_UWORD 256 Compu_FSO_MAP_hyst 0 255.99609375 /end CHARACTERISTIC
/begin COMPU_METHOD Compu_FSO_MAP_hyst " " RAT_FUNC "%.2" "psi" COEFFS 0 256 0 0 0 1 /end COMPU_METHOD
/begin CHARACTERISTIC IVS_source "IVS input source{IVS_source&0xff=0:FPP2/IVS Input}{IVS_source&0xff=1:Oil Pressure Input}{IVS_source&0xff=2:Aux PU1}{IVS_source&0xff=3:Aux PU2}{IVS_source&0xff=4:Aux PU3}" VALUE 0x001c879d /* @ECU_Address@IVS_source@0x010025D8@ */ ECIPP_ALIGNMENT_UBYTE 255 IVS_source_COMPU_VTAB 0 255 BIT_MASK 0xff /end CHARACTERISTIC
/begin COMPU_METHOD IVS_source_COMPU_VTAB "Verbal Table" TAB_VERB "%.0" "list" COMPU_TAB_REF IVS_source_COMPU_VTAB_REF /end COMPU_METHOD
/begin COMPU_VTAB IVS_source_COMPU_VTAB_REF "Verbal Table" TAB_VERB 5 0 "FPP2/IVS Input" 1 "Oil Pressure Input" 2 "Aux PU1" 3 "Aux PU2" 4 "Aux PU3" DEFAULT_VALUE "UNKNOWN" /end COMPU_VTAB
/begin CHARACTERISTIC TCSB_ena "Throttle closed-stop brake function{TCSB_ena&0xff=0:Disabled}{TCSB_ena&0xff=1:Enabled}" VALUE 0x001C9CA6 /* @ECU_Address@TCSB_ena@0x01002768@ */ ECIPP_ALIGNMENT_UBYTE 255 TCSB_ena_COMPU_VTAB 0 255 BIT_MASK 0xff /end CHARACTERISTIC
/begin COMPU_METHOD TCSB_ena_COMPU_VTAB "Verbal Table" TAB_VERB "%.0" "list" COMPU_TAB_REF TCSB_ena_COMPU_VTAB_REF /end COMPU_METHOD
/begin COMPU_VTAB TCSB_ena_COMPU_VTAB_REF "Verbal Table" TAB_VERB 2 0 "Disabled" 1 "Enabled" DEFAULT_VALUE "UNKNOWN" /end COMPU_VTAB
/begin CHARACTERISTIC TCSB_TPSdelta "Closed-stop TPS delta" VALUE 0x001C9CA8 /* @ECU_Address@TCSB_TPSdelta@0x01002770@ */ ECIPP_ALIGNMENT_UWORD 5 Compu_TCSB_TPSdelta 0 5.00114468864469 /end CHARACTERISTIC
/begin COMPU_METHOD Compu_TCSB_TPSdelta " " RAT_FUNC "%.3" "volts" COEFFS 0 13104 0 0 0 1 /end COMPU_METHOD
/begin CHARACTERISTIC TCSB_min_TPSdt "Closed-stop min TPS TPSdt" VALUE 0x001C9CAA /* @ECU_Address@TCSB_min_TPSdt@0x01002778@ */ ECIPP_ALIGNMENT_SWORD 12500 Compu_TCSB_min_TPSdt -12500 12499.6185302734 /end CHARACTERISTIC
/begin COMPU_METHOD Compu_TCSB_min_TPSdt " " RAT_FUNC "%.1" "%/sec" COEFFS 0 2.62144 0 0 0 1 /end COMPU_METHOD
/begin CHARACTERISTIC TCSB_max_TPSdt "Closed-stop max TPS TPSdt" VALUE 0x001C9CAC /* @ECU_Address@TCSB_max_TPSdt@0x01002780@ */ ECIPP_ALIGNMENT_SWORD 12500 Compu_TCSB_max_TPSdt -12500 12499.6185302734 /end CHARACTERISTIC
/begin COMPU_METHOD Compu_TCSB_max_TPSdt " " RAT_FUNC "%.1" "%/sec" COEFFS 0 2.62144 0 0 0 1 /end COMPU_METHOD
/begin CHARACTERISTIC TCSB_Kd "Closed-stop braking Kd" VALUE 0x001C9CAE /* @ECU_Address@TCSB_Kd@0x01002788@ */ ECIPP_ALIGNMENT_SWORD 1 Compu_TCSB_Kd -1.024 1.02396875 /end CHARACTERISTIC
/begin COMPU_METHOD Compu_TCSB_Kd " " RAT_FUNC "%.3" "%/%*sec" COEFFS 0 32000 0 0 0 1 /end COMPU_METHOD
/begin CHARACTERISTIC TOSB_ena "Throttle open-stop brake function{TOSB_ena&0xff=0:Disabled}{TOSB_ena&0xff=1:Enabled}" VALUE 0x001C9CB0 /* @ECU_Address@TOSB_ena@0x01002790@ */ ECIPP_ALIGNMENT_UBYTE 255 TOSB_ena_COMPU_VTAB 0 255 BIT_MASK 0xff /end CHARACTERISTIC
/begin COMPU_METHOD TOSB_ena_COMPU_VTAB "Verbal Table" TAB_VERB "%.0" "list" COMPU_TAB_REF TOSB_ena_COMPU_VTAB_REF /end COMPU_METHOD
/begin COMPU_VTAB TOSB_ena_COMPU_VTAB_REF "Verbal Table" TAB_VERB 2 0 "Disabled" 1 "Enabled" DEFAULT_VALUE "UNKNOWN" /end COMPU_VTAB
/begin CHARACTERISTIC TOSB_TPSdelta "Open-stop TPS delta" VALUE 0x001C9CB2 /* @ECU_Address@TOSB_TPSdelta@0x01002798@ */ ECIPP_ALIGNMENT_UWORD 5 Compu_TOSB_TPSdelta 0 5.00114468864469 /end CHARACTERISTIC
/begin COMPU_METHOD Compu_TOSB_TPSdelta " " RAT_FUNC "%.3" "volts" COEFFS 0 13104 0 0 0 1 /end COMPU_METHOD
/begin CHARACTERISTIC TOSB_min_TPSdt "Open-stop min TPS TPSdt" VALUE 0x001C9CB4 /* @ECU_Address@TOSB_min_TPSdt@0x010027A0@ */ ECIPP_ALIGNMENT_SWORD 12500 Compu_TOSB_min_TPSdt -12500 12499.6185302734 /end CHARACTERISTIC
/begin COMPU_METHOD Compu_TOSB_min_TPSdt " " RAT_FUNC "%.1" "%/sec" COEFFS 0 2.62144 0 0 0 1 /end COMPU_METHOD
/begin CHARACTERISTIC TOSB_max_TPSdt "Open-stop max TPS TPSdt" VALUE 0x001C9CB6 /* @ECU_Address@TOSB_max_TPSdt@0x010027A8@ */ ECIPP_ALIGNMENT_SWORD 12500 Compu_TOSB_max_TPSdt -12500 12499.6185302734 /end CHARACTERISTIC
/begin COMPU_METHOD Compu_TOSB_max_TPSdt " " RAT_FUNC "%.1" "%/sec" COEFFS 0 2.62144 0 0 0 1 /end COMPU_METHOD
/begin CHARACTERISTIC TOSB_Kd "Open-stop braking Kd" VALUE 0x001C9CB8 /* @ECU_Address@TOSB_Kd@0x010027B0@ */ ECIPP_ALIGNMENT_SWORD 1 Compu_TOSB_Kd -1.024 1.02396875 /end CHARACTERISTIC
/begin COMPU_METHOD Compu_TOSB_Kd " " RAT_FUNC "%.3" "%/%*sec" COEFFS 0 32000 0 0 0 1 /end COMPU_METHOD
/begin MEASUREMENT TEM_I "Throttle estimated current" SWORD Compu_TEM_I 0 0 -32 31.9990234375 ECU_ADDRESS 0x010027B8 /end MEASUREMENT
/begin COMPU_METHOD Compu_TEM_I " " RAT_FUNC "%.2" "amps" COEFFS 0 1024 0 0 0 1 /end COMPU_METHOD
/begin MEASUREMENT I_TFB_acc "Integrator value" SLONG Compu_I_TFB_acc 0 0 -25600 25599.9999880791 ECU_ADDRESS 0x010027C0 /end MEASUREMENT
/begin COMPU_METHOD Compu_I_TFB_acc " " RAT_FUNC "%.1" "%" COEFFS 0 83886.08 0 0 0 1 /end COMPU_METHOD
/begin CHARACTERISTIC FSO_runtime_wait "FSO run time wait" VALUE 0x001c429c /* @ECU_Address@FSO_runtime_wait@0x01002CE8@ */ ECIPP_ALIGNMENT_ULONG 4294967 Compu_FSO_runtime_wait 0 4294967.295 /end CHARACTERISTIC
/begin COMPU_METHOD Compu_FSO_runtime_wait " " RAT_FUNC "%.1" "sec" COEFFS 0 1000 0 0 0 1 /end COMPU_METHOD
/begin MEASUREMENT IAC_step_int "IAC stepping interval" UBYTE Compu_IAC_step_int 0 0 0 255 ECU_ADDRESS 0x01002DC0 /end MEASUREMENT
/begin COMPU_METHOD Compu_IAC_step_int " " RAT_FUNC "%.0" "ms" COEFFS 0 1 0 0 0 1 /end COMPU_METHOD
/begin MEASUREMENT IAC_step_d "IAC target step position" SWORD Compu_IAC_step_d 0 0 -32768 32767 ECU_ADDRESS 0x01002DC8 /end MEASUREMENT
/begin COMPU_METHOD Compu_IAC_step_d " " RAT_FUNC "%.0" "steps" COEFFS 0 1 0 0 0 1 /end COMPU_METHOD
/begin MEASUREMENT IAC_step_a "IAC actual step position" SWORD Compu_IAC_step_a 0 0 -32768 32767 ECU_ADDRESS 0x01002DD0 /end MEASUREMENT
/begin COMPU_METHOD Compu_IAC_step_a " " RAT_FUNC "%.0" "steps" COEFFS 0 1 0 0 0 1 /end COMPU_METHOD
/begin MEASUREMENT IAC_pwr_ena "IAC driver power{IAC_pwr_ena&0xff=0:Off}{IAC_pwr_ena&0xff=1:On}" UBYTE IAC_pwr_ena_COMPU_VTAB 0 0 0 255 ECU_ADDRESS 0x01002DD8 BIT_MASK 0xff /end MEASUREMENT
/begin COMPU_METHOD IAC_pwr_ena_COMPU_VTAB "Verbal Table" TAB_VERB "%.0" "list" COMPU_TAB_REF IAC_pwr_ena_COMPU_VTAB_REF /end COMPU_METHOD
/begin COMPU_VTAB IAC_pwr_ena_COMPU_VTAB_REF "Verbal Table" TAB_VERB 2 0 "Off" 1 "On" DEFAULT_VALUE "UNKNOWN" /end COMPU_VTAB
/begin CHARACTERISTIC IAC_step_min "IAC minimum (0%) command position" VALUE 0x001c450c /* @ECU_Address@IAC_step_min@0x01002DE0@ */ ECIPP_ALIGNMENT_SWORD 32767 Compu_IAC_step_min -32768 32767 /end CHARACTERISTIC
/begin COMPU_METHOD Compu_IAC_step_min " " RAT_FUNC "%.0" "steps" COEFFS 0 1 0 0 0 1 /end COMPU_METHOD
/begin CHARACTERISTIC IAC_step_max "IAC maximum (100%) command position" VALUE 0x001c450a /* @ECU_Address@IAC_step_max@0x01002DE8@ */ ECIPP_ALIGNMENT_SWORD 32767 Compu_IAC_step_max -32768 32767 /end CHARACTERISTIC
/begin COMPU_METHOD Compu_IAC_step_max " " RAT_FUNC "%.0" "steps" COEFFS 0 1 0 0 0 1 /end COMPU_METHOD
/begin CHARACTERISTIC IAC_step_home "IAC homing sequence travel" VALUE 0x001c7bee /* @ECU_Address@IAC_step_home@0x01002DF0@ */ ECIPP_ALIGNMENT_UWORD 65535 Compu_IAC_step_home 0 65535 /end CHARACTERISTIC
/begin COMPU_METHOD Compu_IAC_step_home " " RAT_FUNC "%.0" "steps" COEFFS 0 1 0 0 0 1 /end COMPU_METHOD
/begin CHARACTERISTIC IAC_Vbat_min "IAC operation min battery voltage" VALUE 0x001c7bea /* @ECU_Address@IAC_Vbat_min@0x01002DF8@ */ ECIPP_ALIGNMENT_UWORD 256 Compu_IAC_Vbat_min 0 255.99609375 /end CHARACTERISTIC
/begin COMPU_METHOD Compu_IAC_Vbat_min " " RAT_FUNC "%.2" "volts" COEFFS 0 256 0 0 0 1 /end COMPU_METHOD
/begin CHARACTERISTIC IAC_step_park "IAC power-down parking position" VALUE 0x001c7bf0 /* @ECU_Address@IAC_step_park@0x01002E00@ */ ECIPP_ALIGNMENT_UWORD 65535 Compu_IAC_step_park 0 65535 /end CHARACTERISTIC
/begin COMPU_METHOD Compu_IAC_step_park " " RAT_FUNC "%.0" "steps" COEFFS 0 1 0 0 0 1 /end COMPU_METHOD
/begin MEASUREMENT IAC_cmd_pct "IAC commanded position" UWORD Compu_IAC_cmd_pct 0 0 0 99.9984741210938 ECU_ADDRESS 0x01002E08 /end MEASUREMENT
/begin COMPU_METHOD Compu_IAC_cmd_pct " " RAT_FUNC "%.1" "%" COEFFS 0 655.36 0 0 0 1 /end COMPU_METHOD
/begin MEASUREMENT IAC_home_req "IAC home request" UBYTE Compu_IAC_home_req 0 0 0 255 ECU_ADDRESS 0x01002E10 /end MEASUREMENT
/begin COMPU_METHOD Compu_IAC_home_req " " RAT_FUNC "%.0" "0,1,2,3" COEFFS 0 1 0 0 0 1 /end COMPU_METHOD
/begin MEASUREMENT IAC_min_gov_pct "IAC min governor command" UWORD Compu_IAC_min_gov_pct 0 0 0 99.9984741210938 ECU_ADDRESS 0x01002E70 /end MEASUREMENT
/begin COMPU_METHOD Compu_IAC_min_gov_pct " " RAT_FUNC "%.1" "%" COEFFS 0 655.36 0 0 0 1 /end COMPU_METHOD
/begin MEASUREMENT IACflw_cmd "IAC throttle follower command" UWORD Compu_IACflw_cmd 0 0 0 99.9984741210938 ECU_ADDRESS 0x01002E78 /end MEASUREMENT
/begin COMPU_METHOD Compu_IACflw_cmd " " RAT_FUNC "%.1" "%" COEFFS 0 655.36 0 0 0 1 /end COMPU_METHOD
/begin CHARACTERISTIC IACflw_ena "IAC throttle follower function{IACflw_ena&0xff=0:Disabled}{IACflw_ena&0xff=1:Enabled}" VALUE 0x001c8767 /* @ECU_Address@IACflw_ena@0x01002E80@ */ ECIPP_ALIGNMENT_UBYTE 255 IACflw_ena_COMPU_VTAB 0 255 BIT_MASK 0xff /end CHARACTERISTIC
/begin COMPU_METHOD IACflw_ena_COMPU_VTAB "Verbal Table" TAB_VERB "%.0" "list" COMPU_TAB_REF IACflw_ena_COMPU_VTAB_REF /end COMPU_METHOD
/begin COMPU_VTAB IACflw_ena_COMPU_VTAB_REF "Verbal Table" TAB_VERB 2 0 "Disabled" 1 "Enabled" DEFAULT_VALUE "UNKNOWN" /end COMPU_VTAB
/begin MEASUREMENT IACflw_active "IAC throttle follower state{IACflw_active&0xff=0:Inactive}{IACflw_active&0xff=1:Active}" UBYTE IACflw_active_COMPU_VTAB 0 0 0 255 ECU_ADDRESS 0x01002E88 BIT_MASK 0xff /end MEASUREMENT
/begin COMPU_METHOD IACflw_active_COMPU_VTAB "Verbal Table" TAB_VERB "%.0" "list" COMPU_TAB_REF IACflw_active_COMPU_VTAB_REF /end COMPU_METHOD
/begin COMPU_VTAB IACflw_active_COMPU_VTAB_REF "Verbal Table" TAB_VERB 2 0 "Inactive" 1 "Active" DEFAULT_VALUE "UNKNOWN" /end COMPU_VTAB
/begin CHARACTERISTIC IACflw_inc "IAC throttle follow ramp-up" VALUE 0x001c7bfc /* @ECU_Address@IACflw_inc@0x01002E90@ */ ECIPP_ALIGNMENT_UWORD 1562 Compu_IACflw_inc 0 1562.47615814209 /end CHARACTERISTIC
/begin COMPU_METHOD Compu_IACflw_inc " " RAT_FUNC "%.1" "%/sec" COEFFS 0 41.94304 0 0 0 1 /end COMPU_METHOD
/begin CHARACTERISTIC IACflw_dec "IAC throttle follow ramp-down" VALUE 0x001c7bfa /* @ECU_Address@IACflw_dec@0x01002E98@ */ ECIPP_ALIGNMENT_UWORD 1562 Compu_IACflw_dec 0 1562.47615814209 /end CHARACTERISTIC
/begin COMPU_METHOD Compu_IACflw_dec " " RAT_FUNC "%.1" "%/sec" COEFFS 0 41.94304 0 0 0 1 /end COMPU_METHOD
/begin CHARACTERISTIC IACflw_FPP_0 "IAC throttle follower schedule (FPP0)" VALUE 0x001c7bf2 /* @ECU_Address@IACflw_FPP_0@0x01002EA0@ */ ECIPP_ALIGNMENT_UWORD 100 Compu_IACflw_FPP_0 0 99.9984741210938 /end CHARACTERISTIC
/begin COMPU_METHOD Compu_IACflw_FPP_0 " " RAT_FUNC "%.1" "%" COEFFS 0 655.36 0 0 0 1 /end COMPU_METHOD
/begin CHARACTERISTIC IACflw_FPP_1 "IAC throttle follower schedule (FPP1)" VALUE 0x001c7bf4 /* @ECU_Address@IACflw_FPP_1@0x01002EA8@ */ ECIPP_ALIGNMENT_UWORD 100 Compu_IACflw_FPP_1 0 99.9984741210938 /end CHARACTERISTIC
/begin COMPU_METHOD Compu_IACflw_FPP_1 " " RAT_FUNC "%.1" "%" COEFFS 0 655.36 0 0 0 1 /end COMPU_METHOD
/begin CHARACTERISTIC IACflw_cmd_0 "IAC throttle follower schedule (IAC0)" VALUE 0x001c7bf6 /* @ECU_Address@IACflw_cmd_0@0x01002EB0@ */ ECIPP_ALIGNMENT_UWORD 100 Compu_IACflw_cmd_0 0 99.9984741210938 /end CHARACTERISTIC
/begin COMPU_METHOD Compu_IACflw_cmd_0 " " RAT_FUNC "%.1" "%" COEFFS 0 655.36 0 0 0 1 /end COMPU_METHOD
/begin CHARACTERISTIC IACflw_cmd_1 "IAC throttle follower schedule (IAC1)" VALUE 0x001c7bf8 /* @ECU_Address@IACflw_cmd_1@0x01002EB8@ */ ECIPP_ALIGNMENT_UWORD 100 Compu_IACflw_cmd_1 0 99.9984741210938 /end CHARACTERISTIC
/begin COMPU_METHOD Compu_IACflw_cmd_1 " " RAT_FUNC "%.1" "%" COEFFS 0 655.36 0 0 0 1 /end COMPU_METHOD
/begin CHARACTERISTIC IAC_Ilearn_drpm "IAC integrator learn rpm tolerance" VALUE 0x001c7be8 /* @ECU_Address@IAC_Ilearn_drpm@0x01002F10@ */ ECIPP_ALIGNMENT_UWORD 65535 Compu_IAC_Ilearn_drpm 0 65535 /end CHARACTERISTIC
/begin COMPU_METHOD Compu_IAC_Ilearn_drpm " " RAT_FUNC "%.0" "rpm" COEFFS 0 1 0 0 0 1 /end COMPU_METHOD
/begin CHARACTERISTIC IAC_Ilearn_tau "IAC integrator learn tau" VALUE 0x001c8550 /* @ECU_Address@IAC_Ilearn_tau@0x01002F18@ */ ECIPP_ALIGNMENT_UWORD 163840 Compu_IAC_Ilearn_tau 0.16703 163840 /end CHARACTERISTIC
/begin COMPU_METHOD Compu_IAC_Ilearn_tau " " FORM "%.0" "ms"
 /begin FORMULA "-5 / log(1.0000000000001 - (X1 / 32768))" FORMULA_INV "(1.0000000000001 - exp(-5/X1)) * 32768" /end FORMULA
/end COMPU_METHOD
/begin MEASUREMENT IAC_act_sgnpct "IAC actual position" SWORD Compu_IAC_act_sgnpct 0 0 -200 199.993896484375 ECU_ADDRESS 0x01002F68 /end MEASUREMENT
/begin COMPU_METHOD Compu_IAC_act_sgnpct " " RAT_FUNC "%.1" "%" COEFFS 0 163.84 0 0 0 1 /end COMPU_METHOD
/begin MEASUREMENT IAC_full_req "IAC full-open request" UBYTE Compu_IAC_full_req 0 0 0 255 ECU_ADDRESS 0x01003398 /end MEASUREMENT
/begin COMPU_METHOD Compu_IAC_full_req " " RAT_FUNC "%.0" "0,1,2,3" COEFFS 0 1 0 0 0 1 /end COMPU_METHOD
/begin MEASUREMENT FPP2atidle_mode "FPP2 @idle checking state{FPP2atidle_mode&0xff=0:Disabled}{FPP2atidle_mode&0xff=1:Init1}{FPP2atidle_mode&0xff=2:Init2}{FPP2atidle_mode&0xff=3:Enabled}" UBYTE FPP2atidle_mode_COMPU_VTAB 0 0 0 255 ECU_ADDRESS 0x010034C0 BIT_MASK 0xff /end MEASUREMENT
/begin COMPU_METHOD FPP2atidle_mode_COMPU_VTAB "Verbal Table" TAB_VERB "%.0" "list" COMPU_TAB_REF FPP2atidle_mode_COMPU_VTAB_REF /end COMPU_METHOD
/begin COMPU_VTAB FPP2atidle_mode_COMPU_VTAB_REF "Verbal Table" TAB_VERB 4 0 "Disabled" 1 "Init1" 2 "Init2" 3 "Enabled" DEFAULT_VALUE "UNKNOWN" /end COMPU_VTAB
/begin CHARACTERISTIC TPS12ctl_choice "PS1/2 mismatch{TPS12ctl_choice&0xff=0:PS1}{TPS12ctl_choice&0xff=1:Higher %}" VALUE 0x001C9C2A /* @ECU_Address@TPS12ctl_choice@0x01003508@ */ ECIPP_ALIGNMENT_UBYTE 255 TPS12ctl_choice_COMPU_VTAB 0 255 BIT_MASK 0xff /end CHARACTERISTIC
/begin COMPU_METHOD TPS12ctl_choice_COMPU_VTAB "Verbal Table" TAB_VERB "%.0" "list" COMPU_TAB_REF TPS12ctl_choice_COMPU_VTAB_REF /end COMPU_METHOD
/begin COMPU_VTAB TPS12ctl_choice_COMPU_VTAB_REF "Verbal Table" TAB_VERB 2 0 "PS1" 1 "Higher %" DEFAULT_VALUE "UNKNOWN" /end COMPU_VTAB
/begin CHARACTERISTIC TPS2ctl_allow "PS2 backup ctl{TPS2ctl_allow&0xff=0:Disabled}{TPS2ctl_allow&0xff=1:Enabled}" VALUE 0x001C9C29 /* @ECU_Address@TPS2ctl_allow@0x01003510@ */ ECIPP_ALIGNMENT_UBYTE 255 TPS2ctl_allow_COMPU_VTAB 0 255 BIT_MASK 0xff /end CHARACTERISTIC
/begin COMPU_METHOD TPS2ctl_allow_COMPU_VTAB "Verbal Table" TAB_VERB "%.0" "list" COMPU_TAB_REF TPS2ctl_allow_COMPU_VTAB_REF /end COMPU_METHOD
/begin COMPU_VTAB TPS2ctl_allow_COMPU_VTAB_REF "Verbal Table" TAB_VERB 2 0 "Disabled" 1 "Enabled" DEFAULT_VALUE "UNKNOWN" /end COMPU_VTAB
/begin CHARACTERISTIC FPPdualpot_ena "Dual pot pedal{FPPdualpot_ena&0xff=0:Disabled}{FPPdualpot_ena&0xff=1:Enabled}" VALUE 0x001c872a /* @ECU_Address@FPPdualpot_ena@0x01003AE0@ */ ECIPP_ALIGNMENT_UBYTE 255 FPPdualpot_ena_COMPU_VTAB 0 255 BIT_MASK 0xff /end CHARACTERISTIC
/begin COMPU_METHOD FPPdualpot_ena_COMPU_VTAB "Verbal Table" TAB_VERB "%.0" "list" COMPU_TAB_REF FPPdualpot_ena_COMPU_VTAB_REF /end COMPU_METHOD
/begin COMPU_VTAB FPPdualpot_ena_COMPU_VTAB_REF "Verbal Table" TAB_VERB 2 0 "Disabled" 1 "Enabled" DEFAULT_VALUE "UNKNOWN" /end COMPU_VTAB
/begin CHARACTERISTIC TPSdualpot_ena "Dual pot throttle{TPSdualpot_ena&0xff=0:Disabled}{TPSdualpot_ena&0xff=1:Enabled}" VALUE 0x001C9C28 /* @ECU_Address@TPSdualpot_ena@0x01003AE8@ */ ECIPP_ALIGNMENT_UBYTE 255 TPSdualpot_ena_COMPU_VTAB 0 255 BIT_MASK 0xff /end CHARACTERISTIC
/begin COMPU_METHOD TPSdualpot_ena_COMPU_VTAB "Verbal Table" TAB_VERB "%.0" "list" COMPU_TAB_REF TPSdualpot_ena_COMPU_VTAB_REF /end COMPU_METHOD
/begin COMPU_VTAB TPSdualpot_ena_COMPU_VTAB_REF "Verbal Table" TAB_VERB 2 0 "Disabled" 1 "Enabled" DEFAULT_VALUE "UNKNOWN" /end COMPU_VTAB
/begin CHARACTERISTIC door_ntrlk_ena "Door interlock input{door_ntrlk_ena&0xff=0:Disabled}{door_ntrlk_ena&0xff=1:Aux PU1}{door_ntrlk_ena&0xff=2:Aux PU2}{door_ntrlk_ena&0xff=3:Aux PU3}{door_ntrlk_ena&0xff=4:Aux PUD1}{door_ntrlk_ena&0xff=5:Aux PUD2}{door_ntrlk_ena&0xff=6:Aux PUD3}{door_ntrlk_en" VALUE 0x001c8ff4 /* @ECU_Address@door_ntrlk_ena@0x01004830@ */ ECIPP_ALIGNMENT_UBYTE 255 door_ntrlk_ena_COMPU_VTAB 0 255 BIT_MASK 0xff /end CHARACTERISTIC
/begin COMPU_METHOD door_ntrlk_ena_COMPU_VTAB "Verbal Table" TAB_VERB "%.0" "list" COMPU_TAB_REF door_ntrlk_ena_COMPU_VTAB_REF /end COMPU_METHOD
/begin COMPU_VTAB door_ntrlk_ena_COMPU_VTAB_REF "Verbal Table" TAB_VERB 32 0 "Disabled" 1 "Aux PU1" 2 "Aux PU2" 3 "Aux PU3" 4 "Aux PUD1" 5 "Aux PUD2" 6 "Aux PUD3" 7 "Aux DIG1" 8 "Aux DIG2" 9 "Aux DIG3" 10 "Aux DIG4" 11 "Aux DIG5" 12 "Aux DIG6" 13 "Aux DIG7" 14 "Aux DIG8" 15 "Aux DIG9" 16 "Aux DIG10" 17 "Aux DIG11" 18 "Aux DIG12" 19 "Aux DIG13" 20 "Aux DIG14" 21 "Aux DIG15" 22 "Aux DIG16" 23 "Aux DIG17" 24 "Aux DIG18" 25 "Aux DIG19" 26 "Aux DIG20" 27 "Aux DIG21" 28 "Aux DIG22" 29 "Aux DIG23" 30 "Aux DIG24" 31 "Aux DIG25" DEFAULT_VALUE "UNKNOWN" /end COMPU_VTAB
/begin CHARACTERISTIC door_ntrlk_sense "Door interlock sense{door_ntrlk_sense&0xff=0:Open=Inactive}{door_ntrlk_sense&0xff=1:Open=Active}{door_ntrlk_sense&0xff=2:Aux DIG +V=Inactive}{door_ntrlk_sense&0xff=3:Aux DIG +V=Active}" VALUE 0x001c8ff5 /* @ECU_Address@door_ntrlk_sense@0x01004838@ */ ECIPP_ALIGNMENT_UBYTE 255 door_ntrlk_sense_COMPU_VTAB 0 255 BIT_MASK 0xff /end CHARACTERISTIC
/begin COMPU_METHOD door_ntrlk_sense_COMPU_VTAB "Verbal Table" TAB_VERB "%.0" "list" COMPU_TAB_REF door_ntrlk_sense_COMPU_VTAB_REF /end COMPU_METHOD
/begin COMPU_VTAB door_ntrlk_sense_COMPU_VTAB_REF "Verbal Table" TAB_VERB 4 0 "Open=Inactive" 1 "Open=Active" 2 "Aux DIG +V=Inactive" 3 "Aux DIG +V=Active" DEFAULT_VALUE "UNKNOWN" /end COMPU_VTAB
/begin MEASUREMENT door_ntrlk "Door interlock status{door_ntrlk&0xff=0:Released}{door_ntrlk&0xff=1:Locked Idle}" UBYTE door_ntrlk_COMPU_VTAB 0 0 0 255 ECU_ADDRESS 0x01004840 BIT_MASK 0xff /end MEASUREMENT
/begin COMPU_METHOD door_ntrlk_COMPU_VTAB "Verbal Table" TAB_VERB "%.0" "list" COMPU_TAB_REF door_ntrlk_COMPU_VTAB_REF /end COMPU_METHOD
/begin COMPU_VTAB door_ntrlk_COMPU_VTAB_REF "Verbal Table" TAB_VERB 2 0 "Released" 1 "Locked Idle" DEFAULT_VALUE "UNKNOWN" /end COMPU_VTAB
/begin CHARACTERISTIC TPSlim_ena_gsln "Gasoline TPS limiting{TPSlim_ena_gsln&0xff=0:Disabled}{TPSlim_ena_gsln&0xff=1:Enabled}" VALUE 0x001C8F4D /* @ECU_Address@TPSlim_ena_gsln@0x01004898@ */ ECIPP_ALIGNMENT_UBYTE 255 TPSlim_ena_gsln_COMPU_VTAB 0 255 BIT_MASK 0xff /end CHARACTERISTIC
/begin COMPU_METHOD TPSlim_ena_gsln_COMPU_VTAB "Verbal Table" TAB_VERB "%.0" "list" COMPU_TAB_REF TPSlim_ena_gsln_COMPU_VTAB_REF /end COMPU_METHOD
/begin COMPU_VTAB TPSlim_ena_gsln_COMPU_VTAB_REF "Verbal Table" TAB_VERB 2 0 "Disabled" 1 "Enabled" DEFAULT_VALUE "UNKNOWN" /end COMPU_VTAB
/begin CHARACTERISTIC TPSlim_ena_LP "LPG TPS limiting{TPSlim_ena_LP&0xff=0:Disabled}{TPSlim_ena_LP&0xff=1:Enabled}" VALUE 0x001C8F4E /* @ECU_Address@TPSlim_ena_LP@0x010048A0@ */ ECIPP_ALIGNMENT_UBYTE 255 TPSlim_ena_LP_COMPU_VTAB 0 255 BIT_MASK 0xff /end CHARACTERISTIC
/begin COMPU_METHOD TPSlim_ena_LP_COMPU_VTAB "Verbal Table" TAB_VERB "%.0" "list" COMPU_TAB_REF TPSlim_ena_LP_COMPU_VTAB_REF /end COMPU_METHOD
/begin COMPU_VTAB TPSlim_ena_LP_COMPU_VTAB_REF "Verbal Table" TAB_VERB 2 0 "Disabled" 1 "Enabled" DEFAULT_VALUE "UNKNOWN" /end COMPU_VTAB
/begin CHARACTERISTIC TPSlim_ena_NG "NG TPS limiting{TPSlim_ena_NG&0xff=0:Disabled}{TPSlim_ena_NG&0xff=1:Enabled}" VALUE 0x001C8F4F /* @ECU_Address@TPSlim_ena_NG@0x010048A8@ */ ECIPP_ALIGNMENT_UBYTE 255 TPSlim_ena_NG_COMPU_VTAB 0 255 BIT_MASK 0xff /end CHARACTERISTIC
/begin COMPU_METHOD TPSlim_ena_NG_COMPU_VTAB "Verbal Table" TAB_VERB "%.0" "list" COMPU_TAB_REF TPSlim_ena_NG_COMPU_VTAB_REF /end COMPU_METHOD
/begin COMPU_VTAB TPSlim_ena_NG_COMPU_VTAB_REF "Verbal Table" TAB_VERB 2 0 "Disabled" 1 "Enabled" DEFAULT_VALUE "UNKNOWN" /end COMPU_VTAB
/begin MEASUREMENT TPSlim_current "Current max TPS limit" UWORD Compu_TPSlim_current 0 0 0 99.9984741210938 ECU_ADDRESS 0x010048B0 /end MEASUREMENT
/begin COMPU_METHOD Compu_TPSlim_current " " RAT_FUNC "%.1" "%" COEFFS 0 655.36 0 0 0 1 /end COMPU_METHOD
/begin CHARACTERISTIC MMSD_ena "Spin-down MAP control{MMSD_ena&0xff=0:Disabled}{MMSD_ena&0xff=1:Min MAP - single point}{MMSD_ena&0xff=2:Max MAP - single point}{MMSD_ena&0xff=3:Max MAP - filtered idle}" VALUE 0x001c883e /* @ECU_Address@MMSD_ena@0x01004970@ */ ECIPP_ALIGNMENT_UBYTE 255 MMSD_ena_COMPU_VTAB 0 255 BIT_MASK 0xff /end CHARACTERISTIC
/begin COMPU_METHOD MMSD_ena_COMPU_VTAB "Verbal Table" TAB_VERB "%.0" "list" COMPU_TAB_REF MMSD_ena_COMPU_VTAB_REF /end COMPU_METHOD
/begin COMPU_VTAB MMSD_ena_COMPU_VTAB_REF "Verbal Table" TAB_VERB 4 0 "Disabled" 1 "Min MAP - single point" 2 "Max MAP - single point" 3 "Max MAP - filtered idle" DEFAULT_VALUE "UNKNOWN" /end COMPU_VTAB
/begin CHARACTERISTIC MMSD_MinMAP "Spin-down MAP target" VALUE 0x001c7dc6 /* @ECU_Address@MMSD_MinMAP@0x01004978@ */ ECIPP_ALIGNMENT_UWORD 256 Compu_MMSD_MinMAP 0 255.99609375 /end CHARACTERISTIC
/begin COMPU_METHOD Compu_MMSD_MinMAP " " RAT_FUNC "%.2" "psia" COEFFS 0 256 0 0 0 1 /end COMPU_METHOD
/begin CHARACTERISTIC MMSD_minTPS "Spin-down MAP min TPS" VALUE 0x001c7dca /* @ECU_Address@MMSD_minTPS@0x01004980@ */ ECIPP_ALIGNMENT_UWORD 100 Compu_MMSD_minTPS 0 99.9984741210938 /end CHARACTERISTIC
/begin COMPU_METHOD Compu_MMSD_minTPS " " RAT_FUNC "%.1" "%" COEFFS 0 655.36 0 0 0 1 /end COMPU_METHOD
/begin CHARACTERISTIC MMSD_maxTPS "Spin-down MAP max TPS" VALUE 0x001c7dc8 /* @ECU_Address@MMSD_maxTPS@0x01004988@ */ ECIPP_ALIGNMENT_UWORD 100 Compu_MMSD_maxTPS 0 99.9984741210938 /end CHARACTERISTIC
/begin COMPU_METHOD Compu_MMSD_maxTPS " " RAT_FUNC "%.1" "%" COEFFS 0 655.36 0 0 0 1 /end COMPU_METHOD
/begin MEASUREMENT MMSD_TPS_pct "Spin-down MAP TPS" UWORD Compu_MMSD_TPS_pct 0 0 0 99.9984741210938 ECU_ADDRESS 0x01004990 /end MEASUREMENT
/begin COMPU_METHOD Compu_MMSD_TPS_pct " " RAT_FUNC "%.1" "%" COEFFS 0 655.36 0 0 0 1 /end COMPU_METHOD
/begin MEASUREMENT FPP_idlvld_cur "FPP idle valid (current)" UWORD Compu_FPP_idlvld_cur 0 0 0 99.9984741210938 ECU_ADDRESS 0x01004B90 /end MEASUREMENT
/begin COMPU_METHOD Compu_FPP_idlvld_cur " " RAT_FUNC "%.1" "-" COEFFS 0 655.36 0 0 0 1 /end COMPU_METHOD
/begin CHARACTERISTIC FSO_TPS_wait "FSO throttle open delay" VALUE 0x001c7b40 /* @ECU_Address@FSO_TPS_wait@0x01004D80@ */ ECIPP_ALIGNMENT_UWORD 65535 Compu_FSO_TPS_wait 0 65535 /end CHARACTERISTIC
/begin COMPU_METHOD Compu_FSO_TPS_wait " " RAT_FUNC "%.0" "ms" COEFFS 0 1 0 0 0 1 /end COMPU_METHOD
/begin CHARACTERISTIC FSO_timer_init "FPP FSO validation time" VALUE 0x001c7b62 /* @ECU_Address@FSO_timer_init@0x01004D88@ */ ECIPP_ALIGNMENT_UWORD 65535 Compu_FSO_timer_init 0 65535 /end CHARACTERISTIC
/begin COMPU_METHOD Compu_FSO_timer_init " " RAT_FUNC "%.0" "ms" COEFFS 0 1 0 0 0 1 /end COMPU_METHOD
/begin CHARACTERISTIC FSO_fault_init "FSO UEGO fault ignore" VALUE 0x001c7b4c /* @ECU_Address@FSO_fault_init@0x01004D90@ */ ECIPP_ALIGNMENT_UWORD 65535 Compu_FSO_fault_init 0 65535 /end CHARACTERISTIC
/begin COMPU_METHOD Compu_FSO_fault_init " " RAT_FUNC "%.0" "ms" COEFFS 0 1 0 0 0 1 /end COMPU_METHOD
/begin CHARACTERISTIC FSO_rpm_mode "FSO speed specification{FSO_rpm_mode&0xff=0:Absolute}{FSO_rpm_mode&0xff=1:Idle Relative}" VALUE 0x001c873c /* @ECU_Address@FSO_rpm_mode@0x01004D98@ */ ECIPP_ALIGNMENT_UBYTE 255 FSO_rpm_mode_COMPU_VTAB 0 255 BIT_MASK 0xff /end CHARACTERISTIC
/begin COMPU_METHOD FSO_rpm_mode_COMPU_VTAB "Verbal Table" TAB_VERB "%.0" "list" COMPU_TAB_REF FSO_rpm_mode_COMPU_VTAB_REF /end COMPU_METHOD
/begin COMPU_VTAB FSO_rpm_mode_COMPU_VTAB_REF "Verbal Table" TAB_VERB 2 0 "Absolute" 1 "Idle Relative" DEFAULT_VALUE "UNKNOWN" /end COMPU_VTAB
/begin CHARACTERISTIC FSO_bstfault_init "FSO throttle-open boost fault ignore" VALUE 0x001c7b48 /* @ECU_Address@FSO_bstfault_init@0x01005758@ */ ECIPP_ALIGNMENT_UWORD 65535 Compu_FSO_bstfault_init 0 65535 /end CHARACTERISTIC
/begin COMPU_METHOD Compu_FSO_bstfault_init " " RAT_FUNC "%.0" "ms" COEFFS 0 1 0 0 0 1 /end COMPU_METHOD
/begin CHARACTERISTIC secspd_actinv "Secondary speed control invalid activity{secspd_actinv&0xff=0:Disabled}{secspd_actinv&0xff=1:Enabled} (Fault Condition:Secondary speed control invalid activity)" VALUE 0x001c9078 /* @ECU_Address@secspd_actinv@0x01005890@ */ ECIPP_ALIGNMENT_UBYTE 255 secspd_actinv_COMPU_VTAB 0 255 BIT_MASK 0xff /end CHARACTERISTIC
/begin COMPU_METHOD secspd_actinv_COMPU_VTAB "Verbal Table" TAB_VERB "%.0" "detection" COMPU_TAB_REF secspd_actinv_COMPU_VTAB_REF /end COMPU_METHOD
/begin COMPU_VTAB secspd_actinv_COMPU_VTAB_REF "Verbal Table" TAB_VERB 2 0 "Disabled" 1 "Enabled" DEFAULT_VALUE "UNKNOWN" /end COMPU_VTAB
/begin CHARACTERISTIC secspd_FPP2act "FPP2 invalid activity detection level +/- (Fault Condition:FPP2 invalid activity detection level +/-)" VALUE 0x001c84d0 /* @ECU_Address@secspd_FPP2act@0x01005898@ */ ECIPP_ALIGNMENT_UWORD 5 Compu_secspd_FPP2act 0 5.00114468864469 /end CHARACTERISTIC
/begin COMPU_METHOD Compu_secspd_FPP2act " " RAT_FUNC "%.3" "volts" COEFFS 0 13104 0 0 0 1 /end COMPU_METHOD
/begin CHARACTERISTIC secspd_FPP2trk_tau "FPP2 invalid activity reference tau (Fault Condition:FPP2 invalid activity reference tau)" VALUE 0x001c8664 /* @ECU_Address@secspd_FPP2trk_tau@0x010058A0@ */ ECIPP_ALIGNMENT_UWORD 3277 Compu_secspd_FPP2trk_tau 0.0045084 3276.8 /end CHARACTERISTIC
/begin COMPU_METHOD Compu_secspd_FPP2trk_tau " " FORM "%.1" "sec"
 /begin FORMULA "-0.05 / log(1 - (X1 / 65536))" FORMULA_INV "(1 - exp(-0.05/X1)) * 65536" /end FORMULA
/end COMPU_METHOD
/begin MEASUREMENT secspd_FPP2trk "FPP2 invalid activity reference level" UWORD Compu_secspd_FPP2trk 0 0 0 5.00114468864469 ECU_ADDRESS 0x010058B0 /end MEASUREMENT
/begin COMPU_METHOD Compu_secspd_FPP2trk " " RAT_FUNC "%.3" "volts" COEFFS 0 13104 0 0 0 1 /end COMPU_METHOD
/begin MEASUREMENT TPS_ctl_auth "TPS control authority{TPS_ctl_auth&0xff=0:User}{TPS_ctl_auth&0xff=1:Governor}{TPS_ctl_auth&0xff=2:Fault Derate}{TPS_ctl_auth&0xff=3:Load Limiting}{TPS_ctl_auth&0xff=4:Max Torque}{TPS_ctl_auth&0xff=5:Roadspeed}" UBYTE TPS_ctl_auth_COMPU_VTAB 0 0 0 255 ECU_ADDRESS 0x01005B68 BIT_MASK 0xff /end MEASUREMENT
/begin COMPU_METHOD TPS_ctl_auth_COMPU_VTAB "Verbal Table" TAB_VERB "%.0" "list" COMPU_TAB_REF TPS_ctl_auth_COMPU_VTAB_REF /end COMPU_METHOD
/begin COMPU_VTAB TPS_ctl_auth_COMPU_VTAB_REF "Verbal Table" TAB_VERB 6 0 "User" 1 "Governor" 2 "Fault Derate" 3 "Load Limiting" 4 "Max Torque" 5 "Roadspeed" DEFAULT_VALUE "UNKNOWN" /end COMPU_VTAB
/begin CHARACTERISTIC MinMAP_spdgov "Min-MAP discrete speed{MinMAP_spdgov&0xff=0:Disabled}{MinMAP_spdgov&0xff=1:Enabled}" VALUE 0x001c884c /* @ECU_Address@MinMAP_spdgov@0x01005D98@ */ ECIPP_ALIGNMENT_UBYTE 255 MinMAP_spdgov_COMPU_VTAB 0 255 BIT_MASK 0xff /end CHARACTERISTIC
/begin COMPU_METHOD MinMAP_spdgov_COMPU_VTAB "Verbal Table" TAB_VERB "%.0" "list" COMPU_TAB_REF MinMAP_spdgov_COMPU_VTAB_REF /end COMPU_METHOD
/begin COMPU_VTAB MinMAP_spdgov_COMPU_VTAB_REF "Verbal Table" TAB_VERB 2 0 "Disabled" 1 "Enabled" DEFAULT_VALUE "UNKNOWN" /end COMPU_VTAB
/begin CHARACTERISTIC FPP2_source "FPP2 input source{FPP2_source&0xff=0:FPP2 Input}{FPP2_source&0xff=1:Aux PD1}{FPP2_source&0xff=2:TIP Input}" VALUE 0x001c8716 /* @ECU_Address@FPP2_source@0x01005E80@ */ ECIPP_ALIGNMENT_UBYTE 255 FPP2_source_COMPU_VTAB 0 255 BIT_MASK 0xff /end CHARACTERISTIC
/begin COMPU_METHOD FPP2_source_COMPU_VTAB "Verbal Table" TAB_VERB "%.0" "list" COMPU_TAB_REF FPP2_source_COMPU_VTAB_REF /end COMPU_METHOD
/begin COMPU_VTAB FPP2_source_COMPU_VTAB_REF "Verbal Table" TAB_VERB 3 0 "FPP2 Input" 1 "Aux PD1" 2 "TIP Input" DEFAULT_VALUE "UNKNOWN" /end COMPU_VTAB
/begin CHARACTERISTIC FSO_load_init "FSO disengage load reduction" VALUE 0x001c7b54 /* @ECU_Address@FSO_load_init@0x01006738@ */ ECIPP_ALIGNMENT_UWORD 100 Compu_FSO_load_init 0 99.9984741210938 /end CHARACTERISTIC
/begin COMPU_METHOD Compu_FSO_load_init " " RAT_FUNC "%.1" "%" COEFFS 0 655.36 0 0 0 1 /end COMPU_METHOD
/begin MEASUREMENT FSO_load_reduct "FSO load reduction" UWORD Compu_FSO_load_reduct 0 0 0 99.9984741210938 ECU_ADDRESS 0x01006740 /end MEASUREMENT
/begin COMPU_METHOD Compu_FSO_load_reduct " " RAT_FUNC "%.1" "%" COEFFS 0 655.36 0 0 0 1 /end COMPU_METHOD
/begin CHARACTERISTIC FPP_dz_pct "FPP dead zone percent" VALUE 0x001c6f90 /* @ECU_Address@FPP_dz_pct@0x010067E8@ */ ECIPP_ALIGNMENT_UWORD 100 Compu_FPP_dz_pct 0 99.9984741210938 /end CHARACTERISTIC
/begin COMPU_METHOD Compu_FPP_dz_pct " " RAT_FUNC "%.1" "%" COEFFS 0 655.36 0 0 0 1 /end COMPU_METHOD
/begin CHARACTERISTIC FPP_dz_tau "FPP dead zone tau" VALUE 0x001c8540 /* @ECU_Address@FPP_dz_tau@0x010067F0@ */ ECIPP_ALIGNMENT_UWORD 327680 Compu_FPP_dz_tau 0.45084 327680 /end CHARACTERISTIC
/begin COMPU_METHOD Compu_FPP_dz_tau " " FORM "%.0" "ms"
 /begin FORMULA "-5 / log(1 - (X1 / 65536))" FORMULA_INV "(1 - exp(-5/X1)) * 65536" /end FORMULA
/end COMPU_METHOD
/begin CHARACTERISTIC FPP_kickdown_on "FPP kickdown engage" VALUE 0x001c6f98 /* @ECU_Address@FPP_kickdown_on@0x01007290@ */ ECIPP_ALIGNMENT_UWORD 100 Compu_FPP_kickdown_on 0 99.9984741210938 /end CHARACTERISTIC
/begin COMPU_METHOD Compu_FPP_kickdown_on " " RAT_FUNC "%.1" "%" COEFFS 0 655.36 0 0 0 1 /end COMPU_METHOD
/begin CHARACTERISTIC FPP_kickdown_off "FPP kickdown disengage" VALUE 0x001c6f96 /* @ECU_Address@FPP_kickdown_off@0x01007298@ */ ECIPP_ALIGNMENT_UWORD 100 Compu_FPP_kickdown_off 0 99.9984741210938 /end CHARACTERISTIC
/begin COMPU_METHOD Compu_FPP_kickdown_off " " RAT_FUNC "%.1" "%" COEFFS 0 655.36 0 0 0 1 /end COMPU_METHOD
/begin MEASUREMENT FPP_kickdown_active "FPP kickdown active" UBYTE Compu_FPP_kickdown_active 0 0 0 255 ECU_ADDRESS 0x010072A0 /end MEASUREMENT
/begin COMPU_METHOD Compu_FPP_kickdown_active " " RAT_FUNC "%.0" "-" COEFFS 0 1 0 0 0 1 /end COMPU_METHOD
/begin CHARACTERISTIC FPP_kickdown_ena "FPP kickdown monitoring{FPP_kickdown_ena&0xff=0:Disabled}{FPP_kickdown_ena&0xff=1:Enabled}" VALUE 0x001c8721 /* @ECU_Address@FPP_kickdown_ena@0x01007648@ */ ECIPP_ALIGNMENT_UBYTE 255 FPP_kickdown_ena_COMPU_VTAB 0 255 BIT_MASK 0xff /end CHARACTERISTIC
/begin COMPU_METHOD FPP_kickdown_ena_COMPU_VTAB "Verbal Table" TAB_VERB "%.0" "list" COMPU_TAB_REF FPP_kickdown_ena_COMPU_VTAB_REF /end COMPU_METHOD
/begin COMPU_VTAB FPP_kickdown_ena_COMPU_VTAB_REF "Verbal Table" TAB_VERB 2 0 "Disabled" 1 "Enabled" DEFAULT_VALUE "UNKNOWN" /end COMPU_VTAB
/begin CHARACTERISTIC FSO_TPS_UEGO_lmt "FSO throttle open UEGO limit" VALUE 0x001c7b38 /* @ECU_Address@FSO_TPS_UEGO_lmt@0x01007878@ */ ECIPP_ALIGNMENT_UWORD 4 Compu_FSO_TPS_UEGO_lmt 0 3.99993896484375 /end CHARACTERISTIC
/begin COMPU_METHOD Compu_FSO_TPS_UEGO_lmt " " RAT_FUNC "%.3" "phi" COEFFS 0 16384 0 0 0 1 /end COMPU_METHOD
/begin CHARACTERISTIC FSO_TPS_spk_kill "FSO throttle open spark kill{FSO_TPS_spk_kill&0xff=0:Disabled}{FSO_TPS_spk_kill&0xff=1:Enabled}" VALUE 0x001c8736 /* @ECU_Address@FSO_TPS_spk_kill@0x01007880@ */ ECIPP_ALIGNMENT_UBYTE 255 FSO_TPS_spk_kill_COMPU_VTAB 0 255 BIT_MASK 0xff /end CHARACTERISTIC
/begin COMPU_METHOD FSO_TPS_spk_kill_COMPU_VTAB "Verbal Table" TAB_VERB "%.0" "list" COMPU_TAB_REF FSO_TPS_spk_kill_COMPU_VTAB_REF /end COMPU_METHOD
/begin COMPU_VTAB FSO_TPS_spk_kill_COMPU_VTAB_REF "Verbal Table" TAB_VERB 2 0 "Disabled" 1 "Enabled" DEFAULT_VALUE "UNKNOWN" /end COMPU_VTAB
/begin CHARACTERISTIC FPP1_switch_ena "Primary foot pedal mode switch{FPP1_switch_ena&0xff=0:Disabled}{FPP1_switch_ena&0xff=1:Aux DIG1 +V=valid}{FPP1_switch_ena&0xff=2:Aux DIG2 +V=valid}{FPP1_switch_ena&0xff=3:Aux DIG3 +V=valid}{FPP1_switch_ena&0xff=4:Aux DIG4 +V=valid}{FPP1_switch_ena&0xff=5:" VALUE 0x001c8713 /* @ECU_Address@FPP1_switch_ena@0x01007AC8@ */ ECIPP_ALIGNMENT_UBYTE 255 FPP1_switch_ena_COMPU_VTAB 0 255 BIT_MASK 0xff /end CHARACTERISTIC
/begin COMPU_METHOD FPP1_switch_ena_COMPU_VTAB "Verbal Table" TAB_VERB "%.0" "list" COMPU_TAB_REF FPP1_switch_ena_COMPU_VTAB_REF /end COMPU_METHOD
/begin COMPU_VTAB FPP1_switch_ena_COMPU_VTAB_REF "Verbal Table" TAB_VERB 7 0 "Disabled" 1 "Aux DIG1 +V=valid" 2 "Aux DIG2 +V=valid" 3 "Aux DIG3 +V=valid" 4 "Aux DIG4 +V=valid" 5 "Aux DIG5 +V=valid" 6 "Aux DIG6 +V=valid" DEFAULT_VALUE "UNKNOWN" /end COMPU_VTAB
/begin CHARACTERISTIC FPP2_switch_ena "Secondary foot pedal mode switch{FPP2_switch_ena&0xff=0:Disabled}{FPP2_switch_ena&0xff=1:Aux DIG1 +V=valid}{FPP2_switch_ena&0xff=2:Aux DIG2 +V=valid}{FPP2_switch_ena&0xff=3:Aux DIG3 +V=valid}{FPP2_switch_ena&0xff=4:Aux DIG4 +V=valid}{FPP2_switch_ena&0xff=" VALUE 0x001c8717 /* @ECU_Address@FPP2_switch_ena@0x01007AD0@ */ ECIPP_ALIGNMENT_UBYTE 255 FPP2_switch_ena_COMPU_VTAB 0 255 BIT_MASK 0xff /end CHARACTERISTIC
/begin COMPU_METHOD FPP2_switch_ena_COMPU_VTAB "Verbal Table" TAB_VERB "%.0" "list" COMPU_TAB_REF FPP2_switch_ena_COMPU_VTAB_REF /end COMPU_METHOD
/begin COMPU_VTAB FPP2_switch_ena_COMPU_VTAB_REF "Verbal Table" TAB_VERB 7 0 "Disabled" 1 "Aux DIG1 +V=valid" 2 "Aux DIG2 +V=valid" 3 "Aux DIG3 +V=valid" 4 "Aux DIG4 +V=valid" 5 "Aux DIG5 +V=valid" 6 "Aux DIG6 +V=valid" DEFAULT_VALUE "UNKNOWN" /end COMPU_VTAB
/begin CHARACTERISTIC FPP_switch_slew_ena "FPP mode switch slewing{FPP_switch_slew_ena&0xff=0:Disabled}{FPP_switch_slew_ena&0xff=1:Enabled}" VALUE 0x001c8725 /* @ECU_Address@FPP_switch_slew_ena@0x01007AD8@ */ ECIPP_ALIGNMENT_UBYTE 255 FPP_switch_slew_ena_COMPU_VTAB 0 255 BIT_MASK 0xff /end CHARACTERISTIC
/begin COMPU_METHOD FPP_switch_slew_ena_COMPU_VTAB "Verbal Table" TAB_VERB "%.0" "list" COMPU_TAB_REF FPP_switch_slew_ena_COMPU_VTAB_REF /end COMPU_METHOD
/begin COMPU_VTAB FPP_switch_slew_ena_COMPU_VTAB_REF "Verbal Table" TAB_VERB 2 0 "Disabled" 1 "Enabled" DEFAULT_VALUE "UNKNOWN" /end COMPU_VTAB
/begin CHARACTERISTIC FPP_switch_rpm_tau "FPP mode switch rpm filter" VALUE 0x001c8544 /* @ECU_Address@FPP_switch_rpm_tau@0x01007AE0@ */ ECIPP_ALIGNMENT_UWORD 327680 Compu_FPP_switch_rpm_tau 0.45084 327680 /end CHARACTERISTIC
/begin COMPU_METHOD Compu_FPP_switch_rpm_tau " " FORM "%.0" "ms"
 /begin FORMULA "-5 / log(1 - (X1 / 65536))" FORMULA_INV "(1 - exp(-5/X1)) * 65536" /end FORMULA
/end COMPU_METHOD
/begin CHARACTERISTIC FPP_switch_FPP_tau "FPP mode switch FPP filter" VALUE 0x001c8542 /* @ECU_Address@FPP_switch_FPP_tau@0x01007AE8@ */ ECIPP_ALIGNMENT_UWORD 327680 Compu_FPP_switch_FPP_tau 0.45084 327680 /end CHARACTERISTIC
/begin COMPU_METHOD Compu_FPP_switch_FPP_tau " " FORM "%.0" "ms"
 /begin FORMULA "-5 / log(1 - (X1 / 65536))" FORMULA_INV "(1 - exp(-5/X1)) * 65536" /end FORMULA
/end COMPU_METHOD
/begin CHARACTERISTIC FPP_switch_rpm_inc "FPP mode switch rpm increase rate" VALUE 0x001c6fa6 /* @ECU_Address@FPP_switch_rpm_inc@0x01007AF0@ */ ECIPP_ALIGNMENT_UWORD 65535 Compu_FPP_switch_rpm_inc 0 65535 /end CHARACTERISTIC
/begin COMPU_METHOD Compu_FPP_switch_rpm_inc " " RAT_FUNC "%.0" "rpm/sec" COEFFS 0 1 0 0 0 1 /end COMPU_METHOD
/begin CHARACTERISTIC FPP_switch_FPP_inc "FPP mode switch FPP increase rate" VALUE 0x001c6fa4 /* @ECU_Address@FPP_switch_FPP_inc@0x01007AF8@ */ ECIPP_ALIGNMENT_UWORD 100 Compu_FPP_switch_FPP_inc 0 99.9984741210938 /end CHARACTERISTIC
/begin COMPU_METHOD Compu_FPP_switch_FPP_inc " " RAT_FUNC "%.1" "%/sec" COEFFS 0 655.36 0 0 0 1 /end COMPU_METHOD
/begin MEASUREMENT FPP_switch_rpm "FPP mode switch rpm" ULONG Compu_FPP_switch_rpm 0 0 0 65535.9999847412 ECU_ADDRESS 0x01007B00 /end MEASUREMENT
/begin COMPU_METHOD Compu_FPP_switch_rpm " " RAT_FUNC "%.0" "rpm" COEFFS 0 65536 0 0 0 1 /end COMPU_METHOD
/begin MEASUREMENT FPP_switch_FPP "FPP mode switch FPP" ULONG Compu_FPP_switch_FPP 0 0 0 99.9999999767169 ECU_ADDRESS 0x01007B08 /end MEASUREMENT
/begin COMPU_METHOD Compu_FPP_switch_FPP " " RAT_FUNC "%.1" "%" COEFFS 0 42949672.96 0 0 0 1 /end COMPU_METHOD
/begin MEASUREMENT FPP_switch_state "FPP mode switch slew state{FPP_switch_state&0xff=0:Inactive}{FPP_switch_state&0xff=1:RPM slew up active}{FPP_switch_state&0xff=2:FPP slew up active}" UBYTE FPP_switch_state_COMPU_VTAB 0 0 0 255 ECU_ADDRESS 0x01007B10 BIT_MASK 0xff /end MEASUREMENT
/begin COMPU_METHOD FPP_switch_state_COMPU_VTAB "Verbal Table" TAB_VERB "%.0" "list" COMPU_TAB_REF FPP_switch_state_COMPU_VTAB_REF /end COMPU_METHOD
/begin COMPU_VTAB FPP_switch_state_COMPU_VTAB_REF "Verbal Table" TAB_VERB 3 0 "Inactive" 1 "RPM slew up active" 2 "FPP slew up active" DEFAULT_VALUE "UNKNOWN" /end COMPU_VTAB
/begin CHARACTERISTIC FSO_fault_mode "FSO UEGO fault ignore mode{FSO_fault_mode&0xff=0:FSO Active}{FSO_fault_mode&0xff=1:FSO Active or CL Inactive}" VALUE 0x001c873a /* @ECU_Address@FSO_fault_mode@0x010085A0@ */ ECIPP_ALIGNMENT_UBYTE 255 FSO_fault_mode_COMPU_VTAB 0 255 BIT_MASK 0xff /end CHARACTERISTIC
/begin COMPU_METHOD FSO_fault_mode_COMPU_VTAB "Verbal Table" TAB_VERB "%.0" "list" COMPU_TAB_REF FSO_fault_mode_COMPU_VTAB_REF /end COMPU_METHOD
/begin COMPU_VTAB FSO_fault_mode_COMPU_VTAB_REF "Verbal Table" TAB_VERB 2 0 "FSO Active" 1 "FSO Active or CL Inactive" DEFAULT_VALUE "UNKNOWN" /end COMPU_VTAB
/begin CHARACTERISTIC APSdualpot_ena "Dual pot actuator A{APSdualpot_ena&0xff=0:Disabled}{APSdualpot_ena&0xff=1:Enabled}" VALUE 0x001C9DFC /* @ECU_Address@APSdualpot_ena@0x010098C0@ */ ECIPP_ALIGNMENT_UBYTE 255 APSdualpot_ena_COMPU_VTAB 0 255 BIT_MASK 0xff /end CHARACTERISTIC
/begin COMPU_METHOD APSdualpot_ena_COMPU_VTAB "Verbal Table" TAB_VERB "%.0" "list" COMPU_TAB_REF APSdualpot_ena_COMPU_VTAB_REF /end COMPU_METHOD
/begin COMPU_VTAB APSdualpot_ena_COMPU_VTAB_REF "Verbal Table" TAB_VERB 2 0 "Disabled" 1 "Enabled" DEFAULT_VALUE "UNKNOWN" /end COMPU_VTAB
/begin CHARACTERISTIC BPSdualpot_ena "Dual pot actuator B{BPSdualpot_ena&0xff=0:Disabled}{BPSdualpot_ena&0xff=1:Enabled}" VALUE 0x001C9E9C /* @ECU_Address@BPSdualpot_ena@0x010098C8@ */ ECIPP_ALIGNMENT_UBYTE 255 BPSdualpot_ena_COMPU_VTAB 0 255 BIT_MASK 0xff /end CHARACTERISTIC
/begin COMPU_METHOD BPSdualpot_ena_COMPU_VTAB "Verbal Table" TAB_VERB "%.0" "list" COMPU_TAB_REF BPSdualpot_ena_COMPU_VTAB_REF /end COMPU_METHOD
/begin COMPU_VTAB BPSdualpot_ena_COMPU_VTAB_REF "Verbal Table" TAB_VERB 2 0 "Disabled" 1 "Enabled" DEFAULT_VALUE "UNKNOWN" /end COMPU_VTAB
/begin CHARACTERISTIC APS2ctl_allow "PS2 backup ctl{APS2ctl_allow&0xff=0:Disabled}{APS2ctl_allow&0xff=1:Enabled}" VALUE 0x001C9DFD /* @ECU_Address@APS2ctl_allow@0x010098D0@ */ ECIPP_ALIGNMENT_UBYTE 255 APS2ctl_allow_COMPU_VTAB 0 255 BIT_MASK 0xff /end CHARACTERISTIC
/begin COMPU_METHOD APS2ctl_allow_COMPU_VTAB "Verbal Table" TAB_VERB "%.0" "list" COMPU_TAB_REF APS2ctl_allow_COMPU_VTAB_REF /end COMPU_METHOD
/begin COMPU_VTAB APS2ctl_allow_COMPU_VTAB_REF "Verbal Table" TAB_VERB 2 0 "Disabled" 1 "Enabled" DEFAULT_VALUE "UNKNOWN" /end COMPU_VTAB
/begin CHARACTERISTIC BPS2ctl_allow "PS2 backup ctl{BPS2ctl_allow&0xff=0:Disabled}{BPS2ctl_allow&0xff=1:Enabled}" VALUE 0x001C9E9D /* @ECU_Address@BPS2ctl_allow@0x010098D8@ */ ECIPP_ALIGNMENT_UBYTE 255 BPS2ctl_allow_COMPU_VTAB 0 255 BIT_MASK 0xff /end CHARACTERISTIC
/begin COMPU_METHOD BPS2ctl_allow_COMPU_VTAB "Verbal Table" TAB_VERB "%.0" "list" COMPU_TAB_REF BPS2ctl_allow_COMPU_VTAB_REF /end COMPU_METHOD
/begin COMPU_VTAB BPS2ctl_allow_COMPU_VTAB_REF "Verbal Table" TAB_VERB 2 0 "Disabled" 1 "Enabled" DEFAULT_VALUE "UNKNOWN" /end COMPU_VTAB
/begin CHARACTERISTIC APS12ctl_choice "PS1/2 mismatch{APS12ctl_choice&0xff=0:PS1}{APS12ctl_choice&0xff=1:Higher %}" VALUE 0x001C9DFE /* @ECU_Address@APS12ctl_choice@0x010098E0@ */ ECIPP_ALIGNMENT_UBYTE 255 APS12ctl_choice_COMPU_VTAB 0 255 BIT_MASK 0xff /end CHARACTERISTIC
/begin COMPU_METHOD APS12ctl_choice_COMPU_VTAB "Verbal Table" TAB_VERB "%.0" "list" COMPU_TAB_REF APS12ctl_choice_COMPU_VTAB_REF /end COMPU_METHOD
/begin COMPU_VTAB APS12ctl_choice_COMPU_VTAB_REF "Verbal Table" TAB_VERB 2 0 "PS1" 1 "Higher %" DEFAULT_VALUE "UNKNOWN" /end COMPU_VTAB
/begin CHARACTERISTIC BPS12ctl_choice "PS1/2 mismatch{BPS12ctl_choice&0xff=0:PS1}{BPS12ctl_choice&0xff=1:Higher %}" VALUE 0x001C9E9E /* @ECU_Address@BPS12ctl_choice@0x010098E8@ */ ECIPP_ALIGNMENT_UBYTE 255 BPS12ctl_choice_COMPU_VTAB 0 255 BIT_MASK 0xff /end CHARACTERISTIC
/begin COMPU_METHOD BPS12ctl_choice_COMPU_VTAB "Verbal Table" TAB_VERB "%.0" "list" COMPU_TAB_REF BPS12ctl_choice_COMPU_VTAB_REF /end COMPU_METHOD
/begin COMPU_VTAB BPS12ctl_choice_COMPU_VTAB_REF "Verbal Table" TAB_VERB 2 0 "PS1" 1 "Higher %" DEFAULT_VALUE "UNKNOWN" /end COMPU_VTAB
/begin CHARACTERISTIC Kp_AFB "Kp_AFB" VALUE 0x001C9E1C /* @ECU_Address@Kp_AFB@0x01009A10@ */ ECIPP_ALIGNMENT_SWORD 64 Compu_Kp_AFB -64 63.998046875 /end CHARACTERISTIC
/begin COMPU_METHOD Compu_Kp_AFB " " RAT_FUNC "%.1" "% / %" COEFFS 0 512 0 0 0 1 /end COMPU_METHOD
/begin CHARACTERISTIC Kp_BFB "Kp_BFB" VALUE 0x001C9EBC /* @ECU_Address@Kp_BFB@0x01009A18@ */ ECIPP_ALIGNMENT_SWORD 64 Compu_Kp_BFB -64 63.998046875 /end CHARACTERISTIC
/begin COMPU_METHOD Compu_Kp_BFB " " RAT_FUNC "%.1" "% / %" COEFFS 0 512 0 0 0 1 /end COMPU_METHOD
/begin CHARACTERISTIC Ki_AFB "Ki_AFB" VALUE 0x001C9E20 /* @ECU_Address@Ki_AFB@0x01009A20@ */ ECIPP_ALIGNMENT_SWORD 2000 Compu_Ki_AFB -2000 1999.93896484375 /end CHARACTERISTIC
/begin COMPU_METHOD Compu_Ki_AFB " " RAT_FUNC "%.1" "% / % / sec" COEFFS 0 16.384 0 0 0 1 /end COMPU_METHOD
/begin CHARACTERISTIC Ki_BFB "Ki_BFB" VALUE 0x001C9EC0 /* @ECU_Address@Ki_BFB@0x01009A28@ */ ECIPP_ALIGNMENT_SWORD 2000 Compu_Ki_BFB -2000 1999.93896484375 /end CHARACTERISTIC
/begin COMPU_METHOD Compu_Ki_BFB " " RAT_FUNC "%.1" "% / % / sec" COEFFS 0 16.384 0 0 0 1 /end COMPU_METHOD
/begin CHARACTERISTIC Kd_AFB "Kd_AFB" VALUE 0x001C9E22 /* @ECU_Address@Kd_AFB@0x01009A30@ */ ECIPP_ALIGNMENT_SWORD 1 Compu_Kd_AFB -1.024 1.02396875 /end CHARACTERISTIC
/begin COMPU_METHOD Compu_Kd_AFB " " RAT_FUNC "%.3" "% / % * sec" COEFFS 0 32000 0 0 0 1 /end COMPU_METHOD
/begin CHARACTERISTIC Kd_BFB "Kd_BFB" VALUE 0x001C9EC2 /* @ECU_Address@Kd_BFB@0x01009A38@ */ ECIPP_ALIGNMENT_SWORD 1 Compu_Kd_BFB -1.024 1.02396875 /end CHARACTERISTIC
/begin COMPU_METHOD Compu_Kd_BFB " " RAT_FUNC "%.3" "% / % * sec" COEFFS 0 32000 0 0 0 1 /end COMPU_METHOD
/begin CHARACTERISTIC Kp_clo_AFB "Kp_AFB closing offset" VALUE 0x001C9E1E /* @ECU_Address@Kp_clo_AFB@0x01009A40@ */ ECIPP_ALIGNMENT_SWORD 64 Compu_Kp_clo_AFB -64 63.998046875 /end CHARACTERISTIC
/begin COMPU_METHOD Compu_Kp_clo_AFB " " RAT_FUNC "%.1" "% / %" COEFFS 0 512 0 0 0 1 /end COMPU_METHOD
/begin CHARACTERISTIC Kp_clo_BFB "Kp_BFB closing offset" VALUE 0x001C9EBE /* @ECU_Address@Kp_clo_BFB@0x01009A48@ */ ECIPP_ALIGNMENT_SWORD 64 Compu_Kp_clo_BFB -64 63.998046875 /end CHARACTERISTIC
/begin COMPU_METHOD Compu_Kp_clo_BFB " " RAT_FUNC "%.1" "% / %" COEFFS 0 512 0 0 0 1 /end COMPU_METHOD
/begin CHARACTERISTIC Kd_clo_AFB "Kd_AFB closing offset" VALUE 0x001C9E24 /* @ECU_Address@Kd_clo_AFB@0x01009A50@ */ ECIPP_ALIGNMENT_SWORD 1 Compu_Kd_clo_AFB -1.024 1.02396875 /end CHARACTERISTIC
/begin COMPU_METHOD Compu_Kd_clo_AFB " " RAT_FUNC "%.3" "% / % * sec" COEFFS 0 32000 0 0 0 1 /end COMPU_METHOD
/begin CHARACTERISTIC Kd_clo_BFB "Kd_BFB closing offset" VALUE 0x001C9EC4 /* @ECU_Address@Kd_clo_BFB@0x01009A58@ */ ECIPP_ALIGNMENT_SWORD 1 Compu_Kd_clo_BFB -1.024 1.02396875 /end CHARACTERISTIC
/begin COMPU_METHOD Compu_Kd_clo_BFB " " RAT_FUNC "%.3" "% / % * sec" COEFFS 0 32000 0 0 0 1 /end COMPU_METHOD
/begin CHARACTERISTIC I_AFB_min "I_AFB_min" VALUE 0x001C9E26 /* @ECU_Address@I_AFB_min@0x01009A60@ */ ECIPP_ALIGNMENT_SWORD 25599 Compu_I_AFB_min -25600 25599.21875 /end CHARACTERISTIC
/begin COMPU_METHOD Compu_I_AFB_min " " RAT_FUNC "%.0" "%" COEFFS 0 1.28 0 0 0 1 /end COMPU_METHOD
/begin CHARACTERISTIC I_BFB_min "I_BFB_min" VALUE 0x001C9EC6 /* @ECU_Address@I_BFB_min@0x01009A68@ */ ECIPP_ALIGNMENT_SWORD 25599 Compu_I_BFB_min -25600 25599.21875 /end CHARACTERISTIC
/begin COMPU_METHOD Compu_I_BFB_min " " RAT_FUNC "%.0" "%" COEFFS 0 1.28 0 0 0 1 /end COMPU_METHOD
/begin CHARACTERISTIC I_AFB_max "I_AFB_max" VALUE 0x001C9E28 /* @ECU_Address@I_AFB_max@0x01009A70@ */ ECIPP_ALIGNMENT_SWORD 25599 Compu_I_AFB_max -25600 25599.21875 /end CHARACTERISTIC
/begin COMPU_METHOD Compu_I_AFB_max " " RAT_FUNC "%.0" "%" COEFFS 0 1.28 0 0 0 1 /end COMPU_METHOD
/begin CHARACTERISTIC I_BFB_max "I_BFB_max" VALUE 0x001C9EC8 /* @ECU_Address@I_BFB_max@0x01009A78@ */ ECIPP_ALIGNMENT_SWORD 25599 Compu_I_BFB_max -25600 25599.21875 /end CHARACTERISTIC
/begin COMPU_METHOD Compu_I_BFB_max " " RAT_FUNC "%.0" "%" COEFFS 0 1.28 0 0 0 1 /end COMPU_METHOD
/begin CHARACTERISTIC I_AFBdt_frz "I_AFBdt_frz" VALUE 0x001C9E2A /* @ECU_Address@I_AFBdt_frz@0x01009A80@ */ ECIPP_ALIGNMENT_SWORD 12500 Compu_I_AFBdt_frz -12500 12499.6185302734 /end CHARACTERISTIC
/begin COMPU_METHOD Compu_I_AFBdt_frz " " RAT_FUNC "%.1" "% / sec" COEFFS 0 2.62144 0 0 0 1 /end COMPU_METHOD
/begin CHARACTERISTIC I_BFBdt_frz "I_BFBdt_frz" VALUE 0x001C9ECA /* @ECU_Address@I_BFBdt_frz@0x01009A88@ */ ECIPP_ALIGNMENT_SWORD 12500 Compu_I_BFBdt_frz -12500 12499.6185302734 /end CHARACTERISTIC
/begin COMPU_METHOD Compu_I_BFBdt_frz " " RAT_FUNC "%.1" "% / sec" COEFFS 0 2.62144 0 0 0 1 /end COMPU_METHOD
/begin CHARACTERISTIC HBA_ctl_min "HBA_ctl_min" VALUE 0x001C9E2C /* @ECU_Address@HBA_ctl_min@0x01009A90@ */ ECIPP_ALIGNMENT_SWORD 25599 Compu_HBA_ctl_min -25600 25599.21875 /end CHARACTERISTIC
/begin COMPU_METHOD Compu_HBA_ctl_min " " RAT_FUNC "%.0" "%" COEFFS 0 1.28 0 0 0 1 /end COMPU_METHOD
/begin CHARACTERISTIC HBB_ctl_min "HBB_ctl_min" VALUE 0x001C9ECC /* @ECU_Address@HBB_ctl_min@0x01009A98@ */ ECIPP_ALIGNMENT_SWORD 25599 Compu_HBB_ctl_min -25600 25599.21875 /end CHARACTERISTIC
/begin COMPU_METHOD Compu_HBB_ctl_min " " RAT_FUNC "%.0" "%" COEFFS 0 1.28 0 0 0 1 /end COMPU_METHOD
/begin CHARACTERISTIC HBA_ctl_max "HBA_ctl_max" VALUE 0x001C9E2E /* @ECU_Address@HBA_ctl_max@0x01009AA0@ */ ECIPP_ALIGNMENT_SWORD 25599 Compu_HBA_ctl_max -25600 25599.21875 /end CHARACTERISTIC
/begin COMPU_METHOD Compu_HBA_ctl_max " " RAT_FUNC "%.0" "%" COEFFS 0 1.28 0 0 0 1 /end COMPU_METHOD
/begin CHARACTERISTIC HBB_ctl_max "HBB_ctl_max" VALUE 0x001C9ECE /* @ECU_Address@HBB_ctl_max@0x01009AA8@ */ ECIPP_ALIGNMENT_SWORD 25599 Compu_HBB_ctl_max -25600 25599.21875 /end CHARACTERISTIC
/begin COMPU_METHOD Compu_HBB_ctl_max " " RAT_FUNC "%.0" "%" COEFFS 0 1.28 0 0 0 1 /end COMPU_METHOD
/begin CHARACTERISTIC ACSB_ena "Actuator closed-stop brake function{ACSB_ena&0xff=0:Disabled}{ACSB_ena&0xff=1:Enabled}" VALUE 0x001C9E7A /* @ECU_Address@ACSB_ena@0x01009BA0@ */ ECIPP_ALIGNMENT_UBYTE 255 ACSB_ena_COMPU_VTAB 0 255 BIT_MASK 0xff /end CHARACTERISTIC
/begin COMPU_METHOD ACSB_ena_COMPU_VTAB "Verbal Table" TAB_VERB "%.0" "list" COMPU_TAB_REF ACSB_ena_COMPU_VTAB_REF /end COMPU_METHOD
/begin COMPU_VTAB ACSB_ena_COMPU_VTAB_REF "Verbal Table" TAB_VERB 2 0 "Disabled" 1 "Enabled" DEFAULT_VALUE "UNKNOWN" /end COMPU_VTAB
/begin CHARACTERISTIC BCSB_ena "Actuator closed-stop brake function{BCSB_ena&0xff=0:Disabled}{BCSB_ena&0xff=1:Enabled}" VALUE 0x001C9F1A /* @ECU_Address@BCSB_ena@0x01009BA8@ */ ECIPP_ALIGNMENT_UBYTE 255 BCSB_ena_COMPU_VTAB 0 255 BIT_MASK 0xff /end CHARACTERISTIC
/begin COMPU_METHOD BCSB_ena_COMPU_VTAB "Verbal Table" TAB_VERB "%.0" "list" COMPU_TAB_REF BCSB_ena_COMPU_VTAB_REF /end COMPU_METHOD
/begin COMPU_VTAB BCSB_ena_COMPU_VTAB_REF "Verbal Table" TAB_VERB 2 0 "Disabled" 1 "Enabled" DEFAULT_VALUE "UNKNOWN" /end COMPU_VTAB
/begin CHARACTERISTIC ACSB_APSdelta "Closed-stop APS delta" VALUE 0x001C9E7C /* @ECU_Address@ACSB_APSdelta@0x01009BB0@ */ ECIPP_ALIGNMENT_UWORD 5 Compu_ACSB_APSdelta 0 5.00114468864469 /end CHARACTERISTIC
/begin COMPU_METHOD Compu_ACSB_APSdelta " " RAT_FUNC "%.3" "volts" COEFFS 0 13104 0 0 0 1 /end COMPU_METHOD
/begin CHARACTERISTIC BCSB_BPSdelta "Closed-stop BPS delta" VALUE 0x001C9F1C /* @ECU_Address@BCSB_BPSdelta@0x01009BB8@ */ ECIPP_ALIGNMENT_UWORD 5 Compu_BCSB_BPSdelta 0 5.00114468864469 /end CHARACTERISTIC
/begin COMPU_METHOD Compu_BCSB_BPSdelta " " RAT_FUNC "%.3" "volts" COEFFS 0 13104 0 0 0 1 /end COMPU_METHOD
/begin CHARACTERISTIC ACSB_min_APSdt "Closed-stop min APS APSdt" VALUE 0x001C9E7E /* @ECU_Address@ACSB_min_APSdt@0x01009BC0@ */ ECIPP_ALIGNMENT_SWORD 12500 Compu_ACSB_min_APSdt -12500 12499.6185302734 /end CHARACTERISTIC
/begin COMPU_METHOD Compu_ACSB_min_APSdt " " RAT_FUNC "%.1" "%/sec" COEFFS 0 2.62144 0 0 0 1 /end COMPU_METHOD
/begin CHARACTERISTIC BCSB_min_BPSdt "Closed-stop min BPS BPSdt" VALUE 0x001C9F1E /* @ECU_Address@BCSB_min_BPSdt@0x01009BC8@ */ ECIPP_ALIGNMENT_SWORD 12500 Compu_BCSB_min_BPSdt -12500 12499.6185302734 /end CHARACTERISTIC
/begin COMPU_METHOD Compu_BCSB_min_BPSdt " " RAT_FUNC "%.1" "%/sec" COEFFS 0 2.62144 0 0 0 1 /end COMPU_METHOD
/begin CHARACTERISTIC ACSB_max_APSdt "Closed-stop max APS APSdt" VALUE 0x001C9E80 /* @ECU_Address@ACSB_max_APSdt@0x01009BD0@ */ ECIPP_ALIGNMENT_SWORD 12500 Compu_ACSB_max_APSdt -12500 12499.6185302734 /end CHARACTERISTIC
/begin COMPU_METHOD Compu_ACSB_max_APSdt " " RAT_FUNC "%.1" "%/sec" COEFFS 0 2.62144 0 0 0 1 /end COMPU_METHOD
/begin CHARACTERISTIC BCSB_max_BPSdt "Closed-stop max BPS BPSdt" VALUE 0x001C9F20 /* @ECU_Address@BCSB_max_BPSdt@0x01009BD8@ */ ECIPP_ALIGNMENT_SWORD 12500 Compu_BCSB_max_BPSdt -12500 12499.6185302734 /end CHARACTERISTIC
/begin COMPU_METHOD Compu_BCSB_max_BPSdt " " RAT_FUNC "%.1" "%/sec" COEFFS 0 2.62144 0 0 0 1 /end COMPU_METHOD
/begin CHARACTERISTIC ACSB_Kd "Closed-stop braking Kd" VALUE 0x001C9E82 /* @ECU_Address@ACSB_Kd@0x01009BE0@ */ ECIPP_ALIGNMENT_SWORD 1 Compu_ACSB_Kd -1.024 1.02396875 /end CHARACTERISTIC
/begin COMPU_METHOD Compu_ACSB_Kd " " RAT_FUNC "%.3" "%/%*sec" COEFFS 0 32000 0 0 0 1 /end COMPU_METHOD
/begin CHARACTERISTIC BCSB_Kd "Closed-stop braking Kd" VALUE 0x001C9F22 /* @ECU_Address@BCSB_Kd@0x01009BE8@ */ ECIPP_ALIGNMENT_SWORD 1 Compu_BCSB_Kd -1.024 1.02396875 /end CHARACTERISTIC
/begin COMPU_METHOD Compu_BCSB_Kd " " RAT_FUNC "%.3" "%/%*sec" COEFFS 0 32000 0 0 0 1 /end COMPU_METHOD
/begin CHARACTERISTIC AOSB_ena "Actuator open-stop brake function{AOSB_ena&0xff=0:Disabled}{AOSB_ena&0xff=1:Enabled}" VALUE 0x001C9E84 /* @ECU_Address@AOSB_ena@0x01009BF0@ */ ECIPP_ALIGNMENT_UBYTE 255 AOSB_ena_COMPU_VTAB 0 255 BIT_MASK 0xff /end CHARACTERISTIC
/begin COMPU_METHOD AOSB_ena_COMPU_VTAB "Verbal Table" TAB_VERB "%.0" "list" COMPU_TAB_REF AOSB_ena_COMPU_VTAB_REF /end COMPU_METHOD
/begin COMPU_VTAB AOSB_ena_COMPU_VTAB_REF "Verbal Table" TAB_VERB 2 0 "Disabled" 1 "Enabled" DEFAULT_VALUE "UNKNOWN" /end COMPU_VTAB
/begin CHARACTERISTIC BOSB_ena "Actuator open-stop brake function{BOSB_ena&0xff=0:Disabled}{BOSB_ena&0xff=1:Enabled}" VALUE 0x001C9F24 /* @ECU_Address@BOSB_ena@0x01009BF8@ */ ECIPP_ALIGNMENT_UBYTE 255 BOSB_ena_COMPU_VTAB 0 255 BIT_MASK 0xff /end CHARACTERISTIC
/begin COMPU_METHOD BOSB_ena_COMPU_VTAB "Verbal Table" TAB_VERB "%.0" "list" COMPU_TAB_REF BOSB_ena_COMPU_VTAB_REF /end COMPU_METHOD
/begin COMPU_VTAB BOSB_ena_COMPU_VTAB_REF "Verbal Table" TAB_VERB 2 0 "Disabled" 1 "Enabled" DEFAULT_VALUE "UNKNOWN" /end COMPU_VTAB
/begin CHARACTERISTIC AOSB_APSdelta "Open-stop APS delta" VALUE 0x001C9E86 /* @ECU_Address@AOSB_APSdelta@0x01009C00@ */ ECIPP_ALIGNMENT_UWORD 5 Compu_AOSB_APSdelta 0 5.00114468864469 /end CHARACTERISTIC
/begin COMPU_METHOD Compu_AOSB_APSdelta " " RAT_FUNC "%.3" "volts" COEFFS 0 13104 0 0 0 1 /end COMPU_METHOD
/begin CHARACTERISTIC BOSB_BPSdelta "Open-stop BPS delta" VALUE 0x001C9F26 /* @ECU_Address@BOSB_BPSdelta@0x01009C08@ */ ECIPP_ALIGNMENT_UWORD 5 Compu_BOSB_BPSdelta 0 5.00114468864469 /end CHARACTERISTIC
/begin COMPU_METHOD Compu_BOSB_BPSdelta " " RAT_FUNC "%.3" "volts" COEFFS 0 13104 0 0 0 1 /end COMPU_METHOD
/begin CHARACTERISTIC AOSB_min_APSdt "Open-stop min APS APSdt" VALUE 0x001C9E88 /* @ECU_Address@AOSB_min_APSdt@0x01009C10@ */ ECIPP_ALIGNMENT_SWORD 12500 Compu_AOSB_min_APSdt -12500 12499.6185302734 /end CHARACTERISTIC
/begin COMPU_METHOD Compu_AOSB_min_APSdt " " RAT_FUNC "%.1" "%/sec" COEFFS 0 2.62144 0 0 0 1 /end COMPU_METHOD
/begin CHARACTERISTIC BOSB_min_BPSdt "Open-stop min BPS BPSdt" VALUE 0x001C9F28 /* @ECU_Address@BOSB_min_BPSdt@0x01009C18@ */ ECIPP_ALIGNMENT_SWORD 12500 Compu_BOSB_min_BPSdt -12500 12499.6185302734 /end CHARACTERISTIC
/begin COMPU_METHOD Compu_BOSB_min_BPSdt " " RAT_FUNC "%.1" "%/sec" COEFFS 0 2.62144 0 0 0 1 /end COMPU_METHOD
/begin CHARACTERISTIC AOSB_max_APSdt "Open-stop max APS APSdt" VALUE 0x001C9E8A /* @ECU_Address@AOSB_max_APSdt@0x01009C20@ */ ECIPP_ALIGNMENT_SWORD 12500 Compu_AOSB_max_APSdt -12500 12499.6185302734 /end CHARACTERISTIC
/begin COMPU_METHOD Compu_AOSB_max_APSdt " " RAT_FUNC "%.1" "%/sec" COEFFS 0 2.62144 0 0 0 1 /end COMPU_METHOD
/begin CHARACTERISTIC BOSB_max_BPSdt "Open-stop max BPS BPSdt" VALUE 0x001C9F2A /* @ECU_Address@BOSB_max_BPSdt@0x01009C28@ */ ECIPP_ALIGNMENT_SWORD 12500 Compu_BOSB_max_BPSdt -12500 12499.6185302734 /end CHARACTERISTIC
/begin COMPU_METHOD Compu_BOSB_max_BPSdt " " RAT_FUNC "%.1" "%/sec" COEFFS 0 2.62144 0 0 0 1 /end COMPU_METHOD
/begin CHARACTERISTIC AOSB_Kd "Open-stop braking Kd" VALUE 0x001C9E8C /* @ECU_Address@AOSB_Kd@0x01009C30@ */ ECIPP_ALIGNMENT_SWORD 1 Compu_AOSB_Kd -1.024 1.02396875 /end CHARACTERISTIC
/begin COMPU_METHOD Compu_AOSB_Kd " " RAT_FUNC "%.3" "%/%*sec" COEFFS 0 32000 0 0 0 1 /end COMPU_METHOD
/begin CHARACTERISTIC BOSB_Kd "Open-stop braking Kd" VALUE 0x001C9F2C /* @ECU_Address@BOSB_Kd@0x01009C38@ */ ECIPP_ALIGNMENT_SWORD 1 Compu_BOSB_Kd -1.024 1.02396875 /end CHARACTERISTIC
/begin COMPU_METHOD Compu_BOSB_Kd " " RAT_FUNC "%.3" "%/%*sec" COEFFS 0 32000 0 0 0 1 /end COMPU_METHOD
/begin MEASUREMENT I_AFB_acc "I_AFB_acc" SLONG Compu_I_AFB_acc 0 0 -25600 25599.9999880791 ECU_ADDRESS 0x01009C60 /end MEASUREMENT
/begin COMPU_METHOD Compu_I_AFB_acc " " RAT_FUNC "%.1" "%" COEFFS 0 83886.08 0 0 0 1 /end COMPU_METHOD
/begin MEASUREMENT I_BFB_acc "I_BFB_acc" SLONG Compu_I_BFB_acc 0 0 -25600 25599.9999880791 ECU_ADDRESS 0x01009C68 /end MEASUREMENT
/begin COMPU_METHOD Compu_I_BFB_acc " " RAT_FUNC "%.1" "%" COEFFS 0 83886.08 0 0 0 1 /end COMPU_METHOD
/begin MEASUREMENT HBA_ctl_cmd "HBA_ctl_cmd" SWORD Compu_HBA_ctl_cmd 0 0 -100 99.9969482421875 ECU_ADDRESS 0x01009C70 /end MEASUREMENT
/begin COMPU_METHOD Compu_HBA_ctl_cmd " " RAT_FUNC "%.1" "%" COEFFS 0 327.68 0 0 0 1 /end COMPU_METHOD
/begin MEASUREMENT HBB_ctl_cmd "HBB_ctl_cmd" SWORD Compu_HBB_ctl_cmd 0 0 -100 99.9969482421875 ECU_ADDRESS 0x01009C78 /end MEASUREMENT
/begin COMPU_METHOD Compu_HBB_ctl_cmd " " RAT_FUNC "%.1" "%" COEFFS 0 327.68 0 0 0 1 /end COMPU_METHOD
/begin MEASUREMENT AEM_I "AEM_I" SWORD Compu_AEM_I 0 0 -32 31.9990234375 ECU_ADDRESS 0x01009C80 /end MEASUREMENT
/begin COMPU_METHOD Compu_AEM_I " " RAT_FUNC "%.2" "amps" COEFFS 0 1024 0 0 0 1 /end COMPU_METHOD
/begin MEASUREMENT BEM_I "BEM_I" SWORD Compu_BEM_I 0 0 -32 31.9990234375 ECU_ADDRESS 0x01009C88 /end MEASUREMENT
/begin COMPU_METHOD Compu_BEM_I " " RAT_FUNC "%.2" "amps" COEFFS 0 1024 0 0 0 1 /end COMPU_METHOD
/begin MEASUREMENT APS_cmd_pct "APS_cmd_pct" UWORD Compu_APS_cmd_pct 0 0 0 99.9984741210938 ECU_ADDRESS 0x01009C90 /end MEASUREMENT
/begin COMPU_METHOD Compu_APS_cmd_pct " " RAT_FUNC "%.1" "%" COEFFS 0 655.36 0 0 0 1 /end COMPU_METHOD
/begin MEASUREMENT BPS_cmd_pct "BPS_cmd_pct" UWORD Compu_BPS_cmd_pct 0 0 0 99.9984741210938 ECU_ADDRESS 0x01009C98 /end MEASUREMENT
/begin COMPU_METHOD Compu_BPS_cmd_pct " " RAT_FUNC "%.1" "%" COEFFS 0 655.36 0 0 0 1 /end COMPU_METHOD
/begin MEASUREMENT APS_cmd_AD "APS_cmd_AD" UWORD Compu_APS_cmd_AD 0 0 0 5.00114468864469 ECU_ADDRESS 0x01009CA0 /end MEASUREMENT
/begin COMPU_METHOD Compu_APS_cmd_AD " " RAT_FUNC "%.3" "volts" COEFFS 0 13104 0 0 0 1 /end COMPU_METHOD
/begin MEASUREMENT BPS_cmd_AD "BPS_cmd_AD" UWORD Compu_BPS_cmd_AD 0 0 0 5.00114468864469 ECU_ADDRESS 0x01009CA8 /end MEASUREMENT
/begin COMPU_METHOD Compu_BPS_cmd_AD " " RAT_FUNC "%.3" "volts" COEFFS 0 13104 0 0 0 1 /end COMPU_METHOD
/begin MEASUREMENT APS_pct "APS_pct" UWORD Compu_APS_pct 0 0 0 99.9984741210938 ECU_ADDRESS 0x01009CB0 /end MEASUREMENT
/begin COMPU_METHOD Compu_APS_pct " " RAT_FUNC "%.1" "%" COEFFS 0 655.36 0 0 0 1 /end COMPU_METHOD
/begin MEASUREMENT BPS_pct "BPS_pct" UWORD Compu_BPS_pct 0 0 0 99.9984741210938 ECU_ADDRESS 0x01009CB8 /end MEASUREMENT
/begin COMPU_METHOD Compu_BPS_pct " " RAT_FUNC "%.1" "%" COEFFS 0 655.36 0 0 0 1 /end COMPU_METHOD
/begin MEASUREMENT AFBdt "AFBdt" SWORD Compu_AFBdt 0 0 -12500 12499.6185302734 ECU_ADDRESS 0x01009CC0 /end MEASUREMENT
/begin COMPU_METHOD Compu_AFBdt " " RAT_FUNC "%.1" "%/sec" COEFFS 0 2.62144 0 0 0 1 /end COMPU_METHOD
/begin MEASUREMENT BFBdt "BFBdt" SWORD Compu_BFBdt 0 0 -12500 12499.6185302734 ECU_ADDRESS 0x01009CC8 /end MEASUREMENT
/begin COMPU_METHOD Compu_BFBdt " " RAT_FUNC "%.1" "%/sec" COEFFS 0 2.62144 0 0 0 1 /end COMPU_METHOD
/begin MEASUREMENT APS1_rawfilt "APS1_rawfilt" UWORD Compu_APS1_rawfilt 0 0 0 5.00114468864469 ECU_ADDRESS 0x01009CD0 /end MEASUREMENT
/begin COMPU_METHOD Compu_APS1_rawfilt " " RAT_FUNC "%.3" "volts" COEFFS 0 13104 0 0 0 1 /end COMPU_METHOD
/begin MEASUREMENT BPS1_rawfilt "BPS1_rawfilt" UWORD Compu_BPS1_rawfilt 0 0 0 5.00114468864469 ECU_ADDRESS 0x01009CD8 /end MEASUREMENT
/begin COMPU_METHOD Compu_BPS1_rawfilt " " RAT_FUNC "%.3" "volts" COEFFS 0 13104 0 0 0 1 /end COMPU_METHOD
/begin MEASUREMENT APS2_rawfilt "APS2_rawfilt" UWORD Compu_APS2_rawfilt 0 0 0 5.00114468864469 ECU_ADDRESS 0x01009CE0 /end MEASUREMENT
/begin COMPU_METHOD Compu_APS2_rawfilt " " RAT_FUNC "%.3" "volts" COEFFS 0 13104 0 0 0 1 /end COMPU_METHOD
/begin MEASUREMENT BPS2_rawfilt "BPS2_rawfilt" UWORD Compu_BPS2_rawfilt 0 0 0 5.00114468864469 ECU_ADDRESS 0x01009CE8 /end MEASUREMENT
/begin COMPU_METHOD Compu_BPS2_rawfilt " " RAT_FUNC "%.3" "volts" COEFFS 0 13104 0 0 0 1 /end COMPU_METHOD
/begin MEASUREMENT APS1_pct "APS1_pct" UWORD Compu_APS1_pct 0 0 0 99.9984741210938 ECU_ADDRESS 0x01009CF0 /end MEASUREMENT
/begin COMPU_METHOD Compu_APS1_pct " " RAT_FUNC "%.1" "%" COEFFS 0 655.36 0 0 0 1 /end COMPU_METHOD
/begin MEASUREMENT BPS1_pct "BPS1_pct" UWORD Compu_BPS1_pct 0 0 0 99.9984741210938 ECU_ADDRESS 0x01009CF8 /end MEASUREMENT
/begin COMPU_METHOD Compu_BPS1_pct " " RAT_FUNC "%.1" "%" COEFFS 0 655.36 0 0 0 1 /end COMPU_METHOD
/begin MEASUREMENT APS1_idle "APS1_idle" UWORD Compu_APS1_idle 0 0 0 5.00114468864469 ECU_ADDRESS 0x01009D00 /end MEASUREMENT
/begin COMPU_METHOD Compu_APS1_idle " " RAT_FUNC "%.3" "volts" COEFFS 0 13104 0 0 0 1 /end COMPU_METHOD
/begin MEASUREMENT BPS1_idle "BPS1_idle" UWORD Compu_BPS1_idle 0 0 0 5.00114468864469 ECU_ADDRESS 0x01009D08 /end MEASUREMENT
/begin COMPU_METHOD Compu_BPS1_idle " " RAT_FUNC "%.3" "volts" COEFFS 0 13104 0 0 0 1 /end COMPU_METHOD
/begin MEASUREMENT APS1_full "APS1_full" UWORD Compu_APS1_full 0 0 0 5.00114468864469 ECU_ADDRESS 0x01009D10 /end MEASUREMENT
/begin COMPU_METHOD Compu_APS1_full " " RAT_FUNC "%.3" "volts" COEFFS 0 13104 0 0 0 1 /end COMPU_METHOD
/begin MEASUREMENT BPS1_full "BPS1_full" UWORD Compu_BPS1_full 0 0 0 5.00114468864469 ECU_ADDRESS 0x01009D18 /end MEASUREMENT
/begin COMPU_METHOD Compu_BPS1_full " " RAT_FUNC "%.3" "volts" COEFFS 0 13104 0 0 0 1 /end COMPU_METHOD
/begin MEASUREMENT APS2_pct "APS2_pct" UWORD Compu_APS2_pct 0 0 0 99.9984741210938 ECU_ADDRESS 0x01009D20 /end MEASUREMENT
/begin COMPU_METHOD Compu_APS2_pct " " RAT_FUNC "%.1" "%" COEFFS 0 655.36 0 0 0 1 /end COMPU_METHOD
/begin MEASUREMENT BPS2_pct "BPS2_pct" UWORD Compu_BPS2_pct 0 0 0 99.9984741210938 ECU_ADDRESS 0x01009D28 /end MEASUREMENT
/begin COMPU_METHOD Compu_BPS2_pct " " RAT_FUNC "%.1" "%" COEFFS 0 655.36 0 0 0 1 /end COMPU_METHOD
/begin MEASUREMENT APS2_idle "APS2_idle" UWORD Compu_APS2_idle 0 0 0 5.00114468864469 ECU_ADDRESS 0x01009D30 /end MEASUREMENT
/begin COMPU_METHOD Compu_APS2_idle " " RAT_FUNC "%.3" "volts" COEFFS 0 13104 0 0 0 1 /end COMPU_METHOD
/begin MEASUREMENT BPS2_idle "BPS2_idle" UWORD Compu_BPS2_idle 0 0 0 5.00114468864469 ECU_ADDRESS 0x01009D38 /end MEASUREMENT
/begin COMPU_METHOD Compu_BPS2_idle " " RAT_FUNC "%.3" "volts" COEFFS 0 13104 0 0 0 1 /end COMPU_METHOD
/begin MEASUREMENT APS2_full "APS2_full" UWORD Compu_APS2_full 0 0 0 5.00114468864469 ECU_ADDRESS 0x01009D40 /end MEASUREMENT
/begin COMPU_METHOD Compu_APS2_full " " RAT_FUNC "%.3" "volts" COEFFS 0 13104 0 0 0 1 /end COMPU_METHOD
/begin MEASUREMENT BPS2_full "BPS2_full" UWORD Compu_BPS2_full 0 0 0 5.00114468864469 ECU_ADDRESS 0x01009D48 /end MEASUREMENT
/begin COMPU_METHOD Compu_BPS2_full " " RAT_FUNC "%.3" "volts" COEFFS 0 13104 0 0 0 1 /end COMPU_METHOD
/begin CHARACTERISTIC TPS1_source "PS1 source{TPS1_source&0xff=0:Disabled}{TPS1_source&0xff=1:TPS1}{TPS1_source&0xff=2:TPS2}{TPS1_source&0xff=3:PD1}{TPS1_source&0xff=4:PD2}{TPS1_source&0xff=5:PD3}{TPS1_source&0xff=6:PUD1}{TPS1_source&0xff=7:PUD2}{TPS1_source&0xff=8:PUD3}{TPS1_source&0xff=9" VALUE 0x001C9C5C /* @ECU_Address@TPS1_source@0x01009D50@ */ ECIPP_ALIGNMENT_UBYTE 255 TPS1_source_COMPU_VTAB 0 255 BIT_MASK 0xff /end CHARACTERISTIC
/begin COMPU_METHOD TPS1_source_COMPU_VTAB "Verbal Table" TAB_VERB "%.0" "list" COMPU_TAB_REF TPS1_source_COMPU_VTAB_REF /end COMPU_METHOD
/begin COMPU_VTAB TPS1_source_COMPU_VTAB_REF "Verbal Table" TAB_VERB 38 0 "Disabled" 1 "TPS1" 2 "TPS2" 3 "PD1" 4 "PD2" 5 "PD3" 6 "PUD1" 7 "PUD2" 8 "PUD3" 9 "PUD4" 10 "PUD5" 11 "PUD6" 12 "PUD7" 13 "PUD8" 14 "PUD9" 15 "PUD10" 16 "PUD11" 17 "PUD12" 18 "PUD13" 19 "PUD14" 20 "PUD15" 21 "PUD16" 22 "PUD17" 23 "PUD18" 24 "PUD19" 25 "PUD20" 26 "PUD21" 27 "PUD22" 28 "PUD23" 29 "PUD24" 30 "PUD25" 31 "SHIFT FB" 32 "SENT1 Data1" 33 "SENT1 Data2" 34 "SENT2 Data1" 35 "SENT2 Data2" 36 "DIG23-25 Steps" 37 "MFA / AT" DEFAULT_VALUE "UNKNOWN" /end COMPU_VTAB
/begin CHARACTERISTIC TPS2_source "PS2 source{TPS2_source&0xff=0:Disabled}{TPS2_source&0xff=1:TPS1}{TPS2_source&0xff=2:TPS2}{TPS2_source&0xff=3:PD1}{TPS2_source&0xff=4:PD2}{TPS2_source&0xff=5:PD3}{TPS2_source&0xff=6:PUD1}{TPS2_source&0xff=7:PUD2}{TPS2_source&0xff=8:PUD3}{TPS2_source&0xff=9" VALUE 0x001C9C5D /* @ECU_Address@TPS2_source@0x01009D58@ */ ECIPP_ALIGNMENT_UBYTE 255 TPS2_source_COMPU_VTAB 0 255 BIT_MASK 0xff /end CHARACTERISTIC
/begin COMPU_METHOD TPS2_source_COMPU_VTAB "Verbal Table" TAB_VERB "%.0" "list" COMPU_TAB_REF TPS2_source_COMPU_VTAB_REF /end COMPU_METHOD
/begin COMPU_VTAB TPS2_source_COMPU_VTAB_REF "Verbal Table" TAB_VERB 38 0 "Disabled" 1 "TPS1" 2 "TPS2" 3 "PD1" 4 "PD2" 5 "PD3" 6 "PUD1" 7 "PUD2" 8 "PUD3" 9 "PUD4" 10 "PUD5" 11 "PUD6" 12 "PUD7" 13 "PUD8" 14 "PUD9" 15 "PUD10" 16 "PUD11" 17 "PUD12" 18 "PUD13" 19 "PUD14" 20 "PUD15" 21 "PUD16" 22 "PUD17" 23 "PUD18" 24 "PUD19" 25 "PUD20" 26 "PUD21" 27 "PUD22" 28 "PUD23" 29 "PUD24" 30 "PUD25" 31 "SHIFT FB" 32 "SENT1 Data1" 33 "SENT1 Data2" 34 "SENT2 Data1" 35 "SENT2 Data2" 36 "DIG23-25 Steps" 37 "MFA / AT" DEFAULT_VALUE "UNKNOWN" /end COMPU_VTAB
/begin CHARACTERISTIC APS1_source "PS1 source{APS1_source&0xff=0:Disabled}{APS1_source&0xff=1:TPS1}{APS1_source&0xff=2:TPS2}{APS1_source&0xff=3:PD1}{APS1_source&0xff=4:PD2}{APS1_source&0xff=5:PD3}{APS1_source&0xff=6:PUD1}{APS1_source&0xff=7:PUD2}{APS1_source&0xff=8:PUD3}{APS1_source&0xff=9" VALUE 0x001C9E30 /* @ECU_Address@APS1_source@0x01009D60@ */ ECIPP_ALIGNMENT_UBYTE 255 APS1_source_COMPU_VTAB 0 255 BIT_MASK 0xff /end CHARACTERISTIC
/begin COMPU_METHOD APS1_source_COMPU_VTAB "Verbal Table" TAB_VERB "%.0" "list" COMPU_TAB_REF APS1_source_COMPU_VTAB_REF /end COMPU_METHOD
/begin COMPU_VTAB APS1_source_COMPU_VTAB_REF "Verbal Table" TAB_VERB 38 0 "Disabled" 1 "TPS1" 2 "TPS2" 3 "PD1" 4 "PD2" 5 "PD3" 6 "PUD1" 7 "PUD2" 8 "PUD3" 9 "PUD4" 10 "PUD5" 11 "PUD6" 12 "PUD7" 13 "PUD8" 14 "PUD9" 15 "PUD10" 16 "PUD11" 17 "PUD12" 18 "PUD13" 19 "PUD14" 20 "PUD15" 21 "PUD16" 22 "PUD17" 23 "PUD18" 24 "PUD19" 25 "PUD20" 26 "PUD21" 27 "PUD22" 28 "PUD23" 29 "PUD24" 30 "PUD25" 31 "SHIFT FB" 32 "SENT1 Data1" 33 "SENT1 Data2" 34 "SENT2 Data1" 35 "SENT2 Data2" 36 "DIG23-25 Steps" 37 "MFA / AT" DEFAULT_VALUE "UNKNOWN" /end COMPU_VTAB
/begin CHARACTERISTIC APS2_source "PS2 source{APS2_source&0xff=0:Disabled}{APS2_source&0xff=1:TPS1}{APS2_source&0xff=2:TPS2}{APS2_source&0xff=3:PD1}{APS2_source&0xff=4:PD2}{APS2_source&0xff=5:PD3}{APS2_source&0xff=6:PUD1}{APS2_source&0xff=7:PUD2}{APS2_source&0xff=8:PUD3}{APS2_source&0xff=9" VALUE 0x001C9E31 /* @ECU_Address@APS2_source@0x01009D68@ */ ECIPP_ALIGNMENT_UBYTE 255 APS2_source_COMPU_VTAB 0 255 BIT_MASK 0xff /end CHARACTERISTIC
/begin COMPU_METHOD APS2_source_COMPU_VTAB "Verbal Table" TAB_VERB "%.0" "list" COMPU_TAB_REF APS2_source_COMPU_VTAB_REF /end COMPU_METHOD
/begin COMPU_VTAB APS2_source_COMPU_VTAB_REF "Verbal Table" TAB_VERB 38 0 "Disabled" 1 "TPS1" 2 "TPS2" 3 "PD1" 4 "PD2" 5 "PD3" 6 "PUD1" 7 "PUD2" 8 "PUD3" 9 "PUD4" 10 "PUD5" 11 "PUD6" 12 "PUD7" 13 "PUD8" 14 "PUD9" 15 "PUD10" 16 "PUD11" 17 "PUD12" 18 "PUD13" 19 "PUD14" 20 "PUD15" 21 "PUD16" 22 "PUD17" 23 "PUD18" 24 "PUD19" 25 "PUD20" 26 "PUD21" 27 "PUD22" 28 "PUD23" 29 "PUD24" 30 "PUD25" 31 "SHIFT FB" 32 "SENT1 Data1" 33 "SENT1 Data2" 34 "SENT2 Data1" 35 "SENT2 Data2" 36 "DIG23-25 Steps" 37 "MFA / AT" DEFAULT_VALUE "UNKNOWN" /end COMPU_VTAB
/begin CHARACTERISTIC BPS1_source "PS1 source{BPS1_source&0xff=0:Disabled}{BPS1_source&0xff=1:TPS1}{BPS1_source&0xff=2:TPS2}{BPS1_source&0xff=3:PD1}{BPS1_source&0xff=4:PD2}{BPS1_source&0xff=5:PD3}{BPS1_source&0xff=6:PUD1}{BPS1_source&0xff=7:PUD2}{BPS1_source&0xff=8:PUD3}{BPS1_source&0xff=9" VALUE 0x001C9ED0 /* @ECU_Address@BPS1_source@0x01009D70@ */ ECIPP_ALIGNMENT_UBYTE 255 BPS1_source_COMPU_VTAB 0 255 BIT_MASK 0xff /end CHARACTERISTIC
/begin COMPU_METHOD BPS1_source_COMPU_VTAB "Verbal Table" TAB_VERB "%.0" "list" COMPU_TAB_REF BPS1_source_COMPU_VTAB_REF /end COMPU_METHOD
/begin COMPU_VTAB BPS1_source_COMPU_VTAB_REF "Verbal Table" TAB_VERB 38 0 "Disabled" 1 "TPS1" 2 "TPS2" 3 "PD1" 4 "PD2" 5 "PD3" 6 "PUD1" 7 "PUD2" 8 "PUD3" 9 "PUD4" 10 "PUD5" 11 "PUD6" 12 "PUD7" 13 "PUD8" 14 "PUD9" 15 "PUD10" 16 "PUD11" 17 "PUD12" 18 "PUD13" 19 "PUD14" 20 "PUD15" 21 "PUD16" 22 "PUD17" 23 "PUD18" 24 "PUD19" 25 "PUD20" 26 "PUD21" 27 "PUD22" 28 "PUD23" 29 "PUD24" 30 "PUD25" 31 "SHIFT FB" 32 "SENT1 Data1" 33 "SENT1 Data2" 34 "SENT2 Data1" 35 "SENT2 Data2" 36 "DIG23-25 Steps" 37 "MFA / AT" DEFAULT_VALUE "UNKNOWN" /end COMPU_VTAB
/begin CHARACTERISTIC BPS2_source "PS2 source{BPS2_source&0xff=0:Disabled}{BPS2_source&0xff=1:TPS1}{BPS2_source&0xff=2:TPS2}{BPS2_source&0xff=3:PD1}{BPS2_source&0xff=4:PD2}{BPS2_source&0xff=5:PD3}{BPS2_source&0xff=6:PUD1}{BPS2_source&0xff=7:PUD2}{BPS2_source&0xff=8:PUD3}{BPS2_source&0xff=9" VALUE 0x001C9ED1 /* @ECU_Address@BPS2_source@0x01009D78@ */ ECIPP_ALIGNMENT_UBYTE 255 BPS2_source_COMPU_VTAB 0 255 BIT_MASK 0xff /end CHARACTERISTIC
/begin COMPU_METHOD BPS2_source_COMPU_VTAB "Verbal Table" TAB_VERB "%.0" "list" COMPU_TAB_REF BPS2_source_COMPU_VTAB_REF /end COMPU_METHOD
/begin COMPU_VTAB BPS2_source_COMPU_VTAB_REF "Verbal Table" TAB_VERB 38 0 "Disabled" 1 "TPS1" 2 "TPS2" 3 "PD1" 4 "PD2" 5 "PD3" 6 "PUD1" 7 "PUD2" 8 "PUD3" 9 "PUD4" 10 "PUD5" 11 "PUD6" 12 "PUD7" 13 "PUD8" 14 "PUD9" 15 "PUD10" 16 "PUD11" 17 "PUD12" 18 "PUD13" 19 "PUD14" 20 "PUD15" 21 "PUD16" 22 "PUD17" 23 "PUD18" 24 "PUD19" 25 "PUD20" 26 "PUD21" 27 "PUD22" 28 "PUD23" 29 "PUD24" 30 "PUD25" 31 "SHIFT FB" 32 "SENT1 Data1" 33 "SENT1 Data2" 34 "SENT2 Data1" 35 "SENT2 Data2" 36 "DIG23-25 Steps" 37 "MFA / AT" DEFAULT_VALUE "UNKNOWN" /end COMPU_VTAB
/begin MEASUREMENT DBW_iFB_amps "DBW current feedback" UWORD Compu_DBW_iFB_amps 0 0 0 63.9990234375 ECU_ADDRESS 0x01009E50 /end MEASUREMENT
/begin COMPU_METHOD Compu_DBW_iFB_amps " " RAT_FUNC "%.2" "amps" COEFFS 0 1024 0 0 0 1 /end COMPU_METHOD
/begin MEASUREMENT HBA_iFB_amps "HBA current feedback" UWORD Compu_HBA_iFB_amps 0 0 0 63.9990234375 ECU_ADDRESS 0x01009E58 /end MEASUREMENT
/begin COMPU_METHOD Compu_HBA_iFB_amps " " RAT_FUNC "%.2" "amps" COEFFS 0 1024 0 0 0 1 /end COMPU_METHOD
/begin MEASUREMENT HBB_iFB_amps "HBB current feedback" UWORD Compu_HBB_iFB_amps 0 0 0 63.9990234375 ECU_ADDRESS 0x01009E60 /end MEASUREMENT
/begin COMPU_METHOD Compu_HBB_iFB_amps " " RAT_FUNC "%.2" "amps" COEFFS 0 1024 0 0 0 1 /end COMPU_METHOD
/begin MEASUREMENT DBW_device_status "DBW device status{DBW_device_status&0xff=0:No support}{DBW_device_status&0xff=1:Disabled}{DBW_device_status&0xff=2:Fault}{DBW_device_status&0xff=3:OK}" UBYTE DBW_device_status_COMPU_VTAB 0 0 0 255 ECU_ADDRESS 0x01009E68 BIT_MASK 0xff /end MEASUREMENT
/begin COMPU_METHOD DBW_device_status_COMPU_VTAB "Verbal Table" TAB_VERB "%.0" "list" COMPU_TAB_REF DBW_device_status_COMPU_VTAB_REF /end COMPU_METHOD
/begin COMPU_VTAB DBW_device_status_COMPU_VTAB_REF "Verbal Table" TAB_VERB 4 0 "No support" 1 "Disabled" 2 "Fault" 3 "OK" DEFAULT_VALUE "UNKNOWN" /end COMPU_VTAB
/begin MEASUREMENT HBA_device_status "HBA device status{HBA_device_status&0xff=0:No support}{HBA_device_status&0xff=1:Disabled}{HBA_device_status&0xff=2:Fault}{HBA_device_status&0xff=3:OK}" UBYTE HBA_device_status_COMPU_VTAB 0 0 0 255 ECU_ADDRESS 0x01009E70 BIT_MASK 0xff /end MEASUREMENT
/begin COMPU_METHOD HBA_device_status_COMPU_VTAB "Verbal Table" TAB_VERB "%.0" "list" COMPU_TAB_REF HBA_device_status_COMPU_VTAB_REF /end COMPU_METHOD
/begin COMPU_VTAB HBA_device_status_COMPU_VTAB_REF "Verbal Table" TAB_VERB 4 0 "No support" 1 "Disabled" 2 "Fault" 3 "OK" DEFAULT_VALUE "UNKNOWN" /end COMPU_VTAB
/begin MEASUREMENT HBB_device_status "HBB device status{HBB_device_status&0xff=0:No support}{HBB_device_status&0xff=1:Disabled}{HBB_device_status&0xff=2:Fault}{HBB_device_status&0xff=3:OK}" UBYTE HBB_device_status_COMPU_VTAB 0 0 0 255 ECU_ADDRESS 0x01009E78 BIT_MASK 0xff /end MEASUREMENT
/begin COMPU_METHOD HBB_device_status_COMPU_VTAB "Verbal Table" TAB_VERB "%.0" "list" COMPU_TAB_REF HBB_device_status_COMPU_VTAB_REF /end COMPU_METHOD
/begin COMPU_VTAB HBB_device_status_COMPU_VTAB_REF "Verbal Table" TAB_VERB 4 0 "No support" 1 "Disabled" 2 "Fault" 3 "OK" DEFAULT_VALUE "UNKNOWN" /end COMPU_VTAB
/begin CHARACTERISTIC DBW_FB_cmd_LP "DBW command->FB tau" VALUE 0x001C9C64 /* @ECU_Address@DBW_FB_cmd_LP@0x0100A208@ */ ECIPP_ALIGNMENT_UWORD 327680 Compu_DBW_FB_cmd_LP 0.45084 327680 /end CHARACTERISTIC
/begin COMPU_METHOD Compu_DBW_FB_cmd_LP " " FORM "%.1" "ms"
 /begin FORMULA "-5 / log(1 - (X1 / 65536))" FORMULA_INV "(1 - exp(-5/X1)) * 65536" /end FORMULA
/end COMPU_METHOD
/begin CHARACTERISTIC HBA_FB_cmd_LP "HBA command->FB tau" VALUE 0x001C9E38 /* @ECU_Address@HBA_FB_cmd_LP@0x0100A210@ */ ECIPP_ALIGNMENT_UWORD 327680 Compu_HBA_FB_cmd_LP 0.45084 327680 /end CHARACTERISTIC
/begin COMPU_METHOD Compu_HBA_FB_cmd_LP " " FORM "%.1" "ms"
 /begin FORMULA "-5 / log(1 - (X1 / 65536))" FORMULA_INV "(1 - exp(-5/X1)) * 65536" /end FORMULA
/end COMPU_METHOD
/begin CHARACTERISTIC HBB_FB_cmd_LP "HBB command->FB tau" VALUE 0x001C9ED8 /* @ECU_Address@HBB_FB_cmd_LP@0x0100A218@ */ ECIPP_ALIGNMENT_UWORD 327680 Compu_HBB_FB_cmd_LP 0.45084 327680 /end CHARACTERISTIC
/begin COMPU_METHOD Compu_HBB_FB_cmd_LP " " FORM "%.1" "ms"
 /begin FORMULA "-5 / log(1 - (X1 / 65536))" FORMULA_INV "(1 - exp(-5/X1)) * 65536" /end FORMULA
/end COMPU_METHOD
/begin CHARACTERISTIC FPPslewdown_ena "FPP decreasing slew limiting{FPPslewdown_ena&0xff=0:Disabled}{FPPslewdown_ena&0xff=1:Enabled}" VALUE 0x001c872c /* @ECU_Address@FPPslewdown_ena@0x0100A658@ */ ECIPP_ALIGNMENT_UBYTE 255 FPPslewdown_ena_COMPU_VTAB 0 255 BIT_MASK 0xff /end CHARACTERISTIC
/begin COMPU_METHOD FPPslewdown_ena_COMPU_VTAB "Verbal Table" TAB_VERB "%.0" "list" COMPU_TAB_REF FPPslewdown_ena_COMPU_VTAB_REF /end COMPU_METHOD
/begin COMPU_VTAB FPPslewdown_ena_COMPU_VTAB_REF "Verbal Table" TAB_VERB 2 0 "Disabled" 1 "Enabled" DEFAULT_VALUE "UNKNOWN" /end COMPU_VTAB
/begin MEASUREMENT FSO_TPS_open_tmr "FSO TPS open timer" UWORD Compu_FSO_TPS_open_tmr 0 0 0 65535 ECU_ADDRESS 0x0100B1A8 /end MEASUREMENT
/begin COMPU_METHOD Compu_FSO_TPS_open_tmr " " RAT_FUNC "%.0" "ms" COEFFS 0 1 0 0 0 1 /end COMPU_METHOD
/begin CHARACTERISTIC FSO_TPS_coord_ena "FSO TPS/engine brake coordination{FSO_TPS_coord_ena&0xff=0:Disabled}{FSO_TPS_coord_ena&0xff=1:Enabled}" VALUE 0x001c8733 /* @ECU_Address@FSO_TPS_coord_ena@0x0100C348@ */ ECIPP_ALIGNMENT_UBYTE 255 FSO_TPS_coord_ena_COMPU_VTAB 0 255 BIT_MASK 0xff /end CHARACTERISTIC
/begin COMPU_METHOD FSO_TPS_coord_ena_COMPU_VTAB "Verbal Table" TAB_VERB "%.0" "list" COMPU_TAB_REF FSO_TPS_coord_ena_COMPU_VTAB_REF /end COMPU_METHOD
/begin COMPU_VTAB FSO_TPS_coord_ena_COMPU_VTAB_REF "Verbal Table" TAB_VERB 2 0 "Disabled" 1 "Enabled" DEFAULT_VALUE "UNKNOWN" /end COMPU_VTAB
/begin CHARACTERISTIC FSO_TPS_coord_MAP "FSO coordination MAP target" VALUE 0x001c7b3a /* @ECU_Address@FSO_TPS_coord_MAP@0x0100C350@ */ ECIPP_ALIGNMENT_UWORD 256 Compu_FSO_TPS_coord_MAP 0 255.99609375 /end CHARACTERISTIC
/begin COMPU_METHOD Compu_FSO_TPS_coord_MAP " " RAT_FUNC "%.2" "psia" COEFFS 0 256 0 0 0 1 /end COMPU_METHOD
/begin CHARACTERISTIC FSO_TPS_coord_wait "FSO coordination TPS reopen delay" VALUE 0x001c7b3c /* @ECU_Address@FSO_TPS_coord_wait@0x0100C358@ */ ECIPP_ALIGNMENT_UWORD 65535 Compu_FSO_TPS_coord_wait 0 65535 /end CHARACTERISTIC
/begin COMPU_METHOD Compu_FSO_TPS_coord_wait " " RAT_FUNC "%.0" "ms" COEFFS 0 1 0 0 0 1 /end COMPU_METHOD
/begin CHARACTERISTIC FPP_learn_sync_ena "Dual pot pedal learn sync{FPP_learn_sync_ena&0xff=0:Disabled}{FPP_learn_sync_ena&0xff=1:Enabled}" VALUE 0x001c8723 /* @ECU_Address@FPP_learn_sync_ena@0x0100C818@ */ ECIPP_ALIGNMENT_UBYTE 255 FPP_learn_sync_ena_COMPU_VTAB 0 255 BIT_MASK 0xff /end CHARACTERISTIC
/begin COMPU_METHOD FPP_learn_sync_ena_COMPU_VTAB "Verbal Table" TAB_VERB "%.0" "list" COMPU_TAB_REF FPP_learn_sync_ena_COMPU_VTAB_REF /end COMPU_METHOD
/begin COMPU_VTAB FPP_learn_sync_ena_COMPU_VTAB_REF "Verbal Table" TAB_VERB 2 0 "Disabled" 1 "Enabled" DEFAULT_VALUE "UNKNOWN" /end COMPU_VTAB
/begin MEASUREMENT mdot_throttle_float "Throttle flow - total" FLOAT32_IEEE Compu_mdot_throttle_float 0 0 -10000000000 10000000000 ECU_ADDRESS 0x0100CC10 /end MEASUREMENT
/begin COMPU_METHOD Compu_mdot_throttle_float " " RAT_FUNC "%.1" "g/sec" COEFFS 0 1 0 0 0 1 /end COMPU_METHOD
/begin CHARACTERISTIC FPPdual_pedal_chan "Second foot pedal input{FPPdual_pedal_chan&0xff=0:Disabled}{FPPdual_pedal_chan&0xff=1:Aux PU1 = Gnd}{FPPdual_pedal_chan&0xff=2:Aux PU2 = Gnd}{FPPdual_pedal_chan&0xff=3:Aux PU3 = Gnd}{FPPdual_pedal_chan&0xff=4:Aux PUD1 = Gnd}{FPPdual_pedal_chan&0xff=5:Aux " VALUE 0x001c8729 /* @ECU_Address@FPPdual_pedal_chan@0x0100D868@ */ ECIPP_ALIGNMENT_UBYTE 255 FPPdual_pedal_chan_COMPU_VTAB 0 255 BIT_MASK 0xff /end CHARACTERISTIC
/begin COMPU_METHOD FPPdual_pedal_chan_COMPU_VTAB "Verbal Table" TAB_VERB "%.0" "list" COMPU_TAB_REF FPPdual_pedal_chan_COMPU_VTAB_REF /end COMPU_METHOD
/begin COMPU_VTAB FPPdual_pedal_chan_COMPU_VTAB_REF "Verbal Table" TAB_VERB 30 0 "Disabled" 1 "Aux PU1 = Gnd" 2 "Aux PU2 = Gnd" 3 "Aux PU3 = Gnd" 4 "Aux PUD1 = Gnd" 5 "Aux PUD2 = Gnd" 6 "Aux PUD3 = Gnd" 7 "Aux PUD4 = +V" 8 "Aux PUD5 = Gnd" 9 "Aux DIG1" 10 "Aux DIG2" 11 "Aux DIG3" 12 "Aux DIG4" 13 "Aux DIG5" 14 "Aux DIG6" 15 "Aux DIG7" 16 "Aux DIG8" 17 "Aux DIG9" 18 "Aux DIG10" 19 "Aux DIG11" 20 "Aux DIG12" 21 "Aux DIG13" 22 "Aux DIG14" 23 "Aux DIG15" 24 "Aux DIG16" 25 "Aux DIG17" 26 "Aux DIG18" 27 "Aux DIG19" 28 "Gov1" 29 "Gov2" DEFAULT_VALUE "UNKNOWN" /end COMPU_VTAB
/begin CHARACTERISTIC FPPdual_pedal_cfg "Second foot pedal input Aux DIG{FPPdual_pedal_cfg&0xff=0:Default}{FPPdual_pedal_cfg&0xff=1:GND}{FPPdual_pedal_cfg&0xff=2:GND/+V}{FPPdual_pedal_cfg&0xff=3:+V}{FPPdual_pedal_cfg&0xff=4:Open}" VALUE 0x001c8728 /* @ECU_Address@FPPdual_pedal_cfg@0x0100D870@ */ ECIPP_ALIGNMENT_UBYTE 255 FPPdual_pedal_cfg_COMPU_VTAB 0 255 BIT_MASK 0xff /end CHARACTERISTIC
/begin COMPU_METHOD FPPdual_pedal_cfg_COMPU_VTAB "Verbal Table" TAB_VERB "%.0" "list" COMPU_TAB_REF FPPdual_pedal_cfg_COMPU_VTAB_REF /end COMPU_METHOD
/begin COMPU_VTAB FPPdual_pedal_cfg_COMPU_VTAB_REF "Verbal Table" TAB_VERB 5 0 "Default" 1 "GND" 2 "GND/+V" 3 "+V" 4 "Open" DEFAULT_VALUE "UNKNOWN" /end COMPU_VTAB
/begin CHARACTERISTIC TPS_step_max "TPS open loop steps" VALUE 0x001C9C3C /* @ECU_Address@TPS_step_max@0x0100E850@ */ ECIPP_ALIGNMENT_UWORD 65535 Compu_TPS_step_max 0 65535 /end CHARACTERISTIC
/begin COMPU_METHOD Compu_TPS_step_max " " RAT_FUNC "%.0" "steps" COEFFS 0 1 0 0 0 1 /end COMPU_METHOD
/begin CHARACTERISTIC APS_step_max "APS open loop steps" VALUE 0x001C9E10 /* @ECU_Address@APS_step_max@0x0100E858@ */ ECIPP_ALIGNMENT_UWORD 65535 Compu_APS_step_max 0 65535 /end CHARACTERISTIC
/begin COMPU_METHOD Compu_APS_step_max " " RAT_FUNC "%.0" "steps" COEFFS 0 1 0 0 0 1 /end COMPU_METHOD
/begin CHARACTERISTIC BPS_step_max "BPS open loop steps" VALUE 0x001C9EB0 /* @ECU_Address@BPS_step_max@0x0100E860@ */ ECIPP_ALIGNMENT_UWORD 65535 Compu_BPS_step_max 0 65535 /end CHARACTERISTIC
/begin COMPU_METHOD Compu_BPS_step_max " " RAT_FUNC "%.0" "steps" COEFFS 0 1 0 0 0 1 /end COMPU_METHOD
/begin CHARACTERISTIC TPS_EE_store "TPS learn EEPROM restore{TPS_EE_store&0xff=0:Disabled}{TPS_EE_store&0xff=1:Enabled}" VALUE 0x001C9C2B /* @ECU_Address@TPS_EE_store@0x0100F148@ */ ECIPP_ALIGNMENT_UBYTE 255 TPS_EE_store_COMPU_VTAB 0 255 BIT_MASK 0xff /end CHARACTERISTIC
/begin COMPU_METHOD TPS_EE_store_COMPU_VTAB "Verbal Table" TAB_VERB "%.0" "list" COMPU_TAB_REF TPS_EE_store_COMPU_VTAB_REF /end COMPU_METHOD
/begin COMPU_VTAB TPS_EE_store_COMPU_VTAB_REF "Verbal Table" TAB_VERB 2 0 "Disabled" 1 "Enabled" DEFAULT_VALUE "UNKNOWN" /end COMPU_VTAB
/begin CHARACTERISTIC APS_EE_store "APS learn EEPROM restore{APS_EE_store&0xff=0:Disabled}{APS_EE_store&0xff=1:Enabled}" VALUE 0x001C9DFF /* @ECU_Address@APS_EE_store@0x0100F150@ */ ECIPP_ALIGNMENT_UBYTE 255 APS_EE_store_COMPU_VTAB 0 255 BIT_MASK 0xff /end CHARACTERISTIC
/begin COMPU_METHOD APS_EE_store_COMPU_VTAB "Verbal Table" TAB_VERB "%.0" "list" COMPU_TAB_REF APS_EE_store_COMPU_VTAB_REF /end COMPU_METHOD
/begin COMPU_VTAB APS_EE_store_COMPU_VTAB_REF "Verbal Table" TAB_VERB 2 0 "Disabled" 1 "Enabled" DEFAULT_VALUE "UNKNOWN" /end COMPU_VTAB
/begin CHARACTERISTIC BPS_EE_store "BPS learn EEPROM restore{BPS_EE_store&0xff=0:Disabled}{BPS_EE_store&0xff=1:Enabled}" VALUE 0x001C9E9F /* @ECU_Address@BPS_EE_store@0x0100F158@ */ ECIPP_ALIGNMENT_UBYTE 255 BPS_EE_store_COMPU_VTAB 0 255 BIT_MASK 0xff /end CHARACTERISTIC
/begin COMPU_METHOD BPS_EE_store_COMPU_VTAB "Verbal Table" TAB_VERB "%.0" "list" COMPU_TAB_REF BPS_EE_store_COMPU_VTAB_REF /end COMPU_METHOD
/begin COMPU_VTAB BPS_EE_store_COMPU_VTAB_REF "Verbal Table" TAB_VERB 2 0 "Disabled" 1 "Enabled" DEFAULT_VALUE "UNKNOWN" /end COMPU_VTAB
/begin MEASUREMENT FPP1_center "FPP1 default midpoint" UWORD Compu_FPP1_center 0 0 0 5.00114468864469 ECU_ADDRESS 0x0100F240 /end MEASUREMENT
/begin COMPU_METHOD Compu_FPP1_center " " RAT_FUNC "%.3" "volts" COEFFS 0 13104 0 0 0 1 /end COMPU_METHOD
/begin MEASUREMENT FPP2_center "FPP2 default midpoint" UWORD Compu_FPP2_center 0 0 0 5.00114468864469 ECU_ADDRESS 0x0100F248 /end MEASUREMENT
/begin COMPU_METHOD Compu_FPP2_center " " RAT_FUNC "%.3" "volts" COEFFS 0 13104 0 0 0 1 /end COMPU_METHOD
/begin CHARACTERISTIC Phi_FSO_offset "FSO phi catalyst enrichment" VALUE 0x001CA2BE /* @ECU_Address@Phi_FSO_offset@0x0100F5D8@ */ ECIPP_ALIGNMENT_SWORD 200 Compu_Phi_FSO_offset -200 199.993896484375 /end CHARACTERISTIC
/begin COMPU_METHOD Compu_Phi_FSO_offset " " RAT_FUNC "%.1" "%" COEFFS 0 163.84 0 0 0 1 /end COMPU_METHOD
/begin CHARACTERISTIC Phi_FSO_pst_sw "FSO phi catalyst post-EGO switch" VALUE 0x001c7e8c /* @ECU_Address@Phi_FSO_pst_sw@0x0100F5E0@ */ ECIPP_ALIGNMENT_UWORD 16 Compu_Phi_FSO_pst_sw 0 15.999755859375 /end CHARACTERISTIC
/begin COMPU_METHOD Compu_Phi_FSO_pst_sw " " RAT_FUNC "%.3" "volts" COEFFS 0 4096 0 0 0 1 /end COMPU_METHOD
/begin CHARACTERISTIC Phi_FSO_max_ms "FSO phi catalyst max engagement" VALUE 0x001c7e88 /* @ECU_Address@Phi_FSO_max_ms@0x0100F5E8@ */ ECIPP_ALIGNMENT_UWORD 66 Compu_Phi_FSO_max_ms 0 65.535 /end CHARACTERISTIC
/begin COMPU_METHOD Compu_Phi_FSO_max_ms " " RAT_FUNC "%.1" "seconds" COEFFS 0 1000 0 0 0 1 /end COMPU_METHOD
/begin MEASUREMENT Phi_FSO_active "FSO phi offset" SWORD Compu_Phi_FSO_active 0 0 -200 199.993896484375 ECU_ADDRESS 0x0100F5F0 /end MEASUREMENT
/begin COMPU_METHOD Compu_Phi_FSO_active " " RAT_FUNC "%.3" "phi" COEFFS 0 163.84 0 0 0 1 /end COMPU_METHOD
/begin CHARACTERISTIC EGR_minnom_FSO "FSO EGR min/nom table command" VALUE 0x001c0284 /* @ECU_Address@EGR_minnom_FSO@0x0100F5F8@ */ ECIPP_ALIGNMENT_SWORD 2 Compu_EGR_minnom_FSO -2 1.99993896484375 /end CHARACTERISTIC
/begin COMPU_METHOD Compu_EGR_minnom_FSO " " RAT_FUNC "%.2" "min/nom" COEFFS 0 16384 0 0 0 1 /end COMPU_METHOD
/begin CHARACTERISTIC FSO_phi_delt_wt "FSO postcat delta-phi delay" VALUE 0x001c7b58 /* @ECU_Address@FSO_phi_delt_wt@0x01010B00@ */ ECIPP_ALIGNMENT_UWORD 66 Compu_FSO_phi_delt_wt 0 65.535 /end CHARACTERISTIC
/begin COMPU_METHOD Compu_FSO_phi_delt_wt " " RAT_FUNC "%.1" "seconds" COEFFS 0 1000 0 0 0 1 /end COMPU_METHOD
/begin MEASUREMENT MFA_man_mode "MFA manual mode{MFA_man_mode&0xff=0:Auto}{MFA_man_mode&0xff=1:Manual Position}{MFA_man_mode&0xff=2:Manual Flow}{MFA_man_mode&0xff=3:Manual Off}" UBYTE MFA_man_mode_COMPU_VTAB 0 0 0 255 ECU_ADDRESS 0x01011688 BIT_MASK 0xff /end MEASUREMENT
/begin COMPU_METHOD MFA_man_mode_COMPU_VTAB "Verbal Table" TAB_VERB "%.0" "list" COMPU_TAB_REF MFA_man_mode_COMPU_VTAB_REF /end COMPU_METHOD
/begin COMPU_VTAB MFA_man_mode_COMPU_VTAB_REF "Verbal Table" TAB_VERB 4 0 "Auto" 1 "Manual Position" 2 "Manual Flow" 3 "Manual Off" DEFAULT_VALUE "UNKNOWN" /end COMPU_VTAB
/begin MEASUREMENT MFA_ctltype_cmd "MFA control type command{MFA_ctltype_cmd&0xff=0:Off}{MFA_ctltype_cmd&0xff=1:Position}{MFA_ctltype_cmd&0xff=2:Flow}{MFA_ctltype_cmd&0xff=3:Reserved}" UBYTE MFA_ctltype_cmd_COMPU_VTAB 0 0 0 255 ECU_ADDRESS 0x01011690 BIT_MASK 0xff /end MEASUREMENT
/begin COMPU_METHOD MFA_ctltype_cmd_COMPU_VTAB "Verbal Table" TAB_VERB "%.0" "list" COMPU_TAB_REF MFA_ctltype_cmd_COMPU_VTAB_REF /end COMPU_METHOD
/begin COMPU_VTAB MFA_ctltype_cmd_COMPU_VTAB_REF "Verbal Table" TAB_VERB 4 0 "Off" 1 "Position" 2 "Flow" 3 "Reserved" DEFAULT_VALUE "UNKNOWN" /end COMPU_VTAB
/begin MEASUREMENT MFA_ctltype_act "MFA control type feedback{MFA_ctltype_act&0xff=0:Off}{MFA_ctltype_act&0xff=1:Position}{MFA_ctltype_act&0xff=2:Flow}{MFA_ctltype_act&0xff=3:Reserved}" UBYTE MFA_ctltype_act_COMPU_VTAB 0 0 0 255 ECU_ADDRESS 0x01011698 BIT_MASK 0xff /end MEASUREMENT
/begin COMPU_METHOD MFA_ctltype_act_COMPU_VTAB "Verbal Table" TAB_VERB "%.0" "list" COMPU_TAB_REF MFA_ctltype_act_COMPU_VTAB_REF /end COMPU_METHOD
/begin COMPU_VTAB MFA_ctltype_act_COMPU_VTAB_REF "Verbal Table" TAB_VERB 4 0 "Off" 1 "Position" 2 "Flow" 3 "Reserved" DEFAULT_VALUE "UNKNOWN" /end COMPU_VTAB
/begin MEASUREMENT MFA_status "MFA status{MFA_status&0xff=0:Comm Lost}{MFA_status&0xff=1:OK}{MFA_status&0xff=2:Fault}" UBYTE MFA_status_COMPU_VTAB 0 0 0 255 ECU_ADDRESS 0x010116A0 BIT_MASK 0xff /end MEASUREMENT
/begin COMPU_METHOD MFA_status_COMPU_VTAB "Verbal Table" TAB_VERB "%.0" "list" COMPU_TAB_REF MFA_status_COMPU_VTAB_REF /end COMPU_METHOD
/begin COMPU_VTAB MFA_status_COMPU_VTAB_REF "Verbal Table" TAB_VERB 3 0 "Comm Lost" 1 "OK" 2 "Fault" DEFAULT_VALUE "UNKNOWN" /end COMPU_VTAB
/begin MEASUREMENT MFAI_flash_wr_left "Internal flash writes remaining" SBYTE Compu_MFAI_flash_wr_left 0 0 -128 127 ECU_ADDRESS 0x010116A8 /end MEASUREMENT
/begin COMPU_METHOD Compu_MFAI_flash_wr_left " " RAT_FUNC "%.0" "-" COEFFS 0 1 0 0 0 1 /end COMPU_METHOD
/begin MEASUREMENT MFAI_flash_wr_force "Internal flash write request{MFAI_flash_wr_force&0xff=0:Idle}{MFAI_flash_wr_force&0xff=1:Write Flash}" UBYTE MFAI_flash_wr_force_COMPU_VTAB 0 0 0 255 ECU_ADDRESS 0x010116B0 BIT_MASK 0xff /end MEASUREMENT
/begin COMPU_METHOD MFAI_flash_wr_force_COMPU_VTAB "Verbal Table" TAB_VERB "%.0" "list" COMPU_TAB_REF MFAI_flash_wr_force_COMPU_VTAB_REF /end COMPU_METHOD
/begin COMPU_VTAB MFAI_flash_wr_force_COMPU_VTAB_REF "Verbal Table" TAB_VERB 2 0 "Idle" 1 "Write Flash" DEFAULT_VALUE "UNKNOWN" /end COMPU_VTAB
/begin MEASUREMENT MFAI_cur_cal_mod "Internal current MFA cal model" ULONG Compu_MFAI_cur_cal_mod 0 0 0 4294967295 ECU_ADDRESS 0x010116B8 /end MEASUREMENT
/begin COMPU_METHOD Compu_MFAI_cur_cal_mod " " RAT_FUNC "%.0" "-" COEFFS 0 1 0 0 0 1 /end COMPU_METHOD
/begin CHARACTERISTIC PN_MFA_eng_cal_mod "Engine calibration MFA cal model" VALUE 0x001C9FE8 /* @ECU_Address@PN_MFA_eng_cal_mod@0x010116C0@ */ ECIPP_ALIGNMENT_ULONG 4294967295 Compu_PN_MFA_eng_cal_mod 0 4294967295 /end CHARACTERISTIC
/begin COMPU_METHOD Compu_PN_MFA_eng_cal_mod " " RAT_FUNC "%.0" "(7 digits + 1 letter)" COEFFS 0 1 0 0 0 1 /end COMPU_METHOD
/begin MEASUREMENT MFA_param_differ "MFA cal parameter status{MFA_param_differ&0xff=0:Params Match}{MFA_param_differ&0xff=1:Params Do Not Match}" UBYTE MFA_param_differ_COMPU_VTAB 0 0 0 255 ECU_ADDRESS 0x010116C8 BIT_MASK 0xff /end MEASUREMENT
/begin COMPU_METHOD MFA_param_differ_COMPU_VTAB "Verbal Table" TAB_VERB "%.0" "list" COMPU_TAB_REF MFA_param_differ_COMPU_VTAB_REF /end COMPU_METHOD
/begin COMPU_VTAB MFA_param_differ_COMPU_VTAB_REF "Verbal Table" TAB_VERB 2 0 "Params Match" 1 "Params Do Not Match" DEFAULT_VALUE "UNKNOWN" /end COMPU_VTAB
/begin MEASUREMENT MFA_param_upload "MFA cal upload from MFA{MFA_param_upload&0xff=0:Idle}{MFA_param_upload&0xff=1:Upload Params from MFA}" UBYTE MFA_param_upload_COMPU_VTAB 0 0 0 255 ECU_ADDRESS 0x010116D0 BIT_MASK 0xff /end MEASUREMENT
/begin COMPU_METHOD MFA_param_upload_COMPU_VTAB "Verbal Table" TAB_VERB "%.0" "list" COMPU_TAB_REF MFA_param_upload_COMPU_VTAB_REF /end COMPU_METHOD
/begin COMPU_VTAB MFA_param_upload_COMPU_VTAB_REF "Verbal Table" TAB_VERB 2 0 "Idle" 1 "Upload Params from MFA" DEFAULT_VALUE "UNKNOWN" /end COMPU_VTAB
/begin MEASUREMENT MFA_cal_state "MFA cal / paramocan state" UBYTE Compu_MFA_cal_state 0 0 0 255 ECU_ADDRESS 0x010116D8 /end MEASUREMENT
/begin COMPU_METHOD Compu_MFA_cal_state " " RAT_FUNC "%.0" "state" COEFFS 0 1 0 0 0 1 /end COMPU_METHOD
/begin MEASUREMENT MFAI_cur_SW_mod "Internal current MFA SW model" ULONG Compu_MFAI_cur_SW_mod 0 0 0 4294967295 ECU_ADDRESS 0x010116E0 /end MEASUREMENT
/begin COMPU_METHOD Compu_MFAI_cur_SW_mod " " RAT_FUNC "%.0" "-" COEFFS 0 1 0 0 0 1 /end COMPU_METHOD
/begin MEASUREMENT MFAI_cur_HW_mod "Internal current MFA HW model" ULONG Compu_MFAI_cur_HW_mod 0 0 0 4294967295 ECU_ADDRESS 0x010116E8 /end MEASUREMENT
/begin COMPU_METHOD Compu_MFAI_cur_HW_mod " " RAT_FUNC "%.0" "-" COEFFS 0 1 0 0 0 1 /end COMPU_METHOD
/begin CHARACTERISTIC MFA_mdot_FS "MFA full-scale mdot" VALUE 0x001c7d8c /* @ECU_Address@MFA_mdot_FS@0x010116F0@ */ ECIPP_ALIGNMENT_UWORD 16384 Compu_MFA_mdot_FS 0 16383.75 /end CHARACTERISTIC
/begin COMPU_METHOD Compu_MFA_mdot_FS " " RAT_FUNC "%.2" "g/sec" COEFFS 0 4 0 0 0 1 /end COMPU_METHOD
/begin MEASUREMENT MFA_mdot_act_pct "MFA actual flow" UWORD Compu_MFA_mdot_act_pct 0 0 0 99.9984741210938 ECU_ADDRESS 0x010116F8 /end MEASUREMENT
/begin COMPU_METHOD Compu_MFA_mdot_act_pct " " RAT_FUNC "%.1" "% of FS" COEFFS 0 655.36 0 0 0 1 /end COMPU_METHOD
/begin MEASUREMENT MFA_mdot_act "MFA actual flow" ULONG Compu_MFA_mdot_act 0 0 0 16383.9999961853 ECU_ADDRESS 0x01011700 /end MEASUREMENT
/begin COMPU_METHOD Compu_MFA_mdot_act " " RAT_FUNC "%.2" "g/sec" COEFFS 0 262144 0 0 0 1 /end COMPU_METHOD
/begin MEASUREMENT MFA_mdot_cmd_pct "MFA commanded flow" UWORD Compu_MFA_mdot_cmd_pct 0 0 0 99.9984741210938 ECU_ADDRESS 0x01011708 /end MEASUREMENT
/begin COMPU_METHOD Compu_MFA_mdot_cmd_pct " " RAT_FUNC "%.1" "% of FS" COEFFS 0 655.36 0 0 0 1 /end COMPU_METHOD
/begin MEASUREMENT MFA_mdot_cmd "MFA commanded flow" ULONG Compu_MFA_mdot_cmd 0 0 0 16383.9999961853 ECU_ADDRESS 0x01011710 /end MEASUREMENT
/begin COMPU_METHOD Compu_MFA_mdot_cmd " " RAT_FUNC "%.2" "g/sec" COEFFS 0 262144 0 0 0 1 /end COMPU_METHOD
/begin MEASUREMENT MFA_param_NA_cnt "MFA parameter not-available counter" UWORD Compu_MFA_param_NA_cnt 0 0 0 65535 ECU_ADDRESS 0x01011718 /end MEASUREMENT
/begin COMPU_METHOD Compu_MFA_param_NA_cnt " " RAT_FUNC "%.0" "count" COEFFS 0 1 0 0 0 1 /end COMPU_METHOD
/begin MEASUREMENT MFA_TPS_act_pct "MFA actual position" UWORD Compu_MFA_TPS_act_pct 0 0 0 99.9984741210938 ECU_ADDRESS 0x01011720 /end MEASUREMENT
/begin COMPU_METHOD Compu_MFA_TPS_act_pct " " RAT_FUNC "%.1" "%" COEFFS 0 655.36 0 0 0 1 /end COMPU_METHOD
/begin MEASUREMENT MFA_TPS_cmd_pct "MFA commanded position" UWORD Compu_MFA_TPS_cmd_pct 0 0 0 99.9984741210938 ECU_ADDRESS 0x01011728 /end MEASUREMENT
/begin COMPU_METHOD Compu_MFA_TPS_cmd_pct " " RAT_FUNC "%.1" "%" COEFFS 0 655.36 0 0 0 1 /end COMPU_METHOD
/begin MEASUREMENT MFA_FTemp "MFA fluid temperature" UWORD Compu_MFA_FTemp 0 0 -460 1383.171875 ECU_ADDRESS 0x01011730 /end MEASUREMENT
/begin COMPU_METHOD Compu_MFA_FTemp " " RAT_FUNC "%.1" "deg F" COEFFS 0 35.5555555555556 16355.5555555556 0 0 1 /end COMPU_METHOD
/begin MEASUREMENT MFA_USPress "MFA upstream pressure" UWORD Compu_MFA_USPress 0 0 0 148.51664578125 ECU_ADDRESS 0x01011740 /end MEASUREMENT
/begin COMPU_METHOD Compu_MFA_USPress " " RAT_FUNC "%.2" "psia" COEFFS 0 441.263668831617 0 0 0 1 /end COMPU_METHOD
/begin MEASUREMENT MFA_DSPress "MFA downstream pressure" UWORD Compu_MFA_DSPress 0 0 0 148.51664578125 ECU_ADDRESS 0x01011748 /end MEASUREMENT
/begin COMPU_METHOD Compu_MFA_DSPress " " RAT_FUNC "%.2" "psia" COEFFS 0 441.263668831617 0 0 0 1 /end COMPU_METHOD
/begin MEASUREMENT MFA_DPPress "MFA delta pressure" SWORD Compu_MFA_DPPress 0 0 -74.259456 74.25718978125 ECU_ADDRESS 0x01011750 /end MEASUREMENT
/begin COMPU_METHOD Compu_MFA_DPPress " " RAT_FUNC "%.3" "psia" COEFFS 0 441.263668831617 0 0 0 1 /end COMPU_METHOD
/begin CHARACTERISTIC MFA_dP_cyl_events "MFA dP averaging window" VALUE 0x001C9FE2 /* @ECU_Address@MFA_dP_cyl_events@0x01011758@ */ ECIPP_ALIGNMENT_UWORD 64 Compu_MFA_dP_cyl_events 0 63.9990234375 /end CHARACTERISTIC
/begin COMPU_METHOD Compu_MFA_dP_cyl_events " " RAT_FUNC "%.1" "cyl events" COEFFS 0 1024 0 0 0 1 /end COMPU_METHOD
/begin MEASUREMENT MFA_dP_avg_window "MFA dP averaging window" UWORD Compu_MFA_dP_avg_window 0 0 0 1023.984375 ECU_ADDRESS 0x01011760 /end MEASUREMENT
/begin COMPU_METHOD Compu_MFA_dP_avg_window " " RAT_FUNC "%.2" "ms" COEFFS 0 64 0 0 0 1 /end COMPU_METHOD
/begin MEASUREMENT MFA_DPPress_Pcrct "MFA differenced dP corrected" SWORD Compu_MFA_DPPress_Pcrct 0 0 -148.518912 148.5143795625 ECU_ADDRESS 0x01011768 /end MEASUREMENT
/begin COMPU_METHOD Compu_MFA_DPPress_Pcrct " " RAT_FUNC "%.3" "psia" COEFFS 0 220.631834415808 0 0 0 1 /end COMPU_METHOD
/begin MEASUREMENT MFA_DPPress_final "MFA final DP for mass-flow" SWORD Compu_MFA_DPPress_final 0 0 -148.518912 148.5143795625 ECU_ADDRESS 0x01011770 /end MEASUREMENT
/begin COMPU_METHOD Compu_MFA_DPPress_final " " RAT_FUNC "%.3" "psia" COEFFS 0 220.631834415808 0 0 0 1 /end COMPU_METHOD
/begin CHARACTERISTIC MFA_enabled "MFA enabled{MFA_enabled&0xff=0:Disabled}{MFA_enabled&0xff=1:Enabled}" VALUE 0x001C9FE4 /* @ECU_Address@MFA_enabled@0x01011780@ */ ECIPP_ALIGNMENT_UBYTE 255 MFA_enabled_COMPU_VTAB 0 255 BIT_MASK 0xff /end CHARACTERISTIC
/begin COMPU_METHOD MFA_enabled_COMPU_VTAB "Verbal Table" TAB_VERB "%.0" "list" COMPU_TAB_REF MFA_enabled_COMPU_VTAB_REF /end COMPU_METHOD
/begin COMPU_VTAB MFA_enabled_COMPU_VTAB_REF "Verbal Table" TAB_VERB 2 0 "Disabled" 1 "Enabled" DEFAULT_VALUE "UNKNOWN" /end COMPU_VTAB
/begin CHARACTERISTIC MFA_hsdata_tx_ena "MFA high speed data tx enabled{MFA_hsdata_tx_ena&0xff=0:Disabled}{MFA_hsdata_tx_ena&0xff=1:Enabled}{MFA_hsdata_tx_ena&0xff=2:Automatic}" VALUE 0x001C9FF0 /* @ECU_Address@MFA_hsdata_tx_ena@0x010117A8@ */ ECIPP_ALIGNMENT_UBYTE 255 MFA_hsdata_tx_ena_COMPU_VTAB 0 255 BIT_MASK 0xff /end CHARACTERISTIC
/begin COMPU_METHOD MFA_hsdata_tx_ena_COMPU_VTAB "Verbal Table" TAB_VERB "%.0" "list" COMPU_TAB_REF MFA_hsdata_tx_ena_COMPU_VTAB_REF /end COMPU_METHOD
/begin COMPU_VTAB MFA_hsdata_tx_ena_COMPU_VTAB_REF "Verbal Table" TAB_VERB 3 0 "Disabled" 1 "Enabled" 2 "Automatic" DEFAULT_VALUE "UNKNOWN" /end COMPU_VTAB
/begin MEASUREMENT MFA_hsdata_tx_act "MFA high speed data tx actual{MFA_hsdata_tx_act&0xff=0:Disabled}{MFA_hsdata_tx_act&0xff=1:Enabled}" UWORD MFA_hsdata_tx_act_COMPU_VTAB 0 0 0 65535 ECU_ADDRESS 0x010117B0 BIT_MASK 0xff /end MEASUREMENT
/begin COMPU_METHOD MFA_hsdata_tx_act_COMPU_VTAB "Verbal Table" TAB_VERB "%.0" "list" COMPU_TAB_REF MFA_hsdata_tx_act_COMPU_VTAB_REF /end COMPU_METHOD
/begin COMPU_VTAB MFA_hsdata_tx_act_COMPU_VTAB_REF "Verbal Table" TAB_VERB 2 0 "Disabled" 1 "Enabled" DEFAULT_VALUE "UNKNOWN" /end COMPU_VTAB
/begin MEASUREMENT MFA_DSPress_slow "MFA downstream pressure (slow-avg)" UWORD Compu_MFA_DSPress_slow 0 0 0 148.51664578125 ECU_ADDRESS 0x010117B8 /end MEASUREMENT
/begin COMPU_METHOD Compu_MFA_DSPress_slow " " RAT_FUNC "%.2" "psia" COEFFS 0 441.263668831617 0 0 0 1 /end COMPU_METHOD
/begin MEASUREMENT MFA_DSPressdt "MFA downstream pressure dt" SWORD Compu_MFA_DSPressdt 0 0 -2320.608 2320.53718066406 ECU_ADDRESS 0x010117C0 /end MEASUREMENT
/begin COMPU_METHOD Compu_MFA_DSPressdt " " RAT_FUNC "%.2" "psi/sec" COEFFS 0 14.1204374026117 0 0 0 1 /end COMPU_METHOD
/begin MEASUREMENT MFA_DSPress_fast "MFA downstream pressure (fast-avg)" UWORD Compu_MFA_DSPress_fast 0 0 0 148.51664578125 ECU_ADDRESS 0x010117E8 /end MEASUREMENT
/begin COMPU_METHOD Compu_MFA_DSPress_fast " " RAT_FUNC "%.2" "psia" COEFFS 0 441.263668831617 0 0 0 1 /end COMPU_METHOD
/begin MEASUREMENT MFA_hsdata_active "MFA high speed data active{MFA_hsdata_active&0xff=0:Inactive}{MFA_hsdata_active&0xff=1:Active}" UBYTE MFA_hsdata_active_COMPU_VTAB 0 0 0 255 ECU_ADDRESS 0x010117F8 BIT_MASK 0xff /end MEASUREMENT
/begin COMPU_METHOD MFA_hsdata_active_COMPU_VTAB "Verbal Table" TAB_VERB "%.0" "list" COMPU_TAB_REF MFA_hsdata_active_COMPU_VTAB_REF /end COMPU_METHOD
/begin COMPU_VTAB MFA_hsdata_active_COMPU_VTAB_REF "Verbal Table" TAB_VERB 2 0 "Inactive" 1 "Active" DEFAULT_VALUE "UNKNOWN" /end COMPU_VTAB
/begin CHARACTERISTIC MFA_TPS_cmd_min "MFA throttle position min" VALUE 0x001c7d84 /* @ECU_Address@MFA_TPS_cmd_min@0x01011830@ */ ECIPP_ALIGNMENT_UWORD 100 Compu_MFA_TPS_cmd_min 0 99.9984741210938 /end CHARACTERISTIC
/begin COMPU_METHOD Compu_MFA_TPS_cmd_min " " RAT_FUNC "%.1" "%" COEFFS 0 655.36 0 0 0 1 /end COMPU_METHOD
/begin CHARACTERISTIC MFA_TPS_cmd_max "MFA throttle position max" VALUE 0x001c7d82 /* @ECU_Address@MFA_TPS_cmd_max@0x01011838@ */ ECIPP_ALIGNMENT_UWORD 100 Compu_MFA_TPS_cmd_max 0 99.9984741210938 /end CHARACTERISTIC
/begin COMPU_METHOD Compu_MFA_TPS_cmd_max " " RAT_FUNC "%.1" "%" COEFFS 0 655.36 0 0 0 1 /end COMPU_METHOD
/begin MEASUREMENT gamma_throttle "Throttle flow specific heat ratio" UWORD Compu_gamma_throttle 0 0 0 3.99993896484375 ECU_ADDRESS 0x01011860 /end MEASUREMENT
/begin COMPU_METHOD Compu_gamma_throttle " " RAT_FUNC "%.3" "-" COEFFS 0 16384 0 0 0 1 /end COMPU_METHOD
/begin MEASUREMENT SG_throttle "Throttle flow specific gravity" UWORD Compu_SG_throttle 0 0 0 127.998046875 ECU_ADDRESS 0x01011868 /end MEASUREMENT
/begin COMPU_METHOD Compu_SG_throttle " " RAT_FUNC "%.3" "-" COEFFS 0 512 0 0 0 1 /end COMPU_METHOD
/begin MEASUREMENT MFA_fault_range_1 "MFA fault range 1" UWORD Compu_MFA_fault_range_1 0 0 0 65535 ECU_ADDRESS 0x01011878 /end MEASUREMENT
/begin COMPU_METHOD Compu_MFA_fault_range_1 " " RAT_FUNC "%.0" "bit flag" COEFFS 0 1 0 0 0 1 /end COMPU_METHOD
/begin MEASUREMENT MFA_fault_range_2 "MFA fault range 2" UWORD Compu_MFA_fault_range_2 0 0 0 65535 ECU_ADDRESS 0x01011888 /end MEASUREMENT
/begin COMPU_METHOD Compu_MFA_fault_range_2 " " RAT_FUNC "%.0" "bit flag" COEFFS 0 1 0 0 0 1 /end COMPU_METHOD
/begin MEASUREMENT MMSD_maxMAP "Spin-down MAP idle target" UWORD Compu_MMSD_maxMAP 0 0 0 255.99609375 ECU_ADDRESS 0x01011EA8 /end MEASUREMENT
/begin COMPU_METHOD Compu_MMSD_maxMAP " " RAT_FUNC "%.2" "psia" COEFFS 0 256 0 0 0 1 /end COMPU_METHOD
/begin CHARACTERISTIC FSO_TPS_variable_ena "Variable TPS position during FSO{FSO_TPS_variable_ena&0xff=0:Disabled}{FSO_TPS_variable_ena&0xff=1:Enabled}" VALUE 0x001c8737 /* @ECU_Address@FSO_TPS_variable_ena@0x01012560@ */ ECIPP_ALIGNMENT_UBYTE 255 FSO_TPS_variable_ena_COMPU_VTAB 0 255 BIT_MASK 0xff /end CHARACTERISTIC
/begin COMPU_METHOD FSO_TPS_variable_ena_COMPU_VTAB "Verbal Table" TAB_VERB "%.0" "list" COMPU_TAB_REF FSO_TPS_variable_ena_COMPU_VTAB_REF /end COMPU_METHOD
/begin COMPU_VTAB FSO_TPS_variable_ena_COMPU_VTAB_REF "Verbal Table" TAB_VERB 2 0 "Disabled" 1 "Enabled" DEFAULT_VALUE "UNKNOWN" /end COMPU_VTAB
/begin CHARACTERISTIC FSO_TPSmin_braking "FSO throttle open position during engine braking" VALUE 0x001c7b44 /* @ECU_Address@FSO_TPSmin_braking@0x01012568@ */ ECIPP_ALIGNMENT_UWORD 100 Compu_FSO_TPSmin_braking 0 99.9984741210938 /end CHARACTERISTIC
/begin COMPU_METHOD Compu_FSO_TPSmin_braking " " RAT_FUNC "%.1" "%" COEFFS 0 655.36 0 0 0 1 /end COMPU_METHOD
/begin CHARACTERISTIC FSO_engbrk_exitwait "FSO disengage delay after engine braking" VALUE 0x001c7b4a /* @ECU_Address@FSO_engbrk_exitwait@0x01012CF8@ */ ECIPP_ALIGNMENT_UWORD 65535 Compu_FSO_engbrk_exitwait 0 65535 /end CHARACTERISTIC
/begin COMPU_METHOD Compu_FSO_engbrk_exitwait " " RAT_FUNC "%.0" "ms" COEFFS 0 1 0 0 0 1 /end COMPU_METHOD
/begin CHARACTERISTIC FSO_ovrspd_TPS_wait "FSO overspeed throttle open delay" VALUE 0x001c7b56 /* @ECU_Address@FSO_ovrspd_TPS_wait@0x010130E8@ */ ECIPP_ALIGNMENT_UWORD 65535 Compu_FSO_ovrspd_TPS_wait 0 65535 /end CHARACTERISTIC
/begin COMPU_METHOD Compu_FSO_ovrspd_TPS_wait " " RAT_FUNC "%.0" "ms" COEFFS 0 1 0 0 0 1 /end COMPU_METHOD
/begin CHARACTERISTIC brake_override_mode "Brake pedal throttle override{brake_override_mode&0xff=0:Disabled}{brake_override_mode&0xff=1:Enabled}" VALUE 0x001c8fa3 /* @ECU_Address@brake_override_mode@0x010131D0@ */ ECIPP_ALIGNMENT_UBYTE 255 brake_override_mode_COMPU_VTAB 0 255 BIT_MASK 0xff /end CHARACTERISTIC
/begin COMPU_METHOD brake_override_mode_COMPU_VTAB "Verbal Table" TAB_VERB "%.0" "list" COMPU_TAB_REF brake_override_mode_COMPU_VTAB_REF /end COMPU_METHOD
/begin COMPU_VTAB brake_override_mode_COMPU_VTAB_REF "Verbal Table" TAB_VERB 2 0 "Disabled" 1 "Enabled" DEFAULT_VALUE "UNKNOWN" /end COMPU_VTAB
/begin CHARACTERISTIC brake_override_RSmin "Brake override min roadspeed" VALUE 0x001c83a0 /* @ECU_Address@brake_override_RSmin@0x010131D8@ */ ECIPP_ALIGNMENT_UWORD 256 Compu_brake_override_RSmin 0 255.99609375 /end CHARACTERISTIC
/begin COMPU_METHOD Compu_brake_override_RSmin " " RAT_FUNC "%.1" "km/hr" COEFFS 0 256 0 0 0 1 /end COMPU_METHOD
/begin MEASUREMENT brake_override_actv "Brake pedal throttle override engaged{brake_override_actv&0xff=0:NO}{brake_override_actv&0xff=1:YES}" UBYTE brake_override_actv_COMPU_VTAB 0 0 0 255 ECU_ADDRESS 0x010131E0 BIT_MASK 0xff /end MEASUREMENT
/begin COMPU_METHOD brake_override_actv_COMPU_VTAB "Verbal Table" TAB_VERB "%.0" "list" COMPU_TAB_REF brake_override_actv_COMPU_VTAB_REF /end COMPU_METHOD
/begin COMPU_VTAB brake_override_actv_COMPU_VTAB_REF "Verbal Table" TAB_VERB 2 0 "NO" 1 "YES" DEFAULT_VALUE "UNKNOWN" /end COMPU_VTAB
/begin CHARACTERISTIC Phi_FSO_pst_mode "FSO phi catalyst enrichment mode{Phi_FSO_pst_mode&0xff=0:Legacy}{Phi_FSO_pst_mode&0xff=1:Enhanced}{Phi_FSO_pst_mode&0xff=2:Enhanced + CBT}" VALUE 0x001c88b1 /* @ECU_Address@Phi_FSO_pst_mode@0x01013358@ */ ECIPP_ALIGNMENT_UBYTE 255 Phi_FSO_pst_mode_COMPU_VTAB 0 255 BIT_MASK 0xff /end CHARACTERISTIC
/begin COMPU_METHOD Phi_FSO_pst_mode_COMPU_VTAB "Verbal Table" TAB_VERB "%.0" "list" COMPU_TAB_REF Phi_FSO_pst_mode_COMPU_VTAB_REF /end COMPU_METHOD
/begin COMPU_VTAB Phi_FSO_pst_mode_COMPU_VTAB_REF "Verbal Table" TAB_VERB 3 0 "Legacy" 1 "Enhanced" 2 "Enhanced + CBT" DEFAULT_VALUE "UNKNOWN" /end COMPU_VTAB
/begin CHARACTERISTIC Phi_FSO_pst_ROLapdlt "FSO phi ROL approach delta" VALUE 0x001c7e8a /* @ECU_Address@Phi_FSO_pst_ROLapdlt@0x01013360@ */ ECIPP_ALIGNMENT_UWORD 100 Compu_Phi_FSO_pst_ROLapdlt 0 99.9984741210938 /end CHARACTERISTIC
/begin COMPU_METHOD Compu_Phi_FSO_pst_ROLapdlt " " RAT_FUNC "%.1" "%" COEFFS 0 655.36 0 0 0 1 /end COMPU_METHOD
/begin MEASUREMENT Phi_FSO_pst_ROL_thld "FSO phi ROL enrichment exit threshold" UWORD Compu_Phi_FSO_pst_ROL_thld 0 0 0 99.9984741210938 ECU_ADDRESS 0x01013368 /end MEASUREMENT
/begin COMPU_METHOD Compu_Phi_FSO_pst_ROL_thld " " RAT_FUNC "%.1" "%" COEFFS 0 655.36 0 0 0 1 /end COMPU_METHOD
/begin CHARACTERISTIC FPP1_PWM_ena "FPP1 PWM input{FPP1_PWM_ena&0xff=0:Disabled}{FPP1_PWM_ena&0xff=1:Pulse in}{FPP1_PWM_ena&0xff=2:Roadspeed}{FPP1_PWM_ena&0xff=3:Aux DIG23 comparator}{FPP1_PWM_ena&0xff=4:Aux DIG24 comparator}{FPP1_PWM_ena&0xff=5:Aux DIG25 comparator}" VALUE 0x001c8712 /* @ECU_Address@FPP1_PWM_ena@0x01013380@ */ ECIPP_ALIGNMENT_UBYTE 255 FPP1_PWM_ena_COMPU_VTAB 0 255 BIT_MASK 0xff /end CHARACTERISTIC
/begin COMPU_METHOD FPP1_PWM_ena_COMPU_VTAB "Verbal Table" TAB_VERB "%.0" "list" COMPU_TAB_REF FPP1_PWM_ena_COMPU_VTAB_REF /end COMPU_METHOD
/begin COMPU_VTAB FPP1_PWM_ena_COMPU_VTAB_REF "Verbal Table" TAB_VERB 6 0 "Disabled" 1 "Pulse in" 2 "Roadspeed" 3 "Aux DIG23 comparator" 4 "Aux DIG24 comparator" 5 "Aux DIG25 comparator" DEFAULT_VALUE "UNKNOWN" /end COMPU_VTAB
/begin CHARACTERISTIC FPP1_PWM_edge "FPP1 PWM edge capture{FPP1_PWM_edge&0xff=0:Rising edge}{FPP1_PWM_edge&0xff=1:Falling edge}" VALUE 0x001c8711 /* @ECU_Address@FPP1_PWM_edge@0x01013388@ */ ECIPP_ALIGNMENT_UBYTE 255 FPP1_PWM_edge_COMPU_VTAB 0 255 BIT_MASK 0xff /end CHARACTERISTIC
/begin COMPU_METHOD FPP1_PWM_edge_COMPU_VTAB "Verbal Table" TAB_VERB "%.0" "list" COMPU_TAB_REF FPP1_PWM_edge_COMPU_VTAB_REF /end COMPU_METHOD
/begin COMPU_VTAB FPP1_PWM_edge_COMPU_VTAB_REF "Verbal Table" TAB_VERB 2 0 "Rising edge" 1 "Falling edge" DEFAULT_VALUE "UNKNOWN" /end COMPU_VTAB
/begin CHARACTERISTIC FPP1_PWM_Hz_idle "FPP1 PWM idle frequency" VALUE 0x001c3ab8 /* @ECU_Address@FPP1_PWM_Hz_idle@0x01013390@ */ ECIPP_ALIGNMENT_FLOAT32_IEEE 10000000000 Compu_FPP1_PWM_Hz_idle -10000000000 10000000000 /end CHARACTERISTIC
/begin COMPU_METHOD Compu_FPP1_PWM_Hz_idle " " RAT_FUNC "%.0" "Hz" COEFFS 0 1 0 0 0 1 /end COMPU_METHOD
/begin CHARACTERISTIC FPP1_PWM_Hz_full "FPP1 PWM full frequency" VALUE 0x001c3ab4 /* @ECU_Address@FPP1_PWM_Hz_full@0x01013398@ */ ECIPP_ALIGNMENT_FLOAT32_IEEE 10000000000 Compu_FPP1_PWM_Hz_full -10000000000 10000000000 /end CHARACTERISTIC
/begin COMPU_METHOD Compu_FPP1_PWM_Hz_full " " RAT_FUNC "%.0" "Hz" COEFFS 0 1 0 0 0 1 /end COMPU_METHOD
/begin MEASUREMENT FPP1_PWM_Hz "FPP1 PWM frequency" FLOAT32_IEEE Compu_FPP1_PWM_Hz 0 0 -10000000000 10000000000 ECU_ADDRESS 0x010133A0 /end MEASUREMENT
/begin COMPU_METHOD Compu_FPP1_PWM_Hz " " RAT_FUNC "%.0" "Hz" COEFFS 0 1 0 0 0 1 /end COMPU_METHOD
/begin CHARACTERISTIC FPP_stuck_dz "Stuck FPP dead zone" VALUE 0x001c6f9a /* @ECU_Address@FPP_stuck_dz@0x010133A8@ */ ECIPP_ALIGNMENT_UWORD 100 Compu_FPP_stuck_dz 0 99.9984741210938 /end CHARACTERISTIC
/begin COMPU_METHOD Compu_FPP_stuck_dz " " RAT_FUNC "%.1" "%" COEFFS 0 655.36 0 0 0 1 /end COMPU_METHOD
/begin MEASUREMENT FPP_stuck_tmr "Stuck FPP time in dead zone" UWORD Compu_FPP_stuck_tmr 0 0 0 65535 ECU_ADDRESS 0x010133B0 /end MEASUREMENT
/begin COMPU_METHOD Compu_FPP_stuck_tmr " " RAT_FUNC "%.0" "ms" COEFFS 0 1 0 0 0 1 /end COMPU_METHOD
/begin CHARACTERISTIC FPP_stuck_wot "Stuck FPP WOT threshold" VALUE 0x001c6fa0 /* @ECU_Address@FPP_stuck_wot@0x010133B8@ */ ECIPP_ALIGNMENT_UWORD 100 Compu_FPP_stuck_wot 0 99.9984741210938 /end CHARACTERISTIC
/begin COMPU_METHOD Compu_FPP_stuck_wot " " RAT_FUNC "%.1" "%" COEFFS 0 655.36 0 0 0 1 /end COMPU_METHOD
/begin CHARACTERISTIC FPP_stuck_wot_tm "Stuck FPP WOT time limit" VALUE 0x001c6fa2 /* @ECU_Address@FPP_stuck_wot_tm@0x010133C0@ */ ECIPP_ALIGNMENT_UWORD 65535 Compu_FPP_stuck_wot_tm 0 65535 /end CHARACTERISTIC
/begin COMPU_METHOD Compu_FPP_stuck_wot_tm " " RAT_FUNC "%.0" "ms" COEFFS 0 1 0 0 0 1 /end COMPU_METHOD
/begin CHARACTERISTIC FPP_stuck_idle "Stuck FPP idle threshold" VALUE 0x001c6f9c /* @ECU_Address@FPP_stuck_idle@0x010133C8@ */ ECIPP_ALIGNMENT_UWORD 100 Compu_FPP_stuck_idle 0 99.9984741210938 /end CHARACTERISTIC
/begin COMPU_METHOD Compu_FPP_stuck_idle " " RAT_FUNC "%.1" "%" COEFFS 0 655.36 0 0 0 1 /end COMPU_METHOD
/begin CHARACTERISTIC FPP_stuck_offidle_tm "Stuck FPP off-idle time limit" VALUE 0x001c6f9e /* @ECU_Address@FPP_stuck_offidle_tm@0x010133D0@ */ ECIPP_ALIGNMENT_UWORD 65535 Compu_FPP_stuck_offidle_tm 0 65535 /end CHARACTERISTIC
/begin COMPU_METHOD Compu_FPP_stuck_offidle_tm " " RAT_FUNC "%.0" "ms" COEFFS 0 1 0 0 0 1 /end COMPU_METHOD
/begin CHARACTERISTIC MFA_TPS_dP_min "MFA TPS limiting dP minimum" VALUE 0x001c7d86 /* @ECU_Address@MFA_TPS_dP_min@0x010133E0@ */ ECIPP_ALIGNMENT_UWORD 149 Compu_MFA_TPS_dP_min 0 148.51664578125 /end CHARACTERISTIC
/begin COMPU_METHOD Compu_MFA_TPS_dP_min " " RAT_FUNC "%.2" "psia" COEFFS 0 441.263668831617 0 0 0 1 /end COMPU_METHOD
/begin CHARACTERISTIC FSO_TPS_wait_mode "FSO throttle open delay mode{FSO_TPS_wait_mode&0xff=0:Single Point}{FSO_TPS_wait_mode&0xff=1:Table Based}" VALUE 0x001c8738 /* @ECU_Address@FSO_TPS_wait_mode@0x010134A0@ */ ECIPP_ALIGNMENT_UBYTE 255 FSO_TPS_wait_mode_COMPU_VTAB 0 255 BIT_MASK 0xff /end CHARACTERISTIC
/begin COMPU_METHOD FSO_TPS_wait_mode_COMPU_VTAB "Verbal Table" TAB_VERB "%.0" "list" COMPU_TAB_REF FSO_TPS_wait_mode_COMPU_VTAB_REF /end COMPU_METHOD
/begin COMPU_VTAB FSO_TPS_wait_mode_COMPU_VTAB_REF "Verbal Table" TAB_VERB 2 0 "Single Point" 1 "Table Based" DEFAULT_VALUE "UNKNOWN" /end COMPU_VTAB
/begin MEASUREMENT FSO_TPS_wait_cur "FSO throttle open delay" UWORD Compu_FSO_TPS_wait_cur 0 0 0 65535 ECU_ADDRESS 0x010134A8 /end MEASUREMENT
/begin COMPU_METHOD Compu_FSO_TPS_wait_cur " " RAT_FUNC "%.0" "ms" COEFFS 0 1 0 0 0 1 /end COMPU_METHOD
/begin MEASUREMENT Phi_FSO_cs_state "FSO phi cold start state{Phi_FSO_cs_state&0xff=0:Waiting for start}{Phi_FSO_cs_state&0xff=1:Active}{Phi_FSO_cs_state&0xff=10:Disabled}{Phi_FSO_cs_state&0xff=11:Timed out}{Phi_FSO_cs_state&0xff=12:Inactive}{Phi_FSO_cs_state&0xff=13:Complete}" UBYTE Phi_FSO_cs_state_COMPU_VTAB 0 0 0 255 ECU_ADDRESS 0x010137F8 BIT_MASK 0xff /end MEASUREMENT
/begin COMPU_METHOD Phi_FSO_cs_state_COMPU_VTAB "Verbal Table" TAB_VERB "%.0" "list" COMPU_TAB_REF Phi_FSO_cs_state_COMPU_VTAB_REF /end COMPU_METHOD
/begin COMPU_VTAB Phi_FSO_cs_state_COMPU_VTAB_REF "Verbal Table" TAB_VERB 6 0 "Waiting for start" 1 "Active" 10 "Disabled" 11 "Timed out" 12 "Inactive" 13 "Complete" DEFAULT_VALUE "UNKNOWN" /end COMPU_VTAB
/begin CHARACTERISTIC FSO_TPSmin_entry "FSO entry min throttle position" VALUE 0x001c7b46 /* @ECU_Address@FSO_TPSmin_entry@0x010138F0@ */ ECIPP_ALIGNMENT_UWORD 100 Compu_FSO_TPSmin_entry 0 99.9984741210938 /end CHARACTERISTIC
/begin COMPU_METHOD Compu_FSO_TPSmin_entry " " RAT_FUNC "%.1" "%" COEFFS 0 655.36 0 0 0 1 /end COMPU_METHOD
/begin CHARACTERISTIC FPP1_PWM_idle_rpm "FPP1 PWM minimum idle speed" VALUE 0x001c6f7c /* @ECU_Address@FPP1_PWM_idle_rpm@0x01013950@ */ ECIPP_ALIGNMENT_UWORD 65535 Compu_FPP1_PWM_idle_rpm 0 65535 /end CHARACTERISTIC
/begin COMPU_METHOD Compu_FPP1_PWM_idle_rpm " " RAT_FUNC "%.0" "rpm" COEFFS 0 1 0 0 0 1 /end COMPU_METHOD
/begin MEASUREMENT MFA_VE_mdot_err "MFA vs VE-based throttle mdot error" SWORD Compu_MFA_VE_mdot_err 0 0 -400 399.98779296875 ECU_ADDRESS 0x01013A28 /end MEASUREMENT
/begin COMPU_METHOD Compu_MFA_VE_mdot_err " " RAT_FUNC "%.1" "%" COEFFS 0 81.92 0 0 0 1 /end COMPU_METHOD
/begin CHARACTERISTIC FSO_TPS_ctrl_mode "FSO throttle open control mode{FSO_TPS_ctrl_mode&0xff=0:Pre-open UEGO check}{FSO_TPS_ctrl_mode&0xff=1:Post-open UEGO check}" VALUE 0x001c8734 /* @ECU_Address@FSO_TPS_ctrl_mode@0x01013A60@ */ ECIPP_ALIGNMENT_UBYTE 255 FSO_TPS_ctrl_mode_COMPU_VTAB 0 255 BIT_MASK 0xff /end CHARACTERISTIC
/begin COMPU_METHOD FSO_TPS_ctrl_mode_COMPU_VTAB "Verbal Table" TAB_VERB "%.0" "list" COMPU_TAB_REF FSO_TPS_ctrl_mode_COMPU_VTAB_REF /end COMPU_METHOD
/begin COMPU_VTAB FSO_TPS_ctrl_mode_COMPU_VTAB_REF "Verbal Table" TAB_VERB 2 0 "Pre-open UEGO check" 1 "Post-open UEGO check" DEFAULT_VALUE "UNKNOWN" /end COMPU_VTAB
/begin CHARACTERISTIC FSO_TPS_phi_check "FSO post TPS open UEGO check" VALUE 0x001c7b3e /* @ECU_Address@FSO_TPS_phi_check@0x01013A68@ */ ECIPP_ALIGNMENT_UWORD 65535 Compu_FSO_TPS_phi_check 0 65535 /end CHARACTERISTIC
/begin COMPU_METHOD Compu_FSO_TPS_phi_check " " RAT_FUNC "%.0" "ms" COEFFS 0 1 0 0 0 1 /end COMPU_METHOD
/begin CHARACTERISTIC FSO_load_delay "FSO disengage load fixed delay" VALUE 0x001c7b52 /* @ECU_Address@FSO_load_delay@0x01014A50@ */ ECIPP_ALIGNMENT_UWORD 65535 Compu_FSO_load_delay 0 65535 /end CHARACTERISTIC
/begin COMPU_METHOD Compu_FSO_load_delay " " RAT_FUNC "%.0" "ms" COEFFS 0 1 0 0 0 1 /end COMPU_METHOD
/begin CHARACTERISTIC FSO_load_T_delay "FSO disengage load transport delay" VALUE 0x001c7b50 /* @ECU_Address@FSO_load_T_delay@0x01014A58@ */ ECIPP_ALIGNMENT_UWORD 4 Compu_FSO_load_T_delay 0 3.99993896484375 /end CHARACTERISTIC
/begin COMPU_METHOD Compu_FSO_load_T_delay " " RAT_FUNC "%.2" "Tdelays" COEFFS 0 16384 0 0 0 1 /end COMPU_METHOD
/begin MEASUREMENT FPP_unadjust_pct "FPP position unadjusted" UWORD Compu_FPP_unadjust_pct 0 0 0 99.9984741210938 ECU_ADDRESS 0x01014BE8 /end MEASUREMENT
/begin COMPU_METHOD Compu_FPP_unadjust_pct " " RAT_FUNC "%.1" "%" COEFFS 0 655.36 0 0 0 1 /end COMPU_METHOD
/begin CHARACTERISTIC FPP_kickdown_src "FPP kickdown source{FPP_kickdown_src&0xff=0:FPP Command}{FPP_kickdown_src&0xff=1:FPP Position}" VALUE 0x001c8722 /* @ECU_Address@FPP_kickdown_src@0x01014BF0@ */ ECIPP_ALIGNMENT_UBYTE 255 FPP_kickdown_src_COMPU_VTAB 0 255 BIT_MASK 0xff /end CHARACTERISTIC
/begin COMPU_METHOD FPP_kickdown_src_COMPU_VTAB "Verbal Table" TAB_VERB "%.0" "list" COMPU_TAB_REF FPP_kickdown_src_COMPU_VTAB_REF /end COMPU_METHOD
/begin COMPU_VTAB FPP_kickdown_src_COMPU_VTAB_REF "Verbal Table" TAB_VERB 2 0 "FPP Command" 1 "FPP Position" DEFAULT_VALUE "UNKNOWN" /end COMPU_VTAB
/begin CHARACTERISTIC FSO_Gov3_timer_init "Gov3 FSO validation time" VALUE 0x001c7b32 /* @ECU_Address@FSO_Gov3_timer_init@0x01014C08@ */ ECIPP_ALIGNMENT_UWORD 65535 Compu_FSO_Gov3_timer_init 0 65535 /end CHARACTERISTIC
/begin COMPU_METHOD Compu_FSO_Gov3_timer_init " " RAT_FUNC "%.0" "ms" COEFFS 0 1 0 0 0 1 /end COMPU_METHOD
/begin CHARACTERISTIC FSO_Gov3_ena_rpm_err "Gov3 FSO engage speed error" VALUE 0x001c7b2c /* @ECU_Address@FSO_Gov3_ena_rpm_err@0x01014C18@ */ ECIPP_ALIGNMENT_UWORD 65535 Compu_FSO_Gov3_ena_rpm_err 0 65535 /end CHARACTERISTIC
/begin COMPU_METHOD Compu_FSO_Gov3_ena_rpm_err " " RAT_FUNC "%.0" "rpm" COEFFS 0 1 0 0 0 1 /end COMPU_METHOD
/begin CHARACTERISTIC FSO_Gov3_dis_rpm_err "Gov3 FSO disengage speed error" VALUE 0x001c7b2a /* @ECU_Address@FSO_Gov3_dis_rpm_err@0x01014C20@ */ ECIPP_ALIGNMENT_UWORD 65535 Compu_FSO_Gov3_dis_rpm_err 0 65535 /end CHARACTERISTIC
/begin COMPU_METHOD Compu_FSO_Gov3_dis_rpm_err " " RAT_FUNC "%.0" "rpm" COEFFS 0 1 0 0 0 1 /end COMPU_METHOD
/begin CHARACTERISTIC FSO_Gov3_load_max "Gov3 FSO engage load max" VALUE 0x001c7b30 /* @ECU_Address@FSO_Gov3_load_max@0x01014C28@ */ ECIPP_ALIGNMENT_UWORD 100 Compu_FSO_Gov3_load_max 0 99.9984741210938 /end CHARACTERISTIC
/begin COMPU_METHOD Compu_FSO_Gov3_load_max " " RAT_FUNC "%.1" "%" COEFFS 0 655.36 0 0 0 1 /end COMPU_METHOD
/begin CHARACTERISTIC FSO_Gov3_load_delta "Gov3 FSO disengage load change" VALUE 0x001c7b2e /* @ECU_Address@FSO_Gov3_load_delta@0x01014C30@ */ ECIPP_ALIGNMENT_UWORD 100 Compu_FSO_Gov3_load_delta 0 99.9984741210938 /end CHARACTERISTIC
/begin COMPU_METHOD Compu_FSO_Gov3_load_delta " " RAT_FUNC "%.1" "%" COEFFS 0 655.36 0 0 0 1 /end COMPU_METHOD
/begin CHARACTERISTIC FPP1_kickdown_on_V "FPP1 kickdown engagement" VALUE 0x001c6f7e /* @ECU_Address@FPP1_kickdown_on_V@0x01014F98@ */ ECIPP_ALIGNMENT_UWORD 5 Compu_FPP1_kickdown_on_V 0 5.00114468864469 /end CHARACTERISTIC
/begin COMPU_METHOD Compu_FPP1_kickdown_on_V " " RAT_FUNC "%.3" "volts" COEFFS 0 13104 0 0 0 1 /end COMPU_METHOD
/begin CHARACTERISTIC FSO_TPS_flt_chk_mode "FSO throttle open UEGO fault check mode{FSO_TPS_flt_chk_mode&0xff=0:Instantaneous (Legacy)}{FSO_TPS_flt_chk_mode&0xff=1:Pending or Confirmed}" VALUE 0x001c8735 /* @ECU_Address@FSO_TPS_flt_chk_mode@0x01015008@ */ ECIPP_ALIGNMENT_UBYTE 255 FSO_TPS_flt_chk_mode_COMPU_VTAB 0 255 BIT_MASK 0xff /end CHARACTERISTIC
/begin COMPU_METHOD FSO_TPS_flt_chk_mode_COMPU_VTAB "Verbal Table" TAB_VERB "%.0" "list" COMPU_TAB_REF FSO_TPS_flt_chk_mode_COMPU_VTAB_REF /end COMPU_METHOD
/begin COMPU_VTAB FSO_TPS_flt_chk_mode_COMPU_VTAB_REF "Verbal Table" TAB_VERB 2 0 "Instantaneous (Legacy)" 1 "Pending or Confirmed" DEFAULT_VALUE "UNKNOWN" /end COMPU_VTAB
/begin COMPU_METHOD Compu_TTPSlim_rpm " " RAT_FUNC "%.0" "Speed (rpm)" COEFFS 0 1 0 0 0 1 /end COMPU_METHOD
/begin CHARACTERISTIC TTPSlim_TPS "TPS-Limit" CURVE 0x001C5BEE /* @ECU_Address@TTPSlim_TPS@0x02128000@ */ ECIPP_ALIGNMENT_SWORD 200 Compu_TTPSlim_TPS -200 199.993896484375
 /begin AXIS_DESCR COM_AXIS NO_INPUT_QUANTITY Compu_TTPSlim_rpm 8 -32768 32767 AXIS_PTS_REF TTPSlim_rpm /end AXIS_DESCR
/end CHARACTERISTIC
/begin AXIS_PTS TTPSlim_rpm " " 0x001C5BFE /* @ECU_Address@TTPSlim_rpm@0x02127000@ */ NO_INPUT_QUANTITY ECIPP_Lookup_SWORD 0 Compu_TTPSlim_rpm 8 -32768 32767 /end AXIS_PTS
/begin COMPU_METHOD Compu_TTPSlim_TPS " " RAT_FUNC "%.1" "Max TPS (%)" COEFFS 0 163.84 0 0 0 1 /end COMPU_METHOD
/begin COMPU_METHOD Compu_TFPPsdn_FPP " " RAT_FUNC "%.1" "Current FPP (%)" COEFFS 0 327.68 0 0 0 1 /end COMPU_METHOD
/begin COMPU_METHOD Compu_TFPPsdn_TIP " " RAT_FUNC "%.2" "TIP (psia)" COEFFS 0 256 0 0 0 1 /end COMPU_METHOD
/begin CHARACTERISTIC TFPPsdn_slew "FPP Decreasing Slew Limit" MAP 0x001C4E38 /* @ECU_Address@TFPPsdn_slew@0x02310000@ */ ECIPP_ALIGNMENT_SWORD 49998 Compu_TFPPsdn_slew -50000 49998.4741210938
 /begin AXIS_DESCR COM_AXIS NO_INPUT_QUANTITY Compu_TFPPsdn_TIP 2 -128 127.99609375 AXIS_PTS_REF TFPPsdn_TIP /end AXIS_DESCR
 /begin AXIS_DESCR COM_AXIS NO_INPUT_QUANTITY Compu_TFPPsdn_FPP 2 -100 99.9969482421875 AXIS_PTS_REF TFPPsdn_FPP /end AXIS_DESCR
/end CHARACTERISTIC
/begin AXIS_PTS TFPPsdn_TIP " " 0x001C4E34 /* @ECU_Address@TFPPsdn_TIP@0x0230F000@ */ NO_INPUT_QUANTITY ECIPP_Lookup_SWORD 0 Compu_TFPPsdn_TIP 2 -128 127.99609375 /end AXIS_PTS
/begin AXIS_PTS TFPPsdn_FPP " " 0x001C4E30 /* @ECU_Address@TFPPsdn_FPP@0x0230E000@ */ NO_INPUT_QUANTITY ECIPP_Lookup_SWORD 0 Compu_TFPPsdn_FPP 2 -100 99.9969482421875 /end AXIS_PTS
/begin COMPU_METHOD Compu_TFPPsdn_slew "" RAT_FUNC "%.1" "Slew Rate (%/sec)" COEFFS 0 0.65536 0 0 0 1 /end COMPU_METHOD
/begin COMPU_METHOD Compu_TFSO_TPS_wait_RS " " RAT_FUNC "%.0" "Speed (kph)" COEFFS 0 128 0 0 0 1 /end COMPU_METHOD
/begin CHARACTERISTIC TFSO_TPS_wait "FSO Throttle Open Delay" CURVE 0x001C80DE /* @ECU_Address@TFSO_TPS_wait@0x0265E000@ */ ECIPP_ALIGNMENT_UWORD 65535 Compu_TFSO_TPS_wait 0 65535
 /begin AXIS_DESCR COM_AXIS NO_INPUT_QUANTITY Compu_TFSO_TPS_wait_RS 2 -256 255.9921875 AXIS_PTS_REF TFSO_TPS_wait_RS /end AXIS_DESCR
/end CHARACTERISTIC
/begin AXIS_PTS TFSO_TPS_wait_RS " " 0x001C4E40 /* @ECU_Address@TFSO_TPS_wait_RS@0x0265D000@ */ NO_INPUT_QUANTITY ECIPP_Lookup_SWORD 0 Compu_TFSO_TPS_wait_RS 2 -256 255.9921875 /end AXIS_PTS
/begin COMPU_METHOD Compu_TFSO_TPS_wait " " RAT_FUNC "%.0" "Delay (ms)" COEFFS 0 1 0 0 0 1 /end COMPU_METHOD
/begin GROUP EC_DBWCal "ECONTROLS" ROOT
 /begin REF_CHARACTERISTIC Kp_TFB Ki_TFB Kd_TFB I_TFB_min I_TFB_max I_TFBdt_frz DBW_ctl_min DBW_ctl_max FPPdp_max FPPdp_dcy FSO_ena FSO_idle_off FSO_TPSmin FSO_rpm_low FSO_rpm_high FSO_rpm_TPSoff FSO_MAP FSO_ECT_lockout FPPslew_max_lo FPPslew_max_hi Kp_clo_TFB Kd_clo_TFB FPP_mode MinMAP_ena MinMAP_target MinMAP_slew MinMAP_maxTPS Ki_MinMAP FPPIVS_ena FPP2_mode FPPdual_pedal FPP_idle_valid FPP_full_valid FSO_MAP_hyst IVS_source TCSB_ena TCSB_TPSdelta TCSB_min_TPSdt TCSB_max_TPSdt TCSB_Kd TOSB_ena TOSB_TPSdelta TOSB_min_TPSdt TOSB_max_TPSdt TOSB_Kd FSO_runtime_wait IAC_step_min IAC_step_max IAC_step_home IAC_Vbat_min IAC_step_park IACflw_ena IACflw_inc IACflw_dec IACflw_FPP_0 IACflw_FPP_1 IACflw_cmd_0 IACflw_cmd_1 IAC_Ilearn_drpm IAC_Ilearn_tau TPS12ctl_choice TPS2ctl_allow FPPdualpot_ena TPSdualpot_ena door_ntrlk_ena door_ntrlk_sense TPSlim_ena_gsln TPSlim_ena_LP TPSlim_ena_NG MMSD_ena MMSD_MinMAP MMSD_minTPS MMSD_maxTPS FSO_TPS_wait FSO_timer_init FSO_fault_init FSO_rpm_mode FSO_bstfault_init secspd_actinv secspd_FPP2act secspd_FPP2trk_tau MinMAP_spdgov FPP2_source FSO_load_init FPP_dz_pct FPP_dz_tau FPP_kickdown_on FPP_kickdown_off FPP_kickdown_ena FSO_TPS_UEGO_lmt FSO_TPS_spk_kill FPP1_switch_ena FPP2_switch_ena FPP_switch_slew_ena FPP_switch_rpm_tau FPP_switch_FPP_tau FPP_switch_rpm_inc FPP_switch_FPP_inc FSO_fault_mode APSdualpot_ena BPSdualpot_ena APS2ctl_allow BPS2ctl_allow APS12ctl_choice BPS12ctl_choice Kp_AFB Kp_BFB Ki_AFB Ki_BFB Kd_AFB Kd_BFB Kp_clo_AFB Kp_clo_BFB Kd_clo_AFB Kd_clo_BFB I_AFB_min I_BFB_min I_AFB_max I_BFB_max I_AFBdt_frz I_BFBdt_frz HBA_ctl_min HBB_ctl_min HBA_ctl_max HBB_ctl_max ACSB_ena BCSB_ena ACSB_APSdelta BCSB_BPSdelta ACSB_min_APSdt BCSB_min_BPSdt ACSB_max_APSdt BCSB_max_BPSdt ACSB_Kd BCSB_Kd AOSB_ena BOSB_ena AOSB_APSdelta BOSB_BPSdelta AOSB_min_APSdt BOSB_min_BPSdt AOSB_max_APSdt BOSB_max_BPSdt AOSB_Kd BOSB_Kd TPS1_source TPS2_source APS1_source APS2_source BPS1_source BPS2_source DBW_FB_cmd_LP HBA_FB_cmd_LP HBB_FB_cmd_LP FPPslewdown_ena FSO_TPS_coord_ena FSO_TPS_coord_MAP FSO_TPS_coord_wait FPP_learn_sync_ena FPPdual_pedal_chan FPPdual_pedal_cfg TPS_step_max APS_step_max BPS_step_max TPS_EE_store APS_EE_store BPS_EE_store Phi_FSO_offset Phi_FSO_pst_sw Phi_FSO_max_ms EGR_minnom_FSO FSO_phi_delt_wt PN_MFA_eng_cal_mod MFA_mdot_FS MFA_dP_cyl_events MFA_enabled MFA_hsdata_tx_ena MFA_TPS_cmd_min MFA_TPS_cmd_max FSO_TPS_variable_ena FSO_TPSmin_braking FSO_engbrk_exitwait FSO_ovrspd_TPS_wait brake_override_mode brake_override_RSmin Phi_FSO_pst_mode Phi_FSO_pst_ROLapdlt FPP1_PWM_ena FPP1_PWM_edge FPP1_PWM_Hz_idle FPP1_PWM_Hz_full FPP_stuck_dz FPP_stuck_wot FPP_stuck_wot_tm FPP_stuck_idle FPP_stuck_offidle_tm MFA_TPS_dP_min FSO_TPS_wait_mode FSO_TPSmin_entry FPP1_PWM_idle_rpm FSO_TPS_ctrl_mode FSO_TPS_phi_check FSO_load_delay FSO_load_T_delay FPP_kickdown_src FSO_Gov3_timer_init FSO_Gov3_ena_rpm_err FSO_Gov3_dis_rpm_err FSO_Gov3_load_max FSO_Gov3_load_delta FPP1_kickdown_on_V FSO_TPS_flt_chk_mode TTPSlim_TPS TFPPsdn_slew TFSO_TPS_wait /end REF_CHARACTERISTIC
 /begin REF_MEASUREMENT TFBdt TPS1_rawfilt TPS2_rawfilt FPP1_rawfilt FPP2_rawfilt FPP1_pct FPP2_pct TPS1_pct TPS2_pct FPP_cmd_pct TPS_cmd_pct TPS_cmd_AD DBW_ctl_cmd FSO_retard TPS_MinMAP_pct MinMAP_psd FPP_cmd_final FPP1_idle FPP1_full FPP2_idle FPP2_full TPS1_idle TPS1_full TPS2_idle TPS2_full IVS_volt flag4_ACTIVE_FPP flag2_IVS_AT_IDLE DBW_test_ena active_FPP_mode FPPatidle_mode TEM_I I_TFB_acc IAC_step_int IAC_step_d IAC_step_a IAC_pwr_ena IAC_cmd_pct IAC_home_req IAC_min_gov_pct IACflw_cmd IACflw_active IAC_act_sgnpct IAC_full_req FPP2atidle_mode door_ntrlk TPSlim_current MMSD_TPS_pct FPP_idlvld_cur secspd_FPP2trk TPS_ctl_auth FSO_load_reduct FPP_kickdown_active FPP_switch_rpm FPP_switch_FPP FPP_switch_state I_AFB_acc I_BFB_acc HBA_ctl_cmd HBB_ctl_cmd AEM_I BEM_I APS_cmd_pct BPS_cmd_pct APS_cmd_AD BPS_cmd_AD APS_pct BPS_pct AFBdt BFBdt APS1_rawfilt BPS1_rawfilt APS2_rawfilt BPS2_rawfilt APS1_pct BPS1_pct APS1_idle BPS1_idle APS1_full BPS1_full APS2_pct BPS2_pct APS2_idle BPS2_idle APS2_full BPS2_full DBW_iFB_amps HBA_iFB_amps HBB_iFB_amps DBW_device_status HBA_device_status HBB_device_status FSO_TPS_open_tmr mdot_throttle_float FPP1_center FPP2_center Phi_FSO_active MFA_man_mode MFA_ctltype_cmd MFA_ctltype_act MFA_status MFAI_flash_wr_left MFAI_flash_wr_force MFAI_cur_cal_mod MFA_param_differ MFA_param_upload MFA_cal_state MFAI_cur_SW_mod MFAI_cur_HW_mod MFA_mdot_act_pct MFA_mdot_act MFA_mdot_cmd_pct MFA_mdot_cmd MFA_param_NA_cnt MFA_TPS_act_pct MFA_TPS_cmd_pct MFA_FTemp MFA_USPress MFA_DSPress MFA_DPPress MFA_dP_avg_window MFA_DPPress_Pcrct MFA_DPPress_final MFA_hsdata_tx_act MFA_DSPress_slow MFA_DSPressdt MFA_DSPress_fast MFA_hsdata_active gamma_throttle SG_throttle MFA_fault_range_1 MFA_fault_range_2 MMSD_maxMAP brake_override_actv Phi_FSO_pst_ROL_thld FPP1_PWM_Hz FPP_stuck_tmr FSO_TPS_wait_cur Phi_FSO_cs_state MFA_VE_mdot_err FPP_unadjust_pct /end REF_MEASUREMENT
/end GROUP
/begin GROUP EC_EGRCommand "ECONTROLS" ROOT /begin REF_CHARACTERISTIC EGR_minnom_FSO /end REF_CHARACTERISTIC /end GROUP
/begin GROUP EC_Faults "ECONTROLS" ROOT
 /begin REF_MEASUREMENT TPS1_rawfilt TPS2_rawfilt FPP1_rawfilt FPP2_rawfilt TPS1_pct TPS2_pct FPP_cmd_pct TPS_cmd_pct IVS_volt flag2_IVS_AT_IDLE DBW_test_ena /end REF_MEASUREMENT
/end GROUP
/begin GROUP EC_FilterCal "ECONTROLS" ROOT
 /begin REF_MEASUREMENT TFBdt TPS1_rawfilt TPS1_pct AFBdt BFBdt APS1_rawfilt BPS1_rawfilt APS1_pct BPS1_pct /end REF_MEASUREMENT
/end GROUP
/begin GROUP EC_GovCal "ECONTROLS" ROOT /begin REF_MEASUREMENT TPS_cmd_pct flag2_IVS_AT_IDLE /end REF_MEASUREMENT /end GROUP
/begin GROUP EC_GovCalAlt "ECONTROLS" ROOT /begin REF_MEASUREMENT TPS_cmd_pct flag2_IVS_AT_IDLE /end REF_MEASUREMENT /end GROUP
/begin GROUP EC_LDService "ECONTROLS" ROOT
 /begin REF_MEASUREMENT TPS1_rawfilt TPS2_rawfilt FPP_cmd_pct TPS_cmd_pct DBW_test_ena /end REF_MEASUREMENT
/end GROUP
/begin GROUP EC_LEService "ECONTROLS" ROOT
 /begin REF_MEASUREMENT MFA_status MFA_mdot_act MFA_mdot_cmd MFA_TPS_act_pct MFA_FTemp MFA_USPress MFA_DSPress /end REF_MEASUREMENT
/end GROUP
/begin GROUP EC_LoadCal "ECONTROLS" ROOT /begin REF_MEASUREMENT TPS1_rawfilt TPS2_rawfilt FPP_cmd_pct TPS_cmd_pct /end REF_MEASUREMENT /end GROUP
/begin GROUP EC_Marine "ECONTROLS" ROOT /begin REF_MEASUREMENT FPP_cmd_pct TPS_cmd_pct /end REF_MEASUREMENT /end GROUP
/begin GROUP EC_PhiGsln "ECONTROLS" ROOT /begin REF_MEASUREMENT Phi_FSO_active /end REF_MEASUREMENT /end GROUP
/begin GROUP EC_PhiLP "ECONTROLS" ROOT /begin REF_MEASUREMENT Phi_FSO_active /end REF_MEASUREMENT /end GROUP
/begin GROUP EC_PhiNG "ECONTROLS" ROOT /begin REF_MEASUREMENT Phi_FSO_active /end REF_MEASUREMENT /end GROUP
/begin GROUP EC_SparkCal "ECONTROLS" ROOT /begin REF_MEASUREMENT FSO_retard /end REF_MEASUREMENT /end GROUP
/begin GROUP EC_SparkCalLP "ECONTROLS" ROOT /begin REF_MEASUREMENT FSO_retard /end REF_MEASUREMENT /end GROUP
/begin GROUP EC_SparkCalNG "ECONTROLS" ROOT /begin REF_MEASUREMENT FSO_retard /end REF_MEASUREMENT /end GROUP
/begin GROUP EC_SparkOfst "ECONTROLS" ROOT /begin REF_MEASUREMENT FSO_retard /end REF_MEASUREMENT /end GROUP
/begin GROUP EC_Starting "ECONTROLS" ROOT /begin REF_MEASUREMENT FPP_cmd_pct TPS_cmd_pct /end REF_MEASUREMENT /end GROUP
/begin GROUP EC_Tests "ECONTROLS" ROOT
 /begin REF_MEASUREMENT TPS1_rawfilt TPS2_rawfilt FPP1_rawfilt FPP2_rawfilt TPS1_pct TPS2_pct FPP_cmd_pct TPS_cmd_pct IVS_volt flag2_IVS_AT_IDLE DBW_test_ena IAC_pwr_ena IAC_cmd_pct IAC_act_sgnpct /end REF_MEASUREMENT
/end GROUP
/begin GROUP EC_VECal "ECONTROLS" ROOT /begin REF_MEASUREMENT TPS_cmd_pct mdot_throttle_float /end REF_MEASUREMENT /end GROUP
/end MODULE
/end PROJECT
