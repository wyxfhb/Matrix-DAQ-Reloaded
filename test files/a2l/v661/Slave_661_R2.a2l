ASAP2_VERSION 1 61
/begin PROJECT Econtrols_4G "4G Test"
/begin HEADER "4G A2L Configuration" PROJECT_NO EControls4G /* config for version control */ VERSION "$Revision: 82130 $:" /* config for version control */ /end HEADER
/begin MODULE EControls_4G_SH2A "EControls 4G"
/begin MOD_COMMON "" DEPOSIT ABSOLUTE BYTE_ORDER MSB_FIRST /end MOD_COMMON
/* Define the Record Layouts */
/begin RECORD_LAYOUT ECIPP_ALIGNMENT_UBYTE FNC_VALUES 1 UBYTE COLUMN_DIR DIRECT /end RECORD_LAYOUT
/begin RECORD_LAYOUT ECIPP_ALIGNMENT_ULONG FNC_VALUES 1 ULONG COLUMN_DIR DIRECT /end RECORD_LAYOUT
/begin RECORD_LAYOUT ECIPP_Lookup_SLONG AXIS_PTS_X 1 SLONG INDEX_INCR DIRECT /end RECORD_LAYOUT
/begin COMPU_METHOD Compu_IDENTITY "Discrete Values " /* Identifier */ IDENTICAL "%.0" /* Format */ "-" /* Units */ /end COMPU_METHOD
/begin CHARACTERISTIC FCfmi_GLOW2_open "FCtl_FMI(484)" VALUE 0x001E5AE5 /* @ECU_Address@FCtl_FMI@0x021B71E4@ */ ECIPP_ALIGNMENT_UBYTE 255 Compu_IDENTITY 0 255 PHYS_UNIT "FMI" /end CHARACTERISTIC
/begin CHARACTERISTIC FCfmi_GLOW2_short "FCtl_FMI(494)" VALUE 0x001E5AEF /* @ECU_Address@FCtl_FMI@0x021B71EE@ */ ECIPP_ALIGNMENT_UBYTE 255 Compu_IDENTITY 0 255 PHYS_UNIT "FMI" /end CHARACTERISTIC
/begin CHARACTERISTIC FCfmi_GLOW3_open "FCtl_FMI(485)" VALUE 0x001E5AE6 /* @ECU_Address@FCtl_FMI@0x021B71E5@ */ ECIPP_ALIGNMENT_UBYTE 255 Compu_IDENTITY 0 255 PHYS_UNIT "FMI" /end CHARACTERISTIC
/begin CHARACTERISTIC FCfmi_GLOW3_short "FCtl_FMI(495)" VALUE 0x001E5AF0 /* @ECU_Address@FCtl_FMI@0x021B71EF@ */ ECIPP_ALIGNMENT_UBYTE 255 Compu_IDENTITY 0 255 PHYS_UNIT "FMI" /end CHARACTERISTIC
/begin CHARACTERISTIC FCfmi_GLOW4_open "FCtl_FMI(486)" VALUE 0x001E5AE7 /* @ECU_Address@FCtl_FMI@0x021B71E6@ */ ECIPP_ALIGNMENT_UBYTE 255 Compu_IDENTITY 0 255 PHYS_UNIT "FMI" /end CHARACTERISTIC
/begin CHARACTERISTIC FCfmi_GLOW4_short "FCtl_FMI(496)" VALUE 0x001E5AF1 /* @ECU_Address@FCtl_FMI@0x021B71F0@ */ ECIPP_ALIGNMENT_UBYTE 255 Compu_IDENTITY 0 255 PHYS_UNIT "FMI" /end CHARACTERISTIC
/begin CHARACTERISTIC FCfmi_GLOW5_open "FCtl_FMI(487)" VALUE 0x001E5AE8 /* @ECU_Address@FCtl_FMI@0x021B71E7@ */ ECIPP_ALIGNMENT_UBYTE 255 Compu_IDENTITY 0 255 PHYS_UNIT "FMI" /end CHARACTERISTIC
/begin CHARACTERISTIC FCfmi_GLOW5_short "FCtl_FMI(497)" VALUE 0x001E5AF2 /* @ECU_Address@FCtl_FMI@0x021B71F1@ */ ECIPP_ALIGNMENT_UBYTE 255 Compu_IDENTITY 0 255 PHYS_UNIT "FMI" /end CHARACTERISTIC
/begin CHARACTERISTIC FCfmi_GLOW6_open "FCtl_FMI(488)" VALUE 0x001E5AE9 /* @ECU_Address@FCtl_FMI@0x021B71E8@ */ ECIPP_ALIGNMENT_UBYTE 255 Compu_IDENTITY 0 255 PHYS_UNIT "FMI" /end CHARACTERISTIC
/begin CHARACTERISTIC FCfmi_GLOW6_short "FCtl_FMI(498)" VALUE 0x001E5AF3 /* @ECU_Address@FCtl_FMI@0x021B71F2@ */ ECIPP_ALIGNMENT_UBYTE 255 Compu_IDENTITY 0 255 PHYS_UNIT "FMI" /end CHARACTERISTIC
/begin CHARACTERISTIC FCfmi_GLOW7_open "FCtl_FMI(489)" VALUE 0x001E5AEA /* @ECU_Address@FCtl_FMI@0x021B71E9@ */ ECIPP_ALIGNMENT_UBYTE 255 Compu_IDENTITY 0 255 PHYS_UNIT "FMI" /end CHARACTERISTIC
/begin CHARACTERISTIC FCfmi_GLOW7_short "FCtl_FMI(499)" VALUE 0x001E5AF4 /* @ECU_Address@FCtl_FMI@0x021B71F3@ */ ECIPP_ALIGNMENT_UBYTE 255 Compu_IDENTITY 0 255 PHYS_UNIT "FMI" /end CHARACTERISTIC
/begin CHARACTERISTIC FCfmi_GLOW8_open "FCtl_FMI(490)" VALUE 0x001E5AEB /* @ECU_Address@FCtl_FMI@0x021B71EA@ */ ECIPP_ALIGNMENT_UBYTE 255 Compu_IDENTITY 0 255 PHYS_UNIT "FMI" /end CHARACTERISTIC
/begin CHARACTERISTIC FCfmi_GLOW8_short "FCtl_FMI(500)" VALUE 0x001E5AF5 /* @ECU_Address@FCtl_FMI@0x021B71F4@ */ ECIPP_ALIGNMENT_UBYTE 255 Compu_IDENTITY 0 255 PHYS_UNIT "FMI" /end CHARACTERISTIC
/begin CHARACTERISTIC FCfmi_GLOW9_open "FCtl_FMI(491)" VALUE 0x001E5AEC /* @ECU_Address@FCtl_FMI@0x021B71EB@ */ ECIPP_ALIGNMENT_UBYTE 255 Compu_IDENTITY 0 255 PHYS_UNIT "FMI" /end CHARACTERISTIC
/begin CHARACTERISTIC FCfmi_GLOW9_short "FCtl_FMI(501)" VALUE 0x001E5AF6 /* @ECU_Address@FCtl_FMI@0x021B71F5@ */ ECIPP_ALIGNMENT_UBYTE 255 Compu_IDENTITY 0 255 PHYS_UNIT "FMI" /end CHARACTERISTIC
/begin CHARACTERISTIC FCfmi_ICAVD10_mis "FCtl_FMI(315)" VALUE 0x001E5A3C /* @ECU_Address@FCtl_FMI@0x021B713B@ */ ECIPP_ALIGNMENT_UBYTE 255 Compu_IDENTITY 0 255 PHYS_UNIT "FMI" /end CHARACTERISTIC
/begin CHARACTERISTIC FCfmi_ICAVD10_miscat "FCtl_FMI(317)" VALUE 0x001E5A3E /* @ECU_Address@FCtl_FMI@0x021B713D@ */ ECIPP_ALIGNMENT_UBYTE 255 Compu_IDENTITY 0 255 PHYS_UNIT "FMI" /end CHARACTERISTIC
/begin CHARACTERISTIC FCfmi_ICAVD11_mis "FCtl_FMI(1029)" VALUE 0x001E5D06 /* @ECU_Address@FCtl_FMI@0x021B7405@ */ ECIPP_ALIGNMENT_UBYTE 255 Compu_IDENTITY 0 255 PHYS_UNIT "FMI" /end CHARACTERISTIC
/begin CHARACTERISTIC FCfmi_ICAVD11_miscat "FCtl_FMI(1031)" VALUE 0x001E5D08 /* @ECU_Address@FCtl_FMI@0x021B7407@ */ ECIPP_ALIGNMENT_UBYTE 255 Compu_IDENTITY 0 255 PHYS_UNIT "FMI" /end CHARACTERISTIC
/begin CHARACTERISTIC FCfmi_ICAVD12_mis "FCtl_FMI(1030)" VALUE 0x001E5D07 /* @ECU_Address@FCtl_FMI@0x021B7406@ */ ECIPP_ALIGNMENT_UBYTE 255 Compu_IDENTITY 0 255 PHYS_UNIT "FMI" /end CHARACTERISTIC
/begin CHARACTERISTIC FCfmi_ICAVD12_miscat "FCtl_FMI(1032)" VALUE 0x001E5D09 /* @ECU_Address@FCtl_FMI@0x021B7408@ */ ECIPP_ALIGNMENT_UBYTE 255 Compu_IDENTITY 0 255 PHYS_UNIT "FMI" /end CHARACTERISTIC
/begin CHARACTERISTIC FCfmi_ICAVD2_mis "FCtl_FMI(260)" VALUE 0x001E5A05 /* @ECU_Address@FCtl_FMI@0x021B7104@ */ ECIPP_ALIGNMENT_UBYTE 255 Compu_IDENTITY 0 255 PHYS_UNIT "FMI" /end CHARACTERISTIC
/begin CHARACTERISTIC FCfmi_ICAVD2_miscat "FCtl_FMI(268)" VALUE 0x001E5A0D /* @ECU_Address@FCtl_FMI@0x021B710C@ */ ECIPP_ALIGNMENT_UBYTE 255 Compu_IDENTITY 0 255 PHYS_UNIT "FMI" /end CHARACTERISTIC
/begin CHARACTERISTIC FCfmi_ICAVD3_mis "FCtl_FMI(261)" VALUE 0x001E5A06 /* @ECU_Address@FCtl_FMI@0x021B7105@ */ ECIPP_ALIGNMENT_UBYTE 255 Compu_IDENTITY 0 255 PHYS_UNIT "FMI" /end CHARACTERISTIC
/begin CHARACTERISTIC FCfmi_ICAVD3_miscat "FCtl_FMI(269)" VALUE 0x001E5A0E /* @ECU_Address@FCtl_FMI@0x021B710D@ */ ECIPP_ALIGNMENT_UBYTE 255 Compu_IDENTITY 0 255 PHYS_UNIT "FMI" /end CHARACTERISTIC
/begin CHARACTERISTIC FCfmi_ICAVD4_mis "FCtl_FMI(262)" VALUE 0x001E5A07 /* @ECU_Address@FCtl_FMI@0x021B7106@ */ ECIPP_ALIGNMENT_UBYTE 255 Compu_IDENTITY 0 255 PHYS_UNIT "FMI" /end CHARACTERISTIC
/begin CHARACTERISTIC FCfmi_ICAVD4_miscat "FCtl_FMI(270)" VALUE 0x001E5A0F /* @ECU_Address@FCtl_FMI@0x021B710E@ */ ECIPP_ALIGNMENT_UBYTE 255 Compu_IDENTITY 0 255 PHYS_UNIT "FMI" /end CHARACTERISTIC
/begin CHARACTERISTIC FCfmi_ICAVD5_mis "FCtl_FMI(263)" VALUE 0x001E5A08 /* @ECU_Address@FCtl_FMI@0x021B7107@ */ ECIPP_ALIGNMENT_UBYTE 255 Compu_IDENTITY 0 255 PHYS_UNIT "FMI" /end CHARACTERISTIC
/begin CHARACTERISTIC FCfmi_ICAVD5_miscat "FCtl_FMI(271)" VALUE 0x001E5A10 /* @ECU_Address@FCtl_FMI@0x021B710F@ */ ECIPP_ALIGNMENT_UBYTE 255 Compu_IDENTITY 0 255 PHYS_UNIT "FMI" /end CHARACTERISTIC
/begin CHARACTERISTIC FCfmi_ICAVD6_mis "FCtl_FMI(264)" VALUE 0x001E5A09 /* @ECU_Address@FCtl_FMI@0x021B7108@ */ ECIPP_ALIGNMENT_UBYTE 255 Compu_IDENTITY 0 255 PHYS_UNIT "FMI" /end CHARACTERISTIC
/begin CHARACTERISTIC FCfmi_ICAVD6_miscat "FCtl_FMI(272)" VALUE 0x001E5A11 /* @ECU_Address@FCtl_FMI@0x021B7110@ */ ECIPP_ALIGNMENT_UBYTE 255 Compu_IDENTITY 0 255 PHYS_UNIT "FMI" /end CHARACTERISTIC
/begin CHARACTERISTIC FCfmi_ICAVD7_mis "FCtl_FMI(265)" VALUE 0x001E5A0A /* @ECU_Address@FCtl_FMI@0x021B7109@ */ ECIPP_ALIGNMENT_UBYTE 255 Compu_IDENTITY 0 255 PHYS_UNIT "FMI" /end CHARACTERISTIC
/begin CHARACTERISTIC FCfmi_ICAVD7_miscat "FCtl_FMI(273)" VALUE 0x001E5A12 /* @ECU_Address@FCtl_FMI@0x021B7111@ */ ECIPP_ALIGNMENT_UBYTE 255 Compu_IDENTITY 0 255 PHYS_UNIT "FMI" /end CHARACTERISTIC
/begin CHARACTERISTIC FCfmi_ICAVD8_mis "FCtl_FMI(266)" VALUE 0x001E5A0B /* @ECU_Address@FCtl_FMI@0x021B710A@ */ ECIPP_ALIGNMENT_UBYTE 255 Compu_IDENTITY 0 255 PHYS_UNIT "FMI" /end CHARACTERISTIC
/begin CHARACTERISTIC FCfmi_ICAVD8_miscat "FCtl_FMI(274)" VALUE 0x001E5A13 /* @ECU_Address@FCtl_FMI@0x021B7112@ */ ECIPP_ALIGNMENT_UBYTE 255 Compu_IDENTITY 0 255 PHYS_UNIT "FMI" /end CHARACTERISTIC
/begin CHARACTERISTIC FCfmi_ICAVD9_mis "FCtl_FMI(314)" VALUE 0x001E5A3B /* @ECU_Address@FCtl_FMI@0x021B713A@ */ ECIPP_ALIGNMENT_UBYTE 255 Compu_IDENTITY 0 255 PHYS_UNIT "FMI" /end CHARACTERISTIC
/begin CHARACTERISTIC FCfmi_ICAVD9_miscat "FCtl_FMI(316)" VALUE 0x001E5A3D /* @ECU_Address@FCtl_FMI@0x021B713C@ */ ECIPP_ALIGNMENT_UBYTE 255 Compu_IDENTITY 0 255 PHYS_UNIT "FMI" /end CHARACTERISTIC
/begin CHARACTERISTIC FCfmi_INJD10_off_lo "FCtl_FMI(55)" VALUE 0x001E5938 /* @ECU_Address@FCtl_FMI@0x021B7037@ */ ECIPP_ALIGNMENT_UBYTE 255 Compu_IDENTITY 0 255 PHYS_UNIT "FMI" /end CHARACTERISTIC
/begin CHARACTERISTIC FCfmi_INJD10_on_hi "FCtl_FMI(65)" VALUE 0x001E5942 /* @ECU_Address@FCtl_FMI@0x021B7041@ */ ECIPP_ALIGNMENT_UBYTE 255 Compu_IDENTITY 0 255 PHYS_UNIT "FMI" /end CHARACTERISTIC
/begin CHARACTERISTIC FCfmi_INJD11_off_lo "FCtl_FMI(1017)" VALUE 0x001E5CFA /* @ECU_Address@FCtl_FMI@0x021B73F9@ */ ECIPP_ALIGNMENT_UBYTE 255 Compu_IDENTITY 0 255 PHYS_UNIT "FMI" /end CHARACTERISTIC
/begin CHARACTERISTIC FCfmi_INJD11_on_hi "FCtl_FMI(1019)" VALUE 0x001E5CFC /* @ECU_Address@FCtl_FMI@0x021B73FB@ */ ECIPP_ALIGNMENT_UBYTE 255 Compu_IDENTITY 0 255 PHYS_UNIT "FMI" /end CHARACTERISTIC
/begin CHARACTERISTIC FCfmi_INJD12_off_lo "FCtl_FMI(1018)" VALUE 0x001E5CFB /* @ECU_Address@FCtl_FMI@0x021B73FA@ */ ECIPP_ALIGNMENT_UBYTE 255 Compu_IDENTITY 0 255 PHYS_UNIT "FMI" /end CHARACTERISTIC
/begin CHARACTERISTIC FCfmi_INJD12_on_hi "FCtl_FMI(1020)" VALUE 0x001E5CFD /* @ECU_Address@FCtl_FMI@0x021B73FC@ */ ECIPP_ALIGNMENT_UBYTE 255 Compu_IDENTITY 0 255 PHYS_UNIT "FMI" /end CHARACTERISTIC
/begin CHARACTERISTIC FCfmi_INJD2_boost_lo "FCtl_FMI(579)" VALUE 0x001E5B44 /* @ECU_Address@FCtl_FMI@0x021B7243@ */ ECIPP_ALIGNMENT_UBYTE 255 Compu_IDENTITY 0 255 PHYS_UNIT "FMI" /end CHARACTERISTIC
/begin CHARACTERISTIC FCfmi_INJD2_HS_Ihi "FCtl_FMI(563)" VALUE 0x001E5B34 /* @ECU_Address@FCtl_FMI@0x021B7233@ */ ECIPP_ALIGNMENT_UBYTE 255 Compu_IDENTITY 0 255 PHYS_UNIT "FMI" /end CHARACTERISTIC
/begin CHARACTERISTIC FCfmi_INJD2_HW_int "FCtl_FMI(581)" VALUE 0x001E5B46 /* @ECU_Address@FCtl_FMI@0x021B7245@ */ ECIPP_ALIGNMENT_UBYTE 255 Compu_IDENTITY 0 255 PHYS_UNIT "FMI" /end CHARACTERISTIC
/begin CHARACTERISTIC FCfmi_INJD2_LS_Ihi "FCtl_FMI(571)" VALUE 0x001E5B3C /* @ECU_Address@FCtl_FMI@0x021B723B@ */ ECIPP_ALIGNMENT_UBYTE 255 Compu_IDENTITY 0 255 PHYS_UNIT "FMI" /end CHARACTERISTIC
/begin CHARACTERISTIC FCfmi_INJD2_off_lo "FCtl_FMI(47)" VALUE 0x001E5930 /* @ECU_Address@FCtl_FMI@0x021B702F@ */ ECIPP_ALIGNMENT_UBYTE 255 Compu_IDENTITY 0 255 PHYS_UNIT "FMI" /end CHARACTERISTIC
/begin CHARACTERISTIC FCfmi_INJD2_on_hi "FCtl_FMI(57)" VALUE 0x001E593A /* @ECU_Address@FCtl_FMI@0x021B7039@ */ ECIPP_ALIGNMENT_UBYTE 255 Compu_IDENTITY 0 255 PHYS_UNIT "FMI" /end CHARACTERISTIC
/begin CHARACTERISTIC FCfmi_INJD3_HS_Ihi "FCtl_FMI(564)" VALUE 0x001E5B35 /* @ECU_Address@FCtl_FMI@0x021B7234@ */ ECIPP_ALIGNMENT_UBYTE 255 Compu_IDENTITY 0 255 PHYS_UNIT "FMI" /end CHARACTERISTIC
/begin CHARACTERISTIC FCfmi_INJD3_LS_Ihi "FCtl_FMI(572)" VALUE 0x001E5B3D /* @ECU_Address@FCtl_FMI@0x021B723C@ */ ECIPP_ALIGNMENT_UBYTE 255 Compu_IDENTITY 0 255 PHYS_UNIT "FMI" /end CHARACTERISTIC
/begin CHARACTERISTIC FCfmi_INJD3_off_lo "FCtl_FMI(48)" VALUE 0x001E5931 /* @ECU_Address@FCtl_FMI@0x021B7030@ */ ECIPP_ALIGNMENT_UBYTE 255 Compu_IDENTITY 0 255 PHYS_UNIT "FMI" /end CHARACTERISTIC
/begin CHARACTERISTIC FCfmi_INJD3_on_hi "FCtl_FMI(58)" VALUE 0x001E593B /* @ECU_Address@FCtl_FMI@0x021B703A@ */ ECIPP_ALIGNMENT_UBYTE 255 Compu_IDENTITY 0 255 PHYS_UNIT "FMI" /end CHARACTERISTIC
/begin CHARACTERISTIC FCfmi_INJD4_HS_Ihi "FCtl_FMI(565)" VALUE 0x001E5B36 /* @ECU_Address@FCtl_FMI@0x021B7235@ */ ECIPP_ALIGNMENT_UBYTE 255 Compu_IDENTITY 0 255 PHYS_UNIT "FMI" /end CHARACTERISTIC
/begin CHARACTERISTIC FCfmi_INJD4_LS_Ihi "FCtl_FMI(573)" VALUE 0x001E5B3E /* @ECU_Address@FCtl_FMI@0x021B723D@ */ ECIPP_ALIGNMENT_UBYTE 255 Compu_IDENTITY 0 255 PHYS_UNIT "FMI" /end CHARACTERISTIC
/begin CHARACTERISTIC FCfmi_INJD4_off_lo "FCtl_FMI(49)" VALUE 0x001E5932 /* @ECU_Address@FCtl_FMI@0x021B7031@ */ ECIPP_ALIGNMENT_UBYTE 255 Compu_IDENTITY 0 255 PHYS_UNIT "FMI" /end CHARACTERISTIC
/begin CHARACTERISTIC FCfmi_INJD4_on_hi "FCtl_FMI(59)" VALUE 0x001E593C /* @ECU_Address@FCtl_FMI@0x021B703B@ */ ECIPP_ALIGNMENT_UBYTE 255 Compu_IDENTITY 0 255 PHYS_UNIT "FMI" /end CHARACTERISTIC
/begin CHARACTERISTIC FCfmi_INJD5_HS_Ihi "FCtl_FMI(566)" VALUE 0x001E5B37 /* @ECU_Address@FCtl_FMI@0x021B7236@ */ ECIPP_ALIGNMENT_UBYTE 255 Compu_IDENTITY 0 255 PHYS_UNIT "FMI" /end CHARACTERISTIC
/begin CHARACTERISTIC FCfmi_INJD5_LS_Ihi "FCtl_FMI(574)" VALUE 0x001E5B3F /* @ECU_Address@FCtl_FMI@0x021B723E@ */ ECIPP_ALIGNMENT_UBYTE 255 Compu_IDENTITY 0 255 PHYS_UNIT "FMI" /end CHARACTERISTIC
/begin CHARACTERISTIC FCfmi_INJD5_off_lo "FCtl_FMI(50)" VALUE 0x001E5933 /* @ECU_Address@FCtl_FMI@0x021B7032@ */ ECIPP_ALIGNMENT_UBYTE 255 Compu_IDENTITY 0 255 PHYS_UNIT "FMI" /end CHARACTERISTIC
/begin CHARACTERISTIC FCfmi_INJD5_on_hi "FCtl_FMI(60)" VALUE 0x001E593D /* @ECU_Address@FCtl_FMI@0x021B703C@ */ ECIPP_ALIGNMENT_UBYTE 255 Compu_IDENTITY 0 255 PHYS_UNIT "FMI" /end CHARACTERISTIC
/begin CHARACTERISTIC FCfmi_INJD6_HS_Ihi "FCtl_FMI(567)" VALUE 0x001E5B38 /* @ECU_Address@FCtl_FMI@0x021B7237@ */ ECIPP_ALIGNMENT_UBYTE 255 Compu_IDENTITY 0 255 PHYS_UNIT "FMI" /end CHARACTERISTIC
/begin CHARACTERISTIC FCfmi_INJD6_LS_Ihi "FCtl_FMI(575)" VALUE 0x001E5B40 /* @ECU_Address@FCtl_FMI@0x021B723F@ */ ECIPP_ALIGNMENT_UBYTE 255 Compu_IDENTITY 0 255 PHYS_UNIT "FMI" /end CHARACTERISTIC
/begin CHARACTERISTIC FCfmi_INJD6_off_lo "FCtl_FMI(51)" VALUE 0x001E5934 /* @ECU_Address@FCtl_FMI@0x021B7033@ */ ECIPP_ALIGNMENT_UBYTE 255 Compu_IDENTITY 0 255 PHYS_UNIT "FMI" /end CHARACTERISTIC
/begin CHARACTERISTIC FCfmi_INJD6_on_hi "FCtl_FMI(61)" VALUE 0x001E593E /* @ECU_Address@FCtl_FMI@0x021B703D@ */ ECIPP_ALIGNMENT_UBYTE 255 Compu_IDENTITY 0 255 PHYS_UNIT "FMI" /end CHARACTERISTIC
/begin CHARACTERISTIC FCfmi_INJD7_HS_Ihi "FCtl_FMI(568)" VALUE 0x001E5B39 /* @ECU_Address@FCtl_FMI@0x021B7238@ */ ECIPP_ALIGNMENT_UBYTE 255 Compu_IDENTITY 0 255 PHYS_UNIT "FMI" /end CHARACTERISTIC
/begin CHARACTERISTIC FCfmi_INJD7_LS_Ihi "FCtl_FMI(576)" VALUE 0x001E5B41 /* @ECU_Address@FCtl_FMI@0x021B7240@ */ ECIPP_ALIGNMENT_UBYTE 255 Compu_IDENTITY 0 255 PHYS_UNIT "FMI" /end CHARACTERISTIC
/begin CHARACTERISTIC FCfmi_INJD7_off_lo "FCtl_FMI(52)" VALUE 0x001E5935 /* @ECU_Address@FCtl_FMI@0x021B7034@ */ ECIPP_ALIGNMENT_UBYTE 255 Compu_IDENTITY 0 255 PHYS_UNIT "FMI" /end CHARACTERISTIC
/begin CHARACTERISTIC FCfmi_INJD7_on_hi "FCtl_FMI(62)" VALUE 0x001E593F /* @ECU_Address@FCtl_FMI@0x021B703E@ */ ECIPP_ALIGNMENT_UBYTE 255 Compu_IDENTITY 0 255 PHYS_UNIT "FMI" /end CHARACTERISTIC
/begin CHARACTERISTIC FCfmi_INJD8_HS_Ihi "FCtl_FMI(569)" VALUE 0x001E5B3A /* @ECU_Address@FCtl_FMI@0x021B7239@ */ ECIPP_ALIGNMENT_UBYTE 255 Compu_IDENTITY 0 255 PHYS_UNIT "FMI" /end CHARACTERISTIC
/begin CHARACTERISTIC FCfmi_INJD8_LS_Ihi "FCtl_FMI(577)" VALUE 0x001E5B42 /* @ECU_Address@FCtl_FMI@0x021B7241@ */ ECIPP_ALIGNMENT_UBYTE 255 Compu_IDENTITY 0 255 PHYS_UNIT "FMI" /end CHARACTERISTIC
/begin CHARACTERISTIC FCfmi_INJD8_off_lo "FCtl_FMI(53)" VALUE 0x001E5936 /* @ECU_Address@FCtl_FMI@0x021B7035@ */ ECIPP_ALIGNMENT_UBYTE 255 Compu_IDENTITY 0 255 PHYS_UNIT "FMI" /end CHARACTERISTIC
/begin CHARACTERISTIC FCfmi_INJD8_on_hi "FCtl_FMI(63)" VALUE 0x001E5940 /* @ECU_Address@FCtl_FMI@0x021B703F@ */ ECIPP_ALIGNMENT_UBYTE 255 Compu_IDENTITY 0 255 PHYS_UNIT "FMI" /end CHARACTERISTIC
/begin CHARACTERISTIC FCfmi_INJD9_off_lo "FCtl_FMI(54)" VALUE 0x001E5937 /* @ECU_Address@FCtl_FMI@0x021B7036@ */ ECIPP_ALIGNMENT_UBYTE 255 Compu_IDENTITY 0 255 PHYS_UNIT "FMI" /end CHARACTERISTIC
/begin CHARACTERISTIC FCfmi_INJD9_on_hi "FCtl_FMI(64)" VALUE 0x001E5941 /* @ECU_Address@FCtl_FMI@0x021B7040@ */ ECIPP_ALIGNMENT_UBYTE 255 Compu_IDENTITY 0 255 PHYS_UNIT "FMI" /end CHARACTERISTIC
/begin CHARACTERISTIC FCfmi_KNK10_max "FCtl_FMI(1012)" VALUE 0x001E5CF5 /* @ECU_Address@FCtl_FMI@0x021B73F4@ */ ECIPP_ALIGNMENT_UBYTE 255 Compu_IDENTITY 0 255 PHYS_UNIT "FMI" /end CHARACTERISTIC
/begin CHARACTERISTIC FCfmi_KNK10_min "FCtl_FMI(1003)" VALUE 0x001E5CEC /* @ECU_Address@FCtl_FMI@0x021B73EB@ */ ECIPP_ALIGNMENT_UBYTE 255 Compu_IDENTITY 0 255 PHYS_UNIT "FMI" /end CHARACTERISTIC
/begin CHARACTERISTIC FCfmi_KNK11_max "FCtl_FMI(1013)" VALUE 0x001E5CF6 /* @ECU_Address@FCtl_FMI@0x021B73F5@ */ ECIPP_ALIGNMENT_UBYTE 255 Compu_IDENTITY 0 255 PHYS_UNIT "FMI" /end CHARACTERISTIC
/begin CHARACTERISTIC FCfmi_KNK11_min "FCtl_FMI(1004)" VALUE 0x001E5CED /* @ECU_Address@FCtl_FMI@0x021B73EC@ */ ECIPP_ALIGNMENT_UBYTE 255 Compu_IDENTITY 0 255 PHYS_UNIT "FMI" /end CHARACTERISTIC
/begin CHARACTERISTIC FCfmi_KNK12_max "FCtl_FMI(1014)" VALUE 0x001E5CF7 /* @ECU_Address@FCtl_FMI@0x021B73F6@ */ ECIPP_ALIGNMENT_UBYTE 255 Compu_IDENTITY 0 255 PHYS_UNIT "FMI" /end CHARACTERISTIC
/begin CHARACTERISTIC FCfmi_KNK12_min "FCtl_FMI(1005)" VALUE 0x001E5CEE /* @ECU_Address@FCtl_FMI@0x021B73ED@ */ ECIPP_ALIGNMENT_UBYTE 255 Compu_IDENTITY 0 255 PHYS_UNIT "FMI" /end CHARACTERISTIC
/begin CHARACTERISTIC FCfmi_KNK2_max "FCtl_FMI(185)" VALUE 0x001E59BA /* @ECU_Address@FCtl_FMI@0x021B70B9@ */ ECIPP_ALIGNMENT_UBYTE 255 Compu_IDENTITY 0 255 PHYS_UNIT "FMI" /end CHARACTERISTIC
/begin CHARACTERISTIC FCfmi_KNK2_min "FCtl_FMI(184)" VALUE 0x001E59B9 /* @ECU_Address@FCtl_FMI@0x021B70B8@ */ ECIPP_ALIGNMENT_UBYTE 255 Compu_IDENTITY 0 255 PHYS_UNIT "FMI" /end CHARACTERISTIC
/begin CHARACTERISTIC FCfmi_KNK3_max "FCtl_FMI(806)" VALUE 0x001E5C27 /* @ECU_Address@FCtl_FMI@0x021B7326@ */ ECIPP_ALIGNMENT_UBYTE 255 Compu_IDENTITY 0 255 PHYS_UNIT "FMI" /end CHARACTERISTIC
/begin CHARACTERISTIC FCfmi_KNK3_min "FCtl_FMI(805)" VALUE 0x001E5C26 /* @ECU_Address@FCtl_FMI@0x021B7325@ */ ECIPP_ALIGNMENT_UBYTE 255 Compu_IDENTITY 0 255 PHYS_UNIT "FMI" /end CHARACTERISTIC
/begin CHARACTERISTIC FCfmi_KNK4_max "FCtl_FMI(1006)" VALUE 0x001E5CEF /* @ECU_Address@FCtl_FMI@0x021B73EE@ */ ECIPP_ALIGNMENT_UBYTE 255 Compu_IDENTITY 0 255 PHYS_UNIT "FMI" /end CHARACTERISTIC
/begin CHARACTERISTIC FCfmi_KNK4_min "FCtl_FMI(997)" VALUE 0x001E5CE6 /* @ECU_Address@FCtl_FMI@0x021B73E5@ */ ECIPP_ALIGNMENT_UBYTE 255 Compu_IDENTITY 0 255 PHYS_UNIT "FMI" /end CHARACTERISTIC
/begin CHARACTERISTIC FCfmi_KNK5_max "FCtl_FMI(1007)" VALUE 0x001E5CF0 /* @ECU_Address@FCtl_FMI@0x021B73EF@ */ ECIPP_ALIGNMENT_UBYTE 255 Compu_IDENTITY 0 255 PHYS_UNIT "FMI" /end CHARACTERISTIC
/begin CHARACTERISTIC FCfmi_KNK5_min "FCtl_FMI(998)" VALUE 0x001E5CE7 /* @ECU_Address@FCtl_FMI@0x021B73E6@ */ ECIPP_ALIGNMENT_UBYTE 255 Compu_IDENTITY 0 255 PHYS_UNIT "FMI" /end CHARACTERISTIC
/begin CHARACTERISTIC FCfmi_KNK6_max "FCtl_FMI(1008)" VALUE 0x001E5CF1 /* @ECU_Address@FCtl_FMI@0x021B73F0@ */ ECIPP_ALIGNMENT_UBYTE 255 Compu_IDENTITY 0 255 PHYS_UNIT "FMI" /end CHARACTERISTIC
/begin CHARACTERISTIC FCfmi_KNK6_min "FCtl_FMI(999)" VALUE 0x001E5CE8 /* @ECU_Address@FCtl_FMI@0x021B73E7@ */ ECIPP_ALIGNMENT_UBYTE 255 Compu_IDENTITY 0 255 PHYS_UNIT "FMI" /end CHARACTERISTIC
/begin CHARACTERISTIC FCfmi_KNK7_max "FCtl_FMI(1009)" VALUE 0x001E5CF2 /* @ECU_Address@FCtl_FMI@0x021B73F1@ */ ECIPP_ALIGNMENT_UBYTE 255 Compu_IDENTITY 0 255 PHYS_UNIT "FMI" /end CHARACTERISTIC
/begin CHARACTERISTIC FCfmi_KNK7_min "FCtl_FMI(1000)" VALUE 0x001E5CE9 /* @ECU_Address@FCtl_FMI@0x021B73E8@ */ ECIPP_ALIGNMENT_UBYTE 255 Compu_IDENTITY 0 255 PHYS_UNIT "FMI" /end CHARACTERISTIC
/begin CHARACTERISTIC FCfmi_KNK8_max "FCtl_FMI(1010)" VALUE 0x001E5CF3 /* @ECU_Address@FCtl_FMI@0x021B73F2@ */ ECIPP_ALIGNMENT_UBYTE 255 Compu_IDENTITY 0 255 PHYS_UNIT "FMI" /end CHARACTERISTIC
/begin CHARACTERISTIC FCfmi_KNK8_min "FCtl_FMI(1001)" VALUE 0x001E5CEA /* @ECU_Address@FCtl_FMI@0x021B73E9@ */ ECIPP_ALIGNMENT_UBYTE 255 Compu_IDENTITY 0 255 PHYS_UNIT "FMI" /end CHARACTERISTIC
/begin CHARACTERISTIC FCfmi_KNK9_max "FCtl_FMI(1011)" VALUE 0x001E5CF4 /* @ECU_Address@FCtl_FMI@0x021B73F3@ */ ECIPP_ALIGNMENT_UBYTE 255 Compu_IDENTITY 0 255 PHYS_UNIT "FMI" /end CHARACTERISTIC
/begin CHARACTERISTIC FCfmi_KNK9_min "FCtl_FMI(1002)" VALUE 0x001E5CEB /* @ECU_Address@FCtl_FMI@0x021B73EA@ */ ECIPP_ALIGNMENT_UBYTE 255 Compu_IDENTITY 0 255 PHYS_UNIT "FMI" /end CHARACTERISTIC
/begin CHARACTERISTIC FCfmi_KV10_deltaHi "FCtl_FMI(970)" VALUE 0x001E5CCB /* @ECU_Address@FCtl_FMI@0x021B73CA@ */ ECIPP_ALIGNMENT_UBYTE 255 Compu_IDENTITY 0 255 PHYS_UNIT "FMI" /end CHARACTERISTIC
/begin CHARACTERISTIC FCfmi_KV10_deltaLo "FCtl_FMI(982)" VALUE 0x001E5CD7 /* @ECU_Address@FCtl_FMI@0x021B73D6@ */ ECIPP_ALIGNMENT_UBYTE 255 Compu_IDENTITY 0 255 PHYS_UNIT "FMI" /end CHARACTERISTIC
/begin CHARACTERISTIC FCfmi_KV10_high "FCtl_FMI(886)" VALUE 0x001E5C77 /* @ECU_Address@FCtl_FMI@0x021B7376@ */ ECIPP_ALIGNMENT_UBYTE 255 Compu_IDENTITY 0 255 PHYS_UNIT "FMI" /end CHARACTERISTIC
/begin CHARACTERISTIC FCfmi_KV10_low "FCtl_FMI(898)" VALUE 0x001E5C83 /* @ECU_Address@FCtl_FMI@0x021B7382@ */ ECIPP_ALIGNMENT_UBYTE 255 Compu_IDENTITY 0 255 PHYS_UNIT "FMI" /end CHARACTERISTIC
/begin CHARACTERISTIC FCfmi_KV11_deltaHi "FCtl_FMI(971)" VALUE 0x001E5CCC /* @ECU_Address@FCtl_FMI@0x021B73CB@ */ ECIPP_ALIGNMENT_UBYTE 255 Compu_IDENTITY 0 255 PHYS_UNIT "FMI" /end CHARACTERISTIC
/begin CHARACTERISTIC FCfmi_KV11_deltaLo "FCtl_FMI(983)" VALUE 0x001E5CD8 /* @ECU_Address@FCtl_FMI@0x021B73D7@ */ ECIPP_ALIGNMENT_UBYTE 255 Compu_IDENTITY 0 255 PHYS_UNIT "FMI" /end CHARACTERISTIC
/begin CHARACTERISTIC FCfmi_KV11_high "FCtl_FMI(887)" VALUE 0x001E5C78 /* @ECU_Address@FCtl_FMI@0x021B7377@ */ ECIPP_ALIGNMENT_UBYTE 255 Compu_IDENTITY 0 255 PHYS_UNIT "FMI" /end CHARACTERISTIC
/begin CHARACTERISTIC FCfmi_KV11_low "FCtl_FMI(899)" VALUE 0x001E5C84 /* @ECU_Address@FCtl_FMI@0x021B7383@ */ ECIPP_ALIGNMENT_UBYTE 255 Compu_IDENTITY 0 255 PHYS_UNIT "FMI" /end CHARACTERISTIC
/begin CHARACTERISTIC FCfmi_KV12_deltaHi "FCtl_FMI(972)" VALUE 0x001E5CCD /* @ECU_Address@FCtl_FMI@0x021B73CC@ */ ECIPP_ALIGNMENT_UBYTE 255 Compu_IDENTITY 0 255 PHYS_UNIT "FMI" /end CHARACTERISTIC
/begin CHARACTERISTIC FCfmi_KV12_deltaLo "FCtl_FMI(984)" VALUE 0x001E5CD9 /* @ECU_Address@FCtl_FMI@0x021B73D8@ */ ECIPP_ALIGNMENT_UBYTE 255 Compu_IDENTITY 0 255 PHYS_UNIT "FMI" /end CHARACTERISTIC
/begin CHARACTERISTIC FCfmi_KV12_high "FCtl_FMI(888)" VALUE 0x001E5C79 /* @ECU_Address@FCtl_FMI@0x021B7378@ */ ECIPP_ALIGNMENT_UBYTE 255 Compu_IDENTITY 0 255 PHYS_UNIT "FMI" /end CHARACTERISTIC
/begin CHARACTERISTIC FCfmi_KV12_low "FCtl_FMI(900)" VALUE 0x001E5C85 /* @ECU_Address@FCtl_FMI@0x021B7384@ */ ECIPP_ALIGNMENT_UBYTE 255 Compu_IDENTITY 0 255 PHYS_UNIT "FMI" /end CHARACTERISTIC
/begin CHARACTERISTIC FCfmi_KV2_deltaHi "FCtl_FMI(962)" VALUE 0x001E5CC3 /* @ECU_Address@FCtl_FMI@0x021B73C2@ */ ECIPP_ALIGNMENT_UBYTE 255 Compu_IDENTITY 0 255 PHYS_UNIT "FMI" /end CHARACTERISTIC
/begin CHARACTERISTIC FCfmi_KV2_deltaLo "FCtl_FMI(974)" VALUE 0x001E5CCF /* @ECU_Address@FCtl_FMI@0x021B73CE@ */ ECIPP_ALIGNMENT_UBYTE 255 Compu_IDENTITY 0 255 PHYS_UNIT "FMI" /end CHARACTERISTIC
/begin CHARACTERISTIC FCfmi_KV2_high "FCtl_FMI(878)" VALUE 0x001E5C6F /* @ECU_Address@FCtl_FMI@0x021B736E@ */ ECIPP_ALIGNMENT_UBYTE 255 Compu_IDENTITY 0 255 PHYS_UNIT "FMI" /end CHARACTERISTIC
/begin CHARACTERISTIC FCfmi_KV2_low "FCtl_FMI(890)" VALUE 0x001E5C7B /* @ECU_Address@FCtl_FMI@0x021B737A@ */ ECIPP_ALIGNMENT_UBYTE 255 Compu_IDENTITY 0 255 PHYS_UNIT "FMI" /end CHARACTERISTIC
/begin CHARACTERISTIC FCfmi_KV3_deltaHi "FCtl_FMI(963)" VALUE 0x001E5CC4 /* @ECU_Address@FCtl_FMI@0x021B73C3@ */ ECIPP_ALIGNMENT_UBYTE 255 Compu_IDENTITY 0 255 PHYS_UNIT "FMI" /end CHARACTERISTIC
/begin CHARACTERISTIC FCfmi_KV3_deltaLo "FCtl_FMI(975)" VALUE 0x001E5CD0 /* @ECU_Address@FCtl_FMI@0x021B73CF@ */ ECIPP_ALIGNMENT_UBYTE 255 Compu_IDENTITY 0 255 PHYS_UNIT "FMI" /end CHARACTERISTIC
/begin CHARACTERISTIC FCfmi_KV3_high "FCtl_FMI(879)" VALUE 0x001E5C70 /* @ECU_Address@FCtl_FMI@0x021B736F@ */ ECIPP_ALIGNMENT_UBYTE 255 Compu_IDENTITY 0 255 PHYS_UNIT "FMI" /end CHARACTERISTIC
/begin CHARACTERISTIC FCfmi_KV3_low "FCtl_FMI(891)" VALUE 0x001E5C7C /* @ECU_Address@FCtl_FMI@0x021B737B@ */ ECIPP_ALIGNMENT_UBYTE 255 Compu_IDENTITY 0 255 PHYS_UNIT "FMI" /end CHARACTERISTIC
/begin CHARACTERISTIC FCfmi_KV4_deltaHi "FCtl_FMI(964)" VALUE 0x001E5CC5 /* @ECU_Address@FCtl_FMI@0x021B73C4@ */ ECIPP_ALIGNMENT_UBYTE 255 Compu_IDENTITY 0 255 PHYS_UNIT "FMI" /end CHARACTERISTIC
/begin CHARACTERISTIC FCfmi_KV4_deltaLo "FCtl_FMI(976)" VALUE 0x001E5CD1 /* @ECU_Address@FCtl_FMI@0x021B73D0@ */ ECIPP_ALIGNMENT_UBYTE 255 Compu_IDENTITY 0 255 PHYS_UNIT "FMI" /end CHARACTERISTIC
/begin CHARACTERISTIC FCfmi_KV4_high "FCtl_FMI(880)" VALUE 0x001E5C71 /* @ECU_Address@FCtl_FMI@0x021B7370@ */ ECIPP_ALIGNMENT_UBYTE 255 Compu_IDENTITY 0 255 PHYS_UNIT "FMI" /end CHARACTERISTIC
/begin CHARACTERISTIC FCfmi_KV4_low "FCtl_FMI(892)" VALUE 0x001E5C7D /* @ECU_Address@FCtl_FMI@0x021B737C@ */ ECIPP_ALIGNMENT_UBYTE 255 Compu_IDENTITY 0 255 PHYS_UNIT "FMI" /end CHARACTERISTIC
/begin CHARACTERISTIC FCfmi_KV5_deltaHi "FCtl_FMI(965)" VALUE 0x001E5CC6 /* @ECU_Address@FCtl_FMI@0x021B73C5@ */ ECIPP_ALIGNMENT_UBYTE 255 Compu_IDENTITY 0 255 PHYS_UNIT "FMI" /end CHARACTERISTIC
/begin CHARACTERISTIC FCfmi_KV5_deltaLo "FCtl_FMI(977)" VALUE 0x001E5CD2 /* @ECU_Address@FCtl_FMI@0x021B73D1@ */ ECIPP_ALIGNMENT_UBYTE 255 Compu_IDENTITY 0 255 PHYS_UNIT "FMI" /end CHARACTERISTIC
/begin CHARACTERISTIC FCfmi_KV5_high "FCtl_FMI(881)" VALUE 0x001E5C72 /* @ECU_Address@FCtl_FMI@0x021B7371@ */ ECIPP_ALIGNMENT_UBYTE 255 Compu_IDENTITY 0 255 PHYS_UNIT "FMI" /end CHARACTERISTIC
/begin CHARACTERISTIC FCfmi_KV5_low "FCtl_FMI(893)" VALUE 0x001E5C7E /* @ECU_Address@FCtl_FMI@0x021B737D@ */ ECIPP_ALIGNMENT_UBYTE 255 Compu_IDENTITY 0 255 PHYS_UNIT "FMI" /end CHARACTERISTIC
/begin CHARACTERISTIC FCfmi_KV6_deltaHi "FCtl_FMI(966)" VALUE 0x001E5CC7 /* @ECU_Address@FCtl_FMI@0x021B73C6@ */ ECIPP_ALIGNMENT_UBYTE 255 Compu_IDENTITY 0 255 PHYS_UNIT "FMI" /end CHARACTERISTIC
/begin CHARACTERISTIC FCfmi_KV6_deltaLo "FCtl_FMI(978)" VALUE 0x001E5CD3 /* @ECU_Address@FCtl_FMI@0x021B73D2@ */ ECIPP_ALIGNMENT_UBYTE 255 Compu_IDENTITY 0 255 PHYS_UNIT "FMI" /end CHARACTERISTIC
/begin CHARACTERISTIC FCfmi_KV6_high "FCtl_FMI(882)" VALUE 0x001E5C73 /* @ECU_Address@FCtl_FMI@0x021B7372@ */ ECIPP_ALIGNMENT_UBYTE 255 Compu_IDENTITY 0 255 PHYS_UNIT "FMI" /end CHARACTERISTIC
/begin CHARACTERISTIC FCfmi_KV6_low "FCtl_FMI(894)" VALUE 0x001E5C7F /* @ECU_Address@FCtl_FMI@0x021B737E@ */ ECIPP_ALIGNMENT_UBYTE 255 Compu_IDENTITY 0 255 PHYS_UNIT "FMI" /end CHARACTERISTIC
/begin CHARACTERISTIC FCfmi_KV7_deltaHi "FCtl_FMI(967)" VALUE 0x001E5CC8 /* @ECU_Address@FCtl_FMI@0x021B73C7@ */ ECIPP_ALIGNMENT_UBYTE 255 Compu_IDENTITY 0 255 PHYS_UNIT "FMI" /end CHARACTERISTIC
/begin CHARACTERISTIC FCfmi_KV7_deltaLo "FCtl_FMI(979)" VALUE 0x001E5CD4 /* @ECU_Address@FCtl_FMI@0x021B73D3@ */ ECIPP_ALIGNMENT_UBYTE 255 Compu_IDENTITY 0 255 PHYS_UNIT "FMI" /end CHARACTERISTIC
/begin CHARACTERISTIC FCfmi_KV7_high "FCtl_FMI(883)" VALUE 0x001E5C74 /* @ECU_Address@FCtl_FMI@0x021B7373@ */ ECIPP_ALIGNMENT_UBYTE 255 Compu_IDENTITY 0 255 PHYS_UNIT "FMI" /end CHARACTERISTIC
/begin CHARACTERISTIC FCfmi_KV7_low "FCtl_FMI(895)" VALUE 0x001E5C80 /* @ECU_Address@FCtl_FMI@0x021B737F@ */ ECIPP_ALIGNMENT_UBYTE 255 Compu_IDENTITY 0 255 PHYS_UNIT "FMI" /end CHARACTERISTIC
/begin CHARACTERISTIC FCfmi_KV8_deltaHi "FCtl_FMI(968)" VALUE 0x001E5CC9 /* @ECU_Address@FCtl_FMI@0x021B73C8@ */ ECIPP_ALIGNMENT_UBYTE 255 Compu_IDENTITY 0 255 PHYS_UNIT "FMI" /end CHARACTERISTIC
/begin CHARACTERISTIC FCfmi_KV8_deltaLo "FCtl_FMI(980)" VALUE 0x001E5CD5 /* @ECU_Address@FCtl_FMI@0x021B73D4@ */ ECIPP_ALIGNMENT_UBYTE 255 Compu_IDENTITY 0 255 PHYS_UNIT "FMI" /end CHARACTERISTIC
/begin CHARACTERISTIC FCfmi_KV8_high "FCtl_FMI(884)" VALUE 0x001E5C75 /* @ECU_Address@FCtl_FMI@0x021B7374@ */ ECIPP_ALIGNMENT_UBYTE 255 Compu_IDENTITY 0 255 PHYS_UNIT "FMI" /end CHARACTERISTIC
/begin CHARACTERISTIC FCfmi_KV8_low "FCtl_FMI(896)" VALUE 0x001E5C81 /* @ECU_Address@FCtl_FMI@0x021B7380@ */ ECIPP_ALIGNMENT_UBYTE 255 Compu_IDENTITY 0 255 PHYS_UNIT "FMI" /end CHARACTERISTIC
/begin CHARACTERISTIC FCfmi_KV9_deltaHi "FCtl_FMI(969)" VALUE 0x001E5CCA /* @ECU_Address@FCtl_FMI@0x021B73C9@ */ ECIPP_ALIGNMENT_UBYTE 255 Compu_IDENTITY 0 255 PHYS_UNIT "FMI" /end CHARACTERISTIC
/begin CHARACTERISTIC FCfmi_KV9_deltaLo "FCtl_FMI(981)" VALUE 0x001E5CD6 /* @ECU_Address@FCtl_FMI@0x021B73D5@ */ ECIPP_ALIGNMENT_UBYTE 255 Compu_IDENTITY 0 255 PHYS_UNIT "FMI" /end CHARACTERISTIC
/begin CHARACTERISTIC FCfmi_KV9_high "FCtl_FMI(885)" VALUE 0x001E5C76 /* @ECU_Address@FCtl_FMI@0x021B7375@ */ ECIPP_ALIGNMENT_UBYTE 255 Compu_IDENTITY 0 255 PHYS_UNIT "FMI" /end CHARACTERISTIC
/begin CHARACTERISTIC FCfmi_KV9_low "FCtl_FMI(897)" VALUE 0x001E5C82 /* @ECU_Address@FCtl_FMI@0x021B7381@ */ ECIPP_ALIGNMENT_UBYTE 255 Compu_IDENTITY 0 255 PHYS_UNIT "FMI" /end CHARACTERISTIC
/begin CHARACTERISTIC FCfmi_Pri10_open "FCtl_FMI(910)" VALUE 0x001E5C8F /* @ECU_Address@FCtl_FMI@0x021B738E@ */ ECIPP_ALIGNMENT_UBYTE 255 Compu_IDENTITY 0 255 PHYS_UNIT "FMI" /end CHARACTERISTIC
/begin CHARACTERISTIC FCfmi_Pri10_short "FCtl_FMI(922)" VALUE 0x001E5C9B /* @ECU_Address@FCtl_FMI@0x021B739A@ */ ECIPP_ALIGNMENT_UBYTE 255 Compu_IDENTITY 0 255 PHYS_UNIT "FMI" /end CHARACTERISTIC
/begin CHARACTERISTIC FCfmi_Pri11_open "FCtl_FMI(911)" VALUE 0x001E5C90 /* @ECU_Address@FCtl_FMI@0x021B738F@ */ ECIPP_ALIGNMENT_UBYTE 255 Compu_IDENTITY 0 255 PHYS_UNIT "FMI" /end CHARACTERISTIC
/begin CHARACTERISTIC FCfmi_Pri11_short "FCtl_FMI(923)" VALUE 0x001E5C9C /* @ECU_Address@FCtl_FMI@0x021B739B@ */ ECIPP_ALIGNMENT_UBYTE 255 Compu_IDENTITY 0 255 PHYS_UNIT "FMI" /end CHARACTERISTIC
/begin CHARACTERISTIC FCfmi_Pri12_open "FCtl_FMI(912)" VALUE 0x001E5C91 /* @ECU_Address@FCtl_FMI@0x021B7390@ */ ECIPP_ALIGNMENT_UBYTE 255 Compu_IDENTITY 0 255 PHYS_UNIT "FMI" /end CHARACTERISTIC
/begin CHARACTERISTIC FCfmi_Pri12_short "FCtl_FMI(924)" VALUE 0x001E5C9D /* @ECU_Address@FCtl_FMI@0x021B739C@ */ ECIPP_ALIGNMENT_UBYTE 255 Compu_IDENTITY 0 255 PHYS_UNIT "FMI" /end CHARACTERISTIC
/begin CHARACTERISTIC FCfmi_Pri2_open "FCtl_FMI(902)" VALUE 0x001E5C87 /* @ECU_Address@FCtl_FMI@0x021B7386@ */ ECIPP_ALIGNMENT_UBYTE 255 Compu_IDENTITY 0 255 PHYS_UNIT "FMI" /end CHARACTERISTIC
/begin CHARACTERISTIC FCfmi_Pri2_short "FCtl_FMI(914)" VALUE 0x001E5C93 /* @ECU_Address@FCtl_FMI@0x021B7392@ */ ECIPP_ALIGNMENT_UBYTE 255 Compu_IDENTITY 0 255 PHYS_UNIT "FMI" /end CHARACTERISTIC
/begin CHARACTERISTIC FCfmi_Pri3_open "FCtl_FMI(903)" VALUE 0x001E5C88 /* @ECU_Address@FCtl_FMI@0x021B7387@ */ ECIPP_ALIGNMENT_UBYTE 255 Compu_IDENTITY 0 255 PHYS_UNIT "FMI" /end CHARACTERISTIC
/begin CHARACTERISTIC FCfmi_Pri3_short "FCtl_FMI(915)" VALUE 0x001E5C94 /* @ECU_Address@FCtl_FMI@0x021B7393@ */ ECIPP_ALIGNMENT_UBYTE 255 Compu_IDENTITY 0 255 PHYS_UNIT "FMI" /end CHARACTERISTIC
/begin CHARACTERISTIC FCfmi_Pri4_open "FCtl_FMI(904)" VALUE 0x001E5C89 /* @ECU_Address@FCtl_FMI@0x021B7388@ */ ECIPP_ALIGNMENT_UBYTE 255 Compu_IDENTITY 0 255 PHYS_UNIT "FMI" /end CHARACTERISTIC
/begin CHARACTERISTIC FCfmi_Pri4_short "FCtl_FMI(916)" VALUE 0x001E5C95 /* @ECU_Address@FCtl_FMI@0x021B7394@ */ ECIPP_ALIGNMENT_UBYTE 255 Compu_IDENTITY 0 255 PHYS_UNIT "FMI" /end CHARACTERISTIC
/begin CHARACTERISTIC FCfmi_Pri5_open "FCtl_FMI(905)" VALUE 0x001E5C8A /* @ECU_Address@FCtl_FMI@0x021B7389@ */ ECIPP_ALIGNMENT_UBYTE 255 Compu_IDENTITY 0 255 PHYS_UNIT "FMI" /end CHARACTERISTIC
/begin CHARACTERISTIC FCfmi_Pri5_short "FCtl_FMI(917)" VALUE 0x001E5C96 /* @ECU_Address@FCtl_FMI@0x021B7395@ */ ECIPP_ALIGNMENT_UBYTE 255 Compu_IDENTITY 0 255 PHYS_UNIT "FMI" /end CHARACTERISTIC
/begin CHARACTERISTIC FCfmi_Pri6_open "FCtl_FMI(906)" VALUE 0x001E5C8B /* @ECU_Address@FCtl_FMI@0x021B738A@ */ ECIPP_ALIGNMENT_UBYTE 255 Compu_IDENTITY 0 255 PHYS_UNIT "FMI" /end CHARACTERISTIC
/begin CHARACTERISTIC FCfmi_Pri6_short "FCtl_FMI(918)" VALUE 0x001E5C97 /* @ECU_Address@FCtl_FMI@0x021B7396@ */ ECIPP_ALIGNMENT_UBYTE 255 Compu_IDENTITY 0 255 PHYS_UNIT "FMI" /end CHARACTERISTIC
/begin CHARACTERISTIC FCfmi_Pri7_open "FCtl_FMI(907)" VALUE 0x001E5C8C /* @ECU_Address@FCtl_FMI@0x021B738B@ */ ECIPP_ALIGNMENT_UBYTE 255 Compu_IDENTITY 0 255 PHYS_UNIT "FMI" /end CHARACTERISTIC
/begin CHARACTERISTIC FCfmi_Pri7_short "FCtl_FMI(919)" VALUE 0x001E5C98 /* @ECU_Address@FCtl_FMI@0x021B7397@ */ ECIPP_ALIGNMENT_UBYTE 255 Compu_IDENTITY 0 255 PHYS_UNIT "FMI" /end CHARACTERISTIC
/begin CHARACTERISTIC FCfmi_Pri8_open "FCtl_FMI(908)" VALUE 0x001E5C8D /* @ECU_Address@FCtl_FMI@0x021B738C@ */ ECIPP_ALIGNMENT_UBYTE 255 Compu_IDENTITY 0 255 PHYS_UNIT "FMI" /end CHARACTERISTIC
/begin CHARACTERISTIC FCfmi_Pri8_short "FCtl_FMI(920)" VALUE 0x001E5C99 /* @ECU_Address@FCtl_FMI@0x021B7398@ */ ECIPP_ALIGNMENT_UBYTE 255 Compu_IDENTITY 0 255 PHYS_UNIT "FMI" /end CHARACTERISTIC
/begin CHARACTERISTIC FCfmi_Pri9_open "FCtl_FMI(909)" VALUE 0x001E5C8E /* @ECU_Address@FCtl_FMI@0x021B738D@ */ ECIPP_ALIGNMENT_UBYTE 255 Compu_IDENTITY 0 255 PHYS_UNIT "FMI" /end CHARACTERISTIC
/begin CHARACTERISTIC FCfmi_Pri9_short "FCtl_FMI(921)" VALUE 0x001E5C9A /* @ECU_Address@FCtl_FMI@0x021B7399@ */ ECIPP_ALIGNMENT_UBYTE 255 Compu_IDENTITY 0 255 PHYS_UNIT "FMI" /end CHARACTERISTIC
/begin CHARACTERISTIC FCfmi_Sec10_31KV_open "FCtl_FMI(958)" VALUE 0x001E5CBF /* @ECU_Address@FCtl_FMI@0x021B73BE@ */ ECIPP_ALIGNMENT_UBYTE 255 Compu_IDENTITY 0 255 PHYS_UNIT "FMI" /end CHARACTERISTIC
/begin CHARACTERISTIC FCfmi_Sec10_low "FCtl_FMI(946)" VALUE 0x001E5CB3 /* @ECU_Address@FCtl_FMI@0x021B73B2@ */ ECIPP_ALIGNMENT_UBYTE 255 Compu_IDENTITY 0 255 PHYS_UNIT "FMI" /end CHARACTERISTIC
/begin CHARACTERISTIC FCfmi_Sec10_open "FCtl_FMI(934)" VALUE 0x001E5CA7 /* @ECU_Address@FCtl_FMI@0x021B73A6@ */ ECIPP_ALIGNMENT_UBYTE 255 Compu_IDENTITY 0 255 PHYS_UNIT "FMI" /end CHARACTERISTIC
/begin CHARACTERISTIC FCfmi_Sec11_31KV_open "FCtl_FMI(959)" VALUE 0x001E5CC0 /* @ECU_Address@FCtl_FMI@0x021B73BF@ */ ECIPP_ALIGNMENT_UBYTE 255 Compu_IDENTITY 0 255 PHYS_UNIT "FMI" /end CHARACTERISTIC
/begin CHARACTERISTIC FCfmi_Sec11_low "FCtl_FMI(947)" VALUE 0x001E5CB4 /* @ECU_Address@FCtl_FMI@0x021B73B3@ */ ECIPP_ALIGNMENT_UBYTE 255 Compu_IDENTITY 0 255 PHYS_UNIT "FMI" /end CHARACTERISTIC
/begin CHARACTERISTIC FCfmi_Sec11_open "FCtl_FMI(935)" VALUE 0x001E5CA8 /* @ECU_Address@FCtl_FMI@0x021B73A7@ */ ECIPP_ALIGNMENT_UBYTE 255 Compu_IDENTITY 0 255 PHYS_UNIT "FMI" /end CHARACTERISTIC
/begin CHARACTERISTIC FCfmi_Sec12_31KV_open "FCtl_FMI(960)" VALUE 0x001E5CC1 /* @ECU_Address@FCtl_FMI@0x021B73C0@ */ ECIPP_ALIGNMENT_UBYTE 255 Compu_IDENTITY 0 255 PHYS_UNIT "FMI" /end CHARACTERISTIC
/begin CHARACTERISTIC FCfmi_Sec12_low "FCtl_FMI(948)" VALUE 0x001E5CB5 /* @ECU_Address@FCtl_FMI@0x021B73B4@ */ ECIPP_ALIGNMENT_UBYTE 255 Compu_IDENTITY 0 255 PHYS_UNIT "FMI" /end CHARACTERISTIC
/begin CHARACTERISTIC FCfmi_Sec12_open "FCtl_FMI(936)" VALUE 0x001E5CA9 /* @ECU_Address@FCtl_FMI@0x021B73A8@ */ ECIPP_ALIGNMENT_UBYTE 255 Compu_IDENTITY 0 255 PHYS_UNIT "FMI" /end CHARACTERISTIC
/begin CHARACTERISTIC FCfmi_Sec2_31KV_open "FCtl_FMI(950)" VALUE 0x001E5CB7 /* @ECU_Address@FCtl_FMI@0x021B73B6@ */ ECIPP_ALIGNMENT_UBYTE 255 Compu_IDENTITY 0 255 PHYS_UNIT "FMI" /end CHARACTERISTIC
/begin CHARACTERISTIC FCfmi_Sec2_low "FCtl_FMI(938)" VALUE 0x001E5CAB /* @ECU_Address@FCtl_FMI@0x021B73AA@ */ ECIPP_ALIGNMENT_UBYTE 255 Compu_IDENTITY 0 255 PHYS_UNIT "FMI" /end CHARACTERISTIC
/begin CHARACTERISTIC FCfmi_Sec2_open "FCtl_FMI(926)" VALUE 0x001E5C9F /* @ECU_Address@FCtl_FMI@0x021B739E@ */ ECIPP_ALIGNMENT_UBYTE 255 Compu_IDENTITY 0 255 PHYS_UNIT "FMI" /end CHARACTERISTIC
/begin CHARACTERISTIC FCfmi_Sec3_31KV_open "FCtl_FMI(951)" VALUE 0x001E5CB8 /* @ECU_Address@FCtl_FMI@0x021B73B7@ */ ECIPP_ALIGNMENT_UBYTE 255 Compu_IDENTITY 0 255 PHYS_UNIT "FMI" /end CHARACTERISTIC
/begin CHARACTERISTIC FCfmi_Sec3_low "FCtl_FMI(939)" VALUE 0x001E5CAC /* @ECU_Address@FCtl_FMI@0x021B73AB@ */ ECIPP_ALIGNMENT_UBYTE 255 Compu_IDENTITY 0 255 PHYS_UNIT "FMI" /end CHARACTERISTIC
/begin CHARACTERISTIC FCfmi_Sec3_open "FCtl_FMI(927)" VALUE 0x001E5CA0 /* @ECU_Address@FCtl_FMI@0x021B739F@ */ ECIPP_ALIGNMENT_UBYTE 255 Compu_IDENTITY 0 255 PHYS_UNIT "FMI" /end CHARACTERISTIC
/begin CHARACTERISTIC FCfmi_Sec4_31KV_open "FCtl_FMI(952)" VALUE 0x001E5CB9 /* @ECU_Address@FCtl_FMI@0x021B73B8@ */ ECIPP_ALIGNMENT_UBYTE 255 Compu_IDENTITY 0 255 PHYS_UNIT "FMI" /end CHARACTERISTIC
/begin CHARACTERISTIC FCfmi_Sec4_low "FCtl_FMI(940)" VALUE 0x001E5CAD /* @ECU_Address@FCtl_FMI@0x021B73AC@ */ ECIPP_ALIGNMENT_UBYTE 255 Compu_IDENTITY 0 255 PHYS_UNIT "FMI" /end CHARACTERISTIC
/begin CHARACTERISTIC FCfmi_Sec4_open "FCtl_FMI(928)" VALUE 0x001E5CA1 /* @ECU_Address@FCtl_FMI@0x021B73A0@ */ ECIPP_ALIGNMENT_UBYTE 255 Compu_IDENTITY 0 255 PHYS_UNIT "FMI" /end CHARACTERISTIC
/begin CHARACTERISTIC FCfmi_Sec5_31KV_open "FCtl_FMI(953)" VALUE 0x001E5CBA /* @ECU_Address@FCtl_FMI@0x021B73B9@ */ ECIPP_ALIGNMENT_UBYTE 255 Compu_IDENTITY 0 255 PHYS_UNIT "FMI" /end CHARACTERISTIC
/begin CHARACTERISTIC FCfmi_Sec5_low "FCtl_FMI(941)" VALUE 0x001E5CAE /* @ECU_Address@FCtl_FMI@0x021B73AD@ */ ECIPP_ALIGNMENT_UBYTE 255 Compu_IDENTITY 0 255 PHYS_UNIT "FMI" /end CHARACTERISTIC
/begin CHARACTERISTIC FCfmi_Sec5_open "FCtl_FMI(929)" VALUE 0x001E5CA2 /* @ECU_Address@FCtl_FMI@0x021B73A1@ */ ECIPP_ALIGNMENT_UBYTE 255 Compu_IDENTITY 0 255 PHYS_UNIT "FMI" /end CHARACTERISTIC
/begin CHARACTERISTIC FCfmi_Sec6_31KV_open "FCtl_FMI(954)" VALUE 0x001E5CBB /* @ECU_Address@FCtl_FMI@0x021B73BA@ */ ECIPP_ALIGNMENT_UBYTE 255 Compu_IDENTITY 0 255 PHYS_UNIT "FMI" /end CHARACTERISTIC
/begin CHARACTERISTIC FCfmi_Sec6_low "FCtl_FMI(942)" VALUE 0x001E5CAF /* @ECU_Address@FCtl_FMI@0x021B73AE@ */ ECIPP_ALIGNMENT_UBYTE 255 Compu_IDENTITY 0 255 PHYS_UNIT "FMI" /end CHARACTERISTIC
/begin CHARACTERISTIC FCfmi_Sec6_open "FCtl_FMI(930)" VALUE 0x001E5CA3 /* @ECU_Address@FCtl_FMI@0x021B73A2@ */ ECIPP_ALIGNMENT_UBYTE 255 Compu_IDENTITY 0 255 PHYS_UNIT "FMI" /end CHARACTERISTIC
/begin CHARACTERISTIC FCfmi_Sec7_31KV_open "FCtl_FMI(955)" VALUE 0x001E5CBC /* @ECU_Address@FCtl_FMI@0x021B73BB@ */ ECIPP_ALIGNMENT_UBYTE 255 Compu_IDENTITY 0 255 PHYS_UNIT "FMI" /end CHARACTERISTIC
/begin CHARACTERISTIC FCfmi_Sec7_low "FCtl_FMI(943)" VALUE 0x001E5CB0 /* @ECU_Address@FCtl_FMI@0x021B73AF@ */ ECIPP_ALIGNMENT_UBYTE 255 Compu_IDENTITY 0 255 PHYS_UNIT "FMI" /end CHARACTERISTIC
/begin CHARACTERISTIC FCfmi_Sec7_open "FCtl_FMI(931)" VALUE 0x001E5CA4 /* @ECU_Address@FCtl_FMI@0x021B73A3@ */ ECIPP_ALIGNMENT_UBYTE 255 Compu_IDENTITY 0 255 PHYS_UNIT "FMI" /end CHARACTERISTIC
/begin CHARACTERISTIC FCfmi_Sec8_31KV_open "FCtl_FMI(956)" VALUE 0x001E5CBD /* @ECU_Address@FCtl_FMI@0x021B73BC@ */ ECIPP_ALIGNMENT_UBYTE 255 Compu_IDENTITY 0 255 PHYS_UNIT "FMI" /end CHARACTERISTIC
/begin CHARACTERISTIC FCfmi_Sec8_low "FCtl_FMI(944)" VALUE 0x001E5CB1 /* @ECU_Address@FCtl_FMI@0x021B73B0@ */ ECIPP_ALIGNMENT_UBYTE 255 Compu_IDENTITY 0 255 PHYS_UNIT "FMI" /end CHARACTERISTIC
/begin CHARACTERISTIC FCfmi_Sec8_open "FCtl_FMI(932)" VALUE 0x001E5CA5 /* @ECU_Address@FCtl_FMI@0x021B73A4@ */ ECIPP_ALIGNMENT_UBYTE 255 Compu_IDENTITY 0 255 PHYS_UNIT "FMI" /end CHARACTERISTIC
/begin CHARACTERISTIC FCfmi_Sec9_31KV_open "FCtl_FMI(957)" VALUE 0x001E5CBE /* @ECU_Address@FCtl_FMI@0x021B73BD@ */ ECIPP_ALIGNMENT_UBYTE 255 Compu_IDENTITY 0 255 PHYS_UNIT "FMI" /end CHARACTERISTIC
/begin CHARACTERISTIC FCfmi_Sec9_low "FCtl_FMI(945)" VALUE 0x001E5CB2 /* @ECU_Address@FCtl_FMI@0x021B73B1@ */ ECIPP_ALIGNMENT_UBYTE 255 Compu_IDENTITY 0 255 PHYS_UNIT "FMI" /end CHARACTERISTIC
/begin CHARACTERISTIC FCfmi_Sec9_open "FCtl_FMI(933)" VALUE 0x001E5CA6 /* @ECU_Address@FCtl_FMI@0x021B73A5@ */ ECIPP_ALIGNMENT_UBYTE 255 Compu_IDENTITY 0 255 PHYS_UNIT "FMI" /end CHARACTERISTIC
/begin CHARACTERISTIC FCfmi_SPK10_IGBT_T "FCtl_FMI(518)" VALUE 0x001E5B07 /* @ECU_Address@FCtl_FMI@0x021B7206@ */ ECIPP_ALIGNMENT_UBYTE 255 Compu_IDENTITY 0 255 PHYS_UNIT "FMI" /end CHARACTERISTIC
/begin CHARACTERISTIC FCfmi_SPK11_IGBT_T "FCtl_FMI(1021)" VALUE 0x001E5CFE /* @ECU_Address@FCtl_FMI@0x021B73FD@ */ ECIPP_ALIGNMENT_UBYTE 255 Compu_IDENTITY 0 255 PHYS_UNIT "FMI" /end CHARACTERISTIC
/begin CHARACTERISTIC FCfmi_SPK12_IGBT_T "FCtl_FMI(1022)" VALUE 0x001E5CFF /* @ECU_Address@FCtl_FMI@0x021B73FE@ */ ECIPP_ALIGNMENT_UBYTE 255 Compu_IDENTITY 0 255 PHYS_UNIT "FMI" /end CHARACTERISTIC
/begin CHARACTERISTIC FCfmi_SPK2_IGBT_T "FCtl_FMI(510)" VALUE 0x001E5AFF /* @ECU_Address@FCtl_FMI@0x021B71FE@ */ ECIPP_ALIGNMENT_UBYTE 255 Compu_IDENTITY 0 255 PHYS_UNIT "FMI" /end CHARACTERISTIC
/begin CHARACTERISTIC FCfmi_SPK3_IGBT_T "FCtl_FMI(511)" VALUE 0x001E5B00 /* @ECU_Address@FCtl_FMI@0x021B71FF@ */ ECIPP_ALIGNMENT_UBYTE 255 Compu_IDENTITY 0 255 PHYS_UNIT "FMI" /end CHARACTERISTIC
/begin CHARACTERISTIC FCfmi_SPK4_IGBT_T "FCtl_FMI(512)" VALUE 0x001E5B01 /* @ECU_Address@FCtl_FMI@0x021B7200@ */ ECIPP_ALIGNMENT_UBYTE 255 Compu_IDENTITY 0 255 PHYS_UNIT "FMI" /end CHARACTERISTIC
/begin CHARACTERISTIC FCfmi_SPK5_IGBT_T "FCtl_FMI(513)" VALUE 0x001E5B02 /* @ECU_Address@FCtl_FMI@0x021B7201@ */ ECIPP_ALIGNMENT_UBYTE 255 Compu_IDENTITY 0 255 PHYS_UNIT "FMI" /end CHARACTERISTIC
/begin CHARACTERISTIC FCfmi_SPK6_IGBT_T "FCtl_FMI(514)" VALUE 0x001E5B03 /* @ECU_Address@FCtl_FMI@0x021B7202@ */ ECIPP_ALIGNMENT_UBYTE 255 Compu_IDENTITY 0 255 PHYS_UNIT "FMI" /end CHARACTERISTIC
/begin CHARACTERISTIC FCfmi_SPK7_IGBT_T "FCtl_FMI(515)" VALUE 0x001E5B04 /* @ECU_Address@FCtl_FMI@0x021B7203@ */ ECIPP_ALIGNMENT_UBYTE 255 Compu_IDENTITY 0 255 PHYS_UNIT "FMI" /end CHARACTERISTIC
/begin CHARACTERISTIC FCfmi_SPK8_IGBT_T "FCtl_FMI(516)" VALUE 0x001E5B05 /* @ECU_Address@FCtl_FMI@0x021B7204@ */ ECIPP_ALIGNMENT_UBYTE 255 Compu_IDENTITY 0 255 PHYS_UNIT "FMI" /end CHARACTERISTIC
/begin CHARACTERISTIC FCfmi_SPK9_IGBT_T "FCtl_FMI(517)" VALUE 0x001E5B06 /* @ECU_Address@FCtl_FMI@0x021B7205@ */ ECIPP_ALIGNMENT_UBYTE 255 Compu_IDENTITY 0 255 PHYS_UNIT "FMI" /end CHARACTERISTIC
/begin CHARACTERISTIC FCfmi_SPKD10_coil_fail "FCtl_FMI(313)" VALUE 0x001E5A3A /* @ECU_Address@FCtl_FMI@0x021B7139@ */ ECIPP_ALIGNMENT_UBYTE 255 Compu_IDENTITY 0 255 PHYS_UNIT "FMI" /end CHARACTERISTIC
/begin CHARACTERISTIC FCfmi_SPKD10_dw_hi "FCtl_FMI(85)" VALUE 0x001E5956 /* @ECU_Address@FCtl_FMI@0x021B7055@ */ ECIPP_ALIGNMENT_UBYTE 255 Compu_IDENTITY 0 255 PHYS_UNIT "FMI" /end CHARACTERISTIC
/begin CHARACTERISTIC FCfmi_SPKD10_dw_lo "FCtl_FMI(75)" VALUE 0x001E594C /* @ECU_Address@FCtl_FMI@0x021B704B@ */ ECIPP_ALIGNMENT_UBYTE 255 Compu_IDENTITY 0 255 PHYS_UNIT "FMI" /end CHARACTERISTIC
/begin CHARACTERISTIC FCfmi_SPKD11_coil_fail "FCtl_FMI(1027)" VALUE 0x001E5D04 /* @ECU_Address@FCtl_FMI@0x021B7403@ */ ECIPP_ALIGNMENT_UBYTE 255 Compu_IDENTITY 0 255 PHYS_UNIT "FMI" /end CHARACTERISTIC
/begin CHARACTERISTIC FCfmi_SPKD11_dw_hi "FCtl_FMI(1025)" VALUE 0x001E5D02 /* @ECU_Address@FCtl_FMI@0x021B7401@ */ ECIPP_ALIGNMENT_UBYTE 255 Compu_IDENTITY 0 255 PHYS_UNIT "FMI" /end CHARACTERISTIC
/begin CHARACTERISTIC FCfmi_SPKD11_dw_lo "FCtl_FMI(1023)" VALUE 0x001E5D00 /* @ECU_Address@FCtl_FMI@0x021B73FF@ */ ECIPP_ALIGNMENT_UBYTE 255 Compu_IDENTITY 0 255 PHYS_UNIT "FMI" /end CHARACTERISTIC
/begin CHARACTERISTIC FCfmi_SPKD12_coil_fail "FCtl_FMI(1028)" VALUE 0x001E5D05 /* @ECU_Address@FCtl_FMI@0x021B7404@ */ ECIPP_ALIGNMENT_UBYTE 255 Compu_IDENTITY 0 255 PHYS_UNIT "FMI" /end CHARACTERISTIC
/begin CHARACTERISTIC FCfmi_SPKD12_dw_hi "FCtl_FMI(1026)" VALUE 0x001E5D03 /* @ECU_Address@FCtl_FMI@0x021B7402@ */ ECIPP_ALIGNMENT_UBYTE 255 Compu_IDENTITY 0 255 PHYS_UNIT "FMI" /end CHARACTERISTIC
/begin CHARACTERISTIC FCfmi_SPKD12_dw_lo "FCtl_FMI(1024)" VALUE 0x001E5D01 /* @ECU_Address@FCtl_FMI@0x021B7400@ */ ECIPP_ALIGNMENT_UBYTE 255 Compu_IDENTITY 0 255 PHYS_UNIT "FMI" /end CHARACTERISTIC
/begin CHARACTERISTIC FCfmi_SPKD2_coil_fail "FCtl_FMI(305)" VALUE 0x001E5A32 /* @ECU_Address@FCtl_FMI@0x021B7131@ */ ECIPP_ALIGNMENT_UBYTE 255 Compu_IDENTITY 0 255 PHYS_UNIT "FMI" /end CHARACTERISTIC
/begin CHARACTERISTIC FCfmi_SPKD2_dw_hi "FCtl_FMI(77)" VALUE 0x001E594E /* @ECU_Address@FCtl_FMI@0x021B704D@ */ ECIPP_ALIGNMENT_UBYTE 255 Compu_IDENTITY 0 255 PHYS_UNIT "FMI" /end CHARACTERISTIC
/begin CHARACTERISTIC FCfmi_SPKD2_dw_lo "FCtl_FMI(67)" VALUE 0x001E5944 /* @ECU_Address@FCtl_FMI@0x021B7043@ */ ECIPP_ALIGNMENT_UBYTE 255 Compu_IDENTITY 0 255 PHYS_UNIT "FMI" /end CHARACTERISTIC
/begin CHARACTERISTIC FCfmi_SPKD3_coil_fail "FCtl_FMI(306)" VALUE 0x001E5A33 /* @ECU_Address@FCtl_FMI@0x021B7132@ */ ECIPP_ALIGNMENT_UBYTE 255 Compu_IDENTITY 0 255 PHYS_UNIT "FMI" /end CHARACTERISTIC
/begin CHARACTERISTIC FCfmi_SPKD3_dw_hi "FCtl_FMI(78)" VALUE 0x001E594F /* @ECU_Address@FCtl_FMI@0x021B704E@ */ ECIPP_ALIGNMENT_UBYTE 255 Compu_IDENTITY 0 255 PHYS_UNIT "FMI" /end CHARACTERISTIC
/begin CHARACTERISTIC FCfmi_SPKD3_dw_lo "FCtl_FMI(68)" VALUE 0x001E5945 /* @ECU_Address@FCtl_FMI@0x021B7044@ */ ECIPP_ALIGNMENT_UBYTE 255 Compu_IDENTITY 0 255 PHYS_UNIT "FMI" /end CHARACTERISTIC
/begin CHARACTERISTIC FCfmi_SPKD4_coil_fail "FCtl_FMI(307)" VALUE 0x001E5A34 /* @ECU_Address@FCtl_FMI@0x021B7133@ */ ECIPP_ALIGNMENT_UBYTE 255 Compu_IDENTITY 0 255 PHYS_UNIT "FMI" /end CHARACTERISTIC
/begin CHARACTERISTIC FCfmi_SPKD4_dw_hi "FCtl_FMI(79)" VALUE 0x001E5950 /* @ECU_Address@FCtl_FMI@0x021B704F@ */ ECIPP_ALIGNMENT_UBYTE 255 Compu_IDENTITY 0 255 PHYS_UNIT "FMI" /end CHARACTERISTIC
/begin CHARACTERISTIC FCfmi_SPKD4_dw_lo "FCtl_FMI(69)" VALUE 0x001E5946 /* @ECU_Address@FCtl_FMI@0x021B7045@ */ ECIPP_ALIGNMENT_UBYTE 255 Compu_IDENTITY 0 255 PHYS_UNIT "FMI" /end CHARACTERISTIC
/begin CHARACTERISTIC FCfmi_SPKD5_coil_fail "FCtl_FMI(308)" VALUE 0x001E5A35 /* @ECU_Address@FCtl_FMI@0x021B7134@ */ ECIPP_ALIGNMENT_UBYTE 255 Compu_IDENTITY 0 255 PHYS_UNIT "FMI" /end CHARACTERISTIC
/begin CHARACTERISTIC FCfmi_SPKD5_dw_hi "FCtl_FMI(80)" VALUE 0x001E5951 /* @ECU_Address@FCtl_FMI@0x021B7050@ */ ECIPP_ALIGNMENT_UBYTE 255 Compu_IDENTITY 0 255 PHYS_UNIT "FMI" /end CHARACTERISTIC
/begin CHARACTERISTIC FCfmi_SPKD5_dw_lo "FCtl_FMI(70)" VALUE 0x001E5947 /* @ECU_Address@FCtl_FMI@0x021B7046@ */ ECIPP_ALIGNMENT_UBYTE 255 Compu_IDENTITY 0 255 PHYS_UNIT "FMI" /end CHARACTERISTIC
/begin CHARACTERISTIC FCfmi_SPKD6_coil_fail "FCtl_FMI(309)" VALUE 0x001E5A36 /* @ECU_Address@FCtl_FMI@0x021B7135@ */ ECIPP_ALIGNMENT_UBYTE 255 Compu_IDENTITY 0 255 PHYS_UNIT "FMI" /end CHARACTERISTIC
/begin CHARACTERISTIC FCfmi_SPKD6_dw_hi "FCtl_FMI(81)" VALUE 0x001E5952 /* @ECU_Address@FCtl_FMI@0x021B7051@ */ ECIPP_ALIGNMENT_UBYTE 255 Compu_IDENTITY 0 255 PHYS_UNIT "FMI" /end CHARACTERISTIC
/begin CHARACTERISTIC FCfmi_SPKD6_dw_lo "FCtl_FMI(71)" VALUE 0x001E5948 /* @ECU_Address@FCtl_FMI@0x021B7047@ */ ECIPP_ALIGNMENT_UBYTE 255 Compu_IDENTITY 0 255 PHYS_UNIT "FMI" /end CHARACTERISTIC
/begin CHARACTERISTIC FCfmi_SPKD7_coil_fail "FCtl_FMI(310)" VALUE 0x001E5A37 /* @ECU_Address@FCtl_FMI@0x021B7136@ */ ECIPP_ALIGNMENT_UBYTE 255 Compu_IDENTITY 0 255 PHYS_UNIT "FMI" /end CHARACTERISTIC
/begin CHARACTERISTIC FCfmi_SPKD7_dw_hi "FCtl_FMI(82)" VALUE 0x001E5953 /* @ECU_Address@FCtl_FMI@0x021B7052@ */ ECIPP_ALIGNMENT_UBYTE 255 Compu_IDENTITY 0 255 PHYS_UNIT "FMI" /end CHARACTERISTIC
/begin CHARACTERISTIC FCfmi_SPKD7_dw_lo "FCtl_FMI(72)" VALUE 0x001E5949 /* @ECU_Address@FCtl_FMI@0x021B7048@ */ ECIPP_ALIGNMENT_UBYTE 255 Compu_IDENTITY 0 255 PHYS_UNIT "FMI" /end CHARACTERISTIC
/begin CHARACTERISTIC FCfmi_SPKD8_coil_fail "FCtl_FMI(311)" VALUE 0x001E5A38 /* @ECU_Address@FCtl_FMI@0x021B7137@ */ ECIPP_ALIGNMENT_UBYTE 255 Compu_IDENTITY 0 255 PHYS_UNIT "FMI" /end CHARACTERISTIC
/begin CHARACTERISTIC FCfmi_SPKD8_dw_hi "FCtl_FMI(83)" VALUE 0x001E5954 /* @ECU_Address@FCtl_FMI@0x021B7053@ */ ECIPP_ALIGNMENT_UBYTE 255 Compu_IDENTITY 0 255 PHYS_UNIT "FMI" /end CHARACTERISTIC
/begin CHARACTERISTIC FCfmi_SPKD8_dw_lo "FCtl_FMI(73)" VALUE 0x001E594A /* @ECU_Address@FCtl_FMI@0x021B7049@ */ ECIPP_ALIGNMENT_UBYTE 255 Compu_IDENTITY 0 255 PHYS_UNIT "FMI" /end CHARACTERISTIC
/begin CHARACTERISTIC FCfmi_SPKD9_coil_fail "FCtl_FMI(312)" VALUE 0x001E5A39 /* @ECU_Address@FCtl_FMI@0x021B7138@ */ ECIPP_ALIGNMENT_UBYTE 255 Compu_IDENTITY 0 255 PHYS_UNIT "FMI" /end CHARACTERISTIC
/begin CHARACTERISTIC FCfmi_SPKD9_dw_hi "FCtl_FMI(84)" VALUE 0x001E5955 /* @ECU_Address@FCtl_FMI@0x021B7054@ */ ECIPP_ALIGNMENT_UBYTE 255 Compu_IDENTITY 0 255 PHYS_UNIT "FMI" /end CHARACTERISTIC
/begin CHARACTERISTIC FCfmi_SPKD9_dw_lo "FCtl_FMI(74)" VALUE 0x001E594B /* @ECU_Address@FCtl_FMI@0x021B704A@ */ ECIPP_ALIGNMENT_UBYTE 255 Compu_IDENTITY 0 255 PHYS_UNIT "FMI" /end CHARACTERISTIC
/begin CHARACTERISTIC FCfmi_TANK_2_V_maxv "FCtl_FMI(872)" VALUE 0x001E5C69 /* @ECU_Address@FCtl_FMI@0x021B7368@ */ ECIPP_ALIGNMENT_UBYTE 255 Compu_IDENTITY 0 255 PHYS_UNIT "FMI" /end CHARACTERISTIC
/begin CHARACTERISTIC FCfmi_TANK_2_V_minv "FCtl_FMI(874)" VALUE 0x001E5C6B /* @ECU_Address@FCtl_FMI@0x021B736A@ */ ECIPP_ALIGNMENT_UBYTE 255 Compu_IDENTITY 0 255 PHYS_UNIT "FMI" /end CHARACTERISTIC
/begin CHARACTERISTIC FCfmi_TANK_2_V_slow "FCtl_FMI(876)" VALUE 0x001E5C6D /* @ECU_Address@FCtl_FMI@0x021B736C@ */ ECIPP_ALIGNMENT_UBYTE 255 Compu_IDENTITY 0 255 PHYS_UNIT "FMI" /end CHARACTERISTIC
/begin CHARACTERISTIC FCfmi_UGF_Hv_lo "FCtl_FMI(243)" VALUE 0x001E59F4 /* @ECU_Address@FCtl_FMI@0x021B70F3@ */ ECIPP_ALIGNMENT_UBYTE 255 Compu_IDENTITY 0 255 PHYS_UNIT "FMI" /end CHARACTERISTIC
/begin CHARACTERISTIC FCfmi_UGF1_PR_hi "FCtl_FMI(257)" VALUE 0x001E5A02 /* @ECU_Address@FCtl_FMI@0x021B7101@ */ ECIPP_ALIGNMENT_UBYTE 255 Compu_IDENTITY 0 255 PHYS_UNIT "FMI" /end CHARACTERISTIC
/begin CHARACTERISTIC FCfmi_UGF1_PR_lo "FCtl_FMI(258)" VALUE 0x001E5A03 /* @ECU_Address@FCtl_FMI@0x021B7102@ */ ECIPP_ALIGNMENT_UBYTE 255 Compu_IDENTITY 0 255 PHYS_UNIT "FMI" /end CHARACTERISTIC
/begin CHARACTERISTIC FCfmi_UGF1_PR_slow "FCtl_FMI(255)" VALUE 0x001E5A00 /* @ECU_Address@FCtl_FMI@0x021B70FF@ */ ECIPP_ALIGNMENT_UBYTE 255 Compu_IDENTITY 0 255 PHYS_UNIT "FMI" /end CHARACTERISTIC
/begin CHARACTERISTIC FCfmi_UGF1_Pv_hi "FCtl_FMI(252)" VALUE 0x001E59FD /* @ECU_Address@FCtl_FMI@0x021B70FC@ */ ECIPP_ALIGNMENT_UBYTE 255 Compu_IDENTITY 0 255 PHYS_UNIT "FMI" /end CHARACTERISTIC
/begin CHARACTERISTIC FCfmi_UGF1_Pv_lo "FCtl_FMI(253)" VALUE 0x001E59FE /* @ECU_Address@FCtl_FMI@0x021B70FD@ */ ECIPP_ALIGNMENT_UBYTE 255 Compu_IDENTITY 0 255 PHYS_UNIT "FMI" /end CHARACTERISTIC
/begin CHARACTERISTIC FCfmi_UGF1_PvFB_hi "FCtl_FMI(248)" VALUE 0x001E59F9 /* @ECU_Address@FCtl_FMI@0x021B70F8@ */ ECIPP_ALIGNMENT_UBYTE 255 Compu_IDENTITY 0 255 PHYS_UNIT "FMI" /end CHARACTERISTIC
/begin CHARACTERISTIC FCfmi_UGF1_PvFB_lo "FCtl_FMI(249)" VALUE 0x001E59FA /* @ECU_Address@FCtl_FMI@0x021B70F9@ */ ECIPP_ALIGNMENT_UBYTE 255 Compu_IDENTITY 0 255 PHYS_UNIT "FMI" /end CHARACTERISTIC
/begin CHARACTERISTIC FCfmi_UGF1_R_lo "FCtl_FMI(245)" VALUE 0x001E59F6 /* @ECU_Address@FCtl_FMI@0x021B70F5@ */ ECIPP_ALIGNMENT_UBYTE 255 Compu_IDENTITY 0 255 PHYS_UNIT "FMI" /end CHARACTERISTIC
/begin CHARACTERISTIC FCfmi_UGF1_rtn_hi "FCtl_FMI(246)" VALUE 0x001E59F7 /* @ECU_Address@FCtl_FMI@0x021B70F6@ */ ECIPP_ALIGNMENT_UBYTE 255 Compu_IDENTITY 0 255 PHYS_UNIT "FMI" /end CHARACTERISTIC
/begin CHARACTERISTIC FCfmi_UGF1_rtn_lo "FCtl_FMI(247)" VALUE 0x001E59F8 /* @ECU_Address@FCtl_FMI@0x021B70F7@ */ ECIPP_ALIGNMENT_UBYTE 255 Compu_IDENTITY 0 255 PHYS_UNIT "FMI" /end CHARACTERISTIC
/begin CHARACTERISTIC FCfmi_UGF1_Sv_lo "FCtl_FMI(251)" VALUE 0x001E59FC /* @ECU_Address@FCtl_FMI@0x021B70FB@ */ ECIPP_ALIGNMENT_UBYTE 255 Compu_IDENTITY 0 255 PHYS_UNIT "FMI" /end CHARACTERISTIC
/begin CHARACTERISTIC FCfmi_UGF2_Hv_lo "FCtl_FMI(410)" VALUE 0x001E5A9B /* @ECU_Address@FCtl_FMI@0x021B719A@ */ ECIPP_ALIGNMENT_UBYTE 255 Compu_IDENTITY 0 255 PHYS_UNIT "FMI" /end CHARACTERISTIC
/begin CHARACTERISTIC FCfmi_UGF2_PR_hi "FCtl_FMI(424)" VALUE 0x001E5AA9 /* @ECU_Address@FCtl_FMI@0x021B71A8@ */ ECIPP_ALIGNMENT_UBYTE 255 Compu_IDENTITY 0 255 PHYS_UNIT "FMI" /end CHARACTERISTIC
/begin CHARACTERISTIC FCfmi_UGF2_PR_lo "FCtl_FMI(425)" VALUE 0x001E5AAA /* @ECU_Address@FCtl_FMI@0x021B71A9@ */ ECIPP_ALIGNMENT_UBYTE 255 Compu_IDENTITY 0 255 PHYS_UNIT "FMI" /end CHARACTERISTIC
/begin CHARACTERISTIC FCfmi_UGF2_PR_slow "FCtl_FMI(422)" VALUE 0x001E5AA7 /* @ECU_Address@FCtl_FMI@0x021B71A6@ */ ECIPP_ALIGNMENT_UBYTE 255 Compu_IDENTITY 0 255 PHYS_UNIT "FMI" /end CHARACTERISTIC
/begin CHARACTERISTIC FCfmi_UGF2_Pv_hi "FCtl_FMI(419)" VALUE 0x001E5AA4 /* @ECU_Address@FCtl_FMI@0x021B71A3@ */ ECIPP_ALIGNMENT_UBYTE 255 Compu_IDENTITY 0 255 PHYS_UNIT "FMI" /end CHARACTERISTIC
/begin CHARACTERISTIC FCfmi_UGF2_Pv_lo "FCtl_FMI(420)" VALUE 0x001E5AA5 /* @ECU_Address@FCtl_FMI@0x021B71A4@ */ ECIPP_ALIGNMENT_UBYTE 255 Compu_IDENTITY 0 255 PHYS_UNIT "FMI" /end CHARACTERISTIC
/begin CHARACTERISTIC FCfmi_UGF2_PvFB_hi "FCtl_FMI(415)" VALUE 0x001E5AA0 /* @ECU_Address@FCtl_FMI@0x021B719F@ */ ECIPP_ALIGNMENT_UBYTE 255 Compu_IDENTITY 0 255 PHYS_UNIT "FMI" /end CHARACTERISTIC
/begin CHARACTERISTIC FCfmi_UGF2_PvFB_lo "FCtl_FMI(416)" VALUE 0x001E5AA1 /* @ECU_Address@FCtl_FMI@0x021B71A0@ */ ECIPP_ALIGNMENT_UBYTE 255 Compu_IDENTITY 0 255 PHYS_UNIT "FMI" /end CHARACTERISTIC
/begin CHARACTERISTIC FCfmi_UGF2_R_lo "FCtl_FMI(412)" VALUE 0x001E5A9D /* @ECU_Address@FCtl_FMI@0x021B719C@ */ ECIPP_ALIGNMENT_UBYTE 255 Compu_IDENTITY 0 255 PHYS_UNIT "FMI" /end CHARACTERISTIC
/begin CHARACTERISTIC FCfmi_UGF2_rtn_hi "FCtl_FMI(413)" VALUE 0x001E5A9E /* @ECU_Address@FCtl_FMI@0x021B719D@ */ ECIPP_ALIGNMENT_UBYTE 255 Compu_IDENTITY 0 255 PHYS_UNIT "FMI" /end CHARACTERISTIC
/begin CHARACTERISTIC FCfmi_UGF2_rtn_lo "FCtl_FMI(414)" VALUE 0x001E5A9F /* @ECU_Address@FCtl_FMI@0x021B719E@ */ ECIPP_ALIGNMENT_UBYTE 255 Compu_IDENTITY 0 255 PHYS_UNIT "FMI" /end CHARACTERISTIC
/begin CHARACTERISTIC FCfmi_UGF2_Sv_lo "FCtl_FMI(418)" VALUE 0x001E5AA3 /* @ECU_Address@FCtl_FMI@0x021B71A2@ */ ECIPP_ALIGNMENT_UBYTE 255 Compu_IDENTITY 0 255 PHYS_UNIT "FMI" /end CHARACTERISTIC
/begin CHARACTERISTIC FCfmi_UGF3_Hv_lo "FCtl_FMI(606)" VALUE 0x001E5B5F /* @ECU_Address@FCtl_FMI@0x021B725E@ */ ECIPP_ALIGNMENT_UBYTE 255 Compu_IDENTITY 0 255 PHYS_UNIT "FMI" /end CHARACTERISTIC
/begin CHARACTERISTIC FCfmi_UGF3_PR_hi "FCtl_FMI(620)" VALUE 0x001E5B6D /* @ECU_Address@FCtl_FMI@0x021B726C@ */ ECIPP_ALIGNMENT_UBYTE 255 Compu_IDENTITY 0 255 PHYS_UNIT "FMI" /end CHARACTERISTIC
/begin CHARACTERISTIC FCfmi_UGF3_PR_lo "FCtl_FMI(621)" VALUE 0x001E5B6E /* @ECU_Address@FCtl_FMI@0x021B726D@ */ ECIPP_ALIGNMENT_UBYTE 255 Compu_IDENTITY 0 255 PHYS_UNIT "FMI" /end CHARACTERISTIC
/begin CHARACTERISTIC FCfmi_UGF3_PR_slow "FCtl_FMI(618)" VALUE 0x001E5B6B /* @ECU_Address@FCtl_FMI@0x021B726A@ */ ECIPP_ALIGNMENT_UBYTE 255 Compu_IDENTITY 0 255 PHYS_UNIT "FMI" /end CHARACTERISTIC
/begin CHARACTERISTIC FCfmi_UGF3_Pv_hi "FCtl_FMI(615)" VALUE 0x001E5B68 /* @ECU_Address@FCtl_FMI@0x021B7267@ */ ECIPP_ALIGNMENT_UBYTE 255 Compu_IDENTITY 0 255 PHYS_UNIT "FMI" /end CHARACTERISTIC
/begin CHARACTERISTIC FCfmi_UGF3_Pv_lo "FCtl_FMI(616)" VALUE 0x001E5B69 /* @ECU_Address@FCtl_FMI@0x021B7268@ */ ECIPP_ALIGNMENT_UBYTE 255 Compu_IDENTITY 0 255 PHYS_UNIT "FMI" /end CHARACTERISTIC
/begin CHARACTERISTIC FCfmi_UGF3_PvFB_hi "FCtl_FMI(611)" VALUE 0x001E5B64 /* @ECU_Address@FCtl_FMI@0x021B7263@ */ ECIPP_ALIGNMENT_UBYTE 255 Compu_IDENTITY 0 255 PHYS_UNIT "FMI" /end CHARACTERISTIC
/begin CHARACTERISTIC FCfmi_UGF3_PvFB_lo "FCtl_FMI(612)" VALUE 0x001E5B65 /* @ECU_Address@FCtl_FMI@0x021B7264@ */ ECIPP_ALIGNMENT_UBYTE 255 Compu_IDENTITY 0 255 PHYS_UNIT "FMI" /end CHARACTERISTIC
/begin CHARACTERISTIC FCfmi_UGF3_R_lo "FCtl_FMI(608)" VALUE 0x001E5B61 /* @ECU_Address@FCtl_FMI@0x021B7260@ */ ECIPP_ALIGNMENT_UBYTE 255 Compu_IDENTITY 0 255 PHYS_UNIT "FMI" /end CHARACTERISTIC
/begin CHARACTERISTIC FCfmi_UGF3_rtn_hi "FCtl_FMI(609)" VALUE 0x001E5B62 /* @ECU_Address@FCtl_FMI@0x021B7261@ */ ECIPP_ALIGNMENT_UBYTE 255 Compu_IDENTITY 0 255 PHYS_UNIT "FMI" /end CHARACTERISTIC
/begin CHARACTERISTIC FCfmi_UGF3_rtn_lo "FCtl_FMI(610)" VALUE 0x001E5B63 /* @ECU_Address@FCtl_FMI@0x021B7262@ */ ECIPP_ALIGNMENT_UBYTE 255 Compu_IDENTITY 0 255 PHYS_UNIT "FMI" /end CHARACTERISTIC
/begin CHARACTERISTIC FCfmi_UGF3_Sv_lo "FCtl_FMI(614)" VALUE 0x001E5B67 /* @ECU_Address@FCtl_FMI@0x021B7266@ */ ECIPP_ALIGNMENT_UBYTE 255 Compu_IDENTITY 0 255 PHYS_UNIT "FMI" /end CHARACTERISTIC
/begin CHARACTERISTIC FCfmi_UGF4_Hv_lo "FCtl_FMI(629)" VALUE 0x001E5B76 /* @ECU_Address@FCtl_FMI@0x021B7275@ */ ECIPP_ALIGNMENT_UBYTE 255 Compu_IDENTITY 0 255 PHYS_UNIT "FMI" /end CHARACTERISTIC
/begin CHARACTERISTIC FCfmi_UGF4_PR_hi "FCtl_FMI(643)" VALUE 0x001E5B84 /* @ECU_Address@FCtl_FMI@0x021B7283@ */ ECIPP_ALIGNMENT_UBYTE 255 Compu_IDENTITY 0 255 PHYS_UNIT "FMI" /end CHARACTERISTIC
/begin CHARACTERISTIC FCfmi_UGF4_PR_lo "FCtl_FMI(644)" VALUE 0x001E5B85 /* @ECU_Address@FCtl_FMI@0x021B7284@ */ ECIPP_ALIGNMENT_UBYTE 255 Compu_IDENTITY 0 255 PHYS_UNIT "FMI" /end CHARACTERISTIC
/begin CHARACTERISTIC FCfmi_UGF4_PR_slow "FCtl_FMI(641)" VALUE 0x001E5B82 /* @ECU_Address@FCtl_FMI@0x021B7281@ */ ECIPP_ALIGNMENT_UBYTE 255 Compu_IDENTITY 0 255 PHYS_UNIT "FMI" /end CHARACTERISTIC
/begin CHARACTERISTIC FCfmi_UGF4_Pv_hi "FCtl_FMI(638)" VALUE 0x001E5B7F /* @ECU_Address@FCtl_FMI@0x021B727E@ */ ECIPP_ALIGNMENT_UBYTE 255 Compu_IDENTITY 0 255 PHYS_UNIT "FMI" /end CHARACTERISTIC
/begin CHARACTERISTIC FCfmi_UGF4_Pv_lo "FCtl_FMI(639)" VALUE 0x001E5B80 /* @ECU_Address@FCtl_FMI@0x021B727F@ */ ECIPP_ALIGNMENT_UBYTE 255 Compu_IDENTITY 0 255 PHYS_UNIT "FMI" /end CHARACTERISTIC
/begin CHARACTERISTIC FCfmi_UGF4_PvFB_hi "FCtl_FMI(634)" VALUE 0x001E5B7B /* @ECU_Address@FCtl_FMI@0x021B727A@ */ ECIPP_ALIGNMENT_UBYTE 255 Compu_IDENTITY 0 255 PHYS_UNIT "FMI" /end CHARACTERISTIC
/begin CHARACTERISTIC FCfmi_UGF4_PvFB_lo "FCtl_FMI(635)" VALUE 0x001E5B7C /* @ECU_Address@FCtl_FMI@0x021B727B@ */ ECIPP_ALIGNMENT_UBYTE 255 Compu_IDENTITY 0 255 PHYS_UNIT "FMI" /end CHARACTERISTIC
/begin CHARACTERISTIC FCfmi_UGF4_R_lo "FCtl_FMI(631)" VALUE 0x001E5B78 /* @ECU_Address@FCtl_FMI@0x021B7277@ */ ECIPP_ALIGNMENT_UBYTE 255 Compu_IDENTITY 0 255 PHYS_UNIT "FMI" /end CHARACTERISTIC
/begin CHARACTERISTIC FCfmi_UGF4_rtn_hi "FCtl_FMI(632)" VALUE 0x001E5B79 /* @ECU_Address@FCtl_FMI@0x021B7278@ */ ECIPP_ALIGNMENT_UBYTE 255 Compu_IDENTITY 0 255 PHYS_UNIT "FMI" /end CHARACTERISTIC
/begin CHARACTERISTIC FCfmi_UGF4_rtn_lo "FCtl_FMI(633)" VALUE 0x001E5B7A /* @ECU_Address@FCtl_FMI@0x021B7279@ */ ECIPP_ALIGNMENT_UBYTE 255 Compu_IDENTITY 0 255 PHYS_UNIT "FMI" /end CHARACTERISTIC
/begin CHARACTERISTIC FCfmi_UGF4_Sv_lo "FCtl_FMI(637)" VALUE 0x001E5B7E /* @ECU_Address@FCtl_FMI@0x021B727D@ */ ECIPP_ALIGNMENT_UBYTE 255 Compu_IDENTITY 0 255 PHYS_UNIT "FMI" /end CHARACTERISTIC
/begin CHARACTERISTIC FCftb_AL2_hi "FCtl_FTB_0x04(40)" VALUE 0x001E5D3F /* @ECU_Address@FCtl_FTB_0x04@0x024C5028@ */ ECIPP_ALIGNMENT_UBYTE 255 Compu_IDENTITY 0 255 PHYS_UNIT "FTB" /end CHARACTERISTIC
/begin CHARACTERISTIC FCftb_AL2_lo "FCtl_FTB_0x04(41)" VALUE 0x001E5D40 /* @ECU_Address@FCtl_FTB_0x04@0x024C5029@ */ ECIPP_ALIGNMENT_UBYTE 255 Compu_IDENTITY 0 255 PHYS_UNIT "FTB" /end CHARACTERISTIC
/begin CHARACTERISTIC FCftb_CD_MF10 "FCtl_FTB_0x04(994)" VALUE 0x001E60F9 /* @ECU_Address@FCtl_FTB_0x04@0x024C53E2@ */ ECIPP_ALIGNMENT_UBYTE 255 Compu_IDENTITY 0 255 PHYS_UNIT "FTB" /end CHARACTERISTIC
/begin CHARACTERISTIC FCftb_CD_MF11 "FCtl_FTB_0x04(995)" VALUE 0x001E60FA /* @ECU_Address@FCtl_FTB_0x04@0x024C53E3@ */ ECIPP_ALIGNMENT_UBYTE 255 Compu_IDENTITY 0 255 PHYS_UNIT "FTB" /end CHARACTERISTIC
/begin CHARACTERISTIC FCftb_CD_MF12 "FCtl_FTB_0x04(996)" VALUE 0x001E60FB /* @ECU_Address@FCtl_FTB_0x04@0x024C53E4@ */ ECIPP_ALIGNMENT_UBYTE 255 Compu_IDENTITY 0 255 PHYS_UNIT "FTB" /end CHARACTERISTIC
/begin CHARACTERISTIC FCftb_CD_MF2 "FCtl_FTB_0x04(986)" VALUE 0x001E60F1 /* @ECU_Address@FCtl_FTB_0x04@0x024C53DA@ */ ECIPP_ALIGNMENT_UBYTE 255 Compu_IDENTITY 0 255 PHYS_UNIT "FTB" /end CHARACTERISTIC
/begin CHARACTERISTIC FCftb_CD_MF3 "FCtl_FTB_0x04(987)" VALUE 0x001E60F2 /* @ECU_Address@FCtl_FTB_0x04@0x024C53DB@ */ ECIPP_ALIGNMENT_UBYTE 255 Compu_IDENTITY 0 255 PHYS_UNIT "FTB" /end CHARACTERISTIC
/begin CHARACTERISTIC FCftb_CD_MF4 "FCtl_FTB_0x04(988)" VALUE 0x001E60F3 /* @ECU_Address@FCtl_FTB_0x04@0x024C53DC@ */ ECIPP_ALIGNMENT_UBYTE 255 Compu_IDENTITY 0 255 PHYS_UNIT "FTB" /end CHARACTERISTIC
/begin CHARACTERISTIC FCftb_CD_MF5 "FCtl_FTB_0x04(989)" VALUE 0x001E60F4 /* @ECU_Address@FCtl_FTB_0x04@0x024C53DD@ */ ECIPP_ALIGNMENT_UBYTE 255 Compu_IDENTITY 0 255 PHYS_UNIT "FTB" /end CHARACTERISTIC
/begin CHARACTERISTIC FCftb_CD_MF6 "FCtl_FTB_0x04(990)" VALUE 0x001E60F5 /* @ECU_Address@FCtl_FTB_0x04@0x024C53DE@ */ ECIPP_ALIGNMENT_UBYTE 255 Compu_IDENTITY 0 255 PHYS_UNIT "FTB" /end CHARACTERISTIC
/begin CHARACTERISTIC FCftb_CD_MF7 "FCtl_FTB_0x04(991)" VALUE 0x001E60F6 /* @ECU_Address@FCtl_FTB_0x04@0x024C53DF@ */ ECIPP_ALIGNMENT_UBYTE 255 Compu_IDENTITY 0 255 PHYS_UNIT "FTB" /end CHARACTERISTIC
/begin CHARACTERISTIC FCftb_CD_MF8 "FCtl_FTB_0x04(992)" VALUE 0x001E60F7 /* @ECU_Address@FCtl_FTB_0x04@0x024C53E0@ */ ECIPP_ALIGNMENT_UBYTE 255 Compu_IDENTITY 0 255 PHYS_UNIT "FTB" /end CHARACTERISTIC
/begin CHARACTERISTIC FCftb_CD_MF9 "FCtl_FTB_0x04(993)" VALUE 0x001E60F8 /* @ECU_Address@FCtl_FTB_0x04@0x024C53E1@ */ ECIPP_ALIGNMENT_UBYTE 255 Compu_IDENTITY 0 255 PHYS_UNIT "FTB" /end CHARACTERISTIC
/begin CHARACTERISTIC FCftb_CFVxminFT "FCtl_FTB_0x04(533)" VALUE 0x001E5F2C /* @ECU_Address@FCtl_FTB_0x04@0x024C5215@ */ ECIPP_ALIGNMENT_UBYTE 255 Compu_IDENTITY 0 255 PHYS_UNIT "FTB" /end CHARACTERISTIC
/begin CHARACTERISTIC FCftb_CL2_hi "FCtl_FTB_0x04(34)" VALUE 0x001E5D39 /* @ECU_Address@FCtl_FTB_0x04@0x024C5022@ */ ECIPP_ALIGNMENT_UBYTE 255 Compu_IDENTITY 0 255 PHYS_UNIT "FTB" /end CHARACTERISTIC
/begin CHARACTERISTIC FCftb_CL2_lo "FCtl_FTB_0x04(35)" VALUE 0x001E5D3A /* @ECU_Address@FCtl_FTB_0x04@0x024C5023@ */ ECIPP_ALIGNMENT_UBYTE 255 Compu_IDENTITY 0 255 PHYS_UNIT "FTB" /end CHARACTERISTIC
/begin CHARACTERISTIC FCftb_CM2_unresp "FCtl_FTB_0x04(800)" VALUE 0x001E6037 /* @ECU_Address@FCtl_FTB_0x04@0x024C5320@ */ ECIPP_ALIGNMENT_UBYTE 255 Compu_IDENTITY 0 255 PHYS_UNIT "FTB" /end CHARACTERISTIC
/begin CHARACTERISTIC FCftb_CM2gsln_inact "FCtl_FTB_0x04(199)" VALUE 0x001E5DDE /* @ECU_Address@FCtl_FTB_0x04@0x024C50C7@ */ ECIPP_ALIGNMENT_UBYTE 255 Compu_IDENTITY 0 255 PHYS_UNIT "FTB" /end CHARACTERISTIC
/begin CHARACTERISTIC FCftb_EGO4_open "FCtl_FTB_0x04(200)" VALUE 0x001E5DDF /* @ECU_Address@FCtl_FTB_0x04@0x024C50C8@ */ ECIPP_ALIGNMENT_UBYTE 255 Compu_IDENTITY 0 255 PHYS_UNIT "FTB" /end CHARACTERISTIC
/begin CHARACTERISTIC FCftb_EMWT2_HiExp1 "FCtl_FTB_0x04(226)" VALUE 0x001E5DF9 /* @ECU_Address@FCtl_FTB_0x04@0x024C50E2@ */ ECIPP_ALIGNMENT_UBYTE 255 Compu_IDENTITY 0 255 PHYS_UNIT "FTB" /end CHARACTERISTIC
/begin CHARACTERISTIC FCftb_EMWT2_HiExp2 "FCtl_FTB_0x04(228)" VALUE 0x001E5DFB /* @ECU_Address@FCtl_FTB_0x04@0x024C50E4@ */ ECIPP_ALIGNMENT_UBYTE 255 Compu_IDENTITY 0 255 PHYS_UNIT "FTB" /end CHARACTERISTIC
/begin CHARACTERISTIC FCftb_EMWT2_maxv "FCtl_FTB_0x04(222)" VALUE 0x001E5DF5 /* @ECU_Address@FCtl_FTB_0x04@0x024C50DE@ */ ECIPP_ALIGNMENT_UBYTE 255 Compu_IDENTITY 0 255 PHYS_UNIT "FTB" /end CHARACTERISTIC
/begin CHARACTERISTIC FCftb_EMWT2_minv "FCtl_FTB_0x04(224)" VALUE 0x001E5DF7 /* @ECU_Address@FCtl_FTB_0x04@0x024C50E0@ */ ECIPP_ALIGNMENT_UBYTE 255 Compu_IDENTITY 0 255 PHYS_UNIT "FTB" /end CHARACTERISTIC
/begin CHARACTERISTIC FCftb_ERWT2_HiExp1 "FCtl_FTB_0x04(238)" VALUE 0x001E5E05 /* @ECU_Address@FCtl_FTB_0x04@0x024C50EE@ */ ECIPP_ALIGNMENT_UBYTE 255 Compu_IDENTITY 0 255 PHYS_UNIT "FTB" /end CHARACTERISTIC
/begin CHARACTERISTIC FCftb_ERWT2_HiExp2 "FCtl_FTB_0x04(240)" VALUE 0x001E5E07 /* @ECU_Address@FCtl_FTB_0x04@0x024C50F0@ */ ECIPP_ALIGNMENT_UBYTE 255 Compu_IDENTITY 0 255 PHYS_UNIT "FTB" /end CHARACTERISTIC
/begin CHARACTERISTIC FCftb_ERWT2_maxv "FCtl_FTB_0x04(234)" VALUE 0x001E5E01 /* @ECU_Address@FCtl_FTB_0x04@0x024C50EA@ */ ECIPP_ALIGNMENT_UBYTE 255 Compu_IDENTITY 0 255 PHYS_UNIT "FTB" /end CHARACTERISTIC
/begin CHARACTERISTIC FCftb_ERWT2_minv "FCtl_FTB_0x04(236)" VALUE 0x001E5E03 /* @ECU_Address@FCtl_FTB_0x04@0x024C50EC@ */ ECIPP_ALIGNMENT_UBYTE 255 Compu_IDENTITY 0 255 PHYS_UNIT "FTB" /end CHARACTERISTIC
/begin CHARACTERISTIC FCftb_GLOW10_open "FCtl_FTB_0x04(492)" VALUE 0x001E5F03 /* @ECU_Address@FCtl_FTB_0x04@0x024C51EC@ */ ECIPP_ALIGNMENT_UBYTE 255 Compu_IDENTITY 0 255 PHYS_UNIT "FTB" /end CHARACTERISTIC
/begin CHARACTERISTIC FCftb_GLOW10_short "FCtl_FTB_0x04(502)" VALUE 0x001E5F0D /* @ECU_Address@FCtl_FTB_0x04@0x024C51F6@ */ ECIPP_ALIGNMENT_UBYTE 255 Compu_IDENTITY 0 255 PHYS_UNIT "FTB" /end CHARACTERISTIC
/begin CHARACTERISTIC FCftb_GLOW11_open "FCtl_FTB_0x04(1033)" VALUE 0x001E6120 /* @ECU_Address@FCtl_FTB_0x04@0x024C5409@ */ ECIPP_ALIGNMENT_UBYTE 255 Compu_IDENTITY 0 255 PHYS_UNIT "FTB" /end CHARACTERISTIC
/begin CHARACTERISTIC FCftb_GLOW11_short "FCtl_FTB_0x04(1035)" VALUE 0x001E6122 /* @ECU_Address@FCtl_FTB_0x04@0x024C540B@ */ ECIPP_ALIGNMENT_UBYTE 255 Compu_IDENTITY 0 255 PHYS_UNIT "FTB" /end CHARACTERISTIC
/begin CHARACTERISTIC FCftb_GLOW12_open "FCtl_FTB_0x04(1034)" VALUE 0x001E6121 /* @ECU_Address@FCtl_FTB_0x04@0x024C540A@ */ ECIPP_ALIGNMENT_UBYTE 255 Compu_IDENTITY 0 255 PHYS_UNIT "FTB" /end CHARACTERISTIC
/begin CHARACTERISTIC FCftb_GLOW12_short "FCtl_FTB_0x04(1036)" VALUE 0x001E6123 /* @ECU_Address@FCtl_FTB_0x04@0x024C540C@ */ ECIPP_ALIGNMENT_UBYTE 255 Compu_IDENTITY 0 255 PHYS_UNIT "FTB" /end CHARACTERISTIC
/begin CHARACTERISTIC FCftb_GLOW2_open "FCtl_FTB_0x04(484)" VALUE 0x001E5EFB /* @ECU_Address@FCtl_FTB_0x04@0x024C51E4@ */ ECIPP_ALIGNMENT_UBYTE 255 Compu_IDENTITY 0 255 PHYS_UNIT "FTB" /end CHARACTERISTIC
/begin CHARACTERISTIC FCftb_GLOW2_short "FCtl_FTB_0x04(494)" VALUE 0x001E5F05 /* @ECU_Address@FCtl_FTB_0x04@0x024C51EE@ */ ECIPP_ALIGNMENT_UBYTE 255 Compu_IDENTITY 0 255 PHYS_UNIT "FTB" /end CHARACTERISTIC
/begin CHARACTERISTIC FCftb_GLOW3_open "FCtl_FTB_0x04(485)" VALUE 0x001E5EFC /* @ECU_Address@FCtl_FTB_0x04@0x024C51E5@ */ ECIPP_ALIGNMENT_UBYTE 255 Compu_IDENTITY 0 255 PHYS_UNIT "FTB" /end CHARACTERISTIC
/begin CHARACTERISTIC FCftb_GLOW3_short "FCtl_FTB_0x04(495)" VALUE 0x001E5F06 /* @ECU_Address@FCtl_FTB_0x04@0x024C51EF@ */ ECIPP_ALIGNMENT_UBYTE 255 Compu_IDENTITY 0 255 PHYS_UNIT "FTB" /end CHARACTERISTIC
/begin CHARACTERISTIC FCftb_GLOW4_open "FCtl_FTB_0x04(486)" VALUE 0x001E5EFD /* @ECU_Address@FCtl_FTB_0x04@0x024C51E6@ */ ECIPP_ALIGNMENT_UBYTE 255 Compu_IDENTITY 0 255 PHYS_UNIT "FTB" /end CHARACTERISTIC
/begin CHARACTERISTIC FCftb_GLOW4_short "FCtl_FTB_0x04(496)" VALUE 0x001E5F07 /* @ECU_Address@FCtl_FTB_0x04@0x024C51F0@ */ ECIPP_ALIGNMENT_UBYTE 255 Compu_IDENTITY 0 255 PHYS_UNIT "FTB" /end CHARACTERISTIC
/begin CHARACTERISTIC FCftb_GLOW5_open "FCtl_FTB_0x04(487)" VALUE 0x001E5EFE /* @ECU_Address@FCtl_FTB_0x04@0x024C51E7@ */ ECIPP_ALIGNMENT_UBYTE 255 Compu_IDENTITY 0 255 PHYS_UNIT "FTB" /end CHARACTERISTIC
/begin CHARACTERISTIC FCftb_GLOW5_short "FCtl_FTB_0x04(497)" VALUE 0x001E5F08 /* @ECU_Address@FCtl_FTB_0x04@0x024C51F1@ */ ECIPP_ALIGNMENT_UBYTE 255 Compu_IDENTITY 0 255 PHYS_UNIT "FTB" /end CHARACTERISTIC
/begin CHARACTERISTIC FCftb_GLOW6_open "FCtl_FTB_0x04(488)" VALUE 0x001E5EFF /* @ECU_Address@FCtl_FTB_0x04@0x024C51E8@ */ ECIPP_ALIGNMENT_UBYTE 255 Compu_IDENTITY 0 255 PHYS_UNIT "FTB" /end CHARACTERISTIC
/begin CHARACTERISTIC FCftb_GLOW6_short "FCtl_FTB_0x04(498)" VALUE 0x001E5F09 /* @ECU_Address@FCtl_FTB_0x04@0x024C51F2@ */ ECIPP_ALIGNMENT_UBYTE 255 Compu_IDENTITY 0 255 PHYS_UNIT "FTB" /end CHARACTERISTIC
/begin CHARACTERISTIC FCftb_GLOW7_open "FCtl_FTB_0x04(489)" VALUE 0x001E5F00 /* @ECU_Address@FCtl_FTB_0x04@0x024C51E9@ */ ECIPP_ALIGNMENT_UBYTE 255 Compu_IDENTITY 0 255 PHYS_UNIT "FTB" /end CHARACTERISTIC
/begin CHARACTERISTIC FCftb_GLOW7_short "FCtl_FTB_0x04(499)" VALUE 0x001E5F0A /* @ECU_Address@FCtl_FTB_0x04@0x024C51F3@ */ ECIPP_ALIGNMENT_UBYTE 255 Compu_IDENTITY 0 255 PHYS_UNIT "FTB" /end CHARACTERISTIC
/begin CHARACTERISTIC FCftb_GLOW8_open "FCtl_FTB_0x04(490)" VALUE 0x001E5F01 /* @ECU_Address@FCtl_FTB_0x04@0x024C51EA@ */ ECIPP_ALIGNMENT_UBYTE 255 Compu_IDENTITY 0 255 PHYS_UNIT "FTB" /end CHARACTERISTIC
/begin CHARACTERISTIC FCftb_GLOW8_short "FCtl_FTB_0x04(500)" VALUE 0x001E5F0B /* @ECU_Address@FCtl_FTB_0x04@0x024C51F4@ */ ECIPP_ALIGNMENT_UBYTE 255 Compu_IDENTITY 0 255 PHYS_UNIT "FTB" /end CHARACTERISTIC
/begin CHARACTERISTIC FCftb_GLOW9_open "FCtl_FTB_0x04(491)" VALUE 0x001E5F02 /* @ECU_Address@FCtl_FTB_0x04@0x024C51EB@ */ ECIPP_ALIGNMENT_UBYTE 255 Compu_IDENTITY 0 255 PHYS_UNIT "FTB" /end CHARACTERISTIC
/begin CHARACTERISTIC FCftb_GLOW9_short "FCtl_FTB_0x04(501)" VALUE 0x001E5F0C /* @ECU_Address@FCtl_FTB_0x04@0x024C51F5@ */ ECIPP_ALIGNMENT_UBYTE 255 Compu_IDENTITY 0 255 PHYS_UNIT "FTB" /end CHARACTERISTIC
/begin CHARACTERISTIC FCftb_ICAVD10_mis "FCtl_FTB_0x04(315)" VALUE 0x001E5E52 /* @ECU_Address@FCtl_FTB_0x04@0x024C513B@ */ ECIPP_ALIGNMENT_UBYTE 255 Compu_IDENTITY 0 255 PHYS_UNIT "FTB" /end CHARACTERISTIC
/begin CHARACTERISTIC FCftb_ICAVD10_miscat "FCtl_FTB_0x04(317)" VALUE 0x001E5E54 /* @ECU_Address@FCtl_FTB_0x04@0x024C513D@ */ ECIPP_ALIGNMENT_UBYTE 255 Compu_IDENTITY 0 255 PHYS_UNIT "FTB" /end CHARACTERISTIC
/begin CHARACTERISTIC FCftb_ICAVD11_mis "FCtl_FTB_0x04(1029)" VALUE 0x001E611C /* @ECU_Address@FCtl_FTB_0x04@0x024C5405@ */ ECIPP_ALIGNMENT_UBYTE 255 Compu_IDENTITY 0 255 PHYS_UNIT "FTB" /end CHARACTERISTIC
/begin CHARACTERISTIC FCftb_ICAVD11_miscat "FCtl_FTB_0x04(1031)" VALUE 0x001E611E /* @ECU_Address@FCtl_FTB_0x04@0x024C5407@ */ ECIPP_ALIGNMENT_UBYTE 255 Compu_IDENTITY 0 255 PHYS_UNIT "FTB" /end CHARACTERISTIC
/begin CHARACTERISTIC FCftb_ICAVD12_mis "FCtl_FTB_0x04(1030)" VALUE 0x001E611D /* @ECU_Address@FCtl_FTB_0x04@0x024C5406@ */ ECIPP_ALIGNMENT_UBYTE 255 Compu_IDENTITY 0 255 PHYS_UNIT "FTB" /end CHARACTERISTIC
/begin CHARACTERISTIC FCftb_ICAVD12_miscat "FCtl_FTB_0x04(1032)" VALUE 0x001E611F /* @ECU_Address@FCtl_FTB_0x04@0x024C5408@ */ ECIPP_ALIGNMENT_UBYTE 255 Compu_IDENTITY 0 255 PHYS_UNIT "FTB" /end CHARACTERISTIC
/begin CHARACTERISTIC FCftb_ICAVD2_mis "FCtl_FTB_0x04(260)" VALUE 0x001E5E1B /* @ECU_Address@FCtl_FTB_0x04@0x024C5104@ */ ECIPP_ALIGNMENT_UBYTE 255 Compu_IDENTITY 0 255 PHYS_UNIT "FTB" /end CHARACTERISTIC
/begin CHARACTERISTIC FCftb_ICAVD2_miscat "FCtl_FTB_0x04(268)" VALUE 0x001E5E23 /* @ECU_Address@FCtl_FTB_0x04@0x024C510C@ */ ECIPP_ALIGNMENT_UBYTE 255 Compu_IDENTITY 0 255 PHYS_UNIT "FTB" /end CHARACTERISTIC
/begin CHARACTERISTIC FCftb_ICAVD3_mis "FCtl_FTB_0x04(261)" VALUE 0x001E5E1C /* @ECU_Address@FCtl_FTB_0x04@0x024C5105@ */ ECIPP_ALIGNMENT_UBYTE 255 Compu_IDENTITY 0 255 PHYS_UNIT "FTB" /end CHARACTERISTIC
/begin CHARACTERISTIC FCftb_ICAVD3_miscat "FCtl_FTB_0x04(269)" VALUE 0x001E5E24 /* @ECU_Address@FCtl_FTB_0x04@0x024C510D@ */ ECIPP_ALIGNMENT_UBYTE 255 Compu_IDENTITY 0 255 PHYS_UNIT "FTB" /end CHARACTERISTIC
/begin CHARACTERISTIC FCftb_ICAVD4_mis "FCtl_FTB_0x04(262)" VALUE 0x001E5E1D /* @ECU_Address@FCtl_FTB_0x04@0x024C5106@ */ ECIPP_ALIGNMENT_UBYTE 255 Compu_IDENTITY 0 255 PHYS_UNIT "FTB" /end CHARACTERISTIC
/begin CHARACTERISTIC FCftb_ICAVD4_miscat "FCtl_FTB_0x04(270)" VALUE 0x001E5E25 /* @ECU_Address@FCtl_FTB_0x04@0x024C510E@ */ ECIPP_ALIGNMENT_UBYTE 255 Compu_IDENTITY 0 255 PHYS_UNIT "FTB" /end CHARACTERISTIC
/begin CHARACTERISTIC FCftb_ICAVD5_mis "FCtl_FTB_0x04(263)" VALUE 0x001E5E1E /* @ECU_Address@FCtl_FTB_0x04@0x024C5107@ */ ECIPP_ALIGNMENT_UBYTE 255 Compu_IDENTITY 0 255 PHYS_UNIT "FTB" /end CHARACTERISTIC
/begin CHARACTERISTIC FCftb_ICAVD5_miscat "FCtl_FTB_0x04(271)" VALUE 0x001E5E26 /* @ECU_Address@FCtl_FTB_0x04@0x024C510F@ */ ECIPP_ALIGNMENT_UBYTE 255 Compu_IDENTITY 0 255 PHYS_UNIT "FTB" /end CHARACTERISTIC
/begin CHARACTERISTIC FCftb_ICAVD6_mis "FCtl_FTB_0x04(264)" VALUE 0x001E5E1F /* @ECU_Address@FCtl_FTB_0x04@0x024C5108@ */ ECIPP_ALIGNMENT_UBYTE 255 Compu_IDENTITY 0 255 PHYS_UNIT "FTB" /end CHARACTERISTIC
/begin CHARACTERISTIC FCftb_ICAVD6_miscat "FCtl_FTB_0x04(272)" VALUE 0x001E5E27 /* @ECU_Address@FCtl_FTB_0x04@0x024C5110@ */ ECIPP_ALIGNMENT_UBYTE 255 Compu_IDENTITY 0 255 PHYS_UNIT "FTB" /end CHARACTERISTIC
/begin CHARACTERISTIC FCftb_ICAVD7_mis "FCtl_FTB_0x04(265)" VALUE 0x001E5E20 /* @ECU_Address@FCtl_FTB_0x04@0x024C5109@ */ ECIPP_ALIGNMENT_UBYTE 255 Compu_IDENTITY 0 255 PHYS_UNIT "FTB" /end CHARACTERISTIC
/begin CHARACTERISTIC FCftb_ICAVD7_miscat "FCtl_FTB_0x04(273)" VALUE 0x001E5E28 /* @ECU_Address@FCtl_FTB_0x04@0x024C5111@ */ ECIPP_ALIGNMENT_UBYTE 255 Compu_IDENTITY 0 255 PHYS_UNIT "FTB" /end CHARACTERISTIC
/begin CHARACTERISTIC FCftb_ICAVD8_mis "FCtl_FTB_0x04(266)" VALUE 0x001E5E21 /* @ECU_Address@FCtl_FTB_0x04@0x024C510A@ */ ECIPP_ALIGNMENT_UBYTE 255 Compu_IDENTITY 0 255 PHYS_UNIT "FTB" /end CHARACTERISTIC
/begin CHARACTERISTIC FCftb_ICAVD8_miscat "FCtl_FTB_0x04(274)" VALUE 0x001E5E29 /* @ECU_Address@FCtl_FTB_0x04@0x024C5112@ */ ECIPP_ALIGNMENT_UBYTE 255 Compu_IDENTITY 0 255 PHYS_UNIT "FTB" /end CHARACTERISTIC
/begin CHARACTERISTIC FCftb_ICAVD9_mis "FCtl_FTB_0x04(314)" VALUE 0x001E5E51 /* @ECU_Address@FCtl_FTB_0x04@0x024C513A@ */ ECIPP_ALIGNMENT_UBYTE 255 Compu_IDENTITY 0 255 PHYS_UNIT "FTB" /end CHARACTERISTIC
/begin CHARACTERISTIC FCftb_ICAVD9_miscat "FCtl_FTB_0x04(316)" VALUE 0x001E5E53 /* @ECU_Address@FCtl_FTB_0x04@0x024C513C@ */ ECIPP_ALIGNMENT_UBYTE 255 Compu_IDENTITY 0 255 PHYS_UNIT "FTB" /end CHARACTERISTIC
/begin CHARACTERISTIC FCftb_INJD10_off_lo "FCtl_FTB_0x04(55)" VALUE 0x001E5D4E /* @ECU_Address@FCtl_FTB_0x04@0x024C5037@ */ ECIPP_ALIGNMENT_UBYTE 255 Compu_IDENTITY 0 255 PHYS_UNIT "FTB" /end CHARACTERISTIC
/begin CHARACTERISTIC FCftb_INJD10_on_hi "FCtl_FTB_0x04(65)" VALUE 0x001E5D58 /* @ECU_Address@FCtl_FTB_0x04@0x024C5041@ */ ECIPP_ALIGNMENT_UBYTE 255 Compu_IDENTITY 0 255 PHYS_UNIT "FTB" /end CHARACTERISTIC
/begin CHARACTERISTIC FCftb_INJD11_off_lo "FCtl_FTB_0x04(1017)" VALUE 0x001E6110 /* @ECU_Address@FCtl_FTB_0x04@0x024C53F9@ */ ECIPP_ALIGNMENT_UBYTE 255 Compu_IDENTITY 0 255 PHYS_UNIT "FTB" /end CHARACTERISTIC
/begin CHARACTERISTIC FCftb_INJD11_on_hi "FCtl_FTB_0x04(1019)" VALUE 0x001E6112 /* @ECU_Address@FCtl_FTB_0x04@0x024C53FB@ */ ECIPP_ALIGNMENT_UBYTE 255 Compu_IDENTITY 0 255 PHYS_UNIT "FTB" /end CHARACTERISTIC
/begin CHARACTERISTIC FCftb_INJD12_off_lo "FCtl_FTB_0x04(1018)" VALUE 0x001E6111 /* @ECU_Address@FCtl_FTB_0x04@0x024C53FA@ */ ECIPP_ALIGNMENT_UBYTE 255 Compu_IDENTITY 0 255 PHYS_UNIT "FTB" /end CHARACTERISTIC
/begin CHARACTERISTIC FCftb_INJD12_on_hi "FCtl_FTB_0x04(1020)" VALUE 0x001E6113 /* @ECU_Address@FCtl_FTB_0x04@0x024C53FC@ */ ECIPP_ALIGNMENT_UBYTE 255 Compu_IDENTITY 0 255 PHYS_UNIT "FTB" /end CHARACTERISTIC
/begin CHARACTERISTIC FCftb_INJD2_boost_lo "FCtl_FTB_0x04(579)" VALUE 0x001E5F5A /* @ECU_Address@FCtl_FTB_0x04@0x024C5243@ */ ECIPP_ALIGNMENT_UBYTE 255 Compu_IDENTITY 0 255 PHYS_UNIT "FTB" /end CHARACTERISTIC
/begin CHARACTERISTIC FCftb_INJD2_HS_Ihi "FCtl_FTB_0x04(563)" VALUE 0x001E5F4A /* @ECU_Address@FCtl_FTB_0x04@0x024C5233@ */ ECIPP_ALIGNMENT_UBYTE 255 Compu_IDENTITY 0 255 PHYS_UNIT "FTB" /end CHARACTERISTIC
/begin CHARACTERISTIC FCftb_INJD2_HW_int "FCtl_FTB_0x04(581)" VALUE 0x001E5F5C /* @ECU_Address@FCtl_FTB_0x04@0x024C5245@ */ ECIPP_ALIGNMENT_UBYTE 255 Compu_IDENTITY 0 255 PHYS_UNIT "FTB" /end CHARACTERISTIC
/begin CHARACTERISTIC FCftb_INJD2_LS_Ihi "FCtl_FTB_0x04(571)" VALUE 0x001E5F52 /* @ECU_Address@FCtl_FTB_0x04@0x024C523B@ */ ECIPP_ALIGNMENT_UBYTE 255 Compu_IDENTITY 0 255 PHYS_UNIT "FTB" /end CHARACTERISTIC
/begin CHARACTERISTIC FCftb_INJD2_off_lo "FCtl_FTB_0x04(47)" VALUE 0x001E5D46 /* @ECU_Address@FCtl_FTB_0x04@0x024C502F@ */ ECIPP_ALIGNMENT_UBYTE 255 Compu_IDENTITY 0 255 PHYS_UNIT "FTB" /end CHARACTERISTIC
/begin CHARACTERISTIC FCftb_INJD2_on_hi "FCtl_FTB_0x04(57)" VALUE 0x001E5D50 /* @ECU_Address@FCtl_FTB_0x04@0x024C5039@ */ ECIPP_ALIGNMENT_UBYTE 255 Compu_IDENTITY 0 255 PHYS_UNIT "FTB" /end CHARACTERISTIC
/begin CHARACTERISTIC FCftb_INJD3_HS_Ihi "FCtl_FTB_0x04(564)" VALUE 0x001E5F4B /* @ECU_Address@FCtl_FTB_0x04@0x024C5234@ */ ECIPP_ALIGNMENT_UBYTE 255 Compu_IDENTITY 0 255 PHYS_UNIT "FTB" /end CHARACTERISTIC
/begin CHARACTERISTIC FCftb_INJD3_LS_Ihi "FCtl_FTB_0x04(572)" VALUE 0x001E5F53 /* @ECU_Address@FCtl_FTB_0x04@0x024C523C@ */ ECIPP_ALIGNMENT_UBYTE 255 Compu_IDENTITY 0 255 PHYS_UNIT "FTB" /end CHARACTERISTIC
/begin CHARACTERISTIC FCftb_INJD3_off_lo "FCtl_FTB_0x04(48)" VALUE 0x001E5D47 /* @ECU_Address@FCtl_FTB_0x04@0x024C5030@ */ ECIPP_ALIGNMENT_UBYTE 255 Compu_IDENTITY 0 255 PHYS_UNIT "FTB" /end CHARACTERISTIC
/begin CHARACTERISTIC FCftb_INJD3_on_hi "FCtl_FTB_0x04(58)" VALUE 0x001E5D51 /* @ECU_Address@FCtl_FTB_0x04@0x024C503A@ */ ECIPP_ALIGNMENT_UBYTE 255 Compu_IDENTITY 0 255 PHYS_UNIT "FTB" /end CHARACTERISTIC
/begin CHARACTERISTIC FCftb_INJD4_HS_Ihi "FCtl_FTB_0x04(565)" VALUE 0x001E5F4C /* @ECU_Address@FCtl_FTB_0x04@0x024C5235@ */ ECIPP_ALIGNMENT_UBYTE 255 Compu_IDENTITY 0 255 PHYS_UNIT "FTB" /end CHARACTERISTIC
/begin CHARACTERISTIC FCftb_INJD4_LS_Ihi "FCtl_FTB_0x04(573)" VALUE 0x001E5F54 /* @ECU_Address@FCtl_FTB_0x04@0x024C523D@ */ ECIPP_ALIGNMENT_UBYTE 255 Compu_IDENTITY 0 255 PHYS_UNIT "FTB" /end CHARACTERISTIC
/begin CHARACTERISTIC FCftb_INJD4_off_lo "FCtl_FTB_0x04(49)" VALUE 0x001E5D48 /* @ECU_Address@FCtl_FTB_0x04@0x024C5031@ */ ECIPP_ALIGNMENT_UBYTE 255 Compu_IDENTITY 0 255 PHYS_UNIT "FTB" /end CHARACTERISTIC
/begin CHARACTERISTIC FCftb_INJD4_on_hi "FCtl_FTB_0x04(59)" VALUE 0x001E5D52 /* @ECU_Address@FCtl_FTB_0x04@0x024C503B@ */ ECIPP_ALIGNMENT_UBYTE 255 Compu_IDENTITY 0 255 PHYS_UNIT "FTB" /end CHARACTERISTIC
/begin CHARACTERISTIC FCftb_INJD5_HS_Ihi "FCtl_FTB_0x04(566)" VALUE 0x001E5F4D /* @ECU_Address@FCtl_FTB_0x04@0x024C5236@ */ ECIPP_ALIGNMENT_UBYTE 255 Compu_IDENTITY 0 255 PHYS_UNIT "FTB" /end CHARACTERISTIC
/begin CHARACTERISTIC FCftb_INJD5_LS_Ihi "FCtl_FTB_0x04(574)" VALUE 0x001E5F55 /* @ECU_Address@FCtl_FTB_0x04@0x024C523E@ */ ECIPP_ALIGNMENT_UBYTE 255 Compu_IDENTITY 0 255 PHYS_UNIT "FTB" /end CHARACTERISTIC
/begin CHARACTERISTIC FCftb_INJD5_off_lo "FCtl_FTB_0x04(50)" VALUE 0x001E5D49 /* @ECU_Address@FCtl_FTB_0x04@0x024C5032@ */ ECIPP_ALIGNMENT_UBYTE 255 Compu_IDENTITY 0 255 PHYS_UNIT "FTB" /end CHARACTERISTIC
/begin CHARACTERISTIC FCftb_INJD5_on_hi "FCtl_FTB_0x04(60)" VALUE 0x001E5D53 /* @ECU_Address@FCtl_FTB_0x04@0x024C503C@ */ ECIPP_ALIGNMENT_UBYTE 255 Compu_IDENTITY 0 255 PHYS_UNIT "FTB" /end CHARACTERISTIC
/begin CHARACTERISTIC FCftb_INJD6_HS_Ihi "FCtl_FTB_0x04(567)" VALUE 0x001E5F4E /* @ECU_Address@FCtl_FTB_0x04@0x024C5237@ */ ECIPP_ALIGNMENT_UBYTE 255 Compu_IDENTITY 0 255 PHYS_UNIT "FTB" /end CHARACTERISTIC
/begin CHARACTERISTIC FCftb_INJD6_LS_Ihi "FCtl_FTB_0x04(575)" VALUE 0x001E5F56 /* @ECU_Address@FCtl_FTB_0x04@0x024C523F@ */ ECIPP_ALIGNMENT_UBYTE 255 Compu_IDENTITY 0 255 PHYS_UNIT "FTB" /end CHARACTERISTIC
/begin CHARACTERISTIC FCftb_INJD6_off_lo "FCtl_FTB_0x04(51)" VALUE 0x001E5D4A /* @ECU_Address@FCtl_FTB_0x04@0x024C5033@ */ ECIPP_ALIGNMENT_UBYTE 255 Compu_IDENTITY 0 255 PHYS_UNIT "FTB" /end CHARACTERISTIC
/begin CHARACTERISTIC FCftb_INJD6_on_hi "FCtl_FTB_0x04(61)" VALUE 0x001E5D54 /* @ECU_Address@FCtl_FTB_0x04@0x024C503D@ */ ECIPP_ALIGNMENT_UBYTE 255 Compu_IDENTITY 0 255 PHYS_UNIT "FTB" /end CHARACTERISTIC
/begin CHARACTERISTIC FCftb_INJD7_HS_Ihi "FCtl_FTB_0x04(568)" VALUE 0x001E5F4F /* @ECU_Address@FCtl_FTB_0x04@0x024C5238@ */ ECIPP_ALIGNMENT_UBYTE 255 Compu_IDENTITY 0 255 PHYS_UNIT "FTB" /end CHARACTERISTIC
/begin CHARACTERISTIC FCftb_INJD7_LS_Ihi "FCtl_FTB_0x04(576)" VALUE 0x001E5F57 /* @ECU_Address@FCtl_FTB_0x04@0x024C5240@ */ ECIPP_ALIGNMENT_UBYTE 255 Compu_IDENTITY 0 255 PHYS_UNIT "FTB" /end CHARACTERISTIC
/begin CHARACTERISTIC FCftb_INJD7_off_lo "FCtl_FTB_0x04(52)" VALUE 0x001E5D4B /* @ECU_Address@FCtl_FTB_0x04@0x024C5034@ */ ECIPP_ALIGNMENT_UBYTE 255 Compu_IDENTITY 0 255 PHYS_UNIT "FTB" /end CHARACTERISTIC
/begin CHARACTERISTIC FCftb_INJD7_on_hi "FCtl_FTB_0x04(62)" VALUE 0x001E5D55 /* @ECU_Address@FCtl_FTB_0x04@0x024C503E@ */ ECIPP_ALIGNMENT_UBYTE 255 Compu_IDENTITY 0 255 PHYS_UNIT "FTB" /end CHARACTERISTIC
/begin CHARACTERISTIC FCftb_INJD8_HS_Ihi "FCtl_FTB_0x04(569)" VALUE 0x001E5F50 /* @ECU_Address@FCtl_FTB_0x04@0x024C5239@ */ ECIPP_ALIGNMENT_UBYTE 255 Compu_IDENTITY 0 255 PHYS_UNIT "FTB" /end CHARACTERISTIC
/begin CHARACTERISTIC FCftb_INJD8_LS_Ihi "FCtl_FTB_0x04(577)" VALUE 0x001E5F58 /* @ECU_Address@FCtl_FTB_0x04@0x024C5241@ */ ECIPP_ALIGNMENT_UBYTE 255 Compu_IDENTITY 0 255 PHYS_UNIT "FTB" /end CHARACTERISTIC
/begin CHARACTERISTIC FCftb_INJD8_off_lo "FCtl_FTB_0x04(53)" VALUE 0x001E5D4C /* @ECU_Address@FCtl_FTB_0x04@0x024C5035@ */ ECIPP_ALIGNMENT_UBYTE 255 Compu_IDENTITY 0 255 PHYS_UNIT "FTB" /end CHARACTERISTIC
/begin CHARACTERISTIC FCftb_INJD8_on_hi "FCtl_FTB_0x04(63)" VALUE 0x001E5D56 /* @ECU_Address@FCtl_FTB_0x04@0x024C503F@ */ ECIPP_ALIGNMENT_UBYTE 255 Compu_IDENTITY 0 255 PHYS_UNIT "FTB" /end CHARACTERISTIC
/begin CHARACTERISTIC FCftb_INJD9_off_lo "FCtl_FTB_0x04(54)" VALUE 0x001E5D4D /* @ECU_Address@FCtl_FTB_0x04@0x024C5036@ */ ECIPP_ALIGNMENT_UBYTE 255 Compu_IDENTITY 0 255 PHYS_UNIT "FTB" /end CHARACTERISTIC
/begin CHARACTERISTIC FCftb_INJD9_on_hi "FCtl_FTB_0x04(64)" VALUE 0x001E5D57 /* @ECU_Address@FCtl_FTB_0x04@0x024C5040@ */ ECIPP_ALIGNMENT_UBYTE 255 Compu_IDENTITY 0 255 PHYS_UNIT "FTB" /end CHARACTERISTIC
/begin CHARACTERISTIC FCftb_KNK10_max "FCtl_FTB_0x04(1012)" VALUE 0x001E610B /* @ECU_Address@FCtl_FTB_0x04@0x024C53F4@ */ ECIPP_ALIGNMENT_UBYTE 255 Compu_IDENTITY 0 255 PHYS_UNIT "FTB" /end CHARACTERISTIC
/begin CHARACTERISTIC FCftb_KNK10_min "FCtl_FTB_0x04(1003)" VALUE 0x001E6102 /* @ECU_Address@FCtl_FTB_0x04@0x024C53EB@ */ ECIPP_ALIGNMENT_UBYTE 255 Compu_IDENTITY 0 255 PHYS_UNIT "FTB" /end CHARACTERISTIC
/begin CHARACTERISTIC FCftb_KNK11_max "FCtl_FTB_0x04(1013)" VALUE 0x001E610C /* @ECU_Address@FCtl_FTB_0x04@0x024C53F5@ */ ECIPP_ALIGNMENT_UBYTE 255 Compu_IDENTITY 0 255 PHYS_UNIT "FTB" /end CHARACTERISTIC
/begin CHARACTERISTIC FCftb_KNK11_min "FCtl_FTB_0x04(1004)" VALUE 0x001E6103 /* @ECU_Address@FCtl_FTB_0x04@0x024C53EC@ */ ECIPP_ALIGNMENT_UBYTE 255 Compu_IDENTITY 0 255 PHYS_UNIT "FTB" /end CHARACTERISTIC
/begin CHARACTERISTIC FCftb_KNK12_max "FCtl_FTB_0x04(1014)" VALUE 0x001E610D /* @ECU_Address@FCtl_FTB_0x04@0x024C53F6@ */ ECIPP_ALIGNMENT_UBYTE 255 Compu_IDENTITY 0 255 PHYS_UNIT "FTB" /end CHARACTERISTIC
/begin CHARACTERISTIC FCftb_KNK12_min "FCtl_FTB_0x04(1005)" VALUE 0x001E6104 /* @ECU_Address@FCtl_FTB_0x04@0x024C53ED@ */ ECIPP_ALIGNMENT_UBYTE 255 Compu_IDENTITY 0 255 PHYS_UNIT "FTB" /end CHARACTERISTIC
/begin CHARACTERISTIC FCftb_KNK2_max "FCtl_FTB_0x04(185)" VALUE 0x001E5DD0 /* @ECU_Address@FCtl_FTB_0x04@0x024C50B9@ */ ECIPP_ALIGNMENT_UBYTE 255 Compu_IDENTITY 0 255 PHYS_UNIT "FTB" /end CHARACTERISTIC
/begin CHARACTERISTIC FCftb_KNK2_min "FCtl_FTB_0x04(184)" VALUE 0x001E5DCF /* @ECU_Address@FCtl_FTB_0x04@0x024C50B8@ */ ECIPP_ALIGNMENT_UBYTE 255 Compu_IDENTITY 0 255 PHYS_UNIT "FTB" /end CHARACTERISTIC
/begin CHARACTERISTIC FCftb_KNK3_max "FCtl_FTB_0x04(806)" VALUE 0x001E603D /* @ECU_Address@FCtl_FTB_0x04@0x024C5326@ */ ECIPP_ALIGNMENT_UBYTE 255 Compu_IDENTITY 0 255 PHYS_UNIT "FTB" /end CHARACTERISTIC
/begin CHARACTERISTIC FCftb_KNK3_min "FCtl_FTB_0x04(805)" VALUE 0x001E603C /* @ECU_Address@FCtl_FTB_0x04@0x024C5325@ */ ECIPP_ALIGNMENT_UBYTE 255 Compu_IDENTITY 0 255 PHYS_UNIT "FTB" /end CHARACTERISTIC
/begin CHARACTERISTIC FCftb_KNK4_max "FCtl_FTB_0x04(1006)" VALUE 0x001E6105 /* @ECU_Address@FCtl_FTB_0x04@0x024C53EE@ */ ECIPP_ALIGNMENT_UBYTE 255 Compu_IDENTITY 0 255 PHYS_UNIT "FTB" /end CHARACTERISTIC
/begin CHARACTERISTIC FCftb_KNK4_min "FCtl_FTB_0x04(997)" VALUE 0x001E60FC /* @ECU_Address@FCtl_FTB_0x04@0x024C53E5@ */ ECIPP_ALIGNMENT_UBYTE 255 Compu_IDENTITY 0 255 PHYS_UNIT "FTB" /end CHARACTERISTIC
/begin CHARACTERISTIC FCftb_KNK5_max "FCtl_FTB_0x04(1007)" VALUE 0x001E6106 /* @ECU_Address@FCtl_FTB_0x04@0x024C53EF@ */ ECIPP_ALIGNMENT_UBYTE 255 Compu_IDENTITY 0 255 PHYS_UNIT "FTB" /end CHARACTERISTIC
/begin CHARACTERISTIC FCftb_KNK5_min "FCtl_FTB_0x04(998)" VALUE 0x001E60FD /* @ECU_Address@FCtl_FTB_0x04@0x024C53E6@ */ ECIPP_ALIGNMENT_UBYTE 255 Compu_IDENTITY 0 255 PHYS_UNIT "FTB" /end CHARACTERISTIC
/begin CHARACTERISTIC FCftb_KNK6_max "FCtl_FTB_0x04(1008)" VALUE 0x001E6107 /* @ECU_Address@FCtl_FTB_0x04@0x024C53F0@ */ ECIPP_ALIGNMENT_UBYTE 255 Compu_IDENTITY 0 255 PHYS_UNIT "FTB" /end CHARACTERISTIC
/begin CHARACTERISTIC FCftb_KNK6_min "FCtl_FTB_0x04(999)" VALUE 0x001E60FE /* @ECU_Address@FCtl_FTB_0x04@0x024C53E7@ */ ECIPP_ALIGNMENT_UBYTE 255 Compu_IDENTITY 0 255 PHYS_UNIT "FTB" /end CHARACTERISTIC
/begin CHARACTERISTIC FCftb_KNK7_max "FCtl_FTB_0x04(1009)" VALUE 0x001E6108 /* @ECU_Address@FCtl_FTB_0x04@0x024C53F1@ */ ECIPP_ALIGNMENT_UBYTE 255 Compu_IDENTITY 0 255 PHYS_UNIT "FTB" /end CHARACTERISTIC
/begin CHARACTERISTIC FCftb_KNK7_min "FCtl_FTB_0x04(1000)" VALUE 0x001E60FF /* @ECU_Address@FCtl_FTB_0x04@0x024C53E8@ */ ECIPP_ALIGNMENT_UBYTE 255 Compu_IDENTITY 0 255 PHYS_UNIT "FTB" /end CHARACTERISTIC
/begin CHARACTERISTIC FCftb_KNK8_max "FCtl_FTB_0x04(1010)" VALUE 0x001E6109 /* @ECU_Address@FCtl_FTB_0x04@0x024C53F2@ */ ECIPP_ALIGNMENT_UBYTE 255 Compu_IDENTITY 0 255 PHYS_UNIT "FTB" /end CHARACTERISTIC
/begin CHARACTERISTIC FCftb_KNK8_min "FCtl_FTB_0x04(1001)" VALUE 0x001E6100 /* @ECU_Address@FCtl_FTB_0x04@0x024C53E9@ */ ECIPP_ALIGNMENT_UBYTE 255 Compu_IDENTITY 0 255 PHYS_UNIT "FTB" /end CHARACTERISTIC
/begin CHARACTERISTIC FCftb_KNK9_max "FCtl_FTB_0x04(1011)" VALUE 0x001E610A /* @ECU_Address@FCtl_FTB_0x04@0x024C53F3@ */ ECIPP_ALIGNMENT_UBYTE 255 Compu_IDENTITY 0 255 PHYS_UNIT "FTB" /end CHARACTERISTIC
/begin CHARACTERISTIC FCftb_KNK9_min "FCtl_FTB_0x04(1002)" VALUE 0x001E6101 /* @ECU_Address@FCtl_FTB_0x04@0x024C53EA@ */ ECIPP_ALIGNMENT_UBYTE 255 Compu_IDENTITY 0 255 PHYS_UNIT "FTB" /end CHARACTERISTIC
/begin CHARACTERISTIC FCftb_KV10_deltaHi "FCtl_FTB_0x04(970)" VALUE 0x001E60E1 /* @ECU_Address@FCtl_FTB_0x04@0x024C53CA@ */ ECIPP_ALIGNMENT_UBYTE 255 Compu_IDENTITY 0 255 PHYS_UNIT "FTB" /end CHARACTERISTIC
/begin CHARACTERISTIC FCftb_KV10_deltaLo "FCtl_FTB_0x04(982)" VALUE 0x001E60ED /* @ECU_Address@FCtl_FTB_0x04@0x024C53D6@ */ ECIPP_ALIGNMENT_UBYTE 255 Compu_IDENTITY 0 255 PHYS_UNIT "FTB" /end CHARACTERISTIC
/begin CHARACTERISTIC FCftb_KV10_high "FCtl_FTB_0x04(886)" VALUE 0x001E608D /* @ECU_Address@FCtl_FTB_0x04@0x024C5376@ */ ECIPP_ALIGNMENT_UBYTE 255 Compu_IDENTITY 0 255 PHYS_UNIT "FTB" /end CHARACTERISTIC
/begin CHARACTERISTIC FCftb_KV10_low "FCtl_FTB_0x04(898)" VALUE 0x001E6099 /* @ECU_Address@FCtl_FTB_0x04@0x024C5382@ */ ECIPP_ALIGNMENT_UBYTE 255 Compu_IDENTITY 0 255 PHYS_UNIT "FTB" /end CHARACTERISTIC
/begin CHARACTERISTIC FCftb_KV11_deltaHi "FCtl_FTB_0x04(971)" VALUE 0x001E60E2 /* @ECU_Address@FCtl_FTB_0x04@0x024C53CB@ */ ECIPP_ALIGNMENT_UBYTE 255 Compu_IDENTITY 0 255 PHYS_UNIT "FTB" /end CHARACTERISTIC
/begin CHARACTERISTIC FCftb_KV11_deltaLo "FCtl_FTB_0x04(983)" VALUE 0x001E60EE /* @ECU_Address@FCtl_FTB_0x04@0x024C53D7@ */ ECIPP_ALIGNMENT_UBYTE 255 Compu_IDENTITY 0 255 PHYS_UNIT "FTB" /end CHARACTERISTIC
/begin CHARACTERISTIC FCftb_KV11_high "FCtl_FTB_0x04(887)" VALUE 0x001E608E /* @ECU_Address@FCtl_FTB_0x04@0x024C5377@ */ ECIPP_ALIGNMENT_UBYTE 255 Compu_IDENTITY 0 255 PHYS_UNIT "FTB" /end CHARACTERISTIC
/begin CHARACTERISTIC FCftb_KV11_low "FCtl_FTB_0x04(899)" VALUE 0x001E609A /* @ECU_Address@FCtl_FTB_0x04@0x024C5383@ */ ECIPP_ALIGNMENT_UBYTE 255 Compu_IDENTITY 0 255 PHYS_UNIT "FTB" /end CHARACTERISTIC
/begin CHARACTERISTIC FCftb_KV12_deltaHi "FCtl_FTB_0x04(972)" VALUE 0x001E60E3 /* @ECU_Address@FCtl_FTB_0x04@0x024C53CC@ */ ECIPP_ALIGNMENT_UBYTE 255 Compu_IDENTITY 0 255 PHYS_UNIT "FTB" /end CHARACTERISTIC
/begin CHARACTERISTIC FCftb_KV12_deltaLo "FCtl_FTB_0x04(984)" VALUE 0x001E60EF /* @ECU_Address@FCtl_FTB_0x04@0x024C53D8@ */ ECIPP_ALIGNMENT_UBYTE 255 Compu_IDENTITY 0 255 PHYS_UNIT "FTB" /end CHARACTERISTIC
/begin CHARACTERISTIC FCftb_KV12_high "FCtl_FTB_0x04(888)" VALUE 0x001E608F /* @ECU_Address@FCtl_FTB_0x04@0x024C5378@ */ ECIPP_ALIGNMENT_UBYTE 255 Compu_IDENTITY 0 255 PHYS_UNIT "FTB" /end CHARACTERISTIC
/begin CHARACTERISTIC FCftb_KV12_low "FCtl_FTB_0x04(900)" VALUE 0x001E609B /* @ECU_Address@FCtl_FTB_0x04@0x024C5384@ */ ECIPP_ALIGNMENT_UBYTE 255 Compu_IDENTITY 0 255 PHYS_UNIT "FTB" /end CHARACTERISTIC
/begin CHARACTERISTIC FCftb_KV2_deltaHi "FCtl_FTB_0x04(962)" VALUE 0x001E60D9 /* @ECU_Address@FCtl_FTB_0x04@0x024C53C2@ */ ECIPP_ALIGNMENT_UBYTE 255 Compu_IDENTITY 0 255 PHYS_UNIT "FTB" /end CHARACTERISTIC
/begin CHARACTERISTIC FCftb_KV2_deltaLo "FCtl_FTB_0x04(974)" VALUE 0x001E60E5 /* @ECU_Address@FCtl_FTB_0x04@0x024C53CE@ */ ECIPP_ALIGNMENT_UBYTE 255 Compu_IDENTITY 0 255 PHYS_UNIT "FTB" /end CHARACTERISTIC
/begin CHARACTERISTIC FCftb_KV2_high "FCtl_FTB_0x04(878)" VALUE 0x001E6085 /* @ECU_Address@FCtl_FTB_0x04@0x024C536E@ */ ECIPP_ALIGNMENT_UBYTE 255 Compu_IDENTITY 0 255 PHYS_UNIT "FTB" /end CHARACTERISTIC
/begin CHARACTERISTIC FCftb_KV2_low "FCtl_FTB_0x04(890)" VALUE 0x001E6091 /* @ECU_Address@FCtl_FTB_0x04@0x024C537A@ */ ECIPP_ALIGNMENT_UBYTE 255 Compu_IDENTITY 0 255 PHYS_UNIT "FTB" /end CHARACTERISTIC
/begin CHARACTERISTIC FCftb_KV3_deltaHi "FCtl_FTB_0x04(963)" VALUE 0x001E60DA /* @ECU_Address@FCtl_FTB_0x04@0x024C53C3@ */ ECIPP_ALIGNMENT_UBYTE 255 Compu_IDENTITY 0 255 PHYS_UNIT "FTB" /end CHARACTERISTIC
/begin CHARACTERISTIC FCftb_KV3_deltaLo "FCtl_FTB_0x04(975)" VALUE 0x001E60E6 /* @ECU_Address@FCtl_FTB_0x04@0x024C53CF@ */ ECIPP_ALIGNMENT_UBYTE 255 Compu_IDENTITY 0 255 PHYS_UNIT "FTB" /end CHARACTERISTIC
/begin CHARACTERISTIC FCftb_KV3_high "FCtl_FTB_0x04(879)" VALUE 0x001E6086 /* @ECU_Address@FCtl_FTB_0x04@0x024C536F@ */ ECIPP_ALIGNMENT_UBYTE 255 Compu_IDENTITY 0 255 PHYS_UNIT "FTB" /end CHARACTERISTIC
/begin CHARACTERISTIC FCftb_KV3_low "FCtl_FTB_0x04(891)" VALUE 0x001E6092 /* @ECU_Address@FCtl_FTB_0x04@0x024C537B@ */ ECIPP_ALIGNMENT_UBYTE 255 Compu_IDENTITY 0 255 PHYS_UNIT "FTB" /end CHARACTERISTIC
/begin CHARACTERISTIC FCftb_KV4_deltaHi "FCtl_FTB_0x04(964)" VALUE 0x001E60DB /* @ECU_Address@FCtl_FTB_0x04@0x024C53C4@ */ ECIPP_ALIGNMENT_UBYTE 255 Compu_IDENTITY 0 255 PHYS_UNIT "FTB" /end CHARACTERISTIC
/begin CHARACTERISTIC FCftb_KV4_deltaLo "FCtl_FTB_0x04(976)" VALUE 0x001E60E7 /* @ECU_Address@FCtl_FTB_0x04@0x024C53D0@ */ ECIPP_ALIGNMENT_UBYTE 255 Compu_IDENTITY 0 255 PHYS_UNIT "FTB" /end CHARACTERISTIC
/begin CHARACTERISTIC FCftb_KV4_high "FCtl_FTB_0x04(880)" VALUE 0x001E6087 /* @ECU_Address@FCtl_FTB_0x04@0x024C5370@ */ ECIPP_ALIGNMENT_UBYTE 255 Compu_IDENTITY 0 255 PHYS_UNIT "FTB" /end CHARACTERISTIC
/begin CHARACTERISTIC FCftb_KV4_low "FCtl_FTB_0x04(892)" VALUE 0x001E6093 /* @ECU_Address@FCtl_FTB_0x04@0x024C537C@ */ ECIPP_ALIGNMENT_UBYTE 255 Compu_IDENTITY 0 255 PHYS_UNIT "FTB" /end CHARACTERISTIC
/begin CHARACTERISTIC FCftb_KV5_deltaHi "FCtl_FTB_0x04(965)" VALUE 0x001E60DC /* @ECU_Address@FCtl_FTB_0x04@0x024C53C5@ */ ECIPP_ALIGNMENT_UBYTE 255 Compu_IDENTITY 0 255 PHYS_UNIT "FTB" /end CHARACTERISTIC
/begin CHARACTERISTIC FCftb_KV5_deltaLo "FCtl_FTB_0x04(977)" VALUE 0x001E60E8 /* @ECU_Address@FCtl_FTB_0x04@0x024C53D1@ */ ECIPP_ALIGNMENT_UBYTE 255 Compu_IDENTITY 0 255 PHYS_UNIT "FTB" /end CHARACTERISTIC
/begin CHARACTERISTIC FCftb_KV5_high "FCtl_FTB_0x04(881)" VALUE 0x001E6088 /* @ECU_Address@FCtl_FTB_0x04@0x024C5371@ */ ECIPP_ALIGNMENT_UBYTE 255 Compu_IDENTITY 0 255 PHYS_UNIT "FTB" /end CHARACTERISTIC
/begin CHARACTERISTIC FCftb_KV5_low "FCtl_FTB_0x04(893)" VALUE 0x001E6094 /* @ECU_Address@FCtl_FTB_0x04@0x024C537D@ */ ECIPP_ALIGNMENT_UBYTE 255 Compu_IDENTITY 0 255 PHYS_UNIT "FTB" /end CHARACTERISTIC
/begin CHARACTERISTIC FCftb_KV6_deltaHi "FCtl_FTB_0x04(966)" VALUE 0x001E60DD /* @ECU_Address@FCtl_FTB_0x04@0x024C53C6@ */ ECIPP_ALIGNMENT_UBYTE 255 Compu_IDENTITY 0 255 PHYS_UNIT "FTB" /end CHARACTERISTIC
/begin CHARACTERISTIC FCftb_KV6_deltaLo "FCtl_FTB_0x04(978)" VALUE 0x001E60E9 /* @ECU_Address@FCtl_FTB_0x04@0x024C53D2@ */ ECIPP_ALIGNMENT_UBYTE 255 Compu_IDENTITY 0 255 PHYS_UNIT "FTB" /end CHARACTERISTIC
/begin CHARACTERISTIC FCftb_KV6_high "FCtl_FTB_0x04(882)" VALUE 0x001E6089 /* @ECU_Address@FCtl_FTB_0x04@0x024C5372@ */ ECIPP_ALIGNMENT_UBYTE 255 Compu_IDENTITY 0 255 PHYS_UNIT "FTB" /end CHARACTERISTIC
/begin CHARACTERISTIC FCftb_KV6_low "FCtl_FTB_0x04(894)" VALUE 0x001E6095 /* @ECU_Address@FCtl_FTB_0x04@0x024C537E@ */ ECIPP_ALIGNMENT_UBYTE 255 Compu_IDENTITY 0 255 PHYS_UNIT "FTB" /end CHARACTERISTIC
/begin CHARACTERISTIC FCftb_KV7_deltaHi "FCtl_FTB_0x04(967)" VALUE 0x001E60DE /* @ECU_Address@FCtl_FTB_0x04@0x024C53C7@ */ ECIPP_ALIGNMENT_UBYTE 255 Compu_IDENTITY 0 255 PHYS_UNIT "FTB" /end CHARACTERISTIC
/begin CHARACTERISTIC FCftb_KV7_deltaLo "FCtl_FTB_0x04(979)" VALUE 0x001E60EA /* @ECU_Address@FCtl_FTB_0x04@0x024C53D3@ */ ECIPP_ALIGNMENT_UBYTE 255 Compu_IDENTITY 0 255 PHYS_UNIT "FTB" /end CHARACTERISTIC
/begin CHARACTERISTIC FCftb_KV7_high "FCtl_FTB_0x04(883)" VALUE 0x001E608A /* @ECU_Address@FCtl_FTB_0x04@0x024C5373@ */ ECIPP_ALIGNMENT_UBYTE 255 Compu_IDENTITY 0 255 PHYS_UNIT "FTB" /end CHARACTERISTIC
/begin CHARACTERISTIC FCftb_KV7_low "FCtl_FTB_0x04(895)" VALUE 0x001E6096 /* @ECU_Address@FCtl_FTB_0x04@0x024C537F@ */ ECIPP_ALIGNMENT_UBYTE 255 Compu_IDENTITY 0 255 PHYS_UNIT "FTB" /end CHARACTERISTIC
/begin CHARACTERISTIC FCftb_KV8_deltaHi "FCtl_FTB_0x04(968)" VALUE 0x001E60DF /* @ECU_Address@FCtl_FTB_0x04@0x024C53C8@ */ ECIPP_ALIGNMENT_UBYTE 255 Compu_IDENTITY 0 255 PHYS_UNIT "FTB" /end CHARACTERISTIC
/begin CHARACTERISTIC FCftb_KV8_deltaLo "FCtl_FTB_0x04(980)" VALUE 0x001E60EB /* @ECU_Address@FCtl_FTB_0x04@0x024C53D4@ */ ECIPP_ALIGNMENT_UBYTE 255 Compu_IDENTITY 0 255 PHYS_UNIT "FTB" /end CHARACTERISTIC
/begin CHARACTERISTIC FCftb_KV8_high "FCtl_FTB_0x04(884)" VALUE 0x001E608B /* @ECU_Address@FCtl_FTB_0x04@0x024C5374@ */ ECIPP_ALIGNMENT_UBYTE 255 Compu_IDENTITY 0 255 PHYS_UNIT "FTB" /end CHARACTERISTIC
/begin CHARACTERISTIC FCftb_KV8_low "FCtl_FTB_0x04(896)" VALUE 0x001E6097 /* @ECU_Address@FCtl_FTB_0x04@0x024C5380@ */ ECIPP_ALIGNMENT_UBYTE 255 Compu_IDENTITY 0 255 PHYS_UNIT "FTB" /end CHARACTERISTIC
/begin CHARACTERISTIC FCftb_KV9_deltaHi "FCtl_FTB_0x04(969)" VALUE 0x001E60E0 /* @ECU_Address@FCtl_FTB_0x04@0x024C53C9@ */ ECIPP_ALIGNMENT_UBYTE 255 Compu_IDENTITY 0 255 PHYS_UNIT "FTB" /end CHARACTERISTIC
/begin CHARACTERISTIC FCftb_KV9_deltaLo "FCtl_FTB_0x04(981)" VALUE 0x001E60EC /* @ECU_Address@FCtl_FTB_0x04@0x024C53D5@ */ ECIPP_ALIGNMENT_UBYTE 255 Compu_IDENTITY 0 255 PHYS_UNIT "FTB" /end CHARACTERISTIC
/begin CHARACTERISTIC FCftb_KV9_high "FCtl_FTB_0x04(885)" VALUE 0x001E608C /* @ECU_Address@FCtl_FTB_0x04@0x024C5375@ */ ECIPP_ALIGNMENT_UBYTE 255 Compu_IDENTITY 0 255 PHYS_UNIT "FTB" /end CHARACTERISTIC
/begin CHARACTERISTIC FCftb_KV9_low "FCtl_FTB_0x04(897)" VALUE 0x001E6098 /* @ECU_Address@FCtl_FTB_0x04@0x024C5381@ */ ECIPP_ALIGNMENT_UBYTE 255 Compu_IDENTITY 0 255 PHYS_UNIT "FTB" /end CHARACTERISTIC
/begin CHARACTERISTIC FCftb_Pri10_open "FCtl_FTB_0x04(910)" VALUE 0x001E60A5 /* @ECU_Address@FCtl_FTB_0x04@0x024C538E@ */ ECIPP_ALIGNMENT_UBYTE 255 Compu_IDENTITY 0 255 PHYS_UNIT "FTB" /end CHARACTERISTIC
/begin CHARACTERISTIC FCftb_Pri10_short "FCtl_FTB_0x04(922)" VALUE 0x001E60B1 /* @ECU_Address@FCtl_FTB_0x04@0x024C539A@ */ ECIPP_ALIGNMENT_UBYTE 255 Compu_IDENTITY 0 255 PHYS_UNIT "FTB" /end CHARACTERISTIC
/begin CHARACTERISTIC FCftb_Pri11_open "FCtl_FTB_0x04(911)" VALUE 0x001E60A6 /* @ECU_Address@FCtl_FTB_0x04@0x024C538F@ */ ECIPP_ALIGNMENT_UBYTE 255 Compu_IDENTITY 0 255 PHYS_UNIT "FTB" /end CHARACTERISTIC
/begin CHARACTERISTIC FCftb_Pri11_short "FCtl_FTB_0x04(923)" VALUE 0x001E60B2 /* @ECU_Address@FCtl_FTB_0x04@0x024C539B@ */ ECIPP_ALIGNMENT_UBYTE 255 Compu_IDENTITY 0 255 PHYS_UNIT "FTB" /end CHARACTERISTIC
/begin CHARACTERISTIC FCftb_Pri12_open "FCtl_FTB_0x04(912)" VALUE 0x001E60A7 /* @ECU_Address@FCtl_FTB_0x04@0x024C5390@ */ ECIPP_ALIGNMENT_UBYTE 255 Compu_IDENTITY 0 255 PHYS_UNIT "FTB" /end CHARACTERISTIC
/begin CHARACTERISTIC FCftb_Pri12_short "FCtl_FTB_0x04(924)" VALUE 0x001E60B3 /* @ECU_Address@FCtl_FTB_0x04@0x024C539C@ */ ECIPP_ALIGNMENT_UBYTE 255 Compu_IDENTITY 0 255 PHYS_UNIT "FTB" /end CHARACTERISTIC
/begin CHARACTERISTIC FCftb_Pri2_open "FCtl_FTB_0x04(902)" VALUE 0x001E609D /* @ECU_Address@FCtl_FTB_0x04@0x024C5386@ */ ECIPP_ALIGNMENT_UBYTE 255 Compu_IDENTITY 0 255 PHYS_UNIT "FTB" /end CHARACTERISTIC
/begin CHARACTERISTIC FCftb_Pri2_short "FCtl_FTB_0x04(914)" VALUE 0x001E60A9 /* @ECU_Address@FCtl_FTB_0x04@0x024C5392@ */ ECIPP_ALIGNMENT_UBYTE 255 Compu_IDENTITY 0 255 PHYS_UNIT "FTB" /end CHARACTERISTIC
/begin CHARACTERISTIC FCftb_Pri3_open "FCtl_FTB_0x04(903)" VALUE 0x001E609E /* @ECU_Address@FCtl_FTB_0x04@0x024C5387@ */ ECIPP_ALIGNMENT_UBYTE 255 Compu_IDENTITY 0 255 PHYS_UNIT "FTB" /end CHARACTERISTIC
/begin CHARACTERISTIC FCftb_Pri3_short "FCtl_FTB_0x04(915)" VALUE 0x001E60AA /* @ECU_Address@FCtl_FTB_0x04@0x024C5393@ */ ECIPP_ALIGNMENT_UBYTE 255 Compu_IDENTITY 0 255 PHYS_UNIT "FTB" /end CHARACTERISTIC
/begin CHARACTERISTIC FCftb_Pri4_open "FCtl_FTB_0x04(904)" VALUE 0x001E609F /* @ECU_Address@FCtl_FTB_0x04@0x024C5388@ */ ECIPP_ALIGNMENT_UBYTE 255 Compu_IDENTITY 0 255 PHYS_UNIT "FTB" /end CHARACTERISTIC
/begin CHARACTERISTIC FCftb_Pri4_short "FCtl_FTB_0x04(916)" VALUE 0x001E60AB /* @ECU_Address@FCtl_FTB_0x04@0x024C5394@ */ ECIPP_ALIGNMENT_UBYTE 255 Compu_IDENTITY 0 255 PHYS_UNIT "FTB" /end CHARACTERISTIC
/begin CHARACTERISTIC FCftb_Pri5_open "FCtl_FTB_0x04(905)" VALUE 0x001E60A0 /* @ECU_Address@FCtl_FTB_0x04@0x024C5389@ */ ECIPP_ALIGNMENT_UBYTE 255 Compu_IDENTITY 0 255 PHYS_UNIT "FTB" /end CHARACTERISTIC
/begin CHARACTERISTIC FCftb_Pri5_short "FCtl_FTB_0x04(917)" VALUE 0x001E60AC /* @ECU_Address@FCtl_FTB_0x04@0x024C5395@ */ ECIPP_ALIGNMENT_UBYTE 255 Compu_IDENTITY 0 255 PHYS_UNIT "FTB" /end CHARACTERISTIC
/begin CHARACTERISTIC FCftb_Pri6_open "FCtl_FTB_0x04(906)" VALUE 0x001E60A1 /* @ECU_Address@FCtl_FTB_0x04@0x024C538A@ */ ECIPP_ALIGNMENT_UBYTE 255 Compu_IDENTITY 0 255 PHYS_UNIT "FTB" /end CHARACTERISTIC
/begin CHARACTERISTIC FCftb_Pri6_short "FCtl_FTB_0x04(918)" VALUE 0x001E60AD /* @ECU_Address@FCtl_FTB_0x04@0x024C5396@ */ ECIPP_ALIGNMENT_UBYTE 255 Compu_IDENTITY 0 255 PHYS_UNIT "FTB" /end CHARACTERISTIC
/begin CHARACTERISTIC FCftb_Pri7_open "FCtl_FTB_0x04(907)" VALUE 0x001E60A2 /* @ECU_Address@FCtl_FTB_0x04@0x024C538B@ */ ECIPP_ALIGNMENT_UBYTE 255 Compu_IDENTITY 0 255 PHYS_UNIT "FTB" /end CHARACTERISTIC
/begin CHARACTERISTIC FCftb_Pri7_short "FCtl_FTB_0x04(919)" VALUE 0x001E60AE /* @ECU_Address@FCtl_FTB_0x04@0x024C5397@ */ ECIPP_ALIGNMENT_UBYTE 255 Compu_IDENTITY 0 255 PHYS_UNIT "FTB" /end CHARACTERISTIC
/begin CHARACTERISTIC FCftb_Pri8_open "FCtl_FTB_0x04(908)" VALUE 0x001E60A3 /* @ECU_Address@FCtl_FTB_0x04@0x024C538C@ */ ECIPP_ALIGNMENT_UBYTE 255 Compu_IDENTITY 0 255 PHYS_UNIT "FTB" /end CHARACTERISTIC
/begin CHARACTERISTIC FCftb_Pri8_short "FCtl_FTB_0x04(920)" VALUE 0x001E60AF /* @ECU_Address@FCtl_FTB_0x04@0x024C5398@ */ ECIPP_ALIGNMENT_UBYTE 255 Compu_IDENTITY 0 255 PHYS_UNIT "FTB" /end CHARACTERISTIC
/begin CHARACTERISTIC FCftb_Pri9_open "FCtl_FTB_0x04(909)" VALUE 0x001E60A4 /* @ECU_Address@FCtl_FTB_0x04@0x024C538D@ */ ECIPP_ALIGNMENT_UBYTE 255 Compu_IDENTITY 0 255 PHYS_UNIT "FTB" /end CHARACTERISTIC
/begin CHARACTERISTIC FCftb_Pri9_short "FCtl_FTB_0x04(921)" VALUE 0x001E60B0 /* @ECU_Address@FCtl_FTB_0x04@0x024C5399@ */ ECIPP_ALIGNMENT_UBYTE 255 Compu_IDENTITY 0 255 PHYS_UNIT "FTB" /end CHARACTERISTIC
/begin CHARACTERISTIC FCftb_Sec10_31KV_open "FCtl_FTB_0x04(958)" VALUE 0x001E60D5 /* @ECU_Address@FCtl_FTB_0x04@0x024C53BE@ */ ECIPP_ALIGNMENT_UBYTE 255 Compu_IDENTITY 0 255 PHYS_UNIT "FTB" /end CHARACTERISTIC
/begin CHARACTERISTIC FCftb_Sec10_low "FCtl_FTB_0x04(946)" VALUE 0x001E60C9 /* @ECU_Address@FCtl_FTB_0x04@0x024C53B2@ */ ECIPP_ALIGNMENT_UBYTE 255 Compu_IDENTITY 0 255 PHYS_UNIT "FTB" /end CHARACTERISTIC
/begin CHARACTERISTIC FCftb_Sec10_open "FCtl_FTB_0x04(934)" VALUE 0x001E60BD /* @ECU_Address@FCtl_FTB_0x04@0x024C53A6@ */ ECIPP_ALIGNMENT_UBYTE 255 Compu_IDENTITY 0 255 PHYS_UNIT "FTB" /end CHARACTERISTIC
/begin CHARACTERISTIC FCftb_Sec11_31KV_open "FCtl_FTB_0x04(959)" VALUE 0x001E60D6 /* @ECU_Address@FCtl_FTB_0x04@0x024C53BF@ */ ECIPP_ALIGNMENT_UBYTE 255 Compu_IDENTITY 0 255 PHYS_UNIT "FTB" /end CHARACTERISTIC
/begin CHARACTERISTIC FCftb_Sec11_low "FCtl_FTB_0x04(947)" VALUE 0x001E60CA /* @ECU_Address@FCtl_FTB_0x04@0x024C53B3@ */ ECIPP_ALIGNMENT_UBYTE 255 Compu_IDENTITY 0 255 PHYS_UNIT "FTB" /end CHARACTERISTIC
/begin CHARACTERISTIC FCftb_Sec11_open "FCtl_FTB_0x04(935)" VALUE 0x001E60BE /* @ECU_Address@FCtl_FTB_0x04@0x024C53A7@ */ ECIPP_ALIGNMENT_UBYTE 255 Compu_IDENTITY 0 255 PHYS_UNIT "FTB" /end CHARACTERISTIC
/begin CHARACTERISTIC FCftb_Sec12_31KV_open "FCtl_FTB_0x04(960)" VALUE 0x001E60D7 /* @ECU_Address@FCtl_FTB_0x04@0x024C53C0@ */ ECIPP_ALIGNMENT_UBYTE 255 Compu_IDENTITY 0 255 PHYS_UNIT "FTB" /end CHARACTERISTIC
/begin CHARACTERISTIC FCftb_Sec12_low "FCtl_FTB_0x04(948)" VALUE 0x001E60CB /* @ECU_Address@FCtl_FTB_0x04@0x024C53B4@ */ ECIPP_ALIGNMENT_UBYTE 255 Compu_IDENTITY 0 255 PHYS_UNIT "FTB" /end CHARACTERISTIC
/begin CHARACTERISTIC FCftb_Sec12_open "FCtl_FTB_0x04(936)" VALUE 0x001E60BF /* @ECU_Address@FCtl_FTB_0x04@0x024C53A8@ */ ECIPP_ALIGNMENT_UBYTE 255 Compu_IDENTITY 0 255 PHYS_UNIT "FTB" /end CHARACTERISTIC
/begin CHARACTERISTIC FCftb_Sec2_31KV_open "FCtl_FTB_0x04(950)" VALUE 0x001E60CD /* @ECU_Address@FCtl_FTB_0x04@0x024C53B6@ */ ECIPP_ALIGNMENT_UBYTE 255 Compu_IDENTITY 0 255 PHYS_UNIT "FTB" /end CHARACTERISTIC
/begin CHARACTERISTIC FCftb_Sec2_low "FCtl_FTB_0x04(938)" VALUE 0x001E60C1 /* @ECU_Address@FCtl_FTB_0x04@0x024C53AA@ */ ECIPP_ALIGNMENT_UBYTE 255 Compu_IDENTITY 0 255 PHYS_UNIT "FTB" /end CHARACTERISTIC
/begin CHARACTERISTIC FCftb_Sec2_open "FCtl_FTB_0x04(926)" VALUE 0x001E60B5 /* @ECU_Address@FCtl_FTB_0x04@0x024C539E@ */ ECIPP_ALIGNMENT_UBYTE 255 Compu_IDENTITY 0 255 PHYS_UNIT "FTB" /end CHARACTERISTIC
/begin CHARACTERISTIC FCftb_Sec3_31KV_open "FCtl_FTB_0x04(951)" VALUE 0x001E60CE /* @ECU_Address@FCtl_FTB_0x04@0x024C53B7@ */ ECIPP_ALIGNMENT_UBYTE 255 Compu_IDENTITY 0 255 PHYS_UNIT "FTB" /end CHARACTERISTIC
/begin CHARACTERISTIC FCftb_Sec3_low "FCtl_FTB_0x04(939)" VALUE 0x001E60C2 /* @ECU_Address@FCtl_FTB_0x04@0x024C53AB@ */ ECIPP_ALIGNMENT_UBYTE 255 Compu_IDENTITY 0 255 PHYS_UNIT "FTB" /end CHARACTERISTIC
/begin CHARACTERISTIC FCftb_Sec3_open "FCtl_FTB_0x04(927)" VALUE 0x001E60B6 /* @ECU_Address@FCtl_FTB_0x04@0x024C539F@ */ ECIPP_ALIGNMENT_UBYTE 255 Compu_IDENTITY 0 255 PHYS_UNIT "FTB" /end CHARACTERISTIC
/begin CHARACTERISTIC FCftb_Sec4_31KV_open "FCtl_FTB_0x04(952)" VALUE 0x001E60CF /* @ECU_Address@FCtl_FTB_0x04@0x024C53B8@ */ ECIPP_ALIGNMENT_UBYTE 255 Compu_IDENTITY 0 255 PHYS_UNIT "FTB" /end CHARACTERISTIC
/begin CHARACTERISTIC FCftb_Sec4_low "FCtl_FTB_0x04(940)" VALUE 0x001E60C3 /* @ECU_Address@FCtl_FTB_0x04@0x024C53AC@ */ ECIPP_ALIGNMENT_UBYTE 255 Compu_IDENTITY 0 255 PHYS_UNIT "FTB" /end CHARACTERISTIC
/begin CHARACTERISTIC FCftb_Sec4_open "FCtl_FTB_0x04(928)" VALUE 0x001E60B7 /* @ECU_Address@FCtl_FTB_0x04@0x024C53A0@ */ ECIPP_ALIGNMENT_UBYTE 255 Compu_IDENTITY 0 255 PHYS_UNIT "FTB" /end CHARACTERISTIC
/begin CHARACTERISTIC FCftb_Sec5_31KV_open "FCtl_FTB_0x04(953)" VALUE 0x001E60D0 /* @ECU_Address@FCtl_FTB_0x04@0x024C53B9@ */ ECIPP_ALIGNMENT_UBYTE 255 Compu_IDENTITY 0 255 PHYS_UNIT "FTB" /end CHARACTERISTIC
/begin CHARACTERISTIC FCftb_Sec5_low "FCtl_FTB_0x04(941)" VALUE 0x001E60C4 /* @ECU_Address@FCtl_FTB_0x04@0x024C53AD@ */ ECIPP_ALIGNMENT_UBYTE 255 Compu_IDENTITY 0 255 PHYS_UNIT "FTB" /end CHARACTERISTIC
/begin CHARACTERISTIC FCftb_Sec5_open "FCtl_FTB_0x04(929)" VALUE 0x001E60B8 /* @ECU_Address@FCtl_FTB_0x04@0x024C53A1@ */ ECIPP_ALIGNMENT_UBYTE 255 Compu_IDENTITY 0 255 PHYS_UNIT "FTB" /end CHARACTERISTIC
/begin CHARACTERISTIC FCftb_Sec6_31KV_open "FCtl_FTB_0x04(954)" VALUE 0x001E60D1 /* @ECU_Address@FCtl_FTB_0x04@0x024C53BA@ */ ECIPP_ALIGNMENT_UBYTE 255 Compu_IDENTITY 0 255 PHYS_UNIT "FTB" /end CHARACTERISTIC
/begin CHARACTERISTIC FCftb_Sec6_low "FCtl_FTB_0x04(942)" VALUE 0x001E60C5 /* @ECU_Address@FCtl_FTB_0x04@0x024C53AE@ */ ECIPP_ALIGNMENT_UBYTE 255 Compu_IDENTITY 0 255 PHYS_UNIT "FTB" /end CHARACTERISTIC
/begin CHARACTERISTIC FCftb_Sec6_open "FCtl_FTB_0x04(930)" VALUE 0x001E60B9 /* @ECU_Address@FCtl_FTB_0x04@0x024C53A2@ */ ECIPP_ALIGNMENT_UBYTE 255 Compu_IDENTITY 0 255 PHYS_UNIT "FTB" /end CHARACTERISTIC
/begin CHARACTERISTIC FCftb_Sec7_31KV_open "FCtl_FTB_0x04(955)" VALUE 0x001E60D2 /* @ECU_Address@FCtl_FTB_0x04@0x024C53BB@ */ ECIPP_ALIGNMENT_UBYTE 255 Compu_IDENTITY 0 255 PHYS_UNIT "FTB" /end CHARACTERISTIC
/begin CHARACTERISTIC FCftb_Sec7_low "FCtl_FTB_0x04(943)" VALUE 0x001E60C6 /* @ECU_Address@FCtl_FTB_0x04@0x024C53AF@ */ ECIPP_ALIGNMENT_UBYTE 255 Compu_IDENTITY 0 255 PHYS_UNIT "FTB" /end CHARACTERISTIC
/begin CHARACTERISTIC FCftb_Sec7_open "FCtl_FTB_0x04(931)" VALUE 0x001E60BA /* @ECU_Address@FCtl_FTB_0x04@0x024C53A3@ */ ECIPP_ALIGNMENT_UBYTE 255 Compu_IDENTITY 0 255 PHYS_UNIT "FTB" /end CHARACTERISTIC
/begin CHARACTERISTIC FCftb_Sec8_31KV_open "FCtl_FTB_0x04(956)" VALUE 0x001E60D3 /* @ECU_Address@FCtl_FTB_0x04@0x024C53BC@ */ ECIPP_ALIGNMENT_UBYTE 255 Compu_IDENTITY 0 255 PHYS_UNIT "FTB" /end CHARACTERISTIC
/begin CHARACTERISTIC FCftb_Sec8_low "FCtl_FTB_0x04(944)" VALUE 0x001E60C7 /* @ECU_Address@FCtl_FTB_0x04@0x024C53B0@ */ ECIPP_ALIGNMENT_UBYTE 255 Compu_IDENTITY 0 255 PHYS_UNIT "FTB" /end CHARACTERISTIC
/begin CHARACTERISTIC FCftb_Sec8_open "FCtl_FTB_0x04(932)" VALUE 0x001E60BB /* @ECU_Address@FCtl_FTB_0x04@0x024C53A4@ */ ECIPP_ALIGNMENT_UBYTE 255 Compu_IDENTITY 0 255 PHYS_UNIT "FTB" /end CHARACTERISTIC
/begin CHARACTERISTIC FCftb_Sec9_31KV_open "FCtl_FTB_0x04(957)" VALUE 0x001E60D4 /* @ECU_Address@FCtl_FTB_0x04@0x024C53BD@ */ ECIPP_ALIGNMENT_UBYTE 255 Compu_IDENTITY 0 255 PHYS_UNIT "FTB" /end CHARACTERISTIC
/begin CHARACTERISTIC FCftb_Sec9_low "FCtl_FTB_0x04(945)" VALUE 0x001E60C8 /* @ECU_Address@FCtl_FTB_0x04@0x024C53B1@ */ ECIPP_ALIGNMENT_UBYTE 255 Compu_IDENTITY 0 255 PHYS_UNIT "FTB" /end CHARACTERISTIC
/begin CHARACTERISTIC FCftb_Sec9_open "FCtl_FTB_0x04(933)" VALUE 0x001E60BC /* @ECU_Address@FCtl_FTB_0x04@0x024C53A5@ */ ECIPP_ALIGNMENT_UBYTE 255 Compu_IDENTITY 0 255 PHYS_UNIT "FTB" /end CHARACTERISTIC
/begin CHARACTERISTIC FCftb_SPK10_IGBT_T "FCtl_FTB_0x04(518)" VALUE 0x001E5F1D /* @ECU_Address@FCtl_FTB_0x04@0x024C5206@ */ ECIPP_ALIGNMENT_UBYTE 255 Compu_IDENTITY 0 255 PHYS_UNIT "FTB" /end CHARACTERISTIC
/begin CHARACTERISTIC FCftb_SPK11_IGBT_T "FCtl_FTB_0x04(1021)" VALUE 0x001E6114 /* @ECU_Address@FCtl_FTB_0x04@0x024C53FD@ */ ECIPP_ALIGNMENT_UBYTE 255 Compu_IDENTITY 0 255 PHYS_UNIT "FTB" /end CHARACTERISTIC
/begin CHARACTERISTIC FCftb_SPK12_IGBT_T "FCtl_FTB_0x04(1022)" VALUE 0x001E6115 /* @ECU_Address@FCtl_FTB_0x04@0x024C53FE@ */ ECIPP_ALIGNMENT_UBYTE 255 Compu_IDENTITY 0 255 PHYS_UNIT "FTB" /end CHARACTERISTIC
/begin CHARACTERISTIC FCftb_SPK2_IGBT_T "FCtl_FTB_0x04(510)" VALUE 0x001E5F15 /* @ECU_Address@FCtl_FTB_0x04@0x024C51FE@ */ ECIPP_ALIGNMENT_UBYTE 255 Compu_IDENTITY 0 255 PHYS_UNIT "FTB" /end CHARACTERISTIC
/begin CHARACTERISTIC FCftb_SPK3_IGBT_T "FCtl_FTB_0x04(511)" VALUE 0x001E5F16 /* @ECU_Address@FCtl_FTB_0x04@0x024C51FF@ */ ECIPP_ALIGNMENT_UBYTE 255 Compu_IDENTITY 0 255 PHYS_UNIT "FTB" /end CHARACTERISTIC
/begin CHARACTERISTIC FCftb_SPK4_IGBT_T "FCtl_FTB_0x04(512)" VALUE 0x001E5F17 /* @ECU_Address@FCtl_FTB_0x04@0x024C5200@ */ ECIPP_ALIGNMENT_UBYTE 255 Compu_IDENTITY 0 255 PHYS_UNIT "FTB" /end CHARACTERISTIC
/begin CHARACTERISTIC FCftb_SPK5_IGBT_T "FCtl_FTB_0x04(513)" VALUE 0x001E5F18 /* @ECU_Address@FCtl_FTB_0x04@0x024C5201@ */ ECIPP_ALIGNMENT_UBYTE 255 Compu_IDENTITY 0 255 PHYS_UNIT "FTB" /end CHARACTERISTIC
/begin CHARACTERISTIC FCftb_SPK6_IGBT_T "FCtl_FTB_0x04(514)" VALUE 0x001E5F19 /* @ECU_Address@FCtl_FTB_0x04@0x024C5202@ */ ECIPP_ALIGNMENT_UBYTE 255 Compu_IDENTITY 0 255 PHYS_UNIT "FTB" /end CHARACTERISTIC
/begin CHARACTERISTIC FCftb_SPK7_IGBT_T "FCtl_FTB_0x04(515)" VALUE 0x001E5F1A /* @ECU_Address@FCtl_FTB_0x04@0x024C5203@ */ ECIPP_ALIGNMENT_UBYTE 255 Compu_IDENTITY 0 255 PHYS_UNIT "FTB" /end CHARACTERISTIC
/begin CHARACTERISTIC FCftb_SPK8_IGBT_T "FCtl_FTB_0x04(516)" VALUE 0x001E5F1B /* @ECU_Address@FCtl_FTB_0x04@0x024C5204@ */ ECIPP_ALIGNMENT_UBYTE 255 Compu_IDENTITY 0 255 PHYS_UNIT "FTB" /end CHARACTERISTIC
/begin CHARACTERISTIC FCftb_SPK9_IGBT_T "FCtl_FTB_0x04(517)" VALUE 0x001E5F1C /* @ECU_Address@FCtl_FTB_0x04@0x024C5205@ */ ECIPP_ALIGNMENT_UBYTE 255 Compu_IDENTITY 0 255 PHYS_UNIT "FTB" /end CHARACTERISTIC
/begin CHARACTERISTIC FCftb_SPKD10_coil_fail "FCtl_FTB_0x04(313)" VALUE 0x001E5E50 /* @ECU_Address@FCtl_FTB_0x04@0x024C5139@ */ ECIPP_ALIGNMENT_UBYTE 255 Compu_IDENTITY 0 255 PHYS_UNIT "FTB" /end CHARACTERISTIC
/begin CHARACTERISTIC FCftb_SPKD10_dw_hi "FCtl_FTB_0x04(85)" VALUE 0x001E5D6C /* @ECU_Address@FCtl_FTB_0x04@0x024C5055@ */ ECIPP_ALIGNMENT_UBYTE 255 Compu_IDENTITY 0 255 PHYS_UNIT "FTB" /end CHARACTERISTIC
/begin CHARACTERISTIC FCftb_SPKD10_dw_lo "FCtl_FTB_0x04(75)" VALUE 0x001E5D62 /* @ECU_Address@FCtl_FTB_0x04@0x024C504B@ */ ECIPP_ALIGNMENT_UBYTE 255 Compu_IDENTITY 0 255 PHYS_UNIT "FTB" /end CHARACTERISTIC
/begin CHARACTERISTIC FCftb_SPKD11_coil_fail "FCtl_FTB_0x04(1027)" VALUE 0x001E611A /* @ECU_Address@FCtl_FTB_0x04@0x024C5403@ */ ECIPP_ALIGNMENT_UBYTE 255 Compu_IDENTITY 0 255 PHYS_UNIT "FTB" /end CHARACTERISTIC
/begin CHARACTERISTIC FCftb_SPKD11_dw_hi "FCtl_FTB_0x04(1025)" VALUE 0x001E6118 /* @ECU_Address@FCtl_FTB_0x04@0x024C5401@ */ ECIPP_ALIGNMENT_UBYTE 255 Compu_IDENTITY 0 255 PHYS_UNIT "FTB" /end CHARACTERISTIC
/begin CHARACTERISTIC FCftb_SPKD11_dw_lo "FCtl_FTB_0x04(1023)" VALUE 0x001E6116 /* @ECU_Address@FCtl_FTB_0x04@0x024C53FF@ */ ECIPP_ALIGNMENT_UBYTE 255 Compu_IDENTITY 0 255 PHYS_UNIT "FTB" /end CHARACTERISTIC
/begin CHARACTERISTIC FCftb_SPKD12_coil_fail "FCtl_FTB_0x04(1028)" VALUE 0x001E611B /* @ECU_Address@FCtl_FTB_0x04@0x024C5404@ */ ECIPP_ALIGNMENT_UBYTE 255 Compu_IDENTITY 0 255 PHYS_UNIT "FTB" /end CHARACTERISTIC
/begin CHARACTERISTIC FCftb_SPKD12_dw_hi "FCtl_FTB_0x04(1026)" VALUE 0x001E6119 /* @ECU_Address@FCtl_FTB_0x04@0x024C5402@ */ ECIPP_ALIGNMENT_UBYTE 255 Compu_IDENTITY 0 255 PHYS_UNIT "FTB" /end CHARACTERISTIC
/begin CHARACTERISTIC FCftb_SPKD12_dw_lo "FCtl_FTB_0x04(1024)" VALUE 0x001E6117 /* @ECU_Address@FCtl_FTB_0x04@0x024C5400@ */ ECIPP_ALIGNMENT_UBYTE 255 Compu_IDENTITY 0 255 PHYS_UNIT "FTB" /end CHARACTERISTIC
/begin CHARACTERISTIC FCftb_SPKD2_coil_fail "FCtl_FTB_0x04(305)" VALUE 0x001E5E48 /* @ECU_Address@FCtl_FTB_0x04@0x024C5131@ */ ECIPP_ALIGNMENT_UBYTE 255 Compu_IDENTITY 0 255 PHYS_UNIT "FTB" /end CHARACTERISTIC
/begin CHARACTERISTIC FCftb_SPKD2_dw_hi "FCtl_FTB_0x04(77)" VALUE 0x001E5D64 /* @ECU_Address@FCtl_FTB_0x04@0x024C504D@ */ ECIPP_ALIGNMENT_UBYTE 255 Compu_IDENTITY 0 255 PHYS_UNIT "FTB" /end CHARACTERISTIC
/begin CHARACTERISTIC FCftb_SPKD2_dw_lo "FCtl_FTB_0x04(67)" VALUE 0x001E5D5A /* @ECU_Address@FCtl_FTB_0x04@0x024C5043@ */ ECIPP_ALIGNMENT_UBYTE 255 Compu_IDENTITY 0 255 PHYS_UNIT "FTB" /end CHARACTERISTIC
/begin CHARACTERISTIC FCftb_SPKD3_coil_fail "FCtl_FTB_0x04(306)" VALUE 0x001E5E49 /* @ECU_Address@FCtl_FTB_0x04@0x024C5132@ */ ECIPP_ALIGNMENT_UBYTE 255 Compu_IDENTITY 0 255 PHYS_UNIT "FTB" /end CHARACTERISTIC
/begin CHARACTERISTIC FCftb_SPKD3_dw_hi "FCtl_FTB_0x04(78)" VALUE 0x001E5D65 /* @ECU_Address@FCtl_FTB_0x04@0x024C504E@ */ ECIPP_ALIGNMENT_UBYTE 255 Compu_IDENTITY 0 255 PHYS_UNIT "FTB" /end CHARACTERISTIC
/begin CHARACTERISTIC FCftb_SPKD3_dw_lo "FCtl_FTB_0x04(68)" VALUE 0x001E5D5B /* @ECU_Address@FCtl_FTB_0x04@0x024C5044@ */ ECIPP_ALIGNMENT_UBYTE 255 Compu_IDENTITY 0 255 PHYS_UNIT "FTB" /end CHARACTERISTIC
/begin CHARACTERISTIC FCftb_SPKD4_coil_fail "FCtl_FTB_0x04(307)" VALUE 0x001E5E4A /* @ECU_Address@FCtl_FTB_0x04@0x024C5133@ */ ECIPP_ALIGNMENT_UBYTE 255 Compu_IDENTITY 0 255 PHYS_UNIT "FTB" /end CHARACTERISTIC
/begin CHARACTERISTIC FCftb_SPKD4_dw_hi "FCtl_FTB_0x04(79)" VALUE 0x001E5D66 /* @ECU_Address@FCtl_FTB_0x04@0x024C504F@ */ ECIPP_ALIGNMENT_UBYTE 255 Compu_IDENTITY 0 255 PHYS_UNIT "FTB" /end CHARACTERISTIC
/begin CHARACTERISTIC FCftb_SPKD4_dw_lo "FCtl_FTB_0x04(69)" VALUE 0x001E5D5C /* @ECU_Address@FCtl_FTB_0x04@0x024C5045@ */ ECIPP_ALIGNMENT_UBYTE 255 Compu_IDENTITY 0 255 PHYS_UNIT "FTB" /end CHARACTERISTIC
/begin CHARACTERISTIC FCftb_SPKD5_coil_fail "FCtl_FTB_0x04(308)" VALUE 0x001E5E4B /* @ECU_Address@FCtl_FTB_0x04@0x024C5134@ */ ECIPP_ALIGNMENT_UBYTE 255 Compu_IDENTITY 0 255 PHYS_UNIT "FTB" /end CHARACTERISTIC
/begin CHARACTERISTIC FCftb_SPKD5_dw_hi "FCtl_FTB_0x04(80)" VALUE 0x001E5D67 /* @ECU_Address@FCtl_FTB_0x04@0x024C5050@ */ ECIPP_ALIGNMENT_UBYTE 255 Compu_IDENTITY 0 255 PHYS_UNIT "FTB" /end CHARACTERISTIC
/begin CHARACTERISTIC FCftb_SPKD5_dw_lo "FCtl_FTB_0x04(70)" VALUE 0x001E5D5D /* @ECU_Address@FCtl_FTB_0x04@0x024C5046@ */ ECIPP_ALIGNMENT_UBYTE 255 Compu_IDENTITY 0 255 PHYS_UNIT "FTB" /end CHARACTERISTIC
/begin CHARACTERISTIC FCftb_SPKD6_coil_fail "FCtl_FTB_0x04(309)" VALUE 0x001E5E4C /* @ECU_Address@FCtl_FTB_0x04@0x024C5135@ */ ECIPP_ALIGNMENT_UBYTE 255 Compu_IDENTITY 0 255 PHYS_UNIT "FTB" /end CHARACTERISTIC
/begin CHARACTERISTIC FCftb_SPKD6_dw_hi "FCtl_FTB_0x04(81)" VALUE 0x001E5D68 /* @ECU_Address@FCtl_FTB_0x04@0x024C5051@ */ ECIPP_ALIGNMENT_UBYTE 255 Compu_IDENTITY 0 255 PHYS_UNIT "FTB" /end CHARACTERISTIC
/begin CHARACTERISTIC FCftb_SPKD6_dw_lo "FCtl_FTB_0x04(71)" VALUE 0x001E5D5E /* @ECU_Address@FCtl_FTB_0x04@0x024C5047@ */ ECIPP_ALIGNMENT_UBYTE 255 Compu_IDENTITY 0 255 PHYS_UNIT "FTB" /end CHARACTERISTIC
/begin CHARACTERISTIC FCftb_SPKD7_coil_fail "FCtl_FTB_0x04(310)" VALUE 0x001E5E4D /* @ECU_Address@FCtl_FTB_0x04@0x024C5136@ */ ECIPP_ALIGNMENT_UBYTE 255 Compu_IDENTITY 0 255 PHYS_UNIT "FTB" /end CHARACTERISTIC
/begin CHARACTERISTIC FCftb_SPKD7_dw_hi "FCtl_FTB_0x04(82)" VALUE 0x001E5D69 /* @ECU_Address@FCtl_FTB_0x04@0x024C5052@ */ ECIPP_ALIGNMENT_UBYTE 255 Compu_IDENTITY 0 255 PHYS_UNIT "FTB" /end CHARACTERISTIC
/begin CHARACTERISTIC FCftb_SPKD7_dw_lo "FCtl_FTB_0x04(72)" VALUE 0x001E5D5F /* @ECU_Address@FCtl_FTB_0x04@0x024C5048@ */ ECIPP_ALIGNMENT_UBYTE 255 Compu_IDENTITY 0 255 PHYS_UNIT "FTB" /end CHARACTERISTIC
/begin CHARACTERISTIC FCftb_SPKD8_coil_fail "FCtl_FTB_0x04(311)" VALUE 0x001E5E4E /* @ECU_Address@FCtl_FTB_0x04@0x024C5137@ */ ECIPP_ALIGNMENT_UBYTE 255 Compu_IDENTITY 0 255 PHYS_UNIT "FTB" /end CHARACTERISTIC
/begin CHARACTERISTIC FCftb_SPKD8_dw_hi "FCtl_FTB_0x04(83)" VALUE 0x001E5D6A /* @ECU_Address@FCtl_FTB_0x04@0x024C5053@ */ ECIPP_ALIGNMENT_UBYTE 255 Compu_IDENTITY 0 255 PHYS_UNIT "FTB" /end CHARACTERISTIC
/begin CHARACTERISTIC FCftb_SPKD8_dw_lo "FCtl_FTB_0x04(73)" VALUE 0x001E5D60 /* @ECU_Address@FCtl_FTB_0x04@0x024C5049@ */ ECIPP_ALIGNMENT_UBYTE 255 Compu_IDENTITY 0 255 PHYS_UNIT "FTB" /end CHARACTERISTIC
/begin CHARACTERISTIC FCftb_SPKD9_coil_fail "FCtl_FTB_0x04(312)" VALUE 0x001E5E4F /* @ECU_Address@FCtl_FTB_0x04@0x024C5138@ */ ECIPP_ALIGNMENT_UBYTE 255 Compu_IDENTITY 0 255 PHYS_UNIT "FTB" /end CHARACTERISTIC
/begin CHARACTERISTIC FCftb_SPKD9_dw_hi "FCtl_FTB_0x04(84)" VALUE 0x001E5D6B /* @ECU_Address@FCtl_FTB_0x04@0x024C5054@ */ ECIPP_ALIGNMENT_UBYTE 255 Compu_IDENTITY 0 255 PHYS_UNIT "FTB" /end CHARACTERISTIC
/begin CHARACTERISTIC FCftb_SPKD9_dw_lo "FCtl_FTB_0x04(74)" VALUE 0x001E5D61 /* @ECU_Address@FCtl_FTB_0x04@0x024C504A@ */ ECIPP_ALIGNMENT_UBYTE 255 Compu_IDENTITY 0 255 PHYS_UNIT "FTB" /end CHARACTERISTIC
/begin CHARACTERISTIC FCftb_TANK_2_V_maxv "FCtl_FTB_0x04(872)" VALUE 0x001E607F /* @ECU_Address@FCtl_FTB_0x04@0x024C5368@ */ ECIPP_ALIGNMENT_UBYTE 255 Compu_IDENTITY 0 255 PHYS_UNIT "FTB" /end CHARACTERISTIC
/begin CHARACTERISTIC FCftb_TANK_2_V_minv "FCtl_FTB_0x04(874)" VALUE 0x001E6081 /* @ECU_Address@FCtl_FTB_0x04@0x024C536A@ */ ECIPP_ALIGNMENT_UBYTE 255 Compu_IDENTITY 0 255 PHYS_UNIT "FTB" /end CHARACTERISTIC
/begin CHARACTERISTIC FCftb_TANK_2_V_slow "FCtl_FTB_0x04(876)" VALUE 0x001E6083 /* @ECU_Address@FCtl_FTB_0x04@0x024C536C@ */ ECIPP_ALIGNMENT_UBYTE 255 Compu_IDENTITY 0 255 PHYS_UNIT "FTB" /end CHARACTERISTIC
/begin CHARACTERISTIC FCftb_UGF_Hv_lo "FCtl_FTB_0x04(243)" VALUE 0x001E5E0A /* @ECU_Address@FCtl_FTB_0x04@0x024C50F3@ */ ECIPP_ALIGNMENT_UBYTE 255 Compu_IDENTITY 0 255 PHYS_UNIT "FTB" /end CHARACTERISTIC
/begin CHARACTERISTIC FCftb_UGF1_PR_hi "FCtl_FTB_0x04(257)" VALUE 0x001E5E18 /* @ECU_Address@FCtl_FTB_0x04@0x024C5101@ */ ECIPP_ALIGNMENT_UBYTE 255 Compu_IDENTITY 0 255 PHYS_UNIT "FTB" /end CHARACTERISTIC
/begin CHARACTERISTIC FCftb_UGF1_PR_lo "FCtl_FTB_0x04(258)" VALUE 0x001E5E19 /* @ECU_Address@FCtl_FTB_0x04@0x024C5102@ */ ECIPP_ALIGNMENT_UBYTE 255 Compu_IDENTITY 0 255 PHYS_UNIT "FTB" /end CHARACTERISTIC
/begin CHARACTERISTIC FCftb_UGF1_PR_slow "FCtl_FTB_0x04(255)" VALUE 0x001E5E16 /* @ECU_Address@FCtl_FTB_0x04@0x024C50FF@ */ ECIPP_ALIGNMENT_UBYTE 255 Compu_IDENTITY 0 255 PHYS_UNIT "FTB" /end CHARACTERISTIC
/begin CHARACTERISTIC FCftb_UGF1_Pv_hi "FCtl_FTB_0x04(252)" VALUE 0x001E5E13 /* @ECU_Address@FCtl_FTB_0x04@0x024C50FC@ */ ECIPP_ALIGNMENT_UBYTE 255 Compu_IDENTITY 0 255 PHYS_UNIT "FTB" /end CHARACTERISTIC
/begin CHARACTERISTIC FCftb_UGF1_Pv_lo "FCtl_FTB_0x04(253)" VALUE 0x001E5E14 /* @ECU_Address@FCtl_FTB_0x04@0x024C50FD@ */ ECIPP_ALIGNMENT_UBYTE 255 Compu_IDENTITY 0 255 PHYS_UNIT "FTB" /end CHARACTERISTIC
/begin CHARACTERISTIC FCftb_UGF1_PvFB_hi "FCtl_FTB_0x04(248)" VALUE 0x001E5E0F /* @ECU_Address@FCtl_FTB_0x04@0x024C50F8@ */ ECIPP_ALIGNMENT_UBYTE 255 Compu_IDENTITY 0 255 PHYS_UNIT "FTB" /end CHARACTERISTIC
/begin CHARACTERISTIC FCftb_UGF1_PvFB_lo "FCtl_FTB_0x04(249)" VALUE 0x001E5E10 /* @ECU_Address@FCtl_FTB_0x04@0x024C50F9@ */ ECIPP_ALIGNMENT_UBYTE 255 Compu_IDENTITY 0 255 PHYS_UNIT "FTB" /end CHARACTERISTIC
/begin CHARACTERISTIC FCftb_UGF1_R_lo "FCtl_FTB_0x04(245)" VALUE 0x001E5E0C /* @ECU_Address@FCtl_FTB_0x04@0x024C50F5@ */ ECIPP_ALIGNMENT_UBYTE 255 Compu_IDENTITY 0 255 PHYS_UNIT "FTB" /end CHARACTERISTIC
/begin CHARACTERISTIC FCftb_UGF1_rtn_hi "FCtl_FTB_0x04(246)" VALUE 0x001E5E0D /* @ECU_Address@FCtl_FTB_0x04@0x024C50F6@ */ ECIPP_ALIGNMENT_UBYTE 255 Compu_IDENTITY 0 255 PHYS_UNIT "FTB" /end CHARACTERISTIC
/begin CHARACTERISTIC FCftb_UGF1_rtn_lo "FCtl_FTB_0x04(247)" VALUE 0x001E5E0E /* @ECU_Address@FCtl_FTB_0x04@0x024C50F7@ */ ECIPP_ALIGNMENT_UBYTE 255 Compu_IDENTITY 0 255 PHYS_UNIT "FTB" /end CHARACTERISTIC
/begin CHARACTERISTIC FCftb_UGF1_Sv_lo "FCtl_FTB_0x04(251)" VALUE 0x001E5E12 /* @ECU_Address@FCtl_FTB_0x04@0x024C50FB@ */ ECIPP_ALIGNMENT_UBYTE 255 Compu_IDENTITY 0 255 PHYS_UNIT "FTB" /end CHARACTERISTIC
/begin CHARACTERISTIC FCftb_UGF2_Hv_lo "FCtl_FTB_0x04(410)" VALUE 0x001E5EB1 /* @ECU_Address@FCtl_FTB_0x04@0x024C519A@ */ ECIPP_ALIGNMENT_UBYTE 255 Compu_IDENTITY 0 255 PHYS_UNIT "FTB" /end CHARACTERISTIC
/begin CHARACTERISTIC FCftb_UGF2_PR_hi "FCtl_FTB_0x04(424)" VALUE 0x001E5EBF /* @ECU_Address@FCtl_FTB_0x04@0x024C51A8@ */ ECIPP_ALIGNMENT_UBYTE 255 Compu_IDENTITY 0 255 PHYS_UNIT "FTB" /end CHARACTERISTIC
/begin CHARACTERISTIC FCftb_UGF2_PR_lo "FCtl_FTB_0x04(425)" VALUE 0x001E5EC0 /* @ECU_Address@FCtl_FTB_0x04@0x024C51A9@ */ ECIPP_ALIGNMENT_UBYTE 255 Compu_IDENTITY 0 255 PHYS_UNIT "FTB" /end CHARACTERISTIC
/begin CHARACTERISTIC FCftb_UGF2_PR_slow "FCtl_FTB_0x04(422)" VALUE 0x001E5EBD /* @ECU_Address@FCtl_FTB_0x04@0x024C51A6@ */ ECIPP_ALIGNMENT_UBYTE 255 Compu_IDENTITY 0 255 PHYS_UNIT "FTB" /end CHARACTERISTIC
/begin CHARACTERISTIC FCftb_UGF2_Pv_hi "FCtl_FTB_0x04(419)" VALUE 0x001E5EBA /* @ECU_Address@FCtl_FTB_0x04@0x024C51A3@ */ ECIPP_ALIGNMENT_UBYTE 255 Compu_IDENTITY 0 255 PHYS_UNIT "FTB" /end CHARACTERISTIC
/begin CHARACTERISTIC FCftb_UGF2_Pv_lo "FCtl_FTB_0x04(420)" VALUE 0x001E5EBB /* @ECU_Address@FCtl_FTB_0x04@0x024C51A4@ */ ECIPP_ALIGNMENT_UBYTE 255 Compu_IDENTITY 0 255 PHYS_UNIT "FTB" /end CHARACTERISTIC
/begin CHARACTERISTIC FCftb_UGF2_PvFB_hi "FCtl_FTB_0x04(415)" VALUE 0x001E5EB6 /* @ECU_Address@FCtl_FTB_0x04@0x024C519F@ */ ECIPP_ALIGNMENT_UBYTE 255 Compu_IDENTITY 0 255 PHYS_UNIT "FTB" /end CHARACTERISTIC
/begin CHARACTERISTIC FCftb_UGF2_PvFB_lo "FCtl_FTB_0x04(416)" VALUE 0x001E5EB7 /* @ECU_Address@FCtl_FTB_0x04@0x024C51A0@ */ ECIPP_ALIGNMENT_UBYTE 255 Compu_IDENTITY 0 255 PHYS_UNIT "FTB" /end CHARACTERISTIC
/begin CHARACTERISTIC FCftb_UGF2_R_lo "FCtl_FTB_0x04(412)" VALUE 0x001E5EB3 /* @ECU_Address@FCtl_FTB_0x04@0x024C519C@ */ ECIPP_ALIGNMENT_UBYTE 255 Compu_IDENTITY 0 255 PHYS_UNIT "FTB" /end CHARACTERISTIC
/begin CHARACTERISTIC FCftb_UGF2_rtn_hi "FCtl_FTB_0x04(413)" VALUE 0x001E5EB4 /* @ECU_Address@FCtl_FTB_0x04@0x024C519D@ */ ECIPP_ALIGNMENT_UBYTE 255 Compu_IDENTITY 0 255 PHYS_UNIT "FTB" /end CHARACTERISTIC
/begin CHARACTERISTIC FCftb_UGF2_rtn_lo "FCtl_FTB_0x04(414)" VALUE 0x001E5EB5 /* @ECU_Address@FCtl_FTB_0x04@0x024C519E@ */ ECIPP_ALIGNMENT_UBYTE 255 Compu_IDENTITY 0 255 PHYS_UNIT "FTB" /end CHARACTERISTIC
/begin CHARACTERISTIC FCftb_UGF2_Sv_lo "FCtl_FTB_0x04(418)" VALUE 0x001E5EB9 /* @ECU_Address@FCtl_FTB_0x04@0x024C51A2@ */ ECIPP_ALIGNMENT_UBYTE 255 Compu_IDENTITY 0 255 PHYS_UNIT "FTB" /end CHARACTERISTIC
/begin CHARACTERISTIC FCftb_UGF3_Hv_lo "FCtl_FTB_0x04(606)" VALUE 0x001E5F75 /* @ECU_Address@FCtl_FTB_0x04@0x024C525E@ */ ECIPP_ALIGNMENT_UBYTE 255 Compu_IDENTITY 0 255 PHYS_UNIT "FTB" /end CHARACTERISTIC
/begin CHARACTERISTIC FCftb_UGF3_PR_hi "FCtl_FTB_0x04(620)" VALUE 0x001E5F83 /* @ECU_Address@FCtl_FTB_0x04@0x024C526C@ */ ECIPP_ALIGNMENT_UBYTE 255 Compu_IDENTITY 0 255 PHYS_UNIT "FTB" /end CHARACTERISTIC
/begin CHARACTERISTIC FCftb_UGF3_PR_lo "FCtl_FTB_0x04(621)" VALUE 0x001E5F84 /* @ECU_Address@FCtl_FTB_0x04@0x024C526D@ */ ECIPP_ALIGNMENT_UBYTE 255 Compu_IDENTITY 0 255 PHYS_UNIT "FTB" /end CHARACTERISTIC
/begin CHARACTERISTIC FCftb_UGF3_PR_slow "FCtl_FTB_0x04(618)" VALUE 0x001E5F81 /* @ECU_Address@FCtl_FTB_0x04@0x024C526A@ */ ECIPP_ALIGNMENT_UBYTE 255 Compu_IDENTITY 0 255 PHYS_UNIT "FTB" /end CHARACTERISTIC
/begin CHARACTERISTIC FCftb_UGF3_Pv_hi "FCtl_FTB_0x04(615)" VALUE 0x001E5F7E /* @ECU_Address@FCtl_FTB_0x04@0x024C5267@ */ ECIPP_ALIGNMENT_UBYTE 255 Compu_IDENTITY 0 255 PHYS_UNIT "FTB" /end CHARACTERISTIC
/begin CHARACTERISTIC FCftb_UGF3_Pv_lo "FCtl_FTB_0x04(616)" VALUE 0x001E5F7F /* @ECU_Address@FCtl_FTB_0x04@0x024C5268@ */ ECIPP_ALIGNMENT_UBYTE 255 Compu_IDENTITY 0 255 PHYS_UNIT "FTB" /end CHARACTERISTIC
/begin CHARACTERISTIC FCftb_UGF3_PvFB_hi "FCtl_FTB_0x04(611)" VALUE 0x001E5F7A /* @ECU_Address@FCtl_FTB_0x04@0x024C5263@ */ ECIPP_ALIGNMENT_UBYTE 255 Compu_IDENTITY 0 255 PHYS_UNIT "FTB" /end CHARACTERISTIC
/begin CHARACTERISTIC FCftb_UGF3_PvFB_lo "FCtl_FTB_0x04(612)" VALUE 0x001E5F7B /* @ECU_Address@FCtl_FTB_0x04@0x024C5264@ */ ECIPP_ALIGNMENT_UBYTE 255 Compu_IDENTITY 0 255 PHYS_UNIT "FTB" /end CHARACTERISTIC
/begin CHARACTERISTIC FCftb_UGF3_R_lo "FCtl_FTB_0x04(608)" VALUE 0x001E5F77 /* @ECU_Address@FCtl_FTB_0x04@0x024C5260@ */ ECIPP_ALIGNMENT_UBYTE 255 Compu_IDENTITY 0 255 PHYS_UNIT "FTB" /end CHARACTERISTIC
/begin CHARACTERISTIC FCftb_UGF3_rtn_hi "FCtl_FTB_0x04(609)" VALUE 0x001E5F78 /* @ECU_Address@FCtl_FTB_0x04@0x024C5261@ */ ECIPP_ALIGNMENT_UBYTE 255 Compu_IDENTITY 0 255 PHYS_UNIT "FTB" /end CHARACTERISTIC
/begin CHARACTERISTIC FCftb_UGF3_rtn_lo "FCtl_FTB_0x04(610)" VALUE 0x001E5F79 /* @ECU_Address@FCtl_FTB_0x04@0x024C5262@ */ ECIPP_ALIGNMENT_UBYTE 255 Compu_IDENTITY 0 255 PHYS_UNIT "FTB" /end CHARACTERISTIC
/begin CHARACTERISTIC FCftb_UGF3_Sv_lo "FCtl_FTB_0x04(614)" VALUE 0x001E5F7D /* @ECU_Address@FCtl_FTB_0x04@0x024C5266@ */ ECIPP_ALIGNMENT_UBYTE 255 Compu_IDENTITY 0 255 PHYS_UNIT "FTB" /end CHARACTERISTIC
/begin CHARACTERISTIC FCftb_UGF4_Hv_lo "FCtl_FTB_0x04(629)" VALUE 0x001E5F8C /* @ECU_Address@FCtl_FTB_0x04@0x024C5275@ */ ECIPP_ALIGNMENT_UBYTE 255 Compu_IDENTITY 0 255 PHYS_UNIT "FTB" /end CHARACTERISTIC
/begin CHARACTERISTIC FCftb_UGF4_PR_hi "FCtl_FTB_0x04(643)" VALUE 0x001E5F9A /* @ECU_Address@FCtl_FTB_0x04@0x024C5283@ */ ECIPP_ALIGNMENT_UBYTE 255 Compu_IDENTITY 0 255 PHYS_UNIT "FTB" /end CHARACTERISTIC
/begin CHARACTERISTIC FCftb_UGF4_PR_lo "FCtl_FTB_0x04(644)" VALUE 0x001E5F9B /* @ECU_Address@FCtl_FTB_0x04@0x024C5284@ */ ECIPP_ALIGNMENT_UBYTE 255 Compu_IDENTITY 0 255 PHYS_UNIT "FTB" /end CHARACTERISTIC
/begin CHARACTERISTIC FCftb_UGF4_PR_slow "FCtl_FTB_0x04(641)" VALUE 0x001E5F98 /* @ECU_Address@FCtl_FTB_0x04@0x024C5281@ */ ECIPP_ALIGNMENT_UBYTE 255 Compu_IDENTITY 0 255 PHYS_UNIT "FTB" /end CHARACTERISTIC
/begin CHARACTERISTIC FCftb_UGF4_Pv_hi "FCtl_FTB_0x04(638)" VALUE 0x001E5F95 /* @ECU_Address@FCtl_FTB_0x04@0x024C527E@ */ ECIPP_ALIGNMENT_UBYTE 255 Compu_IDENTITY 0 255 PHYS_UNIT "FTB" /end CHARACTERISTIC
/begin CHARACTERISTIC FCftb_UGF4_Pv_lo "FCtl_FTB_0x04(639)" VALUE 0x001E5F96 /* @ECU_Address@FCtl_FTB_0x04@0x024C527F@ */ ECIPP_ALIGNMENT_UBYTE 255 Compu_IDENTITY 0 255 PHYS_UNIT "FTB" /end CHARACTERISTIC
/begin CHARACTERISTIC FCftb_UGF4_PvFB_hi "FCtl_FTB_0x04(634)" VALUE 0x001E5F91 /* @ECU_Address@FCtl_FTB_0x04@0x024C527A@ */ ECIPP_ALIGNMENT_UBYTE 255 Compu_IDENTITY 0 255 PHYS_UNIT "FTB" /end CHARACTERISTIC
/begin CHARACTERISTIC FCftb_UGF4_PvFB_lo "FCtl_FTB_0x04(635)" VALUE 0x001E5F92 /* @ECU_Address@FCtl_FTB_0x04@0x024C527B@ */ ECIPP_ALIGNMENT_UBYTE 255 Compu_IDENTITY 0 255 PHYS_UNIT "FTB" /end CHARACTERISTIC
/begin CHARACTERISTIC FCftb_UGF4_R_lo "FCtl_FTB_0x04(631)" VALUE 0x001E5F8E /* @ECU_Address@FCtl_FTB_0x04@0x024C5277@ */ ECIPP_ALIGNMENT_UBYTE 255 Compu_IDENTITY 0 255 PHYS_UNIT "FTB" /end CHARACTERISTIC
/begin CHARACTERISTIC FCftb_UGF4_rtn_hi "FCtl_FTB_0x04(632)" VALUE 0x001E5F8F /* @ECU_Address@FCtl_FTB_0x04@0x024C5278@ */ ECIPP_ALIGNMENT_UBYTE 255 Compu_IDENTITY 0 255 PHYS_UNIT "FTB" /end CHARACTERISTIC
/begin CHARACTERISTIC FCftb_UGF4_rtn_lo "FCtl_FTB_0x04(633)" VALUE 0x001E5F90 /* @ECU_Address@FCtl_FTB_0x04@0x024C5279@ */ ECIPP_ALIGNMENT_UBYTE 255 Compu_IDENTITY 0 255 PHYS_UNIT "FTB" /end CHARACTERISTIC
/begin CHARACTERISTIC FCftb_UGF4_Sv_lo "FCtl_FTB_0x04(637)" VALUE 0x001E5F94 /* @ECU_Address@FCtl_FTB_0x04@0x024C527D@ */ ECIPP_ALIGNMENT_UBYTE 255 Compu_IDENTITY 0 255 PHYS_UNIT "FTB" /end CHARACTERISTIC
/begin CHARACTERISTIC FCspn_AL2_hi "FCtl_SPN(40)" VALUE 0x001E1E04 /* @ECU_Address@FCtl_SPN@0x21B600A0@ */ ECIPP_ALIGNMENT_ULONG 4294967295 Compu_IDENTITY 0 4294967295 PHYS_UNIT "SPN" /end CHARACTERISTIC
/begin CHARACTERISTIC FCspn_AL2_lo "FCtl_SPN(41)" VALUE 0x001E1E08 /* @ECU_Address@FCtl_SPN@0x21B600A4@ */ ECIPP_ALIGNMENT_ULONG 4294967295 Compu_IDENTITY 0 4294967295 PHYS_UNIT "SPN" /end CHARACTERISTIC
/begin CHARACTERISTIC FCspn_CD_MF10 "FCtl_SPN(994)" VALUE 0x001E2CEC /* @ECU_Address@FCtl_SPN@0x21B60F88@ */ ECIPP_ALIGNMENT_ULONG 4294967295 Compu_IDENTITY 0 4294967295 PHYS_UNIT "SPN" /end CHARACTERISTIC
/begin CHARACTERISTIC FCspn_CD_MF11 "FCtl_SPN(995)" VALUE 0x001E2CF0 /* @ECU_Address@FCtl_SPN@0x21B60F8C@ */ ECIPP_ALIGNMENT_ULONG 4294967295 Compu_IDENTITY 0 4294967295 PHYS_UNIT "SPN" /end CHARACTERISTIC
/begin CHARACTERISTIC FCspn_CD_MF12 "FCtl_SPN(996)" VALUE 0x001E2CF4 /* @ECU_Address@FCtl_SPN@0x21B60F90@ */ ECIPP_ALIGNMENT_ULONG 4294967295 Compu_IDENTITY 0 4294967295 PHYS_UNIT "SPN" /end CHARACTERISTIC
/begin CHARACTERISTIC FCspn_CD_MF2 "FCtl_SPN(986)" VALUE 0x001E2CCC /* @ECU_Address@FCtl_SPN@0x21B60F68@ */ ECIPP_ALIGNMENT_ULONG 4294967295 Compu_IDENTITY 0 4294967295 PHYS_UNIT "SPN" /end CHARACTERISTIC
/begin CHARACTERISTIC FCspn_CD_MF3 "FCtl_SPN(987)" VALUE 0x001E2CD0 /* @ECU_Address@FCtl_SPN@0x21B60F6C@ */ ECIPP_ALIGNMENT_ULONG 4294967295 Compu_IDENTITY 0 4294967295 PHYS_UNIT "SPN" /end CHARACTERISTIC
/begin CHARACTERISTIC FCspn_CD_MF4 "FCtl_SPN(988)" VALUE 0x001E2CD4 /* @ECU_Address@FCtl_SPN@0x21B60F70@ */ ECIPP_ALIGNMENT_ULONG 4294967295 Compu_IDENTITY 0 4294967295 PHYS_UNIT "SPN" /end CHARACTERISTIC
/begin CHARACTERISTIC FCspn_CD_MF5 "FCtl_SPN(989)" VALUE 0x001E2CD8 /* @ECU_Address@FCtl_SPN@0x21B60F74@ */ ECIPP_ALIGNMENT_ULONG 4294967295 Compu_IDENTITY 0 4294967295 PHYS_UNIT "SPN" /end CHARACTERISTIC
/begin CHARACTERISTIC FCspn_CD_MF6 "FCtl_SPN(990)" VALUE 0x001E2CDC /* @ECU_Address@FCtl_SPN@0x21B60F78@ */ ECIPP_ALIGNMENT_ULONG 4294967295 Compu_IDENTITY 0 4294967295 PHYS_UNIT "SPN" /end CHARACTERISTIC
/begin CHARACTERISTIC FCspn_CD_MF7 "FCtl_SPN(991)" VALUE 0x001E2CE0 /* @ECU_Address@FCtl_SPN@0x21B60F7C@ */ ECIPP_ALIGNMENT_ULONG 4294967295 Compu_IDENTITY 0 4294967295 PHYS_UNIT "SPN" /end CHARACTERISTIC
/begin CHARACTERISTIC FCspn_CD_MF8 "FCtl_SPN(992)" VALUE 0x001E2CE4 /* @ECU_Address@FCtl_SPN@0x21B60F80@ */ ECIPP_ALIGNMENT_ULONG 4294967295 Compu_IDENTITY 0 4294967295 PHYS_UNIT "SPN" /end CHARACTERISTIC
/begin CHARACTERISTIC FCspn_CD_MF9 "FCtl_SPN(993)" VALUE 0x001E2CE8 /* @ECU_Address@FCtl_SPN@0x21B60F84@ */ ECIPP_ALIGNMENT_ULONG 4294967295 Compu_IDENTITY 0 4294967295 PHYS_UNIT "SPN" /end CHARACTERISTIC
/begin CHARACTERISTIC FCspn_CFVxminFT "FCtl_SPN(533)" VALUE 0x001E25B8 /* @ECU_Address@FCtl_SPN@0x21B60854@ */ ECIPP_ALIGNMENT_ULONG 4294967295 Compu_IDENTITY 0 4294967295 PHYS_UNIT "SPN" /end CHARACTERISTIC
/begin CHARACTERISTIC FCspn_CL2_hi "FCtl_SPN(34)" VALUE 0x001E1DEC /* @ECU_Address@FCtl_SPN@0x21B60088@ */ ECIPP_ALIGNMENT_ULONG 4294967295 Compu_IDENTITY 0 4294967295 PHYS_UNIT "SPN" /end CHARACTERISTIC
/begin CHARACTERISTIC FCspn_CL2_lo "FCtl_SPN(35)" VALUE 0x001E1DF0 /* @ECU_Address@FCtl_SPN@0x21B6008C@ */ ECIPP_ALIGNMENT_ULONG 4294967295 Compu_IDENTITY 0 4294967295 PHYS_UNIT "SPN" /end CHARACTERISTIC
/begin CHARACTERISTIC FCspn_CM2_unresp "FCtl_SPN(800)" VALUE 0x001E29E4 /* @ECU_Address@FCtl_SPN@0x21B60C80@ */ ECIPP_ALIGNMENT_ULONG 4294967295 Compu_IDENTITY 0 4294967295 PHYS_UNIT "SPN" /end CHARACTERISTIC
/begin CHARACTERISTIC FCspn_CM2gsln_inact "FCtl_SPN(199)" VALUE 0x001E2080 /* @ECU_Address@FCtl_SPN@0x21B6031C@ */ ECIPP_ALIGNMENT_ULONG 4294967295 Compu_IDENTITY 0 4294967295 PHYS_UNIT "SPN" /end CHARACTERISTIC
/begin CHARACTERISTIC FCspn_EGO4_open "FCtl_SPN(200)" VALUE 0x001E2084 /* @ECU_Address@FCtl_SPN@0x21B60320@ */ ECIPP_ALIGNMENT_ULONG 4294967295 Compu_IDENTITY 0 4294967295 PHYS_UNIT "SPN" /end CHARACTERISTIC
/begin CHARACTERISTIC FCspn_EMWT2_HiExp1 "FCtl_SPN(226)" VALUE 0x001E20EC /* @ECU_Address@FCtl_SPN@0x21B60388@ */ ECIPP_ALIGNMENT_ULONG 4294967295 Compu_IDENTITY 0 4294967295 PHYS_UNIT "SPN" /end CHARACTERISTIC
/begin CHARACTERISTIC FCspn_EMWT2_HiExp2 "FCtl_SPN(228)" VALUE 0x001E20F4 /* @ECU_Address@FCtl_SPN@0x21B60390@ */ ECIPP_ALIGNMENT_ULONG 4294967295 Compu_IDENTITY 0 4294967295 PHYS_UNIT "SPN" /end CHARACTERISTIC
/begin CHARACTERISTIC FCspn_EMWT2_maxv "FCtl_SPN(222)" VALUE 0x001E20DC /* @ECU_Address@FCtl_SPN@0x21B60378@ */ ECIPP_ALIGNMENT_ULONG 4294967295 Compu_IDENTITY 0 4294967295 PHYS_UNIT "SPN" /end CHARACTERISTIC
/begin CHARACTERISTIC FCspn_EMWT2_minv "FCtl_SPN(224)" VALUE 0x001E20E4 /* @ECU_Address@FCtl_SPN@0x21B60380@ */ ECIPP_ALIGNMENT_ULONG 4294967295 Compu_IDENTITY 0 4294967295 PHYS_UNIT "SPN" /end CHARACTERISTIC
/begin CHARACTERISTIC FCspn_ERWT2_HiExp1 "FCtl_SPN(238)" VALUE 0x001E211C /* @ECU_Address@FCtl_SPN@0x21B603B8@ */ ECIPP_ALIGNMENT_ULONG 4294967295 Compu_IDENTITY 0 4294967295 PHYS_UNIT "SPN" /end CHARACTERISTIC
/begin CHARACTERISTIC FCspn_ERWT2_HiExp2 "FCtl_SPN(240)" VALUE 0x001E2124 /* @ECU_Address@FCtl_SPN@0x21B603C0@ */ ECIPP_ALIGNMENT_ULONG 4294967295 Compu_IDENTITY 0 4294967295 PHYS_UNIT "SPN" /end CHARACTERISTIC
/begin CHARACTERISTIC FCspn_ERWT2_maxv "FCtl_SPN(234)" VALUE 0x001E210C /* @ECU_Address@FCtl_SPN@0x21B603A8@ */ ECIPP_ALIGNMENT_ULONG 4294967295 Compu_IDENTITY 0 4294967295 PHYS_UNIT "SPN" /end CHARACTERISTIC
/begin CHARACTERISTIC FCspn_ERWT2_minv "FCtl_SPN(236)" VALUE 0x001E2114 /* @ECU_Address@FCtl_SPN@0x21B603B0@ */ ECIPP_ALIGNMENT_ULONG 4294967295 Compu_IDENTITY 0 4294967295 PHYS_UNIT "SPN" /end CHARACTERISTIC
/begin CHARACTERISTIC FCspn_GLOW10_open "FCtl_SPN(492)" VALUE 0x001E2514 /* @ECU_Address@FCtl_SPN@0x21B607B0@ */ ECIPP_ALIGNMENT_ULONG 4294967295 Compu_IDENTITY 0 4294967295 PHYS_UNIT "SPN" /end CHARACTERISTIC
/begin CHARACTERISTIC FCspn_GLOW10_short "FCtl_SPN(502)" VALUE 0x001E253C /* @ECU_Address@FCtl_SPN@0x21B607D8@ */ ECIPP_ALIGNMENT_ULONG 4294967295 Compu_IDENTITY 0 4294967295 PHYS_UNIT "SPN" /end CHARACTERISTIC
/begin CHARACTERISTIC FCspn_GLOW11_open "FCtl_SPN(1033)" VALUE 0x001E2D88 /* @ECU_Address@FCtl_SPN@0x21B61024@ */ ECIPP_ALIGNMENT_ULONG 4294967295 Compu_IDENTITY 0 4294967295 PHYS_UNIT "SPN" /end CHARACTERISTIC
/begin CHARACTERISTIC FCspn_GLOW11_short "FCtl_SPN(1035)" VALUE 0x001E2D90 /* @ECU_Address@FCtl_SPN@0x21B6102C@ */ ECIPP_ALIGNMENT_ULONG 4294967295 Compu_IDENTITY 0 4294967295 PHYS_UNIT "SPN" /end CHARACTERISTIC
/begin CHARACTERISTIC FCspn_GLOW12_open "FCtl_SPN(1034)" VALUE 0x001E2D8C /* @ECU_Address@FCtl_SPN@0x21B61028@ */ ECIPP_ALIGNMENT_ULONG 4294967295 Compu_IDENTITY 0 4294967295 PHYS_UNIT "SPN" /end CHARACTERISTIC
/begin CHARACTERISTIC FCspn_GLOW12_short "FCtl_SPN(1036)" VALUE 0x001E2D94 /* @ECU_Address@FCtl_SPN@0x21B61030@ */ ECIPP_ALIGNMENT_ULONG 4294967295 Compu_IDENTITY 0 4294967295 PHYS_UNIT "SPN" /end CHARACTERISTIC
/begin CHARACTERISTIC FCspn_GLOW2_open "FCtl_SPN(484)" VALUE 0x001E24F4 /* @ECU_Address@FCtl_SPN@0x21B60790@ */ ECIPP_ALIGNMENT_ULONG 4294967295 Compu_IDENTITY 0 4294967295 PHYS_UNIT "SPN" /end CHARACTERISTIC
/begin CHARACTERISTIC FCspn_GLOW2_short "FCtl_SPN(494)" VALUE 0x001E251C /* @ECU_Address@FCtl_SPN@0x21B607B8@ */ ECIPP_ALIGNMENT_ULONG 4294967295 Compu_IDENTITY 0 4294967295 PHYS_UNIT "SPN" /end CHARACTERISTIC
/begin CHARACTERISTIC FCspn_GLOW3_open "FCtl_SPN(485)" VALUE 0x001E24F8 /* @ECU_Address@FCtl_SPN@0x21B60794@ */ ECIPP_ALIGNMENT_ULONG 4294967295 Compu_IDENTITY 0 4294967295 PHYS_UNIT "SPN" /end CHARACTERISTIC
/begin CHARACTERISTIC FCspn_GLOW3_short "FCtl_SPN(495)" VALUE 0x001E2520 /* @ECU_Address@FCtl_SPN@0x21B607BC@ */ ECIPP_ALIGNMENT_ULONG 4294967295 Compu_IDENTITY 0 4294967295 PHYS_UNIT "SPN" /end CHARACTERISTIC
/begin CHARACTERISTIC FCspn_GLOW4_open "FCtl_SPN(486)" VALUE 0x001E24FC /* @ECU_Address@FCtl_SPN@0x21B60798@ */ ECIPP_ALIGNMENT_ULONG 4294967295 Compu_IDENTITY 0 4294967295 PHYS_UNIT "SPN" /end CHARACTERISTIC
/begin CHARACTERISTIC FCspn_GLOW4_short "FCtl_SPN(496)" VALUE 0x001E2524 /* @ECU_Address@FCtl_SPN@0x21B607C0@ */ ECIPP_ALIGNMENT_ULONG 4294967295 Compu_IDENTITY 0 4294967295 PHYS_UNIT "SPN" /end CHARACTERISTIC
/begin CHARACTERISTIC FCspn_GLOW5_open "FCtl_SPN(487)" VALUE 0x001E2500 /* @ECU_Address@FCtl_SPN@0x21B6079C@ */ ECIPP_ALIGNMENT_ULONG 4294967295 Compu_IDENTITY 0 4294967295 PHYS_UNIT "SPN" /end CHARACTERISTIC
/begin CHARACTERISTIC FCspn_GLOW5_short "FCtl_SPN(497)" VALUE 0x001E2528 /* @ECU_Address@FCtl_SPN@0x21B607C4@ */ ECIPP_ALIGNMENT_ULONG 4294967295 Compu_IDENTITY 0 4294967295 PHYS_UNIT "SPN" /end CHARACTERISTIC
/begin CHARACTERISTIC FCspn_GLOW6_open "FCtl_SPN(488)" VALUE 0x001E2504 /* @ECU_Address@FCtl_SPN@0x21B607A0@ */ ECIPP_ALIGNMENT_ULONG 4294967295 Compu_IDENTITY 0 4294967295 PHYS_UNIT "SPN" /end CHARACTERISTIC
/begin CHARACTERISTIC FCspn_GLOW6_short "FCtl_SPN(498)" VALUE 0x001E252C /* @ECU_Address@FCtl_SPN@0x21B607C8@ */ ECIPP_ALIGNMENT_ULONG 4294967295 Compu_IDENTITY 0 4294967295 PHYS_UNIT "SPN" /end CHARACTERISTIC
/begin CHARACTERISTIC FCspn_GLOW7_open "FCtl_SPN(489)" VALUE 0x001E2508 /* @ECU_Address@FCtl_SPN@0x21B607A4@ */ ECIPP_ALIGNMENT_ULONG 4294967295 Compu_IDENTITY 0 4294967295 PHYS_UNIT "SPN" /end CHARACTERISTIC
/begin CHARACTERISTIC FCspn_GLOW7_short "FCtl_SPN(499)" VALUE 0x001E2530 /* @ECU_Address@FCtl_SPN@0x21B607CC@ */ ECIPP_ALIGNMENT_ULONG 4294967295 Compu_IDENTITY 0 4294967295 PHYS_UNIT "SPN" /end CHARACTERISTIC
/begin CHARACTERISTIC FCspn_GLOW8_open "FCtl_SPN(490)" VALUE 0x001E250C /* @ECU_Address@FCtl_SPN@0x21B607A8@ */ ECIPP_ALIGNMENT_ULONG 4294967295 Compu_IDENTITY 0 4294967295 PHYS_UNIT "SPN" /end CHARACTERISTIC
/begin CHARACTERISTIC FCspn_GLOW8_short "FCtl_SPN(500)" VALUE 0x001E2534 /* @ECU_Address@FCtl_SPN@0x21B607D0@ */ ECIPP_ALIGNMENT_ULONG 4294967295 Compu_IDENTITY 0 4294967295 PHYS_UNIT "SPN" /end CHARACTERISTIC
/begin CHARACTERISTIC FCspn_GLOW9_open "FCtl_SPN(491)" VALUE 0x001E2510 /* @ECU_Address@FCtl_SPN@0x21B607AC@ */ ECIPP_ALIGNMENT_ULONG 4294967295 Compu_IDENTITY 0 4294967295 PHYS_UNIT "SPN" /end CHARACTERISTIC
/begin CHARACTERISTIC FCspn_GLOW9_short "FCtl_SPN(501)" VALUE 0x001E2538 /* @ECU_Address@FCtl_SPN@0x21B607D4@ */ ECIPP_ALIGNMENT_ULONG 4294967295 Compu_IDENTITY 0 4294967295 PHYS_UNIT "SPN" /end CHARACTERISTIC
/begin CHARACTERISTIC FCspn_ICAVD10_mis "FCtl_SPN(315)" VALUE 0x001E2250 /* @ECU_Address@FCtl_SPN@0x21B604EC@ */ ECIPP_ALIGNMENT_ULONG 4294967295 Compu_IDENTITY 0 4294967295 PHYS_UNIT "SPN" /end CHARACTERISTIC
/begin CHARACTERISTIC FCspn_ICAVD10_miscat "FCtl_SPN(317)" VALUE 0x001E2258 /* @ECU_Address@FCtl_SPN@0x21B604F4@ */ ECIPP_ALIGNMENT_ULONG 4294967295 Compu_IDENTITY 0 4294967295 PHYS_UNIT "SPN" /end CHARACTERISTIC
/begin CHARACTERISTIC FCspn_ICAVD11_mis "FCtl_SPN(1029)" VALUE 0x001E2D78 /* @ECU_Address@FCtl_SPN@0x21B61014@ */ ECIPP_ALIGNMENT_ULONG 4294967295 Compu_IDENTITY 0 4294967295 PHYS_UNIT "SPN" /end CHARACTERISTIC
/begin CHARACTERISTIC FCspn_ICAVD11_miscat "FCtl_SPN(1031)" VALUE 0x001E2D80 /* @ECU_Address@FCtl_SPN@0x21B6101C@ */ ECIPP_ALIGNMENT_ULONG 4294967295 Compu_IDENTITY 0 4294967295 PHYS_UNIT "SPN" /end CHARACTERISTIC
/begin CHARACTERISTIC FCspn_ICAVD12_mis "FCtl_SPN(1030)" VALUE 0x001E2D7C /* @ECU_Address@FCtl_SPN@0x21B61018@ */ ECIPP_ALIGNMENT_ULONG 4294967295 Compu_IDENTITY 0 4294967295 PHYS_UNIT "SPN" /end CHARACTERISTIC
/begin CHARACTERISTIC FCspn_ICAVD12_miscat "FCtl_SPN(1032)" VALUE 0x001E2D84 /* @ECU_Address@FCtl_SPN@0x21B61020@ */ ECIPP_ALIGNMENT_ULONG 4294967295 Compu_IDENTITY 0 4294967295 PHYS_UNIT "SPN" /end CHARACTERISTIC
/begin CHARACTERISTIC FCspn_ICAVD2_mis "FCtl_SPN(260)" VALUE 0x001E2174 /* @ECU_Address@FCtl_SPN@0x21B60410@ */ ECIPP_ALIGNMENT_ULONG 4294967295 Compu_IDENTITY 0 4294967295 PHYS_UNIT "SPN" /end CHARACTERISTIC
/begin CHARACTERISTIC FCspn_ICAVD2_miscat "FCtl_SPN(268)" VALUE 0x001E2194 /* @ECU_Address@FCtl_SPN@0x21B60430@ */ ECIPP_ALIGNMENT_ULONG 4294967295 Compu_IDENTITY 0 4294967295 PHYS_UNIT "SPN" /end CHARACTERISTIC
/begin CHARACTERISTIC FCspn_ICAVD3_mis "FCtl_SPN(261)" VALUE 0x001E2178 /* @ECU_Address@FCtl_SPN@0x21B60414@ */ ECIPP_ALIGNMENT_ULONG 4294967295 Compu_IDENTITY 0 4294967295 PHYS_UNIT "SPN" /end CHARACTERISTIC
/begin CHARACTERISTIC FCspn_ICAVD3_miscat "FCtl_SPN(269)" VALUE 0x001E2198 /* @ECU_Address@FCtl_SPN@0x21B60434@ */ ECIPP_ALIGNMENT_ULONG 4294967295 Compu_IDENTITY 0 4294967295 PHYS_UNIT "SPN" /end CHARACTERISTIC
/begin CHARACTERISTIC FCspn_ICAVD4_mis "FCtl_SPN(262)" VALUE 0x001E217C /* @ECU_Address@FCtl_SPN@0x21B60418@ */ ECIPP_ALIGNMENT_ULONG 4294967295 Compu_IDENTITY 0 4294967295 PHYS_UNIT "SPN" /end CHARACTERISTIC
/begin CHARACTERISTIC FCspn_ICAVD4_miscat "FCtl_SPN(270)" VALUE 0x001E219C /* @ECU_Address@FCtl_SPN@0x21B60438@ */ ECIPP_ALIGNMENT_ULONG 4294967295 Compu_IDENTITY 0 4294967295 PHYS_UNIT "SPN" /end CHARACTERISTIC
/begin CHARACTERISTIC FCspn_ICAVD5_mis "FCtl_SPN(263)" VALUE 0x001E2180 /* @ECU_Address@FCtl_SPN@0x21B6041C@ */ ECIPP_ALIGNMENT_ULONG 4294967295 Compu_IDENTITY 0 4294967295 PHYS_UNIT "SPN" /end CHARACTERISTIC
/begin CHARACTERISTIC FCspn_ICAVD5_miscat "FCtl_SPN(271)" VALUE 0x001E21A0 /* @ECU_Address@FCtl_SPN@0x21B6043C@ */ ECIPP_ALIGNMENT_ULONG 4294967295 Compu_IDENTITY 0 4294967295 PHYS_UNIT "SPN" /end CHARACTERISTIC
/begin CHARACTERISTIC FCspn_ICAVD6_mis "FCtl_SPN(264)" VALUE 0x001E2184 /* @ECU_Address@FCtl_SPN@0x21B60420@ */ ECIPP_ALIGNMENT_ULONG 4294967295 Compu_IDENTITY 0 4294967295 PHYS_UNIT "SPN" /end CHARACTERISTIC
/begin CHARACTERISTIC FCspn_ICAVD6_miscat "FCtl_SPN(272)" VALUE 0x001E21A4 /* @ECU_Address@FCtl_SPN@0x21B60440@ */ ECIPP_ALIGNMENT_ULONG 4294967295 Compu_IDENTITY 0 4294967295 PHYS_UNIT "SPN" /end CHARACTERISTIC
/begin CHARACTERISTIC FCspn_ICAVD7_mis "FCtl_SPN(265)" VALUE 0x001E2188 /* @ECU_Address@FCtl_SPN@0x21B60424@ */ ECIPP_ALIGNMENT_ULONG 4294967295 Compu_IDENTITY 0 4294967295 PHYS_UNIT "SPN" /end CHARACTERISTIC
/begin CHARACTERISTIC FCspn_ICAVD7_miscat "FCtl_SPN(273)" VALUE 0x001E21A8 /* @ECU_Address@FCtl_SPN@0x21B60444@ */ ECIPP_ALIGNMENT_ULONG 4294967295 Compu_IDENTITY 0 4294967295 PHYS_UNIT "SPN" /end CHARACTERISTIC
/begin CHARACTERISTIC FCspn_ICAVD8_mis "FCtl_SPN(266)" VALUE 0x001E218C /* @ECU_Address@FCtl_SPN@0x21B60428@ */ ECIPP_ALIGNMENT_ULONG 4294967295 Compu_IDENTITY 0 4294967295 PHYS_UNIT "SPN" /end CHARACTERISTIC
/begin CHARACTERISTIC FCspn_ICAVD8_miscat "FCtl_SPN(274)" VALUE 0x001E21AC /* @ECU_Address@FCtl_SPN@0x21B60448@ */ ECIPP_ALIGNMENT_ULONG 4294967295 Compu_IDENTITY 0 4294967295 PHYS_UNIT "SPN" /end CHARACTERISTIC
/begin CHARACTERISTIC FCspn_ICAVD9_mis "FCtl_SPN(314)" VALUE 0x001E224C /* @ECU_Address@FCtl_SPN@0x21B604E8@ */ ECIPP_ALIGNMENT_ULONG 4294967295 Compu_IDENTITY 0 4294967295 PHYS_UNIT "SPN" /end CHARACTERISTIC
/begin CHARACTERISTIC FCspn_ICAVD9_miscat "FCtl_SPN(316)" VALUE 0x001E2254 /* @ECU_Address@FCtl_SPN@0x21B604F0@ */ ECIPP_ALIGNMENT_ULONG 4294967295 Compu_IDENTITY 0 4294967295 PHYS_UNIT "SPN" /end CHARACTERISTIC
/begin CHARACTERISTIC FCspn_INJD10_off_lo "FCtl_SPN(55)" VALUE 0x001E1E40 /* @ECU_Address@FCtl_SPN@0x21B600DC@ */ ECIPP_ALIGNMENT_ULONG 4294967295 Compu_IDENTITY 0 4294967295 PHYS_UNIT "SPN" /end CHARACTERISTIC
/begin CHARACTERISTIC FCspn_INJD10_on_hi "FCtl_SPN(65)" VALUE 0x001E1E68 /* @ECU_Address@FCtl_SPN@0x21B60104@ */ ECIPP_ALIGNMENT_ULONG 4294967295 Compu_IDENTITY 0 4294967295 PHYS_UNIT "SPN" /end CHARACTERISTIC
/begin CHARACTERISTIC FCspn_INJD11_off_lo "FCtl_SPN(1017)" VALUE 0x001E2D48 /* @ECU_Address@FCtl_SPN@0x21B60FE4@ */ ECIPP_ALIGNMENT_ULONG 4294967295 Compu_IDENTITY 0 4294967295 PHYS_UNIT "SPN" /end CHARACTERISTIC
/begin CHARACTERISTIC FCspn_INJD11_on_hi "FCtl_SPN(1019)" VALUE 0x001E2D50 /* @ECU_Address@FCtl_SPN@0x21B60FEC@ */ ECIPP_ALIGNMENT_ULONG 4294967295 Compu_IDENTITY 0 4294967295 PHYS_UNIT "SPN" /end CHARACTERISTIC
/begin CHARACTERISTIC FCspn_INJD12_off_lo "FCtl_SPN(1018)" VALUE 0x001E2D4C /* @ECU_Address@FCtl_SPN@0x21B60FE8@ */ ECIPP_ALIGNMENT_ULONG 4294967295 Compu_IDENTITY 0 4294967295 PHYS_UNIT "SPN" /end CHARACTERISTIC
/begin CHARACTERISTIC FCspn_INJD12_on_hi "FCtl_SPN(1020)" VALUE 0x001E2D54 /* @ECU_Address@FCtl_SPN@0x21B60FF0@ */ ECIPP_ALIGNMENT_ULONG 4294967295 Compu_IDENTITY 0 4294967295 PHYS_UNIT "SPN" /end CHARACTERISTIC
/begin CHARACTERISTIC FCspn_INJD2_boost_lo "FCtl_SPN(579)" VALUE 0x001E2670 /* @ECU_Address@FCtl_SPN@0x21B6090C@ */ ECIPP_ALIGNMENT_ULONG 4294967295 Compu_IDENTITY 0 4294967295 PHYS_UNIT "SPN" /end CHARACTERISTIC
/begin CHARACTERISTIC FCspn_INJD2_HS_Ihi "FCtl_SPN(563)" VALUE 0x001E2630 /* @ECU_Address@FCtl_SPN@0x21B608CC@ */ ECIPP_ALIGNMENT_ULONG 4294967295 Compu_IDENTITY 0 4294967295 PHYS_UNIT "SPN" /end CHARACTERISTIC
/begin CHARACTERISTIC FCspn_INJD2_HW_int "FCtl_SPN(581)" VALUE 0x001E2678 /* @ECU_Address@FCtl_SPN@0x21B60914@ */ ECIPP_ALIGNMENT_ULONG 4294967295 Compu_IDENTITY 0 4294967295 PHYS_UNIT "SPN" /end CHARACTERISTIC
/begin CHARACTERISTIC FCspn_INJD2_LS_Ihi "FCtl_SPN(571)" VALUE 0x001E2650 /* @ECU_Address@FCtl_SPN@0x21B608EC@ */ ECIPP_ALIGNMENT_ULONG 4294967295 Compu_IDENTITY 0 4294967295 PHYS_UNIT "SPN" /end CHARACTERISTIC
/begin CHARACTERISTIC FCspn_INJD2_off_lo "FCtl_SPN(47)" VALUE 0x001E1E20 /* @ECU_Address@FCtl_SPN@0x21B600BC@ */ ECIPP_ALIGNMENT_ULONG 4294967295 Compu_IDENTITY 0 4294967295 PHYS_UNIT "SPN" /end CHARACTERISTIC
/begin CHARACTERISTIC FCspn_INJD2_on_hi "FCtl_SPN(57)" VALUE 0x001E1E48 /* @ECU_Address@FCtl_SPN@0x21B600E4@ */ ECIPP_ALIGNMENT_ULONG 4294967295 Compu_IDENTITY 0 4294967295 PHYS_UNIT "SPN" /end CHARACTERISTIC
/begin CHARACTERISTIC FCspn_INJD3_HS_Ihi "FCtl_SPN(564)" VALUE 0x001E2634 /* @ECU_Address@FCtl_SPN@0x21B608D0@ */ ECIPP_ALIGNMENT_ULONG 4294967295 Compu_IDENTITY 0 4294967295 PHYS_UNIT "SPN" /end CHARACTERISTIC
/begin CHARACTERISTIC FCspn_INJD3_LS_Ihi "FCtl_SPN(572)" VALUE 0x001E2654 /* @ECU_Address@FCtl_SPN@0x21B608F0@ */ ECIPP_ALIGNMENT_ULONG 4294967295 Compu_IDENTITY 0 4294967295 PHYS_UNIT "SPN" /end CHARACTERISTIC
/begin CHARACTERISTIC FCspn_INJD3_off_lo "FCtl_SPN(48)" VALUE 0x001E1E24 /* @ECU_Address@FCtl_SPN@0x21B600C0@ */ ECIPP_ALIGNMENT_ULONG 4294967295 Compu_IDENTITY 0 4294967295 PHYS_UNIT "SPN" /end CHARACTERISTIC
/begin CHARACTERISTIC FCspn_INJD3_on_hi "FCtl_SPN(58)" VALUE 0x001E1E4C /* @ECU_Address@FCtl_SPN@0x21B600E8@ */ ECIPP_ALIGNMENT_ULONG 4294967295 Compu_IDENTITY 0 4294967295 PHYS_UNIT "SPN" /end CHARACTERISTIC
/begin CHARACTERISTIC FCspn_INJD4_HS_Ihi "FCtl_SPN(565)" VALUE 0x001E2638 /* @ECU_Address@FCtl_SPN@0x21B608D4@ */ ECIPP_ALIGNMENT_ULONG 4294967295 Compu_IDENTITY 0 4294967295 PHYS_UNIT "SPN" /end CHARACTERISTIC
/begin CHARACTERISTIC FCspn_INJD4_LS_Ihi "FCtl_SPN(573)" VALUE 0x001E2658 /* @ECU_Address@FCtl_SPN@0x21B608F4@ */ ECIPP_ALIGNMENT_ULONG 4294967295 Compu_IDENTITY 0 4294967295 PHYS_UNIT "SPN" /end CHARACTERISTIC
/begin CHARACTERISTIC FCspn_INJD4_off_lo "FCtl_SPN(49)" VALUE 0x001E1E28 /* @ECU_Address@FCtl_SPN@0x21B600C4@ */ ECIPP_ALIGNMENT_ULONG 4294967295 Compu_IDENTITY 0 4294967295 PHYS_UNIT "SPN" /end CHARACTERISTIC
/begin CHARACTERISTIC FCspn_INJD4_on_hi "FCtl_SPN(59)" VALUE 0x001E1E50 /* @ECU_Address@FCtl_SPN@0x21B600EC@ */ ECIPP_ALIGNMENT_ULONG 4294967295 Compu_IDENTITY 0 4294967295 PHYS_UNIT "SPN" /end CHARACTERISTIC
/begin CHARACTERISTIC FCspn_INJD5_HS_Ihi "FCtl_SPN(566)" VALUE 0x001E263C /* @ECU_Address@FCtl_SPN@0x21B608D8@ */ ECIPP_ALIGNMENT_ULONG 4294967295 Compu_IDENTITY 0 4294967295 PHYS_UNIT "SPN" /end CHARACTERISTIC
/begin CHARACTERISTIC FCspn_INJD5_LS_Ihi "FCtl_SPN(574)" VALUE 0x001E265C /* @ECU_Address@FCtl_SPN@0x21B608F8@ */ ECIPP_ALIGNMENT_ULONG 4294967295 Compu_IDENTITY 0 4294967295 PHYS_UNIT "SPN" /end CHARACTERISTIC
/begin CHARACTERISTIC FCspn_INJD5_off_lo "FCtl_SPN(50)" VALUE 0x001E1E2C /* @ECU_Address@FCtl_SPN@0x21B600C8@ */ ECIPP_ALIGNMENT_ULONG 4294967295 Compu_IDENTITY 0 4294967295 PHYS_UNIT "SPN" /end CHARACTERISTIC
/begin CHARACTERISTIC FCspn_INJD5_on_hi "FCtl_SPN(60)" VALUE 0x001E1E54 /* @ECU_Address@FCtl_SPN@0x21B600F0@ */ ECIPP_ALIGNMENT_ULONG 4294967295 Compu_IDENTITY 0 4294967295 PHYS_UNIT "SPN" /end CHARACTERISTIC
/begin CHARACTERISTIC FCspn_INJD6_HS_Ihi "FCtl_SPN(567)" VALUE 0x001E2640 /* @ECU_Address@FCtl_SPN@0x21B608DC@ */ ECIPP_ALIGNMENT_ULONG 4294967295 Compu_IDENTITY 0 4294967295 PHYS_UNIT "SPN" /end CHARACTERISTIC
/begin CHARACTERISTIC FCspn_INJD6_LS_Ihi "FCtl_SPN(575)" VALUE 0x001E2660 /* @ECU_Address@FCtl_SPN@0x21B608FC@ */ ECIPP_ALIGNMENT_ULONG 4294967295 Compu_IDENTITY 0 4294967295 PHYS_UNIT "SPN" /end CHARACTERISTIC
/begin CHARACTERISTIC FCspn_INJD6_off_lo "FCtl_SPN(51)" VALUE 0x001E1E30 /* @ECU_Address@FCtl_SPN@0x21B600CC@ */ ECIPP_ALIGNMENT_ULONG 4294967295 Compu_IDENTITY 0 4294967295 PHYS_UNIT "SPN" /end CHARACTERISTIC
/begin CHARACTERISTIC FCspn_INJD6_on_hi "FCtl_SPN(61)" VALUE 0x001E1E58 /* @ECU_Address@FCtl_SPN@0x21B600F4@ */ ECIPP_ALIGNMENT_ULONG 4294967295 Compu_IDENTITY 0 4294967295 PHYS_UNIT "SPN" /end CHARACTERISTIC
/begin CHARACTERISTIC FCspn_INJD7_HS_Ihi "FCtl_SPN(568)" VALUE 0x001E2644 /* @ECU_Address@FCtl_SPN@0x21B608E0@ */ ECIPP_ALIGNMENT_ULONG 4294967295 Compu_IDENTITY 0 4294967295 PHYS_UNIT "SPN" /end CHARACTERISTIC
/begin CHARACTERISTIC FCspn_INJD7_LS_Ihi "FCtl_SPN(576)" VALUE 0x001E2664 /* @ECU_Address@FCtl_SPN@0x21B60900@ */ ECIPP_ALIGNMENT_ULONG 4294967295 Compu_IDENTITY 0 4294967295 PHYS_UNIT "SPN" /end CHARACTERISTIC
/begin CHARACTERISTIC FCspn_INJD7_off_lo "FCtl_SPN(52)" VALUE 0x001E1E34 /* @ECU_Address@FCtl_SPN@0x21B600D0@ */ ECIPP_ALIGNMENT_ULONG 4294967295 Compu_IDENTITY 0 4294967295 PHYS_UNIT "SPN" /end CHARACTERISTIC
/begin CHARACTERISTIC FCspn_INJD7_on_hi "FCtl_SPN(62)" VALUE 0x001E1E5C /* @ECU_Address@FCtl_SPN@0x21B600F8@ */ ECIPP_ALIGNMENT_ULONG 4294967295 Compu_IDENTITY 0 4294967295 PHYS_UNIT "SPN" /end CHARACTERISTIC
/begin CHARACTERISTIC FCspn_INJD8_HS_Ihi "FCtl_SPN(569)" VALUE 0x001E2648 /* @ECU_Address@FCtl_SPN@0x21B608E4@ */ ECIPP_ALIGNMENT_ULONG 4294967295 Compu_IDENTITY 0 4294967295 PHYS_UNIT "SPN" /end CHARACTERISTIC
/begin CHARACTERISTIC FCspn_INJD8_LS_Ihi "FCtl_SPN(577)" VALUE 0x001E2668 /* @ECU_Address@FCtl_SPN@0x21B60904@ */ ECIPP_ALIGNMENT_ULONG 4294967295 Compu_IDENTITY 0 4294967295 PHYS_UNIT "SPN" /end CHARACTERISTIC
/begin CHARACTERISTIC FCspn_INJD8_off_lo "FCtl_SPN(53)" VALUE 0x001E1E38 /* @ECU_Address@FCtl_SPN@0x21B600D4@ */ ECIPP_ALIGNMENT_ULONG 4294967295 Compu_IDENTITY 0 4294967295 PHYS_UNIT "SPN" /end CHARACTERISTIC
/begin CHARACTERISTIC FCspn_INJD8_on_hi "FCtl_SPN(63)" VALUE 0x001E1E60 /* @ECU_Address@FCtl_SPN@0x21B600FC@ */ ECIPP_ALIGNMENT_ULONG 4294967295 Compu_IDENTITY 0 4294967295 PHYS_UNIT "SPN" /end CHARACTERISTIC
/begin CHARACTERISTIC FCspn_INJD9_off_lo "FCtl_SPN(54)" VALUE 0x001E1E3C /* @ECU_Address@FCtl_SPN@0x21B600D8@ */ ECIPP_ALIGNMENT_ULONG 4294967295 Compu_IDENTITY 0 4294967295 PHYS_UNIT "SPN" /end CHARACTERISTIC
/begin CHARACTERISTIC FCspn_INJD9_on_hi "FCtl_SPN(64)" VALUE 0x001E1E64 /* @ECU_Address@FCtl_SPN@0x21B60100@ */ ECIPP_ALIGNMENT_ULONG 4294967295 Compu_IDENTITY 0 4294967295 PHYS_UNIT "SPN" /end CHARACTERISTIC
/begin CHARACTERISTIC FCspn_KNK10_max "FCtl_SPN(1012)" VALUE 0x001E2D34 /* @ECU_Address@FCtl_SPN@0x21B60FD0@ */ ECIPP_ALIGNMENT_ULONG 4294967295 Compu_IDENTITY 0 4294967295 PHYS_UNIT "SPN" /end CHARACTERISTIC
/begin CHARACTERISTIC FCspn_KNK10_min "FCtl_SPN(1003)" VALUE 0x001E2D10 /* @ECU_Address@FCtl_SPN@0x21B60FAC@ */ ECIPP_ALIGNMENT_ULONG 4294967295 Compu_IDENTITY 0 4294967295 PHYS_UNIT "SPN" /end CHARACTERISTIC
/begin CHARACTERISTIC FCspn_KNK11_max "FCtl_SPN(1013)" VALUE 0x001E2D38 /* @ECU_Address@FCtl_SPN@0x21B60FD4@ */ ECIPP_ALIGNMENT_ULONG 4294967295 Compu_IDENTITY 0 4294967295 PHYS_UNIT "SPN" /end CHARACTERISTIC
/begin CHARACTERISTIC FCspn_KNK11_min "FCtl_SPN(1004)" VALUE 0x001E2D14 /* @ECU_Address@FCtl_SPN@0x21B60FB0@ */ ECIPP_ALIGNMENT_ULONG 4294967295 Compu_IDENTITY 0 4294967295 PHYS_UNIT "SPN" /end CHARACTERISTIC
/begin CHARACTERISTIC FCspn_KNK12_max "FCtl_SPN(1014)" VALUE 0x001E2D3C /* @ECU_Address@FCtl_SPN@0x21B60FD8@ */ ECIPP_ALIGNMENT_ULONG 4294967295 Compu_IDENTITY 0 4294967295 PHYS_UNIT "SPN" /end CHARACTERISTIC
/begin CHARACTERISTIC FCspn_KNK12_min "FCtl_SPN(1005)" VALUE 0x001E2D18 /* @ECU_Address@FCtl_SPN@0x21B60FB4@ */ ECIPP_ALIGNMENT_ULONG 4294967295 Compu_IDENTITY 0 4294967295 PHYS_UNIT "SPN" /end CHARACTERISTIC
/begin CHARACTERISTIC FCspn_KNK2_max "FCtl_SPN(185)" VALUE 0x001E2048 /* @ECU_Address@FCtl_SPN@0x21B602E4@ */ ECIPP_ALIGNMENT_ULONG 4294967295 Compu_IDENTITY 0 4294967295 PHYS_UNIT "SPN" /end CHARACTERISTIC
/begin CHARACTERISTIC FCspn_KNK2_min "FCtl_SPN(184)" VALUE 0x001E2044 /* @ECU_Address@FCtl_SPN@0x21B602E0@ */ ECIPP_ALIGNMENT_ULONG 4294967295 Compu_IDENTITY 0 4294967295 PHYS_UNIT "SPN" /end CHARACTERISTIC
/begin CHARACTERISTIC FCspn_KNK3_max "FCtl_SPN(806)" VALUE 0x001E29FC /* @ECU_Address@FCtl_SPN@0x21B60C98@ */ ECIPP_ALIGNMENT_ULONG 4294967295 Compu_IDENTITY 0 4294967295 PHYS_UNIT "SPN" /end CHARACTERISTIC
/begin CHARACTERISTIC FCspn_KNK3_min "FCtl_SPN(805)" VALUE 0x001E29F8 /* @ECU_Address@FCtl_SPN@0x21B60C94@ */ ECIPP_ALIGNMENT_ULONG 4294967295 Compu_IDENTITY 0 4294967295 PHYS_UNIT "SPN" /end CHARACTERISTIC
/begin CHARACTERISTIC FCspn_KNK4_max "FCtl_SPN(1006)" VALUE 0x001E2D1C /* @ECU_Address@FCtl_SPN@0x21B60FB8@ */ ECIPP_ALIGNMENT_ULONG 4294967295 Compu_IDENTITY 0 4294967295 PHYS_UNIT "SPN" /end CHARACTERISTIC
/begin CHARACTERISTIC FCspn_KNK4_min "FCtl_SPN(997)" VALUE 0x001E2CF8 /* @ECU_Address@FCtl_SPN@0x21B60F94@ */ ECIPP_ALIGNMENT_ULONG 4294967295 Compu_IDENTITY 0 4294967295 PHYS_UNIT "SPN" /end CHARACTERISTIC
/begin CHARACTERISTIC FCspn_KNK5_max "FCtl_SPN(1007)" VALUE 0x001E2D20 /* @ECU_Address@FCtl_SPN@0x21B60FBC@ */ ECIPP_ALIGNMENT_ULONG 4294967295 Compu_IDENTITY 0 4294967295 PHYS_UNIT "SPN" /end CHARACTERISTIC
/begin CHARACTERISTIC FCspn_KNK5_min "FCtl_SPN(998)" VALUE 0x001E2CFC /* @ECU_Address@FCtl_SPN@0x21B60F98@ */ ECIPP_ALIGNMENT_ULONG 4294967295 Compu_IDENTITY 0 4294967295 PHYS_UNIT "SPN" /end CHARACTERISTIC
/begin CHARACTERISTIC FCspn_KNK6_max "FCtl_SPN(1008)" VALUE 0x001E2D24 /* @ECU_Address@FCtl_SPN@0x21B60FC0@ */ ECIPP_ALIGNMENT_ULONG 4294967295 Compu_IDENTITY 0 4294967295 PHYS_UNIT "SPN" /end CHARACTERISTIC
/begin CHARACTERISTIC FCspn_KNK6_min "FCtl_SPN(999)" VALUE 0x001E2D00 /* @ECU_Address@FCtl_SPN@0x21B60F9C@ */ ECIPP_ALIGNMENT_ULONG 4294967295 Compu_IDENTITY 0 4294967295 PHYS_UNIT "SPN" /end CHARACTERISTIC
/begin CHARACTERISTIC FCspn_KNK7_max "FCtl_SPN(1009)" VALUE 0x001E2D28 /* @ECU_Address@FCtl_SPN@0x21B60FC4@ */ ECIPP_ALIGNMENT_ULONG 4294967295 Compu_IDENTITY 0 4294967295 PHYS_UNIT "SPN" /end CHARACTERISTIC
/begin CHARACTERISTIC FCspn_KNK7_min "FCtl_SPN(1000)" VALUE 0x001E2D04 /* @ECU_Address@FCtl_SPN@0x21B60FA0@ */ ECIPP_ALIGNMENT_ULONG 4294967295 Compu_IDENTITY 0 4294967295 PHYS_UNIT "SPN" /end CHARACTERISTIC
/begin CHARACTERISTIC FCspn_KNK8_max "FCtl_SPN(1010)" VALUE 0x001E2D2C /* @ECU_Address@FCtl_SPN@0x21B60FC8@ */ ECIPP_ALIGNMENT_ULONG 4294967295 Compu_IDENTITY 0 4294967295 PHYS_UNIT "SPN" /end CHARACTERISTIC
/begin CHARACTERISTIC FCspn_KNK8_min "FCtl_SPN(1001)" VALUE 0x001E2D08 /* @ECU_Address@FCtl_SPN@0x21B60FA4@ */ ECIPP_ALIGNMENT_ULONG 4294967295 Compu_IDENTITY 0 4294967295 PHYS_UNIT "SPN" /end CHARACTERISTIC
/begin CHARACTERISTIC FCspn_KNK9_max "FCtl_SPN(1011)" VALUE 0x001E2D30 /* @ECU_Address@FCtl_SPN@0x21B60FCC@ */ ECIPP_ALIGNMENT_ULONG 4294967295 Compu_IDENTITY 0 4294967295 PHYS_UNIT "SPN" /end CHARACTERISTIC
/begin CHARACTERISTIC FCspn_KNK9_min "FCtl_SPN(1002)" VALUE 0x001E2D0C /* @ECU_Address@FCtl_SPN@0x21B60FA8@ */ ECIPP_ALIGNMENT_ULONG 4294967295 Compu_IDENTITY 0 4294967295 PHYS_UNIT "SPN" /end CHARACTERISTIC
/begin CHARACTERISTIC FCspn_KV10_deltaHi "FCtl_SPN(970)" VALUE 0x001E2C8C /* @ECU_Address@FCtl_SPN@0x21B60F28@ */ ECIPP_ALIGNMENT_ULONG 4294967295 Compu_IDENTITY 0 4294967295 PHYS_UNIT "SPN" /end CHARACTERISTIC
/begin CHARACTERISTIC FCspn_KV10_deltaLo "FCtl_SPN(982)" VALUE 0x001E2CBC /* @ECU_Address@FCtl_SPN@0x21B60F58@ */ ECIPP_ALIGNMENT_ULONG 4294967295 Compu_IDENTITY 0 4294967295 PHYS_UNIT "SPN" /end CHARACTERISTIC
/begin CHARACTERISTIC FCspn_KV10_high "FCtl_SPN(886)" VALUE 0x001E2B3C /* @ECU_Address@FCtl_SPN@0x21B60DD8@ */ ECIPP_ALIGNMENT_ULONG 4294967295 Compu_IDENTITY 0 4294967295 PHYS_UNIT "SPN" /end CHARACTERISTIC
/begin CHARACTERISTIC FCspn_KV10_low "FCtl_SPN(898)" VALUE 0x001E2B6C /* @ECU_Address@FCtl_SPN@0x21B60E08@ */ ECIPP_ALIGNMENT_ULONG 4294967295 Compu_IDENTITY 0 4294967295 PHYS_UNIT "SPN" /end CHARACTERISTIC
/begin CHARACTERISTIC FCspn_KV11_deltaHi "FCtl_SPN(971)" VALUE 0x001E2C90 /* @ECU_Address@FCtl_SPN@0x21B60F2C@ */ ECIPP_ALIGNMENT_ULONG 4294967295 Compu_IDENTITY 0 4294967295 PHYS_UNIT "SPN" /end CHARACTERISTIC
/begin CHARACTERISTIC FCspn_KV11_deltaLo "FCtl_SPN(983)" VALUE 0x001E2CC0 /* @ECU_Address@FCtl_SPN@0x21B60F5C@ */ ECIPP_ALIGNMENT_ULONG 4294967295 Compu_IDENTITY 0 4294967295 PHYS_UNIT "SPN" /end CHARACTERISTIC
/begin CHARACTERISTIC FCspn_KV11_high "FCtl_SPN(887)" VALUE 0x001E2B40 /* @ECU_Address@FCtl_SPN@0x21B60DDC@ */ ECIPP_ALIGNMENT_ULONG 4294967295 Compu_IDENTITY 0 4294967295 PHYS_UNIT "SPN" /end CHARACTERISTIC
/begin CHARACTERISTIC FCspn_KV11_low "FCtl_SPN(899)" VALUE 0x001E2B70 /* @ECU_Address@FCtl_SPN@0x21B60E0C@ */ ECIPP_ALIGNMENT_ULONG 4294967295 Compu_IDENTITY 0 4294967295 PHYS_UNIT "SPN" /end CHARACTERISTIC
/begin CHARACTERISTIC FCspn_KV12_deltaHi "FCtl_SPN(972)" VALUE 0x001E2C94 /* @ECU_Address@FCtl_SPN@0x21B60F30@ */ ECIPP_ALIGNMENT_ULONG 4294967295 Compu_IDENTITY 0 4294967295 PHYS_UNIT "SPN" /end CHARACTERISTIC
/begin CHARACTERISTIC FCspn_KV12_deltaLo "FCtl_SPN(984)" VALUE 0x001E2CC4 /* @ECU_Address@FCtl_SPN@0x21B60F60@ */ ECIPP_ALIGNMENT_ULONG 4294967295 Compu_IDENTITY 0 4294967295 PHYS_UNIT "SPN" /end CHARACTERISTIC
/begin CHARACTERISTIC FCspn_KV12_high "FCtl_SPN(888)" VALUE 0x001E2B44 /* @ECU_Address@FCtl_SPN@0x21B60DE0@ */ ECIPP_ALIGNMENT_ULONG 4294967295 Compu_IDENTITY 0 4294967295 PHYS_UNIT "SPN" /end CHARACTERISTIC
/begin CHARACTERISTIC FCspn_KV12_low "FCtl_SPN(900)" VALUE 0x001E2B74 /* @ECU_Address@FCtl_SPN@0x21B60E10@ */ ECIPP_ALIGNMENT_ULONG 4294967295 Compu_IDENTITY 0 4294967295 PHYS_UNIT "SPN" /end CHARACTERISTIC
/begin CHARACTERISTIC FCspn_KV2_deltaHi "FCtl_SPN(962)" VALUE 0x001E2C6C /* @ECU_Address@FCtl_SPN@0x21B60F08@ */ ECIPP_ALIGNMENT_ULONG 4294967295 Compu_IDENTITY 0 4294967295 PHYS_UNIT "SPN" /end CHARACTERISTIC
/begin CHARACTERISTIC FCspn_KV2_deltaLo "FCtl_SPN(974)" VALUE 0x001E2C9C /* @ECU_Address@FCtl_SPN@0x21B60F38@ */ ECIPP_ALIGNMENT_ULONG 4294967295 Compu_IDENTITY 0 4294967295 PHYS_UNIT "SPN" /end CHARACTERISTIC
/begin CHARACTERISTIC FCspn_KV2_high "FCtl_SPN(878)" VALUE 0x001E2B1C /* @ECU_Address@FCtl_SPN@0x21B60DB8@ */ ECIPP_ALIGNMENT_ULONG 4294967295 Compu_IDENTITY 0 4294967295 PHYS_UNIT "SPN" /end CHARACTERISTIC
/begin CHARACTERISTIC FCspn_KV2_low "FCtl_SPN(890)" VALUE 0x001E2B4C /* @ECU_Address@FCtl_SPN@0x21B60DE8@ */ ECIPP_ALIGNMENT_ULONG 4294967295 Compu_IDENTITY 0 4294967295 PHYS_UNIT "SPN" /end CHARACTERISTIC
/begin CHARACTERISTIC FCspn_KV3_deltaHi "FCtl_SPN(963)" VALUE 0x001E2C70 /* @ECU_Address@FCtl_SPN@0x21B60F0C@ */ ECIPP_ALIGNMENT_ULONG 4294967295 Compu_IDENTITY 0 4294967295 PHYS_UNIT "SPN" /end CHARACTERISTIC
/begin CHARACTERISTIC FCspn_KV3_deltaLo "FCtl_SPN(975)" VALUE 0x001E2CA0 /* @ECU_Address@FCtl_SPN@0x21B60F3C@ */ ECIPP_ALIGNMENT_ULONG 4294967295 Compu_IDENTITY 0 4294967295 PHYS_UNIT "SPN" /end CHARACTERISTIC
/begin CHARACTERISTIC FCspn_KV3_high "FCtl_SPN(879)" VALUE 0x001E2B20 /* @ECU_Address@FCtl_SPN@0x21B60DBC@ */ ECIPP_ALIGNMENT_ULONG 4294967295 Compu_IDENTITY 0 4294967295 PHYS_UNIT "SPN" /end CHARACTERISTIC
/begin CHARACTERISTIC FCspn_KV3_low "FCtl_SPN(891)" VALUE 0x001E2B50 /* @ECU_Address@FCtl_SPN@0x21B60DEC@ */ ECIPP_ALIGNMENT_ULONG 4294967295 Compu_IDENTITY 0 4294967295 PHYS_UNIT "SPN" /end CHARACTERISTIC
/begin CHARACTERISTIC FCspn_KV4_deltaHi "FCtl_SPN(964)" VALUE 0x001E2C74 /* @ECU_Address@FCtl_SPN@0x21B60F10@ */ ECIPP_ALIGNMENT_ULONG 4294967295 Compu_IDENTITY 0 4294967295 PHYS_UNIT "SPN" /end CHARACTERISTIC
/begin CHARACTERISTIC FCspn_KV4_deltaLo "FCtl_SPN(976)" VALUE 0x001E2CA4 /* @ECU_Address@FCtl_SPN@0x21B60F40@ */ ECIPP_ALIGNMENT_ULONG 4294967295 Compu_IDENTITY 0 4294967295 PHYS_UNIT "SPN" /end CHARACTERISTIC
/begin CHARACTERISTIC FCspn_KV4_high "FCtl_SPN(880)" VALUE 0x001E2B24 /* @ECU_Address@FCtl_SPN@0x21B60DC0@ */ ECIPP_ALIGNMENT_ULONG 4294967295 Compu_IDENTITY 0 4294967295 PHYS_UNIT "SPN" /end CHARACTERISTIC
/begin CHARACTERISTIC FCspn_KV4_low "FCtl_SPN(892)" VALUE 0x001E2B54 /* @ECU_Address@FCtl_SPN@0x21B60DF0@ */ ECIPP_ALIGNMENT_ULONG 4294967295 Compu_IDENTITY 0 4294967295 PHYS_UNIT "SPN" /end CHARACTERISTIC
/begin CHARACTERISTIC FCspn_KV5_deltaHi "FCtl_SPN(965)" VALUE 0x001E2C78 /* @ECU_Address@FCtl_SPN@0x21B60F14@ */ ECIPP_ALIGNMENT_ULONG 4294967295 Compu_IDENTITY 0 4294967295 PHYS_UNIT "SPN" /end CHARACTERISTIC
/begin CHARACTERISTIC FCspn_KV5_deltaLo "FCtl_SPN(977)" VALUE 0x001E2CA8 /* @ECU_Address@FCtl_SPN@0x21B60F44@ */ ECIPP_ALIGNMENT_ULONG 4294967295 Compu_IDENTITY 0 4294967295 PHYS_UNIT "SPN" /end CHARACTERISTIC
/begin CHARACTERISTIC FCspn_KV5_high "FCtl_SPN(881)" VALUE 0x001E2B28 /* @ECU_Address@FCtl_SPN@0x21B60DC4@ */ ECIPP_ALIGNMENT_ULONG 4294967295 Compu_IDENTITY 0 4294967295 PHYS_UNIT "SPN" /end CHARACTERISTIC
/begin CHARACTERISTIC FCspn_KV5_low "FCtl_SPN(893)" VALUE 0x001E2B58 /* @ECU_Address@FCtl_SPN@0x21B60DF4@ */ ECIPP_ALIGNMENT_ULONG 4294967295 Compu_IDENTITY 0 4294967295 PHYS_UNIT "SPN" /end CHARACTERISTIC
/begin CHARACTERISTIC FCspn_KV6_deltaHi "FCtl_SPN(966)" VALUE 0x001E2C7C /* @ECU_Address@FCtl_SPN@0x21B60F18@ */ ECIPP_ALIGNMENT_ULONG 4294967295 Compu_IDENTITY 0 4294967295 PHYS_UNIT "SPN" /end CHARACTERISTIC
/begin CHARACTERISTIC FCspn_KV6_deltaLo "FCtl_SPN(978)" VALUE 0x001E2CAC /* @ECU_Address@FCtl_SPN@0x21B60F48@ */ ECIPP_ALIGNMENT_ULONG 4294967295 Compu_IDENTITY 0 4294967295 PHYS_UNIT "SPN" /end CHARACTERISTIC
/begin CHARACTERISTIC FCspn_KV6_high "FCtl_SPN(882)" VALUE 0x001E2B2C /* @ECU_Address@FCtl_SPN@0x21B60DC8@ */ ECIPP_ALIGNMENT_ULONG 4294967295 Compu_IDENTITY 0 4294967295 PHYS_UNIT "SPN" /end CHARACTERISTIC
/begin CHARACTERISTIC FCspn_KV6_low "FCtl_SPN(894)" VALUE 0x001E2B5C /* @ECU_Address@FCtl_SPN@0x21B60DF8@ */ ECIPP_ALIGNMENT_ULONG 4294967295 Compu_IDENTITY 0 4294967295 PHYS_UNIT "SPN" /end CHARACTERISTIC
/begin CHARACTERISTIC FCspn_KV7_deltaHi "FCtl_SPN(967)" VALUE 0x001E2C80 /* @ECU_Address@FCtl_SPN@0x21B60F1C@ */ ECIPP_ALIGNMENT_ULONG 4294967295 Compu_IDENTITY 0 4294967295 PHYS_UNIT "SPN" /end CHARACTERISTIC
/begin CHARACTERISTIC FCspn_KV7_deltaLo "FCtl_SPN(979)" VALUE 0x001E2CB0 /* @ECU_Address@FCtl_SPN@0x21B60F4C@ */ ECIPP_ALIGNMENT_ULONG 4294967295 Compu_IDENTITY 0 4294967295 PHYS_UNIT "SPN" /end CHARACTERISTIC
/begin CHARACTERISTIC FCspn_KV7_high "FCtl_SPN(883)" VALUE 0x001E2B30 /* @ECU_Address@FCtl_SPN@0x21B60DCC@ */ ECIPP_ALIGNMENT_ULONG 4294967295 Compu_IDENTITY 0 4294967295 PHYS_UNIT "SPN" /end CHARACTERISTIC
/begin CHARACTERISTIC FCspn_KV7_low "FCtl_SPN(895)" VALUE 0x001E2B60 /* @ECU_Address@FCtl_SPN@0x21B60DFC@ */ ECIPP_ALIGNMENT_ULONG 4294967295 Compu_IDENTITY 0 4294967295 PHYS_UNIT "SPN" /end CHARACTERISTIC
/begin CHARACTERISTIC FCspn_KV8_deltaHi "FCtl_SPN(968)" VALUE 0x001E2C84 /* @ECU_Address@FCtl_SPN@0x21B60F20@ */ ECIPP_ALIGNMENT_ULONG 4294967295 Compu_IDENTITY 0 4294967295 PHYS_UNIT "SPN" /end CHARACTERISTIC
/begin CHARACTERISTIC FCspn_KV8_deltaLo "FCtl_SPN(980)" VALUE 0x001E2CB4 /* @ECU_Address@FCtl_SPN@0x21B60F50@ */ ECIPP_ALIGNMENT_ULONG 4294967295 Compu_IDENTITY 0 4294967295 PHYS_UNIT "SPN" /end CHARACTERISTIC
/begin CHARACTERISTIC FCspn_KV8_high "FCtl_SPN(884)" VALUE 0x001E2B34 /* @ECU_Address@FCtl_SPN@0x21B60DD0@ */ ECIPP_ALIGNMENT_ULONG 4294967295 Compu_IDENTITY 0 4294967295 PHYS_UNIT "SPN" /end CHARACTERISTIC
/begin CHARACTERISTIC FCspn_KV8_low "FCtl_SPN(896)" VALUE 0x001E2B64 /* @ECU_Address@FCtl_SPN@0x21B60E00@ */ ECIPP_ALIGNMENT_ULONG 4294967295 Compu_IDENTITY 0 4294967295 PHYS_UNIT "SPN" /end CHARACTERISTIC
/begin CHARACTERISTIC FCspn_KV9_deltaHi "FCtl_SPN(969)" VALUE 0x001E2C88 /* @ECU_Address@FCtl_SPN@0x21B60F24@ */ ECIPP_ALIGNMENT_ULONG 4294967295 Compu_IDENTITY 0 4294967295 PHYS_UNIT "SPN" /end CHARACTERISTIC
/begin CHARACTERISTIC FCspn_KV9_deltaLo "FCtl_SPN(981)" VALUE 0x001E2CB8 /* @ECU_Address@FCtl_SPN@0x21B60F54@ */ ECIPP_ALIGNMENT_ULONG 4294967295 Compu_IDENTITY 0 4294967295 PHYS_UNIT "SPN" /end CHARACTERISTIC
/begin CHARACTERISTIC FCspn_KV9_high "FCtl_SPN(885)" VALUE 0x001E2B38 /* @ECU_Address@FCtl_SPN@0x21B60DD4@ */ ECIPP_ALIGNMENT_ULONG 4294967295 Compu_IDENTITY 0 4294967295 PHYS_UNIT "SPN" /end CHARACTERISTIC
/begin CHARACTERISTIC FCspn_KV9_low "FCtl_SPN(897)" VALUE 0x001E2B68 /* @ECU_Address@FCtl_SPN@0x21B60E04@ */ ECIPP_ALIGNMENT_ULONG 4294967295 Compu_IDENTITY 0 4294967295 PHYS_UNIT "SPN" /end CHARACTERISTIC
/begin CHARACTERISTIC FCspn_Pri10_open "FCtl_SPN(910)" VALUE 0x001E2B9C /* @ECU_Address@FCtl_SPN@0x21B60E38@ */ ECIPP_ALIGNMENT_ULONG 4294967295 Compu_IDENTITY 0 4294967295 PHYS_UNIT "SPN" /end CHARACTERISTIC
/begin CHARACTERISTIC FCspn_Pri10_short "FCtl_SPN(922)" VALUE 0x001E2BCC /* @ECU_Address@FCtl_SPN@0x21B60E68@ */ ECIPP_ALIGNMENT_ULONG 4294967295 Compu_IDENTITY 0 4294967295 PHYS_UNIT "SPN" /end CHARACTERISTIC
/begin CHARACTERISTIC FCspn_Pri11_open "FCtl_SPN(911)" VALUE 0x001E2BA0 /* @ECU_Address@FCtl_SPN@0x21B60E3C@ */ ECIPP_ALIGNMENT_ULONG 4294967295 Compu_IDENTITY 0 4294967295 PHYS_UNIT "SPN" /end CHARACTERISTIC
/begin CHARACTERISTIC FCspn_Pri11_short "FCtl_SPN(923)" VALUE 0x001E2BD0 /* @ECU_Address@FCtl_SPN@0x21B60E6C@ */ ECIPP_ALIGNMENT_ULONG 4294967295 Compu_IDENTITY 0 4294967295 PHYS_UNIT "SPN" /end CHARACTERISTIC
/begin CHARACTERISTIC FCspn_Pri12_open "FCtl_SPN(912)" VALUE 0x001E2BA4 /* @ECU_Address@FCtl_SPN@0x21B60E40@ */ ECIPP_ALIGNMENT_ULONG 4294967295 Compu_IDENTITY 0 4294967295 PHYS_UNIT "SPN" /end CHARACTERISTIC
/begin CHARACTERISTIC FCspn_Pri12_short "FCtl_SPN(924)" VALUE 0x001E2BD4 /* @ECU_Address@FCtl_SPN@0x21B60E70@ */ ECIPP_ALIGNMENT_ULONG 4294967295 Compu_IDENTITY 0 4294967295 PHYS_UNIT "SPN" /end CHARACTERISTIC
/begin CHARACTERISTIC FCspn_Pri2_open "FCtl_SPN(902)" VALUE 0x001E2B7C /* @ECU_Address@FCtl_SPN@0x21B60E18@ */ ECIPP_ALIGNMENT_ULONG 4294967295 Compu_IDENTITY 0 4294967295 PHYS_UNIT "SPN" /end CHARACTERISTIC
/begin CHARACTERISTIC FCspn_Pri2_short "FCtl_SPN(914)" VALUE 0x001E2BAC /* @ECU_Address@FCtl_SPN@0x21B60E48@ */ ECIPP_ALIGNMENT_ULONG 4294967295 Compu_IDENTITY 0 4294967295 PHYS_UNIT "SPN" /end CHARACTERISTIC
/begin CHARACTERISTIC FCspn_Pri3_open "FCtl_SPN(903)" VALUE 0x001E2B80 /* @ECU_Address@FCtl_SPN@0x21B60E1C@ */ ECIPP_ALIGNMENT_ULONG 4294967295 Compu_IDENTITY 0 4294967295 PHYS_UNIT "SPN" /end CHARACTERISTIC
/begin CHARACTERISTIC FCspn_Pri3_short "FCtl_SPN(915)" VALUE 0x001E2BB0 /* @ECU_Address@FCtl_SPN@0x21B60E4C@ */ ECIPP_ALIGNMENT_ULONG 4294967295 Compu_IDENTITY 0 4294967295 PHYS_UNIT "SPN" /end CHARACTERISTIC
/begin CHARACTERISTIC FCspn_Pri4_open "FCtl_SPN(904)" VALUE 0x001E2B84 /* @ECU_Address@FCtl_SPN@0x21B60E20@ */ ECIPP_ALIGNMENT_ULONG 4294967295 Compu_IDENTITY 0 4294967295 PHYS_UNIT "SPN" /end CHARACTERISTIC
/begin CHARACTERISTIC FCspn_Pri4_short "FCtl_SPN(916)" VALUE 0x001E2BB4 /* @ECU_Address@FCtl_SPN@0x21B60E50@ */ ECIPP_ALIGNMENT_ULONG 4294967295 Compu_IDENTITY 0 4294967295 PHYS_UNIT "SPN" /end CHARACTERISTIC
/begin CHARACTERISTIC FCspn_Pri5_open "FCtl_SPN(905)" VALUE 0x001E2B88 /* @ECU_Address@FCtl_SPN@0x21B60E24@ */ ECIPP_ALIGNMENT_ULONG 4294967295 Compu_IDENTITY 0 4294967295 PHYS_UNIT "SPN" /end CHARACTERISTIC
/begin CHARACTERISTIC FCspn_Pri5_short "FCtl_SPN(917)" VALUE 0x001E2BB8 /* @ECU_Address@FCtl_SPN@0x21B60E54@ */ ECIPP_ALIGNMENT_ULONG 4294967295 Compu_IDENTITY 0 4294967295 PHYS_UNIT "SPN" /end CHARACTERISTIC
/begin CHARACTERISTIC FCspn_Pri6_open "FCtl_SPN(906)" VALUE 0x001E2B8C /* @ECU_Address@FCtl_SPN@0x21B60E28@ */ ECIPP_ALIGNMENT_ULONG 4294967295 Compu_IDENTITY 0 4294967295 PHYS_UNIT "SPN" /end CHARACTERISTIC
/begin CHARACTERISTIC FCspn_Pri6_short "FCtl_SPN(918)" VALUE 0x001E2BBC /* @ECU_Address@FCtl_SPN@0x21B60E58@ */ ECIPP_ALIGNMENT_ULONG 4294967295 Compu_IDENTITY 0 4294967295 PHYS_UNIT "SPN" /end CHARACTERISTIC
/begin CHARACTERISTIC FCspn_Pri7_open "FCtl_SPN(907)" VALUE 0x001E2B90 /* @ECU_Address@FCtl_SPN@0x21B60E2C@ */ ECIPP_ALIGNMENT_ULONG 4294967295 Compu_IDENTITY 0 4294967295 PHYS_UNIT "SPN" /end CHARACTERISTIC
/begin CHARACTERISTIC FCspn_Pri7_short "FCtl_SPN(919)" VALUE 0x001E2BC0 /* @ECU_Address@FCtl_SPN@0x21B60E5C@ */ ECIPP_ALIGNMENT_ULONG 4294967295 Compu_IDENTITY 0 4294967295 PHYS_UNIT "SPN" /end CHARACTERISTIC
/begin CHARACTERISTIC FCspn_Pri8_open "FCtl_SPN(908)" VALUE 0x001E2B94 /* @ECU_Address@FCtl_SPN@0x21B60E30@ */ ECIPP_ALIGNMENT_ULONG 4294967295 Compu_IDENTITY 0 4294967295 PHYS_UNIT "SPN" /end CHARACTERISTIC
/begin CHARACTERISTIC FCspn_Pri8_short "FCtl_SPN(920)" VALUE 0x001E2BC4 /* @ECU_Address@FCtl_SPN@0x21B60E60@ */ ECIPP_ALIGNMENT_ULONG 4294967295 Compu_IDENTITY 0 4294967295 PHYS_UNIT "SPN" /end CHARACTERISTIC
/begin CHARACTERISTIC FCspn_Pri9_open "FCtl_SPN(909)" VALUE 0x001E2B98 /* @ECU_Address@FCtl_SPN@0x21B60E34@ */ ECIPP_ALIGNMENT_ULONG 4294967295 Compu_IDENTITY 0 4294967295 PHYS_UNIT "SPN" /end CHARACTERISTIC
/begin CHARACTERISTIC FCspn_Pri9_short "FCtl_SPN(921)" VALUE 0x001E2BC8 /* @ECU_Address@FCtl_SPN@0x21B60E64@ */ ECIPP_ALIGNMENT_ULONG 4294967295 Compu_IDENTITY 0 4294967295 PHYS_UNIT "SPN" /end CHARACTERISTIC
/begin CHARACTERISTIC FCspn_Sec10_31KV_open "FCtl_SPN(958)" VALUE 0x001E2C5C /* @ECU_Address@FCtl_SPN@0x21B60EF8@ */ ECIPP_ALIGNMENT_ULONG 4294967295 Compu_IDENTITY 0 4294967295 PHYS_UNIT "SPN" /end CHARACTERISTIC
/begin CHARACTERISTIC FCspn_Sec10_low "FCtl_SPN(946)" VALUE 0x001E2C2C /* @ECU_Address@FCtl_SPN@0x21B60EC8@ */ ECIPP_ALIGNMENT_ULONG 4294967295 Compu_IDENTITY 0 4294967295 PHYS_UNIT "SPN" /end CHARACTERISTIC
/begin CHARACTERISTIC FCspn_Sec10_open "FCtl_SPN(934)" VALUE 0x001E2BFC /* @ECU_Address@FCtl_SPN@0x21B60E98@ */ ECIPP_ALIGNMENT_ULONG 4294967295 Compu_IDENTITY 0 4294967295 PHYS_UNIT "SPN" /end CHARACTERISTIC
/begin CHARACTERISTIC FCspn_Sec11_31KV_open "FCtl_SPN(959)" VALUE 0x001E2C60 /* @ECU_Address@FCtl_SPN@0x21B60EFC@ */ ECIPP_ALIGNMENT_ULONG 4294967295 Compu_IDENTITY 0 4294967295 PHYS_UNIT "SPN" /end CHARACTERISTIC
/begin CHARACTERISTIC FCspn_Sec11_low "FCtl_SPN(947)" VALUE 0x001E2C30 /* @ECU_Address@FCtl_SPN@0x21B60ECC@ */ ECIPP_ALIGNMENT_ULONG 4294967295 Compu_IDENTITY 0 4294967295 PHYS_UNIT "SPN" /end CHARACTERISTIC
/begin CHARACTERISTIC FCspn_Sec11_open "FCtl_SPN(935)" VALUE 0x001E2C00 /* @ECU_Address@FCtl_SPN@0x21B60E9C@ */ ECIPP_ALIGNMENT_ULONG 4294967295 Compu_IDENTITY 0 4294967295 PHYS_UNIT "SPN" /end CHARACTERISTIC
/begin CHARACTERISTIC FCspn_Sec12_31KV_open "FCtl_SPN(960)" VALUE 0x001E2C64 /* @ECU_Address@FCtl_SPN@0x21B60F00@ */ ECIPP_ALIGNMENT_ULONG 4294967295 Compu_IDENTITY 0 4294967295 PHYS_UNIT "SPN" /end CHARACTERISTIC
/begin CHARACTERISTIC FCspn_Sec12_low "FCtl_SPN(948)" VALUE 0x001E2C34 /* @ECU_Address@FCtl_SPN@0x21B60ED0@ */ ECIPP_ALIGNMENT_ULONG 4294967295 Compu_IDENTITY 0 4294967295 PHYS_UNIT "SPN" /end CHARACTERISTIC
/begin CHARACTERISTIC FCspn_Sec12_open "FCtl_SPN(936)" VALUE 0x001E2C04 /* @ECU_Address@FCtl_SPN@0x21B60EA0@ */ ECIPP_ALIGNMENT_ULONG 4294967295 Compu_IDENTITY 0 4294967295 PHYS_UNIT "SPN" /end CHARACTERISTIC
/begin CHARACTERISTIC FCspn_Sec2_31KV_open "FCtl_SPN(950)" VALUE 0x001E2C3C /* @ECU_Address@FCtl_SPN@0x21B60ED8@ */ ECIPP_ALIGNMENT_ULONG 4294967295 Compu_IDENTITY 0 4294967295 PHYS_UNIT "SPN" /end CHARACTERISTIC
/begin CHARACTERISTIC FCspn_Sec2_low "FCtl_SPN(938)" VALUE 0x001E2C0C /* @ECU_Address@FCtl_SPN@0x21B60EA8@ */ ECIPP_ALIGNMENT_ULONG 4294967295 Compu_IDENTITY 0 4294967295 PHYS_UNIT "SPN" /end CHARACTERISTIC
/begin CHARACTERISTIC FCspn_Sec2_open "FCtl_SPN(926)" VALUE 0x001E2BDC /* @ECU_Address@FCtl_SPN@0x21B60E78@ */ ECIPP_ALIGNMENT_ULONG 4294967295 Compu_IDENTITY 0 4294967295 PHYS_UNIT "SPN" /end CHARACTERISTIC
/begin CHARACTERISTIC FCspn_Sec3_31KV_open "FCtl_SPN(951)" VALUE 0x001E2C40 /* @ECU_Address@FCtl_SPN@0x21B60EDC@ */ ECIPP_ALIGNMENT_ULONG 4294967295 Compu_IDENTITY 0 4294967295 PHYS_UNIT "SPN" /end CHARACTERISTIC
/begin CHARACTERISTIC FCspn_Sec3_low "FCtl_SPN(939)" VALUE 0x001E2C10 /* @ECU_Address@FCtl_SPN@0x21B60EAC@ */ ECIPP_ALIGNMENT_ULONG 4294967295 Compu_IDENTITY 0 4294967295 PHYS_UNIT "SPN" /end CHARACTERISTIC
/begin CHARACTERISTIC FCspn_Sec3_open "FCtl_SPN(927)" VALUE 0x001E2BE0 /* @ECU_Address@FCtl_SPN@0x21B60E7C@ */ ECIPP_ALIGNMENT_ULONG 4294967295 Compu_IDENTITY 0 4294967295 PHYS_UNIT "SPN" /end CHARACTERISTIC
/begin CHARACTERISTIC FCspn_Sec4_31KV_open "FCtl_SPN(952)" VALUE 0x001E2C44 /* @ECU_Address@FCtl_SPN@0x21B60EE0@ */ ECIPP_ALIGNMENT_ULONG 4294967295 Compu_IDENTITY 0 4294967295 PHYS_UNIT "SPN" /end CHARACTERISTIC
/begin CHARACTERISTIC FCspn_Sec4_low "FCtl_SPN(940)" VALUE 0x001E2C14 /* @ECU_Address@FCtl_SPN@0x21B60EB0@ */ ECIPP_ALIGNMENT_ULONG 4294967295 Compu_IDENTITY 0 4294967295 PHYS_UNIT "SPN" /end CHARACTERISTIC
/begin CHARACTERISTIC FCspn_Sec4_open "FCtl_SPN(928)" VALUE 0x001E2BE4 /* @ECU_Address@FCtl_SPN@0x21B60E80@ */ ECIPP_ALIGNMENT_ULONG 4294967295 Compu_IDENTITY 0 4294967295 PHYS_UNIT "SPN" /end CHARACTERISTIC
/begin CHARACTERISTIC FCspn_Sec5_31KV_open "FCtl_SPN(953)" VALUE 0x001E2C48 /* @ECU_Address@FCtl_SPN@0x21B60EE4@ */ ECIPP_ALIGNMENT_ULONG 4294967295 Compu_IDENTITY 0 4294967295 PHYS_UNIT "SPN" /end CHARACTERISTIC
/begin CHARACTERISTIC FCspn_Sec5_low "FCtl_SPN(941)" VALUE 0x001E2C18 /* @ECU_Address@FCtl_SPN@0x21B60EB4@ */ ECIPP_ALIGNMENT_ULONG 4294967295 Compu_IDENTITY 0 4294967295 PHYS_UNIT "SPN" /end CHARACTERISTIC
/begin CHARACTERISTIC FCspn_Sec5_open "FCtl_SPN(929)" VALUE 0x001E2BE8 /* @ECU_Address@FCtl_SPN@0x21B60E84@ */ ECIPP_ALIGNMENT_ULONG 4294967295 Compu_IDENTITY 0 4294967295 PHYS_UNIT "SPN" /end CHARACTERISTIC
/begin CHARACTERISTIC FCspn_Sec6_31KV_open "FCtl_SPN(954)" VALUE 0x001E2C4C /* @ECU_Address@FCtl_SPN@0x21B60EE8@ */ ECIPP_ALIGNMENT_ULONG 4294967295 Compu_IDENTITY 0 4294967295 PHYS_UNIT "SPN" /end CHARACTERISTIC
/begin CHARACTERISTIC FCspn_Sec6_low "FCtl_SPN(942)" VALUE 0x001E2C1C /* @ECU_Address@FCtl_SPN@0x21B60EB8@ */ ECIPP_ALIGNMENT_ULONG 4294967295 Compu_IDENTITY 0 4294967295 PHYS_UNIT "SPN" /end CHARACTERISTIC
/begin CHARACTERISTIC FCspn_Sec6_open "FCtl_SPN(930)" VALUE 0x001E2BEC /* @ECU_Address@FCtl_SPN@0x21B60E88@ */ ECIPP_ALIGNMENT_ULONG 4294967295 Compu_IDENTITY 0 4294967295 PHYS_UNIT "SPN" /end CHARACTERISTIC
/begin CHARACTERISTIC FCspn_Sec7_31KV_open "FCtl_SPN(955)" VALUE 0x001E2C50 /* @ECU_Address@FCtl_SPN@0x21B60EEC@ */ ECIPP_ALIGNMENT_ULONG 4294967295 Compu_IDENTITY 0 4294967295 PHYS_UNIT "SPN" /end CHARACTERISTIC
/begin CHARACTERISTIC FCspn_Sec7_low "FCtl_SPN(943)" VALUE 0x001E2C20 /* @ECU_Address@FCtl_SPN@0x21B60EBC@ */ ECIPP_ALIGNMENT_ULONG 4294967295 Compu_IDENTITY 0 4294967295 PHYS_UNIT "SPN" /end CHARACTERISTIC
/begin CHARACTERISTIC FCspn_Sec7_open "FCtl_SPN(931)" VALUE 0x001E2BF0 /* @ECU_Address@FCtl_SPN@0x21B60E8C@ */ ECIPP_ALIGNMENT_ULONG 4294967295 Compu_IDENTITY 0 4294967295 PHYS_UNIT "SPN" /end CHARACTERISTIC
/begin CHARACTERISTIC FCspn_Sec8_31KV_open "FCtl_SPN(956)" VALUE 0x001E2C54 /* @ECU_Address@FCtl_SPN@0x21B60EF0@ */ ECIPP_ALIGNMENT_ULONG 4294967295 Compu_IDENTITY 0 4294967295 PHYS_UNIT "SPN" /end CHARACTERISTIC
/begin CHARACTERISTIC FCspn_Sec8_low "FCtl_SPN(944)" VALUE 0x001E2C24 /* @ECU_Address@FCtl_SPN@0x21B60EC0@ */ ECIPP_ALIGNMENT_ULONG 4294967295 Compu_IDENTITY 0 4294967295 PHYS_UNIT "SPN" /end CHARACTERISTIC
/begin CHARACTERISTIC FCspn_Sec8_open "FCtl_SPN(932)" VALUE 0x001E2BF4 /* @ECU_Address@FCtl_SPN@0x21B60E90@ */ ECIPP_ALIGNMENT_ULONG 4294967295 Compu_IDENTITY 0 4294967295 PHYS_UNIT "SPN" /end CHARACTERISTIC
/begin CHARACTERISTIC FCspn_Sec9_31KV_open "FCtl_SPN(957)" VALUE 0x001E2C58 /* @ECU_Address@FCtl_SPN@0x21B60EF4@ */ ECIPP_ALIGNMENT_ULONG 4294967295 Compu_IDENTITY 0 4294967295 PHYS_UNIT "SPN" /end CHARACTERISTIC
/begin CHARACTERISTIC FCspn_Sec9_low "FCtl_SPN(945)" VALUE 0x001E2C28 /* @ECU_Address@FCtl_SPN@0x21B60EC4@ */ ECIPP_ALIGNMENT_ULONG 4294967295 Compu_IDENTITY 0 4294967295 PHYS_UNIT "SPN" /end CHARACTERISTIC
/begin CHARACTERISTIC FCspn_Sec9_open "FCtl_SPN(933)" VALUE 0x001E2BF8 /* @ECU_Address@FCtl_SPN@0x21B60E94@ */ ECIPP_ALIGNMENT_ULONG 4294967295 Compu_IDENTITY 0 4294967295 PHYS_UNIT "SPN" /end CHARACTERISTIC
/begin CHARACTERISTIC FCspn_SPK10_IGBT_T "FCtl_SPN(518)" VALUE 0x001E257C /* @ECU_Address@FCtl_SPN@0x21B60818@ */ ECIPP_ALIGNMENT_ULONG 4294967295 Compu_IDENTITY 0 4294967295 PHYS_UNIT "SPN" /end CHARACTERISTIC
/begin CHARACTERISTIC FCspn_SPK11_IGBT_T "FCtl_SPN(1021)" VALUE 0x001E2D58 /* @ECU_Address@FCtl_SPN@0x21B60FF4@ */ ECIPP_ALIGNMENT_ULONG 4294967295 Compu_IDENTITY 0 4294967295 PHYS_UNIT "SPN" /end CHARACTERISTIC
/begin CHARACTERISTIC FCspn_SPK12_IGBT_T "FCtl_SPN(1022)" VALUE 0x001E2D5C /* @ECU_Address@FCtl_SPN@0x21B60FF8@ */ ECIPP_ALIGNMENT_ULONG 4294967295 Compu_IDENTITY 0 4294967295 PHYS_UNIT "SPN" /end CHARACTERISTIC
/begin CHARACTERISTIC FCspn_SPK2_IGBT_T "FCtl_SPN(510)" VALUE 0x001E255C /* @ECU_Address@FCtl_SPN@0x21B607F8@ */ ECIPP_ALIGNMENT_ULONG 4294967295 Compu_IDENTITY 0 4294967295 PHYS_UNIT "SPN" /end CHARACTERISTIC
/begin CHARACTERISTIC FCspn_SPK3_IGBT_T "FCtl_SPN(511)" VALUE 0x001E2560 /* @ECU_Address@FCtl_SPN@0x21B607FC@ */ ECIPP_ALIGNMENT_ULONG 4294967295 Compu_IDENTITY 0 4294967295 PHYS_UNIT "SPN" /end CHARACTERISTIC
/begin CHARACTERISTIC FCspn_SPK4_IGBT_T "FCtl_SPN(512)" VALUE 0x001E2564 /* @ECU_Address@FCtl_SPN@0x21B60800@ */ ECIPP_ALIGNMENT_ULONG 4294967295 Compu_IDENTITY 0 4294967295 PHYS_UNIT "SPN" /end CHARACTERISTIC
/begin CHARACTERISTIC FCspn_SPK5_IGBT_T "FCtl_SPN(513)" VALUE 0x001E2568 /* @ECU_Address@FCtl_SPN@0x21B60804@ */ ECIPP_ALIGNMENT_ULONG 4294967295 Compu_IDENTITY 0 4294967295 PHYS_UNIT "SPN" /end CHARACTERISTIC
/begin CHARACTERISTIC FCspn_SPK6_IGBT_T "FCtl_SPN(514)" VALUE 0x001E256C /* @ECU_Address@FCtl_SPN@0x21B60808@ */ ECIPP_ALIGNMENT_ULONG 4294967295 Compu_IDENTITY 0 4294967295 PHYS_UNIT "SPN" /end CHARACTERISTIC
/begin CHARACTERISTIC FCspn_SPK7_IGBT_T "FCtl_SPN(515)" VALUE 0x001E2570 /* @ECU_Address@FCtl_SPN@0x21B6080C@ */ ECIPP_ALIGNMENT_ULONG 4294967295 Compu_IDENTITY 0 4294967295 PHYS_UNIT "SPN" /end CHARACTERISTIC
/begin CHARACTERISTIC FCspn_SPK8_IGBT_T "FCtl_SPN(516)" VALUE 0x001E2574 /* @ECU_Address@FCtl_SPN@0x21B60810@ */ ECIPP_ALIGNMENT_ULONG 4294967295 Compu_IDENTITY 0 4294967295 PHYS_UNIT "SPN" /end CHARACTERISTIC
/begin CHARACTERISTIC FCspn_SPK9_IGBT_T "FCtl_SPN(517)" VALUE 0x001E2578 /* @ECU_Address@FCtl_SPN@0x21B60814@ */ ECIPP_ALIGNMENT_ULONG 4294967295 Compu_IDENTITY 0 4294967295 PHYS_UNIT "SPN" /end CHARACTERISTIC
/begin CHARACTERISTIC FCspn_SPKD10_coil_fail "FCtl_SPN(313)" VALUE 0x001E2248 /* @ECU_Address@FCtl_SPN@0x21B604E4@ */ ECIPP_ALIGNMENT_ULONG 4294967295 Compu_IDENTITY 0 4294967295 PHYS_UNIT "SPN" /end CHARACTERISTIC
/begin CHARACTERISTIC FCspn_SPKD10_dw_hi "FCtl_SPN(85)" VALUE 0x001E1EB8 /* @ECU_Address@FCtl_SPN@0x21B60154@ */ ECIPP_ALIGNMENT_ULONG 4294967295 Compu_IDENTITY 0 4294967295 PHYS_UNIT "SPN" /end CHARACTERISTIC
/begin CHARACTERISTIC FCspn_SPKD10_dw_lo "FCtl_SPN(75)" VALUE 0x001E1E90 /* @ECU_Address@FCtl_SPN@0x21B6012C@ */ ECIPP_ALIGNMENT_ULONG 4294967295 Compu_IDENTITY 0 4294967295 PHYS_UNIT "SPN" /end CHARACTERISTIC
/begin CHARACTERISTIC FCspn_SPKD11_coil_fail "FCtl_SPN(1027)" VALUE 0x001E2D70 /* @ECU_Address@FCtl_SPN@0x21B6100C@ */ ECIPP_ALIGNMENT_ULONG 4294967295 Compu_IDENTITY 0 4294967295 PHYS_UNIT "SPN" /end CHARACTERISTIC
/begin CHARACTERISTIC FCspn_SPKD11_dw_hi "FCtl_SPN(1025)" VALUE 0x001E2D68 /* @ECU_Address@FCtl_SPN@0x21B61004@ */ ECIPP_ALIGNMENT_ULONG 4294967295 Compu_IDENTITY 0 4294967295 PHYS_UNIT "SPN" /end CHARACTERISTIC
/begin CHARACTERISTIC FCspn_SPKD11_dw_lo "FCtl_SPN(1023)" VALUE 0x001E2D60 /* @ECU_Address@FCtl_SPN@0x21B60FFC@ */ ECIPP_ALIGNMENT_ULONG 4294967295 Compu_IDENTITY 0 4294967295 PHYS_UNIT "SPN" /end CHARACTERISTIC
/begin CHARACTERISTIC FCspn_SPKD12_coil_fail "FCtl_SPN(1028)" VALUE 0x001E2D74 /* @ECU_Address@FCtl_SPN@0x21B61010@ */ ECIPP_ALIGNMENT_ULONG 4294967295 Compu_IDENTITY 0 4294967295 PHYS_UNIT "SPN" /end CHARACTERISTIC
/begin CHARACTERISTIC FCspn_SPKD12_dw_hi "FCtl_SPN(1026)" VALUE 0x001E2D6C /* @ECU_Address@FCtl_SPN@0x21B61008@ */ ECIPP_ALIGNMENT_ULONG 4294967295 Compu_IDENTITY 0 4294967295 PHYS_UNIT "SPN" /end CHARACTERISTIC
/begin CHARACTERISTIC FCspn_SPKD12_dw_lo "FCtl_SPN(1024)" VALUE 0x001E2D64 /* @ECU_Address@FCtl_SPN@0x21B61000@ */ ECIPP_ALIGNMENT_ULONG 4294967295 Compu_IDENTITY 0 4294967295 PHYS_UNIT "SPN" /end CHARACTERISTIC
/begin CHARACTERISTIC FCspn_SPKD2_coil_fail "FCtl_SPN(305)" VALUE 0x001E2228 /* @ECU_Address@FCtl_SPN@0x21B604C4@ */ ECIPP_ALIGNMENT_ULONG 4294967295 Compu_IDENTITY 0 4294967295 PHYS_UNIT "SPN" /end CHARACTERISTIC
/begin CHARACTERISTIC FCspn_SPKD2_dw_hi "FCtl_SPN(77)" VALUE 0x001E1E98 /* @ECU_Address@FCtl_SPN@0x21B60134@ */ ECIPP_ALIGNMENT_ULONG 4294967295 Compu_IDENTITY 0 4294967295 PHYS_UNIT "SPN" /end CHARACTERISTIC
/begin CHARACTERISTIC FCspn_SPKD2_dw_lo "FCtl_SPN(67)" VALUE 0x001E1E70 /* @ECU_Address@FCtl_SPN@0x21B6010C@ */ ECIPP_ALIGNMENT_ULONG 4294967295 Compu_IDENTITY 0 4294967295 PHYS_UNIT "SPN" /end CHARACTERISTIC
/begin CHARACTERISTIC FCspn_SPKD3_coil_fail "FCtl_SPN(306)" VALUE 0x001E222C /* @ECU_Address@FCtl_SPN@0x21B604C8@ */ ECIPP_ALIGNMENT_ULONG 4294967295 Compu_IDENTITY 0 4294967295 PHYS_UNIT "SPN" /end CHARACTERISTIC
/begin CHARACTERISTIC FCspn_SPKD3_dw_hi "FCtl_SPN(78)" VALUE 0x001E1E9C /* @ECU_Address@FCtl_SPN@0x21B60138@ */ ECIPP_ALIGNMENT_ULONG 4294967295 Compu_IDENTITY 0 4294967295 PHYS_UNIT "SPN" /end CHARACTERISTIC
/begin CHARACTERISTIC FCspn_SPKD3_dw_lo "FCtl_SPN(68)" VALUE 0x001E1E74 /* @ECU_Address@FCtl_SPN@0x21B60110@ */ ECIPP_ALIGNMENT_ULONG 4294967295 Compu_IDENTITY 0 4294967295 PHYS_UNIT "SPN" /end CHARACTERISTIC
/begin CHARACTERISTIC FCspn_SPKD4_coil_fail "FCtl_SPN(307)" VALUE 0x001E2230 /* @ECU_Address@FCtl_SPN@0x21B604CC@ */ ECIPP_ALIGNMENT_ULONG 4294967295 Compu_IDENTITY 0 4294967295 PHYS_UNIT "SPN" /end CHARACTERISTIC
/begin CHARACTERISTIC FCspn_SPKD4_dw_hi "FCtl_SPN(79)" VALUE 0x001E1EA0 /* @ECU_Address@FCtl_SPN@0x21B6013C@ */ ECIPP_ALIGNMENT_ULONG 4294967295 Compu_IDENTITY 0 4294967295 PHYS_UNIT "SPN" /end CHARACTERISTIC
/begin CHARACTERISTIC FCspn_SPKD4_dw_lo "FCtl_SPN(69)" VALUE 0x001E1E78 /* @ECU_Address@FCtl_SPN@0x21B60114@ */ ECIPP_ALIGNMENT_ULONG 4294967295 Compu_IDENTITY 0 4294967295 PHYS_UNIT "SPN" /end CHARACTERISTIC
/begin CHARACTERISTIC FCspn_SPKD5_coil_fail "FCtl_SPN(308)" VALUE 0x001E2234 /* @ECU_Address@FCtl_SPN@0x21B604D0@ */ ECIPP_ALIGNMENT_ULONG 4294967295 Compu_IDENTITY 0 4294967295 PHYS_UNIT "SPN" /end CHARACTERISTIC
/begin CHARACTERISTIC FCspn_SPKD5_dw_hi "FCtl_SPN(80)" VALUE 0x001E1EA4 /* @ECU_Address@FCtl_SPN@0x21B60140@ */ ECIPP_ALIGNMENT_ULONG 4294967295 Compu_IDENTITY 0 4294967295 PHYS_UNIT "SPN" /end CHARACTERISTIC
/begin CHARACTERISTIC FCspn_SPKD5_dw_lo "FCtl_SPN(70)" VALUE 0x001E1E7C /* @ECU_Address@FCtl_SPN@0x21B60118@ */ ECIPP_ALIGNMENT_ULONG 4294967295 Compu_IDENTITY 0 4294967295 PHYS_UNIT "SPN" /end CHARACTERISTIC
/begin CHARACTERISTIC FCspn_SPKD6_coil_fail "FCtl_SPN(309)" VALUE 0x001E2238 /* @ECU_Address@FCtl_SPN@0x21B604D4@ */ ECIPP_ALIGNMENT_ULONG 4294967295 Compu_IDENTITY 0 4294967295 PHYS_UNIT "SPN" /end CHARACTERISTIC
/begin CHARACTERISTIC FCspn_SPKD6_dw_hi "FCtl_SPN(81)" VALUE 0x001E1EA8 /* @ECU_Address@FCtl_SPN@0x21B60144@ */ ECIPP_ALIGNMENT_ULONG 4294967295 Compu_IDENTITY 0 4294967295 PHYS_UNIT "SPN" /end CHARACTERISTIC
/begin CHARACTERISTIC FCspn_SPKD6_dw_lo "FCtl_SPN(71)" VALUE 0x001E1E80 /* @ECU_Address@FCtl_SPN@0x21B6011C@ */ ECIPP_ALIGNMENT_ULONG 4294967295 Compu_IDENTITY 0 4294967295 PHYS_UNIT "SPN" /end CHARACTERISTIC
/begin CHARACTERISTIC FCspn_SPKD7_coil_fail "FCtl_SPN(310)" VALUE 0x001E223C /* @ECU_Address@FCtl_SPN@0x21B604D8@ */ ECIPP_ALIGNMENT_ULONG 4294967295 Compu_IDENTITY 0 4294967295 PHYS_UNIT "SPN" /end CHARACTERISTIC
/begin CHARACTERISTIC FCspn_SPKD7_dw_hi "FCtl_SPN(82)" VALUE 0x001E1EAC /* @ECU_Address@FCtl_SPN@0x21B60148@ */ ECIPP_ALIGNMENT_ULONG 4294967295 Compu_IDENTITY 0 4294967295 PHYS_UNIT "SPN" /end CHARACTERISTIC
/begin CHARACTERISTIC FCspn_SPKD7_dw_lo "FCtl_SPN(72)" VALUE 0x001E1E84 /* @ECU_Address@FCtl_SPN@0x21B60120@ */ ECIPP_ALIGNMENT_ULONG 4294967295 Compu_IDENTITY 0 4294967295 PHYS_UNIT "SPN" /end CHARACTERISTIC
/begin CHARACTERISTIC FCspn_SPKD8_coil_fail "FCtl_SPN(311)" VALUE 0x001E2240 /* @ECU_Address@FCtl_SPN@0x21B604DC@ */ ECIPP_ALIGNMENT_ULONG 4294967295 Compu_IDENTITY 0 4294967295 PHYS_UNIT "SPN" /end CHARACTERISTIC
/begin CHARACTERISTIC FCspn_SPKD8_dw_hi "FCtl_SPN(83)" VALUE 0x001E1EB0 /* @ECU_Address@FCtl_SPN@0x21B6014C@ */ ECIPP_ALIGNMENT_ULONG 4294967295 Compu_IDENTITY 0 4294967295 PHYS_UNIT "SPN" /end CHARACTERISTIC
/begin CHARACTERISTIC FCspn_SPKD8_dw_lo "FCtl_SPN(73)" VALUE 0x001E1E88 /* @ECU_Address@FCtl_SPN@0x21B60124@ */ ECIPP_ALIGNMENT_ULONG 4294967295 Compu_IDENTITY 0 4294967295 PHYS_UNIT "SPN" /end CHARACTERISTIC
/begin CHARACTERISTIC FCspn_SPKD9_coil_fail "FCtl_SPN(312)" VALUE 0x001E2244 /* @ECU_Address@FCtl_SPN@0x21B604E0@ */ ECIPP_ALIGNMENT_ULONG 4294967295 Compu_IDENTITY 0 4294967295 PHYS_UNIT "SPN" /end CHARACTERISTIC
/begin CHARACTERISTIC FCspn_SPKD9_dw_hi "FCtl_SPN(84)" VALUE 0x001E1EB4 /* @ECU_Address@FCtl_SPN@0x21B60150@ */ ECIPP_ALIGNMENT_ULONG 4294967295 Compu_IDENTITY 0 4294967295 PHYS_UNIT "SPN" /end CHARACTERISTIC
/begin CHARACTERISTIC FCspn_SPKD9_dw_lo "FCtl_SPN(74)" VALUE 0x001E1E8C /* @ECU_Address@FCtl_SPN@0x21B60128@ */ ECIPP_ALIGNMENT_ULONG 4294967295 Compu_IDENTITY 0 4294967295 PHYS_UNIT "SPN" /end CHARACTERISTIC
/begin CHARACTERISTIC FCspn_TANK_2_V_maxv "FCtl_SPN(872)" VALUE 0x001E2B04 /* @ECU_Address@FCtl_SPN@0x21B60DA0@ */ ECIPP_ALIGNMENT_ULONG 4294967295 Compu_IDENTITY 0 4294967295 PHYS_UNIT "SPN" /end CHARACTERISTIC
/begin CHARACTERISTIC FCspn_TANK_2_V_minv "FCtl_SPN(874)" VALUE 0x001E2B0C /* @ECU_Address@FCtl_SPN@0x21B60DA8@ */ ECIPP_ALIGNMENT_ULONG 4294967295 Compu_IDENTITY 0 4294967295 PHYS_UNIT "SPN" /end CHARACTERISTIC
/begin CHARACTERISTIC FCspn_TANK_2_V_slow "FCtl_SPN(876)" VALUE 0x001E2B14 /* @ECU_Address@FCtl_SPN@0x21B60DB0@ */ ECIPP_ALIGNMENT_ULONG 4294967295 Compu_IDENTITY 0 4294967295 PHYS_UNIT "SPN" /end CHARACTERISTIC
/begin CHARACTERISTIC FCspn_UGF_Hv_lo "FCtl_SPN(243)" VALUE 0x001E2130 /* @ECU_Address@FCtl_SPN@0x21B603CC@ */ ECIPP_ALIGNMENT_ULONG 4294967295 Compu_IDENTITY 0 4294967295 PHYS_UNIT "SPN" /end CHARACTERISTIC
/begin CHARACTERISTIC FCspn_UGF1_PR_hi "FCtl_SPN(257)" VALUE 0x001E2168 /* @ECU_Address@FCtl_SPN@0x21B60404@ */ ECIPP_ALIGNMENT_ULONG 4294967295 Compu_IDENTITY 0 4294967295 PHYS_UNIT "SPN" /end CHARACTERISTIC
/begin CHARACTERISTIC FCspn_UGF1_PR_lo "FCtl_SPN(258)" VALUE 0x001E216C /* @ECU_Address@FCtl_SPN@0x21B60408@ */ ECIPP_ALIGNMENT_ULONG 4294967295 Compu_IDENTITY 0 4294967295 PHYS_UNIT "SPN" /end CHARACTERISTIC
/begin CHARACTERISTIC FCspn_UGF1_PR_slow "FCtl_SPN(255)" VALUE 0x001E2160 /* @ECU_Address@FCtl_SPN@0x21B603FC@ */ ECIPP_ALIGNMENT_ULONG 4294967295 Compu_IDENTITY 0 4294967295 PHYS_UNIT "SPN" /end CHARACTERISTIC
/begin CHARACTERISTIC FCspn_UGF1_Pv_hi "FCtl_SPN(252)" VALUE 0x001E2154 /* @ECU_Address@FCtl_SPN@0x21B603F0@ */ ECIPP_ALIGNMENT_ULONG 4294967295 Compu_IDENTITY 0 4294967295 PHYS_UNIT "SPN" /end CHARACTERISTIC
/begin CHARACTERISTIC FCspn_UGF1_Pv_lo "FCtl_SPN(253)" VALUE 0x001E2158 /* @ECU_Address@FCtl_SPN@0x21B603F4@ */ ECIPP_ALIGNMENT_ULONG 4294967295 Compu_IDENTITY 0 4294967295 PHYS_UNIT "SPN" /end CHARACTERISTIC
/begin CHARACTERISTIC FCspn_UGF1_PvFB_hi "FCtl_SPN(248)" VALUE 0x001E2144 /* @ECU_Address@FCtl_SPN@0x21B603E0@ */ ECIPP_ALIGNMENT_ULONG 4294967295 Compu_IDENTITY 0 4294967295 PHYS_UNIT "SPN" /end CHARACTERISTIC
/begin CHARACTERISTIC FCspn_UGF1_PvFB_lo "FCtl_SPN(249)" VALUE 0x001E2148 /* @ECU_Address@FCtl_SPN@0x21B603E4@ */ ECIPP_ALIGNMENT_ULONG 4294967295 Compu_IDENTITY 0 4294967295 PHYS_UNIT "SPN" /end CHARACTERISTIC
/begin CHARACTERISTIC FCspn_UGF1_R_lo "FCtl_SPN(245)" VALUE 0x001E2138 /* @ECU_Address@FCtl_SPN@0x21B603D4@ */ ECIPP_ALIGNMENT_ULONG 4294967295 Compu_IDENTITY 0 4294967295 PHYS_UNIT "SPN" /end CHARACTERISTIC
/begin CHARACTERISTIC FCspn_UGF1_rtn_hi "FCtl_SPN(246)" VALUE 0x001E213C /* @ECU_Address@FCtl_SPN@0x21B603D8@ */ ECIPP_ALIGNMENT_ULONG 4294967295 Compu_IDENTITY 0 4294967295 PHYS_UNIT "SPN" /end CHARACTERISTIC
/begin CHARACTERISTIC FCspn_UGF1_rtn_lo "FCtl_SPN(247)" VALUE 0x001E2140 /* @ECU_Address@FCtl_SPN@0x21B603DC@ */ ECIPP_ALIGNMENT_ULONG 4294967295 Compu_IDENTITY 0 4294967295 PHYS_UNIT "SPN" /end CHARACTERISTIC
/begin CHARACTERISTIC FCspn_UGF1_Sv_lo "FCtl_SPN(251)" VALUE 0x001E2150 /* @ECU_Address@FCtl_SPN@0x21B603EC@ */ ECIPP_ALIGNMENT_ULONG 4294967295 Compu_IDENTITY 0 4294967295 PHYS_UNIT "SPN" /end CHARACTERISTIC
/begin CHARACTERISTIC FCspn_UGF2_Hv_lo "FCtl_SPN(410)" VALUE 0x001E23CC /* @ECU_Address@FCtl_SPN@0x21B60668@ */ ECIPP_ALIGNMENT_ULONG 4294967295 Compu_IDENTITY 0 4294967295 PHYS_UNIT "SPN" /end CHARACTERISTIC
/begin CHARACTERISTIC FCspn_UGF2_PR_hi "FCtl_SPN(424)" VALUE 0x001E2404 /* @ECU_Address@FCtl_SPN@0x21B606A0@ */ ECIPP_ALIGNMENT_ULONG 4294967295 Compu_IDENTITY 0 4294967295 PHYS_UNIT "SPN" /end CHARACTERISTIC
/begin CHARACTERISTIC FCspn_UGF2_PR_lo "FCtl_SPN(425)" VALUE 0x001E2408 /* @ECU_Address@FCtl_SPN@0x21B606A4@ */ ECIPP_ALIGNMENT_ULONG 4294967295 Compu_IDENTITY 0 4294967295 PHYS_UNIT "SPN" /end CHARACTERISTIC
/begin CHARACTERISTIC FCspn_UGF2_PR_slow "FCtl_SPN(422)" VALUE 0x001E23FC /* @ECU_Address@FCtl_SPN@0x21B60698@ */ ECIPP_ALIGNMENT_ULONG 4294967295 Compu_IDENTITY 0 4294967295 PHYS_UNIT "SPN" /end CHARACTERISTIC
/begin CHARACTERISTIC FCspn_UGF2_Pv_hi "FCtl_SPN(419)" VALUE 0x001E23F0 /* @ECU_Address@FCtl_SPN@0x21B6068C@ */ ECIPP_ALIGNMENT_ULONG 4294967295 Compu_IDENTITY 0 4294967295 PHYS_UNIT "SPN" /end CHARACTERISTIC
/begin CHARACTERISTIC FCspn_UGF2_Pv_lo "FCtl_SPN(420)" VALUE 0x001E23F4 /* @ECU_Address@FCtl_SPN@0x21B60690@ */ ECIPP_ALIGNMENT_ULONG 4294967295 Compu_IDENTITY 0 4294967295 PHYS_UNIT "SPN" /end CHARACTERISTIC
/begin CHARACTERISTIC FCspn_UGF2_PvFB_hi "FCtl_SPN(415)" VALUE 0x001E23E0 /* @ECU_Address@FCtl_SPN@0x21B6067C@ */ ECIPP_ALIGNMENT_ULONG 4294967295 Compu_IDENTITY 0 4294967295 PHYS_UNIT "SPN" /end CHARACTERISTIC
/begin CHARACTERISTIC FCspn_UGF2_PvFB_lo "FCtl_SPN(416)" VALUE 0x001E23E4 /* @ECU_Address@FCtl_SPN@0x21B60680@ */ ECIPP_ALIGNMENT_ULONG 4294967295 Compu_IDENTITY 0 4294967295 PHYS_UNIT "SPN" /end CHARACTERISTIC
/begin CHARACTERISTIC FCspn_UGF2_R_lo "FCtl_SPN(412)" VALUE 0x001E23D4 /* @ECU_Address@FCtl_SPN@0x21B60670@ */ ECIPP_ALIGNMENT_ULONG 4294967295 Compu_IDENTITY 0 4294967295 PHYS_UNIT "SPN" /end CHARACTERISTIC
/begin CHARACTERISTIC FCspn_UGF2_rtn_hi "FCtl_SPN(413)" VALUE 0x001E23D8 /* @ECU_Address@FCtl_SPN@0x21B60674@ */ ECIPP_ALIGNMENT_ULONG 4294967295 Compu_IDENTITY 0 4294967295 PHYS_UNIT "SPN" /end CHARACTERISTIC
/begin CHARACTERISTIC FCspn_UGF2_rtn_lo "FCtl_SPN(414)" VALUE 0x001E23DC /* @ECU_Address@FCtl_SPN@0x21B60678@ */ ECIPP_ALIGNMENT_ULONG 4294967295 Compu_IDENTITY 0 4294967295 PHYS_UNIT "SPN" /end CHARACTERISTIC
/begin CHARACTERISTIC FCspn_UGF2_Sv_lo "FCtl_SPN(418)" VALUE 0x001E23EC /* @ECU_Address@FCtl_SPN@0x21B60688@ */ ECIPP_ALIGNMENT_ULONG 4294967295 Compu_IDENTITY 0 4294967295 PHYS_UNIT "SPN" /end CHARACTERISTIC
/begin CHARACTERISTIC FCspn_UGF3_Hv_lo "FCtl_SPN(606)" VALUE 0x001E26DC /* @ECU_Address@FCtl_SPN@0x21B60978@ */ ECIPP_ALIGNMENT_ULONG 4294967295 Compu_IDENTITY 0 4294967295 PHYS_UNIT "SPN" /end CHARACTERISTIC
/begin CHARACTERISTIC FCspn_UGF3_PR_hi "FCtl_SPN(620)" VALUE 0x001E2714 /* @ECU_Address@FCtl_SPN@0x21B609B0@ */ ECIPP_ALIGNMENT_ULONG 4294967295 Compu_IDENTITY 0 4294967295 PHYS_UNIT "SPN" /end CHARACTERISTIC
/begin CHARACTERISTIC FCspn_UGF3_PR_lo "FCtl_SPN(621)" VALUE 0x001E2718 /* @ECU_Address@FCtl_SPN@0x21B609B4@ */ ECIPP_ALIGNMENT_ULONG 4294967295 Compu_IDENTITY 0 4294967295 PHYS_UNIT "SPN" /end CHARACTERISTIC
/begin CHARACTERISTIC FCspn_UGF3_PR_slow "FCtl_SPN(618)" VALUE 0x001E270C /* @ECU_Address@FCtl_SPN@0x21B609A8@ */ ECIPP_ALIGNMENT_ULONG 4294967295 Compu_IDENTITY 0 4294967295 PHYS_UNIT "SPN" /end CHARACTERISTIC
/begin CHARACTERISTIC FCspn_UGF3_Pv_hi "FCtl_SPN(615)" VALUE 0x001E2700 /* @ECU_Address@FCtl_SPN@0x21B6099C@ */ ECIPP_ALIGNMENT_ULONG 4294967295 Compu_IDENTITY 0 4294967295 PHYS_UNIT "SPN" /end CHARACTERISTIC
/begin CHARACTERISTIC FCspn_UGF3_Pv_lo "FCtl_SPN(616)" VALUE 0x001E2704 /* @ECU_Address@FCtl_SPN@0x21B609A0@ */ ECIPP_ALIGNMENT_ULONG 4294967295 Compu_IDENTITY 0 4294967295 PHYS_UNIT "SPN" /end CHARACTERISTIC
/begin CHARACTERISTIC FCspn_UGF3_PvFB_hi "FCtl_SPN(611)" VALUE 0x001E26F0 /* @ECU_Address@FCtl_SPN@0x21B6098C@ */ ECIPP_ALIGNMENT_ULONG 4294967295 Compu_IDENTITY 0 4294967295 PHYS_UNIT "SPN" /end CHARACTERISTIC
/begin CHARACTERISTIC FCspn_UGF3_PvFB_lo "FCtl_SPN(612)" VALUE 0x001E26F4 /* @ECU_Address@FCtl_SPN@0x21B60990@ */ ECIPP_ALIGNMENT_ULONG 4294967295 Compu_IDENTITY 0 4294967295 PHYS_UNIT "SPN" /end CHARACTERISTIC
/begin CHARACTERISTIC FCspn_UGF3_R_lo "FCtl_SPN(608)" VALUE 0x001E26E4 /* @ECU_Address@FCtl_SPN@0x21B60980@ */ ECIPP_ALIGNMENT_ULONG 4294967295 Compu_IDENTITY 0 4294967295 PHYS_UNIT "SPN" /end CHARACTERISTIC
/begin CHARACTERISTIC FCspn_UGF3_rtn_hi "FCtl_SPN(609)" VALUE 0x001E26E8 /* @ECU_Address@FCtl_SPN@0x21B60984@ */ ECIPP_ALIGNMENT_ULONG 4294967295 Compu_IDENTITY 0 4294967295 PHYS_UNIT "SPN" /end CHARACTERISTIC
/begin CHARACTERISTIC FCspn_UGF3_rtn_lo "FCtl_SPN(610)" VALUE 0x001E26EC /* @ECU_Address@FCtl_SPN@0x21B60988@ */ ECIPP_ALIGNMENT_ULONG 4294967295 Compu_IDENTITY 0 4294967295 PHYS_UNIT "SPN" /end CHARACTERISTIC
/begin CHARACTERISTIC FCspn_UGF3_Sv_lo "FCtl_SPN(614)" VALUE 0x001E26FC /* @ECU_Address@FCtl_SPN@0x21B60998@ */ ECIPP_ALIGNMENT_ULONG 4294967295 Compu_IDENTITY 0 4294967295 PHYS_UNIT "SPN" /end CHARACTERISTIC
/begin CHARACTERISTIC FCspn_UGF4_Hv_lo "FCtl_SPN(629)" VALUE 0x001E2738 /* @ECU_Address@FCtl_SPN@0x21B609D4@ */ ECIPP_ALIGNMENT_ULONG 4294967295 Compu_IDENTITY 0 4294967295 PHYS_UNIT "SPN" /end CHARACTERISTIC
/begin CHARACTERISTIC FCspn_UGF4_PR_hi "FCtl_SPN(643)" VALUE 0x001E2770 /* @ECU_Address@FCtl_SPN@0x21B60A0C@ */ ECIPP_ALIGNMENT_ULONG 4294967295 Compu_IDENTITY 0 4294967295 PHYS_UNIT "SPN" /end CHARACTERISTIC
/begin CHARACTERISTIC FCspn_UGF4_PR_lo "FCtl_SPN(644)" VALUE 0x001E2774 /* @ECU_Address@FCtl_SPN@0x21B60A10@ */ ECIPP_ALIGNMENT_ULONG 4294967295 Compu_IDENTITY 0 4294967295 PHYS_UNIT "SPN" /end CHARACTERISTIC
/begin CHARACTERISTIC FCspn_UGF4_PR_slow "FCtl_SPN(641)" VALUE 0x001E2768 /* @ECU_Address@FCtl_SPN@0x21B60A04@ */ ECIPP_ALIGNMENT_ULONG 4294967295 Compu_IDENTITY 0 4294967295 PHYS_UNIT "SPN" /end CHARACTERISTIC
/begin CHARACTERISTIC FCspn_UGF4_Pv_hi "FCtl_SPN(638)" VALUE 0x001E275C /* @ECU_Address@FCtl_SPN@0x21B609F8@ */ ECIPP_ALIGNMENT_ULONG 4294967295 Compu_IDENTITY 0 4294967295 PHYS_UNIT "SPN" /end CHARACTERISTIC
/begin CHARACTERISTIC FCspn_UGF4_Pv_lo "FCtl_SPN(639)" VALUE 0x001E2760 /* @ECU_Address@FCtl_SPN@0x21B609FC@ */ ECIPP_ALIGNMENT_ULONG 4294967295 Compu_IDENTITY 0 4294967295 PHYS_UNIT "SPN" /end CHARACTERISTIC
/begin CHARACTERISTIC FCspn_UGF4_PvFB_hi "FCtl_SPN(634)" VALUE 0x001E274C /* @ECU_Address@FCtl_SPN@0x21B609E8@ */ ECIPP_ALIGNMENT_ULONG 4294967295 Compu_IDENTITY 0 4294967295 PHYS_UNIT "SPN" /end CHARACTERISTIC
/begin CHARACTERISTIC FCspn_UGF4_PvFB_lo "FCtl_SPN(635)" VALUE 0x001E2750 /* @ECU_Address@FCtl_SPN@0x21B609EC@ */ ECIPP_ALIGNMENT_ULONG 4294967295 Compu_IDENTITY 0 4294967295 PHYS_UNIT "SPN" /end CHARACTERISTIC
/begin CHARACTERISTIC FCspn_UGF4_R_lo "FCtl_SPN(631)" VALUE 0x001E2740 /* @ECU_Address@FCtl_SPN@0x21B609DC@ */ ECIPP_ALIGNMENT_ULONG 4294967295 Compu_IDENTITY 0 4294967295 PHYS_UNIT "SPN" /end CHARACTERISTIC
/begin CHARACTERISTIC FCspn_UGF4_rtn_hi "FCtl_SPN(632)" VALUE 0x001E2744 /* @ECU_Address@FCtl_SPN@0x21B609E0@ */ ECIPP_ALIGNMENT_ULONG 4294967295 Compu_IDENTITY 0 4294967295 PHYS_UNIT "SPN" /end CHARACTERISTIC
/begin CHARACTERISTIC FCspn_UGF4_rtn_lo "FCtl_SPN(633)" VALUE 0x001E2748 /* @ECU_Address@FCtl_SPN@0x21B609E4@ */ ECIPP_ALIGNMENT_ULONG 4294967295 Compu_IDENTITY 0 4294967295 PHYS_UNIT "SPN" /end CHARACTERISTIC
/begin CHARACTERISTIC FCspn_UGF4_Sv_lo "FCtl_SPN(637)" VALUE 0x001E2758 /* @ECU_Address@FCtl_SPN@0x21B609F4@ */ ECIPP_ALIGNMENT_ULONG 4294967295 Compu_IDENTITY 0 4294967295 PHYS_UNIT "SPN" /end CHARACTERISTIC
/end MODULE
/end PROJECT
