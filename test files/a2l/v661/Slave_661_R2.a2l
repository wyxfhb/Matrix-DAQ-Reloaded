ASAP2_VERSION 1 61
/begin PROJECT Econtrols_4G "4G Test"
/begin HEADER "4G A2L Configuration" PROJECT_NO EControls4G /* config for version control */ VERSION "$Revision: 82130 $:" /* config for version control */ /end HEADER
/begin MODULE EControls_4G_SH2A "EControls 4G"
/begin MOD_COMMON "" DEPOSIT ABSOLUTE BYTE_ORDER MSB_FIRST /end MOD_COMMON
/* Define the Record Layouts */
/begin RECORD_LAYOUT ECIPP_ALIGNMENT_UBYTE FNC_VALUES 1 UBYTE COLUMN_DIR DIRECT /end RECORD_LAYOUT
/begin RECORD_LAYOUT ECIPP_ALIGNMENT_UWORD FNC_VALUES 1 UWORD COLUMN_DIR DIRECT /end RECORD_LAYOUT
/begin RECORD_LAYOUT ECIPP_ALIGNMENT_SWORD FNC_VALUES 1 SWORD COLUMN_DIR DIRECT /end RECORD_LAYOUT
/begin RECORD_LAYOUT ECIPP_Lookup_SWORD AXIS_PTS_X 1 SWORD INDEX_INCR DIRECT /end RECORD_LAYOUT
/begin RECORD_LAYOUT ECIPP_ALIGNMENT_ULONG FNC_VALUES 1 ULONG COLUMN_DIR DIRECT /end RECORD_LAYOUT
/begin RECORD_LAYOUT ECIPP_ALIGNMENT_FLOAT32_IEEE FNC_VALUES 1 FLOAT32_IEEE COLUMN_DIR DIRECT /end RECORD_LAYOUT
/begin RECORD_LAYOUT ECIPP_Lookup_FLOAT32_IEEE AXIS_PTS_X 1 FLOAT32_IEEE INDEX_INCR DIRECT /end RECORD_LAYOUT
/begin MEASUREMENT dwell1 "Coil1 dwell" UWORD Compu_dwell1 0 0 0 209.712 ECU_ADDRESS 0x01000060 /end MEASUREMENT
/begin COMPU_METHOD Compu_dwell1 " " RAT_FUNC "%.2" "ms" COEFFS 0 312.5 0 0 0 1 /end COMPU_METHOD
/begin MEASUREMENT dwell2 "Coil2 dwell" UWORD Compu_dwell2 0 0 0 209.712 ECU_ADDRESS 0x01000068 /end MEASUREMENT
/begin COMPU_METHOD Compu_dwell2 " " RAT_FUNC "%.2" "ms" COEFFS 0 312.5 0 0 0 1 /end COMPU_METHOD
/begin MEASUREMENT dwell3 "Coil3 dwell" UWORD Compu_dwell3 0 0 0 209.712 ECU_ADDRESS 0x01000070 /end MEASUREMENT
/begin COMPU_METHOD Compu_dwell3 " " RAT_FUNC "%.2" "ms" COEFFS 0 312.5 0 0 0 1 /end COMPU_METHOD
/begin MEASUREMENT MAPdt_dz "MAPdt_dz" SWORD Compu_MAPdt_dz 0 0 -4000 3999.8779296875 ECU_ADDRESS 0x010000E8 /end MEASUREMENT
/begin COMPU_METHOD Compu_MAPdt_dz " " RAT_FUNC "%.1" "psi/sec" COEFFS 0 8.192 0 0 0 1 /end COMPU_METHOD
/begin MEASUREMENT rpmdt "rpmdt" SWORD Compu_rpmdt 0 0 -64000 63998.046875 ECU_ADDRESS 0x01000100 /end MEASUREMENT
/begin COMPU_METHOD Compu_rpmdt " " RAT_FUNC "%.0" "rpm / sec" COEFFS 0 0.512 0 0 0 1 /end COMPU_METHOD
/begin MEASUREMENT EGO1_volts "EGO1" UWORD Compu_EGO1_volts 0 0 0 15.999755859375 ECU_ADDRESS 0x01000170 /end MEASUREMENT
/begin COMPU_METHOD Compu_EGO1_volts " " RAT_FUNC "%.3" "volts" COEFFS 0 4096 0 0 0 1 /end COMPU_METHOD
/begin MEASUREMENT EGO2_volts "EGO2" UWORD Compu_EGO2_volts 0 0 0 15.999755859375 ECU_ADDRESS 0x01000178 /end MEASUREMENT
/begin COMPU_METHOD Compu_EGO2_volts " " RAT_FUNC "%.3" "volts" COEFFS 0 4096 0 0 0 1 /end COMPU_METHOD
/begin MEASUREMENT EGO3_volts "EGO3" UWORD Compu_EGO3_volts 0 0 0 15.999755859375 ECU_ADDRESS 0x01000180 /end MEASUREMENT
/begin COMPU_METHOD Compu_EGO3_volts " " RAT_FUNC "%.3" "volts" COEFFS 0 4096 0 0 0 1 /end COMPU_METHOD
/begin MEASUREMENT MAPe "MAP effective" UWORD Compu_MAPe 0 0 0 255.99609375 ECU_ADDRESS 0x010001D0 /end MEASUREMENT
/begin COMPU_METHOD Compu_MAPe " " RAT_FUNC "%.2" "psia" COEFFS 0 256 0 0 0 1 /end COMPU_METHOD
/begin MEASUREMENT eng_load "eng_load" UWORD Compu_eng_load 0 0 0 99.9984741210938 ECU_ADDRESS 0x010002A8 /end MEASUREMENT
/begin COMPU_METHOD Compu_eng_load " " RAT_FUNC "%.1" "%" COEFFS 0 655.36 0 0 0 1 /end COMPU_METHOD
/begin MEASUREMENT PWe_avg "PW (extended)" UWORD Compu_PWe_avg 0 0 0 2047.96875 ECU_ADDRESS 0x01000390 /end MEASUREMENT
/begin COMPU_METHOD Compu_PWe_avg " " RAT_FUNC "%.1" "ms" COEFFS 0 32 0 0 0 1 /end COMPU_METHOD
/begin MEASUREMENT TIP_slow "TIP slow-filtered" UWORD Compu_TIP_slow 0 0 0 255.99609375 ECU_ADDRESS 0x01000460 /end MEASUREMENT
/begin COMPU_METHOD Compu_TIP_slow " " RAT_FUNC "%.2" "psia" COEFFS 0 256 0 0 0 1 /end COMPU_METHOD
/begin MEASUREMENT MAPdt_MAPss "MAP steady-state" UWORD Compu_MAPdt_MAPss 0 0 0 255.99609375 ECU_ADDRESS 0x01000498 /end MEASUREMENT
/begin COMPU_METHOD Compu_MAPdt_MAPss " " RAT_FUNC "%.2" "psia" COEFFS 0 256 0 0 0 1 /end COMPU_METHOD
/begin CHARACTERISTIC TFBdt_n "TFBdt window" VALUE 0x001C9C60 /* @ECU_Address@TFBdt_n@0x01000808@ */ ECIPP_ALIGNMENT_UBYTE 255 Compu_TFBdt_n 0 255 /end CHARACTERISTIC
/begin COMPU_METHOD Compu_TFBdt_n " " RAT_FUNC "%.0" "ms" COEFFS 0 1 0 0 0 1 /end COMPU_METHOD
/begin CHARACTERISTIC MAPdt_n "MAPdt interpolation window" VALUE 0x001c881d /* @ECU_Address@MAPdt_n@0x01000810@ */ ECIPP_ALIGNMENT_UBYTE 255 Compu_MAPdt_n 0 255 /end CHARACTERISTIC
/begin COMPU_METHOD Compu_MAPdt_n " " RAT_FUNC "%.0" "ms" COEFFS 0 1 0 0 0 1 /end COMPU_METHOD
/begin MEASUREMENT rpmdt_n "rpmdt window" UBYTE Compu_rpmdt_n 0 0 0 1275 ECU_ADDRESS 0x01000818 /end MEASUREMENT
/begin COMPU_METHOD Compu_rpmdt_n " " RAT_FUNC "%.0" "ms" COEFFS 0 0.2 0 0 0 1 /end COMPU_METHOD
/begin CHARACTERISTIC TPSraw_LP "TPS raw low-pass" VALUE 0x001C9C5E /* @ECU_Address@TPSraw_LP@0x01000830@ */ ECIPP_ALIGNMENT_UWORD 32768 Compu_TPSraw_LP 0.045084 32768 /end CHARACTERISTIC
/begin COMPU_METHOD Compu_TPSraw_LP " " FORM "%.3" "ms"
 /begin FORMULA "-0.5 / log(1 - (X1 / 65536))" FORMULA_INV "(1 - exp(-0.5/X1)) * 65536" /end FORMULA
/end COMPU_METHOD
/begin CHARACTERISTIC MAPraw_LP "MAP raw low-pass" VALUE 0x001c8568 /* @ECU_Address@MAPraw_LP@0x01000838@ */ ECIPP_ALIGNMENT_UWORD 32768 Compu_MAPraw_LP 0.045084 32768 /end CHARACTERISTIC
/begin COMPU_METHOD Compu_MAPraw_LP " " FORM "%.3" "ms"
 /begin FORMULA "-0.5 / log(1 - (X1 / 65536))" FORMULA_INV "(1 - exp(-0.5/X1)) * 65536" /end FORMULA
/end COMPU_METHOD
/begin CHARACTERISTIC TFBdt_xLP "TFBdt post low-pass" VALUE 0x001C9C62 /* @ECU_Address@TFBdt_xLP@0x01000840@ */ ECIPP_ALIGNMENT_UWORD 32768 Compu_TFBdt_xLP 0.033406 32768 /end CHARACTERISTIC
/begin COMPU_METHOD Compu_TFBdt_xLP " " FORM "%.3" "ms"
 /begin FORMULA "-1 / log(1.0000000000001 - (X1 / 32768))" FORMULA_INV "(1.0000000000001 - exp(-1/X1)) * 32768" /end FORMULA
/end COMPU_METHOD
/begin CHARACTERISTIC MAPdt_xLP "MAPdt low-pass filter" VALUE 0x001c8566 /* @ECU_Address@MAPdt_xLP@0x01000848@ */ ECIPP_ALIGNMENT_UWORD 163840 Compu_MAPdt_xLP 0.16703 163840 /end CHARACTERISTIC
/begin COMPU_METHOD Compu_MAPdt_xLP " " FORM "%.3" "ms"
 /begin FORMULA "-5 / log(1.0000000000001 - (X1 / 32768))" FORMULA_INV "(1.0000000000001 - exp(-5/X1)) * 32768" /end FORMULA
/end COMPU_METHOD
/begin CHARACTERISTIC MAP_favg_n "MAP average window" VALUE 0x001c8815 /* @ECU_Address@MAP_favg_n@0x01000858@ */ ECIPP_ALIGNMENT_UBYTE 255 Compu_MAP_favg_n 0 255 /end CHARACTERISTIC
/begin COMPU_METHOD Compu_MAP_favg_n " " RAT_FUNC "%.0" "ms" COEFFS 0 1 0 0 0 1 /end COMPU_METHOD
/begin CHARACTERISTIC MAP_savg_n "MAP slow average window" VALUE 0x001c8819 /* @ECU_Address@MAP_savg_n@0x01000860@ */ ECIPP_ALIGNMENT_UBYTE 255 Compu_MAP_savg_n 0 255 /end CHARACTERISTIC
/begin COMPU_METHOD Compu_MAP_savg_n " " RAT_FUNC "%.0" "ms" COEFFS 0 1 0 0 0 1 /end COMPU_METHOD
/begin CHARACTERISTIC rpm_filt_n "rpm slow average" VALUE 0x001c9077 /* @ECU_Address@rpm_filt_n@0x01000868@ */ ECIPP_ALIGNMENT_UBYTE 1275 Compu_rpm_filt_n 0 1275 /end CHARACTERISTIC
/begin COMPU_METHOD Compu_rpm_filt_n " " RAT_FUNC "%.0" "ms" COEFFS 0 0.2 0 0 0 1 /end COMPU_METHOD
/begin CHARACTERISTIC MAPdt_crk_dz "MAPdt crank dz" VALUE 0x001c4552 /* @ECU_Address@MAPdt_crk_dz@0x01000870@ */ ECIPP_ALIGNMENT_SWORD 4000 Compu_MAPdt_crk_dz -4000 3999.8779296875 /end CHARACTERISTIC
/begin COMPU_METHOD Compu_MAPdt_crk_dz " " RAT_FUNC "%.1" "psi/sec" COEFFS 0 8.192 0 0 0 1 /end COMPU_METHOD
/begin CHARACTERISTIC MAPdt_nrm_dz "MAPdt normal dz" VALUE 0x001c4554 /* @ECU_Address@MAPdt_nrm_dz@0x01000878@ */ ECIPP_ALIGNMENT_SWORD 4000 Compu_MAPdt_nrm_dz -4000 3999.8779296875 /end CHARACTERISTIC
/begin COMPU_METHOD Compu_MAPdt_nrm_dz " " RAT_FUNC "%.1" "psi/sec" COEFFS 0 8.192 0 0 0 1 /end COMPU_METHOD
/begin CHARACTERISTIC MAP_CADproject "MAP_CADproject" VALUE 0x001c7d3e /* @ECU_Address@MAP_CADproject@0x01000920@ */ ECIPP_ALIGNMENT_UWORD 65535 Compu_MAP_CADproject 0 65535 /end CHARACTERISTIC
/begin COMPU_METHOD Compu_MAP_CADproject " " RAT_FUNC "%.0" "CAD" COEFFS 0 1 0 0 0 1 /end COMPU_METHOD
/begin MEASUREMENT rpmdt_xLP "rpmdt post low-pass" UWORD Compu_rpmdt_xLP 0 0 0.16703 163840 ECU_ADDRESS 0x01000BF0 /end MEASUREMENT
/begin COMPU_METHOD Compu_rpmdt_xLP " " FORM "%.3" "ms"
 /begin FORMULA "-5 / log(1.0000000000001 - (X1 / 32768))" FORMULA_INV "(1.0000000000001 - exp(-5/X1)) * 32768" /end FORMULA
/end COMPU_METHOD
/begin MEASUREMENT inj_kill "Injector kill{inj_kill&0xff=0:Normal}{inj_kill&0xff=1:Injector 1}{inj_kill&0xff=2:Injector 2}{inj_kill&0xff=3:Injector 3}{inj_kill&0xff=4:Injector 4}{inj_kill&0xff=5:Injector 5}{inj_kill&0xff=6:Injector 6}{inj_kill&0xff=7:Injector 7}{inj_kill&0xff=8:Injec" UBYTE inj_kill_COMPU_VTAB 0 0 0 255 ECU_ADDRESS 0x01000F00 BIT_MASK 0xff /end MEASUREMENT
/begin COMPU_METHOD inj_kill_COMPU_VTAB "Verbal Table" TAB_VERB "%.0" "list" COMPU_TAB_REF inj_kill_COMPU_VTAB_REF /end COMPU_METHOD
/begin COMPU_VTAB inj_kill_COMPU_VTAB_REF "Verbal Table" TAB_VERB 13 0 "Normal" 1 "Injector 1" 2 "Injector 2" 3 "Injector 3" 4 "Injector 4" 5 "Injector 5" 6 "Injector 6" 7 "Injector 7" 8 "Injector 8" 9 "Injector 9" 10 "Injector 10" 11 "Injector 11" 12 "Injector 12" DEFAULT_VALUE "UNKNOWN" /end COMPU_VTAB
/begin MEASUREMENT spk_kill "Spark kill{spk_kill&0xff=0:Normal}{spk_kill&0xff=1:Coil 1}{spk_kill&0xff=2:Coil 2}{spk_kill&0xff=3:Coil 3}{spk_kill&0xff=4:Coil 4}{spk_kill&0xff=5:Coil 5}{spk_kill&0xff=6:Coil 6}{spk_kill&0xff=7:Coil 7}{spk_kill&0xff=8:Coil 8}{spk_kill&0xff=9:Coil 9}{spk_" UBYTE spk_kill_COMPU_VTAB 0 0 0 255 ECU_ADDRESS 0x01000F08 BIT_MASK 0xff /end MEASUREMENT
/begin COMPU_METHOD spk_kill_COMPU_VTAB "Verbal Table" TAB_VERB "%.0" "list" COMPU_TAB_REF spk_kill_COMPU_VTAB_REF /end COMPU_METHOD
/begin COMPU_VTAB spk_kill_COMPU_VTAB_REF "Verbal Table" TAB_VERB 13 0 "Normal" 1 "Coil 1" 2 "Coil 2" 3 "Coil 3" 4 "Coil 4" 5 "Coil 5" 6 "Coil 6" 7 "Coil 7" 8 "Coil 8" 9 "Coil 9" 10 "Coil 10" 11 "Coil 11" 12 "Coil 12" DEFAULT_VALUE "UNKNOWN" /end COMPU_VTAB
/begin MEASUREMENT Gov1_volt "Gov1 select voltage" UBYTE Compu_Gov1_volt 0 0 0 31.875 ECU_ADDRESS 0x010012A8 /end MEASUREMENT
/begin COMPU_METHOD Compu_Gov1_volt " " RAT_FUNC "%.1" "volts" COEFFS 0 8 0 0 0 1 /end COMPU_METHOD
/begin MEASUREMENT Gov2_volt "Gov2 select voltage" UBYTE Compu_Gov2_volt 0 0 0 31.875 ECU_ADDRESS 0x010012B0 /end MEASUREMENT
/begin COMPU_METHOD Compu_Gov2_volt " " RAT_FUNC "%.1" "volts" COEFFS 0 8 0 0 0 1 /end COMPU_METHOD
/begin MEASUREMENT OilP_volt "Oil pressure voltage" UBYTE Compu_OilP_volt 0 0 0 31.875 ECU_ADDRESS 0x010012B8 /end MEASUREMENT
/begin COMPU_METHOD Compu_OilP_volt " " RAT_FUNC "%.1" "volts" COEFFS 0 8 0 0 0 1 /end COMPU_METHOD
/begin MEASUREMENT fault_clear_all "Clear All Faults{fault_clear_all&0xff=0:NO}{fault_clear_all&0xff=1:YES}" UBYTE fault_clear_all_COMPU_VTAB 0 0 0 255 ECU_ADDRESS 0x010013D0 BIT_MASK 0xff /end MEASUREMENT
/begin COMPU_METHOD fault_clear_all_COMPU_VTAB "Verbal Table" TAB_VERB "%.0" "list" COMPU_TAB_REF fault_clear_all_COMPU_VTAB_REF /end COMPU_METHOD
/begin COMPU_VTAB fault_clear_all_COMPU_VTAB_REF "Verbal Table" TAB_VERB 2 0 "NO" 1 "YES" DEFAULT_VALUE "UNKNOWN" /end COMPU_VTAB
/begin CHARACTERISTIC FPraw_LP "Primary FP raw filter" VALUE 0x001C9F80 /* @ECU_Address@FPraw_LP@0x01001C70@ */ ECIPP_ALIGNMENT_UWORD 327680 Compu_FPraw_LP 0.45084 327680 /end CHARACTERISTIC
/begin COMPU_METHOD Compu_FPraw_LP " " FORM "%.3" "ms"
 /begin FORMULA "-5 / log(1 - (X1 / 65536))" FORMULA_INV "(1 - exp(-5/X1)) * 65536" /end FORMULA
/end COMPU_METHOD
/begin CHARACTERISTIC TIPraw_LP "TIP raw filter" VALUE 0x001c8606 /* @ECU_Address@TIPraw_LP@0x01001C78@ */ ECIPP_ALIGNMENT_UWORD 327680 Compu_TIPraw_LP 0.45084 327680 /end CHARACTERISTIC
/begin COMPU_METHOD Compu_TIPraw_LP " " FORM "%.3" "ms"
 /begin FORMULA "-5 / log(1 - (X1 / 65536))" FORMULA_INV "(1 - exp(-5/X1)) * 65536" /end FORMULA
/end COMPU_METHOD
/begin CHARACTERISTIC EGO_phidt_n "EGO derivative interp window" VALUE 0x001c86d8 /* @ECU_Address@EGO_phidt_n@0x01002060@ */ ECIPP_ALIGNMENT_UBYTE 255 Compu_EGO_phidt_n 0 255 /end CHARACTERISTIC
/begin COMPU_METHOD Compu_EGO_phidt_n " " RAT_FUNC "%.0" "T_delay" COEFFS 0 1 0 0 0 1 /end COMPU_METHOD
/begin MEASUREMENT dwell4 "Coil4 dwell" UWORD Compu_dwell4 0 0 0 209.712 ECU_ADDRESS 0x01002210 /end MEASUREMENT
/begin COMPU_METHOD Compu_dwell4 " " RAT_FUNC "%.2" "ms" COEFFS 0 312.5 0 0 0 1 /end COMPU_METHOD
/begin MEASUREMENT dwell5 "Coil5 dwell" UWORD Compu_dwell5 0 0 0 209.712 ECU_ADDRESS 0x01002218 /end MEASUREMENT
/begin COMPU_METHOD Compu_dwell5 " " RAT_FUNC "%.2" "ms" COEFFS 0 312.5 0 0 0 1 /end COMPU_METHOD
/begin MEASUREMENT dwell6 "Coil6 dwell" UWORD Compu_dwell6 0 0 0 209.712 ECU_ADDRESS 0x01002220 /end MEASUREMENT
/begin COMPU_METHOD Compu_dwell6 " " RAT_FUNC "%.2" "ms" COEFFS 0 312.5 0 0 0 1 /end COMPU_METHOD
/begin MEASUREMENT dwell7 "Coil7 dwell" UWORD Compu_dwell7 0 0 0 209.712 ECU_ADDRESS 0x01002228 /end MEASUREMENT
/begin COMPU_METHOD Compu_dwell7 " " RAT_FUNC "%.2" "ms" COEFFS 0 312.5 0 0 0 1 /end COMPU_METHOD
/begin MEASUREMENT dwell8 "Coil8 dwell" UWORD Compu_dwell8 0 0 0 209.712 ECU_ADDRESS 0x01002230 /end MEASUREMENT
/begin COMPU_METHOD Compu_dwell8 " " RAT_FUNC "%.2" "ms" COEFFS 0 312.5 0 0 0 1 /end COMPU_METHOD
/begin MEASUREMENT dwell9 "Coil9 dwell" UWORD Compu_dwell9 0 0 0 209.712 ECU_ADDRESS 0x01002238 /end MEASUREMENT
/begin COMPU_METHOD Compu_dwell9 " " RAT_FUNC "%.2" "ms" COEFFS 0 312.5 0 0 0 1 /end COMPU_METHOD
/begin MEASUREMENT dwell10 "Coil10 dwell" UWORD Compu_dwell10 0 0 0 209.712 ECU_ADDRESS 0x01002240 /end MEASUREMENT
/begin COMPU_METHOD Compu_dwell10 " " RAT_FUNC "%.2" "ms" COEFFS 0 312.5 0 0 0 1 /end COMPU_METHOD
/begin CHARACTERISTIC WGPraw_LP "WGP feedback low-pass tau" VALUE 0x001c864a /* @ECU_Address@WGPraw_LP@0x01002558@ */ ECIPP_ALIGNMENT_UWORD 327680 Compu_WGPraw_LP 0.45084 327680 /end CHARACTERISTIC
/begin COMPU_METHOD Compu_WGPraw_LP " " FORM "%.1" "ms"
 /begin FORMULA "-5 / log(1 - (X1 / 65536))" FORMULA_INV "(1 - exp(-5/X1)) * 65536" /end FORMULA
/end COMPU_METHOD
/begin MEASUREMENT MAP_raw "MAP_raw" UWORD Compu_MAP_raw 0 0 0 5.00114468864469 ECU_ADDRESS 0x01002670 /end MEASUREMENT
/begin COMPU_METHOD Compu_MAP_raw " " RAT_FUNC "%.3" "volts" COEFFS 0 13104 0 0 0 1 /end COMPU_METHOD
/begin MEASUREMENT ECT_raw "ECT_raw" UWORD Compu_ECT_raw 0 0 0 5.00114468864469 ECU_ADDRESS 0x010026D0 /end MEASUREMENT
/begin COMPU_METHOD Compu_ECT_raw " " RAT_FUNC "%.3" "volts" COEFFS 0 13104 0 0 0 1 /end COMPU_METHOD
/begin MEASUREMENT IAT_raw "IAT_raw" UWORD Compu_IAT_raw 0 0 0 5.00114468864469 ECU_ADDRESS 0x010026D8 /end MEASUREMENT
/begin COMPU_METHOD Compu_IAT_raw " " RAT_FUNC "%.3" "volts" COEFFS 0 13104 0 0 0 1 /end COMPU_METHOD
/begin CHARACTERISTIC OilP_loP "Oil pressure sender low-presure (Fault Condition:Stage 2: oil pressure <)" VALUE 0x001c7e2a /* @ECU_Address@OilP_loP@0x01002BC8@ */ ECIPP_ALIGNMENT_UWORD 256 Compu_OilP_loP 0 255.99609375 /end CHARACTERISTIC
/begin COMPU_METHOD Compu_OilP_loP " " RAT_FUNC "%.1" "psig" COEFFS 0 256 0 0 0 1 /end COMPU_METHOD
/begin CHARACTERISTIC OilP_hiP "Oil pressure sender high-presure (Fault Condition:Oil pressure >)" VALUE 0x001c7e26 /* @ECU_Address@OilP_hiP@0x01002BD0@ */ ECIPP_ALIGNMENT_UWORD 256 Compu_OilP_hiP 0 255.99609375 /end CHARACTERISTIC
/begin COMPU_METHOD Compu_OilP_hiP " " RAT_FUNC "%.1" "psig" COEFFS 0 256 0 0 0 1 /end COMPU_METHOD
/begin CHARACTERISTIC rpmdt_sLP "Slow-filtered rpmdt filter" VALUE 0x001c8662 /* @ECU_Address@rpmdt_sLP@0x01002F58@ */ ECIPP_ALIGNMENT_UWORD 163840 Compu_rpmdt_sLP 0.16703 163840 /end CHARACTERISTIC
/begin COMPU_METHOD Compu_rpmdt_sLP " " FORM "%.1" "ms"
 /begin FORMULA "-5 / log(1.0000000000001 - (X1 / 32768))" FORMULA_INV "(1.0000000000001 - exp(-5/X1)) * 32768" /end FORMULA
/end COMPU_METHOD
/begin MEASUREMENT rpmdt_slow "Slow-filtered rpmdt" SWORD Compu_rpmdt_slow 0 0 -64000 63998.046875 ECU_ADDRESS 0x01002F60 /end MEASUREMENT
/begin COMPU_METHOD Compu_rpmdt_slow " " RAT_FUNC "%.0" "rpm/sec" COEFFS 0 0.512 0 0 0 1 /end COMPU_METHOD
/begin MEASUREMENT MILout_mirror "MIL output pin{MILout_mirror&0x01=0x00:Off}{MILout_mirror&0x01=0x01:On}" UBYTE MILout_mirror_COMPU_VTAB 0 0 0 255 ECU_ADDRESS 0x01003228 BIT_MASK 0x01 /end MEASUREMENT
/begin COMPU_METHOD MILout_mirror_COMPU_VTAB "Verbal Table" TAB_VERB "%.0" "list" COMPU_TAB_REF MILout_mirror_COMPU_VTAB_REF /end COMPU_METHOD
/begin COMPU_VTAB MILout_mirror_COMPU_VTAB_REF "Verbal Table" TAB_VERB 2 0x00 "Off" 0x01 "On" DEFAULT_VALUE "UNKNOWN" /end COMPU_VTAB
/begin MEASUREMENT BUZZout_mirror "Buzzer output pin{BUZZout_mirror&0x01=0x00:Off}{BUZZout_mirror&0x01=0x01:On}" UBYTE BUZZout_mirror_COMPU_VTAB 0 0 0 255 ECU_ADDRESS 0x01003230 BIT_MASK 0x01 /end MEASUREMENT
/begin COMPU_METHOD BUZZout_mirror_COMPU_VTAB "Verbal Table" TAB_VERB "%.0" "list" COMPU_TAB_REF BUZZout_mirror_COMPU_VTAB_REF /end COMPU_METHOD
/begin COMPU_VTAB BUZZout_mirror_COMPU_VTAB_REF "Verbal Table" TAB_VERB 2 0x00 "Off" 0x01 "On" DEFAULT_VALUE "UNKNOWN" /end COMPU_VTAB
/begin MEASUREMENT SWARNout_mirror "Soft warning output pin{SWARNout_mirror&0x01=0x00:Off}{SWARNout_mirror&0x01=0x01:On}" UBYTE SWARNout_mirror_COMPU_VTAB 0 0 0 255 ECU_ADDRESS 0x01003238 BIT_MASK 0x01 /end MEASUREMENT
/begin COMPU_METHOD SWARNout_mirror_COMPU_VTAB "Verbal Table" TAB_VERB "%.0" "list" COMPU_TAB_REF SWARNout_mirror_COMPU_VTAB_REF /end COMPU_METHOD
/begin COMPU_VTAB SWARNout_mirror_COMPU_VTAB_REF "Verbal Table" TAB_VERB 2 0x00 "Off" 0x01 "On" DEFAULT_VALUE "UNKNOWN" /end COMPU_VTAB
/begin MEASUREMENT HWARNout_mirror "Hard warning output pin{HWARNout_mirror&0x01=0x00:Off}{HWARNout_mirror&0x01=0x01:On}" UBYTE HWARNout_mirror_COMPU_VTAB 0 0 0 255 ECU_ADDRESS 0x01003240 BIT_MASK 0x01 /end MEASUREMENT
/begin COMPU_METHOD HWARNout_mirror_COMPU_VTAB "Verbal Table" TAB_VERB "%.0" "list" COMPU_TAB_REF HWARNout_mirror_COMPU_VTAB_REF /end COMPU_METHOD
/begin COMPU_VTAB HWARNout_mirror_COMPU_VTAB_REF "Verbal Table" TAB_VERB 2 0x00 "Off" 0x01 "On" DEFAULT_VALUE "UNKNOWN" /end COMPU_VTAB
/begin CHARACTERISTIC MAPdt_dz_src "MAPdt normal trigger source{MAPdt_dz_src&0xff=0:Fixed Value}{MAPdt_dz_src&0xff=1:MAP Based Lookup}" VALUE 0x001c881b /* @ECU_Address@MAPdt_dz_src@0x01003840@ */ ECIPP_ALIGNMENT_UBYTE 255 MAPdt_dz_src_COMPU_VTAB 0 255 BIT_MASK 0xff /end CHARACTERISTIC
/begin COMPU_METHOD MAPdt_dz_src_COMPU_VTAB "Verbal Table" TAB_VERB "%.0" "list" COMPU_TAB_REF MAPdt_dz_src_COMPU_VTAB_REF /end COMPU_METHOD
/begin COMPU_VTAB MAPdt_dz_src_COMPU_VTAB_REF "Verbal Table" TAB_VERB 2 0 "Fixed Value" 1 "MAP Based Lookup" DEFAULT_VALUE "UNKNOWN" /end COMPU_VTAB
/begin CHARACTERISTIC MAPdt_dz_shape "MAPdt trigger shape{MAPdt_dz_shape&0xff=0:Step Change}{MAPdt_dz_shape&0xff=1:Cubic Rolloff}" VALUE 0x001c881a /* @ECU_Address@MAPdt_dz_shape@0x01003848@ */ ECIPP_ALIGNMENT_UBYTE 255 MAPdt_dz_shape_COMPU_VTAB 0 255 BIT_MASK 0xff /end CHARACTERISTIC
/begin COMPU_METHOD MAPdt_dz_shape_COMPU_VTAB "Verbal Table" TAB_VERB "%.0" "list" COMPU_TAB_REF MAPdt_dz_shape_COMPU_VTAB_REF /end COMPU_METHOD
/begin COMPU_VTAB MAPdt_dz_shape_COMPU_VTAB_REF "Verbal Table" TAB_VERB 2 0 "Step Change" 1 "Cubic Rolloff" DEFAULT_VALUE "UNKNOWN" /end COMPU_VTAB
/begin CHARACTERISTIC MAPdt_MAPss_tau "MAP steady-state tau for trigger lookup" VALUE 0x001c8564 /* @ECU_Address@MAPdt_MAPss_tau@0x01003850@ */ ECIPP_ALIGNMENT_UWORD 327680 Compu_MAPdt_MAPss_tau 0.45084 327680 /end CHARACTERISTIC
/begin COMPU_METHOD Compu_MAPdt_MAPss_tau " " FORM "%.1" "ms"
 /begin FORMULA "-5 / log(1 - (X1 / 65536))" FORMULA_INV "(1 - exp(-5/X1)) * 65536" /end FORMULA
/end COMPU_METHOD
/begin MEASUREMENT MAPdt_dz_acttrg "Active MAPdt trigger value" SWORD Compu_MAPdt_dz_acttrg 0 0 -4000 3999.8779296875 ECU_ADDRESS 0x01003858 /end MEASUREMENT
/begin COMPU_METHOD Compu_MAPdt_dz_acttrg " " RAT_FUNC "%.1" "psi/sec" COEFFS 0 8.192 0 0 0 1 /end COMPU_METHOD
/begin MEASUREMENT EGO4_volts "EGO4" UWORD Compu_EGO4_volts 0 0 0 15.999755859375 ECU_ADDRESS 0x010038E8 /end MEASUREMENT
/begin COMPU_METHOD Compu_EGO4_volts " " RAT_FUNC "%.3" "volts" COEFFS 0 4096 0 0 0 1 /end COMPU_METHOD
/begin MEASUREMENT FO_BO "Cylinder numbering actual{FO_BO&0xff=0:Firing Order}{FO_BO&0xff=1:Block Order}" UBYTE FO_BO_COMPU_VTAB 0 0 0 255 ECU_ADDRESS 0x01003AD8 BIT_MASK 0xff /end MEASUREMENT
/begin COMPU_METHOD FO_BO_COMPU_VTAB "Verbal Table" TAB_VERB "%.0" "list" COMPU_TAB_REF FO_BO_COMPU_VTAB_REF /end COMPU_METHOD
/begin COMPU_VTAB FO_BO_COMPU_VTAB_REF "Verbal Table" TAB_VERB 2 0 "Firing Order" 1 "Block Order" DEFAULT_VALUE "UNKNOWN" /end COMPU_VTAB
/begin MEASUREMENT torque_Nm_gross "Actual gross torque" UWORD Compu_torque_Nm_gross 0 0 0 16383.75 ECU_ADDRESS 0x01004510 /end MEASUREMENT
/begin COMPU_METHOD Compu_torque_Nm_gross " " RAT_FUNC "%.1" "N-m" COEFFS 0 4 0 0 0 1 /end COMPU_METHOD
/begin MEASUREMENT torque_pct "Actual net torque" UWORD Compu_torque_pct 0 0 0 99.9984741210938 ECU_ADDRESS 0x01004518 /end MEASUREMENT
/begin COMPU_METHOD Compu_torque_pct " " RAT_FUNC "%.1" "%" COEFFS 0 655.36 0 0 0 1 /end COMPU_METHOD
/begin MEASUREMENT HM_MIL_seconds "MIL total on-time" ULONG Compu_HM_MIL_seconds 0 0 0 1193046.47083333 ECU_ADDRESS 0x01005348 /end MEASUREMENT
/begin COMPU_METHOD Compu_HM_MIL_seconds " " RAT_FUNC "%.3" "hours" COEFFS 0 3600 0 0 0 1 /end COMPU_METHOD
/begin CHARACTERISTIC OilP_loP2 "Oil pressure sender low-presure (Fault Condition:Stage 2: oil pressure <)" VALUE 0x001c7e2c /* @ECU_Address@OilP_loP2@0x01005A20@ */ ECIPP_ALIGNMENT_UWORD 256 Compu_OilP_loP2 0 255.99609375 /end CHARACTERISTIC
/begin COMPU_METHOD Compu_OilP_loP2 " " RAT_FUNC "%.1" "psig" COEFFS 0 256 0 0 0 1 /end COMPU_METHOD
/begin CHARACTERISTIC OilP_loRPM "Oil pressure low engine speed (Fault Condition:For RPM > lower limit AND RPM <=)" VALUE 0x001c7e2e /* @ECU_Address@OilP_loRPM@0x01005A28@ */ ECIPP_ALIGNMENT_UWORD 65535 Compu_OilP_loRPM 0 65535 /end CHARACTERISTIC
/begin COMPU_METHOD Compu_OilP_loRPM " " RAT_FUNC "%.0" "rpm" COEFFS 0 1 0 0 0 1 /end COMPU_METHOD
/begin CHARACTERISTIC OilP_loRPM2 "Oil pressure low engine speed (Fault Condition:For RPM >=)" VALUE 0x001c7e30 /* @ECU_Address@OilP_loRPM2@0x01005A30@ */ ECIPP_ALIGNMENT_UWORD 65535 Compu_OilP_loRPM2 0 65535 /end CHARACTERISTIC
/begin COMPU_METHOD Compu_OilP_loRPM2 " " RAT_FUNC "%.0" "rpm" COEFFS 0 1 0 0 0 1 /end COMPU_METHOD
/begin CHARACTERISTIC ECT_CL_ena "Closed loop enable ECT" VALUE 0x001c6e8e /* @ECU_Address@ECT_CL_ena@0x01006010@ */ ECIPP_ALIGNMENT_UWORD 564 Compu_ECT_CL_ena -460 563.984375 /end CHARACTERISTIC
/begin COMPU_METHOD Compu_ECT_CL_ena " " RAT_FUNC "%.1" "deg F" COEFFS 0 64 29440 0 0 1 /end COMPU_METHOD
/begin CHARACTERISTIC OilP_maxV "Oil pressure sensor maximum voltage (Fault Condition:Oil pressure sensor voltage >)" VALUE 0x001c7e32 /* @ECU_Address@OilP_maxV@0x01006230@ */ ECIPP_ALIGNMENT_UWORD 5 Compu_OilP_maxV 0 5.00114468864469 /end CHARACTERISTIC
/begin COMPU_METHOD Compu_OilP_maxV " " RAT_FUNC "%.3" "volts" COEFFS 0 13104 0 0 0 1 /end COMPU_METHOD
/begin CHARACTERISTIC OilP_minV "Oil pressure sensor minimum voltage (Fault Condition:Oil pressure sensor voltage <)" VALUE 0x001c7e34 /* @ECU_Address@OilP_minV@0x01006238@ */ ECIPP_ALIGNMENT_UWORD 5 Compu_OilP_minV 0 5.00114468864469 /end CHARACTERISTIC
/begin COMPU_METHOD Compu_OilP_minV " " RAT_FUNC "%.3" "volts" COEFFS 0 13104 0 0 0 1 /end COMPU_METHOD
/begin CHARACTERISTIC OilP2_loP "Oil pressure sender low-pressure 1 stage 2 (Fault Condition:Stage 1: oil pressure <)" VALUE 0x001c7e1e /* @ECU_Address@OilP2_loP@0x01006858@ */ ECIPP_ALIGNMENT_UWORD 256 Compu_OilP2_loP 0 255.99609375 /end CHARACTERISTIC
/begin COMPU_METHOD Compu_OilP2_loP " " RAT_FUNC "%.1" "psig" COEFFS 0 256 0 0 0 1 /end COMPU_METHOD
/begin CHARACTERISTIC OilP2_loP2 "Oil pressure sender low-pressure 2 stage 2 (Fault Condition:Stage 1: oil pressure <)" VALUE 0x001c7e20 /* @ECU_Address@OilP2_loP2@0x01006860@ */ ECIPP_ALIGNMENT_UWORD 256 Compu_OilP2_loP2 0 255.99609375 /end CHARACTERISTIC
/begin COMPU_METHOD Compu_OilP2_loP2 " " RAT_FUNC "%.1" "psig" COEFFS 0 256 0 0 0 1 /end COMPU_METHOD
/begin CHARACTERISTIC SHIFT_dt_n "Shift feedback dt interpolation" VALUE 0x001c8905 /* @ECU_Address@SHIFT_dt_n@0x010068B0@ */ ECIPP_ALIGNMENT_UBYTE 255 Compu_SHIFT_dt_n 0 255 /end CHARACTERISTIC
/begin COMPU_METHOD Compu_SHIFT_dt_n " " RAT_FUNC "%.0" "ms (1ms sample)" COEFFS 0 1 0 0 0 1 /end COMPU_METHOD
/begin CHARACTERISTIC SHIFT_dt_LP "Shift feedback dt low-pass filter" VALUE 0x001c858a /* @ECU_Address@SHIFT_dt_LP@0x010068B8@ */ ECIPP_ALIGNMENT_UWORD 32768 Compu_SHIFT_dt_LP 0.033406 32768 /end CHARACTERISTIC
/begin COMPU_METHOD Compu_SHIFT_dt_LP " " FORM "%.2" "ms"
 /begin FORMULA "-1 / log(1.0000000000001 - (X1 / 32768))" FORMULA_INV "(1.0000000000001 - exp(-1/X1)) * 32768" /end FORMULA
/end COMPU_METHOD
/begin MEASUREMENT inj1_on_samp "Injector 1 on low-side" UWORD Compu_inj1_on_samp 0 0 0 55.0125915750916 ECU_ADDRESS 0x01006A90 /end MEASUREMENT
/begin COMPU_METHOD Compu_inj1_on_samp " " RAT_FUNC "%.1" "volts" COEFFS 0 1191.27272727273 0 0 0 1 /end COMPU_METHOD
/begin MEASUREMENT inj2_on_samp "2" UWORD Compu_inj2_on_samp 0 0 0 55.0125915750916 ECU_ADDRESS 0x01006A98 /end MEASUREMENT
/begin COMPU_METHOD Compu_inj2_on_samp " " RAT_FUNC "%.1" "volts" COEFFS 0 1191.27272727273 0 0 0 1 /end COMPU_METHOD
/begin MEASUREMENT inj3_on_samp "3" UWORD Compu_inj3_on_samp 0 0 0 55.0125915750916 ECU_ADDRESS 0x01006AA0 /end MEASUREMENT
/begin COMPU_METHOD Compu_inj3_on_samp " " RAT_FUNC "%.1" "volts" COEFFS 0 1191.27272727273 0 0 0 1 /end COMPU_METHOD
/begin MEASUREMENT inj4_on_samp "4" UWORD Compu_inj4_on_samp 0 0 0 55.0125915750916 ECU_ADDRESS 0x01006AA8 /end MEASUREMENT
/begin COMPU_METHOD Compu_inj4_on_samp " " RAT_FUNC "%.1" "volts" COEFFS 0 1191.27272727273 0 0 0 1 /end COMPU_METHOD
/begin MEASUREMENT inj5_on_samp "5" UWORD Compu_inj5_on_samp 0 0 0 55.0125915750916 ECU_ADDRESS 0x01006AB0 /end MEASUREMENT
/begin COMPU_METHOD Compu_inj5_on_samp " " RAT_FUNC "%.1" "volts" COEFFS 0 1191.27272727273 0 0 0 1 /end COMPU_METHOD
/begin MEASUREMENT inj6_on_samp "6" UWORD Compu_inj6_on_samp 0 0 0 55.0125915750916 ECU_ADDRESS 0x01006AB8 /end MEASUREMENT
/begin COMPU_METHOD Compu_inj6_on_samp " " RAT_FUNC "%.1" "volts" COEFFS 0 1191.27272727273 0 0 0 1 /end COMPU_METHOD
/begin MEASUREMENT inj7_on_samp "7" UWORD Compu_inj7_on_samp 0 0 0 55.0125915750916 ECU_ADDRESS 0x01006AC0 /end MEASUREMENT
/begin COMPU_METHOD Compu_inj7_on_samp " " RAT_FUNC "%.1" "volts" COEFFS 0 1191.27272727273 0 0 0 1 /end COMPU_METHOD
/begin MEASUREMENT inj8_on_samp "8" UWORD Compu_inj8_on_samp 0 0 0 55.0125915750916 ECU_ADDRESS 0x01006AC8 /end MEASUREMENT
/begin COMPU_METHOD Compu_inj8_on_samp " " RAT_FUNC "%.1" "volts" COEFFS 0 1191.27272727273 0 0 0 1 /end COMPU_METHOD
/begin MEASUREMENT inj9_on_samp "9" UWORD Compu_inj9_on_samp 0 0 0 55.0125915750916 ECU_ADDRESS 0x01006AD0 /end MEASUREMENT
/begin COMPU_METHOD Compu_inj9_on_samp " " RAT_FUNC "%.1" "volts" COEFFS 0 1191.27272727273 0 0 0 1 /end COMPU_METHOD
/begin MEASUREMENT inj10_on_samp "10" UWORD Compu_inj10_on_samp 0 0 0 55.0125915750916 ECU_ADDRESS 0x01006AD8 /end MEASUREMENT
/begin COMPU_METHOD Compu_inj10_on_samp " " RAT_FUNC "%.1" "volts" COEFFS 0 1191.27272727273 0 0 0 1 /end COMPU_METHOD
/begin MEASUREMENT inj1_off_samp "Injector 1 off low-side" UWORD Compu_inj1_off_samp 0 0 0 55.0125915750916 ECU_ADDRESS 0x01006AE0 /end MEASUREMENT
/begin COMPU_METHOD Compu_inj1_off_samp " " RAT_FUNC "%.1" "volts" COEFFS 0 1191.27272727273 0 0 0 1 /end COMPU_METHOD
/begin MEASUREMENT inj2_off_samp "2" UWORD Compu_inj2_off_samp 0 0 0 55.0125915750916 ECU_ADDRESS 0x01006AE8 /end MEASUREMENT
/begin COMPU_METHOD Compu_inj2_off_samp " " RAT_FUNC "%.1" "volts" COEFFS 0 1191.27272727273 0 0 0 1 /end COMPU_METHOD
/begin MEASUREMENT inj3_off_samp "3" UWORD Compu_inj3_off_samp 0 0 0 55.0125915750916 ECU_ADDRESS 0x01006AF0 /end MEASUREMENT
/begin COMPU_METHOD Compu_inj3_off_samp " " RAT_FUNC "%.1" "volts" COEFFS 0 1191.27272727273 0 0 0 1 /end COMPU_METHOD
/begin MEASUREMENT inj4_off_samp "4" UWORD Compu_inj4_off_samp 0 0 0 55.0125915750916 ECU_ADDRESS 0x01006AF8 /end MEASUREMENT
/begin COMPU_METHOD Compu_inj4_off_samp " " RAT_FUNC "%.1" "volts" COEFFS 0 1191.27272727273 0 0 0 1 /end COMPU_METHOD
/begin MEASUREMENT inj5_off_samp "5" UWORD Compu_inj5_off_samp 0 0 0 55.0125915750916 ECU_ADDRESS 0x01006B00 /end MEASUREMENT
/begin COMPU_METHOD Compu_inj5_off_samp " " RAT_FUNC "%.1" "volts" COEFFS 0 1191.27272727273 0 0 0 1 /end COMPU_METHOD
/begin MEASUREMENT inj6_off_samp "6" UWORD Compu_inj6_off_samp 0 0 0 55.0125915750916 ECU_ADDRESS 0x01006B08 /end MEASUREMENT
/begin COMPU_METHOD Compu_inj6_off_samp " " RAT_FUNC "%.1" "volts" COEFFS 0 1191.27272727273 0 0 0 1 /end COMPU_METHOD
/begin MEASUREMENT inj7_off_samp "7" UWORD Compu_inj7_off_samp 0 0 0 55.0125915750916 ECU_ADDRESS 0x01006B10 /end MEASUREMENT
/begin COMPU_METHOD Compu_inj7_off_samp " " RAT_FUNC "%.1" "volts" COEFFS 0 1191.27272727273 0 0 0 1 /end COMPU_METHOD
/begin MEASUREMENT inj8_off_samp "8" UWORD Compu_inj8_off_samp 0 0 0 55.0125915750916 ECU_ADDRESS 0x01006B18 /end MEASUREMENT
/begin COMPU_METHOD Compu_inj8_off_samp " " RAT_FUNC "%.1" "volts" COEFFS 0 1191.27272727273 0 0 0 1 /end COMPU_METHOD
/begin MEASUREMENT inj9_off_samp "9" UWORD Compu_inj9_off_samp 0 0 0 55.0125915750916 ECU_ADDRESS 0x01006B20 /end MEASUREMENT
/begin COMPU_METHOD Compu_inj9_off_samp " " RAT_FUNC "%.1" "volts" COEFFS 0 1191.27272727273 0 0 0 1 /end COMPU_METHOD
/begin MEASUREMENT inj10_off_samp "10" UWORD Compu_inj10_off_samp 0 0 0 55.0125915750916 ECU_ADDRESS 0x01006B28 /end MEASUREMENT
/begin COMPU_METHOD Compu_inj10_off_samp " " RAT_FUNC "%.1" "volts" COEFFS 0 1191.27272727273 0 0 0 1 /end COMPU_METHOD
/begin CHARACTERISTIC LowOperTemp_ECT "Operating ECT threshold (Fault Condition:ECT >=)" VALUE 0x001c7d1e /* @ECU_Address@LowOperTemp_ECT@0x01008188@ */ ECIPP_ALIGNMENT_UWORD 564 Compu_LowOperTemp_ECT -460 563.984375 /end CHARACTERISTIC
/begin COMPU_METHOD Compu_LowOperTemp_ECT " " RAT_FUNC "%.1" "deg F" COEFFS 0 64 29440 0 0 1 /end COMPU_METHOD
/begin MEASUREMENT FPin_I2 "Secondary fuel rail pressure" UWORD Compu_FPin_I2 0 0 0 255.99609375 ECU_ADDRESS 0x01009200 /end MEASUREMENT
/begin COMPU_METHOD Compu_FPin_I2 " " RAT_FUNC "%.1" "psia" COEFFS 0 256 0 0 0 1 /end COMPU_METHOD
/begin CHARACTERISTIC APSraw_LP "APSraw_LP" VALUE 0x001C9E32 /* @ECU_Address@APSraw_LP@0x01009AB0@ */ ECIPP_ALIGNMENT_UWORD 32768 Compu_APSraw_LP 0.045084 32768 /end CHARACTERISTIC
/begin COMPU_METHOD Compu_APSraw_LP " " FORM "%.3" "ms"
 /begin FORMULA "-0.5 / log(1 - (X1 / 65536))" FORMULA_INV "(1 - exp(-0.5/X1)) * 65536" /end FORMULA
/end COMPU_METHOD
/begin CHARACTERISTIC BPSraw_LP "BPSraw_LP" VALUE 0x001C9ED2 /* @ECU_Address@BPSraw_LP@0x01009AB8@ */ ECIPP_ALIGNMENT_UWORD 32768 Compu_BPSraw_LP 0.045084 32768 /end CHARACTERISTIC
/begin COMPU_METHOD Compu_BPSraw_LP " " FORM "%.3" "ms"
 /begin FORMULA "-0.5 / log(1 - (X1 / 65536))" FORMULA_INV "(1 - exp(-0.5/X1)) * 65536" /end FORMULA
/end COMPU_METHOD
/begin CHARACTERISTIC AFBdt_n "AFBdt_n" VALUE 0x001C9E34 /* @ECU_Address@AFBdt_n@0x01009AC0@ */ ECIPP_ALIGNMENT_UBYTE 255 Compu_AFBdt_n 0 255 /end CHARACTERISTIC
/begin COMPU_METHOD Compu_AFBdt_n " " RAT_FUNC "%.0" "ms" COEFFS 0 1 0 0 0 1 /end COMPU_METHOD
/begin CHARACTERISTIC BFBdt_n "BFBdt_n" VALUE 0x001C9ED4 /* @ECU_Address@BFBdt_n@0x01009AC8@ */ ECIPP_ALIGNMENT_UBYTE 255 Compu_BFBdt_n 0 255 /end CHARACTERISTIC
/begin COMPU_METHOD Compu_BFBdt_n " " RAT_FUNC "%.0" "ms" COEFFS 0 1 0 0 0 1 /end COMPU_METHOD
/begin CHARACTERISTIC AFBdt_xLP "AFBdt_xLP" VALUE 0x001C9E36 /* @ECU_Address@AFBdt_xLP@0x01009AD0@ */ ECIPP_ALIGNMENT_UWORD 32768 Compu_AFBdt_xLP 0.033406 32768 /end CHARACTERISTIC
/begin COMPU_METHOD Compu_AFBdt_xLP " " FORM "%.3" "ms"
 /begin FORMULA "-1 / log(1.0000000000001 - (X1 / 32768))" FORMULA_INV "(1.0000000000001 - exp(-1/X1)) * 32768" /end FORMULA
/end COMPU_METHOD
/begin CHARACTERISTIC BFBdt_xLP "BFBdt_xLP" VALUE 0x001C9ED6 /* @ECU_Address@BFBdt_xLP@0x01009AD8@ */ ECIPP_ALIGNMENT_UWORD 32768 Compu_BFBdt_xLP 0.033406 32768 /end CHARACTERISTIC
/begin COMPU_METHOD Compu_BFBdt_xLP " " FORM "%.3" "ms"
 /begin FORMULA "-1 / log(1.0000000000001 - (X1 / 32768))" FORMULA_INV "(1.0000000000001 - exp(-1/X1)) * 32768" /end FORMULA
/end COMPU_METHOD
/begin CHARACTERISTIC EMP_cyl_events "EMP window" VALUE 0x001c3aa0 /* @ECU_Address@EMP_cyl_events@0x0100A280@ */ ECIPP_ALIGNMENT_FLOAT32_IEEE 10000000000 Compu_EMP_cyl_events -10000000000 10000000000 /end CHARACTERISTIC
/begin COMPU_METHOD Compu_EMP_cyl_events " " RAT_FUNC "%.1" "cyl events" COEFFS 0 1 0 0 0 1 /end COMPU_METHOD
/begin CHARACTERISTIC EMP_tau "EMP low-pass tau" VALUE 0x001c852c /* @ECU_Address@EMP_tau@0x0100A288@ */ ECIPP_ALIGNMENT_UWORD 65536 Compu_EMP_tau 0.090168 65536 /end CHARACTERISTIC
/begin COMPU_METHOD Compu_EMP_tau " " FORM "%.1" "ms"
 /begin FORMULA "-1 / log(1 - (X1 / 65536))" FORMULA_INV "(1 - exp(-1/X1)) * 65536" /end FORMULA
/end COMPU_METHOD
/begin CHARACTERISTIC EMP_slow_tau_ms "EMP slow low-pass tau" VALUE 0x001c3aa4 /* @ECU_Address@EMP_slow_tau_ms@0x0100A290@ */ ECIPP_ALIGNMENT_FLOAT32_IEEE 10000000000 Compu_EMP_slow_tau_ms -10000000000 10000000000 /end CHARACTERISTIC
/begin COMPU_METHOD Compu_EMP_slow_tau_ms " " RAT_FUNC "%.1" "ms" COEFFS 0 1 0 0 0 1 /end COMPU_METHOD
/begin MEASUREMENT MAP_windowed "Cylinder-event averaged MAP" UWORD Compu_MAP_windowed 0 0 0 255.99609375 ECU_ADDRESS 0x0100A6A0 /end MEASUREMENT
/begin COMPU_METHOD Compu_MAP_windowed " " RAT_FUNC "%.2" "psia" COEFFS 0 256 0 0 0 1 /end COMPU_METHOD
/begin MEASUREMENT TIP_windowed "Cylinder-event averaged TIP" UWORD Compu_TIP_windowed 0 0 0 255.99609375 ECU_ADDRESS 0x0100A6A8 /end MEASUREMENT
/begin COMPU_METHOD Compu_TIP_windowed " " RAT_FUNC "%.2" "psia" COEFFS 0 256 0 0 0 1 /end COMPU_METHOD
/begin CHARACTERISTIC MAP_global_filt "MAP global filter method{MAP_global_filt&0xff=0:Default}{MAP_global_filt&0xff=1:Cylinder Windowed}" VALUE 0x001c8818 /* @ECU_Address@MAP_global_filt@0x0100B6F8@ */ ECIPP_ALIGNMENT_UBYTE 255 MAP_global_filt_COMPU_VTAB 0 255 BIT_MASK 0xff /end CHARACTERISTIC
/begin COMPU_METHOD MAP_global_filt_COMPU_VTAB "Verbal Table" TAB_VERB "%.0" "list" COMPU_TAB_REF MAP_global_filt_COMPU_VTAB_REF /end COMPU_METHOD
/begin COMPU_VTAB MAP_global_filt_COMPU_VTAB_REF "Verbal Table" TAB_VERB 2 0 "Default" 1 "Cylinder Windowed" DEFAULT_VALUE "UNKNOWN" /end COMPU_VTAB
/begin CHARACTERISTIC TIP_global_filt "TIP global filter method{TIP_global_filt&0xff=0:Default}{TIP_global_filt&0xff=1:Cylinder Windowed}" VALUE 0x001c8f37 /* @ECU_Address@TIP_global_filt@0x0100B700@ */ ECIPP_ALIGNMENT_UBYTE 255 TIP_global_filt_COMPU_VTAB 0 255 BIT_MASK 0xff /end CHARACTERISTIC
/begin COMPU_METHOD TIP_global_filt_COMPU_VTAB "Verbal Table" TAB_VERB "%.0" "list" COMPU_TAB_REF TIP_global_filt_COMPU_VTAB_REF /end COMPU_METHOD
/begin COMPU_VTAB TIP_global_filt_COMPU_VTAB_REF "Verbal Table" TAB_VERB 2 0 "Default" 1 "Cylinder Windowed" DEFAULT_VALUE "UNKNOWN" /end COMPU_VTAB
/begin CHARACTERISTIC MAP_TIP_win_cyls "MAP/TIP cylinder window size primary" VALUE 0x001c7d46 /* @ECU_Address@MAP_TIP_win_cyls@0x0100B708@ */ ECIPP_ALIGNMENT_UWORD 64 Compu_MAP_TIP_win_cyls 0 63.9990234375 /end CHARACTERISTIC
/begin COMPU_METHOD Compu_MAP_TIP_win_cyls " " RAT_FUNC "%.1" "cyl events" COEFFS 0 1024 0 0 0 1 /end COMPU_METHOD
/begin CHARACTERISTIC EGRdP_tau "EGRdP low-pass tau" VALUE 0x001c0a92 /* @ECU_Address@EGRdP_tau@0x0100BD00@ */ ECIPP_ALIGNMENT_UWORD 163840 Compu_EGRdP_tau 0.16703 163840 /end CHARACTERISTIC
/begin COMPU_METHOD Compu_EGRdP_tau " " FORM "%.0" "ms"
 /begin FORMULA "-5 / log(1.0000000000001 - (X1 / 32768))" FORMULA_INV "(1.0000000000001 - exp(-5/X1)) * 32768" /end FORMULA
/end COMPU_METHOD
/begin CHARACTERISTIC EGRHPLP_cyl_events "EGR HP/LP averaging window" VALUE 0x001c094a /* @ECU_Address@EGRHPLP_cyl_events@0x0100BD70@ */ ECIPP_ALIGNMENT_UWORD 64 Compu_EGRHPLP_cyl_events 0 63.9990234375 /end CHARACTERISTIC
/begin COMPU_METHOD Compu_EGRHPLP_cyl_events " " RAT_FUNC "%.1" "cyl events" COEFFS 0 1024 0 0 0 1 /end COMPU_METHOD
/begin CHARACTERISTIC EGRHPLP_tau "EGR HP/LP low-pass tau" VALUE 0x001c0a80 /* @ECU_Address@EGRHPLP_tau@0x0100BD78@ */ ECIPP_ALIGNMENT_UWORD 327680 Compu_EGRHPLP_tau 0.45084 327680 /end CHARACTERISTIC
/begin COMPU_METHOD Compu_EGRHPLP_tau " " FORM "%.1" "ms"
 /begin FORMULA "-5 / log(1 - (X1 / 65536))" FORMULA_INV "(1 - exp(-5/X1)) * 65536" /end FORMULA
/end COMPU_METHOD
/begin CHARACTERISTIC UEGOB_PI_raw_LP "UEGOB PI raw voltage tau" VALUE 0x001CA350 /* @ECU_Address@UEGOB_PI_raw_LP@0x0100BF78@ */ ECIPP_ALIGNMENT_UWORD 65536 Compu_UEGOB_PI_raw_LP 0.090168 65536 /end CHARACTERISTIC
/begin COMPU_METHOD Compu_UEGOB_PI_raw_LP " " FORM "%.0" "ms"
 /begin FORMULA "-1 / log(1 - (X1 / 65536))" FORMULA_INV "(1 - exp(-1/X1)) * 65536" /end FORMULA
/end COMPU_METHOD
/begin CHARACTERISTIC UEGOB_SR_raw_LP "UEGOB SR raw voltage tau" VALUE 0x001CA352 /* @ECU_Address@UEGOB_SR_raw_LP@0x0100BF80@ */ ECIPP_ALIGNMENT_UWORD 65536 Compu_UEGOB_SR_raw_LP 0.090168 65536 /end CHARACTERISTIC
/begin COMPU_METHOD Compu_UEGOB_SR_raw_LP " " FORM "%.0" "ms"
 /begin FORMULA "-1 / log(1 - (X1 / 65536))" FORMULA_INV "(1 - exp(-1/X1)) * 65536" /end FORMULA
/end COMPU_METHOD
/begin CHARACTERISTIC UEGOB_PI_Vofst_LP "UEGOB PI offset voltage tau" VALUE 0x001CA354 /* @ECU_Address@UEGOB_PI_Vofst_LP@0x0100BF88@ */ ECIPP_ALIGNMENT_UWORD 327680 Compu_UEGOB_PI_Vofst_LP 0.45084 327680 /end CHARACTERISTIC
/begin COMPU_METHOD Compu_UEGOB_PI_Vofst_LP " " FORM "%.0" "ms"
 /begin FORMULA "-5 / log(1 - (X1 / 65536))" FORMULA_INV "(1 - exp(-5/X1)) * 65536" /end FORMULA
/end COMPU_METHOD
/begin CHARACTERISTIC UEGOB_SR_Vofst_LP "UEGOB SR offset voltage tau" VALUE 0x001CA356 /* @ECU_Address@UEGOB_SR_Vofst_LP@0x0100BF90@ */ ECIPP_ALIGNMENT_UWORD 327680 Compu_UEGOB_SR_Vofst_LP 0.45084 327680 /end CHARACTERISTIC
/begin COMPU_METHOD Compu_UEGOB_SR_Vofst_LP " " FORM "%.0" "ms"
 /begin FORMULA "-5 / log(1 - (X1 / 65536))" FORMULA_INV "(1 - exp(-5/X1)) * 65536" /end FORMULA
/end COMPU_METHOD
/begin CHARACTERISTIC UEGOB_PI_Vout_LP "UEGOB PI final voltage tau" VALUE 0x001CA358 /* @ECU_Address@UEGOB_PI_Vout_LP@0x0100BF98@ */ ECIPP_ALIGNMENT_UWORD 327680 Compu_UEGOB_PI_Vout_LP 0.45084 327680 /end CHARACTERISTIC
/begin COMPU_METHOD Compu_UEGOB_PI_Vout_LP " " FORM "%.0" "ms"
 /begin FORMULA "-5 / log(1 - (X1 / 65536))" FORMULA_INV "(1 - exp(-5/X1)) * 65536" /end FORMULA
/end COMPU_METHOD
/begin CHARACTERISTIC UEGOB_SR_Vout_LP "UEGOB SR final voltage tau" VALUE 0x001CA35A /* @ECU_Address@UEGOB_SR_Vout_LP@0x0100BFA0@ */ ECIPP_ALIGNMENT_UWORD 327680 Compu_UEGOB_SR_Vout_LP 0.45084 327680 /end CHARACTERISTIC
/begin COMPU_METHOD Compu_UEGOB_SR_Vout_LP " " FORM "%.0" "ms"
 /begin FORMULA "-5 / log(1 - (X1 / 65536))" FORMULA_INV "(1 - exp(-5/X1)) * 65536" /end FORMULA
/end COMPU_METHOD
/begin CHARACTERISTIC UEGON_PI_raw_LP "UEGON PI raw voltage tau" VALUE 0x001CA3EC /* @ECU_Address@UEGON_PI_raw_LP@0x0100BFB0@ */ ECIPP_ALIGNMENT_UWORD 65536 Compu_UEGON_PI_raw_LP 0.090168 65536 /end CHARACTERISTIC
/begin COMPU_METHOD Compu_UEGON_PI_raw_LP " " FORM "%.0" "ms"
 /begin FORMULA "-1 / log(1 - (X1 / 65536))" FORMULA_INV "(1 - exp(-1/X1)) * 65536" /end FORMULA
/end COMPU_METHOD
/begin CHARACTERISTIC UEGON_SR_raw_LP "UEGON SR raw voltage tau" VALUE 0x001CA3EE /* @ECU_Address@UEGON_SR_raw_LP@0x0100BFB8@ */ ECIPP_ALIGNMENT_UWORD 65536 Compu_UEGON_SR_raw_LP 0.090168 65536 /end CHARACTERISTIC
/begin COMPU_METHOD Compu_UEGON_SR_raw_LP " " FORM "%.0" "ms"
 /begin FORMULA "-1 / log(1 - (X1 / 65536))" FORMULA_INV "(1 - exp(-1/X1)) * 65536" /end FORMULA
/end COMPU_METHOD
/begin CHARACTERISTIC UEGON_PI_Vofst_LP "UEGON PI offset voltage tau" VALUE 0x001CA3F0 /* @ECU_Address@UEGON_PI_Vofst_LP@0x0100BFC0@ */ ECIPP_ALIGNMENT_UWORD 327680 Compu_UEGON_PI_Vofst_LP 0.45084 327680 /end CHARACTERISTIC
/begin COMPU_METHOD Compu_UEGON_PI_Vofst_LP " " FORM "%.0" "ms"
 /begin FORMULA "-5 / log(1 - (X1 / 65536))" FORMULA_INV "(1 - exp(-5/X1)) * 65536" /end FORMULA
/end COMPU_METHOD
/begin CHARACTERISTIC UEGON_SR_Vofst_LP "UEGON SR offset voltage tau" VALUE 0x001CA3F2 /* @ECU_Address@UEGON_SR_Vofst_LP@0x0100BFC8@ */ ECIPP_ALIGNMENT_UWORD 327680 Compu_UEGON_SR_Vofst_LP 0.45084 327680 /end CHARACTERISTIC
/begin COMPU_METHOD Compu_UEGON_SR_Vofst_LP " " FORM "%.0" "ms"
 /begin FORMULA "-5 / log(1 - (X1 / 65536))" FORMULA_INV "(1 - exp(-5/X1)) * 65536" /end FORMULA
/end COMPU_METHOD
/begin CHARACTERISTIC UEGON_PI_Vout_LP "UEGON PI final voltage tau" VALUE 0x001CA3F4 /* @ECU_Address@UEGON_PI_Vout_LP@0x0100BFD0@ */ ECIPP_ALIGNMENT_UWORD 327680 Compu_UEGON_PI_Vout_LP 0.45084 327680 /end CHARACTERISTIC
/begin COMPU_METHOD Compu_UEGON_PI_Vout_LP " " FORM "%.0" "ms"
 /begin FORMULA "-5 / log(1 - (X1 / 65536))" FORMULA_INV "(1 - exp(-5/X1)) * 65536" /end FORMULA
/end COMPU_METHOD
/begin CHARACTERISTIC UEGON_SR_Vout_LP "UEGON SR final voltage tau" VALUE 0x001CA3F6 /* @ECU_Address@UEGON_SR_Vout_LP@0x0100BFD8@ */ ECIPP_ALIGNMENT_UWORD 327680 Compu_UEGON_SR_Vout_LP 0.45084 327680 /end CHARACTERISTIC
/begin COMPU_METHOD Compu_UEGON_SR_Vout_LP " " FORM "%.0" "ms"
 /begin FORMULA "-5 / log(1 - (X1 / 65536))" FORMULA_INV "(1 - exp(-5/X1)) * 65536" /end FORMULA
/end COMPU_METHOD
/begin CHARACTERISTIC EGRdP_cyl_events "EGRdP window" VALUE 0x001c009c /* @ECU_Address@EGRdP_cyl_events@0x0100CCD8@ */ ECIPP_ALIGNMENT_FLOAT32_IEEE 10000000000 Compu_EGRdP_cyl_events -10000000000 10000000000 /end CHARACTERISTIC
/begin COMPU_METHOD Compu_EGRdP_cyl_events " " RAT_FUNC "%.1" "cyl events" COEFFS 0 1 0 0 0 1 /end COMPU_METHOD
/begin CHARACTERISTIC EGRdP_Dz "EGR dP deadzone" VALUE 0x001c02a6 /* @ECU_Address@EGRdP_Dz@0x0100DF68@ */ ECIPP_ALIGNMENT_SWORD 32 Compu_EGRdP_Dz -32 31.9990234375 /end CHARACTERISTIC
/begin COMPU_METHOD Compu_EGRdP_Dz " " RAT_FUNC "%.3" "psi" COEFFS 0 1024 0 0 0 1 /end COMPU_METHOD
/begin MEASUREMENT EGRLP_inst "EGRLP instantaneous" UWORD Compu_EGRLP_inst 0 0 0 255.99609375 ECU_ADDRESS 0x0100E070 /end MEASUREMENT
/begin COMPU_METHOD Compu_EGRLP_inst " " RAT_FUNC "%.2" "psia" COEFFS 0 256 0 0 0 1 /end COMPU_METHOD
/begin MEASUREMENT EGRHP_inst "EGRHP instantaneous" UWORD Compu_EGRHP_inst 0 0 0 255.99609375 ECU_ADDRESS 0x0100E078 /end MEASUREMENT
/begin COMPU_METHOD Compu_EGRHP_inst " " RAT_FUNC "%.2" "psia" COEFFS 0 256 0 0 0 1 /end COMPU_METHOD
/begin CHARACTERISTIC ECT_nom "Nominal ECT" VALUE 0x001c6eb0 /* @ECU_Address@ECT_nom@0x0100E6B0@ */ ECIPP_ALIGNMENT_UWORD 564 Compu_ECT_nom -460 563.984375 /end CHARACTERISTIC
/begin COMPU_METHOD Compu_ECT_nom " " RAT_FUNC "%.1" "deg F" COEFFS 0 64 29440 0 0 1 /end COMPU_METHOD
/begin CHARACTERISTIC ECT_nom_min "Nominal ECT threshold" VALUE 0x001c6eb2 /* @ECU_Address@ECT_nom_min@0x0100E6B8@ */ ECIPP_ALIGNMENT_UWORD 564 Compu_ECT_nom_min -460 563.984375 /end CHARACTERISTIC
/begin COMPU_METHOD Compu_ECT_nom_min " " RAT_FUNC "%.1" "deg F" COEFFS 0 64 29440 0 0 1 /end COMPU_METHOD
/begin CHARACTERISTIC ECTmon_diag_hyst "Maintain diag temp hysteresis" VALUE 0x001c6ec0 /* @ECU_Address@ECTmon_diag_hyst@0x0100E6C0@ */ ECIPP_ALIGNMENT_UWORD 564 Compu_ECTmon_diag_hyst -460 563.984375 /end CHARACTERISTIC
/begin COMPU_METHOD Compu_ECTmon_diag_hyst " " RAT_FUNC "%.1" "deg F" COEFFS 0 64 29440 0 0 1 /end COMPU_METHOD
/begin CHARACTERISTIC ECTmon_AAT "Monitor enable air temperature" VALUE 0x001c6ebc /* @ECU_Address@ECTmon_AAT@0x0100E6C8@ */ ECIPP_ALIGNMENT_UWORD 564 Compu_ECTmon_AAT -460 563.984375 /end CHARACTERISTIC
/begin COMPU_METHOD Compu_ECTmon_AAT " " RAT_FUNC "%.1" "deg F" COEFFS 0 64 29440 0 0 1 /end COMPU_METHOD
/begin CHARACTERISTIC ECTmon_delta "Monitor enable ECT increase" VALUE 0x001c6ebe /* @ECU_Address@ECTmon_delta@0x0100E6D0@ */ ECIPP_ALIGNMENT_UWORD 564 Compu_ECTmon_delta -460 563.984375 /end CHARACTERISTIC
/begin COMPU_METHOD Compu_ECTmon_delta " " RAT_FUNC "%.1" "deg F" COEFFS 0 64 29440 0 0 1 /end COMPU_METHOD
/begin MEASUREMENT ECT_diag_min "Diagnostics enable ECT" UWORD Compu_ECT_diag_min 0 0 -460 563.984375 ECU_ADDRESS 0x0100E750 /end MEASUREMENT
/begin COMPU_METHOD Compu_ECT_diag_min " " RAT_FUNC "%.1" "deg F" COEFFS 0 64 29440 0 0 1 /end COMPU_METHOD
/begin MEASUREMENT ECTmon_state "Monitor status{ECTmon_state&0xff=0:Inactive}{ECTmon_state&0xff=1:Disabled - ECT fault}{ECTmon_state&0xff=2:Disabled - AAT fault}{ECTmon_state&0xff=3:Disabled - Low AAT}{ECTmon_state&0xff=4:Disabled - Warm ECT}{ECTmon_state&0xff=5:Monitor start wait}{ECTmo" UBYTE ECTmon_state_COMPU_VTAB 0 0 0 255 ECU_ADDRESS 0x0100E760 BIT_MASK 0xff /end MEASUREMENT
/begin COMPU_METHOD ECTmon_state_COMPU_VTAB "Verbal Table" TAB_VERB "%.0" "list" COMPU_TAB_REF ECTmon_state_COMPU_VTAB_REF /end COMPU_METHOD
/begin COMPU_VTAB ECTmon_state_COMPU_VTAB_REF "Verbal Table" TAB_VERB 7 0 "Inactive" 1 "Disabled - ECT fault" 2 "Disabled - AAT fault" 3 "Disabled - Low AAT" 4 "Disabled - Warm ECT" 5 "Monitor start wait" 6 "Active" DEFAULT_VALUE "UNKNOWN" /end COMPU_VTAB
/begin MEASUREMENT fm_mon_ena "Fault monitor{fm_mon_ena&0xff=0:Disabled}{fm_mon_ena&0xff=1:Enabled}" UBYTE fm_mon_ena_COMPU_VTAB 0 0 0 255 ECU_ADDRESS 0x0100E908 BIT_MASK 0xff /end MEASUREMENT
/begin COMPU_METHOD fm_mon_ena_COMPU_VTAB "Verbal Table" TAB_VERB "%.0" "list" COMPU_TAB_REF fm_mon_ena_COMPU_VTAB_REF /end COMPU_METHOD
/begin COMPU_VTAB fm_mon_ena_COMPU_VTAB_REF "Verbal Table" TAB_VERB 2 0 "Disabled" 1 "Enabled" DEFAULT_VALUE "UNKNOWN" /end COMPU_VTAB
/begin MEASUREMENT fm_mon_fctl_ndx "Fault index" UWORD Compu_fm_mon_fctl_ndx 0 0 0 65535 ECU_ADDRESS 0x0100E910 /end MEASUREMENT
/begin COMPU_METHOD Compu_fm_mon_fctl_ndx " " RAT_FUNC "%.0" "-" COEFFS 0 1 0 0 0 1 /end COMPU_METHOD
/begin MEASUREMENT fm_mon_TF "Test failed{fm_mon_TF&0x01=0x00:No}{fm_mon_TF&0x01=0x01:Yes}" UBYTE fm_mon_TF_COMPU_VTAB 0 0 0 255 ECU_ADDRESS 0x0100E918 BIT_MASK 0x01 /end MEASUREMENT
/begin COMPU_METHOD fm_mon_TF_COMPU_VTAB "Verbal Table" TAB_VERB "%.0" "list" COMPU_TAB_REF fm_mon_TF_COMPU_VTAB_REF /end COMPU_METHOD
/begin COMPU_VTAB fm_mon_TF_COMPU_VTAB_REF "Verbal Table" TAB_VERB 2 0x00 "No" 0x01 "Yes" DEFAULT_VALUE "UNKNOWN" /end COMPU_VTAB
/begin MEASUREMENT fm_mon_TFTOC "Test failed this cycle{fm_mon_TFTOC&0x02=0x00:No}{fm_mon_TFTOC&0x02=0x02:Yes}" UBYTE fm_mon_TFTOC_COMPU_VTAB 0 0 0 255 ECU_ADDRESS 0x0100E920 BIT_MASK 0x02 /end MEASUREMENT
/begin COMPU_METHOD fm_mon_TFTOC_COMPU_VTAB "Verbal Table" TAB_VERB "%.0" "list" COMPU_TAB_REF fm_mon_TFTOC_COMPU_VTAB_REF /end COMPU_METHOD
/begin COMPU_VTAB fm_mon_TFTOC_COMPU_VTAB_REF "Verbal Table" TAB_VERB 2 0x00 "No" 0x02 "Yes" DEFAULT_VALUE "UNKNOWN" /end COMPU_VTAB
/begin MEASUREMENT fm_mon_PDTC "Pending DTC{fm_mon_PDTC&0x04=0x00:No}{fm_mon_PDTC&0x04=0x04:Yes}" UBYTE fm_mon_PDTC_COMPU_VTAB 0 0 0 255 ECU_ADDRESS 0x0100E928 BIT_MASK 0x04 /end MEASUREMENT
/begin COMPU_METHOD fm_mon_PDTC_COMPU_VTAB "Verbal Table" TAB_VERB "%.0" "list" COMPU_TAB_REF fm_mon_PDTC_COMPU_VTAB_REF /end COMPU_METHOD
/begin COMPU_VTAB fm_mon_PDTC_COMPU_VTAB_REF "Verbal Table" TAB_VERB 2 0x00 "No" 0x04 "Yes" DEFAULT_VALUE "UNKNOWN" /end COMPU_VTAB
/begin MEASUREMENT fm_mon_CDTC "Confirmed DTC{fm_mon_CDTC&0x08=0x00:No}{fm_mon_CDTC&0x08=0x08:Yes}" UBYTE fm_mon_CDTC_COMPU_VTAB 0 0 0 255 ECU_ADDRESS 0x0100E930 BIT_MASK 0x08 /end MEASUREMENT
/begin COMPU_METHOD fm_mon_CDTC_COMPU_VTAB "Verbal Table" TAB_VERB "%.0" "list" COMPU_TAB_REF fm_mon_CDTC_COMPU_VTAB_REF /end COMPU_METHOD
/begin COMPU_VTAB fm_mon_CDTC_COMPU_VTAB_REF "Verbal Table" TAB_VERB 2 0x00 "No" 0x08 "Yes" DEFAULT_VALUE "UNKNOWN" /end COMPU_VTAB
/begin MEASUREMENT fm_mon_TNCSLC "Test not completed since clear{fm_mon_TNCSLC&0x10=0x00:No}{fm_mon_TNCSLC&0x10=0x10:Yes}" UBYTE fm_mon_TNCSLC_COMPU_VTAB 0 0 0 255 ECU_ADDRESS 0x0100E938 BIT_MASK 0xFF /end MEASUREMENT
/begin COMPU_METHOD fm_mon_TNCSLC_COMPU_VTAB "Verbal Table" TAB_VERB "%.0" "list" COMPU_TAB_REF fm_mon_TNCSLC_COMPU_VTAB_REF /end COMPU_METHOD
/begin COMPU_VTAB fm_mon_TNCSLC_COMPU_VTAB_REF "Verbal Table" TAB_VERB 2 0x00 "No" 0x10 "Yes" DEFAULT_VALUE "Unsupported Bit_Shift" /end COMPU_VTAB
/begin MEASUREMENT fm_mon_TFSLC "Test failed since clear{fm_mon_TFSLC&0x20=0x00:No}{fm_mon_TFSLC&0x20=0x20:Yes}" UBYTE fm_mon_TFSLC_COMPU_VTAB 0 0 0 255 ECU_ADDRESS 0x0100E940 BIT_MASK 0x20 /end MEASUREMENT
/begin COMPU_METHOD fm_mon_TFSLC_COMPU_VTAB "Verbal Table" TAB_VERB "%.0" "list" COMPU_TAB_REF fm_mon_TFSLC_COMPU_VTAB_REF /end COMPU_METHOD
/begin COMPU_VTAB fm_mon_TFSLC_COMPU_VTAB_REF "Verbal Table" TAB_VERB 2 0x00 "No" 0x20 "Yes" DEFAULT_VALUE "UNKNOWN" /end COMPU_VTAB
/begin MEASUREMENT fm_mon_TNCTOC "Test not completed this cycle{fm_mon_TNCTOC&0x40=0x00:No}{fm_mon_TNCTOC&0x40=0x40:Yes}" UBYTE fm_mon_TNCTOC_COMPU_VTAB 0 0 0 255 ECU_ADDRESS 0x0100E948 BIT_MASK 0x40 /end MEASUREMENT
/begin COMPU_METHOD fm_mon_TNCTOC_COMPU_VTAB "Verbal Table" TAB_VERB "%.0" "list" COMPU_TAB_REF fm_mon_TNCTOC_COMPU_VTAB_REF /end COMPU_METHOD
/begin COMPU_VTAB fm_mon_TNCTOC_COMPU_VTAB_REF "Verbal Table" TAB_VERB 2 0x00 "No" 0x40 "Yes" DEFAULT_VALUE "UNKNOWN" /end COMPU_VTAB
/begin MEASUREMENT fm_mon_WIR "Warning indicator requested{fm_mon_WIR&0x80=0x00:No}{fm_mon_WIR&0x80=0x80:Yes}" UBYTE fm_mon_WIR_COMPU_VTAB 0 0 0 255 ECU_ADDRESS 0x0100E950 BIT_MASK 0xFF /end MEASUREMENT
/begin COMPU_METHOD fm_mon_WIR_COMPU_VTAB "Verbal Table" TAB_VERB "%.0" "list" COMPU_TAB_REF fm_mon_WIR_COMPU_VTAB_REF /end COMPU_METHOD
/begin COMPU_VTAB fm_mon_WIR_COMPU_VTAB_REF "Verbal Table" TAB_VERB 2 0x00 "No" 0x80 "Yes" DEFAULT_VALUE "Unsupported Bit_Shift" /end COMPU_VTAB
/begin MEASUREMENT fm_mon_potential "Potential{fm_mon_potential&0xff=0:No}{fm_mon_potential&0xff=1:Yes}" UBYTE fm_mon_potential_COMPU_VTAB 0 0 0 255 ECU_ADDRESS 0x0100E958 BIT_MASK 0xff /end MEASUREMENT
/begin COMPU_METHOD fm_mon_potential_COMPU_VTAB "Verbal Table" TAB_VERB "%.0" "list" COMPU_TAB_REF fm_mon_potential_COMPU_VTAB_REF /end COMPU_METHOD
/begin COMPU_VTAB fm_mon_potential_COMPU_VTAB_REF "Verbal Table" TAB_VERB 2 0 "No" 1 "Yes" DEFAULT_VALUE "UNKNOWN" /end COMPU_VTAB
/begin MEASUREMENT fm_mon_pending "Pending{fm_mon_pending&0xff=0:No}{fm_mon_pending&0xff=1:Yes}" UBYTE fm_mon_pending_COMPU_VTAB 0 0 0 255 ECU_ADDRESS 0x0100E960 BIT_MASK 0xff /end MEASUREMENT
/begin COMPU_METHOD fm_mon_pending_COMPU_VTAB "Verbal Table" TAB_VERB "%.0" "list" COMPU_TAB_REF fm_mon_pending_COMPU_VTAB_REF /end COMPU_METHOD
/begin COMPU_VTAB fm_mon_pending_COMPU_VTAB_REF "Verbal Table" TAB_VERB 2 0 "No" 1 "Yes" DEFAULT_VALUE "UNKNOWN" /end COMPU_VTAB
/begin MEASUREMENT fm_mon_confact "Confirmed active{fm_mon_confact&0xff=0:No}{fm_mon_confact&0xff=1:Yes}" UBYTE fm_mon_confact_COMPU_VTAB 0 0 0 255 ECU_ADDRESS 0x0100E968 BIT_MASK 0xff /end MEASUREMENT
/begin COMPU_METHOD fm_mon_confact_COMPU_VTAB "Verbal Table" TAB_VERB "%.0" "list" COMPU_TAB_REF fm_mon_confact_COMPU_VTAB_REF /end COMPU_METHOD
/begin COMPU_VTAB fm_mon_confact_COMPU_VTAB_REF "Verbal Table" TAB_VERB 2 0 "No" 1 "Yes" DEFAULT_VALUE "UNKNOWN" /end COMPU_VTAB
/begin MEASUREMENT fm_mon_prevact "Previously active{fm_mon_prevact&0xff=0:No}{fm_mon_prevact&0xff=1:Yes}" UBYTE fm_mon_prevact_COMPU_VTAB 0 0 0 255 ECU_ADDRESS 0x0100E970 BIT_MASK 0xff /end MEASUREMENT
/begin COMPU_METHOD fm_mon_prevact_COMPU_VTAB "Verbal Table" TAB_VERB "%.0" "list" COMPU_TAB_REF fm_mon_prevact_COMPU_VTAB_REF /end COMPU_METHOD
/begin COMPU_VTAB fm_mon_prevact_COMPU_VTAB_REF "Verbal Table" TAB_VERB 2 0 "No" 1 "Yes" DEFAULT_VALUE "UNKNOWN" /end COMPU_VTAB
/begin MEASUREMENT fm_mon_permanent "Permanent{fm_mon_permanent&0xff=0:No}{fm_mon_permanent&0xff=1:Yes}" UBYTE fm_mon_permanent_COMPU_VTAB 0 0 0 255 ECU_ADDRESS 0x0100E978 BIT_MASK 0xff /end MEASUREMENT
/begin COMPU_METHOD fm_mon_permanent_COMPU_VTAB "Verbal Table" TAB_VERB "%.0" "list" COMPU_TAB_REF fm_mon_permanent_COMPU_VTAB_REF /end COMPU_METHOD
/begin COMPU_VTAB fm_mon_permanent_COMPU_VTAB_REF "Verbal Table" TAB_VERB 2 0 "No" 1 "Yes" DEFAULT_VALUE "UNKNOWN" /end COMPU_VTAB
/begin MEASUREMENT fm_mon_mil_type "MIL state{fm_mon_mil_type&0xff=0:Off}{fm_mon_mil_type&0xff=1:On-demand}{fm_mon_mil_type&0xff=2:Short}{fm_mon_mil_type&0xff=3:Continuous}" UBYTE fm_mon_mil_type_COMPU_VTAB 0 0 0 255 ECU_ADDRESS 0x0100E980 BIT_MASK 0xff /end MEASUREMENT
/begin COMPU_METHOD fm_mon_mil_type_COMPU_VTAB "Verbal Table" TAB_VERB "%.0" "list" COMPU_TAB_REF fm_mon_mil_type_COMPU_VTAB_REF /end COMPU_METHOD
/begin COMPU_VTAB fm_mon_mil_type_COMPU_VTAB_REF "Verbal Table" TAB_VERB 4 0 "Off" 1 "On-demand" 2 "Short" 3 "Continuous" DEFAULT_VALUE "UNKNOWN" /end COMPU_VTAB
/begin MEASUREMENT fm_mon_mil_cnt "MIL countdown" UBYTE Compu_fm_mon_mil_cnt 0 0 0 255 ECU_ADDRESS 0x0100E988 /end MEASUREMENT
/begin COMPU_METHOD Compu_fm_mon_mil_cnt " " RAT_FUNC "%.0" "cycles" COEFFS 0 1 0 0 0 1 /end COMPU_METHOD
/begin MEASUREMENT fm_mon_cycles_cnt "Cycles as prev active" UBYTE Compu_fm_mon_cycles_cnt 0 0 0 255 ECU_ADDRESS 0x0100E990 /end MEASUREMENT
/begin COMPU_METHOD Compu_fm_mon_cycles_cnt " " RAT_FUNC "%.0" "cycles" COEFFS 0 1 0 0 0 1 /end COMPU_METHOD
/begin MEASUREMENT fm_mon_sec_prevact "Engine hours as prev active" ULONG Compu_fm_mon_sec_prevact 0 0 0 1193046.47083333 ECU_ADDRESS 0x0100E998 /end MEASUREMENT
/begin COMPU_METHOD Compu_fm_mon_sec_prevact " " RAT_FUNC "%.2" "hours" COEFFS 0 3600 0 0 0 1 /end COMPU_METHOD
/begin MEASUREMENT fm_mon_act_cnt "Fault counter" UWORD Compu_fm_mon_act_cnt 0 0 0 99.9984741210938 ECU_ADDRESS 0x0100EE50 /end MEASUREMENT
/begin COMPU_METHOD Compu_fm_mon_act_cnt " " RAT_FUNC "%.1" "%" COEFFS 0 655.36 0 0 0 1 /end COMPU_METHOD
/begin MEASUREMENT fm_mon_con_cnt "Diagnostic conclusion" UWORD Compu_fm_mon_con_cnt 0 0 0 99.9984741210938 ECU_ADDRESS 0x0100EE58 /end MEASUREMENT
/begin COMPU_METHOD Compu_fm_mon_con_cnt " " RAT_FUNC "%.1" "%" COEFFS 0 655.36 0 0 0 1 /end COMPU_METHOD
/begin CHARACTERISTIC COT_hi_hyst "COT high fault hysteresis" VALUE 0x001c6e3e /* @ECU_Address@COT_hi_hyst@0x0100EE90@ */ ECIPP_ALIGNMENT_UWORD 7732 Compu_COT_hi_hyst -460 7731.875 /end CHARACTERISTIC
/begin COMPU_METHOD Compu_COT_hi_hyst " " RAT_FUNC "%.1" "deg F" COEFFS 0 8 3680 0 0 1 /end COMPU_METHOD
/begin CHARACTERISTIC TPScmd_dmdot_n "Throttle flow derivative window" VALUE 0x001c8f49 /* @ECU_Address@TPScmd_dmdot_n@0x0100F008@ */ ECIPP_ALIGNMENT_UBYTE 1275 Compu_TPScmd_dmdot_n 0 1275 /end CHARACTERISTIC
/begin COMPU_METHOD Compu_TPScmd_dmdot_n " " RAT_FUNC "%.0" "ms" COEFFS 0 0.2 0 0 0 1 /end COMPU_METHOD
/begin CHARACTERISTIC TPScmd_dmdot_Dz "Throttle flow derivative deadzone" VALUE 0x001c3c8c /* @ECU_Address@TPScmd_dmdot_Dz@0x0100F010@ */ ECIPP_ALIGNMENT_FLOAT32_IEEE 10000000000 Compu_TPScmd_dmdot_Dz -10000000000 10000000000 /end CHARACTERISTIC
/begin COMPU_METHOD Compu_TPScmd_dmdot_Dz " " RAT_FUNC "%.1" "g/s/s" COEFFS 0 1 0 0 0 1 /end COMPU_METHOD
/begin CHARACTERISTIC TPScmd_dmdot_LP "Throttle flow derivative low-pass" VALUE 0x001c860a /* @ECU_Address@TPScmd_dmdot_LP@0x0100F018@ */ ECIPP_ALIGNMENT_UWORD 327680 Compu_TPScmd_dmdot_LP 0.45084 327680 /end CHARACTERISTIC
/begin COMPU_METHOD Compu_TPScmd_dmdot_LP " " FORM "%.1" "ms"
 /begin FORMULA "-5 / log(1 - (X1 / 65536))" FORMULA_INV "(1 - exp(-5/X1)) * 65536" /end FORMULA
/end COMPU_METHOD
/begin MEASUREMENT TPScmd_dmdot "Throttle flow derivative" FLOAT32_IEEE Compu_TPScmd_dmdot 0 0 -10000000000 10000000000 ECU_ADDRESS 0x0100F020 /end MEASUREMENT
/begin COMPU_METHOD Compu_TPScmd_dmdot " " RAT_FUNC "%.1" "g/s/s" COEFFS 0 1 0 0 0 1 /end COMPU_METHOD
/begin MEASUREMENT mdot_TPScmd_f "Throttle flow estimate" FLOAT32_IEEE Compu_mdot_TPScmd_f 0 0 -10000000000 10000000000 ECU_ADDRESS 0x0100F028 /end MEASUREMENT
/begin COMPU_METHOD Compu_mdot_TPScmd_f " " RAT_FUNC "%.1" "g/sec" COEFFS 0 1 0 0 0 1 /end COMPU_METHOD
/begin CHARACTERISTIC TPSdP_ena "TPSdP sensor{TPSdP_ena&0xff=0:Disabled}{TPSdP_ena&0xff=1:Aux PD1}{TPSdP_ena&0xff=2:Aux PD2}{TPSdP_ena&0xff=3:Aux PD3}{TPSdP_ena&0xff=4:Aux PUD1}{TPSdP_ena&0xff=5:Aux PUD2}{TPSdP_ena&0xff=6:Aux PUD3}{TPSdP_ena&0xff=7:Aux PUD4}{TPSdP_ena&0xff=8:Aux PUD5}{TP" VALUE 0x001c8f4c /* @ECU_Address@TPSdP_ena@0x0100F0A8@ */ ECIPP_ALIGNMENT_UBYTE 255 TPSdP_ena_COMPU_VTAB 0 255 BIT_MASK 0xff /end CHARACTERISTIC
/begin COMPU_METHOD TPSdP_ena_COMPU_VTAB "Verbal Table" TAB_VERB "%.0" "list" COMPU_TAB_REF TPSdP_ena_COMPU_VTAB_REF /end COMPU_METHOD
/begin COMPU_VTAB TPSdP_ena_COMPU_VTAB_REF "Verbal Table" TAB_VERB 31 0 "Disabled" 1 "Aux PD1" 2 "Aux PD2" 3 "Aux PD3" 4 "Aux PUD1" 5 "Aux PUD2" 6 "Aux PUD3" 7 "Aux PUD4" 8 "Aux PUD5" 9 "Aux PUD6" 10 "Aux PUD7" 11 "Aux PUD8" 12 "Aux PUD9" 13 "Aux PUD10" 14 "Aux PUD11" 15 "Aux PUD12" 16 "Aux PUD13" 17 "Aux PUD14" 18 "Aux PUD15" 19 "CAN sourced" 20 "FPP2 Input" 21 "Aux PUD16" 22 "Aux PUD17" 23 "Aux PUD18" 24 "Aux PUD19" 25 "Aux PUD20" 26 "Aux PUD21" 27 "Aux PUD22" 28 "Aux PUD23" 29 "Aux PUD24" 30 "Aux PUD25" DEFAULT_VALUE "UNKNOWN" /end COMPU_VTAB
/begin CHARACTERISTIC TPSdP_config "TPSdP configuration{TPSdP_config&0xff=0:Differential (TIP-TOP)}{TPSdP_config&0xff=1:Absolute (TOP)}" VALUE 0x001c8f4b /* @ECU_Address@TPSdP_config@0x0100F0B8@ */ ECIPP_ALIGNMENT_UBYTE 255 TPSdP_config_COMPU_VTAB 0 255 BIT_MASK 0xff /end CHARACTERISTIC
/begin COMPU_METHOD TPSdP_config_COMPU_VTAB "Verbal Table" TAB_VERB "%.0" "list" COMPU_TAB_REF TPSdP_config_COMPU_VTAB_REF /end COMPU_METHOD
/begin COMPU_VTAB TPSdP_config_COMPU_VTAB_REF "Verbal Table" TAB_VERB 2 0 "Differential (TIP-TOP)" 1 "Absolute (TOP)" DEFAULT_VALUE "UNKNOWN" /end COMPU_VTAB
/begin CHARACTERISTIC TPSdP_cyl_events "TPSdP averaging window" VALUE 0x001c3c90 /* @ECU_Address@TPSdP_cyl_events@0x0100F0C0@ */ ECIPP_ALIGNMENT_FLOAT32_IEEE 10000000000 Compu_TPSdP_cyl_events -10000000000 10000000000 /end CHARACTERISTIC
/begin COMPU_METHOD Compu_TPSdP_cyl_events " " RAT_FUNC "%.1" "cyl events" COEFFS 0 1 0 0 0 1 /end COMPU_METHOD
/begin CHARACTERISTIC TPSdP_tau "TPSdP sensor low-pass" VALUE 0x001c860e /* @ECU_Address@TPSdP_tau@0x0100F0C8@ */ ECIPP_ALIGNMENT_UWORD 163840 Compu_TPSdP_tau 0.16703 163840 /end CHARACTERISTIC
/begin COMPU_METHOD Compu_TPSdP_tau " " FORM "%.1" "ms"
 /begin FORMULA "-5 / log(1.0000000000001 - (X1 / 32768))" FORMULA_INV "(1.0000000000001 - exp(-5/X1)) * 32768" /end FORMULA
/end COMPU_METHOD
/begin CHARACTERISTIC TPSdP_offset_keywt "TPSdP offset key-on wait" VALUE 0x001c81c2 /* @ECU_Address@TPSdP_offset_keywt@0x0100F0D0@ */ ECIPP_ALIGNMENT_UWORD 65535 Compu_TPSdP_offset_keywt 0 65535 /end CHARACTERISTIC
/begin COMPU_METHOD Compu_TPSdP_offset_keywt " " RAT_FUNC "%.0" "ms" COEFFS 0 1 0 0 0 1 /end COMPU_METHOD
/begin CHARACTERISTIC TPSdP_offset_strtwt "TPSdP offset start inhibit" VALUE 0x001c81c4 /* @ECU_Address@TPSdP_offset_strtwt@0x0100F0D8@ */ ECIPP_ALIGNMENT_UWORD 65535 Compu_TPSdP_offset_strtwt 0 65535 /end CHARACTERISTIC
/begin COMPU_METHOD Compu_TPSdP_offset_strtwt " " RAT_FUNC "%.0" "ms" COEFFS 0 1 0 0 0 1 /end COMPU_METHOD
/begin CHARACTERISTIC TPSdP_offset_tau "TPSdP offset sampling tau" VALUE 0x001c860c /* @ECU_Address@TPSdP_offset_tau@0x0100F0E0@ */ ECIPP_ALIGNMENT_UWORD 163840 Compu_TPSdP_offset_tau 0.16703 163840 /end CHARACTERISTIC
/begin COMPU_METHOD Compu_TPSdP_offset_tau " " FORM "%.1" "ms"
 /begin FORMULA "-5 / log(1.0000000000001 - (X1 / 32768))" FORMULA_INV "(1.0000000000001 - exp(-5/X1)) * 32768" /end FORMULA
/end COMPU_METHOD
/begin CHARACTERISTIC TPSdP_offset_dPmin "TPSdP offset sample min" VALUE 0x001c58d4 /* @ECU_Address@TPSdP_offset_dPmin@0x0100F0E8@ */ ECIPP_ALIGNMENT_SWORD 32 Compu_TPSdP_offset_dPmin -32 31.9990234375 /end CHARACTERISTIC
/begin COMPU_METHOD Compu_TPSdP_offset_dPmin " " RAT_FUNC "%.3" "psi" COEFFS 0 1024 0 0 0 1 /end COMPU_METHOD
/begin CHARACTERISTIC TPSdP_offset_dPmax "TPSdP offset sample max" VALUE 0x001c58d2 /* @ECU_Address@TPSdP_offset_dPmax@0x0100F0F0@ */ ECIPP_ALIGNMENT_SWORD 32 Compu_TPSdP_offset_dPmax -32 31.9990234375 /end CHARACTERISTIC
/begin COMPU_METHOD Compu_TPSdP_offset_dPmax " " RAT_FUNC "%.3" "psi" COEFFS 0 1024 0 0 0 1 /end COMPU_METHOD
/begin MEASUREMENT TPSdP_inst_float "TPSdP instantaneous" FLOAT32_IEEE Compu_TPSdP_inst_float 0 0 -10000000000 10000000000 ECU_ADDRESS 0x0100F100 /end MEASUREMENT
/begin COMPU_METHOD Compu_TPSdP_inst_float " " RAT_FUNC "%.3" "psi" COEFFS 0 1 0 0 0 1 /end COMPU_METHOD
/begin MEASUREMENT TPSdP_float "TPSdP cyl averaged" FLOAT32_IEEE Compu_TPSdP_float 0 0 -10000000000 10000000000 ECU_ADDRESS 0x0100F108 /end MEASUREMENT
/begin COMPU_METHOD Compu_TPSdP_float " " RAT_FUNC "%.3" "psi" COEFFS 0 1 0 0 0 1 /end COMPU_METHOD
/begin MEASUREMENT fault_maxact_pct0 "Max active percent 0" UWORD Compu_fault_maxact_pct0 0 0 0 399.993896484375 ECU_ADDRESS 0x0100F470 /end MEASUREMENT
/begin COMPU_METHOD Compu_fault_maxact_pct0 " " RAT_FUNC "%.1" "%" COEFFS 0 163.84 0 0 0 1 /end COMPU_METHOD
/begin MEASUREMENT fault_maxact_pct1 "Max active percent 1" UWORD Compu_fault_maxact_pct1 0 0 0 399.993896484375 ECU_ADDRESS 0x0100F478 /end MEASUREMENT
/begin COMPU_METHOD Compu_fault_maxact_pct1 " " RAT_FUNC "%.1" "%" COEFFS 0 163.84 0 0 0 1 /end COMPU_METHOD
/begin MEASUREMENT fault_maxact_pct2 "Max active percent 2" UWORD Compu_fault_maxact_pct2 0 0 0 399.993896484375 ECU_ADDRESS 0x0100F480 /end MEASUREMENT
/begin COMPU_METHOD Compu_fault_maxact_pct2 " " RAT_FUNC "%.1" "%" COEFFS 0 163.84 0 0 0 1 /end COMPU_METHOD
/begin MEASUREMENT fault_maxact_pct3 "Max active percent 3" UWORD Compu_fault_maxact_pct3 0 0 0 399.993896484375 ECU_ADDRESS 0x0100F488 /end MEASUREMENT
/begin COMPU_METHOD Compu_fault_maxact_pct3 " " RAT_FUNC "%.1" "%" COEFFS 0 163.84 0 0 0 1 /end COMPU_METHOD
/begin MEASUREMENT fault_maxact_pct4 "Max active percent 4" UWORD Compu_fault_maxact_pct4 0 0 0 399.993896484375 ECU_ADDRESS 0x0100F490 /end MEASUREMENT
/begin COMPU_METHOD Compu_fault_maxact_pct4 " " RAT_FUNC "%.1" "%" COEFFS 0 163.84 0 0 0 1 /end COMPU_METHOD
/begin MEASUREMENT fault_maxact_pct5 "Max active percent 5" UWORD Compu_fault_maxact_pct5 0 0 0 399.993896484375 ECU_ADDRESS 0x0100F498 /end MEASUREMENT
/begin COMPU_METHOD Compu_fault_maxact_pct5 " " RAT_FUNC "%.1" "%" COEFFS 0 163.84 0 0 0 1 /end COMPU_METHOD
/begin MEASUREMENT fault_maxact_pct6 "Max active percent 6" UWORD Compu_fault_maxact_pct6 0 0 0 399.993896484375 ECU_ADDRESS 0x0100F4A0 /end MEASUREMENT
/begin COMPU_METHOD Compu_fault_maxact_pct6 " " RAT_FUNC "%.1" "%" COEFFS 0 163.84 0 0 0 1 /end COMPU_METHOD
/begin MEASUREMENT fault_maxact_pct7 "Max active percent 7" UWORD Compu_fault_maxact_pct7 0 0 0 399.993896484375 ECU_ADDRESS 0x0100F4A8 /end MEASUREMENT
/begin COMPU_METHOD Compu_fault_maxact_pct7 " " RAT_FUNC "%.1" "%" COEFFS 0 163.84 0 0 0 1 /end COMPU_METHOD
/begin MEASUREMENT fault_maxact_flt0 "Max active fault 0" UWORD Compu_fault_maxact_flt0 0 0 0 65535 ECU_ADDRESS 0x0100F4B0 /end MEASUREMENT
/begin COMPU_METHOD Compu_fault_maxact_flt0 " " RAT_FUNC "%.0" "fault index" COEFFS 0 1 0 0 0 1 /end COMPU_METHOD
/begin MEASUREMENT fault_maxact_flt1 "Max active fault 1" UWORD Compu_fault_maxact_flt1 0 0 0 65535 ECU_ADDRESS 0x0100F4B8 /end MEASUREMENT
/begin COMPU_METHOD Compu_fault_maxact_flt1 " " RAT_FUNC "%.0" "fault index" COEFFS 0 1 0 0 0 1 /end COMPU_METHOD
/begin MEASUREMENT fault_maxact_flt2 "Max active fault 2" UWORD Compu_fault_maxact_flt2 0 0 0 65535 ECU_ADDRESS 0x0100F4C0 /end MEASUREMENT
/begin COMPU_METHOD Compu_fault_maxact_flt2 " " RAT_FUNC "%.0" "fault index" COEFFS 0 1 0 0 0 1 /end COMPU_METHOD
/begin MEASUREMENT fault_maxact_flt3 "Max active fault 3" UWORD Compu_fault_maxact_flt3 0 0 0 65535 ECU_ADDRESS 0x0100F4C8 /end MEASUREMENT
/begin COMPU_METHOD Compu_fault_maxact_flt3 " " RAT_FUNC "%.0" "fault index" COEFFS 0 1 0 0 0 1 /end COMPU_METHOD
/begin MEASUREMENT fault_maxact_flt4 "Max active fault 4" UWORD Compu_fault_maxact_flt4 0 0 0 65535 ECU_ADDRESS 0x0100F4D0 /end MEASUREMENT
/begin COMPU_METHOD Compu_fault_maxact_flt4 " " RAT_FUNC "%.0" "fault index" COEFFS 0 1 0 0 0 1 /end COMPU_METHOD
/begin MEASUREMENT fault_maxact_flt5 "Max active fault 5" UWORD Compu_fault_maxact_flt5 0 0 0 65535 ECU_ADDRESS 0x0100F4D8 /end MEASUREMENT
/begin COMPU_METHOD Compu_fault_maxact_flt5 " " RAT_FUNC "%.0" "fault index" COEFFS 0 1 0 0 0 1 /end COMPU_METHOD
/begin MEASUREMENT fault_maxact_flt6 "Max active fault 6" UWORD Compu_fault_maxact_flt6 0 0 0 65535 ECU_ADDRESS 0x0100F4E0 /end MEASUREMENT
/begin COMPU_METHOD Compu_fault_maxact_flt6 " " RAT_FUNC "%.0" "fault index" COEFFS 0 1 0 0 0 1 /end COMPU_METHOD
/begin MEASUREMENT fault_maxact_flt7 "Max active fault 7" UWORD Compu_fault_maxact_flt7 0 0 0 65535 ECU_ADDRESS 0x0100F4E8 /end MEASUREMENT
/begin COMPU_METHOD Compu_fault_maxact_flt7 " " RAT_FUNC "%.0" "fault index" COEFFS 0 1 0 0 0 1 /end COMPU_METHOD
/begin MEASUREMENT fault_maxact_valid "Max active fault status{fault_maxact_valid&0xff=0:Reset}{fault_maxact_valid&0xff=1:Tracking}" UBYTE fault_maxact_valid_COMPU_VTAB 0 0 0 255 ECU_ADDRESS 0x0100F4F0 BIT_MASK 0xff /end MEASUREMENT
/begin COMPU_METHOD fault_maxact_valid_COMPU_VTAB "Verbal Table" TAB_VERB "%.0" "list" COMPU_TAB_REF fault_maxact_valid_COMPU_VTAB_REF /end COMPU_METHOD
/begin COMPU_VTAB fault_maxact_valid_COMPU_VTAB_REF "Verbal Table" TAB_VERB 2 0 "Reset" 1 "Tracking" DEFAULT_VALUE "UNKNOWN" /end COMPU_VTAB
/begin MEASUREMENT fault_maxact_pct8 "Max active percent 8" UWORD Compu_fault_maxact_pct8 0 0 0 399.993896484375 ECU_ADDRESS 0x0100F690 /end MEASUREMENT
/begin COMPU_METHOD Compu_fault_maxact_pct8 " " RAT_FUNC "%.1" "%" COEFFS 0 163.84 0 0 0 1 /end COMPU_METHOD
/begin MEASUREMENT fault_maxact_pct9 "Max active percent 9" UWORD Compu_fault_maxact_pct9 0 0 0 399.993896484375 ECU_ADDRESS 0x0100F698 /end MEASUREMENT
/begin COMPU_METHOD Compu_fault_maxact_pct9 " " RAT_FUNC "%.1" "%" COEFFS 0 163.84 0 0 0 1 /end COMPU_METHOD
/begin MEASUREMENT fault_maxact_pct10 "Max active percent 10" UWORD Compu_fault_maxact_pct10 0 0 0 399.993896484375 ECU_ADDRESS 0x0100F6A0 /end MEASUREMENT
/begin COMPU_METHOD Compu_fault_maxact_pct10 " " RAT_FUNC "%.1" "%" COEFFS 0 163.84 0 0 0 1 /end COMPU_METHOD
/begin MEASUREMENT fault_maxact_pct11 "Max active percent 11" UWORD Compu_fault_maxact_pct11 0 0 0 399.993896484375 ECU_ADDRESS 0x0100F6A8 /end MEASUREMENT
/begin COMPU_METHOD Compu_fault_maxact_pct11 " " RAT_FUNC "%.1" "%" COEFFS 0 163.84 0 0 0 1 /end COMPU_METHOD
/begin MEASUREMENT fault_maxact_pct12 "Max active percent 12" UWORD Compu_fault_maxact_pct12 0 0 0 399.993896484375 ECU_ADDRESS 0x0100F6B0 /end MEASUREMENT
/begin COMPU_METHOD Compu_fault_maxact_pct12 " " RAT_FUNC "%.1" "%" COEFFS 0 163.84 0 0 0 1 /end COMPU_METHOD
/begin MEASUREMENT fault_maxact_pct13 "Max active percent 13" UWORD Compu_fault_maxact_pct13 0 0 0 399.993896484375 ECU_ADDRESS 0x0100F6B8 /end MEASUREMENT
/begin COMPU_METHOD Compu_fault_maxact_pct13 " " RAT_FUNC "%.1" "%" COEFFS 0 163.84 0 0 0 1 /end COMPU_METHOD
/begin MEASUREMENT fault_maxact_pct14 "Max active percent 14" UWORD Compu_fault_maxact_pct14 0 0 0 399.993896484375 ECU_ADDRESS 0x0100F6C0 /end MEASUREMENT
/begin COMPU_METHOD Compu_fault_maxact_pct14 " " RAT_FUNC "%.1" "%" COEFFS 0 163.84 0 0 0 1 /end COMPU_METHOD
/begin MEASUREMENT fault_maxact_pct15 "Max active percent 15" UWORD Compu_fault_maxact_pct15 0 0 0 399.993896484375 ECU_ADDRESS 0x0100F6C8 /end MEASUREMENT
/begin COMPU_METHOD Compu_fault_maxact_pct15 " " RAT_FUNC "%.1" "%" COEFFS 0 163.84 0 0 0 1 /end COMPU_METHOD
/begin MEASUREMENT fault_maxact_pct16 "Max active percent 16" UWORD Compu_fault_maxact_pct16 0 0 0 399.993896484375 ECU_ADDRESS 0x0100F6D0 /end MEASUREMENT
/begin COMPU_METHOD Compu_fault_maxact_pct16 " " RAT_FUNC "%.1" "%" COEFFS 0 163.84 0 0 0 1 /end COMPU_METHOD
/begin MEASUREMENT fault_maxact_pct17 "Max active percent 17" UWORD Compu_fault_maxact_pct17 0 0 0 399.993896484375 ECU_ADDRESS 0x0100F6D8 /end MEASUREMENT
/begin COMPU_METHOD Compu_fault_maxact_pct17 " " RAT_FUNC "%.1" "%" COEFFS 0 163.84 0 0 0 1 /end COMPU_METHOD
/begin MEASUREMENT fault_maxact_pct18 "Max active percent 18" UWORD Compu_fault_maxact_pct18 0 0 0 399.993896484375 ECU_ADDRESS 0x0100F6E0 /end MEASUREMENT
/begin COMPU_METHOD Compu_fault_maxact_pct18 " " RAT_FUNC "%.1" "%" COEFFS 0 163.84 0 0 0 1 /end COMPU_METHOD
/begin MEASUREMENT fault_maxact_pct19 "Max active percent 19" UWORD Compu_fault_maxact_pct19 0 0 0 399.993896484375 ECU_ADDRESS 0x0100F6E8 /end MEASUREMENT
/begin COMPU_METHOD Compu_fault_maxact_pct19 " " RAT_FUNC "%.1" "%" COEFFS 0 163.84 0 0 0 1 /end COMPU_METHOD
/begin MEASUREMENT fault_maxact_pct20 "Max active percent 20" UWORD Compu_fault_maxact_pct20 0 0 0 399.993896484375 ECU_ADDRESS 0x0100F6F0 /end MEASUREMENT
/begin COMPU_METHOD Compu_fault_maxact_pct20 " " RAT_FUNC "%.1" "%" COEFFS 0 163.84 0 0 0 1 /end COMPU_METHOD
/begin MEASUREMENT fault_maxact_pct21 "Max active percent 21" UWORD Compu_fault_maxact_pct21 0 0 0 399.993896484375 ECU_ADDRESS 0x0100F6F8 /end MEASUREMENT
/begin COMPU_METHOD Compu_fault_maxact_pct21 " " RAT_FUNC "%.1" "%" COEFFS 0 163.84 0 0 0 1 /end COMPU_METHOD
/begin MEASUREMENT fault_maxact_pct22 "Max active percent 22" UWORD Compu_fault_maxact_pct22 0 0 0 399.993896484375 ECU_ADDRESS 0x0100F700 /end MEASUREMENT
/begin COMPU_METHOD Compu_fault_maxact_pct22 " " RAT_FUNC "%.1" "%" COEFFS 0 163.84 0 0 0 1 /end COMPU_METHOD
/begin MEASUREMENT fault_maxact_pct23 "Max active percent 23" UWORD Compu_fault_maxact_pct23 0 0 0 399.993896484375 ECU_ADDRESS 0x0100F708 /end MEASUREMENT
/begin COMPU_METHOD Compu_fault_maxact_pct23 " " RAT_FUNC "%.1" "%" COEFFS 0 163.84 0 0 0 1 /end COMPU_METHOD
/begin MEASUREMENT fault_maxact_pct24 "Max active percent 24" UWORD Compu_fault_maxact_pct24 0 0 0 399.993896484375 ECU_ADDRESS 0x0100F710 /end MEASUREMENT
/begin COMPU_METHOD Compu_fault_maxact_pct24 " " RAT_FUNC "%.1" "%" COEFFS 0 163.84 0 0 0 1 /end COMPU_METHOD
/begin MEASUREMENT fault_maxact_pct25 "Max active percent 25" UWORD Compu_fault_maxact_pct25 0 0 0 399.993896484375 ECU_ADDRESS 0x0100F718 /end MEASUREMENT
/begin COMPU_METHOD Compu_fault_maxact_pct25 " " RAT_FUNC "%.1" "%" COEFFS 0 163.84 0 0 0 1 /end COMPU_METHOD
/begin MEASUREMENT fault_maxact_pct26 "Max active percent 26" UWORD Compu_fault_maxact_pct26 0 0 0 399.993896484375 ECU_ADDRESS 0x0100F720 /end MEASUREMENT
/begin COMPU_METHOD Compu_fault_maxact_pct26 " " RAT_FUNC "%.1" "%" COEFFS 0 163.84 0 0 0 1 /end COMPU_METHOD
/begin MEASUREMENT fault_maxact_pct27 "Max active percent 27" UWORD Compu_fault_maxact_pct27 0 0 0 399.993896484375 ECU_ADDRESS 0x0100F728 /end MEASUREMENT
/begin COMPU_METHOD Compu_fault_maxact_pct27 " " RAT_FUNC "%.1" "%" COEFFS 0 163.84 0 0 0 1 /end COMPU_METHOD
/begin MEASUREMENT fault_maxact_pct28 "Max active percent 28" UWORD Compu_fault_maxact_pct28 0 0 0 399.993896484375 ECU_ADDRESS 0x0100F730 /end MEASUREMENT
/begin COMPU_METHOD Compu_fault_maxact_pct28 " " RAT_FUNC "%.1" "%" COEFFS 0 163.84 0 0 0 1 /end COMPU_METHOD
/begin MEASUREMENT fault_maxact_pct29 "Max active percent 29" UWORD Compu_fault_maxact_pct29 0 0 0 399.993896484375 ECU_ADDRESS 0x0100F738 /end MEASUREMENT
/begin COMPU_METHOD Compu_fault_maxact_pct29 " " RAT_FUNC "%.1" "%" COEFFS 0 163.84 0 0 0 1 /end COMPU_METHOD
/begin MEASUREMENT fault_maxact_flt8 "Max active fault 8" UWORD Compu_fault_maxact_flt8 0 0 0 65535 ECU_ADDRESS 0x0100F740 /end MEASUREMENT
/begin COMPU_METHOD Compu_fault_maxact_flt8 " " RAT_FUNC "%.0" "fault index" COEFFS 0 1 0 0 0 1 /end COMPU_METHOD
/begin MEASUREMENT fault_maxact_flt9 "Max active fault 9" UWORD Compu_fault_maxact_flt9 0 0 0 65535 ECU_ADDRESS 0x0100F748 /end MEASUREMENT
/begin COMPU_METHOD Compu_fault_maxact_flt9 " " RAT_FUNC "%.0" "fault index" COEFFS 0 1 0 0 0 1 /end COMPU_METHOD
/begin MEASUREMENT fault_maxact_flt10 "Max active fault 10" UWORD Compu_fault_maxact_flt10 0 0 0 65535 ECU_ADDRESS 0x0100F750 /end MEASUREMENT
/begin COMPU_METHOD Compu_fault_maxact_flt10 " " RAT_FUNC "%.0" "fault index" COEFFS 0 1 0 0 0 1 /end COMPU_METHOD
/begin MEASUREMENT fault_maxact_flt11 "Max active fault 11" UWORD Compu_fault_maxact_flt11 0 0 0 65535 ECU_ADDRESS 0x0100F758 /end MEASUREMENT
/begin COMPU_METHOD Compu_fault_maxact_flt11 " " RAT_FUNC "%.0" "fault index" COEFFS 0 1 0 0 0 1 /end COMPU_METHOD
/begin MEASUREMENT fault_maxact_flt12 "Max active fault 12" UWORD Compu_fault_maxact_flt12 0 0 0 65535 ECU_ADDRESS 0x0100F760 /end MEASUREMENT
/begin COMPU_METHOD Compu_fault_maxact_flt12 " " RAT_FUNC "%.0" "fault index" COEFFS 0 1 0 0 0 1 /end COMPU_METHOD
/begin MEASUREMENT fault_maxact_flt13 "Max active fault 13" UWORD Compu_fault_maxact_flt13 0 0 0 65535 ECU_ADDRESS 0x0100F768 /end MEASUREMENT
/begin COMPU_METHOD Compu_fault_maxact_flt13 " " RAT_FUNC "%.0" "fault index" COEFFS 0 1 0 0 0 1 /end COMPU_METHOD
/begin MEASUREMENT fault_maxact_flt14 "Max active fault 14" UWORD Compu_fault_maxact_flt14 0 0 0 65535 ECU_ADDRESS 0x0100F770 /end MEASUREMENT
/begin COMPU_METHOD Compu_fault_maxact_flt14 " " RAT_FUNC "%.0" "fault index" COEFFS 0 1 0 0 0 1 /end COMPU_METHOD
/begin MEASUREMENT fault_maxact_flt15 "Max active fault 15" UWORD Compu_fault_maxact_flt15 0 0 0 65535 ECU_ADDRESS 0x0100F778 /end MEASUREMENT
/begin COMPU_METHOD Compu_fault_maxact_flt15 " " RAT_FUNC "%.0" "fault index" COEFFS 0 1 0 0 0 1 /end COMPU_METHOD
/begin MEASUREMENT fault_maxact_flt16 "Max active fault 16" UWORD Compu_fault_maxact_flt16 0 0 0 65535 ECU_ADDRESS 0x0100F780 /end MEASUREMENT
/begin COMPU_METHOD Compu_fault_maxact_flt16 " " RAT_FUNC "%.0" "fault index" COEFFS 0 1 0 0 0 1 /end COMPU_METHOD
/begin MEASUREMENT fault_maxact_flt17 "Max active fault 17" UWORD Compu_fault_maxact_flt17 0 0 0 65535 ECU_ADDRESS 0x0100F788 /end MEASUREMENT
/begin COMPU_METHOD Compu_fault_maxact_flt17 " " RAT_FUNC "%.0" "fault index" COEFFS 0 1 0 0 0 1 /end COMPU_METHOD
/begin MEASUREMENT fault_maxact_flt18 "Max active fault 18" UWORD Compu_fault_maxact_flt18 0 0 0 65535 ECU_ADDRESS 0x0100F790 /end MEASUREMENT
/begin COMPU_METHOD Compu_fault_maxact_flt18 " " RAT_FUNC "%.0" "fault index" COEFFS 0 1 0 0 0 1 /end COMPU_METHOD
/begin MEASUREMENT fault_maxact_flt19 "Max active fault 19" UWORD Compu_fault_maxact_flt19 0 0 0 65535 ECU_ADDRESS 0x0100F798 /end MEASUREMENT
/begin COMPU_METHOD Compu_fault_maxact_flt19 " " RAT_FUNC "%.0" "fault index" COEFFS 0 1 0 0 0 1 /end COMPU_METHOD
/begin MEASUREMENT fault_maxact_flt20 "Max active fault 20" UWORD Compu_fault_maxact_flt20 0 0 0 65535 ECU_ADDRESS 0x0100F7A0 /end MEASUREMENT
/begin COMPU_METHOD Compu_fault_maxact_flt20 " " RAT_FUNC "%.0" "fault index" COEFFS 0 1 0 0 0 1 /end COMPU_METHOD
/begin MEASUREMENT fault_maxact_flt21 "Max active fault 21" UWORD Compu_fault_maxact_flt21 0 0 0 65535 ECU_ADDRESS 0x0100F7A8 /end MEASUREMENT
/begin COMPU_METHOD Compu_fault_maxact_flt21 " " RAT_FUNC "%.0" "fault index" COEFFS 0 1 0 0 0 1 /end COMPU_METHOD
/begin MEASUREMENT fault_maxact_flt22 "Max active fault 22" UWORD Compu_fault_maxact_flt22 0 0 0 65535 ECU_ADDRESS 0x0100F7B0 /end MEASUREMENT
/begin COMPU_METHOD Compu_fault_maxact_flt22 " " RAT_FUNC "%.0" "fault index" COEFFS 0 1 0 0 0 1 /end COMPU_METHOD
/begin MEASUREMENT fault_maxact_flt23 "Max active fault 23" UWORD Compu_fault_maxact_flt23 0 0 0 65535 ECU_ADDRESS 0x0100F7B8 /end MEASUREMENT
/begin COMPU_METHOD Compu_fault_maxact_flt23 " " RAT_FUNC "%.0" "fault index" COEFFS 0 1 0 0 0 1 /end COMPU_METHOD
/begin MEASUREMENT fault_maxact_flt24 "Max active fault 24" UWORD Compu_fault_maxact_flt24 0 0 0 65535 ECU_ADDRESS 0x0100F7C0 /end MEASUREMENT
/begin COMPU_METHOD Compu_fault_maxact_flt24 " " RAT_FUNC "%.0" "fault index" COEFFS 0 1 0 0 0 1 /end COMPU_METHOD
/begin MEASUREMENT fault_maxact_flt25 "Max active fault 25" UWORD Compu_fault_maxact_flt25 0 0 0 65535 ECU_ADDRESS 0x0100F7C8 /end MEASUREMENT
/begin COMPU_METHOD Compu_fault_maxact_flt25 " " RAT_FUNC "%.0" "fault index" COEFFS 0 1 0 0 0 1 /end COMPU_METHOD
/begin MEASUREMENT fault_maxact_flt26 "Max active fault 26" UWORD Compu_fault_maxact_flt26 0 0 0 65535 ECU_ADDRESS 0x0100F7D0 /end MEASUREMENT
/begin COMPU_METHOD Compu_fault_maxact_flt26 " " RAT_FUNC "%.0" "fault index" COEFFS 0 1 0 0 0 1 /end COMPU_METHOD
/begin MEASUREMENT fault_maxact_flt27 "Max active fault 27" UWORD Compu_fault_maxact_flt27 0 0 0 65535 ECU_ADDRESS 0x0100F7D8 /end MEASUREMENT
/begin COMPU_METHOD Compu_fault_maxact_flt27 " " RAT_FUNC "%.0" "fault index" COEFFS 0 1 0 0 0 1 /end COMPU_METHOD
/begin MEASUREMENT fault_maxact_flt28 "Max active fault 28" UWORD Compu_fault_maxact_flt28 0 0 0 65535 ECU_ADDRESS 0x0100F7E0 /end MEASUREMENT
/begin COMPU_METHOD Compu_fault_maxact_flt28 " " RAT_FUNC "%.0" "fault index" COEFFS 0 1 0 0 0 1 /end COMPU_METHOD
/begin MEASUREMENT fault_maxact_flt29 "Max active fault 29" UWORD Compu_fault_maxact_flt29 0 0 0 65535 ECU_ADDRESS 0x0100F7E8 /end MEASUREMENT
/begin COMPU_METHOD Compu_fault_maxact_flt29 " " RAT_FUNC "%.0" "fault index" COEFFS 0 1 0 0 0 1 /end COMPU_METHOD
/begin CHARACTERISTIC fault_SD_dis_ena "Fault shutdown inhibit{fault_SD_dis_ena&0xff=0:Disabled}{fault_SD_dis_ena&0xff=1:Aux PU1 = Gnd}{fault_SD_dis_ena&0xff=2:Aux PU2 = Gnd}{fault_SD_dis_ena&0xff=3:Aux PU3 = Gnd}{fault_SD_dis_ena&0xff=4:Aux PUD1 = Gnd}{fault_SD_dis_ena&0xff=5:Aux PUD2 = Gnd}{f" VALUE 0x001c9016 /* @ECU_Address@fault_SD_dis_ena@0x010106C8@ */ ECIPP_ALIGNMENT_UBYTE 255 fault_SD_dis_ena_COMPU_VTAB 0 255 BIT_MASK 0xff /end CHARACTERISTIC
/begin COMPU_METHOD fault_SD_dis_ena_COMPU_VTAB "Verbal Table" TAB_VERB "%.0" "list" COMPU_TAB_REF fault_SD_dis_ena_COMPU_VTAB_REF /end COMPU_METHOD
/begin COMPU_VTAB fault_SD_dis_ena_COMPU_VTAB_REF "Verbal Table" TAB_VERB 31 0 "Disabled" 1 "Aux PU1 = Gnd" 2 "Aux PU2 = Gnd" 3 "Aux PU3 = Gnd" 4 "Aux PUD1 = Gnd" 5 "Aux PUD2 = Gnd" 6 "Aux PUD3 = Gnd" 7 "Aux PUD4 = +V" 8 "Aux PUD5 = Gnd" 9 "Aux DIG1" 10 "Aux DIG2" 11 "Aux DIG3" 12 "Aux DIG4" 13 "Aux DIG5" 14 "Aux DIG6" 15 "Aux DIG7" 16 "Aux DIG8" 17 "Aux DIG9" 18 "Aux DIG10" 19 "Aux DIG11" 20 "Aux DIG12" 21 "Aux DIG13" 22 "Aux DIG14" 23 "Aux DIG15" 24 "Aux DIG16" 25 "Aux DIG17" 26 "Aux DIG18" 27 "Aux DIG19" 28 "Gov1" 29 "Gov2" 30 "CAN Sourced" DEFAULT_VALUE "UNKNOWN" /end COMPU_VTAB
/begin CHARACTERISTIC fault_SD_dis_cfg "Fault shutdown inhibit Aux DIG config{fault_SD_dis_cfg&0xff=0:Default}{fault_SD_dis_cfg&0xff=1:GND}{fault_SD_dis_cfg&0xff=2:GND/+V}{fault_SD_dis_cfg&0xff=3:+V}{fault_SD_dis_cfg&0xff=4:Open}" VALUE 0x001c9015 /* @ECU_Address@fault_SD_dis_cfg@0x010106D0@ */ ECIPP_ALIGNMENT_UBYTE 255 fault_SD_dis_cfg_COMPU_VTAB 0 255 BIT_MASK 0xff /end CHARACTERISTIC
/begin COMPU_METHOD fault_SD_dis_cfg_COMPU_VTAB "Verbal Table" TAB_VERB "%.0" "list" COMPU_TAB_REF fault_SD_dis_cfg_COMPU_VTAB_REF /end COMPU_METHOD
/begin COMPU_VTAB fault_SD_dis_cfg_COMPU_VTAB_REF "Verbal Table" TAB_VERB 5 0 "Default" 1 "GND" 2 "GND/+V" 3 "+V" 4 "Open" DEFAULT_VALUE "UNKNOWN" /end COMPU_VTAB
/begin MEASUREMENT SD_inhibit "Fault shutdown inhibit active" UBYTE Compu_SD_inhibit 0 0 0 255 ECU_ADDRESS 0x010106D8 /end MEASUREMENT
/begin COMPU_METHOD Compu_SD_inhibit " " RAT_FUNC "%.0" "-" COEFFS 0 1 0 0 0 1 /end COMPU_METHOD
/begin CHARACTERISTIC EGRHPLP_Dz "EGR HP/LP cubic deadzone" VALUE 0x001c0048 /* @ECU_Address@EGRHPLP_Dz@0x01010758@ */ ECIPP_ALIGNMENT_FLOAT32_IEEE 10000000000 Compu_EGRHPLP_Dz -10000000000 10000000000 /end CHARACTERISTIC
/begin COMPU_METHOD Compu_EGRHPLP_Dz " " RAT_FUNC "%.2" "psi" COEFFS 0 1 0 0 0 1 /end COMPU_METHOD
/begin MEASUREMENT EGRLP_wdw "EGRLP windowed" FLOAT32_IEEE Compu_EGRLP_wdw 0 0 -10000000000 10000000000 ECU_ADDRESS 0x01010760 /end MEASUREMENT
/begin COMPU_METHOD Compu_EGRLP_wdw " " RAT_FUNC "%.2" "psia" COEFFS 0 1 0 0 0 1 /end COMPU_METHOD
/begin MEASUREMENT EGRHP_wdw "EGRHP windowed" FLOAT32_IEEE Compu_EGRHP_wdw 0 0 -10000000000 10000000000 ECU_ADDRESS 0x01010768 /end MEASUREMENT
/begin COMPU_METHOD Compu_EGRHP_wdw " " RAT_FUNC "%.2" "psia" COEFFS 0 1 0 0 0 1 /end COMPU_METHOD
/begin CHARACTERISTIC CVdP_dP1_location "CV sensor location 1{CVdP_dP1_location&0xff=0:None}{CVdP_dP1_location&0xff=1:Clean Side}{CVdP_dP1_location&0xff=2:Dirty Side}{CVdP_dP1_location&0xff=3:Aux 1 pressure}{CVdP_dP1_location&0xff=4:Aux 2 pressure}" VALUE 0x001c86af /* @ECU_Address@CVdP_dP1_location@0x01010CC0@ */ ECIPP_ALIGNMENT_UBYTE 255 CVdP_dP1_location_COMPU_VTAB 0 255 BIT_MASK 0xff /end CHARACTERISTIC
/begin COMPU_METHOD CVdP_dP1_location_COMPU_VTAB "Verbal Table" TAB_VERB "%.0" "list" COMPU_TAB_REF CVdP_dP1_location_COMPU_VTAB_REF /end COMPU_METHOD
/begin COMPU_VTAB CVdP_dP1_location_COMPU_VTAB_REF "Verbal Table" TAB_VERB 5 0 "None" 1 "Clean Side" 2 "Dirty Side" 3 "Aux 1 pressure" 4 "Aux 2 pressure" DEFAULT_VALUE "UNKNOWN" /end COMPU_VTAB
/begin CHARACTERISTIC CVdP_dP2_location "CV sensor location 2{CVdP_dP2_location&0xff=0:None}{CVdP_dP2_location&0xff=1:Clean Side}{CVdP_dP2_location&0xff=2:Dirty Side}{CVdP_dP2_location&0xff=3:Aux 1 pressure}{CVdP_dP2_location&0xff=4:Aux 2 pressure}" VALUE 0x001c86b0 /* @ECU_Address@CVdP_dP2_location@0x01010CC8@ */ ECIPP_ALIGNMENT_UBYTE 255 CVdP_dP2_location_COMPU_VTAB 0 255 BIT_MASK 0xff /end CHARACTERISTIC
/begin COMPU_METHOD CVdP_dP2_location_COMPU_VTAB "Verbal Table" TAB_VERB "%.0" "list" COMPU_TAB_REF CVdP_dP2_location_COMPU_VTAB_REF /end COMPU_METHOD
/begin COMPU_VTAB CVdP_dP2_location_COMPU_VTAB_REF "Verbal Table" TAB_VERB 5 0 "None" 1 "Clean Side" 2 "Dirty Side" 3 "Aux 1 pressure" 4 "Aux 2 pressure" DEFAULT_VALUE "UNKNOWN" /end COMPU_VTAB
/begin MEASUREMENT CVdP_dP1_d "Expected pressure" SWORD Compu_CVdP_dP1_d 0 0 -32 31.9990234375 ECU_ADDRESS 0x01010D78 /end MEASUREMENT
/begin COMPU_METHOD Compu_CVdP_dP1_d " " RAT_FUNC "%.4" "psi" COEFFS 0 1024 0 0 0 1 /end COMPU_METHOD
/begin MEASUREMENT CVdP_dP2_d "Expected pressure" SWORD Compu_CVdP_dP2_d 0 0 -32 31.9990234375 ECU_ADDRESS 0x01010D80 /end MEASUREMENT
/begin COMPU_METHOD Compu_CVdP_dP2_d " " RAT_FUNC "%.4" "psi" COEFFS 0 1024 0 0 0 1 /end COMPU_METHOD
/begin MEASUREMENT CVdP_dP1_pcta "Actual/expected" FLOAT32_IEEE Compu_CVdP_dP1_pcta 0 0 -10000000000 10000000000 ECU_ADDRESS 0x01010D88 /end MEASUREMENT
/begin COMPU_METHOD Compu_CVdP_dP1_pcta " " RAT_FUNC "%.0" "%" COEFFS 0 0.01 0 0 0 1 /end COMPU_METHOD
/begin MEASUREMENT CVdP_dP2_pcta "Actual/expected" FLOAT32_IEEE Compu_CVdP_dP2_pcta 0 0 -10000000000 10000000000 ECU_ADDRESS 0x01010D90 /end MEASUREMENT
/begin COMPU_METHOD Compu_CVdP_dP2_pcta " " RAT_FUNC "%.0" "%" COEFFS 0 0.01 0 0 0 1 /end COMPU_METHOD
/begin CHARACTERISTIC AFILTdP_tau "AFILTdP low-pass tau" VALUE 0x001c8512 /* @ECU_Address@AFILTdP_tau@0x01011428@ */ ECIPP_ALIGNMENT_UWORD 163840 Compu_AFILTdP_tau 0.16703 163840 /end CHARACTERISTIC
/begin COMPU_METHOD Compu_AFILTdP_tau " " FORM "%.0" "ms"
 /begin FORMULA "-5 / log(1.0000000000001 - (X1 / 32768))" FORMULA_INV "(1.0000000000001 - exp(-5/X1)) * 32768" /end FORMULA
/end COMPU_METHOD
/begin CHARACTERISTIC AFILTdP_Dz "AFILT dP deadzone" VALUE 0x001c4420 /* @ECU_Address@AFILTdP_Dz@0x01011430@ */ ECIPP_ALIGNMENT_SWORD 32 Compu_AFILTdP_Dz -32 31.9990234375 /end CHARACTERISTIC
/begin COMPU_METHOD Compu_AFILTdP_Dz " " RAT_FUNC "%.3" "psi" COEFFS 0 1024 0 0 0 1 /end COMPU_METHOD
/begin CHARACTERISTIC AFILTdP_cyl_events "AFILTdP window" VALUE 0x001c3a60 /* @ECU_Address@AFILTdP_cyl_events@0x01011438@ */ ECIPP_ALIGNMENT_FLOAT32_IEEE 10000000000 Compu_AFILTdP_cyl_events -10000000000 10000000000 /end CHARACTERISTIC
/begin COMPU_METHOD Compu_AFILTdP_cyl_events " " RAT_FUNC "%.1" "cyl events" COEFFS 0 1 0 0 0 1 /end COMPU_METHOD
/begin CHARACTERISTIC faultact_AL_dis "Fault adaptive learn disable{faultact_AL_dis&0xff=0:Fuel}{faultact_AL_dis&0xff=1:Fuel+throttle}{faultact_AL_dis&0xff=2:Fuel+throttle+EGR valve}" VALUE 0x001ecc9a /* @ECU_Address@faultact_AL_dis@0x01011B50@ */ ECIPP_ALIGNMENT_UBYTE 255 faultact_AL_dis_COMPU_VTAB 0 255 BIT_MASK 0xff /end CHARACTERISTIC
/begin COMPU_METHOD faultact_AL_dis_COMPU_VTAB "Verbal Table" TAB_VERB "%.0" "list" COMPU_TAB_REF faultact_AL_dis_COMPU_VTAB_REF /end COMPU_METHOD
/begin COMPU_VTAB faultact_AL_dis_COMPU_VTAB_REF "Verbal Table" TAB_VERB 3 0 "Fuel" 1 "Fuel+throttle" 2 "Fuel+throttle+EGR valve" DEFAULT_VALUE "UNKNOWN" /end COMPU_VTAB
/begin CHARACTERISTIC ECTmon_warm_wait "Warm engine monitor start wait" VALUE 0x001c428c /* @ECU_Address@ECTmon_warm_wait@0x01011F80@ */ ECIPP_ALIGNMENT_ULONG 4294967 Compu_ECTmon_warm_wait 0 4294967.295 /end CHARACTERISTIC
/begin COMPU_METHOD Compu_ECTmon_warm_wait " " RAT_FUNC "%.0" "sec" COEFFS 0 1000 0 0 0 1 /end COMPU_METHOD
/begin MEASUREMENT ECTmon_CL_wait "CL ECT warm-up time" ULONG Compu_ECTmon_CL_wait 0 0 0 4294967.295 ECU_ADDRESS 0x01011FE8 /end MEASUREMENT
/begin COMPU_METHOD Compu_ECTmon_CL_wait " " RAT_FUNC "%.1" "sec" COEFFS 0 1000 0 0 0 1 /end COMPU_METHOD
/begin MEASUREMENT ECTmon_CL_tmr "CL ECT warm-up timer" ULONG Compu_ECTmon_CL_tmr 0 0 0 4294967.295 ECU_ADDRESS 0x01011FF0 /end MEASUREMENT
/begin COMPU_METHOD Compu_ECTmon_CL_tmr " " RAT_FUNC "%.1" "sec" COEFFS 0 1000 0 0 0 1 /end COMPU_METHOD
/begin MEASUREMENT ECTmon_oper_wait "Operating ECT warm-up time" ULONG Compu_ECTmon_oper_wait 0 0 0 4294967.295 ECU_ADDRESS 0x01011FF8 /end MEASUREMENT
/begin COMPU_METHOD Compu_ECTmon_oper_wait " " RAT_FUNC "%.1" "sec" COEFFS 0 1000 0 0 0 1 /end COMPU_METHOD
/begin MEASUREMENT ECTmon_oper_tmr "Operating ECT warm-up timer" ULONG Compu_ECTmon_oper_tmr 0 0 0 4294967.295 ECU_ADDRESS 0x01012000 /end MEASUREMENT
/begin COMPU_METHOD Compu_ECTmon_oper_tmr " " RAT_FUNC "%.1" "sec" COEFFS 0 1000 0 0 0 1 /end COMPU_METHOD
/begin MEASUREMENT ECTmon_diag_wait "Diagnostics ECT warm-up time" ULONG Compu_ECTmon_diag_wait 0 0 0 4294967.295 ECU_ADDRESS 0x01012008 /end MEASUREMENT
/begin COMPU_METHOD Compu_ECTmon_diag_wait " " RAT_FUNC "%.1" "sec" COEFFS 0 1000 0 0 0 1 /end COMPU_METHOD
/begin MEASUREMENT ECTmon_diag_tmr "Diagnostics ECT warm-up timer" ULONG Compu_ECTmon_diag_tmr 0 0 0 4294967.295 ECU_ADDRESS 0x01012010 /end MEASUREMENT
/begin COMPU_METHOD Compu_ECTmon_diag_tmr " " RAT_FUNC "%.1" "sec" COEFFS 0 1000 0 0 0 1 /end COMPU_METHOD
/begin CHARACTERISTIC faultact_persist "Fault action persist mode{faultact_persist&0xff=0:Cycle}{faultact_persist&0xff=1:Fault state}" VALUE 0x001c9019 /* @ECU_Address@faultact_persist@0x010120B8@ */ ECIPP_ALIGNMENT_UBYTE 255 faultact_persist_COMPU_VTAB 0 255 BIT_MASK 0xff /end CHARACTERISTIC
/begin COMPU_METHOD faultact_persist_COMPU_VTAB "Verbal Table" TAB_VERB "%.0" "list" COMPU_TAB_REF faultact_persist_COMPU_VTAB_REF /end COMPU_METHOD
/begin COMPU_VTAB faultact_persist_COMPU_VTAB_REF "Verbal Table" TAB_VERB 2 0 "Cycle" 1 "Fault state" DEFAULT_VALUE "UNKNOWN" /end COMPU_VTAB
/begin CHARACTERISTIC faultact_persist_cyc "Fault action persist cycles" VALUE 0x001c901b /* @ECU_Address@faultact_persist_cyc@0x010120C0@ */ ECIPP_ALIGNMENT_UBYTE 255 Compu_faultact_persist_cyc 0 255 /end CHARACTERISTIC
/begin COMPU_METHOD Compu_faultact_persist_cyc " " RAT_FUNC "%.0" "cycles" COEFFS 0 1 0 0 0 1 /end COMPU_METHOD
/begin CHARACTERISTIC faultact_persist_MIL "Fault action persist MIL{faultact_persist_MIL&0xff=0:Disabled}{faultact_persist_MIL&0xff=1:Enabled}" VALUE 0x001c901a /* @ECU_Address@faultact_persist_MIL@0x010120C8@ */ ECIPP_ALIGNMENT_UBYTE 255 faultact_persist_MIL_COMPU_VTAB 0 255 BIT_MASK 0xff /end CHARACTERISTIC
/begin COMPU_METHOD faultact_persist_MIL_COMPU_VTAB "Verbal Table" TAB_VERB "%.0" "list" COMPU_TAB_REF faultact_persist_MIL_COMPU_VTAB_REF /end COMPU_METHOD
/begin COMPU_VTAB faultact_persist_MIL_COMPU_VTAB_REF "Verbal Table" TAB_VERB 2 0 "Disabled" 1 "Enabled" DEFAULT_VALUE "UNKNOWN" /end COMPU_VTAB
/begin MEASUREMENT fault_maxact_pct30 "Max active percent 30" UWORD Compu_fault_maxact_pct30 0 0 0 399.993896484375 ECU_ADDRESS 0x010122E0 /end MEASUREMENT
/begin COMPU_METHOD Compu_fault_maxact_pct30 " " RAT_FUNC "%.1" "%" COEFFS 0 163.84 0 0 0 1 /end COMPU_METHOD
/begin MEASUREMENT fault_maxact_pct31 "Max active percent 31" UWORD Compu_fault_maxact_pct31 0 0 0 399.993896484375 ECU_ADDRESS 0x010122E8 /end MEASUREMENT
/begin COMPU_METHOD Compu_fault_maxact_pct31 " " RAT_FUNC "%.1" "%" COEFFS 0 163.84 0 0 0 1 /end COMPU_METHOD
/begin MEASUREMENT fault_maxact_pct32 "Max active percent 32" UWORD Compu_fault_maxact_pct32 0 0 0 399.993896484375 ECU_ADDRESS 0x010122F0 /end MEASUREMENT
/begin COMPU_METHOD Compu_fault_maxact_pct32 " " RAT_FUNC "%.1" "%" COEFFS 0 163.84 0 0 0 1 /end COMPU_METHOD
/begin MEASUREMENT fault_maxact_pct33 "Max active percent 33" UWORD Compu_fault_maxact_pct33 0 0 0 399.993896484375 ECU_ADDRESS 0x010122F8 /end MEASUREMENT
/begin COMPU_METHOD Compu_fault_maxact_pct33 " " RAT_FUNC "%.1" "%" COEFFS 0 163.84 0 0 0 1 /end COMPU_METHOD
/begin MEASUREMENT fault_maxact_pct34 "Max active percent 34" UWORD Compu_fault_maxact_pct34 0 0 0 399.993896484375 ECU_ADDRESS 0x01012300 /end MEASUREMENT
/begin COMPU_METHOD Compu_fault_maxact_pct34 " " RAT_FUNC "%.1" "%" COEFFS 0 163.84 0 0 0 1 /end COMPU_METHOD
/begin MEASUREMENT fault_maxact_pct35 "Max active percent 35" UWORD Compu_fault_maxact_pct35 0 0 0 399.993896484375 ECU_ADDRESS 0x01012308 /end MEASUREMENT
/begin COMPU_METHOD Compu_fault_maxact_pct35 " " RAT_FUNC "%.1" "%" COEFFS 0 163.84 0 0 0 1 /end COMPU_METHOD
/begin MEASUREMENT fault_maxact_pct36 "Max active percent 36" UWORD Compu_fault_maxact_pct36 0 0 0 399.993896484375 ECU_ADDRESS 0x01012310 /end MEASUREMENT
/begin COMPU_METHOD Compu_fault_maxact_pct36 " " RAT_FUNC "%.1" "%" COEFFS 0 163.84 0 0 0 1 /end COMPU_METHOD
/begin MEASUREMENT fault_maxact_pct37 "Max active percent 37" UWORD Compu_fault_maxact_pct37 0 0 0 399.993896484375 ECU_ADDRESS 0x01012318 /end MEASUREMENT
/begin COMPU_METHOD Compu_fault_maxact_pct37 " " RAT_FUNC "%.1" "%" COEFFS 0 163.84 0 0 0 1 /end COMPU_METHOD
/begin MEASUREMENT fault_maxact_pct38 "Max active percent 38" UWORD Compu_fault_maxact_pct38 0 0 0 399.993896484375 ECU_ADDRESS 0x01012320 /end MEASUREMENT
/begin COMPU_METHOD Compu_fault_maxact_pct38 " " RAT_FUNC "%.1" "%" COEFFS 0 163.84 0 0 0 1 /end COMPU_METHOD
/begin MEASUREMENT fault_maxact_pct39 "Max active percent 39" UWORD Compu_fault_maxact_pct39 0 0 0 399.993896484375 ECU_ADDRESS 0x01012328 /end MEASUREMENT
/begin COMPU_METHOD Compu_fault_maxact_pct39 " " RAT_FUNC "%.1" "%" COEFFS 0 163.84 0 0 0 1 /end COMPU_METHOD
/begin MEASUREMENT fault_maxact_pct40 "Max active percent 40" UWORD Compu_fault_maxact_pct40 0 0 0 399.993896484375 ECU_ADDRESS 0x01012330 /end MEASUREMENT
/begin COMPU_METHOD Compu_fault_maxact_pct40 " " RAT_FUNC "%.1" "%" COEFFS 0 163.84 0 0 0 1 /end COMPU_METHOD
/begin MEASUREMENT fault_maxact_pct41 "Max active percent 41" UWORD Compu_fault_maxact_pct41 0 0 0 399.993896484375 ECU_ADDRESS 0x01012338 /end MEASUREMENT
/begin COMPU_METHOD Compu_fault_maxact_pct41 " " RAT_FUNC "%.1" "%" COEFFS 0 163.84 0 0 0 1 /end COMPU_METHOD
/begin MEASUREMENT fault_maxact_pct42 "Max active percent 42" UWORD Compu_fault_maxact_pct42 0 0 0 399.993896484375 ECU_ADDRESS 0x01012340 /end MEASUREMENT
/begin COMPU_METHOD Compu_fault_maxact_pct42 " " RAT_FUNC "%.1" "%" COEFFS 0 163.84 0 0 0 1 /end COMPU_METHOD
/begin MEASUREMENT fault_maxact_pct43 "Max active percent 43" UWORD Compu_fault_maxact_pct43 0 0 0 399.993896484375 ECU_ADDRESS 0x01012348 /end MEASUREMENT
/begin COMPU_METHOD Compu_fault_maxact_pct43 " " RAT_FUNC "%.1" "%" COEFFS 0 163.84 0 0 0 1 /end COMPU_METHOD
/begin MEASUREMENT fault_maxact_pct44 "Max active percent 44" UWORD Compu_fault_maxact_pct44 0 0 0 399.993896484375 ECU_ADDRESS 0x01012350 /end MEASUREMENT
/begin COMPU_METHOD Compu_fault_maxact_pct44 " " RAT_FUNC "%.1" "%" COEFFS 0 163.84 0 0 0 1 /end COMPU_METHOD
/begin MEASUREMENT fault_maxact_pct45 "Max active percent 45" UWORD Compu_fault_maxact_pct45 0 0 0 399.993896484375 ECU_ADDRESS 0x01012358 /end MEASUREMENT
/begin COMPU_METHOD Compu_fault_maxact_pct45 " " RAT_FUNC "%.1" "%" COEFFS 0 163.84 0 0 0 1 /end COMPU_METHOD
/begin MEASUREMENT fault_maxact_pct46 "Max active percent 46" UWORD Compu_fault_maxact_pct46 0 0 0 399.993896484375 ECU_ADDRESS 0x01012360 /end MEASUREMENT
/begin COMPU_METHOD Compu_fault_maxact_pct46 " " RAT_FUNC "%.1" "%" COEFFS 0 163.84 0 0 0 1 /end COMPU_METHOD
/begin MEASUREMENT fault_maxact_pct47 "Max active percent 47" UWORD Compu_fault_maxact_pct47 0 0 0 399.993896484375 ECU_ADDRESS 0x01012368 /end MEASUREMENT
/begin COMPU_METHOD Compu_fault_maxact_pct47 " " RAT_FUNC "%.1" "%" COEFFS 0 163.84 0 0 0 1 /end COMPU_METHOD
/begin MEASUREMENT fault_maxact_pct48 "Max active percent 48" UWORD Compu_fault_maxact_pct48 0 0 0 399.993896484375 ECU_ADDRESS 0x01012370 /end MEASUREMENT
/begin COMPU_METHOD Compu_fault_maxact_pct48 " " RAT_FUNC "%.1" "%" COEFFS 0 163.84 0 0 0 1 /end COMPU_METHOD
/begin MEASUREMENT fault_maxact_pct49 "Max active percent 49" UWORD Compu_fault_maxact_pct49 0 0 0 399.993896484375 ECU_ADDRESS 0x01012378 /end MEASUREMENT
/begin COMPU_METHOD Compu_fault_maxact_pct49 " " RAT_FUNC "%.1" "%" COEFFS 0 163.84 0 0 0 1 /end COMPU_METHOD
/begin MEASUREMENT fault_maxact_pct50 "Max active percent 50" UWORD Compu_fault_maxact_pct50 0 0 0 399.993896484375 ECU_ADDRESS 0x01012380 /end MEASUREMENT
/begin COMPU_METHOD Compu_fault_maxact_pct50 " " RAT_FUNC "%.1" "%" COEFFS 0 163.84 0 0 0 1 /end COMPU_METHOD
/begin MEASUREMENT fault_maxact_pct51 "Max active percent 51" UWORD Compu_fault_maxact_pct51 0 0 0 399.993896484375 ECU_ADDRESS 0x01012388 /end MEASUREMENT
/begin COMPU_METHOD Compu_fault_maxact_pct51 " " RAT_FUNC "%.1" "%" COEFFS 0 163.84 0 0 0 1 /end COMPU_METHOD
/begin MEASUREMENT fault_maxact_pct52 "Max active percent 52" UWORD Compu_fault_maxact_pct52 0 0 0 399.993896484375 ECU_ADDRESS 0x01012390 /end MEASUREMENT
/begin COMPU_METHOD Compu_fault_maxact_pct52 " " RAT_FUNC "%.1" "%" COEFFS 0 163.84 0 0 0 1 /end COMPU_METHOD
/begin MEASUREMENT fault_maxact_pct53 "Max active percent 53" UWORD Compu_fault_maxact_pct53 0 0 0 399.993896484375 ECU_ADDRESS 0x01012398 /end MEASUREMENT
/begin COMPU_METHOD Compu_fault_maxact_pct53 " " RAT_FUNC "%.1" "%" COEFFS 0 163.84 0 0 0 1 /end COMPU_METHOD
/begin MEASUREMENT fault_maxact_pct54 "Max active percent 54" UWORD Compu_fault_maxact_pct54 0 0 0 399.993896484375 ECU_ADDRESS 0x010123A0 /end MEASUREMENT
/begin COMPU_METHOD Compu_fault_maxact_pct54 " " RAT_FUNC "%.1" "%" COEFFS 0 163.84 0 0 0 1 /end COMPU_METHOD
/begin MEASUREMENT fault_maxact_pct55 "Max active percent 55" UWORD Compu_fault_maxact_pct55 0 0 0 399.993896484375 ECU_ADDRESS 0x010123A8 /end MEASUREMENT
/begin COMPU_METHOD Compu_fault_maxact_pct55 " " RAT_FUNC "%.1" "%" COEFFS 0 163.84 0 0 0 1 /end COMPU_METHOD
/begin MEASUREMENT fault_maxact_pct56 "Max active percent 56" UWORD Compu_fault_maxact_pct56 0 0 0 399.993896484375 ECU_ADDRESS 0x010123B0 /end MEASUREMENT
/begin COMPU_METHOD Compu_fault_maxact_pct56 " " RAT_FUNC "%.1" "%" COEFFS 0 163.84 0 0 0 1 /end COMPU_METHOD
/begin MEASUREMENT fault_maxact_pct57 "Max active percent 57" UWORD Compu_fault_maxact_pct57 0 0 0 399.993896484375 ECU_ADDRESS 0x010123B8 /end MEASUREMENT
/begin COMPU_METHOD Compu_fault_maxact_pct57 " " RAT_FUNC "%.1" "%" COEFFS 0 163.84 0 0 0 1 /end COMPU_METHOD
/begin MEASUREMENT fault_maxact_pct58 "Max active percent 58" UWORD Compu_fault_maxact_pct58 0 0 0 399.993896484375 ECU_ADDRESS 0x010123C0 /end MEASUREMENT
/begin COMPU_METHOD Compu_fault_maxact_pct58 " " RAT_FUNC "%.1" "%" COEFFS 0 163.84 0 0 0 1 /end COMPU_METHOD
/begin MEASUREMENT fault_maxact_pct59 "Max active percent 59" UWORD Compu_fault_maxact_pct59 0 0 0 399.993896484375 ECU_ADDRESS 0x010123C8 /end MEASUREMENT
/begin COMPU_METHOD Compu_fault_maxact_pct59 " " RAT_FUNC "%.1" "%" COEFFS 0 163.84 0 0 0 1 /end COMPU_METHOD
/begin MEASUREMENT fault_maxact_flt30 "Max active fault 30" UWORD Compu_fault_maxact_flt30 0 0 0 65535 ECU_ADDRESS 0x010123D0 /end MEASUREMENT
/begin COMPU_METHOD Compu_fault_maxact_flt30 " " RAT_FUNC "%.0" "fault index" COEFFS 0 1 0 0 0 1 /end COMPU_METHOD
/begin MEASUREMENT fault_maxact_flt31 "Max active fault 31" UWORD Compu_fault_maxact_flt31 0 0 0 65535 ECU_ADDRESS 0x010123D8 /end MEASUREMENT
/begin COMPU_METHOD Compu_fault_maxact_flt31 " " RAT_FUNC "%.0" "fault index" COEFFS 0 1 0 0 0 1 /end COMPU_METHOD
/begin MEASUREMENT fault_maxact_flt32 "Max active fault 32" UWORD Compu_fault_maxact_flt32 0 0 0 65535 ECU_ADDRESS 0x010123E0 /end MEASUREMENT
/begin COMPU_METHOD Compu_fault_maxact_flt32 " " RAT_FUNC "%.0" "fault index" COEFFS 0 1 0 0 0 1 /end COMPU_METHOD
/begin MEASUREMENT fault_maxact_flt33 "Max active fault 33" UWORD Compu_fault_maxact_flt33 0 0 0 65535 ECU_ADDRESS 0x010123E8 /end MEASUREMENT
/begin COMPU_METHOD Compu_fault_maxact_flt33 " " RAT_FUNC "%.0" "fault index" COEFFS 0 1 0 0 0 1 /end COMPU_METHOD
/begin MEASUREMENT fault_maxact_flt34 "Max active fault 34" UWORD Compu_fault_maxact_flt34 0 0 0 65535 ECU_ADDRESS 0x010123F0 /end MEASUREMENT
/begin COMPU_METHOD Compu_fault_maxact_flt34 " " RAT_FUNC "%.0" "fault index" COEFFS 0 1 0 0 0 1 /end COMPU_METHOD
/begin MEASUREMENT fault_maxact_flt35 "Max active fault 35" UWORD Compu_fault_maxact_flt35 0 0 0 65535 ECU_ADDRESS 0x010123F8 /end MEASUREMENT
/begin COMPU_METHOD Compu_fault_maxact_flt35 " " RAT_FUNC "%.0" "fault index" COEFFS 0 1 0 0 0 1 /end COMPU_METHOD
/begin MEASUREMENT fault_maxact_flt36 "Max active fault 36" UWORD Compu_fault_maxact_flt36 0 0 0 65535 ECU_ADDRESS 0x01012400 /end MEASUREMENT
/begin COMPU_METHOD Compu_fault_maxact_flt36 " " RAT_FUNC "%.0" "fault index" COEFFS 0 1 0 0 0 1 /end COMPU_METHOD
/begin MEASUREMENT fault_maxact_flt37 "Max active fault 37" UWORD Compu_fault_maxact_flt37 0 0 0 65535 ECU_ADDRESS 0x01012408 /end MEASUREMENT
/begin COMPU_METHOD Compu_fault_maxact_flt37 " " RAT_FUNC "%.0" "fault index" COEFFS 0 1 0 0 0 1 /end COMPU_METHOD
/begin MEASUREMENT fault_maxact_flt38 "Max active fault 38" UWORD Compu_fault_maxact_flt38 0 0 0 65535 ECU_ADDRESS 0x01012410 /end MEASUREMENT
/begin COMPU_METHOD Compu_fault_maxact_flt38 " " RAT_FUNC "%.0" "fault index" COEFFS 0 1 0 0 0 1 /end COMPU_METHOD
/begin MEASUREMENT fault_maxact_flt39 "Max active fault 39" UWORD Compu_fault_maxact_flt39 0 0 0 65535 ECU_ADDRESS 0x01012418 /end MEASUREMENT
/begin COMPU_METHOD Compu_fault_maxact_flt39 " " RAT_FUNC "%.0" "fault index" COEFFS 0 1 0 0 0 1 /end COMPU_METHOD
/begin MEASUREMENT fault_maxact_flt40 "Max active fault 40" UWORD Compu_fault_maxact_flt40 0 0 0 65535 ECU_ADDRESS 0x01012420 /end MEASUREMENT
/begin COMPU_METHOD Compu_fault_maxact_flt40 " " RAT_FUNC "%.0" "fault index" COEFFS 0 1 0 0 0 1 /end COMPU_METHOD
/begin MEASUREMENT fault_maxact_flt41 "Max active fault 41" UWORD Compu_fault_maxact_flt41 0 0 0 65535 ECU_ADDRESS 0x01012428 /end MEASUREMENT
/begin COMPU_METHOD Compu_fault_maxact_flt41 " " RAT_FUNC "%.0" "fault index" COEFFS 0 1 0 0 0 1 /end COMPU_METHOD
/begin MEASUREMENT fault_maxact_flt42 "Max active fault 42" UWORD Compu_fault_maxact_flt42 0 0 0 65535 ECU_ADDRESS 0x01012430 /end MEASUREMENT
/begin COMPU_METHOD Compu_fault_maxact_flt42 " " RAT_FUNC "%.0" "fault index" COEFFS 0 1 0 0 0 1 /end COMPU_METHOD
/begin MEASUREMENT fault_maxact_flt43 "Max active fault 43" UWORD Compu_fault_maxact_flt43 0 0 0 65535 ECU_ADDRESS 0x01012438 /end MEASUREMENT
/begin COMPU_METHOD Compu_fault_maxact_flt43 " " RAT_FUNC "%.0" "fault index" COEFFS 0 1 0 0 0 1 /end COMPU_METHOD
/begin MEASUREMENT fault_maxact_flt44 "Max active fault 44" UWORD Compu_fault_maxact_flt44 0 0 0 65535 ECU_ADDRESS 0x01012440 /end MEASUREMENT
/begin COMPU_METHOD Compu_fault_maxact_flt44 " " RAT_FUNC "%.0" "fault index" COEFFS 0 1 0 0 0 1 /end COMPU_METHOD
/begin MEASUREMENT fault_maxact_flt45 "Max active fault 45" UWORD Compu_fault_maxact_flt45 0 0 0 65535 ECU_ADDRESS 0x01012448 /end MEASUREMENT
/begin COMPU_METHOD Compu_fault_maxact_flt45 " " RAT_FUNC "%.0" "fault index" COEFFS 0 1 0 0 0 1 /end COMPU_METHOD
/begin MEASUREMENT fault_maxact_flt46 "Max active fault 46" UWORD Compu_fault_maxact_flt46 0 0 0 65535 ECU_ADDRESS 0x01012450 /end MEASUREMENT
/begin COMPU_METHOD Compu_fault_maxact_flt46 " " RAT_FUNC "%.0" "fault index" COEFFS 0 1 0 0 0 1 /end COMPU_METHOD
/begin MEASUREMENT fault_maxact_flt47 "Max active fault 47" UWORD Compu_fault_maxact_flt47 0 0 0 65535 ECU_ADDRESS 0x01012458 /end MEASUREMENT
/begin COMPU_METHOD Compu_fault_maxact_flt47 " " RAT_FUNC "%.0" "fault index" COEFFS 0 1 0 0 0 1 /end COMPU_METHOD
/begin MEASUREMENT fault_maxact_flt48 "Max active fault 48" UWORD Compu_fault_maxact_flt48 0 0 0 65535 ECU_ADDRESS 0x01012460 /end MEASUREMENT
/begin COMPU_METHOD Compu_fault_maxact_flt48 " " RAT_FUNC "%.0" "fault index" COEFFS 0 1 0 0 0 1 /end COMPU_METHOD
/begin MEASUREMENT fault_maxact_flt49 "Max active fault 49" UWORD Compu_fault_maxact_flt49 0 0 0 65535 ECU_ADDRESS 0x01012468 /end MEASUREMENT
/begin COMPU_METHOD Compu_fault_maxact_flt49 " " RAT_FUNC "%.0" "fault index" COEFFS 0 1 0 0 0 1 /end COMPU_METHOD
/begin MEASUREMENT fault_maxact_flt50 "Max active fault 50" UWORD Compu_fault_maxact_flt50 0 0 0 65535 ECU_ADDRESS 0x01012470 /end MEASUREMENT
/begin COMPU_METHOD Compu_fault_maxact_flt50 " " RAT_FUNC "%.0" "fault index" COEFFS 0 1 0 0 0 1 /end COMPU_METHOD
/begin MEASUREMENT fault_maxact_flt51 "Max active fault 51" UWORD Compu_fault_maxact_flt51 0 0 0 65535 ECU_ADDRESS 0x01012478 /end MEASUREMENT
/begin COMPU_METHOD Compu_fault_maxact_flt51 " " RAT_FUNC "%.0" "fault index" COEFFS 0 1 0 0 0 1 /end COMPU_METHOD
/begin MEASUREMENT fault_maxact_flt52 "Max active fault 52" UWORD Compu_fault_maxact_flt52 0 0 0 65535 ECU_ADDRESS 0x01012480 /end MEASUREMENT
/begin COMPU_METHOD Compu_fault_maxact_flt52 " " RAT_FUNC "%.0" "fault index" COEFFS 0 1 0 0 0 1 /end COMPU_METHOD
/begin MEASUREMENT fault_maxact_flt53 "Max active fault 53" UWORD Compu_fault_maxact_flt53 0 0 0 65535 ECU_ADDRESS 0x01012488 /end MEASUREMENT
/begin COMPU_METHOD Compu_fault_maxact_flt53 " " RAT_FUNC "%.0" "fault index" COEFFS 0 1 0 0 0 1 /end COMPU_METHOD
/begin MEASUREMENT fault_maxact_flt54 "Max active fault 54" UWORD Compu_fault_maxact_flt54 0 0 0 65535 ECU_ADDRESS 0x01012490 /end MEASUREMENT
/begin COMPU_METHOD Compu_fault_maxact_flt54 " " RAT_FUNC "%.0" "fault index" COEFFS 0 1 0 0 0 1 /end COMPU_METHOD
/begin MEASUREMENT fault_maxact_flt55 "Max active fault 55" UWORD Compu_fault_maxact_flt55 0 0 0 65535 ECU_ADDRESS 0x01012498 /end MEASUREMENT
/begin COMPU_METHOD Compu_fault_maxact_flt55 " " RAT_FUNC "%.0" "fault index" COEFFS 0 1 0 0 0 1 /end COMPU_METHOD
/begin MEASUREMENT fault_maxact_flt56 "Max active fault 56" UWORD Compu_fault_maxact_flt56 0 0 0 65535 ECU_ADDRESS 0x010124A0 /end MEASUREMENT
/begin COMPU_METHOD Compu_fault_maxact_flt56 " " RAT_FUNC "%.0" "fault index" COEFFS 0 1 0 0 0 1 /end COMPU_METHOD
/begin MEASUREMENT fault_maxact_flt57 "Max active fault 57" UWORD Compu_fault_maxact_flt57 0 0 0 65535 ECU_ADDRESS 0x010124A8 /end MEASUREMENT
/begin COMPU_METHOD Compu_fault_maxact_flt57 " " RAT_FUNC "%.0" "fault index" COEFFS 0 1 0 0 0 1 /end COMPU_METHOD
/begin MEASUREMENT fault_maxact_flt58 "Max active fault 58" UWORD Compu_fault_maxact_flt58 0 0 0 65535 ECU_ADDRESS 0x010124B0 /end MEASUREMENT
/begin COMPU_METHOD Compu_fault_maxact_flt58 " " RAT_FUNC "%.0" "fault index" COEFFS 0 1 0 0 0 1 /end COMPU_METHOD
/begin MEASUREMENT fault_maxact_flt59 "Max active fault 59" UWORD Compu_fault_maxact_flt59 0 0 0 65535 ECU_ADDRESS 0x010124B8 /end MEASUREMENT
/begin COMPU_METHOD Compu_fault_maxact_flt59 " " RAT_FUNC "%.0" "fault index" COEFFS 0 1 0 0 0 1 /end COMPU_METHOD
/begin MEASUREMENT fault_maxact_pctmin "Table entry minimum latch" UWORD Compu_fault_maxact_pctmin 0 0 0 399.993896484375 ECU_ADDRESS 0x010124C0 /end MEASUREMENT
/begin COMPU_METHOD Compu_fault_maxact_pctmin " " RAT_FUNC "%.1" "%" COEFFS 0 163.84 0 0 0 1 /end COMPU_METHOD
/begin CHARACTERISTIC EGRdP_HiExp_tbl_pct "EGRdP higher fault margin" VALUE 0x001c09e6 /* @ECU_Address@EGRdP_HiExp_tbl_pct@0x01012718@ */ ECIPP_ALIGNMENT_UWORD 400 Compu_EGRdP_HiExp_tbl_pct 0 399.993896484375 /end CHARACTERISTIC
/begin COMPU_METHOD Compu_EGRdP_HiExp_tbl_pct " " RAT_FUNC "%.1" "%" COEFFS 0 163.84 0 0 0 1 /end COMPU_METHOD
/begin CHARACTERISTIC EGRdP_HiExp_dP_min "EGRdP higher fault dP min" VALUE 0x001c02a8 /* @ECU_Address@EGRdP_HiExp_dP_min@0x01012728@ */ ECIPP_ALIGNMENT_SWORD 32 Compu_EGRdP_HiExp_dP_min -32 31.9990234375 /end CHARACTERISTIC
/begin COMPU_METHOD Compu_EGRdP_HiExp_dP_min " " RAT_FUNC "%.3" "psi" COEFFS 0 1024 0 0 0 1 /end COMPU_METHOD
/begin MEASUREMENT EGRdP_wdw_dz_lp "EGRdP windowed, deadzoned, and low-passed" SWORD Compu_EGRdP_wdw_dz_lp 0 0 -32 31.9990234375 ECU_ADDRESS 0x01012998 /end MEASUREMENT
/begin COMPU_METHOD Compu_EGRdP_wdw_dz_lp " " RAT_FUNC "%.3" "psi" COEFFS 0 1024 0 0 0 1 /end COMPU_METHOD
/begin MEASUREMENT EGRHP_wdw_dz_lp "EGRHP windowed, deadzoned, and low-passed" FLOAT32_IEEE Compu_EGRHP_wdw_dz_lp 0 0 -10000000000 10000000000 ECU_ADDRESS 0x010129A0 /end MEASUREMENT
/begin COMPU_METHOD Compu_EGRHP_wdw_dz_lp " " RAT_FUNC "%.2" "psia" COEFFS 0 1 0 0 0 1 /end COMPU_METHOD
/begin MEASUREMENT EGRHP_mdl_float "EGRHP modeled" FLOAT32_IEEE Compu_EGRHP_mdl_float 0 0 -10000000000 10000000000 ECU_ADDRESS 0x010129A8 /end MEASUREMENT
/begin COMPU_METHOD Compu_EGRHP_mdl_float " " RAT_FUNC "%.2" "psia" COEFFS 0 1 0 0 0 1 /end COMPU_METHOD
/begin MEASUREMENT RTC_sec_epoch "Current date/time" ULONG Compu_RTC_sec_epoch 0 0 951868672 9004932350.125 ECU_ADDRESS 0x010134C8 /end MEASUREMENT
/begin COMPU_METHOD Compu_RTC_sec_epoch " " RAT_FUNC "%.0" "-" COEFFS 0 0.533333333333333 -507663291.733333 0 0 1 /end COMPU_METHOD
/begin MEASUREMENT TRAT_engstop_rtc "Last engine stop date/time" ULONG Compu_TRAT_engstop_rtc 0 0 951868672 9004932350.125 ECU_ADDRESS 0x010134D0 /end MEASUREMENT
/begin COMPU_METHOD Compu_TRAT_engstop_rtc " " RAT_FUNC "%.0" "-" COEFFS 0 0.533333333333333 -507663291.733333 0 0 1 /end COMPU_METHOD
/begin MEASUREMENT TRAT_state "Temperature rationality state{TRAT_state&0xff=0:Disabled}{TRAT_state&0xff=1:Armed}{TRAT_state&0xff=10:Enabled}{TRAT_state&0xff=11:Active: crank delay}{TRAT_state&0xff=12:Active: sampling}{TRAT_state&0xff=13:Active: awaiting diagnostics}{TRAT_state&0xff=20" UBYTE TRAT_state_COMPU_VTAB 0 0 0 255 ECU_ADDRESS 0x010134E0 BIT_MASK 0xff /end MEASUREMENT
/begin COMPU_METHOD TRAT_state_COMPU_VTAB "Verbal Table" TAB_VERB "%.0" "list" COMPU_TAB_REF TRAT_state_COMPU_VTAB_REF /end COMPU_METHOD
/begin COMPU_VTAB TRAT_state_COMPU_VTAB_REF "Verbal Table" TAB_VERB 16 0 "Disabled" 1 "Armed" 10 "Enabled" 11 "Active: crank delay" 12 "Active: sampling" 13 "Active: awaiting diagnostics" 20 "Inactive: key off" 21 "Inactive: insufficient cooling time" 22 "Inactive: AAT low" 23 "Inactive: AAT unavailable" 30 "Inactive: crank time limit" 31 "Inactive for key cycle" 32 "Complete" 40 "Failed: out of range" 41 "Failed: ECT out of range" 42 "Diagnostics failed" DEFAULT_VALUE "UNKNOWN" /end COMPU_VTAB
/begin MEASUREMENT TRAT_tmr "Temperature rationality timer" UWORD Compu_TRAT_tmr 0 0 0 65.535 ECU_ADDRESS 0x010134E8 /end MEASUREMENT
/begin COMPU_METHOD Compu_TRAT_tmr " " RAT_FUNC "%.1" "-" COEFFS 0 1000 0 0 0 1 /end COMPU_METHOD
/begin MEASUREMENT TRAT_ECT_state "Temp. rationality ECT sampling state{TRAT_ECT_state&0xff=0:Disabled}{TRAT_ECT_state&0xff=1:Sampling}{TRAT_ECT_state&0xff=2:Awaiting diagnostics}{TRAT_ECT_state&0xff=10:Inactive}{TRAT_ECT_state&0xff=11:Aborted}{TRAT_ECT_state&0xff=12:Diagnostics failed}{TR" UBYTE TRAT_ECT_state_COMPU_VTAB 0 0 0 255 ECU_ADDRESS 0x01013508 BIT_MASK 0xff /end MEASUREMENT
/begin COMPU_METHOD TRAT_ECT_state_COMPU_VTAB "Verbal Table" TAB_VERB "%.0" "list" COMPU_TAB_REF TRAT_ECT_state_COMPU_VTAB_REF /end COMPU_METHOD
/begin COMPU_VTAB TRAT_ECT_state_COMPU_VTAB_REF "Verbal Table" TAB_VERB 9 0 "Disabled" 1 "Sampling" 2 "Awaiting diagnostics" 10 "Inactive" 11 "Aborted" 12 "Diagnostics failed" 13 "Out of range" 14 "Complete" 15 "Sampling time expired" DEFAULT_VALUE "UNKNOWN" /end COMPU_VTAB
/begin MEASUREMENT TRAT_ECT_avg "Temp. rationality ECT average" UWORD Compu_TRAT_ECT_avg 0 0 -460 563.984375 ECU_ADDRESS 0x01013510 /end MEASUREMENT
/begin COMPU_METHOD Compu_TRAT_ECT_avg " " RAT_FUNC "%.1" "-" COEFFS 0 64 29440 0 0 1 /end COMPU_METHOD
/begin MEASUREMENT TRAT_IAT_state "Temp. rationality IAT sampling state{TRAT_IAT_state&0xff=0:Disabled}{TRAT_IAT_state&0xff=1:Sampling}{TRAT_IAT_state&0xff=2:Awaiting diagnostics}{TRAT_IAT_state&0xff=10:Inactive}{TRAT_IAT_state&0xff=11:Aborted}{TRAT_IAT_state&0xff=12:Diagnostics failed}{TR" UBYTE TRAT_IAT_state_COMPU_VTAB 0 0 0 255 ECU_ADDRESS 0x01013520 BIT_MASK 0xff /end MEASUREMENT
/begin COMPU_METHOD TRAT_IAT_state_COMPU_VTAB "Verbal Table" TAB_VERB "%.0" "list" COMPU_TAB_REF TRAT_IAT_state_COMPU_VTAB_REF /end COMPU_METHOD
/begin COMPU_VTAB TRAT_IAT_state_COMPU_VTAB_REF "Verbal Table" TAB_VERB 9 0 "Disabled" 1 "Sampling" 2 "Awaiting diagnostics" 10 "Inactive" 11 "Aborted" 12 "Diagnostics failed" 13 "Out of range" 14 "Complete" 15 "Sampling time expired" DEFAULT_VALUE "UNKNOWN" /end COMPU_VTAB
/begin MEASUREMENT TRAT_IAT_avg "Temp. rationality IAT average" UWORD Compu_TRAT_IAT_avg 0 0 -460 563.984375 ECU_ADDRESS 0x01013528 /end MEASUREMENT
/begin COMPU_METHOD Compu_TRAT_IAT_avg " " RAT_FUNC "%.1" "-" COEFFS 0 64 29440 0 0 1 /end COMPU_METHOD
/begin MEASUREMENT TRAT_AAT_state "Temp. rationality AAT sampling state{TRAT_AAT_state&0xff=0:Disabled}{TRAT_AAT_state&0xff=1:Sampling}{TRAT_AAT_state&0xff=2:Awaiting diagnostics}{TRAT_AAT_state&0xff=10:Inactive}{TRAT_AAT_state&0xff=11:Aborted}{TRAT_AAT_state&0xff=12:Diagnostics failed}{TR" UBYTE TRAT_AAT_state_COMPU_VTAB 0 0 0 255 ECU_ADDRESS 0x01013538 BIT_MASK 0xff /end MEASUREMENT
/begin COMPU_METHOD TRAT_AAT_state_COMPU_VTAB "Verbal Table" TAB_VERB "%.0" "list" COMPU_TAB_REF TRAT_AAT_state_COMPU_VTAB_REF /end COMPU_METHOD
/begin COMPU_VTAB TRAT_AAT_state_COMPU_VTAB_REF "Verbal Table" TAB_VERB 9 0 "Disabled" 1 "Sampling" 2 "Awaiting diagnostics" 10 "Inactive" 11 "Aborted" 12 "Diagnostics failed" 13 "Out of range" 14 "Complete" 15 "Sampling time expired" DEFAULT_VALUE "UNKNOWN" /end COMPU_VTAB
/begin MEASUREMENT TRAT_AAT_avg "Temp. rationality AAT average" UWORD Compu_TRAT_AAT_avg 0 0 -460 563.984375 ECU_ADDRESS 0x01013540 /end MEASUREMENT
/begin COMPU_METHOD Compu_TRAT_AAT_avg " " RAT_FUNC "%.1" "-" COEFFS 0 64 29440 0 0 1 /end COMPU_METHOD
/begin MEASUREMENT TRAT_EGRT_state "Temp. rationality EGRT sampling state{TRAT_EGRT_state&0xff=0:Disabled}{TRAT_EGRT_state&0xff=1:Sampling}{TRAT_EGRT_state&0xff=2:Awaiting diagnostics}{TRAT_EGRT_state&0xff=10:Inactive}{TRAT_EGRT_state&0xff=11:Aborted}{TRAT_EGRT_state&0xff=12:Diagnostics fai" UBYTE TRAT_EGRT_state_COMPU_VTAB 0 0 0 255 ECU_ADDRESS 0x01013550 BIT_MASK 0xff /end MEASUREMENT
/begin COMPU_METHOD TRAT_EGRT_state_COMPU_VTAB "Verbal Table" TAB_VERB "%.0" "list" COMPU_TAB_REF TRAT_EGRT_state_COMPU_VTAB_REF /end COMPU_METHOD
/begin COMPU_VTAB TRAT_EGRT_state_COMPU_VTAB_REF "Verbal Table" TAB_VERB 9 0 "Disabled" 1 "Sampling" 2 "Awaiting diagnostics" 10 "Inactive" 11 "Aborted" 12 "Diagnostics failed" 13 "Out of range" 14 "Complete" 15 "Sampling time expired" DEFAULT_VALUE "UNKNOWN" /end COMPU_VTAB
/begin MEASUREMENT TRAT_EGRT_avg "Temp. rationality EGRT average" UWORD Compu_TRAT_EGRT_avg 0 0 -460 7731.875 ECU_ADDRESS 0x01013558 /end MEASUREMENT
/begin COMPU_METHOD Compu_TRAT_EGRT_avg " " RAT_FUNC "%.1" "-" COEFFS 0 8 3680 0 0 1 /end COMPU_METHOD
/begin MEASUREMENT TRAT_FT_state "Temp. rationality FT sampling state{TRAT_FT_state&0xff=0:Disabled}{TRAT_FT_state&0xff=1:Sampling}{TRAT_FT_state&0xff=2:Awaiting diagnostics}{TRAT_FT_state&0xff=10:Inactive}{TRAT_FT_state&0xff=11:Aborted}{TRAT_FT_state&0xff=12:Diagnostics failed}{TRAT_FT_s" UBYTE TRAT_FT_state_COMPU_VTAB 0 0 0 255 ECU_ADDRESS 0x01013568 BIT_MASK 0xff /end MEASUREMENT
/begin COMPU_METHOD TRAT_FT_state_COMPU_VTAB "Verbal Table" TAB_VERB "%.0" "list" COMPU_TAB_REF TRAT_FT_state_COMPU_VTAB_REF /end COMPU_METHOD
/begin COMPU_VTAB TRAT_FT_state_COMPU_VTAB_REF "Verbal Table" TAB_VERB 9 0 "Disabled" 1 "Sampling" 2 "Awaiting diagnostics" 10 "Inactive" 11 "Aborted" 12 "Diagnostics failed" 13 "Out of range" 14 "Complete" 15 "Sampling time expired" DEFAULT_VALUE "UNKNOWN" /end COMPU_VTAB
/begin MEASUREMENT TRAT_FT_avg "Temp. rationality FT average" UWORD Compu_TRAT_FT_avg 0 0 -460 563.984375 ECU_ADDRESS 0x01013570 /end MEASUREMENT
/begin COMPU_METHOD Compu_TRAT_FT_avg " " RAT_FUNC "%.1" "-" COEFFS 0 64 29440 0 0 1 /end COMPU_METHOD
/begin MEASUREMENT TRAT_OILT_state "Temp. rationality OILT sampling state{TRAT_OILT_state&0xff=0:Disabled}{TRAT_OILT_state&0xff=1:Sampling}{TRAT_OILT_state&0xff=2:Awaiting diagnostics}{TRAT_OILT_state&0xff=10:Inactive}{TRAT_OILT_state&0xff=11:Aborted}{TRAT_OILT_state&0xff=12:Diagnostics fai" UBYTE TRAT_OILT_state_COMPU_VTAB 0 0 0 255 ECU_ADDRESS 0x01013580 BIT_MASK 0xff /end MEASUREMENT
/begin COMPU_METHOD TRAT_OILT_state_COMPU_VTAB "Verbal Table" TAB_VERB "%.0" "list" COMPU_TAB_REF TRAT_OILT_state_COMPU_VTAB_REF /end COMPU_METHOD
/begin COMPU_VTAB TRAT_OILT_state_COMPU_VTAB_REF "Verbal Table" TAB_VERB 9 0 "Disabled" 1 "Sampling" 2 "Awaiting diagnostics" 10 "Inactive" 11 "Aborted" 12 "Diagnostics failed" 13 "Out of range" 14 "Complete" 15 "Sampling time expired" DEFAULT_VALUE "UNKNOWN" /end COMPU_VTAB
/begin MEASUREMENT TRAT_OILT_avg "Temp. rationality OILT average" UWORD Compu_TRAT_OILT_avg 0 0 -460 7731.875 ECU_ADDRESS 0x01013588 /end MEASUREMENT
/begin COMPU_METHOD Compu_TRAT_OILT_avg " " RAT_FUNC "%.1" "-" COEFFS 0 8 3680 0 0 1 /end COMPU_METHOD
/begin MEASUREMENT TRAT_EGT_state "Temp. rationality EGT sampling state{TRAT_EGT_state&0xff=0:Disabled}{TRAT_EGT_state&0xff=1:Sampling}{TRAT_EGT_state&0xff=2:Awaiting diagnostics}{TRAT_EGT_state&0xff=10:Inactive}{TRAT_EGT_state&0xff=11:Aborted}{TRAT_EGT_state&0xff=12:Diagnostics failed}{TR" UBYTE TRAT_EGT_state_COMPU_VTAB 0 0 0 255 ECU_ADDRESS 0x01013598 BIT_MASK 0xff /end MEASUREMENT
/begin COMPU_METHOD TRAT_EGT_state_COMPU_VTAB "Verbal Table" TAB_VERB "%.0" "list" COMPU_TAB_REF TRAT_EGT_state_COMPU_VTAB_REF /end COMPU_METHOD
/begin COMPU_VTAB TRAT_EGT_state_COMPU_VTAB_REF "Verbal Table" TAB_VERB 9 0 "Disabled" 1 "Sampling" 2 "Awaiting diagnostics" 10 "Inactive" 11 "Aborted" 12 "Diagnostics failed" 13 "Out of range" 14 "Complete" 15 "Sampling time expired" DEFAULT_VALUE "UNKNOWN" /end COMPU_VTAB
/begin MEASUREMENT TRAT_EGT_avg "Temp. rationality EGT average" UWORD Compu_TRAT_EGT_avg 0 0 -460 7731.875 ECU_ADDRESS 0x010135A0 /end MEASUREMENT
/begin COMPU_METHOD Compu_TRAT_EGT_avg " " RAT_FUNC "%.1" "-" COEFFS 0 8 3680 0 0 1 /end COMPU_METHOD
/begin MEASUREMENT TRAT_TIAT_state "Temp. rationality TIAT sampling state{TRAT_TIAT_state&0xff=0:Disabled}{TRAT_TIAT_state&0xff=1:Sampling}{TRAT_TIAT_state&0xff=2:Awaiting diagnostics}{TRAT_TIAT_state&0xff=10:Inactive}{TRAT_TIAT_state&0xff=11:Aborted}{TRAT_TIAT_state&0xff=12:Diagnostics fai" UBYTE TRAT_TIAT_state_COMPU_VTAB 0 0 0 255 ECU_ADDRESS 0x010135B0 BIT_MASK 0xff /end MEASUREMENT
/begin COMPU_METHOD TRAT_TIAT_state_COMPU_VTAB "Verbal Table" TAB_VERB "%.0" "list" COMPU_TAB_REF TRAT_TIAT_state_COMPU_VTAB_REF /end COMPU_METHOD
/begin COMPU_VTAB TRAT_TIAT_state_COMPU_VTAB_REF "Verbal Table" TAB_VERB 9 0 "Disabled" 1 "Sampling" 2 "Awaiting diagnostics" 10 "Inactive" 11 "Aborted" 12 "Diagnostics failed" 13 "Out of range" 14 "Complete" 15 "Sampling time expired" DEFAULT_VALUE "UNKNOWN" /end COMPU_VTAB
/begin MEASUREMENT TRAT_TIAT_avg "Temp. rationality TIAT average" UWORD Compu_TRAT_TIAT_avg 0 0 -460 7731.875 ECU_ADDRESS 0x010135B8 /end MEASUREMENT
/begin COMPU_METHOD Compu_TRAT_TIAT_avg " " RAT_FUNC "%.1" "-" COEFFS 0 8 3680 0 0 1 /end COMPU_METHOD
/begin CHARACTERISTIC TRAT_TAUX_n1 "Temp. rationality TAUX sensor #1 (Fault Condition:where AUX Temperature X is TAUX)" VALUE 0x001E9BE2 /* @ECU_Address@TRAT_TAUX_n1@0x010135C8@ */ ECIPP_ALIGNMENT_UBYTE 255 Compu_TRAT_TAUX_n1 1 256 /end CHARACTERISTIC
/begin COMPU_METHOD Compu_TRAT_TAUX_n1 " " RAT_FUNC "%.0" "-" COEFFS 0 1 -1 0 0 1 /end COMPU_METHOD
/begin MEASUREMENT TRAT_TAUX_n1_state "Temp. rationality TAUX #1 sampling state{TRAT_TAUX_n1_state&0xff=0:Disabled}{TRAT_TAUX_n1_state&0xff=1:Sampling}{TRAT_TAUX_n1_state&0xff=2:Awaiting diagnostics}{TRAT_TAUX_n1_state&0xff=10:Inactive}{TRAT_TAUX_n1_state&0xff=11:Aborted}{TRAT_TAUX_n1_state&0x" UBYTE TRAT_TAUX_n1_state_COMPU_VTAB 0 0 0 255 ECU_ADDRESS 0x010135D0 BIT_MASK 0xff /end MEASUREMENT
/begin COMPU_METHOD TRAT_TAUX_n1_state_COMPU_VTAB "Verbal Table" TAB_VERB "%.0" "list" COMPU_TAB_REF TRAT_TAUX_n1_state_COMPU_VTAB_REF /end COMPU_METHOD
/begin COMPU_VTAB TRAT_TAUX_n1_state_COMPU_VTAB_REF "Verbal Table" TAB_VERB 9 0 "Disabled" 1 "Sampling" 2 "Awaiting diagnostics" 10 "Inactive" 11 "Aborted" 12 "Diagnostics failed" 13 "Out of range" 14 "Complete" 15 "Sampling time expired" DEFAULT_VALUE "UNKNOWN" /end COMPU_VTAB
/begin MEASUREMENT TRAT_TAUX_n1_avg "Temp. rationality TAUX #1 average" UWORD Compu_TRAT_TAUX_n1_avg 0 0 -460 7731.875 ECU_ADDRESS 0x010135D8 /end MEASUREMENT
/begin COMPU_METHOD Compu_TRAT_TAUX_n1_avg " " RAT_FUNC "%.1" "-" COEFFS 0 8 3680 0 0 1 /end COMPU_METHOD
/begin CHARACTERISTIC TRAT_TAUX_n2 "Temp. rationality TAUX sensor #2 (Fault Condition:where AUX Temperature X is TAUX)" VALUE 0x001E9BE3 /* @ECU_Address@TRAT_TAUX_n2@0x010135E8@ */ ECIPP_ALIGNMENT_UBYTE 255 Compu_TRAT_TAUX_n2 1 256 /end CHARACTERISTIC
/begin COMPU_METHOD Compu_TRAT_TAUX_n2 " " RAT_FUNC "%.0" "-" COEFFS 0 1 -1 0 0 1 /end COMPU_METHOD
/begin MEASUREMENT TRAT_TAUX_n2_state "Temp. rationality TAUX #2 sampling state{TRAT_TAUX_n2_state&0xff=0:Disabled}{TRAT_TAUX_n2_state&0xff=1:Sampling}{TRAT_TAUX_n2_state&0xff=2:Awaiting diagnostics}{TRAT_TAUX_n2_state&0xff=10:Inactive}{TRAT_TAUX_n2_state&0xff=11:Aborted}{TRAT_TAUX_n2_state&0x" UBYTE TRAT_TAUX_n2_state_COMPU_VTAB 0 0 0 255 ECU_ADDRESS 0x010135F0 BIT_MASK 0xff /end MEASUREMENT
/begin COMPU_METHOD TRAT_TAUX_n2_state_COMPU_VTAB "Verbal Table" TAB_VERB "%.0" "list" COMPU_TAB_REF TRAT_TAUX_n2_state_COMPU_VTAB_REF /end COMPU_METHOD
/begin COMPU_VTAB TRAT_TAUX_n2_state_COMPU_VTAB_REF "Verbal Table" TAB_VERB 9 0 "Disabled" 1 "Sampling" 2 "Awaiting diagnostics" 10 "Inactive" 11 "Aborted" 12 "Diagnostics failed" 13 "Out of range" 14 "Complete" 15 "Sampling time expired" DEFAULT_VALUE "UNKNOWN" /end COMPU_VTAB
/begin MEASUREMENT TRAT_TAUX_n2_avg "Temp. rationality TAUX #2 average" UWORD Compu_TRAT_TAUX_n2_avg 0 0 -460 7731.875 ECU_ADDRESS 0x010135F8 /end MEASUREMENT
/begin COMPU_METHOD Compu_TRAT_TAUX_n2_avg " " RAT_FUNC "%.1" "-" COEFFS 0 8 3680 0 0 1 /end COMPU_METHOD
/begin CHARACTERISTIC DiagTempWUT_calc "Diag warm-up time calc method{DiagTempWUT_calc&0xff=0:Single Time Axis (legacy)}{DiagTempWUT_calc&0xff=1:Dual Time Axis (AAT-based)}" VALUE 0x001c86be /* @ECU_Address@DiagTempWUT_calc@0x01014820@ */ ECIPP_ALIGNMENT_UBYTE 255 DiagTempWUT_calc_COMPU_VTAB 0 255 BIT_MASK 0xff /end CHARACTERISTIC
/begin COMPU_METHOD DiagTempWUT_calc_COMPU_VTAB "Verbal Table" TAB_VERB "%.0" "list" COMPU_TAB_REF DiagTempWUT_calc_COMPU_VTAB_REF /end COMPU_METHOD
/begin COMPU_VTAB DiagTempWUT_calc_COMPU_VTAB_REF "Verbal Table" TAB_VERB 2 0 "Single Time Axis (legacy)" 1 "Dual Time Axis (AAT-based)" DEFAULT_VALUE "UNKNOWN" /end COMPU_VTAB
/begin CHARACTERISTIC FOP_detect_time "Fuel over pressure validation time" VALUE 0x001c6f72 /* @ECU_Address@FOP_detect_time@0x010148B8@ */ ECIPP_ALIGNMENT_UWORD 65535 Compu_FOP_detect_time 0 65535 /end CHARACTERISTIC
/begin COMPU_METHOD Compu_FOP_detect_time " " RAT_FUNC "%.0" "ms" COEFFS 0 1 0 0 0 1 /end COMPU_METHOD
/begin CHARACTERISTIC FOP_MJ_P_act_lmt "Fuel over pressure EPR feedback lmt (Fault Condition:EPR feedback pressure >)" VALUE 0x001c44d4 /* @ECU_Address@FOP_MJ_P_act_lmt@0x010148C0@ */ ECIPP_ALIGNMENT_SWORD 222 Compu_FOP_MJ_P_act_lmt -222 221.993225097656 /end CHARACTERISTIC
/begin COMPU_METHOD Compu_FOP_MJ_P_act_lmt " " RAT_FUNC "%.1" "in H2O" COEFFS 0 147.603603603604 0 0 0 1 /end COMPU_METHOD
/begin MEASUREMENT FOP_inhibit_active "Fuel over pressure inhibit active" UBYTE Compu_FOP_inhibit_active 0 0 0 255 ECU_ADDRESS 0x010148C8 /end MEASUREMENT
/begin COMPU_METHOD Compu_FOP_inhibit_active " " RAT_FUNC "%.0" "-" COEFFS 0 1 0 0 0 1 /end COMPU_METHOD
/begin MEASUREMENT SD_trigger_ndx "Shutdown trigger fault index" UWORD Compu_SD_trigger_ndx 0 0 0 65535 ECU_ADDRESS 0x01014918 /end MEASUREMENT
/begin COMPU_METHOD Compu_SD_trigger_ndx " " RAT_FUNC "%.0" "-" COEFFS 0 1 0 0 0 1 /end COMPU_METHOD
/begin MEASUREMENT SD_trigger_SPN "Shutdown trigger SPN" ULONG Compu_SD_trigger_SPN 0 0 0 4294967295 ECU_ADDRESS 0x01014920 /end MEASUREMENT
/begin COMPU_METHOD Compu_SD_trigger_SPN " " RAT_FUNC "%.0" "-" COEFFS 0 1 0 0 0 1 /end COMPU_METHOD
/begin MEASUREMENT SD_trigger_FMI "Shutdown trigger FMI" UBYTE Compu_SD_trigger_FMI 0 0 0 255 ECU_ADDRESS 0x01014928 /end MEASUREMENT
/begin COMPU_METHOD Compu_SD_trigger_FMI " " RAT_FUNC "%.0" "-" COEFFS 0 1 0 0 0 1 /end COMPU_METHOD
/begin MEASUREMENT SD_trigger_SA "Shutdown trigger SA" UBYTE Compu_SD_trigger_SA 0 0 0 255 ECU_ADDRESS 0x01014930 /end MEASUREMENT
/begin COMPU_METHOD Compu_SD_trigger_SA " " RAT_FUNC "%.0" "-" COEFFS 0 1 0 0 0 1 /end COMPU_METHOD
/begin MEASUREMENT dwell11 "Coil11 dwell" UWORD Compu_dwell11 0 0 0 209.712 ECU_ADDRESS 0x01014AF0 /end MEASUREMENT
/begin COMPU_METHOD Compu_dwell11 " " RAT_FUNC "%.2" "ms" COEFFS 0 312.5 0 0 0 1 /end COMPU_METHOD
/begin MEASUREMENT dwell12 "Coil12 dwell" UWORD Compu_dwell12 0 0 0 209.712 ECU_ADDRESS 0x01014AF8 /end MEASUREMENT
/begin COMPU_METHOD Compu_dwell12 " " RAT_FUNC "%.2" "ms" COEFFS 0 312.5 0 0 0 1 /end COMPU_METHOD
/begin MEASUREMENT inj11_off_samp "11" UWORD Compu_inj11_off_samp 0 0 0 55.0125915750916 ECU_ADDRESS 0x01014BA0 /end MEASUREMENT
/begin COMPU_METHOD Compu_inj11_off_samp " " RAT_FUNC "%.1" "volts" COEFFS 0 1191.27272727273 0 0 0 1 /end COMPU_METHOD
/begin MEASUREMENT inj12_off_samp "12" UWORD Compu_inj12_off_samp 0 0 0 55.0125915750916 ECU_ADDRESS 0x01014BA8 /end MEASUREMENT
/begin COMPU_METHOD Compu_inj12_off_samp " " RAT_FUNC "%.1" "volts" COEFFS 0 1191.27272727273 0 0 0 1 /end COMPU_METHOD
/begin MEASUREMENT inj11_on_samp "11" UWORD Compu_inj11_on_samp 0 0 0 55.0125915750916 ECU_ADDRESS 0x01014BB0 /end MEASUREMENT
/begin COMPU_METHOD Compu_inj11_on_samp " " RAT_FUNC "%.1" "volts" COEFFS 0 1191.27272727273 0 0 0 1 /end COMPU_METHOD
/begin MEASUREMENT inj12_on_samp "12" UWORD Compu_inj12_on_samp 0 0 0 55.0125915750916 ECU_ADDRESS 0x01014BB8 /end MEASUREMENT
/begin COMPU_METHOD Compu_inj12_on_samp " " RAT_FUNC "%.1" "volts" COEFFS 0 1191.27272727273 0 0 0 1 /end COMPU_METHOD
/begin MEASUREMENT MAPdt_windowed "Cylinder-event averaged MAPdt" SWORD Compu_MAPdt_windowed 0 0 -4000 3999.8779296875 ECU_ADDRESS 0x01014D00 /end MEASUREMENT
/begin COMPU_METHOD Compu_MAPdt_windowed " " RAT_FUNC "%.1" "psi/sec" COEFFS 0 8.192 0 0 0 1 /end COMPU_METHOD
/begin CHARACTERISTIC MAPdt_global_filt "MAPdt global filter method{MAPdt_global_filt&0xff=0:Default}{MAPdt_global_filt&0xff=1:Cylinder Windowed}" VALUE 0x001c881c /* @ECU_Address@MAPdt_global_filt@0x01014D08@ */ ECIPP_ALIGNMENT_UBYTE 255 MAPdt_global_filt_COMPU_VTAB 0 255 BIT_MASK 0xff /end CHARACTERISTIC
/begin COMPU_METHOD MAPdt_global_filt_COMPU_VTAB "Verbal Table" TAB_VERB "%.0" "list" COMPU_TAB_REF MAPdt_global_filt_COMPU_VTAB_REF /end COMPU_METHOD
/begin COMPU_VTAB MAPdt_global_filt_COMPU_VTAB_REF "Verbal Table" TAB_VERB 2 0 "Default" 1 "Cylinder Windowed" DEFAULT_VALUE "UNKNOWN" /end COMPU_VTAB
/begin CHARACTERISTIC MAP_TIP_win_calc "MAP/TIP cylinder window calculation{MAP_TIP_win_calc&0xff=0:Single Window}{MAP_TIP_win_calc&0xff=1:Dual Windows}" VALUE 0x001c8813 /* @ECU_Address@MAP_TIP_win_calc@0x01014D10@ */ ECIPP_ALIGNMENT_UBYTE 255 MAP_TIP_win_calc_COMPU_VTAB 0 255 BIT_MASK 0xff /end CHARACTERISTIC
/begin COMPU_METHOD MAP_TIP_win_calc_COMPU_VTAB "Verbal Table" TAB_VERB "%.0" "list" COMPU_TAB_REF MAP_TIP_win_calc_COMPU_VTAB_REF /end COMPU_METHOD
/begin COMPU_VTAB MAP_TIP_win_calc_COMPU_VTAB_REF "Verbal Table" TAB_VERB 2 0 "Single Window" 1 "Dual Windows" DEFAULT_VALUE "UNKNOWN" /end COMPU_VTAB
/begin CHARACTERISTIC MAP_TIP_win_cyls2 "MAP/TIP cylinder window size secondary" VALUE 0x001c7d48 /* @ECU_Address@MAP_TIP_win_cyls2@0x01014D18@ */ ECIPP_ALIGNMENT_UWORD 64 Compu_MAP_TIP_win_cyls2 0 63.9990234375 /end CHARACTERISTIC
/begin COMPU_METHOD Compu_MAP_TIP_win_cyls2 " " RAT_FUNC "%.1" "cyl events" COEFFS 0 1024 0 0 0 1 /end COMPU_METHOD
/begin MEASUREMENT DERATE_NOx_active "NOx fault requesting derate{DERATE_NOx_active&0x01=0x00:Inactive}{DERATE_NOx_active&0x01=0x01:Active}" UBYTE DERATE_NOx_active_COMPU_VTAB 0 0 0 255 ECU_ADDRESS 0x010154F8 BIT_MASK 0x01 /end MEASUREMENT
/begin COMPU_METHOD DERATE_NOx_active_COMPU_VTAB "Verbal Table" TAB_VERB "%.0" "list" COMPU_TAB_REF DERATE_NOx_active_COMPU_VTAB_REF /end COMPU_METHOD
/begin COMPU_VTAB DERATE_NOx_active_COMPU_VTAB_REF "Verbal Table" TAB_VERB 2 0x00 "Inactive" 0x01 "Active" DEFAULT_VALUE "UNKNOWN" /end COMPU_VTAB
/begin CHARACTERISTIC Trpmdt_rpmdtn "rpmdt Filtering" CURVE 0x001C665C /* @ECU_Address@Trpmdt_rpmdtn@0x02074000@ */ ECIPP_ALIGNMENT_SWORD 640 Compu_Trpmdt_rpmdtn -640 639.98046875
 /begin AXIS_DESCR COM_AXIS NO_INPUT_QUANTITY Compu_Trpmdt_rpm 4 -32768 32767 AXIS_PTS_REF Trpmdt_rpm /end AXIS_DESCR
/end CHARACTERISTIC
/begin AXIS_PTS Trpmdt_rpm " " 0x001C6654 /* @ECU_Address@Trpmdt_rpm@0x0207D000@ */ NO_INPUT_QUANTITY ECIPP_Lookup_SWORD 0 Compu_Trpmdt_rpm 4 -32768 32767 /end AXIS_PTS
/begin COMPU_METHOD Compu_Trpmdt_rpmdtn " " RAT_FUNC "%.0" "rpmdt Window (5ms)" COEFFS 0 51.2 0 0 0 1 /end COMPU_METHOD
/begin CHARACTERISTIC Trpmdt_rpmdtx "rpmdt Filtering" CURVE 0x001C8612 /* @ECU_Address@Trpmdt_rpmdtx@0x02075000@ */ ECIPP_ALIGNMENT_UWORD 163840 Compu_Trpmdt_rpmdtx 0.16703 163840
 /begin AXIS_DESCR COM_AXIS NO_INPUT_QUANTITY Compu_Trpmdt_rpm 4 -32768 32767 AXIS_PTS_REF Trpmdt_rpm /end AXIS_DESCR
/end CHARACTERISTIC
/begin COMPU_METHOD Compu_Trpmdt_rpmdtx " " FORM "%.3" "rpmdt Low-Pass (ms)"
 /begin FORMULA "-5 / log(1.0000000000001 - (X1 / 32768))" FORMULA_INV "(1.0000000000001 - exp(-5/X1)) * 32768" /end FORMULA
/end COMPU_METHOD
/begin COMPU_METHOD Compu_TMAPp_rpm_rpm " " RAT_FUNC "%.0" "Speed (rpm)" COEFFS 0 1 0 0 0 1 /end COMPU_METHOD
/begin CHARACTERISTIC TMAPp_rpm_CAD "MAP Noise Phase" CURVE 0x001C5428 /* @ECU_Address@TMAPp_rpm_CAD@0x02079000@ */ ECIPP_ALIGNMENT_SWORD 32767 Compu_TMAPp_rpm_CAD -32768 32767
 /begin AXIS_DESCR COM_AXIS NO_INPUT_QUANTITY Compu_TMAPp_rpm_rpm 4 -32768 32767 AXIS_PTS_REF TMAPp_rpm_rpm /end AXIS_DESCR
/end CHARACTERISTIC
/begin AXIS_PTS TMAPp_rpm_rpm " " 0x001C5438 /* @ECU_Address@TMAPp_rpm_rpm@0x02078000@ */ NO_INPUT_QUANTITY ECIPP_Lookup_SWORD 0 Compu_TMAPp_rpm_rpm 4 -32768 32767 /end AXIS_PTS
/begin COMPU_METHOD Compu_TMAPp_rpm_CAD " " RAT_FUNC "%.0" "Phase (CAD)" COEFFS 0 1 0 0 0 1 /end COMPU_METHOD
/begin CHARACTERISTIC TMAPp_rpm_psi "MAP Noise P-P Magnitude" CURVE 0x001C5430 /* @ECU_Address@TMAPp_rpm_psi@0x0207A000@ */ ECIPP_ALIGNMENT_SWORD 128 Compu_TMAPp_rpm_psi -128 127.99609375
 /begin AXIS_DESCR COM_AXIS NO_INPUT_QUANTITY Compu_TMAPp_rpm_rpm 4 -32768 32767 AXIS_PTS_REF TMAPp_rpm_rpm /end AXIS_DESCR
/end CHARACTERISTIC
/begin COMPU_METHOD Compu_TMAPp_rpm_psi " " RAT_FUNC "%.2" "P-P Mag (psi)" COEFFS 0 256 0 0 0 1 /end COMPU_METHOD
/begin COMPU_METHOD Compu_Trpmdt_rpm " " RAT_FUNC "%.0" "Speed (rpm)" COEFFS 0 1 0 0 0 1 /end COMPU_METHOD
/begin COMPU_METHOD Compu_MAPdtMAP_MAP " " RAT_FUNC "%.2" "MAPss (psia)" COEFFS 0 256 0 0 0 1 /end COMPU_METHOD
/begin CHARACTERISTIC MAPdtMAP_dz "MAPdt MAP Based Trigger" CURVE 0x001C4548 /* @ECU_Address@MAPdtMAP_dz@0x020FC000@ */ ECIPP_ALIGNMENT_SWORD 4000 Compu_MAPdtMAP_dz -4000 3999.8779296875
 /begin AXIS_DESCR COM_AXIS NO_INPUT_QUANTITY Compu_MAPdtMAP_MAP 4 -128 127.99609375 AXIS_PTS_REF MAPdtMAP_MAP /end AXIS_DESCR
/end CHARACTERISTIC
/begin AXIS_PTS MAPdtMAP_MAP " " 0x001C4540 /* @ECU_Address@MAPdtMAP_MAP@0x020FB000@ */ NO_INPUT_QUANTITY ECIPP_Lookup_SWORD 0 Compu_MAPdtMAP_MAP 4 -128 127.99609375 /end AXIS_PTS
/begin COMPU_METHOD Compu_MAPdtMAP_dz " " RAT_FUNC "%.1" "MAPdt (psi/sec)" COEFFS 0 8.192 0 0 0 1 /end COMPU_METHOD
/begin CHARACTERISTIC FSS_base_tbl "FSS Base 0" VAL_BLK 0x001E56E0 /* @ECU_Address@FSS_base_tbl@0x021A9000@ */ ECIPP_ALIGNMENT_UWORD 65535 Compu_FSS_base_tbl 0 65535 MATRIX_DIM 18 1 1 /end CHARACTERISTIC
/begin COMPU_METHOD Compu_FSS_base_tbl " " RAT_FUNC "%.0" "-" COEFFS 0 1 0 0 0 1 /end COMPU_METHOD
/begin MEASUREMENT FSS_cust_tbl "FSS Custom 0" UWORD Compu_FSS_cust_tbl 0 0 0 65535 ECU_ADDRESS 0x021AA000 MATRIX_DIM 8 1 1 /end MEASUREMENT
/begin COMPU_METHOD Compu_FSS_cust_tbl " " RAT_FUNC "%.0" "-" COEFFS 0 1 0 0 0 1 /end COMPU_METHOD
/begin CHARACTERISTIC FDR_base_tbl "FDR Base 0" VAL_BLK 0x001E50EE /* @ECU_Address@FDR_base_tbl@0x021AB000@ */ ECIPP_ALIGNMENT_UWORD 65535 Compu_FDR_base_tbl 0 65535 MATRIX_DIM 10 1 1 /end CHARACTERISTIC
/begin COMPU_METHOD Compu_FDR_base_tbl " " RAT_FUNC "%.0" "-" COEFFS 0 1 0 0 0 1 /end COMPU_METHOD
/begin MEASUREMENT FDR_cust_tbl "FDR Custom 0" UWORD Compu_FDR_cust_tbl 0 0 0 65535 ECU_ADDRESS 0x021AC000 MATRIX_DIM 2 1 1 /end MEASUREMENT
/begin COMPU_METHOD Compu_FDR_cust_tbl " " RAT_FUNC "%.0" "-" COEFFS 0 1 0 0 0 1 /end COMPU_METHOD
/begin COMPU_METHOD Compu_TOperTempWUT_ECT " " RAT_FUNC "%.1" "ECT (deg F)" COEFFS 0 32 14720 0 0 1 /end COMPU_METHOD
/begin CHARACTERISTIC TOperTempWUT_wait "ECT Threshold Warm-up Time" CURVE 0x001C58BE /* @ECU_Address@TOperTempWUT_wait@0x02480000@ */ ECIPP_ALIGNMENT_SWORD 32767 Compu_TOperTempWUT_wait -32768 32767
 /begin AXIS_DESCR COM_AXIS NO_INPUT_QUANTITY Compu_TOperTempWUT_ECT 8 -1484 563.96875 AXIS_PTS_REF TOperTempWUT_ECT /end AXIS_DESCR
/end CHARACTERISTIC
/begin AXIS_PTS TOperTempWUT_ECT " " 0x001C58AE /* @ECU_Address@TOperTempWUT_ECT@0x0247F000@ */ NO_INPUT_QUANTITY ECIPP_Lookup_SWORD 0 Compu_TOperTempWUT_ECT 8 -1484 563.96875 /end AXIS_PTS
/begin COMPU_METHOD Compu_TOperTempWUT_wait " " RAT_FUNC "%.0" "Time (sec)" COEFFS 0 1 0 0 0 1 /end COMPU_METHOD
/begin COMPU_METHOD Compu_TCLTempWUT_ECT " " RAT_FUNC "%.1" "ECT (deg F)" COEFFS 0 32 14720 0 0 1 /end COMPU_METHOD
/begin CHARACTERISTIC TCLTempWUT_wait "Closed Loop Temp Warm-up Time" CURVE 0x001C4684 /* @ECU_Address@TCLTempWUT_wait@0x02482000@ */ ECIPP_ALIGNMENT_SWORD 32767 Compu_TCLTempWUT_wait -32768 32767
 /begin AXIS_DESCR COM_AXIS NO_INPUT_QUANTITY Compu_TCLTempWUT_ECT 4 -1484 563.96875 AXIS_PTS_REF TCLTempWUT_ECT /end AXIS_DESCR
/end CHARACTERISTIC
/begin AXIS_PTS TCLTempWUT_ECT " " 0x001C467C /* @ECU_Address@TCLTempWUT_ECT@0x02481000@ */ NO_INPUT_QUANTITY ECIPP_Lookup_SWORD 0 Compu_TCLTempWUT_ECT 4 -1484 563.96875 /end AXIS_PTS
/begin COMPU_METHOD Compu_TCLTempWUT_wait " " RAT_FUNC "%.0" "Time (sec)" COEFFS 0 1 0 0 0 1 /end COMPU_METHOD
/begin COMPU_METHOD Compu_TDiagTempWUT_ECT " " RAT_FUNC "%.1" "ECT (deg F)" COEFFS 0 32 14720 0 0 1 /end COMPU_METHOD
/begin CHARACTERISTIC TDiagTempWUT_wait "Diag Enable Temp Warm-up Time" CURVE 0x001C4A1C /* @ECU_Address@TDiagTempWUT_wait@0x02484000@ */ ECIPP_ALIGNMENT_SWORD 32767 Compu_TDiagTempWUT_wait -32768 32767
 /begin AXIS_DESCR COM_AXIS NO_INPUT_QUANTITY Compu_TDiagTempWUT_ECT 8 -1484 563.96875 AXIS_PTS_REF TDiagTempWUT_ECT /end AXIS_DESCR
/end CHARACTERISTIC
/begin AXIS_PTS TDiagTempWUT_ECT " " 0x001C4A0C /* @ECU_Address@TDiagTempWUT_ECT@0x02483000@ */ NO_INPUT_QUANTITY ECIPP_Lookup_SWORD 0 Compu_TDiagTempWUT_ECT 8 -1484 563.96875 /end AXIS_PTS
/begin COMPU_METHOD Compu_TDiagTempWUT_wait " " RAT_FUNC "%.0" "Time (sec)" COEFFS 0 1 0 0 0 1 /end COMPU_METHOD
/begin MEASUREMENT FaultTblSecInit "FSS Init Time 1" ULONG Compu_FaultTblSecInit 0 0 0 1193046.47083333 ECU_ADDRESS 0x024B7000 MATRIX_DIM 31 1 1 /end MEASUREMENT
/begin COMPU_METHOD Compu_FaultTblSecInit " " RAT_FUNC "%.3" "-" COEFFS 0 3600 0 0 0 1 /end COMPU_METHOD
/begin MEASUREMENT FaultTblSecLast "FSS Last Time 1" ULONG Compu_FaultTblSecLast 0 0 0 1193046.47083333 ECU_ADDRESS 0x024B8000 MATRIX_DIM 31 1 1 /end MEASUREMENT
/begin COMPU_METHOD Compu_FaultTblSecLast " " RAT_FUNC "%.3" "-" COEFFS 0 3600 0 0 0 1 /end COMPU_METHOD
/begin MEASUREMENT FaultTblSecPrevAct "FSS PrevAct Time 1" ULONG Compu_FaultTblSecPrevAct 0 0 0 1193046.47083333 ECU_ADDRESS 0x024B9000 MATRIX_DIM 31 1 1 /end MEASUREMENT
/begin COMPU_METHOD Compu_FaultTblSecPrevAct " " RAT_FUNC "%.3" "-" COEFFS 0 3600 0 0 0 1 /end COMPU_METHOD
/begin MEASUREMENT FaultTblOCC "FSS Occurrence Count 1" UBYTE Compu_FaultTblOCC 0 0 0 255 ECU_ADDRESS 0x024BA000 MATRIX_DIM 31 1 1 /end MEASUREMENT
/begin COMPU_METHOD Compu_FaultTblOCC " " RAT_FUNC "%.0" "-" COEFFS 0 1 0 0 0 1 /end COMPU_METHOD
/begin MEASUREMENT FaultTblMILCntdown "FSS MIL Countdown 1" UBYTE Compu_FaultTblMILCntdown 0 0 0 255 ECU_ADDRESS 0x024BB000 MATRIX_DIM 31 1 1 /end MEASUREMENT
/begin COMPU_METHOD Compu_FaultTblMILCntdown " " RAT_FUNC "%.0" "-" COEFFS 0 1 0 0 0 1 /end COMPU_METHOD
/begin MEASUREMENT fss_fault_ndx "FSS Fault Index 1" UWORD Compu_fss_fault_ndx 0 0 0 65535 ECU_ADDRESS 0x024BC000 MATRIX_DIM 31 1 1 /end MEASUREMENT
/begin COMPU_METHOD Compu_fss_fault_ndx " " RAT_FUNC "%.0" "-" COEFFS 0 1 0 0 0 1 /end COMPU_METHOD
/begin MEASUREMENT fss_fault_rank "FSS Fault Rank 1" UBYTE Compu_fss_fault_rank 0 0 0 255 ECU_ADDRESS 0x024BD000 MATRIX_DIM 31 1 1 /end MEASUREMENT
/begin COMPU_METHOD Compu_fss_fault_rank " " RAT_FUNC "%.0" "-" COEFFS 0 1 0 0 0 1 /end COMPU_METHOD
/begin MEASUREMENT fss_fault_dtc "FSS Fault DTC 1" UWORD Compu_fss_fault_dtc 0 0 0 65535 ECU_ADDRESS 0x024BE000 MATRIX_DIM 31 1 1 /end MEASUREMENT
/begin COMPU_METHOD Compu_fss_fault_dtc " " RAT_FUNC "%.0" "-" COEFFS 0 1 0 0 0 1 /end COMPU_METHOD
/begin COMPU_METHOD Compu_TmdotCOTth_mdota " " RAT_FUNC "%.1" "Mass Flow (g/s)" COEFFS 0 32 0 0 0 1 /end COMPU_METHOD
/begin CHARACTERISTIC TmdotCOTth_COT "Air Mass Flow-Based COT Thresholds" CURVE 0x001C660C /* @ECU_Address@TmdotCOTth_COT@0x024C3000@ */ ECIPP_ALIGNMENT_SWORD 7732 Compu_TmdotCOTth_COT -8652 7731.75
 /begin AXIS_DESCR COM_AXIS NO_INPUT_QUANTITY Compu_TmdotCOTth_mdota 4 -1024 1023.96875 AXIS_PTS_REF TmdotCOTth_mdota /end AXIS_DESCR
/end CHARACTERISTIC
/begin AXIS_PTS TmdotCOTth_mdota " " 0x001C6614 /* @ECU_Address@TmdotCOTth_mdota@0x024C2000@ */ NO_INPUT_QUANTITY ECIPP_Lookup_SWORD 0 Compu_TmdotCOTth_mdota 4 -1024 1023.96875 /end AXIS_PTS
/begin COMPU_METHOD Compu_TmdotCOTth_COT " " RAT_FUNC "%.1" "COT (deg F)" COEFFS 0 4 1840 0 0 1 /end COMPU_METHOD
/begin COMPU_METHOD Compu_TCVdP_mdot_a " " RAT_FUNC "%.1" "Mass Flow (g/s)" COEFFS 0 64 0 0 0 1 /end COMPU_METHOD
/begin CHARACTERISTIC TCVdP_dP1 "Crankcase Expected Pressure Drop" CURVE 0x001C4754 /* @ECU_Address@TCVdP_dP1@0x025E0000@ */ ECIPP_ALIGNMENT_SWORD 32 Compu_TCVdP_dP1 -32 31.9990234375
 /begin AXIS_DESCR COM_AXIS NO_INPUT_QUANTITY Compu_TCVdP_mdot_a 8 -512 511.984375 AXIS_PTS_REF TCVdP_mdot_a /end AXIS_DESCR
/end CHARACTERISTIC
/begin AXIS_PTS TCVdP_mdot_a " " 0x001C4774 /* @ECU_Address@TCVdP_mdot_a@0x025DF000@ */ NO_INPUT_QUANTITY ECIPP_Lookup_SWORD 0 Compu_TCVdP_mdot_a 8 -512 511.984375 /end AXIS_PTS
/begin COMPU_METHOD Compu_TCVdP_dP1 " " RAT_FUNC "%.4" "Pressure drop 1 (psi)" COEFFS 0 1024 0 0 0 1 /end COMPU_METHOD
/begin CHARACTERISTIC TCVdP_dP2 "Crankcase Expected Pressure Drop" CURVE 0x001C4764 /* @ECU_Address@TCVdP_dP2@0x025E1000@ */ ECIPP_ALIGNMENT_SWORD 32 Compu_TCVdP_dP2 -32 31.9990234375
 /begin AXIS_DESCR COM_AXIS NO_INPUT_QUANTITY Compu_TCVdP_mdot_a 8 -512 511.984375 AXIS_PTS_REF TCVdP_mdot_a /end AXIS_DESCR
/end CHARACTERISTIC
/begin COMPU_METHOD Compu_TCVdP_dP2 " " RAT_FUNC "%.4" "Pressure drop 2 (psi)" COEFFS 0 1024 0 0 0 1 /end COMPU_METHOD
/begin COMPU_METHOD Compu_TEGRO_postlk_vlvdP " " RAT_FUNC "%.1" "EGR Valve dP (psi)" COEFFS 0 256 0 0 0 1 /end COMPU_METHOD
/begin CHARACTERISTIC TEGRO_postlk_EGRdP "EGR Orifice Expected Pressure Change" CURVE 0x001C4B24 /* @ECU_Address@TEGRO_postlk_EGRdP@0x02623000@ */ ECIPP_ALIGNMENT_SWORD 32 Compu_TEGRO_postlk_EGRdP -32 31.9990234375
 /begin AXIS_DESCR COM_AXIS NO_INPUT_QUANTITY Compu_TEGRO_postlk_vlvdP 6 -128 127.99609375 AXIS_PTS_REF TEGRO_postlk_vlvdP /end AXIS_DESCR
/end CHARACTERISTIC
/begin AXIS_PTS TEGRO_postlk_vlvdP " " 0x001C4B30 /* @ECU_Address@TEGRO_postlk_vlvdP@0x02622000@ */ NO_INPUT_QUANTITY ECIPP_Lookup_SWORD 0 Compu_TEGRO_postlk_vlvdP 6 -128 127.99609375 /end AXIS_PTS
/begin COMPU_METHOD Compu_TEGRO_postlk_EGRdP " " RAT_FUNC "%.3" "EGRdP (psi)" COEFFS 0 1024 0 0 0 1 /end COMPU_METHOD
/begin COMPU_METHOD Compu_TEGRdP_HiExp_mdota " " RAT_FUNC "%.1" "Air Flow (g/sec)" COEFFS 0 64 0 0 0 1 /end COMPU_METHOD
/begin CHARACTERISTIC TEGRdP_HiExp_EGRdP "Air Mass Flow-Based Expected EGRdP" CURVE 0x001C090E /* @ECU_Address@TEGRdP_HiExp_EGRdP@0x02636000@ */ ECIPP_ALIGNMENT_SWORD 32 Compu_TEGRdP_HiExp_EGRdP -32 31.9990234375
 /begin AXIS_DESCR COM_AXIS NO_INPUT_QUANTITY Compu_TEGRdP_HiExp_mdota 6 -512 511.984375 AXIS_PTS_REF TEGRdP_HiExp_mdota /end AXIS_DESCR
/end CHARACTERISTIC
/begin AXIS_PTS TEGRdP_HiExp_mdota " " 0x001C091A /* @ECU_Address@TEGRdP_HiExp_mdota@0x02635000@ */ NO_INPUT_QUANTITY ECIPP_Lookup_SWORD 0 Compu_TEGRdP_HiExp_mdota 6 -512 511.984375 /end AXIS_PTS
/begin COMPU_METHOD Compu_TEGRdP_HiExp_EGRdP " " RAT_FUNC "%.3" "EGRdP (psi)" COEFFS 0 1024 0 0 0 1 /end COMPU_METHOD
/begin COMPU_METHOD Compu_TOILP_wait_ECT " " RAT_FUNC "%.1" "ECT (deg F)" COEFFS 0 1 460 0 0 1 /end COMPU_METHOD
/begin CHARACTERISTIC TOILP_wait_time "Low Oil Pressure Faults Run Time Wait" CURVE 0x001C3C78 /* @ECU_Address@TOILP_wait_time@0x02638000@ */ ECIPP_ALIGNMENT_FLOAT32_IEEE 10000000000 Compu_TOILP_wait_time -10000000000 10000000000
 /begin AXIS_DESCR COM_AXIS NO_INPUT_QUANTITY Compu_TOILP_wait_ECT 4 -10000000000 10000000000 AXIS_PTS_REF TOILP_wait_ECT /end AXIS_DESCR
/end CHARACTERISTIC
/begin AXIS_PTS TOILP_wait_ECT " " 0x001C3C68 /* @ECU_Address@TOILP_wait_ECT@0x02637000@ */ NO_INPUT_QUANTITY ECIPP_Lookup_FLOAT32_IEEE 0 Compu_TOILP_wait_ECT 4 -10000000000 10000000000 /end AXIS_PTS
/begin COMPU_METHOD Compu_TOILP_wait_time " " RAT_FUNC "%.1" "Run time wait (sec)" COEFFS 0 1000 0 0 0 1 /end COMPU_METHOD
/begin COMPU_METHOD Compu_TOILP_hiP_wait_ECT " " RAT_FUNC "%.1" "ECT (deg F)" COEFFS 0 1 460 0 0 1 /end COMPU_METHOD
/begin CHARACTERISTIC TOILP_hiP_wait_time "High Oil Pressure Faults Run Time Wait" CURVE 0x001C3C58 /* @ECU_Address@TOILP_hiP_wait_time@0x0263E000@ */ ECIPP_ALIGNMENT_FLOAT32_IEEE 10000000000 Compu_TOILP_hiP_wait_time -10000000000 10000000000
 /begin AXIS_DESCR COM_AXIS NO_INPUT_QUANTITY Compu_TOILP_hiP_wait_ECT 4 -10000000000 10000000000 AXIS_PTS_REF TOILP_hiP_wait_ECT /end AXIS_DESCR
/end CHARACTERISTIC
/begin AXIS_PTS TOILP_hiP_wait_ECT " " 0x001C3C48 /* @ECU_Address@TOILP_hiP_wait_ECT@0x0263D000@ */ NO_INPUT_QUANTITY ECIPP_Lookup_FLOAT32_IEEE 0 Compu_TOILP_hiP_wait_ECT 4 -10000000000 10000000000 /end AXIS_PTS
/begin COMPU_METHOD Compu_TOILP_hiP_wait_time " " RAT_FUNC "%.1" "Run time wait (sec)" COEFFS 0 1000 0 0 0 1 /end COMPU_METHOD
/begin COMPU_METHOD Compu_TBstTIP_Lo_MAP " " RAT_FUNC "%.1" "MAP (psia)" COEFFS 0 256 0 0 0 1 /end COMPU_METHOD
/begin CHARACTERISTIC TBstTIP_Lo_TIPd "Boost Pressure Control Expected TIP" CURVE 0x001C4674 /* @ECU_Address@TBstTIP_Lo_TIPd@0x0264C000@ */ ECIPP_ALIGNMENT_SWORD 128 Compu_TBstTIP_Lo_TIPd -128 127.99609375
 /begin AXIS_DESCR COM_AXIS NO_INPUT_QUANTITY Compu_TBstTIP_Lo_MAP 4 -128 127.99609375 AXIS_PTS_REF TBstTIP_Lo_MAP /end AXIS_DESCR
/end CHARACTERISTIC
/begin AXIS_PTS TBstTIP_Lo_MAP " " 0x001C466C /* @ECU_Address@TBstTIP_Lo_MAP@0x0264B000@ */ NO_INPUT_QUANTITY ECIPP_Lookup_SWORD 0 Compu_TBstTIP_Lo_MAP 4 -128 127.99609375 /end AXIS_PTS
/begin COMPU_METHOD Compu_TBstTIP_Lo_TIPd " " RAT_FUNC "%.2" "TIP Target (psia)" COEFFS 0 256 0 0 0 1 /end COMPU_METHOD
/begin COMPU_METHOD Compu_TCVdP_AAT " " RAT_FUNC "%.1" "AAT (deg F)" COEFFS 0 32 14720 0 0 1 /end COMPU_METHOD
/begin CHARACTERISTIC TCVdP_run_wait "Crankcase Ventilation Pressure Diagnostics Run Time Wait" CURVE 0x001C8068 /* @ECU_Address@TCVdP_run_wait@0x0264E000@ */ ECIPP_ALIGNMENT_UWORD 65535 Compu_TCVdP_run_wait 0 65535
 /begin AXIS_DESCR COM_AXIS NO_INPUT_QUANTITY Compu_TCVdP_AAT 4 -1484 563.96875 AXIS_PTS_REF TCVdP_AAT /end AXIS_DESCR
/end CHARACTERISTIC
/begin AXIS_PTS TCVdP_AAT " " 0x001C474C /* @ECU_Address@TCVdP_AAT@0x0264D000@ */ NO_INPUT_QUANTITY ECIPP_Lookup_SWORD 0 Compu_TCVdP_AAT 4 -1484 563.96875 /end AXIS_PTS
/begin COMPU_METHOD Compu_TCVdP_run_wait " " RAT_FUNC "%.0" "Run time wait (sec)" COEFFS 0 1 0 0 0 1 /end COMPU_METHOD
/begin CHARACTERISTIC TDiagTempWUT_wait2 "Diag Enable Temp Warm-up Time 2" CURVE 0x001C4A2C /* @ECU_Address@TDiagTempWUT_wait2@0x026AE000@ */ ECIPP_ALIGNMENT_SWORD 32767 Compu_TDiagTempWUT_wait2 -32768 32767
 /begin AXIS_DESCR COM_AXIS NO_INPUT_QUANTITY Compu_TDiagTempWUT_ECT 8 -1484 563.96875 AXIS_PTS_REF TDiagTempWUT_ECT /end AXIS_DESCR
/end CHARACTERISTIC
/begin COMPU_METHOD Compu_TDiagTempWUT_wait2 " " RAT_FUNC "%.0" "Time (sec)" COEFFS 0 1 0 0 0 1 /end COMPU_METHOD
/begin CHARACTERISTIC TDiagTempWUT_AAT "AAT at start" VAL_BLK 0x001C80B0 /* @ECU_Address@TDiagTempWUT_AAT@0x026AF000@ */ ECIPP_ALIGNMENT_UWORD 564 Compu_TDiagTempWUT_AAT -460 563.984375 MATRIX_DIM 2 1 1 /end CHARACTERISTIC
/begin COMPU_METHOD Compu_TDiagTempWUT_AAT " " RAT_FUNC "%.0" "deg F" COEFFS 0 64 29440 0 0 1 /end COMPU_METHOD
/begin COMPU_METHOD Compu_TMAP_TIP_win_rpm " " RAT_FUNC "%.0" "Speed (rpm)" COEFFS 0 1 0 0 0 1 /end COMPU_METHOD
/begin CHARACTERISTIC TMAP_TIP_win_pct "MAP/TIP Dual Windows" CURVE 0x001C8118 /* @ECU_Address@TMAP_TIP_win_pct@0x026B6000@ */ ECIPP_ALIGNMENT_UWORD 200 Compu_TMAP_TIP_win_pct 0 199.996948242188
 /begin AXIS_DESCR COM_AXIS NO_INPUT_QUANTITY Compu_TMAP_TIP_win_rpm 4 -32768 32767 AXIS_PTS_REF TMAP_TIP_win_rpm /end AXIS_DESCR
/end CHARACTERISTIC
/begin AXIS_PTS TMAP_TIP_win_rpm " " 0x001C53C0 /* @ECU_Address@TMAP_TIP_win_rpm@0x026B5000@ */ NO_INPUT_QUANTITY ECIPP_Lookup_SWORD 0 Compu_TMAP_TIP_win_rpm 4 -32768 32767 /end AXIS_PTS
/begin COMPU_METHOD Compu_TMAP_TIP_win_pct " " RAT_FUNC "%.1" "Secondary Contribution (%)" COEFFS 0 327.68 0 0 0 1 /end COMPU_METHOD
/begin GROUP EC_FaultCfg "ECONTROLS" ROOT
 /begin REF_CHARACTERISTIC OilP_loP OilP_hiP OilP_loP2 OilP_loRPM OilP_loRPM2 ECT_CL_ena OilP_maxV OilP_minV OilP2_loP OilP2_loP2 LowOperTemp_ECT ECT_nom ECT_nom_min ECTmon_diag_hyst ECTmon_AAT ECTmon_delta COT_hi_hyst CVdP_dP1_location CVdP_dP2_location ECTmon_warm_wait EGRdP_HiExp_tbl_pct EGRdP_HiExp_dP_min TRAT_TAUX_n1 TRAT_TAUX_n2 DiagTempWUT_calc FOP_detect_time FOP_MJ_P_act_lmt TOperTempWUT_wait TCLTempWUT_wait TDiagTempWUT_wait TmdotCOTth_COT TCVdP_dP1 TCVdP_dP2 TEGRO_postlk_EGRdP TEGRdP_HiExp_EGRdP TOILP_wait_time TOILP_hiP_wait_time TBstTIP_Lo_TIPd TCVdP_run_wait TDiagTempWUT_wait2 TDiagTempWUT_AAT /end REF_CHARACTERISTIC
 /begin REF_MEASUREMENT ECT_diag_min ECTmon_state CVdP_dP1_d CVdP_dP2_d CVdP_dP1_pcta CVdP_dP2_pcta ECTmon_CL_wait ECTmon_CL_tmr ECTmon_oper_wait ECTmon_oper_tmr ECTmon_diag_wait ECTmon_diag_tmr RTC_sec_epoch TRAT_engstop_rtc TRAT_state TRAT_tmr TRAT_ECT_state TRAT_ECT_avg TRAT_IAT_state TRAT_IAT_avg TRAT_AAT_state TRAT_AAT_avg TRAT_EGRT_state TRAT_EGRT_avg TRAT_FT_state TRAT_FT_avg TRAT_OILT_state TRAT_OILT_avg TRAT_EGT_state TRAT_EGT_avg TRAT_TIAT_state TRAT_TIAT_avg TRAT_TAUX_n1_state TRAT_TAUX_n1_avg TRAT_TAUX_n2_state TRAT_TAUX_n2_avg FOP_inhibit_active /end REF_MEASUREMENT
/end GROUP
/begin GROUP EC_FaultMon "ECONTROLS" ROOT
 /begin REF_MEASUREMENT fm_mon_ena fm_mon_fctl_ndx fm_mon_TF fm_mon_TFTOC fm_mon_PDTC fm_mon_CDTC fm_mon_TNCSLC fm_mon_TFSLC fm_mon_TNCTOC fm_mon_WIR fm_mon_potential fm_mon_pending fm_mon_confact fm_mon_prevact fm_mon_permanent fm_mon_mil_type fm_mon_mil_cnt fm_mon_cycles_cnt fm_mon_sec_prevact fm_mon_act_cnt fm_mon_con_cnt fault_maxact_pct0 fault_maxact_pct1 fault_maxact_pct2 fault_maxact_pct3 fault_maxact_pct4 fault_maxact_pct5 fault_maxact_pct6 fault_maxact_pct7 fault_maxact_flt0 fault_maxact_flt1 fault_maxact_flt2 fault_maxact_flt3 fault_maxact_flt4 fault_maxact_flt5 fault_maxact_flt6 fault_maxact_flt7 fault_maxact_valid fault_maxact_pct8 fault_maxact_pct9 fault_maxact_pct10 fault_maxact_pct11 fault_maxact_pct12 fault_maxact_pct13 fault_maxact_pct14 fault_maxact_pct15 fault_maxact_pct16 fault_maxact_pct17 fault_maxact_pct18 fault_maxact_pct19 fault_maxact_pct20 fault_maxact_pct21 fault_maxact_pct22 fault_maxact_pct23 fault_maxact_pct24 fault_maxact_pct25 fault_maxact_pct26 fault_maxact_pct27 fault_maxact_pct28 fault_maxact_pct29 fault_maxact_flt8 fault_maxact_flt9 fault_maxact_flt10 fault_maxact_flt11 fault_maxact_flt12 fault_maxact_flt13 fault_maxact_flt14 fault_maxact_flt15 fault_maxact_flt16 fault_maxact_flt17 fault_maxact_flt18 fault_maxact_flt19 fault_maxact_flt20 fault_maxact_flt21 fault_maxact_flt22 fault_maxact_flt23 fault_maxact_flt24 fault_maxact_flt25 fault_maxact_flt26 fault_maxact_flt27 fault_maxact_flt28 fault_maxact_flt29 fault_maxact_pct30 fault_maxact_pct31 fault_maxact_pct32 fault_maxact_pct33 fault_maxact_pct34 fault_maxact_pct35 fault_maxact_pct36 fault_maxact_pct37 fault_maxact_pct38 fault_maxact_pct39 fault_maxact_pct40 fault_maxact_pct41 fault_maxact_pct42 fault_maxact_pct43 fault_maxact_pct44 fault_maxact_pct45 fault_maxact_pct46 fault_maxact_pct47 fault_maxact_pct48 fault_maxact_pct49 fault_maxact_pct50 fault_maxact_pct51 fault_maxact_pct52 fault_maxact_pct53 fault_maxact_pct54 fault_maxact_pct55 fault_maxact_pct56 fault_maxact_pct57 fault_maxact_pct58 fault_maxact_pct59 fault_maxact_flt30 fault_maxact_flt31 fault_maxact_flt32 fault_maxact_flt33 fault_maxact_flt34 fault_maxact_flt35 fault_maxact_flt36 fault_maxact_flt37 fault_maxact_flt38 fault_maxact_flt39 fault_maxact_flt40 fault_maxact_flt41 fault_maxact_flt42 fault_maxact_flt43 fault_maxact_flt44 fault_maxact_flt45 fault_maxact_flt46 fault_maxact_flt47 fault_maxact_flt48 fault_maxact_flt49 fault_maxact_flt50 fault_maxact_flt51 fault_maxact_flt52 fault_maxact_flt53 fault_maxact_flt54 fault_maxact_flt55 fault_maxact_flt56 fault_maxact_flt57 fault_maxact_flt58 fault_maxact_flt59 fault_maxact_pctmin FaultTblSecInit FaultTblSecLast FaultTblSecPrevAct FaultTblOCC FaultTblMILCntdown fss_fault_ndx fss_fault_rank fss_fault_dtc /end REF_MEASUREMENT
/end GROUP
/begin GROUP EC_Faults "ECONTROLS" ROOT
 /begin REF_CHARACTERISTIC fault_SD_dis_ena fault_SD_dis_cfg faultact_AL_dis faultact_persist faultact_persist_cyc faultact_persist_MIL FSS_base_tbl FDR_base_tbl /end REF_CHARACTERISTIC
 /begin REF_MEASUREMENT dwell1 dwell2 dwell3 EGO1_volts EGO2_volts EGO3_volts eng_load PWe_avg inj_kill spk_kill Gov1_volt Gov2_volt OilP_volt fault_clear_all dwell4 dwell5 dwell6 dwell7 dwell8 dwell9 dwell10 MAP_raw ECT_raw IAT_raw MILout_mirror BUZZout_mirror SWARNout_mirror HWARNout_mirror EGO4_volts FO_BO torque_Nm_gross torque_pct HM_MIL_seconds inj1_on_samp inj2_on_samp inj3_on_samp inj4_on_samp inj5_on_samp inj6_on_samp inj7_on_samp inj8_on_samp inj9_on_samp inj10_on_samp inj1_off_samp inj2_off_samp inj3_off_samp inj4_off_samp inj5_off_samp inj6_off_samp inj7_off_samp inj8_off_samp inj9_off_samp inj10_off_samp FPin_I2 SD_inhibit SD_trigger_ndx SD_trigger_SPN SD_trigger_FMI SD_trigger_SA dwell11 dwell12 inj11_off_samp inj12_off_samp inj11_on_samp inj12_on_samp DERATE_NOx_active FSS_cust_tbl FDR_cust_tbl /end REF_MEASUREMENT
/end GROUP
/begin GROUP EC_FilterCal "ECONTROLS" ROOT
 /begin REF_CHARACTERISTIC TFBdt_n MAPdt_n TPSraw_LP MAPraw_LP TFBdt_xLP MAPdt_xLP MAP_favg_n MAP_savg_n rpm_filt_n MAPdt_crk_dz MAPdt_nrm_dz MAP_CADproject FPraw_LP TIPraw_LP EGO_phidt_n WGPraw_LP rpmdt_sLP MAPdt_dz_src MAPdt_dz_shape MAPdt_MAPss_tau SHIFT_dt_n SHIFT_dt_LP APSraw_LP BPSraw_LP AFBdt_n BFBdt_n AFBdt_xLP BFBdt_xLP EMP_cyl_events EMP_tau EMP_slow_tau_ms MAP_global_filt TIP_global_filt MAP_TIP_win_cyls EGRdP_tau EGRHPLP_cyl_events EGRHPLP_tau UEGOB_PI_raw_LP UEGOB_SR_raw_LP UEGOB_PI_Vofst_LP UEGOB_SR_Vofst_LP UEGOB_PI_Vout_LP UEGOB_SR_Vout_LP UEGON_PI_raw_LP UEGON_SR_raw_LP UEGON_PI_Vofst_LP UEGON_SR_Vofst_LP UEGON_PI_Vout_LP UEGON_SR_Vout_LP EGRdP_cyl_events EGRdP_Dz TPScmd_dmdot_n TPScmd_dmdot_Dz TPScmd_dmdot_LP TPSdP_ena TPSdP_config TPSdP_cyl_events TPSdP_tau TPSdP_offset_keywt TPSdP_offset_strtwt TPSdP_offset_tau TPSdP_offset_dPmin TPSdP_offset_dPmax EGRHPLP_Dz AFILTdP_tau AFILTdP_Dz AFILTdP_cyl_events MAPdt_global_filt MAP_TIP_win_calc MAP_TIP_win_cyls2 Trpmdt_rpmdtn Trpmdt_rpmdtx TMAPp_rpm_CAD TMAPp_rpm_psi MAPdtMAP_dz TMAP_TIP_win_pct /end REF_CHARACTERISTIC
 /begin REF_MEASUREMENT MAPdt_dz rpmdt MAPe TIP_slow MAPdt_MAPss rpmdt_n rpmdt_xLP rpmdt_slow MAPdt_dz_acttrg MAP_windowed TIP_windowed EGRLP_inst EGRHP_inst TPScmd_dmdot mdot_TPScmd_f TPSdP_inst_float TPSdP_float EGRLP_wdw EGRHP_wdw EGRdP_wdw_dz_lp EGRHP_wdw_dz_lp EGRHP_mdl_float MAPdt_windowed /end REF_MEASUREMENT
/end GROUP
/begin GROUP EC_Fuel "ECONTROLS" ROOT /begin REF_CHARACTERISTIC MAP_CADproject /end REF_CHARACTERISTIC /begin REF_MEASUREMENT MAPe PWe_avg FPin_I2 /end REF_MEASUREMENT /end GROUP
/begin GROUP EC_FuelSecond "ECONTROLS" ROOT /begin REF_MEASUREMENT PWe_avg FPin_I2 /end REF_MEASUREMENT /end GROUP
/begin GROUP EC_GovCal "ECONTROLS" ROOT /begin REF_CHARACTERISTIC Trpmdt_rpmdtn Trpmdt_rpmdtx /end REF_CHARACTERISTIC /begin REF_MEASUREMENT rpmdt eng_load rpmdt_n rpmdt_xLP /end REF_MEASUREMENT /end GROUP
/begin GROUP EC_GovCalAlt "ECONTROLS" ROOT /begin REF_CHARACTERISTIC Trpmdt_rpmdtn Trpmdt_rpmdtx /end REF_CHARACTERISTIC /begin REF_MEASUREMENT rpmdt eng_load rpmdt_n rpmdt_xLP /end REF_MEASUREMENT /end GROUP
/begin GROUP EC_HDOBD "ECONTROLS" ROOT /begin REF_MEASUREMENT fault_clear_all MILout_mirror DERATE_NOx_active /end REF_MEASUREMENT /end GROUP
/begin GROUP EC_LDService "ECONTROLS" ROOT
 /begin REF_MEASUREMENT PWe_avg inj_kill spk_kill MILout_mirror BUZZout_mirror SWARNout_mirror HWARNout_mirror FPin_I2 /end REF_MEASUREMENT
/end GROUP
/begin GROUP EC_LEService "ECONTROLS" ROOT
 /begin REF_MEASUREMENT dwell1 dwell2 dwell3 dwell4 dwell5 dwell6 dwell7 dwell8 dwell9 dwell10 MILout_mirror BUZZout_mirror SWARNout_mirror HWARNout_mirror SD_inhibit dwell11 dwell12 /end REF_MEASUREMENT
/end GROUP
/begin GROUP EC_LoadCal "ECONTROLS" ROOT /begin REF_MEASUREMENT torque_Nm_gross torque_pct /end REF_MEASUREMENT /end GROUP
/begin GROUP EC_Marine "ECONTROLS" ROOT /begin REF_MEASUREMENT PWe_avg /end REF_MEASUREMENT /end GROUP
/begin GROUP EC_Misfire "ECONTROLS" ROOT /begin REF_MEASUREMENT inj_kill spk_kill FO_BO /end REF_MEASUREMENT /end GROUP
/begin GROUP EC_Outputs "ECONTROLS" ROOT
 /begin REF_MEASUREMENT MILout_mirror BUZZout_mirror SWARNout_mirror HWARNout_mirror FPin_I2 /end REF_MEASUREMENT
/end GROUP
/begin GROUP EC_PhiLP "ECONTROLS" ROOT /begin REF_MEASUREMENT EGO1_volts EGO2_volts EGO3_volts EGO4_volts /end REF_MEASUREMENT /end GROUP
/begin GROUP EC_PhiNG "ECONTROLS" ROOT /begin REF_MEASUREMENT EGO1_volts EGO2_volts EGO3_volts EGO4_volts /end REF_MEASUREMENT /end GROUP
/begin GROUP EC_RawVolts "ECONTROLS" ROOT
 /begin REF_MEASUREMENT Gov1_volt Gov2_volt OilP_volt MAP_raw ECT_raw IAT_raw inj1_on_samp inj2_on_samp inj3_on_samp inj4_on_samp inj5_on_samp inj6_on_samp inj7_on_samp inj8_on_samp inj9_on_samp inj10_on_samp inj1_off_samp inj2_off_samp inj3_off_samp inj4_off_samp inj5_off_samp inj6_off_samp inj7_off_samp inj8_off_samp inj9_off_samp inj10_off_samp inj11_off_samp inj12_off_samp inj11_on_samp inj12_on_samp /end REF_MEASUREMENT
/end GROUP
/begin GROUP EC_Service1 "ECONTROLS" ROOT /begin REF_MEASUREMENT fault_clear_all /end REF_MEASUREMENT /end GROUP
/begin GROUP EC_Service2 "ECONTROLS" ROOT /begin REF_MEASUREMENT EGO1_volts fault_clear_all /end REF_MEASUREMENT /end GROUP
/begin GROUP EC_SparkCal "ECONTROLS" ROOT
 /begin REF_MEASUREMENT dwell1 dwell2 dwell3 spk_kill dwell4 dwell5 dwell6 dwell7 dwell8 dwell9 dwell10 FO_BO dwell11 dwell12 /end REF_MEASUREMENT
/end GROUP
/begin GROUP EC_Starting "ECONTROLS" ROOT /begin REF_MEASUREMENT PWe_avg /end REF_MEASUREMENT /end GROUP
/begin GROUP EC_Tests "ECONTROLS" ROOT /begin REF_MEASUREMENT PWe_avg inj_kill spk_kill FO_BO /end REF_MEASUREMENT /end GROUP
/begin GROUP EC_VECal "ECONTROLS" ROOT /begin REF_CHARACTERISTIC MAP_CADproject /end REF_CHARACTERISTIC /begin REF_MEASUREMENT MAPe FPin_I2 MAP_windowed TIP_windowed /end REF_MEASUREMENT /end GROUP
/end MODULE
/end PROJECT
