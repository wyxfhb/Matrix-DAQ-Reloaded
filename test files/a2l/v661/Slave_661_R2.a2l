ASAP2_VERSION 1 61
/begin PROJECT Econtrols_4G "4G Test"
/begin HEADER "4G A2L Configuration" PROJECT_NO EControls4G /* config for version control */ VERSION "$Revision: 82130 $:" /* config for version control */ /end HEADER
/begin MODULE EControls_4G_SH2A "EControls 4G"
/begin MOD_COMMON "" DEPOSIT ABSOLUTE BYTE_ORDER MSB_FIRST /end MOD_COMMON
/* Define the Record Layouts */
/begin RECORD_LAYOUT ECIPP_ALIGNMENT_UBYTE FNC_VALUES 1 UBYTE COLUMN_DIR DIRECT /end RECORD_LAYOUT
/begin RECORD_LAYOUT ECIPP_ALIGNMENT_UWORD FNC_VALUES 1 UWORD COLUMN_DIR DIRECT /end RECORD_LAYOUT
/begin RECORD_LAYOUT ECIPP_ALIGNMENT_ULONG FNC_VALUES 1 ULONG COLUMN_DIR DIRECT /end RECORD_LAYOUT
/begin RECORD_LAYOUT ECIPP_ALIGNMENT_FLOAT32_IEEE FNC_VALUES 1 FLOAT32_IEEE COLUMN_DIR DIRECT /end RECORD_LAYOUT
/begin COMPU_METHOD Compu_IDENTITY "Discrete Values " /* Identifier */ IDENTICAL "%.0" /* Format */ "-" /* Units */ /end COMPU_METHOD
/begin CHARACTERISTIC FCdc4_FPrly_coilshort "FCtl_DTC_0x04(169)" VALUE 0x001E41E8 /* @ECU_Address@FCtl_DTC_0x04@0x024C4152@ */ ECIPP_ALIGNMENT_UWORD 65535 Compu_IDENTITY 0 65535 PHYS_UNIT "System ID + DTC" /end CHARACTERISTIC
/begin CHARACTERISTIC FCdc4_FPrly_gndshort "FCtl_DTC_0x04(167)" VALUE 0x001E41E4 /* @ECU_Address@FCtl_DTC_0x04@0x024C414E@ */ ECIPP_ALIGNMENT_UWORD 65535 Compu_IDENTITY 0 65535 PHYS_UNIT "System ID + DTC" /end CHARACTERISTIC
/begin CHARACTERISTIC FCdc4_FSO_post_TPS_phi_hi "FCtl_DTC_0x04(860)" VALUE 0x001E474E /* @ECU_Address@FCtl_DTC_0x04@0x024C46B8@ */ ECIPP_ALIGNMENT_UWORD 65535 Compu_IDENTITY 0 65535 PHYS_UNIT "System ID + DTC" /end CHARACTERISTIC
/begin CHARACTERISTIC FCdc4_FSO_TPS_phi_hi "FCtl_DTC_0x04(803)" VALUE 0x001E46DC /* @ECU_Address@FCtl_DTC_0x04@0x024C4646@ */ ECIPP_ALIGNMENT_UWORD 65535 Compu_IDENTITY 0 65535 PHYS_UNIT "System ID + DTC" /end CHARACTERISTIC
/begin CHARACTERISTIC FCdc4_FT_maxv "FCtl_DTC_0x04(146)" VALUE 0x001E41BA /* @ECU_Address@FCtl_DTC_0x04@0x024C4124@ */ ECIPP_ALIGNMENT_UWORD 65535 Compu_IDENTITY 0 65535 PHYS_UNIT "System ID + DTC" /end CHARACTERISTIC
/begin CHARACTERISTIC FCdc4_FT_minv "FCtl_DTC_0x04(147)" VALUE 0x001E41BC /* @ECU_Address@FCtl_DTC_0x04@0x024C4126@ */ ECIPP_ALIGNMENT_UWORD 65535 Compu_IDENTITY 0 65535 PHYS_UNIT "System ID + DTC" /end CHARACTERISTIC
/begin CHARACTERISTIC FCdc4_FTgasf_maxv "FCtl_DTC_0x04(215)" VALUE 0x001E4244 /* @ECU_Address@FCtl_DTC_0x04@0x024C41AE@ */ ECIPP_ALIGNMENT_UWORD 65535 Compu_IDENTITY 0 65535 PHYS_UNIT "System ID + DTC" /end CHARACTERISTIC
/begin CHARACTERISTIC FCdc4_FTgasf_minv "FCtl_DTC_0x04(216)" VALUE 0x001E4246 /* @ECU_Address@FCtl_DTC_0x04@0x024C41B0@ */ ECIPP_ALIGNMENT_UWORD 65535 Compu_IDENTITY 0 65535 PHYS_UNIT "System ID + DTC" /end CHARACTERISTIC
/begin CHARACTERISTIC FCdc4_GLOW_unit_fail "FCtl_DTC_0x04(503)" VALUE 0x001E4484 /* @ECU_Address@FCtl_DTC_0x04@0x024C43EE@ */ ECIPP_ALIGNMENT_UWORD 65535 Compu_IDENTITY 0 65535 PHYS_UNIT "System ID + DTC" /end CHARACTERISTIC
/begin CHARACTERISTIC FCdc4_GLOW1_open "FCtl_DTC_0x04(483)" VALUE 0x001E445C /* @ECU_Address@FCtl_DTC_0x04@0x024C43C6@ */ ECIPP_ALIGNMENT_UWORD 65535 Compu_IDENTITY 0 65535 PHYS_UNIT "System ID + DTC" /end CHARACTERISTIC
/begin CHARACTERISTIC FCdc4_GLOW1_short "FCtl_DTC_0x04(493)" VALUE 0x001E4470 /* @ECU_Address@FCtl_DTC_0x04@0x024C43DA@ */ ECIPP_ALIGNMENT_UWORD 65535 Compu_IDENTITY 0 65535 PHYS_UNIT "System ID + DTC" /end CHARACTERISTIC
/begin CHARACTERISTIC FCdc4_gov_ntrlock_fail "FCtl_DTC_0x04(92)" VALUE 0x001E414E /* @ECU_Address@FCtl_DTC_0x04@0x024C40B8@ */ ECIPP_ALIGNMENT_UWORD 65535 Compu_IDENTITY 0 65535 PHYS_UNIT "System ID + DTC" /end CHARACTERISTIC
/begin CHARACTERISTIC FCdc4_gyro_x_max "FCtl_DTC_0x04(708)" VALUE 0x001E461E /* @ECU_Address@FCtl_DTC_0x04@0x024C4588@ */ ECIPP_ALIGNMENT_UWORD 65535 Compu_IDENTITY 0 65535 PHYS_UNIT "System ID + DTC" /end CHARACTERISTIC
/begin CHARACTERISTIC FCdc4_gyro_x_min "FCtl_DTC_0x04(709)" VALUE 0x001E4620 /* @ECU_Address@FCtl_DTC_0x04@0x024C458A@ */ ECIPP_ALIGNMENT_UWORD 65535 Compu_IDENTITY 0 65535 PHYS_UNIT "System ID + DTC" /end CHARACTERISTIC
/begin CHARACTERISTIC FCdc4_gyro_y_max "FCtl_DTC_0x04(710)" VALUE 0x001E4622 /* @ECU_Address@FCtl_DTC_0x04@0x024C458C@ */ ECIPP_ALIGNMENT_UWORD 65535 Compu_IDENTITY 0 65535 PHYS_UNIT "System ID + DTC" /end CHARACTERISTIC
/begin CHARACTERISTIC FCdc4_gyro_y_min "FCtl_DTC_0x04(711)" VALUE 0x001E4624 /* @ECU_Address@FCtl_DTC_0x04@0x024C458E@ */ ECIPP_ALIGNMENT_UWORD 65535 Compu_IDENTITY 0 65535 PHYS_UNIT "System ID + DTC" /end CHARACTERISTIC
/begin CHARACTERISTIC FCdc4_gyro_z_max "FCtl_DTC_0x04(712)" VALUE 0x001E4626 /* @ECU_Address@FCtl_DTC_0x04@0x024C4590@ */ ECIPP_ALIGNMENT_UWORD 65535 Compu_IDENTITY 0 65535 PHYS_UNIT "System ID + DTC" /end CHARACTERISTIC
/begin CHARACTERISTIC FCdc4_gyro_z_min "FCtl_DTC_0x04(713)" VALUE 0x001E4628 /* @ECU_Address@FCtl_DTC_0x04@0x024C4592@ */ ECIPP_ALIGNMENT_UWORD 65535 Compu_IDENTITY 0 65535 PHYS_UNIT "System ID + DTC" /end CHARACTERISTIC
/begin CHARACTERISTIC FCdc4_HBA_I_max "FCtl_DTC_0x04(528)" VALUE 0x001E44B6 /* @ECU_Address@FCtl_DTC_0x04@0x024C4420@ */ ECIPP_ALIGNMENT_UWORD 65535 Compu_IDENTITY 0 65535 PHYS_UNIT "System ID + DTC" /end CHARACTERISTIC
/begin CHARACTERISTIC FCdc4_HBB_I_max "FCtl_DTC_0x04(529)" VALUE 0x001E44B8 /* @ECU_Address@FCtl_DTC_0x04@0x024C4422@ */ ECIPP_ALIGNMENT_UWORD 65535 Compu_IDENTITY 0 65535 PHYS_UNIT "System ID + DTC" /end CHARACTERISTIC
/begin CHARACTERISTIC FCdc4_HiDiagTemp "FCtl_DTC_0x04(652)" VALUE 0x001E45AE /* @ECU_Address@FCtl_DTC_0x04@0x024C4518@ */ ECIPP_ALIGNMENT_UWORD 65535 Compu_IDENTITY 0 65535 PHYS_UNIT "System ID + DTC" /end CHARACTERISTIC
/begin CHARACTERISTIC FCdc4_HWID_fail "FCtl_DTC_0x04(318)" VALUE 0x001E4312 /* @ECU_Address@FCtl_DTC_0x04@0x024C427C@ */ ECIPP_ALIGNMENT_UWORD 65535 Compu_IDENTITY 0 65535 PHYS_UNIT "System ID + DTC" /end CHARACTERISTIC
/begin CHARACTERISTIC FCdc4_IAC_gndshort "FCtl_DTC_0x04(156)" VALUE 0x001E41CE /* @ECU_Address@FCtl_DTC_0x04@0x024C4138@ */ ECIPP_ALIGNMENT_UWORD 65535 Compu_IDENTITY 0 65535 PHYS_UNIT "System ID + DTC" /end CHARACTERISTIC
/begin CHARACTERISTIC FCdc4_IAC_openshort "FCtl_DTC_0x04(157)" VALUE 0x001E41D0 /* @ECU_Address@FCtl_DTC_0x04@0x024C413A@ */ ECIPP_ALIGNMENT_UWORD 65535 Compu_IDENTITY 0 65535 PHYS_UNIT "System ID + DTC" /end CHARACTERISTIC
/begin CHARACTERISTIC FCdc4_IAT_HiExp "FCtl_DTC_0x04(87)" VALUE 0x001E4144 /* @ECU_Address@FCtl_DTC_0x04@0x024C40AE@ */ ECIPP_ALIGNMENT_UWORD 65535 Compu_IDENTITY 0 65535 PHYS_UNIT "System ID + DTC" /end CHARACTERISTIC
/begin CHARACTERISTIC FCdc4_IAT_HiExp2 "FCtl_DTC_0x04(88)" VALUE 0x001E4146 /* @ECU_Address@FCtl_DTC_0x04@0x024C40B0@ */ ECIPP_ALIGNMENT_UWORD 65535 Compu_IDENTITY 0 65535 PHYS_UNIT "System ID + DTC" /end CHARACTERISTIC
/begin CHARACTERISTIC FCdc4_IAT_maxv "FCtl_DTC_0x04(5)" VALUE 0x001E40A0 /* @ECU_Address@FCtl_DTC_0x04@0x024C400A@ */ ECIPP_ALIGNMENT_UWORD 65535 Compu_IDENTITY 0 65535 PHYS_UNIT "System ID + DTC" /end CHARACTERISTIC
/begin CHARACTERISTIC FCdc4_IAT_minv "FCtl_DTC_0x04(6)" VALUE 0x001E40A2 /* @ECU_Address@FCtl_DTC_0x04@0x024C400C@ */ ECIPP_ALIGNMENT_UWORD 65535 Compu_IDENTITY 0 65535 PHYS_UNIT "System ID + DTC" /end CHARACTERISTIC
/begin CHARACTERISTIC FCdc4_IBF_detected "FCtl_DTC_0x04(861)" VALUE 0x001E4750 /* @ECU_Address@FCtl_DTC_0x04@0x024C46BA@ */ ECIPP_ALIGNMENT_UWORD 65535 Compu_IDENTITY 0 65535 PHYS_UNIT "System ID + DTC" /end CHARACTERISTIC
/begin CHARACTERISTIC FCdc4_ICam_maxerr "FCtl_DTC_0x04(288)" VALUE 0x001E42D6 /* @ECU_Address@FCtl_DTC_0x04@0x024C4240@ */ ECIPP_ALIGNMENT_UWORD 65535 Compu_IDENTITY 0 65535 PHYS_UNIT "System ID + DTC" /end CHARACTERISTIC
/begin CHARACTERISTIC FCdc4_ICAVD1_mis "FCtl_DTC_0x04(259)" VALUE 0x001E429C /* @ECU_Address@FCtl_DTC_0x04@0x024C4206@ */ ECIPP_ALIGNMENT_UWORD 65535 Compu_IDENTITY 0 65535 PHYS_UNIT "System ID + DTC" /end CHARACTERISTIC
/begin CHARACTERISTIC FCdc4_ICAVD1_miscat "FCtl_DTC_0x04(267)" VALUE 0x001E42AC /* @ECU_Address@FCtl_DTC_0x04@0x024C4216@ */ ECIPP_ALIGNMENT_UWORD 65535 Compu_IDENTITY 0 65535 PHYS_UNIT "System ID + DTC" /end CHARACTERISTIC
/begin CHARACTERISTIC FCdc4_ICCOT_hi "FCtl_DTC_0x04(863)" VALUE 0x001E4754 /* @ECU_Address@FCtl_DTC_0x04@0x024C46BE@ */ ECIPP_ALIGNMENT_UWORD 65535 Compu_IDENTITY 0 65535 PHYS_UNIT "System ID + DTC" /end CHARACTERISTIC
/begin CHARACTERISTIC FCdc4_Idle_SD "FCtl_DTC_0x04(654)" VALUE 0x001E45B2 /* @ECU_Address@FCtl_DTC_0x04@0x024C451C@ */ ECIPP_ALIGNMENT_UWORD 65535 Compu_IDENTITY 0 65535 PHYS_UNIT "System ID + DTC" /end CHARACTERISTIC
/begin CHARACTERISTIC FCdc4_imu_general "FCtl_DTC_0x04(699)" VALUE 0x001E460C /* @ECU_Address@FCtl_DTC_0x04@0x024C4576@ */ ECIPP_ALIGNMENT_UWORD 65535 Compu_IDENTITY 0 65535 PHYS_UNIT "System ID + DTC" /end CHARACTERISTIC
/begin CHARACTERISTIC FCdc4_imu_temp_max "FCtl_DTC_0x04(700)" VALUE 0x001E460E /* @ECU_Address@FCtl_DTC_0x04@0x024C4578@ */ ECIPP_ALIGNMENT_UWORD 65535 Compu_IDENTITY 0 65535 PHYS_UNIT "System ID + DTC" /end CHARACTERISTIC
/begin CHARACTERISTIC FCdc4_imu_temp_min "FCtl_DTC_0x04(701)" VALUE 0x001E4610 /* @ECU_Address@FCtl_DTC_0x04@0x024C457A@ */ ECIPP_ALIGNMENT_UWORD 65535 Compu_IDENTITY 0 65535 PHYS_UNIT "System ID + DTC" /end CHARACTERISTIC
/begin CHARACTERISTIC FCdc4_IMVD_Ifb_hi "FCtl_DTC_0x04(583)" VALUE 0x001E4524 /* @ECU_Address@FCtl_DTC_0x04@0x024C448E@ */ ECIPP_ALIGNMENT_UWORD 65535 Compu_IDENTITY 0 65535 PHYS_UNIT "System ID + DTC" /end CHARACTERISTIC
/begin CHARACTERISTIC FCdc4_IMVD_Ifb_lo "FCtl_DTC_0x04(582)" VALUE 0x001E4522 /* @ECU_Address@FCtl_DTC_0x04@0x024C448C@ */ ECIPP_ALIGNMENT_UWORD 65535 Compu_IDENTITY 0 65535 PHYS_UNIT "System ID + DTC" /end CHARACTERISTIC
/begin CHARACTERISTIC FCdc4_INJD_boost_lo "FCtl_DTC_0x04(578)" VALUE 0x001E451A /* @ECU_Address@FCtl_DTC_0x04@0x024C4484@ */ ECIPP_ALIGNMENT_UWORD 65535 Compu_IDENTITY 0 65535 PHYS_UNIT "System ID + DTC" /end CHARACTERISTIC
/begin CHARACTERISTIC FCdc4_INJD_HS_Ihi "FCtl_DTC_0x04(562)" VALUE 0x001E44FA /* @ECU_Address@FCtl_DTC_0x04@0x024C4464@ */ ECIPP_ALIGNMENT_UWORD 65535 Compu_IDENTITY 0 65535 PHYS_UNIT "System ID + DTC" /end CHARACTERISTIC
/begin CHARACTERISTIC FCdc4_INJD_HW_int "FCtl_DTC_0x04(580)" VALUE 0x001E451E /* @ECU_Address@FCtl_DTC_0x04@0x024C4488@ */ ECIPP_ALIGNMENT_UWORD 65535 Compu_IDENTITY 0 65535 PHYS_UNIT "System ID + DTC" /end CHARACTERISTIC
/begin CHARACTERISTIC FCdc4_INJD_LS_Ihi "FCtl_DTC_0x04(570)" VALUE 0x001E450A /* @ECU_Address@FCtl_DTC_0x04@0x024C4474@ */ ECIPP_ALIGNMENT_UWORD 65535 Compu_IDENTITY 0 65535 PHYS_UNIT "System ID + DTC" /end CHARACTERISTIC
/begin CHARACTERISTIC FCdc4_INJD_off_lo "FCtl_DTC_0x04(46)" VALUE 0x001E40F2 /* @ECU_Address@FCtl_DTC_0x04@0x024C405C@ */ ECIPP_ALIGNMENT_UWORD 65535 Compu_IDENTITY 0 65535 PHYS_UNIT "System ID + DTC" /end CHARACTERISTIC
/begin CHARACTERISTIC FCdc4_INJD_on_hi "FCtl_DTC_0x04(56)" VALUE 0x001E4106 /* @ECU_Address@FCtl_DTC_0x04@0x024C4070@ */ ECIPP_ALIGNMENT_UWORD 65535 Compu_IDENTITY 0 65535 PHYS_UNIT "System ID + DTC" /end CHARACTERISTIC
/begin CHARACTERISTIC FCdc4_intby_poserr "FCtl_DTC_0x04(864)" VALUE 0x001E4756 /* @ECU_Address@FCtl_DTC_0x04@0x024C46C0@ */ ECIPP_ALIGNMENT_UWORD 65535 Compu_IDENTITY 0 65535 PHYS_UNIT "System ID + DTC" /end CHARACTERISTIC
/begin CHARACTERISTIC FCdc4_interrupt "FCtl_DTC_0x04(104)" VALUE 0x001E4166 /* @ECU_Address@FCtl_DTC_0x04@0x024C40D0@ */ ECIPP_ALIGNMENT_UWORD 65535 Compu_IDENTITY 0 65535 PHYS_UNIT "System ID + DTC" /end CHARACTERISTIC
/begin CHARACTERISTIC FCdc4_IRV_CL_OOA "FCtl_DTC_0x04(869)" VALUE 0x001E4760 /* @ECU_Address@FCtl_DTC_0x04@0x024C46CA@ */ ECIPP_ALIGNMENT_UWORD 65535 Compu_IDENTITY 0 65535 PHYS_UNIT "System ID + DTC" /end CHARACTERISTIC
/begin CHARACTERISTIC FCdc4_J1939_AAT_err_loss "FCtl_DTC_0x04(835)" VALUE 0x001E471C /* @ECU_Address@FCtl_DTC_0x04@0x024C4686@ */ ECIPP_ALIGNMENT_UWORD 65535 Compu_IDENTITY 0 65535 PHYS_UNIT "System ID + DTC" /end CHARACTERISTIC
/begin CHARACTERISTIC FCdc4_J1939_addr2Fail "FCtl_DTC_0x04(301)" VALUE 0x001E42F0 /* @ECU_Address@FCtl_DTC_0x04@0x024C425A@ */ ECIPP_ALIGNMENT_UWORD 65535 Compu_IDENTITY 0 65535 PHYS_UNIT "System ID + DTC" /end CHARACTERISTIC
/begin CHARACTERISTIC FCdc4_J1939_addr3Fail "FCtl_DTC_0x04(302)" VALUE 0x001E42F2 /* @ECU_Address@FCtl_DTC_0x04@0x024C425C@ */ ECIPP_ALIGNMENT_UWORD 65535 Compu_IDENTITY 0 65535 PHYS_UNIT "System ID + DTC" /end CHARACTERISTIC
/begin CHARACTERISTIC FCdc4_J1939_addrFail "FCtl_DTC_0x04(188)" VALUE 0x001E420E /* @ECU_Address@FCtl_DTC_0x04@0x024C4178@ */ ECIPP_ALIGNMENT_UWORD 65535 Compu_IDENTITY 0 65535 PHYS_UNIT "System ID + DTC" /end CHARACTERISTIC
/begin CHARACTERISTIC FCdc4_J1939_ETC_loss "FCtl_DTC_0x04(219)" VALUE 0x001E424C /* @ECU_Address@FCtl_DTC_0x04@0x024C41B6@ */ ECIPP_ALIGNMENT_UWORD 65535 Compu_IDENTITY 0 65535 PHYS_UNIT "System ID + DTC" /end CHARACTERISTIC
/begin CHARACTERISTIC FCdc4_J1939_ETC_loss2 "FCtl_DTC_0x04(275)" VALUE 0x001E42BC /* @ECU_Address@FCtl_DTC_0x04@0x024C4226@ */ ECIPP_ALIGNMENT_UWORD 65535 Compu_IDENTITY 0 65535 PHYS_UNIT "System ID + DTC" /end CHARACTERISTIC
/begin CHARACTERISTIC FCdc4_J1939_PGN_tout "FCtl_DTC_0x04(714)" VALUE 0x001E462A /* @ECU_Address@FCtl_DTC_0x04@0x024C4594@ */ ECIPP_ALIGNMENT_UWORD 65535 Compu_IDENTITY 0 65535 PHYS_UNIT "System ID + DTC" /end CHARACTERISTIC
/begin CHARACTERISTIC FCdc4_J1939_PGN_tout10 "FCtl_DTC_0x04(723)" VALUE 0x001E463C /* @ECU_Address@FCtl_DTC_0x04@0x024C45A6@ */ ECIPP_ALIGNMENT_UWORD 65535 Compu_IDENTITY 0 65535 PHYS_UNIT "System ID + DTC" /end CHARACTERISTIC
/begin CHARACTERISTIC FCdc4_J1939_PGN_tout2 "FCtl_DTC_0x04(715)" VALUE 0x001E462C /* @ECU_Address@FCtl_DTC_0x04@0x024C4596@ */ ECIPP_ALIGNMENT_UWORD 65535 Compu_IDENTITY 0 65535 PHYS_UNIT "System ID + DTC" /end CHARACTERISTIC
/begin CHARACTERISTIC FCdc4_J1939_PGN_tout3 "FCtl_DTC_0x04(716)" VALUE 0x001E462E /* @ECU_Address@FCtl_DTC_0x04@0x024C4598@ */ ECIPP_ALIGNMENT_UWORD 65535 Compu_IDENTITY 0 65535 PHYS_UNIT "System ID + DTC" /end CHARACTERISTIC
/begin CHARACTERISTIC FCdc4_J1939_PGN_tout4 "FCtl_DTC_0x04(717)" VALUE 0x001E4630 /* @ECU_Address@FCtl_DTC_0x04@0x024C459A@ */ ECIPP_ALIGNMENT_UWORD 65535 Compu_IDENTITY 0 65535 PHYS_UNIT "System ID + DTC" /end CHARACTERISTIC
/begin CHARACTERISTIC FCdc4_J1939_PGN_tout5 "FCtl_DTC_0x04(718)" VALUE 0x001E4632 /* @ECU_Address@FCtl_DTC_0x04@0x024C459C@ */ ECIPP_ALIGNMENT_UWORD 65535 Compu_IDENTITY 0 65535 PHYS_UNIT "System ID + DTC" /end CHARACTERISTIC
/begin CHARACTERISTIC FCdc4_J1939_PGN_tout6 "FCtl_DTC_0x04(719)" VALUE 0x001E4634 /* @ECU_Address@FCtl_DTC_0x04@0x024C459E@ */ ECIPP_ALIGNMENT_UWORD 65535 Compu_IDENTITY 0 65535 PHYS_UNIT "System ID + DTC" /end CHARACTERISTIC
/begin CHARACTERISTIC FCdc4_J1939_PGN_tout7 "FCtl_DTC_0x04(720)" VALUE 0x001E4636 /* @ECU_Address@FCtl_DTC_0x04@0x024C45A0@ */ ECIPP_ALIGNMENT_UWORD 65535 Compu_IDENTITY 0 65535 PHYS_UNIT "System ID + DTC" /end CHARACTERISTIC
/begin CHARACTERISTIC FCdc4_J1939_PGN_tout8 "FCtl_DTC_0x04(721)" VALUE 0x001E4638 /* @ECU_Address@FCtl_DTC_0x04@0x024C45A2@ */ ECIPP_ALIGNMENT_UWORD 65535 Compu_IDENTITY 0 65535 PHYS_UNIT "System ID + DTC" /end CHARACTERISTIC
/begin CHARACTERISTIC FCdc4_J1939_PGN_tout9 "FCtl_DTC_0x04(722)" VALUE 0x001E463A /* @ECU_Address@FCtl_DTC_0x04@0x024C45A4@ */ ECIPP_ALIGNMENT_UWORD 65535 Compu_IDENTITY 0 65535 PHYS_UNIT "System ID + DTC" /end CHARACTERISTIC
/begin CHARACTERISTIC FCdc4_J1939_RS_err_loss "FCtl_DTC_0x04(834)" VALUE 0x001E471A /* @ECU_Address@FCtl_DTC_0x04@0x024C4684@ */ ECIPP_ALIGNMENT_UWORD 65535 Compu_IDENTITY 0 65535 PHYS_UNIT "System ID + DTC" /end CHARACTERISTIC
/begin CHARACTERISTIC FCdc4_J1939_RSsetpt_loss "FCtl_DTC_0x04(600)" VALUE 0x001E4546 /* @ECU_Address@FCtl_DTC_0x04@0x024C44B0@ */ ECIPP_ALIGNMENT_UWORD 65535 Compu_IDENTITY 0 65535 PHYS_UNIT "System ID + DTC" /end CHARACTERISTIC
/begin CHARACTERISTIC FCdc4_J1939_Rx2Fail "FCtl_DTC_0x04(299)" VALUE 0x001E42EC /* @ECU_Address@FCtl_DTC_0x04@0x024C4256@ */ ECIPP_ALIGNMENT_UWORD 65535 Compu_IDENTITY 0 65535 PHYS_UNIT "System ID + DTC" /end CHARACTERISTIC
/begin CHARACTERISTIC FCdc4_J1939_Rx3Fail "FCtl_DTC_0x04(300)" VALUE 0x001E42EE /* @ECU_Address@FCtl_DTC_0x04@0x024C4258@ */ ECIPP_ALIGNMENT_UWORD 65535 Compu_IDENTITY 0 65535 PHYS_UNIT "System ID + DTC" /end CHARACTERISTIC
/begin CHARACTERISTIC FCdc4_J1939_RxFail "FCtl_DTC_0x04(155)" VALUE 0x001E41CC /* @ECU_Address@FCtl_DTC_0x04@0x024C4136@ */ ECIPP_ALIGNMENT_UWORD 65535 Compu_IDENTITY 0 65535 PHYS_UNIT "System ID + DTC" /end CHARACTERISTIC
/begin CHARACTERISTIC FCdc4_J1939_SD_rq "FCtl_DTC_0x04(153)" VALUE 0x001E41C8 /* @ECU_Address@FCtl_DTC_0x04@0x024C4132@ */ ECIPP_ALIGNMENT_UWORD 65535 Compu_IDENTITY 0 65535 PHYS_UNIT "System ID + DTC" /end CHARACTERISTIC
/begin CHARACTERISTIC FPnd_FPrly_coilshort "FPrm_pending(129)" VALUE 0x001E5214 /* @ECU_Address@FPrm_pending@0x021BE102@ */ ECIPP_ALIGNMENT_UWORD 65535 Compu_IDENTITY 0 65535 PHYS_UNIT "Bit Mask" /end CHARACTERISTIC
/begin CHARACTERISTIC FPnd_FPrly_gndshort "FPrm_pending(127)" VALUE 0x001E5210 /* @ECU_Address@FPrm_pending@0x021BE0FE@ */ ECIPP_ALIGNMENT_UWORD 65535 Compu_IDENTITY 0 65535 PHYS_UNIT "Bit Mask" /end CHARACTERISTIC
/begin CHARACTERISTIC FPnd_FSO_post_TPS_phi_hi "FPrm_pending(687)" VALUE 0x001E5670 /* @ECU_Address@FPrm_pending@0x021BE55E@ */ ECIPP_ALIGNMENT_UWORD 65535 Compu_IDENTITY 0 65535 PHYS_UNIT "Bit Mask" /end CHARACTERISTIC
/begin CHARACTERISTIC FPnd_FSO_TPS_phi_hi "FPrm_pending(632)" VALUE 0x001E5602 /* @ECU_Address@FPrm_pending@0x021BE4F0@ */ ECIPP_ALIGNMENT_UWORD 65535 Compu_IDENTITY 0 65535 PHYS_UNIT "Bit Mask" /end CHARACTERISTIC
/begin CHARACTERISTIC FPnd_FT_maxv "FPrm_pending(106)" VALUE 0x001E51E6 /* @ECU_Address@FPrm_pending@0x021BE0D4@ */ ECIPP_ALIGNMENT_UWORD 65535 Compu_IDENTITY 0 65535 PHYS_UNIT "Bit Mask" /end CHARACTERISTIC
/begin CHARACTERISTIC FPnd_FT_minv "FPrm_pending(107)" VALUE 0x001E51E8 /* @ECU_Address@FPrm_pending@0x021BE0D6@ */ ECIPP_ALIGNMENT_UWORD 65535 Compu_IDENTITY 0 65535 PHYS_UNIT "Bit Mask" /end CHARACTERISTIC
/begin CHARACTERISTIC FPnd_FTgasf_maxv "FPrm_pending(171)" VALUE 0x001E5268 /* @ECU_Address@FPrm_pending@0x021BE156@ */ ECIPP_ALIGNMENT_UWORD 65535 Compu_IDENTITY 0 65535 PHYS_UNIT "Bit Mask" /end CHARACTERISTIC
/begin CHARACTERISTIC FPnd_FTgasf_minv "FPrm_pending(172)" VALUE 0x001E526A /* @ECU_Address@FPrm_pending@0x021BE158@ */ ECIPP_ALIGNMENT_UWORD 65535 Compu_IDENTITY 0 65535 PHYS_UNIT "Bit Mask" /end CHARACTERISTIC
/begin CHARACTERISTIC FPnd_GLOW_unit_fail "FPrm_pending(382)" VALUE 0x001E540E /* @ECU_Address@FPrm_pending@0x021BE2FC@ */ ECIPP_ALIGNMENT_UWORD 65535 Compu_IDENTITY 0 65535 PHYS_UNIT "Bit Mask" /end CHARACTERISTIC
/begin CHARACTERISTIC FPnd_GLOW1_open "FPrm_pending(380)" VALUE 0x001E540A /* @ECU_Address@FPrm_pending@0x021BE2F8@ */ ECIPP_ALIGNMENT_UWORD 65535 Compu_IDENTITY 0 65535 PHYS_UNIT "Bit Mask" /end CHARACTERISTIC
/begin CHARACTERISTIC FPnd_GLOW1_short "FPrm_pending(381)" VALUE 0x001E540C /* @ECU_Address@FPrm_pending@0x021BE2FA@ */ ECIPP_ALIGNMENT_UWORD 65535 Compu_IDENTITY 0 65535 PHYS_UNIT "Bit Mask" /end CHARACTERISTIC
/begin CHARACTERISTIC FPnd_gov_ntrlock_fail "FPrm_pending(36)" VALUE 0x001E515A /* @ECU_Address@FPrm_pending@0x021BE048@ */ ECIPP_ALIGNMENT_UWORD 65535 Compu_IDENTITY 0 65535 PHYS_UNIT "Bit Mask" /end CHARACTERISTIC
/begin CHARACTERISTIC FPnd_gyro_x_max "FPrm_pending(538)" VALUE 0x001E5546 /* @ECU_Address@FPrm_pending@0x021BE434@ */ ECIPP_ALIGNMENT_UWORD 65535 Compu_IDENTITY 0 65535 PHYS_UNIT "Bit Mask" /end CHARACTERISTIC
/begin CHARACTERISTIC FPnd_gyro_x_min "FPrm_pending(539)" VALUE 0x001E5548 /* @ECU_Address@FPrm_pending@0x021BE436@ */ ECIPP_ALIGNMENT_UWORD 65535 Compu_IDENTITY 0 65535 PHYS_UNIT "Bit Mask" /end CHARACTERISTIC
/begin CHARACTERISTIC FPnd_gyro_y_max "FPrm_pending(540)" VALUE 0x001E554A /* @ECU_Address@FPrm_pending@0x021BE438@ */ ECIPP_ALIGNMENT_UWORD 65535 Compu_IDENTITY 0 65535 PHYS_UNIT "Bit Mask" /end CHARACTERISTIC
/begin CHARACTERISTIC FPnd_gyro_y_min "FPrm_pending(541)" VALUE 0x001E554C /* @ECU_Address@FPrm_pending@0x021BE43A@ */ ECIPP_ALIGNMENT_UWORD 65535 Compu_IDENTITY 0 65535 PHYS_UNIT "Bit Mask" /end CHARACTERISTIC
/begin CHARACTERISTIC FPnd_gyro_z_max "FPrm_pending(542)" VALUE 0x001E554E /* @ECU_Address@FPrm_pending@0x021BE43C@ */ ECIPP_ALIGNMENT_UWORD 65535 Compu_IDENTITY 0 65535 PHYS_UNIT "Bit Mask" /end CHARACTERISTIC
/begin CHARACTERISTIC FPnd_gyro_z_min "FPrm_pending(543)" VALUE 0x001E5550 /* @ECU_Address@FPrm_pending@0x021BE43E@ */ ECIPP_ALIGNMENT_UWORD 65535 Compu_IDENTITY 0 65535 PHYS_UNIT "Bit Mask" /end CHARACTERISTIC
/begin CHARACTERISTIC FPnd_HBA_I_max "FPrm_pending(398)" VALUE 0x001E542E /* @ECU_Address@FPrm_pending@0x021BE31C@ */ ECIPP_ALIGNMENT_UWORD 65535 Compu_IDENTITY 0 65535 PHYS_UNIT "Bit Mask" /end CHARACTERISTIC
/begin CHARACTERISTIC FPnd_HBB_I_max "FPrm_pending(399)" VALUE 0x001E5430 /* @ECU_Address@FPrm_pending@0x021BE31E@ */ ECIPP_ALIGNMENT_UWORD 65535 Compu_IDENTITY 0 65535 PHYS_UNIT "Bit Mask" /end CHARACTERISTIC
/begin CHARACTERISTIC FPnd_HiDiagTemp "FPrm_pending(482)" VALUE 0x001E54D6 /* @ECU_Address@FPrm_pending@0x021BE3C4@ */ ECIPP_ALIGNMENT_UWORD 65535 Compu_IDENTITY 0 65535 PHYS_UNIT "Bit Mask" /end CHARACTERISTIC
/begin CHARACTERISTIC FPnd_HWID_fail "FPrm_pending(227)" VALUE 0x001E52D8 /* @ECU_Address@FPrm_pending@0x021BE1C6@ */ ECIPP_ALIGNMENT_UWORD 65535 Compu_IDENTITY 0 65535 PHYS_UNIT "Bit Mask" /end CHARACTERISTIC
/begin CHARACTERISTIC FPnd_IAC_gndshort "FPrm_pending(116)" VALUE 0x001E51FA /* @ECU_Address@FPrm_pending@0x021BE0E8@ */ ECIPP_ALIGNMENT_UWORD 65535 Compu_IDENTITY 0 65535 PHYS_UNIT "Bit Mask" /end CHARACTERISTIC
/begin CHARACTERISTIC FPnd_IAC_openshort "FPrm_pending(117)" VALUE 0x001E51FC /* @ECU_Address@FPrm_pending@0x021BE0EA@ */ ECIPP_ALIGNMENT_UWORD 65535 Compu_IDENTITY 0 65535 PHYS_UNIT "Bit Mask" /end CHARACTERISTIC
/begin CHARACTERISTIC FPnd_IAT_HiExp "FPrm_pending(8)" VALUE 0x001E5122 /* @ECU_Address@FPrm_pending@0x021BE010@ */ ECIPP_ALIGNMENT_UWORD 65535 Compu_IDENTITY 0 65535 PHYS_UNIT "Bit Mask" /end CHARACTERISTIC
/begin CHARACTERISTIC FPnd_IAT_HiExp2 "FPrm_pending(9)" VALUE 0x001E5124 /* @ECU_Address@FPrm_pending@0x021BE012@ */ ECIPP_ALIGNMENT_UWORD 65535 Compu_IDENTITY 0 65535 PHYS_UNIT "Bit Mask" /end CHARACTERISTIC
/begin CHARACTERISTIC FPnd_IAT_maxv "FPrm_pending(6)" VALUE 0x001E511E /* @ECU_Address@FPrm_pending@0x021BE00C@ */ ECIPP_ALIGNMENT_UWORD 65535 Compu_IDENTITY 0 65535 PHYS_UNIT "Bit Mask" /end CHARACTERISTIC
/begin CHARACTERISTIC FPnd_IAT_minv "FPrm_pending(7)" VALUE 0x001E5120 /* @ECU_Address@FPrm_pending@0x021BE00E@ */ ECIPP_ALIGNMENT_UWORD 65535 Compu_IDENTITY 0 65535 PHYS_UNIT "Bit Mask" /end CHARACTERISTIC
/begin CHARACTERISTIC FPnd_IBF_detected "FPrm_pending(688)" VALUE 0x001E5672 /* @ECU_Address@FPrm_pending@0x021BE560@ */ ECIPP_ALIGNMENT_UWORD 65535 Compu_IDENTITY 0 65535 PHYS_UNIT "Bit Mask" /end CHARACTERISTIC
/begin CHARACTERISTIC FPnd_ICam_maxerr "FPrm_pending(210)" VALUE 0x001E52B6 /* @ECU_Address@FPrm_pending@0x021BE1A4@ */ ECIPP_ALIGNMENT_UWORD 65535 Compu_IDENTITY 0 65535 PHYS_UNIT "Bit Mask" /end CHARACTERISTIC
/begin CHARACTERISTIC FPnd_ICAVD1_mis "FPrm_pending(195)" VALUE 0x001E5298 /* @ECU_Address@FPrm_pending@0x021BE186@ */ ECIPP_ALIGNMENT_UWORD 65535 Compu_IDENTITY 0 65535 PHYS_UNIT "Bit Mask" /end CHARACTERISTIC
/begin CHARACTERISTIC FPnd_ICAVD1_miscat "FPrm_pending(196)" VALUE 0x001E529A /* @ECU_Address@FPrm_pending@0x021BE188@ */ ECIPP_ALIGNMENT_UWORD 65535 Compu_IDENTITY 0 65535 PHYS_UNIT "Bit Mask" /end CHARACTERISTIC
/begin CHARACTERISTIC FPnd_ICCOT_hi "FPrm_pending(690)" VALUE 0x001E5676 /* @ECU_Address@FPrm_pending@0x021BE564@ */ ECIPP_ALIGNMENT_UWORD 65535 Compu_IDENTITY 0 65535 PHYS_UNIT "Bit Mask" /end CHARACTERISTIC
/begin CHARACTERISTIC FPnd_Idle_SD "FPrm_pending(484)" VALUE 0x001E54DA /* @ECU_Address@FPrm_pending@0x021BE3C8@ */ ECIPP_ALIGNMENT_UWORD 65535 Compu_IDENTITY 0 65535 PHYS_UNIT "Bit Mask" /end CHARACTERISTIC
/begin CHARACTERISTIC FPnd_imu_general "FPrm_pending(529)" VALUE 0x001E5534 /* @ECU_Address@FPrm_pending@0x021BE422@ */ ECIPP_ALIGNMENT_UWORD 65535 Compu_IDENTITY 0 65535 PHYS_UNIT "Bit Mask" /end CHARACTERISTIC
/begin CHARACTERISTIC FPnd_imu_temp_max "FPrm_pending(530)" VALUE 0x001E5536 /* @ECU_Address@FPrm_pending@0x021BE424@ */ ECIPP_ALIGNMENT_UWORD 65535 Compu_IDENTITY 0 65535 PHYS_UNIT "Bit Mask" /end CHARACTERISTIC
/begin CHARACTERISTIC FPnd_imu_temp_min "FPrm_pending(531)" VALUE 0x001E5538 /* @ECU_Address@FPrm_pending@0x021BE426@ */ ECIPP_ALIGNMENT_UWORD 65535 Compu_IDENTITY 0 65535 PHYS_UNIT "Bit Mask" /end CHARACTERISTIC
/begin CHARACTERISTIC FPnd_IMVD_Ifb_hi "FPrm_pending(437)" VALUE 0x001E547C /* @ECU_Address@FPrm_pending@0x021BE36A@ */ ECIPP_ALIGNMENT_UWORD 65535 Compu_IDENTITY 0 65535 PHYS_UNIT "Bit Mask" /end CHARACTERISTIC
/begin CHARACTERISTIC FPnd_IMVD_Ifb_lo "FPrm_pending(436)" VALUE 0x001E547A /* @ECU_Address@FPrm_pending@0x021BE368@ */ ECIPP_ALIGNMENT_UWORD 65535 Compu_IDENTITY 0 65535 PHYS_UNIT "Bit Mask" /end CHARACTERISTIC
/begin CHARACTERISTIC FPnd_INJD_boost_lo "FPrm_pending(434)" VALUE 0x001E5476 /* @ECU_Address@FPrm_pending@0x021BE364@ */ ECIPP_ALIGNMENT_UWORD 65535 Compu_IDENTITY 0 65535 PHYS_UNIT "Bit Mask" /end CHARACTERISTIC
/begin CHARACTERISTIC FPnd_INJD_HS_Ihi "FPrm_pending(432)" VALUE 0x001E5472 /* @ECU_Address@FPrm_pending@0x021BE360@ */ ECIPP_ALIGNMENT_UWORD 65535 Compu_IDENTITY 0 65535 PHYS_UNIT "Bit Mask" /end CHARACTERISTIC
/begin CHARACTERISTIC FPnd_INJD_HW_int "FPrm_pending(435)" VALUE 0x001E5478 /* @ECU_Address@FPrm_pending@0x021BE366@ */ ECIPP_ALIGNMENT_UWORD 65535 Compu_IDENTITY 0 65535 PHYS_UNIT "Bit Mask" /end CHARACTERISTIC
/begin CHARACTERISTIC FPnd_INJD_LS_Ihi "FPrm_pending(433)" VALUE 0x001E5474 /* @ECU_Address@FPrm_pending@0x021BE362@ */ ECIPP_ALIGNMENT_UWORD 65535 Compu_IDENTITY 0 65535 PHYS_UNIT "Bit Mask" /end CHARACTERISTIC
/begin CHARACTERISTIC FPnd_INJD_off_lo "FPrm_pending(53)" VALUE 0x001E517C /* @ECU_Address@FPrm_pending@0x021BE06A@ */ ECIPP_ALIGNMENT_UWORD 65535 Compu_IDENTITY 0 65535 PHYS_UNIT "Bit Mask" /end CHARACTERISTIC
/begin CHARACTERISTIC FPnd_INJD_on_hi "FPrm_pending(54)" VALUE 0x001E517E /* @ECU_Address@FPrm_pending@0x021BE06C@ */ ECIPP_ALIGNMENT_UWORD 65535 Compu_IDENTITY 0 65535 PHYS_UNIT "Bit Mask" /end CHARACTERISTIC
/begin CHARACTERISTIC FPnd_intby_poserr "FPrm_pending(691)" VALUE 0x001E5678 /* @ECU_Address@FPrm_pending@0x021BE566@ */ ECIPP_ALIGNMENT_UWORD 65535 Compu_IDENTITY 0 65535 PHYS_UNIT "Bit Mask" /end CHARACTERISTIC
/begin CHARACTERISTIC FPnd_interrupt "FPrm_pending(68)" VALUE 0x001E519A /* @ECU_Address@FPrm_pending@0x021BE088@ */ ECIPP_ALIGNMENT_UWORD 65535 Compu_IDENTITY 0 65535 PHYS_UNIT "Bit Mask" /end CHARACTERISTIC
/begin CHARACTERISTIC FPnd_IRV_CL_OOA "FPrm_pending(696)" VALUE 0x001E5682 /* @ECU_Address@FPrm_pending@0x021BE570@ */ ECIPP_ALIGNMENT_UWORD 65535 Compu_IDENTITY 0 65535 PHYS_UNIT "Bit Mask" /end CHARACTERISTIC
/begin CHARACTERISTIC FPnd_J1939_AAT_err_loss "FPrm_pending(662)" VALUE 0x001E563E /* @ECU_Address@FPrm_pending@0x021BE52C@ */ ECIPP_ALIGNMENT_UWORD 65535 Compu_IDENTITY 0 65535 PHYS_UNIT "Bit Mask" /end CHARACTERISTIC
/begin CHARACTERISTIC FPnd_J1939_addr2Fail "FPrm_pending(223)" VALUE 0x001E52D0 /* @ECU_Address@FPrm_pending@0x021BE1BE@ */ ECIPP_ALIGNMENT_UWORD 65535 Compu_IDENTITY 0 65535 PHYS_UNIT "Bit Mask" /end CHARACTERISTIC
/begin CHARACTERISTIC FPnd_J1939_addr3Fail "FPrm_pending(224)" VALUE 0x001E52D2 /* @ECU_Address@FPrm_pending@0x021BE1C0@ */ ECIPP_ALIGNMENT_UWORD 65535 Compu_IDENTITY 0 65535 PHYS_UNIT "Bit Mask" /end CHARACTERISTIC
/begin CHARACTERISTIC FPnd_J1939_addrFail "FPrm_pending(146)" VALUE 0x001E5236 /* @ECU_Address@FPrm_pending@0x021BE124@ */ ECIPP_ALIGNMENT_UWORD 65535 Compu_IDENTITY 0 65535 PHYS_UNIT "Bit Mask" /end CHARACTERISTIC
/begin CHARACTERISTIC FPnd_J1939_ETC_loss "FPrm_pending(175)" VALUE 0x001E5270 /* @ECU_Address@FPrm_pending@0x021BE15E@ */ ECIPP_ALIGNMENT_UWORD 65535 Compu_IDENTITY 0 65535 PHYS_UNIT "Bit Mask" /end CHARACTERISTIC
/begin CHARACTERISTIC FPnd_J1939_ETC_loss2 "FPrm_pending(197)" VALUE 0x001E529C /* @ECU_Address@FPrm_pending@0x021BE18A@ */ ECIPP_ALIGNMENT_UWORD 65535 Compu_IDENTITY 0 65535 PHYS_UNIT "Bit Mask" /end CHARACTERISTIC
/begin CHARACTERISTIC FPnd_J1939_PGN_tout "FPrm_pending(544)" VALUE 0x001E5552 /* @ECU_Address@FPrm_pending@0x021BE440@ */ ECIPP_ALIGNMENT_UWORD 65535 Compu_IDENTITY 0 65535 PHYS_UNIT "Bit Mask" /end CHARACTERISTIC
/begin CHARACTERISTIC FPnd_J1939_PGN_tout10 "FPrm_pending(553)" VALUE 0x001E5564 /* @ECU_Address@FPrm_pending@0x021BE452@ */ ECIPP_ALIGNMENT_UWORD 65535 Compu_IDENTITY 0 65535 PHYS_UNIT "Bit Mask" /end CHARACTERISTIC
/begin CHARACTERISTIC FPnd_J1939_PGN_tout2 "FPrm_pending(545)" VALUE 0x001E5554 /* @ECU_Address@FPrm_pending@0x021BE442@ */ ECIPP_ALIGNMENT_UWORD 65535 Compu_IDENTITY 0 65535 PHYS_UNIT "Bit Mask" /end CHARACTERISTIC
/begin CHARACTERISTIC FPnd_J1939_PGN_tout3 "FPrm_pending(546)" VALUE 0x001E5556 /* @ECU_Address@FPrm_pending@0x021BE444@ */ ECIPP_ALIGNMENT_UWORD 65535 Compu_IDENTITY 0 65535 PHYS_UNIT "Bit Mask" /end CHARACTERISTIC
/begin CHARACTERISTIC FPnd_J1939_PGN_tout4 "FPrm_pending(547)" VALUE 0x001E5558 /* @ECU_Address@FPrm_pending@0x021BE446@ */ ECIPP_ALIGNMENT_UWORD 65535 Compu_IDENTITY 0 65535 PHYS_UNIT "Bit Mask" /end CHARACTERISTIC
/begin CHARACTERISTIC FPnd_J1939_PGN_tout5 "FPrm_pending(548)" VALUE 0x001E555A /* @ECU_Address@FPrm_pending@0x021BE448@ */ ECIPP_ALIGNMENT_UWORD 65535 Compu_IDENTITY 0 65535 PHYS_UNIT "Bit Mask" /end CHARACTERISTIC
/begin CHARACTERISTIC FPnd_J1939_PGN_tout6 "FPrm_pending(549)" VALUE 0x001E555C /* @ECU_Address@FPrm_pending@0x021BE44A@ */ ECIPP_ALIGNMENT_UWORD 65535 Compu_IDENTITY 0 65535 PHYS_UNIT "Bit Mask" /end CHARACTERISTIC
/begin CHARACTERISTIC FPnd_J1939_PGN_tout7 "FPrm_pending(550)" VALUE 0x001E555E /* @ECU_Address@FPrm_pending@0x021BE44C@ */ ECIPP_ALIGNMENT_UWORD 65535 Compu_IDENTITY 0 65535 PHYS_UNIT "Bit Mask" /end CHARACTERISTIC
/begin CHARACTERISTIC FPnd_J1939_PGN_tout8 "FPrm_pending(551)" VALUE 0x001E5560 /* @ECU_Address@FPrm_pending@0x021BE44E@ */ ECIPP_ALIGNMENT_UWORD 65535 Compu_IDENTITY 0 65535 PHYS_UNIT "Bit Mask" /end CHARACTERISTIC
/begin CHARACTERISTIC FPnd_J1939_PGN_tout9 "FPrm_pending(552)" VALUE 0x001E5562 /* @ECU_Address@FPrm_pending@0x021BE450@ */ ECIPP_ALIGNMENT_UWORD 65535 Compu_IDENTITY 0 65535 PHYS_UNIT "Bit Mask" /end CHARACTERISTIC
/begin CHARACTERISTIC FPnd_J1939_RS_err_loss "FPrm_pending(661)" VALUE 0x001E563C /* @ECU_Address@FPrm_pending@0x021BE52A@ */ ECIPP_ALIGNMENT_UWORD 65535 Compu_IDENTITY 0 65535 PHYS_UNIT "Bit Mask" /end CHARACTERISTIC
/begin CHARACTERISTIC FPnd_J1939_RSsetpt_loss "FPrm_pending(454)" VALUE 0x001E549E /* @ECU_Address@FPrm_pending@0x021BE38C@ */ ECIPP_ALIGNMENT_UWORD 65535 Compu_IDENTITY 0 65535 PHYS_UNIT "Bit Mask" /end CHARACTERISTIC
/begin CHARACTERISTIC FPnd_J1939_Rx2Fail "FPrm_pending(221)" VALUE 0x001E52CC /* @ECU_Address@FPrm_pending@0x021BE1BA@ */ ECIPP_ALIGNMENT_UWORD 65535 Compu_IDENTITY 0 65535 PHYS_UNIT "Bit Mask" /end CHARACTERISTIC
/begin CHARACTERISTIC FPnd_J1939_Rx3Fail "FPrm_pending(222)" VALUE 0x001E52CE /* @ECU_Address@FPrm_pending@0x021BE1BC@ */ ECIPP_ALIGNMENT_UWORD 65535 Compu_IDENTITY 0 65535 PHYS_UNIT "Bit Mask" /end CHARACTERISTIC
/begin CHARACTERISTIC FPnd_J1939_RxFail "FPrm_pending(115)" VALUE 0x001E51F8 /* @ECU_Address@FPrm_pending@0x021BE0E6@ */ ECIPP_ALIGNMENT_UWORD 65535 Compu_IDENTITY 0 65535 PHYS_UNIT "Bit Mask" /end CHARACTERISTIC
/begin CHARACTERISTIC FPnd_J1939_SD_rq "FPrm_pending(113)" VALUE 0x001E51F4 /* @ECU_Address@FPrm_pending@0x021BE0E2@ */ ECIPP_ALIGNMENT_UWORD 65535 Compu_IDENTITY 0 65535 PHYS_UNIT "Bit Mask" /end CHARACTERISTIC
/begin CHARACTERISTIC FPsvr_FPrly_coilshort "FPrm_severity(129)" VALUE 0x001E6896 /* @ECU_Address@FPrm_severity@0x024B3081@ */ ECIPP_ALIGNMENT_UBYTE 255 Compu_IDENTITY 0 255 PHYS_UNIT "Severity+Class" /end CHARACTERISTIC
/begin CHARACTERISTIC FPsvr_FPrly_gndshort "FPrm_severity(127)" VALUE 0x001E6894 /* @ECU_Address@FPrm_severity@0x024B307F@ */ ECIPP_ALIGNMENT_UBYTE 255 Compu_IDENTITY 0 255 PHYS_UNIT "Severity+Class" /end CHARACTERISTIC
/begin CHARACTERISTIC FPsvr_FSO_post_TPS_phi_hi "FPrm_severity(687)" VALUE 0x001E6AC4 /* @ECU_Address@FPrm_severity@0x024B32AF@ */ ECIPP_ALIGNMENT_UBYTE 255 Compu_IDENTITY 0 255 PHYS_UNIT "Severity+Class" /end CHARACTERISTIC
/begin CHARACTERISTIC FPsvr_FSO_TPS_phi_hi "FPrm_severity(632)" VALUE 0x001E6A8D /* @ECU_Address@FPrm_severity@0x024B3278@ */ ECIPP_ALIGNMENT_UBYTE 255 Compu_IDENTITY 0 255 PHYS_UNIT "Severity+Class" /end CHARACTERISTIC
/begin CHARACTERISTIC FPsvr_FT_maxv "FPrm_severity(106)" VALUE 0x001E687F /* @ECU_Address@FPrm_severity@0x024B306A@ */ ECIPP_ALIGNMENT_UBYTE 255 Compu_IDENTITY 0 255 PHYS_UNIT "Severity+Class" /end CHARACTERISTIC
/begin CHARACTERISTIC FPsvr_FT_minv "FPrm_severity(107)" VALUE 0x001E6880 /* @ECU_Address@FPrm_severity@0x024B306B@ */ ECIPP_ALIGNMENT_UBYTE 255 Compu_IDENTITY 0 255 PHYS_UNIT "Severity+Class" /end CHARACTERISTIC
/begin CHARACTERISTIC FPsvr_FTgasf_maxv "FPrm_severity(171)" VALUE 0x001E68C0 /* @ECU_Address@FPrm_severity@0x024B30AB@ */ ECIPP_ALIGNMENT_UBYTE 255 Compu_IDENTITY 0 255 PHYS_UNIT "Severity+Class" /end CHARACTERISTIC
/begin CHARACTERISTIC FPsvr_FTgasf_minv "FPrm_severity(172)" VALUE 0x001E68C1 /* @ECU_Address@FPrm_severity@0x024B30AC@ */ ECIPP_ALIGNMENT_UBYTE 255 Compu_IDENTITY 0 255 PHYS_UNIT "Severity+Class" /end CHARACTERISTIC
/begin CHARACTERISTIC FPsvr_GLOW_unit_fail "FPrm_severity(382)" VALUE 0x001E6993 /* @ECU_Address@FPrm_severity@0x024B317E@ */ ECIPP_ALIGNMENT_UBYTE 255 Compu_IDENTITY 0 255 PHYS_UNIT "Severity+Class" /end CHARACTERISTIC
/begin CHARACTERISTIC FPsvr_GLOW1_open "FPrm_severity(380)" VALUE 0x001E6991 /* @ECU_Address@FPrm_severity@0x024B317C@ */ ECIPP_ALIGNMENT_UBYTE 255 Compu_IDENTITY 0 255 PHYS_UNIT "Severity+Class" /end CHARACTERISTIC
/begin CHARACTERISTIC FPsvr_GLOW1_short "FPrm_severity(381)" VALUE 0x001E6992 /* @ECU_Address@FPrm_severity@0x024B317D@ */ ECIPP_ALIGNMENT_UBYTE 255 Compu_IDENTITY 0 255 PHYS_UNIT "Severity+Class" /end CHARACTERISTIC
/begin CHARACTERISTIC FPsvr_gov_ntrlock_fail "FPrm_severity(36)" VALUE 0x001E6839 /* @ECU_Address@FPrm_severity@0x024B3024@ */ ECIPP_ALIGNMENT_UBYTE 255 Compu_IDENTITY 0 255 PHYS_UNIT "Severity+Class" /end CHARACTERISTIC
/begin CHARACTERISTIC FPsvr_gyro_x_max "FPrm_severity(538)" VALUE 0x001E6A2F /* @ECU_Address@FPrm_severity@0x024B321A@ */ ECIPP_ALIGNMENT_UBYTE 255 Compu_IDENTITY 0 255 PHYS_UNIT "Severity+Class" /end CHARACTERISTIC
/begin CHARACTERISTIC FPsvr_gyro_x_min "FPrm_severity(539)" VALUE 0x001E6A30 /* @ECU_Address@FPrm_severity@0x024B321B@ */ ECIPP_ALIGNMENT_UBYTE 255 Compu_IDENTITY 0 255 PHYS_UNIT "Severity+Class" /end CHARACTERISTIC
/begin CHARACTERISTIC FPsvr_gyro_y_max "FPrm_severity(540)" VALUE 0x001E6A31 /* @ECU_Address@FPrm_severity@0x024B321C@ */ ECIPP_ALIGNMENT_UBYTE 255 Compu_IDENTITY 0 255 PHYS_UNIT "Severity+Class" /end CHARACTERISTIC
/begin CHARACTERISTIC FPsvr_gyro_y_min "FPrm_severity(541)" VALUE 0x001E6A32 /* @ECU_Address@FPrm_severity@0x024B321D@ */ ECIPP_ALIGNMENT_UBYTE 255 Compu_IDENTITY 0 255 PHYS_UNIT "Severity+Class" /end CHARACTERISTIC
/begin CHARACTERISTIC FPsvr_gyro_z_max "FPrm_severity(542)" VALUE 0x001E6A33 /* @ECU_Address@FPrm_severity@0x024B321E@ */ ECIPP_ALIGNMENT_UBYTE 255 Compu_IDENTITY 0 255 PHYS_UNIT "Severity+Class" /end CHARACTERISTIC
/begin CHARACTERISTIC FPsvr_gyro_z_min "FPrm_severity(543)" VALUE 0x001E6A34 /* @ECU_Address@FPrm_severity@0x024B321F@ */ ECIPP_ALIGNMENT_UBYTE 255 Compu_IDENTITY 0 255 PHYS_UNIT "Severity+Class" /end CHARACTERISTIC
/begin CHARACTERISTIC FPsvr_HBA_I_max "FPrm_severity(398)" VALUE 0x001E69A3 /* @ECU_Address@FPrm_severity@0x024B318E@ */ ECIPP_ALIGNMENT_UBYTE 255 Compu_IDENTITY 0 255 PHYS_UNIT "Severity+Class" /end CHARACTERISTIC
/begin CHARACTERISTIC FPsvr_HBB_I_max "FPrm_severity(399)" VALUE 0x001E69A4 /* @ECU_Address@FPrm_severity@0x024B318F@ */ ECIPP_ALIGNMENT_UBYTE 255 Compu_IDENTITY 0 255 PHYS_UNIT "Severity+Class" /end CHARACTERISTIC
/begin CHARACTERISTIC FPsvr_HiDiagTemp "FPrm_severity(482)" VALUE 0x001E69F7 /* @ECU_Address@FPrm_severity@0x024B31E2@ */ ECIPP_ALIGNMENT_UBYTE 255 Compu_IDENTITY 0 255 PHYS_UNIT "Severity+Class" /end CHARACTERISTIC
/begin CHARACTERISTIC FPsvr_HWID_fail "FPrm_severity(227)" VALUE 0x001E68F8 /* @ECU_Address@FPrm_severity@0x024B30E3@ */ ECIPP_ALIGNMENT_UBYTE 255 Compu_IDENTITY 0 255 PHYS_UNIT "Severity+Class" /end CHARACTERISTIC
/begin CHARACTERISTIC FPsvr_IAC_gndshort "FPrm_severity(116)" VALUE 0x001E6889 /* @ECU_Address@FPrm_severity@0x024B3074@ */ ECIPP_ALIGNMENT_UBYTE 255 Compu_IDENTITY 0 255 PHYS_UNIT "Severity+Class" /end CHARACTERISTIC
/begin CHARACTERISTIC FPsvr_IAC_openshort "FPrm_severity(117)" VALUE 0x001E688A /* @ECU_Address@FPrm_severity@0x024B3075@ */ ECIPP_ALIGNMENT_UBYTE 255 Compu_IDENTITY 0 255 PHYS_UNIT "Severity+Class" /end CHARACTERISTIC
/begin CHARACTERISTIC FPsvr_IAT_HiExp "FPrm_severity(8)" VALUE 0x001E681D /* @ECU_Address@FPrm_severity@0x024B3008@ */ ECIPP_ALIGNMENT_UBYTE 255 Compu_IDENTITY 0 255 PHYS_UNIT "Severity+Class" /end CHARACTERISTIC
/begin CHARACTERISTIC FPsvr_IAT_HiExp2 "FPrm_severity(9)" VALUE 0x001E681E /* @ECU_Address@FPrm_severity@0x024B3009@ */ ECIPP_ALIGNMENT_UBYTE 255 Compu_IDENTITY 0 255 PHYS_UNIT "Severity+Class" /end CHARACTERISTIC
/begin CHARACTERISTIC FPsvr_IAT_maxv "FPrm_severity(6)" VALUE 0x001E681B /* @ECU_Address@FPrm_severity@0x024B3006@ */ ECIPP_ALIGNMENT_UBYTE 255 Compu_IDENTITY 0 255 PHYS_UNIT "Severity+Class" /end CHARACTERISTIC
/begin CHARACTERISTIC FPsvr_IAT_minv "FPrm_severity(7)" VALUE 0x001E681C /* @ECU_Address@FPrm_severity@0x024B3007@ */ ECIPP_ALIGNMENT_UBYTE 255 Compu_IDENTITY 0 255 PHYS_UNIT "Severity+Class" /end CHARACTERISTIC
/begin CHARACTERISTIC FPsvr_IBF_detected "FPrm_severity(688)" VALUE 0x001E6AC5 /* @ECU_Address@FPrm_severity@0x024B32B0@ */ ECIPP_ALIGNMENT_UBYTE 255 Compu_IDENTITY 0 255 PHYS_UNIT "Severity+Class" /end CHARACTERISTIC
/begin CHARACTERISTIC FPsvr_ICam_maxerr "FPrm_severity(210)" VALUE 0x001E68E7 /* @ECU_Address@FPrm_severity@0x024B30D2@ */ ECIPP_ALIGNMENT_UBYTE 255 Compu_IDENTITY 0 255 PHYS_UNIT "Severity+Class" /end CHARACTERISTIC
/begin CHARACTERISTIC FPsvr_ICAVD1_mis "FPrm_severity(195)" VALUE 0x001E68D8 /* @ECU_Address@FPrm_severity@0x024B30C3@ */ ECIPP_ALIGNMENT_UBYTE 255 Compu_IDENTITY 0 255 PHYS_UNIT "Severity+Class" /end CHARACTERISTIC
/begin CHARACTERISTIC FPsvr_ICAVD1_miscat "FPrm_severity(196)" VALUE 0x001E68D9 /* @ECU_Address@FPrm_severity@0x024B30C4@ */ ECIPP_ALIGNMENT_UBYTE 255 Compu_IDENTITY 0 255 PHYS_UNIT "Severity+Class" /end CHARACTERISTIC
/begin CHARACTERISTIC FPsvr_ICCOT_hi "FPrm_severity(690)" VALUE 0x001E6AC7 /* @ECU_Address@FPrm_severity@0x024B32B2@ */ ECIPP_ALIGNMENT_UBYTE 255 Compu_IDENTITY 0 255 PHYS_UNIT "Severity+Class" /end CHARACTERISTIC
/begin CHARACTERISTIC FPsvr_Idle_SD "FPrm_severity(484)" VALUE 0x001E69F9 /* @ECU_Address@FPrm_severity@0x024B31E4@ */ ECIPP_ALIGNMENT_UBYTE 255 Compu_IDENTITY 0 255 PHYS_UNIT "Severity+Class" /end CHARACTERISTIC
/begin CHARACTERISTIC FPsvr_imu_general "FPrm_severity(529)" VALUE 0x001E6A26 /* @ECU_Address@FPrm_severity@0x024B3211@ */ ECIPP_ALIGNMENT_UBYTE 255 Compu_IDENTITY 0 255 PHYS_UNIT "Severity+Class" /end CHARACTERISTIC
/begin CHARACTERISTIC FPsvr_imu_temp_max "FPrm_severity(530)" VALUE 0x001E6A27 /* @ECU_Address@FPrm_severity@0x024B3212@ */ ECIPP_ALIGNMENT_UBYTE 255 Compu_IDENTITY 0 255 PHYS_UNIT "Severity+Class" /end CHARACTERISTIC
/begin CHARACTERISTIC FPsvr_imu_temp_min "FPrm_severity(531)" VALUE 0x001E6A28 /* @ECU_Address@FPrm_severity@0x024B3213@ */ ECIPP_ALIGNMENT_UBYTE 255 Compu_IDENTITY 0 255 PHYS_UNIT "Severity+Class" /end CHARACTERISTIC
/begin CHARACTERISTIC FPsvr_IMVD_Ifb_hi "FPrm_severity(437)" VALUE 0x001E69CA /* @ECU_Address@FPrm_severity@0x024B31B5@ */ ECIPP_ALIGNMENT_UBYTE 255 Compu_IDENTITY 0 255 PHYS_UNIT "Severity+Class" /end CHARACTERISTIC
/begin CHARACTERISTIC FPsvr_IMVD_Ifb_lo "FPrm_severity(436)" VALUE 0x001E69C9 /* @ECU_Address@FPrm_severity@0x024B31B4@ */ ECIPP_ALIGNMENT_UBYTE 255 Compu_IDENTITY 0 255 PHYS_UNIT "Severity+Class" /end CHARACTERISTIC
/begin CHARACTERISTIC FPsvr_INJD_boost_lo "FPrm_severity(434)" VALUE 0x001E69C7 /* @ECU_Address@FPrm_severity@0x024B31B2@ */ ECIPP_ALIGNMENT_UBYTE 255 Compu_IDENTITY 0 255 PHYS_UNIT "Severity+Class" /end CHARACTERISTIC
/begin CHARACTERISTIC FPsvr_INJD_HS_Ihi "FPrm_severity(432)" VALUE 0x001E69C5 /* @ECU_Address@FPrm_severity@0x024B31B0@ */ ECIPP_ALIGNMENT_UBYTE 255 Compu_IDENTITY 0 255 PHYS_UNIT "Severity+Class" /end CHARACTERISTIC
/begin CHARACTERISTIC FPsvr_INJD_HW_int "FPrm_severity(435)" VALUE 0x001E69C8 /* @ECU_Address@FPrm_severity@0x024B31B3@ */ ECIPP_ALIGNMENT_UBYTE 255 Compu_IDENTITY 0 255 PHYS_UNIT "Severity+Class" /end CHARACTERISTIC
/begin CHARACTERISTIC FPsvr_INJD_LS_Ihi "FPrm_severity(433)" VALUE 0x001E69C6 /* @ECU_Address@FPrm_severity@0x024B31B1@ */ ECIPP_ALIGNMENT_UBYTE 255 Compu_IDENTITY 0 255 PHYS_UNIT "Severity+Class" /end CHARACTERISTIC
/begin CHARACTERISTIC FPsvr_INJD_off_lo "FPrm_severity(53)" VALUE 0x001E684A /* @ECU_Address@FPrm_severity@0x024B3035@ */ ECIPP_ALIGNMENT_UBYTE 255 Compu_IDENTITY 0 255 PHYS_UNIT "Severity+Class" /end CHARACTERISTIC
/begin CHARACTERISTIC FPsvr_INJD_on_hi "FPrm_severity(54)" VALUE 0x001E684B /* @ECU_Address@FPrm_severity@0x024B3036@ */ ECIPP_ALIGNMENT_UBYTE 255 Compu_IDENTITY 0 255 PHYS_UNIT "Severity+Class" /end CHARACTERISTIC
/begin CHARACTERISTIC FPsvr_intby_poserr "FPrm_severity(691)" VALUE 0x001E6AC8 /* @ECU_Address@FPrm_severity@0x024B32B3@ */ ECIPP_ALIGNMENT_UBYTE 255 Compu_IDENTITY 0 255 PHYS_UNIT "Severity+Class" /end CHARACTERISTIC
/begin CHARACTERISTIC FPsvr_interrupt "FPrm_severity(68)" VALUE 0x001E6859 /* @ECU_Address@FPrm_severity@0x024B3044@ */ ECIPP_ALIGNMENT_UBYTE 255 Compu_IDENTITY 0 255 PHYS_UNIT "Severity+Class" /end CHARACTERISTIC
/begin CHARACTERISTIC FPsvr_IRV_CL_OOA "FPrm_severity(696)" VALUE 0x001E6ACD /* @ECU_Address@FPrm_severity@0x024B32B8@ */ ECIPP_ALIGNMENT_UBYTE 255 Compu_IDENTITY 0 255 PHYS_UNIT "Severity+Class" /end CHARACTERISTIC
/begin CHARACTERISTIC FPsvr_J1939_AAT_err_loss "FPrm_severity(662)" VALUE 0x001E6AAB /* @ECU_Address@FPrm_severity@0x024B3296@ */ ECIPP_ALIGNMENT_UBYTE 255 Compu_IDENTITY 0 255 PHYS_UNIT "Severity+Class" /end CHARACTERISTIC
/begin CHARACTERISTIC FPsvr_J1939_addr2Fail "FPrm_severity(223)" VALUE 0x001E68F4 /* @ECU_Address@FPrm_severity@0x024B30DF@ */ ECIPP_ALIGNMENT_UBYTE 255 Compu_IDENTITY 0 255 PHYS_UNIT "Severity+Class" /end CHARACTERISTIC
/begin CHARACTERISTIC FPsvr_J1939_addr3Fail "FPrm_severity(224)" VALUE 0x001E68F5 /* @ECU_Address@FPrm_severity@0x024B30E0@ */ ECIPP_ALIGNMENT_UBYTE 255 Compu_IDENTITY 0 255 PHYS_UNIT "Severity+Class" /end CHARACTERISTIC
/begin CHARACTERISTIC FPsvr_J1939_addrFail "FPrm_severity(146)" VALUE 0x001E68A7 /* @ECU_Address@FPrm_severity@0x024B3092@ */ ECIPP_ALIGNMENT_UBYTE 255 Compu_IDENTITY 0 255 PHYS_UNIT "Severity+Class" /end CHARACTERISTIC
/begin CHARACTERISTIC FPsvr_J1939_ETC_loss "FPrm_severity(175)" VALUE 0x001E68C4 /* @ECU_Address@FPrm_severity@0x024B30AF@ */ ECIPP_ALIGNMENT_UBYTE 255 Compu_IDENTITY 0 255 PHYS_UNIT "Severity+Class" /end CHARACTERISTIC
/begin CHARACTERISTIC FPsvr_J1939_ETC_loss2 "FPrm_severity(197)" VALUE 0x001E68DA /* @ECU_Address@FPrm_severity@0x024B30C5@ */ ECIPP_ALIGNMENT_UBYTE 255 Compu_IDENTITY 0 255 PHYS_UNIT "Severity+Class" /end CHARACTERISTIC
/begin CHARACTERISTIC FPsvr_J1939_PGN_tout "FPrm_severity(544)" VALUE 0x001E6A35 /* @ECU_Address@FPrm_severity@0x024B3220@ */ ECIPP_ALIGNMENT_UBYTE 255 Compu_IDENTITY 0 255 PHYS_UNIT "Severity+Class" /end CHARACTERISTIC
/begin CHARACTERISTIC FPsvr_J1939_PGN_tout10 "FPrm_severity(553)" VALUE 0x001E6A3E /* @ECU_Address@FPrm_severity@0x024B3229@ */ ECIPP_ALIGNMENT_UBYTE 255 Compu_IDENTITY 0 255 PHYS_UNIT "Severity+Class" /end CHARACTERISTIC
/begin CHARACTERISTIC FPsvr_J1939_PGN_tout2 "FPrm_severity(545)" VALUE 0x001E6A36 /* @ECU_Address@FPrm_severity@0x024B3221@ */ ECIPP_ALIGNMENT_UBYTE 255 Compu_IDENTITY 0 255 PHYS_UNIT "Severity+Class" /end CHARACTERISTIC
/begin CHARACTERISTIC FPsvr_J1939_PGN_tout3 "FPrm_severity(546)" VALUE 0x001E6A37 /* @ECU_Address@FPrm_severity@0x024B3222@ */ ECIPP_ALIGNMENT_UBYTE 255 Compu_IDENTITY 0 255 PHYS_UNIT "Severity+Class" /end CHARACTERISTIC
/begin CHARACTERISTIC FPsvr_J1939_PGN_tout4 "FPrm_severity(547)" VALUE 0x001E6A38 /* @ECU_Address@FPrm_severity@0x024B3223@ */ ECIPP_ALIGNMENT_UBYTE 255 Compu_IDENTITY 0 255 PHYS_UNIT "Severity+Class" /end CHARACTERISTIC
/begin CHARACTERISTIC FPsvr_J1939_PGN_tout5 "FPrm_severity(548)" VALUE 0x001E6A39 /* @ECU_Address@FPrm_severity@0x024B3224@ */ ECIPP_ALIGNMENT_UBYTE 255 Compu_IDENTITY 0 255 PHYS_UNIT "Severity+Class" /end CHARACTERISTIC
/begin CHARACTERISTIC FPsvr_J1939_PGN_tout6 "FPrm_severity(549)" VALUE 0x001E6A3A /* @ECU_Address@FPrm_severity@0x024B3225@ */ ECIPP_ALIGNMENT_UBYTE 255 Compu_IDENTITY 0 255 PHYS_UNIT "Severity+Class" /end CHARACTERISTIC
/begin CHARACTERISTIC FPsvr_J1939_PGN_tout7 "FPrm_severity(550)" VALUE 0x001E6A3B /* @ECU_Address@FPrm_severity@0x024B3226@ */ ECIPP_ALIGNMENT_UBYTE 255 Compu_IDENTITY 0 255 PHYS_UNIT "Severity+Class" /end CHARACTERISTIC
/begin CHARACTERISTIC FPsvr_J1939_PGN_tout8 "FPrm_severity(551)" VALUE 0x001E6A3C /* @ECU_Address@FPrm_severity@0x024B3227@ */ ECIPP_ALIGNMENT_UBYTE 255 Compu_IDENTITY 0 255 PHYS_UNIT "Severity+Class" /end CHARACTERISTIC
/begin CHARACTERISTIC FPsvr_J1939_PGN_tout9 "FPrm_severity(552)" VALUE 0x001E6A3D /* @ECU_Address@FPrm_severity@0x024B3228@ */ ECIPP_ALIGNMENT_UBYTE 255 Compu_IDENTITY 0 255 PHYS_UNIT "Severity+Class" /end CHARACTERISTIC
/begin CHARACTERISTIC FPsvr_J1939_RS_err_loss "FPrm_severity(661)" VALUE 0x001E6AAA /* @ECU_Address@FPrm_severity@0x024B3295@ */ ECIPP_ALIGNMENT_UBYTE 255 Compu_IDENTITY 0 255 PHYS_UNIT "Severity+Class" /end CHARACTERISTIC
/begin CHARACTERISTIC FPsvr_J1939_RSsetpt_loss "FPrm_severity(454)" VALUE 0x001E69DB /* @ECU_Address@FPrm_severity@0x024B31C6@ */ ECIPP_ALIGNMENT_UBYTE 255 Compu_IDENTITY 0 255 PHYS_UNIT "Severity+Class" /end CHARACTERISTIC
/begin CHARACTERISTIC FPsvr_J1939_Rx2Fail "FPrm_severity(221)" VALUE 0x001E68F2 /* @ECU_Address@FPrm_severity@0x024B30DD@ */ ECIPP_ALIGNMENT_UBYTE 255 Compu_IDENTITY 0 255 PHYS_UNIT "Severity+Class" /end CHARACTERISTIC
/begin CHARACTERISTIC FPsvr_J1939_Rx3Fail "FPrm_severity(222)" VALUE 0x001E68F3 /* @ECU_Address@FPrm_severity@0x024B30DE@ */ ECIPP_ALIGNMENT_UBYTE 255 Compu_IDENTITY 0 255 PHYS_UNIT "Severity+Class" /end CHARACTERISTIC
/begin CHARACTERISTIC FPsvr_J1939_RxFail "FPrm_severity(115)" VALUE 0x001E6888 /* @ECU_Address@FPrm_severity@0x024B3073@ */ ECIPP_ALIGNMENT_UBYTE 255 Compu_IDENTITY 0 255 PHYS_UNIT "Severity+Class" /end CHARACTERISTIC
/begin CHARACTERISTIC FPsvr_J1939_SD_rq "FPrm_severity(113)" VALUE 0x001E6886 /* @ECU_Address@FPrm_severity@0x024B3071@ */ ECIPP_ALIGNMENT_UBYTE 255 Compu_IDENTITY 0 255 PHYS_UNIT "Severity+Class" /end CHARACTERISTIC
/begin CHARACTERISTIC FPsw_ext1_FPrly_coilshort "FPrm_switches_ext1(129)" VALUE 0x001C7680 /* @ECU_Address@FPrm_switches_ext1@0x023A5102@ */ ECIPP_ALIGNMENT_UWORD 65535 Compu_IDENTITY 0 65535 PHYS_UNIT "Enable bits" /end CHARACTERISTIC
/begin CHARACTERISTIC FPsw_ext1_FPrly_gndshort "FPrm_switches_ext1(127)" VALUE 0x001C767C /* @ECU_Address@FPrm_switches_ext1@0x023A50FE@ */ ECIPP_ALIGNMENT_UWORD 65535 Compu_IDENTITY 0 65535 PHYS_UNIT "Enable bits" /end CHARACTERISTIC
/begin CHARACTERISTIC FPsw_ext1_FSO_post_TPS_phi_hi "FPrm_switches_ext1(687)" VALUE 0x001C7ADC /* @ECU_Address@FPrm_switches_ext1@0x023A555E@ */ ECIPP_ALIGNMENT_UWORD 65535 Compu_IDENTITY 0 65535 PHYS_UNIT "Enable bits" /end CHARACTERISTIC
/begin CHARACTERISTIC FPsw_ext1_FSO_TPS_phi_hi "FPrm_switches_ext1(632)" VALUE 0x001C7A6E /* @ECU_Address@FPrm_switches_ext1@0x023A54F0@ */ ECIPP_ALIGNMENT_UWORD 65535 Compu_IDENTITY 0 65535 PHYS_UNIT "Enable bits" /end CHARACTERISTIC
/begin CHARACTERISTIC FPsw_ext1_FT_maxv "FPrm_switches_ext1(106)" VALUE 0x001C7652 /* @ECU_Address@FPrm_switches_ext1@0x023A50D4@ */ ECIPP_ALIGNMENT_UWORD 65535 Compu_IDENTITY 0 65535 PHYS_UNIT "Enable bits" /end CHARACTERISTIC
/begin CHARACTERISTIC FPsw_ext1_FT_minv "FPrm_switches_ext1(107)" VALUE 0x001C7654 /* @ECU_Address@FPrm_switches_ext1@0x023A50D6@ */ ECIPP_ALIGNMENT_UWORD 65535 Compu_IDENTITY 0 65535 PHYS_UNIT "Enable bits" /end CHARACTERISTIC
/begin CHARACTERISTIC FPsw_ext1_FTgasf_maxv "FPrm_switches_ext1(171)" VALUE 0x001C76D4 /* @ECU_Address@FPrm_switches_ext1@0x023A5156@ */ ECIPP_ALIGNMENT_UWORD 65535 Compu_IDENTITY 0 65535 PHYS_UNIT "Enable bits" /end CHARACTERISTIC
/begin CHARACTERISTIC FPsw_ext1_FTgasf_minv "FPrm_switches_ext1(172)" VALUE 0x001C76D6 /* @ECU_Address@FPrm_switches_ext1@0x023A5158@ */ ECIPP_ALIGNMENT_UWORD 65535 Compu_IDENTITY 0 65535 PHYS_UNIT "Enable bits" /end CHARACTERISTIC
/begin CHARACTERISTIC FPsw_ext1_GLOW_unit_fail "FPrm_switches_ext1(382)" VALUE 0x001C787A /* @ECU_Address@FPrm_switches_ext1@0x023A52FC@ */ ECIPP_ALIGNMENT_UWORD 65535 Compu_IDENTITY 0 65535 PHYS_UNIT "Enable bits" /end CHARACTERISTIC
/begin CHARACTERISTIC FPsw_ext1_GLOW1_open "FPrm_switches_ext1(380)" VALUE 0x001C7876 /* @ECU_Address@FPrm_switches_ext1@0x023A52F8@ */ ECIPP_ALIGNMENT_UWORD 65535 Compu_IDENTITY 0 65535 PHYS_UNIT "Enable bits" /end CHARACTERISTIC
/begin CHARACTERISTIC FPsw_ext1_GLOW1_short "FPrm_switches_ext1(381)" VALUE 0x001C7878 /* @ECU_Address@FPrm_switches_ext1@0x023A52FA@ */ ECIPP_ALIGNMENT_UWORD 65535 Compu_IDENTITY 0 65535 PHYS_UNIT "Enable bits" /end CHARACTERISTIC
/begin CHARACTERISTIC FPsw_ext1_gov_ntrlock_fail "FPrm_switches_ext1(36)" VALUE 0x001C75C6 /* @ECU_Address@FPrm_switches_ext1@0x023A5048@ */ ECIPP_ALIGNMENT_UWORD 65535 Compu_IDENTITY 0 65535 PHYS_UNIT "Enable bits" /end CHARACTERISTIC
/begin CHARACTERISTIC FPsw_ext1_gyro_x_max "FPrm_switches_ext1(538)" VALUE 0x001C79B2 /* @ECU_Address@FPrm_switches_ext1@0x023A5434@ */ ECIPP_ALIGNMENT_UWORD 65535 Compu_IDENTITY 0 65535 PHYS_UNIT "Enable bits" /end CHARACTERISTIC
/begin CHARACTERISTIC FPsw_ext1_gyro_x_min "FPrm_switches_ext1(539)" VALUE 0x001C79B4 /* @ECU_Address@FPrm_switches_ext1@0x023A5436@ */ ECIPP_ALIGNMENT_UWORD 65535 Compu_IDENTITY 0 65535 PHYS_UNIT "Enable bits" /end CHARACTERISTIC
/begin CHARACTERISTIC FPsw_ext1_gyro_y_max "FPrm_switches_ext1(540)" VALUE 0x001C79B6 /* @ECU_Address@FPrm_switches_ext1@0x023A5438@ */ ECIPP_ALIGNMENT_UWORD 65535 Compu_IDENTITY 0 65535 PHYS_UNIT "Enable bits" /end CHARACTERISTIC
/begin CHARACTERISTIC FPsw_ext1_gyro_y_min "FPrm_switches_ext1(541)" VALUE 0x001C79B8 /* @ECU_Address@FPrm_switches_ext1@0x023A543A@ */ ECIPP_ALIGNMENT_UWORD 65535 Compu_IDENTITY 0 65535 PHYS_UNIT "Enable bits" /end CHARACTERISTIC
/begin CHARACTERISTIC FPsw_ext1_gyro_z_max "FPrm_switches_ext1(542)" VALUE 0x001C79BA /* @ECU_Address@FPrm_switches_ext1@0x023A543C@ */ ECIPP_ALIGNMENT_UWORD 65535 Compu_IDENTITY 0 65535 PHYS_UNIT "Enable bits" /end CHARACTERISTIC
/begin CHARACTERISTIC FPsw_ext1_gyro_z_min "FPrm_switches_ext1(543)" VALUE 0x001C79BC /* @ECU_Address@FPrm_switches_ext1@0x023A543E@ */ ECIPP_ALIGNMENT_UWORD 65535 Compu_IDENTITY 0 65535 PHYS_UNIT "Enable bits" /end CHARACTERISTIC
/begin CHARACTERISTIC FPsw_ext1_HBA_I_max "FPrm_switches_ext1(398)" VALUE 0x001C789A /* @ECU_Address@FPrm_switches_ext1@0x023A531C@ */ ECIPP_ALIGNMENT_UWORD 65535 Compu_IDENTITY 0 65535 PHYS_UNIT "Enable bits" /end CHARACTERISTIC
/begin CHARACTERISTIC FPsw_ext1_HBB_I_max "FPrm_switches_ext1(399)" VALUE 0x001C789C /* @ECU_Address@FPrm_switches_ext1@0x023A531E@ */ ECIPP_ALIGNMENT_UWORD 65535 Compu_IDENTITY 0 65535 PHYS_UNIT "Enable bits" /end CHARACTERISTIC
/begin CHARACTERISTIC FPsw_ext1_HiDiagTemp "FPrm_switches_ext1(482)" VALUE 0x001C7942 /* @ECU_Address@FPrm_switches_ext1@0x023A53C4@ */ ECIPP_ALIGNMENT_UWORD 65535 Compu_IDENTITY 0 65535 PHYS_UNIT "Enable bits" /end CHARACTERISTIC
/begin CHARACTERISTIC FPsw_ext1_HWID_fail "FPrm_switches_ext1(227)" VALUE 0x001C7744 /* @ECU_Address@FPrm_switches_ext1@0x023A51C6@ */ ECIPP_ALIGNMENT_UWORD 65535 Compu_IDENTITY 0 65535 PHYS_UNIT "Enable bits" /end CHARACTERISTIC
/begin CHARACTERISTIC FPsw_ext1_IAC_gndshort "FPrm_switches_ext1(116)" VALUE 0x001C7666 /* @ECU_Address@FPrm_switches_ext1@0x023A50E8@ */ ECIPP_ALIGNMENT_UWORD 65535 Compu_IDENTITY 0 65535 PHYS_UNIT "Enable bits" /end CHARACTERISTIC
/begin CHARACTERISTIC FPsw_ext1_IAC_openshort "FPrm_switches_ext1(117)" VALUE 0x001C7668 /* @ECU_Address@FPrm_switches_ext1@0x023A50EA@ */ ECIPP_ALIGNMENT_UWORD 65535 Compu_IDENTITY 0 65535 PHYS_UNIT "Enable bits" /end CHARACTERISTIC
/begin CHARACTERISTIC FPsw_ext1_IAT_HiExp "FPrm_switches_ext1(8)" VALUE 0x001C758E /* @ECU_Address@FPrm_switches_ext1@0x023A5010@ */ ECIPP_ALIGNMENT_UWORD 65535 Compu_IDENTITY 0 65535 PHYS_UNIT "Enable bits" /end CHARACTERISTIC
/begin CHARACTERISTIC FPsw_ext1_IAT_HiExp2 "FPrm_switches_ext1(9)" VALUE 0x001C7590 /* @ECU_Address@FPrm_switches_ext1@0x023A5012@ */ ECIPP_ALIGNMENT_UWORD 65535 Compu_IDENTITY 0 65535 PHYS_UNIT "Enable bits" /end CHARACTERISTIC
/begin CHARACTERISTIC FPsw_ext1_IAT_maxv "FPrm_switches_ext1(6)" VALUE 0x001C758A /* @ECU_Address@FPrm_switches_ext1@0x023A500C@ */ ECIPP_ALIGNMENT_UWORD 65535 Compu_IDENTITY 0 65535 PHYS_UNIT "Enable bits" /end CHARACTERISTIC
/begin CHARACTERISTIC FPsw_ext1_IAT_minv "FPrm_switches_ext1(7)" VALUE 0x001C758C /* @ECU_Address@FPrm_switches_ext1@0x023A500E@ */ ECIPP_ALIGNMENT_UWORD 65535 Compu_IDENTITY 0 65535 PHYS_UNIT "Enable bits" /end CHARACTERISTIC
/begin CHARACTERISTIC FPsw_ext1_IBF_detected "FPrm_switches_ext1(688)" VALUE 0x001C7ADE /* @ECU_Address@FPrm_switches_ext1@0x023A5560@ */ ECIPP_ALIGNMENT_UWORD 65535 Compu_IDENTITY 0 65535 PHYS_UNIT "Enable bits" /end CHARACTERISTIC
/begin CHARACTERISTIC FPsw_ext1_ICam_maxerr "FPrm_switches_ext1(210)" VALUE 0x001C7722 /* @ECU_Address@FPrm_switches_ext1@0x023A51A4@ */ ECIPP_ALIGNMENT_UWORD 65535 Compu_IDENTITY 0 65535 PHYS_UNIT "Enable bits" /end CHARACTERISTIC
/begin CHARACTERISTIC FPsw_ext1_ICAVD1_mis "FPrm_switches_ext1(195)" VALUE 0x001C7704 /* @ECU_Address@FPrm_switches_ext1@0x023A5186@ */ ECIPP_ALIGNMENT_UWORD 65535 Compu_IDENTITY 0 65535 PHYS_UNIT "Enable bits" /end CHARACTERISTIC
/begin CHARACTERISTIC FPsw_ext1_ICAVD1_miscat "FPrm_switches_ext1(196)" VALUE 0x001C7706 /* @ECU_Address@FPrm_switches_ext1@0x023A5188@ */ ECIPP_ALIGNMENT_UWORD 65535 Compu_IDENTITY 0 65535 PHYS_UNIT "Enable bits" /end CHARACTERISTIC
/begin CHARACTERISTIC FPsw_ext1_ICCOT_hi "FPrm_switches_ext1(690)" VALUE 0x001C7AE2 /* @ECU_Address@FPrm_switches_ext1@0x023A5564@ */ ECIPP_ALIGNMENT_UWORD 65535 Compu_IDENTITY 0 65535 PHYS_UNIT "Enable bits" /end CHARACTERISTIC
/begin CHARACTERISTIC FPsw_ext1_Idle_SD "FPrm_switches_ext1(484)" VALUE 0x001C7946 /* @ECU_Address@FPrm_switches_ext1@0x023A53C8@ */ ECIPP_ALIGNMENT_UWORD 65535 Compu_IDENTITY 0 65535 PHYS_UNIT "Enable bits" /end CHARACTERISTIC
/begin CHARACTERISTIC FPsw_ext1_imu_general "FPrm_switches_ext1(529)" VALUE 0x001C79A0 /* @ECU_Address@FPrm_switches_ext1@0x023A5422@ */ ECIPP_ALIGNMENT_UWORD 65535 Compu_IDENTITY 0 65535 PHYS_UNIT "Enable bits" /end CHARACTERISTIC
/begin CHARACTERISTIC FPsw_ext1_imu_temp_max "FPrm_switches_ext1(530)" VALUE 0x001C79A2 /* @ECU_Address@FPrm_switches_ext1@0x023A5424@ */ ECIPP_ALIGNMENT_UWORD 65535 Compu_IDENTITY 0 65535 PHYS_UNIT "Enable bits" /end CHARACTERISTIC
/begin CHARACTERISTIC FPsw_ext1_imu_temp_min "FPrm_switches_ext1(531)" VALUE 0x001C79A4 /* @ECU_Address@FPrm_switches_ext1@0x023A5426@ */ ECIPP_ALIGNMENT_UWORD 65535 Compu_IDENTITY 0 65535 PHYS_UNIT "Enable bits" /end CHARACTERISTIC
/begin CHARACTERISTIC FPsw_ext1_IMVD_Ifb_hi "FPrm_switches_ext1(437)" VALUE 0x001C78E8 /* @ECU_Address@FPrm_switches_ext1@0x023A536A@ */ ECIPP_ALIGNMENT_UWORD 65535 Compu_IDENTITY 0 65535 PHYS_UNIT "Enable bits" /end CHARACTERISTIC
/begin CHARACTERISTIC FPsw_ext1_IMVD_Ifb_lo "FPrm_switches_ext1(436)" VALUE 0x001C78E6 /* @ECU_Address@FPrm_switches_ext1@0x023A5368@ */ ECIPP_ALIGNMENT_UWORD 65535 Compu_IDENTITY 0 65535 PHYS_UNIT "Enable bits" /end CHARACTERISTIC
/begin CHARACTERISTIC FPsw_ext1_INJD_boost_lo "FPrm_switches_ext1(434)" VALUE 0x001C78E2 /* @ECU_Address@FPrm_switches_ext1@0x023A5364@ */ ECIPP_ALIGNMENT_UWORD 65535 Compu_IDENTITY 0 65535 PHYS_UNIT "Enable bits" /end CHARACTERISTIC
/begin CHARACTERISTIC FPsw_ext1_INJD_HS_Ihi "FPrm_switches_ext1(432)" VALUE 0x001C78DE /* @ECU_Address@FPrm_switches_ext1@0x023A5360@ */ ECIPP_ALIGNMENT_UWORD 65535 Compu_IDENTITY 0 65535 PHYS_UNIT "Enable bits" /end CHARACTERISTIC
/begin CHARACTERISTIC FPsw_ext1_INJD_HW_int "FPrm_switches_ext1(435)" VALUE 0x001C78E4 /* @ECU_Address@FPrm_switches_ext1@0x023A5366@ */ ECIPP_ALIGNMENT_UWORD 65535 Compu_IDENTITY 0 65535 PHYS_UNIT "Enable bits" /end CHARACTERISTIC
/begin CHARACTERISTIC FPsw_ext1_INJD_LS_Ihi "FPrm_switches_ext1(433)" VALUE 0x001C78E0 /* @ECU_Address@FPrm_switches_ext1@0x023A5362@ */ ECIPP_ALIGNMENT_UWORD 65535 Compu_IDENTITY 0 65535 PHYS_UNIT "Enable bits" /end CHARACTERISTIC
/begin CHARACTERISTIC FPsw_ext1_INJD_off_lo "FPrm_switches_ext1(53)" VALUE 0x001C75E8 /* @ECU_Address@FPrm_switches_ext1@0x023A506A@ */ ECIPP_ALIGNMENT_UWORD 65535 Compu_IDENTITY 0 65535 PHYS_UNIT "Enable bits" /end CHARACTERISTIC
/begin CHARACTERISTIC FPsw_ext1_INJD_on_hi "FPrm_switches_ext1(54)" VALUE 0x001C75EA /* @ECU_Address@FPrm_switches_ext1@0x023A506C@ */ ECIPP_ALIGNMENT_UWORD 65535 Compu_IDENTITY 0 65535 PHYS_UNIT "Enable bits" /end CHARACTERISTIC
/begin CHARACTERISTIC FPsw_ext1_intby_poserr "FPrm_switches_ext1(691)" VALUE 0x001C7AE4 /* @ECU_Address@FPrm_switches_ext1@0x023A5566@ */ ECIPP_ALIGNMENT_UWORD 65535 Compu_IDENTITY 0 65535 PHYS_UNIT "Enable bits" /end CHARACTERISTIC
/begin CHARACTERISTIC FPsw_ext1_interrupt "FPrm_switches_ext1(68)" VALUE 0x001C7606 /* @ECU_Address@FPrm_switches_ext1@0x023A5088@ */ ECIPP_ALIGNMENT_UWORD 65535 Compu_IDENTITY 0 65535 PHYS_UNIT "Enable bits" /end CHARACTERISTIC
/begin CHARACTERISTIC FPsw_ext1_IRV_CL_OOA "FPrm_switches_ext1(696)" VALUE 0x001C7AEE /* @ECU_Address@FPrm_switches_ext1@0x023A5570@ */ ECIPP_ALIGNMENT_UWORD 65535 Compu_IDENTITY 0 65535 PHYS_UNIT "Enable bits" /end CHARACTERISTIC
/begin CHARACTERISTIC FPsw_ext1_J1939_AAT_err_loss "FPrm_switches_ext1(662)" VALUE 0x001C7AAA /* @ECU_Address@FPrm_switches_ext1@0x023A552C@ */ ECIPP_ALIGNMENT_UWORD 65535 Compu_IDENTITY 0 65535 PHYS_UNIT "Enable bits" /end CHARACTERISTIC
/begin CHARACTERISTIC FPsw_ext1_J1939_addr2Fail "FPrm_switches_ext1(223)" VALUE 0x001C773C /* @ECU_Address@FPrm_switches_ext1@0x023A51BE@ */ ECIPP_ALIGNMENT_UWORD 65535 Compu_IDENTITY 0 65535 PHYS_UNIT "Enable bits" /end CHARACTERISTIC
/begin CHARACTERISTIC FPsw_ext1_J1939_addr3Fail "FPrm_switches_ext1(224)" VALUE 0x001C773E /* @ECU_Address@FPrm_switches_ext1@0x023A51C0@ */ ECIPP_ALIGNMENT_UWORD 65535 Compu_IDENTITY 0 65535 PHYS_UNIT "Enable bits" /end CHARACTERISTIC
/begin CHARACTERISTIC FPsw_ext1_J1939_addrFail "FPrm_switches_ext1(146)" VALUE 0x001C76A2 /* @ECU_Address@FPrm_switches_ext1@0x023A5124@ */ ECIPP_ALIGNMENT_UWORD 65535 Compu_IDENTITY 0 65535 PHYS_UNIT "Enable bits" /end CHARACTERISTIC
/begin CHARACTERISTIC FPsw_ext1_J1939_ETC_loss "FPrm_switches_ext1(175)" VALUE 0x001C76DC /* @ECU_Address@FPrm_switches_ext1@0x023A515E@ */ ECIPP_ALIGNMENT_UWORD 65535 Compu_IDENTITY 0 65535 PHYS_UNIT "Enable bits" /end CHARACTERISTIC
/begin CHARACTERISTIC FPsw_ext1_J1939_ETC_loss2 "FPrm_switches_ext1(197)" VALUE 0x001C7708 /* @ECU_Address@FPrm_switches_ext1@0x023A518A@ */ ECIPP_ALIGNMENT_UWORD 65535 Compu_IDENTITY 0 65535 PHYS_UNIT "Enable bits" /end CHARACTERISTIC
/begin CHARACTERISTIC FPsw_ext1_J1939_PGN_tout "FPrm_switches_ext1(544)" VALUE 0x001C79BE /* @ECU_Address@FPrm_switches_ext1@0x023A5440@ */ ECIPP_ALIGNMENT_UWORD 65535 Compu_IDENTITY 0 65535 PHYS_UNIT "Enable bits" /end CHARACTERISTIC
/begin CHARACTERISTIC FPsw_ext1_J1939_PGN_tout10 "FPrm_switches_ext1(553)" VALUE 0x001C79D0 /* @ECU_Address@FPrm_switches_ext1@0x023A5452@ */ ECIPP_ALIGNMENT_UWORD 65535 Compu_IDENTITY 0 65535 PHYS_UNIT "Enable bits" /end CHARACTERISTIC
/begin CHARACTERISTIC FPsw_ext1_J1939_PGN_tout2 "FPrm_switches_ext1(545)" VALUE 0x001C79C0 /* @ECU_Address@FPrm_switches_ext1@0x023A5442@ */ ECIPP_ALIGNMENT_UWORD 65535 Compu_IDENTITY 0 65535 PHYS_UNIT "Enable bits" /end CHARACTERISTIC
/begin CHARACTERISTIC FPsw_ext1_J1939_PGN_tout3 "FPrm_switches_ext1(546)" VALUE 0x001C79C2 /* @ECU_Address@FPrm_switches_ext1@0x023A5444@ */ ECIPP_ALIGNMENT_UWORD 65535 Compu_IDENTITY 0 65535 PHYS_UNIT "Enable bits" /end CHARACTERISTIC
/begin CHARACTERISTIC FPsw_ext1_J1939_PGN_tout4 "FPrm_switches_ext1(547)" VALUE 0x001C79C4 /* @ECU_Address@FPrm_switches_ext1@0x023A5446@ */ ECIPP_ALIGNMENT_UWORD 65535 Compu_IDENTITY 0 65535 PHYS_UNIT "Enable bits" /end CHARACTERISTIC
/begin CHARACTERISTIC FPsw_ext1_J1939_PGN_tout5 "FPrm_switches_ext1(548)" VALUE 0x001C79C6 /* @ECU_Address@FPrm_switches_ext1@0x023A5448@ */ ECIPP_ALIGNMENT_UWORD 65535 Compu_IDENTITY 0 65535 PHYS_UNIT "Enable bits" /end CHARACTERISTIC
/begin CHARACTERISTIC FPsw_ext1_J1939_PGN_tout6 "FPrm_switches_ext1(549)" VALUE 0x001C79C8 /* @ECU_Address@FPrm_switches_ext1@0x023A544A@ */ ECIPP_ALIGNMENT_UWORD 65535 Compu_IDENTITY 0 65535 PHYS_UNIT "Enable bits" /end CHARACTERISTIC
/begin CHARACTERISTIC FPsw_ext1_J1939_PGN_tout7 "FPrm_switches_ext1(550)" VALUE 0x001C79CA /* @ECU_Address@FPrm_switches_ext1@0x023A544C@ */ ECIPP_ALIGNMENT_UWORD 65535 Compu_IDENTITY 0 65535 PHYS_UNIT "Enable bits" /end CHARACTERISTIC
/begin CHARACTERISTIC FPsw_ext1_J1939_PGN_tout8 "FPrm_switches_ext1(551)" VALUE 0x001C79CC /* @ECU_Address@FPrm_switches_ext1@0x023A544E@ */ ECIPP_ALIGNMENT_UWORD 65535 Compu_IDENTITY 0 65535 PHYS_UNIT "Enable bits" /end CHARACTERISTIC
/begin CHARACTERISTIC FPsw_ext1_J1939_PGN_tout9 "FPrm_switches_ext1(552)" VALUE 0x001C79CE /* @ECU_Address@FPrm_switches_ext1@0x023A5450@ */ ECIPP_ALIGNMENT_UWORD 65535 Compu_IDENTITY 0 65535 PHYS_UNIT "Enable bits" /end CHARACTERISTIC
/begin CHARACTERISTIC FPsw_ext1_J1939_RS_err_loss "FPrm_switches_ext1(661)" VALUE 0x001C7AA8 /* @ECU_Address@FPrm_switches_ext1@0x023A552A@ */ ECIPP_ALIGNMENT_UWORD 65535 Compu_IDENTITY 0 65535 PHYS_UNIT "Enable bits" /end CHARACTERISTIC
/begin CHARACTERISTIC FPsw_ext1_J1939_RSsetpt_loss "FPrm_switches_ext1(454)" VALUE 0x001C790A /* @ECU_Address@FPrm_switches_ext1@0x023A538C@ */ ECIPP_ALIGNMENT_UWORD 65535 Compu_IDENTITY 0 65535 PHYS_UNIT "Enable bits" /end CHARACTERISTIC
/begin CHARACTERISTIC FPsw_ext1_J1939_Rx2Fail "FPrm_switches_ext1(221)" VALUE 0x001C7738 /* @ECU_Address@FPrm_switches_ext1@0x023A51BA@ */ ECIPP_ALIGNMENT_UWORD 65535 Compu_IDENTITY 0 65535 PHYS_UNIT "Enable bits" /end CHARACTERISTIC
/begin CHARACTERISTIC FPsw_ext1_J1939_Rx3Fail "FPrm_switches_ext1(222)" VALUE 0x001C773A /* @ECU_Address@FPrm_switches_ext1@0x023A51BC@ */ ECIPP_ALIGNMENT_UWORD 65535 Compu_IDENTITY 0 65535 PHYS_UNIT "Enable bits" /end CHARACTERISTIC
/begin CHARACTERISTIC FPsw_ext1_J1939_RxFail "FPrm_switches_ext1(115)" VALUE 0x001C7664 /* @ECU_Address@FPrm_switches_ext1@0x023A50E6@ */ ECIPP_ALIGNMENT_UWORD 65535 Compu_IDENTITY 0 65535 PHYS_UNIT "Enable bits" /end CHARACTERISTIC
/begin CHARACTERISTIC FPsw_ext1_J1939_SD_rq "FPrm_switches_ext1(113)" VALUE 0x001C7660 /* @ECU_Address@FPrm_switches_ext1@0x023A50E2@ */ ECIPP_ALIGNMENT_UWORD 65535 Compu_IDENTITY 0 65535 PHYS_UNIT "Enable bits" /end CHARACTERISTIC
/begin CHARACTERISTIC FPsw_FPrly_coilshort "FPrm_switches(129)" VALUE 0x001C70DC /* @ECU_Address@FPrm_switches@0x021B9102@ */ ECIPP_ALIGNMENT_UWORD 65535 Compu_IDENTITY 0 65535 PHYS_UNIT "Enable bits" /end CHARACTERISTIC
/begin CHARACTERISTIC FPsw_FPrly_gndshort "FPrm_switches(127)" VALUE 0x001C70D8 /* @ECU_Address@FPrm_switches@0x021B90FE@ */ ECIPP_ALIGNMENT_UWORD 65535 Compu_IDENTITY 0 65535 PHYS_UNIT "Enable bits" /end CHARACTERISTIC
/begin CHARACTERISTIC FPsw_FSO_post_TPS_phi_hi "FPrm_switches(687)" VALUE 0x001C7538 /* @ECU_Address@FPrm_switches@0x021B955E@ */ ECIPP_ALIGNMENT_UWORD 65535 Compu_IDENTITY 0 65535 PHYS_UNIT "Enable bits" /end CHARACTERISTIC
/begin CHARACTERISTIC FPsw_FSO_TPS_phi_hi "FPrm_switches(632)" VALUE 0x001C74CA /* @ECU_Address@FPrm_switches@0x021B94F0@ */ ECIPP_ALIGNMENT_UWORD 65535 Compu_IDENTITY 0 65535 PHYS_UNIT "Enable bits" /end CHARACTERISTIC
/begin CHARACTERISTIC FPsw_FT_maxv "FPrm_switches(106)" VALUE 0x001C70AE /* @ECU_Address@FPrm_switches@0x021B90D4@ */ ECIPP_ALIGNMENT_UWORD 65535 Compu_IDENTITY 0 65535 PHYS_UNIT "Enable bits" /end CHARACTERISTIC
/begin CHARACTERISTIC FPsw_FT_minv "FPrm_switches(107)" VALUE 0x001C70B0 /* @ECU_Address@FPrm_switches@0x021B90D6@ */ ECIPP_ALIGNMENT_UWORD 65535 Compu_IDENTITY 0 65535 PHYS_UNIT "Enable bits" /end CHARACTERISTIC
/begin CHARACTERISTIC FPsw_FTgasf_maxv "FPrm_switches(171)" VALUE 0x001C7130 /* @ECU_Address@FPrm_switches@0x021B9156@ */ ECIPP_ALIGNMENT_UWORD 65535 Compu_IDENTITY 0 65535 PHYS_UNIT "Enable bits" /end CHARACTERISTIC
/begin CHARACTERISTIC FPsw_FTgasf_minv "FPrm_switches(172)" VALUE 0x001C7132 /* @ECU_Address@FPrm_switches@0x021B9158@ */ ECIPP_ALIGNMENT_UWORD 65535 Compu_IDENTITY 0 65535 PHYS_UNIT "Enable bits" /end CHARACTERISTIC
/begin CHARACTERISTIC FPsw_GLOW_unit_fail "FPrm_switches(382)" VALUE 0x001C72D6 /* @ECU_Address@FPrm_switches@0x021B92FC@ */ ECIPP_ALIGNMENT_UWORD 65535 Compu_IDENTITY 0 65535 PHYS_UNIT "Enable bits" /end CHARACTERISTIC
/begin CHARACTERISTIC FPsw_GLOW1_open "FPrm_switches(380)" VALUE 0x001C72D2 /* @ECU_Address@FPrm_switches@0x021B92F8@ */ ECIPP_ALIGNMENT_UWORD 65535 Compu_IDENTITY 0 65535 PHYS_UNIT "Enable bits" /end CHARACTERISTIC
/begin CHARACTERISTIC FPsw_GLOW1_short "FPrm_switches(381)" VALUE 0x001C72D4 /* @ECU_Address@FPrm_switches@0x021B92FA@ */ ECIPP_ALIGNMENT_UWORD 65535 Compu_IDENTITY 0 65535 PHYS_UNIT "Enable bits" /end CHARACTERISTIC
/begin CHARACTERISTIC FPsw_gov_ntrlock_fail "FPrm_switches(36)" VALUE 0x001C7022 /* @ECU_Address@FPrm_switches@0x021B9048@ */ ECIPP_ALIGNMENT_UWORD 65535 Compu_IDENTITY 0 65535 PHYS_UNIT "Enable bits" /end CHARACTERISTIC
/begin CHARACTERISTIC FPsw_gyro_x_max "FPrm_switches(538)" VALUE 0x001C740E /* @ECU_Address@FPrm_switches@0x021B9434@ */ ECIPP_ALIGNMENT_UWORD 65535 Compu_IDENTITY 0 65535 PHYS_UNIT "Enable bits" /end CHARACTERISTIC
/begin CHARACTERISTIC FPsw_gyro_x_min "FPrm_switches(539)" VALUE 0x001C7410 /* @ECU_Address@FPrm_switches@0x021B9436@ */ ECIPP_ALIGNMENT_UWORD 65535 Compu_IDENTITY 0 65535 PHYS_UNIT "Enable bits" /end CHARACTERISTIC
/begin CHARACTERISTIC FPsw_gyro_y_max "FPrm_switches(540)" VALUE 0x001C7412 /* @ECU_Address@FPrm_switches@0x021B9438@ */ ECIPP_ALIGNMENT_UWORD 65535 Compu_IDENTITY 0 65535 PHYS_UNIT "Enable bits" /end CHARACTERISTIC
/begin CHARACTERISTIC FPsw_gyro_y_min "FPrm_switches(541)" VALUE 0x001C7414 /* @ECU_Address@FPrm_switches@0x021B943A@ */ ECIPP_ALIGNMENT_UWORD 65535 Compu_IDENTITY 0 65535 PHYS_UNIT "Enable bits" /end CHARACTERISTIC
/begin CHARACTERISTIC FPsw_gyro_z_max "FPrm_switches(542)" VALUE 0x001C7416 /* @ECU_Address@FPrm_switches@0x021B943C@ */ ECIPP_ALIGNMENT_UWORD 65535 Compu_IDENTITY 0 65535 PHYS_UNIT "Enable bits" /end CHARACTERISTIC
/begin CHARACTERISTIC FPsw_gyro_z_min "FPrm_switches(543)" VALUE 0x001C7418 /* @ECU_Address@FPrm_switches@0x021B943E@ */ ECIPP_ALIGNMENT_UWORD 65535 Compu_IDENTITY 0 65535 PHYS_UNIT "Enable bits" /end CHARACTERISTIC
/begin CHARACTERISTIC FPsw_HBA_I_max "FPrm_switches(398)" VALUE 0x001C72F6 /* @ECU_Address@FPrm_switches@0x021B931C@ */ ECIPP_ALIGNMENT_UWORD 65535 Compu_IDENTITY 0 65535 PHYS_UNIT "Enable bits" /end CHARACTERISTIC
/begin CHARACTERISTIC FPsw_HBB_I_max "FPrm_switches(399)" VALUE 0x001C72F8 /* @ECU_Address@FPrm_switches@0x021B931E@ */ ECIPP_ALIGNMENT_UWORD 65535 Compu_IDENTITY 0 65535 PHYS_UNIT "Enable bits" /end CHARACTERISTIC
/begin CHARACTERISTIC FPsw_HiDiagTemp "FPrm_switches(482)" VALUE 0x001C739E /* @ECU_Address@FPrm_switches@0x021B93C4@ */ ECIPP_ALIGNMENT_UWORD 65535 Compu_IDENTITY 0 65535 PHYS_UNIT "Enable bits" /end CHARACTERISTIC
/begin CHARACTERISTIC FPsw_HWID_fail "FPrm_switches(227)" VALUE 0x001C71A0 /* @ECU_Address@FPrm_switches@0x021B91C6@ */ ECIPP_ALIGNMENT_UWORD 65535 Compu_IDENTITY 0 65535 PHYS_UNIT "Enable bits" /end CHARACTERISTIC
/begin CHARACTERISTIC FPsw_IAC_gndshort "FPrm_switches(116)" VALUE 0x001C70C2 /* @ECU_Address@FPrm_switches@0x021B90E8@ */ ECIPP_ALIGNMENT_UWORD 65535 Compu_IDENTITY 0 65535 PHYS_UNIT "Enable bits" /end CHARACTERISTIC
/begin CHARACTERISTIC FPsw_IAC_openshort "FPrm_switches(117)" VALUE 0x001C70C4 /* @ECU_Address@FPrm_switches@0x021B90EA@ */ ECIPP_ALIGNMENT_UWORD 65535 Compu_IDENTITY 0 65535 PHYS_UNIT "Enable bits" /end CHARACTERISTIC
/begin CHARACTERISTIC FPsw_IAT_HiExp "FPrm_switches(8)" VALUE 0x001C6FEA /* @ECU_Address@FPrm_switches@0x021B9010@ */ ECIPP_ALIGNMENT_UWORD 65535 Compu_IDENTITY 0 65535 PHYS_UNIT "Enable bits" /end CHARACTERISTIC
/begin CHARACTERISTIC FPsw_IAT_HiExp2 "FPrm_switches(9)" VALUE 0x001C6FEC /* @ECU_Address@FPrm_switches@0x021B9012@ */ ECIPP_ALIGNMENT_UWORD 65535 Compu_IDENTITY 0 65535 PHYS_UNIT "Enable bits" /end CHARACTERISTIC
/begin CHARACTERISTIC FPsw_IAT_maxv "FPrm_switches(6)" VALUE 0x001C6FE6 /* @ECU_Address@FPrm_switches@0x021B900C@ */ ECIPP_ALIGNMENT_UWORD 65535 Compu_IDENTITY 0 65535 PHYS_UNIT "Enable bits" /end CHARACTERISTIC
/begin CHARACTERISTIC FPsw_IAT_minv "FPrm_switches(7)" VALUE 0x001C6FE8 /* @ECU_Address@FPrm_switches@0x021B900E@ */ ECIPP_ALIGNMENT_UWORD 65535 Compu_IDENTITY 0 65535 PHYS_UNIT "Enable bits" /end CHARACTERISTIC
/begin CHARACTERISTIC FPsw_IBF_detected "FPrm_switches(688)" VALUE 0x001C753A /* @ECU_Address@FPrm_switches@0x021B9560@ */ ECIPP_ALIGNMENT_UWORD 65535 Compu_IDENTITY 0 65535 PHYS_UNIT "Enable bits" /end CHARACTERISTIC
/begin CHARACTERISTIC FPsw_ICam_maxerr "FPrm_switches(210)" VALUE 0x001C717E /* @ECU_Address@FPrm_switches@0x021B91A4@ */ ECIPP_ALIGNMENT_UWORD 65535 Compu_IDENTITY 0 65535 PHYS_UNIT "Enable bits" /end CHARACTERISTIC
/begin CHARACTERISTIC FPsw_ICAVD1_mis "FPrm_switches(195)" VALUE 0x001C7160 /* @ECU_Address@FPrm_switches@0x021B9186@ */ ECIPP_ALIGNMENT_UWORD 65535 Compu_IDENTITY 0 65535 PHYS_UNIT "Enable bits" /end CHARACTERISTIC
/begin CHARACTERISTIC FPsw_ICAVD1_miscat "FPrm_switches(196)" VALUE 0x001C7162 /* @ECU_Address@FPrm_switches@0x021B9188@ */ ECIPP_ALIGNMENT_UWORD 65535 Compu_IDENTITY 0 65535 PHYS_UNIT "Enable bits" /end CHARACTERISTIC
/begin CHARACTERISTIC FPsw_ICCOT_hi "FPrm_switches(690)" VALUE 0x001C753E /* @ECU_Address@FPrm_switches@0x021B9564@ */ ECIPP_ALIGNMENT_UWORD 65535 Compu_IDENTITY 0 65535 PHYS_UNIT "Enable bits" /end CHARACTERISTIC
/begin CHARACTERISTIC FPsw_Idle_SD "FPrm_switches(484)" VALUE 0x001C73A2 /* @ECU_Address@FPrm_switches@0x021B93C8@ */ ECIPP_ALIGNMENT_UWORD 65535 Compu_IDENTITY 0 65535 PHYS_UNIT "Enable bits" /end CHARACTERISTIC
/begin CHARACTERISTIC FPsw_imu_general "FPrm_switches(529)" VALUE 0x001C73FC /* @ECU_Address@FPrm_switches@0x021B9422@ */ ECIPP_ALIGNMENT_UWORD 65535 Compu_IDENTITY 0 65535 PHYS_UNIT "Enable bits" /end CHARACTERISTIC
/begin CHARACTERISTIC FPsw_imu_temp_max "FPrm_switches(530)" VALUE 0x001C73FE /* @ECU_Address@FPrm_switches@0x021B9424@ */ ECIPP_ALIGNMENT_UWORD 65535 Compu_IDENTITY 0 65535 PHYS_UNIT "Enable bits" /end CHARACTERISTIC
/begin CHARACTERISTIC FPsw_imu_temp_min "FPrm_switches(531)" VALUE 0x001C7400 /* @ECU_Address@FPrm_switches@0x021B9426@ */ ECIPP_ALIGNMENT_UWORD 65535 Compu_IDENTITY 0 65535 PHYS_UNIT "Enable bits" /end CHARACTERISTIC
/begin CHARACTERISTIC FPsw_IMVD_Ifb_hi "FPrm_switches(437)" VALUE 0x001C7344 /* @ECU_Address@FPrm_switches@0x021B936A@ */ ECIPP_ALIGNMENT_UWORD 65535 Compu_IDENTITY 0 65535 PHYS_UNIT "Enable bits" /end CHARACTERISTIC
/begin CHARACTERISTIC FPsw_IMVD_Ifb_lo "FPrm_switches(436)" VALUE 0x001C7342 /* @ECU_Address@FPrm_switches@0x021B9368@ */ ECIPP_ALIGNMENT_UWORD 65535 Compu_IDENTITY 0 65535 PHYS_UNIT "Enable bits" /end CHARACTERISTIC
/begin CHARACTERISTIC FPsw_INJD_boost_lo "FPrm_switches(434)" VALUE 0x001C733E /* @ECU_Address@FPrm_switches@0x021B9364@ */ ECIPP_ALIGNMENT_UWORD 65535 Compu_IDENTITY 0 65535 PHYS_UNIT "Enable bits" /end CHARACTERISTIC
/begin CHARACTERISTIC FPsw_INJD_HS_Ihi "FPrm_switches(432)" VALUE 0x001C733A /* @ECU_Address@FPrm_switches@0x021B9360@ */ ECIPP_ALIGNMENT_UWORD 65535 Compu_IDENTITY 0 65535 PHYS_UNIT "Enable bits" /end CHARACTERISTIC
/begin CHARACTERISTIC FPsw_INJD_HW_int "FPrm_switches(435)" VALUE 0x001C7340 /* @ECU_Address@FPrm_switches@0x021B9366@ */ ECIPP_ALIGNMENT_UWORD 65535 Compu_IDENTITY 0 65535 PHYS_UNIT "Enable bits" /end CHARACTERISTIC
/begin CHARACTERISTIC FPsw_INJD_LS_Ihi "FPrm_switches(433)" VALUE 0x001C733C /* @ECU_Address@FPrm_switches@0x021B9362@ */ ECIPP_ALIGNMENT_UWORD 65535 Compu_IDENTITY 0 65535 PHYS_UNIT "Enable bits" /end CHARACTERISTIC
/begin CHARACTERISTIC FPsw_INJD_off_lo "FPrm_switches(53)" VALUE 0x001C7044 /* @ECU_Address@FPrm_switches@0x021B906A@ */ ECIPP_ALIGNMENT_UWORD 65535 Compu_IDENTITY 0 65535 PHYS_UNIT "Enable bits" /end CHARACTERISTIC
/begin CHARACTERISTIC FPsw_INJD_on_hi "FPrm_switches(54)" VALUE 0x001C7046 /* @ECU_Address@FPrm_switches@0x021B906C@ */ ECIPP_ALIGNMENT_UWORD 65535 Compu_IDENTITY 0 65535 PHYS_UNIT "Enable bits" /end CHARACTERISTIC
/begin CHARACTERISTIC FPsw_intby_poserr "FPrm_switches(691)" VALUE 0x001C7540 /* @ECU_Address@FPrm_switches@0x021B9566@ */ ECIPP_ALIGNMENT_UWORD 65535 Compu_IDENTITY 0 65535 PHYS_UNIT "Enable bits" /end CHARACTERISTIC
/begin CHARACTERISTIC FPsw_interrupt "FPrm_switches(68)" VALUE 0x001C7062 /* @ECU_Address@FPrm_switches@0x021B9088@ */ ECIPP_ALIGNMENT_UWORD 65535 Compu_IDENTITY 0 65535 PHYS_UNIT "Enable bits" /end CHARACTERISTIC
/begin CHARACTERISTIC FPsw_IRV_CL_OOA "FPrm_switches(696)" VALUE 0x001C754A /* @ECU_Address@FPrm_switches@0x021B9570@ */ ECIPP_ALIGNMENT_UWORD 65535 Compu_IDENTITY 0 65535 PHYS_UNIT "Enable bits" /end CHARACTERISTIC
/begin CHARACTERISTIC FPsw_J1939_AAT_err_loss "FPrm_switches(662)" VALUE 0x001C7506 /* @ECU_Address@FPrm_switches@0x021B952C@ */ ECIPP_ALIGNMENT_UWORD 65535 Compu_IDENTITY 0 65535 PHYS_UNIT "Enable bits" /end CHARACTERISTIC
/begin CHARACTERISTIC FPsw_J1939_addr2Fail "FPrm_switches(223)" VALUE 0x001C7198 /* @ECU_Address@FPrm_switches@0x021B91BE@ */ ECIPP_ALIGNMENT_UWORD 65535 Compu_IDENTITY 0 65535 PHYS_UNIT "Enable bits" /end CHARACTERISTIC
/begin CHARACTERISTIC FPsw_J1939_addr3Fail "FPrm_switches(224)" VALUE 0x001C719A /* @ECU_Address@FPrm_switches@0x021B91C0@ */ ECIPP_ALIGNMENT_UWORD 65535 Compu_IDENTITY 0 65535 PHYS_UNIT "Enable bits" /end CHARACTERISTIC
/begin CHARACTERISTIC FPsw_J1939_addrFail "FPrm_switches(146)" VALUE 0x001C70FE /* @ECU_Address@FPrm_switches@0x021B9124@ */ ECIPP_ALIGNMENT_UWORD 65535 Compu_IDENTITY 0 65535 PHYS_UNIT "Enable bits" /end CHARACTERISTIC
/begin CHARACTERISTIC FPsw_J1939_ETC_loss "FPrm_switches(175)" VALUE 0x001C7138 /* @ECU_Address@FPrm_switches@0x021B915E@ */ ECIPP_ALIGNMENT_UWORD 65535 Compu_IDENTITY 0 65535 PHYS_UNIT "Enable bits" /end CHARACTERISTIC
/begin CHARACTERISTIC FPsw_J1939_ETC_loss2 "FPrm_switches(197)" VALUE 0x001C7164 /* @ECU_Address@FPrm_switches@0x021B918A@ */ ECIPP_ALIGNMENT_UWORD 65535 Compu_IDENTITY 0 65535 PHYS_UNIT "Enable bits" /end CHARACTERISTIC
/begin CHARACTERISTIC FPsw_J1939_PGN_tout "FPrm_switches(544)" VALUE 0x001C741A /* @ECU_Address@FPrm_switches@0x021B9440@ */ ECIPP_ALIGNMENT_UWORD 65535 Compu_IDENTITY 0 65535 PHYS_UNIT "Enable bits" /end CHARACTERISTIC
/begin CHARACTERISTIC FPsw_J1939_PGN_tout10 "FPrm_switches(553)" VALUE 0x001C742C /* @ECU_Address@FPrm_switches@0x021B9452@ */ ECIPP_ALIGNMENT_UWORD 65535 Compu_IDENTITY 0 65535 PHYS_UNIT "Enable bits" /end CHARACTERISTIC
/begin CHARACTERISTIC FPsw_J1939_PGN_tout2 "FPrm_switches(545)" VALUE 0x001C741C /* @ECU_Address@FPrm_switches@0x021B9442@ */ ECIPP_ALIGNMENT_UWORD 65535 Compu_IDENTITY 0 65535 PHYS_UNIT "Enable bits" /end CHARACTERISTIC
/begin CHARACTERISTIC FPsw_J1939_PGN_tout3 "FPrm_switches(546)" VALUE 0x001C741E /* @ECU_Address@FPrm_switches@0x021B9444@ */ ECIPP_ALIGNMENT_UWORD 65535 Compu_IDENTITY 0 65535 PHYS_UNIT "Enable bits" /end CHARACTERISTIC
/begin CHARACTERISTIC FPsw_J1939_PGN_tout4 "FPrm_switches(547)" VALUE 0x001C7420 /* @ECU_Address@FPrm_switches@0x021B9446@ */ ECIPP_ALIGNMENT_UWORD 65535 Compu_IDENTITY 0 65535 PHYS_UNIT "Enable bits" /end CHARACTERISTIC
/begin CHARACTERISTIC FPsw_J1939_PGN_tout5 "FPrm_switches(548)" VALUE 0x001C7422 /* @ECU_Address@FPrm_switches@0x021B9448@ */ ECIPP_ALIGNMENT_UWORD 65535 Compu_IDENTITY 0 65535 PHYS_UNIT "Enable bits" /end CHARACTERISTIC
/begin CHARACTERISTIC FPsw_J1939_PGN_tout6 "FPrm_switches(549)" VALUE 0x001C7424 /* @ECU_Address@FPrm_switches@0x021B944A@ */ ECIPP_ALIGNMENT_UWORD 65535 Compu_IDENTITY 0 65535 PHYS_UNIT "Enable bits" /end CHARACTERISTIC
/begin CHARACTERISTIC FPsw_J1939_PGN_tout7 "FPrm_switches(550)" VALUE 0x001C7426 /* @ECU_Address@FPrm_switches@0x021B944C@ */ ECIPP_ALIGNMENT_UWORD 65535 Compu_IDENTITY 0 65535 PHYS_UNIT "Enable bits" /end CHARACTERISTIC
/begin CHARACTERISTIC FPsw_J1939_PGN_tout8 "FPrm_switches(551)" VALUE 0x001C7428 /* @ECU_Address@FPrm_switches@0x021B944E@ */ ECIPP_ALIGNMENT_UWORD 65535 Compu_IDENTITY 0 65535 PHYS_UNIT "Enable bits" /end CHARACTERISTIC
/begin CHARACTERISTIC FPsw_J1939_PGN_tout9 "FPrm_switches(552)" VALUE 0x001C742A /* @ECU_Address@FPrm_switches@0x021B9450@ */ ECIPP_ALIGNMENT_UWORD 65535 Compu_IDENTITY 0 65535 PHYS_UNIT "Enable bits" /end CHARACTERISTIC
/begin CHARACTERISTIC FPsw_J1939_RS_err_loss "FPrm_switches(661)" VALUE 0x001C7504 /* @ECU_Address@FPrm_switches@0x021B952A@ */ ECIPP_ALIGNMENT_UWORD 65535 Compu_IDENTITY 0 65535 PHYS_UNIT "Enable bits" /end CHARACTERISTIC
/begin CHARACTERISTIC FPsw_J1939_RSsetpt_loss "FPrm_switches(454)" VALUE 0x001C7366 /* @ECU_Address@FPrm_switches@0x021B938C@ */ ECIPP_ALIGNMENT_UWORD 65535 Compu_IDENTITY 0 65535 PHYS_UNIT "Enable bits" /end CHARACTERISTIC
/begin CHARACTERISTIC FPsw_J1939_Rx2Fail "FPrm_switches(221)" VALUE 0x001C7194 /* @ECU_Address@FPrm_switches@0x021B91BA@ */ ECIPP_ALIGNMENT_UWORD 65535 Compu_IDENTITY 0 65535 PHYS_UNIT "Enable bits" /end CHARACTERISTIC
/begin CHARACTERISTIC FPsw_J1939_Rx3Fail "FPrm_switches(222)" VALUE 0x001C7196 /* @ECU_Address@FPrm_switches@0x021B91BC@ */ ECIPP_ALIGNMENT_UWORD 65535 Compu_IDENTITY 0 65535 PHYS_UNIT "Enable bits" /end CHARACTERISTIC
/begin CHARACTERISTIC FPsw_J1939_RxFail "FPrm_switches(115)" VALUE 0x001C70C0 /* @ECU_Address@FPrm_switches@0x021B90E6@ */ ECIPP_ALIGNMENT_UWORD 65535 Compu_IDENTITY 0 65535 PHYS_UNIT "Enable bits" /end CHARACTERISTIC
/begin CHARACTERISTIC FPsw_J1939_SD_rq "FPrm_switches(113)" VALUE 0x001C70BC /* @ECU_Address@FPrm_switches@0x021B90E2@ */ ECIPP_ALIGNMENT_UWORD 65535 Compu_IDENTITY 0 65535 PHYS_UNIT "Enable bits" /end CHARACTERISTIC
/begin CHARACTERISTIC FCdtc_FPrly_coilshort "FCtl_DTC(169)" VALUE 0x001E39BC /* @ECU_Address@FCtl_DTC@0x021B5152@ */ ECIPP_ALIGNMENT_UWORD 65535 Compu_IDENTITY 0 65535 PHYS_UNIT "DTC" /end CHARACTERISTIC
/begin CHARACTERISTIC FCdtc_FPrly_gndshort "FCtl_DTC(167)" VALUE 0x001E39B8 /* @ECU_Address@FCtl_DTC@0x021B514E@ */ ECIPP_ALIGNMENT_UWORD 65535 Compu_IDENTITY 0 65535 PHYS_UNIT "DTC" /end CHARACTERISTIC
/begin CHARACTERISTIC FCdtc_FSO_post_TPS_phi_hi "FCtl_DTC(860)" VALUE 0x001E3F22 /* @ECU_Address@FCtl_DTC@0x021B56B8@ */ ECIPP_ALIGNMENT_UWORD 65535 Compu_IDENTITY 0 65535 PHYS_UNIT "DTC" /end CHARACTERISTIC
/begin CHARACTERISTIC FCdtc_FSO_TPS_phi_hi "FCtl_DTC(803)" VALUE 0x001E3EB0 /* @ECU_Address@FCtl_DTC@0x021B5646@ */ ECIPP_ALIGNMENT_UWORD 65535 Compu_IDENTITY 0 65535 PHYS_UNIT "DTC" /end CHARACTERISTIC
/begin CHARACTERISTIC FCdtc_FT_maxv "FCtl_DTC(146)" VALUE 0x001E398E /* @ECU_Address@FCtl_DTC@0x021B5124@ */ ECIPP_ALIGNMENT_UWORD 65535 Compu_IDENTITY 0 65535 PHYS_UNIT "DTC" /end CHARACTERISTIC
/begin CHARACTERISTIC FCdtc_FT_minv "FCtl_DTC(147)" VALUE 0x001E3990 /* @ECU_Address@FCtl_DTC@0x021B5126@ */ ECIPP_ALIGNMENT_UWORD 65535 Compu_IDENTITY 0 65535 PHYS_UNIT "DTC" /end CHARACTERISTIC
/begin CHARACTERISTIC FCdtc_FTgasf_maxv "FCtl_DTC(215)" VALUE 0x001E3A18 /* @ECU_Address@FCtl_DTC@0x021B51AE@ */ ECIPP_ALIGNMENT_UWORD 65535 Compu_IDENTITY 0 65535 PHYS_UNIT "DTC" /end CHARACTERISTIC
/begin CHARACTERISTIC FCdtc_FTgasf_minv "FCtl_DTC(216)" VALUE 0x001E3A1A /* @ECU_Address@FCtl_DTC@0x021B51B0@ */ ECIPP_ALIGNMENT_UWORD 65535 Compu_IDENTITY 0 65535 PHYS_UNIT "DTC" /end CHARACTERISTIC
/begin CHARACTERISTIC FCdtc_GLOW_unit_fail "FCtl_DTC(503)" VALUE 0x001E3C58 /* @ECU_Address@FCtl_DTC@0x021B53EE@ */ ECIPP_ALIGNMENT_UWORD 65535 Compu_IDENTITY 0 65535 PHYS_UNIT "DTC" /end CHARACTERISTIC
/begin CHARACTERISTIC FCdtc_GLOW1_open "FCtl_DTC(483)" VALUE 0x001E3C30 /* @ECU_Address@FCtl_DTC@0x021B53C6@ */ ECIPP_ALIGNMENT_UWORD 65535 Compu_IDENTITY 0 65535 PHYS_UNIT "DTC" /end CHARACTERISTIC
/begin CHARACTERISTIC FCdtc_GLOW1_short "FCtl_DTC(493)" VALUE 0x001E3C44 /* @ECU_Address@FCtl_DTC@0x021B53DA@ */ ECIPP_ALIGNMENT_UWORD 65535 Compu_IDENTITY 0 65535 PHYS_UNIT "DTC" /end CHARACTERISTIC
/begin CHARACTERISTIC FCdtc_gov_ntrlock_fail "FCtl_DTC(92)" VALUE 0x001E3922 /* @ECU_Address@FCtl_DTC@0x021B50B8@ */ ECIPP_ALIGNMENT_UWORD 65535 Compu_IDENTITY 0 65535 PHYS_UNIT "DTC" /end CHARACTERISTIC
/begin CHARACTERISTIC FCdtc_gyro_x_max "FCtl_DTC(708)" VALUE 0x001E3DF2 /* @ECU_Address@FCtl_DTC@0x021B5588@ */ ECIPP_ALIGNMENT_UWORD 65535 Compu_IDENTITY 0 65535 PHYS_UNIT "DTC" /end CHARACTERISTIC
/begin CHARACTERISTIC FCdtc_gyro_x_min "FCtl_DTC(709)" VALUE 0x001E3DF4 /* @ECU_Address@FCtl_DTC@0x021B558A@ */ ECIPP_ALIGNMENT_UWORD 65535 Compu_IDENTITY 0 65535 PHYS_UNIT "DTC" /end CHARACTERISTIC
/begin CHARACTERISTIC FCdtc_gyro_y_max "FCtl_DTC(710)" VALUE 0x001E3DF6 /* @ECU_Address@FCtl_DTC@0x021B558C@ */ ECIPP_ALIGNMENT_UWORD 65535 Compu_IDENTITY 0 65535 PHYS_UNIT "DTC" /end CHARACTERISTIC
/begin CHARACTERISTIC FCdtc_gyro_y_min "FCtl_DTC(711)" VALUE 0x001E3DF8 /* @ECU_Address@FCtl_DTC@0x021B558E@ */ ECIPP_ALIGNMENT_UWORD 65535 Compu_IDENTITY 0 65535 PHYS_UNIT "DTC" /end CHARACTERISTIC
/begin CHARACTERISTIC FCdtc_gyro_z_max "FCtl_DTC(712)" VALUE 0x001E3DFA /* @ECU_Address@FCtl_DTC@0x021B5590@ */ ECIPP_ALIGNMENT_UWORD 65535 Compu_IDENTITY 0 65535 PHYS_UNIT "DTC" /end CHARACTERISTIC
/begin CHARACTERISTIC FCdtc_gyro_z_min "FCtl_DTC(713)" VALUE 0x001E3DFC /* @ECU_Address@FCtl_DTC@0x021B5592@ */ ECIPP_ALIGNMENT_UWORD 65535 Compu_IDENTITY 0 65535 PHYS_UNIT "DTC" /end CHARACTERISTIC
/begin CHARACTERISTIC FCdtc_HBA_I_max "FCtl_DTC(528)" VALUE 0x001E3C8A /* @ECU_Address@FCtl_DTC@0x021B5420@ */ ECIPP_ALIGNMENT_UWORD 65535 Compu_IDENTITY 0 65535 PHYS_UNIT "DTC" /end CHARACTERISTIC
/begin CHARACTERISTIC FCdtc_HBB_I_max "FCtl_DTC(529)" VALUE 0x001E3C8C /* @ECU_Address@FCtl_DTC@0x021B5422@ */ ECIPP_ALIGNMENT_UWORD 65535 Compu_IDENTITY 0 65535 PHYS_UNIT "DTC" /end CHARACTERISTIC
/begin CHARACTERISTIC FCdtc_HiDiagTemp "FCtl_DTC(652)" VALUE 0x001E3D82 /* @ECU_Address@FCtl_DTC@0x021B5518@ */ ECIPP_ALIGNMENT_UWORD 65535 Compu_IDENTITY 0 65535 PHYS_UNIT "DTC" /end CHARACTERISTIC
/begin CHARACTERISTIC FCdtc_HWID_fail "FCtl_DTC(318)" VALUE 0x001E3AE6 /* @ECU_Address@FCtl_DTC@0x021B527C@ */ ECIPP_ALIGNMENT_UWORD 65535 Compu_IDENTITY 0 65535 PHYS_UNIT "DTC" /end CHARACTERISTIC
/begin CHARACTERISTIC FCdtc_IAC_gndshort "FCtl_DTC(156)" VALUE 0x001E39A2 /* @ECU_Address@FCtl_DTC@0x021B5138@ */ ECIPP_ALIGNMENT_UWORD 65535 Compu_IDENTITY 0 65535 PHYS_UNIT "DTC" /end CHARACTERISTIC
/begin CHARACTERISTIC FCdtc_IAC_openshort "FCtl_DTC(157)" VALUE 0x001E39A4 /* @ECU_Address@FCtl_DTC@0x021B513A@ */ ECIPP_ALIGNMENT_UWORD 65535 Compu_IDENTITY 0 65535 PHYS_UNIT "DTC" /end CHARACTERISTIC
/begin CHARACTERISTIC FCdtc_IAT_HiExp "FCtl_DTC(87)" VALUE 0x001E3918 /* @ECU_Address@FCtl_DTC@0x021B50AE@ */ ECIPP_ALIGNMENT_UWORD 65535 Compu_IDENTITY 0 65535 PHYS_UNIT "DTC" /end CHARACTERISTIC
/begin CHARACTERISTIC FCdtc_IAT_HiExp2 "FCtl_DTC(88)" VALUE 0x001E391A /* @ECU_Address@FCtl_DTC@0x021B50B0@ */ ECIPP_ALIGNMENT_UWORD 65535 Compu_IDENTITY 0 65535 PHYS_UNIT "DTC" /end CHARACTERISTIC
/begin CHARACTERISTIC FCdtc_IAT_maxv "FCtl_DTC(5)" VALUE 0x001E3874 /* @ECU_Address@FCtl_DTC@0x021B500A@ */ ECIPP_ALIGNMENT_UWORD 65535 Compu_IDENTITY 0 65535 PHYS_UNIT "DTC" /end CHARACTERISTIC
/begin CHARACTERISTIC FCdtc_IAT_minv "FCtl_DTC(6)" VALUE 0x001E3876 /* @ECU_Address@FCtl_DTC@0x021B500C@ */ ECIPP_ALIGNMENT_UWORD 65535 Compu_IDENTITY 0 65535 PHYS_UNIT "DTC" /end CHARACTERISTIC
/begin CHARACTERISTIC FCdtc_IBF_detected "FCtl_DTC(861)" VALUE 0x001E3F24 /* @ECU_Address@FCtl_DTC@0x021B56BA@ */ ECIPP_ALIGNMENT_UWORD 65535 Compu_IDENTITY 0 65535 PHYS_UNIT "DTC" /end CHARACTERISTIC
/begin CHARACTERISTIC FCdtc_ICam_maxerr "FCtl_DTC(288)" VALUE 0x001E3AAA /* @ECU_Address@FCtl_DTC@0x021B5240@ */ ECIPP_ALIGNMENT_UWORD 65535 Compu_IDENTITY 0 65535 PHYS_UNIT "DTC" /end CHARACTERISTIC
/begin CHARACTERISTIC FCdtc_ICAVD1_mis "FCtl_DTC(259)" VALUE 0x001E3A70 /* @ECU_Address@FCtl_DTC@0x021B5206@ */ ECIPP_ALIGNMENT_UWORD 65535 Compu_IDENTITY 0 65535 PHYS_UNIT "DTC" /end CHARACTERISTIC
/begin CHARACTERISTIC FCdtc_ICAVD1_miscat "FCtl_DTC(267)" VALUE 0x001E3A80 /* @ECU_Address@FCtl_DTC@0x021B5216@ */ ECIPP_ALIGNMENT_UWORD 65535 Compu_IDENTITY 0 65535 PHYS_UNIT "DTC" /end CHARACTERISTIC
/begin CHARACTERISTIC FCdtc_ICCOT_hi "FCtl_DTC(863)" VALUE 0x001E3F28 /* @ECU_Address@FCtl_DTC@0x021B56BE@ */ ECIPP_ALIGNMENT_UWORD 65535 Compu_IDENTITY 0 65535 PHYS_UNIT "DTC" /end CHARACTERISTIC
/begin CHARACTERISTIC FCdtc_Idle_SD "FCtl_DTC(654)" VALUE 0x001E3D86 /* @ECU_Address@FCtl_DTC@0x021B551C@ */ ECIPP_ALIGNMENT_UWORD 65535 Compu_IDENTITY 0 65535 PHYS_UNIT "DTC" /end CHARACTERISTIC
/begin CHARACTERISTIC FCdtc_imu_general "FCtl_DTC(699)" VALUE 0x001E3DE0 /* @ECU_Address@FCtl_DTC@0x021B5576@ */ ECIPP_ALIGNMENT_UWORD 65535 Compu_IDENTITY 0 65535 PHYS_UNIT "DTC" /end CHARACTERISTIC
/begin CHARACTERISTIC FCdtc_imu_temp_max "FCtl_DTC(700)" VALUE 0x001E3DE2 /* @ECU_Address@FCtl_DTC@0x021B5578@ */ ECIPP_ALIGNMENT_UWORD 65535 Compu_IDENTITY 0 65535 PHYS_UNIT "DTC" /end CHARACTERISTIC
/begin CHARACTERISTIC FCdtc_imu_temp_min "FCtl_DTC(701)" VALUE 0x001E3DE4 /* @ECU_Address@FCtl_DTC@0x021B557A@ */ ECIPP_ALIGNMENT_UWORD 65535 Compu_IDENTITY 0 65535 PHYS_UNIT "DTC" /end CHARACTERISTIC
/begin CHARACTERISTIC FCdtc_IMVD_Ifb_hi "FCtl_DTC(583)" VALUE 0x001E3CF8 /* @ECU_Address@FCtl_DTC@0x021B548E@ */ ECIPP_ALIGNMENT_UWORD 65535 Compu_IDENTITY 0 65535 PHYS_UNIT "DTC" /end CHARACTERISTIC
/begin CHARACTERISTIC FCdtc_IMVD_Ifb_lo "FCtl_DTC(582)" VALUE 0x001E3CF6 /* @ECU_Address@FCtl_DTC@0x021B548C@ */ ECIPP_ALIGNMENT_UWORD 65535 Compu_IDENTITY 0 65535 PHYS_UNIT "DTC" /end CHARACTERISTIC
/begin CHARACTERISTIC FCdtc_INJD_boost_lo "FCtl_DTC(578)" VALUE 0x001E3CEE /* @ECU_Address@FCtl_DTC@0x021B5484@ */ ECIPP_ALIGNMENT_UWORD 65535 Compu_IDENTITY 0 65535 PHYS_UNIT "DTC" /end CHARACTERISTIC
/begin CHARACTERISTIC FCdtc_INJD_HS_Ihi "FCtl_DTC(562)" VALUE 0x001E3CCE /* @ECU_Address@FCtl_DTC@0x021B5464@ */ ECIPP_ALIGNMENT_UWORD 65535 Compu_IDENTITY 0 65535 PHYS_UNIT "DTC" /end CHARACTERISTIC
/begin CHARACTERISTIC FCdtc_INJD_HW_int "FCtl_DTC(580)" VALUE 0x001E3CF2 /* @ECU_Address@FCtl_DTC@0x021B5488@ */ ECIPP_ALIGNMENT_UWORD 65535 Compu_IDENTITY 0 65535 PHYS_UNIT "DTC" /end CHARACTERISTIC
/begin CHARACTERISTIC FCdtc_INJD_LS_Ihi "FCtl_DTC(570)" VALUE 0x001E3CDE /* @ECU_Address@FCtl_DTC@0x021B5474@ */ ECIPP_ALIGNMENT_UWORD 65535 Compu_IDENTITY 0 65535 PHYS_UNIT "DTC" /end CHARACTERISTIC
/begin CHARACTERISTIC FCdtc_INJD_off_lo "FCtl_DTC(46)" VALUE 0x001E38C6 /* @ECU_Address@FCtl_DTC@0x021B505C@ */ ECIPP_ALIGNMENT_UWORD 65535 Compu_IDENTITY 0 65535 PHYS_UNIT "DTC" /end CHARACTERISTIC
/begin CHARACTERISTIC FCdtc_INJD_on_hi "FCtl_DTC(56)" VALUE 0x001E38DA /* @ECU_Address@FCtl_DTC@0x021B5070@ */ ECIPP_ALIGNMENT_UWORD 65535 Compu_IDENTITY 0 65535 PHYS_UNIT "DTC" /end CHARACTERISTIC
/begin CHARACTERISTIC FCdtc_intby_poserr "FCtl_DTC(864)" VALUE 0x001E3F2A /* @ECU_Address@FCtl_DTC@0x021B56C0@ */ ECIPP_ALIGNMENT_UWORD 65535 Compu_IDENTITY 0 65535 PHYS_UNIT "DTC" /end CHARACTERISTIC
/begin CHARACTERISTIC FCdtc_interrupt "FCtl_DTC(104)" VALUE 0x001E393A /* @ECU_Address@FCtl_DTC@0x021B50D0@ */ ECIPP_ALIGNMENT_UWORD 65535 Compu_IDENTITY 0 65535 PHYS_UNIT "DTC" /end CHARACTERISTIC
/begin CHARACTERISTIC FCdtc_IRV_CL_OOA "FCtl_DTC(869)" VALUE 0x001E3F34 /* @ECU_Address@FCtl_DTC@0x021B56CA@ */ ECIPP_ALIGNMENT_UWORD 65535 Compu_IDENTITY 0 65535 PHYS_UNIT "DTC" /end CHARACTERISTIC
/begin CHARACTERISTIC FCdtc_J1939_AAT_err_loss "FCtl_DTC(835)" VALUE 0x001E3EF0 /* @ECU_Address@FCtl_DTC@0x021B5686@ */ ECIPP_ALIGNMENT_UWORD 65535 Compu_IDENTITY 0 65535 PHYS_UNIT "DTC" /end CHARACTERISTIC
/begin CHARACTERISTIC FCdtc_J1939_addr2Fail "FCtl_DTC(301)" VALUE 0x001E3AC4 /* @ECU_Address@FCtl_DTC@0x021B525A@ */ ECIPP_ALIGNMENT_UWORD 65535 Compu_IDENTITY 0 65535 PHYS_UNIT "DTC" /end CHARACTERISTIC
/begin CHARACTERISTIC FCdtc_J1939_addr3Fail "FCtl_DTC(302)" VALUE 0x001E3AC6 /* @ECU_Address@FCtl_DTC@0x021B525C@ */ ECIPP_ALIGNMENT_UWORD 65535 Compu_IDENTITY 0 65535 PHYS_UNIT "DTC" /end CHARACTERISTIC
/begin CHARACTERISTIC FCdtc_J1939_addrFail "FCtl_DTC(188)" VALUE 0x001E39E2 /* @ECU_Address@FCtl_DTC@0x021B5178@ */ ECIPP_ALIGNMENT_UWORD 65535 Compu_IDENTITY 0 65535 PHYS_UNIT "DTC" /end CHARACTERISTIC
/begin CHARACTERISTIC FCdtc_J1939_ETC_loss "FCtl_DTC(219)" VALUE 0x001E3A20 /* @ECU_Address@FCtl_DTC@0x021B51B6@ */ ECIPP_ALIGNMENT_UWORD 65535 Compu_IDENTITY 0 65535 PHYS_UNIT "DTC" /end CHARACTERISTIC
/begin CHARACTERISTIC FCdtc_J1939_ETC_loss2 "FCtl_DTC(275)" VALUE 0x001E3A90 /* @ECU_Address@FCtl_DTC@0x021B5226@ */ ECIPP_ALIGNMENT_UWORD 65535 Compu_IDENTITY 0 65535 PHYS_UNIT "DTC" /end CHARACTERISTIC
/begin CHARACTERISTIC FCdtc_J1939_PGN_tout "FCtl_DTC(714)" VALUE 0x001E3DFE /* @ECU_Address@FCtl_DTC@0x021B5594@ */ ECIPP_ALIGNMENT_UWORD 65535 Compu_IDENTITY 0 65535 PHYS_UNIT "DTC" /end CHARACTERISTIC
/begin CHARACTERISTIC FCdtc_J1939_PGN_tout10 "FCtl_DTC(723)" VALUE 0x001E3E10 /* @ECU_Address@FCtl_DTC@0x021B55A6@ */ ECIPP_ALIGNMENT_UWORD 65535 Compu_IDENTITY 0 65535 PHYS_UNIT "DTC" /end CHARACTERISTIC
/begin CHARACTERISTIC FCdtc_J1939_PGN_tout2 "FCtl_DTC(715)" VALUE 0x001E3E00 /* @ECU_Address@FCtl_DTC@0x021B5596@ */ ECIPP_ALIGNMENT_UWORD 65535 Compu_IDENTITY 0 65535 PHYS_UNIT "DTC" /end CHARACTERISTIC
/begin CHARACTERISTIC FCdtc_J1939_PGN_tout3 "FCtl_DTC(716)" VALUE 0x001E3E02 /* @ECU_Address@FCtl_DTC@0x021B5598@ */ ECIPP_ALIGNMENT_UWORD 65535 Compu_IDENTITY 0 65535 PHYS_UNIT "DTC" /end CHARACTERISTIC
/begin CHARACTERISTIC FCdtc_J1939_PGN_tout4 "FCtl_DTC(717)" VALUE 0x001E3E04 /* @ECU_Address@FCtl_DTC@0x021B559A@ */ ECIPP_ALIGNMENT_UWORD 65535 Compu_IDENTITY 0 65535 PHYS_UNIT "DTC" /end CHARACTERISTIC
/begin CHARACTERISTIC FCdtc_J1939_PGN_tout5 "FCtl_DTC(718)" VALUE 0x001E3E06 /* @ECU_Address@FCtl_DTC@0x021B559C@ */ ECIPP_ALIGNMENT_UWORD 65535 Compu_IDENTITY 0 65535 PHYS_UNIT "DTC" /end CHARACTERISTIC
/begin CHARACTERISTIC FCdtc_J1939_PGN_tout6 "FCtl_DTC(719)" VALUE 0x001E3E08 /* @ECU_Address@FCtl_DTC@0x021B559E@ */ ECIPP_ALIGNMENT_UWORD 65535 Compu_IDENTITY 0 65535 PHYS_UNIT "DTC" /end CHARACTERISTIC
/begin CHARACTERISTIC FCdtc_J1939_PGN_tout7 "FCtl_DTC(720)" VALUE 0x001E3E0A /* @ECU_Address@FCtl_DTC@0x021B55A0@ */ ECIPP_ALIGNMENT_UWORD 65535 Compu_IDENTITY 0 65535 PHYS_UNIT "DTC" /end CHARACTERISTIC
/begin CHARACTERISTIC FCdtc_J1939_PGN_tout8 "FCtl_DTC(721)" VALUE 0x001E3E0C /* @ECU_Address@FCtl_DTC@0x021B55A2@ */ ECIPP_ALIGNMENT_UWORD 65535 Compu_IDENTITY 0 65535 PHYS_UNIT "DTC" /end CHARACTERISTIC
/begin CHARACTERISTIC FCdtc_J1939_PGN_tout9 "FCtl_DTC(722)" VALUE 0x001E3E0E /* @ECU_Address@FCtl_DTC@0x021B55A4@ */ ECIPP_ALIGNMENT_UWORD 65535 Compu_IDENTITY 0 65535 PHYS_UNIT "DTC" /end CHARACTERISTIC
/begin CHARACTERISTIC FCdtc_J1939_RS_err_loss "FCtl_DTC(834)" VALUE 0x001E3EEE /* @ECU_Address@FCtl_DTC@0x021B5684@ */ ECIPP_ALIGNMENT_UWORD 65535 Compu_IDENTITY 0 65535 PHYS_UNIT "DTC" /end CHARACTERISTIC
/begin CHARACTERISTIC FCdtc_J1939_RSsetpt_loss "FCtl_DTC(600)" VALUE 0x001E3D1A /* @ECU_Address@FCtl_DTC@0x021B54B0@ */ ECIPP_ALIGNMENT_UWORD 65535 Compu_IDENTITY 0 65535 PHYS_UNIT "DTC" /end CHARACTERISTIC
/begin CHARACTERISTIC FCdtc_J1939_Rx2Fail "FCtl_DTC(299)" VALUE 0x001E3AC0 /* @ECU_Address@FCtl_DTC@0x021B5256@ */ ECIPP_ALIGNMENT_UWORD 65535 Compu_IDENTITY 0 65535 PHYS_UNIT "DTC" /end CHARACTERISTIC
/begin CHARACTERISTIC FCdtc_J1939_Rx3Fail "FCtl_DTC(300)" VALUE 0x001E3AC2 /* @ECU_Address@FCtl_DTC@0x021B5258@ */ ECIPP_ALIGNMENT_UWORD 65535 Compu_IDENTITY 0 65535 PHYS_UNIT "DTC" /end CHARACTERISTIC
/begin CHARACTERISTIC FCdtc_J1939_RxFail "FCtl_DTC(155)" VALUE 0x001E39A0 /* @ECU_Address@FCtl_DTC@0x021B5136@ */ ECIPP_ALIGNMENT_UWORD 65535 Compu_IDENTITY 0 65535 PHYS_UNIT "DTC" /end CHARACTERISTIC
/begin CHARACTERISTIC FCdtc_J1939_SD_rq "FCtl_DTC(153)" VALUE 0x001E399C /* @ECU_Address@FCtl_DTC@0x021B5132@ */ ECIPP_ALIGNMENT_UWORD 65535 Compu_IDENTITY 0 65535 PHYS_UNIT "DTC" /end CHARACTERISTIC
/begin CHARACTERISTIC FCfmi_FPrly_coilshort "FCtl_FMI(169)" VALUE 0x001E59AA /* @ECU_Address@FCtl_FMI@0x021B70A9@ */ ECIPP_ALIGNMENT_UBYTE 255 Compu_IDENTITY 0 255 PHYS_UNIT "FMI" /end CHARACTERISTIC
/begin CHARACTERISTIC FCfmi_FPrly_gndshort "FCtl_FMI(167)" VALUE 0x001E59A8 /* @ECU_Address@FCtl_FMI@0x021B70A7@ */ ECIPP_ALIGNMENT_UBYTE 255 Compu_IDENTITY 0 255 PHYS_UNIT "FMI" /end CHARACTERISTIC
/begin CHARACTERISTIC FCfmi_FSO_post_TPS_phi_hi "FCtl_FMI(860)" VALUE 0x001E5C5D /* @ECU_Address@FCtl_FMI@0x021B735C@ */ ECIPP_ALIGNMENT_UBYTE 255 Compu_IDENTITY 0 255 PHYS_UNIT "FMI" /end CHARACTERISTIC
/begin CHARACTERISTIC FCfmi_FSO_TPS_phi_hi "FCtl_FMI(803)" VALUE 0x001E5C24 /* @ECU_Address@FCtl_FMI@0x021B7323@ */ ECIPP_ALIGNMENT_UBYTE 255 Compu_IDENTITY 0 255 PHYS_UNIT "FMI" /end CHARACTERISTIC
/begin CHARACTERISTIC FCfmi_FT_maxv "FCtl_FMI(146)" VALUE 0x001E5993 /* @ECU_Address@FCtl_FMI@0x021B7092@ */ ECIPP_ALIGNMENT_UBYTE 255 Compu_IDENTITY 0 255 PHYS_UNIT "FMI" /end CHARACTERISTIC
/begin CHARACTERISTIC FCfmi_FT_minv "FCtl_FMI(147)" VALUE 0x001E5994 /* @ECU_Address@FCtl_FMI@0x021B7093@ */ ECIPP_ALIGNMENT_UBYTE 255 Compu_IDENTITY 0 255 PHYS_UNIT "FMI" /end CHARACTERISTIC
/begin CHARACTERISTIC FCfmi_FTgasf_maxv "FCtl_FMI(215)" VALUE 0x001E59D8 /* @ECU_Address@FCtl_FMI@0x021B70D7@ */ ECIPP_ALIGNMENT_UBYTE 255 Compu_IDENTITY 0 255 PHYS_UNIT "FMI" /end CHARACTERISTIC
/begin CHARACTERISTIC FCfmi_FTgasf_minv "FCtl_FMI(216)" VALUE 0x001E59D9 /* @ECU_Address@FCtl_FMI@0x021B70D8@ */ ECIPP_ALIGNMENT_UBYTE 255 Compu_IDENTITY 0 255 PHYS_UNIT "FMI" /end CHARACTERISTIC
/begin CHARACTERISTIC FCfmi_GLOW_unit_fail "FCtl_FMI(503)" VALUE 0x001E5AF8 /* @ECU_Address@FCtl_FMI@0x021B71F7@ */ ECIPP_ALIGNMENT_UBYTE 255 Compu_IDENTITY 0 255 PHYS_UNIT "FMI" /end CHARACTERISTIC
/begin CHARACTERISTIC FCfmi_GLOW1_open "FCtl_FMI(483)" VALUE 0x001E5AE4 /* @ECU_Address@FCtl_FMI@0x021B71E3@ */ ECIPP_ALIGNMENT_UBYTE 255 Compu_IDENTITY 0 255 PHYS_UNIT "FMI" /end CHARACTERISTIC
/begin CHARACTERISTIC FCfmi_GLOW1_short "FCtl_FMI(493)" VALUE 0x001E5AEE /* @ECU_Address@FCtl_FMI@0x021B71ED@ */ ECIPP_ALIGNMENT_UBYTE 255 Compu_IDENTITY 0 255 PHYS_UNIT "FMI" /end CHARACTERISTIC
/begin CHARACTERISTIC FCfmi_gov_ntrlock_fail "FCtl_FMI(92)" VALUE 0x001E595D /* @ECU_Address@FCtl_FMI@0x021B705C@ */ ECIPP_ALIGNMENT_UBYTE 255 Compu_IDENTITY 0 255 PHYS_UNIT "FMI" /end CHARACTERISTIC
/begin CHARACTERISTIC FCfmi_gyro_x_max "FCtl_FMI(708)" VALUE 0x001E5BC5 /* @ECU_Address@FCtl_FMI@0x021B72C4@ */ ECIPP_ALIGNMENT_UBYTE 255 Compu_IDENTITY 0 255 PHYS_UNIT "FMI" /end CHARACTERISTIC
/begin CHARACTERISTIC FCfmi_gyro_x_min "FCtl_FMI(709)" VALUE 0x001E5BC6 /* @ECU_Address@FCtl_FMI@0x021B72C5@ */ ECIPP_ALIGNMENT_UBYTE 255 Compu_IDENTITY 0 255 PHYS_UNIT "FMI" /end CHARACTERISTIC
/begin CHARACTERISTIC FCfmi_gyro_y_max "FCtl_FMI(710)" VALUE 0x001E5BC7 /* @ECU_Address@FCtl_FMI@0x021B72C6@ */ ECIPP_ALIGNMENT_UBYTE 255 Compu_IDENTITY 0 255 PHYS_UNIT "FMI" /end CHARACTERISTIC
/begin CHARACTERISTIC FCfmi_gyro_y_min "FCtl_FMI(711)" VALUE 0x001E5BC8 /* @ECU_Address@FCtl_FMI@0x021B72C7@ */ ECIPP_ALIGNMENT_UBYTE 255 Compu_IDENTITY 0 255 PHYS_UNIT "FMI" /end CHARACTERISTIC
/begin CHARACTERISTIC FCfmi_gyro_z_max "FCtl_FMI(712)" VALUE 0x001E5BC9 /* @ECU_Address@FCtl_FMI@0x021B72C8@ */ ECIPP_ALIGNMENT_UBYTE 255 Compu_IDENTITY 0 255 PHYS_UNIT "FMI" /end CHARACTERISTIC
/begin CHARACTERISTIC FCfmi_gyro_z_min "FCtl_FMI(713)" VALUE 0x001E5BCA /* @ECU_Address@FCtl_FMI@0x021B72C9@ */ ECIPP_ALIGNMENT_UBYTE 255 Compu_IDENTITY 0 255 PHYS_UNIT "FMI" /end CHARACTERISTIC
/begin CHARACTERISTIC FCfmi_HBA_I_max "FCtl_FMI(528)" VALUE 0x001E5B11 /* @ECU_Address@FCtl_FMI@0x021B7210@ */ ECIPP_ALIGNMENT_UBYTE 255 Compu_IDENTITY 0 255 PHYS_UNIT "FMI" /end CHARACTERISTIC
/begin CHARACTERISTIC FCfmi_HBB_I_max "FCtl_FMI(529)" VALUE 0x001E5B12 /* @ECU_Address@FCtl_FMI@0x021B7211@ */ ECIPP_ALIGNMENT_UBYTE 255 Compu_IDENTITY 0 255 PHYS_UNIT "FMI" /end CHARACTERISTIC
/begin CHARACTERISTIC FCfmi_HiDiagTemp "FCtl_FMI(652)" VALUE 0x001E5B8D /* @ECU_Address@FCtl_FMI@0x021B728C@ */ ECIPP_ALIGNMENT_UBYTE 255 Compu_IDENTITY 0 255 PHYS_UNIT "FMI" /end CHARACTERISTIC
/begin CHARACTERISTIC FCfmi_HWID_fail "FCtl_FMI(318)" VALUE 0x001E5A3F /* @ECU_Address@FCtl_FMI@0x021B713E@ */ ECIPP_ALIGNMENT_UBYTE 255 Compu_IDENTITY 0 255 PHYS_UNIT "FMI" /end CHARACTERISTIC
/begin CHARACTERISTIC FCfmi_IAC_gndshort "FCtl_FMI(156)" VALUE 0x001E599D /* @ECU_Address@FCtl_FMI@0x021B709C@ */ ECIPP_ALIGNMENT_UBYTE 255 Compu_IDENTITY 0 255 PHYS_UNIT "FMI" /end CHARACTERISTIC
/begin CHARACTERISTIC FCfmi_IAC_openshort "FCtl_FMI(157)" VALUE 0x001E599E /* @ECU_Address@FCtl_FMI@0x021B709D@ */ ECIPP_ALIGNMENT_UBYTE 255 Compu_IDENTITY 0 255 PHYS_UNIT "FMI" /end CHARACTERISTIC
/begin CHARACTERISTIC FCfmi_IAT_HiExp "FCtl_FMI(87)" VALUE 0x001E5958 /* @ECU_Address@FCtl_FMI@0x021B7057@ */ ECIPP_ALIGNMENT_UBYTE 255 Compu_IDENTITY 0 255 PHYS_UNIT "FMI" /end CHARACTERISTIC
/begin CHARACTERISTIC FCfmi_IAT_HiExp2 "FCtl_FMI(88)" VALUE 0x001E5959 /* @ECU_Address@FCtl_FMI@0x021B7058@ */ ECIPP_ALIGNMENT_UBYTE 255 Compu_IDENTITY 0 255 PHYS_UNIT "FMI" /end CHARACTERISTIC
/begin CHARACTERISTIC FCfmi_IAT_maxv "FCtl_FMI(5)" VALUE 0x001E5906 /* @ECU_Address@FCtl_FMI@0x021B7005@ */ ECIPP_ALIGNMENT_UBYTE 255 Compu_IDENTITY 0 255 PHYS_UNIT "FMI" /end CHARACTERISTIC
/begin CHARACTERISTIC FCfmi_IAT_minv "FCtl_FMI(6)" VALUE 0x001E5907 /* @ECU_Address@FCtl_FMI@0x021B7006@ */ ECIPP_ALIGNMENT_UBYTE 255 Compu_IDENTITY 0 255 PHYS_UNIT "FMI" /end CHARACTERISTIC
/begin CHARACTERISTIC FCfmi_IBF_detected "FCtl_FMI(861)" VALUE 0x001E5C5E /* @ECU_Address@FCtl_FMI@0x021B735D@ */ ECIPP_ALIGNMENT_UBYTE 255 Compu_IDENTITY 0 255 PHYS_UNIT "FMI" /end CHARACTERISTIC
/begin CHARACTERISTIC FCfmi_ICam_maxerr "FCtl_FMI(288)" VALUE 0x001E5A21 /* @ECU_Address@FCtl_FMI@0x021B7120@ */ ECIPP_ALIGNMENT_UBYTE 255 Compu_IDENTITY 0 255 PHYS_UNIT "FMI" /end CHARACTERISTIC
/begin CHARACTERISTIC FCfmi_ICAVD1_mis "FCtl_FMI(259)" VALUE 0x001E5A04 /* @ECU_Address@FCtl_FMI@0x021B7103@ */ ECIPP_ALIGNMENT_UBYTE 255 Compu_IDENTITY 0 255 PHYS_UNIT "FMI" /end CHARACTERISTIC
/begin CHARACTERISTIC FCfmi_ICAVD1_miscat "FCtl_FMI(267)" VALUE 0x001E5A0C /* @ECU_Address@FCtl_FMI@0x021B710B@ */ ECIPP_ALIGNMENT_UBYTE 255 Compu_IDENTITY 0 255 PHYS_UNIT "FMI" /end CHARACTERISTIC
/begin CHARACTERISTIC FCfmi_ICCOT_hi "FCtl_FMI(863)" VALUE 0x001E5C60 /* @ECU_Address@FCtl_FMI@0x021B735F@ */ ECIPP_ALIGNMENT_UBYTE 255 Compu_IDENTITY 0 255 PHYS_UNIT "FMI" /end CHARACTERISTIC
/begin CHARACTERISTIC FCfmi_Idle_SD "FCtl_FMI(654)" VALUE 0x001E5B8F /* @ECU_Address@FCtl_FMI@0x021B728E@ */ ECIPP_ALIGNMENT_UBYTE 255 Compu_IDENTITY 0 255 PHYS_UNIT "FMI" /end CHARACTERISTIC
/begin CHARACTERISTIC FCfmi_imu_general "FCtl_FMI(699)" VALUE 0x001E5BBC /* @ECU_Address@FCtl_FMI@0x021B72BB@ */ ECIPP_ALIGNMENT_UBYTE 255 Compu_IDENTITY 0 255 PHYS_UNIT "FMI" /end CHARACTERISTIC
/begin CHARACTERISTIC FCfmi_imu_temp_max "FCtl_FMI(700)" VALUE 0x001E5BBD /* @ECU_Address@FCtl_FMI@0x021B72BC@ */ ECIPP_ALIGNMENT_UBYTE 255 Compu_IDENTITY 0 255 PHYS_UNIT "FMI" /end CHARACTERISTIC
/begin CHARACTERISTIC FCfmi_imu_temp_min "FCtl_FMI(701)" VALUE 0x001E5BBE /* @ECU_Address@FCtl_FMI@0x021B72BD@ */ ECIPP_ALIGNMENT_UBYTE 255 Compu_IDENTITY 0 255 PHYS_UNIT "FMI" /end CHARACTERISTIC
/begin CHARACTERISTIC FCfmi_IMVD_Ifb_hi "FCtl_FMI(583)" VALUE 0x001E5B48 /* @ECU_Address@FCtl_FMI@0x021B7247@ */ ECIPP_ALIGNMENT_UBYTE 255 Compu_IDENTITY 0 255 PHYS_UNIT "FMI" /end CHARACTERISTIC
/begin CHARACTERISTIC FCfmi_IMVD_Ifb_lo "FCtl_FMI(582)" VALUE 0x001E5B47 /* @ECU_Address@FCtl_FMI@0x021B7246@ */ ECIPP_ALIGNMENT_UBYTE 255 Compu_IDENTITY 0 255 PHYS_UNIT "FMI" /end CHARACTERISTIC
/begin CHARACTERISTIC FCfmi_INJD_boost_lo "FCtl_FMI(578)" VALUE 0x001E5B43 /* @ECU_Address@FCtl_FMI@0x021B7242@ */ ECIPP_ALIGNMENT_UBYTE 255 Compu_IDENTITY 0 255 PHYS_UNIT "FMI" /end CHARACTERISTIC
/begin CHARACTERISTIC FCfmi_INJD_HS_Ihi "FCtl_FMI(562)" VALUE 0x001E5B33 /* @ECU_Address@FCtl_FMI@0x021B7232@ */ ECIPP_ALIGNMENT_UBYTE 255 Compu_IDENTITY 0 255 PHYS_UNIT "FMI" /end CHARACTERISTIC
/begin CHARACTERISTIC FCfmi_INJD_HW_int "FCtl_FMI(580)" VALUE 0x001E5B45 /* @ECU_Address@FCtl_FMI@0x021B7244@ */ ECIPP_ALIGNMENT_UBYTE 255 Compu_IDENTITY 0 255 PHYS_UNIT "FMI" /end CHARACTERISTIC
/begin CHARACTERISTIC FCfmi_INJD_LS_Ihi "FCtl_FMI(570)" VALUE 0x001E5B3B /* @ECU_Address@FCtl_FMI@0x021B723A@ */ ECIPP_ALIGNMENT_UBYTE 255 Compu_IDENTITY 0 255 PHYS_UNIT "FMI" /end CHARACTERISTIC
/begin CHARACTERISTIC FCfmi_INJD_off_lo "FCtl_FMI(46)" VALUE 0x001E592F /* @ECU_Address@FCtl_FMI@0x021B702E@ */ ECIPP_ALIGNMENT_UBYTE 255 Compu_IDENTITY 0 255 PHYS_UNIT "FMI" /end CHARACTERISTIC
/begin CHARACTERISTIC FCfmi_INJD_on_hi "FCtl_FMI(56)" VALUE 0x001E5939 /* @ECU_Address@FCtl_FMI@0x021B7038@ */ ECIPP_ALIGNMENT_UBYTE 255 Compu_IDENTITY 0 255 PHYS_UNIT "FMI" /end CHARACTERISTIC
/begin CHARACTERISTIC FCfmi_intby_poserr "FCtl_FMI(864)" VALUE 0x001E5C61 /* @ECU_Address@FCtl_FMI@0x021B7360@ */ ECIPP_ALIGNMENT_UBYTE 255 Compu_IDENTITY 0 255 PHYS_UNIT "FMI" /end CHARACTERISTIC
/begin CHARACTERISTIC FCfmi_interrupt "FCtl_FMI(104)" VALUE 0x001E5969 /* @ECU_Address@FCtl_FMI@0x021B7068@ */ ECIPP_ALIGNMENT_UBYTE 255 Compu_IDENTITY 0 255 PHYS_UNIT "FMI" /end CHARACTERISTIC
/begin CHARACTERISTIC FCfmi_IRV_CL_OOA "FCtl_FMI(869)" VALUE 0x001E5C66 /* @ECU_Address@FCtl_FMI@0x021B7365@ */ ECIPP_ALIGNMENT_UBYTE 255 Compu_IDENTITY 0 255 PHYS_UNIT "FMI" /end CHARACTERISTIC
/begin CHARACTERISTIC FCfmi_J1939_AAT_err_loss "FCtl_FMI(835)" VALUE 0x001E5C44 /* @ECU_Address@FCtl_FMI@0x021B7343@ */ ECIPP_ALIGNMENT_UBYTE 255 Compu_IDENTITY 0 255 PHYS_UNIT "FMI" /end CHARACTERISTIC
/begin CHARACTERISTIC FCfmi_J1939_addr2Fail "FCtl_FMI(301)" VALUE 0x001E5A2E /* @ECU_Address@FCtl_FMI@0x021B712D@ */ ECIPP_ALIGNMENT_UBYTE 255 Compu_IDENTITY 0 255 PHYS_UNIT "FMI" /end CHARACTERISTIC
/begin CHARACTERISTIC FCfmi_J1939_addr3Fail "FCtl_FMI(302)" VALUE 0x001E5A2F /* @ECU_Address@FCtl_FMI@0x021B712E@ */ ECIPP_ALIGNMENT_UBYTE 255 Compu_IDENTITY 0 255 PHYS_UNIT "FMI" /end CHARACTERISTIC
/begin CHARACTERISTIC FCfmi_J1939_addrFail "FCtl_FMI(188)" VALUE 0x001E59BD /* @ECU_Address@FCtl_FMI@0x021B70BC@ */ ECIPP_ALIGNMENT_UBYTE 255 Compu_IDENTITY 0 255 PHYS_UNIT "FMI" /end CHARACTERISTIC
/begin CHARACTERISTIC FCfmi_J1939_ETC_loss "FCtl_FMI(219)" VALUE 0x001E59DC /* @ECU_Address@FCtl_FMI@0x021B70DB@ */ ECIPP_ALIGNMENT_UBYTE 255 Compu_IDENTITY 0 255 PHYS_UNIT "FMI" /end CHARACTERISTIC
/begin CHARACTERISTIC FCfmi_J1939_ETC_loss2 "FCtl_FMI(275)" VALUE 0x001E5A14 /* @ECU_Address@FCtl_FMI@0x021B7113@ */ ECIPP_ALIGNMENT_UBYTE 255 Compu_IDENTITY 0 255 PHYS_UNIT "FMI" /end CHARACTERISTIC
/begin CHARACTERISTIC FCfmi_J1939_PGN_tout "FCtl_FMI(714)" VALUE 0x001E5BCB /* @ECU_Address@FCtl_FMI@0x021B72CA@ */ ECIPP_ALIGNMENT_UBYTE 255 Compu_IDENTITY 0 255 PHYS_UNIT "FMI" /end CHARACTERISTIC
/begin CHARACTERISTIC FCfmi_J1939_PGN_tout10 "FCtl_FMI(723)" VALUE 0x001E5BD4 /* @ECU_Address@FCtl_FMI@0x021B72D3@ */ ECIPP_ALIGNMENT_UBYTE 255 Compu_IDENTITY 0 255 PHYS_UNIT "FMI" /end CHARACTERISTIC
/begin CHARACTERISTIC FCfmi_J1939_PGN_tout2 "FCtl_FMI(715)" VALUE 0x001E5BCC /* @ECU_Address@FCtl_FMI@0x021B72CB@ */ ECIPP_ALIGNMENT_UBYTE 255 Compu_IDENTITY 0 255 PHYS_UNIT "FMI" /end CHARACTERISTIC
/begin CHARACTERISTIC FCfmi_J1939_PGN_tout3 "FCtl_FMI(716)" VALUE 0x001E5BCD /* @ECU_Address@FCtl_FMI@0x021B72CC@ */ ECIPP_ALIGNMENT_UBYTE 255 Compu_IDENTITY 0 255 PHYS_UNIT "FMI" /end CHARACTERISTIC
/begin CHARACTERISTIC FCfmi_J1939_PGN_tout4 "FCtl_FMI(717)" VALUE 0x001E5BCE /* @ECU_Address@FCtl_FMI@0x021B72CD@ */ ECIPP_ALIGNMENT_UBYTE 255 Compu_IDENTITY 0 255 PHYS_UNIT "FMI" /end CHARACTERISTIC
/begin CHARACTERISTIC FCfmi_J1939_PGN_tout5 "FCtl_FMI(718)" VALUE 0x001E5BCF /* @ECU_Address@FCtl_FMI@0x021B72CE@ */ ECIPP_ALIGNMENT_UBYTE 255 Compu_IDENTITY 0 255 PHYS_UNIT "FMI" /end CHARACTERISTIC
/begin CHARACTERISTIC FCfmi_J1939_PGN_tout6 "FCtl_FMI(719)" VALUE 0x001E5BD0 /* @ECU_Address@FCtl_FMI@0x021B72CF@ */ ECIPP_ALIGNMENT_UBYTE 255 Compu_IDENTITY 0 255 PHYS_UNIT "FMI" /end CHARACTERISTIC
/begin CHARACTERISTIC FCfmi_J1939_PGN_tout7 "FCtl_FMI(720)" VALUE 0x001E5BD1 /* @ECU_Address@FCtl_FMI@0x021B72D0@ */ ECIPP_ALIGNMENT_UBYTE 255 Compu_IDENTITY 0 255 PHYS_UNIT "FMI" /end CHARACTERISTIC
/begin CHARACTERISTIC FCfmi_J1939_PGN_tout8 "FCtl_FMI(721)" VALUE 0x001E5BD2 /* @ECU_Address@FCtl_FMI@0x021B72D1@ */ ECIPP_ALIGNMENT_UBYTE 255 Compu_IDENTITY 0 255 PHYS_UNIT "FMI" /end CHARACTERISTIC
/begin CHARACTERISTIC FCfmi_J1939_PGN_tout9 "FCtl_FMI(722)" VALUE 0x001E5BD3 /* @ECU_Address@FCtl_FMI@0x021B72D2@ */ ECIPP_ALIGNMENT_UBYTE 255 Compu_IDENTITY 0 255 PHYS_UNIT "FMI" /end CHARACTERISTIC
/begin CHARACTERISTIC FCfmi_J1939_RS_err_loss "FCtl_FMI(834)" VALUE 0x001E5C43 /* @ECU_Address@FCtl_FMI@0x021B7342@ */ ECIPP_ALIGNMENT_UBYTE 255 Compu_IDENTITY 0 255 PHYS_UNIT "FMI" /end CHARACTERISTIC
/begin CHARACTERISTIC FCfmi_J1939_RSsetpt_loss "FCtl_FMI(600)" VALUE 0x001E5B59 /* @ECU_Address@FCtl_FMI@0x021B7258@ */ ECIPP_ALIGNMENT_UBYTE 255 Compu_IDENTITY 0 255 PHYS_UNIT "FMI" /end CHARACTERISTIC
/begin CHARACTERISTIC FCfmi_J1939_Rx2Fail "FCtl_FMI(299)" VALUE 0x001E5A2C /* @ECU_Address@FCtl_FMI@0x021B712B@ */ ECIPP_ALIGNMENT_UBYTE 255 Compu_IDENTITY 0 255 PHYS_UNIT "FMI" /end CHARACTERISTIC
/begin CHARACTERISTIC FCfmi_J1939_Rx3Fail "FCtl_FMI(300)" VALUE 0x001E5A2D /* @ECU_Address@FCtl_FMI@0x021B712C@ */ ECIPP_ALIGNMENT_UBYTE 255 Compu_IDENTITY 0 255 PHYS_UNIT "FMI" /end CHARACTERISTIC
/begin CHARACTERISTIC FCfmi_J1939_RxFail "FCtl_FMI(155)" VALUE 0x001E599C /* @ECU_Address@FCtl_FMI@0x021B709B@ */ ECIPP_ALIGNMENT_UBYTE 255 Compu_IDENTITY 0 255 PHYS_UNIT "FMI" /end CHARACTERISTIC
/begin CHARACTERISTIC FCfmi_J1939_SD_rq "FCtl_FMI(153)" VALUE 0x001E599A /* @ECU_Address@FCtl_FMI@0x021B7099@ */ ECIPP_ALIGNMENT_UBYTE 255 Compu_IDENTITY 0 255 PHYS_UNIT "FMI" /end CHARACTERISTIC
/begin CHARACTERISTIC FCftb_FPrly_coilshort "FCtl_FTB_0x04(169)" VALUE 0x001E5DC0 /* @ECU_Address@FCtl_FTB_0x04@0x024C50A9@ */ ECIPP_ALIGNMENT_UBYTE 255 Compu_IDENTITY 0 255 PHYS_UNIT "FTB" /end CHARACTERISTIC
/begin CHARACTERISTIC FCftb_FPrly_gndshort "FCtl_FTB_0x04(167)" VALUE 0x001E5DBE /* @ECU_Address@FCtl_FTB_0x04@0x024C50A7@ */ ECIPP_ALIGNMENT_UBYTE 255 Compu_IDENTITY 0 255 PHYS_UNIT "FTB" /end CHARACTERISTIC
/begin CHARACTERISTIC FCftb_FSO_post_TPS_phi_hi "FCtl_FTB_0x04(860)" VALUE 0x001E6073 /* @ECU_Address@FCtl_FTB_0x04@0x024C535C@ */ ECIPP_ALIGNMENT_UBYTE 255 Compu_IDENTITY 0 255 PHYS_UNIT "FTB" /end CHARACTERISTIC
/begin CHARACTERISTIC FCftb_FSO_TPS_phi_hi "FCtl_FTB_0x04(803)" VALUE 0x001E603A /* @ECU_Address@FCtl_FTB_0x04@0x024C5323@ */ ECIPP_ALIGNMENT_UBYTE 255 Compu_IDENTITY 0 255 PHYS_UNIT "FTB" /end CHARACTERISTIC
/begin CHARACTERISTIC FCftb_FT_maxv "FCtl_FTB_0x04(146)" VALUE 0x001E5DA9 /* @ECU_Address@FCtl_FTB_0x04@0x024C5092@ */ ECIPP_ALIGNMENT_UBYTE 255 Compu_IDENTITY 0 255 PHYS_UNIT "FTB" /end CHARACTERISTIC
/begin CHARACTERISTIC FCftb_FT_minv "FCtl_FTB_0x04(147)" VALUE 0x001E5DAA /* @ECU_Address@FCtl_FTB_0x04@0x024C5093@ */ ECIPP_ALIGNMENT_UBYTE 255 Compu_IDENTITY 0 255 PHYS_UNIT "FTB" /end CHARACTERISTIC
/begin CHARACTERISTIC FCftb_FTgasf_maxv "FCtl_FTB_0x04(215)" VALUE 0x001E5DEE /* @ECU_Address@FCtl_FTB_0x04@0x024C50D7@ */ ECIPP_ALIGNMENT_UBYTE 255 Compu_IDENTITY 0 255 PHYS_UNIT "FTB" /end CHARACTERISTIC
/begin CHARACTERISTIC FCftb_FTgasf_minv "FCtl_FTB_0x04(216)" VALUE 0x001E5DEF /* @ECU_Address@FCtl_FTB_0x04@0x024C50D8@ */ ECIPP_ALIGNMENT_UBYTE 255 Compu_IDENTITY 0 255 PHYS_UNIT "FTB" /end CHARACTERISTIC
/begin CHARACTERISTIC FCftb_GLOW_unit_fail "FCtl_FTB_0x04(503)" VALUE 0x001E5F0E /* @ECU_Address@FCtl_FTB_0x04@0x024C51F7@ */ ECIPP_ALIGNMENT_UBYTE 255 Compu_IDENTITY 0 255 PHYS_UNIT "FTB" /end CHARACTERISTIC
/begin CHARACTERISTIC FCftb_GLOW1_open "FCtl_FTB_0x04(483)" VALUE 0x001E5EFA /* @ECU_Address@FCtl_FTB_0x04@0x024C51E3@ */ ECIPP_ALIGNMENT_UBYTE 255 Compu_IDENTITY 0 255 PHYS_UNIT "FTB" /end CHARACTERISTIC
/begin CHARACTERISTIC FCftb_GLOW1_short "FCtl_FTB_0x04(493)" VALUE 0x001E5F04 /* @ECU_Address@FCtl_FTB_0x04@0x024C51ED@ */ ECIPP_ALIGNMENT_UBYTE 255 Compu_IDENTITY 0 255 PHYS_UNIT "FTB" /end CHARACTERISTIC
/begin CHARACTERISTIC FCftb_gov_ntrlock_fail "FCtl_FTB_0x04(92)" VALUE 0x001E5D73 /* @ECU_Address@FCtl_FTB_0x04@0x024C505C@ */ ECIPP_ALIGNMENT_UBYTE 255 Compu_IDENTITY 0 255 PHYS_UNIT "FTB" /end CHARACTERISTIC
/begin CHARACTERISTIC FCftb_gyro_x_max "FCtl_FTB_0x04(708)" VALUE 0x001E5FDB /* @ECU_Address@FCtl_FTB_0x04@0x024C52C4@ */ ECIPP_ALIGNMENT_UBYTE 255 Compu_IDENTITY 0 255 PHYS_UNIT "FTB" /end CHARACTERISTIC
/begin CHARACTERISTIC FCftb_gyro_x_min "FCtl_FTB_0x04(709)" VALUE 0x001E5FDC /* @ECU_Address@FCtl_FTB_0x04@0x024C52C5@ */ ECIPP_ALIGNMENT_UBYTE 255 Compu_IDENTITY 0 255 PHYS_UNIT "FTB" /end CHARACTERISTIC
/begin CHARACTERISTIC FCftb_gyro_y_max "FCtl_FTB_0x04(710)" VALUE 0x001E5FDD /* @ECU_Address@FCtl_FTB_0x04@0x024C52C6@ */ ECIPP_ALIGNMENT_UBYTE 255 Compu_IDENTITY 0 255 PHYS_UNIT "FTB" /end CHARACTERISTIC
/begin CHARACTERISTIC FCftb_gyro_y_min "FCtl_FTB_0x04(711)" VALUE 0x001E5FDE /* @ECU_Address@FCtl_FTB_0x04@0x024C52C7@ */ ECIPP_ALIGNMENT_UBYTE 255 Compu_IDENTITY 0 255 PHYS_UNIT "FTB" /end CHARACTERISTIC
/begin CHARACTERISTIC FCftb_gyro_z_max "FCtl_FTB_0x04(712)" VALUE 0x001E5FDF /* @ECU_Address@FCtl_FTB_0x04@0x024C52C8@ */ ECIPP_ALIGNMENT_UBYTE 255 Compu_IDENTITY 0 255 PHYS_UNIT "FTB" /end CHARACTERISTIC
/begin CHARACTERISTIC FCftb_gyro_z_min "FCtl_FTB_0x04(713)" VALUE 0x001E5FE0 /* @ECU_Address@FCtl_FTB_0x04@0x024C52C9@ */ ECIPP_ALIGNMENT_UBYTE 255 Compu_IDENTITY 0 255 PHYS_UNIT "FTB" /end CHARACTERISTIC
/begin CHARACTERISTIC FCftb_HBA_I_max "FCtl_FTB_0x04(528)" VALUE 0x001E5F27 /* @ECU_Address@FCtl_FTB_0x04@0x024C5210@ */ ECIPP_ALIGNMENT_UBYTE 255 Compu_IDENTITY 0 255 PHYS_UNIT "FTB" /end CHARACTERISTIC
/begin CHARACTERISTIC FCftb_HBB_I_max "FCtl_FTB_0x04(529)" VALUE 0x001E5F28 /* @ECU_Address@FCtl_FTB_0x04@0x024C5211@ */ ECIPP_ALIGNMENT_UBYTE 255 Compu_IDENTITY 0 255 PHYS_UNIT "FTB" /end CHARACTERISTIC
/begin CHARACTERISTIC FCftb_HiDiagTemp "FCtl_FTB_0x04(652)" VALUE 0x001E5FA3 /* @ECU_Address@FCtl_FTB_0x04@0x024C528C@ */ ECIPP_ALIGNMENT_UBYTE 255 Compu_IDENTITY 0 255 PHYS_UNIT "FTB" /end CHARACTERISTIC
/begin CHARACTERISTIC FCftb_HWID_fail "FCtl_FTB_0x04(318)" VALUE 0x001E5E55 /* @ECU_Address@FCtl_FTB_0x04@0x024C513E@ */ ECIPP_ALIGNMENT_UBYTE 255 Compu_IDENTITY 0 255 PHYS_UNIT "FTB" /end CHARACTERISTIC
/begin CHARACTERISTIC FCftb_IAC_gndshort "FCtl_FTB_0x04(156)" VALUE 0x001E5DB3 /* @ECU_Address@FCtl_FTB_0x04@0x024C509C@ */ ECIPP_ALIGNMENT_UBYTE 255 Compu_IDENTITY 0 255 PHYS_UNIT "FTB" /end CHARACTERISTIC
/begin CHARACTERISTIC FCftb_IAC_openshort "FCtl_FTB_0x04(157)" VALUE 0x001E5DB4 /* @ECU_Address@FCtl_FTB_0x04@0x024C509D@ */ ECIPP_ALIGNMENT_UBYTE 255 Compu_IDENTITY 0 255 PHYS_UNIT "FTB" /end CHARACTERISTIC
/begin CHARACTERISTIC FCftb_IAT_HiExp "FCtl_FTB_0x04(87)" VALUE 0x001E5D6E /* @ECU_Address@FCtl_FTB_0x04@0x024C5057@ */ ECIPP_ALIGNMENT_UBYTE 255 Compu_IDENTITY 0 255 PHYS_UNIT "FTB" /end CHARACTERISTIC
/begin CHARACTERISTIC FCftb_IAT_HiExp2 "FCtl_FTB_0x04(88)" VALUE 0x001E5D6F /* @ECU_Address@FCtl_FTB_0x04@0x024C5058@ */ ECIPP_ALIGNMENT_UBYTE 255 Compu_IDENTITY 0 255 PHYS_UNIT "FTB" /end CHARACTERISTIC
/begin CHARACTERISTIC FCftb_IAT_maxv "FCtl_FTB_0x04(5)" VALUE 0x001E5D1C /* @ECU_Address@FCtl_FTB_0x04@0x024C5005@ */ ECIPP_ALIGNMENT_UBYTE 255 Compu_IDENTITY 0 255 PHYS_UNIT "FTB" /end CHARACTERISTIC
/begin CHARACTERISTIC FCftb_IAT_minv "FCtl_FTB_0x04(6)" VALUE 0x001E5D1D /* @ECU_Address@FCtl_FTB_0x04@0x024C5006@ */ ECIPP_ALIGNMENT_UBYTE 255 Compu_IDENTITY 0 255 PHYS_UNIT "FTB" /end CHARACTERISTIC
/begin CHARACTERISTIC FCftb_IBF_detected "FCtl_FTB_0x04(861)" VALUE 0x001E6074 /* @ECU_Address@FCtl_FTB_0x04@0x024C535D@ */ ECIPP_ALIGNMENT_UBYTE 255 Compu_IDENTITY 0 255 PHYS_UNIT "FTB" /end CHARACTERISTIC
/begin CHARACTERISTIC FCftb_ICam_maxerr "FCtl_FTB_0x04(288)" VALUE 0x001E5E37 /* @ECU_Address@FCtl_FTB_0x04@0x024C5120@ */ ECIPP_ALIGNMENT_UBYTE 255 Compu_IDENTITY 0 255 PHYS_UNIT "FTB" /end CHARACTERISTIC
/begin CHARACTERISTIC FCftb_ICAVD1_mis "FCtl_FTB_0x04(259)" VALUE 0x001E5E1A /* @ECU_Address@FCtl_FTB_0x04@0x024C5103@ */ ECIPP_ALIGNMENT_UBYTE 255 Compu_IDENTITY 0 255 PHYS_UNIT "FTB" /end CHARACTERISTIC
/begin CHARACTERISTIC FCftb_ICAVD1_miscat "FCtl_FTB_0x04(267)" VALUE 0x001E5E22 /* @ECU_Address@FCtl_FTB_0x04@0x024C510B@ */ ECIPP_ALIGNMENT_UBYTE 255 Compu_IDENTITY 0 255 PHYS_UNIT "FTB" /end CHARACTERISTIC
/begin CHARACTERISTIC FCftb_ICCOT_hi "FCtl_FTB_0x04(863)" VALUE 0x001E6076 /* @ECU_Address@FCtl_FTB_0x04@0x024C535F@ */ ECIPP_ALIGNMENT_UBYTE 255 Compu_IDENTITY 0 255 PHYS_UNIT "FTB" /end CHARACTERISTIC
/begin CHARACTERISTIC FCftb_Idle_SD "FCtl_FTB_0x04(654)" VALUE 0x001E5FA5 /* @ECU_Address@FCtl_FTB_0x04@0x024C528E@ */ ECIPP_ALIGNMENT_UBYTE 255 Compu_IDENTITY 0 255 PHYS_UNIT "FTB" /end CHARACTERISTIC
/begin CHARACTERISTIC FCftb_imu_general "FCtl_FTB_0x04(699)" VALUE 0x001E5FD2 /* @ECU_Address@FCtl_FTB_0x04@0x024C52BB@ */ ECIPP_ALIGNMENT_UBYTE 255 Compu_IDENTITY 0 255 PHYS_UNIT "FTB" /end CHARACTERISTIC
/begin CHARACTERISTIC FCftb_imu_temp_max "FCtl_FTB_0x04(700)" VALUE 0x001E5FD3 /* @ECU_Address@FCtl_FTB_0x04@0x024C52BC@ */ ECIPP_ALIGNMENT_UBYTE 255 Compu_IDENTITY 0 255 PHYS_UNIT "FTB" /end CHARACTERISTIC
/begin CHARACTERISTIC FCftb_imu_temp_min "FCtl_FTB_0x04(701)" VALUE 0x001E5FD4 /* @ECU_Address@FCtl_FTB_0x04@0x024C52BD@ */ ECIPP_ALIGNMENT_UBYTE 255 Compu_IDENTITY 0 255 PHYS_UNIT "FTB" /end CHARACTERISTIC
/begin CHARACTERISTIC FCftb_IMVD_Ifb_hi "FCtl_FTB_0x04(583)" VALUE 0x001E5F5E /* @ECU_Address@FCtl_FTB_0x04@0x024C5247@ */ ECIPP_ALIGNMENT_UBYTE 255 Compu_IDENTITY 0 255 PHYS_UNIT "FTB" /end CHARACTERISTIC
/begin CHARACTERISTIC FCftb_IMVD_Ifb_lo "FCtl_FTB_0x04(582)" VALUE 0x001E5F5D /* @ECU_Address@FCtl_FTB_0x04@0x024C5246@ */ ECIPP_ALIGNMENT_UBYTE 255 Compu_IDENTITY 0 255 PHYS_UNIT "FTB" /end CHARACTERISTIC
/begin CHARACTERISTIC FCftb_INJD_boost_lo "FCtl_FTB_0x04(578)" VALUE 0x001E5F59 /* @ECU_Address@FCtl_FTB_0x04@0x024C5242@ */ ECIPP_ALIGNMENT_UBYTE 255 Compu_IDENTITY 0 255 PHYS_UNIT "FTB" /end CHARACTERISTIC
/begin CHARACTERISTIC FCftb_INJD_HS_Ihi "FCtl_FTB_0x04(562)" VALUE 0x001E5F49 /* @ECU_Address@FCtl_FTB_0x04@0x024C5232@ */ ECIPP_ALIGNMENT_UBYTE 255 Compu_IDENTITY 0 255 PHYS_UNIT "FTB" /end CHARACTERISTIC
/begin CHARACTERISTIC FCftb_INJD_HW_int "FCtl_FTB_0x04(580)" VALUE 0x001E5F5B /* @ECU_Address@FCtl_FTB_0x04@0x024C5244@ */ ECIPP_ALIGNMENT_UBYTE 255 Compu_IDENTITY 0 255 PHYS_UNIT "FTB" /end CHARACTERISTIC
/begin CHARACTERISTIC FCftb_INJD_LS_Ihi "FCtl_FTB_0x04(570)" VALUE 0x001E5F51 /* @ECU_Address@FCtl_FTB_0x04@0x024C523A@ */ ECIPP_ALIGNMENT_UBYTE 255 Compu_IDENTITY 0 255 PHYS_UNIT "FTB" /end CHARACTERISTIC
/begin CHARACTERISTIC FCftb_INJD_off_lo "FCtl_FTB_0x04(46)" VALUE 0x001E5D45 /* @ECU_Address@FCtl_FTB_0x04@0x024C502E@ */ ECIPP_ALIGNMENT_UBYTE 255 Compu_IDENTITY 0 255 PHYS_UNIT "FTB" /end CHARACTERISTIC
/begin CHARACTERISTIC FCftb_INJD_on_hi "FCtl_FTB_0x04(56)" VALUE 0x001E5D4F /* @ECU_Address@FCtl_FTB_0x04@0x024C5038@ */ ECIPP_ALIGNMENT_UBYTE 255 Compu_IDENTITY 0 255 PHYS_UNIT "FTB" /end CHARACTERISTIC
/begin CHARACTERISTIC FCftb_intby_poserr "FCtl_FTB_0x04(864)" VALUE 0x001E6077 /* @ECU_Address@FCtl_FTB_0x04@0x024C5360@ */ ECIPP_ALIGNMENT_UBYTE 255 Compu_IDENTITY 0 255 PHYS_UNIT "FTB" /end CHARACTERISTIC
/begin CHARACTERISTIC FCftb_interrupt "FCtl_FTB_0x04(104)" VALUE 0x001E5D7F /* @ECU_Address@FCtl_FTB_0x04@0x024C5068@ */ ECIPP_ALIGNMENT_UBYTE 255 Compu_IDENTITY 0 255 PHYS_UNIT "FTB" /end CHARACTERISTIC
/begin CHARACTERISTIC FCftb_IRV_CL_OOA "FCtl_FTB_0x04(869)" VALUE 0x001E607C /* @ECU_Address@FCtl_FTB_0x04@0x024C5365@ */ ECIPP_ALIGNMENT_UBYTE 255 Compu_IDENTITY 0 255 PHYS_UNIT "FTB" /end CHARACTERISTIC
/begin CHARACTERISTIC FCftb_J1939_AAT_err_loss "FCtl_FTB_0x04(835)" VALUE 0x001E605A /* @ECU_Address@FCtl_FTB_0x04@0x024C5343@ */ ECIPP_ALIGNMENT_UBYTE 255 Compu_IDENTITY 0 255 PHYS_UNIT "FTB" /end CHARACTERISTIC
/begin CHARACTERISTIC FCftb_J1939_addr2Fail "FCtl_FTB_0x04(301)" VALUE 0x001E5E44 /* @ECU_Address@FCtl_FTB_0x04@0x024C512D@ */ ECIPP_ALIGNMENT_UBYTE 255 Compu_IDENTITY 0 255 PHYS_UNIT "FTB" /end CHARACTERISTIC
/begin CHARACTERISTIC FCftb_J1939_addr3Fail "FCtl_FTB_0x04(302)" VALUE 0x001E5E45 /* @ECU_Address@FCtl_FTB_0x04@0x024C512E@ */ ECIPP_ALIGNMENT_UBYTE 255 Compu_IDENTITY 0 255 PHYS_UNIT "FTB" /end CHARACTERISTIC
/begin CHARACTERISTIC FCftb_J1939_addrFail "FCtl_FTB_0x04(188)" VALUE 0x001E5DD3 /* @ECU_Address@FCtl_FTB_0x04@0x024C50BC@ */ ECIPP_ALIGNMENT_UBYTE 255 Compu_IDENTITY 0 255 PHYS_UNIT "FTB" /end CHARACTERISTIC
/begin CHARACTERISTIC FCftb_J1939_ETC_loss "FCtl_FTB_0x04(219)" VALUE 0x001E5DF2 /* @ECU_Address@FCtl_FTB_0x04@0x024C50DB@ */ ECIPP_ALIGNMENT_UBYTE 255 Compu_IDENTITY 0 255 PHYS_UNIT "FTB" /end CHARACTERISTIC
/begin CHARACTERISTIC FCftb_J1939_ETC_loss2 "FCtl_FTB_0x04(275)" VALUE 0x001E5E2A /* @ECU_Address@FCtl_FTB_0x04@0x024C5113@ */ ECIPP_ALIGNMENT_UBYTE 255 Compu_IDENTITY 0 255 PHYS_UNIT "FTB" /end CHARACTERISTIC
/begin CHARACTERISTIC FCftb_J1939_PGN_tout "FCtl_FTB_0x04(714)" VALUE 0x001E5FE1 /* @ECU_Address@FCtl_FTB_0x04@0x024C52CA@ */ ECIPP_ALIGNMENT_UBYTE 255 Compu_IDENTITY 0 255 PHYS_UNIT "FTB" /end CHARACTERISTIC
/begin CHARACTERISTIC FCftb_J1939_PGN_tout10 "FCtl_FTB_0x04(723)" VALUE 0x001E5FEA /* @ECU_Address@FCtl_FTB_0x04@0x024C52D3@ */ ECIPP_ALIGNMENT_UBYTE 255 Compu_IDENTITY 0 255 PHYS_UNIT "FTB" /end CHARACTERISTIC
/begin CHARACTERISTIC FCftb_J1939_PGN_tout2 "FCtl_FTB_0x04(715)" VALUE 0x001E5FE2 /* @ECU_Address@FCtl_FTB_0x04@0x024C52CB@ */ ECIPP_ALIGNMENT_UBYTE 255 Compu_IDENTITY 0 255 PHYS_UNIT "FTB" /end CHARACTERISTIC
/begin CHARACTERISTIC FCftb_J1939_PGN_tout3 "FCtl_FTB_0x04(716)" VALUE 0x001E5FE3 /* @ECU_Address@FCtl_FTB_0x04@0x024C52CC@ */ ECIPP_ALIGNMENT_UBYTE 255 Compu_IDENTITY 0 255 PHYS_UNIT "FTB" /end CHARACTERISTIC
/begin CHARACTERISTIC FCftb_J1939_PGN_tout4 "FCtl_FTB_0x04(717)" VALUE 0x001E5FE4 /* @ECU_Address@FCtl_FTB_0x04@0x024C52CD@ */ ECIPP_ALIGNMENT_UBYTE 255 Compu_IDENTITY 0 255 PHYS_UNIT "FTB" /end CHARACTERISTIC
/begin CHARACTERISTIC FCftb_J1939_PGN_tout5 "FCtl_FTB_0x04(718)" VALUE 0x001E5FE5 /* @ECU_Address@FCtl_FTB_0x04@0x024C52CE@ */ ECIPP_ALIGNMENT_UBYTE 255 Compu_IDENTITY 0 255 PHYS_UNIT "FTB" /end CHARACTERISTIC
/begin CHARACTERISTIC FCftb_J1939_PGN_tout6 "FCtl_FTB_0x04(719)" VALUE 0x001E5FE6 /* @ECU_Address@FCtl_FTB_0x04@0x024C52CF@ */ ECIPP_ALIGNMENT_UBYTE 255 Compu_IDENTITY 0 255 PHYS_UNIT "FTB" /end CHARACTERISTIC
/begin CHARACTERISTIC FCftb_J1939_PGN_tout7 "FCtl_FTB_0x04(720)" VALUE 0x001E5FE7 /* @ECU_Address@FCtl_FTB_0x04@0x024C52D0@ */ ECIPP_ALIGNMENT_UBYTE 255 Compu_IDENTITY 0 255 PHYS_UNIT "FTB" /end CHARACTERISTIC
/begin CHARACTERISTIC FCftb_J1939_PGN_tout8 "FCtl_FTB_0x04(721)" VALUE 0x001E5FE8 /* @ECU_Address@FCtl_FTB_0x04@0x024C52D1@ */ ECIPP_ALIGNMENT_UBYTE 255 Compu_IDENTITY 0 255 PHYS_UNIT "FTB" /end CHARACTERISTIC
/begin CHARACTERISTIC FCftb_J1939_PGN_tout9 "FCtl_FTB_0x04(722)" VALUE 0x001E5FE9 /* @ECU_Address@FCtl_FTB_0x04@0x024C52D2@ */ ECIPP_ALIGNMENT_UBYTE 255 Compu_IDENTITY 0 255 PHYS_UNIT "FTB" /end CHARACTERISTIC
/begin CHARACTERISTIC FCftb_J1939_RS_err_loss "FCtl_FTB_0x04(834)" VALUE 0x001E6059 /* @ECU_Address@FCtl_FTB_0x04@0x024C5342@ */ ECIPP_ALIGNMENT_UBYTE 255 Compu_IDENTITY 0 255 PHYS_UNIT "FTB" /end CHARACTERISTIC
/begin CHARACTERISTIC FCftb_J1939_RSsetpt_loss "FCtl_FTB_0x04(600)" VALUE 0x001E5F6F /* @ECU_Address@FCtl_FTB_0x04@0x024C5258@ */ ECIPP_ALIGNMENT_UBYTE 255 Compu_IDENTITY 0 255 PHYS_UNIT "FTB" /end CHARACTERISTIC
/begin CHARACTERISTIC FCftb_J1939_Rx2Fail "FCtl_FTB_0x04(299)" VALUE 0x001E5E42 /* @ECU_Address@FCtl_FTB_0x04@0x024C512B@ */ ECIPP_ALIGNMENT_UBYTE 255 Compu_IDENTITY 0 255 PHYS_UNIT "FTB" /end CHARACTERISTIC
/begin CHARACTERISTIC FCftb_J1939_Rx3Fail "FCtl_FTB_0x04(300)" VALUE 0x001E5E43 /* @ECU_Address@FCtl_FTB_0x04@0x024C512C@ */ ECIPP_ALIGNMENT_UBYTE 255 Compu_IDENTITY 0 255 PHYS_UNIT "FTB" /end CHARACTERISTIC
/begin CHARACTERISTIC FCftb_J1939_RxFail "FCtl_FTB_0x04(155)" VALUE 0x001E5DB2 /* @ECU_Address@FCtl_FTB_0x04@0x024C509B@ */ ECIPP_ALIGNMENT_UBYTE 255 Compu_IDENTITY 0 255 PHYS_UNIT "FTB" /end CHARACTERISTIC
/begin CHARACTERISTIC FCftb_J1939_SD_rq "FCtl_FTB_0x04(153)" VALUE 0x001E5DB0 /* @ECU_Address@FCtl_FTB_0x04@0x024C5099@ */ ECIPP_ALIGNMENT_UBYTE 255 Compu_IDENTITY 0 255 PHYS_UNIT "FTB" /end CHARACTERISTIC
/begin CHARACTERISTIC FCspn_FPrly_coilshort "FCtl_SPN(169)" VALUE 0x001E2008 /* @ECU_Address@FCtl_SPN@0x21B602A4@ */ ECIPP_ALIGNMENT_ULONG 4294967295 Compu_IDENTITY 0 4294967295 PHYS_UNIT "SPN" /end CHARACTERISTIC
/begin CHARACTERISTIC FCspn_FPrly_gndshort "FCtl_SPN(167)" VALUE 0x001E2000 /* @ECU_Address@FCtl_SPN@0x21B6029C@ */ ECIPP_ALIGNMENT_ULONG 4294967295 Compu_IDENTITY 0 4294967295 PHYS_UNIT "SPN" /end CHARACTERISTIC
/begin CHARACTERISTIC FCspn_FSO_post_TPS_phi_hi "FCtl_SPN(860)" VALUE 0x001E2AD4 /* @ECU_Address@FCtl_SPN@0x21B60D70@ */ ECIPP_ALIGNMENT_ULONG 4294967295 Compu_IDENTITY 0 4294967295 PHYS_UNIT "SPN" /end CHARACTERISTIC
/begin CHARACTERISTIC FCspn_FSO_TPS_phi_hi "FCtl_SPN(803)" VALUE 0x001E29F0 /* @ECU_Address@FCtl_SPN@0x21B60C8C@ */ ECIPP_ALIGNMENT_ULONG 4294967295 Compu_IDENTITY 0 4294967295 PHYS_UNIT "SPN" /end CHARACTERISTIC
/begin CHARACTERISTIC FCspn_FT_maxv "FCtl_SPN(146)" VALUE 0x001E1FAC /* @ECU_Address@FCtl_SPN@0x21B60248@ */ ECIPP_ALIGNMENT_ULONG 4294967295 Compu_IDENTITY 0 4294967295 PHYS_UNIT "SPN" /end CHARACTERISTIC
/begin CHARACTERISTIC FCspn_FT_minv "FCtl_SPN(147)" VALUE 0x001E1FB0 /* @ECU_Address@FCtl_SPN@0x21B6024C@ */ ECIPP_ALIGNMENT_ULONG 4294967295 Compu_IDENTITY 0 4294967295 PHYS_UNIT "SPN" /end CHARACTERISTIC
/begin CHARACTERISTIC FCspn_FTgasf_maxv "FCtl_SPN(215)" VALUE 0x001E20C0 /* @ECU_Address@FCtl_SPN@0x21B6035C@ */ ECIPP_ALIGNMENT_ULONG 4294967295 Compu_IDENTITY 0 4294967295 PHYS_UNIT "SPN" /end CHARACTERISTIC
/begin CHARACTERISTIC FCspn_FTgasf_minv "FCtl_SPN(216)" VALUE 0x001E20C4 /* @ECU_Address@FCtl_SPN@0x21B60360@ */ ECIPP_ALIGNMENT_ULONG 4294967295 Compu_IDENTITY 0 4294967295 PHYS_UNIT "SPN" /end CHARACTERISTIC
/begin CHARACTERISTIC FCspn_GLOW_unit_fail "FCtl_SPN(503)" VALUE 0x001E2540 /* @ECU_Address@FCtl_SPN@0x21B607DC@ */ ECIPP_ALIGNMENT_ULONG 4294967295 Compu_IDENTITY 0 4294967295 PHYS_UNIT "SPN" /end CHARACTERISTIC
/begin CHARACTERISTIC FCspn_GLOW1_open "FCtl_SPN(483)" VALUE 0x001E24F0 /* @ECU_Address@FCtl_SPN@0x21B6078C@ */ ECIPP_ALIGNMENT_ULONG 4294967295 Compu_IDENTITY 0 4294967295 PHYS_UNIT "SPN" /end CHARACTERISTIC
/begin CHARACTERISTIC FCspn_GLOW1_short "FCtl_SPN(493)" VALUE 0x001E2518 /* @ECU_Address@FCtl_SPN@0x21B607B4@ */ ECIPP_ALIGNMENT_ULONG 4294967295 Compu_IDENTITY 0 4294967295 PHYS_UNIT "SPN" /end CHARACTERISTIC
/begin CHARACTERISTIC FCspn_gov_ntrlock_fail "FCtl_SPN(92)" VALUE 0x001E1ED4 /* @ECU_Address@FCtl_SPN@0x21B60170@ */ ECIPP_ALIGNMENT_ULONG 4294967295 Compu_IDENTITY 0 4294967295 PHYS_UNIT "SPN" /end CHARACTERISTIC
/begin CHARACTERISTIC FCspn_gyro_x_max "FCtl_SPN(708)" VALUE 0x001E2874 /* @ECU_Address@FCtl_SPN@0x21B60B10@ */ ECIPP_ALIGNMENT_ULONG 4294967295 Compu_IDENTITY 0 4294967295 PHYS_UNIT "SPN" /end CHARACTERISTIC
/begin CHARACTERISTIC FCspn_gyro_x_min "FCtl_SPN(709)" VALUE 0x001E2878 /* @ECU_Address@FCtl_SPN@0x21B60B14@ */ ECIPP_ALIGNMENT_ULONG 4294967295 Compu_IDENTITY 0 4294967295 PHYS_UNIT "SPN" /end CHARACTERISTIC
/begin CHARACTERISTIC FCspn_gyro_y_max "FCtl_SPN(710)" VALUE 0x001E287C /* @ECU_Address@FCtl_SPN@0x21B60B18@ */ ECIPP_ALIGNMENT_ULONG 4294967295 Compu_IDENTITY 0 4294967295 PHYS_UNIT "SPN" /end CHARACTERISTIC
/begin CHARACTERISTIC FCspn_gyro_y_min "FCtl_SPN(711)" VALUE 0x001E2880 /* @ECU_Address@FCtl_SPN@0x21B60B1C@ */ ECIPP_ALIGNMENT_ULONG 4294967295 Compu_IDENTITY 0 4294967295 PHYS_UNIT "SPN" /end CHARACTERISTIC
/begin CHARACTERISTIC FCspn_gyro_z_max "FCtl_SPN(712)" VALUE 0x001E2884 /* @ECU_Address@FCtl_SPN@0x21B60B20@ */ ECIPP_ALIGNMENT_ULONG 4294967295 Compu_IDENTITY 0 4294967295 PHYS_UNIT "SPN" /end CHARACTERISTIC
/begin CHARACTERISTIC FCspn_gyro_z_min "FCtl_SPN(713)" VALUE 0x001E2888 /* @ECU_Address@FCtl_SPN@0x21B60B24@ */ ECIPP_ALIGNMENT_ULONG 4294967295 Compu_IDENTITY 0 4294967295 PHYS_UNIT "SPN" /end CHARACTERISTIC
/begin CHARACTERISTIC FCspn_HBA_I_max "FCtl_SPN(528)" VALUE 0x001E25A4 /* @ECU_Address@FCtl_SPN@0x21B60840@ */ ECIPP_ALIGNMENT_ULONG 4294967295 Compu_IDENTITY 0 4294967295 PHYS_UNIT "SPN" /end CHARACTERISTIC
/begin CHARACTERISTIC FCspn_HBB_I_max "FCtl_SPN(529)" VALUE 0x001E25A8 /* @ECU_Address@FCtl_SPN@0x21B60844@ */ ECIPP_ALIGNMENT_ULONG 4294967295 Compu_IDENTITY 0 4294967295 PHYS_UNIT "SPN" /end CHARACTERISTIC
/begin CHARACTERISTIC FCspn_HiDiagTemp "FCtl_SPN(652)" VALUE 0x001E2794 /* @ECU_Address@FCtl_SPN@0x21B60A30@ */ ECIPP_ALIGNMENT_ULONG 4294967295 Compu_IDENTITY 0 4294967295 PHYS_UNIT "SPN" /end CHARACTERISTIC
/begin CHARACTERISTIC FCspn_HWID_fail "FCtl_SPN(318)" VALUE 0x001E225C /* @ECU_Address@FCtl_SPN@0x21B604F8@ */ ECIPP_ALIGNMENT_ULONG 4294967295 Compu_IDENTITY 0 4294967295 PHYS_UNIT "SPN" /end CHARACTERISTIC
/begin CHARACTERISTIC FCspn_IAC_gndshort "FCtl_SPN(156)" VALUE 0x001E1FD4 /* @ECU_Address@FCtl_SPN@0x21B60270@ */ ECIPP_ALIGNMENT_ULONG 4294967295 Compu_IDENTITY 0 4294967295 PHYS_UNIT "SPN" /end CHARACTERISTIC
/begin CHARACTERISTIC FCspn_IAC_openshort "FCtl_SPN(157)" VALUE 0x001E1FD8 /* @ECU_Address@FCtl_SPN@0x21B60274@ */ ECIPP_ALIGNMENT_ULONG 4294967295 Compu_IDENTITY 0 4294967295 PHYS_UNIT "SPN" /end CHARACTERISTIC
/begin CHARACTERISTIC FCspn_IAT_HiExp "FCtl_SPN(87)" VALUE 0x001E1EC0 /* @ECU_Address@FCtl_SPN@0x21B6015C@ */ ECIPP_ALIGNMENT_ULONG 4294967295 Compu_IDENTITY 0 4294967295 PHYS_UNIT "SPN" /end CHARACTERISTIC
/begin CHARACTERISTIC FCspn_IAT_HiExp2 "FCtl_SPN(88)" VALUE 0x001E1EC4 /* @ECU_Address@FCtl_SPN@0x21B60160@ */ ECIPP_ALIGNMENT_ULONG 4294967295 Compu_IDENTITY 0 4294967295 PHYS_UNIT "SPN" /end CHARACTERISTIC
/begin CHARACTERISTIC FCspn_IAT_maxv "FCtl_SPN(5)" VALUE 0x001E1D78 /* @ECU_Address@FCtl_SPN@0x21B60014@ */ ECIPP_ALIGNMENT_ULONG 4294967295 Compu_IDENTITY 0 4294967295 PHYS_UNIT "SPN" /end CHARACTERISTIC
/begin CHARACTERISTIC FCspn_IAT_minv "FCtl_SPN(6)" VALUE 0x001E1D7C /* @ECU_Address@FCtl_SPN@0x21B60018@ */ ECIPP_ALIGNMENT_ULONG 4294967295 Compu_IDENTITY 0 4294967295 PHYS_UNIT "SPN" /end CHARACTERISTIC
/begin CHARACTERISTIC FCspn_IBF_detected "FCtl_SPN(861)" VALUE 0x001E2AD8 /* @ECU_Address@FCtl_SPN@0x21B60D74@ */ ECIPP_ALIGNMENT_ULONG 4294967295 Compu_IDENTITY 0 4294967295 PHYS_UNIT "SPN" /end CHARACTERISTIC
/begin CHARACTERISTIC FCspn_ICam_maxerr "FCtl_SPN(288)" VALUE 0x001E21E4 /* @ECU_Address@FCtl_SPN@0x21B60480@ */ ECIPP_ALIGNMENT_ULONG 4294967295 Compu_IDENTITY 0 4294967295 PHYS_UNIT "SPN" /end CHARACTERISTIC
/begin CHARACTERISTIC FCspn_ICAVD1_mis "FCtl_SPN(259)" VALUE 0x001E2170 /* @ECU_Address@FCtl_SPN@0x21B6040C@ */ ECIPP_ALIGNMENT_ULONG 4294967295 Compu_IDENTITY 0 4294967295 PHYS_UNIT "SPN" /end CHARACTERISTIC
/begin CHARACTERISTIC FCspn_ICAVD1_miscat "FCtl_SPN(267)" VALUE 0x001E2190 /* @ECU_Address@FCtl_SPN@0x21B6042C@ */ ECIPP_ALIGNMENT_ULONG 4294967295 Compu_IDENTITY 0 4294967295 PHYS_UNIT "SPN" /end CHARACTERISTIC
/begin CHARACTERISTIC FCspn_ICCOT_hi "FCtl_SPN(863)" VALUE 0x001E2AE0 /* @ECU_Address@FCtl_SPN@0x21B60D7C@ */ ECIPP_ALIGNMENT_ULONG 4294967295 Compu_IDENTITY 0 4294967295 PHYS_UNIT "SPN" /end CHARACTERISTIC
/begin CHARACTERISTIC FCspn_Idle_SD "FCtl_SPN(654)" VALUE 0x001E279C /* @ECU_Address@FCtl_SPN@0x21B60A38@ */ ECIPP_ALIGNMENT_ULONG 4294967295 Compu_IDENTITY 0 4294967295 PHYS_UNIT "SPN" /end CHARACTERISTIC
/begin CHARACTERISTIC FCspn_imu_general "FCtl_SPN(699)" VALUE 0x001E2850 /* @ECU_Address@FCtl_SPN@0x21B60AEC@ */ ECIPP_ALIGNMENT_ULONG 4294967295 Compu_IDENTITY 0 4294967295 PHYS_UNIT "SPN" /end CHARACTERISTIC
/begin CHARACTERISTIC FCspn_imu_temp_max "FCtl_SPN(700)" VALUE 0x001E2854 /* @ECU_Address@FCtl_SPN@0x21B60AF0@ */ ECIPP_ALIGNMENT_ULONG 4294967295 Compu_IDENTITY 0 4294967295 PHYS_UNIT "SPN" /end CHARACTERISTIC
/begin CHARACTERISTIC FCspn_imu_temp_min "FCtl_SPN(701)" VALUE 0x001E2858 /* @ECU_Address@FCtl_SPN@0x21B60AF4@ */ ECIPP_ALIGNMENT_ULONG 4294967295 Compu_IDENTITY 0 4294967295 PHYS_UNIT "SPN" /end CHARACTERISTIC
/begin CHARACTERISTIC FCspn_IMVD_Ifb_hi "FCtl_SPN(583)" VALUE 0x001E2680 /* @ECU_Address@FCtl_SPN@0x21B6091C@ */ ECIPP_ALIGNMENT_ULONG 4294967295 Compu_IDENTITY 0 4294967295 PHYS_UNIT "SPN" /end CHARACTERISTIC
/begin CHARACTERISTIC FCspn_IMVD_Ifb_lo "FCtl_SPN(582)" VALUE 0x001E267C /* @ECU_Address@FCtl_SPN@0x21B60918@ */ ECIPP_ALIGNMENT_ULONG 4294967295 Compu_IDENTITY 0 4294967295 PHYS_UNIT "SPN" /end CHARACTERISTIC
/begin CHARACTERISTIC FCspn_INJD_boost_lo "FCtl_SPN(578)" VALUE 0x001E266C /* @ECU_Address@FCtl_SPN@0x21B60908@ */ ECIPP_ALIGNMENT_ULONG 4294967295 Compu_IDENTITY 0 4294967295 PHYS_UNIT "SPN" /end CHARACTERISTIC
/begin CHARACTERISTIC FCspn_INJD_HS_Ihi "FCtl_SPN(562)" VALUE 0x001E262C /* @ECU_Address@FCtl_SPN@0x21B608C8@ */ ECIPP_ALIGNMENT_ULONG 4294967295 Compu_IDENTITY 0 4294967295 PHYS_UNIT "SPN" /end CHARACTERISTIC
/begin CHARACTERISTIC FCspn_INJD_HW_int "FCtl_SPN(580)" VALUE 0x001E2674 /* @ECU_Address@FCtl_SPN@0x21B60910@ */ ECIPP_ALIGNMENT_ULONG 4294967295 Compu_IDENTITY 0 4294967295 PHYS_UNIT "SPN" /end CHARACTERISTIC
/begin CHARACTERISTIC FCspn_INJD_LS_Ihi "FCtl_SPN(570)" VALUE 0x001E264C /* @ECU_Address@FCtl_SPN@0x21B608E8@ */ ECIPP_ALIGNMENT_ULONG 4294967295 Compu_IDENTITY 0 4294967295 PHYS_UNIT "SPN" /end CHARACTERISTIC
/begin CHARACTERISTIC FCspn_INJD_off_lo "FCtl_SPN(46)" VALUE 0x001E1E1C /* @ECU_Address@FCtl_SPN@0x21B600B8@ */ ECIPP_ALIGNMENT_ULONG 4294967295 Compu_IDENTITY 0 4294967295 PHYS_UNIT "SPN" /end CHARACTERISTIC
/begin CHARACTERISTIC FCspn_INJD_on_hi "FCtl_SPN(56)" VALUE 0x001E1E44 /* @ECU_Address@FCtl_SPN@0x21B600E0@ */ ECIPP_ALIGNMENT_ULONG 4294967295 Compu_IDENTITY 0 4294967295 PHYS_UNIT "SPN" /end CHARACTERISTIC
/begin CHARACTERISTIC FCspn_intby_poserr "FCtl_SPN(864)" VALUE 0x001E2AE4 /* @ECU_Address@FCtl_SPN@0x21B60D80@ */ ECIPP_ALIGNMENT_ULONG 4294967295 Compu_IDENTITY 0 4294967295 PHYS_UNIT "SPN" /end CHARACTERISTIC
/begin CHARACTERISTIC FCspn_interrupt "FCtl_SPN(104)" VALUE 0x001E1F04 /* @ECU_Address@FCtl_SPN@0x21B601A0@ */ ECIPP_ALIGNMENT_ULONG 4294967295 Compu_IDENTITY 0 4294967295 PHYS_UNIT "SPN" /end CHARACTERISTIC
/begin CHARACTERISTIC FCspn_IRV_CL_OOA "FCtl_SPN(869)" VALUE 0x001E2AF8 /* @ECU_Address@FCtl_SPN@0x21B60D94@ */ ECIPP_ALIGNMENT_ULONG 4294967295 Compu_IDENTITY 0 4294967295 PHYS_UNIT "SPN" /end CHARACTERISTIC
/begin CHARACTERISTIC FCspn_J1939_AAT_err_loss "FCtl_SPN(835)" VALUE 0x001E2A70 /* @ECU_Address@FCtl_SPN@0x21B60D0C@ */ ECIPP_ALIGNMENT_ULONG 4294967295 Compu_IDENTITY 0 4294967295 PHYS_UNIT "SPN" /end CHARACTERISTIC
/begin CHARACTERISTIC FCspn_J1939_addr2Fail "FCtl_SPN(301)" VALUE 0x001E2218 /* @ECU_Address@FCtl_SPN@0x21B604B4@ */ ECIPP_ALIGNMENT_ULONG 4294967295 Compu_IDENTITY 0 4294967295 PHYS_UNIT "SPN" /end CHARACTERISTIC
/begin CHARACTERISTIC FCspn_J1939_addr3Fail "FCtl_SPN(302)" VALUE 0x001E221C /* @ECU_Address@FCtl_SPN@0x21B604B8@ */ ECIPP_ALIGNMENT_ULONG 4294967295 Compu_IDENTITY 0 4294967295 PHYS_UNIT "SPN" /end CHARACTERISTIC
/begin CHARACTERISTIC FCspn_J1939_addrFail "FCtl_SPN(188)" VALUE 0x001E2054 /* @ECU_Address@FCtl_SPN@0x21B602F0@ */ ECIPP_ALIGNMENT_ULONG 4294967295 Compu_IDENTITY 0 4294967295 PHYS_UNIT "SPN" /end CHARACTERISTIC
/begin CHARACTERISTIC FCspn_J1939_ETC_loss "FCtl_SPN(219)" VALUE 0x001E20D0 /* @ECU_Address@FCtl_SPN@0x21B6036C@ */ ECIPP_ALIGNMENT_ULONG 4294967295 Compu_IDENTITY 0 4294967295 PHYS_UNIT "SPN" /end CHARACTERISTIC
/begin CHARACTERISTIC FCspn_J1939_ETC_loss2 "FCtl_SPN(275)" VALUE 0x001E21B0 /* @ECU_Address@FCtl_SPN@0x21B6044C@ */ ECIPP_ALIGNMENT_ULONG 4294967295 Compu_IDENTITY 0 4294967295 PHYS_UNIT "SPN" /end CHARACTERISTIC
/begin CHARACTERISTIC FCspn_J1939_PGN_tout "FCtl_SPN(714)" VALUE 0x001E288C /* @ECU_Address@FCtl_SPN@0x21B60B28@ */ ECIPP_ALIGNMENT_ULONG 4294967295 Compu_IDENTITY 0 4294967295 PHYS_UNIT "SPN" /end CHARACTERISTIC
/begin CHARACTERISTIC FCspn_J1939_PGN_tout10 "FCtl_SPN(723)" VALUE 0x001E28B0 /* @ECU_Address@FCtl_SPN@0x21B60B4C@ */ ECIPP_ALIGNMENT_ULONG 4294967295 Compu_IDENTITY 0 4294967295 PHYS_UNIT "SPN" /end CHARACTERISTIC
/begin CHARACTERISTIC FCspn_J1939_PGN_tout2 "FCtl_SPN(715)" VALUE 0x001E2890 /* @ECU_Address@FCtl_SPN@0x21B60B2C@ */ ECIPP_ALIGNMENT_ULONG 4294967295 Compu_IDENTITY 0 4294967295 PHYS_UNIT "SPN" /end CHARACTERISTIC
/begin CHARACTERISTIC FCspn_J1939_PGN_tout3 "FCtl_SPN(716)" VALUE 0x001E2894 /* @ECU_Address@FCtl_SPN@0x21B60B30@ */ ECIPP_ALIGNMENT_ULONG 4294967295 Compu_IDENTITY 0 4294967295 PHYS_UNIT "SPN" /end CHARACTERISTIC
/begin CHARACTERISTIC FCspn_J1939_PGN_tout4 "FCtl_SPN(717)" VALUE 0x001E2898 /* @ECU_Address@FCtl_SPN@0x21B60B34@ */ ECIPP_ALIGNMENT_ULONG 4294967295 Compu_IDENTITY 0 4294967295 PHYS_UNIT "SPN" /end CHARACTERISTIC
/begin CHARACTERISTIC FCspn_J1939_PGN_tout5 "FCtl_SPN(718)" VALUE 0x001E289C /* @ECU_Address@FCtl_SPN@0x21B60B38@ */ ECIPP_ALIGNMENT_ULONG 4294967295 Compu_IDENTITY 0 4294967295 PHYS_UNIT "SPN" /end CHARACTERISTIC
/begin CHARACTERISTIC FCspn_J1939_PGN_tout6 "FCtl_SPN(719)" VALUE 0x001E28A0 /* @ECU_Address@FCtl_SPN@0x21B60B3C@ */ ECIPP_ALIGNMENT_ULONG 4294967295 Compu_IDENTITY 0 4294967295 PHYS_UNIT "SPN" /end CHARACTERISTIC
/begin CHARACTERISTIC FCspn_J1939_PGN_tout7 "FCtl_SPN(720)" VALUE 0x001E28A4 /* @ECU_Address@FCtl_SPN@0x21B60B40@ */ ECIPP_ALIGNMENT_ULONG 4294967295 Compu_IDENTITY 0 4294967295 PHYS_UNIT "SPN" /end CHARACTERISTIC
/begin CHARACTERISTIC FCspn_J1939_PGN_tout8 "FCtl_SPN(721)" VALUE 0x001E28A8 /* @ECU_Address@FCtl_SPN@0x21B60B44@ */ ECIPP_ALIGNMENT_ULONG 4294967295 Compu_IDENTITY 0 4294967295 PHYS_UNIT "SPN" /end CHARACTERISTIC
/begin CHARACTERISTIC FCspn_J1939_PGN_tout9 "FCtl_SPN(722)" VALUE 0x001E28AC /* @ECU_Address@FCtl_SPN@0x21B60B48@ */ ECIPP_ALIGNMENT_ULONG 4294967295 Compu_IDENTITY 0 4294967295 PHYS_UNIT "SPN" /end CHARACTERISTIC
/begin CHARACTERISTIC FCspn_J1939_RS_err_loss "FCtl_SPN(834)" VALUE 0x001E2A6C /* @ECU_Address@FCtl_SPN@0x21B60D08@ */ ECIPP_ALIGNMENT_ULONG 4294967295 Compu_IDENTITY 0 4294967295 PHYS_UNIT "SPN" /end CHARACTERISTIC
/begin CHARACTERISTIC FCspn_J1939_RSsetpt_loss "FCtl_SPN(600)" VALUE 0x001E26C4 /* @ECU_Address@FCtl_SPN@0x21B60960@ */ ECIPP_ALIGNMENT_ULONG 4294967295 Compu_IDENTITY 0 4294967295 PHYS_UNIT "SPN" /end CHARACTERISTIC
/begin CHARACTERISTIC FCspn_J1939_Rx2Fail "FCtl_SPN(299)" VALUE 0x001E2210 /* @ECU_Address@FCtl_SPN@0x21B604AC@ */ ECIPP_ALIGNMENT_ULONG 4294967295 Compu_IDENTITY 0 4294967295 PHYS_UNIT "SPN" /end CHARACTERISTIC
/begin CHARACTERISTIC FCspn_J1939_Rx3Fail "FCtl_SPN(300)" VALUE 0x001E2214 /* @ECU_Address@FCtl_SPN@0x21B604B0@ */ ECIPP_ALIGNMENT_ULONG 4294967295 Compu_IDENTITY 0 4294967295 PHYS_UNIT "SPN" /end CHARACTERISTIC
/begin CHARACTERISTIC FCspn_J1939_RxFail "FCtl_SPN(155)" VALUE 0x001E1FD0 /* @ECU_Address@FCtl_SPN@0x21B6026C@ */ ECIPP_ALIGNMENT_ULONG 4294967295 Compu_IDENTITY 0 4294967295 PHYS_UNIT "SPN" /end CHARACTERISTIC
/begin CHARACTERISTIC FCspn_J1939_SD_rq "FCtl_SPN(153)" VALUE 0x001E1FC8 /* @ECU_Address@FCtl_SPN@0x21B60264@ */ ECIPP_ALIGNMENT_ULONG 4294967295 Compu_IDENTITY 0 4294967295 PHYS_UNIT "SPN" /end CHARACTERISTIC
/begin CHARACTERISTIC FPfl_FPrly_coilshort "FPrm_latch(129)" VALUE 0x001E021C /* @ECU_Address@FPrm_latch@0x021BB204@ */ ECIPP_ALIGNMENT_FLOAT32_IEEE 10000000000 Compu_IDENTITY -10000000000 10000000000 PHYS_UNIT "samples" /end CHARACTERISTIC
/begin CHARACTERISTIC FPfl_FPrly_gndshort "FPrm_latch(127)" VALUE 0x001E0214 /* @ECU_Address@FPrm_latch@0x021BB1FC@ */ ECIPP_ALIGNMENT_FLOAT32_IEEE 10000000000 Compu_IDENTITY -10000000000 10000000000 PHYS_UNIT "samples" /end CHARACTERISTIC
/begin CHARACTERISTIC FPfl_FSO_post_TPS_phi_hi "FPrm_latch(687)" VALUE 0x001E0AD4 /* @ECU_Address@FPrm_latch@0x021BBABC@ */ ECIPP_ALIGNMENT_FLOAT32_IEEE 10000000000 Compu_IDENTITY -10000000000 10000000000 PHYS_UNIT "samples" /end CHARACTERISTIC
/begin CHARACTERISTIC FPfl_FSO_TPS_phi_hi "FPrm_latch(632)" VALUE 0x001E09F8 /* @ECU_Address@FPrm_latch@0x021BB9E0@ */ ECIPP_ALIGNMENT_FLOAT32_IEEE 10000000000 Compu_IDENTITY -10000000000 10000000000 PHYS_UNIT "ms" /end CHARACTERISTIC
/begin CHARACTERISTIC FPfl_FT_maxv "FPrm_latch(106)" VALUE 0x001E01C0 /* @ECU_Address@FPrm_latch@0x021BB1A8@ */ ECIPP_ALIGNMENT_FLOAT32_IEEE 10000000000 Compu_IDENTITY -10000000000 10000000000 PHYS_UNIT "ms" /end CHARACTERISTIC
/begin CHARACTERISTIC FPfl_FT_minv "FPrm_latch(107)" VALUE 0x001E01C4 /* @ECU_Address@FPrm_latch@0x021BB1AC@ */ ECIPP_ALIGNMENT_FLOAT32_IEEE 10000000000 Compu_IDENTITY -10000000000 10000000000 PHYS_UNIT "ms" /end CHARACTERISTIC
/begin CHARACTERISTIC FPfl_FTgasf_maxv "FPrm_latch(171)" VALUE 0x001E02C4 /* @ECU_Address@FPrm_latch@0x021BB2AC@ */ ECIPP_ALIGNMENT_FLOAT32_IEEE 10000000000 Compu_IDENTITY -10000000000 10000000000 PHYS_UNIT "ms" /end CHARACTERISTIC
/begin CHARACTERISTIC FPfl_FTgasf_minv "FPrm_latch(172)" VALUE 0x001E02C8 /* @ECU_Address@FPrm_latch@0x021BB2B0@ */ ECIPP_ALIGNMENT_FLOAT32_IEEE 10000000000 Compu_IDENTITY -10000000000 10000000000 PHYS_UNIT "ms" /end CHARACTERISTIC
/begin CHARACTERISTIC FPfl_GLOW_unit_fail "FPrm_latch(382)" VALUE 0x001E0610 /* @ECU_Address@FPrm_latch@0x021BB5F8@ */ ECIPP_ALIGNMENT_FLOAT32_IEEE 10000000000 Compu_IDENTITY -10000000000 10000000000 PHYS_UNIT "ms" /end CHARACTERISTIC
/begin CHARACTERISTIC FPfl_GLOW1_open "FPrm_latch(380)" VALUE 0x001E0608 /* @ECU_Address@FPrm_latch@0x021BB5F0@ */ ECIPP_ALIGNMENT_FLOAT32_IEEE 10000000000 Compu_IDENTITY -10000000000 10000000000 PHYS_UNIT "ms" /end CHARACTERISTIC
/begin CHARACTERISTIC FPfl_GLOW1_short "FPrm_latch(381)" VALUE 0x001E060C /* @ECU_Address@FPrm_latch@0x021BB5F4@ */ ECIPP_ALIGNMENT_FLOAT32_IEEE 10000000000 Compu_IDENTITY -10000000000 10000000000 PHYS_UNIT "ms" /end CHARACTERISTIC
/begin CHARACTERISTIC FPfl_gov_ntrlock_fail "FPrm_latch(36)" VALUE 0x001E00A8 /* @ECU_Address@FPrm_latch@0x021BB090@ */ ECIPP_ALIGNMENT_FLOAT32_IEEE 10000000000 Compu_IDENTITY -10000000000 10000000000 PHYS_UNIT "ms" /end CHARACTERISTIC
/begin CHARACTERISTIC FPfl_gyro_x_max "FPrm_latch(538)" VALUE 0x001E0880 /* @ECU_Address@FPrm_latch@0x021BB868@ */ ECIPP_ALIGNMENT_FLOAT32_IEEE 10000000000 Compu_IDENTITY -10000000000 10000000000 PHYS_UNIT "ms" /end CHARACTERISTIC
/begin CHARACTERISTIC FPfl_gyro_x_min "FPrm_latch(539)" VALUE 0x001E0884 /* @ECU_Address@FPrm_latch@0x021BB86C@ */ ECIPP_ALIGNMENT_FLOAT32_IEEE 10000000000 Compu_IDENTITY -10000000000 10000000000 PHYS_UNIT "ms" /end CHARACTERISTIC
/begin CHARACTERISTIC FPfl_gyro_y_max "FPrm_latch(540)" VALUE 0x001E0888 /* @ECU_Address@FPrm_latch@0x021BB870@ */ ECIPP_ALIGNMENT_FLOAT32_IEEE 10000000000 Compu_IDENTITY -10000000000 10000000000 PHYS_UNIT "ms" /end CHARACTERISTIC
/begin CHARACTERISTIC FPfl_gyro_y_min "FPrm_latch(541)" VALUE 0x001E088C /* @ECU_Address@FPrm_latch@0x021BB874@ */ ECIPP_ALIGNMENT_FLOAT32_IEEE 10000000000 Compu_IDENTITY -10000000000 10000000000 PHYS_UNIT "ms" /end CHARACTERISTIC
/begin CHARACTERISTIC FPfl_gyro_z_max "FPrm_latch(542)" VALUE 0x001E0890 /* @ECU_Address@FPrm_latch@0x021BB878@ */ ECIPP_ALIGNMENT_FLOAT32_IEEE 10000000000 Compu_IDENTITY -10000000000 10000000000 PHYS_UNIT "ms" /end CHARACTERISTIC
/begin CHARACTERISTIC FPfl_gyro_z_min "FPrm_latch(543)" VALUE 0x001E0894 /* @ECU_Address@FPrm_latch@0x021BB87C@ */ ECIPP_ALIGNMENT_FLOAT32_IEEE 10000000000 Compu_IDENTITY -10000000000 10000000000 PHYS_UNIT "ms" /end CHARACTERISTIC
/begin CHARACTERISTIC FPfl_HBA_I_max "FPrm_latch(398)" VALUE 0x001E0650 /* @ECU_Address@FPrm_latch@0x021BB638@ */ ECIPP_ALIGNMENT_FLOAT32_IEEE 10000000000 Compu_IDENTITY -10000000000 10000000000 PHYS_UNIT "ms" /end CHARACTERISTIC
/begin CHARACTERISTIC FPfl_HBB_I_max "FPrm_latch(399)" VALUE 0x001E0654 /* @ECU_Address@FPrm_latch@0x021BB63C@ */ ECIPP_ALIGNMENT_FLOAT32_IEEE 10000000000 Compu_IDENTITY -10000000000 10000000000 PHYS_UNIT "ms" /end CHARACTERISTIC
/begin CHARACTERISTIC FPfl_HiDiagTemp "FPrm_latch(482)" VALUE 0x001E07A0 /* @ECU_Address@FPrm_latch@0x021BB788@ */ ECIPP_ALIGNMENT_FLOAT32_IEEE 10000000000 Compu_IDENTITY -10000000000 10000000000 PHYS_UNIT "ms" /end CHARACTERISTIC
/begin CHARACTERISTIC FPfl_HWID_fail "FPrm_latch(227)" VALUE 0x001E03A4 /* @ECU_Address@FPrm_latch@0x021BB38C@ */ ECIPP_ALIGNMENT_FLOAT32_IEEE 10000000000 Compu_IDENTITY -10000000000 10000000000 PHYS_UNIT "ms" /end CHARACTERISTIC
/begin CHARACTERISTIC FPfl_IAC_gndshort "FPrm_latch(116)" VALUE 0x001E01E8 /* @ECU_Address@FPrm_latch@0x021BB1D0@ */ ECIPP_ALIGNMENT_FLOAT32_IEEE 10000000000 Compu_IDENTITY -10000000000 10000000000 PHYS_UNIT "samples" /end CHARACTERISTIC
/begin CHARACTERISTIC FPfl_IAC_openshort "FPrm_latch(117)" VALUE 0x001E01EC /* @ECU_Address@FPrm_latch@0x021BB1D4@ */ ECIPP_ALIGNMENT_FLOAT32_IEEE 10000000000 Compu_IDENTITY -10000000000 10000000000 PHYS_UNIT "samples" /end CHARACTERISTIC
/begin CHARACTERISTIC FPfl_IAT_HiExp "FPrm_latch(8)" VALUE 0x001E0038 /* @ECU_Address@FPrm_latch@0x021BB020@ */ ECIPP_ALIGNMENT_FLOAT32_IEEE 10000000000 Compu_IDENTITY -10000000000 10000000000 PHYS_UNIT "ms" /end CHARACTERISTIC
/begin CHARACTERISTIC FPfl_IAT_HiExp2 "FPrm_latch(9)" VALUE 0x001E003C /* @ECU_Address@FPrm_latch@0x021BB024@ */ ECIPP_ALIGNMENT_FLOAT32_IEEE 10000000000 Compu_IDENTITY -10000000000 10000000000 PHYS_UNIT "ms" /end CHARACTERISTIC
/begin CHARACTERISTIC FPfl_IAT_maxv "FPrm_latch(6)" VALUE 0x001E0030 /* @ECU_Address@FPrm_latch@0x021BB018@ */ ECIPP_ALIGNMENT_FLOAT32_IEEE 10000000000 Compu_IDENTITY -10000000000 10000000000 PHYS_UNIT "ms" /end CHARACTERISTIC
/begin CHARACTERISTIC FPfl_IAT_minv "FPrm_latch(7)" VALUE 0x001E0034 /* @ECU_Address@FPrm_latch@0x021BB01C@ */ ECIPP_ALIGNMENT_FLOAT32_IEEE 10000000000 Compu_IDENTITY -10000000000 10000000000 PHYS_UNIT "ms" /end CHARACTERISTIC
/begin CHARACTERISTIC FPfl_IBF_detected "FPrm_latch(688)" VALUE 0x001E0AD8 /* @ECU_Address@FPrm_latch@0x021BBAC0@ */ ECIPP_ALIGNMENT_FLOAT32_IEEE 10000000000 Compu_IDENTITY -10000000000 10000000000 PHYS_UNIT "ms" /end CHARACTERISTIC
/begin CHARACTERISTIC FPfl_ICam_maxerr "FPrm_latch(210)" VALUE 0x001E0360 /* @ECU_Address@FPrm_latch@0x021BB348@ */ ECIPP_ALIGNMENT_FLOAT32_IEEE 10000000000 Compu_IDENTITY -10000000000 10000000000 PHYS_UNIT "ms" /end CHARACTERISTIC
/begin CHARACTERISTIC FPfl_ICAVD1_mis "FPrm_latch(195)" VALUE 0x001E0324 /* @ECU_Address@FPrm_latch@0x021BB30C@ */ ECIPP_ALIGNMENT_FLOAT32_IEEE 10000000000 Compu_IDENTITY -10000000000 10000000000 PHYS_UNIT "ms" /end CHARACTERISTIC
/begin CHARACTERISTIC FPfl_ICAVD1_miscat "FPrm_latch(196)" VALUE 0x001E0328 /* @ECU_Address@FPrm_latch@0x021BB310@ */ ECIPP_ALIGNMENT_FLOAT32_IEEE 10000000000 Compu_IDENTITY -10000000000 10000000000 PHYS_UNIT "ms" /end CHARACTERISTIC
/begin CHARACTERISTIC FPfl_ICCOT_hi "FPrm_latch(690)" VALUE 0x001E0AE0 /* @ECU_Address@FPrm_latch@0x021BBAC8@ */ ECIPP_ALIGNMENT_FLOAT32_IEEE 10000000000 Compu_IDENTITY -10000000000 10000000000 PHYS_UNIT "ms" /end CHARACTERISTIC
/begin CHARACTERISTIC FPfl_Idle_SD "FPrm_latch(484)" VALUE 0x001E07A8 /* @ECU_Address@FPrm_latch@0x021BB790@ */ ECIPP_ALIGNMENT_FLOAT32_IEEE 10000000000 Compu_IDENTITY -10000000000 10000000000 PHYS_UNIT "ms" /end CHARACTERISTIC
/begin CHARACTERISTIC FPfl_imu_general "FPrm_latch(529)" VALUE 0x001E085C /* @ECU_Address@FPrm_latch@0x021BB844@ */ ECIPP_ALIGNMENT_FLOAT32_IEEE 10000000000 Compu_IDENTITY -10000000000 10000000000 PHYS_UNIT "samples" /end CHARACTERISTIC
/begin CHARACTERISTIC FPfl_imu_temp_max "FPrm_latch(530)" VALUE 0x001E0860 /* @ECU_Address@FPrm_latch@0x021BB848@ */ ECIPP_ALIGNMENT_FLOAT32_IEEE 10000000000 Compu_IDENTITY -10000000000 10000000000 PHYS_UNIT "ms" /end CHARACTERISTIC
/begin CHARACTERISTIC FPfl_imu_temp_min "FPrm_latch(531)" VALUE 0x001E0864 /* @ECU_Address@FPrm_latch@0x021BB84C@ */ ECIPP_ALIGNMENT_FLOAT32_IEEE 10000000000 Compu_IDENTITY -10000000000 10000000000 PHYS_UNIT "ms" /end CHARACTERISTIC
/begin CHARACTERISTIC FPfl_IMVD_Ifb_hi "FPrm_latch(437)" VALUE 0x001E06EC /* @ECU_Address@FPrm_latch@0x021BB6D4@ */ ECIPP_ALIGNMENT_FLOAT32_IEEE 10000000000 Compu_IDENTITY -10000000000 10000000000 PHYS_UNIT "samples" /end CHARACTERISTIC
/begin CHARACTERISTIC FPfl_IMVD_Ifb_lo "FPrm_latch(436)" VALUE 0x001E06E8 /* @ECU_Address@FPrm_latch@0x021BB6D0@ */ ECIPP_ALIGNMENT_FLOAT32_IEEE 10000000000 Compu_IDENTITY -10000000000 10000000000 PHYS_UNIT "samples" /end CHARACTERISTIC
/begin CHARACTERISTIC FPfl_INJD_boost_lo "FPrm_latch(434)" VALUE 0x001E06E0 /* @ECU_Address@FPrm_latch@0x021BB6C8@ */ ECIPP_ALIGNMENT_FLOAT32_IEEE 10000000000 Compu_IDENTITY -10000000000 10000000000 PHYS_UNIT "samples" /end CHARACTERISTIC
/begin CHARACTERISTIC FPfl_INJD_HS_Ihi "FPrm_latch(432)" VALUE 0x001E06D8 /* @ECU_Address@FPrm_latch@0x021BB6C0@ */ ECIPP_ALIGNMENT_FLOAT32_IEEE 10000000000 Compu_IDENTITY -10000000000 10000000000 PHYS_UNIT "samples" /end CHARACTERISTIC
/begin CHARACTERISTIC FPfl_INJD_HW_int "FPrm_latch(435)" VALUE 0x001E06E4 /* @ECU_Address@FPrm_latch@0x021BB6CC@ */ ECIPP_ALIGNMENT_FLOAT32_IEEE 10000000000 Compu_IDENTITY -10000000000 10000000000 PHYS_UNIT "samples" /end CHARACTERISTIC
/begin CHARACTERISTIC FPfl_INJD_LS_Ihi "FPrm_latch(433)" VALUE 0x001E06DC /* @ECU_Address@FPrm_latch@0x021BB6C4@ */ ECIPP_ALIGNMENT_FLOAT32_IEEE 10000000000 Compu_IDENTITY -10000000000 10000000000 PHYS_UNIT "samples" /end CHARACTERISTIC
/begin CHARACTERISTIC FPfl_INJD_off_lo "FPrm_latch(53)" VALUE 0x001E00EC /* @ECU_Address@FPrm_latch@0x021BB0D4@ */ ECIPP_ALIGNMENT_FLOAT32_IEEE 10000000000 Compu_IDENTITY -10000000000 10000000000 PHYS_UNIT "samples" /end CHARACTERISTIC
/begin CHARACTERISTIC FPfl_INJD_on_hi "FPrm_latch(54)" VALUE 0x001E00F0 /* @ECU_Address@FPrm_latch@0x021BB0D8@ */ ECIPP_ALIGNMENT_FLOAT32_IEEE 10000000000 Compu_IDENTITY -10000000000 10000000000 PHYS_UNIT "samples" /end CHARACTERISTIC
/begin CHARACTERISTIC FPfl_intby_poserr "FPrm_latch(691)" VALUE 0x001E0AE4 /* @ECU_Address@FPrm_latch@0x021BBACC@ */ ECIPP_ALIGNMENT_FLOAT32_IEEE 10000000000 Compu_IDENTITY -10000000000 10000000000 PHYS_UNIT "ms" /end CHARACTERISTIC
/begin CHARACTERISTIC FPfl_interrupt "FPrm_latch(68)" VALUE 0x001E0128 /* @ECU_Address@FPrm_latch@0x021BB110@ */ ECIPP_ALIGNMENT_FLOAT32_IEEE 10000000000 Compu_IDENTITY -10000000000 10000000000 PHYS_UNIT "ms" /end CHARACTERISTIC
/begin CHARACTERISTIC FPfl_IRV_CL_OOA "FPrm_latch(696)" VALUE 0x001E0AF8 /* @ECU_Address@FPrm_latch@0x021BBAE0@ */ ECIPP_ALIGNMENT_FLOAT32_IEEE 10000000000 Compu_IDENTITY -10000000000 10000000000 PHYS_UNIT "ms" /end CHARACTERISTIC
/begin CHARACTERISTIC FPfl_J1939_AAT_err_loss "FPrm_latch(662)" VALUE 0x001E0A70 /* @ECU_Address@FPrm_latch@0x021BBA58@ */ ECIPP_ALIGNMENT_FLOAT32_IEEE 10000000000 Compu_IDENTITY -10000000000 10000000000 PHYS_UNIT "ms" /end CHARACTERISTIC
/begin CHARACTERISTIC FPfl_J1939_addr2Fail "FPrm_latch(223)" VALUE 0x001E0394 /* @ECU_Address@FPrm_latch@0x021BB37C@ */ ECIPP_ALIGNMENT_FLOAT32_IEEE 10000000000 Compu_IDENTITY -10000000000 10000000000 PHYS_UNIT "ms" /end CHARACTERISTIC
/begin CHARACTERISTIC FPfl_J1939_addr3Fail "FPrm_latch(224)" VALUE 0x001E0398 /* @ECU_Address@FPrm_latch@0x021BB380@ */ ECIPP_ALIGNMENT_FLOAT32_IEEE 10000000000 Compu_IDENTITY -10000000000 10000000000 PHYS_UNIT "ms" /end CHARACTERISTIC
/begin CHARACTERISTIC FPfl_J1939_addrFail "FPrm_latch(146)" VALUE 0x001E0260 /* @ECU_Address@FPrm_latch@0x021BB248@ */ ECIPP_ALIGNMENT_FLOAT32_IEEE 10000000000 Compu_IDENTITY -10000000000 10000000000 PHYS_UNIT "ms" /end CHARACTERISTIC
/begin CHARACTERISTIC FPfl_J1939_ETC_loss "FPrm_latch(175)" VALUE 0x001E02D4 /* @ECU_Address@FPrm_latch@0x021BB2BC@ */ ECIPP_ALIGNMENT_FLOAT32_IEEE 10000000000 Compu_IDENTITY -10000000000 10000000000 PHYS_UNIT "ms" /end CHARACTERISTIC
/begin CHARACTERISTIC FPfl_J1939_ETC_loss2 "FPrm_latch(197)" VALUE 0x001E032C /* @ECU_Address@FPrm_latch@0x021BB314@ */ ECIPP_ALIGNMENT_FLOAT32_IEEE 10000000000 Compu_IDENTITY -10000000000 10000000000 PHYS_UNIT "ms" /end CHARACTERISTIC
/begin CHARACTERISTIC FPfl_J1939_PGN_tout "FPrm_latch(544)" VALUE 0x001E0898 /* @ECU_Address@FPrm_latch@0x021BB880@ */ ECIPP_ALIGNMENT_FLOAT32_IEEE 10000000000 Compu_IDENTITY -10000000000 10000000000 PHYS_UNIT "ms" /end CHARACTERISTIC
/begin CHARACTERISTIC FPfl_J1939_PGN_tout10 "FPrm_latch(553)" VALUE 0x001E08BC /* @ECU_Address@FPrm_latch@0x021BB8A4@ */ ECIPP_ALIGNMENT_FLOAT32_IEEE 10000000000 Compu_IDENTITY -10000000000 10000000000 PHYS_UNIT "ms" /end CHARACTERISTIC
/begin CHARACTERISTIC FPfl_J1939_PGN_tout2 "FPrm_latch(545)" VALUE 0x001E089C /* @ECU_Address@FPrm_latch@0x021BB884@ */ ECIPP_ALIGNMENT_FLOAT32_IEEE 10000000000 Compu_IDENTITY -10000000000 10000000000 PHYS_UNIT "ms" /end CHARACTERISTIC
/begin CHARACTERISTIC FPfl_J1939_PGN_tout3 "FPrm_latch(546)" VALUE 0x001E08A0 /* @ECU_Address@FPrm_latch@0x021BB888@ */ ECIPP_ALIGNMENT_FLOAT32_IEEE 10000000000 Compu_IDENTITY -10000000000 10000000000 PHYS_UNIT "ms" /end CHARACTERISTIC
/begin CHARACTERISTIC FPfl_J1939_PGN_tout4 "FPrm_latch(547)" VALUE 0x001E08A4 /* @ECU_Address@FPrm_latch@0x021BB88C@ */ ECIPP_ALIGNMENT_FLOAT32_IEEE 10000000000 Compu_IDENTITY -10000000000 10000000000 PHYS_UNIT "ms" /end CHARACTERISTIC
/begin CHARACTERISTIC FPfl_J1939_PGN_tout5 "FPrm_latch(548)" VALUE 0x001E08A8 /* @ECU_Address@FPrm_latch@0x021BB890@ */ ECIPP_ALIGNMENT_FLOAT32_IEEE 10000000000 Compu_IDENTITY -10000000000 10000000000 PHYS_UNIT "ms" /end CHARACTERISTIC
/begin CHARACTERISTIC FPfl_J1939_PGN_tout6 "FPrm_latch(549)" VALUE 0x001E08AC /* @ECU_Address@FPrm_latch@0x021BB894@ */ ECIPP_ALIGNMENT_FLOAT32_IEEE 10000000000 Compu_IDENTITY -10000000000 10000000000 PHYS_UNIT "ms" /end CHARACTERISTIC
/begin CHARACTERISTIC FPfl_J1939_PGN_tout7 "FPrm_latch(550)" VALUE 0x001E08B0 /* @ECU_Address@FPrm_latch@0x021BB898@ */ ECIPP_ALIGNMENT_FLOAT32_IEEE 10000000000 Compu_IDENTITY -10000000000 10000000000 PHYS_UNIT "ms" /end CHARACTERISTIC
/begin CHARACTERISTIC FPfl_J1939_PGN_tout8 "FPrm_latch(551)" VALUE 0x001E08B4 /* @ECU_Address@FPrm_latch@0x021BB89C@ */ ECIPP_ALIGNMENT_FLOAT32_IEEE 10000000000 Compu_IDENTITY -10000000000 10000000000 PHYS_UNIT "ms" /end CHARACTERISTIC
/begin CHARACTERISTIC FPfl_J1939_PGN_tout9 "FPrm_latch(552)" VALUE 0x001E08B8 /* @ECU_Address@FPrm_latch@0x021BB8A0@ */ ECIPP_ALIGNMENT_FLOAT32_IEEE 10000000000 Compu_IDENTITY -10000000000 10000000000 PHYS_UNIT "ms" /end CHARACTERISTIC
/begin CHARACTERISTIC FPfl_J1939_RS_err_loss "FPrm_latch(661)" VALUE 0x001E0A6C /* @ECU_Address@FPrm_latch@0x021BBA54@ */ ECIPP_ALIGNMENT_FLOAT32_IEEE 10000000000 Compu_IDENTITY -10000000000 10000000000 PHYS_UNIT "ms" /end CHARACTERISTIC
/begin CHARACTERISTIC FPfl_J1939_RSsetpt_loss "FPrm_latch(454)" VALUE 0x001E0730 /* @ECU_Address@FPrm_latch@0x021BB718@ */ ECIPP_ALIGNMENT_FLOAT32_IEEE 10000000000 Compu_IDENTITY -10000000000 10000000000 PHYS_UNIT "ms" /end CHARACTERISTIC
/begin CHARACTERISTIC FPfl_J1939_Rx2Fail "FPrm_latch(221)" VALUE 0x001E038C /* @ECU_Address@FPrm_latch@0x021BB374@ */ ECIPP_ALIGNMENT_FLOAT32_IEEE 10000000000 Compu_IDENTITY -10000000000 10000000000 PHYS_UNIT "ms" /end CHARACTERISTIC
/begin CHARACTERISTIC FPfl_J1939_Rx3Fail "FPrm_latch(222)" VALUE 0x001E0390 /* @ECU_Address@FPrm_latch@0x021BB378@ */ ECIPP_ALIGNMENT_FLOAT32_IEEE 10000000000 Compu_IDENTITY -10000000000 10000000000 PHYS_UNIT "ms" /end CHARACTERISTIC
/begin CHARACTERISTIC FPfl_J1939_RxFail "FPrm_latch(115)" VALUE 0x001E01E4 /* @ECU_Address@FPrm_latch@0x021BB1CC@ */ ECIPP_ALIGNMENT_FLOAT32_IEEE 10000000000 Compu_IDENTITY -10000000000 10000000000 PHYS_UNIT "ms" /end CHARACTERISTIC
/begin CHARACTERISTIC FPfl_J1939_SD_rq "FPrm_latch(113)" VALUE 0x001E01DC /* @ECU_Address@FPrm_latch@0x021BB1C4@ */ ECIPP_ALIGNMENT_FLOAT32_IEEE 10000000000 Compu_IDENTITY -10000000000 10000000000 PHYS_UNIT "ms" /end CHARACTERISTIC
/begin CHARACTERISTIC FPfu_FPrly_coilshort "FPrm_unlatch(129)" VALUE 0x001E0D64 /* @ECU_Address@FPrm_unlatch@0x021BD204@ */ ECIPP_ALIGNMENT_FLOAT32_IEEE 10000000000 Compu_IDENTITY -10000000000 10000000000 PHYS_UNIT "samples" /end CHARACTERISTIC
/begin CHARACTERISTIC FPfu_FPrly_gndshort "FPrm_unlatch(127)" VALUE 0x001E0D5C /* @ECU_Address@FPrm_unlatch@0x021BD1FC@ */ ECIPP_ALIGNMENT_FLOAT32_IEEE 10000000000 Compu_IDENTITY -10000000000 10000000000 PHYS_UNIT "samples" /end CHARACTERISTIC
/begin CHARACTERISTIC FPfu_FSO_post_TPS_phi_hi "FPrm_unlatch(687)" VALUE 0x001E161C /* @ECU_Address@FPrm_unlatch@0x021BDABC@ */ ECIPP_ALIGNMENT_FLOAT32_IEEE 10000000000 Compu_IDENTITY -10000000000 10000000000 PHYS_UNIT "samples" /end CHARACTERISTIC
/begin CHARACTERISTIC FPfu_FSO_TPS_phi_hi "FPrm_unlatch(632)" VALUE 0x001E1540 /* @ECU_Address@FPrm_unlatch@0x021BD9E0@ */ ECIPP_ALIGNMENT_FLOAT32_IEEE 10000000000 Compu_IDENTITY -10000000000 10000000000 PHYS_UNIT "ms" /end CHARACTERISTIC
/begin CHARACTERISTIC FPfu_FT_maxv "FPrm_unlatch(106)" VALUE 0x001E0D08 /* @ECU_Address@FPrm_unlatch@0x021BD1A8@ */ ECIPP_ALIGNMENT_FLOAT32_IEEE 10000000000 Compu_IDENTITY -10000000000 10000000000 PHYS_UNIT "ms" /end CHARACTERISTIC
/begin CHARACTERISTIC FPfu_FT_minv "FPrm_unlatch(107)" VALUE 0x001E0D0C /* @ECU_Address@FPrm_unlatch@0x021BD1AC@ */ ECIPP_ALIGNMENT_FLOAT32_IEEE 10000000000 Compu_IDENTITY -10000000000 10000000000 PHYS_UNIT "ms" /end CHARACTERISTIC
/begin CHARACTERISTIC FPfu_FTgasf_maxv "FPrm_unlatch(171)" VALUE 0x001E0E0C /* @ECU_Address@FPrm_unlatch@0x021BD2AC@ */ ECIPP_ALIGNMENT_FLOAT32_IEEE 10000000000 Compu_IDENTITY -10000000000 10000000000 PHYS_UNIT "ms" /end CHARACTERISTIC
/begin CHARACTERISTIC FPfu_FTgasf_minv "FPrm_unlatch(172)" VALUE 0x001E0E10 /* @ECU_Address@FPrm_unlatch@0x021BD2B0@ */ ECIPP_ALIGNMENT_FLOAT32_IEEE 10000000000 Compu_IDENTITY -10000000000 10000000000 PHYS_UNIT "ms" /end CHARACTERISTIC
/begin CHARACTERISTIC FPfu_GLOW_unit_fail "FPrm_unlatch(382)" VALUE 0x001E1158 /* @ECU_Address@FPrm_unlatch@0x021BD5F8@ */ ECIPP_ALIGNMENT_FLOAT32_IEEE 10000000000 Compu_IDENTITY -10000000000 10000000000 PHYS_UNIT "ms" /end CHARACTERISTIC
/begin CHARACTERISTIC FPfu_GLOW1_open "FPrm_unlatch(380)" VALUE 0x001E1150 /* @ECU_Address@FPrm_unlatch@0x021BD5F0@ */ ECIPP_ALIGNMENT_FLOAT32_IEEE 10000000000 Compu_IDENTITY -10000000000 10000000000 PHYS_UNIT "ms" /end CHARACTERISTIC
/begin CHARACTERISTIC FPfu_GLOW1_short "FPrm_unlatch(381)" VALUE 0x001E1154 /* @ECU_Address@FPrm_unlatch@0x021BD5F4@ */ ECIPP_ALIGNMENT_FLOAT32_IEEE 10000000000 Compu_IDENTITY -10000000000 10000000000 PHYS_UNIT "ms" /end CHARACTERISTIC
/begin CHARACTERISTIC FPfu_gov_ntrlock_fail "FPrm_unlatch(36)" VALUE 0x001E0BF0 /* @ECU_Address@FPrm_unlatch@0x021BD090@ */ ECIPP_ALIGNMENT_FLOAT32_IEEE 10000000000 Compu_IDENTITY -10000000000 10000000000 PHYS_UNIT "ms" /end CHARACTERISTIC
/begin CHARACTERISTIC FPfu_gyro_x_max "FPrm_unlatch(538)" VALUE 0x001E13C8 /* @ECU_Address@FPrm_unlatch@0x021BD868@ */ ECIPP_ALIGNMENT_FLOAT32_IEEE 10000000000 Compu_IDENTITY -10000000000 10000000000 PHYS_UNIT "ms" /end CHARACTERISTIC
/begin CHARACTERISTIC FPfu_gyro_x_min "FPrm_unlatch(539)" VALUE 0x001E13CC /* @ECU_Address@FPrm_unlatch@0x021BD86C@ */ ECIPP_ALIGNMENT_FLOAT32_IEEE 10000000000 Compu_IDENTITY -10000000000 10000000000 PHYS_UNIT "ms" /end CHARACTERISTIC
/begin CHARACTERISTIC FPfu_gyro_y_max "FPrm_unlatch(540)" VALUE 0x001E13D0 /* @ECU_Address@FPrm_unlatch@0x021BD870@ */ ECIPP_ALIGNMENT_FLOAT32_IEEE 10000000000 Compu_IDENTITY -10000000000 10000000000 PHYS_UNIT "ms" /end CHARACTERISTIC
/begin CHARACTERISTIC FPfu_gyro_y_min "FPrm_unlatch(541)" VALUE 0x001E13D4 /* @ECU_Address@FPrm_unlatch@0x021BD874@ */ ECIPP_ALIGNMENT_FLOAT32_IEEE 10000000000 Compu_IDENTITY -10000000000 10000000000 PHYS_UNIT "ms" /end CHARACTERISTIC
/begin CHARACTERISTIC FPfu_gyro_z_max "FPrm_unlatch(542)" VALUE 0x001E13D8 /* @ECU_Address@FPrm_unlatch@0x021BD878@ */ ECIPP_ALIGNMENT_FLOAT32_IEEE 10000000000 Compu_IDENTITY -10000000000 10000000000 PHYS_UNIT "ms" /end CHARACTERISTIC
/begin CHARACTERISTIC FPfu_gyro_z_min "FPrm_unlatch(543)" VALUE 0x001E13DC /* @ECU_Address@FPrm_unlatch@0x021BD87C@ */ ECIPP_ALIGNMENT_FLOAT32_IEEE 10000000000 Compu_IDENTITY -10000000000 10000000000 PHYS_UNIT "ms" /end CHARACTERISTIC
/begin CHARACTERISTIC FPfu_HBA_I_max "FPrm_unlatch(398)" VALUE 0x001E1198 /* @ECU_Address@FPrm_unlatch@0x021BD638@ */ ECIPP_ALIGNMENT_FLOAT32_IEEE 10000000000 Compu_IDENTITY -10000000000 10000000000 PHYS_UNIT "ms" /end CHARACTERISTIC
/begin CHARACTERISTIC FPfu_HBB_I_max "FPrm_unlatch(399)" VALUE 0x001E119C /* @ECU_Address@FPrm_unlatch@0x021BD63C@ */ ECIPP_ALIGNMENT_FLOAT32_IEEE 10000000000 Compu_IDENTITY -10000000000 10000000000 PHYS_UNIT "ms" /end CHARACTERISTIC
/begin CHARACTERISTIC FPfu_HiDiagTemp "FPrm_unlatch(482)" VALUE 0x001E12E8 /* @ECU_Address@FPrm_unlatch@0x021BD788@ */ ECIPP_ALIGNMENT_FLOAT32_IEEE 10000000000 Compu_IDENTITY -10000000000 10000000000 PHYS_UNIT "ms" /end CHARACTERISTIC
/begin CHARACTERISTIC FPfu_HWID_fail "FPrm_unlatch(227)" VALUE 0x001E0EEC /* @ECU_Address@FPrm_unlatch@0x021BD38C@ */ ECIPP_ALIGNMENT_FLOAT32_IEEE 10000000000 Compu_IDENTITY -10000000000 10000000000 PHYS_UNIT "ms" /end CHARACTERISTIC
/begin CHARACTERISTIC FPfu_IAC_gndshort "FPrm_unlatch(116)" VALUE 0x001E0D30 /* @ECU_Address@FPrm_unlatch@0x021BD1D0@ */ ECIPP_ALIGNMENT_FLOAT32_IEEE 10000000000 Compu_IDENTITY -10000000000 10000000000 PHYS_UNIT "samples" /end CHARACTERISTIC
/begin CHARACTERISTIC FPfu_IAC_openshort "FPrm_unlatch(117)" VALUE 0x001E0D34 /* @ECU_Address@FPrm_unlatch@0x021BD1D4@ */ ECIPP_ALIGNMENT_FLOAT32_IEEE 10000000000 Compu_IDENTITY -10000000000 10000000000 PHYS_UNIT "samples" /end CHARACTERISTIC
/begin CHARACTERISTIC FPfu_IAT_HiExp "FPrm_unlatch(8)" VALUE 0x001E0B80 /* @ECU_Address@FPrm_unlatch@0x021BD020@ */ ECIPP_ALIGNMENT_FLOAT32_IEEE 10000000000 Compu_IDENTITY -10000000000 10000000000 PHYS_UNIT "ms" /end CHARACTERISTIC
/begin CHARACTERISTIC FPfu_IAT_HiExp2 "FPrm_unlatch(9)" VALUE 0x001E0B84 /* @ECU_Address@FPrm_unlatch@0x021BD024@ */ ECIPP_ALIGNMENT_FLOAT32_IEEE 10000000000 Compu_IDENTITY -10000000000 10000000000 PHYS_UNIT "ms" /end CHARACTERISTIC
/begin CHARACTERISTIC FPfu_IAT_maxv "FPrm_unlatch(6)" VALUE 0x001E0B78 /* @ECU_Address@FPrm_unlatch@0x021BD018@ */ ECIPP_ALIGNMENT_FLOAT32_IEEE 10000000000 Compu_IDENTITY -10000000000 10000000000 PHYS_UNIT "ms" /end CHARACTERISTIC
/begin CHARACTERISTIC FPfu_IAT_minv "FPrm_unlatch(7)" VALUE 0x001E0B7C /* @ECU_Address@FPrm_unlatch@0x021BD01C@ */ ECIPP_ALIGNMENT_FLOAT32_IEEE 10000000000 Compu_IDENTITY -10000000000 10000000000 PHYS_UNIT "ms" /end CHARACTERISTIC
/begin CHARACTERISTIC FPfu_IBF_detected "FPrm_unlatch(688)" VALUE 0x001E1620 /* @ECU_Address@FPrm_unlatch@0x021BDAC0@ */ ECIPP_ALIGNMENT_FLOAT32_IEEE 10000000000 Compu_IDENTITY -10000000000 10000000000 PHYS_UNIT "ms" /end CHARACTERISTIC
/begin CHARACTERISTIC FPfu_ICam_maxerr "FPrm_unlatch(210)" VALUE 0x001E0EA8 /* @ECU_Address@FPrm_unlatch@0x021BD348@ */ ECIPP_ALIGNMENT_FLOAT32_IEEE 10000000000 Compu_IDENTITY -10000000000 10000000000 PHYS_UNIT "ms" /end CHARACTERISTIC
/begin CHARACTERISTIC FPfu_ICAVD1_mis "FPrm_unlatch(195)" VALUE 0x001E0E6C /* @ECU_Address@FPrm_unlatch@0x021BD30C@ */ ECIPP_ALIGNMENT_FLOAT32_IEEE 10000000000 Compu_IDENTITY -10000000000 10000000000 PHYS_UNIT "ms" /end CHARACTERISTIC
/begin CHARACTERISTIC FPfu_ICAVD1_miscat "FPrm_unlatch(196)" VALUE 0x001E0E70 /* @ECU_Address@FPrm_unlatch@0x021BD310@ */ ECIPP_ALIGNMENT_FLOAT32_IEEE 10000000000 Compu_IDENTITY -10000000000 10000000000 PHYS_UNIT "ms" /end CHARACTERISTIC
/begin CHARACTERISTIC FPfu_ICCOT_hi "FPrm_unlatch(690)" VALUE 0x001E1628 /* @ECU_Address@FPrm_unlatch@0x021BDAC8@ */ ECIPP_ALIGNMENT_FLOAT32_IEEE 10000000000 Compu_IDENTITY -10000000000 10000000000 PHYS_UNIT "ms" /end CHARACTERISTIC
/begin CHARACTERISTIC FPfu_Idle_SD "FPrm_unlatch(484)" VALUE 0x001E12F0 /* @ECU_Address@FPrm_unlatch@0x021BD790@ */ ECIPP_ALIGNMENT_FLOAT32_IEEE 10000000000 Compu_IDENTITY -10000000000 10000000000 PHYS_UNIT "ms" /end CHARACTERISTIC
/begin CHARACTERISTIC FPfu_imu_general "FPrm_unlatch(529)" VALUE 0x001E13A4 /* @ECU_Address@FPrm_unlatch@0x021BD844@ */ ECIPP_ALIGNMENT_FLOAT32_IEEE 10000000000 Compu_IDENTITY -10000000000 10000000000 PHYS_UNIT "samples" /end CHARACTERISTIC
/begin CHARACTERISTIC FPfu_imu_temp_max "FPrm_unlatch(530)" VALUE 0x001E13A8 /* @ECU_Address@FPrm_unlatch@0x021BD848@ */ ECIPP_ALIGNMENT_FLOAT32_IEEE 10000000000 Compu_IDENTITY -10000000000 10000000000 PHYS_UNIT "ms" /end CHARACTERISTIC
/begin CHARACTERISTIC FPfu_imu_temp_min "FPrm_unlatch(531)" VALUE 0x001E13AC /* @ECU_Address@FPrm_unlatch@0x021BD84C@ */ ECIPP_ALIGNMENT_FLOAT32_IEEE 10000000000 Compu_IDENTITY -10000000000 10000000000 PHYS_UNIT "ms" /end CHARACTERISTIC
/begin CHARACTERISTIC FPfu_IMVD_Ifb_hi "FPrm_unlatch(437)" VALUE 0x001E1234 /* @ECU_Address@FPrm_unlatch@0x021BD6D4@ */ ECIPP_ALIGNMENT_FLOAT32_IEEE 10000000000 Compu_IDENTITY -10000000000 10000000000 PHYS_UNIT "samples" /end CHARACTERISTIC
/begin CHARACTERISTIC FPfu_IMVD_Ifb_lo "FPrm_unlatch(436)" VALUE 0x001E1230 /* @ECU_Address@FPrm_unlatch@0x021BD6D0@ */ ECIPP_ALIGNMENT_FLOAT32_IEEE 10000000000 Compu_IDENTITY -10000000000 10000000000 PHYS_UNIT "samples" /end CHARACTERISTIC
/begin CHARACTERISTIC FPfu_INJD_boost_lo "FPrm_unlatch(434)" VALUE 0x001E1228 /* @ECU_Address@FPrm_unlatch@0x021BD6C8@ */ ECIPP_ALIGNMENT_FLOAT32_IEEE 10000000000 Compu_IDENTITY -10000000000 10000000000 PHYS_UNIT "samples" /end CHARACTERISTIC
/begin CHARACTERISTIC FPfu_INJD_HS_Ihi "FPrm_unlatch(432)" VALUE 0x001E1220 /* @ECU_Address@FPrm_unlatch@0x021BD6C0@ */ ECIPP_ALIGNMENT_FLOAT32_IEEE 10000000000 Compu_IDENTITY -10000000000 10000000000 PHYS_UNIT "samples" /end CHARACTERISTIC
/begin CHARACTERISTIC FPfu_INJD_HW_int "FPrm_unlatch(435)" VALUE 0x001E122C /* @ECU_Address@FPrm_unlatch@0x021BD6CC@ */ ECIPP_ALIGNMENT_FLOAT32_IEEE 10000000000 Compu_IDENTITY -10000000000 10000000000 PHYS_UNIT "samples" /end CHARACTERISTIC
/begin CHARACTERISTIC FPfu_INJD_LS_Ihi "FPrm_unlatch(433)" VALUE 0x001E1224 /* @ECU_Address@FPrm_unlatch@0x021BD6C4@ */ ECIPP_ALIGNMENT_FLOAT32_IEEE 10000000000 Compu_IDENTITY -10000000000 10000000000 PHYS_UNIT "samples" /end CHARACTERISTIC
/begin CHARACTERISTIC FPfu_INJD_off_lo "FPrm_unlatch(53)" VALUE 0x001E0C34 /* @ECU_Address@FPrm_unlatch@0x021BD0D4@ */ ECIPP_ALIGNMENT_FLOAT32_IEEE 10000000000 Compu_IDENTITY -10000000000 10000000000 PHYS_UNIT "samples" /end CHARACTERISTIC
/begin CHARACTERISTIC FPfu_INJD_on_hi "FPrm_unlatch(54)" VALUE 0x001E0C38 /* @ECU_Address@FPrm_unlatch@0x021BD0D8@ */ ECIPP_ALIGNMENT_FLOAT32_IEEE 10000000000 Compu_IDENTITY -10000000000 10000000000 PHYS_UNIT "samples" /end CHARACTERISTIC
/begin CHARACTERISTIC FPfu_intby_poserr "FPrm_unlatch(691)" VALUE 0x001E162C /* @ECU_Address@FPrm_unlatch@0x021BDACC@ */ ECIPP_ALIGNMENT_FLOAT32_IEEE 10000000000 Compu_IDENTITY -10000000000 10000000000 PHYS_UNIT "ms" /end CHARACTERISTIC
/begin CHARACTERISTIC FPfu_interrupt "FPrm_unlatch(68)" VALUE 0x001E0C70 /* @ECU_Address@FPrm_unlatch@0x021BD110@ */ ECIPP_ALIGNMENT_FLOAT32_IEEE 10000000000 Compu_IDENTITY -10000000000 10000000000 PHYS_UNIT "ms" /end CHARACTERISTIC
/begin CHARACTERISTIC FPfu_IRV_CL_OOA "FPrm_unlatch(696)" VALUE 0x001E1640 /* @ECU_Address@FPrm_unlatch@0x021BDAE0@ */ ECIPP_ALIGNMENT_FLOAT32_IEEE 10000000000 Compu_IDENTITY -10000000000 10000000000 PHYS_UNIT "ms" /end CHARACTERISTIC
/begin CHARACTERISTIC FPfu_J1939_AAT_err_loss "FPrm_unlatch(662)" VALUE 0x001E15B8 /* @ECU_Address@FPrm_unlatch@0x021BDA58@ */ ECIPP_ALIGNMENT_FLOAT32_IEEE 10000000000 Compu_IDENTITY -10000000000 10000000000 PHYS_UNIT "ms" /end CHARACTERISTIC
/begin CHARACTERISTIC FPfu_J1939_addr2Fail "FPrm_unlatch(223)" VALUE 0x001E0EDC /* @ECU_Address@FPrm_unlatch@0x021BD37C@ */ ECIPP_ALIGNMENT_FLOAT32_IEEE 10000000000 Compu_IDENTITY -10000000000 10000000000 PHYS_UNIT "ms" /end CHARACTERISTIC
/begin CHARACTERISTIC FPfu_J1939_addr3Fail "FPrm_unlatch(224)" VALUE 0x001E0EE0 /* @ECU_Address@FPrm_unlatch@0x021BD380@ */ ECIPP_ALIGNMENT_FLOAT32_IEEE 10000000000 Compu_IDENTITY -10000000000 10000000000 PHYS_UNIT "ms" /end CHARACTERISTIC
/begin CHARACTERISTIC FPfu_J1939_addrFail "FPrm_unlatch(146)" VALUE 0x001E0DA8 /* @ECU_Address@FPrm_unlatch@0x021BD248@ */ ECIPP_ALIGNMENT_FLOAT32_IEEE 10000000000 Compu_IDENTITY -10000000000 10000000000 PHYS_UNIT "ms" /end CHARACTERISTIC
/begin CHARACTERISTIC FPfu_J1939_ETC_loss "FPrm_unlatch(175)" VALUE 0x001E0E1C /* @ECU_Address@FPrm_unlatch@0x021BD2BC@ */ ECIPP_ALIGNMENT_FLOAT32_IEEE 10000000000 Compu_IDENTITY -10000000000 10000000000 PHYS_UNIT "ms" /end CHARACTERISTIC
/begin CHARACTERISTIC FPfu_J1939_ETC_loss2 "FPrm_unlatch(197)" VALUE 0x001E0E74 /* @ECU_Address@FPrm_unlatch@0x021BD314@ */ ECIPP_ALIGNMENT_FLOAT32_IEEE 10000000000 Compu_IDENTITY -10000000000 10000000000 PHYS_UNIT "ms" /end CHARACTERISTIC
/begin CHARACTERISTIC FPfu_J1939_PGN_tout "FPrm_unlatch(544)" VALUE 0x001E13E0 /* @ECU_Address@FPrm_unlatch@0x021BD880@ */ ECIPP_ALIGNMENT_FLOAT32_IEEE 10000000000 Compu_IDENTITY -10000000000 10000000000 PHYS_UNIT "ms" /end CHARACTERISTIC
/begin CHARACTERISTIC FPfu_J1939_PGN_tout10 "FPrm_unlatch(553)" VALUE 0x001E1404 /* @ECU_Address@FPrm_unlatch@0x021BD8A4@ */ ECIPP_ALIGNMENT_FLOAT32_IEEE 10000000000 Compu_IDENTITY -10000000000 10000000000 PHYS_UNIT "ms" /end CHARACTERISTIC
/begin CHARACTERISTIC FPfu_J1939_PGN_tout2 "FPrm_unlatch(545)" VALUE 0x001E13E4 /* @ECU_Address@FPrm_unlatch@0x021BD884@ */ ECIPP_ALIGNMENT_FLOAT32_IEEE 10000000000 Compu_IDENTITY -10000000000 10000000000 PHYS_UNIT "ms" /end CHARACTERISTIC
/begin CHARACTERISTIC FPfu_J1939_PGN_tout3 "FPrm_unlatch(546)" VALUE 0x001E13E8 /* @ECU_Address@FPrm_unlatch@0x021BD888@ */ ECIPP_ALIGNMENT_FLOAT32_IEEE 10000000000 Compu_IDENTITY -10000000000 10000000000 PHYS_UNIT "ms" /end CHARACTERISTIC
/begin CHARACTERISTIC FPfu_J1939_PGN_tout4 "FPrm_unlatch(547)" VALUE 0x001E13EC /* @ECU_Address@FPrm_unlatch@0x021BD88C@ */ ECIPP_ALIGNMENT_FLOAT32_IEEE 10000000000 Compu_IDENTITY -10000000000 10000000000 PHYS_UNIT "ms" /end CHARACTERISTIC
/begin CHARACTERISTIC FPfu_J1939_PGN_tout5 "FPrm_unlatch(548)" VALUE 0x001E13F0 /* @ECU_Address@FPrm_unlatch@0x021BD890@ */ ECIPP_ALIGNMENT_FLOAT32_IEEE 10000000000 Compu_IDENTITY -10000000000 10000000000 PHYS_UNIT "ms" /end CHARACTERISTIC
/begin CHARACTERISTIC FPfu_J1939_PGN_tout6 "FPrm_unlatch(549)" VALUE 0x001E13F4 /* @ECU_Address@FPrm_unlatch@0x021BD894@ */ ECIPP_ALIGNMENT_FLOAT32_IEEE 10000000000 Compu_IDENTITY -10000000000 10000000000 PHYS_UNIT "ms" /end CHARACTERISTIC
/begin CHARACTERISTIC FPfu_J1939_PGN_tout7 "FPrm_unlatch(550)" VALUE 0x001E13F8 /* @ECU_Address@FPrm_unlatch@0x021BD898@ */ ECIPP_ALIGNMENT_FLOAT32_IEEE 10000000000 Compu_IDENTITY -10000000000 10000000000 PHYS_UNIT "ms" /end CHARACTERISTIC
/begin CHARACTERISTIC FPfu_J1939_PGN_tout8 "FPrm_unlatch(551)" VALUE 0x001E13FC /* @ECU_Address@FPrm_unlatch@0x021BD89C@ */ ECIPP_ALIGNMENT_FLOAT32_IEEE 10000000000 Compu_IDENTITY -10000000000 10000000000 PHYS_UNIT "ms" /end CHARACTERISTIC
/begin CHARACTERISTIC FPfu_J1939_PGN_tout9 "FPrm_unlatch(552)" VALUE 0x001E1400 /* @ECU_Address@FPrm_unlatch@0x021BD8A0@ */ ECIPP_ALIGNMENT_FLOAT32_IEEE 10000000000 Compu_IDENTITY -10000000000 10000000000 PHYS_UNIT "ms" /end CHARACTERISTIC
/begin CHARACTERISTIC FPfu_J1939_RS_err_loss "FPrm_unlatch(661)" VALUE 0x001E15B4 /* @ECU_Address@FPrm_unlatch@0x021BDA54@ */ ECIPP_ALIGNMENT_FLOAT32_IEEE 10000000000 Compu_IDENTITY -10000000000 10000000000 PHYS_UNIT "ms" /end CHARACTERISTIC
/begin CHARACTERISTIC FPfu_J1939_RSsetpt_loss "FPrm_unlatch(454)" VALUE 0x001E1278 /* @ECU_Address@FPrm_unlatch@0x021BD718@ */ ECIPP_ALIGNMENT_FLOAT32_IEEE 10000000000 Compu_IDENTITY -10000000000 10000000000 PHYS_UNIT "ms" /end CHARACTERISTIC
/begin CHARACTERISTIC FPfu_J1939_Rx2Fail "FPrm_unlatch(221)" VALUE 0x001E0ED4 /* @ECU_Address@FPrm_unlatch@0x021BD374@ */ ECIPP_ALIGNMENT_FLOAT32_IEEE 10000000000 Compu_IDENTITY -10000000000 10000000000 PHYS_UNIT "ms" /end CHARACTERISTIC
/begin CHARACTERISTIC FPfu_J1939_Rx3Fail "FPrm_unlatch(222)" VALUE 0x001E0ED8 /* @ECU_Address@FPrm_unlatch@0x021BD378@ */ ECIPP_ALIGNMENT_FLOAT32_IEEE 10000000000 Compu_IDENTITY -10000000000 10000000000 PHYS_UNIT "ms" /end CHARACTERISTIC
/begin CHARACTERISTIC FPfu_J1939_RxFail "FPrm_unlatch(115)" VALUE 0x001E0D2C /* @ECU_Address@FPrm_unlatch@0x021BD1CC@ */ ECIPP_ALIGNMENT_FLOAT32_IEEE 10000000000 Compu_IDENTITY -10000000000 10000000000 PHYS_UNIT "ms" /end CHARACTERISTIC
/begin CHARACTERISTIC FPfu_J1939_SD_rq "FPrm_unlatch(113)" VALUE 0x001E0D24 /* @ECU_Address@FPrm_unlatch@0x021BD1C4@ */ ECIPP_ALIGNMENT_FLOAT32_IEEE 10000000000 Compu_IDENTITY -10000000000 10000000000 PHYS_UNIT "ms" /end CHARACTERISTIC
/begin GROUP FPrly_coilshort_EC_Fault "Fuel pump relay coil short to power"
 /begin REF_CHARACTERISTIC FCdc4_FPrly_coilshort FCdtc_FPrly_coilshort FCfmi_FPrly_coilshort FCftb_FPrly_coilshort FCspn_FPrly_coilshort FPfl_FPrly_coilshort FPfu_FPrly_coilshort FPnd_FPrly_coilshort FPsvr_FPrly_coilshort FPsw_ext1_FPrly_coilshort FPsw_FPrly_coilshort /end REF_CHARACTERISTIC
/end GROUP
/begin GROUP FPrly_gndshort_EC_Fault "Fuel pump relay control ground short"
 /begin REF_CHARACTERISTIC FCdc4_FPrly_gndshort FCdtc_FPrly_gndshort FCfmi_FPrly_gndshort FCftb_FPrly_gndshort FCspn_FPrly_gndshort FPfl_FPrly_gndshort FPfu_FPrly_gndshort FPnd_FPrly_gndshort FPsvr_FPrly_gndshort FPsw_ext1_FPrly_gndshort FPsw_FPrly_gndshort /end REF_CHARACTERISTIC
/end GROUP
/begin GROUP FSO_post_TPS_phi_hi_EC_Fault "Failed to reach FSO post throttle open UEGO limit"
 /begin REF_CHARACTERISTIC FCdc4_FSO_post_TPS_phi_hi FCdtc_FSO_post_TPS_phi_hi FCfmi_FSO_post_TPS_phi_hi FCftb_FSO_post_TPS_phi_hi FCspn_FSO_post_TPS_phi_hi FPfl_FSO_post_TPS_phi_hi FPfu_FSO_post_TPS_phi_hi FPnd_FSO_post_TPS_phi_hi FPsvr_FSO_post_TPS_phi_hi FPsw_ext1_FSO_post_TPS_phi_hi FPsw_FSO_post_TPS_phi_hi /end REF_CHARACTERISTIC
/end GROUP
/begin GROUP FSO_TPS_phi_hi_EC_Fault "Failed to reach FSO throttle open UEGO limit"
 /begin REF_CHARACTERISTIC FCdc4_FSO_TPS_phi_hi FCdtc_FSO_TPS_phi_hi FCfmi_FSO_TPS_phi_hi FCftb_FSO_TPS_phi_hi FCspn_FSO_TPS_phi_hi FPfl_FSO_TPS_phi_hi FPfu_FSO_TPS_phi_hi FPnd_FSO_TPS_phi_hi FPsvr_FSO_TPS_phi_hi FPsw_ext1_FSO_TPS_phi_hi FPsw_FSO_TPS_phi_hi /end REF_CHARACTERISTIC
/end GROUP
/begin GROUP FT_maxv_EC_Fault "FT gasoline high"
 /begin REF_CHARACTERISTIC FCdc4_FT_maxv FCdtc_FT_maxv FCfmi_FT_maxv FCftb_FT_maxv FCspn_FT_maxv FPfl_FT_maxv FPfu_FT_maxv FPnd_FT_maxv FPsvr_FT_maxv FPsw_ext1_FT_maxv FPsw_FT_maxv /end REF_CHARACTERISTIC
/end GROUP
/begin GROUP FT_minv_EC_Fault "FT gasoline low"
 /begin REF_CHARACTERISTIC FCdc4_FT_minv FCdtc_FT_minv FCfmi_FT_minv FCftb_FT_minv FCspn_FT_minv FPfl_FT_minv FPfu_FT_minv FPnd_FT_minv FPsvr_FT_minv FPsw_ext1_FT_minv FPsw_FT_minv /end REF_CHARACTERISTIC
/end GROUP
/begin GROUP FTgasf_maxv_EC_Fault "FT gaseous fuel high"
 /begin REF_CHARACTERISTIC FCdc4_FTgasf_maxv FCdtc_FTgasf_maxv FCfmi_FTgasf_maxv FCftb_FTgasf_maxv FCspn_FTgasf_maxv FPfl_FTgasf_maxv FPfu_FTgasf_maxv FPnd_FTgasf_maxv FPsvr_FTgasf_maxv FPsw_ext1_FTgasf_maxv FPsw_FTgasf_maxv /end REF_CHARACTERISTIC
/end GROUP
/begin GROUP FTgasf_minv_EC_Fault "FT gaseous fuel low"
 /begin REF_CHARACTERISTIC FCdc4_FTgasf_minv FCdtc_FTgasf_minv FCfmi_FTgasf_minv FCftb_FTgasf_minv FCspn_FTgasf_minv FPfl_FTgasf_minv FPfu_FTgasf_minv FPnd_FTgasf_minv FPsvr_FTgasf_minv FPsw_ext1_FTgasf_minv FPsw_FTgasf_minv /end REF_CHARACTERISTIC
/end GROUP
/begin GROUP GLOW_unit_fail_EC_Fault "Glow Plug Control Unit Failure"
 /begin REF_CHARACTERISTIC FCdc4_GLOW_unit_fail FCdtc_GLOW_unit_fail FCfmi_GLOW_unit_fail FCftb_GLOW_unit_fail FCspn_GLOW_unit_fail FPfl_GLOW_unit_fail FPfu_GLOW_unit_fail FPnd_GLOW_unit_fail FPsvr_GLOW_unit_fail FPsw_ext1_GLOW_unit_fail FPsw_GLOW_unit_fail /end REF_CHARACTERISTIC
/end GROUP
/begin GROUP GLOW1_open_EC_Fault "Glow Plug Open/Power Short"
 /begin REF_CHARACTERISTIC FCdc4_GLOW1_open FCdtc_GLOW1_open FCfmi_GLOW1_open FCftb_GLOW1_open FCspn_GLOW1_open FPfl_GLOW1_open FPfu_GLOW1_open FPnd_GLOW1_open FPsvr_GLOW1_open FPsw_ext1_GLOW1_open FPsw_GLOW1_open /end REF_CHARACTERISTIC
/end GROUP
/begin GROUP GLOW1_short_EC_Fault "Glow Plug Short to Ground"
 /begin REF_CHARACTERISTIC FCdc4_GLOW1_short FCdtc_GLOW1_short FCfmi_GLOW1_short FCftb_GLOW1_short FCspn_GLOW1_short FPfl_GLOW1_short FPfu_GLOW1_short FPnd_GLOW1_short FPsvr_GLOW1_short FPsw_ext1_GLOW1_short FPsw_GLOW1_short /end REF_CHARACTERISTIC
/end GROUP
/begin GROUP gov_ntrlock_fail_EC_Fault "IVS/Brake/Trans-Park interlock failure"
 /begin REF_CHARACTERISTIC FCdc4_gov_ntrlock_fail FCdtc_gov_ntrlock_fail FCfmi_gov_ntrlock_fail FCftb_gov_ntrlock_fail FCspn_gov_ntrlock_fail FPfl_gov_ntrlock_fail FPfu_gov_ntrlock_fail FPnd_gov_ntrlock_fail FPsvr_gov_ntrlock_fail FPsw_ext1_gov_ntrlock_fail FPsw_gov_ntrlock_fail /end REF_CHARACTERISTIC
/end GROUP
/begin GROUP gyro_x_max_EC_Fault "Gyroscope X-axis out-of-range high"
 /begin REF_CHARACTERISTIC FCdc4_gyro_x_max FCdtc_gyro_x_max FCfmi_gyro_x_max FCftb_gyro_x_max FCspn_gyro_x_max FPfl_gyro_x_max FPfu_gyro_x_max FPnd_gyro_x_max FPsvr_gyro_x_max FPsw_ext1_gyro_x_max FPsw_gyro_x_max /end REF_CHARACTERISTIC
/end GROUP
/begin GROUP gyro_x_min_EC_Fault "Gyroscope X-axis out-of-range low"
 /begin REF_CHARACTERISTIC FCdc4_gyro_x_min FCdtc_gyro_x_min FCfmi_gyro_x_min FCftb_gyro_x_min FCspn_gyro_x_min FPfl_gyro_x_min FPfu_gyro_x_min FPnd_gyro_x_min FPsvr_gyro_x_min FPsw_ext1_gyro_x_min FPsw_gyro_x_min /end REF_CHARACTERISTIC
/end GROUP
/begin GROUP gyro_y_max_EC_Fault "Gyroscope Y-axis out-of-range high"
 /begin REF_CHARACTERISTIC FCdc4_gyro_y_max FCdtc_gyro_y_max FCfmi_gyro_y_max FCftb_gyro_y_max FCspn_gyro_y_max FPfl_gyro_y_max FPfu_gyro_y_max FPnd_gyro_y_max FPsvr_gyro_y_max FPsw_ext1_gyro_y_max FPsw_gyro_y_max /end REF_CHARACTERISTIC
/end GROUP
/begin GROUP gyro_y_min_EC_Fault "Gyroscope Y-axis out-of-range low"
 /begin REF_CHARACTERISTIC FCdc4_gyro_y_min FCdtc_gyro_y_min FCfmi_gyro_y_min FCftb_gyro_y_min FCspn_gyro_y_min FPfl_gyro_y_min FPfu_gyro_y_min FPnd_gyro_y_min FPsvr_gyro_y_min FPsw_ext1_gyro_y_min FPsw_gyro_y_min /end REF_CHARACTERISTIC
/end GROUP
/begin GROUP gyro_z_max_EC_Fault "Gyroscope Z-axis out-of-range high"
 /begin REF_CHARACTERISTIC FCdc4_gyro_z_max FCdtc_gyro_z_max FCfmi_gyro_z_max FCftb_gyro_z_max FCspn_gyro_z_max FPfl_gyro_z_max FPfu_gyro_z_max FPnd_gyro_z_max FPsvr_gyro_z_max FPsw_ext1_gyro_z_max FPsw_gyro_z_max /end REF_CHARACTERISTIC
/end GROUP
/begin GROUP gyro_z_min_EC_Fault "Gyroscope Z-axis out-of-range low"
 /begin REF_CHARACTERISTIC FCdc4_gyro_z_min FCdtc_gyro_z_min FCfmi_gyro_z_min FCftb_gyro_z_min FCspn_gyro_z_min FPfl_gyro_z_min FPfu_gyro_z_min FPnd_gyro_z_min FPsvr_gyro_z_min FPsw_ext1_gyro_z_min FPsw_gyro_z_min /end REF_CHARACTERISTIC
/end GROUP
/begin GROUP HBA_I_max_EC_Fault "HBA drive current high"
 /begin REF_CHARACTERISTIC FCdc4_HBA_I_max FCdtc_HBA_I_max FCfmi_HBA_I_max FCftb_HBA_I_max FCspn_HBA_I_max FPfl_HBA_I_max FPfu_HBA_I_max FPnd_HBA_I_max FPsvr_HBA_I_max FPsw_ext1_HBA_I_max FPsw_HBA_I_max /end REF_CHARACTERISTIC
/end GROUP
/begin GROUP HBB_I_max_EC_Fault "HBB drive current high"
 /begin REF_CHARACTERISTIC FCdc4_HBB_I_max FCdtc_HBB_I_max FCfmi_HBB_I_max FCftb_HBB_I_max FCspn_HBB_I_max FPfl_HBB_I_max FPfu_HBB_I_max FPnd_HBB_I_max FPsvr_HBB_I_max FPsw_ext1_HBB_I_max FPsw_HBB_I_max /end REF_CHARACTERISTIC
/end GROUP
/begin GROUP HiDiagTemp_EC_Fault "ECT too high to enable diagnostics"
 /begin REF_CHARACTERISTIC FCdc4_HiDiagTemp FCdtc_HiDiagTemp FCfmi_HiDiagTemp FCftb_HiDiagTemp FCspn_HiDiagTemp FPfl_HiDiagTemp FPfu_HiDiagTemp FPnd_HiDiagTemp FPsvr_HiDiagTemp FPsw_ext1_HiDiagTemp FPsw_HiDiagTemp /end REF_CHARACTERISTIC
/end GROUP
/begin GROUP HWID_fail_EC_Fault "Hardware ID Failure"
 /begin REF_CHARACTERISTIC FCdc4_HWID_fail FCdtc_HWID_fail FCfmi_HWID_fail FCftb_HWID_fail FCspn_HWID_fail FPfl_HWID_fail FPfu_HWID_fail FPnd_HWID_fail FPsvr_HWID_fail FPsw_ext1_HWID_fail FPsw_HWID_fail /end REF_CHARACTERISTIC
/end GROUP
/begin GROUP IAC_gndshort_EC_Fault "IAC ground short"
 /begin REF_CHARACTERISTIC FCdc4_IAC_gndshort FCdtc_IAC_gndshort FCfmi_IAC_gndshort FCftb_IAC_gndshort FCspn_IAC_gndshort FPfl_IAC_gndshort FPfu_IAC_gndshort FPnd_IAC_gndshort FPsvr_IAC_gndshort FPsw_ext1_IAC_gndshort FPsw_IAC_gndshort /end REF_CHARACTERISTIC
/end GROUP
/begin GROUP IAC_openshort_EC_Fault "IAC coil open/short"
 /begin REF_CHARACTERISTIC FCdc4_IAC_openshort FCdtc_IAC_openshort FCfmi_IAC_openshort FCftb_IAC_openshort FCspn_IAC_openshort FPfl_IAC_openshort FPfu_IAC_openshort FPnd_IAC_openshort FPsvr_IAC_openshort FPsw_ext1_IAC_openshort FPsw_IAC_openshort /end REF_CHARACTERISTIC
/end GROUP
/begin GROUP IAT_HiExp_EC_Fault "IAT higher than expected 1"
 /begin REF_CHARACTERISTIC FCdc4_IAT_HiExp FCdtc_IAT_HiExp FCfmi_IAT_HiExp FCftb_IAT_HiExp FCspn_IAT_HiExp FPfl_IAT_HiExp FPfu_IAT_HiExp FPnd_IAT_HiExp FPsvr_IAT_HiExp FPsw_ext1_IAT_HiExp FPsw_IAT_HiExp /end REF_CHARACTERISTIC
/end GROUP
/begin GROUP IAT_HiExp2_EC_Fault "IAT higher than expected 2"
 /begin REF_CHARACTERISTIC FCdc4_IAT_HiExp2 FCdtc_IAT_HiExp2 FCfmi_IAT_HiExp2 FCftb_IAT_HiExp2 FCspn_IAT_HiExp2 FPfl_IAT_HiExp2 FPfu_IAT_HiExp2 FPnd_IAT_HiExp2 FPsvr_IAT_HiExp2 FPsw_ext1_IAT_HiExp2 FPsw_IAT_HiExp2 /end REF_CHARACTERISTIC
/end GROUP
/begin GROUP IAT_maxv_EC_Fault "IAT high voltage"
 /begin REF_CHARACTERISTIC FCdc4_IAT_maxv FCdtc_IAT_maxv FCfmi_IAT_maxv FCftb_IAT_maxv FCspn_IAT_maxv FPfl_IAT_maxv FPfu_IAT_maxv FPnd_IAT_maxv FPsvr_IAT_maxv FPsw_ext1_IAT_maxv FPsw_IAT_maxv /end REF_CHARACTERISTIC
/end GROUP
/begin GROUP IAT_minv_EC_Fault "IAT low voltage"
 /begin REF_CHARACTERISTIC FCdc4_IAT_minv FCdtc_IAT_minv FCfmi_IAT_minv FCftb_IAT_minv FCspn_IAT_minv FPfl_IAT_minv FPfu_IAT_minv FPnd_IAT_minv FPsvr_IAT_minv FPsw_ext1_IAT_minv FPsw_IAT_minv /end REF_CHARACTERISTIC
/end GROUP
/begin GROUP IBF_detected_EC_Fault "Intake backfire detected"
 /begin REF_CHARACTERISTIC FCdc4_IBF_detected FCdtc_IBF_detected FCfmi_IBF_detected FCftb_IBF_detected FCspn_IBF_detected FPfl_IBF_detected FPfu_IBF_detected FPnd_IBF_detected FPsvr_IBF_detected FPsw_ext1_IBF_detected FPsw_IBF_detected /end REF_CHARACTERISTIC
/end GROUP
/begin GROUP ICam_maxerr_EC_Fault "Intake cam / distributor position"
 /begin REF_CHARACTERISTIC FCdc4_ICam_maxerr FCdtc_ICam_maxerr FCfmi_ICam_maxerr FCftb_ICam_maxerr FCspn_ICam_maxerr FPfl_ICam_maxerr FPfu_ICam_maxerr FPnd_ICam_maxerr FPsvr_ICam_maxerr FPsw_ext1_ICam_maxerr FPsw_ICam_maxerr /end REF_CHARACTERISTIC
/end GROUP
/begin GROUP ICAVD1_mis_EC_Fault "Misfire detected"
 /begin REF_CHARACTERISTIC FCdc4_ICAVD1_mis FCdtc_ICAVD1_mis FCfmi_ICAVD1_mis FCftb_ICAVD1_mis FCspn_ICAVD1_mis FPfl_ICAVD1_mis FPfu_ICAVD1_mis FPnd_ICAVD1_mis FPsvr_ICAVD1_mis FPsw_ext1_ICAVD1_mis FPsw_ICAVD1_mis /end REF_CHARACTERISTIC
/end GROUP
/begin GROUP ICAVD1_miscat_EC_Fault "Emissions/catalyst damaging misfire"
 /begin REF_CHARACTERISTIC FCdc4_ICAVD1_miscat FCdtc_ICAVD1_miscat FCfmi_ICAVD1_miscat FCftb_ICAVD1_miscat FCspn_ICAVD1_miscat FPfl_ICAVD1_miscat FPfu_ICAVD1_miscat FPnd_ICAVD1_miscat FPsvr_ICAVD1_miscat FPsw_ext1_ICAVD1_miscat FPsw_ICAVD1_miscat /end REF_CHARACTERISTIC
/end GROUP
/begin GROUP ICCOT_hi_EC_Fault "ICCOT temperature high"
 /begin REF_CHARACTERISTIC FCdc4_ICCOT_hi FCdtc_ICCOT_hi FCfmi_ICCOT_hi FCftb_ICCOT_hi FCspn_ICCOT_hi FPfl_ICCOT_hi FPfu_ICCOT_hi FPnd_ICCOT_hi FPsvr_ICCOT_hi FPsw_ext1_ICCOT_hi FPsw_ICCOT_hi /end REF_CHARACTERISTIC
/end GROUP
/begin GROUP Idle_SD_EC_Fault "Idle shutdown timer exceeded"
 /begin REF_CHARACTERISTIC FCdc4_Idle_SD FCdtc_Idle_SD FCfmi_Idle_SD FCftb_Idle_SD FCspn_Idle_SD FPfl_Idle_SD FPfu_Idle_SD FPnd_Idle_SD FPsvr_Idle_SD FPsw_ext1_Idle_SD FPsw_Idle_SD /end REF_CHARACTERISTIC
/end GROUP
/begin GROUP imu_general_EC_Fault "Inertial measurement unit general error"
 /begin REF_CHARACTERISTIC FCdc4_imu_general FCdtc_imu_general FCfmi_imu_general FCftb_imu_general FCspn_imu_general FPfl_imu_general FPfu_imu_general FPnd_imu_general FPsvr_imu_general FPsw_ext1_imu_general FPsw_imu_general /end REF_CHARACTERISTIC
/end GROUP
/begin GROUP imu_temp_max_EC_Fault "Inertial measurement unit temperature high"
 /begin REF_CHARACTERISTIC FCdc4_imu_temp_max FCdtc_imu_temp_max FCfmi_imu_temp_max FCftb_imu_temp_max FCspn_imu_temp_max FPfl_imu_temp_max FPfu_imu_temp_max FPnd_imu_temp_max FPsvr_imu_temp_max FPsw_ext1_imu_temp_max FPsw_imu_temp_max /end REF_CHARACTERISTIC
/end GROUP
/begin GROUP imu_temp_min_EC_Fault "Inertial measurement unit temperature low"
 /begin REF_CHARACTERISTIC FCdc4_imu_temp_min FCdtc_imu_temp_min FCfmi_imu_temp_min FCftb_imu_temp_min FCspn_imu_temp_min FPfl_imu_temp_min FPfu_imu_temp_min FPnd_imu_temp_min FPsvr_imu_temp_min FPsw_ext1_imu_temp_min FPsw_imu_temp_min /end REF_CHARACTERISTIC
/end GROUP
/begin GROUP IMVD_Ifb_hi_EC_Fault "IMV Coil Short or Short to Power"
 /begin REF_CHARACTERISTIC FCdc4_IMVD_Ifb_hi FCdtc_IMVD_Ifb_hi FCfmi_IMVD_Ifb_hi FCftb_IMVD_Ifb_hi FCspn_IMVD_Ifb_hi FPfl_IMVD_Ifb_hi FPfu_IMVD_Ifb_hi FPnd_IMVD_Ifb_hi FPsvr_IMVD_Ifb_hi FPsw_ext1_IMVD_Ifb_hi FPsw_IMVD_Ifb_hi /end REF_CHARACTERISTIC
/end GROUP
/begin GROUP IMVD_Ifb_lo_EC_Fault "IMV Loop Open or Short to Ground"
 /begin REF_CHARACTERISTIC FCdc4_IMVD_Ifb_lo FCdtc_IMVD_Ifb_lo FCfmi_IMVD_Ifb_lo FCftb_IMVD_Ifb_lo FCspn_IMVD_Ifb_lo FPfl_IMVD_Ifb_lo FPfu_IMVD_Ifb_lo FPnd_IMVD_Ifb_lo FPsvr_IMVD_Ifb_lo FPsw_ext1_IMVD_Ifb_lo FPsw_IMVD_Ifb_lo /end REF_CHARACTERISTIC
/end GROUP
/begin GROUP INJD_boost_lo_EC_Fault "CR Injection Bank Boost Voltage Low"
 /begin REF_CHARACTERISTIC FCdc4_INJD_boost_lo FCdtc_INJD_boost_lo FCfmi_INJD_boost_lo FCftb_INJD_boost_lo FCspn_INJD_boost_lo FPfl_INJD_boost_lo FPfu_INJD_boost_lo FPnd_INJD_boost_lo FPsvr_INJD_boost_lo FPsw_ext1_INJD_boost_lo FPsw_INJD_boost_lo /end REF_CHARACTERISTIC
/end GROUP
/begin GROUP INJD_HS_Ihi_EC_Fault "CR Injector High-Side Short to Ground"
 /begin REF_CHARACTERISTIC FCdc4_INJD_HS_Ihi FCdtc_INJD_HS_Ihi FCfmi_INJD_HS_Ihi FCftb_INJD_HS_Ihi FCspn_INJD_HS_Ihi FPfl_INJD_HS_Ihi FPfu_INJD_HS_Ihi FPnd_INJD_HS_Ihi FPsvr_INJD_HS_Ihi FPsw_ext1_INJD_HS_Ihi FPsw_INJD_HS_Ihi /end REF_CHARACTERISTIC
/end GROUP
/begin GROUP INJD_HW_int_EC_Fault "CR Injection Bank Internal Fault"
 /begin REF_CHARACTERISTIC FCdc4_INJD_HW_int FCdtc_INJD_HW_int FCfmi_INJD_HW_int FCftb_INJD_HW_int FCspn_INJD_HW_int FPfl_INJD_HW_int FPfu_INJD_HW_int FPnd_INJD_HW_int FPsvr_INJD_HW_int FPsw_ext1_INJD_HW_int FPsw_INJD_HW_int /end REF_CHARACTERISTIC
/end GROUP
/begin GROUP INJD_LS_Ihi_EC_Fault "CR Injector Low-Side Short to Power"
 /begin REF_CHARACTERISTIC FCdc4_INJD_LS_Ihi FCdtc_INJD_LS_Ihi FCfmi_INJD_LS_Ihi FCftb_INJD_LS_Ihi FCspn_INJD_LS_Ihi FPfl_INJD_LS_Ihi FPfu_INJD_LS_Ihi FPnd_INJD_LS_Ihi FPsvr_INJD_LS_Ihi FPsw_ext1_INJD_LS_Ihi FPsw_INJD_LS_Ihi /end REF_CHARACTERISTIC
/end GROUP
/begin GROUP INJD_off_lo_EC_Fault "Injector Loop Open or"
 /begin REF_CHARACTERISTIC FCdc4_INJD_off_lo FCdtc_INJD_off_lo FCfmi_INJD_off_lo FCftb_INJD_off_lo FCspn_INJD_off_lo FPfl_INJD_off_lo FPfu_INJD_off_lo FPnd_INJD_off_lo FPsvr_INJD_off_lo FPsw_ext1_INJD_off_lo FPsw_INJD_off_lo /end REF_CHARACTERISTIC
/end GROUP
/begin GROUP INJD_on_hi_EC_Fault "Injector Coil Shorted"
 /begin REF_CHARACTERISTIC FCdc4_INJD_on_hi FCdtc_INJD_on_hi FCfmi_INJD_on_hi FCftb_INJD_on_hi FCspn_INJD_on_hi FPfl_INJD_on_hi FPfu_INJD_on_hi FPnd_INJD_on_hi FPsvr_INJD_on_hi FPsw_ext1_INJD_on_hi FPsw_INJD_on_hi /end REF_CHARACTERISTIC
/end GROUP
/begin GROUP intby_poserr_EC_Fault "Unable to reach intercooler/EGR cooler split valve target position"
 /begin REF_CHARACTERISTIC FCdc4_intby_poserr FCdtc_intby_poserr FCfmi_intby_poserr FCftb_intby_poserr FCspn_intby_poserr FPfl_intby_poserr FPfu_intby_poserr FPnd_intby_poserr FPsvr_intby_poserr FPsw_ext1_intby_poserr FPsw_intby_poserr /end REF_CHARACTERISTIC
/end GROUP
/begin GROUP interrupt_EC_Fault "Invalid interrupt"
 /begin REF_CHARACTERISTIC FCdc4_interrupt FCdtc_interrupt FCfmi_interrupt FCftb_interrupt FCspn_interrupt FPfl_interrupt FPfu_interrupt FPnd_interrupt FPsvr_interrupt FPsw_ext1_interrupt FPsw_interrupt /end REF_CHARACTERISTIC
/end GROUP
/begin GROUP IRV_CL_OOA_EC_Fault "IRV closed loop authority at limit"
 /begin REF_CHARACTERISTIC FCdc4_IRV_CL_OOA FCdtc_IRV_CL_OOA FCfmi_IRV_CL_OOA FCftb_IRV_CL_OOA FCspn_IRV_CL_OOA FPfl_IRV_CL_OOA FPfu_IRV_CL_OOA FPnd_IRV_CL_OOA FPsvr_IRV_CL_OOA FPsw_ext1_IRV_CL_OOA FPsw_IRV_CL_OOA /end REF_CHARACTERISTIC
/end GROUP
/begin GROUP J1939_AAT_err_loss_EC_Fault "J1939 AAT error or message receipt lost"
 /begin REF_CHARACTERISTIC FCdc4_J1939_AAT_err_loss FCdtc_J1939_AAT_err_loss FCfmi_J1939_AAT_err_loss FCftb_J1939_AAT_err_loss FCspn_J1939_AAT_err_loss FPfl_J1939_AAT_err_loss FPfu_J1939_AAT_err_loss FPnd_J1939_AAT_err_loss FPsvr_J1939_AAT_err_loss FPsw_ext1_J1939_AAT_err_loss FPsw_J1939_AAT_err_loss /end REF_CHARACTERISTIC
/end GROUP
/begin GROUP J1939_addr2Fail_EC_Fault "CAN2 address conflict failure"
 /begin REF_CHARACTERISTIC FCdc4_J1939_addr2Fail FCdtc_J1939_addr2Fail FCfmi_J1939_addr2Fail FCftb_J1939_addr2Fail FCspn_J1939_addr2Fail FPfl_J1939_addr2Fail FPfu_J1939_addr2Fail FPnd_J1939_addr2Fail FPsvr_J1939_addr2Fail FPsw_ext1_J1939_addr2Fail FPsw_J1939_addr2Fail /end REF_CHARACTERISTIC
/end GROUP
/begin GROUP J1939_addr3Fail_EC_Fault "CAN3 address conflict failure"
 /begin REF_CHARACTERISTIC FCdc4_J1939_addr3Fail FCdtc_J1939_addr3Fail FCfmi_J1939_addr3Fail FCftb_J1939_addr3Fail FCspn_J1939_addr3Fail FPfl_J1939_addr3Fail FPfu_J1939_addr3Fail FPnd_J1939_addr3Fail FPsvr_J1939_addr3Fail FPsw_ext1_J1939_addr3Fail FPsw_J1939_addr3Fail /end REF_CHARACTERISTIC
/end GROUP
/begin GROUP J1939_addrFail_EC_Fault "CAN1 address conflict failure"
 /begin REF_CHARACTERISTIC FCdc4_J1939_addrFail FCdtc_J1939_addrFail FCfmi_J1939_addrFail FCftb_J1939_addrFail FCspn_J1939_addrFail FPfl_J1939_addrFail FPfu_J1939_addrFail FPnd_J1939_addrFail FPsvr_J1939_addrFail FPsw_ext1_J1939_addrFail FPsw_J1939_addrFail /end REF_CHARACTERISTIC
/end GROUP
/begin GROUP J1939_ETC_loss_EC_Fault "J1939 Electronic Throttle Control (ETC) message receipt lost"
 /begin REF_CHARACTERISTIC FCdc4_J1939_ETC_loss FCdtc_J1939_ETC_loss FCfmi_J1939_ETC_loss FCftb_J1939_ETC_loss FCspn_J1939_ETC_loss FPfl_J1939_ETC_loss FPfu_J1939_ETC_loss FPnd_J1939_ETC_loss FPsvr_J1939_ETC_loss FPsw_ext1_J1939_ETC_loss FPsw_J1939_ETC_loss /end REF_CHARACTERISTIC
/end GROUP
/begin GROUP J1939_ETC_loss2_EC_Fault "J1939 Electronic Throttle Control (ETC) message loss while in-gear"
 /begin REF_CHARACTERISTIC FCdc4_J1939_ETC_loss2 FCdtc_J1939_ETC_loss2 FCfmi_J1939_ETC_loss2 FCftb_J1939_ETC_loss2 FCspn_J1939_ETC_loss2 FPfl_J1939_ETC_loss2 FPfu_J1939_ETC_loss2 FPnd_J1939_ETC_loss2 FPsvr_J1939_ETC_loss2 FPsw_ext1_J1939_ETC_loss2 FPsw_J1939_ETC_loss2 /end REF_CHARACTERISTIC
/end GROUP
/begin GROUP J1939_PGN_tout_EC_Fault "J1939 PGN timeout 1"
 /begin REF_CHARACTERISTIC FCdc4_J1939_PGN_tout FCdtc_J1939_PGN_tout FCfmi_J1939_PGN_tout FCftb_J1939_PGN_tout FCspn_J1939_PGN_tout FPfl_J1939_PGN_tout FPfu_J1939_PGN_tout FPnd_J1939_PGN_tout FPsvr_J1939_PGN_tout FPsw_ext1_J1939_PGN_tout FPsw_J1939_PGN_tout /end REF_CHARACTERISTIC
/end GROUP
/begin GROUP J1939_PGN_tout10_EC_Fault "J1939 PGN timeout 10"
 /begin REF_CHARACTERISTIC FCdc4_J1939_PGN_tout10 FCdtc_J1939_PGN_tout10 FCfmi_J1939_PGN_tout10 FCftb_J1939_PGN_tout10 FCspn_J1939_PGN_tout10 FPfl_J1939_PGN_tout10 FPfu_J1939_PGN_tout10 FPnd_J1939_PGN_tout10 FPsvr_J1939_PGN_tout10 FPsw_ext1_J1939_PGN_tout10 FPsw_J1939_PGN_tout10 /end REF_CHARACTERISTIC
/end GROUP
/begin GROUP J1939_PGN_tout2_EC_Fault "J1939 PGN timeout 2"
 /begin REF_CHARACTERISTIC FCdc4_J1939_PGN_tout2 FCdtc_J1939_PGN_tout2 FCfmi_J1939_PGN_tout2 FCftb_J1939_PGN_tout2 FCspn_J1939_PGN_tout2 FPfl_J1939_PGN_tout2 FPfu_J1939_PGN_tout2 FPnd_J1939_PGN_tout2 FPsvr_J1939_PGN_tout2 FPsw_ext1_J1939_PGN_tout2 FPsw_J1939_PGN_tout2 /end REF_CHARACTERISTIC
/end GROUP
/begin GROUP J1939_PGN_tout3_EC_Fault "J1939 PGN timeout 3"
 /begin REF_CHARACTERISTIC FCdc4_J1939_PGN_tout3 FCdtc_J1939_PGN_tout3 FCfmi_J1939_PGN_tout3 FCftb_J1939_PGN_tout3 FCspn_J1939_PGN_tout3 FPfl_J1939_PGN_tout3 FPfu_J1939_PGN_tout3 FPnd_J1939_PGN_tout3 FPsvr_J1939_PGN_tout3 FPsw_ext1_J1939_PGN_tout3 FPsw_J1939_PGN_tout3 /end REF_CHARACTERISTIC
/end GROUP
/begin GROUP J1939_PGN_tout4_EC_Fault "J1939 PGN timeout 4"
 /begin REF_CHARACTERISTIC FCdc4_J1939_PGN_tout4 FCdtc_J1939_PGN_tout4 FCfmi_J1939_PGN_tout4 FCftb_J1939_PGN_tout4 FCspn_J1939_PGN_tout4 FPfl_J1939_PGN_tout4 FPfu_J1939_PGN_tout4 FPnd_J1939_PGN_tout4 FPsvr_J1939_PGN_tout4 FPsw_ext1_J1939_PGN_tout4 FPsw_J1939_PGN_tout4 /end REF_CHARACTERISTIC
/end GROUP
/begin GROUP J1939_PGN_tout5_EC_Fault "J1939 PGN timeout 5"
 /begin REF_CHARACTERISTIC FCdc4_J1939_PGN_tout5 FCdtc_J1939_PGN_tout5 FCfmi_J1939_PGN_tout5 FCftb_J1939_PGN_tout5 FCspn_J1939_PGN_tout5 FPfl_J1939_PGN_tout5 FPfu_J1939_PGN_tout5 FPnd_J1939_PGN_tout5 FPsvr_J1939_PGN_tout5 FPsw_ext1_J1939_PGN_tout5 FPsw_J1939_PGN_tout5 /end REF_CHARACTERISTIC
/end GROUP
/begin GROUP J1939_PGN_tout6_EC_Fault "J1939 PGN timeout 6"
 /begin REF_CHARACTERISTIC FCdc4_J1939_PGN_tout6 FCdtc_J1939_PGN_tout6 FCfmi_J1939_PGN_tout6 FCftb_J1939_PGN_tout6 FCspn_J1939_PGN_tout6 FPfl_J1939_PGN_tout6 FPfu_J1939_PGN_tout6 FPnd_J1939_PGN_tout6 FPsvr_J1939_PGN_tout6 FPsw_ext1_J1939_PGN_tout6 FPsw_J1939_PGN_tout6 /end REF_CHARACTERISTIC
/end GROUP
/begin GROUP J1939_PGN_tout7_EC_Fault "J1939 PGN timeout 7"
 /begin REF_CHARACTERISTIC FCdc4_J1939_PGN_tout7 FCdtc_J1939_PGN_tout7 FCfmi_J1939_PGN_tout7 FCftb_J1939_PGN_tout7 FCspn_J1939_PGN_tout7 FPfl_J1939_PGN_tout7 FPfu_J1939_PGN_tout7 FPnd_J1939_PGN_tout7 FPsvr_J1939_PGN_tout7 FPsw_ext1_J1939_PGN_tout7 FPsw_J1939_PGN_tout7 /end REF_CHARACTERISTIC
/end GROUP
/begin GROUP J1939_PGN_tout8_EC_Fault "J1939 PGN timeout 8"
 /begin REF_CHARACTERISTIC FCdc4_J1939_PGN_tout8 FCdtc_J1939_PGN_tout8 FCfmi_J1939_PGN_tout8 FCftb_J1939_PGN_tout8 FCspn_J1939_PGN_tout8 FPfl_J1939_PGN_tout8 FPfu_J1939_PGN_tout8 FPnd_J1939_PGN_tout8 FPsvr_J1939_PGN_tout8 FPsw_ext1_J1939_PGN_tout8 FPsw_J1939_PGN_tout8 /end REF_CHARACTERISTIC
/end GROUP
/begin GROUP J1939_PGN_tout9_EC_Fault "J1939 PGN timeout 9"
 /begin REF_CHARACTERISTIC FCdc4_J1939_PGN_tout9 FCdtc_J1939_PGN_tout9 FCfmi_J1939_PGN_tout9 FCftb_J1939_PGN_tout9 FCspn_J1939_PGN_tout9 FPfl_J1939_PGN_tout9 FPfu_J1939_PGN_tout9 FPnd_J1939_PGN_tout9 FPsvr_J1939_PGN_tout9 FPsw_ext1_J1939_PGN_tout9 FPsw_J1939_PGN_tout9 /end REF_CHARACTERISTIC
/end GROUP
/begin GROUP J1939_RS_err_loss_EC_Fault "J1939 roadspeed error or message receipt lost"
 /begin REF_CHARACTERISTIC FCdc4_J1939_RS_err_loss FCdtc_J1939_RS_err_loss FCfmi_J1939_RS_err_loss FCftb_J1939_RS_err_loss FCspn_J1939_RS_err_loss FPfl_J1939_RS_err_loss FPfu_J1939_RS_err_loss FPnd_J1939_RS_err_loss FPsvr_J1939_RS_err_loss FPsw_ext1_J1939_RS_err_loss FPsw_J1939_RS_err_loss /end REF_CHARACTERISTIC
/end GROUP
/begin GROUP J1939_RSsetpt_loss_EC_Fault "J1939 PGN 65450 roadspeed setpoint command receipt lost"
 /begin REF_CHARACTERISTIC FCdc4_J1939_RSsetpt_loss FCdtc_J1939_RSsetpt_loss FCfmi_J1939_RSsetpt_loss FCftb_J1939_RSsetpt_loss FCspn_J1939_RSsetpt_loss FPfl_J1939_RSsetpt_loss FPfu_J1939_RSsetpt_loss FPnd_J1939_RSsetpt_loss FPsvr_J1939_RSsetpt_loss FPsw_ext1_J1939_RSsetpt_loss FPsw_J1939_RSsetpt_loss /end REF_CHARACTERISTIC
/end GROUP
/begin GROUP J1939_Rx2Fail_EC_Fault "CAN2 Rx failure"
 /begin REF_CHARACTERISTIC FCdc4_J1939_Rx2Fail FCdtc_J1939_Rx2Fail FCfmi_J1939_Rx2Fail FCftb_J1939_Rx2Fail FCspn_J1939_Rx2Fail FPfl_J1939_Rx2Fail FPfu_J1939_Rx2Fail FPnd_J1939_Rx2Fail FPsvr_J1939_Rx2Fail FPsw_ext1_J1939_Rx2Fail FPsw_J1939_Rx2Fail /end REF_CHARACTERISTIC
/end GROUP
/begin GROUP J1939_Rx3Fail_EC_Fault "CAN3 Rx failure"
 /begin REF_CHARACTERISTIC FCdc4_J1939_Rx3Fail FCdtc_J1939_Rx3Fail FCfmi_J1939_Rx3Fail FCftb_J1939_Rx3Fail FCspn_J1939_Rx3Fail FPfl_J1939_Rx3Fail FPfu_J1939_Rx3Fail FPnd_J1939_Rx3Fail FPsvr_J1939_Rx3Fail FPsw_ext1_J1939_Rx3Fail FPsw_J1939_Rx3Fail /end REF_CHARACTERISTIC
/end GROUP
/begin GROUP J1939_RxFail_EC_Fault "CAN1 Rx failure"
 /begin REF_CHARACTERISTIC FCdc4_J1939_RxFail FCdtc_J1939_RxFail FCfmi_J1939_RxFail FCftb_J1939_RxFail FCspn_J1939_RxFail FPfl_J1939_RxFail FPfu_J1939_RxFail FPnd_J1939_RxFail FPsvr_J1939_RxFail FPsw_ext1_J1939_RxFail FPsw_J1939_RxFail /end REF_CHARACTERISTIC
/end GROUP
/begin GROUP J1939_SD_rq_EC_Fault "Shutdown Request"
 /begin REF_CHARACTERISTIC FCdc4_J1939_SD_rq FCdtc_J1939_SD_rq FCfmi_J1939_SD_rq FCftb_J1939_SD_rq FCspn_J1939_SD_rq FPfl_J1939_SD_rq FPfu_J1939_SD_rq FPnd_J1939_SD_rq FPsvr_J1939_SD_rq FPsw_ext1_J1939_SD_rq FPsw_J1939_SD_rq /end REF_CHARACTERISTIC
/end GROUP
/end MODULE
/end PROJECT
