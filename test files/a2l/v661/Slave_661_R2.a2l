ASAP2_VERSION 1 61
/begin PROJECT Econtrols_4G "4G Test"
/begin HEADER "4G A2L Configuration" PROJECT_NO EControls4G /* config for version control */ VERSION "$Revision: 82130 $:" /* config for version control */ /end HEADER
/begin MODULE EControls_4G_SH2A "EControls 4G"
/begin MOD_COMMON "" DEPOSIT ABSOLUTE BYTE_ORDER MSB_FIRST /end MOD_COMMON
/* Define the Record Layouts */
/begin RECORD_LAYOUT ECIPP_ALIGNMENT_UBYTE FNC_VALUES 1 UBYTE COLUMN_DIR DIRECT /end RECORD_LAYOUT
/begin RECORD_LAYOUT ECIPP_ALIGNMENT_UWORD FNC_VALUES 1 UWORD COLUMN_DIR DIRECT /end RECORD_LAYOUT
/begin RECORD_LAYOUT ECIPP_ALIGNMENT_SWORD FNC_VALUES 1 SWORD COLUMN_DIR DIRECT /end RECORD_LAYOUT
/begin RECORD_LAYOUT ECIPP_ALIGNMENT_ULONG FNC_VALUES 1 ULONG COLUMN_DIR DIRECT /end RECORD_LAYOUT
/begin RECORD_LAYOUT ECIPP_ALIGNMENT_FLOAT32_IEEE FNC_VALUES 1 FLOAT32_IEEE COLUMN_DIR DIRECT /end RECORD_LAYOUT
/begin COMPU_METHOD Compu_IDENTITY "Discrete Values " /* Identifier */ IDENTICAL "%.0" /* Format */ "-" /* Units */ /end COMPU_METHOD
/* Describe the special address used to COPY RCalibration (RAM) to DCalibration (FLASH) */ /* CCP_CMT_ADDR=0x06000000 CCP_CMD_CMD=0x5A=90 CCP_REL_CMD=0xA5 */
/begin COMPU_METHOD Compu_DirtyCal_VTAB "Verbal Table" TAB_VERB "%8.0" "" COMPU_TAB_REF Compu_DirtyCal_VTAB_REF /end COMPU_METHOD
/begin COMPU_VTAB Compu_DirtyCal_VTAB_REF "Verbal Table" TAB_VERB 2 0 "RAM-EEPROM Mismatch" 1 "RAM-EEPROM Match" DEFAULT_VALUE "Undefined" /end COMPU_VTAB
/begin MEASUREMENT DirtyCalibration "Calibration RAM Data is changed" UBYTE Compu_DirtyCal_VTAB 0 0 0 255 ECU_ADDRESS 0x06000000 /end MEASUREMENT
/begin MEASUREMENT HM_hours "General # HM_hours" UWORD Compu_HM_hours 0 0 0 65535 ECU_ADDRESS 0x01001310 /end MEASUREMENT
/begin COMPU_METHOD Compu_HM_hours " " RAT_FUNC "%.0" "-" COEFFS 0 1 0 0 0 1 /end COMPU_METHOD
/begin CHARACTERISTIC MAP_max "FaultConfig # MAP_max (Fault Condition:MAP pressure >)" VALUE 0x001c7d4c /* @ECU_Address@MAP_max@0x010013E0@ */ ECIPP_ALIGNMENT_UWORD 256 Compu_MAP_max 0 255.99609375 /end CHARACTERISTIC
/begin COMPU_METHOD Compu_MAP_max " " RAT_FUNC "%.3" "psia" COEFFS 0 256 0 0 0 1 /end COMPU_METHOD
/begin CHARACTERISTIC MAP_maxTPS "FaultConfig # MAP_maxTPS (Fault Condition:and TPS <)" VALUE 0x001c7d50 /* @ECU_Address@MAP_maxTPS@0x010013E8@ */ ECIPP_ALIGNMENT_UWORD 100 Compu_MAP_maxTPS 0 99.9984741210938 /end CHARACTERISTIC
/begin COMPU_METHOD Compu_MAP_maxTPS " " RAT_FUNC "%.3" "%" COEFFS 0 655.36 0 0 0 1 /end COMPU_METHOD
/begin CHARACTERISTIC MAP_maxRPM "FaultConfig # MAP_maxRPM (Fault Condition:and RPM >)" VALUE 0x001c7d4e /* @ECU_Address@MAP_maxRPM@0x010013F0@ */ ECIPP_ALIGNMENT_UWORD 65535 Compu_MAP_maxRPM 0 65535 /end CHARACTERISTIC
/begin COMPU_METHOD Compu_MAP_maxRPM " " RAT_FUNC "%.0" "rpm" COEFFS 0 1 0 0 0 1 /end COMPU_METHOD
/begin CHARACTERISTIC MAP_minv "FaultConfig # MAP_minv (Fault Condition:MAP voltage <)" VALUE 0x001c7d54 /* @ECU_Address@MAP_minv@0x010013F8@ */ ECIPP_ALIGNMENT_UWORD 5 Compu_MAP_minv 0 5.00114468864469 /end CHARACTERISTIC
/begin COMPU_METHOD Compu_MAP_minv " " RAT_FUNC "%.3" "volts" COEFFS 0 13104 0 0 0 1 /end COMPU_METHOD
/begin CHARACTERISTIC MAP_minvTPS "FaultConfig # MAP_minvTPS (Fault Condition:and TPS >)" VALUE 0x001c7d58 /* @ECU_Address@MAP_minvTPS@0x01001400@ */ ECIPP_ALIGNMENT_UWORD 100 Compu_MAP_minvTPS 0 99.9984741210938 /end CHARACTERISTIC
/begin COMPU_METHOD Compu_MAP_minvTPS " " RAT_FUNC "%.3" "%" COEFFS 0 655.36 0 0 0 1 /end COMPU_METHOD
/begin CHARACTERISTIC MAP_minvRPM "FaultConfig # MAP_minvRPM (Fault Condition:and RPM <)" VALUE 0x001c7d56 /* @ECU_Address@MAP_minvRPM@0x01001408@ */ ECIPP_ALIGNMENT_UWORD 65535 Compu_MAP_minvRPM 0 65535 /end CHARACTERISTIC
/begin COMPU_METHOD Compu_MAP_minvRPM " " RAT_FUNC "%.0" "rpm" COEFFS 0 1 0 0 0 1 /end COMPU_METHOD
/begin CHARACTERISTIC ECT_maxv "FaultConfig # ECT_maxv (Fault Condition:ECT voltage >)" VALUE 0x001c6eac /* @ECU_Address@ECT_maxv@0x01001410@ */ ECIPP_ALIGNMENT_UWORD 5 Compu_ECT_maxv 0 5.00114468864469 /end CHARACTERISTIC
/begin COMPU_METHOD Compu_ECT_maxv " " RAT_FUNC "%.3" "volts" COEFFS 0 13104 0 0 0 1 /end COMPU_METHOD
/begin CHARACTERISTIC ECT_minv "FaultConfig # ECT_minv (Fault Condition:ECT voltage <)" VALUE 0x001c6eae /* @ECU_Address@ECT_minv@0x01001418@ */ ECIPP_ALIGNMENT_UWORD 5 Compu_ECT_minv 0 5.00114468864469 /end CHARACTERISTIC
/begin COMPU_METHOD Compu_ECT_minv " " RAT_FUNC "%.3" "volts" COEFFS 0 13104 0 0 0 1 /end COMPU_METHOD
/begin CHARACTERISTIC ECT_HiExp "FaultConfig # ECT_HiExp (Fault Condition:ECT >)" VALUE 0x001c6e90 /* @ECU_Address@ECT_HiExp@0x01001420@ */ ECIPP_ALIGNMENT_UWORD 564 Compu_ECT_HiExp -460 563.984375 /end CHARACTERISTIC
/begin COMPU_METHOD Compu_ECT_HiExp " " RAT_FUNC "%.3" "deg F" COEFFS 0 64 29440 0 0 1 /end COMPU_METHOD
/begin CHARACTERISTIC ECT_HiExp_rpm "FaultConfig # ECT_HiExp_rpm (Fault Condition:and RPM >)" VALUE 0x001c6e9a /* @ECU_Address@ECT_HiExp_rpm@0x01001428@ */ ECIPP_ALIGNMENT_UWORD 65535 Compu_ECT_HiExp_rpm 0 65535 /end CHARACTERISTIC
/begin COMPU_METHOD Compu_ECT_HiExp_rpm " " RAT_FUNC "%.0" "rpm" COEFFS 0 1 0 0 0 1 /end COMPU_METHOD
/begin CHARACTERISTIC ECT_HiExp2 "FaultConfig # ECT_HiExp2 (Fault Condition:ECT >)" VALUE 0x001c6e92 /* @ECU_Address@ECT_HiExp2@0x01001430@ */ ECIPP_ALIGNMENT_UWORD 564 Compu_ECT_HiExp2 -460 563.984375 /end CHARACTERISTIC
/begin COMPU_METHOD Compu_ECT_HiExp2 " " RAT_FUNC "%.3" "deg F" COEFFS 0 64 29440 0 0 1 /end COMPU_METHOD
/begin CHARACTERISTIC ECT_HiExp2_rpm "FaultConfig # ECT_HiExp2_rpm (Fault Condition:and RPM >)" VALUE 0x001c6e96 /* @ECU_Address@ECT_HiExp2_rpm@0x01001438@ */ ECIPP_ALIGNMENT_UWORD 65535 Compu_ECT_HiExp2_rpm 0 65535 /end CHARACTERISTIC
/begin COMPU_METHOD Compu_ECT_HiExp2_rpm " " RAT_FUNC "%.0" "rpm" COEFFS 0 1 0 0 0 1 /end COMPU_METHOD
/begin CHARACTERISTIC IAT_maxv "FaultConfig # IAT_maxv (Fault Condition:IAT voltage >)" VALUE 0x001c7c08 /* @ECU_Address@IAT_maxv@0x01001440@ */ ECIPP_ALIGNMENT_UWORD 5 Compu_IAT_maxv 0 5.00114468864469 /end CHARACTERISTIC
/begin COMPU_METHOD Compu_IAT_maxv " " RAT_FUNC "%.3" "volts" COEFFS 0 13104 0 0 0 1 /end COMPU_METHOD
/begin CHARACTERISTIC IAT_minv "FaultConfig # IAT_minv (Fault Condition:IAT voltage <)" VALUE 0x001c7c0a /* @ECU_Address@IAT_minv@0x01001448@ */ ECIPP_ALIGNMENT_UWORD 5 Compu_IAT_minv 0 5.00114468864469 /end CHARACTERISTIC
/begin COMPU_METHOD Compu_IAT_minv " " RAT_FUNC "%.3" "volts" COEFFS 0 13104 0 0 0 1 /end COMPU_METHOD
/begin CHARACTERISTIC IAT_HiExp "FaultConfig # IAT_HiExp (Fault Condition:IAT >)" VALUE 0x001c7bfe /* @ECU_Address@IAT_HiExp@0x01001450@ */ ECIPP_ALIGNMENT_UWORD 564 Compu_IAT_HiExp -460 563.984375 /end CHARACTERISTIC
/begin COMPU_METHOD Compu_IAT_HiExp " " RAT_FUNC "%.3" "deg F" COEFFS 0 64 29440 0 0 1 /end COMPU_METHOD
/begin CHARACTERISTIC IAT_HiExp_rpm "FaultConfig # IAT_HiExp_rpm (Fault Condition:and RPM >)" VALUE 0x001c7c04 /* @ECU_Address@IAT_HiExp_rpm@0x01001458@ */ ECIPP_ALIGNMENT_UWORD 65535 Compu_IAT_HiExp_rpm 0 65535 /end CHARACTERISTIC
/begin COMPU_METHOD Compu_IAT_HiExp_rpm " " RAT_FUNC "%.0" "rpm" COEFFS 0 1 0 0 0 1 /end COMPU_METHOD
/begin CHARACTERISTIC IAT_HiExp2 "FaultConfig # IAT_HiExp2 (Fault Condition:IAT >)" VALUE 0x001c7c00 /* @ECU_Address@IAT_HiExp2@0x01001460@ */ ECIPP_ALIGNMENT_UWORD 564 Compu_IAT_HiExp2 -460 563.984375 /end CHARACTERISTIC
/begin COMPU_METHOD Compu_IAT_HiExp2 " " RAT_FUNC "%.3" "deg F" COEFFS 0 64 29440 0 0 1 /end COMPU_METHOD
/begin CHARACTERISTIC IAT_HiExp2_rpm "FaultConfig # IAT_HiExp2_rpm (Fault Condition:and RPM >)" VALUE 0x001c7c02 /* @ECU_Address@IAT_HiExp2_rpm@0x01001468@ */ ECIPP_ALIGNMENT_UWORD 65535 Compu_IAT_HiExp2_rpm 0 65535 /end CHARACTERISTIC
/begin COMPU_METHOD Compu_IAT_HiExp2_rpm " " RAT_FUNC "%.0" "rpm" COEFFS 0 1 0 0 0 1 /end COMPU_METHOD
/begin CHARACTERISTIC BP_max "FaultConfig # BP_max (Fault Condition:BP pressure >)" VALUE 0x001c6d7e /* @ECU_Address@BP_max@0x01001470@ */ ECIPP_ALIGNMENT_UWORD 256 Compu_BP_max 0 255.99609375 /end CHARACTERISTIC
/begin COMPU_METHOD Compu_BP_max " " RAT_FUNC "%.3" "psia" COEFFS 0 256 0 0 0 1 /end COMPU_METHOD
/begin CHARACTERISTIC BP_min "FaultConfig # BP_min (Fault Condition:BP pressure <)" VALUE 0x001c6d80 /* @ECU_Address@BP_min@0x01001478@ */ ECIPP_ALIGNMENT_UWORD 256 Compu_BP_min 0 255.99609375 /end CHARACTERISTIC
/begin COMPU_METHOD Compu_BP_min " " RAT_FUNC "%.3" "psia" COEFFS 0 256 0 0 0 1 /end COMPU_METHOD
/begin CHARACTERISTIC V_max "FaultConfig # V_max (Fault Condition:Voltage >)" VALUE 0x001c837a /* @ECU_Address@V_max@0x01001480@ */ ECIPP_ALIGNMENT_UWORD 256 Compu_V_max 0 255.99609375 /end CHARACTERISTIC
/begin COMPU_METHOD Compu_V_max " " RAT_FUNC "%.3" "volts" COEFFS 0 256 0 0 0 1 /end COMPU_METHOD
/begin CHARACTERISTIC V_min "FaultConfig # V_min (Fault Condition:Voltage <)" VALUE 0x001c837c /* @ECU_Address@V_min@0x01001488@ */ ECIPP_ALIGNMENT_UWORD 256 Compu_V_min 0 255.99609375 /end CHARACTERISTIC
/begin COMPU_METHOD Compu_V_min " " RAT_FUNC "%.3" "volts" COEFFS 0 256 0 0 0 1 /end COMPU_METHOD
/begin CHARACTERISTIC V_minRPM "FaultConfig # V_minRPM (Fault Condition:and RPM >)" VALUE 0x001c837e /* @ECU_Address@V_minRPM@0x01001490@ */ ECIPP_ALIGNMENT_UWORD 65535 Compu_V_minRPM 0 65535 /end CHARACTERISTIC
/begin COMPU_METHOD Compu_V_minRPM " " RAT_FUNC "%.0" "rpm" COEFFS 0 1 0 0 0 1 /end COMPU_METHOD
/begin CHARACTERISTIC VE5_max "FaultConfig # VE5_max (Fault Condition:5VE1 >)" VALUE 0x001e58b6 /* @ECU_Address@VE5_max@0x01001498@ */ ECIPP_ALIGNMENT_UWORD 6 Compu_VE5_max 0 5.50125915750916 /end CHARACTERISTIC
/begin COMPU_METHOD Compu_VE5_max " " RAT_FUNC "%.3" "volts" COEFFS 0 11912.7272727273 0 0 0 1 /end COMPU_METHOD
/begin CHARACTERISTIC VE5_min "FaultConfig # VE5_min (Fault Condition:5VE1 <)" VALUE 0x001e58b8 /* @ECU_Address@VE5_min@0x010014A0@ */ ECIPP_ALIGNMENT_UWORD 6 Compu_VE5_min 0 5.50125915750916 /end CHARACTERISTIC
/begin COMPU_METHOD Compu_VE5_min " " RAT_FUNC "%.3" "volts" COEFFS 0 11912.7272727273 0 0 0 1 /end COMPU_METHOD
/begin CHARACTERISTIC VE5b_max "FaultConfig # VE5b_max (Fault Condition:5VE2 >)" VALUE 0x001e58ba /* @ECU_Address@VE5b_max@0x010014A8@ */ ECIPP_ALIGNMENT_UWORD 6 Compu_VE5b_max 0 5.50125915750916 /end CHARACTERISTIC
/begin COMPU_METHOD Compu_VE5b_max " " RAT_FUNC "%.3" "volts" COEFFS 0 11912.7272727273 0 0 0 1 /end COMPU_METHOD
/begin CHARACTERISTIC VE5b_min "FaultConfig # VE5b_min (Fault Condition:5VE2 <)" VALUE 0x001e58bc /* @ECU_Address@VE5b_min@0x010014B0@ */ ECIPP_ALIGNMENT_UWORD 6 Compu_VE5b_min 0 5.50125915750916 /end CHARACTERISTIC
/begin COMPU_METHOD Compu_VE5b_min " " RAT_FUNC "%.3" "volts" COEFFS 0 11912.7272727273 0 0 0 1 /end COMPU_METHOD
/begin CHARACTERISTIC TPS1_min "FaultConfig # TPS1_min (Fault Condition:TPS1 voltage <)" VALUE 0x001C9C66 /* @ECU_Address@TPS1_min@0x010014B8@ */ ECIPP_ALIGNMENT_UWORD 5 Compu_TPS1_min 0 5.00114468864469 /end CHARACTERISTIC
/begin COMPU_METHOD Compu_TPS1_min " " RAT_FUNC "%.3" "volts" COEFFS 0 13104 0 0 0 1 /end COMPU_METHOD
/begin CHARACTERISTIC TPS1_max "FaultConfig # TPS1_max (Fault Condition:TPS1 voltage >)" VALUE 0x001C9C68 /* @ECU_Address@TPS1_max@0x010014C0@ */ ECIPP_ALIGNMENT_UWORD 5 Compu_TPS1_max 0 5.00114468864469 /end CHARACTERISTIC
/begin COMPU_METHOD Compu_TPS1_max " " RAT_FUNC "%.3" "volts" COEFFS 0 13104 0 0 0 1 /end COMPU_METHOD
/begin CHARACTERISTIC TPS2_min "FaultConfig # TPS2_min (Fault Condition:TPS2 voltage <)" VALUE 0x001C9C6A /* @ECU_Address@TPS2_min@0x010014C8@ */ ECIPP_ALIGNMENT_UWORD 5 Compu_TPS2_min 0 5.00114468864469 /end CHARACTERISTIC
/begin COMPU_METHOD Compu_TPS2_min " " RAT_FUNC "%.3" "volts" COEFFS 0 13104 0 0 0 1 /end COMPU_METHOD
/begin CHARACTERISTIC TPS2_max "FaultConfig # TPS2_max (Fault Condition:TPS2 voltage >)" VALUE 0x001C9C6C /* @ECU_Address@TPS2_max@0x010014D0@ */ ECIPP_ALIGNMENT_UWORD 5 Compu_TPS2_max 0 5.00114468864469 /end CHARACTERISTIC
/begin COMPU_METHOD Compu_TPS2_max " " RAT_FUNC "%.3" "volts" COEFFS 0 13104 0 0 0 1 /end COMPU_METHOD
/begin CHARACTERISTIC TPS12pct_hi "FaultConfig # TPS12pct_hi (Fault Condition:(TPS1% - TPS2%) >)" VALUE 0x001C9C6E /* @ECU_Address@TPS12pct_hi@0x010014D8@ */ ECIPP_ALIGNMENT_SWORD 100 Compu_TPS12pct_hi -100 99.9969482421875 /end CHARACTERISTIC
/begin COMPU_METHOD Compu_TPS12pct_hi " " RAT_FUNC "%.3" "%" COEFFS 0 327.68 0 0 0 1 /end COMPU_METHOD
/begin CHARACTERISTIC TPS12pct_lo "FaultConfig # TPS12pct_lo (Fault Condition:(TPS1% - TPS2%) <)" VALUE 0x001C9C70 /* @ECU_Address@TPS12pct_lo@0x010014E0@ */ ECIPP_ALIGNMENT_SWORD 100 Compu_TPS12pct_lo -100 99.9969482421875 /end CHARACTERISTIC
/begin COMPU_METHOD Compu_TPS12pct_lo " " RAT_FUNC "%.3" "%" COEFFS 0 327.68 0 0 0 1 /end COMPU_METHOD
/begin CHARACTERISTIC TPSerr_pos "FaultConfig # TPSerr_pos (Fault Condition:(target TPS - actual TPS) >)" VALUE 0x001C9C72 /* @ECU_Address@TPSerr_pos@0x010014E8@ */ ECIPP_ALIGNMENT_SWORD 100 Compu_TPSerr_pos -100 99.9969482421875 /end CHARACTERISTIC
/begin COMPU_METHOD Compu_TPSerr_pos " " RAT_FUNC "%.3" "%" COEFFS 0 327.68 0 0 0 1 /end COMPU_METHOD
/begin CHARACTERISTIC TPSerr_neg "FaultConfig # TPSerr_neg (Fault Condition:(target TPS - actual TPS) <)" VALUE 0x001C9C74 /* @ECU_Address@TPSerr_neg@0x010014F0@ */ ECIPP_ALIGNMENT_SWORD 100 Compu_TPSerr_neg -100 99.9969482421875 /end CHARACTERISTIC
/begin COMPU_METHOD Compu_TPSerr_neg " " RAT_FUNC "%.3" "%" COEFFS 0 327.68 0 0 0 1 /end COMPU_METHOD
/begin CHARACTERISTIC TPSerr_wait "FaultConfig # TPSerr_wait (Fault Condition:persistently longer than)" VALUE 0x001C9C76 /* @ECU_Address@TPSerr_wait@0x010014F8@ */ ECIPP_ALIGNMENT_UWORD 65535 Compu_TPSerr_wait 0 65535 /end CHARACTERISTIC
/begin COMPU_METHOD Compu_TPSerr_wait " " RAT_FUNC "%.0" "ms" COEFFS 0 1 0 0 0 1 /end COMPU_METHOD
/begin CHARACTERISTIC TPSerr_minVbat "FaultConfig # TPSerr_minVbat (Fault Condition:while battery voltage >)" VALUE 0x001C9C78 /* @ECU_Address@TPSerr_minVbat@0x01001500@ */ ECIPP_ALIGNMENT_UWORD 256 Compu_TPSerr_minVbat 0 255.99609375 /end CHARACTERISTIC
/begin COMPU_METHOD Compu_TPSerr_minVbat " " RAT_FUNC "%.3" "volts" COEFFS 0 256 0 0 0 1 /end COMPU_METHOD
/begin CHARACTERISTIC FPP1_min "FaultConfig # FPP1_min (Fault Condition:FPP1 voltage <)" VALUE 0x001e510c /* @ECU_Address@FPP1_min@0x01001510@ */ ECIPP_ALIGNMENT_UWORD 5 Compu_FPP1_min 0 5.00114468864469 /end CHARACTERISTIC
/begin COMPU_METHOD Compu_FPP1_min " " RAT_FUNC "%.3" "volts" COEFFS 0 13104 0 0 0 1 /end COMPU_METHOD
/begin CHARACTERISTIC FPP1_max "FaultConfig # FPP1_max (Fault Condition:FPP1 voltage >)" VALUE 0x001e510a /* @ECU_Address@FPP1_max@0x01001518@ */ ECIPP_ALIGNMENT_UWORD 5 Compu_FPP1_max 0 5.00114468864469 /end CHARACTERISTIC
/begin COMPU_METHOD Compu_FPP1_max " " RAT_FUNC "%.3" "volts" COEFFS 0 13104 0 0 0 1 /end COMPU_METHOD
/begin CHARACTERISTIC FPP2_min "FaultConfig # FPP2_min (Fault Condition:FPP2 voltage <)" VALUE 0x001e5110 /* @ECU_Address@FPP2_min@0x01001520@ */ ECIPP_ALIGNMENT_UWORD 5 Compu_FPP2_min 0 5.00114468864469 /end CHARACTERISTIC
/begin COMPU_METHOD Compu_FPP2_min " " RAT_FUNC "%.3" "volts" COEFFS 0 13104 0 0 0 1 /end COMPU_METHOD
/begin CHARACTERISTIC FPP2_max "FaultConfig # FPP2_max (Fault Condition:FPP2 voltage >)" VALUE 0x001e510e /* @ECU_Address@FPP2_max@0x01001528@ */ ECIPP_ALIGNMENT_UWORD 5 Compu_FPP2_max 0 5.00114468864469 /end CHARACTERISTIC
/begin COMPU_METHOD Compu_FPP2_max " " RAT_FUNC "%.3" "volts" COEFFS 0 13104 0 0 0 1 /end COMPU_METHOD
/begin CHARACTERISTIC FPP12pct_hi "FaultConfig # FPP12pct_hi (Fault Condition:(FPP1% - FPP2%) >)" VALUE 0x001c44e4 /* @ECU_Address@FPP12pct_hi@0x01001530@ */ ECIPP_ALIGNMENT_SWORD 100 Compu_FPP12pct_hi -100 99.9969482421875 /end CHARACTERISTIC
/begin COMPU_METHOD Compu_FPP12pct_hi " " RAT_FUNC "%.3" "%" COEFFS 0 327.68 0 0 0 1 /end COMPU_METHOD
/begin CHARACTERISTIC FPP12pct_lo "FaultConfig # FPP12pct_lo (Fault Condition:(FPP1% - FPP2%) <)" VALUE 0x001c44e6 /* @ECU_Address@FPP12pct_lo@0x01001538@ */ ECIPP_ALIGNMENT_SWORD 100 Compu_FPP12pct_lo -100 99.9969482421875 /end CHARACTERISTIC
/begin COMPU_METHOD Compu_FPP12pct_lo " " RAT_FUNC "%.3" "%" COEFFS 0 327.68 0 0 0 1 /end COMPU_METHOD
/begin CHARACTERISTIC OILP_RPM "FaultConfig # OILP_RPM (Fault Condition:RPM lower limit for all oil pressure low faults:)" VALUE 0x001c7dfc /* @ECU_Address@OILP_RPM@0x01001548@ */ ECIPP_ALIGNMENT_UWORD 65535 Compu_OILP_RPM 0 65535 /end CHARACTERISTIC
/begin COMPU_METHOD Compu_OILP_RPM " " RAT_FUNC "%.0" "rpm" COEFFS 0 1 0 0 0 1 /end COMPU_METHOD
/begin CHARACTERISTIC KNK_min "FaultConfig # KNK_min (Fault Condition:is less than)" VALUE 0x001c7cbc /* @ECU_Address@KNK_min@0x01001578@ */ ECIPP_ALIGNMENT_UWORD 64 Compu_KNK_min 0 63.9990234375 /end CHARACTERISTIC
/begin COMPU_METHOD Compu_KNK_min " " RAT_FUNC "%.3" "volts" COEFFS 0 1024 0 0 0 1 /end COMPU_METHOD
/begin CHARACTERISTIC KNK_min_RPMlim "FaultConfig # KNK_min_RPMlim (Fault Condition:and RPM >)" VALUE 0x001c7cc0 /* @ECU_Address@KNK_min_RPMlim@0x01001580@ */ ECIPP_ALIGNMENT_UWORD 65535 Compu_KNK_min_RPMlim 0 65535 /end CHARACTERISTIC
/begin COMPU_METHOD Compu_KNK_min_RPMlim " " RAT_FUNC "%.0" "rpm" COEFFS 0 1 0 0 0 1 /end COMPU_METHOD
/begin CHARACTERISTIC KNK_min_MAPlim "FaultConfig # KNK_min_MAPlim (Fault Condition:and MAP >)" VALUE 0x001c7cbe /* @ECU_Address@KNK_min_MAPlim@0x01001588@ */ ECIPP_ALIGNMENT_UWORD 256 Compu_KNK_min_MAPlim 0 255.99609375 /end CHARACTERISTIC
/begin COMPU_METHOD Compu_KNK_min_MAPlim " " RAT_FUNC "%.3" "psia" COEFFS 0 256 0 0 0 1 /end COMPU_METHOD
/begin CHARACTERISTIC KNK_max "FaultConfig # KNK_max (Fault Condition:Knock sensor input >)" VALUE 0x001c7cb8 /* @ECU_Address@KNK_max@0x01001590@ */ ECIPP_ALIGNMENT_UWORD 64 Compu_KNK_max 0 63.9990234375 /end CHARACTERISTIC
/begin COMPU_METHOD Compu_KNK_max " " RAT_FUNC "%.3" "volts" COEFFS 0 1024 0 0 0 1 /end COMPU_METHOD
/begin CHARACTERISTIC KNK_max_MAPlim "FaultConfig # KNK_max_MAPlim (Fault Condition:and MAP <)" VALUE 0x001c7cba /* @ECU_Address@KNK_max_MAPlim@0x01001598@ */ ECIPP_ALIGNMENT_UWORD 256 Compu_KNK_max_MAPlim 0 255.99609375 /end CHARACTERISTIC
/begin COMPU_METHOD Compu_KNK_max_MAPlim " " RAT_FUNC "%.3" "psia" COEFFS 0 256 0 0 0 1 /end COMPU_METHOD
/begin CHARACTERISTIC gov_ntrlock_fail "FaultConfig # gov_ntrlock_fail (Fault Condition:interlock failure persistent >)" VALUE 0x001c8466 /* @ECU_Address@gov_ntrlock_fail@0x010015A0@ */ ECIPP_ALIGNMENT_UWORD 65535 Compu_gov_ntrlock_fail 0 65535 /end CHARACTERISTIC
/begin COMPU_METHOD Compu_gov_ntrlock_fail " " RAT_FUNC "%.0" "ms" COEFFS 0 1 0 0 0 1 /end COMPU_METHOD
/begin CHARACTERISTIC crk_flt_chk_minV "FaultConfig # crk_flt_chk_minV" VALUE 0x001c83f0 /* @ECU_Address@crk_flt_chk_minV@0x010015A8@ */ ECIPP_ALIGNMENT_UWORD 256 Compu_crk_flt_chk_minV 0 255.99609375 /end CHARACTERISTIC
/begin COMPU_METHOD Compu_crk_flt_chk_minV " " RAT_FUNC "%.3" "volts" COEFFS 0 256 0 0 0 1 /end COMPU_METHOD
/begin CHARACTERISTIC EGO1fault "FaultConfig # EGO1fault (Fault Condition:EGO cold persistently >)" VALUE 0x001c4290 /* @ECU_Address@EGO1fault@0x010015B0@ */ ECIPP_ALIGNMENT_ULONG 4294967 Compu_EGO1fault 0 4294967.295 /end CHARACTERISTIC
/begin COMPU_METHOD Compu_EGO1fault " " RAT_FUNC "%.3" "seconds" COEFFS 0 1000 0 0 0 1 /end COMPU_METHOD
/begin CHARACTERISTIC INJD_off_lo "FaultConfig # INJD_off_lo (Fault Condition:Non-CR Injector off-state low-side <)" VALUE 0x001c7c54 /* @ECU_Address@INJD_off_lo@0x010015B8@ */ ECIPP_ALIGNMENT_UWORD 55 Compu_INJD_off_lo 0 55.0125915750916 /end CHARACTERISTIC
/begin COMPU_METHOD Compu_INJD_off_lo " " RAT_FUNC "%.3" "volts" COEFFS 0 1191.27272727273 0 0 0 1 /end COMPU_METHOD
/begin CHARACTERISTIC INJD_off_minVbat "FaultConfig # INJD_off_minVbat (Fault Condition:and battery voltage >)" VALUE 0x001c7c56 /* @ECU_Address@INJD_off_minVbat@0x010015C0@ */ ECIPP_ALIGNMENT_UWORD 256 Compu_INJD_off_minVbat 0 255.99609375 /end CHARACTERISTIC
/begin COMPU_METHOD Compu_INJD_off_minVbat " " RAT_FUNC "%.3" "volts" COEFFS 0 256 0 0 0 1 /end COMPU_METHOD
/begin CHARACTERISTIC INJD_on_hi "FaultConfig # INJD_on_hi (Fault Condition:Non-CR Injector on-state low-side >)" VALUE 0x001c7c58 /* @ECU_Address@INJD_on_hi@0x010015C8@ */ ECIPP_ALIGNMENT_UWORD 55 Compu_INJD_on_hi 0 55.0125915750916 /end CHARACTERISTIC
/begin COMPU_METHOD Compu_INJD_on_hi " " RAT_FUNC "%.3" "volts" COEFFS 0 1191.27272727273 0 0 0 1 /end COMPU_METHOD
/begin CHARACTERISTIC INJD_on_maxVbat "FaultConfig # INJD_on_maxVbat (Fault Condition:and battery voltage <)" VALUE 0x001c7c5a /* @ECU_Address@INJD_on_maxVbat@0x010015D0@ */ ECIPP_ALIGNMENT_UWORD 256 Compu_INJD_on_maxVbat 0 255.99609375 /end CHARACTERISTIC
/begin COMPU_METHOD Compu_INJD_on_maxVbat " " RAT_FUNC "%.3" "volts" COEFFS 0 256 0 0 0 1 /end COMPU_METHOD
/begin CHARACTERISTIC SPKD_dw_lo "FaultConfig # SPKD_dw_lo (Fault Condition:dwell adjustment >=)" VALUE 0x001c459e /* @ECU_Address@SPKD_dw_lo@0x010015D8@ */ ECIPP_ALIGNMENT_SWORD 105 Compu_SPKD_dw_lo -104.8576 104.8544 /end CHARACTERISTIC
/begin COMPU_METHOD Compu_SPKD_dw_lo " " RAT_FUNC "%.3" "ms" COEFFS 0 312.5 0 0 0 1 /end COMPU_METHOD
/begin CHARACTERISTIC SPKD_dwabs_lo "FaultConfig # SPKD_dwabs_lo (Fault Condition:or total dwell >=)" VALUE 0x001c7f62 /* @ECU_Address@SPKD_dwabs_lo@0x010015E0@ */ ECIPP_ALIGNMENT_UWORD 210 Compu_SPKD_dwabs_lo 0 209.712 /end CHARACTERISTIC
/begin COMPU_METHOD Compu_SPKD_dwabs_lo " " RAT_FUNC "%.3" "ms" COEFFS 0 312.5 0 0 0 1 /end COMPU_METHOD
/begin CHARACTERISTIC SPKD_dwminv_lo "FaultConfig # SPKD_dwminv_lo (Fault Condition:Battery voltage >)" VALUE 0x001c7f66 /* @ECU_Address@SPKD_dwminv_lo@0x010015E8@ */ ECIPP_ALIGNMENT_UWORD 256 Compu_SPKD_dwminv_lo 0 255.99609375 /end CHARACTERISTIC
/begin COMPU_METHOD Compu_SPKD_dwminv_lo " " RAT_FUNC "%.3" "volts" COEFFS 0 256 0 0 0 1 /end COMPU_METHOD
/begin CHARACTERISTIC SPKD_dw_hi "FaultConfig # SPKD_dw_hi (Fault Condition:dwell adjustment <=)" VALUE 0x001c459c /* @ECU_Address@SPKD_dw_hi@0x010015F0@ */ ECIPP_ALIGNMENT_SWORD 105 Compu_SPKD_dw_hi -104.8576 104.8544 /end CHARACTERISTIC
/begin COMPU_METHOD Compu_SPKD_dw_hi " " RAT_FUNC "%.3" "ms" COEFFS 0 312.5 0 0 0 1 /end COMPU_METHOD
/begin CHARACTERISTIC SPKD_dwabs_hi "FaultConfig # SPKD_dwabs_hi (Fault Condition:or total dwell <=)" VALUE 0x001c7f60 /* @ECU_Address@SPKD_dwabs_hi@0x010015F8@ */ ECIPP_ALIGNMENT_UWORD 210 Compu_SPKD_dwabs_hi 0 209.712 /end CHARACTERISTIC
/begin COMPU_METHOD Compu_SPKD_dwabs_hi " " RAT_FUNC "%.3" "ms" COEFFS 0 312.5 0 0 0 1 /end COMPU_METHOD
/begin CHARACTERISTIC SPKD_dwmaxv_hi "FaultConfig # SPKD_dwmaxv_hi (Fault Condition:Battery voltage <)" VALUE 0x001c7f64 /* @ECU_Address@SPKD_dwmaxv_hi@0x01001600@ */ ECIPP_ALIGNMENT_UWORD 256 Compu_SPKD_dwmaxv_hi 0 255.99609375 /end CHARACTERISTIC
/begin COMPU_METHOD Compu_SPKD_dwmaxv_hi " " RAT_FUNC "%.3" "volts" COEFFS 0 256 0 0 0 1 /end COMPU_METHOD
/begin CHARACTERISTIC crknoise_rpm "FaultConfig # crknoise_rpm (Fault Condition:and RPM >)" VALUE 0x001c83f6 /* @ECU_Address@crknoise_rpm@0x01001608@ */ ECIPP_ALIGNMENT_UWORD 65535 Compu_crknoise_rpm 0 65535 /end CHARACTERISTIC
/begin COMPU_METHOD Compu_crknoise_rpm " " RAT_FUNC "%.0" "rpm" COEFFS 0 1 0 0 0 1 /end COMPU_METHOD
/begin CHARACTERISTIC camloss_rpm "FaultConfig # camloss_rpm (Fault Condition:and RPM >)" VALUE 0x001c83c4 /* @ECU_Address@camloss_rpm@0x01001610@ */ ECIPP_ALIGNMENT_UWORD 65535 Compu_camloss_rpm 0 65535 /end CHARACTERISTIC
/begin COMPU_METHOD Compu_camloss_rpm " " RAT_FUNC "%.0" "rpm" COEFFS 0 1 0 0 0 1 /end COMPU_METHOD
/begin CHARACTERISTIC crknoise "FaultConfig # crknoise (Fault Condition:Number of invalid crank re-syncs)" VALUE 0x001c83f4 /* @ECU_Address@crknoise@0x01001618@ */ ECIPP_ALIGNMENT_UWORD 65535 Compu_crknoise 0 65535 /end CHARACTERISTIC
/begin COMPU_METHOD Compu_crknoise " " RAT_FUNC "%.0" "re-syncs" COEFFS 0 1 0 0 0 1 /end COMPU_METHOD
/begin CHARACTERISTIC camnoise "FaultConfig # camnoise (Fault Condition:Number of invalid cam re-syncs)" VALUE 0x001c83c6 /* @ECU_Address@camnoise@0x01001620@ */ ECIPP_ALIGNMENT_UWORD 65535 Compu_camnoise 0 65535 /end CHARACTERISTIC
/begin COMPU_METHOD Compu_camnoise " " RAT_FUNC "%.0" "re-syncs" COEFFS 0 1 0 0 0 1 /end COMPU_METHOD
/begin CHARACTERISTIC CHT_HiExp "FaultConfig # CHT_HiExp (Fault Condition:CHT >)" VALUE 0x001c6e04 /* @ECU_Address@CHT_HiExp@0x01001628@ */ ECIPP_ALIGNMENT_UWORD 564 Compu_CHT_HiExp -460 563.984375 /end CHARACTERISTIC
/begin COMPU_METHOD Compu_CHT_HiExp " " RAT_FUNC "%.3" "deg F" COEFFS 0 64 29440 0 0 1 /end COMPU_METHOD
/begin CHARACTERISTIC CHT_HiExp_rpm "FaultConfig # CHT_HiExp_rpm (Fault Condition:and RPM >)" VALUE 0x001c6e0a /* @ECU_Address@CHT_HiExp_rpm@0x01001630@ */ ECIPP_ALIGNMENT_UWORD 65535 Compu_CHT_HiExp_rpm 0 65535 /end CHARACTERISTIC
/begin COMPU_METHOD Compu_CHT_HiExp_rpm " " RAT_FUNC "%.0" "rpm" COEFFS 0 1 0 0 0 1 /end COMPU_METHOD
/begin CHARACTERISTIC CHT_HiExp2 "FaultConfig # CHT_HiExp2 (Fault Condition:CHT >)" VALUE 0x001c6e06 /* @ECU_Address@CHT_HiExp2@0x01001638@ */ ECIPP_ALIGNMENT_UWORD 564 Compu_CHT_HiExp2 -460 563.984375 /end CHARACTERISTIC
/begin COMPU_METHOD Compu_CHT_HiExp2 " " RAT_FUNC "%.3" "deg F" COEFFS 0 64 29440 0 0 1 /end COMPU_METHOD
/begin CHARACTERISTIC CHT_HiExp2_rpm "FaultConfig # CHT_HiExp2_rpm (Fault Condition:and RPM >)" VALUE 0x001c6e08 /* @ECU_Address@CHT_HiExp2_rpm@0x01001640@ */ ECIPP_ALIGNMENT_UWORD 65535 Compu_CHT_HiExp2_rpm 0 65535 /end CHARACTERISTIC
/begin COMPU_METHOD Compu_CHT_HiExp2_rpm " " RAT_FUNC "%.0" "rpm" COEFFS 0 1 0 0 0 1 /end COMPU_METHOD
/begin CHARACTERISTIC crknoise_tout "FaultConfig # crknoise_tout (Fault Condition:within a time window of <=)" VALUE 0x001c83f8 /* @ECU_Address@crknoise_tout@0x01001658@ */ ECIPP_ALIGNMENT_UWORD 65535 Compu_crknoise_tout 0 65535 /end CHARACTERISTIC
/begin COMPU_METHOD Compu_crknoise_tout " " RAT_FUNC "%.0" "ms" COEFFS 0 1 0 0 0 1 /end COMPU_METHOD
/begin CHARACTERISTIC camnoise_tout "FaultConfig # camnoise_tout (Fault Condition:within a time window of <=)" VALUE 0x001c83c8 /* @ECU_Address@camnoise_tout@0x01001660@ */ ECIPP_ALIGNMENT_UWORD 65535 Compu_camnoise_tout 0 65535 /end CHARACTERISTIC
/begin COMPU_METHOD Compu_camnoise_tout " " RAT_FUNC "%.0" "ms" COEFFS 0 1 0 0 0 1 /end COMPU_METHOD
/begin CHARACTERISTIC MAP_max_unlch "General # MAP_max_unlch (Fault Condition:to unlatch, MAP pressure must be <)" VALUE 0x001c7d52 /* @ECU_Address@MAP_max_unlch@0x010016A8@ */ ECIPP_ALIGNMENT_UWORD 256 Compu_MAP_max_unlch 0 255.99609375 /end CHARACTERISTIC
/begin COMPU_METHOD Compu_MAP_max_unlch " " RAT_FUNC "%.3" "psia" COEFFS 0 256 0 0 0 1 /end COMPU_METHOD
/begin CHARACTERISTIC MAP_minv_unlch "General # MAP_minv_unlch (Fault Condition:to unlatch, MAP voltage must be >)" VALUE 0x001c7d5a /* @ECU_Address@MAP_minv_unlch@0x010016B0@ */ ECIPP_ALIGNMENT_UWORD 5 Compu_MAP_minv_unlch 0 5.00114468864469 /end CHARACTERISTIC
/begin COMPU_METHOD Compu_MAP_minv_unlch " " RAT_FUNC "%.3" "volts" COEFFS 0 13104 0 0 0 1 /end COMPU_METHOD
/begin CHARACTERISTIC APD1_max "FaultConfig # APD1_max (Fault Condition:AUX analog PD1 >)" VALUE 0x001e3748 /* @ECU_Address@APD1_max@0x01001708@ */ ECIPP_ALIGNMENT_UWORD 5 Compu_APD1_max 0 5.00114468864469 /end CHARACTERISTIC
/begin COMPU_METHOD Compu_APD1_max " " RAT_FUNC "%.3" "volts" COEFFS 0 13104 0 0 0 1 /end COMPU_METHOD
/begin CHARACTERISTIC APD1_min "FaultConfig # APD1_min (Fault Condition:AUX analog PD1 <)" VALUE 0x001e374a /* @ECU_Address@APD1_min@0x01001710@ */ ECIPP_ALIGNMENT_UWORD 5 Compu_APD1_min 0 5.00114468864469 /end CHARACTERISTIC
/begin COMPU_METHOD Compu_APD1_min " " RAT_FUNC "%.3" "volts" COEFFS 0 13104 0 0 0 1 /end COMPU_METHOD
/begin CHARACTERISTIC APU1_max "FaultConfig # APU1_max (Fault Condition:AUX analog PU1 >)" VALUE 0x001e3754 /* @ECU_Address@APU1_max@0x01001718@ */ ECIPP_ALIGNMENT_UWORD 5 Compu_APU1_max 0 5.00114468864469 /end CHARACTERISTIC
/begin COMPU_METHOD Compu_APU1_max " " RAT_FUNC "%.3" "volts" COEFFS 0 13104 0 0 0 1 /end COMPU_METHOD
/begin CHARACTERISTIC APU1_min "FaultConfig # APU1_min (Fault Condition:AUX analog PU1 <)" VALUE 0x001e3756 /* @ECU_Address@APU1_min@0x01001720@ */ ECIPP_ALIGNMENT_UWORD 5 Compu_APU1_min 0 5.00114468864469 /end CHARACTERISTIC
/begin COMPU_METHOD Compu_APU1_min " " RAT_FUNC "%.3" "volts" COEFFS 0 13104 0 0 0 1 /end COMPU_METHOD
/begin CHARACTERISTIC APU2_max "FaultConfig # APU2_max (Fault Condition:AUX analog PU2 >)" VALUE 0x001e3758 /* @ECU_Address@APU2_max@0x01001728@ */ ECIPP_ALIGNMENT_UWORD 5 Compu_APU2_max 0 5.00114468864469 /end CHARACTERISTIC
/begin COMPU_METHOD Compu_APU2_max " " RAT_FUNC "%.3" "volts" COEFFS 0 13104 0 0 0 1 /end COMPU_METHOD
/begin CHARACTERISTIC APU2_min "FaultConfig # APU2_min (Fault Condition:AUX analog PU2 <)" VALUE 0x001e375a /* @ECU_Address@APU2_min@0x01001730@ */ ECIPP_ALIGNMENT_UWORD 5 Compu_APU2_min 0 5.00114468864469 /end CHARACTERISTIC
/begin COMPU_METHOD Compu_APU2_min " " RAT_FUNC "%.3" "volts" COEFFS 0 13104 0 0 0 1 /end COMPU_METHOD
/begin CHARACTERISTIC OILP_wait "FaultConfig # OILP_wait (Fault Condition:Run time wait for all oil pressure low faults:)" VALUE 0x001c42cc /* @ECU_Address@OILP_wait@0x01001780@ */ ECIPP_ALIGNMENT_ULONG 4294967 Compu_OILP_wait 0 4294967.295 /end CHARACTERISTIC
/begin COMPU_METHOD Compu_OILP_wait " " RAT_FUNC "%.3" "seconds" COEFFS 0 1000 0 0 0 1 /end COMPU_METHOD
/begin CHARACTERISTIC RS485_Rx_inact "IOConfig # RS485_Rx_inact (Fault Condition:Power alive >)" VALUE 0x001c42dc /* @ECU_Address@RS485_Rx_inact@0x01001808@ */ ECIPP_ALIGNMENT_ULONG 4294967 Compu_RS485_Rx_inact 0 4294967.295 /end CHARACTERISTIC
/begin COMPU_METHOD Compu_RS485_Rx_inact " " RAT_FUNC "%.3" "sec" COEFFS 0 1000 0 0 0 1 /end COMPU_METHOD
/begin CHARACTERISTIC RS485_Rx_noise "IOConfig # RS485_Rx_noise (Fault Condition:Number of noisy packets >=)" VALUE 0x001c7eb2 /* @ECU_Address@RS485_Rx_noise@0x01001810@ */ ECIPP_ALIGNMENT_UWORD 65535 Compu_RS485_Rx_noise 0 65535 /end CHARACTERISTIC
/begin COMPU_METHOD Compu_RS485_Rx_noise " " RAT_FUNC "%.0" "packets" COEFFS 0 1 0 0 0 1 /end COMPU_METHOD
/begin CHARACTERISTIC RS485_bad_fmt "IOConfig # RS485_bad_fmt (Fault Condition:Number of invalid formats >=)" VALUE 0x001c7eb6 /* @ECU_Address@RS485_bad_fmt@0x01001818@ */ ECIPP_ALIGNMENT_UWORD 65535 Compu_RS485_bad_fmt 0 65535 /end CHARACTERISTIC
/begin COMPU_METHOD Compu_RS485_bad_fmt " " RAT_FUNC "%.0" "packets" COEFFS 0 1 0 0 0 1 /end COMPU_METHOD
/begin CHARACTERISTIC RS485_SD_rq "IOConfig # RS485_SD_rq (Fault Condition:Number of shutdown requests >=)" VALUE 0x001c7eb4 /* @ECU_Address@RS485_SD_rq@0x01001820@ */ ECIPP_ALIGNMENT_UWORD 65535 Compu_RS485_SD_rq 0 65535 /end CHARACTERISTIC
/begin COMPU_METHOD Compu_RS485_SD_rq " " RAT_FUNC "%.0" "requests" COEFFS 0 1 0 0 0 1 /end COMPU_METHOD
/begin CHARACTERISTIC FPP1_IVS_max "FaultConfig # FPP1_IVS_max (Fault Condition:IVS at-idle when FPP1 >)" VALUE 0x001c6f78 /* @ECU_Address@FPP1_IVS_max@0x010018A0@ */ ECIPP_ALIGNMENT_UWORD 5 Compu_FPP1_IVS_max 0 5.00114468864469 /end CHARACTERISTIC
/begin COMPU_METHOD Compu_FPP1_IVS_max " " RAT_FUNC "%.3" "volts" COEFFS 0 13104 0 0 0 1 /end COMPU_METHOD
/begin CHARACTERISTIC FPP1_IVS_min "FaultConfig # FPP1_IVS_min (Fault Condition:IVS off-idle when FPP1 <)" VALUE 0x001c6f7a /* @ECU_Address@FPP1_IVS_min@0x010018A8@ */ ECIPP_ALIGNMENT_UWORD 5 Compu_FPP1_IVS_min 0 5.00114468864469 /end CHARACTERISTIC
/begin COMPU_METHOD Compu_FPP1_IVS_min " " RAT_FUNC "%.3" "volts" COEFFS 0 13104 0 0 0 1 /end COMPU_METHOD
/begin CHARACTERISTIC FPP2_IVS_max "FaultConfig # FPP2_IVS_max (Fault Condition:IVS at-idle when FPP2 >)" VALUE 0x001c6f80 /* @ECU_Address@FPP2_IVS_max@0x010018B0@ */ ECIPP_ALIGNMENT_UWORD 5 Compu_FPP2_IVS_max 0 5.00114468864469 /end CHARACTERISTIC
/begin COMPU_METHOD Compu_FPP2_IVS_max " " RAT_FUNC "%.3" "volts" COEFFS 0 13104 0 0 0 1 /end COMPU_METHOD
/begin CHARACTERISTIC FPP2_IVS_min "FaultConfig # FPP2_IVS_min (Fault Condition:IVS off-idle when FPP2 <)" VALUE 0x001c6f82 /* @ECU_Address@FPP2_IVS_min@0x010018B8@ */ ECIPP_ALIGNMENT_UWORD 5 Compu_FPP2_IVS_min 0 5.00114468864469 /end CHARACTERISTIC
/begin COMPU_METHOD Compu_FPP2_IVS_min " " RAT_FUNC "%.3" "volts" COEFFS 0 13104 0 0 0 1 /end COMPU_METHOD
/begin CHARACTERISTIC max_gov_override "FaultConfig # max_gov_override (Fault Condition:rpm >)" VALUE 0x001c84a2 /* @ECU_Address@max_gov_override@0x010018C0@ */ ECIPP_ALIGNMENT_UWORD 65535 Compu_max_gov_override 0 65535 /end CHARACTERISTIC
/begin COMPU_METHOD Compu_max_gov_override " " RAT_FUNC "%.0" "rpm" COEFFS 0 1 0 0 0 1 /end COMPU_METHOD
/begin CHARACTERISTIC FPPatidle_min "IOConfig # FPPatidle_min" VALUE 0x001c6fae /* @ECU_Address@FPPatidle_min@0x010018D8@ */ ECIPP_ALIGNMENT_UWORD 5 Compu_FPPatidle_min 0 5.00114468864469 /end CHARACTERISTIC
/begin COMPU_METHOD Compu_FPPatidle_min " " RAT_FUNC "%.3" "volts" COEFFS 0 13104 0 0 0 1 /end COMPU_METHOD
/begin CHARACTERISTIC FPPatidle_max "IOConfig # FPPatidle_max" VALUE 0x001c6fac /* @ECU_Address@FPPatidle_max@0x010018E0@ */ ECIPP_ALIGNMENT_UWORD 5 Compu_FPPatidle_max 0 5.00114468864469 /end CHARACTERISTIC
/begin COMPU_METHOD Compu_FPPatidle_max " " RAT_FUNC "%.3" "volts" COEFFS 0 13104 0 0 0 1 /end COMPU_METHOD
/begin CHARACTERISTIC FPPatidle_IVSdelta "IOConfig # FPPatidle_IVSdelta (Fault Condition:and FPP1 < FPP1 learned idle +)" VALUE 0x001c6fa8 /* @ECU_Address@FPPatidle_IVSdelta@0x010018E8@ */ ECIPP_ALIGNMENT_UWORD 5 Compu_FPPatidle_IVSdelta 0 5.00114468864469 /end CHARACTERISTIC
/begin COMPU_METHOD Compu_FPPatidle_IVSdelta " " RAT_FUNC "%.3" "volts" COEFFS 0 13104 0 0 0 1 /end COMPU_METHOD
/begin CHARACTERISTIC FPPatidle_IVSmargin "IOConfig # FPPatidle_IVSmargin" VALUE 0x001c6faa /* @ECU_Address@FPPatidle_IVSmargin@0x010018F0@ */ ECIPP_ALIGNMENT_UWORD 5 Compu_FPPatidle_IVSmargin 0 5.00114468864469 /end CHARACTERISTIC
/begin COMPU_METHOD Compu_FPPatidle_IVSmargin " " RAT_FUNC "%.3" "volts" COEFFS 0 13104 0 0 0 1 /end COMPU_METHOD
/begin CHARACTERISTIC FPPatidle_ena "{FPPatidle_ena&0xff=0:Disabled}{FPPatidle_ena&0xff=1:Enabled} (Fault Condition:OR IVS off-idle if FPP1 @idle fault)" VALUE 0x001c8726 /* @ECU_Address@FPPatidle_ena@0x010018F8@ */ ECIPP_ALIGNMENT_UBYTE 255 FPPatidle_ena_COMPU_VTAB 0 255 BIT_MASK 0xff /end CHARACTERISTIC
/begin COMPU_METHOD FPPatidle_ena_COMPU_VTAB "Verbal Table" TAB_VERB "%.0" "list" COMPU_TAB_REF FPPatidle_ena_COMPU_VTAB_REF /end COMPU_METHOD
/begin COMPU_VTAB FPPatidle_ena_COMPU_VTAB_REF "Verbal Table" TAB_VERB 2 0 "Disabled" 1 "Enabled" DEFAULT_VALUE "UNKNOWN" /end COMPU_VTAB
/begin CHARACTERISTIC FPP1_idle_init "IOConfig # FPP1_idle_init" VALUE 0x001C9D22 /* @ECU_Address@FPP1_idle_init@0x01001900@ */ ECIPP_ALIGNMENT_UWORD 5 Compu_FPP1_idle_init 0 5.00114468864469 /end CHARACTERISTIC
/begin COMPU_METHOD Compu_FPP1_idle_init " " RAT_FUNC "%.3" "volts" COEFFS 0 13104 0 0 0 1 /end COMPU_METHOD
/begin CHARACTERISTIC FPP1_full_init "IOConfig # FPP1_full_init" VALUE 0x001C9D24 /* @ECU_Address@FPP1_full_init@0x01001908@ */ ECIPP_ALIGNMENT_UWORD 5 Compu_FPP1_full_init 0 5.00114468864469 /end CHARACTERISTIC
/begin COMPU_METHOD Compu_FPP1_full_init " " RAT_FUNC "%.3" "volts" COEFFS 0 13104 0 0 0 1 /end COMPU_METHOD
/begin CHARACTERISTIC FPP1_def "IOConfig # FPP1_def" VALUE 0x001C9D1C /* @ECU_Address@FPP1_def@0x01001910@ */ ECIPP_ALIGNMENT_UWORD 5 Compu_FPP1_def 0 5.00114468864469 /end CHARACTERISTIC
/begin COMPU_METHOD Compu_FPP1_def " " RAT_FUNC "%.3" "volts" COEFFS 0 13104 0 0 0 1 /end COMPU_METHOD
/begin CHARACTERISTIC FPP2_idle_init "IOConfig # FPP2_idle_init" VALUE 0x001C9D2C /* @ECU_Address@FPP2_idle_init@0x01001918@ */ ECIPP_ALIGNMENT_UWORD 5 Compu_FPP2_idle_init 0 5.00114468864469 /end CHARACTERISTIC
/begin COMPU_METHOD Compu_FPP2_idle_init " " RAT_FUNC "%.3" "volts" COEFFS 0 13104 0 0 0 1 /end COMPU_METHOD
/begin CHARACTERISTIC FPP2_full_init "IOConfig # FPP2_full_init" VALUE 0x001C9D2E /* @ECU_Address@FPP2_full_init@0x01001920@ */ ECIPP_ALIGNMENT_UWORD 5 Compu_FPP2_full_init 0 5.00114468864469 /end CHARACTERISTIC
/begin COMPU_METHOD Compu_FPP2_full_init " " RAT_FUNC "%.3" "volts" COEFFS 0 13104 0 0 0 1 /end COMPU_METHOD
/begin CHARACTERISTIC FPP2_def "IOConfig # FPP2_def" VALUE 0x001C9D26 /* @ECU_Address@FPP2_def@0x01001928@ */ ECIPP_ALIGNMENT_UWORD 5 Compu_FPP2_def 0 5.00114468864469 /end CHARACTERISTIC
/begin COMPU_METHOD Compu_FPP2_def " " RAT_FUNC "%.3" "volts" COEFFS 0 13104 0 0 0 1 /end COMPU_METHOD
/begin CHARACTERISTIC IVS_trans_wait "IOConfig # IVS_trans_wait" VALUE 0x001c7c66 /* @ECU_Address@IVS_trans_wait@0x01001940@ */ ECIPP_ALIGNMENT_UWORD 65535 Compu_IVS_trans_wait 0 65535 /end CHARACTERISTIC
/begin COMPU_METHOD Compu_IVS_trans_wait " " RAT_FUNC "%.0" "ms" COEFFS 0 1 0 0 0 1 /end COMPU_METHOD
/begin CHARACTERISTIC IVS_FPPpwr_pct "IOConfig # IVS_FPPpwr_pct" VALUE 0x001c7c64 /* @ECU_Address@IVS_FPPpwr_pct@0x01001948@ */ ECIPP_ALIGNMENT_UWORD 100 Compu_IVS_FPPpwr_pct 0 99.9984741210938 /end CHARACTERISTIC
/begin COMPU_METHOD Compu_IVS_FPPpwr_pct " " RAT_FUNC "%.3" "%" COEFFS 0 655.36 0 0 0 1 /end COMPU_METHOD
/begin CHARACTERISTIC MJ_Pe_HiExp "FaultConfig # MJ_Pe_HiExp (Fault Condition:EPR (actual-commanded) pressure >)" VALUE 0x001c4568 /* @ECU_Address@MJ_Pe_HiExp@0x010021D8@ */ ECIPP_ALIGNMENT_SWORD 222 Compu_MJ_Pe_HiExp -222 221.993225097656 /end CHARACTERISTIC
/begin COMPU_METHOD Compu_MJ_Pe_HiExp " " RAT_FUNC "%.3" "in H2O" COEFFS 0 147.603603603604 0 0 0 1 /end COMPU_METHOD
/begin CHARACTERISTIC MJ_Pe_LoExp "FaultConfig # MJ_Pe_LoExp (Fault Condition:EPR (actual-commanded) pressure <)" VALUE 0x001c456a /* @ECU_Address@MJ_Pe_LoExp@0x010021E0@ */ ECIPP_ALIGNMENT_SWORD 222 Compu_MJ_Pe_LoExp -222 221.993225097656 /end CHARACTERISTIC
/begin COMPU_METHOD Compu_MJ_Pe_LoExp " " RAT_FUNC "%.3" "in H2O" COEFFS 0 147.603603603604 0 0 0 1 /end COMPU_METHOD
/begin CHARACTERISTIC MJ_comm_tout "FaultConfig # MJ_comm_tout (Fault Condition:No EPR / CFV packets received within)" VALUE 0x001c7dc0 /* @ECU_Address@MJ_comm_tout@0x010021E8@ */ ECIPP_ALIGNMENT_UWORD 65535 Compu_MJ_comm_tout 0 65535 /end CHARACTERISTIC
/begin COMPU_METHOD Compu_MJ_comm_tout " " RAT_FUNC "%.0" "ms" COEFFS 0 1 0 0 0 1 /end COMPU_METHOD
/begin CHARACTERISTIC DPS_I_min "EPR I min" VALUE 0x001c4498 /* @ECU_Address@DPS_I_min@0x01002420@ */ ECIPP_ALIGNMENT_SWORD 25599 Compu_DPS_I_min -25600 25599.21875 MAX_REFRESH 6 1 /end CHARACTERISTIC
/begin COMPU_METHOD Compu_DPS_I_min " " RAT_FUNC "%.1" "%" COEFFS 0 1.28 0 0 0 1 /end COMPU_METHOD
/begin CHARACTERISTIC DPS_I_max "EPR I max" VALUE 0x001c4496 /* @ECU_Address@DPS_I_max@0x01002428@ */ ECIPP_ALIGNMENT_SWORD 25599 Compu_DPS_I_max -25600 25599.21875 MAX_REFRESH 6 1 /end CHARACTERISTIC
/begin COMPU_METHOD Compu_DPS_I_max " " RAT_FUNC "%.1" "%" COEFFS 0 1.28 0 0 0 1 /end COMPU_METHOD
/begin CHARACTERISTIC DPS_AcmdLP "EPR area output LP tau" VALUE 0x001c8522 /* @ECU_Address@DPS_AcmdLP@0x01002430@ */ ECIPP_ALIGNMENT_UWORD 163840 Compu_DPS_AcmdLP 0.16703 163840 MAX_REFRESH 6 1 /end CHARACTERISTIC
/begin COMPU_METHOD Compu_DPS_AcmdLP " " FORM "%.1" "ms"
 /begin FORMULA "-5 / log(1.0000000000001 - (X1 / 32768))" FORMULA_INV "(1.0000000000001 - exp(-5/X1)) * 32768" /end FORMULA
/end COMPU_METHOD
/begin CHARACTERISTIC DPS_SenseLP "EPR sensor input LP tau" VALUE 0x001c8524 /* @ECU_Address@DPS_SenseLP@0x01002438@ */ ECIPP_ALIGNMENT_UWORD 32768 Compu_DPS_SenseLP 0.045084 32768 MAX_REFRESH 6 1 /end CHARACTERISTIC
/begin COMPU_METHOD Compu_DPS_SenseLP " " FORM "%.1" "ms"
 /begin FORMULA "-0.5 / log(1 - (X1 / 65536))" FORMULA_INV "(1 - exp(-0.5/X1)) * 65536" /end FORMULA
/end COMPU_METHOD
/begin CHARACTERISTIC MJI_Pstart "EPR internal default start press" VALUE 0x001c4566 /* @ECU_Address@MJI_Pstart@0x01002440@ */ ECIPP_ALIGNMENT_SWORD 64 Compu_MJI_Pstart -64 63.998046875 MAX_REFRESH 6 1 /end CHARACTERISTIC
/begin COMPU_METHOD Compu_MJI_Pstart " " RAT_FUNC "%.2" "in H2O" COEFFS 0 512 0 0 0 1 /end COMPU_METHOD
/begin CHARACTERISTIC DBW_Vcomp_min "Gov # DBW_Vcomp_min" VALUE 0x001C9CBA /* @ECU_Address@DBW_Vcomp_min@0x010027C8@ */ ECIPP_ALIGNMENT_UWORD 256 Compu_DBW_Vcomp_min 0 255.99609375 /end CHARACTERISTIC
/begin COMPU_METHOD Compu_DBW_Vcomp_min " " RAT_FUNC "%.3" "volts" COEFFS 0 256 0 0 0 1 /end COMPU_METHOD
/begin CHARACTERISTIC DBW_Vcomp_max "Gov # DBW_Vcomp_max" VALUE 0x001C9CBC /* @ECU_Address@DBW_Vcomp_max@0x010027D0@ */ ECIPP_ALIGNMENT_UWORD 256 Compu_DBW_Vcomp_max 0 255.99609375 /end CHARACTERISTIC
/begin COMPU_METHOD Compu_DBW_Vcomp_max " " RAT_FUNC "%.3" "volts" COEFFS 0 256 0 0 0 1 /end COMPU_METHOD
/begin CHARACTERISTIC TPS_learn_idle_seek "Gov # TPS_learn_idle_seek" VALUE 0x001C9C2E /* @ECU_Address@TPS_learn_idle_seek@0x010027D8@ */ ECIPP_ALIGNMENT_UWORD 100 Compu_TPS_learn_idle_seek 0 99.9984741210938 /end CHARACTERISTIC
/begin COMPU_METHOD Compu_TPS_learn_idle_seek " " RAT_FUNC "%.3" "%" COEFFS 0 655.36 0 0 0 1 /end COMPU_METHOD
/begin CHARACTERISTIC TPS_learn_full_seek "Gov # TPS_learn_full_seek" VALUE 0x001C9C34 /* @ECU_Address@TPS_learn_full_seek@0x010027E0@ */ ECIPP_ALIGNMENT_UWORD 100 Compu_TPS_learn_full_seek 0 99.9984741210938 /end CHARACTERISTIC
/begin COMPU_METHOD Compu_TPS_learn_full_seek " " RAT_FUNC "%.3" "%" COEFFS 0 655.36 0 0 0 1 /end COMPU_METHOD
/begin CHARACTERISTIC TIP_maxMAP "FaultConfig # TIP_maxMAP (Fault Condition:and MAP <)" VALUE 0x001c80fc /* @ECU_Address@TIP_maxMAP@0x01002988@ */ ECIPP_ALIGNMENT_UWORD 256 Compu_TIP_maxMAP 0 255.99609375 /end CHARACTERISTIC
/begin COMPU_METHOD Compu_TIP_maxMAP " " RAT_FUNC "%.3" "psia" COEFFS 0 256 0 0 0 1 /end COMPU_METHOD
/begin CHARACTERISTIC TIP_minv "FaultConfig # TIP_minv (Fault Condition:TIP/TOP voltage <)" VALUE 0x001c8100 /* @ECU_Address@TIP_minv@0x01002990@ */ ECIPP_ALIGNMENT_UWORD 5 Compu_TIP_minv 0 5.00114468864469 /end CHARACTERISTIC
/begin COMPU_METHOD Compu_TIP_minv " " RAT_FUNC "%.3" "volts" COEFFS 0 13104 0 0 0 1 /end COMPU_METHOD
/begin CHARACTERISTIC TIP_maxv "FaultConfig # TIP_maxv (Fault Condition:TIP/TOP voltage >)" VALUE 0x001c80fe /* @ECU_Address@TIP_maxv@0x01002998@ */ ECIPP_ALIGNMENT_UWORD 5 Compu_TIP_maxv 0 5.00114468864469 /end CHARACTERISTIC
/begin COMPU_METHOD Compu_TIP_maxv " " RAT_FUNC "%.3" "volts" COEFFS 0 13104 0 0 0 1 /end COMPU_METHOD
/begin CHARACTERISTIC FP_maxv "FaultConfig # FP_maxv (Fault Condition:Primary FP voltage >)" VALUE 0x001C9F68 /* @ECU_Address@FP_maxv@0x010029D0@ */ ECIPP_ALIGNMENT_UWORD 5 Compu_FP_maxv 0 5.00114468864469 /end CHARACTERISTIC
/begin COMPU_METHOD Compu_FP_maxv " " RAT_FUNC "%.3" "volts" COEFFS 0 13104 0 0 0 1 /end COMPU_METHOD
/begin CHARACTERISTIC FP_minv "FaultConfig # FP_minv (Fault Condition:Primary FP voltage <)" VALUE 0x001C9F6A /* @ECU_Address@FP_minv@0x010029D8@ */ ECIPP_ALIGNMENT_UWORD 5 Compu_FP_minv 0 5.00114468864469 /end CHARACTERISTIC
/begin COMPU_METHOD Compu_FP_minv " " RAT_FUNC "%.3" "volts" COEFFS 0 13104 0 0 0 1 /end COMPU_METHOD
/begin CHARACTERISTIC FT_maxv "FaultConfig # FT_maxv (Fault Condition:FT voltage >)" VALUE 0x001c7b96 /* @ECU_Address@FT_maxv@0x010029E0@ */ ECIPP_ALIGNMENT_UWORD 5 Compu_FT_maxv 0 5.00114468864469 /end CHARACTERISTIC
/begin COMPU_METHOD Compu_FT_maxv " " RAT_FUNC "%.3" "volts" COEFFS 0 13104 0 0 0 1 /end COMPU_METHOD
/begin CHARACTERISTIC FT_minv "FaultConfig # FT_minv (Fault Condition:FT voltage <)" VALUE 0x001c7b98 /* @ECU_Address@FT_minv@0x010029E8@ */ ECIPP_ALIGNMENT_UWORD 5 Compu_FT_minv 0 5.00114468864469 /end CHARACTERISTIC
/begin COMPU_METHOD Compu_FT_minv " " RAT_FUNC "%.3" "volts" COEFFS 0 13104 0 0 0 1 /end COMPU_METHOD
/begin CHARACTERISTIC OilP_hiP_RPM "FaultConfig # OilP_hiP_RPM (Fault Condition:and RPM >)" VALUE 0x001c7e28 /* @ECU_Address@OilP_hiP_RPM@0x01002BC0@ */ ECIPP_ALIGNMENT_UWORD 65535 Compu_OilP_hiP_RPM 0 65535 /end CHARACTERISTIC
/begin COMPU_METHOD Compu_OilP_hiP_RPM " " RAT_FUNC "%.0" "rpm" COEFFS 0 1 0 0 0 1 /end COMPU_METHOD
/begin CHARACTERISTIC crkloss "Spark # crkloss (Fault Condition:Cam pulses without crank activity >)" VALUE 0x001c83f2 /* @ECU_Address@crkloss@0x01002C08@ */ ECIPP_ALIGNMENT_UWORD 65535 Compu_crkloss 0 65535 /end CHARACTERISTIC
/begin COMPU_METHOD Compu_crkloss " " RAT_FUNC "%.0" "cam pulses" COEFFS 0 1 0 0 0 1 /end COMPU_METHOD
/begin CHARACTERISTIC J1939_TxFail "FaultConfig # J1939_TxFail (Fault Condition:Tx error counter >)" VALUE 0x001C9491 /* @ECU_Address@J1939_TxFail@0x01002D38@ */ ECIPP_ALIGNMENT_UBYTE 255 Compu_J1939_TxFail 0 255 /end CHARACTERISTIC
/begin COMPU_METHOD Compu_J1939_TxFail " " RAT_FUNC "%.0" "failures" COEFFS 0 1 0 0 0 1 /end COMPU_METHOD
/begin CHARACTERISTIC J1939_RxFail "FaultConfig # J1939_RxFail (Fault Condition:Rx error counter >)" VALUE 0x001C9492 /* @ECU_Address@J1939_RxFail@0x01002D40@ */ ECIPP_ALIGNMENT_UBYTE 255 Compu_J1939_RxFail 0 255 /end CHARACTERISTIC
/begin COMPU_METHOD Compu_J1939_RxFail " " RAT_FUNC "%.0" "failures" COEFFS 0 1 0 0 0 1 /end COMPU_METHOD
/begin CHARACTERISTIC DBW_IAC_mode "DBW / IAC configuration{DBW_IAC_mode&0xff=0:DBW}{DBW_IAC_mode&0xff=1:IAC}" VALUE 0x001c86b9 /* @ECU_Address@DBW_IAC_mode@0x01002DB8@ */ ECIPP_ALIGNMENT_UBYTE 255 DBW_IAC_mode_COMPU_VTAB 0 255 BIT_MASK 0xff /end CHARACTERISTIC
/begin COMPU_METHOD DBW_IAC_mode_COMPU_VTAB "Verbal Table" TAB_VERB "%.0" "list" COMPU_TAB_REF DBW_IAC_mode_COMPU_VTAB_REF /end COMPU_METHOD
/begin COMPU_VTAB DBW_IAC_mode_COMPU_VTAB_REF "Verbal Table" TAB_VERB 2 0 "DBW" 1 "IAC" DEFAULT_VALUE "UNKNOWN" /end COMPU_VTAB
/begin CHARACTERISTIC MIL_persist_min "FaultConfig # MIL_persist_min" VALUE 0x001c7d9e /* @ECU_Address@MIL_persist_min@0x01003270@ */ ECIPP_ALIGNMENT_UWORD 66 Compu_MIL_persist_min 0 65.535 /end CHARACTERISTIC
/begin COMPU_METHOD Compu_MIL_persist_min " " RAT_FUNC "%.3" "seconds" COEFFS 0 1000 0 0 0 1 /end COMPU_METHOD
/begin CHARACTERISTIC FPP2atidle_min "IOConfig # FPP2atidle_min" VALUE 0x001c6f8a /* @ECU_Address@FPP2atidle_min@0x01003420@ */ ECIPP_ALIGNMENT_UWORD 5 Compu_FPP2atidle_min 0 5.00114468864469 /end CHARACTERISTIC
/begin COMPU_METHOD Compu_FPP2atidle_min " " RAT_FUNC "%.3" "volts" COEFFS 0 13104 0 0 0 1 /end COMPU_METHOD
/begin CHARACTERISTIC FPP2atidle_max "IOConfig # FPP2atidle_max" VALUE 0x001c6f88 /* @ECU_Address@FPP2atidle_max@0x01003428@ */ ECIPP_ALIGNMENT_UWORD 5 Compu_FPP2atidle_max 0 5.00114468864469 /end CHARACTERISTIC
/begin COMPU_METHOD Compu_FPP2atidle_max " " RAT_FUNC "%.3" "volts" COEFFS 0 13104 0 0 0 1 /end COMPU_METHOD
/begin CHARACTERISTIC FPP2atidle_IVSdelta "IOConfig # FPP2atidle_IVSdelta (Fault Condition:and FPP2 < FPP2 learned idle +)" VALUE 0x001c6f84 /* @ECU_Address@FPP2atidle_IVSdelta@0x01003430@ */ ECIPP_ALIGNMENT_UWORD 5 Compu_FPP2atidle_IVSdelta 0 5.00114468864469 /end CHARACTERISTIC
/begin COMPU_METHOD Compu_FPP2atidle_IVSdelta " " RAT_FUNC "%.3" "volts" COEFFS 0 13104 0 0 0 1 /end COMPU_METHOD
/begin CHARACTERISTIC FPP2atidle_IVSmargin "IOConfig # FPP2atidle_IVSmargin" VALUE 0x001c6f86 /* @ECU_Address@FPP2atidle_IVSmargin@0x01003438@ */ ECIPP_ALIGNMENT_UWORD 5 Compu_FPP2atidle_IVSmargin 0 5.00114468864469 /end CHARACTERISTIC
/begin COMPU_METHOD Compu_FPP2atidle_IVSmargin " " RAT_FUNC "%.3" "volts" COEFFS 0 13104 0 0 0 1 /end COMPU_METHOD
/begin CHARACTERISTIC FPP2atidle_ena "{FPP2atidle_ena&0xff=0:Disabled}{FPP2atidle_ena&0xff=1:Enabled} (Fault Condition:or IVS off-idle if FPP2 @idle fault)" VALUE 0x001c8718 /* @ECU_Address@FPP2atidle_ena@0x01003440@ */ ECIPP_ALIGNMENT_UBYTE 255 FPP2atidle_ena_COMPU_VTAB 0 255 BIT_MASK 0xff /end CHARACTERISTIC
/begin COMPU_METHOD FPP2atidle_ena_COMPU_VTAB "Verbal Table" TAB_VERB "%.0" "list" COMPU_TAB_REF FPP2atidle_ena_COMPU_VTAB_REF /end COMPU_METHOD
/begin COMPU_VTAB FPP2atidle_ena_COMPU_VTAB_REF "Verbal Table" TAB_VERB 2 0 "Disabled" 1 "Enabled" DEFAULT_VALUE "UNKNOWN" /end COMPU_VTAB
/begin CHARACTERISTIC DBW_spring_0 "Gov # DBW_spring_0" VALUE 0x001C9CA2 /* @ECU_Address@DBW_spring_0@0x010034F8@ */ ECIPP_ALIGNMENT_SWORD 200 Compu_DBW_spring_0 -200 199.993896484375 /end CHARACTERISTIC
/begin COMPU_METHOD Compu_DBW_spring_0 " " RAT_FUNC "%.3" "%" COEFFS 0 163.84 0 0 0 1 /end COMPU_METHOD
/begin CHARACTERISTIC DBW_spring_100 "Gov # DBW_spring_100" VALUE 0x001C9CA4 /* @ECU_Address@DBW_spring_100@0x01003500@ */ ECIPP_ALIGNMENT_SWORD 200 Compu_DBW_spring_100 -200 199.993896484375 /end CHARACTERISTIC
/begin COMPU_METHOD Compu_DBW_spring_100 " " RAT_FUNC "%.3" "%" COEFFS 0 163.84 0 0 0 1 /end COMPU_METHOD
/begin MEASUREMENT CCP_slave_address "IOConfig # CCP_slave_address" UWORD Compu_CCP_slave_address 0 0 0 65535 ECU_ADDRESS 0x01003538 /end MEASUREMENT
/begin COMPU_METHOD Compu_CCP_slave_address " " RAT_FUNC "%.0" "-" COEFFS 0 1 0 0 0 1 /end COMPU_METHOD
/begin MEASUREMENT CCP_resource "IOConfig # CCP_resource" UBYTE Compu_CCP_resource 0 0 0 255 ECU_ADDRESS 0x01003540 /end MEASUREMENT
/begin COMPU_METHOD Compu_CCP_resource " " RAT_FUNC "%.0" "-" COEFFS 0 1 0 0 0 1 /end COMPU_METHOD
/begin CHARACTERISTIC PWM1_off_loVf "FaultConfig # PWM1_off_loVf (Fault Condition:PWM 1 low-side feedback <)" VALUE 0x001e5770 /* @ECU_Address@PWM1_off_loVf@0x01003708@ */ ECIPP_ALIGNMENT_UWORD 100 Compu_PWM1_off_loVf 0 99.9984741210938 /end CHARACTERISTIC
/begin COMPU_METHOD Compu_PWM1_off_loVf " " RAT_FUNC "%.3" "% Vbat" COEFFS 0 655.36 0 0 0 1 /end COMPU_METHOD
/begin CHARACTERISTIC PWM2_off_loVf "FaultConfig # PWM2_off_loVf (Fault Condition:PWM 2 low-side feedback <)" VALUE 0x001e579c /* @ECU_Address@PWM2_off_loVf@0x01003710@ */ ECIPP_ALIGNMENT_UWORD 100 Compu_PWM2_off_loVf 0 99.9984741210938 /end CHARACTERISTIC
/begin COMPU_METHOD Compu_PWM2_off_loVf " " RAT_FUNC "%.3" "% Vbat" COEFFS 0 655.36 0 0 0 1 /end COMPU_METHOD
/begin CHARACTERISTIC PWM3_off_loVf "FaultConfig # PWM3_off_loVf (Fault Condition:PWM 3 low-side feedback <)" VALUE 0x001e57a4 /* @ECU_Address@PWM3_off_loVf@0x01003718@ */ ECIPP_ALIGNMENT_UWORD 100 Compu_PWM3_off_loVf 0 99.9984741210938 /end CHARACTERISTIC
/begin COMPU_METHOD Compu_PWM3_off_loVf " " RAT_FUNC "%.3" "% Vbat" COEFFS 0 655.36 0 0 0 1 /end COMPU_METHOD
/begin CHARACTERISTIC PWM4_off_loVf "FaultConfig # PWM4_off_loVf (Fault Condition:PWM 4 low-side feedback <)" VALUE 0x001e57b0 /* @ECU_Address@PWM4_off_loVf@0x01003720@ */ ECIPP_ALIGNMENT_UWORD 100 Compu_PWM4_off_loVf 0 99.9984741210938 /end CHARACTERISTIC
/begin COMPU_METHOD Compu_PWM4_off_loVf " " RAT_FUNC "%.3" "% Vbat" COEFFS 0 655.36 0 0 0 1 /end COMPU_METHOD
/begin CHARACTERISTIC PWM5_off_loVf "FaultConfig # PWM5_off_loVf (Fault Condition:PWM 5 low-side feedback <)" VALUE 0x001e57b8 /* @ECU_Address@PWM5_off_loVf@0x01003728@ */ ECIPP_ALIGNMENT_UWORD 100 Compu_PWM5_off_loVf 0 99.9984741210938 /end CHARACTERISTIC
/begin COMPU_METHOD Compu_PWM5_off_loVf " " RAT_FUNC "%.3" "% Vbat" COEFFS 0 655.36 0 0 0 1 /end COMPU_METHOD
/begin CHARACTERISTIC PWM1_on_hiVf "FaultConfig # PWM1_on_hiVf (Fault Condition:PWM 1 low-side feedback >)" VALUE 0x001e5774 /* @ECU_Address@PWM1_on_hiVf@0x01003730@ */ ECIPP_ALIGNMENT_UWORD 100 Compu_PWM1_on_hiVf 0 99.9984741210938 /end CHARACTERISTIC
/begin COMPU_METHOD Compu_PWM1_on_hiVf " " RAT_FUNC "%.3" "% Vbat" COEFFS 0 655.36 0 0 0 1 /end COMPU_METHOD
/begin CHARACTERISTIC PWM2_on_hiVf "FaultConfig # PWM2_on_hiVf (Fault Condition:PWM 2 low-side feedback >)" VALUE 0x001e57a0 /* @ECU_Address@PWM2_on_hiVf@0x01003738@ */ ECIPP_ALIGNMENT_UWORD 100 Compu_PWM2_on_hiVf 0 99.9984741210938 /end CHARACTERISTIC
/begin COMPU_METHOD Compu_PWM2_on_hiVf " " RAT_FUNC "%.3" "% Vbat" COEFFS 0 655.36 0 0 0 1 /end COMPU_METHOD
/begin CHARACTERISTIC PWM3_on_hiVf "FaultConfig # PWM3_on_hiVf (Fault Condition:PWM 3 low-side feedback >)" VALUE 0x001e57a8 /* @ECU_Address@PWM3_on_hiVf@0x01003740@ */ ECIPP_ALIGNMENT_UWORD 100 Compu_PWM3_on_hiVf 0 99.9984741210938 /end CHARACTERISTIC
/begin COMPU_METHOD Compu_PWM3_on_hiVf " " RAT_FUNC "%.3" "% Vbat" COEFFS 0 655.36 0 0 0 1 /end COMPU_METHOD
/begin CHARACTERISTIC PWM4_on_hiVf "FaultConfig # PWM4_on_hiVf (Fault Condition:PWM 4 low-side feedback >)" VALUE 0x001e57b4 /* @ECU_Address@PWM4_on_hiVf@0x01003748@ */ ECIPP_ALIGNMENT_UWORD 100 Compu_PWM4_on_hiVf 0 99.9984741210938 /end CHARACTERISTIC
/begin COMPU_METHOD Compu_PWM4_on_hiVf " " RAT_FUNC "%.3" "% Vbat" COEFFS 0 655.36 0 0 0 1 /end COMPU_METHOD
/begin CHARACTERISTIC PWM5_on_hiVf "FaultConfig # PWM5_on_hiVf (Fault Condition:PWM 5 low-side feedback >)" VALUE 0x001e57bc /* @ECU_Address@PWM5_on_hiVf@0x01003750@ */ ECIPP_ALIGNMENT_UWORD 100 Compu_PWM5_on_hiVf 0 99.9984741210938 /end CHARACTERISTIC
/begin COMPU_METHOD Compu_PWM5_on_hiVf " " RAT_FUNC "%.3" "% Vbat" COEFFS 0 655.36 0 0 0 1 /end COMPU_METHOD
/begin CHARACTERISTIC PWM1_off_loDC "FaultConfig # PWM1_off_loDC (Fault Condition:and PWM duty-cycle <)" VALUE 0x001e576e /* @ECU_Address@PWM1_off_loDC@0x01003758@ */ ECIPP_ALIGNMENT_UWORD 100 Compu_PWM1_off_loDC 0 99.9984741210938 /end CHARACTERISTIC
/begin COMPU_METHOD Compu_PWM1_off_loDC " " RAT_FUNC "%.3" "%" COEFFS 0 655.36 0 0 0 1 /end COMPU_METHOD
/begin CHARACTERISTIC PWM2_off_loDC "FaultConfig # PWM2_off_loDC (Fault Condition:and PWM duty-cycle <)" VALUE 0x001e579a /* @ECU_Address@PWM2_off_loDC@0x01003760@ */ ECIPP_ALIGNMENT_UWORD 100 Compu_PWM2_off_loDC 0 99.9984741210938 /end CHARACTERISTIC
/begin COMPU_METHOD Compu_PWM2_off_loDC " " RAT_FUNC "%.3" "%" COEFFS 0 655.36 0 0 0 1 /end COMPU_METHOD
/begin CHARACTERISTIC PWM3_off_loDC "FaultConfig # PWM3_off_loDC (Fault Condition:and PWM duty-cycle <)" VALUE 0x001e57a2 /* @ECU_Address@PWM3_off_loDC@0x01003768@ */ ECIPP_ALIGNMENT_UWORD 100 Compu_PWM3_off_loDC 0 99.9984741210938 /end CHARACTERISTIC
/begin COMPU_METHOD Compu_PWM3_off_loDC " " RAT_FUNC "%.3" "%" COEFFS 0 655.36 0 0 0 1 /end COMPU_METHOD
/begin CHARACTERISTIC PWM4_off_loDC "FaultConfig # PWM4_off_loDC (Fault Condition:and PWM duty-cycle <)" VALUE 0x001e57ae /* @ECU_Address@PWM4_off_loDC@0x01003770@ */ ECIPP_ALIGNMENT_UWORD 100 Compu_PWM4_off_loDC 0 99.9984741210938 /end CHARACTERISTIC
/begin COMPU_METHOD Compu_PWM4_off_loDC " " RAT_FUNC "%.3" "%" COEFFS 0 655.36 0 0 0 1 /end COMPU_METHOD
/begin CHARACTERISTIC PWM5_off_loDC "FaultConfig # PWM5_off_loDC (Fault Condition:and PWM duty-cycle <)" VALUE 0x001e57b6 /* @ECU_Address@PWM5_off_loDC@0x01003778@ */ ECIPP_ALIGNMENT_UWORD 100 Compu_PWM5_off_loDC 0 99.9984741210938 /end CHARACTERISTIC
/begin COMPU_METHOD Compu_PWM5_off_loDC " " RAT_FUNC "%.3" "%" COEFFS 0 655.36 0 0 0 1 /end COMPU_METHOD
/begin CHARACTERISTIC PWM1_on_hiDC "FaultConfig # PWM1_on_hiDC (Fault Condition:and PWM duty-cycle >)" VALUE 0x001e5772 /* @ECU_Address@PWM1_on_hiDC@0x01003780@ */ ECIPP_ALIGNMENT_UWORD 100 Compu_PWM1_on_hiDC 0 99.9984741210938 /end CHARACTERISTIC
/begin COMPU_METHOD Compu_PWM1_on_hiDC " " RAT_FUNC "%.3" "%" COEFFS 0 655.36 0 0 0 1 /end COMPU_METHOD
/begin CHARACTERISTIC PWM2_on_hiDC "FaultConfig # PWM2_on_hiDC (Fault Condition:and PWM duty-cycle >)" VALUE 0x001e579e /* @ECU_Address@PWM2_on_hiDC@0x01003788@ */ ECIPP_ALIGNMENT_UWORD 100 Compu_PWM2_on_hiDC 0 99.9984741210938 /end CHARACTERISTIC
/begin COMPU_METHOD Compu_PWM2_on_hiDC " " RAT_FUNC "%.3" "%" COEFFS 0 655.36 0 0 0 1 /end COMPU_METHOD
/begin CHARACTERISTIC PWM3_on_hiDC "FaultConfig # PWM3_on_hiDC (Fault Condition:and PWM duty-cycle >)" VALUE 0x001e57a6 /* @ECU_Address@PWM3_on_hiDC@0x01003790@ */ ECIPP_ALIGNMENT_UWORD 100 Compu_PWM3_on_hiDC 0 99.9984741210938 /end CHARACTERISTIC
/begin COMPU_METHOD Compu_PWM3_on_hiDC " " RAT_FUNC "%.3" "%" COEFFS 0 655.36 0 0 0 1 /end COMPU_METHOD
/begin CHARACTERISTIC PWM4_on_hiDC "FaultConfig # PWM4_on_hiDC (Fault Condition:and PWM duty-cycle >)" VALUE 0x001e57b2 /* @ECU_Address@PWM4_on_hiDC@0x01003798@ */ ECIPP_ALIGNMENT_UWORD 100 Compu_PWM4_on_hiDC 0 99.9984741210938 /end CHARACTERISTIC
/begin COMPU_METHOD Compu_PWM4_on_hiDC " " RAT_FUNC "%.3" "%" COEFFS 0 655.36 0 0 0 1 /end COMPU_METHOD
/begin CHARACTERISTIC PWM5_on_hiDC "FaultConfig # PWM5_on_hiDC (Fault Condition:and PWM duty-cycle >)" VALUE 0x001e57ba /* @ECU_Address@PWM5_on_hiDC@0x010037A0@ */ ECIPP_ALIGNMENT_UWORD 100 Compu_PWM5_on_hiDC 0 99.9984741210938 /end CHARACTERISTIC
/begin COMPU_METHOD Compu_PWM5_on_hiDC " " RAT_FUNC "%.3" "%" COEFFS 0 655.36 0 0 0 1 /end COMPU_METHOD
/begin CHARACTERISTIC APU3_max "FaultConfig # APU3_max (Fault Condition:AUX analog PU3 >)" VALUE 0x001e375c /* @ECU_Address@APU3_max@0x01003D38@ */ ECIPP_ALIGNMENT_UWORD 5 Compu_APU3_max 0 5.00114468864469 /end CHARACTERISTIC
/begin COMPU_METHOD Compu_APU3_max " " RAT_FUNC "%.3" "volts" COEFFS 0 13104 0 0 0 1 /end COMPU_METHOD
/begin CHARACTERISTIC FCdc4_UGF2_drifttol "FCtl_DTC_0x04(506)" VALUE 0x001E448A /* @ECU_Address@FCtl_DTC_0x04@0x024C43F4@ */ ECIPP_ALIGNMENT_UWORD 65535 Compu_IDENTITY 0 65535 PHYS_UNIT "System ID + DTC" /end CHARACTERISTIC
/begin CHARACTERISTIC FCdc4_UGF2_Hv_hi "FCtl_DTC_0x04(409)" VALUE 0x001E43C8 /* @ECU_Address@FCtl_DTC_0x04@0x024C4332@ */ ECIPP_ALIGNMENT_UWORD 65535 Compu_IDENTITY 0 65535 PHYS_UNIT "System ID + DTC" /end CHARACTERISTIC
/begin CHARACTERISTIC FCdc4_UGF2_internal "FCtl_DTC_0x04(408)" VALUE 0x001E43C6 /* @ECU_Address@FCtl_DTC_0x04@0x024C4330@ */ ECIPP_ALIGNMENT_UWORD 65535 Compu_IDENTITY 0 65535 PHYS_UNIT "System ID + DTC" /end CHARACTERISTIC
/begin CHARACTERISTIC FCdc4_UGF2_lowsupply "FCtl_DTC_0x04(531)" VALUE 0x001E44BC /* @ECU_Address@FCtl_DTC_0x04@0x024C4426@ */ ECIPP_ALIGNMENT_UWORD 65535 Compu_IDENTITY 0 65535 PHYS_UNIT "System ID + DTC" /end CHARACTERISTIC
/begin CHARACTERISTIC FCdc4_UGF2_R_hi "FCtl_DTC_0x04(411)" VALUE 0x001E43CC /* @ECU_Address@FCtl_DTC_0x04@0x024C4336@ */ ECIPP_ALIGNMENT_UWORD 65535 Compu_IDENTITY 0 65535 PHYS_UNIT "System ID + DTC" /end CHARACTERISTIC
/begin CHARACTERISTIC FCdc4_UGF2_SR_hi "FCtl_DTC_0x04(423)" VALUE 0x001E43E4 /* @ECU_Address@FCtl_DTC_0x04@0x024C434E@ */ ECIPP_ALIGNMENT_UWORD 65535 Compu_IDENTITY 0 65535 PHYS_UNIT "System ID + DTC" /end CHARACTERISTIC
/begin CHARACTERISTIC FCdc4_UGF2_SR_slow "FCtl_DTC_0x04(421)" VALUE 0x001E43E0 /* @ECU_Address@FCtl_DTC_0x04@0x024C434A@ */ ECIPP_ALIGNMENT_UWORD 65535 Compu_IDENTITY 0 65535 PHYS_UNIT "System ID + DTC" /end CHARACTERISTIC
/begin CHARACTERISTIC FCdc4_UGF2_Sv_hi "FCtl_DTC_0x04(417)" VALUE 0x001E43D8 /* @ECU_Address@FCtl_DTC_0x04@0x024C4342@ */ ECIPP_ALIGNMENT_UWORD 65535 Compu_IDENTITY 0 65535 PHYS_UNIT "System ID + DTC" /end CHARACTERISTIC
/begin CHARACTERISTIC FCdc4_UGF3_comm_lost "FCtl_DTC_0x04(682)" VALUE 0x001E45EA /* @ECU_Address@FCtl_DTC_0x04@0x024C4554@ */ ECIPP_ALIGNMENT_UWORD 65535 Compu_IDENTITY 0 65535 PHYS_UNIT "System ID + DTC" /end CHARACTERISTIC
/begin CHARACTERISTIC FCdc4_UGF3_drifttl2 "FCtl_DTC_0x04(604)" VALUE 0x001E454E /* @ECU_Address@FCtl_DTC_0x04@0x024C44B8@ */ ECIPP_ALIGNMENT_UWORD 65535 Compu_IDENTITY 0 65535 PHYS_UNIT "System ID + DTC" /end CHARACTERISTIC
/begin CHARACTERISTIC FCdc4_UGF3_drifttol "FCtl_DTC_0x04(603)" VALUE 0x001E454C /* @ECU_Address@FCtl_DTC_0x04@0x024C44B6@ */ ECIPP_ALIGNMENT_UWORD 65535 Compu_IDENTITY 0 65535 PHYS_UNIT "System ID + DTC" /end CHARACTERISTIC
/begin CHARACTERISTIC FCdc4_UGF3_Hv_hi "FCtl_DTC_0x04(605)" VALUE 0x001E4550 /* @ECU_Address@FCtl_DTC_0x04@0x024C44BA@ */ ECIPP_ALIGNMENT_UWORD 65535 Compu_IDENTITY 0 65535 PHYS_UNIT "System ID + DTC" /end CHARACTERISTIC
/begin CHARACTERISTIC FCdc4_UGF3_internal "FCtl_DTC_0x04(601)" VALUE 0x001E4548 /* @ECU_Address@FCtl_DTC_0x04@0x024C44B2@ */ ECIPP_ALIGNMENT_UWORD 65535 Compu_IDENTITY 0 65535 PHYS_UNIT "System ID + DTC" /end CHARACTERISTIC
/begin CHARACTERISTIC FCdc4_UGF3_lowsupply "FCtl_DTC_0x04(602)" VALUE 0x001E454A /* @ECU_Address@FCtl_DTC_0x04@0x024C44B4@ */ ECIPP_ALIGNMENT_UWORD 65535 Compu_IDENTITY 0 65535 PHYS_UNIT "System ID + DTC" /end CHARACTERISTIC
/begin CHARACTERISTIC FCdc4_UGF3_R_hi "FCtl_DTC_0x04(607)" VALUE 0x001E4554 /* @ECU_Address@FCtl_DTC_0x04@0x024C44BE@ */ ECIPP_ALIGNMENT_UWORD 65535 Compu_IDENTITY 0 65535 PHYS_UNIT "System ID + DTC" /end CHARACTERISTIC
/begin CHARACTERISTIC FCdc4_UGF3_SR_hi "FCtl_DTC_0x04(619)" VALUE 0x001E456C /* @ECU_Address@FCtl_DTC_0x04@0x024C44D6@ */ ECIPP_ALIGNMENT_UWORD 65535 Compu_IDENTITY 0 65535 PHYS_UNIT "System ID + DTC" /end CHARACTERISTIC
/begin CHARACTERISTIC FCdc4_UGF3_SR_slow "FCtl_DTC_0x04(617)" VALUE 0x001E4568 /* @ECU_Address@FCtl_DTC_0x04@0x024C44D2@ */ ECIPP_ALIGNMENT_UWORD 65535 Compu_IDENTITY 0 65535 PHYS_UNIT "System ID + DTC" /end CHARACTERISTIC
/begin CHARACTERISTIC FCdc4_UGF3_Sv_hi "FCtl_DTC_0x04(613)" VALUE 0x001E4560 /* @ECU_Address@FCtl_DTC_0x04@0x024C44CA@ */ ECIPP_ALIGNMENT_UWORD 65535 Compu_IDENTITY 0 65535 PHYS_UNIT "System ID + DTC" /end CHARACTERISTIC
/begin CHARACTERISTIC FCdc4_UGF4_comm_lost "FCtl_DTC_0x04(683)" VALUE 0x001E45EC /* @ECU_Address@FCtl_DTC_0x04@0x024C4556@ */ ECIPP_ALIGNMENT_UWORD 65535 Compu_IDENTITY 0 65535 PHYS_UNIT "System ID + DTC" /end CHARACTERISTIC
/begin CHARACTERISTIC FCdc4_UGF4_drifttl2 "FCtl_DTC_0x04(627)" VALUE 0x001E457C /* @ECU_Address@FCtl_DTC_0x04@0x024C44E6@ */ ECIPP_ALIGNMENT_UWORD 65535 Compu_IDENTITY 0 65535 PHYS_UNIT "System ID + DTC" /end CHARACTERISTIC
/begin CHARACTERISTIC FCdc4_UGF4_drifttol "FCtl_DTC_0x04(626)" VALUE 0x001E457A /* @ECU_Address@FCtl_DTC_0x04@0x024C44E4@ */ ECIPP_ALIGNMENT_UWORD 65535 Compu_IDENTITY 0 65535 PHYS_UNIT "System ID + DTC" /end CHARACTERISTIC
/begin CHARACTERISTIC FCdc4_UGF4_Hv_hi "FCtl_DTC_0x04(628)" VALUE 0x001E457E /* @ECU_Address@FCtl_DTC_0x04@0x024C44E8@ */ ECIPP_ALIGNMENT_UWORD 65535 Compu_IDENTITY 0 65535 PHYS_UNIT "System ID + DTC" /end CHARACTERISTIC
/begin CHARACTERISTIC FCdc4_UGF4_internal "FCtl_DTC_0x04(624)" VALUE 0x001E4576 /* @ECU_Address@FCtl_DTC_0x04@0x024C44E0@ */ ECIPP_ALIGNMENT_UWORD 65535 Compu_IDENTITY 0 65535 PHYS_UNIT "System ID + DTC" /end CHARACTERISTIC
/begin CHARACTERISTIC FCdc4_UGF4_lowsupply "FCtl_DTC_0x04(625)" VALUE 0x001E4578 /* @ECU_Address@FCtl_DTC_0x04@0x024C44E2@ */ ECIPP_ALIGNMENT_UWORD 65535 Compu_IDENTITY 0 65535 PHYS_UNIT "System ID + DTC" /end CHARACTERISTIC
/begin CHARACTERISTIC FCdc4_UGF4_R_hi "FCtl_DTC_0x04(630)" VALUE 0x001E4582 /* @ECU_Address@FCtl_DTC_0x04@0x024C44EC@ */ ECIPP_ALIGNMENT_UWORD 65535 Compu_IDENTITY 0 65535 PHYS_UNIT "System ID + DTC" /end CHARACTERISTIC
/begin CHARACTERISTIC FCdc4_UGF4_SR_hi "FCtl_DTC_0x04(642)" VALUE 0x001E459A /* @ECU_Address@FCtl_DTC_0x04@0x024C4504@ */ ECIPP_ALIGNMENT_UWORD 65535 Compu_IDENTITY 0 65535 PHYS_UNIT "System ID + DTC" /end CHARACTERISTIC
/begin CHARACTERISTIC FCdc4_UGF4_SR_slow "FCtl_DTC_0x04(640)" VALUE 0x001E4596 /* @ECU_Address@FCtl_DTC_0x04@0x024C4500@ */ ECIPP_ALIGNMENT_UWORD 65535 Compu_IDENTITY 0 65535 PHYS_UNIT "System ID + DTC" /end CHARACTERISTIC
/begin CHARACTERISTIC FCdc4_UGF4_Sv_hi "FCtl_DTC_0x04(636)" VALUE 0x001E458E /* @ECU_Address@FCtl_DTC_0x04@0x024C44F8@ */ ECIPP_ALIGNMENT_UWORD 65535 Compu_IDENTITY 0 65535 PHYS_UNIT "System ID + DTC" /end CHARACTERISTIC
/begin CHARACTERISTIC FCdc4_V_max "FCtl_DTC_0x04(9)" VALUE 0x001E40A8 /* @ECU_Address@FCtl_DTC_0x04@0x024C4012@ */ ECIPP_ALIGNMENT_UWORD 65535 Compu_IDENTITY 0 65535 PHYS_UNIT "System ID + DTC" /end CHARACTERISTIC
/begin CHARACTERISTIC FCdc4_V_min "FCtl_DTC_0x04(10)" VALUE 0x001E40AA /* @ECU_Address@FCtl_DTC_0x04@0x024C4014@ */ ECIPP_ALIGNMENT_UWORD 65535 Compu_IDENTITY 0 65535 PHYS_UNIT "System ID + DTC" /end CHARACTERISTIC
/begin CHARACTERISTIC FCdc4_VE5_max "FCtl_DTC_0x04(11)" VALUE 0x001E40AC /* @ECU_Address@FCtl_DTC_0x04@0x024C4016@ */ ECIPP_ALIGNMENT_UWORD 65535 Compu_IDENTITY 0 65535 PHYS_UNIT "System ID + DTC" /end CHARACTERISTIC
/begin CHARACTERISTIC FCdc4_VE5_min "FCtl_DTC_0x04(12)" VALUE 0x001E40AE /* @ECU_Address@FCtl_DTC_0x04@0x024C4018@ */ ECIPP_ALIGNMENT_UWORD 65535 Compu_IDENTITY 0 65535 PHYS_UNIT "System ID + DTC" /end CHARACTERISTIC
/begin CHARACTERISTIC FCdc4_VE5ab_OOR "FCtl_DTC_0x04(183)" VALUE 0x001E4204 /* @ECU_Address@FCtl_DTC_0x04@0x024C416E@ */ ECIPP_ALIGNMENT_UWORD 65535 Compu_IDENTITY 0 65535 PHYS_UNIT "System ID + DTC" /end CHARACTERISTIC
/begin CHARACTERISTIC FCdc4_VE5b_max "FCtl_DTC_0x04(181)" VALUE 0x001E4200 /* @ECU_Address@FCtl_DTC_0x04@0x024C416A@ */ ECIPP_ALIGNMENT_UWORD 65535 Compu_IDENTITY 0 65535 PHYS_UNIT "System ID + DTC" /end CHARACTERISTIC
/begin CHARACTERISTIC FCdc4_VE5b_min "FCtl_DTC_0x04(182)" VALUE 0x001E4202 /* @ECU_Address@FCtl_DTC_0x04@0x024C416C@ */ ECIPP_ALIGNMENT_UWORD 65535 Compu_IDENTITY 0 65535 PHYS_UNIT "System ID + DTC" /end CHARACTERISTIC
/begin CHARACTERISTIC FCdc4_VE5c_max "FCtl_DTC_0x04(507)" VALUE 0x001E448C /* @ECU_Address@FCtl_DTC_0x04@0x024C43F6@ */ ECIPP_ALIGNMENT_UWORD 65535 Compu_IDENTITY 0 65535 PHYS_UNIT "System ID + DTC" /end CHARACTERISTIC
/begin CHARACTERISTIC FCdc4_VE5c_min "FCtl_DTC_0x04(508)" VALUE 0x001E448E /* @ECU_Address@FCtl_DTC_0x04@0x024C43F8@ */ ECIPP_ALIGNMENT_UWORD 65535 Compu_IDENTITY 0 65535 PHYS_UNIT "System ID + DTC" /end CHARACTERISTIC
/begin CHARACTERISTIC FCdc4_WGCV_comm_lost "FCtl_DTC_0x04(1037)" VALUE 0x001E48B0 /* @ECU_Address@FCtl_DTC_0x04@0x024C481A@ */ ECIPP_ALIGNMENT_UWORD 65535 Compu_IDENTITY 0 65535 PHYS_UNIT "System ID + DTC" /end CHARACTERISTIC
/begin CHARACTERISTIC FCdc4_WGCV_func_lost "FCtl_DTC_0x04(1039)" VALUE 0x001E48B4 /* @ECU_Address@FCtl_DTC_0x04@0x024C481E@ */ ECIPP_ALIGNMENT_UWORD 65535 Compu_IDENTITY 0 65535 PHYS_UNIT "System ID + DTC" /end CHARACTERISTIC
/begin CHARACTERISTIC FCdc4_WGCV_perf_limit "FCtl_DTC_0x04(1038)" VALUE 0x001E48B2 /* @ECU_Address@FCtl_DTC_0x04@0x024C481C@ */ ECIPP_ALIGNMENT_UWORD 65535 Compu_IDENTITY 0 65535 PHYS_UNIT "System ID + DTC" /end CHARACTERISTIC
/begin CHARACTERISTIC FCdc4_WGP_maxv "FCtl_DTC_0x04(141)" VALUE 0x001E41B0 /* @ECU_Address@FCtl_DTC_0x04@0x024C411A@ */ ECIPP_ALIGNMENT_UWORD 65535 Compu_IDENTITY 0 65535 PHYS_UNIT "System ID + DTC" /end CHARACTERISTIC
/begin CHARACTERISTIC FCdc4_WGP_minv "FCtl_DTC_0x04(142)" VALUE 0x001E41B2 /* @ECU_Address@FCtl_DTC_0x04@0x024C411C@ */ ECIPP_ALIGNMENT_UWORD 65535 Compu_IDENTITY 0 65535 PHYS_UNIT "System ID + DTC" /end CHARACTERISTIC
/begin CHARACTERISTIC FCdc4_WGPerr_neg "FCtl_DTC_0x04(697)" VALUE 0x001E4608 /* @ECU_Address@FCtl_DTC_0x04@0x024C4572@ */ ECIPP_ALIGNMENT_UWORD 65535 Compu_IDENTITY 0 65535 PHYS_UNIT "System ID + DTC" /end CHARACTERISTIC
/begin CHARACTERISTIC FCdc4_WGPerr_pos "FCtl_DTC_0x04(696)" VALUE 0x001E4606 /* @ECU_Address@FCtl_DTC_0x04@0x024C4570@ */ ECIPP_ALIGNMENT_UWORD 65535 Compu_IDENTITY 0 65535 PHYS_UNIT "System ID + DTC" /end CHARACTERISTIC
/begin CHARACTERISTIC FCdc4_WTRIN_detect "FCtl_DTC_0x04(292)" VALUE 0x001E42DE /* @ECU_Address@FCtl_DTC_0x04@0x024C4248@ */ ECIPP_ALIGNMENT_UWORD 65535 Compu_IDENTITY 0 65535 PHYS_UNIT "System ID + DTC" /end CHARACTERISTIC
/begin CHARACTERISTIC FCdc4_XEGOi_OOR "FCtl_DTC_0x04(802)" VALUE 0x001E46DA /* @ECU_Address@FCtl_DTC_0x04@0x024C4644@ */ ECIPP_ALIGNMENT_UWORD 65535 Compu_IDENTITY 0 65535 PHYS_UNIT "System ID + DTC" /end CHARACTERISTIC
/begin CHARACTERISTIC FPnd_UGF2_drifttol "FPrm_pending(385)" VALUE 0x001E5414 /* @ECU_Address@FPrm_pending@0x021BE302@ */ ECIPP_ALIGNMENT_UWORD 65535 Compu_IDENTITY 0 65535 PHYS_UNIT "Bit Mask" /end CHARACTERISTIC
/begin CHARACTERISTIC FPnd_UGF2_Hv_hi "FPrm_pending(318)" VALUE 0x001E538E /* @ECU_Address@FPrm_pending@0x021BE27C@ */ ECIPP_ALIGNMENT_UWORD 65535 Compu_IDENTITY 0 65535 PHYS_UNIT "Bit Mask" /end CHARACTERISTIC
/begin CHARACTERISTIC FPnd_UGF2_internal "FPrm_pending(317)" VALUE 0x001E538C /* @ECU_Address@FPrm_pending@0x021BE27A@ */ ECIPP_ALIGNMENT_UWORD 65535 Compu_IDENTITY 0 65535 PHYS_UNIT "Bit Mask" /end CHARACTERISTIC
/begin CHARACTERISTIC FPnd_UGF2_lowsupply "FPrm_pending(401)" VALUE 0x001E5434 /* @ECU_Address@FPrm_pending@0x021BE322@ */ ECIPP_ALIGNMENT_UWORD 65535 Compu_IDENTITY 0 65535 PHYS_UNIT "Bit Mask" /end CHARACTERISTIC
/begin CHARACTERISTIC FPnd_UGF2_R_hi "FPrm_pending(319)" VALUE 0x001E5390 /* @ECU_Address@FPrm_pending@0x021BE27E@ */ ECIPP_ALIGNMENT_UWORD 65535 Compu_IDENTITY 0 65535 PHYS_UNIT "Bit Mask" /end CHARACTERISTIC
/begin CHARACTERISTIC FPnd_UGF2_SR_hi "FPrm_pending(322)" VALUE 0x001E5396 /* @ECU_Address@FPrm_pending@0x021BE284@ */ ECIPP_ALIGNMENT_UWORD 65535 Compu_IDENTITY 0 65535 PHYS_UNIT "Bit Mask" /end CHARACTERISTIC
/begin CHARACTERISTIC FPnd_UGF2_SR_slow "FPrm_pending(321)" VALUE 0x001E5394 /* @ECU_Address@FPrm_pending@0x021BE282@ */ ECIPP_ALIGNMENT_UWORD 65535 Compu_IDENTITY 0 65535 PHYS_UNIT "Bit Mask" /end CHARACTERISTIC
/begin CHARACTERISTIC FPnd_UGF2_Sv_hi "FPrm_pending(320)" VALUE 0x001E5392 /* @ECU_Address@FPrm_pending@0x021BE280@ */ ECIPP_ALIGNMENT_UWORD 65535 Compu_IDENTITY 0 65535 PHYS_UNIT "Bit Mask" /end CHARACTERISTIC
/begin CHARACTERISTIC FPnd_UGF3_comm_lost "FPrm_pending(512)" VALUE 0x001E5512 /* @ECU_Address@FPrm_pending@0x021BE400@ */ ECIPP_ALIGNMENT_UWORD 65535 Compu_IDENTITY 0 65535 PHYS_UNIT "Bit Mask" /end CHARACTERISTIC
/begin CHARACTERISTIC FPnd_UGF3_drifttl2 "FPrm_pending(458)" VALUE 0x001E54A6 /* @ECU_Address@FPrm_pending@0x021BE394@ */ ECIPP_ALIGNMENT_UWORD 65535 Compu_IDENTITY 0 65535 PHYS_UNIT "Bit Mask" /end CHARACTERISTIC
/begin CHARACTERISTIC FPnd_UGF3_drifttol "FPrm_pending(457)" VALUE 0x001E54A4 /* @ECU_Address@FPrm_pending@0x021BE392@ */ ECIPP_ALIGNMENT_UWORD 65535 Compu_IDENTITY 0 65535 PHYS_UNIT "Bit Mask" /end CHARACTERISTIC
/begin CHARACTERISTIC FPnd_UGF3_Hv_hi "FPrm_pending(459)" VALUE 0x001E54A8 /* @ECU_Address@FPrm_pending@0x021BE396@ */ ECIPP_ALIGNMENT_UWORD 65535 Compu_IDENTITY 0 65535 PHYS_UNIT "Bit Mask" /end CHARACTERISTIC
/begin CHARACTERISTIC FPnd_UGF3_internal "FPrm_pending(455)" VALUE 0x001E54A0 /* @ECU_Address@FPrm_pending@0x021BE38E@ */ ECIPP_ALIGNMENT_UWORD 65535 Compu_IDENTITY 0 65535 PHYS_UNIT "Bit Mask" /end CHARACTERISTIC
/begin CHARACTERISTIC FPnd_UGF3_lowsupply "FPrm_pending(456)" VALUE 0x001E54A2 /* @ECU_Address@FPrm_pending@0x021BE390@ */ ECIPP_ALIGNMENT_UWORD 65535 Compu_IDENTITY 0 65535 PHYS_UNIT "Bit Mask" /end CHARACTERISTIC
/begin CHARACTERISTIC FPnd_UGF3_R_hi "FPrm_pending(460)" VALUE 0x001E54AA /* @ECU_Address@FPrm_pending@0x021BE398@ */ ECIPP_ALIGNMENT_UWORD 65535 Compu_IDENTITY 0 65535 PHYS_UNIT "Bit Mask" /end CHARACTERISTIC
/begin CHARACTERISTIC FPnd_UGF3_SR_hi "FPrm_pending(463)" VALUE 0x001E54B0 /* @ECU_Address@FPrm_pending@0x021BE39E@ */ ECIPP_ALIGNMENT_UWORD 65535 Compu_IDENTITY 0 65535 PHYS_UNIT "Bit Mask" /end CHARACTERISTIC
/begin CHARACTERISTIC FPnd_UGF3_SR_slow "FPrm_pending(462)" VALUE 0x001E54AE /* @ECU_Address@FPrm_pending@0x021BE39C@ */ ECIPP_ALIGNMENT_UWORD 65535 Compu_IDENTITY 0 65535 PHYS_UNIT "Bit Mask" /end CHARACTERISTIC
/begin CHARACTERISTIC FPnd_UGF3_Sv_hi "FPrm_pending(461)" VALUE 0x001E54AC /* @ECU_Address@FPrm_pending@0x021BE39A@ */ ECIPP_ALIGNMENT_UWORD 65535 Compu_IDENTITY 0 65535 PHYS_UNIT "Bit Mask" /end CHARACTERISTIC
/begin CHARACTERISTIC FPnd_UGF4_comm_lost "FPrm_pending(513)" VALUE 0x001E5514 /* @ECU_Address@FPrm_pending@0x021BE402@ */ ECIPP_ALIGNMENT_UWORD 65535 Compu_IDENTITY 0 65535 PHYS_UNIT "Bit Mask" /end CHARACTERISTIC
/begin CHARACTERISTIC FPnd_UGF4_drifttl2 "FPrm_pending(469)" VALUE 0x001E54BC /* @ECU_Address@FPrm_pending@0x021BE3AA@ */ ECIPP_ALIGNMENT_UWORD 65535 Compu_IDENTITY 0 65535 PHYS_UNIT "Bit Mask" /end CHARACTERISTIC
/begin CHARACTERISTIC FPnd_UGF4_drifttol "FPrm_pending(468)" VALUE 0x001E54BA /* @ECU_Address@FPrm_pending@0x021BE3A8@ */ ECIPP_ALIGNMENT_UWORD 65535 Compu_IDENTITY 0 65535 PHYS_UNIT "Bit Mask" /end CHARACTERISTIC
/begin CHARACTERISTIC FPnd_UGF4_Hv_hi "FPrm_pending(470)" VALUE 0x001E54BE /* @ECU_Address@FPrm_pending@0x021BE3AC@ */ ECIPP_ALIGNMENT_UWORD 65535 Compu_IDENTITY 0 65535 PHYS_UNIT "Bit Mask" /end CHARACTERISTIC
/begin CHARACTERISTIC FPnd_UGF4_internal "FPrm_pending(466)" VALUE 0x001E54B6 /* @ECU_Address@FPrm_pending@0x021BE3A4@ */ ECIPP_ALIGNMENT_UWORD 65535 Compu_IDENTITY 0 65535 PHYS_UNIT "Bit Mask" /end CHARACTERISTIC
/begin CHARACTERISTIC FPnd_UGF4_lowsupply "FPrm_pending(467)" VALUE 0x001E54B8 /* @ECU_Address@FPrm_pending@0x021BE3A6@ */ ECIPP_ALIGNMENT_UWORD 65535 Compu_IDENTITY 0 65535 PHYS_UNIT "Bit Mask" /end CHARACTERISTIC
/begin CHARACTERISTIC FPnd_UGF4_R_hi "FPrm_pending(471)" VALUE 0x001E54C0 /* @ECU_Address@FPrm_pending@0x021BE3AE@ */ ECIPP_ALIGNMENT_UWORD 65535 Compu_IDENTITY 0 65535 PHYS_UNIT "Bit Mask" /end CHARACTERISTIC
/begin CHARACTERISTIC FPnd_UGF4_SR_hi "FPrm_pending(474)" VALUE 0x001E54C6 /* @ECU_Address@FPrm_pending@0x021BE3B4@ */ ECIPP_ALIGNMENT_UWORD 65535 Compu_IDENTITY 0 65535 PHYS_UNIT "Bit Mask" /end CHARACTERISTIC
/begin CHARACTERISTIC FPnd_UGF4_SR_slow "FPrm_pending(473)" VALUE 0x001E54C4 /* @ECU_Address@FPrm_pending@0x021BE3B2@ */ ECIPP_ALIGNMENT_UWORD 65535 Compu_IDENTITY 0 65535 PHYS_UNIT "Bit Mask" /end CHARACTERISTIC
/begin CHARACTERISTIC FPnd_UGF4_Sv_hi "FPrm_pending(472)" VALUE 0x001E54C2 /* @ECU_Address@FPrm_pending@0x021BE3B0@ */ ECIPP_ALIGNMENT_UWORD 65535 Compu_IDENTITY 0 65535 PHYS_UNIT "Bit Mask" /end CHARACTERISTIC
/begin CHARACTERISTIC FPnd_V_max "FPrm_pending(14)" VALUE 0x001E512E /* @ECU_Address@FPrm_pending@0x021BE01C@ */ ECIPP_ALIGNMENT_UWORD 65535 Compu_IDENTITY 0 65535 PHYS_UNIT "Bit Mask" /end CHARACTERISTIC
/begin CHARACTERISTIC FPnd_V_min "FPrm_pending(15)" VALUE 0x001E5130 /* @ECU_Address@FPrm_pending@0x021BE01E@ */ ECIPP_ALIGNMENT_UWORD 65535 Compu_IDENTITY 0 65535 PHYS_UNIT "Bit Mask" /end CHARACTERISTIC
/begin CHARACTERISTIC FPnd_VE5_max "FPrm_pending(16)" VALUE 0x001E5132 /* @ECU_Address@FPrm_pending@0x021BE020@ */ ECIPP_ALIGNMENT_UWORD 65535 Compu_IDENTITY 0 65535 PHYS_UNIT "Bit Mask" /end CHARACTERISTIC
/begin CHARACTERISTIC FPnd_VE5_min "FPrm_pending(17)" VALUE 0x001E5134 /* @ECU_Address@FPrm_pending@0x021BE022@ */ ECIPP_ALIGNMENT_UWORD 65535 Compu_IDENTITY 0 65535 PHYS_UNIT "Bit Mask" /end CHARACTERISTIC
/begin CHARACTERISTIC FPnd_VE5ab_OOR "FPrm_pending(143)" VALUE 0x001E5230 /* @ECU_Address@FPrm_pending@0x021BE11E@ */ ECIPP_ALIGNMENT_UWORD 65535 Compu_IDENTITY 0 65535 PHYS_UNIT "Bit Mask" /end CHARACTERISTIC
/begin CHARACTERISTIC FPnd_VE5b_max "FPrm_pending(141)" VALUE 0x001E522C /* @ECU_Address@FPrm_pending@0x021BE11A@ */ ECIPP_ALIGNMENT_UWORD 65535 Compu_IDENTITY 0 65535 PHYS_UNIT "Bit Mask" /end CHARACTERISTIC
/begin CHARACTERISTIC FPnd_VE5b_min "FPrm_pending(142)" VALUE 0x001E522E /* @ECU_Address@FPrm_pending@0x021BE11C@ */ ECIPP_ALIGNMENT_UWORD 65535 Compu_IDENTITY 0 65535 PHYS_UNIT "Bit Mask" /end CHARACTERISTIC
/begin CHARACTERISTIC FPnd_VE5c_max "FPrm_pending(386)" VALUE 0x001E5416 /* @ECU_Address@FPrm_pending@0x021BE304@ */ ECIPP_ALIGNMENT_UWORD 65535 Compu_IDENTITY 0 65535 PHYS_UNIT "Bit Mask" /end CHARACTERISTIC
/begin CHARACTERISTIC FPnd_VE5c_min "FPrm_pending(387)" VALUE 0x001E5418 /* @ECU_Address@FPrm_pending@0x021BE306@ */ ECIPP_ALIGNMENT_UWORD 65535 Compu_IDENTITY 0 65535 PHYS_UNIT "Bit Mask" /end CHARACTERISTIC
/begin CHARACTERISTIC FPnd_WGCV_comm_lost "FPrm_pending(713)" VALUE 0x001E56A4 /* @ECU_Address@FPrm_pending@0x021BE592@ */ ECIPP_ALIGNMENT_UWORD 65535 Compu_IDENTITY 0 65535 PHYS_UNIT "Bit Mask" /end CHARACTERISTIC
/begin CHARACTERISTIC FPnd_WGCV_func_lost "FPrm_pending(715)" VALUE 0x001E56A8 /* @ECU_Address@FPrm_pending@0x021BE596@ */ ECIPP_ALIGNMENT_UWORD 65535 Compu_IDENTITY 0 65535 PHYS_UNIT "Bit Mask" /end CHARACTERISTIC
/begin CHARACTERISTIC FPnd_WGCV_perf_limit "FPrm_pending(714)" VALUE 0x001E56A6 /* @ECU_Address@FPrm_pending@0x021BE594@ */ ECIPP_ALIGNMENT_UWORD 65535 Compu_IDENTITY 0 65535 PHYS_UNIT "Bit Mask" /end CHARACTERISTIC
/begin CHARACTERISTIC FPnd_WGP_maxv "FPrm_pending(101)" VALUE 0x001E51DC /* @ECU_Address@FPrm_pending@0x021BE0CA@ */ ECIPP_ALIGNMENT_UWORD 65535 Compu_IDENTITY 0 65535 PHYS_UNIT "Bit Mask" /end CHARACTERISTIC
/begin CHARACTERISTIC FPnd_WGP_minv "FPrm_pending(102)" VALUE 0x001E51DE /* @ECU_Address@FPrm_pending@0x021BE0CC@ */ ECIPP_ALIGNMENT_UWORD 65535 Compu_IDENTITY 0 65535 PHYS_UNIT "Bit Mask" /end CHARACTERISTIC
/begin CHARACTERISTIC FPnd_WGPerr_neg "FPrm_pending(527)" VALUE 0x001E5530 /* @ECU_Address@FPrm_pending@0x021BE41E@ */ ECIPP_ALIGNMENT_UWORD 65535 Compu_IDENTITY 0 65535 PHYS_UNIT "Bit Mask" /end CHARACTERISTIC
/begin CHARACTERISTIC FPnd_WGPerr_pos "FPrm_pending(526)" VALUE 0x001E552E /* @ECU_Address@FPrm_pending@0x021BE41C@ */ ECIPP_ALIGNMENT_UWORD 65535 Compu_IDENTITY 0 65535 PHYS_UNIT "Bit Mask" /end CHARACTERISTIC
/begin CHARACTERISTIC FPnd_WTRIN_detect "FPrm_pending(214)" VALUE 0x001E52BE /* @ECU_Address@FPrm_pending@0x021BE1AC@ */ ECIPP_ALIGNMENT_UWORD 65535 Compu_IDENTITY 0 65535 PHYS_UNIT "Bit Mask" /end CHARACTERISTIC
/begin CHARACTERISTIC FPnd_XEGOi_OOR "FPrm_pending(631)" VALUE 0x001E5600 /* @ECU_Address@FPrm_pending@0x021BE4EE@ */ ECIPP_ALIGNMENT_UWORD 65535 Compu_IDENTITY 0 65535 PHYS_UNIT "Bit Mask" /end CHARACTERISTIC
/begin CHARACTERISTIC FPsvr_UGF2_drifttol "FPrm_severity(385)" VALUE 0x001E6996 /* @ECU_Address@FPrm_severity@0x024B3181@ */ ECIPP_ALIGNMENT_UBYTE 255 Compu_IDENTITY 0 255 PHYS_UNIT "Severity+Class" /end CHARACTERISTIC
/begin CHARACTERISTIC FPsvr_UGF2_Hv_hi "FPrm_severity(318)" VALUE 0x001E6953 /* @ECU_Address@FPrm_severity@0x024B313E@ */ ECIPP_ALIGNMENT_UBYTE 255 Compu_IDENTITY 0 255 PHYS_UNIT "Severity+Class" /end CHARACTERISTIC
/begin CHARACTERISTIC FPsvr_UGF2_internal "FPrm_severity(317)" VALUE 0x001E6952 /* @ECU_Address@FPrm_severity@0x024B313D@ */ ECIPP_ALIGNMENT_UBYTE 255 Compu_IDENTITY 0 255 PHYS_UNIT "Severity+Class" /end CHARACTERISTIC
/begin CHARACTERISTIC FPsvr_UGF2_lowsupply "FPrm_severity(401)" VALUE 0x001E69A6 /* @ECU_Address@FPrm_severity@0x024B3191@ */ ECIPP_ALIGNMENT_UBYTE 255 Compu_IDENTITY 0 255 PHYS_UNIT "Severity+Class" /end CHARACTERISTIC
/begin CHARACTERISTIC FPsvr_UGF2_R_hi "FPrm_severity(319)" VALUE 0x001E6954 /* @ECU_Address@FPrm_severity@0x024B313F@ */ ECIPP_ALIGNMENT_UBYTE 255 Compu_IDENTITY 0 255 PHYS_UNIT "Severity+Class" /end CHARACTERISTIC
/begin CHARACTERISTIC FPsvr_UGF2_SR_hi "FPrm_severity(322)" VALUE 0x001E6957 /* @ECU_Address@FPrm_severity@0x024B3142@ */ ECIPP_ALIGNMENT_UBYTE 255 Compu_IDENTITY 0 255 PHYS_UNIT "Severity+Class" /end CHARACTERISTIC
/begin CHARACTERISTIC FPsvr_UGF2_SR_slow "FPrm_severity(321)" VALUE 0x001E6956 /* @ECU_Address@FPrm_severity@0x024B3141@ */ ECIPP_ALIGNMENT_UBYTE 255 Compu_IDENTITY 0 255 PHYS_UNIT "Severity+Class" /end CHARACTERISTIC
/begin CHARACTERISTIC FPsvr_UGF2_Sv_hi "FPrm_severity(320)" VALUE 0x001E6955 /* @ECU_Address@FPrm_severity@0x024B3140@ */ ECIPP_ALIGNMENT_UBYTE 255 Compu_IDENTITY 0 255 PHYS_UNIT "Severity+Class" /end CHARACTERISTIC
/begin CHARACTERISTIC FPsvr_UGF3_comm_lost "FPrm_severity(512)" VALUE 0x001E6A15 /* @ECU_Address@FPrm_severity@0x024B3200@ */ ECIPP_ALIGNMENT_UBYTE 255 Compu_IDENTITY 0 255 PHYS_UNIT "Severity+Class" /end CHARACTERISTIC
/begin CHARACTERISTIC FPsvr_UGF3_drifttl2 "FPrm_severity(458)" VALUE 0x001E69DF /* @ECU_Address@FPrm_severity@0x024B31CA@ */ ECIPP_ALIGNMENT_UBYTE 255 Compu_IDENTITY 0 255 PHYS_UNIT "Severity+Class" /end CHARACTERISTIC
/begin CHARACTERISTIC FPsvr_UGF3_drifttol "FPrm_severity(457)" VALUE 0x001E69DE /* @ECU_Address@FPrm_severity@0x024B31C9@ */ ECIPP_ALIGNMENT_UBYTE 255 Compu_IDENTITY 0 255 PHYS_UNIT "Severity+Class" /end CHARACTERISTIC
/begin CHARACTERISTIC FPsvr_UGF3_Hv_hi "FPrm_severity(459)" VALUE 0x001E69E0 /* @ECU_Address@FPrm_severity@0x024B31CB@ */ ECIPP_ALIGNMENT_UBYTE 255 Compu_IDENTITY 0 255 PHYS_UNIT "Severity+Class" /end CHARACTERISTIC
/begin CHARACTERISTIC FPsvr_UGF3_internal "FPrm_severity(455)" VALUE 0x001E69DC /* @ECU_Address@FPrm_severity@0x024B31C7@ */ ECIPP_ALIGNMENT_UBYTE 255 Compu_IDENTITY 0 255 PHYS_UNIT "Severity+Class" /end CHARACTERISTIC
/begin CHARACTERISTIC FPsvr_UGF3_lowsupply "FPrm_severity(456)" VALUE 0x001E69DD /* @ECU_Address@FPrm_severity@0x024B31C8@ */ ECIPP_ALIGNMENT_UBYTE 255 Compu_IDENTITY 0 255 PHYS_UNIT "Severity+Class" /end CHARACTERISTIC
/begin CHARACTERISTIC FPsvr_UGF3_R_hi "FPrm_severity(460)" VALUE 0x001E69E1 /* @ECU_Address@FPrm_severity@0x024B31CC@ */ ECIPP_ALIGNMENT_UBYTE 255 Compu_IDENTITY 0 255 PHYS_UNIT "Severity+Class" /end CHARACTERISTIC
/begin CHARACTERISTIC FPsvr_UGF3_SR_hi "FPrm_severity(463)" VALUE 0x001E69E4 /* @ECU_Address@FPrm_severity@0x024B31CF@ */ ECIPP_ALIGNMENT_UBYTE 255 Compu_IDENTITY 0 255 PHYS_UNIT "Severity+Class" /end CHARACTERISTIC
/begin CHARACTERISTIC FPsvr_UGF3_SR_slow "FPrm_severity(462)" VALUE 0x001E69E3 /* @ECU_Address@FPrm_severity@0x024B31CE@ */ ECIPP_ALIGNMENT_UBYTE 255 Compu_IDENTITY 0 255 PHYS_UNIT "Severity+Class" /end CHARACTERISTIC
/begin CHARACTERISTIC FPsvr_UGF3_Sv_hi "FPrm_severity(461)" VALUE 0x001E69E2 /* @ECU_Address@FPrm_severity@0x024B31CD@ */ ECIPP_ALIGNMENT_UBYTE 255 Compu_IDENTITY 0 255 PHYS_UNIT "Severity+Class" /end CHARACTERISTIC
/begin CHARACTERISTIC FPsvr_UGF4_comm_lost "FPrm_severity(513)" VALUE 0x001E6A16 /* @ECU_Address@FPrm_severity@0x024B3201@ */ ECIPP_ALIGNMENT_UBYTE 255 Compu_IDENTITY 0 255 PHYS_UNIT "Severity+Class" /end CHARACTERISTIC
/begin CHARACTERISTIC FPsvr_UGF4_drifttl2 "FPrm_severity(469)" VALUE 0x001E69EA /* @ECU_Address@FPrm_severity@0x024B31D5@ */ ECIPP_ALIGNMENT_UBYTE 255 Compu_IDENTITY 0 255 PHYS_UNIT "Severity+Class" /end CHARACTERISTIC
/begin CHARACTERISTIC FPsvr_UGF4_drifttol "FPrm_severity(468)" VALUE 0x001E69E9 /* @ECU_Address@FPrm_severity@0x024B31D4@ */ ECIPP_ALIGNMENT_UBYTE 255 Compu_IDENTITY 0 255 PHYS_UNIT "Severity+Class" /end CHARACTERISTIC
/begin CHARACTERISTIC FPsvr_UGF4_Hv_hi "FPrm_severity(470)" VALUE 0x001E69EB /* @ECU_Address@FPrm_severity@0x024B31D6@ */ ECIPP_ALIGNMENT_UBYTE 255 Compu_IDENTITY 0 255 PHYS_UNIT "Severity+Class" /end CHARACTERISTIC
/begin CHARACTERISTIC FPsvr_UGF4_internal "FPrm_severity(466)" VALUE 0x001E69E7 /* @ECU_Address@FPrm_severity@0x024B31D2@ */ ECIPP_ALIGNMENT_UBYTE 255 Compu_IDENTITY 0 255 PHYS_UNIT "Severity+Class" /end CHARACTERISTIC
/begin CHARACTERISTIC FPsvr_UGF4_lowsupply "FPrm_severity(467)" VALUE 0x001E69E8 /* @ECU_Address@FPrm_severity@0x024B31D3@ */ ECIPP_ALIGNMENT_UBYTE 255 Compu_IDENTITY 0 255 PHYS_UNIT "Severity+Class" /end CHARACTERISTIC
/begin CHARACTERISTIC FPsvr_UGF4_R_hi "FPrm_severity(471)" VALUE 0x001E69EC /* @ECU_Address@FPrm_severity@0x024B31D7@ */ ECIPP_ALIGNMENT_UBYTE 255 Compu_IDENTITY 0 255 PHYS_UNIT "Severity+Class" /end CHARACTERISTIC
/begin CHARACTERISTIC FPsvr_UGF4_SR_hi "FPrm_severity(474)" VALUE 0x001E69EF /* @ECU_Address@FPrm_severity@0x024B31DA@ */ ECIPP_ALIGNMENT_UBYTE 255 Compu_IDENTITY 0 255 PHYS_UNIT "Severity+Class" /end CHARACTERISTIC
/begin CHARACTERISTIC FPsvr_UGF4_SR_slow "FPrm_severity(473)" VALUE 0x001E69EE /* @ECU_Address@FPrm_severity@0x024B31D9@ */ ECIPP_ALIGNMENT_UBYTE 255 Compu_IDENTITY 0 255 PHYS_UNIT "Severity+Class" /end CHARACTERISTIC
/begin CHARACTERISTIC FPsvr_UGF4_Sv_hi "FPrm_severity(472)" VALUE 0x001E69ED /* @ECU_Address@FPrm_severity@0x024B31D8@ */ ECIPP_ALIGNMENT_UBYTE 255 Compu_IDENTITY 0 255 PHYS_UNIT "Severity+Class" /end CHARACTERISTIC
/begin CHARACTERISTIC FPsvr_V_max "FPrm_severity(14)" VALUE 0x001E6823 /* @ECU_Address@FPrm_severity@0x024B300E@ */ ECIPP_ALIGNMENT_UBYTE 255 Compu_IDENTITY 0 255 PHYS_UNIT "Severity+Class" /end CHARACTERISTIC
/begin CHARACTERISTIC FPsvr_V_min "FPrm_severity(15)" VALUE 0x001E6824 /* @ECU_Address@FPrm_severity@0x024B300F@ */ ECIPP_ALIGNMENT_UBYTE 255 Compu_IDENTITY 0 255 PHYS_UNIT "Severity+Class" /end CHARACTERISTIC
/begin CHARACTERISTIC FPsvr_VE5_max "FPrm_severity(16)" VALUE 0x001E6825 /* @ECU_Address@FPrm_severity@0x024B3010@ */ ECIPP_ALIGNMENT_UBYTE 255 Compu_IDENTITY 0 255 PHYS_UNIT "Severity+Class" /end CHARACTERISTIC
/begin CHARACTERISTIC FPsvr_VE5_min "FPrm_severity(17)" VALUE 0x001E6826 /* @ECU_Address@FPrm_severity@0x024B3011@ */ ECIPP_ALIGNMENT_UBYTE 255 Compu_IDENTITY 0 255 PHYS_UNIT "Severity+Class" /end CHARACTERISTIC
/begin CHARACTERISTIC FPsvr_VE5ab_OOR "FPrm_severity(143)" VALUE 0x001E68A4 /* @ECU_Address@FPrm_severity@0x024B308F@ */ ECIPP_ALIGNMENT_UBYTE 255 Compu_IDENTITY 0 255 PHYS_UNIT "Severity+Class" /end CHARACTERISTIC
/begin CHARACTERISTIC FPsvr_VE5b_max "FPrm_severity(141)" VALUE 0x001E68A2 /* @ECU_Address@FPrm_severity@0x024B308D@ */ ECIPP_ALIGNMENT_UBYTE 255 Compu_IDENTITY 0 255 PHYS_UNIT "Severity+Class" /end CHARACTERISTIC
/begin CHARACTERISTIC FPsvr_VE5b_min "FPrm_severity(142)" VALUE 0x001E68A3 /* @ECU_Address@FPrm_severity@0x024B308E@ */ ECIPP_ALIGNMENT_UBYTE 255 Compu_IDENTITY 0 255 PHYS_UNIT "Severity+Class" /end CHARACTERISTIC
/begin CHARACTERISTIC FPsvr_VE5c_max "FPrm_severity(386)" VALUE 0x001E6997 /* @ECU_Address@FPrm_severity@0x024B3182@ */ ECIPP_ALIGNMENT_UBYTE 255 Compu_IDENTITY 0 255 PHYS_UNIT "Severity+Class" /end CHARACTERISTIC
/begin CHARACTERISTIC FPsvr_VE5c_min "FPrm_severity(387)" VALUE 0x001E6998 /* @ECU_Address@FPrm_severity@0x024B3183@ */ ECIPP_ALIGNMENT_UBYTE 255 Compu_IDENTITY 0 255 PHYS_UNIT "Severity+Class" /end CHARACTERISTIC
/begin CHARACTERISTIC FPsvr_WGCV_comm_lost "FPrm_severity(713)" VALUE 0x001E6ADE /* @ECU_Address@FPrm_severity@0x024B32C9@ */ ECIPP_ALIGNMENT_UBYTE 255 Compu_IDENTITY 0 255 PHYS_UNIT "Severity+Class" /end CHARACTERISTIC
/begin CHARACTERISTIC FPsvr_WGCV_func_lost "FPrm_severity(715)" VALUE 0x001E6AE0 /* @ECU_Address@FPrm_severity@0x024B32CB@ */ ECIPP_ALIGNMENT_UBYTE 255 Compu_IDENTITY 0 255 PHYS_UNIT "Severity+Class" /end CHARACTERISTIC
/begin CHARACTERISTIC FPsvr_WGCV_perf_limit "FPrm_severity(714)" VALUE 0x001E6ADF /* @ECU_Address@FPrm_severity@0x024B32CA@ */ ECIPP_ALIGNMENT_UBYTE 255 Compu_IDENTITY 0 255 PHYS_UNIT "Severity+Class" /end CHARACTERISTIC
/begin CHARACTERISTIC FPsvr_WGP_maxv "FPrm_severity(101)" VALUE 0x001E687A /* @ECU_Address@FPrm_severity@0x024B3065@ */ ECIPP_ALIGNMENT_UBYTE 255 Compu_IDENTITY 0 255 PHYS_UNIT "Severity+Class" /end CHARACTERISTIC
/begin CHARACTERISTIC FPsvr_WGP_minv "FPrm_severity(102)" VALUE 0x001E687B /* @ECU_Address@FPrm_severity@0x024B3066@ */ ECIPP_ALIGNMENT_UBYTE 255 Compu_IDENTITY 0 255 PHYS_UNIT "Severity+Class" /end CHARACTERISTIC
/begin CHARACTERISTIC FPsvr_WGPerr_neg "FPrm_severity(527)" VALUE 0x001E6A24 /* @ECU_Address@FPrm_severity@0x024B320F@ */ ECIPP_ALIGNMENT_UBYTE 255 Compu_IDENTITY 0 255 PHYS_UNIT "Severity+Class" /end CHARACTERISTIC
/begin CHARACTERISTIC FPsvr_WGPerr_pos "FPrm_severity(526)" VALUE 0x001E6A23 /* @ECU_Address@FPrm_severity@0x024B320E@ */ ECIPP_ALIGNMENT_UBYTE 255 Compu_IDENTITY 0 255 PHYS_UNIT "Severity+Class" /end CHARACTERISTIC
/begin CHARACTERISTIC FPsvr_WTRIN_detect "FPrm_severity(214)" VALUE 0x001E68EB /* @ECU_Address@FPrm_severity@0x024B30D6@ */ ECIPP_ALIGNMENT_UBYTE 255 Compu_IDENTITY 0 255 PHYS_UNIT "Severity+Class" /end CHARACTERISTIC
/begin CHARACTERISTIC FPsvr_XEGOi_OOR "FPrm_severity(631)" VALUE 0x001E6A8C /* @ECU_Address@FPrm_severity@0x024B3277@ */ ECIPP_ALIGNMENT_UBYTE 255 Compu_IDENTITY 0 255 PHYS_UNIT "Severity+Class" /end CHARACTERISTIC
/begin CHARACTERISTIC FPsw_ext1_UGF2_drifttol "FPrm_switches_ext1(385)" VALUE 0x001C7880 /* @ECU_Address@FPrm_switches_ext1@0x023A5302@ */ ECIPP_ALIGNMENT_UWORD 65535 Compu_IDENTITY 0 65535 PHYS_UNIT "Enable bits" /end CHARACTERISTIC
/begin CHARACTERISTIC FPsw_ext1_UGF2_Hv_hi "FPrm_switches_ext1(318)" VALUE 0x001C77FA /* @ECU_Address@FPrm_switches_ext1@0x023A527C@ */ ECIPP_ALIGNMENT_UWORD 65535 Compu_IDENTITY 0 65535 PHYS_UNIT "Enable bits" /end CHARACTERISTIC
/begin CHARACTERISTIC FPsw_ext1_UGF2_internal "FPrm_switches_ext1(317)" VALUE 0x001C77F8 /* @ECU_Address@FPrm_switches_ext1@0x023A527A@ */ ECIPP_ALIGNMENT_UWORD 65535 Compu_IDENTITY 0 65535 PHYS_UNIT "Enable bits" /end CHARACTERISTIC
/begin CHARACTERISTIC FPsw_ext1_UGF2_lowsupply "FPrm_switches_ext1(401)" VALUE 0x001C78A0 /* @ECU_Address@FPrm_switches_ext1@0x023A5322@ */ ECIPP_ALIGNMENT_UWORD 65535 Compu_IDENTITY 0 65535 PHYS_UNIT "Enable bits" /end CHARACTERISTIC
/begin CHARACTERISTIC FPsw_ext1_UGF2_R_hi "FPrm_switches_ext1(319)" VALUE 0x001C77FC /* @ECU_Address@FPrm_switches_ext1@0x023A527E@ */ ECIPP_ALIGNMENT_UWORD 65535 Compu_IDENTITY 0 65535 PHYS_UNIT "Enable bits" /end CHARACTERISTIC
/begin CHARACTERISTIC FPsw_ext1_UGF2_SR_hi "FPrm_switches_ext1(322)" VALUE 0x001C7802 /* @ECU_Address@FPrm_switches_ext1@0x023A5284@ */ ECIPP_ALIGNMENT_UWORD 65535 Compu_IDENTITY 0 65535 PHYS_UNIT "Enable bits" /end CHARACTERISTIC
/begin CHARACTERISTIC FPsw_ext1_UGF2_SR_slow "FPrm_switches_ext1(321)" VALUE 0x001C7800 /* @ECU_Address@FPrm_switches_ext1@0x023A5282@ */ ECIPP_ALIGNMENT_UWORD 65535 Compu_IDENTITY 0 65535 PHYS_UNIT "Enable bits" /end CHARACTERISTIC
/begin CHARACTERISTIC FPsw_ext1_UGF2_Sv_hi "FPrm_switches_ext1(320)" VALUE 0x001C77FE /* @ECU_Address@FPrm_switches_ext1@0x023A5280@ */ ECIPP_ALIGNMENT_UWORD 65535 Compu_IDENTITY 0 65535 PHYS_UNIT "Enable bits" /end CHARACTERISTIC
/begin CHARACTERISTIC FPsw_ext1_UGF3_comm_lost "FPrm_switches_ext1(512)" VALUE 0x001C797E /* @ECU_Address@FPrm_switches_ext1@0x023A5400@ */ ECIPP_ALIGNMENT_UWORD 65535 Compu_IDENTITY 0 65535 PHYS_UNIT "Enable bits" /end CHARACTERISTIC
/begin CHARACTERISTIC FPsw_ext1_UGF3_drifttl2 "FPrm_switches_ext1(458)" VALUE 0x001C7912 /* @ECU_Address@FPrm_switches_ext1@0x023A5394@ */ ECIPP_ALIGNMENT_UWORD 65535 Compu_IDENTITY 0 65535 PHYS_UNIT "Enable bits" /end CHARACTERISTIC
/begin CHARACTERISTIC FPsw_ext1_UGF3_drifttol "FPrm_switches_ext1(457)" VALUE 0x001C7910 /* @ECU_Address@FPrm_switches_ext1@0x023A5392@ */ ECIPP_ALIGNMENT_UWORD 65535 Compu_IDENTITY 0 65535 PHYS_UNIT "Enable bits" /end CHARACTERISTIC
/begin CHARACTERISTIC FPsw_ext1_UGF3_Hv_hi "FPrm_switches_ext1(459)" VALUE 0x001C7914 /* @ECU_Address@FPrm_switches_ext1@0x023A5396@ */ ECIPP_ALIGNMENT_UWORD 65535 Compu_IDENTITY 0 65535 PHYS_UNIT "Enable bits" /end CHARACTERISTIC
/begin CHARACTERISTIC FPsw_ext1_UGF3_internal "FPrm_switches_ext1(455)" VALUE 0x001C790C /* @ECU_Address@FPrm_switches_ext1@0x023A538E@ */ ECIPP_ALIGNMENT_UWORD 65535 Compu_IDENTITY 0 65535 PHYS_UNIT "Enable bits" /end CHARACTERISTIC
/begin CHARACTERISTIC FPsw_ext1_UGF3_lowsupply "FPrm_switches_ext1(456)" VALUE 0x001C790E /* @ECU_Address@FPrm_switches_ext1@0x023A5390@ */ ECIPP_ALIGNMENT_UWORD 65535 Compu_IDENTITY 0 65535 PHYS_UNIT "Enable bits" /end CHARACTERISTIC
/begin CHARACTERISTIC FPsw_ext1_UGF3_R_hi "FPrm_switches_ext1(460)" VALUE 0x001C7916 /* @ECU_Address@FPrm_switches_ext1@0x023A5398@ */ ECIPP_ALIGNMENT_UWORD 65535 Compu_IDENTITY 0 65535 PHYS_UNIT "Enable bits" /end CHARACTERISTIC
/begin CHARACTERISTIC FPsw_ext1_UGF3_SR_hi "FPrm_switches_ext1(463)" VALUE 0x001C791C /* @ECU_Address@FPrm_switches_ext1@0x023A539E@ */ ECIPP_ALIGNMENT_UWORD 65535 Compu_IDENTITY 0 65535 PHYS_UNIT "Enable bits" /end CHARACTERISTIC
/begin CHARACTERISTIC FPsw_ext1_UGF3_SR_slow "FPrm_switches_ext1(462)" VALUE 0x001C791A /* @ECU_Address@FPrm_switches_ext1@0x023A539C@ */ ECIPP_ALIGNMENT_UWORD 65535 Compu_IDENTITY 0 65535 PHYS_UNIT "Enable bits" /end CHARACTERISTIC
/begin CHARACTERISTIC FPsw_ext1_UGF3_Sv_hi "FPrm_switches_ext1(461)" VALUE 0x001C7918 /* @ECU_Address@FPrm_switches_ext1@0x023A539A@ */ ECIPP_ALIGNMENT_UWORD 65535 Compu_IDENTITY 0 65535 PHYS_UNIT "Enable bits" /end CHARACTERISTIC
/begin CHARACTERISTIC FPsw_ext1_UGF4_comm_lost "FPrm_switches_ext1(513)" VALUE 0x001C7980 /* @ECU_Address@FPrm_switches_ext1@0x023A5402@ */ ECIPP_ALIGNMENT_UWORD 65535 Compu_IDENTITY 0 65535 PHYS_UNIT "Enable bits" /end CHARACTERISTIC
/begin CHARACTERISTIC FPsw_ext1_UGF4_drifttl2 "FPrm_switches_ext1(469)" VALUE 0x001C7928 /* @ECU_Address@FPrm_switches_ext1@0x023A53AA@ */ ECIPP_ALIGNMENT_UWORD 65535 Compu_IDENTITY 0 65535 PHYS_UNIT "Enable bits" /end CHARACTERISTIC
/begin CHARACTERISTIC FPsw_ext1_UGF4_drifttol "FPrm_switches_ext1(468)" VALUE 0x001C7926 /* @ECU_Address@FPrm_switches_ext1@0x023A53A8@ */ ECIPP_ALIGNMENT_UWORD 65535 Compu_IDENTITY 0 65535 PHYS_UNIT "Enable bits" /end CHARACTERISTIC
/begin CHARACTERISTIC FPsw_ext1_UGF4_Hv_hi "FPrm_switches_ext1(470)" VALUE 0x001C792A /* @ECU_Address@FPrm_switches_ext1@0x023A53AC@ */ ECIPP_ALIGNMENT_UWORD 65535 Compu_IDENTITY 0 65535 PHYS_UNIT "Enable bits" /end CHARACTERISTIC
/begin CHARACTERISTIC FPsw_ext1_UGF4_internal "FPrm_switches_ext1(466)" VALUE 0x001C7922 /* @ECU_Address@FPrm_switches_ext1@0x023A53A4@ */ ECIPP_ALIGNMENT_UWORD 65535 Compu_IDENTITY 0 65535 PHYS_UNIT "Enable bits" /end CHARACTERISTIC
/begin CHARACTERISTIC FPsw_ext1_UGF4_lowsupply "FPrm_switches_ext1(467)" VALUE 0x001C7924 /* @ECU_Address@FPrm_switches_ext1@0x023A53A6@ */ ECIPP_ALIGNMENT_UWORD 65535 Compu_IDENTITY 0 65535 PHYS_UNIT "Enable bits" /end CHARACTERISTIC
/begin CHARACTERISTIC FPsw_ext1_UGF4_R_hi "FPrm_switches_ext1(471)" VALUE 0x001C792C /* @ECU_Address@FPrm_switches_ext1@0x023A53AE@ */ ECIPP_ALIGNMENT_UWORD 65535 Compu_IDENTITY 0 65535 PHYS_UNIT "Enable bits" /end CHARACTERISTIC
/begin CHARACTERISTIC FPsw_ext1_UGF4_SR_hi "FPrm_switches_ext1(474)" VALUE 0x001C7932 /* @ECU_Address@FPrm_switches_ext1@0x023A53B4@ */ ECIPP_ALIGNMENT_UWORD 65535 Compu_IDENTITY 0 65535 PHYS_UNIT "Enable bits" /end CHARACTERISTIC
/begin CHARACTERISTIC FPsw_ext1_UGF4_SR_slow "FPrm_switches_ext1(473)" VALUE 0x001C7930 /* @ECU_Address@FPrm_switches_ext1@0x023A53B2@ */ ECIPP_ALIGNMENT_UWORD 65535 Compu_IDENTITY 0 65535 PHYS_UNIT "Enable bits" /end CHARACTERISTIC
/begin CHARACTERISTIC FPsw_ext1_UGF4_Sv_hi "FPrm_switches_ext1(472)" VALUE 0x001C792E /* @ECU_Address@FPrm_switches_ext1@0x023A53B0@ */ ECIPP_ALIGNMENT_UWORD 65535 Compu_IDENTITY 0 65535 PHYS_UNIT "Enable bits" /end CHARACTERISTIC
/begin CHARACTERISTIC FPsw_ext1_V_max "FPrm_switches_ext1(14)" VALUE 0x001C759A /* @ECU_Address@FPrm_switches_ext1@0x023A501C@ */ ECIPP_ALIGNMENT_UWORD 65535 Compu_IDENTITY 0 65535 PHYS_UNIT "Enable bits" /end CHARACTERISTIC
/begin CHARACTERISTIC FPsw_ext1_V_min "FPrm_switches_ext1(15)" VALUE 0x001C759C /* @ECU_Address@FPrm_switches_ext1@0x023A501E@ */ ECIPP_ALIGNMENT_UWORD 65535 Compu_IDENTITY 0 65535 PHYS_UNIT "Enable bits" /end CHARACTERISTIC
/begin CHARACTERISTIC FPsw_ext1_VE5_max "FPrm_switches_ext1(16)" VALUE 0x001C759E /* @ECU_Address@FPrm_switches_ext1@0x023A5020@ */ ECIPP_ALIGNMENT_UWORD 65535 Compu_IDENTITY 0 65535 PHYS_UNIT "Enable bits" /end CHARACTERISTIC
/begin CHARACTERISTIC FPsw_ext1_VE5_min "FPrm_switches_ext1(17)" VALUE 0x001C75A0 /* @ECU_Address@FPrm_switches_ext1@0x023A5022@ */ ECIPP_ALIGNMENT_UWORD 65535 Compu_IDENTITY 0 65535 PHYS_UNIT "Enable bits" /end CHARACTERISTIC
/begin CHARACTERISTIC FPsw_ext1_VE5ab_OOR "FPrm_switches_ext1(143)" VALUE 0x001C769C /* @ECU_Address@FPrm_switches_ext1@0x023A511E@ */ ECIPP_ALIGNMENT_UWORD 65535 Compu_IDENTITY 0 65535 PHYS_UNIT "Enable bits" /end CHARACTERISTIC
/begin CHARACTERISTIC FPsw_ext1_VE5b_max "FPrm_switches_ext1(141)" VALUE 0x001C7698 /* @ECU_Address@FPrm_switches_ext1@0x023A511A@ */ ECIPP_ALIGNMENT_UWORD 65535 Compu_IDENTITY 0 65535 PHYS_UNIT "Enable bits" /end CHARACTERISTIC
/begin CHARACTERISTIC FPsw_ext1_VE5b_min "FPrm_switches_ext1(142)" VALUE 0x001C769A /* @ECU_Address@FPrm_switches_ext1@0x023A511C@ */ ECIPP_ALIGNMENT_UWORD 65535 Compu_IDENTITY 0 65535 PHYS_UNIT "Enable bits" /end CHARACTERISTIC
/begin CHARACTERISTIC FPsw_ext1_VE5c_max "FPrm_switches_ext1(386)" VALUE 0x001C7882 /* @ECU_Address@FPrm_switches_ext1@0x023A5304@ */ ECIPP_ALIGNMENT_UWORD 65535 Compu_IDENTITY 0 65535 PHYS_UNIT "Enable bits" /end CHARACTERISTIC
/begin CHARACTERISTIC FPsw_ext1_VE5c_min "FPrm_switches_ext1(387)" VALUE 0x001C7884 /* @ECU_Address@FPrm_switches_ext1@0x023A5306@ */ ECIPP_ALIGNMENT_UWORD 65535 Compu_IDENTITY 0 65535 PHYS_UNIT "Enable bits" /end CHARACTERISTIC
/begin CHARACTERISTIC FPsw_ext1_WGCV_comm_lost "FPrm_switches_ext1(713)" VALUE 0x001C7B10 /* @ECU_Address@FPrm_switches_ext1@0x023A5592@ */ ECIPP_ALIGNMENT_UWORD 65535 Compu_IDENTITY 0 65535 PHYS_UNIT "Enable bits" /end CHARACTERISTIC
/begin CHARACTERISTIC FPsw_ext1_WGCV_func_lost "FPrm_switches_ext1(715)" VALUE 0x001C7B14 /* @ECU_Address@FPrm_switches_ext1@0x023A5596@ */ ECIPP_ALIGNMENT_UWORD 65535 Compu_IDENTITY 0 65535 PHYS_UNIT "Enable bits" /end CHARACTERISTIC
/begin CHARACTERISTIC FPsw_ext1_WGCV_perf_limit "FPrm_switches_ext1(714)" VALUE 0x001C7B12 /* @ECU_Address@FPrm_switches_ext1@0x023A5594@ */ ECIPP_ALIGNMENT_UWORD 65535 Compu_IDENTITY 0 65535 PHYS_UNIT "Enable bits" /end CHARACTERISTIC
/begin CHARACTERISTIC FPsw_ext1_WGP_maxv "FPrm_switches_ext1(101)" VALUE 0x001C7648 /* @ECU_Address@FPrm_switches_ext1@0x023A50CA@ */ ECIPP_ALIGNMENT_UWORD 65535 Compu_IDENTITY 0 65535 PHYS_UNIT "Enable bits" /end CHARACTERISTIC
/begin CHARACTERISTIC FPsw_ext1_WGP_minv "FPrm_switches_ext1(102)" VALUE 0x001C764A /* @ECU_Address@FPrm_switches_ext1@0x023A50CC@ */ ECIPP_ALIGNMENT_UWORD 65535 Compu_IDENTITY 0 65535 PHYS_UNIT "Enable bits" /end CHARACTERISTIC
/begin CHARACTERISTIC FPsw_ext1_WGPerr_neg "FPrm_switches_ext1(527)" VALUE 0x001C799C /* @ECU_Address@FPrm_switches_ext1@0x023A541E@ */ ECIPP_ALIGNMENT_UWORD 65535 Compu_IDENTITY 0 65535 PHYS_UNIT "Enable bits" /end CHARACTERISTIC
/begin CHARACTERISTIC FPsw_ext1_WGPerr_pos "FPrm_switches_ext1(526)" VALUE 0x001C799A /* @ECU_Address@FPrm_switches_ext1@0x023A541C@ */ ECIPP_ALIGNMENT_UWORD 65535 Compu_IDENTITY 0 65535 PHYS_UNIT "Enable bits" /end CHARACTERISTIC
/begin CHARACTERISTIC FPsw_ext1_WTRIN_detect "FPrm_switches_ext1(214)" VALUE 0x001C772A /* @ECU_Address@FPrm_switches_ext1@0x023A51AC@ */ ECIPP_ALIGNMENT_UWORD 65535 Compu_IDENTITY 0 65535 PHYS_UNIT "Enable bits" /end CHARACTERISTIC
/begin CHARACTERISTIC FPsw_ext1_XEGOi_OOR "FPrm_switches_ext1(631)" VALUE 0x001C7A6C /* @ECU_Address@FPrm_switches_ext1@0x023A54EE@ */ ECIPP_ALIGNMENT_UWORD 65535 Compu_IDENTITY 0 65535 PHYS_UNIT "Enable bits" /end CHARACTERISTIC
/begin CHARACTERISTIC FPsw_UGF2_drifttol "FPrm_switches(385)" VALUE 0x001C72DC /* @ECU_Address@FPrm_switches@0x021B9302@ */ ECIPP_ALIGNMENT_UWORD 65535 Compu_IDENTITY 0 65535 PHYS_UNIT "Enable bits" /end CHARACTERISTIC
/begin CHARACTERISTIC FPsw_UGF2_Hv_hi "FPrm_switches(318)" VALUE 0x001C7256 /* @ECU_Address@FPrm_switches@0x021B927C@ */ ECIPP_ALIGNMENT_UWORD 65535 Compu_IDENTITY 0 65535 PHYS_UNIT "Enable bits" /end CHARACTERISTIC
/begin CHARACTERISTIC FPsw_UGF2_internal "FPrm_switches(317)" VALUE 0x001C7254 /* @ECU_Address@FPrm_switches@0x021B927A@ */ ECIPP_ALIGNMENT_UWORD 65535 Compu_IDENTITY 0 65535 PHYS_UNIT "Enable bits" /end CHARACTERISTIC
/begin CHARACTERISTIC FPsw_UGF2_lowsupply "FPrm_switches(401)" VALUE 0x001C72FC /* @ECU_Address@FPrm_switches@0x021B9322@ */ ECIPP_ALIGNMENT_UWORD 65535 Compu_IDENTITY 0 65535 PHYS_UNIT "Enable bits" /end CHARACTERISTIC
/begin CHARACTERISTIC FPsw_UGF2_R_hi "FPrm_switches(319)" VALUE 0x001C7258 /* @ECU_Address@FPrm_switches@0x021B927E@ */ ECIPP_ALIGNMENT_UWORD 65535 Compu_IDENTITY 0 65535 PHYS_UNIT "Enable bits" /end CHARACTERISTIC
/begin CHARACTERISTIC FPsw_UGF2_SR_hi "FPrm_switches(322)" VALUE 0x001C725E /* @ECU_Address@FPrm_switches@0x021B9284@ */ ECIPP_ALIGNMENT_UWORD 65535 Compu_IDENTITY 0 65535 PHYS_UNIT "Enable bits" /end CHARACTERISTIC
/begin CHARACTERISTIC FPsw_UGF2_SR_slow "FPrm_switches(321)" VALUE 0x001C725C /* @ECU_Address@FPrm_switches@0x021B9282@ */ ECIPP_ALIGNMENT_UWORD 65535 Compu_IDENTITY 0 65535 PHYS_UNIT "Enable bits" /end CHARACTERISTIC
/begin CHARACTERISTIC FPsw_UGF2_Sv_hi "FPrm_switches(320)" VALUE 0x001C725A /* @ECU_Address@FPrm_switches@0x021B9280@ */ ECIPP_ALIGNMENT_UWORD 65535 Compu_IDENTITY 0 65535 PHYS_UNIT "Enable bits" /end CHARACTERISTIC
/begin CHARACTERISTIC FPsw_UGF3_comm_lost "FPrm_switches(512)" VALUE 0x001C73DA /* @ECU_Address@FPrm_switches@0x021B9400@ */ ECIPP_ALIGNMENT_UWORD 65535 Compu_IDENTITY 0 65535 PHYS_UNIT "Enable bits" /end CHARACTERISTIC
/begin CHARACTERISTIC FPsw_UGF3_drifttl2 "FPrm_switches(458)" VALUE 0x001C736E /* @ECU_Address@FPrm_switches@0x021B9394@ */ ECIPP_ALIGNMENT_UWORD 65535 Compu_IDENTITY 0 65535 PHYS_UNIT "Enable bits" /end CHARACTERISTIC
/begin CHARACTERISTIC FPsw_UGF3_drifttol "FPrm_switches(457)" VALUE 0x001C736C /* @ECU_Address@FPrm_switches@0x021B9392@ */ ECIPP_ALIGNMENT_UWORD 65535 Compu_IDENTITY 0 65535 PHYS_UNIT "Enable bits" /end CHARACTERISTIC
/begin CHARACTERISTIC FPsw_UGF3_Hv_hi "FPrm_switches(459)" VALUE 0x001C7370 /* @ECU_Address@FPrm_switches@0x021B9396@ */ ECIPP_ALIGNMENT_UWORD 65535 Compu_IDENTITY 0 65535 PHYS_UNIT "Enable bits" /end CHARACTERISTIC
/begin CHARACTERISTIC FPsw_UGF3_internal "FPrm_switches(455)" VALUE 0x001C7368 /* @ECU_Address@FPrm_switches@0x021B938E@ */ ECIPP_ALIGNMENT_UWORD 65535 Compu_IDENTITY 0 65535 PHYS_UNIT "Enable bits" /end CHARACTERISTIC
/begin CHARACTERISTIC FPsw_UGF3_lowsupply "FPrm_switches(456)" VALUE 0x001C736A /* @ECU_Address@FPrm_switches@0x021B9390@ */ ECIPP_ALIGNMENT_UWORD 65535 Compu_IDENTITY 0 65535 PHYS_UNIT "Enable bits" /end CHARACTERISTIC
/begin CHARACTERISTIC FPsw_UGF3_R_hi "FPrm_switches(460)" VALUE 0x001C7372 /* @ECU_Address@FPrm_switches@0x021B9398@ */ ECIPP_ALIGNMENT_UWORD 65535 Compu_IDENTITY 0 65535 PHYS_UNIT "Enable bits" /end CHARACTERISTIC
/begin CHARACTERISTIC FPsw_UGF3_SR_hi "FPrm_switches(463)" VALUE 0x001C7378 /* @ECU_Address@FPrm_switches@0x021B939E@ */ ECIPP_ALIGNMENT_UWORD 65535 Compu_IDENTITY 0 65535 PHYS_UNIT "Enable bits" /end CHARACTERISTIC
/begin CHARACTERISTIC FPsw_UGF3_SR_slow "FPrm_switches(462)" VALUE 0x001C7376 /* @ECU_Address@FPrm_switches@0x021B939C@ */ ECIPP_ALIGNMENT_UWORD 65535 Compu_IDENTITY 0 65535 PHYS_UNIT "Enable bits" /end CHARACTERISTIC
/begin CHARACTERISTIC FPsw_UGF3_Sv_hi "FPrm_switches(461)" VALUE 0x001C7374 /* @ECU_Address@FPrm_switches@0x021B939A@ */ ECIPP_ALIGNMENT_UWORD 65535 Compu_IDENTITY 0 65535 PHYS_UNIT "Enable bits" /end CHARACTERISTIC
/begin CHARACTERISTIC FPsw_UGF4_comm_lost "FPrm_switches(513)" VALUE 0x001C73DC /* @ECU_Address@FPrm_switches@0x021B9402@ */ ECIPP_ALIGNMENT_UWORD 65535 Compu_IDENTITY 0 65535 PHYS_UNIT "Enable bits" /end CHARACTERISTIC
/begin CHARACTERISTIC FPsw_UGF4_drifttl2 "FPrm_switches(469)" VALUE 0x001C7384 /* @ECU_Address@FPrm_switches@0x021B93AA@ */ ECIPP_ALIGNMENT_UWORD 65535 Compu_IDENTITY 0 65535 PHYS_UNIT "Enable bits" /end CHARACTERISTIC
/begin CHARACTERISTIC FPsw_UGF4_drifttol "FPrm_switches(468)" VALUE 0x001C7382 /* @ECU_Address@FPrm_switches@0x021B93A8@ */ ECIPP_ALIGNMENT_UWORD 65535 Compu_IDENTITY 0 65535 PHYS_UNIT "Enable bits" /end CHARACTERISTIC
/begin CHARACTERISTIC FPsw_UGF4_Hv_hi "FPrm_switches(470)" VALUE 0x001C7386 /* @ECU_Address@FPrm_switches@0x021B93AC@ */ ECIPP_ALIGNMENT_UWORD 65535 Compu_IDENTITY 0 65535 PHYS_UNIT "Enable bits" /end CHARACTERISTIC
/begin CHARACTERISTIC FPsw_UGF4_internal "FPrm_switches(466)" VALUE 0x001C737E /* @ECU_Address@FPrm_switches@0x021B93A4@ */ ECIPP_ALIGNMENT_UWORD 65535 Compu_IDENTITY 0 65535 PHYS_UNIT "Enable bits" /end CHARACTERISTIC
/begin CHARACTERISTIC FPsw_UGF4_lowsupply "FPrm_switches(467)" VALUE 0x001C7380 /* @ECU_Address@FPrm_switches@0x021B93A6@ */ ECIPP_ALIGNMENT_UWORD 65535 Compu_IDENTITY 0 65535 PHYS_UNIT "Enable bits" /end CHARACTERISTIC
/begin CHARACTERISTIC FPsw_UGF4_R_hi "FPrm_switches(471)" VALUE 0x001C7388 /* @ECU_Address@FPrm_switches@0x021B93AE@ */ ECIPP_ALIGNMENT_UWORD 65535 Compu_IDENTITY 0 65535 PHYS_UNIT "Enable bits" /end CHARACTERISTIC
/begin CHARACTERISTIC FPsw_UGF4_SR_hi "FPrm_switches(474)" VALUE 0x001C738E /* @ECU_Address@FPrm_switches@0x021B93B4@ */ ECIPP_ALIGNMENT_UWORD 65535 Compu_IDENTITY 0 65535 PHYS_UNIT "Enable bits" /end CHARACTERISTIC
/begin CHARACTERISTIC FPsw_UGF4_SR_slow "FPrm_switches(473)" VALUE 0x001C738C /* @ECU_Address@FPrm_switches@0x021B93B2@ */ ECIPP_ALIGNMENT_UWORD 65535 Compu_IDENTITY 0 65535 PHYS_UNIT "Enable bits" /end CHARACTERISTIC
/begin CHARACTERISTIC FPsw_UGF4_Sv_hi "FPrm_switches(472)" VALUE 0x001C738A /* @ECU_Address@FPrm_switches@0x021B93B0@ */ ECIPP_ALIGNMENT_UWORD 65535 Compu_IDENTITY 0 65535 PHYS_UNIT "Enable bits" /end CHARACTERISTIC
/begin CHARACTERISTIC FPsw_V_max "FPrm_switches(14)" VALUE 0x001C6FF6 /* @ECU_Address@FPrm_switches@0x021B901C@ */ ECIPP_ALIGNMENT_UWORD 65535 Compu_IDENTITY 0 65535 PHYS_UNIT "Enable bits" /end CHARACTERISTIC
/begin CHARACTERISTIC FPsw_V_min "FPrm_switches(15)" VALUE 0x001C6FF8 /* @ECU_Address@FPrm_switches@0x021B901E@ */ ECIPP_ALIGNMENT_UWORD 65535 Compu_IDENTITY 0 65535 PHYS_UNIT "Enable bits" /end CHARACTERISTIC
/begin CHARACTERISTIC FPsw_VE5_max "FPrm_switches(16)" VALUE 0x001C6FFA /* @ECU_Address@FPrm_switches@0x021B9020@ */ ECIPP_ALIGNMENT_UWORD 65535 Compu_IDENTITY 0 65535 PHYS_UNIT "Enable bits" /end CHARACTERISTIC
/begin CHARACTERISTIC FPsw_VE5_min "FPrm_switches(17)" VALUE 0x001C6FFC /* @ECU_Address@FPrm_switches@0x021B9022@ */ ECIPP_ALIGNMENT_UWORD 65535 Compu_IDENTITY 0 65535 PHYS_UNIT "Enable bits" /end CHARACTERISTIC
/begin CHARACTERISTIC FPsw_VE5ab_OOR "FPrm_switches(143)" VALUE 0x001C70F8 /* @ECU_Address@FPrm_switches@0x021B911E@ */ ECIPP_ALIGNMENT_UWORD 65535 Compu_IDENTITY 0 65535 PHYS_UNIT "Enable bits" /end CHARACTERISTIC
/begin CHARACTERISTIC FPsw_VE5b_max "FPrm_switches(141)" VALUE 0x001C70F4 /* @ECU_Address@FPrm_switches@0x021B911A@ */ ECIPP_ALIGNMENT_UWORD 65535 Compu_IDENTITY 0 65535 PHYS_UNIT "Enable bits" /end CHARACTERISTIC
/begin CHARACTERISTIC FPsw_VE5b_min "FPrm_switches(142)" VALUE 0x001C70F6 /* @ECU_Address@FPrm_switches@0x021B911C@ */ ECIPP_ALIGNMENT_UWORD 65535 Compu_IDENTITY 0 65535 PHYS_UNIT "Enable bits" /end CHARACTERISTIC
/begin CHARACTERISTIC FPsw_VE5c_max "FPrm_switches(386)" VALUE 0x001C72DE /* @ECU_Address@FPrm_switches@0x021B9304@ */ ECIPP_ALIGNMENT_UWORD 65535 Compu_IDENTITY 0 65535 PHYS_UNIT "Enable bits" /end CHARACTERISTIC
/begin CHARACTERISTIC FPsw_VE5c_min "FPrm_switches(387)" VALUE 0x001C72E0 /* @ECU_Address@FPrm_switches@0x021B9306@ */ ECIPP_ALIGNMENT_UWORD 65535 Compu_IDENTITY 0 65535 PHYS_UNIT "Enable bits" /end CHARACTERISTIC
/begin CHARACTERISTIC FPsw_WGCV_comm_lost "FPrm_switches(713)" VALUE 0x001C756C /* @ECU_Address@FPrm_switches@0x021B9592@ */ ECIPP_ALIGNMENT_UWORD 65535 Compu_IDENTITY 0 65535 PHYS_UNIT "Enable bits" /end CHARACTERISTIC
/begin CHARACTERISTIC FPsw_WGCV_func_lost "FPrm_switches(715)" VALUE 0x001C7570 /* @ECU_Address@FPrm_switches@0x021B9596@ */ ECIPP_ALIGNMENT_UWORD 65535 Compu_IDENTITY 0 65535 PHYS_UNIT "Enable bits" /end CHARACTERISTIC
/begin CHARACTERISTIC FPsw_WGCV_perf_limit "FPrm_switches(714)" VALUE 0x001C756E /* @ECU_Address@FPrm_switches@0x021B9594@ */ ECIPP_ALIGNMENT_UWORD 65535 Compu_IDENTITY 0 65535 PHYS_UNIT "Enable bits" /end CHARACTERISTIC
/begin CHARACTERISTIC FPsw_WGP_maxv "FPrm_switches(101)" VALUE 0x001C70A4 /* @ECU_Address@FPrm_switches@0x021B90CA@ */ ECIPP_ALIGNMENT_UWORD 65535 Compu_IDENTITY 0 65535 PHYS_UNIT "Enable bits" /end CHARACTERISTIC
/begin CHARACTERISTIC FPsw_WGP_minv "FPrm_switches(102)" VALUE 0x001C70A6 /* @ECU_Address@FPrm_switches@0x021B90CC@ */ ECIPP_ALIGNMENT_UWORD 65535 Compu_IDENTITY 0 65535 PHYS_UNIT "Enable bits" /end CHARACTERISTIC
/begin CHARACTERISTIC FPsw_WGPerr_neg "FPrm_switches(527)" VALUE 0x001C73F8 /* @ECU_Address@FPrm_switches@0x021B941E@ */ ECIPP_ALIGNMENT_UWORD 65535 Compu_IDENTITY 0 65535 PHYS_UNIT "Enable bits" /end CHARACTERISTIC
/begin CHARACTERISTIC FPsw_WGPerr_pos "FPrm_switches(526)" VALUE 0x001C73F6 /* @ECU_Address@FPrm_switches@0x021B941C@ */ ECIPP_ALIGNMENT_UWORD 65535 Compu_IDENTITY 0 65535 PHYS_UNIT "Enable bits" /end CHARACTERISTIC
/begin CHARACTERISTIC FPsw_WTRIN_detect "FPrm_switches(214)" VALUE 0x001C7186 /* @ECU_Address@FPrm_switches@0x021B91AC@ */ ECIPP_ALIGNMENT_UWORD 65535 Compu_IDENTITY 0 65535 PHYS_UNIT "Enable bits" /end CHARACTERISTIC
/begin CHARACTERISTIC FPsw_XEGOi_OOR "FPrm_switches(631)" VALUE 0x001C74C8 /* @ECU_Address@FPrm_switches@0x021B94EE@ */ ECIPP_ALIGNMENT_UWORD 65535 Compu_IDENTITY 0 65535 PHYS_UNIT "Enable bits" /end CHARACTERISTIC
/begin CHARACTERISTIC FCdtc_UGF2_drifttol "FCtl_DTC(506)" VALUE 0x001E3C5E /* @ECU_Address@FCtl_DTC@0x021B53F4@ */ ECIPP_ALIGNMENT_UWORD 65535 Compu_IDENTITY 0 65535 PHYS_UNIT "DTC" /end CHARACTERISTIC
/begin CHARACTERISTIC FCdtc_UGF2_Hv_hi "FCtl_DTC(409)" VALUE 0x001E3B9C /* @ECU_Address@FCtl_DTC@0x021B5332@ */ ECIPP_ALIGNMENT_UWORD 65535 Compu_IDENTITY 0 65535 PHYS_UNIT "DTC" /end CHARACTERISTIC
/begin CHARACTERISTIC FCdtc_UGF2_internal "FCtl_DTC(408)" VALUE 0x001E3B9A /* @ECU_Address@FCtl_DTC@0x021B5330@ */ ECIPP_ALIGNMENT_UWORD 65535 Compu_IDENTITY 0 65535 PHYS_UNIT "DTC" /end CHARACTERISTIC
/begin CHARACTERISTIC FCdtc_UGF2_lowsupply "FCtl_DTC(531)" VALUE 0x001E3C90 /* @ECU_Address@FCtl_DTC@0x021B5426@ */ ECIPP_ALIGNMENT_UWORD 65535 Compu_IDENTITY 0 65535 PHYS_UNIT "DTC" /end CHARACTERISTIC
/begin CHARACTERISTIC FCdtc_UGF2_R_hi "FCtl_DTC(411)" VALUE 0x001E3BA0 /* @ECU_Address@FCtl_DTC@0x021B5336@ */ ECIPP_ALIGNMENT_UWORD 65535 Compu_IDENTITY 0 65535 PHYS_UNIT "DTC" /end CHARACTERISTIC
/begin CHARACTERISTIC FCdtc_UGF2_SR_hi "FCtl_DTC(423)" VALUE 0x001E3BB8 /* @ECU_Address@FCtl_DTC@0x021B534E@ */ ECIPP_ALIGNMENT_UWORD 65535 Compu_IDENTITY 0 65535 PHYS_UNIT "DTC" /end CHARACTERISTIC
/begin CHARACTERISTIC FCdtc_UGF2_SR_slow "FCtl_DTC(421)" VALUE 0x001E3BB4 /* @ECU_Address@FCtl_DTC@0x021B534A@ */ ECIPP_ALIGNMENT_UWORD 65535 Compu_IDENTITY 0 65535 PHYS_UNIT "DTC" /end CHARACTERISTIC
/begin CHARACTERISTIC FCdtc_UGF2_Sv_hi "FCtl_DTC(417)" VALUE 0x001E3BAC /* @ECU_Address@FCtl_DTC@0x021B5342@ */ ECIPP_ALIGNMENT_UWORD 65535 Compu_IDENTITY 0 65535 PHYS_UNIT "DTC" /end CHARACTERISTIC
/begin CHARACTERISTIC FCdtc_UGF3_comm_lost "FCtl_DTC(682)" VALUE 0x001E3DBE /* @ECU_Address@FCtl_DTC@0x021B5554@ */ ECIPP_ALIGNMENT_UWORD 65535 Compu_IDENTITY 0 65535 PHYS_UNIT "DTC" /end CHARACTERISTIC
/begin CHARACTERISTIC FCdtc_UGF3_drifttl2 "FCtl_DTC(604)" VALUE 0x001E3D22 /* @ECU_Address@FCtl_DTC@0x021B54B8@ */ ECIPP_ALIGNMENT_UWORD 65535 Compu_IDENTITY 0 65535 PHYS_UNIT "DTC" /end CHARACTERISTIC
/begin CHARACTERISTIC FCdtc_UGF3_drifttol "FCtl_DTC(603)" VALUE 0x001E3D20 /* @ECU_Address@FCtl_DTC@0x021B54B6@ */ ECIPP_ALIGNMENT_UWORD 65535 Compu_IDENTITY 0 65535 PHYS_UNIT "DTC" /end CHARACTERISTIC
/begin CHARACTERISTIC FCdtc_UGF3_Hv_hi "FCtl_DTC(605)" VALUE 0x001E3D24 /* @ECU_Address@FCtl_DTC@0x021B54BA@ */ ECIPP_ALIGNMENT_UWORD 65535 Compu_IDENTITY 0 65535 PHYS_UNIT "DTC" /end CHARACTERISTIC
/begin CHARACTERISTIC FCdtc_UGF3_internal "FCtl_DTC(601)" VALUE 0x001E3D1C /* @ECU_Address@FCtl_DTC@0x021B54B2@ */ ECIPP_ALIGNMENT_UWORD 65535 Compu_IDENTITY 0 65535 PHYS_UNIT "DTC" /end CHARACTERISTIC
/begin CHARACTERISTIC FCdtc_UGF3_lowsupply "FCtl_DTC(602)" VALUE 0x001E3D1E /* @ECU_Address@FCtl_DTC@0x021B54B4@ */ ECIPP_ALIGNMENT_UWORD 65535 Compu_IDENTITY 0 65535 PHYS_UNIT "DTC" /end CHARACTERISTIC
/begin CHARACTERISTIC FCdtc_UGF3_R_hi "FCtl_DTC(607)" VALUE 0x001E3D28 /* @ECU_Address@FCtl_DTC@0x021B54BE@ */ ECIPP_ALIGNMENT_UWORD 65535 Compu_IDENTITY 0 65535 PHYS_UNIT "DTC" /end CHARACTERISTIC
/begin CHARACTERISTIC FCdtc_UGF3_SR_hi "FCtl_DTC(619)" VALUE 0x001E3D40 /* @ECU_Address@FCtl_DTC@0x021B54D6@ */ ECIPP_ALIGNMENT_UWORD 65535 Compu_IDENTITY 0 65535 PHYS_UNIT "DTC" /end CHARACTERISTIC
/begin CHARACTERISTIC FCdtc_UGF3_SR_slow "FCtl_DTC(617)" VALUE 0x001E3D3C /* @ECU_Address@FCtl_DTC@0x021B54D2@ */ ECIPP_ALIGNMENT_UWORD 65535 Compu_IDENTITY 0 65535 PHYS_UNIT "DTC" /end CHARACTERISTIC
/begin CHARACTERISTIC FCdtc_UGF3_Sv_hi "FCtl_DTC(613)" VALUE 0x001E3D34 /* @ECU_Address@FCtl_DTC@0x021B54CA@ */ ECIPP_ALIGNMENT_UWORD 65535 Compu_IDENTITY 0 65535 PHYS_UNIT "DTC" /end CHARACTERISTIC
/begin CHARACTERISTIC FCdtc_UGF4_comm_lost "FCtl_DTC(683)" VALUE 0x001E3DC0 /* @ECU_Address@FCtl_DTC@0x021B5556@ */ ECIPP_ALIGNMENT_UWORD 65535 Compu_IDENTITY 0 65535 PHYS_UNIT "DTC" /end CHARACTERISTIC
/begin CHARACTERISTIC FCdtc_UGF4_drifttl2 "FCtl_DTC(627)" VALUE 0x001E3D50 /* @ECU_Address@FCtl_DTC@0x021B54E6@ */ ECIPP_ALIGNMENT_UWORD 65535 Compu_IDENTITY 0 65535 PHYS_UNIT "DTC" /end CHARACTERISTIC
/begin CHARACTERISTIC FCdtc_UGF4_drifttol "FCtl_DTC(626)" VALUE 0x001E3D4E /* @ECU_Address@FCtl_DTC@0x021B54E4@ */ ECIPP_ALIGNMENT_UWORD 65535 Compu_IDENTITY 0 65535 PHYS_UNIT "DTC" /end CHARACTERISTIC
/begin CHARACTERISTIC FCdtc_UGF4_Hv_hi "FCtl_DTC(628)" VALUE 0x001E3D52 /* @ECU_Address@FCtl_DTC@0x021B54E8@ */ ECIPP_ALIGNMENT_UWORD 65535 Compu_IDENTITY 0 65535 PHYS_UNIT "DTC" /end CHARACTERISTIC
/begin CHARACTERISTIC FCdtc_UGF4_internal "FCtl_DTC(624)" VALUE 0x001E3D4A /* @ECU_Address@FCtl_DTC@0x021B54E0@ */ ECIPP_ALIGNMENT_UWORD 65535 Compu_IDENTITY 0 65535 PHYS_UNIT "DTC" /end CHARACTERISTIC
/begin CHARACTERISTIC FCdtc_UGF4_lowsupply "FCtl_DTC(625)" VALUE 0x001E3D4C /* @ECU_Address@FCtl_DTC@0x021B54E2@ */ ECIPP_ALIGNMENT_UWORD 65535 Compu_IDENTITY 0 65535 PHYS_UNIT "DTC" /end CHARACTERISTIC
/begin CHARACTERISTIC FCdtc_UGF4_R_hi "FCtl_DTC(630)" VALUE 0x001E3D56 /* @ECU_Address@FCtl_DTC@0x021B54EC@ */ ECIPP_ALIGNMENT_UWORD 65535 Compu_IDENTITY 0 65535 PHYS_UNIT "DTC" /end CHARACTERISTIC
/begin CHARACTERISTIC FCdtc_UGF4_SR_hi "FCtl_DTC(642)" VALUE 0x001E3D6E /* @ECU_Address@FCtl_DTC@0x021B5504@ */ ECIPP_ALIGNMENT_UWORD 65535 Compu_IDENTITY 0 65535 PHYS_UNIT "DTC" /end CHARACTERISTIC
/begin CHARACTERISTIC FCdtc_UGF4_SR_slow "FCtl_DTC(640)" VALUE 0x001E3D6A /* @ECU_Address@FCtl_DTC@0x021B5500@ */ ECIPP_ALIGNMENT_UWORD 65535 Compu_IDENTITY 0 65535 PHYS_UNIT "DTC" /end CHARACTERISTIC
/begin CHARACTERISTIC FCdtc_UGF4_Sv_hi "FCtl_DTC(636)" VALUE 0x001E3D62 /* @ECU_Address@FCtl_DTC@0x021B54F8@ */ ECIPP_ALIGNMENT_UWORD 65535 Compu_IDENTITY 0 65535 PHYS_UNIT "DTC" /end CHARACTERISTIC
/begin CHARACTERISTIC FCdtc_V_max "FCtl_DTC(9)" VALUE 0x001E387C /* @ECU_Address@FCtl_DTC@0x021B5012@ */ ECIPP_ALIGNMENT_UWORD 65535 Compu_IDENTITY 0 65535 PHYS_UNIT "DTC" /end CHARACTERISTIC
/begin CHARACTERISTIC FCdtc_V_min "FCtl_DTC(10)" VALUE 0x001E387E /* @ECU_Address@FCtl_DTC@0x021B5014@ */ ECIPP_ALIGNMENT_UWORD 65535 Compu_IDENTITY 0 65535 PHYS_UNIT "DTC" /end CHARACTERISTIC
/begin CHARACTERISTIC FCdtc_VE5_max "FCtl_DTC(11)" VALUE 0x001E3880 /* @ECU_Address@FCtl_DTC@0x021B5016@ */ ECIPP_ALIGNMENT_UWORD 65535 Compu_IDENTITY 0 65535 PHYS_UNIT "DTC" /end CHARACTERISTIC
/begin CHARACTERISTIC FCdtc_VE5_min "FCtl_DTC(12)" VALUE 0x001E3882 /* @ECU_Address@FCtl_DTC@0x021B5018@ */ ECIPP_ALIGNMENT_UWORD 65535 Compu_IDENTITY 0 65535 PHYS_UNIT "DTC" /end CHARACTERISTIC
/begin CHARACTERISTIC FCdtc_VE5ab_OOR "FCtl_DTC(183)" VALUE 0x001E39D8 /* @ECU_Address@FCtl_DTC@0x021B516E@ */ ECIPP_ALIGNMENT_UWORD 65535 Compu_IDENTITY 0 65535 PHYS_UNIT "DTC" /end CHARACTERISTIC
/begin CHARACTERISTIC FCdtc_VE5b_max "FCtl_DTC(181)" VALUE 0x001E39D4 /* @ECU_Address@FCtl_DTC@0x021B516A@ */ ECIPP_ALIGNMENT_UWORD 65535 Compu_IDENTITY 0 65535 PHYS_UNIT "DTC" /end CHARACTERISTIC
/begin CHARACTERISTIC FCdtc_VE5b_min "FCtl_DTC(182)" VALUE 0x001E39D6 /* @ECU_Address@FCtl_DTC@0x021B516C@ */ ECIPP_ALIGNMENT_UWORD 65535 Compu_IDENTITY 0 65535 PHYS_UNIT "DTC" /end CHARACTERISTIC
/begin CHARACTERISTIC FCdtc_VE5c_max "FCtl_DTC(507)" VALUE 0x001E3C60 /* @ECU_Address@FCtl_DTC@0x021B53F6@ */ ECIPP_ALIGNMENT_UWORD 65535 Compu_IDENTITY 0 65535 PHYS_UNIT "DTC" /end CHARACTERISTIC
/begin CHARACTERISTIC FCdtc_VE5c_min "FCtl_DTC(508)" VALUE 0x001E3C62 /* @ECU_Address@FCtl_DTC@0x021B53F8@ */ ECIPP_ALIGNMENT_UWORD 65535 Compu_IDENTITY 0 65535 PHYS_UNIT "DTC" /end CHARACTERISTIC
/begin CHARACTERISTIC FCdtc_WGCV_comm_lost "FCtl_DTC(1037)" VALUE 0x001E4084 /* @ECU_Address@FCtl_DTC@0x021B581A@ */ ECIPP_ALIGNMENT_UWORD 65535 Compu_IDENTITY 0 65535 PHYS_UNIT "DTC" /end CHARACTERISTIC
/begin CHARACTERISTIC FCdtc_WGCV_func_lost "FCtl_DTC(1039)" VALUE 0x001E4088 /* @ECU_Address@FCtl_DTC@0x021B581E@ */ ECIPP_ALIGNMENT_UWORD 65535 Compu_IDENTITY 0 65535 PHYS_UNIT "DTC" /end CHARACTERISTIC
/begin CHARACTERISTIC FCdtc_WGCV_perf_limit "FCtl_DTC(1038)" VALUE 0x001E4086 /* @ECU_Address@FCtl_DTC@0x021B581C@ */ ECIPP_ALIGNMENT_UWORD 65535 Compu_IDENTITY 0 65535 PHYS_UNIT "DTC" /end CHARACTERISTIC
/begin CHARACTERISTIC FCdtc_WGP_maxv "FCtl_DTC(141)" VALUE 0x001E3984 /* @ECU_Address@FCtl_DTC@0x021B511A@ */ ECIPP_ALIGNMENT_UWORD 65535 Compu_IDENTITY 0 65535 PHYS_UNIT "DTC" /end CHARACTERISTIC
/begin CHARACTERISTIC FCdtc_WGP_minv "FCtl_DTC(142)" VALUE 0x001E3986 /* @ECU_Address@FCtl_DTC@0x021B511C@ */ ECIPP_ALIGNMENT_UWORD 65535 Compu_IDENTITY 0 65535 PHYS_UNIT "DTC" /end CHARACTERISTIC
/begin CHARACTERISTIC FCdtc_WGPerr_neg "FCtl_DTC(697)" VALUE 0x001E3DDC /* @ECU_Address@FCtl_DTC@0x021B5572@ */ ECIPP_ALIGNMENT_UWORD 65535 Compu_IDENTITY 0 65535 PHYS_UNIT "DTC" /end CHARACTERISTIC
/begin CHARACTERISTIC FCdtc_WGPerr_pos "FCtl_DTC(696)" VALUE 0x001E3DDA /* @ECU_Address@FCtl_DTC@0x021B5570@ */ ECIPP_ALIGNMENT_UWORD 65535 Compu_IDENTITY 0 65535 PHYS_UNIT "DTC" /end CHARACTERISTIC
/begin CHARACTERISTIC FCdtc_WTRIN_detect "FCtl_DTC(292)" VALUE 0x001E3AB2 /* @ECU_Address@FCtl_DTC@0x021B5248@ */ ECIPP_ALIGNMENT_UWORD 65535 Compu_IDENTITY 0 65535 PHYS_UNIT "DTC" /end CHARACTERISTIC
/begin CHARACTERISTIC FCdtc_XEGOi_OOR "FCtl_DTC(802)" VALUE 0x001E3EAE /* @ECU_Address@FCtl_DTC@0x021B5644@ */ ECIPP_ALIGNMENT_UWORD 65535 Compu_IDENTITY 0 65535 PHYS_UNIT "DTC" /end CHARACTERISTIC
/begin CHARACTERISTIC FCfmi_UGF2_drifttol "FCtl_FMI(506)" VALUE 0x001E5AFB /* @ECU_Address@FCtl_FMI@0x021B71FA@ */ ECIPP_ALIGNMENT_UBYTE 255 Compu_IDENTITY 0 255 PHYS_UNIT "FMI" /end CHARACTERISTIC
/begin CHARACTERISTIC FCfmi_UGF2_Hv_hi "FCtl_FMI(409)" VALUE 0x001E5A9A /* @ECU_Address@FCtl_FMI@0x021B7199@ */ ECIPP_ALIGNMENT_UBYTE 255 Compu_IDENTITY 0 255 PHYS_UNIT "FMI" /end CHARACTERISTIC
/begin CHARACTERISTIC FCfmi_UGF2_internal "FCtl_FMI(408)" VALUE 0x001E5A99 /* @ECU_Address@FCtl_FMI@0x021B7198@ */ ECIPP_ALIGNMENT_UBYTE 255 Compu_IDENTITY 0 255 PHYS_UNIT "FMI" /end CHARACTERISTIC
/begin CHARACTERISTIC FCfmi_UGF2_lowsupply "FCtl_FMI(531)" VALUE 0x001E5B14 /* @ECU_Address@FCtl_FMI@0x021B7213@ */ ECIPP_ALIGNMENT_UBYTE 255 Compu_IDENTITY 0 255 PHYS_UNIT "FMI" /end CHARACTERISTIC
/begin CHARACTERISTIC FCfmi_UGF2_R_hi "FCtl_FMI(411)" VALUE 0x001E5A9C /* @ECU_Address@FCtl_FMI@0x021B719B@ */ ECIPP_ALIGNMENT_UBYTE 255 Compu_IDENTITY 0 255 PHYS_UNIT "FMI" /end CHARACTERISTIC
/begin CHARACTERISTIC FCfmi_UGF2_SR_hi "FCtl_FMI(423)" VALUE 0x001E5AA8 /* @ECU_Address@FCtl_FMI@0x021B71A7@ */ ECIPP_ALIGNMENT_UBYTE 255 Compu_IDENTITY 0 255 PHYS_UNIT "FMI" /end CHARACTERISTIC
/begin CHARACTERISTIC FCfmi_UGF2_SR_slow "FCtl_FMI(421)" VALUE 0x001E5AA6 /* @ECU_Address@FCtl_FMI@0x021B71A5@ */ ECIPP_ALIGNMENT_UBYTE 255 Compu_IDENTITY 0 255 PHYS_UNIT "FMI" /end CHARACTERISTIC
/begin CHARACTERISTIC FCfmi_UGF2_Sv_hi "FCtl_FMI(417)" VALUE 0x001E5AA2 /* @ECU_Address@FCtl_FMI@0x021B71A1@ */ ECIPP_ALIGNMENT_UBYTE 255 Compu_IDENTITY 0 255 PHYS_UNIT "FMI" /end CHARACTERISTIC
/begin CHARACTERISTIC FCfmi_UGF3_comm_lost "FCtl_FMI(682)" VALUE 0x001E5BAB /* @ECU_Address@FCtl_FMI@0x021B72AA@ */ ECIPP_ALIGNMENT_UBYTE 255 Compu_IDENTITY 0 255 PHYS_UNIT "FMI" /end CHARACTERISTIC
/begin CHARACTERISTIC FCfmi_UGF3_drifttl2 "FCtl_FMI(604)" VALUE 0x001E5B5D /* @ECU_Address@FCtl_FMI@0x021B725C@ */ ECIPP_ALIGNMENT_UBYTE 255 Compu_IDENTITY 0 255 PHYS_UNIT "FMI" /end CHARACTERISTIC
/begin CHARACTERISTIC FCfmi_UGF3_drifttol "FCtl_FMI(603)" VALUE 0x001E5B5C /* @ECU_Address@FCtl_FMI@0x021B725B@ */ ECIPP_ALIGNMENT_UBYTE 255 Compu_IDENTITY 0 255 PHYS_UNIT "FMI" /end CHARACTERISTIC
/begin CHARACTERISTIC FCfmi_UGF3_Hv_hi "FCtl_FMI(605)" VALUE 0x001E5B5E /* @ECU_Address@FCtl_FMI@0x021B725D@ */ ECIPP_ALIGNMENT_UBYTE 255 Compu_IDENTITY 0 255 PHYS_UNIT "FMI" /end CHARACTERISTIC
/begin CHARACTERISTIC FCfmi_UGF3_internal "FCtl_FMI(601)" VALUE 0x001E5B5A /* @ECU_Address@FCtl_FMI@0x021B7259@ */ ECIPP_ALIGNMENT_UBYTE 255 Compu_IDENTITY 0 255 PHYS_UNIT "FMI" /end CHARACTERISTIC
/begin CHARACTERISTIC FCfmi_UGF3_lowsupply "FCtl_FMI(602)" VALUE 0x001E5B5B /* @ECU_Address@FCtl_FMI@0x021B725A@ */ ECIPP_ALIGNMENT_UBYTE 255 Compu_IDENTITY 0 255 PHYS_UNIT "FMI" /end CHARACTERISTIC
/begin CHARACTERISTIC FCfmi_UGF3_R_hi "FCtl_FMI(607)" VALUE 0x001E5B60 /* @ECU_Address@FCtl_FMI@0x021B725F@ */ ECIPP_ALIGNMENT_UBYTE 255 Compu_IDENTITY 0 255 PHYS_UNIT "FMI" /end CHARACTERISTIC
/begin CHARACTERISTIC FCfmi_UGF3_SR_hi "FCtl_FMI(619)" VALUE 0x001E5B6C /* @ECU_Address@FCtl_FMI@0x021B726B@ */ ECIPP_ALIGNMENT_UBYTE 255 Compu_IDENTITY 0 255 PHYS_UNIT "FMI" /end CHARACTERISTIC
/begin CHARACTERISTIC FCfmi_UGF3_SR_slow "FCtl_FMI(617)" VALUE 0x001E5B6A /* @ECU_Address@FCtl_FMI@0x021B7269@ */ ECIPP_ALIGNMENT_UBYTE 255 Compu_IDENTITY 0 255 PHYS_UNIT "FMI" /end CHARACTERISTIC
/begin CHARACTERISTIC FCfmi_UGF3_Sv_hi "FCtl_FMI(613)" VALUE 0x001E5B66 /* @ECU_Address@FCtl_FMI@0x021B7265@ */ ECIPP_ALIGNMENT_UBYTE 255 Compu_IDENTITY 0 255 PHYS_UNIT "FMI" /end CHARACTERISTIC
/begin CHARACTERISTIC FCfmi_UGF4_comm_lost "FCtl_FMI(683)" VALUE 0x001E5BAC /* @ECU_Address@FCtl_FMI@0x021B72AB@ */ ECIPP_ALIGNMENT_UBYTE 255 Compu_IDENTITY 0 255 PHYS_UNIT "FMI" /end CHARACTERISTIC
/begin CHARACTERISTIC FCfmi_UGF4_drifttl2 "FCtl_FMI(627)" VALUE 0x001E5B74 /* @ECU_Address@FCtl_FMI@0x021B7273@ */ ECIPP_ALIGNMENT_UBYTE 255 Compu_IDENTITY 0 255 PHYS_UNIT "FMI" /end CHARACTERISTIC
/begin CHARACTERISTIC FCfmi_UGF4_drifttol "FCtl_FMI(626)" VALUE 0x001E5B73 /* @ECU_Address@FCtl_FMI@0x021B7272@ */ ECIPP_ALIGNMENT_UBYTE 255 Compu_IDENTITY 0 255 PHYS_UNIT "FMI" /end CHARACTERISTIC
/begin CHARACTERISTIC FCfmi_UGF4_Hv_hi "FCtl_FMI(628)" VALUE 0x001E5B75 /* @ECU_Address@FCtl_FMI@0x021B7274@ */ ECIPP_ALIGNMENT_UBYTE 255 Compu_IDENTITY 0 255 PHYS_UNIT "FMI" /end CHARACTERISTIC
/begin CHARACTERISTIC FCfmi_UGF4_internal "FCtl_FMI(624)" VALUE 0x001E5B71 /* @ECU_Address@FCtl_FMI@0x021B7270@ */ ECIPP_ALIGNMENT_UBYTE 255 Compu_IDENTITY 0 255 PHYS_UNIT "FMI" /end CHARACTERISTIC
/begin CHARACTERISTIC FCfmi_UGF4_lowsupply "FCtl_FMI(625)" VALUE 0x001E5B72 /* @ECU_Address@FCtl_FMI@0x021B7271@ */ ECIPP_ALIGNMENT_UBYTE 255 Compu_IDENTITY 0 255 PHYS_UNIT "FMI" /end CHARACTERISTIC
/begin CHARACTERISTIC FCfmi_UGF4_R_hi "FCtl_FMI(630)" VALUE 0x001E5B77 /* @ECU_Address@FCtl_FMI@0x021B7276@ */ ECIPP_ALIGNMENT_UBYTE 255 Compu_IDENTITY 0 255 PHYS_UNIT "FMI" /end CHARACTERISTIC
/begin CHARACTERISTIC FCfmi_UGF4_SR_hi "FCtl_FMI(642)" VALUE 0x001E5B83 /* @ECU_Address@FCtl_FMI@0x021B7282@ */ ECIPP_ALIGNMENT_UBYTE 255 Compu_IDENTITY 0 255 PHYS_UNIT "FMI" /end CHARACTERISTIC
/begin CHARACTERISTIC FCfmi_UGF4_SR_slow "FCtl_FMI(640)" VALUE 0x001E5B81 /* @ECU_Address@FCtl_FMI@0x021B7280@ */ ECIPP_ALIGNMENT_UBYTE 255 Compu_IDENTITY 0 255 PHYS_UNIT "FMI" /end CHARACTERISTIC
/begin CHARACTERISTIC FCfmi_UGF4_Sv_hi "FCtl_FMI(636)" VALUE 0x001E5B7D /* @ECU_Address@FCtl_FMI@0x021B727C@ */ ECIPP_ALIGNMENT_UBYTE 255 Compu_IDENTITY 0 255 PHYS_UNIT "FMI" /end CHARACTERISTIC
/begin CHARACTERISTIC FCfmi_V_max "FCtl_FMI(9)" VALUE 0x001E590A /* @ECU_Address@FCtl_FMI@0x021B7009@ */ ECIPP_ALIGNMENT_UBYTE 255 Compu_IDENTITY 0 255 PHYS_UNIT "FMI" /end CHARACTERISTIC
/begin CHARACTERISTIC FCfmi_V_min "FCtl_FMI(10)" VALUE 0x001E590B /* @ECU_Address@FCtl_FMI@0x021B700A@ */ ECIPP_ALIGNMENT_UBYTE 255 Compu_IDENTITY 0 255 PHYS_UNIT "FMI" /end CHARACTERISTIC
/begin CHARACTERISTIC FCfmi_VE5_max "FCtl_FMI(11)" VALUE 0x001E590C /* @ECU_Address@FCtl_FMI@0x021B700B@ */ ECIPP_ALIGNMENT_UBYTE 255 Compu_IDENTITY 0 255 PHYS_UNIT "FMI" /end CHARACTERISTIC
/begin CHARACTERISTIC FCfmi_VE5_min "FCtl_FMI(12)" VALUE 0x001E590D /* @ECU_Address@FCtl_FMI@0x021B700C@ */ ECIPP_ALIGNMENT_UBYTE 255 Compu_IDENTITY 0 255 PHYS_UNIT "FMI" /end CHARACTERISTIC
/begin CHARACTERISTIC FCfmi_VE5ab_OOR "FCtl_FMI(183)" VALUE 0x001E59B8 /* @ECU_Address@FCtl_FMI@0x021B70B7@ */ ECIPP_ALIGNMENT_UBYTE 255 Compu_IDENTITY 0 255 PHYS_UNIT "FMI" /end CHARACTERISTIC
/begin CHARACTERISTIC FCfmi_VE5b_max "FCtl_FMI(181)" VALUE 0x001E59B6 /* @ECU_Address@FCtl_FMI@0x021B70B5@ */ ECIPP_ALIGNMENT_UBYTE 255 Compu_IDENTITY 0 255 PHYS_UNIT "FMI" /end CHARACTERISTIC
/begin CHARACTERISTIC FCfmi_VE5b_min "FCtl_FMI(182)" VALUE 0x001E59B7 /* @ECU_Address@FCtl_FMI@0x021B70B6@ */ ECIPP_ALIGNMENT_UBYTE 255 Compu_IDENTITY 0 255 PHYS_UNIT "FMI" /end CHARACTERISTIC
/begin CHARACTERISTIC FCfmi_VE5c_max "FCtl_FMI(507)" VALUE 0x001E5AFC /* @ECU_Address@FCtl_FMI@0x021B71FB@ */ ECIPP_ALIGNMENT_UBYTE 255 Compu_IDENTITY 0 255 PHYS_UNIT "FMI" /end CHARACTERISTIC
/begin CHARACTERISTIC FCfmi_VE5c_min "FCtl_FMI(508)" VALUE 0x001E5AFD /* @ECU_Address@FCtl_FMI@0x021B71FC@ */ ECIPP_ALIGNMENT_UBYTE 255 Compu_IDENTITY 0 255 PHYS_UNIT "FMI" /end CHARACTERISTIC
/begin CHARACTERISTIC FCfmi_WGCV_comm_lost "FCtl_FMI(1037)" VALUE 0x001E5D0E /* @ECU_Address@FCtl_FMI@0x021B740D@ */ ECIPP_ALIGNMENT_UBYTE 255 Compu_IDENTITY 0 255 PHYS_UNIT "FMI" /end CHARACTERISTIC
/begin CHARACTERISTIC FCfmi_WGCV_func_lost "FCtl_FMI(1039)" VALUE 0x001E5D10 /* @ECU_Address@FCtl_FMI@0x021B740F@ */ ECIPP_ALIGNMENT_UBYTE 255 Compu_IDENTITY 0 255 PHYS_UNIT "FMI" /end CHARACTERISTIC
/begin CHARACTERISTIC FCfmi_WGCV_perf_limit "FCtl_FMI(1038)" VALUE 0x001E5D0F /* @ECU_Address@FCtl_FMI@0x021B740E@ */ ECIPP_ALIGNMENT_UBYTE 255 Compu_IDENTITY 0 255 PHYS_UNIT "FMI" /end CHARACTERISTIC
/begin CHARACTERISTIC FCfmi_WGP_maxv "FCtl_FMI(141)" VALUE 0x001E598E /* @ECU_Address@FCtl_FMI@0x021B708D@ */ ECIPP_ALIGNMENT_UBYTE 255 Compu_IDENTITY 0 255 PHYS_UNIT "FMI" /end CHARACTERISTIC
/begin CHARACTERISTIC FCfmi_WGP_minv "FCtl_FMI(142)" VALUE 0x001E598F /* @ECU_Address@FCtl_FMI@0x021B708E@ */ ECIPP_ALIGNMENT_UBYTE 255 Compu_IDENTITY 0 255 PHYS_UNIT "FMI" /end CHARACTERISTIC
/begin CHARACTERISTIC FCfmi_WGPerr_neg "FCtl_FMI(697)" VALUE 0x001E5BBA /* @ECU_Address@FCtl_FMI@0x021B72B9@ */ ECIPP_ALIGNMENT_UBYTE 255 Compu_IDENTITY 0 255 PHYS_UNIT "FMI" /end CHARACTERISTIC
/begin CHARACTERISTIC FCfmi_WGPerr_pos "FCtl_FMI(696)" VALUE 0x001E5BB9 /* @ECU_Address@FCtl_FMI@0x021B72B8@ */ ECIPP_ALIGNMENT_UBYTE 255 Compu_IDENTITY 0 255 PHYS_UNIT "FMI" /end CHARACTERISTIC
/begin CHARACTERISTIC FCfmi_WTRIN_detect "FCtl_FMI(292)" VALUE 0x001E5A25 /* @ECU_Address@FCtl_FMI@0x021B7124@ */ ECIPP_ALIGNMENT_UBYTE 255 Compu_IDENTITY 0 255 PHYS_UNIT "FMI" /end CHARACTERISTIC
/begin CHARACTERISTIC FCfmi_XEGOi_OOR "FCtl_FMI(802)" VALUE 0x001E5C23 /* @ECU_Address@FCtl_FMI@0x021B7322@ */ ECIPP_ALIGNMENT_UBYTE 255 Compu_IDENTITY 0 255 PHYS_UNIT "FMI" /end CHARACTERISTIC
/begin CHARACTERISTIC FCftb_UGF2_drifttol "FCtl_FTB_0x04(506)" VALUE 0x001E5F11 /* @ECU_Address@FCtl_FTB_0x04@0x024C51FA@ */ ECIPP_ALIGNMENT_UBYTE 255 Compu_IDENTITY 0 255 PHYS_UNIT "FTB" /end CHARACTERISTIC
/begin CHARACTERISTIC FCftb_UGF2_Hv_hi "FCtl_FTB_0x04(409)" VALUE 0x001E5EB0 /* @ECU_Address@FCtl_FTB_0x04@0x024C5199@ */ ECIPP_ALIGNMENT_UBYTE 255 Compu_IDENTITY 0 255 PHYS_UNIT "FTB" /end CHARACTERISTIC
/begin CHARACTERISTIC FCftb_UGF2_internal "FCtl_FTB_0x04(408)" VALUE 0x001E5EAF /* @ECU_Address@FCtl_FTB_0x04@0x024C5198@ */ ECIPP_ALIGNMENT_UBYTE 255 Compu_IDENTITY 0 255 PHYS_UNIT "FTB" /end CHARACTERISTIC
/begin CHARACTERISTIC FCftb_UGF2_lowsupply "FCtl_FTB_0x04(531)" VALUE 0x001E5F2A /* @ECU_Address@FCtl_FTB_0x04@0x024C5213@ */ ECIPP_ALIGNMENT_UBYTE 255 Compu_IDENTITY 0 255 PHYS_UNIT "FTB" /end CHARACTERISTIC
/begin CHARACTERISTIC FCftb_UGF2_R_hi "FCtl_FTB_0x04(411)" VALUE 0x001E5EB2 /* @ECU_Address@FCtl_FTB_0x04@0x024C519B@ */ ECIPP_ALIGNMENT_UBYTE 255 Compu_IDENTITY 0 255 PHYS_UNIT "FTB" /end CHARACTERISTIC
/begin CHARACTERISTIC FCftb_UGF2_SR_hi "FCtl_FTB_0x04(423)" VALUE 0x001E5EBE /* @ECU_Address@FCtl_FTB_0x04@0x024C51A7@ */ ECIPP_ALIGNMENT_UBYTE 255 Compu_IDENTITY 0 255 PHYS_UNIT "FTB" /end CHARACTERISTIC
/begin CHARACTERISTIC FCftb_UGF2_SR_slow "FCtl_FTB_0x04(421)" VALUE 0x001E5EBC /* @ECU_Address@FCtl_FTB_0x04@0x024C51A5@ */ ECIPP_ALIGNMENT_UBYTE 255 Compu_IDENTITY 0 255 PHYS_UNIT "FTB" /end CHARACTERISTIC
/begin CHARACTERISTIC FCftb_UGF2_Sv_hi "FCtl_FTB_0x04(417)" VALUE 0x001E5EB8 /* @ECU_Address@FCtl_FTB_0x04@0x024C51A1@ */ ECIPP_ALIGNMENT_UBYTE 255 Compu_IDENTITY 0 255 PHYS_UNIT "FTB" /end CHARACTERISTIC
/begin CHARACTERISTIC FCftb_UGF3_comm_lost "FCtl_FTB_0x04(682)" VALUE 0x001E5FC1 /* @ECU_Address@FCtl_FTB_0x04@0x024C52AA@ */ ECIPP_ALIGNMENT_UBYTE 255 Compu_IDENTITY 0 255 PHYS_UNIT "FTB" /end CHARACTERISTIC
/begin CHARACTERISTIC FCftb_UGF3_drifttl2 "FCtl_FTB_0x04(604)" VALUE 0x001E5F73 /* @ECU_Address@FCtl_FTB_0x04@0x024C525C@ */ ECIPP_ALIGNMENT_UBYTE 255 Compu_IDENTITY 0 255 PHYS_UNIT "FTB" /end CHARACTERISTIC
/begin CHARACTERISTIC FCftb_UGF3_drifttol "FCtl_FTB_0x04(603)" VALUE 0x001E5F72 /* @ECU_Address@FCtl_FTB_0x04@0x024C525B@ */ ECIPP_ALIGNMENT_UBYTE 255 Compu_IDENTITY 0 255 PHYS_UNIT "FTB" /end CHARACTERISTIC
/begin CHARACTERISTIC FCftb_UGF3_Hv_hi "FCtl_FTB_0x04(605)" VALUE 0x001E5F74 /* @ECU_Address@FCtl_FTB_0x04@0x024C525D@ */ ECIPP_ALIGNMENT_UBYTE 255 Compu_IDENTITY 0 255 PHYS_UNIT "FTB" /end CHARACTERISTIC
/begin CHARACTERISTIC FCftb_UGF3_internal "FCtl_FTB_0x04(601)" VALUE 0x001E5F70 /* @ECU_Address@FCtl_FTB_0x04@0x024C5259@ */ ECIPP_ALIGNMENT_UBYTE 255 Compu_IDENTITY 0 255 PHYS_UNIT "FTB" /end CHARACTERISTIC
/begin CHARACTERISTIC FCftb_UGF3_lowsupply "FCtl_FTB_0x04(602)" VALUE 0x001E5F71 /* @ECU_Address@FCtl_FTB_0x04@0x024C525A@ */ ECIPP_ALIGNMENT_UBYTE 255 Compu_IDENTITY 0 255 PHYS_UNIT "FTB" /end CHARACTERISTIC
/begin CHARACTERISTIC FCftb_UGF3_R_hi "FCtl_FTB_0x04(607)" VALUE 0x001E5F76 /* @ECU_Address@FCtl_FTB_0x04@0x024C525F@ */ ECIPP_ALIGNMENT_UBYTE 255 Compu_IDENTITY 0 255 PHYS_UNIT "FTB" /end CHARACTERISTIC
/begin CHARACTERISTIC FCftb_UGF3_SR_hi "FCtl_FTB_0x04(619)" VALUE 0x001E5F82 /* @ECU_Address@FCtl_FTB_0x04@0x024C526B@ */ ECIPP_ALIGNMENT_UBYTE 255 Compu_IDENTITY 0 255 PHYS_UNIT "FTB" /end CHARACTERISTIC
/begin CHARACTERISTIC FCftb_UGF3_SR_slow "FCtl_FTB_0x04(617)" VALUE 0x001E5F80 /* @ECU_Address@FCtl_FTB_0x04@0x024C5269@ */ ECIPP_ALIGNMENT_UBYTE 255 Compu_IDENTITY 0 255 PHYS_UNIT "FTB" /end CHARACTERISTIC
/begin CHARACTERISTIC FCftb_UGF3_Sv_hi "FCtl_FTB_0x04(613)" VALUE 0x001E5F7C /* @ECU_Address@FCtl_FTB_0x04@0x024C5265@ */ ECIPP_ALIGNMENT_UBYTE 255 Compu_IDENTITY 0 255 PHYS_UNIT "FTB" /end CHARACTERISTIC
/begin CHARACTERISTIC FCftb_UGF4_comm_lost "FCtl_FTB_0x04(683)" VALUE 0x001E5FC2 /* @ECU_Address@FCtl_FTB_0x04@0x024C52AB@ */ ECIPP_ALIGNMENT_UBYTE 255 Compu_IDENTITY 0 255 PHYS_UNIT "FTB" /end CHARACTERISTIC
/begin CHARACTERISTIC FCftb_UGF4_drifttl2 "FCtl_FTB_0x04(627)" VALUE 0x001E5F8A /* @ECU_Address@FCtl_FTB_0x04@0x024C5273@ */ ECIPP_ALIGNMENT_UBYTE 255 Compu_IDENTITY 0 255 PHYS_UNIT "FTB" /end CHARACTERISTIC
/begin CHARACTERISTIC FCftb_UGF4_drifttol "FCtl_FTB_0x04(626)" VALUE 0x001E5F89 /* @ECU_Address@FCtl_FTB_0x04@0x024C5272@ */ ECIPP_ALIGNMENT_UBYTE 255 Compu_IDENTITY 0 255 PHYS_UNIT "FTB" /end CHARACTERISTIC
/begin CHARACTERISTIC FCftb_UGF4_Hv_hi "FCtl_FTB_0x04(628)" VALUE 0x001E5F8B /* @ECU_Address@FCtl_FTB_0x04@0x024C5274@ */ ECIPP_ALIGNMENT_UBYTE 255 Compu_IDENTITY 0 255 PHYS_UNIT "FTB" /end CHARACTERISTIC
/begin CHARACTERISTIC FCftb_UGF4_internal "FCtl_FTB_0x04(624)" VALUE 0x001E5F87 /* @ECU_Address@FCtl_FTB_0x04@0x024C5270@ */ ECIPP_ALIGNMENT_UBYTE 255 Compu_IDENTITY 0 255 PHYS_UNIT "FTB" /end CHARACTERISTIC
/begin CHARACTERISTIC FCftb_UGF4_lowsupply "FCtl_FTB_0x04(625)" VALUE 0x001E5F88 /* @ECU_Address@FCtl_FTB_0x04@0x024C5271@ */ ECIPP_ALIGNMENT_UBYTE 255 Compu_IDENTITY 0 255 PHYS_UNIT "FTB" /end CHARACTERISTIC
/begin CHARACTERISTIC FCftb_UGF4_R_hi "FCtl_FTB_0x04(630)" VALUE 0x001E5F8D /* @ECU_Address@FCtl_FTB_0x04@0x024C5276@ */ ECIPP_ALIGNMENT_UBYTE 255 Compu_IDENTITY 0 255 PHYS_UNIT "FTB" /end CHARACTERISTIC
/begin CHARACTERISTIC FCftb_UGF4_SR_hi "FCtl_FTB_0x04(642)" VALUE 0x001E5F99 /* @ECU_Address@FCtl_FTB_0x04@0x024C5282@ */ ECIPP_ALIGNMENT_UBYTE 255 Compu_IDENTITY 0 255 PHYS_UNIT "FTB" /end CHARACTERISTIC
/begin CHARACTERISTIC FCftb_UGF4_SR_slow "FCtl_FTB_0x04(640)" VALUE 0x001E5F97 /* @ECU_Address@FCtl_FTB_0x04@0x024C5280@ */ ECIPP_ALIGNMENT_UBYTE 255 Compu_IDENTITY 0 255 PHYS_UNIT "FTB" /end CHARACTERISTIC
/begin CHARACTERISTIC FCftb_UGF4_Sv_hi "FCtl_FTB_0x04(636)" VALUE 0x001E5F93 /* @ECU_Address@FCtl_FTB_0x04@0x024C527C@ */ ECIPP_ALIGNMENT_UBYTE 255 Compu_IDENTITY 0 255 PHYS_UNIT "FTB" /end CHARACTERISTIC
/begin CHARACTERISTIC FCftb_V_max "FCtl_FTB_0x04(9)" VALUE 0x001E5D20 /* @ECU_Address@FCtl_FTB_0x04@0x024C5009@ */ ECIPP_ALIGNMENT_UBYTE 255 Compu_IDENTITY 0 255 PHYS_UNIT "FTB" /end CHARACTERISTIC
/begin CHARACTERISTIC FCftb_V_min "FCtl_FTB_0x04(10)" VALUE 0x001E5D21 /* @ECU_Address@FCtl_FTB_0x04@0x024C500A@ */ ECIPP_ALIGNMENT_UBYTE 255 Compu_IDENTITY 0 255 PHYS_UNIT "FTB" /end CHARACTERISTIC
/begin CHARACTERISTIC FCftb_VE5_max "FCtl_FTB_0x04(11)" VALUE 0x001E5D22 /* @ECU_Address@FCtl_FTB_0x04@0x024C500B@ */ ECIPP_ALIGNMENT_UBYTE 255 Compu_IDENTITY 0 255 PHYS_UNIT "FTB" /end CHARACTERISTIC
/begin CHARACTERISTIC FCftb_VE5_min "FCtl_FTB_0x04(12)" VALUE 0x001E5D23 /* @ECU_Address@FCtl_FTB_0x04@0x024C500C@ */ ECIPP_ALIGNMENT_UBYTE 255 Compu_IDENTITY 0 255 PHYS_UNIT "FTB" /end CHARACTERISTIC
/begin CHARACTERISTIC FCftb_VE5ab_OOR "FCtl_FTB_0x04(183)" VALUE 0x001E5DCE /* @ECU_Address@FCtl_FTB_0x04@0x024C50B7@ */ ECIPP_ALIGNMENT_UBYTE 255 Compu_IDENTITY 0 255 PHYS_UNIT "FTB" /end CHARACTERISTIC
/begin CHARACTERISTIC FCftb_VE5b_max "FCtl_FTB_0x04(181)" VALUE 0x001E5DCC /* @ECU_Address@FCtl_FTB_0x04@0x024C50B5@ */ ECIPP_ALIGNMENT_UBYTE 255 Compu_IDENTITY 0 255 PHYS_UNIT "FTB" /end CHARACTERISTIC
/begin CHARACTERISTIC FCftb_VE5b_min "FCtl_FTB_0x04(182)" VALUE 0x001E5DCD /* @ECU_Address@FCtl_FTB_0x04@0x024C50B6@ */ ECIPP_ALIGNMENT_UBYTE 255 Compu_IDENTITY 0 255 PHYS_UNIT "FTB" /end CHARACTERISTIC
/begin CHARACTERISTIC FCftb_VE5c_max "FCtl_FTB_0x04(507)" VALUE 0x001E5F12 /* @ECU_Address@FCtl_FTB_0x04@0x024C51FB@ */ ECIPP_ALIGNMENT_UBYTE 255 Compu_IDENTITY 0 255 PHYS_UNIT "FTB" /end CHARACTERISTIC
/begin CHARACTERISTIC FCftb_VE5c_min "FCtl_FTB_0x04(508)" VALUE 0x001E5F13 /* @ECU_Address@FCtl_FTB_0x04@0x024C51FC@ */ ECIPP_ALIGNMENT_UBYTE 255 Compu_IDENTITY 0 255 PHYS_UNIT "FTB" /end CHARACTERISTIC
/begin CHARACTERISTIC FCftb_WGCV_comm_lost "FCtl_FTB_0x04(1037)" VALUE 0x001E6124 /* @ECU_Address@FCtl_FTB_0x04@0x024C540D@ */ ECIPP_ALIGNMENT_UBYTE 255 Compu_IDENTITY 0 255 PHYS_UNIT "FTB" /end CHARACTERISTIC
/begin CHARACTERISTIC FCftb_WGCV_func_lost "FCtl_FTB_0x04(1039)" VALUE 0x001E6126 /* @ECU_Address@FCtl_FTB_0x04@0x024C540F@ */ ECIPP_ALIGNMENT_UBYTE 255 Compu_IDENTITY 0 255 PHYS_UNIT "FTB" /end CHARACTERISTIC
/begin CHARACTERISTIC FCftb_WGCV_perf_limit "FCtl_FTB_0x04(1038)" VALUE 0x001E6125 /* @ECU_Address@FCtl_FTB_0x04@0x024C540E@ */ ECIPP_ALIGNMENT_UBYTE 255 Compu_IDENTITY 0 255 PHYS_UNIT "FTB" /end CHARACTERISTIC
/begin CHARACTERISTIC FCftb_WGP_maxv "FCtl_FTB_0x04(141)" VALUE 0x001E5DA4 /* @ECU_Address@FCtl_FTB_0x04@0x024C508D@ */ ECIPP_ALIGNMENT_UBYTE 255 Compu_IDENTITY 0 255 PHYS_UNIT "FTB" /end CHARACTERISTIC
/begin CHARACTERISTIC FCftb_WGP_minv "FCtl_FTB_0x04(142)" VALUE 0x001E5DA5 /* @ECU_Address@FCtl_FTB_0x04@0x024C508E@ */ ECIPP_ALIGNMENT_UBYTE 255 Compu_IDENTITY 0 255 PHYS_UNIT "FTB" /end CHARACTERISTIC
/begin CHARACTERISTIC FCftb_WGPerr_neg "FCtl_FTB_0x04(697)" VALUE 0x001E5FD0 /* @ECU_Address@FCtl_FTB_0x04@0x024C52B9@ */ ECIPP_ALIGNMENT_UBYTE 255 Compu_IDENTITY 0 255 PHYS_UNIT "FTB" /end CHARACTERISTIC
/begin CHARACTERISTIC FCftb_WGPerr_pos "FCtl_FTB_0x04(696)" VALUE 0x001E5FCF /* @ECU_Address@FCtl_FTB_0x04@0x024C52B8@ */ ECIPP_ALIGNMENT_UBYTE 255 Compu_IDENTITY 0 255 PHYS_UNIT "FTB" /end CHARACTERISTIC
/begin CHARACTERISTIC FCftb_WTRIN_detect "FCtl_FTB_0x04(292)" VALUE 0x001E5E3B /* @ECU_Address@FCtl_FTB_0x04@0x024C5124@ */ ECIPP_ALIGNMENT_UBYTE 255 Compu_IDENTITY 0 255 PHYS_UNIT "FTB" /end CHARACTERISTIC
/begin CHARACTERISTIC FCftb_XEGOi_OOR "FCtl_FTB_0x04(802)" VALUE 0x001E6039 /* @ECU_Address@FCtl_FTB_0x04@0x024C5322@ */ ECIPP_ALIGNMENT_UBYTE 255 Compu_IDENTITY 0 255 PHYS_UNIT "FTB" /end CHARACTERISTIC
/begin CHARACTERISTIC FCspn_UGF2_drifttol "FCtl_SPN(506)" VALUE 0x001E254C /* @ECU_Address@FCtl_SPN@0x21B607E8@ */ ECIPP_ALIGNMENT_ULONG 4294967295 Compu_IDENTITY 0 4294967295 PHYS_UNIT "SPN" /end CHARACTERISTIC
/begin CHARACTERISTIC FCspn_UGF2_Hv_hi "FCtl_SPN(409)" VALUE 0x001E23C8 /* @ECU_Address@FCtl_SPN@0x21B60664@ */ ECIPP_ALIGNMENT_ULONG 4294967295 Compu_IDENTITY 0 4294967295 PHYS_UNIT "SPN" /end CHARACTERISTIC
/begin CHARACTERISTIC FCspn_UGF2_internal "FCtl_SPN(408)" VALUE 0x001E23C4 /* @ECU_Address@FCtl_SPN@0x21B60660@ */ ECIPP_ALIGNMENT_ULONG 4294967295 Compu_IDENTITY 0 4294967295 PHYS_UNIT "SPN" /end CHARACTERISTIC
/begin CHARACTERISTIC FCspn_UGF2_lowsupply "FCtl_SPN(531)" VALUE 0x001E25B0 /* @ECU_Address@FCtl_SPN@0x21B6084C@ */ ECIPP_ALIGNMENT_ULONG 4294967295 Compu_IDENTITY 0 4294967295 PHYS_UNIT "SPN" /end CHARACTERISTIC
/begin CHARACTERISTIC FCspn_UGF2_R_hi "FCtl_SPN(411)" VALUE 0x001E23D0 /* @ECU_Address@FCtl_SPN@0x21B6066C@ */ ECIPP_ALIGNMENT_ULONG 4294967295 Compu_IDENTITY 0 4294967295 PHYS_UNIT "SPN" /end CHARACTERISTIC
/begin CHARACTERISTIC FCspn_UGF2_SR_hi "FCtl_SPN(423)" VALUE 0x001E2400 /* @ECU_Address@FCtl_SPN@0x21B6069C@ */ ECIPP_ALIGNMENT_ULONG 4294967295 Compu_IDENTITY 0 4294967295 PHYS_UNIT "SPN" /end CHARACTERISTIC
/begin CHARACTERISTIC FCspn_UGF2_SR_slow "FCtl_SPN(421)" VALUE 0x001E23F8 /* @ECU_Address@FCtl_SPN@0x21B60694@ */ ECIPP_ALIGNMENT_ULONG 4294967295 Compu_IDENTITY 0 4294967295 PHYS_UNIT "SPN" /end CHARACTERISTIC
/begin CHARACTERISTIC FCspn_UGF2_Sv_hi "FCtl_SPN(417)" VALUE 0x001E23E8 /* @ECU_Address@FCtl_SPN@0x21B60684@ */ ECIPP_ALIGNMENT_ULONG 4294967295 Compu_IDENTITY 0 4294967295 PHYS_UNIT "SPN" /end CHARACTERISTIC
/begin CHARACTERISTIC FCspn_UGF3_comm_lost "FCtl_SPN(682)" VALUE 0x001E280C /* @ECU_Address@FCtl_SPN@0x21B60AA8@ */ ECIPP_ALIGNMENT_ULONG 4294967295 Compu_IDENTITY 0 4294967295 PHYS_UNIT "SPN" /end CHARACTERISTIC
/begin CHARACTERISTIC FCspn_UGF3_drifttl2 "FCtl_SPN(604)" VALUE 0x001E26D4 /* @ECU_Address@FCtl_SPN@0x21B60970@ */ ECIPP_ALIGNMENT_ULONG 4294967295 Compu_IDENTITY 0 4294967295 PHYS_UNIT "SPN" /end CHARACTERISTIC
/begin CHARACTERISTIC FCspn_UGF3_drifttol "FCtl_SPN(603)" VALUE 0x001E26D0 /* @ECU_Address@FCtl_SPN@0x21B6096C@ */ ECIPP_ALIGNMENT_ULONG 4294967295 Compu_IDENTITY 0 4294967295 PHYS_UNIT "SPN" /end CHARACTERISTIC
/begin CHARACTERISTIC FCspn_UGF3_Hv_hi "FCtl_SPN(605)" VALUE 0x001E26D8 /* @ECU_Address@FCtl_SPN@0x21B60974@ */ ECIPP_ALIGNMENT_ULONG 4294967295 Compu_IDENTITY 0 4294967295 PHYS_UNIT "SPN" /end CHARACTERISTIC
/begin CHARACTERISTIC FCspn_UGF3_internal "FCtl_SPN(601)" VALUE 0x001E26C8 /* @ECU_Address@FCtl_SPN@0x21B60964@ */ ECIPP_ALIGNMENT_ULONG 4294967295 Compu_IDENTITY 0 4294967295 PHYS_UNIT "SPN" /end CHARACTERISTIC
/begin CHARACTERISTIC FCspn_UGF3_lowsupply "FCtl_SPN(602)" VALUE 0x001E26CC /* @ECU_Address@FCtl_SPN@0x21B60968@ */ ECIPP_ALIGNMENT_ULONG 4294967295 Compu_IDENTITY 0 4294967295 PHYS_UNIT "SPN" /end CHARACTERISTIC
/begin CHARACTERISTIC FCspn_UGF3_R_hi "FCtl_SPN(607)" VALUE 0x001E26E0 /* @ECU_Address@FCtl_SPN@0x21B6097C@ */ ECIPP_ALIGNMENT_ULONG 4294967295 Compu_IDENTITY 0 4294967295 PHYS_UNIT "SPN" /end CHARACTERISTIC
/begin CHARACTERISTIC FCspn_UGF3_SR_hi "FCtl_SPN(619)" VALUE 0x001E2710 /* @ECU_Address@FCtl_SPN@0x21B609AC@ */ ECIPP_ALIGNMENT_ULONG 4294967295 Compu_IDENTITY 0 4294967295 PHYS_UNIT "SPN" /end CHARACTERISTIC
/begin CHARACTERISTIC FCspn_UGF3_SR_slow "FCtl_SPN(617)" VALUE 0x001E2708 /* @ECU_Address@FCtl_SPN@0x21B609A4@ */ ECIPP_ALIGNMENT_ULONG 4294967295 Compu_IDENTITY 0 4294967295 PHYS_UNIT "SPN" /end CHARACTERISTIC
/begin CHARACTERISTIC FCspn_UGF3_Sv_hi "FCtl_SPN(613)" VALUE 0x001E26F8 /* @ECU_Address@FCtl_SPN@0x21B60994@ */ ECIPP_ALIGNMENT_ULONG 4294967295 Compu_IDENTITY 0 4294967295 PHYS_UNIT "SPN" /end CHARACTERISTIC
/begin CHARACTERISTIC FCspn_UGF4_comm_lost "FCtl_SPN(683)" VALUE 0x001E2810 /* @ECU_Address@FCtl_SPN@0x21B60AAC@ */ ECIPP_ALIGNMENT_ULONG 4294967295 Compu_IDENTITY 0 4294967295 PHYS_UNIT "SPN" /end CHARACTERISTIC
/begin CHARACTERISTIC FCspn_UGF4_drifttl2 "FCtl_SPN(627)" VALUE 0x001E2730 /* @ECU_Address@FCtl_SPN@0x21B609CC@ */ ECIPP_ALIGNMENT_ULONG 4294967295 Compu_IDENTITY 0 4294967295 PHYS_UNIT "SPN" /end CHARACTERISTIC
/begin CHARACTERISTIC FCspn_UGF4_drifttol "FCtl_SPN(626)" VALUE 0x001E272C /* @ECU_Address@FCtl_SPN@0x21B609C8@ */ ECIPP_ALIGNMENT_ULONG 4294967295 Compu_IDENTITY 0 4294967295 PHYS_UNIT "SPN" /end CHARACTERISTIC
/begin CHARACTERISTIC FCspn_UGF4_Hv_hi "FCtl_SPN(628)" VALUE 0x001E2734 /* @ECU_Address@FCtl_SPN@0x21B609D0@ */ ECIPP_ALIGNMENT_ULONG 4294967295 Compu_IDENTITY 0 4294967295 PHYS_UNIT "SPN" /end CHARACTERISTIC
/begin CHARACTERISTIC FCspn_UGF4_internal "FCtl_SPN(624)" VALUE 0x001E2724 /* @ECU_Address@FCtl_SPN@0x21B609C0@ */ ECIPP_ALIGNMENT_ULONG 4294967295 Compu_IDENTITY 0 4294967295 PHYS_UNIT "SPN" /end CHARACTERISTIC
/begin CHARACTERISTIC FCspn_UGF4_lowsupply "FCtl_SPN(625)" VALUE 0x001E2728 /* @ECU_Address@FCtl_SPN@0x21B609C4@ */ ECIPP_ALIGNMENT_ULONG 4294967295 Compu_IDENTITY 0 4294967295 PHYS_UNIT "SPN" /end CHARACTERISTIC
/begin CHARACTERISTIC FCspn_UGF4_R_hi "FCtl_SPN(630)" VALUE 0x001E273C /* @ECU_Address@FCtl_SPN@0x21B609D8@ */ ECIPP_ALIGNMENT_ULONG 4294967295 Compu_IDENTITY 0 4294967295 PHYS_UNIT "SPN" /end CHARACTERISTIC
/begin CHARACTERISTIC FCspn_UGF4_SR_hi "FCtl_SPN(642)" VALUE 0x001E276C /* @ECU_Address@FCtl_SPN@0x21B60A08@ */ ECIPP_ALIGNMENT_ULONG 4294967295 Compu_IDENTITY 0 4294967295 PHYS_UNIT "SPN" /end CHARACTERISTIC
/begin CHARACTERISTIC FCspn_UGF4_SR_slow "FCtl_SPN(640)" VALUE 0x001E2764 /* @ECU_Address@FCtl_SPN@0x21B60A00@ */ ECIPP_ALIGNMENT_ULONG 4294967295 Compu_IDENTITY 0 4294967295 PHYS_UNIT "SPN" /end CHARACTERISTIC
/begin CHARACTERISTIC FCspn_UGF4_Sv_hi "FCtl_SPN(636)" VALUE 0x001E2754 /* @ECU_Address@FCtl_SPN@0x21B609F0@ */ ECIPP_ALIGNMENT_ULONG 4294967295 Compu_IDENTITY 0 4294967295 PHYS_UNIT "SPN" /end CHARACTERISTIC
/begin CHARACTERISTIC FCspn_V_max "FCtl_SPN(9)" VALUE 0x001E1D88 /* @ECU_Address@FCtl_SPN@0x21B60024@ */ ECIPP_ALIGNMENT_ULONG 4294967295 Compu_IDENTITY 0 4294967295 PHYS_UNIT "SPN" /end CHARACTERISTIC
/begin CHARACTERISTIC FCspn_V_min "FCtl_SPN(10)" VALUE 0x001E1D8C /* @ECU_Address@FCtl_SPN@0x21B60028@ */ ECIPP_ALIGNMENT_ULONG 4294967295 Compu_IDENTITY 0 4294967295 PHYS_UNIT "SPN" /end CHARACTERISTIC
/begin CHARACTERISTIC FCspn_VE5_max "FCtl_SPN(11)" VALUE 0x001E1D90 /* @ECU_Address@FCtl_SPN@0x21B6002C@ */ ECIPP_ALIGNMENT_ULONG 4294967295 Compu_IDENTITY 0 4294967295 PHYS_UNIT "SPN" /end CHARACTERISTIC
/begin CHARACTERISTIC FCspn_VE5_min "FCtl_SPN(12)" VALUE 0x001E1D94 /* @ECU_Address@FCtl_SPN@0x21B60030@ */ ECIPP_ALIGNMENT_ULONG 4294967295 Compu_IDENTITY 0 4294967295 PHYS_UNIT "SPN" /end CHARACTERISTIC
/begin CHARACTERISTIC FCspn_VE5ab_OOR "FCtl_SPN(183)" VALUE 0x001E2040 /* @ECU_Address@FCtl_SPN@0x21B602DC@ */ ECIPP_ALIGNMENT_ULONG 4294967295 Compu_IDENTITY 0 4294967295 PHYS_UNIT "SPN" /end CHARACTERISTIC
/begin CHARACTERISTIC FCspn_VE5b_max "FCtl_SPN(181)" VALUE 0x001E2038 /* @ECU_Address@FCtl_SPN@0x21B602D4@ */ ECIPP_ALIGNMENT_ULONG 4294967295 Compu_IDENTITY 0 4294967295 PHYS_UNIT "SPN" /end CHARACTERISTIC
/begin CHARACTERISTIC FCspn_VE5b_min "FCtl_SPN(182)" VALUE 0x001E203C /* @ECU_Address@FCtl_SPN@0x21B602D8@ */ ECIPP_ALIGNMENT_ULONG 4294967295 Compu_IDENTITY 0 4294967295 PHYS_UNIT "SPN" /end CHARACTERISTIC
/begin CHARACTERISTIC FCspn_VE5c_max "FCtl_SPN(507)" VALUE 0x001E2550 /* @ECU_Address@FCtl_SPN@0x21B607EC@ */ ECIPP_ALIGNMENT_ULONG 4294967295 Compu_IDENTITY 0 4294967295 PHYS_UNIT "SPN" /end CHARACTERISTIC
/begin CHARACTERISTIC FCspn_VE5c_min "FCtl_SPN(508)" VALUE 0x001E2554 /* @ECU_Address@FCtl_SPN@0x21B607F0@ */ ECIPP_ALIGNMENT_ULONG 4294967295 Compu_IDENTITY 0 4294967295 PHYS_UNIT "SPN" /end CHARACTERISTIC
/begin CHARACTERISTIC FCspn_WGCV_comm_lost "FCtl_SPN(1037)" VALUE 0x001E2D98 /* @ECU_Address@FCtl_SPN@0x21B61034@ */ ECIPP_ALIGNMENT_ULONG 4294967295 Compu_IDENTITY 0 4294967295 PHYS_UNIT "SPN" /end CHARACTERISTIC
/begin CHARACTERISTIC FCspn_WGCV_func_lost "FCtl_SPN(1039)" VALUE 0x001E2DA0 /* @ECU_Address@FCtl_SPN@0x21B6103C@ */ ECIPP_ALIGNMENT_ULONG 4294967295 Compu_IDENTITY 0 4294967295 PHYS_UNIT "SPN" /end CHARACTERISTIC
/begin CHARACTERISTIC FCspn_WGCV_perf_limit "FCtl_SPN(1038)" VALUE 0x001E2D9C /* @ECU_Address@FCtl_SPN@0x21B61038@ */ ECIPP_ALIGNMENT_ULONG 4294967295 Compu_IDENTITY 0 4294967295 PHYS_UNIT "SPN" /end CHARACTERISTIC
/begin CHARACTERISTIC FCspn_WGP_maxv "FCtl_SPN(141)" VALUE 0x001E1F98 /* @ECU_Address@FCtl_SPN@0x21B60234@ */ ECIPP_ALIGNMENT_ULONG 4294967295 Compu_IDENTITY 0 4294967295 PHYS_UNIT "SPN" /end CHARACTERISTIC
/begin CHARACTERISTIC FCspn_WGP_minv "FCtl_SPN(142)" VALUE 0x001E1F9C /* @ECU_Address@FCtl_SPN@0x21B60238@ */ ECIPP_ALIGNMENT_ULONG 4294967295 Compu_IDENTITY 0 4294967295 PHYS_UNIT "SPN" /end CHARACTERISTIC
/begin CHARACTERISTIC FCspn_WGPerr_neg "FCtl_SPN(697)" VALUE 0x001E2848 /* @ECU_Address@FCtl_SPN@0x21B60AE4@ */ ECIPP_ALIGNMENT_ULONG 4294967295 Compu_IDENTITY 0 4294967295 PHYS_UNIT "SPN" /end CHARACTERISTIC
/begin CHARACTERISTIC FCspn_WGPerr_pos "FCtl_SPN(696)" VALUE 0x001E2844 /* @ECU_Address@FCtl_SPN@0x21B60AE0@ */ ECIPP_ALIGNMENT_ULONG 4294967295 Compu_IDENTITY 0 4294967295 PHYS_UNIT "SPN" /end CHARACTERISTIC
/begin CHARACTERISTIC FCspn_WTRIN_detect "FCtl_SPN(292)" VALUE 0x001E21F4 /* @ECU_Address@FCtl_SPN@0x21B60490@ */ ECIPP_ALIGNMENT_ULONG 4294967295 Compu_IDENTITY 0 4294967295 PHYS_UNIT "SPN" /end CHARACTERISTIC
/begin CHARACTERISTIC FCspn_XEGOi_OOR "FCtl_SPN(802)" VALUE 0x001E29EC /* @ECU_Address@FCtl_SPN@0x21B60C88@ */ ECIPP_ALIGNMENT_ULONG 4294967295 Compu_IDENTITY 0 4294967295 PHYS_UNIT "SPN" /end CHARACTERISTIC
/begin CHARACTERISTIC FPfl_UGF2_drifttol "FPrm_latch(385)" VALUE 0x001E061C /* @ECU_Address@FPrm_latch@0x021BB604@ */ ECIPP_ALIGNMENT_FLOAT32_IEEE 10000000000 Compu_IDENTITY -10000000000 10000000000 PHYS_UNIT "ms" /end CHARACTERISTIC
/begin CHARACTERISTIC FPfl_UGF2_Hv_hi "FPrm_latch(318)" VALUE 0x001E0510 /* @ECU_Address@FPrm_latch@0x021BB4F8@ */ ECIPP_ALIGNMENT_FLOAT32_IEEE 10000000000 Compu_IDENTITY -10000000000 10000000000 PHYS_UNIT "ms" /end CHARACTERISTIC
/begin CHARACTERISTIC FPfl_UGF2_internal "FPrm_latch(317)" VALUE 0x001E050C /* @ECU_Address@FPrm_latch@0x021BB4F4@ */ ECIPP_ALIGNMENT_FLOAT32_IEEE 10000000000 Compu_IDENTITY -10000000000 10000000000 PHYS_UNIT "ms" /end CHARACTERISTIC
/begin CHARACTERISTIC FPfl_UGF2_lowsupply "FPrm_latch(401)" VALUE 0x001E065C /* @ECU_Address@FPrm_latch@0x021BB644@ */ ECIPP_ALIGNMENT_FLOAT32_IEEE 10000000000 Compu_IDENTITY -10000000000 10000000000 PHYS_UNIT "ms" /end CHARACTERISTIC
/begin CHARACTERISTIC FPfl_UGF2_R_hi "FPrm_latch(319)" VALUE 0x001E0514 /* @ECU_Address@FPrm_latch@0x021BB4FC@ */ ECIPP_ALIGNMENT_FLOAT32_IEEE 10000000000 Compu_IDENTITY -10000000000 10000000000 PHYS_UNIT "ms" /end CHARACTERISTIC
/begin CHARACTERISTIC FPfl_UGF2_SR_hi "FPrm_latch(322)" VALUE 0x001E0520 /* @ECU_Address@FPrm_latch@0x021BB508@ */ ECIPP_ALIGNMENT_FLOAT32_IEEE 10000000000 Compu_IDENTITY -10000000000 10000000000 PHYS_UNIT "ms" /end CHARACTERISTIC
/begin CHARACTERISTIC FPfl_UGF2_SR_slow "FPrm_latch(321)" VALUE 0x001E051C /* @ECU_Address@FPrm_latch@0x021BB504@ */ ECIPP_ALIGNMENT_FLOAT32_IEEE 10000000000 Compu_IDENTITY -10000000000 10000000000 PHYS_UNIT "ms" /end CHARACTERISTIC
/begin CHARACTERISTIC FPfl_UGF2_Sv_hi "FPrm_latch(320)" VALUE 0x001E0518 /* @ECU_Address@FPrm_latch@0x021BB500@ */ ECIPP_ALIGNMENT_FLOAT32_IEEE 10000000000 Compu_IDENTITY -10000000000 10000000000 PHYS_UNIT "ms" /end CHARACTERISTIC
/begin CHARACTERISTIC FPfl_UGF3_comm_lost "FPrm_latch(512)" VALUE 0x001E0818 /* @ECU_Address@FPrm_latch@0x021BB800@ */ ECIPP_ALIGNMENT_FLOAT32_IEEE 10000000000 Compu_IDENTITY -10000000000 10000000000 PHYS_UNIT "ms" /end CHARACTERISTIC
/begin CHARACTERISTIC FPfl_UGF3_drifttl2 "FPrm_latch(458)" VALUE 0x001E0740 /* @ECU_Address@FPrm_latch@0x021BB728@ */ ECIPP_ALIGNMENT_FLOAT32_IEEE 10000000000 Compu_IDENTITY -10000000000 10000000000 PHYS_UNIT "ms" /end CHARACTERISTIC
/begin CHARACTERISTIC FPfl_UGF3_drifttol "FPrm_latch(457)" VALUE 0x001E073C /* @ECU_Address@FPrm_latch@0x021BB724@ */ ECIPP_ALIGNMENT_FLOAT32_IEEE 10000000000 Compu_IDENTITY -10000000000 10000000000 PHYS_UNIT "ms" /end CHARACTERISTIC
/begin CHARACTERISTIC FPfl_UGF3_Hv_hi "FPrm_latch(459)" VALUE 0x001E0744 /* @ECU_Address@FPrm_latch@0x021BB72C@ */ ECIPP_ALIGNMENT_FLOAT32_IEEE 10000000000 Compu_IDENTITY -10000000000 10000000000 PHYS_UNIT "ms" /end CHARACTERISTIC
/begin CHARACTERISTIC FPfl_UGF3_internal "FPrm_latch(455)" VALUE 0x001E0734 /* @ECU_Address@FPrm_latch@0x021BB71C@ */ ECIPP_ALIGNMENT_FLOAT32_IEEE 10000000000 Compu_IDENTITY -10000000000 10000000000 PHYS_UNIT "ms" /end CHARACTERISTIC
/begin CHARACTERISTIC FPfl_UGF3_lowsupply "FPrm_latch(456)" VALUE 0x001E0738 /* @ECU_Address@FPrm_latch@0x021BB720@ */ ECIPP_ALIGNMENT_FLOAT32_IEEE 10000000000 Compu_IDENTITY -10000000000 10000000000 PHYS_UNIT "ms" /end CHARACTERISTIC
/begin CHARACTERISTIC FPfl_UGF3_R_hi "FPrm_latch(460)" VALUE 0x001E0748 /* @ECU_Address@FPrm_latch@0x021BB730@ */ ECIPP_ALIGNMENT_FLOAT32_IEEE 10000000000 Compu_IDENTITY -10000000000 10000000000 PHYS_UNIT "ms" /end CHARACTERISTIC
/begin CHARACTERISTIC FPfl_UGF3_SR_hi "FPrm_latch(463)" VALUE 0x001E0754 /* @ECU_Address@FPrm_latch@0x021BB73C@ */ ECIPP_ALIGNMENT_FLOAT32_IEEE 10000000000 Compu_IDENTITY -10000000000 10000000000 PHYS_UNIT "ms" /end CHARACTERISTIC
/begin CHARACTERISTIC FPfl_UGF3_SR_slow "FPrm_latch(462)" VALUE 0x001E0750 /* @ECU_Address@FPrm_latch@0x021BB738@ */ ECIPP_ALIGNMENT_FLOAT32_IEEE 10000000000 Compu_IDENTITY -10000000000 10000000000 PHYS_UNIT "ms" /end CHARACTERISTIC
/begin CHARACTERISTIC FPfl_UGF3_Sv_hi "FPrm_latch(461)" VALUE 0x001E074C /* @ECU_Address@FPrm_latch@0x021BB734@ */ ECIPP_ALIGNMENT_FLOAT32_IEEE 10000000000 Compu_IDENTITY -10000000000 10000000000 PHYS_UNIT "ms" /end CHARACTERISTIC
/begin CHARACTERISTIC FPfl_UGF4_comm_lost "FPrm_latch(513)" VALUE 0x001E081C /* @ECU_Address@FPrm_latch@0x021BB804@ */ ECIPP_ALIGNMENT_FLOAT32_IEEE 10000000000 Compu_IDENTITY -10000000000 10000000000 PHYS_UNIT "ms" /end CHARACTERISTIC
/begin CHARACTERISTIC FPfl_UGF4_drifttl2 "FPrm_latch(469)" VALUE 0x001E076C /* @ECU_Address@FPrm_latch@0x021BB754@ */ ECIPP_ALIGNMENT_FLOAT32_IEEE 10000000000 Compu_IDENTITY -10000000000 10000000000 PHYS_UNIT "ms" /end CHARACTERISTIC
/begin CHARACTERISTIC FPfl_UGF4_drifttol "FPrm_latch(468)" VALUE 0x001E0768 /* @ECU_Address@FPrm_latch@0x021BB750@ */ ECIPP_ALIGNMENT_FLOAT32_IEEE 10000000000 Compu_IDENTITY -10000000000 10000000000 PHYS_UNIT "ms" /end CHARACTERISTIC
/begin CHARACTERISTIC FPfl_UGF4_Hv_hi "FPrm_latch(470)" VALUE 0x001E0770 /* @ECU_Address@FPrm_latch@0x021BB758@ */ ECIPP_ALIGNMENT_FLOAT32_IEEE 10000000000 Compu_IDENTITY -10000000000 10000000000 PHYS_UNIT "ms" /end CHARACTERISTIC
/begin CHARACTERISTIC FPfl_UGF4_internal "FPrm_latch(466)" VALUE 0x001E0760 /* @ECU_Address@FPrm_latch@0x021BB748@ */ ECIPP_ALIGNMENT_FLOAT32_IEEE 10000000000 Compu_IDENTITY -10000000000 10000000000 PHYS_UNIT "ms" /end CHARACTERISTIC
/begin CHARACTERISTIC FPfl_UGF4_lowsupply "FPrm_latch(467)" VALUE 0x001E0764 /* @ECU_Address@FPrm_latch@0x021BB74C@ */ ECIPP_ALIGNMENT_FLOAT32_IEEE 10000000000 Compu_IDENTITY -10000000000 10000000000 PHYS_UNIT "ms" /end CHARACTERISTIC
/begin CHARACTERISTIC FPfl_UGF4_R_hi "FPrm_latch(471)" VALUE 0x001E0774 /* @ECU_Address@FPrm_latch@0x021BB75C@ */ ECIPP_ALIGNMENT_FLOAT32_IEEE 10000000000 Compu_IDENTITY -10000000000 10000000000 PHYS_UNIT "ms" /end CHARACTERISTIC
/begin CHARACTERISTIC FPfl_UGF4_SR_hi "FPrm_latch(474)" VALUE 0x001E0780 /* @ECU_Address@FPrm_latch@0x021BB768@ */ ECIPP_ALIGNMENT_FLOAT32_IEEE 10000000000 Compu_IDENTITY -10000000000 10000000000 PHYS_UNIT "ms" /end CHARACTERISTIC
/begin CHARACTERISTIC FPfl_UGF4_SR_slow "FPrm_latch(473)" VALUE 0x001E077C /* @ECU_Address@FPrm_latch@0x021BB764@ */ ECIPP_ALIGNMENT_FLOAT32_IEEE 10000000000 Compu_IDENTITY -10000000000 10000000000 PHYS_UNIT "ms" /end CHARACTERISTIC
/begin CHARACTERISTIC FPfl_UGF4_Sv_hi "FPrm_latch(472)" VALUE 0x001E0778 /* @ECU_Address@FPrm_latch@0x021BB760@ */ ECIPP_ALIGNMENT_FLOAT32_IEEE 10000000000 Compu_IDENTITY -10000000000 10000000000 PHYS_UNIT "ms" /end CHARACTERISTIC
/begin CHARACTERISTIC FPfl_V_max "FPrm_latch(14)" VALUE 0x001E0050 /* @ECU_Address@FPrm_latch@0x021BB038@ */ ECIPP_ALIGNMENT_FLOAT32_IEEE 10000000000 Compu_IDENTITY -10000000000 10000000000 PHYS_UNIT "ms" /end CHARACTERISTIC
/begin CHARACTERISTIC FPfl_V_min "FPrm_latch(15)" VALUE 0x001E0054 /* @ECU_Address@FPrm_latch@0x021BB03C@ */ ECIPP_ALIGNMENT_FLOAT32_IEEE 10000000000 Compu_IDENTITY -10000000000 10000000000 PHYS_UNIT "ms" /end CHARACTERISTIC
/begin CHARACTERISTIC FPfl_VE5_max "FPrm_latch(16)" VALUE 0x001E0058 /* @ECU_Address@FPrm_latch@0x021BB040@ */ ECIPP_ALIGNMENT_FLOAT32_IEEE 10000000000 Compu_IDENTITY -10000000000 10000000000 PHYS_UNIT "ms" /end CHARACTERISTIC
/begin CHARACTERISTIC FPfl_VE5_min "FPrm_latch(17)" VALUE 0x001E005C /* @ECU_Address@FPrm_latch@0x021BB044@ */ ECIPP_ALIGNMENT_FLOAT32_IEEE 10000000000 Compu_IDENTITY -10000000000 10000000000 PHYS_UNIT "ms" /end CHARACTERISTIC
/begin CHARACTERISTIC FPfl_VE5ab_OOR "FPrm_latch(143)" VALUE 0x001E0254 /* @ECU_Address@FPrm_latch@0x021BB23C@ */ ECIPP_ALIGNMENT_FLOAT32_IEEE 10000000000 Compu_IDENTITY -10000000000 10000000000 PHYS_UNIT "ms" /end CHARACTERISTIC
/begin CHARACTERISTIC FPfl_VE5b_max "FPrm_latch(141)" VALUE 0x001E024C /* @ECU_Address@FPrm_latch@0x021BB234@ */ ECIPP_ALIGNMENT_FLOAT32_IEEE 10000000000 Compu_IDENTITY -10000000000 10000000000 PHYS_UNIT "ms" /end CHARACTERISTIC
/begin CHARACTERISTIC FPfl_VE5b_min "FPrm_latch(142)" VALUE 0x001E0250 /* @ECU_Address@FPrm_latch@0x021BB238@ */ ECIPP_ALIGNMENT_FLOAT32_IEEE 10000000000 Compu_IDENTITY -10000000000 10000000000 PHYS_UNIT "ms" /end CHARACTERISTIC
/begin CHARACTERISTIC FPfl_VE5c_max "FPrm_latch(386)" VALUE 0x001E0620 /* @ECU_Address@FPrm_latch@0x021BB608@ */ ECIPP_ALIGNMENT_FLOAT32_IEEE 10000000000 Compu_IDENTITY -10000000000 10000000000 PHYS_UNIT "ms" /end CHARACTERISTIC
/begin CHARACTERISTIC FPfl_VE5c_min "FPrm_latch(387)" VALUE 0x001E0624 /* @ECU_Address@FPrm_latch@0x021BB60C@ */ ECIPP_ALIGNMENT_FLOAT32_IEEE 10000000000 Compu_IDENTITY -10000000000 10000000000 PHYS_UNIT "ms" /end CHARACTERISTIC
/begin CHARACTERISTIC FPfl_WGCV_comm_lost "FPrm_latch(713)" VALUE 0x001E0B3C /* @ECU_Address@FPrm_latch@0x021BBB24@ */ ECIPP_ALIGNMENT_FLOAT32_IEEE 10000000000 Compu_IDENTITY -10000000000 10000000000 PHYS_UNIT "ms" /end CHARACTERISTIC
/begin CHARACTERISTIC FPfl_WGCV_func_lost "FPrm_latch(715)" VALUE 0x001E0B44 /* @ECU_Address@FPrm_latch@0x021BBB2C@ */ ECIPP_ALIGNMENT_FLOAT32_IEEE 10000000000 Compu_IDENTITY -10000000000 10000000000 PHYS_UNIT "ms" /end CHARACTERISTIC
/begin CHARACTERISTIC FPfl_WGCV_perf_limit "FPrm_latch(714)" VALUE 0x001E0B40 /* @ECU_Address@FPrm_latch@0x021BBB28@ */ ECIPP_ALIGNMENT_FLOAT32_IEEE 10000000000 Compu_IDENTITY -10000000000 10000000000 PHYS_UNIT "ms" /end CHARACTERISTIC
/begin CHARACTERISTIC FPfl_WGP_maxv "FPrm_latch(101)" VALUE 0x001E01AC /* @ECU_Address@FPrm_latch@0x021BB194@ */ ECIPP_ALIGNMENT_FLOAT32_IEEE 10000000000 Compu_IDENTITY -10000000000 10000000000 PHYS_UNIT "ms" /end CHARACTERISTIC
/begin CHARACTERISTIC FPfl_WGP_minv "FPrm_latch(102)" VALUE 0x001E01B0 /* @ECU_Address@FPrm_latch@0x021BB198@ */ ECIPP_ALIGNMENT_FLOAT32_IEEE 10000000000 Compu_IDENTITY -10000000000 10000000000 PHYS_UNIT "ms" /end CHARACTERISTIC
/begin CHARACTERISTIC FPfl_WGPerr_neg "FPrm_latch(527)" VALUE 0x001E0854 /* @ECU_Address@FPrm_latch@0x021BB83C@ */ ECIPP_ALIGNMENT_FLOAT32_IEEE 10000000000 Compu_IDENTITY -10000000000 10000000000 PHYS_UNIT "ms" /end CHARACTERISTIC
/begin CHARACTERISTIC FPfl_WGPerr_pos "FPrm_latch(526)" VALUE 0x001E0850 /* @ECU_Address@FPrm_latch@0x021BB838@ */ ECIPP_ALIGNMENT_FLOAT32_IEEE 10000000000 Compu_IDENTITY -10000000000 10000000000 PHYS_UNIT "ms" /end CHARACTERISTIC
/begin CHARACTERISTIC FPfl_WTRIN_detect "FPrm_latch(214)" VALUE 0x001E0370 /* @ECU_Address@FPrm_latch@0x021BB358@ */ ECIPP_ALIGNMENT_FLOAT32_IEEE 10000000000 Compu_IDENTITY -10000000000 10000000000 PHYS_UNIT "ms" /end CHARACTERISTIC
/begin CHARACTERISTIC FPfl_XEGOi_OOR "FPrm_latch(631)" VALUE 0x001E09F4 /* @ECU_Address@FPrm_latch@0x021BB9DC@ */ ECIPP_ALIGNMENT_FLOAT32_IEEE 10000000000 Compu_IDENTITY -10000000000 10000000000 PHYS_UNIT "ms" /end CHARACTERISTIC
/begin CHARACTERISTIC FPfu_UGF2_drifttol "FPrm_unlatch(385)" VALUE 0x001E1164 /* @ECU_Address@FPrm_unlatch@0x021BD604@ */ ECIPP_ALIGNMENT_FLOAT32_IEEE 10000000000 Compu_IDENTITY -10000000000 10000000000 PHYS_UNIT "ms" /end CHARACTERISTIC
/begin CHARACTERISTIC FPfu_UGF2_Hv_hi "FPrm_unlatch(318)" VALUE 0x001E1058 /* @ECU_Address@FPrm_unlatch@0x021BD4F8@ */ ECIPP_ALIGNMENT_FLOAT32_IEEE 10000000000 Compu_IDENTITY -10000000000 10000000000 PHYS_UNIT "ms" /end CHARACTERISTIC
/begin CHARACTERISTIC FPfu_UGF2_internal "FPrm_unlatch(317)" VALUE 0x001E1054 /* @ECU_Address@FPrm_unlatch@0x021BD4F4@ */ ECIPP_ALIGNMENT_FLOAT32_IEEE 10000000000 Compu_IDENTITY -10000000000 10000000000 PHYS_UNIT "ms" /end CHARACTERISTIC
/begin CHARACTERISTIC FPfu_UGF2_lowsupply "FPrm_unlatch(401)" VALUE 0x001E11A4 /* @ECU_Address@FPrm_unlatch@0x021BD644@ */ ECIPP_ALIGNMENT_FLOAT32_IEEE 10000000000 Compu_IDENTITY -10000000000 10000000000 PHYS_UNIT "ms" /end CHARACTERISTIC
/begin CHARACTERISTIC FPfu_UGF2_R_hi "FPrm_unlatch(319)" VALUE 0x001E105C /* @ECU_Address@FPrm_unlatch@0x021BD4FC@ */ ECIPP_ALIGNMENT_FLOAT32_IEEE 10000000000 Compu_IDENTITY -10000000000 10000000000 PHYS_UNIT "ms" /end CHARACTERISTIC
/begin CHARACTERISTIC FPfu_UGF2_SR_hi "FPrm_unlatch(322)" VALUE 0x001E1068 /* @ECU_Address@FPrm_unlatch@0x021BD508@ */ ECIPP_ALIGNMENT_FLOAT32_IEEE 10000000000 Compu_IDENTITY -10000000000 10000000000 PHYS_UNIT "ms" /end CHARACTERISTIC
/begin CHARACTERISTIC FPfu_UGF2_SR_slow "FPrm_unlatch(321)" VALUE 0x001E1064 /* @ECU_Address@FPrm_unlatch@0x021BD504@ */ ECIPP_ALIGNMENT_FLOAT32_IEEE 10000000000 Compu_IDENTITY -10000000000 10000000000 PHYS_UNIT "ms" /end CHARACTERISTIC
/begin CHARACTERISTIC FPfu_UGF2_Sv_hi "FPrm_unlatch(320)" VALUE 0x001E1060 /* @ECU_Address@FPrm_unlatch@0x021BD500@ */ ECIPP_ALIGNMENT_FLOAT32_IEEE 10000000000 Compu_IDENTITY -10000000000 10000000000 PHYS_UNIT "ms" /end CHARACTERISTIC
/begin CHARACTERISTIC FPfu_UGF3_comm_lost "FPrm_unlatch(512)" VALUE 0x001E1360 /* @ECU_Address@FPrm_unlatch@0x021BD800@ */ ECIPP_ALIGNMENT_FLOAT32_IEEE 10000000000 Compu_IDENTITY -10000000000 10000000000 PHYS_UNIT "ms" /end CHARACTERISTIC
/begin CHARACTERISTIC FPfu_UGF3_drifttl2 "FPrm_unlatch(458)" VALUE 0x001E1288 /* @ECU_Address@FPrm_unlatch@0x021BD728@ */ ECIPP_ALIGNMENT_FLOAT32_IEEE 10000000000 Compu_IDENTITY -10000000000 10000000000 PHYS_UNIT "ms" /end CHARACTERISTIC
/begin CHARACTERISTIC FPfu_UGF3_drifttol "FPrm_unlatch(457)" VALUE 0x001E1284 /* @ECU_Address@FPrm_unlatch@0x021BD724@ */ ECIPP_ALIGNMENT_FLOAT32_IEEE 10000000000 Compu_IDENTITY -10000000000 10000000000 PHYS_UNIT "ms" /end CHARACTERISTIC
/begin CHARACTERISTIC FPfu_UGF3_Hv_hi "FPrm_unlatch(459)" VALUE 0x001E128C /* @ECU_Address@FPrm_unlatch@0x021BD72C@ */ ECIPP_ALIGNMENT_FLOAT32_IEEE 10000000000 Compu_IDENTITY -10000000000 10000000000 PHYS_UNIT "ms" /end CHARACTERISTIC
/begin CHARACTERISTIC FPfu_UGF3_internal "FPrm_unlatch(455)" VALUE 0x001E127C /* @ECU_Address@FPrm_unlatch@0x021BD71C@ */ ECIPP_ALIGNMENT_FLOAT32_IEEE 10000000000 Compu_IDENTITY -10000000000 10000000000 PHYS_UNIT "ms" /end CHARACTERISTIC
/begin CHARACTERISTIC FPfu_UGF3_lowsupply "FPrm_unlatch(456)" VALUE 0x001E1280 /* @ECU_Address@FPrm_unlatch@0x021BD720@ */ ECIPP_ALIGNMENT_FLOAT32_IEEE 10000000000 Compu_IDENTITY -10000000000 10000000000 PHYS_UNIT "ms" /end CHARACTERISTIC
/begin CHARACTERISTIC FPfu_UGF3_R_hi "FPrm_unlatch(460)" VALUE 0x001E1290 /* @ECU_Address@FPrm_unlatch@0x021BD730@ */ ECIPP_ALIGNMENT_FLOAT32_IEEE 10000000000 Compu_IDENTITY -10000000000 10000000000 PHYS_UNIT "ms" /end CHARACTERISTIC
/begin CHARACTERISTIC FPfu_UGF3_SR_hi "FPrm_unlatch(463)" VALUE 0x001E129C /* @ECU_Address@FPrm_unlatch@0x021BD73C@ */ ECIPP_ALIGNMENT_FLOAT32_IEEE 10000000000 Compu_IDENTITY -10000000000 10000000000 PHYS_UNIT "ms" /end CHARACTERISTIC
/begin CHARACTERISTIC FPfu_UGF3_SR_slow "FPrm_unlatch(462)" VALUE 0x001E1298 /* @ECU_Address@FPrm_unlatch@0x021BD738@ */ ECIPP_ALIGNMENT_FLOAT32_IEEE 10000000000 Compu_IDENTITY -10000000000 10000000000 PHYS_UNIT "ms" /end CHARACTERISTIC
/begin CHARACTERISTIC FPfu_UGF3_Sv_hi "FPrm_unlatch(461)" VALUE 0x001E1294 /* @ECU_Address@FPrm_unlatch@0x021BD734@ */ ECIPP_ALIGNMENT_FLOAT32_IEEE 10000000000 Compu_IDENTITY -10000000000 10000000000 PHYS_UNIT "ms" /end CHARACTERISTIC
/begin CHARACTERISTIC FPfu_UGF4_comm_lost "FPrm_unlatch(513)" VALUE 0x001E1364 /* @ECU_Address@FPrm_unlatch@0x021BD804@ */ ECIPP_ALIGNMENT_FLOAT32_IEEE 10000000000 Compu_IDENTITY -10000000000 10000000000 PHYS_UNIT "ms" /end CHARACTERISTIC
/begin CHARACTERISTIC FPfu_UGF4_drifttl2 "FPrm_unlatch(469)" VALUE 0x001E12B4 /* @ECU_Address@FPrm_unlatch@0x021BD754@ */ ECIPP_ALIGNMENT_FLOAT32_IEEE 10000000000 Compu_IDENTITY -10000000000 10000000000 PHYS_UNIT "ms" /end CHARACTERISTIC
/begin CHARACTERISTIC FPfu_UGF4_drifttol "FPrm_unlatch(468)" VALUE 0x001E12B0 /* @ECU_Address@FPrm_unlatch@0x021BD750@ */ ECIPP_ALIGNMENT_FLOAT32_IEEE 10000000000 Compu_IDENTITY -10000000000 10000000000 PHYS_UNIT "ms" /end CHARACTERISTIC
/begin CHARACTERISTIC FPfu_UGF4_Hv_hi "FPrm_unlatch(470)" VALUE 0x001E12B8 /* @ECU_Address@FPrm_unlatch@0x021BD758@ */ ECIPP_ALIGNMENT_FLOAT32_IEEE 10000000000 Compu_IDENTITY -10000000000 10000000000 PHYS_UNIT "ms" /end CHARACTERISTIC
/begin CHARACTERISTIC FPfu_UGF4_internal "FPrm_unlatch(466)" VALUE 0x001E12A8 /* @ECU_Address@FPrm_unlatch@0x021BD748@ */ ECIPP_ALIGNMENT_FLOAT32_IEEE 10000000000 Compu_IDENTITY -10000000000 10000000000 PHYS_UNIT "ms" /end CHARACTERISTIC
/begin CHARACTERISTIC FPfu_UGF4_lowsupply "FPrm_unlatch(467)" VALUE 0x001E12AC /* @ECU_Address@FPrm_unlatch@0x021BD74C@ */ ECIPP_ALIGNMENT_FLOAT32_IEEE 10000000000 Compu_IDENTITY -10000000000 10000000000 PHYS_UNIT "ms" /end CHARACTERISTIC
/begin CHARACTERISTIC FPfu_UGF4_R_hi "FPrm_unlatch(471)" VALUE 0x001E12BC /* @ECU_Address@FPrm_unlatch@0x021BD75C@ */ ECIPP_ALIGNMENT_FLOAT32_IEEE 10000000000 Compu_IDENTITY -10000000000 10000000000 PHYS_UNIT "ms" /end CHARACTERISTIC
/begin CHARACTERISTIC FPfu_UGF4_SR_hi "FPrm_unlatch(474)" VALUE 0x001E12C8 /* @ECU_Address@FPrm_unlatch@0x021BD768@ */ ECIPP_ALIGNMENT_FLOAT32_IEEE 10000000000 Compu_IDENTITY -10000000000 10000000000 PHYS_UNIT "ms" /end CHARACTERISTIC
/begin CHARACTERISTIC FPfu_UGF4_SR_slow "FPrm_unlatch(473)" VALUE 0x001E12C4 /* @ECU_Address@FPrm_unlatch@0x021BD764@ */ ECIPP_ALIGNMENT_FLOAT32_IEEE 10000000000 Compu_IDENTITY -10000000000 10000000000 PHYS_UNIT "ms" /end CHARACTERISTIC
/begin CHARACTERISTIC FPfu_UGF4_Sv_hi "FPrm_unlatch(472)" VALUE 0x001E12C0 /* @ECU_Address@FPrm_unlatch@0x021BD760@ */ ECIPP_ALIGNMENT_FLOAT32_IEEE 10000000000 Compu_IDENTITY -10000000000 10000000000 PHYS_UNIT "ms" /end CHARACTERISTIC
/begin CHARACTERISTIC FPfu_V_max "FPrm_unlatch(14)" VALUE 0x001E0B98 /* @ECU_Address@FPrm_unlatch@0x021BD038@ */ ECIPP_ALIGNMENT_FLOAT32_IEEE 10000000000 Compu_IDENTITY -10000000000 10000000000 PHYS_UNIT "ms" /end CHARACTERISTIC
/begin CHARACTERISTIC FPfu_V_min "FPrm_unlatch(15)" VALUE 0x001E0B9C /* @ECU_Address@FPrm_unlatch@0x021BD03C@ */ ECIPP_ALIGNMENT_FLOAT32_IEEE 10000000000 Compu_IDENTITY -10000000000 10000000000 PHYS_UNIT "ms" /end CHARACTERISTIC
/begin CHARACTERISTIC FPfu_VE5_max "FPrm_unlatch(16)" VALUE 0x001E0BA0 /* @ECU_Address@FPrm_unlatch@0x021BD040@ */ ECIPP_ALIGNMENT_FLOAT32_IEEE 10000000000 Compu_IDENTITY -10000000000 10000000000 PHYS_UNIT "ms" /end CHARACTERISTIC
/begin CHARACTERISTIC FPfu_VE5_min "FPrm_unlatch(17)" VALUE 0x001E0BA4 /* @ECU_Address@FPrm_unlatch@0x021BD044@ */ ECIPP_ALIGNMENT_FLOAT32_IEEE 10000000000 Compu_IDENTITY -10000000000 10000000000 PHYS_UNIT "ms" /end CHARACTERISTIC
/begin CHARACTERISTIC FPfu_VE5ab_OOR "FPrm_unlatch(143)" VALUE 0x001E0D9C /* @ECU_Address@FPrm_unlatch@0x021BD23C@ */ ECIPP_ALIGNMENT_FLOAT32_IEEE 10000000000 Compu_IDENTITY -10000000000 10000000000 PHYS_UNIT "ms" /end CHARACTERISTIC
/begin CHARACTERISTIC FPfu_VE5b_max "FPrm_unlatch(141)" VALUE 0x001E0D94 /* @ECU_Address@FPrm_unlatch@0x021BD234@ */ ECIPP_ALIGNMENT_FLOAT32_IEEE 10000000000 Compu_IDENTITY -10000000000 10000000000 PHYS_UNIT "ms" /end CHARACTERISTIC
/begin CHARACTERISTIC FPfu_VE5b_min "FPrm_unlatch(142)" VALUE 0x001E0D98 /* @ECU_Address@FPrm_unlatch@0x021BD238@ */ ECIPP_ALIGNMENT_FLOAT32_IEEE 10000000000 Compu_IDENTITY -10000000000 10000000000 PHYS_UNIT "ms" /end CHARACTERISTIC
/begin CHARACTERISTIC FPfu_VE5c_max "FPrm_unlatch(386)" VALUE 0x001E1168 /* @ECU_Address@FPrm_unlatch@0x021BD608@ */ ECIPP_ALIGNMENT_FLOAT32_IEEE 10000000000 Compu_IDENTITY -10000000000 10000000000 PHYS_UNIT "ms" /end CHARACTERISTIC
/begin CHARACTERISTIC FPfu_VE5c_min "FPrm_unlatch(387)" VALUE 0x001E116C /* @ECU_Address@FPrm_unlatch@0x021BD60C@ */ ECIPP_ALIGNMENT_FLOAT32_IEEE 10000000000 Compu_IDENTITY -10000000000 10000000000 PHYS_UNIT "ms" /end CHARACTERISTIC
/begin CHARACTERISTIC FPfu_WGCV_comm_lost "FPrm_unlatch(713)" VALUE 0x001E1684 /* @ECU_Address@FPrm_unlatch@0x021BDB24@ */ ECIPP_ALIGNMENT_FLOAT32_IEEE 10000000000 Compu_IDENTITY -10000000000 10000000000 PHYS_UNIT "ms" /end CHARACTERISTIC
/begin CHARACTERISTIC FPfu_WGCV_func_lost "FPrm_unlatch(715)" VALUE 0x001E168C /* @ECU_Address@FPrm_unlatch@0x021BDB2C@ */ ECIPP_ALIGNMENT_FLOAT32_IEEE 10000000000 Compu_IDENTITY -10000000000 10000000000 PHYS_UNIT "ms" /end CHARACTERISTIC
/begin CHARACTERISTIC FPfu_WGCV_perf_limit "FPrm_unlatch(714)" VALUE 0x001E1688 /* @ECU_Address@FPrm_unlatch@0x021BDB28@ */ ECIPP_ALIGNMENT_FLOAT32_IEEE 10000000000 Compu_IDENTITY -10000000000 10000000000 PHYS_UNIT "ms" /end CHARACTERISTIC
/begin CHARACTERISTIC FPfu_WGP_maxv "FPrm_unlatch(101)" VALUE 0x001E0CF4 /* @ECU_Address@FPrm_unlatch@0x021BD194@ */ ECIPP_ALIGNMENT_FLOAT32_IEEE 10000000000 Compu_IDENTITY -10000000000 10000000000 PHYS_UNIT "ms" /end CHARACTERISTIC
/begin CHARACTERISTIC FPfu_WGP_minv "FPrm_unlatch(102)" VALUE 0x001E0CF8 /* @ECU_Address@FPrm_unlatch@0x021BD198@ */ ECIPP_ALIGNMENT_FLOAT32_IEEE 10000000000 Compu_IDENTITY -10000000000 10000000000 PHYS_UNIT "ms" /end CHARACTERISTIC
/begin CHARACTERISTIC FPfu_WGPerr_neg "FPrm_unlatch(527)" VALUE 0x001E139C /* @ECU_Address@FPrm_unlatch@0x021BD83C@ */ ECIPP_ALIGNMENT_FLOAT32_IEEE 10000000000 Compu_IDENTITY -10000000000 10000000000 PHYS_UNIT "ms" /end CHARACTERISTIC
/begin CHARACTERISTIC FPfu_WGPerr_pos "FPrm_unlatch(526)" VALUE 0x001E1398 /* @ECU_Address@FPrm_unlatch@0x021BD838@ */ ECIPP_ALIGNMENT_FLOAT32_IEEE 10000000000 Compu_IDENTITY -10000000000 10000000000 PHYS_UNIT "ms" /end CHARACTERISTIC
/begin CHARACTERISTIC FPfu_WTRIN_detect "FPrm_unlatch(214)" VALUE 0x001E0EB8 /* @ECU_Address@FPrm_unlatch@0x021BD358@ */ ECIPP_ALIGNMENT_FLOAT32_IEEE 10000000000 Compu_IDENTITY -10000000000 10000000000 PHYS_UNIT "ms" /end CHARACTERISTIC
/begin CHARACTERISTIC FPfu_XEGOi_OOR "FPrm_unlatch(631)" VALUE 0x001E153C /* @ECU_Address@FPrm_unlatch@0x021BD9DC@ */ ECIPP_ALIGNMENT_FLOAT32_IEEE 10000000000 Compu_IDENTITY -10000000000 10000000000 PHYS_UNIT "ms" /end CHARACTERISTIC
/begin GROUP UGF2_drifttol_EC_Fault "UEGO2 drift is out-of-tolerance"
 /begin REF_CHARACTERISTIC FCdc4_UGF2_drifttol FCdtc_UGF2_drifttol FCfmi_UGF2_drifttol FCftb_UGF2_drifttol FCspn_UGF2_drifttol FPfl_UGF2_drifttol FPfu_UGF2_drifttol FPnd_UGF2_drifttol FPsvr_UGF2_drifttol FPsw_ext1_UGF2_drifttol FPsw_UGF2_drifttol /end REF_CHARACTERISTIC
/end GROUP
/begin GROUP UGF2_Hv_hi_EC_Fault "UEGO2 heater supply high voltage"
 /begin REF_CHARACTERISTIC FCdc4_UGF2_Hv_hi FCdtc_UGF2_Hv_hi FCfmi_UGF2_Hv_hi FCftb_UGF2_Hv_hi FCspn_UGF2_Hv_hi FPfl_UGF2_Hv_hi FPfu_UGF2_Hv_hi FPnd_UGF2_Hv_hi FPsvr_UGF2_Hv_hi FPsw_ext1_UGF2_Hv_hi FPsw_UGF2_Hv_hi /end REF_CHARACTERISTIC
/end GROUP
/begin GROUP UGF2_internal_EC_Fault "UEGO2 internal processor fault"
 /begin REF_CHARACTERISTIC FCdc4_UGF2_internal FCdtc_UGF2_internal FCfmi_UGF2_internal FCftb_UGF2_internal FCspn_UGF2_internal FPfl_UGF2_internal FPfu_UGF2_internal FPnd_UGF2_internal FPsvr_UGF2_internal FPsw_ext1_UGF2_internal FPsw_UGF2_internal /end REF_CHARACTERISTIC
/end GROUP
/begin GROUP UGF2_lowsupply_EC_Fault "UEGO2 internal supply voltage low"
 /begin REF_CHARACTERISTIC FCdc4_UGF2_lowsupply FCdtc_UGF2_lowsupply FCfmi_UGF2_lowsupply FCftb_UGF2_lowsupply FCspn_UGF2_lowsupply FPfl_UGF2_lowsupply FPfu_UGF2_lowsupply FPnd_UGF2_lowsupply FPsvr_UGF2_lowsupply FPsw_ext1_UGF2_lowsupply FPsw_UGF2_lowsupply /end REF_CHARACTERISTIC
/end GROUP
/begin GROUP UGF2_R_hi_EC_Fault "UEGO2 cal resistor voltage high"
 /begin REF_CHARACTERISTIC FCdc4_UGF2_R_hi FCdtc_UGF2_R_hi FCfmi_UGF2_R_hi FCftb_UGF2_R_hi FCspn_UGF2_R_hi FPfl_UGF2_R_hi FPfu_UGF2_R_hi FPnd_UGF2_R_hi FPsvr_UGF2_R_hi FPsw_ext1_UGF2_R_hi FPsw_UGF2_R_hi /end REF_CHARACTERISTIC
/end GROUP
/begin GROUP UGF2_SR_hi_EC_Fault "UEGO2 sense cell impedance high"
 /begin REF_CHARACTERISTIC FCdc4_UGF2_SR_hi FCdtc_UGF2_SR_hi FCfmi_UGF2_SR_hi FCftb_UGF2_SR_hi FCspn_UGF2_SR_hi FPfl_UGF2_SR_hi FPfu_UGF2_SR_hi FPnd_UGF2_SR_hi FPsvr_UGF2_SR_hi FPsw_ext1_UGF2_SR_hi FPsw_UGF2_SR_hi /end REF_CHARACTERISTIC
/end GROUP
/begin GROUP UGF2_SR_slow_EC_Fault "UEGO2 sense cell slow to warm up"
 /begin REF_CHARACTERISTIC FCdc4_UGF2_SR_slow FCdtc_UGF2_SR_slow FCfmi_UGF2_SR_slow FCftb_UGF2_SR_slow FCspn_UGF2_SR_slow FPfl_UGF2_SR_slow FPfu_UGF2_SR_slow FPnd_UGF2_SR_slow FPsvr_UGF2_SR_slow FPsw_ext1_UGF2_SR_slow FPsw_UGF2_SR_slow /end REF_CHARACTERISTIC
/end GROUP
/begin GROUP UGF2_Sv_hi_EC_Fault "UEGO2 sense cell voltage high"
 /begin REF_CHARACTERISTIC FCdc4_UGF2_Sv_hi FCdtc_UGF2_Sv_hi FCfmi_UGF2_Sv_hi FCftb_UGF2_Sv_hi FCspn_UGF2_Sv_hi FPfl_UGF2_Sv_hi FPfu_UGF2_Sv_hi FPnd_UGF2_Sv_hi FPsvr_UGF2_Sv_hi FPsw_ext1_UGF2_Sv_hi FPsw_UGF2_Sv_hi /end REF_CHARACTERISTIC
/end GROUP
/begin GROUP UGF3_comm_lost_EC_Fault "UEGO3 CAN sensor communication lost"
 /begin REF_CHARACTERISTIC FCdc4_UGF3_comm_lost FCdtc_UGF3_comm_lost FCfmi_UGF3_comm_lost FCftb_UGF3_comm_lost FCspn_UGF3_comm_lost FPfl_UGF3_comm_lost FPfu_UGF3_comm_lost FPnd_UGF3_comm_lost FPsvr_UGF3_comm_lost FPsw_ext1_UGF3_comm_lost FPsw_UGF3_comm_lost /end REF_CHARACTERISTIC
/end GROUP
/begin GROUP UGF3_drifttl2_EC_Fault "UEGO3 drift is out-of-tolerance - level 2"
 /begin REF_CHARACTERISTIC FCdc4_UGF3_drifttl2 FCdtc_UGF3_drifttl2 FCfmi_UGF3_drifttl2 FCftb_UGF3_drifttl2 FCspn_UGF3_drifttl2 FPfl_UGF3_drifttl2 FPfu_UGF3_drifttl2 FPnd_UGF3_drifttl2 FPsvr_UGF3_drifttl2 FPsw_ext1_UGF3_drifttl2 FPsw_UGF3_drifttl2 /end REF_CHARACTERISTIC
/end GROUP
/begin GROUP UGF3_drifttol_EC_Fault "UEGO3 drift is out-of-tolerance"
 /begin REF_CHARACTERISTIC FCdc4_UGF3_drifttol FCdtc_UGF3_drifttol FCfmi_UGF3_drifttol FCftb_UGF3_drifttol FCspn_UGF3_drifttol FPfl_UGF3_drifttol FPfu_UGF3_drifttol FPnd_UGF3_drifttol FPsvr_UGF3_drifttol FPsw_ext1_UGF3_drifttol FPsw_UGF3_drifttol /end REF_CHARACTERISTIC
/end GROUP
/begin GROUP UGF3_Hv_hi_EC_Fault "UEGO3 heater supply high voltage"
 /begin REF_CHARACTERISTIC FCdc4_UGF3_Hv_hi FCdtc_UGF3_Hv_hi FCfmi_UGF3_Hv_hi FCftb_UGF3_Hv_hi FCspn_UGF3_Hv_hi FPfl_UGF3_Hv_hi FPfu_UGF3_Hv_hi FPnd_UGF3_Hv_hi FPsvr_UGF3_Hv_hi FPsw_ext1_UGF3_Hv_hi FPsw_UGF3_Hv_hi /end REF_CHARACTERISTIC
/end GROUP
/begin GROUP UGF3_internal_EC_Fault "UEGO3 internal processor fault"
 /begin REF_CHARACTERISTIC FCdc4_UGF3_internal FCdtc_UGF3_internal FCfmi_UGF3_internal FCftb_UGF3_internal FCspn_UGF3_internal FPfl_UGF3_internal FPfu_UGF3_internal FPnd_UGF3_internal FPsvr_UGF3_internal FPsw_ext1_UGF3_internal FPsw_UGF3_internal /end REF_CHARACTERISTIC
/end GROUP
/begin GROUP UGF3_lowsupply_EC_Fault "UEGO3 internal supply voltage low"
 /begin REF_CHARACTERISTIC FCdc4_UGF3_lowsupply FCdtc_UGF3_lowsupply FCfmi_UGF3_lowsupply FCftb_UGF3_lowsupply FCspn_UGF3_lowsupply FPfl_UGF3_lowsupply FPfu_UGF3_lowsupply FPnd_UGF3_lowsupply FPsvr_UGF3_lowsupply FPsw_ext1_UGF3_lowsupply FPsw_UGF3_lowsupply /end REF_CHARACTERISTIC
/end GROUP
/begin GROUP UGF3_R_hi_EC_Fault "UEGO3 cal resistor voltage high"
 /begin REF_CHARACTERISTIC FCdc4_UGF3_R_hi FCdtc_UGF3_R_hi FCfmi_UGF3_R_hi FCftb_UGF3_R_hi FCspn_UGF3_R_hi FPfl_UGF3_R_hi FPfu_UGF3_R_hi FPnd_UGF3_R_hi FPsvr_UGF3_R_hi FPsw_ext1_UGF3_R_hi FPsw_UGF3_R_hi /end REF_CHARACTERISTIC
/end GROUP
/begin GROUP UGF3_SR_hi_EC_Fault "UEGO3 sense cell impedance high"
 /begin REF_CHARACTERISTIC FCdc4_UGF3_SR_hi FCdtc_UGF3_SR_hi FCfmi_UGF3_SR_hi FCftb_UGF3_SR_hi FCspn_UGF3_SR_hi FPfl_UGF3_SR_hi FPfu_UGF3_SR_hi FPnd_UGF3_SR_hi FPsvr_UGF3_SR_hi FPsw_ext1_UGF3_SR_hi FPsw_UGF3_SR_hi /end REF_CHARACTERISTIC
/end GROUP
/begin GROUP UGF3_SR_slow_EC_Fault "UEGO3 sense cell slow to warm up"
 /begin REF_CHARACTERISTIC FCdc4_UGF3_SR_slow FCdtc_UGF3_SR_slow FCfmi_UGF3_SR_slow FCftb_UGF3_SR_slow FCspn_UGF3_SR_slow FPfl_UGF3_SR_slow FPfu_UGF3_SR_slow FPnd_UGF3_SR_slow FPsvr_UGF3_SR_slow FPsw_ext1_UGF3_SR_slow FPsw_UGF3_SR_slow /end REF_CHARACTERISTIC
/end GROUP
/begin GROUP UGF3_Sv_hi_EC_Fault "UEGO3 sense cell voltage high"
 /begin REF_CHARACTERISTIC FCdc4_UGF3_Sv_hi FCdtc_UGF3_Sv_hi FCfmi_UGF3_Sv_hi FCftb_UGF3_Sv_hi FCspn_UGF3_Sv_hi FPfl_UGF3_Sv_hi FPfu_UGF3_Sv_hi FPnd_UGF3_Sv_hi FPsvr_UGF3_Sv_hi FPsw_ext1_UGF3_Sv_hi FPsw_UGF3_Sv_hi /end REF_CHARACTERISTIC
/end GROUP
/begin GROUP UGF4_comm_lost_EC_Fault "UEGO4 CAN sensor communication lost"
 /begin REF_CHARACTERISTIC FCdc4_UGF4_comm_lost FCdtc_UGF4_comm_lost FCfmi_UGF4_comm_lost FCftb_UGF4_comm_lost FCspn_UGF4_comm_lost FPfl_UGF4_comm_lost FPfu_UGF4_comm_lost FPnd_UGF4_comm_lost FPsvr_UGF4_comm_lost FPsw_ext1_UGF4_comm_lost FPsw_UGF4_comm_lost /end REF_CHARACTERISTIC
/end GROUP
/begin GROUP UGF4_drifttl2_EC_Fault "UEGO4 drift is out-of-tolerance - level 2"
 /begin REF_CHARACTERISTIC FCdc4_UGF4_drifttl2 FCdtc_UGF4_drifttl2 FCfmi_UGF4_drifttl2 FCftb_UGF4_drifttl2 FCspn_UGF4_drifttl2 FPfl_UGF4_drifttl2 FPfu_UGF4_drifttl2 FPnd_UGF4_drifttl2 FPsvr_UGF4_drifttl2 FPsw_ext1_UGF4_drifttl2 FPsw_UGF4_drifttl2 /end REF_CHARACTERISTIC
/end GROUP
/begin GROUP UGF4_drifttol_EC_Fault "UEGO4 drift is out-of-tolerance"
 /begin REF_CHARACTERISTIC FCdc4_UGF4_drifttol FCdtc_UGF4_drifttol FCfmi_UGF4_drifttol FCftb_UGF4_drifttol FCspn_UGF4_drifttol FPfl_UGF4_drifttol FPfu_UGF4_drifttol FPnd_UGF4_drifttol FPsvr_UGF4_drifttol FPsw_ext1_UGF4_drifttol FPsw_UGF4_drifttol /end REF_CHARACTERISTIC
/end GROUP
/begin GROUP UGF4_Hv_hi_EC_Fault "UEGO4 heater supply high voltage"
 /begin REF_CHARACTERISTIC FCdc4_UGF4_Hv_hi FCdtc_UGF4_Hv_hi FCfmi_UGF4_Hv_hi FCftb_UGF4_Hv_hi FCspn_UGF4_Hv_hi FPfl_UGF4_Hv_hi FPfu_UGF4_Hv_hi FPnd_UGF4_Hv_hi FPsvr_UGF4_Hv_hi FPsw_ext1_UGF4_Hv_hi FPsw_UGF4_Hv_hi /end REF_CHARACTERISTIC
/end GROUP
/begin GROUP UGF4_internal_EC_Fault "UEGO4 internal processor fault"
 /begin REF_CHARACTERISTIC FCdc4_UGF4_internal FCdtc_UGF4_internal FCfmi_UGF4_internal FCftb_UGF4_internal FCspn_UGF4_internal FPfl_UGF4_internal FPfu_UGF4_internal FPnd_UGF4_internal FPsvr_UGF4_internal FPsw_ext1_UGF4_internal FPsw_UGF4_internal /end REF_CHARACTERISTIC
/end GROUP
/begin GROUP UGF4_lowsupply_EC_Fault "UEGO4 internal supply voltage low"
 /begin REF_CHARACTERISTIC FCdc4_UGF4_lowsupply FCdtc_UGF4_lowsupply FCfmi_UGF4_lowsupply FCftb_UGF4_lowsupply FCspn_UGF4_lowsupply FPfl_UGF4_lowsupply FPfu_UGF4_lowsupply FPnd_UGF4_lowsupply FPsvr_UGF4_lowsupply FPsw_ext1_UGF4_lowsupply FPsw_UGF4_lowsupply /end REF_CHARACTERISTIC
/end GROUP
/begin GROUP UGF4_R_hi_EC_Fault "UEGO4 cal resistor voltage high"
 /begin REF_CHARACTERISTIC FCdc4_UGF4_R_hi FCdtc_UGF4_R_hi FCfmi_UGF4_R_hi FCftb_UGF4_R_hi FCspn_UGF4_R_hi FPfl_UGF4_R_hi FPfu_UGF4_R_hi FPnd_UGF4_R_hi FPsvr_UGF4_R_hi FPsw_ext1_UGF4_R_hi FPsw_UGF4_R_hi /end REF_CHARACTERISTIC
/end GROUP
/begin GROUP UGF4_SR_hi_EC_Fault "UEGO4 sense cell impedance high"
 /begin REF_CHARACTERISTIC FCdc4_UGF4_SR_hi FCdtc_UGF4_SR_hi FCfmi_UGF4_SR_hi FCftb_UGF4_SR_hi FCspn_UGF4_SR_hi FPfl_UGF4_SR_hi FPfu_UGF4_SR_hi FPnd_UGF4_SR_hi FPsvr_UGF4_SR_hi FPsw_ext1_UGF4_SR_hi FPsw_UGF4_SR_hi /end REF_CHARACTERISTIC
/end GROUP
/begin GROUP UGF4_SR_slow_EC_Fault "UEGO4 sense cell slow to warm up"
 /begin REF_CHARACTERISTIC FCdc4_UGF4_SR_slow FCdtc_UGF4_SR_slow FCfmi_UGF4_SR_slow FCftb_UGF4_SR_slow FCspn_UGF4_SR_slow FPfl_UGF4_SR_slow FPfu_UGF4_SR_slow FPnd_UGF4_SR_slow FPsvr_UGF4_SR_slow FPsw_ext1_UGF4_SR_slow FPsw_UGF4_SR_slow /end REF_CHARACTERISTIC
/end GROUP
/begin GROUP UGF4_Sv_hi_EC_Fault "UEGO4 sense cell voltage high"
 /begin REF_CHARACTERISTIC FCdc4_UGF4_Sv_hi FCdtc_UGF4_Sv_hi FCfmi_UGF4_Sv_hi FCftb_UGF4_Sv_hi FCspn_UGF4_Sv_hi FPfl_UGF4_Sv_hi FPfu_UGF4_Sv_hi FPnd_UGF4_Sv_hi FPsvr_UGF4_Sv_hi FPsw_ext1_UGF4_Sv_hi FPsw_UGF4_Sv_hi /end REF_CHARACTERISTIC
/end GROUP
/begin GROUP V_max_EC_Fault "Voltage high"
 /begin REF_CHARACTERISTIC FCdc4_V_max FCdtc_V_max FCfmi_V_max FCftb_V_max FCspn_V_max FPfl_V_max FPfu_V_max FPnd_V_max FPsvr_V_max FPsw_ext1_V_max FPsw_V_max /end REF_CHARACTERISTIC
/end GROUP
/begin GROUP V_min_EC_Fault "Voltage low"
 /begin REF_CHARACTERISTIC FCdc4_V_min FCdtc_V_min FCfmi_V_min FCftb_V_min FCspn_V_min FPfl_V_min FPfu_V_min FPnd_V_min FPsvr_V_min FPsw_ext1_V_min FPsw_V_min /end REF_CHARACTERISTIC
/end GROUP
/begin GROUP VE5_max_EC_Fault "5VE1 high voltage"
 /begin REF_CHARACTERISTIC FCdc4_VE5_max FCdtc_VE5_max FCfmi_VE5_max FCftb_VE5_max FCspn_VE5_max FPfl_VE5_max FPfu_VE5_max FPnd_VE5_max FPsvr_VE5_max FPsw_ext1_VE5_max FPsw_VE5_max /end REF_CHARACTERISTIC
/end GROUP
/begin GROUP VE5_min_EC_Fault "5VE1 low voltage"
 /begin REF_CHARACTERISTIC FCdc4_VE5_min FCdtc_VE5_min FCfmi_VE5_min FCftb_VE5_min FCspn_VE5_min FPfl_VE5_min FPfu_VE5_min FPnd_VE5_min FPsvr_VE5_min FPsw_ext1_VE5_min FPsw_VE5_min /end REF_CHARACTERISTIC
/end GROUP
/begin GROUP VE5ab_OOR_EC_Fault "5VE1/2 simultaneous out-of-range"
 /begin REF_CHARACTERISTIC FCdc4_VE5ab_OOR FCdtc_VE5ab_OOR FCfmi_VE5ab_OOR FCftb_VE5ab_OOR FCspn_VE5ab_OOR FPfl_VE5ab_OOR FPfu_VE5ab_OOR FPnd_VE5ab_OOR FPsvr_VE5ab_OOR FPsw_ext1_VE5ab_OOR FPsw_VE5ab_OOR /end REF_CHARACTERISTIC
/end GROUP
/begin GROUP VE5b_max_EC_Fault "5VE2 high voltage"
 /begin REF_CHARACTERISTIC FCdc4_VE5b_max FCdtc_VE5b_max FCfmi_VE5b_max FCftb_VE5b_max FCspn_VE5b_max FPfl_VE5b_max FPfu_VE5b_max FPnd_VE5b_max FPsvr_VE5b_max FPsw_ext1_VE5b_max FPsw_VE5b_max /end REF_CHARACTERISTIC
/end GROUP
/begin GROUP VE5b_min_EC_Fault "5VE2 low voltage"
 /begin REF_CHARACTERISTIC FCdc4_VE5b_min FCdtc_VE5b_min FCfmi_VE5b_min FCftb_VE5b_min FCspn_VE5b_min FPfl_VE5b_min FPfu_VE5b_min FPnd_VE5b_min FPsvr_VE5b_min FPsw_ext1_VE5b_min FPsw_VE5b_min /end REF_CHARACTERISTIC
/end GROUP
/begin GROUP VE5c_max_EC_Fault "5VE3 high voltage"
 /begin REF_CHARACTERISTIC FCdc4_VE5c_max FCdtc_VE5c_max FCfmi_VE5c_max FCftb_VE5c_max FCspn_VE5c_max FPfl_VE5c_max FPfu_VE5c_max FPnd_VE5c_max FPsvr_VE5c_max FPsw_ext1_VE5c_max FPsw_VE5c_max /end REF_CHARACTERISTIC
/end GROUP
/begin GROUP VE5c_min_EC_Fault "5VE3 low voltage"
 /begin REF_CHARACTERISTIC FCdc4_VE5c_min FCdtc_VE5c_min FCfmi_VE5c_min FCftb_VE5c_min FCspn_VE5c_min FPfl_VE5c_min FPfu_VE5c_min FPnd_VE5c_min FPsvr_VE5c_min FPsw_ext1_VE5c_min FPsw_VE5c_min /end REF_CHARACTERISTIC
/end GROUP
/begin GROUP WGCV_comm_lost_EC_Fault "WGCV communication lost"
 /begin REF_CHARACTERISTIC FCdc4_WGCV_comm_lost FCdtc_WGCV_comm_lost FCfmi_WGCV_comm_lost FCftb_WGCV_comm_lost FCspn_WGCV_comm_lost FPfl_WGCV_comm_lost FPfu_WGCV_comm_lost FPnd_WGCV_comm_lost FPsvr_WGCV_comm_lost FPsw_ext1_WGCV_comm_lost FPsw_WGCV_comm_lost /end REF_CHARACTERISTIC
/end GROUP
/begin GROUP WGCV_func_lost_EC_Fault "WGCV loss of function"
 /begin REF_CHARACTERISTIC FCdc4_WGCV_func_lost FCdtc_WGCV_func_lost FCfmi_WGCV_func_lost FCftb_WGCV_func_lost FCspn_WGCV_func_lost FPfl_WGCV_func_lost FPfu_WGCV_func_lost FPnd_WGCV_func_lost FPsvr_WGCV_func_lost FPsw_ext1_WGCV_func_lost FPsw_WGCV_func_lost /end REF_CHARACTERISTIC
/end GROUP
/begin GROUP WGCV_perf_limit_EC_Fault "WGCV performance limited"
 /begin REF_CHARACTERISTIC FCdc4_WGCV_perf_limit FCdtc_WGCV_perf_limit FCfmi_WGCV_perf_limit FCftb_WGCV_perf_limit FCspn_WGCV_perf_limit FPfl_WGCV_perf_limit FPfu_WGCV_perf_limit FPnd_WGCV_perf_limit FPsvr_WGCV_perf_limit FPsw_ext1_WGCV_perf_limit FPsw_WGCV_perf_limit /end REF_CHARACTERISTIC
/end GROUP
/begin GROUP WGP_maxv_EC_Fault "WGP high voltage or control pressure too high"
 /begin REF_CHARACTERISTIC FCdc4_WGP_maxv FCdtc_WGP_maxv FCfmi_WGP_maxv FCftb_WGP_maxv FCspn_WGP_maxv FPfl_WGP_maxv FPfu_WGP_maxv FPnd_WGP_maxv FPsvr_WGP_maxv FPsw_ext1_WGP_maxv FPsw_WGP_maxv /end REF_CHARACTERISTIC
/end GROUP
/begin GROUP WGP_minv_EC_Fault "WGP low voltage"
 /begin REF_CHARACTERISTIC FCdc4_WGP_minv FCdtc_WGP_minv FCfmi_WGP_minv FCftb_WGP_minv FCspn_WGP_minv FPfl_WGP_minv FPfu_WGP_minv FPnd_WGP_minv FPsvr_WGP_minv FPsw_ext1_WGP_minv FPsw_WGP_minv /end REF_CHARACTERISTIC
/end GROUP
/begin GROUP WGPerr_neg_EC_Fault "Unable to reach lower WGP"
 /begin REF_CHARACTERISTIC FCdc4_WGPerr_neg FCdtc_WGPerr_neg FCfmi_WGPerr_neg FCftb_WGPerr_neg FCspn_WGPerr_neg FPfl_WGPerr_neg FPfu_WGPerr_neg FPnd_WGPerr_neg FPsvr_WGPerr_neg FPsw_ext1_WGPerr_neg FPsw_WGPerr_neg /end REF_CHARACTERISTIC
/end GROUP
/begin GROUP WGPerr_pos_EC_Fault "Unable to reach higher WGP"
 /begin REF_CHARACTERISTIC FCdc4_WGPerr_pos FCdtc_WGPerr_pos FCfmi_WGPerr_pos FCftb_WGPerr_pos FCspn_WGPerr_pos FPfl_WGPerr_pos FPfu_WGPerr_pos FPnd_WGPerr_pos FPsvr_WGPerr_pos FPsw_ext1_WGPerr_pos FPsw_WGPerr_pos /end REF_CHARACTERISTIC
/end GROUP
/begin GROUP WTRIN_detect_EC_Fault "Water Intrusion Detection"
 /begin REF_CHARACTERISTIC FCdc4_WTRIN_detect FCdtc_WTRIN_detect FCfmi_WTRIN_detect FCftb_WTRIN_detect FCspn_WTRIN_detect FPfl_WTRIN_detect FPfu_WTRIN_detect FPnd_WTRIN_detect FPsvr_WTRIN_detect FPsw_ext1_WTRIN_detect FPsw_WTRIN_detect /end REF_CHARACTERISTIC
/end GROUP
/begin GROUP XEGOi_OOR_EC_Fault "Pre-catalyst O2 sensor out of range"
 /begin REF_CHARACTERISTIC FCdc4_XEGOi_OOR FCdtc_XEGOi_OOR FCfmi_XEGOi_OOR FCftb_XEGOi_OOR FCspn_XEGOi_OOR FPfl_XEGOi_OOR FPfu_XEGOi_OOR FPnd_XEGOi_OOR FPsvr_XEGOi_OOR FPsw_ext1_XEGOi_OOR FPsw_XEGOi_OOR /end REF_CHARACTERISTIC
/end GROUP
/begin GROUP EC__Faults "Diagnostic Faults" ROOT
 /begin SUB_GROUP accel_x_max_EC_Fault accel_x_min_EC_Fault accel_y_max_EC_Fault accel_y_min_EC_Fault accel_z_max_EC_Fault accel_z_min_EC_Fault ACLT_intTlim_OOA_EC_Fault ACT_hi_EC_Fault ADIG1_max_EC_Fault ADIG1_min_EC_Fault ADIG10_max_EC_Fault ADIG10_min_EC_Fault ADIG11_max_EC_Fault ADIG11_min_EC_Fault ADIG12_max_EC_Fault ADIG12_min_EC_Fault ADIG13_max_EC_Fault ADIG13_min_EC_Fault ADIG14_max_EC_Fault ADIG14_min_EC_Fault ADIG15_max_EC_Fault ADIG15_min_EC_Fault ADIG16_max_EC_Fault ADIG16_min_EC_Fault ADIG17_max_EC_Fault ADIG17_min_EC_Fault ADIG18_max_EC_Fault ADIG18_min_EC_Fault ADIG19_max_EC_Fault ADIG19_min_EC_Fault ADIG2_max_EC_Fault ADIG2_min_EC_Fault ADIG20_max_EC_Fault ADIG20_min_EC_Fault ADIG21_max_EC_Fault ADIG21_min_EC_Fault ADIG22_max_EC_Fault ADIG22_min_EC_Fault ADIG23_max_EC_Fault ADIG23_min_EC_Fault ADIG24_max_EC_Fault ADIG24_min_EC_Fault ADIG25_max_EC_Fault ADIG25_min_EC_Fault ADIG3_max_EC_Fault ADIG3_min_EC_Fault ADIG4_max_EC_Fault ADIG4_min_EC_Fault ADIG5_max_EC_Fault ADIG5_min_EC_Fault ADIG6_max_EC_Fault ADIG6_min_EC_Fault ADIG7_max_EC_Fault ADIG7_min_EC_Fault ADIG8_max_EC_Fault ADIG8_min_EC_Fault ADIG9_max_EC_Fault ADIG9_min_EC_Fault ADloss_EC_Fault AFILT_dP_high_EC_Fault AL_hi_EC_Fault AL_lo_EC_Fault ALLP_hi_EC_Fault ALLP_lo_EC_Fault ALNG_hi_EC_Fault ALNG_lo_EC_Fault APD1_max_EC_Fault APD1_min_EC_Fault APD2_max_EC_Fault APD2_min_EC_Fault APD3_max_EC_Fault APD3_min_EC_Fault APS1_max_EC_Fault APS1_min_EC_Fault APS12_OOR_EC_Fault APS12pct_hi_EC_Fault APS12pct_lo_EC_Fault APS2_max_EC_Fault APS2_min_EC_Fault APSerr_neg_EC_Fault APSerr_pos_EC_Fault APU1_max_EC_Fault APU1_min_EC_Fault APU2_max_EC_Fault APU2_min_EC_Fault APU3_max_EC_Fault APU3_min_EC_Fault APUD1_max_EC_Fault APUD1_min_EC_Fault APUD10_max_EC_Fault APUD10_min_EC_Fault APUD11_max_EC_Fault APUD11_min_EC_Fault APUD12_max_EC_Fault APUD12_min_EC_Fault APUD13_max_EC_Fault APUD13_min_EC_Fault APUD14_max_EC_Fault APUD14_min_EC_Fault APUD15_max_EC_Fault APUD15_min_EC_Fault APUD16_max_EC_Fault APUD16_min_EC_Fault APUD17_max_EC_Fault APUD17_min_EC_Fault APUD18_max_EC_Fault APUD18_min_EC_Fault APUD19_max_EC_Fault APUD19_min_EC_Fault APUD2_max_EC_Fault APUD2_min_EC_Fault APUD20_max_EC_Fault APUD20_min_EC_Fault APUD21_max_EC_Fault APUD21_min_EC_Fault APUD22_max_EC_Fault APUD22_min_EC_Fault APUD23_max_EC_Fault APUD23_min_EC_Fault APUD24_max_EC_Fault APUD24_min_EC_Fault APUD25_max_EC_Fault APUD25_min_EC_Fault APUD3_max_EC_Fault APUD3_min_EC_Fault APUD4_max_EC_Fault APUD4_min_EC_Fault APUD5_max_EC_Fault APUD5_min_EC_Fault APUD6_max_EC_Fault APUD6_min_EC_Fault APUD7_max_EC_Fault APUD7_min_EC_Fault APUD8_max_EC_Fault APUD8_min_EC_Fault APUD9_max_EC_Fault APUD9_min_EC_Fault AWP_intF_EC_Fault BP_max_EC_Fault BP_min_EC_Fault BPS1_max_EC_Fault BPS1_min_EC_Fault BPS12_OOR_EC_Fault BPS12pct_hi_EC_Fault BPS12pct_lo_EC_Fault BPS2_max_EC_Fault BPS2_min_EC_Fault BPSerr_neg_EC_Fault BPSerr_pos_EC_Fault brake_gndshort_EC_Fault brake_pwrshort_EC_Fault bst_MAT_derate_actv_EC_Fault BstTIP_Hi_EC_Fault BstTIP_Lo_EC_Fault BstTIP_Lo2_EC_Fault BstTIP_slow_EC_Fault buzz_coilopen_EC_Fault buzz_coilshort_EC_Fault buzz_gndshort_EC_Fault CAC_eta_lo_EC_Fault cal_config_EC_Fault cam2loss_EC_Fault camloss_EC_Fault camnoise_EC_Fault CATdP_hi_EC_Fault CATdP_lo_EC_Fault CATout_OOR_EC_Fault CD_MF1_EC_Fault CFV_FP_minv_EC_Fault CFV_FT_maxv_EC_Fault CFV_FT_minv_EC_Fault CFV_mdot_hi_EC_Fault CFV_mdot_lo_EC_Fault CFV_mdot_rms_hi_EC_Fault CFV_pwr_loss_EC_Fault CFV_RLV_fail_EC_Fault CFV_RLV_P_min_EC_Fault CHT_HiExp_EC_Fault CHT_HiExp2_EC_Fault CL_hi_EC_Fault CL_lo_EC_Fault CL_phi_hi_EC_Fault CL_phi_lo_EC_Fault CLLP_hi_EC_Fault CLLP_lo_EC_Fault CLNG_hi_EC_Fault CLNG_lo_EC_Fault CM_unresp_EC_Fault CMgsln_inact_EC_Fault CMLP_inact_EC_Fault CMNG_inact_EC_Fault COPfail_EC_Fault COT_hi_EC_Fault crkloss_EC_Fault crknever_EC_Fault crknoise_EC_Fault CVCS_discon_EC_Fault CVDS_discon_EC_Fault CVP1_hi_EC_Fault CVP1_lo_EC_Fault CVP2_hi_EC_Fault CVP2_lo_EC_Fault DBW_I_max_EC_Fault ECam_maxerr_EC_Fault ECL_low_EC_Fault ECP_hiP_EC_Fault ECP_loP_EC_Fault ECT_AAT_dT_max_EC_Fault ECT_derate_actv_EC_Fault ECT_dT_max_EC_Fault ECT_EGRT_dT_max_EC_Fault ECT_EGT_dT_max_EC_Fault ECT_FT_dT_max_EC_Fault ECT_HiExp_EC_Fault ECT_HiExp2_EC_Fault ECT_IAT_dT_max_EC_Fault ECT_LoExp_EC_Fault ECT_LoExp2_EC_Fault ECT_maxv_EC_Fault ECT_minv_EC_Fault ECT_OILT_dT_max_EC_Fault ECT_TAUX_dT1_max_EC_Fault ECT_TAUX_dT2_max_EC_Fault ECT_TIAT_dT_max_EC_Fault EGO1_open_EC_Fault EGO2_open_EC_Fault EGO3_open_EC_Fault EGOH1_off_open_EC_Fault EGOH1_on_short_EC_Fault EGOH2_off_open_EC_Fault EGOH2_on_short_EC_Fault EGOH3_off_open_EC_Fault EGOH3_on_short_EC_Fault EGOH4_off_open_EC_Fault EGOH4_on_short_EC_Fault EGR_clr_eta_lo_EC_Fault EGR_clr_eta_lo2_EC_Fault EGR_deice_excess_EC_Fault EGR_offmin_excess_EC_Fault EGR_OOA_hi_EC_Fault EGR_OOA_lo_EC_Fault EGR_slowdec_EC_Fault EGR_slowinc_EC_Fault EGR_UEGOdP_hi_EC_Fault EGR_UEGOdP_lo_EC_Fault EGR_vlv_DC_lim_EC_Fault EGR_vlv_HP_discon_EC_Fault EGR_vlv_stuck_EC_Fault EGR_vlv_temp_hi_EC_Fault EGR_vlvCAN_commlost_EC_Fault EGR_vlvCAN_lowfunc_EC_Fault EGR_vlvCAN_nofunc_EC_Fault EGRdP_HiExp_EC_Fault EGRdP_lo_LP_discon_EC_Fault EGRdP_lo_reversed_EC_Fault EGRdP_LoExp_EC_Fault EGRdP_maxv_EC_Fault EGRdP_minv_EC_Fault EGRflow_HiExp_EC_Fault EGRflow_LoExp_EC_Fault EGRflow_LoExp2_EC_Fault EGRHP_maxv_EC_Fault EGRHP_minv_EC_Fault EGRHP_OOR_EC_Fault EGRO_postlk_EC_Fault EGRT_hi_EC_Fault EGRT_maxv_EC_Fault EGRT_minv_EC_Fault EGT_dig_Hi_EC_Fault EGT_maxv_EC_Fault EGT_minv_EC_Fault EMWT1_HiExp1_EC_Fault EMWT1_HiExp2_EC_Fault EMWT1_maxv_EC_Fault EMWT1_minv_EC_Fault envtech_AAT_inv_EC_Fault envtech_BP_inv_EC_Fault envtech_comm_EC_Fault envtech_general_EC_Fault envtech_RH_inv_EC_Fault envtech_RH_uns_EC_Fault ERCV_speed_OOR_EC_Fault ERWT1_HiExp1_EC_Fault ERWT1_HiExp2_EC_Fault ERWT1_maxv_EC_Fault ERWT1_minv_EC_Fault F1OOR_F2IVS_EC_Fault F2OOR_F1IVS_EC_Fault FCoolH2O_lo_EC_Fault FIMP_pct_high_EC_Fault FIP_LoExp_EC_Fault flash_fail_EC_Fault FOP_start_EC_Fault FP_high_EC_Fault FP_low_EC_Fault FP_maxv_EC_Fault FP_minv_EC_Fault FP2_high_EC_Fault FP2_low_EC_Fault FP2_maxv_EC_Fault FP2_minv_EC_Fault FPD_off_hi_EC_Fault FPD_on_lo_EC_Fault FPlo_derate_actv_EC_Fault FPlo_derate_excess_EC_Fault FPP_NeutLock_fail_EC_Fault FPP1_IVS_max_EC_Fault FPP1_IVS_min_EC_Fault FPP1_max_EC_Fault FPP1_min_EC_Fault FPP12_IVS_max_EC_Fault FPP12_IVS_min_EC_Fault FPP12_OOR_EC_Fault FPP12IVS_TSC1_EC_Fault FPP12MM_IVSMM_EC_Fault FPP12pct_hi_EC_Fault FPP12pct_lo_EC_Fault FPP2_IVS_max_EC_Fault FPP2_IVS_min_EC_Fault FPP2_max_EC_Fault FPP2_min_EC_Fault FPP2V_TSC1_EC_Fault FPrly_coilopen_EC_Fault FPrly_coilshort_EC_Fault FPrly_gndshort_EC_Fault FSO_post_TPS_phi_hi_EC_Fault FSO_TPS_phi_hi_EC_Fault FT_maxv_EC_Fault FT_minv_EC_Fault FTgasf_maxv_EC_Fault FTgasf_minv_EC_Fault GLOW_unit_fail_EC_Fault GLOW1_open_EC_Fault GLOW1_short_EC_Fault gov_ntrlock_fail_EC_Fault gyro_x_max_EC_Fault gyro_x_min_EC_Fault gyro_y_max_EC_Fault gyro_y_min_EC_Fault gyro_z_max_EC_Fault gyro_z_min_EC_Fault HBA_I_max_EC_Fault HBB_I_max_EC_Fault HiDiagTemp_EC_Fault HWID_fail_EC_Fault IAC_gndshort_EC_Fault IAC_openshort_EC_Fault IAT_HiExp_EC_Fault IAT_HiExp2_EC_Fault IAT_maxv_EC_Fault IAT_minv_EC_Fault IBF_detected_EC_Fault ICam_maxerr_EC_Fault ICAVD1_mis_EC_Fault ICAVD1_miscat_EC_Fault ICCOT_hi_EC_Fault Idle_SD_EC_Fault imu_general_EC_Fault imu_temp_max_EC_Fault imu_temp_min_EC_Fault IMVD_Ifb_hi_EC_Fault IMVD_Ifb_lo_EC_Fault INJD_boost_lo_EC_Fault INJD_HS_Ihi_EC_Fault INJD_HW_int_EC_Fault INJD_LS_Ihi_EC_Fault INJD_off_lo_EC_Fault INJD_on_hi_EC_Fault intby_poserr_EC_Fault interrupt_EC_Fault IRV_CL_OOA_EC_Fault J1939_AAT_err_loss_EC_Fault J1939_addr2Fail_EC_Fault J1939_addr3Fail_EC_Fault J1939_addrFail_EC_Fault J1939_ETC_loss_EC_Fault J1939_ETC_loss2_EC_Fault J1939_PGN_tout_EC_Fault J1939_PGN_tout10_EC_Fault J1939_PGN_tout2_EC_Fault J1939_PGN_tout3_EC_Fault J1939_PGN_tout4_EC_Fault J1939_PGN_tout5_EC_Fault J1939_PGN_tout6_EC_Fault J1939_PGN_tout7_EC_Fault J1939_PGN_tout8_EC_Fault J1939_PGN_tout9_EC_Fault J1939_RS_err_loss_EC_Fault J1939_RSsetpt_loss_EC_Fault J1939_Rx2Fail_EC_Fault J1939_Rx3Fail_EC_Fault J1939_RxFail_EC_Fault J1939_SD_rq_EC_Fault J1939_TSC1_chksum_EC_Fault J1939_TSC1_cntr_EC_Fault J1939_TSC1_loss_EC_Fault J1939_Tx2Fail_EC_Fault J1939_Tx3Fail_EC_Fault J1939_TxFail_EC_Fault KNK_max_EC_Fault KNK_min_EC_Fault KNK_retardlmt_EC_Fault KNK_retardlmt2_EC_Fault KV1_deltaHi_EC_Fault KV1_deltaLo_EC_Fault KV1_high_EC_Fault KV1_low_EC_Fault LOD_flk_EC_Fault LOD_FROmax_EC_Fault LOD_slk_EC_Fault low_fuel_mon_EC_Fault LowCLTemp_EC_Fault LowDiagTemp_EC_Fault LowOperTemp_EC_Fault MAP_HiExp_EC_Fault MAP_max_EC_Fault MAP_minv_EC_Fault MFA_ctout_EC_Fault MFA_hi_flow_EC_Fault MFA_hsd_comm_EC_Fault MFA_intF_circ_EC_Fault MFA_intF_DP_V_max_EC_Fault MFA_intF_DP_V_min_EC_Fault MFA_intF_DSPress_V_max_EC_Fault MFA_intF_DSPress_V_min_EC_Fault MFA_intF_FTemp_V_max_EC_Fault MFA_intF_FTemp_V_min_EC_Fault MFA_intF_general_EC_Fault MFA_intF_Tposerr_n_EC_Fault MFA_intF_Tposerr_p_EC_Fault MFA_intF_USPress_V_max_EC_Fault MFA_intF_USPress_V_min_EC_Fault MFA_intF_Vbat_max_EC_Fault MFA_intF_Vbat_min_EC_Fault MFA_lo_flow_EC_Fault MFG_ctout_EC_Fault MFG_hi_flow_EC_Fault MFG_hsd_comm_EC_Fault MFG_intF_circ_EC_Fault MFG_intF_DP_V_max_EC_Fault MFG_intF_DP_V_min_EC_Fault MFG_intF_DPzVolt_V_max_EC_Fault MFG_intF_DPzVolt_V_min_EC_Fault MFG_intF_DSPress_V_max_EC_Fault MFG_intF_DSPress_V_min_EC_Fault MFG_intF_FTemp_V_max_EC_Fault MFG_intF_FTemp_V_min_EC_Fault MFG_intF_general_EC_Fault MFG_intF_Tposerr_n_EC_Fault MFG_intF_Tposerr_p_EC_Fault MFG_intF_USPress_V_max_EC_Fault MFG_intF_USPress_V_min_EC_Fault MFG_intF_Vbat_max_EC_Fault MFG_intF_Vbat_min_EC_Fault MFG_lo_flow_EC_Fault MFG_RLV_fail_EC_Fault MIL_coilopen_EC_Fault MIL_coilshort_EC_Fault MIL_gndshort_EC_Fault MJ_comm_tout_EC_Fault MJ_intF_act_EC_Fault MJ_intF_az_EC_Fault MJ_intF_circ_EC_Fault MJ_intF_comm_EC_Fault MJ_intF_Vhi_EC_Fault MJ_intF_Vlo_EC_Fault MJ_Pe_HiExp_EC_Fault MJ_Pe_LoExp_EC_Fault MJ2_comm_tout_EC_Fault MJ2_intF_act_EC_Fault MJ2_intF_circ_EC_Fault MJ2_intF_comm_EC_Fault MJ2_intF_Vhi_EC_Fault MJ2_intF_Vlo_EC_Fault MJ2_Pe_HiExp_EC_Fault MJ2_Pe_LoExp_EC_Fault NOx_hi_EC_Fault OilP_comm_lost_EC_Fault OilP_hiP_EC_Fault OilP_loP_EC_Fault OilP_maxV_EC_Fault OilP_minV_EC_Fault OILP_test_EC_Fault OilP_VlvStk_EC_Fault OilP2_loP_EC_Fault OILTL_loss_EC_Fault OILTL_Lvl_lo_EC_Fault OILTL_Lvl_OOR_EC_Fault OILTL_T_hi_EC_Fault OILTL_T_OOR_EC_Fault OILTL_V_OOR_EC_Fault PAUX_dP1_max_EC_Fault PAUX_dP1_min_EC_Fault PAUX_dP2_max_EC_Fault PAUX_dP2_min_EC_Fault PAUX1_max_EC_Fault PAUX1_min_EC_Fault PAUX2_max_EC_Fault PAUX2_min_EC_Fault PAUX3_max_EC_Fault PAUX3_min_EC_Fault PAUX4_max_EC_Fault PAUX4_min_EC_Fault post_cntrl_hi_lmt_EC_Fault post_cntrl_lo_lmt_EC_Fault PPEG_BP_EC_Fault PPEG_CVP1_EC_Fault PPEG_CVP2_EC_Fault PPEG_EBP_EC_Fault PPEG_EGRdP_EC_Fault PPEG_EGRHP_EC_Fault PPEG_EGRLP_EC_Fault PPEG_EGRwrP_EC_Fault PPEG_MAP_EC_Fault PPEG_TIP_EC_Fault Pri1_open_EC_Fault Pri1_short_EC_Fault PWM1_off_loVf_EC_Fault PWM1_on_hiVf_EC_Fault PWM10_off_loVf_EC_Fault PWM10_on_hiVf_EC_Fault PWM11_off_loVf_EC_Fault PWM11_on_hiVf_EC_Fault PWM12_off_loVf_EC_Fault PWM12_on_hiVf_EC_Fault PWM13_off_loVf_EC_Fault PWM13_on_hiVf_EC_Fault PWM14_off_loVf_EC_Fault PWM14_on_hiVf_EC_Fault PWM15_off_loVf_EC_Fault PWM15_on_hiVf_EC_Fault PWM16_off_loVf_EC_Fault PWM16_on_hiVf_EC_Fault PWM17_off_loVf_EC_Fault PWM17_on_hiVf_EC_Fault PWM18_off_loVf_EC_Fault PWM18_on_hiVf_EC_Fault PWM19_off_loVf_EC_Fault PWM19_on_hiVf_EC_Fault PWM2_off_loVf_EC_Fault PWM2_on_hiVf_EC_Fault PWM20_off_loVf_EC_Fault PWM20_on_hiVf_EC_Fault PWM21_off_loVf_EC_Fault PWM21_on_hiVf_EC_Fault PWM22_off_loVf_EC_Fault PWM22_on_hiVf_EC_Fault PWM23_off_loVf_EC_Fault PWM23_on_hiVf_EC_Fault PWM3_off_loVf_EC_Fault PWM3_on_hiVf_EC_Fault PWM4_off_loVf_EC_Fault PWM4_on_hiVf_EC_Fault PWM5_off_loVf_EC_Fault PWM5_on_hiVf_EC_Fault PWM6_off_loVf_EC_Fault PWM6_on_hiVf_EC_Fault PWM7_off_loVf_EC_Fault PWM7_on_hiVf_EC_Fault PWM8_off_loVf_EC_Fault PWM8_on_hiVf_EC_Fault PWM9_off_loVf_EC_Fault PWM9_on_hiVf_EC_Fault PWMLO_off_loVf_EC_Fault PWMLO_on_hiVf_EC_Fault radby_poserr_EC_Fault RAM_fail_EC_Fault relay_coilopen_EC_Fault relay_coilshort_EC_Fault relay_gndshort_EC_Fault relayoff_hiV_EC_Fault relayon_loV_EC_Fault rpm_hi_expected_EC_Fault rpmd_gov_lo_EC_Fault RS_discon_EC_Fault RS_hiV_EC_Fault RS_loss_EC_Fault RS_loV_EC_Fault RS485_bad_fmt_EC_Fault RS485_Rx_inact_EC_Fault RS485_Rx_noise_EC_Fault RS485_SD_rq_EC_Fault RTI1_EC_Fault RTI2_EC_Fault RTI3_EC_Fault Sec1_31KV_open_EC_Fault Sec1_low_EC_Fault Sec1_open_EC_Fault SHIFT_FB_OOR_EC_Fault SHIFT_intcirc_fail_EC_Fault SHIFT_shift_fail_EC_Fault SL_fuel_EC_Fault SL_gov_EC_Fault SL_spk_EC_Fault slv_MAP_hi_OOA_EC_Fault slv_MAP_lo_OOA_EC_Fault SPK_int_fail_EC_Fault SPK1_IGBT_T_EC_Fault SPKD_coil_fail_EC_Fault SPKD_dw_hi_EC_Fault SPKD_dw_lo_EC_Fault SRVC_expired_EC_Fault SRVC_expired2_EC_Fault start_coilopen_EC_Fault start_coilshort_EC_Fault start_excess_EC_Fault start_gndshort_EC_Fault start_stuck_active_EC_Fault SubDiagTemp_EC_Fault tach_gndshort_EC_Fault tach_pwrshort_EC_Fault TANK_1_V_maxv_EC_Fault TANK_1_V_minv_EC_Fault TANK_1_V_slow_EC_Fault TAUX_dT1_max_EC_Fault TAUX_dT1_min_EC_Fault TAUX_dT2_max_EC_Fault TAUX_dT2_min_EC_Fault Taux1_derate_actv_EC_Fault TAUX1_max_EC_Fault TAUX1_min_EC_Fault Taux2_derate_actv_EC_Fault TAUX2_max_EC_Fault TAUX2_min_EC_Fault TAUX3_max_EC_Fault TAUX3_min_EC_Fault TAUX4_max_EC_Fault TAUX4_min_EC_Fault TEL_derate_actv_EC_Fault TEL_dis_EC_Fault TEL_intF_EC_Fault TEL_key_invalid_EC_Fault TEL_key_to_EC_Fault TEL_req_to_EC_Fault TEL_RPM_cmd_EC_Fault TEL_RPM_psv_EC_Fault TEL_shutdown_cmd_EC_Fault TEL_shutdown_psv_EC_Fault TEL_torq_cmd_EC_Fault TEL_torq_psv_EC_Fault TIP_act_EC_Fault TIP_maxv_EC_Fault TIP_minv_EC_Fault TPS1_max_EC_Fault TPS1_min_EC_Fault TPS12_OOR_EC_Fault TPS12pct_hi_EC_Fault TPS12pct_lo_EC_Fault TPS2_max_EC_Fault TPS2_min_EC_Fault TPSerr_neg_EC_Fault TPSerr_pos_EC_Fault TRANS_comm_EC_Fault TRANS_fuel_inh_EC_Fault TWCDiag_OSC_lo_EC_Fault UEGOH1_off_open_EC_Fault UEGOH1_on_short_EC_Fault UEGOH2_off_open_EC_Fault UEGOH2_on_short_EC_Fault UEGOH3_off_open_EC_Fault UEGOH3_on_short_EC_Fault UEGOH4_off_open_EC_Fault UEGOH4_on_short_EC_Fault UGF_Hv_hi_EC_Fault UGF_internal_EC_Fault UGF_lowsupply_EC_Fault UGF1_comm_lost_EC_Fault UGF1_drifttl2_EC_Fault UGF1_drifttol_EC_Fault UGF1_R_hi_EC_Fault UGF1_SR_hi_EC_Fault UGF1_SR_slow_EC_Fault UGF1_Sv_hi_EC_Fault UGF2_comm_lost_EC_Fault UGF2_drifttl2_EC_Fault UGF2_drifttol_EC_Fault UGF2_Hv_hi_EC_Fault UGF2_internal_EC_Fault UGF2_lowsupply_EC_Fault UGF2_R_hi_EC_Fault UGF2_SR_hi_EC_Fault UGF2_SR_slow_EC_Fault UGF2_Sv_hi_EC_Fault UGF3_comm_lost_EC_Fault UGF3_drifttl2_EC_Fault UGF3_drifttol_EC_Fault UGF3_Hv_hi_EC_Fault UGF3_internal_EC_Fault UGF3_lowsupply_EC_Fault UGF3_R_hi_EC_Fault UGF3_SR_hi_EC_Fault UGF3_SR_slow_EC_Fault UGF3_Sv_hi_EC_Fault UGF4_comm_lost_EC_Fault UGF4_drifttl2_EC_Fault UGF4_drifttol_EC_Fault UGF4_Hv_hi_EC_Fault UGF4_internal_EC_Fault UGF4_lowsupply_EC_Fault UGF4_R_hi_EC_Fault UGF4_SR_hi_EC_Fault UGF4_SR_slow_EC_Fault UGF4_Sv_hi_EC_Fault V_max_EC_Fault V_min_EC_Fault VE5_max_EC_Fault VE5_min_EC_Fault VE5ab_OOR_EC_Fault VE5b_max_EC_Fault VE5b_min_EC_Fault VE5c_max_EC_Fault VE5c_min_EC_Fault WGCV_comm_lost_EC_Fault WGCV_func_lost_EC_Fault WGCV_perf_limit_EC_Fault WGP_maxv_EC_Fault WGP_minv_EC_Fault WGPerr_neg_EC_Fault WGPerr_pos_EC_Fault WTRIN_detect_EC_Fault XEGOi_OOR_EC_Fault /end SUB_GROUP
/end GROUP
/end MODULE
/end PROJECT
