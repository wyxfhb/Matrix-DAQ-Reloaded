ASAP2_VERSION 1 61
/begin PROJECT Econtrols_4G "4G Test"
/begin HEADER "4G A2L Configuration" PROJECT_NO EControls4G /* config for version control */ VERSION "$Revision: 82130 $:" /* config for version control */ /end HEADER
/begin MODULE EControls_4G_SH2A "EControls 4G"
/begin MOD_COMMON "" DEPOSIT ABSOLUTE BYTE_ORDER MSB_FIRST /end MOD_COMMON
/* Define the Record Layouts */
/begin RECORD_LAYOUT ECIPP_ALIGNMENT_UBYTE FNC_VALUES 1 UBYTE COLUMN_DIR DIRECT /end RECORD_LAYOUT
/begin RECORD_LAYOUT ECIPP_Lookup_UBYTE AXIS_PTS_X 1 UBYTE INDEX_INCR DIRECT /end RECORD_LAYOUT
/begin RECORD_LAYOUT ECIPP_ALIGNMENT_UWORD FNC_VALUES 1 UWORD COLUMN_DIR DIRECT /end RECORD_LAYOUT
/begin RECORD_LAYOUT ECIPP_ALIGNMENT_SWORD FNC_VALUES 1 SWORD COLUMN_DIR DIRECT /end RECORD_LAYOUT
/begin RECORD_LAYOUT ECIPP_ALIGNMENT_ULONG FNC_VALUES 1 ULONG COLUMN_DIR DIRECT /end RECORD_LAYOUT
/begin RECORD_LAYOUT ECIPP_ALIGNMENT_SLONG FNC_VALUES 1 SLONG COLUMN_DIR DIRECT /end RECORD_LAYOUT
/begin RECORD_LAYOUT ECIPP_ALIGNMENT_FLOAT32_IEEE FNC_VALUES 1 FLOAT32_IEEE COLUMN_DIR DIRECT /end RECORD_LAYOUT
/begin CHARACTERISTIC APU3_min "FaultConfig # APU3_min (Fault Condition:AUX analog PU3 <)" VALUE 0x001e375e /* @ECU_Address@APU3_min@0x01003D40@ */ ECIPP_ALIGNMENT_UWORD 5 Compu_APU3_min 0 5.00114468864469 /end CHARACTERISTIC
/begin COMPU_METHOD Compu_APU3_min " " RAT_FUNC "%.3" "volts" COEFFS 0 13104 0 0 0 1 /end COMPU_METHOD
/begin CHARACTERISTIC APUD1_max "FaultConfig # APUD1_max (Fault Condition:AUX analog PUD1 >)" VALUE 0x001e3788 /* @ECU_Address@APUD1_max@0x01003D48@ */ ECIPP_ALIGNMENT_UWORD 5 Compu_APUD1_max 0 5.00114468864469 /end CHARACTERISTIC
/begin COMPU_METHOD Compu_APUD1_max " " RAT_FUNC "%.3" "volts" COEFFS 0 13104 0 0 0 1 /end COMPU_METHOD
/begin CHARACTERISTIC APUD1_min "FaultConfig # APUD1_min (Fault Condition:AUX analog PUD1 <)" VALUE 0x001e378a /* @ECU_Address@APUD1_min@0x01003D50@ */ ECIPP_ALIGNMENT_UWORD 5 Compu_APUD1_min 0 5.00114468864469 /end CHARACTERISTIC
/begin COMPU_METHOD Compu_APUD1_min " " RAT_FUNC "%.3" "volts" COEFFS 0 13104 0 0 0 1 /end COMPU_METHOD
/begin CHARACTERISTIC APUD2_max "FaultConfig # APUD2_max (Fault Condition:AUX analog PUD2 >)" VALUE 0x001e37a4 /* @ECU_Address@APUD2_max@0x01003D58@ */ ECIPP_ALIGNMENT_UWORD 5 Compu_APUD2_max 0 5.00114468864469 /end CHARACTERISTIC
/begin COMPU_METHOD Compu_APUD2_max " " RAT_FUNC "%.3" "volts" COEFFS 0 13104 0 0 0 1 /end COMPU_METHOD
/begin CHARACTERISTIC APUD2_min "FaultConfig # APUD2_min (Fault Condition:AUX analog PUD2 <)" VALUE 0x001e37a6 /* @ECU_Address@APUD2_min@0x01003D60@ */ ECIPP_ALIGNMENT_UWORD 5 Compu_APUD2_min 0 5.00114468864469 /end CHARACTERISTIC
/begin COMPU_METHOD Compu_APUD2_min " " RAT_FUNC "%.3" "volts" COEFFS 0 13104 0 0 0 1 /end COMPU_METHOD
/begin CHARACTERISTIC APUD3_max "FaultConfig # APUD3_max (Fault Condition:AUX analog PUD3 >)" VALUE 0x001e37a8 /* @ECU_Address@APUD3_max@0x01003D68@ */ ECIPP_ALIGNMENT_UWORD 5 Compu_APUD3_max 0 5.00114468864469 /end CHARACTERISTIC
/begin COMPU_METHOD Compu_APUD3_max " " RAT_FUNC "%.3" "volts" COEFFS 0 13104 0 0 0 1 /end COMPU_METHOD
/begin CHARACTERISTIC APUD3_min "FaultConfig # APUD3_min (Fault Condition:AUX analog PUD3 <)" VALUE 0x001e37aa /* @ECU_Address@APUD3_min@0x01003D70@ */ ECIPP_ALIGNMENT_UWORD 5 Compu_APUD3_min 0 5.00114468864469 /end CHARACTERISTIC
/begin COMPU_METHOD Compu_APUD3_min " " RAT_FUNC "%.3" "volts" COEFFS 0 13104 0 0 0 1 /end COMPU_METHOD
/begin CHARACTERISTIC ADIG1_max "FaultConfig # ADIG1_max (Fault Condition:AUX DIG1 >)" VALUE 0x001e370c /* @ECU_Address@ADIG1_max@0x01003D78@ */ ECIPP_ALIGNMENT_UWORD 256 Compu_ADIG1_max 0 255.99609375 /end CHARACTERISTIC
/begin COMPU_METHOD Compu_ADIG1_max " " RAT_FUNC "%.3" "volts" COEFFS 0 256 0 0 0 1 /end COMPU_METHOD
/begin CHARACTERISTIC ADIG1_min "FaultConfig # ADIG1_min (Fault Condition:AUX DIG1 <)" VALUE 0x001e370e /* @ECU_Address@ADIG1_min@0x01003D80@ */ ECIPP_ALIGNMENT_UWORD 256 Compu_ADIG1_min 0 255.99609375 /end CHARACTERISTIC
/begin COMPU_METHOD Compu_ADIG1_min " " RAT_FUNC "%.3" "volts" COEFFS 0 256 0 0 0 1 /end COMPU_METHOD
/begin CHARACTERISTIC ADIG2_max "FaultConfig # ADIG2_max (Fault Condition:AUX DIG2 >)" VALUE 0x001e3728 /* @ECU_Address@ADIG2_max@0x01003D88@ */ ECIPP_ALIGNMENT_UWORD 256 Compu_ADIG2_max 0 255.99609375 /end CHARACTERISTIC
/begin COMPU_METHOD Compu_ADIG2_max " " RAT_FUNC "%.3" "volts" COEFFS 0 256 0 0 0 1 /end COMPU_METHOD
/begin CHARACTERISTIC ADIG2_min "FaultConfig # ADIG2_min (Fault Condition:AUX DIG2 <)" VALUE 0x001e372a /* @ECU_Address@ADIG2_min@0x01003D90@ */ ECIPP_ALIGNMENT_UWORD 256 Compu_ADIG2_min 0 255.99609375 /end CHARACTERISTIC
/begin COMPU_METHOD Compu_ADIG2_min " " RAT_FUNC "%.3" "volts" COEFFS 0 256 0 0 0 1 /end COMPU_METHOD
/begin CHARACTERISTIC ADIG3_min "FaultConfig # ADIG3_min (Fault Condition:AUX DIG3 <)" VALUE 0x001e372e /* @ECU_Address@ADIG3_min@0x01003DA0@ */ ECIPP_ALIGNMENT_UWORD 256 Compu_ADIG3_min 0 255.99609375 /end CHARACTERISTIC
/begin COMPU_METHOD Compu_ADIG3_min " " RAT_FUNC "%.3" "volts" COEFFS 0 256 0 0 0 1 /end COMPU_METHOD
/begin CHARACTERISTIC FTgasf_maxv "FaultConfig # FTgasf_maxv (Fault Condition:FT voltage >)" VALUE 0x001c7b9e /* @ECU_Address@FTgasf_maxv@0x01003E28@ */ ECIPP_ALIGNMENT_UWORD 5 Compu_FTgasf_maxv 0 5.00114468864469 /end CHARACTERISTIC
/begin COMPU_METHOD Compu_FTgasf_maxv " " RAT_FUNC "%.3" "volts" COEFFS 0 13104 0 0 0 1 /end COMPU_METHOD
/begin CHARACTERISTIC FTgasf_minv "FaultConfig # FTgasf_minv (Fault Condition:FT voltage <)" VALUE 0x001c7ba4 /* @ECU_Address@FTgasf_minv@0x01003E30@ */ ECIPP_ALIGNMENT_UWORD 5 Compu_FTgasf_minv 0 5.00114468864469 /end CHARACTERISTIC
/begin COMPU_METHOD Compu_FTgasf_minv " " RAT_FUNC "%.3" "volts" COEFFS 0 13104 0 0 0 1 /end COMPU_METHOD
/begin CHARACTERISTIC BstTIP_Lo_RPM "FaultConfig # BstTIP_Lo_RPM (Fault Condition:and RPM >)" VALUE 0x001c6d9c /* @ECU_Address@BstTIP_Lo_RPM@0x01003E38@ */ ECIPP_ALIGNMENT_UWORD 65535 Compu_BstTIP_Lo_RPM 0 65535 /end CHARACTERISTIC
/begin COMPU_METHOD Compu_BstTIP_Lo_RPM " " RAT_FUNC "%.0" "rpm" COEFFS 0 1 0 0 0 1 /end COMPU_METHOD
/begin CHARACTERISTIC ICam_coil_Rnom "Air # ICam_coil_Rnom" VALUE 0x001C9F3E /* @ECU_Address@ICam_coil_Rnom@0x01004260@ */ ECIPP_ALIGNMENT_UWORD 64 Compu_ICam_coil_Rnom 0 63.9990234375 /end CHARACTERISTIC
/begin COMPU_METHOD Compu_ICam_coil_Rnom " " RAT_FUNC "%.3" "ohms" COEFFS 0 1024 0 0 0 1 /end COMPU_METHOD
/begin CHARACTERISTIC ICam_coil_Rmin "Air # ICam_coil_Rmin" VALUE 0x001C9F3C /* @ECU_Address@ICam_coil_Rmin@0x01004268@ */ ECIPP_ALIGNMENT_UWORD 64 Compu_ICam_coil_Rmin 0 63.9990234375 /end CHARACTERISTIC
/begin COMPU_METHOD Compu_ICam_coil_Rmin " " RAT_FUNC "%.3" "ohms" COEFFS 0 1024 0 0 0 1 /end COMPU_METHOD
/begin CHARACTERISTIC ICam_coil_Rmax "Air # ICam_coil_Rmax" VALUE 0x001C9F3A /* @ECU_Address@ICam_coil_Rmax@0x01004270@ */ ECIPP_ALIGNMENT_UWORD 64 Compu_ICam_coil_Rmax 0 63.9990234375 /end CHARACTERISTIC
/begin COMPU_METHOD Compu_ICam_coil_Rmax " " RAT_FUNC "%.3" "ohms" COEFFS 0 1024 0 0 0 1 /end COMPU_METHOD
/begin CHARACTERISTIC ECam_coil_Rnom "Air # ECam_coil_Rnom" VALUE 0x001C9CCA /* @ECU_Address@ECam_coil_Rnom@0x01004278@ */ ECIPP_ALIGNMENT_UWORD 64 Compu_ECam_coil_Rnom 0 63.9990234375 /end CHARACTERISTIC
/begin COMPU_METHOD Compu_ECam_coil_Rnom " " RAT_FUNC "%.3" "ohms" COEFFS 0 1024 0 0 0 1 /end COMPU_METHOD
/begin CHARACTERISTIC ECam_coil_Rmin "Air # ECam_coil_Rmin" VALUE 0x001C9CC8 /* @ECU_Address@ECam_coil_Rmin@0x01004280@ */ ECIPP_ALIGNMENT_UWORD 64 Compu_ECam_coil_Rmin 0 63.9990234375 /end CHARACTERISTIC
/begin COMPU_METHOD Compu_ECam_coil_Rmin " " RAT_FUNC "%.3" "ohms" COEFFS 0 1024 0 0 0 1 /end COMPU_METHOD
/begin CHARACTERISTIC ECam_coil_Rmax "Air # ECam_coil_Rmax" VALUE 0x001C9CC6 /* @ECU_Address@ECam_coil_Rmax@0x01004288@ */ ECIPP_ALIGNMENT_UWORD 64 Compu_ECam_coil_Rmax 0 63.9990234375 /end CHARACTERISTIC
/begin COMPU_METHOD Compu_ECam_coil_Rmax " " RAT_FUNC "%.3" "ohms" COEFFS 0 1024 0 0 0 1 /end COMPU_METHOD
/begin CHARACTERISTIC ICam_coil_Imin "Air # ICam_coil_Imin" VALUE 0x001C9F42 /* @ECU_Address@ICam_coil_Imin@0x01004298@ */ ECIPP_ALIGNMENT_UWORD 64 Compu_ICam_coil_Imin 0 63.9990234375 /end CHARACTERISTIC
/begin COMPU_METHOD Compu_ICam_coil_Imin " " RAT_FUNC "%.3" "amps" COEFFS 0 1024 0 0 0 1 /end COMPU_METHOD
/begin CHARACTERISTIC ICam_coil_Imax "Air # ICam_coil_Imax" VALUE 0x001C9F40 /* @ECU_Address@ICam_coil_Imax@0x010042A0@ */ ECIPP_ALIGNMENT_UWORD 64 Compu_ICam_coil_Imax 0 63.9990234375 /end CHARACTERISTIC
/begin COMPU_METHOD Compu_ICam_coil_Imax " " RAT_FUNC "%.3" "amps" COEFFS 0 1024 0 0 0 1 /end COMPU_METHOD
/begin CHARACTERISTIC ECam_coil_Imin "Air # ECam_coil_Imin" VALUE 0x001C9CCE /* @ECU_Address@ECam_coil_Imin@0x010042B0@ */ ECIPP_ALIGNMENT_UWORD 64 Compu_ECam_coil_Imin 0 63.9990234375 /end CHARACTERISTIC
/begin COMPU_METHOD Compu_ECam_coil_Imin " " RAT_FUNC "%.3" "amps" COEFFS 0 1024 0 0 0 1 /end COMPU_METHOD
/begin CHARACTERISTIC ECam_coil_Imax "Air # ECam_coil_Imax" VALUE 0x001C9CCC /* @ECU_Address@ECam_coil_Imax@0x010042B8@ */ ECIPP_ALIGNMENT_UWORD 64 Compu_ECam_coil_Imax 0 63.9990234375 /end CHARACTERISTIC
/begin COMPU_METHOD Compu_ECam_coil_Imax " " RAT_FUNC "%.3" "amps" COEFFS 0 1024 0 0 0 1 /end COMPU_METHOD
/begin CHARACTERISTIC ICam_coil_Tnom "Air # ICam_coil_Tnom" VALUE 0x001C9F38 /* @ECU_Address@ICam_coil_Tnom@0x010042F0@ */ ECIPP_ALIGNMENT_UWORD 564 Compu_ICam_coil_Tnom -460 563.984375 /end CHARACTERISTIC
/begin COMPU_METHOD Compu_ICam_coil_Tnom " " RAT_FUNC "%.3" "deg F" COEFFS 0 64 29440 0 0 1 /end COMPU_METHOD
/begin CHARACTERISTIC ECam_coil_Tnom "Air # ECam_coil_Tnom" VALUE 0x001C9CC4 /* @ECU_Address@ECam_coil_Tnom@0x010042F8@ */ ECIPP_ALIGNMENT_UWORD 564 Compu_ECam_coil_Tnom -460 563.984375 /end CHARACTERISTIC
/begin COMPU_METHOD Compu_ECam_coil_Tnom " " RAT_FUNC "%.3" "deg F" COEFFS 0 64 29440 0 0 1 /end COMPU_METHOD
/begin CHARACTERISTIC ICam_coil_KTR "Air # ICam_coil_KTR" VALUE 0x001C9F36 /* @ECU_Address@ICam_coil_KTR@0x01004300@ */ ECIPP_ALIGNMENT_SWORD 0 Compu_ICam_coil_KTR -0.5 0.499984741210938 /end CHARACTERISTIC
/begin COMPU_METHOD Compu_ICam_coil_KTR " " RAT_FUNC "%.3" "ohms/deg F" COEFFS 0 65536 0 0 0 1 /end COMPU_METHOD
/begin CHARACTERISTIC ECam_coil_KTR "Air # ECam_coil_KTR" VALUE 0x001C9CC2 /* @ECU_Address@ECam_coil_KTR@0x01004308@ */ ECIPP_ALIGNMENT_SWORD 0 Compu_ECam_coil_KTR -0.5 0.499984741210938 /end CHARACTERISTIC
/begin COMPU_METHOD Compu_ECam_coil_KTR " " RAT_FUNC "%.3" "ohms/deg F" COEFFS 0 65536 0 0 0 1 /end COMPU_METHOD
/begin CHARACTERISTIC EGO1wait "CL # EGO1wait" VALUE 0x001c4294 /* @ECU_Address@EGO1wait@0x01004668@ */ ECIPP_ALIGNMENT_ULONG 4294967 Compu_EGO1wait 0 4294967.295 /end CHARACTERISTIC
/begin COMPU_METHOD Compu_EGO1wait " " RAT_FUNC "%.3" "seconds" COEFFS 0 1000 0 0 0 1 /end COMPU_METHOD
/begin CHARACTERISTIC EMWT_maxv "FaultConfig # EMWT_maxv (Fault Condition:EMWT voltage >)" VALUE 0x001C9CF6 /* @ECU_Address@EMWT_maxv@0x010048C0@ */ ECIPP_ALIGNMENT_UWORD 5 Compu_EMWT_maxv 0 5.00114468864469 /end CHARACTERISTIC
/begin COMPU_METHOD Compu_EMWT_maxv " " RAT_FUNC "%.3" "volts" COEFFS 0 13104 0 0 0 1 /end COMPU_METHOD
/begin CHARACTERISTIC EMWT_minv "FaultConfig # EMWT_minv (Fault Condition:EMWT voltage <)" VALUE 0x001C9CF8 /* @ECU_Address@EMWT_minv@0x010048C8@ */ ECIPP_ALIGNMENT_UWORD 5 Compu_EMWT_minv 0 5.00114468864469 /end CHARACTERISTIC
/begin COMPU_METHOD Compu_EMWT_minv " " RAT_FUNC "%.3" "volts" COEFFS 0 13104 0 0 0 1 /end COMPU_METHOD
/begin CHARACTERISTIC APD2_max "FaultConfig # APD2_max (Fault Condition:AUX analog PD2 >)" VALUE 0x001e374c /* @ECU_Address@APD2_max@0x01004E38@ */ ECIPP_ALIGNMENT_UWORD 5 Compu_APD2_max 0 5.00114468864469 /end CHARACTERISTIC
/begin COMPU_METHOD Compu_APD2_max " " RAT_FUNC "%.3" "volts" COEFFS 0 13104 0 0 0 1 /end COMPU_METHOD
/begin CHARACTERISTIC APD2_min "FaultConfig # APD2_min (Fault Condition:AUX analog PD2 <)" VALUE 0x001e374e /* @ECU_Address@APD2_min@0x01004E40@ */ ECIPP_ALIGNMENT_UWORD 5 Compu_APD2_min 0 5.00114468864469 /end CHARACTERISTIC
/begin COMPU_METHOD Compu_APD2_min " " RAT_FUNC "%.3" "volts" COEFFS 0 13104 0 0 0 1 /end COMPU_METHOD
/begin CHARACTERISTIC APD3_max "FaultConfig # APD3_max (Fault Condition:AUX analog PD3 >)" VALUE 0x001e3750 /* @ECU_Address@APD3_max@0x01004E48@ */ ECIPP_ALIGNMENT_UWORD 5 Compu_APD3_max 0 5.00114468864469 /end CHARACTERISTIC
/begin COMPU_METHOD Compu_APD3_max " " RAT_FUNC "%.3" "volts" COEFFS 0 13104 0 0 0 1 /end COMPU_METHOD
/begin CHARACTERISTIC APD3_min "FaultConfig # APD3_min (Fault Condition:AUX analog PD3 <)" VALUE 0x001e3752 /* @ECU_Address@APD3_min@0x01004E50@ */ ECIPP_ALIGNMENT_UWORD 5 Compu_APD3_min 0 5.00114468864469 /end CHARACTERISTIC
/begin COMPU_METHOD Compu_APD3_min " " RAT_FUNC "%.3" "volts" COEFFS 0 13104 0 0 0 1 /end COMPU_METHOD
/begin CHARACTERISTIC FTP_abs_gage "{FTP_abs_gage&0xff=0:(psia)}{FTP_abs_gage&0xff=1:(psig)}" VALUE 0x001c8740 /* @ECU_Address@FTP_abs_gage@0x01004E70@ */ ECIPP_ALIGNMENT_UBYTE 255 FTP_abs_gage_COMPU_VTAB 0 255 BIT_MASK 0xff /end CHARACTERISTIC
/begin COMPU_METHOD FTP_abs_gage_COMPU_VTAB "Verbal Table" TAB_VERB "%.0" "list" COMPU_TAB_REF FTP_abs_gage_COMPU_VTAB_REF /end COMPU_METHOD
/begin COMPU_VTAB FTP_abs_gage_COMPU_VTAB_REF "Verbal Table" TAB_VERB 2 0 "(psia)" 1 "(psig)" DEFAULT_VALUE "UNKNOWN" /end COMPU_VTAB
/begin CHARACTERISTIC FTP_def "IOConfig # FTP_def" VALUE 0x001c7b88 /* @ECU_Address@FTP_def@0x01004E80@ */ ECIPP_ALIGNMENT_UWORD 8192 Compu_FTP_def 0 8191.875 /end CHARACTERISTIC
/begin COMPU_METHOD Compu_FTP_def " " RAT_FUNC "%.3" "psia" COEFFS 0 8 0 0 0 1 /end COMPU_METHOD
/begin MEASUREMENT FPP_EOL_throt "IOConfig # FPP_EOL_throt" UBYTE Compu_FPP_EOL_throt 0 0 0 255 ECU_ADDRESS 0x01004EF8 /end MEASUREMENT
/begin COMPU_METHOD Compu_FPP_EOL_throt " " RAT_FUNC "%.0" "-" COEFFS 0 1 0 0 0 1 /end COMPU_METHOD
/begin CHARACTERISTIC ICam_ref_nom "IOConfig # ICam_ref_nom" VALUE 0x001C9F58 /* @ECU_Address@ICam_ref_nom@0x01004F10@ */ ECIPP_ALIGNMENT_SWORD 2048 Compu_ICam_ref_nom -2048 2047.9375 /end CHARACTERISTIC
/begin COMPU_METHOD Compu_ICam_ref_nom " " RAT_FUNC "%.3" "CAD BTDC" COEFFS 0 16 0 0 0 1 /end COMPU_METHOD
/begin CHARACTERISTIC ICam_ref_timing "IOConfig # ICam_ref_timing" VALUE 0x001C9F5A /* @ECU_Address@ICam_ref_timing@0x01004F18@ */ ECIPP_ALIGNMENT_SWORD 2048 Compu_ICam_ref_timing -2048 2047.9375 /end CHARACTERISTIC
/begin COMPU_METHOD Compu_ICam_ref_timing " " RAT_FUNC "%.3" "CAD BTDC" COEFFS 0 16 0 0 0 1 /end COMPU_METHOD
/begin CHARACTERISTIC ECam_ref_nom "IOConfig # ECam_ref_nom" VALUE 0x001C9CE4 /* @ECU_Address@ECam_ref_nom@0x01004F20@ */ ECIPP_ALIGNMENT_SWORD 2048 Compu_ECam_ref_nom -2048 2047.9375 /end CHARACTERISTIC
/begin COMPU_METHOD Compu_ECam_ref_nom " " RAT_FUNC "%.3" "CAD BTDC" COEFFS 0 16 0 0 0 1 /end COMPU_METHOD
/begin CHARACTERISTIC ECam_ref_timing "IOConfig # ECam_ref_timing" VALUE 0x001C9CE6 /* @ECU_Address@ECam_ref_timing@0x01004F28@ */ ECIPP_ALIGNMENT_SWORD 2048 Compu_ECam_ref_timing -2048 2047.9375 /end CHARACTERISTIC
/begin COMPU_METHOD Compu_ECam_ref_timing " " RAT_FUNC "%.3" "CAD BTDC" COEFFS 0 16 0 0 0 1 /end COMPU_METHOD
/begin CHARACTERISTIC ERWT_maxv "FaultConfig # ERWT_maxv (Fault Condition:ERWT voltage >)" VALUE 0x001C9D0E /* @ECU_Address@ERWT_maxv@0x01004FC0@ */ ECIPP_ALIGNMENT_UWORD 5 Compu_ERWT_maxv 0 5.00114468864469 /end CHARACTERISTIC
/begin COMPU_METHOD Compu_ERWT_maxv " " RAT_FUNC "%.3" "volts" COEFFS 0 13104 0 0 0 1 /end COMPU_METHOD
/begin CHARACTERISTIC ERWT_minv "FaultConfig # ERWT_minv (Fault Condition:ERWT voltage <)" VALUE 0x001C9D10 /* @ECU_Address@ERWT_minv@0x01004FC8@ */ ECIPP_ALIGNMENT_UWORD 5 Compu_ERWT_minv 0 5.00114468864469 /end CHARACTERISTIC
/begin COMPU_METHOD Compu_ERWT_minv " " RAT_FUNC "%.3" "volts" COEFFS 0 13104 0 0 0 1 /end COMPU_METHOD
/begin MEASUREMENT ICAV_cid_succ "Continuous ID success count" UWORD Compu_ICAV_cid_succ 0 0 0 65535 ECU_ADDRESS 0x010051C8 /end MEASUREMENT
/begin COMPU_METHOD Compu_ICAV_cid_succ " " RAT_FUNC "%.0" "misfires" COEFFS 0 1 0 0 0 1 /end COMPU_METHOD
/begin MEASUREMENT ICAV_cid_fail "Continuous ID fail count" UWORD Compu_ICAV_cid_fail 0 0 0 65535 ECU_ADDRESS 0x010051D0 /end MEASUREMENT
/begin COMPU_METHOD Compu_ICAV_cid_fail " " RAT_FUNC "%.0" "misfires" COEFFS 0 1 0 0 0 1 /end COMPU_METHOD
/begin CHARACTERISTIC ICAVD_mis "FaultConfig # ICAVD_mis (Fault Condition:Identify cylinders misfiring >=)" VALUE 0x001c7c14 /* @ECU_Address@ICAVD_mis@0x010051D8@ */ ECIPP_ALIGNMENT_UWORD 100 Compu_ICAVD_mis 0 99.9984741210938 /end CHARACTERISTIC
/begin COMPU_METHOD Compu_ICAVD_mis " " RAT_FUNC "%.3" "% max" COEFFS 0 655.36 0 0 0 1 /end COMPU_METHOD
/begin CHARACTERISTIC ICAVD_miscat "FaultConfig # ICAVD_miscat (Fault Condition:Identify cylinders misfiring >=)" VALUE 0x001c7c16 /* @ECU_Address@ICAVD_miscat@0x010051E0@ */ ECIPP_ALIGNMENT_UWORD 100 Compu_ICAVD_miscat 0 99.9984741210938 /end CHARACTERISTIC
/begin COMPU_METHOD Compu_ICAVD_miscat " " RAT_FUNC "%.3" "% max" COEFFS 0 655.36 0 0 0 1 /end COMPU_METHOD
/begin CHARACTERISTIC J1939_ETC_loss2 "FaultConfig # J1939_ETC_loss2 (Fault Condition:In-Gear Loss of ETC after engine running >=)" VALUE 0x001c7c86 /* @ECU_Address@J1939_ETC_loss2@0x01005350@ */ ECIPP_ALIGNMENT_UWORD 66 Compu_J1939_ETC_loss2 0 65.535 /end CHARACTERISTIC
/begin COMPU_METHOD Compu_J1939_ETC_loss2 " " RAT_FUNC "%.3" "sec" COEFFS 0 1000 0 0 0 1 /end COMPU_METHOD
/begin MEASUREMENT ICAV_nomis_keyc "Misfire free key cycles" UWORD Compu_ICAV_nomis_keyc 0 0 0 65535 ECU_ADDRESS 0x01005628 /end MEASUREMENT
/begin COMPU_METHOD Compu_ICAV_nomis_keyc " " RAT_FUNC "%.0" "-" COEFFS 0 1 0 0 0 1 /end COMPU_METHOD
/begin MEASUREMENT ICAV_maxcts_nrm "Max norm cts indicator" SWORD Compu_ICAV_maxcts_nrm 0 0 -4 3.9998779296875 ECU_ADDRESS 0x01005920 /end MEASUREMENT
/begin COMPU_METHOD Compu_ICAV_maxcts_nrm " " RAT_FUNC "%.2" "-" COEFFS 0 8192 0 0 0 1 /end COMPU_METHOD
/begin MEASUREMENT ICAV_maxcts_rpm "Max norm cts indicator speed" UWORD Compu_ICAV_maxcts_rpm 0 0 0 65535 ECU_ADDRESS 0x01005928 /end MEASUREMENT
/begin COMPU_METHOD Compu_ICAV_maxcts_rpm " " RAT_FUNC "%.0" "rpm" COEFFS 0 1 0 0 0 1 /end COMPU_METHOD
/begin MEASUREMENT ICAV_maxcts_maL "Max norm cts indicator load" UWORD Compu_ICAV_maxcts_maL 0 0 0 16383.75 ECU_ADDRESS 0x01005930 /end MEASUREMENT
/begin COMPU_METHOD Compu_ICAV_maxcts_maL " " RAT_FUNC "%.0" "mg/Ld" COEFFS 0 4 0 0 0 1 /end COMPU_METHOD
/begin CHARACTERISTIC PWM6_off_loVf "FaultConfig # PWM6_off_loVf (Fault Condition:PWM 6 low-side feedback <)" VALUE 0x001e57c0 /* @ECU_Address@PWM6_off_loVf@0x01005A38@ */ ECIPP_ALIGNMENT_UWORD 100 Compu_PWM6_off_loVf 0 99.9984741210938 /end CHARACTERISTIC
/begin COMPU_METHOD Compu_PWM6_off_loVf " " RAT_FUNC "%.3" "% Vbat" COEFFS 0 655.36 0 0 0 1 /end COMPU_METHOD
/begin CHARACTERISTIC PWM7_off_loVf "FaultConfig # PWM7_off_loVf (Fault Condition:PWM 7 low-side feedback <)" VALUE 0x001e57cc /* @ECU_Address@PWM7_off_loVf@0x01005A40@ */ ECIPP_ALIGNMENT_UWORD 100 Compu_PWM7_off_loVf 0 99.9984741210938 /end CHARACTERISTIC
/begin COMPU_METHOD Compu_PWM7_off_loVf " " RAT_FUNC "%.3" "% Vbat" COEFFS 0 655.36 0 0 0 1 /end COMPU_METHOD
/begin CHARACTERISTIC PWM6_on_hiVf "FaultConfig # PWM6_on_hiVf (Fault Condition:PWM 6 low-side feedback >)" VALUE 0x001e57c4 /* @ECU_Address@PWM6_on_hiVf@0x01005A48@ */ ECIPP_ALIGNMENT_UWORD 100 Compu_PWM6_on_hiVf 0 99.9984741210938 /end CHARACTERISTIC
/begin COMPU_METHOD Compu_PWM6_on_hiVf " " RAT_FUNC "%.3" "% Vbat" COEFFS 0 655.36 0 0 0 1 /end COMPU_METHOD
/begin CHARACTERISTIC PWM7_on_hiVf "FaultConfig # PWM7_on_hiVf (Fault Condition:PWM 7 low-side feedback >)" VALUE 0x001e57d0 /* @ECU_Address@PWM7_on_hiVf@0x01005A50@ */ ECIPP_ALIGNMENT_UWORD 100 Compu_PWM7_on_hiVf 0 99.9984741210938 /end CHARACTERISTIC
/begin COMPU_METHOD Compu_PWM7_on_hiVf " " RAT_FUNC "%.3" "% Vbat" COEFFS 0 655.36 0 0 0 1 /end COMPU_METHOD
/begin CHARACTERISTIC PWM6_off_loDC "FaultConfig # PWM6_off_loDC (Fault Condition:and PWM duty-cycle <)" VALUE 0x001e57be /* @ECU_Address@PWM6_off_loDC@0x01005A58@ */ ECIPP_ALIGNMENT_UWORD 100 Compu_PWM6_off_loDC 0 99.9984741210938 /end CHARACTERISTIC
/begin COMPU_METHOD Compu_PWM6_off_loDC " " RAT_FUNC "%.3" "%" COEFFS 0 655.36 0 0 0 1 /end COMPU_METHOD
/begin CHARACTERISTIC PWM7_off_loDC "FaultConfig # PWM7_off_loDC (Fault Condition:and PWM duty-cycle <)" VALUE 0x001e57ca /* @ECU_Address@PWM7_off_loDC@0x01005A60@ */ ECIPP_ALIGNMENT_UWORD 100 Compu_PWM7_off_loDC 0 99.9984741210938 /end CHARACTERISTIC
/begin COMPU_METHOD Compu_PWM7_off_loDC " " RAT_FUNC "%.3" "%" COEFFS 0 655.36 0 0 0 1 /end COMPU_METHOD
/begin CHARACTERISTIC PWM6_on_hiDC "FaultConfig # PWM6_on_hiDC (Fault Condition:and PWM duty-cycle >)" VALUE 0x001e57c2 /* @ECU_Address@PWM6_on_hiDC@0x01005A68@ */ ECIPP_ALIGNMENT_UWORD 100 Compu_PWM6_on_hiDC 0 99.9984741210938 /end CHARACTERISTIC
/begin COMPU_METHOD Compu_PWM6_on_hiDC " " RAT_FUNC "%.3" "%" COEFFS 0 655.36 0 0 0 1 /end COMPU_METHOD
/begin CHARACTERISTIC PWM7_on_hiDC "FaultConfig # PWM7_on_hiDC (Fault Condition:and PWM duty-cycle >)" VALUE 0x001e57ce /* @ECU_Address@PWM7_on_hiDC@0x01005A70@ */ ECIPP_ALIGNMENT_UWORD 100 Compu_PWM7_on_hiDC 0 99.9984741210938 /end CHARACTERISTIC
/begin COMPU_METHOD Compu_PWM7_on_hiDC " " RAT_FUNC "%.3" "%" COEFFS 0 655.36 0 0 0 1 /end COMPU_METHOD
/begin CHARACTERISTIC APUD4_max "FaultConfig # APUD4_max (Fault Condition:AUX analog PUD4 >)" VALUE 0x001e37ac /* @ECU_Address@APUD4_max@0x01005AD8@ */ ECIPP_ALIGNMENT_UWORD 5 Compu_APUD4_max 0 5.00114468864469 /end CHARACTERISTIC
/begin COMPU_METHOD Compu_APUD4_max " " RAT_FUNC "%.3" "volts" COEFFS 0 13104 0 0 0 1 /end COMPU_METHOD
/begin CHARACTERISTIC APUD4_min "FaultConfig # APUD4_min (Fault Condition:AUX analog PUD4 <)" VALUE 0x001e37ae /* @ECU_Address@APUD4_min@0x01005AE0@ */ ECIPP_ALIGNMENT_UWORD 5 Compu_APUD4_min 0 5.00114468864469 /end CHARACTERISTIC
/begin COMPU_METHOD Compu_APUD4_min " " RAT_FUNC "%.3" "volts" COEFFS 0 13104 0 0 0 1 /end COMPU_METHOD
/begin CHARACTERISTIC ECT_HiExp_wait "FaultConfig # ECT_HiExp_wait (Fault Condition:and run-time >)" VALUE 0x001c4280 /* @ECU_Address@ECT_HiExp_wait@0x01005BA8@ */ ECIPP_ALIGNMENT_ULONG 4294967 Compu_ECT_HiExp_wait 0 4294967.295 /end CHARACTERISTIC
/begin COMPU_METHOD Compu_ECT_HiExp_wait " " RAT_FUNC "%.3" "seconds" COEFFS 0 1000 0 0 0 1 /end COMPU_METHOD
/begin CHARACTERISTIC CHT_HiExp_wait "FaultConfig # CHT_HiExp_wait (Fault Condition:and run-time >)" VALUE 0x001c426c /* @ECU_Address@CHT_HiExp_wait@0x01005BB0@ */ ECIPP_ALIGNMENT_ULONG 4294967 Compu_CHT_HiExp_wait 0 4294967.295 /end CHARACTERISTIC
/begin COMPU_METHOD Compu_CHT_HiExp_wait " " RAT_FUNC "%.3" "seconds" COEFFS 0 1000 0 0 0 1 /end COMPU_METHOD
/begin CHARACTERISTIC FIMP_pct_high "FaultConfig # FIMP_pct_high (Fault Condition:Fuel impurity level >)" VALUE 0x001c6f58 /* @ECU_Address@FIMP_pct_high@0x01005CB0@ */ ECIPP_ALIGNMENT_UWORD 100 Compu_FIMP_pct_high 0 99.9984741210938 /end CHARACTERISTIC
/begin COMPU_METHOD Compu_FIMP_pct_high " " RAT_FUNC "%.3" "%" COEFFS 0 655.36 0 0 0 1 /end COMPU_METHOD
/begin CHARACTERISTIC PWM8_off_loVf "FaultConfig # PWM8_off_loVf (Fault Condition:PWM 8 low-side feedback <)" VALUE 0x001e57d4 /* @ECU_Address@PWM8_off_loVf@0x01005CC8@ */ ECIPP_ALIGNMENT_UWORD 100 Compu_PWM8_off_loVf 0 99.9984741210938 /end CHARACTERISTIC
/begin COMPU_METHOD Compu_PWM8_off_loVf " " RAT_FUNC "%.3" "% Vbat" COEFFS 0 655.36 0 0 0 1 /end COMPU_METHOD
/begin CHARACTERISTIC PWM9_off_loVf "FaultConfig # PWM9_off_loVf (Fault Condition:PWM 9 low-side feedback <)" VALUE 0x001e57dc /* @ECU_Address@PWM9_off_loVf@0x01005CD0@ */ ECIPP_ALIGNMENT_UWORD 100 Compu_PWM9_off_loVf 0 99.9984741210938 /end CHARACTERISTIC
/begin COMPU_METHOD Compu_PWM9_off_loVf " " RAT_FUNC "%.3" "% Vbat" COEFFS 0 655.36 0 0 0 1 /end COMPU_METHOD
/begin CHARACTERISTIC PWM8_on_hiVf "FaultConfig # PWM8_on_hiVf (Fault Condition:PWM 8 low-side feedback >)" VALUE 0x001e57d8 /* @ECU_Address@PWM8_on_hiVf@0x01005CD8@ */ ECIPP_ALIGNMENT_UWORD 100 Compu_PWM8_on_hiVf 0 99.9984741210938 /end CHARACTERISTIC
/begin COMPU_METHOD Compu_PWM8_on_hiVf " " RAT_FUNC "%.3" "% Vbat" COEFFS 0 655.36 0 0 0 1 /end COMPU_METHOD
/begin CHARACTERISTIC PWM9_on_hiVf "FaultConfig # PWM9_on_hiVf (Fault Condition:PWM 9 low-side feedback >)" VALUE 0x001e57e0 /* @ECU_Address@PWM9_on_hiVf@0x01005CE0@ */ ECIPP_ALIGNMENT_UWORD 100 Compu_PWM9_on_hiVf 0 99.9984741210938 /end CHARACTERISTIC
/begin COMPU_METHOD Compu_PWM9_on_hiVf " " RAT_FUNC "%.3" "% Vbat" COEFFS 0 655.36 0 0 0 1 /end COMPU_METHOD
/begin CHARACTERISTIC PWM8_off_loDC "FaultConfig # PWM8_off_loDC (Fault Condition:and PWM duty-cycle <)" VALUE 0x001e57d2 /* @ECU_Address@PWM8_off_loDC@0x01005CE8@ */ ECIPP_ALIGNMENT_UWORD 100 Compu_PWM8_off_loDC 0 99.9984741210938 /end CHARACTERISTIC
/begin COMPU_METHOD Compu_PWM8_off_loDC " " RAT_FUNC "%.3" "%" COEFFS 0 655.36 0 0 0 1 /end COMPU_METHOD
/begin CHARACTERISTIC PWM9_off_loDC "FaultConfig # PWM9_off_loDC (Fault Condition:and PWM duty-cycle <)" VALUE 0x001e57da /* @ECU_Address@PWM9_off_loDC@0x01005CF0@ */ ECIPP_ALIGNMENT_UWORD 100 Compu_PWM9_off_loDC 0 99.9984741210938 /end CHARACTERISTIC
/begin COMPU_METHOD Compu_PWM9_off_loDC " " RAT_FUNC "%.3" "%" COEFFS 0 655.36 0 0 0 1 /end COMPU_METHOD
/begin CHARACTERISTIC PWM8_on_hiDC "FaultConfig # PWM8_on_hiDC (Fault Condition:and PWM duty-cycle >)" VALUE 0x001e57d6 /* @ECU_Address@PWM8_on_hiDC@0x01005CF8@ */ ECIPP_ALIGNMENT_UWORD 100 Compu_PWM8_on_hiDC 0 99.9984741210938 /end CHARACTERISTIC
/begin COMPU_METHOD Compu_PWM8_on_hiDC " " RAT_FUNC "%.3" "%" COEFFS 0 655.36 0 0 0 1 /end COMPU_METHOD
/begin CHARACTERISTIC PWM9_on_hiDC "FaultConfig # PWM9_on_hiDC (Fault Condition:and PWM duty-cycle >)" VALUE 0x001e57de /* @ECU_Address@PWM9_on_hiDC@0x01005D00@ */ ECIPP_ALIGNMENT_UWORD 100 Compu_PWM9_on_hiDC 0 99.9984741210938 /end CHARACTERISTIC
/begin COMPU_METHOD Compu_PWM9_on_hiDC " " RAT_FUNC "%.3" "%" COEFFS 0 655.36 0 0 0 1 /end COMPU_METHOD
/begin CHARACTERISTIC CTM_mdota_max "FaultConfig # CTM_mdota_max (Fault Condition:and mass flow at ports <=)" VALUE 0x001c6e52 /* @ECU_Address@CTM_mdota_max@0x01005D18@ */ ECIPP_ALIGNMENT_UWORD 1024 Compu_CTM_mdota_max 0 1023.984375 /end CHARACTERISTIC
/begin COMPU_METHOD Compu_CTM_mdota_max " " RAT_FUNC "%.3" "g/sec" COEFFS 0 64 0 0 0 1 /end COMPU_METHOD
/begin CHARACTERISTIC CTM_mdota_min "FaultConfig # CTM_mdota_min (Fault Condition:and mass flow at ports >=)" VALUE 0x001c6e54 /* @ECU_Address@CTM_mdota_min@0x01005D20@ */ ECIPP_ALIGNMENT_UWORD 1024 Compu_CTM_mdota_min 0 1023.984375 /end CHARACTERISTIC
/begin COMPU_METHOD Compu_CTM_mdota_min " " RAT_FUNC "%.3" "g/sec" COEFFS 0 64 0 0 0 1 /end COMPU_METHOD
/begin CHARACTERISTIC CBT_ss_delta "FaultConfig # CBT_ss_delta (Fault Condition:and CBT - CBT_ss +/-)" VALUE 0x001c6dc0 /* @ECU_Address@CBT_ss_delta@0x01005D28@ */ ECIPP_ALIGNMENT_UWORD 8192 Compu_CBT_ss_delta 0 8191.875 /end CHARACTERISTIC
/begin COMPU_METHOD Compu_CBT_ss_delta " " RAT_FUNC "%.3" "deg F" COEFFS 0 8 0 0 0 1 /end COMPU_METHOD
/begin CHARACTERISTIC CTM_fltena_wt "FaultConfig # CTM_fltena_wt (Fault Condition:persistently for)" VALUE 0x001c6e50 /* @ECU_Address@CTM_fltena_wt@0x01005D30@ */ ECIPP_ALIGNMENT_UWORD 66 Compu_CTM_fltena_wt 0 65.535 /end CHARACTERISTIC
/begin COMPU_METHOD Compu_CTM_fltena_wt " " RAT_FUNC "%.3" "sec" COEFFS 0 1000 0 0 0 1 /end COMPU_METHOD
/begin CHARACTERISTIC ICam_maxerr "Air # ICam_maxerr (Fault Condition:Intake cam position error >)" VALUE 0x001C9F54 /* @ECU_Address@ICam_maxerr@0x01005E88@ */ ECIPP_ALIGNMENT_SWORD 2048 Compu_ICam_maxerr -2048 2047.9375 /end CHARACTERISTIC
/begin COMPU_METHOD Compu_ICam_maxerr " " RAT_FUNC "%.3" "CAD" COEFFS 0 16 0 0 0 1 /end COMPU_METHOD
/begin CHARACTERISTIC ECam_maxerr "Air # ECam_maxerr (Fault Condition:Exhaust cam position error >)" VALUE 0x001C9CE0 /* @ECU_Address@ECam_maxerr@0x01005E90@ */ ECIPP_ALIGNMENT_SWORD 2048 Compu_ECam_maxerr -2048 2047.9375 /end CHARACTERISTIC
/begin COMPU_METHOD Compu_ECam_maxerr " " RAT_FUNC "%.3" "CAD" COEFFS 0 16 0 0 0 1 /end COMPU_METHOD
/begin CHARACTERISTIC cam_err_rpm "FaultConfig # cam_err_rpm (Fault Condition:and RPM >)" VALUE 0x001c83c2 /* @ECU_Address@cam_err_rpm@0x01005E98@ */ ECIPP_ALIGNMENT_UWORD 65535 Compu_cam_err_rpm 0 65535 /end CHARACTERISTIC
/begin COMPU_METHOD Compu_cam_err_rpm " " RAT_FUNC "%.0" "-" COEFFS 0 1 0 0 0 1 /end COMPU_METHOD
/begin CHARACTERISTIC TRIM_lim_bhvG "CL # TRIM_lim_bhvG" VALUE 0x001C34DC /* @ECU_Address@TRIM_lim_bhvG@0x01005ED8@ */ ECIPP_ALIGNMENT_UBYTE 255 Compu_TRIM_lim_bhvG 0 255 /end CHARACTERISTIC
/begin COMPU_METHOD Compu_TRIM_lim_bhvG " " RAT_FUNC "%.0" "-" COEFFS 0 1 0 0 0 1 /end COMPU_METHOD
/begin CHARACTERISTIC min_gov_rpm_dummy "Gov # min_gov_rpm_dummy" VALUE 0x001C9DDA /* @ECU_Address@min_gov_rpm_dummy@0x01005EE0@ */ ECIPP_ALIGNMENT_UWORD 65535 Compu_min_gov_rpm_dummy 0 65535 /end CHARACTERISTIC
/begin COMPU_METHOD Compu_min_gov_rpm_dummy " " RAT_FUNC "%.0" "-" COEFFS 0 1 0 0 0 1 /end COMPU_METHOD
/begin CHARACTERISTIC FPP1_learn_wait "IOConfig # FPP1_learn_wait" VALUE 0x001C9D1E /* @ECU_Address@FPP1_learn_wait@0x01005EE8@ */ ECIPP_ALIGNMENT_SWORD 32767 Compu_FPP1_learn_wait -32768 32767 /end CHARACTERISTIC
/begin COMPU_METHOD Compu_FPP1_learn_wait " " RAT_FUNC "%.0" "ms" COEFFS 0 1 0 0 0 1 /end COMPU_METHOD
/begin CHARACTERISTIC FPP2_learn_wait "IOConfig # FPP2_learn_wait" VALUE 0x001C9D28 /* @ECU_Address@FPP2_learn_wait@0x01005EF0@ */ ECIPP_ALIGNMENT_SWORD 32767 Compu_FPP2_learn_wait -32768 32767 /end CHARACTERISTIC
/begin COMPU_METHOD Compu_FPP2_learn_wait " " RAT_FUNC "%.0" "ms" COEFFS 0 1 0 0 0 1 /end COMPU_METHOD
/begin CHARACTERISTIC TPS1_learn_wait "IOConfig # TPS1_learn_wait" VALUE 0x001ECD6E /* @ECU_Address@TPS1_learn_wait@0x01005EF8@ */ ECIPP_ALIGNMENT_SWORD 32767 Compu_TPS1_learn_wait -32768 32767 /end CHARACTERISTIC
/begin COMPU_METHOD Compu_TPS1_learn_wait " " RAT_FUNC "%.0" "ms" COEFFS 0 1 0 0 0 1 /end COMPU_METHOD
/begin CHARACTERISTIC TPS2_learn_wait "IOConfig # TPS2_learn_wait" VALUE 0x001ECD78 /* @ECU_Address@TPS2_learn_wait@0x01005F00@ */ ECIPP_ALIGNMENT_SWORD 32767 Compu_TPS2_learn_wait -32768 32767 /end CHARACTERISTIC
/begin COMPU_METHOD Compu_TPS2_learn_wait " " RAT_FUNC "%.0" "ms" COEFFS 0 1 0 0 0 1 /end COMPU_METHOD
/begin CHARACTERISTIC FPP1_learn_tau "IOConfig # FPP1_learn_tau" VALUE 0x001C9D20 /* @ECU_Address@FPP1_learn_tau@0x01005F08@ */ ECIPP_ALIGNMENT_UWORD 327680 Compu_FPP1_learn_tau 0.45084 327680 /end CHARACTERISTIC
/begin COMPU_METHOD Compu_FPP1_learn_tau " " FORM "%.3" "ms"
 /begin FORMULA "-5 / log(1 - (X1 / 65536))" FORMULA_INV "(1 - exp(-5/X1)) * 65536" /end FORMULA
/end COMPU_METHOD
/begin CHARACTERISTIC FPP2_learn_tau "IOConfig # FPP2_learn_tau" VALUE 0x001C9D2A /* @ECU_Address@FPP2_learn_tau@0x01005F10@ */ ECIPP_ALIGNMENT_UWORD 327680 Compu_FPP2_learn_tau 0.45084 327680 /end CHARACTERISTIC
/begin COMPU_METHOD Compu_FPP2_learn_tau " " FORM "%.3" "ms"
 /begin FORMULA "-5 / log(1 - (X1 / 65536))" FORMULA_INV "(1 - exp(-5/X1)) * 65536" /end FORMULA
/end COMPU_METHOD
/begin CHARACTERISTIC TPS1_learn_tau "IOConfig # TPS1_learn_tau" VALUE 0x001ECD70 /* @ECU_Address@TPS1_learn_tau@0x01005F18@ */ ECIPP_ALIGNMENT_UWORD 327680 Compu_TPS1_learn_tau 0.45084 327680 /end CHARACTERISTIC
/begin COMPU_METHOD Compu_TPS1_learn_tau " " FORM "%.3" "ms"
 /begin FORMULA "-5 / log(1 - (X1 / 65536))" FORMULA_INV "(1 - exp(-5/X1)) * 65536" /end FORMULA
/end COMPU_METHOD
/begin CHARACTERISTIC TPS2_learn_tau "IOConfig # TPS2_learn_tau" VALUE 0x001ECD7A /* @ECU_Address@TPS2_learn_tau@0x01005F20@ */ ECIPP_ALIGNMENT_UWORD 327680 Compu_TPS2_learn_tau 0.45084 327680 /end CHARACTERISTIC
/begin COMPU_METHOD Compu_TPS2_learn_tau " " FORM "%.3" "ms"
 /begin FORMULA "-5 / log(1 - (X1 / 65536))" FORMULA_INV "(1 - exp(-5/X1)) * 65536" /end FORMULA
/end COMPU_METHOD
/begin CHARACTERISTIC TPS1_idle_init "IOConfig # TPS1_idle_init" VALUE 0x001ECD72 /* @ECU_Address@TPS1_idle_init@0x01005F28@ */ ECIPP_ALIGNMENT_UWORD 5 Compu_TPS1_idle_init 0 5.00114468864469 /end CHARACTERISTIC
/begin COMPU_METHOD Compu_TPS1_idle_init " " RAT_FUNC "%.3" "volts" COEFFS 0 13104 0 0 0 1 /end COMPU_METHOD
/begin CHARACTERISTIC TPS1_full_init "IOConfig # TPS1_full_init" VALUE 0x001ECD74 /* @ECU_Address@TPS1_full_init@0x01005F30@ */ ECIPP_ALIGNMENT_UWORD 5 Compu_TPS1_full_init 0 5.00114468864469 /end CHARACTERISTIC
/begin COMPU_METHOD Compu_TPS1_full_init " " RAT_FUNC "%.3" "volts" COEFFS 0 13104 0 0 0 1 /end COMPU_METHOD
/begin CHARACTERISTIC TPS1_def "IOConfig # TPS1_def" VALUE 0x001ECD6C /* @ECU_Address@TPS1_def@0x01005F38@ */ ECIPP_ALIGNMENT_UWORD 5 Compu_TPS1_def 0 5.00114468864469 /end CHARACTERISTIC
/begin COMPU_METHOD Compu_TPS1_def " " RAT_FUNC "%.3" "volts" COEFFS 0 13104 0 0 0 1 /end COMPU_METHOD
/begin CHARACTERISTIC TPS2_idle_init "IOConfig # TPS2_idle_init" VALUE 0x001ECD7C /* @ECU_Address@TPS2_idle_init@0x01005F40@ */ ECIPP_ALIGNMENT_UWORD 5 Compu_TPS2_idle_init 0 5.00114468864469 /end CHARACTERISTIC
/begin COMPU_METHOD Compu_TPS2_idle_init " " RAT_FUNC "%.3" "volts" COEFFS 0 13104 0 0 0 1 /end COMPU_METHOD
/begin CHARACTERISTIC TPS2_full_init "IOConfig # TPS2_full_init" VALUE 0x001ECD7E /* @ECU_Address@TPS2_full_init@0x01005F48@ */ ECIPP_ALIGNMENT_UWORD 5 Compu_TPS2_full_init 0 5.00114468864469 /end CHARACTERISTIC
/begin COMPU_METHOD Compu_TPS2_full_init " " RAT_FUNC "%.3" "volts" COEFFS 0 13104 0 0 0 1 /end COMPU_METHOD
/begin CHARACTERISTIC TPS2_def "IOConfig # TPS2_def" VALUE 0x001ECD76 /* @ECU_Address@TPS2_def@0x01005F50@ */ ECIPP_ALIGNMENT_UWORD 5 Compu_TPS2_def 0 5.00114468864469 /end CHARACTERISTIC
/begin COMPU_METHOD Compu_TPS2_def " " RAT_FUNC "%.3" "volts" COEFFS 0 13104 0 0 0 1 /end COMPU_METHOD
/begin CHARACTERISTIC TPS1_idle_def "IOConfig # TPS1_idle_def" VALUE 0x001C9C40 /* @ECU_Address@TPS1_idle_def@0x01005F58@ */ ECIPP_ALIGNMENT_FLOAT32_IEEE 10000000000 Compu_TPS1_idle_def -10000000000 10000000000 /end CHARACTERISTIC
/begin COMPU_METHOD Compu_TPS1_idle_def " " RAT_FUNC "%.3" "volts" COEFFS 0 1 0 0 0 1 /end COMPU_METHOD
/begin CHARACTERISTIC TPS1_full_def "IOConfig # TPS1_full_def" VALUE 0x001C9C44 /* @ECU_Address@TPS1_full_def@0x01005F60@ */ ECIPP_ALIGNMENT_FLOAT32_IEEE 10000000000 Compu_TPS1_full_def -10000000000 10000000000 /end CHARACTERISTIC
/begin COMPU_METHOD Compu_TPS1_full_def " " RAT_FUNC "%.3" "volts" COEFFS 0 1 0 0 0 1 /end COMPU_METHOD
/begin CHARACTERISTIC TEM_R "IOConfig # TEM_R" VALUE 0x001C9C80 /* @ECU_Address@TEM_R@0x01005F68@ */ ECIPP_ALIGNMENT_FLOAT32_IEEE 10000000000 Compu_TEM_R -10000000000 10000000000 /end CHARACTERISTIC
/begin COMPU_METHOD Compu_TEM_R " " RAT_FUNC "%.3" "ohms" COEFFS 0 1 0 0 0 1 /end COMPU_METHOD
/begin CHARACTERISTIC TEM_L "IOConfig # TEM_L" VALUE 0x001C9C84 /* @ECU_Address@TEM_L@0x01005F70@ */ ECIPP_ALIGNMENT_FLOAT32_IEEE 10000000000 Compu_TEM_L -10000000000 10000000000 /end CHARACTERISTIC
/begin COMPU_METHOD Compu_TEM_L " " RAT_FUNC "%.3" "mH" COEFFS 0 1 0 0 0 1 /end COMPU_METHOD
/begin CHARACTERISTIC TEM_Kv "IOConfig # TEM_Kv" VALUE 0x001C9C88 /* @ECU_Address@TEM_Kv@0x01005F78@ */ ECIPP_ALIGNMENT_FLOAT32_IEEE 10000000000 Compu_TEM_Kv -10000000000 10000000000 /end CHARACTERISTIC
/begin COMPU_METHOD Compu_TEM_Kv " " RAT_FUNC "%.3" "V / (100% / sec)" COEFFS 0 1 0 0 0 1 /end COMPU_METHOD
/begin CHARACTERISTIC Adapt_start_wait "General # Adapt_start_wait" VALUE 0x001c4258 /* @ECU_Address@Adapt_start_wait@0x01005F80@ */ ECIPP_ALIGNMENT_ULONG 4294967 Compu_Adapt_start_wait 0 4294967.295 /end CHARACTERISTIC
/begin COMPU_METHOD Compu_Adapt_start_wait " " RAT_FUNC "%.3" "seconds" COEFFS 0 1000 0 0 0 1 /end COMPU_METHOD
/begin CHARACTERISTIC BP_MAP_H "General # BP_MAP_H" VALUE 0x001c6d72 /* @ECU_Address@BP_MAP_H@0x01005F88@ */ ECIPP_ALIGNMENT_UWORD 256 Compu_BP_MAP_H 0 255.99609375 /end CHARACTERISTIC
/begin COMPU_METHOD Compu_BP_MAP_H " " RAT_FUNC "%.3" "psia" COEFFS 0 256 0 0 0 1 /end COMPU_METHOD
/begin CHARACTERISTIC BP_RPM_H "General # BP_RPM_H" VALUE 0x001c6d74 /* @ECU_Address@BP_RPM_H@0x01005F90@ */ ECIPP_ALIGNMENT_UWORD 65535 Compu_BP_RPM_H 0 65535 /end CHARACTERISTIC
/begin COMPU_METHOD Compu_BP_RPM_H " " RAT_FUNC "%.0" "rpm" COEFFS 0 1 0 0 0 1 /end COMPU_METHOD
/begin CHARACTERISTIC BP_TPS_L "General # BP_TPS_L" VALUE 0x001c6d76 /* @ECU_Address@BP_TPS_L@0x01005F98@ */ ECIPP_ALIGNMENT_UWORD 100 Compu_BP_TPS_L 0 99.9984741210938 /end CHARACTERISTIC
/begin COMPU_METHOD Compu_BP_TPS_L " " RAT_FUNC "%.3" "%" COEFFS 0 655.36 0 0 0 1 /end COMPU_METHOD
/begin CHARACTERISTIC BP_def "General # BP_def" VALUE 0x001c6d78 /* @ECU_Address@BP_def@0x01005FA0@ */ ECIPP_ALIGNMENT_UWORD 256 Compu_BP_def 0 255.99609375 /end CHARACTERISTIC
/begin COMPU_METHOD Compu_BP_def " " RAT_FUNC "%.3" "psia" COEFFS 0 256 0 0 0 1 /end COMPU_METHOD
/begin CHARACTERISTIC BP_key_halt "General # BP_key_halt" VALUE 0x001c6d7a /* @ECU_Address@BP_key_halt@0x01005FA8@ */ ECIPP_ALIGNMENT_UWORD 65535 Compu_BP_key_halt 0 65535 /end CHARACTERISTIC
/begin COMPU_METHOD Compu_BP_key_halt " " RAT_FUNC "%.0" "ms" COEFFS 0 1 0 0 0 1 /end COMPU_METHOD
/begin CHARACTERISTIC BP_key_wait "General # BP_key_wait" VALUE 0x001c6d7c /* @ECU_Address@BP_key_wait@0x01005FB0@ */ ECIPP_ALIGNMENT_UWORD 65535 Compu_BP_key_wait 0 65535 /end CHARACTERISTIC
/begin COMPU_METHOD Compu_BP_key_wait " " RAT_FUNC "%.0" "ms" COEFFS 0 1 0 0 0 1 /end COMPU_METHOD
/begin CHARACTERISTIC BP_sample_tau "General # BP_sample_tau" VALUE 0x001c8514 /* @ECU_Address@BP_sample_tau@0x01005FB8@ */ ECIPP_ALIGNMENT_UWORD 327680 Compu_BP_sample_tau 0.45084 327680 /end CHARACTERISTIC
/begin COMPU_METHOD Compu_BP_sample_tau " " FORM "%.3" "ms"
 /begin FORMULA "-5 / log(1 - (X1 / 65536))" FORMULA_INV "(1 - exp(-5/X1)) * 65536" /end FORMULA
/end COMPU_METHOD
/begin CHARACTERISTIC BPs "General # BPs" VALUE 0x001c6d82 /* @ECU_Address@BPs@0x01005FC0@ */ ECIPP_ALIGNMENT_UWORD 256 Compu_BPs 0 255.99609375 /end CHARACTERISTIC
/begin COMPU_METHOD Compu_BPs " " RAT_FUNC "%.3" "psia" COEFFS 0 256 0 0 0 1 /end COMPU_METHOD
/begin CHARACTERISTIC CHT_ECT_est "{CHT_ECT_est&0xff=0:ECT sensor present / estimate CHT}{CHT_ECT_est&0xff=1:CHT sensor present / estimate ECT}" VALUE 0x001c86a2 /* @ECU_Address@CHT_ECT_est@0x01005FC8@ */ ECIPP_ALIGNMENT_UBYTE 255 CHT_ECT_est_COMPU_VTAB 0 255 BIT_MASK 0xff /end CHARACTERISTIC
/begin COMPU_METHOD CHT_ECT_est_COMPU_VTAB "Verbal Table" TAB_VERB "%.0" "list" COMPU_TAB_REF CHT_ECT_est_COMPU_VTAB_REF /end COMPU_METHOD
/begin COMPU_VTAB CHT_ECT_est_COMPU_VTAB_REF "Verbal Table" TAB_VERB 2 0 "ECT sensor present / estimate CHT" 1 "CHT sensor present / estimate ECT" DEFAULT_VALUE "UNKNOWN" /end COMPU_VTAB
/begin CHARACTERISTIC CHT_def "General # CHT_def" VALUE 0x001c6e0c /* @ECU_Address@CHT_def@0x01005FD0@ */ ECIPP_ALIGNMENT_UWORD 564 Compu_CHT_def -460 563.984375 /end CHARACTERISTIC
/begin COMPU_METHOD Compu_CHT_def " " RAT_FUNC "%.3" "deg F" COEFFS 0 64 29440 0 0 1 /end COMPU_METHOD
/begin CHARACTERISTIC CHT_s "General # CHT_s" VALUE 0x001c6e0e /* @ECU_Address@CHT_s@0x01005FD8@ */ ECIPP_ALIGNMENT_UWORD 564 Compu_CHT_s -460 563.984375 /end CHARACTERISTIC
/begin COMPU_METHOD Compu_CHT_s " " RAT_FUNC "%.3" "deg F" COEFFS 0 64 29440 0 0 1 /end COMPU_METHOD
/begin CHARACTERISTIC CL_start_wait "General # CL_start_wait" VALUE 0x001c4270 /* @ECU_Address@CL_start_wait@0x01005FE8@ */ ECIPP_ALIGNMENT_ULONG 4294967 Compu_CL_start_wait 0 4294967.295 /end CHARACTERISTIC
/begin COMPU_METHOD Compu_CL_start_wait " " RAT_FUNC "%.3" "seconds" COEFFS 0 1000 0 0 0 1 /end COMPU_METHOD
/begin CHARACTERISTIC CLp_tau_def "General # CLp_tau_def" VALUE 0x001c6e34 /* @ECU_Address@CLp_tau_def@0x01005FF0@ */ ECIPP_ALIGNMENT_UWORD 65535 Compu_CLp_tau_def 0 65535 /end CHARACTERISTIC
/begin COMPU_METHOD Compu_CLp_tau_def " " RAT_FUNC "%.0" "ms" COEFFS 0 1 0 0 0 1 /end COMPU_METHOD
/begin CHARACTERISTIC Crank_rpm "General # Crank_rpm" VALUE 0x001c6e6a /* @ECU_Address@Crank_rpm@0x01005FF8@ */ ECIPP_ALIGNMENT_UWORD 65535 Compu_Crank_rpm 0 65535 /end CHARACTERISTIC
/begin COMPU_METHOD Compu_Crank_rpm " " RAT_FUNC "%.0" "rpm" COEFFS 0 1 0 0 0 1 /end COMPU_METHOD
/begin CHARACTERISTIC EBP_def "General # EBP_def" VALUE 0x001c6e74 /* @ECU_Address@EBP_def@0x01006000@ */ ECIPP_ALIGNMENT_UWORD 256 Compu_EBP_def 0 255.99609375 /end CHARACTERISTIC
/begin COMPU_METHOD Compu_EBP_def " " RAT_FUNC "%.3" "psia" COEFFS 0 256 0 0 0 1 /end COMPU_METHOD
/begin CHARACTERISTIC EBPs "General # EBPs" VALUE 0x001c6e78 /* @ECU_Address@EBPs@0x01006008@ */ ECIPP_ALIGNMENT_UWORD 256 Compu_EBPs 0 255.99609375 /end CHARACTERISTIC
/begin COMPU_METHOD Compu_EBPs " " RAT_FUNC "%.3" "psia" COEFFS 0 256 0 0 0 1 /end COMPU_METHOD
/begin CHARACTERISTIC ECT_adapt "General # ECT_adapt" VALUE 0x001c6ea8 /* @ECU_Address@ECT_adapt@0x01006018@ */ ECIPP_ALIGNMENT_UWORD 564 Compu_ECT_adapt -460 563.984375 /end CHARACTERISTIC
/begin COMPU_METHOD Compu_ECT_adapt " " RAT_FUNC "%.3" "deg F" COEFFS 0 64 29440 0 0 1 /end COMPU_METHOD
/begin CHARACTERISTIC ECT_def "General # ECT_def" VALUE 0x001c6eaa /* @ECU_Address@ECT_def@0x01006020@ */ ECIPP_ALIGNMENT_UWORD 564 Compu_ECT_def -460 563.984375 /end CHARACTERISTIC
/begin COMPU_METHOD Compu_ECT_def " " RAT_FUNC "%.3" "deg F" COEFFS 0 64 29440 0 0 1 /end COMPU_METHOD
/begin CHARACTERISTIC ECTs "General # ECTs" VALUE 0x001c6ec2 /* @ECU_Address@ECTs@0x01006028@ */ ECIPP_ALIGNMENT_UWORD 564 Compu_ECTs -460 563.984375 /end CHARACTERISTIC
/begin COMPU_METHOD Compu_ECTs " " RAT_FUNC "%.3" "deg F" COEFFS 0 64 29440 0 0 1 /end COMPU_METHOD
/begin CHARACTERISTIC EGO1Tcold "General # EGO1Tcold" VALUE 0x001c3e40 /* @ECU_Address@EGO1Tcold@0x01006030@ */ ECIPP_ALIGNMENT_SLONG 2147483647 Compu_EGO1Tcold -2147483648 2147483647 /end CHARACTERISTIC
/begin COMPU_METHOD Compu_EGO1Tcold " " RAT_FUNC "%.0" "ms" COEFFS 0 1 0 0 0 1 /end COMPU_METHOD
/begin CHARACTERISTIC EGO1Thot "General # EGO1Thot" VALUE 0x001c3e44 /* @ECU_Address@EGO1Thot@0x01006038@ */ ECIPP_ALIGNMENT_SLONG 2147483647 Compu_EGO1Thot -2147483648 2147483647 /end CHARACTERISTIC
/begin COMPU_METHOD Compu_EGO1Thot " " RAT_FUNC "%.0" "ms" COEFFS 0 1 0 0 0 1 /end COMPU_METHOD
/begin CHARACTERISTIC EGO1sw "General # EGO1sw" VALUE 0x001c6ed6 /* @ECU_Address@EGO1sw@0x01006040@ */ ECIPP_ALIGNMENT_UWORD 16 Compu_EGO1sw 0 15.999755859375 /end CHARACTERISTIC
/begin COMPU_METHOD Compu_EGO1sw " " RAT_FUNC "%.3" "volts" COEFFS 0 4096 0 0 0 1 /end COMPU_METHOD
/begin CHARACTERISTIC EGT_def "General # EGT_def" VALUE 0x001c6f06 /* @ECU_Address@EGT_def@0x01006048@ */ ECIPP_ALIGNMENT_UWORD 7732 Compu_EGT_def -460 7731.875 /end CHARACTERISTIC
/begin COMPU_METHOD Compu_EGT_def " " RAT_FUNC "%.3" "deg F" COEFFS 0 8 3680 0 0 1 /end COMPU_METHOD
/begin CHARACTERISTIC EGTs "General # EGTs" VALUE 0x001c6f0a /* @ECU_Address@EGTs@0x01006050@ */ ECIPP_ALIGNMENT_UWORD 7732 Compu_EGTs -460 7731.875 /end CHARACTERISTIC
/begin COMPU_METHOD Compu_EGTs " " RAT_FUNC "%.3" "deg F" COEFFS 0 8 3680 0 0 1 /end COMPU_METHOD
/begin CHARACTERISTIC ETHC_channel "{ETHC_channel&0xff=0:Aux PWM1}{ETHC_channel&0xff=1:Aux PWM2}" VALUE 0x001c86f2 /* @ECU_Address@ETHC_channel@0x01006058@ */ ECIPP_ALIGNMENT_UBYTE 255 ETHC_channel_COMPU_VTAB 0 255 BIT_MASK 0xff /end CHARACTERISTIC
/begin COMPU_METHOD ETHC_channel_COMPU_VTAB "Verbal Table" TAB_VERB "%.0" "list" COMPU_TAB_REF ETHC_channel_COMPU_VTAB_REF /end COMPU_METHOD
/begin COMPU_VTAB ETHC_channel_COMPU_VTAB_REF "Verbal Table" TAB_VERB 2 0 "Aux PWM1" 1 "Aux PWM2" DEFAULT_VALUE "UNKNOWN" /end COMPU_VTAB
/begin CHARACTERISTIC EvsECTCF_ena "{EvsECTCF_ena&0xff=0:Off}{EvsECTCF_ena&0xff=1:On}" VALUE 0x001c86f8 /* @ECU_Address@EvsECTCF_ena@0x01006060@ */ ECIPP_ALIGNMENT_UBYTE 255 EvsECTCF_ena_COMPU_VTAB 0 255 BIT_MASK 0xff /end CHARACTERISTIC
/begin COMPU_METHOD EvsECTCF_ena_COMPU_VTAB "Verbal Table" TAB_VERB "%.0" "list" COMPU_TAB_REF EvsECTCF_ena_COMPU_VTAB_REF /end COMPU_METHOD
/begin COMPU_VTAB EvsECTCF_ena_COMPU_VTAB_REF "Verbal Table" TAB_VERB 2 0 "Off" 1 "On" DEFAULT_VALUE "UNKNOWN" /end COMPU_VTAB
/begin CHARACTERISTIC EvsMATCF_ena "{EvsMATCF_ena&0xff=0:Off}{EvsMATCF_ena&0xff=1:On}" VALUE 0x001c86f9 /* @ECU_Address@EvsMATCF_ena@0x01006068@ */ ECIPP_ALIGNMENT_UBYTE 255 EvsMATCF_ena_COMPU_VTAB 0 255 BIT_MASK 0xff /end CHARACTERISTIC
/begin COMPU_METHOD EvsMATCF_ena_COMPU_VTAB "Verbal Table" TAB_VERB "%.0" "list" COMPU_TAB_REF EvsMATCF_ena_COMPU_VTAB_REF /end COMPU_METHOD
/begin COMPU_VTAB EvsMATCF_ena_COMPU_VTAB_REF "Verbal Table" TAB_VERB 2 0 "Off" 1 "On" DEFAULT_VALUE "UNKNOWN" /end COMPU_VTAB
/begin CHARACTERISTIC FPout_loc "{FPout_loc&0xff=0:MAP}{FPout_loc&0xff=1:TIP}" VALUE 0x001C9F8D /* @ECU_Address@FPout_loc@0x01006070@ */ ECIPP_ALIGNMENT_UBYTE 255 FPout_loc_COMPU_VTAB 0 255 BIT_MASK 0xff /end CHARACTERISTIC
/begin COMPU_METHOD FPout_loc_COMPU_VTAB "Verbal Table" TAB_VERB "%.0" "list" COMPU_TAB_REF FPout_loc_COMPU_VTAB_REF /end COMPU_METHOD
/begin COMPU_VTAB FPout_loc_COMPU_VTAB_REF "Verbal Table" TAB_VERB 2 0 "MAP" 1 "TIP" DEFAULT_VALUE "UNKNOWN" /end COMPU_VTAB
/begin CHARACTERISTIC FT_MAPsw "General # FT_MAPsw" VALUE 0x001c7b8e /* @ECU_Address@FT_MAPsw@0x01006078@ */ ECIPP_ALIGNMENT_UWORD 256 Compu_FT_MAPsw 0 255.99609375 /end CHARACTERISTIC
/begin COMPU_METHOD Compu_FT_MAPsw " " RAT_FUNC "%.3" "psia" COEFFS 0 256 0 0 0 1 /end COMPU_METHOD
/begin CHARACTERISTIC FT_RPMsw "General # FT_RPMsw" VALUE 0x001c7b90 /* @ECU_Address@FT_RPMsw@0x01006080@ */ ECIPP_ALIGNMENT_UWORD 65535 Compu_FT_RPMsw 0 65535 /end CHARACTERISTIC
/begin COMPU_METHOD Compu_FT_RPMsw " " RAT_FUNC "%.0" "rpm" COEFFS 0 1 0 0 0 1 /end COMPU_METHOD
/begin CHARACTERISTIC FT_sw_mode "{FT_sw_mode&0xff=0:Normal}{FT_sw_mode&0xff=1:Stopped Engine}" VALUE 0x001c8749 /* @ECU_Address@FT_sw_mode@0x01006088@ */ ECIPP_ALIGNMENT_UBYTE 255 FT_sw_mode_COMPU_VTAB 0 255 BIT_MASK 0xff /end CHARACTERISTIC
/begin COMPU_METHOD FT_sw_mode_COMPU_VTAB "Verbal Table" TAB_VERB "%.0" "list" COMPU_TAB_REF FT_sw_mode_COMPU_VTAB_REF /end COMPU_METHOD
/begin COMPU_VTAB FT_sw_mode_COMPU_VTAB_REF "Verbal Table" TAB_VERB 2 0 "Normal" 1 "Stopped Engine" DEFAULT_VALUE "UNKNOWN" /end COMPU_VTAB
/begin CHARACTERISTIC Gov_sw_debounce "General # Gov_sw_debounce" VALUE 0x001c7bd2 /* @ECU_Address@Gov_sw_debounce@0x010060A0@ */ ECIPP_ALIGNMENT_UWORD 65535 Compu_Gov_sw_debounce 0 65535 /end CHARACTERISTIC
/begin COMPU_METHOD Compu_Gov_sw_debounce " " RAT_FUNC "%.0" "ms" COEFFS 0 1 0 0 0 1 /end COMPU_METHOD
/begin CHARACTERISTIC IAT_def "General # IAT_def" VALUE 0x001c7c06 /* @ECU_Address@IAT_def@0x010060A8@ */ ECIPP_ALIGNMENT_UWORD 564 Compu_IAT_def -460 563.984375 /end CHARACTERISTIC
/begin COMPU_METHOD Compu_IAT_def " " RAT_FUNC "%.3" "deg F" COEFFS 0 64 29440 0 0 1 /end COMPU_METHOD
/begin CHARACTERISTIC Inj1_bank "{Inj1_bank&0xff=0:Disabled}{Inj1_bank&0xff=1:Bank 1}{Inj1_bank&0xff=2:Bank 2}" VALUE 0x001C9056 /* @ECU_Address@Inj1_bank@0x010060B0@ */ ECIPP_ALIGNMENT_UBYTE 255 Inj1_bank_COMPU_VTAB 0 255 BIT_MASK 0xff /end CHARACTERISTIC
/begin COMPU_METHOD Inj1_bank_COMPU_VTAB "Verbal Table" TAB_VERB "%.0" "list" COMPU_TAB_REF Inj1_bank_COMPU_VTAB_REF /end COMPU_METHOD
/begin COMPU_VTAB Inj1_bank_COMPU_VTAB_REF "Verbal Table" TAB_VERB 3 0 "Disabled" 1 "Bank 1" 2 "Bank 2" DEFAULT_VALUE "UNKNOWN" /end COMPU_VTAB
/begin CHARACTERISTIC Inj2_bank "{Inj2_bank&0xff=0:Disabled}{Inj2_bank&0xff=1:Bank 1}{Inj2_bank&0xff=2:Bank 2}" VALUE 0x001C9057 /* @ECU_Address@Inj2_bank@0x010060B8@ */ ECIPP_ALIGNMENT_UBYTE 255 Inj2_bank_COMPU_VTAB 0 255 BIT_MASK 0xff /end CHARACTERISTIC
/begin COMPU_METHOD Inj2_bank_COMPU_VTAB "Verbal Table" TAB_VERB "%.0" "list" COMPU_TAB_REF Inj2_bank_COMPU_VTAB_REF /end COMPU_METHOD
/begin COMPU_VTAB Inj2_bank_COMPU_VTAB_REF "Verbal Table" TAB_VERB 3 0 "Disabled" 1 "Bank 1" 2 "Bank 2" DEFAULT_VALUE "UNKNOWN" /end COMPU_VTAB
/begin CHARACTERISTIC Inj3_bank "{Inj3_bank&0xff=0:Disabled}{Inj3_bank&0xff=1:Bank 1}{Inj3_bank&0xff=2:Bank 2}" VALUE 0x001C9058 /* @ECU_Address@Inj3_bank@0x010060C0@ */ ECIPP_ALIGNMENT_UBYTE 255 Inj3_bank_COMPU_VTAB 0 255 BIT_MASK 0xff /end CHARACTERISTIC
/begin COMPU_METHOD Inj3_bank_COMPU_VTAB "Verbal Table" TAB_VERB "%.0" "list" COMPU_TAB_REF Inj3_bank_COMPU_VTAB_REF /end COMPU_METHOD
/begin COMPU_VTAB Inj3_bank_COMPU_VTAB_REF "Verbal Table" TAB_VERB 3 0 "Disabled" 1 "Bank 1" 2 "Bank 2" DEFAULT_VALUE "UNKNOWN" /end COMPU_VTAB
/begin CHARACTERISTIC Inj4_bank "{Inj4_bank&0xff=0:Disabled}{Inj4_bank&0xff=1:Bank 1}{Inj4_bank&0xff=2:Bank 2}" VALUE 0x001C9059 /* @ECU_Address@Inj4_bank@0x010060C8@ */ ECIPP_ALIGNMENT_UBYTE 255 Inj4_bank_COMPU_VTAB 0 255 BIT_MASK 0xff /end CHARACTERISTIC
/begin COMPU_METHOD Inj4_bank_COMPU_VTAB "Verbal Table" TAB_VERB "%.0" "list" COMPU_TAB_REF Inj4_bank_COMPU_VTAB_REF /end COMPU_METHOD
/begin COMPU_VTAB Inj4_bank_COMPU_VTAB_REF "Verbal Table" TAB_VERB 3 0 "Disabled" 1 "Bank 1" 2 "Bank 2" DEFAULT_VALUE "UNKNOWN" /end COMPU_VTAB
/begin CHARACTERISTIC Inj5_bank "{Inj5_bank&0xff=0:Disabled}{Inj5_bank&0xff=1:Bank 1}{Inj5_bank&0xff=2:Bank 2}" VALUE 0x001C905A /* @ECU_Address@Inj5_bank@0x010060D0@ */ ECIPP_ALIGNMENT_UBYTE 255 Inj5_bank_COMPU_VTAB 0 255 BIT_MASK 0xff /end CHARACTERISTIC
/begin COMPU_METHOD Inj5_bank_COMPU_VTAB "Verbal Table" TAB_VERB "%.0" "list" COMPU_TAB_REF Inj5_bank_COMPU_VTAB_REF /end COMPU_METHOD
/begin COMPU_VTAB Inj5_bank_COMPU_VTAB_REF "Verbal Table" TAB_VERB 3 0 "Disabled" 1 "Bank 1" 2 "Bank 2" DEFAULT_VALUE "UNKNOWN" /end COMPU_VTAB
/begin CHARACTERISTIC Inj6_bank "{Inj6_bank&0xff=0:Disabled}{Inj6_bank&0xff=1:Bank 1}{Inj6_bank&0xff=2:Bank 2}" VALUE 0x001C905B /* @ECU_Address@Inj6_bank@0x010060D8@ */ ECIPP_ALIGNMENT_UBYTE 255 Inj6_bank_COMPU_VTAB 0 255 BIT_MASK 0xff /end CHARACTERISTIC
/begin COMPU_METHOD Inj6_bank_COMPU_VTAB "Verbal Table" TAB_VERB "%.0" "list" COMPU_TAB_REF Inj6_bank_COMPU_VTAB_REF /end COMPU_METHOD
/begin COMPU_VTAB Inj6_bank_COMPU_VTAB_REF "Verbal Table" TAB_VERB 3 0 "Disabled" 1 "Bank 1" 2 "Bank 2" DEFAULT_VALUE "UNKNOWN" /end COMPU_VTAB
/begin CHARACTERISTIC Inj7_bank "{Inj7_bank&0xff=0:Disabled}{Inj7_bank&0xff=1:Bank 1}{Inj7_bank&0xff=2:Bank 2}" VALUE 0x001C905C /* @ECU_Address@Inj7_bank@0x010060E0@ */ ECIPP_ALIGNMENT_UBYTE 255 Inj7_bank_COMPU_VTAB 0 255 BIT_MASK 0xff /end CHARACTERISTIC
/begin COMPU_METHOD Inj7_bank_COMPU_VTAB "Verbal Table" TAB_VERB "%.0" "list" COMPU_TAB_REF Inj7_bank_COMPU_VTAB_REF /end COMPU_METHOD
/begin COMPU_VTAB Inj7_bank_COMPU_VTAB_REF "Verbal Table" TAB_VERB 3 0 "Disabled" 1 "Bank 1" 2 "Bank 2" DEFAULT_VALUE "UNKNOWN" /end COMPU_VTAB
/begin CHARACTERISTIC Inj8_bank "{Inj8_bank&0xff=0:Disabled}{Inj8_bank&0xff=1:Bank 1}{Inj8_bank&0xff=2:Bank 2}" VALUE 0x001C905D /* @ECU_Address@Inj8_bank@0x010060E8@ */ ECIPP_ALIGNMENT_UBYTE 255 Inj8_bank_COMPU_VTAB 0 255 BIT_MASK 0xff /end CHARACTERISTIC
/begin COMPU_METHOD Inj8_bank_COMPU_VTAB "Verbal Table" TAB_VERB "%.0" "list" COMPU_TAB_REF Inj8_bank_COMPU_VTAB_REF /end COMPU_METHOD
/begin COMPU_VTAB Inj8_bank_COMPU_VTAB_REF "Verbal Table" TAB_VERB 3 0 "Disabled" 1 "Bank 1" 2 "Bank 2" DEFAULT_VALUE "UNKNOWN" /end COMPU_VTAB
/begin CHARACTERISTIC Inj9_bank "{Inj9_bank&0xff=0:Disabled}{Inj9_bank&0xff=1:Bank 1}{Inj9_bank&0xff=2:Bank 2}" VALUE 0x001C905E /* @ECU_Address@Inj9_bank@0x010060F0@ */ ECIPP_ALIGNMENT_UBYTE 255 Inj9_bank_COMPU_VTAB 0 255 BIT_MASK 0xff /end CHARACTERISTIC
/begin COMPU_METHOD Inj9_bank_COMPU_VTAB "Verbal Table" TAB_VERB "%.0" "list" COMPU_TAB_REF Inj9_bank_COMPU_VTAB_REF /end COMPU_METHOD
/begin COMPU_VTAB Inj9_bank_COMPU_VTAB_REF "Verbal Table" TAB_VERB 3 0 "Disabled" 1 "Bank 1" 2 "Bank 2" DEFAULT_VALUE "UNKNOWN" /end COMPU_VTAB
/begin CHARACTERISTIC Inj10_bank "{Inj10_bank&0xff=0:Disabled}{Inj10_bank&0xff=1:Bank 1}{Inj10_bank&0xff=2:Bank 2}" VALUE 0x001C905F /* @ECU_Address@Inj10_bank@0x010060F8@ */ ECIPP_ALIGNMENT_UBYTE 255 Inj10_bank_COMPU_VTAB 0 255 BIT_MASK 0xff /end CHARACTERISTIC
/begin COMPU_METHOD Inj10_bank_COMPU_VTAB "Verbal Table" TAB_VERB "%.0" "list" COMPU_TAB_REF Inj10_bank_COMPU_VTAB_REF /end COMPU_METHOD
/begin COMPU_VTAB Inj10_bank_COMPU_VTAB_REF "Verbal Table" TAB_VERB 3 0 "Disabled" 1 "Bank 1" 2 "Bank 2" DEFAULT_VALUE "UNKNOWN" /end COMPU_VTAB
/begin CHARACTERISTIC Ipark_Ilim "General # Ipark_Ilim" VALUE 0x001C9C92 /* @ECU_Address@Ipark_Ilim@0x01006100@ */ ECIPP_ALIGNMENT_UWORD 64 Compu_Ipark_Ilim 0 63.9990234375 /end CHARACTERISTIC
/begin COMPU_METHOD Compu_Ipark_Ilim " " RAT_FUNC "%.3" "amps" COEFFS 0 1024 0 0 0 1 /end COMPU_METHOD
/begin CHARACTERISTIC Ipark_Ki "General # Ipark_Ki" VALUE 0x001C9C9E /* @ECU_Address@Ipark_Ki@0x01006108@ */ ECIPP_ALIGNMENT_UWORD 3125 Compu_Ipark_Ki 0 3124.95231628418 /end CHARACTERISTIC
/begin COMPU_METHOD Compu_Ipark_Ki " " RAT_FUNC "%.3" "% / amp / sec" COEFFS 0 20.97152 0 0 0 1 /end COMPU_METHOD
/begin CHARACTERISTIC Ipark_dly "General # Ipark_dly" VALUE 0x001C9C9C /* @ECU_Address@Ipark_dly@0x01006110@ */ ECIPP_ALIGNMENT_UWORD 66 Compu_Ipark_dly 0 65.535 /end CHARACTERISTIC
/begin COMPU_METHOD Compu_Ipark_dly " " RAT_FUNC "%.3" "seconds" COEFFS 0 1000 0 0 0 1 /end COMPU_METHOD
/begin CHARACTERISTIC Ipark_ena "{Ipark_ena&0xff=0:Disabled}{Ipark_ena&0xff=1:Single-Point}{Ipark_ena&0xff=2:1-D Table-Based}" VALUE 0x001C9C90 /* @ECU_Address@Ipark_ena@0x01006118@ */ ECIPP_ALIGNMENT_UBYTE 255 Ipark_ena_COMPU_VTAB 0 255 BIT_MASK 0xff /end CHARACTERISTIC
/begin COMPU_METHOD Ipark_ena_COMPU_VTAB "Verbal Table" TAB_VERB "%.0" "list" COMPU_TAB_REF Ipark_ena_COMPU_VTAB_REF /end COMPU_METHOD
/begin COMPU_VTAB Ipark_ena_COMPU_VTAB_REF "Verbal Table" TAB_VERB 3 0 "Disabled" 1 "Single-Point" 2 "1-D Table-Based" DEFAULT_VALUE "UNKNOWN" /end COMPU_VTAB
/begin CHARACTERISTIC Ipark_max_att "General # Ipark_max_att" VALUE 0x001C9CA0 /* @ECU_Address@Ipark_max_att@0x01006120@ */ ECIPP_ALIGNMENT_SWORD 100 Compu_Ipark_max_att -100 99.9969482421875 /end CHARACTERISTIC
/begin COMPU_METHOD Compu_Ipark_max_att " " RAT_FUNC "%.3" "% decrease" COEFFS 0 327.68 0 0 0 1 /end COMPU_METHOD
/begin CHARACTERISTIC KNKF_retard "General # KNKF_retard" VALUE 0x001c39ce /* @ECU_Address@KNKF_retard@0x01006128@ */ ECIPP_ALIGNMENT_UWORD 128 Compu_KNKF_retard 0 127.998046875 /end CHARACTERISTIC
/begin COMPU_METHOD Compu_KNKF_retard " " RAT_FUNC "%.3" "CAD retard" COEFFS 0 512 0 0 0 1 /end COMPU_METHOD
/begin CHARACTERISTIC LP_EGO "General # LP_EGO" VALUE 0x001c855c /* @ECU_Address@LP_EGO@0x01006130@ */ ECIPP_ALIGNMENT_UWORD 327680 Compu_LP_EGO 0.45084 327680 /end CHARACTERISTIC
/begin COMPU_METHOD Compu_LP_EGO " " FORM "%.3" "ms"
 /begin FORMULA "-5 / log(1 - (X1 / 65536))" FORMULA_INV "(1 - exp(-5/X1)) * 65536" /end FORMULA
/end COMPU_METHOD
/begin CHARACTERISTIC LP_fast "General # LP_fast" VALUE 0x001c855e /* @ECU_Address@LP_fast@0x01006138@ */ ECIPP_ALIGNMENT_UWORD 327680 Compu_LP_fast 0.45084 327680 /end CHARACTERISTIC
/begin COMPU_METHOD Compu_LP_fast " " FORM "%.3" "ms"
 /begin FORMULA "-5 / log(1 - (X1 / 65536))" FORMULA_INV "(1 - exp(-5/X1)) * 65536" /end FORMULA
/end COMPU_METHOD
/begin CHARACTERISTIC LP_nominal "General # LP_nominal" VALUE 0x001c8560 /* @ECU_Address@LP_nominal@0x01006140@ */ ECIPP_ALIGNMENT_UWORD 327680 Compu_LP_nominal 0.45084 327680 /end CHARACTERISTIC
/begin COMPU_METHOD Compu_LP_nominal " " FORM "%.3" "ms"
 /begin FORMULA "-5 / log(1 - (X1 / 65536))" FORMULA_INV "(1 - exp(-5/X1)) * 65536" /end FORMULA
/end COMPU_METHOD
/begin CHARACTERISTIC LP_slow "General # LP_slow" VALUE 0x001c8562 /* @ECU_Address@LP_slow@0x01006148@ */ ECIPP_ALIGNMENT_UWORD 327680 Compu_LP_slow 0.45084 327680 /end CHARACTERISTIC
/begin COMPU_METHOD Compu_LP_slow " " FORM "%.3" "ms"
 /begin FORMULA "-5 / log(1 - (X1 / 65536))" FORMULA_INV "(1 - exp(-5/X1)) * 65536" /end FORMULA
/end COMPU_METHOD
/begin CHARACTERISTIC MAP_MPI_max "General # MAP_MPI_max" VALUE 0x001c7d42 /* @ECU_Address@MAP_MPI_max@0x01006150@ */ ECIPP_ALIGNMENT_UWORD 256 Compu_MAP_MPI_max 0 255.99609375 /end CHARACTERISTIC
/begin COMPU_METHOD Compu_MAP_MPI_max " " RAT_FUNC "%.3" "psia" COEFFS 0 256 0 0 0 1 /end COMPU_METHOD
/begin CHARACTERISTIC MAP_MPI_min "General # MAP_MPI_min" VALUE 0x001c7d44 /* @ECU_Address@MAP_MPI_min@0x01006158@ */ ECIPP_ALIGNMENT_UWORD 256 Compu_MAP_MPI_min 0 255.99609375 /end CHARACTERISTIC
/begin COMPU_METHOD Compu_MAP_MPI_min " " RAT_FUNC "%.3" "psia" COEFFS 0 256 0 0 0 1 /end COMPU_METHOD
/begin CHARACTERISTIC MAP_def "General # MAP_def" VALUE 0x001c7d4a /* @ECU_Address@MAP_def@0x01006160@ */ ECIPP_ALIGNMENT_UWORD 256 Compu_MAP_def 0 255.99609375 /end CHARACTERISTIC
/begin COMPU_METHOD Compu_MAP_def " " RAT_FUNC "%.3" "psia" COEFFS 0 256 0 0 0 1 /end COMPU_METHOD
/begin CHARACTERISTIC MAPdt_ICTmax "General # MAPdt_ICTmax" VALUE 0x001c7d5c /* @ECU_Address@MAPdt_ICTmax@0x01006168@ */ ECIPP_ALIGNMENT_UWORD 564 Compu_MAPdt_ICTmax -460 563.984375 /end CHARACTERISTIC
/begin COMPU_METHOD Compu_MAPdt_ICTmax " " RAT_FUNC "%.3" "deg F" COEFFS 0 64 29440 0 0 1 /end COMPU_METHOD
/begin CHARACTERISTIC MAT_def "General # MAT_def" VALUE 0x001c7d62 /* @ECU_Address@MAT_def@0x01006170@ */ ECIPP_ALIGNMENT_UWORD 564 Compu_MAT_def -460 563.984375 /end CHARACTERISTIC
/begin COMPU_METHOD Compu_MAT_def " " RAT_FUNC "%.3" "deg F" COEFFS 0 64 29440 0 0 1 /end COMPU_METHOD
/begin CHARACTERISTIC MAT_est_ena "{MAT_est_ena&0xff=0:MAT = IAT (estimate off)}{MAT_est_ena&0xff=1:IAT-CHT based estimate}" VALUE 0x001c881e /* @ECU_Address@MAT_est_ena@0x01006180@ */ ECIPP_ALIGNMENT_UBYTE 255 MAT_est_ena_COMPU_VTAB 0 255 BIT_MASK 0xff /end CHARACTERISTIC
/begin COMPU_METHOD MAT_est_ena_COMPU_VTAB "Verbal Table" TAB_VERB "%.0" "list" COMPU_TAB_REF MAT_est_ena_COMPU_VTAB_REF /end COMPU_METHOD
/begin COMPU_VTAB MAT_est_ena_COMPU_VTAB_REF "Verbal Table" TAB_VERB 2 0 "MAT = IAT (estimate off)" 1 "IAT-CHT based estimate" DEFAULT_VALUE "UNKNOWN" /end COMPU_VTAB
/begin CHARACTERISTIC MATs "General # MATs" VALUE 0x001c7d68 /* @ECU_Address@MATs@0x01006188@ */ ECIPP_ALIGNMENT_UWORD 564 Compu_MATs -460 563.984375 /end CHARACTERISTIC
/begin COMPU_METHOD Compu_MATs " " RAT_FUNC "%.3" "deg F" COEFFS 0 64 29440 0 0 1 /end COMPU_METHOD
/begin CHARACTERISTIC MILblk_btw_codes "General # MILblk_btw_codes" VALUE 0x001e6de7 /* @ECU_Address@MILblk_btw_codes@0x01006190@ */ ECIPP_ALIGNMENT_UBYTE 12750 Compu_MILblk_btw_codes 0 12750 /end CHARACTERISTIC
/begin COMPU_METHOD Compu_MILblk_btw_codes " " RAT_FUNC "%.3" "ms" COEFFS 0 0.02 0 0 0 1 /end COMPU_METHOD
/begin CHARACTERISTIC MILblk_btw_digits "General # MILblk_btw_digits" VALUE 0x001e6de8 /* @ECU_Address@MILblk_btw_digits@0x01006198@ */ ECIPP_ALIGNMENT_UBYTE 12750 Compu_MILblk_btw_digits 0 12750 /end CHARACTERISTIC
/begin COMPU_METHOD Compu_MILblk_btw_digits " " RAT_FUNC "%.3" "ms" COEFFS 0 0.02 0 0 0 1 /end COMPU_METHOD
/begin CHARACTERISTIC MILblk_btw_repeat "General # MILblk_btw_repeat" VALUE 0x001e6de9 /* @ECU_Address@MILblk_btw_repeat@0x010061A0@ */ ECIPP_ALIGNMENT_UBYTE 12750 Compu_MILblk_btw_repeat 0 12750 /end CHARACTERISTIC
/begin COMPU_METHOD Compu_MILblk_btw_repeat " " RAT_FUNC "%.3" "ms" COEFFS 0 0.02 0 0 0 1 /end COMPU_METHOD
/begin CHARACTERISTIC MILblk_code_rpt "General # MILblk_code_rpt" VALUE 0x001e6dea /* @ECU_Address@MILblk_code_rpt@0x010061A8@ */ ECIPP_ALIGNMENT_UBYTE 255 Compu_MILblk_code_rpt 0 255 /end CHARACTERISTIC
/begin COMPU_METHOD Compu_MILblk_code_rpt " " RAT_FUNC "%.0" "-" COEFFS 0 1 0 0 0 1 /end COMPU_METHOD
/begin CHARACTERISTIC MILblk_digit_off "General # MILblk_digit_off" VALUE 0x001e6dec /* @ECU_Address@MILblk_digit_off@0x010061B0@ */ ECIPP_ALIGNMENT_UBYTE 12750 Compu_MILblk_digit_off 0 12750 /end CHARACTERISTIC
/begin COMPU_METHOD Compu_MILblk_digit_off " " RAT_FUNC "%.3" "ms" COEFFS 0 0.02 0 0 0 1 /end COMPU_METHOD
/begin CHARACTERISTIC MILblk_digit_on "General # MILblk_digit_on" VALUE 0x001e6ded /* @ECU_Address@MILblk_digit_on@0x010061B8@ */ ECIPP_ALIGNMENT_UBYTE 12750 Compu_MILblk_digit_on 0 12750 /end CHARACTERISTIC
/begin COMPU_METHOD Compu_MILblk_digit_on " " RAT_FUNC "%.3" "ms" COEFFS 0 0.02 0 0 0 1 /end COMPU_METHOD
/begin CHARACTERISTIC MILblk_series_wait "General # MILblk_series_wait" VALUE 0x001e6df1 /* @ECU_Address@MILblk_series_wait@0x010061C0@ */ ECIPP_ALIGNMENT_UBYTE 12750 Compu_MILblk_series_wait 0 12750 /end CHARACTERISTIC
/begin COMPU_METHOD Compu_MILblk_series_wait " " RAT_FUNC "%.3" "ms" COEFFS 0 0.02 0 0 0 1 /end COMPU_METHOD
/begin CHARACTERISTIC MILblk_start_wait "General # MILblk_start_wait" VALUE 0x001e6df2 /* @ECU_Address@MILblk_start_wait@0x010061C8@ */ ECIPP_ALIGNMENT_UBYTE 12750 Compu_MILblk_start_wait 0 12750 /end CHARACTERISTIC
/begin COMPU_METHOD Compu_MILblk_start_wait " " RAT_FUNC "%.3" "ms" COEFFS 0 0.02 0 0 0 1 /end COMPU_METHOD
/begin CHARACTERISTIC MILpdfb_off "General # MILpdfb_off" VALUE 0x001e6df5 /* @ECU_Address@MILpdfb_off@0x010061D0@ */ ECIPP_ALIGNMENT_UBYTE 12750 Compu_MILpdfb_off 0 12750 /end CHARACTERISTIC
/begin COMPU_METHOD Compu_MILpdfb_off " " RAT_FUNC "%.3" "ms" COEFFS 0 0.02 0 0 0 1 /end COMPU_METHOD
/begin CHARACTERISTIC MILpdfb_on "General # MILpdfb_on" VALUE 0x001e6df6 /* @ECU_Address@MILpdfb_on@0x010061D8@ */ ECIPP_ALIGNMENT_UBYTE 12750 Compu_MILpdfb_on 0 12750 /end CHARACTERISTIC
/begin COMPU_METHOD Compu_MILpdfb_on " " RAT_FUNC "%.3" "ms" COEFFS 0 0.02 0 0 0 1 /end COMPU_METHOD
/begin CHARACTERISTIC MILst_off "General # MILst_off" VALUE 0x001e6df7 /* @ECU_Address@MILst_off@0x010061E0@ */ ECIPP_ALIGNMENT_UBYTE 12750 Compu_MILst_off 0 12750 /end CHARACTERISTIC
/begin COMPU_METHOD Compu_MILst_off " " RAT_FUNC "%.3" "ms" COEFFS 0 0.02 0 0 0 1 /end COMPU_METHOD
/begin CHARACTERISTIC MILst_on "General # MILst_on" VALUE 0x001e6df8 /* @ECU_Address@MILst_on@0x010061E8@ */ ECIPP_ALIGNMENT_UBYTE 12750 Compu_MILst_on 0 12750 /end CHARACTERISTIC
/begin COMPU_METHOD Compu_MILst_on " " RAT_FUNC "%.3" "ms" COEFFS 0 0.02 0 0 0 1 /end COMPU_METHOD
/begin CHARACTERISTIC MinMAP_frz_wait "General # MinMAP_frz_wait" VALUE 0x001c7de8 /* @ECU_Address@MinMAP_frz_wait@0x010061F0@ */ ECIPP_ALIGNMENT_UWORD 65535 Compu_MinMAP_frz_wait 0 65535 /end CHARACTERISTIC
/begin COMPU_METHOD Compu_MinMAP_frz_wait " " RAT_FUNC "%.0" "ms" COEFFS 0 1 0 0 0 1 /end COMPU_METHOD
/begin CHARACTERISTIC OILL_def_lowlev "General # OILL_def_lowlev" VALUE 0x001c885d /* @ECU_Address@OILL_def_lowlev@0x010061F8@ */ ECIPP_ALIGNMENT_UBYTE 100 Compu_OILL_def_lowlev 0 99.609375 /end CHARACTERISTIC
/begin COMPU_METHOD Compu_OILL_def_lowlev " " RAT_FUNC "%.3" "%" COEFFS 0 2.56 0 0 0 1 /end COMPU_METHOD
/begin CHARACTERISTIC OILL_def_normlev "General # OILL_def_normlev" VALUE 0x001c885e /* @ECU_Address@OILL_def_normlev@0x01006200@ */ ECIPP_ALIGNMENT_UBYTE 100 Compu_OILL_def_normlev 0 99.609375 /end CHARACTERISTIC
/begin COMPU_METHOD Compu_OILL_def_normlev " " RAT_FUNC "%.3" "%" COEFFS 0 2.56 0 0 0 1 /end COMPU_METHOD
/begin CHARACTERISTIC OILL_input "{OILL_input&0xff=0:Disabled}{OILL_input&0xff=1:Aux PU1}{OILL_input&0xff=2:Aux PD1}{OILL_input&0xff=3:Aux PU2}" VALUE 0x001c885f /* @ECU_Address@OILL_input@0x01006208@ */ ECIPP_ALIGNMENT_UBYTE 255 OILL_input_COMPU_VTAB 0 255 BIT_MASK 0xff /end CHARACTERISTIC
/begin COMPU_METHOD OILL_input_COMPU_VTAB "Verbal Table" TAB_VERB "%.0" "list" COMPU_TAB_REF OILL_input_COMPU_VTAB_REF /end COMPU_METHOD
/begin COMPU_VTAB OILL_input_COMPU_VTAB_REF "Verbal Table" TAB_VERB 4 0 "Disabled" 1 "Aux PU1" 2 "Aux PD1" 3 "Aux PU2" DEFAULT_VALUE "UNKNOWN" /end COMPU_VTAB
/begin CHARACTERISTIC OILL_sense "{OILL_sense&0xff=0:GND = OK}{OILL_sense&0xff=1:OPEN = OK}" VALUE 0x001c8860 /* @ECU_Address@OILL_sense@0x01006210@ */ ECIPP_ALIGNMENT_UBYTE 255 OILL_sense_COMPU_VTAB 0 255 BIT_MASK 0xff /end CHARACTERISTIC
/begin COMPU_METHOD OILL_sense_COMPU_VTAB "Verbal Table" TAB_VERB "%.0" "list" COMPU_TAB_REF OILL_sense_COMPU_VTAB_REF /end COMPU_METHOD
/begin COMPU_VTAB OILL_sense_COMPU_VTAB_REF "Verbal Table" TAB_VERB 2 0 "GND = OK" 1 "OPEN = OK" DEFAULT_VALUE "UNKNOWN" /end COMPU_VTAB
/begin CHARACTERISTIC OILP_def_lowigp "General # OILP_def_lowigp" VALUE 0x001c7dfe /* @ECU_Address@OILP_def_lowigp@0x01006218@ */ ECIPP_ALIGNMENT_UWORD 256 Compu_OILP_def_lowigp 0 255.99609375 /end CHARACTERISTIC
/begin COMPU_METHOD Compu_OILP_def_lowigp " " RAT_FUNC "%.3" "psig" COEFFS 0 256 0 0 0 1 /end COMPU_METHOD
/begin CHARACTERISTIC OILP_def_lowp "General # OILP_def_lowp" VALUE 0x001c7e00 /* @ECU_Address@OILP_def_lowp@0x01006220@ */ ECIPP_ALIGNMENT_UWORD 256 Compu_OILP_def_lowp 0 255.99609375 /end CHARACTERISTIC
/begin COMPU_METHOD Compu_OILP_def_lowp " " RAT_FUNC "%.3" "psig" COEFFS 0 256 0 0 0 1 /end COMPU_METHOD
/begin CHARACTERISTIC OILP_def_normp "General # OILP_def_normp" VALUE 0x001c7e02 /* @ECU_Address@OILP_def_normp@0x01006228@ */ ECIPP_ALIGNMENT_UWORD 256 Compu_OILP_def_normp 0 255.99609375 /end CHARACTERISTIC
/begin COMPU_METHOD Compu_OILP_def_normp " " RAT_FUNC "%.3" "psig" COEFFS 0 256 0 0 0 1 /end COMPU_METHOD
/begin CHARACTERISTIC PR_air_critical "General # PR_air_critical" VALUE 0x001c7e58 /* @ECU_Address@PR_air_critical@0x01006240@ */ ECIPP_ALIGNMENT_UWORD 1 Compu_PR_air_critical 0 0.999984741210938 /end CHARACTERISTIC
/begin COMPU_METHOD Compu_PR_air_critical " " RAT_FUNC "%.3" "-" COEFFS 0 65536 0 0 0 1 /end COMPU_METHOD
/begin CHARACTERISTIC PTPs "General # PTPs" VALUE 0x001c7e82 /* @ECU_Address@PTPs@0x01006248@ */ ECIPP_ALIGNMENT_UWORD 256 Compu_PTPs 0 255.99609375 /end CHARACTERISTIC
/begin COMPU_METHOD Compu_PTPs " " RAT_FUNC "%.3" "psia" COEFFS 0 256 0 0 0 1 /end COMPU_METHOD
/begin CHARACTERISTIC Run_rpm "General # Run_rpm" VALUE 0x001c7f36 /* @ECU_Address@Run_rpm@0x01006250@ */ ECIPP_ALIGNMENT_UWORD 65535 Compu_Run_rpm 0 65535 /end CHARACTERISTIC
/begin COMPU_METHOD Compu_Run_rpm " " RAT_FUNC "%.0" "rpm" COEFFS 0 1 0 0 0 1 /end COMPU_METHOD
/begin CHARACTERISTIC TEM_V_diode "General # TEM_V_diode" VALUE 0x001C9C8C /* @ECU_Address@TEM_V_diode@0x01006258@ */ ECIPP_ALIGNMENT_UWORD 256 Compu_TEM_V_diode 0 255.99609375 /end CHARACTERISTIC
/begin COMPU_METHOD Compu_TEM_V_diode " " RAT_FUNC "%.3" "volts" COEFFS 0 256 0 0 0 1 /end COMPU_METHOD
/begin CHARACTERISTIC TEM_hard_Ilim "General # TEM_hard_Ilim" VALUE 0x001C9C8E /* @ECU_Address@TEM_hard_Ilim@0x01006260@ */ ECIPP_ALIGNMENT_SWORD 32 Compu_TEM_hard_Ilim -32 31.9990234375 /end CHARACTERISTIC
/begin COMPU_METHOD Compu_TEM_hard_Ilim " " RAT_FUNC "%.3" "amps" COEFFS 0 1024 0 0 0 1 /end COMPU_METHOD
/begin CHARACTERISTIC TPS_learn_full_lim "General # TPS_learn_full_lim" VALUE 0x001C9C32 /* @ECU_Address@TPS_learn_full_lim@0x01006268@ */ ECIPP_ALIGNMENT_UWORD 5 Compu_TPS_learn_full_lim 0 5.00114468864469 /end CHARACTERISTIC
/begin COMPU_METHOD Compu_TPS_learn_full_lim " " RAT_FUNC "%.3" "volts" COEFFS 0 13104 0 0 0 1 /end COMPU_METHOD
/begin CHARACTERISTIC TPS_learn_full_ofst "General # TPS_learn_full_ofst" VALUE 0x001C9C36 /* @ECU_Address@TPS_learn_full_ofst@0x01006270@ */ ECIPP_ALIGNMENT_UWORD 5 Compu_TPS_learn_full_ofst 0 5.00114468864469 /end CHARACTERISTIC
/begin COMPU_METHOD Compu_TPS_learn_full_ofst " " RAT_FUNC "%.3" "volts" COEFFS 0 13104 0 0 0 1 /end COMPU_METHOD
/begin CHARACTERISTIC TPS_learn_idle_lim "General # TPS_learn_idle_lim" VALUE 0x001C9C2C /* @ECU_Address@TPS_learn_idle_lim@0x01006278@ */ ECIPP_ALIGNMENT_UWORD 5 Compu_TPS_learn_idle_lim 0 5.00114468864469 /end CHARACTERISTIC
/begin COMPU_METHOD Compu_TPS_learn_idle_lim " " RAT_FUNC "%.3" "volts" COEFFS 0 13104 0 0 0 1 /end COMPU_METHOD
/begin CHARACTERISTIC TPS_learn_idle_ofst "General # TPS_learn_idle_ofst" VALUE 0x001C9C30 /* @ECU_Address@TPS_learn_idle_ofst@0x01006280@ */ ECIPP_ALIGNMENT_UWORD 5 Compu_TPS_learn_idle_ofst 0 5.00114468864469 /end CHARACTERISTIC
/begin COMPU_METHOD Compu_TPS_learn_idle_ofst " " RAT_FUNC "%.3" "volts" COEFFS 0 13104 0 0 0 1 /end COMPU_METHOD
/begin CHARACTERISTIC UEGO_active_ll "General # UEGO_active_ll" VALUE 0x001e58a8 /* @ECU_Address@UEGO_active_ll@0x01006290@ */ ECIPP_ALIGNMENT_UWORD 5 Compu_UEGO_active_ll 0 5.00114468864469 /end CHARACTERISTIC
/begin COMPU_METHOD Compu_UEGO_active_ll " " RAT_FUNC "%.3" "volts" COEFFS 0 13104 0 0 0 1 /end COMPU_METHOD
/begin CHARACTERISTIC UEGO_active_ul "General # UEGO_active_ul" VALUE 0x001e58aa /* @ECU_Address@UEGO_active_ul@0x01006298@ */ ECIPP_ALIGNMENT_UWORD 5 Compu_UEGO_active_ul 0 5.00114468864469 /end CHARACTERISTIC
/begin COMPU_METHOD Compu_UEGO_active_ul " " RAT_FUNC "%.3" "volts" COEFFS 0 13104 0 0 0 1 /end COMPU_METHOD
/begin CHARACTERISTIC UEGO_fault_ll "General # UEGO_fault_ll" VALUE 0x001e58ac /* @ECU_Address@UEGO_fault_ll@0x010062A8@ */ ECIPP_ALIGNMENT_UWORD 5 Compu_UEGO_fault_ll 0 5.00114468864469 /end CHARACTERISTIC
/begin COMPU_METHOD Compu_UEGO_fault_ll " " RAT_FUNC "%.3" "volts" COEFFS 0 13104 0 0 0 1 /end COMPU_METHOD
/begin CHARACTERISTIC UEGO_fault_ul "General # UEGO_fault_ul" VALUE 0x001e58ae /* @ECU_Address@UEGO_fault_ul@0x010062B0@ */ ECIPP_ALIGNMENT_UWORD 5 Compu_UEGO_fault_ul 0 5.00114468864469 /end CHARACTERISTIC
/begin COMPU_METHOD Compu_UEGO_fault_ul " " RAT_FUNC "%.3" "volts" COEFFS 0 13104 0 0 0 1 /end COMPU_METHOD
/begin CHARACTERISTIC UEGO_samp_min "General # UEGO_samp_min" VALUE 0x001c82f6 /* @ECU_Address@UEGO_samp_min@0x010062B8@ */ ECIPP_ALIGNMENT_UWORD 65535 Compu_UEGO_samp_min 0 65535 /end CHARACTERISTIC
/begin COMPU_METHOD Compu_UEGO_samp_min " " RAT_FUNC "%.0" "ms" COEFFS 0 1 0 0 0 1 /end COMPU_METHOD
/begin CHARACTERISTIC UEGO_wait "General # UEGO_wait" VALUE 0x001e58b0 /* @ECU_Address@UEGO_wait@0x010062C0@ */ ECIPP_ALIGNMENT_UWORD 66 Compu_UEGO_wait 0 65.535 /end CHARACTERISTIC
/begin COMPU_METHOD Compu_UEGO_wait " " RAT_FUNC "%.3" "seconds" COEFFS 0 1000 0 0 0 1 /end COMPU_METHOD
/begin CHARACTERISTIC UEGO_warm_ll "General # UEGO_warm_ll" VALUE 0x001e58b2 /* @ECU_Address@UEGO_warm_ll@0x010062C8@ */ ECIPP_ALIGNMENT_UWORD 5 Compu_UEGO_warm_ll 0 5.00114468864469 /end CHARACTERISTIC
/begin COMPU_METHOD Compu_UEGO_warm_ll " " RAT_FUNC "%.3" "volts" COEFFS 0 13104 0 0 0 1 /end COMPU_METHOD
/begin CHARACTERISTIC UEGO_warm_ul "General # UEGO_warm_ul" VALUE 0x001e58b4 /* @ECU_Address@UEGO_warm_ul@0x010062D0@ */ ECIPP_ALIGNMENT_UWORD 5 Compu_UEGO_warm_ul 0 5.00114468864469 /end CHARACTERISTIC
/begin COMPU_METHOD Compu_UEGO_warm_ul " " RAT_FUNC "%.3" "volts" COEFFS 0 13104 0 0 0 1 /end COMPU_METHOD
/begin CHARACTERISTIC UEGOc "General # UEGOc" VALUE 0x001e36de /* @ECU_Address@UEGOc@0x010062D8@ */ ECIPP_ALIGNMENT_SWORD 0 Compu_UEGOc -0.39990234375 0.399890139698982 /end CHARACTERISTIC
/begin COMPU_METHOD Compu_UEGOc " " RAT_FUNC "%.3" "phi / volt" COEFFS 0 81940.0048840049 0 0 0 1 /end COMPU_METHOD
/begin CHARACTERISTIC UEGOo "General # UEGOo" VALUE 0x001e36e0 /* @ECU_Address@UEGOo@0x010062E0@ */ ECIPP_ALIGNMENT_SWORD 4 Compu_UEGOo -4 3.9998779296875 /end CHARACTERISTIC
/begin COMPU_METHOD Compu_UEGOo " " RAT_FUNC "%.3" "phi" COEFFS 0 8192 0 0 0 1 /end COMPU_METHOD
/begin CHARACTERISTIC Underspeed "General # Underspeed" VALUE 0x001c8308 /* @ECU_Address@Underspeed@0x010062E8@ */ ECIPP_ALIGNMENT_UWORD 65535 Compu_Underspeed 0 65535 /end CHARACTERISTIC
/begin COMPU_METHOD Compu_Underspeed " " RAT_FUNC "%.0" "rpm" COEFFS 0 1 0 0 0 1 /end COMPU_METHOD
/begin CHARACTERISTIC VE_CWT_adapt_max "General # VE_CWT_adapt_max" VALUE 0x001c6c0c /* @ECU_Address@VE_CWT_adapt_max@0x010062F0@ */ ECIPP_ALIGNMENT_SWORD 100 Compu_VE_CWT_adapt_max -100 99.9969482421875 /end CHARACTERISTIC
/begin COMPU_METHOD Compu_VE_CWT_adapt_max " " RAT_FUNC "%.3" "%" COEFFS 0 327.68 0 0 0 1 /end COMPU_METHOD
/begin CHARACTERISTIC VE_CWT_adapt_min "General # VE_CWT_adapt_min" VALUE 0x001c6c0e /* @ECU_Address@VE_CWT_adapt_min@0x010062F8@ */ ECIPP_ALIGNMENT_SWORD 100 Compu_VE_CWT_adapt_min -100 99.9969482421875 /end CHARACTERISTIC
/begin COMPU_METHOD Compu_VE_CWT_adapt_min " " RAT_FUNC "%.3" "%" COEFFS 0 327.68 0 0 0 1 /end COMPU_METHOD
/begin CHARACTERISTIC V_def "General # V_def" VALUE 0x001c8378 /* @ECU_Address@V_def@0x01006300@ */ ECIPP_ALIGNMENT_UWORD 256 Compu_V_def 0 255.99609375 /end CHARACTERISTIC
/begin COMPU_METHOD Compu_V_def " " RAT_FUNC "%.3" "volts" COEFFS 0 256 0 0 0 1 /end COMPU_METHOD
/begin CHARACTERISTIC WGP_abs_gage "{WGP_abs_gage&0xff=0:psia}{WGP_abs_gage&0xff=1:psig}" VALUE 0x001c8f92 /* @ECU_Address@WGP_abs_gage@0x01006308@ */ ECIPP_ALIGNMENT_UBYTE 255 WGP_abs_gage_COMPU_VTAB 0 255 BIT_MASK 0xff /end CHARACTERISTIC
/begin COMPU_METHOD WGP_abs_gage_COMPU_VTAB "Verbal Table" TAB_VERB "%.0" "list" COMPU_TAB_REF WGP_abs_gage_COMPU_VTAB_REF /end COMPU_METHOD
/begin COMPU_VTAB WGP_abs_gage_COMPU_VTAB_REF "Verbal Table" TAB_VERB 2 0 "psia" 1 "psig" DEFAULT_VALUE "UNKNOWN" /end COMPU_VTAB
/begin CHARACTERISTIC WGP_maxv "General # WGP_maxv (Fault Condition:WGP voltage >)" VALUE 0x001c838a /* @ECU_Address@WGP_maxv@0x01006318@ */ ECIPP_ALIGNMENT_UWORD 5 Compu_WGP_maxv 0 5.00114468864469 /end CHARACTERISTIC
/begin COMPU_METHOD Compu_WGP_maxv " " RAT_FUNC "%.3" "volts" COEFFS 0 13104 0 0 0 1 /end COMPU_METHOD
/begin CHARACTERISTIC WGP_minv "General # WGP_minv (Fault Condition:WGP voltage <)" VALUE 0x001c838c /* @ECU_Address@WGP_minv@0x01006320@ */ ECIPP_ALIGNMENT_UWORD 5 Compu_WGP_minv 0 5.00114468864469 /end CHARACTERISTIC
/begin COMPU_METHOD Compu_WGP_minv " " RAT_FUNC "%.3" "volts" COEFFS 0 13104 0 0 0 1 /end COMPU_METHOD
/begin CHARACTERISTIC deltaBP_MAP "General # deltaBP_MAP" VALUE 0x001c83fa /* @ECU_Address@deltaBP_MAP@0x01006328@ */ ECIPP_ALIGNMENT_UWORD 256 Compu_deltaBP_MAP 0 255.99609375 /end CHARACTERISTIC
/begin COMPU_METHOD Compu_deltaBP_MAP " " RAT_FUNC "%.3" "psi" COEFFS 0 256 0 0 0 1 /end COMPU_METHOD
/begin CHARACTERISTIC fuel_FP_crct_ena "{fuel_FP_crct_ena&0xff=0:Off}{fuel_FP_crct_ena&0xff=1:On}" VALUE 0x001C9F8E /* @ECU_Address@fuel_FP_crct_ena@0x01006330@ */ ECIPP_ALIGNMENT_UBYTE 255 fuel_FP_crct_ena_COMPU_VTAB 0 255 BIT_MASK 0xff /end CHARACTERISTIC
/begin COMPU_METHOD fuel_FP_crct_ena_COMPU_VTAB "Verbal Table" TAB_VERB "%.0" "list" COMPU_TAB_REF fuel_FP_crct_ena_COMPU_VTAB_REF /end COMPU_METHOD
/begin COMPU_VTAB fuel_FP_crct_ena_COMPU_VTAB_REF "Verbal Table" TAB_VERB 2 0 "Off" 1 "On" DEFAULT_VALUE "UNKNOWN" /end COMPU_VTAB
/begin CHARACTERISTIC fuel_FT_crct_ena "{fuel_FT_crct_ena&0xff=0:Off}{fuel_FT_crct_ena&0xff=1:On}" VALUE 0x001C9F8F /* @ECU_Address@fuel_FT_crct_ena@0x01006338@ */ ECIPP_ALIGNMENT_UBYTE 255 fuel_FT_crct_ena_COMPU_VTAB 0 255 BIT_MASK 0xff /end CHARACTERISTIC
/begin COMPU_METHOD fuel_FT_crct_ena_COMPU_VTAB "Verbal Table" TAB_VERB "%.0" "list" COMPU_TAB_REF fuel_FT_crct_ena_COMPU_VTAB_REF /end COMPU_METHOD
/begin COMPU_VTAB fuel_FT_crct_ena_COMPU_VTAB_REF "Verbal Table" TAB_VERB 2 0 "Off" 1 "On" DEFAULT_VALUE "UNKNOWN" /end COMPU_VTAB
/begin CHARACTERISTIC fuel_MAP_crct_ena "{fuel_MAP_crct_ena&0xff=0:Off}{fuel_MAP_crct_ena&0xff=1:On}" VALUE 0x001C9F8C /* @ECU_Address@fuel_MAP_crct_ena@0x01006340@ */ ECIPP_ALIGNMENT_UBYTE 255 fuel_MAP_crct_ena_COMPU_VTAB 0 255 BIT_MASK 0xff /end CHARACTERISTIC
/begin COMPU_METHOD fuel_MAP_crct_ena_COMPU_VTAB "Verbal Table" TAB_VERB "%.0" "list" COMPU_TAB_REF fuel_MAP_crct_ena_COMPU_VTAB_REF /end COMPU_METHOD
/begin COMPU_VTAB fuel_MAP_crct_ena_COMPU_VTAB_REF "Verbal Table" TAB_VERB 2 0 "Off" 1 "On" DEFAULT_VALUE "UNKNOWN" /end COMPU_VTAB
/begin CHARACTERISTIC fuelclr_FPP "General # fuelclr_FPP" VALUE 0x001e58da /* @ECU_Address@fuelclr_FPP@0x01006348@ */ ECIPP_ALIGNMENT_UWORD 100 Compu_fuelclr_FPP 0 99.9984741210938 /end CHARACTERISTIC
/begin COMPU_METHOD Compu_fuelclr_FPP " " RAT_FUNC "%.3" "%" COEFFS 0 655.36 0 0 0 1 /end COMPU_METHOD
/begin CHARACTERISTIC gamma_N "General # gamma_N" VALUE 0x001c845c /* @ECU_Address@gamma_N@0x01006358@ */ ECIPP_ALIGNMENT_UWORD 4 Compu_gamma_N 0 3.99993896484375 /end CHARACTERISTIC
/begin COMPU_METHOD Compu_gamma_N " " RAT_FUNC "%.3" "-" COEFFS 0 16384 0 0 0 1 /end COMPU_METHOD
/begin CHARACTERISTIC gamma_P "General # gamma_P" VALUE 0x001c845e /* @ECU_Address@gamma_P@0x01006360@ */ ECIPP_ALIGNMENT_UWORD 4 Compu_gamma_P 0 3.99993896484375 /end CHARACTERISTIC
/begin COMPU_METHOD Compu_gamma_P " " RAT_FUNC "%.3" "-" COEFFS 0 16384 0 0 0 1 /end COMPU_METHOD
/begin CHARACTERISTIC inj_off_min "General # inj_off_min" VALUE 0x001C9F78 /* @ECU_Address@inj_off_min@0x01006368@ */ ECIPP_ALIGNMENT_UWORD 210 Compu_inj_off_min 0 209.712 /end CHARACTERISTIC
/begin COMPU_METHOD Compu_inj_off_min " " RAT_FUNC "%.3" "ms" COEFFS 0 312.5 0 0 0 1 /end COMPU_METHOD
/begin CHARACTERISTIC inj_type "{inj_type&0xff=0:Throttle-body}{inj_type&0xff=1:Multi-point - cam sync}{inj_type&0xff=2:Multi-point - crank sync}{inj_type&0xff=3:Direct in-cylinder IVO}{inj_type&0xff=4:Direct in-cylinder TDC}" VALUE 0x001c9064 /* @ECU_Address@inj_type@0x01006370@ */ ECIPP_ALIGNMENT_UBYTE 255 inj_type_COMPU_VTAB 0 255 BIT_MASK 0xff /end CHARACTERISTIC
/begin COMPU_METHOD inj_type_COMPU_VTAB "Verbal Table" TAB_VERB "%.0" "list" COMPU_TAB_REF inj_type_COMPU_VTAB_REF /end COMPU_METHOD
/begin COMPU_VTAB inj_type_COMPU_VTAB_REF "Verbal Table" TAB_VERB 5 0 "Throttle-body" 1 "Multi-point - cam sync" 2 "Multi-point - crank sync" 3 "Direct in-cylinder IVO" 4 "Direct in-cylinder TDC" DEFAULT_VALUE "UNKNOWN" /end COMPU_VTAB
/begin CHARACTERISTIC key_off_sleep "General # key_off_sleep" VALUE 0x001c4408 /* @ECU_Address@key_off_sleep@0x01006378@ */ ECIPP_ALIGNMENT_ULONG 4294967 Compu_key_off_sleep 0 4294967.295 /end CHARACTERISTIC
/begin COMPU_METHOD Compu_key_off_sleep " " RAT_FUNC "%.3" "seconds" COEFFS 0 1000 0 0 0 1 /end COMPU_METHOD
/begin CHARACTERISTIC key_trig_volts "General # key_trig_volts" VALUE 0x001c849c /* @ECU_Address@key_trig_volts@0x01006380@ */ ECIPP_ALIGNMENT_UWORD 256 Compu_key_trig_volts 0 255.99609375 /end CHARACTERISTIC
/begin COMPU_METHOD Compu_key_trig_volts " " RAT_FUNC "%.3" "volts" COEFFS 0 256 0 0 0 1 /end COMPU_METHOD
/begin CHARACTERISTIC key_trigrel_volts "General # key_trigrel_volts" VALUE 0x001c849e /* @ECU_Address@key_trigrel_volts@0x01006388@ */ ECIPP_ALIGNMENT_UWORD 256 Compu_key_trigrel_volts 0 255.99609375 /end CHARACTERISTIC
/begin COMPU_METHOD Compu_key_trigrel_volts " " RAT_FUNC "%.3" "volts" COEFFS 0 256 0 0 0 1 /end COMPU_METHOD
/begin CHARACTERISTIC r_comp "General # r_comp" VALUE 0x001c84b0 /* @ECU_Address@r_comp@0x01006390@ */ ECIPP_ALIGNMENT_UWORD 32 Compu_r_comp 0 31.99951171875 /end CHARACTERISTIC
/begin COMPU_METHOD Compu_r_comp " " RAT_FUNC "%.3" "ratio" COEFFS 0 2048 0 0 0 1 /end COMPU_METHOD
/begin CHARACTERISTIC spk_max_global "General # spk_max_global" VALUE 0x001c6d30 /* @ECU_Address@spk_max_global@0x01006398@ */ ECIPP_ALIGNMENT_SWORD 2048 Compu_spk_max_global -2048 2047.9375 /end CHARACTERISTIC
/begin COMPU_METHOD Compu_spk_max_global " " RAT_FUNC "%.3" "CAD BTDC" COEFFS 0 16 0 0 0 1 /end COMPU_METHOD
/begin CHARACTERISTIC spk_min_global "General # spk_min_global" VALUE 0x001c6d32 /* @ECU_Address@spk_min_global@0x010063A0@ */ ECIPP_ALIGNMENT_SWORD 2048 Compu_spk_min_global -2048 2047.9375 /end CHARACTERISTIC
/begin COMPU_METHOD Compu_spk_min_global " " RAT_FUNC "%.3" "CAD BTDC" COEFFS 0 16 0 0 0 1 /end COMPU_METHOD
/begin CHARACTERISTIC strt_fuel_off "General # strt_fuel_off" VALUE 0x001c84f0 /* @ECU_Address@strt_fuel_off@0x010063A8@ */ ECIPP_ALIGNMENT_UWORD 65535 Compu_strt_fuel_off 0 65535 /end CHARACTERISTIC
/begin COMPU_METHOD Compu_strt_fuel_off " " RAT_FUNC "%.0" "rpm" COEFFS 0 1 0 0 0 1 /end COMPU_METHOD
/begin CHARACTERISTIC strt_ign_rpm "General # strt_ign_rpm" VALUE 0x001c84f2 /* @ECU_Address@strt_ign_rpm@0x010063B0@ */ ECIPP_ALIGNMENT_UWORD 65535 Compu_strt_ign_rpm 0 65535 /end CHARACTERISTIC
/begin COMPU_METHOD Compu_strt_ign_rpm " " RAT_FUNC "%.0" "rpm" COEFFS 0 1 0 0 0 1 /end COMPU_METHOD
/begin CHARACTERISTIC sw_debounce "General # sw_debounce" VALUE 0x001c8500 /* @ECU_Address@sw_debounce@0x010063C0@ */ ECIPP_ALIGNMENT_UWORD 65535 Compu_sw_debounce 0 65535 /end CHARACTERISTIC
/begin COMPU_METHOD Compu_sw_debounce " " RAT_FUNC "%.0" "ms" COEFFS 0 1 0 0 0 1 /end COMPU_METHOD
/begin CHARACTERISTIC PWPCF "General # PWPCF" VALUE 0x001C9F7E /* @ECU_Address@PWPCF@0x010063C8@ */ ECIPP_ALIGNMENT_SWORD 0 Compu_PWPCF -0.1024 0.102396875 /end CHARACTERISTIC
/begin COMPU_METHOD Compu_PWPCF " " RAT_FUNC "%.3" "ms/psi" COEFFS 0 320000 0 0 0 1 /end COMPU_METHOD
/begin CHARACTERISTIC PW_zero "General # PW_zero" VALUE 0x001C9F74 /* @ECU_Address@PW_zero@0x010063D0@ */ ECIPP_ALIGNMENT_UWORD 210 Compu_PW_zero 0 209.712 /end CHARACTERISTIC
/begin COMPU_METHOD Compu_PW_zero " " RAT_FUNC "%.3" "ms" COEFFS 0 312.5 0 0 0 1 /end COMPU_METHOD
/begin CHARACTERISTIC encrypt_key_index_def "{encrypt_key_index_def&0xff=0:Impco}{encrypt_key_index_def&0xff=1:Scania}{encrypt_key_index_def&0xff=2:Hino}{encrypt_key_index_def&0xff=3:Hyundai}{encrypt_key_index_def&0xff=4:Volvo}{encrypt_key_index_def&0xff=5:Aquastar}{encrypt_key_index_def&0xff=6:PCM}" VALUE 0x001c900d /* @ECU_Address@encrypt_key_index_def@0x010063D8@ */ ECIPP_ALIGNMENT_UBYTE 255 encrypt_key_index_def_COMPU_VTAB 0 255 BIT_MASK 0xff /end CHARACTERISTIC
/begin COMPU_METHOD encrypt_key_index_def_COMPU_VTAB "Verbal Table" TAB_VERB "%.0" "list" COMPU_TAB_REF encrypt_key_index_def_COMPU_VTAB_REF /end COMPU_METHOD
/begin COMPU_VTAB encrypt_key_index_def_COMPU_VTAB_REF "Verbal Table" TAB_VERB 76 0 "Impco" 1 "Scania" 2 "Hino" 3 "Hyundai" 4 "Volvo" 5 "Aquastar" 6 "PCM" 7 "Zenith" 8 "PSI" 9 "Rotax" 10 "Shanghai" 11 "EDI" 12 "Wisconsin Motors" 13 "Yuchai Motors" 14 "EOL Tester (All Users)" 15 "ECI Only" 16 "Jehin" 17 "Linde" 18 "Still" 19 "Junhenrich" 20 "EST" 21 "Mast" 22 "Sino Truck" 23 "Amico" 24 "Demo" 25 "Kubota rev 1" 26 "Doosan" 27 "Reserved 3" 28 "Unassigned" 29 "Cummins Power Generation (CPG)" 30 "HHI" 31 "BP Support" 32 "FAW" 33 "Clark" 34 "Indmar" 35 "Ilmor" 36 "Reserved 4" 37 "YUP" 38 "Cummins Power Gen-Northern Pwr" 39 "MTU" 40 "Northern Power" 41 "Reserved 5" 42 "Graham" 43 "Indmar rev 2 Ford" 44 "Raritek" 45 "Kohler rev 1" 46 "PSI rev 2" 47 "DEUTZ" 48 "SwRI" 49 "PSI rev 3" 50 "OBSOLETE - 51" 51 "Graham rev 2" 52 "Kubota rev 2" 53 "CGE rev 1" 54 "Polaris" 55 "Malibu" 56 "Yanmar" 57 "ACTION" 58 "Isuzu" 59 "Reserved 12" 60 "Enovation" 61 "Hatz" 62 "Origin" 63 "Reserved 13" 64 "ChaoChai" 65 "Advantek" 66 "Toyota" 67 "Himoinsa" 68 "Kubota rev 3" 69 "LECS" 70 "Kohler rev 2" 71 "SPOCK rev 1" 72 "Enchanted Rock" 73 "PCM rev 2" 74 "MLA" 75 "ATech" DEFAULT_VALUE "UNKNOWN" /end COMPU_VTAB
/begin CHARACTERISTIC J1939_DM5_OBDc3 "{J1939_DM5_OBDc3&0xff=0:None}{J1939_DM5_OBDc3&0xff=1:OBD (Federal, EPA)}{J1939_DM5_OBDc3&0xff=2:OBD I}{J1939_DM5_OBDc3&0xff=3:OBD, OBD II}{J1939_DM5_OBDc3&0xff=4:OBD II (CARB)}{J1939_DM5_OBDc3&0xff=5:OBD II (CARB 2007/8)}{J1939_DM5_OBDc3&0xff=6:OBDM}{J193" VALUE 0x001C9BBE /* @ECU_Address@J1939_DM5_OBDc3@0x01006418@ */ ECIPP_ALIGNMENT_UBYTE 255 J1939_DM5_OBDc3_COMPU_VTAB 0 255 BIT_MASK 0xff /end CHARACTERISTIC
/begin COMPU_METHOD J1939_DM5_OBDc3_COMPU_VTAB "Verbal Table" TAB_VERB "%.0" "list" COMPU_TAB_REF J1939_DM5_OBDc3_COMPU_VTAB_REF /end COMPU_METHOD
/begin COMPU_VTAB J1939_DM5_OBDc3_COMPU_VTAB_REF "Verbal Table" TAB_VERB 29 0 "None" 1 "OBD (Federal, EPA)" 2 "OBD I" 3 "OBD, OBD II" 4 "OBD II (CARB)" 5 "OBD II (CARB 2007/8)" 6 "OBDM" 7 "EOBD" 8 "EOBD and OBD" 9 "EOBD and OBD II" 10 "EOBD , OBD and OBD II" 11 "JOBD" 12 "JOBD and OBD II" 13 "JOBD and EOBD" 14 "JOBD, EOBD and OBD II" 15 "HD (EURO VI) B1" 16 "HD (EURO V) B2" 17 "HD (EURO EEC) C" 18 "EMD" 19 "EMD+" 20 "HD OBD P" 21 "HD OBD" 22 "World Wide Harmonized OBD" 23 "HD EOBD" 24 "EURO VI" 25 "OBD, OBD II, HD OBD" 26 "OBD, OBD II, HD OBD P" 27 "China Nationwide Stage 6 (China VI)" 28 "Brazil OBD Diesel" DEFAULT_VALUE "UNKNOWN" /end COMPU_VTAB
/begin CHARACTERISTIC J1939_DM19_calid3 "{J1939_DM19_calid3&0xff=0:Calibration Model No.}{J1939_DM19_calid3&0xff=1:Customer Software PN}" VALUE 0x001C9BBF /* @ECU_Address@J1939_DM19_calid3@0x01006420@ */ ECIPP_ALIGNMENT_UBYTE 255 J1939_DM19_calid3_COMPU_VTAB 0 255 BIT_MASK 0xff /end CHARACTERISTIC
/begin COMPU_METHOD J1939_DM19_calid3_COMPU_VTAB "Verbal Table" TAB_VERB "%.0" "list" COMPU_TAB_REF J1939_DM19_calid3_COMPU_VTAB_REF /end COMPU_METHOD
/begin COMPU_VTAB J1939_DM19_calid3_COMPU_VTAB_REF "Verbal Table" TAB_VERB 2 0 "Calibration Model No." 1 "Customer Software PN" DEFAULT_VALUE "UNKNOWN" /end COMPU_VTAB
/begin CHARACTERISTIC J1939_DM5_OBDc2 "{J1939_DM5_OBDc2&0xff=0:None}{J1939_DM5_OBDc2&0xff=1:OBD (Federal, EPA)}{J1939_DM5_OBDc2&0xff=2:OBD I}{J1939_DM5_OBDc2&0xff=3:OBD, OBD II}{J1939_DM5_OBDc2&0xff=4:OBD II (CARB)}{J1939_DM5_OBDc2&0xff=5:OBD II (CARB 2007/8)}{J1939_DM5_OBDc2&0xff=6:OBDM}{J193" VALUE 0x001C9826 /* @ECU_Address@J1939_DM5_OBDc2@0x01006438@ */ ECIPP_ALIGNMENT_UBYTE 255 J1939_DM5_OBDc2_COMPU_VTAB 0 255 BIT_MASK 0xff /end CHARACTERISTIC
/begin COMPU_METHOD J1939_DM5_OBDc2_COMPU_VTAB "Verbal Table" TAB_VERB "%.0" "list" COMPU_TAB_REF J1939_DM5_OBDc2_COMPU_VTAB_REF /end COMPU_METHOD
/begin COMPU_VTAB J1939_DM5_OBDc2_COMPU_VTAB_REF "Verbal Table" TAB_VERB 29 0 "None" 1 "OBD (Federal, EPA)" 2 "OBD I" 3 "OBD, OBD II" 4 "OBD II (CARB)" 5 "OBD II (CARB 2007/8)" 6 "OBDM" 7 "EOBD" 8 "EOBD and OBD" 9 "EOBD and OBD II" 10 "EOBD , OBD and OBD II" 11 "JOBD" 12 "JOBD and OBD II" 13 "JOBD and EOBD" 14 "JOBD, EOBD and OBD II" 15 "HD (EURO VI) B1" 16 "HD (EURO V) B2" 17 "HD (EURO EEC) C" 18 "EMD" 19 "EMD+" 20 "HD OBD P" 21 "HD OBD" 22 "World Wide Harmonized OBD" 23 "HD EOBD" 24 "EURO VI" 25 "OBD, OBD II, HD OBD" 26 "OBD, OBD II, HD OBD P" 27 "China Nationwide Stage 6 (China VI)" 28 "Brazil OBD Diesel" DEFAULT_VALUE "UNKNOWN" /end COMPU_VTAB
/begin CHARACTERISTIC J1939_DM19_calid2 "{J1939_DM19_calid2&0xff=0:Calibration Model No.}{J1939_DM19_calid2&0xff=1:Customer Software PN}" VALUE 0x001C9827 /* @ECU_Address@J1939_DM19_calid2@0x01006440@ */ ECIPP_ALIGNMENT_UBYTE 255 J1939_DM19_calid2_COMPU_VTAB 0 255 BIT_MASK 0xff /end CHARACTERISTIC
/begin COMPU_METHOD J1939_DM19_calid2_COMPU_VTAB "Verbal Table" TAB_VERB "%.0" "list" COMPU_TAB_REF J1939_DM19_calid2_COMPU_VTAB_REF /end COMPU_METHOD
/begin COMPU_VTAB J1939_DM19_calid2_COMPU_VTAB_REF "Verbal Table" TAB_VERB 2 0 "Calibration Model No." 1 "Customer Software PN" DEFAULT_VALUE "UNKNOWN" /end COMPU_VTAB
/begin CHARACTERISTIC sw_loV "IOConfig # sw_loV" VALUE 0x001c8508 /* @ECU_Address@sw_loV@0x01006448@ */ ECIPP_ALIGNMENT_UWORD 256 Compu_sw_loV 0 255.99609375 /end CHARACTERISTIC
/begin COMPU_METHOD Compu_sw_loV " " RAT_FUNC "%.3" "volts" COEFFS 0 256 0 0 0 1 /end COMPU_METHOD
/begin CHARACTERISTIC sw_hiV "IOConfig # sw_hiV" VALUE 0x001c8504 /* @ECU_Address@sw_hiV@0x01006450@ */ ECIPP_ALIGNMENT_UWORD 256 Compu_sw_hiV 0 255.99609375 /end CHARACTERISTIC
/begin COMPU_METHOD Compu_sw_hiV " " RAT_FUNC "%.3" "volts" COEFFS 0 256 0 0 0 1 /end COMPU_METHOD
/begin CHARACTERISTIC sw_loTri "IOConfig # sw_loTri" VALUE 0x001c8506 /* @ECU_Address@sw_loTri@0x01006458@ */ ECIPP_ALIGNMENT_UWORD 256 Compu_sw_loTri 0 255.99609375 /end CHARACTERISTIC
/begin COMPU_METHOD Compu_sw_loTri " " RAT_FUNC "%.3" "volts" COEFFS 0 256 0 0 0 1 /end COMPU_METHOD
/begin CHARACTERISTIC sw_hiTri "IOConfig # sw_hiTri" VALUE 0x001c8502 /* @ECU_Address@sw_hiTri@0x01006460@ */ ECIPP_ALIGNMENT_UWORD 256 Compu_sw_hiTri 0 255.99609375 /end CHARACTERISTIC
/begin COMPU_METHOD Compu_sw_hiTri " " RAT_FUNC "%.3" "volts" COEFFS 0 256 0 0 0 1 /end COMPU_METHOD
/begin CHARACTERISTIC sw_lowbat "IOConfig # sw_lowbat" VALUE 0x001c850a /* @ECU_Address@sw_lowbat@0x01006468@ */ ECIPP_ALIGNMENT_UWORD 256 Compu_sw_lowbat 0 255.99609375 /end CHARACTERISTIC
/begin COMPU_METHOD Compu_sw_lowbat " " RAT_FUNC "%.3" "volts" COEFFS 0 256 0 0 0 1 /end COMPU_METHOD
/begin CHARACTERISTIC camloss "FaultConfig # camloss (Fault Condition:No cam pulse in)" VALUE 0x001c8fce /* @ECU_Address@camloss@0x01006478@ */ ECIPP_ALIGNMENT_UBYTE 64 Compu_camloss 0 63.75 /end CHARACTERISTIC
/begin COMPU_METHOD Compu_camloss " " RAT_FUNC "%.3" "cycles" COEFFS 0 4 0 0 0 1 /end COMPU_METHOD
/begin CHARACTERISTIC crknever "FaultConfig # crknever (Fault Condition:Cranking revs without sync >)" VALUE 0x001c8fe0 /* @ECU_Address@crknever@0x01006480@ */ ECIPP_ALIGNMENT_UBYTE 64 Compu_crknever 0 63.75 /end CHARACTERISTIC
/begin COMPU_METHOD Compu_crknever " " RAT_FUNC "%.3" "revs" COEFFS 0 4 0 0 0 1 /end COMPU_METHOD
/begin CHARACTERISTIC ECT_vdr "IOConfig # ECT_vdr" VALUE 0x001c3a8c /* @ECU_Address@ECT_vdr@0x010064A0@ */ ECIPP_ALIGNMENT_FLOAT32_IEEE 10000000000 Compu_ECT_vdr -10000000000 10000000000 /end CHARACTERISTIC
/begin COMPU_METHOD Compu_ECT_vdr " " RAT_FUNC "%.3" "ohms" COEFFS 0 1 0 0 0 1 /end COMPU_METHOD
/begin CHARACTERISTIC FT_vdr "IOConfig # FT_vdr" VALUE 0x001c3acc /* @ECU_Address@FT_vdr@0x010064A8@ */ ECIPP_ALIGNMENT_FLOAT32_IEEE 10000000000 Compu_FT_vdr -10000000000 10000000000 /end CHARACTERISTIC
/begin COMPU_METHOD Compu_FT_vdr " " RAT_FUNC "%.3" "ohms" COEFFS 0 1 0 0 0 1 /end COMPU_METHOD
/begin CHARACTERISTIC CHT_vdr "IOConfig # CHT_vdr" VALUE 0x001c3a84 /* @ECU_Address@CHT_vdr@0x010064B0@ */ ECIPP_ALIGNMENT_FLOAT32_IEEE 10000000000 Compu_CHT_vdr -10000000000 10000000000 /end CHARACTERISTIC
/begin COMPU_METHOD Compu_CHT_vdr " " RAT_FUNC "%.3" "ohms" COEFFS 0 1 0 0 0 1 /end COMPU_METHOD
/begin CHARACTERISTIC FTgaseous_vdr "IOConfig # FTgaseous_vdr" VALUE 0x001c3ad0 /* @ECU_Address@FTgaseous_vdr@0x010064B8@ */ ECIPP_ALIGNMENT_FLOAT32_IEEE 10000000000 Compu_FTgaseous_vdr -10000000000 10000000000 /end CHARACTERISTIC
/begin COMPU_METHOD Compu_FTgaseous_vdr " " RAT_FUNC "%.3" "ohms" COEFFS 0 1 0 0 0 1 /end COMPU_METHOD
/begin CHARACTERISTIC FTT_vdr "IOConfig # FTT_vdr" VALUE 0x001c3ac8 /* @ECU_Address@FTT_vdr@0x010064C0@ */ ECIPP_ALIGNMENT_FLOAT32_IEEE 10000000000 Compu_FTT_vdr -10000000000 10000000000 /end CHARACTERISTIC
/begin COMPU_METHOD Compu_FTT_vdr " " RAT_FUNC "%.3" "ohms" COEFFS 0 1 0 0 0 1 /end COMPU_METHOD
/begin CHARACTERISTIC FST_vdr "IOConfig # FST_vdr" VALUE 0x001c3ac4 /* @ECU_Address@FST_vdr@0x010064C8@ */ ECIPP_ALIGNMENT_FLOAT32_IEEE 10000000000 Compu_FST_vdr -10000000000 10000000000 /end CHARACTERISTIC
/begin COMPU_METHOD Compu_FST_vdr " " RAT_FUNC "%.3" "ohms" COEFFS 0 1 0 0 0 1 /end COMPU_METHOD
/begin CHARACTERISTIC EMWT_vdr "IOConfig # EMWT_vdr" VALUE 0x001c3aa8 /* @ECU_Address@EMWT_vdr@0x010064D0@ */ ECIPP_ALIGNMENT_FLOAT32_IEEE 10000000000 Compu_EMWT_vdr -10000000000 10000000000 /end CHARACTERISTIC
/begin COMPU_METHOD Compu_EMWT_vdr " " RAT_FUNC "%.3" "ohms" COEFFS 0 1 0 0 0 1 /end COMPU_METHOD
/begin CHARACTERISTIC RPM_high_air "Air # RPM_high_air" VALUE 0x001c3b30 /* @ECU_Address@RPM_high_air@0x010064D8@ */ ECIPP_ALIGNMENT_FLOAT32_IEEE 10000000000 Compu_RPM_high_air -10000000000 10000000000 /end CHARACTERISTIC
/begin COMPU_METHOD Compu_RPM_high_air " " RAT_FUNC "%.3" "rpm at high airflow" COEFFS 0 1 0 0 0 1 /end COMPU_METHOD
/begin CHARACTERISTIC VE_high_air "Air # VE_high_air" VALUE 0x001c3df0 /* @ECU_Address@VE_high_air@0x010064E0@ */ ECIPP_ALIGNMENT_FLOAT32_IEEE 10000000000 Compu_VE_high_air -10000000000 10000000000 /end CHARACTERISTIC
/begin COMPU_METHOD Compu_VE_high_air " " RAT_FUNC "%.3" "% VE at high airflow" COEFFS 0 1 0 0 0 1 /end COMPU_METHOD
/begin CHARACTERISTIC MAP_high_air "Air # MAP_high_air" VALUE 0x001c3ae4 /* @ECU_Address@MAP_high_air@0x010064E8@ */ ECIPP_ALIGNMENT_FLOAT32_IEEE 10000000000 Compu_MAP_high_air -10000000000 10000000000 /end CHARACTERISTIC
/begin COMPU_METHOD Compu_MAP_high_air " " RAT_FUNC "%.3" "psia at high airflow" COEFFS 0 1 0 0 0 1 /end COMPU_METHOD
/begin CHARACTERISTIC HEX_MILblk_def_code "FaultConfig # HEX_MILblk_def_code" VALUE 0x001e5704 /* @ECU_Address@HEX_MILblk_def_code@0x010064F0@ */ ECIPP_ALIGNMENT_UWORD 65535 Compu_HEX_MILblk_def_code 0 65535 /end CHARACTERISTIC
/begin COMPU_METHOD Compu_HEX_MILblk_def_code " " RAT_FUNC "%.0" "-" COEFFS 0 1 0 0 0 1 /end COMPU_METHOD
/begin CHARACTERISTIC J1939_Tx2Fail "FaultConfig # J1939_Tx2Fail (Fault Condition:Tx error counter >)" VALUE 0x001C9829 /* @ECU_Address@J1939_Tx2Fail@0x01006500@ */ ECIPP_ALIGNMENT_UBYTE 255 Compu_J1939_Tx2Fail 0 255 /end CHARACTERISTIC
/begin COMPU_METHOD Compu_J1939_Tx2Fail " " RAT_FUNC "%.0" "failures" COEFFS 0 1 0 0 0 1 /end COMPU_METHOD
/begin CHARACTERISTIC J1939_Rx2Fail "FaultConfig # J1939_Rx2Fail (Fault Condition:Rx error counter >)" VALUE 0x001C982A /* @ECU_Address@J1939_Rx2Fail@0x01006508@ */ ECIPP_ALIGNMENT_UBYTE 255 Compu_J1939_Rx2Fail 0 255 /end CHARACTERISTIC
/begin COMPU_METHOD Compu_J1939_Rx2Fail " " RAT_FUNC "%.0" "failures" COEFFS 0 1 0 0 0 1 /end COMPU_METHOD
/begin CHARACTERISTIC J1939_Tx3Fail "FaultConfig # J1939_Tx3Fail (Fault Condition:Tx error counter >)" VALUE 0x001C9BC1 /* @ECU_Address@J1939_Tx3Fail@0x01006518@ */ ECIPP_ALIGNMENT_UBYTE 255 Compu_J1939_Tx3Fail 0 255 /end CHARACTERISTIC
/begin COMPU_METHOD Compu_J1939_Tx3Fail " " RAT_FUNC "%.0" "failures" COEFFS 0 1 0 0 0 1 /end COMPU_METHOD
/begin CHARACTERISTIC J1939_Rx3Fail "FaultConfig # J1939_Rx3Fail (Fault Condition:Rx error counter >)" VALUE 0x001C9BC2 /* @ECU_Address@J1939_Rx3Fail@0x01006520@ */ ECIPP_ALIGNMENT_UBYTE 255 Compu_J1939_Rx3Fail 0 255 /end CHARACTERISTIC
/begin COMPU_METHOD Compu_J1939_Rx3Fail " " RAT_FUNC "%.0" "failures" COEFFS 0 1 0 0 0 1 /end COMPU_METHOD
/begin CHARACTERISTIC BP_est_ena "{BP_est_ena&0xff=0:BP = default (estimate off)}{BP_est_ena&0xff=1:MAP based estimate}{BP_est_ena&0xff=2:Environmental sensor (CAN)}{BP_est_ena&0xff=3:TOP based estimate}{BP_est_ena&0xff=4:Internal BP sensor}" VALUE 0x001c868c /* @ECU_Address@BP_est_ena@0x010067C8@ */ ECIPP_ALIGNMENT_UBYTE 255 BP_est_ena_COMPU_VTAB 0 255 BIT_MASK 0xff /end CHARACTERISTIC
/begin COMPU_METHOD BP_est_ena_COMPU_VTAB "Verbal Table" TAB_VERB "%.0" "list" COMPU_TAB_REF BP_est_ena_COMPU_VTAB_REF /end COMPU_METHOD
/begin COMPU_VTAB BP_est_ena_COMPU_VTAB_REF "Verbal Table" TAB_VERB 5 0 "BP = default (estimate off)" 1 "MAP based estimate" 2 "Environmental sensor (CAN)" 3 "TOP based estimate" 4 "Internal BP sensor" DEFAULT_VALUE "UNKNOWN" /end COMPU_VTAB
/begin CHARACTERISTIC IAT_HiExp_wait "FaultConfig # IAT_HiExp_wait (Fault Condition:run-time wait for all IAT HiExp faults:)" VALUE 0x001c42b4 /* @ECU_Address@IAT_HiExp_wait@0x010067E0@ */ ECIPP_ALIGNMENT_ULONG 4294967 Compu_IAT_HiExp_wait 0 4294967.295 /end CHARACTERISTIC
/begin COMPU_METHOD Compu_IAT_HiExp_wait " " RAT_FUNC "%.3" "seconds" COEFFS 0 1000 0 0 0 1 /end COMPU_METHOD
/begin CHARACTERISTIC FP_low "FaultConfig # FP_low (Fault Condition:Non-Common-Rail Primary fuel pressure <)" VALUE 0x001C9F64 /* @ECU_Address@FP_low@0x01006800@ */ ECIPP_ALIGNMENT_UWORD 256 Compu_FP_low 0 255.99609375 /end CHARACTERISTIC
/begin COMPU_METHOD Compu_FP_low " " RAT_FUNC "%.3" "psia" COEFFS 0 256 0 0 0 1 /end COMPU_METHOD
/begin CHARACTERISTIC FP_high "FaultConfig # FP_high (Fault Condition:Non-Common-Rail Primary fuel pressure >)" VALUE 0x001C9F66 /* @ECU_Address@FP_high@0x01006808@ */ ECIPP_ALIGNMENT_UWORD 256 Compu_FP_high 0 255.99609375 /end CHARACTERISTIC
/begin COMPU_METHOD Compu_FP_high " " RAT_FUNC "%.3" "psia" COEFFS 0 256 0 0 0 1 /end COMPU_METHOD
/begin CHARACTERISTIC FP_highlow_wait "FaultConfig # FP_highlow_wait (Fault Condition:run time wait for fuel pressure high/low faults:)" VALUE 0x001C9F60 /* @ECU_Address@FP_highlow_wait@0x01006810@ */ ECIPP_ALIGNMENT_ULONG 4294967 Compu_FP_highlow_wait 0 4294967.295 /end CHARACTERISTIC
/begin COMPU_METHOD Compu_FP_highlow_wait " " RAT_FUNC "%.3" "seconds" COEFFS 0 1000 0 0 0 1 /end COMPU_METHOD
/begin CHARACTERISTIC SHIFT_FB_OOR "IOConfig # SHIFT_FB_OOR (Fault Condition:Absent shaft rotation OR shift position feedback >)" VALUE 0x001e57ea /* @ECU_Address@SHIFT_FB_OOR@0x01006968@ */ ECIPP_ALIGNMENT_UWORD 5 Compu_SHIFT_FB_OOR 0 5.00114468864469 /end CHARACTERISTIC
/begin COMPU_METHOD Compu_SHIFT_FB_OOR " " RAT_FUNC "%.3" "volts" COEFFS 0 13104 0 0 0 1 /end COMPU_METHOD
/begin CHARACTERISTIC SHIFT_FB_OORlo "IOConfig # SHIFT_FB_OORlo (Fault Condition:or <)" VALUE 0x001e57ec /* @ECU_Address@SHIFT_FB_OORlo@0x01006970@ */ ECIPP_ALIGNMENT_UWORD 5 Compu_SHIFT_FB_OORlo 0 5.00114468864469 /end CHARACTERISTIC
/begin COMPU_METHOD Compu_SHIFT_FB_OORlo " " RAT_FUNC "%.3" "volts" COEFFS 0 13104 0 0 0 1 /end COMPU_METHOD
/begin CHARACTERISTIC SHIFT_short_fail "IOConfig # SHIFT_short_fail (Fault Condition:or measured - estimated current >)" VALUE 0x001c4596 /* @ECU_Address@SHIFT_short_fail@0x01006978@ */ ECIPP_ALIGNMENT_SWORD 128 Compu_SHIFT_short_fail -128 127.99609375 /end CHARACTERISTIC
/begin COMPU_METHOD Compu_SHIFT_short_fail " " RAT_FUNC "%.3" "A" COEFFS 0 256 0 0 0 1 /end COMPU_METHOD
/begin CHARACTERISTIC SHIFT_open_fail "IOConfig # SHIFT_open_fail (Fault Condition:or estimated - measured current >)" VALUE 0x001c4594 /* @ECU_Address@SHIFT_open_fail@0x01006980@ */ ECIPP_ALIGNMENT_SWORD 128 Compu_SHIFT_open_fail -128 127.99609375 /end CHARACTERISTIC
/begin COMPU_METHOD Compu_SHIFT_open_fail " " RAT_FUNC "%.3" "A" COEFFS 0 256 0 0 0 1 /end COMPU_METHOD
/begin CHARACTERISTIC SHIFT_intcirc_fail "IOConfig # SHIFT_intcirc_fail (Fault Condition:Internal circuit protection activates >=)" VALUE 0x001c8907 /* @ECU_Address@SHIFT_intcirc_fail@0x01006988@ */ ECIPP_ALIGNMENT_UBYTE 255 Compu_SHIFT_intcirc_fail 0 255 /end CHARACTERISTIC
/begin COMPU_METHOD Compu_SHIFT_intcirc_fail " " RAT_FUNC "%.0" "/ key-cycle" COEFFS 0 1 0 0 0 1 /end COMPU_METHOD
/begin CHARACTERISTIC FTgsln_maxT "Fuel # FTgsln_maxT (Fault Condition:or fuel temp >)" VALUE 0x001c7ba6 /* @ECU_Address@FTgsln_maxT@0x01006A58@ */ ECIPP_ALIGNMENT_UWORD 564 Compu_FTgsln_maxT -460 563.984375 /end CHARACTERISTIC
/begin COMPU_METHOD Compu_FTgsln_maxT " " RAT_FUNC "%.3" "deg F" COEFFS 0 64 29440 0 0 1 /end COMPU_METHOD
/begin CHARACTERISTIC FTgsln_minT "Fuel # FTgsln_minT (Fault Condition:or fuel temp <)" VALUE 0x001c7ba8 /* @ECU_Address@FTgsln_minT@0x01006A60@ */ ECIPP_ALIGNMENT_UWORD 564 Compu_FTgsln_minT -460 563.984375 /end CHARACTERISTIC
/begin COMPU_METHOD Compu_FTgsln_minT " " RAT_FUNC "%.3" "deg F" COEFFS 0 64 29440 0 0 1 /end COMPU_METHOD
/begin CHARACTERISTIC FTgasf_maxT "Fuel # FTgasf_maxT (Fault Condition:or fuel temp >)" VALUE 0x001c7b9c /* @ECU_Address@FTgasf_maxT@0x01006A68@ */ ECIPP_ALIGNMENT_UWORD 564 Compu_FTgasf_maxT -460 563.984375 /end CHARACTERISTIC
/begin COMPU_METHOD Compu_FTgasf_maxT " " RAT_FUNC "%.3" "deg F" COEFFS 0 64 29440 0 0 1 /end COMPU_METHOD
/begin CHARACTERISTIC FTgasf_minT "Fuel # FTgasf_minT (Fault Condition:OR fuel temp <)" VALUE 0x001c7ba2 /* @ECU_Address@FTgasf_minT@0x01006A70@ */ ECIPP_ALIGNMENT_UWORD 564 Compu_FTgasf_minT -460 563.984375 /end CHARACTERISTIC
/begin COMPU_METHOD Compu_FTgasf_minT " " RAT_FUNC "%.3" "deg F" COEFFS 0 64 29440 0 0 1 /end COMPU_METHOD
/begin CHARACTERISTIC FT_fault_mode "{FT_fault_mode&0xff=0:Voltage only}{FT_fault_mode&0xff=1:Temp only}{FT_fault_mode&0xff=2:Voltage or temp} (Fault Condition:FT fault mode)" VALUE 0x001c8745 /* @ECU_Address@FT_fault_mode@0x01006A78@ */ ECIPP_ALIGNMENT_UBYTE 255 FT_fault_mode_COMPU_VTAB 0 255 BIT_MASK 0xff /end CHARACTERISTIC
/begin COMPU_METHOD FT_fault_mode_COMPU_VTAB "Verbal Table" TAB_VERB "%.0" "list" COMPU_TAB_REF FT_fault_mode_COMPU_VTAB_REF /end COMPU_METHOD
/begin COMPU_VTAB FT_fault_mode_COMPU_VTAB_REF "Verbal Table" TAB_VERB 3 0 "Voltage only" 1 "Temp only" 2 "Voltage or temp" DEFAULT_VALUE "UNKNOWN" /end COMPU_VTAB
/begin CHARACTERISTIC inj_count "General # inj_count" VALUE 0x001c9062 /* @ECU_Address@inj_count@0x01006A88@ */ ECIPP_ALIGNMENT_UBYTE 255 Compu_inj_count 0 255 /end CHARACTERISTIC
/begin COMPU_METHOD Compu_inj_count " " RAT_FUNC "%.0" "count" COEFFS 0 1 0 0 0 1 /end COMPU_METHOD
/begin CHARACTERISTIC PW_min_extra "General # PW_min_extra" VALUE 0x001C9F76 /* @ECU_Address@PW_min_extra@0x01006C30@ */ ECIPP_ALIGNMENT_UWORD 210 Compu_PW_min_extra 0 209.712 /end CHARACTERISTIC
/begin COMPU_METHOD Compu_PW_min_extra " " RAT_FUNC "%.3" "ms" COEFFS 0 312.5 0 0 0 1 /end COMPU_METHOD
/begin CHARACTERISTIC PWM_I_FB_dly_us "General # PWM_I_FB_dly_us" VALUE 0x001c7e84 /* @ECU_Address@PWM_I_FB_dly_us@0x01006FF8@ */ ECIPP_ALIGNMENT_UWORD 65535 Compu_PWM_I_FB_dly_us 0 65535 /end CHARACTERISTIC
/begin COMPU_METHOD Compu_PWM_I_FB_dly_us " " RAT_FUNC "%.0" "us" COEFFS 0 1 0 0 0 1 /end COMPU_METHOD
/begin CHARACTERISTIC PWM_I_peak_back_max_us "General # PWM_I_peak_back_max_us" VALUE 0x001c7e86 /* @ECU_Address@PWM_I_peak_back_max_us@0x01007000@ */ ECIPP_ALIGNMENT_UWORD 65535 Compu_PWM_I_peak_back_max_us 0 65535 /end CHARACTERISTIC
/begin COMPU_METHOD Compu_PWM_I_peak_back_max_us " " RAT_FUNC "%.0" "us" COEFFS 0 1 0 0 0 1 /end COMPU_METHOD
/begin CHARACTERISTIC PWM1_short_loDC "FaultConfig # PWM1_short_loDC (Fault Condition:and PWM duty-cycle <)" VALUE 0x001e5776 /* @ECU_Address@PWM1_short_loDC@0x01007048@ */ ECIPP_ALIGNMENT_UWORD 100 Compu_PWM1_short_loDC 0 99.9984741210938 /end CHARACTERISTIC
/begin COMPU_METHOD Compu_PWM1_short_loDC " " RAT_FUNC "%.3" "%" COEFFS 0 655.36 0 0 0 1 /end COMPU_METHOD
/begin CHARACTERISTIC PWM3_short_loDC "FaultConfig # PWM3_short_loDC (Fault Condition:and PWM duty-cycle <)" VALUE 0x001e57aa /* @ECU_Address@PWM3_short_loDC@0x01007050@ */ ECIPP_ALIGNMENT_UWORD 100 Compu_PWM3_short_loDC 0 99.9984741210938 /end CHARACTERISTIC
/begin COMPU_METHOD Compu_PWM3_short_loDC " " RAT_FUNC "%.3" "%" COEFFS 0 655.36 0 0 0 1 /end COMPU_METHOD
/begin CHARACTERISTIC PWM1_short_mA "FaultConfig # PWM1_short_mA (Fault Condition:OR PWM 1 current feedback >)" VALUE 0x001e5778 /* @ECU_Address@PWM1_short_mA@0x01007058@ */ ECIPP_ALIGNMENT_UWORD 65535 Compu_PWM1_short_mA 0 65535 /end CHARACTERISTIC
/begin COMPU_METHOD Compu_PWM1_short_mA " " RAT_FUNC "%.0" "mA" COEFFS 0 1 0 0 0 1 /end COMPU_METHOD
/begin CHARACTERISTIC PWM3_short_mA "FaultConfig # PWM3_short_mA (Fault Condition:OR PWM 3 current feedback >)" VALUE 0x001e57ac /* @ECU_Address@PWM3_short_mA@0x01007060@ */ ECIPP_ALIGNMENT_UWORD 65535 Compu_PWM3_short_mA 0 65535 /end CHARACTERISTIC
/begin COMPU_METHOD Compu_PWM3_short_mA " " RAT_FUNC "%.0" "mA" COEFFS 0 1 0 0 0 1 /end COMPU_METHOD
/begin CHARACTERISTIC ICAV_pct_Ttau "FaultConfig # ICAV_pct_Ttau" VALUE 0x001c7c3e /* @ECU_Address@ICAV_pct_Ttau@0x01007068@ */ ECIPP_ALIGNMENT_UWORD 65535 Compu_ICAV_pct_Ttau 0 65535 /end CHARACTERISTIC
/begin COMPU_METHOD Compu_ICAV_pct_Ttau " " RAT_FUNC "%.0" "100 cycle tau" COEFFS 0 1 0 0 0 1 /end COMPU_METHOD
/begin CHARACTERISTIC ICAV_cyc_diag "FaultConfig # ICAV_cyc_diag" VALUE 0x001c7c28 /* @ECU_Address@ICAV_cyc_diag@0x01007070@ */ ECIPP_ALIGNMENT_UWORD 65535 Compu_ICAV_cyc_diag 0 65535 /end CHARACTERISTIC
/begin COMPU_METHOD Compu_ICAV_cyc_diag " " RAT_FUNC "%.0" "cycles" COEFFS 0 1 0 0 0 1 /end COMPU_METHOD
/begin CHARACTERISTIC SPK_int_fail_loV "Spark # SPK_int_fail_loV (Fault Condition:spark module diagnostic feedback <)" VALUE 0x001c7f72 /* @ECU_Address@SPK_int_fail_loV@0x01007080@ */ ECIPP_ALIGNMENT_UWORD 5 Compu_SPK_int_fail_loV 0 5.00114468864469 /end CHARACTERISTIC
/begin COMPU_METHOD Compu_SPK_int_fail_loV " " RAT_FUNC "%.3" "volts" COEFFS 0 13104 0 0 0 1 /end COMPU_METHOD
/begin CHARACTERISTIC SPK_int_fail_hiV "Spark # SPK_int_fail_hiV (Fault Condition:or >)" VALUE 0x001c7f70 /* @ECU_Address@SPK_int_fail_hiV@0x01007088@ */ ECIPP_ALIGNMENT_UWORD 5 Compu_SPK_int_fail_hiV 0 5.00114468864469 /end CHARACTERISTIC
/begin COMPU_METHOD Compu_SPK_int_fail_hiV " " RAT_FUNC "%.3" "volts" COEFFS 0 13104 0 0 0 1 /end COMPU_METHOD
/begin CHARACTERISTIC FPP_diffout_ena "{FPP_diffout_ena&0xff=0:Disabled}{FPP_diffout_ena&0xff=1:Enabled}" VALUE 0x001c8720 /* @ECU_Address@FPP_diffout_ena@0x010070A8@ */ ECIPP_ALIGNMENT_UBYTE 255 FPP_diffout_ena_COMPU_VTAB 0 255 BIT_MASK 0xff /end CHARACTERISTIC
/begin COMPU_METHOD FPP_diffout_ena_COMPU_VTAB "Verbal Table" TAB_VERB "%.0" "list" COMPU_TAB_REF FPP_diffout_ena_COMPU_VTAB_REF /end COMPU_METHOD
/begin COMPU_VTAB FPP_diffout_ena_COMPU_VTAB_REF "Verbal Table" TAB_VERB 2 0 "Disabled" 1 "Enabled" DEFAULT_VALUE "UNKNOWN" /end COMPU_VTAB
/begin CHARACTERISTIC SPK_int_fail_wt "Spark # SPK_int_fail_wt (Fault Condition:and engine run time >)" VALUE 0x001c438c /* @ECU_Address@SPK_int_fail_wt@0x010070D8@ */ ECIPP_ALIGNMENT_ULONG 4294967 Compu_SPK_int_fail_wt 0 4294967.295 /end CHARACTERISTIC
/begin COMPU_METHOD Compu_SPK_int_fail_wt " " RAT_FUNC "%.3" "sec" COEFFS 0 1000 0 0 0 1 /end COMPU_METHOD
/begin CHARACTERISTIC SPK_coil_fail_loV "Spark # SPK_coil_fail_loV (Fault Condition:spark module diagnostic feedback <)" VALUE 0x001c7f6e /* @ECU_Address@SPK_coil_fail_loV@0x010070F0@ */ ECIPP_ALIGNMENT_UWORD 5 Compu_SPK_coil_fail_loV 0 5.00114468864469 /end CHARACTERISTIC
/begin COMPU_METHOD Compu_SPK_coil_fail_loV " " RAT_FUNC "%.3" "volts" COEFFS 0 13104 0 0 0 1 /end COMPU_METHOD
/begin CHARACTERISTIC SPK_coil_fail_hiV "Spark # SPK_coil_fail_hiV (Fault Condition:and >)" VALUE 0x001c7f6c /* @ECU_Address@SPK_coil_fail_hiV@0x010070F8@ */ ECIPP_ALIGNMENT_UWORD 5 Compu_SPK_coil_fail_hiV 0 5.00114468864469 /end CHARACTERISTIC
/begin COMPU_METHOD Compu_SPK_coil_fail_hiV " " RAT_FUNC "%.3" "volts" COEFFS 0 13104 0 0 0 1 /end COMPU_METHOD
/begin CHARACTERISTIC SPK_coil_fail_wt "Spark # SPK_coil_fail_wt (Fault Condition:and engine run time >)" VALUE 0x001c4388 /* @ECU_Address@SPK_coil_fail_wt@0x01007100@ */ ECIPP_ALIGNMENT_ULONG 4294967 Compu_SPK_coil_fail_wt 0 4294967.295 /end CHARACTERISTIC
/begin COMPU_METHOD Compu_SPK_coil_fail_wt " " RAT_FUNC "%.3" "sec" COEFFS 0 1000 0 0 0 1 /end COMPU_METHOD
/begin CHARACTERISTIC SPKD_open_loA "Spark # SPKD_open_loA (Fault Condition:final current <)" VALUE 0x001c45a0 /* @ECU_Address@SPKD_open_loA@0x01007110@ */ ECIPP_ALIGNMENT_SWORD 32 Compu_SPKD_open_loA -32 31.9990234375 /end CHARACTERISTIC
/begin COMPU_METHOD Compu_SPKD_open_loA " " RAT_FUNC "%.3" "amps" COEFFS 0 1024 0 0 0 1 /end COMPU_METHOD
/begin CHARACTERISTIC SPKD_short_hiA "Spark # SPKD_short_hiA (Fault Condition:initial current >)" VALUE 0x001c45a2 /* @ECU_Address@SPKD_short_hiA@0x01007118@ */ ECIPP_ALIGNMENT_SWORD 32 Compu_SPKD_short_hiA -32 31.9990234375 /end CHARACTERISTIC
/begin COMPU_METHOD Compu_SPKD_short_hiA " " RAT_FUNC "%.3" "amps" COEFFS 0 1024 0 0 0 1 /end COMPU_METHOD
/begin CHARACTERISTIC SPKD_extmod_Vmin "Spark # SPKD_extmod_Vmin (Fault Condition:External spark module voltage >)" VALUE 0x001c7f68 /* @ECU_Address@SPKD_extmod_Vmin@0x01007120@ */ ECIPP_ALIGNMENT_UWORD 256 Compu_SPKD_extmod_Vmin 0 255.99609375 /end CHARACTERISTIC
/begin COMPU_METHOD Compu_SPKD_extmod_Vmin " " RAT_FUNC "%.3" "volts" COEFFS 0 256 0 0 0 1 /end COMPU_METHOD
/begin CHARACTERISTIC dwell_open_crkmax "Spark # dwell_open_crkmax (Fault Condition:and crank dwell (external module only) <)" VALUE 0x001c8426 /* @ECU_Address@dwell_open_crkmax@0x01007138@ */ ECIPP_ALIGNMENT_UWORD 1678 Compu_dwell_open_crkmax 0 1677.696 /end CHARACTERISTIC
/begin COMPU_METHOD Compu_dwell_open_crkmax " " RAT_FUNC "%.3" "ms" COEFFS 0 39.0625 0 0 0 1 /end COMPU_METHOD
/begin CHARACTERISTIC EGOH1_off_loVf "FaultConfig # EGOH1_off_loVf (Fault Condition:EGOH1 low-side feedback <)" VALUE 0x001e381c /* @ECU_Address@EGOH1_off_loVf@0x010071F0@ */ ECIPP_ALIGNMENT_UWORD 100 Compu_EGOH1_off_loVf 0 99.9984741210938 /end CHARACTERISTIC
/begin COMPU_METHOD Compu_EGOH1_off_loVf " " RAT_FUNC "%.3" "% Vbat" COEFFS 0 655.36 0 0 0 1 /end COMPU_METHOD
/begin CHARACTERISTIC EGOH2_off_loVf "FaultConfig # EGOH2_off_loVf (Fault Condition:EGOH2 low-side feedback <)" VALUE 0x001e3824 /* @ECU_Address@EGOH2_off_loVf@0x010071F8@ */ ECIPP_ALIGNMENT_UWORD 100 Compu_EGOH2_off_loVf 0 99.9984741210938 /end CHARACTERISTIC
/begin COMPU_METHOD Compu_EGOH2_off_loVf " " RAT_FUNC "%.3" "% Vbat" COEFFS 0 655.36 0 0 0 1 /end COMPU_METHOD
/begin CHARACTERISTIC EGOH3_off_loVf "FaultConfig # EGOH3_off_loVf (Fault Condition:EGOH3 low-side feedback <)" VALUE 0x001e382c /* @ECU_Address@EGOH3_off_loVf@0x01007200@ */ ECIPP_ALIGNMENT_UWORD 100 Compu_EGOH3_off_loVf 0 99.9984741210938 /end CHARACTERISTIC
/begin COMPU_METHOD Compu_EGOH3_off_loVf " " RAT_FUNC "%.3" "% Vbat" COEFFS 0 655.36 0 0 0 1 /end COMPU_METHOD
/begin CHARACTERISTIC EGOH4_off_loVf "FaultConfig # EGOH4_off_loVf (Fault Condition:EGOH4 low-side feedback <)" VALUE 0x001e3834 /* @ECU_Address@EGOH4_off_loVf@0x01007208@ */ ECIPP_ALIGNMENT_UWORD 100 Compu_EGOH4_off_loVf 0 99.9984741210938 /end CHARACTERISTIC
/begin COMPU_METHOD Compu_EGOH4_off_loVf " " RAT_FUNC "%.3" "% Vbat" COEFFS 0 655.36 0 0 0 1 /end COMPU_METHOD
/begin CHARACTERISTIC EGOH1_on_hiVf "FaultConfig # EGOH1_on_hiVf (Fault Condition:EGOH1 low-side feedback >)" VALUE 0x001e3820 /* @ECU_Address@EGOH1_on_hiVf@0x01007210@ */ ECIPP_ALIGNMENT_UWORD 100 Compu_EGOH1_on_hiVf 0 99.9984741210938 /end CHARACTERISTIC
/begin COMPU_METHOD Compu_EGOH1_on_hiVf " " RAT_FUNC "%.3" "% Vbat" COEFFS 0 655.36 0 0 0 1 /end COMPU_METHOD
/begin CHARACTERISTIC EGOH2_on_hiVf "FaultConfig # EGOH2_on_hiVf (Fault Condition:EGOH2 low-side feedback >)" VALUE 0x001e3828 /* @ECU_Address@EGOH2_on_hiVf@0x01007218@ */ ECIPP_ALIGNMENT_UWORD 100 Compu_EGOH2_on_hiVf 0 99.9984741210938 /end CHARACTERISTIC
/begin COMPU_METHOD Compu_EGOH2_on_hiVf " " RAT_FUNC "%.3" "% Vbat" COEFFS 0 655.36 0 0 0 1 /end COMPU_METHOD
/begin CHARACTERISTIC EGOH3_on_hiVf "FaultConfig # EGOH3_on_hiVf (Fault Condition:EGOH3 low-side feedback >)" VALUE 0x001e3830 /* @ECU_Address@EGOH3_on_hiVf@0x01007220@ */ ECIPP_ALIGNMENT_UWORD 100 Compu_EGOH3_on_hiVf 0 99.9984741210938 /end CHARACTERISTIC
/begin COMPU_METHOD Compu_EGOH3_on_hiVf " " RAT_FUNC "%.3" "% Vbat" COEFFS 0 655.36 0 0 0 1 /end COMPU_METHOD
/begin CHARACTERISTIC EGOH4_on_hiVf "FaultConfig # EGOH4_on_hiVf (Fault Condition:EGOH4 low-side feedback >)" VALUE 0x001e3838 /* @ECU_Address@EGOH4_on_hiVf@0x01007228@ */ ECIPP_ALIGNMENT_UWORD 100 Compu_EGOH4_on_hiVf 0 99.9984741210938 /end CHARACTERISTIC
/begin COMPU_METHOD Compu_EGOH4_on_hiVf " " RAT_FUNC "%.3" "% Vbat" COEFFS 0 655.36 0 0 0 1 /end COMPU_METHOD
/begin CHARACTERISTIC EGOH1_off_loDC "FaultConfig # EGOH1_off_loDC (Fault Condition:and PWM duty-cycle <)" VALUE 0x001e381a /* @ECU_Address@EGOH1_off_loDC@0x01007230@ */ ECIPP_ALIGNMENT_UWORD 100 Compu_EGOH1_off_loDC 0 99.9984741210938 /end CHARACTERISTIC
/begin COMPU_METHOD Compu_EGOH1_off_loDC " " RAT_FUNC "%.3" "%" COEFFS 0 655.36 0 0 0 1 /end COMPU_METHOD
/begin CHARACTERISTIC EGOH2_off_loDC "FaultConfig # EGOH2_off_loDC (Fault Condition:and PWM duty-cycle <)" VALUE 0x001e3822 /* @ECU_Address@EGOH2_off_loDC@0x01007238@ */ ECIPP_ALIGNMENT_UWORD 100 Compu_EGOH2_off_loDC 0 99.9984741210938 /end CHARACTERISTIC
/begin COMPU_METHOD Compu_EGOH2_off_loDC " " RAT_FUNC "%.3" "%" COEFFS 0 655.36 0 0 0 1 /end COMPU_METHOD
/begin CHARACTERISTIC EGOH3_off_loDC "FaultConfig # EGOH3_off_loDC (Fault Condition:and PWM duty-cycle <)" VALUE 0x001e382a /* @ECU_Address@EGOH3_off_loDC@0x01007240@ */ ECIPP_ALIGNMENT_UWORD 100 Compu_EGOH3_off_loDC 0 99.9984741210938 /end CHARACTERISTIC
/begin COMPU_METHOD Compu_EGOH3_off_loDC " " RAT_FUNC "%.3" "%" COEFFS 0 655.36 0 0 0 1 /end COMPU_METHOD
/begin CHARACTERISTIC EGOH4_off_loDC "FaultConfig # EGOH4_off_loDC (Fault Condition:and PWM duty-cycle <)" VALUE 0x001e3832 /* @ECU_Address@EGOH4_off_loDC@0x01007248@ */ ECIPP_ALIGNMENT_UWORD 100 Compu_EGOH4_off_loDC 0 99.9984741210938 /end CHARACTERISTIC
/begin COMPU_METHOD Compu_EGOH4_off_loDC " " RAT_FUNC "%.3" "%" COEFFS 0 655.36 0 0 0 1 /end COMPU_METHOD
/begin CHARACTERISTIC EGOH1_on_hiDC "FaultConfig # EGOH1_on_hiDC (Fault Condition:and PWM duty-cycle >)" VALUE 0x001e381e /* @ECU_Address@EGOH1_on_hiDC@0x01007250@ */ ECIPP_ALIGNMENT_UWORD 100 Compu_EGOH1_on_hiDC 0 99.9984741210938 /end CHARACTERISTIC
/begin COMPU_METHOD Compu_EGOH1_on_hiDC " " RAT_FUNC "%.3" "%" COEFFS 0 655.36 0 0 0 1 /end COMPU_METHOD
/begin CHARACTERISTIC EGOH2_on_hiDC "FaultConfig # EGOH2_on_hiDC (Fault Condition:and PWM duty-cycle >)" VALUE 0x001e3826 /* @ECU_Address@EGOH2_on_hiDC@0x01007258@ */ ECIPP_ALIGNMENT_UWORD 100 Compu_EGOH2_on_hiDC 0 99.9984741210938 /end CHARACTERISTIC
/begin COMPU_METHOD Compu_EGOH2_on_hiDC " " RAT_FUNC "%.3" "%" COEFFS 0 655.36 0 0 0 1 /end COMPU_METHOD
/begin CHARACTERISTIC EGOH3_on_hiDC "FaultConfig # EGOH3_on_hiDC (Fault Condition:and PWM duty-cycle >)" VALUE 0x001e382e /* @ECU_Address@EGOH3_on_hiDC@0x01007260@ */ ECIPP_ALIGNMENT_UWORD 100 Compu_EGOH3_on_hiDC 0 99.9984741210938 /end CHARACTERISTIC
/begin COMPU_METHOD Compu_EGOH3_on_hiDC " " RAT_FUNC "%.3" "%" COEFFS 0 655.36 0 0 0 1 /end COMPU_METHOD
/begin CHARACTERISTIC EGOH4_on_hiDC "FaultConfig # EGOH4_on_hiDC (Fault Condition:and PWM duty-cycle >)" VALUE 0x001e3836 /* @ECU_Address@EGOH4_on_hiDC@0x01007268@ */ ECIPP_ALIGNMENT_UWORD 100 Compu_EGOH4_on_hiDC 0 99.9984741210938 /end CHARACTERISTIC
/begin COMPU_METHOD Compu_EGOH4_on_hiDC " " RAT_FUNC "%.3" "%" COEFFS 0 655.36 0 0 0 1 /end COMPU_METHOD
/begin CHARACTERISTIC RELAY_keyoff_chk "{RELAY_keyoff_chk&0xff=0:Disabled}{RELAY_keyoff_chk&0xff=1:Enabled} (Fault Condition:Relay key-off fault checking)" VALUE 0x001c88bd /* @ECU_Address@RELAY_keyoff_chk@0x01007270@ */ ECIPP_ALIGNMENT_UBYTE 255 RELAY_keyoff_chk_COMPU_VTAB 0 255 BIT_MASK 0xff /end CHARACTERISTIC
/begin COMPU_METHOD RELAY_keyoff_chk_COMPU_VTAB "Verbal Table" TAB_VERB "%.0" "list" COMPU_TAB_REF RELAY_keyoff_chk_COMPU_VTAB_REF /end COMPU_METHOD
/begin COMPU_VTAB RELAY_keyoff_chk_COMPU_VTAB_REF "Verbal Table" TAB_VERB 2 0 "Disabled" 1 "Enabled" DEFAULT_VALUE "UNKNOWN" /end COMPU_VTAB
/begin CHARACTERISTIC drivebrake_off_loVf "FaultConfig # drivebrake_off_loVf (Fault Condition:Low-side feedback <)" VALUE 0x001e58d0 /* @ECU_Address@drivebrake_off_loVf@0x010072B8@ */ ECIPP_ALIGNMENT_UWORD 100 Compu_drivebrake_off_loVf 0 99.9984741210938 /end CHARACTERISTIC
/begin COMPU_METHOD Compu_drivebrake_off_loVf " " RAT_FUNC "%.3" "% Vbat" COEFFS 0 655.36 0 0 0 1 /end COMPU_METHOD
/begin CHARACTERISTIC drivebrake_on_hiVf "FaultConfig # drivebrake_on_hiVf (Fault Condition:Low-side feedback >)" VALUE 0x001e58d2 /* @ECU_Address@drivebrake_on_hiVf@0x010072C0@ */ ECIPP_ALIGNMENT_UWORD 100 Compu_drivebrake_on_hiVf 0 99.9984741210938 /end CHARACTERISTIC
/begin COMPU_METHOD Compu_drivebrake_on_hiVf " " RAT_FUNC "%.3" "% Vbat" COEFFS 0 655.36 0 0 0 1 /end COMPU_METHOD
/begin CHARACTERISTIC UGF_run_wait "FaultConfig # UGF_run_wait (Fault Condition:or warmup period and an additional)" VALUE 0x001c43f0 /* @ECU_Address@UGF_run_wait@0x010076F0@ */ ECIPP_ALIGNMENT_ULONG 4294967 Compu_UGF_run_wait 0 4294967.295 /end CHARACTERISTIC
/begin COMPU_METHOD Compu_UGF_run_wait " " RAT_FUNC "%.3" "seconds" COEFFS 0 1000 0 0 0 1 /end COMPU_METHOD
/begin CHARACTERISTIC APUD5_max "FaultConfig # APUD5_max (Fault Condition:AUX analog PUD5 >)" VALUE 0x001e37b0 /* @ECU_Address@APUD5_max@0x010076F8@ */ ECIPP_ALIGNMENT_UWORD 5 Compu_APUD5_max 0 5.00114468864469 /end CHARACTERISTIC
/begin COMPU_METHOD Compu_APUD5_max " " RAT_FUNC "%.3" "volts" COEFFS 0 13104 0 0 0 1 /end COMPU_METHOD
/begin CHARACTERISTIC APUD5_min "FaultConfig # APUD5_min (Fault Condition:AUX analog PUD5 <)" VALUE 0x001e37b2 /* @ECU_Address@APUD5_min@0x01007700@ */ ECIPP_ALIGNMENT_UWORD 5 Compu_APUD5_min 0 5.00114468864469 /end CHARACTERISTIC
/begin COMPU_METHOD Compu_APUD5_min " " RAT_FUNC "%.3" "volts" COEFFS 0 13104 0 0 0 1 /end COMPU_METHOD
/begin CHARACTERISTIC APUD6_max "FaultConfig # APUD6_max (Fault Condition:AUX analog PUD6 >)" VALUE 0x001e37b4 /* @ECU_Address@APUD6_max@0x01007708@ */ ECIPP_ALIGNMENT_UWORD 5 Compu_APUD6_max 0 5.00114468864469 /end CHARACTERISTIC
/begin COMPU_METHOD Compu_APUD6_max " " RAT_FUNC "%.3" "volts" COEFFS 0 13104 0 0 0 1 /end COMPU_METHOD
/begin CHARACTERISTIC APUD6_min "FaultConfig # APUD6_min (Fault Condition:AUX analog PUD6 <)" VALUE 0x001e37b6 /* @ECU_Address@APUD6_min@0x01007710@ */ ECIPP_ALIGNMENT_UWORD 5 Compu_APUD6_min 0 5.00114468864469 /end CHARACTERISTIC
/begin COMPU_METHOD Compu_APUD6_min " " RAT_FUNC "%.3" "volts" COEFFS 0 13104 0 0 0 1 /end COMPU_METHOD
/begin CHARACTERISTIC APUD7_max "FaultConfig # APUD7_max (Fault Condition:AUX analog PUD7 >)" VALUE 0x001e37b8 /* @ECU_Address@APUD7_max@0x01007718@ */ ECIPP_ALIGNMENT_UWORD 5 Compu_APUD7_max 0 5.00114468864469 /end CHARACTERISTIC
/begin COMPU_METHOD Compu_APUD7_max " " RAT_FUNC "%.3" "volts" COEFFS 0 13104 0 0 0 1 /end COMPU_METHOD
/begin CHARACTERISTIC APUD7_min "FaultConfig # APUD7_min (Fault Condition:AUX analog PUD7 <)" VALUE 0x001e37ba /* @ECU_Address@APUD7_min@0x01007720@ */ ECIPP_ALIGNMENT_UWORD 5 Compu_APUD7_min 0 5.00114468864469 /end CHARACTERISTIC
/begin COMPU_METHOD Compu_APUD7_min " " RAT_FUNC "%.3" "volts" COEFFS 0 13104 0 0 0 1 /end COMPU_METHOD
/begin CHARACTERISTIC ADIG4_max "FaultConfig # ADIG4_max (Fault Condition:AUX DIG4 >)" VALUE 0x001e3730 /* @ECU_Address@ADIG4_max@0x01007728@ */ ECIPP_ALIGNMENT_UWORD 256 Compu_ADIG4_max 0 255.99609375 /end CHARACTERISTIC
/begin COMPU_METHOD Compu_ADIG4_max " " RAT_FUNC "%.3" "volts" COEFFS 0 256 0 0 0 1 /end COMPU_METHOD
/begin CHARACTERISTIC ADIG4_min "FaultConfig # ADIG4_min (Fault Condition:AUX DIG4 <)" VALUE 0x001e3732 /* @ECU_Address@ADIG4_min@0x01007730@ */ ECIPP_ALIGNMENT_UWORD 256 Compu_ADIG4_min 0 255.99609375 /end CHARACTERISTIC
/begin COMPU_METHOD Compu_ADIG4_min " " RAT_FUNC "%.3" "volts" COEFFS 0 256 0 0 0 1 /end COMPU_METHOD
/begin CHARACTERISTIC ADIG5_max "FaultConfig # ADIG5_max (Fault Condition:AUX DIG5 >)" VALUE 0x001e3734 /* @ECU_Address@ADIG5_max@0x01007738@ */ ECIPP_ALIGNMENT_UWORD 256 Compu_ADIG5_max 0 255.99609375 /end CHARACTERISTIC
/begin COMPU_METHOD Compu_ADIG5_max " " RAT_FUNC "%.3" "volts" COEFFS 0 256 0 0 0 1 /end COMPU_METHOD
/begin CHARACTERISTIC ADIG5_min "FaultConfig # ADIG5_min (Fault Condition:AUX DIG5 <)" VALUE 0x001e3736 /* @ECU_Address@ADIG5_min@0x01007740@ */ ECIPP_ALIGNMENT_UWORD 256 Compu_ADIG5_min 0 255.99609375 /end CHARACTERISTIC
/begin COMPU_METHOD Compu_ADIG5_min " " RAT_FUNC "%.3" "volts" COEFFS 0 256 0 0 0 1 /end COMPU_METHOD
/begin CHARACTERISTIC ADIG6_max "FaultConfig # ADIG6_max (Fault Condition:AUX DIG6 >)" VALUE 0x001e3738 /* @ECU_Address@ADIG6_max@0x01007748@ */ ECIPP_ALIGNMENT_UWORD 256 Compu_ADIG6_max 0 255.99609375 /end CHARACTERISTIC
/begin COMPU_METHOD Compu_ADIG6_max " " RAT_FUNC "%.3" "volts" COEFFS 0 256 0 0 0 1 /end COMPU_METHOD
/begin CHARACTERISTIC ADIG6_min "FaultConfig # ADIG6_min (Fault Condition:AUX DIG6 <)" VALUE 0x001e373a /* @ECU_Address@ADIG6_min@0x01007750@ */ ECIPP_ALIGNMENT_UWORD 256 Compu_ADIG6_min 0 255.99609375 /end CHARACTERISTIC
/begin COMPU_METHOD Compu_ADIG6_min " " RAT_FUNC "%.3" "volts" COEFFS 0 256 0 0 0 1 /end COMPU_METHOD
/begin CHARACTERISTIC ADIG7_max "FaultConfig # ADIG7_max (Fault Condition:AUX DIG7 >)" VALUE 0x001e373c /* @ECU_Address@ADIG7_max@0x01007758@ */ ECIPP_ALIGNMENT_UWORD 256 Compu_ADIG7_max 0 255.99609375 /end CHARACTERISTIC
/begin COMPU_METHOD Compu_ADIG7_max " " RAT_FUNC "%.3" "volts" COEFFS 0 256 0 0 0 1 /end COMPU_METHOD
/begin CHARACTERISTIC ADIG7_min "FaultConfig # ADIG7_min (Fault Condition:AUX DIG7 <)" VALUE 0x001e373e /* @ECU_Address@ADIG7_min@0x01007760@ */ ECIPP_ALIGNMENT_UWORD 256 Compu_ADIG7_min 0 255.99609375 /end CHARACTERISTIC
/begin COMPU_METHOD Compu_ADIG7_min " " RAT_FUNC "%.3" "volts" COEFFS 0 256 0 0 0 1 /end COMPU_METHOD
/begin CHARACTERISTIC ADIG8_max "FaultConfig # ADIG8_max (Fault Condition:AUX DIG8 >)" VALUE 0x001e3740 /* @ECU_Address@ADIG8_max@0x01007768@ */ ECIPP_ALIGNMENT_UWORD 256 Compu_ADIG8_max 0 255.99609375 /end CHARACTERISTIC
/begin COMPU_METHOD Compu_ADIG8_max " " RAT_FUNC "%.3" "volts" COEFFS 0 256 0 0 0 1 /end COMPU_METHOD
/begin CHARACTERISTIC ADIG8_min "FaultConfig # ADIG8_min (Fault Condition:AUX DIG8 <)" VALUE 0x001e3742 /* @ECU_Address@ADIG8_min@0x01007770@ */ ECIPP_ALIGNMENT_UWORD 256 Compu_ADIG8_min 0 255.99609375 /end CHARACTERISTIC
/begin COMPU_METHOD Compu_ADIG8_min " " RAT_FUNC "%.3" "volts" COEFFS 0 256 0 0 0 1 /end COMPU_METHOD
/begin CHARACTERISTIC ADIG9_max "FaultConfig # ADIG9_max (Fault Condition:AUX DIG9 >)" VALUE 0x001e3744 /* @ECU_Address@ADIG9_max@0x01007778@ */ ECIPP_ALIGNMENT_UWORD 256 Compu_ADIG9_max 0 255.99609375 /end CHARACTERISTIC
/begin COMPU_METHOD Compu_ADIG9_max " " RAT_FUNC "%.3" "volts" COEFFS 0 256 0 0 0 1 /end COMPU_METHOD
/begin CHARACTERISTIC ADIG9_min "FaultConfig # ADIG9_min (Fault Condition:AUX DIG9 <)" VALUE 0x001e3746 /* @ECU_Address@ADIG9_min@0x01007780@ */ ECIPP_ALIGNMENT_UWORD 256 Compu_ADIG9_min 0 255.99609375 /end CHARACTERISTIC
/begin COMPU_METHOD Compu_ADIG9_min " " RAT_FUNC "%.3" "volts" COEFFS 0 256 0 0 0 1 /end COMPU_METHOD
/begin CHARACTERISTIC ADIG10_max "FaultConfig # ADIG10_max (Fault Condition:AUX DIG10 >)" VALUE 0x001e36e4 /* @ECU_Address@ADIG10_max@0x01007788@ */ ECIPP_ALIGNMENT_UWORD 256 Compu_ADIG10_max 0 255.99609375 /end CHARACTERISTIC
/begin COMPU_METHOD Compu_ADIG10_max " " RAT_FUNC "%.3" "volts" COEFFS 0 256 0 0 0 1 /end COMPU_METHOD
/begin CHARACTERISTIC ADIG10_min "FaultConfig # ADIG10_min (Fault Condition:AUX DIG10 <)" VALUE 0x001e36e6 /* @ECU_Address@ADIG10_min@0x01007790@ */ ECIPP_ALIGNMENT_UWORD 256 Compu_ADIG10_min 0 255.99609375 /end CHARACTERISTIC
/begin COMPU_METHOD Compu_ADIG10_min " " RAT_FUNC "%.3" "volts" COEFFS 0 256 0 0 0 1 /end COMPU_METHOD
/begin CHARACTERISTIC MIL_off_loVf "FaultConfig # MIL_off_loVf (Fault Condition:Low-side feedback <)" VALUE 0x001e5716 /* @ECU_Address@MIL_off_loVf@0x01007798@ */ ECIPP_ALIGNMENT_UWORD 100 Compu_MIL_off_loVf 0 99.9984741210938 /end CHARACTERISTIC
/begin COMPU_METHOD Compu_MIL_off_loVf " " RAT_FUNC "%.3" "% Vbat" COEFFS 0 655.36 0 0 0 1 /end COMPU_METHOD
/begin CHARACTERISTIC START_off_loVf "FaultConfig # START_off_loVf (Fault Condition:Low-side feedback <)" VALUE 0x001c7fc0 /* @ECU_Address@START_off_loVf@0x010077A0@ */ ECIPP_ALIGNMENT_UWORD 100 Compu_START_off_loVf 0 99.9984741210938 /end CHARACTERISTIC
/begin COMPU_METHOD Compu_START_off_loVf " " RAT_FUNC "%.3" "% Vbat" COEFFS 0 655.36 0 0 0 1 /end COMPU_METHOD
/begin CHARACTERISTIC TACH_off_loVf "FaultConfig # TACH_off_loVf (Fault Condition:Low-side feedback <)" VALUE 0x001e57ee /* @ECU_Address@TACH_off_loVf@0x010077A8@ */ ECIPP_ALIGNMENT_UWORD 100 Compu_TACH_off_loVf 0 99.9984741210938 /end CHARACTERISTIC
/begin COMPU_METHOD Compu_TACH_off_loVf " " RAT_FUNC "%.3" "% Vbat" COEFFS 0 655.36 0 0 0 1 /end COMPU_METHOD
/begin CHARACTERISTIC RELAY_off_loVf "FaultConfig # RELAY_off_loVf (Fault Condition:Low-side feedback <)" VALUE 0x001c7e9a /* @ECU_Address@RELAY_off_loVf@0x010077B0@ */ ECIPP_ALIGNMENT_UWORD 100 Compu_RELAY_off_loVf 0 99.9984741210938 /end CHARACTERISTIC
/begin COMPU_METHOD Compu_RELAY_off_loVf " " RAT_FUNC "%.3" "% Vbat" COEFFS 0 655.36 0 0 0 1 /end COMPU_METHOD
/begin CHARACTERISTIC MIL_on_hiVf "FaultConfig # MIL_on_hiVf (Fault Condition:Low-side feedback >)" VALUE 0x001e5718 /* @ECU_Address@MIL_on_hiVf@0x010077B8@ */ ECIPP_ALIGNMENT_UWORD 100 Compu_MIL_on_hiVf 0 99.9984741210938 /end CHARACTERISTIC
/begin COMPU_METHOD Compu_MIL_on_hiVf " " RAT_FUNC "%.3" "% Vbat" COEFFS 0 655.36 0 0 0 1 /end COMPU_METHOD
/begin CHARACTERISTIC START_on_hiVf "FaultConfig # START_on_hiVf (Fault Condition:Output feedback >)" VALUE 0x001c7fc2 /* @ECU_Address@START_on_hiVf@0x010077C0@ */ ECIPP_ALIGNMENT_UWORD 100 Compu_START_on_hiVf 0 99.9984741210938 /end CHARACTERISTIC
/begin COMPU_METHOD Compu_START_on_hiVf " " RAT_FUNC "%.3" "% Vbat" COEFFS 0 655.36 0 0 0 1 /end COMPU_METHOD
/begin CHARACTERISTIC TACH_on_hiVf "FaultConfig # TACH_on_hiVf (Fault Condition:Low-side feedback >)" VALUE 0x001e57f0 /* @ECU_Address@TACH_on_hiVf@0x010077C8@ */ ECIPP_ALIGNMENT_UWORD 100 Compu_TACH_on_hiVf 0 99.9984741210938 /end CHARACTERISTIC
/begin COMPU_METHOD Compu_TACH_on_hiVf " " RAT_FUNC "%.3" "% Vbat" COEFFS 0 655.36 0 0 0 1 /end COMPU_METHOD
/begin CHARACTERISTIC RELAY_on_hiVf "FaultConfig # RELAY_on_hiVf (Fault Condition:Low-side feedback >)" VALUE 0x001c7e9c /* @ECU_Address@RELAY_on_hiVf@0x010077D0@ */ ECIPP_ALIGNMENT_UWORD 100 Compu_RELAY_on_hiVf 0 99.9984741210938 /end CHARACTERISTIC
/begin COMPU_METHOD Compu_RELAY_on_hiVf " " RAT_FUNC "%.3" "% Vbat" COEFFS 0 655.36 0 0 0 1 /end COMPU_METHOD
/begin CHARACTERISTIC fuelclr_gaseous "{fuelclr_gaseous&0xff=0:Injection only}{fuelclr_gaseous&0xff=1:Injection + Carburetion}" VALUE 0x001ecca0 /* @ECU_Address@fuelclr_gaseous@0x010077E8@ */ ECIPP_ALIGNMENT_UBYTE 255 fuelclr_gaseous_COMPU_VTAB 0 255 BIT_MASK 0xff /end CHARACTERISTIC
/begin COMPU_METHOD fuelclr_gaseous_COMPU_VTAB "Verbal Table" TAB_VERB "%.0" "list" COMPU_TAB_REF fuelclr_gaseous_COMPU_VTAB_REF /end COMPU_METHOD
/begin COMPU_VTAB fuelclr_gaseous_COMPU_VTAB_REF "Verbal Table" TAB_VERB 2 0 "Injection only" 1 "Injection + Carburetion" DEFAULT_VALUE "UNKNOWN" /end COMPU_VTAB
/begin CHARACTERISTIC FP_fault_mode "{FP_fault_mode&0xff=0:Gasoline + Gaseous}{FP_fault_mode&0xff=1:Gasoline only}{FP_fault_mode&0xff=2:Gaseous only} (Fault Condition:Primary FP fault mode)" VALUE 0x001C9F88 /* @ECU_Address@FP_fault_mode@0x01007858@ */ ECIPP_ALIGNMENT_UBYTE 255 FP_fault_mode_COMPU_VTAB 0 255 BIT_MASK 0xff /end CHARACTERISTIC
/begin COMPU_METHOD FP_fault_mode_COMPU_VTAB "Verbal Table" TAB_VERB "%.0" "list" COMPU_TAB_REF FP_fault_mode_COMPU_VTAB_REF /end COMPU_METHOD
/begin COMPU_VTAB FP_fault_mode_COMPU_VTAB_REF "Verbal Table" TAB_VERB 3 0 "Gasoline + Gaseous" 1 "Gasoline only" 2 "Gaseous only" DEFAULT_VALUE "UNKNOWN" /end COMPU_VTAB
/begin CHARACTERISTIC rpm_hi_expected "FaultConfig # rpm_hi_expected (Fault Condition:rpm >)" VALUE 0x001c84c0 /* @ECU_Address@rpm_hi_expected@0x01007868@ */ ECIPP_ALIGNMENT_UWORD 65535 Compu_rpm_hi_expected 0 65535 /end CHARACTERISTIC
/begin COMPU_METHOD Compu_rpm_hi_expected " " RAT_FUNC "%.0" "rpm" COEFFS 0 1 0 0 0 1 /end COMPU_METHOD
/begin CHARACTERISTIC RS_loss_slowPWM "{RS_loss_slowPWM&0xff=0:Not required}{RS_loss_slowPWM&0xff=1:Required} (Fault Condition:and slow PWM input validation)" VALUE 0x001c88e0 /* @ECU_Address@RS_loss_slowPWM@0x01007870@ */ ECIPP_ALIGNMENT_UBYTE 255 RS_loss_slowPWM_COMPU_VTAB 0 255 BIT_MASK 0xff /end CHARACTERISTIC
/begin COMPU_METHOD RS_loss_slowPWM_COMPU_VTAB "Verbal Table" TAB_VERB "%.0" "list" COMPU_TAB_REF RS_loss_slowPWM_COMPU_VTAB_REF /end COMPU_METHOD
/begin COMPU_VTAB RS_loss_slowPWM_COMPU_VTAB_REF "Verbal Table" TAB_VERB 2 0 "Not required" 1 "Required" DEFAULT_VALUE "UNKNOWN" /end COMPU_VTAB
/begin CHARACTERISTIC FPP_atidle_start "{FPP_atidle_start&0xff=0:Not required}{FPP_atidle_start&0xff=1:Required}" VALUE 0x001c871f /* @ECU_Address@FPP_atidle_start@0x01007888@ */ ECIPP_ALIGNMENT_UBYTE 255 FPP_atidle_start_COMPU_VTAB 0 255 BIT_MASK 0xff /end CHARACTERISTIC
/begin COMPU_METHOD FPP_atidle_start_COMPU_VTAB "Verbal Table" TAB_VERB "%.0" "list" COMPU_TAB_REF FPP_atidle_start_COMPU_VTAB_REF /end COMPU_METHOD
/begin COMPU_VTAB FPP_atidle_start_COMPU_VTAB_REF "Verbal Table" TAB_VERB 2 0 "Not required" 1 "Required" DEFAULT_VALUE "UNKNOWN" /end COMPU_VTAB
/begin CHARACTERISTIC ECT_HiExp2_wait "FaultConfig # ECT_HiExp2_wait (Fault Condition:and run-time >)" VALUE 0x001c427c /* @ECU_Address@ECT_HiExp2_wait@0x010079B8@ */ ECIPP_ALIGNMENT_ULONG 4294967 Compu_ECT_HiExp2_wait 0 4294967.295 /end CHARACTERISTIC
/begin COMPU_METHOD Compu_ECT_HiExp2_wait " " RAT_FUNC "%.3" "seconds" COEFFS 0 1000 0 0 0 1 /end COMPU_METHOD
/begin CHARACTERISTIC CHT_HiExp2_wait "FaultConfig # CHT_HiExp2_wait (Fault Condition:and run-time >)" VALUE 0x001c4268 /* @ECU_Address@CHT_HiExp2_wait@0x010079C0@ */ ECIPP_ALIGNMENT_ULONG 4294967 Compu_CHT_HiExp2_wait 0 4294967.295 /end CHARACTERISTIC
/begin COMPU_METHOD Compu_CHT_HiExp2_wait " " RAT_FUNC "%.3" "seconds" COEFFS 0 1000 0 0 0 1 /end COMPU_METHOD
/begin CHARACTERISTIC Aux_PU3_rpm_lo "FaultConfig # Aux_PU3_rpm_lo (Fault Condition:and RPM >=)" VALUE 0x001e37da /* @ECU_Address@Aux_PU3_rpm_lo@0x010079F8@ */ ECIPP_ALIGNMENT_UWORD 65535 Compu_Aux_PU3_rpm_lo 0 65535 /end CHARACTERISTIC
/begin COMPU_METHOD Compu_Aux_PU3_rpm_lo " " RAT_FUNC "%.0" "rpm" COEFFS 0 1 0 0 0 1 /end COMPU_METHOD
/begin CHARACTERISTIC Aux_PU3_rpm_hi "FaultConfig # Aux_PU3_rpm_hi (Fault Condition:and RPM <=)" VALUE 0x001e37d8 /* @ECU_Address@Aux_PU3_rpm_hi@0x01007A00@ */ ECIPP_ALIGNMENT_UWORD 65535 Compu_Aux_PU3_rpm_hi 0 65535 /end CHARACTERISTIC
/begin COMPU_METHOD Compu_Aux_PU3_rpm_hi " " RAT_FUNC "%.0" "rpm" COEFFS 0 1 0 0 0 1 /end COMPU_METHOD
/begin CHARACTERISTIC Aux_PU3_ECT_lo "FaultConfig # Aux_PU3_ECT_lo (Fault Condition:and ECT >=)" VALUE 0x001e37d6 /* @ECU_Address@Aux_PU3_ECT_lo@0x01007A08@ */ ECIPP_ALIGNMENT_UWORD 564 Compu_Aux_PU3_ECT_lo -460 563.984375 /end CHARACTERISTIC
/begin COMPU_METHOD Compu_Aux_PU3_ECT_lo " " RAT_FUNC "%.3" "deg F" COEFFS 0 64 29440 0 0 1 /end COMPU_METHOD
/begin CHARACTERISTIC Aux_DIG1_rpm_lo "FaultConfig # Aux_DIG1_rpm_lo (Fault Condition:and RPM >=)" VALUE 0x001e37ce /* @ECU_Address@Aux_DIG1_rpm_lo@0x01007A10@ */ ECIPP_ALIGNMENT_UWORD 65535 Compu_Aux_DIG1_rpm_lo 0 65535 /end CHARACTERISTIC
/begin COMPU_METHOD Compu_Aux_DIG1_rpm_lo " " RAT_FUNC "%.0" "rpm" COEFFS 0 1 0 0 0 1 /end COMPU_METHOD
/begin CHARACTERISTIC Aux_DIG1_rpm_hi "FaultConfig # Aux_DIG1_rpm_hi (Fault Condition:and RPM <=)" VALUE 0x001e37cc /* @ECU_Address@Aux_DIG1_rpm_hi@0x01007A18@ */ ECIPP_ALIGNMENT_UWORD 65535 Compu_Aux_DIG1_rpm_hi 0 65535 /end CHARACTERISTIC
/begin COMPU_METHOD Compu_Aux_DIG1_rpm_hi " " RAT_FUNC "%.0" "rpm" COEFFS 0 1 0 0 0 1 /end COMPU_METHOD
/begin CHARACTERISTIC Aux_DIG1_ECT_lo "FaultConfig # Aux_DIG1_ECT_lo (Fault Condition:and ECT >=)" VALUE 0x001e37ca /* @ECU_Address@Aux_DIG1_ECT_lo@0x01007A20@ */ ECIPP_ALIGNMENT_UWORD 564 Compu_Aux_DIG1_ECT_lo -460 563.984375 /end CHARACTERISTIC
/begin COMPU_METHOD Compu_Aux_DIG1_ECT_lo " " RAT_FUNC "%.3" "deg F" COEFFS 0 64 29440 0 0 1 /end COMPU_METHOD
/begin CHARACTERISTIC MES_status_mstr "{MES_status_mstr&0xff=0:Master or slave}{MES_status_mstr&0xff=1:Master only}" VALUE 0x001c8826 /* @ECU_Address@MES_status_mstr@0x01007A48@ */ ECIPP_ALIGNMENT_UBYTE 255 MES_status_mstr_COMPU_VTAB 0 255 BIT_MASK 0xff /end CHARACTERISTIC
/begin COMPU_METHOD MES_status_mstr_COMPU_VTAB "Verbal Table" TAB_VERB "%.0" "list" COMPU_TAB_REF MES_status_mstr_COMPU_VTAB_REF /end COMPU_METHOD
/begin COMPU_VTAB MES_status_mstr_COMPU_VTAB_REF "Verbal Table" TAB_VERB 2 0 "Master or slave" 1 "Master only" DEFAULT_VALUE "UNKNOWN" /end COMPU_VTAB
/begin CHARACTERISTIC MSP_prop_V_mstr "{MSP_prop_V_mstr&0xff=0:Master or slave}{MSP_prop_V_mstr&0xff=1:Master only}" VALUE 0x001c8841 /* @ECU_Address@MSP_prop_V_mstr@0x01007A50@ */ ECIPP_ALIGNMENT_UBYTE 255 MSP_prop_V_mstr_COMPU_VTAB 0 255 BIT_MASK 0xff /end CHARACTERISTIC
/begin COMPU_METHOD MSP_prop_V_mstr_COMPU_VTAB "Verbal Table" TAB_VERB "%.0" "list" COMPU_TAB_REF MSP_prop_V_mstr_COMPU_VTAB_REF /end COMPU_METHOD
/begin COMPU_VTAB MSP_prop_V_mstr_COMPU_VTAB_REF "Verbal Table" TAB_VERB 2 0 "Master or slave" 1 "Master only" DEFAULT_VALUE "UNKNOWN" /end COMPU_VTAB
/begin CHARACTERISTIC MEFI_sync_status "{MEFI_sync_status&0xff=0:Not Available}{MEFI_sync_status&0xff=1:Available}" VALUE 0x001c8820 /* @ECU_Address@MEFI_sync_status@0x01007A60@ */ ECIPP_ALIGNMENT_UBYTE 255 MEFI_sync_status_COMPU_VTAB 0 255 BIT_MASK 0xff /end CHARACTERISTIC
/begin COMPU_METHOD MEFI_sync_status_COMPU_VTAB "Verbal Table" TAB_VERB "%.0" "list" COMPU_TAB_REF MEFI_sync_status_COMPU_VTAB_REF /end COMPU_METHOD
/begin COMPU_VTAB MEFI_sync_status_COMPU_VTAB_REF "Verbal Table" TAB_VERB 2 0 "Not Available" 1 "Available" DEFAULT_VALUE "UNKNOWN" /end COMPU_VTAB
/begin CHARACTERISTIC MSC_spddot_ena "{MSC_spddot_ena&0xff=0:Disabled}{MSC_spddot_ena&0xff=1:Enabled}" VALUE 0x001c883f /* @ECU_Address@MSC_spddot_ena@0x01007BA8@ */ ECIPP_ALIGNMENT_UBYTE 255 MSC_spddot_ena_COMPU_VTAB 0 255 BIT_MASK 0xff /end CHARACTERISTIC
/begin COMPU_METHOD MSC_spddot_ena_COMPU_VTAB "Verbal Table" TAB_VERB "%.0" "list" COMPU_TAB_REF MSC_spddot_ena_COMPU_VTAB_REF /end COMPU_METHOD
/begin COMPU_VTAB MSC_spddot_ena_COMPU_VTAB_REF "Verbal Table" TAB_VERB 2 0 "Disabled" 1 "Enabled" DEFAULT_VALUE "UNKNOWN" /end COMPU_VTAB
/begin CHARACTERISTIC APUD8_max "FaultConfig # APUD8_max (Fault Condition:AUX analog PUD8 >)" VALUE 0x001e37bc /* @ECU_Address@APUD8_max@0x01007C58@ */ ECIPP_ALIGNMENT_UWORD 5 Compu_APUD8_max 0 5.00114468864469 /end CHARACTERISTIC
/begin COMPU_METHOD Compu_APUD8_max " " RAT_FUNC "%.3" "volts" COEFFS 0 13104 0 0 0 1 /end COMPU_METHOD
/begin CHARACTERISTIC APUD8_min "FaultConfig # APUD8_min (Fault Condition:AUX analog PUD8 <)" VALUE 0x001e37be /* @ECU_Address@APUD8_min@0x01007C60@ */ ECIPP_ALIGNMENT_UWORD 5 Compu_APUD8_min 0 5.00114468864469 /end CHARACTERISTIC
/begin COMPU_METHOD Compu_APUD8_min " " RAT_FUNC "%.3" "volts" COEFFS 0 13104 0 0 0 1 /end COMPU_METHOD
/begin CHARACTERISTIC ADIG11_max "FaultConfig # ADIG11_max (Fault Condition:AUX DIG11 >)" VALUE 0x001e36e8 /* @ECU_Address@ADIG11_max@0x01007C68@ */ ECIPP_ALIGNMENT_UWORD 256 Compu_ADIG11_max 0 255.99609375 /end CHARACTERISTIC
/begin COMPU_METHOD Compu_ADIG11_max " " RAT_FUNC "%.3" "volts" COEFFS 0 256 0 0 0 1 /end COMPU_METHOD
/begin CHARACTERISTIC ADIG11_min "FaultConfig # ADIG11_min (Fault Condition:AUX DIG11 <)" VALUE 0x001e36ea /* @ECU_Address@ADIG11_min@0x01007C70@ */ ECIPP_ALIGNMENT_UWORD 256 Compu_ADIG11_min 0 255.99609375 /end CHARACTERISTIC
/begin COMPU_METHOD Compu_ADIG11_min " " RAT_FUNC "%.3" "volts" COEFFS 0 256 0 0 0 1 /end COMPU_METHOD
/begin CHARACTERISTIC ADIG12_max "FaultConfig # ADIG12_max (Fault Condition:AUX DIG12 >)" VALUE 0x001e36ec /* @ECU_Address@ADIG12_max@0x01007C78@ */ ECIPP_ALIGNMENT_UWORD 256 Compu_ADIG12_max 0 255.99609375 /end CHARACTERISTIC
/begin COMPU_METHOD Compu_ADIG12_max " " RAT_FUNC "%.3" "volts" COEFFS 0 256 0 0 0 1 /end COMPU_METHOD
/begin CHARACTERISTIC ADIG12_min "FaultConfig # ADIG12_min (Fault Condition:AUX DIG12 <)" VALUE 0x001e36ee /* @ECU_Address@ADIG12_min@0x01007C80@ */ ECIPP_ALIGNMENT_UWORD 256 Compu_ADIG12_min 0 255.99609375 /end CHARACTERISTIC
/begin COMPU_METHOD Compu_ADIG12_min " " RAT_FUNC "%.3" "volts" COEFFS 0 256 0 0 0 1 /end COMPU_METHOD
/begin CHARACTERISTIC FPUMP_on_loVf "FaultConfig # FPUMP_on_loVf (Fault Condition:OR high-side driver on-state feedback <)" VALUE 0x001c6fc8 /* @ECU_Address@FPUMP_on_loVf@0x01007C88@ */ ECIPP_ALIGNMENT_UWORD 100 Compu_FPUMP_on_loVf 0 99.9984741210938 /end CHARACTERISTIC
/begin COMPU_METHOD Compu_FPUMP_on_loVf " " RAT_FUNC "%.3" "% Vbat" COEFFS 0 655.36 0 0 0 1 /end COMPU_METHOD
/begin CHARACTERISTIC FPUMP_on_hiVf "FaultConfig # FPUMP_on_hiVf (Fault Condition:OR low-side driver on-state feedback >)" VALUE 0x001c6fc6 /* @ECU_Address@FPUMP_on_hiVf@0x01007C90@ */ ECIPP_ALIGNMENT_UWORD 100 Compu_FPUMP_on_hiVf 0 99.9984741210938 /end CHARACTERISTIC
/begin COMPU_METHOD Compu_FPUMP_on_hiVf " " RAT_FUNC "%.3" "% Vbat" COEFFS 0 655.36 0 0 0 1 /end COMPU_METHOD
/begin CHARACTERISTIC FPUMP_off_hi_volt "FaultConfig # FPUMP_off_hi_volt (Fault Condition:OR high-side driver off-state feedback >)" VALUE 0x001c6fc2 /* @ECU_Address@FPUMP_off_hi_volt@0x01007C98@ */ ECIPP_ALIGNMENT_UWORD 256 Compu_FPUMP_off_hi_volt 0 255.99609375 /end CHARACTERISTIC
/begin COMPU_METHOD Compu_FPUMP_off_hi_volt " " RAT_FUNC "%.3" "volts" COEFFS 0 256 0 0 0 1 /end COMPU_METHOD
/begin CHARACTERISTIC START_off_hi_volt "FaultConfig # START_off_hi_volt (Fault Condition:high-side feedback >)" VALUE 0x001c7fbe /* @ECU_Address@START_off_hi_volt@0x01007CA0@ */ ECIPP_ALIGNMENT_UWORD 256 Compu_START_off_hi_volt 0 255.99609375 /end CHARACTERISTIC
/begin COMPU_METHOD Compu_START_off_hi_volt " " RAT_FUNC "%.3" "volts" COEFFS 0 256 0 0 0 1 /end COMPU_METHOD
/begin CHARACTERISTIC START_on_loVf "FaultConfig # START_on_loVf (Fault Condition:High-side feedback  <)" VALUE 0x001c7fc4 /* @ECU_Address@START_on_loVf@0x01007CA8@ */ ECIPP_ALIGNMENT_UWORD 100 Compu_START_on_loVf 0 99.9984741210938 /end CHARACTERISTIC
/begin COMPU_METHOD Compu_START_on_loVf " " RAT_FUNC "%.3" "% Vbat" COEFFS 0 655.36 0 0 0 1 /end COMPU_METHOD
/begin CHARACTERISTIC APUD9_max "FaultConfig # APUD9_max (Fault Condition:AUX analog PUD9 >)" VALUE 0x001e37c0 /* @ECU_Address@APUD9_max@0x01007FF8@ */ ECIPP_ALIGNMENT_UWORD 5 Compu_APUD9_max 0 5.00114468864469 /end CHARACTERISTIC
/begin COMPU_METHOD Compu_APUD9_max " " RAT_FUNC "%.3" "volts" COEFFS 0 13104 0 0 0 1 /end COMPU_METHOD
/begin CHARACTERISTIC APUD9_min "FaultConfig # APUD9_min (Fault Condition:AUX analog PUD9 <)" VALUE 0x001e37c2 /* @ECU_Address@APUD9_min@0x01008000@ */ ECIPP_ALIGNMENT_UWORD 5 Compu_APUD9_min 0 5.00114468864469 /end CHARACTERISTIC
/begin COMPU_METHOD Compu_APUD9_min " " RAT_FUNC "%.3" "volts" COEFFS 0 13104 0 0 0 1 /end COMPU_METHOD
/begin CHARACTERISTIC APUD10_max "FaultConfig # APUD10_max (Fault Condition:AUX analog PUD10 >)" VALUE 0x001e3760 /* @ECU_Address@APUD10_max@0x01008008@ */ ECIPP_ALIGNMENT_UWORD 5 Compu_APUD10_max 0 5.00114468864469 /end CHARACTERISTIC
/begin COMPU_METHOD Compu_APUD10_max " " RAT_FUNC "%.3" "volts" COEFFS 0 13104 0 0 0 1 /end COMPU_METHOD
/begin CHARACTERISTIC APUD10_min "FaultConfig # APUD10_min (Fault Condition:AUX analog PUD10 <)" VALUE 0x001e3762 /* @ECU_Address@APUD10_min@0x01008010@ */ ECIPP_ALIGNMENT_UWORD 5 Compu_APUD10_min 0 5.00114468864469 /end CHARACTERISTIC
/begin COMPU_METHOD Compu_APUD10_min " " RAT_FUNC "%.3" "volts" COEFFS 0 13104 0 0 0 1 /end COMPU_METHOD
/begin CHARACTERISTIC APUD11_max "FaultConfig # APUD11_max (Fault Condition:AUX analog PUD11 >)" VALUE 0x001e3764 /* @ECU_Address@APUD11_max@0x01008018@ */ ECIPP_ALIGNMENT_UWORD 5 Compu_APUD11_max 0 5.00114468864469 /end CHARACTERISTIC
/begin COMPU_METHOD Compu_APUD11_max " " RAT_FUNC "%.3" "volts" COEFFS 0 13104 0 0 0 1 /end COMPU_METHOD
/begin CHARACTERISTIC APUD11_min "FaultConfig # APUD11_min (Fault Condition:AUX analog PUD11 <)" VALUE 0x001e3766 /* @ECU_Address@APUD11_min@0x01008020@ */ ECIPP_ALIGNMENT_UWORD 5 Compu_APUD11_min 0 5.00114468864469 /end CHARACTERISTIC
/begin COMPU_METHOD Compu_APUD11_min " " RAT_FUNC "%.3" "volts" COEFFS 0 13104 0 0 0 1 /end COMPU_METHOD
/begin CHARACTERISTIC APUD12_max "FaultConfig # APUD12_max (Fault Condition:AUX analog PUD12 >)" VALUE 0x001e3768 /* @ECU_Address@APUD12_max@0x01008028@ */ ECIPP_ALIGNMENT_UWORD 5 Compu_APUD12_max 0 5.00114468864469 /end CHARACTERISTIC
/begin COMPU_METHOD Compu_APUD12_max " " RAT_FUNC "%.3" "volts" COEFFS 0 13104 0 0 0 1 /end COMPU_METHOD
/begin CHARACTERISTIC APUD12_min "FaultConfig # APUD12_min (Fault Condition:AUX analog PUD12 <)" VALUE 0x001e376a /* @ECU_Address@APUD12_min@0x01008030@ */ ECIPP_ALIGNMENT_UWORD 5 Compu_APUD12_min 0 5.00114468864469 /end CHARACTERISTIC
/begin COMPU_METHOD Compu_APUD12_min " " RAT_FUNC "%.3" "volts" COEFFS 0 13104 0 0 0 1 /end COMPU_METHOD
/begin CHARACTERISTIC APUD13_max "FaultConfig # APUD13_max (Fault Condition:AUX analog PUD13 >)" VALUE 0x001e376c /* @ECU_Address@APUD13_max@0x01008038@ */ ECIPP_ALIGNMENT_UWORD 5 Compu_APUD13_max 0 5.00114468864469 /end CHARACTERISTIC
/begin COMPU_METHOD Compu_APUD13_max " " RAT_FUNC "%.3" "volts" COEFFS 0 13104 0 0 0 1 /end COMPU_METHOD
/begin CHARACTERISTIC APUD13_min "FaultConfig # APUD13_min (Fault Condition:AUX analog PUD13 <)" VALUE 0x001e376e /* @ECU_Address@APUD13_min@0x01008040@ */ ECIPP_ALIGNMENT_UWORD 5 Compu_APUD13_min 0 5.00114468864469 /end CHARACTERISTIC
/begin COMPU_METHOD Compu_APUD13_min " " RAT_FUNC "%.3" "volts" COEFFS 0 13104 0 0 0 1 /end COMPU_METHOD
/begin CHARACTERISTIC APUD14_max "FaultConfig # APUD14_max (Fault Condition:AUX analog PUD14 >)" VALUE 0x001e3770 /* @ECU_Address@APUD14_max@0x01008048@ */ ECIPP_ALIGNMENT_UWORD 5 Compu_APUD14_max 0 5.00114468864469 /end CHARACTERISTIC
/begin COMPU_METHOD Compu_APUD14_max " " RAT_FUNC "%.3" "volts" COEFFS 0 13104 0 0 0 1 /end COMPU_METHOD
/begin CHARACTERISTIC APUD14_min "FaultConfig # APUD14_min (Fault Condition:AUX analog PUD14 <)" VALUE 0x001e3772 /* @ECU_Address@APUD14_min@0x01008050@ */ ECIPP_ALIGNMENT_UWORD 5 Compu_APUD14_min 0 5.00114468864469 /end CHARACTERISTIC
/begin COMPU_METHOD Compu_APUD14_min " " RAT_FUNC "%.3" "volts" COEFFS 0 13104 0 0 0 1 /end COMPU_METHOD
/begin CHARACTERISTIC APUD15_max "FaultConfig # APUD15_max (Fault Condition:AUX analog PUD15 >)" VALUE 0x001e3774 /* @ECU_Address@APUD15_max@0x01008058@ */ ECIPP_ALIGNMENT_UWORD 5 Compu_APUD15_max 0 5.00114468864469 /end CHARACTERISTIC
/begin COMPU_METHOD Compu_APUD15_max " " RAT_FUNC "%.3" "volts" COEFFS 0 13104 0 0 0 1 /end COMPU_METHOD
/begin CHARACTERISTIC APUD15_min "FaultConfig # APUD15_min (Fault Condition:AUX analog PUD15 <)" VALUE 0x001e3776 /* @ECU_Address@APUD15_min@0x01008060@ */ ECIPP_ALIGNMENT_UWORD 5 Compu_APUD15_min 0 5.00114468864469 /end CHARACTERISTIC
/begin COMPU_METHOD Compu_APUD15_min " " RAT_FUNC "%.3" "volts" COEFFS 0 13104 0 0 0 1 /end COMPU_METHOD
/begin CHARACTERISTIC APUD16_max "FaultConfig # APUD16_max (Fault Condition:AUX analog PUD16 >)" VALUE 0x001e3778 /* @ECU_Address@APUD16_max@0x01008068@ */ ECIPP_ALIGNMENT_UWORD 5 Compu_APUD16_max 0 5.00114468864469 /end CHARACTERISTIC
/begin COMPU_METHOD Compu_APUD16_max " " RAT_FUNC "%.3" "volts" COEFFS 0 13104 0 0 0 1 /end COMPU_METHOD
/begin CHARACTERISTIC APUD16_min "FaultConfig # APUD16_min (Fault Condition:AUX analog PUD16 <)" VALUE 0x001e377a /* @ECU_Address@APUD16_min@0x01008070@ */ ECIPP_ALIGNMENT_UWORD 5 Compu_APUD16_min 0 5.00114468864469 /end CHARACTERISTIC
/begin COMPU_METHOD Compu_APUD16_min " " RAT_FUNC "%.3" "volts" COEFFS 0 13104 0 0 0 1 /end COMPU_METHOD
/begin CHARACTERISTIC APUD17_max "FaultConfig # APUD17_max (Fault Condition:AUX analog PUD17 >)" VALUE 0x001e377c /* @ECU_Address@APUD17_max@0x01008078@ */ ECIPP_ALIGNMENT_UWORD 5 Compu_APUD17_max 0 5.00114468864469 /end CHARACTERISTIC
/begin COMPU_METHOD Compu_APUD17_max " " RAT_FUNC "%.3" "volts" COEFFS 0 13104 0 0 0 1 /end COMPU_METHOD
/begin CHARACTERISTIC APUD17_min "FaultConfig # APUD17_min (Fault Condition:AUX analog PUD17 <)" VALUE 0x001e377e /* @ECU_Address@APUD17_min@0x01008080@ */ ECIPP_ALIGNMENT_UWORD 5 Compu_APUD17_min 0 5.00114468864469 /end CHARACTERISTIC
/begin COMPU_METHOD Compu_APUD17_min " " RAT_FUNC "%.3" "volts" COEFFS 0 13104 0 0 0 1 /end COMPU_METHOD
/begin CHARACTERISTIC APUD18_max "FaultConfig # APUD18_max (Fault Condition:AUX analog PUD18 >)" VALUE 0x001e3780 /* @ECU_Address@APUD18_max@0x01008088@ */ ECIPP_ALIGNMENT_UWORD 5 Compu_APUD18_max 0 5.00114468864469 /end CHARACTERISTIC
/begin COMPU_METHOD Compu_APUD18_max " " RAT_FUNC "%.3" "volts" COEFFS 0 13104 0 0 0 1 /end COMPU_METHOD
/begin CHARACTERISTIC APUD18_min "FaultConfig # APUD18_min (Fault Condition:AUX analog PUD18 <)" VALUE 0x001e3782 /* @ECU_Address@APUD18_min@0x01008090@ */ ECIPP_ALIGNMENT_UWORD 5 Compu_APUD18_min 0 5.00114468864469 /end CHARACTERISTIC
/begin COMPU_METHOD Compu_APUD18_min " " RAT_FUNC "%.3" "volts" COEFFS 0 13104 0 0 0 1 /end COMPU_METHOD
/begin CHARACTERISTIC APUD19_max "FaultConfig # APUD19_max (Fault Condition:AUX analog PUD19 >)" VALUE 0x001e3784 /* @ECU_Address@APUD19_max@0x01008098@ */ ECIPP_ALIGNMENT_UWORD 5 Compu_APUD19_max 0 5.00114468864469 /end CHARACTERISTIC
/begin COMPU_METHOD Compu_APUD19_max " " RAT_FUNC "%.3" "volts" COEFFS 0 13104 0 0 0 1 /end COMPU_METHOD
/begin CHARACTERISTIC APUD19_min "FaultConfig # APUD19_min (Fault Condition:AUX analog PUD19 <)" VALUE 0x001e3786 /* @ECU_Address@APUD19_min@0x010080A0@ */ ECIPP_ALIGNMENT_UWORD 5 Compu_APUD19_min 0 5.00114468864469 /end CHARACTERISTIC
/begin COMPU_METHOD Compu_APUD19_min " " RAT_FUNC "%.3" "volts" COEFFS 0 13104 0 0 0 1 /end COMPU_METHOD
/begin CHARACTERISTIC APUD20_max "FaultConfig # APUD20_max (Fault Condition:AUX analog PUD20 >)" VALUE 0x001e378c /* @ECU_Address@APUD20_max@0x010080A8@ */ ECIPP_ALIGNMENT_UWORD 5 Compu_APUD20_max 0 5.00114468864469 /end CHARACTERISTIC
/begin COMPU_METHOD Compu_APUD20_max " " RAT_FUNC "%.3" "volts" COEFFS 0 13104 0 0 0 1 /end COMPU_METHOD
/begin CHARACTERISTIC APUD20_min "FaultConfig # APUD20_min (Fault Condition:AUX analog PUD20 <)" VALUE 0x001e378e /* @ECU_Address@APUD20_min@0x010080B0@ */ ECIPP_ALIGNMENT_UWORD 5 Compu_APUD20_min 0 5.00114468864469 /end CHARACTERISTIC
/begin COMPU_METHOD Compu_APUD20_min " " RAT_FUNC "%.3" "volts" COEFFS 0 13104 0 0 0 1 /end COMPU_METHOD
/begin CHARACTERISTIC APUD21_max "FaultConfig # APUD21_max (Fault Condition:AUX analog PUD21 >)" VALUE 0x001e3790 /* @ECU_Address@APUD21_max@0x010080B8@ */ ECIPP_ALIGNMENT_UWORD 5 Compu_APUD21_max 0 5.00114468864469 /end CHARACTERISTIC
/begin COMPU_METHOD Compu_APUD21_max " " RAT_FUNC "%.3" "volts" COEFFS 0 13104 0 0 0 1 /end COMPU_METHOD
/begin CHARACTERISTIC APUD21_min "FaultConfig # APUD21_min (Fault Condition:AUX analog PUD21 <)" VALUE 0x001e3792 /* @ECU_Address@APUD21_min@0x010080C0@ */ ECIPP_ALIGNMENT_UWORD 5 Compu_APUD21_min 0 5.00114468864469 /end CHARACTERISTIC
/begin COMPU_METHOD Compu_APUD21_min " " RAT_FUNC "%.3" "volts" COEFFS 0 13104 0 0 0 1 /end COMPU_METHOD
/begin CHARACTERISTIC APUD22_max "FaultConfig # APUD22_max (Fault Condition:AUX analog PUD22 >)" VALUE 0x001e3794 /* @ECU_Address@APUD22_max@0x010080C8@ */ ECIPP_ALIGNMENT_UWORD 5 Compu_APUD22_max 0 5.00114468864469 /end CHARACTERISTIC
/begin COMPU_METHOD Compu_APUD22_max " " RAT_FUNC "%.3" "volts" COEFFS 0 13104 0 0 0 1 /end COMPU_METHOD
/begin CHARACTERISTIC APUD22_min "FaultConfig # APUD22_min (Fault Condition:AUX analog PUD22 <)" VALUE 0x001e3796 /* @ECU_Address@APUD22_min@0x010080D0@ */ ECIPP_ALIGNMENT_UWORD 5 Compu_APUD22_min 0 5.00114468864469 /end CHARACTERISTIC
/begin COMPU_METHOD Compu_APUD22_min " " RAT_FUNC "%.3" "volts" COEFFS 0 13104 0 0 0 1 /end COMPU_METHOD
/begin CHARACTERISTIC APUD23_max "FaultConfig # APUD23_max (Fault Condition:AUX analog PUD23 >)" VALUE 0x001e3798 /* @ECU_Address@APUD23_max@0x010080D8@ */ ECIPP_ALIGNMENT_UWORD 5 Compu_APUD23_max 0 5.00114468864469 /end CHARACTERISTIC
/begin COMPU_METHOD Compu_APUD23_max " " RAT_FUNC "%.3" "volts" COEFFS 0 13104 0 0 0 1 /end COMPU_METHOD
/begin CHARACTERISTIC APUD23_min "FaultConfig # APUD23_min (Fault Condition:AUX analog PUD23 <)" VALUE 0x001e379a /* @ECU_Address@APUD23_min@0x010080E0@ */ ECIPP_ALIGNMENT_UWORD 5 Compu_APUD23_min 0 5.00114468864469 /end CHARACTERISTIC
/begin COMPU_METHOD Compu_APUD23_min " " RAT_FUNC "%.3" "volts" COEFFS 0 13104 0 0 0 1 /end COMPU_METHOD
/begin CHARACTERISTIC APUD24_max "FaultConfig # APUD24_max (Fault Condition:AUX analog PUD24 >)" VALUE 0x001e379c /* @ECU_Address@APUD24_max@0x010080E8@ */ ECIPP_ALIGNMENT_UWORD 5 Compu_APUD24_max 0 5.00114468864469 /end CHARACTERISTIC
/begin COMPU_METHOD Compu_APUD24_max " " RAT_FUNC "%.3" "volts" COEFFS 0 13104 0 0 0 1 /end COMPU_METHOD
/begin CHARACTERISTIC APUD24_min "FaultConfig # APUD24_min (Fault Condition:AUX analog PUD24 <)" VALUE 0x001e379e /* @ECU_Address@APUD24_min@0x010080F0@ */ ECIPP_ALIGNMENT_UWORD 5 Compu_APUD24_min 0 5.00114468864469 /end CHARACTERISTIC
/begin COMPU_METHOD Compu_APUD24_min " " RAT_FUNC "%.3" "volts" COEFFS 0 13104 0 0 0 1 /end COMPU_METHOD
/begin CHARACTERISTIC APUD25_max "FaultConfig # APUD25_max (Fault Condition:AUX analog PUD25 >)" VALUE 0x001e37a0 /* @ECU_Address@APUD25_max@0x010080F8@ */ ECIPP_ALIGNMENT_UWORD 5 Compu_APUD25_max 0 5.00114468864469 /end CHARACTERISTIC
/begin COMPU_METHOD Compu_APUD25_max " " RAT_FUNC "%.3" "volts" COEFFS 0 13104 0 0 0 1 /end COMPU_METHOD
/begin CHARACTERISTIC APUD25_min "FaultConfig # APUD25_min (Fault Condition:AUX analog PUD25 <)" VALUE 0x001e37a2 /* @ECU_Address@APUD25_min@0x01008100@ */ ECIPP_ALIGNMENT_UWORD 5 Compu_APUD25_min 0 5.00114468864469 /end CHARACTERISTIC
/begin COMPU_METHOD Compu_APUD25_min " " RAT_FUNC "%.3" "volts" COEFFS 0 13104 0 0 0 1 /end COMPU_METHOD
/begin CHARACTERISTIC ADIG13_max "FaultConfig # ADIG13_max (Fault Condition:AUX DIG13 >)" VALUE 0x001e36f0 /* @ECU_Address@ADIG13_max@0x01008108@ */ ECIPP_ALIGNMENT_UWORD 256 Compu_ADIG13_max 0 255.99609375 /end CHARACTERISTIC
/begin COMPU_METHOD Compu_ADIG13_max " " RAT_FUNC "%.3" "volts" COEFFS 0 256 0 0 0 1 /end COMPU_METHOD
/begin CHARACTERISTIC ADIG13_min "FaultConfig # ADIG13_min (Fault Condition:AUX DIG13 <)" VALUE 0x001e36f2 /* @ECU_Address@ADIG13_min@0x01008110@ */ ECIPP_ALIGNMENT_UWORD 256 Compu_ADIG13_min 0 255.99609375 /end CHARACTERISTIC
/begin COMPU_METHOD Compu_ADIG13_min " " RAT_FUNC "%.3" "volts" COEFFS 0 256 0 0 0 1 /end COMPU_METHOD
/begin CHARACTERISTIC ADIG14_max "FaultConfig # ADIG14_max (Fault Condition:AUX DIG14 >)" VALUE 0x001e36f4 /* @ECU_Address@ADIG14_max@0x01008118@ */ ECIPP_ALIGNMENT_UWORD 256 Compu_ADIG14_max 0 255.99609375 /end CHARACTERISTIC
/begin COMPU_METHOD Compu_ADIG14_max " " RAT_FUNC "%.3" "volts" COEFFS 0 256 0 0 0 1 /end COMPU_METHOD
/begin CHARACTERISTIC ADIG14_min "FaultConfig # ADIG14_min (Fault Condition:AUX DIG14 <)" VALUE 0x001e36f6 /* @ECU_Address@ADIG14_min@0x01008120@ */ ECIPP_ALIGNMENT_UWORD 256 Compu_ADIG14_min 0 255.99609375 /end CHARACTERISTIC
/begin COMPU_METHOD Compu_ADIG14_min " " RAT_FUNC "%.3" "volts" COEFFS 0 256 0 0 0 1 /end COMPU_METHOD
/begin CHARACTERISTIC ADIG15_max "FaultConfig # ADIG15_max (Fault Condition:AUX DIG15 >)" VALUE 0x001e36f8 /* @ECU_Address@ADIG15_max@0x01008128@ */ ECIPP_ALIGNMENT_UWORD 256 Compu_ADIG15_max 0 255.99609375 /end CHARACTERISTIC
/begin COMPU_METHOD Compu_ADIG15_max " " RAT_FUNC "%.3" "volts" COEFFS 0 256 0 0 0 1 /end COMPU_METHOD
/begin CHARACTERISTIC ADIG15_min "FaultConfig # ADIG15_min (Fault Condition:AUX DIG15 <)" VALUE 0x001e36fa /* @ECU_Address@ADIG15_min@0x01008130@ */ ECIPP_ALIGNMENT_UWORD 256 Compu_ADIG15_min 0 255.99609375 /end CHARACTERISTIC
/begin COMPU_METHOD Compu_ADIG15_min " " RAT_FUNC "%.3" "volts" COEFFS 0 256 0 0 0 1 /end COMPU_METHOD
/begin CHARACTERISTIC ADIG16_max "FaultConfig # ADIG16_max (Fault Condition:AUX DIG16 >)" VALUE 0x001e36fc /* @ECU_Address@ADIG16_max@0x01008138@ */ ECIPP_ALIGNMENT_UWORD 256 Compu_ADIG16_max 0 255.99609375 /end CHARACTERISTIC
/begin COMPU_METHOD Compu_ADIG16_max " " RAT_FUNC "%.3" "volts" COEFFS 0 256 0 0 0 1 /end COMPU_METHOD
/begin CHARACTERISTIC ADIG16_min "FaultConfig # ADIG16_min (Fault Condition:AUX DIG16 <)" VALUE 0x001e36fe /* @ECU_Address@ADIG16_min@0x01008140@ */ ECIPP_ALIGNMENT_UWORD 256 Compu_ADIG16_min 0 255.99609375 /end CHARACTERISTIC
/begin COMPU_METHOD Compu_ADIG16_min " " RAT_FUNC "%.3" "volts" COEFFS 0 256 0 0 0 1 /end COMPU_METHOD
/begin CHARACTERISTIC ADIG17_max "FaultConfig # ADIG17_max (Fault Condition:AUX DIG17 >)" VALUE 0x001e3700 /* @ECU_Address@ADIG17_max@0x01008148@ */ ECIPP_ALIGNMENT_UWORD 256 Compu_ADIG17_max 0 255.99609375 /end CHARACTERISTIC
/begin COMPU_METHOD Compu_ADIG17_max " " RAT_FUNC "%.3" "volts" COEFFS 0 256 0 0 0 1 /end COMPU_METHOD
/begin CHARACTERISTIC ADIG17_min "FaultConfig # ADIG17_min (Fault Condition:AUX DIG17 <)" VALUE 0x001e3702 /* @ECU_Address@ADIG17_min@0x01008150@ */ ECIPP_ALIGNMENT_UWORD 256 Compu_ADIG17_min 0 255.99609375 /end CHARACTERISTIC
/begin COMPU_METHOD Compu_ADIG17_min " " RAT_FUNC "%.3" "volts" COEFFS 0 256 0 0 0 1 /end COMPU_METHOD
/begin CHARACTERISTIC ADIG18_max "FaultConfig # ADIG18_max (Fault Condition:AUX DIG18 >)" VALUE 0x001e3704 /* @ECU_Address@ADIG18_max@0x01008158@ */ ECIPP_ALIGNMENT_UWORD 256 Compu_ADIG18_max 0 255.99609375 /end CHARACTERISTIC
/begin COMPU_METHOD Compu_ADIG18_max " " RAT_FUNC "%.3" "volts" COEFFS 0 256 0 0 0 1 /end COMPU_METHOD
/begin CHARACTERISTIC ADIG18_min "FaultConfig # ADIG18_min (Fault Condition:AUX DIG18 <)" VALUE 0x001e3706 /* @ECU_Address@ADIG18_min@0x01008160@ */ ECIPP_ALIGNMENT_UWORD 256 Compu_ADIG18_min 0 255.99609375 /end CHARACTERISTIC
/begin COMPU_METHOD Compu_ADIG18_min " " RAT_FUNC "%.3" "volts" COEFFS 0 256 0 0 0 1 /end COMPU_METHOD
/begin CHARACTERISTIC ADIG19_max "FaultConfig # ADIG19_max (Fault Condition:AUX DIG19 >)" VALUE 0x001e3708 /* @ECU_Address@ADIG19_max@0x01008168@ */ ECIPP_ALIGNMENT_UWORD 256 Compu_ADIG19_max 0 255.99609375 /end CHARACTERISTIC
/begin COMPU_METHOD Compu_ADIG19_max " " RAT_FUNC "%.3" "volts" COEFFS 0 256 0 0 0 1 /end COMPU_METHOD
/begin CHARACTERISTIC ADIG19_min "FaultConfig # ADIG19_min (Fault Condition:AUX DIG19 <)" VALUE 0x001e370a /* @ECU_Address@ADIG19_min@0x01008170@ */ ECIPP_ALIGNMENT_UWORD 256 Compu_ADIG19_min 0 255.99609375 /end CHARACTERISTIC
/begin COMPU_METHOD Compu_ADIG19_min " " RAT_FUNC "%.3" "volts" COEFFS 0 256 0 0 0 1 /end COMPU_METHOD
/begin CHARACTERISTIC LowOperTemp_MAP "FaultConfig # LowOperTemp_MAP (Fault Condition:and MAP >)" VALUE 0x001c7d20 /* @ECU_Address@LowOperTemp_MAP@0x01008178@ */ ECIPP_ALIGNMENT_UWORD 256 Compu_LowOperTemp_MAP 0 255.99609375 /end CHARACTERISTIC
/begin COMPU_METHOD Compu_LowOperTemp_MAP " " RAT_FUNC "%.3" "psia" COEFFS 0 256 0 0 0 1 /end COMPU_METHOD
/begin CHARACTERISTIC LowOperTemp_rpm "FaultConfig # LowOperTemp_rpm (Fault Condition:and RPM >)" VALUE 0x001c7d22 /* @ECU_Address@LowOperTemp_rpm@0x01008190@ */ ECIPP_ALIGNMENT_UWORD 65535 Compu_LowOperTemp_rpm 0 65535 /end CHARACTERISTIC
/begin COMPU_METHOD Compu_LowOperTemp_rpm " " RAT_FUNC "%.0" "rpm" COEFFS 0 1 0 0 0 1 /end COMPU_METHOD
/begin CHARACTERISTIC UGF2_run_wait "FaultConfig # UGF2_run_wait (Fault Condition:or warmup period and an additional)" VALUE 0x001c43e4 /* @ECU_Address@UGF2_run_wait@0x01008198@ */ ECIPP_ALIGNMENT_ULONG 4294967 Compu_UGF2_run_wait 0 4294967.295 /end CHARACTERISTIC
/begin COMPU_METHOD Compu_UGF2_run_wait " " RAT_FUNC "%.3" "seconds" COEFFS 0 1000 0 0 0 1 /end COMPU_METHOD
/begin CHARACTERISTIC BstPtarget_Hi_abs "FaultConfig # BstPtarget_Hi_abs (Fault Condition:and P target >=)" VALUE 0x001c6d88 /* @ECU_Address@BstPtarget_Hi_abs@0x010082B0@ */ ECIPP_ALIGNMENT_UWORD 256 Compu_BstPtarget_Hi_abs 0 255.99609375 /end CHARACTERISTIC
/begin COMPU_METHOD Compu_BstPtarget_Hi_abs " " RAT_FUNC "%.3" "psia" COEFFS 0 256 0 0 0 1 /end COMPU_METHOD
/begin CHARACTERISTIC Aux_DIG12_rpm_lo "FaultConfig # Aux_DIG12_rpm_lo (Fault Condition:and RPM >=)" VALUE 0x001e37c8 /* @ECU_Address@Aux_DIG12_rpm_lo@0x01008430@ */ ECIPP_ALIGNMENT_UWORD 65535 Compu_Aux_DIG12_rpm_lo 0 65535 /end CHARACTERISTIC
/begin COMPU_METHOD Compu_Aux_DIG12_rpm_lo " " RAT_FUNC "%.0" "rpm" COEFFS 0 1 0 0 0 1 /end COMPU_METHOD
/begin CHARACTERISTIC Aux_DIG12_rpm_hi "FaultConfig # Aux_DIG12_rpm_hi (Fault Condition:and RPM <=)" VALUE 0x001e37c6 /* @ECU_Address@Aux_DIG12_rpm_hi@0x01008438@ */ ECIPP_ALIGNMENT_UWORD 65535 Compu_Aux_DIG12_rpm_hi 0 65535 /end CHARACTERISTIC
/begin COMPU_METHOD Compu_Aux_DIG12_rpm_hi " " RAT_FUNC "%.0" "rpm" COEFFS 0 1 0 0 0 1 /end COMPU_METHOD
/begin CHARACTERISTIC Aux_DIG12_ECT_lo "FaultConfig # Aux_DIG12_ECT_lo (Fault Condition:and ECT >=)" VALUE 0x001e37c4 /* @ECU_Address@Aux_DIG12_ECT_lo@0x01008440@ */ ECIPP_ALIGNMENT_UWORD 564 Compu_Aux_DIG12_ECT_lo -460 563.984375 /end CHARACTERISTIC
/begin COMPU_METHOD Compu_Aux_DIG12_ECT_lo " " RAT_FUNC "%.3" "deg F" COEFFS 0 64 29440 0 0 1 /end COMPU_METHOD
/begin CHARACTERISTIC SPKD_crank_enabled "{SPKD_crank_enabled&0xff=0:Disabled}{SPKD_crank_enabled&0xff=1:Enabled} (Fault Condition:Diagnose faults while cranking)" VALUE 0x001c890b /* @ECU_Address@SPKD_crank_enabled@0x01008468@ */ ECIPP_ALIGNMENT_UBYTE 255 SPKD_crank_enabled_COMPU_VTAB 0 255 BIT_MASK 0xff /end CHARACTERISTIC
/begin COMPU_METHOD SPKD_crank_enabled_COMPU_VTAB "Verbal Table" TAB_VERB "%.0" "list" COMPU_TAB_REF SPKD_crank_enabled_COMPU_VTAB_REF /end COMPU_METHOD
/begin COMPU_VTAB SPKD_crank_enabled_COMPU_VTAB_REF "Verbal Table" TAB_VERB 2 0 "Disabled" 1 "Enabled" DEFAULT_VALUE "UNKNOWN" /end COMPU_VTAB
/begin CHARACTERISTIC BUZZ_off_loVf "FaultConfig # BUZZ_off_loVf (Fault Condition:Low-side feedback <)" VALUE 0x001e37dc /* @ECU_Address@BUZZ_off_loVf@0x01008478@ */ ECIPP_ALIGNMENT_UWORD 100 Compu_BUZZ_off_loVf 0 99.9984741210938 /end CHARACTERISTIC
/begin COMPU_METHOD Compu_BUZZ_off_loVf " " RAT_FUNC "%.3" "% Vbat" COEFFS 0 655.36 0 0 0 1 /end COMPU_METHOD
/begin CHARACTERISTIC BUZZ_on_hiVf "FaultConfig # BUZZ_on_hiVf (Fault Condition:Low-side feedback >)" VALUE 0x001e37de /* @ECU_Address@BUZZ_on_hiVf@0x01008480@ */ ECIPP_ALIGNMENT_UWORD 100 Compu_BUZZ_on_hiVf 0 99.9984741210938 /end CHARACTERISTIC
/begin COMPU_METHOD Compu_BUZZ_on_hiVf " " RAT_FUNC "%.3" "% Vbat" COEFFS 0 655.36 0 0 0 1 /end COMPU_METHOD
/begin CHARACTERISTIC UEGOH1_off_loVf "FaultConfig # UEGOH1_off_loVf (Fault Condition:UEGO1 heater low-side feedback <)" VALUE 0x001e588a /* @ECU_Address@UEGOH1_off_loVf@0x01008560@ */ ECIPP_ALIGNMENT_UWORD 100 Compu_UEGOH1_off_loVf 0 99.9984741210938 /end CHARACTERISTIC
/begin COMPU_METHOD Compu_UEGOH1_off_loVf " " RAT_FUNC "%.3" "% Vbat" COEFFS 0 655.36 0 0 0 1 /end COMPU_METHOD
/begin CHARACTERISTIC UEGOH2_off_loVf "FaultConfig # UEGOH2_off_loVf (Fault Condition:UEGO2 heater low-side feedback <)" VALUE 0x001e5892 /* @ECU_Address@UEGOH2_off_loVf@0x01008568@ */ ECIPP_ALIGNMENT_UWORD 100 Compu_UEGOH2_off_loVf 0 99.9984741210938 /end CHARACTERISTIC
/begin COMPU_METHOD Compu_UEGOH2_off_loVf " " RAT_FUNC "%.3" "% Vbat" COEFFS 0 655.36 0 0 0 1 /end COMPU_METHOD
/begin CHARACTERISTIC UEGOH1_on_hiVf "FaultConfig # UEGOH1_on_hiVf (Fault Condition:UEGO1 heater low-side feedback >)" VALUE 0x001e588e /* @ECU_Address@UEGOH1_on_hiVf@0x01008570@ */ ECIPP_ALIGNMENT_UWORD 100 Compu_UEGOH1_on_hiVf 0 99.9984741210938 /end CHARACTERISTIC
/begin COMPU_METHOD Compu_UEGOH1_on_hiVf " " RAT_FUNC "%.3" "% Vbat" COEFFS 0 655.36 0 0 0 1 /end COMPU_METHOD
/begin CHARACTERISTIC UEGOH2_on_hiVf "FaultConfig # UEGOH2_on_hiVf (Fault Condition:UEGO2 heater low-side feedback >)" VALUE 0x001e5896 /* @ECU_Address@UEGOH2_on_hiVf@0x01008578@ */ ECIPP_ALIGNMENT_UWORD 100 Compu_UEGOH2_on_hiVf 0 99.9984741210938 /end CHARACTERISTIC
/begin COMPU_METHOD Compu_UEGOH2_on_hiVf " " RAT_FUNC "%.3" "% Vbat" COEFFS 0 655.36 0 0 0 1 /end COMPU_METHOD
/begin CHARACTERISTIC UEGOH1_off_loDC "FaultConfig # UEGOH1_off_loDC (Fault Condition:and PWM duty-cycle <)" VALUE 0x001e5888 /* @ECU_Address@UEGOH1_off_loDC@0x01008580@ */ ECIPP_ALIGNMENT_UWORD 100 Compu_UEGOH1_off_loDC 0 99.9984741210938 /end CHARACTERISTIC
/begin COMPU_METHOD Compu_UEGOH1_off_loDC " " RAT_FUNC "%.3" "%" COEFFS 0 655.36 0 0 0 1 /end COMPU_METHOD
/begin CHARACTERISTIC UEGOH2_off_loDC "FaultConfig # UEGOH2_off_loDC (Fault Condition:and PWM duty-cycle <)" VALUE 0x001e5890 /* @ECU_Address@UEGOH2_off_loDC@0x01008588@ */ ECIPP_ALIGNMENT_UWORD 100 Compu_UEGOH2_off_loDC 0 99.9984741210938 /end CHARACTERISTIC
/begin COMPU_METHOD Compu_UEGOH2_off_loDC " " RAT_FUNC "%.3" "%" COEFFS 0 655.36 0 0 0 1 /end COMPU_METHOD
/begin CHARACTERISTIC UEGOH1_on_hiDC "FaultConfig # UEGOH1_on_hiDC (Fault Condition:and PWM duty-cycle >)" VALUE 0x001e588c /* @ECU_Address@UEGOH1_on_hiDC@0x01008590@ */ ECIPP_ALIGNMENT_UWORD 100 Compu_UEGOH1_on_hiDC 0 99.9984741210938 /end CHARACTERISTIC
/begin COMPU_METHOD Compu_UEGOH1_on_hiDC " " RAT_FUNC "%.3" "%" COEFFS 0 655.36 0 0 0 1 /end COMPU_METHOD
/begin CHARACTERISTIC UEGOH2_on_hiDC "FaultConfig # UEGOH2_on_hiDC (Fault Condition:and PWM duty-cycle >)" VALUE 0x001e5894 /* @ECU_Address@UEGOH2_on_hiDC@0x01008598@ */ ECIPP_ALIGNMENT_UWORD 100 Compu_UEGOH2_on_hiDC 0 99.9984741210938 /end CHARACTERISTIC
/begin COMPU_METHOD Compu_UEGOH2_on_hiDC " " RAT_FUNC "%.3" "%" COEFFS 0 655.36 0 0 0 1 /end COMPU_METHOD
/begin CHARACTERISTIC RELAY_off_hi_Vfb "FaultConfig # RELAY_off_hi_Vfb (Fault Condition:Relay control off with feedback >)" VALUE 0x001c7e98 /* @ECU_Address@RELAY_off_hi_Vfb@0x010085B0@ */ ECIPP_ALIGNMENT_UWORD 100 Compu_RELAY_off_hi_Vfb 0 99.9984741210938 /end CHARACTERISTIC
/begin COMPU_METHOD Compu_RELAY_off_hi_Vfb " " RAT_FUNC "%.3" "% Vbat" COEFFS 0 655.36 0 0 0 1 /end COMPU_METHOD
/begin CHARACTERISTIC RELAY_on_lo_Vfb "FaultConfig # RELAY_on_lo_Vfb (Fault Condition:Relay control on with feedback <)" VALUE 0x001c7e9e /* @ECU_Address@RELAY_on_lo_Vfb@0x010085B8@ */ ECIPP_ALIGNMENT_UWORD 100 Compu_RELAY_on_lo_Vfb 0 99.9984741210938 /end CHARACTERISTIC
/begin COMPU_METHOD Compu_RELAY_on_lo_Vfb " " RAT_FUNC "%.3" "% Vbat" COEFFS 0 655.36 0 0 0 1 /end COMPU_METHOD
/begin CHARACTERISTIC RELAY_powered_inj "{RELAY_powered_inj&0xff=0:No}{RELAY_powered_inj&0xff=1:Yes} (Fault Condition:Injectors relay powered)" VALUE 0x001c88bf /* @ECU_Address@RELAY_powered_inj@0x010085C0@ */ ECIPP_ALIGNMENT_UBYTE 255 RELAY_powered_inj_COMPU_VTAB 0 255 BIT_MASK 0xff /end CHARACTERISTIC
/begin COMPU_METHOD RELAY_powered_inj_COMPU_VTAB "Verbal Table" TAB_VERB "%.0" "list" COMPU_TAB_REF RELAY_powered_inj_COMPU_VTAB_REF /end COMPU_METHOD
/begin COMPU_VTAB RELAY_powered_inj_COMPU_VTAB_REF "Verbal Table" TAB_VERB 2 0 "No" 1 "Yes" DEFAULT_VALUE "UNKNOWN" /end COMPU_VTAB
/begin CHARACTERISTIC RELAY_powered_coil "{RELAY_powered_coil&0xff=0:No}{RELAY_powered_coil&0xff=1:Yes} (Fault Condition:Ignition coils relay powered)" VALUE 0x001c88be /* @ECU_Address@RELAY_powered_coil@0x010085C8@ */ ECIPP_ALIGNMENT_UBYTE 255 RELAY_powered_coil_COMPU_VTAB 0 255 BIT_MASK 0xff /end CHARACTERISTIC
/begin COMPU_METHOD RELAY_powered_coil_COMPU_VTAB "Verbal Table" TAB_VERB "%.0" "list" COMPU_TAB_REF RELAY_powered_coil_COMPU_VTAB_REF /end COMPU_METHOD
/begin COMPU_VTAB RELAY_powered_coil_COMPU_VTAB_REF "Verbal Table" TAB_VERB 2 0 "No" 1 "Yes" DEFAULT_VALUE "UNKNOWN" /end COMPU_VTAB
/begin CHARACTERISTIC TRANS_ratio0 "IOConfig # TRANS_ratio0" VALUE 0x001C81C6 /* @ECU_Address@TRANS_ratio0@0x01008CE0@ */ ECIPP_ALIGNMENT_UWORD 64 Compu_TRANS_ratio0 0 63.9990234375 /end CHARACTERISTIC
/begin COMPU_METHOD Compu_TRANS_ratio0 " " RAT_FUNC "%.3" "in/out" COEFFS 0 1024 0 0 0 1 /end COMPU_METHOD
/begin CHARACTERISTIC PWM6_short_loDC "FaultConfig # PWM6_short_loDC (Fault Condition:and PWM duty-cycle <)" VALUE 0x001e57c6 /* @ECU_Address@PWM6_short_loDC@0x01008DB0@ */ ECIPP_ALIGNMENT_UWORD 100 Compu_PWM6_short_loDC 0 99.9984741210938 /end CHARACTERISTIC
/begin COMPU_METHOD Compu_PWM6_short_loDC " " RAT_FUNC "%.3" "%" COEFFS 0 655.36 0 0 0 1 /end COMPU_METHOD
/begin CHARACTERISTIC PWM6_short_mA "FaultConfig # PWM6_short_mA (Fault Condition:OR PWM 6 current feedback >)" VALUE 0x001e57c8 /* @ECU_Address@PWM6_short_mA@0x01008DB8@ */ ECIPP_ALIGNMENT_UWORD 65535 Compu_PWM6_short_mA 0 65535 /end CHARACTERISTIC
/begin COMPU_METHOD Compu_PWM6_short_mA " " RAT_FUNC "%.0" "mA" COEFFS 0 1 0 0 0 1 /end COMPU_METHOD
/begin CHARACTERISTIC PWM10_off_loVf "FaultConfig # PWM10_off_loVf (Fault Condition:PWM 10 low-side feedback <)" VALUE 0x001e5720 /* @ECU_Address@PWM10_off_loVf@0x01008DC0@ */ ECIPP_ALIGNMENT_UWORD 100 Compu_PWM10_off_loVf 0 99.9984741210938 /end CHARACTERISTIC
/begin COMPU_METHOD Compu_PWM10_off_loVf " " RAT_FUNC "%.3" "% Vbat" COEFFS 0 655.36 0 0 0 1 /end COMPU_METHOD
/begin CHARACTERISTIC PWM10_on_hiVf "FaultConfig # PWM10_on_hiVf (Fault Condition:PWM 10 low-side feedback >)" VALUE 0x001e5724 /* @ECU_Address@PWM10_on_hiVf@0x01008DC8@ */ ECIPP_ALIGNMENT_UWORD 100 Compu_PWM10_on_hiVf 0 99.9984741210938 /end CHARACTERISTIC
/begin COMPU_METHOD Compu_PWM10_on_hiVf " " RAT_FUNC "%.3" "% Vbat" COEFFS 0 655.36 0 0 0 1 /end COMPU_METHOD
/begin CHARACTERISTIC PWM10_off_loDC "FaultConfig # PWM10_off_loDC (Fault Condition:and PWM duty-cycle <)" VALUE 0x001e571e /* @ECU_Address@PWM10_off_loDC@0x01008DD0@ */ ECIPP_ALIGNMENT_UWORD 100 Compu_PWM10_off_loDC 0 99.9984741210938 /end CHARACTERISTIC
/begin COMPU_METHOD Compu_PWM10_off_loDC " " RAT_FUNC "%.3" "%" COEFFS 0 655.36 0 0 0 1 /end COMPU_METHOD
/begin CHARACTERISTIC PWM10_on_hiDC "FaultConfig # PWM10_on_hiDC (Fault Condition:and PWM duty-cycle >)" VALUE 0x001e5722 /* @ECU_Address@PWM10_on_hiDC@0x01008DD8@ */ ECIPP_ALIGNMENT_UWORD 100 Compu_PWM10_on_hiDC 0 99.9984741210938 /end CHARACTERISTIC
/begin COMPU_METHOD Compu_PWM10_on_hiDC " " RAT_FUNC "%.3" "%" COEFFS 0 655.36 0 0 0 1 /end COMPU_METHOD
/begin CHARACTERISTIC PWM11_off_loVf "FaultConfig # PWM11_off_loVf (Fault Condition:PWM 11 low-side feedback <)" VALUE 0x001e5728 /* @ECU_Address@PWM11_off_loVf@0x01008DE0@ */ ECIPP_ALIGNMENT_UWORD 100 Compu_PWM11_off_loVf 0 99.9984741210938 /end CHARACTERISTIC
/begin COMPU_METHOD Compu_PWM11_off_loVf " " RAT_FUNC "%.3" "% Vbat" COEFFS 0 655.36 0 0 0 1 /end COMPU_METHOD
/begin CHARACTERISTIC PWM11_on_hiVf "FaultConfig # PWM11_on_hiVf (Fault Condition:PWM 11 low-side feedback >)" VALUE 0x001e572c /* @ECU_Address@PWM11_on_hiVf@0x01008DE8@ */ ECIPP_ALIGNMENT_UWORD 100 Compu_PWM11_on_hiVf 0 99.9984741210938 /end CHARACTERISTIC
/begin COMPU_METHOD Compu_PWM11_on_hiVf " " RAT_FUNC "%.3" "% Vbat" COEFFS 0 655.36 0 0 0 1 /end COMPU_METHOD
/begin CHARACTERISTIC PWM11_off_loDC "FaultConfig # PWM11_off_loDC (Fault Condition:and PWM duty-cycle <)" VALUE 0x001e5726 /* @ECU_Address@PWM11_off_loDC@0x01008DF0@ */ ECIPP_ALIGNMENT_UWORD 100 Compu_PWM11_off_loDC 0 99.9984741210938 /end CHARACTERISTIC
/begin COMPU_METHOD Compu_PWM11_off_loDC " " RAT_FUNC "%.3" "%" COEFFS 0 655.36 0 0 0 1 /end COMPU_METHOD
/begin CHARACTERISTIC PWM11_on_hiDC "FaultConfig # PWM11_on_hiDC (Fault Condition:and PWM duty-cycle >)" VALUE 0x001e572a /* @ECU_Address@PWM11_on_hiDC@0x01008DF8@ */ ECIPP_ALIGNMENT_UWORD 100 Compu_PWM11_on_hiDC 0 99.9984741210938 /end CHARACTERISTIC
/begin COMPU_METHOD Compu_PWM11_on_hiDC " " RAT_FUNC "%.3" "%" COEFFS 0 655.36 0 0 0 1 /end COMPU_METHOD
/begin CHARACTERISTIC PWM12_off_loVf "FaultConfig # PWM12_off_loVf (Fault Condition:PWM 12 low-side feedback <)" VALUE 0x001e5730 /* @ECU_Address@PWM12_off_loVf@0x01008E00@ */ ECIPP_ALIGNMENT_UWORD 100 Compu_PWM12_off_loVf 0 99.9984741210938 /end CHARACTERISTIC
/begin COMPU_METHOD Compu_PWM12_off_loVf " " RAT_FUNC "%.3" "% Vbat" COEFFS 0 655.36 0 0 0 1 /end COMPU_METHOD
/begin CHARACTERISTIC PWM12_on_hiVf "FaultConfig # PWM12_on_hiVf (Fault Condition:PWM 12 low-side feedback >)" VALUE 0x001e5734 /* @ECU_Address@PWM12_on_hiVf@0x01008E08@ */ ECIPP_ALIGNMENT_UWORD 100 Compu_PWM12_on_hiVf 0 99.9984741210938 /end CHARACTERISTIC
/begin COMPU_METHOD Compu_PWM12_on_hiVf " " RAT_FUNC "%.3" "% Vbat" COEFFS 0 655.36 0 0 0 1 /end COMPU_METHOD
/begin CHARACTERISTIC PWM12_off_loDC "FaultConfig # PWM12_off_loDC (Fault Condition:and PWM duty-cycle <)" VALUE 0x001e572e /* @ECU_Address@PWM12_off_loDC@0x01008E10@ */ ECIPP_ALIGNMENT_UWORD 100 Compu_PWM12_off_loDC 0 99.9984741210938 /end CHARACTERISTIC
/begin COMPU_METHOD Compu_PWM12_off_loDC " " RAT_FUNC "%.3" "%" COEFFS 0 655.36 0 0 0 1 /end COMPU_METHOD
/begin CHARACTERISTIC PWM12_on_hiDC "FaultConfig # PWM12_on_hiDC (Fault Condition:and PWM duty-cycle >)" VALUE 0x001e5732 /* @ECU_Address@PWM12_on_hiDC@0x01008E18@ */ ECIPP_ALIGNMENT_UWORD 100 Compu_PWM12_on_hiDC 0 99.9984741210938 /end CHARACTERISTIC
/begin COMPU_METHOD Compu_PWM12_on_hiDC " " RAT_FUNC "%.3" "%" COEFFS 0 655.36 0 0 0 1 /end COMPU_METHOD
/begin CHARACTERISTIC PWM13_off_loVf "FaultConfig # PWM13_off_loVf (Fault Condition:PWM 13 low-side feedback <)" VALUE 0x001e5738 /* @ECU_Address@PWM13_off_loVf@0x01008E20@ */ ECIPP_ALIGNMENT_UWORD 100 Compu_PWM13_off_loVf 0 99.9984741210938 /end CHARACTERISTIC
/begin COMPU_METHOD Compu_PWM13_off_loVf " " RAT_FUNC "%.3" "% Vbat" COEFFS 0 655.36 0 0 0 1 /end COMPU_METHOD
/begin CHARACTERISTIC PWM13_on_hiVf "FaultConfig # PWM13_on_hiVf (Fault Condition:PWM 13 low-side feedback >)" VALUE 0x001e573c /* @ECU_Address@PWM13_on_hiVf@0x01008E28@ */ ECIPP_ALIGNMENT_UWORD 100 Compu_PWM13_on_hiVf 0 99.9984741210938 /end CHARACTERISTIC
/begin COMPU_METHOD Compu_PWM13_on_hiVf " " RAT_FUNC "%.3" "% Vbat" COEFFS 0 655.36 0 0 0 1 /end COMPU_METHOD
/begin CHARACTERISTIC PWM13_off_loDC "FaultConfig # PWM13_off_loDC (Fault Condition:and PWM duty-cycle <)" VALUE 0x001e5736 /* @ECU_Address@PWM13_off_loDC@0x01008E30@ */ ECIPP_ALIGNMENT_UWORD 100 Compu_PWM13_off_loDC 0 99.9984741210938 /end CHARACTERISTIC
/begin COMPU_METHOD Compu_PWM13_off_loDC " " RAT_FUNC "%.3" "%" COEFFS 0 655.36 0 0 0 1 /end COMPU_METHOD
/begin CHARACTERISTIC PWM13_on_hiDC "FaultConfig # PWM13_on_hiDC (Fault Condition:and PWM duty-cycle >)" VALUE 0x001e573a /* @ECU_Address@PWM13_on_hiDC@0x01008E38@ */ ECIPP_ALIGNMENT_UWORD 100 Compu_PWM13_on_hiDC 0 99.9984741210938 /end CHARACTERISTIC
/begin COMPU_METHOD Compu_PWM13_on_hiDC " " RAT_FUNC "%.3" "%" COEFFS 0 655.36 0 0 0 1 /end COMPU_METHOD
/begin CHARACTERISTIC PWM14_off_loVf "FaultConfig # PWM14_off_loVf (Fault Condition:PWM 14 low-side feedback <)" VALUE 0x001e5740 /* @ECU_Address@PWM14_off_loVf@0x01008E40@ */ ECIPP_ALIGNMENT_UWORD 100 Compu_PWM14_off_loVf 0 99.9984741210938 /end CHARACTERISTIC
/begin COMPU_METHOD Compu_PWM14_off_loVf " " RAT_FUNC "%.3" "% Vbat" COEFFS 0 655.36 0 0 0 1 /end COMPU_METHOD
/begin CHARACTERISTIC PWM14_on_hiVf "FaultConfig # PWM14_on_hiVf (Fault Condition:PWM 14 low-side feedback >)" VALUE 0x001e5744 /* @ECU_Address@PWM14_on_hiVf@0x01008E48@ */ ECIPP_ALIGNMENT_UWORD 100 Compu_PWM14_on_hiVf 0 99.9984741210938 /end CHARACTERISTIC
/begin COMPU_METHOD Compu_PWM14_on_hiVf " " RAT_FUNC "%.3" "% Vbat" COEFFS 0 655.36 0 0 0 1 /end COMPU_METHOD
/begin CHARACTERISTIC PWM14_off_loDC "FaultConfig # PWM14_off_loDC (Fault Condition:and PWM duty-cycle <)" VALUE 0x001e573e /* @ECU_Address@PWM14_off_loDC@0x01008E50@ */ ECIPP_ALIGNMENT_UWORD 100 Compu_PWM14_off_loDC 0 99.9984741210938 /end CHARACTERISTIC
/begin COMPU_METHOD Compu_PWM14_off_loDC " " RAT_FUNC "%.3" "%" COEFFS 0 655.36 0 0 0 1 /end COMPU_METHOD
/begin CHARACTERISTIC PWM14_on_hiDC "FaultConfig # PWM14_on_hiDC (Fault Condition:and PWM duty-cycle >)" VALUE 0x001e5742 /* @ECU_Address@PWM14_on_hiDC@0x01008E58@ */ ECIPP_ALIGNMENT_UWORD 100 Compu_PWM14_on_hiDC 0 99.9984741210938 /end CHARACTERISTIC
/begin COMPU_METHOD Compu_PWM14_on_hiDC " " RAT_FUNC "%.3" "%" COEFFS 0 655.36 0 0 0 1 /end COMPU_METHOD
/begin CHARACTERISTIC PWM15_off_loVf "FaultConfig # PWM15_off_loVf (Fault Condition:PWM 15 low-side feedback <)" VALUE 0x001e5748 /* @ECU_Address@PWM15_off_loVf@0x01008E60@ */ ECIPP_ALIGNMENT_UWORD 100 Compu_PWM15_off_loVf 0 99.9984741210938 /end CHARACTERISTIC
/begin COMPU_METHOD Compu_PWM15_off_loVf " " RAT_FUNC "%.3" "% Vbat" COEFFS 0 655.36 0 0 0 1 /end COMPU_METHOD
/begin CHARACTERISTIC PWM15_on_hiVf "FaultConfig # PWM15_on_hiVf (Fault Condition:PWM 15 low-side feedback >)" VALUE 0x001e574c /* @ECU_Address@PWM15_on_hiVf@0x01008E68@ */ ECIPP_ALIGNMENT_UWORD 100 Compu_PWM15_on_hiVf 0 99.9984741210938 /end CHARACTERISTIC
/begin COMPU_METHOD Compu_PWM15_on_hiVf " " RAT_FUNC "%.3" "% Vbat" COEFFS 0 655.36 0 0 0 1 /end COMPU_METHOD
/begin CHARACTERISTIC PWM15_off_loDC "FaultConfig # PWM15_off_loDC (Fault Condition:and PWM duty-cycle <)" VALUE 0x001e5746 /* @ECU_Address@PWM15_off_loDC@0x01008E70@ */ ECIPP_ALIGNMENT_UWORD 100 Compu_PWM15_off_loDC 0 99.9984741210938 /end CHARACTERISTIC
/begin COMPU_METHOD Compu_PWM15_off_loDC " " RAT_FUNC "%.3" "%" COEFFS 0 655.36 0 0 0 1 /end COMPU_METHOD
/begin CHARACTERISTIC PWM15_on_hiDC "FaultConfig # PWM15_on_hiDC (Fault Condition:and PWM duty-cycle >)" VALUE 0x001e574a /* @ECU_Address@PWM15_on_hiDC@0x01008E78@ */ ECIPP_ALIGNMENT_UWORD 100 Compu_PWM15_on_hiDC 0 99.9984741210938 /end CHARACTERISTIC
/begin COMPU_METHOD Compu_PWM15_on_hiDC " " RAT_FUNC "%.3" "%" COEFFS 0 655.36 0 0 0 1 /end COMPU_METHOD
/begin CHARACTERISTIC PWM16_off_loVf "FaultConfig # PWM16_off_loVf (Fault Condition:PWM 16 low-side feedback <)" VALUE 0x001e5750 /* @ECU_Address@PWM16_off_loVf@0x01008E80@ */ ECIPP_ALIGNMENT_UWORD 100 Compu_PWM16_off_loVf 0 99.9984741210938 /end CHARACTERISTIC
/begin COMPU_METHOD Compu_PWM16_off_loVf " " RAT_FUNC "%.3" "% Vbat" COEFFS 0 655.36 0 0 0 1 /end COMPU_METHOD
/begin CHARACTERISTIC PWM16_on_hiVf "FaultConfig # PWM16_on_hiVf (Fault Condition:PWM 16 low-side feedback >)" VALUE 0x001e5754 /* @ECU_Address@PWM16_on_hiVf@0x01008E88@ */ ECIPP_ALIGNMENT_UWORD 100 Compu_PWM16_on_hiVf 0 99.9984741210938 /end CHARACTERISTIC
/begin COMPU_METHOD Compu_PWM16_on_hiVf " " RAT_FUNC "%.3" "% Vbat" COEFFS 0 655.36 0 0 0 1 /end COMPU_METHOD
/begin CHARACTERISTIC PWM16_off_loDC "FaultConfig # PWM16_off_loDC (Fault Condition:and PWM duty-cycle <)" VALUE 0x001e574e /* @ECU_Address@PWM16_off_loDC@0x01008E90@ */ ECIPP_ALIGNMENT_UWORD 100 Compu_PWM16_off_loDC 0 99.9984741210938 /end CHARACTERISTIC
/begin COMPU_METHOD Compu_PWM16_off_loDC " " RAT_FUNC "%.3" "%" COEFFS 0 655.36 0 0 0 1 /end COMPU_METHOD
/begin CHARACTERISTIC PWM16_on_hiDC "FaultConfig # PWM16_on_hiDC (Fault Condition:and PWM duty-cycle >)" VALUE 0x001e5752 /* @ECU_Address@PWM16_on_hiDC@0x01008E98@ */ ECIPP_ALIGNMENT_UWORD 100 Compu_PWM16_on_hiDC 0 99.9984741210938 /end CHARACTERISTIC
/begin COMPU_METHOD Compu_PWM16_on_hiDC " " RAT_FUNC "%.3" "%" COEFFS 0 655.36 0 0 0 1 /end COMPU_METHOD
/begin CHARACTERISTIC PWM17_off_loVf "FaultConfig # PWM17_off_loVf (Fault Condition:PWM 17 low-side feedback <)" VALUE 0x001e5758 /* @ECU_Address@PWM17_off_loVf@0x01008EA0@ */ ECIPP_ALIGNMENT_UWORD 100 Compu_PWM17_off_loVf 0 99.9984741210938 /end CHARACTERISTIC
/begin COMPU_METHOD Compu_PWM17_off_loVf " " RAT_FUNC "%.3" "% Vbat" COEFFS 0 655.36 0 0 0 1 /end COMPU_METHOD
/begin CHARACTERISTIC PWM17_on_hiVf "FaultConfig # PWM17_on_hiVf (Fault Condition:PWM 17 low-side feedback >)" VALUE 0x001e575c /* @ECU_Address@PWM17_on_hiVf@0x01008EA8@ */ ECIPP_ALIGNMENT_UWORD 100 Compu_PWM17_on_hiVf 0 99.9984741210938 /end CHARACTERISTIC
/begin COMPU_METHOD Compu_PWM17_on_hiVf " " RAT_FUNC "%.3" "% Vbat" COEFFS 0 655.36 0 0 0 1 /end COMPU_METHOD
/begin CHARACTERISTIC PWM17_off_loDC "FaultConfig # PWM17_off_loDC (Fault Condition:and PWM duty-cycle <)" VALUE 0x001e5756 /* @ECU_Address@PWM17_off_loDC@0x01008EB0@ */ ECIPP_ALIGNMENT_UWORD 100 Compu_PWM17_off_loDC 0 99.9984741210938 /end CHARACTERISTIC
/begin COMPU_METHOD Compu_PWM17_off_loDC " " RAT_FUNC "%.3" "%" COEFFS 0 655.36 0 0 0 1 /end COMPU_METHOD
/begin CHARACTERISTIC PWM17_on_hiDC "FaultConfig # PWM17_on_hiDC (Fault Condition:and PWM duty-cycle >)" VALUE 0x001e575a /* @ECU_Address@PWM17_on_hiDC@0x01008EB8@ */ ECIPP_ALIGNMENT_UWORD 100 Compu_PWM17_on_hiDC 0 99.9984741210938 /end CHARACTERISTIC
/begin COMPU_METHOD Compu_PWM17_on_hiDC " " RAT_FUNC "%.3" "%" COEFFS 0 655.36 0 0 0 1 /end COMPU_METHOD
/begin CHARACTERISTIC PWM18_off_loVf "FaultConfig # PWM18_off_loVf (Fault Condition:PWM 18 low-side feedback <)" VALUE 0x001e5760 /* @ECU_Address@PWM18_off_loVf@0x01008EC0@ */ ECIPP_ALIGNMENT_UWORD 100 Compu_PWM18_off_loVf 0 99.9984741210938 /end CHARACTERISTIC
/begin COMPU_METHOD Compu_PWM18_off_loVf " " RAT_FUNC "%.3" "% Vbat" COEFFS 0 655.36 0 0 0 1 /end COMPU_METHOD
/begin CHARACTERISTIC PWM18_on_hiVf "FaultConfig # PWM18_on_hiVf (Fault Condition:PWM 18 low-side feedback >)" VALUE 0x001e5764 /* @ECU_Address@PWM18_on_hiVf@0x01008EC8@ */ ECIPP_ALIGNMENT_UWORD 100 Compu_PWM18_on_hiVf 0 99.9984741210938 /end CHARACTERISTIC
/begin COMPU_METHOD Compu_PWM18_on_hiVf " " RAT_FUNC "%.3" "% Vbat" COEFFS 0 655.36 0 0 0 1 /end COMPU_METHOD
/begin CHARACTERISTIC PWM18_off_loDC "FaultConfig # PWM18_off_loDC (Fault Condition:and PWM duty-cycle <)" VALUE 0x001e575e /* @ECU_Address@PWM18_off_loDC@0x01008ED0@ */ ECIPP_ALIGNMENT_UWORD 100 Compu_PWM18_off_loDC 0 99.9984741210938 /end CHARACTERISTIC
/begin COMPU_METHOD Compu_PWM18_off_loDC " " RAT_FUNC "%.3" "%" COEFFS 0 655.36 0 0 0 1 /end COMPU_METHOD
/begin CHARACTERISTIC PWM18_on_hiDC "FaultConfig # PWM18_on_hiDC (Fault Condition:and PWM duty-cycle >)" VALUE 0x001e5762 /* @ECU_Address@PWM18_on_hiDC@0x01008ED8@ */ ECIPP_ALIGNMENT_UWORD 100 Compu_PWM18_on_hiDC 0 99.9984741210938 /end CHARACTERISTIC
/begin COMPU_METHOD Compu_PWM18_on_hiDC " " RAT_FUNC "%.3" "%" COEFFS 0 655.36 0 0 0 1 /end COMPU_METHOD
/begin CHARACTERISTIC PWM19_off_loVf "FaultConfig # PWM19_off_loVf (Fault Condition:PWM 19 low-side feedback <)" VALUE 0x001e5768 /* @ECU_Address@PWM19_off_loVf@0x01008EE0@ */ ECIPP_ALIGNMENT_UWORD 100 Compu_PWM19_off_loVf 0 99.9984741210938 /end CHARACTERISTIC
/begin COMPU_METHOD Compu_PWM19_off_loVf " " RAT_FUNC "%.3" "% Vbat" COEFFS 0 655.36 0 0 0 1 /end COMPU_METHOD
/begin CHARACTERISTIC PWM19_on_hiVf "FaultConfig # PWM19_on_hiVf (Fault Condition:PWM 19 low-side feedback >)" VALUE 0x001e576c /* @ECU_Address@PWM19_on_hiVf@0x01008EE8@ */ ECIPP_ALIGNMENT_UWORD 100 Compu_PWM19_on_hiVf 0 99.9984741210938 /end CHARACTERISTIC
/begin COMPU_METHOD Compu_PWM19_on_hiVf " " RAT_FUNC "%.3" "% Vbat" COEFFS 0 655.36 0 0 0 1 /end COMPU_METHOD
/begin CHARACTERISTIC PWM19_off_loDC "FaultConfig # PWM19_off_loDC (Fault Condition:and PWM duty-cycle <)" VALUE 0x001e5766 /* @ECU_Address@PWM19_off_loDC@0x01008EF0@ */ ECIPP_ALIGNMENT_UWORD 100 Compu_PWM19_off_loDC 0 99.9984741210938 /end CHARACTERISTIC
/begin COMPU_METHOD Compu_PWM19_off_loDC " " RAT_FUNC "%.3" "%" COEFFS 0 655.36 0 0 0 1 /end COMPU_METHOD
/begin CHARACTERISTIC PWM19_on_hiDC "FaultConfig # PWM19_on_hiDC (Fault Condition:and PWM duty-cycle >)" VALUE 0x001e576a /* @ECU_Address@PWM19_on_hiDC@0x01008EF8@ */ ECIPP_ALIGNMENT_UWORD 100 Compu_PWM19_on_hiDC 0 99.9984741210938 /end CHARACTERISTIC
/begin COMPU_METHOD Compu_PWM19_on_hiDC " " RAT_FUNC "%.3" "%" COEFFS 0 655.36 0 0 0 1 /end COMPU_METHOD
/begin CHARACTERISTIC PWM20_off_loVf "FaultConfig # PWM20_off_loVf (Fault Condition:PWM 20 low-side feedback <)" VALUE 0x001e577c /* @ECU_Address@PWM20_off_loVf@0x01008F00@ */ ECIPP_ALIGNMENT_UWORD 100 Compu_PWM20_off_loVf 0 99.9984741210938 /end CHARACTERISTIC
/begin COMPU_METHOD Compu_PWM20_off_loVf " " RAT_FUNC "%.3" "% Vbat" COEFFS 0 655.36 0 0 0 1 /end COMPU_METHOD
/begin CHARACTERISTIC PWM20_on_hiVf "FaultConfig # PWM20_on_hiVf (Fault Condition:PWM 20 low-side feedback >)" VALUE 0x001e5780 /* @ECU_Address@PWM20_on_hiVf@0x01008F08@ */ ECIPP_ALIGNMENT_UWORD 100 Compu_PWM20_on_hiVf 0 99.9984741210938 /end CHARACTERISTIC
/begin COMPU_METHOD Compu_PWM20_on_hiVf " " RAT_FUNC "%.3" "% Vbat" COEFFS 0 655.36 0 0 0 1 /end COMPU_METHOD
/begin CHARACTERISTIC PWM20_off_loDC "FaultConfig # PWM20_off_loDC (Fault Condition:and PWM duty-cycle <)" VALUE 0x001e577a /* @ECU_Address@PWM20_off_loDC@0x01008F10@ */ ECIPP_ALIGNMENT_UWORD 100 Compu_PWM20_off_loDC 0 99.9984741210938 /end CHARACTERISTIC
/begin COMPU_METHOD Compu_PWM20_off_loDC " " RAT_FUNC "%.3" "%" COEFFS 0 655.36 0 0 0 1 /end COMPU_METHOD
/begin CHARACTERISTIC PWM20_on_hiDC "FaultConfig # PWM20_on_hiDC (Fault Condition:and PWM duty-cycle >)" VALUE 0x001e577e /* @ECU_Address@PWM20_on_hiDC@0x01008F18@ */ ECIPP_ALIGNMENT_UWORD 100 Compu_PWM20_on_hiDC 0 99.9984741210938 /end CHARACTERISTIC
/begin COMPU_METHOD Compu_PWM20_on_hiDC " " RAT_FUNC "%.3" "%" COEFFS 0 655.36 0 0 0 1 /end COMPU_METHOD
/begin CHARACTERISTIC PWM21_off_loVf "FaultConfig # PWM21_off_loVf (Fault Condition:PWM 21 low-side feedback <)" VALUE 0x001e5784 /* @ECU_Address@PWM21_off_loVf@0x01008F20@ */ ECIPP_ALIGNMENT_UWORD 100 Compu_PWM21_off_loVf 0 99.9984741210938 /end CHARACTERISTIC
/begin COMPU_METHOD Compu_PWM21_off_loVf " " RAT_FUNC "%.3" "% Vbat" COEFFS 0 655.36 0 0 0 1 /end COMPU_METHOD
/begin CHARACTERISTIC PWM21_on_hiVf "FaultConfig # PWM21_on_hiVf (Fault Condition:PWM 21 low-side feedback >)" VALUE 0x001e5788 /* @ECU_Address@PWM21_on_hiVf@0x01008F28@ */ ECIPP_ALIGNMENT_UWORD 100 Compu_PWM21_on_hiVf 0 99.9984741210938 /end CHARACTERISTIC
/begin COMPU_METHOD Compu_PWM21_on_hiVf " " RAT_FUNC "%.3" "% Vbat" COEFFS 0 655.36 0 0 0 1 /end COMPU_METHOD
/begin CHARACTERISTIC PWM21_off_loDC "FaultConfig # PWM21_off_loDC (Fault Condition:and PWM duty-cycle <)" VALUE 0x001e5782 /* @ECU_Address@PWM21_off_loDC@0x01008F30@ */ ECIPP_ALIGNMENT_UWORD 100 Compu_PWM21_off_loDC 0 99.9984741210938 /end CHARACTERISTIC
/begin COMPU_METHOD Compu_PWM21_off_loDC " " RAT_FUNC "%.3" "%" COEFFS 0 655.36 0 0 0 1 /end COMPU_METHOD
/begin CHARACTERISTIC PWM21_on_hiDC "FaultConfig # PWM21_on_hiDC (Fault Condition:and PWM duty-cycle >)" VALUE 0x001e5786 /* @ECU_Address@PWM21_on_hiDC@0x01008F38@ */ ECIPP_ALIGNMENT_UWORD 100 Compu_PWM21_on_hiDC 0 99.9984741210938 /end CHARACTERISTIC
/begin COMPU_METHOD Compu_PWM21_on_hiDC " " RAT_FUNC "%.3" "%" COEFFS 0 655.36 0 0 0 1 /end COMPU_METHOD
/begin CHARACTERISTIC PWM22_off_loVf "FaultConfig # PWM22_off_loVf (Fault Condition:PWM 22 low-side feedback <)" VALUE 0x001e578c /* @ECU_Address@PWM22_off_loVf@0x01008F40@ */ ECIPP_ALIGNMENT_UWORD 100 Compu_PWM22_off_loVf 0 99.9984741210938 /end CHARACTERISTIC
/begin COMPU_METHOD Compu_PWM22_off_loVf " " RAT_FUNC "%.3" "% Vbat" COEFFS 0 655.36 0 0 0 1 /end COMPU_METHOD
/begin CHARACTERISTIC PWM22_on_hiVf "FaultConfig # PWM22_on_hiVf (Fault Condition:PWM 22 low-side feedback >)" VALUE 0x001e5790 /* @ECU_Address@PWM22_on_hiVf@0x01008F48@ */ ECIPP_ALIGNMENT_UWORD 100 Compu_PWM22_on_hiVf 0 99.9984741210938 /end CHARACTERISTIC
/begin COMPU_METHOD Compu_PWM22_on_hiVf " " RAT_FUNC "%.3" "% Vbat" COEFFS 0 655.36 0 0 0 1 /end COMPU_METHOD
/begin CHARACTERISTIC PWM22_off_loDC "FaultConfig # PWM22_off_loDC (Fault Condition:and PWM duty-cycle <)" VALUE 0x001e578a /* @ECU_Address@PWM22_off_loDC@0x01008F50@ */ ECIPP_ALIGNMENT_UWORD 100 Compu_PWM22_off_loDC 0 99.9984741210938 /end CHARACTERISTIC
/begin COMPU_METHOD Compu_PWM22_off_loDC " " RAT_FUNC "%.3" "%" COEFFS 0 655.36 0 0 0 1 /end COMPU_METHOD
/begin CHARACTERISTIC PWM22_on_hiDC "FaultConfig # PWM22_on_hiDC (Fault Condition:and PWM duty-cycle >)" VALUE 0x001e578e /* @ECU_Address@PWM22_on_hiDC@0x01008F58@ */ ECIPP_ALIGNMENT_UWORD 100 Compu_PWM22_on_hiDC 0 99.9984741210938 /end CHARACTERISTIC
/begin COMPU_METHOD Compu_PWM22_on_hiDC " " RAT_FUNC "%.3" "%" COEFFS 0 655.36 0 0 0 1 /end COMPU_METHOD
/begin CHARACTERISTIC PWM23_off_loVf "FaultConfig # PWM23_off_loVf (Fault Condition:PWM 23 low-side feedback <)" VALUE 0x001e5794 /* @ECU_Address@PWM23_off_loVf@0x01008F60@ */ ECIPP_ALIGNMENT_UWORD 100 Compu_PWM23_off_loVf 0 99.9984741210938 /end CHARACTERISTIC
/begin COMPU_METHOD Compu_PWM23_off_loVf " " RAT_FUNC "%.3" "% Vbat" COEFFS 0 655.36 0 0 0 1 /end COMPU_METHOD
/begin CHARACTERISTIC PWM23_on_hiVf "FaultConfig # PWM23_on_hiVf (Fault Condition:PWM 23 low-side feedback >)" VALUE 0x001e5798 /* @ECU_Address@PWM23_on_hiVf@0x01008F68@ */ ECIPP_ALIGNMENT_UWORD 100 Compu_PWM23_on_hiVf 0 99.9984741210938 /end CHARACTERISTIC
/begin COMPU_METHOD Compu_PWM23_on_hiVf " " RAT_FUNC "%.3" "% Vbat" COEFFS 0 655.36 0 0 0 1 /end COMPU_METHOD
/begin CHARACTERISTIC PWM23_off_loDC "FaultConfig # PWM23_off_loDC (Fault Condition:and PWM duty-cycle <)" VALUE 0x001e5792 /* @ECU_Address@PWM23_off_loDC@0x01008F70@ */ ECIPP_ALIGNMENT_UWORD 100 Compu_PWM23_off_loDC 0 99.9984741210938 /end CHARACTERISTIC
/begin COMPU_METHOD Compu_PWM23_off_loDC " " RAT_FUNC "%.3" "%" COEFFS 0 655.36 0 0 0 1 /end COMPU_METHOD
/begin CHARACTERISTIC PWM23_on_hiDC "FaultConfig # PWM23_on_hiDC (Fault Condition:and PWM duty-cycle >)" VALUE 0x001e5796 /* @ECU_Address@PWM23_on_hiDC@0x01008F78@ */ ECIPP_ALIGNMENT_UWORD 100 Compu_PWM23_on_hiDC 0 99.9984741210938 /end CHARACTERISTIC
/begin COMPU_METHOD Compu_PWM23_on_hiDC " " RAT_FUNC "%.3" "%" COEFFS 0 655.36 0 0 0 1 /end COMPU_METHOD
/begin CHARACTERISTIC PW_zero_I2 "General # PW_zero_I2" VALUE 0x001C9FB0 /* @ECU_Address@PW_zero_I2@0x01009150@ */ ECIPP_ALIGNMENT_UWORD 210 Compu_PW_zero_I2 0 209.712 /end CHARACTERISTIC
/begin COMPU_METHOD Compu_PW_zero_I2 " " RAT_FUNC "%.3" "ms" COEFFS 0 312.5 0 0 0 1 /end COMPU_METHOD
/begin CHARACTERISTIC PW_min_extra_I2 "General # PW_min_extra_I2" VALUE 0x001C9FB2 /* @ECU_Address@PW_min_extra_I2@0x01009158@ */ ECIPP_ALIGNMENT_UWORD 210 Compu_PW_min_extra_I2 0 209.712 /end CHARACTERISTIC
/begin COMPU_METHOD Compu_PW_min_extra_I2 " " RAT_FUNC "%.3" "ms" COEFFS 0 312.5 0 0 0 1 /end COMPU_METHOD
/begin CHARACTERISTIC inj_off_min_I2 "General # inj_off_min_I2" VALUE 0x001C9FB4 /* @ECU_Address@inj_off_min_I2@0x01009160@ */ ECIPP_ALIGNMENT_UWORD 210 Compu_inj_off_min_I2 0 209.712 /end CHARACTERISTIC
/begin COMPU_METHOD Compu_inj_off_min_I2 " " RAT_FUNC "%.3" "ms" COEFFS 0 312.5 0 0 0 1 /end COMPU_METHOD
/begin CHARACTERISTIC PWPCF_I2 "General # PWPCF_I2" VALUE 0x001C9FBA /* @ECU_Address@PWPCF_I2@0x01009170@ */ ECIPP_ALIGNMENT_SWORD 0 Compu_PWPCF_I2 -0.1024 0.102396875 /end CHARACTERISTIC
/begin COMPU_METHOD Compu_PWPCF_I2 " " RAT_FUNC "%.3" "ms/psi" COEFFS 0 320000 0 0 0 1 /end COMPU_METHOD
/begin CHARACTERISTIC fuel_MAP_crct_ena_I2 "{fuel_MAP_crct_ena_I2&0xff=0:Off}{fuel_MAP_crct_ena_I2&0xff=1:On}" VALUE 0x001C9FC8 /* @ECU_Address@fuel_MAP_crct_ena_I2@0x01009178@ */ ECIPP_ALIGNMENT_UBYTE 255 fuel_MAP_crct_ena_I2_COMPU_VTAB 0 255 BIT_MASK 0xff /end CHARACTERISTIC
/begin COMPU_METHOD fuel_MAP_crct_ena_I2_COMPU_VTAB "Verbal Table" TAB_VERB "%.0" "list" COMPU_TAB_REF fuel_MAP_crct_ena_I2_COMPU_VTAB_REF /end COMPU_METHOD
/begin COMPU_VTAB fuel_MAP_crct_ena_I2_COMPU_VTAB_REF "Verbal Table" TAB_VERB 2 0 "Off" 1 "On" DEFAULT_VALUE "UNKNOWN" /end COMPU_VTAB
/begin CHARACTERISTIC FPout_loc_I2 "{FPout_loc_I2&0xff=0:MAP}{FPout_loc_I2&0xff=1:TIP}" VALUE 0x001C9FC9 /* @ECU_Address@FPout_loc_I2@0x01009180@ */ ECIPP_ALIGNMENT_UBYTE 255 FPout_loc_I2_COMPU_VTAB 0 255 BIT_MASK 0xff /end CHARACTERISTIC
/begin COMPU_METHOD FPout_loc_I2_COMPU_VTAB "Verbal Table" TAB_VERB "%.0" "list" COMPU_TAB_REF FPout_loc_I2_COMPU_VTAB_REF /end COMPU_METHOD
/begin COMPU_VTAB FPout_loc_I2_COMPU_VTAB_REF "Verbal Table" TAB_VERB 2 0 "MAP" 1 "TIP" DEFAULT_VALUE "UNKNOWN" /end COMPU_VTAB
/begin CHARACTERISTIC fuel_FP_crct_ena_I2 "{fuel_FP_crct_ena_I2&0xff=0:Off}{fuel_FP_crct_ena_I2&0xff=1:On}" VALUE 0x001C9FCA /* @ECU_Address@fuel_FP_crct_ena_I2@0x01009188@ */ ECIPP_ALIGNMENT_UBYTE 255 fuel_FP_crct_ena_I2_COMPU_VTAB 0 255 BIT_MASK 0xff /end CHARACTERISTIC
/begin COMPU_METHOD fuel_FP_crct_ena_I2_COMPU_VTAB "Verbal Table" TAB_VERB "%.0" "list" COMPU_TAB_REF fuel_FP_crct_ena_I2_COMPU_VTAB_REF /end COMPU_METHOD
/begin COMPU_VTAB fuel_FP_crct_ena_I2_COMPU_VTAB_REF "Verbal Table" TAB_VERB 2 0 "Off" 1 "On" DEFAULT_VALUE "UNKNOWN" /end COMPU_VTAB
/begin CHARACTERISTIC fuel_FT_crct_ena_I2 "{fuel_FT_crct_ena_I2&0xff=0:Off}{fuel_FT_crct_ena_I2&0xff=1:On}" VALUE 0x001C9FCB /* @ECU_Address@fuel_FT_crct_ena_I2@0x01009190@ */ ECIPP_ALIGNMENT_UBYTE 255 fuel_FT_crct_ena_I2_COMPU_VTAB 0 255 BIT_MASK 0xff /end CHARACTERISTIC
/begin COMPU_METHOD fuel_FT_crct_ena_I2_COMPU_VTAB "Verbal Table" TAB_VERB "%.0" "list" COMPU_TAB_REF fuel_FT_crct_ena_I2_COMPU_VTAB_REF /end COMPU_METHOD
/begin COMPU_VTAB fuel_FT_crct_ena_I2_COMPU_VTAB_REF "Verbal Table" TAB_VERB 2 0 "Off" 1 "On" DEFAULT_VALUE "UNKNOWN" /end COMPU_VTAB
/begin CHARACTERISTIC FP_maxv_I2 "FaultConfig # FP_maxv_I2 (Fault Condition:Secondary FP voltage >)" VALUE 0x001C9FA4 /* @ECU_Address@FP_maxv_I2@0x010091B8@ */ ECIPP_ALIGNMENT_UWORD 5 Compu_FP_maxv_I2 0 5.00114468864469 /end CHARACTERISTIC
/begin COMPU_METHOD Compu_FP_maxv_I2 " " RAT_FUNC "%.3" "volts" COEFFS 0 13104 0 0 0 1 /end COMPU_METHOD
/begin CHARACTERISTIC FP_minv_I2 "FaultConfig # FP_minv_I2 (Fault Condition:Secondary FP voltage <)" VALUE 0x001C9FA6 /* @ECU_Address@FP_minv_I2@0x010091C0@ */ ECIPP_ALIGNMENT_UWORD 5 Compu_FP_minv_I2 0 5.00114468864469 /end CHARACTERISTIC
/begin COMPU_METHOD Compu_FP_minv_I2 " " RAT_FUNC "%.3" "volts" COEFFS 0 13104 0 0 0 1 /end COMPU_METHOD
/begin CHARACTERISTIC FP_low_I2 "FaultConfig # FP_low_I2 (Fault Condition:Secondary fuel pressure <)" VALUE 0x001C9FA0 /* @ECU_Address@FP_low_I2@0x010091C8@ */ ECIPP_ALIGNMENT_UWORD 256 Compu_FP_low_I2 0 255.99609375 /end CHARACTERISTIC
/begin COMPU_METHOD Compu_FP_low_I2 " " RAT_FUNC "%.3" "psia" COEFFS 0 256 0 0 0 1 /end COMPU_METHOD
/begin CHARACTERISTIC FP_high_I2 "FaultConfig # FP_high_I2 (Fault Condition:Secondary fuel pressure >)" VALUE 0x001C9FA2 /* @ECU_Address@FP_high_I2@0x010091D0@ */ ECIPP_ALIGNMENT_UWORD 256 Compu_FP_high_I2 0 255.99609375 /end CHARACTERISTIC
/begin COMPU_METHOD Compu_FP_high_I2 " " RAT_FUNC "%.3" "psia" COEFFS 0 256 0 0 0 1 /end COMPU_METHOD
/begin CHARACTERISTIC FP_highlow_wait_I2 "FaultConfig # FP_highlow_wait_I2 (Fault Condition:run time wait for fuel pressure high/low faults:)" VALUE 0x001C9F9C /* @ECU_Address@FP_highlow_wait_I2@0x010091D8@ */ ECIPP_ALIGNMENT_ULONG 4294967 Compu_FP_highlow_wait_I2 0 4294967.295 /end CHARACTERISTIC
/begin COMPU_METHOD Compu_FP_highlow_wait_I2 " " RAT_FUNC "%.3" "seconds" COEFFS 0 1000 0 0 0 1 /end COMPU_METHOD
/begin CHARACTERISTIC FP_fault_mode_I2 "{FP_fault_mode_I2&0xff=0:Gasoline + Gaseous}{FP_fault_mode_I2&0xff=1:Gasoline only}{FP_fault_mode_I2&0xff=2:Gaseous only} (Fault Condition:Secondary FP fault mode)" VALUE 0x001C9FC4 /* @ECU_Address@FP_fault_mode_I2@0x010091E0@ */ ECIPP_ALIGNMENT_UBYTE 255 FP_fault_mode_I2_COMPU_VTAB 0 255 BIT_MASK 0xff /end CHARACTERISTIC
/begin COMPU_METHOD FP_fault_mode_I2_COMPU_VTAB "Verbal Table" TAB_VERB "%.0" "list" COMPU_TAB_REF FP_fault_mode_I2_COMPU_VTAB_REF /end COMPU_METHOD
/begin COMPU_VTAB FP_fault_mode_I2_COMPU_VTAB_REF "Verbal Table" TAB_VERB 3 0 "Gasoline + Gaseous" 1 "Gasoline only" 2 "Gaseous only" DEFAULT_VALUE "UNKNOWN" /end COMPU_VTAB
/begin CHARACTERISTIC fuel_device_LP "{fuel_device_LP&0xff=0:Carburetion}{fuel_device_LP&0xff=1:Pulse Injection - Pri}{fuel_device_LP&0xff=2:Pulse Injection - Sec}{fuel_device_LP&0xff=3:Continuous Injection}{fuel_device_LP&0xff=4:MFG Injection}" VALUE 0x001c902f /* @ECU_Address@fuel_device_LP@0x01009210@ */ ECIPP_ALIGNMENT_UBYTE 255 fuel_device_LP_COMPU_VTAB 0 255 BIT_MASK 0xff /end CHARACTERISTIC
/begin COMPU_METHOD fuel_device_LP_COMPU_VTAB "Verbal Table" TAB_VERB "%.0" "list" COMPU_TAB_REF fuel_device_LP_COMPU_VTAB_REF /end COMPU_METHOD
/begin COMPU_VTAB fuel_device_LP_COMPU_VTAB_REF "Verbal Table" TAB_VERB 5 0 "Carburetion" 1 "Pulse Injection - Pri" 2 "Pulse Injection - Sec" 3 "Continuous Injection" 4 "MFG Injection" DEFAULT_VALUE "UNKNOWN" /end COMPU_VTAB
/begin CHARACTERISTIC fuel_device_NG "{fuel_device_NG&0xff=0:Carburetion}{fuel_device_NG&0xff=1:Pulse Injection - Pri}{fuel_device_NG&0xff=2:Pulse Injection - Sec}{fuel_device_NG&0xff=3:Continuous Injection}{fuel_device_NG&0xff=4:MFG Injection}" VALUE 0x001c9030 /* @ECU_Address@fuel_device_NG@0x01009218@ */ ECIPP_ALIGNMENT_UBYTE 255 fuel_device_NG_COMPU_VTAB 0 255 BIT_MASK 0xff /end CHARACTERISTIC
/begin COMPU_METHOD fuel_device_NG_COMPU_VTAB "Verbal Table" TAB_VERB "%.0" "list" COMPU_TAB_REF fuel_device_NG_COMPU_VTAB_REF /end COMPU_METHOD
/begin COMPU_VTAB fuel_device_NG_COMPU_VTAB_REF "Verbal Table" TAB_VERB 5 0 "Carburetion" 1 "Pulse Injection - Pri" 2 "Pulse Injection - Sec" 3 "Continuous Injection" 4 "MFG Injection" DEFAULT_VALUE "UNKNOWN" /end COMPU_VTAB
/begin CHARACTERISTIC EGT_vdr "IOConfig # EGT_vdr" VALUE 0x001c3a9c /* @ECU_Address@EGT_vdr@0x010093D8@ */ ECIPP_ALIGNMENT_FLOAT32_IEEE 10000000000 Compu_EGT_vdr -10000000000 10000000000 /end CHARACTERISTIC
/begin COMPU_METHOD Compu_EGT_vdr " " RAT_FUNC "%.3" "ohms" COEFFS 0 1 0 0 0 1 /end COMPU_METHOD
/begin CHARACTERISTIC EGRT_vdr "IOConfig # EGRT_vdr" VALUE 0x001c005c /* @ECU_Address@EGRT_vdr@0x010093E0@ */ ECIPP_ALIGNMENT_FLOAT32_IEEE 10000000000 Compu_EGRT_vdr -10000000000 10000000000 /end CHARACTERISTIC
/begin COMPU_METHOD Compu_EGRT_vdr " " RAT_FUNC "%.3" "ohms" COEFFS 0 1 0 0 0 1 /end COMPU_METHOD
/begin CHARACTERISTIC DOCT_vdr "IOConfig # DOCT_vdr" VALUE 0x001ed328 /* @ECU_Address@DOCT_vdr@0x010093E8@ */ ECIPP_ALIGNMENT_FLOAT32_IEEE 10000000000 Compu_DOCT_vdr -10000000000 10000000000 /end CHARACTERISTIC
/begin COMPU_METHOD Compu_DOCT_vdr " " RAT_FUNC "%.3" "ohms" COEFFS 0 1 0 0 0 1 /end COMPU_METHOD
/begin CHARACTERISTIC DPFT_vdr "IOConfig # DPFT_vdr" VALUE 0x001ed32c /* @ECU_Address@DPFT_vdr@0x010093F0@ */ ECIPP_ALIGNMENT_FLOAT32_IEEE 10000000000 Compu_DPFT_vdr -10000000000 10000000000 /end CHARACTERISTIC
/begin COMPU_METHOD Compu_DPFT_vdr " " RAT_FUNC "%.3" "ohms" COEFFS 0 1 0 0 0 1 /end COMPU_METHOD
/begin CHARACTERISTIC SCRT_vdr "IOConfig # SCRT_vdr" VALUE 0x001ed330 /* @ECU_Address@SCRT_vdr@0x010093F8@ */ ECIPP_ALIGNMENT_FLOAT32_IEEE 10000000000 Compu_SCRT_vdr -10000000000 10000000000 /end CHARACTERISTIC
/begin COMPU_METHOD Compu_SCRT_vdr " " RAT_FUNC "%.3" "ohms" COEFFS 0 1 0 0 0 1 /end COMPU_METHOD
/begin CHARACTERISTIC TOT_vdr "IOConfig # TOT_vdr" VALUE 0x001c3c88 /* @ECU_Address@TOT_vdr@0x01009400@ */ ECIPP_ALIGNMENT_FLOAT32_IEEE 10000000000 Compu_TOT_vdr -10000000000 10000000000 /end CHARACTERISTIC
/begin COMPU_METHOD Compu_TOT_vdr " " RAT_FUNC "%.3" "ohms" COEFFS 0 1 0 0 0 1 /end COMPU_METHOD
/begin CHARACTERISTIC EGT_Taux_cal "{EGT_Taux_cal&0xff=0:Fuel source}{EGT_Taux_cal&0xff=1:Exhaust manifold/riser}{EGT_Taux_cal&0xff=2:Aux Temp A}{EGT_Taux_cal&0xff=3:Aux Temp B}{EGT_Taux_cal&0xff=4:Aux Temp C}{EGT_Taux_cal&0xff=5:Aux Temp D}" VALUE 0x001c86dd /* @ECU_Address@EGT_Taux_cal@0x010094B8@ */ ECIPP_ALIGNMENT_UBYTE 255 EGT_Taux_cal_COMPU_VTAB 0 255 BIT_MASK 0xff /end CHARACTERISTIC
/begin COMPU_METHOD EGT_Taux_cal_COMPU_VTAB "Verbal Table" TAB_VERB "%.0" "list" COMPU_TAB_REF EGT_Taux_cal_COMPU_VTAB_REF /end COMPU_METHOD
/begin COMPU_VTAB EGT_Taux_cal_COMPU_VTAB_REF "Verbal Table" TAB_VERB 6 0 "Fuel source" 1 "Exhaust manifold/riser" 2 "Aux Temp A" 3 "Aux Temp B" 4 "Aux Temp C" 5 "Aux Temp D" DEFAULT_VALUE "UNKNOWN" /end COMPU_VTAB
/begin CHARACTERISTIC EGRT_Taux_cal "{EGRT_Taux_cal&0xff=0:Fuel source}{EGRT_Taux_cal&0xff=1:Exhaust manifold/riser}{EGRT_Taux_cal&0xff=2:Aux Temp A}{EGRT_Taux_cal&0xff=3:Aux Temp B}{EGRT_Taux_cal&0xff=4:Aux Temp C}{EGRT_Taux_cal&0xff=5:Aux Temp D}" VALUE 0x001c0aa4 /* @ECU_Address@EGRT_Taux_cal@0x010094C0@ */ ECIPP_ALIGNMENT_UBYTE 255 EGRT_Taux_cal_COMPU_VTAB 0 255 BIT_MASK 0xff /end CHARACTERISTIC
/begin COMPU_METHOD EGRT_Taux_cal_COMPU_VTAB "Verbal Table" TAB_VERB "%.0" "list" COMPU_TAB_REF EGRT_Taux_cal_COMPU_VTAB_REF /end COMPU_METHOD
/begin COMPU_VTAB EGRT_Taux_cal_COMPU_VTAB_REF "Verbal Table" TAB_VERB 6 0 "Fuel source" 1 "Exhaust manifold/riser" 2 "Aux Temp A" 3 "Aux Temp B" 4 "Aux Temp C" 5 "Aux Temp D" DEFAULT_VALUE "UNKNOWN" /end COMPU_VTAB
/begin CHARACTERISTIC DOCT_Taux_cal "{DOCT_Taux_cal&0xff=0:Fuel source}{DOCT_Taux_cal&0xff=1:Exhaust manifold/riser}{DOCT_Taux_cal&0xff=2:Aux Temp A}{DOCT_Taux_cal&0xff=3:Aux Temp B}{DOCT_Taux_cal&0xff=4:Aux Temp C}{DOCT_Taux_cal&0xff=5:Aux Temp D}" VALUE 0x001f1a78 /* @ECU_Address@DOCT_Taux_cal@0x010094C8@ */ ECIPP_ALIGNMENT_UBYTE 255 DOCT_Taux_cal_COMPU_VTAB 0 255 BIT_MASK 0xff /end CHARACTERISTIC
/begin COMPU_METHOD DOCT_Taux_cal_COMPU_VTAB "Verbal Table" TAB_VERB "%.0" "list" COMPU_TAB_REF DOCT_Taux_cal_COMPU_VTAB_REF /end COMPU_METHOD
/begin COMPU_VTAB DOCT_Taux_cal_COMPU_VTAB_REF "Verbal Table" TAB_VERB 6 0 "Fuel source" 1 "Exhaust manifold/riser" 2 "Aux Temp A" 3 "Aux Temp B" 4 "Aux Temp C" 5 "Aux Temp D" DEFAULT_VALUE "UNKNOWN" /end COMPU_VTAB
/begin CHARACTERISTIC DPFT_Taux_cal "{DPFT_Taux_cal&0xff=0:Fuel source}{DPFT_Taux_cal&0xff=1:Exhaust manifold/riser}{DPFT_Taux_cal&0xff=2:Aux Temp A}{DPFT_Taux_cal&0xff=3:Aux Temp B}{DPFT_Taux_cal&0xff=4:Aux Temp C}{DPFT_Taux_cal&0xff=5:Aux Temp D}" VALUE 0x001f1a7a /* @ECU_Address@DPFT_Taux_cal@0x010094D0@ */ ECIPP_ALIGNMENT_UBYTE 255 DPFT_Taux_cal_COMPU_VTAB 0 255 BIT_MASK 0xff /end CHARACTERISTIC
/begin COMPU_METHOD DPFT_Taux_cal_COMPU_VTAB "Verbal Table" TAB_VERB "%.0" "list" COMPU_TAB_REF DPFT_Taux_cal_COMPU_VTAB_REF /end COMPU_METHOD
/begin COMPU_VTAB DPFT_Taux_cal_COMPU_VTAB_REF "Verbal Table" TAB_VERB 6 0 "Fuel source" 1 "Exhaust manifold/riser" 2 "Aux Temp A" 3 "Aux Temp B" 4 "Aux Temp C" 5 "Aux Temp D" DEFAULT_VALUE "UNKNOWN" /end COMPU_VTAB
/begin CHARACTERISTIC SCRT_Taux_cal "{SCRT_Taux_cal&0xff=0:Fuel source}{SCRT_Taux_cal&0xff=1:Exhaust manifold/riser}{SCRT_Taux_cal&0xff=2:Aux Temp A}{SCRT_Taux_cal&0xff=3:Aux Temp B}{SCRT_Taux_cal&0xff=4:Aux Temp C}{SCRT_Taux_cal&0xff=5:Aux Temp D}" VALUE 0x001f1a7e /* @ECU_Address@SCRT_Taux_cal@0x010094D8@ */ ECIPP_ALIGNMENT_UBYTE 255 SCRT_Taux_cal_COMPU_VTAB 0 255 BIT_MASK 0xff /end CHARACTERISTIC
/begin COMPU_METHOD SCRT_Taux_cal_COMPU_VTAB "Verbal Table" TAB_VERB "%.0" "list" COMPU_TAB_REF SCRT_Taux_cal_COMPU_VTAB_REF /end COMPU_METHOD
/begin COMPU_VTAB SCRT_Taux_cal_COMPU_VTAB_REF "Verbal Table" TAB_VERB 6 0 "Fuel source" 1 "Exhaust manifold/riser" 2 "Aux Temp A" 3 "Aux Temp B" 4 "Aux Temp C" 5 "Aux Temp D" DEFAULT_VALUE "UNKNOWN" /end COMPU_VTAB
/begin CHARACTERISTIC TOT_Taux_cal "{TOT_Taux_cal&0xff=0:Fuel source}{TOT_Taux_cal&0xff=1:Exhaust manifold/riser}{TOT_Taux_cal&0xff=2:Aux Temp A}{TOT_Taux_cal&0xff=3:Aux Temp B}{TOT_Taux_cal&0xff=4:Aux Temp C}{TOT_Taux_cal&0xff=5:Aux Temp D}" VALUE 0x001c8f41 /* @ECU_Address@TOT_Taux_cal@0x010094E0@ */ ECIPP_ALIGNMENT_UBYTE 255 TOT_Taux_cal_COMPU_VTAB 0 255 BIT_MASK 0xff /end CHARACTERISTIC
/begin COMPU_METHOD TOT_Taux_cal_COMPU_VTAB "Verbal Table" TAB_VERB "%.0" "list" COMPU_TAB_REF TOT_Taux_cal_COMPU_VTAB_REF /end COMPU_METHOD
/begin COMPU_VTAB TOT_Taux_cal_COMPU_VTAB_REF "Verbal Table" TAB_VERB 6 0 "Fuel source" 1 "Exhaust manifold/riser" 2 "Aux Temp A" 3 "Aux Temp B" 4 "Aux Temp C" 5 "Aux Temp D" DEFAULT_VALUE "UNKNOWN" /end COMPU_VTAB
/begin CHARACTERISTIC EMWT1_Taux_cal "{EMWT1_Taux_cal&0xff=0:Fuel source}{EMWT1_Taux_cal&0xff=1:Exhaust manifold/riser}{EMWT1_Taux_cal&0xff=2:Aux Temp A}{EMWT1_Taux_cal&0xff=3:Aux Temp B}{EMWT1_Taux_cal&0xff=4:Aux Temp C}{EMWT1_Taux_cal&0xff=5:Aux Temp D}" VALUE 0x001c86e4 /* @ECU_Address@EMWT1_Taux_cal@0x010094E8@ */ ECIPP_ALIGNMENT_UBYTE 255 EMWT1_Taux_cal_COMPU_VTAB 0 255 BIT_MASK 0xff /end CHARACTERISTIC
/begin COMPU_METHOD EMWT1_Taux_cal_COMPU_VTAB "Verbal Table" TAB_VERB "%.0" "list" COMPU_TAB_REF EMWT1_Taux_cal_COMPU_VTAB_REF /end COMPU_METHOD
/begin COMPU_VTAB EMWT1_Taux_cal_COMPU_VTAB_REF "Verbal Table" TAB_VERB 6 0 "Fuel source" 1 "Exhaust manifold/riser" 2 "Aux Temp A" 3 "Aux Temp B" 4 "Aux Temp C" 5 "Aux Temp D" DEFAULT_VALUE "UNKNOWN" /end COMPU_VTAB
/begin CHARACTERISTIC EMWT2_Taux_cal "{EMWT2_Taux_cal&0xff=0:Fuel source}{EMWT2_Taux_cal&0xff=1:Exhaust manifold/riser}{EMWT2_Taux_cal&0xff=2:Aux Temp A}{EMWT2_Taux_cal&0xff=3:Aux Temp B}{EMWT2_Taux_cal&0xff=4:Aux Temp C}{EMWT2_Taux_cal&0xff=5:Aux Temp D}" VALUE 0x001c86e6 /* @ECU_Address@EMWT2_Taux_cal@0x010094F0@ */ ECIPP_ALIGNMENT_UBYTE 255 EMWT2_Taux_cal_COMPU_VTAB 0 255 BIT_MASK 0xff /end CHARACTERISTIC
/begin COMPU_METHOD EMWT2_Taux_cal_COMPU_VTAB "Verbal Table" TAB_VERB "%.0" "list" COMPU_TAB_REF EMWT2_Taux_cal_COMPU_VTAB_REF /end COMPU_METHOD
/begin COMPU_VTAB EMWT2_Taux_cal_COMPU_VTAB_REF "Verbal Table" TAB_VERB 6 0 "Fuel source" 1 "Exhaust manifold/riser" 2 "Aux Temp A" 3 "Aux Temp B" 4 "Aux Temp C" 5 "Aux Temp D" DEFAULT_VALUE "UNKNOWN" /end COMPU_VTAB
/begin CHARACTERISTIC ERWT1_Taux_cal "{ERWT1_Taux_cal&0xff=0:Fuel source}{ERWT1_Taux_cal&0xff=1:Exhaust manifold/riser}{ERWT1_Taux_cal&0xff=2:Aux Temp A}{ERWT1_Taux_cal&0xff=3:Aux Temp B}{ERWT1_Taux_cal&0xff=4:Aux Temp C}{ERWT1_Taux_cal&0xff=5:Aux Temp D}" VALUE 0x001c86ea /* @ECU_Address@ERWT1_Taux_cal@0x010094F8@ */ ECIPP_ALIGNMENT_UBYTE 255 ERWT1_Taux_cal_COMPU_VTAB 0 255 BIT_MASK 0xff /end CHARACTERISTIC
/begin COMPU_METHOD ERWT1_Taux_cal_COMPU_VTAB "Verbal Table" TAB_VERB "%.0" "list" COMPU_TAB_REF ERWT1_Taux_cal_COMPU_VTAB_REF /end COMPU_METHOD
/begin COMPU_VTAB ERWT1_Taux_cal_COMPU_VTAB_REF "Verbal Table" TAB_VERB 6 0 "Fuel source" 1 "Exhaust manifold/riser" 2 "Aux Temp A" 3 "Aux Temp B" 4 "Aux Temp C" 5 "Aux Temp D" DEFAULT_VALUE "UNKNOWN" /end COMPU_VTAB
/end MODULE
/end PROJECT
