ASAP2_VERSION 1 61
/begin PROJECT Econtrols_4G "4G Test"
/begin HEADER "4G A2L Configuration" PROJECT_NO EControls4G /* config for version control */ VERSION "$Revision: 82130 $:" /* config for version control */ /end HEADER
/begin MODULE EControls_4G_SH2A "EControls 4G"
/begin MOD_COMMON "" DEPOSIT ABSOLUTE BYTE_ORDER MSB_FIRST /end MOD_COMMON
/* Define the Record Layouts */
/begin RECORD_LAYOUT ECIPP_ALIGNMENT_UBYTE FNC_VALUES 1 UBYTE COLUMN_DIR DIRECT /end RECORD_LAYOUT
/begin RECORD_LAYOUT ECIPP_ALIGNMENT_UWORD FNC_VALUES 1 UWORD COLUMN_DIR DIRECT /end RECORD_LAYOUT
/begin RECORD_LAYOUT ECIPP_ALIGNMENT_SWORD FNC_VALUES 1 SWORD COLUMN_DIR DIRECT /end RECORD_LAYOUT
/begin RECORD_LAYOUT ECIPP_Lookup_SWORD AXIS_PTS_X 1 SWORD INDEX_INCR DIRECT /end RECORD_LAYOUT
/begin RECORD_LAYOUT ECIPP_ALIGNMENT_ULONG FNC_VALUES 1 ULONG COLUMN_DIR DIRECT /end RECORD_LAYOUT
/begin MEASUREMENT TPS1_raw "TPS1_raw" UWORD Compu_TPS1_raw 0 0 0 5.00114468864469 ECU_ADDRESS 0x010000F0 /end MEASUREMENT
/begin COMPU_METHOD Compu_TPS1_raw " " RAT_FUNC "%.3" "volts" COEFFS 0 13104 0 0 0 1 /end COMPU_METHOD
/begin MEASUREMENT TPS2_raw "TPS2_raw" UWORD Compu_TPS2_raw 0 0 0 5.00114468864469 ECU_ADDRESS 0x010000F8 /end MEASUREMENT
/begin COMPU_METHOD Compu_TPS2_raw " " RAT_FUNC "%.3" "volts" COEFFS 0 13104 0 0 0 1 /end COMPU_METHOD
/begin MEASUREMENT RS_dot "Road speed derivative" SWORD Compu_RS_dot 0 0 -32 31.9990234375 ECU_ADDRESS 0x01000490 /end MEASUREMENT
/begin COMPU_METHOD Compu_RS_dot " " RAT_FUNC "%.2" "km/hr/sec" COEFFS 0 1024 0 0 0 1 /end COMPU_METHOD
/begin MEASUREMENT RS_dot_dz "Road speed derivative w/ deadzone" SWORD Compu_RS_dot_dz 0 0 -32 31.9990234375 ECU_ADDRESS 0x010004A8 /end MEASUREMENT
/begin COMPU_METHOD Compu_RS_dot_dz " " RAT_FUNC "%.2" "km/hr/sec" COEFFS 0 1024 0 0 0 1 /end COMPU_METHOD
/begin MEASUREMENT CRK_ana_raw "CRK_ana_raw" UWORD Compu_CRK_ana_raw 0 0 0 5.00114468864469 ECU_ADDRESS 0x010004C0 /end MEASUREMENT
/begin COMPU_METHOD Compu_CRK_ana_raw " " RAT_FUNC "%.3" "-" COEFFS 0 13104 0 0 0 1 /end COMPU_METHOD
/begin MEASUREMENT MAG_BIAS_raw "MAG_BIAS_raw" UWORD Compu_MAG_BIAS_raw 0 0 0 5.00114468864469 ECU_ADDRESS 0x010004C8 /end MEASUREMENT
/begin COMPU_METHOD Compu_MAG_BIAS_raw " " RAT_FUNC "%.3" "-" COEFFS 0 13104 0 0 0 1 /end COMPU_METHOD
/begin MEASUREMENT KNK1H_raw "KNK1H_raw" UWORD Compu_KNK1H_raw 0 0 0 5.00114468864469 ECU_ADDRESS 0x010004D0 /end MEASUREMENT
/begin COMPU_METHOD Compu_KNK1H_raw " " RAT_FUNC "%.3" "volts" COEFFS 0 13104 0 0 0 1 /end COMPU_METHOD
/begin MEASUREMENT KNK2H_raw "KNK2H_raw" UWORD Compu_KNK2H_raw 0 0 0 5.00114468864469 ECU_ADDRESS 0x010004D8 /end MEASUREMENT
/begin COMPU_METHOD Compu_KNK2H_raw " " RAT_FUNC "%.3" "volts" COEFFS 0 13104 0 0 0 1 /end COMPU_METHOD
/begin MEASUREMENT KNK1L_raw "KNK1L_raw" UWORD Compu_KNK1L_raw 0 0 0 5.00114468864469 ECU_ADDRESS 0x010004E0 /end MEASUREMENT
/begin COMPU_METHOD Compu_KNK1L_raw " " RAT_FUNC "%.3" "volts" COEFFS 0 13104 0 0 0 1 /end COMPU_METHOD
/begin MEASUREMENT KNK2L_raw "KNK2L_raw" UWORD Compu_KNK2L_raw 0 0 0 5.00114468864469 ECU_ADDRESS 0x010004E8 /end MEASUREMENT
/begin COMPU_METHOD Compu_KNK2L_raw " " RAT_FUNC "%.3" "volts" COEFFS 0 13104 0 0 0 1 /end COMPU_METHOD
/begin MEASUREMENT RS_dt "Roadspeed pulse time" UWORD Compu_RS_dt 0 0 0 209.712 ECU_ADDRESS 0x01001688 /end MEASUREMENT
/begin COMPU_METHOD Compu_RS_dt " " RAT_FUNC "%.2" "ms" COEFFS 0 312.5 0 0 0 1 /end COMPU_METHOD
/begin MEASUREMENT TIP_raw "TIP_raw" UWORD Compu_TIP_raw 0 0 0 5.00114468864469 ECU_ADDRESS 0x01002678 /end MEASUREMENT
/begin COMPU_METHOD Compu_TIP_raw " " RAT_FUNC "%.3" "volts" COEFFS 0 13104 0 0 0 1 /end COMPU_METHOD
/begin MEASUREMENT FPP1_raw "FPP1_raw" UWORD Compu_FPP1_raw 0 0 0 5.00114468864469 ECU_ADDRESS 0x01002680 /end MEASUREMENT
/begin COMPU_METHOD Compu_FPP1_raw " " RAT_FUNC "%.3" "volts" COEFFS 0 13104 0 0 0 1 /end COMPU_METHOD
/begin MEASUREMENT FPP2_raw "FPP2_raw" UWORD Compu_FPP2_raw 0 0 0 5.00114468864469 ECU_ADDRESS 0x01002688 /end MEASUREMENT
/begin COMPU_METHOD Compu_FPP2_raw " " RAT_FUNC "%.3" "volts" COEFFS 0 13104 0 0 0 1 /end COMPU_METHOD
/begin MEASUREMENT FRP_raw "FRP_raw" UWORD Compu_FRP_raw 0 0 0 5.00114468864469 ECU_ADDRESS 0x01002690 /end MEASUREMENT
/begin COMPU_METHOD Compu_FRP_raw " " RAT_FUNC "%.3" "volts" COEFFS 0 13104 0 0 0 1 /end COMPU_METHOD
/begin MEASUREMENT WGP_raw "WGP_raw" UWORD Compu_WGP_raw 0 0 0 5.00114468864469 ECU_ADDRESS 0x01002698 /end MEASUREMENT
/begin COMPU_METHOD Compu_WGP_raw " " RAT_FUNC "%.3" "volts" COEFFS 0 13104 0 0 0 1 /end COMPU_METHOD
/begin MEASUREMENT EGO1_raw "EGO1_raw" UWORD Compu_EGO1_raw 0 0 0 5.00114468864469 ECU_ADDRESS 0x010026A0 /end MEASUREMENT
/begin COMPU_METHOD Compu_EGO1_raw " " RAT_FUNC "%.3" "volts" COEFFS 0 13104 0 0 0 1 /end COMPU_METHOD
/begin MEASUREMENT EGO2_raw "EGO2_raw" UWORD Compu_EGO2_raw 0 0 0 5.00114468864469 ECU_ADDRESS 0x010026A8 /end MEASUREMENT
/begin COMPU_METHOD Compu_EGO2_raw " " RAT_FUNC "%.3" "volts" COEFFS 0 13104 0 0 0 1 /end COMPU_METHOD
/begin MEASUREMENT EGO3_raw "EGO3_raw" UWORD Compu_EGO3_raw 0 0 0 5.00114468864469 ECU_ADDRESS 0x010026B0 /end MEASUREMENT
/begin COMPU_METHOD Compu_EGO3_raw " " RAT_FUNC "%.3" "volts" COEFFS 0 13104 0 0 0 1 /end COMPU_METHOD
/begin MEASUREMENT Vbat_raw "Vbat_raw" UWORD Compu_Vbat_raw 0 0 0 5.00114468864469 ECU_ADDRESS 0x010026B8 /end MEASUREMENT
/begin COMPU_METHOD Compu_Vbat_raw " " RAT_FUNC "%.3" "volts" COEFFS 0 13104 0 0 0 1 /end COMPU_METHOD
/begin MEASUREMENT Vsw_raw "Vsw_raw" UWORD Compu_Vsw_raw 0 0 0 5.00114468864469 ECU_ADDRESS 0x010026C0 /end MEASUREMENT
/begin COMPU_METHOD Compu_Vsw_raw " " RAT_FUNC "%.3" "volts" COEFFS 0 13104 0 0 0 1 /end COMPU_METHOD
/begin MEASUREMENT VE5a_FB_raw "VE5a_FB_raw" UWORD Compu_VE5a_FB_raw 0 0 0 5.00114468864469 ECU_ADDRESS 0x010026C8 /end MEASUREMENT
/begin COMPU_METHOD Compu_VE5a_FB_raw " " RAT_FUNC "%.3" "volts" COEFFS 0 13104 0 0 0 1 /end COMPU_METHOD
/begin MEASUREMENT FT_raw "FT_raw" UWORD Compu_FT_raw 0 0 0 5.00114468864469 ECU_ADDRESS 0x010026E0 /end MEASUREMENT
/begin COMPU_METHOD Compu_FT_raw " " RAT_FUNC "%.3" "volts" COEFFS 0 13104 0 0 0 1 /end COMPU_METHOD
/begin MEASUREMENT GOV1_raw "GOV1_raw" UWORD Compu_GOV1_raw 0 0 0 5.00114468864469 ECU_ADDRESS 0x010026F0 /end MEASUREMENT
/begin COMPU_METHOD Compu_GOV1_raw " " RAT_FUNC "%.3" "volts" COEFFS 0 13104 0 0 0 1 /end COMPU_METHOD
/begin MEASUREMENT GOV2_raw "AUX_DIG4/GOV2_raw" UWORD Compu_GOV2_raw 0 0 0 5.00114468864469 ECU_ADDRESS 0x010026F8 /end MEASUREMENT
/begin COMPU_METHOD Compu_GOV2_raw " " RAT_FUNC "%.3" "volts" COEFFS 0 13104 0 0 0 1 /end COMPU_METHOD
/begin MEASUREMENT EGO1H_LS_raw "EGO1H_LS_raw" UWORD Compu_EGO1H_LS_raw 0 0 0 5.00114468864469 ECU_ADDRESS 0x01002720 /end MEASUREMENT
/begin COMPU_METHOD Compu_EGO1H_LS_raw " " RAT_FUNC "%.3" "volts" COEFFS 0 13104 0 0 0 1 /end COMPU_METHOD
/begin MEASUREMENT EGO2H_LS_raw "EGO2H_LS_raw" UWORD Compu_EGO2H_LS_raw 0 0 0 5.00114468864469 ECU_ADDRESS 0x01002728 /end MEASUREMENT
/begin COMPU_METHOD Compu_EGO2H_LS_raw " " RAT_FUNC "%.3" "volts" COEFFS 0 13104 0 0 0 1 /end COMPU_METHOD
/begin MEASUREMENT EGO3H_LS_raw "EGO3H_LS_raw" UWORD Compu_EGO3H_LS_raw 0 0 0 5.00114468864469 ECU_ADDRESS 0x01002730 /end MEASUREMENT
/begin COMPU_METHOD Compu_EGO3H_LS_raw " " RAT_FUNC "%.3" "volts" COEFFS 0 13104 0 0 0 1 /end COMPU_METHOD
/begin MEASUREMENT OILP_raw "OILP_raw" UWORD Compu_OILP_raw 0 0 0 5.00114468864469 ECU_ADDRESS 0x01002740 /end MEASUREMENT
/begin COMPU_METHOD Compu_OILP_raw " " RAT_FUNC "%.3" "volts" COEFFS 0 13104 0 0 0 1 /end COMPU_METHOD
/begin MEASUREMENT AUX_DIG1_raw "AUX_DIG1_raw" UWORD Compu_AUX_DIG1_raw 0 0 0 5.00114468864469 ECU_ADDRESS 0x01002748 /end MEASUREMENT
/begin COMPU_METHOD Compu_AUX_DIG1_raw " " RAT_FUNC "%.3" "volts" COEFFS 0 13104 0 0 0 1 /end COMPU_METHOD
/begin MEASUREMENT AUX_DIG2_raw "AUX_DIG2_raw" UWORD Compu_AUX_DIG2_raw 0 0 0 5.00114468864469 ECU_ADDRESS 0x01002750 /end MEASUREMENT
/begin COMPU_METHOD Compu_AUX_DIG2_raw " " RAT_FUNC "%.3" "volts" COEFFS 0 13104 0 0 0 1 /end COMPU_METHOD
/begin MEASUREMENT AUX_PWM1_FB_raw "AUX_PWM1_FB_raw" UWORD Compu_AUX_PWM1_FB_raw 0 0 0 5.00114468864469 ECU_ADDRESS 0x01002758 /end MEASUREMENT
/begin COMPU_METHOD Compu_AUX_PWM1_FB_raw " " RAT_FUNC "%.3" "volts" COEFFS 0 13104 0 0 0 1 /end COMPU_METHOD
/begin MEASUREMENT AUX_PWM2_FB_raw "AUX_PWM2_FB_raw" UWORD Compu_AUX_PWM2_FB_raw 0 0 0 5.00114468864469 ECU_ADDRESS 0x01002760 /end MEASUREMENT
/begin COMPU_METHOD Compu_AUX_PWM2_FB_raw " " RAT_FUNC "%.3" "volts" COEFFS 0 13104 0 0 0 1 /end COMPU_METHOD
/begin MEASUREMENT EGO4_raw "EGO4_raw" UWORD Compu_EGO4_raw 0 0 0 5.00114468864469 ECU_ADDRESS 0x01002E30 /end MEASUREMENT
/begin COMPU_METHOD Compu_EGO4_raw " " RAT_FUNC "%.3" "volts" COEFFS 0 13104 0 0 0 1 /end COMPU_METHOD
/begin MEASUREMENT AUX_DIG3_raw "AUX_DIG3_raw" UWORD Compu_AUX_DIG3_raw 0 0 0 5.00114468864469 ECU_ADDRESS 0x01002E38 /end MEASUREMENT
/begin COMPU_METHOD Compu_AUX_DIG3_raw " " RAT_FUNC "%.3" "volts" COEFFS 0 13104 0 0 0 1 /end COMPU_METHOD
/begin MEASUREMENT EGT_raw "EGT_raw" UWORD Compu_EGT_raw 0 0 0 5.00114468864469 ECU_ADDRESS 0x01002E40 /end MEASUREMENT
/begin COMPU_METHOD Compu_EGT_raw " " RAT_FUNC "%.3" "volts" COEFFS 0 13104 0 0 0 1 /end COMPU_METHOD
/begin MEASUREMENT VE5b_FB_raw "VE5b_FB_raw" UWORD Compu_VE5b_FB_raw 0 0 0 5.00114468864469 ECU_ADDRESS 0x01002E48 /end MEASUREMENT
/begin COMPU_METHOD Compu_VE5b_FB_raw " " RAT_FUNC "%.3" "volts" COEFFS 0 13104 0 0 0 1 /end COMPU_METHOD
/begin MEASUREMENT EGO4H_LS_raw "EGO4H_LS_raw" UWORD Compu_EGO4H_LS_raw 0 0 0 5.00114468864469 ECU_ADDRESS 0x01002E50 /end MEASUREMENT
/begin COMPU_METHOD Compu_EGO4H_LS_raw " " RAT_FUNC "%.3" "volts" COEFFS 0 13104 0 0 0 1 /end COMPU_METHOD
/begin MEASUREMENT AUX_PWM3_FB_raw "AUX_PWM3_FB_raw" UWORD Compu_AUX_PWM3_FB_raw 0 0 0 5.00114468864469 ECU_ADDRESS 0x01002E58 /end MEASUREMENT
/begin COMPU_METHOD Compu_AUX_PWM3_FB_raw " " RAT_FUNC "%.3" "volts" COEFFS 0 13104 0 0 0 1 /end COMPU_METHOD
/begin MEASUREMENT AUX_PWM4_FB_raw "AUX_PWM4_FB_raw" UWORD Compu_AUX_PWM4_FB_raw 0 0 0 5.00114468864469 ECU_ADDRESS 0x01002E60 /end MEASUREMENT
/begin COMPU_METHOD Compu_AUX_PWM4_FB_raw " " RAT_FUNC "%.3" "volts" COEFFS 0 13104 0 0 0 1 /end COMPU_METHOD
/begin MEASUREMENT AUX_PWM5_FB_raw "AUX_PWM5_FB_raw" UWORD Compu_AUX_PWM5_FB_raw 0 0 0 5.00114468864469 ECU_ADDRESS 0x01002E68 /end MEASUREMENT
/begin COMPU_METHOD Compu_AUX_PWM5_FB_raw " " RAT_FUNC "%.3" "volts" COEFFS 0 13104 0 0 0 1 /end COMPU_METHOD
/begin CHARACTERISTIC RS_pulse_space "Roadspeed pulse spacing filter" VALUE 0x001c7ef6 /* @ECU_Address@RS_pulse_space@0x01003138@ */ ECIPP_ALIGNMENT_UWORD 210 Compu_RS_pulse_space 0 209.712 /end CHARACTERISTIC
/begin COMPU_METHOD Compu_RS_pulse_space " " RAT_FUNC "%.3" "ms" COEFFS 0 312.5 0 0 0 1 /end COMPU_METHOD
/begin MEASUREMENT RS_pulse_cnt "Roadspeed pulse accumulator" UWORD Compu_RS_pulse_cnt 0 0 0 65535 ECU_ADDRESS 0x01003140 /end MEASUREMENT
/begin COMPU_METHOD Compu_RS_pulse_cnt " " RAT_FUNC "%.0" "pulses" COEFFS 0 1 0 0 0 1 /end COMPU_METHOD
/begin MEASUREMENT RS_max_load "Roadspeed control output limit" UWORD Compu_RS_max_load 0 0 0 99.9984741210938 ECU_ADDRESS 0x01003148 /end MEASUREMENT
/begin COMPU_METHOD Compu_RS_max_load " " RAT_FUNC "%.1" "% load/RPM" COEFFS 0 655.36 0 0 0 1 /end COMPU_METHOD
/begin MEASUREMENT RS_max_TPS "Roadspeed TPS control TPS limit" UWORD Compu_RS_max_TPS 0 0 0 99.9984741210938 ECU_ADDRESS 0x01003150 /end MEASUREMENT
/begin COMPU_METHOD Compu_RS_max_TPS " " RAT_FUNC "%.1" "%" COEFFS 0 655.36 0 0 0 1 /end COMPU_METHOD
/begin MEASUREMENT RS_Iacc "Roadspeed control integrator" SWORD Compu_RS_Iacc 0 0 -800 799.9755859375 ECU_ADDRESS 0x01003158 /end MEASUREMENT
/begin COMPU_METHOD Compu_RS_Iacc " " RAT_FUNC "%.1" "% load/RPM" COEFFS 0 40.96 0 0 0 1 /end COMPU_METHOD
/begin CHARACTERISTIC RS_hist_avg_t "Roadspeed speed averaging window" VALUE 0x001c7ede /* @ECU_Address@RS_hist_avg_t@0x01003168@ */ ECIPP_ALIGNMENT_UWORD 65535 Compu_RS_hist_avg_t 0 65535 /end CHARACTERISTIC
/begin COMPU_METHOD Compu_RS_hist_avg_t " " RAT_FUNC "%.0" "ms" COEFFS 0 1 0 0 0 1 /end COMPU_METHOD
/begin CHARACTERISTIC RS_hist_tout "Roadspeed speed zeroing time" VALUE 0x001c7ee0 /* @ECU_Address@RS_hist_tout@0x01003170@ */ ECIPP_ALIGNMENT_UWORD 65535 Compu_RS_hist_tout 0 65535 /end CHARACTERISTIC
/begin COMPU_METHOD Compu_RS_hist_tout " " RAT_FUNC "%.0" "ms" COEFFS 0 1 0 0 0 1 /end COMPU_METHOD
/begin CHARACTERISTIC RS_dot_window "Roadspeed acceleration window" VALUE 0x001CA104 /* @ECU_Address@RS_dot_window@0x01003178@ */ ECIPP_ALIGNMENT_UWORD 65535 Compu_RS_dot_window 0 65535 /end CHARACTERISTIC
/begin COMPU_METHOD Compu_RS_dot_window " " RAT_FUNC "%.0" "ms" COEFFS 0 1 0 0 0 1 /end COMPU_METHOD
/begin CHARACTERISTIC RS_speed_tau "Roadspeed speed input low-pass" VALUE 0x001CA100 /* @ECU_Address@RS_speed_tau@0x01003180@ */ ECIPP_ALIGNMENT_UWORD 327680 Compu_RS_speed_tau 0.45084 327680 /end CHARACTERISTIC
/begin COMPU_METHOD Compu_RS_speed_tau " " FORM "%.1" "ms"
 /begin FORMULA "-5 / log(1 - (X1 / 65536))" FORMULA_INV "(1 - exp(-5/X1)) * 65536" /end FORMULA
/end COMPU_METHOD
/begin CHARACTERISTIC RS_TPS_tau "Roadspeed control output low-pass" VALUE 0x001CA116 /* @ECU_Address@RS_TPS_tau@0x01003188@ */ ECIPP_ALIGNMENT_UWORD 327680 Compu_RS_TPS_tau 0.45084 327680 /end CHARACTERISTIC
/begin COMPU_METHOD Compu_RS_TPS_tau " " FORM "%.1" "ms"
 /begin FORMULA "-5 / log(1 - (X1 / 65536))" FORMULA_INV "(1 - exp(-5/X1)) * 65536" /end FORMULA
/end COMPU_METHOD
/begin CHARACTERISTIC RS_dot_tau "Roadspeed acceleration low-pass" VALUE 0x001CA102 /* @ECU_Address@RS_dot_tau@0x01003190@ */ ECIPP_ALIGNMENT_UWORD 163840 Compu_RS_dot_tau 0.16703 163840 /end CHARACTERISTIC
/begin COMPU_METHOD Compu_RS_dot_tau " " FORM "%.1" "ms"
 /begin FORMULA "-5 / log(1.0000000000001 - (X1 / 32768))" FORMULA_INV "(1.0000000000001 - exp(-5/X1)) * 32768" /end FORMULA
/end COMPU_METHOD
/begin CHARACTERISTIC RS_Kp "Roadspeed control Kp" VALUE 0x001CA108 /* @ECU_Address@RS_Kp@0x01003198@ */ ECIPP_ALIGNMENT_SWORD 800 Compu_RS_Kp -800 799.9755859375 /end CHARACTERISTIC
/begin COMPU_METHOD Compu_RS_Kp " " RAT_FUNC "%.1" "% / (km/hr)" COEFFS 0 40.96 0 0 0 1 /end COMPU_METHOD
/begin CHARACTERISTIC RS_Ki "Roadspeed control Ki" VALUE 0x001CA10E /* @ECU_Address@RS_Ki@0x010031A0@ */ ECIPP_ALIGNMENT_SWORD 400 Compu_RS_Ki -400 399.98779296875 /end CHARACTERISTIC
/begin COMPU_METHOD Compu_RS_Ki " " RAT_FUNC "%.1" "% / (km/hr) / sec" COEFFS 0 81.92 0 0 0 1 /end COMPU_METHOD
/begin CHARACTERISTIC RS_Kd "Roadspeed control Kd / Kd_decel" VALUE 0x001CA110 /* @ECU_Address@RS_Kd@0x010031A8@ */ ECIPP_ALIGNMENT_SWORD 3200 Compu_RS_Kd -3200 3199.90234375 /end CHARACTERISTIC
/begin COMPU_METHOD Compu_RS_Kd " " RAT_FUNC "%.1" "% / (km/hr) * sec" COEFFS 0 10.24 0 0 0 1 /end COMPU_METHOD
/begin CHARACTERISTIC RS_Kiv "Roadspeed control Kiv" VALUE 0x001CA114 /* @ECU_Address@RS_Kiv@0x010031B0@ */ ECIPP_ALIGNMENT_SWORD 800 Compu_RS_Kiv -800 799.9755859375 /end CHARACTERISTIC
/begin COMPU_METHOD Compu_RS_Kiv " " RAT_FUNC "%.1" "% / (km/hr)" COEFFS 0 40.96 0 0 0 1 /end COMPU_METHOD
/begin CHARACTERISTIC RS_rpm_nom "Roadspeed limit nominal rpm" VALUE 0x001c7ef8 /* @ECU_Address@RS_rpm_nom@0x010031B8@ */ ECIPP_ALIGNMENT_UWORD 65535 Compu_RS_rpm_nom 0 65535 /end CHARACTERISTIC
/begin COMPU_METHOD Compu_RS_rpm_nom " " RAT_FUNC "%.0" "rpm" COEFFS 0 1 0 0 0 1 /end COMPU_METHOD
/begin CHARACTERISTIC RS_HW_switch "Roadspeed hardware input enable{RS_HW_switch&0xff=0:Not Required}{RS_HW_switch&0xff=1:Aux PU1}{RS_HW_switch&0xff=2:Aux PU2}{RS_HW_switch&0xff=3:Aux PU3}{RS_HW_switch&0xff=4:Aux DIG1=Open/Gnd}{RS_HW_switch&0xff=5:Aux DIG2=Open/Gnd}{RS_HW_switch&0xff=6:Aux " VALUE 0x001c88d8 /* @ECU_Address@RS_HW_switch@0x010031C8@ */ ECIPP_ALIGNMENT_UBYTE 255 RS_HW_switch_COMPU_VTAB 0 255 BIT_MASK 0xff /end CHARACTERISTIC
/begin COMPU_METHOD RS_HW_switch_COMPU_VTAB "Verbal Table" TAB_VERB "%.0" "list" COMPU_TAB_REF RS_HW_switch_COMPU_VTAB_REF /end COMPU_METHOD
/begin COMPU_VTAB RS_HW_switch_COMPU_VTAB_REF "Verbal Table" TAB_VERB 8 0 "Not Required" 1 "Aux PU1" 2 "Aux PU2" 3 "Aux PU3" 4 "Aux DIG1=Open/Gnd" 5 "Aux DIG2=Open/Gnd" 6 "Aux DIG3=Open/Gnd" 7 "Aux DIG4=Gnd" DEFAULT_VALUE "UNKNOWN" /end COMPU_VTAB
/begin MEASUREMENT AUX_DIG1_volt "AUX_DIG1 volts" UWORD Compu_AUX_DIG1_volt 0 0 0 255.99609375 ECU_ADDRESS 0x01003DA8 /end MEASUREMENT
/begin COMPU_METHOD Compu_AUX_DIG1_volt " " RAT_FUNC "%.2" "volts" COEFFS 0 256 0 0 0 1 /end COMPU_METHOD
/begin MEASUREMENT AUX_DIG2_volt "AUX_DIG2 volts" UWORD Compu_AUX_DIG2_volt 0 0 0 255.99609375 ECU_ADDRESS 0x01003DB0 /end MEASUREMENT
/begin COMPU_METHOD Compu_AUX_DIG2_volt " " RAT_FUNC "%.2" "volts" COEFFS 0 256 0 0 0 1 /end COMPU_METHOD
/begin MEASUREMENT AUX_DIG3_volt "AUX_DIG3 volts" UWORD Compu_AUX_DIG3_volt 0 0 0 255.99609375 ECU_ADDRESS 0x01003DB8 /end MEASUREMENT
/begin COMPU_METHOD Compu_AUX_DIG3_volt " " RAT_FUNC "%.2" "volts" COEFFS 0 256 0 0 0 1 /end COMPU_METHOD
/begin CHARACTERISTIC RS_source "Roadspeed signal source{RS_source&0xff=0:Pulse Input}{RS_source&0xff=1:GPS Comm}{RS_source&0xff=2:J1939 Comm}" VALUE 0x001CA0FD /* @ECU_Address@RS_source@0x01003EF0@ */ ECIPP_ALIGNMENT_UBYTE 255 RS_source_COMPU_VTAB 0 255 BIT_MASK 0xff /end CHARACTERISTIC
/begin COMPU_METHOD RS_source_COMPU_VTAB "Verbal Table" TAB_VERB "%.0" "list" COMPU_TAB_REF RS_source_COMPU_VTAB_REF /end COMPU_METHOD
/begin COMPU_VTAB RS_source_COMPU_VTAB_REF "Verbal Table" TAB_VERB 3 0 "Pulse Input" 1 "GPS Comm" 2 "J1939 Comm" DEFAULT_VALUE "UNKNOWN" /end COMPU_VTAB
/begin MEASUREMENT GPS_ENZdot_tmr "GPS speed info wait timer" UWORD Compu_GPS_ENZdot_tmr 0 0 0 65535 ECU_ADDRESS 0x01003EF8 /end MEASUREMENT
/begin COMPU_METHOD Compu_GPS_ENZdot_tmr " " RAT_FUNC "%.0" "ms" COEFFS 0 1 0 0 0 1 /end COMPU_METHOD
/begin MEASUREMENT GPS_Edot "GPS east velocity" SWORD Compu_GPS_Edot 0 0 -512 511.984375 ECU_ADDRESS 0x01003F00 /end MEASUREMENT
/begin COMPU_METHOD Compu_GPS_Edot " " RAT_FUNC "%.1" "km/hr" COEFFS 0 64 0 0 0 1 /end COMPU_METHOD
/begin MEASUREMENT GPS_Ndot "GPS north velocity" SWORD Compu_GPS_Ndot 0 0 -512 511.984375 ECU_ADDRESS 0x01003F08 /end MEASUREMENT
/begin COMPU_METHOD Compu_GPS_Ndot " " RAT_FUNC "%.1" "km/hr" COEFFS 0 64 0 0 0 1 /end COMPU_METHOD
/begin MEASUREMENT GPS_ENZdot_st "GPS speed state{GPS_ENZdot_st&0xff=0:Offline}{GPS_ENZdot_st&0xff=1:Valid}{GPS_ENZdot_st&0xff=2:Error}{GPS_ENZdot_st&0xff=3:Disconnected}{GPS_ENZdot_st&0xff=4:Unacquired}" UBYTE GPS_ENZdot_st_COMPU_VTAB 0 0 0 255 ECU_ADDRESS 0x01003F10 BIT_MASK 0xff /end MEASUREMENT
/begin COMPU_METHOD GPS_ENZdot_st_COMPU_VTAB "Verbal Table" TAB_VERB "%.0" "list" COMPU_TAB_REF GPS_ENZdot_st_COMPU_VTAB_REF /end COMPU_METHOD
/begin COMPU_VTAB GPS_ENZdot_st_COMPU_VTAB_REF "Verbal Table" TAB_VERB 5 0 "Offline" 1 "Valid" 2 "Error" 3 "Disconnected" 4 "Unacquired" DEFAULT_VALUE "UNKNOWN" /end COMPU_VTAB
/begin MEASUREMENT GPS_ENspeed "GPS total speed" UWORD Compu_GPS_ENspeed 0 0 0 255.99609375 ECU_ADDRESS 0x01003F18 /end MEASUREMENT
/begin COMPU_METHOD Compu_GPS_ENspeed " " RAT_FUNC "%.1" "km/hr" COEFFS 0 256 0 0 0 1 /end COMPU_METHOD
/begin CHARACTERISTIC RS_dot_dzlim "Roadspeed acceleration deadzone" VALUE 0x001CA106 /* @ECU_Address@RS_dot_dzlim@0x01003F20@ */ ECIPP_ALIGNMENT_SWORD 32 Compu_RS_dot_dzlim -32 31.9990234375 /end CHARACTERISTIC
/begin COMPU_METHOD Compu_RS_dot_dzlim " " RAT_FUNC "%.1" "km/hr/sec" COEFFS 0 1024 0 0 0 1 /end COMPU_METHOD
/begin MEASUREMENT MaxSetPt_RS "RPM-based roadspeed limit" UWORD Compu_MaxSetPt_RS 0 0 0 255.99609375 ECU_ADDRESS 0x01003F30 /end MEASUREMENT
/begin COMPU_METHOD Compu_MaxSetPt_RS " " RAT_FUNC "%.1" "km/hr" COEFFS 0 256 0 0 0 1 /end COMPU_METHOD
/begin CHARACTERISTIC slowPWMin_ena "Slow PWM input{slowPWMin_ena&0xff=0:Disabled}{slowPWMin_ena&0xff=1:Aux PU1}{slowPWMin_ena&0xff=2:Aux PU2}{slowPWMin_ena&0xff=3:Aux PU3}{slowPWMin_ena&0xff=4:Aux PUD1}{slowPWMin_ena&0xff=5:Aux PUD2}{slowPWMin_ena&0xff=6:Aux PUD3}{slowPWMin_ena&0xff=7:Aux D" VALUE 0x001c907a /* @ECU_Address@slowPWMin_ena@0x01004100@ */ ECIPP_ALIGNMENT_UBYTE 255 slowPWMin_ena_COMPU_VTAB 0 255 BIT_MASK 0xff /end CHARACTERISTIC
/begin COMPU_METHOD slowPWMin_ena_COMPU_VTAB "Verbal Table" TAB_VERB "%.0" "list" COMPU_TAB_REF slowPWMin_ena_COMPU_VTAB_REF /end COMPU_METHOD
/begin COMPU_VTAB slowPWMin_ena_COMPU_VTAB_REF "Verbal Table" TAB_VERB 10 0 "Disabled" 1 "Aux PU1" 2 "Aux PU2" 3 "Aux PU3" 4 "Aux PUD1" 5 "Aux PUD2" 6 "Aux PUD3" 7 "Aux DIG1" 8 "Aux DIG2" 9 "Aux DIG3" DEFAULT_VALUE "UNKNOWN" /end COMPU_VTAB
/begin CHARACTERISTIC slowPWMin_per_edge "Period computation edge definition{slowPWMin_per_edge&0xff=0:Falling-To-Falling Edge}{slowPWMin_per_edge&0xff=1:Rising-To-Rising Edge}" VALUE 0x001c907b /* @ECU_Address@slowPWMin_per_edge@0x01004108@ */ ECIPP_ALIGNMENT_UBYTE 255 slowPWMin_per_edge_COMPU_VTAB 0 255 BIT_MASK 0xff /end CHARACTERISTIC
/begin COMPU_METHOD slowPWMin_per_edge_COMPU_VTAB "Verbal Table" TAB_VERB "%.0" "list" COMPU_TAB_REF slowPWMin_per_edge_COMPU_VTAB_REF /end COMPU_METHOD
/begin COMPU_VTAB slowPWMin_per_edge_COMPU_VTAB_REF "Verbal Table" TAB_VERB 2 0 "Falling-To-Falling Edge" 1 "Rising-To-Rising Edge" DEFAULT_VALUE "UNKNOWN" /end COMPU_VTAB
/begin CHARACTERISTIC slowPWMin_tout "Lost signal timeout" VALUE 0x001c84d2 /* @ECU_Address@slowPWMin_tout@0x01004110@ */ ECIPP_ALIGNMENT_UWORD 65535 Compu_slowPWMin_tout 0 65535 /end CHARACTERISTIC
/begin COMPU_METHOD Compu_slowPWMin_tout " " RAT_FUNC "%.0" "ms" COEFFS 0 1 0 0 0 1 /end COMPU_METHOD
/begin MEASUREMENT slowPWMin_period "Slow PWM input period" UWORD Compu_slowPWMin_period 0 0 0 65535 ECU_ADDRESS 0x01004118 /end MEASUREMENT
/begin COMPU_METHOD Compu_slowPWMin_period " " RAT_FUNC "%.0" "ms" COEFFS 0 1 0 0 0 1 /end COMPU_METHOD
/begin MEASUREMENT slowPWMin_DC "Slow PWM input duty-cycle" UWORD Compu_slowPWMin_DC 0 0 0 99.9984741210938 ECU_ADDRESS 0x01004120 /end MEASUREMENT
/begin COMPU_METHOD Compu_slowPWMin_DC " " RAT_FUNC "%.1" "%" COEFFS 0 655.36 0 0 0 1 /end COMPU_METHOD
/begin CHARACTERISTIC RS_setsrc "Roadspeed setpoint source{RS_setsrc&0xff=0:Fixed Value}{RS_setsrc&0xff=1:Network Setpoint}{RS_setsrc&0xff=2:Aux PD1 Proportional}{RS_setsrc&0xff=3:Aux PD2 Proportional}{RS_setsrc&0xff=4:Aux PD3 Proportional}{RS_setsrc&0xff=5:Aux PUD1 Proportional}{RS_sets" VALUE 0x001c88e4 /* @ECU_Address@RS_setsrc@0x01004128@ */ ECIPP_ALIGNMENT_UBYTE 255 RS_setsrc_COMPU_VTAB 0 255 BIT_MASK 0xff /end CHARACTERISTIC
/begin COMPU_METHOD RS_setsrc_COMPU_VTAB "Verbal Table" TAB_VERB "%.0" "list" COMPU_TAB_REF RS_setsrc_COMPU_VTAB_REF /end COMPU_METHOD
/begin COMPU_VTAB RS_setsrc_COMPU_VTAB_REF "Verbal Table" TAB_VERB 11 0 "Fixed Value" 1 "Network Setpoint" 2 "Aux PD1 Proportional" 3 "Aux PD2 Proportional" 4 "Aux PD3 Proportional" 5 "Aux PUD1 Proportional" 6 "Aux PUD2 Proportional" 7 "Aux PUD3 Proportional" 8 "Gov Switch State" 9 "Gov1" 10 "Gov2" DEFAULT_VALUE "UNKNOWN" /end COMPU_VTAB
/begin CHARACTERISTIC sPWMi_DC_lo "Duty-cycle valid if >=" VALUE 0x001c84ca /* @ECU_Address@sPWMi_DC_lo@0x01004130@ */ ECIPP_ALIGNMENT_UWORD 100 Compu_sPWMi_DC_lo 0 99.9984741210938 /end CHARACTERISTIC
/begin COMPU_METHOD Compu_sPWMi_DC_lo " " RAT_FUNC "%.1" "%" COEFFS 0 655.36 0 0 0 1 /end COMPU_METHOD
/begin CHARACTERISTIC sPWMi_DC_hi "Duty-cycle valid if <=" VALUE 0x001c84c8 /* @ECU_Address@sPWMi_DC_hi@0x01004138@ */ ECIPP_ALIGNMENT_UWORD 100 Compu_sPWMi_DC_hi 0 99.9984741210938 /end CHARACTERISTIC
/begin COMPU_METHOD Compu_sPWMi_DC_hi " " RAT_FUNC "%.1" "%" COEFFS 0 655.36 0 0 0 1 /end COMPU_METHOD
/begin CHARACTERISTIC sPWMi_per_lo "Period valid if >=" VALUE 0x001c84ce /* @ECU_Address@sPWMi_per_lo@0x01004140@ */ ECIPP_ALIGNMENT_UWORD 65535 Compu_sPWMi_per_lo 0 65535 /end CHARACTERISTIC
/begin COMPU_METHOD Compu_sPWMi_per_lo " " RAT_FUNC "%.0" "ms" COEFFS 0 1 0 0 0 1 /end COMPU_METHOD
/begin CHARACTERISTIC sPWMi_per_hi "Period valid if <=" VALUE 0x001c84cc /* @ECU_Address@sPWMi_per_hi@0x01004148@ */ ECIPP_ALIGNMENT_UWORD 65535 Compu_sPWMi_per_hi 0 65535 /end CHARACTERISTIC
/begin COMPU_METHOD Compu_sPWMi_per_hi " " RAT_FUNC "%.0" "ms" COEFFS 0 1 0 0 0 1 /end COMPU_METHOD
/begin CHARACTERISTIC RS_setsrc_valid "Proportional setpoint redundant validation{RS_setsrc_valid&0xff=0:None Required}{RS_setsrc_valid&0xff=1:Slow PWM Input Valid}" VALUE 0x001c88e7 /* @ECU_Address@RS_setsrc_valid@0x01004150@ */ ECIPP_ALIGNMENT_UBYTE 255 RS_setsrc_valid_COMPU_VTAB 0 255 BIT_MASK 0xff /end CHARACTERISTIC
/begin COMPU_METHOD RS_setsrc_valid_COMPU_VTAB "Verbal Table" TAB_VERB "%.0" "list" COMPU_TAB_REF RS_setsrc_valid_COMPU_VTAB_REF /end COMPU_METHOD
/begin COMPU_VTAB RS_setsrc_valid_COMPU_VTAB_REF "Verbal Table" TAB_VERB 2 0 "None Required" 1 "Slow PWM Input Valid" DEFAULT_VALUE "UNKNOWN" /end COMPU_VTAB
/begin MEASUREMENT slowPWMin_valid "Slow PWM input waveform status{slowPWMin_valid&0xff=0:Invalid}{slowPWMin_valid&0xff=1:Valid}" UBYTE slowPWMin_valid_COMPU_VTAB 0 0 0 255 ECU_ADDRESS 0x01004160 BIT_MASK 0xff /end MEASUREMENT
/begin COMPU_METHOD slowPWMin_valid_COMPU_VTAB "Verbal Table" TAB_VERB "%.0" "list" COMPU_TAB_REF slowPWMin_valid_COMPU_VTAB_REF /end COMPU_METHOD
/begin COMPU_VTAB slowPWMin_valid_COMPU_VTAB_REF "Verbal Table" TAB_VERB 2 0 "Invalid" 1 "Valid" DEFAULT_VALUE "UNKNOWN" /end COMPU_VTAB
/begin CHARACTERISTIC RS_prop_tau "Proportional setpoint input low-pass" VALUE 0x001c8586 /* @ECU_Address@RS_prop_tau@0x01004198@ */ ECIPP_ALIGNMENT_UWORD 327680 Compu_RS_prop_tau 0.45084 327680 /end CHARACTERISTIC
/begin COMPU_METHOD Compu_RS_prop_tau " " FORM "%.1" "ms"
 /begin FORMULA "-5 / log(1 - (X1 / 65536))" FORMULA_INV "(1 - exp(-5/X1)) * 65536" /end FORMULA
/end COMPU_METHOD
/begin MEASUREMENT Aqua_setpt_mode "Aquastar setpoint mode{Aqua_setpt_mode&0xff=0:Off}{Aqua_setpt_mode&0xff=1:Vehicle Speed}{Aqua_setpt_mode&0xff=2:Engine RPM}{Aqua_setpt_mode&0xff=3:Not Available}" UBYTE Aqua_setpt_mode_COMPU_VTAB 0 0 0 255 ECU_ADDRESS 0x010045D8 BIT_MASK 0xff /end MEASUREMENT
/begin COMPU_METHOD Aqua_setpt_mode_COMPU_VTAB "Verbal Table" TAB_VERB "%.0" "list" COMPU_TAB_REF Aqua_setpt_mode_COMPU_VTAB_REF /end COMPU_METHOD
/begin COMPU_VTAB Aqua_setpt_mode_COMPU_VTAB_REF "Verbal Table" TAB_VERB 4 0 "Off" 1 "Vehicle Speed" 2 "Engine RPM" 3 "Not Available" DEFAULT_VALUE "UNKNOWN" /end COMPU_VTAB
/begin MEASUREMENT Aqua_setpt_speed "Aquastar ground speed setpoint" UWORD Compu_Aqua_setpt_speed 0 0 0 255.99609375 ECU_ADDRESS 0x010045E0 /end MEASUREMENT
/begin COMPU_METHOD Compu_Aqua_setpt_speed " " RAT_FUNC "%.1" "km/hr" COEFFS 0 256 0 0 0 1 /end COMPU_METHOD
/begin MEASUREMENT Aqua_setpt_rpm "Aquastar engine rpm setpoint" UWORD Compu_Aqua_setpt_rpm 0 0 0 65535 ECU_ADDRESS 0x010045E8 /end MEASUREMENT
/begin COMPU_METHOD Compu_Aqua_setpt_rpm " " RAT_FUNC "%.0" "rpm" COEFFS 0 1 0 0 0 1 /end COMPU_METHOD
/begin MEASUREMENT Aqua_ENdot "Aquastar vehicle speed" SWORD Compu_Aqua_ENdot 0 0 -512 511.984375 ECU_ADDRESS 0x010045F0 /end MEASUREMENT
/begin COMPU_METHOD Compu_Aqua_ENdot " " RAT_FUNC "%.1" "km/hr" COEFFS 0 64 0 0 0 1 /end COMPU_METHOD
/begin MEASUREMENT Aqua_fwdaccel "Aquastar vehicle acceleration" SWORD Compu_Aqua_fwdaccel 0 0 -32 31.9990234375 ECU_ADDRESS 0x010045F8 /end MEASUREMENT
/begin COMPU_METHOD Compu_Aqua_fwdaccel " " RAT_FUNC "%.2" "km/hr/sec" COEFFS 0 1024 0 0 0 1 /end COMPU_METHOD
/begin MEASUREMENT Aqua_fwdaccel_st "Aquastar vehicle acceleration state{Aqua_fwdaccel_st&0xff=0:Offline}{Aqua_fwdaccel_st&0xff=1:Valid}{Aqua_fwdaccel_st&0xff=2:Error}{Aqua_fwdaccel_st&0xff=3:Disconnected}{Aqua_fwdaccel_st&0xff=4:Unacquired}" UBYTE Aqua_fwdaccel_st_COMPU_VTAB 0 0 0 255 ECU_ADDRESS 0x01004600 BIT_MASK 0xff /end MEASUREMENT
/begin COMPU_METHOD Aqua_fwdaccel_st_COMPU_VTAB "Verbal Table" TAB_VERB "%.0" "list" COMPU_TAB_REF Aqua_fwdaccel_st_COMPU_VTAB_REF /end COMPU_METHOD
/begin COMPU_VTAB Aqua_fwdaccel_st_COMPU_VTAB_REF "Verbal Table" TAB_VERB 5 0 "Offline" 1 "Valid" 2 "Error" 3 "Disconnected" 4 "Unacquired" DEFAULT_VALUE "UNKNOWN" /end COMPU_VTAB
/begin CHARACTERISTIC RS_rpmtol_Ifrz "Roadspeed RPM control error Int freeze" VALUE 0x001c7efa /* @ECU_Address@RS_rpmtol_Ifrz@0x01004610@ */ ECIPP_ALIGNMENT_UWORD 65535 Compu_RS_rpmtol_Ifrz 0 65535 /end CHARACTERISTIC
/begin COMPU_METHOD Compu_RS_rpmtol_Ifrz " " RAT_FUNC "%.0" "rpm" COEFFS 0 1 0 0 0 1 /end COMPU_METHOD
/begin CHARACTERISTIC RS_Kivapp_RS0 "Roadspeed approach Kiv zero error" VALUE 0x001CA11A /* @ECU_Address@RS_Kivapp_RS0@0x01004618@ */ ECIPP_ALIGNMENT_UWORD 256 Compu_RS_Kivapp_RS0 0 255.99609375 /end CHARACTERISTIC
/begin COMPU_METHOD Compu_RS_Kivapp_RS0 " " RAT_FUNC "%.1" "km/hr" COEFFS 0 256 0 0 0 1 /end COMPU_METHOD
/begin CHARACTERISTIC RS_Kivapp_RS100 "Roadspeed approach Kiv full error" VALUE 0x001CA11C /* @ECU_Address@RS_Kivapp_RS100@0x01004620@ */ ECIPP_ALIGNMENT_UWORD 256 Compu_RS_Kivapp_RS100 0 255.99609375 /end CHARACTERISTIC
/begin COMPU_METHOD Compu_RS_Kivapp_RS100 " " RAT_FUNC "%.1" "km/hr" COEFFS 0 256 0 0 0 1 /end COMPU_METHOD
/begin CHARACTERISTIC RS_Kivapp_add "Roadspeed approach Kiv adder" VALUE 0x001CA118 /* @ECU_Address@RS_Kivapp_add@0x01004628@ */ ECIPP_ALIGNMENT_UWORD 1600 Compu_RS_Kivapp_add 0 1599.9755859375 /end CHARACTERISTIC
/begin COMPU_METHOD Compu_RS_Kivapp_add " " RAT_FUNC "%.1" "% / (km/hr)" COEFFS 0 40.96 0 0 0 1 /end COMPU_METHOD
/begin CHARACTERISTIC RSovsc_ena "Roadspeed overshoot control{RSovsc_ena&0xff=0:Disabled}{RSovsc_ena&0xff=1:Enabled}" VALUE 0x001CA0FE /* @ECU_Address@RSovsc_ena@0x01004788@ */ ECIPP_ALIGNMENT_UBYTE 255 RSovsc_ena_COMPU_VTAB 0 255 BIT_MASK 0xff /end CHARACTERISTIC
/begin COMPU_METHOD RSovsc_ena_COMPU_VTAB "Verbal Table" TAB_VERB "%.0" "list" COMPU_TAB_REF RSovsc_ena_COMPU_VTAB_REF /end COMPU_METHOD
/begin COMPU_VTAB RSovsc_ena_COMPU_VTAB_REF "Verbal Table" TAB_VERB 2 0 "Disabled" 1 "Enabled" DEFAULT_VALUE "UNKNOWN" /end COMPU_VTAB
/begin MEASUREMENT RSovsc_armed "Roadspeed overshoot control status{RSovsc_armed&0xff=0:Disarmed}{RSovsc_armed&0xff=1:Armed}{RSovsc_armed&0xff=2:Active}{RSovsc_armed&0xff=3:Phase-Out}" UBYTE RSovsc_armed_COMPU_VTAB 0 0 0 255 ECU_ADDRESS 0x01004790 BIT_MASK 0xff /end MEASUREMENT
/begin COMPU_METHOD RSovsc_armed_COMPU_VTAB "Verbal Table" TAB_VERB "%.0" "list" COMPU_TAB_REF RSovsc_armed_COMPU_VTAB_REF /end COMPU_METHOD
/begin COMPU_VTAB RSovsc_armed_COMPU_VTAB_REF "Verbal Table" TAB_VERB 4 0 "Disarmed" 1 "Armed" 2 "Active" 3 "Phase-Out" DEFAULT_VALUE "UNKNOWN" /end COMPU_VTAB
/begin CHARACTERISTIC RSovsc_Kiv "Single-point overshoot control Kiv" VALUE 0x001CA12C /* @ECU_Address@RSovsc_Kiv@0x01004798@ */ ECIPP_ALIGNMENT_SWORD 800 Compu_RSovsc_Kiv -800 799.9755859375 /end CHARACTERISTIC
/begin COMPU_METHOD Compu_RSovsc_Kiv " " RAT_FUNC "%.1" "% / (km/hr)" COEFFS 0 40.96 0 0 0 1 /end COMPU_METHOD
/begin CHARACTERISTIC RSovsc_dIlim "Single-point overshoot control rate limit" VALUE 0x001CA128 /* @ECU_Address@RSovsc_dIlim@0x010047A0@ */ ECIPP_ALIGNMENT_ULONG 320000 Compu_RSovsc_dIlim 0 319999.999925494 /end CHARACTERISTIC
/begin COMPU_METHOD Compu_RSovsc_dIlim " " RAT_FUNC "%.1" "% / sec" COEFFS 0 13421.7728 0 0 0 1 /end COMPU_METHOD
/begin CHARACTERISTIC RSovsc_deng "Roadspeed overshoot control engage" VALUE 0x001CA11E /* @ECU_Address@RSovsc_deng@0x010047A8@ */ ECIPP_ALIGNMENT_UWORD 256 Compu_RSovsc_deng 0 255.99609375 /end CHARACTERISTIC
/begin COMPU_METHOD Compu_RSovsc_deng " " RAT_FUNC "%.1" "km/hr" COEFFS 0 256 0 0 0 1 /end COMPU_METHOD
/begin CHARACTERISTIC RSovsc_denghyst "Roadspeed overshoot control hysteresis" VALUE 0x001CA120 /* @ECU_Address@RSovsc_denghyst@0x010047B0@ */ ECIPP_ALIGNMENT_UWORD 256 Compu_RSovsc_denghyst 0 255.99609375 /end CHARACTERISTIC
/begin COMPU_METHOD Compu_RSovsc_denghyst " " RAT_FUNC "%.1" "km/hr" COEFFS 0 256 0 0 0 1 /end COMPU_METHOD
/begin CHARACTERISTIC RS_Kd_accel "Roadspeed control Kd_accel" VALUE 0x001CA112 /* @ECU_Address@RS_Kd_accel@0x010047D0@ */ ECIPP_ALIGNMENT_SWORD 3200 Compu_RS_Kd_accel -3200 3199.90234375 /end CHARACTERISTIC
/begin COMPU_METHOD Compu_RS_Kd_accel " " RAT_FUNC "%.1" "% / (km/hr) * sec" COEFFS 0 10.24 0 0 0 1 /end COMPU_METHOD
/begin CHARACTERISTIC RS_loss "Roadspeed input < (Fault Condition:Roadspeed input <)" VALUE 0x001c7ee4 /* @ECU_Address@RS_loss@0x01004818@ */ ECIPP_ALIGNMENT_UWORD 256 Compu_RS_loss 0 255.99609375 /end CHARACTERISTIC
/begin COMPU_METHOD Compu_RS_loss " " RAT_FUNC "%.1" "km/hr" COEFFS 0 256 0 0 0 1 /end COMPU_METHOD
/begin CHARACTERISTIC RS_loss_RPM "and engine speed > (Fault Condition:and engine speed >)" VALUE 0x001c7ee8 /* @ECU_Address@RS_loss_RPM@0x01004820@ */ ECIPP_ALIGNMENT_UWORD 65535 Compu_RS_loss_RPM 0 65535 /end CHARACTERISTIC
/begin COMPU_METHOD Compu_RS_loss_RPM " " RAT_FUNC "%.0" "rpm" COEFFS 0 1 0 0 0 1 /end COMPU_METHOD
/begin CHARACTERISTIC RS_loss_MAP "and MAP > (Fault Condition:and MAP >)" VALUE 0x001c7ee6 /* @ECU_Address@RS_loss_MAP@0x01004828@ */ ECIPP_ALIGNMENT_UWORD 256 Compu_RS_loss_MAP 0 255.99609375 /end CHARACTERISTIC
/begin COMPU_METHOD Compu_RS_loss_MAP " " RAT_FUNC "%.2" "psia" COEFFS 0 256 0 0 0 1 /end COMPU_METHOD
/begin CHARACTERISTIC RSdrop_rpm_arm "engine speed > (Fault Condition:engine speed >)" VALUE 0x001c7f06 /* @ECU_Address@RSdrop_rpm_arm@0x01004860@ */ ECIPP_ALIGNMENT_UWORD 65535 Compu_RSdrop_rpm_arm 0 65535 /end CHARACTERISTIC
/begin COMPU_METHOD Compu_RSdrop_rpm_arm " " RAT_FUNC "%.0" "rpm" COEFFS 0 1 0 0 0 1 /end COMPU_METHOD
/begin CHARACTERISTIC RSdrop_kph_arm "with initial roadspeed > (Fault Condition:with initial roadspeed >)" VALUE 0x001c7f02 /* @ECU_Address@RSdrop_kph_arm@0x01004868@ */ ECIPP_ALIGNMENT_UWORD 256 Compu_RSdrop_kph_arm 0 255.99609375 /end CHARACTERISTIC
/begin COMPU_METHOD Compu_RSdrop_kph_arm " " RAT_FUNC "%.1" "km/hr" COEFFS 0 256 0 0 0 1 /end COMPU_METHOD
/begin CHARACTERISTIC RSdrop_tout_arm "for at least (Fault Condition:for at least)" VALUE 0x001c7f08 /* @ECU_Address@RSdrop_tout_arm@0x01004870@ */ ECIPP_ALIGNMENT_UWORD 65535 Compu_RSdrop_tout_arm 0 65535 /end CHARACTERISTIC
/begin COMPU_METHOD Compu_RSdrop_tout_arm " " RAT_FUNC "%.0" "ms" COEFFS 0 1 0 0 0 1 /end COMPU_METHOD
/begin CHARACTERISTIC RSdrop_kph_trig "followed by roadspeed <= (Fault Condition:followed by roadspeed <=)" VALUE 0x001c7f04 /* @ECU_Address@RSdrop_kph_trig@0x01004878@ */ ECIPP_ALIGNMENT_UWORD 256 Compu_RSdrop_kph_trig 0 255.99609375 /end CHARACTERISTIC
/begin COMPU_METHOD Compu_RSdrop_kph_trig " " RAT_FUNC "%.1" "km/hr" COEFFS 0 256 0 0 0 1 /end COMPU_METHOD
/begin CHARACTERISTIC RSdrop_tout_trig "for at least (Fault Condition:for at least)" VALUE 0x001c7f0c /* @ECU_Address@RSdrop_tout_trig@0x01004880@ */ ECIPP_ALIGNMENT_UWORD 65535 Compu_RSdrop_tout_trig 0 65535 /end CHARACTERISTIC
/begin COMPU_METHOD Compu_RSdrop_tout_trig " " RAT_FUNC "%.0" "ms" COEFFS 0 1 0 0 0 1 /end COMPU_METHOD
/begin CHARACTERISTIC RSdrop_tout_disarm "after dropping roadspeed faster than (Fault Condition:after dropping roadspeed faster than)" VALUE 0x001c7f0a /* @ECU_Address@RSdrop_tout_disarm@0x01004888@ */ ECIPP_ALIGNMENT_UWORD 65535 Compu_RSdrop_tout_disarm 0 65535 /end CHARACTERISTIC
/begin COMPU_METHOD Compu_RSdrop_tout_disarm " " RAT_FUNC "%.0" "ms" COEFFS 0 1 0 0 0 1 /end COMPU_METHOD
/begin MEASUREMENT RSdrop_status "Roadspeed dropout detection{RSdrop_status&0xff=0:Disarmed}{RSdrop_status&0xff=1:Armed - Monitoring}{RSdrop_status&0xff=2:Dropout Detected}" UBYTE RSdrop_status_COMPU_VTAB 0 0 0 255 ECU_ADDRESS 0x01004890 BIT_MASK 0xff /end MEASUREMENT
/begin COMPU_METHOD RSdrop_status_COMPU_VTAB "Verbal Table" TAB_VERB "%.0" "list" COMPU_TAB_REF RSdrop_status_COMPU_VTAB_REF /end COMPU_METHOD
/begin COMPU_VTAB RSdrop_status_COMPU_VTAB_REF "Verbal Table" TAB_VERB 3 0 "Disarmed" 1 "Armed - Monitoring" 2 "Dropout Detected" DEFAULT_VALUE "UNKNOWN" /end COMPU_VTAB
/begin CHARACTERISTIC RSovsc_table "Roadspeed overshoot gain selection{RSovsc_table&0xff=0:Single Point}{RSovsc_table&0xff=1:Table Based}" VALUE 0x001CA0FF /* @ECU_Address@RSovsc_table@0x01004BA0@ */ ECIPP_ALIGNMENT_UBYTE 255 RSovsc_table_COMPU_VTAB 0 255 BIT_MASK 0xff /end CHARACTERISTIC
/begin COMPU_METHOD RSovsc_table_COMPU_VTAB "Verbal Table" TAB_VERB "%.0" "list" COMPU_TAB_REF RSovsc_table_COMPU_VTAB_REF /end COMPU_METHOD
/begin COMPU_VTAB RSovsc_table_COMPU_VTAB_REF "Verbal Table" TAB_VERB 2 0 "Single Point" 1 "Table Based" DEFAULT_VALUE "UNKNOWN" /end COMPU_VTAB
/begin MEASUREMENT RSovsc_Kiv_a "Roadspeed overshoot control Kiv" SWORD Compu_RSovsc_Kiv_a 0 0 -800 799.9755859375 ECU_ADDRESS 0x01004BA8 /end MEASUREMENT
/begin COMPU_METHOD Compu_RSovsc_Kiv_a " " RAT_FUNC "%.1" "% / (km/hr)" COEFFS 0 40.96 0 0 0 1 /end COMPU_METHOD
/begin MEASUREMENT RSovsc_dIlim_a "Roadspeed overshoot control rate limit" ULONG Compu_RSovsc_dIlim_a 0 0 0 319999.999925494 ECU_ADDRESS 0x01004BB0 /end MEASUREMENT
/begin COMPU_METHOD Compu_RSovsc_dIlim_a " " RAT_FUNC "%.1" "% / sec" COEFFS 0 13421.7728 0 0 0 1 /end COMPU_METHOD
/begin MEASUREMENT Aqua_gain_ndx "Aquastar gain selection{Aqua_gain_ndx&0xff=0:A - Normal}{Aqua_gain_ndx&0xff=1:B - Symmetric Low}{Aqua_gain_ndx&0xff=2:C - Reversed A}{Aqua_gain_ndx&0xff=3:Jmp - Symmetric Hi}" UBYTE Aqua_gain_ndx_COMPU_VTAB 0 0 0 255 ECU_ADDRESS 0x01004C20 BIT_MASK 0xff /end MEASUREMENT
/begin COMPU_METHOD Aqua_gain_ndx_COMPU_VTAB "Verbal Table" TAB_VERB "%.0" "list" COMPU_TAB_REF Aqua_gain_ndx_COMPU_VTAB_REF /end COMPU_METHOD
/begin COMPU_VTAB Aqua_gain_ndx_COMPU_VTAB_REF "Verbal Table" TAB_VERB 4 0 "A - Normal" 1 "B - Symmetric Low" 2 "C - Reversed A" 3 "Jmp - Symmetric Hi" DEFAULT_VALUE "UNKNOWN" /end COMPU_VTAB
/begin MEASUREMENT Aqua_spddotd_dis "Roadspeed desired acceleration calculation{Aqua_spddotd_dis&0xff=0:Enabled}{Aqua_spddotd_dis&0xff=1:Disabled}" UBYTE Aqua_spddotd_dis_COMPU_VTAB 0 0 0 255 ECU_ADDRESS 0x01004C90 BIT_MASK 0xff /end MEASUREMENT
/begin COMPU_METHOD Aqua_spddotd_dis_COMPU_VTAB "Verbal Table" TAB_VERB "%.0" "list" COMPU_TAB_REF Aqua_spddotd_dis_COMPU_VTAB_REF /end COMPU_METHOD
/begin COMPU_VTAB Aqua_spddotd_dis_COMPU_VTAB_REF "Verbal Table" TAB_VERB 2 0 "Enabled" 1 "Disabled" DEFAULT_VALUE "UNKNOWN" /end COMPU_VTAB
/begin CHARACTERISTIC RSovsc_Kiv_phout "Roadspeed overshoot Kiv phase-out" VALUE 0x001CA124 /* @ECU_Address@RSovsc_Kiv_phout@0x01004F00@ */ ECIPP_ALIGNMENT_UWORD 66 Compu_RSovsc_Kiv_phout 0 65.535 /end CHARACTERISTIC
/begin COMPU_METHOD Compu_RSovsc_Kiv_phout " " RAT_FUNC "%.1" "sec" COEFFS 0 1000 0 0 0 1 /end COMPU_METHOD
/begin CHARACTERISTIC RS_dot_ovsc_tau "Roadspeed overshoot decel detect tau" VALUE 0x001CA122 /* @ECU_Address@RS_dot_ovsc_tau@0x01004F08@ */ ECIPP_ALIGNMENT_UWORD 163840 Compu_RS_dot_ovsc_tau 0.16703 163840 /end CHARACTERISTIC
/begin COMPU_METHOD Compu_RS_dot_ovsc_tau " " FORM "%.1" "ms"
 /begin FORMULA "-5 / log(1.0000000000001 - (X1 / 32768))" FORMULA_INV "(1.0000000000001 - exp(-5/X1)) * 32768" /end FORMULA
/end COMPU_METHOD
/begin MEASUREMENT AUX_PUD4_raw "AUX_PUD4_raw" UWORD Compu_AUX_PUD4_raw 0 0 0 5.00114468864469 ECU_ADDRESS 0x01004FA0 /end MEASUREMENT
/begin COMPU_METHOD Compu_AUX_PUD4_raw " " RAT_FUNC "%.3" "volts" COEFFS 0 13104 0 0 0 1 /end COMPU_METHOD
/begin MEASUREMENT AUX_PUD5_raw "AUX_PUD5_raw" UWORD Compu_AUX_PUD5_raw 0 0 0 5.00114468864469 ECU_ADDRESS 0x01004FA8 /end MEASUREMENT
/begin COMPU_METHOD Compu_AUX_PUD5_raw " " RAT_FUNC "%.3" "volts" COEFFS 0 13104 0 0 0 1 /end COMPU_METHOD
/begin MEASUREMENT AUX_PUD6_raw "AUX_PUD6_raw" UWORD Compu_AUX_PUD6_raw 0 0 0 5.00114468864469 ECU_ADDRESS 0x01004FB0 /end MEASUREMENT
/begin COMPU_METHOD Compu_AUX_PUD6_raw " " RAT_FUNC "%.3" "volts" COEFFS 0 13104 0 0 0 1 /end COMPU_METHOD
/begin MEASUREMENT RSP_selected "Currently active control parameters{RSP_selected&0xff=0:Set 1}{RSP_selected&0xff=1:Set 2}{RSP_selected&0xff=2:Set 3}" UBYTE RSP_selected_COMPU_VTAB 0 0 0 255 ECU_ADDRESS 0x010053E0 BIT_MASK 0xff /end MEASUREMENT
/begin COMPU_METHOD RSP_selected_COMPU_VTAB "Verbal Table" TAB_VERB "%.0" "list" COMPU_TAB_REF RSP_selected_COMPU_VTAB_REF /end COMPU_METHOD
/begin COMPU_VTAB RSP_selected_COMPU_VTAB_REF "Verbal Table" TAB_VERB 3 0 "Set 1" 1 "Set 2" 2 "Set 3" DEFAULT_VALUE "UNKNOWN" /end COMPU_VTAB
/begin CHARACTERISTIC RS_gainset "Control parameter set selection{RS_gainset&0xff=0:Disabled}{RS_gainset&0xff=1:Default}{RS_gainset&0xff=2:MSP HW}{RS_gainset&0xff=3:MSP Aqua}{RS_gainset&0xff=4:MSP MSC}{RS_gainset&0xff=5:GPS}{RS_gainset&0xff=6:No GPS}{RS_gainset&0xff=7:Net Cfg1}{RS_gainset" VALUE 0x001CA0FC /* @ECU_Address@RS_gainset@0x010053E8@ */ ECIPP_ALIGNMENT_UBYTE 255 RS_gainset_COMPU_VTAB 0 255 BIT_MASK 0xff /end CHARACTERISTIC
/begin COMPU_METHOD RS_gainset_COMPU_VTAB "Verbal Table" TAB_VERB "%.0" "list" COMPU_TAB_REF RS_gainset_COMPU_VTAB_REF /end COMPU_METHOD
/begin COMPU_VTAB RS_gainset_COMPU_VTAB_REF "Verbal Table" TAB_VERB 11 0 "Disabled" 1 "Default" 2 "MSP HW" 3 "MSP Aqua" 4 "MSP MSC" 5 "GPS" 6 "No GPS" 7 "Net Cfg1" 8 "Net Cfg2" 9 "Net Cfg3" 10 "Cruise Engaged" DEFAULT_VALUE "UNKNOWN" /end COMPU_VTAB
/begin CHARACTERISTIC RS2_gainset "Control parameter set selection 2{RS2_gainset&0xff=0:Disabled}{RS2_gainset&0xff=1:Default}{RS2_gainset&0xff=2:MSP HW}{RS2_gainset&0xff=3:MSP Aqua}{RS2_gainset&0xff=4:MSP MSC}{RS2_gainset&0xff=5:GPS}{RS2_gainset&0xff=6:No GPS}{RS2_gainset&0xff=7:Net Cfg1}{" VALUE 0x001CA148 /* @ECU_Address@RS2_gainset@0x010053F0@ */ ECIPP_ALIGNMENT_UBYTE 255 RS2_gainset_COMPU_VTAB 0 255 BIT_MASK 0xff /end CHARACTERISTIC
/begin COMPU_METHOD RS2_gainset_COMPU_VTAB "Verbal Table" TAB_VERB "%.0" "list" COMPU_TAB_REF RS2_gainset_COMPU_VTAB_REF /end COMPU_METHOD
/begin COMPU_VTAB RS2_gainset_COMPU_VTAB_REF "Verbal Table" TAB_VERB 11 0 "Disabled" 1 "Default" 2 "MSP HW" 3 "MSP Aqua" 4 "MSP MSC" 5 "GPS" 6 "No GPS" 7 "Net Cfg1" 8 "Net Cfg2" 9 "Net Cfg3" 10 "Cruise Engaged" DEFAULT_VALUE "UNKNOWN" /end COMPU_VTAB
/begin CHARACTERISTIC RS2_source "Roadspeed2 signal source{RS2_source&0xff=0:Pulse Input}{RS2_source&0xff=1:GPS Comm}{RS2_source&0xff=2:J1939 Comm}" VALUE 0x001CA149 /* @ECU_Address@RS2_source@0x010053F8@ */ ECIPP_ALIGNMENT_UBYTE 255 RS2_source_COMPU_VTAB 0 255 BIT_MASK 0xff /end CHARACTERISTIC
/begin COMPU_METHOD RS2_source_COMPU_VTAB "Verbal Table" TAB_VERB "%.0" "list" COMPU_TAB_REF RS2_source_COMPU_VTAB_REF /end COMPU_METHOD
/begin COMPU_VTAB RS2_source_COMPU_VTAB_REF "Verbal Table" TAB_VERB 3 0 "Pulse Input" 1 "GPS Comm" 2 "J1939 Comm" DEFAULT_VALUE "UNKNOWN" /end COMPU_VTAB
/begin CHARACTERISTIC RS2ovsc_ena "Roadspeed2 overshoot control{RS2ovsc_ena&0xff=0:Disabled}{RS2ovsc_ena&0xff=1:Enabled}" VALUE 0x001CA14A /* @ECU_Address@RS2ovsc_ena@0x01005400@ */ ECIPP_ALIGNMENT_UBYTE 255 RS2ovsc_ena_COMPU_VTAB 0 255 BIT_MASK 0xff /end CHARACTERISTIC
/begin COMPU_METHOD RS2ovsc_ena_COMPU_VTAB "Verbal Table" TAB_VERB "%.0" "list" COMPU_TAB_REF RS2ovsc_ena_COMPU_VTAB_REF /end COMPU_METHOD
/begin COMPU_VTAB RS2ovsc_ena_COMPU_VTAB_REF "Verbal Table" TAB_VERB 2 0 "Disabled" 1 "Enabled" DEFAULT_VALUE "UNKNOWN" /end COMPU_VTAB
/begin CHARACTERISTIC RS2ovsc_table "Roadspeed2 overshoot gain selection{RS2ovsc_table&0xff=0:Single Point}{RS2ovsc_table&0xff=1:Table Based}" VALUE 0x001CA14B /* @ECU_Address@RS2ovsc_table@0x01005408@ */ ECIPP_ALIGNMENT_UBYTE 255 RS2ovsc_table_COMPU_VTAB 0 255 BIT_MASK 0xff /end CHARACTERISTIC
/begin COMPU_METHOD RS2ovsc_table_COMPU_VTAB "Verbal Table" TAB_VERB "%.0" "list" COMPU_TAB_REF RS2ovsc_table_COMPU_VTAB_REF /end COMPU_METHOD
/begin COMPU_VTAB RS2ovsc_table_COMPU_VTAB_REF "Verbal Table" TAB_VERB 2 0 "Single Point" 1 "Table Based" DEFAULT_VALUE "UNKNOWN" /end COMPU_VTAB
/begin CHARACTERISTIC RS2_speed_tau "Roadspeed2 speed input low-pass" VALUE 0x001CA14C /* @ECU_Address@RS2_speed_tau@0x01005410@ */ ECIPP_ALIGNMENT_UWORD 327680 Compu_RS2_speed_tau 0.45084 327680 /end CHARACTERISTIC
/begin COMPU_METHOD Compu_RS2_speed_tau " " FORM "%.1" "ms"
 /begin FORMULA "-5 / log(1 - (X1 / 65536))" FORMULA_INV "(1 - exp(-5/X1)) * 65536" /end FORMULA
/end COMPU_METHOD
/begin CHARACTERISTIC RS2_dot_tau "Roadspeed2 acceleration low-pass" VALUE 0x001CA14E /* @ECU_Address@RS2_dot_tau@0x01005418@ */ ECIPP_ALIGNMENT_UWORD 163840 Compu_RS2_dot_tau 0.16703 163840 /end CHARACTERISTIC
/begin COMPU_METHOD Compu_RS2_dot_tau " " FORM "%.1" "ms"
 /begin FORMULA "-5 / log(1.0000000000001 - (X1 / 32768))" FORMULA_INV "(1.0000000000001 - exp(-5/X1)) * 32768" /end FORMULA
/end COMPU_METHOD
/begin CHARACTERISTIC RS2_dot_window "Roadspeed2 acceleration window" VALUE 0x001CA150 /* @ECU_Address@RS2_dot_window@0x01005420@ */ ECIPP_ALIGNMENT_UWORD 65535 Compu_RS2_dot_window 0 65535 /end CHARACTERISTIC
/begin COMPU_METHOD Compu_RS2_dot_window " " RAT_FUNC "%.0" "ms" COEFFS 0 1 0 0 0 1 /end COMPU_METHOD
/begin CHARACTERISTIC RS2_dot_dzlim "Roadspeed2 acceleration deadzone" VALUE 0x001CA152 /* @ECU_Address@RS2_dot_dzlim@0x01005428@ */ ECIPP_ALIGNMENT_SWORD 32 Compu_RS2_dot_dzlim -32 31.9990234375 /end CHARACTERISTIC
/begin COMPU_METHOD Compu_RS2_dot_dzlim " " RAT_FUNC "%.1" "km/hr/sec" COEFFS 0 1024 0 0 0 1 /end COMPU_METHOD
/begin CHARACTERISTIC RS2_Kp "Roadspeed2 control Kp" VALUE 0x001CA154 /* @ECU_Address@RS2_Kp@0x01005430@ */ ECIPP_ALIGNMENT_SWORD 800 Compu_RS2_Kp -800 799.9755859375 /end CHARACTERISTIC
/begin COMPU_METHOD Compu_RS2_Kp " " RAT_FUNC "%.1" "% / (km/hr)" COEFFS 0 40.96 0 0 0 1 /end COMPU_METHOD
/begin CHARACTERISTIC RS2_Ki "Roadspeed2 control Ki" VALUE 0x001CA15A /* @ECU_Address@RS2_Ki@0x01005438@ */ ECIPP_ALIGNMENT_SWORD 400 Compu_RS2_Ki -400 399.98779296875 /end CHARACTERISTIC
/begin COMPU_METHOD Compu_RS2_Ki " " RAT_FUNC "%.1" "% / (km/hr) / sec" COEFFS 0 81.92 0 0 0 1 /end COMPU_METHOD
/begin CHARACTERISTIC RS2_Kd "Roadspeed2 control Kd / Kd_decel" VALUE 0x001CA15C /* @ECU_Address@RS2_Kd@0x01005440@ */ ECIPP_ALIGNMENT_SWORD 3200 Compu_RS2_Kd -3200 3199.90234375 /end CHARACTERISTIC
/begin COMPU_METHOD Compu_RS2_Kd " " RAT_FUNC "%.1" "% / (km/hr) * sec" COEFFS 0 10.24 0 0 0 1 /end COMPU_METHOD
/begin CHARACTERISTIC RS2_Kd_accel "Roadspeed2 control Kd_accel" VALUE 0x001CA15E /* @ECU_Address@RS2_Kd_accel@0x01005448@ */ ECIPP_ALIGNMENT_SWORD 3200 Compu_RS2_Kd_accel -3200 3199.90234375 /end CHARACTERISTIC
/begin COMPU_METHOD Compu_RS2_Kd_accel " " RAT_FUNC "%.1" "% / (km/hr) * sec" COEFFS 0 10.24 0 0 0 1 /end COMPU_METHOD
/begin CHARACTERISTIC RS2_Kiv "Roadspeed2 control Kiv" VALUE 0x001CA160 /* @ECU_Address@RS2_Kiv@0x01005450@ */ ECIPP_ALIGNMENT_SWORD 800 Compu_RS2_Kiv -800 799.9755859375 /end CHARACTERISTIC
/begin COMPU_METHOD Compu_RS2_Kiv " " RAT_FUNC "%.1" "% / (km/hr)" COEFFS 0 40.96 0 0 0 1 /end COMPU_METHOD
/begin CHARACTERISTIC RS2_TPS_tau "Roadspeed2 control output low-pass" VALUE 0x001CA162 /* @ECU_Address@RS2_TPS_tau@0x01005458@ */ ECIPP_ALIGNMENT_UWORD 327680 Compu_RS2_TPS_tau 0.45084 327680 /end CHARACTERISTIC
/begin COMPU_METHOD Compu_RS2_TPS_tau " " FORM "%.1" "ms"
 /begin FORMULA "-5 / log(1 - (X1 / 65536))" FORMULA_INV "(1 - exp(-5/X1)) * 65536" /end FORMULA
/end COMPU_METHOD
/begin CHARACTERISTIC RS2_Kivapp_add "Roadspeed2 approach Kiv adder" VALUE 0x001CA164 /* @ECU_Address@RS2_Kivapp_add@0x01005460@ */ ECIPP_ALIGNMENT_UWORD 1600 Compu_RS2_Kivapp_add 0 1599.9755859375 /end CHARACTERISTIC
/begin COMPU_METHOD Compu_RS2_Kivapp_add " " RAT_FUNC "%.1" "% / (km/hr)" COEFFS 0 40.96 0 0 0 1 /end COMPU_METHOD
/begin CHARACTERISTIC RS2_Kivapp_RS0 "Roadspeed2 approach Kiv zero error" VALUE 0x001CA166 /* @ECU_Address@RS2_Kivapp_RS0@0x01005468@ */ ECIPP_ALIGNMENT_UWORD 256 Compu_RS2_Kivapp_RS0 0 255.99609375 /end CHARACTERISTIC
/begin COMPU_METHOD Compu_RS2_Kivapp_RS0 " " RAT_FUNC "%.1" "km/hr" COEFFS 0 256 0 0 0 1 /end COMPU_METHOD
/begin CHARACTERISTIC RS2_Kivapp_RS100 "Roadspeed2 approach Kiv full error" VALUE 0x001CA168 /* @ECU_Address@RS2_Kivapp_RS100@0x01005470@ */ ECIPP_ALIGNMENT_UWORD 256 Compu_RS2_Kivapp_RS100 0 255.99609375 /end CHARACTERISTIC
/begin COMPU_METHOD Compu_RS2_Kivapp_RS100 " " RAT_FUNC "%.1" "km/hr" COEFFS 0 256 0 0 0 1 /end COMPU_METHOD
/begin CHARACTERISTIC RS2ovsc_deng "Roadspeed2 overshoot control engage" VALUE 0x001CA16A /* @ECU_Address@RS2ovsc_deng@0x01005478@ */ ECIPP_ALIGNMENT_UWORD 256 Compu_RS2ovsc_deng 0 255.99609375 /end CHARACTERISTIC
/begin COMPU_METHOD Compu_RS2ovsc_deng " " RAT_FUNC "%.1" "km/hr" COEFFS 0 256 0 0 0 1 /end COMPU_METHOD
/begin CHARACTERISTIC RS2ovsc_denghyst "Roadspeed2 overshoot control hysteresis" VALUE 0x001CA16C /* @ECU_Address@RS2ovsc_denghyst@0x01005480@ */ ECIPP_ALIGNMENT_UWORD 256 Compu_RS2ovsc_denghyst 0 255.99609375 /end CHARACTERISTIC
/begin COMPU_METHOD Compu_RS2ovsc_denghyst " " RAT_FUNC "%.1" "km/hr" COEFFS 0 256 0 0 0 1 /end COMPU_METHOD
/begin CHARACTERISTIC RS2_dot_ovsc_tau "Roadspeed2 overshoot decel detect tau" VALUE 0x001CA16E /* @ECU_Address@RS2_dot_ovsc_tau@0x01005488@ */ ECIPP_ALIGNMENT_UWORD 163840 Compu_RS2_dot_ovsc_tau 0.16703 163840 /end CHARACTERISTIC
/begin COMPU_METHOD Compu_RS2_dot_ovsc_tau " " FORM "%.1" "ms"
 /begin FORMULA "-5 / log(1.0000000000001 - (X1 / 32768))" FORMULA_INV "(1.0000000000001 - exp(-5/X1)) * 32768" /end FORMULA
/end COMPU_METHOD
/begin CHARACTERISTIC RS2ovsc_Kiv_phout "Roadspeed2 overshoot Kiv phase-out" VALUE 0x001CA170 /* @ECU_Address@RS2ovsc_Kiv_phout@0x01005490@ */ ECIPP_ALIGNMENT_UWORD 66 Compu_RS2ovsc_Kiv_phout 0 65.535 /end CHARACTERISTIC
/begin COMPU_METHOD Compu_RS2ovsc_Kiv_phout " " RAT_FUNC "%.1" "sec" COEFFS 0 1000 0 0 0 1 /end COMPU_METHOD
/begin CHARACTERISTIC RS2ovsc_dIlim "RS2 Single-point overshoot control rate limit" VALUE 0x001CA174 /* @ECU_Address@RS2ovsc_dIlim@0x01005498@ */ ECIPP_ALIGNMENT_ULONG 320000 Compu_RS2ovsc_dIlim 0 319999.999925494 /end CHARACTERISTIC
/begin COMPU_METHOD Compu_RS2ovsc_dIlim " " RAT_FUNC "%.1" "% / sec" COEFFS 0 13421.7728 0 0 0 1 /end COMPU_METHOD
/begin CHARACTERISTIC RS2ovsc_Kiv "RS2 Single-point overshoot control Kiv" VALUE 0x001CA178 /* @ECU_Address@RS2ovsc_Kiv@0x010054A0@ */ ECIPP_ALIGNMENT_SWORD 800 Compu_RS2ovsc_Kiv -800 799.9755859375 /end CHARACTERISTIC
/begin COMPU_METHOD Compu_RS2ovsc_Kiv " " RAT_FUNC "%.1" "% / (km/hr)" COEFFS 0 40.96 0 0 0 1 /end COMPU_METHOD
/begin CHARACTERISTIC RS3_gainset "Control parameter set selection 3{RS3_gainset&0xff=0:Disabled}{RS3_gainset&0xff=1:Default}{RS3_gainset&0xff=2:MSP HW}{RS3_gainset&0xff=3:MSP Aqua}{RS3_gainset&0xff=4:MSP MSC}{RS3_gainset&0xff=5:GPS}{RS3_gainset&0xff=6:No GPS}{RS3_gainset&0xff=7:Net Cfg1}{" VALUE 0x001CA194 /* @ECU_Address@RS3_gainset@0x010054A8@ */ ECIPP_ALIGNMENT_UBYTE 255 RS3_gainset_COMPU_VTAB 0 255 BIT_MASK 0xff /end CHARACTERISTIC
/begin COMPU_METHOD RS3_gainset_COMPU_VTAB "Verbal Table" TAB_VERB "%.0" "list" COMPU_TAB_REF RS3_gainset_COMPU_VTAB_REF /end COMPU_METHOD
/begin COMPU_VTAB RS3_gainset_COMPU_VTAB_REF "Verbal Table" TAB_VERB 11 0 "Disabled" 1 "Default" 2 "MSP HW" 3 "MSP Aqua" 4 "MSP MSC" 5 "GPS" 6 "No GPS" 7 "Net Cfg1" 8 "Net Cfg2" 9 "Net Cfg3" 10 "Cruise Engaged" DEFAULT_VALUE "UNKNOWN" /end COMPU_VTAB
/begin CHARACTERISTIC RS3_source "Roadspeed3 signal source{RS3_source&0xff=0:Pulse Input}{RS3_source&0xff=1:GPS Comm}{RS3_source&0xff=2:J1939 Comm}" VALUE 0x001CA195 /* @ECU_Address@RS3_source@0x010054B0@ */ ECIPP_ALIGNMENT_UBYTE 255 RS3_source_COMPU_VTAB 0 255 BIT_MASK 0xff /end CHARACTERISTIC
/begin COMPU_METHOD RS3_source_COMPU_VTAB "Verbal Table" TAB_VERB "%.0" "list" COMPU_TAB_REF RS3_source_COMPU_VTAB_REF /end COMPU_METHOD
/begin COMPU_VTAB RS3_source_COMPU_VTAB_REF "Verbal Table" TAB_VERB 3 0 "Pulse Input" 1 "GPS Comm" 2 "J1939 Comm" DEFAULT_VALUE "UNKNOWN" /end COMPU_VTAB
/begin CHARACTERISTIC RS3ovsc_ena "Roadspeed3 overshoot control{RS3ovsc_ena&0xff=0:Disabled}{RS3ovsc_ena&0xff=1:Enabled}" VALUE 0x001CA196 /* @ECU_Address@RS3ovsc_ena@0x010054B8@ */ ECIPP_ALIGNMENT_UBYTE 255 RS3ovsc_ena_COMPU_VTAB 0 255 BIT_MASK 0xff /end CHARACTERISTIC
/begin COMPU_METHOD RS3ovsc_ena_COMPU_VTAB "Verbal Table" TAB_VERB "%.0" "list" COMPU_TAB_REF RS3ovsc_ena_COMPU_VTAB_REF /end COMPU_METHOD
/begin COMPU_VTAB RS3ovsc_ena_COMPU_VTAB_REF "Verbal Table" TAB_VERB 2 0 "Disabled" 1 "Enabled" DEFAULT_VALUE "UNKNOWN" /end COMPU_VTAB
/begin CHARACTERISTIC RS3ovsc_table "Roadspeed3 overshoot gain selection{RS3ovsc_table&0xff=0:Single Point}{RS3ovsc_table&0xff=1:Table Based}" VALUE 0x001CA197 /* @ECU_Address@RS3ovsc_table@0x010054C0@ */ ECIPP_ALIGNMENT_UBYTE 255 RS3ovsc_table_COMPU_VTAB 0 255 BIT_MASK 0xff /end CHARACTERISTIC
/begin COMPU_METHOD RS3ovsc_table_COMPU_VTAB "Verbal Table" TAB_VERB "%.0" "list" COMPU_TAB_REF RS3ovsc_table_COMPU_VTAB_REF /end COMPU_METHOD
/begin COMPU_VTAB RS3ovsc_table_COMPU_VTAB_REF "Verbal Table" TAB_VERB 2 0 "Single Point" 1 "Table Based" DEFAULT_VALUE "UNKNOWN" /end COMPU_VTAB
/begin CHARACTERISTIC RS3_speed_tau "Roadspeed3 speed input low-pass" VALUE 0x001CA198 /* @ECU_Address@RS3_speed_tau@0x010054C8@ */ ECIPP_ALIGNMENT_UWORD 327680 Compu_RS3_speed_tau 0.45084 327680 /end CHARACTERISTIC
/begin COMPU_METHOD Compu_RS3_speed_tau " " FORM "%.1" "ms"
 /begin FORMULA "-5 / log(1 - (X1 / 65536))" FORMULA_INV "(1 - exp(-5/X1)) * 65536" /end FORMULA
/end COMPU_METHOD
/begin CHARACTERISTIC RS3_dot_tau "Roadspeed3 acceleration low-pass" VALUE 0x001CA19A /* @ECU_Address@RS3_dot_tau@0x010054D0@ */ ECIPP_ALIGNMENT_UWORD 163840 Compu_RS3_dot_tau 0.16703 163840 /end CHARACTERISTIC
/begin COMPU_METHOD Compu_RS3_dot_tau " " FORM "%.1" "ms"
 /begin FORMULA "-5 / log(1.0000000000001 - (X1 / 32768))" FORMULA_INV "(1.0000000000001 - exp(-5/X1)) * 32768" /end FORMULA
/end COMPU_METHOD
/begin CHARACTERISTIC RS3_dot_window "Roadspeed3 acceleration window" VALUE 0x001CA19C /* @ECU_Address@RS3_dot_window@0x010054D8@ */ ECIPP_ALIGNMENT_UWORD 65535 Compu_RS3_dot_window 0 65535 /end CHARACTERISTIC
/begin COMPU_METHOD Compu_RS3_dot_window " " RAT_FUNC "%.0" "ms" COEFFS 0 1 0 0 0 1 /end COMPU_METHOD
/begin CHARACTERISTIC RS3_dot_dzlim "Roadspeed3 acceleration deadzone" VALUE 0x001CA19E /* @ECU_Address@RS3_dot_dzlim@0x010054E0@ */ ECIPP_ALIGNMENT_SWORD 32 Compu_RS3_dot_dzlim -32 31.9990234375 /end CHARACTERISTIC
/begin COMPU_METHOD Compu_RS3_dot_dzlim " " RAT_FUNC "%.1" "km/hr/sec" COEFFS 0 1024 0 0 0 1 /end COMPU_METHOD
/begin CHARACTERISTIC RS3_Kp "Roadspeed3 control Kp" VALUE 0x001CA1A0 /* @ECU_Address@RS3_Kp@0x010054E8@ */ ECIPP_ALIGNMENT_SWORD 800 Compu_RS3_Kp -800 799.9755859375 /end CHARACTERISTIC
/begin COMPU_METHOD Compu_RS3_Kp " " RAT_FUNC "%.1" "% / (km/hr)" COEFFS 0 40.96 0 0 0 1 /end COMPU_METHOD
/begin CHARACTERISTIC RS3_Ki "Roadspeed3 control Ki" VALUE 0x001CA1A6 /* @ECU_Address@RS3_Ki@0x010054F0@ */ ECIPP_ALIGNMENT_SWORD 400 Compu_RS3_Ki -400 399.98779296875 /end CHARACTERISTIC
/begin COMPU_METHOD Compu_RS3_Ki " " RAT_FUNC "%.1" "% / (km/hr) / sec" COEFFS 0 81.92 0 0 0 1 /end COMPU_METHOD
/begin CHARACTERISTIC RS3_Kd "Roadspeed3 control Kd / Kd_decel" VALUE 0x001CA1A8 /* @ECU_Address@RS3_Kd@0x010054F8@ */ ECIPP_ALIGNMENT_SWORD 3200 Compu_RS3_Kd -3200 3199.90234375 /end CHARACTERISTIC
/begin COMPU_METHOD Compu_RS3_Kd " " RAT_FUNC "%.1" "% / (km/hr) * sec" COEFFS 0 10.24 0 0 0 1 /end COMPU_METHOD
/begin CHARACTERISTIC RS3_Kd_accel "Roadspeed3 control Kd_accel" VALUE 0x001CA1AA /* @ECU_Address@RS3_Kd_accel@0x01005500@ */ ECIPP_ALIGNMENT_SWORD 3200 Compu_RS3_Kd_accel -3200 3199.90234375 /end CHARACTERISTIC
/begin COMPU_METHOD Compu_RS3_Kd_accel " " RAT_FUNC "%.1" "% / (km/hr) * sec" COEFFS 0 10.24 0 0 0 1 /end COMPU_METHOD
/begin CHARACTERISTIC RS3_Kiv "Roadspeed3 control Kiv" VALUE 0x001CA1AC /* @ECU_Address@RS3_Kiv@0x01005508@ */ ECIPP_ALIGNMENT_SWORD 800 Compu_RS3_Kiv -800 799.9755859375 /end CHARACTERISTIC
/begin COMPU_METHOD Compu_RS3_Kiv " " RAT_FUNC "%.1" "% / (km/hr)" COEFFS 0 40.96 0 0 0 1 /end COMPU_METHOD
/begin CHARACTERISTIC RS3_TPS_tau "Roadspeed3 control output low-pass" VALUE 0x001CA1AE /* @ECU_Address@RS3_TPS_tau@0x01005510@ */ ECIPP_ALIGNMENT_UWORD 327680 Compu_RS3_TPS_tau 0.45084 327680 /end CHARACTERISTIC
/begin COMPU_METHOD Compu_RS3_TPS_tau " " FORM "%.1" "ms"
 /begin FORMULA "-5 / log(1 - (X1 / 65536))" FORMULA_INV "(1 - exp(-5/X1)) * 65536" /end FORMULA
/end COMPU_METHOD
/begin CHARACTERISTIC RS3_Kivapp_add "Roadspeed3 approach Kiv adder" VALUE 0x001CA1B0 /* @ECU_Address@RS3_Kivapp_add@0x01005518@ */ ECIPP_ALIGNMENT_UWORD 1600 Compu_RS3_Kivapp_add 0 1599.9755859375 /end CHARACTERISTIC
/begin COMPU_METHOD Compu_RS3_Kivapp_add " " RAT_FUNC "%.1" "% / (km/hr)" COEFFS 0 40.96 0 0 0 1 /end COMPU_METHOD
/begin CHARACTERISTIC RS3_Kivapp_RS0 "Roadspeed3 approach Kiv zero error" VALUE 0x001CA1B2 /* @ECU_Address@RS3_Kivapp_RS0@0x01005520@ */ ECIPP_ALIGNMENT_UWORD 256 Compu_RS3_Kivapp_RS0 0 255.99609375 /end CHARACTERISTIC
/begin COMPU_METHOD Compu_RS3_Kivapp_RS0 " " RAT_FUNC "%.1" "km/hr" COEFFS 0 256 0 0 0 1 /end COMPU_METHOD
/begin CHARACTERISTIC RS3_Kivapp_RS100 "Roadspeed3 approach Kiv full error" VALUE 0x001CA1B4 /* @ECU_Address@RS3_Kivapp_RS100@0x01005528@ */ ECIPP_ALIGNMENT_UWORD 256 Compu_RS3_Kivapp_RS100 0 255.99609375 /end CHARACTERISTIC
/begin COMPU_METHOD Compu_RS3_Kivapp_RS100 " " RAT_FUNC "%.1" "km/hr" COEFFS 0 256 0 0 0 1 /end COMPU_METHOD
/begin CHARACTERISTIC RS3ovsc_deng "Roadspeed3 overshoot control engage" VALUE 0x001CA1B6 /* @ECU_Address@RS3ovsc_deng@0x01005530@ */ ECIPP_ALIGNMENT_UWORD 256 Compu_RS3ovsc_deng 0 255.99609375 /end CHARACTERISTIC
/begin COMPU_METHOD Compu_RS3ovsc_deng " " RAT_FUNC "%.1" "km/hr" COEFFS 0 256 0 0 0 1 /end COMPU_METHOD
/begin CHARACTERISTIC RS3ovsc_denghyst "Roadspeed3 overshoot control hysteresis" VALUE 0x001CA1B8 /* @ECU_Address@RS3ovsc_denghyst@0x01005538@ */ ECIPP_ALIGNMENT_UWORD 256 Compu_RS3ovsc_denghyst 0 255.99609375 /end CHARACTERISTIC
/begin COMPU_METHOD Compu_RS3ovsc_denghyst " " RAT_FUNC "%.1" "km/hr" COEFFS 0 256 0 0 0 1 /end COMPU_METHOD
/begin CHARACTERISTIC RS3_dot_ovsc_tau "Roadspeed3 overshoot decel detect tau" VALUE 0x001CA1BA /* @ECU_Address@RS3_dot_ovsc_tau@0x01005540@ */ ECIPP_ALIGNMENT_UWORD 163840 Compu_RS3_dot_ovsc_tau 0.16703 163840 /end CHARACTERISTIC
/begin COMPU_METHOD Compu_RS3_dot_ovsc_tau " " FORM "%.1" "ms"
 /begin FORMULA "-5 / log(1.0000000000001 - (X1 / 32768))" FORMULA_INV "(1.0000000000001 - exp(-5/X1)) * 32768" /end FORMULA
/end COMPU_METHOD
/begin CHARACTERISTIC RS3ovsc_Kiv_phout "Roadspeed3 overshoot Kiv phase-out" VALUE 0x001CA1BC /* @ECU_Address@RS3ovsc_Kiv_phout@0x01005548@ */ ECIPP_ALIGNMENT_UWORD 66 Compu_RS3ovsc_Kiv_phout 0 65.535 /end CHARACTERISTIC
/begin COMPU_METHOD Compu_RS3ovsc_Kiv_phout " " RAT_FUNC "%.1" "sec" COEFFS 0 1000 0 0 0 1 /end COMPU_METHOD
/begin CHARACTERISTIC RS3ovsc_dIlim "RS3 Single-point overshoot control rate limit" VALUE 0x001CA1C0 /* @ECU_Address@RS3ovsc_dIlim@0x01005550@ */ ECIPP_ALIGNMENT_ULONG 320000 Compu_RS3ovsc_dIlim 0 319999.999925494 /end CHARACTERISTIC
/begin COMPU_METHOD Compu_RS3ovsc_dIlim " " RAT_FUNC "%.1" "% / sec" COEFFS 0 13421.7728 0 0 0 1 /end COMPU_METHOD
/begin CHARACTERISTIC RS3ovsc_Kiv "RS3 Single-point overshoot control Kiv" VALUE 0x001CA1C4 /* @ECU_Address@RS3ovsc_Kiv@0x01005558@ */ ECIPP_ALIGNMENT_SWORD 800 Compu_RS3ovsc_Kiv -800 799.9755859375 /end CHARACTERISTIC
/begin COMPU_METHOD Compu_RS3ovsc_Kiv " " RAT_FUNC "%.1" "% / (km/hr)" COEFFS 0 40.96 0 0 0 1 /end COMPU_METHOD
/begin MEASUREMENT SHIFT_I_FB_raw "SHIFT_I_FB_raw" UWORD Compu_SHIFT_I_FB_raw 0 0 0 5.00114468864469 ECU_ADDRESS 0x010069A0 /end MEASUREMENT
/begin COMPU_METHOD Compu_SHIFT_I_FB_raw " " RAT_FUNC "%.3" "volts" COEFFS 0 13104 0 0 0 1 /end COMPU_METHOD
/begin MEASUREMENT Valternator_raw "Valternator_raw" UWORD Compu_Valternator_raw 0 0 0 5.00114468864469 ECU_ADDRESS 0x01006FE8 /end MEASUREMENT
/begin COMPU_METHOD Compu_Valternator_raw " " RAT_FUNC "%.3" "-" COEFFS 0 13104 0 0 0 1 /end COMPU_METHOD
/begin MEASUREMENT AUX_PWM6_FB_raw "AUX_PWM6_FB_raw" UWORD Compu_AUX_PWM6_FB_raw 0 0 0 5.00114468864469 ECU_ADDRESS 0x01007040 /end MEASUREMENT
/begin COMPU_METHOD Compu_AUX_PWM6_FB_raw " " RAT_FUNC "%.3" "volts" COEFFS 0 13104 0 0 0 1 /end COMPU_METHOD
/begin CHARACTERISTIC RSC_enable_chan "Cruise enable input{RSC_enable_chan&0xff=0:Disabled}{RSC_enable_chan&0xff=1:Aux PU1 = Gnd}{RSC_enable_chan&0xff=2:Aux PU2 = Gnd}{RSC_enable_chan&0xff=3:Aux PU3 = Gnd}{RSC_enable_chan&0xff=4:Aux PUD1 = Gnd}{RSC_enable_chan&0xff=5:Aux PUD2 = Gnd}{RSC_enable" VALUE 0x001c88cd /* @ECU_Address@RSC_enable_chan@0x01007370@ */ ECIPP_ALIGNMENT_UBYTE 255 RSC_enable_chan_COMPU_VTAB 0 255 BIT_MASK 0xff /end CHARACTERISTIC
/begin COMPU_METHOD RSC_enable_chan_COMPU_VTAB "Verbal Table" TAB_VERB "%.0" "list" COMPU_TAB_REF RSC_enable_chan_COMPU_VTAB_REF /end COMPU_METHOD
/begin COMPU_VTAB RSC_enable_chan_COMPU_VTAB_REF "Verbal Table" TAB_VERB 32 0 "Disabled" 1 "Aux PU1 = Gnd" 2 "Aux PU2 = Gnd" 3 "Aux PU3 = Gnd" 4 "Aux PUD1 = Gnd" 5 "Aux PUD2 = Gnd" 6 "Aux PUD3 = Gnd" 7 "Aux PUD4 = +V" 8 "Aux PUD5 = Gnd" 9 "Aux DIG1" 10 "Aux DIG2" 11 "Aux DIG3" 12 "Aux DIG4" 13 "Aux DIG5" 14 "Aux DIG6" 15 "Aux DIG7" 16 "Aux DIG8" 17 "Aux DIG9" 18 "Aux DIG10" 19 "Aux DIG11" 20 "Aux DIG12" 21 "Aux DIG13" 22 "Aux DIG14" 23 "Aux DIG15" 24 "Aux DIG16" 25 "Aux DIG17" 26 "Aux DIG18" 27 "Aux DIG19" 28 "Gov1" 29 "Gov2" 30 "CAN sourced" 31 "Always enabled" DEFAULT_VALUE "UNKNOWN" /end COMPU_VTAB
/begin CHARACTERISTIC RSC_resume_chan "Cruise resume input{RSC_resume_chan&0xff=0:Disabled}{RSC_resume_chan&0xff=1:Aux PU1 = Gnd}{RSC_resume_chan&0xff=2:Aux PU2 = Gnd}{RSC_resume_chan&0xff=3:Aux PU3 = Gnd}{RSC_resume_chan&0xff=4:Aux PUD1 = Gnd}{RSC_resume_chan&0xff=5:Aux PUD2 = Gnd}{RSC_resume" VALUE 0x001c88d1 /* @ECU_Address@RSC_resume_chan@0x01007378@ */ ECIPP_ALIGNMENT_UBYTE 255 RSC_resume_chan_COMPU_VTAB 0 255 BIT_MASK 0xff /end CHARACTERISTIC
/begin COMPU_METHOD RSC_resume_chan_COMPU_VTAB "Verbal Table" TAB_VERB "%.0" "list" COMPU_TAB_REF RSC_resume_chan_COMPU_VTAB_REF /end COMPU_METHOD
/begin COMPU_VTAB RSC_resume_chan_COMPU_VTAB_REF "Verbal Table" TAB_VERB 31 0 "Disabled" 1 "Aux PU1 = Gnd" 2 "Aux PU2 = Gnd" 3 "Aux PU3 = Gnd" 4 "Aux PUD1 = Gnd" 5 "Aux PUD2 = Gnd" 6 "Aux PUD3 = Gnd" 7 "Aux PUD4 = +V" 8 "Aux PUD5 = Gnd" 9 "Aux DIG1" 10 "Aux DIG2" 11 "Aux DIG3" 12 "Aux DIG4" 13 "Aux DIG5" 14 "Aux DIG6" 15 "Aux DIG7" 16 "Aux DIG8" 17 "Aux DIG9" 18 "Aux DIG10" 19 "Aux DIG11" 20 "Aux DIG12" 21 "Aux DIG13" 22 "Aux DIG14" 23 "Aux DIG15" 24 "Aux DIG16" 25 "Aux DIG17" 26 "Aux DIG18" 27 "Aux DIG19" 28 "Gov1" 29 "Gov2" 30 "CAN sourced" DEFAULT_VALUE "UNKNOWN" /end COMPU_VTAB
/begin CHARACTERISTIC RSC_setinc_chan "Cruise set/inc input{RSC_setinc_chan&0xff=0:Disabled}{RSC_setinc_chan&0xff=1:Aux PU1 = Gnd}{RSC_setinc_chan&0xff=2:Aux PU2 = Gnd}{RSC_setinc_chan&0xff=3:Aux PU3 = Gnd}{RSC_setinc_chan&0xff=4:Aux PUD1 = Gnd}{RSC_setinc_chan&0xff=5:Aux PUD2 = Gnd}{RSC_setin" VALUE 0x001c88d6 /* @ECU_Address@RSC_setinc_chan@0x01007380@ */ ECIPP_ALIGNMENT_UBYTE 255 RSC_setinc_chan_COMPU_VTAB 0 255 BIT_MASK 0xff /end CHARACTERISTIC
/begin COMPU_METHOD RSC_setinc_chan_COMPU_VTAB "Verbal Table" TAB_VERB "%.0" "list" COMPU_TAB_REF RSC_setinc_chan_COMPU_VTAB_REF /end COMPU_METHOD
/begin COMPU_VTAB RSC_setinc_chan_COMPU_VTAB_REF "Verbal Table" TAB_VERB 31 0 "Disabled" 1 "Aux PU1 = Gnd" 2 "Aux PU2 = Gnd" 3 "Aux PU3 = Gnd" 4 "Aux PUD1 = Gnd" 5 "Aux PUD2 = Gnd" 6 "Aux PUD3 = Gnd" 7 "Aux PUD4 = +V" 8 "Aux PUD5 = Gnd" 9 "Aux DIG1" 10 "Aux DIG2" 11 "Aux DIG3" 12 "Aux DIG4" 13 "Aux DIG5" 14 "Aux DIG6" 15 "Aux DIG7" 16 "Aux DIG8" 17 "Aux DIG9" 18 "Aux DIG10" 19 "Aux DIG11" 20 "Aux DIG12" 21 "Aux DIG13" 22 "Aux DIG14" 23 "Aux DIG15" 24 "Aux DIG16" 25 "Aux DIG17" 26 "Aux DIG18" 27 "Aux DIG19" 28 "Gov1" 29 "Gov2" 30 "CAN sourced" DEFAULT_VALUE "UNKNOWN" /end COMPU_VTAB
/begin CHARACTERISTIC RSC_setdec_chan "Cruise set/dec input{RSC_setdec_chan&0xff=0:Disabled}{RSC_setdec_chan&0xff=1:Aux PU1 = Gnd}{RSC_setdec_chan&0xff=2:Aux PU2 = Gnd}{RSC_setdec_chan&0xff=3:Aux PU3 = Gnd}{RSC_setdec_chan&0xff=4:Aux PUD1 = Gnd}{RSC_setdec_chan&0xff=5:Aux PUD2 = Gnd}{RSC_setde" VALUE 0x001c88d4 /* @ECU_Address@RSC_setdec_chan@0x01007388@ */ ECIPP_ALIGNMENT_UBYTE 255 RSC_setdec_chan_COMPU_VTAB 0 255 BIT_MASK 0xff /end CHARACTERISTIC
/begin COMPU_METHOD RSC_setdec_chan_COMPU_VTAB "Verbal Table" TAB_VERB "%.0" "list" COMPU_TAB_REF RSC_setdec_chan_COMPU_VTAB_REF /end COMPU_METHOD
/begin COMPU_VTAB RSC_setdec_chan_COMPU_VTAB_REF "Verbal Table" TAB_VERB 31 0 "Disabled" 1 "Aux PU1 = Gnd" 2 "Aux PU2 = Gnd" 3 "Aux PU3 = Gnd" 4 "Aux PUD1 = Gnd" 5 "Aux PUD2 = Gnd" 6 "Aux PUD3 = Gnd" 7 "Aux PUD4 = +V" 8 "Aux PUD5 = Gnd" 9 "Aux DIG1" 10 "Aux DIG2" 11 "Aux DIG3" 12 "Aux DIG4" 13 "Aux DIG5" 14 "Aux DIG6" 15 "Aux DIG7" 16 "Aux DIG8" 17 "Aux DIG9" 18 "Aux DIG10" 19 "Aux DIG11" 20 "Aux DIG12" 21 "Aux DIG13" 22 "Aux DIG14" 23 "Aux DIG15" 24 "Aux DIG16" 25 "Aux DIG17" 26 "Aux DIG18" 27 "Aux DIG19" 28 "Gov1" 29 "Gov2" 30 "CAN sourced" DEFAULT_VALUE "UNKNOWN" /end COMPU_VTAB
/begin CHARACTERISTIC RSC_enable_moment "Cruise enable input type{RSC_enable_moment&0xff=0:Toggle switch}{RSC_enable_moment&0xff=1:Momentary switch}" VALUE 0x001c88ce /* @ECU_Address@RSC_enable_moment@0x01007390@ */ ECIPP_ALIGNMENT_UBYTE 255 RSC_enable_moment_COMPU_VTAB 0 255 BIT_MASK 0xff /end CHARACTERISTIC
/begin COMPU_METHOD RSC_enable_moment_COMPU_VTAB "Verbal Table" TAB_VERB "%.0" "list" COMPU_TAB_REF RSC_enable_moment_COMPU_VTAB_REF /end COMPU_METHOD
/begin COMPU_VTAB RSC_enable_moment_COMPU_VTAB_REF "Verbal Table" TAB_VERB 2 0 "Toggle switch" 1 "Momentary switch" DEFAULT_VALUE "UNKNOWN" /end COMPU_VTAB
/begin CHARACTERISTIC RSC_setinc_wait "Cruise set/inc ramp wait" VALUE 0x001c7ed2 /* @ECU_Address@RSC_setinc_wait@0x01007398@ */ ECIPP_ALIGNMENT_UWORD 65535 Compu_RSC_setinc_wait 0 65535 /end CHARACTERISTIC
/begin COMPU_METHOD Compu_RSC_setinc_wait " " RAT_FUNC "%.0" "ms" COEFFS 0 1 0 0 0 1 /end COMPU_METHOD
/begin CHARACTERISTIC RSC_setdec_wait "Cruise set/dec ramp wait" VALUE 0x001c7ecc /* @ECU_Address@RSC_setdec_wait@0x010073A0@ */ ECIPP_ALIGNMENT_UWORD 65535 Compu_RSC_setdec_wait 0 65535 /end CHARACTERISTIC
/begin COMPU_METHOD Compu_RSC_setdec_wait " " RAT_FUNC "%.0" "ms" COEFFS 0 1 0 0 0 1 /end COMPU_METHOD
/begin CHARACTERISTIC RSC_resume_ramp "Cruise resume ramp rate" VALUE 0x001c7ec6 /* @ECU_Address@RSC_resume_ramp@0x010073A8@ */ ECIPP_ALIGNMENT_UWORD 256 Compu_RSC_resume_ramp 0 255.99609375 /end CHARACTERISTIC
/begin COMPU_METHOD Compu_RSC_resume_ramp " " RAT_FUNC "%.2" "kph/sec" COEFFS 0 256 0 0 0 1 /end COMPU_METHOD
/begin CHARACTERISTIC RSC_setinc_tap "Cruise set/inc tap step" VALUE 0x001c7ed0 /* @ECU_Address@RSC_setinc_tap@0x010073B0@ */ ECIPP_ALIGNMENT_UWORD 256 Compu_RSC_setinc_tap 0 255.99609375 /end CHARACTERISTIC
/begin COMPU_METHOD Compu_RSC_setinc_tap " " RAT_FUNC "%.2" "kph" COEFFS 0 256 0 0 0 1 /end COMPU_METHOD
/begin CHARACTERISTIC RSC_setinc_ramp "Cruise set/inc ramp rate" VALUE 0x001c7ece /* @ECU_Address@RSC_setinc_ramp@0x010073B8@ */ ECIPP_ALIGNMENT_UWORD 256 Compu_RSC_setinc_ramp 0 255.99609375 /end CHARACTERISTIC
/begin COMPU_METHOD Compu_RSC_setinc_ramp " " RAT_FUNC "%.2" "kph/sec" COEFFS 0 256 0 0 0 1 /end COMPU_METHOD
/begin CHARACTERISTIC RSC_setdec_tap "Cruise set/dec tap step" VALUE 0x001c7eca /* @ECU_Address@RSC_setdec_tap@0x010073C0@ */ ECIPP_ALIGNMENT_UWORD 256 Compu_RSC_setdec_tap 0 255.99609375 /end CHARACTERISTIC
/begin COMPU_METHOD Compu_RSC_setdec_tap " " RAT_FUNC "%.2" "kph" COEFFS 0 256 0 0 0 1 /end COMPU_METHOD
/begin CHARACTERISTIC RSC_setdec_ramp "Cruise set/dec ramp rate" VALUE 0x001c7ec8 /* @ECU_Address@RSC_setdec_ramp@0x010073C8@ */ ECIPP_ALIGNMENT_UWORD 256 Compu_RSC_setdec_ramp 0 255.99609375 /end CHARACTERISTIC
/begin COMPU_METHOD Compu_RSC_setdec_ramp " " RAT_FUNC "%.2" "kph/sec" COEFFS 0 256 0 0 0 1 /end COMPU_METHOD
/begin CHARACTERISTIC RSC_min_kph "Cruise min roadspeed" VALUE 0x001c7ec2 /* @ECU_Address@RSC_min_kph@0x010073D0@ */ ECIPP_ALIGNMENT_UWORD 256 Compu_RSC_min_kph 0 255.99609375 /end CHARACTERISTIC
/begin COMPU_METHOD Compu_RSC_min_kph " " RAT_FUNC "%.1" "kph" COEFFS 0 256 0 0 0 1 /end COMPU_METHOD
/begin CHARACTERISTIC RSC_max_kph "Cruise max roadspeet" VALUE 0x001c7ec0 /* @ECU_Address@RSC_max_kph@0x010073D8@ */ ECIPP_ALIGNMENT_UWORD 256 Compu_RSC_max_kph 0 255.99609375 /end CHARACTERISTIC
/begin COMPU_METHOD Compu_RSC_max_kph " " RAT_FUNC "%.1" "kph" COEFFS 0 256 0 0 0 1 /end COMPU_METHOD
/begin MEASUREMENT RSC_speed_accum "Cruise control final target" ULONG Compu_RSC_speed_accum 0 0 0 255.999999940395 ECU_ADDRESS 0x010073E0 /end MEASUREMENT
/begin COMPU_METHOD Compu_RSC_speed_accum " " RAT_FUNC "%.1" "kph" COEFFS 0 16777216 0 0 0 1 /end COMPU_METHOD
/begin MEASUREMENT RSC_speed_slew "Cruise control instant target" ULONG Compu_RSC_speed_slew 0 0 0 255.999999940395 ECU_ADDRESS 0x010073E8 /end MEASUREMENT
/begin COMPU_METHOD Compu_RSC_speed_slew " " RAT_FUNC "%.1" "kph" COEFFS 0 16777216 0 0 0 1 /end COMPU_METHOD
/begin MEASUREMENT RSC_engaged "Cruise control engaged{RSC_engaged&0xff=0:Not engaged}{RSC_engaged&0xff=1:Engaged}" UBYTE RSC_engaged_COMPU_VTAB 0 0 0 255 ECU_ADDRESS 0x010073F0 BIT_MASK 0xff /end MEASUREMENT
/begin COMPU_METHOD RSC_engaged_COMPU_VTAB "Verbal Table" TAB_VERB "%.0" "list" COMPU_TAB_REF RSC_engaged_COMPU_VTAB_REF /end COMPU_METHOD
/begin COMPU_VTAB RSC_engaged_COMPU_VTAB_REF "Verbal Table" TAB_VERB 2 0 "Not engaged" 1 "Engaged" DEFAULT_VALUE "UNKNOWN" /end COMPU_VTAB
/begin MEASUREMENT RSC_enabled "Cruise control enabled{RSC_enabled&0xff=0:Disabled}{RSC_enabled&0xff=1:Enabled}" UBYTE RSC_enabled_COMPU_VTAB 0 0 0 255 ECU_ADDRESS 0x010073F8 BIT_MASK 0xff /end MEASUREMENT
/begin COMPU_METHOD RSC_enabled_COMPU_VTAB "Verbal Table" TAB_VERB "%.0" "list" COMPU_TAB_REF RSC_enabled_COMPU_VTAB_REF /end COMPU_METHOD
/begin COMPU_VTAB RSC_enabled_COMPU_VTAB_REF "Verbal Table" TAB_VERB 2 0 "Disabled" 1 "Enabled" DEFAULT_VALUE "UNKNOWN" /end COMPU_VTAB
/begin MEASUREMENT CAM1_ana_raw "CAM1_ana_raw" UWORD Compu_CAM1_ana_raw 0 0 0 5.00114468864469 ECU_ADDRESS 0x01007448 /end MEASUREMENT
/begin COMPU_METHOD Compu_CAM1_ana_raw " " RAT_FUNC "%.3" "-" COEFFS 0 13104 0 0 0 1 /end COMPU_METHOD
/begin MEASUREMENT RS_ana_raw "RS_ana_raw" UWORD Compu_RS_ana_raw 0 0 0 5.00114468864469 ECU_ADDRESS 0x01007450 /end MEASUREMENT
/begin COMPU_METHOD Compu_RS_ana_raw " " RAT_FUNC "%.3" "-" COEFFS 0 13104 0 0 0 1 /end COMPU_METHOD
/begin MEASUREMENT AUX_PWM7_FB_raw "AUX_PWM7_FB_raw" UWORD Compu_AUX_PWM7_FB_raw 0 0 0 5.00114468864469 ECU_ADDRESS 0x01007458 /end MEASUREMENT
/begin COMPU_METHOD Compu_AUX_PWM7_FB_raw " " RAT_FUNC "%.3" "-" COEFFS 0 13104 0 0 0 1 /end COMPU_METHOD
/begin MEASUREMENT AUX_PWM8_FB_raw "AUX_PWM8_FB_raw" UWORD Compu_AUX_PWM8_FB_raw 0 0 0 5.00114468864469 ECU_ADDRESS 0x01007460 /end MEASUREMENT
/begin COMPU_METHOD Compu_AUX_PWM8_FB_raw " " RAT_FUNC "%.3" "-" COEFFS 0 13104 0 0 0 1 /end COMPU_METHOD
/begin MEASUREMENT RELAY_LS_raw "RELAY_LS_raw" UWORD Compu_RELAY_LS_raw 0 0 0 5.00114468864469 ECU_ADDRESS 0x01007468 /end MEASUREMENT
/begin COMPU_METHOD Compu_RELAY_LS_raw " " RAT_FUNC "%.3" "-" COEFFS 0 13104 0 0 0 1 /end COMPU_METHOD
/begin MEASUREMENT LOCKOFF_LS_raw "LOCKOFF_LS_raw" UWORD Compu_LOCKOFF_LS_raw 0 0 0 5.00114468864469 ECU_ADDRESS 0x01007470 /end MEASUREMENT
/begin COMPU_METHOD Compu_LOCKOFF_LS_raw " " RAT_FUNC "%.3" "-" COEFFS 0 13104 0 0 0 1 /end COMPU_METHOD
/begin MEASUREMENT STARTER_FB_raw "STARTER_FB_raw" UWORD Compu_STARTER_FB_raw 0 0 0 5.00114468864469 ECU_ADDRESS 0x01007478 /end MEASUREMENT
/begin COMPU_METHOD Compu_STARTER_FB_raw " " RAT_FUNC "%.3" "-" COEFFS 0 13104 0 0 0 1 /end COMPU_METHOD
/begin MEASUREMENT MIL_LS_raw "MIL_LS_raw" UWORD Compu_MIL_LS_raw 0 0 0 5.00114468864469 ECU_ADDRESS 0x01007480 /end MEASUREMENT
/begin COMPU_METHOD Compu_MIL_LS_raw " " RAT_FUNC "%.3" "-" COEFFS 0 13104 0 0 0 1 /end COMPU_METHOD
/begin MEASUREMENT TACH_FB_raw "TACH_FB_raw" UWORD Compu_TACH_FB_raw 0 0 0 5.00114468864469 ECU_ADDRESS 0x01007488 /end MEASUREMENT
/begin COMPU_METHOD Compu_TACH_FB_raw " " RAT_FUNC "%.3" "-" COEFFS 0 13104 0 0 0 1 /end COMPU_METHOD
/begin MEASUREMENT AUX_DIG4_raw "AUX_DIG4_raw" UWORD Compu_AUX_DIG4_raw 0 0 0 5.00114468864469 ECU_ADDRESS 0x01007490 /end MEASUREMENT
/begin COMPU_METHOD Compu_AUX_DIG4_raw " " RAT_FUNC "%.3" "-" COEFFS 0 13104 0 0 0 1 /end COMPU_METHOD
/begin MEASUREMENT AUX_DIG5_raw "AUX_DIG5_raw" UWORD Compu_AUX_DIG5_raw 0 0 0 5.00114468864469 ECU_ADDRESS 0x01007498 /end MEASUREMENT
/begin COMPU_METHOD Compu_AUX_DIG5_raw " " RAT_FUNC "%.3" "-" COEFFS 0 13104 0 0 0 1 /end COMPU_METHOD
/begin MEASUREMENT AUX_DIG6_raw "AUX_DIG6_raw" UWORD Compu_AUX_DIG6_raw 0 0 0 5.00114468864469 ECU_ADDRESS 0x010074A0 /end MEASUREMENT
/begin COMPU_METHOD Compu_AUX_DIG6_raw " " RAT_FUNC "%.3" "-" COEFFS 0 13104 0 0 0 1 /end COMPU_METHOD
/begin MEASUREMENT AUX_DIG7_raw "AUX_DIG7_raw" UWORD Compu_AUX_DIG7_raw 0 0 0 5.00114468864469 ECU_ADDRESS 0x010074A8 /end MEASUREMENT
/begin COMPU_METHOD Compu_AUX_DIG7_raw " " RAT_FUNC "%.3" "-" COEFFS 0 13104 0 0 0 1 /end COMPU_METHOD
/begin MEASUREMENT AUX_DIG8_raw "AUX_DIG8_raw" UWORD Compu_AUX_DIG8_raw 0 0 0 5.00114468864469 ECU_ADDRESS 0x010074B0 /end MEASUREMENT
/begin COMPU_METHOD Compu_AUX_DIG8_raw " " RAT_FUNC "%.3" "-" COEFFS 0 13104 0 0 0 1 /end COMPU_METHOD
/begin MEASUREMENT AUX_DIG4_volt "AUX_DIG4 volts" UWORD Compu_AUX_DIG4_volt 0 0 0 255.99609375 ECU_ADDRESS 0x010074B8 /end MEASUREMENT
/begin COMPU_METHOD Compu_AUX_DIG4_volt " " RAT_FUNC "%.2" "volts" COEFFS 0 256 0 0 0 1 /end COMPU_METHOD
/begin MEASUREMENT AUX_DIG5_volt "AUX_DIG5 volts" UWORD Compu_AUX_DIG5_volt 0 0 0 255.99609375 ECU_ADDRESS 0x010074C0 /end MEASUREMENT
/begin COMPU_METHOD Compu_AUX_DIG5_volt " " RAT_FUNC "%.2" "volts" COEFFS 0 256 0 0 0 1 /end COMPU_METHOD
/begin MEASUREMENT AUX_DIG6_volt "AUX_DIG6 volts" UWORD Compu_AUX_DIG6_volt 0 0 0 255.99609375 ECU_ADDRESS 0x010074C8 /end MEASUREMENT
/begin COMPU_METHOD Compu_AUX_DIG6_volt " " RAT_FUNC "%.2" "volts" COEFFS 0 256 0 0 0 1 /end COMPU_METHOD
/begin MEASUREMENT AUX_DIG7_volt "AUX_DIG7 volts" UWORD Compu_AUX_DIG7_volt 0 0 0 255.99609375 ECU_ADDRESS 0x010074D0 /end MEASUREMENT
/begin COMPU_METHOD Compu_AUX_DIG7_volt " " RAT_FUNC "%.2" "volts" COEFFS 0 256 0 0 0 1 /end COMPU_METHOD
/begin MEASUREMENT AUX_DIG8_volt "AUX_DIG8 volts" UWORD Compu_AUX_DIG8_volt 0 0 0 255.99609375 ECU_ADDRESS 0x010074D8 /end MEASUREMENT
/begin COMPU_METHOD Compu_AUX_DIG8_volt " " RAT_FUNC "%.2" "volts" COEFFS 0 256 0 0 0 1 /end COMPU_METHOD
/begin MEASUREMENT UEGOPI_raw "UEGOPI_raw" UWORD Compu_UEGOPI_raw 0 0 0 5.00114468864469 ECU_ADDRESS 0x01007548 /end MEASUREMENT
/begin COMPU_METHOD Compu_UEGOPI_raw " " RAT_FUNC "%.3" "-" COEFFS 0 13104 0 0 0 1 /end COMPU_METHOD
/begin MEASUREMENT UEGOSR_raw "UEGOSR_raw" UWORD Compu_UEGOSR_raw 0 0 0 5.00114468864469 ECU_ADDRESS 0x01007550 /end MEASUREMENT
/begin COMPU_METHOD Compu_UEGOSR_raw " " RAT_FUNC "%.3" "-" COEFFS 0 13104 0 0 0 1 /end COMPU_METHOD
/begin MEASUREMENT UEGOHFB_raw "UEGOHFB_raw" UWORD Compu_UEGOHFB_raw 0 0 0 5.00114468864469 ECU_ADDRESS 0x01007558 /end MEASUREMENT
/begin COMPU_METHOD Compu_UEGOHFB_raw " " RAT_FUNC "%.3" "-" COEFFS 0 13104 0 0 0 1 /end COMPU_METHOD
/begin CHARACTERISTIC RSC_engaged_light "Cruise engaged light{RSC_engaged_light&0xff=0:Disabled}{RSC_engaged_light&0xff=1:Buzzer Output}{RSC_engaged_light&0xff=2:MIL Output}{RSC_engaged_light&0xff=3:TACH Output}{RSC_engaged_light&0xff=4:Starter Output}{RSC_engaged_light&0xff=5:EGOH1}{RSC_engaged" VALUE 0x001c88cf /* @ECU_Address@RSC_engaged_light@0x01007680@ */ ECIPP_ALIGNMENT_UBYTE 255 RSC_engaged_light_COMPU_VTAB 0 255 BIT_MASK 0xff /end CHARACTERISTIC
/begin COMPU_METHOD RSC_engaged_light_COMPU_VTAB "Verbal Table" TAB_VERB "%.0" "list" COMPU_TAB_REF RSC_engaged_light_COMPU_VTAB_REF /end COMPU_METHOD
/begin COMPU_VTAB RSC_engaged_light_COMPU_VTAB_REF "Verbal Table" TAB_VERB 32 0 "Disabled" 1 "Buzzer Output" 2 "MIL Output" 3 "TACH Output" 4 "Starter Output" 5 "EGOH1" 6 "EGOH2" 7 "EGOH3" 8 "EGOH4" 9 "Aux PWM1" 10 "Aux PWM2" 11 "Aux PWM3" 12 "Aux PWM4" 13 "Aux PWM5" 14 "Aux PWM6" 15 "Aux PWM7" 16 "Aux PWM8" 17 "Aux PWM9" 18 "Aux PWM10" 19 "Aux PWM11" 20 "Aux PWM12" 21 "Aux PWM13" 22 "Aux PWM14" 23 "Aux PWM15" 24 "Aux PWM16" 25 "Aux PWM17" 26 "Aux PWM18" 27 "Aux PWM19" 28 "Aux PWM20" 29 "Aux PWM21" 30 "Aux PWM22" 31 "Aux PWM23" DEFAULT_VALUE "UNKNOWN" /end COMPU_VTAB
/begin CHARACTERISTIC RS_kph_crct_ena "Roadspeed nonlinear correction{RS_kph_crct_ena&0xff=0:Disabled}{RS_kph_crct_ena&0xff=1:Enabled}" VALUE 0x001c88df /* @ECU_Address@RS_kph_crct_ena@0x010077D8@ */ ECIPP_ALIGNMENT_UBYTE 255 RS_kph_crct_ena_COMPU_VTAB 0 255 BIT_MASK 0xff /end CHARACTERISTIC
/begin COMPU_METHOD RS_kph_crct_ena_COMPU_VTAB "Verbal Table" TAB_VERB "%.0" "list" COMPU_TAB_REF RS_kph_crct_ena_COMPU_VTAB_REF /end COMPU_METHOD
/begin COMPU_VTAB RS_kph_crct_ena_COMPU_VTAB_REF "Verbal Table" TAB_VERB 2 0 "Disabled" 1 "Enabled" DEFAULT_VALUE "UNKNOWN" /end COMPU_VTAB
/begin MEASUREMENT RS_speed_meas_acc "Road speed measured" ULONG Compu_RS_speed_meas_acc 0 0 0 255.999999940395 ECU_ADDRESS 0x010077E0 /end MEASUREMENT
/begin COMPU_METHOD Compu_RS_speed_meas_acc " " RAT_FUNC "%.1" "km/hr" COEFFS 0 16777216 0 0 0 1 /end COMPU_METHOD
/begin MEASUREMENT RS_min_FPP "Roadspeed min FPP command" ULONG Compu_RS_min_FPP 0 0 0 99.9999999767169 ECU_ADDRESS 0x01007890 /end MEASUREMENT
/begin COMPU_METHOD Compu_RS_min_FPP " " RAT_FUNC "%.1" "%" COEFFS 0 42949672.96 0 0 0 1 /end COMPU_METHOD
/begin MEASUREMENT RS_OOA_state "Roadspeed authority status{RS_OOA_state&0xff=0xff:Request < TPS}{RS_OOA_state&0xff=0x00:In Authority}{RS_OOA_state&0xff=0x01:Request > TPS}" UBYTE RS_OOA_state_COMPU_VTAB 0 0 0 255 ECU_ADDRESS 0x01007898 BIT_MASK 0xff /end MEASUREMENT
/begin COMPU_METHOD RS_OOA_state_COMPU_VTAB "Verbal Table" TAB_VERB "%.0" "list" COMPU_TAB_REF RS_OOA_state_COMPU_VTAB_REF /end COMPU_METHOD
/begin COMPU_VTAB RS_OOA_state_COMPU_VTAB_REF "Verbal Table" TAB_VERB 3 0xff "Request < TPS" 0x00 "In Authority" 0x01 "Request > TPS" DEFAULT_VALUE "UNKNOWN" /end COMPU_VTAB
/begin MEASUREMENT RSC_CCVS_status "Roadspeed cruise status{RSC_CCVS_status&0xff=0x00:Disabled}{RSC_CCVS_status&0xff=0x01:Holding}{RSC_CCVS_status&0xff=0x02:Accelerating}{RSC_CCVS_status&0xff=0x03:Decelerating}{RSC_CCVS_status&0xff=0x04:Resuming}{RSC_CCVS_status&0xff=0x05:Setting}{RSC_CCVS_" UBYTE RSC_CCVS_status_COMPU_VTAB 0 0 0 255 ECU_ADDRESS 0x010078A0 BIT_MASK 0xff /end MEASUREMENT
/begin COMPU_METHOD RSC_CCVS_status_COMPU_VTAB "Verbal Table" TAB_VERB "%.0" "list" COMPU_TAB_REF RSC_CCVS_status_COMPU_VTAB_REF /end COMPU_METHOD
/begin COMPU_VTAB RSC_CCVS_status_COMPU_VTAB_REF "Verbal Table" TAB_VERB 7 0x00 "Disabled" 0x01 "Holding" 0x02 "Accelerating" 0x03 "Decelerating" 0x04 "Resuming" 0x05 "Setting" 0x06 "User Override" DEFAULT_VALUE "UNKNOWN" /end COMPU_VTAB
/begin MEASUREMENT RS_max_FPP "Roadspeed max FPP command" ULONG Compu_RS_max_FPP 0 0 0 99.9999999767169 ECU_ADDRESS 0x010078A8 /end MEASUREMENT
/begin COMPU_METHOD Compu_RS_max_FPP " " RAT_FUNC "%.1" "%" COEFFS 0 42949672.96 0 0 0 1 /end COMPU_METHOD
/begin CHARACTERISTIC RSC_disable_kph "Cruise disengage speed limit" VALUE 0x001c7eb8 /* @ECU_Address@RSC_disable_kph@0x010078E8@ */ ECIPP_ALIGNMENT_UWORD 256 Compu_RSC_disable_kph 0 255.99609375 /end CHARACTERISTIC
/begin COMPU_METHOD Compu_RSC_disable_kph " " RAT_FUNC "%.1" "kph" COEFFS 0 256 0 0 0 1 /end COMPU_METHOD
/begin CHARACTERISTIC RSC_retard_braking "Cruise retarder braking behavior{RSC_retard_braking&0xff=0:Not allowed}{RSC_retard_braking&0xff=1:Allowed}" VALUE 0x001c88d2 /* @ECU_Address@RSC_retard_braking@0x01007940@ */ ECIPP_ALIGNMENT_UBYTE 255 RSC_retard_braking_COMPU_VTAB 0 255 BIT_MASK 0xff /end CHARACTERISTIC
/begin COMPU_METHOD RSC_retard_braking_COMPU_VTAB "Verbal Table" TAB_VERB "%.0" "list" COMPU_TAB_REF RSC_retard_braking_COMPU_VTAB_REF /end COMPU_METHOD
/begin COMPU_VTAB RSC_retard_braking_COMPU_VTAB_REF "Verbal Table" TAB_VERB 2 0 "Not allowed" 1 "Allowed" DEFAULT_VALUE "UNKNOWN" /end COMPU_VTAB
/begin MEASUREMENT RS_FPPmin_Iacc "Roadspeed control integrator" SWORD Compu_RS_FPPmin_Iacc 0 0 -800 799.9755859375 ECU_ADDRESS 0x01007958 /end MEASUREMENT
/begin COMPU_METHOD Compu_RS_FPPmin_Iacc " " RAT_FUNC "%.1" "% load/RPM" COEFFS 0 40.96 0 0 0 1 /end COMPU_METHOD
/begin MEASUREMENT RS_FPPmax_Iacc "Roadspeed control integrator" SWORD Compu_RS_FPPmax_Iacc 0 0 -800 799.9755859375 ECU_ADDRESS 0x01007960 /end MEASUREMENT
/begin COMPU_METHOD Compu_RS_FPPmax_Iacc " " RAT_FUNC "%.1" "% load/RPM" COEFFS 0 40.96 0 0 0 1 /end COMPU_METHOD
/begin CHARACTERISTIC RS_Kp_dz "Roadspeed velocity Kp deadzone" VALUE 0x001CA10C /* @ECU_Address@RS_Kp_dz@0x01007988@ */ ECIPP_ALIGNMENT_SWORD 128 Compu_RS_Kp_dz -128 127.99609375 /end CHARACTERISTIC
/begin COMPU_METHOD Compu_RS_Kp_dz " " RAT_FUNC "%.1" "km/hr" COEFFS 0 256 0 0 0 1 /end COMPU_METHOD
/begin CHARACTERISTIC RS2_Kp_dz "Roadspeed2 velocity Kp deadzone" VALUE 0x001CA158 /* @ECU_Address@RS2_Kp_dz@0x01007990@ */ ECIPP_ALIGNMENT_SWORD 128 Compu_RS2_Kp_dz -128 127.99609375 /end CHARACTERISTIC
/begin COMPU_METHOD Compu_RS2_Kp_dz " " RAT_FUNC "%.1" "km/hr" COEFFS 0 256 0 0 0 1 /end COMPU_METHOD
/begin CHARACTERISTIC RS3_Kp_dz "Roadspeed3 velocity Kp deadzone" VALUE 0x001CA1A4 /* @ECU_Address@RS3_Kp_dz@0x01007998@ */ ECIPP_ALIGNMENT_SWORD 128 Compu_RS3_Kp_dz -128 127.99609375 /end CHARACTERISTIC
/begin COMPU_METHOD Compu_RS3_Kp_dz " " RAT_FUNC "%.1" "km/hr" COEFFS 0 256 0 0 0 1 /end COMPU_METHOD
/begin CHARACTERISTIC RS_Kp_dz_tout "Roadspeed velocity Kp deadzone timeout" VALUE 0x001CA10A /* @ECU_Address@RS_Kp_dz_tout@0x010079A0@ */ ECIPP_ALIGNMENT_UWORD 65535 Compu_RS_Kp_dz_tout 0 65535 /end CHARACTERISTIC
/begin COMPU_METHOD Compu_RS_Kp_dz_tout " " RAT_FUNC "%.0" "ms" COEFFS 0 1 0 0 0 1 /end COMPU_METHOD
/begin CHARACTERISTIC RS2_Kp_dz_tout "Roadspeed2 velocity Kp deadzone timeout" VALUE 0x001CA156 /* @ECU_Address@RS2_Kp_dz_tout@0x010079A8@ */ ECIPP_ALIGNMENT_UWORD 65535 Compu_RS2_Kp_dz_tout 0 65535 /end CHARACTERISTIC
/begin COMPU_METHOD Compu_RS2_Kp_dz_tout " " RAT_FUNC "%.0" "ms" COEFFS 0 1 0 0 0 1 /end COMPU_METHOD
/begin CHARACTERISTIC RS3_Kp_dz_tout "Roadspeed3 velocity Kp deadzone timeout" VALUE 0x001CA1A2 /* @ECU_Address@RS3_Kp_dz_tout@0x010079B0@ */ ECIPP_ALIGNMENT_UWORD 65535 Compu_RS3_Kp_dz_tout 0 65535 /end CHARACTERISTIC
/begin COMPU_METHOD Compu_RS3_Kp_dz_tout " " RAT_FUNC "%.0" "ms" COEFFS 0 1 0 0 0 1 /end COMPU_METHOD
/begin CHARACTERISTIC RS_speed_CAN_tau "Roadspeed CAN additional low-pass" VALUE 0x001c8588 /* @ECU_Address@RS_speed_CAN_tau@0x01007A30@ */ ECIPP_ALIGNMENT_UWORD 327680 Compu_RS_speed_CAN_tau 0.45084 327680 /end CHARACTERISTIC
/begin COMPU_METHOD Compu_RS_speed_CAN_tau " " FORM "%.1" "ms"
 /begin FORMULA "-5 / log(1 - (X1 / 65536))" FORMULA_INV "(1 - exp(-5/X1)) * 65536" /end FORMULA
/end COMPU_METHOD
/begin MEASUREMENT RS_speed_CAN "Road speed CAN published speed" UWORD Compu_RS_speed_CAN 0 0 0 255.99609375 ECU_ADDRESS 0x01007A38 /end MEASUREMENT
/begin COMPU_METHOD Compu_RS_speed_CAN " " RAT_FUNC "%.1" "km/hr" COEFFS 0 256 0 0 0 1 /end COMPU_METHOD
/begin MEASUREMENT AUX_DIG12_raw "AUX_DIG12_raw" UWORD Compu_AUX_DIG12_raw 0 0 0 5.00114468864469 ECU_ADDRESS 0x01007B18 /end MEASUREMENT
/begin COMPU_METHOD Compu_AUX_DIG12_raw " " RAT_FUNC "%.3" "volts" COEFFS 0 13104 0 0 0 1 /end COMPU_METHOD
/begin MEASUREMENT AUX_PUD7_raw "AUX_PUD7_raw" UWORD Compu_AUX_PUD7_raw 0 0 0 5.00114468864469 ECU_ADDRESS 0x01007B20 /end MEASUREMENT
/begin COMPU_METHOD Compu_AUX_PUD7_raw " " RAT_FUNC "%.3" "volts" COEFFS 0 13104 0 0 0 1 /end COMPU_METHOD
/begin MEASUREMENT AUX_PUD8_raw "AUX_PUD8_raw" UWORD Compu_AUX_PUD8_raw 0 0 0 5.00114468864469 ECU_ADDRESS 0x01007B28 /end MEASUREMENT
/begin COMPU_METHOD Compu_AUX_PUD8_raw " " RAT_FUNC "%.3" "volts" COEFFS 0 13104 0 0 0 1 /end COMPU_METHOD
/begin MEASUREMENT AUX_DIG11_raw "AUX_DIG11_raw" UWORD Compu_AUX_DIG11_raw 0 0 0 5.00114468864469 ECU_ADDRESS 0x01007B30 /end MEASUREMENT
/begin COMPU_METHOD Compu_AUX_DIG11_raw " " RAT_FUNC "%.3" "volts" COEFFS 0 13104 0 0 0 1 /end COMPU_METHOD
/begin MEASUREMENT AUX_DIG11_volt "AUX_DIG11 volts" UWORD Compu_AUX_DIG11_volt 0 0 0 255.99609375 ECU_ADDRESS 0x01007B38 /end MEASUREMENT
/begin COMPU_METHOD Compu_AUX_DIG11_volt " " RAT_FUNC "%.2" "volts" COEFFS 0 256 0 0 0 1 /end COMPU_METHOD
/begin MEASUREMENT FPUMP_FB_raw "FPUMP_FB_raw" UWORD Compu_FPUMP_FB_raw 0 0 0 5.00114468864469 ECU_ADDRESS 0x01007B48 /end MEASUREMENT
/begin COMPU_METHOD Compu_FPUMP_FB_raw " " RAT_FUNC "%.3" "volts" COEFFS 0 13104 0 0 0 1 /end COMPU_METHOD
/begin MEASUREMENT AUX_DIG9_raw "AUX_DIG9_raw" UWORD Compu_AUX_DIG9_raw 0 0 0 5.00114468864469 ECU_ADDRESS 0x01007B68 /end MEASUREMENT
/begin COMPU_METHOD Compu_AUX_DIG9_raw " " RAT_FUNC "%.3" "-" COEFFS 0 13104 0 0 0 1 /end COMPU_METHOD
/begin MEASUREMENT AUX_DIG9_volt "AUX_DIG9 volts" UWORD Compu_AUX_DIG9_volt 0 0 0 255.99609375 ECU_ADDRESS 0x01007B70 /end MEASUREMENT
/begin COMPU_METHOD Compu_AUX_DIG9_volt " " RAT_FUNC "%.2" "volts" COEFFS 0 256 0 0 0 1 /end COMPU_METHOD
/begin MEASUREMENT AUX_DIG10_raw "AUX_DIG10_raw" UWORD Compu_AUX_DIG10_raw 0 0 0 5.00114468864469 ECU_ADDRESS 0x01007B80 /end MEASUREMENT
/begin COMPU_METHOD Compu_AUX_DIG10_raw " " RAT_FUNC "%.3" "-" COEFFS 0 13104 0 0 0 1 /end COMPU_METHOD
/begin MEASUREMENT AUX_DIG10_volt "AUX_DIG10 volts" UWORD Compu_AUX_DIG10_volt 0 0 0 255.99609375 ECU_ADDRESS 0x01007B88 /end MEASUREMENT
/begin COMPU_METHOD Compu_AUX_DIG10_volt " " RAT_FUNC "%.2" "volts" COEFFS 0 256 0 0 0 1 /end COMPU_METHOD
/begin MEASUREMENT AUX_DIG12_volt "AUX_DIG12 volts" UWORD Compu_AUX_DIG12_volt 0 0 0 255.99609375 ECU_ADDRESS 0x01007B98 /end MEASUREMENT
/begin COMPU_METHOD Compu_AUX_DIG12_volt " " RAT_FUNC "%.2" "volts" COEFFS 0 256 0 0 0 1 /end COMPU_METHOD
/begin MEASUREMENT AUX_DIG13_raw "AUX_DIG13_raw" UWORD Compu_AUX_DIG13_raw 0 0 0 5.00114468864469 ECU_ADDRESS 0x01007D68 /end MEASUREMENT
/begin COMPU_METHOD Compu_AUX_DIG13_raw " " RAT_FUNC "%.3" "volts" COEFFS 0 13104 0 0 0 1 /end COMPU_METHOD
/begin MEASUREMENT AUX_DIG13_volt "AUX_DIG13 volts" UWORD Compu_AUX_DIG13_volt 0 0 0 255.99609375 ECU_ADDRESS 0x01007D70 /end MEASUREMENT
/begin COMPU_METHOD Compu_AUX_DIG13_volt " " RAT_FUNC "%.2" "volts" COEFFS 0 256 0 0 0 1 /end COMPU_METHOD
/begin MEASUREMENT AUX_DIG14_raw "AUX_DIG14_raw" UWORD Compu_AUX_DIG14_raw 0 0 0 5.00114468864469 ECU_ADDRESS 0x01007D80 /end MEASUREMENT
/begin COMPU_METHOD Compu_AUX_DIG14_raw " " RAT_FUNC "%.3" "volts" COEFFS 0 13104 0 0 0 1 /end COMPU_METHOD
/begin MEASUREMENT AUX_DIG14_volt "AUX_DIG14 volts" UWORD Compu_AUX_DIG14_volt 0 0 0 255.99609375 ECU_ADDRESS 0x01007D88 /end MEASUREMENT
/begin COMPU_METHOD Compu_AUX_DIG14_volt " " RAT_FUNC "%.2" "volts" COEFFS 0 256 0 0 0 1 /end COMPU_METHOD
/begin MEASUREMENT AUX_DIG15_raw "AUX_DIG15_raw" UWORD Compu_AUX_DIG15_raw 0 0 0 5.00114468864469 ECU_ADDRESS 0x01007D98 /end MEASUREMENT
/begin COMPU_METHOD Compu_AUX_DIG15_raw " " RAT_FUNC "%.3" "volts" COEFFS 0 13104 0 0 0 1 /end COMPU_METHOD
/begin MEASUREMENT AUX_DIG15_volt "AUX_DIG15 volts" UWORD Compu_AUX_DIG15_volt 0 0 0 255.99609375 ECU_ADDRESS 0x01007DA0 /end MEASUREMENT
/begin COMPU_METHOD Compu_AUX_DIG15_volt " " RAT_FUNC "%.2" "volts" COEFFS 0 256 0 0 0 1 /end COMPU_METHOD
/begin MEASUREMENT AUX_DIG16_raw "AUX_DIG16_raw" UWORD Compu_AUX_DIG16_raw 0 0 0 5.00114468864469 ECU_ADDRESS 0x01007DB0 /end MEASUREMENT
/begin COMPU_METHOD Compu_AUX_DIG16_raw " " RAT_FUNC "%.3" "volts" COEFFS 0 13104 0 0 0 1 /end COMPU_METHOD
/begin MEASUREMENT AUX_DIG16_volt "AUX_DIG16 volts" UWORD Compu_AUX_DIG16_volt 0 0 0 255.99609375 ECU_ADDRESS 0x01007DB8 /end MEASUREMENT
/begin COMPU_METHOD Compu_AUX_DIG16_volt " " RAT_FUNC "%.2" "volts" COEFFS 0 256 0 0 0 1 /end COMPU_METHOD
/begin MEASUREMENT AUX_DIG17_raw "AUX_DIG17_raw" UWORD Compu_AUX_DIG17_raw 0 0 0 5.00114468864469 ECU_ADDRESS 0x01007DC8 /end MEASUREMENT
/begin COMPU_METHOD Compu_AUX_DIG17_raw " " RAT_FUNC "%.3" "volts" COEFFS 0 13104 0 0 0 1 /end COMPU_METHOD
/begin MEASUREMENT AUX_DIG17_volt "AUX_DIG17 volts" UWORD Compu_AUX_DIG17_volt 0 0 0 255.99609375 ECU_ADDRESS 0x01007DD0 /end MEASUREMENT
/begin COMPU_METHOD Compu_AUX_DIG17_volt " " RAT_FUNC "%.2" "volts" COEFFS 0 256 0 0 0 1 /end COMPU_METHOD
/begin MEASUREMENT AUX_DIG18_raw "AUX_DIG18_raw" UWORD Compu_AUX_DIG18_raw 0 0 0 5.00114468864469 ECU_ADDRESS 0x01007DE0 /end MEASUREMENT
/begin COMPU_METHOD Compu_AUX_DIG18_raw " " RAT_FUNC "%.3" "volts" COEFFS 0 13104 0 0 0 1 /end COMPU_METHOD
/begin MEASUREMENT AUX_DIG18_volt "AUX_DIG18 volts" UWORD Compu_AUX_DIG18_volt 0 0 0 255.99609375 ECU_ADDRESS 0x01007DE8 /end MEASUREMENT
/begin COMPU_METHOD Compu_AUX_DIG18_volt " " RAT_FUNC "%.2" "volts" COEFFS 0 256 0 0 0 1 /end COMPU_METHOD
/begin MEASUREMENT AUX_DIG19_raw "AUX_DIG19_raw" UWORD Compu_AUX_DIG19_raw 0 0 0 5.00114468864469 ECU_ADDRESS 0x01007DF8 /end MEASUREMENT
/begin COMPU_METHOD Compu_AUX_DIG19_raw " " RAT_FUNC "%.3" "volts" COEFFS 0 13104 0 0 0 1 /end COMPU_METHOD
/begin MEASUREMENT AUX_DIG19_volt "AUX_DIG19 volts" UWORD Compu_AUX_DIG19_volt 0 0 0 255.99609375 ECU_ADDRESS 0x01007E00 /end MEASUREMENT
/begin COMPU_METHOD Compu_AUX_DIG19_volt " " RAT_FUNC "%.2" "volts" COEFFS 0 256 0 0 0 1 /end COMPU_METHOD
/begin MEASUREMENT AUX_PUD9_raw "AUX_PUD9_raw" UWORD Compu_AUX_PUD9_raw 0 0 0 5.00114468864469 ECU_ADDRESS 0x01007E10 /end MEASUREMENT
/begin COMPU_METHOD Compu_AUX_PUD9_raw " " RAT_FUNC "%.3" "volts" COEFFS 0 13104 0 0 0 1 /end COMPU_METHOD
/begin MEASUREMENT AUX_PUD10_raw "AUX_PUD10_raw" UWORD Compu_AUX_PUD10_raw 0 0 0 5.00114468864469 ECU_ADDRESS 0x01007E18 /end MEASUREMENT
/begin COMPU_METHOD Compu_AUX_PUD10_raw " " RAT_FUNC "%.3" "volts" COEFFS 0 13104 0 0 0 1 /end COMPU_METHOD
/begin MEASUREMENT AUX_PUD11_raw "AUX_PUD11_raw" UWORD Compu_AUX_PUD11_raw 0 0 0 5.00114468864469 ECU_ADDRESS 0x01007E20 /end MEASUREMENT
/begin COMPU_METHOD Compu_AUX_PUD11_raw " " RAT_FUNC "%.3" "volts" COEFFS 0 13104 0 0 0 1 /end COMPU_METHOD
/begin MEASUREMENT AUX_PUD12_raw "AUX_PUD12_raw" UWORD Compu_AUX_PUD12_raw 0 0 0 5.00114468864469 ECU_ADDRESS 0x01007E28 /end MEASUREMENT
/begin COMPU_METHOD Compu_AUX_PUD12_raw " " RAT_FUNC "%.3" "volts" COEFFS 0 13104 0 0 0 1 /end COMPU_METHOD
/begin MEASUREMENT AUX_PUD13_raw "AUX_PUD13_raw" UWORD Compu_AUX_PUD13_raw 0 0 0 5.00114468864469 ECU_ADDRESS 0x01007E30 /end MEASUREMENT
/begin COMPU_METHOD Compu_AUX_PUD13_raw " " RAT_FUNC "%.3" "volts" COEFFS 0 13104 0 0 0 1 /end COMPU_METHOD
/begin MEASUREMENT AUX_PUD14_raw "AUX_PUD14_raw" UWORD Compu_AUX_PUD14_raw 0 0 0 5.00114468864469 ECU_ADDRESS 0x01007E38 /end MEASUREMENT
/begin COMPU_METHOD Compu_AUX_PUD14_raw " " RAT_FUNC "%.3" "volts" COEFFS 0 13104 0 0 0 1 /end COMPU_METHOD
/begin MEASUREMENT AUX_PUD15_raw "AUX_PUD15_raw" UWORD Compu_AUX_PUD15_raw 0 0 0 5.00114468864469 ECU_ADDRESS 0x01007E40 /end MEASUREMENT
/begin COMPU_METHOD Compu_AUX_PUD15_raw " " RAT_FUNC "%.3" "volts" COEFFS 0 13104 0 0 0 1 /end COMPU_METHOD
/begin MEASUREMENT AUX_PUD16_raw "AUX_PUD16_raw" UWORD Compu_AUX_PUD16_raw 0 0 0 5.00114468864469 ECU_ADDRESS 0x01007E48 /end MEASUREMENT
/begin COMPU_METHOD Compu_AUX_PUD16_raw " " RAT_FUNC "%.3" "volts" COEFFS 0 13104 0 0 0 1 /end COMPU_METHOD
/begin MEASUREMENT AUX_PUD17_raw "AUX_PUD17_raw" UWORD Compu_AUX_PUD17_raw 0 0 0 5.00114468864469 ECU_ADDRESS 0x01007E50 /end MEASUREMENT
/begin COMPU_METHOD Compu_AUX_PUD17_raw " " RAT_FUNC "%.3" "volts" COEFFS 0 13104 0 0 0 1 /end COMPU_METHOD
/begin MEASUREMENT AUX_PUD18_raw "AUX_PUD18_raw" UWORD Compu_AUX_PUD18_raw 0 0 0 5.00114468864469 ECU_ADDRESS 0x01007E58 /end MEASUREMENT
/begin COMPU_METHOD Compu_AUX_PUD18_raw " " RAT_FUNC "%.3" "volts" COEFFS 0 13104 0 0 0 1 /end COMPU_METHOD
/begin MEASUREMENT AUX_PUD19_raw "AUX_PUD19_raw" UWORD Compu_AUX_PUD19_raw 0 0 0 5.00114468864469 ECU_ADDRESS 0x01007E60 /end MEASUREMENT
/begin COMPU_METHOD Compu_AUX_PUD19_raw " " RAT_FUNC "%.3" "volts" COEFFS 0 13104 0 0 0 1 /end COMPU_METHOD
/begin MEASUREMENT AUX_PUD20_raw "AUX_PUD20_raw" UWORD Compu_AUX_PUD20_raw 0 0 0 5.00114468864469 ECU_ADDRESS 0x01007E68 /end MEASUREMENT
/begin COMPU_METHOD Compu_AUX_PUD20_raw " " RAT_FUNC "%.3" "volts" COEFFS 0 13104 0 0 0 1 /end COMPU_METHOD
/begin MEASUREMENT AUX_PUD21_raw "AUX_PUD21_raw" UWORD Compu_AUX_PUD21_raw 0 0 0 5.00114468864469 ECU_ADDRESS 0x01007E70 /end MEASUREMENT
/begin COMPU_METHOD Compu_AUX_PUD21_raw " " RAT_FUNC "%.3" "volts" COEFFS 0 13104 0 0 0 1 /end COMPU_METHOD
/begin MEASUREMENT AUX_PUD22_raw "AUX_PUD22_raw" UWORD Compu_AUX_PUD22_raw 0 0 0 5.00114468864469 ECU_ADDRESS 0x01007E78 /end MEASUREMENT
/begin COMPU_METHOD Compu_AUX_PUD22_raw " " RAT_FUNC "%.3" "volts" COEFFS 0 13104 0 0 0 1 /end COMPU_METHOD
/begin MEASUREMENT AUX_PUD23_raw "AUX_PUD23_raw" UWORD Compu_AUX_PUD23_raw 0 0 0 5.00114468864469 ECU_ADDRESS 0x01007E80 /end MEASUREMENT
/begin COMPU_METHOD Compu_AUX_PUD23_raw " " RAT_FUNC "%.3" "volts" COEFFS 0 13104 0 0 0 1 /end COMPU_METHOD
/begin MEASUREMENT AUX_PUD24_raw "AUX_PUD24_raw" UWORD Compu_AUX_PUD24_raw 0 0 0 5.00114468864469 ECU_ADDRESS 0x01007E88 /end MEASUREMENT
/begin COMPU_METHOD Compu_AUX_PUD24_raw " " RAT_FUNC "%.3" "volts" COEFFS 0 13104 0 0 0 1 /end COMPU_METHOD
/begin MEASUREMENT AUX_PUD25_raw "AUX_PUD25_raw" UWORD Compu_AUX_PUD25_raw 0 0 0 5.00114468864469 ECU_ADDRESS 0x01007E90 /end MEASUREMENT
/begin COMPU_METHOD Compu_AUX_PUD25_raw " " RAT_FUNC "%.3" "volts" COEFFS 0 13104 0 0 0 1 /end COMPU_METHOD
/begin MEASUREMENT AUX_PWM9_FB_raw "AUX_PWM9_FB_raw" UWORD Compu_AUX_PWM9_FB_raw 0 0 0 5.00114468864469 ECU_ADDRESS 0x01007F98 /end MEASUREMENT
/begin COMPU_METHOD Compu_AUX_PWM9_FB_raw " " RAT_FUNC "%.3" "volts" COEFFS 0 13104 0 0 0 1 /end COMPU_METHOD
/begin MEASUREMENT AUX_PWM10_FB_raw "AUX_PWM10_FB_raw" UWORD Compu_AUX_PWM10_FB_raw 0 0 0 5.00114468864469 ECU_ADDRESS 0x01007FA0 /end MEASUREMENT
/begin COMPU_METHOD Compu_AUX_PWM10_FB_raw " " RAT_FUNC "%.3" "volts" COEFFS 0 13104 0 0 0 1 /end COMPU_METHOD
/begin MEASUREMENT AUX_PWM11_FB_raw "AUX_PWM11_FB_raw" UWORD Compu_AUX_PWM11_FB_raw 0 0 0 5.00114468864469 ECU_ADDRESS 0x01007FA8 /end MEASUREMENT
/begin COMPU_METHOD Compu_AUX_PWM11_FB_raw " " RAT_FUNC "%.3" "volts" COEFFS 0 13104 0 0 0 1 /end COMPU_METHOD
/begin MEASUREMENT AUX_PWM12_FB_raw "AUX_PWM12_FB_raw" UWORD Compu_AUX_PWM12_FB_raw 0 0 0 5.00114468864469 ECU_ADDRESS 0x01007FB0 /end MEASUREMENT
/begin COMPU_METHOD Compu_AUX_PWM12_FB_raw " " RAT_FUNC "%.3" "volts" COEFFS 0 13104 0 0 0 1 /end COMPU_METHOD
/begin MEASUREMENT AUX_PWM13_FB_raw "AUX_PWM13_FB_raw" UWORD Compu_AUX_PWM13_FB_raw 0 0 0 5.00114468864469 ECU_ADDRESS 0x01007FB8 /end MEASUREMENT
/begin COMPU_METHOD Compu_AUX_PWM13_FB_raw " " RAT_FUNC "%.3" "volts" COEFFS 0 13104 0 0 0 1 /end COMPU_METHOD
/begin MEASUREMENT AUX_PWM14_FB_raw "AUX_PWM14_FB_raw" UWORD Compu_AUX_PWM14_FB_raw 0 0 0 5.00114468864469 ECU_ADDRESS 0x01007FC0 /end MEASUREMENT
/begin COMPU_METHOD Compu_AUX_PWM14_FB_raw " " RAT_FUNC "%.3" "volts" COEFFS 0 13104 0 0 0 1 /end COMPU_METHOD
/begin MEASUREMENT AUX_PWM15_FB_raw "AUX_PWM15_FB_raw" UWORD Compu_AUX_PWM15_FB_raw 0 0 0 5.00114468864469 ECU_ADDRESS 0x01007FC8 /end MEASUREMENT
/begin COMPU_METHOD Compu_AUX_PWM15_FB_raw " " RAT_FUNC "%.3" "volts" COEFFS 0 13104 0 0 0 1 /end COMPU_METHOD
/begin MEASUREMENT UEGO2PI_raw "UEGO2PI_raw" UWORD Compu_UEGO2PI_raw 0 0 0 5.00114468864469 ECU_ADDRESS 0x010081E0 /end MEASUREMENT
/begin COMPU_METHOD Compu_UEGO2PI_raw " " RAT_FUNC "%.3" "-" COEFFS 0 13104 0 0 0 1 /end COMPU_METHOD
/begin MEASUREMENT UEGO2SR_raw "UEGO2SR_raw" UWORD Compu_UEGO2SR_raw 0 0 0 5.00114468864469 ECU_ADDRESS 0x010081E8 /end MEASUREMENT
/begin COMPU_METHOD Compu_UEGO2SR_raw " " RAT_FUNC "%.3" "-" COEFFS 0 13104 0 0 0 1 /end COMPU_METHOD
/begin MEASUREMENT UEGO2HFB_raw "UEGO2HFB_raw" UWORD Compu_UEGO2HFB_raw 0 0 0 5.00114468864469 ECU_ADDRESS 0x010081F0 /end MEASUREMENT
/begin COMPU_METHOD Compu_UEGO2HFB_raw " " RAT_FUNC "%.3" "-" COEFFS 0 13104 0 0 0 1 /end COMPU_METHOD
/begin MEASUREMENT Vrelay_raw "Vrelay_raw" UWORD Compu_Vrelay_raw 0 0 0 5.00114468864469 ECU_ADDRESS 0x010086E0 /end MEASUREMENT
/begin COMPU_METHOD Compu_Vrelay_raw " " RAT_FUNC "%.3" "volts" COEFFS 0 13104 0 0 0 1 /end COMPU_METHOD
/begin MEASUREMENT VE5c_FB_raw "VE5c_FB_raw" UWORD Compu_VE5c_FB_raw 0 0 0 5.00114468864469 ECU_ADDRESS 0x010086E8 /end MEASUREMENT
/begin COMPU_METHOD Compu_VE5c_FB_raw " " RAT_FUNC "%.3" "volts" COEFFS 0 13104 0 0 0 1 /end COMPU_METHOD
/begin MEASUREMENT IVS_raw "IVS_raw" UWORD Compu_IVS_raw 0 0 0 5.00114468864469 ECU_ADDRESS 0x010086F0 /end MEASUREMENT
/begin COMPU_METHOD Compu_IVS_raw " " RAT_FUNC "%.3" "volts" COEFFS 0 13104 0 0 0 1 /end COMPU_METHOD
/begin MEASUREMENT AUX_DIG20_raw "AUX_DIG20_raw" UWORD Compu_AUX_DIG20_raw 0 0 0 5.00114468864469 ECU_ADDRESS 0x010086F8 /end MEASUREMENT
/begin COMPU_METHOD Compu_AUX_DIG20_raw " " RAT_FUNC "%.3" "volts" COEFFS 0 13104 0 0 0 1 /end COMPU_METHOD
/begin MEASUREMENT AUX_DIG20_volt "AUX_DIG20_volt" UWORD Compu_AUX_DIG20_volt 0 0 0 255.99609375 ECU_ADDRESS 0x01008700 /end MEASUREMENT
/begin COMPU_METHOD Compu_AUX_DIG20_volt " " RAT_FUNC "%.2" "volts" COEFFS 0 256 0 0 0 1 /end COMPU_METHOD
/begin MEASUREMENT AUX_DIG21_raw "AUX_DIG21_raw" UWORD Compu_AUX_DIG21_raw 0 0 0 5.00114468864469 ECU_ADDRESS 0x01008710 /end MEASUREMENT
/begin COMPU_METHOD Compu_AUX_DIG21_raw " " RAT_FUNC "%.3" "volts" COEFFS 0 13104 0 0 0 1 /end COMPU_METHOD
/begin MEASUREMENT AUX_DIG21_volt "AUX_DIG21_volt" UWORD Compu_AUX_DIG21_volt 0 0 0 255.99609375 ECU_ADDRESS 0x01008718 /end MEASUREMENT
/begin COMPU_METHOD Compu_AUX_DIG21_volt " " RAT_FUNC "%.2" "volts" COEFFS 0 256 0 0 0 1 /end COMPU_METHOD
/begin MEASUREMENT AUX_DIG22_raw "AUX_DIG22_raw" UWORD Compu_AUX_DIG22_raw 0 0 0 5.00114468864469 ECU_ADDRESS 0x01008728 /end MEASUREMENT
/begin COMPU_METHOD Compu_AUX_DIG22_raw " " RAT_FUNC "%.3" "volts" COEFFS 0 13104 0 0 0 1 /end COMPU_METHOD
/begin MEASUREMENT AUX_DIG22_volt "AUX_DIG22_volt" UWORD Compu_AUX_DIG22_volt 0 0 0 255.99609375 ECU_ADDRESS 0x01008730 /end MEASUREMENT
/begin COMPU_METHOD Compu_AUX_DIG22_volt " " RAT_FUNC "%.2" "volts" COEFFS 0 256 0 0 0 1 /end COMPU_METHOD
/begin MEASUREMENT AUX_PWM16_FB_raw "AUX_PWM16_FB_raw" UWORD Compu_AUX_PWM16_FB_raw 0 0 0 5.00114468864469 ECU_ADDRESS 0x01008740 /end MEASUREMENT
/begin COMPU_METHOD Compu_AUX_PWM16_FB_raw " " RAT_FUNC "%.3" "volts" COEFFS 0 13104 0 0 0 1 /end COMPU_METHOD
/begin MEASUREMENT AUX_PWM17_FB_raw "AUX_PWM17_FB_raw" UWORD Compu_AUX_PWM17_FB_raw 0 0 0 5.00114468864469 ECU_ADDRESS 0x01008748 /end MEASUREMENT
/begin COMPU_METHOD Compu_AUX_PWM17_FB_raw " " RAT_FUNC "%.3" "volts" COEFFS 0 13104 0 0 0 1 /end COMPU_METHOD
/begin MEASUREMENT AUX_PWM18_FB_raw "AUX_PWM18_FB_raw" UWORD Compu_AUX_PWM18_FB_raw 0 0 0 5.00114468864469 ECU_ADDRESS 0x01008750 /end MEASUREMENT
/begin COMPU_METHOD Compu_AUX_PWM18_FB_raw " " RAT_FUNC "%.3" "volts" COEFFS 0 13104 0 0 0 1 /end COMPU_METHOD
/begin MEASUREMENT AUX_PWM19_FB_raw "AUX_PWM19_FB_raw" UWORD Compu_AUX_PWM19_FB_raw 0 0 0 5.00114468864469 ECU_ADDRESS 0x01008758 /end MEASUREMENT
/begin COMPU_METHOD Compu_AUX_PWM19_FB_raw " " RAT_FUNC "%.3" "volts" COEFFS 0 13104 0 0 0 1 /end COMPU_METHOD
/begin MEASUREMENT AUX_PWM20_FB_raw "AUX_PWM20_FB_raw" UWORD Compu_AUX_PWM20_FB_raw 0 0 0 5.00114468864469 ECU_ADDRESS 0x01008760 /end MEASUREMENT
/begin COMPU_METHOD Compu_AUX_PWM20_FB_raw " " RAT_FUNC "%.3" "volts" COEFFS 0 13104 0 0 0 1 /end COMPU_METHOD
/begin MEASUREMENT AUX_PWM21_FB_raw "AUX_PWM21_FB_raw" UWORD Compu_AUX_PWM21_FB_raw 0 0 0 5.00114468864469 ECU_ADDRESS 0x01008768 /end MEASUREMENT
/begin COMPU_METHOD Compu_AUX_PWM21_FB_raw " " RAT_FUNC "%.3" "volts" COEFFS 0 13104 0 0 0 1 /end COMPU_METHOD
/begin MEASUREMENT AUX_PWM22_FB_raw "AUX_PWM22_FB_raw" UWORD Compu_AUX_PWM22_FB_raw 0 0 0 5.00114468864469 ECU_ADDRESS 0x01008770 /end MEASUREMENT
/begin COMPU_METHOD Compu_AUX_PWM22_FB_raw " " RAT_FUNC "%.3" "volts" COEFFS 0 13104 0 0 0 1 /end COMPU_METHOD
/begin MEASUREMENT AUX_PWM23_FB_raw "AUX_PWM23_FB_raw" UWORD Compu_AUX_PWM23_FB_raw 0 0 0 5.00114468864469 ECU_ADDRESS 0x01008778 /end MEASUREMENT
/begin COMPU_METHOD Compu_AUX_PWM23_FB_raw " " RAT_FUNC "%.3" "volts" COEFFS 0 13104 0 0 0 1 /end COMPU_METHOD
/begin MEASUREMENT PULSE_IN_raw "PULSE_IN_raw" UWORD Compu_PULSE_IN_raw 0 0 0 5.00114468864469 ECU_ADDRESS 0x01008780 /end MEASUREMENT
/begin COMPU_METHOD Compu_PULSE_IN_raw " " RAT_FUNC "%.3" "volts" COEFFS 0 13104 0 0 0 1 /end COMPU_METHOD
/begin MEASUREMENT BUZZ_FB_raw "BUZZ_FB_raw" UWORD Compu_BUZZ_FB_raw 0 0 0 5.00114468864469 ECU_ADDRESS 0x01008788 /end MEASUREMENT
/begin COMPU_METHOD Compu_BUZZ_FB_raw " " RAT_FUNC "%.3" "volts" COEFFS 0 13104 0 0 0 1 /end COMPU_METHOD
/begin MEASUREMENT DBW_iFB_raw "DBW_iFB_raw" UWORD Compu_DBW_iFB_raw 0 0 0 5.00114468864469 ECU_ADDRESS 0x01008790 /end MEASUREMENT
/begin COMPU_METHOD Compu_DBW_iFB_raw " " RAT_FUNC "%.3" "volts" COEFFS 0 13104 0 0 0 1 /end COMPU_METHOD
/begin MEASUREMENT HBA_iFB_raw "HBA_iFB_raw" UWORD Compu_HBA_iFB_raw 0 0 0 5.00114468864469 ECU_ADDRESS 0x01008798 /end MEASUREMENT
/begin COMPU_METHOD Compu_HBA_iFB_raw " " RAT_FUNC "%.3" "volts" COEFFS 0 13104 0 0 0 1 /end COMPU_METHOD
/begin MEASUREMENT HBB_iFB_raw "HBB_iFB_raw" UWORD Compu_HBB_iFB_raw 0 0 0 5.00114468864469 ECU_ADDRESS 0x010087A0 /end MEASUREMENT
/begin COMPU_METHOD Compu_HBB_iFB_raw " " RAT_FUNC "%.3" "volts" COEFFS 0 13104 0 0 0 1 /end COMPU_METHOD
/begin MEASUREMENT CAM2_ana_raw "CAM2_ana_raw" UWORD Compu_CAM2_ana_raw 0 0 0 5.00114468864469 ECU_ADDRESS 0x010087A8 /end MEASUREMENT
/begin COMPU_METHOD Compu_CAM2_ana_raw " " RAT_FUNC "%.3" "volts" COEFFS 0 13104 0 0 0 1 /end COMPU_METHOD
/begin MEASUREMENT SPKI_samp_raw "SPKI_samp_raw" UWORD Compu_SPKI_samp_raw 0 0 0 5.00114468864469 ECU_ADDRESS 0x010089C0 /end MEASUREMENT
/begin COMPU_METHOD Compu_SPKI_samp_raw " " RAT_FUNC "%.3" "volts" COEFFS 0 13104 0 0 0 1 /end COMPU_METHOD
/begin MEASUREMENT CRI1_boost_raw "CRI1_boost_raw" UWORD Compu_CRI1_boost_raw 0 0 0 5.00114468864469 ECU_ADDRESS 0x0100B678 /end MEASUREMENT
/begin COMPU_METHOD Compu_CRI1_boost_raw " " RAT_FUNC "%.3" "volts" COEFFS 0 13104 0 0 0 1 /end COMPU_METHOD
/begin MEASUREMENT CRI1_LS_i_raw "CRI1_LS_i_raw" UWORD Compu_CRI1_LS_i_raw 0 0 0 5.00114468864469 ECU_ADDRESS 0x0100B680 /end MEASUREMENT
/begin COMPU_METHOD Compu_CRI1_LS_i_raw " " RAT_FUNC "%.3" "volts" COEFFS 0 13104 0 0 0 1 /end COMPU_METHOD
/begin MEASUREMENT CRI2_boost_raw "CRI2_boost_raw" UWORD Compu_CRI2_boost_raw 0 0 0 5.00114468864469 ECU_ADDRESS 0x0100B688 /end MEASUREMENT
/begin COMPU_METHOD Compu_CRI2_boost_raw " " RAT_FUNC "%.3" "volts" COEFFS 0 13104 0 0 0 1 /end COMPU_METHOD
/begin MEASUREMENT CRI2_LS_i_raw "CRI2_LS_i_raw" UWORD Compu_CRI2_LS_i_raw 0 0 0 5.00114468864469 ECU_ADDRESS 0x0100B690 /end MEASUREMENT
/begin COMPU_METHOD Compu_CRI2_LS_i_raw " " RAT_FUNC "%.3" "volts" COEFFS 0 13104 0 0 0 1 /end COMPU_METHOD
/begin MEASUREMENT ref_4096V_raw "ref_4096V_raw" UWORD Compu_ref_4096V_raw 0 0 0 5.00114468864469 ECU_ADDRESS 0x0100B8B0 /end MEASUREMENT
/begin COMPU_METHOD Compu_ref_4096V_raw " " RAT_FUNC "%.3" "volts" COEFFS 0 13104 0 0 0 1 /end COMPU_METHOD
/begin MEASUREMENT RS_freq_raw "Unfiltered roadspeed pulse input frequency" FLOAT32_IEEE Compu_RS_freq_raw 0 0 -10000000000 10000000000 ECU_ADDRESS 0x0100B988 /end MEASUREMENT
/begin COMPU_METHOD Compu_RS_freq_raw " " RAT_FUNC "%.3" "Hz" COEFFS 0 1 0 0 0 1 /end COMPU_METHOD
/begin CHARACTERISTIC C2ASpd_ena "Cam2 Aux Speed input function{C2ASpd_ena&0xff=0:Disabled}{C2ASpd_ena&0xff=1:Enabled}" VALUE 0x001c868f /* @ECU_Address@C2ASpd_ena@0x0100BC18@ */ ECIPP_ALIGNMENT_UBYTE 255 C2ASpd_ena_COMPU_VTAB 0 255 BIT_MASK 0xff /end CHARACTERISTIC
/begin COMPU_METHOD C2ASpd_ena_COMPU_VTAB "Verbal Table" TAB_VERB "%.0" "list" COMPU_TAB_REF C2ASpd_ena_COMPU_VTAB_REF /end COMPU_METHOD
/begin COMPU_VTAB C2ASpd_ena_COMPU_VTAB_REF "Verbal Table" TAB_VERB 2 0 "Disabled" 1 "Enabled" DEFAULT_VALUE "UNKNOWN" /end COMPU_VTAB
/begin CHARACTERISTIC C2ASpd_hist_avg_t "Cam2 Aux Speed averaging window" VALUE 0x001c6da8 /* @ECU_Address@C2ASpd_hist_avg_t@0x0100BC20@ */ ECIPP_ALIGNMENT_UWORD 65535 Compu_C2ASpd_hist_avg_t 0 65535 /end CHARACTERISTIC
/begin COMPU_METHOD Compu_C2ASpd_hist_avg_t " " RAT_FUNC "%.0" "ms" COEFFS 0 1 0 0 0 1 /end COMPU_METHOD
/begin CHARACTERISTIC C2ASpd_hist_tout "Cam2 Aux Speed zeroing time" VALUE 0x001c6daa /* @ECU_Address@C2ASpd_hist_tout@0x0100BC28@ */ ECIPP_ALIGNMENT_UWORD 65535 Compu_C2ASpd_hist_tout 0 65535 /end CHARACTERISTIC
/begin COMPU_METHOD Compu_C2ASpd_hist_tout " " RAT_FUNC "%.0" "ms" COEFFS 0 1 0 0 0 1 /end COMPU_METHOD
/begin MEASUREMENT C2ASpd_freq_raw "Cam2 Aux Speed pulse input frequency" FLOAT32_IEEE Compu_C2ASpd_freq_raw 0 0 -10000000000 10000000000 ECU_ADDRESS 0x0100BC30 /end MEASUREMENT
/begin COMPU_METHOD Compu_C2ASpd_freq_raw " " RAT_FUNC "%.3" "Hz" COEFFS 0 1 0 0 0 1 /end COMPU_METHOD
/begin MEASUREMENT VE6_FB_raw "VE6_FB_raw" UWORD Compu_VE6_FB_raw 0 0 0 5.00114468864469 ECU_ADDRESS 0x0100C270 /end MEASUREMENT
/begin COMPU_METHOD Compu_VE6_FB_raw " " RAT_FUNC "%.3" "volts" COEFFS 0 13104 0 0 0 1 /end COMPU_METHOD
/begin MEASUREMENT UEGO_Vcc_raw "UEGO_Vcc_raw" UWORD Compu_UEGO_Vcc_raw 0 0 0 5.00114468864469 ECU_ADDRESS 0x0100C278 /end MEASUREMENT
/begin COMPU_METHOD Compu_UEGO_Vcc_raw " " RAT_FUNC "%.3" "volts" COEFFS 0 13104 0 0 0 1 /end COMPU_METHOD
/begin CHARACTERISTIC RS_Iacc_init "Initial Integrator" VALUE 0x001c4584 /* @ECU_Address@RS_Iacc_init@0x0100C340@ */ ECIPP_ALIGNMENT_SWORD 800 Compu_RS_Iacc_init -800 799.9755859375 /end CHARACTERISTIC
/begin COMPU_METHOD Compu_RS_Iacc_init " " RAT_FUNC "%.1" "% load/RPM" COEFFS 0 40.96 0 0 0 1 /end COMPU_METHOD
/begin CHARACTERISTIC RSC_enable_cfg "Cruise enable Aux DIG config{RSC_enable_cfg&0xff=0:Default}{RSC_enable_cfg&0xff=1:GND}{RSC_enable_cfg&0xff=2:GND/+V}{RSC_enable_cfg&0xff=3:+V}{RSC_enable_cfg&0xff=4:Open}" VALUE 0x001c88cc /* @ECU_Address@RSC_enable_cfg@0x0100C7B8@ */ ECIPP_ALIGNMENT_UBYTE 255 RSC_enable_cfg_COMPU_VTAB 0 255 BIT_MASK 0xff /end CHARACTERISTIC
/begin COMPU_METHOD RSC_enable_cfg_COMPU_VTAB "Verbal Table" TAB_VERB "%.0" "list" COMPU_TAB_REF RSC_enable_cfg_COMPU_VTAB_REF /end COMPU_METHOD
/begin COMPU_VTAB RSC_enable_cfg_COMPU_VTAB_REF "Verbal Table" TAB_VERB 5 0 "Default" 1 "GND" 2 "GND/+V" 3 "+V" 4 "Open" DEFAULT_VALUE "UNKNOWN" /end COMPU_VTAB
/begin CHARACTERISTIC RSC_setinc_cfg "Cruise set/inc input Aux DIG config{RSC_setinc_cfg&0xff=0:Default}{RSC_setinc_cfg&0xff=1:GND}{RSC_setinc_cfg&0xff=2:GND/+V}{RSC_setinc_cfg&0xff=3:+V}{RSC_setinc_cfg&0xff=4:Open}" VALUE 0x001c88d5 /* @ECU_Address@RSC_setinc_cfg@0x0100C7C0@ */ ECIPP_ALIGNMENT_UBYTE 255 RSC_setinc_cfg_COMPU_VTAB 0 255 BIT_MASK 0xff /end CHARACTERISTIC
/begin COMPU_METHOD RSC_setinc_cfg_COMPU_VTAB "Verbal Table" TAB_VERB "%.0" "list" COMPU_TAB_REF RSC_setinc_cfg_COMPU_VTAB_REF /end COMPU_METHOD
/begin COMPU_VTAB RSC_setinc_cfg_COMPU_VTAB_REF "Verbal Table" TAB_VERB 5 0 "Default" 1 "GND" 2 "GND/+V" 3 "+V" 4 "Open" DEFAULT_VALUE "UNKNOWN" /end COMPU_VTAB
/begin CHARACTERISTIC RSC_setdec_cfg "Cruise set/dec input Aux DIG config{RSC_setdec_cfg&0xff=0:Default}{RSC_setdec_cfg&0xff=1:GND}{RSC_setdec_cfg&0xff=2:GND/+V}{RSC_setdec_cfg&0xff=3:+V}{RSC_setdec_cfg&0xff=4:Open}" VALUE 0x001c88d3 /* @ECU_Address@RSC_setdec_cfg@0x0100C7C8@ */ ECIPP_ALIGNMENT_UBYTE 255 RSC_setdec_cfg_COMPU_VTAB 0 255 BIT_MASK 0xff /end CHARACTERISTIC
/begin COMPU_METHOD RSC_setdec_cfg_COMPU_VTAB "Verbal Table" TAB_VERB "%.0" "list" COMPU_TAB_REF RSC_setdec_cfg_COMPU_VTAB_REF /end COMPU_METHOD
/begin COMPU_VTAB RSC_setdec_cfg_COMPU_VTAB_REF "Verbal Table" TAB_VERB 5 0 "Default" 1 "GND" 2 "GND/+V" 3 "+V" 4 "Open" DEFAULT_VALUE "UNKNOWN" /end COMPU_VTAB
/begin CHARACTERISTIC RSC_resume_cfg "Cruise resume input Aux DIG config{RSC_resume_cfg&0xff=0:Default}{RSC_resume_cfg&0xff=1:GND}{RSC_resume_cfg&0xff=2:GND/+V}{RSC_resume_cfg&0xff=3:+V}{RSC_resume_cfg&0xff=4:Open}" VALUE 0x001c88d0 /* @ECU_Address@RSC_resume_cfg@0x0100C7D0@ */ ECIPP_ALIGNMENT_UBYTE 255 RSC_resume_cfg_COMPU_VTAB 0 255 BIT_MASK 0xff /end CHARACTERISTIC
/begin COMPU_METHOD RSC_resume_cfg_COMPU_VTAB "Verbal Table" TAB_VERB "%.0" "list" COMPU_TAB_REF RSC_resume_cfg_COMPU_VTAB_REF /end COMPU_METHOD
/begin COMPU_VTAB RSC_resume_cfg_COMPU_VTAB_REF "Verbal Table" TAB_VERB 5 0 "Default" 1 "GND" 2 "GND/+V" 3 "+V" 4 "Open" DEFAULT_VALUE "UNKNOWN" /end COMPU_VTAB
/begin CHARACTERISTIC MEFI_RS_source_ena "MEFI command packet roadspeed source selection{MEFI_RS_source_ena&0xff=0:Disabled}{MEFI_RS_source_ena&0xff=1:Enabled}" VALUE 0x001c881f /* @ECU_Address@MEFI_RS_source_ena@0x0100D0D0@ */ ECIPP_ALIGNMENT_UBYTE 255 MEFI_RS_source_ena_COMPU_VTAB 0 255 BIT_MASK 0xff /end CHARACTERISTIC
/begin COMPU_METHOD MEFI_RS_source_ena_COMPU_VTAB "Verbal Table" TAB_VERB "%.0" "list" COMPU_TAB_REF MEFI_RS_source_ena_COMPU_VTAB_REF /end COMPU_METHOD
/begin COMPU_VTAB MEFI_RS_source_ena_COMPU_VTAB_REF "Verbal Table" TAB_VERB 2 0 "Disabled" 1 "Enabled" DEFAULT_VALUE "UNKNOWN" /end COMPU_VTAB
/begin MEASUREMENT MEFI_RS_source_req "MEFI command packet roadspeed source request{MEFI_RS_source_req&0xff=0:N/A - Default}{MEFI_RS_source_req&0xff=1:Paddlewheel / Pulse Input}{MEFI_RS_source_req&0xff=2:ZeroOff GPS}{MEFI_RS_source_req&0xff=3:Generic J1939 GPS}" UBYTE MEFI_RS_source_req_COMPU_VTAB 0 0 0 255 ECU_ADDRESS 0x0100D0D8 BIT_MASK 0xff /end MEASUREMENT
/begin COMPU_METHOD MEFI_RS_source_req_COMPU_VTAB "Verbal Table" TAB_VERB "%.0" "list" COMPU_TAB_REF MEFI_RS_source_req_COMPU_VTAB_REF /end COMPU_METHOD
/begin COMPU_VTAB MEFI_RS_source_req_COMPU_VTAB_REF "Verbal Table" TAB_VERB 4 0 "N/A - Default" 1 "Paddlewheel / Pulse Input" 2 "ZeroOff GPS" 3 "Generic J1939 GPS" DEFAULT_VALUE "UNKNOWN" /end COMPU_VTAB
/begin MEASUREMENT AUX_DIG23_raw "AUX_DIG23_raw" UWORD Compu_AUX_DIG23_raw 0 0 0 5.00114468864469 ECU_ADDRESS 0x0100D1F8 /end MEASUREMENT
/begin COMPU_METHOD Compu_AUX_DIG23_raw " " RAT_FUNC "%.3" "volts" COEFFS 0 13104 0 0 0 1 /end COMPU_METHOD
/begin MEASUREMENT AUX_DIG23_volt "AUX_DIG23_volt" UWORD Compu_AUX_DIG23_volt 0 0 0 255.99609375 ECU_ADDRESS 0x0100D200 /end MEASUREMENT
/begin COMPU_METHOD Compu_AUX_DIG23_volt " " RAT_FUNC "%.2" "volts" COEFFS 0 256 0 0 0 1 /end COMPU_METHOD
/begin MEASUREMENT AUX_DIG24_raw "AUX_DIG24_raw" UWORD Compu_AUX_DIG24_raw 0 0 0 5.00114468864469 ECU_ADDRESS 0x0100D210 /end MEASUREMENT
/begin COMPU_METHOD Compu_AUX_DIG24_raw " " RAT_FUNC "%.3" "volts" COEFFS 0 13104 0 0 0 1 /end COMPU_METHOD
/begin MEASUREMENT AUX_DIG24_volt "AUX_DIG24_volt" UWORD Compu_AUX_DIG24_volt 0 0 0 255.99609375 ECU_ADDRESS 0x0100D218 /end MEASUREMENT
/begin COMPU_METHOD Compu_AUX_DIG24_volt " " RAT_FUNC "%.2" "volts" COEFFS 0 256 0 0 0 1 /end COMPU_METHOD
/begin MEASUREMENT AUX_DIG25_raw "AUX_DIG25_raw" UWORD Compu_AUX_DIG25_raw 0 0 0 5.00114468864469 ECU_ADDRESS 0x0100D228 /end MEASUREMENT
/begin COMPU_METHOD Compu_AUX_DIG25_raw " " RAT_FUNC "%.3" "volts" COEFFS 0 13104 0 0 0 1 /end COMPU_METHOD
/begin MEASUREMENT AUX_DIG25_volt "AUX_DIG25_volt" UWORD Compu_AUX_DIG25_volt 0 0 0 255.99609375 ECU_ADDRESS 0x0100D230 /end MEASUREMENT
/begin COMPU_METHOD Compu_AUX_DIG25_volt " " RAT_FUNC "%.2" "volts" COEFFS 0 256 0 0 0 1 /end COMPU_METHOD
/begin CHARACTERISTIC RSC_disable_chan "Cruise disable input{RSC_disable_chan&0xff=0:Disabled}{RSC_disable_chan&0xff=1:Aux PU1 = Gnd}{RSC_disable_chan&0xff=2:Aux PU2 = Gnd}{RSC_disable_chan&0xff=3:Aux PU3 = Gnd}{RSC_disable_chan&0xff=4:Aux PUD1 = Gnd}{RSC_disable_chan&0xff=5:Aux PUD2 = Gnd}{RSC" VALUE 0x001c88cb /* @ECU_Address@RSC_disable_chan@0x0100D788@ */ ECIPP_ALIGNMENT_UBYTE 255 RSC_disable_chan_COMPU_VTAB 0 255 BIT_MASK 0xff /end CHARACTERISTIC
/begin COMPU_METHOD RSC_disable_chan_COMPU_VTAB "Verbal Table" TAB_VERB "%.0" "list" COMPU_TAB_REF RSC_disable_chan_COMPU_VTAB_REF /end COMPU_METHOD
/begin COMPU_VTAB RSC_disable_chan_COMPU_VTAB_REF "Verbal Table" TAB_VERB 30 0 "Disabled" 1 "Aux PU1 = Gnd" 2 "Aux PU2 = Gnd" 3 "Aux PU3 = Gnd" 4 "Aux PUD1 = Gnd" 5 "Aux PUD2 = Gnd" 6 "Aux PUD3 = Gnd" 7 "Aux PUD4 = +V" 8 "Aux PUD5 = Gnd" 9 "Aux DIG1" 10 "Aux DIG2" 11 "Aux DIG3" 12 "Aux DIG4" 13 "Aux DIG5" 14 "Aux DIG6" 15 "Aux DIG7" 16 "Aux DIG8" 17 "Aux DIG9" 18 "Aux DIG10" 19 "Aux DIG11" 20 "Aux DIG12" 21 "Aux DIG13" 22 "Aux DIG14" 23 "Aux DIG15" 24 "Aux DIG16" 25 "Aux DIG17" 26 "Aux DIG18" 27 "Aux DIG19" 28 "Gov1" 29 "Gov2" DEFAULT_VALUE "UNKNOWN" /end COMPU_VTAB
/begin CHARACTERISTIC RSC_disable_cfg "Cruise disable Aux DIG config{RSC_disable_cfg&0xff=0:Default}{RSC_disable_cfg&0xff=1:GND}{RSC_disable_cfg&0xff=2:GND/+V}{RSC_disable_cfg&0xff=3:+V}{RSC_disable_cfg&0xff=4:Open}" VALUE 0x001c88ca /* @ECU_Address@RSC_disable_cfg@0x0100D790@ */ ECIPP_ALIGNMENT_UBYTE 255 RSC_disable_cfg_COMPU_VTAB 0 255 BIT_MASK 0xff /end CHARACTERISTIC
/begin COMPU_METHOD RSC_disable_cfg_COMPU_VTAB "Verbal Table" TAB_VERB "%.0" "list" COMPU_TAB_REF RSC_disable_cfg_COMPU_VTAB_REF /end COMPU_METHOD
/begin COMPU_VTAB RSC_disable_cfg_COMPU_VTAB_REF "Verbal Table" TAB_VERB 5 0 "Default" 1 "GND" 2 "GND/+V" 3 "+V" 4 "Open" DEFAULT_VALUE "UNKNOWN" /end COMPU_VTAB
/begin CHARACTERISTIC RS_speed_Llim "Roadspeed network setpoint lower-limit" VALUE 0x001c7efc /* @ECU_Address@RS_speed_Llim@0x0100DD78@ */ ECIPP_ALIGNMENT_UWORD 256 Compu_RS_speed_Llim 0 255.99609375 /end CHARACTERISTIC
/begin COMPU_METHOD Compu_RS_speed_Llim " " RAT_FUNC "%.1" "km/hr" COEFFS 0 256 0 0 0 1 /end COMPU_METHOD
/begin CHARACTERISTIC RS_speed_Ulim "Roadspeed network setpoint upper-limit" VALUE 0x001c7efe /* @ECU_Address@RS_speed_Ulim@0x0100DD80@ */ ECIPP_ALIGNMENT_UWORD 256 Compu_RS_speed_Ulim 0 255.99609375 /end CHARACTERISTIC
/begin COMPU_METHOD Compu_RS_speed_Ulim " " RAT_FUNC "%.1" "km/hr" COEFFS 0 256 0 0 0 1 /end COMPU_METHOD
/begin CHARACTERISTIC RS_ppkm_Ulim "Roadspeed pulse cal upper-limit" VALUE 0x001c7eec /* @ECU_Address@RS_ppkm_Ulim@0x0100DD88@ */ ECIPP_ALIGNMENT_UWORD 1048560 Compu_RS_ppkm_Ulim 0 1048560 /end CHARACTERISTIC
/begin COMPU_METHOD Compu_RS_ppkm_Ulim " " RAT_FUNC "%.1" "pulses/km" COEFFS 0 0.0625 0 0 0 1 /end COMPU_METHOD
/begin CHARACTERISTIC RS_loV "Roadspeed internal 0-5V low voltage (Fault Condition:No pulse activity and internal 0-5V input <)" VALUE 0x001c7ee2 /* @ECU_Address@RS_loV@0x0100DD90@ */ ECIPP_ALIGNMENT_UWORD 5 Compu_RS_loV 0 5.00114468864469 /end CHARACTERISTIC
/begin COMPU_METHOD Compu_RS_loV " " RAT_FUNC "%.3" "volts" COEFFS 0 13104 0 0 0 1 /end COMPU_METHOD
/begin CHARACTERISTIC RS_hiV "Roadspeed internal 0-5V high voltage (Fault Condition:No pulse activity and internal 0-5V input >)" VALUE 0x001c7edc /* @ECU_Address@RS_hiV@0x0100DD98@ */ ECIPP_ALIGNMENT_UWORD 5 Compu_RS_hiV 0 5.00114468864469 /end CHARACTERISTIC
/begin COMPU_METHOD Compu_RS_hiV " " RAT_FUNC "%.3" "volts" COEFFS 0 13104 0 0 0 1 /end COMPU_METHOD
/begin MEASUREMENT RMT_RS_pulses_per_km "Roadspeed network pulse calibration" UWORD Compu_RMT_RS_pulses_per_km 0 0 0 1048560 ECU_ADDRESS 0x0100DDA8 /end MEASUREMENT
/begin COMPU_METHOD Compu_RMT_RS_pulses_per_km " " RAT_FUNC "%.1" "pulses/km" COEFFS 0 0.0625 0 0 0 1 /end COMPU_METHOD
/begin MEASUREMENT RMT_RS_speed_1 "Roadspeed network speed target 1" UWORD Compu_RMT_RS_speed_1 0 0 0 255.99609375 ECU_ADDRESS 0x0100DDB0 /end MEASUREMENT
/begin COMPU_METHOD Compu_RMT_RS_speed_1 " " RAT_FUNC "%.1" "km/hr" COEFFS 0 256 0 0 0 1 /end COMPU_METHOD
/begin MEASUREMENT RMT_RS_speed_2 "Roadspeed network speed target 2" UWORD Compu_RMT_RS_speed_2 0 0 0 255.99609375 ECU_ADDRESS 0x0100DDB8 /end MEASUREMENT
/begin COMPU_METHOD Compu_RMT_RS_speed_2 " " RAT_FUNC "%.1" "km/hr" COEFFS 0 256 0 0 0 1 /end COMPU_METHOD
/begin MEASUREMENT RMT_RS_mode "Roadspeed network target mode{RMT_RS_mode&0xff=255:Not Available}{RMT_RS_mode&0xff=0:Gov Select Target}{RMT_RS_mode&0xff=1:Remote Target 1}{RMT_RS_mode&0xff=2:Remote Target 2}" UBYTE RMT_RS_mode_COMPU_VTAB 0 0 0 255 ECU_ADDRESS 0x0100DDC0 BIT_MASK 0xff /end MEASUREMENT
/begin COMPU_METHOD RMT_RS_mode_COMPU_VTAB "Verbal Table" TAB_VERB "%.0" "list" COMPU_TAB_REF RMT_RS_mode_COMPU_VTAB_REF /end COMPU_METHOD
/begin COMPU_VTAB RMT_RS_mode_COMPU_VTAB_REF "Verbal Table" TAB_VERB 4 255 "Not Available" 0 "Gov Select Target" 1 "Remote Target 1" 2 "Remote Target 2" DEFAULT_VALUE "UNKNOWN" /end COMPU_VTAB
/begin CHARACTERISTIC RSC_disable_by_RBC "Cruise disabled by retarder braking{RSC_disable_by_RBC&0xff=0:No}{RSC_disable_by_RBC&0xff=1:Yes}" VALUE 0x001c88c9 /* @ECU_Address@RSC_disable_by_RBC@0x0100E5A8@ */ ECIPP_ALIGNMENT_UBYTE 255 RSC_disable_by_RBC_COMPU_VTAB 0 255 BIT_MASK 0xff /end CHARACTERISTIC
/begin COMPU_METHOD RSC_disable_by_RBC_COMPU_VTAB "Verbal Table" TAB_VERB "%.0" "list" COMPU_TAB_REF RSC_disable_by_RBC_COMPU_VTAB_REF /end COMPU_METHOD
/begin COMPU_VTAB RSC_disable_by_RBC_COMPU_VTAB_REF "Verbal Table" TAB_VERB 2 0 "No" 1 "Yes" DEFAULT_VALUE "UNKNOWN" /end COMPU_VTAB
/begin MEASUREMENT RS_dir "Roadspeed direction{RS_dir&0xff=0:Not Available}{RS_dir&0xff=1:Error}{RS_dir&0xff=2:Stopped}{RS_dir&0xff=3:Waiting}{RS_dir&0xff=4:Fwd or Reverse}{RS_dir&0xff=5:Forward}{RS_dir&0xff=6:Reverse}" UBYTE RS_dir_COMPU_VTAB 0 0 0 255 ECU_ADDRESS 0x0100F218 BIT_MASK 0xff /end MEASUREMENT
/begin COMPU_METHOD RS_dir_COMPU_VTAB "Verbal Table" TAB_VERB "%.0" "list" COMPU_TAB_REF RS_dir_COMPU_VTAB_REF /end COMPU_METHOD
/begin COMPU_VTAB RS_dir_COMPU_VTAB_REF "Verbal Table" TAB_VERB 7 0 "Not Available" 1 "Error" 2 "Stopped" 3 "Waiting" 4 "Fwd or Reverse" 5 "Forward" 6 "Reverse" DEFAULT_VALUE "UNKNOWN" /end COMPU_VTAB
/begin CHARACTERISTIC RS_pattern "Roadspeed pulse pattern{RS_pattern&0xff=0:Uniform Non-Directional}{RS_pattern&0xff=1:Directional 5+6+7}{RS_pattern&0xff=2:Directional 7+6+5}" VALUE 0x001c88e2 /* @ECU_Address@RS_pattern@0x0100F220@ */ ECIPP_ALIGNMENT_UBYTE 255 RS_pattern_COMPU_VTAB 0 255 BIT_MASK 0xff /end CHARACTERISTIC
/begin COMPU_METHOD RS_pattern_COMPU_VTAB "Verbal Table" TAB_VERB "%.0" "list" COMPU_TAB_REF RS_pattern_COMPU_VTAB_REF /end COMPU_METHOD
/begin COMPU_VTAB RS_pattern_COMPU_VTAB_REF "Verbal Table" TAB_VERB 3 0 "Uniform Non-Directional" 1 "Directional 5+6+7" 2 "Directional 7+6+5" DEFAULT_VALUE "UNKNOWN" /end COMPU_VTAB
/begin CHARACTERISTIC RS_disc_tmr "Sample rate (Fault Condition:No pulse activity at sample rate of:)" VALUE 0x001c42e4 /* @ECU_Address@RS_disc_tmr@0x0100FC10@ */ ECIPP_ALIGNMENT_ULONG 4294967 Compu_RS_disc_tmr 0 4294967.295 /end CHARACTERISTIC
/begin COMPU_METHOD Compu_RS_disc_tmr " " RAT_FUNC "%.3" "sec" COEFFS 0 1000 0 0 0 1 /end COMPU_METHOD
/begin CHARACTERISTIC RS_disc_thr "Offset (Fault Condition:AND input RS sensor offset voltage >)" VALUE 0x001c7eda /* @ECU_Address@RS_disc_thr@0x0100FC18@ */ ECIPP_ALIGNMENT_UWORD 5 Compu_RS_disc_thr 0 5.00114468864469 /end CHARACTERISTIC
/begin COMPU_METHOD Compu_RS_disc_thr " " RAT_FUNC "%.3" "volts" COEFFS 0 13104 0 0 0 1 /end COMPU_METHOD
/begin MEASUREMENT RS_disc_ana "RS_ana_raw during Mag test" UWORD Compu_RS_disc_ana 0 0 0 5.00114468864469 ECU_ADDRESS 0x0100FC20 /end MEASUREMENT
/begin COMPU_METHOD Compu_RS_disc_ana " " RAT_FUNC "%.3" "volts" COEFFS 0 13104 0 0 0 1 /end COMPU_METHOD
/begin MEASUREMENT RS_disc_calc "Threshold voltage" UWORD Compu_RS_disc_calc 0 0 0 5.00114468864469 ECU_ADDRESS 0x0100FC28 /end MEASUREMENT
/begin COMPU_METHOD Compu_RS_disc_calc " " RAT_FUNC "%.3" "volts" COEFFS 0 13104 0 0 0 1 /end COMPU_METHOD
/begin CHARACTERISTIC RS_disc_rpm "Engine speed < (Fault Condition:AND engine speed <)" VALUE 0x001c7ed8 /* @ECU_Address@RS_disc_rpm@0x0100FC30@ */ ECIPP_ALIGNMENT_UWORD 65535 Compu_RS_disc_rpm 0 65535 /end CHARACTERISTIC
/begin COMPU_METHOD Compu_RS_disc_rpm " " RAT_FUNC "%.0" "rpm" COEFFS 0 1 0 0 0 1 /end COMPU_METHOD
/begin CHARACTERISTIC RS_GPS_UA_tout "GPS unacquired control set switch" VALUE 0x001c7ed4 /* @ECU_Address@RS_GPS_UA_tout@0x0100FC50@ */ ECIPP_ALIGNMENT_UWORD 65535 Compu_RS_GPS_UA_tout 0 65535 /end CHARACTERISTIC
/begin COMPU_METHOD Compu_RS_GPS_UA_tout " " RAT_FUNC "%.0" "ms" COEFFS 0 1 0 0 0 1 /end COMPU_METHOD
/begin CHARACTERISTIC RS_disc_ena "Enable test{RS_disc_ena&0xff=0:Disabled}{RS_disc_ena&0xff=1:Always enabled}{RS_disc_ena&0xff=2:Active RS HW input}{RS_disc_ena&0xff=3:Active CAN setpoint} (Fault Condition:Roadspeed sensor disconnected testing:)" VALUE 0x001c88dc /* @ECU_Address@RS_disc_ena@0x0100FC88@ */ ECIPP_ALIGNMENT_UBYTE 255 RS_disc_ena_COMPU_VTAB 0 255 BIT_MASK 0xff /end CHARACTERISTIC
/begin COMPU_METHOD RS_disc_ena_COMPU_VTAB "Verbal Table" TAB_VERB "%.0" "list" COMPU_TAB_REF RS_disc_ena_COMPU_VTAB_REF /end COMPU_METHOD
/begin COMPU_VTAB RS_disc_ena_COMPU_VTAB_REF "Verbal Table" TAB_VERB 4 0 "Disabled" 1 "Always enabled" 2 "Active RS HW input" 3 "Active CAN setpoint" DEFAULT_VALUE "UNKNOWN" /end COMPU_VTAB
/begin CHARACTERISTIC RS_disc_Vbat "Vbat >= (Fault Condition:while battery voltage >)" VALUE 0x001c7ed6 /* @ECU_Address@RS_disc_Vbat@0x0100FC90@ */ ECIPP_ALIGNMENT_UWORD 256 Compu_RS_disc_Vbat 0 255.99609375 /end CHARACTERISTIC
/begin COMPU_METHOD Compu_RS_disc_Vbat " " RAT_FUNC "%.1" "volts" COEFFS 0 256 0 0 0 1 /end COMPU_METHOD
/begin MEASUREMENT AUX_PWM1_iFB_raw "AUX_PWM1_iFB_raw" UWORD Compu_AUX_PWM1_iFB_raw 0 0 0 5.00114468864469 ECU_ADDRESS 0x010100C8 /end MEASUREMENT
/begin COMPU_METHOD Compu_AUX_PWM1_iFB_raw " " RAT_FUNC "%.3" "volts" COEFFS 0 13104 0 0 0 1 /end COMPU_METHOD
/begin MEASUREMENT AUX_PWM2_iFB_raw "AUX_PWM2_iFB_raw" UWORD Compu_AUX_PWM2_iFB_raw 0 0 0 5.00114468864469 ECU_ADDRESS 0x010100D0 /end MEASUREMENT
/begin COMPU_METHOD Compu_AUX_PWM2_iFB_raw " " RAT_FUNC "%.3" "volts" COEFFS 0 13104 0 0 0 1 /end COMPU_METHOD
/begin MEASUREMENT AUX_PWM3_iFB_raw "AUX_PWM3_iFB_raw" UWORD Compu_AUX_PWM3_iFB_raw 0 0 0 5.00114468864469 ECU_ADDRESS 0x010100D8 /end MEASUREMENT
/begin COMPU_METHOD Compu_AUX_PWM3_iFB_raw " " RAT_FUNC "%.3" "volts" COEFFS 0 13104 0 0 0 1 /end COMPU_METHOD
/begin MEASUREMENT AUX_PWM4_iFB_raw "AUX_PWM4_iFB_raw" UWORD Compu_AUX_PWM4_iFB_raw 0 0 0 5.00114468864469 ECU_ADDRESS 0x010100E0 /end MEASUREMENT
/begin COMPU_METHOD Compu_AUX_PWM4_iFB_raw " " RAT_FUNC "%.3" "volts" COEFFS 0 13104 0 0 0 1 /end COMPU_METHOD
/begin MEASUREMENT AUX_PWM5_iFB_raw "AUX_PWM5_iFB_raw" UWORD Compu_AUX_PWM5_iFB_raw 0 0 0 5.00114468864469 ECU_ADDRESS 0x010100E8 /end MEASUREMENT
/begin COMPU_METHOD Compu_AUX_PWM5_iFB_raw " " RAT_FUNC "%.3" "volts" COEFFS 0 13104 0 0 0 1 /end COMPU_METHOD
/begin MEASUREMENT AUX_PWM6_iFB_raw "AUX_PWM6_iFB_raw" UWORD Compu_AUX_PWM6_iFB_raw 0 0 0 5.00114468864469 ECU_ADDRESS 0x010100F0 /end MEASUREMENT
/begin COMPU_METHOD Compu_AUX_PWM6_iFB_raw " " RAT_FUNC "%.3" "volts" COEFFS 0 13104 0 0 0 1 /end COMPU_METHOD
/begin MEASUREMENT AUX_PWM8_iFB_raw "AUX_PWM8_iFB_raw" UWORD Compu_AUX_PWM8_iFB_raw 0 0 0 5.00114468864469 ECU_ADDRESS 0x010100F8 /end MEASUREMENT
/begin COMPU_METHOD Compu_AUX_PWM8_iFB_raw " " RAT_FUNC "%.3" "volts" COEFFS 0 13104 0 0 0 1 /end COMPU_METHOD
/begin MEASUREMENT AUX_PWM9_iFB_raw "AUX_PWM9_iFB_raw" UWORD Compu_AUX_PWM9_iFB_raw 0 0 0 5.00114468864469 ECU_ADDRESS 0x01010100 /end MEASUREMENT
/begin COMPU_METHOD Compu_AUX_PWM9_iFB_raw " " RAT_FUNC "%.3" "volts" COEFFS 0 13104 0 0 0 1 /end COMPU_METHOD
/begin MEASUREMENT FPP_allspeed_rpm "FPP allspeed rpm" UWORD Compu_FPP_allspeed_rpm 0 0 0 65535 ECU_ADDRESS 0x01010108 /end MEASUREMENT
/begin COMPU_METHOD Compu_FPP_allspeed_rpm " " RAT_FUNC "%.0" "rpm" COEFFS 0 1 0 0 0 1 /end COMPU_METHOD
/begin MEASUREMENT allspeed_rpm "Final allspeed rpm" UWORD Compu_allspeed_rpm 0 0 0 65535 ECU_ADDRESS 0x01010110 /end MEASUREMENT
/begin COMPU_METHOD Compu_allspeed_rpm " " RAT_FUNC "%.0" "rpm" COEFFS 0 1 0 0 0 1 /end COMPU_METHOD
/begin MEASUREMENT RS_max_allspeed_rpm "Roadspeed max allspeed rpm" UWORD Compu_RS_max_allspeed_rpm 0 0 0 65535 ECU_ADDRESS 0x01010118 /end MEASUREMENT
/begin COMPU_METHOD Compu_RS_max_allspeed_rpm " " RAT_FUNC "%.0" "rpm" COEFFS 0 1 0 0 0 1 /end COMPU_METHOD
/begin CHARACTERISTIC RS_max_allspeed_ena "Roadspeed RPM-based all-speed limit{RS_max_allspeed_ena&0xff=0:Disabled}{RS_max_allspeed_ena&0xff=1:Enabled}" VALUE 0x001c88e1 /* @ECU_Address@RS_max_allspeed_ena@0x01010120@ */ ECIPP_ALIGNMENT_UBYTE 255 RS_max_allspeed_ena_COMPU_VTAB 0 255 BIT_MASK 0xff /end CHARACTERISTIC
/begin COMPU_METHOD RS_max_allspeed_ena_COMPU_VTAB "Verbal Table" TAB_VERB "%.0" "list" COMPU_TAB_REF RS_max_allspeed_ena_COMPU_VTAB_REF /end COMPU_METHOD
/begin COMPU_VTAB RS_max_allspeed_ena_COMPU_VTAB_REF "Verbal Table" TAB_VERB 2 0 "Disabled" 1 "Enabled" DEFAULT_VALUE "UNKNOWN" /end COMPU_VTAB
/begin MEASUREMENT RS_max_allspeed_use "Roadspeed max allspeed rpm in-use{RS_max_allspeed_use&0xff=0:Inactive}{RS_max_allspeed_use&0xff=1:Active}" UBYTE RS_max_allspeed_use_COMPU_VTAB 0 0 0 255 ECU_ADDRESS 0x01010128 BIT_MASK 0xff /end MEASUREMENT
/begin COMPU_METHOD RS_max_allspeed_use_COMPU_VTAB "Verbal Table" TAB_VERB "%.0" "list" COMPU_TAB_REF RS_max_allspeed_use_COMPU_VTAB_REF /end COMPU_METHOD
/begin COMPU_VTAB RS_max_allspeed_use_COMPU_VTAB_REF "Verbal Table" TAB_VERB 2 0 "Inactive" 1 "Active" DEFAULT_VALUE "UNKNOWN" /end COMPU_VTAB
/begin MEASUREMENT AUX_PWM7_iFB_raw "AUX_PWM7_iFB_raw" UWORD Compu_AUX_PWM7_iFB_raw 0 0 0 5.00114468864469 ECU_ADDRESS 0x01010170 /end MEASUREMENT
/begin COMPU_METHOD Compu_AUX_PWM7_iFB_raw " " RAT_FUNC "%.3" "volts" COEFFS 0 13104 0 0 0 1 /end COMPU_METHOD
/begin MEASUREMENT AUX_PWM10_iFB_raw "AUX_PWM10_iFB_raw" UWORD Compu_AUX_PWM10_iFB_raw 0 0 0 5.00114468864469 ECU_ADDRESS 0x01010178 /end MEASUREMENT
/begin COMPU_METHOD Compu_AUX_PWM10_iFB_raw " " RAT_FUNC "%.3" "volts" COEFFS 0 13104 0 0 0 1 /end COMPU_METHOD
/begin MEASUREMENT AUX_PWM11_iFB_raw "AUX_PWM11_iFB_raw" UWORD Compu_AUX_PWM11_iFB_raw 0 0 0 5.00114468864469 ECU_ADDRESS 0x01010180 /end MEASUREMENT
/begin COMPU_METHOD Compu_AUX_PWM11_iFB_raw " " RAT_FUNC "%.3" "volts" COEFFS 0 13104 0 0 0 1 /end COMPU_METHOD
/begin MEASUREMENT AUX_PWM12_iFB_raw "AUX_PWM12_iFB_raw" UWORD Compu_AUX_PWM12_iFB_raw 0 0 0 5.00114468864469 ECU_ADDRESS 0x01010188 /end MEASUREMENT
/begin COMPU_METHOD Compu_AUX_PWM12_iFB_raw " " RAT_FUNC "%.3" "volts" COEFFS 0 13104 0 0 0 1 /end COMPU_METHOD
/begin MEASUREMENT AUX_PWM13_iFB_raw "AUX_PWM13_iFB_raw" UWORD Compu_AUX_PWM13_iFB_raw 0 0 0 5.00114468864469 ECU_ADDRESS 0x01010190 /end MEASUREMENT
/begin COMPU_METHOD Compu_AUX_PWM13_iFB_raw " " RAT_FUNC "%.3" "volts" COEFFS 0 13104 0 0 0 1 /end COMPU_METHOD
/begin MEASUREMENT AUX_PWM14_iFB_raw "AUX_PWM14_iFB_raw" UWORD Compu_AUX_PWM14_iFB_raw 0 0 0 5.00114468864469 ECU_ADDRESS 0x01010198 /end MEASUREMENT
/begin COMPU_METHOD Compu_AUX_PWM14_iFB_raw " " RAT_FUNC "%.3" "volts" COEFFS 0 13104 0 0 0 1 /end COMPU_METHOD
/begin MEASUREMENT AUX_PWM15_iFB_raw "AUX_PWM15_iFB_raw" UWORD Compu_AUX_PWM15_iFB_raw 0 0 0 5.00114468864469 ECU_ADDRESS 0x010101A0 /end MEASUREMENT
/begin COMPU_METHOD Compu_AUX_PWM15_iFB_raw " " RAT_FUNC "%.3" "volts" COEFFS 0 13104 0 0 0 1 /end COMPU_METHOD
/begin MEASUREMENT AUX_PWM16_iFB_raw "AUX_PWM16_iFB_raw" UWORD Compu_AUX_PWM16_iFB_raw 0 0 0 5.00114468864469 ECU_ADDRESS 0x010101A8 /end MEASUREMENT
/begin COMPU_METHOD Compu_AUX_PWM16_iFB_raw " " RAT_FUNC "%.3" "volts" COEFFS 0 13104 0 0 0 1 /end COMPU_METHOD
/begin MEASUREMENT AUX_PWM17_iFB_raw "AUX_PWM17_iFB_raw" UWORD Compu_AUX_PWM17_iFB_raw 0 0 0 5.00114468864469 ECU_ADDRESS 0x010101B0 /end MEASUREMENT
/begin COMPU_METHOD Compu_AUX_PWM17_iFB_raw " " RAT_FUNC "%.3" "volts" COEFFS 0 13104 0 0 0 1 /end COMPU_METHOD
/begin MEASUREMENT AUX_PWM18_iFB_raw "AUX_PWM18_iFB_raw" UWORD Compu_AUX_PWM18_iFB_raw 0 0 0 5.00114468864469 ECU_ADDRESS 0x010101B8 /end MEASUREMENT
/begin COMPU_METHOD Compu_AUX_PWM18_iFB_raw " " RAT_FUNC "%.3" "volts" COEFFS 0 13104 0 0 0 1 /end COMPU_METHOD
/begin MEASUREMENT AUX_PWM19_iFB_raw "AUX_PWM19_iFB_raw" UWORD Compu_AUX_PWM19_iFB_raw 0 0 0 5.00114468864469 ECU_ADDRESS 0x010101C0 /end MEASUREMENT
/begin COMPU_METHOD Compu_AUX_PWM19_iFB_raw " " RAT_FUNC "%.3" "volts" COEFFS 0 13104 0 0 0 1 /end COMPU_METHOD
/begin MEASUREMENT AUX_PWM20_iFB_raw "AUX_PWM20_iFB_raw" UWORD Compu_AUX_PWM20_iFB_raw 0 0 0 5.00114468864469 ECU_ADDRESS 0x010101C8 /end MEASUREMENT
/begin COMPU_METHOD Compu_AUX_PWM20_iFB_raw " " RAT_FUNC "%.3" "volts" COEFFS 0 13104 0 0 0 1 /end COMPU_METHOD
/begin MEASUREMENT AUX_PWM21_iFB_raw "AUX_PWM21_iFB_raw" UWORD Compu_AUX_PWM21_iFB_raw 0 0 0 5.00114468864469 ECU_ADDRESS 0x010101D0 /end MEASUREMENT
/begin COMPU_METHOD Compu_AUX_PWM21_iFB_raw " " RAT_FUNC "%.3" "volts" COEFFS 0 13104 0 0 0 1 /end COMPU_METHOD
/begin MEASUREMENT AUX_PWM22_iFB_raw "AUX_PWM22_iFB_raw" UWORD Compu_AUX_PWM22_iFB_raw 0 0 0 5.00114468864469 ECU_ADDRESS 0x010101D8 /end MEASUREMENT
/begin COMPU_METHOD Compu_AUX_PWM22_iFB_raw " " RAT_FUNC "%.3" "volts" COEFFS 0 13104 0 0 0 1 /end COMPU_METHOD
/begin MEASUREMENT AUX_PWM23_iFB_raw "AUX_PWM23_iFB_raw" UWORD Compu_AUX_PWM23_iFB_raw 0 0 0 5.00114468864469 ECU_ADDRESS 0x010101E0 /end MEASUREMENT
/begin COMPU_METHOD Compu_AUX_PWM23_iFB_raw " " RAT_FUNC "%.3" "volts" COEFFS 0 13104 0 0 0 1 /end COMPU_METHOD
/begin MEASUREMENT VE5a "Primary 5V external" UWORD Compu_VE5a 0 0 0 255.99609375 ECU_ADDRESS 0x01010318 /end MEASUREMENT
/begin COMPU_METHOD Compu_VE5a " " RAT_FUNC "%.1" "volts" COEFFS 0 256 0 0 0 1 /end COMPU_METHOD
/begin MEASUREMENT VE5b "Secondary 5V external" UWORD Compu_VE5b 0 0 0 255.99609375 ECU_ADDRESS 0x01010320 /end MEASUREMENT
/begin COMPU_METHOD Compu_VE5b " " RAT_FUNC "%.1" "volts" COEFFS 0 256 0 0 0 1 /end COMPU_METHOD
/begin MEASUREMENT VE5c "Tertiary 5V external" UWORD Compu_VE5c 0 0 0 255.99609375 ECU_ADDRESS 0x01010328 /end MEASUREMENT
/begin COMPU_METHOD Compu_VE5c " " RAT_FUNC "%.1" "volts" COEFFS 0 256 0 0 0 1 /end COMPU_METHOD
/begin MEASUREMENT Vrelay "Vrelay" UWORD Compu_Vrelay 0 0 0 255.99609375 ECU_ADDRESS 0x01011C30 /end MEASUREMENT
/begin COMPU_METHOD Compu_Vrelay " " RAT_FUNC "%.1" "volts" COEFFS 0 256 0 0 0 1 /end COMPU_METHOD
/begin MEASUREMENT KNK3H_raw "KNK3H_raw" UWORD Compu_KNK3H_raw 0 0 0 5.00114468864469 ECU_ADDRESS 0x01011F90 /end MEASUREMENT
/begin COMPU_METHOD Compu_KNK3H_raw " " RAT_FUNC "%.3" "volts" COEFFS 0 13104 0 0 0 1 /end COMPU_METHOD
/begin MEASUREMENT KNK3L_raw "KNK3L_raw" UWORD Compu_KNK3L_raw 0 0 0 5.00114468864469 ECU_ADDRESS 0x01011F98 /end MEASUREMENT
/begin COMPU_METHOD Compu_KNK3L_raw " " RAT_FUNC "%.3" "volts" COEFFS 0 13104 0 0 0 1 /end COMPU_METHOD
/begin MEASUREMENT T_internal_raw "T_internal_raw" UWORD Compu_T_internal_raw 0 0 0 5.00114468864469 ECU_ADDRESS 0x01011FA8 /end MEASUREMENT
/begin COMPU_METHOD Compu_T_internal_raw " " RAT_FUNC "%.3" "volts" COEFFS 0 13104 0 0 0 1 /end COMPU_METHOD
/begin CHARACTERISTIC RS_TPS_bstld_crct "Roadspeed TPS control boost load adjustment{RS_TPS_bstld_crct&0xff=0:Disabled}{RS_TPS_bstld_crct&0xff=1:Enabled}" VALUE 0x001c88da /* @ECU_Address@RS_TPS_bstld_crct@0x010124E8@ */ ECIPP_ALIGNMENT_UBYTE 255 RS_TPS_bstld_crct_COMPU_VTAB 0 255 BIT_MASK 0xff /end CHARACTERISTIC
/begin COMPU_METHOD RS_TPS_bstld_crct_COMPU_VTAB "Verbal Table" TAB_VERB "%.0" "list" COMPU_TAB_REF RS_TPS_bstld_crct_COMPU_VTAB_REF /end COMPU_METHOD
/begin COMPU_VTAB RS_TPS_bstld_crct_COMPU_VTAB_REF "Verbal Table" TAB_VERB 2 0 "Disabled" 1 "Enabled" DEFAULT_VALUE "UNKNOWN" /end COMPU_VTAB
/begin CHARACTERISTIC RSC_disable_2inputs "Cruise disabled by simultaneous input{RSC_disable_2inputs&0xff=0:Disabled}{RSC_disable_2inputs&0xff=1:Enabled}" VALUE 0x001c88c8 /* @ECU_Address@RSC_disable_2inputs@0x01012530@ */ ECIPP_ALIGNMENT_UBYTE 255 RSC_disable_2inputs_COMPU_VTAB 0 255 BIT_MASK 0xff /end CHARACTERISTIC
/begin COMPU_METHOD RSC_disable_2inputs_COMPU_VTAB "Verbal Table" TAB_VERB "%.0" "list" COMPU_TAB_REF RSC_disable_2inputs_COMPU_VTAB_REF /end COMPU_METHOD
/begin COMPU_VTAB RSC_disable_2inputs_COMPU_VTAB_REF "Verbal Table" TAB_VERB 2 0 "Disabled" 1 "Enabled" DEFAULT_VALUE "UNKNOWN" /end COMPU_VTAB
/begin CHARACTERISTIC RSC_disable_rpm "Cruise disengage engine speed limit" VALUE 0x001c7eba /* @ECU_Address@RSC_disable_rpm@0x01012538@ */ ECIPP_ALIGNMENT_UWORD 65535 Compu_RSC_disable_rpm 0 65535 /end CHARACTERISTIC
/begin COMPU_METHOD Compu_RSC_disable_rpm " " RAT_FUNC "%.0" "rpm" COEFFS 0 1 0 0 0 1 /end COMPU_METHOD
/begin CHARACTERISTIC RSC_ramp_time_max "Cruise maximum ramp time" VALUE 0x001c7ec4 /* @ECU_Address@RSC_ramp_time_max@0x01012540@ */ ECIPP_ALIGNMENT_UWORD 66 Compu_RSC_ramp_time_max 0 65.535 /end CHARACTERISTIC
/begin COMPU_METHOD Compu_RSC_ramp_time_max " " RAT_FUNC "%.1" "sec" COEFFS 0 1000 0 0 0 1 /end COMPU_METHOD
/begin CHARACTERISTIC RSC_error_pct "Cruise persistent error limit" VALUE 0x001c7ebc /* @ECU_Address@RSC_error_pct@0x01012548@ */ ECIPP_ALIGNMENT_UWORD 100 Compu_RSC_error_pct 0 99.9984741210938 /end CHARACTERISTIC
/begin COMPU_METHOD Compu_RSC_error_pct " " RAT_FUNC "%.1" "%" COEFFS 0 655.36 0 0 0 1 /end COMPU_METHOD
/begin CHARACTERISTIC RSC_error_wait "Cruise persistent error disengage time" VALUE 0x001c42e0 /* @ECU_Address@RSC_error_wait@0x01012550@ */ ECIPP_ALIGNMENT_ULONG 4294967 Compu_RSC_error_wait 0 4294967.295 /end CHARACTERISTIC
/begin COMPU_METHOD Compu_RSC_error_wait " " RAT_FUNC "%.1" "sec" COEFFS 0 1000 0 0 0 1 /end COMPU_METHOD
/begin CHARACTERISTIC RS_setsrc_ntwk "Roadspeed limit network source{RS_setsrc_ntwk&0xff=0:PGN 65450}{RS_setsrc_ntwk&0xff=1:PGN 65261 CCSS}{RS_setsrc_ntwk&0xff=2:PGN 65473}{RS_setsrc_ntwk&0xff=3:PGN 62720 / 529 (11-bit)}" VALUE 0x001c88e6 /* @ECU_Address@RS_setsrc_ntwk@0x010126A8@ */ ECIPP_ALIGNMENT_UBYTE 255 RS_setsrc_ntwk_COMPU_VTAB 0 255 BIT_MASK 0xff /end CHARACTERISTIC
/begin COMPU_METHOD RS_setsrc_ntwk_COMPU_VTAB "Verbal Table" TAB_VERB "%.0" "list" COMPU_TAB_REF RS_setsrc_ntwk_COMPU_VTAB_REF /end COMPU_METHOD
/begin COMPU_VTAB RS_setsrc_ntwk_COMPU_VTAB_REF "Verbal Table" TAB_VERB 4 0 "PGN 65450" 1 "PGN 65261 CCSS" 2 "PGN 65473" 3 "PGN 62720 / 529 (11-bit)" DEFAULT_VALUE "UNKNOWN" /end COMPU_VTAB
/begin CHARACTERISTIC RSC_CAN_set_sw "Cruise CAN set switch behavior{RSC_CAN_set_sw&0xff=0:Engage only}{RSC_CAN_set_sw&0xff=1:Engage + disengage}{RSC_CAN_set_sw&0xff=2:Disengage only}" VALUE 0x001c88c7 /* @ECU_Address@RSC_CAN_set_sw@0x01012778@ */ ECIPP_ALIGNMENT_UBYTE 255 RSC_CAN_set_sw_COMPU_VTAB 0 255 BIT_MASK 0xff /end CHARACTERISTIC
/begin COMPU_METHOD RSC_CAN_set_sw_COMPU_VTAB "Verbal Table" TAB_VERB "%.0" "list" COMPU_TAB_REF RSC_CAN_set_sw_COMPU_VTAB_REF /end COMPU_METHOD
/begin COMPU_VTAB RSC_CAN_set_sw_COMPU_VTAB_REF "Verbal Table" TAB_VERB 3 0 "Engage only" 1 "Engage + disengage" 2 "Disengage only" DEFAULT_VALUE "UNKNOWN" /end COMPU_VTAB
/begin CHARACTERISTIC RS_TPS_FPPlim_ena "Roadspeed TPS control FPP limiting{RS_TPS_FPPlim_ena&0xff=0:Disabled}{RS_TPS_FPPlim_ena&0xff=1:Enabled}" VALUE 0x001c88d9 /* @ECU_Address@RS_TPS_FPPlim_ena@0x01012910@ */ ECIPP_ALIGNMENT_UBYTE 255 RS_TPS_FPPlim_ena_COMPU_VTAB 0 255 BIT_MASK 0xff /end CHARACTERISTIC
/begin COMPU_METHOD RS_TPS_FPPlim_ena_COMPU_VTAB "Verbal Table" TAB_VERB "%.0" "list" COMPU_TAB_REF RS_TPS_FPPlim_ena_COMPU_VTAB_REF /end COMPU_METHOD
/begin COMPU_VTAB RS_TPS_FPPlim_ena_COMPU_VTAB_REF "Verbal Table" TAB_VERB 2 0 "Disabled" 1 "Enabled" DEFAULT_VALUE "UNKNOWN" /end COMPU_VTAB
/begin CHARACTERISTIC RS_CAN_source "Roadspeed CAN signal source{RS_CAN_source&0xff=0:Most recent message}{RS_CAN_source&0xff=1:J1939 TCO1}{RS_CAN_source&0xff=2:J1939 CCVS1 or PGN 65473}{RS_CAN_source&0xff=3:PGN 42309 / 513 (11-bit)}" VALUE 0x001c88d7 /* @ECU_Address@RS_CAN_source@0x01012CD8@ */ ECIPP_ALIGNMENT_UBYTE 255 RS_CAN_source_COMPU_VTAB 0 255 BIT_MASK 0xff /end CHARACTERISTIC
/begin COMPU_METHOD RS_CAN_source_COMPU_VTAB "Verbal Table" TAB_VERB "%.0" "list" COMPU_TAB_REF RS_CAN_source_COMPU_VTAB_REF /end COMPU_METHOD
/begin COMPU_VTAB RS_CAN_source_COMPU_VTAB_REF "Verbal Table" TAB_VERB 4 0 "Most recent message" 1 "J1939 TCO1" 2 "J1939 CCVS1 or PGN 65473" 3 "PGN 42309 / 513 (11-bit)" DEFAULT_VALUE "UNKNOWN" /end COMPU_VTAB
/begin CHARACTERISTIC RS_max_load_inc_slew "Max load inc slew rate after RS loss" VALUE 0x001c7eea /* @ECU_Address@RS_max_load_inc_slew@0x010137B8@ */ ECIPP_ALIGNMENT_UWORD 20000 Compu_RS_max_load_inc_slew 0 19999.6948242188 /end CHARACTERISTIC
/begin COMPU_METHOD Compu_RS_max_load_inc_slew " " RAT_FUNC "%.1" "%/sec" COEFFS 0 3.2768 0 0 0 1 /end COMPU_METHOD
/begin MEASUREMENT START_CMD_raw "START_CMD raw" UWORD Compu_START_CMD_raw 0 0 0 5.00114468864469 ECU_ADDRESS 0x010138E0 /end MEASUREMENT
/begin COMPU_METHOD Compu_START_CMD_raw " " RAT_FUNC "%.3" "volts" COEFFS 0 13104 0 0 0 1 /end COMPU_METHOD
/begin MEASUREMENT START_CMD_volt "START_CMD volts" UWORD Compu_START_CMD_volt 0 0 0 255.99609375 ECU_ADDRESS 0x010138E8 /end MEASUREMENT
/begin COMPU_METHOD Compu_START_CMD_volt " " RAT_FUNC "%.2" "volts" COEFFS 0 256 0 0 0 1 /end COMPU_METHOD
/begin CHARACTERISTIC RSC_gainset_reengage "Cruise parameter-set reengage offset" VALUE 0x001c7ebe /* @ECU_Address@RSC_gainset_reengage@0x01014418@ */ ECIPP_ALIGNMENT_UWORD 256 Compu_RSC_gainset_reengage 0 255.99609375 /end CHARACTERISTIC
/begin COMPU_METHOD Compu_RSC_gainset_reengage " " RAT_FUNC "%.1" "kph" COEFFS 0 256 0 0 0 1 /end COMPU_METHOD
/begin MEASUREMENT KNK4H_raw "KNK4H_raw" UWORD Compu_KNK4H_raw 0 0 0 5.00114468864469 ECU_ADDRESS 0x010146D0 /end MEASUREMENT
/begin COMPU_METHOD Compu_KNK4H_raw " " RAT_FUNC "%.3" "volts" COEFFS 0 13104 0 0 0 1 /end COMPU_METHOD
/begin MEASUREMENT KNK5H_raw "KNK5H_raw" UWORD Compu_KNK5H_raw 0 0 0 5.00114468864469 ECU_ADDRESS 0x010146D8 /end MEASUREMENT
/begin COMPU_METHOD Compu_KNK5H_raw " " RAT_FUNC "%.3" "volts" COEFFS 0 13104 0 0 0 1 /end COMPU_METHOD
/begin MEASUREMENT KNK6H_raw "KNK6H_raw" UWORD Compu_KNK6H_raw 0 0 0 5.00114468864469 ECU_ADDRESS 0x010146E0 /end MEASUREMENT
/begin COMPU_METHOD Compu_KNK6H_raw " " RAT_FUNC "%.3" "volts" COEFFS 0 13104 0 0 0 1 /end COMPU_METHOD
/begin MEASUREMENT KNK7H_raw "KNK7H_raw" UWORD Compu_KNK7H_raw 0 0 0 5.00114468864469 ECU_ADDRESS 0x010146E8 /end MEASUREMENT
/begin COMPU_METHOD Compu_KNK7H_raw " " RAT_FUNC "%.3" "volts" COEFFS 0 13104 0 0 0 1 /end COMPU_METHOD
/begin MEASUREMENT KNK8H_raw "KNK8H_raw" UWORD Compu_KNK8H_raw 0 0 0 5.00114468864469 ECU_ADDRESS 0x010146F0 /end MEASUREMENT
/begin COMPU_METHOD Compu_KNK8H_raw " " RAT_FUNC "%.3" "volts" COEFFS 0 13104 0 0 0 1 /end COMPU_METHOD
/begin MEASUREMENT KNK9H_raw "KNK9H_raw" UWORD Compu_KNK9H_raw 0 0 0 5.00114468864469 ECU_ADDRESS 0x010146F8 /end MEASUREMENT
/begin COMPU_METHOD Compu_KNK9H_raw " " RAT_FUNC "%.3" "volts" COEFFS 0 13104 0 0 0 1 /end COMPU_METHOD
/begin MEASUREMENT KNK10H_raw "KNK10H_raw" UWORD Compu_KNK10H_raw 0 0 0 5.00114468864469 ECU_ADDRESS 0x01014700 /end MEASUREMENT
/begin COMPU_METHOD Compu_KNK10H_raw " " RAT_FUNC "%.3" "volts" COEFFS 0 13104 0 0 0 1 /end COMPU_METHOD
/begin MEASUREMENT KNK11H_raw "KNK11H_raw" UWORD Compu_KNK11H_raw 0 0 0 5.00114468864469 ECU_ADDRESS 0x01014708 /end MEASUREMENT
/begin COMPU_METHOD Compu_KNK11H_raw " " RAT_FUNC "%.3" "volts" COEFFS 0 13104 0 0 0 1 /end COMPU_METHOD
/begin MEASUREMENT KNK12H_raw "KNK12H_raw" UWORD Compu_KNK12H_raw 0 0 0 5.00114468864469 ECU_ADDRESS 0x01014710 /end MEASUREMENT
/begin COMPU_METHOD Compu_KNK12H_raw " " RAT_FUNC "%.3" "volts" COEFFS 0 13104 0 0 0 1 /end COMPU_METHOD
/begin MEASUREMENT RSC_enable_sw_stat "Roadspeed cruise enable switch input status{RSC_enable_sw_stat&0xff=0:Not Active}{RSC_enable_sw_stat&0xff=1:Active}{RSC_enable_sw_stat&0xff=2:Error/Fault}{RSC_enable_sw_stat&0xff=3:Not Configured}" UBYTE RSC_enable_sw_stat_COMPU_VTAB 0 0 0 255 ECU_ADDRESS 0x010149B0 BIT_MASK 0xff /end MEASUREMENT
/begin COMPU_METHOD RSC_enable_sw_stat_COMPU_VTAB "Verbal Table" TAB_VERB "%.0" "list" COMPU_TAB_REF RSC_enable_sw_stat_COMPU_VTAB_REF /end COMPU_METHOD
/begin COMPU_VTAB RSC_enable_sw_stat_COMPU_VTAB_REF "Verbal Table" TAB_VERB 4 0 "Not Active" 1 "Active" 2 "Error/Fault" 3 "Not Configured" DEFAULT_VALUE "UNKNOWN" /end COMPU_VTAB
/begin MEASUREMENT RSC_disable_sw_stat "Roadspeed cruise disable switch input status{RSC_disable_sw_stat&0xff=0:Not Active}{RSC_disable_sw_stat&0xff=1:Active}{RSC_disable_sw_stat&0xff=2:Error/Fault}{RSC_disable_sw_stat&0xff=3:Not Configured}" UBYTE RSC_disable_sw_stat_COMPU_VTAB 0 0 0 255 ECU_ADDRESS 0x010149B8 BIT_MASK 0xff /end MEASUREMENT
/begin COMPU_METHOD RSC_disable_sw_stat_COMPU_VTAB "Verbal Table" TAB_VERB "%.0" "list" COMPU_TAB_REF RSC_disable_sw_stat_COMPU_VTAB_REF /end COMPU_METHOD
/begin COMPU_VTAB RSC_disable_sw_stat_COMPU_VTAB_REF "Verbal Table" TAB_VERB 4 0 "Not Active" 1 "Active" 2 "Error/Fault" 3 "Not Configured" DEFAULT_VALUE "UNKNOWN" /end COMPU_VTAB
/begin MEASUREMENT RSC_setinc_sw_stat "Roadspeed cruise set/inc switch input status{RSC_setinc_sw_stat&0xff=0:Not Active}{RSC_setinc_sw_stat&0xff=1:Active}{RSC_setinc_sw_stat&0xff=2:Error/Fault}{RSC_setinc_sw_stat&0xff=3:Not Configured}" UBYTE RSC_setinc_sw_stat_COMPU_VTAB 0 0 0 255 ECU_ADDRESS 0x010149C0 BIT_MASK 0xff /end MEASUREMENT
/begin COMPU_METHOD RSC_setinc_sw_stat_COMPU_VTAB "Verbal Table" TAB_VERB "%.0" "list" COMPU_TAB_REF RSC_setinc_sw_stat_COMPU_VTAB_REF /end COMPU_METHOD
/begin COMPU_VTAB RSC_setinc_sw_stat_COMPU_VTAB_REF "Verbal Table" TAB_VERB 4 0 "Not Active" 1 "Active" 2 "Error/Fault" 3 "Not Configured" DEFAULT_VALUE "UNKNOWN" /end COMPU_VTAB
/begin MEASUREMENT RSC_setdec_sw_stat "Roadspeed cruise set/dec switch input status{RSC_setdec_sw_stat&0xff=0:Not Active}{RSC_setdec_sw_stat&0xff=1:Active}{RSC_setdec_sw_stat&0xff=2:Error/Fault}{RSC_setdec_sw_stat&0xff=3:Not Configured}" UBYTE RSC_setdec_sw_stat_COMPU_VTAB 0 0 0 255 ECU_ADDRESS 0x010149C8 BIT_MASK 0xff /end MEASUREMENT
/begin COMPU_METHOD RSC_setdec_sw_stat_COMPU_VTAB "Verbal Table" TAB_VERB "%.0" "list" COMPU_TAB_REF RSC_setdec_sw_stat_COMPU_VTAB_REF /end COMPU_METHOD
/begin COMPU_VTAB RSC_setdec_sw_stat_COMPU_VTAB_REF "Verbal Table" TAB_VERB 4 0 "Not Active" 1 "Active" 2 "Error/Fault" 3 "Not Configured" DEFAULT_VALUE "UNKNOWN" /end COMPU_VTAB
/begin MEASUREMENT RSC_resume_sw_stat "Roadspeed cruise resume switch input status{RSC_resume_sw_stat&0xff=0:Not Active}{RSC_resume_sw_stat&0xff=1:Active}{RSC_resume_sw_stat&0xff=2:Error/Fault}{RSC_resume_sw_stat&0xff=3:Not Configured}" UBYTE RSC_resume_sw_stat_COMPU_VTAB 0 0 0 255 ECU_ADDRESS 0x010149D0 BIT_MASK 0xff /end MEASUREMENT
/begin COMPU_METHOD RSC_resume_sw_stat_COMPU_VTAB "Verbal Table" TAB_VERB "%.0" "list" COMPU_TAB_REF RSC_resume_sw_stat_COMPU_VTAB_REF /end COMPU_METHOD
/begin COMPU_VTAB RSC_resume_sw_stat_COMPU_VTAB_REF "Verbal Table" TAB_VERB 4 0 "Not Active" 1 "Active" 2 "Error/Fault" 3 "Not Configured" DEFAULT_VALUE "UNKNOWN" /end COMPU_VTAB
/begin CHARACTERISTIC RS_TPS_lmt_ena "Roadspeed TPS control TPS limiting{RS_TPS_lmt_ena&0xff=0:Enabled}{RS_TPS_lmt_ena&0xff=1:Enabled - TSC1 Inactive}" VALUE 0x001c88db /* @ECU_Address@RS_TPS_lmt_ena@0x01014BC0@ */ ECIPP_ALIGNMENT_UBYTE 255 RS_TPS_lmt_ena_COMPU_VTAB 0 255 BIT_MASK 0xff /end CHARACTERISTIC
/begin COMPU_METHOD RS_TPS_lmt_ena_COMPU_VTAB "Verbal Table" TAB_VERB "%.0" "list" COMPU_TAB_REF RS_TPS_lmt_ena_COMPU_VTAB_REF /end COMPU_METHOD
/begin COMPU_VTAB RS_TPS_lmt_ena_COMPU_VTAB_REF "Verbal Table" TAB_VERB 2 0 "Enabled" 1 "Enabled - TSC1 Inactive" DEFAULT_VALUE "UNKNOWN" /end COMPU_VTAB
/begin CHARACTERISTIC RS_setsrc_cfg "Roadspeed limit setpoint source config{RS_setsrc_cfg&0xff=0:Default}{RS_setsrc_cfg&0xff=1:GND}{RS_setsrc_cfg&0xff=2:GND/+V}{RS_setsrc_cfg&0xff=3:+V}{RS_setsrc_cfg&0xff=4:Open}" VALUE 0x001c88e5 /* @ECU_Address@RS_setsrc_cfg@0x01014BC8@ */ ECIPP_ALIGNMENT_UBYTE 255 RS_setsrc_cfg_COMPU_VTAB 0 255 BIT_MASK 0xff /end CHARACTERISTIC
/begin COMPU_METHOD RS_setsrc_cfg_COMPU_VTAB "Verbal Table" TAB_VERB "%.0" "list" COMPU_TAB_REF RS_setsrc_cfg_COMPU_VTAB_REF /end COMPU_METHOD
/begin COMPU_VTAB RS_setsrc_cfg_COMPU_VTAB_REF "Verbal Table" TAB_VERB 5 0 "Default" 1 "GND" 2 "GND/+V" 3 "+V" 4 "Open" DEFAULT_VALUE "UNKNOWN" /end COMPU_VTAB
/begin COMPU_METHOD Compu_TRSovsc_RS " " RAT_FUNC "%.1" "Speed (kph)" COEFFS 0 128 0 0 0 1 /end COMPU_METHOD
/begin CHARACTERISTIC TRSovsc_Kiv "Roadspeed overshoot control Kiv" CURVE 0x001CA136 /* @ECU_Address@TRSovsc_Kiv@0x02137000@ */ ECIPP_ALIGNMENT_SWORD 800 Compu_TRSovsc_Kiv -800 799.9755859375
 /begin AXIS_DESCR COM_AXIS NO_INPUT_QUANTITY Compu_TRSovsc_RS 4 -256 255.9921875 AXIS_PTS_REF TRSovsc_RS /end AXIS_DESCR
/end CHARACTERISTIC
/begin AXIS_PTS TRSovsc_RS " " 0x001CA12E /* @ECU_Address@TRSovsc_RS@0x02136000@ */ NO_INPUT_QUANTITY ECIPP_Lookup_SWORD 0 Compu_TRSovsc_RS 4 -256 255.9921875 /end AXIS_PTS
/begin COMPU_METHOD Compu_TRSovsc_Kiv " " RAT_FUNC "%.1" "Kiv (%/kph)" COEFFS 0 40.96 0 0 0 1 /end COMPU_METHOD
/begin CHARACTERISTIC TRSovsc_dIlim "Roadspeed overshoot control dIlim" CURVE 0x001CA13E /* @ECU_Address@TRSovsc_dIlim@0x02138000@ */ ECIPP_ALIGNMENT_SWORD 625 Compu_TRSovsc_dIlim -625 624.980926513672
 /begin AXIS_DESCR COM_AXIS NO_INPUT_QUANTITY Compu_TRSovsc_RS 4 -256 255.9921875 AXIS_PTS_REF TRSovsc_RS /end AXIS_DESCR
/end CHARACTERISTIC
/begin COMPU_METHOD Compu_TRSovsc_dIlim " " RAT_FUNC "%.1" "Rate Limit (%/sec)" COEFFS 0 52.4288 0 0 0 1 /end COMPU_METHOD
/begin COMPU_METHOD Compu_TRS2ovsc_RS " " RAT_FUNC "%.1" "Speed (kph)" COEFFS 0 128 0 0 0 1 /end COMPU_METHOD
/begin CHARACTERISTIC TRS2ovsc_Kiv "Roadspeed2 overshoot control Kiv" CURVE 0x001CA182 /* @ECU_Address@TRS2ovsc_Kiv@0x02180000@ */ ECIPP_ALIGNMENT_SWORD 800 Compu_TRS2ovsc_Kiv -800 799.9755859375
 /begin AXIS_DESCR COM_AXIS NO_INPUT_QUANTITY Compu_TRS2ovsc_RS 4 -256 255.9921875 AXIS_PTS_REF TRS2ovsc_RS /end AXIS_DESCR
/end CHARACTERISTIC
/begin AXIS_PTS TRS2ovsc_RS " " 0x001CA17A /* @ECU_Address@TRS2ovsc_RS@0x0217F000@ */ NO_INPUT_QUANTITY ECIPP_Lookup_SWORD 0 Compu_TRS2ovsc_RS 4 -256 255.9921875 /end AXIS_PTS
/begin COMPU_METHOD Compu_TRS2ovsc_Kiv " " RAT_FUNC "%.1" "Kiv (%/kph)" COEFFS 0 40.96 0 0 0 1 /end COMPU_METHOD
/begin CHARACTERISTIC TRS2ovsc_dIlim "Roadspeed2 overshoot control dIlim" CURVE 0x001CA18A /* @ECU_Address@TRS2ovsc_dIlim@0x02181000@ */ ECIPP_ALIGNMENT_SWORD 625 Compu_TRS2ovsc_dIlim -625 624.980926513672
 /begin AXIS_DESCR COM_AXIS NO_INPUT_QUANTITY Compu_TRS2ovsc_RS 4 -256 255.9921875 AXIS_PTS_REF TRS2ovsc_RS /end AXIS_DESCR
/end CHARACTERISTIC
/begin COMPU_METHOD Compu_TRS2ovsc_dIlim " " RAT_FUNC "%.1" "Rate Limit (%/sec)" COEFFS 0 52.4288 0 0 0 1 /end COMPU_METHOD
/begin COMPU_METHOD Compu_TRS3ovsc_RS " " RAT_FUNC "%.1" "Speed (kph)" COEFFS 0 128 0 0 0 1 /end COMPU_METHOD
/begin CHARACTERISTIC TRS3ovsc_Kiv "Roadspeed3 overshoot control Kiv" CURVE 0x001CA1CE /* @ECU_Address@TRS3ovsc_Kiv@0x02183000@ */ ECIPP_ALIGNMENT_SWORD 800 Compu_TRS3ovsc_Kiv -800 799.9755859375
 /begin AXIS_DESCR COM_AXIS NO_INPUT_QUANTITY Compu_TRS3ovsc_RS 4 -256 255.9921875 AXIS_PTS_REF TRS3ovsc_RS /end AXIS_DESCR
/end CHARACTERISTIC
/begin AXIS_PTS TRS3ovsc_RS " " 0x001CA1C6 /* @ECU_Address@TRS3ovsc_RS@0x02182000@ */ NO_INPUT_QUANTITY ECIPP_Lookup_SWORD 0 Compu_TRS3ovsc_RS 4 -256 255.9921875 /end AXIS_PTS
/begin COMPU_METHOD Compu_TRS3ovsc_Kiv " " RAT_FUNC "%.1" "Kiv (%/kph)" COEFFS 0 40.96 0 0 0 1 /end COMPU_METHOD
/begin CHARACTERISTIC TRS3ovsc_dIlim "Roadspeed3 overshoot control dIlim" CURVE 0x001CA1D6 /* @ECU_Address@TRS3ovsc_dIlim@0x02184000@ */ ECIPP_ALIGNMENT_SWORD 625 Compu_TRS3ovsc_dIlim -625 624.980926513672
 /begin AXIS_DESCR COM_AXIS NO_INPUT_QUANTITY Compu_TRS3ovsc_RS 4 -256 255.9921875 AXIS_PTS_REF TRS3ovsc_RS /end AXIS_DESCR
/end CHARACTERISTIC
/begin COMPU_METHOD Compu_TRS3ovsc_dIlim " " RAT_FUNC "%.1" "Rate Limit (%/sec)" COEFFS 0 52.4288 0 0 0 1 /end COMPU_METHOD
/begin COMPU_METHOD Compu_TRS_kph_meas " " RAT_FUNC "%.1" "Measured kph" COEFFS 0 128 0 0 0 1 /end COMPU_METHOD
/begin CHARACTERISTIC TRS_kph_act "Roadspeed nonlinear correction" CURVE 0x001C58E0 /* @ECU_Address@TRS_kph_act@0x0222E000@ */ ECIPP_ALIGNMENT_SWORD 256 Compu_TRS_kph_act -256 255.9921875
 /begin AXIS_DESCR COM_AXIS NO_INPUT_QUANTITY Compu_TRS_kph_meas 6 -256 255.9921875 AXIS_PTS_REF TRS_kph_meas /end AXIS_DESCR
/end CHARACTERISTIC
/begin AXIS_PTS TRS_kph_meas " " 0x001C58EC /* @ECU_Address@TRS_kph_meas@0x0222D000@ */ NO_INPUT_QUANTITY ECIPP_Lookup_SWORD 0 Compu_TRS_kph_meas 6 -256 255.9921875 /end AXIS_PTS
/begin COMPU_METHOD Compu_TRS_kph_act " " RAT_FUNC "%.1" "Actual kph" COEFFS 0 128 0 0 0 1 /end COMPU_METHOD
/begin MEASUREMENT SPK_IGBT_T_raw "Spk_IGBT_T_raw 0" UWORD Compu_SPK_IGBT_T_raw 0 0 0 5.00114468864469 ECU_ADDRESS 0x0233C000 MATRIX_DIM 13 1 1 /end MEASUREMENT
/begin COMPU_METHOD Compu_SPK_IGBT_T_raw " " RAT_FUNC "%.3" "volts" COEFFS 0 13104 0 0 0 1 /end COMPU_METHOD
/begin GROUP EC_RawVolts "ECONTROLS" ROOT
 /begin REF_MEASUREMENT TPS1_raw TPS2_raw CRK_ana_raw MAG_BIAS_raw KNK1H_raw KNK2H_raw KNK1L_raw KNK2L_raw TIP_raw FPP1_raw FPP2_raw FRP_raw WGP_raw EGO1_raw EGO2_raw EGO3_raw Vbat_raw Vsw_raw VE5a_FB_raw FT_raw GOV1_raw GOV2_raw EGO1H_LS_raw EGO2H_LS_raw EGO3H_LS_raw OILP_raw AUX_DIG1_raw AUX_DIG2_raw AUX_PWM1_FB_raw AUX_PWM2_FB_raw EGO4_raw AUX_DIG3_raw EGT_raw VE5b_FB_raw EGO4H_LS_raw AUX_PWM3_FB_raw AUX_PWM4_FB_raw AUX_PWM5_FB_raw AUX_DIG1_volt AUX_DIG2_volt AUX_DIG3_volt AUX_PUD4_raw AUX_PUD5_raw AUX_PUD6_raw SHIFT_I_FB_raw Valternator_raw AUX_PWM6_FB_raw CAM1_ana_raw RS_ana_raw AUX_PWM7_FB_raw AUX_PWM8_FB_raw RELAY_LS_raw LOCKOFF_LS_raw STARTER_FB_raw MIL_LS_raw TACH_FB_raw AUX_DIG4_raw AUX_DIG5_raw AUX_DIG6_raw AUX_DIG7_raw AUX_DIG8_raw AUX_DIG4_volt AUX_DIG5_volt AUX_DIG6_volt AUX_DIG7_volt AUX_DIG8_volt UEGOPI_raw UEGOSR_raw UEGOHFB_raw AUX_DIG12_raw AUX_PUD7_raw AUX_PUD8_raw AUX_DIG11_raw AUX_DIG11_volt FPUMP_FB_raw AUX_DIG9_raw AUX_DIG9_volt AUX_DIG10_raw AUX_DIG10_volt AUX_DIG12_volt AUX_DIG13_raw AUX_DIG13_volt AUX_DIG14_raw AUX_DIG14_volt AUX_DIG15_raw AUX_DIG15_volt AUX_DIG16_raw AUX_DIG16_volt AUX_DIG17_raw AUX_DIG17_volt AUX_DIG18_raw AUX_DIG18_volt AUX_DIG19_raw AUX_DIG19_volt AUX_PUD9_raw AUX_PUD10_raw AUX_PUD11_raw AUX_PUD12_raw AUX_PUD13_raw AUX_PUD14_raw AUX_PUD15_raw AUX_PUD16_raw AUX_PUD17_raw AUX_PUD18_raw AUX_PUD19_raw AUX_PUD20_raw AUX_PUD21_raw AUX_PUD22_raw AUX_PUD23_raw AUX_PUD24_raw AUX_PUD25_raw AUX_PWM9_FB_raw AUX_PWM10_FB_raw AUX_PWM11_FB_raw AUX_PWM12_FB_raw AUX_PWM13_FB_raw AUX_PWM14_FB_raw AUX_PWM15_FB_raw UEGO2PI_raw UEGO2SR_raw UEGO2HFB_raw Vrelay_raw VE5c_FB_raw IVS_raw AUX_DIG20_raw AUX_DIG20_volt AUX_DIG21_raw AUX_DIG21_volt AUX_DIG22_raw AUX_DIG22_volt AUX_PWM16_FB_raw AUX_PWM17_FB_raw AUX_PWM18_FB_raw AUX_PWM19_FB_raw AUX_PWM20_FB_raw AUX_PWM21_FB_raw AUX_PWM22_FB_raw AUX_PWM23_FB_raw PULSE_IN_raw BUZZ_FB_raw DBW_iFB_raw HBA_iFB_raw HBB_iFB_raw CAM2_ana_raw SPKI_samp_raw CRI1_boost_raw CRI1_LS_i_raw CRI2_boost_raw CRI2_LS_i_raw ref_4096V_raw VE6_FB_raw UEGO_Vcc_raw AUX_DIG23_raw AUX_DIG23_volt AUX_DIG24_raw AUX_DIG24_volt AUX_DIG25_raw AUX_DIG25_volt AUX_PWM1_iFB_raw AUX_PWM2_iFB_raw AUX_PWM3_iFB_raw AUX_PWM4_iFB_raw AUX_PWM5_iFB_raw AUX_PWM6_iFB_raw AUX_PWM8_iFB_raw AUX_PWM9_iFB_raw AUX_PWM7_iFB_raw AUX_PWM10_iFB_raw AUX_PWM11_iFB_raw AUX_PWM12_iFB_raw AUX_PWM13_iFB_raw AUX_PWM14_iFB_raw AUX_PWM15_iFB_raw AUX_PWM16_iFB_raw AUX_PWM17_iFB_raw AUX_PWM18_iFB_raw AUX_PWM19_iFB_raw AUX_PWM20_iFB_raw AUX_PWM21_iFB_raw AUX_PWM22_iFB_raw AUX_PWM23_iFB_raw VE5a VE5b VE5c Vrelay KNK3H_raw KNK3L_raw T_internal_raw START_CMD_raw START_CMD_volt KNK4H_raw KNK5H_raw KNK6H_raw KNK7H_raw KNK8H_raw KNK9H_raw KNK10H_raw KNK11H_raw KNK12H_raw SPK_IGBT_T_raw /end REF_MEASUREMENT
/end GROUP
/begin GROUP EC_Roadspeed "ECONTROLS" ROOT
 /begin REF_CHARACTERISTIC RS_pulse_space RS_hist_avg_t RS_hist_tout RS_dot_window RS_speed_tau RS_TPS_tau RS_dot_tau RS_Kp RS_Ki RS_Kd RS_Kiv RS_rpm_nom RS_HW_switch RS_source RS_dot_dzlim slowPWMin_ena slowPWMin_per_edge slowPWMin_tout RS_setsrc sPWMi_DC_lo sPWMi_DC_hi sPWMi_per_lo sPWMi_per_hi RS_setsrc_valid RS_prop_tau RS_rpmtol_Ifrz RS_Kivapp_RS0 RS_Kivapp_RS100 RS_Kivapp_add RSovsc_ena RSovsc_Kiv RSovsc_dIlim RSovsc_deng RSovsc_denghyst RS_Kd_accel RS_loss RS_loss_RPM RS_loss_MAP RSdrop_rpm_arm RSdrop_kph_arm RSdrop_tout_arm RSdrop_kph_trig RSdrop_tout_trig RSdrop_tout_disarm RSovsc_table RSovsc_Kiv_phout RS_dot_ovsc_tau RS_gainset RS2_gainset RS2_source RS2ovsc_ena RS2ovsc_table RS2_speed_tau RS2_dot_tau RS2_dot_window RS2_dot_dzlim RS2_Kp RS2_Ki RS2_Kd RS2_Kd_accel RS2_Kiv RS2_TPS_tau RS2_Kivapp_add RS2_Kivapp_RS0 RS2_Kivapp_RS100 RS2ovsc_deng RS2ovsc_denghyst RS2_dot_ovsc_tau RS2ovsc_Kiv_phout RS2ovsc_dIlim RS2ovsc_Kiv RS3_gainset RS3_source RS3ovsc_ena RS3ovsc_table RS3_speed_tau RS3_dot_tau RS3_dot_window RS3_dot_dzlim RS3_Kp RS3_Ki RS3_Kd RS3_Kd_accel RS3_Kiv RS3_TPS_tau RS3_Kivapp_add RS3_Kivapp_RS0 RS3_Kivapp_RS100 RS3ovsc_deng RS3ovsc_denghyst RS3_dot_ovsc_tau RS3ovsc_Kiv_phout RS3ovsc_dIlim RS3ovsc_Kiv RSC_enable_chan RSC_resume_chan RSC_setinc_chan RSC_setdec_chan RSC_enable_moment RSC_setinc_wait RSC_setdec_wait RSC_resume_ramp RSC_setinc_tap RSC_setinc_ramp RSC_setdec_tap RSC_setdec_ramp RSC_min_kph RSC_max_kph RSC_engaged_light RS_kph_crct_ena RSC_disable_kph RSC_retard_braking RS_Kp_dz RS2_Kp_dz RS3_Kp_dz RS_Kp_dz_tout RS2_Kp_dz_tout RS3_Kp_dz_tout RS_speed_CAN_tau C2ASpd_ena C2ASpd_hist_avg_t C2ASpd_hist_tout RS_Iacc_init RSC_enable_cfg RSC_setinc_cfg RSC_setdec_cfg RSC_resume_cfg MEFI_RS_source_ena RSC_disable_chan RSC_disable_cfg RS_speed_Llim RS_speed_Ulim RS_ppkm_Ulim RS_loV RS_hiV RSC_disable_by_RBC RS_pattern RS_disc_tmr RS_disc_thr RS_disc_rpm RS_GPS_UA_tout RS_disc_ena RS_disc_Vbat RS_max_allspeed_ena RS_TPS_bstld_crct RSC_disable_2inputs RSC_disable_rpm RSC_ramp_time_max RSC_error_pct RSC_error_wait RS_setsrc_ntwk RSC_CAN_set_sw RS_TPS_FPPlim_ena RS_CAN_source RS_max_load_inc_slew RSC_gainset_reengage RS_TPS_lmt_ena RS_setsrc_cfg TRSovsc_Kiv TRSovsc_dIlim TRS2ovsc_Kiv TRS2ovsc_dIlim TRS3ovsc_Kiv TRS3ovsc_dIlim TRS_kph_act /end REF_CHARACTERISTIC
 /begin REF_MEASUREMENT RS_dot RS_dot_dz MAG_BIAS_raw RS_dt RS_pulse_cnt RS_max_load RS_max_TPS RS_Iacc GPS_ENZdot_tmr GPS_Edot GPS_Ndot GPS_ENZdot_st GPS_ENspeed MaxSetPt_RS slowPWMin_period slowPWMin_DC slowPWMin_valid Aqua_setpt_mode Aqua_setpt_speed Aqua_setpt_rpm Aqua_ENdot Aqua_fwdaccel Aqua_fwdaccel_st RSovsc_armed RSdrop_status RSovsc_Kiv_a RSovsc_dIlim_a Aqua_gain_ndx Aqua_spddotd_dis RSP_selected RSC_speed_accum RSC_speed_slew RSC_engaged RSC_enabled RS_ana_raw RS_speed_meas_acc RS_min_FPP RS_OOA_state RSC_CCVS_status RS_max_FPP RS_FPPmin_Iacc RS_FPPmax_Iacc RS_speed_CAN RS_freq_raw C2ASpd_freq_raw MEFI_RS_source_req RMT_RS_pulses_per_km RMT_RS_speed_1 RMT_RS_speed_2 RMT_RS_mode RS_dir RS_disc_ana RS_disc_calc FPP_allspeed_rpm allspeed_rpm RS_max_allspeed_rpm RS_max_allspeed_use RSC_enable_sw_stat RSC_disable_sw_stat RSC_setinc_sw_stat RSC_setdec_sw_stat RSC_resume_sw_stat /end REF_MEASUREMENT
/end GROUP
/end MODULE
/end PROJECT
