ASAP2_VERSION 1 61
/begin PROJECT Econtrols_4G "4G Test"
/begin HEADER "4G A2L Configuration" PROJECT_NO EControls4G /* config for version control */ VERSION "$Revision: 82130 $:" /* config for version control */ /end HEADER
/begin MODULE EControls_4G_SH2A "EControls 4G"
/begin MOD_COMMON "" DEPOSIT ABSOLUTE BYTE_ORDER MSB_FIRST /end MOD_COMMON
/* Define the Record Layouts */
/begin RECORD_LAYOUT ECIPP_ALIGNMENT_UBYTE FNC_VALUES 1 UBYTE COLUMN_DIR DIRECT /end RECORD_LAYOUT
/begin RECORD_LAYOUT ECIPP_ALIGNMENT_UWORD FNC_VALUES 1 UWORD COLUMN_DIR DIRECT /end RECORD_LAYOUT
/begin RECORD_LAYOUT ECIPP_ALIGNMENT_SWORD FNC_VALUES 1 SWORD COLUMN_DIR DIRECT /end RECORD_LAYOUT
/begin RECORD_LAYOUT ECIPP_Lookup_SWORD AXIS_PTS_X 1 SWORD INDEX_INCR DIRECT /end RECORD_LAYOUT
/begin RECORD_LAYOUT ECIPP_ALIGNMENT_ULONG FNC_VALUES 1 ULONG COLUMN_DIR DIRECT /end RECORD_LAYOUT
/begin RECORD_LAYOUT ECIPP_ALIGNMENT_FLOAT32_IEEE FNC_VALUES 1 FLOAT32_IEEE COLUMN_DIR DIRECT /end RECORD_LAYOUT
/begin MEASUREMENT inj_timing "Injection timing" SWORD Compu_inj_timing 0 0 -2048 2047.9375 ECU_ADDRESS 0x01000078 /end MEASUREMENT
/begin COMPU_METHOD Compu_inj_timing " " RAT_FUNC "%.0" "CAD BBDCI" COEFFS 0 16 0 0 0 1 /end COMPU_METHOD
/begin MEASUREMENT m_f_port "m_f_port" UWORD Compu_m_f_port 0 0 0 1023.984375 ECU_ADDRESS 0x01000120 /end MEASUREMENT
/begin COMPU_METHOD Compu_m_f_port " " RAT_FUNC "%.1" "mg/intake" COEFFS 0 64 0 0 0 1 /end COMPU_METHOD
/begin MEASUREMENT mdot_f_throttle "mdot_f_throttle" UWORD Compu_mdot_f_throttle 0 0 0 127.998046875 ECU_ADDRESS 0x01000140 /end MEASUREMENT
/begin COMPU_METHOD Compu_mdot_f_throttle " " RAT_FUNC "%.2" "g/sec" COEFFS 0 512 0 0 0 1 /end COMPU_METHOD
/begin MEASUREMENT PW_offset_global "Pulse width offset" SWORD Compu_PW_offset_global 0 0 -104.8576 104.8544 ECU_ADDRESS 0x010002A0 /end MEASUREMENT
/begin COMPU_METHOD Compu_PW_offset_global " " RAT_FUNC "%.2" "ms" COEFFS 0 312.5 0 0 0 1 /end COMPU_METHOD
/begin MEASUREMENT AUX_PD1_raw "AUX_PD1_raw" UWORD Compu_AUX_PD1_raw 0 0 0 5.00114468864469 ECU_ADDRESS 0x010003C0 /end MEASUREMENT
/begin COMPU_METHOD Compu_AUX_PD1_raw " " RAT_FUNC "%.3" "volts" COEFFS 0 13104 0 0 0 1 /end COMPU_METHOD
/begin MEASUREMENT AUX_PU1_raw "AUX_PU1_raw" UWORD Compu_AUX_PU1_raw 0 0 0 5.00114468864469 ECU_ADDRESS 0x010003C8 /end MEASUREMENT
/begin COMPU_METHOD Compu_AUX_PU1_raw " " RAT_FUNC "%.3" "volts" COEFFS 0 13104 0 0 0 1 /end COMPU_METHOD
/begin MEASUREMENT FPC_dot "Fuel rail pressure derivative" SWORD Compu_FPC_dot 0 0 -512 511.984375 ECU_ADDRESS 0x010004A0 /end MEASUREMENT
/begin COMPU_METHOD Compu_FPC_dot " " RAT_FUNC "%.1" "psi/sec" COEFFS 0 64 0 0 0 1 /end COMPU_METHOD
/begin CHARACTERISTIC async_inj_ena "Asynchronous Injection{async_inj_ena&0xff=0x00:OFF}{async_inj_ena&0xff=0x01:ON}" VALUE 0x001C9F8B /* @ECU_Address@async_inj_ena@0x010009E0@ */ ECIPP_ALIGNMENT_UBYTE 255 async_inj_ena_COMPU_VTAB 0 255 BIT_MASK 0xff /end CHARACTERISTIC
/begin COMPU_METHOD async_inj_ena_COMPU_VTAB "Verbal Table" TAB_VERB "%.0" "list" COMPU_TAB_REF async_inj_ena_COMPU_VTAB_REF /end COMPU_METHOD
/begin COMPU_VTAB async_inj_ena_COMPU_VTAB_REF "Verbal Table" TAB_VERB 2 0x00 "OFF" 0x01 "ON" DEFAULT_VALUE "UNKNOWN" /end COMPU_VTAB
/begin CHARACTERISTIC tri_fuel_ena "Tri-Fuel Mode{tri_fuel_ena&0xff=0x00:Disabled}{tri_fuel_ena&0xff=0x01:Enabled}" VALUE 0x001c908c /* @ECU_Address@tri_fuel_ena@0x01000BA8@ */ ECIPP_ALIGNMENT_UBYTE 255 tri_fuel_ena_COMPU_VTAB 0 255 BIT_MASK 0xff /end CHARACTERISTIC
/begin COMPU_METHOD tri_fuel_ena_COMPU_VTAB "Verbal Table" TAB_VERB "%.0" "list" COMPU_TAB_REF tri_fuel_ena_COMPU_VTAB_REF /end COMPU_METHOD
/begin COMPU_VTAB tri_fuel_ena_COMPU_VTAB_REF "Verbal Table" TAB_VERB 2 0x00 "Disabled" 0x01 "Enabled" DEFAULT_VALUE "UNKNOWN" /end COMPU_VTAB
/begin CHARACTERISTIC FPUMP_wakeup "FPUMP wakeup" VALUE 0x001c6fca /* @ECU_Address@FPUMP_wakeup@0x01000BB8@ */ ECIPP_ALIGNMENT_UWORD 65535 Compu_FPUMP_wakeup 0 65535 /end CHARACTERISTIC
/begin COMPU_METHOD Compu_FPUMP_wakeup " " RAT_FUNC "%.0" "ms" COEFFS 0 1 0 0 0 1 /end COMPU_METHOD
/begin CHARACTERISTIC LOCKOFF_wakeup "LOCKOFF wakeup" VALUE 0x001c7cfe /* @ECU_Address@LOCKOFF_wakeup@0x01000BC0@ */ ECIPP_ALIGNMENT_UWORD 65535 Compu_LOCKOFF_wakeup 0 65535 /end CHARACTERISTIC
/begin COMPU_METHOD Compu_LOCKOFF_wakeup " " RAT_FUNC "%.0" "ms" COEFFS 0 1 0 0 0 1 /end COMPU_METHOD
/begin CHARACTERISTIC gsln2gas_overlap "Gasoline to LP/NG overlap" VALUE 0x001c6d1a /* @ECU_Address@gsln2gas_overlap@0x01000BC8@ */ ECIPP_ALIGNMENT_SWORD 32767 Compu_gsln2gas_overlap -32768 32767 /end CHARACTERISTIC
/begin COMPU_METHOD Compu_gsln2gas_overlap " " RAT_FUNC "%.0" "ms" COEFFS 0 1 0 0 0 1 /end COMPU_METHOD
/begin CHARACTERISTIC gas2gsln_overlap "LP/NG to Gasoline overlap" VALUE 0x001c6d18 /* @ECU_Address@gas2gsln_overlap@0x01000BD0@ */ ECIPP_ALIGNMENT_SWORD 32767 Compu_gas2gsln_overlap -32768 32767 /end CHARACTERISTIC
/begin COMPU_METHOD Compu_gas2gsln_overlap " " RAT_FUNC "%.0" "ms" COEFFS 0 1 0 0 0 1 /end COMPU_METHOD
/begin CHARACTERISTIC V_LPG_off "LPG turnoff V equivalent (single value)" VALUE 0x001c8372 /* @ECU_Address@V_LPG_off@0x01000BD8@ */ ECIPP_ALIGNMENT_UWORD 32 Compu_V_LPG_off 0 31.99951171875 /end CHARACTERISTIC
/begin COMPU_METHOD Compu_V_LPG_off " " RAT_FUNC "%.2" "liters" COEFFS 0 2048 0 0 0 1 /end COMPU_METHOD
/begin CHARACTERISTIC V_NG_off "NG turnoff V equivalent" VALUE 0x001c8376 /* @ECU_Address@V_NG_off@0x01000BE0@ */ ECIPP_ALIGNMENT_UWORD 32 Compu_V_NG_off 0 31.99951171875 /end CHARACTERISTIC
/begin COMPU_METHOD Compu_V_NG_off " " RAT_FUNC "%.2" "liters" COEFFS 0 2048 0 0 0 1 /end COMPU_METHOD
/begin CHARACTERISTIC FT_input_cfg "Fuel switch configuration{FT_input_cfg&0xff=0x00:Gnd=LP, Open=Gsln, +V=NG}{FT_input_cfg&0xff=0x01:Gnd=NG, Open=Gsln, +V=LP}{FT_input_cfg&0xff=0x02:Gnd/Open=Gsln, +V=LP}{FT_input_cfg&0xff=0x03:Gnd/Open=Gsln, +V=NG}{FT_input_cfg&0xff=0x04:Gasoline Only}{FT_" VALUE 0x001c8747 /* @ECU_Address@FT_input_cfg@0x010013D8@ */ ECIPP_ALIGNMENT_UBYTE 255 FT_input_cfg_COMPU_VTAB 0 255 BIT_MASK 0xff /end CHARACTERISTIC
/begin COMPU_METHOD FT_input_cfg_COMPU_VTAB "Verbal Table" TAB_VERB "%.0" "list" COMPU_TAB_REF FT_input_cfg_COMPU_VTAB_REF /end COMPU_METHOD
/begin COMPU_VTAB FT_input_cfg_COMPU_VTAB_REF "Verbal Table" TAB_VERB 12 0x00 "Gnd=LP, Open=Gsln, +V=NG" 0x01 "Gnd=NG, Open=Gsln, +V=LP" 0x02 "Gnd/Open=Gsln, +V=LP" 0x03 "Gnd/Open=Gsln, +V=NG" 0x04 "Gasoline Only" 0x05 "LP Only" 0x06 "NG Only" 0x07 "Gnd/Open=LP, +V=NG" 0x08 "Gnd/Open=NG, +V=LP" 0x09 "Gnd=LP, Open=NG, +V=Gsln" 0x0A "Gnd=Gsln, Open/+V=LP" 0x0B "Gnd/Open=LP, +V=Gsln" DEFAULT_VALUE "UNKNOWN" /end COMPU_VTAB
/begin CHARACTERISTIC fuelrunout_ena "Fuel run-out feature{fuelrunout_ena&0xff=0x00:Disabled}{fuelrunout_ena&0xff=0x01:Enabled: LPG, NG}{fuelrunout_ena&0xff=0x02:Enabled: All Fuels}" VALUE 0x001c903d /* @ECU_Address@fuelrunout_ena@0x010016F8@ */ ECIPP_ALIGNMENT_UBYTE 255 fuelrunout_ena_COMPU_VTAB 0 255 BIT_MASK 0xff /end CHARACTERISTIC
/begin COMPU_METHOD fuelrunout_ena_COMPU_VTAB "Verbal Table" TAB_VERB "%.0" "list" COMPU_TAB_REF fuelrunout_ena_COMPU_VTAB_REF /end COMPU_METHOD
/begin COMPU_VTAB fuelrunout_ena_COMPU_VTAB_REF "Verbal Table" TAB_VERB 3 0x00 "Disabled" 0x01 "Enabled: LPG, NG" 0x02 "Enabled: All Fuels" DEFAULT_VALUE "UNKNOWN" /end COMPU_VTAB
/begin CHARACTERISTIC fuelrunout_max "Fuel run-out time limit" VALUE 0x001c8458 /* @ECU_Address@fuelrunout_max@0x01001700@ */ ECIPP_ALIGNMENT_UWORD 65535 Compu_fuelrunout_max 0 65535 /end CHARACTERISTIC
/begin COMPU_METHOD Compu_fuelrunout_max " " RAT_FUNC "%.0" "ms" COEFFS 0 1 0 0 0 1 /end COMPU_METHOD
/begin CHARACTERISTIC rev_lim_fuel "Fuel rev limit (Fault Condition:rpm >)" VALUE 0x001c84b8 /* @ECU_Address@rev_lim_fuel@0x010018C8@ */ ECIPP_ALIGNMENT_UWORD 65535 Compu_rev_lim_fuel 0 65535 /end CHARACTERISTIC
/begin COMPU_METHOD Compu_rev_lim_fuel " " RAT_FUNC "%.0" "rpm" COEFFS 0 1 0 0 0 1 /end COMPU_METHOD
/begin CHARACTERISTIC rev_lim_spk "Spark rev limit (Fault Condition:rpm >)" VALUE 0x001c84bc /* @ECU_Address@rev_lim_spk@0x010018D0@ */ ECIPP_ALIGNMENT_UWORD 65535 Compu_rev_lim_spk 0 65535 /end CHARACTERISTIC
/begin COMPU_METHOD Compu_rev_lim_spk " " RAT_FUNC "%.0" "rpm" COEFFS 0 1 0 0 0 1 /end COMPU_METHOD
/begin CHARACTERISTIC tri_fuel_lockoff "Tri-Fuel mode LOCKOFF output{tri_fuel_lockoff&0xff=0:LPG}{tri_fuel_lockoff&0xff=1:NG}" VALUE 0x001c908d /* @ECU_Address@tri_fuel_lockoff@0x01001B48@ */ ECIPP_ALIGNMENT_UBYTE 255 tri_fuel_lockoff_COMPU_VTAB 0 255 BIT_MASK 0xff /end CHARACTERISTIC
/begin COMPU_METHOD tri_fuel_lockoff_COMPU_VTAB "Verbal Table" TAB_VERB "%.0" "list" COMPU_TAB_REF tri_fuel_lockoff_COMPU_VTAB_REF /end COMPU_METHOD
/begin COMPU_VTAB tri_fuel_lockoff_COMPU_VTAB_REF "Verbal Table" TAB_VERB 2 0 "LPG" 1 "NG" DEFAULT_VALUE "UNKNOWN" /end COMPU_VTAB
/begin CHARACTERISTIC gagedrv_chan "ECT gauge driver channel{gagedrv_chan&0xff=0:Disabled}{gagedrv_chan&0xff=1:Not Available}{gagedrv_chan&0xff=2:Not Available}{gagedrv_chan&0xff=3:Aux PWM1}{gagedrv_chan&0xff=4:Aux PWM2}{gagedrv_chan&0xff=5:Aux PWM3}{gagedrv_chan&0xff=6:Aux PWM4}{gagedrv_ch" VALUE 0x001c903e /* @ECU_Address@gagedrv_chan@0x01001CC0@ */ ECIPP_ALIGNMENT_UBYTE 255 gagedrv_chan_COMPU_VTAB 0 255 BIT_MASK 0xff /end CHARACTERISTIC
/begin COMPU_METHOD gagedrv_chan_COMPU_VTAB "Verbal Table" TAB_VERB "%.0" "list" COMPU_TAB_REF gagedrv_chan_COMPU_VTAB_REF /end COMPU_METHOD
/begin COMPU_VTAB gagedrv_chan_COMPU_VTAB_REF "Verbal Table" TAB_VERB 8 0 "Disabled" 1 "Not Available" 2 "Not Available" 3 "Aux PWM1" 4 "Aux PWM2" 5 "Aux PWM3" 6 "Aux PWM4" 7 "Aux PWM5" DEFAULT_VALUE "UNKNOWN" /end COMPU_VTAB
/begin CHARACTERISTIC gagedrv_per "ECT gauge driver PWM period" VALUE 0x001c845a /* @ECU_Address@gagedrv_per@0x01001CC8@ */ ECIPP_ALIGNMENT_UWORD 210 Compu_gagedrv_per 0 209.712 /end CHARACTERISTIC
/begin COMPU_METHOD Compu_gagedrv_per " " RAT_FUNC "%.2" "ms" COEFFS 0 312.5 0 0 0 1 /end COMPU_METHOD
/begin MEASUREMENT gagedrv_DC "ECT gauge driver duty-cycle" UWORD Compu_gagedrv_DC 0 0 0 99.9984741210938 ECU_ADDRESS 0x01001CD0 /end MEASUREMENT
/begin COMPU_METHOD Compu_gagedrv_DC " " RAT_FUNC "%.1" "%" COEFFS 0 655.36 0 0 0 1 /end COMPU_METHOD
/begin MEASUREMENT gagedrv_manual "Gauge driver mode{gagedrv_manual&0xff=0:Automatic}{gagedrv_manual&0xff=1:Manual}" UBYTE gagedrv_manual_COMPU_VTAB 0 0 0 255 ECU_ADDRESS 0x01001CD8 BIT_MASK 0xff /end MEASUREMENT
/begin COMPU_METHOD gagedrv_manual_COMPU_VTAB "Verbal Table" TAB_VERB "%.0" "list" COMPU_TAB_REF gagedrv_manual_COMPU_VTAB_REF /end COMPU_METHOD
/begin COMPU_VTAB gagedrv_manual_COMPU_VTAB_REF "Verbal Table" TAB_VERB 2 0 "Automatic" 1 "Manual" DEFAULT_VALUE "UNKNOWN" /end COMPU_VTAB
/begin CHARACTERISTIC gas2gsln_slew "LPG/NG to gasoline slew-in" VALUE 0x001c8460 /* @ECU_Address@gas2gsln_slew@0x01001DF0@ */ ECIPP_ALIGNMENT_UWORD 65535 Compu_gas2gsln_slew 0 65535 /end CHARACTERISTIC
/begin COMPU_METHOD Compu_gas2gsln_slew " " RAT_FUNC "%.0" "ms" COEFFS 0 1 0 0 0 1 /end COMPU_METHOD
/begin MEASUREMENT FT_gsln_slew_att "Gasoline slew-in factor" UWORD Compu_FT_gsln_slew_att 0 0 0.00152587890625 100 ECU_ADDRESS 0x01001DF8 /end MEASUREMENT
/begin COMPU_METHOD Compu_FT_gsln_slew_att " " RAT_FUNC "%.0" "%" COEFFS 0 -655.36 65536 0 0 1 /end COMPU_METHOD
/begin CHARACTERISTIC GasCarb_trim_mode "Fuel trim mode{GasCarb_trim_mode&0xff=0:PWM Valve}{GasCarb_trim_mode&0xff=1:MJ/EPR}{GasCarb_trim_mode&0xff=2:Dual DEPR Dual Mixer}" VALUE 0x001c8755 /* @ECU_Address@GasCarb_trim_mode@0x010020A0@ */ ECIPP_ALIGNMENT_UBYTE 255 GasCarb_trim_mode_COMPU_VTAB 0 255 BIT_MASK 0xff /end CHARACTERISTIC
/begin COMPU_METHOD GasCarb_trim_mode_COMPU_VTAB "Verbal Table" TAB_VERB "%.0" "list" COMPU_TAB_REF GasCarb_trim_mode_COMPU_VTAB_REF /end COMPU_METHOD
/begin COMPU_VTAB GasCarb_trim_mode_COMPU_VTAB_REF "Verbal Table" TAB_VERB 3 0 "PWM Valve" 1 "MJ/EPR" 2 "Dual DEPR Dual Mixer" DEFAULT_VALUE "UNKNOWN" /end COMPU_VTAB
/begin MEASUREMENT AUX_PU2_raw "AUX_PU2_raw" UWORD Compu_AUX_PU2_raw 0 0 0 5.00114468864469 ECU_ADDRESS 0x01002700 /end MEASUREMENT
/begin COMPU_METHOD Compu_AUX_PU2_raw " " RAT_FUNC "%.3" "volts" COEFFS 0 13104 0 0 0 1 /end COMPU_METHOD
/begin MEASUREMENT AUX_PU3_raw "AUX_PU3_raw" UWORD Compu_AUX_PU3_raw 0 0 0 5.00114468864469 ECU_ADDRESS 0x01002708 /end MEASUREMENT
/begin COMPU_METHOD Compu_AUX_PU3_raw " " RAT_FUNC "%.3" "volts" COEFFS 0 13104 0 0 0 1 /end COMPU_METHOD
/begin MEASUREMENT AUX_PD2_raw "AUX_PD2_raw" UWORD Compu_AUX_PD2_raw 0 0 0 5.00114468864469 ECU_ADDRESS 0x01002710 /end MEASUREMENT
/begin COMPU_METHOD Compu_AUX_PD2_raw " " RAT_FUNC "%.3" "volts" COEFFS 0 13104 0 0 0 1 /end COMPU_METHOD
/begin MEASUREMENT AUX_PD3_raw "AUX_PD3_raw" UWORD Compu_AUX_PD3_raw 0 0 0 5.00114468864469 ECU_ADDRESS 0x01002718 /end MEASUREMENT
/begin COMPU_METHOD Compu_AUX_PD3_raw " " RAT_FUNC "%.3" "volts" COEFFS 0 13104 0 0 0 1 /end COMPU_METHOD
/begin MEASUREMENT AUX_PUD1_raw "AUX_PUD1_raw" UWORD Compu_AUX_PUD1_raw 0 0 0 5.00114468864469 ECU_ADDRESS 0x01002E18 /end MEASUREMENT
/begin COMPU_METHOD Compu_AUX_PUD1_raw " " RAT_FUNC "%.3" "volts" COEFFS 0 13104 0 0 0 1 /end COMPU_METHOD
/begin MEASUREMENT AUX_PUD2_raw "AUX_PUD2_raw" UWORD Compu_AUX_PUD2_raw 0 0 0 5.00114468864469 ECU_ADDRESS 0x01002E20 /end MEASUREMENT
/begin COMPU_METHOD Compu_AUX_PUD2_raw " " RAT_FUNC "%.3" "volts" COEFFS 0 13104 0 0 0 1 /end COMPU_METHOD
/begin MEASUREMENT AUX_PUD3_raw "AUX_PUD3_raw" UWORD Compu_AUX_PUD3_raw 0 0 0 5.00114468864469 ECU_ADDRESS 0x01002E28 /end MEASUREMENT
/begin COMPU_METHOD Compu_AUX_PUD3_raw " " RAT_FUNC "%.3" "volts" COEFFS 0 13104 0 0 0 1 /end COMPU_METHOD
/begin CHARACTERISTIC ECTgd_ctl_type "ECT gauge driver control type{ECTgd_ctl_type&0xff=0:Duty-cycle PWM}{ECTgd_ctl_type&0xff=1:Resistance Simulation}" VALUE 0x001c86ce /* @ECU_Address@ECTgd_ctl_type@0x01002F70@ */ ECIPP_ALIGNMENT_UBYTE 255 ECTgd_ctl_type_COMPU_VTAB 0 255 BIT_MASK 0xff /end CHARACTERISTIC
/begin COMPU_METHOD ECTgd_ctl_type_COMPU_VTAB "Verbal Table" TAB_VERB "%.0" "list" COMPU_TAB_REF ECTgd_ctl_type_COMPU_VTAB_REF /end COMPU_METHOD
/begin COMPU_VTAB ECTgd_ctl_type_COMPU_VTAB_REF "Verbal Table" TAB_VERB 2 0 "Duty-cycle PWM" 1 "Resistance Simulation" DEFAULT_VALUE "UNKNOWN" /end COMPU_VTAB
/begin CHARACTERISTIC ECTgd_Rpu_tau "ECT gauge resistance ctrl tau" VALUE 0x001c852a /* @ECU_Address@ECTgd_Rpu_tau@0x01002F78@ */ ECIPP_ALIGNMENT_UWORD 3276795 Compu_ECTgd_Rpu_tau 4.5084 3276800 /end CHARACTERISTIC
/begin COMPU_METHOD Compu_ECTgd_Rpu_tau " " FORM "%.0" "ms"
 /begin FORMULA "-50 / log(1 - (X1 / 65536))" FORMULA_INV "(1 - exp(-50/X1)) * 65536" /end FORMULA
/end COMPU_METHOD
/begin CHARACTERISTIC Vsw_gauge_tau "Gauge excitation voltage low-pass" VALUE 0x001c8646 /* @ECU_Address@Vsw_gauge_tau@0x01002F80@ */ ECIPP_ALIGNMENT_UWORD 327680 Compu_Vsw_gauge_tau 0.45084 327680 /end CHARACTERISTIC
/begin COMPU_METHOD Compu_Vsw_gauge_tau " " FORM "%.0" "ms"
 /begin FORMULA "-5 / log(1 - (X1 / 65536))" FORMULA_INV "(1 - exp(-5/X1)) * 65536" /end FORMULA
/end COMPU_METHOD
/begin CHARACTERISTIC ECTgd_Rpu_def "ECT gauge driver initial pullup R" VALUE 0x001c6eb6 /* @ECU_Address@ECTgd_Rpu_def@0x01002F88@ */ ECIPP_ALIGNMENT_UWORD 8192 Compu_ECTgd_Rpu_def 0 8191.875 /end CHARACTERISTIC
/begin COMPU_METHOD Compu_ECTgd_Rpu_def " " RAT_FUNC "%.1" "ohms" COEFFS 0 8 0 0 0 1 /end COMPU_METHOD
/begin MEASUREMENT ECTgd_Rpu "ECT gauge pullup R estimate" UWORD Compu_ECTgd_Rpu 0 0 0 8191.875 ECU_ADDRESS 0x01002F90 /end MEASUREMENT
/begin COMPU_METHOD Compu_ECTgd_Rpu " " RAT_FUNC "%.1" "ohms" COEFFS 0 8 0 0 0 1 /end COMPU_METHOD
/begin MEASUREMENT ECTgd_Rd "ECT gauge sender target R" UWORD Compu_ECTgd_Rd 0 0 0 8191.875 ECU_ADDRESS 0x01002F98 /end MEASUREMENT
/begin COMPU_METHOD Compu_ECTgd_Rd " " RAT_FUNC "%.1" "ohms" COEFFS 0 8 0 0 0 1 /end COMPU_METHOD
/begin MEASUREMENT ECTgd_Ra "ECT gauge sender actual R" UWORD Compu_ECTgd_Ra 0 0 0 8191.875 ECU_ADDRESS 0x01002FA0 /end MEASUREMENT
/begin COMPU_METHOD Compu_ECTgd_Ra " " RAT_FUNC "%.1" "ohms" COEFFS 0 8 0 0 0 1 /end COMPU_METHOD
/begin MEASUREMENT ECTgd_V_FB "ECT gauge sender voltage" UWORD Compu_ECTgd_V_FB 0 0 0 255.99609375 ECU_ADDRESS 0x01002FA8 /end MEASUREMENT
/begin COMPU_METHOD Compu_ECTgd_V_FB " " RAT_FUNC "%.2" "volts" COEFFS 0 256 0 0 0 1 /end COMPU_METHOD
/begin MEASUREMENT Vsw_gauge "Gauge excitation voltage estimate" UWORD Compu_Vsw_gauge 0 0 0 255.99609375 ECU_ADDRESS 0x01002FB0 /end MEASUREMENT
/begin COMPU_METHOD Compu_Vsw_gauge " " RAT_FUNC "%.2" "volts" COEFFS 0 256 0 0 0 1 /end COMPU_METHOD
/begin MEASUREMENT ECTgd_Id "ECT gauge driver current" UWORD Compu_ECTgd_Id 0 0 0 499.992370605469 ECU_ADDRESS 0x01002FB8 /end MEASUREMENT
/begin COMPU_METHOD Compu_ECTgd_Id " " RAT_FUNC "%.1" "mA" COEFFS 0 131.072 0 0 0 1 /end COMPU_METHOD
/begin CHARACTERISTIC OilPgd_ctl_type "OilP gauge driver control type{OilPgd_ctl_type&0xff=0:Duty-cycle PWM}{OilPgd_ctl_type&0xff=1:Resistance Simulation}" VALUE 0x001c8871 /* @ECU_Address@OilPgd_ctl_type@0x01002FC0@ */ ECIPP_ALIGNMENT_UBYTE 255 OilPgd_ctl_type_COMPU_VTAB 0 255 BIT_MASK 0xff /end CHARACTERISTIC
/begin COMPU_METHOD OilPgd_ctl_type_COMPU_VTAB "Verbal Table" TAB_VERB "%.0" "list" COMPU_TAB_REF OilPgd_ctl_type_COMPU_VTAB_REF /end COMPU_METHOD
/begin COMPU_VTAB OilPgd_ctl_type_COMPU_VTAB_REF "Verbal Table" TAB_VERB 2 0 "Duty-cycle PWM" 1 "Resistance Simulation" DEFAULT_VALUE "UNKNOWN" /end COMPU_VTAB
/begin CHARACTERISTIC OilPgd_Rpu_tau "OilP gauge resistance ctrl tau" VALUE 0x001c8584 /* @ECU_Address@OilPgd_Rpu_tau@0x01002FC8@ */ ECIPP_ALIGNMENT_UWORD 3276795 Compu_OilPgd_Rpu_tau 4.5084 3276800 /end CHARACTERISTIC
/begin COMPU_METHOD Compu_OilPgd_Rpu_tau " " FORM "%.0" "ms"
 /begin FORMULA "-50 / log(1 - (X1 / 65536))" FORMULA_INV "(1 - exp(-50/X1)) * 65536" /end FORMULA
/end COMPU_METHOD
/begin CHARACTERISTIC OilPgd_Rpu_def "OilP gauge driver initial pullup R" VALUE 0x001c7e36 /* @ECU_Address@OilPgd_Rpu_def@0x01002FD0@ */ ECIPP_ALIGNMENT_UWORD 8192 Compu_OilPgd_Rpu_def 0 8191.875 /end CHARACTERISTIC
/begin COMPU_METHOD Compu_OilPgd_Rpu_def " " RAT_FUNC "%.1" "ohms" COEFFS 0 8 0 0 0 1 /end COMPU_METHOD
/begin MEASUREMENT OilPgd_Rpu "OilP gauge pullup R estimate" UWORD Compu_OilPgd_Rpu 0 0 0 8191.875 ECU_ADDRESS 0x01002FD8 /end MEASUREMENT
/begin COMPU_METHOD Compu_OilPgd_Rpu " " RAT_FUNC "%.1" "ohms" COEFFS 0 8 0 0 0 1 /end COMPU_METHOD
/begin MEASUREMENT OilPgd_Rd "OilP gauge sender target R" UWORD Compu_OilPgd_Rd 0 0 0 8191.875 ECU_ADDRESS 0x01002FE0 /end MEASUREMENT
/begin COMPU_METHOD Compu_OilPgd_Rd " " RAT_FUNC "%.1" "ohms" COEFFS 0 8 0 0 0 1 /end COMPU_METHOD
/begin MEASUREMENT OilPgd_Ra "OilP gauge sender actual R" UWORD Compu_OilPgd_Ra 0 0 0 8191.875 ECU_ADDRESS 0x01002FE8 /end MEASUREMENT
/begin COMPU_METHOD Compu_OilPgd_Ra " " RAT_FUNC "%.1" "ohms" COEFFS 0 8 0 0 0 1 /end COMPU_METHOD
/begin MEASUREMENT OilPgd_V_FB "OilP gauge sender voltage" UWORD Compu_OilPgd_V_FB 0 0 0 255.99609375 ECU_ADDRESS 0x01002FF0 /end MEASUREMENT
/begin COMPU_METHOD Compu_OilPgd_V_FB " " RAT_FUNC "%.2" "volts" COEFFS 0 256 0 0 0 1 /end COMPU_METHOD
/begin MEASUREMENT OilPgd_Id "OilP gauge driver current" UWORD Compu_OilPgd_Id 0 0 0 499.992370605469 ECU_ADDRESS 0x01002FF8 /end MEASUREMENT
/begin COMPU_METHOD Compu_OilPgd_Id " " RAT_FUNC "%.1" "mA" COEFFS 0 131.072 0 0 0 1 /end COMPU_METHOD
/begin CHARACTERISTIC OilPgd_chan "OilP gauge driver channel{OilPgd_chan&0xff=0:Disabled}{OilPgd_chan&0xff=1:Not Available}{OilPgd_chan&0xff=2:Not Available}{OilPgd_chan&0xff=3:Aux PWM1}{OilPgd_chan&0xff=4:Aux PWM2}{OilPgd_chan&0xff=5:Aux PWM3}{OilPgd_chan&0xff=6:Aux PWM4}{OilPgd_chan&0xff" VALUE 0x001c8870 /* @ECU_Address@OilPgd_chan@0x01003000@ */ ECIPP_ALIGNMENT_UBYTE 255 OilPgd_chan_COMPU_VTAB 0 255 BIT_MASK 0xff /end CHARACTERISTIC
/begin COMPU_METHOD OilPgd_chan_COMPU_VTAB "Verbal Table" TAB_VERB "%.0" "list" COMPU_TAB_REF OilPgd_chan_COMPU_VTAB_REF /end COMPU_METHOD
/begin COMPU_VTAB OilPgd_chan_COMPU_VTAB_REF "Verbal Table" TAB_VERB 8 0 "Disabled" 1 "Not Available" 2 "Not Available" 3 "Aux PWM1" 4 "Aux PWM2" 5 "Aux PWM3" 6 "Aux PWM4" 7 "Aux PWM5" DEFAULT_VALUE "UNKNOWN" /end COMPU_VTAB
/begin CHARACTERISTIC OilPgd_per "OilP gauge driver PWM period" VALUE 0x001c7e3c /* @ECU_Address@OilPgd_per@0x01003008@ */ ECIPP_ALIGNMENT_UWORD 210 Compu_OilPgd_per 0 209.712 /end CHARACTERISTIC
/begin COMPU_METHOD Compu_OilPgd_per " " RAT_FUNC "%.2" "ms" COEFFS 0 312.5 0 0 0 1 /end COMPU_METHOD
/begin MEASUREMENT OilPgd_DC "OilP gauge driver duty-cycle" UWORD Compu_OilPgd_DC 0 0 0 99.9984741210938 ECU_ADDRESS 0x01003010 /end MEASUREMENT
/begin COMPU_METHOD Compu_OilPgd_DC " " RAT_FUNC "%.1" "%" COEFFS 0 655.36 0 0 0 1 /end COMPU_METHOD
/begin CHARACTERISTIC V1gd_ctl_type "Volt1 gauge driver control type{V1gd_ctl_type&0xff=0:Duty-cycle PWM}{V1gd_ctl_type&0xff=1:Resistance Simulation}" VALUE 0x001c8f85 /* @ECU_Address@V1gd_ctl_type@0x01003018@ */ ECIPP_ALIGNMENT_UBYTE 255 V1gd_ctl_type_COMPU_VTAB 0 255 BIT_MASK 0xff /end CHARACTERISTIC
/begin COMPU_METHOD V1gd_ctl_type_COMPU_VTAB "Verbal Table" TAB_VERB "%.0" "list" COMPU_TAB_REF V1gd_ctl_type_COMPU_VTAB_REF /end COMPU_METHOD
/begin COMPU_VTAB V1gd_ctl_type_COMPU_VTAB_REF "Verbal Table" TAB_VERB 2 0 "Duty-cycle PWM" 1 "Resistance Simulation" DEFAULT_VALUE "UNKNOWN" /end COMPU_VTAB
/begin CHARACTERISTIC V1gd_Rpu_tau "Volt1 gauge resistance ctrl tau" VALUE 0x001c863c /* @ECU_Address@V1gd_Rpu_tau@0x01003020@ */ ECIPP_ALIGNMENT_UWORD 3276795 Compu_V1gd_Rpu_tau 4.5084 3276800 /end CHARACTERISTIC
/begin COMPU_METHOD Compu_V1gd_Rpu_tau " " FORM "%.0" "ms"
 /begin FORMULA "-50 / log(1 - (X1 / 65536))" FORMULA_INV "(1 - exp(-50/X1)) * 65536" /end FORMULA
/end COMPU_METHOD
/begin CHARACTERISTIC V1gd_Rpu_def "Volt1 gauge driver initial pullup R" VALUE 0x001c831e /* @ECU_Address@V1gd_Rpu_def@0x01003028@ */ ECIPP_ALIGNMENT_UWORD 8192 Compu_V1gd_Rpu_def 0 8191.875 /end CHARACTERISTIC
/begin COMPU_METHOD Compu_V1gd_Rpu_def " " RAT_FUNC "%.1" "ohms" COEFFS 0 8 0 0 0 1 /end COMPU_METHOD
/begin MEASUREMENT V1gd_Rpu "Volt1 gauge pullup R estimate" UWORD Compu_V1gd_Rpu 0 0 0 8191.875 ECU_ADDRESS 0x01003030 /end MEASUREMENT
/begin COMPU_METHOD Compu_V1gd_Rpu " " RAT_FUNC "%.1" "ohms" COEFFS 0 8 0 0 0 1 /end COMPU_METHOD
/begin MEASUREMENT V1gd_Rd "Volt1 gauge sender target R" UWORD Compu_V1gd_Rd 0 0 0 8191.875 ECU_ADDRESS 0x01003038 /end MEASUREMENT
/begin COMPU_METHOD Compu_V1gd_Rd " " RAT_FUNC "%.1" "ohms" COEFFS 0 8 0 0 0 1 /end COMPU_METHOD
/begin MEASUREMENT V1gd_Ra "Volt1 gauge sender actual R" UWORD Compu_V1gd_Ra 0 0 0 8191.875 ECU_ADDRESS 0x01003040 /end MEASUREMENT
/begin COMPU_METHOD Compu_V1gd_Ra " " RAT_FUNC "%.1" "ohms" COEFFS 0 8 0 0 0 1 /end COMPU_METHOD
/begin MEASUREMENT V1gd_V_FB "Volt1 gauge sender voltage" UWORD Compu_V1gd_V_FB 0 0 0 255.99609375 ECU_ADDRESS 0x01003048 /end MEASUREMENT
/begin COMPU_METHOD Compu_V1gd_V_FB " " RAT_FUNC "%.2" "volts" COEFFS 0 256 0 0 0 1 /end COMPU_METHOD
/begin MEASUREMENT V1gd_Id "Volt1 gauge driver current" UWORD Compu_V1gd_Id 0 0 0 499.992370605469 ECU_ADDRESS 0x01003050 /end MEASUREMENT
/begin COMPU_METHOD Compu_V1gd_Id " " RAT_FUNC "%.1" "mA" COEFFS 0 131.072 0 0 0 1 /end COMPU_METHOD
/begin CHARACTERISTIC V1gd_chan "Volt1 gauge driver channel{V1gd_chan&0xff=0:Disabled}{V1gd_chan&0xff=1:Not Available}{V1gd_chan&0xff=2:Not Available}{V1gd_chan&0xff=3:Aux PWM1}{V1gd_chan&0xff=4:Aux PWM2}{V1gd_chan&0xff=5:Aux PWM3}{V1gd_chan&0xff=6:Aux PWM4}{V1gd_chan&0xff=7:Aux PWM5}" VALUE 0x001c8f84 /* @ECU_Address@V1gd_chan@0x01003058@ */ ECIPP_ALIGNMENT_UBYTE 255 V1gd_chan_COMPU_VTAB 0 255 BIT_MASK 0xff /end CHARACTERISTIC
/begin COMPU_METHOD V1gd_chan_COMPU_VTAB "Verbal Table" TAB_VERB "%.0" "list" COMPU_TAB_REF V1gd_chan_COMPU_VTAB_REF /end COMPU_METHOD
/begin COMPU_VTAB V1gd_chan_COMPU_VTAB_REF "Verbal Table" TAB_VERB 8 0 "Disabled" 1 "Not Available" 2 "Not Available" 3 "Aux PWM1" 4 "Aux PWM2" 5 "Aux PWM3" 6 "Aux PWM4" 7 "Aux PWM5" DEFAULT_VALUE "UNKNOWN" /end COMPU_VTAB
/begin CHARACTERISTIC V1gd_per "Volt1 gauge driver PWM period" VALUE 0x001c8324 /* @ECU_Address@V1gd_per@0x01003060@ */ ECIPP_ALIGNMENT_UWORD 210 Compu_V1gd_per 0 209.712 /end CHARACTERISTIC
/begin COMPU_METHOD Compu_V1gd_per " " RAT_FUNC "%.2" "ms" COEFFS 0 312.5 0 0 0 1 /end COMPU_METHOD
/begin MEASUREMENT V1gd_DC "Volt1 gauge driver duty-cycle" UWORD Compu_V1gd_DC 0 0 0 99.9984741210938 ECU_ADDRESS 0x01003068 /end MEASUREMENT
/begin COMPU_METHOD Compu_V1gd_DC " " RAT_FUNC "%.1" "%" COEFFS 0 655.36 0 0 0 1 /end COMPU_METHOD
/begin MEASUREMENT V1gd_volts "Volt1 gauge driver source signal" UWORD Compu_V1gd_volts 0 0 0 255.99609375 ECU_ADDRESS 0x01003070 /end MEASUREMENT
/begin COMPU_METHOD Compu_V1gd_volts " " RAT_FUNC "%.2" "volts" COEFFS 0 256 0 0 0 1 /end COMPU_METHOD
/begin CHARACTERISTIC V1gd_input_chan "Volt1 gauge driver input source{V1gd_input_chan&0xff=0:Aux PU1}{V1gd_input_chan&0xff=1:Aux PU2}{V1gd_input_chan&0xff=2:Aux PU3}{V1gd_input_chan&0xff=3:Aux PD1}{V1gd_input_chan&0xff=4:Aux PD2}{V1gd_input_chan&0xff=5:Aux PD3}{V1gd_input_chan&0xff=6:Aux PUD1" VALUE 0x001c8f87 /* @ECU_Address@V1gd_input_chan@0x01003078@ */ ECIPP_ALIGNMENT_UBYTE 255 V1gd_input_chan_COMPU_VTAB 0 255 BIT_MASK 0xff /end CHARACTERISTIC
/begin COMPU_METHOD V1gd_input_chan_COMPU_VTAB "Verbal Table" TAB_VERB "%.0" "list" COMPU_TAB_REF V1gd_input_chan_COMPU_VTAB_REF /end COMPU_METHOD
/begin COMPU_VTAB V1gd_input_chan_COMPU_VTAB_REF "Verbal Table" TAB_VERB 10 0 "Aux PU1" 1 "Aux PU2" 2 "Aux PU3" 3 "Aux PD1" 4 "Aux PD2" 5 "Aux PD3" 6 "Aux PUD1" 7 "Aux PUD2" 8 "Aux PUD3" 9 "Network Percent Rx" DEFAULT_VALUE "UNKNOWN" /end COMPU_VTAB
/begin CHARACTERISTIC ECTgd_Vexc_reg "ECT gauge excitation regulation" VALUE 0x001c6eba /* @ECU_Address@ECTgd_Vexc_reg@0x01003080@ */ ECIPP_ALIGNMENT_UWORD 256 Compu_ECTgd_Vexc_reg 0 255.99609375 /end CHARACTERISTIC
/begin COMPU_METHOD Compu_ECTgd_Vexc_reg " " RAT_FUNC "%.2" "volts" COEFFS 0 256 0 0 0 1 /end COMPU_METHOD
/begin CHARACTERISTIC OilPgd_Vexc_reg "OilP gauge excitation regulation" VALUE 0x001c7e3a /* @ECU_Address@OilPgd_Vexc_reg@0x01003088@ */ ECIPP_ALIGNMENT_UWORD 256 Compu_OilPgd_Vexc_reg 0 255.99609375 /end CHARACTERISTIC
/begin COMPU_METHOD Compu_OilPgd_Vexc_reg " " RAT_FUNC "%.2" "volts" COEFFS 0 256 0 0 0 1 /end COMPU_METHOD
/begin CHARACTERISTIC V1gd_Vexc_reg "Volt1 gauge excitation regulation" VALUE 0x001c8322 /* @ECU_Address@V1gd_Vexc_reg@0x01003090@ */ ECIPP_ALIGNMENT_UWORD 256 Compu_V1gd_Vexc_reg 0 255.99609375 /end CHARACTERISTIC
/begin COMPU_METHOD Compu_V1gd_Vexc_reg " " RAT_FUNC "%.2" "volts" COEFFS 0 256 0 0 0 1 /end COMPU_METHOD
/begin CHARACTERISTIC ECTgd_Vexc_ratio "ECT gauge excitation ratio" VALUE 0x001c6eb8 /* @ECU_Address@ECTgd_Vexc_ratio@0x01003098@ */ ECIPP_ALIGNMENT_UWORD 1 Compu_ECTgd_Vexc_ratio 0 0.999984741210938 /end CHARACTERISTIC
/begin COMPU_METHOD Compu_ECTgd_Vexc_ratio " " RAT_FUNC "%.3" "ratio" COEFFS 0 65536 0 0 0 1 /end COMPU_METHOD
/begin CHARACTERISTIC OilPgd_Vexc_ratio "OilP gauge excitation ratio" VALUE 0x001c7e38 /* @ECU_Address@OilPgd_Vexc_ratio@0x010030A0@ */ ECIPP_ALIGNMENT_UWORD 1 Compu_OilPgd_Vexc_ratio 0 0.999984741210938 /end CHARACTERISTIC
/begin COMPU_METHOD Compu_OilPgd_Vexc_ratio " " RAT_FUNC "%.3" "ratio" COEFFS 0 65536 0 0 0 1 /end COMPU_METHOD
/begin CHARACTERISTIC V1gd_Vexc_ratio "Volt1 gauge excitation ratio" VALUE 0x001c8320 /* @ECU_Address@V1gd_Vexc_ratio@0x010030A8@ */ ECIPP_ALIGNMENT_UWORD 1 Compu_V1gd_Vexc_ratio 0 0.999984741210938 /end CHARACTERISTIC
/begin COMPU_METHOD Compu_V1gd_Vexc_ratio " " RAT_FUNC "%.3" "ratio" COEFFS 0 65536 0 0 0 1 /end COMPU_METHOD
/begin CHARACTERISTIC ECT_gauge_sync "ECT muti-engine gauge sync{ECT_gauge_sync&0xff=0:Disabled}{ECT_gauge_sync&0xff=1:Enabled}" VALUE 0x001c86cc /* @ECU_Address@ECT_gauge_sync@0x010036C8@ */ ECIPP_ALIGNMENT_UBYTE 255 ECT_gauge_sync_COMPU_VTAB 0 255 BIT_MASK 0xff /end CHARACTERISTIC
/begin COMPU_METHOD ECT_gauge_sync_COMPU_VTAB "Verbal Table" TAB_VERB "%.0" "list" COMPU_TAB_REF ECT_gauge_sync_COMPU_VTAB_REF /end COMPU_METHOD
/begin COMPU_VTAB ECT_gauge_sync_COMPU_VTAB_REF "Verbal Table" TAB_VERB 2 0 "Disabled" 1 "Enabled" DEFAULT_VALUE "UNKNOWN" /end COMPU_VTAB
/begin CHARACTERISTIC OILP_gauge_sync "OilP muti-engine gauge sync{OILP_gauge_sync&0xff=0:Disabled}{OILP_gauge_sync&0xff=1:Enabled}" VALUE 0x001c8862 /* @ECU_Address@OILP_gauge_sync@0x010036D0@ */ ECIPP_ALIGNMENT_UBYTE 255 OILP_gauge_sync_COMPU_VTAB 0 255 BIT_MASK 0xff /end CHARACTERISTIC
/begin COMPU_METHOD OILP_gauge_sync_COMPU_VTAB "Verbal Table" TAB_VERB "%.0" "list" COMPU_TAB_REF OILP_gauge_sync_COMPU_VTAB_REF /end COMPU_METHOD
/begin COMPU_VTAB OILP_gauge_sync_COMPU_VTAB_REF "Verbal Table" TAB_VERB 2 0 "Disabled" 1 "Enabled" DEFAULT_VALUE "UNKNOWN" /end COMPU_VTAB
/begin CHARACTERISTIC OILP_gauge_dz "OilP gauge sync deadband" VALUE 0x001c457a /* @ECU_Address@OILP_gauge_dz@0x010036D8@ */ ECIPP_ALIGNMENT_SWORD 256 Compu_OILP_gauge_dz -256 255.9921875 /end CHARACTERISTIC
/begin COMPU_METHOD Compu_OILP_gauge_dz " " RAT_FUNC "%.1" "psig" COEFFS 0 128 0 0 0 1 /end COMPU_METHOD
/begin CHARACTERISTIC ECT_gauge_dz "ECT gauge sync deadband" VALUE 0x001c44a0 /* @ECU_Address@ECT_gauge_dz@0x010036E0@ */ ECIPP_ALIGNMENT_SWORD 1024 Compu_ECT_gauge_dz -1024 1023.96875 /end CHARACTERISTIC
/begin COMPU_METHOD Compu_ECT_gauge_dz " " RAT_FUNC "%.0" "deg F" COEFFS 0 32 0 0 0 1 /end COMPU_METHOD
/begin MEASUREMENT ECT_gauge_value "ECT gauge sync'd display value" UWORD Compu_ECT_gauge_value 0 0 -460 563.984375 ECU_ADDRESS 0x010036F0 /end MEASUREMENT
/begin COMPU_METHOD Compu_ECT_gauge_value " " RAT_FUNC "%.0" "deg F" COEFFS 0 64 29440 0 0 1 /end COMPU_METHOD
/begin MEASUREMENT OILP_gauge_value "OilP gauge sync'd display value" UWORD Compu_OILP_gauge_value 0 0 0 255.99609375 ECU_ADDRESS 0x010036F8 /end MEASUREMENT
/begin COMPU_METHOD Compu_OILP_gauge_value " " RAT_FUNC "%.0" "psig" COEFFS 0 256 0 0 0 1 /end COMPU_METHOD
/begin CHARACTERISTIC ECT_gauge_DHena "ECT gauge dual-helm sender{ECT_gauge_DHena&0xff=0:Disabled}{ECT_gauge_DHena&0xff=1:Enabled}{ECT_gauge_DHena&0xff=2:Aux PU1}{ECT_gauge_DHena&0xff=3:Aux PU2}{ECT_gauge_DHena&0xff=4:Aux PU3}{ECT_gauge_DHena&0xff=5:Aux PUD1}{ECT_gauge_DHena&0xff=6:Aux PUD2}{E" VALUE 0x001c86cb /* @ECU_Address@ECT_gauge_DHena@0x010037A8@ */ ECIPP_ALIGNMENT_UBYTE 255 ECT_gauge_DHena_COMPU_VTAB 0 255 BIT_MASK 0xff /end CHARACTERISTIC
/begin COMPU_METHOD ECT_gauge_DHena_COMPU_VTAB "Verbal Table" TAB_VERB "%.0" "list" COMPU_TAB_REF ECT_gauge_DHena_COMPU_VTAB_REF /end COMPU_METHOD
/begin COMPU_VTAB ECT_gauge_DHena_COMPU_VTAB_REF "Verbal Table" TAB_VERB 11 0 "Disabled" 1 "Enabled" 2 "Aux PU1" 3 "Aux PU2" 4 "Aux PU3" 5 "Aux PUD1" 6 "Aux PUD2" 7 "Aux PUD3" 8 "Aux DIG1" 9 "Aux DIG2" 10 "Aux DIG3" DEFAULT_VALUE "UNKNOWN" /end COMPU_VTAB
/begin CHARACTERISTIC OILP_gauge_DHena "OilP dual-helm gauge sender{OILP_gauge_DHena&0xff=0:Disabled}{OILP_gauge_DHena&0xff=1:Enabled}{OILP_gauge_DHena&0xff=2:Aux PU1}{OILP_gauge_DHena&0xff=3:Aux PU2}{OILP_gauge_DHena&0xff=4:Aux PU3}{OILP_gauge_DHena&0xff=5:Aux PUD1}{OILP_gauge_DHena&0xff=6:Aux" VALUE 0x001c8861 /* @ECU_Address@OILP_gauge_DHena@0x010037B0@ */ ECIPP_ALIGNMENT_UBYTE 255 OILP_gauge_DHena_COMPU_VTAB 0 255 BIT_MASK 0xff /end CHARACTERISTIC
/begin COMPU_METHOD OILP_gauge_DHena_COMPU_VTAB "Verbal Table" TAB_VERB "%.0" "list" COMPU_TAB_REF OILP_gauge_DHena_COMPU_VTAB_REF /end COMPU_METHOD
/begin COMPU_VTAB OILP_gauge_DHena_COMPU_VTAB_REF "Verbal Table" TAB_VERB 11 0 "Disabled" 1 "Enabled" 2 "Aux PU1" 3 "Aux PU2" 4 "Aux PU3" 5 "Aux PUD1" 6 "Aux PUD2" 7 "Aux PUD3" 8 "Aux DIG1" 9 "Aux DIG2" 10 "Aux DIG3" DEFAULT_VALUE "UNKNOWN" /end COMPU_VTAB
/begin CHARACTERISTIC V1gd_gauge_DHena "Volt1 dual-helm gauge sender{V1gd_gauge_DHena&0xff=0:Disabled}{V1gd_gauge_DHena&0xff=1:Enabled}{V1gd_gauge_DHena&0xff=2:Aux PU1}{V1gd_gauge_DHena&0xff=3:Aux PU2}{V1gd_gauge_DHena&0xff=4:Aux PU3}{V1gd_gauge_DHena&0xff=5:Aux PUD1}{V1gd_gauge_DHena&0xff=6:Au" VALUE 0x001c8f86 /* @ECU_Address@V1gd_gauge_DHena@0x010037B8@ */ ECIPP_ALIGNMENT_UBYTE 255 V1gd_gauge_DHena_COMPU_VTAB 0 255 BIT_MASK 0xff /end CHARACTERISTIC
/begin COMPU_METHOD V1gd_gauge_DHena_COMPU_VTAB "Verbal Table" TAB_VERB "%.0" "list" COMPU_TAB_REF V1gd_gauge_DHena_COMPU_VTAB_REF /end COMPU_METHOD
/begin COMPU_VTAB V1gd_gauge_DHena_COMPU_VTAB_REF "Verbal Table" TAB_VERB 11 0 "Disabled" 1 "Enabled" 2 "Aux PU1" 3 "Aux PU2" 4 "Aux PU3" 5 "Aux PUD1" 6 "Aux PUD2" 7 "Aux PUD3" 8 "Aux DIG1" 9 "Aux DIG2" 10 "Aux DIG3" DEFAULT_VALUE "UNKNOWN" /end COMPU_VTAB
/begin MEASUREMENT ECT_gauge_DHstat "ECT gauge single/dual-helm status{ECT_gauge_DHstat&0xff=0:Single-Helm}{ECT_gauge_DHstat&0xff=1:Dual-Helm}" UBYTE ECT_gauge_DHstat_COMPU_VTAB 0 0 0 255 ECU_ADDRESS 0x01003808 BIT_MASK 0xff /end MEASUREMENT
/begin COMPU_METHOD ECT_gauge_DHstat_COMPU_VTAB "Verbal Table" TAB_VERB "%.0" "list" COMPU_TAB_REF ECT_gauge_DHstat_COMPU_VTAB_REF /end COMPU_METHOD
/begin COMPU_VTAB ECT_gauge_DHstat_COMPU_VTAB_REF "Verbal Table" TAB_VERB 2 0 "Single-Helm" 1 "Dual-Helm" DEFAULT_VALUE "UNKNOWN" /end COMPU_VTAB
/begin MEASUREMENT OILP_gauge_DHstat "OilP gauge single/dual-helm status{OILP_gauge_DHstat&0xff=0:Single-Helm}{OILP_gauge_DHstat&0xff=1:Dual-Helm}" UBYTE OILP_gauge_DHstat_COMPU_VTAB 0 0 0 255 ECU_ADDRESS 0x01003810 BIT_MASK 0xff /end MEASUREMENT
/begin COMPU_METHOD OILP_gauge_DHstat_COMPU_VTAB "Verbal Table" TAB_VERB "%.0" "list" COMPU_TAB_REF OILP_gauge_DHstat_COMPU_VTAB_REF /end COMPU_METHOD
/begin COMPU_VTAB OILP_gauge_DHstat_COMPU_VTAB_REF "Verbal Table" TAB_VERB 2 0 "Single-Helm" 1 "Dual-Helm" DEFAULT_VALUE "UNKNOWN" /end COMPU_VTAB
/begin MEASUREMENT V1gd_gauge_DHstat "Volt1 gauge single/dual-helm status{V1gd_gauge_DHstat&0xff=0:Single-Helm}{V1gd_gauge_DHstat&0xff=1:Dual-Helm}" UBYTE V1gd_gauge_DHstat_COMPU_VTAB 0 0 0 255 ECU_ADDRESS 0x01003818 BIT_MASK 0xff /end MEASUREMENT
/begin COMPU_METHOD V1gd_gauge_DHstat_COMPU_VTAB "Verbal Table" TAB_VERB "%.0" "list" COMPU_TAB_REF V1gd_gauge_DHstat_COMPU_VTAB_REF /end COMPU_METHOD
/begin COMPU_VTAB V1gd_gauge_DHstat_COMPU_VTAB_REF "Verbal Table" TAB_VERB 2 0 "Single-Helm" 1 "Dual-Helm" DEFAULT_VALUE "UNKNOWN" /end COMPU_VTAB
/begin MEASUREMENT ECTgd_Rdtbl "ECT gauge sender cal-table R" UWORD Compu_ECTgd_Rdtbl 0 0 0 8191.875 ECU_ADDRESS 0x01003860 /end MEASUREMENT
/begin COMPU_METHOD Compu_ECTgd_Rdtbl " " RAT_FUNC "%.1" "ohms" COEFFS 0 8 0 0 0 1 /end COMPU_METHOD
/begin MEASUREMENT OilPgd_Rdtbl "OilP gauge sender cal-table R" UWORD Compu_OilPgd_Rdtbl 0 0 0 8191.875 ECU_ADDRESS 0x01003868 /end MEASUREMENT
/begin COMPU_METHOD Compu_OilPgd_Rdtbl " " RAT_FUNC "%.1" "ohms" COEFFS 0 8 0 0 0 1 /end COMPU_METHOD
/begin MEASUREMENT V1gd_Rdtbl "Volt1 gauge sender cal-table R" UWORD Compu_V1gd_Rdtbl 0 0 0 8191.875 ECU_ADDRESS 0x01003870 /end MEASUREMENT
/begin COMPU_METHOD Compu_V1gd_Rdtbl " " RAT_FUNC "%.1" "ohms" COEFFS 0 8 0 0 0 1 /end COMPU_METHOD
/begin CHARACTERISTIC rev_lim_fuel_drpm "Fuel rev limit proportional span" VALUE 0x001c84ba /* @ECU_Address@rev_lim_fuel_drpm@0x01003AF0@ */ ECIPP_ALIGNMENT_UWORD 65535 Compu_rev_lim_fuel_drpm 0 65535 /end CHARACTERISTIC
/begin COMPU_METHOD Compu_rev_lim_fuel_drpm " " RAT_FUNC "%.0" "delta-rpm" COEFFS 0 1 0 0 0 1 /end COMPU_METHOD
/begin CHARACTERISTIC FPC_ena "Liquid fuel pressure control{FPC_ena&0xff=0:Disabled}{FPC_ena&0xff=1:Aux PWM3}{FPC_ena&0xff=2:Aux PWM4}{FPC_ena&0xff=3:Aux PWM5}{FPC_ena&0xff=4:Aux PWM6}{FPC_ena&0xff=5:Aux PWM8}{FPC_ena&0xff=6:Aux PWM9}{FPC_ena&0xff=7:TACH Output}{FPC_ena&0xff=8:EGOH1}{F" VALUE 0x001c870f /* @ECU_Address@FPC_ena@0x01003B58@ */ ECIPP_ALIGNMENT_UBYTE 255 FPC_ena_COMPU_VTAB 0 255 BIT_MASK 0xff /end CHARACTERISTIC
/begin COMPU_METHOD FPC_ena_COMPU_VTAB "Verbal Table" TAB_VERB "%.0" "list" COMPU_TAB_REF FPC_ena_COMPU_VTAB_REF /end COMPU_METHOD
/begin COMPU_VTAB FPC_ena_COMPU_VTAB_REF "Verbal Table" TAB_VERB 14 0 "Disabled" 1 "Aux PWM3" 2 "Aux PWM4" 3 "Aux PWM5" 4 "Aux PWM6" 5 "Aux PWM8" 6 "Aux PWM9" 7 "TACH Output" 8 "EGOH1" 9 "EGOH2" 10 "EGOH3" 11 "EGOH4" 12 "Aux PWM1" 13 "Aux PWM2" DEFAULT_VALUE "UNKNOWN" /end COMPU_VTAB
/begin CHARACTERISTIC FPC_Kp "FP feedback Kp" VALUE 0x001c44e2 /* @ECU_Address@FPC_Kp@0x01003B60@ */ ECIPP_ALIGNMENT_SWORD 800 Compu_FPC_Kp -800 799.9755859375 /end CHARACTERISTIC
/begin COMPU_METHOD Compu_FPC_Kp " " RAT_FUNC "%.1" "%/psi" COEFFS 0 40.96 0 0 0 1 /end COMPU_METHOD
/begin CHARACTERISTIC FPC_Ki "FP feedback Ki" VALUE 0x001c44de /* @ECU_Address@FPC_Ki@0x01003B68@ */ ECIPP_ALIGNMENT_SWORD 400 Compu_FPC_Ki -400 399.98779296875 /end CHARACTERISTIC
/begin COMPU_METHOD Compu_FPC_Ki " " RAT_FUNC "%.1" "%/psi/sec" COEFFS 0 81.92 0 0 0 1 /end COMPU_METHOD
/begin CHARACTERISTIC FPC_Kd "FP feedback Kd" VALUE 0x001c44dc /* @ECU_Address@FPC_Kd@0x01003B70@ */ ECIPP_ALIGNMENT_SWORD 200 Compu_FPC_Kd -200 199.993896484375 /end CHARACTERISTIC
/begin COMPU_METHOD Compu_FPC_Kd " " RAT_FUNC "%.2" "%/(psi/sec)" COEFFS 0 163.84 0 0 0 1 /end COMPU_METHOD
/begin CHARACTERISTIC FPC_Kiv "FP feedback Kiv" VALUE 0x001c44e0 /* @ECU_Address@FPC_Kiv@0x01003B78@ */ ECIPP_ALIGNMENT_SWORD 50 Compu_FPC_Kiv -50 49.9984741210938 /end CHARACTERISTIC
/begin COMPU_METHOD Compu_FPC_Kiv " " RAT_FUNC "%.2" "%/psi/sec" COEFFS 0 655.36 0 0 0 1 /end COMPU_METHOD
/begin CHARACTERISTIC FPC_dot_window "FP derivative window" VALUE 0x001c6f76 /* @ECU_Address@FPC_dot_window@0x01003B80@ */ ECIPP_ALIGNMENT_UWORD 65535 Compu_FPC_dot_window 0 65535 /end CHARACTERISTIC
/begin COMPU_METHOD Compu_FPC_dot_window " " RAT_FUNC "%.0" "ms" COEFFS 0 1 0 0 0 1 /end COMPU_METHOD
/begin CHARACTERISTIC FPC_dot_tau "FP derivative low-pass tau" VALUE 0x001c853c /* @ECU_Address@FPC_dot_tau@0x01003B88@ */ ECIPP_ALIGNMENT_UWORD 163840 Compu_FPC_dot_tau 0.16703 163840 /end CHARACTERISTIC
/begin COMPU_METHOD Compu_FPC_dot_tau " " FORM "%.1" "ms"
 /begin FORMULA "-5 / log(1.0000000000001 - (X1 / 32768))" FORMULA_INV "(1.0000000000001 - exp(-5/X1)) * 32768" /end FORMULA
/end COMPU_METHOD
/begin CHARACTERISTIC FPCVmin "FPump min voltage" VALUE 0x001c44da /* @ECU_Address@FPCVmin@0x01003B90@ */ ECIPP_ALIGNMENT_SWORD 128 Compu_FPCVmin -128 127.99609375 /end CHARACTERISTIC
/begin COMPU_METHOD Compu_FPCVmin " " RAT_FUNC "%.2" "volts" COEFFS 0 256 0 0 0 1 /end COMPU_METHOD
/begin CHARACTERISTIC FPCVmax "FPump max voltage" VALUE 0x001c44d8 /* @ECU_Address@FPCVmax@0x01003B98@ */ ECIPP_ALIGNMENT_SWORD 128 Compu_FPCVmax -128 127.99609375 /end CHARACTERISTIC
/begin COMPU_METHOD Compu_FPCVmax " " RAT_FUNC "%.2" "volts" COEFFS 0 256 0 0 0 1 /end COMPU_METHOD
/begin CHARACTERISTIC FPCV_CLauth "FPump command voltage authority" VALUE 0x001c44d6 /* @ECU_Address@FPCV_CLauth@0x01003BA0@ */ ECIPP_ALIGNMENT_SWORD 128 Compu_FPCV_CLauth -128 127.99609375 /end CHARACTERISTIC
/begin COMPU_METHOD Compu_FPCV_CLauth " " RAT_FUNC "%.2" "+/- volts" COEFFS 0 256 0 0 0 1 /end COMPU_METHOD
/begin CHARACTERISTIC FPC_SD_deltaP "FPump shutdown max pressure delta" VALUE 0x001c6f74 /* @ECU_Address@FPC_SD_deltaP@0x01003BA8@ */ ECIPP_ALIGNMENT_UWORD 256 Compu_FPC_SD_deltaP 0 255.99609375 /end CHARACTERISTIC
/begin COMPU_METHOD Compu_FPC_SD_deltaP " " RAT_FUNC "%.2" "psi delta" COEFFS 0 256 0 0 0 1 /end COMPU_METHOD
/begin CHARACTERISTIC FPCcmd_tau "FPump command low-pass" VALUE 0x001c853e /* @ECU_Address@FPCcmd_tau@0x01003BB0@ */ ECIPP_ALIGNMENT_UWORD 163840 Compu_FPCcmd_tau 0.16703 163840 /end CHARACTERISTIC
/begin COMPU_METHOD Compu_FPCcmd_tau " " FORM "%.1" "ms"
 /begin FORMULA "-5 / log(1.0000000000001 - (X1 / 32768))" FORMULA_INV "(1.0000000000001 - exp(-5/X1)) * 32768" /end FORMULA
/end COMPU_METHOD
/begin CHARACTERISTIC FPin_a "Fuel rail pressure target" VALUE 0x001C9F70 /* @ECU_Address@FPin_a@0x01003BB8@ */ ECIPP_ALIGNMENT_UWORD 256 Compu_FPin_a 0 255.99609375 /end CHARACTERISTIC
/begin COMPU_METHOD Compu_FPin_a " " RAT_FUNC "%.1" "psia" COEFFS 0 256 0 0 0 1 /end COMPU_METHOD
/begin MEASUREMENT FPC_Iacc "FP feedback integrator" SWORD Compu_FPC_Iacc 0 0 -800 799.9755859375 ECU_ADDRESS 0x01003BC0 /end MEASUREMENT
/begin COMPU_METHOD Compu_FPC_Iacc " " RAT_FUNC "%.1" "%" COEFFS 0 40.96 0 0 0 1 /end COMPU_METHOD
/begin MEASUREMENT FPCcmd "FP closed-loop percent command" SWORD Compu_FPCcmd 0 0 -100 99.9969482421875 ECU_ADDRESS 0x01003BC8 /end MEASUREMENT
/begin COMPU_METHOD Compu_FPCcmd " " RAT_FUNC "%.1" "%" COEFFS 0 327.68 0 0 0 1 /end COMPU_METHOD
/begin MEASUREMENT FPCcmd_V "FP control voltage command" UWORD Compu_FPCcmd_V 0 0 0 255.99609375 ECU_ADDRESS 0x01003BD0 /end MEASUREMENT
/begin COMPU_METHOD Compu_FPCcmd_V " " RAT_FUNC "%.2" "volts" COEFFS 0 256 0 0 0 1 /end COMPU_METHOD
/begin MEASUREMENT FPCcmd_DC "FP control PWM duty-cycle command" UWORD Compu_FPCcmd_DC 0 0 0 99.9984741210938 ECU_ADDRESS 0x01003BD8 /end MEASUREMENT
/begin COMPU_METHOD Compu_FPCcmd_DC " " RAT_FUNC "%.1" "%" COEFFS 0 655.36 0 0 0 1 /end COMPU_METHOD
/begin CHARACTERISTIC FPUMP_pin "Fuel pump enable pin{FPUMP_pin&0xff=0:Disabled}{FPUMP_pin&0xff=1:Standard}{FPUMP_pin&0xff=2:Aux PWM1}{FPUMP_pin&0xff=3:Aux PWM2}{FPUMP_pin&0xff=4:Aux PWM3}{FPUMP_pin&0xff=5:Aux PWM4}{FPUMP_pin&0xff=6:Aux PWM5}{FPUMP_pin&0xff=7:Aux PWM6}{FPUMP_pin&0xff=8:E" VALUE 0x001c872d /* @ECU_Address@FPUMP_pin@0x01003BE0@ */ ECIPP_ALIGNMENT_UBYTE 255 FPUMP_pin_COMPU_VTAB 0 255 BIT_MASK 0xff /end CHARACTERISTIC
/begin COMPU_METHOD FPUMP_pin_COMPU_VTAB "Verbal Table" TAB_VERB "%.0" "list" COMPU_TAB_REF FPUMP_pin_COMPU_VTAB_REF /end COMPU_METHOD
/begin COMPU_VTAB FPUMP_pin_COMPU_VTAB_REF "Verbal Table" TAB_VERB 12 0 "Disabled" 1 "Standard" 2 "Aux PWM1" 3 "Aux PWM2" 4 "Aux PWM3" 5 "Aux PWM4" 6 "Aux PWM5" 7 "Aux PWM6" 8 "EGOH1" 9 "EGOH2" 10 "EGOH3" 11 "EGOH4" DEFAULT_VALUE "UNKNOWN" /end COMPU_VTAB
/begin CHARACTERISTIC LOCKOFF_pin "Gaseous lockoff enable pin{LOCKOFF_pin&0xff=0:Disabled}{LOCKOFF_pin&0xff=1:Standard}{LOCKOFF_pin&0xff=2:Aux PWM1}{LOCKOFF_pin&0xff=3:Aux PWM2}{LOCKOFF_pin&0xff=4:Aux PWM3}{LOCKOFF_pin&0xff=5:Aux PWM4}{LOCKOFF_pin&0xff=6:Aux PWM5}{LOCKOFF_pin&0xff=7:Aux PW" VALUE 0x001c87d5 /* @ECU_Address@LOCKOFF_pin@0x01003BE8@ */ ECIPP_ALIGNMENT_UBYTE 255 LOCKOFF_pin_COMPU_VTAB 0 255 BIT_MASK 0xff /end CHARACTERISTIC
/begin COMPU_METHOD LOCKOFF_pin_COMPU_VTAB "Verbal Table" TAB_VERB "%.0" "list" COMPU_TAB_REF LOCKOFF_pin_COMPU_VTAB_REF /end COMPU_METHOD
/begin COMPU_VTAB LOCKOFF_pin_COMPU_VTAB_REF "Verbal Table" TAB_VERB 12 0 "Disabled" 1 "Standard" 2 "Aux PWM1" 3 "Aux PWM2" 4 "Aux PWM3" 5 "Aux PWM4" 6 "Aux PWM5" 7 "Aux PWM6" 8 "EGOH1" 9 "EGOH2" 10 "EGOH3" 11 "EGOH4" DEFAULT_VALUE "UNKNOWN" /end COMPU_VTAB
/begin CHARACTERISTIC FT_input_pin "Fuel type select input pin{FT_input_pin&0xff=0:Disabled}{FT_input_pin&0xff=1:Aux DIG1}{FT_input_pin&0xff=2:Aux DIG2}{FT_input_pin&0xff=3:Aux DIG3}{FT_input_pin&0xff=4:Aux DIG4}{FT_input_pin&0xff=5:Aux DIG5}{FT_input_pin&0xff=6:Aux DIG6}{FT_input_pin&0xff=" VALUE 0x001c8748 /* @ECU_Address@FT_input_pin@0x01003BF0@ */ ECIPP_ALIGNMENT_UBYTE 255 FT_input_pin_COMPU_VTAB 0 255 BIT_MASK 0xff /end CHARACTERISTIC
/begin COMPU_METHOD FT_input_pin_COMPU_VTAB "Verbal Table" TAB_VERB "%.0" "list" COMPU_TAB_REF FT_input_pin_COMPU_VTAB_REF /end COMPU_METHOD
/begin COMPU_VTAB FT_input_pin_COMPU_VTAB_REF "Verbal Table" TAB_VERB 20 0 "Disabled" 1 "Aux DIG1" 2 "Aux DIG2" 3 "Aux DIG3" 4 "Aux DIG4" 5 "Aux DIG5" 6 "Aux DIG6" 7 "Aux DIG7" 8 "Aux DIG8" 9 "Aux DIG9" 10 "Aux DIG10" 11 "Aux DIG11" 12 "Aux DIG12" 13 "Aux DIG13" 14 "Aux DIG14" 15 "Aux DIG15" 16 "Aux DIG16" 17 "Aux DIG17" 18 "Aux DIG18" 19 "Aux DIG19" DEFAULT_VALUE "UNKNOWN" /end COMPU_VTAB
/begin CHARACTERISTIC LOCKOFF_flowwt "Gaseous lockoff fuel flow start delay" VALUE 0x001c7cf6 /* @ECU_Address@LOCKOFF_flowwt@0x01003F48@ */ ECIPP_ALIGNMENT_UWORD 65535 Compu_LOCKOFF_flowwt 0 65535 /end CHARACTERISTIC
/begin COMPU_METHOD Compu_LOCKOFF_flowwt " " RAT_FUNC "%.0" "ms" COEFFS 0 1 0 0 0 1 /end COMPU_METHOD
/begin CHARACTERISTIC V_LPG_off_type "LPG turnoff volume type{V_LPG_off_type&0xff=0:Single Value}{V_LPG_off_type&0xff=1:ECT Based Table}{V_LPG_off_type&0xff=2:FT Based Table}" VALUE 0x001c8f90 /* @ECU_Address@V_LPG_off_type@0x010041B8@ */ ECIPP_ALIGNMENT_UBYTE 255 V_LPG_off_type_COMPU_VTAB 0 255 BIT_MASK 0xff /end CHARACTERISTIC
/begin COMPU_METHOD V_LPG_off_type_COMPU_VTAB "Verbal Table" TAB_VERB "%.0" "list" COMPU_TAB_REF V_LPG_off_type_COMPU_VTAB_REF /end COMPU_METHOD
/begin COMPU_VTAB V_LPG_off_type_COMPU_VTAB_REF "Verbal Table" TAB_VERB 3 0 "Single Value" 1 "ECT Based Table" 2 "FT Based Table" DEFAULT_VALUE "UNKNOWN" /end COMPU_VTAB
/begin MEASUREMENT V_LPG_off_cur "LPG turnoff V equivalent current" UWORD Compu_V_LPG_off_cur 0 0 0 31.99951171875 ECU_ADDRESS 0x010041C0 /end MEASUREMENT
/begin COMPU_METHOD Compu_V_LPG_off_cur " " RAT_FUNC "%.2" "liters" COEFFS 0 2048 0 0 0 1 /end COMPU_METHOD
/begin CHARACTERISTIC LOD_FROmax "Fuel run-out fault time (Fault Condition:Fuel run-out engine run time >)" VALUE 0x001c7d00 /* @ECU_Address@LOD_FROmax@0x01004588@ */ ECIPP_ALIGNMENT_UWORD 65535 Compu_LOD_FROmax 0 65535 /end CHARACTERISTIC
/begin COMPU_METHOD Compu_LOD_FROmax " " RAT_FUNC "%.0" "ms" COEFFS 0 1 0 0 0 1 /end COMPU_METHOD
/begin MEASUREMENT V1gd_pctref "Volt1 gauge driver reference" UWORD Compu_V1gd_pctref 0 0 0 399.993896484375 ECU_ADDRESS 0x01004658 /end MEASUREMENT
/begin COMPU_METHOD Compu_V1gd_pctref " " RAT_FUNC "%.1" "%" COEFFS 0 163.84 0 0 0 1 /end COMPU_METHOD
/begin CHARACTERISTIC TRIM_out_chan "Trim valve PWM output channel{TRIM_out_chan&0xff=0:Aux PWM3}{TRIM_out_chan&0xff=1:Aux PWM4}" VALUE 0x001c8f51 /* @ECU_Address@TRIM_out_chan@0x01004BF8@ */ ECIPP_ALIGNMENT_UBYTE 255 TRIM_out_chan_COMPU_VTAB 0 255 BIT_MASK 0xff /end CHARACTERISTIC
/begin COMPU_METHOD TRIM_out_chan_COMPU_VTAB "Verbal Table" TAB_VERB "%.0" "list" COMPU_TAB_REF TRIM_out_chan_COMPU_VTAB_REF /end COMPU_METHOD
/begin COMPU_VTAB TRIM_out_chan_COMPU_VTAB_REF "Verbal Table" TAB_VERB 2 0 "Aux PWM3" 1 "Aux PWM4" DEFAULT_VALUE "UNKNOWN" /end COMPU_VTAB
/begin CHARACTERISTIC TRIM_fueltran_mode "TRIM/EPR fuel transition mode{TRIM_fueltran_mode&0xff=0:Fixed command value}{TRIM_fueltran_mode&0xff=1:Nominal lookup value}" VALUE 0x001c8f50 /* @ECU_Address@TRIM_fueltran_mode@0x01004C00@ */ ECIPP_ALIGNMENT_UBYTE 255 TRIM_fueltran_mode_COMPU_VTAB 0 255 BIT_MASK 0xff /end CHARACTERISTIC
/begin COMPU_METHOD TRIM_fueltran_mode_COMPU_VTAB "Verbal Table" TAB_VERB "%.0" "list" COMPU_TAB_REF TRIM_fueltran_mode_COMPU_VTAB_REF /end COMPU_METHOD
/begin COMPU_VTAB TRIM_fueltran_mode_COMPU_VTAB_REF "Verbal Table" TAB_VERB 2 0 "Fixed command value" 1 "Nominal lookup value" DEFAULT_VALUE "UNKNOWN" /end COMPU_VTAB
/begin CHARACTERISTIC TRIM_ftran_DCdef "TRIM fuel transition fixed value" VALUE 0x001c81ce /* @ECU_Address@TRIM_ftran_DCdef@0x01004C08@ */ ECIPP_ALIGNMENT_UWORD 100 Compu_TRIM_ftran_DCdef 0 99.9984741210938 /end CHARACTERISTIC
/begin COMPU_METHOD Compu_TRIM_ftran_DCdef " " RAT_FUNC "%.1" "% DC" COEFFS 0 655.36 0 0 0 1 /end COMPU_METHOD
/begin CHARACTERISTIC MJ_ftran_Pdef "EPR fuel transition fixed value" VALUE 0x001c4574 /* @ECU_Address@MJ_ftran_Pdef@0x01004C10@ */ ECIPP_ALIGNMENT_SWORD 222 Compu_MJ_ftran_Pdef -222 221.993225097656 /end CHARACTERISTIC
/begin COMPU_METHOD Compu_MJ_ftran_Pdef " " RAT_FUNC "%.2" "in H2O" COEFFS 0 147.603603603604 0 0 0 1 /end COMPU_METHOD
/begin CHARACTERISTIC FIMP_ena "Fuel impurity compensation{FIMP_ena&0xff=0:Disabled}{FIMP_ena&0xff=1:Impure = Gsln Cal}{FIMP_ena&0xff=2:Impure = LPG Cal}{FIMP_ena&0xff=3:Impure = NG Cal}" VALUE 0x001c8702 /* @ECU_Address@FIMP_ena@0x01004DD0@ */ ECIPP_ALIGNMENT_UBYTE 255 FIMP_ena_COMPU_VTAB 0 255 BIT_MASK 0xff /end CHARACTERISTIC
/begin COMPU_METHOD FIMP_ena_COMPU_VTAB "Verbal Table" TAB_VERB "%.0" "list" COMPU_TAB_REF FIMP_ena_COMPU_VTAB_REF /end COMPU_METHOD
/begin COMPU_VTAB FIMP_ena_COMPU_VTAB_REF "Verbal Table" TAB_VERB 4 0 "Disabled" 1 "Impure = Gsln Cal" 2 "Impure = LPG Cal" 3 "Impure = NG Cal" DEFAULT_VALUE "UNKNOWN" /end COMPU_VTAB
/begin CHARACTERISTIC FIMP_type "Fuel impurity determination mode{FIMP_type&0xff=0:Constant / Default}{FIMP_type&0xff=1:LPG FTP/FTT Adapt}{FIMP_type&0xff=2:Tri-state switch input}{FIMP_type&0xff=3:External Voltage input}{FIMP_type&0xff=4:Fuel BTU input}" VALUE 0x001c8705 /* @ECU_Address@FIMP_type@0x01004DD8@ */ ECIPP_ALIGNMENT_UBYTE 255 FIMP_type_COMPU_VTAB 0 255 BIT_MASK 0xff /end CHARACTERISTIC
/begin COMPU_METHOD FIMP_type_COMPU_VTAB "Verbal Table" TAB_VERB "%.0" "list" COMPU_TAB_REF FIMP_type_COMPU_VTAB_REF /end COMPU_METHOD
/begin COMPU_VTAB FIMP_type_COMPU_VTAB_REF "Verbal Table" TAB_VERB 5 0 "Constant / Default" 1 "LPG FTP/FTT Adapt" 2 "Tri-state switch input" 3 "External Voltage input" 4 "Fuel BTU input" DEFAULT_VALUE "UNKNOWN" /end COMPU_VTAB
/begin CHARACTERISTIC FIMP_init_mode "Key-on fuel impurity reset mode{FIMP_init_mode&0xff=0:Use last value}{FIMP_init_mode&0xff=1:Reset to default}" VALUE 0x001c8704 /* @ECU_Address@FIMP_init_mode@0x01004DE0@ */ ECIPP_ALIGNMENT_UBYTE 255 FIMP_init_mode_COMPU_VTAB 0 255 BIT_MASK 0xff /end CHARACTERISTIC
/begin COMPU_METHOD FIMP_init_mode_COMPU_VTAB "Verbal Table" TAB_VERB "%.0" "list" COMPU_TAB_REF FIMP_init_mode_COMPU_VTAB_REF /end COMPU_METHOD
/begin COMPU_VTAB FIMP_init_mode_COMPU_VTAB_REF "Verbal Table" TAB_VERB 2 0 "Use last value" 1 "Reset to default" DEFAULT_VALUE "UNKNOWN" /end COMPU_VTAB
/begin CHARACTERISTIC FIMP_pct_init "Cold power-up default fuel impurity level" VALUE 0x001c6f5a /* @ECU_Address@FIMP_pct_init@0x01004DE8@ */ ECIPP_ALIGNMENT_UWORD 100 Compu_FIMP_pct_init 0 99.9984741210938 /end CHARACTERISTIC
/begin COMPU_METHOD Compu_FIMP_pct_init " " RAT_FUNC "%.1" "%" COEFFS 0 655.36 0 0 0 1 /end COMPU_METHOD
/begin CHARACTERISTIC FIMP_MAP_min "LPG adapt MAP min" VALUE 0x001c6f4e /* @ECU_Address@FIMP_MAP_min@0x01004DF0@ */ ECIPP_ALIGNMENT_UWORD 256 Compu_FIMP_MAP_min 0 255.99609375 /end CHARACTERISTIC
/begin COMPU_METHOD Compu_FIMP_MAP_min " " RAT_FUNC "%.2" "psia" COEFFS 0 256 0 0 0 1 /end COMPU_METHOD
/begin CHARACTERISTIC FIMP_MAP_max "LPG adapt MAP max" VALUE 0x001c6f4c /* @ECU_Address@FIMP_MAP_max@0x01004DF8@ */ ECIPP_ALIGNMENT_UWORD 256 Compu_FIMP_MAP_max 0 255.99609375 /end CHARACTERISTIC
/begin COMPU_METHOD Compu_FIMP_MAP_max " " RAT_FUNC "%.2" "psia" COEFFS 0 256 0 0 0 1 /end COMPU_METHOD
/begin CHARACTERISTIC FIMP_RPM_min "LPG adapt RPM min" VALUE 0x001c6f52 /* @ECU_Address@FIMP_RPM_min@0x01004E00@ */ ECIPP_ALIGNMENT_UWORD 65535 Compu_FIMP_RPM_min 0 65535 /end CHARACTERISTIC
/begin COMPU_METHOD Compu_FIMP_RPM_min " " RAT_FUNC "%.0" "rpm" COEFFS 0 1 0 0 0 1 /end COMPU_METHOD
/begin CHARACTERISTIC FIMP_RPM_max "LPG adapt RPM max" VALUE 0x001c6f50 /* @ECU_Address@FIMP_RPM_max@0x01004E08@ */ ECIPP_ALIGNMENT_UWORD 65535 Compu_FIMP_RPM_max 0 65535 /end CHARACTERISTIC
/begin COMPU_METHOD Compu_FIMP_RPM_max " " RAT_FUNC "%.0" "rpm" COEFFS 0 1 0 0 0 1 /end COMPU_METHOD
/begin CHARACTERISTIC FIMP_strt_wait "Fuel impurity adapt engine start wait" VALUE 0x001c6f5c /* @ECU_Address@FIMP_strt_wait@0x01004E10@ */ ECIPP_ALIGNMENT_UWORD 3277 Compu_FIMP_strt_wait 0 3276.75 /end CHARACTERISTIC
/begin COMPU_METHOD Compu_FIMP_strt_wait " " RAT_FUNC "%.1" "sec" COEFFS 0 20 0 0 0 1 /end COMPU_METHOD
/begin CHARACTERISTIC FIMP_wndw_wait "Fuel impurity adapt window wait" VALUE 0x001c6f5e /* @ECU_Address@FIMP_wndw_wait@0x01004E18@ */ ECIPP_ALIGNMENT_UWORD 3277 Compu_FIMP_wndw_wait 0 3276.75 /end CHARACTERISTIC
/begin COMPU_METHOD Compu_FIMP_wndw_wait " " RAT_FUNC "%.1" "sec" COEFFS 0 20 0 0 0 1 /end COMPU_METHOD
/begin CHARACTERISTIC FIMP_learn_tau "Fuel impurity adaptation tau" VALUE 0x001c8538 /* @ECU_Address@FIMP_learn_tau@0x01004E20@ */ ECIPP_ALIGNMENT_UWORD 3277 Compu_FIMP_learn_tau 0.0045084 3276.8 /end CHARACTERISTIC
/begin COMPU_METHOD Compu_FIMP_learn_tau " " FORM "%.1" "sec"
 /begin FORMULA "-0.05 / log(1 - (X1 / 65536))" FORMULA_INV "(1 - exp(-0.05/X1)) * 65536" /end FORMULA
/end COMPU_METHOD
/begin CHARACTERISTIC FIMP_LL_strt "Load-limit fuel impurity linear start" VALUE 0x001c6f4a /* @ECU_Address@FIMP_LL_strt@0x01004E28@ */ ECIPP_ALIGNMENT_UWORD 100 Compu_FIMP_LL_strt 0 99.9984741210938 /end CHARACTERISTIC
/begin COMPU_METHOD Compu_FIMP_LL_strt " " RAT_FUNC "%.1" "%" COEFFS 0 655.36 0 0 0 1 /end COMPU_METHOD
/begin CHARACTERISTIC FIMP_LL_stop "Load-limit fuel impurity linear finish" VALUE 0x001c6f48 /* @ECU_Address@FIMP_LL_stop@0x01004E30@ */ ECIPP_ALIGNMENT_UWORD 100 Compu_FIMP_LL_stop 0 99.9984741210938 /end CHARACTERISTIC
/begin COMPU_METHOD Compu_FIMP_LL_stop " " RAT_FUNC "%.1" "%" COEFFS 0 655.36 0 0 0 1 /end COMPU_METHOD
/begin CHARACTERISTIC FTT_ena "FTT source{FTT_ena&0xff=0:Disabled}{FTT_ena&0xff=1:Aux PU1}{FTT_ena&0xff=2:Aux PU2}{FTT_ena&0xff=3:Aux PU3}{FTT_ena&0xff=4:Aux PUD1}{FTT_ena&0xff=5:Aux PUD2}{FTT_ena&0xff=6:Aux PUD3}{FTT_ena&0xff=7:EGT Input}{FTT_ena&0xff=8:Aux PUD4}{FTT_ena&0xff=9:Aux PU" VALUE 0x001c8742 /* @ECU_Address@FTT_ena@0x01004E58@ */ ECIPP_ALIGNMENT_UBYTE 255 FTT_ena_COMPU_VTAB 0 255 BIT_MASK 0xff /end CHARACTERISTIC
/begin COMPU_METHOD FTT_ena_COMPU_VTAB "Verbal Table" TAB_VERB "%.0" "list" COMPU_TAB_REF FTT_ena_COMPU_VTAB_REF /end COMPU_METHOD
/begin COMPU_VTAB FTT_ena_COMPU_VTAB_REF "Verbal Table" TAB_VERB 31 0 "Disabled" 1 "Aux PU1" 2 "Aux PU2" 3 "Aux PU3" 4 "Aux PUD1" 5 "Aux PUD2" 6 "Aux PUD3" 7 "EGT Input" 8 "Aux PUD4" 9 "Aux PUD5" 10 "Aux PUD6" 11 "Aux PUD7" 12 "Aux PUD8" 13 "Aux PUD9" 14 "Aux PUD10" 15 "Aux PUD11" 16 "Aux PUD12" 17 "Aux PUD13" 18 "Aux PUD14" 19 "Aux PUD15" 20 "Aux PUD16" 21 "Aux PUD17" 22 "Aux PUD18" 23 "Aux PUD19" 24 "Aux PUD20" 25 "Aux PUD21" 26 "Aux PUD22" 27 "Aux PUD23" 28 "Aux PUD24" 29 "Aux PUD25" 30 "CAN sourced" DEFAULT_VALUE "UNKNOWN" /end COMPU_VTAB
/begin CHARACTERISTIC FTP_ena "FTP source{FTP_ena&0xff=0:Disabled}{FTP_ena&0xff=1:Aux PD1}{FTP_ena&0xff=2:Aux PD2}{FTP_ena&0xff=3:Aux PD3}{FTP_ena&0xff=4:Aux PUD1}{FTP_ena&0xff=5:Aux PUD2}{FTP_ena&0xff=6:Aux PUD3}{FTP_ena&0xff=7:Aux PUD4}{FTP_ena&0xff=8:Aux PUD5}{FTP_ena&0xff=9:Aux PUD" VALUE 0x001c8741 /* @ECU_Address@FTP_ena@0x01004E68@ */ ECIPP_ALIGNMENT_UBYTE 255 FTP_ena_COMPU_VTAB 0 255 BIT_MASK 0xff /end CHARACTERISTIC
/begin COMPU_METHOD FTP_ena_COMPU_VTAB "Verbal Table" TAB_VERB "%.0" "list" COMPU_TAB_REF FTP_ena_COMPU_VTAB_REF /end COMPU_METHOD
/begin COMPU_VTAB FTP_ena_COMPU_VTAB_REF "Verbal Table" TAB_VERB 31 0 "Disabled" 1 "Aux PD1" 2 "Aux PD2" 3 "Aux PD3" 4 "Aux PUD1" 5 "Aux PUD2" 6 "Aux PUD3" 7 "Aux PUD4" 8 "Aux PUD5" 9 "Aux PUD6" 10 "Aux PUD7" 11 "Aux PUD8" 12 "Aux PUD9" 13 "Aux PUD10" 14 "Aux PUD11" 15 "Aux PUD12" 16 "Aux PUD13" 17 "Aux PUD14" 18 "Aux PUD15" 19 "CAN sourced" 20 "FPP2 Input" 21 "Aux PUD16" 22 "Aux PUD17" 23 "Aux PUD18" 24 "Aux PUD19" 25 "Aux PUD20" 26 "Aux PUD21" 27 "Aux PUD22" 28 "Aux PUD23" 29 "Aux PUD24" 30 "Aux PUD25" DEFAULT_VALUE "UNKNOWN" /end COMPU_VTAB
/begin MEASUREMENT FIMP_percent "Current fuel impurity" UWORD Compu_FIMP_percent 0 0 0 99.9984741210938 ECU_ADDRESS 0x01004E88 /end MEASUREMENT
/begin COMPU_METHOD Compu_FIMP_percent " " RAT_FUNC "%.1" "%" COEFFS 0 655.36 0 0 0 1 /end COMPU_METHOD
/begin MEASUREMENT FIMP_LL_pct "Current load-limit fuel impurity factor" UWORD Compu_FIMP_LL_pct 0 0 0 99.9984741210938 ECU_ADDRESS 0x01004E90 /end MEASUREMENT
/begin COMPU_METHOD Compu_FIMP_LL_pct " " RAT_FUNC "%.1" "%" COEFFS 0 655.36 0 0 0 1 /end COMPU_METHOD
/begin MEASUREMENT FIMP_pct_ss "Steady-State fuel impurity" UWORD Compu_FIMP_pct_ss 0 0 0 99.9984741210938 ECU_ADDRESS 0x01004E98 /end MEASUREMENT
/begin COMPU_METHOD Compu_FIMP_pct_ss " " RAT_FUNC "%.1" "%" COEFFS 0 655.36 0 0 0 1 /end COMPU_METHOD
/begin CHARACTERISTIC inj_timing_dz "Injection timing dead-zone" VALUE 0x001C9F82 /* @ECU_Address@inj_timing_dz@0x01005290@ */ ECIPP_ALIGNMENT_SWORD 2048 Compu_inj_timing_dz -2048 2047.9375 /end CHARACTERISTIC
/begin COMPU_METHOD Compu_inj_timing_dz " " RAT_FUNC "%.0" "CAD" COEFFS 0 16 0 0 0 1 /end COMPU_METHOD
/begin CHARACTERISTIC inj_timing_dz_tau "Injection timing dead-zone tau" VALUE 0x001C9F84 /* @ECU_Address@inj_timing_dz_tau@0x01005298@ */ ECIPP_ALIGNMENT_UWORD 163840 Compu_inj_timing_dz_tau 0.16703 163840 /end CHARACTERISTIC
/begin COMPU_METHOD Compu_inj_timing_dz_tau " " FORM "%.0" "ms"
 /begin FORMULA "-5 / log(1.0000000000001 - (X1 / 32768))" FORMULA_INV "(1.0000000000001 - exp(-5/X1)) * 32768" /end FORMULA
/end COMPU_METHOD
/begin CHARACTERISTIC rev_lim_spk_drpm "Spark rev limit proportional span" VALUE 0x001c84be /* @ECU_Address@rev_lim_spk_drpm@0x01005588@ */ ECIPP_ALIGNMENT_UWORD 65535 Compu_rev_lim_spk_drpm 0 65535 /end CHARACTERISTIC
/begin COMPU_METHOD Compu_rev_lim_spk_drpm " " RAT_FUNC "%.0" "delta-rpm" COEFFS 0 1 0 0 0 1 /end COMPU_METHOD
/begin CHARACTERISTIC FLEV_ena "FLEV fuel level monitoring{FLEV_ena&0xff=0:Disabled}{FLEV_ena&0xff=1:Enabled}" VALUE 0x001c870a /* @ECU_Address@FLEV_ena@0x01005590@ */ ECIPP_ALIGNMENT_UBYTE 255 FLEV_ena_COMPU_VTAB 0 255 BIT_MASK 0xff /end CHARACTERISTIC
/begin COMPU_METHOD FLEV_ena_COMPU_VTAB "Verbal Table" TAB_VERB "%.0" "list" COMPU_TAB_REF FLEV_ena_COMPU_VTAB_REF /end COMPU_METHOD
/begin COMPU_VTAB FLEV_ena_COMPU_VTAB_REF "Verbal Table" TAB_VERB 2 0 "Disabled" 1 "Enabled" DEFAULT_VALUE "UNKNOWN" /end COMPU_VTAB
/begin CHARACTERISTIC FLEV_FT_crct "FLEV tank temperature correction{FLEV_FT_crct&0xff=0:Disabled}{FLEV_FT_crct&0xff=1:FTT}" VALUE 0x001c8709 /* @ECU_Address@FLEV_FT_crct@0x01005598@ */ ECIPP_ALIGNMENT_UBYTE 255 FLEV_FT_crct_COMPU_VTAB 0 255 BIT_MASK 0xff /end CHARACTERISTIC
/begin COMPU_METHOD FLEV_FT_crct_COMPU_VTAB "Verbal Table" TAB_VERB "%.0" "list" COMPU_TAB_REF FLEV_FT_crct_COMPU_VTAB_REF /end COMPU_METHOD
/begin COMPU_VTAB FLEV_FT_crct_COMPU_VTAB_REF "Verbal Table" TAB_VERB 2 0 "Disabled" 1 "FTT" DEFAULT_VALUE "UNKNOWN" /end COMPU_VTAB
/begin CHARACTERISTIC FLEV_lo_faults "FLEV low fuel fault disabling{FLEV_lo_faults&0xff=0:Disabled}{FLEV_lo_faults&0xff=1:Enabled - Legacy}{FLEV_lo_faults&0xff=2:Use Low Fuel Monitoring}" VALUE 0x001c870c /* @ECU_Address@FLEV_lo_faults@0x010055A0@ */ ECIPP_ALIGNMENT_UBYTE 255 FLEV_lo_faults_COMPU_VTAB 0 255 BIT_MASK 0xff /end CHARACTERISTIC
/begin COMPU_METHOD FLEV_lo_faults_COMPU_VTAB "Verbal Table" TAB_VERB "%.0" "list" COMPU_TAB_REF FLEV_lo_faults_COMPU_VTAB_REF /end COMPU_METHOD
/begin COMPU_VTAB FLEV_lo_faults_COMPU_VTAB_REF "Verbal Table" TAB_VERB 3 0 "Disabled" 1 "Enabled - Legacy" 2 "Use Low Fuel Monitoring" DEFAULT_VALUE "UNKNOWN" /end COMPU_VTAB
/begin CHARACTERISTIC FLEV_lo_chan "FLEV low fuel indicator channel{FLEV_lo_chan&0xff=0:Disabled}{FLEV_lo_chan&0xff=1:Aux PWM1}{FLEV_lo_chan&0xff=2:Aux PWM2}{FLEV_lo_chan&0xff=3:Aux PWM3}{FLEV_lo_chan&0xff=4:Aux PWM4}{FLEV_lo_chan&0xff=5:Aux PWM5}" VALUE 0x001c870b /* @ECU_Address@FLEV_lo_chan@0x010055A8@ */ ECIPP_ALIGNMENT_UBYTE 255 FLEV_lo_chan_COMPU_VTAB 0 255 BIT_MASK 0xff /end CHARACTERISTIC
/begin COMPU_METHOD FLEV_lo_chan_COMPU_VTAB "Verbal Table" TAB_VERB "%.0" "list" COMPU_TAB_REF FLEV_lo_chan_COMPU_VTAB_REF /end COMPU_METHOD
/begin COMPU_VTAB FLEV_lo_chan_COMPU_VTAB_REF "Verbal Table" TAB_VERB 6 0 "Disabled" 1 "Aux PWM1" 2 "Aux PWM2" 3 "Aux PWM3" 4 "Aux PWM4" 5 "Aux PWM5" DEFAULT_VALUE "UNKNOWN" /end COMPU_VTAB
/begin CHARACTERISTIC FLEVgd_chan "FLEV gauge driver channel{FLEVgd_chan&0xff=0:Disabled}{FLEVgd_chan&0xff=1:Aux PWM1}{FLEVgd_chan&0xff=2:Aux PWM2}{FLEVgd_chan&0xff=3:Aux PWM3}{FLEVgd_chan&0xff=4:Aux PWM4}{FLEVgd_chan&0xff=5:Aux PWM5}" VALUE 0x001c870d /* @ECU_Address@FLEVgd_chan@0x010055B0@ */ ECIPP_ALIGNMENT_UBYTE 255 FLEVgd_chan_COMPU_VTAB 0 255 BIT_MASK 0xff /end CHARACTERISTIC
/begin COMPU_METHOD FLEVgd_chan_COMPU_VTAB "Verbal Table" TAB_VERB "%.0" "list" COMPU_TAB_REF FLEVgd_chan_COMPU_VTAB_REF /end COMPU_METHOD
/begin COMPU_VTAB FLEVgd_chan_COMPU_VTAB_REF "Verbal Table" TAB_VERB 6 0 "Disabled" 1 "Aux PWM1" 2 "Aux PWM2" 3 "Aux PWM3" 4 "Aux PWM4" 5 "Aux PWM5" DEFAULT_VALUE "UNKNOWN" /end COMPU_VTAB
/begin CHARACTERISTIC FLEV_FTstd "FLEV standard tank temperature" VALUE 0x001c6f68 /* @ECU_Address@FLEV_FTstd@0x010055B8@ */ ECIPP_ALIGNMENT_UWORD 564 Compu_FLEV_FTstd -460 563.984375 /end CHARACTERISTIC
/begin COMPU_METHOD Compu_FLEV_FTstd " " RAT_FUNC "%.1" "deg R" COEFFS 0 64 29440 0 0 1 /end COMPU_METHOD
/begin CHARACTERISTIC FLEV_FTP_empty "FLEV empty fuel tank pressure" VALUE 0x001c6f64 /* @ECU_Address@FLEV_FTP_empty@0x010055C0@ */ ECIPP_ALIGNMENT_UWORD 8192 Compu_FLEV_FTP_empty 0 8191.875 /end CHARACTERISTIC
/begin COMPU_METHOD Compu_FLEV_FTP_empty " " RAT_FUNC "%.1" "psig" COEFFS 0 8 0 0 0 1 /end COMPU_METHOD
/begin CHARACTERISTIC FLEV_FTP_full "FLEV full fuel tank pressure" VALUE 0x001c6f66 /* @ECU_Address@FLEV_FTP_full@0x010055C8@ */ ECIPP_ALIGNMENT_UWORD 8192 Compu_FLEV_FTP_full 0 8191.875 /end CHARACTERISTIC
/begin COMPU_METHOD Compu_FLEV_FTP_full " " RAT_FUNC "%.1" "psig" COEFFS 0 8 0 0 0 1 /end COMPU_METHOD
/begin CHARACTERISTIC FLEV_lo_trig "FLEV low fuel trigger" VALUE 0x001c6f6e /* @ECU_Address@FLEV_lo_trig@0x010055D0@ */ ECIPP_ALIGNMENT_UWORD 100 Compu_FLEV_lo_trig 0 99.9984741210938 /end CHARACTERISTIC
/begin COMPU_METHOD Compu_FLEV_lo_trig " " RAT_FUNC "%.1" "%" COEFFS 0 655.36 0 0 0 1 /end COMPU_METHOD
/begin CHARACTERISTIC FLEV_lo_hyst "FLEV low fuel hysteresis" VALUE 0x001c6f6c /* @ECU_Address@FLEV_lo_hyst@0x010055D8@ */ ECIPP_ALIGNMENT_UWORD 100 Compu_FLEV_lo_hyst 0 99.9984741210938 /end CHARACTERISTIC
/begin COMPU_METHOD Compu_FLEV_lo_hyst " " RAT_FUNC "%.1" "%" COEFFS 0 655.36 0 0 0 1 /end COMPU_METHOD
/begin CHARACTERISTIC FLEV_lo_LLpct "FLEV low fuel load-limit" VALUE 0x001c6f6a /* @ECU_Address@FLEV_lo_LLpct@0x010055E0@ */ ECIPP_ALIGNMENT_UWORD 400 Compu_FLEV_lo_LLpct 0 399.993896484375 /end CHARACTERISTIC
/begin COMPU_METHOD Compu_FLEV_lo_LLpct " " RAT_FUNC "%.1" "% max load" COEFFS 0 163.84 0 0 0 1 /end COMPU_METHOD
/begin CHARACTERISTIC FLEVgd_per "FLEV gauge driver PWM period" VALUE 0x001c6f70 /* @ECU_Address@FLEVgd_per@0x010055E8@ */ ECIPP_ALIGNMENT_UWORD 210 Compu_FLEVgd_per 0 209.712 /end CHARACTERISTIC
/begin COMPU_METHOD Compu_FLEVgd_per " " RAT_FUNC "%.1" "ms" COEFFS 0 312.5 0 0 0 1 /end COMPU_METHOD
/begin MEASUREMENT FLEV_lo_active "FLEV low fuel level" UBYTE Compu_FLEV_lo_active 0 0 0 255 ECU_ADDRESS 0x010055F0 /end MEASUREMENT
/begin COMPU_METHOD Compu_FLEV_lo_active " " RAT_FUNC "%.0" "-" COEFFS 0 1 0 0 0 1 /end COMPU_METHOD
/begin MEASUREMENT FLEV_pct "FLEV fuel level" UWORD Compu_FLEV_pct 0 0 0 99.9984741210938 ECU_ADDRESS 0x010055F8 /end MEASUREMENT
/begin COMPU_METHOD Compu_FLEV_pct " " RAT_FUNC "%.1" "%" COEFFS 0 655.36 0 0 0 1 /end COMPU_METHOD
/begin MEASUREMENT FLEVgd_DC "FLEV gauge driver duty-cycle" UWORD Compu_FLEVgd_DC 0 0 0 99.9984741210938 ECU_ADDRESS 0x01005600 /end MEASUREMENT
/begin COMPU_METHOD Compu_FLEVgd_DC " " RAT_FUNC "%.1" "%" COEFFS 0 655.36 0 0 0 1 /end COMPU_METHOD
/begin CHARACTERISTIC FRO_key_mode "Fuel run-out key-back-on transition{FRO_key_mode&0xff=0:Ignored}{FRO_key_mode&0xff=1:Continue Running}" VALUE 0x001c8730 /* @ECU_Address@FRO_key_mode@0x01005740@ */ ECIPP_ALIGNMENT_UBYTE 255 FRO_key_mode_COMPU_VTAB 0 255 BIT_MASK 0xff /end CHARACTERISTIC
/begin COMPU_METHOD FRO_key_mode_COMPU_VTAB "Verbal Table" TAB_VERB "%.0" "list" COMPU_TAB_REF FRO_key_mode_COMPU_VTAB_REF /end COMPU_METHOD
/begin COMPU_VTAB FRO_key_mode_COMPU_VTAB_REF "Verbal Table" TAB_VERB 2 0 "Ignored" 1 "Continue Running" DEFAULT_VALUE "UNKNOWN" /end COMPU_VTAB
/begin CHARACTERISTIC FRO_shutdown_ena "Fuel run-out fault shutdown{FRO_shutdown_ena&0xff=0:Disabled}{FRO_shutdown_ena&0xff=1:Enabled}" VALUE 0x001c8731 /* @ECU_Address@FRO_shutdown_ena@0x01005CA8@ */ ECIPP_ALIGNMENT_UBYTE 255 FRO_shutdown_ena_COMPU_VTAB 0 255 BIT_MASK 0xff /end CHARACTERISTIC
/begin COMPU_METHOD FRO_shutdown_ena_COMPU_VTAB "Verbal Table" TAB_VERB "%.0" "list" COMPU_TAB_REF FRO_shutdown_ena_COMPU_VTAB_REF /end COMPU_METHOD
/begin COMPU_VTAB FRO_shutdown_ena_COMPU_VTAB_REF "Verbal Table" TAB_VERB 2 0 "Disabled" 1 "Enabled" DEFAULT_VALUE "UNKNOWN" /end COMPU_VTAB
/begin CHARACTERISTIC V1gd_AL_ena "Volt1 gauge driver auto-learn{V1gd_AL_ena&0xff=0:Disabled}{V1gd_AL_ena&0xff=1:2-point mode}{V1gd_AL_ena&0xff=2:3-point mode}" VALUE 0x001c8f83 /* @ECU_Address@V1gd_AL_ena@0x01005D38@ */ ECIPP_ALIGNMENT_UBYTE 255 V1gd_AL_ena_COMPU_VTAB 0 255 BIT_MASK 0xff /end CHARACTERISTIC
/begin COMPU_METHOD V1gd_AL_ena_COMPU_VTAB "Verbal Table" TAB_VERB "%.0" "list" COMPU_TAB_REF V1gd_AL_ena_COMPU_VTAB_REF /end COMPU_METHOD
/begin COMPU_VTAB V1gd_AL_ena_COMPU_VTAB_REF "Verbal Table" TAB_VERB 3 0 "Disabled" 1 "2-point mode" 2 "3-point mode" DEFAULT_VALUE "UNKNOWN" /end COMPU_VTAB
/begin CHARACTERISTIC V1gd_AL_Rlo "Volt1 gauge AL input low R" VALUE 0x001c8312 /* @ECU_Address@V1gd_AL_Rlo@0x01005D40@ */ ECIPP_ALIGNMENT_UWORD 8192 Compu_V1gd_AL_Rlo 0 8191.875 /end CHARACTERISTIC
/begin COMPU_METHOD Compu_V1gd_AL_Rlo " " RAT_FUNC "%.1" "ohms" COEFFS 0 8 0 0 0 1 /end COMPU_METHOD
/begin CHARACTERISTIC V1gd_AL_Rhi "Volt1 gauge AL input high R" VALUE 0x001c8310 /* @ECU_Address@V1gd_AL_Rhi@0x01005D48@ */ ECIPP_ALIGNMENT_UWORD 8192 Compu_V1gd_AL_Rhi 0 8191.875 /end CHARACTERISTIC
/begin COMPU_METHOD Compu_V1gd_AL_Rhi " " RAT_FUNC "%.1" "ohms" COEFFS 0 8 0 0 0 1 /end COMPU_METHOD
/begin CHARACTERISTIC V1gd_AL_Vlo_def "Volt1 gauge AL input low init" VALUE 0x001c8318 /* @ECU_Address@V1gd_AL_Vlo_def@0x01005D50@ */ ECIPP_ALIGNMENT_UWORD 256 Compu_V1gd_AL_Vlo_def 0 255.99609375 /end CHARACTERISTIC
/begin COMPU_METHOD Compu_V1gd_AL_Vlo_def " " RAT_FUNC "%.2" "volts" COEFFS 0 256 0 0 0 1 /end COMPU_METHOD
/begin CHARACTERISTIC V1gd_AL_Vhi_def "Volt1 gauge AL input high init" VALUE 0x001c8316 /* @ECU_Address@V1gd_AL_Vhi_def@0x01005D58@ */ ECIPP_ALIGNMENT_UWORD 256 Compu_V1gd_AL_Vhi_def 0 255.99609375 /end CHARACTERISTIC
/begin COMPU_METHOD Compu_V1gd_AL_Vhi_def " " RAT_FUNC "%.2" "volts" COEFFS 0 256 0 0 0 1 /end COMPU_METHOD
/begin CHARACTERISTIC V1gd_AL_Vrate "Volt1 gauge AL max rate" VALUE 0x001c831c /* @ECU_Address@V1gd_AL_Vrate@0x01005D60@ */ ECIPP_ALIGNMENT_UWORD 5120 Compu_V1gd_AL_Vrate 0 5119.921875 /end CHARACTERISTIC
/begin COMPU_METHOD Compu_V1gd_AL_Vrate " " RAT_FUNC "%.1" "volts/sec" COEFFS 0 12.8 0 0 0 1 /end COMPU_METHOD
/begin MEASUREMENT V1gd_AL_tmr "Volt1 gauge AL disable wait" UWORD Compu_V1gd_AL_tmr 0 0 0 65.535 ECU_ADDRESS 0x01005D68 /end MEASUREMENT
/begin COMPU_METHOD Compu_V1gd_AL_tmr " " RAT_FUNC "%.1" "sec" COEFFS 0 1000 0 0 0 1 /end COMPU_METHOD
/begin MEASUREMENT V1gd_AL_Vlo "Volt1 gauge AL low limit" UWORD Compu_V1gd_AL_Vlo 0 0 0 255.99609375 ECU_ADDRESS 0x01005D70 /end MEASUREMENT
/begin COMPU_METHOD Compu_V1gd_AL_Vlo " " RAT_FUNC "%.2" "volts" COEFFS 0 256 0 0 0 1 /end COMPU_METHOD
/begin MEASUREMENT V1gd_AL_Vhi "Volt1 gauge AL high limit" UWORD Compu_V1gd_AL_Vhi 0 0 0 255.99609375 ECU_ADDRESS 0x01005D78 /end MEASUREMENT
/begin COMPU_METHOD Compu_V1gd_AL_Vhi " " RAT_FUNC "%.2" "volts" COEFFS 0 256 0 0 0 1 /end COMPU_METHOD
/begin MEASUREMENT V1gd_AL_rst "Volt1 gauge AL reset{V1gd_AL_rst&0xff=0:Idle}{V1gd_AL_rst&0xff=1:Reset}" UBYTE V1gd_AL_rst_COMPU_VTAB 0 0 0 255 ECU_ADDRESS 0x01005D80 BIT_MASK 0xff /end MEASUREMENT
/begin COMPU_METHOD V1gd_AL_rst_COMPU_VTAB "Verbal Table" TAB_VERB "%.0" "list" COMPU_TAB_REF V1gd_AL_rst_COMPU_VTAB_REF /end COMPU_METHOD
/begin COMPU_VTAB V1gd_AL_rst_COMPU_VTAB_REF "Verbal Table" TAB_VERB 2 0 "Idle" 1 "Reset" DEFAULT_VALUE "UNKNOWN" /end COMPU_VTAB
/begin CHARACTERISTIC V1gd_AL_Rmid "Volt1 gauge AL input mid R" VALUE 0x001c8314 /* @ECU_Address@V1gd_AL_Rmid@0x01005DA0@ */ ECIPP_ALIGNMENT_UWORD 8192 Compu_V1gd_AL_Rmid 0 8191.875 /end CHARACTERISTIC
/begin COMPU_METHOD Compu_V1gd_AL_Rmid " " RAT_FUNC "%.1" "ohms" COEFFS 0 8 0 0 0 1 /end COMPU_METHOD
/begin CHARACTERISTIC V1gd_AL_Vmid "Volt1 gauge AL input mid" VALUE 0x001c831a /* @ECU_Address@V1gd_AL_Vmid@0x01005DA8@ */ ECIPP_ALIGNMENT_UWORD 256 Compu_V1gd_AL_Vmid 0 255.99609375 /end CHARACTERISTIC
/begin COMPU_METHOD Compu_V1gd_AL_Vmid " " RAT_FUNC "%.2" "volts" COEFFS 0 256 0 0 0 1 /end COMPU_METHOD
/begin CHARACTERISTIC V1gd_AL_DChi "Volt1 gauge AL DC hi" VALUE 0x001c830a /* @ECU_Address@V1gd_AL_DChi@0x01005DB0@ */ ECIPP_ALIGNMENT_UWORD 400 Compu_V1gd_AL_DChi 0 399.993896484375 /end CHARACTERISTIC
/begin COMPU_METHOD Compu_V1gd_AL_DChi " " RAT_FUNC "%.1" "%" COEFFS 0 163.84 0 0 0 1 /end COMPU_METHOD
/begin CHARACTERISTIC V1gd_AL_DCmid "Volt1 gauge AL DC mid" VALUE 0x001c830e /* @ECU_Address@V1gd_AL_DCmid@0x01005DB8@ */ ECIPP_ALIGNMENT_UWORD 400 Compu_V1gd_AL_DCmid 0 399.993896484375 /end CHARACTERISTIC
/begin COMPU_METHOD Compu_V1gd_AL_DCmid " " RAT_FUNC "%.1" "%" COEFFS 0 163.84 0 0 0 1 /end COMPU_METHOD
/begin CHARACTERISTIC V1gd_AL_DClo "Volt1 gauge AL DC lo" VALUE 0x001c830c /* @ECU_Address@V1gd_AL_DClo@0x01005DC0@ */ ECIPP_ALIGNMENT_UWORD 400 Compu_V1gd_AL_DClo 0 399.993896484375 /end CHARACTERISTIC
/begin COMPU_METHOD Compu_V1gd_AL_DClo " " RAT_FUNC "%.1" "%" COEFFS 0 163.84 0 0 0 1 /end COMPU_METHOD
/begin CHARACTERISTIC LOCKOFF_keyonwt "Gaseous key-on lockoff open delay" VALUE 0x001c7cfc /* @ECU_Address@LOCKOFF_keyonwt@0x01005DD8@ */ ECIPP_ALIGNMENT_UWORD 65535 Compu_LOCKOFF_keyonwt 0 65535 /end CHARACTERISTIC
/begin COMPU_METHOD Compu_LOCKOFF_keyonwt " " RAT_FUNC "%.0" "ms" COEFFS 0 1 0 0 0 1 /end COMPU_METHOD
/begin CHARACTERISTIC Ginj_peak_offset "Peak off-time offset" VALUE 0x001C9F90 /* @ECU_Address@Ginj_peak_offset@0x01006490@ */ ECIPP_ALIGNMENT_UWORD 210 Compu_Ginj_peak_offset 0 209.712 /end CHARACTERISTIC
/begin COMPU_METHOD Compu_Ginj_peak_offset " " RAT_FUNC "%.3" "ms" COEFFS 0 312.5 0 0 0 1 /end COMPU_METHOD
/begin CHARACTERISTIC FRO_gov_state_freeze "Fuel run-out governor switch freeze{FRO_gov_state_freeze&0xff=0:Disabled}{FRO_gov_state_freeze&0xff=1:Enabled}" VALUE 0x001c872f /* @ECU_Address@FRO_gov_state_freeze@0x01006850@ */ ECIPP_ALIGNMENT_UBYTE 255 FRO_gov_state_freeze_COMPU_VTAB 0 255 BIT_MASK 0xff /end CHARACTERISTIC
/begin COMPU_METHOD FRO_gov_state_freeze_COMPU_VTAB "Verbal Table" TAB_VERB "%.0" "list" COMPU_TAB_REF FRO_gov_state_freeze_COMPU_VTAB_REF /end COMPU_METHOD
/begin COMPU_VTAB FRO_gov_state_freeze_COMPU_VTAB_REF "Verbal Table" TAB_VERB 2 0 "Disabled" 1 "Enabled" DEFAULT_VALUE "UNKNOWN" /end COMPU_VTAB
/begin CHARACTERISTIC FRO_fuelclear_ms "Fuel run-out fuel clear time" VALUE 0x001c7b22 /* @ECU_Address@FRO_fuelclear_ms@0x01006A80@ */ ECIPP_ALIGNMENT_UWORD 65535 Compu_FRO_fuelclear_ms 0 65535 /end CHARACTERISTIC
/begin COMPU_METHOD Compu_FRO_fuelclear_ms " " RAT_FUNC "%.0" "ms" COEFFS 0 1 0 0 0 1 /end COMPU_METHOD
/begin MEASUREMENT inj1_last_falling "Injection 1 last EOI" SWORD Compu_inj1_last_falling 0 0 -2048 2047.9375 ECU_ADDRESS 0x01007148 /end MEASUREMENT
/begin COMPU_METHOD Compu_inj1_last_falling " " RAT_FUNC "%.1" "CAD BBDCI" COEFFS 0 16 0 0 0 1 /end COMPU_METHOD
/begin MEASUREMENT inj2_last_falling "Injection 2 last EOI" SWORD Compu_inj2_last_falling 0 0 -2048 2047.9375 ECU_ADDRESS 0x01007150 /end MEASUREMENT
/begin COMPU_METHOD Compu_inj2_last_falling " " RAT_FUNC "%.1" "CAD BBDCI" COEFFS 0 16 0 0 0 1 /end COMPU_METHOD
/begin MEASUREMENT inj3_last_falling "Injection 3 last EOI" SWORD Compu_inj3_last_falling 0 0 -2048 2047.9375 ECU_ADDRESS 0x01007158 /end MEASUREMENT
/begin COMPU_METHOD Compu_inj3_last_falling " " RAT_FUNC "%.1" "CAD BBDCI" COEFFS 0 16 0 0 0 1 /end COMPU_METHOD
/begin MEASUREMENT inj4_last_falling "Injection 4 last EOI" SWORD Compu_inj4_last_falling 0 0 -2048 2047.9375 ECU_ADDRESS 0x01007160 /end MEASUREMENT
/begin COMPU_METHOD Compu_inj4_last_falling " " RAT_FUNC "%.1" "CAD BBDCI" COEFFS 0 16 0 0 0 1 /end COMPU_METHOD
/begin MEASUREMENT inj5_last_falling "Injection 5 last EOI" SWORD Compu_inj5_last_falling 0 0 -2048 2047.9375 ECU_ADDRESS 0x01007168 /end MEASUREMENT
/begin COMPU_METHOD Compu_inj5_last_falling " " RAT_FUNC "%.1" "CAD BBDCI" COEFFS 0 16 0 0 0 1 /end COMPU_METHOD
/begin MEASUREMENT inj6_last_falling "Injection 6 last EOI" SWORD Compu_inj6_last_falling 0 0 -2048 2047.9375 ECU_ADDRESS 0x01007170 /end MEASUREMENT
/begin COMPU_METHOD Compu_inj6_last_falling " " RAT_FUNC "%.1" "CAD BBDCI" COEFFS 0 16 0 0 0 1 /end COMPU_METHOD
/begin MEASUREMENT inj7_last_falling "Injection 7 last EOI" SWORD Compu_inj7_last_falling 0 0 -2048 2047.9375 ECU_ADDRESS 0x01007178 /end MEASUREMENT
/begin COMPU_METHOD Compu_inj7_last_falling " " RAT_FUNC "%.1" "CAD BBDCI" COEFFS 0 16 0 0 0 1 /end COMPU_METHOD
/begin MEASUREMENT inj8_last_falling "Injection 8 last EOI" SWORD Compu_inj8_last_falling 0 0 -2048 2047.9375 ECU_ADDRESS 0x01007180 /end MEASUREMENT
/begin COMPU_METHOD Compu_inj8_last_falling " " RAT_FUNC "%.1" "CAD BBDCI" COEFFS 0 16 0 0 0 1 /end COMPU_METHOD
/begin MEASUREMENT inj9_last_falling "Injection 9 last EOI" SWORD Compu_inj9_last_falling 0 0 -2048 2047.9375 ECU_ADDRESS 0x010071C0 /end MEASUREMENT
/begin COMPU_METHOD Compu_inj9_last_falling " " RAT_FUNC "%.1" "CAD BBDCI" COEFFS 0 16 0 0 0 1 /end COMPU_METHOD
/begin MEASUREMENT inj10_last_falling "Injection 10 last EOI" SWORD Compu_inj10_last_falling 0 0 -2048 2047.9375 ECU_ADDRESS 0x010071C8 /end MEASUREMENT
/begin COMPU_METHOD Compu_inj10_last_falling " " RAT_FUNC "%.1" "CAD BBDCI" COEFFS 0 16 0 0 0 1 /end COMPU_METHOD
/begin CHARACTERISTIC LOCKOFF_hold_wait "Gaseous lockoff hold duty-cycle wait" VALUE 0x001c7cfa /* @ECU_Address@LOCKOFF_hold_wait@0x01007840@ */ ECIPP_ALIGNMENT_UWORD 66 Compu_LOCKOFF_hold_wait 0 65.535 /end CHARACTERISTIC
/begin COMPU_METHOD Compu_LOCKOFF_hold_wait " " RAT_FUNC "%.1" "sec" COEFFS 0 1000 0 0 0 1 /end COMPU_METHOD
/begin CHARACTERISTIC LOCKOFF_hold_DC "Gaseous lockoff hold duty-cycle" VALUE 0x001c7cf8 /* @ECU_Address@LOCKOFF_hold_DC@0x01007848@ */ ECIPP_ALIGNMENT_UWORD 100 Compu_LOCKOFF_hold_DC 0 99.9984741210938 /end CHARACTERISTIC
/begin COMPU_METHOD Compu_LOCKOFF_hold_DC " " RAT_FUNC "%.1" "%" COEFFS 0 655.36 0 0 0 1 /end COMPU_METHOD
/begin CHARACTERISTIC CRI_V_boost "Boost voltage" VALUE 0x001ed2c4 /* @ECU_Address@CRI_V_boost@0x01008808@ */ ECIPP_ALIGNMENT_UWORD 1024 Compu_CRI_V_boost 0 1023.984375 /end CHARACTERISTIC
/begin COMPU_METHOD Compu_CRI_V_boost " " RAT_FUNC "%.1" "volts" COEFFS 0 64 0 0 0 1 /end COMPU_METHOD
/begin CHARACTERISTIC CRI_i_peak "Peak current" VALUE 0x001ed2d2 /* @ECU_Address@CRI_i_peak@0x01008818@ */ ECIPP_ALIGNMENT_UWORD 128 Compu_CRI_i_peak 0 127.998046875 /end CHARACTERISTIC
/begin COMPU_METHOD Compu_CRI_i_peak " " RAT_FUNC "%.1" "amps" COEFFS 0 512 0 0 0 1 /end COMPU_METHOD
/begin CHARACTERISTIC CRI_i_hold "Hold current" VALUE 0x001ed2ce /* @ECU_Address@CRI_i_hold@0x01008820@ */ ECIPP_ALIGNMENT_UWORD 128 Compu_CRI_i_hold 0 127.998046875 /end CHARACTERISTIC
/begin COMPU_METHOD Compu_CRI_i_hold " " RAT_FUNC "%.1" "amps" COEFFS 0 512 0 0 0 1 /end COMPU_METHOD
/begin CHARACTERISTIC CRI_i_hys "Peak/Hold hysteresis" VALUE 0x001ed2d0 /* @ECU_Address@CRI_i_hys@0x01008828@ */ ECIPP_ALIGNMENT_UWORD 128 Compu_CRI_i_hys 0 127.998046875 /end CHARACTERISTIC
/begin COMPU_METHOD Compu_CRI_i_hys " " RAT_FUNC "%.2" "amps" COEFFS 0 512 0 0 0 1 /end COMPU_METHOD
/begin CHARACTERISTIC CRI_i_recharge "Boost recharge current" VALUE 0x001ed2d6 /* @ECU_Address@CRI_i_recharge@0x01008830@ */ ECIPP_ALIGNMENT_UWORD 128 Compu_CRI_i_recharge 0 127.998046875 /end CHARACTERISTIC
/begin COMPU_METHOD Compu_CRI_i_recharge " " RAT_FUNC "%.1" "amps" COEFFS 0 512 0 0 0 1 /end COMPU_METHOD
/begin CHARACTERISTIC CRI_i_HS_short "High-side short current" VALUE 0x001ed2ca /* @ECU_Address@CRI_i_HS_short@0x01008838@ */ ECIPP_ALIGNMENT_UWORD 128 Compu_CRI_i_HS_short 0 127.998046875 /end CHARACTERISTIC
/begin COMPU_METHOD Compu_CRI_i_HS_short " " RAT_FUNC "%.1" "amps" COEFFS 0 512 0 0 0 1 /end COMPU_METHOD
/begin CHARACTERISTIC CRI_i_LS_short "Low-side short current" VALUE 0x001ed2cc /* @ECU_Address@CRI_i_LS_short@0x01008840@ */ ECIPP_ALIGNMENT_UWORD 128 Compu_CRI_i_LS_short 0 127.998046875 /end CHARACTERISTIC
/begin COMPU_METHOD Compu_CRI_i_LS_short " " RAT_FUNC "%.1" "amps" COEFFS 0 512 0 0 0 1 /end COMPU_METHOD
/begin CHARACTERISTIC CRI_peak_time_min "Peak min time" VALUE 0x001ed2dc /* @ECU_Address@CRI_peak_time_min@0x01008848@ */ ECIPP_ALIGNMENT_UWORD 3277 Compu_CRI_peak_time_min 0 3276.75 /end CHARACTERISTIC
/begin COMPU_METHOD Compu_CRI_peak_time_min " " RAT_FUNC "%.0" "us" COEFFS 0 20 0 0 0 1 /end COMPU_METHOD
/begin CHARACTERISTIC CRI_peak_time_max "Peak max time" VALUE 0x001ed2da /* @ECU_Address@CRI_peak_time_max@0x01008850@ */ ECIPP_ALIGNMENT_UWORD 3277 Compu_CRI_peak_time_max 0 3276.75 /end CHARACTERISTIC
/begin COMPU_METHOD Compu_CRI_peak_time_max " " RAT_FUNC "%.0" "us" COEFFS 0 20 0 0 0 1 /end COMPU_METHOD
/begin CHARACTERISTIC CRI_hold_decay "Hold current decay" VALUE 0x001ed2c8 /* @ECU_Address@CRI_hold_decay@0x01008858@ */ ECIPP_ALIGNMENT_UWORD 3277 Compu_CRI_hold_decay 0 3276.75 /end CHARACTERISTIC
/begin COMPU_METHOD Compu_CRI_hold_decay " " RAT_FUNC "%.0" "us" COEFFS 0 20 0 0 0 1 /end COMPU_METHOD
/begin CHARACTERISTIC CRI_lift_pump_ena "Low-pressure lift pump output{CRI_lift_pump_ena&0xff=0:Disabled}{CRI_lift_pump_ena&0xff=1:Buzzer Output}{CRI_lift_pump_ena&0xff=2:MIL Output}{CRI_lift_pump_ena&0xff=3:TACH Output}{CRI_lift_pump_ena&0xff=4:Starter Output}{CRI_lift_pump_ena&0xff=5:EGOH1}{CR" VALUE 0x001ed324 /* @ECU_Address@CRI_lift_pump_ena@0x01008860@ */ ECIPP_ALIGNMENT_UBYTE 255 CRI_lift_pump_ena_COMPU_VTAB 0 255 BIT_MASK 0xff /end CHARACTERISTIC
/begin COMPU_METHOD CRI_lift_pump_ena_COMPU_VTAB "Verbal Table" TAB_VERB "%.0" "list" COMPU_TAB_REF CRI_lift_pump_ena_COMPU_VTAB_REF /end COMPU_METHOD
/begin COMPU_VTAB CRI_lift_pump_ena_COMPU_VTAB_REF "Verbal Table" TAB_VERB 32 0 "Disabled" 1 "Buzzer Output" 2 "MIL Output" 3 "TACH Output" 4 "Starter Output" 5 "EGOH1" 6 "EGOH2" 7 "EGOH3" 8 "EGOH4" 9 "Aux PWM1" 10 "Aux PWM2" 11 "Aux PWM3" 12 "Aux PWM4" 13 "Aux PWM5" 14 "Aux PWM6" 15 "Aux PWM7" 16 "Aux PWM8" 17 "Aux PWM9" 18 "Aux PWM10" 19 "Aux PWM11" 20 "Aux PWM12" 21 "Aux PWM13" 22 "Aux PWM14" 23 "Aux PWM15" 24 "Aux PWM16" 25 "Aux PWM17" 26 "Aux PWM18" 27 "Aux PWM19" 28 "Aux PWM20" 29 "Aux PWM21" 30 "Aux PWM22" 31 "Aux PWM23" DEFAULT_VALUE "UNKNOWN" /end COMPU_VTAB
/begin CHARACTERISTIC CRI_IMV_ena "IMV (inlet metering valve){CRI_IMV_ena&0xff=0:Disabled}{CRI_IMV_ena&0xff=1:Aux PWM8 i-control}{CRI_IMV_ena&0xff=2:Aux PWM9 i-control}" VALUE 0x001ed31a /* @ECU_Address@CRI_IMV_ena@0x01008868@ */ ECIPP_ALIGNMENT_UBYTE 255 CRI_IMV_ena_COMPU_VTAB 0 255 BIT_MASK 0xff /end CHARACTERISTIC
/begin COMPU_METHOD CRI_IMV_ena_COMPU_VTAB "Verbal Table" TAB_VERB "%.0" "list" COMPU_TAB_REF CRI_IMV_ena_COMPU_VTAB_REF /end COMPU_METHOD
/begin COMPU_VTAB CRI_IMV_ena_COMPU_VTAB_REF "Verbal Table" TAB_VERB 3 0 "Disabled" 1 "Aux PWM8 i-control" 2 "Aux PWM9 i-control" DEFAULT_VALUE "UNKNOWN" /end COMPU_VTAB
/begin CHARACTERISTIC CRI_IMVp_Kp "IMV rail pressure Kp gain" VALUE 0x001ecf38 /* @ECU_Address@CRI_IMVp_Kp@0x01008870@ */ ECIPP_ALIGNMENT_FLOAT32_IEEE 10000000000 Compu_CRI_IMVp_Kp -10000000000 10000000000 /end CHARACTERISTIC
/begin COMPU_METHOD Compu_CRI_IMVp_Kp " " RAT_FUNC "%.1" "CTLunits/Kbar" COEFFS 0 1 0 0 0 1 /end COMPU_METHOD
/begin CHARACTERISTIC CRI_IMVp_Ki "IMV rail pressure Ki gain" VALUE 0x001ecf34 /* @ECU_Address@CRI_IMVp_Ki@0x01008878@ */ ECIPP_ALIGNMENT_FLOAT32_IEEE 10000000000 Compu_CRI_IMVp_Ki -10000000000 10000000000 /end CHARACTERISTIC
/begin COMPU_METHOD Compu_CRI_IMVp_Ki " " RAT_FUNC "%.1" "CTLunits/Kbar/sec" COEFFS 0 1 0 0 0 1 /end COMPU_METHOD
/begin CHARACTERISTIC CRI_IMVp_Kd "IMV rail pressure Kd gain" VALUE 0x001ecf30 /* @ECU_Address@CRI_IMVp_Kd@0x01008880@ */ ECIPP_ALIGNMENT_FLOAT32_IEEE 10000000000 Compu_CRI_IMVp_Kd -10000000000 10000000000 /end CHARACTERISTIC
/begin COMPU_METHOD Compu_CRI_IMVp_Kd " " RAT_FUNC "%.1" "CTLunits/(Kbar/sec)" COEFFS 0 1 0 0 0 1 /end COMPU_METHOD
/begin MEASUREMENT CRI_Prail_target "Rail pressure final target" UWORD Compu_CRI_Prail_target 0 0 0 8191.875 ECU_ADDRESS 0x01008888 /end MEASUREMENT
/begin COMPU_METHOD Compu_CRI_Prail_target " " RAT_FUNC "%.0" "bar" COEFFS 0 8 0 0 0 1 /end COMPU_METHOD
/begin CHARACTERISTIC CRI_Prail_ena "Rail pressure sensor{CRI_Prail_ena&0xff=0:Disabled}{CRI_Prail_ena&0xff=1:Aux PU1}{CRI_Prail_ena&0xff=2:Aux PU2}{CRI_Prail_ena&0xff=3:Aux PU3}{CRI_Prail_ena&0xff=4:Aux PD1}{CRI_Prail_ena&0xff=5:Aux PD2}{CRI_Prail_ena&0xff=6:Aux PD3}{CRI_Prail_ena&0xff=7:Au" VALUE 0x001ed321 /* @ECU_Address@CRI_Prail_ena@0x010088E8@ */ ECIPP_ALIGNMENT_UBYTE 255 CRI_Prail_ena_COMPU_VTAB 0 255 BIT_MASK 0xff /end CHARACTERISTIC
/begin COMPU_METHOD CRI_Prail_ena_COMPU_VTAB "Verbal Table" TAB_VERB "%.0" "list" COMPU_TAB_REF CRI_Prail_ena_COMPU_VTAB_REF /end COMPU_METHOD
/begin COMPU_VTAB CRI_Prail_ena_COMPU_VTAB_REF "Verbal Table" TAB_VERB 36 0 "Disabled" 1 "Aux PU1" 2 "Aux PU2" 3 "Aux PU3" 4 "Aux PD1" 5 "Aux PD2" 6 "Aux PD3" 7 "Aux PUD1" 8 "Aux PUD2" 9 "Aux PUD3" 10 "Aux PUD4" 11 "Aux PUD5" 12 "Aux PUD6" 13 "Aux PUD7" 14 "Aux PUD8" 15 "Aux PUD9" 16 "Aux PUD10" 17 "Aux PUD11" 18 "Aux PUD12" 19 "Aux PUD13" 20 "Aux PUD14" 21 "Aux PUD15" 22 "Aux PUD16" 23 "Aux PUD17" 24 "Aux PUD18" 25 "Aux PUD19" 26 "Aux PUD20" 27 "Aux PUD21" 28 "Aux PUD22" 29 "Aux PUD23" 30 "Aux PUD24" 31 "Aux PUD25" 32 "SENT1 Data1" 33 "SENT1 Data2" 34 "SENT2 Data1" 35 "SENT2 Data2" DEFAULT_VALUE "UNKNOWN" /end COMPU_VTAB
/begin CHARACTERISTIC CRI_IMV_ohms_nom "IMV resistance R nominal" VALUE 0x001ed2ae /* @ECU_Address@CRI_IMV_ohms_nom@0x010089C8@ */ ECIPP_ALIGNMENT_UWORD 64 Compu_CRI_IMV_ohms_nom 0 63.9990234375 /end CHARACTERISTIC
/begin COMPU_METHOD Compu_CRI_IMV_ohms_nom " " RAT_FUNC "%.2" "ohms" COEFFS 0 1024 0 0 0 1 /end COMPU_METHOD
/begin CHARACTERISTIC CRI_IMV_mH "IMV inductance L" VALUE 0x001ed2ac /* @ECU_Address@CRI_IMV_mH@0x010089D0@ */ ECIPP_ALIGNMENT_UWORD 64 Compu_CRI_IMV_mH 0 63.9990234375 /end CHARACTERISTIC
/begin COMPU_METHOD Compu_CRI_IMV_mH " " RAT_FUNC "%.2" "mH" COEFFS 0 1024 0 0 0 1 /end COMPU_METHOD
/begin CHARACTERISTIC CRI_Prail_edot_n "Rail pressure edot interpolation" VALUE 0x001ed320 /* @ECU_Address@CRI_Prail_edot_n@0x010089E0@ */ ECIPP_ALIGNMENT_UBYTE 255 Compu_CRI_Prail_edot_n 0 255 /end CHARACTERISTIC
/begin COMPU_METHOD Compu_CRI_Prail_edot_n " " RAT_FUNC "%.0" "ms" COEFFS 0 1 0 0 0 1 /end COMPU_METHOD
/begin CHARACTERISTIC CRI_Prail_edot_LP "Rail pressure edot low-pass filter" VALUE 0x001ed314 /* @ECU_Address@CRI_Prail_edot_LP@0x010089E8@ */ ECIPP_ALIGNMENT_UWORD 65536 Compu_CRI_Prail_edot_LP 0.090168 65536 /end CHARACTERISTIC
/begin COMPU_METHOD Compu_CRI_Prail_edot_LP " " FORM "%.1" "ms"
 /begin FORMULA "-1 / log(1 - (X1 / 65536))" FORMULA_INV "(1 - exp(-1/X1)) * 65536" /end FORMULA
/end COMPU_METHOD
/begin MEASUREMENT CRI_Prail_edot "Rail pressure error derivative" FLOAT32_IEEE Compu_CRI_Prail_edot 0 0 -10000000000 10000000000 ECU_ADDRESS 0x010089F0 /end MEASUREMENT
/begin COMPU_METHOD Compu_CRI_Prail_edot " " RAT_FUNC "%.2" "Kbar/sec" COEFFS 0 1 0 0 0 1 /end COMPU_METHOD
/begin CHARACTERISTIC CRI_IMVp_acc_max "IMV rail pressure accum max" VALUE 0x001ecf3c /* @ECU_Address@CRI_IMVp_acc_max@0x010089F8@ */ ECIPP_ALIGNMENT_FLOAT32_IEEE 10000000000 Compu_CRI_IMVp_acc_max -10000000000 10000000000 /end CHARACTERISTIC
/begin COMPU_METHOD Compu_CRI_IMVp_acc_max " " RAT_FUNC "%.2" "CTLunits" COEFFS 0 1 0 0 0 1 /end COMPU_METHOD
/begin CHARACTERISTIC CRI_IMVp_acc_min "IMV rail pressure accum min" VALUE 0x001ecf40 /* @ECU_Address@CRI_IMVp_acc_min@0x01008A00@ */ ECIPP_ALIGNMENT_FLOAT32_IEEE 10000000000 Compu_CRI_IMVp_acc_min -10000000000 10000000000 /end CHARACTERISTIC
/begin COMPU_METHOD Compu_CRI_IMVp_acc_min " " RAT_FUNC "%.2" "CTLunits" COEFFS 0 1 0 0 0 1 /end COMPU_METHOD
/begin MEASUREMENT CRI_IMVi_cmd "IMV i-command final" UWORD Compu_CRI_IMVi_cmd 0 0 0 63.9990234375 ECU_ADDRESS 0x01008A18 /end MEASUREMENT
/begin COMPU_METHOD Compu_CRI_IMVi_cmd " " RAT_FUNC "%.2" "amps" COEFFS 0 1024 0 0 0 1 /end COMPU_METHOD
/begin MEASUREMENT CRI_IMVd_imag "IMV dither amplitude" UWORD Compu_CRI_IMVd_imag 0 0 0 63.9990234375 ECU_ADDRESS 0x01008A20 /end MEASUREMENT
/begin COMPU_METHOD Compu_CRI_IMVd_imag " " RAT_FUNC "%.2" "amps" COEFFS 0 1024 0 0 0 1 /end COMPU_METHOD
/begin MEASUREMENT CRI_IMVd_fHz "IMV dither frequency" UWORD Compu_CRI_IMVd_fHz 0 0 0 4095.9375 ECU_ADDRESS 0x01008A28 /end MEASUREMENT
/begin COMPU_METHOD Compu_CRI_IMVd_fHz " " RAT_FUNC "%.1" "Hz" COEFFS 0 16 0 0 0 1 /end COMPU_METHOD
/begin CHARACTERISTIC CRI_IMV_Vdiode "IMV recirc diode drop" VALUE 0x001ed2aa /* @ECU_Address@CRI_IMV_Vdiode@0x01008A30@ */ ECIPP_ALIGNMENT_UWORD 256 Compu_CRI_IMV_Vdiode 0 255.99609375 /end CHARACTERISTIC
/begin COMPU_METHOD Compu_CRI_IMV_Vdiode " " RAT_FUNC "%.2" "volts" COEFFS 0 256 0 0 0 1 /end COMPU_METHOD
/begin CHARACTERISTIC CRI_IMV_ohms_Ki "IMV resistance R gain" VALUE 0x001ecf1c /* @ECU_Address@CRI_IMV_ohms_Ki@0x01008A40@ */ ECIPP_ALIGNMENT_FLOAT32_IEEE 10000000000 Compu_CRI_IMV_ohms_Ki -10000000000 10000000000 /end CHARACTERISTIC
/begin COMPU_METHOD Compu_CRI_IMV_ohms_Ki " " RAT_FUNC "%.2" "ohms/amp/sec" COEFFS 0 1 0 0 0 1 /end COMPU_METHOD
/begin MEASUREMENT CRI_IMV_ohms "IMV resistance R estimate" FLOAT32_IEEE Compu_CRI_IMV_ohms 0 0 -10000000000 10000000000 ECU_ADDRESS 0x01008BE0 /end MEASUREMENT
/begin COMPU_METHOD Compu_CRI_IMV_ohms " " RAT_FUNC "%.2" "ohms" COEFFS 0 1 0 0 0 1 /end COMPU_METHOD
/begin CHARACTERISTIC CRI_IMV_ohms_min "IMV resistance R min" VALUE 0x001ecf24 /* @ECU_Address@CRI_IMV_ohms_min@0x01008BE8@ */ ECIPP_ALIGNMENT_FLOAT32_IEEE 10000000000 Compu_CRI_IMV_ohms_min -10000000000 10000000000 /end CHARACTERISTIC
/begin COMPU_METHOD Compu_CRI_IMV_ohms_min " " RAT_FUNC "%.2" "ohms" COEFFS 0 1 0 0 0 1 /end COMPU_METHOD
/begin CHARACTERISTIC CRI_IMV_ohms_max "IMV resistance R max" VALUE 0x001ecf20 /* @ECU_Address@CRI_IMV_ohms_max@0x01008BF0@ */ ECIPP_ALIGNMENT_FLOAT32_IEEE 10000000000 Compu_CRI_IMV_ohms_max -10000000000 10000000000 /end CHARACTERISTIC
/begin COMPU_METHOD Compu_CRI_IMV_ohms_max " " RAT_FUNC "%.2" "ohms" COEFFS 0 1 0 0 0 1 /end COMPU_METHOD
/begin CHARACTERISTIC CRI_PCV_ena "PCV (pressure control valve){CRI_PCV_ena&0xff=0:Disabled}{CRI_PCV_ena&0xff=1:Aux PWM8 i-control}{CRI_PCV_ena&0xff=2:Aux PWM9 i-control}" VALUE 0x001ed31e /* @ECU_Address@CRI_PCV_ena@0x01008C20@ */ ECIPP_ALIGNMENT_UBYTE 255 CRI_PCV_ena_COMPU_VTAB 0 255 BIT_MASK 0xff /end CHARACTERISTIC
/begin COMPU_METHOD CRI_PCV_ena_COMPU_VTAB "Verbal Table" TAB_VERB "%.0" "list" COMPU_TAB_REF CRI_PCV_ena_COMPU_VTAB_REF /end COMPU_METHOD
/begin COMPU_VTAB CRI_PCV_ena_COMPU_VTAB_REF "Verbal Table" TAB_VERB 3 0 "Disabled" 1 "Aux PWM8 i-control" 2 "Aux PWM9 i-control" DEFAULT_VALUE "UNKNOWN" /end COMPU_VTAB
/begin MEASUREMENT fuel_trip_gas "Gaseous trip fuel" ULONG Compu_fuel_trip_gas 0 0 0 2147483647.5 ECU_ADDRESS 0x01008C88 /end MEASUREMENT
/begin COMPU_METHOD Compu_fuel_trip_gas " " RAT_FUNC "%.1" "kg" COEFFS 0 2 0 0 0 1 /end COMPU_METHOD
/begin CHARACTERISTIC FPin_a_I2 "Sec fuel rail pressure target" VALUE 0x001C9FAC /* @ECU_Address@FPin_a_I2@0x01009130@ */ ECIPP_ALIGNMENT_UWORD 256 Compu_FPin_a_I2 0 255.99609375 /end CHARACTERISTIC
/begin COMPU_METHOD Compu_FPin_a_I2 " " RAT_FUNC "%.1" "psia" COEFFS 0 256 0 0 0 1 /end COMPU_METHOD
/begin CHARACTERISTIC async_inj_ena_I2 "Sec Asynchronous Injection{async_inj_ena_I2&0xff=0x00:OFF}{async_inj_ena_I2&0xff=0x01:ON}" VALUE 0x001C9FC7 /* @ECU_Address@async_inj_ena_I2@0x01009168@ */ ECIPP_ALIGNMENT_UBYTE 255 async_inj_ena_I2_COMPU_VTAB 0 255 BIT_MASK 0xff /end CHARACTERISTIC
/begin COMPU_METHOD async_inj_ena_I2_COMPU_VTAB "Verbal Table" TAB_VERB "%.0" "list" COMPU_TAB_REF async_inj_ena_I2_COMPU_VTAB_REF /end COMPU_METHOD
/begin COMPU_VTAB async_inj_ena_I2_COMPU_VTAB_REF "Verbal Table" TAB_VERB 2 0x00 "OFF" 0x01 "ON" DEFAULT_VALUE "UNKNOWN" /end COMPU_VTAB
/begin CHARACTERISTIC Ginj_peak_offset_I2 "Sec peak off-time offset" VALUE 0x001C9FCC /* @ECU_Address@Ginj_peak_offset_I2@0x010091A8@ */ ECIPP_ALIGNMENT_UWORD 210 Compu_Ginj_peak_offset_I2 0 209.712 /end CHARACTERISTIC
/begin COMPU_METHOD Compu_Ginj_peak_offset_I2 " " RAT_FUNC "%.3" "ms" COEFFS 0 312.5 0 0 0 1 /end COMPU_METHOD
/begin CHARACTERISTIC inj_timing_dz_I2 "Sec injection timing dead-zone" VALUE 0x001C9FBE /* @ECU_Address@inj_timing_dz_I2@0x010091E8@ */ ECIPP_ALIGNMENT_SWORD 2048 Compu_inj_timing_dz_I2 -2048 2047.9375 /end CHARACTERISTIC
/begin COMPU_METHOD Compu_inj_timing_dz_I2 " " RAT_FUNC "%.0" "CAD" COEFFS 0 16 0 0 0 1 /end COMPU_METHOD
/begin CHARACTERISTIC inj_timing_dz_tau_I2 "Sec injection timing dead-zone tau" VALUE 0x001C9FC0 /* @ECU_Address@inj_timing_dz_tau_I2@0x010091F0@ */ ECIPP_ALIGNMENT_UWORD 163840 Compu_inj_timing_dz_tau_I2 0.16703 163840 /end CHARACTERISTIC
/begin COMPU_METHOD Compu_inj_timing_dz_tau_I2 " " FORM "%.0" "ms"
 /begin FORMULA "-5 / log(1.0000000000001 - (X1 / 32768))" FORMULA_INV "(1.0000000000001 - exp(-5/X1)) * 32768" /end FORMULA
/end COMPU_METHOD
/begin CHARACTERISTIC strt_inj_tmng_I2 "Start secondary injection timing" VALUE 0x001C9FC2 /* @ECU_Address@strt_inj_tmng_I2@0x010091F8@ */ ECIPP_ALIGNMENT_SWORD 2048 Compu_strt_inj_tmng_I2 -2048 2047.9375 /end CHARACTERISTIC
/begin COMPU_METHOD Compu_strt_inj_tmng_I2 " " RAT_FUNC "%.0" "CAD BBDCI" COEFFS 0 16 0 0 0 1 /end COMPU_METHOD
/begin MEASUREMENT active_fuel_device "Active fuel device{active_fuel_device&0xff=0:Invalid}{active_fuel_device&0xff=1:Pulse Injection - Pri}{active_fuel_device&0xff=2:Pulse Injection - Sec}{active_fuel_device&0xff=3:Carb - MJ / EPR}{active_fuel_device&0xff=4:Carb - PWM Trim}{active_fuel_devic" UBYTE active_fuel_device_COMPU_VTAB 0 0 0 255 ECU_ADDRESS 0x01009220 BIT_MASK 0xff /end MEASUREMENT
/begin COMPU_METHOD active_fuel_device_COMPU_VTAB "Verbal Table" TAB_VERB "%.0" "list" COMPU_TAB_REF active_fuel_device_COMPU_VTAB_REF /end COMPU_METHOD
/begin COMPU_VTAB active_fuel_device_COMPU_VTAB_REF "Verbal Table" TAB_VERB 9 0 "Invalid" 1 "Pulse Injection - Pri" 2 "Pulse Injection - Sec" 3 "Carb - MJ / EPR" 4 "Carb - PWM Trim" 5 "CFV Injection" 6 "Carb - Dual EPR" 7 "MFG Injection" 8 "8 - UNKNOWN" DEFAULT_VALUE "UNKNOWN" /end COMPU_VTAB
/begin MEASUREMENT fuel_trip_liquid "Liquid trip fuel" ULONG Compu_fuel_trip_liquid 0 0 0 4294967.295 ECU_ADDRESS 0x01009260 /end MEASUREMENT
/begin COMPU_METHOD Compu_fuel_trip_liquid " " RAT_FUNC "%.3" "L" COEFFS 0 1000 0 0 0 1 /end COMPU_METHOD
/begin MEASUREMENT CRI_Prail_targ_raw "Rail pressure raw target" UWORD Compu_CRI_Prail_targ_raw 0 0 0 8191.875 ECU_ADDRESS 0x0100A0E8 /end MEASUREMENT
/begin COMPU_METHOD Compu_CRI_Prail_targ_raw " " RAT_FUNC "%.0" "bar" COEFFS 0 8 0 0 0 1 /end COMPU_METHOD
/begin MEASUREMENT CRI_Prail_act_raw "Rail pressure raw actual" UWORD Compu_CRI_Prail_act_raw 0 0 0 8191.875 ECU_ADDRESS 0x0100A0F0 /end MEASUREMENT
/begin COMPU_METHOD Compu_CRI_Prail_act_raw " " RAT_FUNC "%.0" "bar" COEFFS 0 8 0 0 0 1 /end COMPU_METHOD
/begin CHARACTERISTIC CRI_ontime_min "Zero fuel pulse width" VALUE 0x001ecff4 /* @ECU_Address@CRI_ontime_min@0x0100A0F8@ */ ECIPP_ALIGNMENT_ULONG 214748365 Compu_CRI_ontime_min 0 214748364.75 /end CHARACTERISTIC
/begin COMPU_METHOD Compu_CRI_ontime_min " " RAT_FUNC "%.0" "us" COEFFS 0 20 0 0 0 1 /end COMPU_METHOD
/begin CHARACTERISTIC CRI_Prail_targ_LP "Rail pressure target tau" VALUE 0x001ed316 /* @ECU_Address@CRI_Prail_targ_LP@0x0100A100@ */ ECIPP_ALIGNMENT_UWORD 65536 Compu_CRI_Prail_targ_LP 0.090168 65536 /end CHARACTERISTIC
/begin COMPU_METHOD Compu_CRI_Prail_targ_LP " " FORM "%.1" "ms"
 /begin FORMULA "-1 / log(1 - (X1 / 65536))" FORMULA_INV "(1 - exp(-1/X1)) * 65536" /end FORMULA
/end COMPU_METHOD
/begin CHARACTERISTIC CRI_Prail_act_LP "Rail pressure actual tau" VALUE 0x001ed310 /* @ECU_Address@CRI_Prail_act_LP@0x0100A108@ */ ECIPP_ALIGNMENT_UWORD 65536 Compu_CRI_Prail_act_LP 0.090168 65536 /end CHARACTERISTIC
/begin COMPU_METHOD Compu_CRI_Prail_act_LP " " FORM "%.1" "ms"
 /begin FORMULA "-1 / log(1 - (X1 / 65536))" FORMULA_INV "(1 - exp(-1/X1)) * 65536" /end FORMULA
/end COMPU_METHOD
/begin CHARACTERISTIC CRI_Prail_act_ediLP "Rail pressure actual edot tau" VALUE 0x001ed312 /* @ECU_Address@CRI_Prail_act_ediLP@0x0100A110@ */ ECIPP_ALIGNMENT_UWORD 65536 Compu_CRI_Prail_act_ediLP 0.090168 65536 /end CHARACTERISTIC
/begin COMPU_METHOD Compu_CRI_Prail_act_ediLP " " FORM "%.1" "ms"
 /begin FORMULA "-1 / log(1 - (X1 / 65536))" FORMULA_INV "(1 - exp(-1/X1)) * 65536" /end FORMULA
/end COMPU_METHOD
/begin CHARACTERISTIC CRI_IMVp_Ddz "IMV rail pressure Kd deadzone" VALUE 0x001ecf28 /* @ECU_Address@CRI_IMVp_Ddz@0x0100A118@ */ ECIPP_ALIGNMENT_FLOAT32_IEEE 10000000000 Compu_CRI_IMVp_Ddz -10000000000 10000000000 /end CHARACTERISTIC
/begin COMPU_METHOD Compu_CRI_IMVp_Ddz " " RAT_FUNC "%.3" "Kbar/sec" COEFFS 0 1 0 0 0 1 /end COMPU_METHOD
/begin CHARACTERISTIC CRI_IMVp_FSO_Ifrz "IMV fuel shutoff negative I-freeze" VALUE 0x001ecf2c /* @ECU_Address@CRI_IMVp_FSO_Ifrz@0x0100A120@ */ ECIPP_ALIGNMENT_FLOAT32_IEEE 10000000000 Compu_CRI_IMVp_FSO_Ifrz -10000000000 10000000000 /end CHARACTERISTIC
/begin COMPU_METHOD Compu_CRI_IMVp_FSO_Ifrz " " RAT_FUNC "%.3" "Kbar/sec" COEFFS 0 1 0 0 0 1 /end COMPU_METHOD
/begin CHARACTERISTIC CRI_ontime_max "Time-based max fuel pulse width" VALUE 0x001ecff0 /* @ECU_Address@CRI_ontime_max@0x0100A258@ */ ECIPP_ALIGNMENT_ULONG 214748365 Compu_CRI_ontime_max 0 214748364.75 /end CHARACTERISTIC
/begin COMPU_METHOD Compu_CRI_ontime_max " " RAT_FUNC "%.0" "us" COEFFS 0 20 0 0 0 1 /end COMPU_METHOD
/begin CHARACTERISTIC CRI_Prail_min "Rail pressure min for injection" VALUE 0x001ed2c0 /* @ECU_Address@CRI_Prail_min@0x0100A260@ */ ECIPP_ALIGNMENT_UWORD 8192 Compu_CRI_Prail_min 0 8191.875 /end CHARACTERISTIC
/begin COMPU_METHOD Compu_CRI_Prail_min " " RAT_FUNC "%.1" "bar" COEFFS 0 8 0 0 0 1 /end COMPU_METHOD
/begin MEASUREMENT CRI_Prail_cld "Common rail P cold offset" SWORD Compu_CRI_Prail_cld 0 0 -4096 4095.875 ECU_ADDRESS 0x0100A2E8 /end MEASUREMENT
/begin COMPU_METHOD Compu_CRI_Prail_cld " " RAT_FUNC "%.1" "bar" COEFFS 0 8 0 0 0 1 /end COMPU_METHOD
/begin CHARACTERISTIC CRI_offtime_min "Injector minimum off time" VALUE 0x001ecf50 /* @ECU_Address@CRI_offtime_min@0x0100A760@ */ ECIPP_ALIGNMENT_FLOAT32_IEEE 10000000000 Compu_CRI_offtime_min -10000000000 10000000000 /end CHARACTERISTIC
/begin COMPU_METHOD Compu_CRI_offtime_min " " RAT_FUNC "%.0" "us" COEFFS 0 1 0 0 0 1 /end COMPU_METHOD
/begin MEASUREMENT CRI1_V_boost_filt "Bank 1 current boost voltage" UWORD Compu_CRI1_V_boost_filt 0 0 0 1023.984375 ECU_ADDRESS 0x0100B538 /end MEASUREMENT
/begin COMPU_METHOD Compu_CRI1_V_boost_filt " " RAT_FUNC "%.1" "volts" COEFFS 0 64 0 0 0 1 /end COMPU_METHOD
/begin MEASUREMENT CRI2_V_boost_filt "Bank 2 current boost voltage" UWORD Compu_CRI2_V_boost_filt 0 0 0 1023.984375 ECU_ADDRESS 0x0100B540 /end MEASUREMENT
/begin COMPU_METHOD Compu_CRI2_V_boost_filt " " RAT_FUNC "%.1" "volts" COEFFS 0 64 0 0 0 1 /end COMPU_METHOD
/begin CHARACTERISTIC CRI_i_peak_init "Initial peak current" VALUE 0x001ed2d4 /* @ECU_Address@CRI_i_peak_init@0x0100B548@ */ ECIPP_ALIGNMENT_UWORD 128 Compu_CRI_i_peak_init 0 127.998046875 /end CHARACTERISTIC
/begin COMPU_METHOD Compu_CRI_i_peak_init " " RAT_FUNC "%.1" "amps" COEFFS 0 512 0 0 0 1 /end COMPU_METHOD
/begin CHARACTERISTIC CRI_i_PH_offset "Peak->Hold transition trigger offset" VALUE 0x001ed012 /* @ECU_Address@CRI_i_PH_offset@0x0100B550@ */ ECIPP_ALIGNMENT_SWORD 64 Compu_CRI_i_PH_offset -64 63.998046875 /end CHARACTERISTIC
/begin COMPU_METHOD Compu_CRI_i_PH_offset " " RAT_FUNC "%.2" "amps" COEFFS 0 512 0 0 0 1 /end COMPU_METHOD
/begin CHARACTERISTIC CRI_IMVi_min "IMV current command minimum" VALUE 0x001ed2b2 /* @ECU_Address@CRI_IMVi_min@0x0100B558@ */ ECIPP_ALIGNMENT_UWORD 64 Compu_CRI_IMVi_min 0 63.9990234375 /end CHARACTERISTIC
/begin COMPU_METHOD Compu_CRI_IMVi_min " " RAT_FUNC "%.2" "amps" COEFFS 0 1024 0 0 0 1 /end COMPU_METHOD
/begin CHARACTERISTIC CRI_IMVi_max "IMV current command maximum" VALUE 0x001ed2b0 /* @ECU_Address@CRI_IMVi_max@0x0100B560@ */ ECIPP_ALIGNMENT_UWORD 64 Compu_CRI_IMVi_max 0 63.9990234375 /end CHARACTERISTIC
/begin COMPU_METHOD Compu_CRI_IMVi_max " " RAT_FUNC "%.2" "amps" COEFFS 0 1024 0 0 0 1 /end COMPU_METHOD
/begin CHARACTERISTIC CRI_IMVp_NCvalve "IMV valve type{CRI_IMVp_NCvalve&0xff=0:Normally Open}{CRI_IMVp_NCvalve&0xff=1:Normally Closed}" VALUE 0x001ed31d /* @ECU_Address@CRI_IMVp_NCvalve@0x0100B568@ */ ECIPP_ALIGNMENT_UBYTE 255 CRI_IMVp_NCvalve_COMPU_VTAB 0 255 BIT_MASK 0xff /end CHARACTERISTIC
/begin COMPU_METHOD CRI_IMVp_NCvalve_COMPU_VTAB "Verbal Table" TAB_VERB "%.0" "list" COMPU_TAB_REF CRI_IMVp_NCvalve_COMPU_VTAB_REF /end COMPU_METHOD
/begin COMPU_VTAB CRI_IMVp_NCvalve_COMPU_VTAB_REF "Verbal Table" TAB_VERB 2 0 "Normally Open" 1 "Normally Closed" DEFAULT_VALUE "UNKNOWN" /end COMPU_VTAB
/begin CHARACTERISTIC CRI_IMV_pulsed "IMV valve control strategy{CRI_IMV_pulsed&0xff=0:Continuous Current}{CRI_IMV_pulsed&0xff=1:Time-Pulsed Synchronous}{CRI_IMV_pulsed&0xff=2:CAD-Pulsed Synchronous}" VALUE 0x001ed31b /* @ECU_Address@CRI_IMV_pulsed@0x0100B5E0@ */ ECIPP_ALIGNMENT_UBYTE 255 CRI_IMV_pulsed_COMPU_VTAB 0 255 BIT_MASK 0xff /end CHARACTERISTIC
/begin COMPU_METHOD CRI_IMV_pulsed_COMPU_VTAB "Verbal Table" TAB_VERB "%.0" "list" COMPU_TAB_REF CRI_IMV_pulsed_COMPU_VTAB_REF /end COMPU_METHOD
/begin COMPU_VTAB CRI_IMV_pulsed_COMPU_VTAB_REF "Verbal Table" TAB_VERB 3 0 "Continuous Current" 1 "Time-Pulsed Synchronous" 2 "CAD-Pulsed Synchronous" DEFAULT_VALUE "UNKNOWN" /end COMPU_VTAB
/begin CHARACTERISTIC IMV_pulse_phase "Pulsed-IMV end-of-pulse timing" VALUE 0x001ed018 /* @ECU_Address@IMV_pulse_phase@0x0100B5E8@ */ ECIPP_ALIGNMENT_SWORD 2048 Compu_IMV_pulse_phase -2048 2047.9375 /end CHARACTERISTIC
/begin COMPU_METHOD Compu_IMV_pulse_phase " " RAT_FUNC "%.1" "CAD BTDCC #1" COEFFS 0 16 0 0 0 1 /end COMPU_METHOD
/begin CHARACTERISTIC IMV_pulse_spacing "Pulsed-IMV pulse spacing" VALUE 0x001ed2ee /* @ECU_Address@IMV_pulse_spacing@0x0100B5F0@ */ ECIPP_ALIGNMENT_UWORD 4096 Compu_IMV_pulse_spacing 0 4095.9375 /end CHARACTERISTIC
/begin COMPU_METHOD Compu_IMV_pulse_spacing " " RAT_FUNC "%.1" "CAD" COEFFS 0 16 0 0 0 1 /end COMPU_METHOD
/begin CHARACTERISTIC IMVpulse_Ipeak "Pulsed-IMV waveform peak current" VALUE 0x001ed2fa /* @ECU_Address@IMVpulse_Ipeak@0x0100B5F8@ */ ECIPP_ALIGNMENT_UWORD 64 Compu_IMVpulse_Ipeak 0 63.9990234375 /end CHARACTERISTIC
/begin COMPU_METHOD Compu_IMVpulse_Ipeak " " RAT_FUNC "%.2" "amps" COEFFS 0 1024 0 0 0 1 /end COMPU_METHOD
/begin CHARACTERISTIC IMVpulse_Ireduce "Pulsed-IMV waveform avg reduce current" VALUE 0x001ed2fc /* @ECU_Address@IMVpulse_Ireduce@0x0100B600@ */ ECIPP_ALIGNMENT_UWORD 64 Compu_IMVpulse_Ireduce 0 63.9990234375 /end CHARACTERISTIC
/begin COMPU_METHOD Compu_IMVpulse_Ireduce " " RAT_FUNC "%.2" "amps" COEFFS 0 1024 0 0 0 1 /end COMPU_METHOD
/begin CHARACTERISTIC IMVpulse_Ihold "Pulsed-IMV waveform hold current" VALUE 0x001ed2f8 /* @ECU_Address@IMVpulse_Ihold@0x0100B608@ */ ECIPP_ALIGNMENT_UWORD 64 Compu_IMVpulse_Ihold 0 63.9990234375 /end CHARACTERISTIC
/begin COMPU_METHOD Compu_IMVpulse_Ihold " " RAT_FUNC "%.2" "amps" COEFFS 0 1024 0 0 0 1 /end COMPU_METHOD
/begin CHARACTERISTIC IMVpulse_Icushion "Pulsed-IMV waveform cushion current" VALUE 0x001ed2f6 /* @ECU_Address@IMVpulse_Icushion@0x0100B610@ */ ECIPP_ALIGNMENT_UWORD 64 Compu_IMVpulse_Icushion 0 63.9990234375 /end CHARACTERISTIC
/begin COMPU_METHOD Compu_IMVpulse_Icushion " " RAT_FUNC "%.2" "amps" COEFFS 0 1024 0 0 0 1 /end COMPU_METHOD
/begin CHARACTERISTIC IMVpulse_Treduce "Pulsed-IMV waveform reduce duration" VALUE 0x001ed308 /* @ECU_Address@IMVpulse_Treduce@0x0100B618@ */ ECIPP_ALIGNMENT_UWORD 65535 Compu_IMVpulse_Treduce 0 65535 /end CHARACTERISTIC
/begin COMPU_METHOD Compu_IMVpulse_Treduce " " RAT_FUNC "%.0" "us" COEFFS 0 1 0 0 0 1 /end COMPU_METHOD
/begin CHARACTERISTIC IMVpulse_Tpause "Pulsed-IMV waveform pause duration" VALUE 0x001ed304 /* @ECU_Address@IMVpulse_Tpause@0x0100B620@ */ ECIPP_ALIGNMENT_UWORD 65535 Compu_IMVpulse_Tpause 0 65535 /end CHARACTERISTIC
/begin COMPU_METHOD Compu_IMVpulse_Tpause " " RAT_FUNC "%.0" "us" COEFFS 0 1 0 0 0 1 /end COMPU_METHOD
/begin CHARACTERISTIC IMVpulse_Tcushion "Pulsed-IMV waveform cushion duration" VALUE 0x001ed2fe /* @ECU_Address@IMVpulse_Tcushion@0x0100B628@ */ ECIPP_ALIGNMENT_UWORD 65535 Compu_IMVpulse_Tcushion 0 65535 /end CHARACTERISTIC
/begin COMPU_METHOD Compu_IMVpulse_Tcushion " " RAT_FUNC "%.0" "us" COEFFS 0 1 0 0 0 1 /end COMPU_METHOD
/begin CHARACTERISTIC IMVpulse_Tdecay "Pulsed-IMV waveform decay duration" VALUE 0x001ed300 /* @ECU_Address@IMVpulse_Tdecay@0x0100B630@ */ ECIPP_ALIGNMENT_UWORD 65535 Compu_IMVpulse_Tdecay 0 65535 /end CHARACTERISTIC
/begin COMPU_METHOD Compu_IMVpulse_Tdecay " " RAT_FUNC "%.0" "us" COEFFS 0 1 0 0 0 1 /end COMPU_METHOD
/begin MEASUREMENT CRI_IMVcad_final "Pulsed-IMV final CAD duration equivalent" SWORD Compu_CRI_IMVcad_final 0 0 -2048 2047.9375 ECU_ADDRESS 0x0100B638 /end MEASUREMENT
/begin COMPU_METHOD Compu_CRI_IMVcad_final " " RAT_FUNC "%.1" "CAD" COEFFS 0 16 0 0 0 1 /end COMPU_METHOD
/begin CHARACTERISTIC CRI_IMVpw_min "Pulsed-IMV effective elecrical on-time min" VALUE 0x001ecf4c /* @ECU_Address@CRI_IMVpw_min@0x0100B640@ */ ECIPP_ALIGNMENT_FLOAT32_IEEE 10000000000 Compu_CRI_IMVpw_min -10000000000 10000000000 /end CHARACTERISTIC
/begin COMPU_METHOD Compu_CRI_IMVpw_min " " RAT_FUNC "%.2" "ms" COEFFS 0 1 0 0 0 1 /end COMPU_METHOD
/begin CHARACTERISTIC CRI_IMVpw_max "Pulsed-IMV effective elecrical on-time max" VALUE 0x001ecf48 /* @ECU_Address@CRI_IMVpw_max@0x0100B648@ */ ECIPP_ALIGNMENT_FLOAT32_IEEE 10000000000 Compu_CRI_IMVpw_max -10000000000 10000000000 /end CHARACTERISTIC
/begin COMPU_METHOD Compu_CRI_IMVpw_max " " RAT_FUNC "%.2" "ms" COEFFS 0 1 0 0 0 1 /end COMPU_METHOD
/begin MEASUREMENT CRI_IMVpw_cmd "Pulsed-IMV effective electrical on-time command" FLOAT32_IEEE Compu_CRI_IMVpw_cmd 0 0 -10000000000 10000000000 ECU_ADDRESS 0x0100B650 /end MEASUREMENT
/begin COMPU_METHOD Compu_CRI_IMVpw_cmd " " RAT_FUNC "%.2" "ms" COEFFS 0 1 0 0 0 1 /end COMPU_METHOD
/begin MEASUREMENT CRI_IMV_PID "IMV rail pressure control PID term" FLOAT32_IEEE Compu_CRI_IMV_PID 0 0 -10000000000 10000000000 ECU_ADDRESS 0x0100B658 /end MEASUREMENT
/begin COMPU_METHOD Compu_CRI_IMV_PID " " RAT_FUNC "%.2" "CTLunits" COEFFS 0 1 0 0 0 1 /end COMPU_METHOD
/begin MEASUREMENT CRI_IMV_Iaccum "IMV rail pressure control integrator" FLOAT32_IEEE Compu_CRI_IMV_Iaccum 0 0 -10000000000 10000000000 ECU_ADDRESS 0x0100B660 /end MEASUREMENT
/begin COMPU_METHOD Compu_CRI_IMV_Iaccum " " RAT_FUNC "%.2" "CTLunits" COEFFS 0 1 0 0 0 1 /end COMPU_METHOD
/begin CHARACTERISTIC CRI_hold_recharge "Boost recharging during hold phase{CRI_hold_recharge&0xff=0x00:Disabled}{CRI_hold_recharge&0xff=0x01:Enabled}" VALUE 0x001ed323 /* @ECU_Address@CRI_hold_recharge@0x0100B668@ */ ECIPP_ALIGNMENT_UBYTE 255 CRI_hold_recharge_COMPU_VTAB 0 255 BIT_MASK 0xff /end CHARACTERISTIC
/begin COMPU_METHOD CRI_hold_recharge_COMPU_VTAB "Verbal Table" TAB_VERB "%.0" "list" COMPU_TAB_REF CRI_hold_recharge_COMPU_VTAB_REF /end COMPU_METHOD
/begin COMPU_VTAB CRI_hold_recharge_COMPU_VTAB_REF "Verbal Table" TAB_VERB 2 0x00 "Disabled" 0x01 "Enabled" DEFAULT_VALUE "UNKNOWN" /end COMPU_VTAB
/begin CHARACTERISTIC CRI_peakhold_decay "Peak-to-Hold transition wait time" VALUE 0x001ed2de /* @ECU_Address@CRI_peakhold_decay@0x0100B670@ */ ECIPP_ALIGNMENT_UWORD 3277 Compu_CRI_peakhold_decay 0 3276.75 /end CHARACTERISTIC
/begin COMPU_METHOD Compu_CRI_peakhold_decay " " RAT_FUNC "%.0" "us" COEFFS 0 20 0 0 0 1 /end COMPU_METHOD
/begin MEASUREMENT IMVpulsetest_mode "Pulsed-IMV test pulse mode{IMVpulsetest_mode&0xff=0x00:Disabled}{IMVpulsetest_mode&0xff=0x01:Pulsing}" UBYTE IMVpulsetest_mode_COMPU_VTAB 0 0 0 255 ECU_ADDRESS 0x0100B698 BIT_MASK 0xff /end MEASUREMENT
/begin COMPU_METHOD IMVpulsetest_mode_COMPU_VTAB "Verbal Table" TAB_VERB "%.0" "list" COMPU_TAB_REF IMVpulsetest_mode_COMPU_VTAB_REF /end COMPU_METHOD
/begin COMPU_VTAB IMVpulsetest_mode_COMPU_VTAB_REF "Verbal Table" TAB_VERB 2 0x00 "Disabled" 0x01 "Pulsing" DEFAULT_VALUE "UNKNOWN" /end COMPU_VTAB
/begin MEASUREMENT IMVpulsetest_pw "Pulsed-IMV test pulse duration" UWORD Compu_IMVpulsetest_pw 0 0 0 65535 ECU_ADDRESS 0x0100B6A0 /end MEASUREMENT
/begin COMPU_METHOD Compu_IMVpulsetest_pw " " RAT_FUNC "%.0" "us" COEFFS 0 1 0 0 0 1 /end COMPU_METHOD
/begin MEASUREMENT CRI_IMVpw_total "Pulsed-IMV total on-time" FLOAT32_IEEE Compu_CRI_IMVpw_total 0 0 -10000000000 10000000000 ECU_ADDRESS 0x0100B6A8 /end MEASUREMENT
/begin COMPU_METHOD Compu_CRI_IMVpw_total " " RAT_FUNC "%.2" "ms" COEFFS 0 1 0 0 0 1 /end COMPU_METHOD
/begin CHARACTERISTIC CRI_IMVp_baseline "IMV current/on-time zero-reponse offset" VALUE 0x001ecf44 /* @ECU_Address@CRI_IMVp_baseline@0x0100B6B0@ */ ECIPP_ALIGNMENT_FLOAT32_IEEE 10000000000 Compu_CRI_IMVp_baseline -10000000000 10000000000 /end CHARACTERISTIC
/begin COMPU_METHOD Compu_CRI_IMVp_baseline " " RAT_FUNC "%.2" "amps or ms" COEFFS 0 1 0 0 0 1 /end COMPU_METHOD
/begin CHARACTERISTIC CRI_Prail_targdz_LP "Rail pressure target deadzone tau" VALUE 0x001ed318 /* @ECU_Address@CRI_Prail_targdz_LP@0x0100B6B8@ */ ECIPP_ALIGNMENT_UWORD 65536 Compu_CRI_Prail_targdz_LP 0.090168 65536 /end CHARACTERISTIC
/begin COMPU_METHOD Compu_CRI_Prail_targdz_LP " " FORM "%.1" "ms"
 /begin FORMULA "-1 / log(1 - (X1 / 65536))" FORMULA_INV "(1 - exp(-1/X1)) * 65536" /end FORMULA
/end COMPU_METHOD
/begin CHARACTERISTIC CRI_Prail_targ_dz "Rail pressure target deadzone" VALUE 0x001ed2c2 /* @ECU_Address@CRI_Prail_targ_dz@0x0100B6C0@ */ ECIPP_ALIGNMENT_UWORD 8192 Compu_CRI_Prail_targ_dz 0 8191.875 /end CHARACTERISTIC
/begin COMPU_METHOD Compu_CRI_Prail_targ_dz " " RAT_FUNC "%.0" "bar" COEFFS 0 8 0 0 0 1 /end COMPU_METHOD
/begin MEASUREMENT CRI_IMVff_TLU "IMV feedforward table lookup value" FLOAT32_IEEE Compu_CRI_IMVff_TLU 0 0 -10000000000 10000000000 ECU_ADDRESS 0x0100B6C8 /end MEASUREMENT
/begin COMPU_METHOD Compu_CRI_IMVff_TLU " " RAT_FUNC "%.2" "amps or mA/mg or us/mg or CAD/mg" COEFFS 0 1 0 0 0 1 /end COMPU_METHOD
/begin MEASUREMENT CRI_IMVp_ff "IMV feedforward control adder" FLOAT32_IEEE Compu_CRI_IMVp_ff 0 0 -10000000000 10000000000 ECU_ADDRESS 0x0100B6D0 /end MEASUREMENT
/begin COMPU_METHOD Compu_CRI_IMVp_ff " " RAT_FUNC "%.2" "CTLunits" COEFFS 0 1 0 0 0 1 /end COMPU_METHOD
/begin CHARACTERISTIC CRI_IMVff_mode "IMV feedforward table mode/units{CRI_IMVff_mode&0xff=0:Disabled}{CRI_IMVff_mode&0xff=1:Amps}{CRI_IMVff_mode&0xff=2:mA / mg fuel}{CRI_IMVff_mode&0xff=3:us / mg fuel}{CRI_IMVff_mode&0xff=4:CAD / mg fuel}" VALUE 0x001ed31c /* @ECU_Address@CRI_IMVff_mode@0x0100B6D8@ */ ECIPP_ALIGNMENT_UBYTE 255 CRI_IMVff_mode_COMPU_VTAB 0 255 BIT_MASK 0xff /end CHARACTERISTIC
/begin COMPU_METHOD CRI_IMVff_mode_COMPU_VTAB "Verbal Table" TAB_VERB "%.0" "list" COMPU_TAB_REF CRI_IMVff_mode_COMPU_VTAB_REF /end COMPU_METHOD
/begin COMPU_VTAB CRI_IMVff_mode_COMPU_VTAB_REF "Verbal Table" TAB_VERB 5 0 "Disabled" 1 "Amps" 2 "mA / mg fuel" 3 "us / mg fuel" 4 "CAD / mg fuel" DEFAULT_VALUE "UNKNOWN" /end COMPU_VTAB
/begin CHARACTERISTIC IMVpulse_Tpeak_max "Pulsed-IMV waveform max peak duration" VALUE 0x001ed306 /* @ECU_Address@IMVpulse_Tpeak_max@0x0100B6E0@ */ ECIPP_ALIGNMENT_UWORD 65535 Compu_IMVpulse_Tpeak_max 0 65535 /end CHARACTERISTIC
/begin COMPU_METHOD Compu_IMVpulse_Tpeak_max " " RAT_FUNC "%.0" "us" COEFFS 0 1 0 0 0 1 /end COMPU_METHOD
/begin CHARACTERISTIC IMVpulse_Ttotal_max "Pulsed-IMV waveform max total duration" VALUE 0x001ed30a /* @ECU_Address@IMVpulse_Ttotal_max@0x0100B6E8@ */ ECIPP_ALIGNMENT_UWORD 65535 Compu_IMVpulse_Ttotal_max 0 65535 /end CHARACTERISTIC
/begin COMPU_METHOD Compu_IMVpulse_Ttotal_max " " RAT_FUNC "%.0" "us" COEFFS 0 1 0 0 0 1 /end COMPU_METHOD
/begin MEASUREMENT CRI_IMVi_FB "IMV current control feedback value" SWORD Compu_CRI_IMVi_FB 0 0 -32 31.9990234375 ECU_ADDRESS 0x0100B6F0 /end MEASUREMENT
/begin COMPU_METHOD Compu_CRI_IMVi_FB " " RAT_FUNC "%.2" "amps" COEFFS 0 1024 0 0 0 1 /end COMPU_METHOD
/begin CHARACTERISTIC CRI_IMV_Iinit "IMV rail pressure integrator initial value" VALUE 0x001ecf18 /* @ECU_Address@CRI_IMV_Iinit@0x0100B830@ */ ECIPP_ALIGNMENT_FLOAT32_IEEE 10000000000 Compu_CRI_IMV_Iinit -10000000000 10000000000 /end CHARACTERISTIC
/begin COMPU_METHOD Compu_CRI_IMV_Iinit " " RAT_FUNC "%.2" "CTLunits" COEFFS 0 1 0 0 0 1 /end COMPU_METHOD
/begin MEASUREMENT CRI_ontime_finalmax "Final computed max pulse-width" ULONG Compu_CRI_ontime_finalmax 0 0 0 214748364.75 ECU_ADDRESS 0x0100B838 /end MEASUREMENT
/begin COMPU_METHOD Compu_CRI_ontime_finalmax " " RAT_FUNC "%.0" "us" COEFFS 0 20 0 0 0 1 /end COMPU_METHOD
/begin CHARACTERISTIC CRI_ontime_CADmax "CAD-based max fuel pulse width" VALUE 0x001ed2d8 /* @ECU_Address@CRI_ontime_CADmax@0x0100B840@ */ ECIPP_ALIGNMENT_UWORD 4096 Compu_CRI_ontime_CADmax 0 4095.9375 /end CHARACTERISTIC
/begin COMPU_METHOD Compu_CRI_ontime_CADmax " " RAT_FUNC "%.1" "CAD" COEFFS 0 16 0 0 0 1 /end COMPU_METHOD
/begin CHARACTERISTIC IMVpck_PWfixed "Pulsed-IMV cranking pre-sync fixed-time pulse" VALUE 0x001ecf54 /* @ECU_Address@IMVpck_PWfixed@0x0100B848@ */ ECIPP_ALIGNMENT_FLOAT32_IEEE 10000000000 Compu_IMVpck_PWfixed -10000000000 10000000000 /end CHARACTERISTIC
/begin COMPU_METHOD Compu_IMVpck_PWfixed " " RAT_FUNC "%.2" "ms" COEFFS 0 1 0 0 0 1 /end COMPU_METHOD
/begin CHARACTERISTIC IMVpck_presync_tau "Pulsed-IMV cranking pre-sync fixed-time interval" VALUE 0x001ecf58 /* @ECU_Address@IMVpck_presync_tau@0x0100B850@ */ ECIPP_ALIGNMENT_FLOAT32_IEEE 10000000000 Compu_IMVpck_presync_tau -10000000000 10000000000 /end CHARACTERISTIC
/begin COMPU_METHOD Compu_IMVpck_presync_tau " " RAT_FUNC "%.2" "ms" COEFFS 0 1 0 0 0 1 /end COMPU_METHOD
/begin CHARACTERISTIC IMVpck_pstsync_ph "Pulsed-IMV cranking post-sync fixed-CAD timing" VALUE 0x001ed01c /* @ECU_Address@IMVpck_pstsync_ph@0x0100B858@ */ ECIPP_ALIGNMENT_SWORD 2048 Compu_IMVpck_pstsync_ph -2048 2047.9375 /end CHARACTERISTIC
/begin COMPU_METHOD Compu_IMVpck_pstsync_ph " " RAT_FUNC "%.1" "CAD BTDCC #1" COEFFS 0 16 0 0 0 1 /end COMPU_METHOD
/begin CHARACTERISTIC IMVpck_Pctlhyst_pct "Pulsed-IMV cranking pressure hysteresis" VALUE 0x001ed2f4 /* @ECU_Address@IMVpck_Pctlhyst_pct@0x0100B860@ */ ECIPP_ALIGNMENT_UWORD 100 Compu_IMVpck_Pctlhyst_pct 0 99.9984741210938 /end CHARACTERISTIC
/begin COMPU_METHOD Compu_IMVpck_Pctlhyst_pct " " RAT_FUNC "%.1" "%" COEFFS 0 655.36 0 0 0 1 /end COMPU_METHOD
/begin MEASUREMENT IMVpck_taufix "Pulsed-IMV cranking fixed-time-interval mode{IMVpck_taufix&0xff=0:Inactive}{IMVpck_taufix&0xff=1:Active}" UBYTE IMVpck_taufix_COMPU_VTAB 0 0 0 255 ECU_ADDRESS 0x0100B868 BIT_MASK 0xff /end MEASUREMENT
/begin COMPU_METHOD IMVpck_taufix_COMPU_VTAB "Verbal Table" TAB_VERB "%.0" "list" COMPU_TAB_REF IMVpck_taufix_COMPU_VTAB_REF /end COMPU_METHOD
/begin COMPU_VTAB IMVpck_taufix_COMPU_VTAB_REF "Verbal Table" TAB_VERB 2 0 "Inactive" 1 "Active" DEFAULT_VALUE "UNKNOWN" /end COMPU_VTAB
/begin MEASUREMENT fuel_total_gas "Gaseous total fuel" ULONG Compu_fuel_total_gas 0 0 0 2147483647.5 ECU_ADDRESS 0x0100B878 /end MEASUREMENT
/begin COMPU_METHOD Compu_fuel_total_gas " " RAT_FUNC "%.1" "kg" COEFFS 0 2 0 0 0 1 /end COMPU_METHOD
/begin CHARACTERISTIC LOCKOFF2_pin "Secondary Gaseous lockoff enable pin{LOCKOFF2_pin&0xff=0:Disabled}{LOCKOFF2_pin&0xff=1:Not Available}{LOCKOFF2_pin&0xff=2:Aux PWM1}{LOCKOFF2_pin&0xff=3:Aux PWM2}{LOCKOFF2_pin&0xff=4:Aux PWM3}{LOCKOFF2_pin&0xff=5:Aux PWM4}{LOCKOFF2_pin&0xff=6:Aux PWM5}{LOC" VALUE 0x001c87d2 /* @ECU_Address@LOCKOFF2_pin@0x0100C2C0@ */ ECIPP_ALIGNMENT_UBYTE 255 LOCKOFF2_pin_COMPU_VTAB 0 255 BIT_MASK 0xff /end CHARACTERISTIC
/begin COMPU_METHOD LOCKOFF2_pin_COMPU_VTAB "Verbal Table" TAB_VERB "%.0" "list" COMPU_TAB_REF LOCKOFF2_pin_COMPU_VTAB_REF /end COMPU_METHOD
/begin COMPU_VTAB LOCKOFF2_pin_COMPU_VTAB_REF "Verbal Table" TAB_VERB 12 0 "Disabled" 1 "Not Available" 2 "Aux PWM1" 3 "Aux PWM2" 4 "Aux PWM3" 5 "Aux PWM4" 6 "Aux PWM5" 7 "Aux PWM6" 8 "EGOH1" 9 "EGOH2" 10 "EGOH3" 11 "EGOH4" DEFAULT_VALUE "UNKNOWN" /end COMPU_VTAB
/begin CHARACTERISTIC CRI_purge "General (non green-engine) rail air purge mode{CRI_purge&0xff=0:Disabled}{CRI_purge&0xff=1:Enabled}" VALUE 0x001ed325 /* @ECU_Address@CRI_purge@0x0100C4C8@ */ ECIPP_ALIGNMENT_UBYTE 255 CRI_purge_COMPU_VTAB 0 255 BIT_MASK 0xff /end CHARACTERISTIC
/begin COMPU_METHOD CRI_purge_COMPU_VTAB "Verbal Table" TAB_VERB "%.0" "list" COMPU_TAB_REF CRI_purge_COMPU_VTAB_REF /end COMPU_METHOD
/begin COMPU_VTAB CRI_purge_COMPU_VTAB_REF "Verbal Table" TAB_VERB 2 0 "Disabled" 1 "Enabled" DEFAULT_VALUE "UNKNOWN" /end COMPU_VTAB
/begin MEASUREMENT CRI_purge_active "Rail air purge status{CRI_purge_active&0xff=0:Inactive}{CRI_purge_active&0xff=1:Fuel Pressure}{CRI_purge_active&0xff=2:Crank Time}" UBYTE CRI_purge_active_COMPU_VTAB 0 0 0 255 ECU_ADDRESS 0x0100C4D0 BIT_MASK 0xff /end MEASUREMENT
/begin COMPU_METHOD CRI_purge_active_COMPU_VTAB "Verbal Table" TAB_VERB "%.0" "list" COMPU_TAB_REF CRI_purge_active_COMPU_VTAB_REF /end COMPU_METHOD
/begin COMPU_VTAB CRI_purge_active_COMPU_VTAB_REF "Verbal Table" TAB_VERB 3 0 "Inactive" 1 "Fuel Pressure" 2 "Crank Time" DEFAULT_VALUE "UNKNOWN" /end COMPU_VTAB
/begin CHARACTERISTIC CRI_purge_Plower "Rail purge lower initiation pressure" VALUE 0x001ed2e0 /* @ECU_Address@CRI_purge_Plower@0x0100C4D8@ */ ECIPP_ALIGNMENT_UWORD 8192 Compu_CRI_purge_Plower 0 8191.875 /end CHARACTERISTIC
/begin COMPU_METHOD Compu_CRI_purge_Plower " " RAT_FUNC "%.1" "bar" COEFFS 0 8 0 0 0 1 /end COMPU_METHOD
/begin CHARACTERISTIC CRI_purge_Pupper "Rail purge upper termination pressure" VALUE 0x001ed2e2 /* @ECU_Address@CRI_purge_Pupper@0x0100C4E0@ */ ECIPP_ALIGNMENT_UWORD 8192 Compu_CRI_purge_Pupper 0 8191.875 /end CHARACTERISTIC
/begin COMPU_METHOD Compu_CRI_purge_Pupper " " RAT_FUNC "%.1" "bar" COEFFS 0 8 0 0 0 1 /end COMPU_METHOD
/begin CHARACTERISTIC CRI_purge_cycwait "General purge mode rotation validation wait" VALUE 0x001ed2e4 /* @ECU_Address@CRI_purge_cycwait@0x0100C4E8@ */ ECIPP_ALIGNMENT_UWORD 4096 Compu_CRI_purge_cycwait 0 4095.9375 /end CHARACTERISTIC
/begin COMPU_METHOD Compu_CRI_purge_cycwait " " RAT_FUNC "%.1" "cycles" COEFFS 0 16 0 0 0 1 /end COMPU_METHOD
/begin CHARACTERISTIC FT_bleedoff_ena "Bleed-off enable{FT_bleedoff_ena&0xff=0:Disabled}{FT_bleedoff_ena&0xff=1:LPG only}{FT_bleedoff_ena&0xff=2:NG only}{FT_bleedoff_ena&0xff=3:LPG or NG}" VALUE 0x001c8743 /* @ECU_Address@FT_bleedoff_ena@0x0100C820@ */ ECIPP_ALIGNMENT_UBYTE 255 FT_bleedoff_ena_COMPU_VTAB 0 255 BIT_MASK 0xff /end CHARACTERISTIC
/begin COMPU_METHOD FT_bleedoff_ena_COMPU_VTAB "Verbal Table" TAB_VERB "%.0" "list" COMPU_TAB_REF FT_bleedoff_ena_COMPU_VTAB_REF /end COMPU_METHOD
/begin COMPU_VTAB FT_bleedoff_ena_COMPU_VTAB_REF "Verbal Table" TAB_VERB 4 0 "Disabled" 1 "LPG only" 2 "NG only" 3 "LPG or NG" DEFAULT_VALUE "UNKNOWN" /end COMPU_VTAB
/begin MEASUREMENT FT_bleedoff_state "Bleed-off state{FT_bleedoff_state&0xff=0:Inactive}{FT_bleedoff_state&0xff=1:Active}" UBYTE FT_bleedoff_state_COMPU_VTAB 0 0 0 255 ECU_ADDRESS 0x0100C828 BIT_MASK 0xff /end MEASUREMENT
/begin COMPU_METHOD FT_bleedoff_state_COMPU_VTAB "Verbal Table" TAB_VERB "%.0" "list" COMPU_TAB_REF FT_bleedoff_state_COMPU_VTAB_REF /end COMPU_METHOD
/begin COMPU_VTAB FT_bleedoff_state_COMPU_VTAB_REF "Verbal Table" TAB_VERB 2 0 "Inactive" 1 "Active" DEFAULT_VALUE "UNKNOWN" /end COMPU_VTAB
/begin CHARACTERISTIC FT_bleedoff_dP_cmd "Bleed-off delta P" VALUE 0x001c4504 /* @ECU_Address@FT_bleedoff_dP_cmd@0x0100C830@ */ ECIPP_ALIGNMENT_SWORD 222 Compu_FT_bleedoff_dP_cmd -222 221.993225097656 /end CHARACTERISTIC
/begin COMPU_METHOD Compu_FT_bleedoff_dP_cmd " " RAT_FUNC "%.2" "in H2O" COEFFS 0 147.603603603604 0 0 0 1 /end COMPU_METHOD
/begin CHARACTERISTIC FT_bleedoff_Ptarget "Bleed-off target" VALUE 0x001c4502 /* @ECU_Address@FT_bleedoff_Ptarget@0x0100C838@ */ ECIPP_ALIGNMENT_SWORD 222 Compu_FT_bleedoff_Ptarget -222 221.993225097656 /end CHARACTERISTIC
/begin COMPU_METHOD Compu_FT_bleedoff_Ptarget " " RAT_FUNC "%.2" "in H2O" COEFFS 0 147.603603603604 0 0 0 1 /end COMPU_METHOD
/begin MEASUREMENT active_fuel_loc "Active fuel location{active_fuel_loc&0xff=0:Ports}{active_fuel_loc&0xff=1:Pre-throttle}{active_fuel_loc&0xff=2:Cylinder IVO}{active_fuel_loc&0xff=3:Cylinder TDC}{active_fuel_loc&0xff=4:Post-throttle}{active_fuel_loc&0xff=5:Air filter}" UBYTE active_fuel_loc_COMPU_VTAB 0 0 0 255 ECU_ADDRESS 0x0100CCC0 BIT_MASK 0xff /end MEASUREMENT
/begin COMPU_METHOD active_fuel_loc_COMPU_VTAB "Verbal Table" TAB_VERB "%.0" "list" COMPU_TAB_REF active_fuel_loc_COMPU_VTAB_REF /end COMPU_METHOD
/begin COMPU_VTAB active_fuel_loc_COMPU_VTAB_REF "Verbal Table" TAB_VERB 6 0 "Ports" 1 "Pre-throttle" 2 "Cylinder IVO" 3 "Cylinder TDC" 4 "Post-throttle" 5 "Air filter" DEFAULT_VALUE "UNKNOWN" /end COMPU_VTAB
/begin CHARACTERISTIC CRI_Prail_hyst "Rail pressure minimum hysteresis" VALUE 0x001ed2be /* @ECU_Address@CRI_Prail_hyst@0x0100CE90@ */ ECIPP_ALIGNMENT_UWORD 8192 Compu_CRI_Prail_hyst 0 8191.875 /end CHARACTERISTIC
/begin COMPU_METHOD Compu_CRI_Prail_hyst " " RAT_FUNC "%.1" "bar" COEFFS 0 8 0 0 0 1 /end COMPU_METHOD
/begin CHARACTERISTIC IMV_varcam_mode "Pulsed-IMV variable cam drive{IMV_varcam_mode&0xff=0:Fixed Drive - N/A}{IMV_varcam_mode&0xff=1:Variable Intake Cam Drive}{IMV_varcam_mode&0xff=2:Variable Exhaust Cam Drive}" VALUE 0x001ed326 /* @ECU_Address@IMV_varcam_mode@0x0100CE98@ */ ECIPP_ALIGNMENT_UBYTE 255 IMV_varcam_mode_COMPU_VTAB 0 255 BIT_MASK 0xff /end CHARACTERISTIC
/begin COMPU_METHOD IMV_varcam_mode_COMPU_VTAB "Verbal Table" TAB_VERB "%.0" "list" COMPU_TAB_REF IMV_varcam_mode_COMPU_VTAB_REF /end COMPU_METHOD
/begin COMPU_VTAB IMV_varcam_mode_COMPU_VTAB_REF "Verbal Table" TAB_VERB 3 0 "Fixed Drive - N/A" 1 "Variable Intake Cam Drive" 2 "Variable Exhaust Cam Drive" DEFAULT_VALUE "UNKNOWN" /end COMPU_VTAB
/begin CHARACTERISTIC IMV_varcam_nom "Pulsed-IMV variable cam nominal/crank ref" VALUE 0x001ed01a /* @ECU_Address@IMV_varcam_nom@0x0100CEA0@ */ ECIPP_ALIGNMENT_SWORD 2048 Compu_IMV_varcam_nom -2048 2047.9375 /end CHARACTERISTIC
/begin COMPU_METHOD Compu_IMV_varcam_nom " " RAT_FUNC "%.1" "CAD BTDC" COEFFS 0 16 0 0 0 1 /end COMPU_METHOD
/begin CHARACTERISTIC IMVpck_CAD_cycmin "Pulsed-IMV cranking post-sync fixed-time hold" VALUE 0x001ed2f0 /* @ECU_Address@IMVpck_CAD_cycmin@0x0100CEA8@ */ ECIPP_ALIGNMENT_UWORD 256 Compu_IMVpck_CAD_cycmin 0 255.99609375 /end CHARACTERISTIC
/begin COMPU_METHOD Compu_IMVpck_CAD_cycmin " " RAT_FUNC "%.2" "cycles" COEFFS 0 256 0 0 0 1 /end COMPU_METHOD
/begin CHARACTERISTIC IMVpck_CADfixed "Pulsed-IMV cranking post-sync fixed-CAD pulse" VALUE 0x001ed2f2 /* @ECU_Address@IMVpck_CADfixed@0x0100CEB0@ */ ECIPP_ALIGNMENT_UWORD 4096 Compu_IMVpck_CADfixed 0 4095.9375 /end CHARACTERISTIC
/begin COMPU_METHOD Compu_IMVpck_CADfixed " " RAT_FUNC "%.1" "CAD" COEFFS 0 16 0 0 0 1 /end COMPU_METHOD
/begin CHARACTERISTIC CRI_Pdry_min "Dry-rail pressure minimum for injection" VALUE 0x001ed2ba /* @ECU_Address@CRI_Pdry_min@0x0100CEB8@ */ ECIPP_ALIGNMENT_UWORD 8192 Compu_CRI_Pdry_min 0 8191.875 /end CHARACTERISTIC
/begin COMPU_METHOD Compu_CRI_Pdry_min " " RAT_FUNC "%.1" "bar" COEFFS 0 8 0 0 0 1 /end COMPU_METHOD
/begin CHARACTERISTIC CRI_Pdry_hyst "Dry-rail pressure minimum hysteresis" VALUE 0x001ed2b8 /* @ECU_Address@CRI_Pdry_hyst@0x0100CEC0@ */ ECIPP_ALIGNMENT_UWORD 8192 Compu_CRI_Pdry_hyst 0 8191.875 /end CHARACTERISTIC
/begin COMPU_METHOD Compu_CRI_Pdry_hyst " " RAT_FUNC "%.1" "bar" COEFFS 0 8 0 0 0 1 /end COMPU_METHOD
/begin CHARACTERISTIC CRI_Pdry_cycwait "Dry-rail detection extended cranking trigger" VALUE 0x001ed2b6 /* @ECU_Address@CRI_Pdry_cycwait@0x0100CEC8@ */ ECIPP_ALIGNMENT_UWORD 4096 Compu_CRI_Pdry_cycwait 0 4095.9375 /end CHARACTERISTIC
/begin COMPU_METHOD Compu_CRI_Pdry_cycwait " " RAT_FUNC "%.1" "cycles" COEFFS 0 16 0 0 0 1 /end COMPU_METHOD
/begin CHARACTERISTIC CRI_Pdry_runhold "Dry-rail mode post-run hold time" VALUE 0x001ed2bc /* @ECU_Address@CRI_Pdry_runhold@0x0100CED0@ */ ECIPP_ALIGNMENT_UWORD 66 Compu_CRI_Pdry_runhold 0 65.535 /end CHARACTERISTIC
/begin COMPU_METHOD Compu_CRI_Pdry_runhold " " RAT_FUNC "%.3" "sec" COEFFS 0 1000 0 0 0 1 /end COMPU_METHOD
/begin CHARACTERISTIC CRI_ontime_drymax "Dry-rail time-based max fuel pulse width" VALUE 0x001ecfec /* @ECU_Address@CRI_ontime_drymax@0x0100CED8@ */ ECIPP_ALIGNMENT_ULONG 214748365 Compu_CRI_ontime_drymax 0 214748364.75 /end CHARACTERISTIC
/begin COMPU_METHOD Compu_CRI_ontime_drymax " " RAT_FUNC "%.0" "us" COEFFS 0 20 0 0 0 1 /end COMPU_METHOD
/begin MEASUREMENT CRI_IMVi_raw "IMV uncompensated current feedback value" SWORD Compu_CRI_IMVi_raw 0 0 -32 31.9990234375 ECU_ADDRESS 0x0100CEE0 /end MEASUREMENT
/begin COMPU_METHOD Compu_CRI_IMVi_raw " " RAT_FUNC "%.2" "amps" COEFFS 0 1024 0 0 0 1 /end COMPU_METHOD
/begin MEASUREMENT CRI_Prail_min_a "Rail pressure minimum actual instantaneous value" UWORD Compu_CRI_Prail_min_a 0 0 0 8191.875 ECU_ADDRESS 0x0100CF28 /end MEASUREMENT
/begin COMPU_METHOD Compu_CRI_Prail_min_a " " RAT_FUNC "%.1" "bar" COEFFS 0 8 0 0 0 1 /end COMPU_METHOD
/begin CHARACTERISTIC IMVpulse_Tmx_rpmeq "Pulsed-IMV waveform rpm-equivalent max duration cranking override" VALUE 0x001ed302 /* @ECU_Address@IMVpulse_Tmx_rpmeq@0x0100CF30@ */ ECIPP_ALIGNMENT_UWORD 65535 Compu_IMVpulse_Tmx_rpmeq 0 65535 /end CHARACTERISTIC
/begin COMPU_METHOD Compu_IMVpulse_Tmx_rpmeq " " RAT_FUNC "%.0" "rpm" COEFFS 0 1 0 0 0 1 /end COMPU_METHOD
/begin MEASUREMENT CRI_last_rise_time1 "CR injector 1A peak current rise time" SLONG Compu_CRI_last_rise_time1 0 0 -107374182.4 107374182.35 ECU_ADDRESS 0x0100CF48 /end MEASUREMENT
/begin COMPU_METHOD Compu_CRI_last_rise_time1 " " RAT_FUNC "%.0" "us" COEFFS 0 20 0 0 0 1 /end COMPU_METHOD
/begin MEASUREMENT CRI_last_rise_time2 "CR injector 2A peak current rise time" SLONG Compu_CRI_last_rise_time2 0 0 -107374182.4 107374182.35 ECU_ADDRESS 0x0100CF50 /end MEASUREMENT
/begin COMPU_METHOD Compu_CRI_last_rise_time2 " " RAT_FUNC "%.0" "us" COEFFS 0 20 0 0 0 1 /end COMPU_METHOD
/begin MEASUREMENT CRI_last_rise_time3 "CR injector 1B peak current rise time" SLONG Compu_CRI_last_rise_time3 0 0 -107374182.4 107374182.35 ECU_ADDRESS 0x0100CF58 /end MEASUREMENT
/begin COMPU_METHOD Compu_CRI_last_rise_time3 " " RAT_FUNC "%.0" "us" COEFFS 0 20 0 0 0 1 /end COMPU_METHOD
/begin MEASUREMENT CRI_last_rise_time4 "CR injector 2B peak current rise time" SLONG Compu_CRI_last_rise_time4 0 0 -107374182.4 107374182.35 ECU_ADDRESS 0x0100CF60 /end MEASUREMENT
/begin COMPU_METHOD Compu_CRI_last_rise_time4 " " RAT_FUNC "%.0" "us" COEFFS 0 20 0 0 0 1 /end COMPU_METHOD
/begin MEASUREMENT CRI_last_rise_time5 "CR injector 1C peak current rise time" SLONG Compu_CRI_last_rise_time5 0 0 -107374182.4 107374182.35 ECU_ADDRESS 0x0100CF68 /end MEASUREMENT
/begin COMPU_METHOD Compu_CRI_last_rise_time5 " " RAT_FUNC "%.0" "us" COEFFS 0 20 0 0 0 1 /end COMPU_METHOD
/begin MEASUREMENT CRI_last_rise_time6 "CR injector 2C peak current rise time" SLONG Compu_CRI_last_rise_time6 0 0 -107374182.4 107374182.35 ECU_ADDRESS 0x0100CF70 /end MEASUREMENT
/begin COMPU_METHOD Compu_CRI_last_rise_time6 " " RAT_FUNC "%.0" "us" COEFFS 0 20 0 0 0 1 /end COMPU_METHOD
/begin MEASUREMENT CRI_last_rise_time7 "CR injector 1D peak current rise time" SLONG Compu_CRI_last_rise_time7 0 0 -107374182.4 107374182.35 ECU_ADDRESS 0x0100CF78 /end MEASUREMENT
/begin COMPU_METHOD Compu_CRI_last_rise_time7 " " RAT_FUNC "%.0" "us" COEFFS 0 20 0 0 0 1 /end COMPU_METHOD
/begin MEASUREMENT CRI_last_rise_time8 "CR injector 2D peak current rise time" SLONG Compu_CRI_last_rise_time8 0 0 -107374182.4 107374182.35 ECU_ADDRESS 0x0100CF80 /end MEASUREMENT
/begin COMPU_METHOD Compu_CRI_last_rise_time8 " " RAT_FUNC "%.0" "us" COEFFS 0 20 0 0 0 1 /end COMPU_METHOD
/begin CHARACTERISTIC CRI_Pdry_ena "Dry-rail detection during extended cranking{CRI_Pdry_ena&0xff=0:Disabled}{CRI_Pdry_ena&0xff=1:Enabled}" VALUE 0x001ed31f /* @ECU_Address@CRI_Pdry_ena@0x0100CF88@ */ ECIPP_ALIGNMENT_UBYTE 255 CRI_Pdry_ena_COMPU_VTAB 0 255 BIT_MASK 0xff /end CHARACTERISTIC
/begin COMPU_METHOD CRI_Pdry_ena_COMPU_VTAB "Verbal Table" TAB_VERB "%.0" "list" COMPU_TAB_REF CRI_Pdry_ena_COMPU_VTAB_REF /end COMPU_METHOD
/begin COMPU_VTAB CRI_Pdry_ena_COMPU_VTAB_REF "Verbal Table" TAB_VERB 2 0 "Disabled" 1 "Enabled" DEFAULT_VALUE "UNKNOWN" /end COMPU_VTAB
/begin MEASUREMENT CRI_IMVi_halfpeak "Pulsed-IMV current at 1/2 rise-time to peak" SWORD Compu_CRI_IMVi_halfpeak 0 0 -32 31.9990234375 ECU_ADDRESS 0x0100CF90 /end MEASUREMENT
/begin COMPU_METHOD Compu_CRI_IMVi_halfpeak " " RAT_FUNC "%.2" "amps" COEFFS 0 1024 0 0 0 1 /end COMPU_METHOD
/begin CHARACTERISTIC Ginj_cs_max_pre "Max pre-running injections" VALUE 0x001C9F92 /* @ECU_Address@Ginj_cs_max_pre@0x0100D480@ */ ECIPP_ALIGNMENT_UWORD 65535 Compu_Ginj_cs_max_pre 0 65535 /end CHARACTERISTIC
/begin COMPU_METHOD Compu_Ginj_cs_max_pre " " RAT_FUNC "%.0" "count" COEFFS 0 1 0 0 0 1 /end COMPU_METHOD
/begin CHARACTERISTIC Ginj_cs_max_pre_I2 "Sec max pre-running injections" VALUE 0x001C9FCE /* @ECU_Address@Ginj_cs_max_pre_I2@0x0100D488@ */ ECIPP_ALIGNMENT_UWORD 65535 Compu_Ginj_cs_max_pre_I2 0 65535 /end CHARACTERISTIC
/begin COMPU_METHOD Compu_Ginj_cs_max_pre_I2 " " RAT_FUNC "%.0" "count" COEFFS 0 1 0 0 0 1 /end COMPU_METHOD
/begin CHARACTERISTIC Ginj_cs_max_post "Max post-running injections" VALUE 0x001C9F94 /* @ECU_Address@Ginj_cs_max_post@0x0100D490@ */ ECIPP_ALIGNMENT_UWORD 65535 Compu_Ginj_cs_max_post 0 65535 /end CHARACTERISTIC
/begin COMPU_METHOD Compu_Ginj_cs_max_post " " RAT_FUNC "%.0" "count" COEFFS 0 1 0 0 0 1 /end COMPU_METHOD
/begin CHARACTERISTIC Ginj_cs_max_post_I2 "Sec max post-running injections" VALUE 0x001C9FD0 /* @ECU_Address@Ginj_cs_max_post_I2@0x0100D498@ */ ECIPP_ALIGNMENT_UWORD 65535 Compu_Ginj_cs_max_post_I2 0 65535 /end CHARACTERISTIC
/begin COMPU_METHOD Compu_Ginj_cs_max_post_I2 " " RAT_FUNC "%.0" "count" COEFFS 0 1 0 0 0 1 /end COMPU_METHOD
/begin CHARACTERISTIC Ginj_cs_ect "ECT threshold" VALUE 0x001C9F96 /* @ECU_Address@Ginj_cs_ect@0x0100D4A0@ */ ECIPP_ALIGNMENT_UWORD 564 Compu_Ginj_cs_ect -460 563.984375 /end CHARACTERISTIC
/begin COMPU_METHOD Compu_Ginj_cs_ect " " RAT_FUNC "%.1" "deg F" COEFFS 0 64 29440 0 0 1 /end COMPU_METHOD
/begin CHARACTERISTIC Ginj_cs_ect_I2 "Sec ECT threshold" VALUE 0x001C9FD2 /* @ECU_Address@Ginj_cs_ect_I2@0x0100D4A8@ */ ECIPP_ALIGNMENT_UWORD 564 Compu_Ginj_cs_ect_I2 -460 563.984375 /end CHARACTERISTIC
/begin COMPU_METHOD Compu_Ginj_cs_ect_I2 " " RAT_FUNC "%.1" "deg F" COEFFS 0 64 29440 0 0 1 /end COMPU_METHOD
/begin CHARACTERISTIC Ginj_cs_ptime "Peak current hold time" VALUE 0x001C9F98 /* @ECU_Address@Ginj_cs_ptime@0x0100D4B0@ */ ECIPP_ALIGNMENT_UWORD 210 Compu_Ginj_cs_ptime 0 209.712 /end CHARACTERISTIC
/begin COMPU_METHOD Compu_Ginj_cs_ptime " " RAT_FUNC "%.3" "ms" COEFFS 0 312.5 0 0 0 1 /end COMPU_METHOD
/begin CHARACTERISTIC Ginj_cs_ptime_I2 "Sec peak current hold time" VALUE 0x001C9FD4 /* @ECU_Address@Ginj_cs_ptime_I2@0x0100D4B8@ */ ECIPP_ALIGNMENT_UWORD 210 Compu_Ginj_cs_ptime_I2 0 209.712 /end CHARACTERISTIC
/begin COMPU_METHOD Compu_Ginj_cs_ptime_I2 " " RAT_FUNC "%.3" "ms" COEFFS 0 312.5 0 0 0 1 /end COMPU_METHOD
/begin MEASUREMENT Ginj_cs_active "Cold start mode active{Ginj_cs_active&0xff=0:NO}{Ginj_cs_active&0xff=1:YES}" UBYTE Ginj_cs_active_COMPU_VTAB 0 0 0 255 ECU_ADDRESS 0x0100D4D0 BIT_MASK 0xff /end MEASUREMENT
/begin COMPU_METHOD Ginj_cs_active_COMPU_VTAB "Verbal Table" TAB_VERB "%.0" "list" COMPU_TAB_REF Ginj_cs_active_COMPU_VTAB_REF /end COMPU_METHOD
/begin COMPU_VTAB Ginj_cs_active_COMPU_VTAB_REF "Verbal Table" TAB_VERB 2 0 "NO" 1 "YES" DEFAULT_VALUE "UNKNOWN" /end COMPU_VTAB
/begin MEASUREMENT inj_count_prerun "Pre-running injection count" UWORD Compu_inj_count_prerun 0 0 0 65535 ECU_ADDRESS 0x0100D4D8 /end MEASUREMENT
/begin COMPU_METHOD Compu_inj_count_prerun " " RAT_FUNC "%.0" "-" COEFFS 0 1 0 0 0 1 /end COMPU_METHOD
/begin MEASUREMENT inj_count_postrun "Post-running injection count" UWORD Compu_inj_count_postrun 0 0 0 65535 ECU_ADDRESS 0x0100D4E0 /end MEASUREMENT
/begin COMPU_METHOD Compu_inj_count_postrun " " RAT_FUNC "%.0" "-" COEFFS 0 1 0 0 0 1 /end COMPU_METHOD
/begin MEASUREMENT Ginj_peakd_avg "Avg desired peak hold time" UWORD Compu_Ginj_peakd_avg 0 0 0 209.712 ECU_ADDRESS 0x0100D4E8 /end MEASUREMENT
/begin COMPU_METHOD Compu_Ginj_peakd_avg " " RAT_FUNC "%.3" "ms" COEFFS 0 312.5 0 0 0 1 /end COMPU_METHOD
/begin MEASUREMENT Ginj_peaka_avg "Avg actual peak hold time" UWORD Compu_Ginj_peaka_avg 0 0 0 209.712 ECU_ADDRESS 0x0100D4F0 /end MEASUREMENT
/begin COMPU_METHOD Compu_Ginj_peaka_avg " " RAT_FUNC "%.3" "ms" COEFFS 0 312.5 0 0 0 1 /end COMPU_METHOD
/begin CHARACTERISTIC FT_bleedoff_delay "Bleed-off start delay" VALUE 0x001c7b92 /* @ECU_Address@FT_bleedoff_delay@0x0100D4F8@ */ ECIPP_ALIGNMENT_UWORD 65535 Compu_FT_bleedoff_delay 0 65535 /end CHARACTERISTIC
/begin COMPU_METHOD Compu_FT_bleedoff_delay " " RAT_FUNC "%.0" "ms" COEFFS 0 1 0 0 0 1 /end COMPU_METHOD
/begin MEASUREMENT FT_bleedoff_fuelType "Bleed-off fuel type{FT_bleedoff_fuelType&0xff=0x00:Gasoline}{FT_bleedoff_fuelType&0xff=0x01:Propane}{FT_bleedoff_fuelType&0xff=0x02:Natural Gas}" UBYTE FT_bleedoff_fuelType_COMPU_VTAB 0 0 0 255 ECU_ADDRESS 0x0100D500 BIT_MASK 0xff /end MEASUREMENT
/begin COMPU_METHOD FT_bleedoff_fuelType_COMPU_VTAB "Verbal Table" TAB_VERB "%.0" "list" COMPU_TAB_REF FT_bleedoff_fuelType_COMPU_VTAB_REF /end COMPU_METHOD
/begin COMPU_VTAB FT_bleedoff_fuelType_COMPU_VTAB_REF "Verbal Table" TAB_VERB 3 0x00 "Gasoline" 0x01 "Propane" 0x02 "Natural Gas" DEFAULT_VALUE "UNKNOWN" /end COMPU_VTAB
/begin MEASUREMENT fuel_type_keyoff "Fuel type at last key off{fuel_type_keyoff&0xff=0x00:Gasoline}{fuel_type_keyoff&0xff=0x01:Propane}{fuel_type_keyoff&0xff=0x02:Natural Gas}" UBYTE fuel_type_keyoff_COMPU_VTAB 0 0 0 255 ECU_ADDRESS 0x0100D508 BIT_MASK 0xff /end MEASUREMENT
/begin COMPU_METHOD fuel_type_keyoff_COMPU_VTAB "Verbal Table" TAB_VERB "%.0" "list" COMPU_TAB_REF fuel_type_keyoff_COMPU_VTAB_REF /end COMPU_METHOD
/begin COMPU_VTAB fuel_type_keyoff_COMPU_VTAB_REF "Verbal Table" TAB_VERB 3 0x00 "Gasoline" 0x01 "Propane" 0x02 "Natural Gas" DEFAULT_VALUE "UNKNOWN" /end COMPU_VTAB
/begin CHARACTERISTIC TBI_fuel_calc "Throttle-body injection fuel calc{TBI_fuel_calc&0xff=0:Speed-density}{TBI_fuel_calc&0xff=1:Speed-density + dMAP}{TBI_fuel_calc&0xff=2:Throttle-model based}" VALUE 0x001c8f17 /* @ECU_Address@TBI_fuel_calc@0x0100D600@ */ ECIPP_ALIGNMENT_UBYTE 255 TBI_fuel_calc_COMPU_VTAB 0 255 BIT_MASK 0xff /end CHARACTERISTIC
/begin COMPU_METHOD TBI_fuel_calc_COMPU_VTAB "Verbal Table" TAB_VERB "%.0" "list" COMPU_TAB_REF TBI_fuel_calc_COMPU_VTAB_REF /end COMPU_METHOD
/begin COMPU_VTAB TBI_fuel_calc_COMPU_VTAB_REF "Verbal Table" TAB_VERB 3 0 "Speed-density" 1 "Speed-density + dMAP" 2 "Throttle-model based" DEFAULT_VALUE "UNKNOWN" /end COMPU_VTAB
/begin CHARACTERISTIC CRI_IMVpw_CAD "Pulsed-IMV CAD mode desired electrical pulse" VALUE 0x001ed2b4 /* @ECU_Address@CRI_IMVpw_CAD@0x0100D668@ */ ECIPP_ALIGNMENT_UWORD 4096 Compu_CRI_IMVpw_CAD 0 4095.9375 /end CHARACTERISTIC
/begin COMPU_METHOD Compu_CRI_IMVpw_CAD " " RAT_FUNC "%.1" "CAD" COEFFS 0 16 0 0 0 1 /end COMPU_METHOD
/begin CHARACTERISTIC CRI_IMVcad_min "Pulsed-IMV CAD mode min control duration" VALUE 0x001ed00e /* @ECU_Address@CRI_IMVcad_min@0x0100D670@ */ ECIPP_ALIGNMENT_SWORD 2048 Compu_CRI_IMVcad_min -2048 2047.9375 /end CHARACTERISTIC
/begin COMPU_METHOD Compu_CRI_IMVcad_min " " RAT_FUNC "%.1" "CAD" COEFFS 0 16 0 0 0 1 /end COMPU_METHOD
/begin CHARACTERISTIC CRI_IMVcad_max "Pulsed-IMV CAD mode max control duration" VALUE 0x001ed00c /* @ECU_Address@CRI_IMVcad_max@0x0100D678@ */ ECIPP_ALIGNMENT_SWORD 2048 Compu_CRI_IMVcad_max -2048 2047.9375 /end CHARACTERISTIC
/begin COMPU_METHOD Compu_CRI_IMVcad_max " " RAT_FUNC "%.1" "CAD" COEFFS 0 16 0 0 0 1 /end COMPU_METHOD
/begin CHARACTERISTIC CRI_grneng "Green-engine rail air purge mode{CRI_grneng&0xff=0:Disabled}{CRI_grneng&0xff=1:Manual trigger only}{CRI_grneng&0xff=2:Manual or Zero-Hour trigger}" VALUE 0x001ed322 /* @ECU_Address@CRI_grneng@0x0100D680@ */ ECIPP_ALIGNMENT_UBYTE 255 CRI_grneng_COMPU_VTAB 0 255 BIT_MASK 0xff /end CHARACTERISTIC
/begin COMPU_METHOD CRI_grneng_COMPU_VTAB "Verbal Table" TAB_VERB "%.0" "list" COMPU_TAB_REF CRI_grneng_COMPU_VTAB_REF /end COMPU_METHOD
/begin COMPU_VTAB CRI_grneng_COMPU_VTAB_REF "Verbal Table" TAB_VERB 3 0 "Disabled" 1 "Manual trigger only" 2 "Manual or Zero-Hour trigger" DEFAULT_VALUE "UNKNOWN" /end COMPU_VTAB
/begin MEASUREMENT CRI_grneng_state "Green-engine rail purge state{CRI_grneng_state&0xff=0:Inactive}{CRI_grneng_state&0xff=1:Purge Requested}{CRI_grneng_state&0xff=2:Purge Active}{CRI_grneng_state&0xff=3:Purge Completed}" UBYTE CRI_grneng_state_COMPU_VTAB 0 0 0 255 ECU_ADDRESS 0x0100D688 BIT_MASK 0xff /end MEASUREMENT
/begin COMPU_METHOD CRI_grneng_state_COMPU_VTAB "Verbal Table" TAB_VERB "%.0" "list" COMPU_TAB_REF CRI_grneng_state_COMPU_VTAB_REF /end COMPU_METHOD
/begin COMPU_VTAB CRI_grneng_state_COMPU_VTAB_REF "Verbal Table" TAB_VERB 4 0 "Inactive" 1 "Purge Requested" 2 "Purge Active" 3 "Purge Completed" DEFAULT_VALUE "UNKNOWN" /end COMPU_VTAB
/begin MEASUREMENT CRI_grneng_mantrig "Green-engine rail purge trigger{CRI_grneng_mantrig&0xff=0:Disarmed}{CRI_grneng_mantrig&0xff=1:Armed}" UBYTE CRI_grneng_mantrig_COMPU_VTAB 0 0 0 255 ECU_ADDRESS 0x0100D690 BIT_MASK 0xff /end MEASUREMENT
/begin COMPU_METHOD CRI_grneng_mantrig_COMPU_VTAB "Verbal Table" TAB_VERB "%.0" "list" COMPU_TAB_REF CRI_grneng_mantrig_COMPU_VTAB_REF /end COMPU_METHOD
/begin COMPU_VTAB CRI_grneng_mantrig_COMPU_VTAB_REF "Verbal Table" TAB_VERB 2 0 "Disarmed" 1 "Armed" DEFAULT_VALUE "UNKNOWN" /end COMPU_VTAB
/begin CHARACTERISTIC CRI_purge_tout "Rail purge duration time-out" VALUE 0x001ed2e8 /* @ECU_Address@CRI_purge_tout@0x0100D698@ */ ECIPP_ALIGNMENT_UWORD 65535 Compu_CRI_purge_tout 0 65535 /end CHARACTERISTIC
/begin COMPU_METHOD Compu_CRI_purge_tout " " RAT_FUNC "%.0" "ms" COEFFS 0 1 0 0 0 1 /end COMPU_METHOD
/begin MEASUREMENT CRI_purge_tmr "Rail purge duration timer" UWORD Compu_CRI_purge_tmr 0 0 0 65535 ECU_ADDRESS 0x0100D6A0 /end MEASUREMENT
/begin COMPU_METHOD Compu_CRI_purge_tmr " " RAT_FUNC "%.0" "ms" COEFFS 0 1 0 0 0 1 /end COMPU_METHOD
/begin MEASUREMENT CRI_purge_spkdis "Rail purge spark inhibit status{CRI_purge_spkdis&0xff=0:Spark Active}{CRI_purge_spkdis&0xff=1:Spark Inhibited}" UBYTE CRI_purge_spkdis_COMPU_VTAB 0 0 0 255 ECU_ADDRESS 0x0100D760 BIT_MASK 0xff /end MEASUREMENT
/begin COMPU_METHOD CRI_purge_spkdis_COMPU_VTAB "Verbal Table" TAB_VERB "%.0" "list" COMPU_TAB_REF CRI_purge_spkdis_COMPU_VTAB_REF /end COMPU_METHOD
/begin COMPU_VTAB CRI_purge_spkdis_COMPU_VTAB_REF "Verbal Table" TAB_VERB 2 0 "Spark Active" 1 "Spark Inhibited" DEFAULT_VALUE "UNKNOWN" /end COMPU_VTAB
/begin CHARACTERISTIC CRI_purge_spkpct "Rail purge spark inhibit fraction of time-out" VALUE 0x001ed2e6 /* @ECU_Address@CRI_purge_spkpct@0x0100D768@ */ ECIPP_ALIGNMENT_UWORD 100 Compu_CRI_purge_spkpct 0 99.9984741210938 /end CHARACTERISTIC
/begin COMPU_METHOD Compu_CRI_purge_spkpct " " RAT_FUNC "%.1" "%" COEFFS 0 655.36 0 0 0 1 /end COMPU_METHOD
/begin CHARACTERISTIC J1939_GFC_ena "Gaseous usage filters{J1939_GFC_ena&0xff=0:Disabled}{J1939_GFC_ena&0xff=1:Enabled}" VALUE 0x001c87ac /* @ECU_Address@J1939_GFC_ena@0x0100DA98@ */ ECIPP_ALIGNMENT_UBYTE 255 J1939_GFC_ena_COMPU_VTAB 0 255 BIT_MASK 0xff /end CHARACTERISTIC
/begin COMPU_METHOD J1939_GFC_ena_COMPU_VTAB "Verbal Table" TAB_VERB "%.0" "list" COMPU_TAB_REF J1939_GFC_ena_COMPU_VTAB_REF /end COMPU_METHOD
/begin COMPU_VTAB J1939_GFC_ena_COMPU_VTAB_REF "Verbal Table" TAB_VERB 2 0 "Disabled" 1 "Enabled" DEFAULT_VALUE "UNKNOWN" /end COMPU_VTAB
/begin CHARACTERISTIC J1939_GFC_tau1 "Gaseous filter tau" VALUE 0x001C7C88 /* @ECU_Address@J1939_GFC_tau1@0x0100DAA0@ */ ECIPP_ALIGNMENT_UWORD 4096 Compu_J1939_GFC_tau1 0 4095.9375 /end CHARACTERISTIC
/begin COMPU_METHOD Compu_J1939_GFC_tau1 " " RAT_FUNC "%.1" "sec" COEFFS 0 16 0 0 0 1 /end COMPU_METHOD
/begin CHARACTERISTIC J1939_GFC_tau2 "Gaseous filter tau" VALUE 0x001C7C8A /* @ECU_Address@J1939_GFC_tau2@0x0100DAA8@ */ ECIPP_ALIGNMENT_UWORD 4096 Compu_J1939_GFC_tau2 0 4095.9375 /end CHARACTERISTIC
/begin COMPU_METHOD Compu_J1939_GFC_tau2 " " RAT_FUNC "%.1" "sec" COEFFS 0 16 0 0 0 1 /end COMPU_METHOD
/begin MEASUREMENT J1939_GFC_m_hr1 "Gaseous mass/hour" UWORD Compu_J1939_GFC_m_hr1 0 0 0 655.35 ECU_ADDRESS 0x0100DAB0 /end MEASUREMENT
/begin COMPU_METHOD Compu_J1939_GFC_m_hr1 " " RAT_FUNC "%.2" "kg/hr" COEFFS 0 100 0 0 0 1 /end COMPU_METHOD
/begin MEASUREMENT J1939_GFC_m_hr2 "Gaseous mass/hour" UWORD Compu_J1939_GFC_m_hr2 0 0 0 655.35 ECU_ADDRESS 0x0100DAB8 /end MEASUREMENT
/begin COMPU_METHOD Compu_J1939_GFC_m_hr2 " " RAT_FUNC "%.2" "kg/hr" COEFFS 0 100 0 0 0 1 /end COMPU_METHOD
/begin MEASUREMENT J1939_GFC_m_100km1 "Gaseous mass/100 km" UWORD Compu_J1939_GFC_m_100km1 0 0 0 655.35 ECU_ADDRESS 0x0100DAC0 /end MEASUREMENT
/begin COMPU_METHOD Compu_J1939_GFC_m_100km1 " " RAT_FUNC "%.2" "kg" COEFFS 0 100 0 0 0 1 /end COMPU_METHOD
/begin MEASUREMENT J1939_GFC_m_100km2 "Gaseous mass/100 km" UWORD Compu_J1939_GFC_m_100km2 0 0 0 655.35 ECU_ADDRESS 0x0100DAC8 /end MEASUREMENT
/begin COMPU_METHOD Compu_J1939_GFC_m_100km2 " " RAT_FUNC "%.2" "kg" COEFFS 0 100 0 0 0 1 /end COMPU_METHOD
/begin CHARACTERISTIC CRI_IMV_HW_period "IMV hardware PWM frequency" VALUE 0x001ed000 /* @ECU_Address@CRI_IMV_HW_period@0x0100E5E8@ */ ECIPP_ALIGNMENT_ULONG 10000000000 Compu_CRI_IMV_HW_period 0 10000000000 /end CHARACTERISTIC
/begin COMPU_METHOD Compu_CRI_IMV_HW_period " " RAT_FUNC "%.0" "Hz" COEFFS 0 0 1 0 0.00000005 0 /end COMPU_METHOD
/begin CHARACTERISTIC FIMP_LL_ena "Load-limit fuel impurity method{FIMP_LL_ena&0xff=0x00:Disabled}{FIMP_LL_ena&0xff=0x01:Linear start-to-finish}{FIMP_LL_ena&0xff=0x02:Nonlinear derate table}{FIMP_LL_ena&0xff=0x03:Speed derate tables}" VALUE 0x001c86ff /* @ECU_Address@FIMP_LL_ena@0x0100FB88@ */ ECIPP_ALIGNMENT_UBYTE 255 FIMP_LL_ena_COMPU_VTAB 0 255 BIT_MASK 0xff /end CHARACTERISTIC
/begin COMPU_METHOD FIMP_LL_ena_COMPU_VTAB "Verbal Table" TAB_VERB "%.0" "list" COMPU_TAB_REF FIMP_LL_ena_COMPU_VTAB_REF /end COMPU_METHOD
/begin COMPU_VTAB FIMP_LL_ena_COMPU_VTAB_REF "Verbal Table" TAB_VERB 4 0x00 "Disabled" 0x01 "Linear start-to-finish" 0x02 "Nonlinear derate table" 0x03 "Speed derate tables" DEFAULT_VALUE "UNKNOWN" /end COMPU_VTAB
/begin CHARACTERISTIC FIMP_BTU_pure "Fuel BTU pure" VALUE 0x001c6f46 /* @ECU_Address@FIMP_BTU_pure@0x0100FB90@ */ ECIPP_ALIGNMENT_UWORD 65535 Compu_FIMP_BTU_pure 0 65535 /end CHARACTERISTIC
/begin COMPU_METHOD Compu_FIMP_BTU_pure " " RAT_FUNC "%.0" "BTU / cu ft" COEFFS 0 1 0 0 0 1 /end COMPU_METHOD
/begin CHARACTERISTIC FIMP_BTU_act "Fuel BTU actual" VALUE 0x001c6f42 /* @ECU_Address@FIMP_BTU_act@0x0100FB98@ */ ECIPP_ALIGNMENT_UWORD 65535 Compu_FIMP_BTU_act 0 65535 /end CHARACTERISTIC
/begin COMPU_METHOD Compu_FIMP_BTU_act " " RAT_FUNC "%.0" "BTU / cu ft" COEFFS 0 1 0 0 0 1 /end COMPU_METHOD
/begin CHARACTERISTIC FIMP_BTU_imp "Fuel BTU impure" VALUE 0x001c6f44 /* @ECU_Address@FIMP_BTU_imp@0x0100FBA0@ */ ECIPP_ALIGNMENT_UWORD 65535 Compu_FIMP_BTU_imp 0 65535 /end CHARACTERISTIC
/begin COMPU_METHOD Compu_FIMP_BTU_imp " " RAT_FUNC "%.0" "BTU / cu ft" COEFFS 0 1 0 0 0 1 /end COMPU_METHOD
/begin CHARACTERISTIC LOCKOFF3_pin "Tri-fuel gaseous lockoff enable pin{LOCKOFF3_pin&0xff=0:Aux PWM1}{LOCKOFF3_pin&0xff=1:Aux PWM2}{LOCKOFF3_pin&0xff=2:Aux PWM3}{LOCKOFF3_pin&0xff=3:Aux PWM4}{LOCKOFF3_pin&0xff=4:Aux PWM5}{LOCKOFF3_pin&0xff=5:Aux PWM6}{LOCKOFF3_pin&0xff=6:EGOH1}{LOCKOFF3_pin" VALUE 0x001c87d3 /* @ECU_Address@LOCKOFF3_pin@0x0100FCF8@ */ ECIPP_ALIGNMENT_UBYTE 255 LOCKOFF3_pin_COMPU_VTAB 0 255 BIT_MASK 0xff /end CHARACTERISTIC
/begin COMPU_METHOD LOCKOFF3_pin_COMPU_VTAB "Verbal Table" TAB_VERB "%.0" "list" COMPU_TAB_REF LOCKOFF3_pin_COMPU_VTAB_REF /end COMPU_METHOD
/begin COMPU_VTAB LOCKOFF3_pin_COMPU_VTAB_REF "Verbal Table" TAB_VERB 10 0 "Aux PWM1" 1 "Aux PWM2" 2 "Aux PWM3" 3 "Aux PWM4" 4 "Aux PWM5" 5 "Aux PWM6" 6 "EGOH1" 7 "EGOH2" 8 "EGOH3" 9 "EGOH4" DEFAULT_VALUE "UNKNOWN" /end COMPU_VTAB
/begin CHARACTERISTIC BIP_enabled "BIP detection{BIP_enabled&0xff=0:Disabled}{BIP_enabled&0xff=1:Enabled on main pulse}{BIP_enabled&0xff=2:Enabled on back-side pulse}" VALUE 0x001c8686 /* @ECU_Address@BIP_enabled@0x010119B0@ */ ECIPP_ALIGNMENT_UBYTE 255 BIP_enabled_COMPU_VTAB 0 255 BIT_MASK 0xff /end CHARACTERISTIC
/begin COMPU_METHOD BIP_enabled_COMPU_VTAB "Verbal Table" TAB_VERB "%.0" "list" COMPU_TAB_REF BIP_enabled_COMPU_VTAB_REF /end COMPU_METHOD
/begin COMPU_VTAB BIP_enabled_COMPU_VTAB_REF "Verbal Table" TAB_VERB 3 0 "Disabled" 1 "Enabled on main pulse" 2 "Enabled on back-side pulse" DEFAULT_VALUE "UNKNOWN" /end COMPU_VTAB
/begin CHARACTERISTIC BIP_min "Min BIP time" VALUE 0x001c6d6c /* @ECU_Address@BIP_min@0x010119B8@ */ ECIPP_ALIGNMENT_UWORD 65535 Compu_BIP_min 0 65535 /end CHARACTERISTIC
/begin COMPU_METHOD Compu_BIP_min " " RAT_FUNC "%.0" "us" COEFFS 0 1 0 0 0 1 /end COMPU_METHOD
/begin CHARACTERISTIC BIP_max "Max BIP time" VALUE 0x001c6d6a /* @ECU_Address@BIP_max@0x010119C0@ */ ECIPP_ALIGNMENT_UWORD 65535 Compu_BIP_max 0 65535 /end CHARACTERISTIC
/begin COMPU_METHOD Compu_BIP_max " " RAT_FUNC "%.0" "us" COEFFS 0 1 0 0 0 1 /end COMPU_METHOD
/begin CHARACTERISTIC BIP_num_pulses "Num pulses per BIP scan" VALUE 0x001c8687 /* @ECU_Address@BIP_num_pulses@0x010119C8@ */ ECIPP_ALIGNMENT_UBYTE 255 Compu_BIP_num_pulses 0 255 /end CHARACTERISTIC
/begin COMPU_METHOD Compu_BIP_num_pulses " " RAT_FUNC "%.0" "-" COEFFS 0 1 0 0 0 1 /end COMPU_METHOD
/begin CHARACTERISTIC BIP_tau "BIP discrete filter constant" VALUE 0x001c6d70 /* @ECU_Address@BIP_tau@0x010119D0@ */ ECIPP_ALIGNMENT_UWORD 100 Compu_BIP_tau 0 99.9984741210938 /end CHARACTERISTIC
/begin COMPU_METHOD Compu_BIP_tau " " RAT_FUNC "%.0" "%" COEFFS 0 655.36 0 0 0 1 /end COMPU_METHOD
/begin CHARACTERISTIC BIP_nom "Nominal UCV BIP" VALUE 0x001c6d6e /* @ECU_Address@BIP_nom@0x010119D8@ */ ECIPP_ALIGNMENT_UWORD 65535 Compu_BIP_nom 0 65535 /end CHARACTERISTIC
/begin COMPU_METHOD Compu_BIP_nom " " RAT_FUNC "%.0" "us" COEFFS 0 1 0 0 0 1 /end COMPU_METHOD
/begin CHARACTERISTIC BIP_interval_ms "BIP detection interval" VALUE 0x001c425c /* @ECU_Address@BIP_interval_ms@0x010119E0@ */ ECIPP_ALIGNMENT_ULONG 4294967 Compu_BIP_interval_ms 0 4294967.295 /end CHARACTERISTIC
/begin COMPU_METHOD Compu_BIP_interval_ms " " RAT_FUNC "%.0" "seconds" COEFFS 0 1000 0 0 0 1 /end COMPU_METHOD
/begin CHARACTERISTIC BIP_dIinj_thld "Current slope thld" VALUE 0x001c3a64 /* @ECU_Address@BIP_dIinj_thld@0x010119E8@ */ ECIPP_ALIGNMENT_FLOAT32_IEEE 10000000000 Compu_BIP_dIinj_thld -10000000000 10000000000 /end CHARACTERISTIC
/begin COMPU_METHOD Compu_BIP_dIinj_thld " " RAT_FUNC "%.1" "mA/us" COEFFS 0 0.001 0 0 0 1 /end COMPU_METHOD
/begin MEASUREMENT CRI_LS_PH_off "CRI LS peak-hold control{CRI_LS_PH_off&0xff=0:Fast decay (normal)}{CRI_LS_PH_off&0xff=1:Slow decay (BIP detect)}" UBYTE CRI_LS_PH_off_COMPU_VTAB 0 0 0 255 ECU_ADDRESS 0x010119F0 BIT_MASK 0xff /end MEASUREMENT
/begin COMPU_METHOD CRI_LS_PH_off_COMPU_VTAB "Verbal Table" TAB_VERB "%.0" "list" COMPU_TAB_REF CRI_LS_PH_off_COMPU_VTAB_REF /end COMPU_METHOD
/begin COMPU_VTAB CRI_LS_PH_off_COMPU_VTAB_REF "Verbal Table" TAB_VERB 2 0 "Fast decay (normal)" 1 "Slow decay (BIP detect)" DEFAULT_VALUE "UNKNOWN" /end COMPU_VTAB
/begin MEASUREMENT BIP_last_cyl1 "BIP_last_cyl1" UWORD Compu_BIP_last_cyl1 0 0 0 65535 ECU_ADDRESS 0x010119F8 /end MEASUREMENT
/begin COMPU_METHOD Compu_BIP_last_cyl1 " " RAT_FUNC "%.0" "us" COEFFS 0 1 0 0 0 1 /end COMPU_METHOD
/begin MEASUREMENT BIP_last_cyl2 "BIP_last_cyl2" UWORD Compu_BIP_last_cyl2 0 0 0 65535 ECU_ADDRESS 0x01011A00 /end MEASUREMENT
/begin COMPU_METHOD Compu_BIP_last_cyl2 " " RAT_FUNC "%.0" "us" COEFFS 0 1 0 0 0 1 /end COMPU_METHOD
/begin MEASUREMENT BIP_last_cyl3 "BIP_last_cyl3" UWORD Compu_BIP_last_cyl3 0 0 0 65535 ECU_ADDRESS 0x01011A08 /end MEASUREMENT
/begin COMPU_METHOD Compu_BIP_last_cyl3 " " RAT_FUNC "%.0" "us" COEFFS 0 1 0 0 0 1 /end COMPU_METHOD
/begin MEASUREMENT BIP_last_cyl4 "BIP_last_cyl4" UWORD Compu_BIP_last_cyl4 0 0 0 65535 ECU_ADDRESS 0x01011A10 /end MEASUREMENT
/begin COMPU_METHOD Compu_BIP_last_cyl4 " " RAT_FUNC "%.0" "us" COEFFS 0 1 0 0 0 1 /end COMPU_METHOD
/begin MEASUREMENT BIP_last_cyl5 "BIP_last_cyl5" UWORD Compu_BIP_last_cyl5 0 0 0 65535 ECU_ADDRESS 0x01011A18 /end MEASUREMENT
/begin COMPU_METHOD Compu_BIP_last_cyl5 " " RAT_FUNC "%.0" "us" COEFFS 0 1 0 0 0 1 /end COMPU_METHOD
/begin MEASUREMENT BIP_last_cyl6 "BIP_last_cyl6" UWORD Compu_BIP_last_cyl6 0 0 0 65535 ECU_ADDRESS 0x01011A20 /end MEASUREMENT
/begin COMPU_METHOD Compu_BIP_last_cyl6 " " RAT_FUNC "%.0" "us" COEFFS 0 1 0 0 0 1 /end COMPU_METHOD
/begin MEASUREMENT BIP_last_cyl7 "BIP_last_cyl7" UWORD Compu_BIP_last_cyl7 0 0 0 65535 ECU_ADDRESS 0x01011A28 /end MEASUREMENT
/begin COMPU_METHOD Compu_BIP_last_cyl7 " " RAT_FUNC "%.0" "us" COEFFS 0 1 0 0 0 1 /end COMPU_METHOD
/begin MEASUREMENT BIP_last_cyl8 "BIP_last_cyl8" UWORD Compu_BIP_last_cyl8 0 0 0 65535 ECU_ADDRESS 0x01011A30 /end MEASUREMENT
/begin COMPU_METHOD Compu_BIP_last_cyl8 " " RAT_FUNC "%.0" "us" COEFFS 0 1 0 0 0 1 /end COMPU_METHOD
/begin MEASUREMENT BIP_cyl1 "BIP_cyl1" UWORD Compu_BIP_cyl1 0 0 0 65535 ECU_ADDRESS 0x01011A38 /end MEASUREMENT
/begin COMPU_METHOD Compu_BIP_cyl1 " " RAT_FUNC "%.0" "us" COEFFS 0 1 0 0 0 1 /end COMPU_METHOD
/begin MEASUREMENT BIP_cyl2 "BIP_cyl2" UWORD Compu_BIP_cyl2 0 0 0 65535 ECU_ADDRESS 0x01011A40 /end MEASUREMENT
/begin COMPU_METHOD Compu_BIP_cyl2 " " RAT_FUNC "%.0" "us" COEFFS 0 1 0 0 0 1 /end COMPU_METHOD
/begin MEASUREMENT BIP_cyl3 "BIP_cyl3" UWORD Compu_BIP_cyl3 0 0 0 65535 ECU_ADDRESS 0x01011A48 /end MEASUREMENT
/begin COMPU_METHOD Compu_BIP_cyl3 " " RAT_FUNC "%.0" "us" COEFFS 0 1 0 0 0 1 /end COMPU_METHOD
/begin MEASUREMENT BIP_cyl4 "BIP_cyl4" UWORD Compu_BIP_cyl4 0 0 0 65535 ECU_ADDRESS 0x01011A50 /end MEASUREMENT
/begin COMPU_METHOD Compu_BIP_cyl4 " " RAT_FUNC "%.0" "us" COEFFS 0 1 0 0 0 1 /end COMPU_METHOD
/begin MEASUREMENT BIP_cyl5 "BIP_cyl5" UWORD Compu_BIP_cyl5 0 0 0 65535 ECU_ADDRESS 0x01011A58 /end MEASUREMENT
/begin COMPU_METHOD Compu_BIP_cyl5 " " RAT_FUNC "%.0" "us" COEFFS 0 1 0 0 0 1 /end COMPU_METHOD
/begin MEASUREMENT BIP_cyl6 "BIP_cyl6" UWORD Compu_BIP_cyl6 0 0 0 65535 ECU_ADDRESS 0x01011A60 /end MEASUREMENT
/begin COMPU_METHOD Compu_BIP_cyl6 " " RAT_FUNC "%.0" "us" COEFFS 0 1 0 0 0 1 /end COMPU_METHOD
/begin MEASUREMENT BIP_cyl7 "BIP_cyl7" UWORD Compu_BIP_cyl7 0 0 0 65535 ECU_ADDRESS 0x01011A68 /end MEASUREMENT
/begin COMPU_METHOD Compu_BIP_cyl7 " " RAT_FUNC "%.0" "us" COEFFS 0 1 0 0 0 1 /end COMPU_METHOD
/begin MEASUREMENT BIP_cyl8 "BIP_cyl8" UWORD Compu_BIP_cyl8 0 0 0 65535 ECU_ADDRESS 0x01011A70 /end MEASUREMENT
/begin COMPU_METHOD Compu_BIP_cyl8 " " RAT_FUNC "%.0" "us" COEFFS 0 1 0 0 0 1 /end COMPU_METHOD
/begin MEASUREMENT BIP_CAD_offset_cyl1 "BIP_CAD_offset_cyl1" SWORD Compu_BIP_CAD_offset_cyl1 0 0 -2048 2047.9375 ECU_ADDRESS 0x01011A78 /end MEASUREMENT
/begin COMPU_METHOD Compu_BIP_CAD_offset_cyl1 " " RAT_FUNC "%.2" "CAD BTDCC" COEFFS 0 16 0 0 0 1 /end COMPU_METHOD
/begin MEASUREMENT BIP_CAD_offset_cyl2 "BIP_CAD_offset_cyl2" SWORD Compu_BIP_CAD_offset_cyl2 0 0 -2048 2047.9375 ECU_ADDRESS 0x01011A80 /end MEASUREMENT
/begin COMPU_METHOD Compu_BIP_CAD_offset_cyl2 " " RAT_FUNC "%.2" "CAD BTDCC" COEFFS 0 16 0 0 0 1 /end COMPU_METHOD
/begin MEASUREMENT BIP_CAD_offset_cyl3 "BIP_CAD_offset_cyl3" SWORD Compu_BIP_CAD_offset_cyl3 0 0 -2048 2047.9375 ECU_ADDRESS 0x01011A88 /end MEASUREMENT
/begin COMPU_METHOD Compu_BIP_CAD_offset_cyl3 " " RAT_FUNC "%.2" "CAD BTDCC" COEFFS 0 16 0 0 0 1 /end COMPU_METHOD
/begin MEASUREMENT BIP_CAD_offset_cyl4 "BIP_CAD_offset_cyl4" SWORD Compu_BIP_CAD_offset_cyl4 0 0 -2048 2047.9375 ECU_ADDRESS 0x01011A90 /end MEASUREMENT
/begin COMPU_METHOD Compu_BIP_CAD_offset_cyl4 " " RAT_FUNC "%.2" "CAD BTDCC" COEFFS 0 16 0 0 0 1 /end COMPU_METHOD
/begin MEASUREMENT BIP_CAD_offset_cyl5 "BIP_CAD_offset_cyl5" SWORD Compu_BIP_CAD_offset_cyl5 0 0 -2048 2047.9375 ECU_ADDRESS 0x01011A98 /end MEASUREMENT
/begin COMPU_METHOD Compu_BIP_CAD_offset_cyl5 " " RAT_FUNC "%.2" "CAD BTDCC" COEFFS 0 16 0 0 0 1 /end COMPU_METHOD
/begin MEASUREMENT BIP_CAD_offset_cyl6 "BIP_CAD_offset_cyl6" SWORD Compu_BIP_CAD_offset_cyl6 0 0 -2048 2047.9375 ECU_ADDRESS 0x01011AA0 /end MEASUREMENT
/begin COMPU_METHOD Compu_BIP_CAD_offset_cyl6 " " RAT_FUNC "%.2" "CAD BTDCC" COEFFS 0 16 0 0 0 1 /end COMPU_METHOD
/begin MEASUREMENT BIP_CAD_offset_cyl7 "BIP_CAD_offset_cyl7" SWORD Compu_BIP_CAD_offset_cyl7 0 0 -2048 2047.9375 ECU_ADDRESS 0x01011AA8 /end MEASUREMENT
/begin COMPU_METHOD Compu_BIP_CAD_offset_cyl7 " " RAT_FUNC "%.2" "CAD BTDCC" COEFFS 0 16 0 0 0 1 /end COMPU_METHOD
/begin MEASUREMENT BIP_CAD_offset_cyl8 "BIP_CAD_offset_cyl8" SWORD Compu_BIP_CAD_offset_cyl8 0 0 -2048 2047.9375 ECU_ADDRESS 0x01011AB0 /end MEASUREMENT
/begin COMPU_METHOD Compu_BIP_CAD_offset_cyl8 " " RAT_FUNC "%.2" "CAD BTDCC" COEFFS 0 16 0 0 0 1 /end COMPU_METHOD
/begin CHARACTERISTIC LPG_NG_ovlp "LPG->NG lockoff overlap" VALUE 0x001c7d08 /* @ECU_Address@LPG_NG_ovlp@0x01011AB8@ */ ECIPP_ALIGNMENT_UWORD 65535 Compu_LPG_NG_ovlp 0 65535 /end CHARACTERISTIC
/begin COMPU_METHOD Compu_LPG_NG_ovlp " " RAT_FUNC "%.0" "ms" COEFFS 0 1 0 0 0 1 /end COMPU_METHOD
/begin CHARACTERISTIC NG_LPG_ovlp "NG->LPG lockoff overlap" VALUE 0x001c7df0 /* @ECU_Address@NG_LPG_ovlp@0x01011AC0@ */ ECIPP_ALIGNMENT_UWORD 65535 Compu_NG_LPG_ovlp 0 65535 /end CHARACTERISTIC
/begin COMPU_METHOD Compu_NG_LPG_ovlp " " RAT_FUNC "%.0" "ms" COEFFS 0 1 0 0 0 1 /end COMPU_METHOD
/begin CHARACTERISTIC LPG_NG_lockout "LPG->NG lockout time" VALUE 0x001c42c0 /* @ECU_Address@LPG_NG_lockout@0x01011AC8@ */ ECIPP_ALIGNMENT_ULONG 4294967 Compu_LPG_NG_lockout 0 4294967.295 /end CHARACTERISTIC
/begin COMPU_METHOD Compu_LPG_NG_lockout " " RAT_FUNC "%.0" "s" COEFFS 0 1000 0 0 0 1 /end COMPU_METHOD
/begin CHARACTERISTIC FIP_LL_ena "Fuel inlet pressure load-limiting{FIP_LL_ena&0xff=0:Disabled}{FIP_LL_ena&0xff=1:Enabled}" VALUE 0x001c8706 /* @ECU_Address@FIP_LL_ena@0x01011FC8@ */ ECIPP_ALIGNMENT_UBYTE 255 FIP_LL_ena_COMPU_VTAB 0 255 BIT_MASK 0xff /end CHARACTERISTIC
/begin COMPU_METHOD FIP_LL_ena_COMPU_VTAB "Verbal Table" TAB_VERB "%.0" "list" COMPU_TAB_REF FIP_LL_ena_COMPU_VTAB_REF /end COMPU_METHOD
/begin COMPU_VTAB FIP_LL_ena_COMPU_VTAB_REF "Verbal Table" TAB_VERB 2 0 "Disabled" 1 "Enabled" DEFAULT_VALUE "UNKNOWN" /end COMPU_VTAB
/begin CHARACTERISTIC LOCKOFF4_pin "Tri-Fuel seconday gaseous lockoff{LOCKOFF4_pin&0xff=0:Disabled}{LOCKOFF4_pin&0xff=1:Secondary lockoff pin}{LOCKOFF4_pin&0xff=2:Aux PWM1}{LOCKOFF4_pin&0xff=3:Aux PWM2}{LOCKOFF4_pin&0xff=4:Aux PWM3}{LOCKOFF4_pin&0xff=5:Aux PWM4}{LOCKOFF4_pin&0xff=6:Aux PWM5" VALUE 0x001c87d4 /* @ECU_Address@LOCKOFF4_pin@0x010120A8@ */ ECIPP_ALIGNMENT_UBYTE 255 LOCKOFF4_pin_COMPU_VTAB 0 255 BIT_MASK 0xff /end CHARACTERISTIC
/begin COMPU_METHOD LOCKOFF4_pin_COMPU_VTAB "Verbal Table" TAB_VERB "%.0" "list" COMPU_TAB_REF LOCKOFF4_pin_COMPU_VTAB_REF /end COMPU_METHOD
/begin COMPU_VTAB LOCKOFF4_pin_COMPU_VTAB_REF "Verbal Table" TAB_VERB 12 0 "Disabled" 1 "Secondary lockoff pin" 2 "Aux PWM1" 3 "Aux PWM2" 4 "Aux PWM3" 5 "Aux PWM4" 6 "Aux PWM5" 7 "Aux PWM6" 8 "EGOH1" 9 "EGOH2" 10 "EGOH3" 11 "EGOH4" DEFAULT_VALUE "UNKNOWN" /end COMPU_VTAB
/begin CHARACTERISTIC CRI_i_peak_init_BIP "BIP initial peak current" VALUE 0x001c6e44 /* @ECU_Address@CRI_i_peak_init_BIP@0x010127E8@ */ ECIPP_ALIGNMENT_UWORD 128 Compu_CRI_i_peak_init_BIP 0 127.998046875 /end CHARACTERISTIC
/begin COMPU_METHOD Compu_CRI_i_peak_init_BIP " " RAT_FUNC "%.1" "amps" COEFFS 0 512 0 0 0 1 /end COMPU_METHOD
/begin CHARACTERISTIC CRI_i_peak_BIP "BIP peak current" VALUE 0x001c6e42 /* @ECU_Address@CRI_i_peak_BIP@0x010127F0@ */ ECIPP_ALIGNMENT_UWORD 128 Compu_CRI_i_peak_BIP 0 127.998046875 /end CHARACTERISTIC
/begin COMPU_METHOD Compu_CRI_i_peak_BIP " " RAT_FUNC "%.1" "amps" COEFFS 0 512 0 0 0 1 /end COMPU_METHOD
/begin CHARACTERISTIC CRI_i_hold_BIP "BIP hold current" VALUE 0x001c6e40 /* @ECU_Address@CRI_i_hold_BIP@0x010127F8@ */ ECIPP_ALIGNMENT_UWORD 128 Compu_CRI_i_hold_BIP 0 127.998046875 /end CHARACTERISTIC
/begin COMPU_METHOD Compu_CRI_i_hold_BIP " " RAT_FUNC "%.1" "amps" COEFFS 0 512 0 0 0 1 /end COMPU_METHOD
/begin CHARACTERISTIC CRI_cad_post2_BIP "BIP back-side pulse timing" VALUE 0x001c4466 /* @ECU_Address@CRI_cad_post2_BIP@0x01012800@ */ ECIPP_ALIGNMENT_SWORD 2048 Compu_CRI_cad_post2_BIP -2048 2047.9375 /end CHARACTERISTIC
/begin COMPU_METHOD Compu_CRI_cad_post2_BIP " " RAT_FUNC "%.1" "CAD BTDCC" COEFFS 0 16 0 0 0 1 /end COMPU_METHOD
/begin CHARACTERISTIC CRI_width_post2_BIP "BIP back-side pulse width" VALUE 0x001c4274 /* @ECU_Address@CRI_width_post2_BIP@0x01012808@ */ ECIPP_ALIGNMENT_ULONG 214748365 Compu_CRI_width_post2_BIP 0 214748364.75 /end CHARACTERISTIC
/begin COMPU_METHOD Compu_CRI_width_post2_BIP " " RAT_FUNC "%.0" "us" COEFFS 0 20 0 0 0 1 /end COMPU_METHOD
/begin CHARACTERISTIC FPC_FP_source "Liquid fuel pressure source{FPC_FP_source&0xff=0:Primary}{FPC_FP_source&0xff=1:Secondary}" VALUE 0x001c870e /* @ECU_Address@FPC_FP_source@0x010130C0@ */ ECIPP_ALIGNMENT_UBYTE 255 FPC_FP_source_COMPU_VTAB 0 255 BIT_MASK 0xff /end CHARACTERISTIC
/begin COMPU_METHOD FPC_FP_source_COMPU_VTAB "Verbal Table" TAB_VERB "%.0" "list" COMPU_TAB_REF FPC_FP_source_COMPU_VTAB_REF /end COMPU_METHOD
/begin COMPU_VTAB FPC_FP_source_COMPU_VTAB_REF "Verbal Table" TAB_VERB 2 0 "Primary" 1 "Secondary" DEFAULT_VALUE "UNKNOWN" /end COMPU_VTAB
/begin CHARACTERISTIC lockoff_keyoff_ena "LPG lockoff close at Vswitch drop{lockoff_keyoff_ena&0xff=0:Disabled}{lockoff_keyoff_ena&0xff=1:Enabled}" VALUE 0x001c906b /* @ECU_Address@lockoff_keyoff_ena@0x01013920@ */ ECIPP_ALIGNMENT_UBYTE 255 lockoff_keyoff_ena_COMPU_VTAB 0 255 BIT_MASK 0xff /end CHARACTERISTIC
/begin COMPU_METHOD lockoff_keyoff_ena_COMPU_VTAB "Verbal Table" TAB_VERB "%.0" "list" COMPU_TAB_REF lockoff_keyoff_ena_COMPU_VTAB_REF /end COMPU_METHOD
/begin COMPU_VTAB lockoff_keyoff_ena_COMPU_VTAB_REF "Verbal Table" TAB_VERB 2 0 "Disabled" 1 "Enabled" DEFAULT_VALUE "UNKNOWN" /end COMPU_VTAB
/begin MEASUREMENT inj11_last_falling "Injection 11 last EOI" SWORD Compu_inj11_last_falling 0 0 -2048 2047.9375 ECU_ADDRESS 0x01014B90 /end MEASUREMENT
/begin COMPU_METHOD Compu_inj11_last_falling " " RAT_FUNC "%.1" "CAD BBDCI" COEFFS 0 16 0 0 0 1 /end COMPU_METHOD
/begin MEASUREMENT inj12_last_falling "Injection 12 last EOI" SWORD Compu_inj12_last_falling 0 0 -2048 2047.9375 ECU_ADDRESS 0x01014B98 /end MEASUREMENT
/begin COMPU_METHOD Compu_inj12_last_falling " " RAT_FUNC "%.1" "CAD BBDCI" COEFFS 0 16 0 0 0 1 /end COMPU_METHOD
/begin CHARACTERISTIC FPin_a_type "Fuel rail pressure target type{FPin_a_type&0xff=0:Static - cal}{FPin_a_type&0xff=1:MAP + 1 bar}" VALUE 0x001C9F7A /* @ECU_Address@FPin_a_type@0x01015468@ */ ECIPP_ALIGNMENT_UBYTE 255 FPin_a_type_COMPU_VTAB 0 255 BIT_MASK 0xff /end CHARACTERISTIC
/begin COMPU_METHOD FPin_a_type_COMPU_VTAB "Verbal Table" TAB_VERB "%.0" "list" COMPU_TAB_REF FPin_a_type_COMPU_VTAB_REF /end COMPU_METHOD
/begin COMPU_VTAB FPin_a_type_COMPU_VTAB_REF "Verbal Table" TAB_VERB 2 0 "Static - cal" 1 "MAP + 1 bar" DEFAULT_VALUE "UNKNOWN" /end COMPU_VTAB
/begin CHARACTERISTIC FPin_a_I2_type "Sec fuel rail pressure target{FPin_a_I2_type&0xff=0:Static - cal}{FPin_a_I2_type&0xff=1:MAP + 1 bar}" VALUE 0x001C9FB6 /* @ECU_Address@FPin_a_I2_type@0x01015470@ */ ECIPP_ALIGNMENT_UBYTE 255 FPin_a_I2_type_COMPU_VTAB 0 255 BIT_MASK 0xff /end CHARACTERISTIC
/begin COMPU_METHOD FPin_a_I2_type_COMPU_VTAB "Verbal Table" TAB_VERB "%.0" "list" COMPU_TAB_REF FPin_a_I2_type_COMPU_VTAB_REF /end COMPU_METHOD
/begin COMPU_VTAB FPin_a_I2_type_COMPU_VTAB_REF "Verbal Table" TAB_VERB 2 0 "Static - cal" 1 "MAP + 1 bar" DEFAULT_VALUE "UNKNOWN" /end COMPU_VTAB
/begin MEASUREMENT FPin_a_val "Fuel rail pressure target value" UWORD Compu_FPin_a_val 0 0 0 255.99609375 ECU_ADDRESS 0x01015478 /end MEASUREMENT
/begin COMPU_METHOD Compu_FPin_a_val " " RAT_FUNC "%.1" "psia" COEFFS 0 256 0 0 0 1 /end COMPU_METHOD
/begin MEASUREMENT FPin_a_I2_val "Sec fuel rail pressure target value" UWORD Compu_FPin_a_I2_val 0 0 0 255.99609375 ECU_ADDRESS 0x01015480 /end MEASUREMENT
/begin COMPU_METHOD Compu_FPin_a_I2_val " " RAT_FUNC "%.1" "psia" COEFFS 0 256 0 0 0 1 /end COMPU_METHOD
/begin CHARACTERISTIC Tinj_CAD_CAD "Injection Timing - Primary" MAP 0x001C64CC /* @ECU_Address@Tinj_CAD_CAD@0x02014000@ */ ECIPP_ALIGNMENT_SWORD 2048 Compu_Tinj_CAD_CAD -2048 2047.9375
 /begin AXIS_DESCR COM_AXIS NO_INPUT_QUANTITY Compu_Tinj_CAD_PW 8 -104.8576 104.8544 AXIS_PTS_REF Tinj_CAD_PW /end AXIS_DESCR
 /begin AXIS_DESCR COM_AXIS NO_INPUT_QUANTITY Compu_Tinj_CAD_rpm 8 -32768 32767 AXIS_PTS_REF Tinj_CAD_rpm /end AXIS_DESCR
/end CHARACTERISTIC
/begin AXIS_PTS Tinj_CAD_PW " " 0x001C65CC /* @ECU_Address@Tinj_CAD_PW@0x02015000@ */ NO_INPUT_QUANTITY ECIPP_Lookup_SWORD 0 Compu_Tinj_CAD_PW 8 -104.8576 104.8544 /end AXIS_PTS
/begin AXIS_PTS Tinj_CAD_rpm " " 0x001C65EC /* @ECU_Address@Tinj_CAD_rpm@0x02016000@ */ NO_INPUT_QUANTITY ECIPP_Lookup_SWORD 0 Compu_Tinj_CAD_rpm 8 -32768 32767 /end AXIS_PTS
/begin COMPU_METHOD Compu_Tinj_CAD_CAD "" RAT_FUNC "%.0" "CAD BBDC Intake" COEFFS 0 16 0 0 0 1 /end COMPU_METHOD
/begin COMPU_METHOD Compu_Tinj_CAD_PW " " RAT_FUNC "%.1" "PW (ms)" COEFFS 0 312.5 0 0 0 1 /end COMPU_METHOD
/begin COMPU_METHOD Compu_Tinj_CAD_rpm " " RAT_FUNC "%.0" "Speed (rpm)" COEFFS 0 1 0 0 0 1 /end COMPU_METHOD
/begin COMPU_METHOD Compu_Tgagedrv_ECT " " RAT_FUNC "%.1" "ECT (deg F)" COEFFS 0 32 14720 0 0 1 /end COMPU_METHOD
/begin CHARACTERISTIC Tgagedrv_DC "ECT Gauge Driver Calibration" CURVE 0x001C648C /* @ECU_Address@Tgagedrv_DC@0x020C1000@ */ ECIPP_ALIGNMENT_SWORD 200 Compu_Tgagedrv_DC -200 199.993896484375
 /begin AXIS_DESCR COM_AXIS NO_INPUT_QUANTITY Compu_Tgagedrv_ECT 16 -1484 563.96875 AXIS_PTS_REF Tgagedrv_ECT /end AXIS_DESCR
/end CHARACTERISTIC
/begin AXIS_PTS Tgagedrv_ECT " " 0x001C64AC /* @ECU_Address@Tgagedrv_ECT@0x020C0000@ */ NO_INPUT_QUANTITY ECIPP_Lookup_SWORD 0 Compu_Tgagedrv_ECT 16 -1484 563.96875 /end AXIS_PTS
/begin COMPU_METHOD Compu_Tgagedrv_DC " " RAT_FUNC "%.1" "Duty-Cycle (%)" COEFFS 0 163.84 0 0 0 1 /end COMPU_METHOD
/begin CHARACTERISTIC TECTgd_R "ECT Gauge Driver Calibration" CURVE 0x001C4A3C /* @ECU_Address@TECTgd_R@0x020F4000@ */ ECIPP_ALIGNMENT_SWORD 4096 Compu_TECTgd_R -4096 4095.875
 /begin AXIS_DESCR COM_AXIS NO_INPUT_QUANTITY Compu_Tgagedrv_ECT 16 -1484 563.96875 AXIS_PTS_REF Tgagedrv_ECT /end AXIS_DESCR
/end CHARACTERISTIC
/begin COMPU_METHOD Compu_TECTgd_R " " RAT_FUNC "%.1" "Resistance (ohms)" COEFFS 0 8 0 0 0 1 /end COMPU_METHOD
/begin COMPU_METHOD Compu_TOilPgd_OilP " " RAT_FUNC "%.1" "OilP (psig)" COEFFS 0 128 0 0 0 1 /end COMPU_METHOD
/begin CHARACTERISTIC TOilPgd_DC "OilP Gauge Driver Calibration" CURVE 0x001C584E /* @ECU_Address@TOilPgd_DC@0x020F6000@ */ ECIPP_ALIGNMENT_SWORD 200 Compu_TOilPgd_DC -200 199.993896484375
 /begin AXIS_DESCR COM_AXIS NO_INPUT_QUANTITY Compu_TOilPgd_OilP 16 -256 255.9921875 AXIS_PTS_REF TOilPgd_OilP /end AXIS_DESCR
/end CHARACTERISTIC
/begin AXIS_PTS TOilPgd_OilP " " 0x001C586E /* @ECU_Address@TOilPgd_OilP@0x020F5000@ */ NO_INPUT_QUANTITY ECIPP_Lookup_SWORD 0 Compu_TOilPgd_OilP 16 -256 255.9921875 /end AXIS_PTS
/begin COMPU_METHOD Compu_TOilPgd_DC " " RAT_FUNC "%.1" "Duty-Cycle (%)" COEFFS 0 163.84 0 0 0 1 /end COMPU_METHOD
/begin CHARACTERISTIC TOilPgd_R "OilP Gauge Driver Calibration" CURVE 0x001C588E /* @ECU_Address@TOilPgd_R@0x020F7000@ */ ECIPP_ALIGNMENT_SWORD 4096 Compu_TOilPgd_R -4096 4095.875
 /begin AXIS_DESCR COM_AXIS NO_INPUT_QUANTITY Compu_TOilPgd_OilP 16 -256 255.9921875 AXIS_PTS_REF TOilPgd_OilP /end AXIS_DESCR
/end CHARACTERISTIC
/begin COMPU_METHOD Compu_TOilPgd_R " " RAT_FUNC "%.1" "Resistance (ohms)" COEFFS 0 8 0 0 0 1 /end COMPU_METHOD
/begin COMPU_METHOD Compu_TV1gd_volts " " RAT_FUNC "%.2" "Volt1 (volts)" COEFFS 0 256 0 0 0 1 /end COMPU_METHOD
/begin CHARACTERISTIC TV1gd_DC "Volt1 Gauge Driver Calibration" CURVE 0x001C5C66 /* @ECU_Address@TV1gd_DC@0x020F9000@ */ ECIPP_ALIGNMENT_SWORD 200 Compu_TV1gd_DC -200 199.993896484375
 /begin AXIS_DESCR COM_AXIS NO_INPUT_QUANTITY Compu_TV1gd_volts 16 -128 127.99609375 AXIS_PTS_REF TV1gd_volts /end AXIS_DESCR
/end CHARACTERISTIC
/begin AXIS_PTS TV1gd_volts " " 0x001C5CA6 /* @ECU_Address@TV1gd_volts@0x020F8000@ */ NO_INPUT_QUANTITY ECIPP_Lookup_SWORD 0 Compu_TV1gd_volts 16 -128 127.99609375 /end AXIS_PTS
/begin COMPU_METHOD Compu_TV1gd_DC " " RAT_FUNC "%.1" "Duty-Cycle (%)" COEFFS 0 163.84 0 0 0 1 /end COMPU_METHOD
/begin CHARACTERISTIC TV1gd_R "Volt1 Gauge Driver Calibration" CURVE 0x001C5C86 /* @ECU_Address@TV1gd_R@0x020FA000@ */ ECIPP_ALIGNMENT_SWORD 4096 Compu_TV1gd_R -4096 4095.875
 /begin AXIS_DESCR COM_AXIS NO_INPUT_QUANTITY Compu_TV1gd_volts 16 -128 127.99609375 AXIS_PTS_REF TV1gd_volts /end AXIS_DESCR
/end CHARACTERISTIC
/begin COMPU_METHOD Compu_TV1gd_R " " RAT_FUNC "%.1" "Resistance (ohms)" COEFFS 0 8 0 0 0 1 /end COMPU_METHOD
/begin COMPU_METHOD Compu_TFPC_mdotf " " RAT_FUNC "%.2" "fuel (g/sec)" COEFFS 0 256 0 0 0 1 /end COMPU_METHOD
/begin CHARACTERISTIC TFPC_Vnom "Fuel Pump Feedforward Voltage" CURVE 0x001C4C98 /* @ECU_Address@TFPC_Vnom@0x02102000@ */ ECIPP_ALIGNMENT_SWORD 128 Compu_TFPC_Vnom -128 127.99609375
 /begin AXIS_DESCR COM_AXIS NO_INPUT_QUANTITY Compu_TFPC_mdotf 8 -128 127.99609375 AXIS_PTS_REF TFPC_mdotf /end AXIS_DESCR
/end CHARACTERISTIC
/begin AXIS_PTS TFPC_mdotf " " 0x001C4CA8 /* @ECU_Address@TFPC_mdotf@0x02101000@ */ NO_INPUT_QUANTITY ECIPP_Lookup_SWORD 0 Compu_TFPC_mdotf 8 -128 127.99609375 /end AXIS_PTS
/begin COMPU_METHOD Compu_TFPC_Vnom " " RAT_FUNC "%.2" "pump volts" COEFFS 0 256 0 0 0 1 /end COMPU_METHOD
/begin COMPU_METHOD Compu_TVLPGoff_T " " RAT_FUNC "%.0" "ECT/FT (deg F)" COEFFS 0 32 14720 0 0 1 /end COMPU_METHOD
/begin CHARACTERISTIC TVLPGoff_V "LPG turnoff volume equivalent (table based)" CURVE 0x001C5F0E /* @ECU_Address@TVLPGoff_V@0x0210D000@ */ ECIPP_ALIGNMENT_SWORD 32 Compu_TVLPGoff_V -32 31.9990234375
 /begin AXIS_DESCR COM_AXIS NO_INPUT_QUANTITY Compu_TVLPGoff_T 4 -1484 563.96875 AXIS_PTS_REF TVLPGoff_T /end AXIS_DESCR
/end CHARACTERISTIC
/begin AXIS_PTS TVLPGoff_T " " 0x001C5F06 /* @ECU_Address@TVLPGoff_T@0x0210C000@ */ NO_INPUT_QUANTITY ECIPP_Lookup_SWORD 0 Compu_TVLPGoff_T 4 -1484 563.96875 /end AXIS_PTS
/begin COMPU_METHOD Compu_TVLPGoff_V " " RAT_FUNC "%.2" "LPG V (liters)" COEFFS 0 1024 0 0 0 1 /end COMPU_METHOD
/begin COMPU_METHOD Compu_TFIMPb_FTT " " RAT_FUNC "%.0" "FTT (deg F)" COEFFS 0 32 14720 0 0 1 /end COMPU_METHOD
/begin COMPU_METHOD Compu_TFIMPb_IMPpct " " RAT_FUNC "%.1" "Fuel Impurity (%)" COEFFS 0 163.84 0 0 0 1 /end COMPU_METHOD
/begin CHARACTERISTIC TFIMPb_FTP "LPG FTP/FTT Fuel Impurity Calibration" MAP 0x001C4C00 /* @ECU_Address@TFIMPb_FTP@0x02151000@ */ ECIPP_ALIGNMENT_SWORD 4096 Compu_TFIMPb_FTP -4096 4095.875
 /begin AXIS_DESCR COM_AXIS NO_INPUT_QUANTITY Compu_TFIMPb_IMPpct 4 -200 199.993896484375 AXIS_PTS_REF TFIMPb_IMPpct /end AXIS_DESCR
 /begin AXIS_DESCR COM_AXIS NO_INPUT_QUANTITY Compu_TFIMPb_FTT 8 -1484 563.96875 AXIS_PTS_REF TFIMPb_FTT /end AXIS_DESCR
/end CHARACTERISTIC
/begin AXIS_PTS TFIMPb_IMPpct " " 0x001C4C50 /* @ECU_Address@TFIMPb_IMPpct@0x02150000@ */ NO_INPUT_QUANTITY ECIPP_Lookup_SWORD 0 Compu_TFIMPb_IMPpct 4 -200 199.993896484375 /end AXIS_PTS
/begin AXIS_PTS TFIMPb_FTT " " 0x001C4C40 /* @ECU_Address@TFIMPb_FTT@0x0214F000@ */ NO_INPUT_QUANTITY ECIPP_Lookup_SWORD 0 Compu_TFIMPb_FTT 8 -1484 563.96875 /end AXIS_PTS
/begin COMPU_METHOD Compu_TFIMPb_FTP "" RAT_FUNC "%.1" "FTP (psia)" COEFFS 0 8 0 0 0 1 /end COMPU_METHOD
/begin COMPU_METHOD Compu_TFLEVgd_pct " " RAT_FUNC "%.1" "Fuel level (%)" COEFFS 0 163.84 0 0 0 1 /end COMPU_METHOD
/begin CHARACTERISTIC TFLEVgd_DC "FLEV Gauge Driver Calibration" CURVE 0x001C4C58 /* @ECU_Address@TFLEVgd_DC@0x02186000@ */ ECIPP_ALIGNMENT_SWORD 200 Compu_TFLEVgd_DC -200 199.993896484375
 /begin AXIS_DESCR COM_AXIS NO_INPUT_QUANTITY Compu_TFLEVgd_pct 16 -200 199.993896484375 AXIS_PTS_REF TFLEVgd_pct /end AXIS_DESCR
/end CHARACTERISTIC
/begin AXIS_PTS TFLEVgd_pct " " 0x001C4C78 /* @ECU_Address@TFLEVgd_pct@0x02185000@ */ NO_INPUT_QUANTITY ECIPP_Lookup_SWORD 0 Compu_TFLEVgd_pct 16 -200 199.993896484375 /end AXIS_PTS
/begin COMPU_METHOD Compu_TFLEVgd_DC " " RAT_FUNC "%.1" "Duty-Cycle (%)" COEFFS 0 163.84 0 0 0 1 /end COMPU_METHOD
/begin COMPU_METHOD Compu_CRIPcal_V " " RAT_FUNC "%.2" "volts" COEFFS 0 6553.6 0 0 0 1 /end COMPU_METHOD
/begin CHARACTERISTIC CRIPcal_P "CRI Pressure Sensor Calibration" CURVE 0x001ED004 /* @ECU_Address@CRIPcal_P@0x0227C000@ */ ECIPP_ALIGNMENT_SWORD 4096 Compu_CRIPcal_P -4096 4095.875
 /begin AXIS_DESCR COM_AXIS NO_INPUT_QUANTITY Compu_CRIPcal_V 2 -5 4.99984741210938 AXIS_PTS_REF CRIPcal_V /end AXIS_DESCR
/end CHARACTERISTIC
/begin AXIS_PTS CRIPcal_V " " 0x001ED008 /* @ECU_Address@CRIPcal_V@0x0227B000@ */ NO_INPUT_QUANTITY ECIPP_Lookup_SWORD 0 Compu_CRIPcal_V 2 -5 4.99984741210938 /end AXIS_PTS
/begin COMPU_METHOD Compu_CRIPcal_P " " RAT_FUNC "%.1" "bar" COEFFS 0 8 0 0 0 1 /end COMPU_METHOD
/begin COMPU_METHOD Compu_TCRI_IMVi_rpm " " RAT_FUNC "%.0" "Speed (rpm)" COEFFS 0 1 0 0 0 1 /end COMPU_METHOD
/begin COMPU_METHOD Compu_TCRI_IMVi_Prail " " RAT_FUNC "%.0" "Common-Rail Pressure (bar)" COEFFS 0 8 0 0 0 1 /end COMPU_METHOD
/begin COMPU_METHOD Compu_TCRI_IMVd_icmd " " RAT_FUNC "%.2" "IMV Command (amps)" COEFFS 0 1024 0 0 0 1 /end COMPU_METHOD
/begin CHARACTERISTIC TCRI_IMVd_imag "IMV Dither Amplitude" CURVE 0x001ED036 /* @ECU_Address@TCRI_IMVd_imag@0x02281000@ */ ECIPP_ALIGNMENT_SWORD 32 Compu_TCRI_IMVd_imag -32 31.9990234375
 /begin AXIS_DESCR COM_AXIS NO_INPUT_QUANTITY Compu_TCRI_IMVd_icmd 6 -32 31.9990234375 AXIS_PTS_REF TCRI_IMVd_icmd /end AXIS_DESCR
/end CHARACTERISTIC
/begin AXIS_PTS TCRI_IMVd_icmd " " 0x001ED02A /* @ECU_Address@TCRI_IMVd_icmd@0x02280000@ */ NO_INPUT_QUANTITY ECIPP_Lookup_SWORD 0 Compu_TCRI_IMVd_icmd 6 -32 31.9990234375 /end AXIS_PTS
/begin COMPU_METHOD Compu_TCRI_IMVd_imag " " RAT_FUNC "%.2" "Dither Amplitude (amps)" COEFFS 0 1024 0 0 0 1 /end COMPU_METHOD
/begin COMPU_METHOD Compu_TCRI_IMVd_rpm " " RAT_FUNC "%.0" "Engine Speed (rpm)" COEFFS 0 1 0 0 0 1 /end COMPU_METHOD
/begin CHARACTERISTIC TCRI_IMVd_fHz "IMV Dither Frequency" CURVE 0x001ED01E /* @ECU_Address@TCRI_IMVd_fHz@0x02283000@ */ ECIPP_ALIGNMENT_SWORD 2048 Compu_TCRI_IMVd_fHz -2048 2047.9375
 /begin AXIS_DESCR COM_AXIS NO_INPUT_QUANTITY Compu_TCRI_IMVd_rpm 6 -32768 32767 AXIS_PTS_REF TCRI_IMVd_rpm /end AXIS_DESCR
/end CHARACTERISTIC
/begin AXIS_PTS TCRI_IMVd_rpm " " 0x001ED042 /* @ECU_Address@TCRI_IMVd_rpm@0x02282000@ */ NO_INPUT_QUANTITY ECIPP_Lookup_SWORD 0 Compu_TCRI_IMVd_rpm 6 -32768 32767 /end AXIS_PTS
/begin COMPU_METHOD Compu_TCRI_IMVd_fHz " " RAT_FUNC "%.1" "Dither Freq (Hz)" COEFFS 0 16 0 0 0 1 /end COMPU_METHOD
/begin CHARACTERISTIC Tinj_CAD_CAD_I2 "Injection Timing - Secondary" MAP 0x001C654C /* @ECU_Address@Tinj_CAD_CAD_I2@0x022A4000@ */ ECIPP_ALIGNMENT_SWORD 2048 Compu_Tinj_CAD_CAD_I2 -2048 2047.9375
 /begin AXIS_DESCR COM_AXIS NO_INPUT_QUANTITY Compu_Tinj_CAD_PW_I2 8 -104.8576 104.8544 AXIS_PTS_REF Tinj_CAD_PW_I2 /end AXIS_DESCR
 /begin AXIS_DESCR COM_AXIS NO_INPUT_QUANTITY Compu_Tinj_CAD_rpm_I2 8 -32768 32767 AXIS_PTS_REF Tinj_CAD_rpm_I2 /end AXIS_DESCR
/end CHARACTERISTIC
/begin AXIS_PTS Tinj_CAD_PW_I2 " " 0x001C65DC /* @ECU_Address@Tinj_CAD_PW_I2@0x022A5000@ */ NO_INPUT_QUANTITY ECIPP_Lookup_SWORD 0 Compu_Tinj_CAD_PW_I2 8 -104.8576 104.8544 /end AXIS_PTS
/begin AXIS_PTS Tinj_CAD_rpm_I2 " " 0x001C65FC /* @ECU_Address@Tinj_CAD_rpm_I2@0x022A6000@ */ NO_INPUT_QUANTITY ECIPP_Lookup_SWORD 0 Compu_Tinj_CAD_rpm_I2 8 -32768 32767 /end AXIS_PTS
/begin COMPU_METHOD Compu_Tinj_CAD_CAD_I2 "" RAT_FUNC "%.0" "CAD BBDC Intake" COEFFS 0 16 0 0 0 1 /end COMPU_METHOD
/begin COMPU_METHOD Compu_Tinj_CAD_PW_I2 " " RAT_FUNC "%.1" "PW (ms)" COEFFS 0 312.5 0 0 0 1 /end COMPU_METHOD
/begin COMPU_METHOD Compu_Tinj_CAD_rpm_I2 " " RAT_FUNC "%.0" "Speed (rpm)" COEFFS 0 1 0 0 0 1 /end COMPU_METHOD
/begin COMPU_METHOD Compu_TCRI_QPT_yrpm " " RAT_FUNC "%.0" "Speed (rpm)" COEFFS 0 1 0 0 0 1 /end COMPU_METHOD
/begin AXIS_PTS TCRI_QPT_yrpm " " 0x001ED286 /* @ECU_Address@TCRI_QPT_yrpm@0x022E1000@ */ NO_INPUT_QUANTITY ECIPP_Lookup_SWORD 0 Compu_TCRI_QPT_yrpm 16 -32768 32767 /end AXIS_PTS
/begin CHARACTERISTIC TCRI_IMVff "IMV Feedforward Value / Coefficient" MAP 0x001ECF5C /* @ECU_Address@TCRI_IMVff@0x0233B000@ */ ECIPP_ALIGNMENT_FLOAT32_IEEE 10000000000 Compu_TCRI_IMVff -10000000000 10000000000
 /begin AXIS_DESCR COM_AXIS NO_INPUT_QUANTITY Compu_TCRI_IMVi_Prail 6 -4096 4095.875 AXIS_PTS_REF TCRI_IMVi_Prail /end AXIS_DESCR
 /begin AXIS_DESCR COM_AXIS NO_INPUT_QUANTITY Compu_TCRI_IMVi_rpm 6 -32768 32767 AXIS_PTS_REF TCRI_IMVi_rpm /end AXIS_DESCR
/end CHARACTERISTIC
/begin AXIS_PTS TCRI_IMVi_Prail " " 0x001ED04E /* @ECU_Address@TCRI_IMVi_Prail@0x0227E000@ */ NO_INPUT_QUANTITY ECIPP_Lookup_SWORD 0 Compu_TCRI_IMVi_Prail 6 -4096 4095.875 /end AXIS_PTS
/begin AXIS_PTS TCRI_IMVi_rpm " " 0x001ED05A /* @ECU_Address@TCRI_IMVi_rpm@0x0227D000@ */ NO_INPUT_QUANTITY ECIPP_Lookup_SWORD 0 Compu_TCRI_IMVi_rpm 6 -32768 32767 /end AXIS_PTS
/begin COMPU_METHOD Compu_TCRI_IMVff "" RAT_FUNC "%.2" "Amps or mA/mg or us/mg" COEFFS 0 1 0 0 0 1 /end COMPU_METHOD
/begin COMPU_METHOD Compu_TLdLimFIMP_pct " " RAT_FUNC "%.1" "FIMP (%)" COEFFS 0 327.68 0 0 0 1 /end COMPU_METHOD
/begin CHARACTERISTIC TLdLimFIMP_FIMPpct "FIMP Nonlinear Derate" CURVE 0x001C52B0 /* @ECU_Address@TLdLimFIMP_FIMPpct@0x02530000@ */ ECIPP_ALIGNMENT_SWORD 100 Compu_TLdLimFIMP_FIMPpct -100 99.9969482421875
 /begin AXIS_DESCR COM_AXIS NO_INPUT_QUANTITY Compu_TLdLimFIMP_pct 8 -100 99.9969482421875 AXIS_PTS_REF TLdLimFIMP_pct /end AXIS_DESCR
/end CHARACTERISTIC
/begin AXIS_PTS TLdLimFIMP_pct " " 0x001C52C0 /* @ECU_Address@TLdLimFIMP_pct@0x0252F000@ */ NO_INPUT_QUANTITY ECIPP_Lookup_SWORD 0 Compu_TLdLimFIMP_pct 8 -100 99.9969482421875 /end AXIS_PTS
/begin COMPU_METHOD Compu_TLdLimFIMP_FIMPpct " " RAT_FUNC "%.1" "LL (%)" COEFFS 0 327.68 0 0 0 1 /end COMPU_METHOD
/begin COMPU_METHOD Compu_TLdLimFIP " " RAT_FUNC "%.1" "FIP (psia)" COEFFS 0 16 0 0 0 1 /end COMPU_METHOD
/begin CHARACTERISTIC TLdLimFIP_pct "FIP Nonlinear Derate" CURVE 0x001C52E0 /* @ECU_Address@TLdLimFIP_pct@0x02619000@ */ ECIPP_ALIGNMENT_SWORD 200 Compu_TLdLimFIP_pct -200 199.993896484375
 /begin AXIS_DESCR COM_AXIS NO_INPUT_QUANTITY Compu_TLdLimFIP 8 -2048 2047.9375 AXIS_PTS_REF TLdLimFIP /end AXIS_DESCR
/end CHARACTERISTIC
/begin AXIS_PTS TLdLimFIP " " 0x001C52D0 /* @ECU_Address@TLdLimFIP@0x02618000@ */ NO_INPUT_QUANTITY ECIPP_Lookup_SWORD 0 Compu_TLdLimFIP 8 -2048 2047.9375 /end AXIS_PTS
/begin COMPU_METHOD Compu_TLdLimFIP_pct " " RAT_FUNC "%.1" "LL (%)" COEFFS 0 163.84 0 0 0 1 /end COMPU_METHOD
/begin GROUP EC_Fuel "ECONTROLS" ROOT
 /begin REF_CHARACTERISTIC async_inj_ena tri_fuel_ena FPUMP_wakeup LOCKOFF_wakeup gsln2gas_overlap gas2gsln_overlap V_LPG_off V_NG_off FT_input_cfg fuelrunout_ena fuelrunout_max rev_lim_fuel rev_lim_spk tri_fuel_lockoff gas2gsln_slew GasCarb_trim_mode rev_lim_fuel_drpm FPC_ena FPC_Kp FPC_Ki FPC_Kd FPC_Kiv FPC_dot_window FPC_dot_tau FPCVmin FPCVmax FPCV_CLauth FPC_SD_deltaP FPCcmd_tau FPin_a FPUMP_pin LOCKOFF_pin FT_input_pin LOCKOFF_flowwt V_LPG_off_type LOD_FROmax TRIM_out_chan TRIM_fueltran_mode TRIM_ftran_DCdef MJ_ftran_Pdef FIMP_ena FIMP_type FIMP_init_mode FIMP_pct_init FIMP_MAP_min FIMP_MAP_max FIMP_RPM_min FIMP_RPM_max FIMP_strt_wait FIMP_wndw_wait FIMP_learn_tau FIMP_LL_strt FIMP_LL_stop FTT_ena FTP_ena inj_timing_dz inj_timing_dz_tau rev_lim_spk_drpm FRO_key_mode FRO_shutdown_ena LOCKOFF_keyonwt Ginj_peak_offset FRO_gov_state_freeze FRO_fuelclear_ms LOCKOFF_hold_wait LOCKOFF_hold_DC LOCKOFF2_pin FT_bleedoff_ena FT_bleedoff_dP_cmd FT_bleedoff_Ptarget Ginj_cs_max_pre Ginj_cs_max_post Ginj_cs_ect Ginj_cs_ptime FT_bleedoff_delay TBI_fuel_calc J1939_GFC_ena J1939_GFC_tau1 J1939_GFC_tau2 FIMP_LL_ena FIMP_BTU_pure FIMP_BTU_act FIMP_BTU_imp LOCKOFF3_pin LPG_NG_ovlp NG_LPG_ovlp LPG_NG_lockout FIP_LL_ena LOCKOFF4_pin FPC_FP_source lockoff_keyoff_ena FPin_a_type Tinj_CAD_CAD TFPC_Vnom TVLPGoff_V TFIMPb_FTP TLdLimFIMP_FIMPpct TLdLimFIP_pct /end REF_CHARACTERISTIC
 /begin REF_MEASUREMENT inj_timing m_f_port mdot_f_throttle PW_offset_global FPC_dot FT_gsln_slew_att FPC_Iacc FPCcmd FPCcmd_V FPCcmd_DC V_LPG_off_cur FIMP_percent FIMP_LL_pct FIMP_pct_ss inj1_last_falling inj2_last_falling inj3_last_falling inj4_last_falling inj5_last_falling inj6_last_falling inj7_last_falling inj8_last_falling inj9_last_falling inj10_last_falling fuel_trip_gas active_fuel_device fuel_trip_liquid fuel_total_gas FT_bleedoff_state active_fuel_loc Ginj_cs_active inj_count_prerun inj_count_postrun Ginj_peakd_avg Ginj_peaka_avg FT_bleedoff_fuelType fuel_type_keyoff J1939_GFC_m_hr1 J1939_GFC_m_hr2 J1939_GFC_m_100km1 J1939_GFC_m_100km2 inj11_last_falling inj12_last_falling FPin_a_val /end REF_MEASUREMENT
/end GROUP
/begin GROUP EC_FuelRail "ECONTROLS" ROOT
 /begin REF_CHARACTERISTIC CRI_V_boost CRI_i_peak CRI_i_hold CRI_i_hys CRI_i_recharge CRI_i_HS_short CRI_i_LS_short CRI_peak_time_min CRI_peak_time_max CRI_hold_decay CRI_lift_pump_ena CRI_IMV_ena CRI_IMVp_Kp CRI_IMVp_Ki CRI_IMVp_Kd CRI_Prail_ena CRI_IMV_ohms_nom CRI_IMV_mH CRI_Prail_edot_n CRI_Prail_edot_LP CRI_IMVp_acc_max CRI_IMVp_acc_min CRI_IMV_Vdiode CRI_IMV_ohms_Ki CRI_IMV_ohms_min CRI_IMV_ohms_max CRI_PCV_ena CRI_ontime_min CRI_Prail_targ_LP CRI_Prail_act_LP CRI_Prail_act_ediLP CRI_IMVp_Ddz CRI_IMVp_FSO_Ifrz CRI_ontime_max CRI_Prail_min CRI_offtime_min CRI_i_peak_init CRI_i_PH_offset CRI_IMVi_min CRI_IMVi_max CRI_IMVp_NCvalve CRI_IMV_pulsed IMV_pulse_phase IMV_pulse_spacing IMVpulse_Ipeak IMVpulse_Ireduce IMVpulse_Ihold IMVpulse_Icushion IMVpulse_Treduce IMVpulse_Tpause IMVpulse_Tcushion IMVpulse_Tdecay CRI_IMVpw_min CRI_IMVpw_max CRI_hold_recharge CRI_peakhold_decay CRI_IMVp_baseline CRI_Prail_targdz_LP CRI_Prail_targ_dz CRI_IMVff_mode IMVpulse_Tpeak_max IMVpulse_Ttotal_max CRI_IMV_Iinit CRI_ontime_CADmax IMVpck_PWfixed IMVpck_presync_tau IMVpck_pstsync_ph IMVpck_Pctlhyst_pct CRI_purge CRI_purge_Plower CRI_purge_Pupper CRI_purge_cycwait CRI_Prail_hyst IMV_varcam_mode IMV_varcam_nom IMVpck_CAD_cycmin IMVpck_CADfixed CRI_Pdry_min CRI_Pdry_hyst CRI_Pdry_cycwait CRI_Pdry_runhold CRI_ontime_drymax IMVpulse_Tmx_rpmeq CRI_Pdry_ena CRI_IMVpw_CAD CRI_IMVcad_min CRI_IMVcad_max CRI_grneng CRI_purge_tout CRI_purge_spkpct CRI_IMV_HW_period BIP_enabled BIP_min BIP_max BIP_num_pulses BIP_tau BIP_nom BIP_interval_ms BIP_dIinj_thld CRI_i_peak_init_BIP CRI_i_peak_BIP CRI_i_hold_BIP CRI_cad_post2_BIP CRI_width_post2_BIP CRIPcal_P TCRI_IMVd_imag TCRI_IMVd_fHz TCRI_QPT_yrpm TCRI_IMVff /end REF_CHARACTERISTIC
 /begin REF_MEASUREMENT CRI_Prail_target CRI_Prail_edot CRI_IMVi_cmd CRI_IMVd_imag CRI_IMVd_fHz CRI_IMV_ohms CRI_Prail_targ_raw CRI_Prail_act_raw CRI_Prail_cld CRI1_V_boost_filt CRI2_V_boost_filt CRI_IMVcad_final CRI_IMVpw_cmd CRI_IMV_PID CRI_IMV_Iaccum IMVpulsetest_mode IMVpulsetest_pw CRI_IMVpw_total CRI_IMVff_TLU CRI_IMVp_ff CRI_IMVi_FB CRI_ontime_finalmax IMVpck_taufix CRI_purge_active CRI_IMVi_raw CRI_Prail_min_a CRI_last_rise_time1 CRI_last_rise_time2 CRI_last_rise_time3 CRI_last_rise_time4 CRI_last_rise_time5 CRI_last_rise_time6 CRI_last_rise_time7 CRI_last_rise_time8 CRI_IMVi_halfpeak CRI_grneng_state CRI_grneng_mantrig CRI_purge_tmr CRI_purge_spkdis CRI_LS_PH_off BIP_last_cyl1 BIP_last_cyl2 BIP_last_cyl3 BIP_last_cyl4 BIP_last_cyl5 BIP_last_cyl6 BIP_last_cyl7 BIP_last_cyl8 BIP_cyl1 BIP_cyl2 BIP_cyl3 BIP_cyl4 BIP_cyl5 BIP_cyl6 BIP_cyl7 BIP_cyl8 BIP_CAD_offset_cyl1 BIP_CAD_offset_cyl2 BIP_CAD_offset_cyl3 BIP_CAD_offset_cyl4 BIP_CAD_offset_cyl5 BIP_CAD_offset_cyl6 BIP_CAD_offset_cyl7 BIP_CAD_offset_cyl8 /end REF_MEASUREMENT
/end GROUP
/begin GROUP EC_FuelSecond "ECONTROLS" ROOT
 /begin REF_CHARACTERISTIC FPin_a_I2 async_inj_ena_I2 Ginj_peak_offset_I2 inj_timing_dz_I2 inj_timing_dz_tau_I2 strt_inj_tmng_I2 Ginj_cs_max_pre_I2 Ginj_cs_max_post_I2 Ginj_cs_ect_I2 Ginj_cs_ptime_I2 FPin_a_I2_type Tinj_CAD_CAD_I2 /end REF_CHARACTERISTIC
 /begin REF_MEASUREMENT inj_timing m_f_port mdot_f_throttle PW_offset_global inj1_last_falling inj2_last_falling inj3_last_falling inj4_last_falling inj5_last_falling inj6_last_falling inj7_last_falling inj8_last_falling inj9_last_falling inj10_last_falling active_fuel_device active_fuel_loc Ginj_cs_active inj_count_prerun inj_count_postrun Ginj_peakd_avg Ginj_peaka_avg inj11_last_falling inj12_last_falling FPin_a_I2_val /end REF_MEASUREMENT
/end GROUP
/begin GROUP EC_GaugeDrive "ECONTROLS" ROOT
 /begin REF_CHARACTERISTIC gagedrv_chan gagedrv_per ECTgd_ctl_type ECTgd_Rpu_tau Vsw_gauge_tau ECTgd_Rpu_def OilPgd_ctl_type OilPgd_Rpu_tau OilPgd_Rpu_def OilPgd_chan OilPgd_per V1gd_ctl_type V1gd_Rpu_tau V1gd_Rpu_def V1gd_chan V1gd_per V1gd_input_chan ECTgd_Vexc_reg OilPgd_Vexc_reg V1gd_Vexc_reg ECTgd_Vexc_ratio OilPgd_Vexc_ratio V1gd_Vexc_ratio ECT_gauge_sync OILP_gauge_sync OILP_gauge_dz ECT_gauge_dz ECT_gauge_DHena OILP_gauge_DHena V1gd_gauge_DHena FLEV_ena FLEV_FT_crct FLEV_lo_faults FLEV_lo_chan FLEVgd_chan FLEV_FTstd FLEV_FTP_empty FLEV_FTP_full FLEV_lo_trig FLEV_lo_hyst FLEV_lo_LLpct FLEVgd_per V1gd_AL_ena V1gd_AL_Rlo V1gd_AL_Rhi V1gd_AL_Vlo_def V1gd_AL_Vhi_def V1gd_AL_Vrate V1gd_AL_Rmid V1gd_AL_Vmid V1gd_AL_DChi V1gd_AL_DCmid V1gd_AL_DClo Tgagedrv_DC TECTgd_R TOilPgd_DC TOilPgd_R TV1gd_DC TV1gd_R TFLEVgd_DC /end REF_CHARACTERISTIC
 /begin REF_MEASUREMENT AUX_PD1_raw AUX_PU1_raw gagedrv_DC gagedrv_manual AUX_PU2_raw AUX_PU3_raw AUX_PD2_raw AUX_PD3_raw AUX_PUD1_raw AUX_PUD2_raw AUX_PUD3_raw ECTgd_Rpu ECTgd_Rd ECTgd_Ra ECTgd_V_FB Vsw_gauge ECTgd_Id OilPgd_Rpu OilPgd_Rd OilPgd_Ra OilPgd_V_FB OilPgd_Id OilPgd_DC V1gd_Rpu V1gd_Rd V1gd_Ra V1gd_V_FB V1gd_Id V1gd_DC V1gd_volts ECT_gauge_value OILP_gauge_value ECT_gauge_DHstat OILP_gauge_DHstat V1gd_gauge_DHstat ECTgd_Rdtbl OilPgd_Rdtbl V1gd_Rdtbl V1gd_pctref FLEV_lo_active FLEV_pct FLEVgd_DC V1gd_AL_tmr V1gd_AL_Vlo V1gd_AL_Vhi V1gd_AL_rst /end REF_MEASUREMENT
/end GROUP
/begin GROUP EC_HDService "ECONTROLS" ROOT /begin REF_MEASUREMENT fuel_trip_gas fuel_total_gas /end REF_MEASUREMENT /end GROUP
/begin GROUP EC_Marine "ECONTROLS" ROOT /begin REF_CHARACTERISTIC ECT_gauge_sync OILP_gauge_sync OILP_gauge_dz ECT_gauge_dz /end REF_CHARACTERISTIC /begin REF_MEASUREMENT ECT_gauge_value OILP_gauge_value /end REF_MEASUREMENT /end GROUP
/begin GROUP EC_Megajector "ECONTROLS" ROOT /begin REF_CHARACTERISTIC FT_bleedoff_Ptarget /end REF_CHARACTERISTIC
 /begin REF_MEASUREMENT active_fuel_device FT_bleedoff_state active_fuel_loc FT_bleedoff_fuelType /end REF_MEASUREMENT
/end GROUP
/begin GROUP EC_Outputs "ECONTROLS" ROOT /begin REF_MEASUREMENT AUX_PD1_raw AUX_PU1_raw FLEV_lo_active /end REF_MEASUREMENT /end GROUP
/begin GROUP EC_PhiGsln "ECONTROLS" ROOT /begin REF_MEASUREMENT PW_offset_global /end REF_MEASUREMENT /end GROUP
/begin GROUP EC_RawVolts "ECONTROLS" ROOT
 /begin REF_MEASUREMENT AUX_PD1_raw AUX_PU1_raw AUX_PU2_raw AUX_PU3_raw AUX_PD2_raw AUX_PD3_raw AUX_PUD1_raw AUX_PUD2_raw AUX_PUD3_raw /end REF_MEASUREMENT
/end GROUP
/begin GROUP EC_Service1 "ECONTROLS" ROOT /begin REF_CHARACTERISTIC FT_input_cfg /end REF_CHARACTERISTIC /end GROUP
/begin GROUP EC_Starting "ECONTROLS" ROOT /begin REF_CHARACTERISTIC strt_inj_tmng_I2 /end REF_CHARACTERISTIC /begin REF_MEASUREMENT m_f_port /end REF_MEASUREMENT /end GROUP
/begin GROUP EC_TranCal "ECONTROLS" ROOT /begin REF_MEASUREMENT m_f_port /end REF_MEASUREMENT /end GROUP
/begin GROUP EC_VECal "ECONTROLS" ROOT
 /begin REF_MEASUREMENT m_f_port mdot_f_throttle PW_offset_global active_fuel_device active_fuel_loc /end REF_MEASUREMENT
/end GROUP
/end MODULE
/end PROJECT
