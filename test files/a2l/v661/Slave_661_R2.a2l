/*
Copyright (c) 2000-2022.
All rights reserved.  This is an unpublished work.
*/
ASAP2_VERSION 1 61
/begin PROJECT Econtrols_4G "4G Test"
/begin HEADER "4G A2L Configuration" PROJECT_NO EControls4G /* config for version control */ VERSION "$Revision: 82130 $:" /* config for version control */ /end HEADER
/begin MODULE EControls_4G_SH2A "EControls 4G"
/begin MOD_COMMON "" DEPOSIT ABSOLUTE BYTE_ORDER MSB_FIRST /end MOD_COMMON
/* Define the Record Layouts */
/begin RECORD_LAYOUT ECIPP_ALIGNMENT_UBYTE FNC_VALUES 1 UBYTE COLUMN_DIR DIRECT /end RECORD_LAYOUT
/begin RECORD_LAYOUT ECIPP_ALIGNMENT_UWORD FNC_VALUES 1 UWORD COLUMN_DIR DIRECT /end RECORD_LAYOUT
/begin RECORD_LAYOUT ECIPP_Lookup_UWORD AXIS_PTS_X 1 UWORD INDEX_INCR DIRECT /end RECORD_LAYOUT
/begin RECORD_LAYOUT ECIPP_ALIGNMENT_SWORD FNC_VALUES 1 SWORD COLUMN_DIR DIRECT /end RECORD_LAYOUT
/begin RECORD_LAYOUT ECIPP_Lookup_SWORD AXIS_PTS_X 1 SWORD INDEX_INCR DIRECT /end RECORD_LAYOUT
/begin RECORD_LAYOUT ECIPP_ALIGNMENT_ULONG FNC_VALUES 1 ULONG COLUMN_DIR DIRECT /end RECORD_LAYOUT
/begin RECORD_LAYOUT ECIPP_ALIGNMENT_SLONG FNC_VALUES 1 SLONG COLUMN_DIR DIRECT /end RECORD_LAYOUT
/begin RECORD_LAYOUT ECIPP_ALIGNMENT_FLOAT32_IEEE FNC_VALUES 1 FLOAT32_IEEE COLUMN_DIR DIRECT /end RECORD_LAYOUT
/begin RECORD_LAYOUT ECIPP_Lookup_FLOAT32_IEEE AXIS_PTS_X 1 FLOAT32_IEEE INDEX_INCR DIRECT /end RECORD_LAYOUT
/begin MEASUREMENT MAPdt "MAPdt" SWORD Compu_MAPdt 0 0 -4000 3999.8779296875 ECU_ADDRESS 0x010000E0 /end MEASUREMENT
/begin COMPU_METHOD Compu_MAPdt " " RAT_FUNC "%.1" "psi/sec" COEFFS 0 8.192 0 0 0 1 /end COMPU_METHOD
/begin MEASUREMENT Manual_BM "Manual_BM" SWORD Compu_Manual_BM 0 0 -100 99.9969482421875 ECU_ADDRESS 0x01000208 /end MEASUREMENT
/begin COMPU_METHOD Compu_Manual_BM " " RAT_FUNC "%.1" "%" COEFFS 0 327.68 0 0 0 1 /end COMPU_METHOD
/begin MEASUREMENT BM1_crct "Total fuel correction 1" UWORD Compu_BM1_crct 0 0 0 1.99996948242188 ECU_ADDRESS 0x01000210 /end MEASUREMENT
/begin COMPU_METHOD Compu_BM1_crct " " RAT_FUNC "%.3" "multiplier" COEFFS 0 32768 0 0 0 1 /end COMPU_METHOD
/begin MEASUREMENT CL1_perturb "CL perturbation 1" SWORD Compu_CL1_perturb 0 0 -100 99.9969482421875 ECU_ADDRESS 0x01000218 /end MEASUREMENT
/begin COMPU_METHOD Compu_CL1_perturb " " RAT_FUNC "%.1" "%" COEFFS 0 327.68 0 0 0 1 /end COMPU_METHOD
/begin MEASUREMENT CLInactiveFlag "CL Inactive Indication{CLInactiveFlag&4=4:Manual force inactive}{CLInactiveFlag&1=1:CL Ena Map = 0}{CLInactiveFlag&2=2:Phi command out-of range}{CLInactiveFlag&0=0:NONE}" UBYTE CLInactiveFlag_COMPU_VTAB 0 0 0 255 ECU_ADDRESS 0x01000220 BIT_MASK 4 /end MEASUREMENT
/begin COMPU_METHOD CLInactiveFlag_COMPU_VTAB "Verbal Table" TAB_VERB "%.0" "flag" COMPU_TAB_REF CLInactiveFlag_COMPU_VTAB_REF /end COMPU_METHOD
/begin COMPU_VTAB CLInactiveFlag_COMPU_VTAB_REF "Verbal Table" TAB_VERB 1 4 "Manual force inactive" DEFAULT_VALUE "Unsupported Bit_Mask" /end COMPU_VTAB
/begin MEASUREMENT CB1pre_DCa "Pre-cat EGO DC actual" UWORD Compu_CB1pre_DCa 0 0 0 199.996948242188 ECU_ADDRESS 0x01000228 /end MEASUREMENT
/begin COMPU_METHOD Compu_CB1pre_DCa " " RAT_FUNC "%.1" "%" COEFFS 0 327.68 0 0 0 1 /end COMPU_METHOD
/begin MEASUREMENT CB1pre_DCd "Pre-cat EGO DC desired" UWORD Compu_CB1pre_DCd 0 0 0 199.996948242188 ECU_ADDRESS 0x01000230 /end MEASUREMENT
/begin COMPU_METHOD Compu_CB1pre_DCd " " RAT_FUNC "%.1" "%" COEFFS 0 327.68 0 0 0 1 /end COMPU_METHOD
/begin MEASUREMENT CLp_E "CL1_E" UWORD Compu_CLp_E 0 0 0 199.996948242188 ECU_ADDRESS 0x01000238 /end MEASUREMENT
/begin COMPU_METHOD Compu_CLp_E " " RAT_FUNC "%.1" "%" COEFFS 0 327.68 0 0 0 1 /end COMPU_METHOD
/begin MEASUREMENT mdot_a_trans "mdot throttle air transient" SWORD Compu_mdot_a_trans 0 0 -512 511.984375 ECU_ADDRESS 0x01000250 /end MEASUREMENT
/begin COMPU_METHOD Compu_mdot_a_trans " " RAT_FUNC "%.1" "g/sec" COEFFS 0 64 0 0 0 1 /end COMPU_METHOD
/begin MEASUREMENT mdot_a_trans_pct "mdot throttle air transient relative" SWORD Compu_mdot_a_trans_pct 0 0 -800 799.9755859375 ECU_ADDRESS 0x01000258 /end MEASUREMENT
/begin COMPU_METHOD Compu_mdot_a_trans_pct " " RAT_FUNC "%.1" "%" COEFFS 0 40.96 0 0 0 1 /end COMPU_METHOD
/begin MEASUREMENT TRIM_DC "TRIM duty-cycle" UWORD Compu_TRIM_DC 0 0 0 99.9984741210938 ECU_ADDRESS 0x010002B0 /end MEASUREMENT
/begin COMPU_METHOD Compu_TRIM_DC " " RAT_FUNC "%.1" "%" COEFFS 0 655.36 0 0 0 1 /end COMPU_METHOD
/begin MEASUREMENT CL_temp_wait_tmr "CL temporary disable timer" UWORD Compu_CL_temp_wait_tmr 0 0 0 65535 ECU_ADDRESS 0x010002F0 /end MEASUREMENT
/begin COMPU_METHOD Compu_CL_temp_wait_tmr " " RAT_FUNC "%.0" "ms" COEFFS 0 1 0 0 0 1 /end COMPU_METHOD
/begin MEASUREMENT BM2_crct "Total fuel correction 2" UWORD Compu_BM2_crct 0 0 0 1.99996948242188 ECU_ADDRESS 0x01000338 /end MEASUREMENT
/begin COMPU_METHOD Compu_BM2_crct " " RAT_FUNC "%.3" "multiplier" COEFFS 0 32768 0 0 0 1 /end COMPU_METHOD
/begin MEASUREMENT CL2_perturb "CL perturbation 2" SWORD Compu_CL2_perturb 0 0 -100 99.9969482421875 ECU_ADDRESS 0x01000358 /end MEASUREMENT
/begin COMPU_METHOD Compu_CL2_perturb " " RAT_FUNC "%.1" "%" COEFFS 0 327.68 0 0 0 1 /end COMPU_METHOD
/begin MEASUREMENT CB2pre_DCa "Pre-cat EGO DC actual" UWORD Compu_CB2pre_DCa 0 0 0 199.996948242188 ECU_ADDRESS 0x01000360 /end MEASUREMENT
/begin COMPU_METHOD Compu_CB2pre_DCa " " RAT_FUNC "%.1" "%" COEFFS 0 327.68 0 0 0 1 /end COMPU_METHOD
/begin MEASUREMENT Phi_UEGO "UEGO phi" UWORD Compu_Phi_UEGO 0 0 0 3.99993896484375 ECU_ADDRESS 0x01000398 /end MEASUREMENT
/begin COMPU_METHOD Compu_Phi_UEGO " " RAT_FUNC "%.3" "phi" COEFFS 0 16384 0 0 0 1 /end COMPU_METHOD
/begin MEASUREMENT FPin "Fuel rail pressure" UWORD Compu_FPin 0 0 0 255.99609375 ECU_ADDRESS 0x01000420 /end MEASUREMENT
/begin COMPU_METHOD Compu_FPin " " RAT_FUNC "%.1" "psia" COEFFS 0 256 0 0 0 1 /end COMPU_METHOD
/begin MEASUREMENT MJ_P_act "EPR feedback press" SWORD Compu_MJ_P_act 0 0 -222 221.993225097656 ECU_ADDRESS 0x01000430 /end MEASUREMENT
/begin COMPU_METHOD Compu_MJ_P_act " " RAT_FUNC "%.2" "in H2O" COEFFS 0 147.603603603604 0 0 0 1 /end COMPU_METHOD
/begin MEASUREMENT MJ_P_cmd "EPR press command" SWORD Compu_MJ_P_cmd 0 0 -222 221.993225097656 ECU_ADDRESS 0x01000438 /end MEASUREMENT
/begin COMPU_METHOD Compu_MJ_P_cmd " " RAT_FUNC "%.2" "in H2O" COEFFS 0 147.603603603604 0 0 0 1 /end COMPU_METHOD
/begin MEASUREMENT MJ_A_act "Legacy EPR duty-cycle feedback" SWORD Compu_MJ_A_act 0 0 -100 99.9969482421875 ECU_ADDRESS 0x01000440 /end MEASUREMENT
/begin COMPU_METHOD Compu_MJ_A_act " " RAT_FUNC "%.3" "%" COEFFS 0 327.68 0 0 0 1 /end COMPU_METHOD
/begin MEASUREMENT MJ_A_cmd "EPR duty-cycle/pulse command" UWORD Compu_MJ_A_cmd 0 0 0 65535 ECU_ADDRESS 0x01000448 /end MEASUREMENT
/begin COMPU_METHOD Compu_MJ_A_cmd " " RAT_FUNC "%.3" "integer" COEFFS 0 1 0 0 0 1 /end COMPU_METHOD
/begin CHARACTERISTIC CLp_Emin "CLp_Emin" VALUE 0x001C348A /* @ECU_Address@CLp_Emin@0x01000928@ */ ECIPP_ALIGNMENT_UWORD 200 Compu_CLp_Emin 0 199.996948242188 /end CHARACTERISTIC
/begin COMPU_METHOD Compu_CLp_Emin " " RAT_FUNC "%.1" "%" COEFFS 0 327.68 0 0 0 1 /end COMPU_METHOD
/begin CHARACTERISTIC CLp_Emax "CLp_Emax" VALUE 0x001C3488 /* @ECU_Address@CLp_Emax@0x01000930@ */ ECIPP_ALIGNMENT_UWORD 200 Compu_CLp_Emax 0 199.996948242188 /end CHARACTERISTIC
/begin COMPU_METHOD Compu_CLp_Emax " " RAT_FUNC "%.1" "%" COEFFS 0 327.68 0 0 0 1 /end COMPU_METHOD
/begin CHARACTERISTIC CLp_Rp_def "CLp_Rp" VALUE 0x001C348C /* @ECU_Address@CLp_Rp_def@0x01000938@ */ ECIPP_ALIGNMENT_UWORD 100 Compu_CLp_Rp_def 0 99.9984741210938 /end CHARACTERISTIC
/begin COMPU_METHOD Compu_CLp_Rp_def " " RAT_FUNC "%.1" "%" COEFFS 0 655.36 0 0 0 1 /end COMPU_METHOD
/begin CHARACTERISTIC CLp_Rn_def "CLp_Rn" VALUE 0x001C348E /* @ECU_Address@CLp_Rn_def@0x01000940@ */ ECIPP_ALIGNMENT_UWORD 100 Compu_CLp_Rn_def 0 99.9984741210938 /end CHARACTERISTIC
/begin COMPU_METHOD Compu_CLp_Rn_def " " RAT_FUNC "%.1" "%" COEFFS 0 655.36 0 0 0 1 /end COMPU_METHOD
/begin MEASUREMENT CLp_tau "CLp_tau" UWORD Compu_CLp_tau 0 0 0 65535 ECU_ADDRESS 0x01000948 /end MEASUREMENT
/begin COMPU_METHOD Compu_CLp_tau " " RAT_FUNC "%.0" "ms" COEFFS 0 1 0 0 0 1 /end COMPU_METHOD
/begin CHARACTERISTIC CLp_rich_DC "CLp_rich_DC" VALUE 0x001c6e32 /* @ECU_Address@CLp_rich_DC@0x01000950@ */ ECIPP_ALIGNMENT_UWORD 200 Compu_CLp_rich_DC 0 199.996948242188 /end CHARACTERISTIC
/begin COMPU_METHOD Compu_CLp_rich_DC " " RAT_FUNC "%.1" "%" COEFFS 0 327.68 0 0 0 1 /end COMPU_METHOD
/begin CHARACTERISTIC CLp_lean_DC "CLp_lean_DC" VALUE 0x001c6e30 /* @ECU_Address@CLp_lean_DC@0x01000958@ */ ECIPP_ALIGNMENT_UWORD 200 Compu_CLp_lean_DC 0 199.996948242188 /end CHARACTERISTIC
/begin COMPU_METHOD Compu_CLp_lean_DC " " RAT_FUNC "%.1" "%" COEFFS 0 327.68 0 0 0 1 /end COMPU_METHOD
/begin MEASUREMENT CLp_Hp "CL1_Hp" UWORD Compu_CLp_Hp 0 0 0 99.9984741210938 ECU_ADDRESS 0x01000960 /end MEASUREMENT
/begin COMPU_METHOD Compu_CLp_Hp " " RAT_FUNC "%.1" "%" COEFFS 0 655.36 0 0 0 1 /end COMPU_METHOD
/begin MEASUREMENT CLp_Hn "CL1_Hn" UWORD Compu_CLp_Hn 0 0 0 99.9984741210938 ECU_ADDRESS 0x01000968 /end MEASUREMENT
/begin COMPU_METHOD Compu_CLp_Hn " " RAT_FUNC "%.1" "%" COEFFS 0 655.36 0 0 0 1 /end COMPU_METHOD
/begin MEASUREMENT CL_ena_value "CL_ena_value" UWORD Compu_CL_ena_value 0 0 0 255.99609375 ECU_ADDRESS 0x01000970 /end MEASUREMENT
/begin COMPU_METHOD Compu_CL_ena_value " " RAT_FUNC "%.2" "logical" COEFFS 0 256 0 0 0 1 /end COMPU_METHOD
/begin CHARACTERISTIC TRIM_trig_chg "Trim disable air transient trigger" VALUE 0x001c58de /* @ECU_Address@TRIM_trig_chg@0x01000998@ */ ECIPP_ALIGNMENT_SWORD 800 Compu_TRIM_trig_chg -800 799.9755859375 /end CHARACTERISTIC
/begin COMPU_METHOD Compu_TRIM_trig_chg " " RAT_FUNC "%.1" "%" COEFFS 0 40.96 0 0 0 1 /end COMPU_METHOD
/begin CHARACTERISTIC TRIM_period_def "TRIM period" VALUE 0x001c81d0 /* @ECU_Address@TRIM_period_def@0x01000A30@ */ ECIPP_ALIGNMENT_UWORD 210 Compu_TRIM_period_def 0 209.712 /end CHARACTERISTIC
/begin COMPU_METHOD Compu_TRIM_period_def " " RAT_FUNC "%.1" "ms" COEFFS 0 312.5 0 0 0 1 /end COMPU_METHOD
/begin CHARACTERISTIC MAPdt_CLoff "CL disable MAPdt" VALUE 0x001c4550 /* @ECU_Address@MAPdt_CLoff@0x01000AB8@ */ ECIPP_ALIGNMENT_SWORD 4000 Compu_MAPdt_CLoff -4000 3999.8779296875 /end CHARACTERISTIC
/begin COMPU_METHOD Compu_MAPdt_CLoff " " RAT_FUNC "%.1" "psi/sec" COEFFS 0 8.192 0 0 0 1 /end COMPU_METHOD
/begin CHARACTERISTIC K_adapt "K adaptive learn" VALUE 0x001C3494 /* @ECU_Address@K_adapt@0x01000B20@ */ ECIPP_ALIGNMENT_SWORD 100 Compu_K_adapt -100 99.9969482421875 /end CHARACTERISTIC
/begin COMPU_METHOD Compu_K_adapt " " RAT_FUNC "%.1" "%" COEFFS 0 327.68 0 0 0 1 /end COMPU_METHOD
/begin CHARACTERISTIC Adapt_pos_lim "Adapt max (Fault Condition:AL_BM >)" VALUE 0x001C3490 /* @ECU_Address@Adapt_pos_lim@0x01000B28@ */ ECIPP_ALIGNMENT_SWORD 100 Compu_Adapt_pos_lim -100 99.9969482421875 /end CHARACTERISTIC
/begin COMPU_METHOD Compu_Adapt_pos_lim " " RAT_FUNC "%.1" "%" COEFFS 0 327.68 0 0 0 1 /end COMPU_METHOD
/begin CHARACTERISTIC Adapt_neg_lim "Adapt min (Fault Condition:AL_BM <)" VALUE 0x001C3492 /* @ECU_Address@Adapt_neg_lim@0x01000B30@ */ ECIPP_ALIGNMENT_SWORD 100 Compu_Adapt_neg_lim -100 99.9969482421875 /end CHARACTERISTIC
/begin COMPU_METHOD Compu_Adapt_neg_lim " " RAT_FUNC "%.1" "%" COEFFS 0 327.68 0 0 0 1 /end COMPU_METHOD
/begin CHARACTERISTIC Adapt_stepmax "Adapt stepmax" VALUE 0x001C3496 /* @ECU_Address@Adapt_stepmax@0x01000B38@ */ ECIPP_ALIGNMENT_UWORD 200 Compu_Adapt_stepmax 0 199.996948242188 /end CHARACTERISTIC
/begin COMPU_METHOD Compu_Adapt_stepmax " " RAT_FUNC "%.1" "%" COEFFS 0 327.68 0 0 0 1 /end COMPU_METHOD
/begin CHARACTERISTIC Adapt_dzone "Adapt deadzone" VALUE 0x001C3498 /* @ECU_Address@Adapt_dzone@0x01000B40@ */ ECIPP_ALIGNMENT_UWORD 200 Compu_Adapt_dzone 0 199.996948242188 /end CHARACTERISTIC
/begin COMPU_METHOD Compu_Adapt_dzone " " RAT_FUNC "%.1" "%" COEFFS 0 327.68 0 0 0 1 /end COMPU_METHOD
/begin CHARACTERISTIC Adapt_valid "Adaptive update validation error" VALUE 0x001C349A /* @ECU_Address@Adapt_valid@0x01000B48@ */ ECIPP_ALIGNMENT_SWORD 100 Compu_Adapt_valid -100 99.9969482421875 /end CHARACTERISTIC
/begin COMPU_METHOD Compu_Adapt_valid " " RAT_FUNC "%.1" "%" COEFFS 0 327.68 0 0 0 1 /end COMPU_METHOD
/begin CHARACTERISTIC Adapt_wait "Valid adaptive cycles min" VALUE 0x001C349C /* @ECU_Address@Adapt_wait@0x01000B50@ */ ECIPP_ALIGNMENT_UBYTE 255 Compu_Adapt_wait 0 255 /end CHARACTERISTIC
/begin COMPU_METHOD Compu_Adapt_wait " " RAT_FUNC "%.0" "count" COEFFS 0 1 0 0 0 1 /end COMPU_METHOD
/begin CHARACTERISTIC K_CL_acquire "K_CL_acquire" VALUE 0x001C3484 /* @ECU_Address@K_CL_acquire@0x01000B58@ */ ECIPP_ALIGNMENT_SWORD 100 Compu_K_CL_acquire -100 99.9969482421875 /end CHARACTERISTIC
/begin COMPU_METHOD Compu_K_CL_acquire " " RAT_FUNC "%.1" "%" COEFFS 0 327.68 0 0 0 1 /end COMPU_METHOD
/begin CHARACTERISTIC K_CL "K_CL_switching" VALUE 0x001C3482 /* @ECU_Address@K_CL@0x01000B60@ */ ECIPP_ALIGNMENT_SWORD 100 Compu_K_CL -100 99.9969482421875 /end CHARACTERISTIC
/begin COMPU_METHOD Compu_K_CL " " RAT_FUNC "%.1" "%" COEFFS 0 327.68 0 0 0 1 /end COMPU_METHOD
/begin CHARACTERISTIC CL_BM_max "CL max (Fault Condition:CL_BM >)" VALUE 0x001C347E /* @ECU_Address@CL_BM_max@0x01000B68@ */ ECIPP_ALIGNMENT_SWORD 100 Compu_CL_BM_max -100 99.9969482421875 /end CHARACTERISTIC
/begin COMPU_METHOD Compu_CL_BM_max " " RAT_FUNC "%.1" "%" COEFFS 0 327.68 0 0 0 1 /end COMPU_METHOD
/begin CHARACTERISTIC CL_BM_min "CL min (Fault Condition:CL_BM <)" VALUE 0x001C3480 /* @ECU_Address@CL_BM_min@0x01000B70@ */ ECIPP_ALIGNMENT_SWORD 100 Compu_CL_BM_min -100 99.9969482421875 /end CHARACTERISTIC
/begin COMPU_METHOD Compu_CL_BM_min " " RAT_FUNC "%.1" "%" COEFFS 0 327.68 0 0 0 1 /end COMPU_METHOD
/begin CHARACTERISTIC CL_stepmax "CL_stepmax" VALUE 0x001C3486 /* @ECU_Address@CL_stepmax@0x01000B78@ */ ECIPP_ALIGNMENT_SWORD 100 Compu_CL_stepmax -100 99.9969482421875 /end CHARACTERISTIC
/begin COMPU_METHOD Compu_CL_stepmax " " RAT_FUNC "%.1" "%" COEFFS 0 327.68 0 0 0 1 /end COMPU_METHOD
/begin MEASUREMENT AL_temp_wait_tmr "AL_temp_wait_tmr" UWORD Compu_AL_temp_wait_tmr 0 0 0 65535 ECU_ADDRESS 0x01000B88 /end MEASUREMENT
/begin COMPU_METHOD Compu_AL_temp_wait_tmr " " RAT_FUNC "%.0" "ms" COEFFS 0 1 0 0 0 1 /end COMPU_METHOD
/begin MEASUREMENT Adapt1_valid_cnt "Adapt1 valid count" UBYTE Compu_Adapt1_valid_cnt 0 0 0 255 ECU_ADDRESS 0x01000B90 /end MEASUREMENT
/begin COMPU_METHOD Compu_Adapt1_valid_cnt " " RAT_FUNC "%.0" "count" COEFFS 0 1 0 0 0 1 /end COMPU_METHOD
/begin MEASUREMENT TRIM_mode "TRIM mode{TRIM_mode&0xff=0x00:Auto}{TRIM_mode&0xff=0x01:Manual}" UBYTE TRIM_mode_COMPU_VTAB 0 0 0 255 ECU_ADDRESS 0x01000BB0 BIT_MASK 0xff /end MEASUREMENT
/begin COMPU_METHOD TRIM_mode_COMPU_VTAB "Verbal Table" TAB_VERB "%.0" "list" COMPU_TAB_REF TRIM_mode_COMPU_VTAB_REF /end COMPU_METHOD
/begin COMPU_VTAB TRIM_mode_COMPU_VTAB_REF "Verbal Table" TAB_VERB 2 0x00 "Auto" 0x01 "Manual" DEFAULT_VALUE "UNKNOWN" /end COMPU_VTAB
/begin MEASUREMENT CL_inact_force "Force CL inactive{CL_inact_force&0xff=0x00:Normal}{CL_inact_force&0xff=0x01:Force CL Inactive}" UBYTE CL_inact_force_COMPU_VTAB 0 0 0 255 ECU_ADDRESS 0x01000F10 BIT_MASK 0xff /end MEASUREMENT
/begin COMPU_METHOD CL_inact_force_COMPU_VTAB "Verbal Table" TAB_VERB "%.0" "list" COMPU_TAB_REF CL_inact_force_COMPU_VTAB_REF /end COMPU_METHOD
/begin COMPU_VTAB CL_inact_force_COMPU_VTAB_REF "Verbal Table" TAB_VERB 2 0x00 "Normal" 0x01 "Force CL Inactive" DEFAULT_VALUE "UNKNOWN" /end COMPU_VTAB
/begin CHARACTERISTIC TRIM_dis_hold "Trim disable hold time" VALUE 0x001c81cc /* @ECU_Address@TRIM_dis_hold@0x01000F18@ */ ECIPP_ALIGNMENT_UWORD 65535 Compu_TRIM_dis_hold 0 65535 /end CHARACTERISTIC
/begin COMPU_METHOD Compu_TRIM_dis_hold " " RAT_FUNC "%.0" "ms" COEFFS 0 1 0 0 0 1 /end COMPU_METHOD
/begin CHARACTERISTIC mda_trans_tau "mdot throttle air transient tau" VALUE 0x001c865e /* @ECU_Address@mda_trans_tau@0x01000F28@ */ ECIPP_ALIGNMENT_UWORD 327680 Compu_mda_trans_tau 0.45084 327680 /end CHARACTERISTIC
/begin COMPU_METHOD Compu_mda_trans_tau " " FORM "%.0" "ms"
 /begin FORMULA "-5 / log(1 - (X1 / 65536))" FORMULA_INV "(1 - exp(-5/X1)) * 65536" /end FORMULA
/end COMPU_METHOD
/begin CHARACTERISTIC TRIM_trans_dis "TRIM transient compensation{TRIM_trans_dis&0xff=0x00:Enabled}{TRIM_trans_dis&0xff=0x01:Disabled}" VALUE 0x001c8f52 /* @ECU_Address@TRIM_trans_dis@0x01000F70@ */ ECIPP_ALIGNMENT_UBYTE 255 TRIM_trans_dis_COMPU_VTAB 0 255 BIT_MASK 0xff /end CHARACTERISTIC
/begin COMPU_METHOD TRIM_trans_dis_COMPU_VTAB "Verbal Table" TAB_VERB "%.0" "list" COMPU_TAB_REF TRIM_trans_dis_COMPU_VTAB_REF /end COMPU_METHOD
/begin COMPU_VTAB TRIM_trans_dis_COMPU_VTAB_REF "Verbal Table" TAB_VERB 2 0x00 "Enabled" 0x01 "Disabled" DEFAULT_VALUE "UNKNOWN" /end COMPU_VTAB
/begin CHARACTERISTIC trim_nom_crkP "Trim valve cranking nominal" VALUE 0x001c19a8 /* @ECU_Address@trim_nom_crkP@0x01000FB0@ */ ECIPP_ALIGNMENT_SWORD 200 Compu_trim_nom_crkP -200 199.993896484375 /end CHARACTERISTIC
/begin COMPU_METHOD Compu_trim_nom_crkP " " RAT_FUNC "%.1" "%" COEFFS 0 163.84 0 0 0 1 /end COMPU_METHOD
/begin CHARACTERISTIC trim_nom_crkN "Trim valve cranking nominal" VALUE 0x001c2912 /* @ECU_Address@trim_nom_crkN@0x01000FB8@ */ ECIPP_ALIGNMENT_SWORD 200 Compu_trim_nom_crkN -200 199.993896484375 /end CHARACTERISTIC
/begin COMPU_METHOD Compu_trim_nom_crkN " " RAT_FUNC "%.1" "%" COEFFS 0 163.84 0 0 0 1 /end COMPU_METHOD
/begin MEASUREMENT Adapt2_valid_cnt "Adapt2 valid count" UBYTE Compu_Adapt2_valid_cnt 0 0 0 255 ECU_ADDRESS 0x01000FC0 /end MEASUREMENT
/begin COMPU_METHOD Compu_Adapt2_valid_cnt " " RAT_FUNC "%.0" "count" COEFFS 0 1 0 0 0 1 /end COMPU_METHOD
/begin CHARACTERISTIC CLLP_hi "CL max (Fault Condition:CL_BM >)" VALUE 0x001C19C2 /* @ECU_Address@CLLP_hi@0x01000FC8@ */ ECIPP_ALIGNMENT_SWORD 100 Compu_CLLP_hi -100 99.9969482421875 /end CHARACTERISTIC
/begin COMPU_METHOD Compu_CLLP_hi " " RAT_FUNC "%.1" "%" COEFFS 0 327.68 0 0 0 1 /end COMPU_METHOD
/begin CHARACTERISTIC CLLP_lo "CL min (Fault Condition:CL_BM <)" VALUE 0x001C19C4 /* @ECU_Address@CLLP_lo@0x01000FD0@ */ ECIPP_ALIGNMENT_SWORD 100 Compu_CLLP_lo -100 99.9969482421875 /end CHARACTERISTIC
/begin COMPU_METHOD Compu_CLLP_lo " " RAT_FUNC "%.1" "%" COEFFS 0 327.68 0 0 0 1 /end COMPU_METHOD
/begin CHARACTERISTIC CLLP_K "K_CL_switching" VALUE 0x001C19C6 /* @ECU_Address@CLLP_K@0x01000FD8@ */ ECIPP_ALIGNMENT_SWORD 100 Compu_CLLP_K -100 99.9969482421875 /end CHARACTERISTIC
/begin COMPU_METHOD Compu_CLLP_K " " RAT_FUNC "%.1" "%" COEFFS 0 327.68 0 0 0 1 /end COMPU_METHOD
/begin CHARACTERISTIC CLLP_K_acquire "K_CL_acquire" VALUE 0x001C19C8 /* @ECU_Address@CLLP_K_acquire@0x01000FE0@ */ ECIPP_ALIGNMENT_SWORD 100 Compu_CLLP_K_acquire -100 99.9969482421875 /end CHARACTERISTIC
/begin COMPU_METHOD Compu_CLLP_K_acquire " " RAT_FUNC "%.1" "%" COEFFS 0 327.68 0 0 0 1 /end COMPU_METHOD
/begin CHARACTERISTIC CLLP_stepmax "CL_stepmax" VALUE 0x001C19CA /* @ECU_Address@CLLP_stepmax@0x01000FE8@ */ ECIPP_ALIGNMENT_SWORD 100 Compu_CLLP_stepmax -100 99.9969482421875 /end CHARACTERISTIC
/begin COMPU_METHOD Compu_CLLP_stepmax " " RAT_FUNC "%.1" "%" COEFFS 0 327.68 0 0 0 1 /end COMPU_METHOD
/begin CHARACTERISTIC CLpLP_Emax "CLp_Emax" VALUE 0x001C19CC /* @ECU_Address@CLpLP_Emax@0x01000FF0@ */ ECIPP_ALIGNMENT_UWORD 200 Compu_CLpLP_Emax 0 199.996948242188 /end CHARACTERISTIC
/begin COMPU_METHOD Compu_CLpLP_Emax " " RAT_FUNC "%.1" "%" COEFFS 0 327.68 0 0 0 1 /end COMPU_METHOD
/begin CHARACTERISTIC CLpLP_Emin "CLp_Emin" VALUE 0x001C19CE /* @ECU_Address@CLpLP_Emin@0x01000FF8@ */ ECIPP_ALIGNMENT_UWORD 200 Compu_CLpLP_Emin 0 199.996948242188 /end CHARACTERISTIC
/begin COMPU_METHOD Compu_CLpLP_Emin " " RAT_FUNC "%.1" "%" COEFFS 0 327.68 0 0 0 1 /end COMPU_METHOD
/begin CHARACTERISTIC CLpLP_Rp_def "CLp_Rp" VALUE 0x001C19D0 /* @ECU_Address@CLpLP_Rp_def@0x01001000@ */ ECIPP_ALIGNMENT_UWORD 100 Compu_CLpLP_Rp_def 0 99.9984741210938 /end CHARACTERISTIC
/begin COMPU_METHOD Compu_CLpLP_Rp_def " " RAT_FUNC "%.1" "%" COEFFS 0 655.36 0 0 0 1 /end COMPU_METHOD
/begin CHARACTERISTIC CLpLP_Rn_def "CLp_Rn" VALUE 0x001C19D2 /* @ECU_Address@CLpLP_Rn_def@0x01001008@ */ ECIPP_ALIGNMENT_UWORD 100 Compu_CLpLP_Rn_def 0 99.9984741210938 /end CHARACTERISTIC
/begin COMPU_METHOD Compu_CLpLP_Rn_def " " RAT_FUNC "%.1" "%" COEFFS 0 655.36 0 0 0 1 /end COMPU_METHOD
/begin CHARACTERISTIC ALLP_hi "Adapt max (Fault Condition:AL_BM >)" VALUE 0x001C19D4 /* @ECU_Address@ALLP_hi@0x01001010@ */ ECIPP_ALIGNMENT_SWORD 100 Compu_ALLP_hi -100 99.9969482421875 /end CHARACTERISTIC
/begin COMPU_METHOD Compu_ALLP_hi " " RAT_FUNC "%.1" "%" COEFFS 0 327.68 0 0 0 1 /end COMPU_METHOD
/begin CHARACTERISTIC ALLP_lo "Adapt min (Fault Condition:AL_BM <)" VALUE 0x001C19D6 /* @ECU_Address@ALLP_lo@0x01001018@ */ ECIPP_ALIGNMENT_SWORD 100 Compu_ALLP_lo -100 99.9969482421875 /end CHARACTERISTIC
/begin COMPU_METHOD Compu_ALLP_lo " " RAT_FUNC "%.1" "%" COEFFS 0 327.68 0 0 0 1 /end COMPU_METHOD
/begin CHARACTERISTIC ALLP_K "K adaptive learn" VALUE 0x001C19D8 /* @ECU_Address@ALLP_K@0x01001020@ */ ECIPP_ALIGNMENT_SWORD 100 Compu_ALLP_K -100 99.9969482421875 /end CHARACTERISTIC
/begin COMPU_METHOD Compu_ALLP_K " " RAT_FUNC "%.1" "%" COEFFS 0 327.68 0 0 0 1 /end COMPU_METHOD
/begin CHARACTERISTIC ALLP_stepmax "Adapt stepmax" VALUE 0x001C19DA /* @ECU_Address@ALLP_stepmax@0x01001028@ */ ECIPP_ALIGNMENT_UWORD 200 Compu_ALLP_stepmax 0 199.996948242188 /end CHARACTERISTIC
/begin COMPU_METHOD Compu_ALLP_stepmax " " RAT_FUNC "%.1" "%" COEFFS 0 327.68 0 0 0 1 /end COMPU_METHOD
/begin CHARACTERISTIC ALLP_dzone "Adapt deadzone" VALUE 0x001C19DC /* @ECU_Address@ALLP_dzone@0x01001030@ */ ECIPP_ALIGNMENT_UWORD 200 Compu_ALLP_dzone 0 199.996948242188 /end CHARACTERISTIC
/begin COMPU_METHOD Compu_ALLP_dzone " " RAT_FUNC "%.1" "%" COEFFS 0 327.68 0 0 0 1 /end COMPU_METHOD
/begin CHARACTERISTIC ALLP_valid "Adaptive update validation error" VALUE 0x001C19DE /* @ECU_Address@ALLP_valid@0x01001038@ */ ECIPP_ALIGNMENT_SWORD 100 Compu_ALLP_valid -100 99.9969482421875 /end CHARACTERISTIC
/begin COMPU_METHOD Compu_ALLP_valid " " RAT_FUNC "%.1" "%" COEFFS 0 327.68 0 0 0 1 /end COMPU_METHOD
/begin CHARACTERISTIC ALLP_wait "Valid adaptive cycles min" VALUE 0x001C19E0 /* @ECU_Address@ALLP_wait@0x01001040@ */ ECIPP_ALIGNMENT_UBYTE 255 Compu_ALLP_wait 0 255 /end CHARACTERISTIC
/begin COMPU_METHOD Compu_ALLP_wait " " RAT_FUNC "%.0" "count" COEFFS 0 1 0 0 0 1 /end COMPU_METHOD
/begin CHARACTERISTIC CLNG_hi "CL max (Fault Condition:CL_BM >)" VALUE 0x001C292C /* @ECU_Address@CLNG_hi@0x01001048@ */ ECIPP_ALIGNMENT_SWORD 100 Compu_CLNG_hi -100 99.9969482421875 /end CHARACTERISTIC
/begin COMPU_METHOD Compu_CLNG_hi " " RAT_FUNC "%.1" "%" COEFFS 0 327.68 0 0 0 1 /end COMPU_METHOD
/begin CHARACTERISTIC CLNG_lo "CL min (Fault Condition:CL_BM <)" VALUE 0x001C292E /* @ECU_Address@CLNG_lo@0x01001050@ */ ECIPP_ALIGNMENT_SWORD 100 Compu_CLNG_lo -100 99.9969482421875 /end CHARACTERISTIC
/begin COMPU_METHOD Compu_CLNG_lo " " RAT_FUNC "%.1" "%" COEFFS 0 327.68 0 0 0 1 /end COMPU_METHOD
/begin CHARACTERISTIC CLNG_K "K_CL_switching" VALUE 0x001C2930 /* @ECU_Address@CLNG_K@0x01001058@ */ ECIPP_ALIGNMENT_SWORD 100 Compu_CLNG_K -100 99.9969482421875 /end CHARACTERISTIC
/begin COMPU_METHOD Compu_CLNG_K " " RAT_FUNC "%.1" "%" COEFFS 0 327.68 0 0 0 1 /end COMPU_METHOD
/begin CHARACTERISTIC CLNG_K_acquire "K_CL_acquire" VALUE 0x001C2932 /* @ECU_Address@CLNG_K_acquire@0x01001060@ */ ECIPP_ALIGNMENT_SWORD 100 Compu_CLNG_K_acquire -100 99.9969482421875 /end CHARACTERISTIC
/begin COMPU_METHOD Compu_CLNG_K_acquire " " RAT_FUNC "%.1" "%" COEFFS 0 327.68 0 0 0 1 /end COMPU_METHOD
/begin CHARACTERISTIC CLNG_stepmax "CL_stepmax" VALUE 0x001C2934 /* @ECU_Address@CLNG_stepmax@0x01001068@ */ ECIPP_ALIGNMENT_SWORD 100 Compu_CLNG_stepmax -100 99.9969482421875 /end CHARACTERISTIC
/begin COMPU_METHOD Compu_CLNG_stepmax " " RAT_FUNC "%.1" "%" COEFFS 0 327.68 0 0 0 1 /end COMPU_METHOD
/begin CHARACTERISTIC CLpNG_Emax "CLp_Emax" VALUE 0x001C2936 /* @ECU_Address@CLpNG_Emax@0x01001070@ */ ECIPP_ALIGNMENT_UWORD 200 Compu_CLpNG_Emax 0 199.996948242188 /end CHARACTERISTIC
/begin COMPU_METHOD Compu_CLpNG_Emax " " RAT_FUNC "%.1" "%" COEFFS 0 327.68 0 0 0 1 /end COMPU_METHOD
/begin CHARACTERISTIC CLpNG_Emin "CLp_Emin" VALUE 0x001C2938 /* @ECU_Address@CLpNG_Emin@0x01001078@ */ ECIPP_ALIGNMENT_UWORD 200 Compu_CLpNG_Emin 0 199.996948242188 /end CHARACTERISTIC
/begin COMPU_METHOD Compu_CLpNG_Emin " " RAT_FUNC "%.1" "%" COEFFS 0 327.68 0 0 0 1 /end COMPU_METHOD
/begin CHARACTERISTIC CLpNG_Rp_def "CLp_Rp" VALUE 0x001C293A /* @ECU_Address@CLpNG_Rp_def@0x01001080@ */ ECIPP_ALIGNMENT_UWORD 100 Compu_CLpNG_Rp_def 0 99.9984741210938 /end CHARACTERISTIC
/begin COMPU_METHOD Compu_CLpNG_Rp_def " " RAT_FUNC "%.1" "%" COEFFS 0 655.36 0 0 0 1 /end COMPU_METHOD
/begin CHARACTERISTIC CLpNG_Rn_def "CLp_Rn" VALUE 0x001C293C /* @ECU_Address@CLpNG_Rn_def@0x01001088@ */ ECIPP_ALIGNMENT_UWORD 100 Compu_CLpNG_Rn_def 0 99.9984741210938 /end CHARACTERISTIC
/begin COMPU_METHOD Compu_CLpNG_Rn_def " " RAT_FUNC "%.1" "%" COEFFS 0 655.36 0 0 0 1 /end COMPU_METHOD
/begin CHARACTERISTIC ALNG_hi "Adapt max (Fault Condition:AL_BM >)" VALUE 0x001C293E /* @ECU_Address@ALNG_hi@0x01001090@ */ ECIPP_ALIGNMENT_SWORD 100 Compu_ALNG_hi -100 99.9969482421875 /end CHARACTERISTIC
/begin COMPU_METHOD Compu_ALNG_hi " " RAT_FUNC "%.1" "%" COEFFS 0 327.68 0 0 0 1 /end COMPU_METHOD
/begin CHARACTERISTIC ALNG_lo "Adapt min (Fault Condition:AL_BM <)" VALUE 0x001C2940 /* @ECU_Address@ALNG_lo@0x01001098@ */ ECIPP_ALIGNMENT_SWORD 100 Compu_ALNG_lo -100 99.9969482421875 /end CHARACTERISTIC
/begin COMPU_METHOD Compu_ALNG_lo " " RAT_FUNC "%.1" "%" COEFFS 0 327.68 0 0 0 1 /end COMPU_METHOD
/begin CHARACTERISTIC ALNG_K "K adaptive learn" VALUE 0x001C2942 /* @ECU_Address@ALNG_K@0x010010A0@ */ ECIPP_ALIGNMENT_SWORD 100 Compu_ALNG_K -100 99.9969482421875 /end CHARACTERISTIC
/begin COMPU_METHOD Compu_ALNG_K " " RAT_FUNC "%.1" "%" COEFFS 0 327.68 0 0 0 1 /end COMPU_METHOD
/begin CHARACTERISTIC ALNG_stepmax "Adapt stepmax" VALUE 0x001C2944 /* @ECU_Address@ALNG_stepmax@0x010010A8@ */ ECIPP_ALIGNMENT_UWORD 200 Compu_ALNG_stepmax 0 199.996948242188 /end CHARACTERISTIC
/begin COMPU_METHOD Compu_ALNG_stepmax " " RAT_FUNC "%.1" "%" COEFFS 0 327.68 0 0 0 1 /end COMPU_METHOD
/begin CHARACTERISTIC ALNG_dzone "Adapt deadzone" VALUE 0x001C2946 /* @ECU_Address@ALNG_dzone@0x010010B0@ */ ECIPP_ALIGNMENT_UWORD 200 Compu_ALNG_dzone 0 199.996948242188 /end CHARACTERISTIC
/begin COMPU_METHOD Compu_ALNG_dzone " " RAT_FUNC "%.1" "%" COEFFS 0 327.68 0 0 0 1 /end COMPU_METHOD
/begin CHARACTERISTIC ALNG_valid "Adaptive update validation error" VALUE 0x001C2948 /* @ECU_Address@ALNG_valid@0x010010B8@ */ ECIPP_ALIGNMENT_SWORD 100 Compu_ALNG_valid -100 99.9969482421875 /end CHARACTERISTIC
/begin COMPU_METHOD Compu_ALNG_valid " " RAT_FUNC "%.1" "%" COEFFS 0 327.68 0 0 0 1 /end COMPU_METHOD
/begin CHARACTERISTIC ALNG_wait "Valid adaptive cycles min" VALUE 0x001C294A /* @ECU_Address@ALNG_wait@0x010010C0@ */ ECIPP_ALIGNMENT_UBYTE 255 Compu_ALNG_wait 0 255 /end CHARACTERISTIC
/begin COMPU_METHOD Compu_ALNG_wait " " RAT_FUNC "%.0" "count" COEFFS 0 1 0 0 0 1 /end COMPU_METHOD
/begin MEASUREMENT UEGO_mode "UEGO mode{UEGO_mode&0xff=0xfe:Invalid}{UEGO_mode&0xff=0xff:Fault}{UEGO_mode&0xff=0x00:Off}{UEGO_mode&0xff=0x01:Warming}{UEGO_mode&0xff=0x02:Waiting}{UEGO_mode&0xff=0x03:Active}" UBYTE UEGO_mode_COMPU_VTAB 0 0 0 255 ECU_ADDRESS 0x01001240 BIT_MASK 0xff /end MEASUREMENT
/begin COMPU_METHOD UEGO_mode_COMPU_VTAB "Verbal Table" TAB_VERB "%.0" "list" COMPU_TAB_REF UEGO_mode_COMPU_VTAB_REF /end COMPU_METHOD
/begin COMPU_VTAB UEGO_mode_COMPU_VTAB_REF "Verbal Table" TAB_VERB 6 0xfe "Invalid" 0xff "Fault" 0x00 "Off" 0x01 "Warming" 0x02 "Waiting" 0x03 "Active" DEFAULT_VALUE "UNKNOWN" /end COMPU_VTAB
/begin CHARACTERISTIC CL_dis_Gsln "Gasoline CL Control{CL_dis_Gsln&0xff=0x00:Enabled}{CL_dis_Gsln&0xff=0x01:Disabled}" VALUE 0x001C86A5 /* @ECU_Address@CL_dis_Gsln@0x010013B8@ */ ECIPP_ALIGNMENT_UBYTE 255 CL_dis_Gsln_COMPU_VTAB 0 255 BIT_MASK 0xff /end CHARACTERISTIC
/begin COMPU_METHOD CL_dis_Gsln_COMPU_VTAB "Verbal Table" TAB_VERB "%.0" "list" COMPU_TAB_REF CL_dis_Gsln_COMPU_VTAB_REF /end COMPU_METHOD
/begin COMPU_VTAB CL_dis_Gsln_COMPU_VTAB_REF "Verbal Table" TAB_VERB 2 0x00 "Enabled" 0x01 "Disabled" DEFAULT_VALUE "UNKNOWN" /end COMPU_VTAB
/begin CHARACTERISTIC CL_dis_LP "LPG CL Control{CL_dis_LP&0xff=0x00:Enabled}{CL_dis_LP&0xff=0x01:Disabled}" VALUE 0x001C86A6 /* @ECU_Address@CL_dis_LP@0x010013C0@ */ ECIPP_ALIGNMENT_UBYTE 255 CL_dis_LP_COMPU_VTAB 0 255 BIT_MASK 0xff /end CHARACTERISTIC
/begin COMPU_METHOD CL_dis_LP_COMPU_VTAB "Verbal Table" TAB_VERB "%.0" "list" COMPU_TAB_REF CL_dis_LP_COMPU_VTAB_REF /end COMPU_METHOD
/begin COMPU_VTAB CL_dis_LP_COMPU_VTAB_REF "Verbal Table" TAB_VERB 2 0x00 "Enabled" 0x01 "Disabled" DEFAULT_VALUE "UNKNOWN" /end COMPU_VTAB
/begin CHARACTERISTIC CL_dis_NG "NG CL Control{CL_dis_NG&0xff=0x00:Enabled}{CL_dis_NG&0xff=0x01:Disabled}" VALUE 0x001C86A7 /* @ECU_Address@CL_dis_NG@0x010013C8@ */ ECIPP_ALIGNMENT_UBYTE 255 CL_dis_NG_COMPU_VTAB 0 255 BIT_MASK 0xff /end CHARACTERISTIC
/begin COMPU_METHOD CL_dis_NG_COMPU_VTAB "Verbal Table" TAB_VERB "%.0" "list" COMPU_TAB_REF CL_dis_NG_COMPU_VTAB_REF /end COMPU_METHOD
/begin COMPU_VTAB CL_dis_NG_COMPU_VTAB_REF "Verbal Table" TAB_VERB 2 0x00 "Enabled" 0x01 "Disabled" DEFAULT_VALUE "UNKNOWN" /end COMPU_VTAB
/begin MEASUREMENT FP_crct "Fuel pressure correction" UWORD Compu_FP_crct 0 0 0 1.99996948242188 ECU_ADDRESS 0x01001C68 /end MEASUREMENT
/begin COMPU_METHOD Compu_FP_crct " " RAT_FUNC "%.3" "fraction" COEFFS 0 32768 0 0 0 1 /end COMPU_METHOD
/begin MEASUREMENT TRIM_nom_DC "TRIM nominal DC" UWORD Compu_TRIM_nom_DC 0 0 0 99.9984741210938 ECU_ADDRESS 0x01001E28 /end MEASUREMENT
/begin COMPU_METHOD Compu_TRIM_nom_DC " " RAT_FUNC "%.1" "%" COEFFS 0 655.36 0 0 0 1 /end COMPU_METHOD
/begin MEASUREMENT TRIM_nom_phi "TRIM nominal phi" UWORD Compu_TRIM_nom_phi 0 0 0 3.99993896484375 ECU_ADDRESS 0x01001E30 /end MEASUREMENT
/begin COMPU_METHOD Compu_TRIM_nom_phi " " RAT_FUNC "%.3" "phi" COEFFS 0 16384 0 0 0 1 /end COMPU_METHOD
/begin MEASUREMENT TRIM_sens "TRIM sensitivity" SWORD Compu_TRIM_sens 0 0 -0.2 0.199993896484375 ECU_ADDRESS 0x01001E38 /end MEASUREMENT
/begin COMPU_METHOD Compu_TRIM_sens " " RAT_FUNC "%.3" "dphi / 10% DC" COEFFS 0 163840 0 0 0 1 /end COMPU_METHOD
/begin CHARACTERISTIC trim_LP_min "Trim valve minimum duty-cycle" VALUE 0x001c19ba /* @ECU_Address@trim_LP_min@0x01001EA0@ */ ECIPP_ALIGNMENT_UWORD 100 Compu_trim_LP_min 0 99.9984741210938 /end CHARACTERISTIC
/begin COMPU_METHOD Compu_trim_LP_min " " RAT_FUNC "%.1" "%" COEFFS 0 655.36 0 0 0 1 /end COMPU_METHOD
/begin CHARACTERISTIC trim_LP_max "Trim valve maximum duty-cycle" VALUE 0x001c19b8 /* @ECU_Address@trim_LP_max@0x01001EA8@ */ ECIPP_ALIGNMENT_UWORD 100 Compu_trim_LP_max 0 99.9984741210938 /end CHARACTERISTIC
/begin COMPU_METHOD Compu_trim_LP_max " " RAT_FUNC "%.1" "%" COEFFS 0 655.36 0 0 0 1 /end COMPU_METHOD
/begin CHARACTERISTIC trim_NG_max "Trim valve maximum duty-cycle" VALUE 0x001c2922 /* @ECU_Address@trim_NG_max@0x01001EB0@ */ ECIPP_ALIGNMENT_UWORD 100 Compu_trim_NG_max 0 99.9984741210938 /end CHARACTERISTIC
/begin COMPU_METHOD Compu_trim_NG_max " " RAT_FUNC "%.1" "%" COEFFS 0 655.36 0 0 0 1 /end COMPU_METHOD
/begin CHARACTERISTIC trim_NG_min "Trim valve minimum duty-cycle" VALUE 0x001c2924 /* @ECU_Address@trim_NG_min@0x01001EB8@ */ ECIPP_ALIGNMENT_UWORD 100 Compu_trim_NG_min 0 99.9984741210938 /end CHARACTERISTIC
/begin COMPU_METHOD Compu_trim_NG_min " " RAT_FUNC "%.1" "%" COEFFS 0 655.36 0 0 0 1 /end COMPU_METHOD
/begin MEASUREMENT EGO1_phiFB "EGO1 current phi" UWORD Compu_EGO1_phiFB 0 0 0 3.99993896484375 ECU_ADDRESS 0x01001EF0 /end MEASUREMENT
/begin COMPU_METHOD Compu_EGO1_phiFB " " RAT_FUNC "%.3" "phi" COEFFS 0 16384 0 0 0 1 /end COMPU_METHOD
/begin MEASUREMENT EGO2_phiFB "EGO2 current phi" UWORD Compu_EGO2_phiFB 0 0 0 3.99993896484375 ECU_ADDRESS 0x01001EF8 /end MEASUREMENT
/begin COMPU_METHOD Compu_EGO2_phiFB " " RAT_FUNC "%.3" "phi" COEFFS 0 16384 0 0 0 1 /end COMPU_METHOD
/begin MEASUREMENT EGO3_phiFB "EGO3 current phi" UWORD Compu_EGO3_phiFB 0 0 0 3.99993896484375 ECU_ADDRESS 0x01001F00 /end MEASUREMENT
/begin COMPU_METHOD Compu_EGO3_phiFB " " RAT_FUNC "%.3" "phi" COEFFS 0 16384 0 0 0 1 /end COMPU_METHOD
/begin MEASUREMENT EGO1_phiFB_avg "EGO1 average phi" UWORD Compu_EGO1_phiFB_avg 0 0 0 3.99993896484375 ECU_ADDRESS 0x01001F08 /end MEASUREMENT
/begin COMPU_METHOD Compu_EGO1_phiFB_avg " " RAT_FUNC "%.3" "phi" COEFFS 0 16384 0 0 0 1 /end COMPU_METHOD
/begin MEASUREMENT EGO2_phiFB_avg "EGO2 average phi" UWORD Compu_EGO2_phiFB_avg 0 0 0 3.99993896484375 ECU_ADDRESS 0x01001F10 /end MEASUREMENT
/begin COMPU_METHOD Compu_EGO2_phiFB_avg " " RAT_FUNC "%.3" "phi" COEFFS 0 16384 0 0 0 1 /end COMPU_METHOD
/begin MEASUREMENT EGO3_phiFB_avg "EGO3 average phi" UWORD Compu_EGO3_phiFB_avg 0 0 0 3.99993896484375 ECU_ADDRESS 0x01001F18 /end MEASUREMENT
/begin COMPU_METHOD Compu_EGO3_phiFB_avg " " RAT_FUNC "%.3" "phi" COEFFS 0 16384 0 0 0 1 /end COMPU_METHOD
/begin MEASUREMENT Phi_post_d "Target post-cat phi" UWORD Compu_Phi_post_d 0 0 0 3.99993896484375 ECU_ADDRESS 0x01001F20 /end MEASUREMENT
/begin COMPU_METHOD Compu_Phi_post_d " " RAT_FUNC "%.3" "phi" COEFFS 0 16384 0 0 0 1 /end COMPU_METHOD
/begin MEASUREMENT Phi1_post_delt "Post-cat1 phi-target offset" SWORD Compu_Phi1_post_delt 0 0 -2 1.99993896484375 ECU_ADDRESS 0x01001F28 /end MEASUREMENT
/begin COMPU_METHOD Compu_Phi1_post_delt " " RAT_FUNC "%.3" "phi" COEFFS 0 16384 0 0 0 1 /end COMPU_METHOD
/begin MEASUREMENT Phi_post_act "Post-cat phi update status{Phi_post_act&0xff=0:Inactive}{Phi_post_act&0xff=1:Active}" UBYTE Phi_post_act_COMPU_VTAB 0 0 0 255 ECU_ADDRESS 0x01001F30 BIT_MASK 0xff /end MEASUREMENT
/begin COMPU_METHOD Phi_post_act_COMPU_VTAB "Verbal Table" TAB_VERB "%.0" "list" COMPU_TAB_REF Phi_post_act_COMPU_VTAB_REF /end COMPU_METHOD
/begin COMPU_VTAB Phi_post_act_COMPU_VTAB_REF "Verbal Table" TAB_VERB 2 0 "Inactive" 1 "Active" DEFAULT_VALUE "UNKNOWN" /end COMPU_VTAB
/begin CHARACTERISTIC CL_Ki_p_postcat "Ki increasing postcat" VALUE 0x001C34A2 /* @ECU_Address@CL_Ki_p_postcat@0x01001F40@ */ ECIPP_ALIGNMENT_SWORD 100 Compu_CL_Ki_p_postcat -100 99.9969482421875 /end CHARACTERISTIC
/begin COMPU_METHOD Compu_CL_Ki_p_postcat " " RAT_FUNC "%.1" "% / T_delay" COEFFS 0 327.68 0 0 0 1 /end COMPU_METHOD
/begin CHARACTERISTIC CL_hi_postcat "Postcat delta-phi max" VALUE 0x001C34B2 /* @ECU_Address@CL_hi_postcat@0x01001F48@ */ ECIPP_ALIGNMENT_SWORD 2 Compu_CL_hi_postcat -2 1.99993896484375 /end CHARACTERISTIC
/begin COMPU_METHOD Compu_CL_hi_postcat " " RAT_FUNC "%.3" "phi" COEFFS 0 16384 0 0 0 1 /end COMPU_METHOD
/begin CHARACTERISTIC CL_lo_postcat "Postcat delta-phi min" VALUE 0x001C34B4 /* @ECU_Address@CL_lo_postcat@0x01001F50@ */ ECIPP_ALIGNMENT_SWORD 2 Compu_CL_lo_postcat -2 1.99993896484375 /end CHARACTERISTIC
/begin COMPU_METHOD Compu_CL_lo_postcat " " RAT_FUNC "%.3" "phi" COEFFS 0 16384 0 0 0 1 /end COMPU_METHOD
/begin CHARACTERISTIC CLLP_lo_postcat "Postcat delta-phi min" VALUE 0x001C19F8 /* @ECU_Address@CLLP_lo_postcat@0x01001F58@ */ ECIPP_ALIGNMENT_SWORD 2 Compu_CLLP_lo_postcat -2 1.99993896484375 /end CHARACTERISTIC
/begin COMPU_METHOD Compu_CLLP_lo_postcat " " RAT_FUNC "%.3" "phi" COEFFS 0 16384 0 0 0 1 /end COMPU_METHOD
/begin CHARACTERISTIC CLNG_lo_postcat "Postcat delta-phi min" VALUE 0x001C2962 /* @ECU_Address@CLNG_lo_postcat@0x01001F60@ */ ECIPP_ALIGNMENT_SWORD 2 Compu_CLNG_lo_postcat -2 1.99993896484375 /end CHARACTERISTIC
/begin COMPU_METHOD Compu_CLNG_lo_postcat " " RAT_FUNC "%.3" "phi" COEFFS 0 16384 0 0 0 1 /end COMPU_METHOD
/begin CHARACTERISTIC CLNG_hi_postcat "Postcat delta-phi max" VALUE 0x001C2960 /* @ECU_Address@CLNG_hi_postcat@0x01001F68@ */ ECIPP_ALIGNMENT_SWORD 2 Compu_CLNG_hi_postcat -2 1.99993896484375 /end CHARACTERISTIC
/begin COMPU_METHOD Compu_CLNG_hi_postcat " " RAT_FUNC "%.3" "phi" COEFFS 0 16384 0 0 0 1 /end COMPU_METHOD
/begin CHARACTERISTIC CLLP_hi_postcat "Postcat delta-phi max" VALUE 0x001C19F6 /* @ECU_Address@CLLP_hi_postcat@0x01001F70@ */ ECIPP_ALIGNMENT_SWORD 2 Compu_CLLP_hi_postcat -2 1.99993896484375 /end CHARACTERISTIC
/begin COMPU_METHOD Compu_CLLP_hi_postcat " " RAT_FUNC "%.3" "phi" COEFFS 0 16384 0 0 0 1 /end COMPU_METHOD
/begin CHARACTERISTIC CLLP_Ki_p_postcat "Ki increasing postcat" VALUE 0x001C19E6 /* @ECU_Address@CLLP_Ki_p_postcat@0x01001F78@ */ ECIPP_ALIGNMENT_SWORD 100 Compu_CLLP_Ki_p_postcat -100 99.9969482421875 /end CHARACTERISTIC
/begin COMPU_METHOD Compu_CLLP_Ki_p_postcat " " RAT_FUNC "%.1" "% / T_delay" COEFFS 0 327.68 0 0 0 1 /end COMPU_METHOD
/begin CHARACTERISTIC CLNG_Ki_p_postcat "Ki increasing postcat" VALUE 0x001C2950 /* @ECU_Address@CLNG_Ki_p_postcat@0x01001F80@ */ ECIPP_ALIGNMENT_SWORD 100 Compu_CLNG_Ki_p_postcat -100 99.9969482421875 /end CHARACTERISTIC
/begin COMPU_METHOD Compu_CLNG_Ki_p_postcat " " RAT_FUNC "%.1" "% / T_delay" COEFFS 0 327.68 0 0 0 1 /end COMPU_METHOD
/begin CHARACTERISTIC CL_postcat_ena "Gasoline postcat control{CL_postcat_ena&0xff=0:Disabled}{CL_postcat_ena&0xff=1:Post-Cat Phi}{CL_postcat_ena&0xff=2:TWC Model}" VALUE 0x001C349D /* @ECU_Address@CL_postcat_ena@0x01001F88@ */ ECIPP_ALIGNMENT_UBYTE 255 CL_postcat_ena_COMPU_VTAB 0 255 BIT_MASK 0xff /end CHARACTERISTIC
/begin COMPU_METHOD CL_postcat_ena_COMPU_VTAB "Verbal Table" TAB_VERB "%.0" "list" COMPU_TAB_REF CL_postcat_ena_COMPU_VTAB_REF /end COMPU_METHOD
/begin COMPU_VTAB CL_postcat_ena_COMPU_VTAB_REF "Verbal Table" TAB_VERB 3 0 "Disabled" 1 "Post-Cat Phi" 2 "TWC Model" DEFAULT_VALUE "UNKNOWN" /end COMPU_VTAB
/begin CHARACTERISTIC CLLP_postcat_ena "LPG postcat control{CLLP_postcat_ena&0xff=0:Disabled}{CLLP_postcat_ena&0xff=1:Post-Cat Phi}{CLLP_postcat_ena&0xff=2:TWC Model}" VALUE 0x001C19E1 /* @ECU_Address@CLLP_postcat_ena@0x01001F90@ */ ECIPP_ALIGNMENT_UBYTE 255 CLLP_postcat_ena_COMPU_VTAB 0 255 BIT_MASK 0xff /end CHARACTERISTIC
/begin COMPU_METHOD CLLP_postcat_ena_COMPU_VTAB "Verbal Table" TAB_VERB "%.0" "list" COMPU_TAB_REF CLLP_postcat_ena_COMPU_VTAB_REF /end COMPU_METHOD
/begin COMPU_VTAB CLLP_postcat_ena_COMPU_VTAB_REF "Verbal Table" TAB_VERB 3 0 "Disabled" 1 "Post-Cat Phi" 2 "TWC Model" DEFAULT_VALUE "UNKNOWN" /end COMPU_VTAB
/begin CHARACTERISTIC CLNG_postcat_ena "NG postcat control{CLNG_postcat_ena&0xff=0:Disabled}{CLNG_postcat_ena&0xff=1:Post-Cat Phi}{CLNG_postcat_ena&0xff=2:TWC Model}" VALUE 0x001C294B /* @ECU_Address@CLNG_postcat_ena@0x01001F98@ */ ECIPP_ALIGNMENT_UBYTE 255 CLNG_postcat_ena_COMPU_VTAB 0 255 BIT_MASK 0xff /end CHARACTERISTIC
/begin COMPU_METHOD CLNG_postcat_ena_COMPU_VTAB "Verbal Table" TAB_VERB "%.0" "list" COMPU_TAB_REF CLNG_postcat_ena_COMPU_VTAB_REF /end COMPU_METHOD
/begin COMPU_VTAB CLNG_postcat_ena_COMPU_VTAB_REF "Verbal Table" TAB_VERB 3 0 "Disabled" 1 "Post-Cat Phi" 2 "TWC Model" DEFAULT_VALUE "UNKNOWN" /end COMPU_VTAB
/begin CHARACTERISTIC CL_Ki_n_postcat "Ki decreasing postcat" VALUE 0x001C34A4 /* @ECU_Address@CL_Ki_n_postcat@0x01001FE8@ */ ECIPP_ALIGNMENT_SWORD 100 Compu_CL_Ki_n_postcat -100 99.9969482421875 /end CHARACTERISTIC
/begin COMPU_METHOD Compu_CL_Ki_n_postcat " " RAT_FUNC "%.1" "% / T_delay" COEFFS 0 327.68 0 0 0 1 /end COMPU_METHOD
/begin CHARACTERISTIC CLLP_Ki_n_postcat "Ki decreasing postcat" VALUE 0x001C19E8 /* @ECU_Address@CLLP_Ki_n_postcat@0x01001FF0@ */ ECIPP_ALIGNMENT_SWORD 100 Compu_CLLP_Ki_n_postcat -100 99.9969482421875 /end CHARACTERISTIC
/begin COMPU_METHOD Compu_CLLP_Ki_n_postcat " " RAT_FUNC "%.1" "% / T_delay" COEFFS 0 327.68 0 0 0 1 /end COMPU_METHOD
/begin CHARACTERISTIC CLNG_Ki_n_postcat "Ki decreasing postcat" VALUE 0x001C2952 /* @ECU_Address@CLNG_Ki_n_postcat@0x01001FF8@ */ ECIPP_ALIGNMENT_SWORD 100 Compu_CLNG_Ki_n_postcat -100 99.9969482421875 /end CHARACTERISTIC
/begin COMPU_METHOD Compu_CLNG_Ki_n_postcat " " RAT_FUNC "%.1" "% / T_delay" COEFFS 0 327.68 0 0 0 1 /end COMPU_METHOD
/begin CHARACTERISTIC CL_Kp_p_postcat "Kp increasing postcat" VALUE 0x001C349E /* @ECU_Address@CL_Kp_p_postcat@0x01002000@ */ ECIPP_ALIGNMENT_SWORD 100 Compu_CL_Kp_p_postcat -100 99.9969482421875 /end CHARACTERISTIC
/begin COMPU_METHOD Compu_CL_Kp_p_postcat " " RAT_FUNC "%.1" "%" COEFFS 0 327.68 0 0 0 1 /end COMPU_METHOD
/begin CHARACTERISTIC CLLP_Kp_p_postcat "Kp increasing postcat" VALUE 0x001C19E2 /* @ECU_Address@CLLP_Kp_p_postcat@0x01002008@ */ ECIPP_ALIGNMENT_SWORD 100 Compu_CLLP_Kp_p_postcat -100 99.9969482421875 /end CHARACTERISTIC
/begin COMPU_METHOD Compu_CLLP_Kp_p_postcat " " RAT_FUNC "%.1" "%" COEFFS 0 327.68 0 0 0 1 /end COMPU_METHOD
/begin CHARACTERISTIC CLNG_Kp_p_postcat "Kp increasing postcat" VALUE 0x001C294C /* @ECU_Address@CLNG_Kp_p_postcat@0x01002010@ */ ECIPP_ALIGNMENT_SWORD 100 Compu_CLNG_Kp_p_postcat -100 99.9969482421875 /end CHARACTERISTIC
/begin COMPU_METHOD Compu_CLNG_Kp_p_postcat " " RAT_FUNC "%.1" "%" COEFFS 0 327.68 0 0 0 1 /end COMPU_METHOD
/begin CHARACTERISTIC CL_Kp_n_postcat "Kp decreasing postcat" VALUE 0x001C34A0 /* @ECU_Address@CL_Kp_n_postcat@0x01002018@ */ ECIPP_ALIGNMENT_SWORD 100 Compu_CL_Kp_n_postcat -100 99.9969482421875 /end CHARACTERISTIC
/begin COMPU_METHOD Compu_CL_Kp_n_postcat " " RAT_FUNC "%.1" "%" COEFFS 0 327.68 0 0 0 1 /end COMPU_METHOD
/begin CHARACTERISTIC CLLP_Kp_n_postcat "Kp decreasing postcat" VALUE 0x001C19E4 /* @ECU_Address@CLLP_Kp_n_postcat@0x01002020@ */ ECIPP_ALIGNMENT_SWORD 100 Compu_CLLP_Kp_n_postcat -100 99.9969482421875 /end CHARACTERISTIC
/begin COMPU_METHOD Compu_CLLP_Kp_n_postcat " " RAT_FUNC "%.1" "%" COEFFS 0 327.68 0 0 0 1 /end COMPU_METHOD
/begin CHARACTERISTIC CLNG_Kp_n_postcat "Kp decreasing postcat" VALUE 0x001C294E /* @ECU_Address@CLNG_Kp_n_postcat@0x01002028@ */ ECIPP_ALIGNMENT_SWORD 100 Compu_CLNG_Kp_n_postcat -100 99.9969482421875 /end CHARACTERISTIC
/begin COMPU_METHOD Compu_CLNG_Kp_n_postcat " " RAT_FUNC "%.1" "%" COEFFS 0 327.68 0 0 0 1 /end COMPU_METHOD
/begin CHARACTERISTIC CL_Kiv_p_postcat "Kiv increasing postcat" VALUE 0x001C34A6 /* @ECU_Address@CL_Kiv_p_postcat@0x01002030@ */ ECIPP_ALIGNMENT_SWORD 800 Compu_CL_Kiv_p_postcat -800 799.9755859375 /end CHARACTERISTIC
/begin COMPU_METHOD Compu_CL_Kiv_p_postcat " " RAT_FUNC "%.1" "% / T_delay^2" COEFFS 0 40.96 0 0 0 1 /end COMPU_METHOD
/begin CHARACTERISTIC CL_Kiv_n_postcat "Kiv decreasing postcat" VALUE 0x001C34A8 /* @ECU_Address@CL_Kiv_n_postcat@0x01002038@ */ ECIPP_ALIGNMENT_SWORD 800 Compu_CL_Kiv_n_postcat -800 799.9755859375 /end CHARACTERISTIC
/begin COMPU_METHOD Compu_CL_Kiv_n_postcat " " RAT_FUNC "%.1" "% / T_delay^2" COEFFS 0 40.96 0 0 0 1 /end COMPU_METHOD
/begin CHARACTERISTIC CLLP_Kiv_p_postcat "Kiv increasing postcat" VALUE 0x001C19EA /* @ECU_Address@CLLP_Kiv_p_postcat@0x01002040@ */ ECIPP_ALIGNMENT_SWORD 800 Compu_CLLP_Kiv_p_postcat -800 799.9755859375 /end CHARACTERISTIC
/begin COMPU_METHOD Compu_CLLP_Kiv_p_postcat " " RAT_FUNC "%.1" "% / T_delay^2" COEFFS 0 40.96 0 0 0 1 /end COMPU_METHOD
/begin CHARACTERISTIC CLLP_Kiv_n_postcat "Kiv decreasing postcat" VALUE 0x001C19EC /* @ECU_Address@CLLP_Kiv_n_postcat@0x01002048@ */ ECIPP_ALIGNMENT_SWORD 800 Compu_CLLP_Kiv_n_postcat -800 799.9755859375 /end CHARACTERISTIC
/begin COMPU_METHOD Compu_CLLP_Kiv_n_postcat " " RAT_FUNC "%.1" "% / T_delay^2" COEFFS 0 40.96 0 0 0 1 /end COMPU_METHOD
/begin CHARACTERISTIC CLNG_Kiv_p_postcat "Kiv increasing postcat" VALUE 0x001C2954 /* @ECU_Address@CLNG_Kiv_p_postcat@0x01002050@ */ ECIPP_ALIGNMENT_SWORD 800 Compu_CLNG_Kiv_p_postcat -800 799.9755859375 /end CHARACTERISTIC
/begin COMPU_METHOD Compu_CLNG_Kiv_p_postcat " " RAT_FUNC "%.1" "% / T_delay^2" COEFFS 0 40.96 0 0 0 1 /end COMPU_METHOD
/begin CHARACTERISTIC CLNG_Kiv_n_postcat "Kiv decreasing postcat" VALUE 0x001C2956 /* @ECU_Address@CLNG_Kiv_n_postcat@0x01002058@ */ ECIPP_ALIGNMENT_SWORD 800 Compu_CLNG_Kiv_n_postcat -800 799.9755859375 /end CHARACTERISTIC
/begin COMPU_METHOD Compu_CLNG_Kiv_n_postcat " " RAT_FUNC "%.1" "% / T_delay^2" COEFFS 0 40.96 0 0 0 1 /end COMPU_METHOD
/begin CHARACTERISTIC CL_phidt_hi_postcat "Postcat dphi/dt max" VALUE 0x001C34B6 /* @ECU_Address@CL_phidt_hi_postcat@0x01002068@ */ ECIPP_ALIGNMENT_SWORD 0 Compu_CL_phidt_hi_postcat -0.125 0.124996185302734 /end CHARACTERISTIC
/begin COMPU_METHOD Compu_CL_phidt_hi_postcat " " RAT_FUNC "%.3" "dphi / T_delay" COEFFS 0 262144 0 0 0 1 /end COMPU_METHOD
/begin CHARACTERISTIC CL_phidt_lo_postcat "Postcat dphi/dt min" VALUE 0x001C34B8 /* @ECU_Address@CL_phidt_lo_postcat@0x01002070@ */ ECIPP_ALIGNMENT_SWORD 0 Compu_CL_phidt_lo_postcat -0.125 0.124996185302734 /end CHARACTERISTIC
/begin COMPU_METHOD Compu_CL_phidt_lo_postcat " " RAT_FUNC "%.3" "dphi / T_delay" COEFFS 0 262144 0 0 0 1 /end COMPU_METHOD
/begin CHARACTERISTIC CLP_phidt_hi_postcat "Postcat dphi/dt max" VALUE 0x001C19FA /* @ECU_Address@CLP_phidt_hi_postcat@0x01002078@ */ ECIPP_ALIGNMENT_SWORD 0 Compu_CLP_phidt_hi_postcat -0.125 0.124996185302734 /end CHARACTERISTIC
/begin COMPU_METHOD Compu_CLP_phidt_hi_postcat " " RAT_FUNC "%.3" "dphi / T_delay" COEFFS 0 262144 0 0 0 1 /end COMPU_METHOD
/begin CHARACTERISTIC CLP_phidt_lo_postcat "Postcat dphi/dt min" VALUE 0x001C19FC /* @ECU_Address@CLP_phidt_lo_postcat@0x01002080@ */ ECIPP_ALIGNMENT_SWORD 0 Compu_CLP_phidt_lo_postcat -0.125 0.124996185302734 /end CHARACTERISTIC
/begin COMPU_METHOD Compu_CLP_phidt_lo_postcat " " RAT_FUNC "%.3" "dphi / T_delay" COEFFS 0 262144 0 0 0 1 /end COMPU_METHOD
/begin CHARACTERISTIC CLN_phidt_hi_postcat "Postcat dphi/dt max" VALUE 0x001C2964 /* @ECU_Address@CLN_phidt_hi_postcat@0x01002088@ */ ECIPP_ALIGNMENT_SWORD 0 Compu_CLN_phidt_hi_postcat -0.125 0.124996185302734 /end CHARACTERISTIC
/begin COMPU_METHOD Compu_CLN_phidt_hi_postcat " " RAT_FUNC "%.3" "dphi / T_delay" COEFFS 0 262144 0 0 0 1 /end COMPU_METHOD
/begin CHARACTERISTIC CLN_phidt_lo_postcat "Postcat dphi/dt min" VALUE 0x001C2966 /* @ECU_Address@CLN_phidt_lo_postcat@0x01002090@ */ ECIPP_ALIGNMENT_SWORD 0 Compu_CLN_phidt_lo_postcat -0.125 0.124996185302734 /end CHARACTERISTIC
/begin COMPU_METHOD Compu_CLN_phidt_lo_postcat " " RAT_FUNC "%.3" "dphi / T_delay" COEFFS 0 262144 0 0 0 1 /end COMPU_METHOD
/begin CHARACTERISTIC MJ_nom_crkP "Cranking nominal EPR setpoint" VALUE 0x001c0af0 /* @ECU_Address@MJ_nom_crkP@0x010020A8@ */ ECIPP_ALIGNMENT_SWORD 222 Compu_MJ_nom_crkP -222 221.993225097656 /end CHARACTERISTIC
/begin COMPU_METHOD Compu_MJ_nom_crkP " " RAT_FUNC "%.2" "in H2O" COEFFS 0 147.603603603604 0 0 0 1 /end COMPU_METHOD
/begin CHARACTERISTIC MJ_P_minP "EPR minimum pressure" VALUE 0x001c0aec /* @ECU_Address@MJ_P_minP@0x010020B0@ */ ECIPP_ALIGNMENT_SWORD 222 Compu_MJ_P_minP -222 221.993225097656 /end CHARACTERISTIC
/begin COMPU_METHOD Compu_MJ_P_minP " " RAT_FUNC "%.2" "in H2O" COEFFS 0 147.603603603604 0 0 0 1 /end COMPU_METHOD
/begin CHARACTERISTIC MJ_P_minN "EPR minimum pressure" VALUE 0x001c1a56 /* @ECU_Address@MJ_P_minN@0x010020B8@ */ ECIPP_ALIGNMENT_SWORD 222 Compu_MJ_P_minN -222 221.993225097656 /end CHARACTERISTIC
/begin COMPU_METHOD Compu_MJ_P_minN " " RAT_FUNC "%.2" "in H2O" COEFFS 0 147.603603603604 0 0 0 1 /end COMPU_METHOD
/begin CHARACTERISTIC MJ_P_maxP "EPR maximum pressure" VALUE 0x001c0aea /* @ECU_Address@MJ_P_maxP@0x010020C0@ */ ECIPP_ALIGNMENT_SWORD 222 Compu_MJ_P_maxP -222 221.993225097656 /end CHARACTERISTIC
/begin COMPU_METHOD Compu_MJ_P_maxP " " RAT_FUNC "%.2" "in H2O" COEFFS 0 147.603603603604 0 0 0 1 /end COMPU_METHOD
/begin CHARACTERISTIC MJ_P_maxN "EPR maximum pressure" VALUE 0x001c1a54 /* @ECU_Address@MJ_P_maxN@0x010020C8@ */ ECIPP_ALIGNMENT_SWORD 222 Compu_MJ_P_maxN -222 221.993225097656 /end CHARACTERISTIC
/begin COMPU_METHOD Compu_MJ_P_maxN " " RAT_FUNC "%.2" "in H2O" COEFFS 0 147.603603603604 0 0 0 1 /end COMPU_METHOD
/begin CHARACTERISTIC MJ_nom_crkN "Cranking nominal EPR setpoint" VALUE 0x001c1a5a /* @ECU_Address@MJ_nom_crkN@0x010020D0@ */ ECIPP_ALIGNMENT_SWORD 222 Compu_MJ_nom_crkN -222 221.993225097656 /end CHARACTERISTIC
/begin COMPU_METHOD Compu_MJ_nom_crkN " " RAT_FUNC "%.2" "in H2O" COEFFS 0 147.603603603604 0 0 0 1 /end COMPU_METHOD
/begin MEASUREMENT EGO3_phiFB_dphidt "EGO3 derivative" SWORD Compu_EGO3_phiFB_dphidt 0 0 -0.125 0.124996185302734 ECU_ADDRESS 0x010020E8 /end MEASUREMENT
/begin COMPU_METHOD Compu_EGO3_phiFB_dphidt " " RAT_FUNC "%.4" "dphi / T_delay" COEFFS 0 262144 0 0 0 1 /end COMPU_METHOD
/begin MEASUREMENT MJ_P_nom "EPR nominal press" SWORD Compu_MJ_P_nom 0 0 -222 221.993225097656 ECU_ADDRESS 0x010020F0 /end MEASUREMENT
/begin COMPU_METHOD Compu_MJ_P_nom " " RAT_FUNC "%.2" "in H2O" COEFFS 0 147.603603603604 0 0 0 1 /end COMPU_METHOD
/begin MEASUREMENT Vent_P_sig "Venturi press signal" SWORD Compu_Vent_P_sig 0 0 -222 221.993225097656 ECU_ADDRESS 0x010020F8 /end MEASUREMENT
/begin COMPU_METHOD Compu_Vent_P_sig " " RAT_FUNC "%.2" "in H2O" COEFFS 0 147.603603603604 0 0 0 1 /end COMPU_METHOD
/begin MEASUREMENT Vent_dP_nom "Venturi nominal fuel driving dP" SWORD Compu_Vent_dP_nom 0 0 -222 221.993225097656 ECU_ADDRESS 0x01002100 /end MEASUREMENT
/begin COMPU_METHOD Compu_Vent_dP_nom " " RAT_FUNC "%.2" "in H2O" COEFFS 0 147.603603603604 0 0 0 1 /end COMPU_METHOD
/begin MEASUREMENT MJ_man_mode "EPR manual mode{MJ_man_mode&0xff=0:Auto}{MJ_man_mode&0xff=1:Manual Press}{MJ_man_mode&0xff=2:Manual Area}{MJ_man_mode&0xff=3:Manual Pulsed}" UBYTE MJ_man_mode_COMPU_VTAB 0 0 0 255 ECU_ADDRESS 0x01002108 BIT_MASK 0xff /end MEASUREMENT
/begin COMPU_METHOD MJ_man_mode_COMPU_VTAB "Verbal Table" TAB_VERB "%.0" "list" COMPU_TAB_REF MJ_man_mode_COMPU_VTAB_REF /end COMPU_METHOD
/begin COMPU_VTAB MJ_man_mode_COMPU_VTAB_REF "Verbal Table" TAB_VERB 4 0 "Auto" 1 "Manual Press" 2 "Manual Area" 3 "Manual Pulsed" DEFAULT_VALUE "UNKNOWN" /end COMPU_VTAB
/begin MEASUREMENT MJ_ctltype_cmd "EPR control type command{MJ_ctltype_cmd&0xff=0:Pressure Cmd}{MJ_ctltype_cmd&0xff=1:Area Cmd}{MJ_ctltype_cmd&0xff=2:PA+FF or Pulsed}{MJ_ctltype_cmd&0xff=3:Offline}" UBYTE MJ_ctltype_cmd_COMPU_VTAB 0 0 0 255 ECU_ADDRESS 0x01002110 BIT_MASK 0xff /end MEASUREMENT
/begin COMPU_METHOD MJ_ctltype_cmd_COMPU_VTAB "Verbal Table" TAB_VERB "%.0" "list" COMPU_TAB_REF MJ_ctltype_cmd_COMPU_VTAB_REF /end COMPU_METHOD
/begin COMPU_VTAB MJ_ctltype_cmd_COMPU_VTAB_REF "Verbal Table" TAB_VERB 4 0 "Pressure Cmd" 1 "Area Cmd" 2 "PA+FF or Pulsed" 3 "Offline" DEFAULT_VALUE "UNKNOWN" /end COMPU_VTAB
/begin MEASUREMENT MJ_ctltype_act "EPR control type feedback{MJ_ctltype_act&0xff=0:Pressure Cmd}{MJ_ctltype_act&0xff=1:Area Cmd}{MJ_ctltype_act&0xff=2:PA+FF or Pulsed}{MJ_ctltype_act&0xff=3:Offline}" UBYTE MJ_ctltype_act_COMPU_VTAB 0 0 0 255 ECU_ADDRESS 0x01002118 BIT_MASK 0xff /end MEASUREMENT
/begin COMPU_METHOD MJ_ctltype_act_COMPU_VTAB "Verbal Table" TAB_VERB "%.0" "list" COMPU_TAB_REF MJ_ctltype_act_COMPU_VTAB_REF /end COMPU_METHOD
/begin COMPU_VTAB MJ_ctltype_act_COMPU_VTAB_REF "Verbal Table" TAB_VERB 4 0 "Pressure Cmd" 1 "Area Cmd" 2 "PA+FF or Pulsed" 3 "Offline" DEFAULT_VALUE "UNKNOWN" /end COMPU_VTAB
/begin MEASUREMENT MJ_status "EPR status{MJ_status&0xff=0:Comm Lost}{MJ_status&0xff=1:OK}{MJ_status&0xff=2:Fault}" UBYTE MJ_status_COMPU_VTAB 0 0 0 255 ECU_ADDRESS 0x01002120 BIT_MASK 0xff /end MEASUREMENT
/begin COMPU_METHOD MJ_status_COMPU_VTAB "Verbal Table" TAB_VERB "%.0" "list" COMPU_TAB_REF MJ_status_COMPU_VTAB_REF /end COMPU_METHOD
/begin COMPU_VTAB MJ_status_COMPU_VTAB_REF "Verbal Table" TAB_VERB 3 0 "Comm Lost" 1 "OK" 2 "Fault" DEFAULT_VALUE "UNKNOWN" /end COMPU_VTAB
/begin CHARACTERISTIC MJ_Pin_P "EPR nominal inlet pressure" VALUE 0x001c0aee /* @ECU_Address@MJ_Pin_P@0x01002378@ */ ECIPP_ALIGNMENT_SWORD 222 Compu_MJ_Pin_P -222 221.993225097656 /end CHARACTERISTIC
/begin COMPU_METHOD Compu_MJ_Pin_P " " RAT_FUNC "%.2" "H2O" COEFFS 0 147.603603603604 0 0 0 1 /end COMPU_METHOD
/begin CHARACTERISTIC MJ_Pin_N "EPR nominal inlet pressure" VALUE 0x001c1a58 /* @ECU_Address@MJ_Pin_N@0x01002380@ */ ECIPP_ALIGNMENT_SWORD 222 Compu_MJ_Pin_N -222 221.993225097656 /end CHARACTERISTIC
/begin COMPU_METHOD Compu_MJ_Pin_N " " RAT_FUNC "%.2" "H2O" COEFFS 0 147.603603603604 0 0 0 1 /end COMPU_METHOD
/begin CHARACTERISTIC FT_def "Fuel temperature default" VALUE 0x001c7b94 /* @ECU_Address@FT_def@0x01002390@ */ ECIPP_ALIGNMENT_UWORD 564 Compu_FT_def -460 563.984375 /end CHARACTERISTIC
/begin COMPU_METHOD Compu_FT_def " " RAT_FUNC "%.1" "deg F" COEFFS 0 64 29440 0 0 1 /end COMPU_METHOD
/begin MEASUREMENT FT "Fuel regulator temperature" UWORD Compu_FT 0 0 -460 563.984375 ECU_ADDRESS 0x01002398 /end MEASUREMENT
/begin COMPU_METHOD Compu_FT " " RAT_FUNC "%.1" "deg F" COEFFS 0 64 29440 0 0 1 /end COMPU_METHOD
/begin CHARACTERISTIC EGO1delay "EGO response delay" VALUE 0x001c6ed4 /* @ECU_Address@EGO1delay@0x010025B8@ */ ECIPP_ALIGNMENT_UWORD 65535 Compu_EGO1delay 0 65535 /end CHARACTERISTIC
/begin COMPU_METHOD Compu_EGO1delay " " RAT_FUNC "%.0" "ms" COEFFS 0 1 0 0 0 1 /end COMPU_METHOD
/begin CHARACTERISTIC CL_temp_wait_mul "CL temp disable wait multiplier" VALUE 0x001c6e28 /* @ECU_Address@CL_temp_wait_mul@0x010025C0@ */ ECIPP_ALIGNMENT_UWORD 4096 Compu_CL_temp_wait_mul 0 4095.9375 /end CHARACTERISTIC
/begin COMPU_METHOD Compu_CL_temp_wait_mul " " RAT_FUNC "%.1" "multiplier" COEFFS 0 16 0 0 0 1 /end COMPU_METHOD
/begin CHARACTERISTIC AL_temp_wait_mul "AL temp disable wait multiplier" VALUE 0x001c6d5e /* @ECU_Address@AL_temp_wait_mul@0x010025C8@ */ ECIPP_ALIGNMENT_UWORD 4096 Compu_AL_temp_wait_mul 0 4095.9375 /end CHARACTERISTIC
/begin COMPU_METHOD Compu_AL_temp_wait_mul " " RAT_FUNC "%.1" "multiplier" COEFFS 0 16 0 0 0 1 /end COMPU_METHOD
/begin MEASUREMENT mdot_a_equcarb "Mdota carb equivalent" UWORD Compu_mdot_a_equcarb 0 0 0 1023.984375 ECU_ADDRESS 0x01002618 /end MEASUREMENT
/begin COMPU_METHOD Compu_mdot_a_equcarb " " RAT_FUNC "%.1" "g/sec" COEFFS 0 64 0 0 0 1 /end COMPU_METHOD
/begin CHARACTERISTIC FAstoich_s_G "Stoich F/A ratio standard" VALUE 0x001CA53E /* @ECU_Address@FAstoich_s_G@0x01002920@ */ ECIPP_ALIGNMENT_UWORD 0 Compu_FAstoich_s_G 0 0.124998092651367 /end CHARACTERISTIC
/begin COMPU_METHOD Compu_FAstoich_s_G " " RAT_FUNC "%.5" "-" COEFFS 0 524288 0 0 0 1 /end COMPU_METHOD
/begin CHARACTERISTIC FAstoich_s_P "Stoich F/A ratio standard" VALUE 0x001CA546 /* @ECU_Address@FAstoich_s_P@0x01002928@ */ ECIPP_ALIGNMENT_UWORD 0 Compu_FAstoich_s_P 0 0.124998092651367 /end CHARACTERISTIC
/begin COMPU_METHOD Compu_FAstoich_s_P " " RAT_FUNC "%.5" "-" COEFFS 0 524288 0 0 0 1 /end COMPU_METHOD
/begin CHARACTERISTIC FAstoich_s_N "Stoich F/A ratio standard" VALUE 0x001CA54E /* @ECU_Address@FAstoich_s_N@0x01002930@ */ ECIPP_ALIGNMENT_UWORD 0 Compu_FAstoich_s_N 0 0.124998092651367 /end CHARACTERISTIC
/begin COMPU_METHOD Compu_FAstoich_s_N " " RAT_FUNC "%.5" "-" COEFFS 0 524288 0 0 0 1 /end COMPU_METHOD
/begin CHARACTERISTIC FAstoich_a_G "Stoich F/A ratio actual" VALUE 0x001CA53C /* @ECU_Address@FAstoich_a_G@0x01002938@ */ ECIPP_ALIGNMENT_UWORD 0 Compu_FAstoich_a_G 0 0.124998092651367 /end CHARACTERISTIC
/begin COMPU_METHOD Compu_FAstoich_a_G " " RAT_FUNC "%.5" "-" COEFFS 0 524288 0 0 0 1 /end COMPU_METHOD
/begin CHARACTERISTIC FAstoich_a_P "Stoich F/A ratio actual" VALUE 0x001CA544 /* @ECU_Address@FAstoich_a_P@0x01002940@ */ ECIPP_ALIGNMENT_UWORD 0 Compu_FAstoich_a_P 0 0.124998092651367 /end CHARACTERISTIC
/begin COMPU_METHOD Compu_FAstoich_a_P " " RAT_FUNC "%.5" "-" COEFFS 0 524288 0 0 0 1 /end COMPU_METHOD
/begin CHARACTERISTIC FAstoich_a_N "Stoich F/A ratio actual" VALUE 0x001CA54C /* @ECU_Address@FAstoich_a_N@0x01002948@ */ ECIPP_ALIGNMENT_UWORD 0 Compu_FAstoich_a_N 0 0.124998092651367 /end CHARACTERISTIC
/begin COMPU_METHOD Compu_FAstoich_a_N " " RAT_FUNC "%.5" "-" COEFFS 0 524288 0 0 0 1 /end COMPU_METHOD
/begin MEASUREMENT trim_SG_FA_x "Trim fuel SG FAratio correction" UWORD Compu_trim_SG_FA_x 0 0 0 3.99993896484375 ECU_ADDRESS 0x01002950 /end MEASUREMENT
/begin COMPU_METHOD Compu_trim_SG_FA_x " " RAT_FUNC "%.3" "multiplier" COEFFS 0 16384 0 0 0 1 /end COMPU_METHOD
/begin CHARACTERISTIC SGf "Fuel specific gravity actual" VALUE 0x001CA538 /* @ECU_Address@SGf@0x01002958@ */ ECIPP_ALIGNMENT_UWORD 128 Compu_SGf 0 127.998046875 /end CHARACTERISTIC
/begin COMPU_METHOD Compu_SGf " " RAT_FUNC "%.3" "-" COEFFS 0 512 0 0 0 1 /end COMPU_METHOD
/begin CHARACTERISTIC SGfs "Fuel specific gravity standard" VALUE 0x001CA53A /* @ECU_Address@SGfs@0x01002960@ */ ECIPP_ALIGNMENT_UWORD 128 Compu_SGfs 0 127.998046875 /end CHARACTERISTIC
/begin COMPU_METHOD Compu_SGfs " " RAT_FUNC "%.3" "-" COEFFS 0 512 0 0 0 1 /end COMPU_METHOD
/begin CHARACTERISTIC SGf_LP "Fuel specific gravity actual" VALUE 0x001CA540 /* @ECU_Address@SGf_LP@0x01002968@ */ ECIPP_ALIGNMENT_UWORD 128 Compu_SGf_LP 0 127.998046875 /end CHARACTERISTIC
/begin COMPU_METHOD Compu_SGf_LP " " RAT_FUNC "%.3" "-" COEFFS 0 512 0 0 0 1 /end COMPU_METHOD
/begin CHARACTERISTIC SGfs_LP "Fuel specific gravity standard" VALUE 0x001CA542 /* @ECU_Address@SGfs_LP@0x01002970@ */ ECIPP_ALIGNMENT_UWORD 128 Compu_SGfs_LP 0 127.998046875 /end CHARACTERISTIC
/begin COMPU_METHOD Compu_SGfs_LP " " RAT_FUNC "%.3" "-" COEFFS 0 512 0 0 0 1 /end COMPU_METHOD
/begin CHARACTERISTIC SGf_NG "Fuel specific gravity actual" VALUE 0x001CA548 /* @ECU_Address@SGf_NG@0x01002978@ */ ECIPP_ALIGNMENT_UWORD 128 Compu_SGf_NG 0 127.998046875 /end CHARACTERISTIC
/begin COMPU_METHOD Compu_SGf_NG " " RAT_FUNC "%.3" "-" COEFFS 0 512 0 0 0 1 /end COMPU_METHOD
/begin CHARACTERISTIC SGfs_NG "Fuel specific gravity standard" VALUE 0x001CA54A /* @ECU_Address@SGfs_NG@0x01002980@ */ ECIPP_ALIGNMENT_UWORD 128 Compu_SGfs_NG 0 127.998046875 /end CHARACTERISTIC
/begin COMPU_METHOD Compu_SGfs_NG " " RAT_FUNC "%.3" "-" COEFFS 0 512 0 0 0 1 /end COMPU_METHOD
/begin MEASUREMENT Phi2_post_delt "Post-cat2 phi-target offset" SWORD Compu_Phi2_post_delt 0 0 -2 1.99993896484375 ECU_ADDRESS 0x010038D0 /end MEASUREMENT
/begin COMPU_METHOD Compu_Phi2_post_delt " " RAT_FUNC "%.3" "phi" COEFFS 0 16384 0 0 0 1 /end COMPU_METHOD
/begin MEASUREMENT CL2_Hp "CL2_Hp" UWORD Compu_CL2_Hp 0 0 0 99.9984741210938 ECU_ADDRESS 0x010038D8 /end MEASUREMENT
/begin COMPU_METHOD Compu_CL2_Hp " " RAT_FUNC "%.1" "%" COEFFS 0 655.36 0 0 0 1 /end COMPU_METHOD
/begin MEASUREMENT CL2_Hn "CL2_Hn" UWORD Compu_CL2_Hn 0 0 0 99.9984741210938 ECU_ADDRESS 0x010038E0 /end MEASUREMENT
/begin COMPU_METHOD Compu_CL2_Hn " " RAT_FUNC "%.1" "%" COEFFS 0 655.36 0 0 0 1 /end COMPU_METHOD
/begin MEASUREMENT CB2pre_DCd "Pre-cat EGO DC desired" UWORD Compu_CB2pre_DCd 0 0 0 199.996948242188 ECU_ADDRESS 0x010038F0 /end MEASUREMENT
/begin COMPU_METHOD Compu_CB2pre_DCd " " RAT_FUNC "%.1" "%" COEFFS 0 327.68 0 0 0 1 /end COMPU_METHOD
/begin MEASUREMENT CL2_E "CL2_E" UWORD Compu_CL2_E 0 0 0 199.996948242188 ECU_ADDRESS 0x010038F8 /end MEASUREMENT
/begin COMPU_METHOD Compu_CL2_E " " RAT_FUNC "%.1" "%" COEFFS 0 327.68 0 0 0 1 /end COMPU_METHOD
/begin MEASUREMENT EGO4_phiFB "EGO4 current phi" UWORD Compu_EGO4_phiFB 0 0 0 3.99993896484375 ECU_ADDRESS 0x01003910 /end MEASUREMENT
/begin COMPU_METHOD Compu_EGO4_phiFB " " RAT_FUNC "%.3" "phi" COEFFS 0 16384 0 0 0 1 /end COMPU_METHOD
/begin MEASUREMENT EGO4_phiFB_avg "EGO4 average phi" UWORD Compu_EGO4_phiFB_avg 0 0 0 3.99993896484375 ECU_ADDRESS 0x01003918 /end MEASUREMENT
/begin COMPU_METHOD Compu_EGO4_phiFB_avg " " RAT_FUNC "%.3" "phi" COEFFS 0 16384 0 0 0 1 /end COMPU_METHOD
/begin MEASUREMENT CL_bank_mode "Pre-cat CL bank mode{CL_bank_mode&0xff=0:Disabled}{CL_bank_mode&0xff=1:Single}{CL_bank_mode&0xff=2:Dual}{CL_bank_mode&0xff=3:Average}" UBYTE CL_bank_mode_COMPU_VTAB 0 0 0 255 ECU_ADDRESS 0x01003938 BIT_MASK 0xff /end MEASUREMENT
/begin COMPU_METHOD CL_bank_mode_COMPU_VTAB "Verbal Table" TAB_VERB "%.0" "list" COMPU_TAB_REF CL_bank_mode_COMPU_VTAB_REF /end COMPU_METHOD
/begin COMPU_VTAB CL_bank_mode_COMPU_VTAB_REF "Verbal Table" TAB_VERB 4 0 "Disabled" 1 "Single" 2 "Dual" 3 "Average" DEFAULT_VALUE "UNKNOWN" /end COMPU_VTAB
/begin MEASUREMENT Cat_bank_mode "Post-cat CL bank mode{Cat_bank_mode&0xff=0:Disabled}{Cat_bank_mode&0xff=1:Single}{Cat_bank_mode&0xff=2:Dual}" UBYTE Cat_bank_mode_COMPU_VTAB 0 0 0 255 ECU_ADDRESS 0x01003940 BIT_MASK 0xff /end MEASUREMENT
/begin COMPU_METHOD Cat_bank_mode_COMPU_VTAB "Verbal Table" TAB_VERB "%.0" "list" COMPU_TAB_REF Cat_bank_mode_COMPU_VTAB_REF /end COMPU_METHOD
/begin COMPU_VTAB Cat_bank_mode_COMPU_VTAB_REF "Verbal Table" TAB_VERB 3 0 "Disabled" 1 "Single" 2 "Dual" DEFAULT_VALUE "UNKNOWN" /end COMPU_VTAB
/begin MEASUREMENT EGO4_phiFB_dphidt "EGO4 derivative" SWORD Compu_EGO4_phiFB_dphidt 0 0 -0.125 0.124996185302734 ECU_ADDRESS 0x01003948 /end MEASUREMENT
/begin COMPU_METHOD Compu_EGO4_phiFB_dphidt " " RAT_FUNC "%.4" "dphi / T_delay" COEFFS 0 262144 0 0 0 1 /end COMPU_METHOD
/begin MEASUREMENT Phi1_pre_d "Phi pre-cat1 target" UWORD Compu_Phi1_pre_d 0 0 0 3.99993896484375 ECU_ADDRESS 0x01003950 /end MEASUREMENT
/begin COMPU_METHOD Compu_Phi1_pre_d " " RAT_FUNC "%.3" "-" COEFFS 0 16384 0 0 0 1 /end COMPU_METHOD
/begin MEASUREMENT Phi2_pre_d "Phi pre-cat2 target" UWORD Compu_Phi2_pre_d 0 0 0 3.99993896484375 ECU_ADDRESS 0x01003958 /end MEASUREMENT
/begin COMPU_METHOD Compu_Phi2_pre_d " " RAT_FUNC "%.3" "-" COEFFS 0 16384 0 0 0 1 /end COMPU_METHOD
/begin MEASUREMENT MJ_VVC_Tcrct "Variable venturi FRT/IAT dP multiplier" UWORD Compu_MJ_VVC_Tcrct 0 0 0 1.99996948242188 ECU_ADDRESS 0x01003E08 /end MEASUREMENT
/begin COMPU_METHOD Compu_MJ_VVC_Tcrct " " RAT_FUNC "%.3" "-" COEFFS 0 32768 0 0 0 1 /end COMPU_METHOD
/begin MEASUREMENT MJ_P_Tnom "EPR temp corrected nominal press" SWORD Compu_MJ_P_Tnom 0 0 -222 221.993225097656 ECU_ADDRESS 0x01003E10 /end MEASUREMENT
/begin COMPU_METHOD Compu_MJ_P_Tnom " " RAT_FUNC "%.2" "in H2O" COEFFS 0 147.603603603604 0 0 0 1 /end COMPU_METHOD
/begin MEASUREMENT m_a_perL "Air mass per liter displacement" UWORD Compu_m_a_perL 0 0 0 16383.75 ECU_ADDRESS 0x01003EC8 /end MEASUREMENT
/begin COMPU_METHOD Compu_m_a_perL " " RAT_FUNC "%.0" "mg/L-disp" COEFFS 0 4 0 0 0 1 /end COMPU_METHOD
/begin CHARACTERISTIC trim_load_src "Fuel trim calibration load axis{trim_load_src&0xff=0:MAP}{trim_load_src&0xff=1:Air mass/L-displacement}" VALUE 0x001c908f /* @ECU_Address@trim_load_src@0x01003ED0@ */ ECIPP_ALIGNMENT_UBYTE 255 trim_load_src_COMPU_VTAB 0 255 BIT_MASK 0xff /end CHARACTERISTIC
/begin COMPU_METHOD trim_load_src_COMPU_VTAB "Verbal Table" TAB_VERB "%.0" "list" COMPU_TAB_REF trim_load_src_COMPU_VTAB_REF /end COMPU_METHOD
/begin COMPU_VTAB trim_load_src_COMPU_VTAB_REF "Verbal Table" TAB_VERB 2 0 "MAP" 1 "Air mass/L-displacement" DEFAULT_VALUE "UNKNOWN" /end COMPU_VTAB
/begin CHARACTERISTIC trim_TIP_Vdot_comp "Fuel trim TIP-Vdot compensation{trim_TIP_Vdot_comp&0xff=0:Disabled}{trim_TIP_Vdot_comp&0xff=1:Enabled}" VALUE 0x001c908e /* @ECU_Address@trim_TIP_Vdot_comp@0x010040C0@ */ ECIPP_ALIGNMENT_UBYTE 255 trim_TIP_Vdot_comp_COMPU_VTAB 0 255 BIT_MASK 0xff /end CHARACTERISTIC
/begin COMPU_METHOD trim_TIP_Vdot_comp_COMPU_VTAB "Verbal Table" TAB_VERB "%.0" "list" COMPU_TAB_REF trim_TIP_Vdot_comp_COMPU_VTAB_REF /end COMPU_METHOD
/begin COMPU_VTAB trim_TIP_Vdot_comp_COMPU_VTAB_REF "Verbal Table" TAB_VERB 2 0 "Disabled" 1 "Enabled" DEFAULT_VALUE "UNKNOWN" /end COMPU_VTAB
/begin MEASUREMENT trim_MAP_Vdc "Fuel trim Vdot comp MAP" UWORD Compu_trim_MAP_Vdc 0 0 0 255.99609375 ECU_ADDRESS 0x010040E0 /end MEASUREMENT
/begin COMPU_METHOD Compu_trim_MAP_Vdc " " RAT_FUNC "%.2" "psia" COEFFS 0 256 0 0 0 1 /end COMPU_METHOD
/begin MEASUREMENT trim_m_a_Vdc "Fuel trim Vdot comp mdot air" UWORD Compu_trim_m_a_Vdc 0 0 0 16383.75 ECU_ADDRESS 0x010040E8 /end MEASUREMENT
/begin COMPU_METHOD Compu_trim_m_a_Vdc " " RAT_FUNC "%.0" "mg/Ld" COEFFS 0 4 0 0 0 1 /end COMPU_METHOD
/begin MEASUREMENT Phi_cmd_dly "Phi command delayed" UWORD Compu_Phi_cmd_dly 0 0 0 3.99993896484375 ECU_ADDRESS 0x010040F0 /end MEASUREMENT
/begin COMPU_METHOD Compu_Phi_cmd_dly " " RAT_FUNC "%.3" "-" COEFFS 0 16384 0 0 0 1 /end COMPU_METHOD
/begin MEASUREMENT CL_HW_disable "CL HW disable status{CL_HW_disable&0xff=0:CL Allowed}{CL_HW_disable&0xff=1:CL Disabled}" UBYTE CL_HW_disable_COMPU_VTAB 0 0 0 255 ECU_ADDRESS 0x01004330 BIT_MASK 0xff /end MEASUREMENT
/begin COMPU_METHOD CL_HW_disable_COMPU_VTAB "Verbal Table" TAB_VERB "%.0" "list" COMPU_TAB_REF CL_HW_disable_COMPU_VTAB_REF /end COMPU_METHOD
/begin COMPU_VTAB CL_HW_disable_COMPU_VTAB_REF "Verbal Table" TAB_VERB 2 0 "CL Allowed" 1 "CL Disabled" DEFAULT_VALUE "UNKNOWN" /end COMPU_VTAB
/begin CHARACTERISTIC CL_HW_dis_cfg "CL HW disable input config{CL_HW_dis_cfg&0xff=0:Disabled}{CL_HW_dis_cfg&0xff=1:Aux PU1}{CL_HW_dis_cfg&0xff=2:Aux PU2}{CL_HW_dis_cfg&0xff=3:Aux PU3}{CL_HW_dis_cfg&0xff=4:Aux PUD1}{CL_HW_dis_cfg&0xff=5:Aux PUD2}{CL_HW_dis_cfg&0xff=6:Aux PUD3}{CL_HW_dis_cfg&" VALUE 0x001c86a3 /* @ECU_Address@CL_HW_dis_cfg@0x01004338@ */ ECIPP_ALIGNMENT_UBYTE 255 CL_HW_dis_cfg_COMPU_VTAB 0 255 BIT_MASK 0xff /end CHARACTERISTIC
/begin COMPU_METHOD CL_HW_dis_cfg_COMPU_VTAB "Verbal Table" TAB_VERB "%.0" "list" COMPU_TAB_REF CL_HW_dis_cfg_COMPU_VTAB_REF /end COMPU_METHOD
/begin COMPU_VTAB CL_HW_dis_cfg_COMPU_VTAB_REF "Verbal Table" TAB_VERB 10 0 "Disabled" 1 "Aux PU1" 2 "Aux PU2" 3 "Aux PU3" 4 "Aux PUD1" 5 "Aux PUD2" 6 "Aux PUD3" 7 "Aux DIG1" 8 "Aux DIG2" 9 "Aux DIG3" DEFAULT_VALUE "UNKNOWN" /end COMPU_VTAB
/begin MEASUREMENT CL_fuellev_low "Low fuel monitoring status{CL_fuellev_low&0xff=0:OK}{CL_fuellev_low&0xff=1:Low Fuel}" UBYTE CL_fuellev_low_COMPU_VTAB 0 0 0 255 ECU_ADDRESS 0x01004348 BIT_MASK 0xff /end MEASUREMENT
/begin COMPU_METHOD CL_fuellev_low_COMPU_VTAB "Verbal Table" TAB_VERB "%.0" "list" COMPU_TAB_REF CL_fuellev_low_COMPU_VTAB_REF /end COMPU_METHOD
/begin COMPU_VTAB CL_fuellev_low_COMPU_VTAB_REF "Verbal Table" TAB_VERB 2 0 "OK" 1 "Low Fuel" DEFAULT_VALUE "UNKNOWN" /end COMPU_VTAB
/begin CHARACTERISTIC trim_tran_forceP "+Transient forced valve setpoint" VALUE 0x001c19be /* @ECU_Address@trim_tran_forceP@0x01004350@ */ ECIPP_ALIGNMENT_UWORD 100 Compu_trim_tran_forceP 0 99.9984741210938 /end CHARACTERISTIC
/begin COMPU_METHOD Compu_trim_tran_forceP " " RAT_FUNC "%.1" "%" COEFFS 0 655.36 0 0 0 1 /end COMPU_METHOD
/begin CHARACTERISTIC trim_tran_forceN "+Transient forced valve setpoint" VALUE 0x001c2928 /* @ECU_Address@trim_tran_forceN@0x01004358@ */ ECIPP_ALIGNMENT_UWORD 100 Compu_trim_tran_forceN 0 99.9984741210938 /end CHARACTERISTIC
/begin COMPU_METHOD Compu_trim_tran_forceN " " RAT_FUNC "%.1" "%" COEFFS 0 655.36 0 0 0 1 /end COMPU_METHOD
/begin CHARACTERISTIC trim_ntran_forceP "-Transient forced valve setpoint" VALUE 0x001c19bc /* @ECU_Address@trim_ntran_forceP@0x01004360@ */ ECIPP_ALIGNMENT_UWORD 100 Compu_trim_ntran_forceP 0 99.9984741210938 /end CHARACTERISTIC
/begin COMPU_METHOD Compu_trim_ntran_forceP " " RAT_FUNC "%.1" "%" COEFFS 0 655.36 0 0 0 1 /end COMPU_METHOD
/begin CHARACTERISTIC trim_ntran_forceN "-Transient forced valve setpoint" VALUE 0x001c2926 /* @ECU_Address@trim_ntran_forceN@0x01004368@ */ ECIPP_ALIGNMENT_UWORD 100 Compu_trim_ntran_forceN 0 99.9984741210938 /end CHARACTERISTIC
/begin COMPU_METHOD Compu_trim_ntran_forceN " " RAT_FUNC "%.1" "%" COEFFS 0 655.36 0 0 0 1 /end COMPU_METHOD
/begin MEASUREMENT TRIM_BM "TRIM BM" SWORD Compu_TRIM_BM 0 0 -100 99.9969482421875 ECU_ADDRESS 0x01004380 /end MEASUREMENT
/begin COMPU_METHOD Compu_TRIM_BM " " RAT_FUNC "%.1" "%" COEFFS 0 327.68 0 0 0 1 /end COMPU_METHOD
/begin MEASUREMENT TRIM_min_BM "TRIM min BM" SWORD Compu_TRIM_min_BM 0 0 -100 99.9969482421875 ECU_ADDRESS 0x01004388 /end MEASUREMENT
/begin COMPU_METHOD Compu_TRIM_min_BM " " RAT_FUNC "%.1" "%" COEFFS 0 327.68 0 0 0 1 /end COMPU_METHOD
/begin MEASUREMENT TRIM_max_BM "TRIM max BM" SWORD Compu_TRIM_max_BM 0 0 -100 99.9969482421875 ECU_ADDRESS 0x01004390 /end MEASUREMENT
/begin COMPU_METHOD Compu_TRIM_max_BM " " RAT_FUNC "%.1" "%" COEFFS 0 327.68 0 0 0 1 /end COMPU_METHOD
/begin CHARACTERISTIC CL_TD_enable "CL acquire transport delay{CL_TD_enable&0xff=0:Disabled}{CL_TD_enable&0xff=1:Enabled}" VALUE 0x001C34DA /* @ECU_Address@CL_TD_enable@0x01004A48@ */ ECIPP_ALIGNMENT_UBYTE 255 CL_TD_enable_COMPU_VTAB 0 255 BIT_MASK 0xff /end CHARACTERISTIC
/begin COMPU_METHOD CL_TD_enable_COMPU_VTAB "Verbal Table" TAB_VERB "%.0" "list" COMPU_TAB_REF CL_TD_enable_COMPU_VTAB_REF /end COMPU_METHOD
/begin COMPU_VTAB CL_TD_enable_COMPU_VTAB_REF "Verbal Table" TAB_VERB 2 0 "Disabled" 1 "Enabled" DEFAULT_VALUE "UNKNOWN" /end COMPU_VTAB
/begin CHARACTERISTIC CL_TD_max_p "CL acquire max rich overshoot" VALUE 0x001C34D2 /* @ECU_Address@CL_TD_max_p@0x01004A50@ */ ECIPP_ALIGNMENT_SWORD 100 Compu_CL_TD_max_p -100 99.9969482421875 /end CHARACTERISTIC
/begin COMPU_METHOD Compu_CL_TD_max_p " " RAT_FUNC "%.1" "%" COEFFS 0 327.68 0 0 0 1 /end COMPU_METHOD
/begin CHARACTERISTIC CL_TD_max_n "CL acquire max lean overshoot" VALUE 0x001C34D0 /* @ECU_Address@CL_TD_max_n@0x01004A58@ */ ECIPP_ALIGNMENT_SWORD 100 Compu_CL_TD_max_n -100 99.9969482421875 /end CHARACTERISTIC
/begin COMPU_METHOD Compu_CL_TD_max_n " " RAT_FUNC "%.1" "%" COEFFS 0 327.68 0 0 0 1 /end COMPU_METHOD
/begin CHARACTERISTIC CL_TD_EGOsw_ena "EGO switch acquisition mode{CL_TD_EGOsw_ena&0xff=0:Disabled}{CL_TD_EGOsw_ena&0xff=1:Enabled}" VALUE 0x001C34DB /* @ECU_Address@CL_TD_EGOsw_ena@0x01004A60@ */ ECIPP_ALIGNMENT_UBYTE 255 CL_TD_EGOsw_ena_COMPU_VTAB 0 255 BIT_MASK 0xff /end CHARACTERISTIC
/begin COMPU_METHOD CL_TD_EGOsw_ena_COMPU_VTAB "Verbal Table" TAB_VERB "%.0" "list" COMPU_TAB_REF CL_TD_EGOsw_ena_COMPU_VTAB_REF /end COMPU_METHOD
/begin COMPU_VTAB CL_TD_EGOsw_ena_COMPU_VTAB_REF "Verbal Table" TAB_VERB 2 0 "Disabled" 1 "Enabled" DEFAULT_VALUE "UNKNOWN" /end COMPU_VTAB
/begin CHARACTERISTIC CL_TD_sw_offset "EGO switch delay offset" VALUE 0x001C34D4 /* @ECU_Address@CL_TD_sw_offset@0x01004A68@ */ ECIPP_ALIGNMENT_SWORD 100 Compu_CL_TD_sw_offset -100 99.9969482421875 /end CHARACTERISTIC
/begin COMPU_METHOD Compu_CL_TD_sw_offset " " RAT_FUNC "%.1" "%" COEFFS 0 327.68 0 0 0 1 /end COMPU_METHOD
/begin CHARACTERISTIC CL_TD_sw_pct "EGO switch initial step" VALUE 0x001C34D6 /* @ECU_Address@CL_TD_sw_pct@0x01004A70@ */ ECIPP_ALIGNMENT_UWORD 200 Compu_CL_TD_sw_pct 0 199.996948242188 /end CHARACTERISTIC
/begin COMPU_METHOD Compu_CL_TD_sw_pct " " RAT_FUNC "%.1" "%" COEFFS 0 327.68 0 0 0 1 /end COMPU_METHOD
/begin CHARACTERISTIC CLLP_TD_enable "CL acquire transport delay{CLLP_TD_enable&0xff=0:Disabled}{CLLP_TD_enable&0xff=1:Enabled}" VALUE 0x001C1A1E /* @ECU_Address@CLLP_TD_enable@0x01004A78@ */ ECIPP_ALIGNMENT_UBYTE 255 CLLP_TD_enable_COMPU_VTAB 0 255 BIT_MASK 0xff /end CHARACTERISTIC
/begin COMPU_METHOD CLLP_TD_enable_COMPU_VTAB "Verbal Table" TAB_VERB "%.0" "list" COMPU_TAB_REF CLLP_TD_enable_COMPU_VTAB_REF /end COMPU_METHOD
/begin COMPU_VTAB CLLP_TD_enable_COMPU_VTAB_REF "Verbal Table" TAB_VERB 2 0 "Disabled" 1 "Enabled" DEFAULT_VALUE "UNKNOWN" /end COMPU_VTAB
/begin CHARACTERISTIC CLLP_TD_max_p "CL acquire max rich overshoot" VALUE 0x001C1A16 /* @ECU_Address@CLLP_TD_max_p@0x01004A80@ */ ECIPP_ALIGNMENT_SWORD 100 Compu_CLLP_TD_max_p -100 99.9969482421875 /end CHARACTERISTIC
/begin COMPU_METHOD Compu_CLLP_TD_max_p " " RAT_FUNC "%.1" "%" COEFFS 0 327.68 0 0 0 1 /end COMPU_METHOD
/begin CHARACTERISTIC CLLP_TD_max_n "CL acquire max lean overshoot" VALUE 0x001C1A14 /* @ECU_Address@CLLP_TD_max_n@0x01004A88@ */ ECIPP_ALIGNMENT_SWORD 100 Compu_CLLP_TD_max_n -100 99.9969482421875 /end CHARACTERISTIC
/begin COMPU_METHOD Compu_CLLP_TD_max_n " " RAT_FUNC "%.1" "%" COEFFS 0 327.68 0 0 0 1 /end COMPU_METHOD
/begin CHARACTERISTIC CLLP_TD_EGOsw_ena "EGO switch acquisition mode{CLLP_TD_EGOsw_ena&0xff=0:Disabled}{CLLP_TD_EGOsw_ena&0xff=1:Enabled}" VALUE 0x001C1A1F /* @ECU_Address@CLLP_TD_EGOsw_ena@0x01004A90@ */ ECIPP_ALIGNMENT_UBYTE 255 CLLP_TD_EGOsw_ena_COMPU_VTAB 0 255 BIT_MASK 0xff /end CHARACTERISTIC
/begin COMPU_METHOD CLLP_TD_EGOsw_ena_COMPU_VTAB "Verbal Table" TAB_VERB "%.0" "list" COMPU_TAB_REF CLLP_TD_EGOsw_ena_COMPU_VTAB_REF /end COMPU_METHOD
/begin COMPU_VTAB CLLP_TD_EGOsw_ena_COMPU_VTAB_REF "Verbal Table" TAB_VERB 2 0 "Disabled" 1 "Enabled" DEFAULT_VALUE "UNKNOWN" /end COMPU_VTAB
/begin CHARACTERISTIC CLLP_TD_sw_offset "EGO switch delay offset" VALUE 0x001C1A18 /* @ECU_Address@CLLP_TD_sw_offset@0x01004A98@ */ ECIPP_ALIGNMENT_SWORD 100 Compu_CLLP_TD_sw_offset -100 99.9969482421875 /end CHARACTERISTIC
/begin COMPU_METHOD Compu_CLLP_TD_sw_offset " " RAT_FUNC "%.1" "%" COEFFS 0 327.68 0 0 0 1 /end COMPU_METHOD
/begin CHARACTERISTIC CLLP_TD_sw_pct "EGO switch initial step" VALUE 0x001C1A1A /* @ECU_Address@CLLP_TD_sw_pct@0x01004AA0@ */ ECIPP_ALIGNMENT_UWORD 200 Compu_CLLP_TD_sw_pct 0 199.996948242188 /end CHARACTERISTIC
/begin COMPU_METHOD Compu_CLLP_TD_sw_pct " " RAT_FUNC "%.1" "%" COEFFS 0 327.68 0 0 0 1 /end COMPU_METHOD
/begin CHARACTERISTIC CLNG_TD_enable "CL acquire transport delay{CLNG_TD_enable&0xff=0:Disabled}{CLNG_TD_enable&0xff=1:Enabled}" VALUE 0x001C2988 /* @ECU_Address@CLNG_TD_enable@0x01004AA8@ */ ECIPP_ALIGNMENT_UBYTE 255 CLNG_TD_enable_COMPU_VTAB 0 255 BIT_MASK 0xff /end CHARACTERISTIC
/begin COMPU_METHOD CLNG_TD_enable_COMPU_VTAB "Verbal Table" TAB_VERB "%.0" "list" COMPU_TAB_REF CLNG_TD_enable_COMPU_VTAB_REF /end COMPU_METHOD
/begin COMPU_VTAB CLNG_TD_enable_COMPU_VTAB_REF "Verbal Table" TAB_VERB 2 0 "Disabled" 1 "Enabled" DEFAULT_VALUE "UNKNOWN" /end COMPU_VTAB
/begin CHARACTERISTIC CLNG_TD_max_p "CL acquire max rich overshoot" VALUE 0x001C2980 /* @ECU_Address@CLNG_TD_max_p@0x01004AB0@ */ ECIPP_ALIGNMENT_SWORD 100 Compu_CLNG_TD_max_p -100 99.9969482421875 /end CHARACTERISTIC
/begin COMPU_METHOD Compu_CLNG_TD_max_p " " RAT_FUNC "%.1" "%" COEFFS 0 327.68 0 0 0 1 /end COMPU_METHOD
/begin CHARACTERISTIC CLNG_TD_max_n "CL acquire max lean overshoot" VALUE 0x001C297E /* @ECU_Address@CLNG_TD_max_n@0x01004AB8@ */ ECIPP_ALIGNMENT_SWORD 100 Compu_CLNG_TD_max_n -100 99.9969482421875 /end CHARACTERISTIC
/begin COMPU_METHOD Compu_CLNG_TD_max_n " " RAT_FUNC "%.1" "%" COEFFS 0 327.68 0 0 0 1 /end COMPU_METHOD
/begin CHARACTERISTIC CLNG_TD_EGOsw_ena "EGO switch acquisition mode{CLNG_TD_EGOsw_ena&0xff=0:Disabled}{CLNG_TD_EGOsw_ena&0xff=1:Enabled}" VALUE 0x001C2989 /* @ECU_Address@CLNG_TD_EGOsw_ena@0x01004AC0@ */ ECIPP_ALIGNMENT_UBYTE 255 CLNG_TD_EGOsw_ena_COMPU_VTAB 0 255 BIT_MASK 0xff /end CHARACTERISTIC
/begin COMPU_METHOD CLNG_TD_EGOsw_ena_COMPU_VTAB "Verbal Table" TAB_VERB "%.0" "list" COMPU_TAB_REF CLNG_TD_EGOsw_ena_COMPU_VTAB_REF /end COMPU_METHOD
/begin COMPU_VTAB CLNG_TD_EGOsw_ena_COMPU_VTAB_REF "Verbal Table" TAB_VERB 2 0 "Disabled" 1 "Enabled" DEFAULT_VALUE "UNKNOWN" /end COMPU_VTAB
/begin CHARACTERISTIC CLNG_TD_sw_offset "EGO switch delay offset" VALUE 0x001C2982 /* @ECU_Address@CLNG_TD_sw_offset@0x01004AC8@ */ ECIPP_ALIGNMENT_SWORD 100 Compu_CLNG_TD_sw_offset -100 99.9969482421875 /end CHARACTERISTIC
/begin COMPU_METHOD Compu_CLNG_TD_sw_offset " " RAT_FUNC "%.1" "%" COEFFS 0 327.68 0 0 0 1 /end COMPU_METHOD
/begin CHARACTERISTIC CLNG_TD_sw_pct "EGO switch initial step" VALUE 0x001C2984 /* @ECU_Address@CLNG_TD_sw_pct@0x01004AD0@ */ ECIPP_ALIGNMENT_UWORD 200 Compu_CLNG_TD_sw_pct 0 199.996948242188 /end CHARACTERISTIC
/begin COMPU_METHOD Compu_CLNG_TD_sw_pct " " RAT_FUNC "%.1" "%" COEFFS 0 327.68 0 0 0 1 /end COMPU_METHOD
/begin MEASUREMENT MAPrsc_trim "BP rescaled MAP trim index" UWORD Compu_MAPrsc_trim 0 0 0 255.99609375 ECU_ADDRESS 0x01004B38 /end MEASUREMENT
/begin COMPU_METHOD Compu_MAPrsc_trim " " RAT_FUNC "%.2" "psia" COEFFS 0 256 0 0 0 1 /end COMPU_METHOD
/begin MEASUREMENT MAPrsc_max_trim "Max MAP for BP-MAP trim rescaling" UWORD Compu_MAPrsc_max_trim 0 0 0 255.99609375 ECU_ADDRESS 0x01004B48 /end MEASUREMENT
/begin COMPU_METHOD Compu_MAPrsc_max_trim " " RAT_FUNC "%.2" "psia" COEFFS 0 256 0 0 0 1 /end COMPU_METHOD
/begin CHARACTERISTIC MAPrsc_min_trim "Min MAP for BP-MAP trim rescaling" VALUE 0x001c7d60 /* @ECU_Address@MAPrsc_min_trim@0x01004B58@ */ ECIPP_ALIGNMENT_UWORD 256 Compu_MAPrsc_min_trim 0 255.99609375 /end CHARACTERISTIC
/begin COMPU_METHOD Compu_MAPrsc_min_trim " " RAT_FUNC "%.2" "psia" COEFFS 0 256 0 0 0 1 /end COMPU_METHOD
/begin CHARACTERISTIC CL_rst_postcat "Postcat inactive delta-phi reset{CL_rst_postcat&0xff=0:Do not reset}{CL_rst_postcat&0xff=1:Reset temporarily}{CL_rst_postcat&0xff=2:Reset completely}" VALUE 0x001C34DD /* @ECU_Address@CL_rst_postcat@0x01005048@ */ ECIPP_ALIGNMENT_UBYTE 255 CL_rst_postcat_COMPU_VTAB 0 255 BIT_MASK 0xff /end CHARACTERISTIC
/begin COMPU_METHOD CL_rst_postcat_COMPU_VTAB "Verbal Table" TAB_VERB "%.0" "list" COMPU_TAB_REF CL_rst_postcat_COMPU_VTAB_REF /end COMPU_METHOD
/begin COMPU_VTAB CL_rst_postcat_COMPU_VTAB_REF "Verbal Table" TAB_VERB 3 0 "Do not reset" 1 "Reset temporarily" 2 "Reset completely" DEFAULT_VALUE "UNKNOWN" /end COMPU_VTAB
/begin CHARACTERISTIC CLLP_rst_postcat "Postcat inactive delta-phi reset{CLLP_rst_postcat&0xff=0:Do not reset}{CLLP_rst_postcat&0xff=1:Reset temporarily}{CLLP_rst_postcat&0xff=2:Reset completely}" VALUE 0x001C1A21 /* @ECU_Address@CLLP_rst_postcat@0x01005050@ */ ECIPP_ALIGNMENT_UBYTE 255 CLLP_rst_postcat_COMPU_VTAB 0 255 BIT_MASK 0xff /end CHARACTERISTIC
/begin COMPU_METHOD CLLP_rst_postcat_COMPU_VTAB "Verbal Table" TAB_VERB "%.0" "list" COMPU_TAB_REF CLLP_rst_postcat_COMPU_VTAB_REF /end COMPU_METHOD
/begin COMPU_VTAB CLLP_rst_postcat_COMPU_VTAB_REF "Verbal Table" TAB_VERB 3 0 "Do not reset" 1 "Reset temporarily" 2 "Reset completely" DEFAULT_VALUE "UNKNOWN" /end COMPU_VTAB
/begin CHARACTERISTIC CLNG_rst_postcat "Postcat inactive delta-phi reset{CLNG_rst_postcat&0xff=0:Do not reset}{CLNG_rst_postcat&0xff=1:Reset temporarily}{CLNG_rst_postcat&0xff=2:Reset completely}" VALUE 0x001C298B /* @ECU_Address@CLNG_rst_postcat@0x01005058@ */ ECIPP_ALIGNMENT_UBYTE 255 CLNG_rst_postcat_COMPU_VTAB 0 255 BIT_MASK 0xff /end CHARACTERISTIC
/begin COMPU_METHOD CLNG_rst_postcat_COMPU_VTAB "Verbal Table" TAB_VERB "%.0" "list" COMPU_TAB_REF CLNG_rst_postcat_COMPU_VTAB_REF /end COMPU_METHOD
/begin COMPU_VTAB CLNG_rst_postcat_COMPU_VTAB_REF "Verbal Table" TAB_VERB 3 0 "Do not reset" 1 "Reset temporarily" 2 "Reset completely" DEFAULT_VALUE "UNKNOWN" /end COMPU_VTAB
/begin CHARACTERISTIC CL_TD_mdota "CL acquire min port air flow rate" VALUE 0x001C34D8 /* @ECU_Address@CL_TD_mdota@0x01005EB8@ */ ECIPP_ALIGNMENT_UWORD 1024 Compu_CL_TD_mdota 0 1023.984375 /end CHARACTERISTIC
/begin COMPU_METHOD Compu_CL_TD_mdota " " RAT_FUNC "%.1" "g/sec" COEFFS 0 64 0 0 0 1 /end COMPU_METHOD
/begin CHARACTERISTIC CLLP_TD_mdota "CL acquire min port air flow rate" VALUE 0x001C1A1C /* @ECU_Address@CLLP_TD_mdota@0x01005EC0@ */ ECIPP_ALIGNMENT_UWORD 1024 Compu_CLLP_TD_mdota 0 1023.984375 /end CHARACTERISTIC
/begin COMPU_METHOD Compu_CLLP_TD_mdota " " RAT_FUNC "%.1" "g/sec" COEFFS 0 64 0 0 0 1 /end COMPU_METHOD
/begin CHARACTERISTIC CLNG_TD_mdota "CL acquire min port air flow rate" VALUE 0x001C2986 /* @ECU_Address@CLNG_TD_mdota@0x01005EC8@ */ ECIPP_ALIGNMENT_UWORD 1024 Compu_CLNG_TD_mdota 0 1023.984375 /end CHARACTERISTIC
/begin COMPU_METHOD Compu_CLNG_TD_mdota " " RAT_FUNC "%.1" "g/sec" COEFFS 0 64 0 0 0 1 /end COMPU_METHOD
/begin CHARACTERISTIC CL_control_type "CL control type{CL_control_type&0xff=0:Switching (EGO or UEGO)}{CL_control_type&0xff=1:Continuous (UEGO Only)}" VALUE 0x001c86a4 /* @ECU_Address@CL_control_type@0x01005FE0@ */ ECIPP_ALIGNMENT_UBYTE 255 CL_control_type_COMPU_VTAB 0 255 BIT_MASK 0xff /end CHARACTERISTIC
/begin COMPU_METHOD CL_control_type_COMPU_VTAB "Verbal Table" TAB_VERB "%.0" "list" COMPU_TAB_REF CL_control_type_COMPU_VTAB_REF /end COMPU_METHOD
/begin COMPU_VTAB CL_control_type_COMPU_VTAB_REF "Verbal Table" TAB_VERB 2 0 "Switching (EGO or UEGO)" 1 "Continuous (UEGO Only)" DEFAULT_VALUE "UNKNOWN" /end COMPU_VTAB
/begin CHARACTERISTIC MJ_nom_crkslwdP "Cranking final/slewed EPR setpoint" VALUE 0x001c0af2 /* @ECU_Address@MJ_nom_crkslwdP@0x01006A28@ */ ECIPP_ALIGNMENT_SWORD 222 Compu_MJ_nom_crkslwdP -222 221.993225097656 /end CHARACTERISTIC
/begin COMPU_METHOD Compu_MJ_nom_crkslwdP " " RAT_FUNC "%.2" "in H2O" COEFFS 0 147.603603603604 0 0 0 1 /end COMPU_METHOD
/begin CHARACTERISTIC MJ_nom_crkslwdN "Cranking final/slewed EPR setpoint" VALUE 0x001c1a5c /* @ECU_Address@MJ_nom_crkslwdN@0x01006A30@ */ ECIPP_ALIGNMENT_SWORD 222 Compu_MJ_nom_crkslwdN -222 221.993225097656 /end CHARACTERISTIC
/begin COMPU_METHOD Compu_MJ_nom_crkslwdN " " RAT_FUNC "%.2" "in H2O" COEFFS 0 147.603603603604 0 0 0 1 /end COMPU_METHOD
/begin CHARACTERISTIC MJ_crk_holdP "Cranking initial EPR setpoint hold" VALUE 0x001c19aa /* @ECU_Address@MJ_crk_holdP@0x01006A38@ */ ECIPP_ALIGNMENT_UWORD 256 Compu_MJ_crk_holdP 0 255.99609375 /end CHARACTERISTIC
/begin COMPU_METHOD Compu_MJ_crk_holdP " " RAT_FUNC "%.2" "cycles" COEFFS 0 256 0 0 0 1 /end COMPU_METHOD
/begin CHARACTERISTIC MJ_crk_slewP "Cranking transition EPR setpoint slew" VALUE 0x001c19ae /* @ECU_Address@MJ_crk_slewP@0x01006A40@ */ ECIPP_ALIGNMENT_UWORD 256 Compu_MJ_crk_slewP 0 255.99609375 /end CHARACTERISTIC
/begin COMPU_METHOD Compu_MJ_crk_slewP " " RAT_FUNC "%.2" "cycles" COEFFS 0 256 0 0 0 1 /end COMPU_METHOD
/begin CHARACTERISTIC MJ_crk_holdN "Cranking initial EPR setpoint hold" VALUE 0x001c2914 /* @ECU_Address@MJ_crk_holdN@0x01006A48@ */ ECIPP_ALIGNMENT_UWORD 256 Compu_MJ_crk_holdN 0 255.99609375 /end CHARACTERISTIC
/begin COMPU_METHOD Compu_MJ_crk_holdN " " RAT_FUNC "%.2" "cycles" COEFFS 0 256 0 0 0 1 /end COMPU_METHOD
/begin CHARACTERISTIC MJ_crk_slewN "Cranking transition EPR setpoint slew" VALUE 0x001c2918 /* @ECU_Address@MJ_crk_slewN@0x01006A50@ */ ECIPP_ALIGNMENT_UWORD 256 Compu_MJ_crk_slewN 0 255.99609375 /end CHARACTERISTIC
/begin COMPU_METHOD Compu_MJ_crk_slewN " " RAT_FUNC "%.2" "cycles" COEFFS 0 256 0 0 0 1 /end COMPU_METHOD
/begin CHARACTERISTIC MJ_crk_run_slewP "Run mode EPR maximum slew" VALUE 0x001c19ac /* @ECU_Address@MJ_crk_run_slewP@0x01007830@ */ ECIPP_ALIGNMENT_UWORD 444 Compu_MJ_crk_run_slewP 0 443.993225097656 /end CHARACTERISTIC
/begin COMPU_METHOD Compu_MJ_crk_run_slewP " " RAT_FUNC "%.2" "H20" COEFFS 0 147.603603603604 0 0 0 1 /end COMPU_METHOD
/begin CHARACTERISTIC MJ_crk_run_slewN "Run mode EPR maximum slew" VALUE 0x001c2916 /* @ECU_Address@MJ_crk_run_slewN@0x01007838@ */ ECIPP_ALIGNMENT_UWORD 444 Compu_MJ_crk_run_slewN 0 443.993225097656 /end CHARACTERISTIC
/begin COMPU_METHOD Compu_MJ_crk_run_slewN " " RAT_FUNC "%.2" "H20" COEFFS 0 147.603603603604 0 0 0 1 /end COMPU_METHOD
/begin CHARACTERISTIC CLacq_lmt_step "Fast CL Acquire Step Limiting{CLacq_lmt_step&0xff=0:Disabled}{CLacq_lmt_step&0xff=1:Enabled}" VALUE 0x001c86aa /* @ECU_Address@CLacq_lmt_step@0x01007860@ */ ECIPP_ALIGNMENT_UBYTE 255 CLacq_lmt_step_COMPU_VTAB 0 255 BIT_MASK 0xff /end CHARACTERISTIC
/begin COMPU_METHOD CLacq_lmt_step_COMPU_VTAB "Verbal Table" TAB_VERB "%.0" "list" COMPU_TAB_REF CLacq_lmt_step_COMPU_VTAB_REF /end COMPU_METHOD
/begin COMPU_VTAB CLacq_lmt_step_COMPU_VTAB_REF "Verbal Table" TAB_VERB 2 0 "Disabled" 1 "Enabled" DEFAULT_VALUE "UNKNOWN" /end COMPU_VTAB
/begin MEASUREMENT Phi_UEGO2 "UEGO phi" UWORD Compu_Phi_UEGO2 0 0 0 3.99993896484375 ECU_ADDRESS 0x01007D50 /end MEASUREMENT
/begin COMPU_METHOD Compu_Phi_UEGO2 " " RAT_FUNC "%.3" "phi" COEFFS 0 16384 0 0 0 1 /end COMPU_METHOD
/begin MEASUREMENT UEGO2_mode "UEGO mode{UEGO2_mode&0xff=0xfe:Invalid}{UEGO2_mode&0xff=0xff:Fault}{UEGO2_mode&0xff=0x00:Off}{UEGO2_mode&0xff=0x01:Warming}{UEGO2_mode&0xff=0x02:Waiting}{UEGO2_mode&0xff=0x03:Active}" UBYTE UEGO2_mode_COMPU_VTAB 0 0 0 255 ECU_ADDRESS 0x01007D60 BIT_MASK 0xff /end MEASUREMENT
/begin COMPU_METHOD UEGO2_mode_COMPU_VTAB "Verbal Table" TAB_VERB "%.0" "list" COMPU_TAB_REF UEGO2_mode_COMPU_VTAB_REF /end COMPU_METHOD
/begin COMPU_VTAB UEGO2_mode_COMPU_VTAB_REF "Verbal Table" TAB_VERB 6 0xfe "Invalid" 0xff "Fault" 0x00 "Off" 0x01 "Warming" 0x02 "Waiting" 0x03 "Active" DEFAULT_VALUE "UNKNOWN" /end COMPU_VTAB
/begin CHARACTERISTIC CL_switch_type "CL switching type{CL_switch_type&0xff=0:Legacy Asymmetric (EGO or UEGO)}{CL_switch_type&0xff=1:Corrected Asymmetric (EGO or UEGO)}{CL_switch_type&0xff=2:Symmetric (UEGO Only)}" VALUE 0x001c86a9 /* @ECU_Address@CL_switch_type@0x01008CA8@ */ ECIPP_ALIGNMENT_UBYTE 255 CL_switch_type_COMPU_VTAB 0 255 BIT_MASK 0xff /end CHARACTERISTIC
/begin COMPU_METHOD CL_switch_type_COMPU_VTAB "Verbal Table" TAB_VERB "%.0" "list" COMPU_TAB_REF CL_switch_type_COMPU_VTAB_REF /end COMPU_METHOD
/begin COMPU_VTAB CL_switch_type_COMPU_VTAB_REF "Verbal Table" TAB_VERB 3 0 "Legacy Asymmetric (EGO or UEGO)" 1 "Corrected Asymmetric (EGO or UEGO)" 2 "Symmetric (UEGO Only)" DEFAULT_VALUE "UNKNOWN" /end COMPU_VTAB
/begin MEASUREMENT CRI_mg_main_cld "Cold main quantity offset" SWORD Compu_CRI_mg_main_cld 0 0 -1024 1023.96875 ECU_ADDRESS 0x0100A080 /end MEASUREMENT
/begin COMPU_METHOD Compu_CRI_mg_main_cld " " RAT_FUNC "%.1" "mg/stroke" COEFFS 0 32 0 0 0 1 /end COMPU_METHOD
/begin MEASUREMENT CRI_mg_pilot2_cld "Cold pilot 2 quantity offset" SWORD Compu_CRI_mg_pilot2_cld 0 0 -1024 1023.96875 ECU_ADDRESS 0x0100A088 /end MEASUREMENT
/begin COMPU_METHOD Compu_CRI_mg_pilot2_cld " " RAT_FUNC "%.1" "mg/stroke" COEFFS 0 32 0 0 0 1 /end COMPU_METHOD
/begin MEASUREMENT CRI_mg_pilot1_cld "Cold pilot 1 quantity offset" SWORD Compu_CRI_mg_pilot1_cld 0 0 -1024 1023.96875 ECU_ADDRESS 0x0100A090 /end MEASUREMENT
/begin COMPU_METHOD Compu_CRI_mg_pilot1_cld " " RAT_FUNC "%.1" "mg/stroke" COEFFS 0 32 0 0 0 1 /end COMPU_METHOD
/begin MEASUREMENT CRI_mg_post1_cld "Cold post 1 quantity offset" SWORD Compu_CRI_mg_post1_cld 0 0 -1024 1023.96875 ECU_ADDRESS 0x0100A098 /end MEASUREMENT
/begin COMPU_METHOD Compu_CRI_mg_post1_cld " " RAT_FUNC "%.1" "mg/stroke" COEFFS 0 32 0 0 0 1 /end COMPU_METHOD
/begin MEASUREMENT CRI_mg_post2_cld "Cold post 2 quantity offset" SWORD Compu_CRI_mg_post2_cld 0 0 -1024 1023.96875 ECU_ADDRESS 0x0100A0A0 /end MEASUREMENT
/begin COMPU_METHOD Compu_CRI_mg_post2_cld " " RAT_FUNC "%.1" "mg/stroke" COEFFS 0 32 0 0 0 1 /end COMPU_METHOD
/begin MEASUREMENT CRI_cad_main_cld "Cold main  timing offset" SWORD Compu_CRI_cad_main_cld 0 0 -2048 2047.9375 ECU_ADDRESS 0x0100A0A8 /end MEASUREMENT
/begin COMPU_METHOD Compu_CRI_cad_main_cld " " RAT_FUNC "%.1" "CAD" COEFFS 0 16 0 0 0 1 /end COMPU_METHOD
/begin MEASUREMENT CRI_cad_pilot2_cld "Cold pilot 2 timing offset" SWORD Compu_CRI_cad_pilot2_cld 0 0 -2048 2047.9375 ECU_ADDRESS 0x0100A0B0 /end MEASUREMENT
/begin COMPU_METHOD Compu_CRI_cad_pilot2_cld " " RAT_FUNC "%.1" "CAD" COEFFS 0 16 0 0 0 1 /end COMPU_METHOD
/begin MEASUREMENT CRI_cad_pilot1_cld "Cold pilot 1 timing offset" SWORD Compu_CRI_cad_pilot1_cld 0 0 -2048 2047.9375 ECU_ADDRESS 0x0100A0B8 /end MEASUREMENT
/begin COMPU_METHOD Compu_CRI_cad_pilot1_cld " " RAT_FUNC "%.1" "CAD" COEFFS 0 16 0 0 0 1 /end COMPU_METHOD
/begin MEASUREMENT CRI_cad_post1_cld "Cold post 1 timing offset" SWORD Compu_CRI_cad_post1_cld 0 0 -2048 2047.9375 ECU_ADDRESS 0x0100A0C0 /end MEASUREMENT
/begin COMPU_METHOD Compu_CRI_cad_post1_cld " " RAT_FUNC "%.1" "CAD" COEFFS 0 16 0 0 0 1 /end COMPU_METHOD
/begin MEASUREMENT CRI_cad_post2_cld "Cold post 2 timing offset" SWORD Compu_CRI_cad_post2_cld 0 0 -2048 2047.9375 ECU_ADDRESS 0x0100A0C8 /end MEASUREMENT
/begin COMPU_METHOD Compu_CRI_cad_post2_cld " " RAT_FUNC "%.1" "CAD" COEFFS 0 16 0 0 0 1 /end COMPU_METHOD
/begin CHARACTERISTIC CRI_Tpilot2_type "Pilot 2 timing type{CRI_Tpilot2_type&0xff=0:(CAD BTDCC)}{CRI_Tpilot2_type&0xff=1:(us before main)}{CRI_Tpilot2_type&0xff=2:(us before pilot 1)}" VALUE 0x001f19cd /* @ECU_Address@CRI_Tpilot2_type@0x0100A2F0@ */ ECIPP_ALIGNMENT_UBYTE 255 CRI_Tpilot2_type_COMPU_VTAB 0 255 BIT_MASK 0xff /end CHARACTERISTIC
/begin COMPU_METHOD CRI_Tpilot2_type_COMPU_VTAB "Verbal Table" TAB_VERB "%.0" "list" COMPU_TAB_REF CRI_Tpilot2_type_COMPU_VTAB_REF /end COMPU_METHOD
/begin COMPU_VTAB CRI_Tpilot2_type_COMPU_VTAB_REF "Verbal Table" TAB_VERB 3 0 "(CAD BTDCC)" 1 "(us before main)" 2 "(us before pilot 1)" DEFAULT_VALUE "UNKNOWN" /end COMPU_VTAB
/begin CHARACTERISTIC CRI_Tpilot1_type "Pilot 1 timing type{CRI_Tpilot1_type&0xff=0:(CAD BTDCC)}{CRI_Tpilot1_type&0xff=1:(us before main)}" VALUE 0x001f19c2 /* @ECU_Address@CRI_Tpilot1_type@0x0100A2F8@ */ ECIPP_ALIGNMENT_UBYTE 255 CRI_Tpilot1_type_COMPU_VTAB 0 255 BIT_MASK 0xff /end CHARACTERISTIC
/begin COMPU_METHOD CRI_Tpilot1_type_COMPU_VTAB "Verbal Table" TAB_VERB "%.0" "list" COMPU_TAB_REF CRI_Tpilot1_type_COMPU_VTAB_REF /end COMPU_METHOD
/begin COMPU_VTAB CRI_Tpilot1_type_COMPU_VTAB_REF "Verbal Table" TAB_VERB 2 0 "(CAD BTDCC)" 1 "(us before main)" DEFAULT_VALUE "UNKNOWN" /end COMPU_VTAB
/begin MEASUREMENT T_delay_FB "Transport delay" UWORD Compu_T_delay_FB 0 0 0 65535 ECU_ADDRESS 0x0100B1F0 /end MEASUREMENT
/begin COMPU_METHOD Compu_T_delay_FB " " RAT_FUNC "%.0" "ms" COEFFS 0 1 0 0 0 1 /end COMPU_METHOD
/begin CHARACTERISTIC T_delay_plug_flow "CL T_delay estimate{T_delay_plug_flow&0xff=0:Standard}{T_delay_plug_flow&0xff=1:Extended}" VALUE 0x001c8f6a /* @ECU_Address@T_delay_plug_flow@0x0100C200@ */ ECIPP_ALIGNMENT_UBYTE 255 T_delay_plug_flow_COMPU_VTAB 0 255 BIT_MASK 0xff /end CHARACTERISTIC
/begin COMPU_METHOD T_delay_plug_flow_COMPU_VTAB "Verbal Table" TAB_VERB "%.0" "list" COMPU_TAB_REF T_delay_plug_flow_COMPU_VTAB_REF /end COMPU_METHOD
/begin COMPU_VTAB T_delay_plug_flow_COMPU_VTAB_REF "Verbal Table" TAB_VERB 2 0 "Standard" 1 "Extended" DEFAULT_VALUE "UNKNOWN" /end COMPU_VTAB
/begin MEASUREMENT CB1pre_phiFB "Bank 1 pre-cat current phi" UWORD Compu_CB1pre_phiFB 0 0 0 3.99993896484375 ECU_ADDRESS 0x0100D018 /end MEASUREMENT
/begin COMPU_METHOD Compu_CB1pre_phiFB " " RAT_FUNC "%.3" "phi" COEFFS 0 16384 0 0 0 1 /end COMPU_METHOD
/begin MEASUREMENT CB1pst_phiFB "Bank 1 post-cat current phi" UWORD Compu_CB1pst_phiFB 0 0 0 3.99993896484375 ECU_ADDRESS 0x0100D020 /end MEASUREMENT
/begin COMPU_METHOD Compu_CB1pst_phiFB " " RAT_FUNC "%.3" "phi" COEFFS 0 16384 0 0 0 1 /end COMPU_METHOD
/begin MEASUREMENT CB2pre_phiFB "Bank 2 pre-cat current phi" UWORD Compu_CB2pre_phiFB 0 0 0 3.99993896484375 ECU_ADDRESS 0x0100D028 /end MEASUREMENT
/begin COMPU_METHOD Compu_CB2pre_phiFB " " RAT_FUNC "%.3" "phi" COEFFS 0 16384 0 0 0 1 /end COMPU_METHOD
/begin MEASUREMENT CB2pst_phiFB "Bank 2 post-cat current phi" UWORD Compu_CB2pst_phiFB 0 0 0 3.99993896484375 ECU_ADDRESS 0x0100D030 /end MEASUREMENT
/begin COMPU_METHOD Compu_CB2pst_phiFB " " RAT_FUNC "%.3" "phi" COEFFS 0 16384 0 0 0 1 /end COMPU_METHOD
/begin MEASUREMENT CB1pre_phiFB_avg "Bank 1 pre-cat average phi" UWORD Compu_CB1pre_phiFB_avg 0 0 0 3.99993896484375 ECU_ADDRESS 0x0100D038 /end MEASUREMENT
/begin COMPU_METHOD Compu_CB1pre_phiFB_avg " " RAT_FUNC "%.3" "phi" COEFFS 0 16384 0 0 0 1 /end COMPU_METHOD
/begin MEASUREMENT CB1pst_phiFB_avg "Bank 1 post-cat average phi" UWORD Compu_CB1pst_phiFB_avg 0 0 0 3.99993896484375 ECU_ADDRESS 0x0100D040 /end MEASUREMENT
/begin COMPU_METHOD Compu_CB1pst_phiFB_avg " " RAT_FUNC "%.3" "phi" COEFFS 0 16384 0 0 0 1 /end COMPU_METHOD
/begin MEASUREMENT CB2pre_phiFB_avg "Bank 2 pre-cat average phi" UWORD Compu_CB2pre_phiFB_avg 0 0 0 3.99993896484375 ECU_ADDRESS 0x0100D048 /end MEASUREMENT
/begin COMPU_METHOD Compu_CB2pre_phiFB_avg " " RAT_FUNC "%.3" "phi" COEFFS 0 16384 0 0 0 1 /end COMPU_METHOD
/begin MEASUREMENT CB2pst_phiFB_avg "Bank 2 post-cat average phi" UWORD Compu_CB2pst_phiFB_avg 0 0 0 3.99993896484375 ECU_ADDRESS 0x0100D050 /end MEASUREMENT
/begin COMPU_METHOD Compu_CB2pst_phiFB_avg " " RAT_FUNC "%.3" "phi" COEFFS 0 16384 0 0 0 1 /end COMPU_METHOD
/begin MEASUREMENT CB1pst_phiFB_dphidt "Bank 1 post-cat derivative" SWORD Compu_CB1pst_phiFB_dphidt 0 0 -0.125 0.124996185302734 ECU_ADDRESS 0x0100D058 /end MEASUREMENT
/begin COMPU_METHOD Compu_CB1pst_phiFB_dphidt " " RAT_FUNC "%.4" "dphi / T_delay" COEFFS 0 262144 0 0 0 1 /end COMPU_METHOD
/begin MEASUREMENT CB2pst_phiFB_dphidt "Bank 2 post-cat derivative" SWORD Compu_CB2pst_phiFB_dphidt 0 0 -0.125 0.124996185302734 ECU_ADDRESS 0x0100D060 /end MEASUREMENT
/begin COMPU_METHOD Compu_CB2pst_phiFB_dphidt " " RAT_FUNC "%.4" "dphi / T_delay" COEFFS 0 262144 0 0 0 1 /end COMPU_METHOD
/begin CHARACTERISTIC MJ_man_mode_rpm "EPR manual mode RPM limit" VALUE 0x001c7dc4 /* @ECU_Address@MJ_man_mode_rpm@0x0100D0E0@ */ ECIPP_ALIGNMENT_UWORD 65535 Compu_MJ_man_mode_rpm 0 65535 /end CHARACTERISTIC
/begin COMPU_METHOD Compu_MJ_man_mode_rpm " " RAT_FUNC "%.0" "rpm" COEFFS 0 1 0 0 0 1 /end COMPU_METHOD
/begin CHARACTERISTIC MJ_man_mode_map "EPR manual mode MAP limit" VALUE 0x001c7dc2 /* @ECU_Address@MJ_man_mode_map@0x0100D0E8@ */ ECIPP_ALIGNMENT_UWORD 256 Compu_MJ_man_mode_map 0 255.99609375 /end CHARACTERISTIC
/begin COMPU_METHOD Compu_MJ_man_mode_map " " RAT_FUNC "%.2" "psia" COEFFS 0 256 0 0 0 1 /end COMPU_METHOD
/begin MEASUREMENT UEGO3_mode "UEGO mode{UEGO3_mode&0xff=0xfe:Invalid}{UEGO3_mode&0xff=0xff:Fault}{UEGO3_mode&0xff=0x00:Off}{UEGO3_mode&0xff=0x01:Warming}{UEGO3_mode&0xff=0x02:Waiting}{UEGO3_mode&0xff=0x03:Active}" UBYTE UEGO3_mode_COMPU_VTAB 0 0 0 255 ECU_ADDRESS 0x0100E0E8 BIT_MASK 0xff /end MEASUREMENT
/begin COMPU_METHOD UEGO3_mode_COMPU_VTAB "Verbal Table" TAB_VERB "%.0" "list" COMPU_TAB_REF UEGO3_mode_COMPU_VTAB_REF /end COMPU_METHOD
/begin COMPU_VTAB UEGO3_mode_COMPU_VTAB_REF "Verbal Table" TAB_VERB 6 0xfe "Invalid" 0xff "Fault" 0x00 "Off" 0x01 "Warming" 0x02 "Waiting" 0x03 "Active" DEFAULT_VALUE "UNKNOWN" /end COMPU_VTAB
/begin MEASUREMENT Phi_UEGO3 "UEGO phi" UWORD Compu_Phi_UEGO3 0 0 0 3.99993896484375 ECU_ADDRESS 0x0100E100 /end MEASUREMENT
/begin COMPU_METHOD Compu_Phi_UEGO3 " " RAT_FUNC "%.3" "phi" COEFFS 0 16384 0 0 0 1 /end COMPU_METHOD
/begin MEASUREMENT UEGO4_mode "UEGO mode{UEGO4_mode&0xff=0xfe:Invalid}{UEGO4_mode&0xff=0xff:Fault}{UEGO4_mode&0xff=0x00:Off}{UEGO4_mode&0xff=0x01:Warming}{UEGO4_mode&0xff=0x02:Waiting}{UEGO4_mode&0xff=0x03:Active}" UBYTE UEGO4_mode_COMPU_VTAB 0 0 0 255 ECU_ADDRESS 0x0100E1C0 BIT_MASK 0xff /end MEASUREMENT
/begin COMPU_METHOD UEGO4_mode_COMPU_VTAB "Verbal Table" TAB_VERB "%.0" "list" COMPU_TAB_REF UEGO4_mode_COMPU_VTAB_REF /end COMPU_METHOD
/begin COMPU_VTAB UEGO4_mode_COMPU_VTAB_REF "Verbal Table" TAB_VERB 6 0xfe "Invalid" 0xff "Fault" 0x00 "Off" 0x01 "Warming" 0x02 "Waiting" 0x03 "Active" DEFAULT_VALUE "UNKNOWN" /end COMPU_VTAB
/begin MEASUREMENT Phi_UEGO4 "UEGO phi" UWORD Compu_Phi_UEGO4 0 0 0 3.99993896484375 ECU_ADDRESS 0x0100E1D8 /end MEASUREMENT
/begin COMPU_METHOD Compu_Phi_UEGO4 " " RAT_FUNC "%.3" "phi" COEFFS 0 16384 0 0 0 1 /end COMPU_METHOD
/begin CHARACTERISTIC adapt_store_EE "Adaptive table retention memory{adapt_store_EE&0xff=0:Battery}{adapt_store_EE&0xff=1:Permanent}" VALUE 0x001c8f98 /* @ECU_Address@adapt_store_EE@0x0100E7D8@ */ ECIPP_ALIGNMENT_UBYTE 255 adapt_store_EE_COMPU_VTAB 0 255 BIT_MASK 0xff /end CHARACTERISTIC
/begin COMPU_METHOD adapt_store_EE_COMPU_VTAB "Verbal Table" TAB_VERB "%.0" "list" COMPU_TAB_REF adapt_store_EE_COMPU_VTAB_REF /end COMPU_METHOD
/begin COMPU_VTAB adapt_store_EE_COMPU_VTAB_REF "Verbal Table" TAB_VERB 2 0 "Battery" 1 "Permanent" DEFAULT_VALUE "UNKNOWN" /end COMPU_VTAB
/begin CHARACTERISTIC CLp_fastwr_ena "CL UEGO perturb disable{CLp_fastwr_ena&0xff=0:Disabled}{CLp_fastwr_ena&0xff=1:Enabled}" VALUE 0x001c86ab /* @ECU_Address@CLp_fastwr_ena@0x0100EFE0@ */ ECIPP_ALIGNMENT_UBYTE 255 CLp_fastwr_ena_COMPU_VTAB 0 255 BIT_MASK 0xff /end CHARACTERISTIC
/begin COMPU_METHOD CLp_fastwr_ena_COMPU_VTAB "Verbal Table" TAB_VERB "%.0" "list" COMPU_TAB_REF CLp_fastwr_ena_COMPU_VTAB_REF /end COMPU_METHOD
/begin COMPU_VTAB CLp_fastwr_ena_COMPU_VTAB_REF "Verbal Table" TAB_VERB 2 0 "Disabled" 1 "Enabled" DEFAULT_VALUE "UNKNOWN" /end COMPU_VTAB
/begin CHARACTERISTIC CLp_fastwr_MAPdt "CL UEGO MAPdt engage" VALUE 0x001c445a /* @ECU_Address@CLp_fastwr_MAPdt@0x0100EFE8@ */ ECIPP_ALIGNMENT_SWORD 4000 Compu_CLp_fastwr_MAPdt -4000 3999.8779296875 /end CHARACTERISTIC
/begin COMPU_METHOD Compu_CLp_fastwr_MAPdt " " RAT_FUNC "%.1" "psi/sec" COEFFS 0 8.192 0 0 0 1 /end COMPU_METHOD
/begin CHARACTERISTIC CLp_fastwr_phierr "CL UEGO phi error disengage" VALUE 0x001c4460 /* @ECU_Address@CLp_fastwr_phierr@0x0100EFF0@ */ ECIPP_ALIGNMENT_SWORD 100 Compu_CLp_fastwr_phierr -100 99.9969482421875 /end CHARACTERISTIC
/begin COMPU_METHOD Compu_CLp_fastwr_phierr " " RAT_FUNC "%.1" "%" COEFFS 0 327.68 0 0 0 1 /end COMPU_METHOD
/begin CHARACTERISTIC CLp_fastwr_mincyc "CL UEGO min engagement" VALUE 0x001c6e2e /* @ECU_Address@CLp_fastwr_mincyc@0x0100EFF8@ */ ECIPP_ALIGNMENT_UWORD 4096 Compu_CLp_fastwr_mincyc 0 4095.9375 /end CHARACTERISTIC
/begin COMPU_METHOD Compu_CLp_fastwr_mincyc " " RAT_FUNC "%.1" "eng cyc" COEFFS 0 16 0 0 0 1 /end COMPU_METHOD
/begin MEASUREMENT CLp_fastwr_status "CL UEGO status{CLp_fastwr_status&0xff=0:Inactive}{CLp_fastwr_status&0xff=1:Active: Phi Rich}{CLp_fastwr_status&0xff=2:Active: Phi Lean}{CLp_fastwr_status&0xff=3:Active: MAPdt}{CLp_fastwr_status&0xff=4:Active: TWC Diag}{CLp_fastwr_status&0xff=5:Active: TWC" UBYTE CLp_fastwr_status_COMPU_VTAB 0 0 0 255 ECU_ADDRESS 0x0100F000 BIT_MASK 0xff /end MEASUREMENT
/begin COMPU_METHOD CLp_fastwr_status_COMPU_VTAB "Verbal Table" TAB_VERB "%.0" "list" COMPU_TAB_REF CLp_fastwr_status_COMPU_VTAB_REF /end COMPU_METHOD
/begin COMPU_VTAB CLp_fastwr_status_COMPU_VTAB_REF "Verbal Table" TAB_VERB 8 0 "Inactive" 1 "Active: Phi Rich" 2 "Active: Phi Lean" 3 "Active: MAPdt" 4 "Active: TWC Diag" 5 "Active: TWC Enrich" 6 "Active: Cold Start" 7 "Active: TWC Lean/Rich" DEFAULT_VALUE "UNKNOWN" /end COMPU_VTAB
/begin CHARACTERISTIC CLp_fastwr_rich_err "CL UEGO rich error engage" VALUE 0x001c4462 /* @ECU_Address@CLp_fastwr_rich_err@0x0100F110@ */ ECIPP_ALIGNMENT_SWORD 100 Compu_CLp_fastwr_rich_err -100 99.9969482421875 /end CHARACTERISTIC
/begin COMPU_METHOD Compu_CLp_fastwr_rich_err " " RAT_FUNC "%.1" "%" COEFFS 0 327.68 0 0 0 1 /end COMPU_METHOD
/begin CHARACTERISTIC CLp_fastwr_lean_err "CL UEGO lean error engage" VALUE 0x001c445c /* @ECU_Address@CLp_fastwr_lean_err@0x0100F118@ */ ECIPP_ALIGNMENT_SWORD 100 Compu_CLp_fastwr_lean_err -100 99.9969482421875 /end CHARACTERISTIC
/begin COMPU_METHOD Compu_CLp_fastwr_lean_err " " RAT_FUNC "%.1" "%" COEFFS 0 327.68 0 0 0 1 /end COMPU_METHOD
/begin CHARACTERISTIC CLp_fastwr_rich_step "CL UEGO rich engage initial step" VALUE 0x001c4464 /* @ECU_Address@CLp_fastwr_rich_step@0x0100F120@ */ ECIPP_ALIGNMENT_SWORD 200 Compu_CLp_fastwr_rich_step -200 199.993896484375 /end CHARACTERISTIC
/begin COMPU_METHOD Compu_CLp_fastwr_rich_step " " RAT_FUNC "%.1" "%" COEFFS 0 163.84 0 0 0 1 /end COMPU_METHOD
/begin CHARACTERISTIC CLp_fastwr_lean_step "CL UEGO lean engage initial step" VALUE 0x001c445e /* @ECU_Address@CLp_fastwr_lean_step@0x0100F128@ */ ECIPP_ALIGNMENT_SWORD 200 Compu_CLp_fastwr_lean_step -200 199.993896484375 /end CHARACTERISTIC
/begin COMPU_METHOD Compu_CLp_fastwr_lean_step " " RAT_FUNC "%.1" "%" COEFFS 0 163.84 0 0 0 1 /end COMPU_METHOD
/begin CHARACTERISTIC CLp_fastwr_mdot_min "CL UEGO min port flow" VALUE 0x001c6e2c /* @ECU_Address@CLp_fastwr_mdot_min@0x0100F1D0@ */ ECIPP_ALIGNMENT_UWORD 1024 Compu_CLp_fastwr_mdot_min 0 1023.984375 /end CHARACTERISTIC
/begin COMPU_METHOD Compu_CLp_fastwr_mdot_min " " RAT_FUNC "%.1" "g/sec" COEFFS 0 64 0 0 0 1 /end COMPU_METHOD
/begin MEASUREMENT CL1_phi_error "CL phi error" SWORD Compu_CL1_phi_error 0 0 -100 99.9969482421875 ECU_ADDRESS 0x0100F1D8 /end MEASUREMENT
/begin COMPU_METHOD Compu_CL1_phi_error " " RAT_FUNC "%.1" "phi" COEFFS 0 327.68 0 0 0 1 /end COMPU_METHOD
/begin MEASUREMENT CL2_phi_error "CL phi error" SWORD Compu_CL2_phi_error 0 0 -100 99.9969482421875 ECU_ADDRESS 0x0100F1E0 /end MEASUREMENT
/begin COMPU_METHOD Compu_CL2_phi_error " " RAT_FUNC "%.1" "phi" COEFFS 0 327.68 0 0 0 1 /end COMPU_METHOD
/begin CHARACTERISTIC GLOW_type "Glow device output type{GLOW_type&0xff=0:Disabled}{GLOW_type&0xff=1:Direct output}{GLOW_type&0xff=2:Glow control unit}" VALUE 0x001c8754 /* @ECU_Address@GLOW_type@0x01011470@ */ ECIPP_ALIGNMENT_UBYTE 255 GLOW_type_COMPU_VTAB 0 255 BIT_MASK 0xff /end CHARACTERISTIC
/begin COMPU_METHOD GLOW_type_COMPU_VTAB "Verbal Table" TAB_VERB "%.0" "list" COMPU_TAB_REF GLOW_type_COMPU_VTAB_REF /end COMPU_METHOD
/begin COMPU_VTAB GLOW_type_COMPU_VTAB_REF "Verbal Table" TAB_VERB 3 0 "Disabled" 1 "Direct output" 2 "Glow control unit" DEFAULT_VALUE "UNKNOWN" /end COMPU_VTAB
/begin CHARACTERISTIC GLOW_mode "Glow control mode{GLOW_mode&0xff=0:Pre-glow only}{GLOW_mode&0xff=1:Pre- & post-glow}" VALUE 0x001c8752 /* @ECU_Address@GLOW_mode@0x01011478@ */ ECIPP_ALIGNMENT_UBYTE 255 GLOW_mode_COMPU_VTAB 0 255 BIT_MASK 0xff /end CHARACTERISTIC
/begin COMPU_METHOD GLOW_mode_COMPU_VTAB "Verbal Table" TAB_VERB "%.0" "list" COMPU_TAB_REF GLOW_mode_COMPU_VTAB_REF /end COMPU_METHOD
/begin COMPU_VTAB GLOW_mode_COMPU_VTAB_REF "Verbal Table" TAB_VERB 2 0 "Pre-glow only" 1 "Pre- & post-glow" DEFAULT_VALUE "UNKNOWN" /end COMPU_VTAB
/begin CHARACTERISTIC GLOW_channel "Glow output channel{GLOW_channel&0xff=0:Disabled}{GLOW_channel&0xff=1:Buzzer Output}{GLOW_channel&0xff=2:MIL Output}{GLOW_channel&0xff=3:TACH Output}{GLOW_channel&0xff=4:Starter Output}{GLOW_channel&0xff=5:EGOH1}{GLOW_channel&0xff=6:EGOH2}{GLOW_channel&0x" VALUE 0x001c8750 /* @ECU_Address@GLOW_channel@0x01011480@ */ ECIPP_ALIGNMENT_UBYTE 255 GLOW_channel_COMPU_VTAB 0 255 BIT_MASK 0xff /end CHARACTERISTIC
/begin COMPU_METHOD GLOW_channel_COMPU_VTAB "Verbal Table" TAB_VERB "%.0" "list" COMPU_TAB_REF GLOW_channel_COMPU_VTAB_REF /end COMPU_METHOD
/begin COMPU_VTAB GLOW_channel_COMPU_VTAB_REF "Verbal Table" TAB_VERB 19 0 "Disabled" 1 "Buzzer Output" 2 "MIL Output" 3 "TACH Output" 4 "Starter Output" 5 "EGOH1" 6 "EGOH2" 7 "EGOH3" 8 "EGOH4" 9 "Aux PWM1" 10 "Aux PWM2" 11 "Aux PWM3" 12 "Aux PWM4" 13 "Aux PWM5" 14 "Aux PWM6" 15 "Aux PWM7" 16 "Aux PWM8" 17 "Aux PWM9" 18 "Aux PWM10" DEFAULT_VALUE "UNKNOWN" /end COMPU_VTAB
/begin CHARACTERISTIC GLOW_GCU_diag_in "GCU diag. input channel{GLOW_GCU_diag_in&0xff=0:Disabled}{GLOW_GCU_diag_in&0xff=1:Aux PU1}{GLOW_GCU_diag_in&0xff=2:Aux PU2}{GLOW_GCU_diag_in&0xff=3:Aux PU3}{GLOW_GCU_diag_in&0xff=4:Aux PD1}{GLOW_GCU_diag_in&0xff=5:Aux PD2}{GLOW_GCU_diag_in&0xff=6:Aux PD3}" VALUE 0x001c874f /* @ECU_Address@GLOW_GCU_diag_in@0x01011488@ */ ECIPP_ALIGNMENT_UBYTE 255 GLOW_GCU_diag_in_COMPU_VTAB 0 255 BIT_MASK 0xff /end CHARACTERISTIC
/begin COMPU_METHOD GLOW_GCU_diag_in_COMPU_VTAB "Verbal Table" TAB_VERB "%.0" "list" COMPU_TAB_REF GLOW_GCU_diag_in_COMPU_VTAB_REF /end COMPU_METHOD
/begin COMPU_VTAB GLOW_GCU_diag_in_COMPU_VTAB_REF "Verbal Table" TAB_VERB 14 0 "Disabled" 1 "Aux PU1" 2 "Aux PU2" 3 "Aux PU3" 4 "Aux PD1" 5 "Aux PD2" 6 "Aux PD3" 7 "Aux PUD1" 8 "Aux PUD2" 9 "Aux PUD3" 10 "Aux PUD4" 11 "Aux PUD5" 12 "Aux PUD6" 13 "Aux PUD7" DEFAULT_VALUE "UNKNOWN" /end COMPU_VTAB
/begin CHARACTERISTIC GLOW_temp_input "Glow temperature input{GLOW_temp_input&0xff=0:Ambient air temperature}{GLOW_temp_input&0xff=1:Engine coolant temperature}{GLOW_temp_input&0xff=2:Oil temperature}{GLOW_temp_input&0xff=3:Cylinder head temperature}" VALUE 0x001c8753 /* @ECU_Address@GLOW_temp_input@0x01011490@ */ ECIPP_ALIGNMENT_UBYTE 255 GLOW_temp_input_COMPU_VTAB 0 255 BIT_MASK 0xff /end CHARACTERISTIC
/begin COMPU_METHOD GLOW_temp_input_COMPU_VTAB "Verbal Table" TAB_VERB "%.0" "list" COMPU_TAB_REF GLOW_temp_input_COMPU_VTAB_REF /end COMPU_METHOD
/begin COMPU_VTAB GLOW_temp_input_COMPU_VTAB_REF "Verbal Table" TAB_VERB 4 0 "Ambient air temperature" 1 "Engine coolant temperature" 2 "Oil temperature" 3 "Cylinder head temperature" DEFAULT_VALUE "UNKNOWN" /end COMPU_VTAB
/begin CHARACTERISTIC GLOW_Vbat_high "Glow Vbat high" VALUE 0x001c7bba /* @ECU_Address@GLOW_Vbat_high@0x01011498@ */ ECIPP_ALIGNMENT_UWORD 256 Compu_GLOW_Vbat_high 0 255.99609375 /end CHARACTERISTIC
/begin COMPU_METHOD Compu_GLOW_Vbat_high " " RAT_FUNC "%.1" "V" COEFFS 0 256 0 0 0 1 /end COMPU_METHOD
/begin CHARACTERISTIC GLOW_pre_Vbat_low "Glow Vbat low" VALUE 0x001c7bbc /* @ECU_Address@GLOW_pre_Vbat_low@0x010114A0@ */ ECIPP_ALIGNMENT_UWORD 256 Compu_GLOW_pre_Vbat_low 0 255.99609375 /end CHARACTERISTIC
/begin COMPU_METHOD Compu_GLOW_pre_Vbat_low " " RAT_FUNC "%.1" "V" COEFFS 0 256 0 0 0 1 /end COMPU_METHOD
/begin CHARACTERISTIC GLOW_ECT_high "Glow temp high thld" VALUE 0x001c7bb8 /* @ECU_Address@GLOW_ECT_high@0x010114A8@ */ ECIPP_ALIGNMENT_UWORD 564 Compu_GLOW_ECT_high -460 563.984375 /end CHARACTERISTIC
/begin COMPU_METHOD Compu_GLOW_ECT_high " " RAT_FUNC "%.0" "deg F" COEFFS 0 64 29440 0 0 1 /end COMPU_METHOD
/begin CHARACTERISTIC GLOW_pre_keyon_wt "Glow key-on wait time" VALUE 0x001c7bbe /* @ECU_Address@GLOW_pre_keyon_wt@0x010114B0@ */ ECIPP_ALIGNMENT_UWORD 65535 Compu_GLOW_pre_keyon_wt 0 65535 /end CHARACTERISTIC
/begin COMPU_METHOD Compu_GLOW_pre_keyon_wt " " RAT_FUNC "%.0" "ms" COEFFS 0 1 0 0 0 1 /end COMPU_METHOD
/begin CHARACTERISTIC GLOW_shutoff_temp "Glow shut-off temp." VALUE 0x001c7bc2 /* @ECU_Address@GLOW_shutoff_temp@0x010114B8@ */ ECIPP_ALIGNMENT_UWORD 564 Compu_GLOW_shutoff_temp -460 563.984375 /end CHARACTERISTIC
/begin COMPU_METHOD Compu_GLOW_shutoff_temp " " RAT_FUNC "%.0" "deg F" COEFFS 0 64 29440 0 0 1 /end COMPU_METHOD
/begin CHARACTERISTIC GLOW_time_max "Maximum glow time" VALUE 0x001c7bc6 /* @ECU_Address@GLOW_time_max@0x010114C0@ */ ECIPP_ALIGNMENT_UWORD 1049 Compu_GLOW_time_max 0 1048.56 /end CHARACTERISTIC
/begin COMPU_METHOD Compu_GLOW_time_max " " RAT_FUNC "%.1" "seconds" COEFFS 0 62.5 0 0 0 1 /end COMPU_METHOD
/begin CHARACTERISTIC GLOW_voltage "Target glow voltage" VALUE 0x001c7bc8 /* @ECU_Address@GLOW_voltage@0x010114C8@ */ ECIPP_ALIGNMENT_UWORD 256 Compu_GLOW_voltage 0 255.99609375 /end CHARACTERISTIC
/begin COMPU_METHOD Compu_GLOW_voltage " " RAT_FUNC "%.1" "V" COEFFS 0 256 0 0 0 1 /end COMPU_METHOD
/begin CHARACTERISTIC GLOW_DC_min "Min. glow output DC" VALUE 0x001c7bb6 /* @ECU_Address@GLOW_DC_min@0x010114D0@ */ ECIPP_ALIGNMENT_UWORD 100 Compu_GLOW_DC_min 0 99.9984741210938 /end CHARACTERISTIC
/begin COMPU_METHOD Compu_GLOW_DC_min " " RAT_FUNC "%.1" "%" COEFFS 0 655.36 0 0 0 1 /end COMPU_METHOD
/begin CHARACTERISTIC GLOW_DC_max "Max. glow output DC" VALUE 0x001c7bb4 /* @ECU_Address@GLOW_DC_max@0x010114D8@ */ ECIPP_ALIGNMENT_UWORD 100 Compu_GLOW_DC_max 0 99.9984741210938 /end CHARACTERISTIC
/begin COMPU_METHOD Compu_GLOW_DC_max " " RAT_FUNC "%.1" "%" COEFFS 0 655.36 0 0 0 1 /end COMPU_METHOD
/begin MEASUREMENT GLOW_state "Glow state{GLOW_state&0xff=0x00:GLOW_INIT}{GLOW_state&0xff=0x01:GLOW_WAIT_FOR_STOP}{GLOW_state&0xff=0x02:GLOW_PRE_ACTIVE_ENGINE_STOPPED}{GLOW_state&0xff=0x03:GLOW_PRE_PERSIST_ENGINE_RUNNING}{GLOW_state&0xff=0x04:GLOW_POST_ACTIVE_ENGINE_RUNNING}{GLOW_state" UBYTE GLOW_state_COMPU_VTAB 0 0 0 255 ECU_ADDRESS 0x010114E0 BIT_MASK 0xff /end MEASUREMENT
/begin COMPU_METHOD GLOW_state_COMPU_VTAB "Verbal Table" TAB_VERB "%.0" "list" COMPU_TAB_REF GLOW_state_COMPU_VTAB_REF /end COMPU_METHOD
/begin COMPU_VTAB GLOW_state_COMPU_VTAB_REF "Verbal Table" TAB_VERB 9 0x00 "GLOW_INIT" 0x01 "GLOW_WAIT_FOR_STOP" 0x02 "GLOW_PRE_ACTIVE_ENGINE_STOPPED" 0x03 "GLOW_PRE_PERSIST_ENGINE_RUNNING" 0x04 "GLOW_POST_ACTIVE_ENGINE_RUNNING" 0x05 "GLOW_COMPLETE" 0x06 "GLOW_ABORT" 0x07 "GLOW_WAIT_FOR_START" 0x08 "GLOW_INTERMEDIATE" DEFAULT_VALUE "UNKNOWN" /end COMPU_VTAB
/begin MEASUREMENT GLOW_temp "Glow feedback temp." UWORD Compu_GLOW_temp 0 0 -460 563.984375 ECU_ADDRESS 0x010114E8 /end MEASUREMENT
/begin COMPU_METHOD Compu_GLOW_temp " " RAT_FUNC "%.0" "deg F" COEFFS 0 64 29440 0 0 1 /end COMPU_METHOD
/begin MEASUREMENT GLOW_pre_ms "Pre-glow timer" ULONG Compu_GLOW_pre_ms 0 0 0 4294967.295 ECU_ADDRESS 0x010114F0 /end MEASUREMENT
/begin COMPU_METHOD Compu_GLOW_pre_ms " " RAT_FUNC "%.1" "seconds" COEFFS 0 1000 0 0 0 1 /end COMPU_METHOD
/begin MEASUREMENT GLOW_max_ms "Max glow timer" ULONG Compu_GLOW_max_ms 0 0 0 4294967.295 ECU_ADDRESS 0x010114F8 /end MEASUREMENT
/begin COMPU_METHOD Compu_GLOW_max_ms " " RAT_FUNC "%.1" "seconds" COEFFS 0 1000 0 0 0 1 /end COMPU_METHOD
/begin MEASUREMENT GLOW_active "Glow activity{GLOW_active&0xff=0x00:Inactive}{GLOW_active&0xff=0x01:Active}" UBYTE GLOW_active_COMPU_VTAB 0 0 0 255 ECU_ADDRESS 0x01011500 BIT_MASK 0xff /end MEASUREMENT
/begin COMPU_METHOD GLOW_active_COMPU_VTAB "Verbal Table" TAB_VERB "%.0" "list" COMPU_TAB_REF GLOW_active_COMPU_VTAB_REF /end COMPU_METHOD
/begin COMPU_VTAB GLOW_active_COMPU_VTAB_REF "Verbal Table" TAB_VERB 2 0x00 "Inactive" 0x01 "Active" DEFAULT_VALUE "UNKNOWN" /end COMPU_VTAB
/begin CHARACTERISTIC GLOW_lamp_channel "Glow lamp channel{GLOW_lamp_channel&0xff=0:Disabled}{GLOW_lamp_channel&0xff=1:Buzzer Output}{GLOW_lamp_channel&0xff=2:MIL Output}{GLOW_lamp_channel&0xff=3:TACH Output}{GLOW_lamp_channel&0xff=4:Starter Output}{GLOW_lamp_channel&0xff=5:EGOH1}{GLOW_lamp_chan" VALUE 0x001c8751 /* @ECU_Address@GLOW_lamp_channel@0x01011980@ */ ECIPP_ALIGNMENT_UBYTE 255 GLOW_lamp_channel_COMPU_VTAB 0 255 BIT_MASK 0xff /end CHARACTERISTIC
/begin COMPU_METHOD GLOW_lamp_channel_COMPU_VTAB "Verbal Table" TAB_VERB "%.0" "list" COMPU_TAB_REF GLOW_lamp_channel_COMPU_VTAB_REF /end COMPU_METHOD
/begin COMPU_VTAB GLOW_lamp_channel_COMPU_VTAB_REF "Verbal Table" TAB_VERB 19 0 "Disabled" 1 "Buzzer Output" 2 "MIL Output" 3 "TACH Output" 4 "Starter Output" 5 "EGOH1" 6 "EGOH2" 7 "EGOH3" 8 "EGOH4" 9 "Aux PWM1" 10 "Aux PWM2" 11 "Aux PWM3" 12 "Aux PWM4" 13 "Aux PWM5" 14 "Aux PWM6" 15 "Aux PWM7" 16 "Aux PWM8" 17 "Aux PWM9" 18 "Aux PWM10" DEFAULT_VALUE "UNKNOWN" /end COMPU_VTAB
/begin CHARACTERISTIC GLOW_pre_time_max "Maximum pre-glow time" VALUE 0x001c7bc0 /* @ECU_Address@GLOW_pre_time_max@0x01011988@ */ ECIPP_ALIGNMENT_UWORD 1049 Compu_GLOW_pre_time_max 0 1048.56 /end CHARACTERISTIC
/begin COMPU_METHOD Compu_GLOW_pre_time_max " " RAT_FUNC "%.0" "seconds" COEFFS 0 62.5 0 0 0 1 /end COMPU_METHOD
/begin MEASUREMENT GLOW_post_ms "Post-glow timer" ULONG Compu_GLOW_post_ms 0 0 0 4294967.295 ECU_ADDRESS 0x01011990 /end MEASUREMENT
/begin COMPU_METHOD Compu_GLOW_post_ms " " RAT_FUNC "%.1" "seconds" COEFFS 0 1000 0 0 0 1 /end COMPU_METHOD
/begin MEASUREMENT GLOW_pre_max_ms "Pre-glow timer" ULONG Compu_GLOW_pre_max_ms 0 0 0 4294967.295 ECU_ADDRESS 0x01011998 /end MEASUREMENT
/begin COMPU_METHOD Compu_GLOW_pre_max_ms " " RAT_FUNC "%.1" "seconds" COEFFS 0 1000 0 0 0 1 /end COMPU_METHOD
/begin CHARACTERISTIC GLOW_starter_pause "Glow starter in-rush pause time" VALUE 0x001c7bc4 /* @ECU_Address@GLOW_starter_pause@0x010119A0@ */ ECIPP_ALIGNMENT_UWORD 65535 Compu_GLOW_starter_pause 0 65535 /end CHARACTERISTIC
/begin COMPU_METHOD Compu_GLOW_starter_pause " " RAT_FUNC "%.0" "ms" COEFFS 0 1 0 0 0 1 /end COMPU_METHOD
/begin CHARACTERISTIC TWCctrl_ROL_d_def "TWC desired (fixed) ROL" VALUE 0x001c3d6c /* @ECU_Address@TWCctrl_ROL_d_def@0x01011CE0@ */ ECIPP_ALIGNMENT_FLOAT32_IEEE 10000000000 Compu_TWCctrl_ROL_d_def -10000000000 10000000000 /end CHARACTERISTIC
/begin COMPU_METHOD Compu_TWCctrl_ROL_d_def " " RAT_FUNC "%.1" "%" COEFFS 0 0.01 0 0 0 1 /end COMPU_METHOD
/begin MEASUREMENT TWCctrl_ROL_e "TWC ROL error" FLOAT32_IEEE Compu_TWCctrl_ROL_e 0 0 -10000000000 10000000000 ECU_ADDRESS 0x01011CE8 /end MEASUREMENT
/begin COMPU_METHOD Compu_TWCctrl_ROL_e " " RAT_FUNC "%.1" "%" COEFFS 0 0.01 0 0 0 1 /end COMPU_METHOD
/begin CHARACTERISTIC CL_Kp_p_ROL "Kp increasing ROL" VALUE 0x001C34AA /* @ECU_Address@CL_Kp_p_ROL@0x01011D50@ */ ECIPP_ALIGNMENT_SWORD 100 Compu_CL_Kp_p_ROL -100 99.9969482421875 /end CHARACTERISTIC
/begin COMPU_METHOD Compu_CL_Kp_p_ROL " " RAT_FUNC "%.1" "%" COEFFS 0 327.68 0 0 0 1 /end COMPU_METHOD
/begin CHARACTERISTIC CLLP_Kp_p_ROL "Kp increasing ROL" VALUE 0x001C19EE /* @ECU_Address@CLLP_Kp_p_ROL@0x01011D58@ */ ECIPP_ALIGNMENT_SWORD 100 Compu_CLLP_Kp_p_ROL -100 99.9969482421875 /end CHARACTERISTIC
/begin COMPU_METHOD Compu_CLLP_Kp_p_ROL " " RAT_FUNC "%.1" "%" COEFFS 0 327.68 0 0 0 1 /end COMPU_METHOD
/begin CHARACTERISTIC CLNG_Kp_p_ROL "Kp increasing ROL" VALUE 0x001C2958 /* @ECU_Address@CLNG_Kp_p_ROL@0x01011D60@ */ ECIPP_ALIGNMENT_SWORD 100 Compu_CLNG_Kp_p_ROL -100 99.9969482421875 /end CHARACTERISTIC
/begin COMPU_METHOD Compu_CLNG_Kp_p_ROL " " RAT_FUNC "%.1" "%" COEFFS 0 327.68 0 0 0 1 /end COMPU_METHOD
/begin CHARACTERISTIC CL_Kp_n_ROL "Kp decreasing ROL" VALUE 0x001C34AC /* @ECU_Address@CL_Kp_n_ROL@0x01011D68@ */ ECIPP_ALIGNMENT_SWORD 100 Compu_CL_Kp_n_ROL -100 99.9969482421875 /end CHARACTERISTIC
/begin COMPU_METHOD Compu_CL_Kp_n_ROL " " RAT_FUNC "%.1" "%" COEFFS 0 327.68 0 0 0 1 /end COMPU_METHOD
/begin CHARACTERISTIC CLLP_Kp_n_ROL "Kp decreasing ROL" VALUE 0x001C19F0 /* @ECU_Address@CLLP_Kp_n_ROL@0x01011D70@ */ ECIPP_ALIGNMENT_SWORD 100 Compu_CLLP_Kp_n_ROL -100 99.9969482421875 /end CHARACTERISTIC
/begin COMPU_METHOD Compu_CLLP_Kp_n_ROL " " RAT_FUNC "%.1" "%" COEFFS 0 327.68 0 0 0 1 /end COMPU_METHOD
/begin CHARACTERISTIC CLNG_Kp_n_ROL "Kp decreasing ROL" VALUE 0x001C295A /* @ECU_Address@CLNG_Kp_n_ROL@0x01011D78@ */ ECIPP_ALIGNMENT_SWORD 100 Compu_CLNG_Kp_n_ROL -100 99.9969482421875 /end CHARACTERISTIC
/begin COMPU_METHOD Compu_CLNG_Kp_n_ROL " " RAT_FUNC "%.1" "%" COEFFS 0 327.68 0 0 0 1 /end COMPU_METHOD
/begin CHARACTERISTIC CL_Ki_p_ROL "Ki increasing ROL" VALUE 0x001C34AE /* @ECU_Address@CL_Ki_p_ROL@0x01011D80@ */ ECIPP_ALIGNMENT_SWORD 100 Compu_CL_Ki_p_ROL -100 99.9969482421875 /end CHARACTERISTIC
/begin COMPU_METHOD Compu_CL_Ki_p_ROL " " RAT_FUNC "%.1" "%" COEFFS 0 327.68 0 0 0 1 /end COMPU_METHOD
/begin CHARACTERISTIC CLLP_Ki_p_ROL "Ki increasing ROL" VALUE 0x001C19F2 /* @ECU_Address@CLLP_Ki_p_ROL@0x01011D88@ */ ECIPP_ALIGNMENT_SWORD 100 Compu_CLLP_Ki_p_ROL -100 99.9969482421875 /end CHARACTERISTIC
/begin COMPU_METHOD Compu_CLLP_Ki_p_ROL " " RAT_FUNC "%.1" "%" COEFFS 0 327.68 0 0 0 1 /end COMPU_METHOD
/begin CHARACTERISTIC CLNG_Ki_p_ROL "Ki increasing ROL" VALUE 0x001C295C /* @ECU_Address@CLNG_Ki_p_ROL@0x01011D90@ */ ECIPP_ALIGNMENT_SWORD 100 Compu_CLNG_Ki_p_ROL -100 99.9969482421875 /end CHARACTERISTIC
/begin COMPU_METHOD Compu_CLNG_Ki_p_ROL " " RAT_FUNC "%.1" "%" COEFFS 0 327.68 0 0 0 1 /end COMPU_METHOD
/begin CHARACTERISTIC CL_Ki_n_ROL "Ki decreasing ROL" VALUE 0x001C34B0 /* @ECU_Address@CL_Ki_n_ROL@0x01011D98@ */ ECIPP_ALIGNMENT_SWORD 100 Compu_CL_Ki_n_ROL -100 99.9969482421875 /end CHARACTERISTIC
/begin COMPU_METHOD Compu_CL_Ki_n_ROL " " RAT_FUNC "%.1" "%" COEFFS 0 327.68 0 0 0 1 /end COMPU_METHOD
/begin CHARACTERISTIC CLLP_Ki_n_ROL "Ki decreasing ROL" VALUE 0x001C19F4 /* @ECU_Address@CLLP_Ki_n_ROL@0x01011DA0@ */ ECIPP_ALIGNMENT_SWORD 100 Compu_CLLP_Ki_n_ROL -100 99.9969482421875 /end CHARACTERISTIC
/begin COMPU_METHOD Compu_CLLP_Ki_n_ROL " " RAT_FUNC "%.1" "%" COEFFS 0 327.68 0 0 0 1 /end COMPU_METHOD
/begin CHARACTERISTIC CLNG_Ki_n_ROL "Ki decreasing ROL" VALUE 0x001C295E /* @ECU_Address@CLNG_Ki_n_ROL@0x01011DA8@ */ ECIPP_ALIGNMENT_SWORD 100 Compu_CLNG_Ki_n_ROL -100 99.9969482421875 /end CHARACTERISTIC
/begin COMPU_METHOD Compu_CLNG_Ki_n_ROL " " RAT_FUNC "%.1" "%" COEFFS 0 327.68 0 0 0 1 /end COMPU_METHOD
/begin CHARACTERISTIC CL_ROL_win_p "ROL post-cat window upper" VALUE 0x001C34DE /* @ECU_Address@CL_ROL_win_p@0x01011DB0@ */ ECIPP_ALIGNMENT_SWORD 2 Compu_CL_ROL_win_p -2 1.99993896484375 /end CHARACTERISTIC
/begin COMPU_METHOD Compu_CL_ROL_win_p " " RAT_FUNC "%.3" "-" COEFFS 0 16384 0 0 0 1 /end COMPU_METHOD
/begin CHARACTERISTIC CLLP_ROL_win_p "ROL post-cat window upper" VALUE 0x001C1A22 /* @ECU_Address@CLLP_ROL_win_p@0x01011DB8@ */ ECIPP_ALIGNMENT_SWORD 2 Compu_CLLP_ROL_win_p -2 1.99993896484375 /end CHARACTERISTIC
/begin COMPU_METHOD Compu_CLLP_ROL_win_p " " RAT_FUNC "%.3" "-" COEFFS 0 16384 0 0 0 1 /end COMPU_METHOD
/begin CHARACTERISTIC CLNG_ROL_win_p "ROL post-cat window upper" VALUE 0x001C298C /* @ECU_Address@CLNG_ROL_win_p@0x01011DC0@ */ ECIPP_ALIGNMENT_SWORD 2 Compu_CLNG_ROL_win_p -2 1.99993896484375 /end CHARACTERISTIC
/begin COMPU_METHOD Compu_CLNG_ROL_win_p " " RAT_FUNC "%.3" "-" COEFFS 0 16384 0 0 0 1 /end COMPU_METHOD
/begin CHARACTERISTIC CL_ROL_win_n "ROL post-cat window lower" VALUE 0x001C34E0 /* @ECU_Address@CL_ROL_win_n@0x01011DC8@ */ ECIPP_ALIGNMENT_SWORD 2 Compu_CL_ROL_win_n -2 1.99993896484375 /end CHARACTERISTIC
/begin COMPU_METHOD Compu_CL_ROL_win_n " " RAT_FUNC "%.3" "-" COEFFS 0 16384 0 0 0 1 /end COMPU_METHOD
/begin CHARACTERISTIC CLLP_ROL_win_n "ROL post-cat window lower" VALUE 0x001C1A24 /* @ECU_Address@CLLP_ROL_win_n@0x01011DD0@ */ ECIPP_ALIGNMENT_SWORD 2 Compu_CLLP_ROL_win_n -2 1.99993896484375 /end CHARACTERISTIC
/begin COMPU_METHOD Compu_CLLP_ROL_win_n " " RAT_FUNC "%.3" "-" COEFFS 0 16384 0 0 0 1 /end COMPU_METHOD
/begin CHARACTERISTIC CLNG_ROL_win_n "ROL post-cat window lower" VALUE 0x001C298E /* @ECU_Address@CLNG_ROL_win_n@0x01011DD8@ */ ECIPP_ALIGNMENT_SWORD 2 Compu_CLNG_ROL_win_n -2 1.99993896484375 /end CHARACTERISTIC
/begin COMPU_METHOD Compu_CLNG_ROL_win_n " " RAT_FUNC "%.3" "-" COEFFS 0 16384 0 0 0 1 /end COMPU_METHOD
/begin CHARACTERISTIC CL_ROL_res_dly "ROL ctrl resume delay" VALUE 0x001C34E2 /* @ECU_Address@CL_ROL_res_dly@0x01011DE0@ */ ECIPP_ALIGNMENT_UWORD 66 Compu_CL_ROL_res_dly 0 65.535 /end CHARACTERISTIC
/begin COMPU_METHOD Compu_CL_ROL_res_dly " " RAT_FUNC "%.1" "sec" COEFFS 0 1000 0 0 0 1 /end COMPU_METHOD
/begin CHARACTERISTIC CLLP_ROL_res_dly "ROL ctrl resume delay" VALUE 0x001C1A26 /* @ECU_Address@CLLP_ROL_res_dly@0x01011DE8@ */ ECIPP_ALIGNMENT_UWORD 66 Compu_CLLP_ROL_res_dly 0 65.535 /end CHARACTERISTIC
/begin COMPU_METHOD Compu_CLLP_ROL_res_dly " " RAT_FUNC "%.1" "sec" COEFFS 0 1000 0 0 0 1 /end COMPU_METHOD
/begin CHARACTERISTIC CLNG_ROL_res_dly "ROL ctrl resume delay" VALUE 0x001C2990 /* @ECU_Address@CLNG_ROL_res_dly@0x01011DF0@ */ ECIPP_ALIGNMENT_UWORD 66 Compu_CLNG_ROL_res_dly 0 65.535 /end CHARACTERISTIC
/begin COMPU_METHOD Compu_CLNG_ROL_res_dly " " RAT_FUNC "%.1" "sec" COEFFS 0 1000 0 0 0 1 /end COMPU_METHOD
/begin CHARACTERISTIC CL_SS_dly "ROL SS trans delay" VALUE 0x001C34E4 /* @ECU_Address@CL_SS_dly@0x01011DF8@ */ ECIPP_ALIGNMENT_UWORD 66 Compu_CL_SS_dly 0 65.535 /end CHARACTERISTIC
/begin COMPU_METHOD Compu_CL_SS_dly " " RAT_FUNC "%.1" "sec" COEFFS 0 1000 0 0 0 1 /end COMPU_METHOD
/begin CHARACTERISTIC CLLP_SS_dly "ROL SS trans delay" VALUE 0x001C1A28 /* @ECU_Address@CLLP_SS_dly@0x01011E00@ */ ECIPP_ALIGNMENT_UWORD 66 Compu_CLLP_SS_dly 0 65.535 /end CHARACTERISTIC
/begin COMPU_METHOD Compu_CLLP_SS_dly " " RAT_FUNC "%.1" "sec" COEFFS 0 1000 0 0 0 1 /end COMPU_METHOD
/begin CHARACTERISTIC CLNG_SS_dly "ROL SS trans delay" VALUE 0x001C2992 /* @ECU_Address@CLNG_SS_dly@0x01011E08@ */ ECIPP_ALIGNMENT_UWORD 66 Compu_CLNG_SS_dly 0 65.535 /end CHARACTERISTIC
/begin COMPU_METHOD Compu_CLNG_SS_dly " " RAT_FUNC "%.1" "sec" COEFFS 0 1000 0 0 0 1 /end COMPU_METHOD
/begin MEASUREMENT TWCctrl_ROL_d "TWC desired ROL" FLOAT32_IEEE Compu_TWCctrl_ROL_d 0 0 -10000000000 10000000000 ECU_ADDRESS 0x01011E10 /end MEASUREMENT
/begin COMPU_METHOD Compu_TWCctrl_ROL_d " " RAT_FUNC "%.1" "%" COEFFS 0 0.01 0 0 0 1 /end COMPU_METHOD
/begin MEASUREMENT CL1_post_SS_status "Post-cat SS mode{CL1_post_SS_status&0xff=0:Steady-state}{CL1_post_SS_status&0xff=1:Transient}" UBYTE CL1_post_SS_status_COMPU_VTAB 0 0 0 255 ECU_ADDRESS 0x01011E90 BIT_MASK 0xff /end MEASUREMENT
/begin COMPU_METHOD CL1_post_SS_status_COMPU_VTAB "Verbal Table" TAB_VERB "%.0" "list" COMPU_TAB_REF CL1_post_SS_status_COMPU_VTAB_REF /end COMPU_METHOD
/begin COMPU_VTAB CL1_post_SS_status_COMPU_VTAB_REF "Verbal Table" TAB_VERB 2 0 "Steady-state" 1 "Transient" DEFAULT_VALUE "UNKNOWN" /end COMPU_VTAB
/begin MEASUREMENT CL1_post_phi_ROL "Post-cat control mode{CL1_post_phi_ROL&0xff=0:ROL}{CL1_post_phi_ROL&0xff=1:Post-Cat Phi}{CL1_post_phi_ROL&0xff=2:Temp ROL}{CL1_post_phi_ROL&0xff=3:Temp Post-Cat Phi}" UBYTE CL1_post_phi_ROL_COMPU_VTAB 0 0 0 255 ECU_ADDRESS 0x01011E98 BIT_MASK 0xff /end MEASUREMENT
/begin COMPU_METHOD CL1_post_phi_ROL_COMPU_VTAB "Verbal Table" TAB_VERB "%.0" "list" COMPU_TAB_REF CL1_post_phi_ROL_COMPU_VTAB_REF /end COMPU_METHOD
/begin COMPU_VTAB CL1_post_phi_ROL_COMPU_VTAB_REF "Verbal Table" TAB_VERB 4 0 "ROL" 1 "Post-Cat Phi" 2 "Temp ROL" 3 "Temp Post-Cat Phi" DEFAULT_VALUE "UNKNOWN" /end COMPU_VTAB
/begin CHARACTERISTIC diesel_lwld_comp_ena "Low-load compensation enable{diesel_lwld_comp_ena&0xff=0:Disabled}{diesel_lwld_comp_ena&0xff=1:Alternate 1 as offset}" VALUE 0x001c8ff3 /* @ECU_Address@diesel_lwld_comp_ena@0x01012788@ */ ECIPP_ALIGNMENT_UBYTE 255 diesel_lwld_comp_ena_COMPU_VTAB 0 255 BIT_MASK 0xff /end CHARACTERISTIC
/begin COMPU_METHOD diesel_lwld_comp_ena_COMPU_VTAB "Verbal Table" TAB_VERB "%.0" "list" COMPU_TAB_REF diesel_lwld_comp_ena_COMPU_VTAB_REF /end COMPU_METHOD
/begin COMPU_VTAB diesel_lwld_comp_ena_COMPU_VTAB_REF "Verbal Table" TAB_VERB 2 0 "Disabled" 1 "Alternate 1 as offset" DEFAULT_VALUE "UNKNOWN" /end COMPU_VTAB
/begin CHARACTERISTIC diesel_lwld_spd_thld "Low-load speed threshold" VALUE 0x001c8414 /* @ECU_Address@diesel_lwld_spd_thld@0x01012790@ */ ECIPP_ALIGNMENT_UWORD 65535 Compu_diesel_lwld_spd_thld 0 65535 /end CHARACTERISTIC
/begin COMPU_METHOD Compu_diesel_lwld_spd_thld " " RAT_FUNC "%.0" "rpm" COEFFS 0 1 0 0 0 1 /end COMPU_METHOD
/begin CHARACTERISTIC diesel_lwld_ld_thld "Low-load load threshold" VALUE 0x001c840a /* @ECU_Address@diesel_lwld_ld_thld@0x01012798@ */ ECIPP_ALIGNMENT_UWORD 100 Compu_diesel_lwld_ld_thld 0 99.9984741210938 /end CHARACTERISTIC
/begin COMPU_METHOD Compu_diesel_lwld_ld_thld " " RAT_FUNC "%.0" "%" COEFFS 0 655.36 0 0 0 1 /end COMPU_METHOD
/begin CHARACTERISTIC diesel_lwld_low_wait "Low-load wait time" VALUE 0x001c840e /* @ECU_Address@diesel_lwld_low_wait@0x010127A0@ */ ECIPP_ALIGNMENT_UWORD 65535 Compu_diesel_lwld_low_wait 0 65535 /end CHARACTERISTIC
/begin COMPU_METHOD Compu_diesel_lwld_low_wait " " RAT_FUNC "%.1" "sec" COEFFS 0 1 0 0 0 1 /end COMPU_METHOD
/begin CHARACTERISTIC diesel_lwld_low_slew "Low-load slew rate" VALUE 0x001c840c /* @ECU_Address@diesel_lwld_low_slew@0x010127A8@ */ ECIPP_ALIGNMENT_UWORD 100 Compu_diesel_lwld_low_slew 0 99.9984741210938 /end CHARACTERISTIC
/begin COMPU_METHOD Compu_diesel_lwld_low_slew " " RAT_FUNC "%.1" "%/sec" COEFFS 0 655.36 0 0 0 1 /end COMPU_METHOD
/begin CHARACTERISTIC diesel_lwld_nrm_wait "Normal mode wait time" VALUE 0x001c8412 /* @ECU_Address@diesel_lwld_nrm_wait@0x010127B0@ */ ECIPP_ALIGNMENT_UWORD 65535 Compu_diesel_lwld_nrm_wait 0 65535 /end CHARACTERISTIC
/begin COMPU_METHOD Compu_diesel_lwld_nrm_wait " " RAT_FUNC "%.1" "sec" COEFFS 0 1 0 0 0 1 /end COMPU_METHOD
/begin CHARACTERISTIC diesel_lwld_nrm_slew "Normal mode slew rate" VALUE 0x001c8410 /* @ECU_Address@diesel_lwld_nrm_slew@0x010127B8@ */ ECIPP_ALIGNMENT_UWORD 100 Compu_diesel_lwld_nrm_slew 0 99.9984741210938 /end CHARACTERISTIC
/begin COMPU_METHOD Compu_diesel_lwld_nrm_slew " " RAT_FUNC "%.1" "%/sec" COEFFS 0 655.36 0 0 0 1 /end COMPU_METHOD
/begin MEASUREMENT diesel_lwld_state "Low-load compensation state{diesel_lwld_state&0xff=0:Normal}{diesel_lwld_state&0xff=1:Low-load waiting}{diesel_lwld_state&0xff=2:Low-load slewing}{diesel_lwld_state&0xff=3:Low-load}{diesel_lwld_state&0xff=4:Normal waiting}{diesel_lwld_state&0xff=5:Normal " UBYTE diesel_lwld_state_COMPU_VTAB 0 0 0 255 ECU_ADDRESS 0x010127C0 BIT_MASK 0xff /end MEASUREMENT
/begin COMPU_METHOD diesel_lwld_state_COMPU_VTAB "Verbal Table" TAB_VERB "%.0" "list" COMPU_TAB_REF diesel_lwld_state_COMPU_VTAB_REF /end COMPU_METHOD
/begin COMPU_VTAB diesel_lwld_state_COMPU_VTAB_REF "Verbal Table" TAB_VERB 7 0 "Normal" 1 "Low-load waiting" 2 "Low-load slewing" 3 "Low-load" 4 "Normal waiting" 5 "Normal slewing" 6 "Low-load initialized" DEFAULT_VALUE "UNKNOWN" /end COMPU_VTAB
/begin MEASUREMENT diesel_lwld_timer "Mode change timer" ULONG Compu_diesel_lwld_timer 0 0 0 4294967.295 ECU_ADDRESS 0x010127C8 /end MEASUREMENT
/begin COMPU_METHOD Compu_diesel_lwld_timer " " RAT_FUNC "%.1" "sec" COEFFS 0 1000 0 0 0 1 /end COMPU_METHOD
/begin MEASUREMENT diesel_lwld_slewval "Low-load compensation factor" UWORD Compu_diesel_lwld_slewval 0 0 0 99.9984741210938 ECU_ADDRESS 0x010127D0 /end MEASUREMENT
/begin COMPU_METHOD Compu_diesel_lwld_slewval " " RAT_FUNC "%.1" "%" COEFFS 0 655.36 0 0 0 1 /end COMPU_METHOD
/begin CHARACTERISTIC TWCctrl_CBT_FSO_ena "ROL control min CBT & FSO req.{TWCctrl_CBT_FSO_ena&0xff=0:NO}{TWCctrl_CBT_FSO_ena&0xff=1:YES}" VALUE 0x001c8f63 /* @ECU_Address@TWCctrl_CBT_FSO_ena@0x01012D88@ */ ECIPP_ALIGNMENT_UBYTE 255 TWCctrl_CBT_FSO_ena_COMPU_VTAB 0 255 BIT_MASK 0xff /end CHARACTERISTIC
/begin COMPU_METHOD TWCctrl_CBT_FSO_ena_COMPU_VTAB "Verbal Table" TAB_VERB "%.0" "list" COMPU_TAB_REF TWCctrl_CBT_FSO_ena_COMPU_VTAB_REF /end COMPU_METHOD
/begin COMPU_VTAB TWCctrl_CBT_FSO_ena_COMPU_VTAB_REF "Verbal Table" TAB_VERB 2 0 "NO" 1 "YES" DEFAULT_VALUE "UNKNOWN" /end COMPU_VTAB
/begin CHARACTERISTIC TWCctrl_CBT_min "ROL control min CBT threshold" VALUE 0x001c8260 /* @ECU_Address@TWCctrl_CBT_min@0x01012D90@ */ ECIPP_ALIGNMENT_UWORD 7732 Compu_TWCctrl_CBT_min -460 7731.875 /end CHARACTERISTIC
/begin COMPU_METHOD Compu_TWCctrl_CBT_min " " RAT_FUNC "%.0" "deg F" COEFFS 0 8 3680 0 0 1 /end COMPU_METHOD
/begin MEASUREMENT CL1_CBT_hot "CBT threshold exceeded{CL1_CBT_hot&0xff=0:NO}{CL1_CBT_hot&0xff=1:YES}{CL1_CBT_hot&0xff=2:N/A}" UBYTE CL1_CBT_hot_COMPU_VTAB 0 0 0 255 ECU_ADDRESS 0x01012D98 BIT_MASK 0xff /end MEASUREMENT
/begin COMPU_METHOD CL1_CBT_hot_COMPU_VTAB "Verbal Table" TAB_VERB "%.0" "list" COMPU_TAB_REF CL1_CBT_hot_COMPU_VTAB_REF /end COMPU_METHOD
/begin COMPU_VTAB CL1_CBT_hot_COMPU_VTAB_REF "Verbal Table" TAB_VERB 3 0 "NO" 1 "YES" 2 "N/A" DEFAULT_VALUE "UNKNOWN" /end COMPU_VTAB
/begin MEASUREMENT CL1_FSO_occurred "Lean FSO occurred{CL1_FSO_occurred&0xff=0:NO}{CL1_FSO_occurred&0xff=1:YES}{CL1_FSO_occurred&0xff=2:N/A}" UBYTE CL1_FSO_occurred_COMPU_VTAB 0 0 0 255 ECU_ADDRESS 0x01012DA0 BIT_MASK 0xff /end MEASUREMENT
/begin COMPU_METHOD CL1_FSO_occurred_COMPU_VTAB "Verbal Table" TAB_VERB "%.0" "list" COMPU_TAB_REF CL1_FSO_occurred_COMPU_VTAB_REF /end COMPU_METHOD
/begin COMPU_VTAB CL1_FSO_occurred_COMPU_VTAB_REF "Verbal Table" TAB_VERB 3 0 "NO" 1 "YES" 2 "N/A" DEFAULT_VALUE "UNKNOWN" /end COMPU_VTAB
/begin MEASUREMENT CLp_fastwr_cs_state "CL UEGO cold start state{CLp_fastwr_cs_state&0xff=0:Waiting for start}{CLp_fastwr_cs_state&0xff=1:Active}{CLp_fastwr_cs_state&0xff=10:Disabled}{CLp_fastwr_cs_state&0xff=11:Timed out}{CLp_fastwr_cs_state&0xff=12:Inactive}{CLp_fastwr_cs_state&0xff=13:Comple" UBYTE CLp_fastwr_cs_state_COMPU_VTAB 0 0 0 255 ECU_ADDRESS 0x01013800 BIT_MASK 0xff /end MEASUREMENT
/begin COMPU_METHOD CLp_fastwr_cs_state_COMPU_VTAB "Verbal Table" TAB_VERB "%.0" "list" COMPU_TAB_REF CLp_fastwr_cs_state_COMPU_VTAB_REF /end COMPU_METHOD
/begin COMPU_VTAB CLp_fastwr_cs_state_COMPU_VTAB_REF "Verbal Table" TAB_VERB 6 0 "Waiting for start" 1 "Active" 10 "Disabled" 11 "Timed out" 12 "Inactive" 13 "Complete" DEFAULT_VALUE "UNKNOWN" /end COMPU_VTAB
/begin CHARACTERISTIC CLp_fastwr_cs_CBT "CL UEGO cold start CBT" VALUE 0x001c6e2a /* @ECU_Address@CLp_fastwr_cs_CBT@0x01013808@ */ ECIPP_ALIGNMENT_UWORD 7732 Compu_CLp_fastwr_cs_CBT -460 7731.875 /end CHARACTERISTIC
/begin COMPU_METHOD Compu_CLp_fastwr_cs_CBT " " RAT_FUNC "%.0" "deg F" COEFFS 0 8 3680 0 0 1 /end COMPU_METHOD
/begin MEASUREMENT Phi_post_cs_state "Postcat cold start state{Phi_post_cs_state&0xff=0:Waiting for start}{Phi_post_cs_state&0xff=1:Active}{Phi_post_cs_state&0xff=10:Disabled}{Phi_post_cs_state&0xff=11:Timed out}{Phi_post_cs_state&0xff=12:Inactive}{Phi_post_cs_state&0xff=13:Complete}" UBYTE Phi_post_cs_state_COMPU_VTAB 0 0 0 255 ECU_ADDRESS 0x01013810 BIT_MASK 0xff /end MEASUREMENT
/begin COMPU_METHOD Phi_post_cs_state_COMPU_VTAB "Verbal Table" TAB_VERB "%.0" "list" COMPU_TAB_REF Phi_post_cs_state_COMPU_VTAB_REF /end COMPU_METHOD
/begin COMPU_VTAB Phi_post_cs_state_COMPU_VTAB_REF "Verbal Table" TAB_VERB 6 0 "Waiting for start" 1 "Active" 10 "Disabled" 11 "Timed out" 12 "Inactive" 13 "Complete" DEFAULT_VALUE "UNKNOWN" /end COMPU_VTAB
/begin CHARACTERISTIC Phi_post_cs_CBT "Postcat cold start CBT" VALUE 0x001c7e92 /* @ECU_Address@Phi_post_cs_CBT@0x01013818@ */ ECIPP_ALIGNMENT_UWORD 7732 Compu_Phi_post_cs_CBT -460 7731.875 /end CHARACTERISTIC
/begin COMPU_METHOD Compu_Phi_post_cs_CBT " " RAT_FUNC "%.0" "deg F" COEFFS 0 8 3680 0 0 1 /end COMPU_METHOD
/begin CHARACTERISTIC CL_postcat_winpdlt "Post-cat window high delta" VALUE 0x001C34EC /* @ECU_Address@CL_postcat_winpdlt@0x01013820@ */ ECIPP_ALIGNMENT_SWORD 2 Compu_CL_postcat_winpdlt -2 1.99993896484375 /end CHARACTERISTIC
/begin COMPU_METHOD Compu_CL_postcat_winpdlt " " RAT_FUNC "%.3" "-" COEFFS 0 16384 0 0 0 1 /end COMPU_METHOD
/begin CHARACTERISTIC CLLP_postcat_winpdlt "Post-cat window high delta" VALUE 0x001C1A30 /* @ECU_Address@CLLP_postcat_winpdlt@0x01013828@ */ ECIPP_ALIGNMENT_SWORD 2 Compu_CLLP_postcat_winpdlt -2 1.99993896484375 /end CHARACTERISTIC
/begin COMPU_METHOD Compu_CLLP_postcat_winpdlt " " RAT_FUNC "%.3" "-" COEFFS 0 16384 0 0 0 1 /end COMPU_METHOD
/begin CHARACTERISTIC CLNG_postcat_winpdlt "Post-cat window high delta" VALUE 0x001C299A /* @ECU_Address@CLNG_postcat_winpdlt@0x01013830@ */ ECIPP_ALIGNMENT_SWORD 2 Compu_CLNG_postcat_winpdlt -2 1.99993896484375 /end CHARACTERISTIC
/begin COMPU_METHOD Compu_CLNG_postcat_winpdlt " " RAT_FUNC "%.3" "-" COEFFS 0 16384 0 0 0 1 /end COMPU_METHOD
/begin CHARACTERISTIC CL_postcat_winndlt "Post-cat window low delta" VALUE 0x001C34EE /* @ECU_Address@CL_postcat_winndlt@0x01013838@ */ ECIPP_ALIGNMENT_SWORD 2 Compu_CL_postcat_winndlt -2 1.99993896484375 /end CHARACTERISTIC
/begin COMPU_METHOD Compu_CL_postcat_winndlt " " RAT_FUNC "%.3" "-" COEFFS 0 16384 0 0 0 1 /end COMPU_METHOD
/begin CHARACTERISTIC CLLP_postcat_winndlt "Post-cat window low delta" VALUE 0x001C1A32 /* @ECU_Address@CLLP_postcat_winndlt@0x01013840@ */ ECIPP_ALIGNMENT_SWORD 2 Compu_CLLP_postcat_winndlt -2 1.99993896484375 /end CHARACTERISTIC
/begin COMPU_METHOD Compu_CLLP_postcat_winndlt " " RAT_FUNC "%.3" "-" COEFFS 0 16384 0 0 0 1 /end COMPU_METHOD
/begin CHARACTERISTIC CLNG_postcat_winndlt "Post-cat window low delta" VALUE 0x001C299C /* @ECU_Address@CLNG_postcat_winndlt@0x01013848@ */ ECIPP_ALIGNMENT_SWORD 2 Compu_CLNG_postcat_winndlt -2 1.99993896484375 /end CHARACTERISTIC
/begin COMPU_METHOD Compu_CLNG_postcat_winndlt " " RAT_FUNC "%.3" "-" COEFFS 0 16384 0 0 0 1 /end COMPU_METHOD
/begin CHARACTERISTIC CL_ROLend_fastwrtm "Post-cat Temp Phi cont CL" VALUE 0x001C34F0 /* @ECU_Address@CL_ROLend_fastwrtm@0x01013850@ */ ECIPP_ALIGNMENT_UWORD 66 Compu_CL_ROLend_fastwrtm 0 65.535 /end CHARACTERISTIC
/begin COMPU_METHOD Compu_CL_ROLend_fastwrtm " " RAT_FUNC "%.2" "sec" COEFFS 0 1000 0 0 0 1 /end COMPU_METHOD
/begin CHARACTERISTIC CLLP_ROLend_fastwrtm "Post-cat Temp Phi cont CL" VALUE 0x001C1A34 /* @ECU_Address@CLLP_ROLend_fastwrtm@0x01013858@ */ ECIPP_ALIGNMENT_UWORD 66 Compu_CLLP_ROLend_fastwrtm 0 65.535 /end CHARACTERISTIC
/begin COMPU_METHOD Compu_CLLP_ROLend_fastwrtm " " RAT_FUNC "%.2" "sec" COEFFS 0 1000 0 0 0 1 /end COMPU_METHOD
/begin CHARACTERISTIC CLNG_ROLend_fastwrtm "Post-cat Temp Phi cont CL" VALUE 0x001C299E /* @ECU_Address@CLNG_ROLend_fastwrtm@0x01013860@ */ ECIPP_ALIGNMENT_UWORD 66 Compu_CLNG_ROLend_fastwrtm 0 65.535 /end CHARACTERISTIC
/begin COMPU_METHOD Compu_CLNG_ROLend_fastwrtm " " RAT_FUNC "%.2" "sec" COEFFS 0 1000 0 0 0 1 /end COMPU_METHOD
/begin CHARACTERISTIC CL_post_fastwr_tm "Post-cat Phi cont CL time" VALUE 0x001C34F2 /* @ECU_Address@CL_post_fastwr_tm@0x01013868@ */ ECIPP_ALIGNMENT_UWORD 66 Compu_CL_post_fastwr_tm 0 65.535 /end CHARACTERISTIC
/begin COMPU_METHOD Compu_CL_post_fastwr_tm " " RAT_FUNC "%.2" "sec" COEFFS 0 1000 0 0 0 1 /end COMPU_METHOD
/begin CHARACTERISTIC CLLP_post_fastwr_tm "Post-cat Phi cont CL time" VALUE 0x001C1A36 /* @ECU_Address@CLLP_post_fastwr_tm@0x01013870@ */ ECIPP_ALIGNMENT_UWORD 66 Compu_CLLP_post_fastwr_tm 0 65.535 /end CHARACTERISTIC
/begin COMPU_METHOD Compu_CLLP_post_fastwr_tm " " RAT_FUNC "%.2" "sec" COEFFS 0 1000 0 0 0 1 /end COMPU_METHOD
/begin CHARACTERISTIC CLNG_post_fastwr_tm "Post-cat Phi cont CL time" VALUE 0x001C29A0 /* @ECU_Address@CLNG_post_fastwr_tm@0x01013878@ */ ECIPP_ALIGNMENT_UWORD 66 Compu_CLNG_post_fastwr_tm 0 65.535 /end CHARACTERISTIC
/begin COMPU_METHOD Compu_CLNG_post_fastwr_tm " " RAT_FUNC "%.2" "sec" COEFFS 0 1000 0 0 0 1 /end COMPU_METHOD
/begin MEASUREMENT CL1_ROL_win_p_th "ROL window high limit" UWORD Compu_CL1_ROL_win_p_th 0 0 0 3.99993896484375 ECU_ADDRESS 0x01013880 /end MEASUREMENT
/begin COMPU_METHOD Compu_CL1_ROL_win_p_th " " RAT_FUNC "%.3" "phi" COEFFS 0 16384 0 0 0 1 /end COMPU_METHOD
/begin MEASUREMENT CL1_ROL_win_n_th "ROL window low limit" UWORD Compu_CL1_ROL_win_n_th 0 0 0 3.99993896484375 ECU_ADDRESS 0x01013888 /end MEASUREMENT
/begin COMPU_METHOD Compu_CL1_ROL_win_n_th " " RAT_FUNC "%.3" "phi" COEFFS 0 16384 0 0 0 1 /end COMPU_METHOD
/begin MEASUREMENT CL1_postcat_hi_th "Post-cat window high limit" UWORD Compu_CL1_postcat_hi_th 0 0 0 3.99993896484375 ECU_ADDRESS 0x01013890 /end MEASUREMENT
/begin COMPU_METHOD Compu_CL1_postcat_hi_th " " RAT_FUNC "%.3" "phi" COEFFS 0 16384 0 0 0 1 /end COMPU_METHOD
/begin MEASUREMENT CL1_postcat_lo_th "Post-cat window low limit" UWORD Compu_CL1_postcat_lo_th 0 0 0 3.99993896484375 ECU_ADDRESS 0x01013898 /end MEASUREMENT
/begin COMPU_METHOD Compu_CL1_postcat_lo_th " " RAT_FUNC "%.3" "phi" COEFFS 0 16384 0 0 0 1 /end COMPU_METHOD
/begin CHARACTERISTIC diesel_lwld_ini_wait "Low-load init. wait time" VALUE 0x001c8408 /* @ECU_Address@diesel_lwld_ini_wait@0x01013A58@ */ ECIPP_ALIGNMENT_UWORD 65535 Compu_diesel_lwld_ini_wait 0 65535 /end CHARACTERISTIC
/begin COMPU_METHOD Compu_diesel_lwld_ini_wait " " RAT_FUNC "%.1" "sec" COEFFS 0 1 0 0 0 1 /end COMPU_METHOD
/begin CHARACTERISTIC CL_ROLend_tm_mode "Post-cat Temp Phi mode{CL_ROLend_tm_mode&0xff=0:Lean Only}{CL_ROLend_tm_mode&0xff=1:Lean or Rich}" VALUE 0x001C34F4 /* @ECU_Address@CL_ROLend_tm_mode@0x01014860@ */ ECIPP_ALIGNMENT_UBYTE 255 CL_ROLend_tm_mode_COMPU_VTAB 0 255 BIT_MASK 0xff /end CHARACTERISTIC
/begin COMPU_METHOD CL_ROLend_tm_mode_COMPU_VTAB "Verbal Table" TAB_VERB "%.0" "list" COMPU_TAB_REF CL_ROLend_tm_mode_COMPU_VTAB_REF /end COMPU_METHOD
/begin COMPU_VTAB CL_ROLend_tm_mode_COMPU_VTAB_REF "Verbal Table" TAB_VERB 2 0 "Lean Only" 1 "Lean or Rich" DEFAULT_VALUE "UNKNOWN" /end COMPU_VTAB
/begin CHARACTERISTIC CLLP_ROLend_tm_mode "Post-cat Temp Phi mode{CLLP_ROLend_tm_mode&0xff=0:Lean Only}{CLLP_ROLend_tm_mode&0xff=1:Lean or Rich}" VALUE 0x001C1A38 /* @ECU_Address@CLLP_ROLend_tm_mode@0x01014868@ */ ECIPP_ALIGNMENT_UBYTE 255 CLLP_ROLend_tm_mode_COMPU_VTAB 0 255 BIT_MASK 0xff /end CHARACTERISTIC
/begin COMPU_METHOD CLLP_ROLend_tm_mode_COMPU_VTAB "Verbal Table" TAB_VERB "%.0" "list" COMPU_TAB_REF CLLP_ROLend_tm_mode_COMPU_VTAB_REF /end COMPU_METHOD
/begin COMPU_VTAB CLLP_ROLend_tm_mode_COMPU_VTAB_REF "Verbal Table" TAB_VERB 2 0 "Lean Only" 1 "Lean or Rich" DEFAULT_VALUE "UNKNOWN" /end COMPU_VTAB
/begin CHARACTERISTIC CLNG_ROLend_tm_mode "Post-cat Temp Phi mode{CLNG_ROLend_tm_mode&0xff=0:Lean Only}{CLNG_ROLend_tm_mode&0xff=1:Lean or Rich}" VALUE 0x001C29A2 /* @ECU_Address@CLNG_ROLend_tm_mode@0x01014870@ */ ECIPP_ALIGNMENT_UBYTE 255 CLNG_ROLend_tm_mode_COMPU_VTAB 0 255 BIT_MASK 0xff /end CHARACTERISTIC
/begin COMPU_METHOD CLNG_ROLend_tm_mode_COMPU_VTAB "Verbal Table" TAB_VERB "%.0" "list" COMPU_TAB_REF CLNG_ROLend_tm_mode_COMPU_VTAB_REF /end COMPU_METHOD
/begin COMPU_VTAB CLNG_ROLend_tm_mode_COMPU_VTAB_REF "Verbal Table" TAB_VERB 2 0 "Lean Only" 1 "Lean or Rich" DEFAULT_VALUE "UNKNOWN" /end COMPU_VTAB
/begin CHARACTERISTIC CL_ROL_trans_mode "ROL transition mode{CL_ROL_trans_mode&0xff=0:Legacy}{CL_ROL_trans_mode&0xff=1:Enhanced - Unidirectional}{CL_ROL_trans_mode&0xff=2:Enhanced - Bidirectional}" VALUE 0x001C34F5 /* @ECU_Address@CL_ROL_trans_mode@0x01014878@ */ ECIPP_ALIGNMENT_UBYTE 255 CL_ROL_trans_mode_COMPU_VTAB 0 255 BIT_MASK 0xff /end CHARACTERISTIC
/begin COMPU_METHOD CL_ROL_trans_mode_COMPU_VTAB "Verbal Table" TAB_VERB "%.0" "list" COMPU_TAB_REF CL_ROL_trans_mode_COMPU_VTAB_REF /end COMPU_METHOD
/begin COMPU_VTAB CL_ROL_trans_mode_COMPU_VTAB_REF "Verbal Table" TAB_VERB 3 0 "Legacy" 1 "Enhanced - Unidirectional" 2 "Enhanced - Bidirectional" DEFAULT_VALUE "UNKNOWN" /end COMPU_VTAB
/begin CHARACTERISTIC CLLP_ROL_trans_mode "ROL transition mode{CLLP_ROL_trans_mode&0xff=0:Legacy}{CLLP_ROL_trans_mode&0xff=1:Enhanced - Unidirectional}{CLLP_ROL_trans_mode&0xff=2:Enhanced - Bidirectional}" VALUE 0x001C1A39 /* @ECU_Address@CLLP_ROL_trans_mode@0x01014880@ */ ECIPP_ALIGNMENT_UBYTE 255 CLLP_ROL_trans_mode_COMPU_VTAB 0 255 BIT_MASK 0xff /end CHARACTERISTIC
/begin COMPU_METHOD CLLP_ROL_trans_mode_COMPU_VTAB "Verbal Table" TAB_VERB "%.0" "list" COMPU_TAB_REF CLLP_ROL_trans_mode_COMPU_VTAB_REF /end COMPU_METHOD
/begin COMPU_VTAB CLLP_ROL_trans_mode_COMPU_VTAB_REF "Verbal Table" TAB_VERB 3 0 "Legacy" 1 "Enhanced - Unidirectional" 2 "Enhanced - Bidirectional" DEFAULT_VALUE "UNKNOWN" /end COMPU_VTAB
/begin CHARACTERISTIC CLNG_ROL_trans_mode "ROL transition mode{CLNG_ROL_trans_mode&0xff=0:Legacy}{CLNG_ROL_trans_mode&0xff=1:Enhanced - Unidirectional}{CLNG_ROL_trans_mode&0xff=2:Enhanced - Bidirectional}" VALUE 0x001C29A3 /* @ECU_Address@CLNG_ROL_trans_mode@0x01014888@ */ ECIPP_ALIGNMENT_UBYTE 255 CLNG_ROL_trans_mode_COMPU_VTAB 0 255 BIT_MASK 0xff /end CHARACTERISTIC
/begin COMPU_METHOD CLNG_ROL_trans_mode_COMPU_VTAB "Verbal Table" TAB_VERB "%.0" "list" COMPU_TAB_REF CLNG_ROL_trans_mode_COMPU_VTAB_REF /end COMPU_METHOD
/begin COMPU_VTAB CLNG_ROL_trans_mode_COMPU_VTAB_REF "Verbal Table" TAB_VERB 3 0 "Legacy" 1 "Enhanced - Unidirectional" 2 "Enhanced - Bidirectional" DEFAULT_VALUE "UNKNOWN" /end COMPU_VTAB
/begin CHARACTERISTIC SPL_NG_ena "Single-point learn{SPL_NG_ena&0xff=0:Disabled}{SPL_NG_ena&0xff=1:Enabled - Unidirectional}{SPL_NG_ena&0xff=2:Enabled - Bidirectional}" VALUE 0x001c890d /* @ECU_Address@SPL_NG_ena@0x01014C80@ */ ECIPP_ALIGNMENT_UBYTE 255 SPL_NG_ena_COMPU_VTAB 0 255 BIT_MASK 0xff /end CHARACTERISTIC
/begin COMPU_METHOD SPL_NG_ena_COMPU_VTAB "Verbal Table" TAB_VERB "%.0" "list" COMPU_TAB_REF SPL_NG_ena_COMPU_VTAB_REF /end COMPU_METHOD
/begin COMPU_VTAB SPL_NG_ena_COMPU_VTAB_REF "Verbal Table" TAB_VERB 3 0 "Disabled" 1 "Enabled - Unidirectional" 2 "Enabled - Bidirectional" DEFAULT_VALUE "UNKNOWN" /end COMPU_VTAB
/begin CHARACTERISTIC SPL_NG_run_min "Single-point run time min" VALUE 0x001c4394 /* @ECU_Address@SPL_NG_run_min@0x01014C88@ */ ECIPP_ALIGNMENT_ULONG 4294967 Compu_SPL_NG_run_min 0 4294967.295 /end CHARACTERISTIC
/begin COMPU_METHOD Compu_SPL_NG_run_min " " RAT_FUNC "%.0" "sec" COEFFS 0 1000 0 0 0 1 /end COMPU_METHOD
/begin CHARACTERISTIC SPL_NG_ECT_min "Single-point ECT min" VALUE 0x001c7f74 /* @ECU_Address@SPL_NG_ECT_min@0x01014C90@ */ ECIPP_ALIGNMENT_UWORD 564 Compu_SPL_NG_ECT_min -460 563.984375 /end CHARACTERISTIC
/begin COMPU_METHOD Compu_SPL_NG_ECT_min " " RAT_FUNC "%.1" "deg F" COEFFS 0 64 29440 0 0 1 /end COMPU_METHOD
/begin CHARACTERISTIC SPL_NG_rpm_min "Single-point window speed min" VALUE 0x001c7f7c /* @ECU_Address@SPL_NG_rpm_min@0x01014C98@ */ ECIPP_ALIGNMENT_UWORD 65535 Compu_SPL_NG_rpm_min 0 65535 /end CHARACTERISTIC
/begin COMPU_METHOD Compu_SPL_NG_rpm_min " " RAT_FUNC "%.0" "rpm" COEFFS 0 1 0 0 0 1 /end COMPU_METHOD
/begin CHARACTERISTIC SPL_NG_rpm_max "Single-point window speed max" VALUE 0x001c7f7a /* @ECU_Address@SPL_NG_rpm_max@0x01014CA0@ */ ECIPP_ALIGNMENT_UWORD 65535 Compu_SPL_NG_rpm_max 0 65535 /end CHARACTERISTIC
/begin COMPU_METHOD Compu_SPL_NG_rpm_max " " RAT_FUNC "%.0" "rpm" COEFFS 0 1 0 0 0 1 /end COMPU_METHOD
/begin CHARACTERISTIC SPL_NG_MAPload_min "Single-point window MAP-load min" VALUE 0x001c7f78 /* @ECU_Address@SPL_NG_MAPload_min@0x01014CA8@ */ ECIPP_ALIGNMENT_UWORD 256 Compu_SPL_NG_MAPload_min 0 255.99609375 /end CHARACTERISTIC
/begin COMPU_METHOD Compu_SPL_NG_MAPload_min " " RAT_FUNC "%.2" "psia" COEFFS 0 256 0 0 0 1 /end COMPU_METHOD
/begin CHARACTERISTIC SPL_NG_MAPload_max "Single-point window MAP-load max" VALUE 0x001c7f76 /* @ECU_Address@SPL_NG_MAPload_max@0x01014CB0@ */ ECIPP_ALIGNMENT_UWORD 256 Compu_SPL_NG_MAPload_max 0 255.99609375 /end CHARACTERISTIC
/begin COMPU_METHOD Compu_SPL_NG_MAPload_max " " RAT_FUNC "%.2" "psia" COEFFS 0 256 0 0 0 1 /end COMPU_METHOD
/begin CHARACTERISTIC SPL_NG_stable_time "Single-point stabilization time" VALUE 0x001c7f7e /* @ECU_Address@SPL_NG_stable_time@0x01014CB8@ */ ECIPP_ALIGNMENT_UWORD 66 Compu_SPL_NG_stable_time 0 65.535 /end CHARACTERISTIC
/begin COMPU_METHOD Compu_SPL_NG_stable_time " " RAT_FUNC "%.1" "sec" COEFFS 0 1000 0 0 0 1 /end COMPU_METHOD
/begin CHARACTERISTIC SPL_NG_eval_time "Single-point evaluation time" VALUE 0x001c4390 /* @ECU_Address@SPL_NG_eval_time@0x01014CC0@ */ ECIPP_ALIGNMENT_ULONG 4294967 Compu_SPL_NG_eval_time 0 4294967.295 /end CHARACTERISTIC
/begin COMPU_METHOD Compu_SPL_NG_eval_time " " RAT_FUNC "%.0" "sec" COEFFS 0 1000 0 0 0 1 /end COMPU_METHOD
/begin CHARACTERISTIC SPL_NG_BM_nominal "Single-point fuel correction nominal" VALUE 0x001c45a6 /* @ECU_Address@SPL_NG_BM_nominal@0x01014CC8@ */ ECIPP_ALIGNMENT_SWORD 100 Compu_SPL_NG_BM_nominal -100 99.9969482421875 /end CHARACTERISTIC
/begin COMPU_METHOD Compu_SPL_NG_BM_nominal " " RAT_FUNC "%.1" "%" COEFFS 0 327.68 0 0 0 1 /end COMPU_METHOD
/begin CHARACTERISTIC SPL_NG_BM_high "Single-point fuel correction high" VALUE 0x001c45a4 /* @ECU_Address@SPL_NG_BM_high@0x01014CD0@ */ ECIPP_ALIGNMENT_SWORD 100 Compu_SPL_NG_BM_high -100 99.9969482421875 /end CHARACTERISTIC
/begin COMPU_METHOD Compu_SPL_NG_BM_high " " RAT_FUNC "%.1" "%" COEFFS 0 327.68 0 0 0 1 /end COMPU_METHOD
/begin MEASUREMENT SPL_mon_state "Single-point learn state{SPL_mon_state&0xff=0:Disabled}{SPL_mon_state&0xff=1:Engine off}{SPL_mon_state&0xff=2:Waiting for warm up}{SPL_mon_state&0xff=3:Waiting for stabilization}{SPL_mon_state&0xff=4:Sampling in progress}{SPL_mon_state&0xff=5:Sampling com" UBYTE SPL_mon_state_COMPU_VTAB 0 0 0 255 ECU_ADDRESS 0x01014CD8 BIT_MASK 0xff /end MEASUREMENT
/begin COMPU_METHOD SPL_mon_state_COMPU_VTAB "Verbal Table" TAB_VERB "%.0" "list" COMPU_TAB_REF SPL_mon_state_COMPU_VTAB_REF /end COMPU_METHOD
/begin COMPU_VTAB SPL_mon_state_COMPU_VTAB_REF "Verbal Table" TAB_VERB 6 0 "Disabled" 1 "Engine off" 2 "Waiting for warm up" 3 "Waiting for stabilization" 4 "Sampling in progress" 5 "Sampling complete" DEFAULT_VALUE "UNKNOWN" /end COMPU_VTAB
/begin MEASUREMENT SPL_eval_tmr "Single-point learn evaluation timer" ULONG Compu_SPL_eval_tmr 0 0 0 4294967.295 ECU_ADDRESS 0x01014CE0 /end MEASUREMENT
/begin COMPU_METHOD Compu_SPL_eval_tmr " " RAT_FUNC "%.0" "sec" COEFFS 0 1000 0 0 0 1 /end COMPU_METHOD
/begin MEASUREMENT SPL_BM "Single-point learn fuel correction" SWORD Compu_SPL_BM 0 0 -100 99.9969482421875 ECU_ADDRESS 0x01014CE8 /end MEASUREMENT
/begin COMPU_METHOD Compu_SPL_BM " " RAT_FUNC "%.1" "%" COEFFS 0 327.68 0 0 0 1 /end COMPU_METHOD
/begin CHARACTERISTIC TWCctrl_ROL_d_sel "TWC control ROL set point selection{TWCctrl_ROL_d_sel&0xff=0:Single Point}{TWCctrl_ROL_d_sel&0xff=1:Table Based}" VALUE 0x001c8f64 /* @ECU_Address@TWCctrl_ROL_d_sel@0x01014F00@ */ ECIPP_ALIGNMENT_UBYTE 255 TWCctrl_ROL_d_sel_COMPU_VTAB 0 255 BIT_MASK 0xff /end CHARACTERISTIC
/begin COMPU_METHOD TWCctrl_ROL_d_sel_COMPU_VTAB "Verbal Table" TAB_VERB "%.0" "list" COMPU_TAB_REF TWCctrl_ROL_d_sel_COMPU_VTAB_REF /end COMPU_METHOD
/begin COMPU_VTAB TWCctrl_ROL_d_sel_COMPU_VTAB_REF "Verbal Table" TAB_VERB 2 0 "Single Point" 1 "Table Based" DEFAULT_VALUE "UNKNOWN" /end COMPU_VTAB
/begin COMPU_METHOD Compu_TPhi_base_MAP " " RAT_FUNC "%.1" "MAP load (psia)" COEFFS 0 256 0 0 0 1 /end COMPU_METHOD
/begin COMPU_METHOD Compu_TPhi_base_rpm " " RAT_FUNC "%.0" "Speed (rpm)" COEFFS 0 1 0 0 0 1 /end COMPU_METHOD
/begin AXIS_PTS TPhi_base_MAP " " 0x001C2C66 /* @ECU_Address@TPhi_base_MAP@0x0201A000@ */ NO_INPUT_QUANTITY ECIPP_Lookup_SWORD 0 Compu_TPhi_base_MAP 14 -128 127.99609375 /end AXIS_PTS
/begin AXIS_PTS TPhi_base_rpm " " 0x001C2D9A /* @ECU_Address@TPhi_base_rpm@0x0201B000@ */ NO_INPUT_QUANTITY ECIPP_Lookup_SWORD 0 Compu_TPhi_base_rpm 10 -32768 32767 /end AXIS_PTS
/begin CHARACTERISTIC TCL_ena "Gasoline CL Enable Table" MAP 0x001C29BE /* @ECU_Address@TCL_ena@0x02023000@ */ ECIPP_ALIGNMENT_SWORD 128 Compu_TCL_ena -128 127.99609375
 /begin AXIS_DESCR COM_AXIS NO_INPUT_QUANTITY Compu_TPhi_base_MAP 14 -128 127.99609375 AXIS_PTS_REF TPhi_base_MAP /end AXIS_DESCR
 /begin AXIS_DESCR COM_AXIS NO_INPUT_QUANTITY Compu_TPhi_base_rpm 10 -32768 32767 AXIS_PTS_REF TPhi_base_rpm /end AXIS_DESCR
/end CHARACTERISTIC
/begin COMPU_METHOD Compu_TCL_ena "" RAT_FUNC "%.0" "CL eanble (logical)" COEFFS 0 256 0 0 0 1 /end COMPU_METHOD
/begin COMPU_METHOD Compu_TCLp_tau_rpm " " RAT_FUNC "%.0" "Speed (rpm)" COEFFS 0 1 0 0 0 1 /end COMPU_METHOD
/begin COMPU_METHOD Compu_TCLp_tau_MAP " " RAT_FUNC "%.1" "MAP (psia)" COEFFS 0 256 0 0 0 1 /end COMPU_METHOD
/begin CHARACTERISTIC TCLp_tau_cyc "Gasoline CL Switching Frequency" MAP 0x001C2BF6 /* @ECU_Address@TCLp_tau_cyc@0x0203A000@ */ ECIPP_ALIGNMENT_SWORD 2048 Compu_TCLp_tau_cyc -2048 2047.9375
 /begin AXIS_DESCR COM_AXIS NO_INPUT_QUANTITY Compu_TCLp_tau_MAP 4 -128 127.99609375 AXIS_PTS_REF TCLp_tau_MAP /end AXIS_DESCR
 /begin AXIS_DESCR COM_AXIS NO_INPUT_QUANTITY Compu_TCLp_tau_rpm 8 -32768 32767 AXIS_PTS_REF TCLp_tau_rpm /end AXIS_DESCR
/end CHARACTERISTIC
/begin AXIS_PTS TCLp_tau_MAP " " 0x001C2BEE /* @ECU_Address@TCLp_tau_MAP@0x02039000@ */ NO_INPUT_QUANTITY ECIPP_Lookup_SWORD 0 Compu_TCLp_tau_MAP 4 -128 127.99609375 /end AXIS_PTS
/begin AXIS_PTS TCLp_tau_rpm " " 0x001C2C36 /* @ECU_Address@TCLp_tau_rpm@0x02038000@ */ NO_INPUT_QUANTITY ECIPP_Lookup_SWORD 0 Compu_TCLp_tau_rpm 8 -32768 32767 /end AXIS_PTS
/begin COMPU_METHOD Compu_TCLp_tau_cyc "" RAT_FUNC "%.1" "Engine Cycles" COEFFS 0 16 0 0 0 1 /end COMPU_METHOD
/begin COMPU_METHOD Compu_TCLp_tau_rpmP " " RAT_FUNC "%.0" "Speed (rpm)" COEFFS 0 1 0 0 0 1 /end COMPU_METHOD
/begin COMPU_METHOD Compu_TCLp_tau_MAPP " " RAT_FUNC "%.1" "MAP (psia)" COEFFS 0 256 0 0 0 1 /end COMPU_METHOD
/begin CHARACTERISTIC TCLp_tau_cycP "LPG CL Switching Frequency" MAP 0x001C10C0 /* @ECU_Address@TCLp_tau_cycP@0x02063000@ */ ECIPP_ALIGNMENT_SWORD 2048 Compu_TCLp_tau_cycP -2048 2047.9375
 /begin AXIS_DESCR COM_AXIS NO_INPUT_QUANTITY Compu_TCLp_tau_MAPP 4 -128 127.99609375 AXIS_PTS_REF TCLp_tau_MAPP /end AXIS_DESCR
 /begin AXIS_DESCR COM_AXIS NO_INPUT_QUANTITY Compu_TCLp_tau_rpmP 8 -32768 32767 AXIS_PTS_REF TCLp_tau_rpmP /end AXIS_DESCR
/end CHARACTERISTIC
/begin AXIS_PTS TCLp_tau_MAPP " " 0x001C10B8 /* @ECU_Address@TCLp_tau_MAPP@0x02062000@ */ NO_INPUT_QUANTITY ECIPP_Lookup_SWORD 0 Compu_TCLp_tau_MAPP 4 -128 127.99609375 /end AXIS_PTS
/begin AXIS_PTS TCLp_tau_rpmP " " 0x001C1100 /* @ECU_Address@TCLp_tau_rpmP@0x02061000@ */ NO_INPUT_QUANTITY ECIPP_Lookup_SWORD 0 Compu_TCLp_tau_rpmP 8 -32768 32767 /end AXIS_PTS
/begin COMPU_METHOD Compu_TCLp_tau_cycP "" RAT_FUNC "%.1" "Engine Cycles" COEFFS 0 16 0 0 0 1 /end COMPU_METHOD
/begin COMPU_METHOD Compu_TCLp_tau_rpmNG " " RAT_FUNC "%.0" "Speed (rpm)" COEFFS 0 1 0 0 0 1 /end COMPU_METHOD
/begin COMPU_METHOD Compu_TCLp_tau_MAPNG " " RAT_FUNC "%.1" "MAP (psia)" COEFFS 0 256 0 0 0 1 /end COMPU_METHOD
/begin CHARACTERISTIC TCLp_tau_cycNG "NG CL switching frequency" MAP 0x001C202A /* @ECU_Address@TCLp_tau_cycNG@0x02066000@ */ ECIPP_ALIGNMENT_SWORD 2048 Compu_TCLp_tau_cycNG -2048 2047.9375
 /begin AXIS_DESCR COM_AXIS NO_INPUT_QUANTITY Compu_TCLp_tau_MAPNG 4 -128 127.99609375 AXIS_PTS_REF TCLp_tau_MAPNG /end AXIS_DESCR
 /begin AXIS_DESCR COM_AXIS NO_INPUT_QUANTITY Compu_TCLp_tau_rpmNG 8 -32768 32767 AXIS_PTS_REF TCLp_tau_rpmNG /end AXIS_DESCR
/end CHARACTERISTIC
/begin AXIS_PTS TCLp_tau_MAPNG " " 0x001C2022 /* @ECU_Address@TCLp_tau_MAPNG@0x02065000@ */ NO_INPUT_QUANTITY ECIPP_Lookup_SWORD 0 Compu_TCLp_tau_MAPNG 4 -128 127.99609375 /end AXIS_PTS
/begin AXIS_PTS TCLp_tau_rpmNG " " 0x001C206A /* @ECU_Address@TCLp_tau_rpmNG@0x02064000@ */ NO_INPUT_QUANTITY ECIPP_Lookup_SWORD 0 Compu_TCLp_tau_rpmNG 8 -32768 32767 /end AXIS_PTS
/begin COMPU_METHOD Compu_TCLp_tau_cycNG "" RAT_FUNC "%.1" "Engine Cycles" COEFFS 0 16 0 0 0 1 /end COMPU_METHOD
/begin CHARACTERISTIC TCL_enaP "LPG CL Enable Table" MAP 0x001C0E88 /* @ECU_Address@TCL_enaP@0x02067000@ */ ECIPP_ALIGNMENT_SWORD 128 Compu_TCL_enaP -128 127.99609375
 /begin AXIS_DESCR COM_AXIS NO_INPUT_QUANTITY Compu_TPhi_base_MAPP 14 -128 127.99609375 AXIS_PTS_REF TPhi_base_MAPP /end AXIS_DESCR
 /begin AXIS_DESCR COM_AXIS NO_INPUT_QUANTITY Compu_TPhi_base_rpmP 10 -32768 32767 AXIS_PTS_REF TPhi_base_rpmP /end AXIS_DESCR
/end CHARACTERISTIC
/begin AXIS_PTS TPhi_base_MAPP " " 0x001C1130 /* @ECU_Address@TPhi_base_MAPP@0x02069000@ */ NO_INPUT_QUANTITY ECIPP_Lookup_SWORD 0 Compu_TPhi_base_MAPP 14 -128 127.99609375 /end AXIS_PTS
/begin AXIS_PTS TPhi_base_rpmP " " 0x001C1264 /* @ECU_Address@TPhi_base_rpmP@0x0206A000@ */ NO_INPUT_QUANTITY ECIPP_Lookup_SWORD 0 Compu_TPhi_base_rpmP 10 -32768 32767 /end AXIS_PTS
/begin COMPU_METHOD Compu_TCL_enaP "" RAT_FUNC "%.0" "CL eanble (logical)" COEFFS 0 256 0 0 0 1 /end COMPU_METHOD
/begin CHARACTERISTIC TCL_enaNG "NG CL Enable Table" MAP 0x001C1DF2 /* @ECU_Address@TCL_enaNG@0x02068000@ */ ECIPP_ALIGNMENT_SWORD 128 Compu_TCL_enaNG -128 127.99609375
 /begin AXIS_DESCR COM_AXIS NO_INPUT_QUANTITY Compu_TPhi_base_MAPNG 14 -128 127.99609375 AXIS_PTS_REF TPhi_base_MAPNG /end AXIS_DESCR
 /begin AXIS_DESCR COM_AXIS NO_INPUT_QUANTITY Compu_TPhi_base_rpmNG 10 -32768 32767 AXIS_PTS_REF TPhi_base_rpmNG /end AXIS_DESCR
/end CHARACTERISTIC
/begin AXIS_PTS TPhi_base_MAPNG " " 0x001C209A /* @ECU_Address@TPhi_base_MAPNG@0x0206C000@ */ NO_INPUT_QUANTITY ECIPP_Lookup_SWORD 0 Compu_TPhi_base_MAPNG 14 -128 127.99609375 /end AXIS_PTS
/begin AXIS_PTS TPhi_base_rpmNG " " 0x001C21CE /* @ECU_Address@TPhi_base_rpmNG@0x0206D000@ */ NO_INPUT_QUANTITY ECIPP_Lookup_SWORD 0 Compu_TPhi_base_rpmNG 10 -32768 32767 /end AXIS_PTS
/begin COMPU_METHOD Compu_TCL_enaNG "" RAT_FUNC "%.0" "CL eanble (logical)" COEFFS 0 256 0 0 0 1 /end COMPU_METHOD
/begin COMPU_METHOD Compu_TPhi_base_MAPP " " RAT_FUNC "%.1" "MAP load (psia)" COEFFS 0 256 0 0 0 1 /end COMPU_METHOD
/begin COMPU_METHOD Compu_TPhi_base_rpmP " " RAT_FUNC "%.0" "Speed (rpm)" COEFFS 0 1 0 0 0 1 /end COMPU_METHOD
/begin COMPU_METHOD Compu_TPhi_base_MAPNG " " RAT_FUNC "%.1" "MAP load (psia)" COEFFS 0 256 0 0 0 1 /end COMPU_METHOD
/begin COMPU_METHOD Compu_TPhi_base_rpmNG " " RAT_FUNC "%.0" "Speed (rpm)" COEFFS 0 1 0 0 0 1 /end COMPU_METHOD
/begin COMPU_METHOD Compu_Ttrim_mdotaP " " RAT_FUNC "%.1" "Mdot Air (g/sec)" COEFFS 0 32 0 0 0 1 /end COMPU_METHOD
/begin COMPU_METHOD Compu_Ttrim_mdotaNG " " RAT_FUNC "%.1" "Mdot Air (g/sec)" COEFFS 0 32 0 0 0 1 /end COMPU_METHOD
/begin CHARACTERISTIC TCL_postcat_phigsln "Gasoline Post-Cat Phi Target Table" MAP 0x001C2AD6 /* @ECU_Address@TCL_postcat_phigsln@0x020C2000@ */ ECIPP_ALIGNMENT_SWORD 2 Compu_TCL_postcat_phigsln -2 1.99993896484375
 /begin AXIS_DESCR COM_AXIS NO_INPUT_QUANTITY Compu_TPhi_base_MAP 14 -128 127.99609375 AXIS_PTS_REF TPhi_base_MAP /end AXIS_DESCR
 /begin AXIS_DESCR COM_AXIS NO_INPUT_QUANTITY Compu_TPhi_base_rpm 10 -32768 32767 AXIS_PTS_REF TPhi_base_rpm /end AXIS_DESCR
/end CHARACTERISTIC
/begin COMPU_METHOD Compu_TCL_postcat_phigsln "" RAT_FUNC "%.4" "Phi-Target (phi)" COEFFS 0 16384 0 0 0 1 /end COMPU_METHOD
/begin CHARACTERISTIC Tvent_PP "LPG Venturi Signal" CURVE 0x001C1998 /* @ECU_Address@Tvent_PP@0x020C5000@ */ ECIPP_ALIGNMENT_SWORD 222 Compu_Tvent_PP -222 221.993225097656
 /begin AXIS_DESCR COM_AXIS NO_INPUT_QUANTITY Compu_Ttrim_mdotaP 8 -1024 1023.96875 AXIS_PTS_REF Ttrim_mdotaP /end AXIS_DESCR
/end CHARACTERISTIC
/begin AXIS_PTS Ttrim_mdotaP " " 0x001C1988 /* @ECU_Address@Ttrim_mdotaP@0x0206F000@ */ NO_INPUT_QUANTITY ECIPP_Lookup_SWORD 0 Compu_Ttrim_mdotaP 8 -1024 1023.96875 /end AXIS_PTS
/begin COMPU_METHOD Compu_Tvent_PP " " RAT_FUNC "%.2" "in H2O" COEFFS 0 147.603603603604 0 0 0 1 /end COMPU_METHOD
/begin CHARACTERISTIC Tvent_PN "NG Venturi Signal" CURVE 0x001C2902 /* @ECU_Address@Tvent_PN@0x020C6000@ */ ECIPP_ALIGNMENT_SWORD 222 Compu_Tvent_PN -222 221.993225097656
 /begin AXIS_DESCR COM_AXIS NO_INPUT_QUANTITY Compu_Ttrim_mdotaNG 8 -1024 1023.96875 AXIS_PTS_REF Ttrim_mdotaNG /end AXIS_DESCR
/end CHARACTERISTIC
/begin AXIS_PTS Ttrim_mdotaNG " " 0x001C28F2 /* @ECU_Address@Ttrim_mdotaNG@0x02071000@ */ NO_INPUT_QUANTITY ECIPP_Lookup_SWORD 0 Compu_Ttrim_mdotaNG 8 -1024 1023.96875 /end AXIS_PTS
/begin COMPU_METHOD Compu_Tvent_PN " " RAT_FUNC "%.2" "in H2O" COEFFS 0 147.603603603604 0 0 0 1 /end COMPU_METHOD
/begin COMPU_METHOD Compu_T2trim_nom_MAPP " " RAT_FUNC "%.1" "MAP_load (psia)" COEFFS 0 256 0 0 0 1 /end COMPU_METHOD
/begin COMPU_METHOD Compu_T2trim_nom_rpmP " " RAT_FUNC "%.0" "Speed (rpm)" COEFFS 0 1 0 0 0 1 /end COMPU_METHOD
/begin CHARACTERISTIC T2trim_nom_DCP "LPG Nominal PWM Trim Duty-Cycle" MAP 0x001C0C0C /* @ECU_Address@T2trim_nom_DCP@0x020CD000@ */ ECIPP_ALIGNMENT_SWORD 200 Compu_T2trim_nom_DCP -200 199.993896484375
 /begin AXIS_DESCR COM_AXIS NO_INPUT_QUANTITY Compu_T2trim_nom_MAPP 14 -128 127.99609375 AXIS_PTS_REF T2trim_nom_MAPP /end AXIS_DESCR
 /begin AXIS_DESCR COM_AXIS NO_INPUT_QUANTITY Compu_T2trim_nom_rpmP 10 -32768 32767 AXIS_PTS_REF T2trim_nom_rpmP /end AXIS_DESCR
/end CHARACTERISTIC
/begin AXIS_PTS T2trim_nom_MAPP " " 0x001C0D24 /* @ECU_Address@T2trim_nom_MAPP@0x020CB000@ */ NO_INPUT_QUANTITY ECIPP_Lookup_SWORD 0 Compu_T2trim_nom_MAPP 14 -128 127.99609375 /end AXIS_PTS
/begin AXIS_PTS T2trim_nom_rpmP " " 0x001C0E74 /* @ECU_Address@T2trim_nom_rpmP@0x020CC000@ */ NO_INPUT_QUANTITY ECIPP_Lookup_SWORD 0 Compu_T2trim_nom_rpmP 10 -32768 32767 /end AXIS_PTS
/begin COMPU_METHOD Compu_T2trim_nom_DCP "" RAT_FUNC "%.1" "Nominal Duty-Cycle (%)" COEFFS 0 163.84 0 0 0 1 /end COMPU_METHOD
/begin CHARACTERISTIC T2MJ_nom_PP "LPG Nominal MegaJector Outlet Pressure" MAP 0x001C0AF4 /* @ECU_Address@T2MJ_nom_PP@0x020CE000@ */ ECIPP_ALIGNMENT_SWORD 222 Compu_T2MJ_nom_PP -222 221.993225097656
 /begin AXIS_DESCR COM_AXIS NO_INPUT_QUANTITY Compu_T2trim_nom_MAPP 14 -128 127.99609375 AXIS_PTS_REF T2trim_nom_MAPP /end AXIS_DESCR
 /begin AXIS_DESCR COM_AXIS NO_INPUT_QUANTITY Compu_T2trim_nom_rpmP 10 -32768 32767 AXIS_PTS_REF T2trim_nom_rpmP /end AXIS_DESCR
/end CHARACTERISTIC
/begin COMPU_METHOD Compu_T2MJ_nom_PP "" RAT_FUNC "%.2" "Nominal Phi Pressure (in H2O)" COEFFS 0 147.603603603604 0 0 0 1 /end COMPU_METHOD
/begin CHARACTERISTIC T2trim_nom_phiP "LPG Nominal Trim Phi" MAP 0x001C0D5C /* @ECU_Address@T2trim_nom_phiP@0x020CF000@ */ ECIPP_ALIGNMENT_SWORD 2 Compu_T2trim_nom_phiP -2 1.99993896484375
 /begin AXIS_DESCR COM_AXIS NO_INPUT_QUANTITY Compu_T2trim_nom_MAPP 14 -128 127.99609375 AXIS_PTS_REF T2trim_nom_MAPP /end AXIS_DESCR
 /begin AXIS_DESCR COM_AXIS NO_INPUT_QUANTITY Compu_T2trim_nom_rpmP 10 -32768 32767 AXIS_PTS_REF T2trim_nom_rpmP /end AXIS_DESCR
/end CHARACTERISTIC
/begin COMPU_METHOD Compu_T2trim_nom_phiP "" RAT_FUNC "%.3" "Nominal Phi" COEFFS 0 16384 0 0 0 1 /end COMPU_METHOD
/begin COMPU_METHOD Compu_T2trim_nom_MAPNG " " RAT_FUNC "%.1" "MAP_load (psia)" COEFFS 0 256 0 0 0 1 /end COMPU_METHOD
/begin COMPU_METHOD Compu_T2trim_nom_rpmNG " " RAT_FUNC "%.0" "Speed (rpm)" COEFFS 0 1 0 0 0 1 /end COMPU_METHOD
/begin CHARACTERISTIC T2trim_nom_DCNG "NG Nominal PWM Trim Duty-Cycle" MAP 0x001C1B76 /* @ECU_Address@T2trim_nom_DCNG@0x020D2000@ */ ECIPP_ALIGNMENT_SWORD 200 Compu_T2trim_nom_DCNG -200 199.993896484375
 /begin AXIS_DESCR COM_AXIS NO_INPUT_QUANTITY Compu_T2trim_nom_MAPNG 14 -128 127.99609375 AXIS_PTS_REF T2trim_nom_MAPNG /end AXIS_DESCR
 /begin AXIS_DESCR COM_AXIS NO_INPUT_QUANTITY Compu_T2trim_nom_rpmNG 10 -32768 32767 AXIS_PTS_REF T2trim_nom_rpmNG /end AXIS_DESCR
/end CHARACTERISTIC
/begin AXIS_PTS T2trim_nom_MAPNG " " 0x001C1C8E /* @ECU_Address@T2trim_nom_MAPNG@0x020D0000@ */ NO_INPUT_QUANTITY ECIPP_Lookup_SWORD 0 Compu_T2trim_nom_MAPNG 14 -128 127.99609375 /end AXIS_PTS
/begin AXIS_PTS T2trim_nom_rpmNG " " 0x001C1DDE /* @ECU_Address@T2trim_nom_rpmNG@0x020D1000@ */ NO_INPUT_QUANTITY ECIPP_Lookup_SWORD 0 Compu_T2trim_nom_rpmNG 10 -32768 32767 /end AXIS_PTS
/begin COMPU_METHOD Compu_T2trim_nom_DCNG "" RAT_FUNC "%.1" "Nominal Duty-Cycle (%)" COEFFS 0 163.84 0 0 0 1 /end COMPU_METHOD
/begin CHARACTERISTIC T2MJ_nom_PN "NG Nominal MegaJector Outlet Pressure" MAP 0x001C1A5E /* @ECU_Address@T2MJ_nom_PN@0x020D3000@ */ ECIPP_ALIGNMENT_SWORD 222 Compu_T2MJ_nom_PN -222 221.993225097656
 /begin AXIS_DESCR COM_AXIS NO_INPUT_QUANTITY Compu_T2trim_nom_MAPNG 14 -128 127.99609375 AXIS_PTS_REF T2trim_nom_MAPNG /end AXIS_DESCR
 /begin AXIS_DESCR COM_AXIS NO_INPUT_QUANTITY Compu_T2trim_nom_rpmNG 10 -32768 32767 AXIS_PTS_REF T2trim_nom_rpmNG /end AXIS_DESCR
/end CHARACTERISTIC
/begin COMPU_METHOD Compu_T2MJ_nom_PN "" RAT_FUNC "%.2" "Nominal Phi Pressure (in H2O)" COEFFS 0 147.603603603604 0 0 0 1 /end COMPU_METHOD
/begin CHARACTERISTIC T2trim_nom_phiNG "NG Nominal Trim Phi" MAP 0x001C1CC6 /* @ECU_Address@T2trim_nom_phiNG@0x020D4000@ */ ECIPP_ALIGNMENT_SWORD 2 Compu_T2trim_nom_phiNG -2 1.99993896484375
 /begin AXIS_DESCR COM_AXIS NO_INPUT_QUANTITY Compu_T2trim_nom_MAPNG 14 -128 127.99609375 AXIS_PTS_REF T2trim_nom_MAPNG /end AXIS_DESCR
 /begin AXIS_DESCR COM_AXIS NO_INPUT_QUANTITY Compu_T2trim_nom_rpmNG 10 -32768 32767 AXIS_PTS_REF T2trim_nom_rpmNG /end AXIS_DESCR
/end CHARACTERISTIC
/begin COMPU_METHOD Compu_T2trim_nom_phiNG "" RAT_FUNC "%.3" "Nominal Phi" COEFFS 0 16384 0 0 0 1 /end COMPU_METHOD
/begin CHARACTERISTIC T2trim_nom_maLP "Trim Vdot comp mdot air X-axis LPG" VAL_BLK 0x001C0D40 /* @ECU_Address@T2trim_nom_maLP@0x02108000@ */ ECIPP_ALIGNMENT_SWORD 8192 Compu_T2trim_nom_maLP -8192 8191.75 MATRIX_DIM 14 1 1 /end CHARACTERISTIC
/begin COMPU_METHOD Compu_T2trim_nom_maLP " " RAT_FUNC "%.0" "mg/Ld" COEFFS 0 4 0 0 0 1 /end COMPU_METHOD
/begin CHARACTERISTIC T2trim_nom_maLNG "Trim Vdot comp mdot air X-axis NG" VAL_BLK 0x001C1CAA /* @ECU_Address@T2trim_nom_maLNG@0x02109000@ */ ECIPP_ALIGNMENT_SWORD 8192 Compu_T2trim_nom_maLNG -8192 8191.75 MATRIX_DIM 14 1 1 /end CHARACTERISTIC
/begin COMPU_METHOD Compu_T2trim_nom_maLNG " " RAT_FUNC "%.0" "mg/Ld" COEFFS 0 4 0 0 0 1 /end COMPU_METHOD
/begin COMPU_METHOD Compu_TTVf_BMDC_DCP " " RAT_FUNC "%.1" "Duty-Cycle (%)" COEFFS 0 163.84 0 0 0 1 /end COMPU_METHOD
/begin COMPU_METHOD Compu_TTVf_BMDC_DCN " " RAT_FUNC "%.1" "Duty-Cycle (%)" COEFFS 0 163.84 0 0 0 1 /end COMPU_METHOD
/begin CHARACTERISTIC TTVf_BMDC_BMP "LPG PWM Trim Sensitivity" MAP 0x001C14A8 /* @ECU_Address@TTVf_BMDC_BMP@0x02116000@ */ ECIPP_ALIGNMENT_SWORD 200 Compu_TTVf_BMDC_BMP -200 199.993896484375
 /begin AXIS_DESCR COM_AXIS NO_INPUT_QUANTITY Compu_TTVf_BMDC_DCP 4 0 399.993896484375 AXIS_PTS_REF TTVf_BMDC_DCP /end AXIS_DESCR
 /begin AXIS_DESCR COM_AXIS NO_INPUT_QUANTITY Compu_Ttrim_mdotaP 8 -1024 1023.96875 AXIS_PTS_REF Ttrim_mdotaP /end AXIS_DESCR
/end CHARACTERISTIC
/begin AXIS_PTS TTVf_BMDC_DCP " " 0x001C19B0 /* @ECU_Address@TTVf_BMDC_DCP@0x02114000@ */ NO_INPUT_QUANTITY ECIPP_Lookup_UWORD 0 Compu_TTVf_BMDC_DCP 4 0 399.993896484375 /end AXIS_PTS
/begin COMPU_METHOD Compu_TTVf_BMDC_BMP "" RAT_FUNC "%.1" "Delta-phi from 50% DC (%)" COEFFS 0 163.84 0 0 0 1 /end COMPU_METHOD
/begin CHARACTERISTIC TTVf_BMDC_BMN "NG PWM Trim Sensitivity" MAP 0x001C2412 /* @ECU_Address@TTVf_BMDC_BMN@0x02117000@ */ ECIPP_ALIGNMENT_SWORD 200 Compu_TTVf_BMDC_BMN -200 199.993896484375
 /begin AXIS_DESCR COM_AXIS NO_INPUT_QUANTITY Compu_TTVf_BMDC_DCN 4 0 399.993896484375 AXIS_PTS_REF TTVf_BMDC_DCN /end AXIS_DESCR
 /begin AXIS_DESCR COM_AXIS NO_INPUT_QUANTITY Compu_Ttrim_mdotaNG 8 -1024 1023.96875 AXIS_PTS_REF Ttrim_mdotaNG /end AXIS_DESCR
/end CHARACTERISTIC
/begin AXIS_PTS TTVf_BMDC_DCN " " 0x001C291A /* @ECU_Address@TTVf_BMDC_DCN@0x02115000@ */ NO_INPUT_QUANTITY ECIPP_Lookup_UWORD 0 Compu_TTVf_BMDC_DCN 4 0 399.993896484375 /end AXIS_PTS
/begin COMPU_METHOD Compu_TTVf_BMDC_BMN "" RAT_FUNC "%.1" "Delta-phi from 50% DC (%)" COEFFS 0 163.84 0 0 0 1 /end COMPU_METHOD
/begin COMPU_METHOD Compu_TMAPrsc_BP " " RAT_FUNC "%.2" "BP (psia)" COEFFS 0 256 0 0 0 1 /end COMPU_METHOD
/begin AXIS_PTS TMAPrsc_BP " " 0x001C5440 /* @ECU_Address@TMAPrsc_BP@0x0212E000@ */ NO_INPUT_QUANTITY ECIPP_Lookup_SWORD 0 Compu_TMAPrsc_BP 4 -128 127.99609375 /end AXIS_PTS
/begin CHARACTERISTIC TMAPrsc_max_trim "Max MAP for BP-MAP trim rescale" CURVE 0x001C5450 /* @ECU_Address@TMAPrsc_max_trim@0x02130000@ */ ECIPP_ALIGNMENT_SWORD 128 Compu_TMAPrsc_max_trim -128 127.99609375
 /begin AXIS_DESCR COM_AXIS NO_INPUT_QUANTITY Compu_TMAPrsc_BP 4 -128 127.99609375 AXIS_PTS_REF TMAPrsc_BP /end AXIS_DESCR
/end CHARACTERISTIC
/begin COMPU_METHOD Compu_TMAPrsc_max_trim " " RAT_FUNC "%.2" "Max MAP (psia)" COEFFS 0 256 0 0 0 1 /end COMPU_METHOD
/begin COMPU_METHOD Compu_TCRI_cld_ECT " " RAT_FUNC "%.1" "ECT (deg F)" COEFFS 0 32 14720 0 0 1 /end COMPU_METHOD
/begin COMPU_METHOD Compu_TCRI_cld_yrpm " " RAT_FUNC "%.0" "Speed (rpm)" COEFFS 0 1 0 0 0 1 /end COMPU_METHOD
/begin AXIS_PTS TCRI_cld_xload " " 0x001F1574 /* @ECU_Address@TCRI_cld_xload@0x022EB000@ */ NO_INPUT_QUANTITY ECIPP_Lookup_SWORD 0 Compu_TCRI_cld_xload 8 -1024 1023.96875 /end AXIS_PTS
/begin AXIS_PTS TCRI_cld_yrpm " " 0x001F1584 /* @ECU_Address@TCRI_cld_yrpm@0x022E0000@ */ NO_INPUT_QUANTITY ECIPP_Lookup_SWORD 0 Compu_TCRI_cld_yrpm 8 -32768 32767 /end AXIS_PTS
/begin CHARACTERISTIC TCRI_cld_Pmult "Pressure Base Offset Multiplier" CURVE 0x001F1544 /* @ECU_Address@TCRI_cld_Pmult@0x022E8000@ */ ECIPP_ALIGNMENT_SWORD 128 Compu_TCRI_cld_Pmult -128 127.99609375
 /begin AXIS_DESCR COM_AXIS NO_INPUT_QUANTITY Compu_TCRI_cld_ECT 8 -1484 563.96875 AXIS_PTS_REF TCRI_cld_ECT /end AXIS_DESCR
/end CHARACTERISTIC
/begin AXIS_PTS TCRI_cld_ECT " " 0x001F1534 /* @ECU_Address@TCRI_cld_ECT@0x022DE000@ */ NO_INPUT_QUANTITY ECIPP_Lookup_SWORD 0 Compu_TCRI_cld_ECT 8 -1484 563.96875 /end AXIS_PTS
/begin COMPU_METHOD Compu_TCRI_cld_Pmult " " RAT_FUNC "%.2" "Pressure Offset Mult" COEFFS 0 256 0 0 0 1 /end COMPU_METHOD
/begin CHARACTERISTIC TCRI_cld_Qmult "Quantity Base Offset Multiplier" CURVE 0x001F1554 /* @ECU_Address@TCRI_cld_Qmult@0x022E9000@ */ ECIPP_ALIGNMENT_SWORD 128 Compu_TCRI_cld_Qmult -128 127.99609375
 /begin AXIS_DESCR COM_AXIS NO_INPUT_QUANTITY Compu_TCRI_cld_ECT 8 -1484 563.96875 AXIS_PTS_REF TCRI_cld_ECT /end AXIS_DESCR
/end CHARACTERISTIC
/begin COMPU_METHOD Compu_TCRI_cld_Qmult " " RAT_FUNC "%.2" "Quantity Offset Mult" COEFFS 0 256 0 0 0 1 /end COMPU_METHOD
/begin CHARACTERISTIC TCRI_cld_Tmult "Timing Base Offset Multiplier" CURVE 0x001F1564 /* @ECU_Address@TCRI_cld_Tmult@0x022EA000@ */ ECIPP_ALIGNMENT_SWORD 128 Compu_TCRI_cld_Tmult -128 127.99609375
 /begin AXIS_DESCR COM_AXIS NO_INPUT_QUANTITY Compu_TCRI_cld_ECT 8 -1484 563.96875 AXIS_PTS_REF TCRI_cld_ECT /end AXIS_DESCR
/end CHARACTERISTIC
/begin COMPU_METHOD Compu_TCRI_cld_Tmult " " RAT_FUNC "%.2" "Timing Offset Mult" COEFFS 0 256 0 0 0 1 /end COMPU_METHOD
/begin COMPU_METHOD Compu_TCRI_cld_xload " " RAT_FUNC "%.1" "Fuel Load (mg/cyl)" COEFFS 0 32 0 0 0 1 /end COMPU_METHOD
/begin CHARACTERISTIC TCRI_Qpost1_cld "Post 1 Quantity Base Offset (mg/stroke)" MAP 0x001EFAB4 /* @ECU_Address@TCRI_Qpost1_cld@0x022F8000@ */ ECIPP_ALIGNMENT_SWORD 1024 Compu_TCRI_Qpost1_cld -1024 1023.96875
 /begin AXIS_DESCR COM_AXIS NO_INPUT_QUANTITY Compu_TCRI_cld_xload 8 -1024 1023.96875 AXIS_PTS_REF TCRI_cld_xload /end AXIS_DESCR
 /begin AXIS_DESCR COM_AXIS NO_INPUT_QUANTITY Compu_TCRI_cld_yrpm 8 -32768 32767 AXIS_PTS_REF TCRI_cld_yrpm /end AXIS_DESCR
/end CHARACTERISTIC
/begin COMPU_METHOD Compu_TCRI_Qpost1_cld "" RAT_FUNC "%.1" "Fuel Load (mg/cyl)" COEFFS 0 32 0 0 0 1 /end COMPU_METHOD
/begin CHARACTERISTIC TCRI_Qpost2_cld "Post 2 Quantity Base Offset (mg/stroke)" MAP 0x001EFF34 /* @ECU_Address@TCRI_Qpost2_cld@0x022FB000@ */ ECIPP_ALIGNMENT_SWORD 1024 Compu_TCRI_Qpost2_cld -1024 1023.96875
 /begin AXIS_DESCR COM_AXIS NO_INPUT_QUANTITY Compu_TCRI_cld_xload 8 -1024 1023.96875 AXIS_PTS_REF TCRI_cld_xload /end AXIS_DESCR
 /begin AXIS_DESCR COM_AXIS NO_INPUT_QUANTITY Compu_TCRI_cld_yrpm 8 -32768 32767 AXIS_PTS_REF TCRI_cld_yrpm /end AXIS_DESCR
/end CHARACTERISTIC
/begin COMPU_METHOD Compu_TCRI_Qpost2_cld "" RAT_FUNC "%.1" "Fuel Load (mg/cyl)" COEFFS 0 32 0 0 0 1 /end COMPU_METHOD
/begin CHARACTERISTIC TCRI_Tpilot1_cld "Pilot 1 Timing Base Offset (CAD)" MAP 0x001ED734 /* @ECU_Address@TCRI_Tpilot1_cld@0x02301000@ */ ECIPP_ALIGNMENT_SLONG 134217728 Compu_TCRI_Tpilot1_cld -134217728 134217727.9375
 /begin AXIS_DESCR COM_AXIS NO_INPUT_QUANTITY Compu_TCRI_cld_xload 8 -1024 1023.96875 AXIS_PTS_REF TCRI_cld_xload /end AXIS_DESCR
 /begin AXIS_DESCR COM_AXIS NO_INPUT_QUANTITY Compu_TCRI_cld_yrpm 8 -32768 32767 AXIS_PTS_REF TCRI_cld_yrpm /end AXIS_DESCR
/end CHARACTERISTIC
/begin COMPU_METHOD Compu_TCRI_Tpilot1_cld "" RAT_FUNC "%.1" "Fuel Load (mg/cyl)" COEFFS 0 16 0 0 0 1 /end COMPU_METHOD
/begin COMPU_METHOD Compu_TGLOW_pre_TdegR " " RAT_FUNC "%.1" "Temp (deg F)" COEFFS 0 32 14720 0 0 1 /end COMPU_METHOD
/begin CHARACTERISTIC TGLOW_pre_time "Pre-glow schedule" CURVE 0x001C4E6C /* @ECU_Address@TGLOW_pre_time@0x025F6000@ */ ECIPP_ALIGNMENT_SWORD 524 Compu_TGLOW_pre_time -524.288 524.272
 /begin AXIS_DESCR COM_AXIS NO_INPUT_QUANTITY Compu_TGLOW_pre_TdegR 8 -1484 563.96875 AXIS_PTS_REF TGLOW_pre_TdegR /end AXIS_DESCR
/end CHARACTERISTIC
/begin AXIS_PTS TGLOW_pre_TdegR " " 0x001C4E5C /* @ECU_Address@TGLOW_pre_TdegR@0x025F5000@ */ NO_INPUT_QUANTITY ECIPP_Lookup_SWORD 0 Compu_TGLOW_pre_TdegR 8 -1484 563.96875 /end AXIS_PTS
/begin COMPU_METHOD Compu_TGLOW_pre_time " " RAT_FUNC "%.1" "Time (sec)" COEFFS 0 62.5 0 0 0 1 /end COMPU_METHOD
/begin CHARACTERISTIC TGLOW_post_time "Post-glow schedule" CURVE 0x001C4E4C /* @ECU_Address@TGLOW_post_time@0x025FC000@ */ ECIPP_ALIGNMENT_SWORD 524 Compu_TGLOW_post_time -524.288 524.272
 /begin AXIS_DESCR COM_AXIS NO_INPUT_QUANTITY Compu_TGLOW_pre_TdegR 8 -1484 563.96875 AXIS_PTS_REF TGLOW_pre_TdegR /end AXIS_DESCR
/end CHARACTERISTIC
/begin COMPU_METHOD Compu_TGLOW_post_time " " RAT_FUNC "%.1" "Time (sec)" COEFFS 0 62.5 0 0 0 1 /end COMPU_METHOD
/begin COMPU_METHOD Compu_TWCctrl_ROL_d_OSC " " RAT_FUNC "%.1" "OSC (g)" COEFFS 0 1 0 0 0 1 /end COMPU_METHOD
/begin CHARACTERISTIC TWCctrl_ROL_d_ROL "TWC control ROL set point (table)" CURVE 0x001C3D5C /* @ECU_Address@TWCctrl_ROL_d_ROL@0x026C8000@ */ ECIPP_ALIGNMENT_FLOAT32_IEEE 10000000000 Compu_TWCctrl_ROL_d_ROL -10000000000 10000000000
 /begin AXIS_DESCR COM_AXIS NO_INPUT_QUANTITY Compu_TWCctrl_ROL_d_OSC 4 -10000000000 10000000000 AXIS_PTS_REF TWCctrl_ROL_d_OSC /end AXIS_DESCR
/end CHARACTERISTIC
/begin AXIS_PTS TWCctrl_ROL_d_OSC " " 0x001C3D4C /* @ECU_Address@TWCctrl_ROL_d_OSC@0x026C7000@ */ NO_INPUT_QUANTITY ECIPP_Lookup_FLOAT32_IEEE 0 Compu_TWCctrl_ROL_d_OSC 4 -10000000000 10000000000 /end AXIS_PTS
/begin COMPU_METHOD Compu_TWCctrl_ROL_d_ROL " " RAT_FUNC "%.0" "ROL (%)" COEFFS 0 0.01 0 0 0 1 /end COMPU_METHOD
/begin GROUP EC_CLCalGsln "ECONTROLS" ROOT
 /begin REF_CHARACTERISTIC CLp_Emin CLp_Emax CLp_Rp_def CLp_Rn_def CLp_rich_DC CLp_lean_DC MAPdt_CLoff K_adapt Adapt_pos_lim Adapt_neg_lim Adapt_stepmax Adapt_dzone Adapt_valid Adapt_wait K_CL_acquire K_CL CL_BM_max CL_BM_min CL_stepmax CL_dis_Gsln CL_Ki_p_postcat CL_hi_postcat CL_lo_postcat CL_postcat_ena CL_Ki_n_postcat CL_Kp_p_postcat CL_Kp_n_postcat CL_Kiv_p_postcat CL_Kiv_n_postcat CL_phidt_hi_postcat CL_phidt_lo_postcat EGO1delay CL_temp_wait_mul AL_temp_wait_mul FAstoich_s_G FAstoich_a_G SGf SGfs CL_HW_dis_cfg CL_TD_enable CL_TD_max_p CL_TD_max_n CL_TD_EGOsw_ena CL_TD_sw_offset CL_TD_sw_pct CL_rst_postcat CL_TD_mdota CL_control_type CLacq_lmt_step CL_switch_type T_delay_plug_flow adapt_store_EE CLp_fastwr_ena CLp_fastwr_MAPdt CLp_fastwr_phierr CLp_fastwr_mincyc CLp_fastwr_rich_err CLp_fastwr_lean_err CLp_fastwr_rich_step CLp_fastwr_lean_step CLp_fastwr_mdot_min TWCctrl_ROL_d_def CL_Kp_p_ROL CL_Kp_n_ROL CL_Ki_p_ROL CL_Ki_n_ROL CL_ROL_win_p CL_ROL_win_n CL_ROL_res_dly CL_SS_dly TWCctrl_CBT_FSO_ena TWCctrl_CBT_min CLp_fastwr_cs_CBT Phi_post_cs_CBT CL_postcat_winpdlt CL_postcat_winndlt CL_ROLend_fastwrtm CL_post_fastwr_tm CL_ROLend_tm_mode CL_ROL_trans_mode TWCctrl_ROL_d_sel TCL_ena TCLp_tau_cyc TCL_postcat_phigsln TWCctrl_ROL_d_ROL /end REF_CHARACTERISTIC
 /begin REF_MEASUREMENT MAPdt Manual_BM BM1_crct CL1_perturb CLInactiveFlag CB1pre_DCa CB1pre_DCd CLp_E CL_temp_wait_tmr BM2_crct CL2_perturb CB2pre_DCa Phi_UEGO FPin CLp_tau CLp_Hp CLp_Hn CL_ena_value AL_temp_wait_tmr Adapt1_valid_cnt CL_inact_force Adapt2_valid_cnt UEGO_mode FP_crct EGO1_phiFB EGO2_phiFB EGO3_phiFB EGO1_phiFB_avg EGO2_phiFB_avg EGO3_phiFB_avg Phi_post_d Phi1_post_delt Phi_post_act EGO3_phiFB_dphidt trim_SG_FA_x Phi2_post_delt CL2_Hp CL2_Hn CB2pre_DCd CL2_E EGO4_phiFB EGO4_phiFB_avg CL_bank_mode Cat_bank_mode EGO4_phiFB_dphidt Phi1_pre_d Phi2_pre_d CL_HW_disable CL_fuellev_low Phi_UEGO2 UEGO2_mode T_delay_FB CB1pre_phiFB CB1pst_phiFB CB2pre_phiFB CB2pst_phiFB CB1pre_phiFB_avg CB1pst_phiFB_avg CB2pre_phiFB_avg CB2pst_phiFB_avg CB1pst_phiFB_dphidt CB2pst_phiFB_dphidt UEGO3_mode Phi_UEGO3 UEGO4_mode Phi_UEGO4 CLp_fastwr_status CL1_phi_error CL2_phi_error TWCctrl_ROL_e TWCctrl_ROL_d CL1_post_SS_status CL1_post_phi_ROL CL1_CBT_hot CL1_FSO_occurred CLp_fastwr_cs_state Phi_post_cs_state CL1_ROL_win_p_th CL1_ROL_win_n_th CL1_postcat_hi_th CL1_postcat_lo_th /end REF_MEASUREMENT
/end GROUP
/begin GROUP EC_CLCalLP "ECONTROLS" ROOT
 /begin REF_CHARACTERISTIC CLp_rich_DC CLp_lean_DC TRIM_trig_chg TRIM_period_def MAPdt_CLoff TRIM_dis_hold mda_trans_tau TRIM_trans_dis trim_nom_crkP CLLP_hi CLLP_lo CLLP_K CLLP_K_acquire CLLP_stepmax CLpLP_Emax CLpLP_Emin CLpLP_Rp_def CLpLP_Rn_def ALLP_hi ALLP_lo ALLP_K ALLP_stepmax ALLP_dzone ALLP_valid ALLP_wait CL_dis_LP trim_LP_min trim_LP_max CLLP_lo_postcat CLLP_hi_postcat CLLP_Ki_p_postcat CLLP_postcat_ena CLLP_Ki_n_postcat CLLP_Kp_p_postcat CLLP_Kp_n_postcat CLLP_Kiv_p_postcat CLLP_Kiv_n_postcat CLP_phidt_hi_postcat CLP_phidt_lo_postcat MJ_nom_crkP MJ_P_minP MJ_P_maxP MJ_Pin_P FT_def FAstoich_s_P FAstoich_a_P SGf_LP SGfs_LP trim_load_src trim_TIP_Vdot_comp CL_HW_dis_cfg trim_tran_forceP trim_ntran_forceP CLLP_TD_enable CLLP_TD_max_p CLLP_TD_max_n CLLP_TD_EGOsw_ena CLLP_TD_sw_offset CLLP_TD_sw_pct MAPrsc_min_trim CLLP_rst_postcat CLLP_TD_mdota CL_control_type MJ_nom_crkslwdP MJ_crk_holdP MJ_crk_slewP MJ_crk_run_slewP CLacq_lmt_step CL_switch_type T_delay_plug_flow MJ_man_mode_rpm MJ_man_mode_map adapt_store_EE CLp_fastwr_ena CLp_fastwr_MAPdt CLp_fastwr_phierr CLp_fastwr_mincyc CLp_fastwr_rich_err CLp_fastwr_lean_err CLp_fastwr_rich_step CLp_fastwr_lean_step CLp_fastwr_mdot_min TWCctrl_ROL_d_def CLLP_Kp_p_ROL CLLP_Kp_n_ROL CLLP_Ki_p_ROL CLLP_Ki_n_ROL CLLP_ROL_win_p CLLP_ROL_win_n CLLP_ROL_res_dly CLLP_SS_dly TWCctrl_CBT_FSO_ena TWCctrl_CBT_min CLp_fastwr_cs_CBT Phi_post_cs_CBT CLLP_postcat_winpdlt CLLP_postcat_winndlt CLLP_ROLend_fastwrtm CLLP_post_fastwr_tm CLLP_ROLend_tm_mode CLLP_ROL_trans_mode TWCctrl_ROL_d_sel TCLp_tau_cycP TCL_enaP Tvent_PP T2trim_nom_DCP T2MJ_nom_PP T2trim_nom_phiP T2trim_nom_maLP TTVf_BMDC_BMP TMAPrsc_max_trim TWCctrl_ROL_d_ROL /end REF_CHARACTERISTIC
 /begin REF_MEASUREMENT MAPdt Manual_BM BM1_crct CL1_perturb CLInactiveFlag CB1pre_DCa CB1pre_DCd CLp_E mdot_a_trans mdot_a_trans_pct TRIM_DC CL_temp_wait_tmr CB2pre_DCa Phi_UEGO MJ_P_act MJ_P_cmd MJ_A_act MJ_A_cmd CLp_tau CLp_Hp CLp_Hn CL_ena_value AL_temp_wait_tmr Adapt1_valid_cnt TRIM_mode CL_inact_force UEGO_mode TRIM_nom_DC TRIM_nom_phi TRIM_sens Phi_post_d Phi1_post_delt Phi_post_act MJ_P_nom Vent_P_sig Vent_dP_nom MJ_man_mode MJ_ctltype_cmd MJ_ctltype_act MJ_status FT mdot_a_equcarb trim_SG_FA_x CB2pre_DCd MJ_VVC_Tcrct MJ_P_Tnom m_a_perL trim_MAP_Vdc trim_m_a_Vdc Phi_cmd_dly CL_HW_disable CL_fuellev_low TRIM_BM TRIM_min_BM TRIM_max_BM MAPrsc_trim MAPrsc_max_trim Phi_UEGO2 UEGO2_mode T_delay_FB CB1pre_phiFB CB1pst_phiFB CB2pre_phiFB CB1pre_phiFB_avg CB1pst_phiFB_avg CB2pre_phiFB_avg CB1pst_phiFB_dphidt UEGO3_mode Phi_UEGO3 UEGO4_mode Phi_UEGO4 CLp_fastwr_status CL1_phi_error TWCctrl_ROL_e TWCctrl_ROL_d CL1_post_SS_status CL1_post_phi_ROL CL1_CBT_hot CL1_FSO_occurred CLp_fastwr_cs_state Phi_post_cs_state CL1_ROL_win_p_th CL1_ROL_win_n_th CL1_postcat_hi_th CL1_postcat_lo_th /end REF_MEASUREMENT
/end GROUP
/begin GROUP EC_CLCalNG "ECONTROLS" ROOT
 /begin REF_CHARACTERISTIC CLp_rich_DC CLp_lean_DC TRIM_trig_chg TRIM_period_def MAPdt_CLoff TRIM_dis_hold mda_trans_tau TRIM_trans_dis trim_nom_crkN CLNG_hi CLNG_lo CLNG_K CLNG_K_acquire CLNG_stepmax CLpNG_Emax CLpNG_Emin CLpNG_Rp_def CLpNG_Rn_def ALNG_hi ALNG_lo ALNG_K ALNG_stepmax ALNG_dzone ALNG_valid ALNG_wait CL_dis_NG trim_NG_max trim_NG_min CLNG_lo_postcat CLNG_hi_postcat CLNG_Ki_p_postcat CLNG_postcat_ena CLNG_Ki_n_postcat CLNG_Kp_p_postcat CLNG_Kp_n_postcat CLNG_Kiv_p_postcat CLNG_Kiv_n_postcat CLN_phidt_hi_postcat CLN_phidt_lo_postcat MJ_P_minN MJ_P_maxN MJ_nom_crkN MJ_Pin_N FT_def FAstoich_s_N FAstoich_a_N SGf_NG SGfs_NG trim_load_src trim_TIP_Vdot_comp CL_HW_dis_cfg trim_tran_forceN trim_ntran_forceN CLNG_TD_enable CLNG_TD_max_p CLNG_TD_max_n CLNG_TD_EGOsw_ena CLNG_TD_sw_offset CLNG_TD_sw_pct CLNG_rst_postcat CLNG_TD_mdota CL_control_type MJ_nom_crkslwdN MJ_crk_holdN MJ_crk_slewN MJ_crk_run_slewN CLacq_lmt_step CL_switch_type T_delay_plug_flow MJ_man_mode_rpm MJ_man_mode_map adapt_store_EE CLp_fastwr_ena CLp_fastwr_MAPdt CLp_fastwr_phierr CLp_fastwr_mincyc CLp_fastwr_rich_err CLp_fastwr_lean_err CLp_fastwr_rich_step CLp_fastwr_lean_step CLp_fastwr_mdot_min TWCctrl_ROL_d_def CLNG_Kp_p_ROL CLNG_Kp_n_ROL CLNG_Ki_p_ROL CLNG_Ki_n_ROL CLNG_ROL_win_p CLNG_ROL_win_n CLNG_ROL_res_dly CLNG_SS_dly TWCctrl_CBT_FSO_ena TWCctrl_CBT_min CLp_fastwr_cs_CBT Phi_post_cs_CBT CLNG_postcat_winpdlt CLNG_postcat_winndlt CLNG_ROLend_fastwrtm CLNG_post_fastwr_tm CLNG_ROLend_tm_mode CLNG_ROL_trans_mode SPL_NG_ena SPL_NG_run_min SPL_NG_ECT_min SPL_NG_rpm_min SPL_NG_rpm_max SPL_NG_MAPload_min SPL_NG_MAPload_max SPL_NG_stable_time SPL_NG_eval_time SPL_NG_BM_nominal SPL_NG_BM_high TWCctrl_ROL_d_sel TCLp_tau_cycNG TCL_enaNG Tvent_PN T2trim_nom_DCNG T2MJ_nom_PN T2trim_nom_phiNG T2trim_nom_maLNG TTVf_BMDC_BMN TWCctrl_ROL_d_ROL /end REF_CHARACTERISTIC
 /begin REF_MEASUREMENT MAPdt Manual_BM BM1_crct CL1_perturb CLInactiveFlag CB1pre_DCa CB1pre_DCd CLp_E mdot_a_trans mdot_a_trans_pct TRIM_DC CL_temp_wait_tmr CB2pre_DCa Phi_UEGO MJ_P_act MJ_P_cmd MJ_A_act MJ_A_cmd CLp_tau CLp_Hp CLp_Hn CL_ena_value AL_temp_wait_tmr Adapt1_valid_cnt TRIM_mode CL_inact_force UEGO_mode TRIM_nom_DC TRIM_nom_phi TRIM_sens Phi_post_d Phi1_post_delt Phi_post_act MJ_P_nom Vent_P_sig Vent_dP_nom MJ_man_mode MJ_ctltype_cmd MJ_ctltype_act MJ_status FT mdot_a_equcarb trim_SG_FA_x CB2pre_DCd MJ_VVC_Tcrct MJ_P_Tnom m_a_perL trim_MAP_Vdc trim_m_a_Vdc Phi_cmd_dly CL_HW_disable CL_fuellev_low TRIM_BM TRIM_min_BM TRIM_max_BM MAPrsc_trim Phi_UEGO2 UEGO2_mode T_delay_FB CB1pre_phiFB CB1pst_phiFB CB2pre_phiFB CB1pre_phiFB_avg CB1pst_phiFB_avg CB2pre_phiFB_avg CB1pst_phiFB_dphidt UEGO3_mode Phi_UEGO3 UEGO4_mode Phi_UEGO4 CLp_fastwr_status CL1_phi_error TWCctrl_ROL_e TWCctrl_ROL_d CL1_post_SS_status CL1_post_phi_ROL CL1_CBT_hot CL1_FSO_occurred CLp_fastwr_cs_state Phi_post_cs_state CL1_ROL_win_p_th CL1_ROL_win_n_th CL1_postcat_hi_th CL1_postcat_lo_th SPL_mon_state SPL_eval_tmr SPL_BM /end REF_MEASUREMENT
/end GROUP
/begin GROUP EC_ColdStart "ECONTROLS" ROOT
 /begin REF_CHARACTERISTIC CRI_Tpilot2_type CRI_Tpilot1_type GLOW_type GLOW_mode GLOW_channel GLOW_GCU_diag_in GLOW_temp_input GLOW_Vbat_high GLOW_pre_Vbat_low GLOW_ECT_high GLOW_pre_keyon_wt GLOW_shutoff_temp GLOW_time_max GLOW_voltage GLOW_DC_min GLOW_DC_max GLOW_lamp_channel GLOW_pre_time_max GLOW_starter_pause diesel_lwld_comp_ena diesel_lwld_spd_thld diesel_lwld_ld_thld diesel_lwld_low_wait diesel_lwld_low_slew diesel_lwld_nrm_wait diesel_lwld_nrm_slew diesel_lwld_ini_wait TCRI_cld_Pmult TCRI_cld_Qmult TCRI_cld_Tmult TCRI_Qpost1_cld TCRI_Qpost2_cld TCRI_Tpilot1_cld TGLOW_pre_time TGLOW_post_time /end REF_CHARACTERISTIC
 /begin REF_MEASUREMENT CRI_mg_main_cld CRI_mg_pilot2_cld CRI_mg_pilot1_cld CRI_mg_post1_cld CRI_mg_post2_cld CRI_cad_main_cld CRI_cad_pilot2_cld CRI_cad_pilot1_cld CRI_cad_post1_cld CRI_cad_post2_cld GLOW_state GLOW_temp GLOW_pre_ms GLOW_max_ms GLOW_active GLOW_post_ms GLOW_pre_max_ms diesel_lwld_state diesel_lwld_timer diesel_lwld_slewval /end REF_MEASUREMENT
/end GROUP
/begin GROUP EC_ConfigApp "ECONTROLS" ROOT /begin REF_MEASUREMENT CL_fuellev_low /end REF_MEASUREMENT /end GROUP
/begin GROUP EC_EGOConfig "ECONTROLS" ROOT
 /begin REF_MEASUREMENT Phi_UEGO UEGO_mode Phi_UEGO2 UEGO2_mode UEGO3_mode Phi_UEGO3 UEGO4_mode Phi_UEGO4 /end REF_MEASUREMENT
/end GROUP
/begin GROUP EC_Faults "ECONTROLS" ROOT /begin REF_MEASUREMENT TRIM_DC FPin MJ_P_act MJ_P_cmd Phi1_post_delt FT /end REF_MEASUREMENT /end GROUP
/begin GROUP EC_FilterCal "ECONTROLS" ROOT /begin REF_MEASUREMENT MAPdt /end REF_MEASUREMENT /end GROUP
/begin GROUP EC_Fuel "ECONTROLS" ROOT /begin REF_MEASUREMENT FPin CL_ena_value Phi_post_d Phi_post_act /end REF_MEASUREMENT /end GROUP
/begin GROUP EC_HDService "ECONTROLS" ROOT
 /begin REF_MEASUREMENT Phi_UEGO MJ_P_act MJ_P_cmd UEGO_mode FT Phi_UEGO2 Phi_UEGO3 Phi_UEGO4 /end REF_MEASUREMENT
/end GROUP
/begin GROUP EC_LDService "ECONTROLS" ROOT
 /begin REF_MEASUREMENT FPin MJ_P_act MJ_P_cmd MJ_ctltype_cmd MJ_ctltype_act MJ_status FT /end REF_MEASUREMENT
/end GROUP
/begin GROUP EC_LEService "ECONTROLS" ROOT
 /begin REF_MEASUREMENT Phi_UEGO MJ_P_act MJ_P_cmd UEGO_mode MJ_ctltype_cmd MJ_ctltype_act MJ_status Phi_UEGO2 UEGO2_mode CB1pst_phiFB_avg /end REF_MEASUREMENT
/end GROUP
/begin GROUP EC_Megajector "ECONTROLS" ROOT /begin REF_CHARACTERISTIC FT_def trim_TIP_Vdot_comp MJ_man_mode_rpm MJ_man_mode_map /end REF_CHARACTERISTIC
 /begin REF_MEASUREMENT MJ_P_act MJ_P_cmd MJ_A_act MJ_A_cmd MJ_P_nom MJ_man_mode MJ_ctltype_cmd MJ_ctltype_act MJ_status FT MJ_VVC_Tcrct MJ_P_Tnom trim_MAP_Vdc trim_m_a_Vdc /end REF_MEASUREMENT
/end GROUP
/begin GROUP EC_Misfire "ECONTROLS" ROOT /begin REF_MEASUREMENT MAPdt m_a_perL /end REF_MEASUREMENT /end GROUP
/begin GROUP EC_PhiGsln "ECONTROLS" ROOT
 /begin REF_MEASUREMENT Manual_BM Phi_UEGO FPin FP_crct Phi_UEGO2 Phi_UEGO3 Phi_UEGO4 /end REF_MEASUREMENT
/end GROUP
/begin GROUP EC_PhiLP "ECONTROLS" ROOT
 /begin REF_CHARACTERISTIC CLp_rich_DC CLp_lean_DC CLpLP_Emax CLpLP_Emin CLpLP_Rp_def CLpLP_Rn_def CL_dis_LP /end REF_CHARACTERISTIC
 /begin REF_MEASUREMENT Manual_BM BM1_crct CL1_perturb CLInactiveFlag CB1pre_DCa CB1pre_DCd CLp_E CB2pre_DCa Phi_UEGO CLp_Hp CLp_Hn CL_ena_value CL_inact_force Phi1_post_delt CB2pre_DCd Phi_UEGO2 Phi_UEGO3 Phi_UEGO4 /end REF_MEASUREMENT
/end GROUP
/begin GROUP EC_PhiNG "ECONTROLS" ROOT
 /begin REF_CHARACTERISTIC CLp_rich_DC CLp_lean_DC CLpNG_Emax CLpNG_Emin CLpNG_Rp_def CLpNG_Rn_def CL_dis_NG /end REF_CHARACTERISTIC
 /begin REF_MEASUREMENT Manual_BM BM1_crct CL1_perturb CLInactiveFlag CB1pre_DCa CB1pre_DCd CLp_E CB2pre_DCa Phi_UEGO CLp_Hp CLp_Hn CL_ena_value CL_inact_force Phi1_post_delt CB2pre_DCd Phi_UEGO2 Phi_UEGO3 Phi_UEGO4 /end REF_MEASUREMENT
/end GROUP
/begin GROUP EC_QTpilot2 "ECONTROLS" ROOT /begin REF_CHARACTERISTIC CRI_Tpilot2_type /end REF_CHARACTERISTIC /end GROUP
/begin GROUP EC_QTpilot1 "ECONTROLS" ROOT /begin REF_CHARACTERISTIC CRI_Tpilot1_type /end REF_CHARACTERISTIC /end GROUP
/begin GROUP EC_Service1 "ECONTROLS" ROOT /begin REF_MEASUREMENT CL_inact_force /end REF_MEASUREMENT /end GROUP
/begin GROUP EC_Tests "ECONTROLS" ROOT /begin REF_CHARACTERISTIC MJ_man_mode_rpm MJ_man_mode_map /end REF_CHARACTERISTIC
 /begin REF_MEASUREMENT MJ_P_act MJ_P_cmd MJ_A_act MJ_A_cmd UEGO_mode MJ_man_mode MJ_ctltype_cmd MJ_ctltype_act MJ_status UEGO2_mode UEGO3_mode UEGO4_mode /end REF_MEASUREMENT
/end GROUP
/begin GROUP EC_TranCal "ECONTROLS" ROOT /begin REF_MEASUREMENT Phi_cmd_dly /end REF_MEASUREMENT /end GROUP
/begin GROUP EC_VECal "ECONTROLS" ROOT
 /begin REF_MEASUREMENT Manual_BM Phi_UEGO FPin FP_crct FT m_a_perL Phi_UEGO2 Phi_UEGO3 Phi_UEGO4 /end REF_MEASUREMENT
/end GROUP
/end MODULE
/end PROJECT
