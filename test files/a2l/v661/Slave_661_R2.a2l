ASAP2_VERSION 1 61
/begin PROJECT Econtrols_4G "4G Test"
/begin HEADER "4G A2L Configuration" PROJECT_NO EControls4G /* config for version control */ VERSION "$Revision: 82130 $:" /* config for version control */ /end HEADER
/begin MODULE EControls_4G_SH2A "EControls 4G"
/begin MOD_COMMON "" DEPOSIT ABSOLUTE BYTE_ORDER MSB_FIRST /end MOD_COMMON
/* Define the Record Layouts */
/begin RECORD_LAYOUT ECIPP_ALIGNMENT_UBYTE FNC_VALUES 1 UBYTE COLUMN_DIR DIRECT /end RECORD_LAYOUT
/begin RECORD_LAYOUT ECIPP_ALIGNMENT_UWORD FNC_VALUES 1 UWORD COLUMN_DIR DIRECT /end RECORD_LAYOUT
/begin RECORD_LAYOUT ECIPP_ALIGNMENT_SWORD FNC_VALUES 1 SWORD COLUMN_DIR DIRECT /end RECORD_LAYOUT
/begin RECORD_LAYOUT ECIPP_Lookup_SWORD AXIS_PTS_X 1 SWORD INDEX_INCR DIRECT /end RECORD_LAYOUT
/begin RECORD_LAYOUT ECIPP_ALIGNMENT_ULONG FNC_VALUES 1 ULONG COLUMN_DIR DIRECT /end RECORD_LAYOUT
/begin RECORD_LAYOUT ECIPP_ALIGNMENT_SLONG FNC_VALUES 1 SLONG COLUMN_DIR DIRECT /end RECORD_LAYOUT
/begin RECORD_LAYOUT ECIPP_ALIGNMENT_FLOAT32_IEEE FNC_VALUES 1 FLOAT32_IEEE COLUMN_DIR DIRECT /end RECORD_LAYOUT
/begin COMPU_METHOD Compu_IDENTITY "Discrete Values " /* Identifier */ IDENTICAL "%.0" /* Format */ "-" /* Units */ /end COMPU_METHOD
/begin CHARACTERISTIC SH_def "SH default" VALUE 0x001c8909 /* @ECU_Address@SH_def@0x01001AA8@ */ ECIPP_ALIGNMENT_UBYTE 62 Compu_SH_def 0 62.255859375 /end CHARACTERISTIC
/begin COMPU_METHOD Compu_SH_def " " RAT_FUNC "%.1" "g/kg" COEFFS 0 4.096 0 0 0 1 /end COMPU_METHOD
/begin CHARACTERISTIC AAT_def "AAT default" VALUE 0x001c6d36 /* @ECU_Address@AAT_def@0x01001AB0@ */ ECIPP_ALIGNMENT_UWORD 564 Compu_AAT_def -460 563.984375 /end CHARACTERISTIC
/begin COMPU_METHOD Compu_AAT_def " " RAT_FUNC "%.1" "deg F" COEFFS 0 64 29440 0 0 1 /end COMPU_METHOD
/begin CHARACTERISTIC RS_present "RoadSpeed input circuit{RS_present&0xff=0:Not Populated}{RS_present&0xff=1:Populated}" VALUE 0x001c88e3 /* @ECU_Address@RS_present@0x01002180@ */ ECIPP_ALIGNMENT_UBYTE 255 RS_present_COMPU_VTAB 0 255 BIT_MASK 0xff /end CHARACTERISTIC
/begin COMPU_METHOD RS_present_COMPU_VTAB "Verbal Table" TAB_VERB "%.0" "list" COMPU_TAB_REF RS_present_COMPU_VTAB_REF /end COMPU_METHOD
/begin COMPU_VTAB RS_present_COMPU_VTAB_REF "Verbal Table" TAB_VERB 2 0 "Not Populated" 1 "Populated" DEFAULT_VALUE "UNKNOWN" /end COMPU_VTAB
/begin CHARACTERISTIC key_on_waitalt "Key-on stopped wait - gaseous fuel" VALUE 0x001c849a /* @ECU_Address@key_on_waitalt@0x01002200@ */ ECIPP_ALIGNMENT_UWORD 66 Compu_key_on_waitalt 0 65.535 /end CHARACTERISTIC
/begin COMPU_METHOD Compu_key_on_waitalt " " RAT_FUNC "%.1" "seconds" COEFFS 0 1000 0 0 0 1 /end COMPU_METHOD
/begin CHARACTERISTIC ALfltG_RPMmin "and RPM >= (Fault Condition:and RPM >=)" VALUE 0x001C34CA /* @ECU_Address@ALfltG_RPMmin@0x010022B8@ */ ECIPP_ALIGNMENT_UWORD 65535 Compu_ALfltG_RPMmin 0 65535 /end CHARACTERISTIC
/begin COMPU_METHOD Compu_ALfltG_RPMmin " " RAT_FUNC "%.0" "rpm" COEFFS 0 1 0 0 0 1 /end COMPU_METHOD
/begin CHARACTERISTIC ALfltG_RPMmax "and RPM <= (Fault Condition:and RPM <=)" VALUE 0x001C34C8 /* @ECU_Address@ALfltG_RPMmax@0x010022C0@ */ ECIPP_ALIGNMENT_UWORD 65535 Compu_ALfltG_RPMmax 0 65535 /end CHARACTERISTIC
/begin COMPU_METHOD Compu_ALfltG_RPMmax " " RAT_FUNC "%.0" "rpm" COEFFS 0 1 0 0 0 1 /end COMPU_METHOD
/begin CHARACTERISTIC ALfltP_RPMmin "and RPM >= (Fault Condition:and RPM >=)" VALUE 0x001C1A0E /* @ECU_Address@ALfltP_RPMmin@0x010022C8@ */ ECIPP_ALIGNMENT_UWORD 65535 Compu_ALfltP_RPMmin 0 65535 /end CHARACTERISTIC
/begin COMPU_METHOD Compu_ALfltP_RPMmin " " RAT_FUNC "%.0" "rpm" COEFFS 0 1 0 0 0 1 /end COMPU_METHOD
/begin CHARACTERISTIC ALfltP_RPMmax "and RPM <= (Fault Condition:and RPM <=)" VALUE 0x001C1A0C /* @ECU_Address@ALfltP_RPMmax@0x010022D0@ */ ECIPP_ALIGNMENT_UWORD 65535 Compu_ALfltP_RPMmax 0 65535 /end CHARACTERISTIC
/begin COMPU_METHOD Compu_ALfltP_RPMmax " " RAT_FUNC "%.0" "rpm" COEFFS 0 1 0 0 0 1 /end COMPU_METHOD
/begin CHARACTERISTIC ALfltN_RPMmin "and RPM >= (Fault Condition:and RPM >=)" VALUE 0x001C2978 /* @ECU_Address@ALfltN_RPMmin@0x010022D8@ */ ECIPP_ALIGNMENT_UWORD 65535 Compu_ALfltN_RPMmin 0 65535 /end CHARACTERISTIC
/begin COMPU_METHOD Compu_ALfltN_RPMmin " " RAT_FUNC "%.0" "rpm" COEFFS 0 1 0 0 0 1 /end COMPU_METHOD
/begin CHARACTERISTIC ALfltN_RPMmax "and RPM <= (Fault Condition:and RPM <=)" VALUE 0x001C2976 /* @ECU_Address@ALfltN_RPMmax@0x010022E0@ */ ECIPP_ALIGNMENT_UWORD 65535 Compu_ALfltN_RPMmax 0 65535 /end CHARACTERISTIC
/begin COMPU_METHOD Compu_ALfltN_RPMmax " " RAT_FUNC "%.0" "rpm" COEFFS 0 1 0 0 0 1 /end COMPU_METHOD
/begin CHARACTERISTIC CLfltG_RPMmin "and RPM >= (Fault Condition:and RPM >=)" VALUE 0x001C34C2 /* @ECU_Address@CLfltG_RPMmin@0x010022E8@ */ ECIPP_ALIGNMENT_UWORD 65535 Compu_CLfltG_RPMmin 0 65535 /end CHARACTERISTIC
/begin COMPU_METHOD Compu_CLfltG_RPMmin " " RAT_FUNC "%.0" "rpm" COEFFS 0 1 0 0 0 1 /end COMPU_METHOD
/begin CHARACTERISTIC CLfltP_RPMmin "and RPM >= (Fault Condition:and RPM >=)" VALUE 0x001C1A06 /* @ECU_Address@CLfltP_RPMmin@0x010022F0@ */ ECIPP_ALIGNMENT_UWORD 65535 Compu_CLfltP_RPMmin 0 65535 /end CHARACTERISTIC
/begin COMPU_METHOD Compu_CLfltP_RPMmin " " RAT_FUNC "%.0" "rpm" COEFFS 0 1 0 0 0 1 /end COMPU_METHOD
/begin CHARACTERISTIC CLfltN_RPMmin "and RPM >= (Fault Condition:and RPM >=)" VALUE 0x001C2970 /* @ECU_Address@CLfltN_RPMmin@0x010022F8@ */ ECIPP_ALIGNMENT_UWORD 65535 Compu_CLfltN_RPMmin 0 65535 /end CHARACTERISTIC
/begin COMPU_METHOD Compu_CLfltN_RPMmin " " RAT_FUNC "%.0" "rpm" COEFFS 0 1 0 0 0 1 /end COMPU_METHOD
/begin CHARACTERISTIC CLfltG_RPMmax "and RPM <= (Fault Condition:and RPM <=)" VALUE 0x001C34C0 /* @ECU_Address@CLfltG_RPMmax@0x01002300@ */ ECIPP_ALIGNMENT_UWORD 65535 Compu_CLfltG_RPMmax 0 65535 /end CHARACTERISTIC
/begin COMPU_METHOD Compu_CLfltG_RPMmax " " RAT_FUNC "%.0" "rpm" COEFFS 0 1 0 0 0 1 /end COMPU_METHOD
/begin CHARACTERISTIC CLfltP_RPMmax "and RPM <= (Fault Condition:and RPM <=)" VALUE 0x001C1A04 /* @ECU_Address@CLfltP_RPMmax@0x01002308@ */ ECIPP_ALIGNMENT_UWORD 65535 Compu_CLfltP_RPMmax 0 65535 /end CHARACTERISTIC
/begin COMPU_METHOD Compu_CLfltP_RPMmax " " RAT_FUNC "%.0" "rpm" COEFFS 0 1 0 0 0 1 /end COMPU_METHOD
/begin CHARACTERISTIC CLfltN_RPMmax "and RPM <= (Fault Condition:and RPM <=)" VALUE 0x001C296E /* @ECU_Address@CLfltN_RPMmax@0x01002310@ */ ECIPP_ALIGNMENT_UWORD 65535 Compu_CLfltN_RPMmax 0 65535 /end CHARACTERISTIC
/begin COMPU_METHOD Compu_CLfltN_RPMmax " " RAT_FUNC "%.0" "rpm" COEFFS 0 1 0 0 0 1 /end COMPU_METHOD
/begin CHARACTERISTIC ALfltG_MAPmin "and MAP >= (Fault Condition:and MAP >=)" VALUE 0x001C34CE /* @ECU_Address@ALfltG_MAPmin@0x01002318@ */ ECIPP_ALIGNMENT_UWORD 256 Compu_ALfltG_MAPmin 0 255.99609375 /end CHARACTERISTIC
/begin COMPU_METHOD Compu_ALfltG_MAPmin " " RAT_FUNC "%.2" "psia" COEFFS 0 256 0 0 0 1 /end COMPU_METHOD
/begin CHARACTERISTIC ALfltP_MAPmin "and MAP >= (Fault Condition:and MAP >=)" VALUE 0x001C1A12 /* @ECU_Address@ALfltP_MAPmin@0x01002320@ */ ECIPP_ALIGNMENT_UWORD 256 Compu_ALfltP_MAPmin 0 255.99609375 /end CHARACTERISTIC
/begin COMPU_METHOD Compu_ALfltP_MAPmin " " RAT_FUNC "%.2" "psia" COEFFS 0 256 0 0 0 1 /end COMPU_METHOD
/begin CHARACTERISTIC ALfltN_MAPmin "and MAP >= (Fault Condition:and MAP >=)" VALUE 0x001C297C /* @ECU_Address@ALfltN_MAPmin@0x01002328@ */ ECIPP_ALIGNMENT_UWORD 256 Compu_ALfltN_MAPmin 0 255.99609375 /end CHARACTERISTIC
/begin COMPU_METHOD Compu_ALfltN_MAPmin " " RAT_FUNC "%.2" "psia" COEFFS 0 256 0 0 0 1 /end COMPU_METHOD
/begin CHARACTERISTIC ALfltG_MAPmax "and MAP <= (Fault Condition:and MAP <=)" VALUE 0x001C34CC /* @ECU_Address@ALfltG_MAPmax@0x01002330@ */ ECIPP_ALIGNMENT_UWORD 256 Compu_ALfltG_MAPmax 0 255.99609375 /end CHARACTERISTIC
/begin COMPU_METHOD Compu_ALfltG_MAPmax " " RAT_FUNC "%.2" "psia" COEFFS 0 256 0 0 0 1 /end COMPU_METHOD
/begin CHARACTERISTIC ALfltP_MAPmax "and MAP <= (Fault Condition:and MAP <=)" VALUE 0x001C1A10 /* @ECU_Address@ALfltP_MAPmax@0x01002338@ */ ECIPP_ALIGNMENT_UWORD 256 Compu_ALfltP_MAPmax 0 255.99609375 /end CHARACTERISTIC
/begin COMPU_METHOD Compu_ALfltP_MAPmax " " RAT_FUNC "%.2" "psia" COEFFS 0 256 0 0 0 1 /end COMPU_METHOD
/begin CHARACTERISTIC ALfltN_MAPmax "and MAP <= (Fault Condition:and MAP <=)" VALUE 0x001C297A /* @ECU_Address@ALfltN_MAPmax@0x01002340@ */ ECIPP_ALIGNMENT_UWORD 256 Compu_ALfltN_MAPmax 0 255.99609375 /end CHARACTERISTIC
/begin COMPU_METHOD Compu_ALfltN_MAPmax " " RAT_FUNC "%.2" "psia" COEFFS 0 256 0 0 0 1 /end COMPU_METHOD
/begin CHARACTERISTIC CLfltG_MAPmin "and MAP >= (Fault Condition:and MAP >=)" VALUE 0x001C34C6 /* @ECU_Address@CLfltG_MAPmin@0x01002348@ */ ECIPP_ALIGNMENT_UWORD 256 Compu_CLfltG_MAPmin 0 255.99609375 /end CHARACTERISTIC
/begin COMPU_METHOD Compu_CLfltG_MAPmin " " RAT_FUNC "%.2" "psia" COEFFS 0 256 0 0 0 1 /end COMPU_METHOD
/begin CHARACTERISTIC CLfltP_MAPmin "and MAP >= (Fault Condition:and MAP >=)" VALUE 0x001C1A0A /* @ECU_Address@CLfltP_MAPmin@0x01002350@ */ ECIPP_ALIGNMENT_UWORD 256 Compu_CLfltP_MAPmin 0 255.99609375 /end CHARACTERISTIC
/begin COMPU_METHOD Compu_CLfltP_MAPmin " " RAT_FUNC "%.2" "psia" COEFFS 0 256 0 0 0 1 /end COMPU_METHOD
/begin CHARACTERISTIC CLfltN_MAPmin "and MAP >= (Fault Condition:and MAP >=)" VALUE 0x001C2974 /* @ECU_Address@CLfltN_MAPmin@0x01002358@ */ ECIPP_ALIGNMENT_UWORD 256 Compu_CLfltN_MAPmin 0 255.99609375 /end CHARACTERISTIC
/begin COMPU_METHOD Compu_CLfltN_MAPmin " " RAT_FUNC "%.2" "psia" COEFFS 0 256 0 0 0 1 /end COMPU_METHOD
/begin CHARACTERISTIC CLfltG_MAPmax "and MAP <= (Fault Condition:and MAP <=)" VALUE 0x001C34C4 /* @ECU_Address@CLfltG_MAPmax@0x01002360@ */ ECIPP_ALIGNMENT_UWORD 256 Compu_CLfltG_MAPmax 0 255.99609375 /end CHARACTERISTIC
/begin COMPU_METHOD Compu_CLfltG_MAPmax " " RAT_FUNC "%.2" "psia" COEFFS 0 256 0 0 0 1 /end COMPU_METHOD
/begin CHARACTERISTIC CLfltP_MAPmax "and MAP <= (Fault Condition:and MAP <=)" VALUE 0x001C1A08 /* @ECU_Address@CLfltP_MAPmax@0x01002368@ */ ECIPP_ALIGNMENT_UWORD 256 Compu_CLfltP_MAPmax 0 255.99609375 /end CHARACTERISTIC
/begin COMPU_METHOD Compu_CLfltP_MAPmax " " RAT_FUNC "%.2" "psia" COEFFS 0 256 0 0 0 1 /end COMPU_METHOD
/begin CHARACTERISTIC CLfltN_MAPmax "and MAP <= (Fault Condition:and MAP <=)" VALUE 0x001C2972 /* @ECU_Address@CLfltN_MAPmax@0x01002370@ */ ECIPP_ALIGNMENT_UWORD 256 Compu_CLfltN_MAPmax 0 255.99609375 /end CHARACTERISTIC
/begin COMPU_METHOD Compu_CLfltN_MAPmax " " RAT_FUNC "%.2" "psia" COEFFS 0 256 0 0 0 1 /end COMPU_METHOD
/begin CHARACTERISTIC MJ_ctl_strat "EPR control strategy{MJ_ctl_strat&0xff=0:Internal PID Only}{MJ_ctl_strat&0xff=1:Feedforward Area}" VALUE 0x001c883b /* @ECU_Address@MJ_ctl_strat@0x01002388@ */ ECIPP_ALIGNMENT_UBYTE 255 MJ_ctl_strat_COMPU_VTAB 0 255 BIT_MASK 0xff /end CHARACTERISTIC
/begin COMPU_METHOD MJ_ctl_strat_COMPU_VTAB "Verbal Table" TAB_VERB "%.0" "list" COMPU_TAB_REF MJ_ctl_strat_COMPU_VTAB_REF /end COMPU_METHOD
/begin COMPU_VTAB MJ_ctl_strat_COMPU_VTAB_REF "Verbal Table" TAB_VERB 2 0 "Internal PID Only" 1 "Feedforward Area" DEFAULT_VALUE "UNKNOWN" /end COMPU_VTAB
/begin CHARACTERISTIC Carb_loc "Carburetor configuration{Carb_loc&0xff=0:Draw-Through}{Carb_loc&0xff=1:Blow-Through}" VALUE 0x001c86b4 /* @ECU_Address@Carb_loc@0x010023A0@ */ ECIPP_ALIGNMENT_UBYTE 255 Carb_loc_COMPU_VTAB 0 255 BIT_MASK 0xff /end CHARACTERISTIC
/begin COMPU_METHOD Carb_loc_COMPU_VTAB "Verbal Table" TAB_VERB "%.0" "list" COMPU_TAB_REF Carb_loc_COMPU_VTAB_REF /end COMPU_METHOD
/begin COMPU_VTAB Carb_loc_COMPU_VTAB_REF "Verbal Table" TAB_VERB 2 0 "Draw-Through" 1 "Blow-Through" DEFAULT_VALUE "UNKNOWN" /end COMPU_VTAB
/begin CHARACTERISTIC MJ_param_comm "EPR parameter comms{MJ_param_comm&0xff=0:Disabled}{MJ_param_comm&0xff=1:Enabled}{MJ_param_comm&0xff=2:Faults only}" VALUE 0x001c883d /* @ECU_Address@MJ_param_comm@0x01002468@ */ ECIPP_ALIGNMENT_UBYTE 255 MJ_param_comm_COMPU_VTAB 0 255 BIT_MASK 0xff /end CHARACTERISTIC
/begin COMPU_METHOD MJ_param_comm_COMPU_VTAB "Verbal Table" TAB_VERB "%.0" "list" COMPU_TAB_REF MJ_param_comm_COMPU_VTAB_REF /end COMPU_METHOD
/begin COMPU_VTAB MJ_param_comm_COMPU_VTAB_REF "Verbal Table" TAB_VERB 3 0 "Disabled" 1 "Enabled" 2 "Faults only" DEFAULT_VALUE "UNKNOWN" /end COMPU_VTAB
/begin CHARACTERISTIC key_off_valid "Key-off abs validate" VALUE 0x001c440c /* @ECU_Address@key_off_valid@0x01002490@ */ ECIPP_ALIGNMENT_ULONG 4294967295 Compu_key_off_valid 0 4294967295 /end CHARACTERISTIC
/begin COMPU_METHOD Compu_key_off_valid " " RAT_FUNC "%.0" "ms" COEFFS 0 1 0 0 0 1 /end COMPU_METHOD
/begin CHARACTERISTIC key_offrel_valid "Key-off rel validate" VALUE 0x001c4410 /* @ECU_Address@key_offrel_valid@0x01002498@ */ ECIPP_ALIGNMENT_ULONG 4294967295 Compu_key_offrel_valid 0 4294967295 /end CHARACTERISTIC
/begin COMPU_METHOD Compu_key_offrel_valid " " RAT_FUNC "%.0" "ms" COEFFS 0 1 0 0 0 1 /end COMPU_METHOD
/begin CHARACTERISTIC BstTIP_Hi "TIP > TIP target + (Fault Condition:P > P target +)" VALUE 0x001c6d8a /* @ECU_Address@BstTIP_Hi@0x01002838@ */ ECIPP_ALIGNMENT_UWORD 256 Compu_BstTIP_Hi 0 255.99609375 /end CHARACTERISTIC
/begin COMPU_METHOD Compu_BstTIP_Hi " " RAT_FUNC "%.2" "psi" COEFFS 0 256 0 0 0 1 /end COMPU_METHOD
/begin CHARACTERISTIC BstTIP_Hi_abs "and TIP > (Fault Condition:and P >)" VALUE 0x001c6d8c /* @ECU_Address@BstTIP_Hi_abs@0x01002840@ */ ECIPP_ALIGNMENT_UWORD 256 Compu_BstTIP_Hi_abs 0 255.99609375 /end CHARACTERISTIC
/begin COMPU_METHOD Compu_BstTIP_Hi_abs " " RAT_FUNC "%.2" "psia" COEFFS 0 256 0 0 0 1 /end COMPU_METHOD
/begin CHARACTERISTIC BstTIP_Hi_dtdz "and dTIP/dt >= (Fault Condition:and dP/dt >=)" VALUE 0x001c4422 /* @ECU_Address@BstTIP_Hi_dtdz@0x01002848@ */ ECIPP_ALIGNMENT_SWORD 512 Compu_BstTIP_Hi_dtdz -512 511.984375 /end CHARACTERISTIC
/begin COMPU_METHOD Compu_BstTIP_Hi_dtdz " " RAT_FUNC "%.1" "psi/sec" COEFFS 0 64 0 0 0 1 /end COMPU_METHOD
/begin CHARACTERISTIC BstTIP_Lo_dtdz "and dTIP/dt <= (Fault Condition:and dP/dt <=)" VALUE 0x001c4426 /* @ECU_Address@BstTIP_Lo_dtdz@0x01002850@ */ ECIPP_ALIGNMENT_SWORD 512 Compu_BstTIP_Lo_dtdz -512 511.984375 /end CHARACTERISTIC
/begin COMPU_METHOD Compu_BstTIP_Lo_dtdz " " RAT_FUNC "%.1" "psi/sec" COEFFS 0 64 0 0 0 1 /end COMPU_METHOD
/begin CHARACTERISTIC BstTIP_Lo "TIP < TIP target - (Fault Condition:P < P target -)" VALUE 0x001c6d8e /* @ECU_Address@BstTIP_Lo@0x01002858@ */ ECIPP_ALIGNMENT_UWORD 256 Compu_BstTIP_Lo 0 255.99609375 /end CHARACTERISTIC
/begin COMPU_METHOD Compu_BstTIP_Lo " " RAT_FUNC "%.2" "psi" COEFFS 0 256 0 0 0 1 /end COMPU_METHOD
/begin CHARACTERISTIC BstTIP_Lo_abs "and TIP taget > (Fault Condition:and P target >)" VALUE 0x001c6da0 /* @ECU_Address@BstTIP_Lo_abs@0x01002860@ */ ECIPP_ALIGNMENT_UWORD 256 Compu_BstTIP_Lo_abs 0 255.99609375 /end CHARACTERISTIC
/begin COMPU_METHOD Compu_BstTIP_Lo_abs " " RAT_FUNC "%.2" "psia" COEFFS 0 256 0 0 0 1 /end COMPU_METHOD
/begin CHARACTERISTIC BstTIP_Lo_ECT "and ECT > (Fault Condition:and ECT >)" VALUE 0x001c6d9a /* @ECU_Address@BstTIP_Lo_ECT@0x01002868@ */ ECIPP_ALIGNMENT_UWORD 564 Compu_BstTIP_Lo_ECT -460 563.984375 /end CHARACTERISTIC
/begin COMPU_METHOD Compu_BstTIP_Lo_ECT " " RAT_FUNC "%.0" "deg F" COEFFS 0 64 29440 0 0 1 /end COMPU_METHOD
/begin CHARACTERISTIC TIP_act "TIP active fault TIP low (Fault Condition:TIP < (turbo) / TOP > (supercharged))" VALUE 0x001c80f4 /* @ECU_Address@TIP_act@0x010029A0@ */ ECIPP_ALIGNMENT_UWORD 256 Compu_TIP_act 0 255.99609375 /end CHARACTERISTIC
/begin COMPU_METHOD Compu_TIP_act " " RAT_FUNC "%.2" "psia" COEFFS 0 256 0 0 0 1 /end COMPU_METHOD
/begin CHARACTERISTIC TIP_actMAP "TIP active fault MAP min (Fault Condition:and MAP > (turbo) / MAP < (supercharged))" VALUE 0x001c80f6 /* @ECU_Address@TIP_actMAP@0x010029A8@ */ ECIPP_ALIGNMENT_UWORD 256 Compu_TIP_actMAP 0 255.99609375 /end CHARACTERISTIC
/begin COMPU_METHOD Compu_TIP_actMAP " " RAT_FUNC "%.2" "psia" COEFFS 0 256 0 0 0 1 /end COMPU_METHOD
/begin CHARACTERISTIC IAC_home_int_min "IAC homing sequence min step rate" VALUE 0x001c7bec /* @ECU_Address@IAC_home_int_min@0x010033D8@ */ ECIPP_ALIGNMENT_UWORD 256 Compu_IAC_home_int_min 0 255.99609375 /end CHARACTERISTIC
/begin COMPU_METHOD Compu_IAC_home_int_min " " RAT_FUNC "%.1" "ms" COEFFS 0 256 0 0 0 1 /end COMPU_METHOD
/begin CHARACTERISTIC FPP1_5V_source "FPP1 5V excitation source{FPP1_5V_source&0xff=0:Primary - 5VE 1/a}{FPP1_5V_source&0xff=1:Secondary - 5VE 2/b}{FPP1_5V_source&0xff=2:Secondary - 5VE 2/b rescaled}" VALUE 0x001c8710 /* @ECU_Address@FPP1_5V_source@0x01003458@ */ ECIPP_ALIGNMENT_UBYTE 255 FPP1_5V_source_COMPU_VTAB 0 255 BIT_MASK 0xff /end CHARACTERISTIC
/begin COMPU_METHOD FPP1_5V_source_COMPU_VTAB "Verbal Table" TAB_VERB "%.0" "list" COMPU_TAB_REF FPP1_5V_source_COMPU_VTAB_REF /end COMPU_METHOD
/begin COMPU_VTAB FPP1_5V_source_COMPU_VTAB_REF "Verbal Table" TAB_VERB 3 0 "Primary - 5VE 1/a" 1 "Secondary - 5VE 2/b" 2 "Secondary - 5VE 2/b rescaled" DEFAULT_VALUE "UNKNOWN" /end COMPU_VTAB
/begin CHARACTERISTIC FPP2_5V_source "FPP2 5V excitation source{FPP2_5V_source&0xff=0:Primary - 5VE 1/a}{FPP2_5V_source&0xff=1:Secondary - 5VE 2/b}{FPP2_5V_source&0xff=2:Secondary - 5VE 2/b rescaled}" VALUE 0x001c8714 /* @ECU_Address@FPP2_5V_source@0x01003460@ */ ECIPP_ALIGNMENT_UBYTE 255 FPP2_5V_source_COMPU_VTAB 0 255 BIT_MASK 0xff /end CHARACTERISTIC
/begin COMPU_METHOD FPP2_5V_source_COMPU_VTAB "Verbal Table" TAB_VERB "%.0" "list" COMPU_TAB_REF FPP2_5V_source_COMPU_VTAB_REF /end COMPU_METHOD
/begin COMPU_VTAB FPP2_5V_source_COMPU_VTAB_REF "Verbal Table" TAB_VERB 3 0 "Primary - 5VE 1/a" 1 "Secondary - 5VE 2/b" 2 "Secondary - 5VE 2/b rescaled" DEFAULT_VALUE "UNKNOWN" /end COMPU_VTAB
/begin MEASUREMENT emcal_CS_16 "Emissions cal checksum16" UWORD Compu_emcal_CS_16 0 0 0 65535 ECU_ADDRESS 0x01003470 /end MEASUREMENT
/begin COMPU_METHOD Compu_emcal_CS_16 " " RAT_FUNC "%.0" "-" COEFFS 0 1 0 0 0 1 /end COMPU_METHOD
/begin MEASUREMENT totalcal_CS_16 "Total checksum16" UWORD Compu_totalcal_CS_16 0 0 0 65535 ECU_ADDRESS 0x010034B8 /end MEASUREMENT
/begin COMPU_METHOD Compu_totalcal_CS_16 " " RAT_FUNC "%.0" "-" COEFFS 0 1 0 0 0 1 /end COMPU_METHOD
/begin CHARACTERISTIC cam_pos_tau "Cam position estimation filter" VALUE 0x001c865a /* @ECU_Address@cam_pos_tau@0x01003570@ */ ECIPP_ALIGNMENT_UWORD 1638398 Compu_cam_pos_tau 1.6703 1638400 /end CHARACTERISTIC
/begin COMPU_METHOD Compu_cam_pos_tau " " FORM "%.0" "ms"
 /begin FORMULA "-50 / log(1.0000000000001 - (X1 / 32768))" FORMULA_INV "(1.0000000000001 - exp(-50/X1)) * 32768" /end FORMULA
/end COMPU_METHOD
/begin CHARACTERISTIC FaultCylBlock_use "Cylinder numbering request{FaultCylBlock_use&0xff=0:Firing Order}{FaultCylBlock_use&0xff=1:Block Order}" VALUE 0x001c874a /* @ECU_Address@FaultCylBlock_use@0x01003AD0@ */ ECIPP_ALIGNMENT_UBYTE 255 FaultCylBlock_use_COMPU_VTAB 0 255 BIT_MASK 0xff /end CHARACTERISTIC
/begin COMPU_METHOD FaultCylBlock_use_COMPU_VTAB "Verbal Table" TAB_VERB "%.0" "list" COMPU_TAB_REF FaultCylBlock_use_COMPU_VTAB_REF /end COMPU_METHOD
/begin COMPU_VTAB FaultCylBlock_use_COMPU_VTAB_REF "Verbal Table" TAB_VERB 2 0 "Firing Order" 1 "Block Order" DEFAULT_VALUE "UNKNOWN" /end COMPU_VTAB
/begin CHARACTERISTIC ADIG3_max "Water intrusion input limit (Fault Condition:AUX DIG3 >)" VALUE 0x001e372c /* @ECU_Address@ADIG3_max@0x01003D98@ */ ECIPP_ALIGNMENT_UWORD 256 Compu_ADIG3_max 0 255.99609375 /end CHARACTERISTIC
/begin COMPU_METHOD Compu_ADIG3_max " " RAT_FUNC "%.2" "volts" COEFFS 0 256 0 0 0 1 /end COMPU_METHOD
/begin CHARACTERISTIC J1939_TSC1_loss "Loss of TSC1 after engine running >= (Fault Condition:Loss of TSC1 after engine running >=)" VALUE 0x001c7ca6 /* @ECU_Address@J1939_TSC1_loss@0x010040F8@ */ ECIPP_ALIGNMENT_UWORD 66 Compu_J1939_TSC1_loss 0 65.535 /end CHARACTERISTIC
/begin COMPU_METHOD Compu_J1939_TSC1_loss " " RAT_FUNC "%.2" "sec" COEFFS 0 1000 0 0 0 1 /end COMPU_METHOD
/begin CHARACTERISTIC TRIM_lim_bhvP "LP trim valve +/- limit behavior{TRIM_lim_bhvP&0xff=0:Allow CL to reach hard limits}{TRIM_lim_bhvP&0xff=1:Limit CL to valve authority without fault setting}{TRIM_lim_bhvP&0xff=2:Limit CL to valve authority with fault setting}" VALUE 0x001C1A20 /* @ECU_Address@TRIM_lim_bhvP@0x01004370@ */ ECIPP_ALIGNMENT_UBYTE 255 TRIM_lim_bhvP_COMPU_VTAB 0 255 BIT_MASK 0xff /end CHARACTERISTIC
/begin COMPU_METHOD TRIM_lim_bhvP_COMPU_VTAB "Verbal Table" TAB_VERB "%.0" "list" COMPU_TAB_REF TRIM_lim_bhvP_COMPU_VTAB_REF /end COMPU_METHOD
/begin COMPU_VTAB TRIM_lim_bhvP_COMPU_VTAB_REF "Verbal Table" TAB_VERB 3 0 "Allow CL to reach hard limits" 1 "Limit CL to valve authority without fault setting" 2 "Limit CL to valve authority with fault setting" DEFAULT_VALUE "UNKNOWN" /end COMPU_VTAB
/begin CHARACTERISTIC TRIM_lim_bhvN "NG trim valve +/- limit behavior{TRIM_lim_bhvN&0xff=0:Allow CL to reach hard limits}{TRIM_lim_bhvN&0xff=1:Limit CL to valve authority without fault setting}{TRIM_lim_bhvN&0xff=2:Limit CL to valve authority with fault setting}" VALUE 0x001C298A /* @ECU_Address@TRIM_lim_bhvN@0x01004378@ */ ECIPP_ALIGNMENT_UBYTE 255 TRIM_lim_bhvN_COMPU_VTAB 0 255 BIT_MASK 0xff /end CHARACTERISTIC
/begin COMPU_METHOD TRIM_lim_bhvN_COMPU_VTAB "Verbal Table" TAB_VERB "%.0" "list" COMPU_TAB_REF TRIM_lim_bhvN_COMPU_VTAB_REF /end COMPU_METHOD
/begin COMPU_VTAB TRIM_lim_bhvN_COMPU_VTAB_REF "Verbal Table" TAB_VERB 3 0 "Allow CL to reach hard limits" 1 "Limit CL to valve authority without fault setting" 2 "Limit CL to valve authority with fault setting" DEFAULT_VALUE "UNKNOWN" /end COMPU_VTAB
/begin CHARACTERISTIC J1939_ETC_loss "Loss of ETC after engine running >= (Fault Condition:Loss of ETC after engine running >=)" VALUE 0x001c7c84 /* @ECU_Address@J1939_ETC_loss@0x01004590@ */ ECIPP_ALIGNMENT_UWORD 66 Compu_J1939_ETC_loss 0 65.535 /end CHARACTERISTIC
/begin COMPU_METHOD Compu_J1939_ETC_loss " " RAT_FUNC "%.2" "sec" COEFFS 0 1000 0 0 0 1 /end COMPU_METHOD
/begin CHARACTERISTIC V_LPG "LPG upstream volume" VALUE 0x001c8370 /* @ECU_Address@V_LPG@0x01004B20@ */ ECIPP_ALIGNMENT_UWORD 32 Compu_V_LPG 0 31.99951171875 /end CHARACTERISTIC
/begin COMPU_METHOD Compu_V_LPG " " RAT_FUNC "%.2" "L" COEFFS 0 2048 0 0 0 1 /end COMPU_METHOD
/begin CHARACTERISTIC V_NG "NG upstream volume" VALUE 0x001c8374 /* @ECU_Address@V_NG@0x01004B28@ */ ECIPP_ALIGNMENT_UWORD 32 Compu_V_NG 0 31.99951171875 /end CHARACTERISTIC
/begin COMPU_METHOD Compu_V_NG " " RAT_FUNC "%.2" "L" COEFFS 0 2048 0 0 0 1 /end COMPU_METHOD
/begin CHARACTERISTIC key_on_wait "Key-on stopped wait - gasoline" VALUE 0x001c8498 /* @ECU_Address@key_on_wait@0x01004CB0@ */ ECIPP_ALIGNMENT_UWORD 66 Compu_key_on_wait 0 65.535 /end CHARACTERISTIC
/begin COMPU_METHOD Compu_key_on_wait " " RAT_FUNC "%.1" "seconds" COEFFS 0 1000 0 0 0 1 /end COMPU_METHOD
/begin CHARACTERISTIC fpump_key_wait "Fuel pump stopped wait - gasoline" VALUE 0x001c843c /* @ECU_Address@fpump_key_wait@0x01004D20@ */ ECIPP_ALIGNMENT_UWORD 66 Compu_fpump_key_wait 0 65.535 /end CHARACTERISTIC
/begin COMPU_METHOD Compu_fpump_key_wait " " RAT_FUNC "%.1" "seconds" COEFFS 0 1000 0 0 0 1 /end COMPU_METHOD
/begin CHARACTERISTIC lockoff_key_wait "Lockoff stopped wait - gaseous fuel" VALUE 0x001c84a0 /* @ECU_Address@lockoff_key_wait@0x01004D28@ */ ECIPP_ALIGNMENT_UWORD 66 Compu_lockoff_key_wait 0 65.535 /end CHARACTERISTIC
/begin COMPU_METHOD Compu_lockoff_key_wait " " RAT_FUNC "%.1" "seconds" COEFFS 0 1000 0 0 0 1 /end COMPU_METHOD
/begin CHARACTERISTIC LOD_WARN_force "Historic fault forced indication{LOD_WARN_force&0xff=0:Disabled}{LOD_WARN_force&0xff=1:Soft Warning}{LOD_WARN_force&0xff=2:Hard Warning} (Fault Condition:Historic fault forced indication)" VALUE 0x001c87d6 /* @ECU_Address@LOD_WARN_force@0x01004F48@ */ ECIPP_ALIGNMENT_UBYTE 255 LOD_WARN_force_COMPU_VTAB 0 255 BIT_MASK 0xff /end CHARACTERISTIC
/begin COMPU_METHOD LOD_WARN_force_COMPU_VTAB "Verbal Table" TAB_VERB "%.0" "list" COMPU_TAB_REF LOD_WARN_force_COMPU_VTAB_REF /end COMPU_METHOD
/begin COMPU_VTAB LOD_WARN_force_COMPU_VTAB_REF "Verbal Table" TAB_VERB 3 0 "Disabled" 1 "Soft Warning" 2 "Hard Warning" DEFAULT_VALUE "UNKNOWN" /end COMPU_VTAB
/begin CHARACTERISTIC SWARN_bulbchk "Soft warning bulb-check time" VALUE 0x001c7fc6 /* @ECU_Address@SWARN_bulbchk@0x01004F50@ */ ECIPP_ALIGNMENT_UWORD 65535 Compu_SWARN_bulbchk 0 65535 /end CHARACTERISTIC
/begin COMPU_METHOD Compu_SWARN_bulbchk " " RAT_FUNC "%.0" "ms" COEFFS 0 1 0 0 0 1 /end COMPU_METHOD
/begin CHARACTERISTIC HWARN_bulbchk "Hard warning bulb-check time" VALUE 0x001c7be4 /* @ECU_Address@HWARN_bulbchk@0x01004F58@ */ ECIPP_ALIGNMENT_UWORD 65535 Compu_HWARN_bulbchk 0 65535 /end CHARACTERISTIC
/begin COMPU_METHOD Compu_HWARN_bulbchk " " RAT_FUNC "%.0" "ms" COEFFS 0 1 0 0 0 1 /end COMPU_METHOD
/begin CHARACTERISTIC J1939_DM19_calid "J1939 DM19 calibration ID{J1939_DM19_calid&0xff=0:Calibration Model No.}{J1939_DM19_calid&0xff=1:Customer Software PN}" VALUE 0x001C948F /* @ECU_Address@J1939_DM19_calid@0x01005610@ */ ECIPP_ALIGNMENT_UBYTE 255 J1939_DM19_calid_COMPU_VTAB 0 255 BIT_MASK 0xff /end CHARACTERISTIC
/begin COMPU_METHOD J1939_DM19_calid_COMPU_VTAB "Verbal Table" TAB_VERB "%.0" "list" COMPU_TAB_REF J1939_DM19_calid_COMPU_VTAB_REF /end COMPU_METHOD
/begin COMPU_VTAB J1939_DM19_calid_COMPU_VTAB_REF "Verbal Table" TAB_VERB 2 0 "Calibration Model No." 1 "Customer Software PN" DEFAULT_VALUE "UNKNOWN" /end COMPU_VTAB
/begin CHARACTERISTIC J1939_DM5_OBDc "J1939 DM5 OBD compliance{J1939_DM5_OBDc&0xff=0:None}{J1939_DM5_OBDc&0xff=1:OBD (Federal, EPA)}{J1939_DM5_OBDc&0xff=2:OBD I}{J1939_DM5_OBDc&0xff=3:OBD, OBD II}{J1939_DM5_OBDc&0xff=4:OBD II (CARB)}{J1939_DM5_OBDc&0xff=5:OBD II (CARB 2007/8)}{J1939_DM5_OBDc&" VALUE 0x001C948E /* @ECU_Address@J1939_DM5_OBDc@0x01005618@ */ ECIPP_ALIGNMENT_UBYTE 255 J1939_DM5_OBDc_COMPU_VTAB 0 255 BIT_MASK 0xff /end CHARACTERISTIC
/begin COMPU_METHOD J1939_DM5_OBDc_COMPU_VTAB "Verbal Table" TAB_VERB "%.0" "list" COMPU_TAB_REF J1939_DM5_OBDc_COMPU_VTAB_REF /end COMPU_METHOD
/begin COMPU_VTAB J1939_DM5_OBDc_COMPU_VTAB_REF "Verbal Table" TAB_VERB 29 0 "None" 1 "OBD (Federal, EPA)" 2 "OBD I" 3 "OBD, OBD II" 4 "OBD II (CARB)" 5 "OBD II (CARB 2007/8)" 6 "OBDM" 7 "EOBD" 8 "EOBD and OBD" 9 "EOBD and OBD II" 10 "EOBD , OBD and OBD II" 11 "JOBD" 12 "JOBD and OBD II" 13 "JOBD and EOBD" 14 "JOBD, EOBD and OBD II" 15 "HD (EURO VI) B1" 16 "HD (EURO V) B2" 17 "HD (EURO EEC) C" 18 "EMD" 19 "EMD+" 20 "HD OBD P" 21 "HD OBD" 22 "World Wide Harmonized OBD" 23 "HD EOBD" 24 "EURO VI" 25 "OBD, OBD II, HD OBD" 26 "OBD, OBD II, HD OBD P" 27 "China Nationwide Stage 6 (China VI)" 28 "Brazil OBD Diesel" DEFAULT_VALUE "UNKNOWN" /end COMPU_VTAB
/begin CHARACTERISTIC Vs "Primary injection standard voltage" VALUE 0x001C9F72 /* @ECU_Address@Vs@0x010056F0@ */ ECIPP_ALIGNMENT_UWORD 256 Compu_Vs 0 255.99609375 /end CHARACTERISTIC
/begin COMPU_METHOD Compu_Vs " " RAT_FUNC "%.2" "volts" COEFFS 0 256 0 0 0 1 /end COMPU_METHOD
/begin CHARACTERISTIC FPin_s "Fuel pressure in std" VALUE 0x001C9F6C /* @ECU_Address@FPin_s@0x010056F8@ */ ECIPP_ALIGNMENT_UWORD 256 Compu_FPin_s 0 255.99609375 /end CHARACTERISTIC
/begin COMPU_METHOD Compu_FPin_s " " RAT_FUNC "%.1" "psia" COEFFS 0 256 0 0 0 1 /end COMPU_METHOD
/begin CHARACTERISTIC FPout_s "Fuel pressure out std" VALUE 0x001C9F6E /* @ECU_Address@FPout_s@0x01005700@ */ ECIPP_ALIGNMENT_UWORD 256 Compu_FPout_s 0 255.99609375 /end CHARACTERISTIC
/begin COMPU_METHOD Compu_FPout_s " " RAT_FUNC "%.1" "psia" COEFFS 0 256 0 0 0 1 /end COMPU_METHOD
/begin CHARACTERISTIC FP_ena "Primary fuel pressure channel{FP_ena&0xff=0:Disabled}{FP_ena&0xff=1:Default Input}{FP_ena&0xff=2:Aux PD1}{FP_ena&0xff=3:Aux PD2}{FP_ena&0xff=4:Aux PD3}{FP_ena&0xff=5:Aux PUD1}{FP_ena&0xff=6:Aux PUD2}{FP_ena&0xff=7:Aux PUD3}{FP_ena&0xff=8:Aux PUD4}{FP_ena&" VALUE 0x001C9F89 /* @ECU_Address@FP_ena@0x01005708@ */ ECIPP_ALIGNMENT_UBYTE 255 FP_ena_COMPU_VTAB 0 255 BIT_MASK 0xff /end CHARACTERISTIC
/begin COMPU_METHOD FP_ena_COMPU_VTAB "Verbal Table" TAB_VERB "%.0" "list" COMPU_TAB_REF FP_ena_COMPU_VTAB_REF /end COMPU_METHOD
/begin COMPU_VTAB FP_ena_COMPU_VTAB_REF "Verbal Table" TAB_VERB 11 0 "Disabled" 1 "Default Input" 2 "Aux PD1" 3 "Aux PD2" 4 "Aux PD3" 5 "Aux PUD1" 6 "Aux PUD2" 7 "Aux PUD3" 8 "Aux PUD4" 9 "Aux PUD5" 10 "SENT - CRI" DEFAULT_VALUE "UNKNOWN" /end COMPU_VTAB
/begin CHARACTERISTIC FP_abs_gage "Fuel pressure units{FP_abs_gage&0xff=0:psia}{FP_abs_gage&0xff=1:psig}" VALUE 0x001C9F8A /* @ECU_Address@FP_abs_gage@0x01005710@ */ ECIPP_ALIGNMENT_UBYTE 255 FP_abs_gage_COMPU_VTAB 0 255 BIT_MASK 0xff /end CHARACTERISTIC
/begin COMPU_METHOD FP_abs_gage_COMPU_VTAB "Verbal Table" TAB_VERB "%.0" "list" COMPU_TAB_REF FP_abs_gage_COMPU_VTAB_REF /end COMPU_METHOD
/begin COMPU_VTAB FP_abs_gage_COMPU_VTAB_REF "Verbal Table" TAB_VERB 2 0 "psia" 1 "psig" DEFAULT_VALUE "UNKNOWN" /end COMPU_VTAB
/begin CHARACTERISTIC adapt_ena "Adaptive control{adapt_ena&0xff=0:Disabled}{adapt_ena&0xff=1:Enabled}" VALUE 0x001c8f97 /* @ECU_Address@adapt_ena@0x01005718@ */ ECIPP_ALIGNMENT_UBYTE 255 adapt_ena_COMPU_VTAB 0 255 BIT_MASK 0xff /end CHARACTERISTIC
/begin COMPU_METHOD adapt_ena_COMPU_VTAB "Verbal Table" TAB_VERB "%.0" "list" COMPU_TAB_REF adapt_ena_COMPU_VTAB_REF /end COMPU_METHOD
/begin COMPU_VTAB adapt_ena_COMPU_VTAB_REF "Verbal Table" TAB_VERB 2 0 "Disabled" 1 "Enabled" DEFAULT_VALUE "UNKNOWN" /end COMPU_VTAB
/begin CHARACTERISTIC HWARN_bulbon "Hard warning bulb check{HWARN_bulbon&0xff=0:Blink}{HWARN_bulbon&0xff=1:On}" VALUE 0x001c8760 /* @ECU_Address@HWARN_bulbon@0x010058F0@ */ ECIPP_ALIGNMENT_UBYTE 255 HWARN_bulbon_COMPU_VTAB 0 255 BIT_MASK 0xff /end CHARACTERISTIC
/begin COMPU_METHOD HWARN_bulbon_COMPU_VTAB "Verbal Table" TAB_VERB "%.0" "list" COMPU_TAB_REF HWARN_bulbon_COMPU_VTAB_REF /end COMPU_METHOD
/begin COMPU_VTAB HWARN_bulbon_COMPU_VTAB_REF "Verbal Table" TAB_VERB 2 0 "Blink" 1 "On" DEFAULT_VALUE "UNKNOWN" /end COMPU_VTAB
/begin CHARACTERISTIC SWARN_bulbon "Soft warning bulb check{SWARN_bulbon&0xff=0:Blink}{SWARN_bulbon&0xff=1:On}" VALUE 0x001c8eef /* @ECU_Address@SWARN_bulbon@0x010058F8@ */ ECIPP_ALIGNMENT_UBYTE 255 SWARN_bulbon_COMPU_VTAB 0 255 BIT_MASK 0xff /end CHARACTERISTIC
/begin COMPU_METHOD SWARN_bulbon_COMPU_VTAB "Verbal Table" TAB_VERB "%.0" "list" COMPU_TAB_REF SWARN_bulbon_COMPU_VTAB_REF /end COMPU_METHOD
/begin COMPU_VTAB SWARN_bulbon_COMPU_VTAB_REF "Verbal Table" TAB_VERB 2 0 "Blink" 1 "On" DEFAULT_VALUE "UNKNOWN" /end COMPU_VTAB
/begin CHARACTERISTIC fuelclr_mult "General # fuelclr_mult" VALUE 0x001c8442 /* @ECU_Address@fuelclr_mult@0x01006350@ */ ECIPP_ALIGNMENT_UWORD 1 Compu_fuelclr_mult 0 0.999984741210938 /end CHARACTERISTIC
/begin COMPU_METHOD Compu_fuelclr_mult " " RAT_FUNC "%.0" "-" COEFFS 0 65536 0 0 0 1 /end COMPU_METHOD
/begin CHARACTERISTIC CRI_V_relay "Boost-recharge transition" VALUE 0x001ed2c6 /* @ECU_Address@CRI_V_relay@0x01008810@ */ ECIPP_ALIGNMENT_UWORD 1024 Compu_CRI_V_relay 0 1023.984375 /end CHARACTERISTIC
/begin COMPU_METHOD Compu_CRI_V_relay " " RAT_FUNC "%.1" "volts" COEFFS 0 64 0 0 0 1 /end COMPU_METHOD
/begin CHARACTERISTIC FPin_s_I2 "Sec fuel pressure in std" VALUE 0x001C9FA8 /* @ECU_Address@FPin_s_I2@0x01009120@ */ ECIPP_ALIGNMENT_UWORD 256 Compu_FPin_s_I2 0 255.99609375 /end CHARACTERISTIC
/begin COMPU_METHOD Compu_FPin_s_I2 " " RAT_FUNC "%.1" "psia" COEFFS 0 256 0 0 0 1 /end COMPU_METHOD
/begin CHARACTERISTIC FPout_s_I2 "Sec fuel pressure out std" VALUE 0x001C9FAA /* @ECU_Address@FPout_s_I2@0x01009128@ */ ECIPP_ALIGNMENT_UWORD 256 Compu_FPout_s_I2 0 255.99609375 /end CHARACTERISTIC
/begin COMPU_METHOD Compu_FPout_s_I2 " " RAT_FUNC "%.1" "psia" COEFFS 0 256 0 0 0 1 /end COMPU_METHOD
/begin CHARACTERISTIC Vs_I2 "Secondary injection standard voltage" VALUE 0x001C9FAE /* @ECU_Address@Vs_I2@0x01009138@ */ ECIPP_ALIGNMENT_UWORD 256 Compu_Vs_I2 0 255.99609375 /end CHARACTERISTIC
/begin COMPU_METHOD Compu_Vs_I2 " " RAT_FUNC "%.2" "volts" COEFFS 0 256 0 0 0 1 /end COMPU_METHOD
/begin CHARACTERISTIC FP_ena_I2 "Secondary fuel pressure channel{FP_ena_I2&0xff=0:Disabled}{FP_ena_I2&0xff=1:Default Input}{FP_ena_I2&0xff=2:Aux PD1}{FP_ena_I2&0xff=3:Aux PD2}{FP_ena_I2&0xff=4:Aux PD3}{FP_ena_I2&0xff=5:Aux PUD1}{FP_ena_I2&0xff=6:Aux PUD2}{FP_ena_I2&0xff=7:Aux PUD3}{FP_en" VALUE 0x001C9FC5 /* @ECU_Address@FP_ena_I2@0x01009140@ */ ECIPP_ALIGNMENT_UBYTE 255 FP_ena_I2_COMPU_VTAB 0 255 BIT_MASK 0xff /end CHARACTERISTIC
/begin COMPU_METHOD FP_ena_I2_COMPU_VTAB "Verbal Table" TAB_VERB "%.0" "list" COMPU_TAB_REF FP_ena_I2_COMPU_VTAB_REF /end COMPU_METHOD
/begin COMPU_VTAB FP_ena_I2_COMPU_VTAB_REF "Verbal Table" TAB_VERB 11 0 "Disabled" 1 "Default Input" 2 "Aux PD1" 3 "Aux PD2" 4 "Aux PD3" 5 "Aux PUD1" 6 "Aux PUD2" 7 "Aux PUD3" 8 "Aux PUD4" 9 "Aux PUD5" 10 "SENT - CRI" DEFAULT_VALUE "UNKNOWN" /end COMPU_VTAB
/begin CHARACTERISTIC FP_abs_gage_I2 "Secondary fuel pressure units{FP_abs_gage_I2&0xff=0:psia}{FP_abs_gage_I2&0xff=1:psig}" VALUE 0x001C9FC6 /* @ECU_Address@FP_abs_gage_I2@0x01009148@ */ ECIPP_ALIGNMENT_UBYTE 255 FP_abs_gage_I2_COMPU_VTAB 0 255 BIT_MASK 0xff /end CHARACTERISTIC
/begin COMPU_METHOD FP_abs_gage_I2_COMPU_VTAB "Verbal Table" TAB_VERB "%.0" "list" COMPU_TAB_REF FP_abs_gage_I2_COMPU_VTAB_REF /end COMPU_METHOD
/begin COMPU_VTAB FP_abs_gage_I2_COMPU_VTAB_REF "Verbal Table" TAB_VERB 2 0 "psia" 1 "psig" DEFAULT_VALUE "UNKNOWN" /end COMPU_VTAB
/begin CHARACTERISTIC FPraw_LP_I2 "Secondary FP raw filter" VALUE 0x001C9FBC /* @ECU_Address@FPraw_LP_I2@0x010091B0@ */ ECIPP_ALIGNMENT_UWORD 327680 Compu_FPraw_LP_I2 0.45084 327680 /end CHARACTERISTIC
/begin COMPU_METHOD Compu_FPraw_LP_I2 " " FORM "%.3" "ms"
 /begin FORMULA "-5 / log(1 - (X1 / 65536))" FORMULA_INV "(1 - exp(-5/X1)) * 65536" /end FORMULA
/end COMPU_METHOD
/begin CHARACTERISTIC EGR_clr_Cr_nom "EGR cooler nominal heat capacity ratio" VALUE 0x001c0070 /* @ECU_Address@EGR_clr_Cr_nom@0x01009290@ */ ECIPP_ALIGNMENT_FLOAT32_IEEE 10000000000 Compu_EGR_clr_Cr_nom -10000000000 10000000000 /end CHARACTERISTIC
/begin COMPU_METHOD Compu_EGR_clr_Cr_nom " " RAT_FUNC "%.3" "-" COEFFS 0 1 0 0 0 1 /end COMPU_METHOD
/begin CHARACTERISTIC EGR_clr_eta_nom "EGR cooler nominal efficiency" VALUE 0x001c0080 /* @ECU_Address@EGR_clr_eta_nom@0x010092A0@ */ ECIPP_ALIGNMENT_FLOAT32_IEEE 10000000000 Compu_EGR_clr_eta_nom -10000000000 10000000000 /end CHARACTERISTIC
/begin COMPU_METHOD Compu_EGR_clr_eta_nom " " RAT_FUNC "%.1" "%" COEFFS 0 0.01 0 0 0 1 /end COMPU_METHOD
/begin CHARACTERISTIC EGT_ena "EGT source{EGT_ena&0xff=0:Disabled}{EGT_ena&0xff=1:Aux PU1}{EGT_ena&0xff=2:Aux PU2}{EGT_ena&0xff=3:Aux PU3}{EGT_ena&0xff=4:Aux PUD1}{EGT_ena&0xff=5:Aux PUD2}{EGT_ena&0xff=6:Aux PUD3}{EGT_ena&0xff=7:EGT Input}{EGT_ena&0xff=8:Aux PUD4}{EGT_ena&0xff=9:Aux PU" VALUE 0x001c86df /* @ECU_Address@EGT_ena@0x010093A8@ */ ECIPP_ALIGNMENT_UBYTE 255 EGT_ena_COMPU_VTAB 0 255 BIT_MASK 0xff /end CHARACTERISTIC
/begin COMPU_METHOD EGT_ena_COMPU_VTAB "Verbal Table" TAB_VERB "%.0" "list" COMPU_TAB_REF EGT_ena_COMPU_VTAB_REF /end COMPU_METHOD
/begin COMPU_VTAB EGT_ena_COMPU_VTAB_REF "Verbal Table" TAB_VERB 31 0 "Disabled" 1 "Aux PU1" 2 "Aux PU2" 3 "Aux PU3" 4 "Aux PUD1" 5 "Aux PUD2" 6 "Aux PUD3" 7 "EGT Input" 8 "Aux PUD4" 9 "Aux PUD5" 10 "Aux PUD6" 11 "Aux PUD7" 12 "Aux PUD8" 13 "Aux PUD9" 14 "Aux PUD10" 15 "Aux PUD11" 16 "Aux PUD12" 17 "Aux PUD13" 18 "Aux PUD14" 19 "Aux PUD15" 20 "Aux PUD16" 21 "Aux PUD17" 22 "Aux PUD18" 23 "Aux PUD19" 24 "Aux PUD20" 25 "Aux PUD21" 26 "Aux PUD22" 27 "Aux PUD23" 28 "Aux PUD24" 29 "Aux PUD25" 30 "CAN sourced" DEFAULT_VALUE "UNKNOWN" /end COMPU_VTAB
/begin CHARACTERISTIC TOT_ena "Turbo Tout source{TOT_ena&0xff=0:Disabled}{TOT_ena&0xff=1:Aux PU1}{TOT_ena&0xff=2:Aux PU2}{TOT_ena&0xff=3:Aux PU3}{TOT_ena&0xff=4:Aux PUD1}{TOT_ena&0xff=5:Aux PUD2}{TOT_ena&0xff=6:Aux PUD3}{TOT_ena&0xff=7:EGT Input}{TOT_ena&0xff=8:Aux PUD4}{TOT_ena&0xff=9" VALUE 0x001c8f42 /* @ECU_Address@TOT_ena@0x010093D0@ */ ECIPP_ALIGNMENT_UBYTE 255 TOT_ena_COMPU_VTAB 0 255 BIT_MASK 0xff /end CHARACTERISTIC
/begin COMPU_METHOD TOT_ena_COMPU_VTAB "Verbal Table" TAB_VERB "%.0" "list" COMPU_TAB_REF TOT_ena_COMPU_VTAB_REF /end COMPU_METHOD
/begin COMPU_VTAB TOT_ena_COMPU_VTAB_REF "Verbal Table" TAB_VERB 31 0 "Disabled" 1 "Aux PU1" 2 "Aux PU2" 3 "Aux PU3" 4 "Aux PUD1" 5 "Aux PUD2" 6 "Aux PUD3" 7 "EGT Input" 8 "Aux PUD4" 9 "Aux PUD5" 10 "Aux PUD6" 11 "Aux PUD7" 12 "Aux PUD8" 13 "Aux PUD9" 14 "Aux PUD10" 15 "Aux PUD11" 16 "Aux PUD12" 17 "Aux PUD13" 18 "Aux PUD14" 19 "Aux PUD15" 20 "Aux PUD16" 21 "Aux PUD17" 22 "Aux PUD18" 23 "Aux PUD19" 24 "Aux PUD20" 25 "Aux PUD21" 26 "Aux PUD22" 27 "Aux PUD23" 28 "Aux PUD24" 29 "Aux PUD25" 30 "CAN sourced" DEFAULT_VALUE "UNKNOWN" /end COMPU_VTAB
/begin CHARACTERISTIC EGR_PWM_period "EGR PWM frequency" VALUE 0x001c026c /* @ECU_Address@EGR_PWM_period@0x01009428@ */ ECIPP_ALIGNMENT_ULONG 10000000000 Compu_EGR_PWM_period 0 10000000000 /end CHARACTERISTIC
/begin COMPU_METHOD Compu_EGR_PWM_period " " RAT_FUNC "%.0" "Hz" COEFFS 0 0 1 0 0.00000005 0 /end COMPU_METHOD
/begin CHARACTERISTIC EGR_vlv_tau "EGR PWM position feedback tau" VALUE 0x001c0a8a /* @ECU_Address@EGR_vlv_tau@0x01009E48@ */ ECIPP_ALIGNMENT_UWORD 327680 Compu_EGR_vlv_tau 0.45084 327680 /end CHARACTERISTIC
/begin COMPU_METHOD Compu_EGR_vlv_tau " " FORM "%.1" "ms"
 /begin FORMULA "-5 / log(1 - (X1 / 65536))" FORMULA_INV "(1 - exp(-5/X1)) * 65536" /end FORMULA
/end COMPU_METHOD
/begin CHARACTERISTIC EGR_Vrelay_nominal "EGR nominal operating voltage" VALUE 0x001c0984 /* @ECU_Address@EGR_Vrelay_nominal@0x0100A300@ */ ECIPP_ALIGNMENT_UWORD 256 Compu_EGR_Vrelay_nominal 0 255.99609375 /end CHARACTERISTIC
/begin COMPU_METHOD Compu_EGR_Vrelay_nominal " " RAT_FUNC "%.1" "volts" COEFFS 0 256 0 0 0 1 /end COMPU_METHOD
/begin CHARACTERISTIC CFV_Preg_HiExp "CFV HiExp (actual-commanded) pressure > (Fault Condition:or CFV (actual-commanded) pressure >)" VALUE 0x001c4448 /* @ECU_Address@CFV_Preg_HiExp@0x0100B158@ */ ECIPP_ALIGNMENT_SWORD 128 Compu_CFV_Preg_HiExp -128 127.99609375 /end CHARACTERISTIC
/begin COMPU_METHOD Compu_CFV_Preg_HiExp " " RAT_FUNC "%.2" "psi" COEFFS 0 256 0 0 0 1 /end COMPU_METHOD
/begin CHARACTERISTIC CFV_Preg_LoExp "CFV LoExp (actual-commanded) pressure < (Fault Condition:or CFV (actual-commanded) pressure <)" VALUE 0x001c444a /* @ECU_Address@CFV_Preg_LoExp@0x0100B160@ */ ECIPP_ALIGNMENT_SWORD 128 Compu_CFV_Preg_LoExp -128 127.99609375 /end CHARACTERISTIC
/begin COMPU_METHOD Compu_CFV_Preg_LoExp " " RAT_FUNC "%.2" "psi" COEFFS 0 256 0 0 0 1 /end COMPU_METHOD
/begin CHARACTERISTIC TC_comp_Pref "Compressor reference P" VALUE 0x001c8076 /* @ECU_Address@TC_comp_Pref@0x0100B940@ */ ECIPP_ALIGNMENT_UWORD 256 Compu_TC_comp_Pref 0 255.99609375 /end CHARACTERISTIC
/begin COMPU_METHOD Compu_TC_comp_Pref " " RAT_FUNC "%.2" "psia" COEFFS 0 256 0 0 0 1 /end COMPU_METHOD
/begin CHARACTERISTIC TC_comp_Tref "Compressor reference T" VALUE 0x001c807a /* @ECU_Address@TC_comp_Tref@0x0100B948@ */ ECIPP_ALIGNMENT_UWORD 564 Compu_TC_comp_Tref -460 563.984375 /end CHARACTERISTIC
/begin COMPU_METHOD Compu_TC_comp_Tref " " RAT_FUNC "%.1" "deg F" COEFFS 0 64 29440 0 0 1 /end COMPU_METHOD
/begin CHARACTERISTIC TC_turb_Nr_pct "Turbine reference speed" VALUE 0x001c808a /* @ECU_Address@TC_turb_Nr_pct@0x0100B950@ */ ECIPP_ALIGNMENT_UWORD 400 Compu_TC_turb_Nr_pct 0 399.993896484375 /end CHARACTERISTIC
/begin COMPU_METHOD Compu_TC_turb_Nr_pct " " RAT_FUNC "%.1" "% comp ref" COEFFS 0 163.84 0 0 0 1 /end COMPU_METHOD
/begin CHARACTERISTIC TC_turb_Pref "Turbine reference P" VALUE 0x001c808c /* @ECU_Address@TC_turb_Pref@0x0100B958@ */ ECIPP_ALIGNMENT_UWORD 256 Compu_TC_turb_Pref 0 255.99609375 /end CHARACTERISTIC
/begin COMPU_METHOD Compu_TC_turb_Pref " " RAT_FUNC "%.2" "psia" COEFFS 0 256 0 0 0 1 /end COMPU_METHOD
/begin CHARACTERISTIC TC_turb_Tref "Turbine reference T" VALUE 0x001c8090 /* @ECU_Address@TC_turb_Tref@0x0100B960@ */ ECIPP_ALIGNMENT_UWORD 564 Compu_TC_turb_Tref -460 563.984375 /end CHARACTERISTIC
/begin COMPU_METHOD Compu_TC_turb_Tref " " RAT_FUNC "%.1" "deg F" COEFFS 0 64 29440 0 0 1 /end COMPU_METHOD
/begin CHARACTERISTIC TC_turb_etamin "Turbine minimum efficiency" VALUE 0x001c8092 /* @ECU_Address@TC_turb_etamin@0x0100B968@ */ ECIPP_ALIGNMENT_UWORD 400 Compu_TC_turb_etamin 0 399.993896484375 /end CHARACTERISTIC
/begin COMPU_METHOD Compu_TC_turb_etamin " " RAT_FUNC "%.1" "%" COEFFS 0 163.84 0 0 0 1 /end COMPU_METHOD
/begin CHARACTERISTIC TC_turb_mdotr_pct "Turbine reference flow" VALUE 0x001c809c /* @ECU_Address@TC_turb_mdotr_pct@0x0100B970@ */ ECIPP_ALIGNMENT_UWORD 400 Compu_TC_turb_mdotr_pct 0 399.993896484375 /end CHARACTERISTIC
/begin COMPU_METHOD Compu_TC_turb_mdotr_pct " " RAT_FUNC "%.1" "% comp ref" COEFFS 0 163.84 0 0 0 1 /end COMPU_METHOD
/begin CHARACTERISTIC TC_turb_mdot0c_pct "Full-closed corrected flow" VALUE 0x001c809a /* @ECU_Address@TC_turb_mdot0c_pct@0x0100B978@ */ ECIPP_ALIGNMENT_UWORD 400 Compu_TC_turb_mdot0c_pct 0 399.993896484375 /end CHARACTERISTIC
/begin COMPU_METHOD Compu_TC_turb_mdot0c_pct " " RAT_FUNC "%.1" "% ref" COEFFS 0 163.84 0 0 0 1 /end COMPU_METHOD
/begin MEASUREMENT m_d_pct_reqnom "Diluent request (mass fraction)" UWORD Compu_m_d_pct_reqnom 0 0 0 399.993896484375 ECU_ADDRESS 0x0100BD28 /end MEASUREMENT
/begin COMPU_METHOD Compu_m_d_pct_reqnom " " RAT_FUNC "%.2" "%" COEFFS 0 163.84 0 0 0 1 /end COMPU_METHOD
/begin CHARACTERISTIC IMVD_Ifb_hi "IMV high-current short-circuit detection threshold (Fault Condition:IMV raw (uncompensated) current >)" VALUE 0x001ed014 /* @ECU_Address@IMVD_Ifb_hi@0x0100CEE8@ */ ECIPP_ALIGNMENT_SWORD 32 Compu_IMVD_Ifb_hi -32 31.9990234375 /end CHARACTERISTIC
/begin COMPU_METHOD Compu_IMVD_Ifb_hi " " RAT_FUNC "%.2" "amps" COEFFS 0 1024 0 0 0 1 /end COMPU_METHOD
/begin CHARACTERISTIC IMVD_Ifb_lo "IMV low-current open-circuit detection threshold (Fault Condition:IMV raw (uncompensated) current <)" VALUE 0x001ed016 /* @ECU_Address@IMVD_Ifb_lo@0x0100CEF0@ */ ECIPP_ALIGNMENT_SWORD 32 Compu_IMVD_Ifb_lo -32 31.9990234375 /end CHARACTERISTIC
/begin COMPU_METHOD Compu_IMVD_Ifb_lo " " RAT_FUNC "%.2" "amps" COEFFS 0 1024 0 0 0 1 /end COMPU_METHOD
/begin CHARACTERISTIC IMVD_lo_Icmd "IMV open-circuit detection minimum current command (Fault Condition:Proportional-IMV:  and commanded current >)" VALUE 0x001ed2ea /* @ECU_Address@IMVD_lo_Icmd@0x0100CEF8@ */ ECIPP_ALIGNMENT_UWORD 64 Compu_IMVD_lo_Icmd 0 63.9990234375 /end CHARACTERISTIC
/begin COMPU_METHOD Compu_IMVD_lo_Icmd " " RAT_FUNC "%.2" "amps" COEFFS 0 1024 0 0 0 1 /end COMPU_METHOD
/begin CHARACTERISTIC IMVD_lo_PWcmd "IMV open-circuit detection minimum pulse-width command (Fault Condition:Pulsed-IMV:  and total pulse-width >)" VALUE 0x001ed2ec /* @ECU_Address@IMVD_lo_PWcmd@0x0100CF00@ */ ECIPP_ALIGNMENT_UWORD 65535 Compu_IMVD_lo_PWcmd 0 65535 /end CHARACTERISTIC
/begin COMPU_METHOD Compu_IMVD_lo_PWcmd " " RAT_FUNC "%.0" "us" COEFFS 0 1 0 0 0 1 /end COMPU_METHOD
/begin CHARACTERISTIC INJD_Vboost_LOtol "CRI low boost voltage (target - actual) limit (Fault Condition:and minimum boost voltage (target - actual) <)" VALUE 0x001ed30e /* @ECU_Address@INJD_Vboost_LOtol@0x0100CF08@ */ ECIPP_ALIGNMENT_UWORD 1024 Compu_INJD_Vboost_LOtol 0 1023.984375 /end CHARACTERISTIC
/begin COMPU_METHOD Compu_INJD_Vboost_LOtol " " RAT_FUNC "%.1" "volts" COEFFS 0 64 0 0 0 1 /end COMPU_METHOD
/begin CHARACTERISTIC INJD_Vboost_HItol "CRI high boost voltage (actual - target) limit (Fault Condition:and maximum boost voltage (actual - target) <)" VALUE 0x001ed30c /* @ECU_Address@INJD_Vboost_HItol@0x0100CF10@ */ ECIPP_ALIGNMENT_UWORD 1024 Compu_INJD_Vboost_HItol 0 1023.984375 /end CHARACTERISTIC
/begin COMPU_METHOD Compu_INJD_Vboost_HItol " " RAT_FUNC "%.1" "volts" COEFFS 0 64 0 0 0 1 /end COMPU_METHOD
/begin CHARACTERISTIC INJD_max_riseT "CR injector open-circuit detection max rise-time to peak current (Fault Condition:CR Injector current rise-time to peak >)" VALUE 0x001ecff8 /* @ECU_Address@INJD_max_riseT@0x0100CF18@ */ ECIPP_ALIGNMENT_ULONG 214748365 Compu_INJD_max_riseT 0 214748364.75 /end CHARACTERISTIC
/begin COMPU_METHOD Compu_INJD_max_riseT " " RAT_FUNC "%.0" "us" COEFFS 0 20 0 0 0 1 /end COMPU_METHOD
/begin CHARACTERISTIC INJD_min_riseT "CR injector short-circuit detection min rise-time to peak current (Fault Condition:CR Injector current rise-time to peak <)" VALUE 0x001ecffc /* @ECU_Address@INJD_min_riseT@0x0100CF20@ */ ECIPP_ALIGNMENT_ULONG 214748365 Compu_INJD_min_riseT 0 214748364.75 /end CHARACTERISTIC
/begin COMPU_METHOD Compu_INJD_min_riseT " " RAT_FUNC "%.0" "us" COEFFS 0 20 0 0 0 1 /end COMPU_METHOD
/begin CHARACTERISTIC CRI_FPerr_high "CRI high fuel pressure diagnostic error tolerance (Fault Condition:or Common-Rail (actual - target) fuel pressure >)" VALUE 0x001ed2a6 /* @ECU_Address@CRI_FPerr_high@0x0100CF38@ */ ECIPP_ALIGNMENT_UWORD 8192 Compu_CRI_FPerr_high 0 8191.875 /end CHARACTERISTIC
/begin COMPU_METHOD Compu_CRI_FPerr_high " " RAT_FUNC "%.1" "bar" COEFFS 0 8 0 0 0 1 /end COMPU_METHOD
/begin CHARACTERISTIC CRI_FPerr_low "CRI low fuel pressure diagnostic error tolerance (Fault Condition:or Common-Rail (target - actual) fuel pressure >)" VALUE 0x001ed2a8 /* @ECU_Address@CRI_FPerr_low@0x0100CF40@ */ ECIPP_ALIGNMENT_UWORD 8192 Compu_CRI_FPerr_low 0 8191.875 /end CHARACTERISTIC
/begin COMPU_METHOD Compu_CRI_FPerr_low " " RAT_FUNC "%.1" "bar" COEFFS 0 8 0 0 0 1 /end COMPU_METHOD
/begin CHARACTERISTIC key_on_relay_force "Key-on sets RELAY on{key_on_relay_force&0xff=0:Disabled}{key_on_relay_force&0xff=1:Enabled}" VALUE 0x001c9068 /* @ECU_Address@key_on_relay_force@0x0100D798@ */ ECIPP_ALIGNMENT_UBYTE 255 key_on_relay_force_COMPU_VTAB 0 255 BIT_MASK 0xff /end CHARACTERISTIC
/begin COMPU_METHOD key_on_relay_force_COMPU_VTAB "Verbal Table" TAB_VERB "%.0" "list" COMPU_TAB_REF key_on_relay_force_COMPU_VTAB_REF /end COMPU_METHOD
/begin COMPU_VTAB key_on_relay_force_COMPU_VTAB_REF "Verbal Table" TAB_VERB 2 0 "Disabled" 1 "Enabled" DEFAULT_VALUE "UNKNOWN" /end COMPU_VTAB
/begin CHARACTERISTIC DATE_engine_defMfg "General # DATE_engine_defMfg" VALUE 0x001e1d54 /* @ECU_Address@DATE_engine_defMfg@0x0100D908@ */ ECIPP_ALIGNMENT_ULONG 4294967295 Compu_DATE_engine_defMfg 0 4294967295 /end CHARACTERISTIC
/begin COMPU_METHOD Compu_DATE_engine_defMfg " " RAT_FUNC "%.0" "date" COEFFS 0 1 0 0 0 1 /end COMPU_METHOD
/begin CHARACTERISTIC COT_ena "COT source{COT_ena&0xff=0:Disabled}{COT_ena&0xff=1:Aux PU1}{COT_ena&0xff=2:Aux PU2}{COT_ena&0xff=3:Aux PU3}{COT_ena&0xff=4:Aux PUD1}{COT_ena&0xff=5:Aux PUD2}{COT_ena&0xff=6:Aux PUD3}{COT_ena&0xff=7:EGT Input}{COT_ena&0xff=8:Aux PUD4}{COT_ena&0xff=9:Aux PU" VALUE 0x001c86ad /* @ECU_Address@COT_ena@0x0100EED8@ */ ECIPP_ALIGNMENT_UBYTE 255 COT_ena_COMPU_VTAB 0 255 BIT_MASK 0xff /end CHARACTERISTIC
/begin COMPU_METHOD COT_ena_COMPU_VTAB "Verbal Table" TAB_VERB "%.0" "list" COMPU_TAB_REF COT_ena_COMPU_VTAB_REF /end COMPU_METHOD
/begin COMPU_VTAB COT_ena_COMPU_VTAB_REF "Verbal Table" TAB_VERB 31 0 "Disabled" 1 "Aux PU1" 2 "Aux PU2" 3 "Aux PU3" 4 "Aux PUD1" 5 "Aux PUD2" 6 "Aux PUD3" 7 "EGT Input" 8 "Aux PUD4" 9 "Aux PUD5" 10 "Aux PUD6" 11 "Aux PUD7" 12 "Aux PUD8" 13 "Aux PUD9" 14 "Aux PUD10" 15 "Aux PUD11" 16 "Aux PUD12" 17 "Aux PUD13" 18 "Aux PUD14" 19 "Aux PUD15" 20 "Aux PUD16" 21 "Aux PUD17" 22 "Aux PUD18" 23 "Aux PUD19" 24 "Aux PUD20" 25 "Aux PUD21" 26 "Aux PUD22" 27 "Aux PUD23" 28 "Aux PUD24" 29 "Aux PUD25" 30 "CAN sourced" DEFAULT_VALUE "UNKNOWN" /end COMPU_VTAB
/begin CHARACTERISTIC CylTempSwt_chan "Cylinder temperature switch input{CylTempSwt_chan&0xff=0:Disabled}{CylTempSwt_chan&0xff=1:Aux PU1 = Gnd}{CylTempSwt_chan&0xff=2:Aux PU2 = Gnd}{CylTempSwt_chan&0xff=3:Aux PU3 = Gnd}{CylTempSwt_chan&0xff=4:Aux PUD1 = Gnd}{CylTempSwt_chan&0xff=5:Aux PUD2 = G" VALUE 0x001c86b6 /* @ECU_Address@CylTempSwt_chan@0x01010D68@ */ ECIPP_ALIGNMENT_UBYTE 255 CylTempSwt_chan_COMPU_VTAB 0 255 BIT_MASK 0xff /end CHARACTERISTIC
/begin COMPU_METHOD CylTempSwt_chan_COMPU_VTAB "Verbal Table" TAB_VERB "%.0" "list" COMPU_TAB_REF CylTempSwt_chan_COMPU_VTAB_REF /end COMPU_METHOD
/begin COMPU_VTAB CylTempSwt_chan_COMPU_VTAB_REF "Verbal Table" TAB_VERB 30 0 "Disabled" 1 "Aux PU1 = Gnd" 2 "Aux PU2 = Gnd" 3 "Aux PU3 = Gnd" 4 "Aux PUD1 = Gnd" 5 "Aux PUD2 = Gnd" 6 "Aux PUD3 = Gnd" 7 "Aux PUD4 = +V" 8 "Aux PUD5 = Gnd" 9 "Aux DIG1" 10 "Aux DIG2" 11 "Aux DIG3" 12 "Aux DIG4" 13 "Aux DIG5" 14 "Aux DIG6" 15 "Aux DIG7" 16 "Aux DIG8" 17 "Aux DIG9" 18 "Aux DIG10" 19 "Aux DIG11" 20 "Aux DIG12" 21 "Aux DIG13" 22 "Aux DIG14" 23 "Aux DIG15" 24 "Aux DIG16" 25 "Aux DIG17" 26 "Aux DIG18" 27 "Aux DIG19" 28 "Gov1" 29 "Gov2" DEFAULT_VALUE "UNKNOWN" /end COMPU_VTAB
/begin CHARACTERISTIC CylTempSwt_chan_cfg "Cylinder temperature switch Aux DIG config{CylTempSwt_chan_cfg&0xff=0:Default}{CylTempSwt_chan_cfg&0xff=1:GND}{CylTempSwt_chan_cfg&0xff=2:GND/+V}{CylTempSwt_chan_cfg&0xff=3:+V}{CylTempSwt_chan_cfg&0xff=4:Open}" VALUE 0x001c86b7 /* @ECU_Address@CylTempSwt_chan_cfg@0x01010D70@ */ ECIPP_ALIGNMENT_UBYTE 255 CylTempSwt_chan_cfg_COMPU_VTAB 0 255 BIT_MASK 0xff /end CHARACTERISTIC
/begin COMPU_METHOD CylTempSwt_chan_cfg_COMPU_VTAB "Verbal Table" TAB_VERB "%.0" "list" COMPU_TAB_REF CylTempSwt_chan_cfg_COMPU_VTAB_REF /end COMPU_METHOD
/begin COMPU_VTAB CylTempSwt_chan_cfg_COMPU_VTAB_REF "Verbal Table" TAB_VERB 5 0 "Default" 1 "GND" 2 "GND/+V" 3 "+V" 4 "Open" DEFAULT_VALUE "UNKNOWN" /end COMPU_VTAB
/begin CHARACTERISTIC VDS_enghrs_limit "VDS Time Limit" VALUE 0x001e2f04 /* @ECU_Address@VDS_enghrs_limit@0x01010EA8@ */ ECIPP_ALIGNMENT_ULONG 1193046 Compu_VDS_enghrs_limit 0 1193046.47083333 /end CHARACTERISTIC
/begin COMPU_METHOD Compu_VDS_enghrs_limit " " RAT_FUNC "%.3" "Hours" COEFFS 0 3600 0 0 0 1 /end COMPU_METHOD
/begin CHARACTERISTIC adapt_fuel_rpm_src "Adapt RPM source{adapt_fuel_rpm_src&0xff=0:Actual RPM}{adapt_fuel_rpm_src&0xff=1:Desired RPM}" VALUE 0x001e9be6 /* @ECU_Address@adapt_fuel_rpm_src@0x01011918@ */ ECIPP_ALIGNMENT_UBYTE 255 adapt_fuel_rpm_src_COMPU_VTAB 0 255 BIT_MASK 0xff /end CHARACTERISTIC
/begin COMPU_METHOD adapt_fuel_rpm_src_COMPU_VTAB "Verbal Table" TAB_VERB "%.0" "list" COMPU_TAB_REF adapt_fuel_rpm_src_COMPU_VTAB_REF /end COMPU_METHOD
/begin COMPU_VTAB adapt_fuel_rpm_src_COMPU_VTAB_REF "Verbal Table" TAB_VERB 2 0 "Actual RPM" 1 "Desired RPM" DEFAULT_VALUE "UNKNOWN" /end COMPU_VTAB
/begin CHARACTERISTIC adapt_fuel_rpm_dz "Adapt disable updates RPM deadzone" VALUE 0x001e58ce /* @ECU_Address@adapt_fuel_rpm_dz@0x01011920@ */ ECIPP_ALIGNMENT_UWORD 65535 Compu_adapt_fuel_rpm_dz 0 65535 /end CHARACTERISTIC
/begin COMPU_METHOD Compu_adapt_fuel_rpm_dz " " RAT_FUNC "%.0" "rpm" COEFFS 0 1 0 0 0 1 /end COMPU_METHOD
/begin CHARACTERISTIC HWARN_lamp "Hard warning lamp{HWARN_lamp&0xff=0:Disabled}{HWARN_lamp&0xff=1:Amber Warning Lamp}{HWARN_lamp&0xff=2:Red Stop Lamp}{HWARN_lamp&0xff=3:Protect Lamp}" VALUE 0x001c8762 /* @ECU_Address@HWARN_lamp@0x01011B68@ */ ECIPP_ALIGNMENT_UBYTE 255 HWARN_lamp_COMPU_VTAB 0 255 BIT_MASK 0xff /end CHARACTERISTIC
/begin COMPU_METHOD HWARN_lamp_COMPU_VTAB "Verbal Table" TAB_VERB "%.0" "list" COMPU_TAB_REF HWARN_lamp_COMPU_VTAB_REF /end COMPU_METHOD
/begin COMPU_VTAB HWARN_lamp_COMPU_VTAB_REF "Verbal Table" TAB_VERB 4 0 "Disabled" 1 "Amber Warning Lamp" 2 "Red Stop Lamp" 3 "Protect Lamp" DEFAULT_VALUE "UNKNOWN" /end COMPU_VTAB
/begin CHARACTERISTIC SWARN_lamp "Soft warning lamp{SWARN_lamp&0xff=0:Disabled}{SWARN_lamp&0xff=1:Amber Warning Lamp}{SWARN_lamp&0xff=2:Red Stop Lamp}{SWARN_lamp&0xff=3:Protect Lamp}" VALUE 0x001c8ef1 /* @ECU_Address@SWARN_lamp@0x01011B70@ */ ECIPP_ALIGNMENT_UBYTE 255 SWARN_lamp_COMPU_VTAB 0 255 BIT_MASK 0xff /end CHARACTERISTIC
/begin COMPU_METHOD SWARN_lamp_COMPU_VTAB "Verbal Table" TAB_VERB "%.0" "list" COMPU_TAB_REF SWARN_lamp_COMPU_VTAB_REF /end COMPU_METHOD
/begin COMPU_VTAB SWARN_lamp_COMPU_VTAB_REF "Verbal Table" TAB_VERB 4 0 "Disabled" 1 "Amber Warning Lamp" 2 "Red Stop Lamp" 3 "Protect Lamp" DEFAULT_VALUE "UNKNOWN" /end COMPU_VTAB
/begin CHARACTERISTIC DERATE_lamp "Derate lamp{DERATE_lamp&0xff=0:Disabled}{DERATE_lamp&0xff=1:Amber Warning Lamp}{DERATE_lamp&0xff=2:Red Stop Lamp}{DERATE_lamp&0xff=3:Protect Lamp}" VALUE 0x001c86bb /* @ECU_Address@DERATE_lamp@0x01011B80@ */ ECIPP_ALIGNMENT_UBYTE 255 DERATE_lamp_COMPU_VTAB 0 255 BIT_MASK 0xff /end CHARACTERISTIC
/begin COMPU_METHOD DERATE_lamp_COMPU_VTAB "Verbal Table" TAB_VERB "%.0" "list" COMPU_TAB_REF DERATE_lamp_COMPU_VTAB_REF /end COMPU_METHOD
/begin COMPU_VTAB DERATE_lamp_COMPU_VTAB_REF "Verbal Table" TAB_VERB 4 0 "Disabled" 1 "Amber Warning Lamp" 2 "Red Stop Lamp" 3 "Protect Lamp" DEFAULT_VALUE "UNKNOWN" /end COMPU_VTAB
/begin CHARACTERISTIC LOWREVLIM_lamp "Low rev limit lamp{LOWREVLIM_lamp&0xff=0:Disabled}{LOWREVLIM_lamp&0xff=1:Amber Warning Lamp}{LOWREVLIM_lamp&0xff=2:Red Stop Lamp}{LOWREVLIM_lamp&0xff=3:Protect Lamp}" VALUE 0x001c87d9 /* @ECU_Address@LOWREVLIM_lamp@0x01011B88@ */ ECIPP_ALIGNMENT_UBYTE 255 LOWREVLIM_lamp_COMPU_VTAB 0 255 BIT_MASK 0xff /end CHARACTERISTIC
/begin COMPU_METHOD LOWREVLIM_lamp_COMPU_VTAB "Verbal Table" TAB_VERB "%.0" "list" COMPU_TAB_REF LOWREVLIM_lamp_COMPU_VTAB_REF /end COMPU_METHOD
/begin COMPU_VTAB LOWREVLIM_lamp_COMPU_VTAB_REF "Verbal Table" TAB_VERB 4 0 "Disabled" 1 "Amber Warning Lamp" 2 "Red Stop Lamp" 3 "Protect Lamp" DEFAULT_VALUE "UNKNOWN" /end COMPU_VTAB
/begin CHARACTERISTIC SD_lamp "Shutdown active lamp{SD_lamp&0xff=0:Disabled}{SD_lamp&0xff=1:Amber Warning Lamp}{SD_lamp&0xff=2:Red Stop Lamp}{SD_lamp&0xff=3:Protect Lamp}" VALUE 0x001c88ff /* @ECU_Address@SD_lamp@0x01011B90@ */ ECIPP_ALIGNMENT_UBYTE 255 SD_lamp_COMPU_VTAB 0 255 BIT_MASK 0xff /end CHARACTERISTIC
/begin COMPU_METHOD SD_lamp_COMPU_VTAB "Verbal Table" TAB_VERB "%.0" "list" COMPU_TAB_REF SD_lamp_COMPU_VTAB_REF /end COMPU_METHOD
/begin COMPU_VTAB SD_lamp_COMPU_VTAB_REF "Verbal Table" TAB_VERB 4 0 "Disabled" 1 "Amber Warning Lamp" 2 "Red Stop Lamp" 3 "Protect Lamp" DEFAULT_VALUE "UNKNOWN" /end COMPU_VTAB
/begin CHARACTERISTIC DERATEblk_on "Derate blink on" VALUE 0x001c86bd /* @ECU_Address@DERATEblk_on@0x01011B98@ */ ECIPP_ALIGNMENT_UBYTE 12750 Compu_DERATEblk_on 0 12750 /end CHARACTERISTIC
/begin COMPU_METHOD Compu_DERATEblk_on " " RAT_FUNC "%.0" "On-Time (ms)" COEFFS 0 0.02 0 0 0 1 /end COMPU_METHOD
/begin CHARACTERISTIC LOWREVLIMblk_on "Low rev limit blink on" VALUE 0x001c87dc /* @ECU_Address@LOWREVLIMblk_on@0x01011BA0@ */ ECIPP_ALIGNMENT_UBYTE 12750 Compu_LOWREVLIMblk_on 0 12750 /end CHARACTERISTIC
/begin COMPU_METHOD Compu_LOWREVLIMblk_on " " RAT_FUNC "%.0" "On-Time (ms)" COEFFS 0 0.02 0 0 0 1 /end COMPU_METHOD
/begin CHARACTERISTIC SDblk_on "Shutdown active blink on" VALUE 0x001c8903 /* @ECU_Address@SDblk_on@0x01011BA8@ */ ECIPP_ALIGNMENT_UBYTE 12750 Compu_SDblk_on 0 12750 /end CHARACTERISTIC
/begin COMPU_METHOD Compu_SDblk_on " " RAT_FUNC "%.0" "On-Time (ms)" COEFFS 0 0.02 0 0 0 1 /end COMPU_METHOD
/begin CHARACTERISTIC DERATEblk_off "Shutdown active blink off" VALUE 0x001c86bc /* @ECU_Address@DERATEblk_off@0x01011BB0@ */ ECIPP_ALIGNMENT_UBYTE 12750 Compu_DERATEblk_off 0 12750 /end CHARACTERISTIC
/begin COMPU_METHOD Compu_DERATEblk_off " " RAT_FUNC "%.0" "Off-Time (ms)" COEFFS 0 0.02 0 0 0 1 /end COMPU_METHOD
/begin CHARACTERISTIC LOWREVLIMblk_off "Low rev limit blink off" VALUE 0x001c87db /* @ECU_Address@LOWREVLIMblk_off@0x01011BB8@ */ ECIPP_ALIGNMENT_UBYTE 12750 Compu_LOWREVLIMblk_off 0 12750 /end CHARACTERISTIC
/begin COMPU_METHOD Compu_LOWREVLIMblk_off " " RAT_FUNC "%.0" "Off-Time (ms)" COEFFS 0 0.02 0 0 0 1 /end COMPU_METHOD
/begin CHARACTERISTIC SDblk_off "Shutdown active blink off" VALUE 0x001c8902 /* @ECU_Address@SDblk_off@0x01011BC0@ */ ECIPP_ALIGNMENT_UBYTE 12750 Compu_SDblk_off 0 12750 /end CHARACTERISTIC
/begin COMPU_METHOD Compu_SDblk_off " " RAT_FUNC "%.0" "Off-Time (ms)" COEFFS 0 0.02 0 0 0 1 /end COMPU_METHOD
/begin CHARACTERISTIC MIL_DM1_output "DM1 MIL output configuration{MIL_DM1_output&0xff=0:Legacy}{MIL_DM1_output&0xff=1:Euro VI Discriminatory MIL}" VALUE 0x001c8830 /* @ECU_Address@MIL_DM1_output@0x01011BC8@ */ ECIPP_ALIGNMENT_UBYTE 255 MIL_DM1_output_COMPU_VTAB 0 255 BIT_MASK 0xff /end CHARACTERISTIC
/begin COMPU_METHOD MIL_DM1_output_COMPU_VTAB "Verbal Table" TAB_VERB "%.0" "list" COMPU_TAB_REF MIL_DM1_output_COMPU_VTAB_REF /end COMPU_METHOD
/begin COMPU_VTAB MIL_DM1_output_COMPU_VTAB_REF "Verbal Table" TAB_VERB 2 0 "Legacy" 1 "Euro VI Discriminatory MIL" DEFAULT_VALUE "UNKNOWN" /end COMPU_VTAB
/begin CHARACTERISTIC FSS_cust_tbl_def "General # FSS_cust_tbl_def" VAL_BLK 0x001C7B64 /* @ECU_Address@FSS_cust_tbl_def@0x021AF000@ */ ECIPP_ALIGNMENT_UWORD 65535 Compu_FSS_cust_tbl_def 0 65535 MATRIX_DIM 8 1 1 /end CHARACTERISTIC
/begin COMPU_METHOD Compu_FSS_cust_tbl_def " " RAT_FUNC "%.0" "-" COEFFS 0 1 0 0 0 1 /end COMPU_METHOD
/begin CHARACTERISTIC FDR_cust_tbl_def "General # FDR_cust_tbl_def" VAL_BLK 0x001C6F3E /* @ECU_Address@FDR_cust_tbl_def@0x021B0000@ */ ECIPP_ALIGNMENT_UWORD 65535 Compu_FDR_cust_tbl_def 0 65535 MATRIX_DIM 2 1 1 /end CHARACTERISTIC
/begin COMPU_METHOD Compu_FDR_cust_tbl_def " " RAT_FUNC "%.0" "-" COEFFS 0 1 0 0 0 1 /end COMPU_METHOD
/begin CHARACTERISTIC TMJ_KcompN_Kc "General # TMJ_KcompN_Kc" VAL_BLK 0x001E312E /* @ECU_Address@TMJ_KcompN_Kc@0x021CC000@ */ ECIPP_ALIGNMENT_SWORD 0 Compu_TMJ_KcompN_Kc -0.5 0.499984741210938 MATRIX_DIM 32 1 1 /end CHARACTERISTIC
/begin COMPU_METHOD Compu_TMJ_KcompN_Kc " " RAT_FUNC "%.0" "-" COEFFS 0 65536 0 0 0 1 /end COMPU_METHOD
/begin CHARACTERISTIC TMJ_KcompP_Kc "General # TMJ_KcompP_Kc" VAL_BLK 0x001E316E /* @ECU_Address@TMJ_KcompP_Kc@0x021CD000@ */ ECIPP_ALIGNMENT_SWORD 0 Compu_TMJ_KcompP_Kc -0.5 0.499984741210938 MATRIX_DIM 32 1 1 /end CHARACTERISTIC
/begin COMPU_METHOD Compu_TMJ_KcompP_Kc " " RAT_FUNC "%.0" "-" COEFFS 0 65536 0 0 0 1 /end COMPU_METHOD
/begin CHARACTERISTIC TMJ_Kcomp_PR "General # TMJ_Kcomp_PR" VAL_BLK 0x001E31AE /* @ECU_Address@TMJ_Kcomp_PR@0x021CE000@ */ ECIPP_ALIGNMENT_SWORD 0 Compu_TMJ_Kcomp_PR 0.75 0.999996185302734 MATRIX_DIM 32 1 1 /end CHARACTERISTIC
/begin COMPU_METHOD Compu_TMJ_Kcomp_PR " " RAT_FUNC "%.0" "-" COEFFS 0 262144 -229376 0 0 1 /end COMPU_METHOD
/begin CHARACTERISTIC TTM_PRKc_Kc "General # TTM_PRKc_Kc" VAL_BLK 0x001E356E /* @ECU_Address@TTM_PRKc_Kc@0x021D6000@ */ ECIPP_ALIGNMENT_SWORD 1 Compu_TTM_PRKc_Kc -1 0.999969482421875 MATRIX_DIM 16 1 1 /end CHARACTERISTIC
/begin COMPU_METHOD Compu_TTM_PRKc_Kc " " RAT_FUNC "%.0" "-" COEFFS 0 32768 0 0 0 1 /end COMPU_METHOD
/begin CHARACTERISTIC TTM_PRKc_PR "General # TTM_PRKc_PR" VAL_BLK 0x001E358E /* @ECU_Address@TTM_PRKc_PR@0x021D7000@ */ ECIPP_ALIGNMENT_SWORD 1 Compu_TTM_PRKc_PR -1 0.999969482421875 MATRIX_DIM 16 1 1 /end CHARACTERISTIC
/begin COMPU_METHOD Compu_TTM_PRKc_PR " " RAT_FUNC "%.0" "-" COEFFS 0 32768 0 0 0 1 /end COMPU_METHOD
/begin CHARACTERISTIC TVEmod_ECT_mul "General # TVEmod_ECT_mul" VAL_BLK 0x001E364E /* @ECU_Address@TVEmod_ECT_mul@0x021DB000@ */ ECIPP_ALIGNMENT_SWORD 2 Compu_TVEmod_ECT_mul -2 1.99993896484375 MATRIX_DIM 16 1 1 /end CHARACTERISTIC
/begin COMPU_METHOD Compu_TVEmod_ECT_mul " " RAT_FUNC "%.0" "-" COEFFS 0 16384 0 0 0 1 /end COMPU_METHOD
/begin CHARACTERISTIC TVEmod_MAT_mul "General # TVEmod_MAT_mul" VAL_BLK 0x001E368E /* @ECU_Address@TVEmod_MAT_mul@0x021DD000@ */ ECIPP_ALIGNMENT_SWORD 2 Compu_TVEmod_MAT_mul -2 1.99993896484375 MATRIX_DIM 16 1 1 /end CHARACTERISTIC
/begin COMPU_METHOD Compu_TVEmod_MAT_mul " " RAT_FUNC "%.0" "-" COEFFS 0 16384 0 0 0 1 /end COMPU_METHOD
/begin CHARACTERISTIC Tspkmx_ECT_CAD "General # Tspkmx_ECT_CAD" VAL_BLK 0x001C69B8 /* @ECU_Address@Tspkmx_ECT_CAD@0x021DE000@ */ ECIPP_ALIGNMENT_SWORD 2048 Compu_Tspkmx_ECT_CAD -2048 2047.9375 MATRIX_DIM 16 1 1 /end CHARACTERISTIC
/begin COMPU_METHOD Compu_Tspkmx_ECT_CAD " " RAT_FUNC "%.0" "CAD" COEFFS 0 16 0 0 0 1 /end COMPU_METHOD
/begin CHARACTERISTIC TFlt_xface_addr "FaultConfig # TFlt_xface_addr" VAL_BLK 0x001C9480 /* @ECU_Address@TFlt_xface_addr@0x0222F000@ */ ECIPP_ALIGNMENT_UBYTE 255 Compu_TFlt_xface_addr 0 255 MATRIX_DIM 6 1 1 /end CHARACTERISTIC
/begin COMPU_METHOD Compu_TFlt_xface_addr " " RAT_FUNC "%.0" "-" COEFFS 0 1 0 0 0 1 /end COMPU_METHOD
/begin CHARACTERISTIC TFlt_xface2_addr "FaultConfig # TFlt_xface2_addr" VAL_BLK 0x001C9818 /* @ECU_Address@TFlt_xface2_addr@0x02230000@ */ ECIPP_ALIGNMENT_UBYTE 255 Compu_TFlt_xface2_addr 0 255 MATRIX_DIM 6 1 1 /end CHARACTERISTIC
/begin COMPU_METHOD Compu_TFlt_xface2_addr " " RAT_FUNC "%.0" "-" COEFFS 0 1 0 0 0 1 /end COMPU_METHOD
/begin CHARACTERISTIC TFlt_xface3_addr "FaultConfig # TFlt_xface3_addr" VAL_BLK 0x001C9BB0 /* @ECU_Address@TFlt_xface3_addr@0x02231000@ */ ECIPP_ALIGNMENT_UBYTE 255 Compu_TFlt_xface3_addr 0 255 MATRIX_DIM 6 1 1 /end CHARACTERISTIC
/begin COMPU_METHOD Compu_TFlt_xface3_addr " " RAT_FUNC "%.0" "-" COEFFS 0 1 0 0 0 1 /end COMPU_METHOD
/begin COMPU_METHOD Compu_TCRI_ontime_mm3 " " RAT_FUNC "%.1" "Fuel Volume (mm3/stroke)" COEFFS 0 32 0 0 0 1 /end COMPU_METHOD
/begin COMPU_METHOD Compu_TCRI_ontime_prail " " RAT_FUNC "%.0" "Prail (bar)" COEFFS 0 8 0 0 0 1 /end COMPU_METHOD
/begin CHARACTERISTIC TCRI_ontime "Injector On-Time (us)" MAP 0x001C3E4C /* @ECU_Address@TCRI_ontime@0x02268000@ */ ECIPP_ALIGNMENT_SLONG 107374182 Compu_TCRI_ontime -107374182.4 107374182.35
 /begin AXIS_DESCR COM_AXIS NO_INPUT_QUANTITY Compu_TCRI_ontime_mm3 16 -1024 1023.96875 AXIS_PTS_REF TCRI_ontime_mm3 /end AXIS_DESCR
 /begin AXIS_DESCR COM_AXIS NO_INPUT_QUANTITY Compu_TCRI_ontime_prail 16 -4096 4095.875 AXIS_PTS_REF TCRI_ontime_prail /end AXIS_DESCR
/end CHARACTERISTIC
/begin AXIS_PTS TCRI_ontime_mm3 " " 0x001C468C /* @ECU_Address@TCRI_ontime_mm3@0x02266000@ */ NO_INPUT_QUANTITY ECIPP_Lookup_SWORD 0 Compu_TCRI_ontime_mm3 16 -1024 1023.96875 /end AXIS_PTS
/begin AXIS_PTS TCRI_ontime_prail " " 0x001C46AC /* @ECU_Address@TCRI_ontime_prail@0x02267000@ */ NO_INPUT_QUANTITY ECIPP_Lookup_SWORD 0 Compu_TCRI_ontime_prail 16 -4096 4095.875 /end AXIS_PTS
/begin COMPU_METHOD Compu_TCRI_ontime "" RAT_FUNC "%.0" "µs" COEFFS 0 20 0 0 0 1 /end COMPU_METHOD
/begin CHARACTERISTIC TCRI_rho_diesel "Fuel # TCRI_rho_diesel" VAL_BLK 0x001E302E /* @ECU_Address@TCRI_rho_diesel@0x02289000@ */ ECIPP_ALIGNMENT_SWORD 4 Compu_TCRI_rho_diesel -4 3.9998779296875 MATRIX_DIM 32 1 1 /end CHARACTERISTIC
/begin COMPU_METHOD Compu_TCRI_rho_diesel "" RAT_FUNC "%.0" "mg/mm3" COEFFS 0 8192 0 0 0 1 /end COMPU_METHOD
/begin COMPU_METHOD Compu_TCRI_QPT_xfpp " " RAT_FUNC "%.1" "Load Command (%)" COEFFS 0 327.68 0 0 0 1 /end COMPU_METHOD
/begin COMPU_METHOD Compu_TCRI_cld_yrpm " " RAT_FUNC "%.0" "Speed (rpm)" COEFFS 0 1 0 0 0 1 /end COMPU_METHOD
/begin COMPU_METHOD Compu_TCRI_QPT_yrpm " " RAT_FUNC "%.0" "Speed (rpm)" COEFFS 0 1 0 0 0 1 /end COMPU_METHOD
/begin COMPU_METHOD Compu_TCRI_QPT_xair " " RAT_FUNC "%.0" "Air Mass (mg/intake)" COEFFS 0 2 0 0 0 1 /end COMPU_METHOD
/begin CHARACTERISTIC TCRI_air_std "Air Mass - Standard (mg/intake)" MAP 0x001F1334 /* @ECU_Address@TCRI_air_std@0x022E3000@ */ ECIPP_ALIGNMENT_SWORD 8192 Compu_TCRI_air_std -8192 8191.75
 /begin AXIS_DESCR COM_AXIS NO_INPUT_QUANTITY Compu_TCRI_QPT_xload 16 -1024 1023.96875 AXIS_PTS_REF TCRI_QPT_xload /end AXIS_DESCR
 /begin AXIS_DESCR COM_AXIS NO_INPUT_QUANTITY Compu_TCRI_QPT_yrpm 16 -32768 32767 AXIS_PTS_REF TCRI_QPT_yrpm /end AXIS_DESCR
/end CHARACTERISTIC
/begin AXIS_PTS TCRI_QPT_xload " " 0x001ED266 /* @ECU_Address@TCRI_QPT_xload@0x022EC000@ */ NO_INPUT_QUANTITY ECIPP_Lookup_SWORD 0 Compu_TCRI_QPT_xload 16 -1024 1023.96875 /end AXIS_PTS
/begin AXIS_PTS TCRI_QPT_yrpm " " 0x001ED286 /* @ECU_Address@TCRI_QPT_yrpm@0x022E1000@ */ NO_INPUT_QUANTITY ECIPP_Lookup_SWORD 0 Compu_TCRI_QPT_yrpm 16 -32768 32767 /end AXIS_PTS
/begin COMPU_METHOD Compu_TCRI_air_std "" RAT_FUNC "%.0" "mg/intake" COEFFS 0 4 0 0 0 1 /end COMPU_METHOD
/begin CHARACTERISTIC TCRI_air_alt1 "Air Mass - Alternate (mg/intake)" MAP 0x001F1134 /* @ECU_Address@TCRI_air_alt1@0x022E4000@ */ ECIPP_ALIGNMENT_SWORD 8192 Compu_TCRI_air_alt1 -8192 8191.75
 /begin AXIS_DESCR COM_AXIS NO_INPUT_QUANTITY Compu_TCRI_QPT_xload 16 -1024 1023.96875 AXIS_PTS_REF TCRI_QPT_xload /end AXIS_DESCR
 /begin AXIS_DESCR COM_AXIS NO_INPUT_QUANTITY Compu_TCRI_QPT_yrpm 16 -32768 32767 AXIS_PTS_REF TCRI_QPT_yrpm /end AXIS_DESCR
/end CHARACTERISTIC
/begin COMPU_METHOD Compu_TCRI_air_alt1 "" RAT_FUNC "%.0" "mg/intake" COEFFS 0 4 0 0 0 1 /end COMPU_METHOD
/begin CHARACTERISTIC TCRI_P_cld "Fuel Pressure Base Offset (bar)" MAP 0x001EE7D4 /* @ECU_Address@TCRI_P_cld@0x022E5000@ */ ECIPP_ALIGNMENT_SWORD 4096 Compu_TCRI_P_cld -4096 4095.875
 /begin AXIS_DESCR COM_AXIS NO_INPUT_QUANTITY Compu_TCRI_cld_xload 8 -1024 1023.96875 AXIS_PTS_REF TCRI_cld_xload /end AXIS_DESCR
 /begin AXIS_DESCR COM_AXIS NO_INPUT_QUANTITY Compu_TCRI_cld_yrpm 8 -32768 32767 AXIS_PTS_REF TCRI_cld_yrpm /end AXIS_DESCR
/end CHARACTERISTIC
/begin AXIS_PTS TCRI_cld_xload " " 0x001F1574 /* @ECU_Address@TCRI_cld_xload@0x022EB000@ */ NO_INPUT_QUANTITY ECIPP_Lookup_SWORD 0 Compu_TCRI_cld_xload 8 -1024 1023.96875 /end AXIS_PTS
/begin AXIS_PTS TCRI_cld_yrpm " " 0x001F1584 /* @ECU_Address@TCRI_cld_yrpm@0x022E0000@ */ NO_INPUT_QUANTITY ECIPP_Lookup_SWORD 0 Compu_TCRI_cld_yrpm 8 -32768 32767 /end AXIS_PTS
/begin COMPU_METHOD Compu_TCRI_P_cld "" RAT_FUNC "%.0" "bar" COEFFS 0 8 0 0 0 1 /end COMPU_METHOD
/begin CHARACTERISTIC TCRI_P_std "Fuel Pressure - Standard (bar)" MAP 0x001ED066 /* @ECU_Address@TCRI_P_std@0x022E6000@ */ ECIPP_ALIGNMENT_SWORD 4096 Compu_TCRI_P_std -4096 4095.875
 /begin AXIS_DESCR COM_AXIS NO_INPUT_QUANTITY Compu_TCRI_QPT_xload 16 -1024 1023.96875 AXIS_PTS_REF TCRI_QPT_xload /end AXIS_DESCR
 /begin AXIS_DESCR COM_AXIS NO_INPUT_QUANTITY Compu_TCRI_QPT_yrpm 16 -32768 32767 AXIS_PTS_REF TCRI_QPT_yrpm /end AXIS_DESCR
/end CHARACTERISTIC
/begin COMPU_METHOD Compu_TCRI_P_std "" RAT_FUNC "%.0" "bar" COEFFS 0 8 0 0 0 1 /end COMPU_METHOD
/begin CHARACTERISTIC TCRI_P_alt1 "Fuel Pressure - Alternate (bar)" MAP 0x001EE5D4 /* @ECU_Address@TCRI_P_alt1@0x022E7000@ */ ECIPP_ALIGNMENT_SWORD 4096 Compu_TCRI_P_alt1 -4096 4095.875
 /begin AXIS_DESCR COM_AXIS NO_INPUT_QUANTITY Compu_TCRI_QPT_xload 16 -1024 1023.96875 AXIS_PTS_REF TCRI_QPT_xload /end AXIS_DESCR
 /begin AXIS_DESCR COM_AXIS NO_INPUT_QUANTITY Compu_TCRI_QPT_yrpm 16 -32768 32767 AXIS_PTS_REF TCRI_QPT_yrpm /end AXIS_DESCR
/end CHARACTERISTIC
/begin COMPU_METHOD Compu_TCRI_P_alt1 "" RAT_FUNC "%.0" "bar" COEFFS 0 8 0 0 0 1 /end COMPU_METHOD
/begin COMPU_METHOD Compu_TCRI_cld_xload " " RAT_FUNC "%.1" "Fuel Load (mg/cyl)" COEFFS 0 32 0 0 0 1 /end COMPU_METHOD
/begin COMPU_METHOD Compu_TCRI_QPT_xload " " RAT_FUNC "%.1" "Fuel Load (mg/cyl)" COEFFS 0 32 0 0 0 1 /end COMPU_METHOD
/begin CHARACTERISTIC TCRI_smk_limit "Fuel Smoke Limit (mg/cyl)" MAP 0x001F1594 /* @ECU_Address@TCRI_smk_limit@0x022ED000@ */ ECIPP_ALIGNMENT_SWORD 1024 Compu_TCRI_smk_limit -1024 1023.96875
 /begin AXIS_DESCR COM_AXIS NO_INPUT_QUANTITY Compu_TCRI_QPT_xair 16 -16384 16383.5 AXIS_PTS_REF TCRI_QPT_xair /end AXIS_DESCR
 /begin AXIS_DESCR COM_AXIS NO_INPUT_QUANTITY Compu_TCRI_QPT_yrpm 16 -32768 32767 AXIS_PTS_REF TCRI_QPT_yrpm /end AXIS_DESCR
/end CHARACTERISTIC
/begin AXIS_PTS TCRI_QPT_xair " " 0x001EE854 /* @ECU_Address@TCRI_QPT_xair@0x022E2000@ */ NO_INPUT_QUANTITY ECIPP_Lookup_SWORD 0 Compu_TCRI_QPT_xair 16 -16384 16383.5 /end AXIS_PTS
/begin COMPU_METHOD Compu_TCRI_smk_limit "" RAT_FUNC "%.1" "mg/cyl" COEFFS 0 32 0 0 0 1 /end COMPU_METHOD
/begin CHARACTERISTIC TCRI_Qpilot2_cld "Pilot 2 Quantity Base Offset" MAP 0x001EF634 /* @ECU_Address@TCRI_Qpilot2_cld@0x022EE000@ */ ECIPP_ALIGNMENT_SWORD 1024 Compu_TCRI_Qpilot2_cld -1024 1023.96875
 /begin AXIS_DESCR COM_AXIS NO_INPUT_QUANTITY Compu_TCRI_cld_xload 8 -1024 1023.96875 AXIS_PTS_REF TCRI_cld_xload /end AXIS_DESCR
 /begin AXIS_DESCR COM_AXIS NO_INPUT_QUANTITY Compu_TCRI_cld_yrpm 8 -32768 32767 AXIS_PTS_REF TCRI_cld_yrpm /end AXIS_DESCR
/end CHARACTERISTIC
/begin COMPU_METHOD Compu_TCRI_Qpilot2_cld "" RAT_FUNC "%.1" "mg/stroke" COEFFS 0 32 0 0 0 1 /end COMPU_METHOD
/begin CHARACTERISTIC TCRI_Qpilot2_std "Pilot 2 Quantity - Standard" MAP 0x001EF6B4 /* @ECU_Address@TCRI_Qpilot2_std@0x022EF000@ */ ECIPP_ALIGNMENT_SWORD 1024 Compu_TCRI_Qpilot2_std -1024 1023.96875
 /begin AXIS_DESCR COM_AXIS NO_INPUT_QUANTITY Compu_TCRI_QPT_xload 16 -1024 1023.96875 AXIS_PTS_REF TCRI_QPT_xload /end AXIS_DESCR
 /begin AXIS_DESCR COM_AXIS NO_INPUT_QUANTITY Compu_TCRI_QPT_yrpm 16 -32768 32767 AXIS_PTS_REF TCRI_QPT_yrpm /end AXIS_DESCR
/end CHARACTERISTIC
/begin COMPU_METHOD Compu_TCRI_Qpilot2_std "" RAT_FUNC "%.1" "mg/stroke" COEFFS 0 32 0 0 0 1 /end COMPU_METHOD
/begin CHARACTERISTIC TCRI_Qpilot2_alt1 "Pilot 2 Quantity - Alternate" MAP 0x001EF434 /* @ECU_Address@TCRI_Qpilot2_alt1@0x022F0000@ */ ECIPP_ALIGNMENT_SWORD 1024 Compu_TCRI_Qpilot2_alt1 -1024 1023.96875
 /begin AXIS_DESCR COM_AXIS NO_INPUT_QUANTITY Compu_TCRI_QPT_xload 16 -1024 1023.96875 AXIS_PTS_REF TCRI_QPT_xload /end AXIS_DESCR
 /begin AXIS_DESCR COM_AXIS NO_INPUT_QUANTITY Compu_TCRI_QPT_yrpm 16 -32768 32767 AXIS_PTS_REF TCRI_QPT_yrpm /end AXIS_DESCR
/end CHARACTERISTIC
/begin COMPU_METHOD Compu_TCRI_Qpilot2_alt1 "" RAT_FUNC "%.1" "mg/stroke" COEFFS 0 32 0 0 0 1 /end COMPU_METHOD
/begin CHARACTERISTIC TCRI_Qpilot1_cld "Pilot 1 Quantity Base Offset" MAP 0x001EF1B4 /* @ECU_Address@TCRI_Qpilot1_cld@0x022F1000@ */ ECIPP_ALIGNMENT_SWORD 1024 Compu_TCRI_Qpilot1_cld -1024 1023.96875
 /begin AXIS_DESCR COM_AXIS NO_INPUT_QUANTITY Compu_TCRI_cld_xload 8 -1024 1023.96875 AXIS_PTS_REF TCRI_cld_xload /end AXIS_DESCR
 /begin AXIS_DESCR COM_AXIS NO_INPUT_QUANTITY Compu_TCRI_cld_yrpm 8 -32768 32767 AXIS_PTS_REF TCRI_cld_yrpm /end AXIS_DESCR
/end CHARACTERISTIC
/begin COMPU_METHOD Compu_TCRI_Qpilot1_cld "" RAT_FUNC "%.1" "mg/stroke" COEFFS 0 32 0 0 0 1 /end COMPU_METHOD
/begin CHARACTERISTIC TCRI_Qpilot1_std "Pilot 1 Quantity - Standard" MAP 0x001EF234 /* @ECU_Address@TCRI_Qpilot1_std@0x022F2000@ */ ECIPP_ALIGNMENT_SWORD 1024 Compu_TCRI_Qpilot1_std -1024 1023.96875
 /begin AXIS_DESCR COM_AXIS NO_INPUT_QUANTITY Compu_TCRI_QPT_xload 16 -1024 1023.96875 AXIS_PTS_REF TCRI_QPT_xload /end AXIS_DESCR
 /begin AXIS_DESCR COM_AXIS NO_INPUT_QUANTITY Compu_TCRI_QPT_yrpm 16 -32768 32767 AXIS_PTS_REF TCRI_QPT_yrpm /end AXIS_DESCR
/end CHARACTERISTIC
/begin COMPU_METHOD Compu_TCRI_Qpilot1_std "" RAT_FUNC "%.1" "mg/stroke" COEFFS 0 32 0 0 0 1 /end COMPU_METHOD
/begin CHARACTERISTIC TCRI_Qpilot1_alt1 "Pilot 1 Quantity - Alternate" MAP 0x001EEFB4 /* @ECU_Address@TCRI_Qpilot1_alt1@0x022F3000@ */ ECIPP_ALIGNMENT_SWORD 1024 Compu_TCRI_Qpilot1_alt1 -1024 1023.96875
 /begin AXIS_DESCR COM_AXIS NO_INPUT_QUANTITY Compu_TCRI_QPT_xload 16 -1024 1023.96875 AXIS_PTS_REF TCRI_QPT_xload /end AXIS_DESCR
 /begin AXIS_DESCR COM_AXIS NO_INPUT_QUANTITY Compu_TCRI_QPT_yrpm 16 -32768 32767 AXIS_PTS_REF TCRI_QPT_yrpm /end AXIS_DESCR
/end CHARACTERISTIC
/begin COMPU_METHOD Compu_TCRI_Qpilot1_alt1 "" RAT_FUNC "%.1" "mg/stroke" COEFFS 0 32 0 0 0 1 /end COMPU_METHOD
/begin CHARACTERISTIC TCRI_Qmain_cld "Main Quantity Base Offset (mg/stroke)" MAP 0x001EEE94 /* @ECU_Address@TCRI_Qmain_cld@0x022F4000@ */ ECIPP_ALIGNMENT_SWORD 1024 Compu_TCRI_Qmain_cld -1024 1023.96875
 /begin AXIS_DESCR COM_AXIS NO_INPUT_QUANTITY Compu_TCRI_cld_xload 8 -1024 1023.96875 AXIS_PTS_REF TCRI_cld_xload /end AXIS_DESCR
 /begin AXIS_DESCR COM_AXIS NO_INPUT_QUANTITY Compu_TCRI_cld_yrpm 8 -32768 32767 AXIS_PTS_REF TCRI_cld_yrpm /end AXIS_DESCR
/end CHARACTERISTIC
/begin COMPU_METHOD Compu_TCRI_Qmain_cld "" RAT_FUNC "%.1" "mg/stroke" COEFFS 0 32 0 0 0 1 /end COMPU_METHOD
/begin CHARACTERISTIC TCRI_Qload_std "Fuel Load - Standard (mg/cyl)" MAP 0x001EEC94 /* @ECU_Address@TCRI_Qload_std@0x022F5000@ */ ECIPP_ALIGNMENT_SWORD 1024 Compu_TCRI_Qload_std -1024 1023.96875
 /begin AXIS_DESCR COM_AXIS NO_INPUT_QUANTITY Compu_TCRI_QPT_xfpp 16 -100 99.9969482421875 AXIS_PTS_REF TCRI_QPT_xfpp /end AXIS_DESCR
 /begin AXIS_DESCR COM_AXIS NO_INPUT_QUANTITY Compu_TCRI_QPT_yrpm 16 -32768 32767 AXIS_PTS_REF TCRI_QPT_yrpm /end AXIS_DESCR
/end CHARACTERISTIC
/begin AXIS_PTS TCRI_QPT_xfpp " " 0x001EE874 /* @ECU_Address@TCRI_QPT_xfpp@0x022DF000@ */ NO_INPUT_QUANTITY ECIPP_Lookup_SWORD 0 Compu_TCRI_QPT_xfpp 16 -100 99.9969482421875 /end AXIS_PTS
/begin COMPU_METHOD Compu_TCRI_Qload_std "" RAT_FUNC "%.1" "mg/cyl" COEFFS 0 32 0 0 0 1 /end COMPU_METHOD
/begin CHARACTERISTIC TCRI_Qload_alt1 "Fuel Load - Alternate 1 (mg/cyl)" MAP 0x001EE894 /* @ECU_Address@TCRI_Qload_alt1@0x022F6000@ */ ECIPP_ALIGNMENT_SWORD 1024 Compu_TCRI_Qload_alt1 -1024 1023.96875
 /begin AXIS_DESCR COM_AXIS NO_INPUT_QUANTITY Compu_TCRI_QPT_xfpp 16 -100 99.9969482421875 AXIS_PTS_REF TCRI_QPT_xfpp /end AXIS_DESCR
 /begin AXIS_DESCR COM_AXIS NO_INPUT_QUANTITY Compu_TCRI_QPT_yrpm 16 -32768 32767 AXIS_PTS_REF TCRI_QPT_yrpm /end AXIS_DESCR
/end CHARACTERISTIC
/begin COMPU_METHOD Compu_TCRI_Qload_alt1 "" RAT_FUNC "%.1" "mg/cyl" COEFFS 0 32 0 0 0 1 /end COMPU_METHOD
/begin CHARACTERISTIC TCRI_Qload_alt2 "Fuel Load - Alternate 2 (mg/cyl)" MAP 0x001EEA94 /* @ECU_Address@TCRI_Qload_alt2@0x022F7000@ */ ECIPP_ALIGNMENT_SWORD 1024 Compu_TCRI_Qload_alt2 -1024 1023.96875
 /begin AXIS_DESCR COM_AXIS NO_INPUT_QUANTITY Compu_TCRI_QPT_xfpp 16 -100 99.9969482421875 AXIS_PTS_REF TCRI_QPT_xfpp /end AXIS_DESCR
 /begin AXIS_DESCR COM_AXIS NO_INPUT_QUANTITY Compu_TCRI_QPT_yrpm 16 -32768 32767 AXIS_PTS_REF TCRI_QPT_yrpm /end AXIS_DESCR
/end CHARACTERISTIC
/begin COMPU_METHOD Compu_TCRI_Qload_alt2 "" RAT_FUNC "%.1" "mg/cyl" COEFFS 0 32 0 0 0 1 /end COMPU_METHOD
/begin CHARACTERISTIC TCRI_Qpost1_std "Post 1 Quantity - Standard (mg/stroke)" MAP 0x001EFB34 /* @ECU_Address@TCRI_Qpost1_std@0x022F9000@ */ ECIPP_ALIGNMENT_SWORD 1024 Compu_TCRI_Qpost1_std -1024 1023.96875
 /begin AXIS_DESCR COM_AXIS NO_INPUT_QUANTITY Compu_TCRI_QPT_xload 16 -1024 1023.96875 AXIS_PTS_REF TCRI_QPT_xload /end AXIS_DESCR
 /begin AXIS_DESCR COM_AXIS NO_INPUT_QUANTITY Compu_TCRI_QPT_yrpm 16 -32768 32767 AXIS_PTS_REF TCRI_QPT_yrpm /end AXIS_DESCR
/end CHARACTERISTIC
/begin COMPU_METHOD Compu_TCRI_Qpost1_std "" RAT_FUNC "%.1" "mg/stroke" COEFFS 0 32 0 0 0 1 /end COMPU_METHOD
/begin CHARACTERISTIC TCRI_Qpost1_alt1 "Post 1 Quantity - Alternate (mg/stroke)" MAP 0x001EF8B4 /* @ECU_Address@TCRI_Qpost1_alt1@0x022FA000@ */ ECIPP_ALIGNMENT_SWORD 1024 Compu_TCRI_Qpost1_alt1 -1024 1023.96875
 /begin AXIS_DESCR COM_AXIS NO_INPUT_QUANTITY Compu_TCRI_QPT_xload 16 -1024 1023.96875 AXIS_PTS_REF TCRI_QPT_xload /end AXIS_DESCR
 /begin AXIS_DESCR COM_AXIS NO_INPUT_QUANTITY Compu_TCRI_QPT_yrpm 16 -32768 32767 AXIS_PTS_REF TCRI_QPT_yrpm /end AXIS_DESCR
/end CHARACTERISTIC
/begin COMPU_METHOD Compu_TCRI_Qpost1_alt1 "" RAT_FUNC "%.1" "mg/stroke" COEFFS 0 32 0 0 0 1 /end COMPU_METHOD
/begin CHARACTERISTIC TCRI_Qpost2_std "Post 2 Quantity - Standard (mg/stroke)" MAP 0x001EFFB4 /* @ECU_Address@TCRI_Qpost2_std@0x022FC000@ */ ECIPP_ALIGNMENT_SWORD 1024 Compu_TCRI_Qpost2_std -1024 1023.96875
 /begin AXIS_DESCR COM_AXIS NO_INPUT_QUANTITY Compu_TCRI_QPT_xload 16 -1024 1023.96875 AXIS_PTS_REF TCRI_QPT_xload /end AXIS_DESCR
 /begin AXIS_DESCR COM_AXIS NO_INPUT_QUANTITY Compu_TCRI_QPT_yrpm 16 -32768 32767 AXIS_PTS_REF TCRI_QPT_yrpm /end AXIS_DESCR
/end CHARACTERISTIC
/begin COMPU_METHOD Compu_TCRI_Qpost2_std "" RAT_FUNC "%.1" "mg/stroke" COEFFS 0 32 0 0 0 1 /end COMPU_METHOD
/begin CHARACTERISTIC TCRI_Qpost2_alt1 "Post 2 Quantity - Alternate (mg/stroke)" MAP 0x001EFD34 /* @ECU_Address@TCRI_Qpost2_alt1@0x022FD000@ */ ECIPP_ALIGNMENT_SWORD 1024 Compu_TCRI_Qpost2_alt1 -1024 1023.96875
 /begin AXIS_DESCR COM_AXIS NO_INPUT_QUANTITY Compu_TCRI_QPT_xload 16 -1024 1023.96875 AXIS_PTS_REF TCRI_QPT_xload /end AXIS_DESCR
 /begin AXIS_DESCR COM_AXIS NO_INPUT_QUANTITY Compu_TCRI_QPT_yrpm 16 -32768 32767 AXIS_PTS_REF TCRI_QPT_yrpm /end AXIS_DESCR
/end CHARACTERISTIC
/begin COMPU_METHOD Compu_TCRI_Qpost2_alt1 "" RAT_FUNC "%.1" "mg/stroke" COEFFS 0 32 0 0 0 1 /end COMPU_METHOD
/begin CHARACTERISTIC TCRI_Tpilot2_cld "Pilot 2 Timing Base Offset (CAD)" MAP 0x001EE034 /* @ECU_Address@TCRI_Tpilot2_cld@0x022FE000@ */ ECIPP_ALIGNMENT_SLONG 134217728 Compu_TCRI_Tpilot2_cld -134217728 134217727.9375
 /begin AXIS_DESCR COM_AXIS NO_INPUT_QUANTITY Compu_TCRI_cld_xload 8 -1024 1023.96875 AXIS_PTS_REF TCRI_cld_xload /end AXIS_DESCR
 /begin AXIS_DESCR COM_AXIS NO_INPUT_QUANTITY Compu_TCRI_cld_yrpm 8 -32768 32767 AXIS_PTS_REF TCRI_cld_yrpm /end AXIS_DESCR
/end CHARACTERISTIC
/begin COMPU_METHOD Compu_TCRI_Tpilot2_cld "" RAT_FUNC "%.1" "CAD" COEFFS 0 16 0 0 0 1 /end COMPU_METHOD
/begin CHARACTERISTIC TCRI_Tpilot2_std "Pilot 2 Timing - Standard (CAD BTDCC)" MAP 0x001EE134 /* @ECU_Address@TCRI_Tpilot2_std@0x022FF000@ */ ECIPP_ALIGNMENT_SLONG 134217728 Compu_TCRI_Tpilot2_std -134217728 134217727.9375
 /begin AXIS_DESCR COM_AXIS NO_INPUT_QUANTITY Compu_TCRI_QPT_xload 16 -1024 1023.96875 AXIS_PTS_REF TCRI_QPT_xload /end AXIS_DESCR
 /begin AXIS_DESCR COM_AXIS NO_INPUT_QUANTITY Compu_TCRI_QPT_yrpm 16 -32768 32767 AXIS_PTS_REF TCRI_QPT_yrpm /end AXIS_DESCR
/end CHARACTERISTIC
/begin COMPU_METHOD Compu_TCRI_Tpilot2_std "" RAT_FUNC "%.1" "CAD/BTDCC - or - µs before main" COEFFS 0 16 0 0 0 1 /end COMPU_METHOD
/begin CHARACTERISTIC TCRI_Tpilot2_alt1 "Pilot 2 Timing - Alternate (CAD BTDCC)" MAP 0x001EDC34 /* @ECU_Address@TCRI_Tpilot2_alt1@0x02300000@ */ ECIPP_ALIGNMENT_SLONG 134217728 Compu_TCRI_Tpilot2_alt1 -134217728 134217727.9375
 /begin AXIS_DESCR COM_AXIS NO_INPUT_QUANTITY Compu_TCRI_QPT_xload 16 -1024 1023.96875 AXIS_PTS_REF TCRI_QPT_xload /end AXIS_DESCR
 /begin AXIS_DESCR COM_AXIS NO_INPUT_QUANTITY Compu_TCRI_QPT_yrpm 16 -32768 32767 AXIS_PTS_REF TCRI_QPT_yrpm /end AXIS_DESCR
/end CHARACTERISTIC
/begin COMPU_METHOD Compu_TCRI_Tpilot2_alt1 "" RAT_FUNC "%.1" "CAD/BTDCC" COEFFS 0 16 0 0 0 1 /end COMPU_METHOD
/begin CHARACTERISTIC TCRI_Tpilot1_std "Pilot 1 Timing - Standard (CAD BTDCC)" MAP 0x001ED834 /* @ECU_Address@TCRI_Tpilot1_std@0x02302000@ */ ECIPP_ALIGNMENT_SLONG 134217728 Compu_TCRI_Tpilot1_std -134217728 134217727.9375
 /begin AXIS_DESCR COM_AXIS NO_INPUT_QUANTITY Compu_TCRI_QPT_xload 16 -1024 1023.96875 AXIS_PTS_REF TCRI_QPT_xload /end AXIS_DESCR
 /begin AXIS_DESCR COM_AXIS NO_INPUT_QUANTITY Compu_TCRI_QPT_yrpm 16 -32768 32767 AXIS_PTS_REF TCRI_QPT_yrpm /end AXIS_DESCR
/end CHARACTERISTIC
/begin COMPU_METHOD Compu_TCRI_Tpilot1_std "" RAT_FUNC "%.1" "CAD/BTDCC - or - µs before main" COEFFS 0 16 0 0 0 1 /end COMPU_METHOD
/begin CHARACTERISTIC TCRI_Tpilot1_alt1 "Pilot 1 Timing - Alternate (CAD BTDCC)" MAP 0x001ED334 /* @ECU_Address@TCRI_Tpilot1_alt1@0x02303000@ */ ECIPP_ALIGNMENT_SLONG 134217728 Compu_TCRI_Tpilot1_alt1 -134217728 134217727.9375
 /begin AXIS_DESCR COM_AXIS NO_INPUT_QUANTITY Compu_TCRI_QPT_xload 16 -1024 1023.96875 AXIS_PTS_REF TCRI_QPT_xload /end AXIS_DESCR
 /begin AXIS_DESCR COM_AXIS NO_INPUT_QUANTITY Compu_TCRI_QPT_yrpm 16 -32768 32767 AXIS_PTS_REF TCRI_QPT_yrpm /end AXIS_DESCR
/end CHARACTERISTIC
/begin COMPU_METHOD Compu_TCRI_Tpilot1_alt1 "" RAT_FUNC "%.1" "CAD/BTDCC" COEFFS 0 16 0 0 0 1 /end COMPU_METHOD
/begin CHARACTERISTIC TCRI_Tmain_cld "Main Timing Base Offset (CAD)" MAP 0x001F05B4 /* @ECU_Address@TCRI_Tmain_cld@0x02304000@ */ ECIPP_ALIGNMENT_SWORD 2048 Compu_TCRI_Tmain_cld -2048 2047.9375
 /begin AXIS_DESCR COM_AXIS NO_INPUT_QUANTITY Compu_TCRI_cld_xload 8 -1024 1023.96875 AXIS_PTS_REF TCRI_cld_xload /end AXIS_DESCR
 /begin AXIS_DESCR COM_AXIS NO_INPUT_QUANTITY Compu_TCRI_cld_yrpm 8 -32768 32767 AXIS_PTS_REF TCRI_cld_yrpm /end AXIS_DESCR
/end CHARACTERISTIC
/begin COMPU_METHOD Compu_TCRI_Tmain_cld "" RAT_FUNC "%.1" "CAD" COEFFS 0 16 0 0 0 1 /end COMPU_METHOD
/begin CHARACTERISTIC TCRI_Tmain_std "Main Timing - Standard (CAD BTDCC)" MAP 0x001F0634 /* @ECU_Address@TCRI_Tmain_std@0x02305000@ */ ECIPP_ALIGNMENT_SWORD 2048 Compu_TCRI_Tmain_std -2048 2047.9375
 /begin AXIS_DESCR COM_AXIS NO_INPUT_QUANTITY Compu_TCRI_QPT_xload 16 -1024 1023.96875 AXIS_PTS_REF TCRI_QPT_xload /end AXIS_DESCR
 /begin AXIS_DESCR COM_AXIS NO_INPUT_QUANTITY Compu_TCRI_QPT_yrpm 16 -32768 32767 AXIS_PTS_REF TCRI_QPT_yrpm /end AXIS_DESCR
/end CHARACTERISTIC
/begin COMPU_METHOD Compu_TCRI_Tmain_std "" RAT_FUNC "%.1" "CAD BTDCC" COEFFS 0 16 0 0 0 1 /end COMPU_METHOD
/begin CHARACTERISTIC TCRI_Tmain_alt1 "Main Timing - Alternate 1 (CAD BTDCC)" MAP 0x001F01B4 /* @ECU_Address@TCRI_Tmain_alt1@0x02306000@ */ ECIPP_ALIGNMENT_SWORD 2048 Compu_TCRI_Tmain_alt1 -2048 2047.9375
 /begin AXIS_DESCR COM_AXIS NO_INPUT_QUANTITY Compu_TCRI_QPT_xload 16 -1024 1023.96875 AXIS_PTS_REF TCRI_QPT_xload /end AXIS_DESCR
 /begin AXIS_DESCR COM_AXIS NO_INPUT_QUANTITY Compu_TCRI_QPT_yrpm 16 -32768 32767 AXIS_PTS_REF TCRI_QPT_yrpm /end AXIS_DESCR
/end CHARACTERISTIC
/begin COMPU_METHOD Compu_TCRI_Tmain_alt1 "" RAT_FUNC "%.1" "CAD BTDCC" COEFFS 0 16 0 0 0 1 /end COMPU_METHOD
/begin CHARACTERISTIC TCRI_Tmain_alt2 "Main Timing - Alternate 2 (CAD BTDCC)" MAP 0x001F03B4 /* @ECU_Address@TCRI_Tmain_alt2@0x02307000@ */ ECIPP_ALIGNMENT_SWORD 2048 Compu_TCRI_Tmain_alt2 -2048 2047.9375
 /begin AXIS_DESCR COM_AXIS NO_INPUT_QUANTITY Compu_TCRI_QPT_xload 16 -1024 1023.96875 AXIS_PTS_REF TCRI_QPT_xload /end AXIS_DESCR
 /begin AXIS_DESCR COM_AXIS NO_INPUT_QUANTITY Compu_TCRI_QPT_yrpm 16 -32768 32767 AXIS_PTS_REF TCRI_QPT_yrpm /end AXIS_DESCR
/end CHARACTERISTIC
/begin COMPU_METHOD Compu_TCRI_Tmain_alt2 "" RAT_FUNC "%.1" "CAD BTDCC" COEFFS 0 16 0 0 0 1 /end COMPU_METHOD
/begin CHARACTERISTIC TCRI_Tpost1_cld "Post 1 Timing Base Offset (CAD)" MAP 0x001F0A34 /* @ECU_Address@TCRI_Tpost1_cld@0x02308000@ */ ECIPP_ALIGNMENT_SWORD 2048 Compu_TCRI_Tpost1_cld -2048 2047.9375
 /begin AXIS_DESCR COM_AXIS NO_INPUT_QUANTITY Compu_TCRI_cld_xload 8 -1024 1023.96875 AXIS_PTS_REF TCRI_cld_xload /end AXIS_DESCR
 /begin AXIS_DESCR COM_AXIS NO_INPUT_QUANTITY Compu_TCRI_cld_yrpm 8 -32768 32767 AXIS_PTS_REF TCRI_cld_yrpm /end AXIS_DESCR
/end CHARACTERISTIC
/begin COMPU_METHOD Compu_TCRI_Tpost1_cld "" RAT_FUNC "%.1" "CAD" COEFFS 0 16 0 0 0 1 /end COMPU_METHOD
/begin CHARACTERISTIC TCRI_Tpost1_std "Post 1 Timing - Standard (CAD BTDCC)" MAP 0x001F0AB4 /* @ECU_Address@TCRI_Tpost1_std@0x02309000@ */ ECIPP_ALIGNMENT_SWORD 2048 Compu_TCRI_Tpost1_std -2048 2047.9375
 /begin AXIS_DESCR COM_AXIS NO_INPUT_QUANTITY Compu_TCRI_QPT_xload 16 -1024 1023.96875 AXIS_PTS_REF TCRI_QPT_xload /end AXIS_DESCR
 /begin AXIS_DESCR COM_AXIS NO_INPUT_QUANTITY Compu_TCRI_QPT_yrpm 16 -32768 32767 AXIS_PTS_REF TCRI_QPT_yrpm /end AXIS_DESCR
/end CHARACTERISTIC
/begin COMPU_METHOD Compu_TCRI_Tpost1_std "" RAT_FUNC "%.1" "CAD/BTDCC" COEFFS 0 16 0 0 0 1 /end COMPU_METHOD
/begin CHARACTERISTIC TCRI_Tpost1_alt1 "Post 1 Timing - Alternate (CAD BTDCC)" MAP 0x001F0834 /* @ECU_Address@TCRI_Tpost1_alt1@0x0230A000@ */ ECIPP_ALIGNMENT_SWORD 2048 Compu_TCRI_Tpost1_alt1 -2048 2047.9375
 /begin AXIS_DESCR COM_AXIS NO_INPUT_QUANTITY Compu_TCRI_QPT_xload 16 -1024 1023.96875 AXIS_PTS_REF TCRI_QPT_xload /end AXIS_DESCR
 /begin AXIS_DESCR COM_AXIS NO_INPUT_QUANTITY Compu_TCRI_QPT_yrpm 16 -32768 32767 AXIS_PTS_REF TCRI_QPT_yrpm /end AXIS_DESCR
/end CHARACTERISTIC
/begin COMPU_METHOD Compu_TCRI_Tpost1_alt1 "" RAT_FUNC "%.1" "CAD/BTDCC" COEFFS 0 16 0 0 0 1 /end COMPU_METHOD
/begin CHARACTERISTIC TCRI_Tpost2_cld "Post 2 Timing Base Offset (CAD)" MAP 0x001F0EB4 /* @ECU_Address@TCRI_Tpost2_cld@0x0230B000@ */ ECIPP_ALIGNMENT_SWORD 2048 Compu_TCRI_Tpost2_cld -2048 2047.9375
 /begin AXIS_DESCR COM_AXIS NO_INPUT_QUANTITY Compu_TCRI_cld_xload 8 -1024 1023.96875 AXIS_PTS_REF TCRI_cld_xload /end AXIS_DESCR
 /begin AXIS_DESCR COM_AXIS NO_INPUT_QUANTITY Compu_TCRI_cld_yrpm 8 -32768 32767 AXIS_PTS_REF TCRI_cld_yrpm /end AXIS_DESCR
/end CHARACTERISTIC
/begin COMPU_METHOD Compu_TCRI_Tpost2_cld "" RAT_FUNC "%.1" "CAD" COEFFS 0 16 0 0 0 1 /end COMPU_METHOD
/begin CHARACTERISTIC TCRI_Tpost2_std "Post 2 Timing - Standard (CAD BTDCC)" MAP 0x001F0F34 /* @ECU_Address@TCRI_Tpost2_std@0x0230C000@ */ ECIPP_ALIGNMENT_SWORD 2048 Compu_TCRI_Tpost2_std -2048 2047.9375
 /begin AXIS_DESCR COM_AXIS NO_INPUT_QUANTITY Compu_TCRI_QPT_xload 16 -1024 1023.96875 AXIS_PTS_REF TCRI_QPT_xload /end AXIS_DESCR
 /begin AXIS_DESCR COM_AXIS NO_INPUT_QUANTITY Compu_TCRI_QPT_yrpm 16 -32768 32767 AXIS_PTS_REF TCRI_QPT_yrpm /end AXIS_DESCR
/end CHARACTERISTIC
/begin COMPU_METHOD Compu_TCRI_Tpost2_std "" RAT_FUNC "%.1" "CAD/BTDCC" COEFFS 0 16 0 0 0 1 /end COMPU_METHOD
/begin CHARACTERISTIC TCRI_Tpost2_alt1 "Post 2 Timing - Alternate (CAD BTDCC)" MAP 0x001F0CB4 /* @ECU_Address@TCRI_Tpost2_alt1@0x0230D000@ */ ECIPP_ALIGNMENT_SWORD 2048 Compu_TCRI_Tpost2_alt1 -2048 2047.9375
 /begin AXIS_DESCR COM_AXIS NO_INPUT_QUANTITY Compu_TCRI_QPT_xload 16 -1024 1023.96875 AXIS_PTS_REF TCRI_QPT_xload /end AXIS_DESCR
 /begin AXIS_DESCR COM_AXIS NO_INPUT_QUANTITY Compu_TCRI_QPT_yrpm 16 -32768 32767 AXIS_PTS_REF TCRI_QPT_yrpm /end AXIS_DESCR
/end CHARACTERISTIC
/begin COMPU_METHOD Compu_TCRI_Tpost2_alt1 "" RAT_FUNC "%.1" "CAD/BTDCC" COEFFS 0 16 0 0 0 1 /end COMPU_METHOD
/begin COMPU_METHOD Compu_TCRI_Qmin_xPrail " " RAT_FUNC "%.0" "Rail Pressure (bar)" COEFFS 0 8 0 0 0 1 /end COMPU_METHOD
/begin COMPU_METHOD Compu_TCRI_Qmin_yrpm " " RAT_FUNC "%.0" "Speed (rpm)" COEFFS 0 1 0 0 0 1 /end COMPU_METHOD
/begin CHARACTERISTIC TCRI_Qmin "Minimum Injection Quantity (mg/stroke)" MAP 0x001EEF14 /* @ECU_Address@TCRI_Qmin@0x02316000@ */ ECIPP_ALIGNMENT_SWORD 256 Compu_TCRI_Qmin -256 255.9921875
 /begin AXIS_DESCR COM_AXIS NO_INPUT_QUANTITY Compu_TCRI_Qmin_xPrail 8 -4096 4095.875 AXIS_PTS_REF TCRI_Qmin_xPrail /end AXIS_DESCR
 /begin AXIS_DESCR COM_AXIS NO_INPUT_QUANTITY Compu_TCRI_Qmin_yrpm 8 -32768 32767 AXIS_PTS_REF TCRI_Qmin_yrpm /end AXIS_DESCR
/end CHARACTERISTIC
/begin AXIS_PTS TCRI_Qmin_xPrail " " 0x001EEF94 /* @ECU_Address@TCRI_Qmin_xPrail@0x02314000@ */ NO_INPUT_QUANTITY ECIPP_Lookup_SWORD 0 Compu_TCRI_Qmin_xPrail 8 -4096 4095.875 /end AXIS_PTS
/begin AXIS_PTS TCRI_Qmin_yrpm " " 0x001EEFA4 /* @ECU_Address@TCRI_Qmin_yrpm@0x02315000@ */ NO_INPUT_QUANTITY ECIPP_Lookup_SWORD 0 Compu_TCRI_Qmin_yrpm 8 -32768 32767 /end AXIS_PTS
/begin COMPU_METHOD Compu_TCRI_Qmin "" RAT_FUNC "%.2" "mg/stroke" COEFFS 0 128 0 0 0 1 /end COMPU_METHOD
/begin CHARACTERISTIC TCRI_pulseoff_std "Forced Injection Disable - Standard" MAP 0x001F1B81 /* @ECU_Address@TCRI_pulseoff_std@0x0231B000@ */ ECIPP_ALIGNMENT_UBYTE 255 Compu_TCRI_pulseoff_std 0 255
 /begin AXIS_DESCR COM_AXIS NO_INPUT_QUANTITY Compu_TCRI_QPT_xload 16 -1024 1023.96875 AXIS_PTS_REF TCRI_QPT_xload /end AXIS_DESCR
 /begin AXIS_DESCR COM_AXIS NO_INPUT_QUANTITY Compu_TCRI_QPT_yrpm 16 -32768 32767 AXIS_PTS_REF TCRI_QPT_yrpm /end AXIS_DESCR
/end CHARACTERISTIC
/begin COMPU_METHOD Compu_TCRI_pulseoff_std "" RAT_FUNC "%.0" "-" COEFFS 0 1 0 0 0 1 /end COMPU_METHOD
/begin CHARACTERISTIC TCRI_pulseoff_alt1 "Forced Injection Disable - Alternate" MAP 0x001F1A81 /* @ECU_Address@TCRI_pulseoff_alt1@0x0231C000@ */ ECIPP_ALIGNMENT_UBYTE 255 Compu_TCRI_pulseoff_alt1 0 255
 /begin AXIS_DESCR COM_AXIS NO_INPUT_QUANTITY Compu_TCRI_QPT_xload 16 -1024 1023.96875 AXIS_PTS_REF TCRI_QPT_xload /end AXIS_DESCR
 /begin AXIS_DESCR COM_AXIS NO_INPUT_QUANTITY Compu_TCRI_QPT_yrpm 16 -32768 32767 AXIS_PTS_REF TCRI_QPT_yrpm /end AXIS_DESCR
/end CHARACTERISTIC
/begin COMPU_METHOD Compu_TCRI_pulseoff_alt1 "" RAT_FUNC "%.0" "-" COEFFS 0 1 0 0 0 1 /end COMPU_METHOD
/begin COMPU_METHOD Compu_TDOC_Tcl_yrpm " " RAT_FUNC "%.0" "Speed (rpm)" COEFFS 0 1 0 0 0 1 /end COMPU_METHOD
/begin COMPU_METHOD Compu_TDOC_Tcl_xload " " RAT_FUNC "%.1" "Fuel Load (mg/cyl)" COEFFS 0 32 0 0 0 1 /end COMPU_METHOD
/begin CHARACTERISTIC TDOC_Tcl_std "DOC Temperature Target - Standard (deg F)" MAP 0x001F1814 /* @ECU_Address@TDOC_Tcl_std@0x02329000@ */ ECIPP_ALIGNMENT_SWORD 3636 Compu_TDOC_Tcl_std -4556 3635.875
 /begin AXIS_DESCR COM_AXIS NO_INPUT_QUANTITY Compu_TDOC_Tcl_xload 8 -1024 1023.96875 AXIS_PTS_REF TDOC_Tcl_xload /end AXIS_DESCR
 /begin AXIS_DESCR COM_AXIS NO_INPUT_QUANTITY Compu_TDOC_Tcl_yrpm 8 -32768 32767 AXIS_PTS_REF TDOC_Tcl_yrpm /end AXIS_DESCR
/end CHARACTERISTIC
/begin AXIS_PTS TDOC_Tcl_xload " " 0x001F1894 /* @ECU_Address@TDOC_Tcl_xload@0x02328000@ */ NO_INPUT_QUANTITY ECIPP_Lookup_SWORD 0 Compu_TDOC_Tcl_xload 8 -1024 1023.96875 /end AXIS_PTS
/begin AXIS_PTS TDOC_Tcl_yrpm " " 0x001F18A4 /* @ECU_Address@TDOC_Tcl_yrpm@0x02327000@ */ NO_INPUT_QUANTITY ECIPP_Lookup_SWORD 0 Compu_TDOC_Tcl_yrpm 8 -32768 32767 /end AXIS_PTS
/begin COMPU_METHOD Compu_TDOC_Tcl_std "" RAT_FUNC "%.0" "degF" COEFFS 0 8 3680 0 0 1 /end COMPU_METHOD
/begin CHARACTERISTIC TDOC_Tcl_alt1 "DOC Temperature Target - Alternate (deg F)" MAP 0x001F1794 /* @ECU_Address@TDOC_Tcl_alt1@0x0232A000@ */ ECIPP_ALIGNMENT_SWORD 3636 Compu_TDOC_Tcl_alt1 -4556 3635.875
 /begin AXIS_DESCR COM_AXIS NO_INPUT_QUANTITY Compu_TDOC_Tcl_xload 8 -1024 1023.96875 AXIS_PTS_REF TDOC_Tcl_xload /end AXIS_DESCR
 /begin AXIS_DESCR COM_AXIS NO_INPUT_QUANTITY Compu_TDOC_Tcl_yrpm 8 -32768 32767 AXIS_PTS_REF TDOC_Tcl_yrpm /end AXIS_DESCR
/end CHARACTERISTIC
/begin COMPU_METHOD Compu_TDOC_Tcl_alt1 "" RAT_FUNC "%.0" "degF" COEFFS 0 8 3680 0 0 1 /end COMPU_METHOD
/begin CHARACTERISTIC TTC_turb_Pratio "Air # TTC_turb_Pratio" VAL_BLK 0x001E3436 /* @ECU_Address@TTC_turb_Pratio@0x0233F000@ */ ECIPP_ALIGNMENT_SWORD 16 Compu_TTC_turb_Pratio -16 15.99951171875 MATRIX_DIM 8 1 1 /end CHARACTERISTIC
/begin COMPU_METHOD Compu_TTC_turb_Pratio " " RAT_FUNC "%.0" "-" COEFFS 0 2048 0 0 0 1 /end COMPU_METHOD
/begin CHARACTERISTIC TTC_comp_Npct "Air # TTC_comp_Npct" VAL_BLK 0x001E330E /* @ECU_Address@TTC_comp_Npct@0x02343000@ */ ECIPP_ALIGNMENT_SWORD 200 Compu_TTC_comp_Npct -200 199.993896484375 MATRIX_DIM 32 1 1 /end CHARACTERISTIC
/begin COMPU_METHOD Compu_TTC_comp_Npct "" RAT_FUNC "%.0" "% ref" COEFFS 0 163.84 0 0 0 1 /end COMPU_METHOD
/begin CHARACTERISTIC TTC_turb_Nmult_neg "Air # TTC_turb_Nmult_neg" VAL_BLK 0x001E3396 /* @ECU_Address@TTC_turb_Nmult_neg@0x02344000@ */ ECIPP_ALIGNMENT_SWORD 2 Compu_TTC_turb_Nmult_neg -2 1.99993896484375 MATRIX_DIM 8 1 1 /end CHARACTERISTIC
/begin COMPU_METHOD Compu_TTC_turb_Nmult_neg " " RAT_FUNC "%.0" "%/Krpm^2" COEFFS 0 16384 0 0 0 1 /end COMPU_METHOD
/begin CHARACTERISTIC TTC_turb_Nmult_pos "Air # TTC_turb_Nmult_pos" VAL_BLK 0x001E33A6 /* @ECU_Address@TTC_turb_Nmult_pos@0x02345000@ */ ECIPP_ALIGNMENT_SWORD 2 Compu_TTC_turb_Nmult_pos -2 1.99993896484375 MATRIX_DIM 8 1 1 /end CHARACTERISTIC
/begin COMPU_METHOD Compu_TTC_turb_Nmult_pos " " RAT_FUNC "%.0" "%/Krpm^2" COEFFS 0 16384 0 0 0 1 /end COMPU_METHOD
/begin CHARACTERISTIC TTC_turb_etamax "Air # TTC_turb_etamax" VAL_BLK 0x001E3466 /* @ECU_Address@TTC_turb_etamax@0x02347000@ */ ECIPP_ALIGNMENT_SWORD 200 Compu_TTC_turb_etamax -200 199.993896484375 MATRIX_DIM 64 1 1 /end CHARACTERISTIC
/begin COMPU_METHOD Compu_TTC_turb_etamax "" RAT_FUNC "%.0" "%" COEFFS 0 163.84 0 0 0 1 /end COMPU_METHOD
/begin CHARACTERISTIC TTC_turb_Npct_etamax "Air # TTC_turb_Npct_etamax" VAL_BLK 0x001E33B6 /* @ECU_Address@TTC_turb_Npct_etamax@0x02348000@ */ ECIPP_ALIGNMENT_SWORD 200 Compu_TTC_turb_Npct_etamax -200 199.993896484375 MATRIX_DIM 64 1 1 /end CHARACTERISTIC
/begin COMPU_METHOD Compu_TTC_turb_Npct_etamax "" RAT_FUNC "%.0" "% ref" COEFFS 0 163.84 0 0 0 1 /end COMPU_METHOD
/begin CHARACTERISTIC TTC_turb_mdot1c_pct "Air # TTC_turb_mdot1c_pct" VAL_BLK 0x001E34EE /* @ECU_Address@TTC_turb_mdot1c_pct@0x0234B000@ */ ECIPP_ALIGNMENT_SWORD 200 Compu_TTC_turb_mdot1c_pct -200 199.993896484375 MATRIX_DIM 32 1 1 /end CHARACTERISTIC
/begin COMPU_METHOD Compu_TTC_turb_mdot1c_pct "" RAT_FUNC "%.0" "% ref" COEFFS 0 163.84 0 0 0 1 /end COMPU_METHOD
/begin CHARACTERISTIC HEX_FSS_PID_tbl "General # HEX_FSS_PID_tbl" VAL_BLK 0x001E6DBA /* @ECU_Address@HEX_FSS_PID_tbl@0x025B7000@ */ ECIPP_ALIGNMENT_UBYTE 255 Compu_HEX_FSS_PID_tbl 0 255 MATRIX_DIM 30 1 1 /end CHARACTERISTIC
/begin COMPU_METHOD Compu_HEX_FSS_PID_tbl " " RAT_FUNC "%.0" "-" COEFFS 0 1 0 0 0 1 /end COMPU_METHOD
/begin CHARACTERISTIC FCdc4_accel_x_max "FCtl_DTC_0x04(702)" VALUE 0x001E4612 /* @ECU_Address@FCtl_DTC_0x04@0x024C457C@ */ ECIPP_ALIGNMENT_UWORD 65535 Compu_IDENTITY 0 65535 PHYS_UNIT "System ID + DTC" /end CHARACTERISTIC
/begin CHARACTERISTIC FCdc4_accel_x_min "FCtl_DTC_0x04(703)" VALUE 0x001E4614 /* @ECU_Address@FCtl_DTC_0x04@0x024C457E@ */ ECIPP_ALIGNMENT_UWORD 65535 Compu_IDENTITY 0 65535 PHYS_UNIT "System ID + DTC" /end CHARACTERISTIC
/begin CHARACTERISTIC FCdc4_accel_y_max "FCtl_DTC_0x04(704)" VALUE 0x001E4616 /* @ECU_Address@FCtl_DTC_0x04@0x024C4580@ */ ECIPP_ALIGNMENT_UWORD 65535 Compu_IDENTITY 0 65535 PHYS_UNIT "System ID + DTC" /end CHARACTERISTIC
/begin CHARACTERISTIC FCdc4_accel_y_min "FCtl_DTC_0x04(705)" VALUE 0x001E4618 /* @ECU_Address@FCtl_DTC_0x04@0x024C4582@ */ ECIPP_ALIGNMENT_UWORD 65535 Compu_IDENTITY 0 65535 PHYS_UNIT "System ID + DTC" /end CHARACTERISTIC
/begin CHARACTERISTIC FCdc4_accel_z_max "FCtl_DTC_0x04(706)" VALUE 0x001E461A /* @ECU_Address@FCtl_DTC_0x04@0x024C4584@ */ ECIPP_ALIGNMENT_UWORD 65535 Compu_IDENTITY 0 65535 PHYS_UNIT "System ID + DTC" /end CHARACTERISTIC
/begin CHARACTERISTIC FCdc4_accel_z_min "FCtl_DTC_0x04(707)" VALUE 0x001E461C /* @ECU_Address@FCtl_DTC_0x04@0x024C4586@ */ ECIPP_ALIGNMENT_UWORD 65535 Compu_IDENTITY 0 65535 PHYS_UNIT "System ID + DTC" /end CHARACTERISTIC
/begin CHARACTERISTIC FCdc4_ACLT_intTlim_OOA "FCtl_DTC_0x04(868)" VALUE 0x001E475E /* @ECU_Address@FCtl_DTC_0x04@0x024C46C8@ */ ECIPP_ALIGNMENT_UWORD 65535 Compu_IDENTITY 0 65535 PHYS_UNIT "System ID + DTC" /end CHARACTERISTIC
/begin CHARACTERISTIC FCdc4_ACT_hi "FCtl_DTC_0x04(862)" VALUE 0x001E4752 /* @ECU_Address@FCtl_DTC_0x04@0x024C46BC@ */ ECIPP_ALIGNMENT_UWORD 65535 Compu_IDENTITY 0 65535 PHYS_UNIT "System ID + DTC" /end CHARACTERISTIC
/begin CHARACTERISTIC FCdc4_ADIG1_max "FCtl_DTC_0x04(209)" VALUE 0x001E4238 /* @ECU_Address@FCtl_DTC_0x04@0x024C41A2@ */ ECIPP_ALIGNMENT_UWORD 65535 Compu_IDENTITY 0 65535 PHYS_UNIT "System ID + DTC" /end CHARACTERISTIC
/begin CHARACTERISTIC FCdc4_ADIG1_min "FCtl_DTC_0x04(210)" VALUE 0x001E423A /* @ECU_Address@FCtl_DTC_0x04@0x024C41A4@ */ ECIPP_ALIGNMENT_UWORD 65535 Compu_IDENTITY 0 65535 PHYS_UNIT "System ID + DTC" /end CHARACTERISTIC
/begin CHARACTERISTIC FCdc4_ADIG10_max "FCtl_DTC_0x04(349)" VALUE 0x001E4350 /* @ECU_Address@FCtl_DTC_0x04@0x024C42BA@ */ ECIPP_ALIGNMENT_UWORD 65535 Compu_IDENTITY 0 65535 PHYS_UNIT "System ID + DTC" /end CHARACTERISTIC
/begin CHARACTERISTIC FCdc4_ADIG10_min "FCtl_DTC_0x04(350)" VALUE 0x001E4352 /* @ECU_Address@FCtl_DTC_0x04@0x024C42BC@ */ ECIPP_ALIGNMENT_UWORD 65535 Compu_IDENTITY 0 65535 PHYS_UNIT "System ID + DTC" /end CHARACTERISTIC
/begin CHARACTERISTIC FCdc4_ADIG11_max "FCtl_DTC_0x04(354)" VALUE 0x001E435A /* @ECU_Address@FCtl_DTC_0x04@0x024C42C4@ */ ECIPP_ALIGNMENT_UWORD 65535 Compu_IDENTITY 0 65535 PHYS_UNIT "System ID + DTC" /end CHARACTERISTIC
/begin CHARACTERISTIC FCdc4_ADIG11_min "FCtl_DTC_0x04(355)" VALUE 0x001E435C /* @ECU_Address@FCtl_DTC_0x04@0x024C42C6@ */ ECIPP_ALIGNMENT_UWORD 65535 Compu_IDENTITY 0 65535 PHYS_UNIT "System ID + DTC" /end CHARACTERISTIC
/begin CHARACTERISTIC FCdc4_ADIG12_max "FCtl_DTC_0x04(356)" VALUE 0x001E435E /* @ECU_Address@FCtl_DTC_0x04@0x024C42C8@ */ ECIPP_ALIGNMENT_UWORD 65535 Compu_IDENTITY 0 65535 PHYS_UNIT "System ID + DTC" /end CHARACTERISTIC
/begin CHARACTERISTIC FCdc4_ADIG12_min "FCtl_DTC_0x04(357)" VALUE 0x001E4360 /* @ECU_Address@FCtl_DTC_0x04@0x024C42CA@ */ ECIPP_ALIGNMENT_UWORD 65535 Compu_IDENTITY 0 65535 PHYS_UNIT "System ID + DTC" /end CHARACTERISTIC
/begin CHARACTERISTIC FCdc4_ADIG13_max "FCtl_DTC_0x04(393)" VALUE 0x001E43A8 /* @ECU_Address@FCtl_DTC_0x04@0x024C4312@ */ ECIPP_ALIGNMENT_UWORD 65535 Compu_IDENTITY 0 65535 PHYS_UNIT "System ID + DTC" /end CHARACTERISTIC
/begin CHARACTERISTIC FCdc4_ADIG13_min "FCtl_DTC_0x04(394)" VALUE 0x001E43AA /* @ECU_Address@FCtl_DTC_0x04@0x024C4314@ */ ECIPP_ALIGNMENT_UWORD 65535 Compu_IDENTITY 0 65535 PHYS_UNIT "System ID + DTC" /end CHARACTERISTIC
/begin CHARACTERISTIC FCdc4_ADIG14_max "FCtl_DTC_0x04(395)" VALUE 0x001E43AC /* @ECU_Address@FCtl_DTC_0x04@0x024C4316@ */ ECIPP_ALIGNMENT_UWORD 65535 Compu_IDENTITY 0 65535 PHYS_UNIT "System ID + DTC" /end CHARACTERISTIC
/begin CHARACTERISTIC FCdc4_ADIG14_min "FCtl_DTC_0x04(396)" VALUE 0x001E43AE /* @ECU_Address@FCtl_DTC_0x04@0x024C4318@ */ ECIPP_ALIGNMENT_UWORD 65535 Compu_IDENTITY 0 65535 PHYS_UNIT "System ID + DTC" /end CHARACTERISTIC
/begin CHARACTERISTIC FCdc4_ADIG15_max "FCtl_DTC_0x04(397)" VALUE 0x001E43B0 /* @ECU_Address@FCtl_DTC_0x04@0x024C431A@ */ ECIPP_ALIGNMENT_UWORD 65535 Compu_IDENTITY 0 65535 PHYS_UNIT "System ID + DTC" /end CHARACTERISTIC
/begin CHARACTERISTIC FCdc4_ADIG15_min "FCtl_DTC_0x04(398)" VALUE 0x001E43B2 /* @ECU_Address@FCtl_DTC_0x04@0x024C431C@ */ ECIPP_ALIGNMENT_UWORD 65535 Compu_IDENTITY 0 65535 PHYS_UNIT "System ID + DTC" /end CHARACTERISTIC
/begin CHARACTERISTIC FCdc4_ADIG16_max "FCtl_DTC_0x04(399)" VALUE 0x001E43B4 /* @ECU_Address@FCtl_DTC_0x04@0x024C431E@ */ ECIPP_ALIGNMENT_UWORD 65535 Compu_IDENTITY 0 65535 PHYS_UNIT "System ID + DTC" /end CHARACTERISTIC
/begin CHARACTERISTIC FCdc4_ADIG16_min "FCtl_DTC_0x04(400)" VALUE 0x001E43B6 /* @ECU_Address@FCtl_DTC_0x04@0x024C4320@ */ ECIPP_ALIGNMENT_UWORD 65535 Compu_IDENTITY 0 65535 PHYS_UNIT "System ID + DTC" /end CHARACTERISTIC
/begin CHARACTERISTIC FCdc4_ADIG17_max "FCtl_DTC_0x04(401)" VALUE 0x001E43B8 /* @ECU_Address@FCtl_DTC_0x04@0x024C4322@ */ ECIPP_ALIGNMENT_UWORD 65535 Compu_IDENTITY 0 65535 PHYS_UNIT "System ID + DTC" /end CHARACTERISTIC
/begin CHARACTERISTIC FCdc4_ADIG17_min "FCtl_DTC_0x04(402)" VALUE 0x001E43BA /* @ECU_Address@FCtl_DTC_0x04@0x024C4324@ */ ECIPP_ALIGNMENT_UWORD 65535 Compu_IDENTITY 0 65535 PHYS_UNIT "System ID + DTC" /end CHARACTERISTIC
/begin CHARACTERISTIC FCdc4_ADIG18_max "FCtl_DTC_0x04(403)" VALUE 0x001E43BC /* @ECU_Address@FCtl_DTC_0x04@0x024C4326@ */ ECIPP_ALIGNMENT_UWORD 65535 Compu_IDENTITY 0 65535 PHYS_UNIT "System ID + DTC" /end CHARACTERISTIC
/begin CHARACTERISTIC FCdc4_ADIG18_min "FCtl_DTC_0x04(404)" VALUE 0x001E43BE /* @ECU_Address@FCtl_DTC_0x04@0x024C4328@ */ ECIPP_ALIGNMENT_UWORD 65535 Compu_IDENTITY 0 65535 PHYS_UNIT "System ID + DTC" /end CHARACTERISTIC
/begin CHARACTERISTIC FCdc4_ADIG19_max "FCtl_DTC_0x04(405)" VALUE 0x001E43C0 /* @ECU_Address@FCtl_DTC_0x04@0x024C432A@ */ ECIPP_ALIGNMENT_UWORD 65535 Compu_IDENTITY 0 65535 PHYS_UNIT "System ID + DTC" /end CHARACTERISTIC
/begin CHARACTERISTIC FCdc4_ADIG19_min "FCtl_DTC_0x04(406)" VALUE 0x001E43C2 /* @ECU_Address@FCtl_DTC_0x04@0x024C432C@ */ ECIPP_ALIGNMENT_UWORD 65535 Compu_IDENTITY 0 65535 PHYS_UNIT "System ID + DTC" /end CHARACTERISTIC
/begin CHARACTERISTIC FCdc4_ADIG2_max "FCtl_DTC_0x04(211)" VALUE 0x001E423C /* @ECU_Address@FCtl_DTC_0x04@0x024C41A6@ */ ECIPP_ALIGNMENT_UWORD 65535 Compu_IDENTITY 0 65535 PHYS_UNIT "System ID + DTC" /end CHARACTERISTIC
/begin CHARACTERISTIC FCdc4_ADIG2_min "FCtl_DTC_0x04(212)" VALUE 0x001E423E /* @ECU_Address@FCtl_DTC_0x04@0x024C41A8@ */ ECIPP_ALIGNMENT_UWORD 65535 Compu_IDENTITY 0 65535 PHYS_UNIT "System ID + DTC" /end CHARACTERISTIC
/begin CHARACTERISTIC FCdc4_ADIG20_max "FCtl_DTC_0x04(584)" VALUE 0x001E4526 /* @ECU_Address@FCtl_DTC_0x04@0x024C4490@ */ ECIPP_ALIGNMENT_UWORD 65535 Compu_IDENTITY 0 65535 PHYS_UNIT "System ID + DTC" /end CHARACTERISTIC
/begin CHARACTERISTIC FCdc4_ADIG20_min "FCtl_DTC_0x04(585)" VALUE 0x001E4528 /* @ECU_Address@FCtl_DTC_0x04@0x024C4492@ */ ECIPP_ALIGNMENT_UWORD 65535 Compu_IDENTITY 0 65535 PHYS_UNIT "System ID + DTC" /end CHARACTERISTIC
/begin CHARACTERISTIC FCdc4_ADIG21_max "FCtl_DTC_0x04(586)" VALUE 0x001E452A /* @ECU_Address@FCtl_DTC_0x04@0x024C4494@ */ ECIPP_ALIGNMENT_UWORD 65535 Compu_IDENTITY 0 65535 PHYS_UNIT "System ID + DTC" /end CHARACTERISTIC
/begin CHARACTERISTIC FCdc4_ADIG21_min "FCtl_DTC_0x04(587)" VALUE 0x001E452C /* @ECU_Address@FCtl_DTC_0x04@0x024C4496@ */ ECIPP_ALIGNMENT_UWORD 65535 Compu_IDENTITY 0 65535 PHYS_UNIT "System ID + DTC" /end CHARACTERISTIC
/begin CHARACTERISTIC FCdc4_ADIG22_max "FCtl_DTC_0x04(588)" VALUE 0x001E452E /* @ECU_Address@FCtl_DTC_0x04@0x024C4498@ */ ECIPP_ALIGNMENT_UWORD 65535 Compu_IDENTITY 0 65535 PHYS_UNIT "System ID + DTC" /end CHARACTERISTIC
/begin CHARACTERISTIC FPnd_accel_x_max "FPrm_pending(532)" VALUE 0x001E553A /* @ECU_Address@FPrm_pending@0x021BE428@ */ ECIPP_ALIGNMENT_UWORD 65535 Compu_IDENTITY 0 65535 PHYS_UNIT "Bit Mask" /end CHARACTERISTIC
/begin CHARACTERISTIC FPnd_accel_x_min "FPrm_pending(533)" VALUE 0x001E553C /* @ECU_Address@FPrm_pending@0x021BE42A@ */ ECIPP_ALIGNMENT_UWORD 65535 Compu_IDENTITY 0 65535 PHYS_UNIT "Bit Mask" /end CHARACTERISTIC
/begin CHARACTERISTIC FPnd_accel_y_max "FPrm_pending(534)" VALUE 0x001E553E /* @ECU_Address@FPrm_pending@0x021BE42C@ */ ECIPP_ALIGNMENT_UWORD 65535 Compu_IDENTITY 0 65535 PHYS_UNIT "Bit Mask" /end CHARACTERISTIC
/begin CHARACTERISTIC FPnd_accel_y_min "FPrm_pending(535)" VALUE 0x001E5540 /* @ECU_Address@FPrm_pending@0x021BE42E@ */ ECIPP_ALIGNMENT_UWORD 65535 Compu_IDENTITY 0 65535 PHYS_UNIT "Bit Mask" /end CHARACTERISTIC
/begin CHARACTERISTIC FPnd_accel_z_max "FPrm_pending(536)" VALUE 0x001E5542 /* @ECU_Address@FPrm_pending@0x021BE430@ */ ECIPP_ALIGNMENT_UWORD 65535 Compu_IDENTITY 0 65535 PHYS_UNIT "Bit Mask" /end CHARACTERISTIC
/begin CHARACTERISTIC FPnd_accel_z_min "FPrm_pending(537)" VALUE 0x001E5544 /* @ECU_Address@FPrm_pending@0x021BE432@ */ ECIPP_ALIGNMENT_UWORD 65535 Compu_IDENTITY 0 65535 PHYS_UNIT "Bit Mask" /end CHARACTERISTIC
/begin CHARACTERISTIC FPnd_ACLT_intTlim_OOA "FPrm_pending(695)" VALUE 0x001E5680 /* @ECU_Address@FPrm_pending@0x021BE56E@ */ ECIPP_ALIGNMENT_UWORD 65535 Compu_IDENTITY 0 65535 PHYS_UNIT "Bit Mask" /end CHARACTERISTIC
/begin CHARACTERISTIC FPnd_ACT_hi "FPrm_pending(689)" VALUE 0x001E5674 /* @ECU_Address@FPrm_pending@0x021BE562@ */ ECIPP_ALIGNMENT_UWORD 65535 Compu_IDENTITY 0 65535 PHYS_UNIT "Bit Mask" /end CHARACTERISTIC
/begin CHARACTERISTIC FPnd_ADIG1_max "FPrm_pending(165)" VALUE 0x001E525C /* @ECU_Address@FPrm_pending@0x021BE14A@ */ ECIPP_ALIGNMENT_UWORD 65535 Compu_IDENTITY 0 65535 PHYS_UNIT "Bit Mask" /end CHARACTERISTIC
/begin CHARACTERISTIC FPnd_ADIG1_min "FPrm_pending(166)" VALUE 0x001E525E /* @ECU_Address@FPrm_pending@0x021BE14C@ */ ECIPP_ALIGNMENT_UWORD 65535 Compu_IDENTITY 0 65535 PHYS_UNIT "Bit Mask" /end CHARACTERISTIC
/begin CHARACTERISTIC FPnd_ADIG10_max "FPrm_pending(258)" VALUE 0x001E5316 /* @ECU_Address@FPrm_pending@0x021BE204@ */ ECIPP_ALIGNMENT_UWORD 65535 Compu_IDENTITY 0 65535 PHYS_UNIT "Bit Mask" /end CHARACTERISTIC
/begin CHARACTERISTIC FPnd_ADIG10_min "FPrm_pending(259)" VALUE 0x001E5318 /* @ECU_Address@FPrm_pending@0x021BE206@ */ ECIPP_ALIGNMENT_UWORD 65535 Compu_IDENTITY 0 65535 PHYS_UNIT "Bit Mask" /end CHARACTERISTIC
/begin CHARACTERISTIC FPnd_ADIG11_max "FPrm_pending(263)" VALUE 0x001E5320 /* @ECU_Address@FPrm_pending@0x021BE20E@ */ ECIPP_ALIGNMENT_UWORD 65535 Compu_IDENTITY 0 65535 PHYS_UNIT "Bit Mask" /end CHARACTERISTIC
/begin CHARACTERISTIC FPnd_ADIG11_min "FPrm_pending(264)" VALUE 0x001E5322 /* @ECU_Address@FPrm_pending@0x021BE210@ */ ECIPP_ALIGNMENT_UWORD 65535 Compu_IDENTITY 0 65535 PHYS_UNIT "Bit Mask" /end CHARACTERISTIC
/begin CHARACTERISTIC FPnd_ADIG12_max "FPrm_pending(265)" VALUE 0x001E5324 /* @ECU_Address@FPrm_pending@0x021BE212@ */ ECIPP_ALIGNMENT_UWORD 65535 Compu_IDENTITY 0 65535 PHYS_UNIT "Bit Mask" /end CHARACTERISTIC
/begin CHARACTERISTIC FPnd_ADIG12_min "FPrm_pending(266)" VALUE 0x001E5326 /* @ECU_Address@FPrm_pending@0x021BE214@ */ ECIPP_ALIGNMENT_UWORD 65535 Compu_IDENTITY 0 65535 PHYS_UNIT "Bit Mask" /end CHARACTERISTIC
/begin CHARACTERISTIC FPnd_ADIG13_max "FPrm_pending(302)" VALUE 0x001E536E /* @ECU_Address@FPrm_pending@0x021BE25C@ */ ECIPP_ALIGNMENT_UWORD 65535 Compu_IDENTITY 0 65535 PHYS_UNIT "Bit Mask" /end CHARACTERISTIC
/begin CHARACTERISTIC FPnd_ADIG13_min "FPrm_pending(303)" VALUE 0x001E5370 /* @ECU_Address@FPrm_pending@0x021BE25E@ */ ECIPP_ALIGNMENT_UWORD 65535 Compu_IDENTITY 0 65535 PHYS_UNIT "Bit Mask" /end CHARACTERISTIC
/begin CHARACTERISTIC FPnd_ADIG14_max "FPrm_pending(304)" VALUE 0x001E5372 /* @ECU_Address@FPrm_pending@0x021BE260@ */ ECIPP_ALIGNMENT_UWORD 65535 Compu_IDENTITY 0 65535 PHYS_UNIT "Bit Mask" /end CHARACTERISTIC
/begin CHARACTERISTIC FPnd_ADIG14_min "FPrm_pending(305)" VALUE 0x001E5374 /* @ECU_Address@FPrm_pending@0x021BE262@ */ ECIPP_ALIGNMENT_UWORD 65535 Compu_IDENTITY 0 65535 PHYS_UNIT "Bit Mask" /end CHARACTERISTIC
/begin CHARACTERISTIC FPnd_ADIG15_max "FPrm_pending(306)" VALUE 0x001E5376 /* @ECU_Address@FPrm_pending@0x021BE264@ */ ECIPP_ALIGNMENT_UWORD 65535 Compu_IDENTITY 0 65535 PHYS_UNIT "Bit Mask" /end CHARACTERISTIC
/begin CHARACTERISTIC FPnd_ADIG15_min "FPrm_pending(307)" VALUE 0x001E5378 /* @ECU_Address@FPrm_pending@0x021BE266@ */ ECIPP_ALIGNMENT_UWORD 65535 Compu_IDENTITY 0 65535 PHYS_UNIT "Bit Mask" /end CHARACTERISTIC
/begin CHARACTERISTIC FPnd_ADIG16_max "FPrm_pending(308)" VALUE 0x001E537A /* @ECU_Address@FPrm_pending@0x021BE268@ */ ECIPP_ALIGNMENT_UWORD 65535 Compu_IDENTITY 0 65535 PHYS_UNIT "Bit Mask" /end CHARACTERISTIC
/begin CHARACTERISTIC FPnd_ADIG16_min "FPrm_pending(309)" VALUE 0x001E537C /* @ECU_Address@FPrm_pending@0x021BE26A@ */ ECIPP_ALIGNMENT_UWORD 65535 Compu_IDENTITY 0 65535 PHYS_UNIT "Bit Mask" /end CHARACTERISTIC
/begin CHARACTERISTIC FPnd_ADIG17_max "FPrm_pending(310)" VALUE 0x001E537E /* @ECU_Address@FPrm_pending@0x021BE26C@ */ ECIPP_ALIGNMENT_UWORD 65535 Compu_IDENTITY 0 65535 PHYS_UNIT "Bit Mask" /end CHARACTERISTIC
/begin CHARACTERISTIC FPnd_ADIG17_min "FPrm_pending(311)" VALUE 0x001E5380 /* @ECU_Address@FPrm_pending@0x021BE26E@ */ ECIPP_ALIGNMENT_UWORD 65535 Compu_IDENTITY 0 65535 PHYS_UNIT "Bit Mask" /end CHARACTERISTIC
/begin CHARACTERISTIC FPnd_ADIG18_max "FPrm_pending(312)" VALUE 0x001E5382 /* @ECU_Address@FPrm_pending@0x021BE270@ */ ECIPP_ALIGNMENT_UWORD 65535 Compu_IDENTITY 0 65535 PHYS_UNIT "Bit Mask" /end CHARACTERISTIC
/begin CHARACTERISTIC FPnd_ADIG18_min "FPrm_pending(313)" VALUE 0x001E5384 /* @ECU_Address@FPrm_pending@0x021BE272@ */ ECIPP_ALIGNMENT_UWORD 65535 Compu_IDENTITY 0 65535 PHYS_UNIT "Bit Mask" /end CHARACTERISTIC
/begin CHARACTERISTIC FPnd_ADIG19_max "FPrm_pending(314)" VALUE 0x001E5386 /* @ECU_Address@FPrm_pending@0x021BE274@ */ ECIPP_ALIGNMENT_UWORD 65535 Compu_IDENTITY 0 65535 PHYS_UNIT "Bit Mask" /end CHARACTERISTIC
/begin CHARACTERISTIC FPnd_ADIG19_min "FPrm_pending(315)" VALUE 0x001E5388 /* @ECU_Address@FPrm_pending@0x021BE276@ */ ECIPP_ALIGNMENT_UWORD 65535 Compu_IDENTITY 0 65535 PHYS_UNIT "Bit Mask" /end CHARACTERISTIC
/begin CHARACTERISTIC FPnd_ADIG2_max "FPrm_pending(167)" VALUE 0x001E5260 /* @ECU_Address@FPrm_pending@0x021BE14E@ */ ECIPP_ALIGNMENT_UWORD 65535 Compu_IDENTITY 0 65535 PHYS_UNIT "Bit Mask" /end CHARACTERISTIC
/begin CHARACTERISTIC FPnd_ADIG2_min "FPrm_pending(168)" VALUE 0x001E5262 /* @ECU_Address@FPrm_pending@0x021BE150@ */ ECIPP_ALIGNMENT_UWORD 65535 Compu_IDENTITY 0 65535 PHYS_UNIT "Bit Mask" /end CHARACTERISTIC
/begin CHARACTERISTIC FPnd_ADIG20_max "FPrm_pending(438)" VALUE 0x001E547E /* @ECU_Address@FPrm_pending@0x021BE36C@ */ ECIPP_ALIGNMENT_UWORD 65535 Compu_IDENTITY 0 65535 PHYS_UNIT "Bit Mask" /end CHARACTERISTIC
/begin CHARACTERISTIC FPnd_ADIG20_min "FPrm_pending(439)" VALUE 0x001E5480 /* @ECU_Address@FPrm_pending@0x021BE36E@ */ ECIPP_ALIGNMENT_UWORD 65535 Compu_IDENTITY 0 65535 PHYS_UNIT "Bit Mask" /end CHARACTERISTIC
/begin CHARACTERISTIC FPnd_ADIG21_max "FPrm_pending(440)" VALUE 0x001E5482 /* @ECU_Address@FPrm_pending@0x021BE370@ */ ECIPP_ALIGNMENT_UWORD 65535 Compu_IDENTITY 0 65535 PHYS_UNIT "Bit Mask" /end CHARACTERISTIC
/begin CHARACTERISTIC FPnd_ADIG21_min "FPrm_pending(441)" VALUE 0x001E5484 /* @ECU_Address@FPrm_pending@0x021BE372@ */ ECIPP_ALIGNMENT_UWORD 65535 Compu_IDENTITY 0 65535 PHYS_UNIT "Bit Mask" /end CHARACTERISTIC
/begin CHARACTERISTIC FPnd_ADIG22_max "FPrm_pending(442)" VALUE 0x001E5486 /* @ECU_Address@FPrm_pending@0x021BE374@ */ ECIPP_ALIGNMENT_UWORD 65535 Compu_IDENTITY 0 65535 PHYS_UNIT "Bit Mask" /end CHARACTERISTIC
/begin CHARACTERISTIC FPsvr_accel_x_max "FPrm_severity(532)" VALUE 0x001E6A29 /* @ECU_Address@FPrm_severity@0x024B3214@ */ ECIPP_ALIGNMENT_UBYTE 255 Compu_IDENTITY 0 255 PHYS_UNIT "Severity+Class" /end CHARACTERISTIC
/begin CHARACTERISTIC FPsvr_accel_x_min "FPrm_severity(533)" VALUE 0x001E6A2A /* @ECU_Address@FPrm_severity@0x024B3215@ */ ECIPP_ALIGNMENT_UBYTE 255 Compu_IDENTITY 0 255 PHYS_UNIT "Severity+Class" /end CHARACTERISTIC
/begin CHARACTERISTIC FPsvr_accel_y_max "FPrm_severity(534)" VALUE 0x001E6A2B /* @ECU_Address@FPrm_severity@0x024B3216@ */ ECIPP_ALIGNMENT_UBYTE 255 Compu_IDENTITY 0 255 PHYS_UNIT "Severity+Class" /end CHARACTERISTIC
/begin CHARACTERISTIC FPsvr_accel_y_min "FPrm_severity(535)" VALUE 0x001E6A2C /* @ECU_Address@FPrm_severity@0x024B3217@ */ ECIPP_ALIGNMENT_UBYTE 255 Compu_IDENTITY 0 255 PHYS_UNIT "Severity+Class" /end CHARACTERISTIC
/begin CHARACTERISTIC FPsvr_accel_z_max "FPrm_severity(536)" VALUE 0x001E6A2D /* @ECU_Address@FPrm_severity@0x024B3218@ */ ECIPP_ALIGNMENT_UBYTE 255 Compu_IDENTITY 0 255 PHYS_UNIT "Severity+Class" /end CHARACTERISTIC
/begin CHARACTERISTIC FPsvr_accel_z_min "FPrm_severity(537)" VALUE 0x001E6A2E /* @ECU_Address@FPrm_severity@0x024B3219@ */ ECIPP_ALIGNMENT_UBYTE 255 Compu_IDENTITY 0 255 PHYS_UNIT "Severity+Class" /end CHARACTERISTIC
/begin CHARACTERISTIC FPsvr_ACLT_intTlim_OOA "FPrm_severity(695)" VALUE 0x001E6ACC /* @ECU_Address@FPrm_severity@0x024B32B7@ */ ECIPP_ALIGNMENT_UBYTE 255 Compu_IDENTITY 0 255 PHYS_UNIT "Severity+Class" /end CHARACTERISTIC
/begin CHARACTERISTIC FPsvr_ACT_hi "FPrm_severity(689)" VALUE 0x001E6AC6 /* @ECU_Address@FPrm_severity@0x024B32B1@ */ ECIPP_ALIGNMENT_UBYTE 255 Compu_IDENTITY 0 255 PHYS_UNIT "Severity+Class" /end CHARACTERISTIC
/begin CHARACTERISTIC FPsvr_ADIG1_max "FPrm_severity(165)" VALUE 0x001E68BA /* @ECU_Address@FPrm_severity@0x024B30A5@ */ ECIPP_ALIGNMENT_UBYTE 255 Compu_IDENTITY 0 255 PHYS_UNIT "Severity+Class" /end CHARACTERISTIC
/begin CHARACTERISTIC FPsvr_ADIG1_min "FPrm_severity(166)" VALUE 0x001E68BB /* @ECU_Address@FPrm_severity@0x024B30A6@ */ ECIPP_ALIGNMENT_UBYTE 255 Compu_IDENTITY 0 255 PHYS_UNIT "Severity+Class" /end CHARACTERISTIC
/begin CHARACTERISTIC FPsvr_ADIG10_max "FPrm_severity(258)" VALUE 0x001E6917 /* @ECU_Address@FPrm_severity@0x024B3102@ */ ECIPP_ALIGNMENT_UBYTE 255 Compu_IDENTITY 0 255 PHYS_UNIT "Severity+Class" /end CHARACTERISTIC
/begin CHARACTERISTIC FPsvr_ADIG10_min "FPrm_severity(259)" VALUE 0x001E6918 /* @ECU_Address@FPrm_severity@0x024B3103@ */ ECIPP_ALIGNMENT_UBYTE 255 Compu_IDENTITY 0 255 PHYS_UNIT "Severity+Class" /end CHARACTERISTIC
/begin CHARACTERISTIC FPsvr_ADIG11_max "FPrm_severity(263)" VALUE 0x001E691C /* @ECU_Address@FPrm_severity@0x024B3107@ */ ECIPP_ALIGNMENT_UBYTE 255 Compu_IDENTITY 0 255 PHYS_UNIT "Severity+Class" /end CHARACTERISTIC
/begin CHARACTERISTIC FPsvr_ADIG11_min "FPrm_severity(264)" VALUE 0x001E691D /* @ECU_Address@FPrm_severity@0x024B3108@ */ ECIPP_ALIGNMENT_UBYTE 255 Compu_IDENTITY 0 255 PHYS_UNIT "Severity+Class" /end CHARACTERISTIC
/begin CHARACTERISTIC FPsvr_ADIG12_max "FPrm_severity(265)" VALUE 0x001E691E /* @ECU_Address@FPrm_severity@0x024B3109@ */ ECIPP_ALIGNMENT_UBYTE 255 Compu_IDENTITY 0 255 PHYS_UNIT "Severity+Class" /end CHARACTERISTIC
/begin CHARACTERISTIC FPsvr_ADIG12_min "FPrm_severity(266)" VALUE 0x001E691F /* @ECU_Address@FPrm_severity@0x024B310A@ */ ECIPP_ALIGNMENT_UBYTE 255 Compu_IDENTITY 0 255 PHYS_UNIT "Severity+Class" /end CHARACTERISTIC
/begin CHARACTERISTIC FPsvr_ADIG13_max "FPrm_severity(302)" VALUE 0x001E6943 /* @ECU_Address@FPrm_severity@0x024B312E@ */ ECIPP_ALIGNMENT_UBYTE 255 Compu_IDENTITY 0 255 PHYS_UNIT "Severity+Class" /end CHARACTERISTIC
/begin CHARACTERISTIC FPsvr_ADIG13_min "FPrm_severity(303)" VALUE 0x001E6944 /* @ECU_Address@FPrm_severity@0x024B312F@ */ ECIPP_ALIGNMENT_UBYTE 255 Compu_IDENTITY 0 255 PHYS_UNIT "Severity+Class" /end CHARACTERISTIC
/begin CHARACTERISTIC FPsvr_ADIG14_max "FPrm_severity(304)" VALUE 0x001E6945 /* @ECU_Address@FPrm_severity@0x024B3130@ */ ECIPP_ALIGNMENT_UBYTE 255 Compu_IDENTITY 0 255 PHYS_UNIT "Severity+Class" /end CHARACTERISTIC
/begin CHARACTERISTIC FPsvr_ADIG14_min "FPrm_severity(305)" VALUE 0x001E6946 /* @ECU_Address@FPrm_severity@0x024B3131@ */ ECIPP_ALIGNMENT_UBYTE 255 Compu_IDENTITY 0 255 PHYS_UNIT "Severity+Class" /end CHARACTERISTIC
/begin CHARACTERISTIC FPsvr_ADIG15_max "FPrm_severity(306)" VALUE 0x001E6947 /* @ECU_Address@FPrm_severity@0x024B3132@ */ ECIPP_ALIGNMENT_UBYTE 255 Compu_IDENTITY 0 255 PHYS_UNIT "Severity+Class" /end CHARACTERISTIC
/begin CHARACTERISTIC FPsvr_ADIG15_min "FPrm_severity(307)" VALUE 0x001E6948 /* @ECU_Address@FPrm_severity@0x024B3133@ */ ECIPP_ALIGNMENT_UBYTE 255 Compu_IDENTITY 0 255 PHYS_UNIT "Severity+Class" /end CHARACTERISTIC
/begin CHARACTERISTIC FPsvr_ADIG16_max "FPrm_severity(308)" VALUE 0x001E6949 /* @ECU_Address@FPrm_severity@0x024B3134@ */ ECIPP_ALIGNMENT_UBYTE 255 Compu_IDENTITY 0 255 PHYS_UNIT "Severity+Class" /end CHARACTERISTIC
/begin CHARACTERISTIC FPsvr_ADIG16_min "FPrm_severity(309)" VALUE 0x001E694A /* @ECU_Address@FPrm_severity@0x024B3135@ */ ECIPP_ALIGNMENT_UBYTE 255 Compu_IDENTITY 0 255 PHYS_UNIT "Severity+Class" /end CHARACTERISTIC
/begin CHARACTERISTIC FPsvr_ADIG17_max "FPrm_severity(310)" VALUE 0x001E694B /* @ECU_Address@FPrm_severity@0x024B3136@ */ ECIPP_ALIGNMENT_UBYTE 255 Compu_IDENTITY 0 255 PHYS_UNIT "Severity+Class" /end CHARACTERISTIC
/begin CHARACTERISTIC FPsvr_ADIG17_min "FPrm_severity(311)" VALUE 0x001E694C /* @ECU_Address@FPrm_severity@0x024B3137@ */ ECIPP_ALIGNMENT_UBYTE 255 Compu_IDENTITY 0 255 PHYS_UNIT "Severity+Class" /end CHARACTERISTIC
/begin CHARACTERISTIC FPsvr_ADIG18_max "FPrm_severity(312)" VALUE 0x001E694D /* @ECU_Address@FPrm_severity@0x024B3138@ */ ECIPP_ALIGNMENT_UBYTE 255 Compu_IDENTITY 0 255 PHYS_UNIT "Severity+Class" /end CHARACTERISTIC
/begin CHARACTERISTIC FPsvr_ADIG18_min "FPrm_severity(313)" VALUE 0x001E694E /* @ECU_Address@FPrm_severity@0x024B3139@ */ ECIPP_ALIGNMENT_UBYTE 255 Compu_IDENTITY 0 255 PHYS_UNIT "Severity+Class" /end CHARACTERISTIC
/begin CHARACTERISTIC FPsvr_ADIG19_max "FPrm_severity(314)" VALUE 0x001E694F /* @ECU_Address@FPrm_severity@0x024B313A@ */ ECIPP_ALIGNMENT_UBYTE 255 Compu_IDENTITY 0 255 PHYS_UNIT "Severity+Class" /end CHARACTERISTIC
/begin CHARACTERISTIC FPsvr_ADIG19_min "FPrm_severity(315)" VALUE 0x001E6950 /* @ECU_Address@FPrm_severity@0x024B313B@ */ ECIPP_ALIGNMENT_UBYTE 255 Compu_IDENTITY 0 255 PHYS_UNIT "Severity+Class" /end CHARACTERISTIC
/begin CHARACTERISTIC FPsvr_ADIG2_max "FPrm_severity(167)" VALUE 0x001E68BC /* @ECU_Address@FPrm_severity@0x024B30A7@ */ ECIPP_ALIGNMENT_UBYTE 255 Compu_IDENTITY 0 255 PHYS_UNIT "Severity+Class" /end CHARACTERISTIC
/begin CHARACTERISTIC FPsvr_ADIG2_min "FPrm_severity(168)" VALUE 0x001E68BD /* @ECU_Address@FPrm_severity@0x024B30A8@ */ ECIPP_ALIGNMENT_UBYTE 255 Compu_IDENTITY 0 255 PHYS_UNIT "Severity+Class" /end CHARACTERISTIC
/begin CHARACTERISTIC FPsvr_ADIG20_max "FPrm_severity(438)" VALUE 0x001E69CB /* @ECU_Address@FPrm_severity@0x024B31B6@ */ ECIPP_ALIGNMENT_UBYTE 255 Compu_IDENTITY 0 255 PHYS_UNIT "Severity+Class" /end CHARACTERISTIC
/begin CHARACTERISTIC FPsvr_ADIG20_min "FPrm_severity(439)" VALUE 0x001E69CC /* @ECU_Address@FPrm_severity@0x024B31B7@ */ ECIPP_ALIGNMENT_UBYTE 255 Compu_IDENTITY 0 255 PHYS_UNIT "Severity+Class" /end CHARACTERISTIC
/begin CHARACTERISTIC FPsvr_ADIG21_max "FPrm_severity(440)" VALUE 0x001E69CD /* @ECU_Address@FPrm_severity@0x024B31B8@ */ ECIPP_ALIGNMENT_UBYTE 255 Compu_IDENTITY 0 255 PHYS_UNIT "Severity+Class" /end CHARACTERISTIC
/begin CHARACTERISTIC FPsvr_ADIG21_min "FPrm_severity(441)" VALUE 0x001E69CE /* @ECU_Address@FPrm_severity@0x024B31B9@ */ ECIPP_ALIGNMENT_UBYTE 255 Compu_IDENTITY 0 255 PHYS_UNIT "Severity+Class" /end CHARACTERISTIC
/begin CHARACTERISTIC FPsvr_ADIG22_max "FPrm_severity(442)" VALUE 0x001E69CF /* @ECU_Address@FPrm_severity@0x024B31BA@ */ ECIPP_ALIGNMENT_UBYTE 255 Compu_IDENTITY 0 255 PHYS_UNIT "Severity+Class" /end CHARACTERISTIC
/begin CHARACTERISTIC FPsw_accel_x_max "FPrm_switches(532)" VALUE 0x001C7402 /* @ECU_Address@FPrm_switches@0x021B9428@ */ ECIPP_ALIGNMENT_UWORD 65535 Compu_IDENTITY 0 65535 PHYS_UNIT "Enable bits" /end CHARACTERISTIC
/begin CHARACTERISTIC FPsw_accel_x_min "FPrm_switches(533)" VALUE 0x001C7404 /* @ECU_Address@FPrm_switches@0x021B942A@ */ ECIPP_ALIGNMENT_UWORD 65535 Compu_IDENTITY 0 65535 PHYS_UNIT "Enable bits" /end CHARACTERISTIC
/begin CHARACTERISTIC FPsw_accel_y_max "FPrm_switches(534)" VALUE 0x001C7406 /* @ECU_Address@FPrm_switches@0x021B942C@ */ ECIPP_ALIGNMENT_UWORD 65535 Compu_IDENTITY 0 65535 PHYS_UNIT "Enable bits" /end CHARACTERISTIC
/begin CHARACTERISTIC FPsw_accel_y_min "FPrm_switches(535)" VALUE 0x001C7408 /* @ECU_Address@FPrm_switches@0x021B942E@ */ ECIPP_ALIGNMENT_UWORD 65535 Compu_IDENTITY 0 65535 PHYS_UNIT "Enable bits" /end CHARACTERISTIC
/begin CHARACTERISTIC FPsw_accel_z_max "FPrm_switches(536)" VALUE 0x001C740A /* @ECU_Address@FPrm_switches@0x021B9430@ */ ECIPP_ALIGNMENT_UWORD 65535 Compu_IDENTITY 0 65535 PHYS_UNIT "Enable bits" /end CHARACTERISTIC
/begin CHARACTERISTIC FPsw_accel_z_min "FPrm_switches(537)" VALUE 0x001C740C /* @ECU_Address@FPrm_switches@0x021B9432@ */ ECIPP_ALIGNMENT_UWORD 65535 Compu_IDENTITY 0 65535 PHYS_UNIT "Enable bits" /end CHARACTERISTIC
/begin CHARACTERISTIC FPsw_ACLT_intTlim_OOA "FPrm_switches(695)" VALUE 0x001C7548 /* @ECU_Address@FPrm_switches@0x021B956E@ */ ECIPP_ALIGNMENT_UWORD 65535 Compu_IDENTITY 0 65535 PHYS_UNIT "Enable bits" /end CHARACTERISTIC
/begin CHARACTERISTIC FPsw_ACT_hi "FPrm_switches(689)" VALUE 0x001C753C /* @ECU_Address@FPrm_switches@0x021B9562@ */ ECIPP_ALIGNMENT_UWORD 65535 Compu_IDENTITY 0 65535 PHYS_UNIT "Enable bits" /end CHARACTERISTIC
/begin CHARACTERISTIC FPsw_ADIG1_max "FPrm_switches(165)" VALUE 0x001C7124 /* @ECU_Address@FPrm_switches@0x021B914A@ */ ECIPP_ALIGNMENT_UWORD 65535 Compu_IDENTITY 0 65535 PHYS_UNIT "Enable bits" /end CHARACTERISTIC
/begin CHARACTERISTIC FPsw_ADIG1_min "FPrm_switches(166)" VALUE 0x001C7126 /* @ECU_Address@FPrm_switches@0x021B914C@ */ ECIPP_ALIGNMENT_UWORD 65535 Compu_IDENTITY 0 65535 PHYS_UNIT "Enable bits" /end CHARACTERISTIC
/begin CHARACTERISTIC FPsw_ADIG10_max "FPrm_switches(258)" VALUE 0x001C71DE /* @ECU_Address@FPrm_switches@0x021B9204@ */ ECIPP_ALIGNMENT_UWORD 65535 Compu_IDENTITY 0 65535 PHYS_UNIT "Enable bits" /end CHARACTERISTIC
/begin CHARACTERISTIC FPsw_ADIG10_min "FPrm_switches(259)" VALUE 0x001C71E0 /* @ECU_Address@FPrm_switches@0x021B9206@ */ ECIPP_ALIGNMENT_UWORD 65535 Compu_IDENTITY 0 65535 PHYS_UNIT "Enable bits" /end CHARACTERISTIC
/begin CHARACTERISTIC FPsw_ADIG11_max "FPrm_switches(263)" VALUE 0x001C71E8 /* @ECU_Address@FPrm_switches@0x021B920E@ */ ECIPP_ALIGNMENT_UWORD 65535 Compu_IDENTITY 0 65535 PHYS_UNIT "Enable bits" /end CHARACTERISTIC
/begin CHARACTERISTIC FPsw_ADIG11_min "FPrm_switches(264)" VALUE 0x001C71EA /* @ECU_Address@FPrm_switches@0x021B9210@ */ ECIPP_ALIGNMENT_UWORD 65535 Compu_IDENTITY 0 65535 PHYS_UNIT "Enable bits" /end CHARACTERISTIC
/begin CHARACTERISTIC FPsw_ADIG12_max "FPrm_switches(265)" VALUE 0x001C71EC /* @ECU_Address@FPrm_switches@0x021B9212@ */ ECIPP_ALIGNMENT_UWORD 65535 Compu_IDENTITY 0 65535 PHYS_UNIT "Enable bits" /end CHARACTERISTIC
/begin CHARACTERISTIC FPsw_ADIG12_min "FPrm_switches(266)" VALUE 0x001C71EE /* @ECU_Address@FPrm_switches@0x021B9214@ */ ECIPP_ALIGNMENT_UWORD 65535 Compu_IDENTITY 0 65535 PHYS_UNIT "Enable bits" /end CHARACTERISTIC
/begin CHARACTERISTIC FPsw_ADIG13_max "FPrm_switches(302)" VALUE 0x001C7236 /* @ECU_Address@FPrm_switches@0x021B925C@ */ ECIPP_ALIGNMENT_UWORD 65535 Compu_IDENTITY 0 65535 PHYS_UNIT "Enable bits" /end CHARACTERISTIC
/begin CHARACTERISTIC FPsw_ADIG13_min "FPrm_switches(303)" VALUE 0x001C7238 /* @ECU_Address@FPrm_switches@0x021B925E@ */ ECIPP_ALIGNMENT_UWORD 65535 Compu_IDENTITY 0 65535 PHYS_UNIT "Enable bits" /end CHARACTERISTIC
/begin CHARACTERISTIC FPsw_ADIG14_max "FPrm_switches(304)" VALUE 0x001C723A /* @ECU_Address@FPrm_switches@0x021B9260@ */ ECIPP_ALIGNMENT_UWORD 65535 Compu_IDENTITY 0 65535 PHYS_UNIT "Enable bits" /end CHARACTERISTIC
/begin CHARACTERISTIC FPsw_ADIG14_min "FPrm_switches(305)" VALUE 0x001C723C /* @ECU_Address@FPrm_switches@0x021B9262@ */ ECIPP_ALIGNMENT_UWORD 65535 Compu_IDENTITY 0 65535 PHYS_UNIT "Enable bits" /end CHARACTERISTIC
/begin CHARACTERISTIC FPsw_ADIG15_max "FPrm_switches(306)" VALUE 0x001C723E /* @ECU_Address@FPrm_switches@0x021B9264@ */ ECIPP_ALIGNMENT_UWORD 65535 Compu_IDENTITY 0 65535 PHYS_UNIT "Enable bits" /end CHARACTERISTIC
/begin CHARACTERISTIC FPsw_ADIG15_min "FPrm_switches(307)" VALUE 0x001C7240 /* @ECU_Address@FPrm_switches@0x021B9266@ */ ECIPP_ALIGNMENT_UWORD 65535 Compu_IDENTITY 0 65535 PHYS_UNIT "Enable bits" /end CHARACTERISTIC
/begin CHARACTERISTIC FPsw_ADIG16_max "FPrm_switches(308)" VALUE 0x001C7242 /* @ECU_Address@FPrm_switches@0x021B9268@ */ ECIPP_ALIGNMENT_UWORD 65535 Compu_IDENTITY 0 65535 PHYS_UNIT "Enable bits" /end CHARACTERISTIC
/begin CHARACTERISTIC FPsw_ADIG16_min "FPrm_switches(309)" VALUE 0x001C7244 /* @ECU_Address@FPrm_switches@0x021B926A@ */ ECIPP_ALIGNMENT_UWORD 65535 Compu_IDENTITY 0 65535 PHYS_UNIT "Enable bits" /end CHARACTERISTIC
/begin CHARACTERISTIC FPsw_ADIG17_max "FPrm_switches(310)" VALUE 0x001C7246 /* @ECU_Address@FPrm_switches@0x021B926C@ */ ECIPP_ALIGNMENT_UWORD 65535 Compu_IDENTITY 0 65535 PHYS_UNIT "Enable bits" /end CHARACTERISTIC
/begin CHARACTERISTIC FPsw_ADIG17_min "FPrm_switches(311)" VALUE 0x001C7248 /* @ECU_Address@FPrm_switches@0x021B926E@ */ ECIPP_ALIGNMENT_UWORD 65535 Compu_IDENTITY 0 65535 PHYS_UNIT "Enable bits" /end CHARACTERISTIC
/begin CHARACTERISTIC FPsw_ADIG18_max "FPrm_switches(312)" VALUE 0x001C724A /* @ECU_Address@FPrm_switches@0x021B9270@ */ ECIPP_ALIGNMENT_UWORD 65535 Compu_IDENTITY 0 65535 PHYS_UNIT "Enable bits" /end CHARACTERISTIC
/begin CHARACTERISTIC FPsw_ADIG18_min "FPrm_switches(313)" VALUE 0x001C724C /* @ECU_Address@FPrm_switches@0x021B9272@ */ ECIPP_ALIGNMENT_UWORD 65535 Compu_IDENTITY 0 65535 PHYS_UNIT "Enable bits" /end CHARACTERISTIC
/begin CHARACTERISTIC FPsw_ADIG19_max "FPrm_switches(314)" VALUE 0x001C724E /* @ECU_Address@FPrm_switches@0x021B9274@ */ ECIPP_ALIGNMENT_UWORD 65535 Compu_IDENTITY 0 65535 PHYS_UNIT "Enable bits" /end CHARACTERISTIC
/begin CHARACTERISTIC FPsw_ADIG19_min "FPrm_switches(315)" VALUE 0x001C7250 /* @ECU_Address@FPrm_switches@0x021B9276@ */ ECIPP_ALIGNMENT_UWORD 65535 Compu_IDENTITY 0 65535 PHYS_UNIT "Enable bits" /end CHARACTERISTIC
/begin CHARACTERISTIC FPsw_ADIG2_max "FPrm_switches(167)" VALUE 0x001C7128 /* @ECU_Address@FPrm_switches@0x021B914E@ */ ECIPP_ALIGNMENT_UWORD 65535 Compu_IDENTITY 0 65535 PHYS_UNIT "Enable bits" /end CHARACTERISTIC
/begin CHARACTERISTIC FPsw_ADIG2_min "FPrm_switches(168)" VALUE 0x001C712A /* @ECU_Address@FPrm_switches@0x021B9150@ */ ECIPP_ALIGNMENT_UWORD 65535 Compu_IDENTITY 0 65535 PHYS_UNIT "Enable bits" /end CHARACTERISTIC
/begin CHARACTERISTIC FPsw_ADIG20_max "FPrm_switches(438)" VALUE 0x001C7346 /* @ECU_Address@FPrm_switches@0x021B936C@ */ ECIPP_ALIGNMENT_UWORD 65535 Compu_IDENTITY 0 65535 PHYS_UNIT "Enable bits" /end CHARACTERISTIC
/begin CHARACTERISTIC FPsw_ADIG20_min "FPrm_switches(439)" VALUE 0x001C7348 /* @ECU_Address@FPrm_switches@0x021B936E@ */ ECIPP_ALIGNMENT_UWORD 65535 Compu_IDENTITY 0 65535 PHYS_UNIT "Enable bits" /end CHARACTERISTIC
/begin CHARACTERISTIC FPsw_ADIG21_max "FPrm_switches(440)" VALUE 0x001C734A /* @ECU_Address@FPrm_switches@0x021B9370@ */ ECIPP_ALIGNMENT_UWORD 65535 Compu_IDENTITY 0 65535 PHYS_UNIT "Enable bits" /end CHARACTERISTIC
/begin CHARACTERISTIC FPsw_ADIG21_min "FPrm_switches(441)" VALUE 0x001C734C /* @ECU_Address@FPrm_switches@0x021B9372@ */ ECIPP_ALIGNMENT_UWORD 65535 Compu_IDENTITY 0 65535 PHYS_UNIT "Enable bits" /end CHARACTERISTIC
/begin CHARACTERISTIC FPsw_ADIG22_max "FPrm_switches(442)" VALUE 0x001C734E /* @ECU_Address@FPrm_switches@0x021B9374@ */ ECIPP_ALIGNMENT_UWORD 65535 Compu_IDENTITY 0 65535 PHYS_UNIT "Enable bits" /end CHARACTERISTIC
/begin CHARACTERISTIC FPsw_ext1_accel_x_max "FPrm_switches_ext1(532)" VALUE 0x001C79A6 /* @ECU_Address@FPrm_switches_ext1@0x023A5428@ */ ECIPP_ALIGNMENT_UWORD 65535 Compu_IDENTITY 0 65535 PHYS_UNIT "Enable bits" /end CHARACTERISTIC
/begin CHARACTERISTIC FPsw_ext1_accel_x_min "FPrm_switches_ext1(533)" VALUE 0x001C79A8 /* @ECU_Address@FPrm_switches_ext1@0x023A542A@ */ ECIPP_ALIGNMENT_UWORD 65535 Compu_IDENTITY 0 65535 PHYS_UNIT "Enable bits" /end CHARACTERISTIC
/begin CHARACTERISTIC FPsw_ext1_accel_y_max "FPrm_switches_ext1(534)" VALUE 0x001C79AA /* @ECU_Address@FPrm_switches_ext1@0x023A542C@ */ ECIPP_ALIGNMENT_UWORD 65535 Compu_IDENTITY 0 65535 PHYS_UNIT "Enable bits" /end CHARACTERISTIC
/begin CHARACTERISTIC FPsw_ext1_accel_y_min "FPrm_switches_ext1(535)" VALUE 0x001C79AC /* @ECU_Address@FPrm_switches_ext1@0x023A542E@ */ ECIPP_ALIGNMENT_UWORD 65535 Compu_IDENTITY 0 65535 PHYS_UNIT "Enable bits" /end CHARACTERISTIC
/begin CHARACTERISTIC FPsw_ext1_accel_z_max "FPrm_switches_ext1(536)" VALUE 0x001C79AE /* @ECU_Address@FPrm_switches_ext1@0x023A5430@ */ ECIPP_ALIGNMENT_UWORD 65535 Compu_IDENTITY 0 65535 PHYS_UNIT "Enable bits" /end CHARACTERISTIC
/begin CHARACTERISTIC FPsw_ext1_accel_z_min "FPrm_switches_ext1(537)" VALUE 0x001C79B0 /* @ECU_Address@FPrm_switches_ext1@0x023A5432@ */ ECIPP_ALIGNMENT_UWORD 65535 Compu_IDENTITY 0 65535 PHYS_UNIT "Enable bits" /end CHARACTERISTIC
/begin CHARACTERISTIC FPsw_ext1_ACLT_intTlim_OOA "FPrm_switches_ext1(695)" VALUE 0x001C7AEC /* @ECU_Address@FPrm_switches_ext1@0x023A556E@ */ ECIPP_ALIGNMENT_UWORD 65535 Compu_IDENTITY 0 65535 PHYS_UNIT "Enable bits" /end CHARACTERISTIC
/begin CHARACTERISTIC FPsw_ext1_ACT_hi "FPrm_switches_ext1(689)" VALUE 0x001C7AE0 /* @ECU_Address@FPrm_switches_ext1@0x023A5562@ */ ECIPP_ALIGNMENT_UWORD 65535 Compu_IDENTITY 0 65535 PHYS_UNIT "Enable bits" /end CHARACTERISTIC
/begin CHARACTERISTIC FPsw_ext1_ADIG1_max "FPrm_switches_ext1(165)" VALUE 0x001C76C8 /* @ECU_Address@FPrm_switches_ext1@0x023A514A@ */ ECIPP_ALIGNMENT_UWORD 65535 Compu_IDENTITY 0 65535 PHYS_UNIT "Enable bits" /end CHARACTERISTIC
/begin CHARACTERISTIC FPsw_ext1_ADIG1_min "FPrm_switches_ext1(166)" VALUE 0x001C76CA /* @ECU_Address@FPrm_switches_ext1@0x023A514C@ */ ECIPP_ALIGNMENT_UWORD 65535 Compu_IDENTITY 0 65535 PHYS_UNIT "Enable bits" /end CHARACTERISTIC
/begin CHARACTERISTIC FPsw_ext1_ADIG10_max "FPrm_switches_ext1(258)" VALUE 0x001C7782 /* @ECU_Address@FPrm_switches_ext1@0x023A5204@ */ ECIPP_ALIGNMENT_UWORD 65535 Compu_IDENTITY 0 65535 PHYS_UNIT "Enable bits" /end CHARACTERISTIC
/begin CHARACTERISTIC FPsw_ext1_ADIG10_min "FPrm_switches_ext1(259)" VALUE 0x001C7784 /* @ECU_Address@FPrm_switches_ext1@0x023A5206@ */ ECIPP_ALIGNMENT_UWORD 65535 Compu_IDENTITY 0 65535 PHYS_UNIT "Enable bits" /end CHARACTERISTIC
/begin CHARACTERISTIC FPsw_ext1_ADIG11_max "FPrm_switches_ext1(263)" VALUE 0x001C778C /* @ECU_Address@FPrm_switches_ext1@0x023A520E@ */ ECIPP_ALIGNMENT_UWORD 65535 Compu_IDENTITY 0 65535 PHYS_UNIT "Enable bits" /end CHARACTERISTIC
/begin CHARACTERISTIC FPsw_ext1_ADIG11_min "FPrm_switches_ext1(264)" VALUE 0x001C778E /* @ECU_Address@FPrm_switches_ext1@0x023A5210@ */ ECIPP_ALIGNMENT_UWORD 65535 Compu_IDENTITY 0 65535 PHYS_UNIT "Enable bits" /end CHARACTERISTIC
/begin CHARACTERISTIC FPsw_ext1_ADIG12_max "FPrm_switches_ext1(265)" VALUE 0x001C7790 /* @ECU_Address@FPrm_switches_ext1@0x023A5212@ */ ECIPP_ALIGNMENT_UWORD 65535 Compu_IDENTITY 0 65535 PHYS_UNIT "Enable bits" /end CHARACTERISTIC
/begin CHARACTERISTIC FPsw_ext1_ADIG12_min "FPrm_switches_ext1(266)" VALUE 0x001C7792 /* @ECU_Address@FPrm_switches_ext1@0x023A5214@ */ ECIPP_ALIGNMENT_UWORD 65535 Compu_IDENTITY 0 65535 PHYS_UNIT "Enable bits" /end CHARACTERISTIC
/begin CHARACTERISTIC FPsw_ext1_ADIG13_max "FPrm_switches_ext1(302)" VALUE 0x001C77DA /* @ECU_Address@FPrm_switches_ext1@0x023A525C@ */ ECIPP_ALIGNMENT_UWORD 65535 Compu_IDENTITY 0 65535 PHYS_UNIT "Enable bits" /end CHARACTERISTIC
/begin CHARACTERISTIC FPsw_ext1_ADIG13_min "FPrm_switches_ext1(303)" VALUE 0x001C77DC /* @ECU_Address@FPrm_switches_ext1@0x023A525E@ */ ECIPP_ALIGNMENT_UWORD 65535 Compu_IDENTITY 0 65535 PHYS_UNIT "Enable bits" /end CHARACTERISTIC
/begin CHARACTERISTIC FPsw_ext1_ADIG14_max "FPrm_switches_ext1(304)" VALUE 0x001C77DE /* @ECU_Address@FPrm_switches_ext1@0x023A5260@ */ ECIPP_ALIGNMENT_UWORD 65535 Compu_IDENTITY 0 65535 PHYS_UNIT "Enable bits" /end CHARACTERISTIC
/begin CHARACTERISTIC FPsw_ext1_ADIG14_min "FPrm_switches_ext1(305)" VALUE 0x001C77E0 /* @ECU_Address@FPrm_switches_ext1@0x023A5262@ */ ECIPP_ALIGNMENT_UWORD 65535 Compu_IDENTITY 0 65535 PHYS_UNIT "Enable bits" /end CHARACTERISTIC
/begin CHARACTERISTIC FPsw_ext1_ADIG15_max "FPrm_switches_ext1(306)" VALUE 0x001C77E2 /* @ECU_Address@FPrm_switches_ext1@0x023A5264@ */ ECIPP_ALIGNMENT_UWORD 65535 Compu_IDENTITY 0 65535 PHYS_UNIT "Enable bits" /end CHARACTERISTIC
/begin CHARACTERISTIC FPsw_ext1_ADIG15_min "FPrm_switches_ext1(307)" VALUE 0x001C77E4 /* @ECU_Address@FPrm_switches_ext1@0x023A5266@ */ ECIPP_ALIGNMENT_UWORD 65535 Compu_IDENTITY 0 65535 PHYS_UNIT "Enable bits" /end CHARACTERISTIC
/begin CHARACTERISTIC FPsw_ext1_ADIG16_max "FPrm_switches_ext1(308)" VALUE 0x001C77E6 /* @ECU_Address@FPrm_switches_ext1@0x023A5268@ */ ECIPP_ALIGNMENT_UWORD 65535 Compu_IDENTITY 0 65535 PHYS_UNIT "Enable bits" /end CHARACTERISTIC
/begin CHARACTERISTIC FPsw_ext1_ADIG16_min "FPrm_switches_ext1(309)" VALUE 0x001C77E8 /* @ECU_Address@FPrm_switches_ext1@0x023A526A@ */ ECIPP_ALIGNMENT_UWORD 65535 Compu_IDENTITY 0 65535 PHYS_UNIT "Enable bits" /end CHARACTERISTIC
/begin CHARACTERISTIC FPsw_ext1_ADIG17_max "FPrm_switches_ext1(310)" VALUE 0x001C77EA /* @ECU_Address@FPrm_switches_ext1@0x023A526C@ */ ECIPP_ALIGNMENT_UWORD 65535 Compu_IDENTITY 0 65535 PHYS_UNIT "Enable bits" /end CHARACTERISTIC
/begin CHARACTERISTIC FPsw_ext1_ADIG17_min "FPrm_switches_ext1(311)" VALUE 0x001C77EC /* @ECU_Address@FPrm_switches_ext1@0x023A526E@ */ ECIPP_ALIGNMENT_UWORD 65535 Compu_IDENTITY 0 65535 PHYS_UNIT "Enable bits" /end CHARACTERISTIC
/begin CHARACTERISTIC FPsw_ext1_ADIG18_max "FPrm_switches_ext1(312)" VALUE 0x001C77EE /* @ECU_Address@FPrm_switches_ext1@0x023A5270@ */ ECIPP_ALIGNMENT_UWORD 65535 Compu_IDENTITY 0 65535 PHYS_UNIT "Enable bits" /end CHARACTERISTIC
/begin CHARACTERISTIC FPsw_ext1_ADIG18_min "FPrm_switches_ext1(313)" VALUE 0x001C77F0 /* @ECU_Address@FPrm_switches_ext1@0x023A5272@ */ ECIPP_ALIGNMENT_UWORD 65535 Compu_IDENTITY 0 65535 PHYS_UNIT "Enable bits" /end CHARACTERISTIC
/begin CHARACTERISTIC FPsw_ext1_ADIG19_max "FPrm_switches_ext1(314)" VALUE 0x001C77F2 /* @ECU_Address@FPrm_switches_ext1@0x023A5274@ */ ECIPP_ALIGNMENT_UWORD 65535 Compu_IDENTITY 0 65535 PHYS_UNIT "Enable bits" /end CHARACTERISTIC
/begin CHARACTERISTIC FPsw_ext1_ADIG19_min "FPrm_switches_ext1(315)" VALUE 0x001C77F4 /* @ECU_Address@FPrm_switches_ext1@0x023A5276@ */ ECIPP_ALIGNMENT_UWORD 65535 Compu_IDENTITY 0 65535 PHYS_UNIT "Enable bits" /end CHARACTERISTIC
/begin CHARACTERISTIC FPsw_ext1_ADIG2_max "FPrm_switches_ext1(167)" VALUE 0x001C76CC /* @ECU_Address@FPrm_switches_ext1@0x023A514E@ */ ECIPP_ALIGNMENT_UWORD 65535 Compu_IDENTITY 0 65535 PHYS_UNIT "Enable bits" /end CHARACTERISTIC
/begin CHARACTERISTIC FPsw_ext1_ADIG2_min "FPrm_switches_ext1(168)" VALUE 0x001C76CE /* @ECU_Address@FPrm_switches_ext1@0x023A5150@ */ ECIPP_ALIGNMENT_UWORD 65535 Compu_IDENTITY 0 65535 PHYS_UNIT "Enable bits" /end CHARACTERISTIC
/begin CHARACTERISTIC FPsw_ext1_ADIG20_max "FPrm_switches_ext1(438)" VALUE 0x001C78EA /* @ECU_Address@FPrm_switches_ext1@0x023A536C@ */ ECIPP_ALIGNMENT_UWORD 65535 Compu_IDENTITY 0 65535 PHYS_UNIT "Enable bits" /end CHARACTERISTIC
/begin CHARACTERISTIC FPsw_ext1_ADIG20_min "FPrm_switches_ext1(439)" VALUE 0x001C78EC /* @ECU_Address@FPrm_switches_ext1@0x023A536E@ */ ECIPP_ALIGNMENT_UWORD 65535 Compu_IDENTITY 0 65535 PHYS_UNIT "Enable bits" /end CHARACTERISTIC
/begin CHARACTERISTIC FPsw_ext1_ADIG21_max "FPrm_switches_ext1(440)" VALUE 0x001C78EE /* @ECU_Address@FPrm_switches_ext1@0x023A5370@ */ ECIPP_ALIGNMENT_UWORD 65535 Compu_IDENTITY 0 65535 PHYS_UNIT "Enable bits" /end CHARACTERISTIC
/begin CHARACTERISTIC FPsw_ext1_ADIG21_min "FPrm_switches_ext1(441)" VALUE 0x001C78F0 /* @ECU_Address@FPrm_switches_ext1@0x023A5372@ */ ECIPP_ALIGNMENT_UWORD 65535 Compu_IDENTITY 0 65535 PHYS_UNIT "Enable bits" /end CHARACTERISTIC
/begin CHARACTERISTIC FPsw_ext1_ADIG22_max "FPrm_switches_ext1(442)" VALUE 0x001C78F2 /* @ECU_Address@FPrm_switches_ext1@0x023A5374@ */ ECIPP_ALIGNMENT_UWORD 65535 Compu_IDENTITY 0 65535 PHYS_UNIT "Enable bits" /end CHARACTERISTIC
/begin CHARACTERISTIC FCdtc_accel_x_max "FCtl_DTC(702)" VALUE 0x001E3DE6 /* @ECU_Address@FCtl_DTC@0x021B557C@ */ ECIPP_ALIGNMENT_UWORD 65535 Compu_IDENTITY 0 65535 PHYS_UNIT "DTC" /end CHARACTERISTIC
/begin CHARACTERISTIC FCdtc_accel_x_min "FCtl_DTC(703)" VALUE 0x001E3DE8 /* @ECU_Address@FCtl_DTC@0x021B557E@ */ ECIPP_ALIGNMENT_UWORD 65535 Compu_IDENTITY 0 65535 PHYS_UNIT "DTC" /end CHARACTERISTIC
/begin CHARACTERISTIC FCdtc_accel_y_max "FCtl_DTC(704)" VALUE 0x001E3DEA /* @ECU_Address@FCtl_DTC@0x021B5580@ */ ECIPP_ALIGNMENT_UWORD 65535 Compu_IDENTITY 0 65535 PHYS_UNIT "DTC" /end CHARACTERISTIC
/begin CHARACTERISTIC FCdtc_accel_y_min "FCtl_DTC(705)" VALUE 0x001E3DEC /* @ECU_Address@FCtl_DTC@0x021B5582@ */ ECIPP_ALIGNMENT_UWORD 65535 Compu_IDENTITY 0 65535 PHYS_UNIT "DTC" /end CHARACTERISTIC
/begin CHARACTERISTIC FCdtc_accel_z_max "FCtl_DTC(706)" VALUE 0x001E3DEE /* @ECU_Address@FCtl_DTC@0x021B5584@ */ ECIPP_ALIGNMENT_UWORD 65535 Compu_IDENTITY 0 65535 PHYS_UNIT "DTC" /end CHARACTERISTIC
/begin CHARACTERISTIC FCdtc_accel_z_min "FCtl_DTC(707)" VALUE 0x001E3DF0 /* @ECU_Address@FCtl_DTC@0x021B5586@ */ ECIPP_ALIGNMENT_UWORD 65535 Compu_IDENTITY 0 65535 PHYS_UNIT "DTC" /end CHARACTERISTIC
/begin CHARACTERISTIC FCdtc_ACLT_intTlim_OOA "FCtl_DTC(868)" VALUE 0x001E3F32 /* @ECU_Address@FCtl_DTC@0x021B56C8@ */ ECIPP_ALIGNMENT_UWORD 65535 Compu_IDENTITY 0 65535 PHYS_UNIT "DTC" /end CHARACTERISTIC
/begin CHARACTERISTIC FCdtc_ACT_hi "FCtl_DTC(862)" VALUE 0x001E3F26 /* @ECU_Address@FCtl_DTC@0x021B56BC@ */ ECIPP_ALIGNMENT_UWORD 65535 Compu_IDENTITY 0 65535 PHYS_UNIT "DTC" /end CHARACTERISTIC
/begin CHARACTERISTIC FCdtc_ADIG1_max "FCtl_DTC(209)" VALUE 0x001E3A0C /* @ECU_Address@FCtl_DTC@0x021B51A2@ */ ECIPP_ALIGNMENT_UWORD 65535 Compu_IDENTITY 0 65535 PHYS_UNIT "DTC" /end CHARACTERISTIC
/begin CHARACTERISTIC FCdtc_ADIG1_min "FCtl_DTC(210)" VALUE 0x001E3A0E /* @ECU_Address@FCtl_DTC@0x021B51A4@ */ ECIPP_ALIGNMENT_UWORD 65535 Compu_IDENTITY 0 65535 PHYS_UNIT "DTC" /end CHARACTERISTIC
/begin CHARACTERISTIC FCdtc_ADIG10_max "FCtl_DTC(349)" VALUE 0x001E3B24 /* @ECU_Address@FCtl_DTC@0x021B52BA@ */ ECIPP_ALIGNMENT_UWORD 65535 Compu_IDENTITY 0 65535 PHYS_UNIT "DTC" /end CHARACTERISTIC
/begin CHARACTERISTIC FCdtc_ADIG10_min "FCtl_DTC(350)" VALUE 0x001E3B26 /* @ECU_Address@FCtl_DTC@0x021B52BC@ */ ECIPP_ALIGNMENT_UWORD 65535 Compu_IDENTITY 0 65535 PHYS_UNIT "DTC" /end CHARACTERISTIC
/begin CHARACTERISTIC FCdtc_ADIG11_max "FCtl_DTC(354)" VALUE 0x001E3B2E /* @ECU_Address@FCtl_DTC@0x021B52C4@ */ ECIPP_ALIGNMENT_UWORD 65535 Compu_IDENTITY 0 65535 PHYS_UNIT "DTC" /end CHARACTERISTIC
/begin CHARACTERISTIC FCdtc_ADIG11_min "FCtl_DTC(355)" VALUE 0x001E3B30 /* @ECU_Address@FCtl_DTC@0x021B52C6@ */ ECIPP_ALIGNMENT_UWORD 65535 Compu_IDENTITY 0 65535 PHYS_UNIT "DTC" /end CHARACTERISTIC
/begin CHARACTERISTIC FCdtc_ADIG12_max "FCtl_DTC(356)" VALUE 0x001E3B32 /* @ECU_Address@FCtl_DTC@0x021B52C8@ */ ECIPP_ALIGNMENT_UWORD 65535 Compu_IDENTITY 0 65535 PHYS_UNIT "DTC" /end CHARACTERISTIC
/begin CHARACTERISTIC FCdtc_ADIG12_min "FCtl_DTC(357)" VALUE 0x001E3B34 /* @ECU_Address@FCtl_DTC@0x021B52CA@ */ ECIPP_ALIGNMENT_UWORD 65535 Compu_IDENTITY 0 65535 PHYS_UNIT "DTC" /end CHARACTERISTIC
/begin CHARACTERISTIC FCdtc_ADIG13_max "FCtl_DTC(393)" VALUE 0x001E3B7C /* @ECU_Address@FCtl_DTC@0x021B5312@ */ ECIPP_ALIGNMENT_UWORD 65535 Compu_IDENTITY 0 65535 PHYS_UNIT "DTC" /end CHARACTERISTIC
/begin CHARACTERISTIC FCdtc_ADIG13_min "FCtl_DTC(394)" VALUE 0x001E3B7E /* @ECU_Address@FCtl_DTC@0x021B5314@ */ ECIPP_ALIGNMENT_UWORD 65535 Compu_IDENTITY 0 65535 PHYS_UNIT "DTC" /end CHARACTERISTIC
/begin CHARACTERISTIC FCdtc_ADIG14_max "FCtl_DTC(395)" VALUE 0x001E3B80 /* @ECU_Address@FCtl_DTC@0x021B5316@ */ ECIPP_ALIGNMENT_UWORD 65535 Compu_IDENTITY 0 65535 PHYS_UNIT "DTC" /end CHARACTERISTIC
/begin CHARACTERISTIC FCdtc_ADIG14_min "FCtl_DTC(396)" VALUE 0x001E3B82 /* @ECU_Address@FCtl_DTC@0x021B5318@ */ ECIPP_ALIGNMENT_UWORD 65535 Compu_IDENTITY 0 65535 PHYS_UNIT "DTC" /end CHARACTERISTIC
/begin CHARACTERISTIC FCdtc_ADIG15_max "FCtl_DTC(397)" VALUE 0x001E3B84 /* @ECU_Address@FCtl_DTC@0x021B531A@ */ ECIPP_ALIGNMENT_UWORD 65535 Compu_IDENTITY 0 65535 PHYS_UNIT "DTC" /end CHARACTERISTIC
/begin CHARACTERISTIC FCdtc_ADIG15_min "FCtl_DTC(398)" VALUE 0x001E3B86 /* @ECU_Address@FCtl_DTC@0x021B531C@ */ ECIPP_ALIGNMENT_UWORD 65535 Compu_IDENTITY 0 65535 PHYS_UNIT "DTC" /end CHARACTERISTIC
/begin CHARACTERISTIC FCdtc_ADIG16_max "FCtl_DTC(399)" VALUE 0x001E3B88 /* @ECU_Address@FCtl_DTC@0x021B531E@ */ ECIPP_ALIGNMENT_UWORD 65535 Compu_IDENTITY 0 65535 PHYS_UNIT "DTC" /end CHARACTERISTIC
/begin CHARACTERISTIC FCdtc_ADIG16_min "FCtl_DTC(400)" VALUE 0x001E3B8A /* @ECU_Address@FCtl_DTC@0x021B5320@ */ ECIPP_ALIGNMENT_UWORD 65535 Compu_IDENTITY 0 65535 PHYS_UNIT "DTC" /end CHARACTERISTIC
/begin CHARACTERISTIC FCdtc_ADIG17_max "FCtl_DTC(401)" VALUE 0x001E3B8C /* @ECU_Address@FCtl_DTC@0x021B5322@ */ ECIPP_ALIGNMENT_UWORD 65535 Compu_IDENTITY 0 65535 PHYS_UNIT "DTC" /end CHARACTERISTIC
/begin CHARACTERISTIC FCdtc_ADIG17_min "FCtl_DTC(402)" VALUE 0x001E3B8E /* @ECU_Address@FCtl_DTC@0x021B5324@ */ ECIPP_ALIGNMENT_UWORD 65535 Compu_IDENTITY 0 65535 PHYS_UNIT "DTC" /end CHARACTERISTIC
/begin CHARACTERISTIC FCdtc_ADIG18_max "FCtl_DTC(403)" VALUE 0x001E3B90 /* @ECU_Address@FCtl_DTC@0x021B5326@ */ ECIPP_ALIGNMENT_UWORD 65535 Compu_IDENTITY 0 65535 PHYS_UNIT "DTC" /end CHARACTERISTIC
/begin CHARACTERISTIC FCdtc_ADIG18_min "FCtl_DTC(404)" VALUE 0x001E3B92 /* @ECU_Address@FCtl_DTC@0x021B5328@ */ ECIPP_ALIGNMENT_UWORD 65535 Compu_IDENTITY 0 65535 PHYS_UNIT "DTC" /end CHARACTERISTIC
/begin CHARACTERISTIC FCdtc_ADIG19_max "FCtl_DTC(405)" VALUE 0x001E3B94 /* @ECU_Address@FCtl_DTC@0x021B532A@ */ ECIPP_ALIGNMENT_UWORD 65535 Compu_IDENTITY 0 65535 PHYS_UNIT "DTC" /end CHARACTERISTIC
/begin CHARACTERISTIC FCdtc_ADIG19_min "FCtl_DTC(406)" VALUE 0x001E3B96 /* @ECU_Address@FCtl_DTC@0x021B532C@ */ ECIPP_ALIGNMENT_UWORD 65535 Compu_IDENTITY 0 65535 PHYS_UNIT "DTC" /end CHARACTERISTIC
/begin CHARACTERISTIC FCdtc_ADIG2_max "FCtl_DTC(211)" VALUE 0x001E3A10 /* @ECU_Address@FCtl_DTC@0x021B51A6@ */ ECIPP_ALIGNMENT_UWORD 65535 Compu_IDENTITY 0 65535 PHYS_UNIT "DTC" /end CHARACTERISTIC
/begin CHARACTERISTIC FCdtc_ADIG2_min "FCtl_DTC(212)" VALUE 0x001E3A12 /* @ECU_Address@FCtl_DTC@0x021B51A8@ */ ECIPP_ALIGNMENT_UWORD 65535 Compu_IDENTITY 0 65535 PHYS_UNIT "DTC" /end CHARACTERISTIC
/begin CHARACTERISTIC FCdtc_ADIG20_max "FCtl_DTC(584)" VALUE 0x001E3CFA /* @ECU_Address@FCtl_DTC@0x021B5490@ */ ECIPP_ALIGNMENT_UWORD 65535 Compu_IDENTITY 0 65535 PHYS_UNIT "DTC" /end CHARACTERISTIC
/begin CHARACTERISTIC FCdtc_ADIG20_min "FCtl_DTC(585)" VALUE 0x001E3CFC /* @ECU_Address@FCtl_DTC@0x021B5492@ */ ECIPP_ALIGNMENT_UWORD 65535 Compu_IDENTITY 0 65535 PHYS_UNIT "DTC" /end CHARACTERISTIC
/begin CHARACTERISTIC FCdtc_ADIG21_max "FCtl_DTC(586)" VALUE 0x001E3CFE /* @ECU_Address@FCtl_DTC@0x021B5494@ */ ECIPP_ALIGNMENT_UWORD 65535 Compu_IDENTITY 0 65535 PHYS_UNIT "DTC" /end CHARACTERISTIC
/begin CHARACTERISTIC FCdtc_ADIG21_min "FCtl_DTC(587)" VALUE 0x001E3D00 /* @ECU_Address@FCtl_DTC@0x021B5496@ */ ECIPP_ALIGNMENT_UWORD 65535 Compu_IDENTITY 0 65535 PHYS_UNIT "DTC" /end CHARACTERISTIC
/begin CHARACTERISTIC FCdtc_ADIG22_max "FCtl_DTC(588)" VALUE 0x001E3D02 /* @ECU_Address@FCtl_DTC@0x021B5498@ */ ECIPP_ALIGNMENT_UWORD 65535 Compu_IDENTITY 0 65535 PHYS_UNIT "DTC" /end CHARACTERISTIC
/begin CHARACTERISTIC FCfmi_accel_x_max "FCtl_FMI(702)" VALUE 0x001E5BBF /* @ECU_Address@FCtl_FMI@0x021B72BE@ */ ECIPP_ALIGNMENT_UBYTE 255 Compu_IDENTITY 0 255 PHYS_UNIT "FMI" /end CHARACTERISTIC
/begin CHARACTERISTIC FCfmi_accel_x_min "FCtl_FMI(703)" VALUE 0x001E5BC0 /* @ECU_Address@FCtl_FMI@0x021B72BF@ */ ECIPP_ALIGNMENT_UBYTE 255 Compu_IDENTITY 0 255 PHYS_UNIT "FMI" /end CHARACTERISTIC
/begin CHARACTERISTIC FCfmi_accel_y_max "FCtl_FMI(704)" VALUE 0x001E5BC1 /* @ECU_Address@FCtl_FMI@0x021B72C0@ */ ECIPP_ALIGNMENT_UBYTE 255 Compu_IDENTITY 0 255 PHYS_UNIT "FMI" /end CHARACTERISTIC
/begin CHARACTERISTIC FCfmi_accel_y_min "FCtl_FMI(705)" VALUE 0x001E5BC2 /* @ECU_Address@FCtl_FMI@0x021B72C1@ */ ECIPP_ALIGNMENT_UBYTE 255 Compu_IDENTITY 0 255 PHYS_UNIT "FMI" /end CHARACTERISTIC
/begin CHARACTERISTIC FCfmi_accel_z_max "FCtl_FMI(706)" VALUE 0x001E5BC3 /* @ECU_Address@FCtl_FMI@0x021B72C2@ */ ECIPP_ALIGNMENT_UBYTE 255 Compu_IDENTITY 0 255 PHYS_UNIT "FMI" /end CHARACTERISTIC
/begin CHARACTERISTIC FCfmi_accel_z_min "FCtl_FMI(707)" VALUE 0x001E5BC4 /* @ECU_Address@FCtl_FMI@0x021B72C3@ */ ECIPP_ALIGNMENT_UBYTE 255 Compu_IDENTITY 0 255 PHYS_UNIT "FMI" /end CHARACTERISTIC
/begin CHARACTERISTIC FCfmi_ACLT_intTlim_OOA "FCtl_FMI(868)" VALUE 0x001E5C65 /* @ECU_Address@FCtl_FMI@0x021B7364@ */ ECIPP_ALIGNMENT_UBYTE 255 Compu_IDENTITY 0 255 PHYS_UNIT "FMI" /end CHARACTERISTIC
/begin CHARACTERISTIC FCfmi_ACT_hi "FCtl_FMI(862)" VALUE 0x001E5C5F /* @ECU_Address@FCtl_FMI@0x021B735E@ */ ECIPP_ALIGNMENT_UBYTE 255 Compu_IDENTITY 0 255 PHYS_UNIT "FMI" /end CHARACTERISTIC
/begin CHARACTERISTIC FCfmi_ADIG1_max "FCtl_FMI(209)" VALUE 0x001E59D2 /* @ECU_Address@FCtl_FMI@0x021B70D1@ */ ECIPP_ALIGNMENT_UBYTE 255 Compu_IDENTITY 0 255 PHYS_UNIT "FMI" /end CHARACTERISTIC
/begin CHARACTERISTIC FCfmi_ADIG1_min "FCtl_FMI(210)" VALUE 0x001E59D3 /* @ECU_Address@FCtl_FMI@0x021B70D2@ */ ECIPP_ALIGNMENT_UBYTE 255 Compu_IDENTITY 0 255 PHYS_UNIT "FMI" /end CHARACTERISTIC
/begin CHARACTERISTIC FCfmi_ADIG10_max "FCtl_FMI(349)" VALUE 0x001E5A5E /* @ECU_Address@FCtl_FMI@0x021B715D@ */ ECIPP_ALIGNMENT_UBYTE 255 Compu_IDENTITY 0 255 PHYS_UNIT "FMI" /end CHARACTERISTIC
/begin CHARACTERISTIC FCfmi_ADIG10_min "FCtl_FMI(350)" VALUE 0x001E5A5F /* @ECU_Address@FCtl_FMI@0x021B715E@ */ ECIPP_ALIGNMENT_UBYTE 255 Compu_IDENTITY 0 255 PHYS_UNIT "FMI" /end CHARACTERISTIC
/begin CHARACTERISTIC FCfmi_ADIG11_max "FCtl_FMI(354)" VALUE 0x001E5A63 /* @ECU_Address@FCtl_FMI@0x021B7162@ */ ECIPP_ALIGNMENT_UBYTE 255 Compu_IDENTITY 0 255 PHYS_UNIT "FMI" /end CHARACTERISTIC
/begin CHARACTERISTIC FCfmi_ADIG11_min "FCtl_FMI(355)" VALUE 0x001E5A64 /* @ECU_Address@FCtl_FMI@0x021B7163@ */ ECIPP_ALIGNMENT_UBYTE 255 Compu_IDENTITY 0 255 PHYS_UNIT "FMI" /end CHARACTERISTIC
/begin CHARACTERISTIC FCfmi_ADIG12_max "FCtl_FMI(356)" VALUE 0x001E5A65 /* @ECU_Address@FCtl_FMI@0x021B7164@ */ ECIPP_ALIGNMENT_UBYTE 255 Compu_IDENTITY 0 255 PHYS_UNIT "FMI" /end CHARACTERISTIC
/begin CHARACTERISTIC FCfmi_ADIG12_min "FCtl_FMI(357)" VALUE 0x001E5A66 /* @ECU_Address@FCtl_FMI@0x021B7165@ */ ECIPP_ALIGNMENT_UBYTE 255 Compu_IDENTITY 0 255 PHYS_UNIT "FMI" /end CHARACTERISTIC
/begin CHARACTERISTIC FCfmi_ADIG13_max "FCtl_FMI(393)" VALUE 0x001E5A8A /* @ECU_Address@FCtl_FMI@0x021B7189@ */ ECIPP_ALIGNMENT_UBYTE 255 Compu_IDENTITY 0 255 PHYS_UNIT "FMI" /end CHARACTERISTIC
/begin CHARACTERISTIC FCfmi_ADIG13_min "FCtl_FMI(394)" VALUE 0x001E5A8B /* @ECU_Address@FCtl_FMI@0x021B718A@ */ ECIPP_ALIGNMENT_UBYTE 255 Compu_IDENTITY 0 255 PHYS_UNIT "FMI" /end CHARACTERISTIC
/begin CHARACTERISTIC FCfmi_ADIG14_max "FCtl_FMI(395)" VALUE 0x001E5A8C /* @ECU_Address@FCtl_FMI@0x021B718B@ */ ECIPP_ALIGNMENT_UBYTE 255 Compu_IDENTITY 0 255 PHYS_UNIT "FMI" /end CHARACTERISTIC
/begin CHARACTERISTIC FCfmi_ADIG14_min "FCtl_FMI(396)" VALUE 0x001E5A8D /* @ECU_Address@FCtl_FMI@0x021B718C@ */ ECIPP_ALIGNMENT_UBYTE 255 Compu_IDENTITY 0 255 PHYS_UNIT "FMI" /end CHARACTERISTIC
/begin CHARACTERISTIC FCfmi_ADIG15_max "FCtl_FMI(397)" VALUE 0x001E5A8E /* @ECU_Address@FCtl_FMI@0x021B718D@ */ ECIPP_ALIGNMENT_UBYTE 255 Compu_IDENTITY 0 255 PHYS_UNIT "FMI" /end CHARACTERISTIC
/begin CHARACTERISTIC FCfmi_ADIG15_min "FCtl_FMI(398)" VALUE 0x001E5A8F /* @ECU_Address@FCtl_FMI@0x021B718E@ */ ECIPP_ALIGNMENT_UBYTE 255 Compu_IDENTITY 0 255 PHYS_UNIT "FMI" /end CHARACTERISTIC
/begin CHARACTERISTIC FCfmi_ADIG16_max "FCtl_FMI(399)" VALUE 0x001E5A90 /* @ECU_Address@FCtl_FMI@0x021B718F@ */ ECIPP_ALIGNMENT_UBYTE 255 Compu_IDENTITY 0 255 PHYS_UNIT "FMI" /end CHARACTERISTIC
/begin CHARACTERISTIC FCfmi_ADIG16_min "FCtl_FMI(400)" VALUE 0x001E5A91 /* @ECU_Address@FCtl_FMI@0x021B7190@ */ ECIPP_ALIGNMENT_UBYTE 255 Compu_IDENTITY 0 255 PHYS_UNIT "FMI" /end CHARACTERISTIC
/begin CHARACTERISTIC FCfmi_ADIG17_max "FCtl_FMI(401)" VALUE 0x001E5A92 /* @ECU_Address@FCtl_FMI@0x021B7191@ */ ECIPP_ALIGNMENT_UBYTE 255 Compu_IDENTITY 0 255 PHYS_UNIT "FMI" /end CHARACTERISTIC
/begin CHARACTERISTIC FCfmi_ADIG17_min "FCtl_FMI(402)" VALUE 0x001E5A93 /* @ECU_Address@FCtl_FMI@0x021B7192@ */ ECIPP_ALIGNMENT_UBYTE 255 Compu_IDENTITY 0 255 PHYS_UNIT "FMI" /end CHARACTERISTIC
/begin CHARACTERISTIC FCfmi_ADIG18_max "FCtl_FMI(403)" VALUE 0x001E5A94 /* @ECU_Address@FCtl_FMI@0x021B7193@ */ ECIPP_ALIGNMENT_UBYTE 255 Compu_IDENTITY 0 255 PHYS_UNIT "FMI" /end CHARACTERISTIC
/begin CHARACTERISTIC FCfmi_ADIG18_min "FCtl_FMI(404)" VALUE 0x001E5A95 /* @ECU_Address@FCtl_FMI@0x021B7194@ */ ECIPP_ALIGNMENT_UBYTE 255 Compu_IDENTITY 0 255 PHYS_UNIT "FMI" /end CHARACTERISTIC
/begin CHARACTERISTIC FCfmi_ADIG19_max "FCtl_FMI(405)" VALUE 0x001E5A96 /* @ECU_Address@FCtl_FMI@0x021B7195@ */ ECIPP_ALIGNMENT_UBYTE 255 Compu_IDENTITY 0 255 PHYS_UNIT "FMI" /end CHARACTERISTIC
/begin CHARACTERISTIC FCfmi_ADIG19_min "FCtl_FMI(406)" VALUE 0x001E5A97 /* @ECU_Address@FCtl_FMI@0x021B7196@ */ ECIPP_ALIGNMENT_UBYTE 255 Compu_IDENTITY 0 255 PHYS_UNIT "FMI" /end CHARACTERISTIC
/begin CHARACTERISTIC FCfmi_ADIG2_max "FCtl_FMI(211)" VALUE 0x001E59D4 /* @ECU_Address@FCtl_FMI@0x021B70D3@ */ ECIPP_ALIGNMENT_UBYTE 255 Compu_IDENTITY 0 255 PHYS_UNIT "FMI" /end CHARACTERISTIC
/begin CHARACTERISTIC FCfmi_ADIG2_min "FCtl_FMI(212)" VALUE 0x001E59D5 /* @ECU_Address@FCtl_FMI@0x021B70D4@ */ ECIPP_ALIGNMENT_UBYTE 255 Compu_IDENTITY 0 255 PHYS_UNIT "FMI" /end CHARACTERISTIC
/begin CHARACTERISTIC FCfmi_ADIG20_max "FCtl_FMI(584)" VALUE 0x001E5B49 /* @ECU_Address@FCtl_FMI@0x021B7248@ */ ECIPP_ALIGNMENT_UBYTE 255 Compu_IDENTITY 0 255 PHYS_UNIT "FMI" /end CHARACTERISTIC
/begin CHARACTERISTIC FCfmi_ADIG20_min "FCtl_FMI(585)" VALUE 0x001E5B4A /* @ECU_Address@FCtl_FMI@0x021B7249@ */ ECIPP_ALIGNMENT_UBYTE 255 Compu_IDENTITY 0 255 PHYS_UNIT "FMI" /end CHARACTERISTIC
/begin CHARACTERISTIC FCfmi_ADIG21_max "FCtl_FMI(586)" VALUE 0x001E5B4B /* @ECU_Address@FCtl_FMI@0x021B724A@ */ ECIPP_ALIGNMENT_UBYTE 255 Compu_IDENTITY 0 255 PHYS_UNIT "FMI" /end CHARACTERISTIC
/begin CHARACTERISTIC FCfmi_ADIG21_min "FCtl_FMI(587)" VALUE 0x001E5B4C /* @ECU_Address@FCtl_FMI@0x021B724B@ */ ECIPP_ALIGNMENT_UBYTE 255 Compu_IDENTITY 0 255 PHYS_UNIT "FMI" /end CHARACTERISTIC
/begin CHARACTERISTIC FCfmi_ADIG22_max "FCtl_FMI(588)" VALUE 0x001E5B4D /* @ECU_Address@FCtl_FMI@0x021B724C@ */ ECIPP_ALIGNMENT_UBYTE 255 Compu_IDENTITY 0 255 PHYS_UNIT "FMI" /end CHARACTERISTIC
/begin CHARACTERISTIC FCftb_accel_x_max "FCtl_FTB_0x04(702)" VALUE 0x001E5FD5 /* @ECU_Address@FCtl_FTB_0x04@0x024C52BE@ */ ECIPP_ALIGNMENT_UBYTE 255 Compu_IDENTITY 0 255 PHYS_UNIT "FTB" /end CHARACTERISTIC
/begin CHARACTERISTIC FCftb_accel_x_min "FCtl_FTB_0x04(703)" VALUE 0x001E5FD6 /* @ECU_Address@FCtl_FTB_0x04@0x024C52BF@ */ ECIPP_ALIGNMENT_UBYTE 255 Compu_IDENTITY 0 255 PHYS_UNIT "FTB" /end CHARACTERISTIC
/begin CHARACTERISTIC FCftb_accel_y_max "FCtl_FTB_0x04(704)" VALUE 0x001E5FD7 /* @ECU_Address@FCtl_FTB_0x04@0x024C52C0@ */ ECIPP_ALIGNMENT_UBYTE 255 Compu_IDENTITY 0 255 PHYS_UNIT "FTB" /end CHARACTERISTIC
/begin CHARACTERISTIC FCftb_accel_y_min "FCtl_FTB_0x04(705)" VALUE 0x001E5FD8 /* @ECU_Address@FCtl_FTB_0x04@0x024C52C1@ */ ECIPP_ALIGNMENT_UBYTE 255 Compu_IDENTITY 0 255 PHYS_UNIT "FTB" /end CHARACTERISTIC
/begin CHARACTERISTIC FCftb_accel_z_max "FCtl_FTB_0x04(706)" VALUE 0x001E5FD9 /* @ECU_Address@FCtl_FTB_0x04@0x024C52C2@ */ ECIPP_ALIGNMENT_UBYTE 255 Compu_IDENTITY 0 255 PHYS_UNIT "FTB" /end CHARACTERISTIC
/begin CHARACTERISTIC FCftb_accel_z_min "FCtl_FTB_0x04(707)" VALUE 0x001E5FDA /* @ECU_Address@FCtl_FTB_0x04@0x024C52C3@ */ ECIPP_ALIGNMENT_UBYTE 255 Compu_IDENTITY 0 255 PHYS_UNIT "FTB" /end CHARACTERISTIC
/begin CHARACTERISTIC FCftb_ACLT_intTlim_OOA "FCtl_FTB_0x04(868)" VALUE 0x001E607B /* @ECU_Address@FCtl_FTB_0x04@0x024C5364@ */ ECIPP_ALIGNMENT_UBYTE 255 Compu_IDENTITY 0 255 PHYS_UNIT "FTB" /end CHARACTERISTIC
/begin CHARACTERISTIC FCftb_ACT_hi "FCtl_FTB_0x04(862)" VALUE 0x001E6075 /* @ECU_Address@FCtl_FTB_0x04@0x024C535E@ */ ECIPP_ALIGNMENT_UBYTE 255 Compu_IDENTITY 0 255 PHYS_UNIT "FTB" /end CHARACTERISTIC
/begin CHARACTERISTIC FCftb_ADIG1_max "FCtl_FTB_0x04(209)" VALUE 0x001E5DE8 /* @ECU_Address@FCtl_FTB_0x04@0x024C50D1@ */ ECIPP_ALIGNMENT_UBYTE 255 Compu_IDENTITY 0 255 PHYS_UNIT "FTB" /end CHARACTERISTIC
/begin CHARACTERISTIC FCftb_ADIG1_min "FCtl_FTB_0x04(210)" VALUE 0x001E5DE9 /* @ECU_Address@FCtl_FTB_0x04@0x024C50D2@ */ ECIPP_ALIGNMENT_UBYTE 255 Compu_IDENTITY 0 255 PHYS_UNIT "FTB" /end CHARACTERISTIC
/begin CHARACTERISTIC FCftb_ADIG10_max "FCtl_FTB_0x04(349)" VALUE 0x001E5E74 /* @ECU_Address@FCtl_FTB_0x04@0x024C515D@ */ ECIPP_ALIGNMENT_UBYTE 255 Compu_IDENTITY 0 255 PHYS_UNIT "FTB" /end CHARACTERISTIC
/begin CHARACTERISTIC FCftb_ADIG10_min "FCtl_FTB_0x04(350)" VALUE 0x001E5E75 /* @ECU_Address@FCtl_FTB_0x04@0x024C515E@ */ ECIPP_ALIGNMENT_UBYTE 255 Compu_IDENTITY 0 255 PHYS_UNIT "FTB" /end CHARACTERISTIC
/begin CHARACTERISTIC FCftb_ADIG11_max "FCtl_FTB_0x04(354)" VALUE 0x001E5E79 /* @ECU_Address@FCtl_FTB_0x04@0x024C5162@ */ ECIPP_ALIGNMENT_UBYTE 255 Compu_IDENTITY 0 255 PHYS_UNIT "FTB" /end CHARACTERISTIC
/begin CHARACTERISTIC FCftb_ADIG11_min "FCtl_FTB_0x04(355)" VALUE 0x001E5E7A /* @ECU_Address@FCtl_FTB_0x04@0x024C5163@ */ ECIPP_ALIGNMENT_UBYTE 255 Compu_IDENTITY 0 255 PHYS_UNIT "FTB" /end CHARACTERISTIC
/begin CHARACTERISTIC FCftb_ADIG12_max "FCtl_FTB_0x04(356)" VALUE 0x001E5E7B /* @ECU_Address@FCtl_FTB_0x04@0x024C5164@ */ ECIPP_ALIGNMENT_UBYTE 255 Compu_IDENTITY 0 255 PHYS_UNIT "FTB" /end CHARACTERISTIC
/begin CHARACTERISTIC FCftb_ADIG12_min "FCtl_FTB_0x04(357)" VALUE 0x001E5E7C /* @ECU_Address@FCtl_FTB_0x04@0x024C5165@ */ ECIPP_ALIGNMENT_UBYTE 255 Compu_IDENTITY 0 255 PHYS_UNIT "FTB" /end CHARACTERISTIC
/begin CHARACTERISTIC FCftb_ADIG13_max "FCtl_FTB_0x04(393)" VALUE 0x001E5EA0 /* @ECU_Address@FCtl_FTB_0x04@0x024C5189@ */ ECIPP_ALIGNMENT_UBYTE 255 Compu_IDENTITY 0 255 PHYS_UNIT "FTB" /end CHARACTERISTIC
/begin CHARACTERISTIC FCftb_ADIG13_min "FCtl_FTB_0x04(394)" VALUE 0x001E5EA1 /* @ECU_Address@FCtl_FTB_0x04@0x024C518A@ */ ECIPP_ALIGNMENT_UBYTE 255 Compu_IDENTITY 0 255 PHYS_UNIT "FTB" /end CHARACTERISTIC
/begin CHARACTERISTIC FCftb_ADIG14_max "FCtl_FTB_0x04(395)" VALUE 0x001E5EA2 /* @ECU_Address@FCtl_FTB_0x04@0x024C518B@ */ ECIPP_ALIGNMENT_UBYTE 255 Compu_IDENTITY 0 255 PHYS_UNIT "FTB" /end CHARACTERISTIC
/begin CHARACTERISTIC FCftb_ADIG14_min "FCtl_FTB_0x04(396)" VALUE 0x001E5EA3 /* @ECU_Address@FCtl_FTB_0x04@0x024C518C@ */ ECIPP_ALIGNMENT_UBYTE 255 Compu_IDENTITY 0 255 PHYS_UNIT "FTB" /end CHARACTERISTIC
/begin CHARACTERISTIC FCftb_ADIG15_max "FCtl_FTB_0x04(397)" VALUE 0x001E5EA4 /* @ECU_Address@FCtl_FTB_0x04@0x024C518D@ */ ECIPP_ALIGNMENT_UBYTE 255 Compu_IDENTITY 0 255 PHYS_UNIT "FTB" /end CHARACTERISTIC
/begin CHARACTERISTIC FCftb_ADIG15_min "FCtl_FTB_0x04(398)" VALUE 0x001E5EA5 /* @ECU_Address@FCtl_FTB_0x04@0x024C518E@ */ ECIPP_ALIGNMENT_UBYTE 255 Compu_IDENTITY 0 255 PHYS_UNIT "FTB" /end CHARACTERISTIC
/begin CHARACTERISTIC FCftb_ADIG16_max "FCtl_FTB_0x04(399)" VALUE 0x001E5EA6 /* @ECU_Address@FCtl_FTB_0x04@0x024C518F@ */ ECIPP_ALIGNMENT_UBYTE 255 Compu_IDENTITY 0 255 PHYS_UNIT "FTB" /end CHARACTERISTIC
/begin CHARACTERISTIC FCftb_ADIG16_min "FCtl_FTB_0x04(400)" VALUE 0x001E5EA7 /* @ECU_Address@FCtl_FTB_0x04@0x024C5190@ */ ECIPP_ALIGNMENT_UBYTE 255 Compu_IDENTITY 0 255 PHYS_UNIT "FTB" /end CHARACTERISTIC
/begin CHARACTERISTIC FCftb_ADIG17_max "FCtl_FTB_0x04(401)" VALUE 0x001E5EA8 /* @ECU_Address@FCtl_FTB_0x04@0x024C5191@ */ ECIPP_ALIGNMENT_UBYTE 255 Compu_IDENTITY 0 255 PHYS_UNIT "FTB" /end CHARACTERISTIC
/begin CHARACTERISTIC FCftb_ADIG17_min "FCtl_FTB_0x04(402)" VALUE 0x001E5EA9 /* @ECU_Address@FCtl_FTB_0x04@0x024C5192@ */ ECIPP_ALIGNMENT_UBYTE 255 Compu_IDENTITY 0 255 PHYS_UNIT "FTB" /end CHARACTERISTIC
/begin CHARACTERISTIC FCftb_ADIG18_max "FCtl_FTB_0x04(403)" VALUE 0x001E5EAA /* @ECU_Address@FCtl_FTB_0x04@0x024C5193@ */ ECIPP_ALIGNMENT_UBYTE 255 Compu_IDENTITY 0 255 PHYS_UNIT "FTB" /end CHARACTERISTIC
/begin CHARACTERISTIC FCftb_ADIG18_min "FCtl_FTB_0x04(404)" VALUE 0x001E5EAB /* @ECU_Address@FCtl_FTB_0x04@0x024C5194@ */ ECIPP_ALIGNMENT_UBYTE 255 Compu_IDENTITY 0 255 PHYS_UNIT "FTB" /end CHARACTERISTIC
/begin CHARACTERISTIC FCftb_ADIG19_max "FCtl_FTB_0x04(405)" VALUE 0x001E5EAC /* @ECU_Address@FCtl_FTB_0x04@0x024C5195@ */ ECIPP_ALIGNMENT_UBYTE 255 Compu_IDENTITY 0 255 PHYS_UNIT "FTB" /end CHARACTERISTIC
/begin CHARACTERISTIC FCftb_ADIG19_min "FCtl_FTB_0x04(406)" VALUE 0x001E5EAD /* @ECU_Address@FCtl_FTB_0x04@0x024C5196@ */ ECIPP_ALIGNMENT_UBYTE 255 Compu_IDENTITY 0 255 PHYS_UNIT "FTB" /end CHARACTERISTIC
/begin CHARACTERISTIC FCftb_ADIG2_max "FCtl_FTB_0x04(211)" VALUE 0x001E5DEA /* @ECU_Address@FCtl_FTB_0x04@0x024C50D3@ */ ECIPP_ALIGNMENT_UBYTE 255 Compu_IDENTITY 0 255 PHYS_UNIT "FTB" /end CHARACTERISTIC
/begin CHARACTERISTIC FCftb_ADIG2_min "FCtl_FTB_0x04(212)" VALUE 0x001E5DEB /* @ECU_Address@FCtl_FTB_0x04@0x024C50D4@ */ ECIPP_ALIGNMENT_UBYTE 255 Compu_IDENTITY 0 255 PHYS_UNIT "FTB" /end CHARACTERISTIC
/begin CHARACTERISTIC FCftb_ADIG20_max "FCtl_FTB_0x04(584)" VALUE 0x001E5F5F /* @ECU_Address@FCtl_FTB_0x04@0x024C5248@ */ ECIPP_ALIGNMENT_UBYTE 255 Compu_IDENTITY 0 255 PHYS_UNIT "FTB" /end CHARACTERISTIC
/begin CHARACTERISTIC FCftb_ADIG20_min "FCtl_FTB_0x04(585)" VALUE 0x001E5F60 /* @ECU_Address@FCtl_FTB_0x04@0x024C5249@ */ ECIPP_ALIGNMENT_UBYTE 255 Compu_IDENTITY 0 255 PHYS_UNIT "FTB" /end CHARACTERISTIC
/begin CHARACTERISTIC FCftb_ADIG21_max "FCtl_FTB_0x04(586)" VALUE 0x001E5F61 /* @ECU_Address@FCtl_FTB_0x04@0x024C524A@ */ ECIPP_ALIGNMENT_UBYTE 255 Compu_IDENTITY 0 255 PHYS_UNIT "FTB" /end CHARACTERISTIC
/begin CHARACTERISTIC FCftb_ADIG21_min "FCtl_FTB_0x04(587)" VALUE 0x001E5F62 /* @ECU_Address@FCtl_FTB_0x04@0x024C524B@ */ ECIPP_ALIGNMENT_UBYTE 255 Compu_IDENTITY 0 255 PHYS_UNIT "FTB" /end CHARACTERISTIC
/begin CHARACTERISTIC FCftb_ADIG22_max "FCtl_FTB_0x04(588)" VALUE 0x001E5F63 /* @ECU_Address@FCtl_FTB_0x04@0x024C524C@ */ ECIPP_ALIGNMENT_UBYTE 255 Compu_IDENTITY 0 255 PHYS_UNIT "FTB" /end CHARACTERISTIC
/begin CHARACTERISTIC FCspn_accel_x_max "FCtl_SPN(702)" VALUE 0x001E285C /* @ECU_Address@FCtl_SPN@0x21B60AF8@ */ ECIPP_ALIGNMENT_ULONG 4294967295 Compu_IDENTITY 0 4294967295 PHYS_UNIT "SPN" /end CHARACTERISTIC
/begin CHARACTERISTIC FCspn_accel_x_min "FCtl_SPN(703)" VALUE 0x001E2860 /* @ECU_Address@FCtl_SPN@0x21B60AFC@ */ ECIPP_ALIGNMENT_ULONG 4294967295 Compu_IDENTITY 0 4294967295 PHYS_UNIT "SPN" /end CHARACTERISTIC
/begin CHARACTERISTIC FCspn_accel_y_max "FCtl_SPN(704)" VALUE 0x001E2864 /* @ECU_Address@FCtl_SPN@0x21B60B00@ */ ECIPP_ALIGNMENT_ULONG 4294967295 Compu_IDENTITY 0 4294967295 PHYS_UNIT "SPN" /end CHARACTERISTIC
/begin CHARACTERISTIC FCspn_accel_y_min "FCtl_SPN(705)" VALUE 0x001E2868 /* @ECU_Address@FCtl_SPN@0x21B60B04@ */ ECIPP_ALIGNMENT_ULONG 4294967295 Compu_IDENTITY 0 4294967295 PHYS_UNIT "SPN" /end CHARACTERISTIC
/begin CHARACTERISTIC FCspn_accel_z_max "FCtl_SPN(706)" VALUE 0x001E286C /* @ECU_Address@FCtl_SPN@0x21B60B08@ */ ECIPP_ALIGNMENT_ULONG 4294967295 Compu_IDENTITY 0 4294967295 PHYS_UNIT "SPN" /end CHARACTERISTIC
/begin CHARACTERISTIC FCspn_accel_z_min "FCtl_SPN(707)" VALUE 0x001E2870 /* @ECU_Address@FCtl_SPN@0x21B60B0C@ */ ECIPP_ALIGNMENT_ULONG 4294967295 Compu_IDENTITY 0 4294967295 PHYS_UNIT "SPN" /end CHARACTERISTIC
/begin CHARACTERISTIC FCspn_ACLT_intTlim_OOA "FCtl_SPN(868)" VALUE 0x001E2AF4 /* @ECU_Address@FCtl_SPN@0x21B60D90@ */ ECIPP_ALIGNMENT_ULONG 4294967295 Compu_IDENTITY 0 4294967295 PHYS_UNIT "SPN" /end CHARACTERISTIC
/begin CHARACTERISTIC FCspn_ACT_hi "FCtl_SPN(862)" VALUE 0x001E2ADC /* @ECU_Address@FCtl_SPN@0x21B60D78@ */ ECIPP_ALIGNMENT_ULONG 4294967295 Compu_IDENTITY 0 4294967295 PHYS_UNIT "SPN" /end CHARACTERISTIC
/begin CHARACTERISTIC FCspn_ADIG1_max "FCtl_SPN(209)" VALUE 0x001E20A8 /* @ECU_Address@FCtl_SPN@0x21B60344@ */ ECIPP_ALIGNMENT_ULONG 4294967295 Compu_IDENTITY 0 4294967295 PHYS_UNIT "SPN" /end CHARACTERISTIC
/begin CHARACTERISTIC FCspn_ADIG1_min "FCtl_SPN(210)" VALUE 0x001E20AC /* @ECU_Address@FCtl_SPN@0x21B60348@ */ ECIPP_ALIGNMENT_ULONG 4294967295 Compu_IDENTITY 0 4294967295 PHYS_UNIT "SPN" /end CHARACTERISTIC
/begin CHARACTERISTIC FCspn_ADIG10_max "FCtl_SPN(349)" VALUE 0x001E22D8 /* @ECU_Address@FCtl_SPN@0x21B60574@ */ ECIPP_ALIGNMENT_ULONG 4294967295 Compu_IDENTITY 0 4294967295 PHYS_UNIT "SPN" /end CHARACTERISTIC
/begin CHARACTERISTIC FCspn_ADIG10_min "FCtl_SPN(350)" VALUE 0x001E22DC /* @ECU_Address@FCtl_SPN@0x21B60578@ */ ECIPP_ALIGNMENT_ULONG 4294967295 Compu_IDENTITY 0 4294967295 PHYS_UNIT "SPN" /end CHARACTERISTIC
/begin CHARACTERISTIC FCspn_ADIG11_max "FCtl_SPN(354)" VALUE 0x001E22EC /* @ECU_Address@FCtl_SPN@0x21B60588@ */ ECIPP_ALIGNMENT_ULONG 4294967295 Compu_IDENTITY 0 4294967295 PHYS_UNIT "SPN" /end CHARACTERISTIC
/begin CHARACTERISTIC FCspn_ADIG11_min "FCtl_SPN(355)" VALUE 0x001E22F0 /* @ECU_Address@FCtl_SPN@0x21B6058C@ */ ECIPP_ALIGNMENT_ULONG 4294967295 Compu_IDENTITY 0 4294967295 PHYS_UNIT "SPN" /end CHARACTERISTIC
/begin CHARACTERISTIC FCspn_ADIG12_max "FCtl_SPN(356)" VALUE 0x001E22F4 /* @ECU_Address@FCtl_SPN@0x21B60590@ */ ECIPP_ALIGNMENT_ULONG 4294967295 Compu_IDENTITY 0 4294967295 PHYS_UNIT "SPN" /end CHARACTERISTIC
/begin CHARACTERISTIC FCspn_ADIG12_min "FCtl_SPN(357)" VALUE 0x001E22F8 /* @ECU_Address@FCtl_SPN@0x21B60594@ */ ECIPP_ALIGNMENT_ULONG 4294967295 Compu_IDENTITY 0 4294967295 PHYS_UNIT "SPN" /end CHARACTERISTIC
/begin CHARACTERISTIC FCspn_ADIG13_max "FCtl_SPN(393)" VALUE 0x001E2388 /* @ECU_Address@FCtl_SPN@0x21B60624@ */ ECIPP_ALIGNMENT_ULONG 4294967295 Compu_IDENTITY 0 4294967295 PHYS_UNIT "SPN" /end CHARACTERISTIC
/begin CHARACTERISTIC FCspn_ADIG13_min "FCtl_SPN(394)" VALUE 0x001E238C /* @ECU_Address@FCtl_SPN@0x21B60628@ */ ECIPP_ALIGNMENT_ULONG 4294967295 Compu_IDENTITY 0 4294967295 PHYS_UNIT "SPN" /end CHARACTERISTIC
/begin CHARACTERISTIC FCspn_ADIG14_max "FCtl_SPN(395)" VALUE 0x001E2390 /* @ECU_Address@FCtl_SPN@0x21B6062C@ */ ECIPP_ALIGNMENT_ULONG 4294967295 Compu_IDENTITY 0 4294967295 PHYS_UNIT "SPN" /end CHARACTERISTIC
/begin CHARACTERISTIC FCspn_ADIG14_min "FCtl_SPN(396)" VALUE 0x001E2394 /* @ECU_Address@FCtl_SPN@0x21B60630@ */ ECIPP_ALIGNMENT_ULONG 4294967295 Compu_IDENTITY 0 4294967295 PHYS_UNIT "SPN" /end CHARACTERISTIC
/begin CHARACTERISTIC FCspn_ADIG15_max "FCtl_SPN(397)" VALUE 0x001E2398 /* @ECU_Address@FCtl_SPN@0x21B60634@ */ ECIPP_ALIGNMENT_ULONG 4294967295 Compu_IDENTITY 0 4294967295 PHYS_UNIT "SPN" /end CHARACTERISTIC
/begin CHARACTERISTIC FCspn_ADIG15_min "FCtl_SPN(398)" VALUE 0x001E239C /* @ECU_Address@FCtl_SPN@0x21B60638@ */ ECIPP_ALIGNMENT_ULONG 4294967295 Compu_IDENTITY 0 4294967295 PHYS_UNIT "SPN" /end CHARACTERISTIC
/begin CHARACTERISTIC FCspn_ADIG16_max "FCtl_SPN(399)" VALUE 0x001E23A0 /* @ECU_Address@FCtl_SPN@0x21B6063C@ */ ECIPP_ALIGNMENT_ULONG 4294967295 Compu_IDENTITY 0 4294967295 PHYS_UNIT "SPN" /end CHARACTERISTIC
/begin CHARACTERISTIC FCspn_ADIG16_min "FCtl_SPN(400)" VALUE 0x001E23A4 /* @ECU_Address@FCtl_SPN@0x21B60640@ */ ECIPP_ALIGNMENT_ULONG 4294967295 Compu_IDENTITY 0 4294967295 PHYS_UNIT "SPN" /end CHARACTERISTIC
/begin CHARACTERISTIC FCspn_ADIG17_max "FCtl_SPN(401)" VALUE 0x001E23A8 /* @ECU_Address@FCtl_SPN@0x21B60644@ */ ECIPP_ALIGNMENT_ULONG 4294967295 Compu_IDENTITY 0 4294967295 PHYS_UNIT "SPN" /end CHARACTERISTIC
/begin CHARACTERISTIC FCspn_ADIG17_min "FCtl_SPN(402)" VALUE 0x001E23AC /* @ECU_Address@FCtl_SPN@0x21B60648@ */ ECIPP_ALIGNMENT_ULONG 4294967295 Compu_IDENTITY 0 4294967295 PHYS_UNIT "SPN" /end CHARACTERISTIC
/begin CHARACTERISTIC FCspn_ADIG18_max "FCtl_SPN(403)" VALUE 0x001E23B0 /* @ECU_Address@FCtl_SPN@0x21B6064C@ */ ECIPP_ALIGNMENT_ULONG 4294967295 Compu_IDENTITY 0 4294967295 PHYS_UNIT "SPN" /end CHARACTERISTIC
/begin CHARACTERISTIC FCspn_ADIG18_min "FCtl_SPN(404)" VALUE 0x001E23B4 /* @ECU_Address@FCtl_SPN@0x21B60650@ */ ECIPP_ALIGNMENT_ULONG 4294967295 Compu_IDENTITY 0 4294967295 PHYS_UNIT "SPN" /end CHARACTERISTIC
/begin CHARACTERISTIC FCspn_ADIG19_max "FCtl_SPN(405)" VALUE 0x001E23B8 /* @ECU_Address@FCtl_SPN@0x21B60654@ */ ECIPP_ALIGNMENT_ULONG 4294967295 Compu_IDENTITY 0 4294967295 PHYS_UNIT "SPN" /end CHARACTERISTIC
/begin CHARACTERISTIC FCspn_ADIG19_min "FCtl_SPN(406)" VALUE 0x001E23BC /* @ECU_Address@FCtl_SPN@0x21B60658@ */ ECIPP_ALIGNMENT_ULONG 4294967295 Compu_IDENTITY 0 4294967295 PHYS_UNIT "SPN" /end CHARACTERISTIC
/begin CHARACTERISTIC FCspn_ADIG2_max "FCtl_SPN(211)" VALUE 0x001E20B0 /* @ECU_Address@FCtl_SPN@0x21B6034C@ */ ECIPP_ALIGNMENT_ULONG 4294967295 Compu_IDENTITY 0 4294967295 PHYS_UNIT "SPN" /end CHARACTERISTIC
/begin CHARACTERISTIC FCspn_ADIG2_min "FCtl_SPN(212)" VALUE 0x001E20B4 /* @ECU_Address@FCtl_SPN@0x21B60350@ */ ECIPP_ALIGNMENT_ULONG 4294967295 Compu_IDENTITY 0 4294967295 PHYS_UNIT "SPN" /end CHARACTERISTIC
/begin CHARACTERISTIC FCspn_ADIG20_max "FCtl_SPN(584)" VALUE 0x001E2684 /* @ECU_Address@FCtl_SPN@0x21B60920@ */ ECIPP_ALIGNMENT_ULONG 4294967295 Compu_IDENTITY 0 4294967295 PHYS_UNIT "SPN" /end CHARACTERISTIC
/begin CHARACTERISTIC FCspn_ADIG20_min "FCtl_SPN(585)" VALUE 0x001E2688 /* @ECU_Address@FCtl_SPN@0x21B60924@ */ ECIPP_ALIGNMENT_ULONG 4294967295 Compu_IDENTITY 0 4294967295 PHYS_UNIT "SPN" /end CHARACTERISTIC
/begin CHARACTERISTIC FCspn_ADIG21_max "FCtl_SPN(586)" VALUE 0x001E268C /* @ECU_Address@FCtl_SPN@0x21B60928@ */ ECIPP_ALIGNMENT_ULONG 4294967295 Compu_IDENTITY 0 4294967295 PHYS_UNIT "SPN" /end CHARACTERISTIC
/begin CHARACTERISTIC FCspn_ADIG21_min "FCtl_SPN(587)" VALUE 0x001E2690 /* @ECU_Address@FCtl_SPN@0x21B6092C@ */ ECIPP_ALIGNMENT_ULONG 4294967295 Compu_IDENTITY 0 4294967295 PHYS_UNIT "SPN" /end CHARACTERISTIC
/begin CHARACTERISTIC FCspn_ADIG22_max "FCtl_SPN(588)" VALUE 0x001E2694 /* @ECU_Address@FCtl_SPN@0x21B60930@ */ ECIPP_ALIGNMENT_ULONG 4294967295 Compu_IDENTITY 0 4294967295 PHYS_UNIT "SPN" /end CHARACTERISTIC
/begin CHARACTERISTIC FPfl_accel_x_max "FPrm_latch(532)" VALUE 0x001E0868 /* @ECU_Address@FPrm_latch@0x021BB850@ */ ECIPP_ALIGNMENT_FLOAT32_IEEE 10000000000 Compu_IDENTITY -10000000000 10000000000 PHYS_UNIT "ms" /end CHARACTERISTIC
/begin CHARACTERISTIC FPfl_accel_x_min "FPrm_latch(533)" VALUE 0x001E086C /* @ECU_Address@FPrm_latch@0x021BB854@ */ ECIPP_ALIGNMENT_FLOAT32_IEEE 10000000000 Compu_IDENTITY -10000000000 10000000000 PHYS_UNIT "ms" /end CHARACTERISTIC
/begin CHARACTERISTIC FPfl_accel_y_max "FPrm_latch(534)" VALUE 0x001E0870 /* @ECU_Address@FPrm_latch@0x021BB858@ */ ECIPP_ALIGNMENT_FLOAT32_IEEE 10000000000 Compu_IDENTITY -10000000000 10000000000 PHYS_UNIT "ms" /end CHARACTERISTIC
/begin CHARACTERISTIC FPfl_accel_y_min "FPrm_latch(535)" VALUE 0x001E0874 /* @ECU_Address@FPrm_latch@0x021BB85C@ */ ECIPP_ALIGNMENT_FLOAT32_IEEE 10000000000 Compu_IDENTITY -10000000000 10000000000 PHYS_UNIT "ms" /end CHARACTERISTIC
/begin CHARACTERISTIC FPfl_accel_z_max "FPrm_latch(536)" VALUE 0x001E0878 /* @ECU_Address@FPrm_latch@0x021BB860@ */ ECIPP_ALIGNMENT_FLOAT32_IEEE 10000000000 Compu_IDENTITY -10000000000 10000000000 PHYS_UNIT "ms" /end CHARACTERISTIC
/begin CHARACTERISTIC FPfl_accel_z_min "FPrm_latch(537)" VALUE 0x001E087C /* @ECU_Address@FPrm_latch@0x021BB864@ */ ECIPP_ALIGNMENT_FLOAT32_IEEE 10000000000 Compu_IDENTITY -10000000000 10000000000 PHYS_UNIT "ms" /end CHARACTERISTIC
/begin CHARACTERISTIC FPfl_ACLT_intTlim_OOA "FPrm_latch(695)" VALUE 0x001E0AF4 /* @ECU_Address@FPrm_latch@0x021BBADC@ */ ECIPP_ALIGNMENT_FLOAT32_IEEE 10000000000 Compu_IDENTITY -10000000000 10000000000 PHYS_UNIT "ms" /end CHARACTERISTIC
/begin CHARACTERISTIC FPfl_ACT_hi "FPrm_latch(689)" VALUE 0x001E0ADC /* @ECU_Address@FPrm_latch@0x021BBAC4@ */ ECIPP_ALIGNMENT_FLOAT32_IEEE 10000000000 Compu_IDENTITY -10000000000 10000000000 PHYS_UNIT "ms" /end CHARACTERISTIC
/begin CHARACTERISTIC FPfl_ADIG1_max "FPrm_latch(165)" VALUE 0x001E02AC /* @ECU_Address@FPrm_latch@0x021BB294@ */ ECIPP_ALIGNMENT_FLOAT32_IEEE 10000000000 Compu_IDENTITY -10000000000 10000000000 PHYS_UNIT "ms" /end CHARACTERISTIC
/begin CHARACTERISTIC FPfl_ADIG1_min "FPrm_latch(166)" VALUE 0x001E02B0 /* @ECU_Address@FPrm_latch@0x021BB298@ */ ECIPP_ALIGNMENT_FLOAT32_IEEE 10000000000 Compu_IDENTITY -10000000000 10000000000 PHYS_UNIT "ms" /end CHARACTERISTIC
/begin CHARACTERISTIC FPfl_ADIG10_max "FPrm_latch(258)" VALUE 0x001E0420 /* @ECU_Address@FPrm_latch@0x021BB408@ */ ECIPP_ALIGNMENT_FLOAT32_IEEE 10000000000 Compu_IDENTITY -10000000000 10000000000 PHYS_UNIT "ms" /end CHARACTERISTIC
/begin CHARACTERISTIC FPfl_ADIG10_min "FPrm_latch(259)" VALUE 0x001E0424 /* @ECU_Address@FPrm_latch@0x021BB40C@ */ ECIPP_ALIGNMENT_FLOAT32_IEEE 10000000000 Compu_IDENTITY -10000000000 10000000000 PHYS_UNIT "ms" /end CHARACTERISTIC
/begin CHARACTERISTIC FPfl_ADIG11_max "FPrm_latch(263)" VALUE 0x001E0434 /* @ECU_Address@FPrm_latch@0x021BB41C@ */ ECIPP_ALIGNMENT_FLOAT32_IEEE 10000000000 Compu_IDENTITY -10000000000 10000000000 PHYS_UNIT "ms" /end CHARACTERISTIC
/begin CHARACTERISTIC FPfl_ADIG11_min "FPrm_latch(264)" VALUE 0x001E0438 /* @ECU_Address@FPrm_latch@0x021BB420@ */ ECIPP_ALIGNMENT_FLOAT32_IEEE 10000000000 Compu_IDENTITY -10000000000 10000000000 PHYS_UNIT "ms" /end CHARACTERISTIC
/begin CHARACTERISTIC FPfl_ADIG12_max "FPrm_latch(265)" VALUE 0x001E043C /* @ECU_Address@FPrm_latch@0x021BB424@ */ ECIPP_ALIGNMENT_FLOAT32_IEEE 10000000000 Compu_IDENTITY -10000000000 10000000000 PHYS_UNIT "ms" /end CHARACTERISTIC
/begin CHARACTERISTIC FPfl_ADIG12_min "FPrm_latch(266)" VALUE 0x001E0440 /* @ECU_Address@FPrm_latch@0x021BB428@ */ ECIPP_ALIGNMENT_FLOAT32_IEEE 10000000000 Compu_IDENTITY -10000000000 10000000000 PHYS_UNIT "ms" /end CHARACTERISTIC
/begin CHARACTERISTIC FPfl_ADIG13_max "FPrm_latch(302)" VALUE 0x001E04D0 /* @ECU_Address@FPrm_latch@0x021BB4B8@ */ ECIPP_ALIGNMENT_FLOAT32_IEEE 10000000000 Compu_IDENTITY -10000000000 10000000000 PHYS_UNIT "ms" /end CHARACTERISTIC
/begin CHARACTERISTIC FPfl_ADIG13_min "FPrm_latch(303)" VALUE 0x001E04D4 /* @ECU_Address@FPrm_latch@0x021BB4BC@ */ ECIPP_ALIGNMENT_FLOAT32_IEEE 10000000000 Compu_IDENTITY -10000000000 10000000000 PHYS_UNIT "ms" /end CHARACTERISTIC
/begin CHARACTERISTIC FPfl_ADIG14_max "FPrm_latch(304)" VALUE 0x001E04D8 /* @ECU_Address@FPrm_latch@0x021BB4C0@ */ ECIPP_ALIGNMENT_FLOAT32_IEEE 10000000000 Compu_IDENTITY -10000000000 10000000000 PHYS_UNIT "ms" /end CHARACTERISTIC
/begin CHARACTERISTIC FPfl_ADIG14_min "FPrm_latch(305)" VALUE 0x001E04DC /* @ECU_Address@FPrm_latch@0x021BB4C4@ */ ECIPP_ALIGNMENT_FLOAT32_IEEE 10000000000 Compu_IDENTITY -10000000000 10000000000 PHYS_UNIT "ms" /end CHARACTERISTIC
/begin CHARACTERISTIC FPfl_ADIG15_max "FPrm_latch(306)" VALUE 0x001E04E0 /* @ECU_Address@FPrm_latch@0x021BB4C8@ */ ECIPP_ALIGNMENT_FLOAT32_IEEE 10000000000 Compu_IDENTITY -10000000000 10000000000 PHYS_UNIT "ms" /end CHARACTERISTIC
/begin CHARACTERISTIC FPfl_ADIG15_min "FPrm_latch(307)" VALUE 0x001E04E4 /* @ECU_Address@FPrm_latch@0x021BB4CC@ */ ECIPP_ALIGNMENT_FLOAT32_IEEE 10000000000 Compu_IDENTITY -10000000000 10000000000 PHYS_UNIT "ms" /end CHARACTERISTIC
/begin CHARACTERISTIC FPfl_ADIG16_max "FPrm_latch(308)" VALUE 0x001E04E8 /* @ECU_Address@FPrm_latch@0x021BB4D0@ */ ECIPP_ALIGNMENT_FLOAT32_IEEE 10000000000 Compu_IDENTITY -10000000000 10000000000 PHYS_UNIT "ms" /end CHARACTERISTIC
/begin CHARACTERISTIC FPfl_ADIG16_min "FPrm_latch(309)" VALUE 0x001E04EC /* @ECU_Address@FPrm_latch@0x021BB4D4@ */ ECIPP_ALIGNMENT_FLOAT32_IEEE 10000000000 Compu_IDENTITY -10000000000 10000000000 PHYS_UNIT "ms" /end CHARACTERISTIC
/begin CHARACTERISTIC FPfl_ADIG17_max "FPrm_latch(310)" VALUE 0x001E04F0 /* @ECU_Address@FPrm_latch@0x021BB4D8@ */ ECIPP_ALIGNMENT_FLOAT32_IEEE 10000000000 Compu_IDENTITY -10000000000 10000000000 PHYS_UNIT "ms" /end CHARACTERISTIC
/begin CHARACTERISTIC FPfl_ADIG17_min "FPrm_latch(311)" VALUE 0x001E04F4 /* @ECU_Address@FPrm_latch@0x021BB4DC@ */ ECIPP_ALIGNMENT_FLOAT32_IEEE 10000000000 Compu_IDENTITY -10000000000 10000000000 PHYS_UNIT "ms" /end CHARACTERISTIC
/begin CHARACTERISTIC FPfl_ADIG18_max "FPrm_latch(312)" VALUE 0x001E04F8 /* @ECU_Address@FPrm_latch@0x021BB4E0@ */ ECIPP_ALIGNMENT_FLOAT32_IEEE 10000000000 Compu_IDENTITY -10000000000 10000000000 PHYS_UNIT "ms" /end CHARACTERISTIC
/begin CHARACTERISTIC FPfl_ADIG18_min "FPrm_latch(313)" VALUE 0x001E04FC /* @ECU_Address@FPrm_latch@0x021BB4E4@ */ ECIPP_ALIGNMENT_FLOAT32_IEEE 10000000000 Compu_IDENTITY -10000000000 10000000000 PHYS_UNIT "ms" /end CHARACTERISTIC
/begin CHARACTERISTIC FPfl_ADIG19_max "FPrm_latch(314)" VALUE 0x001E0500 /* @ECU_Address@FPrm_latch@0x021BB4E8@ */ ECIPP_ALIGNMENT_FLOAT32_IEEE 10000000000 Compu_IDENTITY -10000000000 10000000000 PHYS_UNIT "ms" /end CHARACTERISTIC
/begin CHARACTERISTIC FPfl_ADIG19_min "FPrm_latch(315)" VALUE 0x001E0504 /* @ECU_Address@FPrm_latch@0x021BB4EC@ */ ECIPP_ALIGNMENT_FLOAT32_IEEE 10000000000 Compu_IDENTITY -10000000000 10000000000 PHYS_UNIT "ms" /end CHARACTERISTIC
/begin CHARACTERISTIC FPfl_ADIG2_max "FPrm_latch(167)" VALUE 0x001E02B4 /* @ECU_Address@FPrm_latch@0x021BB29C@ */ ECIPP_ALIGNMENT_FLOAT32_IEEE 10000000000 Compu_IDENTITY -10000000000 10000000000 PHYS_UNIT "ms" /end CHARACTERISTIC
/begin CHARACTERISTIC FPfl_ADIG2_min "FPrm_latch(168)" VALUE 0x001E02B8 /* @ECU_Address@FPrm_latch@0x021BB2A0@ */ ECIPP_ALIGNMENT_FLOAT32_IEEE 10000000000 Compu_IDENTITY -10000000000 10000000000 PHYS_UNIT "ms" /end CHARACTERISTIC
/begin CHARACTERISTIC FPfl_ADIG20_max "FPrm_latch(438)" VALUE 0x001E06F0 /* @ECU_Address@FPrm_latch@0x021BB6D8@ */ ECIPP_ALIGNMENT_FLOAT32_IEEE 10000000000 Compu_IDENTITY -10000000000 10000000000 PHYS_UNIT "ms" /end CHARACTERISTIC
/begin CHARACTERISTIC FPfl_ADIG20_min "FPrm_latch(439)" VALUE 0x001E06F4 /* @ECU_Address@FPrm_latch@0x021BB6DC@ */ ECIPP_ALIGNMENT_FLOAT32_IEEE 10000000000 Compu_IDENTITY -10000000000 10000000000 PHYS_UNIT "ms" /end CHARACTERISTIC
/begin CHARACTERISTIC FPfl_ADIG21_max "FPrm_latch(440)" VALUE 0x001E06F8 /* @ECU_Address@FPrm_latch@0x021BB6E0@ */ ECIPP_ALIGNMENT_FLOAT32_IEEE 10000000000 Compu_IDENTITY -10000000000 10000000000 PHYS_UNIT "ms" /end CHARACTERISTIC
/begin CHARACTERISTIC FPfl_ADIG21_min "FPrm_latch(441)" VALUE 0x001E06FC /* @ECU_Address@FPrm_latch@0x021BB6E4@ */ ECIPP_ALIGNMENT_FLOAT32_IEEE 10000000000 Compu_IDENTITY -10000000000 10000000000 PHYS_UNIT "ms" /end CHARACTERISTIC
/begin CHARACTERISTIC FPfl_ADIG22_max "FPrm_latch(442)" VALUE 0x001E0700 /* @ECU_Address@FPrm_latch@0x021BB6E8@ */ ECIPP_ALIGNMENT_FLOAT32_IEEE 10000000000 Compu_IDENTITY -10000000000 10000000000 PHYS_UNIT "ms" /end CHARACTERISTIC
/begin CHARACTERISTIC FPfu_accel_x_max "FPrm_unlatch(532)" VALUE 0x001E13B0 /* @ECU_Address@FPrm_unlatch@0x021BD850@ */ ECIPP_ALIGNMENT_FLOAT32_IEEE 10000000000 Compu_IDENTITY -10000000000 10000000000 PHYS_UNIT "ms" /end CHARACTERISTIC
/begin CHARACTERISTIC FPfu_accel_x_min "FPrm_unlatch(533)" VALUE 0x001E13B4 /* @ECU_Address@FPrm_unlatch@0x021BD854@ */ ECIPP_ALIGNMENT_FLOAT32_IEEE 10000000000 Compu_IDENTITY -10000000000 10000000000 PHYS_UNIT "ms" /end CHARACTERISTIC
/begin CHARACTERISTIC FPfu_accel_y_max "FPrm_unlatch(534)" VALUE 0x001E13B8 /* @ECU_Address@FPrm_unlatch@0x021BD858@ */ ECIPP_ALIGNMENT_FLOAT32_IEEE 10000000000 Compu_IDENTITY -10000000000 10000000000 PHYS_UNIT "ms" /end CHARACTERISTIC
/begin CHARACTERISTIC FPfu_accel_y_min "FPrm_unlatch(535)" VALUE 0x001E13BC /* @ECU_Address@FPrm_unlatch@0x021BD85C@ */ ECIPP_ALIGNMENT_FLOAT32_IEEE 10000000000 Compu_IDENTITY -10000000000 10000000000 PHYS_UNIT "ms" /end CHARACTERISTIC
/begin CHARACTERISTIC FPfu_accel_z_max "FPrm_unlatch(536)" VALUE 0x001E13C0 /* @ECU_Address@FPrm_unlatch@0x021BD860@ */ ECIPP_ALIGNMENT_FLOAT32_IEEE 10000000000 Compu_IDENTITY -10000000000 10000000000 PHYS_UNIT "ms" /end CHARACTERISTIC
/begin CHARACTERISTIC FPfu_accel_z_min "FPrm_unlatch(537)" VALUE 0x001E13C4 /* @ECU_Address@FPrm_unlatch@0x021BD864@ */ ECIPP_ALIGNMENT_FLOAT32_IEEE 10000000000 Compu_IDENTITY -10000000000 10000000000 PHYS_UNIT "ms" /end CHARACTERISTIC
/begin CHARACTERISTIC FPfu_ACLT_intTlim_OOA "FPrm_unlatch(695)" VALUE 0x001E163C /* @ECU_Address@FPrm_unlatch@0x021BDADC@ */ ECIPP_ALIGNMENT_FLOAT32_IEEE 10000000000 Compu_IDENTITY -10000000000 10000000000 PHYS_UNIT "ms" /end CHARACTERISTIC
/begin CHARACTERISTIC FPfu_ACT_hi "FPrm_unlatch(689)" VALUE 0x001E1624 /* @ECU_Address@FPrm_unlatch@0x021BDAC4@ */ ECIPP_ALIGNMENT_FLOAT32_IEEE 10000000000 Compu_IDENTITY -10000000000 10000000000 PHYS_UNIT "ms" /end CHARACTERISTIC
/begin CHARACTERISTIC FPfu_ADIG1_max "FPrm_unlatch(165)" VALUE 0x001E0DF4 /* @ECU_Address@FPrm_unlatch@0x021BD294@ */ ECIPP_ALIGNMENT_FLOAT32_IEEE 10000000000 Compu_IDENTITY -10000000000 10000000000 PHYS_UNIT "ms" /end CHARACTERISTIC
/begin CHARACTERISTIC FPfu_ADIG1_min "FPrm_unlatch(166)" VALUE 0x001E0DF8 /* @ECU_Address@FPrm_unlatch@0x021BD298@ */ ECIPP_ALIGNMENT_FLOAT32_IEEE 10000000000 Compu_IDENTITY -10000000000 10000000000 PHYS_UNIT "ms" /end CHARACTERISTIC
/begin CHARACTERISTIC FPfu_ADIG10_max "FPrm_unlatch(258)" VALUE 0x001E0F68 /* @ECU_Address@FPrm_unlatch@0x021BD408@ */ ECIPP_ALIGNMENT_FLOAT32_IEEE 10000000000 Compu_IDENTITY -10000000000 10000000000 PHYS_UNIT "ms" /end CHARACTERISTIC
/begin CHARACTERISTIC FPfu_ADIG10_min "FPrm_unlatch(259)" VALUE 0x001E0F6C /* @ECU_Address@FPrm_unlatch@0x021BD40C@ */ ECIPP_ALIGNMENT_FLOAT32_IEEE 10000000000 Compu_IDENTITY -10000000000 10000000000 PHYS_UNIT "ms" /end CHARACTERISTIC
/begin CHARACTERISTIC FPfu_ADIG11_max "FPrm_unlatch(263)" VALUE 0x001E0F7C /* @ECU_Address@FPrm_unlatch@0x021BD41C@ */ ECIPP_ALIGNMENT_FLOAT32_IEEE 10000000000 Compu_IDENTITY -10000000000 10000000000 PHYS_UNIT "ms" /end CHARACTERISTIC
/begin CHARACTERISTIC FPfu_ADIG11_min "FPrm_unlatch(264)" VALUE 0x001E0F80 /* @ECU_Address@FPrm_unlatch@0x021BD420@ */ ECIPP_ALIGNMENT_FLOAT32_IEEE 10000000000 Compu_IDENTITY -10000000000 10000000000 PHYS_UNIT "ms" /end CHARACTERISTIC
/begin CHARACTERISTIC FPfu_ADIG12_max "FPrm_unlatch(265)" VALUE 0x001E0F84 /* @ECU_Address@FPrm_unlatch@0x021BD424@ */ ECIPP_ALIGNMENT_FLOAT32_IEEE 10000000000 Compu_IDENTITY -10000000000 10000000000 PHYS_UNIT "ms" /end CHARACTERISTIC
/begin CHARACTERISTIC FPfu_ADIG12_min "FPrm_unlatch(266)" VALUE 0x001E0F88 /* @ECU_Address@FPrm_unlatch@0x021BD428@ */ ECIPP_ALIGNMENT_FLOAT32_IEEE 10000000000 Compu_IDENTITY -10000000000 10000000000 PHYS_UNIT "ms" /end CHARACTERISTIC
/begin CHARACTERISTIC FPfu_ADIG13_max "FPrm_unlatch(302)" VALUE 0x001E1018 /* @ECU_Address@FPrm_unlatch@0x021BD4B8@ */ ECIPP_ALIGNMENT_FLOAT32_IEEE 10000000000 Compu_IDENTITY -10000000000 10000000000 PHYS_UNIT "ms" /end CHARACTERISTIC
/begin CHARACTERISTIC FPfu_ADIG13_min "FPrm_unlatch(303)" VALUE 0x001E101C /* @ECU_Address@FPrm_unlatch@0x021BD4BC@ */ ECIPP_ALIGNMENT_FLOAT32_IEEE 10000000000 Compu_IDENTITY -10000000000 10000000000 PHYS_UNIT "ms" /end CHARACTERISTIC
/begin CHARACTERISTIC FPfu_ADIG14_max "FPrm_unlatch(304)" VALUE 0x001E1020 /* @ECU_Address@FPrm_unlatch@0x021BD4C0@ */ ECIPP_ALIGNMENT_FLOAT32_IEEE 10000000000 Compu_IDENTITY -10000000000 10000000000 PHYS_UNIT "ms" /end CHARACTERISTIC
/begin CHARACTERISTIC FPfu_ADIG14_min "FPrm_unlatch(305)" VALUE 0x001E1024 /* @ECU_Address@FPrm_unlatch@0x021BD4C4@ */ ECIPP_ALIGNMENT_FLOAT32_IEEE 10000000000 Compu_IDENTITY -10000000000 10000000000 PHYS_UNIT "ms" /end CHARACTERISTIC
/begin CHARACTERISTIC FPfu_ADIG15_max "FPrm_unlatch(306)" VALUE 0x001E1028 /* @ECU_Address@FPrm_unlatch@0x021BD4C8@ */ ECIPP_ALIGNMENT_FLOAT32_IEEE 10000000000 Compu_IDENTITY -10000000000 10000000000 PHYS_UNIT "ms" /end CHARACTERISTIC
/begin CHARACTERISTIC FPfu_ADIG15_min "FPrm_unlatch(307)" VALUE 0x001E102C /* @ECU_Address@FPrm_unlatch@0x021BD4CC@ */ ECIPP_ALIGNMENT_FLOAT32_IEEE 10000000000 Compu_IDENTITY -10000000000 10000000000 PHYS_UNIT "ms" /end CHARACTERISTIC
/begin CHARACTERISTIC FPfu_ADIG16_max "FPrm_unlatch(308)" VALUE 0x001E1030 /* @ECU_Address@FPrm_unlatch@0x021BD4D0@ */ ECIPP_ALIGNMENT_FLOAT32_IEEE 10000000000 Compu_IDENTITY -10000000000 10000000000 PHYS_UNIT "ms" /end CHARACTERISTIC
/begin CHARACTERISTIC FPfu_ADIG16_min "FPrm_unlatch(309)" VALUE 0x001E1034 /* @ECU_Address@FPrm_unlatch@0x021BD4D4@ */ ECIPP_ALIGNMENT_FLOAT32_IEEE 10000000000 Compu_IDENTITY -10000000000 10000000000 PHYS_UNIT "ms" /end CHARACTERISTIC
/begin CHARACTERISTIC FPfu_ADIG17_max "FPrm_unlatch(310)" VALUE 0x001E1038 /* @ECU_Address@FPrm_unlatch@0x021BD4D8@ */ ECIPP_ALIGNMENT_FLOAT32_IEEE 10000000000 Compu_IDENTITY -10000000000 10000000000 PHYS_UNIT "ms" /end CHARACTERISTIC
/begin CHARACTERISTIC FPfu_ADIG17_min "FPrm_unlatch(311)" VALUE 0x001E103C /* @ECU_Address@FPrm_unlatch@0x021BD4DC@ */ ECIPP_ALIGNMENT_FLOAT32_IEEE 10000000000 Compu_IDENTITY -10000000000 10000000000 PHYS_UNIT "ms" /end CHARACTERISTIC
/begin CHARACTERISTIC FPfu_ADIG18_max "FPrm_unlatch(312)" VALUE 0x001E1040 /* @ECU_Address@FPrm_unlatch@0x021BD4E0@ */ ECIPP_ALIGNMENT_FLOAT32_IEEE 10000000000 Compu_IDENTITY -10000000000 10000000000 PHYS_UNIT "ms" /end CHARACTERISTIC
/begin CHARACTERISTIC FPfu_ADIG18_min "FPrm_unlatch(313)" VALUE 0x001E1044 /* @ECU_Address@FPrm_unlatch@0x021BD4E4@ */ ECIPP_ALIGNMENT_FLOAT32_IEEE 10000000000 Compu_IDENTITY -10000000000 10000000000 PHYS_UNIT "ms" /end CHARACTERISTIC
/begin CHARACTERISTIC FPfu_ADIG19_max "FPrm_unlatch(314)" VALUE 0x001E1048 /* @ECU_Address@FPrm_unlatch@0x021BD4E8@ */ ECIPP_ALIGNMENT_FLOAT32_IEEE 10000000000 Compu_IDENTITY -10000000000 10000000000 PHYS_UNIT "ms" /end CHARACTERISTIC
/begin CHARACTERISTIC FPfu_ADIG19_min "FPrm_unlatch(315)" VALUE 0x001E104C /* @ECU_Address@FPrm_unlatch@0x021BD4EC@ */ ECIPP_ALIGNMENT_FLOAT32_IEEE 10000000000 Compu_IDENTITY -10000000000 10000000000 PHYS_UNIT "ms" /end CHARACTERISTIC
/begin CHARACTERISTIC FPfu_ADIG2_max "FPrm_unlatch(167)" VALUE 0x001E0DFC /* @ECU_Address@FPrm_unlatch@0x021BD29C@ */ ECIPP_ALIGNMENT_FLOAT32_IEEE 10000000000 Compu_IDENTITY -10000000000 10000000000 PHYS_UNIT "ms" /end CHARACTERISTIC
/begin CHARACTERISTIC FPfu_ADIG2_min "FPrm_unlatch(168)" VALUE 0x001E0E00 /* @ECU_Address@FPrm_unlatch@0x021BD2A0@ */ ECIPP_ALIGNMENT_FLOAT32_IEEE 10000000000 Compu_IDENTITY -10000000000 10000000000 PHYS_UNIT "ms" /end CHARACTERISTIC
/begin CHARACTERISTIC FPfu_ADIG20_max "FPrm_unlatch(438)" VALUE 0x001E1238 /* @ECU_Address@FPrm_unlatch@0x021BD6D8@ */ ECIPP_ALIGNMENT_FLOAT32_IEEE 10000000000 Compu_IDENTITY -10000000000 10000000000 PHYS_UNIT "ms" /end CHARACTERISTIC
/begin CHARACTERISTIC FPfu_ADIG20_min "FPrm_unlatch(439)" VALUE 0x001E123C /* @ECU_Address@FPrm_unlatch@0x021BD6DC@ */ ECIPP_ALIGNMENT_FLOAT32_IEEE 10000000000 Compu_IDENTITY -10000000000 10000000000 PHYS_UNIT "ms" /end CHARACTERISTIC
/begin CHARACTERISTIC FPfu_ADIG21_max "FPrm_unlatch(440)" VALUE 0x001E1240 /* @ECU_Address@FPrm_unlatch@0x021BD6E0@ */ ECIPP_ALIGNMENT_FLOAT32_IEEE 10000000000 Compu_IDENTITY -10000000000 10000000000 PHYS_UNIT "ms" /end CHARACTERISTIC
/begin CHARACTERISTIC FPfu_ADIG21_min "FPrm_unlatch(441)" VALUE 0x001E1244 /* @ECU_Address@FPrm_unlatch@0x021BD6E4@ */ ECIPP_ALIGNMENT_FLOAT32_IEEE 10000000000 Compu_IDENTITY -10000000000 10000000000 PHYS_UNIT "ms" /end CHARACTERISTIC
/begin CHARACTERISTIC FPfu_ADIG22_max "FPrm_unlatch(442)" VALUE 0x001E1248 /* @ECU_Address@FPrm_unlatch@0x021BD6E8@ */ ECIPP_ALIGNMENT_FLOAT32_IEEE 10000000000 Compu_IDENTITY -10000000000 10000000000 PHYS_UNIT "ms" /end CHARACTERISTIC
/begin GROUP EC_NONE_100 "ECONTROLS" ROOT
 /begin REF_CHARACTERISTIC SH_def AAT_def RS_present key_on_waitalt ALfltG_RPMmin ALfltG_RPMmax ALfltP_RPMmin ALfltP_RPMmax ALfltN_RPMmin ALfltN_RPMmax CLfltG_RPMmin CLfltP_RPMmin CLfltN_RPMmin CLfltG_RPMmax CLfltP_RPMmax CLfltN_RPMmax ALfltG_MAPmin ALfltP_MAPmin ALfltN_MAPmin ALfltG_MAPmax ALfltP_MAPmax ALfltN_MAPmax CLfltG_MAPmin CLfltP_MAPmin CLfltN_MAPmin CLfltG_MAPmax CLfltP_MAPmax CLfltN_MAPmax MJ_ctl_strat Carb_loc MJ_param_comm key_off_valid key_offrel_valid BstTIP_Hi BstTIP_Hi_abs BstTIP_Hi_dtdz BstTIP_Lo_dtdz BstTIP_Lo BstTIP_Lo_abs BstTIP_Lo_ECT TIP_act TIP_actMAP IAC_home_int_min FPP1_5V_source FPP2_5V_source cam_pos_tau FaultCylBlock_use ADIG3_max J1939_TSC1_loss TRIM_lim_bhvP TRIM_lim_bhvN J1939_ETC_loss V_LPG V_NG key_on_wait fpump_key_wait lockoff_key_wait LOD_WARN_force SWARN_bulbchk HWARN_bulbchk J1939_DM19_calid J1939_DM5_OBDc Vs FPin_s FPout_s FP_ena FP_abs_gage adapt_ena HWARN_bulbon SWARN_bulbon fuelclr_mult CRI_V_relay FPin_s_I2 FPout_s_I2 Vs_I2 FP_ena_I2 FP_abs_gage_I2 FPraw_LP_I2 EGR_clr_Cr_nom EGR_clr_eta_nom EGT_ena TOT_ena EGR_PWM_period EGR_vlv_tau EGR_Vrelay_nominal CFV_Preg_HiExp CFV_Preg_LoExp TC_comp_Pref TC_comp_Tref TC_turb_Nr_pct TC_turb_Pref TC_turb_Tref TC_turb_etamin TC_turb_mdotr_pct TC_turb_mdot0c_pct IMVD_Ifb_hi IMVD_Ifb_lo IMVD_lo_Icmd IMVD_lo_PWcmd INJD_Vboost_LOtol INJD_Vboost_HItol INJD_max_riseT INJD_min_riseT CRI_FPerr_high CRI_FPerr_low key_on_relay_force DATE_engine_defMfg COT_ena CylTempSwt_chan CylTempSwt_chan_cfg VDS_enghrs_limit adapt_fuel_rpm_src adapt_fuel_rpm_dz HWARN_lamp SWARN_lamp DERATE_lamp LOWREVLIM_lamp SD_lamp DERATEblk_on LOWREVLIMblk_on SDblk_on DERATEblk_off LOWREVLIMblk_off SDblk_off MIL_DM1_output FSS_cust_tbl_def FDR_cust_tbl_def TMJ_KcompN_Kc TMJ_KcompP_Kc TMJ_Kcomp_PR TTM_PRKc_Kc TTM_PRKc_PR TVEmod_ECT_mul TVEmod_MAT_mul Tspkmx_ECT_CAD TFlt_xface_addr TFlt_xface2_addr TFlt_xface3_addr TCRI_ontime TCRI_rho_diesel TCRI_air_std TCRI_air_alt1 TCRI_P_cld TCRI_P_std TCRI_P_alt1 TCRI_smk_limit TCRI_Qpilot2_cld TCRI_Qpilot2_std TCRI_Qpilot2_alt1 TCRI_Qpilot1_cld TCRI_Qpilot1_std TCRI_Qpilot1_alt1 TCRI_Qmain_cld TCRI_Qload_std TCRI_Qload_alt1 TCRI_Qload_alt2 TCRI_Qpost1_std TCRI_Qpost1_alt1 TCRI_Qpost2_std TCRI_Qpost2_alt1 TCRI_Tpilot2_cld TCRI_Tpilot2_std TCRI_Tpilot2_alt1 TCRI_Tpilot1_std TCRI_Tpilot1_alt1 TCRI_Tmain_cld TCRI_Tmain_std TCRI_Tmain_alt1 TCRI_Tmain_alt2 TCRI_Tpost1_cld TCRI_Tpost1_std TCRI_Tpost1_alt1 TCRI_Tpost2_cld TCRI_Tpost2_std TCRI_Tpost2_alt1 TCRI_Qmin TCRI_pulseoff_std TCRI_pulseoff_alt1 TDOC_Tcl_std TDOC_Tcl_alt1 TTC_turb_Pratio TTC_comp_Npct TTC_turb_Nmult_neg TTC_turb_Nmult_pos TTC_turb_etamax TTC_turb_Npct_etamax TTC_turb_mdot1c_pct HEX_FSS_PID_tbl /end REF_CHARACTERISTIC
 /begin REF_MEASUREMENT emcal_CS_16 totalcal_CS_16 m_d_pct_reqnom /end REF_MEASUREMENT
/end GROUP
/begin GROUP accel_x_max_EC_Fault "Accelerometer X-axis out-of-range high"
 /begin REF_CHARACTERISTIC FCdc4_accel_x_max FCdtc_accel_x_max FCfmi_accel_x_max FCftb_accel_x_max FCspn_accel_x_max FPfl_accel_x_max FPfu_accel_x_max FPnd_accel_x_max FPsvr_accel_x_max FPsw_ext1_accel_x_max FPsw_accel_x_max /end REF_CHARACTERISTIC
/end GROUP
/begin GROUP accel_x_min_EC_Fault "Accelerometer X-axis out-of-range low"
 /begin REF_CHARACTERISTIC FCdc4_accel_x_min FCdtc_accel_x_min FCfmi_accel_x_min FCftb_accel_x_min FCspn_accel_x_min FPfl_accel_x_min FPfu_accel_x_min FPnd_accel_x_min FPsvr_accel_x_min FPsw_ext1_accel_x_min FPsw_accel_x_min /end REF_CHARACTERISTIC
/end GROUP
/begin GROUP accel_y_max_EC_Fault "Accelerometer Y-axis out-of-range high"
 /begin REF_CHARACTERISTIC FCdc4_accel_y_max FCdtc_accel_y_max FCfmi_accel_y_max FCftb_accel_y_max FCspn_accel_y_max FPfl_accel_y_max FPfu_accel_y_max FPnd_accel_y_max FPsvr_accel_y_max FPsw_ext1_accel_y_max FPsw_accel_y_max /end REF_CHARACTERISTIC
/end GROUP
/begin GROUP accel_y_min_EC_Fault "Accelerometer Y-axis out-of-range low"
 /begin REF_CHARACTERISTIC FCdc4_accel_y_min FCdtc_accel_y_min FCfmi_accel_y_min FCftb_accel_y_min FCspn_accel_y_min FPfl_accel_y_min FPfu_accel_y_min FPnd_accel_y_min FPsvr_accel_y_min FPsw_ext1_accel_y_min FPsw_accel_y_min /end REF_CHARACTERISTIC
/end GROUP
/begin GROUP accel_z_max_EC_Fault "Accelerometer Z-axis out-of-range high"
 /begin REF_CHARACTERISTIC FCdc4_accel_z_max FCdtc_accel_z_max FCfmi_accel_z_max FCftb_accel_z_max FCspn_accel_z_max FPfl_accel_z_max FPfu_accel_z_max FPnd_accel_z_max FPsvr_accel_z_max FPsw_ext1_accel_z_max FPsw_accel_z_max /end REF_CHARACTERISTIC
/end GROUP
/begin GROUP accel_z_min_EC_Fault "Accelerometer Z-axis out-of-range low"
 /begin REF_CHARACTERISTIC FCdc4_accel_z_min FCdtc_accel_z_min FCfmi_accel_z_min FCftb_accel_z_min FCspn_accel_z_min FPfl_accel_z_min FPfu_accel_z_min FPnd_accel_z_min FPsvr_accel_z_min FPsw_ext1_accel_z_min FPsw_accel_z_min /end REF_CHARACTERISTIC
/end GROUP
/begin GROUP ACLT_intTlim_OOA_EC_Fault "Intercooler temperature limiting out of authority"
 /begin REF_CHARACTERISTIC FCdc4_ACLT_intTlim_OOA FCdtc_ACLT_intTlim_OOA FCfmi_ACLT_intTlim_OOA FCftb_ACLT_intTlim_OOA FCspn_ACLT_intTlim_OOA FPfl_ACLT_intTlim_OOA FPfu_ACLT_intTlim_OOA FPnd_ACLT_intTlim_OOA FPsvr_ACLT_intTlim_OOA FPsw_ext1_ACLT_intTlim_OOA FPsw_ACLT_intTlim_OOA /end REF_CHARACTERISTIC
/end GROUP
/begin GROUP ACT_hi_EC_Fault "ACT temperature high"
 /begin REF_CHARACTERISTIC FCdc4_ACT_hi FCdtc_ACT_hi FCfmi_ACT_hi FCftb_ACT_hi FCspn_ACT_hi FPfl_ACT_hi FPfu_ACT_hi FPnd_ACT_hi FPsvr_ACT_hi FPsw_ext1_ACT_hi FPsw_ACT_hi /end REF_CHARACTERISTIC
/end GROUP
/begin GROUP ADIG1_max_EC_Fault "AUX digital 1 high voltage"
 /begin REF_CHARACTERISTIC FCdc4_ADIG1_max FCdtc_ADIG1_max FCfmi_ADIG1_max FCftb_ADIG1_max FCspn_ADIG1_max FPfl_ADIG1_max FPfu_ADIG1_max FPnd_ADIG1_max FPsvr_ADIG1_max FPsw_ext1_ADIG1_max FPsw_ADIG1_max /end REF_CHARACTERISTIC
/end GROUP
/begin GROUP ADIG1_min_EC_Fault "AUX digital 1 low voltage"
 /begin REF_CHARACTERISTIC FCdc4_ADIG1_min FCdtc_ADIG1_min FCfmi_ADIG1_min FCftb_ADIG1_min FCspn_ADIG1_min FPfl_ADIG1_min FPfu_ADIG1_min FPnd_ADIG1_min FPsvr_ADIG1_min FPsw_ext1_ADIG1_min FPsw_ADIG1_min /end REF_CHARACTERISTIC
/end GROUP
/begin GROUP ADIG10_max_EC_Fault "AUX digital 10 high voltage"
 /begin REF_CHARACTERISTIC FCdc4_ADIG10_max FCdtc_ADIG10_max FCfmi_ADIG10_max FCftb_ADIG10_max FCspn_ADIG10_max FPfl_ADIG10_max FPfu_ADIG10_max FPnd_ADIG10_max FPsvr_ADIG10_max FPsw_ext1_ADIG10_max FPsw_ADIG10_max /end REF_CHARACTERISTIC
/end GROUP
/begin GROUP ADIG10_min_EC_Fault "AUX digital 10 low voltage"
 /begin REF_CHARACTERISTIC FCdc4_ADIG10_min FCdtc_ADIG10_min FCfmi_ADIG10_min FCftb_ADIG10_min FCspn_ADIG10_min FPfl_ADIG10_min FPfu_ADIG10_min FPnd_ADIG10_min FPsvr_ADIG10_min FPsw_ext1_ADIG10_min FPsw_ADIG10_min /end REF_CHARACTERISTIC
/end GROUP
/begin GROUP ADIG11_max_EC_Fault "AUX digital 11 high voltage"
 /begin REF_CHARACTERISTIC FCdc4_ADIG11_max FCdtc_ADIG11_max FCfmi_ADIG11_max FCftb_ADIG11_max FCspn_ADIG11_max FPfl_ADIG11_max FPfu_ADIG11_max FPnd_ADIG11_max FPsvr_ADIG11_max FPsw_ext1_ADIG11_max FPsw_ADIG11_max /end REF_CHARACTERISTIC
/end GROUP
/begin GROUP ADIG11_min_EC_Fault "AUX digital 11 low voltage"
 /begin REF_CHARACTERISTIC FCdc4_ADIG11_min FCdtc_ADIG11_min FCfmi_ADIG11_min FCftb_ADIG11_min FCspn_ADIG11_min FPfl_ADIG11_min FPfu_ADIG11_min FPnd_ADIG11_min FPsvr_ADIG11_min FPsw_ext1_ADIG11_min FPsw_ADIG11_min /end REF_CHARACTERISTIC
/end GROUP
/begin GROUP ADIG12_max_EC_Fault "AUX digital 12 high voltage"
 /begin REF_CHARACTERISTIC FCdc4_ADIG12_max FCdtc_ADIG12_max FCfmi_ADIG12_max FCftb_ADIG12_max FCspn_ADIG12_max FPfl_ADIG12_max FPfu_ADIG12_max FPnd_ADIG12_max FPsvr_ADIG12_max FPsw_ext1_ADIG12_max FPsw_ADIG12_max /end REF_CHARACTERISTIC
/end GROUP
/begin GROUP ADIG12_min_EC_Fault "AUX digital 12 low voltage"
 /begin REF_CHARACTERISTIC FCdc4_ADIG12_min FCdtc_ADIG12_min FCfmi_ADIG12_min FCftb_ADIG12_min FCspn_ADIG12_min FPfl_ADIG12_min FPfu_ADIG12_min FPnd_ADIG12_min FPsvr_ADIG12_min FPsw_ext1_ADIG12_min FPsw_ADIG12_min /end REF_CHARACTERISTIC
/end GROUP
/begin GROUP ADIG13_max_EC_Fault "AUX digital 13 high voltage"
 /begin REF_CHARACTERISTIC FCdc4_ADIG13_max FCdtc_ADIG13_max FCfmi_ADIG13_max FCftb_ADIG13_max FCspn_ADIG13_max FPfl_ADIG13_max FPfu_ADIG13_max FPnd_ADIG13_max FPsvr_ADIG13_max FPsw_ext1_ADIG13_max FPsw_ADIG13_max /end REF_CHARACTERISTIC
/end GROUP
/begin GROUP ADIG13_min_EC_Fault "AUX digital 13 low voltage"
 /begin REF_CHARACTERISTIC FCdc4_ADIG13_min FCdtc_ADIG13_min FCfmi_ADIG13_min FCftb_ADIG13_min FCspn_ADIG13_min FPfl_ADIG13_min FPfu_ADIG13_min FPnd_ADIG13_min FPsvr_ADIG13_min FPsw_ext1_ADIG13_min FPsw_ADIG13_min /end REF_CHARACTERISTIC
/end GROUP
/begin GROUP ADIG14_max_EC_Fault "AUX digital 14 high voltage"
 /begin REF_CHARACTERISTIC FCdc4_ADIG14_max FCdtc_ADIG14_max FCfmi_ADIG14_max FCftb_ADIG14_max FCspn_ADIG14_max FPfl_ADIG14_max FPfu_ADIG14_max FPnd_ADIG14_max FPsvr_ADIG14_max FPsw_ext1_ADIG14_max FPsw_ADIG14_max /end REF_CHARACTERISTIC
/end GROUP
/begin GROUP ADIG14_min_EC_Fault "AUX digital 14 low voltage"
 /begin REF_CHARACTERISTIC FCdc4_ADIG14_min FCdtc_ADIG14_min FCfmi_ADIG14_min FCftb_ADIG14_min FCspn_ADIG14_min FPfl_ADIG14_min FPfu_ADIG14_min FPnd_ADIG14_min FPsvr_ADIG14_min FPsw_ext1_ADIG14_min FPsw_ADIG14_min /end REF_CHARACTERISTIC
/end GROUP
/begin GROUP ADIG15_max_EC_Fault "AUX digital 15 high voltage"
 /begin REF_CHARACTERISTIC FCdc4_ADIG15_max FCdtc_ADIG15_max FCfmi_ADIG15_max FCftb_ADIG15_max FCspn_ADIG15_max FPfl_ADIG15_max FPfu_ADIG15_max FPnd_ADIG15_max FPsvr_ADIG15_max FPsw_ext1_ADIG15_max FPsw_ADIG15_max /end REF_CHARACTERISTIC
/end GROUP
/begin GROUP ADIG15_min_EC_Fault "AUX digital 15 low voltage"
 /begin REF_CHARACTERISTIC FCdc4_ADIG15_min FCdtc_ADIG15_min FCfmi_ADIG15_min FCftb_ADIG15_min FCspn_ADIG15_min FPfl_ADIG15_min FPfu_ADIG15_min FPnd_ADIG15_min FPsvr_ADIG15_min FPsw_ext1_ADIG15_min FPsw_ADIG15_min /end REF_CHARACTERISTIC
/end GROUP
/begin GROUP ADIG16_max_EC_Fault "AUX digital 16 high voltage"
 /begin REF_CHARACTERISTIC FCdc4_ADIG16_max FCdtc_ADIG16_max FCfmi_ADIG16_max FCftb_ADIG16_max FCspn_ADIG16_max FPfl_ADIG16_max FPfu_ADIG16_max FPnd_ADIG16_max FPsvr_ADIG16_max FPsw_ext1_ADIG16_max FPsw_ADIG16_max /end REF_CHARACTERISTIC
/end GROUP
/begin GROUP ADIG16_min_EC_Fault "AUX digital 16 low voltage"
 /begin REF_CHARACTERISTIC FCdc4_ADIG16_min FCdtc_ADIG16_min FCfmi_ADIG16_min FCftb_ADIG16_min FCspn_ADIG16_min FPfl_ADIG16_min FPfu_ADIG16_min FPnd_ADIG16_min FPsvr_ADIG16_min FPsw_ext1_ADIG16_min FPsw_ADIG16_min /end REF_CHARACTERISTIC
/end GROUP
/begin GROUP ADIG17_max_EC_Fault "AUX digital 17 high voltage"
 /begin REF_CHARACTERISTIC FCdc4_ADIG17_max FCdtc_ADIG17_max FCfmi_ADIG17_max FCftb_ADIG17_max FCspn_ADIG17_max FPfl_ADIG17_max FPfu_ADIG17_max FPnd_ADIG17_max FPsvr_ADIG17_max FPsw_ext1_ADIG17_max FPsw_ADIG17_max /end REF_CHARACTERISTIC
/end GROUP
/begin GROUP ADIG17_min_EC_Fault "AUX digital 17 low voltage"
 /begin REF_CHARACTERISTIC FCdc4_ADIG17_min FCdtc_ADIG17_min FCfmi_ADIG17_min FCftb_ADIG17_min FCspn_ADIG17_min FPfl_ADIG17_min FPfu_ADIG17_min FPnd_ADIG17_min FPsvr_ADIG17_min FPsw_ext1_ADIG17_min FPsw_ADIG17_min /end REF_CHARACTERISTIC
/end GROUP
/begin GROUP ADIG18_max_EC_Fault "AUX digital 18 high voltage"
 /begin REF_CHARACTERISTIC FCdc4_ADIG18_max FCdtc_ADIG18_max FCfmi_ADIG18_max FCftb_ADIG18_max FCspn_ADIG18_max FPfl_ADIG18_max FPfu_ADIG18_max FPnd_ADIG18_max FPsvr_ADIG18_max FPsw_ext1_ADIG18_max FPsw_ADIG18_max /end REF_CHARACTERISTIC
/end GROUP
/begin GROUP ADIG18_min_EC_Fault "AUX digital 18 low voltage"
 /begin REF_CHARACTERISTIC FCdc4_ADIG18_min FCdtc_ADIG18_min FCfmi_ADIG18_min FCftb_ADIG18_min FCspn_ADIG18_min FPfl_ADIG18_min FPfu_ADIG18_min FPnd_ADIG18_min FPsvr_ADIG18_min FPsw_ext1_ADIG18_min FPsw_ADIG18_min /end REF_CHARACTERISTIC
/end GROUP
/begin GROUP ADIG19_max_EC_Fault "AUX digital 19 high voltage"
 /begin REF_CHARACTERISTIC FCdc4_ADIG19_max FCdtc_ADIG19_max FCfmi_ADIG19_max FCftb_ADIG19_max FCspn_ADIG19_max FPfl_ADIG19_max FPfu_ADIG19_max FPnd_ADIG19_max FPsvr_ADIG19_max FPsw_ext1_ADIG19_max FPsw_ADIG19_max /end REF_CHARACTERISTIC
/end GROUP
/begin GROUP ADIG19_min_EC_Fault "AUX digital 19 low voltage"
 /begin REF_CHARACTERISTIC FCdc4_ADIG19_min FCdtc_ADIG19_min FCfmi_ADIG19_min FCftb_ADIG19_min FCspn_ADIG19_min FPfl_ADIG19_min FPfu_ADIG19_min FPnd_ADIG19_min FPsvr_ADIG19_min FPsw_ext1_ADIG19_min FPsw_ADIG19_min /end REF_CHARACTERISTIC
/end GROUP
/begin GROUP ADIG2_max_EC_Fault "AUX digital 2 high voltage"
 /begin REF_CHARACTERISTIC FCdc4_ADIG2_max FCdtc_ADIG2_max FCfmi_ADIG2_max FCftb_ADIG2_max FCspn_ADIG2_max FPfl_ADIG2_max FPfu_ADIG2_max FPnd_ADIG2_max FPsvr_ADIG2_max FPsw_ext1_ADIG2_max FPsw_ADIG2_max /end REF_CHARACTERISTIC
/end GROUP
/begin GROUP ADIG2_min_EC_Fault "AUX digital 2 low voltage"
 /begin REF_CHARACTERISTIC FCdc4_ADIG2_min FCdtc_ADIG2_min FCfmi_ADIG2_min FCftb_ADIG2_min FCspn_ADIG2_min FPfl_ADIG2_min FPfu_ADIG2_min FPnd_ADIG2_min FPsvr_ADIG2_min FPsw_ext1_ADIG2_min FPsw_ADIG2_min /end REF_CHARACTERISTIC
/end GROUP
/begin GROUP ADIG20_max_EC_Fault "AUX digital 20 high voltage"
 /begin REF_CHARACTERISTIC FCdc4_ADIG20_max FCdtc_ADIG20_max FCfmi_ADIG20_max FCftb_ADIG20_max FCspn_ADIG20_max FPfl_ADIG20_max FPfu_ADIG20_max FPnd_ADIG20_max FPsvr_ADIG20_max FPsw_ext1_ADIG20_max FPsw_ADIG20_max /end REF_CHARACTERISTIC
/end GROUP
/begin GROUP ADIG20_min_EC_Fault "AUX digital 20 low voltage"
 /begin REF_CHARACTERISTIC FCdc4_ADIG20_min FCdtc_ADIG20_min FCfmi_ADIG20_min FCftb_ADIG20_min FCspn_ADIG20_min FPfl_ADIG20_min FPfu_ADIG20_min FPnd_ADIG20_min FPsvr_ADIG20_min FPsw_ext1_ADIG20_min FPsw_ADIG20_min /end REF_CHARACTERISTIC
/end GROUP
/begin GROUP ADIG21_max_EC_Fault "AUX digital 21 high voltage"
 /begin REF_CHARACTERISTIC FCdc4_ADIG21_max FCdtc_ADIG21_max FCfmi_ADIG21_max FCftb_ADIG21_max FCspn_ADIG21_max FPfl_ADIG21_max FPfu_ADIG21_max FPnd_ADIG21_max FPsvr_ADIG21_max FPsw_ext1_ADIG21_max FPsw_ADIG21_max /end REF_CHARACTERISTIC
/end GROUP
/begin GROUP ADIG21_min_EC_Fault "AUX digital 21 low voltage"
 /begin REF_CHARACTERISTIC FCdc4_ADIG21_min FCdtc_ADIG21_min FCfmi_ADIG21_min FCftb_ADIG21_min FCspn_ADIG21_min FPfl_ADIG21_min FPfu_ADIG21_min FPnd_ADIG21_min FPsvr_ADIG21_min FPsw_ext1_ADIG21_min FPsw_ADIG21_min /end REF_CHARACTERISTIC
/end GROUP
/begin GROUP ADIG22_max_EC_Fault "AUX digital 22 high voltage"
 /begin REF_CHARACTERISTIC FCdc4_ADIG22_max FCdtc_ADIG22_max FCfmi_ADIG22_max FCftb_ADIG22_max FCspn_ADIG22_max FPfl_ADIG22_max FPfu_ADIG22_max FPnd_ADIG22_max FPsvr_ADIG22_max FPsw_ext1_ADIG22_max FPsw_ADIG22_max /end REF_CHARACTERISTIC
/end GROUP
/end MODULE
/end PROJECT
